ASAP2_VERSION 1 41
/begin PROJECT RD8 "_default_ProjectLongIdentifier"
/begin HEADER "_default_HeaderComment" PROJECT_NO RD9 /end HEADER
/begin MODULE _default_ModuleName "_default_ModuleLongIdentifier"
/begin MOD_COMMON "_default_ModCommonComment" DEPOSIT ABSOLUTE BYTE_ORDER MSB_LAST ALIGNMENT_BYTE 1 ALIGNMENT_WORD 2 ALIGNMENT_LONG 2 ALIGNMENT_FLOAT32_IEEE 2 ALIGNMENT_FLOAT64_IEEE 4 /end MOD_COMMON
/begin MEASUREMENT Vxx_acel_pdl_secu_ctr "Counter of accelerator pedal safety case detected failure N°1" UBYTE _CNV_A_R_ECME_LINEA_0_CM 1 0. 0. 255. DISPLAY_IDENTIFIER InPciApi_NVM.Vxx_acel_pdl_secu_ctr_NVM ECU_ADDRESS 0xd0007bdb FORMAT "%3.0" /end MEASUREMENT
/begin MEASUREMENT Vbx_acel_pdl_100_rat "Accel pedal depressed beyond 100% ratio" UBYTE _CNV_S_2_RANGE______3_CM 1 0. 0. 1. ECU_ADDRESS 0xd0006bc5 BIT_MASK 0x1 /end MEASUREMENT
/begin MEASUREMENT Vbx_acel_pdl_kd "accel pedal depressed beyond mechanical hard point (if no mechanical KD, flag remains inactive)" UBYTE _CNV_S_2_RANGE______3_CM 1 0. 0. 1. ECU_ADDRESS 0xd0006bc6 BIT_MASK 0x1 /end MEASUREMENT
/begin MEASUREMENT Vsx_acel_pdl_rat_vld "Normalised acelerator pedal position" UBYTE _CNV_S_3_STATUS_OK__179_CM 1 0. 0. 2. ECU_ADDRESS 0xd0006bc7 /end MEASUREMENT
/begin MEASUREMENT Vxx_acel_pdl_0_rat_v "Uref ratio value defining 0 pedal ratio position" UWORD _CNV_A_R_LINEAR_____266_CM 1 0. 0. 1. ECU_ADDRESS 0xd0004372 FORMAT "%9.7" /end MEASUREMENT
/begin MEASUREMENT Vxx_acel_pdl_100_rat_v "Uref ratio value defining 1 pedal ratio position" UWORD _CNV_A_R_LINEAR_____266_CM 1 0. 0. 1. ECU_ADDRESS 0xd0004374 FORMAT "%9.7" /end MEASUREMENT
/begin MEASUREMENT Vxx_acel_pdl_100_rat_v_max "Uref ratio value defining the activation of 100% pedal ratio flag" UWORD _CNV_A_R_LINEAR_____266_CM 1 0. 0. 1. ECU_ADDRESS 0xd0004376 FORMAT "%9.7" /end MEASUREMENT
/begin MEASUREMENT Vxx_acel_pdl_kd_in_thd "Uref ratio entry threshold for accelerato pedal kick-down detection" UWORD _CNV_A_R_LINEAR_____266_CM 1 0. 0. 1. ECU_ADDRESS 0xd0004378 FORMAT "%9.7" /end MEASUREMENT
/begin MEASUREMENT Vxx_acel_pdl_rat "Normalised accelerator pedal position" UWORD _CNV_A_R_LINEAR_____267_CM 1 0. 0. 1.25 ECU_ADDRESS 0xd000437a FORMAT "%7.5" /end MEASUREMENT
/begin CHARACTERISTIC Cxx_acel_pdl_0_rat_v_nok "Uref ratio value defining 0 pedal ratio position if failure on track 1 and no failure on track 2" VALUE 0xa0021528 _REC_S1VAL_20_u2 1. _CNV_A_R_LINEAR_____266_CM 0. 1. FORMAT "%9.7" /end CHARACTERISTIC
/begin CHARACTERISTIC Cxx_acel_pdl_0_rat_v_ok "Uref ratio value defining 0 pedal ratio position when pedal sensor is in nominal operation (track 1)" VALUE 0xa002152a _REC_S1VAL_20_u2 1. _CNV_A_R_LINEAR_____266_CM 0. 1. FORMAT "%9.7" /end CHARACTERISTIC
/begin CHARACTERISTIC Cxx_acel_pdl_100_rat_v_hys "Uref ratio hysteresis linked with 100% pedal ratio flag" VALUE 0xa002152c _REC_S1VAL_20_u2 1. _CNV_A_R_LINEAR_____266_CM 0. 1. FORMAT "%9.7" /end CHARACTERISTIC
/begin CHARACTERISTIC Cxx_acel_pdl_100_rat_v_max_nok "Uref ratio maximum value defining 100% pedal ratio flag if failure on track 1 and no failure on track 2" VALUE 0xa002152e _REC_S1VAL_20_u2 1. _CNV_A_R_LINEAR_____266_CM 0. 1. FORMAT "%9.7" /end CHARACTERISTIC
/begin CHARACTERISTIC Cxx_acel_pdl_100_rat_v_max_ok "Uref ratio maximum value defining 100% pedal ratio flag when pedal sensor is in nominal operation (track 1)" VALUE 0xa0021530 _REC_S1VAL_20_u2 1. _CNV_A_R_LINEAR_____266_CM 0. 1. FORMAT "%9.7" /end CHARACTERISTIC
/begin CHARACTERISTIC Cxx_acel_pdl_100_rat_v_nok "Uref ratio value defining 100% pedal ratio position if failure on track 1 and no failure on track 2" VALUE 0xa0021532 _REC_S1VAL_20_u2 1. _CNV_A_R_LINEAR_____266_CM 0. 1. FORMAT "%9.7" /end CHARACTERISTIC
/begin CHARACTERISTIC Cxx_acel_pdl_100_rat_v_ok "Uref ratio value defining 100% pedal ratio position when pedal sensor is in nominal operation (track 1)" VALUE 0xa0021534 _REC_S1VAL_20_u2 1. _CNV_A_R_LINEAR_____266_CM 0. 1. FORMAT "%9.7" /end CHARACTERISTIC
/begin CHARACTERISTIC Cxx_acel_pdl_kd_hys "Uref ratio hysteresis linked with kick-down flag" VALUE 0xa0021536 _REC_S1VAL_20_u2 1. _CNV_A_R_LINEAR_____266_CM 0. 1. FORMAT "%9.7" /end CHARACTERISTIC
/begin CHARACTERISTIC Cxx_acel_pdl_kd_in_thd_nok "Uref ratio entry threshold to activate kick-down flag if failure on track 1 and no failure on track 2" VALUE 0xa0021538 _REC_S1VAL_20_u2 1. _CNV_A_R_LINEAR_____266_CM 0. 1. FORMAT "%9.7" /end CHARACTERISTIC
/begin CHARACTERISTIC Cxx_acel_pdl_kd_in_thd_ok "Uref ratio entry threshold to activate kick-down flag when pedal sensor is in nominal operation (track 1)" VALUE 0xa002153a _REC_S1VAL_20_u2 1. _CNV_A_R_LINEAR_____266_CM 0. 1. FORMAT "%9.7" /end CHARACTERISTIC
/begin AXIS_PTS Ctb_acel_pdl_v_max_dif "Pedal breakpoint for the consistency diagnosis" 0xa002da00 Vxx_acel_pdl_fil_sens_v1 _REC_A2AXS_20_u2 1. _CNV_A_R_LINEAR_____266_CM 9 0. 1. FORMAT "%9.7" /end AXIS_PTS
/begin CHARACTERISTIC Ctp_acel_pdl_v_max_dif "Interpolated calibration table to detect an inconsistency on accelerator pedal tracks" CURVE 0xa002da14 _REC_A1CUR_20_u2_u2 1. _CNV_A_R_LINEAR_____266_CM 0. 1. FORMAT "%9.7"
 /begin AXIS_DESCR COM_AXIS Vxx_acel_pdl_fil_sens_v1 _CNV_A_R_LINEAR_____266_CM 9 0. 1. FORMAT "%9.7" AXIS_PTS_REF Ctb_acel_pdl_v_max_dif /end AXIS_DESCR
/end CHARACTERISTIC
/begin MEASUREMENT Vbx_acel_pdl_sens1_ok "accelerator pedal sensor track 1 without default " UBYTE _CNV_S_2_RANGE______3_CM 1 0. 0. 1. ECU_ADDRESS 0xd0006bcc BIT_MASK 0x1 /end MEASUREMENT
/begin MEASUREMENT Vbx_det_acel_pdl_rdcy_loss "Detected loss of redundancy on accelerator pedal sensor" UBYTE _CNV_S_2_RANGE______3_CM 1 0. 0. 1. ECU_ADDRESS 0xd0006bd2 BIT_MASK 0x1 /end MEASUREMENT
/begin MEASUREMENT Vbx_df_acel_pdl_chr "Accelerator pedal consistency detected failure" UBYTE _CNV_S_2_RANGE______3_CM 1 0. 0. 1. ECU_ADDRESS 0xd0006bd3 BIT_MASK 0x1 /end MEASUREMENT
/begin MEASUREMENT Vbx_df_acel_pdl_tot "Total loss of accelerator pedal detected failure" UBYTE _CNV_S_2_RANGE______3_CM 1 0. 0. 1. ECU_ADDRESS 0xd0006bcd BIT_MASK 0x1 /end MEASUREMENT
/begin MEASUREMENT Vbx_df_acel_pdl_v1_h "Accelerator pedal track 1 high signal detected failure" UBYTE _CNV_S_2_RANGE______3_CM 1 0. 0. 1. ECU_ADDRESS 0xd0006bd4 BIT_MASK 0x1 /end MEASUREMENT
/begin MEASUREMENT Vbx_df_acel_pdl_v1_l "Accelerator pedal track 1 low signal detected failure" UBYTE _CNV_S_2_RANGE______3_CM 1 0. 0. 1. ECU_ADDRESS 0xd0006bd5 BIT_MASK 0x1 /end MEASUREMENT
/begin MEASUREMENT Vbx_df_acel_pdl_v2_h "Accelerator pedal track 2 high signal detected failure" UBYTE _CNV_S_2_RANGE______3_CM 1 0. 0. 1. ECU_ADDRESS 0xd0006bd6 BIT_MASK 0x1 /end MEASUREMENT
/begin MEASUREMENT Vbx_df_acel_pdl_v2_l "Accelerator pedal track 2 low signal detected failure" UBYTE _CNV_S_2_RANGE______3_CM 1 0. 0. 1. ECU_ADDRESS 0xd0006bd7 BIT_MASK 0x1 /end MEASUREMENT
/begin MEASUREMENT Vbx_diag_ena_acel_pdl_chr "Accelerator pedal consistency diagnosis authorization" UBYTE _CNV_S_2_RANGE______3_CM 1 0. 0. 1. ECU_ADDRESS 0xd0006bce BIT_MASK 0x1 /end MEASUREMENT
/begin MEASUREMENT Vbx_fail_pws_acel_pdl_v1 "Failure on power supply of accelerator pedal track 1" UBYTE _CNV_S_2_RANGE______3_CM 1 0. 0. 1. ECU_ADDRESS 0xd0006bcf BIT_MASK 0x1 /end MEASUREMENT
/begin MEASUREMENT Vbx_fail_pws_acel_pdl_v2 "Failure on power supply of accelerator pedal track 2" UBYTE _CNV_S_2_RANGE______3_CM 1 0. 0. 1. ECU_ADDRESS 0xd0006bd0 BIT_MASK 0x1 /end MEASUREMENT
/begin MEASUREMENT Vbx_loss_acel_pdl_v1 "" UBYTE _CNV_S_2_RANGE______3_CM 1 0. 0. 1. ECU_ADDRESS 0xd0006bd1 BIT_MASK 0x1 /end MEASUREMENT
/begin MEASUREMENT Vsx_acel_pdl_sens_v1_vld "Accelerator pedal sensor output voltage : track 1 validity status" UBYTE _CNV_S_2_STATUS_OK__241_CM 1 0. 0. 1. ECU_ADDRESS 0xd0006bd8 /end MEASUREMENT
/begin MEASUREMENT Vsx_acel_pdl_v_vld "Normalised acelerator pedal position" UBYTE _CNV_S_3_STATUS_OK__213_CM 1 0. 0. 2. ECU_ADDRESS 0xd0006bd9 /end MEASUREMENT
/begin MEASUREMENT Vxx_acel_pdl_sens_v "filtered accelerator pedal sensor output voltage: track 1" UWORD _CNV_A_R_LINEAR_____266_CM 1 0. 0. 1. ECU_ADDRESS 0xd0004386 FORMAT "%9.7" /end MEASUREMENT
/begin MEASUREMENT Vxx_acel_pdl_v "Accelerator pedal sensor output voltage (Upot1 or Upot2 or safety replacement value)" UWORD _CNV_A_R_LINEAR_____266_CM 1 0. 0. 1. ECU_ADDRESS 0xd0004388 FORMAT "%9.7" /end MEASUREMENT
/begin CHARACTERISTIC Cxx_acel_pdl_lih_sub_v "Accelerator pedal voltage (safety replacement value) if accelerator pedal limp home actived" VALUE 0xa0021540 _REC_S1VAL_20_u2 1. _CNV_A_R_LINEAR_____266_CM 0. 1. FORMAT "%9.7" /end CHARACTERISTIC
/begin CHARACTERISTIC Cxx_acel_pdl_v1_max_thd "Maximum threshold to detect high signal failure on accelerator pedal track 1" VALUE 0xa0021542 _REC_S1VAL_20_u2 1. _CNV_A_R_LINEAR_____266_CM 0. 1. FORMAT "%9.7" /end CHARACTERISTIC
/begin CHARACTERISTIC Cxx_acel_pdl_v1_min_thd "Minimum threshold to detect high signal failure on accelerator pedal track 1" VALUE 0xa0021544 _REC_S1VAL_20_u2 1. _CNV_A_R_LINEAR_____266_CM 0. 1. FORMAT "%9.7" /end CHARACTERISTIC
/begin CHARACTERISTIC Cxx_acel_pdl_v1_v2_fac "Accelerator pedal voltage (safety replacement value) if accelerator pedal limp home actived" VALUE 0xa002155a _REC_S1VAL_20_u1 255. _CNV_A_R_ECME_LINEA_0_CM 0. 255. FORMAT "%3.0" /end CHARACTERISTIC
/begin CHARACTERISTIC Cxx_acel_pdl_v2_max_thd "Maximum threshold to detect high signal failure on accelerator pedal track 2" VALUE 0xa0021546 _REC_S1VAL_20_u2 1. _CNV_A_R_LINEAR_____266_CM 0. 1. FORMAT "%9.7" /end CHARACTERISTIC
/begin CHARACTERISTIC Cxx_acel_pdl_v2_min_thd "Minimum threshold to detect high signal failure on accelerator pedal track 2" VALUE 0xa0021548 _REC_S1VAL_20_u2 1. _CNV_A_R_LINEAR_____266_CM 0. 1. FORMAT "%9.7" /end CHARACTERISTIC
/begin CHARACTERISTIC Cxx_dfdec_acel_pdl_chr "Accelerator pedal consistency detected failure counter decrement" VALUE 0xa002154a _REC_S1VAL_20_u2 65535. _CNV_A_R_ECME_LINEA_0_CM 0. 65535. FORMAT "%5.0" /end CHARACTERISTIC
/begin CHARACTERISTIC Cxx_dfdec_acel_pdl_tot "Total loss of accelerator pedal detected failure counter decrement" VALUE 0xa002154c _REC_S1VAL_20_u2 65535. _CNV_A_R_ECME_LINEA_0_CM 0. 65535. FORMAT "%5.0" /end CHARACTERISTIC
/begin CHARACTERISTIC Cxx_dfdec_acel_pdl_v1 "Accelerator pedal track 1 detected failure counter decrement" VALUE 0xa002154e _REC_S1VAL_20_u2 65535. _CNV_A_R_ECME_LINEA_0_CM 0. 65535. FORMAT "%5.0" /end CHARACTERISTIC
/begin CHARACTERISTIC Cxx_dfdec_acel_pdl_v2 "Accelerator pedal track 2 detected failure counter decrement" VALUE 0xa0021550 _REC_S1VAL_20_u2 65535. _CNV_A_R_ECME_LINEA_0_CM 0. 65535. FORMAT "%5.0" /end CHARACTERISTIC
/begin CHARACTERISTIC Cxx_dfinc_acel_pdl_chr "Accelerator pedal consistency detected failure counter increment" VALUE 0xa0021552 _REC_S1VAL_20_u2 65535. _CNV_A_R_ECME_LINEA_0_CM 0. 65535. FORMAT "%5.0" /end CHARACTERISTIC
/begin CHARACTERISTIC Cxx_dfinc_acel_pdl_tot "Total loss of accelerator pedal detected failure counter increment" VALUE 0xa0021554 _REC_S1VAL_20_u2 65535. _CNV_A_R_ECME_LINEA_0_CM 0. 65535. FORMAT "%5.0" /end CHARACTERISTIC
/begin CHARACTERISTIC Cxx_dfinc_acel_pdl_v1 "Accelerator pedal track 1 detected failure counter increment" VALUE 0xa0021556 _REC_S1VAL_20_u2 65535. _CNV_A_R_ECME_LINEA_0_CM 0. 65535. FORMAT "%5.0" /end CHARACTERISTIC
/begin CHARACTERISTIC Cxx_dfinc_acel_pdl_v2 "Accelerator pedal track 2 detected failure counter increment" VALUE 0xa0021558 _REC_S1VAL_20_u2 65535. _CNV_A_R_ECME_LINEA_0_CM 0. 65535. FORMAT "%5.0" /end CHARACTERISTIC
/begin MEASUREMENT Vbx_acel_pdl_secu_cdn_1 "Condition 1 for activation of pedal safety case (used for the exit of emergency mode too)" UBYTE _CNV_S_2_RANGE______3_CM 1 0. 0. 1. ECU_ADDRESS 0xd0007bdc BIT_MASK 0x1 /end MEASUREMENT
/begin MEASUREMENT Vbx_acel_pdl_secu_cdn_2 "Condition 2 for activation of pedal safety case (not used for the exit of emergency mode too)" UBYTE _CNV_S_2_RANGE______3_CM 1 0. 0. 1. ECU_ADDRESS 0xd0007bdd BIT_MASK 0x1 /end MEASUREMENT
/begin MEASUREMENT Vbx_acel_pdl_secu_det "Detection of the conditions accelerator pedal safety case (before breaking)" UBYTE _CNV_S_2_RANGE______3_CM 1 0. 0. 1. ECU_ADDRESS 0xd0007bde BIT_MASK 0x1 /end MEASUREMENT
/begin MEASUREMENT Vbx_df_acel_pdl_secu_1 "Detection of the conditions accelerator pedal safety case N°1 (before breaking)" UBYTE _CNV_S_2_RANGE______3_CM 1 0. 0. 1. ECU_ADDRESS 0xd0007bdf BIT_MASK 0x1 /end MEASUREMENT
/begin MEASUREMENT Vbx_df_acel_pdl_secu_2 "Detected failure of accelerator pedal safety case N°2 (reversible or irreversible downgraded mode)" UBYTE _CNV_S_2_RANGE______3_CM 1 0. 0. 1. ECU_ADDRESS 0xd0007be0 BIT_MASK 0x1 /end MEASUREMENT
/begin MEASUREMENT Vbx_diag_ena_acel_pdl_secu_2 "Accelerator pedal safety case N°2 diagnosis authorization" UBYTE _CNV_S_2_RANGE______3_CM 1 0. 0. 1. ECU_ADDRESS 0xd0007be1 BIT_MASK 0x1 /end MEASUREMENT
/begin CHARACTERISTIC Cbx_acel_pdl_secu_2_cfm "bit of configuration to set accelerator pedal safety case N°2 irreversible" VALUE 0xa002156c _REC_S1VAL_20_u1 1. _CNV_A_R_ECME_LINEA_0_CM 0. 1. FORMAT "%1.0" BIT_MASK 0x1 /end CHARACTERISTIC
/begin CHARACTERISTIC Cbx_acel_pdl_secu_acc_cfm "bit of configuration to disable ACC condition for accelerator pedal safety case" VALUE 0xa002156d _REC_S1VAL_20_u1 1. _CNV_A_R_ECME_LINEA_0_CM 0. 1. FORMAT "%1.0" BIT_MASK 0x1 /end CHARACTERISTIC
/begin CHARACTERISTIC Cbx_acel_pdl_secu_esp_cfm "bit of configuration to disable ASR/MSR/AYC conditions for accelerator pedal safety case" VALUE 0xa002156e _REC_S1VAL_20_u1 1. _CNV_A_R_ECME_LINEA_0_CM 0. 1. FORMAT "%1.0" BIT_MASK 0x1 /end CHARACTERISTIC
/begin CHARACTERISTIC Cxx_acel_pdl_secu_2_inc_1 "Accelerator pedal safety case N°2 counter increment (when diagnosis is not confirmed)" VALUE 0xa002155c _REC_S1VAL_20_u2 65535. _CNV_A_R_ECME_LINEA_0_CM 0. 65535. FORMAT "%5.0" /end CHARACTERISTIC
/begin CHARACTERISTIC Cxx_acel_pdl_secu_2_inc_2 "Accelerator pedal safety case N°2 counter increment (when diagnosis is confirmed)" VALUE 0xa002155e _REC_S1VAL_20_u2 65535. _CNV_A_R_ECME_LINEA_0_CM 0. 65535. FORMAT "%5.0" /end CHARACTERISTIC
/begin CHARACTERISTIC Cxx_acel_pdl_secu_2_thd "Pedal threshold to allow the healing of accelerator pedal safety case N°2" VALUE 0xa0021560 _REC_S1VAL_20_u2 1. _CNV_A_R_LINEAR_____266_CM 0. 1. FORMAT "%9.7" /end CHARACTERISTIC
/begin CHARACTERISTIC Cxx_acel_pdl_secu_2_vs_thd "Vehicle speed threshold to allow the healing of accelerator pedal safety case N°2" VALUE 0xa002156f _REC_S1VAL_20_u1 255. _CNV_A_R_LINEAR_____71_CM 0. 255. FORMAT "%3.0" /end CHARACTERISTIC
/begin CHARACTERISTIC Cxx_acel_pdl_secu_dly1 "Tempo 1 (before breaking) to validate the conditions of accelerator pedal safety case" VALUE 0xa0021562 _REC_S1VAL_20_u2 655.35 _CNV_A_R_LINEAR_____32_CM 0. 655.35 FORMAT "%6.2" /end CHARACTERISTIC
/begin CHARACTERISTIC Cxx_acel_pdl_secu_dly2 "Tempo 2 (after breaking) to detect the failure of accelerator pedal safety case N°1" VALUE 0xa0021564 _REC_S1VAL_20_u2 655.35 _CNV_A_R_LINEAR_____32_CM 0. 655.35 FORMAT "%6.2" /end CHARACTERISTIC
/begin CHARACTERISTIC Cxx_acel_pdl_secu_flu_thd "Pedal variation threshold to allowthe detection of accelerator pedal safety case" VALUE 0xa0021566 _REC_S1VAL_20_u2 1. _CNV_A_R_LINEAR_____268_CM 0. 1. FORMAT "%9.7" /end CHARACTERISTIC
/begin CHARACTERISTIC Cxx_acel_pdl_secu_n_thd "Engine speed threshold to allow the detection of accelerator pedal safety case" VALUE 0xa0021570 _REC_S1VAL_20_u1 8160. _CNV_A_R_LINEAR_____2_CM 0. 8160. FORMAT "%4.0" /end CHARACTERISTIC
/begin CHARACTERISTIC Cxx_acel_pdl_secu_thd "Pedal threshold to allow the detection of accelerator pedal safety case" VALUE 0xa0021568 _REC_S1VAL_20_u2 1. _CNV_A_R_LINEAR_____266_CM 0. 1. FORMAT "%9.7" /end CHARACTERISTIC
/begin CHARACTERISTIC Cxx_acel_pdl_secu_vs_thd "Pedal threshold to allow the detection of accelerator pedal safety case" VALUE 0xa0021571 _REC_S1VAL_20_u1 255. _CNV_A_R_LINEAR_____71_CM 0. 255. FORMAT "%3.0" /end CHARACTERISTIC
/begin CHARACTERISTIC Cxx_dfdec_acel_pdl_secu_2 "Accelerator pedal safety case N°2 detected failure counter decrement" VALUE 0xa002156a _REC_S1VAL_20_u2 65535. _CNV_A_R_ECME_LINEA_0_CM 0. 65535. FORMAT "%5.0" /end CHARACTERISTIC
/begin MEASUREMENT Vbx_df_vb_h "Battery voltage above max threshold detected failure" UBYTE _CNV_S_2_RANGE______3_CM 1 0. 0. 1. ECU_ADDRESS 0xd0006d92 BIT_MASK 0x1 /end MEASUREMENT
/begin MEASUREMENT Vbx_df_vb_l "Battery voltage below min threshold detected failure counter saturation" UBYTE _CNV_S_2_RANGE______3_CM 1 0. 0. 1. ECU_ADDRESS 0xd0006d93 BIT_MASK 0x1 /end MEASUREMENT
/begin MEASUREMENT Vbx_diag_ena_vb_h "Battery voltage above max threshold diagnosis information available" UBYTE _CNV_S_2_RANGE______3_CM 1 0. 0. 1. ECU_ADDRESS 0xd0006d94 BIT_MASK 0x1 /end MEASUREMENT
/begin MEASUREMENT Vbx_diag_ena_vb_l "Battery voltage below min threshold diagnosis information available" UBYTE _CNV_S_2_RANGE______3_CM 1 0. 0. 1. ECU_ADDRESS 0xd0006d95 BIT_MASK 0x1 /end MEASUREMENT
/begin MEASUREMENT Vsx_vb_rly_vld "Main relay validity indicator" UBYTE _CNV_A_R_ECME_LINEA_0_CM 1 0. 0. 255. ECU_ADDRESS 0xd0006d96 FORMAT "%3.0" /end MEASUREMENT
/begin MEASUREMENT Vsx_vb_vld "Filtered voltage battery validity status" UBYTE _CNV_A_R_ECME_LINEA_0_CM 1 0. 0. 255. ECU_ADDRESS 0xd0006d97 FORMAT "%3.0" /end MEASUREMENT
/begin MEASUREMENT Vxx_mv_vb "Filtered battery voltage" UWORD _CNV_A_R_LINEAR_____107_CM 1 0. 0. 25000. ECU_ADDRESS 0xd00044e8 FORMAT "%5.0" /end MEASUREMENT
/begin MEASUREMENT Vxx_vb "Battery voltage" UWORD _CNV_A_R_LINEAR_____205_CM 1 0. 0. 60. ECU_ADDRESS 0xd00044ea FORMAT "%5.2" /end MEASUREMENT
/begin CHARACTERISTIC Cxx_dfdec_vb_h "Battery voltage above max threshold detected failure counter decrement" VALUE 0xa00217dc _REC_S1VAL_20_u2 65535. _CNV_A_R_ECME_LINEA_0_CM 0. 65535. FORMAT "%5.0" /end CHARACTERISTIC
/begin CHARACTERISTIC Cxx_dfdec_vb_l "Battery voltage below min threshold detected failure counter decrement" VALUE 0xa00217de _REC_S1VAL_20_u2 65535. _CNV_A_R_ECME_LINEA_0_CM 0. 65535. FORMAT "%5.0" /end CHARACTERISTIC
/begin CHARACTERISTIC Cxx_dfdec_vb_rly_oc_scg "Open circuit or short circuit to ground on main relay detected failure counter decrement" VALUE 0xa00217e0 _REC_S1VAL_20_u2 65535. _CNV_A_R_ECME_LINEA_0_CM 0. 65535. FORMAT "%5.0" /end CHARACTERISTIC
/begin CHARACTERISTIC Cxx_dfdec_vb_rly_scw "Short circuit to battery on main relay detected failure counter decrement" VALUE 0xa00217e2 _REC_S1VAL_20_u2 65535. _CNV_A_R_ECME_LINEA_0_CM 0. 65535. FORMAT "%5.0" /end CHARACTERISTIC
/begin CHARACTERISTIC Cxx_dfinc_vb_h "Battery voltage above max threshold detected failure counter increment" VALUE 0xa00217e4 _REC_S1VAL_20_u2 65535. _CNV_A_R_ECME_LINEA_0_CM 0. 65535. FORMAT "%5.0" /end CHARACTERISTIC
/begin CHARACTERISTIC Cxx_dfinc_vb_l "Battery voltage below min threshold detected failure counter increment" VALUE 0xa00217e6 _REC_S1VAL_20_u2 65535. _CNV_A_R_ECME_LINEA_0_CM 0. 65535. FORMAT "%5.0" /end CHARACTERISTIC
/begin CHARACTERISTIC Cxx_dfinc_vb_rly_oc_scg "Open circuit or short circuit to ground on main relay detected failure counter increment" VALUE 0xa00217e8 _REC_S1VAL_20_u2 65535. _CNV_A_R_ECME_LINEA_0_CM 0. 65535. FORMAT "%5.0" /end CHARACTERISTIC
/begin CHARACTERISTIC Cxx_dfinc_vb_rly_scw "Short circuit to battery relay detected failure counter increment" VALUE 0xa00217ea _REC_S1VAL_20_u2 65535. _CNV_A_R_ECME_LINEA_0_CM 0. 65535. FORMAT "%5.0" /end CHARACTERISTIC
/begin CHARACTERISTIC Cxx_mv_vb_fac "Filter factor applied to raw battery voltage" VALUE 0xa00217ec _REC_S1VAL_20_u2 655.35 _CNV_A_R_LINEAR_____32_CM 0. 655.35 FORMAT "%6.2" /end CHARACTERISTIC
/begin CHARACTERISTIC Cxx_thd_n_diag_vb_h "Engine speed threshold for high level battery voltage fault detection" VALUE 0xa00217ee _REC_S1VAL_20_u2 16383.75 _CNV_A_R_ENSD_LINEA_22_CM 0. 16383.75 FORMAT "%8.2" /end CHARACTERISTIC
/begin CHARACTERISTIC Cxx_thd_n_diag_vb_l "Engine speed threshold for low level battery voltage fault detection" VALUE 0xa00217f0 _REC_S1VAL_20_u2 16383.75 _CNV_A_R_ENSD_LINEA_22_CM 0. 16383.75 FORMAT "%8.2" /end CHARACTERISTIC
/begin CHARACTERISTIC Cxx_thd_vb_h "Max threshold for battery voltage fault detection" VALUE 0xa00217f2 _REC_S1VAL_20_u2 60. _CNV_A_R_LINEAR_____205_CM 0. 60. FORMAT "%5.2" /end CHARACTERISTIC
/begin CHARACTERISTIC Cxx_thd_vb_l "Min threshold for battery voltage fault detection" VALUE 0xa00217f4 _REC_S1VAL_20_u2 60. _CNV_A_R_LINEAR_____205_CM 0. 60. FORMAT "%5.2" /end CHARACTERISTIC
/begin MEASUREMENT Vbx_bdu_ope "Boolean thet indicates BDU opening" UBYTE _CNV_S_2_RANGE______3_CM 1 0. 0. 1. ECU_ADDRESS 0xd0006d98 BIT_MASK 0x1 /end MEASUREMENT
/begin MEASUREMENT Vsx_sens_alt_fil_pwm_vld "Filtered wire frame alternator load validity status" UBYTE _CNV_S_3_STATUS_OK__179_CM 1 0. 0. 2. ECU_ADDRESS 0xd0006d90 /end MEASUREMENT
/begin MEASUREMENT Vxx_sens_alt_fil_pwm "filtered wire frame alternator load" UBYTE _CNV_A_R_LINEAR_____165_CM 1 0. 0. 100. ECU_ADDRESS 0xd0007c24 FORMAT "%12.8" /end MEASUREMENT
/begin MEASUREMENT Vsx_alt_pwm_vld "Alternator load validity status" UBYTE _CNV_S_2_STATUS_OK__269_CM 1 0. 0. 1. ECU_ADDRESS 0xd0006d8e /end MEASUREMENT
/begin MEASUREMENT Vxx_alt_pwm "Filtered alternator load" UBYTE _CNV_A_R_LINEAR_____165_CM 1 0. 0. 100. ECU_ADDRESS 0xd0006d8f FORMAT "%12.8" /end MEASUREMENT
/begin CHARACTERISTIC Cbx_mux_alt_pwm_cfm "Multiplexed alternator load configuration" VALUE 0xa00217d8 _REC_S1VAL_20_u1 1. _CNV_A_R_ECME_LINEA_0_CM 0. 1. FORMAT "%1.0" BIT_MASK 0x1 /end CHARACTERISTIC
/begin CHARACTERISTIC Cxx_alt_pwm_l "Alternator load setting when engine is not autonomous" VALUE 0xa00217d9 _REC_S1VAL_20_u1 100. _CNV_A_R_LINEAR_____165_CM 0. 100. FORMAT "%12.8" /end CHARACTERISTIC
/begin CHARACTERISTIC Cxx_alt_pwm_sub "Alternator load by default" VALUE 0xa00217da _REC_S1VAL_20_u1 100. _CNV_A_R_LINEAR_____165_CM 0. 100. FORMAT "%12.8" /end CHARACTERISTIC
/begin CHARACTERISTIC Cxx_mux_alt_pwm_fil_t "Multiplexed alternator load filter time constant" VALUE 0xa00217d6 _REC_S1VAL_20_u2 65535. _CNV_A_R_LINEAR_____201_CM 0. 65535. FORMAT "%5.0" /end CHARACTERISTIC
/begin MEASUREMENT Vxx_dfctr_ac_prs_h "" UWORD _CNV_A_R_A_105_CM 1 0. 0. 65535. DISPLAY_IDENTIFIER fm_sta_ac_prs_h.Vxx_dfctr_xxx ECU_ADDRESS 0xd00051bc /end MEASUREMENT
/begin MEASUREMENT Vxx_rdn_ac_prs_h "" UWORD _CNV_A_R_A_105_CM 1 0. 0. 65535. DISPLAY_IDENTIFIER fm_sta_ac_prs_h.Vxx_rdn_xxx ECU_ADDRESS 0xd00051be /end MEASUREMENT
/begin MEASUREMENT Vbx_cf_ac_prs_h "" UBYTE _CNV_A_R_A_105_CM 1 0. 0. 255. DISPLAY_IDENTIFIER fm_sta_ac_prs_h.fm_static_bitfield.Vbx_cf_xxx ECU_ADDRESS 0xd00051c0 BIT_MASK 0x1 /end MEASUREMENT
/begin MEASUREMENT Vbx_clf_ac_prs_h "" UBYTE _CNV_A_R_A_105_CM 1 0. 0. 255. DISPLAY_IDENTIFIER fm_sta_ac_prs_h.fm_static_bitfield.Vbx_clf_xxx ECU_ADDRESS 0xd00051c0 BIT_MASK 0x2 /end MEASUREMENT
/begin MEASUREMENT Vbx_df_old_ac_prs_h "" UBYTE _CNV_A_R_A_105_CM 1 0. 0. 255. DISPLAY_IDENTIFIER fm_sta_ac_prs_h.fm_static_bitfield.Vbx_df_old_xxx ECU_ADDRESS 0xd00051c0 BIT_MASK 0x4 /end MEASUREMENT
/begin MEASUREMENT Vbx_dfctr_sat_ac_prs_h "" UBYTE _CNV_A_R_A_105_CM 1 0. 0. 255. DISPLAY_IDENTIFIER fm_sta_ac_prs_h.fm_static_bitfield.Vbx_dfctr_sat_xxx ECU_ADDRESS 0xd00051c0 BIT_MASK 0x8 /end MEASUREMENT
/begin MEASUREMENT Vbx_rdn_ac_prs_h "" UBYTE _CNV_A_R_A_105_CM 1 0. 0. 255. DISPLAY_IDENTIFIER fm_sta_ac_prs_h.fm_static_bitfield.Vbx_rdn_xxx ECU_ADDRESS 0xd00051c0 BIT_MASK 0x40 /end MEASUREMENT
/begin MEASUREMENT Vxx_dtc_stt_ac_prs_h "" UBYTE _CNV_A_R_A_105_CM 1 0. 0. 255. DISPLAY_IDENTIFIER fm_sta_ac_prs_h.Vxx_dtc_stt_xxx ECU_ADDRESS 0xd00051c1 /end MEASUREMENT
/begin MEASUREMENT Vxx_dfctr_ac_prs_l "" UWORD _CNV_A_R_A_105_CM 1 0. 0. 65535. DISPLAY_IDENTIFIER fm_sta_ac_prs_l.Vxx_dfctr_xxx ECU_ADDRESS 0xd00051c2 /end MEASUREMENT
/begin MEASUREMENT Vxx_rdn_ac_prs_l "" UWORD _CNV_A_R_A_105_CM 1 0. 0. 65535. DISPLAY_IDENTIFIER fm_sta_ac_prs_l.Vxx_rdn_xxx ECU_ADDRESS 0xd00051c4 /end MEASUREMENT
/begin MEASUREMENT Vbx_cf_ac_prs_l "" UBYTE _CNV_A_R_A_105_CM 1 0. 0. 255. DISPLAY_IDENTIFIER fm_sta_ac_prs_l.fm_static_bitfield.Vbx_cf_xxx ECU_ADDRESS 0xd00051c6 BIT_MASK 0x1 /end MEASUREMENT
/begin MEASUREMENT Vbx_clf_ac_prs_l "" UBYTE _CNV_A_R_A_105_CM 1 0. 0. 255. DISPLAY_IDENTIFIER fm_sta_ac_prs_l.fm_static_bitfield.Vbx_clf_xxx ECU_ADDRESS 0xd00051c6 BIT_MASK 0x2 /end MEASUREMENT
/begin MEASUREMENT Vbx_df_old_ac_prs_l "" UBYTE _CNV_A_R_A_105_CM 1 0. 0. 255. DISPLAY_IDENTIFIER fm_sta_ac_prs_l.fm_static_bitfield.Vbx_df_old_xxx ECU_ADDRESS 0xd00051c6 BIT_MASK 0x4 /end MEASUREMENT
/begin MEASUREMENT Vbx_dfctr_sat_ac_prs_l "" UBYTE _CNV_A_R_A_105_CM 1 0. 0. 255. DISPLAY_IDENTIFIER fm_sta_ac_prs_l.fm_static_bitfield.Vbx_dfctr_sat_xxx ECU_ADDRESS 0xd00051c6 BIT_MASK 0x8 /end MEASUREMENT
/begin MEASUREMENT Vbx_rdn_ac_prs_l "" UBYTE _CNV_A_R_A_105_CM 1 0. 0. 255. DISPLAY_IDENTIFIER fm_sta_ac_prs_l.fm_static_bitfield.Vbx_rdn_xxx ECU_ADDRESS 0xd00051c6 BIT_MASK 0x40 /end MEASUREMENT
/begin MEASUREMENT Vxx_dtc_stt_ac_prs_l "" UBYTE _CNV_A_R_A_105_CM 1 0. 0. 255. DISPLAY_IDENTIFIER fm_sta_ac_prs_l.Vxx_dtc_stt_xxx ECU_ADDRESS 0xd00051c7 /end MEASUREMENT
/begin MEASUREMENT Vxx_dfctr_acel_pdl_chr "" UWORD _CNV_A_R_A_105_CM 1 0. 0. 65535. DISPLAY_IDENTIFIER fm_sta_acel_pdl_chr.Vxx_dfctr_xxx ECU_ADDRESS 0xd00051c8 /end MEASUREMENT
/begin MEASUREMENT Vxx_rdn_acel_pdl_chr "" UWORD _CNV_A_R_A_105_CM 1 0. 0. 65535. DISPLAY_IDENTIFIER fm_sta_acel_pdl_chr.Vxx_rdn_xxx ECU_ADDRESS 0xd00051ca /end MEASUREMENT
/begin MEASUREMENT Vbx_cf_acel_pdl_chr "" UBYTE _CNV_A_R_A_105_CM 1 0. 0. 255. DISPLAY_IDENTIFIER fm_sta_acel_pdl_chr.fm_static_bitfield.Vbx_cf_xxx ECU_ADDRESS 0xd00051cc BIT_MASK 0x1 /end MEASUREMENT
/begin MEASUREMENT Vbx_clf_acel_pdl_chr "" UBYTE _CNV_A_R_A_105_CM 1 0. 0. 255. DISPLAY_IDENTIFIER fm_sta_acel_pdl_chr.fm_static_bitfield.Vbx_clf_xxx ECU_ADDRESS 0xd00051cc BIT_MASK 0x2 /end MEASUREMENT
/begin MEASUREMENT Vbx_df_old_acel_pdl_chr "" UBYTE _CNV_A_R_A_105_CM 1 0. 0. 255. DISPLAY_IDENTIFIER fm_sta_acel_pdl_chr.fm_static_bitfield.Vbx_df_old_xxx ECU_ADDRESS 0xd00051cc BIT_MASK 0x4 /end MEASUREMENT
/begin MEASUREMENT Vbx_dfctr_sat_acel_pdl_chr "" UBYTE _CNV_A_R_A_105_CM 1 0. 0. 255. DISPLAY_IDENTIFIER fm_sta_acel_pdl_chr.fm_static_bitfield.Vbx_dfctr_sat_xxx ECU_ADDRESS 0xd00051cc BIT_MASK 0x8 /end MEASUREMENT
/begin MEASUREMENT Vbx_rdn_acel_pdl_chr "" UBYTE _CNV_A_R_A_105_CM 1 0. 0. 255. DISPLAY_IDENTIFIER fm_sta_acel_pdl_chr.fm_static_bitfield.Vbx_rdn_xxx ECU_ADDRESS 0xd00051cc BIT_MASK 0x40 /end MEASUREMENT
/begin MEASUREMENT Vxx_dtc_stt_acel_pdl_chr "" UBYTE _CNV_A_R_A_105_CM 1 0. 0. 255. DISPLAY_IDENTIFIER fm_sta_acel_pdl_chr.Vxx_dtc_stt_xxx ECU_ADDRESS 0xd00051cd /end MEASUREMENT
/begin MEASUREMENT Vxx_dfctr_acel_pdl_secu_1 "" UWORD _CNV_A_R_A_105_CM 1 0. 0. 65535. DISPLAY_IDENTIFIER fm_sta_acel_pdl_secu_1.Vxx_dfctr_xxx ECU_ADDRESS 0xd00051ce /end MEASUREMENT
/begin MEASUREMENT Vxx_rdn_acel_pdl_secu_1 "" UWORD _CNV_A_R_A_105_CM 1 0. 0. 65535. DISPLAY_IDENTIFIER fm_sta_acel_pdl_secu_1.Vxx_rdn_xxx ECU_ADDRESS 0xd00051d0 /end MEASUREMENT
/begin MEASUREMENT Vbx_cf_acel_pdl_secu_1 "" UBYTE _CNV_A_R_A_105_CM 1 0. 0. 255. DISPLAY_IDENTIFIER fm_sta_acel_pdl_secu_1.fm_static_bitfield.Vbx_cf_xxx ECU_ADDRESS 0xd00051d2 BIT_MASK 0x1 /end MEASUREMENT
/begin MEASUREMENT Vbx_clf_acel_pdl_secu_1 "" UBYTE _CNV_A_R_A_105_CM 1 0. 0. 255. DISPLAY_IDENTIFIER fm_sta_acel_pdl_secu_1.fm_static_bitfield.Vbx_clf_xxx ECU_ADDRESS 0xd00051d2 BIT_MASK 0x2 /end MEASUREMENT
/begin MEASUREMENT Vbx_df_old_acel_pdl_secu_1 "" UBYTE _CNV_A_R_A_105_CM 1 0. 0. 255. DISPLAY_IDENTIFIER fm_sta_acel_pdl_secu_1.fm_static_bitfield.Vbx_df_old_xxx ECU_ADDRESS 0xd00051d2 BIT_MASK 0x4 /end MEASUREMENT
/begin MEASUREMENT Vbx_dfctr_sat_acel_pdl_secu_1 "" UBYTE _CNV_A_R_A_105_CM 1 0. 0. 255. DISPLAY_IDENTIFIER fm_sta_acel_pdl_secu_1.fm_static_bitfield.Vbx_dfctr_sat_xxx ECU_ADDRESS 0xd00051d2 BIT_MASK 0x8 /end MEASUREMENT
/begin MEASUREMENT Vbx_rdn_acel_pdl_secu_1 "" UBYTE _CNV_A_R_A_105_CM 1 0. 0. 255. DISPLAY_IDENTIFIER fm_sta_acel_pdl_secu_1.fm_static_bitfield.Vbx_rdn_xxx ECU_ADDRESS 0xd00051d2 BIT_MASK 0x40 /end MEASUREMENT
/begin MEASUREMENT Vxx_dtc_stt_acel_pdl_secu_1 "" UBYTE _CNV_A_R_A_105_CM 1 0. 0. 255. DISPLAY_IDENTIFIER fm_sta_acel_pdl_secu_1.Vxx_dtc_stt_xxx ECU_ADDRESS 0xd00051d3 /end MEASUREMENT
/begin MEASUREMENT Vxx_dfctr_acel_pdl_secu_2 "" UWORD _CNV_A_R_A_105_CM 1 0. 0. 65535. DISPLAY_IDENTIFIER fm_sta_acel_pdl_secu_2.Vxx_dfctr_xxx ECU_ADDRESS 0xd00051d4 /end MEASUREMENT
/begin MEASUREMENT Vxx_rdn_acel_pdl_secu_2 "" UWORD _CNV_A_R_A_105_CM 1 0. 0. 65535. DISPLAY_IDENTIFIER fm_sta_acel_pdl_secu_2.Vxx_rdn_xxx ECU_ADDRESS 0xd00051d6 /end MEASUREMENT
/begin MEASUREMENT Vbx_cf_acel_pdl_secu_2 "" UBYTE _CNV_A_R_A_105_CM 1 0. 0. 255. DISPLAY_IDENTIFIER fm_sta_acel_pdl_secu_2.fm_static_bitfield.Vbx_cf_xxx ECU_ADDRESS 0xd00051d8 BIT_MASK 0x1 /end MEASUREMENT
/begin MEASUREMENT Vbx_clf_acel_pdl_secu_2 "" UBYTE _CNV_A_R_A_105_CM 1 0. 0. 255. DISPLAY_IDENTIFIER fm_sta_acel_pdl_secu_2.fm_static_bitfield.Vbx_clf_xxx ECU_ADDRESS 0xd00051d8 BIT_MASK 0x2 /end MEASUREMENT
/begin MEASUREMENT Vbx_df_old_acel_pdl_secu_2 "" UBYTE _CNV_A_R_A_105_CM 1 0. 0. 255. DISPLAY_IDENTIFIER fm_sta_acel_pdl_secu_2.fm_static_bitfield.Vbx_df_old_xxx ECU_ADDRESS 0xd00051d8 BIT_MASK 0x4 /end MEASUREMENT
/begin MEASUREMENT Vbx_dfctr_sat_acel_pdl_secu_2 "" UBYTE _CNV_A_R_A_105_CM 1 0. 0. 255. DISPLAY_IDENTIFIER fm_sta_acel_pdl_secu_2.fm_static_bitfield.Vbx_dfctr_sat_xxx ECU_ADDRESS 0xd00051d8 BIT_MASK 0x8 /end MEASUREMENT
/begin MEASUREMENT Vbx_rdn_acel_pdl_secu_2 "" UBYTE _CNV_A_R_A_105_CM 1 0. 0. 255. DISPLAY_IDENTIFIER fm_sta_acel_pdl_secu_2.fm_static_bitfield.Vbx_rdn_xxx ECU_ADDRESS 0xd00051d8 BIT_MASK 0x40 /end MEASUREMENT
/begin MEASUREMENT Vxx_dtc_stt_acel_pdl_secu_2 "" UBYTE _CNV_A_R_A_105_CM 1 0. 0. 255. DISPLAY_IDENTIFIER fm_sta_acel_pdl_secu_2.Vxx_dtc_stt_xxx ECU_ADDRESS 0xd00051d9 /end MEASUREMENT
/begin MEASUREMENT Vxx_dfctr_acel_pdl_tot "" UWORD _CNV_A_R_A_105_CM 1 0. 0. 65535. DISPLAY_IDENTIFIER fm_sta_acel_pdl_tot.Vxx_dfctr_xxx ECU_ADDRESS 0xd00051da /end MEASUREMENT
/begin MEASUREMENT Vxx_rdn_acel_pdl_tot "" UWORD _CNV_A_R_A_105_CM 1 0. 0. 65535. DISPLAY_IDENTIFIER fm_sta_acel_pdl_tot.Vxx_rdn_xxx ECU_ADDRESS 0xd00051dc /end MEASUREMENT
/begin MEASUREMENT Vbx_cf_acel_pdl_tot "" UBYTE _CNV_A_R_A_105_CM 1 0. 0. 255. DISPLAY_IDENTIFIER fm_sta_acel_pdl_tot.fm_static_bitfield.Vbx_cf_xxx ECU_ADDRESS 0xd00051de BIT_MASK 0x1 /end MEASUREMENT
/begin MEASUREMENT Vbx_clf_acel_pdl_tot "" UBYTE _CNV_A_R_A_105_CM 1 0. 0. 255. DISPLAY_IDENTIFIER fm_sta_acel_pdl_tot.fm_static_bitfield.Vbx_clf_xxx ECU_ADDRESS 0xd00051de BIT_MASK 0x2 /end MEASUREMENT
/begin MEASUREMENT Vbx_df_old_acel_pdl_tot "" UBYTE _CNV_A_R_A_105_CM 1 0. 0. 255. DISPLAY_IDENTIFIER fm_sta_acel_pdl_tot.fm_static_bitfield.Vbx_df_old_xxx ECU_ADDRESS 0xd00051de BIT_MASK 0x4 /end MEASUREMENT
/begin MEASUREMENT Vbx_dfctr_sat_acel_pdl_tot "" UBYTE _CNV_A_R_A_105_CM 1 0. 0. 255. DISPLAY_IDENTIFIER fm_sta_acel_pdl_tot.fm_static_bitfield.Vbx_dfctr_sat_xxx ECU_ADDRESS 0xd00051de BIT_MASK 0x8 /end MEASUREMENT
/begin MEASUREMENT Vbx_rdn_acel_pdl_tot "" UBYTE _CNV_A_R_A_105_CM 1 0. 0. 255. DISPLAY_IDENTIFIER fm_sta_acel_pdl_tot.fm_static_bitfield.Vbx_rdn_xxx ECU_ADDRESS 0xd00051de BIT_MASK 0x40 /end MEASUREMENT
/begin MEASUREMENT Vxx_dtc_stt_acel_pdl_tot "" UBYTE _CNV_A_R_A_105_CM 1 0. 0. 255. DISPLAY_IDENTIFIER fm_sta_acel_pdl_tot.Vxx_dtc_stt_xxx ECU_ADDRESS 0xd00051df /end MEASUREMENT
/begin MEASUREMENT Vxx_dfctr_acel_pdl_v1_h "" UWORD _CNV_A_R_A_105_CM 1 0. 0. 65535. DISPLAY_IDENTIFIER fm_sta_acel_pdl_v1_h.Vxx_dfctr_xxx ECU_ADDRESS 0xd00051e0 /end MEASUREMENT
/begin MEASUREMENT Vxx_rdn_acel_pdl_v1_h "" UWORD _CNV_A_R_A_105_CM 1 0. 0. 65535. DISPLAY_IDENTIFIER fm_sta_acel_pdl_v1_h.Vxx_rdn_xxx ECU_ADDRESS 0xd00051e2 /end MEASUREMENT
/begin MEASUREMENT Vbx_cf_acel_pdl_v1_h "" UBYTE _CNV_A_R_A_105_CM 1 0. 0. 255. DISPLAY_IDENTIFIER fm_sta_acel_pdl_v1_h.fm_static_bitfield.Vbx_cf_xxx ECU_ADDRESS 0xd00051e4 BIT_MASK 0x1 /end MEASUREMENT
/begin MEASUREMENT Vbx_clf_acel_pdl_v1_h "" UBYTE _CNV_A_R_A_105_CM 1 0. 0. 255. DISPLAY_IDENTIFIER fm_sta_acel_pdl_v1_h.fm_static_bitfield.Vbx_clf_xxx ECU_ADDRESS 0xd00051e4 BIT_MASK 0x2 /end MEASUREMENT
/begin MEASUREMENT Vbx_df_old_acel_pdl_v1_h "" UBYTE _CNV_A_R_A_105_CM 1 0. 0. 255. DISPLAY_IDENTIFIER fm_sta_acel_pdl_v1_h.fm_static_bitfield.Vbx_df_old_xxx ECU_ADDRESS 0xd00051e4 BIT_MASK 0x4 /end MEASUREMENT
/begin MEASUREMENT Vbx_dfctr_sat_acel_pdl_v1_h "" UBYTE _CNV_A_R_A_105_CM 1 0. 0. 255. DISPLAY_IDENTIFIER fm_sta_acel_pdl_v1_h.fm_static_bitfield.Vbx_dfctr_sat_xxx ECU_ADDRESS 0xd00051e4 BIT_MASK 0x8 /end MEASUREMENT
/begin MEASUREMENT Vbx_rdn_acel_pdl_v1_h "" UBYTE _CNV_A_R_A_105_CM 1 0. 0. 255. DISPLAY_IDENTIFIER fm_sta_acel_pdl_v1_h.fm_static_bitfield.Vbx_rdn_xxx ECU_ADDRESS 0xd00051e4 BIT_MASK 0x40 /end MEASUREMENT
/begin MEASUREMENT Vxx_dtc_stt_acel_pdl_v1_h "" UBYTE _CNV_A_R_A_105_CM 1 0. 0. 255. DISPLAY_IDENTIFIER fm_sta_acel_pdl_v1_h.Vxx_dtc_stt_xxx ECU_ADDRESS 0xd00051e5 /end MEASUREMENT
/begin MEASUREMENT Vxx_dfctr_acel_pdl_v1_l "" UWORD _CNV_A_R_A_105_CM 1 0. 0. 65535. DISPLAY_IDENTIFIER fm_sta_acel_pdl_v1_l.Vxx_dfctr_xxx ECU_ADDRESS 0xd00051e6 /end MEASUREMENT
/begin MEASUREMENT Vxx_rdn_acel_pdl_v1_l "" UWORD _CNV_A_R_A_105_CM 1 0. 0. 65535. DISPLAY_IDENTIFIER fm_sta_acel_pdl_v1_l.Vxx_rdn_xxx ECU_ADDRESS 0xd00051e8 /end MEASUREMENT
/begin MEASUREMENT Vbx_cf_acel_pdl_v1_l "" UBYTE _CNV_A_R_A_105_CM 1 0. 0. 255. DISPLAY_IDENTIFIER fm_sta_acel_pdl_v1_l.fm_static_bitfield.Vbx_cf_xxx ECU_ADDRESS 0xd00051ea BIT_MASK 0x1 /end MEASUREMENT
/begin MEASUREMENT Vbx_clf_acel_pdl_v1_l "" UBYTE _CNV_A_R_A_105_CM 1 0. 0. 255. DISPLAY_IDENTIFIER fm_sta_acel_pdl_v1_l.fm_static_bitfield.Vbx_clf_xxx ECU_ADDRESS 0xd00051ea BIT_MASK 0x2 /end MEASUREMENT
/begin MEASUREMENT Vbx_df_old_acel_pdl_v1_l "" UBYTE _CNV_A_R_A_105_CM 1 0. 0. 255. DISPLAY_IDENTIFIER fm_sta_acel_pdl_v1_l.fm_static_bitfield.Vbx_df_old_xxx ECU_ADDRESS 0xd00051ea BIT_MASK 0x4 /end MEASUREMENT
/begin MEASUREMENT Vbx_dfctr_sat_acel_pdl_v1_l "" UBYTE _CNV_A_R_A_105_CM 1 0. 0. 255. DISPLAY_IDENTIFIER fm_sta_acel_pdl_v1_l.fm_static_bitfield.Vbx_dfctr_sat_xxx ECU_ADDRESS 0xd00051ea BIT_MASK 0x8 /end MEASUREMENT
/begin MEASUREMENT Vbx_rdn_acel_pdl_v1_l "" UBYTE _CNV_A_R_A_105_CM 1 0. 0. 255. DISPLAY_IDENTIFIER fm_sta_acel_pdl_v1_l.fm_static_bitfield.Vbx_rdn_xxx ECU_ADDRESS 0xd00051ea BIT_MASK 0x40 /end MEASUREMENT
/begin MEASUREMENT Vxx_dtc_stt_acel_pdl_v1_l "" UBYTE _CNV_A_R_A_105_CM 1 0. 0. 255. DISPLAY_IDENTIFIER fm_sta_acel_pdl_v1_l.Vxx_dtc_stt_xxx ECU_ADDRESS 0xd00051eb /end MEASUREMENT
/begin MEASUREMENT Vxx_dfctr_acel_pdl_v2_h "" UWORD _CNV_A_R_A_105_CM 1 0. 0. 65535. DISPLAY_IDENTIFIER fm_sta_acel_pdl_v2_h.Vxx_dfctr_xxx ECU_ADDRESS 0xd00051ec /end MEASUREMENT
/begin MEASUREMENT Vxx_rdn_acel_pdl_v2_h "" UWORD _CNV_A_R_A_105_CM 1 0. 0. 65535. DISPLAY_IDENTIFIER fm_sta_acel_pdl_v2_h.Vxx_rdn_xxx ECU_ADDRESS 0xd00051ee /end MEASUREMENT
/begin MEASUREMENT Vbx_cf_acel_pdl_v2_h "" UBYTE _CNV_A_R_A_105_CM 1 0. 0. 255. DISPLAY_IDENTIFIER fm_sta_acel_pdl_v2_h.fm_static_bitfield.Vbx_cf_xxx ECU_ADDRESS 0xd00051f0 BIT_MASK 0x1 /end MEASUREMENT
/begin MEASUREMENT Vbx_clf_acel_pdl_v2_h "" UBYTE _CNV_A_R_A_105_CM 1 0. 0. 255. DISPLAY_IDENTIFIER fm_sta_acel_pdl_v2_h.fm_static_bitfield.Vbx_clf_xxx ECU_ADDRESS 0xd00051f0 BIT_MASK 0x2 /end MEASUREMENT
/begin MEASUREMENT Vbx_df_old_acel_pdl_v2_h "" UBYTE _CNV_A_R_A_105_CM 1 0. 0. 255. DISPLAY_IDENTIFIER fm_sta_acel_pdl_v2_h.fm_static_bitfield.Vbx_df_old_xxx ECU_ADDRESS 0xd00051f0 BIT_MASK 0x4 /end MEASUREMENT
/begin MEASUREMENT Vbx_dfctr_sat_acel_pdl_v2_h "" UBYTE _CNV_A_R_A_105_CM 1 0. 0. 255. DISPLAY_IDENTIFIER fm_sta_acel_pdl_v2_h.fm_static_bitfield.Vbx_dfctr_sat_xxx ECU_ADDRESS 0xd00051f0 BIT_MASK 0x8 /end MEASUREMENT
/begin MEASUREMENT Vbx_rdn_acel_pdl_v2_h "" UBYTE _CNV_A_R_A_105_CM 1 0. 0. 255. DISPLAY_IDENTIFIER fm_sta_acel_pdl_v2_h.fm_static_bitfield.Vbx_rdn_xxx ECU_ADDRESS 0xd00051f0 BIT_MASK 0x40 /end MEASUREMENT
/begin MEASUREMENT Vxx_dtc_stt_acel_pdl_v2_h "" UBYTE _CNV_A_R_A_105_CM 1 0. 0. 255. DISPLAY_IDENTIFIER fm_sta_acel_pdl_v2_h.Vxx_dtc_stt_xxx ECU_ADDRESS 0xd00051f1 /end MEASUREMENT
/begin MEASUREMENT Vxx_dfctr_acel_pdl_v2_l "" UWORD _CNV_A_R_A_105_CM 1 0. 0. 65535. DISPLAY_IDENTIFIER fm_sta_acel_pdl_v2_l.Vxx_dfctr_xxx ECU_ADDRESS 0xd00051f2 /end MEASUREMENT
/begin MEASUREMENT Vxx_rdn_acel_pdl_v2_l "" UWORD _CNV_A_R_A_105_CM 1 0. 0. 65535. DISPLAY_IDENTIFIER fm_sta_acel_pdl_v2_l.Vxx_rdn_xxx ECU_ADDRESS 0xd00051f4 /end MEASUREMENT
/begin MEASUREMENT Vbx_cf_acel_pdl_v2_l "" UBYTE _CNV_A_R_A_105_CM 1 0. 0. 255. DISPLAY_IDENTIFIER fm_sta_acel_pdl_v2_l.fm_static_bitfield.Vbx_cf_xxx ECU_ADDRESS 0xd00051f6 BIT_MASK 0x1 /end MEASUREMENT
/begin MEASUREMENT Vbx_clf_acel_pdl_v2_l "" UBYTE _CNV_A_R_A_105_CM 1 0. 0. 255. DISPLAY_IDENTIFIER fm_sta_acel_pdl_v2_l.fm_static_bitfield.Vbx_clf_xxx ECU_ADDRESS 0xd00051f6 BIT_MASK 0x2 /end MEASUREMENT
/begin MEASUREMENT Vbx_df_old_acel_pdl_v2_l "" UBYTE _CNV_A_R_A_105_CM 1 0. 0. 255. DISPLAY_IDENTIFIER fm_sta_acel_pdl_v2_l.fm_static_bitfield.Vbx_df_old_xxx ECU_ADDRESS 0xd00051f6 BIT_MASK 0x4 /end MEASUREMENT
/begin MEASUREMENT Vbx_dfctr_sat_acel_pdl_v2_l "" UBYTE _CNV_A_R_A_105_CM 1 0. 0. 255. DISPLAY_IDENTIFIER fm_sta_acel_pdl_v2_l.fm_static_bitfield.Vbx_dfctr_sat_xxx ECU_ADDRESS 0xd00051f6 BIT_MASK 0x8 /end MEASUREMENT
/begin MEASUREMENT Vbx_rdn_acel_pdl_v2_l "" UBYTE _CNV_A_R_A_105_CM 1 0. 0. 255. DISPLAY_IDENTIFIER fm_sta_acel_pdl_v2_l.fm_static_bitfield.Vbx_rdn_xxx ECU_ADDRESS 0xd00051f6 BIT_MASK 0x40 /end MEASUREMENT
/begin MEASUREMENT Vxx_dtc_stt_acel_pdl_v2_l "" UBYTE _CNV_A_R_A_105_CM 1 0. 0. 255. DISPLAY_IDENTIFIER fm_sta_acel_pdl_v2_l.Vxx_dtc_stt_xxx ECU_ADDRESS 0xd00051f7 /end MEASUREMENT
/begin MEASUREMENT Vxx_dfctr_actr_rly_oc "" UWORD _CNV_A_R_A_105_CM 1 0. 0. 65535. DISPLAY_IDENTIFIER fm_sta_actr_rly_oc.Vxx_dfctr_xxx ECU_ADDRESS 0xd00051f8 /end MEASUREMENT
/begin MEASUREMENT Vxx_rdn_actr_rly_oc "" UWORD _CNV_A_R_A_105_CM 1 0. 0. 65535. DISPLAY_IDENTIFIER fm_sta_actr_rly_oc.Vxx_rdn_xxx ECU_ADDRESS 0xd00051fa /end MEASUREMENT
/begin MEASUREMENT Vbx_cf_actr_rly_oc "" UBYTE _CNV_A_R_A_105_CM 1 0. 0. 255. DISPLAY_IDENTIFIER fm_sta_actr_rly_oc.fm_static_bitfield.Vbx_cf_xxx ECU_ADDRESS 0xd00051fc BIT_MASK 0x1 /end MEASUREMENT
/begin MEASUREMENT Vbx_clf_actr_rly_oc "" UBYTE _CNV_A_R_A_105_CM 1 0. 0. 255. DISPLAY_IDENTIFIER fm_sta_actr_rly_oc.fm_static_bitfield.Vbx_clf_xxx ECU_ADDRESS 0xd00051fc BIT_MASK 0x2 /end MEASUREMENT
/begin MEASUREMENT Vbx_df_old_actr_rly_oc "" UBYTE _CNV_A_R_A_105_CM 1 0. 0. 255. DISPLAY_IDENTIFIER fm_sta_actr_rly_oc.fm_static_bitfield.Vbx_df_old_xxx ECU_ADDRESS 0xd00051fc BIT_MASK 0x4 /end MEASUREMENT
/begin MEASUREMENT Vbx_dfctr_sat_actr_rly_oc "" UBYTE _CNV_A_R_A_105_CM 1 0. 0. 255. DISPLAY_IDENTIFIER fm_sta_actr_rly_oc.fm_static_bitfield.Vbx_dfctr_sat_xxx ECU_ADDRESS 0xd00051fc BIT_MASK 0x8 /end MEASUREMENT
/begin MEASUREMENT Vbx_rdn_actr_rly_oc "" UBYTE _CNV_A_R_A_105_CM 1 0. 0. 255. DISPLAY_IDENTIFIER fm_sta_actr_rly_oc.fm_static_bitfield.Vbx_rdn_xxx ECU_ADDRESS 0xd00051fc BIT_MASK 0x40 /end MEASUREMENT
/begin MEASUREMENT Vxx_dtc_stt_actr_rly_oc "" UBYTE _CNV_A_R_A_105_CM 1 0. 0. 255. DISPLAY_IDENTIFIER fm_sta_actr_rly_oc.Vxx_dtc_stt_xxx ECU_ADDRESS 0xd00051fd /end MEASUREMENT
/begin MEASUREMENT Vxx_dfctr_actr_rly_scg "" UWORD _CNV_A_R_A_105_CM 1 0. 0. 65535. DISPLAY_IDENTIFIER fm_sta_actr_rly_scg.Vxx_dfctr_xxx ECU_ADDRESS 0xd00051fe /end MEASUREMENT
/begin MEASUREMENT Vxx_rdn_actr_rly_scg "" UWORD _CNV_A_R_A_105_CM 1 0. 0. 65535. DISPLAY_IDENTIFIER fm_sta_actr_rly_scg.Vxx_rdn_xxx ECU_ADDRESS 0xd0005200 /end MEASUREMENT
/begin MEASUREMENT Vbx_cf_actr_rly_scg "" UBYTE _CNV_A_R_A_105_CM 1 0. 0. 255. DISPLAY_IDENTIFIER fm_sta_actr_rly_scg.fm_static_bitfield.Vbx_cf_xxx ECU_ADDRESS 0xd0005202 BIT_MASK 0x1 /end MEASUREMENT
/begin MEASUREMENT Vbx_clf_actr_rly_scg "" UBYTE _CNV_A_R_A_105_CM 1 0. 0. 255. DISPLAY_IDENTIFIER fm_sta_actr_rly_scg.fm_static_bitfield.Vbx_clf_xxx ECU_ADDRESS 0xd0005202 BIT_MASK 0x2 /end MEASUREMENT
/begin MEASUREMENT Vbx_df_old_actr_rly_scg "" UBYTE _CNV_A_R_A_105_CM 1 0. 0. 255. DISPLAY_IDENTIFIER fm_sta_actr_rly_scg.fm_static_bitfield.Vbx_df_old_xxx ECU_ADDRESS 0xd0005202 BIT_MASK 0x4 /end MEASUREMENT
/begin MEASUREMENT Vbx_dfctr_sat_actr_rly_scg "" UBYTE _CNV_A_R_A_105_CM 1 0. 0. 255. DISPLAY_IDENTIFIER fm_sta_actr_rly_scg.fm_static_bitfield.Vbx_dfctr_sat_xxx ECU_ADDRESS 0xd0005202 BIT_MASK 0x8 /end MEASUREMENT
/begin MEASUREMENT Vbx_rdn_actr_rly_scg "" UBYTE _CNV_A_R_A_105_CM 1 0. 0. 255. DISPLAY_IDENTIFIER fm_sta_actr_rly_scg.fm_static_bitfield.Vbx_rdn_xxx ECU_ADDRESS 0xd0005202 BIT_MASK 0x40 /end MEASUREMENT
/begin MEASUREMENT Vxx_dtc_stt_actr_rly_scg "" UBYTE _CNV_A_R_A_105_CM 1 0. 0. 255. DISPLAY_IDENTIFIER fm_sta_actr_rly_scg.Vxx_dtc_stt_xxx ECU_ADDRESS 0xd0005203 /end MEASUREMENT
/begin MEASUREMENT Vxx_dfctr_actr_rly_scw "" UWORD _CNV_A_R_A_105_CM 1 0. 0. 65535. DISPLAY_IDENTIFIER fm_sta_actr_rly_scw.Vxx_dfctr_xxx ECU_ADDRESS 0xd0005204 /end MEASUREMENT
/begin MEASUREMENT Vxx_rdn_actr_rly_scw "" UWORD _CNV_A_R_A_105_CM 1 0. 0. 65535. DISPLAY_IDENTIFIER fm_sta_actr_rly_scw.Vxx_rdn_xxx ECU_ADDRESS 0xd0005206 /end MEASUREMENT
/begin MEASUREMENT Vbx_cf_actr_rly_scw "" UBYTE _CNV_A_R_A_105_CM 1 0. 0. 255. DISPLAY_IDENTIFIER fm_sta_actr_rly_scw.fm_static_bitfield.Vbx_cf_xxx ECU_ADDRESS 0xd0005208 BIT_MASK 0x1 /end MEASUREMENT
/begin MEASUREMENT Vbx_clf_actr_rly_scw "" UBYTE _CNV_A_R_A_105_CM 1 0. 0. 255. DISPLAY_IDENTIFIER fm_sta_actr_rly_scw.fm_static_bitfield.Vbx_clf_xxx ECU_ADDRESS 0xd0005208 BIT_MASK 0x2 /end MEASUREMENT
/begin MEASUREMENT Vbx_df_old_actr_rly_scw "" UBYTE _CNV_A_R_A_105_CM 1 0. 0. 255. DISPLAY_IDENTIFIER fm_sta_actr_rly_scw.fm_static_bitfield.Vbx_df_old_xxx ECU_ADDRESS 0xd0005208 BIT_MASK 0x4 /end MEASUREMENT
/begin MEASUREMENT Vbx_dfctr_sat_actr_rly_scw "" UBYTE _CNV_A_R_A_105_CM 1 0. 0. 255. DISPLAY_IDENTIFIER fm_sta_actr_rly_scw.fm_static_bitfield.Vbx_dfctr_sat_xxx ECU_ADDRESS 0xd0005208 BIT_MASK 0x8 /end MEASUREMENT
/begin MEASUREMENT Vbx_rdn_actr_rly_scw "" UBYTE _CNV_A_R_A_105_CM 1 0. 0. 255. DISPLAY_IDENTIFIER fm_sta_actr_rly_scw.fm_static_bitfield.Vbx_rdn_xxx ECU_ADDRESS 0xd0005208 BIT_MASK 0x40 /end MEASUREMENT
/begin MEASUREMENT Vxx_dtc_stt_actr_rly_scw "" UBYTE _CNV_A_R_A_105_CM 1 0. 0. 255. DISPLAY_IDENTIFIER fm_sta_actr_rly_scw.Vxx_dtc_stt_xxx ECU_ADDRESS 0xd0005209 /end MEASUREMENT
/begin MEASUREMENT Vxx_dfctr_agb_data_chr "" UWORD _CNV_A_R_A_105_CM 1 0. 0. 65535. DISPLAY_IDENTIFIER fm_sta_agb_data_chr.Vxx_dfctr_xxx ECU_ADDRESS 0xd000520a /end MEASUREMENT
/begin MEASUREMENT Vxx_rdn_agb_data_chr "" UWORD _CNV_A_R_A_105_CM 1 0. 0. 65535. DISPLAY_IDENTIFIER fm_sta_agb_data_chr.Vxx_rdn_xxx ECU_ADDRESS 0xd000520c /end MEASUREMENT
/begin MEASUREMENT Vbx_cf_agb_data_chr "" UBYTE _CNV_A_R_A_105_CM 1 0. 0. 255. DISPLAY_IDENTIFIER fm_sta_agb_data_chr.fm_static_bitfield.Vbx_cf_xxx ECU_ADDRESS 0xd000520e BIT_MASK 0x1 /end MEASUREMENT
/begin MEASUREMENT Vbx_clf_agb_data_chr "" UBYTE _CNV_A_R_A_105_CM 1 0. 0. 255. DISPLAY_IDENTIFIER fm_sta_agb_data_chr.fm_static_bitfield.Vbx_clf_xxx ECU_ADDRESS 0xd000520e BIT_MASK 0x2 /end MEASUREMENT
/begin MEASUREMENT Vbx_df_old_agb_data_chr "" UBYTE _CNV_A_R_A_105_CM 1 0. 0. 255. DISPLAY_IDENTIFIER fm_sta_agb_data_chr.fm_static_bitfield.Vbx_df_old_xxx ECU_ADDRESS 0xd000520e BIT_MASK 0x4 /end MEASUREMENT
/begin MEASUREMENT Vbx_dfctr_sat_agb_data_chr "" UBYTE _CNV_A_R_A_105_CM 1 0. 0. 255. DISPLAY_IDENTIFIER fm_sta_agb_data_chr.fm_static_bitfield.Vbx_dfctr_sat_xxx ECU_ADDRESS 0xd000520e BIT_MASK 0x8 /end MEASUREMENT
/begin MEASUREMENT Vbx_rdn_agb_data_chr "" UBYTE _CNV_A_R_A_105_CM 1 0. 0. 255. DISPLAY_IDENTIFIER fm_sta_agb_data_chr.fm_static_bitfield.Vbx_rdn_xxx ECU_ADDRESS 0xd000520e BIT_MASK 0x40 /end MEASUREMENT
/begin MEASUREMENT Vxx_dtc_stt_agb_data_chr "" UBYTE _CNV_A_R_A_105_CM 1 0. 0. 255. DISPLAY_IDENTIFIER fm_sta_agb_data_chr.Vxx_dtc_stt_xxx ECU_ADDRESS 0xd000520f /end MEASUREMENT
/begin MEASUREMENT Vxx_dfctr_agb_data_seq_ctr "" UWORD _CNV_A_R_A_105_CM 1 0. 0. 65535. DISPLAY_IDENTIFIER fm_sta_agb_data_seq_ctr.Vxx_dfctr_xxx ECU_ADDRESS 0xd0005210 /end MEASUREMENT
/begin MEASUREMENT Vxx_rdn_agb_data_seq_ctr "" UWORD _CNV_A_R_A_105_CM 1 0. 0. 65535. DISPLAY_IDENTIFIER fm_sta_agb_data_seq_ctr.Vxx_rdn_xxx ECU_ADDRESS 0xd0005212 /end MEASUREMENT
/begin MEASUREMENT Vbx_cf_agb_data_seq_ctr "" UBYTE _CNV_A_R_A_105_CM 1 0. 0. 255. DISPLAY_IDENTIFIER fm_sta_agb_data_seq_ctr.fm_static_bitfield.Vbx_cf_xxx ECU_ADDRESS 0xd0005214 BIT_MASK 0x1 /end MEASUREMENT
/begin MEASUREMENT Vbx_clf_agb_data_seq_ctr "" UBYTE _CNV_A_R_A_105_CM 1 0. 0. 255. DISPLAY_IDENTIFIER fm_sta_agb_data_seq_ctr.fm_static_bitfield.Vbx_clf_xxx ECU_ADDRESS 0xd0005214 BIT_MASK 0x2 /end MEASUREMENT
/begin MEASUREMENT Vbx_df_old_agb_data_seq_ctr "" UBYTE _CNV_A_R_A_105_CM 1 0. 0. 255. DISPLAY_IDENTIFIER fm_sta_agb_data_seq_ctr.fm_static_bitfield.Vbx_df_old_xxx ECU_ADDRESS 0xd0005214 BIT_MASK 0x4 /end MEASUREMENT
/begin MEASUREMENT Vbx_dfctr_sat_agb_data_seq_ctr "" UBYTE _CNV_A_R_A_105_CM 1 0. 0. 255. DISPLAY_IDENTIFIER fm_sta_agb_data_seq_ctr.fm_static_bitfield.Vbx_dfctr_sat_xxx ECU_ADDRESS 0xd0005214 BIT_MASK 0x8 /end MEASUREMENT
/begin MEASUREMENT Vbx_rdn_agb_data_seq_ctr "" UBYTE _CNV_A_R_A_105_CM 1 0. 0. 255. DISPLAY_IDENTIFIER fm_sta_agb_data_seq_ctr.fm_static_bitfield.Vbx_rdn_xxx ECU_ADDRESS 0xd0005214 BIT_MASK 0x40 /end MEASUREMENT
/begin MEASUREMENT Vxx_dtc_stt_agb_data_seq_ctr "" UBYTE _CNV_A_R_A_105_CM 1 0. 0. 255. DISPLAY_IDENTIFIER fm_sta_agb_data_seq_ctr.Vxx_dtc_stt_xxx ECU_ADDRESS 0xd0005215 /end MEASUREMENT
/begin MEASUREMENT Vxx_dfctr_agb_data_tout "" UWORD _CNV_A_R_A_105_CM 1 0. 0. 65535. DISPLAY_IDENTIFIER fm_sta_agb_data_tout.Vxx_dfctr_xxx ECU_ADDRESS 0xd0005216 /end MEASUREMENT
/begin MEASUREMENT Vxx_rdn_agb_data_tout "" UWORD _CNV_A_R_A_105_CM 1 0. 0. 65535. DISPLAY_IDENTIFIER fm_sta_agb_data_tout.Vxx_rdn_xxx ECU_ADDRESS 0xd0005218 /end MEASUREMENT
/begin MEASUREMENT Vbx_cf_agb_data_tout "" UBYTE _CNV_A_R_A_105_CM 1 0. 0. 255. DISPLAY_IDENTIFIER fm_sta_agb_data_tout.fm_static_bitfield.Vbx_cf_xxx ECU_ADDRESS 0xd000521a BIT_MASK 0x1 /end MEASUREMENT
/begin MEASUREMENT Vbx_clf_agb_data_tout "" UBYTE _CNV_A_R_A_105_CM 1 0. 0. 255. DISPLAY_IDENTIFIER fm_sta_agb_data_tout.fm_static_bitfield.Vbx_clf_xxx ECU_ADDRESS 0xd000521a BIT_MASK 0x2 /end MEASUREMENT
/begin MEASUREMENT Vbx_df_old_agb_data_tout "" UBYTE _CNV_A_R_A_105_CM 1 0. 0. 255. DISPLAY_IDENTIFIER fm_sta_agb_data_tout.fm_static_bitfield.Vbx_df_old_xxx ECU_ADDRESS 0xd000521a BIT_MASK 0x4 /end MEASUREMENT
/begin MEASUREMENT Vbx_dfctr_sat_agb_data_tout "" UBYTE _CNV_A_R_A_105_CM 1 0. 0. 255. DISPLAY_IDENTIFIER fm_sta_agb_data_tout.fm_static_bitfield.Vbx_dfctr_sat_xxx ECU_ADDRESS 0xd000521a BIT_MASK 0x8 /end MEASUREMENT
/begin MEASUREMENT Vbx_rdn_agb_data_tout "" UBYTE _CNV_A_R_A_105_CM 1 0. 0. 255. DISPLAY_IDENTIFIER fm_sta_agb_data_tout.fm_static_bitfield.Vbx_rdn_xxx ECU_ADDRESS 0xd000521a BIT_MASK 0x40 /end MEASUREMENT
/begin MEASUREMENT Vxx_dtc_stt_agb_data_tout "" UBYTE _CNV_A_R_A_105_CM 1 0. 0. 255. DISPLAY_IDENTIFIER fm_sta_agb_data_tout.Vxx_dtc_stt_xxx ECU_ADDRESS 0xd000521b /end MEASUREMENT
/begin MEASUREMENT Vxx_dfctr_agb_no_frm "" UWORD _CNV_A_R_A_105_CM 1 0. 0. 65535. DISPLAY_IDENTIFIER fm_sta_agb_no_frm.Vxx_dfctr_xxx ECU_ADDRESS 0xd000521c /end MEASUREMENT
/begin MEASUREMENT Vxx_rdn_agb_no_frm "" UWORD _CNV_A_R_A_105_CM 1 0. 0. 65535. DISPLAY_IDENTIFIER fm_sta_agb_no_frm.Vxx_rdn_xxx ECU_ADDRESS 0xd000521e /end MEASUREMENT
/begin MEASUREMENT Vbx_cf_agb_no_frm "" UBYTE _CNV_A_R_A_105_CM 1 0. 0. 255. DISPLAY_IDENTIFIER fm_sta_agb_no_frm.fm_static_bitfield.Vbx_cf_xxx ECU_ADDRESS 0xd0005220 BIT_MASK 0x1 /end MEASUREMENT
/begin MEASUREMENT Vbx_clf_agb_no_frm "" UBYTE _CNV_A_R_A_105_CM 1 0. 0. 255. DISPLAY_IDENTIFIER fm_sta_agb_no_frm.fm_static_bitfield.Vbx_clf_xxx ECU_ADDRESS 0xd0005220 BIT_MASK 0x2 /end MEASUREMENT
/begin MEASUREMENT Vbx_df_old_agb_no_frm "" UBYTE _CNV_A_R_A_105_CM 1 0. 0. 255. DISPLAY_IDENTIFIER fm_sta_agb_no_frm.fm_static_bitfield.Vbx_df_old_xxx ECU_ADDRESS 0xd0005220 BIT_MASK 0x4 /end MEASUREMENT
/begin MEASUREMENT Vbx_dfctr_sat_agb_no_frm "" UBYTE _CNV_A_R_A_105_CM 1 0. 0. 255. DISPLAY_IDENTIFIER fm_sta_agb_no_frm.fm_static_bitfield.Vbx_dfctr_sat_xxx ECU_ADDRESS 0xd0005220 BIT_MASK 0x8 /end MEASUREMENT
/begin MEASUREMENT Vbx_rdn_agb_no_frm "" UBYTE _CNV_A_R_A_105_CM 1 0. 0. 255. DISPLAY_IDENTIFIER fm_sta_agb_no_frm.fm_static_bitfield.Vbx_rdn_xxx ECU_ADDRESS 0xd0005220 BIT_MASK 0x40 /end MEASUREMENT
/begin MEASUREMENT Vxx_dtc_stt_agb_no_frm "" UBYTE _CNV_A_R_A_105_CM 1 0. 0. 255. DISPLAY_IDENTIFIER fm_sta_agb_no_frm.Vxx_dtc_stt_xxx ECU_ADDRESS 0xd0005221 /end MEASUREMENT
/begin MEASUREMENT Vxx_dfctr_bgin_clu_cmp "" UWORD _CNV_A_R_A_105_CM 1 0. 0. 65535. DISPLAY_IDENTIFIER fm_sta_bgin_clu_cmp.Vxx_dfctr_xxx ECU_ADDRESS 0xd00053ae /end MEASUREMENT
/begin MEASUREMENT Vxx_rdn_bgin_clu_cmp "" UWORD _CNV_A_R_A_105_CM 1 0. 0. 65535. DISPLAY_IDENTIFIER fm_sta_bgin_clu_cmp.Vxx_rdn_xxx ECU_ADDRESS 0xd00053b0 /end MEASUREMENT
/begin MEASUREMENT Vbx_cf_bgin_clu_cmp "" UBYTE _CNV_A_R_A_105_CM 1 0. 0. 255. DISPLAY_IDENTIFIER fm_sta_bgin_clu_cmp.fm_static_bitfield.Vbx_cf_xxx ECU_ADDRESS 0xd00053b2 BIT_MASK 0x1 /end MEASUREMENT
/begin MEASUREMENT Vbx_clf_bgin_clu_cmp "" UBYTE _CNV_A_R_A_105_CM 1 0. 0. 255. DISPLAY_IDENTIFIER fm_sta_bgin_clu_cmp.fm_static_bitfield.Vbx_clf_xxx ECU_ADDRESS 0xd00053b2 BIT_MASK 0x2 /end MEASUREMENT
/begin MEASUREMENT Vbx_df_old_bgin_clu_cmp "" UBYTE _CNV_A_R_A_105_CM 1 0. 0. 255. DISPLAY_IDENTIFIER fm_sta_bgin_clu_cmp.fm_static_bitfield.Vbx_df_old_xxx ECU_ADDRESS 0xd00053b2 BIT_MASK 0x4 /end MEASUREMENT
/begin MEASUREMENT Vbx_dfctr_sat_bgin_clu_cmp "" UBYTE _CNV_A_R_A_105_CM 1 0. 0. 255. DISPLAY_IDENTIFIER fm_sta_bgin_clu_cmp.fm_static_bitfield.Vbx_dfctr_sat_xxx ECU_ADDRESS 0xd00053b2 BIT_MASK 0x8 /end MEASUREMENT
/begin MEASUREMENT Vbx_rdn_bgin_clu_cmp "" UBYTE _CNV_A_R_A_105_CM 1 0. 0. 255. DISPLAY_IDENTIFIER fm_sta_bgin_clu_cmp.fm_static_bitfield.Vbx_rdn_xxx ECU_ADDRESS 0xd00053b2 BIT_MASK 0x40 /end MEASUREMENT
/begin MEASUREMENT Vxx_dtc_stt_bgin_clu_cmp "" UBYTE _CNV_A_R_A_105_CM 1 0. 0. 255. DISPLAY_IDENTIFIER fm_sta_bgin_clu_cmp.Vxx_dtc_stt_xxx ECU_ADDRESS 0xd00053b3 /end MEASUREMENT
/begin MEASUREMENT Vxx_dfctr_bgin_clu_nok "" UWORD _CNV_A_R_A_105_CM 1 0. 0. 65535. DISPLAY_IDENTIFIER fm_sta_bgin_clu_nok.Vxx_dfctr_xxx ECU_ADDRESS 0xd00053b4 /end MEASUREMENT
/begin MEASUREMENT Vxx_rdn_bgin_clu_nok "" UWORD _CNV_A_R_A_105_CM 1 0. 0. 65535. DISPLAY_IDENTIFIER fm_sta_bgin_clu_nok.Vxx_rdn_xxx ECU_ADDRESS 0xd00053b6 /end MEASUREMENT
/begin MEASUREMENT Vbx_cf_bgin_clu_nok "" UBYTE _CNV_A_R_A_105_CM 1 0. 0. 255. DISPLAY_IDENTIFIER fm_sta_bgin_clu_nok.fm_static_bitfield.Vbx_cf_xxx ECU_ADDRESS 0xd00053b8 BIT_MASK 0x1 /end MEASUREMENT
/begin MEASUREMENT Vbx_clf_bgin_clu_nok "" UBYTE _CNV_A_R_A_105_CM 1 0. 0. 255. DISPLAY_IDENTIFIER fm_sta_bgin_clu_nok.fm_static_bitfield.Vbx_clf_xxx ECU_ADDRESS 0xd00053b8 BIT_MASK 0x2 /end MEASUREMENT
/begin MEASUREMENT Vbx_df_old_bgin_clu_nok "" UBYTE _CNV_A_R_A_105_CM 1 0. 0. 255. DISPLAY_IDENTIFIER fm_sta_bgin_clu_nok.fm_static_bitfield.Vbx_df_old_xxx ECU_ADDRESS 0xd00053b8 BIT_MASK 0x4 /end MEASUREMENT
/begin MEASUREMENT Vbx_dfctr_sat_bgin_clu_nok "" UBYTE _CNV_A_R_A_105_CM 1 0. 0. 255. DISPLAY_IDENTIFIER fm_sta_bgin_clu_nok.fm_static_bitfield.Vbx_dfctr_sat_xxx ECU_ADDRESS 0xd00053b8 BIT_MASK 0x8 /end MEASUREMENT
/begin MEASUREMENT Vbx_rdn_bgin_clu_nok "" UBYTE _CNV_A_R_A_105_CM 1 0. 0. 255. DISPLAY_IDENTIFIER fm_sta_bgin_clu_nok.fm_static_bitfield.Vbx_rdn_xxx ECU_ADDRESS 0xd00053b8 BIT_MASK 0x40 /end MEASUREMENT
/begin MEASUREMENT Vxx_dtc_stt_bgin_clu_nok "" UBYTE _CNV_A_R_A_105_CM 1 0. 0. 255. DISPLAY_IDENTIFIER fm_sta_bgin_clu_nok.Vxx_dtc_stt_xxx ECU_ADDRESS 0xd00053b9 /end MEASUREMENT
/begin MEASUREMENT Vxx_dfctr_brk_pdl_cmp "" UWORD _CNV_A_R_A_105_CM 1 0. 0. 65535. DISPLAY_IDENTIFIER fm_sta_brk_pdl_cmp.Vxx_dfctr_xxx ECU_ADDRESS 0xd00053ba /end MEASUREMENT
/begin MEASUREMENT Vxx_rdn_brk_pdl_cmp "" UWORD _CNV_A_R_A_105_CM 1 0. 0. 65535. DISPLAY_IDENTIFIER fm_sta_brk_pdl_cmp.Vxx_rdn_xxx ECU_ADDRESS 0xd00053bc /end MEASUREMENT
/begin MEASUREMENT Vbx_cf_brk_pdl_cmp "" UBYTE _CNV_A_R_A_105_CM 1 0. 0. 255. DISPLAY_IDENTIFIER fm_sta_brk_pdl_cmp.fm_static_bitfield.Vbx_cf_xxx ECU_ADDRESS 0xd00053be BIT_MASK 0x1 /end MEASUREMENT
/begin MEASUREMENT Vbx_clf_brk_pdl_cmp "" UBYTE _CNV_A_R_A_105_CM 1 0. 0. 255. DISPLAY_IDENTIFIER fm_sta_brk_pdl_cmp.fm_static_bitfield.Vbx_clf_xxx ECU_ADDRESS 0xd00053be BIT_MASK 0x2 /end MEASUREMENT
/begin MEASUREMENT Vbx_df_old_brk_pdl_cmp "" UBYTE _CNV_A_R_A_105_CM 1 0. 0. 255. DISPLAY_IDENTIFIER fm_sta_brk_pdl_cmp.fm_static_bitfield.Vbx_df_old_xxx ECU_ADDRESS 0xd00053be BIT_MASK 0x4 /end MEASUREMENT
/begin MEASUREMENT Vbx_dfctr_sat_brk_pdl_cmp "" UBYTE _CNV_A_R_A_105_CM 1 0. 0. 255. DISPLAY_IDENTIFIER fm_sta_brk_pdl_cmp.fm_static_bitfield.Vbx_dfctr_sat_xxx ECU_ADDRESS 0xd00053be BIT_MASK 0x8 /end MEASUREMENT
/begin MEASUREMENT Vbx_rdn_brk_pdl_cmp "" UBYTE _CNV_A_R_A_105_CM 1 0. 0. 255. DISPLAY_IDENTIFIER fm_sta_brk_pdl_cmp.fm_static_bitfield.Vbx_rdn_xxx ECU_ADDRESS 0xd00053be BIT_MASK 0x40 /end MEASUREMENT
/begin MEASUREMENT Vxx_dtc_stt_brk_pdl_cmp "" UBYTE _CNV_A_R_A_105_CM 1 0. 0. 255. DISPLAY_IDENTIFIER fm_sta_brk_pdl_cmp.Vxx_dtc_stt_xxx ECU_ADDRESS 0xd00053bf /end MEASUREMENT
/begin MEASUREMENT Vxx_dfctr_cata_cpt "" UWORD _CNV_A_R_A_105_CM 1 0. 0. 65535. DISPLAY_IDENTIFIER fm_sta_cata_cpt.Vxx_dfctr_xxx ECU_ADDRESS 0xd00053c0 /end MEASUREMENT
/begin MEASUREMENT Vxx_rdn_cata_cpt "" UWORD _CNV_A_R_A_105_CM 1 0. 0. 65535. DISPLAY_IDENTIFIER fm_sta_cata_cpt.Vxx_rdn_xxx ECU_ADDRESS 0xd00053c2 /end MEASUREMENT
/begin MEASUREMENT Vbx_cf_cata_cpt "" UBYTE _CNV_A_R_A_105_CM 1 0. 0. 255. DISPLAY_IDENTIFIER fm_sta_cata_cpt.fm_static_bitfield.Vbx_cf_xxx ECU_ADDRESS 0xd00053c4 BIT_MASK 0x1 /end MEASUREMENT
/begin MEASUREMENT Vbx_clf_cata_cpt "" UBYTE _CNV_A_R_A_105_CM 1 0. 0. 255. DISPLAY_IDENTIFIER fm_sta_cata_cpt.fm_static_bitfield.Vbx_clf_xxx ECU_ADDRESS 0xd00053c4 BIT_MASK 0x2 /end MEASUREMENT
/begin MEASUREMENT Vbx_df_old_cata_cpt "" UBYTE _CNV_A_R_A_105_CM 1 0. 0. 255. DISPLAY_IDENTIFIER fm_sta_cata_cpt.fm_static_bitfield.Vbx_df_old_xxx ECU_ADDRESS 0xd00053c4 BIT_MASK 0x4 /end MEASUREMENT
/begin MEASUREMENT Vbx_dfctr_sat_cata_cpt "" UBYTE _CNV_A_R_A_105_CM 1 0. 0. 255. DISPLAY_IDENTIFIER fm_sta_cata_cpt.fm_static_bitfield.Vbx_dfctr_sat_xxx ECU_ADDRESS 0xd00053c4 BIT_MASK 0x8 /end MEASUREMENT
/begin MEASUREMENT Vbx_rdn_cata_cpt "" UBYTE _CNV_A_R_A_105_CM 1 0. 0. 255. DISPLAY_IDENTIFIER fm_sta_cata_cpt.fm_static_bitfield.Vbx_rdn_xxx ECU_ADDRESS 0xd00053c4 BIT_MASK 0x40 /end MEASUREMENT
/begin MEASUREMENT Vxx_dtc_stt_cata_cpt "" UBYTE _CNV_A_R_A_105_CM 1 0. 0. 255. DISPLAY_IDENTIFIER fm_sta_cata_cpt.Vxx_dtc_stt_xxx ECU_ADDRESS 0xd00053c5 /end MEASUREMENT
/begin MEASUREMENT Vxx_dfctr_cl_rich_chr "" UWORD _CNV_A_R_A_105_CM 1 0. 0. 65535. DISPLAY_IDENTIFIER fm_sta_cl_rich_chr.Vxx_dfctr_xxx ECU_ADDRESS 0xd000557c /end MEASUREMENT
/begin MEASUREMENT Vxx_rdn_cl_rich_chr "" UWORD _CNV_A_R_A_105_CM 1 0. 0. 65535. DISPLAY_IDENTIFIER fm_sta_cl_rich_chr.Vxx_rdn_xxx ECU_ADDRESS 0xd000557e /end MEASUREMENT
/begin MEASUREMENT Vbx_cf_cl_rich_chr "" UBYTE _CNV_A_R_A_105_CM 1 0. 0. 255. DISPLAY_IDENTIFIER fm_sta_cl_rich_chr.fm_static_bitfield.Vbx_cf_xxx ECU_ADDRESS 0xd0005580 BIT_MASK 0x1 /end MEASUREMENT
/begin MEASUREMENT Vbx_clf_cl_rich_chr "" UBYTE _CNV_A_R_A_105_CM 1 0. 0. 255. DISPLAY_IDENTIFIER fm_sta_cl_rich_chr.fm_static_bitfield.Vbx_clf_xxx ECU_ADDRESS 0xd0005580 BIT_MASK 0x2 /end MEASUREMENT
/begin MEASUREMENT Vbx_df_old_cl_rich_chr "" UBYTE _CNV_A_R_A_105_CM 1 0. 0. 255. DISPLAY_IDENTIFIER fm_sta_cl_rich_chr.fm_static_bitfield.Vbx_df_old_xxx ECU_ADDRESS 0xd0005580 BIT_MASK 0x4 /end MEASUREMENT
/begin MEASUREMENT Vbx_dfctr_sat_cl_rich_chr "" UBYTE _CNV_A_R_A_105_CM 1 0. 0. 255. DISPLAY_IDENTIFIER fm_sta_cl_rich_chr.fm_static_bitfield.Vbx_dfctr_sat_xxx ECU_ADDRESS 0xd0005580 BIT_MASK 0x8 /end MEASUREMENT
/begin MEASUREMENT Vbx_rdn_cl_rich_chr "" UBYTE _CNV_A_R_A_105_CM 1 0. 0. 255. DISPLAY_IDENTIFIER fm_sta_cl_rich_chr.fm_static_bitfield.Vbx_rdn_xxx ECU_ADDRESS 0xd0005580 BIT_MASK 0x40 /end MEASUREMENT
/begin MEASUREMENT Vxx_dtc_stt_cl_rich_chr "" UBYTE _CNV_A_R_A_105_CM 1 0. 0. 255. DISPLAY_IDENTIFIER fm_sta_cl_rich_chr.Vxx_dtc_stt_xxx ECU_ADDRESS 0xd0005581 /end MEASUREMENT
/begin MEASUREMENT Vxx_dfctr_clu_cnt_nok "" UWORD _CNV_A_R_A_105_CM 1 0. 0. 65535. DISPLAY_IDENTIFIER fm_sta_clu_cnt_nok.Vxx_dfctr_xxx ECU_ADDRESS 0xd0005222 /end MEASUREMENT
/begin MEASUREMENT Vxx_rdn_clu_cnt_nok "" UWORD _CNV_A_R_A_105_CM 1 0. 0. 65535. DISPLAY_IDENTIFIER fm_sta_clu_cnt_nok.Vxx_rdn_xxx ECU_ADDRESS 0xd0005224 /end MEASUREMENT
/begin MEASUREMENT Vbx_cf_clu_cnt_nok "" UBYTE _CNV_A_R_A_105_CM 1 0. 0. 255. DISPLAY_IDENTIFIER fm_sta_clu_cnt_nok.fm_static_bitfield.Vbx_cf_xxx ECU_ADDRESS 0xd0005226 BIT_MASK 0x1 /end MEASUREMENT
/begin MEASUREMENT Vbx_clf_clu_cnt_nok "" UBYTE _CNV_A_R_A_105_CM 1 0. 0. 255. DISPLAY_IDENTIFIER fm_sta_clu_cnt_nok.fm_static_bitfield.Vbx_clf_xxx ECU_ADDRESS 0xd0005226 BIT_MASK 0x2 /end MEASUREMENT
/begin MEASUREMENT Vbx_df_old_clu_cnt_nok "" UBYTE _CNV_A_R_A_105_CM 1 0. 0. 255. DISPLAY_IDENTIFIER fm_sta_clu_cnt_nok.fm_static_bitfield.Vbx_df_old_xxx ECU_ADDRESS 0xd0005226 BIT_MASK 0x4 /end MEASUREMENT
/begin MEASUREMENT Vbx_dfctr_sat_clu_cnt_nok "" UBYTE _CNV_A_R_A_105_CM 1 0. 0. 255. DISPLAY_IDENTIFIER fm_sta_clu_cnt_nok.fm_static_bitfield.Vbx_dfctr_sat_xxx ECU_ADDRESS 0xd0005226 BIT_MASK 0x8 /end MEASUREMENT
/begin MEASUREMENT Vbx_rdn_clu_cnt_nok "" UBYTE _CNV_A_R_A_105_CM 1 0. 0. 255. DISPLAY_IDENTIFIER fm_sta_clu_cnt_nok.fm_static_bitfield.Vbx_rdn_xxx ECU_ADDRESS 0xd0005226 BIT_MASK 0x40 /end MEASUREMENT
/begin MEASUREMENT Vxx_dtc_stt_clu_cnt_nok "" UBYTE _CNV_A_R_A_105_CM 1 0. 0. 255. DISPLAY_IDENTIFIER fm_sta_clu_cnt_nok.Vxx_dtc_stt_xxx ECU_ADDRESS 0xd0005227 /end MEASUREMENT
/begin MEASUREMENT Vxx_dfctr_cp_blk_open "" UWORD _CNV_A_R_A_105_CM 1 0. 0. 65535. DISPLAY_IDENTIFIER fm_sta_cp_blk_open.Vxx_dfctr_xxx ECU_ADDRESS 0xd00055b8 /end MEASUREMENT
/begin MEASUREMENT Vxx_rdn_cp_blk_open "" UWORD _CNV_A_R_A_105_CM 1 0. 0. 65535. DISPLAY_IDENTIFIER fm_sta_cp_blk_open.Vxx_rdn_xxx ECU_ADDRESS 0xd00055ba /end MEASUREMENT
/begin MEASUREMENT Vbx_cf_cp_blk_open "" UBYTE _CNV_A_R_A_105_CM 1 0. 0. 255. DISPLAY_IDENTIFIER fm_sta_cp_blk_open.fm_static_bitfield.Vbx_cf_xxx ECU_ADDRESS 0xd00055bc BIT_MASK 0x1 /end MEASUREMENT
/begin MEASUREMENT Vbx_clf_cp_blk_open "" UBYTE _CNV_A_R_A_105_CM 1 0. 0. 255. DISPLAY_IDENTIFIER fm_sta_cp_blk_open.fm_static_bitfield.Vbx_clf_xxx ECU_ADDRESS 0xd00055bc BIT_MASK 0x2 /end MEASUREMENT
/begin MEASUREMENT Vbx_df_old_cp_blk_open "" UBYTE _CNV_A_R_A_105_CM 1 0. 0. 255. DISPLAY_IDENTIFIER fm_sta_cp_blk_open.fm_static_bitfield.Vbx_df_old_xxx ECU_ADDRESS 0xd00055bc BIT_MASK 0x4 /end MEASUREMENT
/begin MEASUREMENT Vbx_dfctr_sat_cp_blk_open "" UBYTE _CNV_A_R_A_105_CM 1 0. 0. 255. DISPLAY_IDENTIFIER fm_sta_cp_blk_open.fm_static_bitfield.Vbx_dfctr_sat_xxx ECU_ADDRESS 0xd00055bc BIT_MASK 0x8 /end MEASUREMENT
/begin MEASUREMENT Vbx_rdn_cp_blk_open "" UBYTE _CNV_A_R_A_105_CM 1 0. 0. 255. DISPLAY_IDENTIFIER fm_sta_cp_blk_open.fm_static_bitfield.Vbx_rdn_xxx ECU_ADDRESS 0xd00055bc BIT_MASK 0x40 /end MEASUREMENT
/begin MEASUREMENT Vxx_dtc_stt_cp_blk_open "" UBYTE _CNV_A_R_A_105_CM 1 0. 0. 255. DISPLAY_IDENTIFIER fm_sta_cp_blk_open.Vxx_dtc_stt_xxx ECU_ADDRESS 0xd00055bd /end MEASUREMENT
/begin MEASUREMENT Vxx_dfctr_cp_oc "" UWORD _CNV_A_R_A_105_CM 1 0. 0. 65535. DISPLAY_IDENTIFIER fm_sta_cp_oc.Vxx_dfctr_xxx ECU_ADDRESS 0xd0005390 /end MEASUREMENT
/begin MEASUREMENT Vxx_rdn_cp_oc "" UWORD _CNV_A_R_A_105_CM 1 0. 0. 65535. DISPLAY_IDENTIFIER fm_sta_cp_oc.Vxx_rdn_xxx ECU_ADDRESS 0xd0005392 /end MEASUREMENT
/begin MEASUREMENT Vbx_cf_cp_oc "" UBYTE _CNV_A_R_A_105_CM 1 0. 0. 255. DISPLAY_IDENTIFIER fm_sta_cp_oc.fm_static_bitfield.Vbx_cf_xxx ECU_ADDRESS 0xd0005394 BIT_MASK 0x1 /end MEASUREMENT
/begin MEASUREMENT Vbx_clf_cp_oc "" UBYTE _CNV_A_R_A_105_CM 1 0. 0. 255. DISPLAY_IDENTIFIER fm_sta_cp_oc.fm_static_bitfield.Vbx_clf_xxx ECU_ADDRESS 0xd0005394 BIT_MASK 0x2 /end MEASUREMENT
/begin MEASUREMENT Vbx_df_old_cp_oc "" UBYTE _CNV_A_R_A_105_CM 1 0. 0. 255. DISPLAY_IDENTIFIER fm_sta_cp_oc.fm_static_bitfield.Vbx_df_old_xxx ECU_ADDRESS 0xd0005394 BIT_MASK 0x4 /end MEASUREMENT
/begin MEASUREMENT Vbx_dfctr_sat_cp_oc "" UBYTE _CNV_A_R_A_105_CM 1 0. 0. 255. DISPLAY_IDENTIFIER fm_sta_cp_oc.fm_static_bitfield.Vbx_dfctr_sat_xxx ECU_ADDRESS 0xd0005394 BIT_MASK 0x8 /end MEASUREMENT
/begin MEASUREMENT Vbx_rdn_cp_oc "" UBYTE _CNV_A_R_A_105_CM 1 0. 0. 255. DISPLAY_IDENTIFIER fm_sta_cp_oc.fm_static_bitfield.Vbx_rdn_xxx ECU_ADDRESS 0xd0005394 BIT_MASK 0x40 /end MEASUREMENT
/begin MEASUREMENT Vxx_dtc_stt_cp_oc "" UBYTE _CNV_A_R_A_105_CM 1 0. 0. 255. DISPLAY_IDENTIFIER fm_sta_cp_oc.Vxx_dtc_stt_xxx ECU_ADDRESS 0xd0005395 /end MEASUREMENT
/begin MEASUREMENT Vxx_dfctr_cp_scg "" UWORD _CNV_A_R_A_105_CM 1 0. 0. 65535. DISPLAY_IDENTIFIER fm_sta_cp_scg.Vxx_dfctr_xxx ECU_ADDRESS 0xd0005396 /end MEASUREMENT
/begin MEASUREMENT Vxx_rdn_cp_scg "" UWORD _CNV_A_R_A_105_CM 1 0. 0. 65535. DISPLAY_IDENTIFIER fm_sta_cp_scg.Vxx_rdn_xxx ECU_ADDRESS 0xd0005398 /end MEASUREMENT
/begin MEASUREMENT Vbx_cf_cp_scg "" UBYTE _CNV_A_R_A_105_CM 1 0. 0. 255. DISPLAY_IDENTIFIER fm_sta_cp_scg.fm_static_bitfield.Vbx_cf_xxx ECU_ADDRESS 0xd000539a BIT_MASK 0x1 /end MEASUREMENT
/begin MEASUREMENT Vbx_clf_cp_scg "" UBYTE _CNV_A_R_A_105_CM 1 0. 0. 255. DISPLAY_IDENTIFIER fm_sta_cp_scg.fm_static_bitfield.Vbx_clf_xxx ECU_ADDRESS 0xd000539a BIT_MASK 0x2 /end MEASUREMENT
/begin MEASUREMENT Vbx_df_old_cp_scg "" UBYTE _CNV_A_R_A_105_CM 1 0. 0. 255. DISPLAY_IDENTIFIER fm_sta_cp_scg.fm_static_bitfield.Vbx_df_old_xxx ECU_ADDRESS 0xd000539a BIT_MASK 0x4 /end MEASUREMENT
/begin MEASUREMENT Vbx_dfctr_sat_cp_scg "" UBYTE _CNV_A_R_A_105_CM 1 0. 0. 255. DISPLAY_IDENTIFIER fm_sta_cp_scg.fm_static_bitfield.Vbx_dfctr_sat_xxx ECU_ADDRESS 0xd000539a BIT_MASK 0x8 /end MEASUREMENT
/begin MEASUREMENT Vbx_rdn_cp_scg "" UBYTE _CNV_A_R_A_105_CM 1 0. 0. 255. DISPLAY_IDENTIFIER fm_sta_cp_scg.fm_static_bitfield.Vbx_rdn_xxx ECU_ADDRESS 0xd000539a BIT_MASK 0x40 /end MEASUREMENT
/begin MEASUREMENT Vxx_dtc_stt_cp_scg "" UBYTE _CNV_A_R_A_105_CM 1 0. 0. 255. DISPLAY_IDENTIFIER fm_sta_cp_scg.Vxx_dtc_stt_xxx ECU_ADDRESS 0xd000539b /end MEASUREMENT
/begin MEASUREMENT Vxx_dfctr_cp_scw "" UWORD _CNV_A_R_A_105_CM 1 0. 0. 65535. DISPLAY_IDENTIFIER fm_sta_cp_scw.Vxx_dfctr_xxx ECU_ADDRESS 0xd000539c /end MEASUREMENT
/begin MEASUREMENT Vxx_rdn_cp_scw "" UWORD _CNV_A_R_A_105_CM 1 0. 0. 65535. DISPLAY_IDENTIFIER fm_sta_cp_scw.Vxx_rdn_xxx ECU_ADDRESS 0xd000539e /end MEASUREMENT
/begin MEASUREMENT Vbx_cf_cp_scw "" UBYTE _CNV_A_R_A_105_CM 1 0. 0. 255. DISPLAY_IDENTIFIER fm_sta_cp_scw.fm_static_bitfield.Vbx_cf_xxx ECU_ADDRESS 0xd00053a0 BIT_MASK 0x1 /end MEASUREMENT
/begin MEASUREMENT Vbx_clf_cp_scw "" UBYTE _CNV_A_R_A_105_CM 1 0. 0. 255. DISPLAY_IDENTIFIER fm_sta_cp_scw.fm_static_bitfield.Vbx_clf_xxx ECU_ADDRESS 0xd00053a0 BIT_MASK 0x2 /end MEASUREMENT
/begin MEASUREMENT Vbx_df_old_cp_scw "" UBYTE _CNV_A_R_A_105_CM 1 0. 0. 255. DISPLAY_IDENTIFIER fm_sta_cp_scw.fm_static_bitfield.Vbx_df_old_xxx ECU_ADDRESS 0xd00053a0 BIT_MASK 0x4 /end MEASUREMENT
/begin MEASUREMENT Vbx_dfctr_sat_cp_scw "" UBYTE _CNV_A_R_A_105_CM 1 0. 0. 255. DISPLAY_IDENTIFIER fm_sta_cp_scw.fm_static_bitfield.Vbx_dfctr_sat_xxx ECU_ADDRESS 0xd00053a0 BIT_MASK 0x8 /end MEASUREMENT
/begin MEASUREMENT Vbx_rdn_cp_scw "" UBYTE _CNV_A_R_A_105_CM 1 0. 0. 255. DISPLAY_IDENTIFIER fm_sta_cp_scw.fm_static_bitfield.Vbx_rdn_xxx ECU_ADDRESS 0xd00053a0 BIT_MASK 0x40 /end MEASUREMENT
/begin MEASUREMENT Vxx_dtc_stt_cp_scw "" UBYTE _CNV_A_R_A_105_CM 1 0. 0. 255. DISPLAY_IDENTIFIER fm_sta_cp_scw.Vxx_dtc_stt_xxx ECU_ADDRESS 0xd00053a1 /end MEASUREMENT
/begin MEASUREMENT Vxx_dfctr_crk_chr "" UWORD _CNV_A_R_A_105_CM 1 0. 0. 65535. DISPLAY_IDENTIFIER fm_sta_crk_chr.Vxx_dfctr_xxx ECU_ADDRESS 0xd00054f2 /end MEASUREMENT
/begin MEASUREMENT Vxx_rdn_crk_chr "" UWORD _CNV_A_R_A_105_CM 1 0. 0. 65535. DISPLAY_IDENTIFIER fm_sta_crk_chr.Vxx_rdn_xxx ECU_ADDRESS 0xd00054f4 /end MEASUREMENT
/begin MEASUREMENT Vbx_cf_crk_chr "" UBYTE _CNV_A_R_A_105_CM 1 0. 0. 255. DISPLAY_IDENTIFIER fm_sta_crk_chr.fm_static_bitfield.Vbx_cf_xxx ECU_ADDRESS 0xd00054f6 BIT_MASK 0x1 /end MEASUREMENT
/begin MEASUREMENT Vbx_clf_crk_chr "" UBYTE _CNV_A_R_A_105_CM 1 0. 0. 255. DISPLAY_IDENTIFIER fm_sta_crk_chr.fm_static_bitfield.Vbx_clf_xxx ECU_ADDRESS 0xd00054f6 BIT_MASK 0x2 /end MEASUREMENT
/begin MEASUREMENT Vbx_df_old_crk_chr "" UBYTE _CNV_A_R_A_105_CM 1 0. 0. 255. DISPLAY_IDENTIFIER fm_sta_crk_chr.fm_static_bitfield.Vbx_df_old_xxx ECU_ADDRESS 0xd00054f6 BIT_MASK 0x4 /end MEASUREMENT
/begin MEASUREMENT Vbx_dfctr_sat_crk_chr "" UBYTE _CNV_A_R_A_105_CM 1 0. 0. 255. DISPLAY_IDENTIFIER fm_sta_crk_chr.fm_static_bitfield.Vbx_dfctr_sat_xxx ECU_ADDRESS 0xd00054f6 BIT_MASK 0x8 /end MEASUREMENT
/begin MEASUREMENT Vbx_rdn_crk_chr "" UBYTE _CNV_A_R_A_105_CM 1 0. 0. 255. DISPLAY_IDENTIFIER fm_sta_crk_chr.fm_static_bitfield.Vbx_rdn_xxx ECU_ADDRESS 0xd00054f6 BIT_MASK 0x40 /end MEASUREMENT
/begin MEASUREMENT Vxx_dtc_stt_crk_chr "" UBYTE _CNV_A_R_A_105_CM 1 0. 0. 255. DISPLAY_IDENTIFIER fm_sta_crk_chr.Vxx_dtc_stt_xxx ECU_ADDRESS 0xd00054f7 /end MEASUREMENT
/begin MEASUREMENT Vxx_dfctr_crk_cmp "" UWORD _CNV_A_R_A_105_CM 1 0. 0. 65535. DISPLAY_IDENTIFIER fm_sta_crk_cmp.Vxx_dfctr_xxx ECU_ADDRESS 0xd000556a /end MEASUREMENT
/begin MEASUREMENT Vxx_rdn_crk_cmp "" UWORD _CNV_A_R_A_105_CM 1 0. 0. 65535. DISPLAY_IDENTIFIER fm_sta_crk_cmp.Vxx_rdn_xxx ECU_ADDRESS 0xd000556c /end MEASUREMENT
/begin MEASUREMENT Vbx_cf_crk_cmp "" UBYTE _CNV_A_R_A_105_CM 1 0. 0. 255. DISPLAY_IDENTIFIER fm_sta_crk_cmp.fm_static_bitfield.Vbx_cf_xxx ECU_ADDRESS 0xd000556e BIT_MASK 0x1 /end MEASUREMENT
/begin MEASUREMENT Vbx_clf_crk_cmp "" UBYTE _CNV_A_R_A_105_CM 1 0. 0. 255. DISPLAY_IDENTIFIER fm_sta_crk_cmp.fm_static_bitfield.Vbx_clf_xxx ECU_ADDRESS 0xd000556e BIT_MASK 0x2 /end MEASUREMENT
/begin MEASUREMENT Vbx_df_old_crk_cmp "" UBYTE _CNV_A_R_A_105_CM 1 0. 0. 255. DISPLAY_IDENTIFIER fm_sta_crk_cmp.fm_static_bitfield.Vbx_df_old_xxx ECU_ADDRESS 0xd000556e BIT_MASK 0x4 /end MEASUREMENT
/begin MEASUREMENT Vbx_dfctr_sat_crk_cmp "" UBYTE _CNV_A_R_A_105_CM 1 0. 0. 255. DISPLAY_IDENTIFIER fm_sta_crk_cmp.fm_static_bitfield.Vbx_dfctr_sat_xxx ECU_ADDRESS 0xd000556e BIT_MASK 0x8 /end MEASUREMENT
/begin MEASUREMENT Vbx_rdn_crk_cmp "" UBYTE _CNV_A_R_A_105_CM 1 0. 0. 255. DISPLAY_IDENTIFIER fm_sta_crk_cmp.fm_static_bitfield.Vbx_rdn_xxx ECU_ADDRESS 0xd000556e BIT_MASK 0x40 /end MEASUREMENT
/begin MEASUREMENT Vxx_dtc_stt_crk_cmp "" UBYTE _CNV_A_R_A_105_CM 1 0. 0. 255. DISPLAY_IDENTIFIER fm_sta_crk_cmp.Vxx_dtc_stt_xxx ECU_ADDRESS 0xd000556f /end MEASUREMENT
/begin MEASUREMENT Vxx_dfctr_crk_cyc "" UWORD _CNV_A_R_A_105_CM 1 0. 0. 65535. DISPLAY_IDENTIFIER fm_sta_crk_cyc.Vxx_dfctr_xxx ECU_ADDRESS 0xd00054f8 /end MEASUREMENT
/begin MEASUREMENT Vxx_rdn_crk_cyc "" UWORD _CNV_A_R_A_105_CM 1 0. 0. 65535. DISPLAY_IDENTIFIER fm_sta_crk_cyc.Vxx_rdn_xxx ECU_ADDRESS 0xd00054fa /end MEASUREMENT
/begin MEASUREMENT Vbx_cf_crk_cyc "" UBYTE _CNV_A_R_A_105_CM 1 0. 0. 255. DISPLAY_IDENTIFIER fm_sta_crk_cyc.fm_static_bitfield.Vbx_cf_xxx ECU_ADDRESS 0xd00054fc BIT_MASK 0x1 /end MEASUREMENT
/begin MEASUREMENT Vbx_clf_crk_cyc "" UBYTE _CNV_A_R_A_105_CM 1 0. 0. 255. DISPLAY_IDENTIFIER fm_sta_crk_cyc.fm_static_bitfield.Vbx_clf_xxx ECU_ADDRESS 0xd00054fc BIT_MASK 0x2 /end MEASUREMENT
/begin MEASUREMENT Vbx_df_old_crk_cyc "" UBYTE _CNV_A_R_A_105_CM 1 0. 0. 255. DISPLAY_IDENTIFIER fm_sta_crk_cyc.fm_static_bitfield.Vbx_df_old_xxx ECU_ADDRESS 0xd00054fc BIT_MASK 0x4 /end MEASUREMENT
/begin MEASUREMENT Vbx_dfctr_sat_crk_cyc "" UBYTE _CNV_A_R_A_105_CM 1 0. 0. 255. DISPLAY_IDENTIFIER fm_sta_crk_cyc.fm_static_bitfield.Vbx_dfctr_sat_xxx ECU_ADDRESS 0xd00054fc BIT_MASK 0x8 /end MEASUREMENT
/begin MEASUREMENT Vbx_rdn_crk_cyc "" UBYTE _CNV_A_R_A_105_CM 1 0. 0. 255. DISPLAY_IDENTIFIER fm_sta_crk_cyc.fm_static_bitfield.Vbx_rdn_xxx ECU_ADDRESS 0xd00054fc BIT_MASK 0x40 /end MEASUREMENT
/begin MEASUREMENT Vxx_dtc_stt_crk_cyc "" UBYTE _CNV_A_R_A_105_CM 1 0. 0. 255. DISPLAY_IDENTIFIER fm_sta_crk_cyc.Vxx_dtc_stt_xxx ECU_ADDRESS 0xd00054fd /end MEASUREMENT
/begin MEASUREMENT Vxx_dfctr_crk_no_sig "" UWORD _CNV_A_R_A_105_CM 1 0. 0. 65535. DISPLAY_IDENTIFIER fm_sta_crk_no_sig.Vxx_dfctr_xxx ECU_ADDRESS 0xd000552e /end MEASUREMENT
/begin MEASUREMENT Vxx_rdn_crk_no_sig "" UWORD _CNV_A_R_A_105_CM 1 0. 0. 65535. DISPLAY_IDENTIFIER fm_sta_crk_no_sig.Vxx_rdn_xxx ECU_ADDRESS 0xd0005530 /end MEASUREMENT
/begin MEASUREMENT Vbx_cf_crk_no_sig "" UBYTE _CNV_A_R_A_105_CM 1 0. 0. 255. DISPLAY_IDENTIFIER fm_sta_crk_no_sig.fm_static_bitfield.Vbx_cf_xxx ECU_ADDRESS 0xd0005532 BIT_MASK 0x1 /end MEASUREMENT
/begin MEASUREMENT Vbx_clf_crk_no_sig "" UBYTE _CNV_A_R_A_105_CM 1 0. 0. 255. DISPLAY_IDENTIFIER fm_sta_crk_no_sig.fm_static_bitfield.Vbx_clf_xxx ECU_ADDRESS 0xd0005532 BIT_MASK 0x2 /end MEASUREMENT
/begin MEASUREMENT Vbx_df_old_crk_no_sig "" UBYTE _CNV_A_R_A_105_CM 1 0. 0. 255. DISPLAY_IDENTIFIER fm_sta_crk_no_sig.fm_static_bitfield.Vbx_df_old_xxx ECU_ADDRESS 0xd0005532 BIT_MASK 0x4 /end MEASUREMENT
/begin MEASUREMENT Vbx_dfctr_sat_crk_no_sig "" UBYTE _CNV_A_R_A_105_CM 1 0. 0. 255. DISPLAY_IDENTIFIER fm_sta_crk_no_sig.fm_static_bitfield.Vbx_dfctr_sat_xxx ECU_ADDRESS 0xd0005532 BIT_MASK 0x8 /end MEASUREMENT
/begin MEASUREMENT Vbx_rdn_crk_no_sig "" UBYTE _CNV_A_R_A_105_CM 1 0. 0. 255. DISPLAY_IDENTIFIER fm_sta_crk_no_sig.fm_static_bitfield.Vbx_rdn_xxx ECU_ADDRESS 0xd0005532 BIT_MASK 0x40 /end MEASUREMENT
/begin MEASUREMENT Vxx_dtc_stt_crk_no_sig "" UBYTE _CNV_A_R_A_105_CM 1 0. 0. 255. DISPLAY_IDENTIFIER fm_sta_crk_no_sig.Vxx_dtc_stt_xxx ECU_ADDRESS 0xd0005533 /end MEASUREMENT
/begin MEASUREMENT Vxx_dfctr_crk_oc "" UWORD _CNV_A_R_A_105_CM 1 0. 0. 65535. DISPLAY_IDENTIFIER fm_sta_crk_oc.Vxx_dfctr_xxx ECU_ADDRESS 0xd0005576 /end MEASUREMENT
/begin MEASUREMENT Vxx_rdn_crk_oc "" UWORD _CNV_A_R_A_105_CM 1 0. 0. 65535. DISPLAY_IDENTIFIER fm_sta_crk_oc.Vxx_rdn_xxx ECU_ADDRESS 0xd0005578 /end MEASUREMENT
/begin MEASUREMENT Vbx_cf_crk_oc "" UBYTE _CNV_A_R_A_105_CM 1 0. 0. 255. DISPLAY_IDENTIFIER fm_sta_crk_oc.fm_static_bitfield.Vbx_cf_xxx ECU_ADDRESS 0xd000557a BIT_MASK 0x1 /end MEASUREMENT
/begin MEASUREMENT Vbx_clf_crk_oc "" UBYTE _CNV_A_R_A_105_CM 1 0. 0. 255. DISPLAY_IDENTIFIER fm_sta_crk_oc.fm_static_bitfield.Vbx_clf_xxx ECU_ADDRESS 0xd000557a BIT_MASK 0x2 /end MEASUREMENT
/begin MEASUREMENT Vbx_df_old_crk_oc "" UBYTE _CNV_A_R_A_105_CM 1 0. 0. 255. DISPLAY_IDENTIFIER fm_sta_crk_oc.fm_static_bitfield.Vbx_df_old_xxx ECU_ADDRESS 0xd000557a BIT_MASK 0x4 /end MEASUREMENT
/begin MEASUREMENT Vbx_dfctr_sat_crk_oc "" UBYTE _CNV_A_R_A_105_CM 1 0. 0. 255. DISPLAY_IDENTIFIER fm_sta_crk_oc.fm_static_bitfield.Vbx_dfctr_sat_xxx ECU_ADDRESS 0xd000557a BIT_MASK 0x8 /end MEASUREMENT
/begin MEASUREMENT Vbx_rdn_crk_oc "" UBYTE _CNV_A_R_A_105_CM 1 0. 0. 255. DISPLAY_IDENTIFIER fm_sta_crk_oc.fm_static_bitfield.Vbx_rdn_xxx ECU_ADDRESS 0xd000557a BIT_MASK 0x40 /end MEASUREMENT
/begin MEASUREMENT Vxx_dtc_stt_crk_oc "" UBYTE _CNV_A_R_A_105_CM 1 0. 0. 255. DISPLAY_IDENTIFIER fm_sta_crk_oc.Vxx_dtc_stt_xxx ECU_ADDRESS 0xd000557b /end MEASUREMENT
/begin MEASUREMENT Vxx_dfctr_crk_shp "" UWORD _CNV_A_R_A_105_CM 1 0. 0. 65535. DISPLAY_IDENTIFIER fm_sta_crk_shp.Vxx_dfctr_xxx ECU_ADDRESS 0xd0005570 /end MEASUREMENT
/begin MEASUREMENT Vxx_rdn_crk_shp "" UWORD _CNV_A_R_A_105_CM 1 0. 0. 65535. DISPLAY_IDENTIFIER fm_sta_crk_shp.Vxx_rdn_xxx ECU_ADDRESS 0xd0005572 /end MEASUREMENT
/begin MEASUREMENT Vbx_cf_crk_shp "" UBYTE _CNV_A_R_A_105_CM 1 0. 0. 255. DISPLAY_IDENTIFIER fm_sta_crk_shp.fm_static_bitfield.Vbx_cf_xxx ECU_ADDRESS 0xd0005574 BIT_MASK 0x1 /end MEASUREMENT
/begin MEASUREMENT Vbx_clf_crk_shp "" UBYTE _CNV_A_R_A_105_CM 1 0. 0. 255. DISPLAY_IDENTIFIER fm_sta_crk_shp.fm_static_bitfield.Vbx_clf_xxx ECU_ADDRESS 0xd0005574 BIT_MASK 0x2 /end MEASUREMENT
/begin MEASUREMENT Vbx_df_old_crk_shp "" UBYTE _CNV_A_R_A_105_CM 1 0. 0. 255. DISPLAY_IDENTIFIER fm_sta_crk_shp.fm_static_bitfield.Vbx_df_old_xxx ECU_ADDRESS 0xd0005574 BIT_MASK 0x4 /end MEASUREMENT
/begin MEASUREMENT Vbx_dfctr_sat_crk_shp "" UBYTE _CNV_A_R_A_105_CM 1 0. 0. 255. DISPLAY_IDENTIFIER fm_sta_crk_shp.fm_static_bitfield.Vbx_dfctr_sat_xxx ECU_ADDRESS 0xd0005574 BIT_MASK 0x8 /end MEASUREMENT
/begin MEASUREMENT Vbx_rdn_crk_shp "" UBYTE _CNV_A_R_A_105_CM 1 0. 0. 255. DISPLAY_IDENTIFIER fm_sta_crk_shp.fm_static_bitfield.Vbx_rdn_xxx ECU_ADDRESS 0xd0005574 BIT_MASK 0x40 /end MEASUREMENT
/begin MEASUREMENT Vxx_dtc_stt_crk_shp "" UBYTE _CNV_A_R_A_105_CM 1 0. 0. 255. DISPLAY_IDENTIFIER fm_sta_crk_shp.Vxx_dtc_stt_xxx ECU_ADDRESS 0xd0005575 /end MEASUREMENT
/begin MEASUREMENT Vxx_dfctr_cru_cmp "" UWORD _CNV_A_R_A_105_CM 1 0. 0. 65535. DISPLAY_IDENTIFIER fm_sta_cru_cmp.Vxx_dfctr_xxx ECU_ADDRESS 0xd00053c6 /end MEASUREMENT
/begin MEASUREMENT Vxx_rdn_cru_cmp "" UWORD _CNV_A_R_A_105_CM 1 0. 0. 65535. DISPLAY_IDENTIFIER fm_sta_cru_cmp.Vxx_rdn_xxx ECU_ADDRESS 0xd00053c8 /end MEASUREMENT
/begin MEASUREMENT Vbx_cf_cru_cmp "" UBYTE _CNV_A_R_A_105_CM 1 0. 0. 255. DISPLAY_IDENTIFIER fm_sta_cru_cmp.fm_static_bitfield.Vbx_cf_xxx ECU_ADDRESS 0xd00053ca BIT_MASK 0x1 /end MEASUREMENT
/begin MEASUREMENT Vbx_clf_cru_cmp "" UBYTE _CNV_A_R_A_105_CM 1 0. 0. 255. DISPLAY_IDENTIFIER fm_sta_cru_cmp.fm_static_bitfield.Vbx_clf_xxx ECU_ADDRESS 0xd00053ca BIT_MASK 0x2 /end MEASUREMENT
/begin MEASUREMENT Vbx_df_old_cru_cmp "" UBYTE _CNV_A_R_A_105_CM 1 0. 0. 255. DISPLAY_IDENTIFIER fm_sta_cru_cmp.fm_static_bitfield.Vbx_df_old_xxx ECU_ADDRESS 0xd00053ca BIT_MASK 0x4 /end MEASUREMENT
/begin MEASUREMENT Vbx_dfctr_sat_cru_cmp "" UBYTE _CNV_A_R_A_105_CM 1 0. 0. 255. DISPLAY_IDENTIFIER fm_sta_cru_cmp.fm_static_bitfield.Vbx_dfctr_sat_xxx ECU_ADDRESS 0xd00053ca BIT_MASK 0x8 /end MEASUREMENT
/begin MEASUREMENT Vbx_rdn_cru_cmp "" UBYTE _CNV_A_R_A_105_CM 1 0. 0. 255. DISPLAY_IDENTIFIER fm_sta_cru_cmp.fm_static_bitfield.Vbx_rdn_xxx ECU_ADDRESS 0xd00053ca BIT_MASK 0x40 /end MEASUREMENT
/begin MEASUREMENT Vxx_dtc_stt_cru_cmp "" UBYTE _CNV_A_R_A_105_CM 1 0. 0. 255. DISPLAY_IDENTIFIER fm_sta_cru_cmp.Vxx_dtc_stt_xxx ECU_ADDRESS 0xd00053cb /end MEASUREMENT
/begin MEASUREMENT Vxx_dfctr_cru_sl_swi_chr "" UWORD _CNV_A_R_A_105_CM 1 0. 0. 65535. DISPLAY_IDENTIFIER fm_sta_cru_sl_swi_chr.Vxx_dfctr_xxx ECU_ADDRESS 0xd00053cc /end MEASUREMENT
/begin MEASUREMENT Vxx_rdn_cru_sl_swi_chr "" UWORD _CNV_A_R_A_105_CM 1 0. 0. 65535. DISPLAY_IDENTIFIER fm_sta_cru_sl_swi_chr.Vxx_rdn_xxx ECU_ADDRESS 0xd00053ce /end MEASUREMENT
/begin MEASUREMENT Vbx_cf_cru_sl_swi_chr "" UBYTE _CNV_A_R_A_105_CM 1 0. 0. 255. DISPLAY_IDENTIFIER fm_sta_cru_sl_swi_chr.fm_static_bitfield.Vbx_cf_xxx ECU_ADDRESS 0xd00053d0 BIT_MASK 0x1 /end MEASUREMENT
/begin MEASUREMENT Vbx_clf_cru_sl_swi_chr "" UBYTE _CNV_A_R_A_105_CM 1 0. 0. 255. DISPLAY_IDENTIFIER fm_sta_cru_sl_swi_chr.fm_static_bitfield.Vbx_clf_xxx ECU_ADDRESS 0xd00053d0 BIT_MASK 0x2 /end MEASUREMENT
/begin MEASUREMENT Vbx_df_old_cru_sl_swi_chr "" UBYTE _CNV_A_R_A_105_CM 1 0. 0. 255. DISPLAY_IDENTIFIER fm_sta_cru_sl_swi_chr.fm_static_bitfield.Vbx_df_old_xxx ECU_ADDRESS 0xd00053d0 BIT_MASK 0x4 /end MEASUREMENT
/begin MEASUREMENT Vbx_dfctr_sat_cru_sl_swi_chr "" UBYTE _CNV_A_R_A_105_CM 1 0. 0. 255. DISPLAY_IDENTIFIER fm_sta_cru_sl_swi_chr.fm_static_bitfield.Vbx_dfctr_sat_xxx ECU_ADDRESS 0xd00053d0 BIT_MASK 0x8 /end MEASUREMENT
/begin MEASUREMENT Vbx_rdn_cru_sl_swi_chr "" UBYTE _CNV_A_R_A_105_CM 1 0. 0. 255. DISPLAY_IDENTIFIER fm_sta_cru_sl_swi_chr.fm_static_bitfield.Vbx_rdn_xxx ECU_ADDRESS 0xd00053d0 BIT_MASK 0x40 /end MEASUREMENT
/begin MEASUREMENT Vxx_dtc_stt_cru_sl_swi_chr "" UBYTE _CNV_A_R_A_105_CM 1 0. 0. 255. DISPLAY_IDENTIFIER fm_sta_cru_sl_swi_chr.Vxx_dtc_stt_xxx ECU_ADDRESS 0xd00053d1 /end MEASUREMENT
/begin MEASUREMENT Vxx_dfctr_cru_sl_tot "" UWORD _CNV_A_R_A_105_CM 1 0. 0. 65535. DISPLAY_IDENTIFIER fm_sta_cru_sl_tot.Vxx_dfctr_xxx ECU_ADDRESS 0xd00053d2 /end MEASUREMENT
/begin MEASUREMENT Vxx_rdn_cru_sl_tot "" UWORD _CNV_A_R_A_105_CM 1 0. 0. 65535. DISPLAY_IDENTIFIER fm_sta_cru_sl_tot.Vxx_rdn_xxx ECU_ADDRESS 0xd00053d4 /end MEASUREMENT
/begin MEASUREMENT Vbx_cf_cru_sl_tot "" UBYTE _CNV_A_R_A_105_CM 1 0. 0. 255. DISPLAY_IDENTIFIER fm_sta_cru_sl_tot.fm_static_bitfield.Vbx_cf_xxx ECU_ADDRESS 0xd00053d6 BIT_MASK 0x1 /end MEASUREMENT
/begin MEASUREMENT Vbx_clf_cru_sl_tot "" UBYTE _CNV_A_R_A_105_CM 1 0. 0. 255. DISPLAY_IDENTIFIER fm_sta_cru_sl_tot.fm_static_bitfield.Vbx_clf_xxx ECU_ADDRESS 0xd00053d6 BIT_MASK 0x2 /end MEASUREMENT
/begin MEASUREMENT Vbx_df_old_cru_sl_tot "" UBYTE _CNV_A_R_A_105_CM 1 0. 0. 255. DISPLAY_IDENTIFIER fm_sta_cru_sl_tot.fm_static_bitfield.Vbx_df_old_xxx ECU_ADDRESS 0xd00053d6 BIT_MASK 0x4 /end MEASUREMENT
/begin MEASUREMENT Vbx_dfctr_sat_cru_sl_tot "" UBYTE _CNV_A_R_A_105_CM 1 0. 0. 255. DISPLAY_IDENTIFIER fm_sta_cru_sl_tot.fm_static_bitfield.Vbx_dfctr_sat_xxx ECU_ADDRESS 0xd00053d6 BIT_MASK 0x8 /end MEASUREMENT
/begin MEASUREMENT Vbx_rdn_cru_sl_tot "" UBYTE _CNV_A_R_A_105_CM 1 0. 0. 255. DISPLAY_IDENTIFIER fm_sta_cru_sl_tot.fm_static_bitfield.Vbx_rdn_xxx ECU_ADDRESS 0xd00053d6 BIT_MASK 0x40 /end MEASUREMENT
/begin MEASUREMENT Vxx_dtc_stt_cru_sl_tot "" UBYTE _CNV_A_R_A_105_CM 1 0. 0. 255. DISPLAY_IDENTIFIER fm_sta_cru_sl_tot.Vxx_dtc_stt_xxx ECU_ADDRESS 0xd00053d7 /end MEASUREMENT
/begin MEASUREMENT Vxx_dfctr_cru_vs_cmp "" UWORD _CNV_A_R_A_105_CM 1 0. 0. 65535. DISPLAY_IDENTIFIER fm_sta_cru_vs_cmp.Vxx_dfctr_xxx ECU_ADDRESS 0xd00053d8 /end MEASUREMENT
/begin MEASUREMENT Vxx_rdn_cru_vs_cmp "" UWORD _CNV_A_R_A_105_CM 1 0. 0. 65535. DISPLAY_IDENTIFIER fm_sta_cru_vs_cmp.Vxx_rdn_xxx ECU_ADDRESS 0xd00053da /end MEASUREMENT
/begin MEASUREMENT Vbx_cf_cru_vs_cmp "" UBYTE _CNV_A_R_A_105_CM 1 0. 0. 255. DISPLAY_IDENTIFIER fm_sta_cru_vs_cmp.fm_static_bitfield.Vbx_cf_xxx ECU_ADDRESS 0xd00053dc BIT_MASK 0x1 /end MEASUREMENT
/begin MEASUREMENT Vbx_clf_cru_vs_cmp "" UBYTE _CNV_A_R_A_105_CM 1 0. 0. 255. DISPLAY_IDENTIFIER fm_sta_cru_vs_cmp.fm_static_bitfield.Vbx_clf_xxx ECU_ADDRESS 0xd00053dc BIT_MASK 0x2 /end MEASUREMENT
/begin MEASUREMENT Vbx_df_old_cru_vs_cmp "" UBYTE _CNV_A_R_A_105_CM 1 0. 0. 255. DISPLAY_IDENTIFIER fm_sta_cru_vs_cmp.fm_static_bitfield.Vbx_df_old_xxx ECU_ADDRESS 0xd00053dc BIT_MASK 0x4 /end MEASUREMENT
/begin MEASUREMENT Vbx_dfctr_sat_cru_vs_cmp "" UBYTE _CNV_A_R_A_105_CM 1 0. 0. 255. DISPLAY_IDENTIFIER fm_sta_cru_vs_cmp.fm_static_bitfield.Vbx_dfctr_sat_xxx ECU_ADDRESS 0xd00053dc BIT_MASK 0x8 /end MEASUREMENT
/begin MEASUREMENT Vbx_rdn_cru_vs_cmp "" UBYTE _CNV_A_R_A_105_CM 1 0. 0. 255. DISPLAY_IDENTIFIER fm_sta_cru_vs_cmp.fm_static_bitfield.Vbx_rdn_xxx ECU_ADDRESS 0xd00053dc BIT_MASK 0x40 /end MEASUREMENT
/begin MEASUREMENT Vxx_dtc_stt_cru_vs_cmp "" UBYTE _CNV_A_R_A_105_CM 1 0. 0. 255. DISPLAY_IDENTIFIER fm_sta_cru_vs_cmp.Vxx_dtc_stt_xxx ECU_ADDRESS 0xd00053dd /end MEASUREMENT
/begin MEASUREMENT Vxx_dfctr_cru_whl_cmd_nok "" UWORD _CNV_A_R_A_105_CM 1 0. 0. 65535. DISPLAY_IDENTIFIER fm_sta_cru_whl_cmd_nok.Vxx_dfctr_xxx ECU_ADDRESS 0xd00053de /end MEASUREMENT
/begin MEASUREMENT Vxx_rdn_cru_whl_cmd_nok "" UWORD _CNV_A_R_A_105_CM 1 0. 0. 65535. DISPLAY_IDENTIFIER fm_sta_cru_whl_cmd_nok.Vxx_rdn_xxx ECU_ADDRESS 0xd00053e0 /end MEASUREMENT
/begin MEASUREMENT Vbx_cf_cru_whl_cmd_nok "" UBYTE _CNV_A_R_A_105_CM 1 0. 0. 255. DISPLAY_IDENTIFIER fm_sta_cru_whl_cmd_nok.fm_static_bitfield.Vbx_cf_xxx ECU_ADDRESS 0xd00053e2 BIT_MASK 0x1 /end MEASUREMENT
/begin MEASUREMENT Vbx_clf_cru_whl_cmd_nok "" UBYTE _CNV_A_R_A_105_CM 1 0. 0. 255. DISPLAY_IDENTIFIER fm_sta_cru_whl_cmd_nok.fm_static_bitfield.Vbx_clf_xxx ECU_ADDRESS 0xd00053e2 BIT_MASK 0x2 /end MEASUREMENT
/begin MEASUREMENT Vbx_df_old_cru_whl_cmd_nok "" UBYTE _CNV_A_R_A_105_CM 1 0. 0. 255. DISPLAY_IDENTIFIER fm_sta_cru_whl_cmd_nok.fm_static_bitfield.Vbx_df_old_xxx ECU_ADDRESS 0xd00053e2 BIT_MASK 0x4 /end MEASUREMENT
/begin MEASUREMENT Vbx_dfctr_sat_cru_whl_cmd_nok "" UBYTE _CNV_A_R_A_105_CM 1 0. 0. 255. DISPLAY_IDENTIFIER fm_sta_cru_whl_cmd_nok.fm_static_bitfield.Vbx_dfctr_sat_xxx ECU_ADDRESS 0xd00053e2 BIT_MASK 0x8 /end MEASUREMENT
/begin MEASUREMENT Vbx_rdn_cru_whl_cmd_nok "" UBYTE _CNV_A_R_A_105_CM 1 0. 0. 255. DISPLAY_IDENTIFIER fm_sta_cru_whl_cmd_nok.fm_static_bitfield.Vbx_rdn_xxx ECU_ADDRESS 0xd00053e2 BIT_MASK 0x40 /end MEASUREMENT
/begin MEASUREMENT Vxx_dtc_stt_cru_whl_cmd_nok "" UBYTE _CNV_A_R_A_105_CM 1 0. 0. 255. DISPLAY_IDENTIFIER fm_sta_cru_whl_cmd_nok.Vxx_dtc_stt_xxx ECU_ADDRESS 0xd00053e3 /end MEASUREMENT
/begin MEASUREMENT Vxx_dfctr_cru_whl_cmd_oc_scw "" UWORD _CNV_A_R_A_105_CM 1 0. 0. 65535. DISPLAY_IDENTIFIER fm_sta_cru_whl_cmd_oc_scw.Vxx_dfctr_xxx ECU_ADDRESS 0xd00053e4 /end MEASUREMENT
/begin MEASUREMENT Vxx_rdn_cru_whl_cmd_oc_scw "" UWORD _CNV_A_R_A_105_CM 1 0. 0. 65535. DISPLAY_IDENTIFIER fm_sta_cru_whl_cmd_oc_scw.Vxx_rdn_xxx ECU_ADDRESS 0xd00053e6 /end MEASUREMENT
/begin MEASUREMENT Vbx_cf_cru_whl_cmd_oc_scw "" UBYTE _CNV_A_R_A_105_CM 1 0. 0. 255. DISPLAY_IDENTIFIER fm_sta_cru_whl_cmd_oc_scw.fm_static_bitfield.Vbx_cf_xxx ECU_ADDRESS 0xd00053e8 BIT_MASK 0x1 /end MEASUREMENT
/begin MEASUREMENT Vbx_clf_cru_whl_cmd_oc_scw "" UBYTE _CNV_A_R_A_105_CM 1 0. 0. 255. DISPLAY_IDENTIFIER fm_sta_cru_whl_cmd_oc_scw.fm_static_bitfield.Vbx_clf_xxx ECU_ADDRESS 0xd00053e8 BIT_MASK 0x2 /end MEASUREMENT
/begin MEASUREMENT Vbx_df_old_cru_whl_cmd_oc_scw "" UBYTE _CNV_A_R_A_105_CM 1 0. 0. 255. DISPLAY_IDENTIFIER fm_sta_cru_whl_cmd_oc_scw.fm_static_bitfield.Vbx_df_old_xxx ECU_ADDRESS 0xd00053e8 BIT_MASK 0x4 /end MEASUREMENT
/begin MEASUREMENT Vbx_dfctr_sat_cru_whl_cmd_oc_scw "" UBYTE _CNV_A_R_A_105_CM 1 0. 0. 255. DISPLAY_IDENTIFIER fm_sta_cru_whl_cmd_oc_scw.fm_static_bitfield.Vbx_dfctr_sat_xxx ECU_ADDRESS 0xd00053e8 BIT_MASK 0x8 /end MEASUREMENT
/begin MEASUREMENT Vbx_rdn_cru_whl_cmd_oc_scw "" UBYTE _CNV_A_R_A_105_CM 1 0. 0. 255. DISPLAY_IDENTIFIER fm_sta_cru_whl_cmd_oc_scw.fm_static_bitfield.Vbx_rdn_xxx ECU_ADDRESS 0xd00053e8 BIT_MASK 0x40 /end MEASUREMENT
/begin MEASUREMENT Vxx_dtc_stt_cru_whl_cmd_oc_scw "" UBYTE _CNV_A_R_A_105_CM 1 0. 0. 255. DISPLAY_IDENTIFIER fm_sta_cru_whl_cmd_oc_scw.Vxx_dtc_stt_xxx ECU_ADDRESS 0xd00053e9 /end MEASUREMENT
/begin MEASUREMENT Vxx_dfctr_cru_whl_cmd_oor "" UWORD _CNV_A_R_A_105_CM 1 0. 0. 65535. DISPLAY_IDENTIFIER fm_sta_cru_whl_cmd_oor.Vxx_dfctr_xxx ECU_ADDRESS 0xd00053ea /end MEASUREMENT
/begin MEASUREMENT Vxx_rdn_cru_whl_cmd_oor "" UWORD _CNV_A_R_A_105_CM 1 0. 0. 65535. DISPLAY_IDENTIFIER fm_sta_cru_whl_cmd_oor.Vxx_rdn_xxx ECU_ADDRESS 0xd00053ec /end MEASUREMENT
/begin MEASUREMENT Vbx_cf_cru_whl_cmd_oor "" UBYTE _CNV_A_R_A_105_CM 1 0. 0. 255. DISPLAY_IDENTIFIER fm_sta_cru_whl_cmd_oor.fm_static_bitfield.Vbx_cf_xxx ECU_ADDRESS 0xd00053ee BIT_MASK 0x1 /end MEASUREMENT
/begin MEASUREMENT Vbx_clf_cru_whl_cmd_oor "" UBYTE _CNV_A_R_A_105_CM 1 0. 0. 255. DISPLAY_IDENTIFIER fm_sta_cru_whl_cmd_oor.fm_static_bitfield.Vbx_clf_xxx ECU_ADDRESS 0xd00053ee BIT_MASK 0x2 /end MEASUREMENT
/begin MEASUREMENT Vbx_df_old_cru_whl_cmd_oor "" UBYTE _CNV_A_R_A_105_CM 1 0. 0. 255. DISPLAY_IDENTIFIER fm_sta_cru_whl_cmd_oor.fm_static_bitfield.Vbx_df_old_xxx ECU_ADDRESS 0xd00053ee BIT_MASK 0x4 /end MEASUREMENT
/begin MEASUREMENT Vbx_dfctr_sat_cru_whl_cmd_oor "" UBYTE _CNV_A_R_A_105_CM 1 0. 0. 255. DISPLAY_IDENTIFIER fm_sta_cru_whl_cmd_oor.fm_static_bitfield.Vbx_dfctr_sat_xxx ECU_ADDRESS 0xd00053ee BIT_MASK 0x8 /end MEASUREMENT
/begin MEASUREMENT Vbx_rdn_cru_whl_cmd_oor "" UBYTE _CNV_A_R_A_105_CM 1 0. 0. 255. DISPLAY_IDENTIFIER fm_sta_cru_whl_cmd_oor.fm_static_bitfield.Vbx_rdn_xxx ECU_ADDRESS 0xd00053ee BIT_MASK 0x40 /end MEASUREMENT
/begin MEASUREMENT Vxx_dtc_stt_cru_whl_cmd_oor "" UBYTE _CNV_A_R_A_105_CM 1 0. 0. 255. DISPLAY_IDENTIFIER fm_sta_cru_whl_cmd_oor.Vxx_dtc_stt_xxx ECU_ADDRESS 0xd00053ef /end MEASUREMENT
/begin MEASUREMENT Vxx_dfctr_ecm_adc_tron "" UWORD _CNV_A_R_A_105_CM 1 0. 0. 65535. DISPLAY_IDENTIFIER fm_sta_ecm_adc_tron.Vxx_dfctr_xxx ECU_ADDRESS 0xd000558e /end MEASUREMENT
/begin MEASUREMENT Vxx_rdn_ecm_adc_tron "" UWORD _CNV_A_R_A_105_CM 1 0. 0. 65535. DISPLAY_IDENTIFIER fm_sta_ecm_adc_tron.Vxx_rdn_xxx ECU_ADDRESS 0xd0005590 /end MEASUREMENT
/begin MEASUREMENT Vbx_cf_ecm_adc_tron "" UBYTE _CNV_A_R_A_105_CM 1 0. 0. 255. DISPLAY_IDENTIFIER fm_sta_ecm_adc_tron.fm_static_bitfield.Vbx_cf_xxx ECU_ADDRESS 0xd0005592 BIT_MASK 0x1 /end MEASUREMENT
/begin MEASUREMENT Vbx_clf_ecm_adc_tron "" UBYTE _CNV_A_R_A_105_CM 1 0. 0. 255. DISPLAY_IDENTIFIER fm_sta_ecm_adc_tron.fm_static_bitfield.Vbx_clf_xxx ECU_ADDRESS 0xd0005592 BIT_MASK 0x2 /end MEASUREMENT
/begin MEASUREMENT Vbx_df_old_ecm_adc_tron "" UBYTE _CNV_A_R_A_105_CM 1 0. 0. 255. DISPLAY_IDENTIFIER fm_sta_ecm_adc_tron.fm_static_bitfield.Vbx_df_old_xxx ECU_ADDRESS 0xd0005592 BIT_MASK 0x4 /end MEASUREMENT
/begin MEASUREMENT Vbx_dfctr_sat_ecm_adc_tron "" UBYTE _CNV_A_R_A_105_CM 1 0. 0. 255. DISPLAY_IDENTIFIER fm_sta_ecm_adc_tron.fm_static_bitfield.Vbx_dfctr_sat_xxx ECU_ADDRESS 0xd0005592 BIT_MASK 0x8 /end MEASUREMENT
/begin MEASUREMENT Vbx_rdn_ecm_adc_tron "" UBYTE _CNV_A_R_A_105_CM 1 0. 0. 255. DISPLAY_IDENTIFIER fm_sta_ecm_adc_tron.fm_static_bitfield.Vbx_rdn_xxx ECU_ADDRESS 0xd0005592 BIT_MASK 0x40 /end MEASUREMENT
/begin MEASUREMENT Vxx_dtc_stt_ecm_adc_tron "" UBYTE _CNV_A_R_A_105_CM 1 0. 0. 255. DISPLAY_IDENTIFIER fm_sta_ecm_adc_tron.Vxx_dtc_stt_xxx ECU_ADDRESS 0xd0005593 /end MEASUREMENT
/begin MEASUREMENT Vxx_dfctr_ecm_err_itl "" UWORD _CNV_A_R_A_105_CM 1 0. 0. 65535. DISPLAY_IDENTIFIER fm_sta_ecm_err_itl.Vxx_dfctr_xxx ECU_ADDRESS 0xd0005534 /end MEASUREMENT
/begin MEASUREMENT Vxx_rdn_ecm_err_itl "" UWORD _CNV_A_R_A_105_CM 1 0. 0. 65535. DISPLAY_IDENTIFIER fm_sta_ecm_err_itl.Vxx_rdn_xxx ECU_ADDRESS 0xd0005536 /end MEASUREMENT
/begin MEASUREMENT Vbx_cf_ecm_err_itl "" UBYTE _CNV_A_R_A_105_CM 1 0. 0. 255. DISPLAY_IDENTIFIER fm_sta_ecm_err_itl.fm_static_bitfield.Vbx_cf_xxx ECU_ADDRESS 0xd0005538 BIT_MASK 0x1 /end MEASUREMENT
/begin MEASUREMENT Vbx_clf_ecm_err_itl "" UBYTE _CNV_A_R_A_105_CM 1 0. 0. 255. DISPLAY_IDENTIFIER fm_sta_ecm_err_itl.fm_static_bitfield.Vbx_clf_xxx ECU_ADDRESS 0xd0005538 BIT_MASK 0x2 /end MEASUREMENT
/begin MEASUREMENT Vbx_df_old_ecm_err_itl "" UBYTE _CNV_A_R_A_105_CM 1 0. 0. 255. DISPLAY_IDENTIFIER fm_sta_ecm_err_itl.fm_static_bitfield.Vbx_df_old_xxx ECU_ADDRESS 0xd0005538 BIT_MASK 0x4 /end MEASUREMENT
/begin MEASUREMENT Vbx_dfctr_sat_ecm_err_itl "" UBYTE _CNV_A_R_A_105_CM 1 0. 0. 255. DISPLAY_IDENTIFIER fm_sta_ecm_err_itl.fm_static_bitfield.Vbx_dfctr_sat_xxx ECU_ADDRESS 0xd0005538 BIT_MASK 0x8 /end MEASUREMENT
/begin MEASUREMENT Vbx_rdn_ecm_err_itl "" UBYTE _CNV_A_R_A_105_CM 1 0. 0. 255. DISPLAY_IDENTIFIER fm_sta_ecm_err_itl.fm_static_bitfield.Vbx_rdn_xxx ECU_ADDRESS 0xd0005538 BIT_MASK 0x40 /end MEASUREMENT
/begin MEASUREMENT Vxx_dtc_stt_ecm_err_itl "" UBYTE _CNV_A_R_A_105_CM 1 0. 0. 255. DISPLAY_IDENTIFIER fm_sta_ecm_err_itl.Vxx_dtc_stt_xxx ECU_ADDRESS 0xd0005539 /end MEASUREMENT
/begin MEASUREMENT Vxx_dfctr_ecm_mon_secu_1 "" UWORD _CNV_A_R_A_105_CM 1 0. 0. 65535. DISPLAY_IDENTIFIER fm_sta_ecm_mon_secu_1.Vxx_dfctr_xxx ECU_ADDRESS 0xd0005582 /end MEASUREMENT
/begin MEASUREMENT Vxx_rdn_ecm_mon_secu_1 "" UWORD _CNV_A_R_A_105_CM 1 0. 0. 65535. DISPLAY_IDENTIFIER fm_sta_ecm_mon_secu_1.Vxx_rdn_xxx ECU_ADDRESS 0xd0005584 /end MEASUREMENT
/begin MEASUREMENT Vbx_cf_ecm_mon_secu_1 "" UBYTE _CNV_A_R_A_105_CM 1 0. 0. 255. DISPLAY_IDENTIFIER fm_sta_ecm_mon_secu_1.fm_static_bitfield.Vbx_cf_xxx ECU_ADDRESS 0xd0005586 BIT_MASK 0x1 /end MEASUREMENT
/begin MEASUREMENT Vbx_clf_ecm_mon_secu_1 "" UBYTE _CNV_A_R_A_105_CM 1 0. 0. 255. DISPLAY_IDENTIFIER fm_sta_ecm_mon_secu_1.fm_static_bitfield.Vbx_clf_xxx ECU_ADDRESS 0xd0005586 BIT_MASK 0x2 /end MEASUREMENT
/begin MEASUREMENT Vbx_df_old_ecm_mon_secu_1 "" UBYTE _CNV_A_R_A_105_CM 1 0. 0. 255. DISPLAY_IDENTIFIER fm_sta_ecm_mon_secu_1.fm_static_bitfield.Vbx_df_old_xxx ECU_ADDRESS 0xd0005586 BIT_MASK 0x4 /end MEASUREMENT
/begin MEASUREMENT Vbx_dfctr_sat_ecm_mon_secu_1 "" UBYTE _CNV_A_R_A_105_CM 1 0. 0. 255. DISPLAY_IDENTIFIER fm_sta_ecm_mon_secu_1.fm_static_bitfield.Vbx_dfctr_sat_xxx ECU_ADDRESS 0xd0005586 BIT_MASK 0x8 /end MEASUREMENT
/begin MEASUREMENT Vbx_rdn_ecm_mon_secu_1 "" UBYTE _CNV_A_R_A_105_CM 1 0. 0. 255. DISPLAY_IDENTIFIER fm_sta_ecm_mon_secu_1.fm_static_bitfield.Vbx_rdn_xxx ECU_ADDRESS 0xd0005586 BIT_MASK 0x40 /end MEASUREMENT
/begin MEASUREMENT Vxx_dtc_stt_ecm_mon_secu_1 "" UBYTE _CNV_A_R_A_105_CM 1 0. 0. 255. DISPLAY_IDENTIFIER fm_sta_ecm_mon_secu_1.Vxx_dtc_stt_xxx ECU_ADDRESS 0xd0005587 /end MEASUREMENT
/begin MEASUREMENT Vxx_dfctr_ecm_mon_secu_2 "" UWORD _CNV_A_R_A_105_CM 1 0. 0. 65535. DISPLAY_IDENTIFIER fm_sta_ecm_mon_secu_2.Vxx_dfctr_xxx ECU_ADDRESS 0xd0005588 /end MEASUREMENT
/begin MEASUREMENT Vxx_rdn_ecm_mon_secu_2 "" UWORD _CNV_A_R_A_105_CM 1 0. 0. 65535. DISPLAY_IDENTIFIER fm_sta_ecm_mon_secu_2.Vxx_rdn_xxx ECU_ADDRESS 0xd000558a /end MEASUREMENT
/begin MEASUREMENT Vbx_cf_ecm_mon_secu_2 "" UBYTE _CNV_A_R_A_105_CM 1 0. 0. 255. DISPLAY_IDENTIFIER fm_sta_ecm_mon_secu_2.fm_static_bitfield.Vbx_cf_xxx ECU_ADDRESS 0xd000558c BIT_MASK 0x1 /end MEASUREMENT
/begin MEASUREMENT Vbx_clf_ecm_mon_secu_2 "" UBYTE _CNV_A_R_A_105_CM 1 0. 0. 255. DISPLAY_IDENTIFIER fm_sta_ecm_mon_secu_2.fm_static_bitfield.Vbx_clf_xxx ECU_ADDRESS 0xd000558c BIT_MASK 0x2 /end MEASUREMENT
/begin MEASUREMENT Vbx_df_old_ecm_mon_secu_2 "" UBYTE _CNV_A_R_A_105_CM 1 0. 0. 255. DISPLAY_IDENTIFIER fm_sta_ecm_mon_secu_2.fm_static_bitfield.Vbx_df_old_xxx ECU_ADDRESS 0xd000558c BIT_MASK 0x4 /end MEASUREMENT
/begin MEASUREMENT Vbx_dfctr_sat_ecm_mon_secu_2 "" UBYTE _CNV_A_R_A_105_CM 1 0. 0. 255. DISPLAY_IDENTIFIER fm_sta_ecm_mon_secu_2.fm_static_bitfield.Vbx_dfctr_sat_xxx ECU_ADDRESS 0xd000558c BIT_MASK 0x8 /end MEASUREMENT
/begin MEASUREMENT Vbx_rdn_ecm_mon_secu_2 "" UBYTE _CNV_A_R_A_105_CM 1 0. 0. 255. DISPLAY_IDENTIFIER fm_sta_ecm_mon_secu_2.fm_static_bitfield.Vbx_rdn_xxx ECU_ADDRESS 0xd000558c BIT_MASK 0x40 /end MEASUREMENT
/begin MEASUREMENT Vxx_dtc_stt_ecm_mon_secu_2 "" UBYTE _CNV_A_R_A_105_CM 1 0. 0. 255. DISPLAY_IDENTIFIER fm_sta_ecm_mon_secu_2.Vxx_dtc_stt_xxx ECU_ADDRESS 0xd000558d /end MEASUREMENT
/begin MEASUREMENT Vxx_dfctr_ecm_mon_tron "" UWORD _CNV_A_R_A_105_CM 1 0. 0. 65535. DISPLAY_IDENTIFIER fm_sta_ecm_mon_tron.Vxx_dfctr_xxx ECU_ADDRESS 0xd000553a /end MEASUREMENT
/begin MEASUREMENT Vxx_rdn_ecm_mon_tron "" UWORD _CNV_A_R_A_105_CM 1 0. 0. 65535. DISPLAY_IDENTIFIER fm_sta_ecm_mon_tron.Vxx_rdn_xxx ECU_ADDRESS 0xd000553c /end MEASUREMENT
/begin MEASUREMENT Vbx_cf_ecm_mon_tron "" UBYTE _CNV_A_R_A_105_CM 1 0. 0. 255. DISPLAY_IDENTIFIER fm_sta_ecm_mon_tron.fm_static_bitfield.Vbx_cf_xxx ECU_ADDRESS 0xd000553e BIT_MASK 0x1 /end MEASUREMENT
/begin MEASUREMENT Vbx_clf_ecm_mon_tron "" UBYTE _CNV_A_R_A_105_CM 1 0. 0. 255. DISPLAY_IDENTIFIER fm_sta_ecm_mon_tron.fm_static_bitfield.Vbx_clf_xxx ECU_ADDRESS 0xd000553e BIT_MASK 0x2 /end MEASUREMENT
/begin MEASUREMENT Vbx_df_old_ecm_mon_tron "" UBYTE _CNV_A_R_A_105_CM 1 0. 0. 255. DISPLAY_IDENTIFIER fm_sta_ecm_mon_tron.fm_static_bitfield.Vbx_df_old_xxx ECU_ADDRESS 0xd000553e BIT_MASK 0x4 /end MEASUREMENT
/begin MEASUREMENT Vbx_dfctr_sat_ecm_mon_tron "" UBYTE _CNV_A_R_A_105_CM 1 0. 0. 255. DISPLAY_IDENTIFIER fm_sta_ecm_mon_tron.fm_static_bitfield.Vbx_dfctr_sat_xxx ECU_ADDRESS 0xd000553e BIT_MASK 0x8 /end MEASUREMENT
/begin MEASUREMENT Vbx_rdn_ecm_mon_tron "" UBYTE _CNV_A_R_A_105_CM 1 0. 0. 255. DISPLAY_IDENTIFIER fm_sta_ecm_mon_tron.fm_static_bitfield.Vbx_rdn_xxx ECU_ADDRESS 0xd000553e BIT_MASK 0x40 /end MEASUREMENT
/begin MEASUREMENT Vxx_dtc_stt_ecm_mon_tron "" UBYTE _CNV_A_R_A_105_CM 1 0. 0. 255. DISPLAY_IDENTIFIER fm_sta_ecm_mon_tron.Vxx_dtc_stt_xxx ECU_ADDRESS 0xd000553f /end MEASUREMENT
/begin MEASUREMENT Vxx_dfctr_efi_sldv_2_oc "" UWORD _CNV_A_R_A_105_CM 1 0. 0. 65535. DISPLAY_IDENTIFIER fm_sta_efi_sldv_2_oc.Vxx_dfctr_xxx ECU_ADDRESS 0xd000566c /end MEASUREMENT
/begin MEASUREMENT Vxx_rdn_efi_sldv_2_oc "" UWORD _CNV_A_R_A_105_CM 1 0. 0. 65535. DISPLAY_IDENTIFIER fm_sta_efi_sldv_2_oc.Vxx_rdn_xxx ECU_ADDRESS 0xd000566e /end MEASUREMENT
/begin MEASUREMENT Vbx_cf_efi_sldv_2_oc "" UBYTE _CNV_A_R_A_105_CM 1 0. 0. 255. DISPLAY_IDENTIFIER fm_sta_efi_sldv_2_oc.fm_static_bitfield.Vbx_cf_xxx ECU_ADDRESS 0xd0005670 BIT_MASK 0x1 /end MEASUREMENT
/begin MEASUREMENT Vbx_clf_efi_sldv_2_oc "" UBYTE _CNV_A_R_A_105_CM 1 0. 0. 255. DISPLAY_IDENTIFIER fm_sta_efi_sldv_2_oc.fm_static_bitfield.Vbx_clf_xxx ECU_ADDRESS 0xd0005670 BIT_MASK 0x2 /end MEASUREMENT
/begin MEASUREMENT Vbx_df_old_efi_sldv_2_oc "" UBYTE _CNV_A_R_A_105_CM 1 0. 0. 255. DISPLAY_IDENTIFIER fm_sta_efi_sldv_2_oc.fm_static_bitfield.Vbx_df_old_xxx ECU_ADDRESS 0xd0005670 BIT_MASK 0x4 /end MEASUREMENT
/begin MEASUREMENT Vbx_dfctr_sat_efi_sldv_2_oc "" UBYTE _CNV_A_R_A_105_CM 1 0. 0. 255. DISPLAY_IDENTIFIER fm_sta_efi_sldv_2_oc.fm_static_bitfield.Vbx_dfctr_sat_xxx ECU_ADDRESS 0xd0005670 BIT_MASK 0x8 /end MEASUREMENT
/begin MEASUREMENT Vbx_rdn_efi_sldv_2_oc "" UBYTE _CNV_A_R_A_105_CM 1 0. 0. 255. DISPLAY_IDENTIFIER fm_sta_efi_sldv_2_oc.fm_static_bitfield.Vbx_rdn_xxx ECU_ADDRESS 0xd0005670 BIT_MASK 0x40 /end MEASUREMENT
/begin MEASUREMENT Vxx_dtc_stt_efi_sldv_2_oc "" UBYTE _CNV_A_R_A_105_CM 1 0. 0. 255. DISPLAY_IDENTIFIER fm_sta_efi_sldv_2_oc.Vxx_dtc_stt_xxx ECU_ADDRESS 0xd0005671 /end MEASUREMENT
/begin MEASUREMENT Vxx_dfctr_efi_sldv_2_scg "" UWORD _CNV_A_R_A_105_CM 1 0. 0. 65535. DISPLAY_IDENTIFIER fm_sta_efi_sldv_2_scg.Vxx_dfctr_xxx ECU_ADDRESS 0xd0005672 /end MEASUREMENT
/begin MEASUREMENT Vxx_rdn_efi_sldv_2_scg "" UWORD _CNV_A_R_A_105_CM 1 0. 0. 65535. DISPLAY_IDENTIFIER fm_sta_efi_sldv_2_scg.Vxx_rdn_xxx ECU_ADDRESS 0xd0005674 /end MEASUREMENT
/begin MEASUREMENT Vbx_cf_efi_sldv_2_scg "" UBYTE _CNV_A_R_A_105_CM 1 0. 0. 255. DISPLAY_IDENTIFIER fm_sta_efi_sldv_2_scg.fm_static_bitfield.Vbx_cf_xxx ECU_ADDRESS 0xd0005676 BIT_MASK 0x1 /end MEASUREMENT
/begin MEASUREMENT Vbx_clf_efi_sldv_2_scg "" UBYTE _CNV_A_R_A_105_CM 1 0. 0. 255. DISPLAY_IDENTIFIER fm_sta_efi_sldv_2_scg.fm_static_bitfield.Vbx_clf_xxx ECU_ADDRESS 0xd0005676 BIT_MASK 0x2 /end MEASUREMENT
/begin MEASUREMENT Vbx_df_old_efi_sldv_2_scg "" UBYTE _CNV_A_R_A_105_CM 1 0. 0. 255. DISPLAY_IDENTIFIER fm_sta_efi_sldv_2_scg.fm_static_bitfield.Vbx_df_old_xxx ECU_ADDRESS 0xd0005676 BIT_MASK 0x4 /end MEASUREMENT
/begin MEASUREMENT Vbx_dfctr_sat_efi_sldv_2_scg "" UBYTE _CNV_A_R_A_105_CM 1 0. 0. 255. DISPLAY_IDENTIFIER fm_sta_efi_sldv_2_scg.fm_static_bitfield.Vbx_dfctr_sat_xxx ECU_ADDRESS 0xd0005676 BIT_MASK 0x8 /end MEASUREMENT
/begin MEASUREMENT Vbx_rdn_efi_sldv_2_scg "" UBYTE _CNV_A_R_A_105_CM 1 0. 0. 255. DISPLAY_IDENTIFIER fm_sta_efi_sldv_2_scg.fm_static_bitfield.Vbx_rdn_xxx ECU_ADDRESS 0xd0005676 BIT_MASK 0x40 /end MEASUREMENT
/begin MEASUREMENT Vxx_dtc_stt_efi_sldv_2_scg "" UBYTE _CNV_A_R_A_105_CM 1 0. 0. 255. DISPLAY_IDENTIFIER fm_sta_efi_sldv_2_scg.Vxx_dtc_stt_xxx ECU_ADDRESS 0xd0005677 /end MEASUREMENT
/begin MEASUREMENT Vxx_dfctr_efi_sldv_2_scw "" UWORD _CNV_A_R_A_105_CM 1 0. 0. 65535. DISPLAY_IDENTIFIER fm_sta_efi_sldv_2_scw.Vxx_dfctr_xxx ECU_ADDRESS 0xd0005678 /end MEASUREMENT
/begin MEASUREMENT Vxx_rdn_efi_sldv_2_scw "" UWORD _CNV_A_R_A_105_CM 1 0. 0. 65535. DISPLAY_IDENTIFIER fm_sta_efi_sldv_2_scw.Vxx_rdn_xxx ECU_ADDRESS 0xd000567a /end MEASUREMENT
/begin MEASUREMENT Vbx_cf_efi_sldv_2_scw "" UBYTE _CNV_A_R_A_105_CM 1 0. 0. 255. DISPLAY_IDENTIFIER fm_sta_efi_sldv_2_scw.fm_static_bitfield.Vbx_cf_xxx ECU_ADDRESS 0xd000567c BIT_MASK 0x1 /end MEASUREMENT
/begin MEASUREMENT Vbx_clf_efi_sldv_2_scw "" UBYTE _CNV_A_R_A_105_CM 1 0. 0. 255. DISPLAY_IDENTIFIER fm_sta_efi_sldv_2_scw.fm_static_bitfield.Vbx_clf_xxx ECU_ADDRESS 0xd000567c BIT_MASK 0x2 /end MEASUREMENT
/begin MEASUREMENT Vbx_df_old_efi_sldv_2_scw "" UBYTE _CNV_A_R_A_105_CM 1 0. 0. 255. DISPLAY_IDENTIFIER fm_sta_efi_sldv_2_scw.fm_static_bitfield.Vbx_df_old_xxx ECU_ADDRESS 0xd000567c BIT_MASK 0x4 /end MEASUREMENT
/begin MEASUREMENT Vbx_dfctr_sat_efi_sldv_2_scw "" UBYTE _CNV_A_R_A_105_CM 1 0. 0. 255. DISPLAY_IDENTIFIER fm_sta_efi_sldv_2_scw.fm_static_bitfield.Vbx_dfctr_sat_xxx ECU_ADDRESS 0xd000567c BIT_MASK 0x8 /end MEASUREMENT
/begin MEASUREMENT Vbx_rdn_efi_sldv_2_scw "" UBYTE _CNV_A_R_A_105_CM 1 0. 0. 255. DISPLAY_IDENTIFIER fm_sta_efi_sldv_2_scw.fm_static_bitfield.Vbx_rdn_xxx ECU_ADDRESS 0xd000567c BIT_MASK 0x40 /end MEASUREMENT
/begin MEASUREMENT Vxx_dtc_stt_efi_sldv_2_scw "" UBYTE _CNV_A_R_A_105_CM 1 0. 0. 255. DISPLAY_IDENTIFIER fm_sta_efi_sldv_2_scw.Vxx_dtc_stt_xxx ECU_ADDRESS 0xd000567d /end MEASUREMENT
/begin MEASUREMENT Sbx_dyn_ac_prs_h "" UBYTE _CNV_A_R_A_105_CM 1 0. 0. 255. DISPLAY_IDENTIFIER fm_sta_eprm_ac_prs_h.fm_static_eprm_bitfield.Sbx_dyn_xxx ECU_ADDRESS 0xd000569c BIT_MASK 0x8 /end MEASUREMENT
/begin MEASUREMENT Sbx_rdn_ac_prs_h "" UBYTE _CNV_A_R_A_105_CM 1 0. 0. 255. DISPLAY_IDENTIFIER fm_sta_eprm_ac_prs_h.fm_static_eprm_bitfield.Sbx_rdn_xxx ECU_ADDRESS 0xd000569c BIT_MASK 0x10 /end MEASUREMENT
/begin MEASUREMENT Sbx_mf_ac_prs_h "" UBYTE _CNV_A_R_A_105_CM 1 0. 0. 255. DISPLAY_IDENTIFIER fm_sta_eprm_ac_prs_h.fm_static_eprm_bitfield.Sbx_mf_xxx ECU_ADDRESS 0xd000569c BIT_MASK 0x20 /end MEASUREMENT
/begin MEASUREMENT Sbx_cf_ac_prs_h "" UBYTE _CNV_A_R_A_105_CM 1 0. 0. 255. DISPLAY_IDENTIFIER fm_sta_eprm_ac_prs_h.fm_static_eprm_bitfield.Sbx_cf_xxx ECU_ADDRESS 0xd000569c BIT_MASK 0x80 /end MEASUREMENT
/begin MEASUREMENT Sbx_dyn_ac_prs_l "" UBYTE _CNV_A_R_A_105_CM 1 0. 0. 255. DISPLAY_IDENTIFIER fm_sta_eprm_ac_prs_l.fm_static_eprm_bitfield.Sbx_dyn_xxx ECU_ADDRESS 0xd000569e BIT_MASK 0x8 /end MEASUREMENT
/begin MEASUREMENT Sbx_rdn_ac_prs_l "" UBYTE _CNV_A_R_A_105_CM 1 0. 0. 255. DISPLAY_IDENTIFIER fm_sta_eprm_ac_prs_l.fm_static_eprm_bitfield.Sbx_rdn_xxx ECU_ADDRESS 0xd000569e BIT_MASK 0x10 /end MEASUREMENT
/begin MEASUREMENT Sbx_mf_ac_prs_l "" UBYTE _CNV_A_R_A_105_CM 1 0. 0. 255. DISPLAY_IDENTIFIER fm_sta_eprm_ac_prs_l.fm_static_eprm_bitfield.Sbx_mf_xxx ECU_ADDRESS 0xd000569e BIT_MASK 0x20 /end MEASUREMENT
/begin MEASUREMENT Sbx_cf_ac_prs_l "" UBYTE _CNV_A_R_A_105_CM 1 0. 0. 255. DISPLAY_IDENTIFIER fm_sta_eprm_ac_prs_l.fm_static_eprm_bitfield.Sbx_cf_xxx ECU_ADDRESS 0xd000569e BIT_MASK 0x80 /end MEASUREMENT
/begin MEASUREMENT Sbx_dyn_acel_pdl_chr "" UBYTE _CNV_A_R_A_105_CM 1 0. 0. 255. DISPLAY_IDENTIFIER fm_sta_eprm_acel_pdl_chr.fm_static_eprm_bitfield.Sbx_dyn_xxx ECU_ADDRESS 0xd00056a0 BIT_MASK 0x8 /end MEASUREMENT
/begin MEASUREMENT Sbx_rdn_acel_pdl_chr "" UBYTE _CNV_A_R_A_105_CM 1 0. 0. 255. DISPLAY_IDENTIFIER fm_sta_eprm_acel_pdl_chr.fm_static_eprm_bitfield.Sbx_rdn_xxx ECU_ADDRESS 0xd00056a0 BIT_MASK 0x10 /end MEASUREMENT
/begin MEASUREMENT Sbx_mf_acel_pdl_chr "" UBYTE _CNV_A_R_A_105_CM 1 0. 0. 255. DISPLAY_IDENTIFIER fm_sta_eprm_acel_pdl_chr.fm_static_eprm_bitfield.Sbx_mf_xxx ECU_ADDRESS 0xd00056a0 BIT_MASK 0x20 /end MEASUREMENT
/begin MEASUREMENT Sbx_cf_acel_pdl_chr "" UBYTE _CNV_A_R_A_105_CM 1 0. 0. 255. DISPLAY_IDENTIFIER fm_sta_eprm_acel_pdl_chr.fm_static_eprm_bitfield.Sbx_cf_xxx ECU_ADDRESS 0xd00056a0 BIT_MASK 0x80 /end MEASUREMENT
/begin MEASUREMENT Sbx_dyn_acel_pdl_secu_1 "" UBYTE _CNV_A_R_A_105_CM 1 0. 0. 255. DISPLAY_IDENTIFIER fm_sta_eprm_acel_pdl_secu_1.fm_static_eprm_bitfield.Sbx_dyn_xxx ECU_ADDRESS 0xd00056a2 BIT_MASK 0x8 /end MEASUREMENT
/begin MEASUREMENT Sbx_rdn_acel_pdl_secu_1 "" UBYTE _CNV_A_R_A_105_CM 1 0. 0. 255. DISPLAY_IDENTIFIER fm_sta_eprm_acel_pdl_secu_1.fm_static_eprm_bitfield.Sbx_rdn_xxx ECU_ADDRESS 0xd00056a2 BIT_MASK 0x10 /end MEASUREMENT
/begin MEASUREMENT Sbx_mf_acel_pdl_secu_1 "" UBYTE _CNV_A_R_A_105_CM 1 0. 0. 255. DISPLAY_IDENTIFIER fm_sta_eprm_acel_pdl_secu_1.fm_static_eprm_bitfield.Sbx_mf_xxx ECU_ADDRESS 0xd00056a2 BIT_MASK 0x20 /end MEASUREMENT
/begin MEASUREMENT Sbx_cf_acel_pdl_secu_1 "" UBYTE _CNV_A_R_A_105_CM 1 0. 0. 255. DISPLAY_IDENTIFIER fm_sta_eprm_acel_pdl_secu_1.fm_static_eprm_bitfield.Sbx_cf_xxx ECU_ADDRESS 0xd00056a2 BIT_MASK 0x80 /end MEASUREMENT
/begin MEASUREMENT Sbx_dyn_acel_pdl_secu_2 "" UBYTE _CNV_A_R_A_105_CM 1 0. 0. 255. DISPLAY_IDENTIFIER fm_sta_eprm_acel_pdl_secu_2.fm_static_eprm_bitfield.Sbx_dyn_xxx ECU_ADDRESS 0xd00056a4 BIT_MASK 0x8 /end MEASUREMENT
/begin MEASUREMENT Sbx_rdn_acel_pdl_secu_2 "" UBYTE _CNV_A_R_A_105_CM 1 0. 0. 255. DISPLAY_IDENTIFIER fm_sta_eprm_acel_pdl_secu_2.fm_static_eprm_bitfield.Sbx_rdn_xxx ECU_ADDRESS 0xd00056a4 BIT_MASK 0x10 /end MEASUREMENT
/begin MEASUREMENT Sbx_mf_acel_pdl_secu_2 "" UBYTE _CNV_A_R_A_105_CM 1 0. 0. 255. DISPLAY_IDENTIFIER fm_sta_eprm_acel_pdl_secu_2.fm_static_eprm_bitfield.Sbx_mf_xxx ECU_ADDRESS 0xd00056a4 BIT_MASK 0x20 /end MEASUREMENT
/begin MEASUREMENT Sbx_cf_acel_pdl_secu_2 "" UBYTE _CNV_A_R_A_105_CM 1 0. 0. 255. DISPLAY_IDENTIFIER fm_sta_eprm_acel_pdl_secu_2.fm_static_eprm_bitfield.Sbx_cf_xxx ECU_ADDRESS 0xd00056a4 BIT_MASK 0x80 /end MEASUREMENT
/begin MEASUREMENT Sbx_dyn_acel_pdl_tot "" UBYTE _CNV_A_R_A_105_CM 1 0. 0. 255. DISPLAY_IDENTIFIER fm_sta_eprm_acel_pdl_tot.fm_static_eprm_bitfield.Sbx_dyn_xxx ECU_ADDRESS 0xd00056a6 BIT_MASK 0x8 /end MEASUREMENT
/begin MEASUREMENT Sbx_rdn_acel_pdl_tot "" UBYTE _CNV_A_R_A_105_CM 1 0. 0. 255. DISPLAY_IDENTIFIER fm_sta_eprm_acel_pdl_tot.fm_static_eprm_bitfield.Sbx_rdn_xxx ECU_ADDRESS 0xd00056a6 BIT_MASK 0x10 /end MEASUREMENT
/begin MEASUREMENT Sbx_mf_acel_pdl_tot "" UBYTE _CNV_A_R_A_105_CM 1 0. 0. 255. DISPLAY_IDENTIFIER fm_sta_eprm_acel_pdl_tot.fm_static_eprm_bitfield.Sbx_mf_xxx ECU_ADDRESS 0xd00056a6 BIT_MASK 0x20 /end MEASUREMENT
/begin MEASUREMENT Sbx_cf_acel_pdl_tot "" UBYTE _CNV_A_R_A_105_CM 1 0. 0. 255. DISPLAY_IDENTIFIER fm_sta_eprm_acel_pdl_tot.fm_static_eprm_bitfield.Sbx_cf_xxx ECU_ADDRESS 0xd00056a6 BIT_MASK 0x80 /end MEASUREMENT
/begin MEASUREMENT Sbx_dyn_acel_pdl_v1_h "" UBYTE _CNV_A_R_A_105_CM 1 0. 0. 255. DISPLAY_IDENTIFIER fm_sta_eprm_acel_pdl_v1_h.fm_static_eprm_bitfield.Sbx_dyn_xxx ECU_ADDRESS 0xd00056a8 BIT_MASK 0x8 /end MEASUREMENT
/begin MEASUREMENT Sbx_rdn_acel_pdl_v1_h "" UBYTE _CNV_A_R_A_105_CM 1 0. 0. 255. DISPLAY_IDENTIFIER fm_sta_eprm_acel_pdl_v1_h.fm_static_eprm_bitfield.Sbx_rdn_xxx ECU_ADDRESS 0xd00056a8 BIT_MASK 0x10 /end MEASUREMENT
/begin MEASUREMENT Sbx_mf_acel_pdl_v1_h "" UBYTE _CNV_A_R_A_105_CM 1 0. 0. 255. DISPLAY_IDENTIFIER fm_sta_eprm_acel_pdl_v1_h.fm_static_eprm_bitfield.Sbx_mf_xxx ECU_ADDRESS 0xd00056a8 BIT_MASK 0x20 /end MEASUREMENT
/begin MEASUREMENT Sbx_cf_acel_pdl_v1_h "" UBYTE _CNV_A_R_A_105_CM 1 0. 0. 255. DISPLAY_IDENTIFIER fm_sta_eprm_acel_pdl_v1_h.fm_static_eprm_bitfield.Sbx_cf_xxx ECU_ADDRESS 0xd00056a8 BIT_MASK 0x80 /end MEASUREMENT
/begin MEASUREMENT Sbx_dyn_acel_pdl_v1_l "" UBYTE _CNV_A_R_A_105_CM 1 0. 0. 255. DISPLAY_IDENTIFIER fm_sta_eprm_acel_pdl_v1_l.fm_static_eprm_bitfield.Sbx_dyn_xxx ECU_ADDRESS 0xd00056aa BIT_MASK 0x8 /end MEASUREMENT
/begin MEASUREMENT Sbx_rdn_acel_pdl_v1_l "" UBYTE _CNV_A_R_A_105_CM 1 0. 0. 255. DISPLAY_IDENTIFIER fm_sta_eprm_acel_pdl_v1_l.fm_static_eprm_bitfield.Sbx_rdn_xxx ECU_ADDRESS 0xd00056aa BIT_MASK 0x10 /end MEASUREMENT
/begin MEASUREMENT Sbx_mf_acel_pdl_v1_l "" UBYTE _CNV_A_R_A_105_CM 1 0. 0. 255. DISPLAY_IDENTIFIER fm_sta_eprm_acel_pdl_v1_l.fm_static_eprm_bitfield.Sbx_mf_xxx ECU_ADDRESS 0xd00056aa BIT_MASK 0x20 /end MEASUREMENT
/begin MEASUREMENT Sbx_cf_acel_pdl_v1_l "" UBYTE _CNV_A_R_A_105_CM 1 0. 0. 255. DISPLAY_IDENTIFIER fm_sta_eprm_acel_pdl_v1_l.fm_static_eprm_bitfield.Sbx_cf_xxx ECU_ADDRESS 0xd00056aa BIT_MASK 0x80 /end MEASUREMENT
/begin MEASUREMENT Sbx_dyn_acel_pdl_v2_h "" UBYTE _CNV_A_R_A_105_CM 1 0. 0. 255. DISPLAY_IDENTIFIER fm_sta_eprm_acel_pdl_v2_h.fm_static_eprm_bitfield.Sbx_dyn_xxx ECU_ADDRESS 0xd00056ac BIT_MASK 0x8 /end MEASUREMENT
/begin MEASUREMENT Sbx_rdn_acel_pdl_v2_h "" UBYTE _CNV_A_R_A_105_CM 1 0. 0. 255. DISPLAY_IDENTIFIER fm_sta_eprm_acel_pdl_v2_h.fm_static_eprm_bitfield.Sbx_rdn_xxx ECU_ADDRESS 0xd00056ac BIT_MASK 0x10 /end MEASUREMENT
/begin MEASUREMENT Sbx_mf_acel_pdl_v2_h "" UBYTE _CNV_A_R_A_105_CM 1 0. 0. 255. DISPLAY_IDENTIFIER fm_sta_eprm_acel_pdl_v2_h.fm_static_eprm_bitfield.Sbx_mf_xxx ECU_ADDRESS 0xd00056ac BIT_MASK 0x20 /end MEASUREMENT
/begin MEASUREMENT Sbx_cf_acel_pdl_v2_h "" UBYTE _CNV_A_R_A_105_CM 1 0. 0. 255. DISPLAY_IDENTIFIER fm_sta_eprm_acel_pdl_v2_h.fm_static_eprm_bitfield.Sbx_cf_xxx ECU_ADDRESS 0xd00056ac BIT_MASK 0x80 /end MEASUREMENT
/begin MEASUREMENT Sbx_dyn_acel_pdl_v2_l "" UBYTE _CNV_A_R_A_105_CM 1 0. 0. 255. DISPLAY_IDENTIFIER fm_sta_eprm_acel_pdl_v2_l.fm_static_eprm_bitfield.Sbx_dyn_xxx ECU_ADDRESS 0xd00056ae BIT_MASK 0x8 /end MEASUREMENT
/begin MEASUREMENT Sbx_rdn_acel_pdl_v2_l "" UBYTE _CNV_A_R_A_105_CM 1 0. 0. 255. DISPLAY_IDENTIFIER fm_sta_eprm_acel_pdl_v2_l.fm_static_eprm_bitfield.Sbx_rdn_xxx ECU_ADDRESS 0xd00056ae BIT_MASK 0x10 /end MEASUREMENT
/begin MEASUREMENT Sbx_mf_acel_pdl_v2_l "" UBYTE _CNV_A_R_A_105_CM 1 0. 0. 255. DISPLAY_IDENTIFIER fm_sta_eprm_acel_pdl_v2_l.fm_static_eprm_bitfield.Sbx_mf_xxx ECU_ADDRESS 0xd00056ae BIT_MASK 0x20 /end MEASUREMENT
/begin MEASUREMENT Sbx_cf_acel_pdl_v2_l "" UBYTE _CNV_A_R_A_105_CM 1 0. 0. 255. DISPLAY_IDENTIFIER fm_sta_eprm_acel_pdl_v2_l.fm_static_eprm_bitfield.Sbx_cf_xxx ECU_ADDRESS 0xd00056ae BIT_MASK 0x80 /end MEASUREMENT
/begin MEASUREMENT Sbx_dyn_actr_rly_oc "" UBYTE _CNV_A_R_A_105_CM 1 0. 0. 255. DISPLAY_IDENTIFIER fm_sta_eprm_actr_rly_oc.fm_static_eprm_bitfield.Sbx_dyn_xxx ECU_ADDRESS 0xd00056b0 BIT_MASK 0x8 /end MEASUREMENT
/begin MEASUREMENT Sbx_rdn_actr_rly_oc "" UBYTE _CNV_A_R_A_105_CM 1 0. 0. 255. DISPLAY_IDENTIFIER fm_sta_eprm_actr_rly_oc.fm_static_eprm_bitfield.Sbx_rdn_xxx ECU_ADDRESS 0xd00056b0 BIT_MASK 0x10 /end MEASUREMENT
/begin MEASUREMENT Sbx_mf_actr_rly_oc "" UBYTE _CNV_A_R_A_105_CM 1 0. 0. 255. DISPLAY_IDENTIFIER fm_sta_eprm_actr_rly_oc.fm_static_eprm_bitfield.Sbx_mf_xxx ECU_ADDRESS 0xd00056b0 BIT_MASK 0x20 /end MEASUREMENT
/begin MEASUREMENT Sbx_cf_actr_rly_oc "" UBYTE _CNV_A_R_A_105_CM 1 0. 0. 255. DISPLAY_IDENTIFIER fm_sta_eprm_actr_rly_oc.fm_static_eprm_bitfield.Sbx_cf_xxx ECU_ADDRESS 0xd00056b0 BIT_MASK 0x80 /end MEASUREMENT
/begin MEASUREMENT Sbx_dyn_actr_rly_scg "" UBYTE _CNV_A_R_A_105_CM 1 0. 0. 255. DISPLAY_IDENTIFIER fm_sta_eprm_actr_rly_scg.fm_static_eprm_bitfield.Sbx_dyn_xxx ECU_ADDRESS 0xd00056b2 BIT_MASK 0x8 /end MEASUREMENT
/begin MEASUREMENT Sbx_rdn_actr_rly_scg "" UBYTE _CNV_A_R_A_105_CM 1 0. 0. 255. DISPLAY_IDENTIFIER fm_sta_eprm_actr_rly_scg.fm_static_eprm_bitfield.Sbx_rdn_xxx ECU_ADDRESS 0xd00056b2 BIT_MASK 0x10 /end MEASUREMENT
/begin MEASUREMENT Sbx_mf_actr_rly_scg "" UBYTE _CNV_A_R_A_105_CM 1 0. 0. 255. DISPLAY_IDENTIFIER fm_sta_eprm_actr_rly_scg.fm_static_eprm_bitfield.Sbx_mf_xxx ECU_ADDRESS 0xd00056b2 BIT_MASK 0x20 /end MEASUREMENT
/begin MEASUREMENT Sbx_cf_actr_rly_scg "" UBYTE _CNV_A_R_A_105_CM 1 0. 0. 255. DISPLAY_IDENTIFIER fm_sta_eprm_actr_rly_scg.fm_static_eprm_bitfield.Sbx_cf_xxx ECU_ADDRESS 0xd00056b2 BIT_MASK 0x80 /end MEASUREMENT
/begin MEASUREMENT Sbx_dyn_actr_rly_scw "" UBYTE _CNV_A_R_A_105_CM 1 0. 0. 255. DISPLAY_IDENTIFIER fm_sta_eprm_actr_rly_scw.fm_static_eprm_bitfield.Sbx_dyn_xxx ECU_ADDRESS 0xd00056b4 BIT_MASK 0x8 /end MEASUREMENT
/begin MEASUREMENT Sbx_rdn_actr_rly_scw "" UBYTE _CNV_A_R_A_105_CM 1 0. 0. 255. DISPLAY_IDENTIFIER fm_sta_eprm_actr_rly_scw.fm_static_eprm_bitfield.Sbx_rdn_xxx ECU_ADDRESS 0xd00056b4 BIT_MASK 0x10 /end MEASUREMENT
/begin MEASUREMENT Sbx_mf_actr_rly_scw "" UBYTE _CNV_A_R_A_105_CM 1 0. 0. 255. DISPLAY_IDENTIFIER fm_sta_eprm_actr_rly_scw.fm_static_eprm_bitfield.Sbx_mf_xxx ECU_ADDRESS 0xd00056b4 BIT_MASK 0x20 /end MEASUREMENT
/begin MEASUREMENT Sbx_cf_actr_rly_scw "" UBYTE _CNV_A_R_A_105_CM 1 0. 0. 255. DISPLAY_IDENTIFIER fm_sta_eprm_actr_rly_scw.fm_static_eprm_bitfield.Sbx_cf_xxx ECU_ADDRESS 0xd00056b4 BIT_MASK 0x80 /end MEASUREMENT
/begin MEASUREMENT Sbx_dyn_agb_data_chr "" UBYTE _CNV_A_R_A_105_CM 1 0. 0. 255. DISPLAY_IDENTIFIER fm_sta_eprm_agb_data_chr.fm_static_eprm_bitfield.Sbx_dyn_xxx ECU_ADDRESS 0xd00056b6 BIT_MASK 0x8 /end MEASUREMENT
/begin MEASUREMENT Sbx_rdn_agb_data_chr "" UBYTE _CNV_A_R_A_105_CM 1 0. 0. 255. DISPLAY_IDENTIFIER fm_sta_eprm_agb_data_chr.fm_static_eprm_bitfield.Sbx_rdn_xxx ECU_ADDRESS 0xd00056b6 BIT_MASK 0x10 /end MEASUREMENT
/begin MEASUREMENT Sbx_mf_agb_data_chr "" UBYTE _CNV_A_R_A_105_CM 1 0. 0. 255. DISPLAY_IDENTIFIER fm_sta_eprm_agb_data_chr.fm_static_eprm_bitfield.Sbx_mf_xxx ECU_ADDRESS 0xd00056b6 BIT_MASK 0x20 /end MEASUREMENT
/begin MEASUREMENT Sbx_cf_agb_data_chr "" UBYTE _CNV_A_R_A_105_CM 1 0. 0. 255. DISPLAY_IDENTIFIER fm_sta_eprm_agb_data_chr.fm_static_eprm_bitfield.Sbx_cf_xxx ECU_ADDRESS 0xd00056b6 BIT_MASK 0x80 /end MEASUREMENT
/begin MEASUREMENT Sbx_dyn_agb_data_seq_ctr "" UBYTE _CNV_A_R_A_105_CM 1 0. 0. 255. DISPLAY_IDENTIFIER fm_sta_eprm_agb_data_seq_ctr.fm_static_eprm_bitfield.Sbx_dyn_xxx ECU_ADDRESS 0xd00056b8 BIT_MASK 0x8 /end MEASUREMENT
/begin MEASUREMENT Sbx_rdn_agb_data_seq_ctr "" UBYTE _CNV_A_R_A_105_CM 1 0. 0. 255. DISPLAY_IDENTIFIER fm_sta_eprm_agb_data_seq_ctr.fm_static_eprm_bitfield.Sbx_rdn_xxx ECU_ADDRESS 0xd00056b8 BIT_MASK 0x10 /end MEASUREMENT
/begin MEASUREMENT Sbx_mf_agb_data_seq_ctr "" UBYTE _CNV_A_R_A_105_CM 1 0. 0. 255. DISPLAY_IDENTIFIER fm_sta_eprm_agb_data_seq_ctr.fm_static_eprm_bitfield.Sbx_mf_xxx ECU_ADDRESS 0xd00056b8 BIT_MASK 0x20 /end MEASUREMENT
/begin MEASUREMENT Sbx_cf_agb_data_seq_ctr "" UBYTE _CNV_A_R_A_105_CM 1 0. 0. 255. DISPLAY_IDENTIFIER fm_sta_eprm_agb_data_seq_ctr.fm_static_eprm_bitfield.Sbx_cf_xxx ECU_ADDRESS 0xd00056b8 BIT_MASK 0x80 /end MEASUREMENT
/begin MEASUREMENT Sbx_dyn_agb_data_tout "" UBYTE _CNV_A_R_A_105_CM 1 0. 0. 255. DISPLAY_IDENTIFIER fm_sta_eprm_agb_data_tout.fm_static_eprm_bitfield.Sbx_dyn_xxx ECU_ADDRESS 0xd00056ba BIT_MASK 0x8 /end MEASUREMENT
/begin MEASUREMENT Sbx_rdn_agb_data_tout "" UBYTE _CNV_A_R_A_105_CM 1 0. 0. 255. DISPLAY_IDENTIFIER fm_sta_eprm_agb_data_tout.fm_static_eprm_bitfield.Sbx_rdn_xxx ECU_ADDRESS 0xd00056ba BIT_MASK 0x10 /end MEASUREMENT
/begin MEASUREMENT Sbx_mf_agb_data_tout "" UBYTE _CNV_A_R_A_105_CM 1 0. 0. 255. DISPLAY_IDENTIFIER fm_sta_eprm_agb_data_tout.fm_static_eprm_bitfield.Sbx_mf_xxx ECU_ADDRESS 0xd00056ba BIT_MASK 0x20 /end MEASUREMENT
/begin MEASUREMENT Sbx_cf_agb_data_tout "" UBYTE _CNV_A_R_A_105_CM 1 0. 0. 255. DISPLAY_IDENTIFIER fm_sta_eprm_agb_data_tout.fm_static_eprm_bitfield.Sbx_cf_xxx ECU_ADDRESS 0xd00056ba BIT_MASK 0x80 /end MEASUREMENT
/begin MEASUREMENT Sbx_dyn_agb_no_frm "" UBYTE _CNV_A_R_A_105_CM 1 0. 0. 255. DISPLAY_IDENTIFIER fm_sta_eprm_agb_no_frm.fm_static_eprm_bitfield.Sbx_dyn_xxx ECU_ADDRESS 0xd00056bc BIT_MASK 0x8 /end MEASUREMENT
/begin MEASUREMENT Sbx_rdn_agb_no_frm "" UBYTE _CNV_A_R_A_105_CM 1 0. 0. 255. DISPLAY_IDENTIFIER fm_sta_eprm_agb_no_frm.fm_static_eprm_bitfield.Sbx_rdn_xxx ECU_ADDRESS 0xd00056bc BIT_MASK 0x10 /end MEASUREMENT
/begin MEASUREMENT Sbx_mf_agb_no_frm "" UBYTE _CNV_A_R_A_105_CM 1 0. 0. 255. DISPLAY_IDENTIFIER fm_sta_eprm_agb_no_frm.fm_static_eprm_bitfield.Sbx_mf_xxx ECU_ADDRESS 0xd00056bc BIT_MASK 0x20 /end MEASUREMENT
/begin MEASUREMENT Sbx_cf_agb_no_frm "" UBYTE _CNV_A_R_A_105_CM 1 0. 0. 255. DISPLAY_IDENTIFIER fm_sta_eprm_agb_no_frm.fm_static_eprm_bitfield.Sbx_cf_xxx ECU_ADDRESS 0xd00056bc BIT_MASK 0x80 /end MEASUREMENT
/begin MEASUREMENT Sbx_dyn_bgin_clu_cmp "" UBYTE _CNV_A_R_A_105_CM 1 0. 0. 255. DISPLAY_IDENTIFIER fm_sta_eprm_bgin_clu_cmp.fm_static_eprm_bitfield.Sbx_dyn_xxx ECU_ADDRESS 0xd0005742 BIT_MASK 0x8 /end MEASUREMENT
/begin MEASUREMENT Sbx_rdn_bgin_clu_cmp "" UBYTE _CNV_A_R_A_105_CM 1 0. 0. 255. DISPLAY_IDENTIFIER fm_sta_eprm_bgin_clu_cmp.fm_static_eprm_bitfield.Sbx_rdn_xxx ECU_ADDRESS 0xd0005742 BIT_MASK 0x10 /end MEASUREMENT
/begin MEASUREMENT Sbx_mf_bgin_clu_cmp "" UBYTE _CNV_A_R_A_105_CM 1 0. 0. 255. DISPLAY_IDENTIFIER fm_sta_eprm_bgin_clu_cmp.fm_static_eprm_bitfield.Sbx_mf_xxx ECU_ADDRESS 0xd0005742 BIT_MASK 0x20 /end MEASUREMENT
/begin MEASUREMENT Sbx_cf_bgin_clu_cmp "" UBYTE _CNV_A_R_A_105_CM 1 0. 0. 255. DISPLAY_IDENTIFIER fm_sta_eprm_bgin_clu_cmp.fm_static_eprm_bitfield.Sbx_cf_xxx ECU_ADDRESS 0xd0005742 BIT_MASK 0x80 /end MEASUREMENT
/begin MEASUREMENT Sbx_dyn_bgin_clu_nok "" UBYTE _CNV_A_R_A_105_CM 1 0. 0. 255. DISPLAY_IDENTIFIER fm_sta_eprm_bgin_clu_nok.fm_static_eprm_bitfield.Sbx_dyn_xxx ECU_ADDRESS 0xd0005744 BIT_MASK 0x8 /end MEASUREMENT
/begin MEASUREMENT Sbx_rdn_bgin_clu_nok "" UBYTE _CNV_A_R_A_105_CM 1 0. 0. 255. DISPLAY_IDENTIFIER fm_sta_eprm_bgin_clu_nok.fm_static_eprm_bitfield.Sbx_rdn_xxx ECU_ADDRESS 0xd0005744 BIT_MASK 0x10 /end MEASUREMENT
/begin MEASUREMENT Sbx_mf_bgin_clu_nok "" UBYTE _CNV_A_R_A_105_CM 1 0. 0. 255. DISPLAY_IDENTIFIER fm_sta_eprm_bgin_clu_nok.fm_static_eprm_bitfield.Sbx_mf_xxx ECU_ADDRESS 0xd0005744 BIT_MASK 0x20 /end MEASUREMENT
/begin MEASUREMENT Sbx_cf_bgin_clu_nok "" UBYTE _CNV_A_R_A_105_CM 1 0. 0. 255. DISPLAY_IDENTIFIER fm_sta_eprm_bgin_clu_nok.fm_static_eprm_bitfield.Sbx_cf_xxx ECU_ADDRESS 0xd0005744 BIT_MASK 0x80 /end MEASUREMENT
/begin MEASUREMENT Sbx_dyn_brk_pdl_cmp "" UBYTE _CNV_A_R_A_105_CM 1 0. 0. 255. DISPLAY_IDENTIFIER fm_sta_eprm_brk_pdl_cmp.fm_static_eprm_bitfield.Sbx_dyn_xxx ECU_ADDRESS 0xd0005746 BIT_MASK 0x8 /end MEASUREMENT
/begin MEASUREMENT Sbx_rdn_brk_pdl_cmp "" UBYTE _CNV_A_R_A_105_CM 1 0. 0. 255. DISPLAY_IDENTIFIER fm_sta_eprm_brk_pdl_cmp.fm_static_eprm_bitfield.Sbx_rdn_xxx ECU_ADDRESS 0xd0005746 BIT_MASK 0x10 /end MEASUREMENT
/begin MEASUREMENT Sbx_mf_brk_pdl_cmp "" UBYTE _CNV_A_R_A_105_CM 1 0. 0. 255. DISPLAY_IDENTIFIER fm_sta_eprm_brk_pdl_cmp.fm_static_eprm_bitfield.Sbx_mf_xxx ECU_ADDRESS 0xd0005746 BIT_MASK 0x20 /end MEASUREMENT
/begin MEASUREMENT Sbx_cf_brk_pdl_cmp "" UBYTE _CNV_A_R_A_105_CM 1 0. 0. 255. DISPLAY_IDENTIFIER fm_sta_eprm_brk_pdl_cmp.fm_static_eprm_bitfield.Sbx_cf_xxx ECU_ADDRESS 0xd0005746 BIT_MASK 0x80 /end MEASUREMENT
/begin MEASUREMENT Sbx_dyn_cata_cpt "" UBYTE _CNV_A_R_A_105_CM 1 0. 0. 255. DISPLAY_IDENTIFIER fm_sta_eprm_cata_cpt.fm_static_eprm_bitfield.Sbx_dyn_xxx ECU_ADDRESS 0xd0005748 BIT_MASK 0x8 /end MEASUREMENT
/begin MEASUREMENT Sbx_rdn_cata_cpt "" UBYTE _CNV_A_R_A_105_CM 1 0. 0. 255. DISPLAY_IDENTIFIER fm_sta_eprm_cata_cpt.fm_static_eprm_bitfield.Sbx_rdn_xxx ECU_ADDRESS 0xd0005748 BIT_MASK 0x10 /end MEASUREMENT
/begin MEASUREMENT Sbx_mf_cata_cpt "" UBYTE _CNV_A_R_A_105_CM 1 0. 0. 255. DISPLAY_IDENTIFIER fm_sta_eprm_cata_cpt.fm_static_eprm_bitfield.Sbx_mf_xxx ECU_ADDRESS 0xd0005748 BIT_MASK 0x20 /end MEASUREMENT
/begin MEASUREMENT Sbx_cf_cata_cpt "" UBYTE _CNV_A_R_A_105_CM 1 0. 0. 255. DISPLAY_IDENTIFIER fm_sta_eprm_cata_cpt.fm_static_eprm_bitfield.Sbx_cf_xxx ECU_ADDRESS 0xd0005748 BIT_MASK 0x80 /end MEASUREMENT
/begin MEASUREMENT Sbx_dyn_cl_rich_chr "" UBYTE _CNV_A_R_A_105_CM 1 0. 0. 255. DISPLAY_IDENTIFIER fm_sta_eprm_cl_rich_chr.fm_static_eprm_bitfield.Sbx_dyn_xxx ECU_ADDRESS 0xd00057dc BIT_MASK 0x8 /end MEASUREMENT
/begin MEASUREMENT Sbx_rdn_cl_rich_chr "" UBYTE _CNV_A_R_A_105_CM 1 0. 0. 255. DISPLAY_IDENTIFIER fm_sta_eprm_cl_rich_chr.fm_static_eprm_bitfield.Sbx_rdn_xxx ECU_ADDRESS 0xd00057dc BIT_MASK 0x10 /end MEASUREMENT
/begin MEASUREMENT Sbx_mf_cl_rich_chr "" UBYTE _CNV_A_R_A_105_CM 1 0. 0. 255. DISPLAY_IDENTIFIER fm_sta_eprm_cl_rich_chr.fm_static_eprm_bitfield.Sbx_mf_xxx ECU_ADDRESS 0xd00057dc BIT_MASK 0x20 /end MEASUREMENT
/begin MEASUREMENT Sbx_cf_cl_rich_chr "" UBYTE _CNV_A_R_A_105_CM 1 0. 0. 255. DISPLAY_IDENTIFIER fm_sta_eprm_cl_rich_chr.fm_static_eprm_bitfield.Sbx_cf_xxx ECU_ADDRESS 0xd00057dc BIT_MASK 0x80 /end MEASUREMENT
/begin MEASUREMENT Sbx_dyn_clu_cnt_nok "" UBYTE _CNV_A_R_A_105_CM 1 0. 0. 255. DISPLAY_IDENTIFIER fm_sta_eprm_clu_cnt_nok.fm_static_eprm_bitfield.Sbx_dyn_xxx ECU_ADDRESS 0xd00056be BIT_MASK 0x8 /end MEASUREMENT
/begin MEASUREMENT Sbx_rdn_clu_cnt_nok "" UBYTE _CNV_A_R_A_105_CM 1 0. 0. 255. DISPLAY_IDENTIFIER fm_sta_eprm_clu_cnt_nok.fm_static_eprm_bitfield.Sbx_rdn_xxx ECU_ADDRESS 0xd00056be BIT_MASK 0x10 /end MEASUREMENT
/begin MEASUREMENT Sbx_mf_clu_cnt_nok "" UBYTE _CNV_A_R_A_105_CM 1 0. 0. 255. DISPLAY_IDENTIFIER fm_sta_eprm_clu_cnt_nok.fm_static_eprm_bitfield.Sbx_mf_xxx ECU_ADDRESS 0xd00056be BIT_MASK 0x20 /end MEASUREMENT
/begin MEASUREMENT Sbx_cf_clu_cnt_nok "" UBYTE _CNV_A_R_A_105_CM 1 0. 0. 255. DISPLAY_IDENTIFIER fm_sta_eprm_clu_cnt_nok.fm_static_eprm_bitfield.Sbx_cf_xxx ECU_ADDRESS 0xd00056be BIT_MASK 0x80 /end MEASUREMENT
/begin MEASUREMENT Sbx_dyn_cp_blk_open "" UBYTE _CNV_A_R_A_105_CM 1 0. 0. 255. DISPLAY_IDENTIFIER fm_sta_eprm_cp_blk_open.fm_static_eprm_bitfield.Sbx_dyn_xxx ECU_ADDRESS 0xd00057f0 BIT_MASK 0x8 /end MEASUREMENT
/begin MEASUREMENT Sbx_rdn_cp_blk_open "" UBYTE _CNV_A_R_A_105_CM 1 0. 0. 255. DISPLAY_IDENTIFIER fm_sta_eprm_cp_blk_open.fm_static_eprm_bitfield.Sbx_rdn_xxx ECU_ADDRESS 0xd00057f0 BIT_MASK 0x10 /end MEASUREMENT
/begin MEASUREMENT Sbx_mf_cp_blk_open "" UBYTE _CNV_A_R_A_105_CM 1 0. 0. 255. DISPLAY_IDENTIFIER fm_sta_eprm_cp_blk_open.fm_static_eprm_bitfield.Sbx_mf_xxx ECU_ADDRESS 0xd00057f0 BIT_MASK 0x20 /end MEASUREMENT
/begin MEASUREMENT Sbx_cf_cp_blk_open "" UBYTE _CNV_A_R_A_105_CM 1 0. 0. 255. DISPLAY_IDENTIFIER fm_sta_eprm_cp_blk_open.fm_static_eprm_bitfield.Sbx_cf_xxx ECU_ADDRESS 0xd00057f0 BIT_MASK 0x80 /end MEASUREMENT
/begin MEASUREMENT Sbx_dyn_cp_oc "" UBYTE _CNV_A_R_A_105_CM 1 0. 0. 255. DISPLAY_IDENTIFIER fm_sta_eprm_cp_oc.fm_static_eprm_bitfield.Sbx_dyn_xxx ECU_ADDRESS 0xd0005738 BIT_MASK 0x8 /end MEASUREMENT
/begin MEASUREMENT Sbx_rdn_cp_oc "" UBYTE _CNV_A_R_A_105_CM 1 0. 0. 255. DISPLAY_IDENTIFIER fm_sta_eprm_cp_oc.fm_static_eprm_bitfield.Sbx_rdn_xxx ECU_ADDRESS 0xd0005738 BIT_MASK 0x10 /end MEASUREMENT
/begin MEASUREMENT Sbx_mf_cp_oc "" UBYTE _CNV_A_R_A_105_CM 1 0. 0. 255. DISPLAY_IDENTIFIER fm_sta_eprm_cp_oc.fm_static_eprm_bitfield.Sbx_mf_xxx ECU_ADDRESS 0xd0005738 BIT_MASK 0x20 /end MEASUREMENT
/begin MEASUREMENT Sbx_cf_cp_oc "" UBYTE _CNV_A_R_A_105_CM 1 0. 0. 255. DISPLAY_IDENTIFIER fm_sta_eprm_cp_oc.fm_static_eprm_bitfield.Sbx_cf_xxx ECU_ADDRESS 0xd0005738 BIT_MASK 0x80 /end MEASUREMENT
/begin MEASUREMENT Sbx_dyn_cp_scg "" UBYTE _CNV_A_R_A_105_CM 1 0. 0. 255. DISPLAY_IDENTIFIER fm_sta_eprm_cp_scg.fm_static_eprm_bitfield.Sbx_dyn_xxx ECU_ADDRESS 0xd000573a BIT_MASK 0x8 /end MEASUREMENT
/begin MEASUREMENT Sbx_rdn_cp_scg "" UBYTE _CNV_A_R_A_105_CM 1 0. 0. 255. DISPLAY_IDENTIFIER fm_sta_eprm_cp_scg.fm_static_eprm_bitfield.Sbx_rdn_xxx ECU_ADDRESS 0xd000573a BIT_MASK 0x10 /end MEASUREMENT
/begin MEASUREMENT Sbx_mf_cp_scg "" UBYTE _CNV_A_R_A_105_CM 1 0. 0. 255. DISPLAY_IDENTIFIER fm_sta_eprm_cp_scg.fm_static_eprm_bitfield.Sbx_mf_xxx ECU_ADDRESS 0xd000573a BIT_MASK 0x20 /end MEASUREMENT
/begin MEASUREMENT Sbx_cf_cp_scg "" UBYTE _CNV_A_R_A_105_CM 1 0. 0. 255. DISPLAY_IDENTIFIER fm_sta_eprm_cp_scg.fm_static_eprm_bitfield.Sbx_cf_xxx ECU_ADDRESS 0xd000573a BIT_MASK 0x80 /end MEASUREMENT
/begin MEASUREMENT Sbx_dyn_cp_scw "" UBYTE _CNV_A_R_A_105_CM 1 0. 0. 255. DISPLAY_IDENTIFIER fm_sta_eprm_cp_scw.fm_static_eprm_bitfield.Sbx_dyn_xxx ECU_ADDRESS 0xd000573c BIT_MASK 0x8 /end MEASUREMENT
/begin MEASUREMENT Sbx_rdn_cp_scw "" UBYTE _CNV_A_R_A_105_CM 1 0. 0. 255. DISPLAY_IDENTIFIER fm_sta_eprm_cp_scw.fm_static_eprm_bitfield.Sbx_rdn_xxx ECU_ADDRESS 0xd000573c BIT_MASK 0x10 /end MEASUREMENT
/begin MEASUREMENT Sbx_mf_cp_scw "" UBYTE _CNV_A_R_A_105_CM 1 0. 0. 255. DISPLAY_IDENTIFIER fm_sta_eprm_cp_scw.fm_static_eprm_bitfield.Sbx_mf_xxx ECU_ADDRESS 0xd000573c BIT_MASK 0x20 /end MEASUREMENT
/begin MEASUREMENT Sbx_cf_cp_scw "" UBYTE _CNV_A_R_A_105_CM 1 0. 0. 255. DISPLAY_IDENTIFIER fm_sta_eprm_cp_scw.fm_static_eprm_bitfield.Sbx_cf_xxx ECU_ADDRESS 0xd000573c BIT_MASK 0x80 /end MEASUREMENT
/begin MEASUREMENT Sbx_dyn_crk_chr "" UBYTE _CNV_A_R_A_105_CM 1 0. 0. 255. DISPLAY_IDENTIFIER fm_sta_eprm_crk_chr.fm_static_eprm_bitfield.Sbx_dyn_xxx ECU_ADDRESS 0xd00057ae BIT_MASK 0x8 /end MEASUREMENT
/begin MEASUREMENT Sbx_rdn_crk_chr "" UBYTE _CNV_A_R_A_105_CM 1 0. 0. 255. DISPLAY_IDENTIFIER fm_sta_eprm_crk_chr.fm_static_eprm_bitfield.Sbx_rdn_xxx ECU_ADDRESS 0xd00057ae BIT_MASK 0x10 /end MEASUREMENT
/begin MEASUREMENT Sbx_mf_crk_chr "" UBYTE _CNV_A_R_A_105_CM 1 0. 0. 255. DISPLAY_IDENTIFIER fm_sta_eprm_crk_chr.fm_static_eprm_bitfield.Sbx_mf_xxx ECU_ADDRESS 0xd00057ae BIT_MASK 0x20 /end MEASUREMENT
/begin MEASUREMENT Sbx_cf_crk_chr "" UBYTE _CNV_A_R_A_105_CM 1 0. 0. 255. DISPLAY_IDENTIFIER fm_sta_eprm_crk_chr.fm_static_eprm_bitfield.Sbx_cf_xxx ECU_ADDRESS 0xd00057ae BIT_MASK 0x80 /end MEASUREMENT
/begin MEASUREMENT Sbx_dyn_crk_cmp "" UBYTE _CNV_A_R_A_105_CM 1 0. 0. 255. DISPLAY_IDENTIFIER fm_sta_eprm_crk_cmp.fm_static_eprm_bitfield.Sbx_dyn_xxx ECU_ADDRESS 0xd00057d6 BIT_MASK 0x8 /end MEASUREMENT
/begin MEASUREMENT Sbx_rdn_crk_cmp "" UBYTE _CNV_A_R_A_105_CM 1 0. 0. 255. DISPLAY_IDENTIFIER fm_sta_eprm_crk_cmp.fm_static_eprm_bitfield.Sbx_rdn_xxx ECU_ADDRESS 0xd00057d6 BIT_MASK 0x10 /end MEASUREMENT
/begin MEASUREMENT Sbx_mf_crk_cmp "" UBYTE _CNV_A_R_A_105_CM 1 0. 0. 255. DISPLAY_IDENTIFIER fm_sta_eprm_crk_cmp.fm_static_eprm_bitfield.Sbx_mf_xxx ECU_ADDRESS 0xd00057d6 BIT_MASK 0x20 /end MEASUREMENT
/begin MEASUREMENT Sbx_cf_crk_cmp "" UBYTE _CNV_A_R_A_105_CM 1 0. 0. 255. DISPLAY_IDENTIFIER fm_sta_eprm_crk_cmp.fm_static_eprm_bitfield.Sbx_cf_xxx ECU_ADDRESS 0xd00057d6 BIT_MASK 0x80 /end MEASUREMENT
/begin MEASUREMENT Sbx_dyn_crk_cyc "" UBYTE _CNV_A_R_A_105_CM 1 0. 0. 255. DISPLAY_IDENTIFIER fm_sta_eprm_crk_cyc.fm_static_eprm_bitfield.Sbx_dyn_xxx ECU_ADDRESS 0xd00057b0 BIT_MASK 0x8 /end MEASUREMENT
/begin MEASUREMENT Sbx_rdn_crk_cyc "" UBYTE _CNV_A_R_A_105_CM 1 0. 0. 255. DISPLAY_IDENTIFIER fm_sta_eprm_crk_cyc.fm_static_eprm_bitfield.Sbx_rdn_xxx ECU_ADDRESS 0xd00057b0 BIT_MASK 0x10 /end MEASUREMENT
/begin MEASUREMENT Sbx_mf_crk_cyc "" UBYTE _CNV_A_R_A_105_CM 1 0. 0. 255. DISPLAY_IDENTIFIER fm_sta_eprm_crk_cyc.fm_static_eprm_bitfield.Sbx_mf_xxx ECU_ADDRESS 0xd00057b0 BIT_MASK 0x20 /end MEASUREMENT
/begin MEASUREMENT Sbx_cf_crk_cyc "" UBYTE _CNV_A_R_A_105_CM 1 0. 0. 255. DISPLAY_IDENTIFIER fm_sta_eprm_crk_cyc.fm_static_eprm_bitfield.Sbx_cf_xxx ECU_ADDRESS 0xd00057b0 BIT_MASK 0x80 /end MEASUREMENT
/begin MEASUREMENT Sbx_dyn_crk_no_sig "" UBYTE _CNV_A_R_A_105_CM 1 0. 0. 255. DISPLAY_IDENTIFIER fm_sta_eprm_crk_no_sig.fm_static_eprm_bitfield.Sbx_dyn_xxx ECU_ADDRESS 0xd00057c2 BIT_MASK 0x8 /end MEASUREMENT
/begin MEASUREMENT Sbx_rdn_crk_no_sig "" UBYTE _CNV_A_R_A_105_CM 1 0. 0. 255. DISPLAY_IDENTIFIER fm_sta_eprm_crk_no_sig.fm_static_eprm_bitfield.Sbx_rdn_xxx ECU_ADDRESS 0xd00057c2 BIT_MASK 0x10 /end MEASUREMENT
/begin MEASUREMENT Sbx_mf_crk_no_sig "" UBYTE _CNV_A_R_A_105_CM 1 0. 0. 255. DISPLAY_IDENTIFIER fm_sta_eprm_crk_no_sig.fm_static_eprm_bitfield.Sbx_mf_xxx ECU_ADDRESS 0xd00057c2 BIT_MASK 0x20 /end MEASUREMENT
/begin MEASUREMENT Sbx_cf_crk_no_sig "" UBYTE _CNV_A_R_A_105_CM 1 0. 0. 255. DISPLAY_IDENTIFIER fm_sta_eprm_crk_no_sig.fm_static_eprm_bitfield.Sbx_cf_xxx ECU_ADDRESS 0xd00057c2 BIT_MASK 0x80 /end MEASUREMENT
/begin MEASUREMENT Sbx_dyn_crk_oc "" UBYTE _CNV_A_R_A_105_CM 1 0. 0. 255. DISPLAY_IDENTIFIER fm_sta_eprm_crk_oc.fm_static_eprm_bitfield.Sbx_dyn_xxx ECU_ADDRESS 0xd00057da BIT_MASK 0x8 /end MEASUREMENT
/begin MEASUREMENT Sbx_rdn_crk_oc "" UBYTE _CNV_A_R_A_105_CM 1 0. 0. 255. DISPLAY_IDENTIFIER fm_sta_eprm_crk_oc.fm_static_eprm_bitfield.Sbx_rdn_xxx ECU_ADDRESS 0xd00057da BIT_MASK 0x10 /end MEASUREMENT
/begin MEASUREMENT Sbx_mf_crk_oc "" UBYTE _CNV_A_R_A_105_CM 1 0. 0. 255. DISPLAY_IDENTIFIER fm_sta_eprm_crk_oc.fm_static_eprm_bitfield.Sbx_mf_xxx ECU_ADDRESS 0xd00057da BIT_MASK 0x20 /end MEASUREMENT
/begin MEASUREMENT Sbx_cf_crk_oc "" UBYTE _CNV_A_R_A_105_CM 1 0. 0. 255. DISPLAY_IDENTIFIER fm_sta_eprm_crk_oc.fm_static_eprm_bitfield.Sbx_cf_xxx ECU_ADDRESS 0xd00057da BIT_MASK 0x80 /end MEASUREMENT
/begin MEASUREMENT Sbx_dyn_crk_shp "" UBYTE _CNV_A_R_A_105_CM 1 0. 0. 255. DISPLAY_IDENTIFIER fm_sta_eprm_crk_shp.fm_static_eprm_bitfield.Sbx_dyn_xxx ECU_ADDRESS 0xd00057d8 BIT_MASK 0x8 /end MEASUREMENT
/begin MEASUREMENT Sbx_rdn_crk_shp "" UBYTE _CNV_A_R_A_105_CM 1 0. 0. 255. DISPLAY_IDENTIFIER fm_sta_eprm_crk_shp.fm_static_eprm_bitfield.Sbx_rdn_xxx ECU_ADDRESS 0xd00057d8 BIT_MASK 0x10 /end MEASUREMENT
/begin MEASUREMENT Sbx_mf_crk_shp "" UBYTE _CNV_A_R_A_105_CM 1 0. 0. 255. DISPLAY_IDENTIFIER fm_sta_eprm_crk_shp.fm_static_eprm_bitfield.Sbx_mf_xxx ECU_ADDRESS 0xd00057d8 BIT_MASK 0x20 /end MEASUREMENT
/begin MEASUREMENT Sbx_cf_crk_shp "" UBYTE _CNV_A_R_A_105_CM 1 0. 0. 255. DISPLAY_IDENTIFIER fm_sta_eprm_crk_shp.fm_static_eprm_bitfield.Sbx_cf_xxx ECU_ADDRESS 0xd00057d8 BIT_MASK 0x80 /end MEASUREMENT
/begin MEASUREMENT Sbx_dyn_cru_cmp "" UBYTE _CNV_A_R_A_105_CM 1 0. 0. 255. DISPLAY_IDENTIFIER fm_sta_eprm_cru_cmp.fm_static_eprm_bitfield.Sbx_dyn_xxx ECU_ADDRESS 0xd000574a BIT_MASK 0x8 /end MEASUREMENT
/begin MEASUREMENT Sbx_rdn_cru_cmp "" UBYTE _CNV_A_R_A_105_CM 1 0. 0. 255. DISPLAY_IDENTIFIER fm_sta_eprm_cru_cmp.fm_static_eprm_bitfield.Sbx_rdn_xxx ECU_ADDRESS 0xd000574a BIT_MASK 0x10 /end MEASUREMENT
/begin MEASUREMENT Sbx_mf_cru_cmp "" UBYTE _CNV_A_R_A_105_CM 1 0. 0. 255. DISPLAY_IDENTIFIER fm_sta_eprm_cru_cmp.fm_static_eprm_bitfield.Sbx_mf_xxx ECU_ADDRESS 0xd000574a BIT_MASK 0x20 /end MEASUREMENT
/begin MEASUREMENT Sbx_cf_cru_cmp "" UBYTE _CNV_A_R_A_105_CM 1 0. 0. 255. DISPLAY_IDENTIFIER fm_sta_eprm_cru_cmp.fm_static_eprm_bitfield.Sbx_cf_xxx ECU_ADDRESS 0xd000574a BIT_MASK 0x80 /end MEASUREMENT
/begin MEASUREMENT Sbx_dyn_cru_sl_swi_chr "" UBYTE _CNV_A_R_A_105_CM 1 0. 0. 255. DISPLAY_IDENTIFIER fm_sta_eprm_cru_sl_swi_chr.fm_static_eprm_bitfield.Sbx_dyn_xxx ECU_ADDRESS 0xd000574c BIT_MASK 0x8 /end MEASUREMENT
/begin MEASUREMENT Sbx_rdn_cru_sl_swi_chr "" UBYTE _CNV_A_R_A_105_CM 1 0. 0. 255. DISPLAY_IDENTIFIER fm_sta_eprm_cru_sl_swi_chr.fm_static_eprm_bitfield.Sbx_rdn_xxx ECU_ADDRESS 0xd000574c BIT_MASK 0x10 /end MEASUREMENT
/begin MEASUREMENT Sbx_mf_cru_sl_swi_chr "" UBYTE _CNV_A_R_A_105_CM 1 0. 0. 255. DISPLAY_IDENTIFIER fm_sta_eprm_cru_sl_swi_chr.fm_static_eprm_bitfield.Sbx_mf_xxx ECU_ADDRESS 0xd000574c BIT_MASK 0x20 /end MEASUREMENT
/begin MEASUREMENT Sbx_cf_cru_sl_swi_chr "" UBYTE _CNV_A_R_A_105_CM 1 0. 0. 255. DISPLAY_IDENTIFIER fm_sta_eprm_cru_sl_swi_chr.fm_static_eprm_bitfield.Sbx_cf_xxx ECU_ADDRESS 0xd000574c BIT_MASK 0x80 /end MEASUREMENT
/begin MEASUREMENT Sbx_dyn_cru_sl_tot "" UBYTE _CNV_A_R_A_105_CM 1 0. 0. 255. DISPLAY_IDENTIFIER fm_sta_eprm_cru_sl_tot.fm_static_eprm_bitfield.Sbx_dyn_xxx ECU_ADDRESS 0xd000574e BIT_MASK 0x8 /end MEASUREMENT
/begin MEASUREMENT Sbx_rdn_cru_sl_tot "" UBYTE _CNV_A_R_A_105_CM 1 0. 0. 255. DISPLAY_IDENTIFIER fm_sta_eprm_cru_sl_tot.fm_static_eprm_bitfield.Sbx_rdn_xxx ECU_ADDRESS 0xd000574e BIT_MASK 0x10 /end MEASUREMENT
/begin MEASUREMENT Sbx_mf_cru_sl_tot "" UBYTE _CNV_A_R_A_105_CM 1 0. 0. 255. DISPLAY_IDENTIFIER fm_sta_eprm_cru_sl_tot.fm_static_eprm_bitfield.Sbx_mf_xxx ECU_ADDRESS 0xd000574e BIT_MASK 0x20 /end MEASUREMENT
/begin MEASUREMENT Sbx_cf_cru_sl_tot "" UBYTE _CNV_A_R_A_105_CM 1 0. 0. 255. DISPLAY_IDENTIFIER fm_sta_eprm_cru_sl_tot.fm_static_eprm_bitfield.Sbx_cf_xxx ECU_ADDRESS 0xd000574e BIT_MASK 0x80 /end MEASUREMENT
/begin MEASUREMENT Sbx_dyn_cru_vs_cmp "" UBYTE _CNV_A_R_A_105_CM 1 0. 0. 255. DISPLAY_IDENTIFIER fm_sta_eprm_cru_vs_cmp.fm_static_eprm_bitfield.Sbx_dyn_xxx ECU_ADDRESS 0xd0005750 BIT_MASK 0x8 /end MEASUREMENT
/begin MEASUREMENT Sbx_rdn_cru_vs_cmp "" UBYTE _CNV_A_R_A_105_CM 1 0. 0. 255. DISPLAY_IDENTIFIER fm_sta_eprm_cru_vs_cmp.fm_static_eprm_bitfield.Sbx_rdn_xxx ECU_ADDRESS 0xd0005750 BIT_MASK 0x10 /end MEASUREMENT
/begin MEASUREMENT Sbx_mf_cru_vs_cmp "" UBYTE _CNV_A_R_A_105_CM 1 0. 0. 255. DISPLAY_IDENTIFIER fm_sta_eprm_cru_vs_cmp.fm_static_eprm_bitfield.Sbx_mf_xxx ECU_ADDRESS 0xd0005750 BIT_MASK 0x20 /end MEASUREMENT
/begin MEASUREMENT Sbx_cf_cru_vs_cmp "" UBYTE _CNV_A_R_A_105_CM 1 0. 0. 255. DISPLAY_IDENTIFIER fm_sta_eprm_cru_vs_cmp.fm_static_eprm_bitfield.Sbx_cf_xxx ECU_ADDRESS 0xd0005750 BIT_MASK 0x80 /end MEASUREMENT
/begin MEASUREMENT Sbx_dyn_cru_whl_cmd_nok "" UBYTE _CNV_A_R_A_105_CM 1 0. 0. 255. DISPLAY_IDENTIFIER fm_sta_eprm_cru_whl_cmd_nok.fm_static_eprm_bitfield.Sbx_dyn_xxx ECU_ADDRESS 0xd0005752 BIT_MASK 0x8 /end MEASUREMENT
/begin MEASUREMENT Sbx_rdn_cru_whl_cmd_nok "" UBYTE _CNV_A_R_A_105_CM 1 0. 0. 255. DISPLAY_IDENTIFIER fm_sta_eprm_cru_whl_cmd_nok.fm_static_eprm_bitfield.Sbx_rdn_xxx ECU_ADDRESS 0xd0005752 BIT_MASK 0x10 /end MEASUREMENT
/begin MEASUREMENT Sbx_mf_cru_whl_cmd_nok "" UBYTE _CNV_A_R_A_105_CM 1 0. 0. 255. DISPLAY_IDENTIFIER fm_sta_eprm_cru_whl_cmd_nok.fm_static_eprm_bitfield.Sbx_mf_xxx ECU_ADDRESS 0xd0005752 BIT_MASK 0x20 /end MEASUREMENT
/begin MEASUREMENT Sbx_cf_cru_whl_cmd_nok "" UBYTE _CNV_A_R_A_105_CM 1 0. 0. 255. DISPLAY_IDENTIFIER fm_sta_eprm_cru_whl_cmd_nok.fm_static_eprm_bitfield.Sbx_cf_xxx ECU_ADDRESS 0xd0005752 BIT_MASK 0x80 /end MEASUREMENT
/begin MEASUREMENT Sbx_dyn_cru_whl_cmd_oc_scw "" UBYTE _CNV_A_R_A_105_CM 1 0. 0. 255. DISPLAY_IDENTIFIER fm_sta_eprm_cru_whl_cmd_oc_scw.fm_static_eprm_bitfield.Sbx_dyn_xxx ECU_ADDRESS 0xd0005754 BIT_MASK 0x8 /end MEASUREMENT
/begin MEASUREMENT Sbx_rdn_cru_whl_cmd_oc_scw "" UBYTE _CNV_A_R_A_105_CM 1 0. 0. 255. DISPLAY_IDENTIFIER fm_sta_eprm_cru_whl_cmd_oc_scw.fm_static_eprm_bitfield.Sbx_rdn_xxx ECU_ADDRESS 0xd0005754 BIT_MASK 0x10 /end MEASUREMENT
/begin MEASUREMENT Sbx_mf_cru_whl_cmd_oc_scw "" UBYTE _CNV_A_R_A_105_CM 1 0. 0. 255. DISPLAY_IDENTIFIER fm_sta_eprm_cru_whl_cmd_oc_scw.fm_static_eprm_bitfield.Sbx_mf_xxx ECU_ADDRESS 0xd0005754 BIT_MASK 0x20 /end MEASUREMENT
/begin MEASUREMENT Sbx_cf_cru_whl_cmd_oc_scw "" UBYTE _CNV_A_R_A_105_CM 1 0. 0. 255. DISPLAY_IDENTIFIER fm_sta_eprm_cru_whl_cmd_oc_scw.fm_static_eprm_bitfield.Sbx_cf_xxx ECU_ADDRESS 0xd0005754 BIT_MASK 0x80 /end MEASUREMENT
/begin MEASUREMENT Sbx_dyn_cru_whl_cmd_oor "" UBYTE _CNV_A_R_A_105_CM 1 0. 0. 255. DISPLAY_IDENTIFIER fm_sta_eprm_cru_whl_cmd_oor.fm_static_eprm_bitfield.Sbx_dyn_xxx ECU_ADDRESS 0xd0005756 BIT_MASK 0x8 /end MEASUREMENT
/begin MEASUREMENT Sbx_rdn_cru_whl_cmd_oor "" UBYTE _CNV_A_R_A_105_CM 1 0. 0. 255. DISPLAY_IDENTIFIER fm_sta_eprm_cru_whl_cmd_oor.fm_static_eprm_bitfield.Sbx_rdn_xxx ECU_ADDRESS 0xd0005756 BIT_MASK 0x10 /end MEASUREMENT
/begin MEASUREMENT Sbx_mf_cru_whl_cmd_oor "" UBYTE _CNV_A_R_A_105_CM 1 0. 0. 255. DISPLAY_IDENTIFIER fm_sta_eprm_cru_whl_cmd_oor.fm_static_eprm_bitfield.Sbx_mf_xxx ECU_ADDRESS 0xd0005756 BIT_MASK 0x20 /end MEASUREMENT
/begin MEASUREMENT Sbx_cf_cru_whl_cmd_oor "" UBYTE _CNV_A_R_A_105_CM 1 0. 0. 255. DISPLAY_IDENTIFIER fm_sta_eprm_cru_whl_cmd_oor.fm_static_eprm_bitfield.Sbx_cf_xxx ECU_ADDRESS 0xd0005756 BIT_MASK 0x80 /end MEASUREMENT
/begin MEASUREMENT Sbx_dyn_ecm_adc_tron "" UBYTE _CNV_A_R_A_105_CM 1 0. 0. 255. DISPLAY_IDENTIFIER fm_sta_eprm_ecm_adc_tron.fm_static_eprm_bitfield.Sbx_dyn_xxx ECU_ADDRESS 0xd00057e2 BIT_MASK 0x8 /end MEASUREMENT
/begin MEASUREMENT Sbx_rdn_ecm_adc_tron "" UBYTE _CNV_A_R_A_105_CM 1 0. 0. 255. DISPLAY_IDENTIFIER fm_sta_eprm_ecm_adc_tron.fm_static_eprm_bitfield.Sbx_rdn_xxx ECU_ADDRESS 0xd00057e2 BIT_MASK 0x10 /end MEASUREMENT
/begin MEASUREMENT Sbx_mf_ecm_adc_tron "" UBYTE _CNV_A_R_A_105_CM 1 0. 0. 255. DISPLAY_IDENTIFIER fm_sta_eprm_ecm_adc_tron.fm_static_eprm_bitfield.Sbx_mf_xxx ECU_ADDRESS 0xd00057e2 BIT_MASK 0x20 /end MEASUREMENT
/begin MEASUREMENT Sbx_cf_ecm_adc_tron "" UBYTE _CNV_A_R_A_105_CM 1 0. 0. 255. DISPLAY_IDENTIFIER fm_sta_eprm_ecm_adc_tron.fm_static_eprm_bitfield.Sbx_cf_xxx ECU_ADDRESS 0xd00057e2 BIT_MASK 0x80 /end MEASUREMENT
/begin MEASUREMENT Sbx_dyn_ecm_err_itl "" UBYTE _CNV_A_R_A_105_CM 1 0. 0. 255. DISPLAY_IDENTIFIER fm_sta_eprm_ecm_err_itl.fm_static_eprm_bitfield.Sbx_dyn_xxx ECU_ADDRESS 0xd00057c4 BIT_MASK 0x8 /end MEASUREMENT
/begin MEASUREMENT Sbx_rdn_ecm_err_itl "" UBYTE _CNV_A_R_A_105_CM 1 0. 0. 255. DISPLAY_IDENTIFIER fm_sta_eprm_ecm_err_itl.fm_static_eprm_bitfield.Sbx_rdn_xxx ECU_ADDRESS 0xd00057c4 BIT_MASK 0x10 /end MEASUREMENT
/begin MEASUREMENT Sbx_mf_ecm_err_itl "" UBYTE _CNV_A_R_A_105_CM 1 0. 0. 255. DISPLAY_IDENTIFIER fm_sta_eprm_ecm_err_itl.fm_static_eprm_bitfield.Sbx_mf_xxx ECU_ADDRESS 0xd00057c4 BIT_MASK 0x20 /end MEASUREMENT
/begin MEASUREMENT Sbx_cf_ecm_err_itl "" UBYTE _CNV_A_R_A_105_CM 1 0. 0. 255. DISPLAY_IDENTIFIER fm_sta_eprm_ecm_err_itl.fm_static_eprm_bitfield.Sbx_cf_xxx ECU_ADDRESS 0xd00057c4 BIT_MASK 0x80 /end MEASUREMENT
/begin MEASUREMENT Sbx_dyn_ecm_mon_secu_1 "" UBYTE _CNV_A_R_A_105_CM 1 0. 0. 255. DISPLAY_IDENTIFIER fm_sta_eprm_ecm_mon_secu_1.fm_static_eprm_bitfield.Sbx_dyn_xxx ECU_ADDRESS 0xd00057de BIT_MASK 0x8 /end MEASUREMENT
/begin MEASUREMENT Sbx_rdn_ecm_mon_secu_1 "" UBYTE _CNV_A_R_A_105_CM 1 0. 0. 255. DISPLAY_IDENTIFIER fm_sta_eprm_ecm_mon_secu_1.fm_static_eprm_bitfield.Sbx_rdn_xxx ECU_ADDRESS 0xd00057de BIT_MASK 0x10 /end MEASUREMENT
/begin MEASUREMENT Sbx_mf_ecm_mon_secu_1 "" UBYTE _CNV_A_R_A_105_CM 1 0. 0. 255. DISPLAY_IDENTIFIER fm_sta_eprm_ecm_mon_secu_1.fm_static_eprm_bitfield.Sbx_mf_xxx ECU_ADDRESS 0xd00057de BIT_MASK 0x20 /end MEASUREMENT
/begin MEASUREMENT Sbx_cf_ecm_mon_secu_1 "" UBYTE _CNV_A_R_A_105_CM 1 0. 0. 255. DISPLAY_IDENTIFIER fm_sta_eprm_ecm_mon_secu_1.fm_static_eprm_bitfield.Sbx_cf_xxx ECU_ADDRESS 0xd00057de BIT_MASK 0x80 /end MEASUREMENT
/begin MEASUREMENT Sbx_dyn_ecm_mon_secu_2 "" UBYTE _CNV_A_R_A_105_CM 1 0. 0. 255. DISPLAY_IDENTIFIER fm_sta_eprm_ecm_mon_secu_2.fm_static_eprm_bitfield.Sbx_dyn_xxx ECU_ADDRESS 0xd00057e0 BIT_MASK 0x8 /end MEASUREMENT
/begin MEASUREMENT Sbx_rdn_ecm_mon_secu_2 "" UBYTE _CNV_A_R_A_105_CM 1 0. 0. 255. DISPLAY_IDENTIFIER fm_sta_eprm_ecm_mon_secu_2.fm_static_eprm_bitfield.Sbx_rdn_xxx ECU_ADDRESS 0xd00057e0 BIT_MASK 0x10 /end MEASUREMENT
/begin MEASUREMENT Sbx_mf_ecm_mon_secu_2 "" UBYTE _CNV_A_R_A_105_CM 1 0. 0. 255. DISPLAY_IDENTIFIER fm_sta_eprm_ecm_mon_secu_2.fm_static_eprm_bitfield.Sbx_mf_xxx ECU_ADDRESS 0xd00057e0 BIT_MASK 0x20 /end MEASUREMENT
/begin MEASUREMENT Sbx_cf_ecm_mon_secu_2 "" UBYTE _CNV_A_R_A_105_CM 1 0. 0. 255. DISPLAY_IDENTIFIER fm_sta_eprm_ecm_mon_secu_2.fm_static_eprm_bitfield.Sbx_cf_xxx ECU_ADDRESS 0xd00057e0 BIT_MASK 0x80 /end MEASUREMENT
/begin MEASUREMENT Sbx_dyn_ecm_mon_tron "" UBYTE _CNV_A_R_A_105_CM 1 0. 0. 255. DISPLAY_IDENTIFIER fm_sta_eprm_ecm_mon_tron.fm_static_eprm_bitfield.Sbx_dyn_xxx ECU_ADDRESS 0xd00057c6 BIT_MASK 0x8 /end MEASUREMENT
/begin MEASUREMENT Sbx_rdn_ecm_mon_tron "" UBYTE _CNV_A_R_A_105_CM 1 0. 0. 255. DISPLAY_IDENTIFIER fm_sta_eprm_ecm_mon_tron.fm_static_eprm_bitfield.Sbx_rdn_xxx ECU_ADDRESS 0xd00057c6 BIT_MASK 0x10 /end MEASUREMENT
/begin MEASUREMENT Sbx_mf_ecm_mon_tron "" UBYTE _CNV_A_R_A_105_CM 1 0. 0. 255. DISPLAY_IDENTIFIER fm_sta_eprm_ecm_mon_tron.fm_static_eprm_bitfield.Sbx_mf_xxx ECU_ADDRESS 0xd00057c6 BIT_MASK 0x20 /end MEASUREMENT
/begin MEASUREMENT Sbx_cf_ecm_mon_tron "" UBYTE _CNV_A_R_A_105_CM 1 0. 0. 255. DISPLAY_IDENTIFIER fm_sta_eprm_ecm_mon_tron.fm_static_eprm_bitfield.Sbx_cf_xxx ECU_ADDRESS 0xd00057c6 BIT_MASK 0x80 /end MEASUREMENT
/begin MEASUREMENT Sbx_dyn_efi_sldv_2_oc "" UBYTE _CNV_A_R_A_105_CM 1 0. 0. 255. DISPLAY_IDENTIFIER fm_sta_eprm_efi_sldv_2_oc.fm_static_eprm_bitfield.Sbx_dyn_xxx ECU_ADDRESS 0xd000582c BIT_MASK 0x8 /end MEASUREMENT
/begin MEASUREMENT Sbx_rdn_efi_sldv_2_oc "" UBYTE _CNV_A_R_A_105_CM 1 0. 0. 255. DISPLAY_IDENTIFIER fm_sta_eprm_efi_sldv_2_oc.fm_static_eprm_bitfield.Sbx_rdn_xxx ECU_ADDRESS 0xd000582c BIT_MASK 0x10 /end MEASUREMENT
/begin MEASUREMENT Sbx_mf_efi_sldv_2_oc "" UBYTE _CNV_A_R_A_105_CM 1 0. 0. 255. DISPLAY_IDENTIFIER fm_sta_eprm_efi_sldv_2_oc.fm_static_eprm_bitfield.Sbx_mf_xxx ECU_ADDRESS 0xd000582c BIT_MASK 0x20 /end MEASUREMENT
/begin MEASUREMENT Sbx_cf_efi_sldv_2_oc "" UBYTE _CNV_A_R_A_105_CM 1 0. 0. 255. DISPLAY_IDENTIFIER fm_sta_eprm_efi_sldv_2_oc.fm_static_eprm_bitfield.Sbx_cf_xxx ECU_ADDRESS 0xd000582c BIT_MASK 0x80 /end MEASUREMENT
/begin MEASUREMENT Sbx_dyn_efi_sldv_2_scg "" UBYTE _CNV_A_R_A_105_CM 1 0. 0. 255. DISPLAY_IDENTIFIER fm_sta_eprm_efi_sldv_2_scg.fm_static_eprm_bitfield.Sbx_dyn_xxx ECU_ADDRESS 0xd000582e BIT_MASK 0x8 /end MEASUREMENT
/begin MEASUREMENT Sbx_rdn_efi_sldv_2_scg "" UBYTE _CNV_A_R_A_105_CM 1 0. 0. 255. DISPLAY_IDENTIFIER fm_sta_eprm_efi_sldv_2_scg.fm_static_eprm_bitfield.Sbx_rdn_xxx ECU_ADDRESS 0xd000582e BIT_MASK 0x10 /end MEASUREMENT
/begin MEASUREMENT Sbx_mf_efi_sldv_2_scg "" UBYTE _CNV_A_R_A_105_CM 1 0. 0. 255. DISPLAY_IDENTIFIER fm_sta_eprm_efi_sldv_2_scg.fm_static_eprm_bitfield.Sbx_mf_xxx ECU_ADDRESS 0xd000582e BIT_MASK 0x20 /end MEASUREMENT
/begin MEASUREMENT Sbx_cf_efi_sldv_2_scg "" UBYTE _CNV_A_R_A_105_CM 1 0. 0. 255. DISPLAY_IDENTIFIER fm_sta_eprm_efi_sldv_2_scg.fm_static_eprm_bitfield.Sbx_cf_xxx ECU_ADDRESS 0xd000582e BIT_MASK 0x80 /end MEASUREMENT
/begin MEASUREMENT Sbx_dyn_efi_sldv_2_scw "" UBYTE _CNV_A_R_A_105_CM 1 0. 0. 255. DISPLAY_IDENTIFIER fm_sta_eprm_efi_sldv_2_scw.fm_static_eprm_bitfield.Sbx_dyn_xxx ECU_ADDRESS 0xd0005830 BIT_MASK 0x8 /end MEASUREMENT
/begin MEASUREMENT Sbx_rdn_efi_sldv_2_scw "" UBYTE _CNV_A_R_A_105_CM 1 0. 0. 255. DISPLAY_IDENTIFIER fm_sta_eprm_efi_sldv_2_scw.fm_static_eprm_bitfield.Sbx_rdn_xxx ECU_ADDRESS 0xd0005830 BIT_MASK 0x10 /end MEASUREMENT
/begin MEASUREMENT Sbx_mf_efi_sldv_2_scw "" UBYTE _CNV_A_R_A_105_CM 1 0. 0. 255. DISPLAY_IDENTIFIER fm_sta_eprm_efi_sldv_2_scw.fm_static_eprm_bitfield.Sbx_mf_xxx ECU_ADDRESS 0xd0005830 BIT_MASK 0x20 /end MEASUREMENT
/begin MEASUREMENT Sbx_cf_efi_sldv_2_scw "" UBYTE _CNV_A_R_A_105_CM 1 0. 0. 255. DISPLAY_IDENTIFIER fm_sta_eprm_efi_sldv_2_scw.fm_static_eprm_bitfield.Sbx_cf_xxx ECU_ADDRESS 0xd0005830 BIT_MASK 0x80 /end MEASUREMENT
/begin MEASUREMENT Sbx_dyn_esp_data_chr "" UBYTE _CNV_A_R_A_105_CM 1 0. 0. 255. DISPLAY_IDENTIFIER fm_sta_eprm_esp_data_chr.fm_static_eprm_bitfield.Sbx_dyn_xxx ECU_ADDRESS 0xd00056c0 BIT_MASK 0x8 /end MEASUREMENT
/begin MEASUREMENT Sbx_rdn_esp_data_chr "" UBYTE _CNV_A_R_A_105_CM 1 0. 0. 255. DISPLAY_IDENTIFIER fm_sta_eprm_esp_data_chr.fm_static_eprm_bitfield.Sbx_rdn_xxx ECU_ADDRESS 0xd00056c0 BIT_MASK 0x10 /end MEASUREMENT
/begin MEASUREMENT Sbx_mf_esp_data_chr "" UBYTE _CNV_A_R_A_105_CM 1 0. 0. 255. DISPLAY_IDENTIFIER fm_sta_eprm_esp_data_chr.fm_static_eprm_bitfield.Sbx_mf_xxx ECU_ADDRESS 0xd00056c0 BIT_MASK 0x20 /end MEASUREMENT
/begin MEASUREMENT Sbx_cf_esp_data_chr "" UBYTE _CNV_A_R_A_105_CM 1 0. 0. 255. DISPLAY_IDENTIFIER fm_sta_eprm_esp_data_chr.fm_static_eprm_bitfield.Sbx_cf_xxx ECU_ADDRESS 0xd00056c0 BIT_MASK 0x80 /end MEASUREMENT
/begin MEASUREMENT Sbx_dyn_esp_data_seq_ctr "" UBYTE _CNV_A_R_A_105_CM 1 0. 0. 255. DISPLAY_IDENTIFIER fm_sta_eprm_esp_data_seq_ctr.fm_static_eprm_bitfield.Sbx_dyn_xxx ECU_ADDRESS 0xd00056c2 BIT_MASK 0x8 /end MEASUREMENT
/begin MEASUREMENT Sbx_rdn_esp_data_seq_ctr "" UBYTE _CNV_A_R_A_105_CM 1 0. 0. 255. DISPLAY_IDENTIFIER fm_sta_eprm_esp_data_seq_ctr.fm_static_eprm_bitfield.Sbx_rdn_xxx ECU_ADDRESS 0xd00056c2 BIT_MASK 0x10 /end MEASUREMENT
/begin MEASUREMENT Sbx_mf_esp_data_seq_ctr "" UBYTE _CNV_A_R_A_105_CM 1 0. 0. 255. DISPLAY_IDENTIFIER fm_sta_eprm_esp_data_seq_ctr.fm_static_eprm_bitfield.Sbx_mf_xxx ECU_ADDRESS 0xd00056c2 BIT_MASK 0x20 /end MEASUREMENT
/begin MEASUREMENT Sbx_cf_esp_data_seq_ctr "" UBYTE _CNV_A_R_A_105_CM 1 0. 0. 255. DISPLAY_IDENTIFIER fm_sta_eprm_esp_data_seq_ctr.fm_static_eprm_bitfield.Sbx_cf_xxx ECU_ADDRESS 0xd00056c2 BIT_MASK 0x80 /end MEASUREMENT
/begin MEASUREMENT Sbx_dyn_esp_no_frm "" UBYTE _CNV_A_R_A_105_CM 1 0. 0. 255. DISPLAY_IDENTIFIER fm_sta_eprm_esp_no_frm.fm_static_eprm_bitfield.Sbx_dyn_xxx ECU_ADDRESS 0xd00056c4 BIT_MASK 0x8 /end MEASUREMENT
/begin MEASUREMENT Sbx_rdn_esp_no_frm "" UBYTE _CNV_A_R_A_105_CM 1 0. 0. 255. DISPLAY_IDENTIFIER fm_sta_eprm_esp_no_frm.fm_static_eprm_bitfield.Sbx_rdn_xxx ECU_ADDRESS 0xd00056c4 BIT_MASK 0x10 /end MEASUREMENT
/begin MEASUREMENT Sbx_mf_esp_no_frm "" UBYTE _CNV_A_R_A_105_CM 1 0. 0. 255. DISPLAY_IDENTIFIER fm_sta_eprm_esp_no_frm.fm_static_eprm_bitfield.Sbx_mf_xxx ECU_ADDRESS 0xd00056c4 BIT_MASK 0x20 /end MEASUREMENT
/begin MEASUREMENT Sbx_cf_esp_no_frm "" UBYTE _CNV_A_R_A_105_CM 1 0. 0. 255. DISPLAY_IDENTIFIER fm_sta_eprm_esp_no_frm.fm_static_eprm_bitfield.Sbx_cf_xxx ECU_ADDRESS 0xd00056c4 BIT_MASK 0x80 /end MEASUREMENT
/begin MEASUREMENT Sbx_dyn_eva_fcap_abn_cple "" UBYTE _CNV_A_R_A_105_CM 1 0. 0. 255. DISPLAY_IDENTIFIER fm_sta_eprm_eva_fcap_abn_cple.fm_static_eprm_bitfield.Sbx_dyn_xxx ECU_ADDRESS 0xd00057f4 BIT_MASK 0x8 /end MEASUREMENT
/begin MEASUREMENT Sbx_rdn_eva_fcap_abn_cple "" UBYTE _CNV_A_R_A_105_CM 1 0. 0. 255. DISPLAY_IDENTIFIER fm_sta_eprm_eva_fcap_abn_cple.fm_static_eprm_bitfield.Sbx_rdn_xxx ECU_ADDRESS 0xd00057f4 BIT_MASK 0x10 /end MEASUREMENT
/begin MEASUREMENT Sbx_mf_eva_fcap_abn_cple "" UBYTE _CNV_A_R_A_105_CM 1 0. 0. 255. DISPLAY_IDENTIFIER fm_sta_eprm_eva_fcap_abn_cple.fm_static_eprm_bitfield.Sbx_mf_xxx ECU_ADDRESS 0xd00057f4 BIT_MASK 0x20 /end MEASUREMENT
/begin MEASUREMENT Sbx_cf_eva_fcap_abn_cple "" UBYTE _CNV_A_R_A_105_CM 1 0. 0. 255. DISPLAY_IDENTIFIER fm_sta_eprm_eva_fcap_abn_cple.fm_static_eprm_bitfield.Sbx_cf_xxx ECU_ADDRESS 0xd00057f4 BIT_MASK 0x80 /end MEASUREMENT
/begin MEASUREMENT Sbx_dyn_eva_fcap_no_lk "" UBYTE _CNV_A_R_A_105_CM 1 0. 0. 255. DISPLAY_IDENTIFIER fm_sta_eprm_eva_fcap_no_lk.fm_static_eprm_bitfield.Sbx_dyn_xxx ECU_ADDRESS 0xd00057f6 BIT_MASK 0x8 /end MEASUREMENT
/begin MEASUREMENT Sbx_rdn_eva_fcap_no_lk "" UBYTE _CNV_A_R_A_105_CM 1 0. 0. 255. DISPLAY_IDENTIFIER fm_sta_eprm_eva_fcap_no_lk.fm_static_eprm_bitfield.Sbx_rdn_xxx ECU_ADDRESS 0xd00057f6 BIT_MASK 0x10 /end MEASUREMENT
/begin MEASUREMENT Sbx_mf_eva_fcap_no_lk "" UBYTE _CNV_A_R_A_105_CM 1 0. 0. 255. DISPLAY_IDENTIFIER fm_sta_eprm_eva_fcap_no_lk.fm_static_eprm_bitfield.Sbx_mf_xxx ECU_ADDRESS 0xd00057f6 BIT_MASK 0x20 /end MEASUREMENT
/begin MEASUREMENT Sbx_cf_eva_fcap_no_lk "" UBYTE _CNV_A_R_A_105_CM 1 0. 0. 255. DISPLAY_IDENTIFIER fm_sta_eprm_eva_fcap_no_lk.fm_static_eprm_bitfield.Sbx_cf_xxx ECU_ADDRESS 0xd00057f6 BIT_MASK 0x80 /end MEASUREMENT
/begin MEASUREMENT Sbx_dyn_eva_sldv_blk_clos "" UBYTE _CNV_A_R_A_105_CM 1 0. 0. 255. DISPLAY_IDENTIFIER fm_sta_eprm_eva_sldv_blk_clos.fm_static_eprm_bitfield.Sbx_dyn_xxx ECU_ADDRESS 0xd00057fa BIT_MASK 0x8 /end MEASUREMENT
/begin MEASUREMENT Sbx_rdn_eva_sldv_blk_clos "" UBYTE _CNV_A_R_A_105_CM 1 0. 0. 255. DISPLAY_IDENTIFIER fm_sta_eprm_eva_sldv_blk_clos.fm_static_eprm_bitfield.Sbx_rdn_xxx ECU_ADDRESS 0xd00057fa BIT_MASK 0x10 /end MEASUREMENT
/begin MEASUREMENT Sbx_mf_eva_sldv_blk_clos "" UBYTE _CNV_A_R_A_105_CM 1 0. 0. 255. DISPLAY_IDENTIFIER fm_sta_eprm_eva_sldv_blk_clos.fm_static_eprm_bitfield.Sbx_mf_xxx ECU_ADDRESS 0xd00057fa BIT_MASK 0x20 /end MEASUREMENT
/begin MEASUREMENT Sbx_cf_eva_sldv_blk_clos "" UBYTE _CNV_A_R_A_105_CM 1 0. 0. 255. DISPLAY_IDENTIFIER fm_sta_eprm_eva_sldv_blk_clos.fm_static_eprm_bitfield.Sbx_cf_xxx ECU_ADDRESS 0xd00057fa BIT_MASK 0x80 /end MEASUREMENT
/begin MEASUREMENT Sbx_dyn_eva_sldv_oc "" UBYTE _CNV_A_R_A_105_CM 1 0. 0. 255. DISPLAY_IDENTIFIER fm_sta_eprm_eva_sldv_oc.fm_static_eprm_bitfield.Sbx_dyn_xxx ECU_ADDRESS 0xd00057fc BIT_MASK 0x8 /end MEASUREMENT
/begin MEASUREMENT Sbx_rdn_eva_sldv_oc "" UBYTE _CNV_A_R_A_105_CM 1 0. 0. 255. DISPLAY_IDENTIFIER fm_sta_eprm_eva_sldv_oc.fm_static_eprm_bitfield.Sbx_rdn_xxx ECU_ADDRESS 0xd00057fc BIT_MASK 0x10 /end MEASUREMENT
/begin MEASUREMENT Sbx_mf_eva_sldv_oc "" UBYTE _CNV_A_R_A_105_CM 1 0. 0. 255. DISPLAY_IDENTIFIER fm_sta_eprm_eva_sldv_oc.fm_static_eprm_bitfield.Sbx_mf_xxx ECU_ADDRESS 0xd00057fc BIT_MASK 0x20 /end MEASUREMENT
/begin MEASUREMENT Sbx_cf_eva_sldv_oc "" UBYTE _CNV_A_R_A_105_CM 1 0. 0. 255. DISPLAY_IDENTIFIER fm_sta_eprm_eva_sldv_oc.fm_static_eprm_bitfield.Sbx_cf_xxx ECU_ADDRESS 0xd00057fc BIT_MASK 0x80 /end MEASUREMENT
/begin MEASUREMENT Sbx_dyn_eva_sldv_scg "" UBYTE _CNV_A_R_A_105_CM 1 0. 0. 255. DISPLAY_IDENTIFIER fm_sta_eprm_eva_sldv_scg.fm_static_eprm_bitfield.Sbx_dyn_xxx ECU_ADDRESS 0xd00057fe BIT_MASK 0x8 /end MEASUREMENT
/begin MEASUREMENT Sbx_rdn_eva_sldv_scg "" UBYTE _CNV_A_R_A_105_CM 1 0. 0. 255. DISPLAY_IDENTIFIER fm_sta_eprm_eva_sldv_scg.fm_static_eprm_bitfield.Sbx_rdn_xxx ECU_ADDRESS 0xd00057fe BIT_MASK 0x10 /end MEASUREMENT
/begin MEASUREMENT Sbx_mf_eva_sldv_scg "" UBYTE _CNV_A_R_A_105_CM 1 0. 0. 255. DISPLAY_IDENTIFIER fm_sta_eprm_eva_sldv_scg.fm_static_eprm_bitfield.Sbx_mf_xxx ECU_ADDRESS 0xd00057fe BIT_MASK 0x20 /end MEASUREMENT
/begin MEASUREMENT Sbx_cf_eva_sldv_scg "" UBYTE _CNV_A_R_A_105_CM 1 0. 0. 255. DISPLAY_IDENTIFIER fm_sta_eprm_eva_sldv_scg.fm_static_eprm_bitfield.Sbx_cf_xxx ECU_ADDRESS 0xd00057fe BIT_MASK 0x80 /end MEASUREMENT
/begin MEASUREMENT Sbx_dyn_eva_sldv_scw "" UBYTE _CNV_A_R_A_105_CM 1 0. 0. 255. DISPLAY_IDENTIFIER fm_sta_eprm_eva_sldv_scw.fm_static_eprm_bitfield.Sbx_dyn_xxx ECU_ADDRESS 0xd0005800 BIT_MASK 0x8 /end MEASUREMENT
/begin MEASUREMENT Sbx_rdn_eva_sldv_scw "" UBYTE _CNV_A_R_A_105_CM 1 0. 0. 255. DISPLAY_IDENTIFIER fm_sta_eprm_eva_sldv_scw.fm_static_eprm_bitfield.Sbx_rdn_xxx ECU_ADDRESS 0xd0005800 BIT_MASK 0x10 /end MEASUREMENT
/begin MEASUREMENT Sbx_mf_eva_sldv_scw "" UBYTE _CNV_A_R_A_105_CM 1 0. 0. 255. DISPLAY_IDENTIFIER fm_sta_eprm_eva_sldv_scw.fm_static_eprm_bitfield.Sbx_mf_xxx ECU_ADDRESS 0xd0005800 BIT_MASK 0x20 /end MEASUREMENT
/begin MEASUREMENT Sbx_cf_eva_sldv_scw "" UBYTE _CNV_A_R_A_105_CM 1 0. 0. 255. DISPLAY_IDENTIFIER fm_sta_eprm_eva_sldv_scw.fm_static_eprm_bitfield.Sbx_cf_xxx ECU_ADDRESS 0xd0005800 BIT_MASK 0x80 /end MEASUREMENT
/begin MEASUREMENT Sbx_dyn_evap_chr "" UBYTE _CNV_A_R_A_105_CM 1 0. 0. 255. DISPLAY_IDENTIFIER fm_sta_eprm_evap_chr.fm_static_eprm_bitfield.Sbx_dyn_xxx ECU_ADDRESS 0xd00057f2 BIT_MASK 0x8 /end MEASUREMENT
/begin MEASUREMENT Sbx_rdn_evap_chr "" UBYTE _CNV_A_R_A_105_CM 1 0. 0. 255. DISPLAY_IDENTIFIER fm_sta_eprm_evap_chr.fm_static_eprm_bitfield.Sbx_rdn_xxx ECU_ADDRESS 0xd00057f2 BIT_MASK 0x10 /end MEASUREMENT
/begin MEASUREMENT Sbx_mf_evap_chr "" UBYTE _CNV_A_R_A_105_CM 1 0. 0. 255. DISPLAY_IDENTIFIER fm_sta_eprm_evap_chr.fm_static_eprm_bitfield.Sbx_mf_xxx ECU_ADDRESS 0xd00057f2 BIT_MASK 0x20 /end MEASUREMENT
/begin MEASUREMENT Sbx_cf_evap_chr "" UBYTE _CNV_A_R_A_105_CM 1 0. 0. 255. DISPLAY_IDENTIFIER fm_sta_eprm_evap_chr.fm_static_eprm_bitfield.Sbx_cf_xxx ECU_ADDRESS 0xd00057f2 BIT_MASK 0x80 /end MEASUREMENT
/begin MEASUREMENT Sbx_dyn_evap_lkg "" UBYTE _CNV_A_R_A_105_CM 1 0. 0. 255. DISPLAY_IDENTIFIER fm_sta_eprm_evap_lkg.fm_static_eprm_bitfield.Sbx_dyn_xxx ECU_ADDRESS 0xd00057f8 BIT_MASK 0x8 /end MEASUREMENT
/begin MEASUREMENT Sbx_rdn_evap_lkg "" UBYTE _CNV_A_R_A_105_CM 1 0. 0. 255. DISPLAY_IDENTIFIER fm_sta_eprm_evap_lkg.fm_static_eprm_bitfield.Sbx_rdn_xxx ECU_ADDRESS 0xd00057f8 BIT_MASK 0x10 /end MEASUREMENT
/begin MEASUREMENT Sbx_mf_evap_lkg "" UBYTE _CNV_A_R_A_105_CM 1 0. 0. 255. DISPLAY_IDENTIFIER fm_sta_eprm_evap_lkg.fm_static_eprm_bitfield.Sbx_mf_xxx ECU_ADDRESS 0xd00057f8 BIT_MASK 0x20 /end MEASUREMENT
/begin MEASUREMENT Sbx_cf_evap_lkg "" UBYTE _CNV_A_R_A_105_CM 1 0. 0. 255. DISPLAY_IDENTIFIER fm_sta_eprm_evap_lkg.fm_static_eprm_bitfield.Sbx_cf_xxx ECU_ADDRESS 0xd00057f8 BIT_MASK 0x80 /end MEASUREMENT
/begin MEASUREMENT Sbx_dyn_fsys_cpt "" UBYTE _CNV_A_R_A_105_CM 1 0. 0. 255. DISPLAY_IDENTIFIER fm_sta_eprm_fsys_cpt.fm_static_eprm_bitfield.Sbx_dyn_xxx ECU_ADDRESS 0xd0005758 BIT_MASK 0x8 /end MEASUREMENT
/begin MEASUREMENT Sbx_rdn_fsys_cpt "" UBYTE _CNV_A_R_A_105_CM 1 0. 0. 255. DISPLAY_IDENTIFIER fm_sta_eprm_fsys_cpt.fm_static_eprm_bitfield.Sbx_rdn_xxx ECU_ADDRESS 0xd0005758 BIT_MASK 0x10 /end MEASUREMENT
/begin MEASUREMENT Sbx_mf_fsys_cpt "" UBYTE _CNV_A_R_A_105_CM 1 0. 0. 255. DISPLAY_IDENTIFIER fm_sta_eprm_fsys_cpt.fm_static_eprm_bitfield.Sbx_mf_xxx ECU_ADDRESS 0xd0005758 BIT_MASK 0x20 /end MEASUREMENT
/begin MEASUREMENT Sbx_cf_fsys_cpt "" UBYTE _CNV_A_R_A_105_CM 1 0. 0. 255. DISPLAY_IDENTIFIER fm_sta_eprm_fsys_cpt.fm_static_eprm_bitfield.Sbx_cf_xxx ECU_ADDRESS 0xd0005758 BIT_MASK 0x80 /end MEASUREMENT
/begin MEASUREMENT Sbx_dyn_gas_pump_2_oc "" UBYTE _CNV_A_R_A_105_CM 1 0. 0. 255. DISPLAY_IDENTIFIER fm_sta_eprm_gas_pump_2_oc.fm_static_eprm_bitfield.Sbx_dyn_xxx ECU_ADDRESS 0xd0005832 BIT_MASK 0x8 /end MEASUREMENT
/begin MEASUREMENT Sbx_rdn_gas_pump_2_oc "" UBYTE _CNV_A_R_A_105_CM 1 0. 0. 255. DISPLAY_IDENTIFIER fm_sta_eprm_gas_pump_2_oc.fm_static_eprm_bitfield.Sbx_rdn_xxx ECU_ADDRESS 0xd0005832 BIT_MASK 0x10 /end MEASUREMENT
/begin MEASUREMENT Sbx_mf_gas_pump_2_oc "" UBYTE _CNV_A_R_A_105_CM 1 0. 0. 255. DISPLAY_IDENTIFIER fm_sta_eprm_gas_pump_2_oc.fm_static_eprm_bitfield.Sbx_mf_xxx ECU_ADDRESS 0xd0005832 BIT_MASK 0x20 /end MEASUREMENT
/begin MEASUREMENT Sbx_cf_gas_pump_2_oc "" UBYTE _CNV_A_R_A_105_CM 1 0. 0. 255. DISPLAY_IDENTIFIER fm_sta_eprm_gas_pump_2_oc.fm_static_eprm_bitfield.Sbx_cf_xxx ECU_ADDRESS 0xd0005832 BIT_MASK 0x80 /end MEASUREMENT
/begin MEASUREMENT Sbx_dyn_gas_pump_2_scg "" UBYTE _CNV_A_R_A_105_CM 1 0. 0. 255. DISPLAY_IDENTIFIER fm_sta_eprm_gas_pump_2_scg.fm_static_eprm_bitfield.Sbx_dyn_xxx ECU_ADDRESS 0xd0005834 BIT_MASK 0x8 /end MEASUREMENT
/begin MEASUREMENT Sbx_rdn_gas_pump_2_scg "" UBYTE _CNV_A_R_A_105_CM 1 0. 0. 255. DISPLAY_IDENTIFIER fm_sta_eprm_gas_pump_2_scg.fm_static_eprm_bitfield.Sbx_rdn_xxx ECU_ADDRESS 0xd0005834 BIT_MASK 0x10 /end MEASUREMENT
/begin MEASUREMENT Sbx_mf_gas_pump_2_scg "" UBYTE _CNV_A_R_A_105_CM 1 0. 0. 255. DISPLAY_IDENTIFIER fm_sta_eprm_gas_pump_2_scg.fm_static_eprm_bitfield.Sbx_mf_xxx ECU_ADDRESS 0xd0005834 BIT_MASK 0x20 /end MEASUREMENT
/begin MEASUREMENT Sbx_cf_gas_pump_2_scg "" UBYTE _CNV_A_R_A_105_CM 1 0. 0. 255. DISPLAY_IDENTIFIER fm_sta_eprm_gas_pump_2_scg.fm_static_eprm_bitfield.Sbx_cf_xxx ECU_ADDRESS 0xd0005834 BIT_MASK 0x80 /end MEASUREMENT
/begin MEASUREMENT Sbx_dyn_gas_pump_2_scw "" UBYTE _CNV_A_R_A_105_CM 1 0. 0. 255. DISPLAY_IDENTIFIER fm_sta_eprm_gas_pump_2_scw.fm_static_eprm_bitfield.Sbx_dyn_xxx ECU_ADDRESS 0xd0005836 BIT_MASK 0x8 /end MEASUREMENT
/begin MEASUREMENT Sbx_rdn_gas_pump_2_scw "" UBYTE _CNV_A_R_A_105_CM 1 0. 0. 255. DISPLAY_IDENTIFIER fm_sta_eprm_gas_pump_2_scw.fm_static_eprm_bitfield.Sbx_rdn_xxx ECU_ADDRESS 0xd0005836 BIT_MASK 0x10 /end MEASUREMENT
/begin MEASUREMENT Sbx_mf_gas_pump_2_scw "" UBYTE _CNV_A_R_A_105_CM 1 0. 0. 255. DISPLAY_IDENTIFIER fm_sta_eprm_gas_pump_2_scw.fm_static_eprm_bitfield.Sbx_mf_xxx ECU_ADDRESS 0xd0005836 BIT_MASK 0x20 /end MEASUREMENT
/begin MEASUREMENT Sbx_cf_gas_pump_2_scw "" UBYTE _CNV_A_R_A_105_CM 1 0. 0. 255. DISPLAY_IDENTIFIER fm_sta_eprm_gas_pump_2_scw.fm_static_eprm_bitfield.Sbx_cf_xxx ECU_ADDRESS 0xd0005836 BIT_MASK 0x80 /end MEASUREMENT
/begin MEASUREMENT Sbx_dyn_gas_pump_oc "" UBYTE _CNV_A_R_A_105_CM 1 0. 0. 255. DISPLAY_IDENTIFIER fm_sta_eprm_gas_pump_oc.fm_static_eprm_bitfield.Sbx_dyn_xxx ECU_ADDRESS 0xd00056c6 BIT_MASK 0x8 /end MEASUREMENT
/begin MEASUREMENT Sbx_rdn_gas_pump_oc "" UBYTE _CNV_A_R_A_105_CM 1 0. 0. 255. DISPLAY_IDENTIFIER fm_sta_eprm_gas_pump_oc.fm_static_eprm_bitfield.Sbx_rdn_xxx ECU_ADDRESS 0xd00056c6 BIT_MASK 0x10 /end MEASUREMENT
/begin MEASUREMENT Sbx_mf_gas_pump_oc "" UBYTE _CNV_A_R_A_105_CM 1 0. 0. 255. DISPLAY_IDENTIFIER fm_sta_eprm_gas_pump_oc.fm_static_eprm_bitfield.Sbx_mf_xxx ECU_ADDRESS 0xd00056c6 BIT_MASK 0x20 /end MEASUREMENT
/begin MEASUREMENT Sbx_cf_gas_pump_oc "" UBYTE _CNV_A_R_A_105_CM 1 0. 0. 255. DISPLAY_IDENTIFIER fm_sta_eprm_gas_pump_oc.fm_static_eprm_bitfield.Sbx_cf_xxx ECU_ADDRESS 0xd00056c6 BIT_MASK 0x80 /end MEASUREMENT
/begin MEASUREMENT Sbx_dyn_gas_pump_scg "" UBYTE _CNV_A_R_A_105_CM 1 0. 0. 255. DISPLAY_IDENTIFIER fm_sta_eprm_gas_pump_scg.fm_static_eprm_bitfield.Sbx_dyn_xxx ECU_ADDRESS 0xd00056c8 BIT_MASK 0x8 /end MEASUREMENT
/begin MEASUREMENT Sbx_rdn_gas_pump_scg "" UBYTE _CNV_A_R_A_105_CM 1 0. 0. 255. DISPLAY_IDENTIFIER fm_sta_eprm_gas_pump_scg.fm_static_eprm_bitfield.Sbx_rdn_xxx ECU_ADDRESS 0xd00056c8 BIT_MASK 0x10 /end MEASUREMENT
/begin MEASUREMENT Sbx_mf_gas_pump_scg "" UBYTE _CNV_A_R_A_105_CM 1 0. 0. 255. DISPLAY_IDENTIFIER fm_sta_eprm_gas_pump_scg.fm_static_eprm_bitfield.Sbx_mf_xxx ECU_ADDRESS 0xd00056c8 BIT_MASK 0x20 /end MEASUREMENT
/begin MEASUREMENT Sbx_cf_gas_pump_scg "" UBYTE _CNV_A_R_A_105_CM 1 0. 0. 255. DISPLAY_IDENTIFIER fm_sta_eprm_gas_pump_scg.fm_static_eprm_bitfield.Sbx_cf_xxx ECU_ADDRESS 0xd00056c8 BIT_MASK 0x80 /end MEASUREMENT
/begin MEASUREMENT Sbx_dyn_gas_pump_scw "" UBYTE _CNV_A_R_A_105_CM 1 0. 0. 255. DISPLAY_IDENTIFIER fm_sta_eprm_gas_pump_scw.fm_static_eprm_bitfield.Sbx_dyn_xxx ECU_ADDRESS 0xd00056ca BIT_MASK 0x8 /end MEASUREMENT
/begin MEASUREMENT Sbx_rdn_gas_pump_scw "" UBYTE _CNV_A_R_A_105_CM 1 0. 0. 255. DISPLAY_IDENTIFIER fm_sta_eprm_gas_pump_scw.fm_static_eprm_bitfield.Sbx_rdn_xxx ECU_ADDRESS 0xd00056ca BIT_MASK 0x10 /end MEASUREMENT
/begin MEASUREMENT Sbx_mf_gas_pump_scw "" UBYTE _CNV_A_R_A_105_CM 1 0. 0. 255. DISPLAY_IDENTIFIER fm_sta_eprm_gas_pump_scw.fm_static_eprm_bitfield.Sbx_mf_xxx ECU_ADDRESS 0xd00056ca BIT_MASK 0x20 /end MEASUREMENT
/begin MEASUREMENT Sbx_cf_gas_pump_scw "" UBYTE _CNV_A_R_A_105_CM 1 0. 0. 255. DISPLAY_IDENTIFIER fm_sta_eprm_gas_pump_scw.fm_static_eprm_bitfield.Sbx_cf_xxx ECU_ADDRESS 0xd00056ca BIT_MASK 0x80 /end MEASUREMENT
/begin MEASUREMENT Sbx_dyn_igc_1_oc "" UBYTE _CNV_A_R_A_105_CM 1 0. 0. 255. DISPLAY_IDENTIFIER fm_sta_eprm_igc_1_oc.fm_static_eprm_bitfield.Sbx_dyn_xxx ECU_ADDRESS 0xd00057e6 BIT_MASK 0x8 /end MEASUREMENT
/begin MEASUREMENT Sbx_rdn_igc_1_oc "" UBYTE _CNV_A_R_A_105_CM 1 0. 0. 255. DISPLAY_IDENTIFIER fm_sta_eprm_igc_1_oc.fm_static_eprm_bitfield.Sbx_rdn_xxx ECU_ADDRESS 0xd00057e6 BIT_MASK 0x10 /end MEASUREMENT
/begin MEASUREMENT Sbx_mf_igc_1_oc "" UBYTE _CNV_A_R_A_105_CM 1 0. 0. 255. DISPLAY_IDENTIFIER fm_sta_eprm_igc_1_oc.fm_static_eprm_bitfield.Sbx_mf_xxx ECU_ADDRESS 0xd00057e6 BIT_MASK 0x20 /end MEASUREMENT
/begin MEASUREMENT Sbx_cf_igc_1_oc "" UBYTE _CNV_A_R_A_105_CM 1 0. 0. 255. DISPLAY_IDENTIFIER fm_sta_eprm_igc_1_oc.fm_static_eprm_bitfield.Sbx_cf_xxx ECU_ADDRESS 0xd00057e6 BIT_MASK 0x80 /end MEASUREMENT
/begin MEASUREMENT Sbx_dyn_igc_1_scg "" UBYTE _CNV_A_R_A_105_CM 1 0. 0. 255. DISPLAY_IDENTIFIER fm_sta_eprm_igc_1_scg.fm_static_eprm_bitfield.Sbx_dyn_xxx ECU_ADDRESS 0xd00057e8 BIT_MASK 0x8 /end MEASUREMENT
/begin MEASUREMENT Sbx_rdn_igc_1_scg "" UBYTE _CNV_A_R_A_105_CM 1 0. 0. 255. DISPLAY_IDENTIFIER fm_sta_eprm_igc_1_scg.fm_static_eprm_bitfield.Sbx_rdn_xxx ECU_ADDRESS 0xd00057e8 BIT_MASK 0x10 /end MEASUREMENT
/begin MEASUREMENT Sbx_mf_igc_1_scg "" UBYTE _CNV_A_R_A_105_CM 1 0. 0. 255. DISPLAY_IDENTIFIER fm_sta_eprm_igc_1_scg.fm_static_eprm_bitfield.Sbx_mf_xxx ECU_ADDRESS 0xd00057e8 BIT_MASK 0x20 /end MEASUREMENT
/begin MEASUREMENT Sbx_cf_igc_1_scg "" UBYTE _CNV_A_R_A_105_CM 1 0. 0. 255. DISPLAY_IDENTIFIER fm_sta_eprm_igc_1_scg.fm_static_eprm_bitfield.Sbx_cf_xxx ECU_ADDRESS 0xd00057e8 BIT_MASK 0x80 /end MEASUREMENT
/begin MEASUREMENT Sbx_dyn_igc_1_scw "" UBYTE _CNV_A_R_A_105_CM 1 0. 0. 255. DISPLAY_IDENTIFIER fm_sta_eprm_igc_1_scw.fm_static_eprm_bitfield.Sbx_dyn_xxx ECU_ADDRESS 0xd00057ea BIT_MASK 0x8 /end MEASUREMENT
/begin MEASUREMENT Sbx_rdn_igc_1_scw "" UBYTE _CNV_A_R_A_105_CM 1 0. 0. 255. DISPLAY_IDENTIFIER fm_sta_eprm_igc_1_scw.fm_static_eprm_bitfield.Sbx_rdn_xxx ECU_ADDRESS 0xd00057ea BIT_MASK 0x10 /end MEASUREMENT
/begin MEASUREMENT Sbx_mf_igc_1_scw "" UBYTE _CNV_A_R_A_105_CM 1 0. 0. 255. DISPLAY_IDENTIFIER fm_sta_eprm_igc_1_scw.fm_static_eprm_bitfield.Sbx_mf_xxx ECU_ADDRESS 0xd00057ea BIT_MASK 0x20 /end MEASUREMENT
/begin MEASUREMENT Sbx_cf_igc_1_scw "" UBYTE _CNV_A_R_A_105_CM 1 0. 0. 255. DISPLAY_IDENTIFIER fm_sta_eprm_igc_1_scw.fm_static_eprm_bitfield.Sbx_cf_xxx ECU_ADDRESS 0xd00057ea BIT_MASK 0x80 /end MEASUREMENT
/begin MEASUREMENT Sbx_dyn_igc_2_oc "" UBYTE _CNV_A_R_A_105_CM 1 0. 0. 255. DISPLAY_IDENTIFIER fm_sta_eprm_igc_2_oc.fm_static_eprm_bitfield.Sbx_dyn_xxx ECU_ADDRESS 0xd00057ec BIT_MASK 0x8 /end MEASUREMENT
/begin MEASUREMENT Sbx_rdn_igc_2_oc "" UBYTE _CNV_A_R_A_105_CM 1 0. 0. 255. DISPLAY_IDENTIFIER fm_sta_eprm_igc_2_oc.fm_static_eprm_bitfield.Sbx_rdn_xxx ECU_ADDRESS 0xd00057ec BIT_MASK 0x10 /end MEASUREMENT
/begin MEASUREMENT Sbx_mf_igc_2_oc "" UBYTE _CNV_A_R_A_105_CM 1 0. 0. 255. DISPLAY_IDENTIFIER fm_sta_eprm_igc_2_oc.fm_static_eprm_bitfield.Sbx_mf_xxx ECU_ADDRESS 0xd00057ec BIT_MASK 0x20 /end MEASUREMENT
/begin MEASUREMENT Sbx_cf_igc_2_oc "" UBYTE _CNV_A_R_A_105_CM 1 0. 0. 255. DISPLAY_IDENTIFIER fm_sta_eprm_igc_2_oc.fm_static_eprm_bitfield.Sbx_cf_xxx ECU_ADDRESS 0xd00057ec BIT_MASK 0x80 /end MEASUREMENT
/begin MEASUREMENT Sbx_dyn_igc_2_scg "" UBYTE _CNV_A_R_A_105_CM 1 0. 0. 255. DISPLAY_IDENTIFIER fm_sta_eprm_igc_2_scg.fm_static_eprm_bitfield.Sbx_dyn_xxx ECU_ADDRESS 0xd000580e BIT_MASK 0x8 /end MEASUREMENT
/begin MEASUREMENT Sbx_rdn_igc_2_scg "" UBYTE _CNV_A_R_A_105_CM 1 0. 0. 255. DISPLAY_IDENTIFIER fm_sta_eprm_igc_2_scg.fm_static_eprm_bitfield.Sbx_rdn_xxx ECU_ADDRESS 0xd000580e BIT_MASK 0x10 /end MEASUREMENT
/begin MEASUREMENT Sbx_mf_igc_2_scg "" UBYTE _CNV_A_R_A_105_CM 1 0. 0. 255. DISPLAY_IDENTIFIER fm_sta_eprm_igc_2_scg.fm_static_eprm_bitfield.Sbx_mf_xxx ECU_ADDRESS 0xd000580e BIT_MASK 0x20 /end MEASUREMENT
/begin MEASUREMENT Sbx_cf_igc_2_scg "" UBYTE _CNV_A_R_A_105_CM 1 0. 0. 255. DISPLAY_IDENTIFIER fm_sta_eprm_igc_2_scg.fm_static_eprm_bitfield.Sbx_cf_xxx ECU_ADDRESS 0xd000580e BIT_MASK 0x80 /end MEASUREMENT
/begin MEASUREMENT Sbx_dyn_igc_2_scw "" UBYTE _CNV_A_R_A_105_CM 1 0. 0. 255. DISPLAY_IDENTIFIER fm_sta_eprm_igc_2_scw.fm_static_eprm_bitfield.Sbx_dyn_xxx ECU_ADDRESS 0xd0005810 BIT_MASK 0x8 /end MEASUREMENT
/begin MEASUREMENT Sbx_rdn_igc_2_scw "" UBYTE _CNV_A_R_A_105_CM 1 0. 0. 255. DISPLAY_IDENTIFIER fm_sta_eprm_igc_2_scw.fm_static_eprm_bitfield.Sbx_rdn_xxx ECU_ADDRESS 0xd0005810 BIT_MASK 0x10 /end MEASUREMENT
/begin MEASUREMENT Sbx_mf_igc_2_scw "" UBYTE _CNV_A_R_A_105_CM 1 0. 0. 255. DISPLAY_IDENTIFIER fm_sta_eprm_igc_2_scw.fm_static_eprm_bitfield.Sbx_mf_xxx ECU_ADDRESS 0xd0005810 BIT_MASK 0x20 /end MEASUREMENT
/begin MEASUREMENT Sbx_cf_igc_2_scw "" UBYTE _CNV_A_R_A_105_CM 1 0. 0. 255. DISPLAY_IDENTIFIER fm_sta_eprm_igc_2_scw.fm_static_eprm_bitfield.Sbx_cf_xxx ECU_ADDRESS 0xd0005810 BIT_MASK 0x80 /end MEASUREMENT
/begin MEASUREMENT Sbx_dyn_igc_3_oc "" UBYTE _CNV_A_R_A_105_CM 1 0. 0. 255. DISPLAY_IDENTIFIER fm_sta_eprm_igc_3_oc.fm_static_eprm_bitfield.Sbx_dyn_xxx ECU_ADDRESS 0xd0005812 BIT_MASK 0x8 /end MEASUREMENT
/begin MEASUREMENT Sbx_rdn_igc_3_oc "" UBYTE _CNV_A_R_A_105_CM 1 0. 0. 255. DISPLAY_IDENTIFIER fm_sta_eprm_igc_3_oc.fm_static_eprm_bitfield.Sbx_rdn_xxx ECU_ADDRESS 0xd0005812 BIT_MASK 0x10 /end MEASUREMENT
/begin MEASUREMENT Sbx_mf_igc_3_oc "" UBYTE _CNV_A_R_A_105_CM 1 0. 0. 255. DISPLAY_IDENTIFIER fm_sta_eprm_igc_3_oc.fm_static_eprm_bitfield.Sbx_mf_xxx ECU_ADDRESS 0xd0005812 BIT_MASK 0x20 /end MEASUREMENT
/begin MEASUREMENT Sbx_cf_igc_3_oc "" UBYTE _CNV_A_R_A_105_CM 1 0. 0. 255. DISPLAY_IDENTIFIER fm_sta_eprm_igc_3_oc.fm_static_eprm_bitfield.Sbx_cf_xxx ECU_ADDRESS 0xd0005812 BIT_MASK 0x80 /end MEASUREMENT
/begin MEASUREMENT Sbx_dyn_igc_3_scg "" UBYTE _CNV_A_R_A_105_CM 1 0. 0. 255. DISPLAY_IDENTIFIER fm_sta_eprm_igc_3_scg.fm_static_eprm_bitfield.Sbx_dyn_xxx ECU_ADDRESS 0xd0005814 BIT_MASK 0x8 /end MEASUREMENT
/begin MEASUREMENT Sbx_rdn_igc_3_scg "" UBYTE _CNV_A_R_A_105_CM 1 0. 0. 255. DISPLAY_IDENTIFIER fm_sta_eprm_igc_3_scg.fm_static_eprm_bitfield.Sbx_rdn_xxx ECU_ADDRESS 0xd0005814 BIT_MASK 0x10 /end MEASUREMENT
/begin MEASUREMENT Sbx_mf_igc_3_scg "" UBYTE _CNV_A_R_A_105_CM 1 0. 0. 255. DISPLAY_IDENTIFIER fm_sta_eprm_igc_3_scg.fm_static_eprm_bitfield.Sbx_mf_xxx ECU_ADDRESS 0xd0005814 BIT_MASK 0x20 /end MEASUREMENT
/begin MEASUREMENT Sbx_cf_igc_3_scg "" UBYTE _CNV_A_R_A_105_CM 1 0. 0. 255. DISPLAY_IDENTIFIER fm_sta_eprm_igc_3_scg.fm_static_eprm_bitfield.Sbx_cf_xxx ECU_ADDRESS 0xd0005814 BIT_MASK 0x80 /end MEASUREMENT
/begin MEASUREMENT Sbx_dyn_igc_3_scw "" UBYTE _CNV_A_R_A_105_CM 1 0. 0. 255. DISPLAY_IDENTIFIER fm_sta_eprm_igc_3_scw.fm_static_eprm_bitfield.Sbx_dyn_xxx ECU_ADDRESS 0xd0005816 BIT_MASK 0x8 /end MEASUREMENT
/begin MEASUREMENT Sbx_rdn_igc_3_scw "" UBYTE _CNV_A_R_A_105_CM 1 0. 0. 255. DISPLAY_IDENTIFIER fm_sta_eprm_igc_3_scw.fm_static_eprm_bitfield.Sbx_rdn_xxx ECU_ADDRESS 0xd0005816 BIT_MASK 0x10 /end MEASUREMENT
/begin MEASUREMENT Sbx_mf_igc_3_scw "" UBYTE _CNV_A_R_A_105_CM 1 0. 0. 255. DISPLAY_IDENTIFIER fm_sta_eprm_igc_3_scw.fm_static_eprm_bitfield.Sbx_mf_xxx ECU_ADDRESS 0xd0005816 BIT_MASK 0x20 /end MEASUREMENT
/begin MEASUREMENT Sbx_cf_igc_3_scw "" UBYTE _CNV_A_R_A_105_CM 1 0. 0. 255. DISPLAY_IDENTIFIER fm_sta_eprm_igc_3_scw.fm_static_eprm_bitfield.Sbx_cf_xxx ECU_ADDRESS 0xd0005816 BIT_MASK 0x80 /end MEASUREMENT
/begin MEASUREMENT Sbx_dyn_igc_4_oc "" UBYTE _CNV_A_R_A_105_CM 1 0. 0. 255. DISPLAY_IDENTIFIER fm_sta_eprm_igc_4_oc.fm_static_eprm_bitfield.Sbx_dyn_xxx ECU_ADDRESS 0xd0005818 BIT_MASK 0x8 /end MEASUREMENT
/begin MEASUREMENT Sbx_rdn_igc_4_oc "" UBYTE _CNV_A_R_A_105_CM 1 0. 0. 255. DISPLAY_IDENTIFIER fm_sta_eprm_igc_4_oc.fm_static_eprm_bitfield.Sbx_rdn_xxx ECU_ADDRESS 0xd0005818 BIT_MASK 0x10 /end MEASUREMENT
/begin MEASUREMENT Sbx_mf_igc_4_oc "" UBYTE _CNV_A_R_A_105_CM 1 0. 0. 255. DISPLAY_IDENTIFIER fm_sta_eprm_igc_4_oc.fm_static_eprm_bitfield.Sbx_mf_xxx ECU_ADDRESS 0xd0005818 BIT_MASK 0x20 /end MEASUREMENT
/begin MEASUREMENT Sbx_cf_igc_4_oc "" UBYTE _CNV_A_R_A_105_CM 1 0. 0. 255. DISPLAY_IDENTIFIER fm_sta_eprm_igc_4_oc.fm_static_eprm_bitfield.Sbx_cf_xxx ECU_ADDRESS 0xd0005818 BIT_MASK 0x80 /end MEASUREMENT
/begin MEASUREMENT Sbx_dyn_igc_4_scg "" UBYTE _CNV_A_R_A_105_CM 1 0. 0. 255. DISPLAY_IDENTIFIER fm_sta_eprm_igc_4_scg.fm_static_eprm_bitfield.Sbx_dyn_xxx ECU_ADDRESS 0xd000581a BIT_MASK 0x8 /end MEASUREMENT
/begin MEASUREMENT Sbx_rdn_igc_4_scg "" UBYTE _CNV_A_R_A_105_CM 1 0. 0. 255. DISPLAY_IDENTIFIER fm_sta_eprm_igc_4_scg.fm_static_eprm_bitfield.Sbx_rdn_xxx ECU_ADDRESS 0xd000581a BIT_MASK 0x10 /end MEASUREMENT
/begin MEASUREMENT Sbx_mf_igc_4_scg "" UBYTE _CNV_A_R_A_105_CM 1 0. 0. 255. DISPLAY_IDENTIFIER fm_sta_eprm_igc_4_scg.fm_static_eprm_bitfield.Sbx_mf_xxx ECU_ADDRESS 0xd000581a BIT_MASK 0x20 /end MEASUREMENT
/begin MEASUREMENT Sbx_cf_igc_4_scg "" UBYTE _CNV_A_R_A_105_CM 1 0. 0. 255. DISPLAY_IDENTIFIER fm_sta_eprm_igc_4_scg.fm_static_eprm_bitfield.Sbx_cf_xxx ECU_ADDRESS 0xd000581a BIT_MASK 0x80 /end MEASUREMENT
/begin MEASUREMENT Sbx_dyn_igc_4_scw "" UBYTE _CNV_A_R_A_105_CM 1 0. 0. 255. DISPLAY_IDENTIFIER fm_sta_eprm_igc_4_scw.fm_static_eprm_bitfield.Sbx_dyn_xxx ECU_ADDRESS 0xd000581c BIT_MASK 0x8 /end MEASUREMENT
/begin MEASUREMENT Sbx_rdn_igc_4_scw "" UBYTE _CNV_A_R_A_105_CM 1 0. 0. 255. DISPLAY_IDENTIFIER fm_sta_eprm_igc_4_scw.fm_static_eprm_bitfield.Sbx_rdn_xxx ECU_ADDRESS 0xd000581c BIT_MASK 0x10 /end MEASUREMENT
/begin MEASUREMENT Sbx_mf_igc_4_scw "" UBYTE _CNV_A_R_A_105_CM 1 0. 0. 255. DISPLAY_IDENTIFIER fm_sta_eprm_igc_4_scw.fm_static_eprm_bitfield.Sbx_mf_xxx ECU_ADDRESS 0xd000581c BIT_MASK 0x20 /end MEASUREMENT
/begin MEASUREMENT Sbx_cf_igc_4_scw "" UBYTE _CNV_A_R_A_105_CM 1 0. 0. 255. DISPLAY_IDENTIFIER fm_sta_eprm_igc_4_scw.fm_static_eprm_bitfield.Sbx_cf_xxx ECU_ADDRESS 0xd000581c BIT_MASK 0x80 /end MEASUREMENT
/begin MEASUREMENT Sbx_dyn_in_cam_chr "" UBYTE _CNV_A_R_A_105_CM 1 0. 0. 255. DISPLAY_IDENTIFIER fm_sta_eprm_in_cam_chr.fm_static_eprm_bitfield.Sbx_dyn_xxx ECU_ADDRESS 0xd00057b2 BIT_MASK 0x8 /end MEASUREMENT
/begin MEASUREMENT Sbx_rdn_in_cam_chr "" UBYTE _CNV_A_R_A_105_CM 1 0. 0. 255. DISPLAY_IDENTIFIER fm_sta_eprm_in_cam_chr.fm_static_eprm_bitfield.Sbx_rdn_xxx ECU_ADDRESS 0xd00057b2 BIT_MASK 0x10 /end MEASUREMENT
/begin MEASUREMENT Sbx_mf_in_cam_chr "" UBYTE _CNV_A_R_A_105_CM 1 0. 0. 255. DISPLAY_IDENTIFIER fm_sta_eprm_in_cam_chr.fm_static_eprm_bitfield.Sbx_mf_xxx ECU_ADDRESS 0xd00057b2 BIT_MASK 0x20 /end MEASUREMENT
/begin MEASUREMENT Sbx_cf_in_cam_chr "" UBYTE _CNV_A_R_A_105_CM 1 0. 0. 255. DISPLAY_IDENTIFIER fm_sta_eprm_in_cam_chr.fm_static_eprm_bitfield.Sbx_cf_xxx ECU_ADDRESS 0xd00057b2 BIT_MASK 0x80 /end MEASUREMENT
/begin MEASUREMENT Sbx_dyn_in_cam_crk_cmp "" UBYTE _CNV_A_R_A_105_CM 1 0. 0. 255. DISPLAY_IDENTIFIER fm_sta_eprm_in_cam_crk_cmp.fm_static_eprm_bitfield.Sbx_dyn_xxx ECU_ADDRESS 0xd00057b4 BIT_MASK 0x8 /end MEASUREMENT
/begin MEASUREMENT Sbx_rdn_in_cam_crk_cmp "" UBYTE _CNV_A_R_A_105_CM 1 0. 0. 255. DISPLAY_IDENTIFIER fm_sta_eprm_in_cam_crk_cmp.fm_static_eprm_bitfield.Sbx_rdn_xxx ECU_ADDRESS 0xd00057b4 BIT_MASK 0x10 /end MEASUREMENT
/begin MEASUREMENT Sbx_mf_in_cam_crk_cmp "" UBYTE _CNV_A_R_A_105_CM 1 0. 0. 255. DISPLAY_IDENTIFIER fm_sta_eprm_in_cam_crk_cmp.fm_static_eprm_bitfield.Sbx_mf_xxx ECU_ADDRESS 0xd00057b4 BIT_MASK 0x20 /end MEASUREMENT
/begin MEASUREMENT Sbx_cf_in_cam_crk_cmp "" UBYTE _CNV_A_R_A_105_CM 1 0. 0. 255. DISPLAY_IDENTIFIER fm_sta_eprm_in_cam_crk_cmp.fm_static_eprm_bitfield.Sbx_cf_xxx ECU_ADDRESS 0xd00057b4 BIT_MASK 0x80 /end MEASUREMENT
/begin MEASUREMENT Sbx_dyn_in_cam_cyc "" UBYTE _CNV_A_R_A_105_CM 1 0. 0. 255. DISPLAY_IDENTIFIER fm_sta_eprm_in_cam_cyc.fm_static_eprm_bitfield.Sbx_dyn_xxx ECU_ADDRESS 0xd00057d4 BIT_MASK 0x8 /end MEASUREMENT
/begin MEASUREMENT Sbx_rdn_in_cam_cyc "" UBYTE _CNV_A_R_A_105_CM 1 0. 0. 255. DISPLAY_IDENTIFIER fm_sta_eprm_in_cam_cyc.fm_static_eprm_bitfield.Sbx_rdn_xxx ECU_ADDRESS 0xd00057d4 BIT_MASK 0x10 /end MEASUREMENT
/begin MEASUREMENT Sbx_mf_in_cam_cyc "" UBYTE _CNV_A_R_A_105_CM 1 0. 0. 255. DISPLAY_IDENTIFIER fm_sta_eprm_in_cam_cyc.fm_static_eprm_bitfield.Sbx_mf_xxx ECU_ADDRESS 0xd00057d4 BIT_MASK 0x20 /end MEASUREMENT
/begin MEASUREMENT Sbx_cf_in_cam_cyc "" UBYTE _CNV_A_R_A_105_CM 1 0. 0. 255. DISPLAY_IDENTIFIER fm_sta_eprm_in_cam_cyc.fm_static_eprm_bitfield.Sbx_cf_xxx ECU_ADDRESS 0xd00057d4 BIT_MASK 0x80 /end MEASUREMENT
/begin MEASUREMENT Sbx_dyn_in_cam_no_sig "" UBYTE _CNV_A_R_A_105_CM 1 0. 0. 255. DISPLAY_IDENTIFIER fm_sta_eprm_in_cam_no_sig.fm_static_eprm_bitfield.Sbx_dyn_xxx ECU_ADDRESS 0xd00057b6 BIT_MASK 0x8 /end MEASUREMENT
/begin MEASUREMENT Sbx_rdn_in_cam_no_sig "" UBYTE _CNV_A_R_A_105_CM 1 0. 0. 255. DISPLAY_IDENTIFIER fm_sta_eprm_in_cam_no_sig.fm_static_eprm_bitfield.Sbx_rdn_xxx ECU_ADDRESS 0xd00057b6 BIT_MASK 0x10 /end MEASUREMENT
/begin MEASUREMENT Sbx_mf_in_cam_no_sig "" UBYTE _CNV_A_R_A_105_CM 1 0. 0. 255. DISPLAY_IDENTIFIER fm_sta_eprm_in_cam_no_sig.fm_static_eprm_bitfield.Sbx_mf_xxx ECU_ADDRESS 0xd00057b6 BIT_MASK 0x20 /end MEASUREMENT
/begin MEASUREMENT Sbx_cf_in_cam_no_sig "" UBYTE _CNV_A_R_A_105_CM 1 0. 0. 255. DISPLAY_IDENTIFIER fm_sta_eprm_in_cam_no_sig.fm_static_eprm_bitfield.Sbx_cf_xxx ECU_ADDRESS 0xd00057b6 BIT_MASK 0x80 /end MEASUREMENT
/begin MEASUREMENT Sbx_dyn_in_cam_nok "" UBYTE _CNV_A_R_A_105_CM 1 0. 0. 255. DISPLAY_IDENTIFIER fm_sta_eprm_in_cam_nok.fm_static_eprm_bitfield.Sbx_dyn_xxx ECU_ADDRESS 0xd00057d2 BIT_MASK 0x8 /end MEASUREMENT
/begin MEASUREMENT Sbx_rdn_in_cam_nok "" UBYTE _CNV_A_R_A_105_CM 1 0. 0. 255. DISPLAY_IDENTIFIER fm_sta_eprm_in_cam_nok.fm_static_eprm_bitfield.Sbx_rdn_xxx ECU_ADDRESS 0xd00057d2 BIT_MASK 0x10 /end MEASUREMENT
/begin MEASUREMENT Sbx_mf_in_cam_nok "" UBYTE _CNV_A_R_A_105_CM 1 0. 0. 255. DISPLAY_IDENTIFIER fm_sta_eprm_in_cam_nok.fm_static_eprm_bitfield.Sbx_mf_xxx ECU_ADDRESS 0xd00057d2 BIT_MASK 0x20 /end MEASUREMENT
/begin MEASUREMENT Sbx_cf_in_cam_nok "" UBYTE _CNV_A_R_A_105_CM 1 0. 0. 255. DISPLAY_IDENTIFIER fm_sta_eprm_in_cam_nok.fm_static_eprm_bitfield.Sbx_cf_xxx ECU_ADDRESS 0xd00057d2 BIT_MASK 0x80 /end MEASUREMENT
/begin MEASUREMENT Sbx_dyn_in_vvtc_ad "" UBYTE _CNV_A_R_A_105_CM 1 0. 0. 255. DISPLAY_IDENTIFIER fm_sta_eprm_in_vvtc_ad.fm_static_eprm_bitfield.Sbx_dyn_xxx ECU_ADDRESS 0xd00057b8 BIT_MASK 0x8 /end MEASUREMENT
/begin MEASUREMENT Sbx_rdn_in_vvtc_ad "" UBYTE _CNV_A_R_A_105_CM 1 0. 0. 255. DISPLAY_IDENTIFIER fm_sta_eprm_in_vvtc_ad.fm_static_eprm_bitfield.Sbx_rdn_xxx ECU_ADDRESS 0xd00057b8 BIT_MASK 0x10 /end MEASUREMENT
/begin MEASUREMENT Sbx_mf_in_vvtc_ad "" UBYTE _CNV_A_R_A_105_CM 1 0. 0. 255. DISPLAY_IDENTIFIER fm_sta_eprm_in_vvtc_ad.fm_static_eprm_bitfield.Sbx_mf_xxx ECU_ADDRESS 0xd00057b8 BIT_MASK 0x20 /end MEASUREMENT
/begin MEASUREMENT Sbx_cf_in_vvtc_ad "" UBYTE _CNV_A_R_A_105_CM 1 0. 0. 255. DISPLAY_IDENTIFIER fm_sta_eprm_in_vvtc_ad.fm_static_eprm_bitfield.Sbx_cf_xxx ECU_ADDRESS 0xd00057b8 BIT_MASK 0x80 /end MEASUREMENT
/begin MEASUREMENT Sbx_dyn_in_vvtc_blk "" UBYTE _CNV_A_R_A_105_CM 1 0. 0. 255. DISPLAY_IDENTIFIER fm_sta_eprm_in_vvtc_blk.fm_static_eprm_bitfield.Sbx_dyn_xxx ECU_ADDRESS 0xd00056cc BIT_MASK 0x8 /end MEASUREMENT
/begin MEASUREMENT Sbx_rdn_in_vvtc_blk "" UBYTE _CNV_A_R_A_105_CM 1 0. 0. 255. DISPLAY_IDENTIFIER fm_sta_eprm_in_vvtc_blk.fm_static_eprm_bitfield.Sbx_rdn_xxx ECU_ADDRESS 0xd00056cc BIT_MASK 0x10 /end MEASUREMENT
/begin MEASUREMENT Sbx_mf_in_vvtc_blk "" UBYTE _CNV_A_R_A_105_CM 1 0. 0. 255. DISPLAY_IDENTIFIER fm_sta_eprm_in_vvtc_blk.fm_static_eprm_bitfield.Sbx_mf_xxx ECU_ADDRESS 0xd00056cc BIT_MASK 0x20 /end MEASUREMENT
/begin MEASUREMENT Sbx_cf_in_vvtc_blk "" UBYTE _CNV_A_R_A_105_CM 1 0. 0. 255. DISPLAY_IDENTIFIER fm_sta_eprm_in_vvtc_blk.fm_static_eprm_bitfield.Sbx_cf_xxx ECU_ADDRESS 0xd00056cc BIT_MASK 0x80 /end MEASUREMENT
/begin MEASUREMENT Sbx_dyn_in_vvtc_dirt_lkg "" UBYTE _CNV_A_R_A_105_CM 1 0. 0. 255. DISPLAY_IDENTIFIER fm_sta_eprm_in_vvtc_dirt_lkg.fm_static_eprm_bitfield.Sbx_dyn_xxx ECU_ADDRESS 0xd00056ce BIT_MASK 0x8 /end MEASUREMENT
/begin MEASUREMENT Sbx_rdn_in_vvtc_dirt_lkg "" UBYTE _CNV_A_R_A_105_CM 1 0. 0. 255. DISPLAY_IDENTIFIER fm_sta_eprm_in_vvtc_dirt_lkg.fm_static_eprm_bitfield.Sbx_rdn_xxx ECU_ADDRESS 0xd00056ce BIT_MASK 0x10 /end MEASUREMENT
/begin MEASUREMENT Sbx_mf_in_vvtc_dirt_lkg "" UBYTE _CNV_A_R_A_105_CM 1 0. 0. 255. DISPLAY_IDENTIFIER fm_sta_eprm_in_vvtc_dirt_lkg.fm_static_eprm_bitfield.Sbx_mf_xxx ECU_ADDRESS 0xd00056ce BIT_MASK 0x20 /end MEASUREMENT
/begin MEASUREMENT Sbx_cf_in_vvtc_dirt_lkg "" UBYTE _CNV_A_R_A_105_CM 1 0. 0. 255. DISPLAY_IDENTIFIER fm_sta_eprm_in_vvtc_dirt_lkg.fm_static_eprm_bitfield.Sbx_cf_xxx ECU_ADDRESS 0xd00056ce BIT_MASK 0x80 /end MEASUREMENT
/begin MEASUREMENT Sbx_dyn_in_vvtc_sldv_oc "" UBYTE _CNV_A_R_A_105_CM 1 0. 0. 255. DISPLAY_IDENTIFIER fm_sta_eprm_in_vvtc_sldv_oc.fm_static_eprm_bitfield.Sbx_dyn_xxx ECU_ADDRESS 0xd00056d0 BIT_MASK 0x8 /end MEASUREMENT
/begin MEASUREMENT Sbx_rdn_in_vvtc_sldv_oc "" UBYTE _CNV_A_R_A_105_CM 1 0. 0. 255. DISPLAY_IDENTIFIER fm_sta_eprm_in_vvtc_sldv_oc.fm_static_eprm_bitfield.Sbx_rdn_xxx ECU_ADDRESS 0xd00056d0 BIT_MASK 0x10 /end MEASUREMENT
/begin MEASUREMENT Sbx_mf_in_vvtc_sldv_oc "" UBYTE _CNV_A_R_A_105_CM 1 0. 0. 255. DISPLAY_IDENTIFIER fm_sta_eprm_in_vvtc_sldv_oc.fm_static_eprm_bitfield.Sbx_mf_xxx ECU_ADDRESS 0xd00056d0 BIT_MASK 0x20 /end MEASUREMENT
/begin MEASUREMENT Sbx_cf_in_vvtc_sldv_oc "" UBYTE _CNV_A_R_A_105_CM 1 0. 0. 255. DISPLAY_IDENTIFIER fm_sta_eprm_in_vvtc_sldv_oc.fm_static_eprm_bitfield.Sbx_cf_xxx ECU_ADDRESS 0xd00056d0 BIT_MASK 0x80 /end MEASUREMENT
/begin MEASUREMENT Sbx_dyn_in_vvtc_sldv_scg "" UBYTE _CNV_A_R_A_105_CM 1 0. 0. 255. DISPLAY_IDENTIFIER fm_sta_eprm_in_vvtc_sldv_scg.fm_static_eprm_bitfield.Sbx_dyn_xxx ECU_ADDRESS 0xd00056d2 BIT_MASK 0x8 /end MEASUREMENT
/begin MEASUREMENT Sbx_rdn_in_vvtc_sldv_scg "" UBYTE _CNV_A_R_A_105_CM 1 0. 0. 255. DISPLAY_IDENTIFIER fm_sta_eprm_in_vvtc_sldv_scg.fm_static_eprm_bitfield.Sbx_rdn_xxx ECU_ADDRESS 0xd00056d2 BIT_MASK 0x10 /end MEASUREMENT
/begin MEASUREMENT Sbx_mf_in_vvtc_sldv_scg "" UBYTE _CNV_A_R_A_105_CM 1 0. 0. 255. DISPLAY_IDENTIFIER fm_sta_eprm_in_vvtc_sldv_scg.fm_static_eprm_bitfield.Sbx_mf_xxx ECU_ADDRESS 0xd00056d2 BIT_MASK 0x20 /end MEASUREMENT
/begin MEASUREMENT Sbx_cf_in_vvtc_sldv_scg "" UBYTE _CNV_A_R_A_105_CM 1 0. 0. 255. DISPLAY_IDENTIFIER fm_sta_eprm_in_vvtc_sldv_scg.fm_static_eprm_bitfield.Sbx_cf_xxx ECU_ADDRESS 0xd00056d2 BIT_MASK 0x80 /end MEASUREMENT
/begin MEASUREMENT Sbx_dyn_in_vvtc_sldv_scw "" UBYTE _CNV_A_R_A_105_CM 1 0. 0. 255. DISPLAY_IDENTIFIER fm_sta_eprm_in_vvtc_sldv_scw.fm_static_eprm_bitfield.Sbx_dyn_xxx ECU_ADDRESS 0xd00056d4 BIT_MASK 0x8 /end MEASUREMENT
/begin MEASUREMENT Sbx_rdn_in_vvtc_sldv_scw "" UBYTE _CNV_A_R_A_105_CM 1 0. 0. 255. DISPLAY_IDENTIFIER fm_sta_eprm_in_vvtc_sldv_scw.fm_static_eprm_bitfield.Sbx_rdn_xxx ECU_ADDRESS 0xd00056d4 BIT_MASK 0x10 /end MEASUREMENT
/begin MEASUREMENT Sbx_mf_in_vvtc_sldv_scw "" UBYTE _CNV_A_R_A_105_CM 1 0. 0. 255. DISPLAY_IDENTIFIER fm_sta_eprm_in_vvtc_sldv_scw.fm_static_eprm_bitfield.Sbx_mf_xxx ECU_ADDRESS 0xd00056d4 BIT_MASK 0x20 /end MEASUREMENT
/begin MEASUREMENT Sbx_cf_in_vvtc_sldv_scw "" UBYTE _CNV_A_R_A_105_CM 1 0. 0. 255. DISPLAY_IDENTIFIER fm_sta_eprm_in_vvtc_sldv_scw.fm_static_eprm_bitfield.Sbx_cf_xxx ECU_ADDRESS 0xd00056d4 BIT_MASK 0x80 /end MEASUREMENT
/begin MEASUREMENT Sbx_dyn_inj1_oc "" UBYTE _CNV_A_R_A_105_CM 1 0. 0. 255. DISPLAY_IDENTIFIER fm_sta_eprm_inj1_oc.fm_static_eprm_bitfield.Sbx_dyn_xxx ECU_ADDRESS 0xd00056da BIT_MASK 0x8 /end MEASUREMENT
/begin MEASUREMENT Sbx_rdn_inj1_oc "" UBYTE _CNV_A_R_A_105_CM 1 0. 0. 255. DISPLAY_IDENTIFIER fm_sta_eprm_inj1_oc.fm_static_eprm_bitfield.Sbx_rdn_xxx ECU_ADDRESS 0xd00056da BIT_MASK 0x10 /end MEASUREMENT
/begin MEASUREMENT Sbx_mf_inj1_oc "" UBYTE _CNV_A_R_A_105_CM 1 0. 0. 255. DISPLAY_IDENTIFIER fm_sta_eprm_inj1_oc.fm_static_eprm_bitfield.Sbx_mf_xxx ECU_ADDRESS 0xd00056da BIT_MASK 0x20 /end MEASUREMENT
/begin MEASUREMENT Sbx_cf_inj1_oc "" UBYTE _CNV_A_R_A_105_CM 1 0. 0. 255. DISPLAY_IDENTIFIER fm_sta_eprm_inj1_oc.fm_static_eprm_bitfield.Sbx_cf_xxx ECU_ADDRESS 0xd00056da BIT_MASK 0x80 /end MEASUREMENT
/begin MEASUREMENT Sbx_dyn_inj1_scg "" UBYTE _CNV_A_R_A_105_CM 1 0. 0. 255. DISPLAY_IDENTIFIER fm_sta_eprm_inj1_scg.fm_static_eprm_bitfield.Sbx_dyn_xxx ECU_ADDRESS 0xd00056dc BIT_MASK 0x8 /end MEASUREMENT
/begin MEASUREMENT Sbx_rdn_inj1_scg "" UBYTE _CNV_A_R_A_105_CM 1 0. 0. 255. DISPLAY_IDENTIFIER fm_sta_eprm_inj1_scg.fm_static_eprm_bitfield.Sbx_rdn_xxx ECU_ADDRESS 0xd00056dc BIT_MASK 0x10 /end MEASUREMENT
/begin MEASUREMENT Sbx_mf_inj1_scg "" UBYTE _CNV_A_R_A_105_CM 1 0. 0. 255. DISPLAY_IDENTIFIER fm_sta_eprm_inj1_scg.fm_static_eprm_bitfield.Sbx_mf_xxx ECU_ADDRESS 0xd00056dc BIT_MASK 0x20 /end MEASUREMENT
/begin MEASUREMENT Sbx_cf_inj1_scg "" UBYTE _CNV_A_R_A_105_CM 1 0. 0. 255. DISPLAY_IDENTIFIER fm_sta_eprm_inj1_scg.fm_static_eprm_bitfield.Sbx_cf_xxx ECU_ADDRESS 0xd00056dc BIT_MASK 0x80 /end MEASUREMENT
/begin MEASUREMENT Sbx_dyn_inj1_scw "" UBYTE _CNV_A_R_A_105_CM 1 0. 0. 255. DISPLAY_IDENTIFIER fm_sta_eprm_inj1_scw.fm_static_eprm_bitfield.Sbx_dyn_xxx ECU_ADDRESS 0xd00056de BIT_MASK 0x8 /end MEASUREMENT
/begin MEASUREMENT Sbx_rdn_inj1_scw "" UBYTE _CNV_A_R_A_105_CM 1 0. 0. 255. DISPLAY_IDENTIFIER fm_sta_eprm_inj1_scw.fm_static_eprm_bitfield.Sbx_rdn_xxx ECU_ADDRESS 0xd00056de BIT_MASK 0x10 /end MEASUREMENT
/begin MEASUREMENT Sbx_mf_inj1_scw "" UBYTE _CNV_A_R_A_105_CM 1 0. 0. 255. DISPLAY_IDENTIFIER fm_sta_eprm_inj1_scw.fm_static_eprm_bitfield.Sbx_mf_xxx ECU_ADDRESS 0xd00056de BIT_MASK 0x20 /end MEASUREMENT
/begin MEASUREMENT Sbx_cf_inj1_scw "" UBYTE _CNV_A_R_A_105_CM 1 0. 0. 255. DISPLAY_IDENTIFIER fm_sta_eprm_inj1_scw.fm_static_eprm_bitfield.Sbx_cf_xxx ECU_ADDRESS 0xd00056de BIT_MASK 0x80 /end MEASUREMENT
/begin MEASUREMENT Sbx_dyn_inj2_oc "" UBYTE _CNV_A_R_A_105_CM 1 0. 0. 255. DISPLAY_IDENTIFIER fm_sta_eprm_inj2_oc.fm_static_eprm_bitfield.Sbx_dyn_xxx ECU_ADDRESS 0xd00056e0 BIT_MASK 0x8 /end MEASUREMENT
/begin MEASUREMENT Sbx_rdn_inj2_oc "" UBYTE _CNV_A_R_A_105_CM 1 0. 0. 255. DISPLAY_IDENTIFIER fm_sta_eprm_inj2_oc.fm_static_eprm_bitfield.Sbx_rdn_xxx ECU_ADDRESS 0xd00056e0 BIT_MASK 0x10 /end MEASUREMENT
/begin MEASUREMENT Sbx_mf_inj2_oc "" UBYTE _CNV_A_R_A_105_CM 1 0. 0. 255. DISPLAY_IDENTIFIER fm_sta_eprm_inj2_oc.fm_static_eprm_bitfield.Sbx_mf_xxx ECU_ADDRESS 0xd00056e0 BIT_MASK 0x20 /end MEASUREMENT
/begin MEASUREMENT Sbx_cf_inj2_oc "" UBYTE _CNV_A_R_A_105_CM 1 0. 0. 255. DISPLAY_IDENTIFIER fm_sta_eprm_inj2_oc.fm_static_eprm_bitfield.Sbx_cf_xxx ECU_ADDRESS 0xd00056e0 BIT_MASK 0x80 /end MEASUREMENT
/begin MEASUREMENT Sbx_dyn_inj2_scg "" UBYTE _CNV_A_R_A_105_CM 1 0. 0. 255. DISPLAY_IDENTIFIER fm_sta_eprm_inj2_scg.fm_static_eprm_bitfield.Sbx_dyn_xxx ECU_ADDRESS 0xd00056e2 BIT_MASK 0x8 /end MEASUREMENT
/begin MEASUREMENT Sbx_rdn_inj2_scg "" UBYTE _CNV_A_R_A_105_CM 1 0. 0. 255. DISPLAY_IDENTIFIER fm_sta_eprm_inj2_scg.fm_static_eprm_bitfield.Sbx_rdn_xxx ECU_ADDRESS 0xd00056e2 BIT_MASK 0x10 /end MEASUREMENT
/begin MEASUREMENT Sbx_mf_inj2_scg "" UBYTE _CNV_A_R_A_105_CM 1 0. 0. 255. DISPLAY_IDENTIFIER fm_sta_eprm_inj2_scg.fm_static_eprm_bitfield.Sbx_mf_xxx ECU_ADDRESS 0xd00056e2 BIT_MASK 0x20 /end MEASUREMENT
/begin MEASUREMENT Sbx_cf_inj2_scg "" UBYTE _CNV_A_R_A_105_CM 1 0. 0. 255. DISPLAY_IDENTIFIER fm_sta_eprm_inj2_scg.fm_static_eprm_bitfield.Sbx_cf_xxx ECU_ADDRESS 0xd00056e2 BIT_MASK 0x80 /end MEASUREMENT
/begin MEASUREMENT Sbx_dyn_inj2_scw "" UBYTE _CNV_A_R_A_105_CM 1 0. 0. 255. DISPLAY_IDENTIFIER fm_sta_eprm_inj2_scw.fm_static_eprm_bitfield.Sbx_dyn_xxx ECU_ADDRESS 0xd00056e4 BIT_MASK 0x8 /end MEASUREMENT
/begin MEASUREMENT Sbx_rdn_inj2_scw "" UBYTE _CNV_A_R_A_105_CM 1 0. 0. 255. DISPLAY_IDENTIFIER fm_sta_eprm_inj2_scw.fm_static_eprm_bitfield.Sbx_rdn_xxx ECU_ADDRESS 0xd00056e4 BIT_MASK 0x10 /end MEASUREMENT
/begin MEASUREMENT Sbx_mf_inj2_scw "" UBYTE _CNV_A_R_A_105_CM 1 0. 0. 255. DISPLAY_IDENTIFIER fm_sta_eprm_inj2_scw.fm_static_eprm_bitfield.Sbx_mf_xxx ECU_ADDRESS 0xd00056e4 BIT_MASK 0x20 /end MEASUREMENT
/begin MEASUREMENT Sbx_cf_inj2_scw "" UBYTE _CNV_A_R_A_105_CM 1 0. 0. 255. DISPLAY_IDENTIFIER fm_sta_eprm_inj2_scw.fm_static_eprm_bitfield.Sbx_cf_xxx ECU_ADDRESS 0xd00056e4 BIT_MASK 0x80 /end MEASUREMENT
/begin MEASUREMENT Sbx_dyn_inj3_oc "" UBYTE _CNV_A_R_A_105_CM 1 0. 0. 255. DISPLAY_IDENTIFIER fm_sta_eprm_inj3_oc.fm_static_eprm_bitfield.Sbx_dyn_xxx ECU_ADDRESS 0xd00056e6 BIT_MASK 0x8 /end MEASUREMENT
/begin COMPU_METHOD _CNV_A_R_ECME_LINEA_0_CM "" RAT_FUNC "%6.3" "-" COEFFS 0 1. 0. 0 0 1 /end COMPU_METHOD
/begin COMPU_METHOD _CNV_A_R_LINEAR_____2_CM "" RAT_FUNC "%6.3" "rpm" COEFFS 0 3.125e-002 0. 0 0 1 /end COMPU_METHOD
/begin COMPU_METHOD _CNV_S_2_RANGE______3_CM "" TAB_VERB "%6.3" "-" COMPU_TAB_REF _CNV_S_2_RANGE______3 /end COMPU_METHOD
/begin COMPU_VTAB _CNV_S_2_RANGE______3 "" TAB_VERB 2 0 "0" 1 "1" /end COMPU_VTAB
/begin COMPU_METHOD _CNV_A_R_ENSD_LINEA_22_CM "" RAT_FUNC "%6.3" "rpm" COEFFS 0 4. 0. 0 0 1 /end COMPU_METHOD
/begin COMPU_METHOD _CNV_A_R_LINEAR_____32_CM "" RAT_FUNC "%6.3" "s" COEFFS 0 100. 0. 0 0 1 /end COMPU_METHOD
/begin COMPU_METHOD _CNV_A_R_LINEAR_____71_CM "" RAT_FUNC "%6.3" "km/h" COEFFS 0 1. 0. 0 0 1 /end COMPU_METHOD
/begin COMPU_METHOD _CNV_A_R_A_105_CM "" RAT_FUNC "%6.3" "" COEFFS 0 1. 0. 0 0 1 /end COMPU_METHOD
/begin COMPU_METHOD _CNV_A_R_LINEAR_____107_CM "" RAT_FUNC "%6.3" "mV" COEFFS 0 1. 0. 0 0 1 /end COMPU_METHOD
/begin COMPU_METHOD _CNV_A_R_LINEAR_____165_CM "" RAT_FUNC "%6.3" "%" COEFFS 0 2.55 0. 0 0 1 /end COMPU_METHOD
/begin COMPU_METHOD _CNV_S_3_STATUS_OK__179_CM "" TAB_VERB "%6.3" "-" COMPU_TAB_REF _CNV_S_3_STATUS_OK__179 /end COMPU_METHOD
/begin COMPU_VTAB _CNV_S_3_STATUS_OK__179 "" TAB_VERB 3 0 "Nsx_vld_nok_0" 1 "Nsx_vld_ok_1" 2 "Nsx_vld_fail_2" /end COMPU_VTAB
/begin COMPU_METHOD _CNV_A_R_LINEAR_____201_CM "" RAT_FUNC "%6.3" "ms" COEFFS 0 1. 0. 0 0 1 /end COMPU_METHOD
/begin COMPU_METHOD _CNV_A_R_LINEAR_____205_CM "" RAT_FUNC "%6.3" "V" COEFFS 0 100. 0. 0 0 1 /end COMPU_METHOD
/begin COMPU_METHOD _CNV_S_3_STATUS_OK__213_CM "" TAB_VERB "%6.3" "" COMPU_TAB_REF _CNV_S_3_STATUS_OK__213 /end COMPU_METHOD
/begin COMPU_VTAB _CNV_S_3_STATUS_OK__213 "" TAB_VERB 3 0 "Nsx_vld_nok_0" 1 "Nsx_vld_ok_1" 2 "Nsx_vld_fail_2" /end COMPU_VTAB
/begin COMPU_METHOD _CNV_S_2_STATUS_OK__241_CM "" TAB_VERB "%6.3" "" COMPU_TAB_REF _CNV_S_2_STATUS_OK__241 /end COMPU_METHOD
/begin COMPU_VTAB _CNV_S_2_STATUS_OK__241 "" TAB_VERB 2 0 "Nsx_vld_nok_0" 1 "Nsx_vld_ok_1" /end COMPU_VTAB
/begin COMPU_METHOD _CNV_A_R_LINEAR_____266_CM "" RAT_FUNC "%6.3" "-" COEFFS 0 1023. 0. 0 0 1 /end COMPU_METHOD
/begin COMPU_METHOD _CNV_A_R_LINEAR_____267_CM "" RAT_FUNC "%6.3" "%" COEFFS 0 800. 0. 0 0 1 /end COMPU_METHOD
/begin COMPU_METHOD _CNV_A_R_LINEAR_____268_CM "" RAT_FUNC "%6.3" "%/s" COEFFS 0 1023. 0. 0 0 1 /end COMPU_METHOD
/begin COMPU_METHOD _CNV_S_2_STATUS_OK__269_CM "" TAB_VERB "%6.3" "-" COMPU_TAB_REF _CNV_S_2_STATUS_OK__269 /end COMPU_METHOD
/begin COMPU_VTAB _CNV_S_2_STATUS_OK__269 "" TAB_VERB 2 0 "Nsx_vld_nok_0" 1 "Nsx_vld_ok_1" /end COMPU_VTAB
/begin RECORD_LAYOUT _REC_S1VAL_20_u1 FNC_VALUES 1 UBYTE COLUMN_DIR DIRECT /end RECORD_LAYOUT
/begin RECORD_LAYOUT _REC_S1VAL_20_u2 FNC_VALUES 1 UWORD COLUMN_DIR DIRECT /end RECORD_LAYOUT
/begin RECORD_LAYOUT _REC_A2AXS_20_u2 NO_AXIS_PTS_X 1 UWORD AXIS_PTS_X 2 UWORD INDEX_INCR DIRECT /end RECORD_LAYOUT
/begin RECORD_LAYOUT _REC_A1CUR_20_u2_u2 FNC_VALUES 1 UWORD COLUMN_DIR DIRECT /end RECORD_LAYOUT
/begin FUNCTION InPciApi_Pedinxx ""
 /begin DEF_CHARACTERISTIC Cxx_acel_pdl_0_rat_v_nok Cxx_acel_pdl_0_rat_v_ok Cxx_acel_pdl_100_rat_v_hys Cxx_acel_pdl_100_rat_v_max_nok Cxx_acel_pdl_100_rat_v_max_ok Cxx_acel_pdl_100_rat_v_nok Cxx_acel_pdl_100_rat_v_ok Cxx_acel_pdl_kd_hys Cxx_acel_pdl_kd_in_thd_nok Cxx_acel_pdl_kd_in_thd_ok /end DEF_CHARACTERISTIC
 /begin OUT_MEASUREMENT Vbx_acel_pdl_100_rat Vbx_acel_pdl_kd Vsx_acel_pdl_rat_vld Vxx_acel_pdl_0_rat_v Vxx_acel_pdl_100_rat_v Vxx_acel_pdl_100_rat_v_max Vxx_acel_pdl_kd_in_thd Vxx_acel_pdl_rat /end OUT_MEASUREMENT
/end FUNCTION
/begin FUNCTION InPciApi_Sftpdxx ""
 /begin DEF_CHARACTERISTIC Cbx_acel_pdl_secu_2_cfm Cbx_acel_pdl_secu_acc_cfm Cbx_acel_pdl_secu_esp_cfm Cxx_acel_pdl_secu_2_inc_1 Cxx_acel_pdl_secu_2_inc_2 Cxx_acel_pdl_secu_2_thd Cxx_acel_pdl_secu_2_vs_thd Cxx_acel_pdl_secu_dly1 Cxx_acel_pdl_secu_dly2 Cxx_acel_pdl_secu_flu_thd Cxx_acel_pdl_secu_n_thd Cxx_acel_pdl_secu_thd Cxx_acel_pdl_secu_vs_thd Cxx_dfdec_acel_pdl_secu_2 /end DEF_CHARACTERISTIC
 /begin OUT_MEASUREMENT Vxx_acel_pdl_secu_ctr Vbx_acel_pdl_secu_cdn_1 Vbx_acel_pdl_secu_cdn_2 Vbx_acel_pdl_secu_det Vbx_df_acel_pdl_secu_1 Vbx_df_acel_pdl_secu_2 Vbx_diag_ena_acel_pdl_secu_2 /end OUT_MEASUREMENT
/end FUNCTION
/begin FUNCTION InPciApi_Pedxxxx ""
 /begin DEF_CHARACTERISTIC Ctb_acel_pdl_v_max_dif Ctp_acel_pdl_v_max_dif Cxx_acel_pdl_lih_sub_v Cxx_acel_pdl_v1_max_thd Cxx_acel_pdl_v1_min_thd Cxx_acel_pdl_v1_v2_fac Cxx_acel_pdl_v2_max_thd Cxx_acel_pdl_v2_min_thd Cxx_dfdec_acel_pdl_chr Cxx_dfdec_acel_pdl_tot Cxx_dfdec_acel_pdl_v1 Cxx_dfdec_acel_pdl_v2 Cxx_dfinc_acel_pdl_chr Cxx_dfinc_acel_pdl_tot Cxx_dfinc_acel_pdl_v1 Cxx_dfinc_acel_pdl_v2 /end DEF_CHARACTERISTIC
 /begin OUT_MEASUREMENT Vbx_acel_pdl_sens1_ok Vbx_det_acel_pdl_rdcy_loss Vbx_df_acel_pdl_chr Vbx_df_acel_pdl_tot Vbx_df_acel_pdl_v1_h Vbx_df_acel_pdl_v1_l Vbx_df_acel_pdl_v2_h Vbx_df_acel_pdl_v2_l Vbx_diag_ena_acel_pdl_chr Vbx_fail_pws_acel_pdl_v1 Vbx_fail_pws_acel_pdl_v2 Vbx_loss_acel_pdl_v1 Vsx_acel_pdl_sens_v1_vld Vsx_acel_pdl_v_vld Vxx_acel_pdl_sens_v Vxx_acel_pdl_v /end OUT_MEASUREMENT
/end FUNCTION
/begin FUNCTION InVfiEmi ""
 /begin SUB_FUNCTION InVfiEmi_Batxxxx InVfiEmi_Altdfcs InVfiEmi_Bduxxbc InVfiEmi_Altdfsr /end SUB_FUNCTION
/end FUNCTION
/begin FUNCTION InVfiEmi_Batxxxx ""
 /begin DEF_CHARACTERISTIC Cxx_dfdec_vb_h Cxx_dfdec_vb_l Cxx_dfdec_vb_rly_oc_scg Cxx_dfdec_vb_rly_scw Cxx_dfinc_vb_h Cxx_dfinc_vb_l Cxx_dfinc_vb_rly_oc_scg Cxx_dfinc_vb_rly_scw Cxx_mv_vb_fac Cxx_thd_n_diag_vb_h Cxx_thd_n_diag_vb_l Cxx_thd_vb_h Cxx_thd_vb_l /end DEF_CHARACTERISTIC
 /begin OUT_MEASUREMENT Vbx_df_vb_h Vbx_df_vb_l Vbx_diag_ena_vb_h Vbx_diag_ena_vb_l Vsx_vb_rly_vld Vsx_vb_vld Vxx_mv_vb Vxx_vb /end OUT_MEASUREMENT
/end FUNCTION
/begin FUNCTION InVfiEmi_Altdfcs ""
 /begin DEF_CHARACTERISTIC Cbx_mux_alt_pwm_cfm Cxx_alt_pwm_l Cxx_alt_pwm_sub Cxx_mux_alt_pwm_fil_t /end DEF_CHARACTERISTIC
 /begin OUT_MEASUREMENT Vsx_alt_pwm_vld Vxx_alt_pwm /end OUT_MEASUREMENT
/end FUNCTION
/begin FUNCTION InVfiEmi_Bduxxbc "" /begin OUT_MEASUREMENT Vbx_bdu_ope /end OUT_MEASUREMENT /end FUNCTION
/begin FUNCTION InVfiEmi_Altdfsr "" /begin OUT_MEASUREMENT Vsx_sens_alt_fil_pwm_vld Vxx_sens_alt_fil_pwm /end OUT_MEASUREMENT /end FUNCTION
/begin FUNCTION DgDftCfg ""
 /begin OUT_MEASUREMENT Vxx_dfctr_ac_prs_h Vxx_rdn_ac_prs_h Vbx_cf_ac_prs_h Vbx_clf_ac_prs_h Vbx_df_old_ac_prs_h Vbx_dfctr_sat_ac_prs_h Vbx_rdn_ac_prs_h Vxx_dtc_stt_ac_prs_h Vxx_dfctr_ac_prs_l Vxx_rdn_ac_prs_l Vbx_cf_ac_prs_l Vbx_clf_ac_prs_l Vbx_df_old_ac_prs_l Vbx_dfctr_sat_ac_prs_l Vbx_rdn_ac_prs_l Vxx_dtc_stt_ac_prs_l Vxx_dfctr_acel_pdl_chr Vxx_rdn_acel_pdl_chr Vbx_cf_acel_pdl_chr Vbx_clf_acel_pdl_chr Vbx_df_old_acel_pdl_chr Vbx_dfctr_sat_acel_pdl_chr Vbx_rdn_acel_pdl_chr Vxx_dtc_stt_acel_pdl_chr Vxx_dfctr_acel_pdl_secu_1 Vxx_rdn_acel_pdl_secu_1 Vbx_cf_acel_pdl_secu_1 Vbx_clf_acel_pdl_secu_1 Vbx_df_old_acel_pdl_secu_1 Vbx_dfctr_sat_acel_pdl_secu_1 Vbx_rdn_acel_pdl_secu_1 Vxx_dtc_stt_acel_pdl_secu_1 Vxx_dfctr_acel_pdl_secu_2 Vxx_rdn_acel_pdl_secu_2 Vbx_cf_acel_pdl_secu_2 Vbx_clf_acel_pdl_secu_2 Vbx_df_old_acel_pdl_secu_2 Vbx_dfctr_sat_acel_pdl_secu_2 Vbx_rdn_acel_pdl_secu_2 Vxx_dtc_stt_acel_pdl_secu_2 Vxx_dfctr_acel_pdl_tot Vxx_rdn_acel_pdl_tot Vbx_cf_acel_pdl_tot Vbx_clf_acel_pdl_tot Vbx_df_old_acel_pdl_tot Vbx_dfctr_sat_acel_pdl_tot Vbx_rdn_acel_pdl_tot Vxx_dtc_stt_acel_pdl_tot Vxx_dfctr_acel_pdl_v1_h Vxx_rdn_acel_pdl_v1_h Vbx_cf_acel_pdl_v1_h Vbx_clf_acel_pdl_v1_h Vbx_df_old_acel_pdl_v1_h Vbx_dfctr_sat_acel_pdl_v1_h Vbx_rdn_acel_pdl_v1_h Vxx_dtc_stt_acel_pdl_v1_h Vxx_dfctr_acel_pdl_v1_l Vxx_rdn_acel_pdl_v1_l Vbx_cf_acel_pdl_v1_l Vbx_clf_acel_pdl_v1_l Vbx_df_old_acel_pdl_v1_l Vbx_dfctr_sat_acel_pdl_v1_l Vbx_rdn_acel_pdl_v1_l Vxx_dtc_stt_acel_pdl_v1_l Vxx_dfctr_acel_pdl_v2_h Vxx_rdn_acel_pdl_v2_h Vbx_cf_acel_pdl_v2_h Vbx_clf_acel_pdl_v2_h Vbx_df_old_acel_pdl_v2_h Vbx_dfctr_sat_acel_pdl_v2_h Vbx_rdn_acel_pdl_v2_h Vxx_dtc_stt_acel_pdl_v2_h Vxx_dfctr_acel_pdl_v2_l Vxx_rdn_acel_pdl_v2_l Vbx_cf_acel_pdl_v2_l Vbx_clf_acel_pdl_v2_l Vbx_df_old_acel_pdl_v2_l Vbx_dfctr_sat_acel_pdl_v2_l Vbx_rdn_acel_pdl_v2_l Vxx_dtc_stt_acel_pdl_v2_l Vxx_dfctr_actr_rly_oc Vxx_rdn_actr_rly_oc Vbx_cf_actr_rly_oc Vbx_clf_actr_rly_oc Vbx_df_old_actr_rly_oc Vbx_dfctr_sat_actr_rly_oc Vbx_rdn_actr_rly_oc Vxx_dtc_stt_actr_rly_oc Vxx_dfctr_actr_rly_scg Vxx_rdn_actr_rly_scg Vbx_cf_actr_rly_scg Vbx_clf_actr_rly_scg Vbx_df_old_actr_rly_scg Vbx_dfctr_sat_actr_rly_scg Vbx_rdn_actr_rly_scg Vxx_dtc_stt_actr_rly_scg Vxx_dfctr_actr_rly_scw Vxx_rdn_actr_rly_scw Vbx_cf_actr_rly_scw Vbx_clf_actr_rly_scw Vbx_df_old_actr_rly_scw Vbx_dfctr_sat_actr_rly_scw Vbx_rdn_actr_rly_scw Vxx_dtc_stt_actr_rly_scw Vxx_dfctr_agb_data_chr Vxx_rdn_agb_data_chr Vbx_cf_agb_data_chr Vbx_clf_agb_data_chr Vbx_df_old_agb_data_chr Vbx_dfctr_sat_agb_data_chr Vbx_rdn_agb_data_chr Vxx_dtc_stt_agb_data_chr Vxx_dfctr_agb_data_seq_ctr Vxx_rdn_agb_data_seq_ctr Vbx_cf_agb_data_seq_ctr Vbx_clf_agb_data_seq_ctr Vbx_df_old_agb_data_seq_ctr Vbx_dfctr_sat_agb_data_seq_ctr Vbx_rdn_agb_data_seq_ctr Vxx_dtc_stt_agb_data_seq_ctr Vxx_dfctr_agb_data_tout Vxx_rdn_agb_data_tout Vbx_cf_agb_data_tout Vbx_clf_agb_data_tout Vbx_df_old_agb_data_tout Vbx_dfctr_sat_agb_data_tout Vbx_rdn_agb_data_tout Vxx_dtc_stt_agb_data_tout Vxx_dfctr_agb_no_frm Vxx_rdn_agb_no_frm Vbx_cf_agb_no_frm Vbx_clf_agb_no_frm Vbx_df_old_agb_no_frm Vbx_dfctr_sat_agb_no_frm Vbx_rdn_agb_no_frm Vxx_dtc_stt_agb_no_frm Vxx_dfctr_bgin_clu_cmp Vxx_rdn_bgin_clu_cmp Vbx_cf_bgin_clu_cmp Vbx_clf_bgin_clu_cmp Vbx_df_old_bgin_clu_cmp Vbx_dfctr_sat_bgin_clu_cmp Vbx_rdn_bgin_clu_cmp Vxx_dtc_stt_bgin_clu_cmp Vxx_dfctr_bgin_clu_nok Vxx_rdn_bgin_clu_nok Vbx_cf_bgin_clu_nok Vbx_clf_bgin_clu_nok Vbx_df_old_bgin_clu_nok Vbx_dfctr_sat_bgin_clu_nok Vbx_rdn_bgin_clu_nok Vxx_dtc_stt_bgin_clu_nok Vxx_dfctr_brk_pdl_cmp Vxx_rdn_brk_pdl_cmp Vbx_cf_brk_pdl_cmp Vbx_clf_brk_pdl_cmp Vbx_df_old_brk_pdl_cmp Vbx_dfctr_sat_brk_pdl_cmp Vbx_rdn_brk_pdl_cmp Vxx_dtc_stt_brk_pdl_cmp Vxx_dfctr_cata_cpt Vxx_rdn_cata_cpt Vbx_cf_cata_cpt Vbx_clf_cata_cpt Vbx_df_old_cata_cpt Vbx_dfctr_sat_cata_cpt Vbx_rdn_cata_cpt Vxx_dtc_stt_cata_cpt Vxx_dfctr_cl_rich_chr Vxx_rdn_cl_rich_chr Vbx_cf_cl_rich_chr Vbx_clf_cl_rich_chr Vbx_df_old_cl_rich_chr Vbx_dfctr_sat_cl_rich_chr Vbx_rdn_cl_rich_chr Vxx_dtc_stt_cl_rich_chr Vxx_dfctr_clu_cnt_nok Vxx_rdn_clu_cnt_nok Vbx_cf_clu_cnt_nok Vbx_clf_clu_cnt_nok Vbx_df_old_clu_cnt_nok Vbx_dfctr_sat_clu_cnt_nok Vbx_rdn_clu_cnt_nok Vxx_dtc_stt_clu_cnt_nok Vxx_dfctr_cp_blk_open Vxx_rdn_cp_blk_open Vbx_cf_cp_blk_open Vbx_clf_cp_blk_open Vbx_df_old_cp_blk_open Vbx_dfctr_sat_cp_blk_open Vbx_rdn_cp_blk_open Vxx_dtc_stt_cp_blk_open Vxx_dfctr_cp_oc Vxx_rdn_cp_oc Vbx_cf_cp_oc Vbx_clf_cp_oc Vbx_df_old_cp_oc Vbx_dfctr_sat_cp_oc Vbx_rdn_cp_oc Vxx_dtc_stt_cp_oc Vxx_dfctr_cp_scg Vxx_rdn_cp_scg Vbx_cf_cp_scg Vbx_clf_cp_scg Vbx_df_old_cp_scg Vbx_dfctr_sat_cp_scg Vbx_rdn_cp_scg Vxx_dtc_stt_cp_scg Vxx_dfctr_cp_scw Vxx_rdn_cp_scw Vbx_cf_cp_scw Vbx_clf_cp_scw Vbx_df_old_cp_scw Vbx_dfctr_sat_cp_scw Vbx_rdn_cp_scw Vxx_dtc_stt_cp_scw Vxx_dfctr_crk_chr Vxx_rdn_crk_chr Vbx_cf_crk_chr Vbx_clf_crk_chr Vbx_df_old_crk_chr Vbx_dfctr_sat_crk_chr Vbx_rdn_crk_chr Vxx_dtc_stt_crk_chr Vxx_dfctr_crk_cmp Vxx_rdn_crk_cmp Vbx_cf_crk_cmp Vbx_clf_crk_cmp Vbx_df_old_crk_cmp Vbx_dfctr_sat_crk_cmp Vbx_rdn_crk_cmp Vxx_dtc_stt_crk_cmp Vxx_dfctr_crk_cyc Vxx_rdn_crk_cyc Vbx_cf_crk_cyc Vbx_clf_crk_cyc Vbx_df_old_crk_cyc Vbx_dfctr_sat_crk_cyc Vbx_rdn_crk_cyc Vxx_dtc_stt_crk_cyc Vxx_dfctr_crk_no_sig Vxx_rdn_crk_no_sig Vbx_cf_crk_no_sig Vbx_clf_crk_no_sig Vbx_df_old_crk_no_sig Vbx_dfctr_sat_crk_no_sig Vbx_rdn_crk_no_sig Vxx_dtc_stt_crk_no_sig Vxx_dfctr_crk_oc Vxx_rdn_crk_oc Vbx_cf_crk_oc Vbx_clf_crk_oc Vbx_df_old_crk_oc Vbx_dfctr_sat_crk_oc Vbx_rdn_crk_oc Vxx_dtc_stt_crk_oc Vxx_dfctr_crk_shp Vxx_rdn_crk_shp Vbx_cf_crk_shp Vbx_clf_crk_shp Vbx_df_old_crk_shp Vbx_dfctr_sat_crk_shp Vbx_rdn_crk_shp Vxx_dtc_stt_crk_shp Vxx_dfctr_cru_cmp Vxx_rdn_cru_cmp Vbx_cf_cru_cmp Vbx_clf_cru_cmp Vbx_df_old_cru_cmp Vbx_dfctr_sat_cru_cmp Vbx_rdn_cru_cmp Vxx_dtc_stt_cru_cmp Vxx_dfctr_cru_sl_swi_chr Vxx_rdn_cru_sl_swi_chr Vbx_cf_cru_sl_swi_chr Vbx_clf_cru_sl_swi_chr Vbx_df_old_cru_sl_swi_chr Vbx_dfctr_sat_cru_sl_swi_chr Vbx_rdn_cru_sl_swi_chr Vxx_dtc_stt_cru_sl_swi_chr Vxx_dfctr_cru_sl_tot Vxx_rdn_cru_sl_tot Vbx_cf_cru_sl_tot Vbx_clf_cru_sl_tot Vbx_df_old_cru_sl_tot Vbx_dfctr_sat_cru_sl_tot Vbx_rdn_cru_sl_tot Vxx_dtc_stt_cru_sl_tot Vxx_dfctr_cru_vs_cmp Vxx_rdn_cru_vs_cmp Vbx_cf_cru_vs_cmp Vbx_clf_cru_vs_cmp Vbx_df_old_cru_vs_cmp Vbx_dfctr_sat_cru_vs_cmp Vbx_rdn_cru_vs_cmp Vxx_dtc_stt_cru_vs_cmp Vxx_dfctr_cru_whl_cmd_nok Vxx_rdn_cru_whl_cmd_nok Vbx_cf_cru_whl_cmd_nok Vbx_clf_cru_whl_cmd_nok Vbx_df_old_cru_whl_cmd_nok Vbx_dfctr_sat_cru_whl_cmd_nok Vbx_rdn_cru_whl_cmd_nok Vxx_dtc_stt_cru_whl_cmd_nok Vxx_dfctr_cru_whl_cmd_oc_scw Vxx_rdn_cru_whl_cmd_oc_scw Vbx_cf_cru_whl_cmd_oc_scw Vbx_clf_cru_whl_cmd_oc_scw Vbx_df_old_cru_whl_cmd_oc_scw Vbx_dfctr_sat_cru_whl_cmd_oc_scw Vbx_rdn_cru_whl_cmd_oc_scw Vxx_dtc_stt_cru_whl_cmd_oc_scw Vxx_dfctr_cru_whl_cmd_oor Vxx_rdn_cru_whl_cmd_oor Vbx_cf_cru_whl_cmd_oor Vbx_clf_cru_whl_cmd_oor Vbx_df_old_cru_whl_cmd_oor Vbx_dfctr_sat_cru_whl_cmd_oor Vbx_rdn_cru_whl_cmd_oor Vxx_dtc_stt_cru_whl_cmd_oor Vxx_dfctr_ecm_adc_tron Vxx_rdn_ecm_adc_tron Vbx_cf_ecm_adc_tron Vbx_clf_ecm_adc_tron Vbx_df_old_ecm_adc_tron Vbx_dfctr_sat_ecm_adc_tron Vbx_rdn_ecm_adc_tron Vxx_dtc_stt_ecm_adc_tron Vxx_dfctr_ecm_err_itl Vxx_rdn_ecm_err_itl Vbx_cf_ecm_err_itl Vbx_clf_ecm_err_itl Vbx_df_old_ecm_err_itl Vbx_dfctr_sat_ecm_err_itl Vbx_rdn_ecm_err_itl Vxx_dtc_stt_ecm_err_itl Vxx_dfctr_ecm_mon_secu_1 Vxx_rdn_ecm_mon_secu_1 Vbx_cf_ecm_mon_secu_1 Vbx_clf_ecm_mon_secu_1 Vbx_df_old_ecm_mon_secu_1 Vbx_dfctr_sat_ecm_mon_secu_1 Vbx_rdn_ecm_mon_secu_1 Vxx_dtc_stt_ecm_mon_secu_1 Vxx_dfctr_ecm_mon_secu_2 Vxx_rdn_ecm_mon_secu_2 Vbx_cf_ecm_mon_secu_2 Vbx_clf_ecm_mon_secu_2 Vbx_df_old_ecm_mon_secu_2 Vbx_dfctr_sat_ecm_mon_secu_2 Vbx_rdn_ecm_mon_secu_2 Vxx_dtc_stt_ecm_mon_secu_2 Vxx_dfctr_ecm_mon_tron Vxx_rdn_ecm_mon_tron Vbx_cf_ecm_mon_tron Vbx_clf_ecm_mon_tron Vbx_df_old_ecm_mon_tron Vbx_dfctr_sat_ecm_mon_tron Vbx_rdn_ecm_mon_tron Vxx_dtc_stt_ecm_mon_tron Vxx_dfctr_efi_sldv_2_oc Vxx_rdn_efi_sldv_2_oc Vbx_cf_efi_sldv_2_oc Vbx_clf_efi_sldv_2_oc Vbx_df_old_efi_sldv_2_oc Vbx_dfctr_sat_efi_sldv_2_oc Vbx_rdn_efi_sldv_2_oc Vxx_dtc_stt_efi_sldv_2_oc Vxx_dfctr_efi_sldv_2_scg Vxx_rdn_efi_sldv_2_scg Vbx_cf_efi_sldv_2_scg Vbx_clf_efi_sldv_2_scg Vbx_df_old_efi_sldv_2_scg Vbx_dfctr_sat_efi_sldv_2_scg Vbx_rdn_efi_sldv_2_scg Vxx_dtc_stt_efi_sldv_2_scg Vxx_dfctr_efi_sldv_2_scw Vxx_rdn_efi_sldv_2_scw Vbx_cf_efi_sldv_2_scw Vbx_clf_efi_sldv_2_scw Vbx_df_old_efi_sldv_2_scw Vbx_dfctr_sat_efi_sldv_2_scw Vbx_rdn_efi_sldv_2_scw Vxx_dtc_stt_efi_sldv_2_scw Sbx_dyn_ac_prs_h Sbx_rdn_ac_prs_h Sbx_mf_ac_prs_h Sbx_cf_ac_prs_h Sbx_dyn_ac_prs_l Sbx_rdn_ac_prs_l Sbx_mf_ac_prs_l Sbx_cf_ac_prs_l Sbx_dyn_acel_pdl_chr Sbx_rdn_acel_pdl_chr Sbx_mf_acel_pdl_chr Sbx_cf_acel_pdl_chr Sbx_dyn_acel_pdl_secu_1 Sbx_rdn_acel_pdl_secu_1 Sbx_mf_acel_pdl_secu_1 Sbx_cf_acel_pdl_secu_1 Sbx_dyn_acel_pdl_secu_2 Sbx_rdn_acel_pdl_secu_2 Sbx_mf_acel_pdl_secu_2 Sbx_cf_acel_pdl_secu_2 Sbx_dyn_acel_pdl_tot Sbx_rdn_acel_pdl_tot Sbx_mf_acel_pdl_tot Sbx_cf_acel_pdl_tot Sbx_dyn_acel_pdl_v1_h Sbx_rdn_acel_pdl_v1_h Sbx_mf_acel_pdl_v1_h Sbx_cf_acel_pdl_v1_h Sbx_dyn_acel_pdl_v1_l Sbx_rdn_acel_pdl_v1_l Sbx_mf_acel_pdl_v1_l Sbx_cf_acel_pdl_v1_l Sbx_dyn_acel_pdl_v2_h Sbx_rdn_acel_pdl_v2_h Sbx_mf_acel_pdl_v2_h Sbx_cf_acel_pdl_v2_h Sbx_dyn_acel_pdl_v2_l Sbx_rdn_acel_pdl_v2_l Sbx_mf_acel_pdl_v2_l Sbx_cf_acel_pdl_v2_l Sbx_dyn_actr_rly_oc Sbx_rdn_actr_rly_oc Sbx_mf_actr_rly_oc Sbx_cf_actr_rly_oc Sbx_dyn_actr_rly_scg Sbx_rdn_actr_rly_scg Sbx_mf_actr_rly_scg Sbx_cf_actr_rly_scg Sbx_dyn_actr_rly_scw Sbx_rdn_actr_rly_scw Sbx_mf_actr_rly_scw Sbx_cf_actr_rly_scw Sbx_dyn_agb_data_chr Sbx_rdn_agb_data_chr Sbx_mf_agb_data_chr Sbx_cf_agb_data_chr Sbx_dyn_agb_data_seq_ctr Sbx_rdn_agb_data_seq_ctr Sbx_mf_agb_data_seq_ctr Sbx_cf_agb_data_seq_ctr Sbx_dyn_agb_data_tout Sbx_rdn_agb_data_tout Sbx_mf_agb_data_tout Sbx_cf_agb_data_tout Sbx_dyn_agb_no_frm Sbx_rdn_agb_no_frm Sbx_mf_agb_no_frm Sbx_cf_agb_no_frm Sbx_dyn_bgin_clu_cmp Sbx_rdn_bgin_clu_cmp Sbx_mf_bgin_clu_cmp Sbx_cf_bgin_clu_cmp Sbx_dyn_bgin_clu_nok Sbx_rdn_bgin_clu_nok Sbx_mf_bgin_clu_nok Sbx_cf_bgin_clu_nok Sbx_dyn_brk_pdl_cmp Sbx_rdn_brk_pdl_cmp Sbx_mf_brk_pdl_cmp Sbx_cf_brk_pdl_cmp Sbx_dyn_cata_cpt Sbx_rdn_cata_cpt Sbx_mf_cata_cpt Sbx_cf_cata_cpt Sbx_dyn_cl_rich_chr Sbx_rdn_cl_rich_chr Sbx_mf_cl_rich_chr Sbx_cf_cl_rich_chr Sbx_dyn_clu_cnt_nok Sbx_rdn_clu_cnt_nok Sbx_mf_clu_cnt_nok Sbx_cf_clu_cnt_nok Sbx_dyn_cp_blk_open Sbx_rdn_cp_blk_open Sbx_mf_cp_blk_open Sbx_cf_cp_blk_open Sbx_dyn_cp_oc Sbx_rdn_cp_oc Sbx_mf_cp_oc Sbx_cf_cp_oc Sbx_dyn_cp_scg Sbx_rdn_cp_scg Sbx_mf_cp_scg Sbx_cf_cp_scg Sbx_dyn_cp_scw Sbx_rdn_cp_scw Sbx_mf_cp_scw Sbx_cf_cp_scw Sbx_dyn_crk_chr Sbx_rdn_crk_chr Sbx_mf_crk_chr Sbx_cf_crk_chr Sbx_dyn_crk_cmp Sbx_rdn_crk_cmp Sbx_mf_crk_cmp Sbx_cf_crk_cmp Sbx_dyn_crk_cyc Sbx_rdn_crk_cyc Sbx_mf_crk_cyc Sbx_cf_crk_cyc Sbx_dyn_crk_no_sig Sbx_rdn_crk_no_sig Sbx_mf_crk_no_sig Sbx_cf_crk_no_sig Sbx_dyn_crk_oc Sbx_rdn_crk_oc Sbx_mf_crk_oc Sbx_cf_crk_oc Sbx_dyn_crk_shp Sbx_rdn_crk_shp Sbx_mf_crk_shp Sbx_cf_crk_shp Sbx_dyn_cru_cmp Sbx_rdn_cru_cmp Sbx_mf_cru_cmp Sbx_cf_cru_cmp Sbx_dyn_cru_sl_swi_chr Sbx_rdn_cru_sl_swi_chr Sbx_mf_cru_sl_swi_chr Sbx_cf_cru_sl_swi_chr Sbx_dyn_cru_sl_tot Sbx_rdn_cru_sl_tot Sbx_mf_cru_sl_tot Sbx_cf_cru_sl_tot Sbx_dyn_cru_vs_cmp Sbx_rdn_cru_vs_cmp Sbx_mf_cru_vs_cmp Sbx_cf_cru_vs_cmp Sbx_dyn_cru_whl_cmd_nok Sbx_rdn_cru_whl_cmd_nok Sbx_mf_cru_whl_cmd_nok Sbx_cf_cru_whl_cmd_nok Sbx_dyn_cru_whl_cmd_oc_scw Sbx_rdn_cru_whl_cmd_oc_scw Sbx_mf_cru_whl_cmd_oc_scw Sbx_cf_cru_whl_cmd_oc_scw Sbx_dyn_cru_whl_cmd_oor Sbx_rdn_cru_whl_cmd_oor Sbx_mf_cru_whl_cmd_oor Sbx_cf_cru_whl_cmd_oor Sbx_dyn_ecm_adc_tron Sbx_rdn_ecm_adc_tron Sbx_mf_ecm_adc_tron Sbx_cf_ecm_adc_tron Sbx_dyn_ecm_err_itl Sbx_rdn_ecm_err_itl Sbx_mf_ecm_err_itl Sbx_cf_ecm_err_itl Sbx_dyn_ecm_mon_secu_1 Sbx_rdn_ecm_mon_secu_1 Sbx_mf_ecm_mon_secu_1 Sbx_cf_ecm_mon_secu_1 Sbx_dyn_ecm_mon_secu_2 Sbx_rdn_ecm_mon_secu_2 Sbx_mf_ecm_mon_secu_2 Sbx_cf_ecm_mon_secu_2 Sbx_dyn_ecm_mon_tron Sbx_rdn_ecm_mon_tron Sbx_mf_ecm_mon_tron Sbx_cf_ecm_mon_tron Sbx_dyn_efi_sldv_2_oc Sbx_rdn_efi_sldv_2_oc Sbx_mf_efi_sldv_2_oc Sbx_cf_efi_sldv_2_oc Sbx_dyn_efi_sldv_2_scg Sbx_rdn_efi_sldv_2_scg Sbx_mf_efi_sldv_2_scg Sbx_cf_efi_sldv_2_scg Sbx_dyn_efi_sldv_2_scw Sbx_rdn_efi_sldv_2_scw Sbx_mf_efi_sldv_2_scw Sbx_cf_efi_sldv_2_scw Sbx_dyn_esp_data_chr Sbx_rdn_esp_data_chr Sbx_mf_esp_data_chr Sbx_cf_esp_data_chr Sbx_dyn_esp_data_seq_ctr Sbx_rdn_esp_data_seq_ctr Sbx_mf_esp_data_seq_ctr Sbx_cf_esp_data_seq_ctr Sbx_dyn_esp_no_frm Sbx_rdn_esp_no_frm Sbx_mf_esp_no_frm Sbx_cf_esp_no_frm Sbx_dyn_eva_fcap_abn_cple Sbx_rdn_eva_fcap_abn_cple Sbx_mf_eva_fcap_abn_cple Sbx_cf_eva_fcap_abn_cple Sbx_dyn_eva_fcap_no_lk Sbx_rdn_eva_fcap_no_lk Sbx_mf_eva_fcap_no_lk Sbx_cf_eva_fcap_no_lk Sbx_dyn_eva_sldv_blk_clos Sbx_rdn_eva_sldv_blk_clos Sbx_mf_eva_sldv_blk_clos Sbx_cf_eva_sldv_blk_clos Sbx_dyn_eva_sldv_oc Sbx_rdn_eva_sldv_oc Sbx_mf_eva_sldv_oc Sbx_cf_eva_sldv_oc Sbx_dyn_eva_sldv_scg Sbx_rdn_eva_sldv_scg Sbx_mf_eva_sldv_scg Sbx_cf_eva_sldv_scg Sbx_dyn_eva_sldv_scw Sbx_rdn_eva_sldv_scw Sbx_mf_eva_sldv_scw Sbx_cf_eva_sldv_scw Sbx_dyn_evap_chr Sbx_rdn_evap_chr Sbx_mf_evap_chr Sbx_cf_evap_chr Sbx_dyn_evap_lkg Sbx_rdn_evap_lkg Sbx_mf_evap_lkg Sbx_cf_evap_lkg Sbx_dyn_fsys_cpt Sbx_rdn_fsys_cpt Sbx_mf_fsys_cpt Sbx_cf_fsys_cpt Sbx_dyn_gas_pump_2_oc Sbx_rdn_gas_pump_2_oc Sbx_mf_gas_pump_2_oc Sbx_cf_gas_pump_2_oc Sbx_dyn_gas_pump_2_scg Sbx_rdn_gas_pump_2_scg Sbx_mf_gas_pump_2_scg Sbx_cf_gas_pump_2_scg Sbx_dyn_gas_pump_2_scw Sbx_rdn_gas_pump_2_scw Sbx_mf_gas_pump_2_scw Sbx_cf_gas_pump_2_scw Sbx_dyn_gas_pump_oc Sbx_rdn_gas_pump_oc Sbx_mf_gas_pump_oc Sbx_cf_gas_pump_oc Sbx_dyn_gas_pump_scg Sbx_rdn_gas_pump_scg Sbx_mf_gas_pump_scg Sbx_cf_gas_pump_scg Sbx_dyn_gas_pump_scw Sbx_rdn_gas_pump_scw Sbx_mf_gas_pump_scw Sbx_cf_gas_pump_scw Sbx_dyn_igc_1_oc Sbx_rdn_igc_1_oc Sbx_mf_igc_1_oc Sbx_cf_igc_1_oc Sbx_dyn_igc_1_scg Sbx_rdn_igc_1_scg Sbx_mf_igc_1_scg Sbx_cf_igc_1_scg Sbx_dyn_igc_1_scw Sbx_rdn_igc_1_scw Sbx_mf_igc_1_scw Sbx_cf_igc_1_scw Sbx_dyn_igc_2_oc Sbx_rdn_igc_2_oc Sbx_mf_igc_2_oc Sbx_cf_igc_2_oc Sbx_dyn_igc_2_scg Sbx_rdn_igc_2_scg Sbx_mf_igc_2_scg Sbx_cf_igc_2_scg Sbx_dyn_igc_2_scw Sbx_rdn_igc_2_scw Sbx_mf_igc_2_scw Sbx_cf_igc_2_scw Sbx_dyn_igc_3_oc Sbx_rdn_igc_3_oc Sbx_mf_igc_3_oc Sbx_cf_igc_3_oc Sbx_dyn_igc_3_scg Sbx_rdn_igc_3_scg Sbx_mf_igc_3_scg Sbx_cf_igc_3_scg Sbx_dyn_igc_3_scw Sbx_rdn_igc_3_scw Sbx_mf_igc_3_scw Sbx_cf_igc_3_scw Sbx_dyn_igc_4_oc Sbx_rdn_igc_4_oc Sbx_mf_igc_4_oc Sbx_cf_igc_4_oc Sbx_dyn_igc_4_scg Sbx_rdn_igc_4_scg Sbx_mf_igc_4_scg Sbx_cf_igc_4_scg Sbx_dyn_igc_4_scw Sbx_rdn_igc_4_scw Sbx_mf_igc_4_scw Sbx_cf_igc_4_scw Sbx_dyn_in_cam_chr Sbx_rdn_in_cam_chr Sbx_mf_in_cam_chr Sbx_cf_in_cam_chr Sbx_dyn_in_cam_crk_cmp Sbx_rdn_in_cam_crk_cmp Sbx_mf_in_cam_crk_cmp Sbx_cf_in_cam_crk_cmp Sbx_dyn_in_cam_cyc Sbx_rdn_in_cam_cyc Sbx_mf_in_cam_cyc Sbx_cf_in_cam_cyc Sbx_dyn_in_cam_no_sig Sbx_rdn_in_cam_no_sig Sbx_mf_in_cam_no_sig Sbx_cf_in_cam_no_sig Sbx_dyn_in_cam_nok Sbx_rdn_in_cam_nok Sbx_mf_in_cam_nok Sbx_cf_in_cam_nok Sbx_dyn_in_vvtc_ad Sbx_rdn_in_vvtc_ad Sbx_mf_in_vvtc_ad Sbx_cf_in_vvtc_ad Sbx_dyn_in_vvtc_blk Sbx_rdn_in_vvtc_blk Sbx_mf_in_vvtc_blk Sbx_cf_in_vvtc_blk Sbx_dyn_in_vvtc_dirt_lkg Sbx_rdn_in_vvtc_dirt_lkg Sbx_mf_in_vvtc_dirt_lkg Sbx_cf_in_vvtc_dirt_lkg Sbx_dyn_in_vvtc_sldv_oc Sbx_rdn_in_vvtc_sldv_oc Sbx_mf_in_vvtc_sldv_oc Sbx_cf_in_vvtc_sldv_oc Sbx_dyn_in_vvtc_sldv_scg Sbx_rdn_in_vvtc_sldv_scg Sbx_mf_in_vvtc_sldv_scg Sbx_cf_in_vvtc_sldv_scg Sbx_dyn_in_vvtc_sldv_scw Sbx_rdn_in_vvtc_sldv_scw Sbx_mf_in_vvtc_sldv_scw Sbx_cf_in_vvtc_sldv_scw Sbx_dyn_inj1_oc Sbx_rdn_inj1_oc Sbx_mf_inj1_oc Sbx_cf_inj1_oc Sbx_dyn_inj1_scg Sbx_rdn_inj1_scg Sbx_mf_inj1_scg Sbx_cf_inj1_scg Sbx_dyn_inj1_scw Sbx_rdn_inj1_scw Sbx_mf_inj1_scw Sbx_cf_inj1_scw Sbx_dyn_inj2_oc Sbx_rdn_inj2_oc Sbx_mf_inj2_oc Sbx_cf_inj2_oc Sbx_dyn_inj2_scg Sbx_rdn_inj2_scg Sbx_mf_inj2_scg Sbx_cf_inj2_scg Sbx_dyn_inj2_scw Sbx_rdn_inj2_scw Sbx_mf_inj2_scw Sbx_cf_inj2_scw Sbx_dyn_inj3_oc /end OUT_MEASUREMENT
 /begin SUB_FUNCTION DgDftCfg_Failxxx /end SUB_FUNCTION
/end FUNCTION
/end MODULE
/end PROJECT
