ASAP2_VERSION 1 41
/begin PROJECT RD8 "_default_ProjectLongIdentifier"
/begin HEADER "_default_HeaderComment" PROJECT_NO RD9 /end HEADER
/begin MODULE _default_ModuleName "_default_ModuleLongIdentifier"
/begin MOD_COMMON "_default_ModCommonComment" DEPOSIT ABSOLUTE BYTE_ORDER MSB_LAST ALIGNMENT_BYTE 1 ALIGNMENT_WORD 2 ALIGNMENT_LONG 2 ALIGNMENT_FLOAT32_IEEE 2 ALIGNMENT_FLOAT64_IEEE 4 /end MOD_COMMON
/begin CHARACTERISTIC Cmp_spg_ol_pwm_alco "PWM setpoint for the wastegate command" MAP 0xa0024a8c _REC_A1MAP_20_u1_u2_u2 100. _CNV_A_R_LINEAR_____165_CM 0. 100. FORMAT "%12.8"
 /begin AXIS_DESCR COM_AXIS Vxx_n _CNV_A_R_ENSD_LINEA_22_CM 9 0. 16383.75 FORMAT "%8.2" AXIS_PTS_REF Ctb_n2 /end AXIS_DESCR
 /begin AXIS_DESCR COM_AXIS Vxx_alti_cor_map_sp _CNV_A_R_LINEAR_____115_CM 9 0. 20000. FORMAT "%5.0" AXIS_PTS_REF Ctb_spg_ol_map_sp /end AXIS_DESCR
/end CHARACTERISTIC
/begin MEASUREMENT Vxx_spg_ol_pwm_alco "PWM setpoint for the wastegate command (alcohol setting)" UBYTE _CNV_A_R_LINEAR_____165_CM 1 0. 0. 100. ECU_ADDRESS 0xd0006480 FORMAT "%12.8" /end MEASUREMENT
/begin AXIS_PTS Ctb_spg_ol_map_sp "9 breakpoint table for the manifold pressure setpoint" 0xa0024b9c Vxx_alti_cor_map_sp _REC_A2AXS_20_u2 20000. _CNV_A_R_LINEAR_____115_CM 9 0. 20000. FORMAT "%5.0" /end AXIS_PTS
/begin AXIS_PTS Ctb_pump_maf "9 breakpoints table for mass air flow." 0xa002cbe8 Vxx_pump_maf _REC_A2AXS_20_u2 3000. _CNV_A_R_LINEAR_____172_CM 9 0. 3000. FORMAT "%7.2" /end AXIS_PTS
/begin AXIS_PTS Ctb_spg_pwm "9 breakpoints for the wastegate RCO setpoint." 0xa002cbfc Vxx_spg_pwm_sp_fil _REC_A2AXS_20_u1 100. _CNV_A_R_LINEAR_____165_CM 9 0. 100. FORMAT "%12.8" /end AXIS_PTS
/begin CHARACTERISTIC Cmp_ex_prs_dif_fac "Load losses coefficient linked to the wastegate and turbine without injection cut." MAP 0xa002cc08 _REC_A1MAP_20_u2_u1_u2 0.65535 _CNV_A_R_LINEAR_____178_CM 0. 0.65535 FORMAT "%7.5"
 /begin AXIS_DESCR COM_AXIS Vxx_spg_pwm_sp_fil _CNV_A_R_LINEAR_____165_CM 9 0. 100. FORMAT "%12.8" AXIS_PTS_REF Ctb_spg_pwm /end AXIS_DESCR
 /begin AXIS_DESCR COM_AXIS Vxx_pump_maf _CNV_A_R_LINEAR_____172_CM 9 0. 3000. FORMAT "%7.2" AXIS_PTS_REF Ctb_pump_maf /end AXIS_DESCR
/end CHARACTERISTIC
/begin MEASUREMENT Vsx_ex_prs_mdl_vld "Estimated exhaust manifold pressure validity status" UBYTE _CNV_S_3_STATUS_OK__179_CM 1 0. 0. 2. ECU_ADDRESS 0xd0007b35 /end MEASUREMENT
/begin MEASUREMENT Vsx_ex_prs_vld "Exhaust manifold pressure validity status" UBYTE _CNV_S_4_STATUS_OK__180_CM 1 0. 0. 3. ECU_ADDRESS 0xd0007b36 /end MEASUREMENT
/begin MEASUREMENT Vxx_ex_prs "Exhaust manifold pressure" UWORD _CNV_A_R_LINEAR_____115_CM 1 0. 0. 20000. ECU_ADDRESS 0xd0005eac FORMAT "%5.0" /end MEASUREMENT
/begin MEASUREMENT Vxx_ex_prs_mdl "Estimated exhaust manifold pressure" UWORD _CNV_A_R_LINEAR_____115_CM 1 0. 0. 20000. ECU_ADDRESS 0xd0005eae FORMAT "%5.0" /end MEASUREMENT
/begin MEASUREMENT Vxx_spg_pwm_sp_fil "RCO setpoint of the wastegate" UBYTE _CNV_A_R_LINEAR_____165_CM 1 0. 0. 100. ECU_ADDRESS 0xd0007b37 FORMAT "%12.8" /end MEASUREMENT
/begin MEASUREMENT Vxx_up_tbn_prs_dif "Exhaust counter pressure before turbine." UWORD _CNV_A_R_LINEAR_____115_CM 1 0. 0. 20000. ECU_ADDRESS 0xd0005eb0 FORMAT "%5.0" /end MEASUREMENT
/begin MEASUREMENT Vxx_up_tbn_prs_dif_fac "Load losses coefficient linked to the wastegate and turbine" UWORD _CNV_A_R_LINEAR_____178_CM 1 0. 0. 0.65535 ECU_ADDRESS 0xd0005eb2 FORMAT "%7.5" /end MEASUREMENT
/begin CHARACTERISTIC Cxx_ex_prs_fail_val "Exhaust manifold pressure default value" VALUE 0xa0021320 _REC_S1VAL_20_u2 20000. _CNV_A_R_LINEAR_____115_CM 0. 20000. FORMAT "%5.0" /end CHARACTERISTIC
/begin CHARACTERISTIC Cxx_spg_pwm_sp_ftc "Filter time constant for wastegate PWM" VALUE 0xa0021322 _REC_S1VAL_20_u2 65.535 _CNV_A_R_LINEAR_____116_CM 0. 65.535 /end CHARACTERISTIC
/begin CHARACTERISTIC Cxx_tbn_prs_dif_cut_fac "Wastegate and turbine load losses coefficient during injection cut" VALUE 0xa0021324 _REC_S1VAL_20_u2 100. _CNV_A_R_LINEAR_____159_CM 0. 100. FORMAT "%12.8" /end CHARACTERISTIC
/begin MEASUREMENT Vxx_is_ad_tq "Adaptive correction" SWORD _CNV_A_R_LINEAR_____181_CM 1 0. -1024. 1023.96875 DISPLAY_IDENTIFIER SmIsrCtl_NVM.Vxx_is_ad_tq_NVM ECU_ADDRESS 0xd0005fce FORMAT "%11.5" /end MEASUREMENT
/begin AXIS_PTS Ctb_is_n_d_dif "Static error breakpoints for idle speed regulator (case derivate)" 0xa003457c Vxx_dif_n_sp _REC_A2AXS_20_u2 16383.75 _CNV_A_R_LINEAR_____182_CM 8 -8192. 8191.75 FORMAT "%8.2" /end AXIS_PTS
/begin AXIS_PTS Ctb_is_tco "Coolant temperature breakpoints for ISR set point tables" 0xa0034590 Vxx_tco _REC_A2AXS_20_u2 240. _CNV_A_R_LINEAR_____110_CM 9 -40. 200. FORMAT "%6.1" /end AXIS_PTS
/begin CHARACTERISTIC Ctp_is_d_err_fac "Derivative correction factor table dependent on static error" CURVE 0xa00345a4 _REC_A1CUR_20_u2_u2 2. _CNV_A_R_LINEAR_____183_CM 0. 2. FORMAT "%10.8"
 /begin AXIS_DESCR COM_AXIS Vxx_dif_n_sp _CNV_A_R_LINEAR_____182_CM 8 -8192. 8191.75 FORMAT "%8.2" AXIS_PTS_REF Ctb_is_n_d_dif /end AXIS_DESCR
/end CHARACTERISTIC
/begin CHARACTERISTIC Ctp_is_d_gear_fac "Derivative correction factor table dependent on gear ratio" CURVE 0xa00345b4 _REC_A1CUR_20_u2_u1 2. _CNV_A_R_LINEAR_____184_CM 0. 2. FORMAT "%10.8"
 /begin AXIS_DESCR COM_AXIS Vxx_gear _CNV_A_R_LINEAR_____145_CM 8 -1. 6. READ_ONLY FORMAT "%2.0" AXIS_PTS_REF Ntb_gear /end AXIS_DESCR
/end CHARACTERISTIC
/begin CHARACTERISTIC Ctp_is_d_max "Idle speed table used to determine the maximum limitation of derivative correction function Tco" CURVE 0xa00345c4 _REC_A1CUR_20_u2_u2 2047.96875 _CNV_A_R_LINEAR_____185_CM -1024. 1023.96875 FORMAT "%11.5"
 /begin AXIS_DESCR COM_AXIS Vxx_tco _CNV_A_R_LINEAR_____110_CM 9 -40. 200. FORMAT "%6.1" AXIS_PTS_REF Ctb_is_tco /end AXIS_DESCR
/end CHARACTERISTIC
/begin CHARACTERISTIC Ctp_is_d_min "Idle speed table used to determine the minimum limitation of derivative correction function Tco" CURVE 0xa00345d8 _REC_A1CUR_20_u2_u2 2047.96875 _CNV_A_R_LINEAR_____185_CM -1024. 1023.96875 FORMAT "%11.5"
 /begin AXIS_DESCR COM_AXIS Vxx_tco _CNV_A_R_LINEAR_____110_CM 9 -40. 200. FORMAT "%6.1" AXIS_PTS_REF Ctb_is_tco /end AXIS_DESCR
/end CHARACTERISTIC
/begin CHARACTERISTIC Ctp_is_d_tco_fac "Derivative correction factor table dependent on coolant temperature" CURVE 0xa00345ec _REC_A1CUR_20_u2_u2 2. _CNV_A_R_LINEAR_____183_CM 0. 2. FORMAT "%10.8"
 /begin AXIS_DESCR COM_AXIS Vxx_tco _CNV_A_R_LINEAR_____110_CM 9 -40. 200. FORMAT "%6.1" AXIS_PTS_REF Ctb_is_tco /end AXIS_DESCR
/end CHARACTERISTIC
/begin MEASUREMENT Vbx_ini_drv "Initialization conditions with switch boolean" UBYTE _CNV_S_2_RANGE______3_CM 1 0. 0. 1. ECU_ADDRESS 0xd00070aa BIT_MASK 0x1 /end MEASUREMENT
/begin MEASUREMENT Vxx_dif_n_sp_grd "Derivative of difference between engine speed and idle speed setpoint by report to the time" SWORD _CNV_A_R_LINEAR_____21_CM 1 0. -8192. 8191. ECU_ADDRESS 0xd0004884 FORMAT "%5.0" /end MEASUREMENT
/begin MEASUREMENT Vxx_is_d_cor "Derivative correction" SWORD _CNV_A_R_LINEAR_____181_CM 1 0. -1024. 1023.96875 ECU_ADDRESS 0xd0004886 FORMAT "%11.5" /end MEASUREMENT
/begin MEASUREMENT Vxx_is_d_fac "Factor of derivative correction function of Tco and difference between engine and idle speed" UWORD _CNV_A_R_LINEAR_____184_CM 1 0. 0. 7.9990234375 ECU_ADDRESS 0xd0004888 FORMAT "%11.9" /end MEASUREMENT
/begin MEASUREMENT Vxx_max_is_d "Maxmimum saturation of derivative correction" SWORD _CNV_A_R_LINEAR_____181_CM 1 0. -1024. 1023.96875 ECU_ADDRESS 0xd000488a FORMAT "%11.5" /end MEASUREMENT
/begin MEASUREMENT Vxx_min_is_d "Minimum saturation of derivative correction" SWORD _CNV_A_R_LINEAR_____181_CM 1 0. -1024. 1023.96875 ECU_ADDRESS 0xd000488c FORMAT "%11.5" /end MEASUREMENT
/begin MEASUREMENT Vxx_mmv_n_dif_drv "Moving mean value of derivative difference between engine and idle speed setpoint" SWORD _CNV_A_R_LINEAR_____21_CM 1 0. -8192. 8191. ECU_ADDRESS 0xd000488e FORMAT "%5.0" /end MEASUREMENT
/begin MEASUREMENT Vxx_raw_n_dif_drv "Derivative of difference between engine speed and idle speed setpoint by report to the time" SWORD _CNV_A_R_LINEAR_____21_CM 1 0. -8192. 8191. ECU_ADDRESS 0xd0004890 FORMAT "%5.0" /end MEASUREMENT
/begin CHARACTERISTIC Cxx_fac_n_d "Filter factor on moving mean value of derivative difference between engine and idle speed" VALUE 0xa0021d0a _REC_S1VAL_20_u2 65.535 _CNV_A_R_LINEAR_____116_CM 0. 65.535 /end CHARACTERISTIC
/begin CHARACTERISTIC Cxx_is_d_pft_rgn_fac "Derivate correction factor in case of particulate filter regeneration" VALUE 0xa0021d0c _REC_S1VAL_20_u2 2. _CNV_A_R_LINEAR_____183_CM 0. 2. FORMAT "%11.8" /end CHARACTERISTIC
/begin MEASUREMENT Vbx_blk_n "Engine speed hooked above of idle setpoint" UBYTE _CNV_S_2_RANGE______3_CM 1 0. 0. 1. ECU_ADDRESS 0xd0007c98 BIT_MASK 0x1 /end MEASUREMENT
/begin MEASUREMENT Vbx_is_blk_n_cdn "All conditions for the detection of engine speed hook are reunited" UBYTE _CNV_S_2_RANGE______3_CM 1 0. 0. 1. ECU_ADDRESS 0xd0007c99 BIT_MASK 0x1 /end MEASUREMENT
/begin MEASUREMENT Vbx_is_blk_vh "Detect if vehicle runs without engaged gear" UBYTE _CNV_S_2_RANGE______3_CM 1 0. 0. 1. ECU_ADDRESS 0xd00070b0 BIT_MASK 0x1 /end MEASUREMENT
/begin MEASUREMENT Vxx_is_i_zon_out_dly "Temporization of initialization of recognition of exit of engine speed hook" UWORD _CNV_A_R_LINEAR_____32_CM 1 0. 0. 655.35 ECU_ADDRESS 0xd0005fd0 FORMAT "%6.2" /end MEASUREMENT
/begin CHARACTERISTIC Cbx_is_blk_vh_run_cfm "Choice to activate the detection of engine speed hook when vehicle runs without engaged gear" VALUE 0xa0021d18 _REC_S1VAL_20_u1 1. _CNV_A_R_ECME_LINEA_0_CM 0. 1. FORMAT "%1.0" BIT_MASK 0x1 /end CHARACTERISTIC
/begin CHARACTERISTIC Cbx_on_ac_cor_cfm "Inhibition boolean of the condition on the AC clutch for the detection of a engine speed hook" VALUE 0xa0021d19 _REC_S1VAL_20_u1 1. _CNV_A_R_ECME_LINEA_0_CM 0. 1. FORMAT "%1.0" BIT_MASK 0x1 /end CHARACTERISTIC
/begin CHARACTERISTIC Cbx_on_alt_cor_cfm "Inhibition boolean of the condition on the alternator power for the detection of an engine speed hook" VALUE 0xa0021d1a _REC_S1VAL_20_u1 1. _CNV_A_R_ECME_LINEA_0_CM 0. 1. FORMAT "%1.0" BIT_MASK 0x1 /end CHARACTERISTIC
/begin CHARACTERISTIC Cbx_on_mdf_cor_cfm "Inhibition boolean of the condition on the flans for the detection of a engine speed hook" VALUE 0xa0021d1b _REC_S1VAL_20_u1 1. _CNV_A_R_ECME_LINEA_0_CM 0. 1. FORMAT "%1.0" BIT_MASK 0x1 /end CHARACTERISTIC
/begin CHARACTERISTIC Cbx_on_pwst_cor_cfm "Inhibition boolean of the condition on the power steering  manostat activation for the detection of a engine speed hook" VALUE 0xa0021d1c _REC_S1VAL_20_u1 1. _CNV_A_R_ECME_LINEA_0_CM 0. 1. FORMAT "%1.0" BIT_MASK 0x1 /end CHARACTERISTIC
/begin CHARACTERISTIC Cxx_fast_ad_cdn_dly "Delay of initialization of recognition of engine speed hook" VALUE 0xa0021d0e _REC_S1VAL_20_u2 655.35 _CNV_A_R_LINEAR_____32_CM 0. 655.35 FORMAT "%6.2" /end CHARACTERISTIC
/begin CHARACTERISTIC Cxx_h_blk_is_alt_pow "High theshold on filtered alternator mechanical power to authorize the detection of an engine speed hook" VALUE 0xa0021d10 _REC_S1VAL_20_u2 655350. _CNV_A_R_LINEAR_____186_CM 0. 655350. FORMAT "%6.0" /end CHARACTERISTIC
/begin CHARACTERISTIC Cxx_is_i_zon_out_dly "Delay of initialization of recognition of exit of engine speed hook" VALUE 0xa0021d12 _REC_S1VAL_20_u2 655.35 _CNV_A_R_LINEAR_____32_CM 0. 655.35 FORMAT "%6.2" /end CHARACTERISTIC
/begin CHARACTERISTIC Cxx_l_blk_is_alt_pow "Low theshold on filtered alternator mechanical power to authorize the detection of an engine speed hook" VALUE 0xa0021d14 _REC_S1VAL_20_u2 655350. _CNV_A_R_LINEAR_____186_CM 0. 655350. FORMAT "%6.0" /end CHARACTERISTIC
/begin CHARACTERISTIC Cxx_min_is_i_ofs "Offset about minimum torque value of idle speed regulator integral correction to detect a engine speed hook" VALUE 0xa0021d16 _REC_S1VAL_20_s2 2047.96875 _CNV_A_R_LINEAR_____181_CM -1024. 1023.96875 FORMAT "%11.5" /end CHARACTERISTIC
/begin AXIS_PTS Ctb_is_in_ofs_drv "Breakpoint calibration of thresholds of entry to ISR" 0xa0034600 Vxx_n_drv_is _REC_A2AXS_20_u2 16383. _CNV_A_R_LINEAR_____187_CM 6 -8192. 8191. FORMAT "%5.0" /end AXIS_PTS
/begin CHARACTERISTIC Cmp_is_in_ofs_drv_gear "Indexed table to choose the threshold of entry to ISR depending on engine speed derivate and gearbox ratio." MAP 0xa0034610 _REC_A1MAP_20_u2_u2_u1 16383.75 _CNV_A_R_ENSD_LINEA_22_CM 0. 16383.75 FORMAT "%8.2"
 /begin AXIS_DESCR COM_AXIS Vxx_n_drv_is _CNV_A_R_LINEAR_____187_CM 6 -8192. 8191. FORMAT "%5.0" AXIS_PTS_REF Ctb_is_in_ofs_drv /end AXIS_DESCR
 /begin AXIS_DESCR COM_AXIS Vxx_gear _CNV_A_R_LINEAR_____145_CM 8 -1. 6. READ_ONLY FORMAT "%2.0" AXIS_PTS_REF Ntb_gear /end AXIS_DESCR
/end CHARACTERISTIC
/begin CHARACTERISTIC Ctp_is_in_tco_ofs "Offset function coolant temperature to modify the threshold of entry to ISR" CURVE 0xa0034670 _REC_A1CUR_20_u2_u2 16383.75 _CNV_A_R_LINEAR_____182_CM -8192. 8191.75 FORMAT "%8.2"
 /begin AXIS_DESCR COM_AXIS Vxx_tco _CNV_A_R_LINEAR_____110_CM 9 -40. 200. FORMAT "%6.1" AXIS_PTS_REF Ctb_is_tco /end AXIS_DESCR
/end CHARACTERISTIC
/begin CHARACTERISTIC Ctp_is_out_sta_dly "Delay to exit of start state to condition state directly (function coolant temperature)" CURVE 0xa0034684 _REC_A1CUR_20_u2_u2 655.35 _CNV_A_R_LINEAR_____32_CM 0. 655.35 FORMAT "%6.2"
 /begin AXIS_DESCR COM_AXIS Vxx_tco _CNV_A_R_LINEAR_____110_CM 8 -40. 200. FORMAT "%5.1" AXIS_PTS_REF Ctb_sta_tco /end AXIS_DESCR
/end CHARACTERISTIC
/begin CHARACTERISTIC Ctp_sta_off_ofs "Offset (depending coolant temperature) about idle speed setpoint to create start state threshold" CURVE 0xa0034694 _REC_A1CUR_20_u2_u2 16383.75 _CNV_A_R_LINEAR_____182_CM -8192. 8191.75 FORMAT "%8.2"
 /begin AXIS_DESCR COM_AXIS Vxx_tco _CNV_A_R_LINEAR_____110_CM 8 -40. 200. FORMAT "%5.1" AXIS_PTS_REF Ctb_sta_tco /end AXIS_DESCR
/end CHARACTERISTIC
/begin MEASUREMENT Vbx_is_act "Booleen indicating if ISR calculation is authorised" UBYTE _CNV_S_2_RANGE______3_CM 1 0. 0. 1. ECU_ADDRESS 0xd00070c5 BIT_MASK 0x1 /end MEASUREMENT
/begin MEASUREMENT Vbx_old_igk_cut "Flag to detect micro-cut" UBYTE _CNV_S_2_RANGE______3_CM 1 0. 0. 1. ECU_ADDRESS 0xd00070c6 BIT_MASK 0x1 /end MEASUREMENT
/begin MEASUREMENT Vbx_sta "Booleen indicating if first entry in ISR after start engine" UBYTE _CNV_S_2_RANGE______3_CM 1 0. 0. 1. ECU_ADDRESS 0xd00070c7 BIT_MASK 0x1 /end MEASUREMENT
/begin MEASUREMENT Vsx_is "State variable of idle speed regulation" UBYTE _CNV_A_R_ECME_LINEA_0_CM 1 0. 0. 255. ECU_ADDRESS 0xd00070c8 FORMAT "%3.0" /end MEASUREMENT
/begin MEASUREMENT Vsx_is_raw "State variable of idle speed regulation without consolidation" UBYTE _CNV_S_6_RANGE_STAT_188_CM 1 0. 2. 64. ECU_ADDRESS 0xd00070c9 /end MEASUREMENT
/begin MEASUREMENT Vsx_mc "Micro cut detection" UBYTE _CNV_A_R_ECME_LINEA_0_CM 1 0. 0. 1. ECU_ADDRESS 0xd00070ca FORMAT "%1.0" /end MEASUREMENT
/begin MEASUREMENT Vxx_is_ast_ofs "Offset (depending coolant temperature) about idle speed setpoint to create after start state threshold" SWORD _CNV_A_R_ENSD_LINEA_22_CM 1 0. -8192. 8191.75 ECU_ADDRESS 0xd000489e FORMAT "%8.2" /end MEASUREMENT
/begin MEASUREMENT Vxx_is_cdn_h_n_dly "Delay after start" UWORD _CNV_A_R_LINEAR_____32_CM 1 0. 0. 655.35 ECU_ADDRESS 0xd00048a0 FORMAT "%6.2" /end MEASUREMENT
/begin MEASUREMENT Vxx_is_in_deci_dly "Variable that indicates a forced activate state when engine speed is reacher" UWORD _CNV_A_R_LINEAR_____32_CM 1 0. 0. 655.35 ECU_ADDRESS 0xd00048a2 FORMAT "%6.2" /end MEASUREMENT
/begin MEASUREMENT Vxx_is_in_dly "Interdiction delay to entry in activate idle speed state" UWORD _CNV_A_R_LINEAR_____32_CM 1 0. 0. 655.35 ECU_ADDRESS 0xd00048a4 FORMAT "%6.2" /end MEASUREMENT
/begin MEASUREMENT Vxx_is_in_n_thd "Variable of offset about idle speed setpoint to enter in condition state idle speed" UWORD _CNV_A_R_ENSD_LINEA_22_CM 1 0. 0. 16383.75 ECU_ADDRESS 0xd00048a6 FORMAT "%8.2" /end MEASUREMENT
/begin MEASUREMENT Vxx_is_n_stab_fac "Anti-pumping factor" UWORD _CNV_A_R_LINEAR_____189_CM 1 0. 0. 1. ECU_ADDRESS 0xd00048a8 FORMAT "%6.4" /end MEASUREMENT
/begin MEASUREMENT Vxx_is_out_ast_dly "Delay to fore input in condition idle speed state" UWORD _CNV_A_R_LINEAR_____32_CM 1 0. 0. 655.35 ECU_ADDRESS 0xd00048aa FORMAT "%6.2" /end MEASUREMENT
/begin MEASUREMENT Vxx_is_out_n_thd "Variable of offset about idle speed setpoint to exit of condition idle speed state" UWORD _CNV_A_R_ENSD_LINEA_22_CM 1 0. 0. 16383.75 ECU_ADDRESS 0xd00048ac FORMAT "%8.2" /end MEASUREMENT
/begin MEASUREMENT Vxx_is_out_sta_dly "Delay to exit of start state to condition state directly" UWORD _CNV_A_R_LINEAR_____32_CM 1 0. 0. 655.35 ECU_ADDRESS 0xd00048ae FORMAT "%6.2" /end MEASUREMENT
/begin MEASUREMENT Vxx_n_drv_is "derivate of engine speed for idle speed" SWORD _CNV_A_R_LINEAR_____21_CM 1 0. -8192. 8191. ECU_ADDRESS 0xd00048b0 FORMAT "%5.0" /end MEASUREMENT
/begin MEASUREMENT Vxx_n_drv_sub "Filtred derivate of engine speed for start engine state" SWORD _CNV_A_R_LINEAR_____21_CM 1 0. -8192. 8191. ECU_ADDRESS 0xd00048b2 FORMAT "%6.0" /end MEASUREMENT
/begin MEASUREMENT Vxx_sta_off_ofs "Offset (depending coolant temperature) about idle speed setpoint to create start state threshold" SWORD _CNV_A_R_ENSD_LINEA_22_CM 1 0. -8192. 8191.75 ECU_ADDRESS 0xd00048b4 FORMAT "%8.2" /end MEASUREMENT
/begin CHARACTERISTIC Cbx_tq_trs_ctl_mux_cfm "Consideration of the information intersystem torque request (=0) or no (=1)" VALUE 0xa0021d62 _REC_S1VAL_20_u1 1. _CNV_A_R_ECME_LINEA_0_CM 0. 1. FORMAT "%1.0" BIT_MASK 0x1 /end CHARACTERISTIC
/begin CHARACTERISTIC Cxx_ac_is_in_cdn_ofs "Offset on the threshold determined by the derivate of engine speed when the air conditioning compressor is clutched" VALUE 0xa0021d1e _REC_S1VAL_20_u2 16383.75 _CNV_A_R_ENSD_LINEA_22_CM 0. 16383.75 FORMAT "%8.2" /end CHARACTERISTIC
/begin CHARACTERISTIC Cxx_ac_is_in_cdn_ofs2 "Offset on the threshold determined by the derivate of engine speed when the air conditioning compressor is clutched and when we are not entered in active ISR at the end of a temporization" VALUE 0xa0021d20 _REC_S1VAL_20_u2 16383.75 _CNV_A_R_ENSD_LINEA_22_CM 0. 16383.75 FORMAT "%8.2" /end CHARACTERISTIC
/begin CHARACTERISTIC Cxx_ac_is_in_dly "Delay to enter in activate state after condition state with air conditioning compressor clutched (coming out IS)" VALUE 0xa0021d22 _REC_S1VAL_20_u2 655.35 _CNV_A_R_LINEAR_____32_CM 0. 655.35 FORMAT "%6.2" /end CHARACTERISTIC
/begin CHARACTERISTIC Cxx_ac_is_out_n_ofs "Offset about setpoint to exit condition state when acc is clutch" VALUE 0xa0021d24 _REC_S1VAL_20_u2 16383.75 _CNV_A_R_ENSD_LINEA_22_CM 0. 16383.75 FORMAT "%8.2" /end CHARACTERISTIC
/begin CHARACTERISTIC Cxx_fac_n_drv_d "Derivate filter factor" VALUE 0xa0021d26 _REC_S1VAL_20_u2 65.535 _CNV_A_R_LINEAR_____116_CM 0. 65.535 /end CHARACTERISTIC
/begin CHARACTERISTIC Cxx_fac_n_drv_fil "Derivate filter factor for derivate of engine speed for start engine state" VALUE 0xa0021d28 _REC_S1VAL_20_u2 65.535 _CNV_A_R_LINEAR_____116_CM 0. 65.535 /end CHARACTERISTIC
/begin CHARACTERISTIC Cxx_is_act_ofs "Offset about idle speed setpoint to create activate idle speed state threshold" VALUE 0xa0021d2a _REC_S1VAL_20_u2 16383.75 _CNV_A_R_ENSD_LINEA_22_CM 0. 16383.75 FORMAT "%8.2" /end CHARACTERISTIC
/begin CHARACTERISTIC Cxx_is_ast_ofs_zon "Zone of offset about idle speed setpoint to generate a setpoint in after start state" VALUE 0xa0021d2c _REC_S1VAL_20_u2 16383.75 _CNV_A_R_ENSD_LINEA_22_CM 0. 16383.75 FORMAT "%8.2" /end CHARACTERISTIC
/begin CHARACTERISTIC Cxx_is_cdn_h_sta_n_dly "Delay after start during threshold to exit condition state is increased" VALUE 0xa0021d2e _REC_S1VAL_20_u2 655.35 _CNV_A_R_LINEAR_____32_CM 0. 655.35 FORMAT "%6.2" /end CHARACTERISTIC
/begin CHARACTERISTIC Cxx_is_deci_in_dly "Delay to force activate state when engine speed is reacher" VALUE 0xa0021d30 _REC_S1VAL_20_u2 655.35 _CNV_A_R_LINEAR_____32_CM 0. 655.35 FORMAT "%6.2" /end CHARACTERISTIC
/begin CHARACTERISTIC Cxx_is_deci_in_n_thd "Threshold of engine speed beyond which the strategy of forced entry to ISR is inhibited" VALUE 0xa0021d32 _REC_S1VAL_20_u2 16383.75 _CNV_A_R_ENSD_LINEA_22_CM 0. 16383.75 FORMAT "%8.2" /end CHARACTERISTIC
/begin CHARACTERISTIC Cxx_is_fil_drv_n_max_ofs "Offset of (offset + zone of offset) about idle speed setpoint to generate a setpoint in after start state" VALUE 0xa0021d34 _REC_S1VAL_20_u2 16383.75 _CNV_A_R_ENSD_LINEA_22_CM 0. 16383.75 FORMAT "%8.2" /end CHARACTERISTIC
/begin CHARACTERISTIC Cxx_is_fil_drv_n_min "Threshold of hysteresis on engine speed to authorize a filtred derivate of engine speed" VALUE 0xa0021d36 _REC_S1VAL_20_u2 16383.75 _CNV_A_R_ENSD_LINEA_22_CM 0. 16383.75 FORMAT "%8.2" /end CHARACTERISTIC
/begin CHARACTERISTIC Cxx_is_in_cdn_ofs "Offset on the threshold determined by the derivate of engine speed" VALUE 0xa0021d38 _REC_S1VAL_20_u2 16383.75 _CNV_A_R_ENSD_LINEA_22_CM 0. 16383.75 FORMAT "%8.2" /end CHARACTERISTIC
/begin CHARACTERISTIC Cxx_is_in_cdn_ofs2 "Offset on the threshold determined by the derivate of engine speed when we are not entered in active ISR at the end of a temporization" VALUE 0xa0021d3a _REC_S1VAL_20_u2 16383.75 _CNV_A_R_ENSD_LINEA_22_CM 0. 16383.75 FORMAT "%8.2" /end CHARACTERISTIC
/begin CHARACTERISTIC Cxx_is_in_dly "Delay to enter in activate state after condition state (coming out IS)" VALUE 0xa0021d3c _REC_S1VAL_20_u2 655.35 _CNV_A_R_LINEAR_____32_CM 0. 655.35 FORMAT "%6.2" /end CHARACTERISTIC
/begin CHARACTERISTIC Cxx_is_in_pump_thd "Threshold below control can enter in activate state" VALUE 0xa0021d3e _REC_S1VAL_20_u2 1. _CNV_A_R_LINEAR_____189_CM 0. 1. FORMAT "%6.4" /end CHARACTERISTIC
/begin CHARACTERISTIC Cxx_is_in_wit_pdl_ofs "Offset about idle speed setpoint to enter in ISR with a powertrain setpoint request" VALUE 0xa0021d40 _REC_S1VAL_20_s2 16383.75 _CNV_A_R_ENSD_LINEA_22_CM -8192. 8191.75 FORMAT "%8.2" /end CHARACTERISTIC
/begin CHARACTERISTIC Cxx_is_n_act "Engine speed threshold under ISR calculation is authorised" VALUE 0xa0021d42 _REC_S1VAL_20_u2 16383.75 _CNV_A_R_ENSD_LINEA_22_CM 0. 16383.75 FORMAT "%8.2" /end CHARACTERISTIC
/begin CHARACTERISTIC Cxx_is_n_act_hys "Engine speed hysteresis to deactivate ISR" VALUE 0xa0021d44 _REC_S1VAL_20_u2 16383.75 _CNV_A_R_ENSD_LINEA_22_CM 0. 16383.75 FORMAT "%8.2" /end CHARACTERISTIC
/begin CHARACTERISTIC Cxx_is_n_stab_clc_fac "Stability engine speed factor in idle speed" VALUE 0xa0021d46 _REC_S1VAL_20_u2 1.998046875e-003 _CNV_A_R_LINEAR_____190_CM 0. 1.998046875e-003 FORMAT "%8.6" /end CHARACTERISTIC
/begin CHARACTERISTIC Cxx_is_n_stab_clc_ini "anti-pumping factor initialisation" VALUE 0xa0021d48 _REC_S1VAL_20_u2 1. _CNV_A_R_LINEAR_____189_CM 0. 1. FORMAT "%6.4" /end CHARACTERISTIC
/begin CHARACTERISTIC Cxx_is_n_stab_drv_thd "Stability derivative engine speed threshold in idle speed" VALUE 0xa0021d4a _REC_S1VAL_20_u2 8191. _CNV_A_R_LINEAR_____21_CM 0. 8191. FORMAT "%4.0" /end CHARACTERISTIC
/begin CHARACTERISTIC Cxx_is_out_ast_dly "Delay to enter in condition idle speed state after a start" VALUE 0xa0021d4c _REC_S1VAL_20_u2 655.35 _CNV_A_R_LINEAR_____32_CM 0. 655.35 FORMAT "%6.2" /end CHARACTERISTIC
/begin CHARACTERISTIC Cxx_is_out_drv_thd "Threshold about derivate of engine speed to exit of ISR" VALUE 0xa0021d4e _REC_S1VAL_20_s2 16383. _CNV_A_R_LINEAR_____21_CM -8192. 8191. FORMAT "%6.0" /end CHARACTERISTIC
/begin CHARACTERISTIC Cxx_is_out_n_ofs "Offset about setpoint to exit condition state" VALUE 0xa0021d50 _REC_S1VAL_20_u2 16383.75 _CNV_A_R_ENSD_LINEA_22_CM 0. 16383.75 FORMAT "%8.2" /end CHARACTERISTIC
/begin CHARACTERISTIC Cxx_is_out_n_ofs_sta "Offset about setpoint to exit activate state" VALUE 0xa0021d52 _REC_S1VAL_20_u2 16383.75 _CNV_A_R_ENSD_LINEA_22_CM 0. 16383.75 FORMAT "%8.2" /end CHARACTERISTIC
/begin CHARACTERISTIC Cxx_is_out_n_run_vh_thd "Threshold about engine speed to exit of ISR (vehicle running)" VALUE 0xa0021d54 _REC_S1VAL_20_u2 16383.75 _CNV_A_R_ENSD_LINEA_22_CM 0. 16383.75 FORMAT "%8.2" /end CHARACTERISTIC
/begin CHARACTERISTIC Cxx_is_out_n_stop_vh_thd "Threshold about engine speed to exit of ISR (vehicle stopped)" VALUE 0xa0021d56 _REC_S1VAL_20_u2 16383.75 _CNV_A_R_ENSD_LINEA_22_CM 0. 16383.75 FORMAT "%8.2" /end CHARACTERISTIC
/begin CHARACTERISTIC Cxx_is_out_pump_thd "Threshold above control can exit of activate state" VALUE 0xa0021d58 _REC_S1VAL_20_u2 1. _CNV_A_R_LINEAR_____189_CM 0. 1. FORMAT "%6.4" /end CHARACTERISTIC
/begin CHARACTERISTIC Cxx_is_out_wit_pdl_ofs "Offset about idle speed setpoint to exit of ISR with a powertrain setpoint request" VALUE 0xa0021d5a _REC_S1VAL_20_s2 16383.75 _CNV_A_R_ENSD_LINEA_22_CM -8192. 8191.75 FORMAT "%8.2" /end CHARACTERISTIC
/begin CHARACTERISTIC Cxx_n_drv_ast "Calibration of comparison of the derivate of engine speed for the access Ast - > Cdn" VALUE 0xa0021d5c _REC_S1VAL_20_s2 16383. _CNV_A_R_LINEAR_____21_CM -8192. 8191. FORMAT "%6.0" /end CHARACTERISTIC
/begin CHARACTERISTIC Cxx_n_drv_out "Calibration of comparison of the derivate of engine speed for the access Out or Tkof - > Cdn" VALUE 0xa0021d5e _REC_S1VAL_20_s2 16383. _CNV_A_R_LINEAR_____21_CM -8192. 8191. FORMAT "%6.0" /end CHARACTERISTIC
/begin CHARACTERISTIC Cxx_sta_stt_is_in_dly "Delay to enter in activate state  after condition state (coming engine start)" VALUE 0xa0021d60 _REC_S1VAL_20_u2 655.35 _CNV_A_R_LINEAR_____32_CM 0. 655.35 FORMAT "%6.2" /end CHARACTERISTIC
/begin AXIS_PTS Ctb_is_n_i_dif "Static error breakpoints for idle speed regulator" 0xa00346c8 Vxx_dif_n_sp _REC_A2AXS_20_u2 16383.75 _CNV_A_R_LINEAR_____182_CM 8 -8192. 8191.75 FORMAT "%8.2" /end AXIS_PTS
/begin AXIS_PTS Ctb_is_n_i_dif2 "Static error breakpoints for idle speed regulator" 0xa00346dc Vxx_dif_n_sp _REC_A2AXS_20_u2 16383.75 _CNV_A_R_LINEAR_____182_CM 8 -8192. 8191.75 FORMAT "%8.2" /end AXIS_PTS
/begin CHARACTERISTIC Cmp_is_i_err_gear_fac "Integral correction factor table dependent on gear ratio and static error." MAP 0xa00346f0 _REC_A1MAP_20_u2_u2_u1 2. _CNV_A_R_LINEAR_____191_CM 0. 2. FORMAT "%7.4"
 /begin AXIS_DESCR COM_AXIS Vxx_dif_n_sp _CNV_A_R_LINEAR_____182_CM 8 -8192. 8191.75 FORMAT "%8.2" AXIS_PTS_REF Ctb_is_n_i_dif2 /end AXIS_DESCR
 /begin AXIS_DESCR COM_AXIS Vxx_gear _CNV_A_R_LINEAR_____145_CM 8 -1. 6. READ_ONLY FORMAT "%2.0" AXIS_PTS_REF Ntb_gear /end AXIS_DESCR
/end CHARACTERISTIC
/begin CHARACTERISTIC Cmp_is_i_err_tco_fac "Integral correction factor table dependant on static error and coolant temperature" MAP 0xa0034770 _REC_A1MAP_20_u2_u2_u2 2. _CNV_A_R_LINEAR_____183_CM 0. 2. FORMAT "%11.8"
 /begin AXIS_DESCR COM_AXIS Vxx_dif_n_sp _CNV_A_R_LINEAR_____182_CM 8 -8192. 8191.75 FORMAT "%8.2" AXIS_PTS_REF Ctb_is_n_i_dif /end AXIS_DESCR
 /begin AXIS_DESCR COM_AXIS Vxx_tco _CNV_A_R_LINEAR_____110_CM 9 -40. 200. FORMAT "%6.1" AXIS_PTS_REF Ctb_is_tco /end AXIS_DESCR
/end CHARACTERISTIC
/begin CHARACTERISTIC Cmp_tco_ini_i "Initial Power value of Idle Speed regulator integral correction table" MAP 0xa0034800 _REC_A1MAP_20_u2_u1_u2 2047.96875 _CNV_A_R_LINEAR_____185_CM -1024. 1023.96875 FORMAT "%11.5"
 /begin AXIS_DESCR COM_AXIS Vxx_gear _CNV_A_R_LINEAR_____145_CM 8 -1. 6. READ_ONLY FORMAT "%2.0" AXIS_PTS_REF Ntb_gear /end AXIS_DESCR
 /begin AXIS_DESCR COM_AXIS Vxx_tco _CNV_A_R_LINEAR_____110_CM 9 -40. 200. FORMAT "%6.1" AXIS_PTS_REF Ctb_is_tco /end AXIS_DESCR
/end CHARACTERISTIC
/begin CHARACTERISTIC Ctp_tco_ini_i_sta "Initial power value of idle speed regulator integral correction table in start state" CURVE 0xa0034890 _REC_A1CUR_20_u2_u2 2047.96875 _CNV_A_R_LINEAR_____185_CM -1024. 1023.96875 FORMAT "%11.5"
 /begin AXIS_DESCR COM_AXIS Vxx_tco _CNV_A_R_LINEAR_____110_CM 8 -40. 200. FORMAT "%5.1" AXIS_PTS_REF Ctb_sta_tco /end AXIS_DESCR
/end CHARACTERISTIC
/begin CHARACTERISTIC Ctp_tco_tqe_max_is_i "Basic value of maximum integral torque correction table" CURVE 0xa00348a0 _REC_A1CUR_20_u2_u2 2047.96875 _CNV_A_R_LINEAR_____185_CM -1024. 1023.96875 FORMAT "%11.5"
 /begin AXIS_DESCR COM_AXIS Vxx_tco _CNV_A_R_LINEAR_____110_CM 9 -40. 200. FORMAT "%6.1" AXIS_PTS_REF Ctb_is_tco /end AXIS_DESCR
/end CHARACTERISTIC
/begin MEASUREMENT Vbx_is_i_cor_prev_sgn "Integral torque correction signum (1 = positive or nil; 0 = negative)" UBYTE _CNV_S_2_RANGE______3_CM 1 0. 0. 1. ECU_ADDRESS 0xd00070d7 BIT_MASK 0x1 /end MEASUREMENT
/begin MEASUREMENT Vtx_ini_i[0] "Initial torque value of Idle Speed Regulator integral correction" SWORD _CNV_A_R_LINEAR_____181_CM 1 0. -1024. 1023.96875 ECU_ADDRESS 0xd00048ca FORMAT "%11.5" /end MEASUREMENT
/begin MEASUREMENT Vtx_ini_i[1] "Initial torque value of Idle Speed Regulator integral correction" SWORD _CNV_A_R_LINEAR_____181_CM 1 0. -1024. 1023.96875 ECU_ADDRESS 0xd00048cc FORMAT "%11.5" /end MEASUREMENT
/begin MEASUREMENT Vxx_is_i_cor "Integral torque correction of Idle Speed Regulator" SWORD _CNV_A_R_LINEAR_____181_CM 1 0. -1024. 1023.96875 ECU_ADDRESS 0xd00048ce FORMAT "%11.5" /end MEASUREMENT
/begin MEASUREMENT Vxx_is_i_cor_ini "Initial torque value of idle speed regulator integral  correction" SLONG _CNV_A_R_LINEAR_____192_CM 1 0. -1024. 1023.999996875 ECU_ADDRESS 0xd0002bb0 FORMAT "%12.6" /end MEASUREMENT
/begin MEASUREMENT Vxx_is_i_cor_ini_ad "Integral torque correction of Idle Speed Regulator after update with the adaptive torque" SLONG _CNV_A_R_LINEAR_____192_CM 1 0. -1024. 1023.999996875 ECU_ADDRESS 0xd0002bb4 FORMAT "%12.6" /end MEASUREMENT
/begin MEASUREMENT Vxx_is_i_cor_prev "Integral torque correction of Idle Speed Regulator" SLONG _CNV_A_R_LINEAR_____192_CM 1 0. -1024. 1023.999996875 ECU_ADDRESS 0xd0002bb8 FORMAT "%12.6" /end MEASUREMENT
/begin MEASUREMENT Vxx_is_i_cor_wio_set "Integral torque correction of Idle Speed Regulator without ti fix integral correction under certain conditions" SLONG _CNV_A_R_LINEAR_____192_CM 1 0. -1024. 1023.999996875 ECU_ADDRESS 0xd0002bbc FORMAT "%12.6" /end MEASUREMENT
/begin MEASUREMENT Vxx_is_i_cor_wit_set "Integral torque correction of Idle Speed Regulator with fix integral correction under certain conditions" SLONG _CNV_A_R_LINEAR_____192_CM 1 0. -1024. 1023.999996875 ECU_ADDRESS 0xd0002bc0 FORMAT "%12.6" /end MEASUREMENT
/begin MEASUREMENT Vxx_is_i_fac "Current integral correction factor for Idle Speed regulator" UWORD _CNV_A_R_LINEAR_____191_CM 1 0. 0. 55.9990234375 ECU_ADDRESS 0xd00048d0 FORMAT "%7.4" /end MEASUREMENT
/begin MEASUREMENT Vxx_is_i_out_fil "Decrementation integral correction when idle speed regulation is disable" SLONG _CNV_A_R_LINEAR_____192_CM 1 0. -1024. 1023.999996875 ECU_ADDRESS 0xd0002bc4 FORMAT "%12.6" /end MEASUREMENT
/begin MEASUREMENT Vxx_is_n_is_i "Engine speed threshold to decrease or increase integral" UWORD _CNV_A_R_ENSD_LINEA_22_CM 1 0. 0. 16383.75 ECU_ADDRESS 0xd00048d2 FORMAT "%8.2" /end MEASUREMENT
/begin MEASUREMENT Vxx_is_n_is_i_grd "Torque gradient to decrease or increase the integral" UWORD _CNV_A_R_LINEAR_____193_CM 1 0. 0. 7.9998779296875 ECU_ADDRESS 0xd00048d4 FORMAT "%4.2" /end MEASUREMENT
/begin MEASUREMENT Vxx_max_is_i "Maximum torque value of idle speed regulator integral  correction" SWORD _CNV_A_R_LINEAR_____181_CM 1 0. -1024. 1023.96875 ECU_ADDRESS 0xd00048d6 FORMAT "%11.5" /end MEASUREMENT
/begin MEASUREMENT Vxx_min_is_i "Minimum torque value of idle speed regulator integral  correction" SWORD _CNV_A_R_LINEAR_____181_CM 1 0. -1024. 1023.96875 ECU_ADDRESS 0xd0005fd2 FORMAT "%11.5" /end MEASUREMENT
/begin MEASUREMENT Vxx_min_is_i_wio_blk "Minimum torque value of idle speed regulator integral  correction without the offset in case of blocked engine speed" SWORD _CNV_A_R_LINEAR_____181_CM 1 0. -1024. 1023.96875 ECU_ADDRESS 0xd0005fd4 FORMAT "%11.5" /end MEASUREMENT
/begin MEASUREMENT Vxx_tqe_ini_i "Initial Value of Idle Speed regulator integral torque correction (in ast and cdn states)" SLONG _CNV_A_R_LINEAR_____192_CM 1 0. -1024. 1023.999996875 ECU_ADDRESS 0xd0002bc8 FORMAT "%12.6" /end MEASUREMENT
/begin CHARACTERISTIC Cbx_i_set_is_cfm "Switch allowing to choose between a constant integral or a calculated integral on a brake pedal" VALUE 0xa0021d92 _REC_S1VAL_20_u1 1. _CNV_A_R_ECME_LINEA_0_CM 0. 1. FORMAT "%1.0" BIT_MASK 0x1 /end CHARACTERISTIC
/begin CHARACTERISTIC Cbx_ini_i_tco_cfm "Switch allowing to choose between an initialization of integral correction function of the losses or function of (Tco, gear ratio)" VALUE 0xa0021d93 _REC_S1VAL_20_u1 1. _CNV_A_R_ECME_LINEA_0_CM 0. 1. FORMAT "%1.0" BIT_MASK 0x1 /end CHARACTERISTIC
/begin CHARACTERISTIC Cbx_is_cdn_i_act_cfm "Boolean authorizing the integral correction to regulate in the start phase and in state Cdn of ISR" VALUE 0xa0021d94 _REC_S1VAL_20_u1 1. _CNV_A_R_ECME_LINEA_0_CM 0. 1. FORMAT "%1.0" BIT_MASK 0x1 /end CHARACTERISTIC
/begin CHARACTERISTIC Cbx_is_int_ftc_n_cfm "Switch to decrease the integral according to the engine speed" VALUE 0xa0021d95 _REC_S1VAL_20_u1 1. _CNV_A_R_ECME_LINEA_0_CM 0. 1. FORMAT "%1.0" BIT_MASK 0x1 /end CHARACTERISTIC
/begin CHARACTERISTIC Cxx_blk_n_i_fac_cor "Factor on integral torque correction in case of blocked engine speed" VALUE 0xa0021d70 _REC_S1VAL_20_u2 6.99 _CNV_A_R_LINEAR_____123_CM 0. 6.99 FORMAT "%6.2" /end CHARACTERISTIC
/begin CHARACTERISTIC Cxx_blk_n_min_is_i "Offset on minimum integral torque correction in case of blocked engine speed" VALUE 0xa0021d72 _REC_S1VAL_20_u2 1. _CNV_A_R_LINEAR_____161_CM 0. 1. /end CHARACTERISTIC
/begin CHARACTERISTIC Cxx_fil_is_i_sp "Value of progressive return of the integral correction torque in Out ISR state" VALUE 0xa0021d74 _REC_S1VAL_20_s2 2047.96875 _CNV_A_R_LINEAR_____181_CM -1024. 1023.96875 FORMAT "%11.5" /end CHARACTERISTIC
/begin CHARACTERISTIC Cxx_ini_i_fac "Factor on the losses to estimate the couple of initialization of the integral torque" VALUE 0xa0021d76 _REC_S1VAL_20_u2 1. _CNV_A_R_LINEAR_____161_CM 0. 1. FORMAT "%5.3" /end CHARACTERISTIC
/begin CHARACTERISTIC Cxx_is_i_out_fil_fac "Filtering factor of filtered integral correction" VALUE 0xa0021d78 _REC_S1VAL_20_u2 1. _CNV_A_R_LINEAR_____183_CM 0. 1. FORMAT "%11.9" /end CHARACTERISTIC
/begin CHARACTERISTIC Cxx_is_i_out_fil_wit_pdl_fac "Filtering factor of filtered integral correction without powertrain setpoint request" VALUE 0xa0021d7a _REC_S1VAL_20_u2 1. _CNV_A_R_LINEAR_____183_CM 0. 1. FORMAT "%11.8" /end CHARACTERISTIC
/begin CHARACTERISTIC Cxx_is_i_pft_rgn_fac "Integral correction factor in case of particulate filter regeneration" VALUE 0xa0021d7c _REC_S1VAL_20_u2 2. _CNV_A_R_LINEAR_____183_CM 0. 2. FORMAT "%11.8" /end CHARACTERISTIC
/begin CHARACTERISTIC Cxx_is_i_set_ofs "Engine speed threshold for fixed integral correction" VALUE 0xa0021d7e _REC_S1VAL_20_s2 16383.75 _CNV_A_R_ENSD_LINEA_22_CM -8192. 8191.75 FORMAT "%8.2" /end CHARACTERISTIC
/begin CHARACTERISTIC Cxx_is_i_tq_trs_ctl_mux_n_in "Engine speed threshold to fix integral correction under inter-system request" VALUE 0xa0021d80 _REC_S1VAL_20_s2 16383.75 _CNV_A_R_ENSD_LINEA_22_CM -8192. 8191.75 FORMAT "%8.2" /end CHARACTERISTIC
/begin CHARACTERISTIC Cxx_is_i_tq_trs_ctl_mux_n_out "Engine speed threshold to stop fixed integral correction under inter-system request" VALUE 0xa0021d82 _REC_S1VAL_20_s2 16383.75 _CNV_A_R_ENSD_LINEA_22_CM -8192. 8191.75 FORMAT "%8.2" /end CHARACTERISTIC
/begin CHARACTERISTIC Cxx_is_n_max_is_i "Engine speed threshold to decrease the positive integral" VALUE 0xa0021d84 _REC_S1VAL_20_u2 16383.75 _CNV_A_R_ENSD_LINEA_22_CM 0. 16383.75 FORMAT "%8.2" /end CHARACTERISTIC
/begin CHARACTERISTIC Cxx_is_n_max_is_i_grd "Torque gradient to decrease the integral" VALUE 0xa0021d86 _REC_S1VAL_20_u2 7.9998779296875 _CNV_A_R_LINEAR_____193_CM 0. 7.9998779296875 FORMAT "%4.2" /end CHARACTERISTIC
/begin CHARACTERISTIC Cxx_is_n_min_is_i "Engine speed threshold to increase the negative integral" VALUE 0xa0021d88 _REC_S1VAL_20_u2 16383.75 _CNV_A_R_ENSD_LINEA_22_CM 0. 16383.75 FORMAT "%8.2" /end CHARACTERISTIC
/begin CHARACTERISTIC Cxx_is_n_min_is_i_grd "Torque gradient to increase the integral" VALUE 0xa0021d8a _REC_S1VAL_20_u2 7.9998779296875 _CNV_A_R_LINEAR_____193_CM 0. 7.9998779296875 FORMAT "%4.2" /end CHARACTERISTIC
/begin CHARACTERISTIC Cxx_vh_run_max_is_i_ofs "Offset on the maximum saturation if the vehicle is running" VALUE 0xa0021d8c _REC_S1VAL_20_s2 2047.96875 _CNV_A_R_LINEAR_____181_CM -1024. 1023.96875 FORMAT "%11.5" /end CHARACTERISTIC
/begin CHARACTERISTIC Cxx_vh_run_min_is_i_fac "Factor of the losses to estimate the maximum saturation if the vehicle is running" VALUE 0xa0021d8e _REC_S1VAL_20_u2 1. _CNV_A_R_LINEAR_____161_CM 0. 1. /end CHARACTERISTIC
/begin CHARACTERISTIC Cxx_vh_stop_min_is_i_fac "Factor of the losses to estimate the minimum saturation if the vehicle is stopped" VALUE 0xa0021d90 _REC_S1VAL_20_u2 1. _CNV_A_R_LINEAR_____161_CM 0. 1. /end CHARACTERISTIC
/begin AXIS_PTS Ctb_is_n_p_dif "Static error breakpoints for idle speed regulator (case proportional)" 0xa00348b4 Vxx_dif_n_sp _REC_A2AXS_20_u2 16383.75 _CNV_A_R_LINEAR_____182_CM 8 -8192. 8191.75 FORMAT "%8.2" /end AXIS_PTS
/begin AXIS_PTS Ctb_is_n_p_dif2 "Static error breakpoint for idle speed regulator (case proportional)" 0xa00348c8 Vxx_dif_n_sp _REC_A2AXS_20_u2 16383.75 _CNV_A_R_LINEAR_____182_CM 8 -8192. 8191.75 FORMAT "%8.2" /end AXIS_PTS
/begin CHARACTERISTIC Cmp_is_p_err_gear_fac "Proportionnal correction factor table dependent on gear ratio and static error." MAP 0xa00348dc _REC_A1MAP_20_u2_u2_u1 2. _CNV_A_R_LINEAR_____194_CM 0. 2. FORMAT "%10.7"
 /begin AXIS_DESCR COM_AXIS Vxx_dif_n_sp _CNV_A_R_LINEAR_____182_CM 8 -8192. 8191.75 FORMAT "%8.2" AXIS_PTS_REF Ctb_is_n_p_dif2 /end AXIS_DESCR
 /begin AXIS_DESCR COM_AXIS Vxx_gear _CNV_A_R_LINEAR_____145_CM 8 -1. 6. READ_ONLY FORMAT "%2.0" AXIS_PTS_REF Ntb_gear /end AXIS_DESCR
/end CHARACTERISTIC
/begin CHARACTERISTIC Cmp_is_p_err_tco_fac "Proportionnal correction factor table dependant on static error and coolant temperature" MAP 0xa003495c _REC_A1MAP_20_u2_u2_u2 2. _CNV_A_R_LINEAR_____183_CM 0. 2. FORMAT "%11.8"
 /begin AXIS_DESCR COM_AXIS Vxx_dif_n_sp _CNV_A_R_LINEAR_____182_CM 8 -8192. 8191.75 FORMAT "%8.2" AXIS_PTS_REF Ctb_is_n_p_dif /end AXIS_DESCR
 /begin AXIS_DESCR COM_AXIS Vxx_tco _CNV_A_R_LINEAR_____110_CM 9 -40. 200. FORMAT "%6.1" AXIS_PTS_REF Ctb_is_tco /end AXIS_DESCR
/end CHARACTERISTIC
/begin CHARACTERISTIC Ctp_is_p_max "Maximum proportionnal torque correction Table dependent on coolant temperature" CURVE 0xa00349ec _REC_A1CUR_20_u2_u2 2047.96875 _CNV_A_R_LINEAR_____185_CM -1024. 1023.96875 FORMAT "%11.5"
 /begin AXIS_DESCR COM_AXIS Vxx_tco _CNV_A_R_LINEAR_____110_CM 9 -40. 200. FORMAT "%6.1" AXIS_PTS_REF Ctb_is_tco /end AXIS_DESCR
/end CHARACTERISTIC
/begin CHARACTERISTIC Ctp_is_p_min "Minimum proportionnal torque correction Table dependent on coolant temperature" CURVE 0xa0034a00 _REC_A1CUR_20_u2_u2 2047.96875 _CNV_A_R_LINEAR_____185_CM -1024. 1023.96875 FORMAT "%11.5"
 /begin AXIS_DESCR COM_AXIS Vxx_tco _CNV_A_R_LINEAR_____110_CM 9 -40. 200. FORMAT "%6.1" AXIS_PTS_REF Ctb_is_tco /end AXIS_DESCR
/end CHARACTERISTIC
/begin CHARACTERISTIC Ctp_is_p_sta_fac "Proportionnal Starting correction factor table dependent on Gear ratio and regulator (IS) static er" CURVE 0xa0034a14 _REC_A1CUR_20_u2_u2 7.9990234375 _CNV_A_R_LINEAR_____194_CM 0. 7.9990234375 FORMAT "%10.7"
 /begin AXIS_DESCR COM_AXIS Vxx_tco _CNV_A_R_LINEAR_____110_CM 8 -40. 200. FORMAT "%5.1" AXIS_PTS_REF Ctb_sta_tco /end AXIS_DESCR
/end CHARACTERISTIC
/begin MEASUREMENT Vtx_is_p_fac[0] "Current proportionnal correction factor" UWORD _CNV_A_R_LINEAR_____194_CM 1 0. 0. 7.9990234375 ECU_ADDRESS 0xd00048dc FORMAT "%12.9" /end MEASUREMENT
/begin MEASUREMENT Vtx_is_p_fac[1] "Current proportionnal correction factor" UWORD _CNV_A_R_LINEAR_____194_CM 1 0. 0. 7.9990234375 ECU_ADDRESS 0xd00048de FORMAT "%12.9" /end MEASUREMENT
/begin MEASUREMENT Vxx_dif_n_sp "" SWORD _CNV_A_R_ENSD_LINEA_22_CM 1 0. -8192. 8191.75 ECU_ADDRESS 0xd00048e0 FORMAT "%8.2" /end MEASUREMENT
/begin MEASUREMENT Vxx_is_gear "Gear engaged" UBYTE _CNV_A_R_LINEAR_____145_CM 1 0. -1. 6. ECU_ADDRESS 0xd00070d9 FORMAT "%2.0" /end MEASUREMENT
/begin MEASUREMENT Vxx_is_p_cor "Proportional correction" SWORD _CNV_A_R_LINEAR_____181_CM 1 0. -1024. 1023.96875 ECU_ADDRESS 0xd00048e2 FORMAT "%11.5" /end MEASUREMENT
/begin MEASUREMENT Vxx_max_is_p "Maximum proportionnal torque correction" SWORD _CNV_A_R_LINEAR_____181_CM 1 0. -1024. 1023.96875 ECU_ADDRESS 0xd00048e4 FORMAT "%11.5" /end MEASUREMENT
/begin MEASUREMENT Vxx_min_is_p "Minimum proportionnal torque correction" SWORD _CNV_A_R_LINEAR_____181_CM 1 0. -1024. 1023.96875 ECU_ADDRESS 0xd00048e6 FORMAT "%11.5" /end MEASUREMENT
/begin CHARACTERISTIC Cbx_tq_trs_ctl_mux_p_cfm "For minimal proportional saturation, consideration of the information intersystem torque request (=1) or no (=0)" VALUE 0xa0021dac _REC_S1VAL_20_u1 1. _CNV_A_R_ECME_LINEA_0_CM 0. 1. FORMAT "%1.0" BIT_MASK 0x1 /end CHARACTERISTIC
/begin CHARACTERISTIC Cxx_is_ctl_mux_min_p "Minimum proportional torque correction when an intersystem torque request is in progress" VALUE 0xa0021da2 _REC_S1VAL_20_s2 2047.96875 _CNV_A_R_LINEAR_____181_CM -1024. 1023.96875 FORMAT "%11.5" /end CHARACTERISTIC
/begin CHARACTERISTIC Cxx_is_p_dec_slop "Value of the decrease slop for proportional correction" VALUE 0xa0021da4 _REC_S1VAL_20_u2 2047.96875 _CNV_A_R_LINEAR_____195_CM -2047.96875 0. FORMAT "%8.2" /end CHARACTERISTIC
/begin CHARACTERISTIC Cxx_is_p_inc_slop "Value of the increase slop for proportional correction" VALUE 0xa0021da6 _REC_S1VAL_20_u2 2047.96875 _CNV_A_R_LINEAR_____196_CM 0. 2047.96875 FORMAT "%7.2" /end CHARACTERISTIC
/begin CHARACTERISTIC Cxx_is_p_pft_rgn_fac "Proportionnal correction factor in case of particulate filter regeneration" VALUE 0xa0021da8 _REC_S1VAL_20_u2 2. _CNV_A_R_LINEAR_____183_CM 0. 2. FORMAT "%11.8" /end CHARACTERISTIC
/begin CHARACTERISTIC Cxx_is_p_sta_max "Maximum proportionnal torque correction for the Start state" VALUE 0xa0021daa _REC_S1VAL_20_s2 2047.96875 _CNV_A_R_LINEAR_____181_CM -1024. 1023.96875 FORMAT "%11.5" /end CHARACTERISTIC
/begin MEASUREMENT Vbx_tkof_vs_ena "Active the take off" UBYTE _CNV_S_2_RANGE______3_CM 1 0. 0. 1. ECU_ADDRESS 0xd00070de BIT_MASK 0x1 /end MEASUREMENT
/begin CHARACTERISTIC Cxx_tkof_ena_vs_thd "Threshold of vehicle speed to enter in take off state" VALUE 0xa0021dc4 _REC_S1VAL_20_u2 655.35 _CNV_A_R_LINEAR_____125_CM 0. 655.35 FORMAT "%6.2" /end CHARACTERISTIC
/begin CHARACTERISTIC Cxx_tkof_end_vs_thd "Threshold of vehicle speed to exit of take off state" VALUE 0xa0021dc6 _REC_S1VAL_20_u2 655.35 _CNV_A_R_LINEAR_____125_CM 0. 655.35 FORMAT "%6.2" /end CHARACTERISTIC
/begin CHARACTERISTIC Cxx_tkof_n_grd_end_thd "derivate of engine speed threshold for take off" VALUE 0xa0021dc8 _REC_S1VAL_20_s2 16383. _CNV_A_R_LINEAR_____21_CM -8192. 8191. FORMAT "%5.0" /end CHARACTERISTIC
/begin CHARACTERISTIC Cxx_tkof_vs_n_rat_stop_thd "Threshold of vehicle and engine speed ratio to exit of take off state" VALUE 0xa0021dca _REC_S1VAL_20_u2 210. _CNV_A_R_LINEAR_____197_CM -10. 200. FORMAT "%6.2" /end CHARACTERISTIC
/begin AXIS_PTS Ctb_is_n_dif "Static error breakpoints for idle speed regulator" 0xa00346a4 Vxx_dif_n_sp _REC_A2AXS_20_u2 16383.75 _CNV_A_R_LINEAR_____182_CM 8 -8192. 8191.75 FORMAT "%8.2" /end AXIS_PTS
/begin CHARACTERISTIC Ctp_raw_p_d_fac "Percentage of P torque and D torque considered for the calculation of the raw torque" CURVE 0xa00346b8 _REC_A1CUR_20_u2_u2 1. _CNV_A_R_LINEAR_____183_CM 0. 1. FORMAT "%11.9"
 /begin AXIS_DESCR COM_AXIS Vxx_dif_n_sp _CNV_A_R_LINEAR_____182_CM 8 -8192. 8191.75 FORMAT "%8.2" AXIS_PTS_REF Ctb_is_n_dif /end AXIS_DESCR
/end CHARACTERISTIC
/begin MEASUREMENT Vxx_is_tqe_raw "Raw idle speed torque" SWORD _CNV_A_R_LINEAR_____181_CM 1 0. -1024. 1023.96875 ECU_ADDRESS 0xd00048b6 FORMAT "%11.5" /end MEASUREMENT
/begin MEASUREMENT Vxx_is_tqe_sp "Setpoint idle speed torque" SWORD _CNV_A_R_LINEAR_____181_CM 1 0. -1024. 1023.96875 ECU_ADDRESS 0xd00048b8 FORMAT "%11.5" /end MEASUREMENT
/begin MEASUREMENT Vxx_is_tqe_tgt "Target idle speed torque" SWORD _CNV_A_R_LINEAR_____181_CM 1 0. -1024. 1023.96875 ECU_ADDRESS 0xd00048ba FORMAT "%11.5" /end MEASUREMENT
/begin MEASUREMENT Vxx_raw_raw_is_tqe "Raw raw idle speed torque" SWORD _CNV_A_R_LINEAR_____181_CM 1 0. -1024. 1023.96875 ECU_ADDRESS 0xd00048bc FORMAT "%11.5" /end MEASUREMENT
/begin MEASUREMENT Vxx_raw_sp_is_tqe "Raw idle speed torque" SWORD _CNV_A_R_LINEAR_____181_CM 1 0. -1024. 1023.96875 ECU_ADDRESS 0xd00048be FORMAT "%11.5" /end MEASUREMENT
/begin MEASUREMENT Vxx_raw_tgt_is_tqe "Raw idle speed torque" SWORD _CNV_A_R_LINEAR_____181_CM 1 0. -1024. 1023.96875 ECU_ADDRESS 0xd00048c0 FORMAT "%11.5" /end MEASUREMENT
/begin CHARACTERISTIC Cbx_cdn_is_fil_tgt_cfm "Switch allowing to initialize the filtering (to obtain the raw an couple) in Cdn state" VALUE 0xa0021d6e _REC_S1VAL_20_u1 1. _CNV_A_R_ECME_LINEA_0_CM 0. 1. FORMAT "%1.0" BIT_MASK 0x1 /end CHARACTERISTIC
/begin CHARACTERISTIC Cbx_tq_pow_is_cfm "Switch allowing to choose between torques or their equivalence in power" VALUE 0xa0021d6f _REC_S1VAL_20_u1 1. _CNV_A_R_ECME_LINEA_0_CM 0. 1. FORMAT "%1.0" BIT_MASK 0x1 /end CHARACTERISTIC
/begin CHARACTERISTIC Cxx_is_tgt_ftc "Raw torque filter factor" VALUE 0xa0021d64 _REC_S1VAL_20_u2 65.535 _CNV_A_R_LINEAR_____116_CM 0. 65.535 /end CHARACTERISTIC
/begin CHARACTERISTIC Cxx_is_tgt_ftc_dec_slop "Decrement slop to raw torque filter factor" VALUE 0xa0021d66 _REC_S1VAL_20_u2 655.35 _CNV_A_R_LINEAR_____198_CM -655.35 0. FORMAT "%7.2" /end CHARACTERISTIC
/begin CHARACTERISTIC Cxx_is_tgt_ftc_inc_slop "Increment slop to raw torque filter factor" VALUE 0xa0021d68 _REC_S1VAL_20_u2 655.35 _CNV_A_R_LINEAR_____199_CM 0. 655.35 FORMAT "%6.2" /end CHARACTERISTIC
/begin CHARACTERISTIC Cxx_mfld_dly_dec_slop "Decrement slop to manifold time constant" VALUE 0xa0021d6a _REC_S1VAL_20_u2 655.35 _CNV_A_R_LINEAR_____198_CM -655.35 0. FORMAT "%7.2" /end CHARACTERISTIC
/begin CHARACTERISTIC Cxx_mfld_dly_inc_slop "Increment slop to manifold time constant" VALUE 0xa0021d6c _REC_S1VAL_20_u2 655.35 _CNV_A_R_LINEAR_____199_CM 0. 655.35 FORMAT "%6.2" /end CHARACTERISTIC
/begin MEASUREMENT Vbx_is_ad_cdn "All the conditions for the calculation of the adaptive are reunited" UBYTE _CNV_S_2_RANGE______3_CM 1 0. 0. 1. ECU_ADDRESS 0xd0007c97 BIT_MASK 0x1 /end MEASUREMENT
/begin MEASUREMENT Vxx_fil_is_i_cor "Filtered integral torque correction" SLONG _CNV_A_R_LINEAR_____192_CM 1 0. -1024. 1023.999996875 ECU_ADDRESS 0xd0002b68 FORMAT "%12.6" /end MEASUREMENT
/begin MEASUREMENT Vxx_fil_is_i_cor_ad "Filtered integral torque correction after update with the adaptive torque" SLONG _CNV_A_R_LINEAR_____192_CM 1 0. -1024. 1023.999996875 ECU_ADDRESS 0xd0002b6c FORMAT "%12.6" /end MEASUREMENT
/begin MEASUREMENT Vxx_fil_is_i_cor_ad_last "Filtered integral torque correction after update with the adaptive torque (one step of delay)" SLONG _CNV_A_R_LINEAR_____192_CM 1 0. -1024. 1023.999996875 ECU_ADDRESS 0xd0002b70 FORMAT "%12.6" /end MEASUREMENT
/begin MEASUREMENT Vxx_is_ad_tq_ini "Initialization of adaptive correction " SLONG _CNV_A_R_LINEAR_____192_CM 1 0. -1024. 1023.999996875 ECU_ADDRESS 0xd00035c8 FORMAT "%12.6" /end MEASUREMENT
/begin MEASUREMENT Vxx_is_ad_tq_last "Adaptive correction" SLONG _CNV_A_R_LINEAR_____192_CM 1 0. -1024. 1023.999996875 ECU_ADDRESS 0xd00035cc FORMAT "%12.6" /end MEASUREMENT
/begin MEASUREMENT Vxx_is_ad_tq_raw "Adaptive correction" SLONG _CNV_A_R_LINEAR_____192_CM 1 0. -1024. 1023.999996875 ECU_ADDRESS 0xd00035d0 FORMAT "%12.6" /end MEASUREMENT
/begin CHARACTERISTIC Cbx_is_ad_mdf_cfm "Authorize to calculate the adaptive torque when the flans turn" VALUE 0xa0021d08 _REC_S1VAL_20_u1 1. _CNV_A_R_ECME_LINEA_0_CM 0. 1. FORMAT "%1.0" BIT_MASK 0x1 /end CHARACTERISTIC
/begin CHARACTERISTIC Cxx_ac_pow "Maximum AC power to authorize calculation of adaptive torque" VALUE 0xa0021cee _REC_S1VAL_20_u2 655350. _CNV_A_R_LINEAR_____186_CM 0. 655350. FORMAT "%6.0" /end CHARACTERISTIC
/begin CHARACTERISTIC Cxx_ad_cor_dsb_dly "Delay of interdiction to learn adaptive torque after start" VALUE 0xa0021cf0 _REC_S1VAL_20_u2 655.35 _CNV_A_R_LINEAR_____32_CM 0. 655.35 FORMAT "%6.2" /end CHARACTERISTIC
/begin CHARACTERISTIC Cxx_dri_agb_ad_is_fil "Filtering factor for the calculation of the adaptive torque if automatic transmissionis in drive" VALUE 0xa0021cf2 _REC_S1VAL_20_u2 1. _CNV_A_R_LINEAR_____143_CM 0. 1. FORMAT "%10.9" /end CHARACTERISTIC
/begin CHARACTERISTIC Cxx_h_ad_is_alt_pow "High threshold on filtered alternator mechanical power to authorize the calculation of the adaptive torque" VALUE 0xa0021cf4 _REC_S1VAL_20_u2 655350. _CNV_A_R_LINEAR_____186_CM 0. 655350. FORMAT "%6.0" /end CHARACTERISTIC
/begin CHARACTERISTIC Cxx_is_ad_tq_dft "First value and default calibration of adaptive correction torque about erasing authorization after a clear diag info request from the" VALUE 0xa0021cf6 _REC_S1VAL_20_s2 2047.96875 _CNV_A_R_LINEAR_____181_CM -1024. 1023.96875 FORMAT "%11.5" /end CHARACTERISTIC
/begin CHARACTERISTIC Cxx_is_i_fil_fac1 "Filtering factor of integral torque if integral torque superior to filtered integral torque correction update by adaptive torque" VALUE 0xa0021cf8 _REC_S1VAL_20_u2 1. _CNV_A_R_LINEAR_____143_CM 0. 1. FORMAT "%11.9" /end CHARACTERISTIC
/begin CHARACTERISTIC Cxx_is_i_fil_fac2 "Filtering factor of integral torque if integral torque inferior to filtered integral torque correction update by adaptive torque update by adaptive torque" VALUE 0xa0021cfa _REC_S1VAL_20_u2 1. _CNV_A_R_LINEAR_____143_CM 0. 1. FORMAT "%11.9" /end CHARACTERISTIC
/begin CHARACTERISTIC Cxx_l_ad_is_alt_pow "Low threshold on filtered alternator mechanical power to authorize the calculation of the adaptive torque" VALUE 0xa0021cfc _REC_S1VAL_20_u2 655350. _CNV_A_R_LINEAR_____186_CM 0. 655350. FORMAT "%6.0" /end CHARACTERISTIC
/begin CHARACTERISTIC Cxx_max_is_ad_tq "Maximum of adaptive correction" VALUE 0xa0021cfe _REC_S1VAL_20_s2 2047.96875 _CNV_A_R_LINEAR_____181_CM -1024. 1023.96875 FORMAT "%11.5" /end CHARACTERISTIC
/begin CHARACTERISTIC Cxx_max_n_ad_sp_dif "Difference between engine speed and idle speed setpoint to authorize calculation of adaptive torque" VALUE 0xa0021d00 _REC_S1VAL_20_u2 16383.75 _CNV_A_R_LINEAR_____182_CM -8192. 8191.75 FORMAT "%8.2" /end CHARACTERISTIC
/begin CHARACTERISTIC Cxx_min_is_ad_tq "Minimum of adaptive correction" VALUE 0xa0021d02 _REC_S1VAL_20_s2 2047.96875 _CNV_A_R_LINEAR_____181_CM -1024. 1023.96875 FORMAT "%11.5" /end CHARACTERISTIC
/begin CHARACTERISTIC Cxx_min_tco_ad_cor "Minimum engine coolant temperature to authorize calculation of adaptive torque" VALUE 0xa0021d04 _REC_S1VAL_20_u2 240. _CNV_A_R_LINEAR_____110_CM -40. 200. FORMAT "%5.1" /end CHARACTERISTIC
/begin CHARACTERISTIC Cxx_neut_ad_is_fil "Filtering factor for the calculation of the adaptive torque if automatic or mechanical transmission is in neutral" VALUE 0xa0021d06 _REC_S1VAL_20_u2 1. _CNV_A_R_LINEAR_____143_CM 0. 1. FORMAT "%10.9" /end CHARACTERISTIC
/begin AXIS_PTS Ctb_n_dif_tkof "engine speed difference breakpoints table for take off" 0xa0034a24 NO_INPUT_QUANTITY _REC_A2AXS_20_u2 16383.75 _CNV_A_R_ENSD_LINEA_22_CM 5 0. 16383.75 FORMAT "%8.2" /end AXIS_PTS
/begin AXIS_PTS Ctb_n_drv_tkof "breakpoints table of derivative of engine speed difference for take off" 0xa0034a30 NO_INPUT_QUANTITY _REC_A2AXS_20_u2 16383. _CNV_A_R_LINEAR_____187_CM 5 -8192. 8191. FORMAT "%5.0" /end AXIS_PTS
/begin AXIS_PTS Ctb_n_tkof "engine speed breakpoints for take off" 0xa0034a3c Vxx_n _REC_A2AXS_20_u2 16383.75 _CNV_A_R_ENSD_LINEA_22_CM 5 0. 16383.75 FORMAT "%8.2" /end AXIS_PTS
/begin CHARACTERISTIC Ctp_n_dif_tkof_p "gain of proportionnal controller for take off" CURVE 0xa0034a48 _REC_A1CUR_20_u2_u2 0.2 _CNV_A_R_LINEAR_____200_CM -0.1 0.1 FORMAT "%8.5"
 /begin AXIS_DESCR COM_AXIS NO_INPUT_QUANTITY _CNV_A_R_ENSD_LINEA_22_CM 5 0. 16383.75 FORMAT "%8.2" AXIS_PTS_REF Ctb_n_dif_tkof /end AXIS_DESCR
/end CHARACTERISTIC
/begin CHARACTERISTIC Ctp_n_drv_tkof_d "gain of derivative correction for take off" CURVE 0xa0034a54 _REC_A1CUR_20_u2_u2 0.2 _CNV_A_R_LINEAR_____200_CM -0.1 0.1 FORMAT "%8.5"
 /begin AXIS_DESCR COM_AXIS NO_INPUT_QUANTITY _CNV_A_R_LINEAR_____187_CM 5 -8192. 8191. FORMAT "%5.0" AXIS_PTS_REF Ctb_n_drv_tkof /end AXIS_DESCR
/end CHARACTERISTIC
/begin CHARACTERISTIC Ctp_n_tkof_d "factor on derivate controler for take off" CURVE 0xa0021dae _REC_A1CUR_20_u1_u2 0.99609375 _CNV_A_R_LINEAR_____29_CM 0. 0.99609375 FORMAT "%10.8"
 /begin AXIS_DESCR COM_AXIS Vxx_n _CNV_A_R_ENSD_LINEA_22_CM 5 0. 16383.75 FORMAT "%8.2" AXIS_PTS_REF Ctb_n_tkof /end AXIS_DESCR
/end CHARACTERISTIC
/begin CHARACTERISTIC Ctp_n_tkof_p "factor on proportionnal controller for take off" CURVE 0xa0021db4 _REC_A1CUR_20_u1_u2 0.99609375 _CNV_A_R_LINEAR_____29_CM 0. 0.99609375 FORMAT "%10.8"
 /begin AXIS_DESCR COM_AXIS Vxx_n _CNV_A_R_ENSD_LINEA_22_CM 5 0. 16383.75 FORMAT "%8.2" AXIS_PTS_REF Ctb_n_tkof /end AXIS_DESCR
/end CHARACTERISTIC
/begin MEASUREMENT Vbx_tkof_tq_cor_ena "enable take off torque correction" UBYTE _CNV_S_2_RANGE______3_CM 1 0. 0. 1. ECU_ADDRESS 0xd00070db BIT_MASK 0x1 /end MEASUREMENT
/begin MEASUREMENT Vxx_tkof_d_cor "derivative take off correction" SWORD _CNV_A_R_LINEAR_____181_CM 1 0. -1024. 1023.96875 ECU_ADDRESS 0xd00048e8 FORMAT "%11.5" /end MEASUREMENT
/begin MEASUREMENT Vxx_tkof_p_cor "proportionnal take off correction" SWORD _CNV_A_R_LINEAR_____181_CM 1 0. -1024. 1023.96875 ECU_ADDRESS 0xd00048ea FORMAT "%11.5" /end MEASUREMENT
/begin MEASUREMENT Vxx_tkof_tqe_cor "take off torque correction" SWORD _CNV_A_R_LINEAR_____181_CM 1 0. -1024. 1023.96875 ECU_ADDRESS 0xd00048ec FORMAT "%11.5" /end MEASUREMENT
/begin CHARACTERISTIC Cxx_ct_stop_tkof_ftc "filtering time constant for take off torque in exit of activation conditions." VALUE 0xa0021dc2 _REC_S1VAL_20_u1 2.55 _CNV_A_R_LINEAR_____32_CM 0. 2.55 FORMAT "%4.2" /end CHARACTERISTIC
/begin CHARACTERISTIC Cxx_stop_tkof_ftc "filtering time constant for take off torque in exit of activation conditions." VALUE 0xa0021dc3 _REC_S1VAL_20_u1 2.55 _CNV_A_R_LINEAR_____32_CM 0. 2.55 FORMAT "%4.2" /end CHARACTERISTIC
/begin CHARACTERISTIC Cxx_tkof_tq_d_max "maximum derivative take off correction" VALUE 0xa0021dba _REC_S1VAL_20_s2 2047.96875 _CNV_A_R_LINEAR_____181_CM -1024. 1023.96875 FORMAT "%11.5" /end CHARACTERISTIC
/begin CHARACTERISTIC Cxx_tkof_tq_d_min "minimum derivative take off correction" VALUE 0xa0021dbc _REC_S1VAL_20_s2 2047.96875 _CNV_A_R_LINEAR_____181_CM -1024. 1023.96875 FORMAT "%11.5" /end CHARACTERISTIC
/begin CHARACTERISTIC Cxx_tkof_tq_p_max "maximum proportionnal take off correction" VALUE 0xa0021dbe _REC_S1VAL_20_s2 2047.96875 _CNV_A_R_LINEAR_____181_CM -1024. 1023.96875 FORMAT "%11.5" /end CHARACTERISTIC
/begin CHARACTERISTIC Cxx_tkof_tq_p_min "minimum proportionnal take off correction" VALUE 0xa0021dc0 _REC_S1VAL_20_s2 2047.96875 _CNV_A_R_LINEAR_____181_CM -1024. 1023.96875 FORMAT "%11.5" /end CHARACTERISTIC
/begin MEASUREMENT Vbx_df_isr_h_lvl "OBD idle speed overshoot detected failure" UBYTE _CNV_S_2_RANGE______3_CM 1 0. 0. 1. ECU_ADDRESS 0xd0007c9a BIT_MASK 0x1 /end MEASUREMENT
/begin MEASUREMENT Vbx_df_isr_l_lvl "OBD idle speed undershoot detected failure" UBYTE _CNV_S_2_RANGE______3_CM 1 0. 0. 1. ECU_ADDRESS 0xd0007c9b BIT_MASK 0x1 /end MEASUREMENT
/begin CHARACTERISTIC Cxx_dfdec_isr_h_lvl "OBD idle speed overshoot detected failure counter decrement" VALUE 0xa0021d96 _REC_S1VAL_20_u2 65535. _CNV_A_R_ECME_LINEA_0_CM 0. 65535. FORMAT "%5.0" /end CHARACTERISTIC
/begin CHARACTERISTIC Cxx_dfdec_isr_l_lvl "OBD idle speed undershoot detected failure counter decrement" VALUE 0xa0021d98 _REC_S1VAL_20_u2 65535. _CNV_A_R_ECME_LINEA_0_CM 0. 65535. FORMAT "%5.0" /end CHARACTERISTIC
/begin CHARACTERISTIC Cxx_dfinc_isr_h_lvl "OBD idle speed overshoot detected failure counter increment" VALUE 0xa0021d9a _REC_S1VAL_20_u2 65535. _CNV_A_R_ECME_LINEA_0_CM 0. 65535. FORMAT "%5.0" /end CHARACTERISTIC
/begin CHARACTERISTIC Cxx_dfinc_isr_l_lvl "OBD idle speed undershoot detected failure counter increment" VALUE 0xa0021d9c _REC_S1VAL_20_u2 65535. _CNV_A_R_ECME_LINEA_0_CM 0. 65535. FORMAT "%5.0" /end CHARACTERISTIC
/begin CHARACTERISTIC Cxx_isr_h_lvl_obd "Threshold of difference of engine speed detecting an overshoot" VALUE 0xa0021d9e _REC_S1VAL_20_s2 16383.75 _CNV_A_R_ENSD_LINEA_22_CM -8192. 8191.75 FORMAT "%8.2" /end CHARACTERISTIC
/begin CHARACTERISTIC Cxx_isr_l_lvl_obd "Threshold of difference of engine speed detecting an undershoot" VALUE 0xa0021da0 _REC_S1VAL_20_s2 16383.75 _CNV_A_R_ENSD_LINEA_22_CM -8192. 8191.75 FORMAT "%8.2" /end CHARACTERISTIC
/begin MEASUREMENT Vbx_is_loop_diag_cfm "Idle Speed loop diagnosis configuration" UBYTE _CNV_S_2_RANGE______3_CM 1 0. 0. 1. ECU_ADDRESS 0xd0007c9e BIT_MASK 0x1 /end MEASUREMENT
/begin CHARACTERISTIC Cbx_is_loop_diag_cfm "Choice of Idle Speed loop diagnosis configuration" VALUE 0xa0021dad _REC_S1VAL_20_u1 1. _CNV_A_R_ECME_LINEA_0_CM 0. 1. FORMAT "%1.0" BIT_MASK 0x1 /end CHARACTERISTIC
/begin MEASUREMENT Vbx_is_fac_cho "Boolean allowing to fall over on specific PID coefficients" UBYTE _CNV_S_2_RANGE______3_CM 1 0. 0. 1. ECU_ADDRESS 0xd00070a6 BIT_MASK 0x1 /end MEASUREMENT
/begin CHARACTERISTIC Ctp_aut_eng_n_thd "Table of engine speed threshold used to declare the autonomous state" CURVE 0xa0034f24 _REC_A1CUR_20_u2_u2 16383.75 _CNV_A_R_ENSD_LINEA_22_CM 0. 16383.75 FORMAT "%8.2"
 /begin AXIS_DESCR COM_AXIS Vxx_tco _CNV_A_R_LINEAR_____110_CM 9 -40. 200. FORMAT "%5.1" AXIS_PTS_REF Ctb_tco2 /end AXIS_DESCR
/end CHARACTERISTIC
/begin CHARACTERISTIC Ctp_sta_dly "Table of driven delay function of the coolant temperature" CURVE 0xa0034f38 _REC_A1CUR_20_u2_u2 655.35 _CNV_A_R_LINEAR_____32_CM 0. 655.35 FORMAT "%6.2"
 /begin AXIS_DESCR COM_AXIS Vxx_tco _CNV_A_R_LINEAR_____110_CM 9 -40. 200. FORMAT "%5.1" AXIS_PTS_REF Ctb_tco2 /end AXIS_DESCR
/end CHARACTERISTIC
/begin MEASUREMENT Vbx_trs_eng_aut "Transition used to past in the autonomous state" UBYTE _CNV_S_2_RANGE______3_CM 1 0. 0. 1. ECU_ADDRESS 0xd0007121 BIT_MASK 0x1 /end MEASUREMENT
/begin MEASUREMENT Vsx_eng "Engine states" UBYTE _CNV_A_R_ECME_LINEA_0_CM 1 0. 0. 255. ECU_ADDRESS 0xd0007122 FORMAT "%3.0" /end MEASUREMENT
/begin MEASUREMENT Vsx_prev_eng "Previous engine states" UBYTE _CNV_A_R_ECME_LINEA_0_CM 1 0. 0. 255. ECU_ADDRESS 0xd0007123 FORMAT "%3.0" /end MEASUREMENT
/begin CHARACTERISTIC Cxx_aut_eng_n_thd_h "Engine speed threshold used to declare the autonomous engine state" VALUE 0xa0021e9e _REC_S1VAL_20_u2 16383.75 _CNV_A_R_ENSD_LINEA_22_CM 0. 16383.75 FORMAT "%8.2" /end CHARACTERISTIC
/begin CHARACTERISTIC Cxx_drvn_eng_n_thd_h "High threshold of engine speed used to initialize the timer" VALUE 0xa0021ea0 _REC_S1VAL_20_u2 16383.75 _CNV_A_R_ENSD_LINEA_22_CM 0. 16383.75 FORMAT "%8.2" /end CHARACTERISTIC
/begin CHARACTERISTIC Cxx_drvn_eng_n_thd_l "Low threshold of engine speed used to initialize the timer" VALUE 0xa0021ea2 _REC_S1VAL_20_u2 16383.75 _CNV_A_R_ENSD_LINEA_22_CM 0. 16383.75 FORMAT "%8.2" /end CHARACTERISTIC
/begin MEASUREMENT Vbx_frst_sta_done "" UBYTE _CNV_S_2_RANGE______3_CM 1 0. 0. 1. DISPLAY_IDENTIFIER SmStaSpv_NVM.Vbx_frst_sta_done_NVM ECU_ADDRESS 0xd000711a BIT_MASK 0x1 /end MEASUREMENT
/begin MEASUREMENT Vbx_clu_stal "" UBYTE _CNV_S_2_RANGE______3_CM 1 0. 0. 1. DISPLAY_IDENTIFIER SmStaSpv_NVM.Vbx_clu_stal_NVM ECU_ADDRESS 0xd000711b BIT_MASK 0x1 /end MEASUREMENT
/begin MEASUREMENT Vbx_swlk_stal "" UBYTE _CNV_S_2_RANGE______3_CM 1 0. 0. 1. DISPLAY_IDENTIFIER SmStaSpv_NVM.Vbx_swlk_stal_NVM ECU_ADDRESS 0xd000711c BIT_MASK 0x1 /end MEASUREMENT
/begin MEASUREMENT Vbx_mem_swlk "" UBYTE _CNV_S_2_RANGE______3_CM 1 0. 0. 1. DISPLAY_IDENTIFIER SmStaSpv_NVM.Vbx_mem_swlk_NVM ECU_ADDRESS 0xd000711d BIT_MASK 0x1 /end MEASUREMENT
/begin MEASUREMENT Vbx_df_actr_rly_oc "Open Circuit of actuators relay detected failure" UBYTE _CNV_S_2_RANGE______3_CM 1 0. 0. 1. ECU_ADDRESS 0xd00065a0 BIT_MASK 0x1 /end MEASUREMENT
/begin MEASUREMENT Vbx_df_actr_rly_scg "Short Circuit to Ground of actuators relay detected failure" UBYTE _CNV_S_2_RANGE______3_CM 1 0. 0. 1. ECU_ADDRESS 0xd00065a1 BIT_MASK 0x1 /end MEASUREMENT
/begin MEASUREMENT Vbx_df_actr_rly_scw "Short Circuit to battery of actuators relay detected failure" UBYTE _CNV_S_2_RANGE______3_CM 1 0. 0. 1. ECU_ADDRESS 0xd00065a2 BIT_MASK 0x1 /end MEASUREMENT
/begin MEASUREMENT Vbx_df_pws_1_h "Power supply 1 voltage above max threshold detected failure" UBYTE _CNV_S_2_RANGE______3_CM 1 0. 0. 1. ECU_ADDRESS 0xd00065a8 BIT_MASK 0x1 /end MEASUREMENT
/begin MEASUREMENT Vbx_df_pws_1_l "Power supply 1 voltage below min threshold detected failure" UBYTE _CNV_S_2_RANGE______3_CM 1 0. 0. 1. ECU_ADDRESS 0xd00065a9 BIT_MASK 0x1 /end MEASUREMENT
/begin MEASUREMENT Vbx_df_pws_2_h "Power supply 2 voltage above max threshold detected failure" UBYTE _CNV_S_2_RANGE______3_CM 1 0. 0. 1. ECU_ADDRESS 0xd00065aa BIT_MASK 0x1 /end MEASUREMENT
/begin MEASUREMENT Vbx_df_pws_2_l "Power supply 2 voltage below min threshold detected failure" UBYTE _CNV_S_2_RANGE______3_CM 1 0. 0. 1. ECU_ADDRESS 0xd00065ab BIT_MASK 0x1 /end MEASUREMENT
/begin MEASUREMENT Vbx_df_pws_3_h "Power supply 3 voltage above max threshold detected failure" UBYTE _CNV_S_2_RANGE______3_CM 1 0. 0. 1. ECU_ADDRESS 0xd00065ac BIT_MASK 0x1 /end MEASUREMENT
/begin MEASUREMENT Vbx_df_pws_3_l "Power supply 3 voltage below min threshold detected failure" UBYTE _CNV_S_2_RANGE______3_CM 1 0. 0. 1. ECU_ADDRESS 0xd00065ad BIT_MASK 0x1 /end MEASUREMENT
/begin MEASUREMENT Vbx_diag_ena_actr_rly_oc "Open Circuit of actuators relay diagnosis information available" UBYTE _CNV_S_2_RANGE______3_CM 1 0. 0. 1. ECU_ADDRESS 0xd00065a3 BIT_MASK 0x1 /end MEASUREMENT
/begin MEASUREMENT Vbx_diag_ena_actr_rly_scg "Short Circuit to Ground of actuators relay diagnosis information available" UBYTE _CNV_S_2_RANGE______3_CM 1 0. 0. 1. ECU_ADDRESS 0xd00065a4 BIT_MASK 0x1 /end MEASUREMENT
/begin MEASUREMENT Vbx_diag_ena_actr_rly_scw "Short Circuit to battery of actuators relay diagnosis information available" UBYTE _CNV_S_2_RANGE______3_CM 1 0. 0. 1. ECU_ADDRESS 0xd00065a5 BIT_MASK 0x1 /end MEASUREMENT
/begin MEASUREMENT Vbx_diag_ena_pws_1_h "Diagnosis condition for diagnosis pws_1 high level" UBYTE _CNV_S_2_RANGE______3_CM 1 0. 0. 1. ECU_ADDRESS 0xd00065ae BIT_MASK 0x1 /end MEASUREMENT
/begin MEASUREMENT Vbx_diag_ena_pws_1_l "Diagnosis condition for diagnosis pws_1 low level" UBYTE _CNV_S_2_RANGE______3_CM 1 0. 0. 1. ECU_ADDRESS 0xd00065af BIT_MASK 0x1 /end MEASUREMENT
/begin MEASUREMENT Vbx_diag_ena_pws_2_h "Diagnosis condition for diagnosis pws_2 high level" UBYTE _CNV_S_2_RANGE______3_CM 1 0. 0. 1. ECU_ADDRESS 0xd00065b0 BIT_MASK 0x1 /end MEASUREMENT
/begin MEASUREMENT Vbx_diag_ena_pws_2_l "Diagnosis condition for diagnosis pws_2 low level" UBYTE _CNV_S_2_RANGE______3_CM 1 0. 0. 1. ECU_ADDRESS 0xd00065b1 BIT_MASK 0x1 /end MEASUREMENT
/begin MEASUREMENT Vbx_diag_ena_pws_3_h "Diagnosis condition for diagnosis pws_3 high level" UBYTE _CNV_S_2_RANGE______3_CM 1 0. 0. 1. ECU_ADDRESS 0xd00065b2 BIT_MASK 0x1 /end MEASUREMENT
/begin MEASUREMENT Vbx_diag_ena_pws_3_l "Diagnosis condition for diagnosis pws_3 low level" UBYTE _CNV_S_2_RANGE______3_CM 1 0. 0. 1. ECU_ADDRESS 0xd00065b3 BIT_MASK 0x1 /end MEASUREMENT
/begin MEASUREMENT Vbx_ecu_rst "Flag indicating that a ECU reset has occured during the trip." UBYTE _CNV_S_2_RANGE______3_CM 1 0. 0. 1. ECU_ADDRESS 0xd00065b7 BIT_MASK 0x1 /end MEASUREMENT
/begin MEASUREMENT Vbx_pws3_cfm "Boolean indicating a third power supply present at ECU ignition" UBYTE _CNV_S_2_RANGE______3_CM 1 0. 0. 1. ECU_ADDRESS 0xd00065b8 BIT_MASK 0x1 /end MEASUREMENT
/begin MEASUREMENT Vxx_raw_pws_1 "Sensors power supply 1 voltage raw acquisition" UWORD _CNV_A_R_LINEAR_____107_CM 1 0. 0. 25000. ECU_ADDRESS 0xd0003f18 FORMAT "%5.0" /end MEASUREMENT
/begin MEASUREMENT Vxx_raw_pws_2 "Sensors power supply 2 voltage raw acquisition" UWORD _CNV_A_R_LINEAR_____107_CM 1 0. 0. 25000. ECU_ADDRESS 0xd0003f1a FORMAT "%5.0" /end MEASUREMENT
/begin MEASUREMENT Vxx_raw_pws_3 "Sensors power supply 3 voltage raw acquisition" UWORD _CNV_A_R_LINEAR_____107_CM 1 0. 0. 25000. ECU_ADDRESS 0xd0003f1c FORMAT "%5.0" /end MEASUREMENT
/begin MEASUREMENT lv_err_vcc_1 "error flag for diagnosis instance Vcc_1" UBYTE _CNV_S_2_RANGE______3_CM 1 0. 0. 1. ECU_ADDRESS 0xd00065b4 /end MEASUREMENT
/begin MEASUREMENT lv_err_vcc_2 "eroor flag for diagnosis instance Vcc_2" UBYTE _CNV_S_2_RANGE______3_CM 1 0. 0. 1. ECU_ADDRESS 0xd00065b5 /end MEASUREMENT
/begin MEASUREMENT lv_err_vcc_3 "eroor flag for diagnosis instance Vcc_3" UBYTE _CNV_S_2_RANGE______3_CM 1 0. 0. 1. ECU_ADDRESS 0xd00065b6 /end MEASUREMENT
/begin MEASUREMENT lv_main_rly_pwl "Flag which indicates if main Relay is stuck to 12V" UBYTE _CNV_S_2_RANGE______3_CM 1 0. 0. 1. ECU_ADDRESS 0xd000de66 BIT_MASK 0x1 /end MEASUREMENT
/begin MEASUREMENT lv_main_rly_pwl_2 "This flag is a copy of lv_main_rly_pwl" UBYTE _CNV_S_2_RANGE______3_CM 1 0. 0. 1. ECU_ADDRESS 0xd000de68 BIT_MASK 0x1 /end MEASUREMENT
/begin MEASUREMENT lv_mu_inh_pwl_tran_es_el "LV request to shut off MU, \"point of no return\" for ECU shut down" UBYTE _CNV_S_2_RANGE______3_CM 1 0. 0. 1. ECU_ADDRESS 0xd000659f BIT_MASK 0x1 /end MEASUREMENT
/begin MEASUREMENT lv_pwl_rst_wdt_asw "Power latch phase is ended: beginning of system shutdown mechanism" UBYTE _CNV_S_2_RANGE______3_CM 1 0. 0. 1. ECU_ADDRESS 0xd00065a6 BIT_MASK 0x1 /end MEASUREMENT
/begin MEASUREMENT lv_pwl_unlock_cdn_asw "Main relay control command state (0H=relay shall be switched off, 1H= relay shall be switched on)" UBYTE _CNV_S_2_RANGE______3_CM 1 0. 0. 1. ECU_ADDRESS 0xd00065a7 BIT_MASK 0x1 /end MEASUREMENT
/begin MEASUREMENT lv_rly_main "Main relay control command state (0H=relay shall be switched off, 1H= relay shall be switched on)" UBYTE _CNV_S_2_RANGE______3_CM 1 0. 0. 1. ECU_ADDRESS 0xd000659e BIT_MASK 0x1 /end MEASUREMENT
/begin MEASUREMENT t_main_rly_pwl "Time used for the main relay diagnostic" UWORD _CNV_A_R_LINEAR_____201_CM 1 0. 0. 65535. ECU_ADDRESS 0xd0004f44 FORMAT "%5.0" /end MEASUREMENT
/begin CHARACTERISTIC Cbx_pws3_cfm "3rd power supply present" VALUE 0xa0020b0a _REC_S1VAL_20_u1 1. _CNV_S_2_RANGE______3_CM 0. 1. /end CHARACTERISTIC
/begin CHARACTERISTIC lc_rly_main_pwl_on "Logical calibration to activate main relay diag" VALUE 0xa0020b4f _REC_S1VAL_20_u1 1. _CNV_A_R_ECME_LINEA_0_CM 0. 1. FORMAT "%1.0" /end CHARACTERISTIC
/begin MEASUREMENT Vbx_df_sens_map_h "Manifold pressure sensor high signal detected failure" UBYTE _CNV_S_2_RANGE______3_CM 1 0. 0. 1. ECU_ADDRESS 0xd00064c4 BIT_MASK 0x1 /end MEASUREMENT
/begin MEASUREMENT Vbx_df_sens_map_l "Manifold pressure sensor low signal detected failure" UBYTE _CNV_S_2_RANGE______3_CM 1 0. 0. 1. ECU_ADDRESS 0xd00064c5 BIT_MASK 0x1 /end MEASUREMENT
/begin MEASUREMENT Vbx_df_sens_spg_h "Boost pressure sensor high signal detected failure" UBYTE _CNV_S_2_RANGE______3_CM 1 0. 0. 1. ECU_ADDRESS 0xd00064c8 BIT_MASK 0x1 /end MEASUREMENT
/begin MEASUREMENT Vbx_df_sens_spg_l "Boost pressure sensor low signal detected failure" UBYTE _CNV_S_2_RANGE______3_CM 1 0. 0. 1. ECU_ADDRESS 0xd00064c9 BIT_MASK 0x1 /end MEASUREMENT
/begin MEASUREMENT Vbx_diag_ena_sens_map_h "Manifold pressure sensor high signal diagnostic information available" UBYTE _CNV_S_2_RANGE______3_CM 1 0. 0. 1. ECU_ADDRESS 0xd00064c6 BIT_MASK 0x1 /end MEASUREMENT
/begin MEASUREMENT Vbx_diag_ena_sens_map_l "Manifold pressure sensor low signal diagnostic information available" UBYTE _CNV_S_2_RANGE______3_CM 1 0. 0. 1. ECU_ADDRESS 0xd00064c7 BIT_MASK 0x1 /end MEASUREMENT
/begin MEASUREMENT Vbx_diag_ena_sens_spg_h "Boost pressure sensor high signal diagnostic information available" UBYTE _CNV_S_2_RANGE______3_CM 1 0. 0. 1. ECU_ADDRESS 0xd00064ca BIT_MASK 0x1 /end MEASUREMENT
/begin MEASUREMENT Vbx_diag_ena_sens_spg_l "Boost pressure sensor low signal diagnostic information available" UBYTE _CNV_S_2_RANGE______3_CM 1 0. 0. 1. ECU_ADDRESS 0xd00064cb BIT_MASK 0x1 /end MEASUREMENT
/begin MEASUREMENT Vp_map_fil "Filtered Voltage of the intake manifold Pressure Sensor" UWORD _CNV_A_R_LINEAR_____14_CM 1 0. 0. 4.99984741210938 ECU_ADDRESS 0xd0003eae FORMAT "%6.4" /end MEASUREMENT
/begin MEASUREMENT Vxx_sens_map_v "Raw acquisition of the manifold pressure" UWORD _CNV_A_R_LINEAR_____107_CM 1 0. 0. 25000. ECU_ADDRESS 0xd0003eac FORMAT "%5.0" /end MEASUREMENT
/begin MEASUREMENT Vxx_sens_spg_v "Raw acquisition of the supercharging pressure" UWORD _CNV_A_R_LINEAR_____107_CM 1 0. 0. 25000. ECU_ADDRESS 0xd0003ea8 FORMAT "%5.0" /end MEASUREMENT
/begin MEASUREMENT lv_err_map "MAP sensor error detected" UBYTE _CNV_S_2_RANGE______3_CM 1 0. 0. 1. ECU_ADDRESS 0xd00064cc BIT_MASK 0x1 /end MEASUREMENT
/begin MEASUREMENT vp_map_max "Maximum manifold air pressure per segment in voltage" UWORD _CNV_A_R_LINEAR_____14_CM 1 0. 0. 4.99984741210938 ECU_ADDRESS 0xd0003eb0 FORMAT "%6.4" /end MEASUREMENT
/begin MEASUREMENT vp_map_max_inter "Internal maximum manifold air pressure per segment in voltage" UWORD _CNV_A_R_LINEAR_____14_CM 1 0. 0. 4.99984741210938 ECU_ADDRESS 0xd0004eb8 FORMAT "%6.4" /end MEASUREMENT
/begin MEASUREMENT vp_map_min "Minimum manifold air pressure per segment in voltage" UWORD _CNV_A_R_LINEAR_____14_CM 1 0. 0. 4.99984741210938 ECU_ADDRESS 0xd0003eb2 FORMAT "%6.4" /end MEASUREMENT
/begin MEASUREMENT vp_map_min_inter "Internal minimum manifold air pressure per segment in voltage" UWORD _CNV_A_R_LINEAR_____14_CM 1 0. 0. 4.99984741210938 ECU_ADDRESS 0xd0004eba FORMAT "%6.4" /end MEASUREMENT
/begin MEASUREMENT vp_map_mv "Mean value Voltage of the intake manifold pressure sensor (for diagnosis)" UWORD _CNV_A_R_LINEAR_____14_CM 1 0. 0. 4.99984741210938 ECU_ADDRESS 0xd0003eb4 FORMAT "%6.4" /end MEASUREMENT
/begin MEASUREMENT vp_put_mv "Mean value Voltage of the pressure upstream throttle" UWORD _CNV_A_R_LINEAR_____14_CM 1 0. 0. 4.99984741210938 ECU_ADDRESS 0xd0003eb6 FORMAT "%6.4" /end MEASUREMENT
/begin CHARACTERISTIC Cxx_hw_ftc "Hardware filter time constant" VALUE 0xa0020a98 _REC_S1VAL_20_u2 65535. _CNV_A_R_LINEAR_____202_CM 0. 65535. FORMAT "%5.0" /end CHARACTERISTIC
/begin CHARACTERISTIC c_vp_map_mv_max_diag "Threshold value VP_MAP_MV to detect Short circuit in signal wire to VB" VALUE 0xa0020aee _REC_S1VAL_20_u2 4.99984741210938 _CNV_A_R_LINEAR_____14_CM 0. 4.99984741210938 FORMAT "%6.4" /end CHARACTERISTIC
/begin CHARACTERISTIC c_vp_map_mv_min_diag "Threshold value VP_MAP_MV to detect Short circuit in signal wire to earth or wire break" VALUE 0xa0020af0 _REC_S1VAL_20_u2 4.99984741210938 _CNV_A_R_LINEAR_____14_CM 0. 4.99984741210938 FORMAT "%6.4" /end CHARACTERISTIC
/begin CHARACTERISTIC c_vp_put_mv_max_diag "Threshold value VP_PUT_MV to detect Short circuit in signal wire to VB" VALUE 0xa0020af2 _REC_S1VAL_20_u2 4.99984741210938 _CNV_A_R_LINEAR_____14_CM 0. 4.99984741210938 FORMAT "%6.4" /end CHARACTERISTIC
/begin CHARACTERISTIC c_vp_put_mv_min_diag "Threshold value VP_PUT_MV to detect Short circuit in signal wire to earth or wire break" VALUE 0xa0020af4 _REC_S1VAL_20_u2 4.99984741210938 _CNV_A_R_LINEAR_____14_CM 0. 4.99984741210938 FORMAT "%6.4" /end CHARACTERISTIC
/begin AXIS_PTS Ntb_n_spg_fil_ftc "9 breakpoints for theinterpolated filtering factor setpoint." 0xa0022ad8 Vxx_n _REC_A2AXS_20_u2 16383.75 _CNV_A_R_ENSD_LINEA_22_CM 9 0. 16383.75 READ_ONLY FORMAT "%8.2" /end AXIS_PTS
/begin CHARACTERISTIC Ctp_n_spg_fil_ftc "Interpolated filtering factor depending on the driving regime" CURVE 0xa0022aec _REC_A1CUR_20_u2_u2 65.535 _CNV_A_R_LINEAR_____116_CM 0. 65.535 FORMAT "%5.3"
 /begin AXIS_DESCR COM_AXIS Vxx_n _CNV_A_R_ENSD_LINEA_22_CM 9 0. 16383.75 READ_ONLY FORMAT "%8.2" AXIS_PTS_REF Ntb_n_spg_fil_ftc /end AXIS_DESCR
/end CHARACTERISTIC
/begin MEASUREMENT Vbx_run_spg "flag indicating a running engine" UBYTE _CNV_S_2_RANGE______3_CM 1 0. 0. 1. ECU_ADDRESS 0xd00061ea BIT_MASK 0x1 /end MEASUREMENT
/begin MEASUREMENT Vbx_stop_spg "flag indicating a stopped engine" UBYTE _CNV_S_2_RANGE______3_CM 1 0. 0. 1. ECU_ADDRESS 0xd00061eb BIT_MASK 0x1 /end MEASUREMENT
/begin MEASUREMENT Vxx_raw_sens_spg "raw boost pressure from sensor" UWORD _CNV_A_R_LINEAR_____115_CM 1 0. 0. 20000. ECU_ADDRESS 0xd0003c68 FORMAT "%5.0" /end MEASUREMENT
/begin MEASUREMENT Vxx_raw_sens_spg_run "Raw boost pressure from sensor during driven engine" UWORD _CNV_A_R_LINEAR_____115_CM 1 0. 0. 20000. ECU_ADDRESS 0xd0003c6a FORMAT "%5.0" /end MEASUREMENT
/begin MEASUREMENT Vxx_raw_sens_spg_stop "Raw boost pressure from sensor during stopped engine" UWORD _CNV_A_R_LINEAR_____115_CM 1 0. 0. 20000. ECU_ADDRESS 0xd0003c6c FORMAT "%5.0" /end MEASUREMENT
/begin CHARACTERISTIC Cxx_spg_fac "Earning of conversion of the measured ratio metric measure in supercharging pressure" VALUE 0xa0020704 _REC_S1VAL_20_u2 20000. _CNV_A_R_LINEAR_____115_CM 0. 20000. FORMAT "%5.0" /end CHARACTERISTIC
/begin CHARACTERISTIC Cxx_spg_ofs "Distance between the transfer function offset of the spg the reference of 103 hPa" VALUE 0xa0020706 _REC_S1VAL_20_s2 20000. _CNV_A_R_LINEAR_____115_CM -10000. 10000. FORMAT "%5.0" /end CHARACTERISTIC
/begin AXIS_PTS Ntb_n_map_fil_ftc "9 breakpoints for theinterpolated filtering factor setpoint." 0xa0022ab0 Vxx_n _REC_A2AXS_20_u2 16383.75 _CNV_A_R_ENSD_LINEA_22_CM 9 0. 16383.75 READ_ONLY FORMAT "%8.2" /end AXIS_PTS
/begin CHARACTERISTIC Ctp_n_map_fil_ftc "Interpolated filtering factor depending on the driving regime" CURVE 0xa0022ac4 _REC_A1CUR_20_u2_u2 65.535 _CNV_A_R_LINEAR_____116_CM 0. 65.535 FORMAT "%5.3"
 /begin AXIS_DESCR COM_AXIS Vxx_n _CNV_A_R_ENSD_LINEA_22_CM 9 0. 16383.75 READ_ONLY FORMAT "%8.2" AXIS_PTS_REF Ntb_n_map_fil_ftc /end AXIS_DESCR
/end CHARACTERISTIC
/begin MEASUREMENT Vbx_run_map "flag indicating a running engine" UBYTE _CNV_S_2_RANGE______3_CM 1 0. 0. 1. ECU_ADDRESS 0xd00061e8 BIT_MASK 0x1 /end MEASUREMENT
/begin MEASUREMENT Vbx_stop_map "flag indicating a stopped engine" UBYTE _CNV_S_2_RANGE______3_CM 1 0. 0. 1. ECU_ADDRESS 0xd00061e9 BIT_MASK 0x1 /end MEASUREMENT
/begin MEASUREMENT Vxx_raw_sens_map "Raw_manifold pressure from sensor" UWORD _CNV_A_R_LINEAR_____115_CM 1 0. 0. 20000. ECU_ADDRESS 0xd0003c5c FORMAT "%5.0" /end MEASUREMENT
/begin MEASUREMENT Vxx_raw_sens_map_run "Raw manifold pressure from sensor during driven engine" UWORD _CNV_A_R_LINEAR_____115_CM 1 0. 0. 20000. ECU_ADDRESS 0xd0003c5e FORMAT "%5.0" /end MEASUREMENT
/begin MEASUREMENT Vxx_raw_sens_map_stop "Raw manifold pressure from sensor during stopped engine" UWORD _CNV_A_R_LINEAR_____115_CM 1 0. 0. 20000. ECU_ADDRESS 0xd0003c60 FORMAT "%5.0" /end MEASUREMENT
/begin CHARACTERISTIC Cxx_map_fac "Gain of the pressure sensor linarisation" VALUE 0xa0020700 _REC_S1VAL_20_u2 20000. _CNV_A_R_LINEAR_____115_CM 0. 20000. FORMAT "%5.0" /end CHARACTERISTIC
/begin CHARACTERISTIC Cxx_map_ofs "Offset of the pressure sensor linarisation" VALUE 0xa0020702 _REC_S1VAL_20_s2 20000. _CNV_A_R_LINEAR_____115_CM -10000. 10000. FORMAT "%6.0" /end CHARACTERISTIC
/begin AXIS_PTS ldpm_vp_tia_1_airt "" 0xa0023838 vp_tia[0] _REC_A2AXS_20_u2 4.99984741210938 _CNV_A_R_LINEAR_____14_CM 16 0. 4.99984741210938 FORMAT "%6.4" /end AXIS_PTS
/begin CHARACTERISTIC ip_tia_mes "Intake temperature linear table" CURVE 0xa0024588 _REC_A1CUR_20_u1_u2 190.5 _CNV_A_R_LINEAR_____41_CM -48. 142.5 FORMAT "%6.2"
 /begin AXIS_DESCR COM_AXIS vp_tia[0] _CNV_A_R_LINEAR_____14_CM 16 0. 4.99984741210938 FORMAT "%6.4" AXIS_PTS_REF ldpm_vp_tia_1_airt /end AXIS_DESCR
/end CHARACTERISTIC
/begin MEASUREMENT Vbx_df_sens_mat_h "Manifold air temperature sensor high signal detected failure" UBYTE _CNV_S_2_RANGE______3_CM 1 0. 0. 1. ECU_ADDRESS 0xd00064d5 BIT_MASK 0x1 /end MEASUREMENT
/begin MEASUREMENT Vbx_df_sens_mat_l "Manifold air temperature sensor low signal detected failure." UBYTE _CNV_S_2_RANGE______3_CM 1 0. 0. 1. ECU_ADDRESS 0xd00064d4 BIT_MASK 0x1 /end MEASUREMENT
/begin MEASUREMENT Vbx_diag_ena_sens_mat_h "Manifold air temperature sensor high signal diagnosis information available." UBYTE _CNV_S_2_RANGE______3_CM 1 0. 0. 1. ECU_ADDRESS 0xd00064d7 BIT_MASK 0x1 /end MEASUREMENT
/begin MEASUREMENT Vbx_diag_ena_sens_mat_l "Manifold air temperature sensor low signal diagnosis information available." UBYTE _CNV_S_2_RANGE______3_CM 1 0. 0. 1. ECU_ADDRESS 0xd00064d6 BIT_MASK 0x1 /end MEASUREMENT
/begin MEASUREMENT Vxx_raw_sens_mat "Raw manifold air temperature sensor" UWORD _CNV_A_R_LINEAR_____110_CM 1 0. -40. 200. ECU_ADDRESS 0xd0003ec8 FORMAT "%5.1" /end MEASUREMENT
/begin MEASUREMENT Vxx_sens_mat_v "Manifold air temperature (sensor) raw value" UWORD _CNV_A_R_LINEAR_____203_CM 1 0. 0. 5. ECU_ADDRESS 0xd0003eca FORMAT "%10.8" /end MEASUREMENT
/begin MEASUREMENT err_sym_el_tia[0] "Symtom of TIA elctrical detected failure" UBYTE _CNV_S_16_RANGE_ERR__62_CM 1 0. 0. 15. ECU_ADDRESS 0xd00064d1 /end MEASUREMENT
/begin MEASUREMENT lv_cdn_diag_el_tia[0] "Conditions for TIA electrical diagnosis: 1: fulfilled,: one value for each TIa sensor of AIRT" UBYTE _CNV_A_R_ECME_LINEA_0_CM 1 0. 0. 1. ECU_ADDRESS 0xd00064d3 FORMAT "%1.0" /end MEASUREMENT
/begin MEASUREMENT tia_mes[0] "Intake air raw measured temperature" UBYTE _CNV_A_R_LINEAR_____41_CM 1 0. -48. 142.5 ECU_ADDRESS 0xd00064d2 FORMAT "%6.2" /end MEASUREMENT
/begin MEASUREMENT vp_tia[0] "Air intake temperature raw value" UWORD _CNV_A_R_LINEAR_____14_CM 1 0. 0. 4.99984741210938 ECU_ADDRESS 0xd0003ec6 FORMAT "%6.4" /end MEASUREMENT
/begin MEASUREMENT vp_tia_mmv[0] "filtered value of intake air temperature" UWORD _CNV_A_R_LINEAR_____14_CM 1 0. 0. 4.99984741210938 ECU_ADDRESS 0xd0003ecc FORMAT "%6.4" /end MEASUREMENT
/begin CHARACTERISTIC c_vp_tia_max_diag_el "Vp_tia voltage threshlod value for Short Cut to Ground" VALUE 0xa0020afa _REC_S1VAL_20_u2 4.99984741210938 _CNV_A_R_LINEAR_____14_CM 0. 4.99984741210938 FORMAT "%6.4" /end CHARACTERISTIC
/begin CHARACTERISTIC c_vp_tia_min_diag_el "Vp_tia voltage threshlod value for Short Cut to Plus or Open circuit" VALUE 0xa0020afc _REC_S1VAL_20_u2 4.99984741210938 _CNV_A_R_LINEAR_____14_CM 0. 4.99984741210938 FORMAT "%6.4" /end CHARACTERISTIC
/begin MEASUREMENT maf "Air mass (predicted) for calculation of basic fuel injection" UWORD _CNV_A_R_LINEAR_____80_CM 1 0. 0. 1389. ECU_ADDRESS 0xd0003ea4 FORMAT "%13.8" /end MEASUREMENT
/begin AXIS_PTS ldp_vp_tco_ip_tco_mes "" 0xa0023804 vp_tco[0] _REC_A2AXS_20_u2 4.99984741210938 _CNV_A_R_LINEAR_____14_CM 16 0. 4.99984741210938 FORMAT "%6.4" /end AXIS_PTS
/begin CHARACTERISTIC ip_tco_mes "Linearization of the coolant temperature sensor voltage for temperature acquisition " CURVE 0xa0024578 _REC_A1CUR_20_u1_u2 190.5 _CNV_A_R_LINEAR_____41_CM -48. 142.5 FORMAT "%6.2"
 /begin AXIS_DESCR COM_AXIS vp_tco[0] _CNV_A_R_LINEAR_____14_CM 16 0. 4.99984741210938 FORMAT "%6.4" AXIS_PTS_REF ldp_vp_tco_ip_tco_mes /end AXIS_DESCR
/end CHARACTERISTIC
/begin MEASUREMENT Vbx_df_sens_tco_h "Engine cooling temperature sensor high signal detected failure" UBYTE _CNV_S_2_RANGE______3_CM 1 0. 0. 1. ECU_ADDRESS 0xd00064f2 BIT_MASK 0x1 /end MEASUREMENT
/begin MEASUREMENT Vbx_df_sens_tco_l "engine cooling temperature sensor low signal detected failure" UBYTE _CNV_S_2_RANGE______3_CM 1 0. 0. 1. ECU_ADDRESS 0xd00064f1 BIT_MASK 0x1 /end MEASUREMENT
/begin MEASUREMENT Vbx_diag_ena_sens_tco_h "engine cooling temperature sensor high signal diagnostic information available" UBYTE _CNV_S_2_RANGE______3_CM 1 0. 0. 1. ECU_ADDRESS 0xd00064f4 BIT_MASK 0x1 /end MEASUREMENT
/begin MEASUREMENT Vbx_diag_ena_sens_tco_l "engine cooling temperature sensor low signal diagnostic information available" UBYTE _CNV_S_2_RANGE______3_CM 1 0. 0. 1. ECU_ADDRESS 0xd00064f3 BIT_MASK 0x1 /end MEASUREMENT
/begin MEASUREMENT Vxx_raw_sens_tco "Raw engine coolant temperature" UWORD _CNV_A_R_LINEAR_____110_CM 1 0. -40. 200. ECU_ADDRESS 0xd0003ee6 FORMAT "%5.1" /end MEASUREMENT
/begin MEASUREMENT Vxx_sens_tco_v "Raw engine coolant temperature" UWORD _CNV_A_R_LINEAR_____205_CM 1 0. 0. 60. ECU_ADDRESS 0xd0003ee8 FORMAT "%5.2" /end MEASUREMENT
/begin MEASUREMENT Vxx_sfty_sens_tco_v "voltage signal of the coolant sensor for safety" UWORD _CNV_A_R_LINEAR_____107_CM 1 0. 0. 25000. ECU_ADDRESS 0xd0003eea FORMAT "%5.0" /end MEASUREMENT
/begin MEASUREMENT lv_err_tco "Global TCO error flag" UBYTE _CNV_S_2_RANGE______3_CM 1 0. 0. 1. ECU_ADDRESS 0xd00064f5 BIT_MASK 0x1 /end MEASUREMENT
/begin CHARACTERISTIC c_vp_tco_max_diag_tco_el "Minimum raw sensor signal voltage for the coolant temperature electrical diagnosis" VALUE 0xa0020af6 _REC_S1VAL_20_u2 4.99984741210938 _CNV_A_R_LINEAR_____14_CM 0. 4.99984741210938 FORMAT "%6.4" /end CHARACTERISTIC
/begin CHARACTERISTIC c_vp_tco_min_diag_tco_el "Minimum raw sensor signal voltage for the coolant temperature electrical diagnosis" VALUE 0xa0020af8 _REC_S1VAL_20_u2 4.99984741210938 _CNV_A_R_LINEAR_____14_CM 0. 4.99984741210938 FORMAT "%6.4" /end CHARACTERISTIC
/begin CHARACTERISTIC lc_tco_diag_ena_rst "Boolean to enable diagnosis call at reset" VALUE 0xa0020b50 _REC_S1VAL_20_u1 1. _CNV_A_R_ECME_LINEA_0_CM 0. 1. FORMAT "%1.0" /end CHARACTERISTIC
/begin MEASUREMENT Vxx_acel_pdl_sens_v1 "Accelerator pedal sensor output voltage : track 1" UWORD _CNV_A_R_LINEAR_____107_CM 1 0. 0. 25000. ECU_ADDRESS 0xd0003c74 FORMAT "%5.0" /end MEASUREMENT
/begin MEASUREMENT Vxx_acel_pdl_sens_v2 "Accelerator pedal sensor output voltage : track 2" UWORD _CNV_A_R_LINEAR_____107_CM 1 0. 0. 25000. ECU_ADDRESS 0xd0003c76 FORMAT "%5.0" /end MEASUREMENT
/begin MEASUREMENT Vxx_sfty_acel_pdl_sens_v1 "Copy of accelerator pedal sensor output voltage : track 1 for safety monitoring" UWORD _CNV_A_R_LINEAR_____107_CM 1 0. 0. 25000. ECU_ADDRESS 0xd0007eb6 FORMAT "%5.0" /end MEASUREMENT
/begin MEASUREMENT vp_pvs_1 "Voltage of pedal value sensor 1" UWORD _CNV_A_R_LINEAR_____14_CM 1 0. 0. 4.99984741210938 ECU_ADDRESS 0xd0003eec FORMAT "%6.4" /end MEASUREMENT
/begin MEASUREMENT vp_pvs_1_mon "Voltage of safety pedal value sensor 1" UWORD _CNV_A_R_LINEAR_____14_CM 1 0. 0. 4.99984741210938 ECU_ADDRESS 0xd0007f7e FORMAT "%6.4" /end MEASUREMENT
/begin MEASUREMENT vp_pvs_2 "Voltage of pedal value sensor 2" UWORD _CNV_A_R_LINEAR_____14_CM 1 0. 0. 4.99984741210938 ECU_ADDRESS 0xd0003eee FORMAT "%6.4" /end MEASUREMENT
/begin MEASUREMENT vp_pvs_2_mon "Voltage of safety pedal value sensor 2" UWORD _CNV_A_R_LINEAR_____14_CM 1 0. 0. 4.99984741210938 ECU_ADDRESS 0xd0007f80 FORMAT "%6.4" /end MEASUREMENT
/begin MEASUREMENT Vbx_sens_igk "Ignition key signal sensor" UBYTE _CNV_S_2_RANGE______3_CM 1 0. 0. 1. ECU_ADDRESS 0xd0006507 BIT_MASK 0x1 /end MEASUREMENT
/begin MEASUREMENT Vbx_df_vb_rly_oc_scg "Open circuit or short circuit to ground relay detected failure" UBYTE _CNV_S_2_RANGE______3_CM 1 0. 0. 1. ECU_ADDRESS 0xd0006518 BIT_MASK 0x1 /end MEASUREMENT
/begin MEASUREMENT Vbx_df_vb_rly_scw "Short circuit to battery relay detected failure" UBYTE _CNV_S_2_RANGE______3_CM 1 0. 0. 1. ECU_ADDRESS 0xd0006519 BIT_MASK 0x1 /end MEASUREMENT
/begin MEASUREMENT Vbx_diag_ena_vb_rly_oc_scg "Open circuit or short circuit to ground relay diagnostic information available" UBYTE _CNV_S_2_RANGE______3_CM 1 0. 0. 1. ECU_ADDRESS 0xd000651a BIT_MASK 0x1 /end MEASUREMENT
/begin MEASUREMENT Vbx_diag_ena_vb_rly_scw "Short circuit to battery relay diagnostic information available" UBYTE _CNV_S_2_RANGE______3_CM 1 0. 0. 1. ECU_ADDRESS 0xd000651b BIT_MASK 0x1 /end MEASUREMENT
/begin MEASUREMENT Vxx_raw_vb "Battery voltage" UWORD _CNV_A_R_LINEAR_____205_CM 1 0. 0. 60. ECU_ADDRESS 0xd0003f08 FORMAT "%5.2" /end MEASUREMENT
/begin MEASUREMENT Vxx_vb_rly "After relay battery voltage" UWORD _CNV_A_R_LINEAR_____205_CM 1 0. 0. 60. ECU_ADDRESS 0xd0003f06 FORMAT "%5.2" /end MEASUREMENT
/begin MEASUREMENT lv_vb_cdn_obd_2 "Boolean for battery voltage condition fulfilled for OBD diagnosis" UBYTE _CNV_S_2_RANGE______3_CM 1 0. 0. 1. ECU_ADDRESS 0xd0006517 /end MEASUREMENT
/begin CHARACTERISTIC c_cdn_vb_min_diag "Battery voltage threshold for low voltage detection for sensor diagnosis" VALUE 0xa0020b30 _REC_S1VAL_20_u1 25.8984375 _CNV_A_R_LINEAR_____40_CM 0. 25.8984375 FORMAT "%9.6" /end CHARACTERISTIC
/begin CHARACTERISTIC c_sub_vb "Battery voltage substitute value when VB acquisition is impossible while key is turned off (typical value 12,6V)" VALUE 0xa0020b40 _REC_S1VAL_20_u1 25.8984375 _CNV_A_R_LINEAR_____40_CM 0. 25.8984375 FORMAT "%9.6" /end CHARACTERISTIC
/begin CHARACTERISTIC c_t_vcc_diag_auth "Delay for diagnosis authorisation after reset" VALUE 0xa0020b41 _REC_S1VAL_20_u1 10.16 _CNV_A_R_LINEAR_____208_CM 4.e-002 10.2 FORMAT "%5.2" /end CHARACTERISTIC
/begin CHARACTERISTIC c_vb_max_obd1 "" VALUE 0xa0020b45 _REC_S1VAL_20_u1 25.8984375 _CNV_A_R_LINEAR_____40_CM 0. 25.8984375 FORMAT "%9.6" /end CHARACTERISTIC
/begin CHARACTERISTIC c_vb_max_obd2 "VB - threshold for maximum permissible battery voltage for OBDdiagnosis" VALUE 0xa0020b46 _REC_S1VAL_20_u1 25.8984375 _CNV_A_R_LINEAR_____40_CM 0. 25.8984375 FORMAT "%9.6" /end CHARACTERISTIC
/begin CHARACTERISTIC c_vb_min_obd1 "" VALUE 0xa0020b48 _REC_S1VAL_20_u1 25.8984375 _CNV_A_R_LINEAR_____40_CM 0. 25.8984375 FORMAT "%9.6" /end CHARACTERISTIC
/begin CHARACTERISTIC c_vb_min_obd2 "VB - threshold for minimum permissible battery voltage for OBDdiagnosis (=6V)" VALUE 0xa0020b49 _REC_S1VAL_20_u1 25.8984375 _CNV_A_R_LINEAR_____40_CM 0. 25.8984375 FORMAT "%9.6" /end CHARACTERISTIC
/begin CHARACTERISTIC c_vb_raw_inh_diag "Raw battery voltage threshold for minimum permissible battery voltage for the diagnosis" VALUE 0xa0020b4a _REC_S1VAL_20_u1 25.8984375 _CNV_A_R_LINEAR_____40_CM 0. 25.8984375 FORMAT "%9.6" /end CHARACTERISTIC
/begin CHARACTERISTIC c_vcc_1_dif_diag "threshold for noise detection on 5V" VALUE 0xa0020ada _REC_S1VAL_20_u2 10. _CNV_A_R_LINEAR_____209_CM 0. 10. FORMAT "%7.4" /end CHARACTERISTIC
/begin CHARACTERISTIC c_vcc_1_max_diag "Max threshold on VA1 or VA2 to detect a failure" VALUE 0xa0020adc _REC_S1VAL_20_u2 10. _CNV_A_R_LINEAR_____209_CM 0. 10. FORMAT "%7.4" /end CHARACTERISTIC
/begin CHARACTERISTIC c_vcc_1_min_diag "Min threshold on VA1 or VA2 to detect a failure" VALUE 0xa0020ade _REC_S1VAL_20_u2 10. _CNV_A_R_LINEAR_____209_CM 0. 10. FORMAT "%7.4" /end CHARACTERISTIC
/begin CHARACTERISTIC c_vcc_2_dif_diag "threshold for noise detection on 5V" VALUE 0xa0020ae0 _REC_S1VAL_20_u2 10. _CNV_A_R_LINEAR_____209_CM 0. 10. FORMAT "%7.4" /end CHARACTERISTIC
/begin CHARACTERISTIC c_vcc_2_max_diag "Max threshold on VA1 or VA2 to detect a failure" VALUE 0xa0020ae2 _REC_S1VAL_20_u2 10. _CNV_A_R_LINEAR_____209_CM 0. 10. FORMAT "%7.4" /end CHARACTERISTIC
/begin CHARACTERISTIC c_vcc_2_min_diag "Min threshold on VA1 or VA2 to detect a failure" VALUE 0xa0020ae4 _REC_S1VAL_20_u2 10. _CNV_A_R_LINEAR_____209_CM 0. 10. FORMAT "%7.4" /end CHARACTERISTIC
/begin CHARACTERISTIC c_vcc_3_dif_diag "threshold for noise detection on 5V" VALUE 0xa0020ae6 _REC_S1VAL_20_u2 10. _CNV_A_R_LINEAR_____209_CM 0. 10. FORMAT "%7.4" /end CHARACTERISTIC
/begin CHARACTERISTIC c_vcc_3_max_diag "Max threshold on VA3 to detect a failure" VALUE 0xa0020ae8 _REC_S1VAL_20_u2 10. _CNV_A_R_LINEAR_____209_CM 0. 10. FORMAT "%7.4" /end CHARACTERISTIC
/begin CHARACTERISTIC c_vcc_3_min_diag "Min threshold on VA3 to detect a failure" VALUE 0xa0020aea _REC_S1VAL_20_u2 10. _CNV_A_R_LINEAR_____209_CM 0. 10. FORMAT "%7.4" /end CHARACTERISTIC
/begin CHARACTERISTIC c_vcc_gain_dif "Gain of the filter for 5V diynamic evaluation" VALUE 0xa0020aec _REC_S1VAL_20_u2 1. _CNV_A_R_LINEAR_____143_CM 0. 1. FORMAT "%11.9" /end CHARACTERISTIC
/begin MEASUREMENT Vbx_df_it_cmd_el "Inlet Throttle H_bridge detected failure" UBYTE _CNV_S_2_RANGE______3_CM 1 0. 0. 1. ECU_ADDRESS 0xd000652b BIT_MASK 0x1 /end MEASUREMENT
/begin MEASUREMENT Vbx_diag_ena_it_cmd_el "Inlet throttle HBridge detected failure." UBYTE _CNV_S_2_RANGE______3_CM 1 0. 0. 1. ECU_ADDRESS 0xd000652a BIT_MASK 0x1 /end MEASUREMENT
/begin MEASUREMENT Vbx_it_hbrg_ok "H_bridge driver check successfully completed" UBYTE _CNV_S_2_RANGE______3_CM 1 0. 0. 1. ECU_ADDRESS 0xd000652c BIT_MASK 0x1 /end MEASUREMENT
/begin MEASUREMENT err_sym_etc_dr "For each symptom: status of failure (set to 1 when failure symptom detected)" UBYTE _CNV_S_16_RANGE_ERR__62_CM 1 0. 0. 15. ECU_ADDRESS 0xd0006529 /end MEASUREMENT
/begin MEASUREMENT lv_cdn_diag_etc_dr "Diagnostic condition to start symptom detection (set to 1 when condition is fulfilled)" UBYTE _CNV_S_2_RANGE______3_CM 1 0. 0. 1. ECU_ADDRESS 0xd0006530 /end MEASUREMENT
/begin MEASUREMENT lv_off_mtc_asw "Disable flag of the ETC driver" UBYTE _CNV_S_2_RANGE______3_CM 1 0. 0. 1. ECU_ADDRESS 0xd000652d /end MEASUREMENT
/begin MEASUREMENT v_mtc_sp "Voltage set point" SWORD _CNV_A_R_LINEAR_____212_CM 1 0. -28.8 28.79912109375 ECU_ADDRESS 0xd0003f10 FORMAT "%9.3" /end MEASUREMENT
/begin MEASUREMENT Vbx_clu_stal_ctr "Boolean to allow increment of Vxx_clu_stal_ctr" UBYTE _CNV_S_2_RANGE______3_CM 1 0. 0. 1. DISPLAY_IDENTIFIER InSmiSyn_NVM.Vbx_clu_stal_ctr_NVM ECU_ADDRESS 0xd0004408 BIT_MASK 0x1 /end MEASUREMENT
/begin MEASUREMENT Vxx_clu_stal_ctr "Counter of stalling of type: clutch, failed starting up, due to the software lock" UWORD _CNV_A_R_ECME_LINEA_0_CM 1 0. 0. 65535. DISPLAY_IDENTIFIER InSmiSyn_NVM.Vxx_clu_stal_ctr_NVM ECU_ADDRESS 0xd00043f0 FORMAT "%5.0" /end MEASUREMENT
/begin MEASUREMENT Vxx_cylr_is_vld_ctr "Counter of success of cylinder recognition in idle speed regulation" UWORD _CNV_A_R_ECME_LINEA_0_CM 1 0. 0. 65535. DISPLAY_IDENTIFIER InSmiSyn_NVM.Vxx_cylr_is_vld_ctr_NVM ECU_ADDRESS 0xd00043f2 FORMAT "%5.0" /end MEASUREMENT
/begin MEASUREMENT Vxx_cylr_ok_aftr_stal_ctr "Counter of confirmation of phase in using cylinder recognition (running vehicule)" UWORD _CNV_A_R_ECME_LINEA_0_CM 1 0. 0. 65535. DISPLAY_IDENTIFIER InSmiSyn_NVM.Vxx_cylr_ok_aftr_stal_ctr_NVM ECU_ADDRESS 0xd00043f4 FORMAT "%5.0" /end MEASUREMENT
/begin MEASUREMENT Vxx_cylr_ok_ctr "Failure counter for cylinder recognition" UWORD _CNV_A_R_ECME_LINEA_0_CM 1 0. 0. 65535. DISPLAY_IDENTIFIER InSmiSyn_NVM.Vxx_cylr_ok_ctr_NVM ECU_ADDRESS 0xd00043f6 FORMAT "%5.0" /end MEASUREMENT
/begin MEASUREMENT Vxx_err_cylr_ctr "cylinder recognition counter" UWORD _CNV_A_R_ECME_LINEA_0_CM 1 0. 0. 65535. DISPLAY_IDENTIFIER InSmiSyn_NVM.Vxx_err_cylr_ctr_NVM ECU_ADDRESS 0xd00043f8 FORMAT "%5.0" /end MEASUREMENT
/begin MEASUREMENT Vxx_err_cylr_is_run_ctr "cylinder recognition counter in idle speed regulation" UWORD _CNV_A_R_ECME_LINEA_0_CM 1 0. 0. 65535. DISPLAY_IDENTIFIER InSmiSyn_NVM.Vxx_err_cylr_is_run_ctr_NVM ECU_ADDRESS 0xd00043fa FORMAT "%5.0" /end MEASUREMENT
/begin MEASUREMENT Vxx_err_id_is_run_ctr "Failure counter for idle speed speed regulation (not confirmed by cylinder recognition for running vehicle)" UWORD _CNV_A_R_ECME_LINEA_0_CM 1 0. 0. 65535. DISPLAY_IDENTIFIER InSmiSyn_NVM.Vxx_err_id_is_run_ctr_NVM ECU_ADDRESS 0xd00043fc FORMAT "%5.0" /end MEASUREMENT
/begin MEASUREMENT Vxx_is_cylr_ok_ctr "Counter of success od cylinder recognition in idle speed regulation" UWORD _CNV_A_R_ECME_LINEA_0_CM 1 0. 0. 65535. DISPLAY_IDENTIFIER InSmiSyn_NVM.Vxx_is_cylr_ok_ctr_NVM ECU_ADDRESS 0xd00043fe FORMAT "%5.0" /end MEASUREMENT
/begin MEASUREMENT Vxx_no_deci_cylr_ctr "Counter of no decision of cylinder recognition" UWORD _CNV_A_R_ECME_LINEA_0_CM 1 0. 0. 65535. DISPLAY_IDENTIFIER InSmiSyn_NVM.Vxx_no_deci_cylr_ctr_NVM ECU_ADDRESS 0xd0004400 FORMAT "%5.0" /end MEASUREMENT
/begin MEASUREMENT Vxx_no_deci_id_is_ctr "Counter of no decision of cylinder recognition in RR mode" UWORD _CNV_A_R_ECME_LINEA_0_CM 1 0. 0. 65535. DISPLAY_IDENTIFIER InSmiSyn_NVM.Vxx_no_deci_id_is_ctr_NVM ECU_ADDRESS 0xd0004402 FORMAT "%5.0" /end MEASUREMENT
/begin MEASUREMENT Vxx_run_re_phs_ctr "Rephasing counter after cylinder recognition in running vehicle" UWORD _CNV_A_R_ECME_LINEA_0_CM 1 0. 0. 65535. DISPLAY_IDENTIFIER InSmiSyn_NVM.Vxx_run_re_phs_ctr_NVM ECU_ADDRESS 0xd0004404 FORMAT "%5.0" /end MEASUREMENT
/begin MEASUREMENT Vxx_crk_syn_loss_ctr "Counter of loss of crankshaft synchronization." UWORD _CNV_A_R_ECME_LINEA_0_CM 1 0. 0. 65535. DISPLAY_IDENTIFIER InSmiSyn_NVM.Vxx_crk_syn_loss_ctr_NVM ECU_ADDRESS 0xd0004406 FORMAT "%5.0" /end MEASUREMENT
/begin MEASUREMENT Vbx_actr_rly_cmd "State of the actuators relay" UBYTE _CNV_S_2_RANGE______3_CM 1 0. 0. 1. ECU_ADDRESS 0xd0007601 BIT_MASK 0x1 /end MEASUREMENT
/begin MEASUREMENT Vbx_max_ecu_pws "Maximum retention of the power supply ECU" UBYTE _CNV_S_2_RANGE______3_CM 1 0. 0. 1. ECU_ADDRESS 0xd0007602 BIT_MASK 0x1 /end MEASUREMENT
/begin MEASUREMENT Vbx_min_ecu_pws "Minimum retention of the power supply ECU" UBYTE _CNV_S_2_RANGE______3_CM 1 0. 0. 1. ECU_ADDRESS 0xd0007603 BIT_MASK 0x1 /end MEASUREMENT
/begin MEASUREMENT Vbx_pwl_dly_pws "Boolean of the reset generated if Vxx_pwl_dly_pws >Cxx_pwl_dly_pws_max" UBYTE _CNV_S_2_RANGE______3_CM 1 0. 0. 1. ECU_ADDRESS 0xd0007604 BIT_MASK 0x1 /end MEASUREMENT
/begin MEASUREMENT Vbx_pwl_dly_secu "Boolean of the reset generated if Vxx_pwl_dly_secu == 0" UBYTE _CNV_S_2_RANGE______3_CM 1 0. 0. 1. ECU_ADDRESS 0xd0007605 BIT_MASK 0x1 /end MEASUREMENT
/begin MEASUREMENT Vbx_pwl_on "Power-latch state" UBYTE _CNV_S_2_RANGE______3_CM 1 0. 0. 1. ECU_ADDRESS 0xd0007606 BIT_MASK 0x1 /end MEASUREMENT
/begin MEASUREMENT Vbx_rly_cmd_req "Retention request for the actuator relay command" UBYTE _CNV_S_2_RANGE______3_CM 1 0. 0. 1. ECU_ADDRESS 0xd0007607 BIT_MASK 0x1 /end MEASUREMENT
/begin MEASUREMENT Vsx_actr_rly_vld "Actuators relay validity indicator" UBYTE _CNV_S_3_STATUS_OK__213_CM 1 0. 0. 2. ECU_ADDRESS 0xd0007608 /end MEASUREMENT
/begin MEASUREMENT Vxx_pwl_dly "Power latch temporization" UWORD _CNV_A_R_LINEAR_____58_CM 1 0. 0. 6553.5 ECU_ADDRESS 0xd0004fba FORMAT "%6.1" /end MEASUREMENT
/begin MEASUREMENT Vxx_pwl_dly_pws "time-out temporization on abnormal key OFF duration" UWORD _CNV_A_R_LINEAR_____58_CM 1 0. 0. 6553.5 ECU_ADDRESS 0xd0004fbc FORMAT "%6.1" /end MEASUREMENT
/begin CHARACTERISTIC Cbx_l_pwl_conf "Minimum power latch configuration" VALUE 0xa00207d6 _REC_S1VAL_20_u1 1. _CNV_A_R_ECME_LINEA_0_CM 0. 1. FORMAT "%1.0" BIT_MASK 0x1 /end CHARACTERISTIC
/begin CHARACTERISTIC Cxx_dfdec_actr_rly_oc "Open circuit on actuators relay detected failure counter decrement" VALUE 0xa00207c2 _REC_S1VAL_20_u2 65535. _CNV_A_R_ECME_LINEA_0_CM 0. 65535. FORMAT "%5.0" /end CHARACTERISTIC
/begin CHARACTERISTIC Cxx_dfdec_actr_rly_scg "Short circuit to ground on actuators relay detected failure counter decrement" VALUE 0xa00207c4 _REC_S1VAL_20_u2 65535. _CNV_A_R_ECME_LINEA_0_CM 0. 65535. FORMAT "%5.0" /end CHARACTERISTIC
/begin CHARACTERISTIC Cxx_dfdec_actr_rly_scw "Short circuit to battery on actuators relay detected failure counter decrement" VALUE 0xa00207c6 _REC_S1VAL_20_u2 65535. _CNV_A_R_ECME_LINEA_0_CM 0. 65535. FORMAT "%5.0" /end CHARACTERISTIC
/begin CHARACTERISTIC Cxx_dfinc_actr_rly_oc "Open circuit on actuators relay detected failure counter increment" VALUE 0xa00207c8 _REC_S1VAL_20_u2 65535. _CNV_A_R_ECME_LINEA_0_CM 0. 65535. FORMAT "%5.0" /end CHARACTERISTIC
/begin CHARACTERISTIC Cxx_dfinc_actr_rly_scg "Short circuit to ground on actuators relay detected failure counter increment" VALUE 0xa00207ca _REC_S1VAL_20_u2 65535. _CNV_A_R_ECME_LINEA_0_CM 0. 65535. FORMAT "%5.0" /end CHARACTERISTIC
/begin CHARACTERISTIC Cxx_dfinc_actr_rly_scw "Short circuit to battery on actuators relay detected failure counter increment" VALUE 0xa00207cc _REC_S1VAL_20_u2 65535. _CNV_A_R_ECME_LINEA_0_CM 0. 65535. FORMAT "%5.0" /end CHARACTERISTIC
/begin CHARACTERISTIC Cxx_min_pwl_dly "Minimum temporization of power latch" VALUE 0xa00207ce _REC_S1VAL_20_u2 6553.5 _CNV_A_R_LINEAR_____58_CM 0. 6553.5 FORMAT "%6.1" /end CHARACTERISTIC
/begin CHARACTERISTIC Cxx_pwl_dly "maximum powerlatch delay" VALUE 0xa00207d0 _REC_S1VAL_20_u2 6553.5 _CNV_A_R_LINEAR_____58_CM 0. 6553.5 FORMAT "%6.1" /end CHARACTERISTIC
/begin CHARACTERISTIC Cxx_pwl_dly_pws_max "Duration of the power latch time-out on key OFF" VALUE 0xa00207d2 _REC_S1VAL_20_u2 6553.5 _CNV_A_R_LINEAR_____58_CM 0. 6553.5 FORMAT "%6.1" /end CHARACTERISTIC
/begin CHARACTERISTIC Cxx_pwl_dly_secu "Duration of the power latch  time-out" VALUE 0xa00207d4 _REC_S1VAL_20_u2 6553.5 _CNV_A_R_LINEAR_____58_CM 0. 6553.5 FORMAT "%6.1" /end CHARACTERISTIC
/begin MEASUREMENT Vxx_brk_pdl_clos_blk_off_dly "Close active brake switch blocked off counter delay " UWORD _CNV_A_R_LINEAR_____68_CM 1 0. 0. 65535. DISPLAY_IDENTIFIER INPCIBKI_NVM.Vxx_brk_pdl_clos_blk_off_dly_NVM ECU_ADDRESS 0xd0005f20 FORMAT "%5.0" /end MEASUREMENT
/begin MEASUREMENT Vxx_brk_pdl_clos_blk_on_dly "Close active brake switch blocked on counter delay " UWORD _CNV_A_R_LINEAR_____68_CM 1 0. 0. 65535. DISPLAY_IDENTIFIER INPCIBKI_NVM.Vxx_brk_pdl_clos_blk_on_dly_NVM ECU_ADDRESS 0xd0005f22 FORMAT "%5.0" /end MEASUREMENT
/begin MEASUREMENT Vxx_brk_pdl_open_blk_off_dly "Open active brake switch blocked off counter delay" UWORD _CNV_A_R_LINEAR_____68_CM 1 0. 0. 65535. DISPLAY_IDENTIFIER INPCIBKI_NVM.Vxx_brk_pdl_open_blk_off_dly_NVM ECU_ADDRESS 0xd0005f24 FORMAT "%5.0" /end MEASUREMENT
/begin MEASUREMENT Vxx_brk_pdl_open_blk_on_dly "Open active brake switch blocked on counter delay" UWORD _CNV_A_R_LINEAR_____68_CM 1 0. 0. 65535. DISPLAY_IDENTIFIER INPCIBKI_NVM.Vxx_brk_pdl_open_blk_on_dly_NVM ECU_ADDRESS 0xd0005f26 FORMAT "%5.0" /end MEASUREMENT
/begin MEASUREMENT Vbx_sens_brk_pdl_open_lk_stt "" UBYTE _CNV_S_2_RANGE______3_CM 1 0. 0. 1. DISPLAY_IDENTIFIER INPCIBKI_NVM.Vbx_sens_brk_pdl_open_lk_stt_NVM ECU_ADDRESS 0xd0005f28 BIT_MASK 0x1 /end MEASUREMENT
/begin MEASUREMENT Vbx_abs_reg "ABS in regulation" UBYTE _CNV_S_2_RANGE______3_CM 1 0. 0. 1. ECU_ADDRESS 0xd0006bda BIT_MASK 0x1 /end MEASUREMENT
/begin MEASUREMENT Vbx_bpk "Automatic or manual parking brake detected" UBYTE _CNV_S_2_RANGE______3_CM 1 0. 0. 1. ECU_ADDRESS 0xd0006bdb BIT_MASK 0x1 /end MEASUREMENT
/begin MEASUREMENT Vsx_brk_pdl "Brake pedal states" UBYTE _CNV_S_3_STATUS_BRK_214_CM 1 0. 1. 4. ECU_ADDRESS 0xd0006bdc /end MEASUREMENT
/begin MEASUREMENT Vsx_brk_pdl_cru_vld "Brake pedal states for cruise controlvalidity status" UBYTE _CNV_S_4_STATUS_OK__180_CM 1 0. 0. 3. ECU_ADDRESS 0xd0006bdd /end MEASUREMENT
/begin MEASUREMENT Vsx_brk_pdl_vld "Brake pedal states validity status" UBYTE _CNV_S_3_STATUS_OK__179_CM 1 0. 0. 2. ECU_ADDRESS 0xd0006bde /end MEASUREMENT
/begin MEASUREMENT Vsx_brk_pdl_open "Open active brake switch" UBYTE _CNV_S_2_STATUS_BRK_215_CM 1 0. 1. 2. ECU_ADDRESS 0xd0006be2 /end MEASUREMENT
/begin MEASUREMENT Vsx_brk_pdl_open_vld "Open active brake switch validity status" UBYTE _CNV_S_3_STATUS_OK__213_CM 1 0. 0. 2. ECU_ADDRESS 0xd0006be3 /end MEASUREMENT
/begin CHARACTERISTIC Cxx_sens_brk_lk_vb_dly "Time to enable the open active brake switch conection status" VALUE 0xa0021574 _REC_S1VAL_20_u1 25.5 _CNV_A_R_LINEAR_____58_CM 0. 25.5 FORMAT "%4.1" /end CHARACTERISTIC
/begin CHARACTERISTIC Cxx_sens_brk_lk_vb_thd "Minimum battery voltage to enable the open active brake switch conection status" VALUE 0xa0021572 _REC_S1VAL_20_u2 25000. _CNV_A_R_LINEAR_____107_CM 0. 25000. FORMAT "%5.0" /end CHARACTERISTIC
/begin AXIS_PTS Ctb_sta_tco "Coolant temperature breakpoints for starting set point tables" 0xa002d498 Vxx_tco _REC_A2AXS_20_u2 240. _CNV_A_R_LINEAR_____110_CM 8 -40. 200. FORMAT "%5.1" /end AXIS_PTS
/begin AXIS_PTS Ctb_tco2 "Engine coolant temperature breakpoints" 0xa002d4d0 Vxx_tco _REC_A2AXS_20_u2 240. _CNV_A_R_LINEAR_____110_CM 9 -40. 200. FORMAT "%5.1" /end AXIS_PTS
/begin AXIS_PTS Ctb_sta_tco_alco "Coolant temperature breakpoints for starting set point table in alcool" 0xa00351f0 Vxx_tco _REC_A2AXS_20_u2 240. _CNV_A_R_LINEAR_____110_CM 11 -40. 200. FORMAT "%5.1" /end AXIS_PTS
/begin AXIS_PTS Ctb_cylr_map "Break point table of Ctp_cylr_prs_stab_dif" 0xa002db2c Vxx_map_cor _REC_A2AXS_20_u2 20000. _CNV_A_R_LINEAR_____115_CM 17 0. 20000. FORMAT "%5.0" /end AXIS_PTS
/begin CHARACTERISTIC Ctp_cylr_prs_stab_dif "Maximum difference of pressure for engine stability criteria of cylinder recognition" CURVE 0xa002db50 _REC_A1CUR_20_u2_u2 20000. _CNV_A_R_LINEAR_____115_CM 0. 20000. FORMAT "%5.0"
 /begin AXIS_DESCR COM_AXIS Vxx_map_cor _CNV_A_R_LINEAR_____115_CM 17 0. 20000. FORMAT "%5.0" AXIS_PTS_REF Ctb_cylr_map /end AXIS_DESCR
/end CHARACTERISTIC
/begin MEASUREMENT Vbx_ac_in_mem "Input state of air conditioning during cylinder recognition memorized" UBYTE _CNV_S_2_RANGE______3_CM 1 0. 0. 1. ECU_ADDRESS 0xd0006cde BIT_MASK 0x1 /end MEASUREMENT
/begin MEASUREMENT Vbx_ac_out_mem "Output state of air conditioning during cylinder recognition memorized" UBYTE _CNV_S_2_RANGE______3_CM 1 0. 0. 1. ECU_ADDRESS 0xd0006cdf BIT_MASK 0x1 /end MEASUREMENT
/begin MEASUREMENT Vbx_clu_stal_ctr_ini "Initial value of Vbx_clu_stal_ctr" UBYTE _CNV_S_2_RANGE______3_CM 1 0. 0. 1. ECU_ADDRESS 0xd0006ce0 BIT_MASK 0x1 /end MEASUREMENT
/begin MEASUREMENT Vbx_cylr_is_run_ctl_ini "Cylinder recognition in idle speed regulation wanted at initialization" UBYTE _CNV_S_2_RANGE______3_CM 1 0. 0. 1. ECU_ADDRESS 0xd0006ce1 BIT_MASK 0x1 /end MEASUREMENT
/begin MEASUREMENT Vbx_cylr_is_run_mes "Cylinder recognition in idle speed regulation is done" UBYTE _CNV_S_2_RANGE______3_CM 1 0. 0. 1. ECU_ADDRESS 0xd0006ce2 BIT_MASK 0x1 /end MEASUREMENT
/begin MEASUREMENT Vbx_cylr_is_run_req "Cylinder recognition is required in idle speed regulation" UBYTE _CNV_S_2_RANGE______3_CM 1 0. 0. 1. ECU_ADDRESS 0xd0006ce3 BIT_MASK 0x1 /end MEASUREMENT
/begin MEASUREMENT Vbx_cylr_is_run_stab_cdn "Conditions of stability for cylinder recognition in idle speed regulation" UBYTE _CNV_S_2_RANGE______3_CM 1 0. 0. 1. ECU_ADDRESS 0xd0006ce4 BIT_MASK 0x1 /end MEASUREMENT
/begin MEASUREMENT Vbx_cylr_is_run_stop "Cylinder recognition in ilde speed regulation is done" UBYTE _CNV_S_2_RANGE______3_CM 1 0. 0. 1. ECU_ADDRESS 0xd0006ce5 BIT_MASK 0x1 /end MEASUREMENT
/begin MEASUREMENT Vbx_cylr_run_loop_stop "Cylinder recognition in close loop state and running vehicle" UBYTE _CNV_S_2_RANGE______3_CM 1 0. 0. 1. ECU_ADDRESS 0xd0006ce6 BIT_MASK 0x1 /end MEASUREMENT
/begin MEASUREMENT Vbx_cylr_run_stab_cdn "Stability condition cylinder recognition running vehicle (close loop)" UBYTE _CNV_S_2_RANGE______3_CM 1 0. 0. 1. ECU_ADDRESS 0xd0006ce7 BIT_MASK 0x1 /end MEASUREMENT
/begin MEASUREMENT Vbx_cylr_stab_cdn "Stability condition of cynlinder recognition (running vehicle or idle speed regulation)" UBYTE _CNV_S_2_RANGE______3_CM 1 0. 0. 1. ECU_ADDRESS 0xd0006ce8 BIT_MASK 0x1 /end MEASUREMENT
/begin MEASUREMENT Vbx_cylr_stab_cdn_rtn "Freeze frame for stability condition for cylinder recognition" UBYTE _CNV_S_2_RANGE______3_CM 1 0. 0. 1. ECU_ADDRESS 0xd0006ce9 BIT_MASK 0x1 /end MEASUREMENT
/begin MEASUREMENT Vbx_cylr_stop "Boolean indicating that partial injections, cylinder recognition, and, possibly, injection rephasing are ended or realized" UBYTE _CNV_S_2_RANGE______3_CM 1 0. 0. 1. ECU_ADDRESS 0xd0006cea BIT_MASK 0x1 /end MEASUREMENT
/begin MEASUREMENT Vbx_cylr_tot_stab_cdn "General stability condition for cylinder recognition" UBYTE _CNV_S_2_RANGE______3_CM 1 0. 0. 1. ECU_ADDRESS 0xd0006ceb BIT_MASK 0x1 /end MEASUREMENT
/begin MEASUREMENT Vbx_gas_comb_mod "Boolean  indicating gazoline calibrations must be used" UBYTE _CNV_S_2_RANGE______3_CM 1 0. 0. 1. ECU_ADDRESS 0xd0006cec BIT_MASK 0x1 /end MEASUREMENT
/begin MEASUREMENT Vbx_iga_re_syn_req "Boolean of ignition resynchro request" UBYTE _CNV_S_2_RANGE______3_CM 1 0. 0. 1. ECU_ADDRESS 0xd0006ced BIT_MASK 0x1 /end MEASUREMENT
/begin MEASUREMENT Vbx_inj_dstb_act "Partial injections in progress (for cylinder recognition)" UBYTE _CNV_S_2_RANGE______3_CM 1 0. 0. 1. ECU_ADDRESS 0xd0006cee BIT_MASK 0x1 /end MEASUREMENT
/begin MEASUREMENT Vbx_inj_dstb_phs1 "Phase 1 of partial injections" UBYTE _CNV_S_2_RANGE______3_CM 1 0. 0. 1. ECU_ADDRESS 0xd0006cef BIT_MASK 0x1 /end MEASUREMENT
/begin MEASUREMENT Vbx_inj_dstb_phs2 "Phase 2 of partial injections" UBYTE _CNV_S_2_RANGE______3_CM 1 0. 0. 1. ECU_ADDRESS 0xd0006cf0 BIT_MASK 0x1 /end MEASUREMENT
/begin MEASUREMENT Vbx_inj_re_phs_req "Demand of rephasage of the mark of phase of the injections" UBYTE _CNV_S_2_RANGE______3_CM 1 0. 0. 1. ECU_ADDRESS 0xd0006cf1 BIT_MASK 0x1 /end MEASUREMENT
/begin MEASUREMENT Vbx_mdf1_cmd_mem "State command MDF1 memorized during cylinder recognition" UBYTE _CNV_S_2_RANGE______3_CM 1 0. 0. 1. ECU_ADDRESS 0xd0006cf2 BIT_MASK 0x1 /end MEASUREMENT
/begin MEASUREMENT Vbx_mdf2_cmd_mem "State command MDF2 memorized during cylinder recognition" UBYTE _CNV_S_2_RANGE______3_CM 1 0. 0. 1. ECU_ADDRESS 0xd0006cf3 BIT_MASK 0x1 /end MEASUREMENT
/begin MEASUREMENT Vbx_mis_inj_re_phs_done "Boolean indicating that rephasage is done on misfire request" UBYTE _CNV_S_2_RANGE______3_CM 1 0. 0. 1. ECU_ADDRESS 0xd0006cf4 BIT_MASK 0x1 /end MEASUREMENT
/begin MEASUREMENT Vbx_rich_cl_cylr_mem "Richness loop state memorized during cylinder recognition" UBYTE _CNV_S_2_RANGE______3_CM 1 0. 0. 1. ECU_ADDRESS 0xd0006cf5 BIT_MASK 0x1 /end MEASUREMENT
/begin MEASUREMENT Vbx_run_cylr_mem "Cylinder recognition memorized running vehicle" UBYTE _CNV_S_2_RANGE______3_CM 1 0. 0. 1. ECU_ADDRESS 0xd0006cf6 BIT_MASK 0x1 /end MEASUREMENT
/begin MEASUREMENT Vbx_tdc_re_syn_ctr_req "Boolean of resynchro TDC counter request" UBYTE _CNV_S_2_RANGE______3_CM 1 0. 0. 1. ECU_ADDRESS 0xd0006cf7 BIT_MASK 0x1 /end MEASUREMENT
/begin MEASUREMENT Vbx_tolo "Boolean indicating a loss of crankshaft synchronisation for resetting of recocyl stateflow" UBYTE _CNV_S_2_RANGE______3_CM 1 0. 0. 1. ECU_ADDRESS 0xd0006cf8 BIT_MASK 0x1 /end MEASUREMENT
/begin MEASUREMENT Vxx_clu_stal_ctr_ini "Initial value of Vxx_clu_stal_ctr" UWORD _CNV_A_R_ECME_LINEA_0_CM 1 0. 0. 65535. ECU_ADDRESS 0xd0004420 FORMAT "%5.0" /end MEASUREMENT
/begin MEASUREMENT Vxx_cylr_clc_ctr_yy "Duration of multiple injections in number of engine cycles (= 4TDC)" UWORD _CNV_A_R_LINEAR_____101_CM 1 0. 0. 65535. ECU_ADDRESS 0xd0004422 FORMAT "%5.0" /end MEASUREMENT
/begin MEASUREMENT Vxx_cylr_ctl_phs "Cylinder recognition automate phase" UBYTE _CNV_A_R_ECME_LINEA_0_CM 1 0. 0. 255. ECU_ADDRESS 0xd0006cf9 FORMAT "%3.0" /end MEASUREMENT
/begin MEASUREMENT Vxx_cylr_id_sta_ofs "Offset at the beginning of the strategy" UBYTE _CNV_A_R_LINEAR_____368_CM 1 0. 0. 255. ECU_ADDRESS 0xd0006cfa FORMAT "%3.0" /end MEASUREMENT
/begin MEASUREMENT Vxx_cylr_iga_mem "Ignition advance memorized due to stability during cylinder recognition" UBYTE _CNV_A_R_IGRE_LINEA_47_CM 1 0. -23.625 72. ECU_ADDRESS 0xd0006cfb FORMAT "%7.3" /end MEASUREMENT
/begin MEASUREMENT Vxx_cylr_is_clc_ctr_yy "Duration of multiple injection in number of engine cycle (= 4TDC) in idle speed regulation" UWORD _CNV_A_R_LINEAR_____101_CM 1 0. 0. 65535. ECU_ADDRESS 0xd0004424 FORMAT "%5.0" /end MEASUREMENT
/begin MEASUREMENT Vxx_cylr_is_max_tq_dec_yy "Maximal deterioration of torque to refute the phasing of the injection mark in RR mode" SWORD _CNV_A_R_LINEAR_____369_CM 1 0. -3276.8 3276.7 ECU_ADDRESS 0xd0004426 FORMAT "%6.1" /end MEASUREMENT
/begin MEASUREMENT Vxx_cylr_is_min_tq_dec_yy "Minimal deterioration of torque to confirm the phasing of the injection mark in RR mode" SWORD _CNV_A_R_LINEAR_____369_CM 1 0. -3276.8 3276.7 ECU_ADDRESS 0xd0004428 FORMAT "%6.1" /end MEASUREMENT
/begin MEASUREMENT Vxx_cylr_is_run_test_ctr "Cylinder recognition attempts counter in idle speed regulation" UBYTE _CNV_A_R_ECME_LINEA_0_CM 1 0. 0. 255. ECU_ADDRESS 0xd0006cfc FORMAT "%3.0" /end MEASUREMENT
/begin MEASUREMENT Vxx_cylr_is_vld_ctr_ini "Initial value of Vxx_cylr_is_vld_ctr" UWORD _CNV_A_R_ECME_LINEA_0_CM 1 0. 0. 65535. ECU_ADDRESS 0xd000442a FORMAT "%5.0" /end MEASUREMENT
/begin MEASUREMENT Vxx_cylr_max_n_yy "Maximal engine speed for cylinder recognition" UBYTE _CNV_A_R_LINEAR_____2_CM 1 0. 0. 8160. ECU_ADDRESS 0xd0006cfd FORMAT "%4.0" /end MEASUREMENT
/begin MEASUREMENT Vxx_cylr_max_prs_yy "Maximal pressure for cylinder recognition" UWORD _CNV_A_R_LINEAR_____115_CM 1 0. 0. 20000. ECU_ADDRESS 0xd000442c FORMAT "%5.0" /end MEASUREMENT
/begin MEASUREMENT Vxx_cylr_max_tq_dec_yy "Maximal deterioration of torque to refute the phasing of the injection mark" SWORD _CNV_A_R_LINEAR_____369_CM 1 0. -3276.8 3276.7 ECU_ADDRESS 0xd000442e FORMAT "%6.1" /end MEASUREMENT
/begin MEASUREMENT Vxx_cylr_min_n_yy "Minimal engine speed for cylinder recognition" UBYTE _CNV_A_R_LINEAR_____2_CM 1 0. 0. 8160. ECU_ADDRESS 0xd0006cfe FORMAT "%4.0" /end MEASUREMENT
/begin MEASUREMENT Vxx_cylr_min_prs_yy "Minimal pressure for cylinder recognition" UWORD _CNV_A_R_LINEAR_____115_CM 1 0. 0. 20000. ECU_ADDRESS 0xd0004430 FORMAT "%5.0" /end MEASUREMENT
/begin MEASUREMENT Vxx_cylr_min_tq_dec_yy "Minimal deterioration of torque to confirm the phasing of the injection mark" SWORD _CNV_A_R_LINEAR_____369_CM 1 0. -3276.8 3276.7 ECU_ADDRESS 0xd0004432 FORMAT "%6.1" /end MEASUREMENT
/begin MEASUREMENT Vxx_cylr_ok_aftr_stal_ctr_ini "Initial value of Vxx_cylr_ok_aftr_stal_ctr" UWORD _CNV_A_R_ECME_LINEA_0_CM 1 0. 0. 65535. ECU_ADDRESS 0xd0004434 FORMAT "%5.0" /end MEASUREMENT
/begin MEASUREMENT Vxx_cylr_ok_ctr_ini "Initial value of Vxx_cylr_ok_ctr" UWORD _CNV_A_R_ECME_LINEA_0_CM 1 0. 0. 65535. ECU_ADDRESS 0xd0004436 FORMAT "%5.0" /end MEASUREMENT
/begin MEASUREMENT Vxx_cylr_prs_stab_dif "Maximum difference of pressure for engine stability criteria of cylinder recognition" UWORD _CNV_A_R_LINEAR_____115_CM 1 0. 0. 20000. ECU_ADDRESS 0xd0004438 FORMAT "%5.0" /end MEASUREMENT
/begin MEASUREMENT Vxx_cylr_stab_ctr_yy "Number of stability TDC to launch partial injection" UBYTE _CNV_A_R_LINEAR_____101_CM 1 0. 0. 255. ECU_ADDRESS 0xd0006cff FORMAT "%3.0" /end MEASUREMENT
/begin MEASUREMENT Vxx_cylr_stab_is_ctr_yy "Number of stability TDC to launch partial injection in idle speed regulation" UBYTE _CNV_A_R_LINEAR_____101_CM 1 0. 0. 255. ECU_ADDRESS 0xd0006d00 FORMAT "%3.0" /end MEASUREMENT
/begin MEASUREMENT Vxx_cylr_tdc_ctr "TDC counter for cylinder recognition" UWORD _CNV_A_R_LINEAR_____101_CM 1 0. 0. 65535. ECU_ADDRESS 0xd000443a FORMAT "%5.0" /end MEASUREMENT
/begin MEASUREMENT Vxx_cylr_test_ctr "Cylinder recognition attempts counter" UBYTE _CNV_A_R_ECME_LINEA_0_CM 1 0. 0. 255. ECU_ADDRESS 0xd0006d01 FORMAT "%3.0" /end MEASUREMENT
/begin MEASUREMENT Vxx_dyn_re_phs_ofs "Dynamic offset during rephasage" UBYTE _CNV_A_R_LINEAR_____368_CM 1 0. 0. 255. ECU_ADDRESS 0xd0006d02 FORMAT "%3.0" /end MEASUREMENT
/begin MEASUREMENT Vxx_err_cylr_ctr_ini "Initial value of Vxx_err_cylr_ctr" UWORD _CNV_A_R_ECME_LINEA_0_CM 1 0. 0. 65535. ECU_ADDRESS 0xd000443c FORMAT "%5.0" /end MEASUREMENT
/begin MEASUREMENT Vxx_err_cylr_is_run_ctr_ini "Initial value of Vxx_err_cylr_is_run_ctr" UWORD _CNV_A_R_ECME_LINEA_0_CM 1 0. 0. 65535. ECU_ADDRESS 0xd000443e FORMAT "%5.0" /end MEASUREMENT
/begin MEASUREMENT Vxx_err_id_is_run_ctr_ini "Initial value of Vxx_err_id_is_run_ctr" UWORD _CNV_A_R_ECME_LINEA_0_CM 1 0. 0. 65535. ECU_ADDRESS 0xd0004440 FORMAT "%5.0" /end MEASUREMENT
/begin MEASUREMENT Vxx_inj_mov_ofs "Offset for mark injection gap" UBYTE _CNV_A_R_LINEAR_____368_CM 1 0. 0. 255. ECU_ADDRESS 0xd0006d03 FORMAT "%3.0" /end MEASUREMENT
/begin MEASUREMENT Vxx_is_cylr_ok_ctr_ini "initial value of Vxx_is_cylr_ok_ctr" UWORD _CNV_A_R_ECME_LINEA_0_CM 1 0. 0. 65535. ECU_ADDRESS 0xd0004442 FORMAT "%5.0" /end MEASUREMENT
/begin MEASUREMENT Vxx_map_cor "Manifold pressure corrected as a function of atmospheric pressure" UWORD _CNV_A_R_LINEAR_____115_CM 1 0. 0. 20000. ECU_ADDRESS 0xd0004444 FORMAT "%5.0" /end MEASUREMENT
/begin MEASUREMENT Vxx_n_cylr_mem "Engine speed memorized for stability for stability in idle speed regulation" UBYTE _CNV_A_R_LINEAR_____2_CM 1 0. 0. 8160. ECU_ADDRESS 0xd0006d04 FORMAT "%4.0" /end MEASUREMENT
/begin MEASUREMENT Vxx_no_deci_cylr_ctr_ini "Initial value of Vxx_no_deci_cylr_ctr" UWORD _CNV_A_R_ECME_LINEA_0_CM 1 0. 0. 65535. ECU_ADDRESS 0xd0004446 FORMAT "%5.0" /end MEASUREMENT
/begin MEASUREMENT Vxx_no_deci_id_is_ctr_ini "Initial value of Vxx_no_deci_id_is_ctr" UWORD _CNV_A_R_ECME_LINEA_0_CM 1 0. 0. 65535. ECU_ADDRESS 0xd0004448 FORMAT "%5.0" /end MEASUREMENT
/begin MEASUREMENT Vxx_prs_cylr_mem "Memorized pressure for stability during cylinder recognition" UWORD _CNV_A_R_LINEAR_____115_CM 1 0. 0. 20000. ECU_ADDRESS 0xd000444a FORMAT "%5.0" /end MEASUREMENT
/begin MEASUREMENT Vxx_run_re_phs_ctr_ini "Initial value of Vxx_run_re_phs_ctr" UWORD _CNV_A_R_ECME_LINEA_0_CM 1 0. 0. 65535. ECU_ADDRESS 0xd000444c FORMAT "%5.0" /end MEASUREMENT
/begin MEASUREMENT Vxx_ti_cylr_mem "Memorized effective time injection" ULONG _CNV_A_R_LINEAR_____102_CM 1 0. 0. 500000. ECU_ADDRESS 0xd0002758 FORMAT "%6.0" /end MEASUREMENT
/begin MEASUREMENT Vxx_tq_dec "Torque deterioration" SWORD _CNV_A_R_LINEAR_____369_CM 1 0. -3276.8 3276.7 ECU_ADDRESS 0xd000444e FORMAT "%6.1" /end MEASUREMENT
/begin MEASUREMENT Vxx_trz_cylr_mem "Raw gas torque memorized for cylinder recognition" SWORD _CNV_A_R_LINEAR_____369_CM 1 0. -3276.8 3276.7 ECU_ADDRESS 0xd0004450 FORMAT "%6.1" /end MEASUREMENT
/begin CHARACTERISTIC Cbx_bch_cylr "Cylinder recognition in bench mode" VALUE 0xa00216a0 _REC_S1VAL_20_u1 1. _CNV_A_R_ECME_LINEA_0_CM 0. 1. FORMAT "%1.0" BIT_MASK 0x1 /end CHARACTERISTIC
/begin CHARACTERISTIC Cbx_cylr_bas_conf "Software configuration with/without cylinder recognition" VALUE 0xa00216a1 _REC_S1VAL_20_u1 1. _CNV_A_R_ECME_LINEA_0_CM 0. 1. FORMAT "%1.0" BIT_MASK 0x1 /end CHARACTERISTIC
/begin CHARACTERISTIC Cbx_cylr_bch_mod "Activation of cylinder recognition in bench mode" VALUE 0xa00216a2 _REC_S1VAL_20_u1 1. _CNV_A_R_ECME_LINEA_0_CM 0. 1. FORMAT "%1.0" BIT_MASK 0x1 /end CHARACTERISTIC
/begin CHARACTERISTIC Cbx_cylr_ena_re_phs "Rephasing of injection mark is authorised" VALUE 0xa00216a3 _REC_S1VAL_20_u1 1. _CNV_A_R_ECME_LINEA_0_CM 0. 1. FORMAT "%1.0" BIT_MASK 0x1 /end CHARACTERISTIC
/begin CHARACTERISTIC Cbx_cylr_is_neg_clu_stal "Cylinder recognition in idle speed regulation (looped or unlooped) authorized if no clutch stall" VALUE 0xa00216a4 _REC_S1VAL_20_u1 1. _CNV_A_R_ECME_LINEA_0_CM 0. 1. FORMAT "%1.0" BIT_MASK 0x1 /end CHARACTERISTIC
/begin CHARACTERISTIC Cbx_cylr_is_run_gex_appl "Compulsory cylinder recognition in idle speed regulation (looped or unlooped) if upstream lambda sensor is in GEX" VALUE 0xa00216a5 _REC_S1VAL_20_u1 1. _CNV_A_R_ECME_LINEA_0_CM 0. 1. FORMAT "%1.0" BIT_MASK 0x1 /end CHARACTERISTIC
/begin CHARACTERISTIC Cbx_cylr_loop "Cylinder recognition in infinite loop for tuning needs" VALUE 0xa00216a6 _REC_S1VAL_20_u1 1. _CNV_A_R_ECME_LINEA_0_CM 0. 1. FORMAT "%1.0" BIT_MASK 0x1 /end CHARACTERISTIC
/begin CHARACTERISTIC Cbx_cylr_run_ol "Cylinder recognition in richness open loop authorised" VALUE 0xa00216a7 _REC_S1VAL_20_u1 1. _CNV_A_R_ECME_LINEA_0_CM 0. 1. FORMAT "%1.0" BIT_MASK 0x1 /end CHARACTERISTIC
/begin CHARACTERISTIC Cxx_crk1_bas_toth_nr "Teeth number of crankshaft target seen by LDB" VALUE 0xa00216a8 _REC_S1VAL_20_u1 255. _CNV_A_R_LINEAR_____368_CM 0. 255. FORMAT "%3.0" /end CHARACTERISTIC
/begin CHARACTERISTIC Cxx_cylr_alti_prs_max_fac "Factor on the calculation of maximal pressure threshold depending on altitude for cylinder recognition" VALUE 0xa00216a9 _REC_S1VAL_20_u1 1. _CNV_A_R_LINEAR_____162_CM 0. 1. FORMAT "%9.7" /end CHARACTERISTIC
/begin CHARACTERISTIC Cxx_cylr_alti_prs_min_fac "Factor on the calculation of minimal pressure threshold depending on altitude for cylinder recognition" VALUE 0xa00216aa _REC_S1VAL_20_u1 1. _CNV_A_R_LINEAR_____162_CM 0. 1. FORMAT "%9.7" /end CHARACTERISTIC
/begin CHARACTERISTIC Cxx_cylr_clc_ctr "Duration of multiple injections in number of engine cycles (= 4TDC)" VALUE 0xa00216ab _REC_S1VAL_20_u1 1020. _CNV_A_R_LINEAR_____324_CM 0. 1020. FORMAT "%4.0" /end CHARACTERISTIC
/begin CHARACTERISTIC Cxx_cylr_clc_ctr_lpg "Duration of multiple injections in number of engine cycles (= 4TDC) in LPG" VALUE 0xa00216ac _REC_S1VAL_20_u1 1020. _CNV_A_R_LINEAR_____324_CM 0. 1020. FORMAT "%4.0" /end CHARACTERISTIC
/begin CHARACTERISTIC Cxx_cylr_cold_is_stab_t "Duration of expectation period during multiple injection in idle speed regulation and cold engine" VALUE 0xa00216ad _REC_S1VAL_20_u1 1020. _CNV_A_R_LINEAR_____324_CM 0. 1020. FORMAT "%4.0" /end CHARACTERISTIC
/begin CHARACTERISTIC Cxx_cylr_gear "Minimum value of VehicleSpeed/Neng ratio for cylinder recognition " VALUE 0xa0021674 _REC_S1VAL_20_u2 210. _CNV_A_R_LINEAR_____197_CM -10. 200. FORMAT "%6.2" /end CHARACTERISTIC
/begin CHARACTERISTIC Cxx_cylr_is_clc_ctr "Duration of multiple injection in number of engine cycle (= 4TDC) in idle speed regulation" VALUE 0xa00216ae _REC_S1VAL_20_u1 1020. _CNV_A_R_LINEAR_____324_CM 0. 1020. FORMAT "%4.0" /end CHARACTERISTIC
/begin CHARACTERISTIC Cxx_cylr_is_clc_ctr_lpg "Duration of multiple injection in number of engine cycle (= 4TDC) in idle speed regulation for LPG" VALUE 0xa00216af _REC_S1VAL_20_u1 1020. _CNV_A_R_LINEAR_____324_CM 0. 1020. FORMAT "%4.0" /end CHARACTERISTIC
/begin CHARACTERISTIC Cxx_cylr_is_max_test_nr "Threshold of cylinder recognition attempts when RR is launched" VALUE 0xa00216b0 _REC_S1VAL_20_u1 255. _CNV_A_R_ECME_LINEA_0_CM 0. 255. FORMAT "%3.0" /end CHARACTERISTIC
/begin CHARACTERISTIC Cxx_cylr_is_max_tq_dec "Maximal deterioration of torque to refute the phasing of the injection mark in RR mode" VALUE 0xa0021676 _REC_S1VAL_20_s2 6553.5 _CNV_A_R_LINEAR_____369_CM -3276.8 3276.7 FORMAT "%6.1" /end CHARACTERISTIC
/begin CHARACTERISTIC Cxx_cylr_is_max_tq_dec_lpg "Maximal deterioration of torque to refute the phasing of the injection mark in RR mode for LPG" VALUE 0xa0021678 _REC_S1VAL_20_s2 6553.5 _CNV_A_R_LINEAR_____369_CM -3276.8 3276.7 FORMAT "%6.1" /end CHARACTERISTIC
/begin CHARACTERISTIC Cxx_cylr_is_min_tq_dec "Minimal deterioration of torque to confirm the phasing of the injection mark in RR mode" VALUE 0xa002167a _REC_S1VAL_20_s2 6553.5 _CNV_A_R_LINEAR_____369_CM -3276.8 3276.7 FORMAT "%6.1" /end CHARACTERISTIC
/begin CHARACTERISTIC Cxx_cylr_is_min_tq_dec_lpg "Minimal deterioration of torque to confirm the phasing of the injection mark in RR mode" VALUE 0xa002167c _REC_S1VAL_20_s2 6553.5 _CNV_A_R_LINEAR_____369_CM -3276.8 3276.7 FORMAT "%6.1" /end CHARACTERISTIC
/begin CHARACTERISTIC Cxx_cylr_is_run_max_tco "Maximal water temperature for Idle speed regulation cylinder recognition with extended wait" VALUE 0xa002167e _REC_S1VAL_20_u2 240. _CNV_A_R_LINEAR_____110_CM -40. 200. FORMAT "%5.1" /end CHARACTERISTIC
/begin CHARACTERISTIC Cxx_cylr_is_run_min_tco "Minimal water temperature for Idle speed regulation cylinder recognition" VALUE 0xa0021680 _REC_S1VAL_20_u2 240. _CNV_A_R_LINEAR_____110_CM -40. 200. FORMAT "%5.1" /end CHARACTERISTIC
/begin CHARACTERISTIC Cxx_cylr_is_run_n_fac "Offset of zone of engine speed (on REGNOM) for cylinder recognition in RR" VALUE 0xa00216b1 _REC_S1VAL_20_u1 8160. _CNV_A_R_LINEAR_____2_CM 0. 8160. FORMAT "%4.0" /end CHARACTERISTIC
/begin CHARACTERISTIC Cxx_cylr_is_ti_cor_max "Maximum value of Vxx_tco_ti_cor for engine stabily tests in idle speed regulation" VALUE 0xa0021682 _REC_S1VAL_20_u2 3.99993896484375 _CNV_A_R_LINEAR_____170_CM 0.5 4.49993896484375 FORMAT "%10.8" /end CHARACTERISTIC
/begin CHARACTERISTIC Cxx_cylr_l_n_re_phs "Low engine speed for cylinder recognition rephasage" VALUE 0xa00216b2 _REC_S1VAL_20_u1 8160. _CNV_A_R_LINEAR_____2_CM 0. 8160. FORMAT "%4.0" /end CHARACTERISTIC
/begin CHARACTERISTIC Cxx_cylr_l_prs_dif_fac "Factor on the calculation of maximal pressure difference threshold depending on altitude for cylinder recognition" VALUE 0xa00216b3 _REC_S1VAL_20_u1 1. _CNV_A_R_LINEAR_____162_CM 0. 1. FORMAT "%9.7" /end CHARACTERISTIC
/begin CHARACTERISTIC Cxx_cylr_l_prs_re_phs "Low pressure for cylinder recognition regulation" VALUE 0xa0021684 _REC_S1VAL_20_u2 20000. _CNV_A_R_LINEAR_____115_CM 0. 20000. FORMAT "%5.0" /end CHARACTERISTIC
/begin CHARACTERISTIC Cxx_cylr_max_dif_iga "Maximal advance gap due to stability for cylinder recognition" VALUE 0xa00216b4 _REC_S1VAL_20_u1 95.625 _CNV_A_R_LINEAR_____23_CM 0. 95.625 /end CHARACTERISTIC
/begin CHARACTERISTIC Cxx_cylr_max_mv_lamb_fac "Maximal value of the lambda average factor for the cylinder recognition" VALUE 0xa0021686 _REC_S1VAL_20_u2 0.66665649414063 _CNV_A_R_LINEAR_____100_CM 0.6666666 1.33332309414063 FORMAT "%8.7" /end CHARACTERISTIC
/begin CHARACTERISTIC Cxx_cylr_max_n "Maximal engine speed for cylinder recognition" VALUE 0xa00216b5 _REC_S1VAL_20_u1 8160. _CNV_A_R_LINEAR_____2_CM 0. 8160. FORMAT "%4.0" /end CHARACTERISTIC
/begin CHARACTERISTIC Cxx_cylr_max_n_lpg "Maximal engine speed for cylinder recognition (LPG)" VALUE 0xa00216b6 _REC_S1VAL_20_u1 8160. _CNV_A_R_LINEAR_____2_CM 0. 8160. FORMAT "%4.0" /end CHARACTERISTIC
/begin CHARACTERISTIC Cxx_cylr_max_prs "Maximal pressure for cylinder recognition" VALUE 0xa0021688 _REC_S1VAL_20_u2 20000. _CNV_A_R_LINEAR_____115_CM 0. 20000. FORMAT "%5.0" /end CHARACTERISTIC
/begin CHARACTERISTIC Cxx_cylr_max_prs_lpg "Maximal pressure for cylinder recognition (LPG)" VALUE 0xa002168a _REC_S1VAL_20_u2 20000. _CNV_A_R_LINEAR_____115_CM 0. 20000. FORMAT "%5.0" /end CHARACTERISTIC
/begin CHARACTERISTIC Cxx_cylr_max_tco "Maximal water temperature for cylinder recognition in idle speed regulation" VALUE 0xa002168c _REC_S1VAL_20_u2 240. _CNV_A_R_LINEAR_____110_CM -40. 200. FORMAT "%5.1" /end CHARACTERISTIC
/begin CHARACTERISTIC Cxx_cylr_max_test_nr "Threshold of cylinder recognition attempts" VALUE 0xa00216b7 _REC_S1VAL_20_u1 255. _CNV_A_R_ECME_LINEA_0_CM 0. 255. FORMAT "%3.0" /end CHARACTERISTIC
/begin CHARACTERISTIC Cxx_cylr_max_tq_dec "Maximal deterioration of torque to refute the phasing of the injection mark" VALUE 0xa002168e _REC_S1VAL_20_s2 6553.5 _CNV_A_R_LINEAR_____369_CM -3276.8 3276.7 FORMAT "%6.1" /end CHARACTERISTIC
/begin CHARACTERISTIC Cxx_cylr_max_tq_dec_lpg "Maximal deterioration of torque to refute the phasing of the injection mark for LPG" VALUE 0xa0021690 _REC_S1VAL_20_s2 6553.5 _CNV_A_R_LINEAR_____369_CM -3276.8 3276.7 FORMAT "%6.1" /end CHARACTERISTIC
/begin CHARACTERISTIC Cxx_cylr_min_mv_lamb_fac "Minimal value of the lambda average factor for the cylinder recognition" VALUE 0xa0021692 _REC_S1VAL_20_u2 0.66665649414063 _CNV_A_R_LINEAR_____100_CM 0.6666666 1.33332309414063 FORMAT "%8.7" /end CHARACTERISTIC
/begin CHARACTERISTIC Cxx_cylr_min_n "Minimal engine speed for cylinder recognition" VALUE 0xa00216b8 _REC_S1VAL_20_u1 8160. _CNV_A_R_LINEAR_____2_CM 0. 8160. FORMAT "%4.0" /end CHARACTERISTIC
/begin CHARACTERISTIC Cxx_cylr_min_n_lpg "Maximal engine speed for cylinder recognition (LPG)" VALUE 0xa00216b9 _REC_S1VAL_20_u1 8160. _CNV_A_R_LINEAR_____2_CM 0. 8160. FORMAT "%4.0" /end CHARACTERISTIC
/begin CHARACTERISTIC Cxx_cylr_min_prs "Minimal pressure for cylinder recognition" VALUE 0xa0021694 _REC_S1VAL_20_u2 20000. _CNV_A_R_LINEAR_____115_CM 0. 20000. FORMAT "%5.0" /end CHARACTERISTIC
/begin CHARACTERISTIC Cxx_cylr_min_prs_lpg "Minimal pressure for cylinder recognition (LPG)" VALUE 0xa0021696 _REC_S1VAL_20_u2 20000. _CNV_A_R_LINEAR_____115_CM 0. 20000. FORMAT "%5.0" /end CHARACTERISTIC
/begin CHARACTERISTIC Cxx_cylr_min_tco "Minimal water temperature for cylinder recognition" VALUE 0xa0021698 _REC_S1VAL_20_u2 240. _CNV_A_R_LINEAR_____110_CM -40. 200. FORMAT "%5.1" /end CHARACTERISTIC
/begin CHARACTERISTIC Cxx_cylr_min_tq_dec "Minimal deterioration of torque to confirm the phasing of the injection mark" VALUE 0xa002169a _REC_S1VAL_20_s2 6553.5 _CNV_A_R_LINEAR_____369_CM -3276.8 3276.7 FORMAT "%6.1" /end CHARACTERISTIC
/begin CHARACTERISTIC Cxx_cylr_min_tq_dec_lpg "Minimal deterioration of torque to confirm the phasing of the injection mark for LPG" VALUE 0xa002169c _REC_S1VAL_20_s2 6553.5 _CNV_A_R_LINEAR_____369_CM -3276.8 3276.7 FORMAT "%6.1" /end CHARACTERISTIC
/begin CHARACTERISTIC Cxx_cylr_n_stab_dif "maximal engine speed gap due to stability for cylinder recognition in idle speed regulation" VALUE 0xa00216ba _REC_S1VAL_20_u1 8160. _CNV_A_R_LINEAR_____2_CM 0. 8160. FORMAT "%4.0" /end CHARACTERISTIC
/begin CHARACTERISTIC Cxx_cylr_stab_ctr "Number of stability TDC to launch partial injection" VALUE 0xa00216bb _REC_S1VAL_20_u1 255. _CNV_A_R_LINEAR_____101_CM 0. 255. FORMAT "%3.0" /end CHARACTERISTIC
/begin CHARACTERISTIC Cxx_cylr_stab_ctr_lpg "Number of stability TDC to launch partial injection (LPG)" VALUE 0xa00216bc _REC_S1VAL_20_u1 255. _CNV_A_R_LINEAR_____101_CM 0. 255. FORMAT "%3.0" /end CHARACTERISTIC
/begin CHARACTERISTIC Cxx_cylr_stab_inj_dif "Max percentage of injection time due to stability for cylinder recognition" VALUE 0xa00216bd _REC_S1VAL_20_u1 1. _CNV_A_R_LINEAR_____162_CM 0. 1. FORMAT "%9.7" /end CHARACTERISTIC
/begin CHARACTERISTIC Cxx_cylr_stab_is_ctr "Number of stability TDC to launch partial injection in idle speed regulation" VALUE 0xa00216be _REC_S1VAL_20_u1 255. _CNV_A_R_LINEAR_____101_CM 0. 255. FORMAT "%3.0" /end CHARACTERISTIC
/begin CHARACTERISTIC Cxx_cylr_stab_is_ctr_lpg "Number of stability TDC to launch partial injection in idle speed regulation (LPG)" VALUE 0xa00216bf _REC_S1VAL_20_u1 255. _CNV_A_R_LINEAR_____101_CM 0. 255. FORMAT "%3.0" /end CHARACTERISTIC
/begin CHARACTERISTIC Cxx_cylr_stab_t "Duration of the expectation period during the multiple injections" VALUE 0xa00216c0 _REC_S1VAL_20_u1 1020. _CNV_A_R_LINEAR_____324_CM 0. 1020. FORMAT "%4.0" /end CHARACTERISTIC
/begin CHARACTERISTIC Cxx_cylr_trz_stab_dif "Maximum difference of TRZ torque gap for engine stability criteria" VALUE 0xa002169e _REC_S1VAL_20_u2 6553.5 _CNV_A_R_LINEAR_____369_CM 0. 6553.5 FORMAT "%6.1" /end CHARACTERISTIC
/begin CHARACTERISTIC Cxx_is_run_stal_step "Step of gap in teeth during a rephasage in idle speed regulation" VALUE 0xa00216c1 _REC_S1VAL_20_u1 255. _CNV_A_R_LINEAR_____368_CM 0. 255. FORMAT "%3.0" /end CHARACTERISTIC
/begin CHARACTERISTIC Cxx_stal_step "Step of gap in teeth" VALUE 0xa00216c2 _REC_S1VAL_20_u1 255. _CNV_A_R_LINEAR_____368_CM 0. 255. FORMAT "%3.0" /end CHARACTERISTIC
/begin MEASUREMENT Vbx_in_cam_lvl "Consolidated intake camshaft level" UBYTE _CNV_S_2_RANGE______3_CM 1 0. 0. 1. ECU_ADDRESS 0xd0006cbc BIT_MASK 0x1 /end MEASUREMENT
/begin MEASUREMENT Vbx_pres_df_in_cam_chr "Consolidation of intake camshaft signal incoherency detected failure" UBYTE _CNV_S_2_RANGE______3_CM 1 0. 0. 1. ECU_ADDRESS 0xd0006cbd BIT_MASK 0x1 /end MEASUREMENT
/begin MEASUREMENT Vbx_pres_df_in_cam_crk_cmp "Consolidation of incoherency between intake camshaft signal and crankshaft signal detected failure" UBYTE _CNV_S_2_RANGE______3_CM 1 0. 0. 1. ECU_ADDRESS 0xd0006cbe BIT_MASK 0x1 /end MEASUREMENT
/begin MEASUREMENT Vbx_pres_df_in_cam_cyc "Consolidation of interference close to a intake camshaft edge confirmed failure" UBYTE _CNV_S_2_RANGE______3_CM 1 0. 0. 1. ECU_ADDRESS 0xd0006cbf BIT_MASK 0x1 /end MEASUREMENT
/begin MEASUREMENT Vbx_pres_df_in_cam_no_sig "Consolidation of no intake camshaft signal detected failure" UBYTE _CNV_S_2_RANGE______3_CM 1 0. 0. 1. ECU_ADDRESS 0xd0006cc0 BIT_MASK 0x1 /end MEASUREMENT
/begin MEASUREMENT Vbx_pres_df_in_cam_nok "Consolidation of camshaft signal invalid for synchronisation detected failure" UBYTE _CNV_S_2_RANGE______3_CM 1 0. 0. 1. ECU_ADDRESS 0xd0006cc1 BIT_MASK 0x1 /end MEASUREMENT
/begin MEASUREMENT Vsx_sens_in_cam_vld "Intake camshaft sensor validity status" UBYTE _CNV_S_3_STATUS_OK__179_CM 1 0. 0. 2. ECU_ADDRESS 0xd0006cc2 /end MEASUREMENT
/begin MEASUREMENT Vxx_in_cam_toth_per "Duration between two intake camshaft events" UWORD _CNV_A_R_LINEAR_____202_CM 1 0. 0. 65535. ECU_ADDRESS 0xd00043ee FORMAT "%5.0" /end MEASUREMENT
/begin CHARACTERISTIC Cxx_dfdec_in_cam_chr "intake camshaft signal incoherency detected failure counter decrement" VALUE 0xa0021632 _REC_S1VAL_20_u2 65535. _CNV_A_R_ECME_LINEA_0_CM 0. 65535. FORMAT "%5.0" /end CHARACTERISTIC
/begin CHARACTERISTIC Cxx_dfdec_in_cam_crk_cmp "incoherency between intake camshaft signal and crankshaft signal detected failure counter decrement" VALUE 0xa0021634 _REC_S1VAL_20_u2 65535. _CNV_A_R_ECME_LINEA_0_CM 0. 65535. FORMAT "%5.0" /end CHARACTERISTIC
/begin CHARACTERISTIC Cxx_dfdec_in_cam_cyc "Interference close to a intake camshaft edge detected failure counter decrement" VALUE 0xa0021636 _REC_S1VAL_20_u2 65535. _CNV_A_R_ECME_LINEA_0_CM 0. 65535. FORMAT "%5.0" /end CHARACTERISTIC
/begin CHARACTERISTIC Cxx_dfdec_in_cam_no_sig "no intake camshaft signal detected failure counter decrement" VALUE 0xa0021638 _REC_S1VAL_20_u2 65535. _CNV_A_R_ECME_LINEA_0_CM 0. 65535. FORMAT "%5.0" /end CHARACTERISTIC
/begin CHARACTERISTIC Cxx_dfdec_in_cam_nok "Camshaft signal invalid for synchronisation detected failure counter decrement" VALUE 0xa002163a _REC_S1VAL_20_u2 65535. _CNV_A_R_ECME_LINEA_0_CM 0. 65535. FORMAT "%5.0" /end CHARACTERISTIC
/begin CHARACTERISTIC Cxx_dfinc_in_cam_chr "intake camshaft signal incoherency detected failure counter increment" VALUE 0xa002163c _REC_S1VAL_20_u2 65535. _CNV_A_R_ECME_LINEA_0_CM 0. 65535. FORMAT "%5.0" /end CHARACTERISTIC
/begin CHARACTERISTIC Cxx_dfinc_in_cam_crk_cmp "incoherency between intake camshaft signal and crankshaft signal detected failure counter increment" VALUE 0xa002163e _REC_S1VAL_20_u2 65535. _CNV_A_R_ECME_LINEA_0_CM 0. 65535. FORMAT "%5.0" /end CHARACTERISTIC
/begin CHARACTERISTIC Cxx_dfinc_in_cam_cyc "Interference close to a intake camshaft edge detected failure counter increment" VALUE 0xa0021640 _REC_S1VAL_20_u2 65535. _CNV_A_R_ECME_LINEA_0_CM 0. 65535. FORMAT "%5.0" /end CHARACTERISTIC
/begin CHARACTERISTIC Cxx_dfinc_in_cam_no_sig "no intake camshaft signal detected failure counter increment" VALUE 0xa0021642 _REC_S1VAL_20_u2 65535. _CNV_A_R_ECME_LINEA_0_CM 0. 65535. FORMAT "%5.0" /end CHARACTERISTIC
/begin CHARACTERISTIC Cxx_dfinc_in_cam_nok "Camshaft signal invalid for synchronisation detected failure counter increment" VALUE 0xa0021644 _REC_S1VAL_20_u2 65535. _CNV_A_R_ECME_LINEA_0_CM 0. 65535. FORMAT "%5.0" /end CHARACTERISTIC
/begin MEASUREMENT Vbx_crk "Crankshaft signal" UBYTE _CNV_S_2_RANGE______3_CM 1 0. 0. 1. ECU_ADDRESS 0xd0007c09 BIT_MASK 0x1 /end MEASUREMENT
/begin MEASUREMENT Vbx_crk_syn "Set to ON after the first long tooth" UBYTE _CNV_S_2_RANGE______3_CM 1 0. 0. 1. ECU_ADDRESS 0xd0007c0a BIT_MASK 0x1 /end MEASUREMENT
/begin MEASUREMENT Vbx_deb_cdn "Flag indicating debouce test is OK" UBYTE _CNV_S_2_RANGE______3_CM 1 0. 0. 1. ECU_ADDRESS 0xd0007c0b BIT_MASK 0x1 /end MEASUREMENT
/begin MEASUREMENT Vbx_df_crk_no_sig "no crankshaft signal detected failure" UBYTE _CNV_S_2_RANGE______3_CM 1 0. 0. 1. ECU_ADDRESS 0xd0006cc3 BIT_MASK 0x1 /end MEASUREMENT
/begin MEASUREMENT Vbx_df_crk_no_sig_wio_cam "no crankshaft signal detected failure for engine without camshaft sensor" UBYTE _CNV_S_2_RANGE______3_CM 1 0. 0. 1. ECU_ADDRESS 0xd0007c0c BIT_MASK 0x1 /end MEASUREMENT
/begin MEASUREMENT Vbx_diag_ena_crk_no_sig "no crankshaft signal diagnosis authorization" UBYTE _CNV_S_2_RANGE______3_CM 1 0. 0. 1. ECU_ADDRESS 0xd0006cc4 BIT_MASK 0x1 /end MEASUREMENT
/begin MEASUREMENT Vbx_diag_ena_crk_no_sig_wio_cam "no crankshaft signal diagnosis authorization for engine without camshaft sensor" UBYTE _CNV_S_2_RANGE______3_CM 1 0. 0. 1. ECU_ADDRESS 0xd0007c0d BIT_MASK 0x1 /end MEASUREMENT
/begin MEASUREMENT Vbx_main_cdn "Flag indicating general conditions for the detection of crankshaft absence are OK" UBYTE _CNV_S_2_RANGE______3_CM 1 0. 0. 1. ECU_ADDRESS 0xd0007c0e BIT_MASK 0x1 /end MEASUREMENT
/begin MEASUREMENT Vbx_map_flu_cdn "Flag indicating manifold pressure variation are in the range of running engine" UBYTE _CNV_S_2_RANGE______3_CM 1 0. 0. 1. ECU_ADDRESS 0xd0007c0f BIT_MASK 0x1 /end MEASUREMENT
/begin MEASUREMENT Vbx_pres_df_crk_chr "Consolidation of no cranshaft reference detection  detected failure" UBYTE _CNV_S_2_RANGE______3_CM 1 0. 0. 1. ECU_ADDRESS 0xd0006cc5 BIT_MASK 0x1 /end MEASUREMENT
/begin MEASUREMENT Vbx_pres_df_crk_cmp "Consolidation of incorrect number of crankshaft teeth detected failure" UBYTE _CNV_S_2_RANGE______3_CM 1 0. 0. 1. ECU_ADDRESS 0xd0006cc6 BIT_MASK 0x1 /end MEASUREMENT
/begin MEASUREMENT Vbx_pres_df_crk_cyc "Consolidation of interference between two crankshaft teeth detected failure" UBYTE _CNV_S_2_RANGE______3_CM 1 0. 0. 1. ECU_ADDRESS 0xd0006cc7 BIT_MASK 0x1 /end MEASUREMENT
/begin MEASUREMENT Vbx_pres_df_crk_no_sig "Consolidation of no crankshaft signal detected failure" UBYTE _CNV_S_2_RANGE______3_CM 1 0. 0. 1. ECU_ADDRESS 0xd0006cc8 BIT_MASK 0x1 /end MEASUREMENT
/begin MEASUREMENT Vbx_pres_df_crk_oc "Consolidation of open circuit of one of the leads of crankshaft sensor detected failure" UBYTE _CNV_S_2_RANGE______3_CM 1 0. 0. 1. ECU_ADDRESS 0xd0006cc9 BIT_MASK 0x1 /end MEASUREMENT
/begin MEASUREMENT Vbx_pres_df_crk_shp "Consolidation of no detection of crankshaft reference detected failure" UBYTE _CNV_S_2_RANGE______3_CM 1 0. 0. 1. ECU_ADDRESS 0xd0006cca BIT_MASK 0x1 /end MEASUREMENT
/begin MEASUREMENT Vbx_run_eng_det "Boolean indicating that the engine is running" UBYTE _CNV_S_2_RANGE______3_CM 1 0. 0. 1. ECU_ADDRESS 0xd0007c10 BIT_MASK 0x1 /end MEASUREMENT
/begin MEASUREMENT Vsx_sens_crk_vld "Crankshaft sensor validity status" UBYTE _CNV_S_3_STATUS_OK__179_CM 1 0. 0. 2. ECU_ADDRESS 0xd0006ccb /end MEASUREMENT
/begin MEASUREMENT Vxx_crk_syn_loss_ctr_ini "Initial value of Vxx_crk_syn_loss_ctr" UWORD _CNV_A_R_ECME_LINEA_0_CM 1 0. 0. 65535. ECU_ADDRESS 0xd0005f42 FORMAT "%5.0" /end MEASUREMENT
/begin MEASUREMENT Vxx_ctr_vld_crk_fail1 "Counter of the number of confirmation of the first detected failure \"No crankshft signal\"" UBYTE _CNV_A_R_ECME_LINEA_0_CM 1 0. 0. 255. ECU_ADDRESS 0xd0007c11 FORMAT "%3.0" /end MEASUREMENT
/begin CHARACTERISTIC Cxx_dfdec_crk_chr "no cranshaft reference detection detected failure counter decrement" VALUE 0xa0021646 _REC_S1VAL_20_u2 65535. _CNV_A_R_ECME_LINEA_0_CM 0. 65535. FORMAT "%5.0" /end CHARACTERISTIC
/begin CHARACTERISTIC Cxx_dfdec_crk_cmp "Incorrect number of crankshaft teeth detected failure counter decrement" VALUE 0xa0021648 _REC_S1VAL_20_u2 65535. _CNV_A_R_ECME_LINEA_0_CM 0. 65535. FORMAT "%5.0" /end CHARACTERISTIC
/begin CHARACTERISTIC Cxx_dfdec_crk_cyc "Interference between two crankshaft teeth detected failure counter decrement" VALUE 0xa002164a _REC_S1VAL_20_u2 65535. _CNV_A_R_ECME_LINEA_0_CM 0. 65535. FORMAT "%5.0" /end CHARACTERISTIC
/begin CHARACTERISTIC Cxx_dfdec_crk_no_sig "no crankshaft signal detected failure counter decrement" VALUE 0xa002164c _REC_S1VAL_20_u2 65535. _CNV_A_R_ECME_LINEA_0_CM 0. 65535. FORMAT "%5.0" /end CHARACTERISTIC
/begin CHARACTERISTIC Cxx_dfdec_crk_oc "Open circuit of one of the leads of crankshaft sensor detected failure counter decrement" VALUE 0xa002164e _REC_S1VAL_20_u2 65535. _CNV_A_R_ECME_LINEA_0_CM 0. 65535. FORMAT "%5.0" /end CHARACTERISTIC
/begin CHARACTERISTIC Cxx_dfdec_crk_shp "No detection of crankshaft reference detected failure counter decrement" VALUE 0xa0021650 _REC_S1VAL_20_u2 65535. _CNV_A_R_ECME_LINEA_0_CM 0. 65535. FORMAT "%5.0" /end CHARACTERISTIC
/begin CHARACTERISTIC Cxx_dfinc_crk_chr "no cranshaft reference detection detected failure counter increment" VALUE 0xa0021652 _REC_S1VAL_20_u2 65535. _CNV_A_R_ECME_LINEA_0_CM 0. 65535. FORMAT "%5.0" /end CHARACTERISTIC
/begin CHARACTERISTIC Cxx_dfinc_crk_cmp "Incorrect number of crankshaft teeth detected failure counter increment" VALUE 0xa0021654 _REC_S1VAL_20_u2 65535. _CNV_A_R_ECME_LINEA_0_CM 0. 65535. FORMAT "%5.0" /end CHARACTERISTIC
/begin CHARACTERISTIC Cxx_dfinc_crk_cyc "Interference between two crankshaft teeth detected failure counter increment" VALUE 0xa0021656 _REC_S1VAL_20_u2 65535. _CNV_A_R_ECME_LINEA_0_CM 0. 65535. FORMAT "%5.0" /end CHARACTERISTIC
/begin CHARACTERISTIC Cxx_dfinc_crk_no_sig "no crankshaft signal detected failure counter increment" VALUE 0xa0021658 _REC_S1VAL_20_u2 65535. _CNV_A_R_ECME_LINEA_0_CM 0. 65535. FORMAT "%5.0" /end CHARACTERISTIC
/begin CHARACTERISTIC Cxx_dfinc_crk_oc "Open circuit of one of the leads of crankshaft sensor detected failure counter increment" VALUE 0xa002165a _REC_S1VAL_20_u2 65535. _CNV_A_R_ECME_LINEA_0_CM 0. 65535. FORMAT "%5.0" /end CHARACTERISTIC
/begin CHARACTERISTIC Cxx_dfinc_crk_shp "No detection of crankshaft reference detected failure counter increment" VALUE 0xa002165c _REC_S1VAL_20_u2 65535. _CNV_A_R_ECME_LINEA_0_CM 0. 65535. FORMAT "%5.0" /end CHARACTERISTIC
/begin CHARACTERISTIC Cxx_h_dif_prs_dsb_sp "Maximal amplitude of the oscillations of manifold pressure" VALUE 0xa002165e _REC_S1VAL_20_u2 20000. _CNV_A_R_LINEAR_____115_CM 0. 20000. FORMAT "%5.0" /end CHARACTERISTIC
/begin CHARACTERISTIC Cxx_h_thd_dif_prs_dsb_sp "Variation of vacuum pressure due to the rotation of starter" VALUE 0xa0021660 _REC_S1VAL_20_u2 20000. _CNV_A_R_LINEAR_____115_CM 0. 20000. FORMAT "%5.0" /end CHARACTERISTIC
/begin CHARACTERISTIC Cxx_h_thd_prs_sp_fail "Minimal vacuum pressure when starter is running" VALUE 0xa0021662 _REC_S1VAL_20_u2 20000. _CNV_A_R_LINEAR_____115_CM 0. 20000. FORMAT "%5.0" /end CHARACTERISTIC
/begin CHARACTERISTIC Cxx_l_thd_dif_prs_dsb_sp "Minimal amplitude of the oscillations of manifold pressure" VALUE 0xa0021664 _REC_S1VAL_20_u2 20000. _CNV_A_R_LINEAR_____115_CM 0. 20000. FORMAT "%5.0" /end CHARACTERISTIC
/begin CHARACTERISTIC Cxx_nr_vld_crk_fail1 "Number of confirmation of the first detected failure \"No crankshft signal\"" VALUE 0xa0021666 _REC_S1VAL_20_u1 255. _CNV_A_R_ECME_LINEA_0_CM 0. 255. FORMAT "%3.0" /end CHARACTERISTIC
/begin AXIS_PTS Ctb_n "20 programmable engine speed breakpoints map" 0xa002db74 Vxx_n _REC_A2AXS_20_u2 16383.75 _CNV_A_R_ENSD_LINEA_22_CM 20 0. 16383.75 FORMAT "%8.2" /end AXIS_PTS
/begin AXIS_PTS Ctb_n2 "9 programmable engine speed breakpoints table" 0xa002dba0 Vxx_n _REC_A2AXS_20_u2 16383.75 _CNV_A_R_ENSD_LINEA_22_CM 9 0. 16383.75 FORMAT "%8.2" /end AXIS_PTS
/begin MEASUREMENT Vxb_n.factor "" UWORD _CNV_A_R_A_105_CM 1 0. 0. 65535. ECU_ADDRESS 0xd0006d06 /end MEASUREMENT
/begin MEASUREMENT Vxb_n.index "" UBYTE _CNV_A_R_A_105_CM 1 0. 0. 255. ECU_ADDRESS 0xd0006d08 /end MEASUREMENT
/begin MEASUREMENT Vxb_n.num_dp "" UBYTE _CNV_A_R_A_105_CM 1 0. 0. 255. ECU_ADDRESS 0xd0006d09 /end MEASUREMENT
/begin MEASUREMENT Vxb_n2.factor "" UWORD _CNV_A_R_A_105_CM 1 0. 0. 65535. ECU_ADDRESS 0xd0006d0a /end MEASUREMENT
/begin MEASUREMENT Vxb_n2.index "" UBYTE _CNV_A_R_A_105_CM 1 0. 0. 255. ECU_ADDRESS 0xd0006d0c /end MEASUREMENT
/begin MEASUREMENT Vxb_n2.num_dp "" UBYTE _CNV_A_R_A_105_CM 1 0. 0. 255. ECU_ADDRESS 0xd0006d0d /end MEASUREMENT
/begin CHARACTERISTIC Ctp_tco_n_ini "Engine speed initialization depending on coolant temperature" CURVE 0xa002dbb4 _REC_A1CUR_20_u2_u2 16383.75 _CNV_A_R_ENSD_LINEA_22_CM 0. 16383.75 FORMAT "%8.2"
 /begin AXIS_DESCR COM_AXIS Vxx_tco _CNV_A_R_LINEAR_____110_CM 9 -40. 200. FORMAT "%5.1" AXIS_PTS_REF Ctb_tco2 /end AXIS_DESCR
/end CHARACTERISTIC
/begin MEASUREMENT Vbx_n_ini "initialization conditions" UBYTE _CNV_S_2_RANGE______3_CM 1 0. 0. 1. ECU_ADDRESS 0xd0006d0f BIT_MASK 0x1 /end MEASUREMENT
/begin MEASUREMENT Vsx_n_vld "Engine speed validity status" UBYTE _CNV_S_3_STATUS_OK__179_CM 1 0. 0. 2. ECU_ADDRESS 0xd0006d0e /end MEASUREMENT
/begin MEASUREMENT Vxx_n "Engine Speed" UWORD _CNV_A_R_ENSD_LINEA_22_CM 1 0. 0. 16383.75 ECU_ADDRESS 0xd000445e FORMAT "%8.2" /end MEASUREMENT
/begin MEASUREMENT Vxx_tdc_per "tdc period (32bits)" ULONG _CNV_A_R_LINEAR_____370_CM 1 0. 0. 1. ECU_ADDRESS 0xd000275c FORMAT "%9.7" /end MEASUREMENT
/begin CHARACTERISTIC Cxx_tdc_rev_nr "ratio of one complete revolution on one tdc duration" VALUE 0xa00216c4 _REC_S1VAL_20_u1 4. _CNV_A_R_LINEAR_____371_CM 0. 4. FORMAT "%6.4" /end CHARACTERISTIC
/begin MEASUREMENT Vxb_n2_mv.factor "" UWORD _CNV_A_R_A_105_CM 1 0. 0. 65535. ECU_ADDRESS 0xd0006cd2 /end MEASUREMENT
/begin MEASUREMENT Vxb_n2_mv.index "" UBYTE _CNV_A_R_A_105_CM 1 0. 0. 255. ECU_ADDRESS 0xd0006cd4 /end MEASUREMENT
/begin MEASUREMENT Vxb_n2_mv.num_dp "" UBYTE _CNV_A_R_A_105_CM 1 0. 0. 255. ECU_ADDRESS 0xd0006cd5 /end MEASUREMENT
/begin MEASUREMENT Vxb_n_mv.factor "" UWORD _CNV_A_R_A_105_CM 1 0. 0. 65535. ECU_ADDRESS 0xd0006cd6 /end MEASUREMENT
/begin MEASUREMENT Vxb_n_mv.index "" UBYTE _CNV_A_R_A_105_CM 1 0. 0. 255. ECU_ADDRESS 0xd0006cd8 /end MEASUREMENT
/begin MEASUREMENT Vxb_n_mv.num_dp "" UBYTE _CNV_A_R_A_105_CM 1 0. 0. 255. ECU_ADDRESS 0xd0006cd9 /end MEASUREMENT
/begin CHARACTERISTIC Ctp_gear_n_mv_ftc "filtering time constant for engine speed" CURVE 0xa002166c _REC_A1CUR_20_u1_u1 2.55 _CNV_A_R_LINEAR_____32_CM 0. 2.55 FORMAT "%4.2"
 /begin AXIS_DESCR COM_AXIS Vxx_gear _CNV_A_R_LINEAR_____145_CM 8 -1. 6. READ_ONLY FORMAT "%2.0" AXIS_PTS_REF Ntb_gear /end AXIS_DESCR
/end CHARACTERISTIC
/begin MEASUREMENT Vxx_n_mv "filtered engine speed" UWORD _CNV_A_R_ENSD_LINEA_22_CM 1 0. 0. 16383.75 ECU_ADDRESS 0xd000441c FORMAT "%8.2" /end MEASUREMENT
/begin MEASUREMENT Vxx_n_mv_raw "filtered engine speed" UWORD _CNV_A_R_ENSD_LINEA_22_CM 1 0. 0. 16383.75 ECU_ADDRESS 0xd000441e FORMAT "%8.2" /end MEASUREMENT
/begin MEASUREMENT Vbx_eng_syn "Engine synchronization" UBYTE _CNV_S_2_RANGE______3_CM 1 0. 0. 1. ECU_ADDRESS 0xd0006d11 BIT_MASK 0x1 /end MEASUREMENT
/begin MEASUREMENT Vxx_eng_angl "Angular position of engine" UWORD _CNV_A_R_LINEAR_____129_CM 1 0. 0. 719.98 ECU_ADDRESS 0xd0004460 FORMAT "%6.2" /end MEASUREMENT
/begin MEASUREMENT Vxx_tdc_ctr "TDC counter, indicates wich cylinder is active" UBYTE _CNV_A_R_LINEAR_____101_CM 1 0. 0. 3. ECU_ADDRESS 0xd0006d12 FORMAT "%1.0" /end MEASUREMENT
/begin MEASUREMENT Vxx_n_tdc_2 "Engine speed tdc i-2" UWORD _CNV_A_R_ENSD_LINEA_22_CM 1 0. 0. 16383.75 ECU_ADDRESS 0xd0004458 FORMAT "%8.2" /end MEASUREMENT
/begin MEASUREMENT Vxx_n_tdc_4 "Engine speed tdc i-4" UWORD _CNV_A_R_ENSD_LINEA_22_CM 1 0. 0. 16383.75 ECU_ADDRESS 0xd000445a FORMAT "%8.2" /end MEASUREMENT
/begin MEASUREMENT Vbx_in_vvt_cfm "Boolean indicating that intake VVT strategies must be activated" UBYTE _CNV_S_2_RANGE______3_CM 1 0. 0. 1. ECU_ADDRESS 0xd0007c12 BIT_MASK 0x1 /end MEASUREMENT
/begin CHARACTERISTIC Cbx_in_vvtc_abst_pres_cfm "Boolean indicating that intake VVTC strategies must be enabled (in configuration Nxx_in_vvtc_cho)" VALUE 0xa00216c3 _REC_S1VAL_20_u1 1. _CNV_S_2_RANGE______3_CM 0. 1. BIT_MASK 0x1 /end CHARACTERISTIC
/begin MEASUREMENT Vxx_mv_n_drv "derivate of engine speed after moving average" SWORD _CNV_A_R_LINEAR_____21_CM 1 0. -8192. 8191. ECU_ADDRESS 0xd0004410 FORMAT "%5.0" /end MEASUREMENT
/begin MEASUREMENT Vxx_n_drv "derivate of engine speed" SWORD _CNV_A_R_LINEAR_____21_CM 1 0. -8192. 8191. ECU_ADDRESS 0xd0004412 FORMAT "%5.0" /end MEASUREMENT
/begin MEASUREMENT Vxx_raw_n_drv "raw derivate of engine speed" SWORD _CNV_A_R_LINEAR_____21_CM 1 0. -8192. 8191. ECU_ADDRESS 0xd0004414 FORMAT "%5.0" /end MEASUREMENT
/begin CHARACTERISTIC Cxx_n_drv_fil_fac "first order filter factor for engine speed derivate" VALUE 0xa0021668 _REC_S1VAL_20_u2 1. _CNV_A_R_LINEAR_____143_CM 0. 1. FORMAT "%11.9" /end CHARACTERISTIC
/begin MEASUREMENT Vbx_trz_clc_ena "TLZ/TRZ calculation enabled." UBYTE _CNV_S_2_RANGE______3_CM 1 0. 0. 1. ECU_ADDRESS 0xd0006d13 BIT_MASK 0x1 /end MEASUREMENT
/begin MEASUREMENT Vxx_trz_t_toth_0 "Duration of 30° Crk package" ULONG _CNV_A_R_LINEAR_____372_CM 1 0. 0. 52428800. ECU_ADDRESS 0xd0002760 FORMAT "%8.0" /end MEASUREMENT
/begin MEASUREMENT Vxx_trz_t_toth_0_nxt "Duration of 30° Crk package ( Vxx_trz_t_toth_0_nxt (i) = Vxx_trz_t_toth_0 (i+1) )" ULONG _CNV_A_R_LINEAR_____372_CM 1 0. 0. 52428800. ECU_ADDRESS 0xd0002764 FORMAT "%8.0" /end MEASUREMENT
/begin MEASUREMENT Vxx_trz_t_toth_1 "Duration of 30° Crk package" ULONG _CNV_A_R_LINEAR_____372_CM 1 0. 0. 52428800. ECU_ADDRESS 0xd0002768 FORMAT "%8.0" /end MEASUREMENT
/begin MEASUREMENT Vxx_trz_t_toth_2 "Duration of 30° Crk package" ULONG _CNV_A_R_LINEAR_____372_CM 1 0. 0. 52428800. ECU_ADDRESS 0xd000276c FORMAT "%8.0" /end MEASUREMENT
/begin MEASUREMENT Vxx_trz_t_toth_3 "Duration of 30° Crk package" ULONG _CNV_A_R_LINEAR_____372_CM 1 0. 0. 52428800. ECU_ADDRESS 0xd0002770 FORMAT "%8.0" /end MEASUREMENT
/begin MEASUREMENT Vxx_trz_t_toth_4 "Duration of 30° Crk package" ULONG _CNV_A_R_LINEAR_____372_CM 1 0. 0. 52428800. ECU_ADDRESS 0xd0002774 FORMAT "%8.0" /end MEASUREMENT
/begin MEASUREMENT Vxx_trz_t_toth_5 "Duration of 30° Crk package" ULONG _CNV_A_R_LINEAR_____372_CM 1 0. 0. 52428800. ECU_ADDRESS 0xd0002778 FORMAT "%8.0" /end MEASUREMENT
/begin MEASUREMENT Vxx_trz_t_toth_5_prev "Duration of 30° Crk package ( Vxx_trz_t_toth_5_prev (i) = Vxx_trz_t_toth_5 (i-1) )" ULONG _CNV_A_R_LINEAR_____372_CM 1 0. 0. 52428800. ECU_ADDRESS 0xd000277c FORMAT "%8.0" /end MEASUREMENT
/begin MEASUREMENT Vsx_pws_sens_ac_prs_vld "Power supply of air cooling pressure sensor validity status" UBYTE _CNV_S_3_STATUS_OK__213_CM 1 0. 0. 2. ECU_ADDRESS 0xd0006297 /end MEASUREMENT
/begin MEASUREMENT Vsx_pws_sens_acel_pdl_v1_vld "Power supply of accelerator pedal track 1 validity status" UBYTE _CNV_S_3_STATUS_OK__213_CM 1 0. 0. 2. ECU_ADDRESS 0xd0006298 /end MEASUREMENT
/begin MEASUREMENT Vsx_pws_sens_acel_pdl_v2_vld "Power supply of accelerator pedal track 2 validity status" UBYTE _CNV_S_3_STATUS_OK__213_CM 1 0. 0. 2. ECU_ADDRESS 0xd0006299 /end MEASUREMENT
/begin MEASUREMENT Vsx_pws_sens_it_vld "Powerstage of the Inlet throttle sensor validity status." UBYTE _CNV_S_3_STATUS_OK__213_CM 1 0. 0. 2. ECU_ADDRESS 0xd000629a /end MEASUREMENT
/begin MEASUREMENT Vsx_pws_sens_lbdw_vld "Power supply of lambda down sensor validity status" UBYTE _CNV_S_3_STATUS_OK__213_CM 1 0. 0. 2. ECU_ADDRESS 0xd000629b /end MEASUREMENT
/begin MEASUREMENT Vsx_pws_sens_lbup_vld "Power supply of upstream sensor validity status" UBYTE _CNV_S_3_STATUS_OK__213_CM 1 0. 0. 2. ECU_ADDRESS 0xd000629c /end MEASUREMENT
/begin MEASUREMENT Vsx_pws_sens_map_vld "Power supply of manifold pressure validity status" UBYTE _CNV_S_3_STATUS_OK__213_CM 1 0. 0. 2. ECU_ADDRESS 0xd000629d /end MEASUREMENT
/begin MEASUREMENT Vsx_pws_sens_rvac_vld "Power supply of tank pressure validity status" UBYTE _CNV_S_3_STATUS_OK__179_CM 1 0. 0. 2. ECU_ADDRESS 0xd000629e /end MEASUREMENT
/begin MEASUREMENT Vsx_pws_sens_spg_vld "Power supply of supercharging pressure validity status" UBYTE _CNV_S_3_STATUS_OK__213_CM 1 0. 0. 2. ECU_ADDRESS 0xd000629f /end MEASUREMENT
/begin MEASUREMENT Vxx_pws_sens_it "Sensors power supply voltage raw acquisition" UWORD _CNV_A_R_LINEAR_____107_CM 1 0. 0. 25000. ECU_ADDRESS 0xd0003cd8 FORMAT "%5.0" /end MEASUREMENT
/begin MEASUREMENT Vsx_pws_1_vld "Power supply 1 validity status" UBYTE _CNV_S_3_STATUS_OK__213_CM 1 0. 0. 2. ECU_ADDRESS 0xd000760a /end MEASUREMENT
/begin MEASUREMENT Vsx_pws_2_vld "Power supply 2 validity status" UBYTE _CNV_S_3_STATUS_OK__213_CM 1 0. 0. 2. ECU_ADDRESS 0xd000760b /end MEASUREMENT
/begin MEASUREMENT Vxx_pws_1 "Sensors power supply 1 voltage raw acquisition" UWORD _CNV_A_R_LINEAR_____107_CM 1 0. 0. 25000. ECU_ADDRESS 0xd0003cda FORMAT "%5.0" /end MEASUREMENT
/begin MEASUREMENT Vxx_pws_2 "Sensors power supply 2 voltage raw acquisition" UWORD _CNV_A_R_LINEAR_____107_CM 1 0. 0. 25000. ECU_ADDRESS 0xd0003cdc FORMAT "%5.0" /end MEASUREMENT
/begin CHARACTERISTIC Cxx_dfdec_pws_1_h "Power supply 1 voltage above max threshold detected failure counter decrement" VALUE 0xa00207e0 _REC_S1VAL_20_u2 65535. _CNV_A_R_ECME_LINEA_0_CM 0. 65535. FORMAT "%5.0" /end CHARACTERISTIC
/begin CHARACTERISTIC Cxx_dfdec_pws_1_l "Power supply 1 voltage below min threshold detected failure counter decrement" VALUE 0xa00207e2 _REC_S1VAL_20_u2 65535. _CNV_A_R_ECME_LINEA_0_CM 0. 65535. FORMAT "%5.0" /end CHARACTERISTIC
/begin CHARACTERISTIC Cxx_dfdec_pws_2_h "Power supply 2 voltage above max threshold detected failure counter decrement" VALUE 0xa00207e4 _REC_S1VAL_20_u2 65535. _CNV_A_R_ECME_LINEA_0_CM 0. 65535. FORMAT "%5.0" /end CHARACTERISTIC
/begin CHARACTERISTIC Cxx_dfdec_pws_2_l "Power supply 2 voltage below min threshold detected failure counter decrement" VALUE 0xa00207e6 _REC_S1VAL_20_u2 65535. _CNV_A_R_ECME_LINEA_0_CM 0. 65535. FORMAT "%5.0" /end CHARACTERISTIC
/begin CHARACTERISTIC Cxx_dfinc_pws_1_h "Power supply 1 voltage above max threshold detected failure counter increment" VALUE 0xa00207e8 _REC_S1VAL_20_u2 65535. _CNV_A_R_ECME_LINEA_0_CM 0. 65535. FORMAT "%5.0" /end CHARACTERISTIC
/begin CHARACTERISTIC Cxx_dfinc_pws_1_l "Power supply 1 voltage below min threshold detected failure counter increment" VALUE 0xa00207ea _REC_S1VAL_20_u2 65535. _CNV_A_R_ECME_LINEA_0_CM 0. 65535. FORMAT "%5.0" /end CHARACTERISTIC
/begin CHARACTERISTIC Cxx_dfinc_pws_2_h "Power supply 2 voltage above max threshold detected failure counter increment" VALUE 0xa00207ec _REC_S1VAL_20_u2 65535. _CNV_A_R_ECME_LINEA_0_CM 0. 65535. FORMAT "%5.0" /end CHARACTERISTIC
/begin CHARACTERISTIC Cxx_dfinc_pws_2_l "Power supply 2 voltage below min threshold detected failure counter increment" VALUE 0xa00207ee _REC_S1VAL_20_u2 65535. _CNV_A_R_ECME_LINEA_0_CM 0. 65535. FORMAT "%5.0" /end CHARACTERISTIC
/begin MEASUREMENT Vbx_clu_stal_ini "Boolean for clutch engine stalling detection to the initialization" UBYTE _CNV_S_2_RANGE______3_CM 1 0. 0. 1. ECU_ADDRESS 0xd000712c BIT_MASK 0x1 /end MEASUREMENT
/begin MEASUREMENT Vbx_igk_stal_eng_n_thd "Boolean for the reset of clutch engine stalling and software lock conditions" UBYTE _CNV_S_2_RANGE______3_CM 1 0. 0. 1. ECU_ADDRESS 0xd000712d BIT_MASK 0x1 /end MEASUREMENT
/begin MEASUREMENT Vbx_sta_stal "Boolean for no starting engine stalling detection" UBYTE _CNV_S_2_RANGE______3_CM 1 0. 0. 1. ECU_ADDRESS 0xd000712e BIT_MASK 0x1 /end MEASUREMENT
/begin MEASUREMENT Vbx_swlk_stal_ini "Boolean for no starting software lock engine stalling detection to the initialization" UBYTE _CNV_S_2_RANGE______3_CM 1 0. 0. 1. ECU_ADDRESS 0xd000712f BIT_MASK 0x1 /end MEASUREMENT
/begin CHARACTERISTIC Cxx_igk_stal_eng_n_thd "Engine speed threshold for the reset of clutch engine stalling and software lock conditions" VALUE 0xa0021ea6 _REC_S1VAL_20_u2 16383.75 _CNV_A_R_ENSD_LINEA_22_CM 0. 16383.75 FORMAT "%8.2" /end CHARACTERISTIC
/begin CHARACTERISTIC Cxx_set_stal_dly "Initialization value of the delay used to detect the engine stalled condition" VALUE 0xa0021ea8 _REC_S1VAL_20_u1 2.55 _CNV_A_R_LINEAR_____32_CM 0. 2.55 FORMAT "%4.2" /end CHARACTERISTIC
/begin CHARACTERISTIC Cxx_stal_det_swlk_dly "Delay before we declare the stalled state due to the software lock" VALUE 0xa0021ea9 _REC_S1VAL_20_u1 2.55 _CNV_A_R_LINEAR_____32_CM 0. 2.55 FORMAT "%4.2" /end CHARACTERISTIC
/begin MEASUREMENT Vbx_rest_pwl_rtn "Power-latch retain for restart" UBYTE _CNV_S_2_RANGE______3_CM 1 0. 0. 1. ECU_ADDRESS 0xd0007609 BIT_MASK 0x1 /end MEASUREMENT
/begin MEASUREMENT Vsx_pws_3_vld "Power supply 3 validity status" UBYTE _CNV_S_3_STATUS_OK__179_CM 1 0. 0. 2. ECU_ADDRESS 0xd0006296 /end MEASUREMENT
/begin MEASUREMENT Vxx_pws_3 "Sensors power supply 3 voltage raw acquisition." UWORD _CNV_A_R_LINEAR_____107_CM 1 0. 0. 25000. ECU_ADDRESS 0xd0003cd6 FORMAT "%5.0" /end MEASUREMENT
/begin CHARACTERISTIC Cxx_dfdec_pws_3_h "Power supply 3 voltage above max threshold detected failure counter decrement" VALUE 0xa00207d8 _REC_S1VAL_20_u2 65535. _CNV_A_R_ECME_LINEA_0_CM 0. 65535. FORMAT "%5.0" /end CHARACTERISTIC
/begin CHARACTERISTIC Cxx_dfdec_pws_3_l "Power supply 3 voltage below min threshold detected failure counter decrement" VALUE 0xa00207da _REC_S1VAL_20_u2 65535. _CNV_A_R_ECME_LINEA_0_CM 0. 65535. FORMAT "%5.0" /end CHARACTERISTIC
/begin CHARACTERISTIC Cxx_dfinc_pws_3_h "Power supply 3 voltage above max threshold detected failure counter increment" VALUE 0xa00207dc _REC_S1VAL_20_u2 65535. _CNV_A_R_ECME_LINEA_0_CM 0. 65535. FORMAT "%5.0" /end CHARACTERISTIC
/begin CHARACTERISTIC Cxx_dfinc_pws_3_l "Power supply 3 voltage below min threshold detected failure counter increment" VALUE 0xa00207de _REC_S1VAL_20_u2 65535. _CNV_A_R_ECME_LINEA_0_CM 0. 65535. FORMAT "%5.0" /end CHARACTERISTIC
/begin AXIS_PTS Ntb_gear "Gearbox ratio breakpoint" 0xa002da28 Vxx_gear _REC_A2AXS_20_u1 7. _CNV_A_R_LINEAR_____145_CM 8 -1. 6. READ_ONLY FORMAT "%2.0" /end AXIS_PTS
/begin MEASUREMENT Vsx_vh_eng "CAN output data indicating the engine states" UBYTE _CNV_A_R_ECME_LINEA_0_CM 1 0. 0. 255. ECU_ADDRESS 0xd0007125 FORMAT "%3.0" /end MEASUREMENT
/begin CHARACTERISTIC Cxx_ini_stop_dly "Inhibition delay of the judgement of the engine stop state" VALUE 0xa0021ea4 _REC_S1VAL_20_u2 655.35 _CNV_A_R_LINEAR_____32_CM 0. 655.35 FORMAT "%6.2" /end CHARACTERISTIC
/begin CHARACTERISTIC Ctp_eng_diag_spg_dly "The engine speed delay to enable diagnosis" CURVE 0xa0024b24 _REC_A1CUR_20_u2_u2 655.35 _CNV_A_R_LINEAR_____32_CM 0. 655.35 FORMAT "%6.2"
 /begin AXIS_DESCR COM_AXIS Vxx_n _CNV_A_R_ENSD_LINEA_22_CM 9 0. 16383.75 FORMAT "%8.2" AXIS_PTS_REF Ctb_n2 /end AXIS_DESCR
/end CHARACTERISTIC
/begin MEASUREMENT Vbx_df_spg_reg_apl_down "Negative deviation of the turbocharger detected failure" UBYTE _CNV_S_2_RANGE______3_CM 1 0. 0. 1. ECU_ADDRESS 0xd000771c BIT_MASK 0x1 /end MEASUREMENT
/begin MEASUREMENT Vbx_df_spg_reg_apl_up "Positive deviation of the turbocharger detected failure" UBYTE _CNV_S_2_RANGE______3_CM 1 0. 0. 1. ECU_ADDRESS 0xd000771d BIT_MASK 0x1 /end MEASUREMENT
/begin MEASUREMENT Vbx_spg_dev_int_rst "Reset flag for the criteria calculation" UBYTE _CNV_S_2_RANGE______3_CM 1 0. 0. 1. ECU_ADDRESS 0xd000771e BIT_MASK 0x1 /end MEASUREMENT
/begin MEASUREMENT Vbx_spg_diag_int_cdn "Engine conditions allowing the continuous diagnosis of the turbocharger" UBYTE _CNV_S_2_RANGE______3_CM 1 0. 0. 1. ECU_ADDRESS 0xd000771f BIT_MASK 0x1 /end MEASUREMENT
/begin MEASUREMENT Vbx_spg_prs_dly "Flag for the engine speed delay" UBYTE _CNV_S_2_RANGE______3_CM 1 0. 0. 1. ECU_ADDRESS 0xd0006489 BIT_MASK 0x1 /end MEASUREMENT
/begin MEASUREMENT Vbx_spg_prs_err_sgn "Governor error sign : 1=positive deviation 0=negative deviation" UBYTE _CNV_S_2_RANGE______3_CM 1 0. 0. 1. ECU_ADDRESS 0xd0007720 BIT_MASK 0x1 /end MEASUREMENT
/begin MEASUREMENT Vbx_spg_prs_init "Flag for the init delay" UBYTE _CNV_S_2_RANGE______3_CM 1 0. 0. 1. ECU_ADDRESS 0xd000648a BIT_MASK 0x1 /end MEASUREMENT
/begin MEASUREMENT Vbx_spg_prs_sp_min "Flag for minimum boost pressure set point acquiered" UBYTE _CNV_S_2_RANGE______3_CM 1 0. 0. 1. ECU_ADDRESS 0xd0007721 BIT_MASK 0x1 /end MEASUREMENT
/begin MEASUREMENT Vbx_spg_reg_apl_down "Turbocharger negative deviation sample flag" UBYTE _CNV_S_2_RANGE______3_CM 1 0. 0. 1. ECU_ADDRESS 0xd0007722 BIT_MASK 0x1 /end MEASUREMENT
/begin MEASUREMENT Vbx_spg_reg_apl_up "Turbocharger positive deviation sample flag" UBYTE _CNV_S_2_RANGE______3_CM 1 0. 0. 1. ECU_ADDRESS 0xd0007723 BIT_MASK 0x1 /end MEASUREMENT
/begin MEASUREMENT Vsx_spg_reg_vld "Boost pressure regulation validity criteria" UBYTE _CNV_S_3_STATUS_OK__179_CM 1 0. 0. 2. ECU_ADDRESS 0xd000648b /end MEASUREMENT
/begin MEASUREMENT Vxx_dt1_exp "" UWORD _CNV_A_R_LINEAR_____487_CM 1 0. 0. 9. ECU_ADDRESS 0xd0004fd8 FORMAT "%5.4" /end MEASUREMENT
/begin MEASUREMENT Vxx_spg_dev_int "Integrated criteria raw value" ULONG _CNV_A_R_LINEAR_____488_CM 1 0. 0. 10000. ECU_ADDRESS 0xd0003490 FORMAT "%7.1" /end MEASUREMENT
/begin MEASUREMENT Vxx_spg_int_in "Value of the integrator input" UWORD _CNV_A_R_LINEAR_____115_CM 1 0. 0. 10000. ECU_ADDRESS 0xd0004fda FORMAT "%5.0" /end MEASUREMENT
/begin MEASUREMENT Vxx_spg_prs_dly "Engine speed delay to enable diagnosis" UWORD _CNV_A_R_LINEAR_____32_CM 1 0. 0. 655.35 ECU_ADDRESS 0xd0003dd0 FORMAT "%6.2" /end MEASUREMENT
/begin MEASUREMENT Vxx_spg_prs_sp_dt1 "Derivative value of the filtered pressure set point" SWORD _CNV_A_R_LINEAR_____489_CM 1 0. -10000. 10000. ECU_ADDRESS 0xd0004fdc FORMAT "%6.0" /end MEASUREMENT
/begin MEASUREMENT Vxx_spg_prs_sp_fil "Filtered boost pressure set point" UWORD _CNV_A_R_LINEAR_____115_CM 1 0. 0. 20000. ECU_ADDRESS 0xd0004fde FORMAT "%5.0" /end MEASUREMENT
/begin MEASUREMENT Vxx_spg_reg_apl_down "Negative deviation diagnostic criteria" ULONG _CNV_A_R_LINEAR_____488_CM 1 0. 0. 10000. ECU_ADDRESS 0xd0003494 FORMAT "%7.1" /end MEASUREMENT
/begin MEASUREMENT Vxx_spg_reg_apl_up "Positive deviation diagnostic criteria" ULONG _CNV_A_R_LINEAR_____488_CM 1 0. 0. 10000. ECU_ADDRESS 0xd0003498 FORMAT "%7.1" /end MEASUREMENT
/begin CHARACTERISTIC Cbx_run_eng_ena_inhi "Boolean enabling boost pressure diagnostic during engine stop requests" VALUE 0xa0020c06 _REC_S1VAL_20_u1 1. _CNV_A_R_ECME_LINEA_0_CM 0. 1. FORMAT "%1.0" BIT_MASK 0x1 /end CHARACTERISTIC
/begin CHARACTERISTIC Cbx_spg_prs_sp_min "Boolean which disables minimum pressure setpoint threshold depending on altitude" VALUE 0xa0020c07 _REC_S1VAL_20_u1 1. _CNV_A_R_ECME_LINEA_0_CM 0. 1. FORMAT "%1.0" BIT_MASK 0x1 /end CHARACTERISTIC
/begin CHARACTERISTIC Cbx_spg_reg_fail_cfm "Boolean to choose if the Vsx_spg_reg_vld is in nok_0 or fail_2 when Vsx_amp_vld is in nok_0" VALUE 0xa0020c08 _REC_S1VAL_20_u1 1. _CNV_A_R_ECME_LINEA_0_CM 0. 1. FORMAT "%1.0" BIT_MASK 0x1 /end CHARACTERISTIC
/begin CHARACTERISTIC Cbx_up_thr_prs_sens "Boolean which indicate if the engine has a pressure sensor before the inlet throttle" VALUE 0xa0020c09 _REC_S1VAL_20_u1 1. _CNV_A_R_ECME_LINEA_0_CM 0. 1. FORMAT "%1.0" BIT_MASK 0x1 /end CHARACTERISTIC
/begin CHARACTERISTIC Cxx_dfdec_spg_reg_apl_down "Turbocharger negative deviation detected failure counter decrement" VALUE 0xa0020be6 _REC_S1VAL_20_u2 65535. _CNV_A_R_ECME_LINEA_0_CM 0. 65535. FORMAT "%5.0" /end CHARACTERISTIC
/begin CHARACTERISTIC Cxx_dfdec_spg_reg_apl_up "Turbocharger positive deviation detected failure counter decrement" VALUE 0xa0020be8 _REC_S1VAL_20_u2 65535. _CNV_A_R_ECME_LINEA_0_CM 0. 65535. FORMAT "%5.0" /end CHARACTERISTIC
/begin CHARACTERISTIC Cxx_dfinc_spg_reg_apl_down "Turbocharger negative deviation detected failure counter increment" VALUE 0xa0020bea _REC_S1VAL_20_u2 65535. _CNV_A_R_ECME_LINEA_0_CM 0. 65535. FORMAT "%5.0" /end CHARACTERISTIC
/begin CHARACTERISTIC Cxx_dfinc_spg_reg_apl_up "Turbocharger positive deviation detected failure counter increment" VALUE 0xa0020bec _REC_S1VAL_20_u2 65535. _CNV_A_R_ECME_LINEA_0_CM 0. 65535. FORMAT "%5.0" /end CHARACTERISTIC
/begin CHARACTERISTIC Cxx_spg_n_thd_max "Maximum engine speed to allow continuous diagnosis" VALUE 0xa0020bee _REC_S1VAL_20_u2 16383.75 _CNV_A_R_ENSD_LINEA_22_CM 0. 16383.75 FORMAT "%8.2" /end CHARACTERISTIC
/begin CHARACTERISTIC Cxx_spg_n_thd_min "Minimum engine speed to allow continuous diagnosis" VALUE 0xa0020bf0 _REC_S1VAL_20_u2 16383.75 _CNV_A_R_ENSD_LINEA_22_CM 0. 16383.75 FORMAT "%8.2" /end CHARACTERISTIC
/begin CHARACTERISTIC Cxx_spg_prs_err_min "Minimum boost air pressure governor error to take into account the diagnosis criteria" VALUE 0xa0020bf2 _REC_S1VAL_20_s2 1000. _CNV_A_R_LINEAR_____115_CM -500. 500. FORMAT "%6.0" /end CHARACTERISTIC
/begin CHARACTERISTIC Cxx_spg_prs_sp_dev_max "Maximum pressure set point deviation allowed to enable the continuous diagnosis of the turbocharger" VALUE 0xa0020bf4 _REC_S1VAL_20_u2 10000. _CNV_A_R_LINEAR_____173_CM 0. 10000. FORMAT "%5.0" /end CHARACTERISTIC
/begin CHARACTERISTIC Cxx_spg_prs_sp_dev_min "Minimum pressure set point deviation allowed to init the enable diagnosis delay" VALUE 0xa0020bf6 _REC_S1VAL_20_s2 20000. _CNV_A_R_LINEAR_____489_CM -10000. 10000. FORMAT "%6.0" /end CHARACTERISTIC
/begin CHARACTERISTIC Cxx_spg_prs_sp_dt1_fac "DT1 gain for filtered boost air pressure set point" VALUE 0xa0020bf8 _REC_S1VAL_20_u2 50. _CNV_A_R_LINEAR_____413_CM 0. 50. FORMAT "%5.2" /end CHARACTERISTIC
/begin CHARACTERISTIC Cxx_spg_prs_sp_dt1_t "DT1 time constant for filtered boost air pressure" VALUE 0xa0020bfa _REC_S1VAL_20_u2 65.535 _CNV_A_R_LINEAR_____116_CM 0. 65.535 /end CHARACTERISTIC
/begin CHARACTERISTIC Cxx_spg_prs_sp_min "Minimum boost air pressure set point (Cbx_spg_prs_sp_min=1) or atmospheric pressure additive threshold (Cbx_spg_prs_sp_min=0)" VALUE 0xa0020bfc _REC_S1VAL_20_u2 4000. _CNV_A_R_LINEAR_____115_CM 0. 4000. FORMAT "%5.0" /end CHARACTERISTIC
/begin CHARACTERISTIC Cxx_spg_prs_sp_t_fil "Time constant of boost air pressure first order filter" VALUE 0xa0020bfe _REC_S1VAL_20_u2 65.535 _CNV_A_R_LINEAR_____116_CM 0. 65.535 /end CHARACTERISTIC
/begin CHARACTERISTIC Cxx_spg_reg_apl_down_thd "Threshold of negative deviation of the turbocharger" VALUE 0xa0020c00 _REC_S1VAL_20_u2 10000. _CNV_A_R_LINEAR_____490_CM 0. 10000. FORMAT "%5.0" /end CHARACTERISTIC
/begin CHARACTERISTIC Cxx_spg_reg_apl_up_thd "Threshold of positive deviation of the turbocharger" VALUE 0xa0020c02 _REC_S1VAL_20_u2 10000. _CNV_A_R_LINEAR_____490_CM 0. 10000. FORMAT "%5.0" /end CHARACTERISTIC
/begin CHARACTERISTIC Cxx_spg_sys_diag_dly "Intersystem setpoint time allowing the continuous diagnosis of the turbocharger" VALUE 0xa0020c04 _REC_S1VAL_20_u2 655.35 _CNV_A_R_LINEAR_____32_CM 0. 655.35 FORMAT "%6.2" /end CHARACTERISTIC
/begin CHARACTERISTIC Ctp_tco_ini_i_sta_alco "Initial torque value of Idle Speed regulator integral correction table in Start State for alcohol" CURVE 0xa0034564 _REC_A1CUR_20_u2_u2 2047.96875 _CNV_A_R_LINEAR_____185_CM -1024. 1023.96875 FORMAT "%11.5"
 /begin AXIS_DESCR COM_AXIS Vxx_tco _CNV_A_R_LINEAR_____110_CM 11 -40. 200. FORMAT "%5.1" AXIS_PTS_REF Ctb_sta_tco_alco /end AXIS_DESCR
/end CHARACTERISTIC
/begin MEASUREMENT Vxx_tco_ini_i_sta_alco "Initial torque value of Idle Speed regulator integral correction in Start State for alcohol" SWORD _CNV_A_R_LINEAR_____181_CM 1 0. -1024. 1023.96875 ECU_ADDRESS 0xd000487e FORMAT "%11.5" /end MEASUREMENT
/begin COMPU_METHOD _CNV_A_R_ECME_LINEA_0_CM "" RAT_FUNC "%6.3" "-" COEFFS 0 1. 0. 0 0 1 /end COMPU_METHOD
/begin COMPU_METHOD _CNV_A_R_LINEAR_____2_CM "" RAT_FUNC "%6.3" "rpm" COEFFS 0 3.125e-002 0. 0 0 1 /end COMPU_METHOD
/begin COMPU_METHOD _CNV_S_2_RANGE______3_CM "" TAB_VERB "%6.3" "-" COMPU_TAB_REF _CNV_S_2_RANGE______3 /end COMPU_METHOD
/begin COMPU_VTAB _CNV_S_2_RANGE______3 "" TAB_VERB 2 0 "0" 1 "1" /end COMPU_VTAB
/begin COMPU_METHOD _CNV_A_R_LINEAR_____14_CM "" RAT_FUNC "%6.3" "V" COEFFS 0 6553.599999999993 0. 0 0 1 /end COMPU_METHOD
/begin COMPU_METHOD _CNV_A_R_LINEAR_____21_CM "" RAT_FUNC "%6.3" "rpm/s" COEFFS 0 1. 0. 0 0 1 /end COMPU_METHOD
/begin COMPU_METHOD _CNV_A_R_ENSD_LINEA_22_CM "" RAT_FUNC "%6.3" "rpm" COEFFS 0 4. 0. 0 0 1 /end COMPU_METHOD
/begin COMPU_METHOD _CNV_A_R_LINEAR_____23_CM "" RAT_FUNC "%6.3" "°CRK" COEFFS 0 2.666666666666667 0. 0 0 1 /end COMPU_METHOD
/begin COMPU_METHOD _CNV_A_R_LINEAR_____29_CM "" RAT_FUNC "%6.3" "-" COEFFS 0 256. 0. 0 0 1 /end COMPU_METHOD
/begin COMPU_METHOD _CNV_A_R_LINEAR_____32_CM "" RAT_FUNC "%6.3" "s" COEFFS 0 100. 0. 0 0 1 /end COMPU_METHOD
/begin COMPU_METHOD _CNV_A_R_LINEAR_____40_CM "" RAT_FUNC "%6.3" "V" COEFFS 0 9.846153846153847 0. 0 0 1 /end COMPU_METHOD
/begin COMPU_METHOD _CNV_A_R_LINEAR_____41_CM "" RAT_FUNC "%6.3" "°C" COEFFS 0 1.333333333333333 64. 0 0 1 /end COMPU_METHOD
/begin COMPU_METHOD _CNV_A_R_IGRE_LINEA_47_CM "" RAT_FUNC "%6.3" "°CRK" COEFFS 0 2.666666666666667 63. 0 0 1 /end COMPU_METHOD
/begin COMPU_METHOD _CNV_A_R_LINEAR_____58_CM "" RAT_FUNC "%6.3" "s" COEFFS 0 10. 0. 0 0 1 /end COMPU_METHOD
/begin COMPU_METHOD _CNV_S_16_RANGE_ERR__62_CM "" TAB_VERB "%6.3" "-" COMPU_TAB_REF _CNV_S_16_RANGE_ERR__62 /end COMPU_METHOD
/begin COMPU_VTAB _CNV_S_16_RANGE_ERR__62 "" TAB_VERB 16 0 "NO_SYM" 1 "SYM_0" 2 "SYM_1" 3 "SYM_0, SYM_1" 4 "SYM_2" 5 "SYM_0, SYM_2" 6 "SYM_1, SYM_2" 7 "SYM_0, SYM_1, SYM_2" 8 "SYM_3" 9 "SYM_0, SYM_3" 10 "SYM_1, SYM_3" 11 "SYM_0, SYM_1,SYM_3" 12 "SYM_2, SYM_3" 13 "SYM_0, SYM_2, SYM_3" 14 "SYM_1, SYM_2, SYM_3" 15 "SYM_0, SYM_1, SYM_2, SYM_3" /end COMPU_VTAB
/begin COMPU_METHOD _CNV_A_R_LINEAR_____68_CM "" RAT_FUNC "%6.3" "s" COEFFS 0 1. 0. 0 0 1 /end COMPU_METHOD
/begin COMPU_METHOD _CNV_A_R_LINEAR_____80_CM "" RAT_FUNC "%6.3" "mg/stk" COEFFS 0 47.18142548596112 0. 0 0 1 /end COMPU_METHOD
/begin COMPU_METHOD _CNV_A_R_LINEAR_____100_CM "" RAT_FUNC "%6.3" "-" COEFFS 0 98303.99999999926 -65535.99344639951 0 0 1 /end COMPU_METHOD
/begin COMPU_METHOD _CNV_A_R_LINEAR_____101_CM "" RAT_FUNC "%6.3" "TDC" COEFFS 0 1. 0. 0 0 1 /end COMPU_METHOD
/begin COMPU_METHOD _CNV_A_R_LINEAR_____102_CM "" RAT_FUNC "%6.3" "µs" COEFFS 0 0.25 0. 0 0 1 /end COMPU_METHOD
/begin COMPU_METHOD _CNV_A_R_A_105_CM "" RAT_FUNC "%6.3" "" COEFFS 0 1. 0. 0 0 1 /end COMPU_METHOD
/begin COMPU_METHOD _CNV_A_R_LINEAR_____107_CM "" RAT_FUNC "%6.3" "mV" COEFFS 0 1. 0. 0 0 1 /end COMPU_METHOD
/begin COMPU_METHOD _CNV_A_R_LINEAR_____110_CM "" RAT_FUNC "%6.3" "°C" COEFFS 0 10. 400. 0 0 1 /end COMPU_METHOD
/begin COMPU_METHOD _CNV_A_R_LINEAR_____115_CM "" RAT_FUNC "%6.3" "hPa" COEFFS 0 1. 0. 0 0 1 /end COMPU_METHOD
/begin COMPU_METHOD _CNV_A_R_LINEAR_____116_CM "" RAT_FUNC "%6.3" "s" COEFFS 0 1000. 0. 0 0 1 /end COMPU_METHOD
/begin COMPU_METHOD _CNV_A_R_LINEAR_____123_CM "" RAT_FUNC "%6.3" "-" COEFFS 0 100. 0. 0 0 1 /end COMPU_METHOD
/begin COMPU_METHOD _CNV_A_R_LINEAR_____125_CM "" RAT_FUNC "%6.3" "km/h" COEFFS 0 100. 0. 0 0 1 /end COMPU_METHOD
/begin COMPU_METHOD _CNV_A_R_LINEAR_____129_CM "" RAT_FUNC "%6.3" "°CRK" COEFFS 0 50. 0. 0 0 1 /end COMPU_METHOD
/begin COMPU_METHOD _CNV_A_R_LINEAR_____143_CM "" RAT_FUNC "%6.3" "-" COEFFS 0 65535. 0. 0 0 1 /end COMPU_METHOD
/begin COMPU_METHOD _CNV_A_R_LINEAR_____145_CM "" RAT_FUNC "%6.3" "-" COEFFS 0 1. 1. 0 0 1 /end COMPU_METHOD
/begin COMPU_METHOD _CNV_A_R_LINEAR_____159_CM "" RAT_FUNC "%6.3" "%" COEFFS 0 655.35 0. 0 0 1 /end COMPU_METHOD
/begin COMPU_METHOD _CNV_A_R_LINEAR_____161_CM "" RAT_FUNC "%6.3" "-" COEFFS 0 1000. 0. 0 0 1 /end COMPU_METHOD
/begin COMPU_METHOD _CNV_A_R_LINEAR_____162_CM "" RAT_FUNC "%6.3" "-" COEFFS 0 255. 0. 0 0 1 /end COMPU_METHOD
/begin COMPU_METHOD _CNV_A_R_LINEAR_____165_CM "" RAT_FUNC "%6.3" "%" COEFFS 0 2.55 0. 0 0 1 /end COMPU_METHOD
/begin COMPU_METHOD _CNV_A_R_LINEAR_____170_CM "" RAT_FUNC "%6.3" "-" COEFFS 0 16384. -8192. 0 0 1 /end COMPU_METHOD
/begin COMPU_METHOD _CNV_A_R_LINEAR_____172_CM "" RAT_FUNC "%6.3" "kg/h" COEFFS 0 20. 0. 0 0 1 /end COMPU_METHOD
/begin COMPU_METHOD _CNV_A_R_LINEAR_____173_CM "" RAT_FUNC "%6.3" "hPa/s" COEFFS 0 0.1 0. 0 0 1 /end COMPU_METHOD
/begin COMPU_METHOD _CNV_A_R_LINEAR_____178_CM "" RAT_FUNC "%6.3" "hpa/(kg/h)²" COEFFS 0 100000. 0. 0 0 1 /end COMPU_METHOD
/begin COMPU_METHOD _CNV_S_3_STATUS_OK__179_CM "" TAB_VERB "%6.3" "-" COMPU_TAB_REF _CNV_S_3_STATUS_OK__179 /end COMPU_METHOD
/begin COMPU_VTAB _CNV_S_3_STATUS_OK__179 "" TAB_VERB 3 0 "Nsx_vld_nok_0" 1 "Nsx_vld_ok_1" 2 "Nsx_vld_fail_2" /end COMPU_VTAB
/begin COMPU_METHOD _CNV_S_4_STATUS_OK__180_CM "" TAB_VERB "%6.3" "-" COMPU_TAB_REF _CNV_S_4_STATUS_OK__180 /end COMPU_METHOD
/begin COMPU_VTAB _CNV_S_4_STATUS_OK__180 "" TAB_VERB 4 0 "Nsx_vld_nok_0" 1 "Nsx_vld_ok_1" 2 "Nsx_vld_fail_2" 3 "Nsx_vld_fail_3" /end COMPU_VTAB
/begin COMPU_METHOD _CNV_A_R_LINEAR_____181_CM "" RAT_FUNC "%6.3" "Nm" COEFFS 0 32. 0. 0 0 1 /end COMPU_METHOD
/begin COMPU_METHOD _CNV_A_R_LINEAR_____182_CM "" RAT_FUNC "%6.3" "rpm" COEFFS 0 4. 32768. 0 0 1 /end COMPU_METHOD
/begin COMPU_METHOD _CNV_A_R_LINEAR_____183_CM "" RAT_FUNC "%6.3" "-" COEFFS 0 1024. 0. 0 0 1 /end COMPU_METHOD
/begin COMPU_METHOD _CNV_A_R_LINEAR_____184_CM "" RAT_FUNC "%6.3" "Nms/rpm" COEFFS 0 1024. 0. 0 0 1 /end COMPU_METHOD
/begin COMPU_METHOD _CNV_A_R_LINEAR_____185_CM "" RAT_FUNC "%6.3" "Nm" COEFFS 0 32. 32768. 0 0 1 /end COMPU_METHOD
/begin COMPU_METHOD _CNV_A_R_LINEAR_____186_CM "" RAT_FUNC "%6.3" "W" COEFFS 0 0.1 0. 0 0 1 /end COMPU_METHOD
/begin COMPU_METHOD _CNV_A_R_LINEAR_____187_CM "" RAT_FUNC "%6.3" "rpm/s" COEFFS 0 1. 8192. 0 0 1 /end COMPU_METHOD
/begin COMPU_METHOD _CNV_S_6_RANGE_STAT_188_CM "" TAB_VERB "%6.3" "-" COMPU_TAB_REF _CNV_S_6_RANGE_STAT_188 /end COMPU_METHOD
/begin COMPU_VTAB _CNV_S_6_RANGE_STAT_188 "" TAB_VERB 6 2 "Nsx_out_is" 4 "Nsx_tkof_is" 8 "Nsx_sta_is" 16 "Nsx_ast_is" 32 "Nsx_cdn_is" 64 "Nsx_act_is" /end COMPU_VTAB
/begin COMPU_METHOD _CNV_A_R_LINEAR_____189_CM "" RAT_FUNC "%6.3" "[-]" COEFFS 0 1024. 0. 0 0 1 /end COMPU_METHOD
/begin COMPU_METHOD _CNV_A_R_LINEAR_____190_CM "" RAT_FUNC "%6.3" "s/rpm" COEFFS 0 512000.0000000001 0. 0 0 1 /end COMPU_METHOD
/begin COMPU_METHOD _CNV_A_R_LINEAR_____191_CM "" RAT_FUNC "%6.3" "Nm/(rpm.s)" COEFFS 0 1024. 0. 0 0 1 /end COMPU_METHOD
/begin COMPU_METHOD _CNV_A_R_LINEAR_____192_CM "" RAT_FUNC "%6.3" "Nm" COEFFS 0 320000. 0. 0 0 1 /end COMPU_METHOD
/begin COMPU_METHOD _CNV_A_R_LINEAR_____193_CM "" RAT_FUNC "%6.3" "Nm/rpm" COEFFS 0 8192. 0. 0 0 1 /end COMPU_METHOD
/begin COMPU_METHOD _CNV_A_R_LINEAR_____194_CM "" RAT_FUNC "%6.3" "Nm/rpm" COEFFS 0 1024. 0. 0 0 1 /end COMPU_METHOD
/begin COMPU_METHOD _CNV_A_R_LINEAR_____195_CM "" RAT_FUNC "%6.3" "Nm/s" COEFFS 0 -32. 0. 0 0 1 /end COMPU_METHOD
/begin COMPU_METHOD _CNV_A_R_LINEAR_____196_CM "" RAT_FUNC "%6.3" "Nm/s" COEFFS 0 32. 0. 0 0 1 /end COMPU_METHOD
/begin COMPU_METHOD _CNV_A_R_LINEAR_____197_CM "" RAT_FUNC "%6.3" "(km/h)/K*rpm" COEFFS 0 100. 1000. 0 0 1 /end COMPU_METHOD
/begin COMPU_METHOD _CNV_A_R_LINEAR_____198_CM "" RAT_FUNC "%6.3" "s/s" COEFFS 0 -100. 0. 0 0 1 /end COMPU_METHOD
/begin COMPU_METHOD _CNV_A_R_LINEAR_____199_CM "" RAT_FUNC "%6.3" "s/s" COEFFS 0 100. 0. 0 0 1 /end COMPU_METHOD
/begin COMPU_METHOD _CNV_A_R_LINEAR_____200_CM "" RAT_FUNC "%6.3" "Nm/rpm" COEFFS 0 5120. 512. 0 0 1 /end COMPU_METHOD
/begin COMPU_METHOD _CNV_A_R_LINEAR_____201_CM "" RAT_FUNC "%6.3" "ms" COEFFS 0 1. 0. 0 0 1 /end COMPU_METHOD
/begin COMPU_METHOD _CNV_A_R_LINEAR_____202_CM "" RAT_FUNC "%6.3" "µs" COEFFS 0 1. 0. 0 0 1 /end COMPU_METHOD
/begin COMPU_METHOD _CNV_A_R_LINEAR_____203_CM "" RAT_FUNC "%6.3" "V" COEFFS 0 204.6 0. 0 0 1 /end COMPU_METHOD
/begin COMPU_METHOD _CNV_A_R_LINEAR_____205_CM "" RAT_FUNC "%6.3" "V" COEFFS 0 100. 0. 0 0 1 /end COMPU_METHOD
/begin COMPU_METHOD _CNV_A_R_LINEAR_____208_CM "" RAT_FUNC "%6.3" "s" COEFFS 0 25. 0. 0 0 1 /end COMPU_METHOD
/begin COMPU_METHOD _CNV_A_R_LINEAR_____209_CM "" RAT_FUNC "%6.3" "V" COEFFS 0 102.3 0. 0 0 1 /end COMPU_METHOD
/begin COMPU_METHOD _CNV_A_R_LINEAR_____212_CM "" RAT_FUNC "%6.3" "V" COEFFS 0 1137.777777777778 0. 0 0 1 /end COMPU_METHOD
/begin COMPU_METHOD _CNV_S_3_STATUS_OK__213_CM "" TAB_VERB "%6.3" "" COMPU_TAB_REF _CNV_S_3_STATUS_OK__213 /end COMPU_METHOD
/begin COMPU_VTAB _CNV_S_3_STATUS_OK__213 "" TAB_VERB 3 0 "Nsx_vld_nok_0" 1 "Nsx_vld_ok_1" 2 "Nsx_vld_fail_2" /end COMPU_VTAB
/begin COMPU_METHOD _CNV_S_3_STATUS_BRK_214_CM "" TAB_VERB "%6.3" "" COMPU_TAB_REF _CNV_S_3_STATUS_BRK_214 /end COMPU_METHOD
/begin COMPU_VTAB _CNV_S_3_STATUS_BRK_214 "" TAB_VERB 3 1 "Nsx_brk_pdl_off" 2 "Nsx_brk_pdl_on" 4 "Nsx_brk_pdl_vld_on" /end COMPU_VTAB
/begin COMPU_METHOD _CNV_S_2_STATUS_BRK_215_CM "" TAB_VERB "%6.3" "" COMPU_TAB_REF _CNV_S_2_STATUS_BRK_215 /end COMPU_METHOD
/begin COMPU_VTAB _CNV_S_2_STATUS_BRK_215 "" TAB_VERB 2 1 "Nsx_brk_pdl_off" 2 "Nsx_brk_pdl_on" /end COMPU_VTAB
/begin COMPU_METHOD _CNV_A_R_LINEAR_____324_CM "" RAT_FUNC "%6.3" "TDC" COEFFS 0 0.25 0. 0 0 1 /end COMPU_METHOD
/begin COMPU_METHOD _CNV_A_R_LINEAR_____368_CM "" RAT_FUNC "%6.3" "dent" COEFFS 0 1. 0. 0 0 1 /end COMPU_METHOD
/begin COMPU_METHOD _CNV_A_R_LINEAR_____369_CM "" RAT_FUNC "%6.3" "Nm" COEFFS 0 10. 0. 0 0 1 /end COMPU_METHOD
/begin COMPU_METHOD _CNV_A_R_LINEAR_____370_CM "" RAT_FUNC "%6.3" "s" COEFFS 0 312500. 0. 0 0 1 /end COMPU_METHOD
/begin COMPU_METHOD _CNV_A_R_LINEAR_____371_CM "" RAT_FUNC "%6.3" "-" COEFFS 0 6. 0. 0 0 1 /end COMPU_METHOD
/begin COMPU_METHOD _CNV_A_R_LINEAR_____372_CM "" RAT_FUNC "%6.3" "ns" COEFFS 0 1.e-002 0. 0 0 1 /end COMPU_METHOD
/begin COMPU_METHOD _CNV_A_R_LINEAR_____413_CM "" RAT_FUNC "%6.3" "1/s" COEFFS 0 100. 0. 0 0 1 /end COMPU_METHOD
/begin COMPU_METHOD _CNV_A_R_LINEAR_____487_CM "" RAT_FUNC "%6.3" "-" COEFFS 0 7281.666666666667 0. 0 0 1 /end COMPU_METHOD
/begin COMPU_METHOD _CNV_A_R_LINEAR_____488_CM "" RAT_FUNC "%6.3" "hPa*s" COEFFS 0 10. 0. 0 0 1 /end COMPU_METHOD
/begin COMPU_METHOD _CNV_A_R_LINEAR_____489_CM "" RAT_FUNC "%6.3" "[hPa/s]" COEFFS 0 0.1 0. 0 0 1 /end COMPU_METHOD
/begin COMPU_METHOD _CNV_A_R_LINEAR_____490_CM "" RAT_FUNC "%6.3" "hPa*s" COEFFS 0 1. 0. 0 0 1 /end COMPU_METHOD
/begin RECORD_LAYOUT _REC_S1VAL_20_u1 FNC_VALUES 1 UBYTE COLUMN_DIR DIRECT /end RECORD_LAYOUT
/begin RECORD_LAYOUT _REC_A2AXS_20_u1 NO_AXIS_PTS_X 1 UBYTE AXIS_PTS_X 2 UBYTE INDEX_INCR DIRECT /end RECORD_LAYOUT
/begin RECORD_LAYOUT _REC_S1VAL_20_u2 FNC_VALUES 1 UWORD COLUMN_DIR DIRECT /end RECORD_LAYOUT
/begin RECORD_LAYOUT _REC_S1VAL_20_s2 FNC_VALUES 1 SWORD COLUMN_DIR DIRECT /end RECORD_LAYOUT
/begin RECORD_LAYOUT _REC_A2AXS_20_u2 NO_AXIS_PTS_X 1 UWORD AXIS_PTS_X 2 UWORD INDEX_INCR DIRECT /end RECORD_LAYOUT
/begin RECORD_LAYOUT _REC_A1CUR_20_u1_u2 FNC_VALUES 1 UBYTE COLUMN_DIR DIRECT /end RECORD_LAYOUT
/begin RECORD_LAYOUT _REC_A1CUR_20_u1_u1 FNC_VALUES 1 UBYTE COLUMN_DIR DIRECT /end RECORD_LAYOUT
/begin RECORD_LAYOUT _REC_A1CUR_20_u2_u1 FNC_VALUES 1 UWORD COLUMN_DIR DIRECT /end RECORD_LAYOUT
/begin RECORD_LAYOUT _REC_A1MAP_20_u2_u2_u2 FNC_VALUES 1 UWORD COLUMN_DIR DIRECT /end RECORD_LAYOUT
/begin RECORD_LAYOUT _REC_A1CUR_20_u2_u2 FNC_VALUES 1 UWORD COLUMN_DIR DIRECT /end RECORD_LAYOUT
/begin RECORD_LAYOUT _REC_A1MAP_20_u2_u2_u1 FNC_VALUES 1 UWORD COLUMN_DIR DIRECT /end RECORD_LAYOUT
/begin RECORD_LAYOUT _REC_A1MAP_20_u1_u2_u2 FNC_VALUES 1 UBYTE COLUMN_DIR DIRECT /end RECORD_LAYOUT
/begin RECORD_LAYOUT _REC_A1MAP_20_u2_u1_u2 FNC_VALUES 1 UWORD COLUMN_DIR DIRECT /end RECORD_LAYOUT
/begin FUNCTION AsBstCtl_Bpcdmxx ""
 /begin DEF_CHARACTERISTIC Ctp_eng_diag_spg_dly Cbx_run_eng_ena_inhi Cbx_spg_prs_sp_min Cbx_spg_reg_fail_cfm Cbx_up_thr_prs_sens Cxx_dfdec_spg_reg_apl_down Cxx_dfdec_spg_reg_apl_up Cxx_dfinc_spg_reg_apl_down Cxx_dfinc_spg_reg_apl_up Cxx_spg_n_thd_max Cxx_spg_n_thd_min Cxx_spg_prs_err_min Cxx_spg_prs_sp_dev_max Cxx_spg_prs_sp_dev_min Cxx_spg_prs_sp_dt1_fac Cxx_spg_prs_sp_dt1_t Cxx_spg_prs_sp_min Cxx_spg_prs_sp_t_fil Cxx_spg_reg_apl_down_thd Cxx_spg_reg_apl_up_thd Cxx_spg_sys_diag_dly /end DEF_CHARACTERISTIC
 /begin OUT_MEASUREMENT Vbx_df_spg_reg_apl_down Vbx_df_spg_reg_apl_up Vbx_spg_dev_int_rst Vbx_spg_diag_int_cdn Vbx_spg_prs_dly Vbx_spg_prs_err_sgn Vbx_spg_prs_init Vbx_spg_prs_sp_min Vbx_spg_reg_apl_down Vbx_spg_reg_apl_up Vsx_spg_reg_vld Vxx_dt1_exp Vxx_spg_dev_int Vxx_spg_int_in Vxx_spg_prs_dly Vxx_spg_prs_sp_dt1 Vxx_spg_prs_sp_fil Vxx_spg_reg_apl_down Vxx_spg_reg_apl_up /end OUT_MEASUREMENT
/end FUNCTION
/begin FUNCTION AsBstCtl_Alcoxxx "" /begin DEF_CHARACTERISTIC Cmp_spg_ol_pwm_alco /end DEF_CHARACTERISTIC /begin OUT_MEASUREMENT Vxx_spg_ol_pwm_alco /end OUT_MEASUREMENT /end FUNCTION
/begin FUNCTION InAsiPbt "" /begin SUB_FUNCTION InAsiPbt_Btprsxx_xxxxxg /end SUB_FUNCTION /end FUNCTION
/begin FUNCTION InAsiPbt_Btprsxx_xxxxxg ""
 /begin DEF_CHARACTERISTIC Ctb_pump_maf Ctb_spg_pwm Cmp_ex_prs_dif_fac Cxx_ex_prs_fail_val Cxx_spg_pwm_sp_ftc Cxx_tbn_prs_dif_cut_fac /end DEF_CHARACTERISTIC
 /begin OUT_MEASUREMENT Vsx_ex_prs_mdl_vld Vsx_ex_prs_vld Vxx_ex_prs Vxx_ex_prs_mdl Vxx_spg_pwm_sp_fil Vxx_up_tbn_prs_dif Vxx_up_tbn_prs_dif_fac /end OUT_MEASUREMENT
/end FUNCTION
/begin FUNCTION SmIsrCtl "" /begin OUT_MEASUREMENT Vxx_is_ad_tq /end OUT_MEASUREMENT
 /begin SUB_FUNCTION SmIsrCtl_Dervxxx SmIsrCtl_Hookxxx SmIsrCtl_Idactxx SmIsrCtl_Intxxxx SmIsrCtl_Propxxx SmIsrCtl_Tkodlxx SmIsrCtl_Idctrxx SmIsrCtl_Adaptxx SmIsrCtl_Tkocoxx SmIsrCtl_Obdisxx SmIsrCtl_Ctlfacx SmIsrCtl_Schedul SmIsrCtl_Alcoxxx /end SUB_FUNCTION
/end FUNCTION
/begin FUNCTION SmIsrCtl_Dervxxx ""
 /begin DEF_CHARACTERISTIC Ctb_is_n_d_dif Ctb_is_tco Ctp_is_d_err_fac Ctp_is_d_gear_fac Ctp_is_d_max Ctp_is_d_min Ctp_is_d_tco_fac Cxx_fac_n_d Cxx_is_d_pft_rgn_fac /end DEF_CHARACTERISTIC
 /begin OUT_MEASUREMENT Vbx_ini_drv Vxx_dif_n_sp_grd Vxx_is_d_cor Vxx_is_d_fac Vxx_max_is_d Vxx_min_is_d Vxx_mmv_n_dif_drv Vxx_raw_n_dif_drv /end OUT_MEASUREMENT
/end FUNCTION
/begin FUNCTION SmIsrCtl_Hookxxx ""
 /begin DEF_CHARACTERISTIC Cbx_is_blk_vh_run_cfm Cbx_on_ac_cor_cfm Cbx_on_alt_cor_cfm Cbx_on_mdf_cor_cfm Cbx_on_pwst_cor_cfm Cxx_fast_ad_cdn_dly Cxx_h_blk_is_alt_pow Cxx_is_i_zon_out_dly Cxx_l_blk_is_alt_pow Cxx_min_is_i_ofs /end DEF_CHARACTERISTIC
 /begin OUT_MEASUREMENT Vbx_blk_n Vbx_is_blk_n_cdn Vbx_is_blk_vh Vxx_is_i_zon_out_dly /end OUT_MEASUREMENT
/end FUNCTION
/begin FUNCTION SmIsrCtl_Idactxx ""
 /begin DEF_CHARACTERISTIC Ctb_is_in_ofs_drv Cmp_is_in_ofs_drv_gear Ctp_is_in_tco_ofs Ctp_is_out_sta_dly Ctp_sta_off_ofs Cbx_tq_trs_ctl_mux_cfm Cxx_ac_is_in_cdn_ofs Cxx_ac_is_in_cdn_ofs2 Cxx_ac_is_in_dly Cxx_ac_is_out_n_ofs Cxx_fac_n_drv_d Cxx_fac_n_drv_fil Cxx_is_act_ofs Cxx_is_ast_ofs_zon Cxx_is_cdn_h_sta_n_dly Cxx_is_deci_in_dly Cxx_is_deci_in_n_thd Cxx_is_fil_drv_n_max_ofs Cxx_is_fil_drv_n_min Cxx_is_in_cdn_ofs Cxx_is_in_cdn_ofs2 Cxx_is_in_dly Cxx_is_in_pump_thd Cxx_is_in_wit_pdl_ofs Cxx_is_n_act Cxx_is_n_act_hys Cxx_is_n_stab_clc_fac Cxx_is_n_stab_clc_ini Cxx_is_n_stab_drv_thd Cxx_is_out_ast_dly Cxx_is_out_drv_thd Cxx_is_out_n_ofs Cxx_is_out_n_ofs_sta Cxx_is_out_n_run_vh_thd Cxx_is_out_n_stop_vh_thd Cxx_is_out_pump_thd Cxx_is_out_wit_pdl_ofs Cxx_n_drv_ast Cxx_n_drv_out Cxx_sta_stt_is_in_dly /end DEF_CHARACTERISTIC
 /begin OUT_MEASUREMENT Vbx_is_act Vbx_old_igk_cut Vbx_sta Vsx_is Vsx_is_raw Vsx_mc Vxx_is_ast_ofs Vxx_is_cdn_h_n_dly Vxx_is_in_deci_dly Vxx_is_in_dly Vxx_is_in_n_thd Vxx_is_n_stab_fac Vxx_is_out_ast_dly Vxx_is_out_n_thd Vxx_is_out_sta_dly Vxx_n_drv_is Vxx_n_drv_sub Vxx_sta_off_ofs /end OUT_MEASUREMENT
/end FUNCTION
/begin FUNCTION SmIsrCtl_Intxxxx ""
 /begin DEF_CHARACTERISTIC Ctb_is_n_i_dif Ctb_is_n_i_dif2 Cmp_is_i_err_gear_fac Cmp_is_i_err_tco_fac Cmp_tco_ini_i Ctp_tco_ini_i_sta Ctp_tco_tqe_max_is_i Cbx_i_set_is_cfm Cbx_ini_i_tco_cfm Cbx_is_cdn_i_act_cfm Cbx_is_int_ftc_n_cfm Cxx_blk_n_i_fac_cor Cxx_blk_n_min_is_i Cxx_fil_is_i_sp Cxx_ini_i_fac Cxx_is_i_out_fil_fac Cxx_is_i_out_fil_wit_pdl_fac Cxx_is_i_pft_rgn_fac Cxx_is_i_set_ofs Cxx_is_i_tq_trs_ctl_mux_n_in Cxx_is_i_tq_trs_ctl_mux_n_out Cxx_is_n_max_is_i Cxx_is_n_max_is_i_grd Cxx_is_n_min_is_i Cxx_is_n_min_is_i_grd Cxx_vh_run_max_is_i_ofs Cxx_vh_run_min_is_i_fac Cxx_vh_stop_min_is_i_fac /end DEF_CHARACTERISTIC
 /begin OUT_MEASUREMENT Vbx_is_i_cor_prev_sgn Vtx_ini_i[0] Vtx_ini_i[1] Vxx_is_i_cor Vxx_is_i_cor_ini Vxx_is_i_cor_ini_ad Vxx_is_i_cor_prev Vxx_is_i_cor_wio_set Vxx_is_i_cor_wit_set Vxx_is_i_fac Vxx_is_i_out_fil Vxx_is_n_is_i Vxx_is_n_is_i_grd Vxx_max_is_i Vxx_min_is_i Vxx_min_is_i_wio_blk Vxx_tqe_ini_i /end OUT_MEASUREMENT
/end FUNCTION
/begin FUNCTION SmIsrCtl_Propxxx ""
 /begin DEF_CHARACTERISTIC Ctb_is_n_p_dif Ctb_is_n_p_dif2 Cmp_is_p_err_gear_fac Cmp_is_p_err_tco_fac Ctp_is_p_max Ctp_is_p_min Ctp_is_p_sta_fac Cbx_tq_trs_ctl_mux_p_cfm Cxx_is_ctl_mux_min_p Cxx_is_p_dec_slop Cxx_is_p_inc_slop Cxx_is_p_pft_rgn_fac Cxx_is_p_sta_max /end DEF_CHARACTERISTIC
 /begin OUT_MEASUREMENT Vtx_is_p_fac[0] Vtx_is_p_fac[1] Vxx_dif_n_sp Vxx_is_gear Vxx_is_p_cor Vxx_max_is_p Vxx_min_is_p /end OUT_MEASUREMENT
/end FUNCTION
/begin FUNCTION SmIsrCtl_Tkodlxx ""
 /begin DEF_CHARACTERISTIC Cxx_tkof_ena_vs_thd Cxx_tkof_end_vs_thd Cxx_tkof_n_grd_end_thd Cxx_tkof_vs_n_rat_stop_thd /end DEF_CHARACTERISTIC
 /begin OUT_MEASUREMENT Vbx_tkof_vs_ena /end OUT_MEASUREMENT
/end FUNCTION
/begin FUNCTION SmIsrCtl_Idctrxx ""
 /begin DEF_CHARACTERISTIC Ctb_is_n_dif Ctp_raw_p_d_fac Cbx_cdn_is_fil_tgt_cfm Cbx_tq_pow_is_cfm Cxx_is_tgt_ftc Cxx_is_tgt_ftc_dec_slop Cxx_is_tgt_ftc_inc_slop Cxx_mfld_dly_dec_slop Cxx_mfld_dly_inc_slop /end DEF_CHARACTERISTIC
 /begin OUT_MEASUREMENT Vxx_is_tqe_raw Vxx_is_tqe_sp Vxx_is_tqe_tgt Vxx_raw_raw_is_tqe Vxx_raw_sp_is_tqe Vxx_raw_tgt_is_tqe /end OUT_MEASUREMENT
/end FUNCTION
/begin FUNCTION SmIsrCtl_Adaptxx ""
 /begin DEF_CHARACTERISTIC Cbx_is_ad_mdf_cfm Cxx_ac_pow Cxx_ad_cor_dsb_dly Cxx_dri_agb_ad_is_fil Cxx_h_ad_is_alt_pow Cxx_is_ad_tq_dft Cxx_is_i_fil_fac1 Cxx_is_i_fil_fac2 Cxx_l_ad_is_alt_pow Cxx_max_is_ad_tq Cxx_max_n_ad_sp_dif Cxx_min_is_ad_tq Cxx_min_tco_ad_cor Cxx_neut_ad_is_fil /end DEF_CHARACTERISTIC
 /begin OUT_MEASUREMENT Vbx_is_ad_cdn Vxx_fil_is_i_cor Vxx_fil_is_i_cor_ad Vxx_fil_is_i_cor_ad_last Vxx_is_ad_tq_ini Vxx_is_ad_tq_last Vxx_is_ad_tq_raw /end OUT_MEASUREMENT
/end FUNCTION
/begin FUNCTION SmIsrCtl_Tkocoxx ""
 /begin DEF_CHARACTERISTIC Ctb_n_dif_tkof Ctb_n_drv_tkof Ctb_n_tkof Ctp_n_dif_tkof_p Ctp_n_drv_tkof_d Ctp_n_tkof_d Ctp_n_tkof_p Cxx_ct_stop_tkof_ftc Cxx_stop_tkof_ftc Cxx_tkof_tq_d_max Cxx_tkof_tq_d_min Cxx_tkof_tq_p_max Cxx_tkof_tq_p_min /end DEF_CHARACTERISTIC
 /begin OUT_MEASUREMENT Vbx_tkof_tq_cor_ena Vxx_tkof_d_cor Vxx_tkof_p_cor Vxx_tkof_tqe_cor /end OUT_MEASUREMENT
/end FUNCTION
/begin FUNCTION SmIsrCtl_Obdisxx ""
 /begin DEF_CHARACTERISTIC Cxx_dfdec_isr_h_lvl Cxx_dfdec_isr_l_lvl Cxx_dfinc_isr_h_lvl Cxx_dfinc_isr_l_lvl Cxx_isr_h_lvl_obd Cxx_isr_l_lvl_obd /end DEF_CHARACTERISTIC
 /begin OUT_MEASUREMENT Vbx_df_isr_h_lvl Vbx_df_isr_l_lvl /end OUT_MEASUREMENT
/end FUNCTION
/begin FUNCTION SmIsrCtl_Ctlfacx "" /begin OUT_MEASUREMENT Vbx_is_fac_cho /end OUT_MEASUREMENT /end FUNCTION
/begin FUNCTION SmIsrCtl_Schedul "" /begin DEF_CHARACTERISTIC Cbx_is_loop_diag_cfm /end DEF_CHARACTERISTIC /begin OUT_MEASUREMENT Vbx_is_loop_diag_cfm /end OUT_MEASUREMENT /end FUNCTION
/begin FUNCTION SmIsrCtl_Alcoxxx "" /begin DEF_CHARACTERISTIC Ctp_tco_ini_i_sta_alco /end DEF_CHARACTERISTIC /begin OUT_MEASUREMENT Vxx_tco_ini_i_sta_alco /end OUT_MEASUREMENT /end FUNCTION
/begin FUNCTION SmStaSpv "" /begin SUB_FUNCTION SmStaSpv_Engstxx SmStaSpv_Stalixx SmStaSpv_Entrfxx /end SUB_FUNCTION /end FUNCTION
/begin FUNCTION SmStaSpv_Engstxx ""
 /begin DEF_CHARACTERISTIC Ctp_aut_eng_n_thd Ctp_sta_dly Cxx_aut_eng_n_thd_h Cxx_drvn_eng_n_thd_h Cxx_drvn_eng_n_thd_l /end DEF_CHARACTERISTIC
 /begin OUT_MEASUREMENT Vbx_trs_eng_aut Vsx_eng Vsx_prev_eng Vbx_frst_sta_done Vbx_clu_stal Vbx_swlk_stal Vbx_mem_swlk /end OUT_MEASUREMENT
/end FUNCTION
/begin FUNCTION SmStaSpv_Stalixx ""
 /begin DEF_CHARACTERISTIC Cxx_igk_stal_eng_n_thd Cxx_set_stal_dly Cxx_stal_det_swlk_dly /end DEF_CHARACTERISTIC
 /begin OUT_MEASUREMENT Vbx_clu_stal_ini Vbx_igk_stal_eng_n_thd Vbx_sta_stal Vbx_swlk_stal_ini /end OUT_MEASUREMENT
/end FUNCTION
/begin FUNCTION SmStaSpv_Entrfxx "" /begin DEF_CHARACTERISTIC Cxx_ini_stop_dly /end DEF_CHARACTERISTIC /begin OUT_MEASUREMENT Vsx_vh_eng /end OUT_MEASUREMENT /end FUNCTION
/begin FUNCTION BoVfoSup "" /begin DEF_CHARACTERISTIC Cbx_pws3_cfm lc_rly_main_pwl_on /end DEF_CHARACTERISTIC
 /begin OUT_MEASUREMENT Vbx_df_actr_rly_oc Vbx_df_actr_rly_scg Vbx_df_actr_rly_scw Vbx_df_pws_1_h Vbx_df_pws_1_l Vbx_df_pws_2_h Vbx_df_pws_2_l Vbx_df_pws_3_h Vbx_df_pws_3_l Vbx_diag_ena_actr_rly_oc Vbx_diag_ena_actr_rly_scg Vbx_diag_ena_actr_rly_scw Vbx_diag_ena_pws_1_h Vbx_diag_ena_pws_1_l Vbx_diag_ena_pws_2_h Vbx_diag_ena_pws_2_l Vbx_diag_ena_pws_3_h Vbx_diag_ena_pws_3_l Vbx_ecu_rst Vbx_pws3_cfm Vxx_raw_pws_1 Vxx_raw_pws_2 Vxx_raw_pws_3 lv_err_vcc_1 lv_err_vcc_2 lv_err_vcc_3 lv_main_rly_pwl lv_main_rly_pwl_2 lv_mu_inh_pwl_tran_es_el lv_pwl_rst_wdt_asw lv_pwl_unlock_cdn_asw lv_rly_main t_main_rly_pwl /end OUT_MEASUREMENT
/end FUNCTION
/begin FUNCTION BiAsiIap ""
 /begin DEF_CHARACTERISTIC Cxx_hw_ftc c_vp_map_mv_max_diag c_vp_map_mv_min_diag c_vp_put_mv_max_diag c_vp_put_mv_min_diag /end DEF_CHARACTERISTIC
 /begin OUT_MEASUREMENT Vbx_df_sens_map_h Vbx_df_sens_map_l Vbx_df_sens_spg_h Vbx_df_sens_spg_l Vbx_diag_ena_sens_map_h Vbx_diag_ena_sens_map_l Vbx_diag_ena_sens_spg_h Vbx_diag_ena_sens_spg_l Vp_map_fil Vxx_sens_map_v Vxx_sens_spg_v lv_err_map vp_map_max vp_map_max_inter vp_map_min vp_map_min_inter vp_map_mv vp_put_mv /end OUT_MEASUREMENT
 /begin SUB_FUNCTION BiAsiIap_Mapxxsr BiAsiIap_Spgxxsr /end SUB_FUNCTION
/end FUNCTION
/begin FUNCTION BiAsiIap_Mapxxsr ""
 /begin DEF_CHARACTERISTIC Ntb_n_map_fil_ftc Ctp_n_map_fil_ftc Cxx_map_fac Cxx_map_ofs /end DEF_CHARACTERISTIC
 /begin OUT_MEASUREMENT Vbx_run_map Vbx_stop_map Vxx_raw_sens_map Vxx_raw_sens_map_run Vxx_raw_sens_map_stop /end OUT_MEASUREMENT
/end FUNCTION
/begin FUNCTION BiAsiIap_Spgxxsr ""
 /begin DEF_CHARACTERISTIC Ntb_n_spg_fil_ftc Ctp_n_spg_fil_ftc Cxx_spg_fac Cxx_spg_ofs /end DEF_CHARACTERISTIC
 /begin OUT_MEASUREMENT Vbx_run_spg Vbx_stop_spg Vxx_raw_sens_spg Vxx_raw_sens_spg_run Vxx_raw_sens_spg_stop /end OUT_MEASUREMENT
/end FUNCTION
/begin FUNCTION BiAsiIat ""
 /begin DEF_CHARACTERISTIC ldpm_vp_tia_1_airt ip_tia_mes c_vp_tia_max_diag_el c_vp_tia_min_diag_el /end DEF_CHARACTERISTIC
 /begin OUT_MEASUREMENT Vbx_df_sens_mat_h Vbx_df_sens_mat_l Vbx_diag_ena_sens_mat_h Vbx_diag_ena_sens_mat_l Vxx_raw_sens_mat Vxx_sens_mat_v err_sym_el_tia[0] lv_cdn_diag_el_tia[0] tia_mes[0] vp_tia[0] vp_tia_mmv[0] /end OUT_MEASUREMENT
/end FUNCTION
/begin FUNCTION BiAsiIaf "" /begin OUT_MEASUREMENT maf /end OUT_MEASUREMENT /end FUNCTION
/begin FUNCTION BiCliCoi ""
 /begin DEF_CHARACTERISTIC ldp_vp_tco_ip_tco_mes ip_tco_mes c_vp_tco_max_diag_tco_el c_vp_tco_min_diag_tco_el lc_tco_diag_ena_rst /end DEF_CHARACTERISTIC
 /begin OUT_MEASUREMENT Vbx_df_sens_tco_h Vbx_df_sens_tco_l Vbx_diag_ena_sens_tco_h Vbx_diag_ena_sens_tco_l Vxx_raw_sens_tco Vxx_sens_tco_v Vxx_sfty_sens_tco_v lv_err_tco /end OUT_MEASUREMENT
/end FUNCTION
/begin FUNCTION BiPciApi ""
 /begin OUT_MEASUREMENT Vxx_acel_pdl_sens_v1 Vxx_acel_pdl_sens_v2 Vxx_sfty_acel_pdl_sens_v1 vp_pvs_1 vp_pvs_1_mon vp_pvs_2 vp_pvs_2_mon /end OUT_MEASUREMENT
/end FUNCTION
/begin FUNCTION BiVfiCri "" /begin OUT_MEASUREMENT Vbx_sens_igk /end OUT_MEASUREMENT /end FUNCTION
/begin FUNCTION BiVfiEmi ""
 /begin DEF_CHARACTERISTIC c_cdn_vb_min_diag c_sub_vb c_t_vcc_diag_auth c_vb_max_obd1 c_vb_max_obd2 c_vb_min_obd1 c_vb_min_obd2 c_vb_raw_inh_diag c_vcc_1_dif_diag c_vcc_1_max_diag c_vcc_1_min_diag c_vcc_2_dif_diag c_vcc_2_max_diag c_vcc_2_min_diag c_vcc_3_dif_diag c_vcc_3_max_diag c_vcc_3_min_diag c_vcc_gain_dif /end DEF_CHARACTERISTIC
 /begin OUT_MEASUREMENT Vbx_df_vb_rly_oc_scg Vbx_df_vb_rly_scw Vbx_diag_ena_vb_rly_oc_scg Vbx_diag_ena_vb_rly_scw Vxx_raw_vb Vxx_vb_rly lv_vb_cdn_obd_2 /end OUT_MEASUREMENT
/end FUNCTION
/begin FUNCTION BoAsoIto ""
 /begin OUT_MEASUREMENT Vbx_df_it_cmd_el Vbx_diag_ena_it_cmd_el Vbx_it_hbrg_ok err_sym_etc_dr lv_cdn_diag_etc_dr lv_off_mtc_asw v_mtc_sp /end OUT_MEASUREMENT
/end FUNCTION
/begin FUNCTION InSmiSyn ""
 /begin OUT_MEASUREMENT Vbx_clu_stal_ctr Vxx_clu_stal_ctr Vxx_cylr_is_vld_ctr Vxx_cylr_ok_aftr_stal_ctr Vxx_cylr_ok_ctr Vxx_err_cylr_ctr Vxx_err_cylr_is_run_ctr Vxx_err_id_is_run_ctr Vxx_is_cylr_ok_ctr Vxx_no_deci_cylr_ctr Vxx_no_deci_id_is_ctr Vxx_run_re_phs_ctr Vxx_crk_syn_loss_ctr /end OUT_MEASUREMENT
 /begin SUB_FUNCTION InSmiSyn_Crksixx InSmiSyn_Derivxx InSmiSyn_Filspxx InSmiSyn_Speedxx InSmiSyn_Synchro InSmiSyn_Tothpac InSmiSyn_Camsixx InSmiSyn_Recocxx InSmiSyn_Spdmfxx InSmiSyn_Schedul /end SUB_FUNCTION
/end FUNCTION
/begin FUNCTION InSmiSyn_Crksixx ""
 /begin DEF_CHARACTERISTIC Cxx_dfdec_crk_chr Cxx_dfdec_crk_cmp Cxx_dfdec_crk_cyc Cxx_dfdec_crk_no_sig Cxx_dfdec_crk_oc Cxx_dfdec_crk_shp Cxx_dfinc_crk_chr Cxx_dfinc_crk_cmp Cxx_dfinc_crk_cyc Cxx_dfinc_crk_no_sig Cxx_dfinc_crk_oc Cxx_dfinc_crk_shp Cxx_h_dif_prs_dsb_sp Cxx_h_thd_dif_prs_dsb_sp Cxx_h_thd_prs_sp_fail Cxx_l_thd_dif_prs_dsb_sp Cxx_nr_vld_crk_fail1 /end DEF_CHARACTERISTIC
 /begin OUT_MEASUREMENT Vbx_crk Vbx_crk_syn Vbx_deb_cdn Vbx_df_crk_no_sig Vbx_df_crk_no_sig_wio_cam Vbx_diag_ena_crk_no_sig Vbx_diag_ena_crk_no_sig_wio_cam Vbx_main_cdn Vbx_map_flu_cdn Vbx_pres_df_crk_chr Vbx_pres_df_crk_cmp Vbx_pres_df_crk_cyc Vbx_pres_df_crk_no_sig Vbx_pres_df_crk_oc Vbx_pres_df_crk_shp Vbx_run_eng_det Vsx_sens_crk_vld Vxx_crk_syn_loss_ctr_ini Vxx_ctr_vld_crk_fail1 /end OUT_MEASUREMENT
/end FUNCTION
/begin FUNCTION InSmiSyn_Derivxx "" /begin DEF_CHARACTERISTIC Cxx_n_drv_fil_fac /end DEF_CHARACTERISTIC /begin OUT_MEASUREMENT Vxx_mv_n_drv Vxx_n_drv Vxx_raw_n_drv /end OUT_MEASUREMENT /end FUNCTION
/begin FUNCTION InSmiSyn_Filspxx "" /begin DEF_CHARACTERISTIC Ctp_gear_n_mv_ftc /end DEF_CHARACTERISTIC
 /begin OUT_MEASUREMENT Vxb_n2_mv.factor Vxb_n2_mv.index Vxb_n2_mv.num_dp Vxb_n_mv.factor Vxb_n_mv.index Vxb_n_mv.num_dp Vxx_n_mv Vxx_n_mv_raw /end OUT_MEASUREMENT
/end FUNCTION
/begin FUNCTION InSmiSyn_Speedxx "" /begin DEF_CHARACTERISTIC Ctb_n Ctb_n2 Ctp_tco_n_ini Cxx_tdc_rev_nr /end DEF_CHARACTERISTIC
 /begin OUT_MEASUREMENT Vxb_n.factor Vxb_n.index Vxb_n.num_dp Vxb_n2.factor Vxb_n2.index Vxb_n2.num_dp Vbx_n_ini Vsx_n_vld Vxx_n Vxx_tdc_per /end OUT_MEASUREMENT
/end FUNCTION
/begin FUNCTION InSmiSyn_Synchro "" /begin OUT_MEASUREMENT Vbx_eng_syn Vxx_eng_angl Vxx_tdc_ctr /end OUT_MEASUREMENT /end FUNCTION
/begin FUNCTION InSmiSyn_Tothpac ""
 /begin OUT_MEASUREMENT Vbx_trz_clc_ena Vxx_trz_t_toth_0 Vxx_trz_t_toth_0_nxt Vxx_trz_t_toth_1 Vxx_trz_t_toth_2 Vxx_trz_t_toth_3 Vxx_trz_t_toth_4 Vxx_trz_t_toth_5 Vxx_trz_t_toth_5_prev /end OUT_MEASUREMENT
/end FUNCTION
/begin FUNCTION InSmiSyn_Camsixx ""
 /begin DEF_CHARACTERISTIC Cxx_dfdec_in_cam_chr Cxx_dfdec_in_cam_crk_cmp Cxx_dfdec_in_cam_cyc Cxx_dfdec_in_cam_no_sig Cxx_dfdec_in_cam_nok Cxx_dfinc_in_cam_chr Cxx_dfinc_in_cam_crk_cmp Cxx_dfinc_in_cam_cyc Cxx_dfinc_in_cam_no_sig Cxx_dfinc_in_cam_nok /end DEF_CHARACTERISTIC
 /begin OUT_MEASUREMENT Vbx_in_cam_lvl Vbx_pres_df_in_cam_chr Vbx_pres_df_in_cam_crk_cmp Vbx_pres_df_in_cam_cyc Vbx_pres_df_in_cam_no_sig Vbx_pres_df_in_cam_nok Vsx_sens_in_cam_vld Vxx_in_cam_toth_per /end OUT_MEASUREMENT
/end FUNCTION
/begin FUNCTION InSmiSyn_Recocxx ""
 /begin DEF_CHARACTERISTIC Ctb_cylr_map Ctp_cylr_prs_stab_dif Cbx_bch_cylr Cbx_cylr_bas_conf Cbx_cylr_bch_mod Cbx_cylr_ena_re_phs Cbx_cylr_is_neg_clu_stal Cbx_cylr_is_run_gex_appl Cbx_cylr_loop Cbx_cylr_run_ol Cxx_crk1_bas_toth_nr Cxx_cylr_alti_prs_max_fac Cxx_cylr_alti_prs_min_fac Cxx_cylr_clc_ctr Cxx_cylr_clc_ctr_lpg Cxx_cylr_cold_is_stab_t Cxx_cylr_gear Cxx_cylr_is_clc_ctr Cxx_cylr_is_clc_ctr_lpg Cxx_cylr_is_max_test_nr Cxx_cylr_is_max_tq_dec Cxx_cylr_is_max_tq_dec_lpg Cxx_cylr_is_min_tq_dec Cxx_cylr_is_min_tq_dec_lpg Cxx_cylr_is_run_max_tco Cxx_cylr_is_run_min_tco Cxx_cylr_is_run_n_fac Cxx_cylr_is_ti_cor_max Cxx_cylr_l_n_re_phs Cxx_cylr_l_prs_dif_fac Cxx_cylr_l_prs_re_phs Cxx_cylr_max_dif_iga Cxx_cylr_max_mv_lamb_fac Cxx_cylr_max_n Cxx_cylr_max_n_lpg Cxx_cylr_max_prs Cxx_cylr_max_prs_lpg Cxx_cylr_max_tco Cxx_cylr_max_test_nr Cxx_cylr_max_tq_dec Cxx_cylr_max_tq_dec_lpg Cxx_cylr_min_mv_lamb_fac Cxx_cylr_min_n Cxx_cylr_min_n_lpg Cxx_cylr_min_prs Cxx_cylr_min_prs_lpg Cxx_cylr_min_tco Cxx_cylr_min_tq_dec Cxx_cylr_min_tq_dec_lpg Cxx_cylr_n_stab_dif Cxx_cylr_stab_ctr Cxx_cylr_stab_ctr_lpg Cxx_cylr_stab_inj_dif Cxx_cylr_stab_is_ctr Cxx_cylr_stab_is_ctr_lpg Cxx_cylr_stab_t Cxx_cylr_trz_stab_dif Cxx_is_run_stal_step Cxx_stal_step /end DEF_CHARACTERISTIC
 /begin OUT_MEASUREMENT Vbx_ac_in_mem Vbx_ac_out_mem Vbx_clu_stal_ctr_ini Vbx_cylr_is_run_ctl_ini Vbx_cylr_is_run_mes Vbx_cylr_is_run_req Vbx_cylr_is_run_stab_cdn Vbx_cylr_is_run_stop Vbx_cylr_run_loop_stop Vbx_cylr_run_stab_cdn Vbx_cylr_stab_cdn Vbx_cylr_stab_cdn_rtn Vbx_cylr_stop Vbx_cylr_tot_stab_cdn Vbx_gas_comb_mod Vbx_iga_re_syn_req Vbx_inj_dstb_act Vbx_inj_dstb_phs1 Vbx_inj_dstb_phs2 Vbx_inj_re_phs_req Vbx_mdf1_cmd_mem Vbx_mdf2_cmd_mem Vbx_mis_inj_re_phs_done Vbx_rich_cl_cylr_mem Vbx_run_cylr_mem Vbx_tdc_re_syn_ctr_req Vbx_tolo Vxx_clu_stal_ctr_ini Vxx_cylr_clc_ctr_yy Vxx_cylr_ctl_phs Vxx_cylr_id_sta_ofs Vxx_cylr_iga_mem Vxx_cylr_is_clc_ctr_yy Vxx_cylr_is_max_tq_dec_yy Vxx_cylr_is_min_tq_dec_yy Vxx_cylr_is_run_test_ctr Vxx_cylr_is_vld_ctr_ini Vxx_cylr_max_n_yy Vxx_cylr_max_prs_yy Vxx_cylr_max_tq_dec_yy Vxx_cylr_min_n_yy Vxx_cylr_min_prs_yy Vxx_cylr_min_tq_dec_yy Vxx_cylr_ok_aftr_stal_ctr_ini Vxx_cylr_ok_ctr_ini Vxx_cylr_prs_stab_dif Vxx_cylr_stab_ctr_yy Vxx_cylr_stab_is_ctr_yy Vxx_cylr_tdc_ctr Vxx_cylr_test_ctr Vxx_dyn_re_phs_ofs Vxx_err_cylr_ctr_ini Vxx_err_cylr_is_run_ctr_ini Vxx_err_id_is_run_ctr_ini Vxx_inj_mov_ofs Vxx_is_cylr_ok_ctr_ini Vxx_map_cor Vxx_n_cylr_mem Vxx_no_deci_cylr_ctr_ini Vxx_no_deci_id_is_ctr_ini Vxx_prs_cylr_mem Vxx_run_re_phs_ctr_ini Vxx_ti_cylr_mem Vxx_tq_dec Vxx_trz_cylr_mem /end OUT_MEASUREMENT
/end FUNCTION
/begin FUNCTION InSmiSyn_Spdmfxx "" /begin OUT_MEASUREMENT Vxx_n_tdc_2 Vxx_n_tdc_4 /end OUT_MEASUREMENT /end FUNCTION
/begin FUNCTION InSmiSyn_Schedul "" /begin DEF_CHARACTERISTIC Cbx_in_vvtc_abst_pres_cfm /end DEF_CHARACTERISTIC /begin OUT_MEASUREMENT Vbx_in_vvt_cfm /end OUT_MEASUREMENT /end FUNCTION
/begin FUNCTION OuVfoSup ""
 /begin SUB_FUNCTION OuVfoSup_Actuaxx OuVfoSup_Pwsxxxx OuVfoSup_Pws3xxx OuVfoSup_Pwsxvld OuVfoSup_Pwlrtnx /end SUB_FUNCTION
/end FUNCTION
/begin FUNCTION OuVfoSup_Actuaxx ""
 /begin DEF_CHARACTERISTIC Cbx_l_pwl_conf Cxx_dfdec_actr_rly_oc Cxx_dfdec_actr_rly_scg Cxx_dfdec_actr_rly_scw Cxx_dfinc_actr_rly_oc Cxx_dfinc_actr_rly_scg Cxx_dfinc_actr_rly_scw Cxx_min_pwl_dly Cxx_pwl_dly Cxx_pwl_dly_pws_max Cxx_pwl_dly_secu /end DEF_CHARACTERISTIC
 /begin OUT_MEASUREMENT Vbx_actr_rly_cmd Vbx_max_ecu_pws Vbx_min_ecu_pws Vbx_pwl_dly_pws Vbx_pwl_dly_secu Vbx_pwl_on Vbx_rly_cmd_req Vsx_actr_rly_vld Vxx_pwl_dly Vxx_pwl_dly_pws /end OUT_MEASUREMENT
/end FUNCTION
/begin FUNCTION OuVfoSup_Pwsxxxx ""
 /begin DEF_CHARACTERISTIC Cxx_dfdec_pws_1_h Cxx_dfdec_pws_1_l Cxx_dfdec_pws_2_h Cxx_dfdec_pws_2_l Cxx_dfinc_pws_1_h Cxx_dfinc_pws_1_l Cxx_dfinc_pws_2_h Cxx_dfinc_pws_2_l /end DEF_CHARACTERISTIC
 /begin OUT_MEASUREMENT Vsx_pws_1_vld Vsx_pws_2_vld Vxx_pws_1 Vxx_pws_2 /end OUT_MEASUREMENT
/end FUNCTION
/begin FUNCTION OuVfoSup_Pws3xxx ""
 /begin DEF_CHARACTERISTIC Cxx_dfdec_pws_3_h Cxx_dfdec_pws_3_l Cxx_dfinc_pws_3_h Cxx_dfinc_pws_3_l /end DEF_CHARACTERISTIC
 /begin OUT_MEASUREMENT Vsx_pws_3_vld Vxx_pws_3 /end OUT_MEASUREMENT
/end FUNCTION
/begin FUNCTION OuVfoSup_Pwsxvld ""
 /begin OUT_MEASUREMENT Vsx_pws_sens_ac_prs_vld Vsx_pws_sens_acel_pdl_v1_vld Vsx_pws_sens_acel_pdl_v2_vld Vsx_pws_sens_it_vld Vsx_pws_sens_lbdw_vld Vsx_pws_sens_lbup_vld Vsx_pws_sens_map_vld Vsx_pws_sens_rvac_vld Vsx_pws_sens_spg_vld Vxx_pws_sens_it /end OUT_MEASUREMENT
/end FUNCTION
/begin FUNCTION OuVfoSup_Pwlrtnx "" /begin OUT_MEASUREMENT Vbx_rest_pwl_rtn /end OUT_MEASUREMENT /end FUNCTION
/begin FUNCTION InPciBki ""
 /begin OUT_MEASUREMENT Vxx_brk_pdl_clos_blk_off_dly Vxx_brk_pdl_clos_blk_on_dly Vxx_brk_pdl_open_blk_off_dly Vxx_brk_pdl_open_blk_on_dly Vbx_sens_brk_pdl_open_lk_stt /end OUT_MEASUREMENT
 /begin SUB_FUNCTION InPciBki_Absxxcs InPciBki_Brk1xcs InPciBki_Cnbkocs InPciBki_Bpkxxcs /end SUB_FUNCTION
/end FUNCTION
/begin FUNCTION InPciBki_Absxxcs "" /begin OUT_MEASUREMENT Vbx_abs_reg /end OUT_MEASUREMENT /end FUNCTION
/begin FUNCTION InPciBki_Brk1xcs "" /begin OUT_MEASUREMENT Vsx_brk_pdl Vsx_brk_pdl_cru_vld Vsx_brk_pdl_vld /end OUT_MEASUREMENT /end FUNCTION
/begin FUNCTION InPciBki_Cnbkocs "" /begin DEF_CHARACTERISTIC Cxx_sens_brk_lk_vb_dly Cxx_sens_brk_lk_vb_thd /end DEF_CHARACTERISTIC /begin OUT_MEASUREMENT Vsx_brk_pdl_open Vsx_brk_pdl_open_vld /end OUT_MEASUREMENT /end FUNCTION
/begin FUNCTION InPciBki_Bpkxxcs "" /begin OUT_MEASUREMENT Vbx_bpk /end OUT_MEASUREMENT /end FUNCTION
/begin FUNCTION InPciEsp "" /begin SUB_FUNCTION InPciEsp_Absctxx_xxxxxx InPciEsp_Espxxcs_xxxxxx /end SUB_FUNCTION /end FUNCTION
/end MODULE
/end PROJECT
