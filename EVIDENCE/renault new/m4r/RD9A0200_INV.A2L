ASAP2_VERSION 1 41
/begin PROJECT RD8 "_default_ProjectLongIdentifier"
/begin HEADER "_default_HeaderComment" PROJECT_NO RD9 /end HEADER
/begin MODULE _default_ModuleName "_default_ModuleLongIdentifier"
/begin MOD_COMMON "_default_ModCommonComment" DEPOSIT ABSOLUTE BYTE_ORDER MSB_LAST ALIGNMENT_BYTE 1 ALIGNMENT_WORD 2 ALIGNMENT_LONG 2 ALIGNMENT_FLOAT32_IEEE 2 ALIGNMENT_FLOAT64_IEEE 4 /end MOD_COMMON
/begin CHARACTERISTIC Cmp_eal_n_lamb_v_alco "Map of command voltage for the downstream lambda sensor (alcohol setting)" MAP 0xa0028540 _REC_A1MAP_20_u2_u2_u2 25000. _CNV_A_R_LINEAR_____107_CM 0. 25000. FORMAT "%5.0"
 /begin AXIS_DESCR COM_AXIS Vxx_eal _CNV_A_R_LINEAR_____53_CM 16 0. 3.99993896484375 FORMAT "%10.8" AXIS_PTS_REF Ctb_eal /end AXIS_DESCR
 /begin AXIS_DESCR COM_AXIS Vxx_n _CNV_A_R_ENSD_LINEA_22_CM 9 0. 16383.75 FORMAT "%8.2" AXIS_PTS_REF Ctb_n2 /end AXIS_DESCR
/end CHARACTERISTIC
/begin CHARACTERISTIC Cmp_n_eal_ti_ofs1_alco "Map of offset to be applied on richness closed loop. Vehicule stopped. (Exotic fuel settings)" MAP 0xa0028660 _REC_A1MAP_20_u2_u2_u2 0.666656493949999 _CNV_A_R_LINEAR_____108_CM -0.333333333238019 0.33332316071198 FORMAT "%8.5"
 /begin AXIS_DESCR COM_AXIS Vxx_eal _CNV_A_R_LINEAR_____53_CM 16 0. 3.99993896484375 FORMAT "%10.8" AXIS_PTS_REF Ctb_eal /end AXIS_DESCR
 /begin AXIS_DESCR COM_AXIS Vxx_n _CNV_A_R_ENSD_LINEA_22_CM 9 0. 16383.75 FORMAT "%8.2" AXIS_PTS_REF Ctb_n2 /end AXIS_DESCR
/end CHARACTERISTIC
/begin CHARACTERISTIC Cmp_n_eal_ti_ofs2_alco "Map of offset to be applied on richness closed loop. Vehicule running. (Exotic fuel settings)" MAP 0xa0028780 _REC_A1MAP_20_u2_u2_u2 0.666656493949999 _CNV_A_R_LINEAR_____108_CM -0.333333333238019 0.33332316071198 FORMAT "%8.5"
 /begin AXIS_DESCR COM_AXIS Vxx_eal _CNV_A_R_LINEAR_____53_CM 16 0. 3.99993896484375 FORMAT "%10.8" AXIS_PTS_REF Ctb_eal /end AXIS_DESCR
 /begin AXIS_DESCR COM_AXIS Vxx_n _CNV_A_R_ENSD_LINEA_22_CM 9 0. 16383.75 FORMAT "%8.2" AXIS_PTS_REF Ctb_n2 /end AXIS_DESCR
/end CHARACTERISTIC
/begin CHARACTERISTIC Cmp_n_eal_ti_p_cor_alco "Proportional term for Vxx_cl_ti_fac _fct(n,eal) in exotic fuel mode" MAP 0xa00288a0 _REC_A1MAP_20_u1_u2_u2 0.33203125 _CNV_A_R_LINEAR_____109_CM 0. 0.33203125 FORMAT "%8.6"
 /begin AXIS_DESCR COM_AXIS Vxx_n _CNV_A_R_ENSD_LINEA_22_CM 9 0. 16383.75 FORMAT "%8.2" AXIS_PTS_REF Ctb_n2 /end AXIS_DESCR
 /begin AXIS_DESCR COM_AXIS Vxx_eal _CNV_A_R_LINEAR_____53_CM 9 0. 3.99993896484375 FORMAT "%10.8" AXIS_PTS_REF Ctb_eal2 /end AXIS_DESCR
/end CHARACTERISTIC
/begin CHARACTERISTIC Cmp_n_tco_eal_fl_thd_alco "Map of EAL inducing full load conditions, depending on engine speed and water temp. (exotic fuel)" MAP 0xa00288f4 _REC_A1MAP_20_u2_u2_u2 3.99993896484375 _CNV_A_R_LINEAR_____53_CM 0. 3.99993896484375 FORMAT "%7.5"
 /begin AXIS_DESCR COM_AXIS Vxx_tco _CNV_A_R_LINEAR_____110_CM 13 -40. 200. FORMAT "%5.1" AXIS_PTS_REF Ctb_tco_cl_off /end AXIS_DESCR
 /begin AXIS_DESCR COM_AXIS Vxx_n _CNV_A_R_ENSD_LINEA_22_CM 20 0. 16383.75 FORMAT "%8.2" AXIS_PTS_REF Ctb_n /end AXIS_DESCR
/end CHARACTERISTIC
/begin CHARACTERISTIC Cmp_wet_dep_fac_tco00_alco "Map of fuel film factor for a 0°C water température for flex-fuel" MAP 0xa0028afc _REC_A1MAP_20_u1_u2_u2 2550. _CNV_A_R_LINEAR_____111_CM 0. 2550. FORMAT "%4.0"
 /begin AXIS_DESCR COM_AXIS Vxx_eal _CNV_A_R_LINEAR_____53_CM 9 0. 3.99993896484375 FORMAT "%7.5" AXIS_PTS_REF Ctb_wet_eal /end AXIS_DESCR
 /begin AXIS_DESCR COM_AXIS Vxx_n _CNV_A_R_ENSD_LINEA_22_CM 5 0. 16383.75 FORMAT "%8.2" AXIS_PTS_REF Ctb_wet_n /end AXIS_DESCR
/end CHARACTERISTIC
/begin CHARACTERISTIC Cmp_wet_dep_fac_tco20_alco "Map of fuel film factor for a 20°C water temperature for flex-fuel" MAP 0xa0028b2c _REC_A1MAP_20_u1_u2_u2 2550. _CNV_A_R_LINEAR_____111_CM 0. 2550. FORMAT "%4.0"
 /begin AXIS_DESCR COM_AXIS Vxx_eal _CNV_A_R_LINEAR_____53_CM 9 0. 3.99993896484375 FORMAT "%7.5" AXIS_PTS_REF Ctb_wet_eal /end AXIS_DESCR
 /begin AXIS_DESCR COM_AXIS Vxx_n _CNV_A_R_ENSD_LINEA_22_CM 5 0. 16383.75 FORMAT "%8.2" AXIS_PTS_REF Ctb_wet_n /end AXIS_DESCR
/end CHARACTERISTIC
/begin CHARACTERISTIC Cmp_wet_dep_fac_tco40_alco "Map of fuel film factor for a 40°C water temperature for flex-fuel" MAP 0xa0028b5c _REC_A1MAP_20_u1_u2_u2 2550. _CNV_A_R_LINEAR_____111_CM 0. 2550. FORMAT "%4.0"
 /begin AXIS_DESCR COM_AXIS Vxx_eal _CNV_A_R_LINEAR_____53_CM 9 0. 3.99993896484375 FORMAT "%7.5" AXIS_PTS_REF Ctb_wet_eal /end AXIS_DESCR
 /begin AXIS_DESCR COM_AXIS Vxx_n _CNV_A_R_ENSD_LINEA_22_CM 5 0. 16383.75 FORMAT "%8.2" AXIS_PTS_REF Ctb_wet_n /end AXIS_DESCR
/end CHARACTERISTIC
/begin CHARACTERISTIC Cmp_wet_dep_fac_tco60_alco "Map of fuel film factor for a 60°C water temperature for flex-fuel" MAP 0xa0028b8c _REC_A1MAP_20_u1_u2_u2 2550. _CNV_A_R_LINEAR_____111_CM 0. 2550. FORMAT "%4.0"
 /begin AXIS_DESCR COM_AXIS Vxx_eal _CNV_A_R_LINEAR_____53_CM 9 0. 3.99993896484375 FORMAT "%7.5" AXIS_PTS_REF Ctb_wet_eal /end AXIS_DESCR
 /begin AXIS_DESCR COM_AXIS Vxx_n _CNV_A_R_ENSD_LINEA_22_CM 5 0. 16383.75 FORMAT "%8.2" AXIS_PTS_REF Ctb_wet_n /end AXIS_DESCR
/end CHARACTERISTIC
/begin CHARACTERISTIC Cmp_wet_dep_fac_tco80_alco "Map of fuel film factor for a 80°C water temperature for flex-fuel" MAP 0xa0028bbc _REC_A1MAP_20_u1_u2_u2 2550. _CNV_A_R_LINEAR_____111_CM 0. 2550. FORMAT "%4.0"
 /begin AXIS_DESCR COM_AXIS Vxx_eal _CNV_A_R_LINEAR_____53_CM 9 0. 3.99993896484375 FORMAT "%7.5" AXIS_PTS_REF Ctb_wet_eal /end AXIS_DESCR
 /begin AXIS_DESCR COM_AXIS Vxx_n _CNV_A_R_ENSD_LINEA_22_CM 5 0. 16383.75 FORMAT "%8.2" AXIS_PTS_REF Ctb_wet_n /end AXIS_DESCR
/end CHARACTERISTIC
/begin CHARACTERISTIC Cmp_wet_fil_fac_tco00_alco "Map of dynamic filter factors in acceleration for a 0°C water temperature for flex-fuel" MAP 0xa0028bec _REC_A1MAP_20_u1_u2_u2 9.9609375e-002 _CNV_A_R_LINEAR_____112_CM 0. 9.9609375e-002 FORMAT "%6.4"
 /begin AXIS_DESCR COM_AXIS Vxx_eal _CNV_A_R_LINEAR_____53_CM 9 0. 3.99993896484375 FORMAT "%7.5" AXIS_PTS_REF Ctb_wet_eal /end AXIS_DESCR
 /begin AXIS_DESCR COM_AXIS Vxx_n _CNV_A_R_ENSD_LINEA_22_CM 5 0. 16383.75 FORMAT "%8.2" AXIS_PTS_REF Ctb_wet_n /end AXIS_DESCR
/end CHARACTERISTIC
/begin CHARACTERISTIC Cmp_wet_fil_fac_tco20_alco "Map of dynamic filter factors in acceleration for a 20°C water temperature for flex-fuel" MAP 0xa0028c1c _REC_A1MAP_20_u1_u2_u2 9.9609375e-002 _CNV_A_R_LINEAR_____112_CM 0. 9.9609375e-002 FORMAT "%6.4"
 /begin AXIS_DESCR COM_AXIS Vxx_eal _CNV_A_R_LINEAR_____53_CM 9 0. 3.99993896484375 FORMAT "%7.5" AXIS_PTS_REF Ctb_wet_eal /end AXIS_DESCR
 /begin AXIS_DESCR COM_AXIS Vxx_n _CNV_A_R_ENSD_LINEA_22_CM 5 0. 16383.75 FORMAT "%8.2" AXIS_PTS_REF Ctb_wet_n /end AXIS_DESCR
/end CHARACTERISTIC
/begin CHARACTERISTIC Cmp_wet_fil_fac_tco40_alco "Map of dynamic filter factors in acceleration for a 40°C water temperature for flex-fuel" MAP 0xa0028c4c _REC_A1MAP_20_u1_u2_u2 9.9609375e-002 _CNV_A_R_LINEAR_____112_CM 0. 9.9609375e-002 FORMAT "%6.4"
 /begin AXIS_DESCR COM_AXIS Vxx_eal _CNV_A_R_LINEAR_____53_CM 9 0. 3.99993896484375 FORMAT "%7.5" AXIS_PTS_REF Ctb_wet_eal /end AXIS_DESCR
 /begin AXIS_DESCR COM_AXIS Vxx_n _CNV_A_R_ENSD_LINEA_22_CM 5 0. 16383.75 FORMAT "%8.2" AXIS_PTS_REF Ctb_wet_n /end AXIS_DESCR
/end CHARACTERISTIC
/begin CHARACTERISTIC Cmp_wet_fil_fac_tco60_alco "Map of dynamic filter factors in acceleration for a 60°C water temperature for flex-fuel" MAP 0xa0028c7c _REC_A1MAP_20_u1_u2_u2 9.9609375e-002 _CNV_A_R_LINEAR_____112_CM 0. 9.9609375e-002 FORMAT "%6.4"
 /begin AXIS_DESCR COM_AXIS Vxx_eal _CNV_A_R_LINEAR_____53_CM 9 0. 3.99993896484375 FORMAT "%7.5" AXIS_PTS_REF Ctb_wet_eal /end AXIS_DESCR
 /begin AXIS_DESCR COM_AXIS Vxx_n _CNV_A_R_ENSD_LINEA_22_CM 5 0. 16383.75 FORMAT "%8.2" AXIS_PTS_REF Ctb_wet_n /end AXIS_DESCR
/end CHARACTERISTIC
/begin CHARACTERISTIC Cmp_wet_fil_fac_tco80_alco "Map of dynamic filter factors in acceleration for a 80°C water temperature for flex-fuel" MAP 0xa0028cac _REC_A1MAP_20_u1_u2_u2 9.9609375e-002 _CNV_A_R_LINEAR_____112_CM 0. 9.9609375e-002 FORMAT "%6.4"
 /begin AXIS_DESCR COM_AXIS Vxx_eal _CNV_A_R_LINEAR_____53_CM 9 0. 3.99993896484375 FORMAT "%7.5" AXIS_PTS_REF Ctb_wet_eal /end AXIS_DESCR
 /begin AXIS_DESCR COM_AXIS Vxx_n _CNV_A_R_ENSD_LINEA_22_CM 5 0. 16383.75 FORMAT "%8.2" AXIS_PTS_REF Ctb_wet_n /end AXIS_DESCR
/end CHARACTERISTIC
/begin CHARACTERISTIC Ctp_cl_t_alco "Table giving the minimum time before closing richness loop, depending on water temp for alcool" CURVE 0xa0028cdc _REC_A1CUR_20_u2_u2 6553.5 _CNV_A_R_LINEAR_____58_CM 0. 6553.5 FORMAT "%6.1"
 /begin AXIS_DESCR COM_AXIS Vxx_tco _CNV_A_R_LINEAR_____110_CM 13 -40. 200. FORMAT "%5.1" AXIS_PTS_REF Ctb_tco_cl_off /end AXIS_DESCR
/end CHARACTERISTIC
/begin CHARACTERISTIC Ctp_eal_l_ti_i_cor_alco "Corrective factor depending on engine air load for integral term. For exotic fuel" CURVE 0xa0028cf8 _REC_A1CUR_20_u1_u2 1.9921875 _CNV_A_R_LINEAR_____42_CM 0. 1.9921875 FORMAT "%8.6"
 /begin AXIS_DESCR COM_AXIS Vxx_eal _CNV_A_R_LINEAR_____53_CM 16 0. 3.99993896484375 FORMAT "%10.8" AXIS_PTS_REF Ctb_eal /end AXIS_DESCR
/end CHARACTERISTIC
/begin CHARACTERISTIC Ctp_eal_l_ti_i_cor_lean_alco "Corrective factor depending on engine air load for integral term. in learn settings for exotic fuel" CURVE 0xa0028d08 _REC_A1CUR_20_u1_u2 1.9921875 _CNV_A_R_LINEAR_____42_CM 0. 1.9921875 FORMAT "%8.6"
 /begin AXIS_DESCR COM_AXIS Vxx_eal _CNV_A_R_LINEAR_____53_CM 16 0. 3.99993896484375 FORMAT "%10.8" AXIS_PTS_REF Ctb_eal /end AXIS_DESCR
/end CHARACTERISTIC
/begin CHARACTERISTIC Ctp_n_dly_ofs_dly_alco "Table indicating delay before full load application. (exotic fuel)" CURVE 0xa0028d18 _REC_A1CUR_20_u2_u2 6553.5 _CNV_A_R_LINEAR_____58_CM 0. 6553.5 FORMAT "%6.1"
 /begin AXIS_DESCR COM_AXIS Vxx_n _CNV_A_R_ENSD_LINEA_22_CM 9 0. 16383.75 FORMAT "%8.2" AXIS_PTS_REF Ctb_n2 /end AXIS_DESCR
/end CHARACTERISTIC
/begin CHARACTERISTIC Ctp_n_l_ti_i_alco "Table of Integral factor to be applied on Vxx_cl_ti_fac in normal conditions. for exotic fuel" CURVE 0xa0028d2c _REC_A1CUR_20_u1_u2 2.593994140625e-003 _CNV_A_R_LINEAR_____50_CM 0. 2.593994140625e-003 FORMAT "%10.8"
 /begin AXIS_DESCR COM_AXIS Vxx_n _CNV_A_R_ENSD_LINEA_22_CM 9 0. 16383.75 FORMAT "%8.2" AXIS_PTS_REF Ctb_n2 /end AXIS_DESCR
/end CHARACTERISTIC
/begin CHARACTERISTIC Ctp_n_l_ti_i_lean_alco "Table of Integral factor to be applied on Vxx_cl_ti_fac in normal conditions. lean settings exotic fuel" CURVE 0xa0028d38 _REC_A1CUR_20_u1_u2 2.593994140625e-003 _CNV_A_R_LINEAR_____50_CM 0. 2.593994140625e-003 FORMAT "%10.8"
 /begin AXIS_DESCR COM_AXIS Vxx_n _CNV_A_R_ENSD_LINEA_22_CM 9 0. 16383.75 FORMAT "%8.2" AXIS_PTS_REF Ctb_n2 /end AXIS_DESCR
/end CHARACTERISTIC
/begin CHARACTERISTIC Ctp_tco_cl2_ena_ctr_alco "Table of the necessary tdc number to warm up the catalyst for alcohol" CURVE 0xa0028d44 _REC_A1CUR_20_u2_u2 65535. _CNV_A_R_ECME_LINEA_0_CM 0. 65535. FORMAT "%5.0"
 /begin AXIS_DESCR COM_AXIS Vxx_tco _CNV_A_R_LINEAR_____110_CM 9 -40. 200. FORMAT "%5.1" AXIS_PTS_REF Ctb_tco2 /end AXIS_DESCR
/end CHARACTERISTIC
/begin CHARACTERISTIC Ctp_wet_acel_cor_fac_alco "Table of corrective factors in acceleration for flex-fuel" CURVE 0xa0028d58 _REC_A1CUR_20_u2_u2 65.536 _CNV_A_R_LINEAR_____113_CM 0. 65.536 FORMAT "%4.3"
 /begin AXIS_DESCR COM_AXIS Vxx_tco _CNV_A_R_LINEAR_____110_CM 17 -40. 200. FORMAT "%5.1" AXIS_PTS_REF Ctb_wet_tco_17 /end AXIS_DESCR
/end CHARACTERISTIC
/begin CHARACTERISTIC Ctp_wet_decl_cor_fac_alco "Table of corrective factors in deceleration for flex-fuel" CURVE 0xa0028d7c _REC_A1CUR_20_u2_u2 65.536 _CNV_A_R_LINEAR_____113_CM 0. 65.536 FORMAT "%4.3"
 /begin AXIS_DESCR COM_AXIS Vxx_tco _CNV_A_R_LINEAR_____110_CM 17 -40. 200. FORMAT "%5.1" AXIS_PTS_REF Ctb_wet_tco_17 /end AXIS_DESCR
/end CHARACTERISTIC
/begin CHARACTERISTIC Ctp_wet_decl_fil_fac_alco "Table of dynamic filter factors in deceleration for flex-fuel" CURVE 0xa0028da0 _REC_A1CUR_20_u1_u2 9.9609375e-002 _CNV_A_R_LINEAR_____112_CM 0. 9.9609375e-002 FORMAT "%6.4"
 /begin AXIS_DESCR COM_AXIS Vxx_tco _CNV_A_R_LINEAR_____110_CM 17 -40. 200. FORMAT "%5.1" AXIS_PTS_REF Ctb_wet_tco_17 /end AXIS_DESCR
/end CHARACTERISTIC
/begin CHARACTERISTIC Ctp_wet_ini_acel_cor_ofs_alco "Table of specific corrective offset in case of first acceleration for flex-fuel" CURVE 0xa0028db4 _REC_A1CUR_20_u2_u2 65.53400000000001 _CNV_A_R_LINEAR_____113_CM 0. 65.53400000000001 FORMAT "%4.3"
 /begin AXIS_DESCR COM_AXIS Vxx_tco _CNV_A_R_LINEAR_____110_CM 17 -40. 200. FORMAT "%5.1" AXIS_PTS_REF Ctb_wet_tco_17 /end AXIS_DESCR
/end CHARACTERISTIC
/begin CHARACTERISTIC Ctp_wet_vol_dif_thd_acel_alco "Threshold to apply the wall wetting correction in acceleration for flex-fuel" CURVE 0xa0028dd8 _REC_A1CUR_20_u2_u2 1000. _CNV_A_R_LINEAR_____114_CM 0. 1000. FORMAT "%6.1"
 /begin AXIS_DESCR COM_AXIS Vxx_tco _CNV_A_R_LINEAR_____110_CM 9 -40. 200. FORMAT "%5.1" AXIS_PTS_REF Ctb_wet_tco_9 /end AXIS_DESCR
/end CHARACTERISTIC
/begin CHARACTERISTIC Ctp_wet_vol_dif_thd_decl_alco "Threshold to apply the wall wetting correction in deceleration for flex-fuel" CURVE 0xa0028dec _REC_A1CUR_20_u2_u2 1000. _CNV_A_R_LINEAR_____114_CM 0. 1000. FORMAT "%6.1"
 /begin AXIS_DESCR COM_AXIS Vxx_tco _CNV_A_R_LINEAR_____110_CM 9 -40. 200. FORMAT "%5.1" AXIS_PTS_REF Ctb_wet_tco_9 /end AXIS_DESCR
/end CHARACTERISTIC
/begin CHARACTERISTIC Ctp_wet_vol_dif_thd_sta_alco "Threshold to apply the wall wetting correction in a specific after start time for flex-fuel" CURVE 0xa0028e00 _REC_A1CUR_20_u2_u2 1000. _CNV_A_R_LINEAR_____114_CM 0. 1000. FORMAT "%6.1"
 /begin AXIS_DESCR COM_AXIS Vxx_tco _CNV_A_R_LINEAR_____110_CM 9 -40. 200. FORMAT "%5.1" AXIS_PTS_REF Ctb_wet_tco_9 /end AXIS_DESCR
/end CHARACTERISTIC
/begin MEASUREMENT Vxx_cl_t_alco "minimum time before closing richness loop, depending on water temp using alcool" UWORD _CNV_A_R_LINEAR_____58_CM 1 0. 0. 6553.5 ECU_ADDRESS 0xd0003fd0 FORMAT "%6.1" /end MEASUREMENT
/begin MEASUREMENT Vxx_dly_ofs_dly_alco "delay before full load application. (exotic fuel)" UWORD _CNV_A_R_LINEAR_____58_CM 1 0. 0. 6553.5 ECU_ADDRESS 0xd0003fd2 FORMAT "%6.1" /end MEASUREMENT
/begin MEASUREMENT Vxx_eal_fl_thd_alco "EAL inducing full load conditions (exotic fuel)" UWORD _CNV_A_R_LINEAR_____53_CM 1 0. 0. 3.99993896484375 ECU_ADDRESS 0xd0003fd4 FORMAT "%7.5" /end MEASUREMENT
/begin MEASUREMENT Vxx_eal_n_lamb_v_alco "Map of command voltage of the loop down for alcohol (fonction of engine air load and engine speed)" UWORD _CNV_A_R_LINEAR_____107_CM 1 0. 0. 25000. ECU_ADDRESS 0xd0003fd6 FORMAT "%5.0" /end MEASUREMENT
/begin MEASUREMENT Vxx_rich_cl_eal_i_cor_alco "Corrective factor depending on engine air load for integral term. For exotic fuel" UBYTE _CNV_A_R_LINEAR_____42_CM 1 0. 0. 1.9921875 ECU_ADDRESS 0xd0006735 FORMAT "%8.6" /end MEASUREMENT
/begin MEASUREMENT Vxx_rich_cl_eal_i_cor_lean_alco "Corrective factor depending on engine air load for integral term. in lean settings for exotic fuel" UBYTE _CNV_A_R_LINEAR_____42_CM 1 0. 0. 1.9921875 ECU_ADDRESS 0xd0006736 FORMAT "%8.6" /end MEASUREMENT
/begin MEASUREMENT Vxx_rich_cl_n_i_alco "Integral factor to be applied on Vxx_cl_ti_fac in normal conditions. for exotic fuel" UBYTE _CNV_A_R_LINEAR_____50_CM 1 0. 0. 2.593994140625e-003 ECU_ADDRESS 0xd0006737 FORMAT "%7.5" /end MEASUREMENT
/begin MEASUREMENT Vxx_rich_cl_n_i_lean_alco "Integral factor to be applied on Vxx_cl_ti_fac in normal conditions. lean settings exotic fuel" UBYTE _CNV_A_R_LINEAR_____50_CM 1 0. 0. 2.593994140625e-003 ECU_ADDRESS 0xd0006738 FORMAT "%7.5" /end MEASUREMENT
/begin MEASUREMENT Vxx_rich_cl_p_cor_alco "Proportional term for Vxx_cl_ti_fac fct in exotic fuel mode" UBYTE _CNV_A_R_LINEAR_____109_CM 1 0. 0. 0.33203125 ECU_ADDRESS 0xd0006739 FORMAT "%8.6" /end MEASUREMENT
/begin MEASUREMENT Vxx_rich_cl_ti_ofs1_alco "offset to be applied on richness closed loop. Vehicule stopped. (Exotic fuel settings)" UWORD _CNV_A_R_LINEAR_____108_CM 1 0. -0.333333333238019 0.33332316071198 ECU_ADDRESS 0xd0003fd8 FORMAT "%8.5" /end MEASUREMENT
/begin MEASUREMENT Vxx_rich_cl_ti_ofs2_alco "offset to be applied on richness closed loop. Vehicule running. (Exotic fuel settings)" UWORD _CNV_A_R_LINEAR_____108_CM 1 0. -0.333333333238019 0.33332316071198 ECU_ADDRESS 0xd0003fda FORMAT "%8.5" /end MEASUREMENT
/begin MEASUREMENT Vxx_tco_cl2_ena_ctr_alco "Number of tdc to warm up the catalyst for alcohol" UWORD _CNV_A_R_ECME_LINEA_0_CM 1 0. 0. 65535. ECU_ADDRESS 0xd0003fdc FORMAT "%5.0" /end MEASUREMENT
/begin MEASUREMENT Vxx_wet_acel_cor_fac_alco "Corrective factor for wall wetting correction in acceleration for flex-fuel" UWORD _CNV_A_R_LINEAR_____113_CM 1 0. 0. 65.536 ECU_ADDRESS 0xd000510e FORMAT "%4.3" /end MEASUREMENT
/begin MEASUREMENT Vxx_wet_decl_cor_fac_alco "Corrective factor for wall wetting correction in deceleration for flex-fuel" UWORD _CNV_A_R_LINEAR_____113_CM 1 0. 0. 65.536 ECU_ADDRESS 0xd0005110 FORMAT "%4.3" /end MEASUREMENT
/begin MEASUREMENT Vxx_wet_dep_fac_alco "Gain for the calculation of the stabilized fuel film for flex-fuel" UBYTE _CNV_A_R_LINEAR_____111_CM 1 0. 0. 2550. ECU_ADDRESS 0xd000673a FORMAT "%4.0" /end MEASUREMENT
/begin MEASUREMENT Vxx_wet_fil_fac_acel_alco "Dynamic filter factor of the fuel film in acceleration for flex-fuel" UBYTE _CNV_A_R_LINEAR_____112_CM 1 0. 0. 9.9609375e-002 ECU_ADDRESS 0xd000673b FORMAT "%6.4" /end MEASUREMENT
/begin MEASUREMENT Vxx_wet_fil_fac_decl_alco "Dynamic filter factor of the fuel film in deceleration for flex-fuel" UBYTE _CNV_A_R_LINEAR_____112_CM 1 0. 0. 9.9609375e-002 ECU_ADDRESS 0xd000673c FORMAT "%6.4" /end MEASUREMENT
/begin MEASUREMENT Vxx_wet_ini_acel_cor_ofs_alco "Specific corrective offset in case of first acceleration for flex-fuel" UWORD _CNV_A_R_LINEAR_____113_CM 1 0. 0. 65.53400000000001 ECU_ADDRESS 0xd0003fde FORMAT "%4.3" /end MEASUREMENT
/begin MEASUREMENT Vxx_wet_vol_dif_thd_acel_alco "Threshold to apply the wall wetting correction in acceleration for flex-fuel" UWORD _CNV_A_R_LINEAR_____114_CM 1 0. 0. 1000. ECU_ADDRESS 0xd0005112 FORMAT "%6.1" /end MEASUREMENT
/begin MEASUREMENT Vxx_wet_vol_dif_thd_decl_alco "Threshold to apply the wall wetting correction in deceleration for flex-fuel" UWORD _CNV_A_R_LINEAR_____114_CM 1 0. 0. 1000. ECU_ADDRESS 0xd0005114 FORMAT "%6.1" /end MEASUREMENT
/begin MEASUREMENT Vxx_wet_vol_dif_thd_sta_alco "Threshold to apply the wall wetting correction in a specific after start time for flex-fuel" UWORD _CNV_A_R_LINEAR_____114_CM 1 0. 0. 1000. ECU_ADDRESS 0xd0005116 FORMAT "%6.1" /end MEASUREMENT
/begin CHARACTERISTIC Cbx_tco_vlv_temp_cl_off "Enables the usage of Vxx_vlv_air_temp for the richness close loop delay after start instead of Vxx_tco" VALUE 0xa0020e7b _REC_S1VAL_20_u1 1. _CNV_A_R_ECME_LINEA_0_CM 0. 1. FORMAT "%1.0" BIT_MASK 0x1 /end CHARACTERISTIC
/begin AXIS_PTS Ctb_eal2 "9 breakpoint table for Engine air load" 0xa0028f60 Vxx_eal _REC_A2AXS_20_u2 3.99993896484375 _CNV_A_R_LINEAR_____53_CM 9 0. 3.99993896484375 FORMAT "%10.8" /end AXIS_PTS
/begin AXIS_PTS Ctb_tco_cl_off "13 breakpoint table for richness closed loop" 0xa0029334 Vxx_tco _REC_A2AXS_20_u2 240. _CNV_A_R_LINEAR_____110_CM 13 -40. 200. FORMAT "%5.1" /end AXIS_PTS
/begin AXIS_PTS Ctb_wet_eal "9 eal breakpoints table for wall wetting" 0xa0029bfc Vxx_eal _REC_A2AXS_20_u2 3.99993896484375 _CNV_A_R_LINEAR_____53_CM 9 0. 3.99993896484375 FORMAT "%7.5" /end AXIS_PTS
/begin AXIS_PTS Ctb_wet_n "5 RPM breakpoints table for wall wetting" 0xa0029c1c Vxx_n _REC_A2AXS_20_u2 16383.75 _CNV_A_R_ENSD_LINEA_22_CM 5 0. 16383.75 FORMAT "%8.2" /end AXIS_PTS
/begin AXIS_PTS Ctb_wet_tco_17 "17 water temperature breakpoints table for wall wetting" 0xa0029c28 Vxx_tco _REC_A2AXS_20_u2 240. _CNV_A_R_LINEAR_____110_CM 17 -40. 200. FORMAT "%5.1" /end AXIS_PTS
/begin AXIS_PTS Ctb_wet_tco_9 "9 water temperature breakpoints table for wall wetting" 0xa0029c4c Vxx_tco _REC_A2AXS_20_u2 240. _CNV_A_R_LINEAR_____110_CM 9 -40. 200. FORMAT "%5.1" /end AXIS_PTS
/begin CHARACTERISTIC Cmp_n_eal_rich_sp_alco "Open loop basic richness setpoint map for flex-fuel." MAP 0xa0029fb0 _REC_A1MAP_20_u1_u2_u2 1.328125 _CNV_A_R_LINEAR_____104_CM 0.6666666 1.9947916 FORMAT "%8.6"
 /begin AXIS_DESCR COM_AXIS Vxx_n _CNV_A_R_ENSD_LINEA_22_CM 20 0. 16383.75 FORMAT "%8.2" AXIS_PTS_REF Ctb_n /end AXIS_DESCR
 /begin AXIS_DESCR COM_AXIS Vxx_eal _CNV_A_R_LINEAR_____53_CM 16 0. 3.99993896484375 FORMAT "%10.8" AXIS_PTS_REF Ctb_eal /end AXIS_DESCR
/end CHARACTERISTIC
/begin CHARACTERISTIC Ctp_n_kd_rich_fac_alco "Minimum richness setpoint applied in case of full load requested by the driver for exotic fuel." CURVE 0xa002a0f0 _REC_A1CUR_20_u1_u2 1.328125 _CNV_A_R_LINEAR_____104_CM 0.6666666 1.9947916 FORMAT "%8.6"
 /begin AXIS_DESCR COM_AXIS Vxx_n _CNV_A_R_ENSD_LINEA_22_CM 20 0. 16383.75 FORMAT "%8.2" AXIS_PTS_REF Ctb_n /end AXIS_DESCR
/end CHARACTERISTIC
/begin MEASUREMENT Vxx_n_eal_rich_sp_alco "Basic richness setpoint in open loop for flex-fuel." UBYTE _CNV_A_R_LINEAR_____104_CM 1 0. 0.6666666 1.9947916 ECU_ADDRESS 0xd00067a9 FORMAT "%8.6" /end MEASUREMENT
/begin MEASUREMENT Vxx_n_kd_rich_fac_alco "Full load richness factor for flex-fuel." UBYTE _CNV_A_R_LINEAR_____104_CM 1 0. 0.6666666 1.9947916 ECU_ADDRESS 0xd00067aa FORMAT "%8.6" /end MEASUREMENT
/begin MEASUREMENT Vtx_dstb_cylx_fim_fac[0] "4 factors applied to richness of each cylinder during richness distribution" UBYTE _CNV_A_R_LINEAR_____42_CM 1 0. 0. 1.9921875 ECU_ADDRESS 0xd00077f8 FORMAT "%8.6" /end MEASUREMENT
/begin MEASUREMENT Vtx_dstb_cylx_fim_fac[1] "4 factors applied to richness of each cylinder during richness distribution" UBYTE _CNV_A_R_LINEAR_____42_CM 1 0. 0. 1.9921875 ECU_ADDRESS 0xd00077f9 FORMAT "%8.6" /end MEASUREMENT
/begin MEASUREMENT Vtx_dstb_cylx_fim_fac[2] "4 factors applied to richness of each cylinder during richness distribution" UBYTE _CNV_A_R_LINEAR_____42_CM 1 0. 0. 1.9921875 ECU_ADDRESS 0xd00077fa FORMAT "%8.6" /end MEASUREMENT
/begin MEASUREMENT Vtx_dstb_cylx_fim_fac[3] "4 factors applied to richness of each cylinder during richness distribution" UBYTE _CNV_A_R_LINEAR_____42_CM 1 0. 0. 1.9921875 ECU_ADDRESS 0xd00077fb FORMAT "%8.6" /end MEASUREMENT
/begin MEASUREMENT Vtx_dstb_cylx_fim_fac_is[0] "4 factors applied to richness of each cylinder during richness distribution and iddle speed" UBYTE _CNV_A_R_LINEAR_____42_CM 1 0. 0. 1.9921875 ECU_ADDRESS 0xd00077fc FORMAT "%8.6" /end MEASUREMENT
/begin MEASUREMENT Vtx_dstb_cylx_fim_fac_is[1] "4 factors applied to richness of each cylinder during richness distribution and iddle speed" UBYTE _CNV_A_R_LINEAR_____42_CM 1 0. 0. 1.9921875 ECU_ADDRESS 0xd00077fd FORMAT "%8.6" /end MEASUREMENT
/begin MEASUREMENT Vtx_dstb_cylx_fim_fac_is[2] "4 factors applied to richness of each cylinder during richness distribution and iddle speed" UBYTE _CNV_A_R_LINEAR_____42_CM 1 0. 0. 1.9921875 ECU_ADDRESS 0xd00077fe FORMAT "%8.6" /end MEASUREMENT
/begin MEASUREMENT Vtx_dstb_cylx_fim_fac_is[3] "4 factors applied to richness of each cylinder during richness distribution and iddle speed" UBYTE _CNV_A_R_LINEAR_____42_CM 1 0. 0. 1.9921875 ECU_ADDRESS 0xd00077ff FORMAT "%8.6" /end MEASUREMENT
/begin MEASUREMENT Vxx_cata_rich_dstb_cyl1_fac "Factor applied to richness of cylinder 1 during richness distribution and no iddle speed" UBYTE _CNV_A_R_LINEAR_____42_CM 1 0. 0. 1.9921875 ECU_ADDRESS 0xd00067b3 FORMAT "%10.8" /end MEASUREMENT
/begin MEASUREMENT Vxx_cata_rich_dstb_cyl2_fac "Factor applied to richness of cylinder 2 during richness distribution and no iddle speed" UBYTE _CNV_A_R_LINEAR_____42_CM 1 0. 0. 1.9921875 ECU_ADDRESS 0xd00067b4 FORMAT "%10.8" /end MEASUREMENT
/begin MEASUREMENT Vxx_cata_rich_dstb_cyl3_fac "Factor applied to richness of cylinder 3 during richness distribution and no iddle speed" UBYTE _CNV_A_R_LINEAR_____42_CM 1 0. 0. 1.9921875 ECU_ADDRESS 0xd00067b5 FORMAT "%10.8" /end MEASUREMENT
/begin MEASUREMENT Vxx_cata_rich_dstb_cyl4_fac "Factor applied to richness of cylinder 4 during richness distribution and no iddle speed" UBYTE _CNV_A_R_LINEAR_____42_CM 1 0. 0. 1.9921875 ECU_ADDRESS 0xd00067b6 FORMAT "%10.8" /end MEASUREMENT
/begin CHARACTERISTIC Cxx_dstb_cyl1_fim_fac_is "Factor applied to richness of cylinder one during richness distribution and iddle speed" VALUE 0xa0020fde _REC_S1VAL_20_u1 1.9921875 _CNV_A_R_LINEAR_____42_CM 0. 1.9921875 FORMAT "%10.8" /end CHARACTERISTIC
/begin CHARACTERISTIC Cxx_dstb_cyl1_fim_fac_is_alco "Factor applied to richness of cylinder one during richness distribution and iddle speed for flex-fuel" VALUE 0xa0020fdf _REC_S1VAL_20_u1 1.9921875 _CNV_A_R_LINEAR_____42_CM 0. 1.9921875 FORMAT "%8.6" /end CHARACTERISTIC
/begin CHARACTERISTIC Cxx_dstb_cyl1_h_fim_fac "High factor applied to richness of cylinder one during richness distribution and no iddle speed" VALUE 0xa0020fe0 _REC_S1VAL_20_u1 1.9921875 _CNV_A_R_LINEAR_____42_CM 0. 1.9921875 FORMAT "%10.8" /end CHARACTERISTIC
/begin CHARACTERISTIC Cxx_dstb_cyl1_h_fim_fac_alco "High factor applied to richness of cylinder one during richness distribution and no iddle speed for flex-fuel" VALUE 0xa0020fe1 _REC_S1VAL_20_u1 1.9921875 _CNV_A_R_LINEAR_____42_CM 0. 1.9921875 FORMAT "%8.6" /end CHARACTERISTIC
/begin CHARACTERISTIC Cxx_dstb_cyl1_l_fim_fac "Low factor applied to richness of cylinder one during richness distribution and no iddle speed" VALUE 0xa0020fe2 _REC_S1VAL_20_u1 1.9921875 _CNV_A_R_LINEAR_____42_CM 0. 1.9921875 FORMAT "%10.8" /end CHARACTERISTIC
/begin CHARACTERISTIC Cxx_dstb_cyl1_l_fim_fac_alco "Low factor applied to richness of cylinder one during richness distribution and no iddle speed for flex-fuel" VALUE 0xa0020fe3 _REC_S1VAL_20_u1 1.9921875 _CNV_A_R_LINEAR_____42_CM 0. 1.9921875 FORMAT "%8.6" /end CHARACTERISTIC
/begin CHARACTERISTIC Cxx_dstb_cyl2_fim_fac_is "Factor applied to richness of cylinder two during richness distribution and iddle speed" VALUE 0xa0020fe4 _REC_S1VAL_20_u1 1.9921875 _CNV_A_R_LINEAR_____42_CM 0. 1.9921875 FORMAT "%10.8" /end CHARACTERISTIC
/begin CHARACTERISTIC Cxx_dstb_cyl2_fim_fac_is_alco "Factor applied to richness of cylinder two during richness distribution and iddle speed for flex-fuel" VALUE 0xa0020fe5 _REC_S1VAL_20_u1 1.9921875 _CNV_A_R_LINEAR_____42_CM 0. 1.9921875 FORMAT "%8.6" /end CHARACTERISTIC
/begin CHARACTERISTIC Cxx_dstb_cyl2_h_fim_fac "High factor applied to richness of cylinder two during richness distribution and no iddle speed" VALUE 0xa0020fe6 _REC_S1VAL_20_u1 1.9921875 _CNV_A_R_LINEAR_____42_CM 0. 1.9921875 FORMAT "%10.8" /end CHARACTERISTIC
/begin CHARACTERISTIC Cxx_dstb_cyl2_h_fim_fac_alco "High factor applied to richness of cylinder two during richness distribution and no iddle speed for flex-fuel" VALUE 0xa0020fe7 _REC_S1VAL_20_u1 1.9921875 _CNV_A_R_LINEAR_____42_CM 0. 1.9921875 FORMAT "%8.6" /end CHARACTERISTIC
/begin CHARACTERISTIC Cxx_dstb_cyl2_l_fim_fac "Low factor applied to richness of cylinder two during richness distribution and no iddle speed" VALUE 0xa0020fe8 _REC_S1VAL_20_u1 1.9921875 _CNV_A_R_LINEAR_____42_CM 0. 1.9921875 FORMAT "%10.8" /end CHARACTERISTIC
/begin CHARACTERISTIC Cxx_dstb_cyl2_l_fim_fac_alco "Low factor applied to richness of cylinder two during richness distribution and no iddle speed for flex-fuel" VALUE 0xa0020fe9 _REC_S1VAL_20_u1 1.9921875 _CNV_A_R_LINEAR_____42_CM 0. 1.9921875 FORMAT "%8.6" /end CHARACTERISTIC
/begin CHARACTERISTIC Cxx_dstb_cyl3_fim_fac_is "Factor applied to richness of cylinder three during richness distribution and iddle speed" VALUE 0xa0020fea _REC_S1VAL_20_u1 1.9921875 _CNV_A_R_LINEAR_____42_CM 0. 1.9921875 FORMAT "%10.8" /end CHARACTERISTIC
/begin CHARACTERISTIC Cxx_dstb_cyl3_fim_fac_is_alco "Factor applied to richness of cylinder three during richness distribution and iddle speed for flex-fuel" VALUE 0xa0020feb _REC_S1VAL_20_u1 1.9921875 _CNV_A_R_LINEAR_____42_CM 0. 1.9921875 FORMAT "%8.6" /end CHARACTERISTIC
/begin CHARACTERISTIC Cxx_dstb_cyl3_h_fim_fac "High factor applied to richness of cylinder three during richness distribution and no iddle speed" VALUE 0xa0020fec _REC_S1VAL_20_u1 1.9921875 _CNV_A_R_LINEAR_____42_CM 0. 1.9921875 FORMAT "%10.8" /end CHARACTERISTIC
/begin CHARACTERISTIC Cxx_dstb_cyl3_h_fim_fac_alco "High factor applied to richness of cylinder three during richness distribution and no iddle speed for flex-fuel" VALUE 0xa0020fed _REC_S1VAL_20_u1 1.9921875 _CNV_A_R_LINEAR_____42_CM 0. 1.9921875 FORMAT "%8.6" /end CHARACTERISTIC
/begin CHARACTERISTIC Cxx_dstb_cyl3_l_fim_fac "Low factor applied to richness of cylinder three during richness distribution and no iddle speed" VALUE 0xa0020fee _REC_S1VAL_20_u1 1.9921875 _CNV_A_R_LINEAR_____42_CM 0. 1.9921875 FORMAT "%10.8" /end CHARACTERISTIC
/begin CHARACTERISTIC Cxx_dstb_cyl3_l_fim_fac_alco "Low factor applied to richness of cylinder three during richness distribution and no iddle speed for flex-fuel" VALUE 0xa0020fef _REC_S1VAL_20_u1 1.9921875 _CNV_A_R_LINEAR_____42_CM 0. 1.9921875 FORMAT "%8.6" /end CHARACTERISTIC
/begin CHARACTERISTIC Cxx_dstb_cyl4_fim_fac_is "Factor applied to richness of cylinder four during richness distribution and iddle speed" VALUE 0xa0020ff0 _REC_S1VAL_20_u1 1.9921875 _CNV_A_R_LINEAR_____42_CM 0. 1.9921875 FORMAT "%10.8" /end CHARACTERISTIC
/begin CHARACTERISTIC Cxx_dstb_cyl4_fim_fac_is_alco "Factor applied to richness of cylinder four during richness distribution and iddle speed for flex-fuel" VALUE 0xa0020ff1 _REC_S1VAL_20_u1 1.9921875 _CNV_A_R_LINEAR_____42_CM 0. 1.9921875 FORMAT "%8.6" /end CHARACTERISTIC
/begin CHARACTERISTIC Cxx_dstb_cyl4_h_fim_fac "High factor applied to richness of cylinder four during richness distribution and no iddle speed" VALUE 0xa0020ff2 _REC_S1VAL_20_u1 1.9921875 _CNV_A_R_LINEAR_____42_CM 0. 1.9921875 FORMAT "%10.8" /end CHARACTERISTIC
/begin CHARACTERISTIC Cxx_dstb_cyl4_h_fim_fac_alco "High factor applied to richness of cylinder four during richness distribution and no iddle speed for flex-fuel" VALUE 0xa0020ff3 _REC_S1VAL_20_u1 1.9921875 _CNV_A_R_LINEAR_____42_CM 0. 1.9921875 FORMAT "%8.6" /end CHARACTERISTIC
/begin CHARACTERISTIC Cxx_dstb_cyl4_l_fim_fac "Low factor applied to richness of cylinder four during richness distribution and no iddle speed" VALUE 0xa0020ff4 _REC_S1VAL_20_u1 1.9921875 _CNV_A_R_LINEAR_____42_CM 0. 1.9921875 FORMAT "%10.8" /end CHARACTERISTIC
/begin CHARACTERISTIC Cxx_dstb_cyl4_l_fim_fac_alco "Low factor applied to richness of cylinder four during richness distribution and no iddle speed for flex-fuel" VALUE 0xa0020ff5 _REC_S1VAL_20_u1 1.9921875 _CNV_A_R_LINEAR_____42_CM 0. 1.9921875 FORMAT "%8.6" /end CHARACTERISTIC
/begin CHARACTERISTIC Cmp_n_eal_rich_sp_h "Open loop basic richness setpoint map for state high" MAP 0xa002a104 _REC_A1MAP_20_u1_u2_u2 1.328125 _CNV_A_R_LINEAR_____104_CM 0.6666666 1.9947916 FORMAT "%8.6"
 /begin AXIS_DESCR COM_AXIS Vxx_n _CNV_A_R_ENSD_LINEA_22_CM 20 0. 16383.75 FORMAT "%8.2" AXIS_PTS_REF Ctb_n /end AXIS_DESCR
 /begin AXIS_DESCR COM_AXIS Vxx_eal _CNV_A_R_LINEAR_____53_CM 16 0. 3.99993896484375 FORMAT "%10.8" AXIS_PTS_REF Ctb_eal /end AXIS_DESCR
/end CHARACTERISTIC
/begin CHARACTERISTIC Cmp_n_eal_rich_sp_l "Open loop basic richness setpoint map for state low" MAP 0xa002a244 _REC_A1MAP_20_u1_u2_u2 1.328125 _CNV_A_R_LINEAR_____104_CM 0.6666666 1.9947916 FORMAT "%8.6"
 /begin AXIS_DESCR COM_AXIS Vxx_n _CNV_A_R_ENSD_LINEA_22_CM 20 0. 16383.75 FORMAT "%8.2" AXIS_PTS_REF Ctb_n /end AXIS_DESCR
 /begin AXIS_DESCR COM_AXIS Vxx_eal _CNV_A_R_LINEAR_____53_CM 16 0. 3.99993896484375 FORMAT "%10.8" AXIS_PTS_REF Ctb_eal /end AXIS_DESCR
/end CHARACTERISTIC
/begin CHARACTERISTIC Cmp_n_eal_rich_sp_midh "Open loop basic richness setpoint map for state mid-high" MAP 0xa002a384 _REC_A1MAP_20_u1_u2_u2 1.328125 _CNV_A_R_LINEAR_____104_CM 0.6666666 1.9947916 FORMAT "%8.6"
 /begin AXIS_DESCR COM_AXIS Vxx_n _CNV_A_R_ENSD_LINEA_22_CM 20 0. 16383.75 FORMAT "%8.2" AXIS_PTS_REF Ctb_n /end AXIS_DESCR
 /begin AXIS_DESCR COM_AXIS Vxx_eal _CNV_A_R_LINEAR_____53_CM 16 0. 3.99993896484375 FORMAT "%10.8" AXIS_PTS_REF Ctb_eal /end AXIS_DESCR
/end CHARACTERISTIC
/begin CHARACTERISTIC Cmp_n_eal_rich_sp_midl "Open loop basic richness setpoint map for state mid-low" MAP 0xa002a4c4 _REC_A1MAP_20_u1_u2_u2 1.328125 _CNV_A_R_LINEAR_____104_CM 0.6666666 1.9947916 FORMAT "%8.6"
 /begin AXIS_DESCR COM_AXIS Vxx_n _CNV_A_R_ENSD_LINEA_22_CM 20 0. 16383.75 FORMAT "%8.2" AXIS_PTS_REF Ctb_n /end AXIS_DESCR
 /begin AXIS_DESCR COM_AXIS Vxx_eal _CNV_A_R_LINEAR_____53_CM 16 0. 3.99993896484375 FORMAT "%10.8" AXIS_PTS_REF Ctb_eal /end AXIS_DESCR
/end CHARACTERISTIC
/begin CHARACTERISTIC Ctp_n_kd_rich_fac "Minimum richness setpoint table applied in case of full load requested by the driver" CURVE 0xa002a604 _REC_A1CUR_20_u1_u2 1.328125 _CNV_A_R_LINEAR_____104_CM 0.6666666 1.9947916 FORMAT "%8.6"
 /begin AXIS_DESCR COM_AXIS Vxx_n _CNV_A_R_ENSD_LINEA_22_CM 20 0. 16383.75 FORMAT "%8.2" AXIS_PTS_REF Ctb_n /end AXIS_DESCR
/end CHARACTERISTIC
/begin MEASUREMENT Vxx_bas_rich_fac "Basic richness setpoint in open loop operation" UBYTE _CNV_A_R_LINEAR_____104_CM 1 0. 0.6666666 1.9947916 ECU_ADDRESS 0xd00067ab FORMAT "%8.6" /end MEASUREMENT
/begin MEASUREMENT Vxx_kd_rich_fac "Full load richness factor" UBYTE _CNV_A_R_LINEAR_____104_CM 1 0. 0.6666666 1.9947916 ECU_ADDRESS 0xd00067ac FORMAT "%8.6" /end MEASUREMENT
/begin MEASUREMENT Vxx_kd_rich_fac_itl "Full load richness factor internal" UBYTE _CNV_A_R_LINEAR_____104_CM 1 0. 0.6666666 1.9947916 ECU_ADDRESS 0xd00067ad FORMAT "%8.6" /end MEASUREMENT
/begin MEASUREMENT Vxx_n_eal_rich_sp_h "Basic richness setpoint in open loop for state high" UBYTE _CNV_A_R_LINEAR_____104_CM 1 0. 0.6666666 1.9947916 ECU_ADDRESS 0xd00067ae FORMAT "%8.6" /end MEASUREMENT
/begin MEASUREMENT Vxx_n_eal_rich_sp_l "Basic richness setpoint in open loop for state low" UBYTE _CNV_A_R_LINEAR_____104_CM 1 0. 0.6666666 1.9947916 ECU_ADDRESS 0xd00067af FORMAT "%8.6" /end MEASUREMENT
/begin MEASUREMENT Vxx_n_eal_rich_sp_midh "Basic richness setpoint in open loop for state mid-high" UBYTE _CNV_A_R_LINEAR_____104_CM 1 0. 0.6666666 1.9947916 ECU_ADDRESS 0xd00067b0 FORMAT "%8.6" /end MEASUREMENT
/begin MEASUREMENT Vxx_n_eal_rich_sp_midl "Basic richness setpoint in open loop for state mid-low" UBYTE _CNV_A_R_LINEAR_____104_CM 1 0. 0.6666666 1.9947916 ECU_ADDRESS 0xd00067b1 FORMAT "%8.6" /end MEASUREMENT
/begin MEASUREMENT Vxx_n_kd_rich_fac "Minimum richness setpoint applied in case of full load requested by the driver" UBYTE _CNV_A_R_LINEAR_____104_CM 1 0. 0.6666666 1.9947916 ECU_ADDRESS 0xd00067b2 FORMAT "%8.6" /end MEASUREMENT
/begin CHARACTERISTIC Cxx_cold_loop_kd_rich_fac "Richness factor correction depending on the ignition timing correction of the slow loop (Vxx_knk_slow_cor_max_iga)" VALUE 0xa0020fd9 _REC_S1VAL_20_u1 2.98828125e-002 _CNV_A_R_LINEAR_____139_CM 0. 2.98828125e-002 FORMAT "%12.10" /end CHARACTERISTIC
/begin CHARACTERISTIC Cxx_rich_cor_ena_n_thd "RPM threshold over wich a richness correction factor is autorized for exhaust thermal protection" VALUE 0xa0020fda _REC_S1VAL_20_u1 8160. _CNV_A_R_LINEAR_____2_CM 0. 8160. FORMAT "%4.0" /end CHARACTERISTIC
/begin CHARACTERISTIC Cxx_tia_kd_rich_cor_fac "Richness factor correction depending on the ignition timing correction for the air temperature (Vxx_tia_iga_cor)" VALUE 0xa0020fdb _REC_S1VAL_20_u1 2.98828125e-002 _CNV_A_R_LINEAR_____139_CM 0. 2.98828125e-002 FORMAT "%12.10" /end CHARACTERISTIC
/begin CHARACTERISTIC Cxx_tkof_fl_rich_fac "Richness setpoint during take-off phase" VALUE 0xa0020fdc _REC_S1VAL_20_u1 1.328125 _CNV_A_R_LINEAR_____104_CM 0.6666666 1.9947916 FORMAT "%8.6" /end CHARACTERISTIC
/begin CHARACTERISTIC Cxx_tkof_fl_rich_fac_alco "Richness setpoint during take-off phase for flex-fuel." VALUE 0xa0020fdd _REC_S1VAL_20_u1 1.328125 _CNV_A_R_LINEAR_____104_CM 0.6666666 1.9947916 FORMAT "%8.6" /end CHARACTERISTIC
/begin AXIS_PTS Ctb_prs_rat "" 0xa0024e44 Vxx_it_prs_rat_fil _REC_A2AXS_20_u2 0.9999847412109381 _CNV_A_R_LINEAR_____7_CM 22 0. 0.9999847412109381 FORMAT "%7.5" /end AXIS_PTS
/begin CHARACTERISTIC Ctp_it_prs_rat_fil_ftc "Constant of time calculated from up and down throttle rate pressure value" CURVE 0xa0024e74 _REC_A1CUR_20_u2_u2 20. _CNV_A_R_LINEAR_____140_CM 0. 20. FORMAT "%10.8"
 /begin AXIS_DESCR COM_AXIS Vxx_it_prs_rat_fil _CNV_A_R_LINEAR_____7_CM 22 0. 0.9999847412109381 FORMAT "%7.5" AXIS_PTS_REF Ctb_prs_rat /end AXIS_DESCR
/end CHARACTERISTIC
/begin CHARACTERISTIC Ctp_prs_tmp_flr_val "Intermediate variable for the calculation of the surfacic flow, Res = 1/(16*256^2)" CURVE 0xa0024ea0 _REC_A1CUR_20_u2_u2 6.249904600000001e-002 _CNV_A_R_LINEAR_____141_CM 0. 6.2499046e-002 FORMAT "%7.6"
 /begin AXIS_DESCR COM_AXIS Vxx_it_prs_rat_fil _CNV_A_R_LINEAR_____7_CM 22 0. 0.9999847412109381 FORMAT "%7.5" AXIS_PTS_REF Ctb_prs_rat /end AXIS_DESCR
/end CHARACTERISTIC
/begin MEASUREMENT Vxx_ar_flr_tmp_val "Intermediate variable for the calculation of the surfacic flow, Res= 1/(16*256^2)" UWORD _CNV_A_R_LINEAR_____141_CM 1 0. 0. 6.2499046e-002 ECU_ADDRESS 0xd0003dec FORMAT "%7.6" /end MEASUREMENT
/begin MEASUREMENT Vxx_it_ar_maf "Mass air flow per unity of throttle efficient area" UWORD _CNV_A_R_LINEAR_____142_CM 1 0. 0. 1836000. ECU_ADDRESS 0xd0003dee FORMAT "%10.3" /end MEASUREMENT
/begin MEASUREMENT Vxx_it_prs_rat_fil "Filtered pressure rate Pmanifold/Pup_throttle" UWORD _CNV_A_R_LINEAR_____143_CM 1 0. 0. 1. ECU_ADDRESS 0xd0003df0 FORMAT "%10.9" /end MEASUREMENT
/begin MEASUREMENT Vxx_raw_prs_rat "Rate value of up and down throttle pressure Pmanifold/Pup_throttle raw" UWORD _CNV_A_R_LINEAR_____143_CM 1 0. 0. 1. ECU_ADDRESS 0xd0003df2 FORMAT "%10.9" /end MEASUREMENT
/begin CHARACTERISTIC Cbx_prs_sp_dsb_cfm "Choice between the measured manifold pressure and the calculated manifold pressure." VALUE 0xa0020c4d _REC_S1VAL_20_u1 1. _CNV_A_R_ECME_LINEA_0_CM 0. 1. FORMAT "%1.0" BIT_MASK 0x1 /end CHARACTERISTIC
/begin CHARACTERISTIC Cmp_n_gear_noi_max_it_ar "Maximum throttle opening limitation due to the acoustic depending on gear engaged" MAP 0xa0024ecc _REC_A1MAP_20_u2_u2_u1 3.90619e-003 _CNV_A_R_LINEAR_____144_CM 0. 3.90619e-003 FORMAT "%11.9"
 /begin AXIS_DESCR COM_AXIS Vxx_n_mv _CNV_A_R_ENSD_LINEA_22_CM 9 0. 16383.75 FORMAT "%8.2" AXIS_PTS_REF Ctb_n_noi_lim /end AXIS_DESCR
 /begin AXIS_DESCR COM_AXIS Vxx_gear _CNV_A_R_LINEAR_____145_CM 8 -1. 6. READ_ONLY FORMAT "%2.0" AXIS_PTS_REF Ntb_gear /end AXIS_DESCR
/end CHARACTERISTIC
/begin CHARACTERISTIC Ctp_cold_stop_it_psn_sp "Throttle position order during the damper phase, at cold manifold air temperature" CURVE 0xa0024f5c _REC_A1CUR_20_u2_u2 200. _CNV_A_R_LINEAR_____146_CM 0. 200. FORMAT "%6.2"
 /begin AXIS_DESCR COM_AXIS Vxx_tco _CNV_A_R_LINEAR_____110_CM 9 -40. 200. FORMAT "%5.1" AXIS_PTS_REF Ctb_tco2 /end AXIS_DESCR
/end CHARACTERISTIC
/begin CHARACTERISTIC Ctp_n_min_map_it_ar "Minimum throttle opening limitation due to minimum manifold pressure (oil consumption)" CURVE 0xa0024f70 _REC_A1CUR_20_u2_u2 3.90619e-003 _CNV_A_R_LINEAR_____144_CM 0. 3.90619e-003 FORMAT "%11.9"
 /begin AXIS_DESCR COM_AXIS Vxx_n _CNV_A_R_ENSD_LINEA_22_CM 20 0. 16383.75 FORMAT "%8.2" AXIS_PTS_REF Ctb_n /end AXIS_DESCR
/end CHARACTERISTIC
/begin CHARACTERISTIC Ctp_n_min_map_it_ar_fac "Minimum throttle opening lim (oil consumption constraint) correction factor" CURVE 0xa0024f98 _REC_A1CUR_20_u2_u2 1.999969482 _CNV_A_R_LINEAR_____147_CM 0. 1.999969482 FORMAT "%10.8"
 /begin AXIS_DESCR COM_AXIS Vxx_tco _CNV_A_R_LINEAR_____110_CM 16 -40. 200. FORMAT "%5.1" AXIS_PTS_REF Ctb_tco /end AXIS_DESCR
/end CHARACTERISTIC
/begin CHARACTERISTIC Ctp_n_noi_max_it_ar "" CURVE 0xa0024fb8 _REC_A1CUR_20_u2_u2 3.90619e-003 _CNV_A_R_LINEAR_____144_CM 0. 3.90619e-003 FORMAT "%11.9"
 /begin AXIS_DESCR COM_AXIS Vxx_n_mv _CNV_A_R_ENSD_LINEA_22_CM 9 0. 16383.75 FORMAT "%8.2" AXIS_PTS_REF Ctb_n_noi_lim /end AXIS_DESCR
/end CHARACTERISTIC
/begin CHARACTERISTIC Ctp_tco_clos_it_t "Table of duration of the throttle closure temporization at the key off." CURVE 0xa0024fcc _REC_A1CUR_20_u2_u2 655.35 _CNV_A_R_LINEAR_____32_CM 0. 655.35 FORMAT "%6.2"
 /begin AXIS_DESCR COM_AXIS Vxx_tco _CNV_A_R_LINEAR_____110_CM 16 -40. 200. FORMAT "%5.1" AXIS_PTS_REF Ctb_tco /end AXIS_DESCR
/end CHARACTERISTIC
/begin MEASUREMENT Vbx_clos_it_dly_stop "Ended of temporization for the throttle closure." UBYTE _CNV_S_2_RANGE______3_CM 1 0. 0. 1. ECU_ADDRESS 0xd0006498 BIT_MASK 0x1 /end MEASUREMENT
/begin MEASUREMENT Vbx_clos_it_stop "Boolean indicating that throttle closing phase is terminated or disabled (choking)." UBYTE _CNV_S_2_RANGE______3_CM 1 0. 0. 1. ECU_ADDRESS 0xd0006499 BIT_MASK 0x1 /end MEASUREMENT
/begin MEASUREMENT Vxx_fil1_it_psn_sp "Inlet throttle position reference from the air system." UWORD _CNV_A_R_LINEAR_____146_CM 1 0. 0. 200. ECU_ADDRESS 0xd0003e3c FORMAT "%5.2" /end MEASUREMENT
/begin MEASUREMENT Vxx_it_ar_sp "Command of throttle area" UWORD _CNV_A_R_LINEAR_____144_CM 1 0. 0. 3.90619e-003 ECU_ADDRESS 0xd0003e3e FORMAT "%11.9" /end MEASUREMENT
/begin MEASUREMENT Vxx_it_psn_sp "Ended of temporization for the throttle closure." UWORD _CNV_A_R_LINEAR_____146_CM 1 0. 0. 200. ECU_ADDRESS 0xd0003e40 FORMAT "%5.2" /end MEASUREMENT
/begin MEASUREMENT Vxx_raw_it_psn_sp "Corrected raw command of the motorized throttle position." UWORD _CNV_A_R_LINEAR_____146_CM 1 0. 0. 200. ECU_ADDRESS 0xd0003e42 FORMAT "%5.2" /end MEASUREMENT
/begin MEASUREMENT Vxx_tq_it_ar_sp "Command of the efficiency throttle area for the torque control." UWORD _CNV_A_R_LINEAR_____148_CM 1 0. 0. 3.90619039535522e-003 ECU_ADDRESS 0xd0003e44 FORMAT "%16.12" /end MEASUREMENT
/begin CHARACTERISTIC Cbx_clos_it_dsb "Inhibition of the function damper in the driving stop." VALUE 0xa0020c64 _REC_S1VAL_20_u1 1. _CNV_A_R_ECME_LINEA_0_CM 0. 1. FORMAT "%1.0" BIT_MASK 0x1 /end CHARACTERISTIC
/begin CHARACTERISTIC Cbx_it_bch_cfm "Throttle bench mode." VALUE 0xa0020c65 _REC_S1VAL_20_u1 1. _CNV_A_R_ECME_LINEA_0_CM 0. 1. FORMAT "%1.0" BIT_MASK 0x1 /end CHARACTERISTIC
/begin CHARACTERISTIC Cbx_it_ped_bch_cfm "Throttle bench mode (calculated with pedal ratio)." VALUE 0xa0020c66 _REC_S1VAL_20_u1 1. _CNV_A_R_ECME_LINEA_0_CM 0. 1. FORMAT "%1.0" BIT_MASK 0x1 /end CHARACTERISTIC
/begin CHARACTERISTIC Cxx_clos_it_mat_min "Temperature of the air over which the throttle closure (damper) is forbidden." VALUE 0xa0020c4e _REC_S1VAL_20_u2 240. _CNV_A_R_LINEAR_____110_CM -40. 200. FORMAT "%5.1" /end CHARACTERISTIC
/begin CHARACTERISTIC Cxx_clos_it_n_max "Engine rpm over which the function damper is finished." VALUE 0xa0020c50 _REC_S1VAL_20_u2 16383.75 _CNV_A_R_ENSD_LINEA_22_CM 0. 16383.75 FORMAT "%8.2" /end CHARACTERISTIC
/begin CHARACTERISTIC Cxx_clos_it_n_min "Engine rpm below which the function damper is finished." VALUE 0xa0020c52 _REC_S1VAL_20_u2 16383.75 _CNV_A_R_ENSD_LINEA_22_CM 0. 16383.75 FORMAT "%8.2" /end CHARACTERISTIC
/begin CHARACTERISTIC Cxx_clos_it_vs_max "Speed over which the function damper is forbidden." VALUE 0xa0020c54 _REC_S1VAL_20_u2 655.35 _CNV_A_R_LINEAR_____125_CM 0. 655.35 FORMAT "%6.2" /end CHARACTERISTIC
/begin CHARACTERISTIC Cxx_eng_stop_it_psn_sp "Position throttle order during the damper phase." VALUE 0xa0020c56 _REC_S1VAL_20_u2 200. _CNV_A_R_LINEAR_____146_CM 0. 200. FORMAT "%5.2" /end CHARACTERISTIC
/begin CHARACTERISTIC Cxx_ffig_it_psn_sp "Inlet throttle position reference in case of ffig." VALUE 0xa0020c58 _REC_S1VAL_20_u2 200. _CNV_A_R_LINEAR_____146_CM 0. 200. FORMAT "%6.2" /end CHARACTERISTIC
/begin CHARACTERISTIC Cxx_fl_max_it_ar "Command of full load maximum throttle area." VALUE 0xa0020c5a _REC_S1VAL_20_u2 3.90619e-003 _CNV_A_R_LINEAR_____144_CM 0. 3.90619e-003 FORMAT "%11.9" /end CHARACTERISTIC
/begin CHARACTERISTIC Cxx_it_pos_ped_fac_bch "factor for throttle position calculation in bench mode." VALUE 0xa0020c5c _REC_S1VAL_20_u2 200. _CNV_A_R_CPULOAD__0_5_CM 0. 200. FORMAT "%13.8" /end CHARACTERISTIC
/begin CHARACTERISTIC Cxx_it_pos_sc_bch "Throttle position in bench mode." VALUE 0xa0020c5e _REC_S1VAL_20_u2 200. _CNV_A_R_LINEAR_____146_CM 0. 200. FORMAT "%5.2" /end CHARACTERISTIC
/begin CHARACTERISTIC Cxx_it_pos_sc_l_thd_bch "low throttle position in bench mode." VALUE 0xa0020c60 _REC_S1VAL_20_u2 200. _CNV_A_R_LINEAR_____146_CM 0. 200. FORMAT "%6.2" /end CHARACTERISTIC
/begin CHARACTERISTIC Cxx_l_it_ar "Value in case of division by zero." VALUE 0xa0020c62 _REC_S1VAL_20_u2 3.90619e-003 _CNV_A_R_LINEAR_____144_CM 0. 3.90619e-003 FORMAT "%11.9" /end CHARACTERISTIC
/begin MEASUREMENT Vtp_it_ar[0] "Variable table for throttle area curve." UWORD _CNV_A_R_LINEAR_____144_CM 1 0. 0. 3.90619e-003 DISPLAY_IDENTIFIER AsMapCtl_NVM.Vtp_it_ar_NVM[0] ECU_ADDRESS 0xd0005000 FORMAT "%11.9" /end MEASUREMENT
/begin MEASUREMENT Vtp_it_ar[1] "Variable table for throttle area curve." UWORD _CNV_A_R_LINEAR_____144_CM 1 0. 0. 3.90619e-003 DISPLAY_IDENTIFIER AsMapCtl_NVM.Vtp_it_ar_NVM[1] ECU_ADDRESS 0xd0005002 FORMAT "%11.9" /end MEASUREMENT
/begin MEASUREMENT Vtp_it_ar[2] "Variable table for throttle area curve." UWORD _CNV_A_R_LINEAR_____144_CM 1 0. 0. 3.90619e-003 DISPLAY_IDENTIFIER AsMapCtl_NVM.Vtp_it_ar_NVM[2] ECU_ADDRESS 0xd0005004 FORMAT "%11.9" /end MEASUREMENT
/begin MEASUREMENT Vtp_it_ar[3] "Variable table for throttle area curve." UWORD _CNV_A_R_LINEAR_____144_CM 1 0. 0. 3.90619e-003 DISPLAY_IDENTIFIER AsMapCtl_NVM.Vtp_it_ar_NVM[3] ECU_ADDRESS 0xd0005006 FORMAT "%11.9" /end MEASUREMENT
/begin MEASUREMENT Vtp_it_ar[4] "Variable table for throttle area curve." UWORD _CNV_A_R_LINEAR_____144_CM 1 0. 0. 3.90619e-003 DISPLAY_IDENTIFIER AsMapCtl_NVM.Vtp_it_ar_NVM[4] ECU_ADDRESS 0xd0005008 FORMAT "%11.9" /end MEASUREMENT
/begin MEASUREMENT Vtp_it_ar[5] "Variable table for throttle area curve." UWORD _CNV_A_R_LINEAR_____144_CM 1 0. 0. 3.90619e-003 DISPLAY_IDENTIFIER AsMapCtl_NVM.Vtp_it_ar_NVM[5] ECU_ADDRESS 0xd000500a FORMAT "%11.9" /end MEASUREMENT
/begin MEASUREMENT Vtp_it_ar[6] "Variable table for throttle area curve." UWORD _CNV_A_R_LINEAR_____144_CM 1 0. 0. 3.90619e-003 DISPLAY_IDENTIFIER AsMapCtl_NVM.Vtp_it_ar_NVM[6] ECU_ADDRESS 0xd000500c FORMAT "%11.9" /end MEASUREMENT
/begin MEASUREMENT Vtp_it_ar[7] "Variable table for throttle area curve." UWORD _CNV_A_R_LINEAR_____144_CM 1 0. 0. 3.90619e-003 DISPLAY_IDENTIFIER AsMapCtl_NVM.Vtp_it_ar_NVM[7] ECU_ADDRESS 0xd000500e FORMAT "%11.9" /end MEASUREMENT
/begin MEASUREMENT Vtp_it_ar[8] "Variable table for throttle area curve." UWORD _CNV_A_R_LINEAR_____144_CM 1 0. 0. 3.90619e-003 DISPLAY_IDENTIFIER AsMapCtl_NVM.Vtp_it_ar_NVM[8] ECU_ADDRESS 0xd0005010 FORMAT "%11.9" /end MEASUREMENT
/begin MEASUREMENT Vtp_it_ar[9] "Variable table for throttle area curve." UWORD _CNV_A_R_LINEAR_____144_CM 1 0. 0. 3.90619e-003 DISPLAY_IDENTIFIER AsMapCtl_NVM.Vtp_it_ar_NVM[9] ECU_ADDRESS 0xd0005012 FORMAT "%11.9" /end MEASUREMENT
/begin MEASUREMENT Vtp_it_ar[10] "Variable table for throttle area curve." UWORD _CNV_A_R_LINEAR_____144_CM 1 0. 0. 3.90619e-003 DISPLAY_IDENTIFIER AsMapCtl_NVM.Vtp_it_ar_NVM[10] ECU_ADDRESS 0xd0005014 FORMAT "%11.9" /end MEASUREMENT
/begin MEASUREMENT Vtp_it_ar[11] "Variable table for throttle area curve." UWORD _CNV_A_R_LINEAR_____144_CM 1 0. 0. 3.90619e-003 DISPLAY_IDENTIFIER AsMapCtl_NVM.Vtp_it_ar_NVM[11] ECU_ADDRESS 0xd0005016 FORMAT "%11.9" /end MEASUREMENT
/begin MEASUREMENT Vtp_it_ar[12] "Variable table for throttle area curve." UWORD _CNV_A_R_LINEAR_____144_CM 1 0. 0. 3.90619e-003 DISPLAY_IDENTIFIER AsMapCtl_NVM.Vtp_it_ar_NVM[12] ECU_ADDRESS 0xd0005018 FORMAT "%11.9" /end MEASUREMENT
/begin MEASUREMENT Vtp_it_ar[13] "Variable table for throttle area curve." UWORD _CNV_A_R_LINEAR_____144_CM 1 0. 0. 3.90619e-003 DISPLAY_IDENTIFIER AsMapCtl_NVM.Vtp_it_ar_NVM[13] ECU_ADDRESS 0xd000501a FORMAT "%11.9" /end MEASUREMENT
/begin MEASUREMENT Vtp_it_ar[14] "Variable table for throttle area curve." UWORD _CNV_A_R_LINEAR_____144_CM 1 0. 0. 3.90619e-003 DISPLAY_IDENTIFIER AsMapCtl_NVM.Vtp_it_ar_NVM[14] ECU_ADDRESS 0xd000501c FORMAT "%11.9" /end MEASUREMENT
/begin MEASUREMENT Vtp_it_ar[15] "Variable table for throttle area curve." UWORD _CNV_A_R_LINEAR_____144_CM 1 0. 0. 3.90619e-003 DISPLAY_IDENTIFIER AsMapCtl_NVM.Vtp_it_ar_NVM[15] ECU_ADDRESS 0xd000501e FORMAT "%11.9" /end MEASUREMENT
/begin MEASUREMENT Vtp_it_ar[16] "Variable table for throttle area curve." UWORD _CNV_A_R_LINEAR_____144_CM 1 0. 0. 3.90619e-003 DISPLAY_IDENTIFIER AsMapCtl_NVM.Vtp_it_ar_NVM[16] ECU_ADDRESS 0xd0005020 FORMAT "%11.9" /end MEASUREMENT
/begin CHARACTERISTIC Ctb_no_it_psn "Table of numbers for breakpoint throttle position." CURVE 0xa0024fec _REC_A1CUR_20_u2_u2 31.99951171875 _CNV_A_R_LINEAR_____149_CM 0. 31.99951171875 FORMAT "%9.6"
 /begin AXIS_DESCR COM_AXIS Vxx_mv_it_rel_psn _CNV_A_R_LINEAR_____150_CM 17 0. 100. FORMAT "%6.2" AXIS_PTS_REF Ctp_it_ar_psn /end AXIS_DESCR
/end CHARACTERISTIC
/begin MEASUREMENT Vbx_act1_cor_it_adj "Boolean indicated that stabilised conditions agree to enable the \"A.C.T.A\" computing" UBYTE _CNV_S_2_RANGE______3_CM 1 0. 0. 1. ECU_ADDRESS 0xd000649b BIT_MASK 0x1 /end MEASUREMENT
/begin MEASUREMENT Vbx_act2_cor_it_adj "Boolean indicated that limit conditions agree to enable the \"A.C.T.A\" computing" UBYTE _CNV_S_2_RANGE______3_CM 1 0. 0. 1. ECU_ADDRESS 0xd000649c BIT_MASK 0x1 /end MEASUREMENT
/begin MEASUREMENT Vbx_act_cor_it_adj "Boolean for activation of \"A.C.T.A\" computing" UBYTE _CNV_S_2_RANGE______3_CM 1 0. 0. 1. ECU_ADDRESS 0xd000649d BIT_MASK 0x1 /end MEASUREMENT
/begin MEASUREMENT Vbx_cor_map_it_adj "Boolean of M.A.P stabilised conditions for \"A.C.T.A\" computing activation" UBYTE _CNV_S_2_RANGE______3_CM 1 0. 0. 1. ECU_ADDRESS 0xd000649e BIT_MASK 0x1 /end MEASUREMENT
/begin MEASUREMENT Vbx_cor_n_it_adj "Boolean of engine speed stabilised conditions for \"A.C.T.A\" computing activation" UBYTE _CNV_S_2_RANGE______3_CM 1 0. 0. 1. ECU_ADDRESS 0xd000649f BIT_MASK 0x1 /end MEASUREMENT
/begin MEASUREMENT Vbx_rst_cor_it_adj "Boolean to reset the modified throttle are curve towards reference one" UBYTE _CNV_S_2_RANGE______3_CM 1 0. 0. 1. ECU_ADDRESS 0xd00064a0 BIT_MASK 0x1 /end MEASUREMENT
/begin MEASUREMENT Vtp_cor_it_ar[0] "Final throttle area curve computed from \"A.C.T.A.\" strategy" UWORD _CNV_A_R_LINEAR_____144_CM 1 0. 0. 3.90619e-003 ECU_ADDRESS 0xd0005024 FORMAT "%11.9" /end MEASUREMENT
/begin MEASUREMENT Vtp_cor_it_ar[1] "Final throttle area curve computed from \"A.C.T.A.\" strategy" UWORD _CNV_A_R_LINEAR_____144_CM 1 0. 0. 3.90619e-003 ECU_ADDRESS 0xd0005026 FORMAT "%11.9" /end MEASUREMENT
/begin MEASUREMENT Vtp_cor_it_ar[2] "Final throttle area curve computed from \"A.C.T.A.\" strategy" UWORD _CNV_A_R_LINEAR_____144_CM 1 0. 0. 3.90619e-003 ECU_ADDRESS 0xd0005028 FORMAT "%11.9" /end MEASUREMENT
/begin MEASUREMENT Vtp_cor_it_ar[3] "Final throttle area curve computed from \"A.C.T.A.\" strategy" UWORD _CNV_A_R_LINEAR_____144_CM 1 0. 0. 3.90619e-003 ECU_ADDRESS 0xd000502a FORMAT "%11.9" /end MEASUREMENT
/begin MEASUREMENT Vtp_cor_it_ar[4] "Final throttle area curve computed from \"A.C.T.A.\" strategy" UWORD _CNV_A_R_LINEAR_____144_CM 1 0. 0. 3.90619e-003 ECU_ADDRESS 0xd000502c FORMAT "%11.9" /end MEASUREMENT
/begin MEASUREMENT Vtp_cor_it_ar[5] "Final throttle area curve computed from \"A.C.T.A.\" strategy" UWORD _CNV_A_R_LINEAR_____144_CM 1 0. 0. 3.90619e-003 ECU_ADDRESS 0xd000502e FORMAT "%11.9" /end MEASUREMENT
/begin MEASUREMENT Vtp_cor_it_ar[6] "Final throttle area curve computed from \"A.C.T.A.\" strategy" UWORD _CNV_A_R_LINEAR_____144_CM 1 0. 0. 3.90619e-003 ECU_ADDRESS 0xd0005030 FORMAT "%11.9" /end MEASUREMENT
/begin MEASUREMENT Vtp_cor_it_ar[7] "Final throttle area curve computed from \"A.C.T.A.\" strategy" UWORD _CNV_A_R_LINEAR_____144_CM 1 0. 0. 3.90619e-003 ECU_ADDRESS 0xd0005032 FORMAT "%11.9" /end MEASUREMENT
/begin MEASUREMENT Vtp_cor_it_ar[8] "Final throttle area curve computed from \"A.C.T.A.\" strategy" UWORD _CNV_A_R_LINEAR_____144_CM 1 0. 0. 3.90619e-003 ECU_ADDRESS 0xd0005034 FORMAT "%11.9" /end MEASUREMENT
/begin MEASUREMENT Vtp_cor_it_ar[9] "Final throttle area curve computed from \"A.C.T.A.\" strategy" UWORD _CNV_A_R_LINEAR_____144_CM 1 0. 0. 3.90619e-003 ECU_ADDRESS 0xd0005036 FORMAT "%11.9" /end MEASUREMENT
/begin MEASUREMENT Vtp_cor_it_ar[10] "Final throttle area curve computed from \"A.C.T.A.\" strategy" UWORD _CNV_A_R_LINEAR_____144_CM 1 0. 0. 3.90619e-003 ECU_ADDRESS 0xd0005038 FORMAT "%11.9" /end MEASUREMENT
/begin MEASUREMENT Vtp_cor_it_ar[11] "Final throttle area curve computed from \"A.C.T.A.\" strategy" UWORD _CNV_A_R_LINEAR_____144_CM 1 0. 0. 3.90619e-003 ECU_ADDRESS 0xd000503a FORMAT "%11.9" /end MEASUREMENT
/begin MEASUREMENT Vtp_cor_it_ar[12] "Final throttle area curve computed from \"A.C.T.A.\" strategy" UWORD _CNV_A_R_LINEAR_____144_CM 1 0. 0. 3.90619e-003 ECU_ADDRESS 0xd000503c FORMAT "%11.9" /end MEASUREMENT
/begin MEASUREMENT Vtp_cor_it_ar[13] "Final throttle area curve computed from \"A.C.T.A.\" strategy" UWORD _CNV_A_R_LINEAR_____144_CM 1 0. 0. 3.90619e-003 ECU_ADDRESS 0xd000503e FORMAT "%11.9" /end MEASUREMENT
/begin MEASUREMENT Vtp_cor_it_ar[14] "Final throttle area curve computed from \"A.C.T.A.\" strategy" UWORD _CNV_A_R_LINEAR_____144_CM 1 0. 0. 3.90619e-003 ECU_ADDRESS 0xd0005040 FORMAT "%11.9" /end MEASUREMENT
/begin MEASUREMENT Vtp_cor_it_ar[15] "Final throttle area curve computed from \"A.C.T.A.\" strategy" UWORD _CNV_A_R_LINEAR_____144_CM 1 0. 0. 3.90619e-003 ECU_ADDRESS 0xd0005042 FORMAT "%11.9" /end MEASUREMENT
/begin MEASUREMENT Vtp_cor_it_ar[16] "Final throttle area curve computed from \"A.C.T.A.\" strategy" UWORD _CNV_A_R_LINEAR_____144_CM 1 0. 0. 3.90619e-003 ECU_ADDRESS 0xd0005044 FORMAT "%11.9" /end MEASUREMENT
/begin MEASUREMENT Vtp_int_it_ar[0] "Intermediate throttle area curve computed from \"A.C.T.A\" strategy" UWORD _CNV_A_R_LINEAR_____144_CM 1 0. 0. 3.90619e-003 ECU_ADDRESS 0xd0005048 FORMAT "%11.9" /end MEASUREMENT
/begin MEASUREMENT Vtp_int_it_ar[1] "Intermediate throttle area curve computed from \"A.C.T.A\" strategy" UWORD _CNV_A_R_LINEAR_____144_CM 1 0. 0. 3.90619e-003 ECU_ADDRESS 0xd000504a FORMAT "%11.9" /end MEASUREMENT
/begin MEASUREMENT Vtp_int_it_ar[2] "Intermediate throttle area curve computed from \"A.C.T.A\" strategy" UWORD _CNV_A_R_LINEAR_____144_CM 1 0. 0. 3.90619e-003 ECU_ADDRESS 0xd000504c FORMAT "%11.9" /end MEASUREMENT
/begin MEASUREMENT Vtp_int_it_ar[3] "Intermediate throttle area curve computed from \"A.C.T.A\" strategy" UWORD _CNV_A_R_LINEAR_____144_CM 1 0. 0. 3.90619e-003 ECU_ADDRESS 0xd000504e FORMAT "%11.9" /end MEASUREMENT
/begin MEASUREMENT Vtp_int_it_ar[4] "Intermediate throttle area curve computed from \"A.C.T.A\" strategy" UWORD _CNV_A_R_LINEAR_____144_CM 1 0. 0. 3.90619e-003 ECU_ADDRESS 0xd0005050 FORMAT "%11.9" /end MEASUREMENT
/begin MEASUREMENT Vtp_int_it_ar[5] "Intermediate throttle area curve computed from \"A.C.T.A\" strategy" UWORD _CNV_A_R_LINEAR_____144_CM 1 0. 0. 3.90619e-003 ECU_ADDRESS 0xd0005052 FORMAT "%11.9" /end MEASUREMENT
/begin MEASUREMENT Vtp_int_it_ar[6] "Intermediate throttle area curve computed from \"A.C.T.A\" strategy" UWORD _CNV_A_R_LINEAR_____144_CM 1 0. 0. 3.90619e-003 ECU_ADDRESS 0xd0005054 FORMAT "%11.9" /end MEASUREMENT
/begin MEASUREMENT Vtp_int_it_ar[7] "Intermediate throttle area curve computed from \"A.C.T.A\" strategy" UWORD _CNV_A_R_LINEAR_____144_CM 1 0. 0. 3.90619e-003 ECU_ADDRESS 0xd0005056 FORMAT "%11.9" /end MEASUREMENT
/begin MEASUREMENT Vtp_int_it_ar[8] "Intermediate throttle area curve computed from \"A.C.T.A\" strategy" UWORD _CNV_A_R_LINEAR_____144_CM 1 0. 0. 3.90619e-003 ECU_ADDRESS 0xd0005058 FORMAT "%11.9" /end MEASUREMENT
/begin MEASUREMENT Vtp_int_it_ar[9] "Intermediate throttle area curve computed from \"A.C.T.A\" strategy" UWORD _CNV_A_R_LINEAR_____144_CM 1 0. 0. 3.90619e-003 ECU_ADDRESS 0xd000505a FORMAT "%11.9" /end MEASUREMENT
/begin MEASUREMENT Vtp_int_it_ar[10] "Intermediate throttle area curve computed from \"A.C.T.A\" strategy" UWORD _CNV_A_R_LINEAR_____144_CM 1 0. 0. 3.90619e-003 ECU_ADDRESS 0xd000505c FORMAT "%11.9" /end MEASUREMENT
/begin MEASUREMENT Vtp_int_it_ar[11] "Intermediate throttle area curve computed from \"A.C.T.A\" strategy" UWORD _CNV_A_R_LINEAR_____144_CM 1 0. 0. 3.90619e-003 ECU_ADDRESS 0xd000505e FORMAT "%11.9" /end MEASUREMENT
/begin MEASUREMENT Vtp_int_it_ar[12] "Intermediate throttle area curve computed from \"A.C.T.A\" strategy" UWORD _CNV_A_R_LINEAR_____144_CM 1 0. 0. 3.90619e-003 ECU_ADDRESS 0xd0005060 FORMAT "%11.9" /end MEASUREMENT
/begin MEASUREMENT Vtp_int_it_ar[13] "Intermediate throttle area curve computed from \"A.C.T.A\" strategy" UWORD _CNV_A_R_LINEAR_____144_CM 1 0. 0. 3.90619e-003 ECU_ADDRESS 0xd0005062 FORMAT "%11.9" /end MEASUREMENT
/begin MEASUREMENT Vtp_int_it_ar[14] "Intermediate throttle area curve computed from \"A.C.T.A\" strategy" UWORD _CNV_A_R_LINEAR_____144_CM 1 0. 0. 3.90619e-003 ECU_ADDRESS 0xd0005064 FORMAT "%11.9" /end MEASUREMENT
/begin MEASUREMENT Vtp_int_it_ar[15] "Intermediate throttle area curve computed from \"A.C.T.A\" strategy" UWORD _CNV_A_R_LINEAR_____144_CM 1 0. 0. 3.90619e-003 ECU_ADDRESS 0xd0005066 FORMAT "%11.9" /end MEASUREMENT
/begin MEASUREMENT Vtp_int_it_ar[16] "Intermediate throttle area curve computed from \"A.C.T.A\" strategy" UWORD _CNV_A_R_LINEAR_____144_CM 1 0. 0. 3.90619e-003 ECU_ADDRESS 0xd0005068 FORMAT "%11.9" /end MEASUREMENT
/begin MEASUREMENT Vtp_it_ar_raw[0] "Intermediate throttle area curve computed from \"A.C.T.A\" strategy" UWORD _CNV_A_R_LINEAR_____144_CM 1 0. 0. 3.90619e-003 ECU_ADDRESS 0xd000506c FORMAT "%11.9" /end MEASUREMENT
/begin MEASUREMENT Vtp_it_ar_raw[1] "Intermediate throttle area curve computed from \"A.C.T.A\" strategy" UWORD _CNV_A_R_LINEAR_____144_CM 1 0. 0. 3.90619e-003 ECU_ADDRESS 0xd000506e FORMAT "%11.9" /end MEASUREMENT
/begin MEASUREMENT Vtp_it_ar_raw[2] "Intermediate throttle area curve computed from \"A.C.T.A\" strategy" UWORD _CNV_A_R_LINEAR_____144_CM 1 0. 0. 3.90619e-003 ECU_ADDRESS 0xd0005070 FORMAT "%11.9" /end MEASUREMENT
/begin MEASUREMENT Vtp_it_ar_raw[3] "Intermediate throttle area curve computed from \"A.C.T.A\" strategy" UWORD _CNV_A_R_LINEAR_____144_CM 1 0. 0. 3.90619e-003 ECU_ADDRESS 0xd0005072 FORMAT "%11.9" /end MEASUREMENT
/begin MEASUREMENT Vtp_it_ar_raw[4] "Intermediate throttle area curve computed from \"A.C.T.A\" strategy" UWORD _CNV_A_R_LINEAR_____144_CM 1 0. 0. 3.90619e-003 ECU_ADDRESS 0xd0005074 FORMAT "%11.9" /end MEASUREMENT
/begin MEASUREMENT Vtp_it_ar_raw[5] "Intermediate throttle area curve computed from \"A.C.T.A\" strategy" UWORD _CNV_A_R_LINEAR_____144_CM 1 0. 0. 3.90619e-003 ECU_ADDRESS 0xd0005076 FORMAT "%11.9" /end MEASUREMENT
/begin MEASUREMENT Vtp_it_ar_raw[6] "Intermediate throttle area curve computed from \"A.C.T.A\" strategy" UWORD _CNV_A_R_LINEAR_____144_CM 1 0. 0. 3.90619e-003 ECU_ADDRESS 0xd0005078 FORMAT "%11.9" /end MEASUREMENT
/begin MEASUREMENT Vtp_it_ar_raw[7] "Intermediate throttle area curve computed from \"A.C.T.A\" strategy" UWORD _CNV_A_R_LINEAR_____144_CM 1 0. 0. 3.90619e-003 ECU_ADDRESS 0xd000507a FORMAT "%11.9" /end MEASUREMENT
/begin MEASUREMENT Vtp_it_ar_raw[8] "Intermediate throttle area curve computed from \"A.C.T.A\" strategy" UWORD _CNV_A_R_LINEAR_____144_CM 1 0. 0. 3.90619e-003 ECU_ADDRESS 0xd000507c FORMAT "%11.9" /end MEASUREMENT
/begin MEASUREMENT Vtp_it_ar_raw[9] "Intermediate throttle area curve computed from \"A.C.T.A\" strategy" UWORD _CNV_A_R_LINEAR_____144_CM 1 0. 0. 3.90619e-003 ECU_ADDRESS 0xd000507e FORMAT "%11.9" /end MEASUREMENT
/begin MEASUREMENT Vtp_it_ar_raw[10] "Intermediate throttle area curve computed from \"A.C.T.A\" strategy" UWORD _CNV_A_R_LINEAR_____144_CM 1 0. 0. 3.90619e-003 ECU_ADDRESS 0xd0005080 FORMAT "%11.9" /end MEASUREMENT
/begin MEASUREMENT Vtp_it_ar_raw[11] "Intermediate throttle area curve computed from \"A.C.T.A\" strategy" UWORD _CNV_A_R_LINEAR_____144_CM 1 0. 0. 3.90619e-003 ECU_ADDRESS 0xd0005082 FORMAT "%11.9" /end MEASUREMENT
/begin MEASUREMENT Vtp_it_ar_raw[12] "Intermediate throttle area curve computed from \"A.C.T.A\" strategy" UWORD _CNV_A_R_LINEAR_____144_CM 1 0. 0. 3.90619e-003 ECU_ADDRESS 0xd0005084 FORMAT "%11.9" /end MEASUREMENT
/begin MEASUREMENT Vtp_it_ar_raw[13] "Intermediate throttle area curve computed from \"A.C.T.A\" strategy" UWORD _CNV_A_R_LINEAR_____144_CM 1 0. 0. 3.90619e-003 ECU_ADDRESS 0xd0005086 FORMAT "%11.9" /end MEASUREMENT
/begin MEASUREMENT Vtp_it_ar_raw[14] "Intermediate throttle area curve computed from \"A.C.T.A\" strategy" UWORD _CNV_A_R_LINEAR_____144_CM 1 0. 0. 3.90619e-003 ECU_ADDRESS 0xd0005088 FORMAT "%11.9" /end MEASUREMENT
/begin MEASUREMENT Vtp_it_ar_raw[15] "Intermediate throttle area curve computed from \"A.C.T.A\" strategy" UWORD _CNV_A_R_LINEAR_____144_CM 1 0. 0. 3.90619e-003 ECU_ADDRESS 0xd000508a FORMAT "%11.9" /end MEASUREMENT
/begin MEASUREMENT Vtp_it_ar_raw[16] "Intermediate throttle area curve computed from \"A.C.T.A\" strategy" UWORD _CNV_A_R_LINEAR_____144_CM 1 0. 0. 3.90619e-003 ECU_ADDRESS 0xd000508c FORMAT "%11.9" /end MEASUREMENT
/begin MEASUREMENT Vtp_lim_it_ar[0] "Limited intermediate throttle area curve computed from \"A.C.T.A\" strategy" UWORD _CNV_A_R_LINEAR_____144_CM 1 0. 0. 3.90619e-003 ECU_ADDRESS 0xd0005090 FORMAT "%11.9" /end MEASUREMENT
/begin MEASUREMENT Vtp_lim_it_ar[1] "Limited intermediate throttle area curve computed from \"A.C.T.A\" strategy" UWORD _CNV_A_R_LINEAR_____144_CM 1 0. 0. 3.90619e-003 ECU_ADDRESS 0xd0005092 FORMAT "%11.9" /end MEASUREMENT
/begin MEASUREMENT Vtp_lim_it_ar[2] "Limited intermediate throttle area curve computed from \"A.C.T.A\" strategy" UWORD _CNV_A_R_LINEAR_____144_CM 1 0. 0. 3.90619e-003 ECU_ADDRESS 0xd0005094 FORMAT "%11.9" /end MEASUREMENT
/begin MEASUREMENT Vtp_lim_it_ar[3] "Limited intermediate throttle area curve computed from \"A.C.T.A\" strategy" UWORD _CNV_A_R_LINEAR_____144_CM 1 0. 0. 3.90619e-003 ECU_ADDRESS 0xd0005096 FORMAT "%11.9" /end MEASUREMENT
/begin MEASUREMENT Vtp_lim_it_ar[4] "Limited intermediate throttle area curve computed from \"A.C.T.A\" strategy" UWORD _CNV_A_R_LINEAR_____144_CM 1 0. 0. 3.90619e-003 ECU_ADDRESS 0xd0005098 FORMAT "%11.9" /end MEASUREMENT
/begin MEASUREMENT Vtp_lim_it_ar[5] "Limited intermediate throttle area curve computed from \"A.C.T.A\" strategy" UWORD _CNV_A_R_LINEAR_____144_CM 1 0. 0. 3.90619e-003 ECU_ADDRESS 0xd000509a FORMAT "%11.9" /end MEASUREMENT
/begin MEASUREMENT Vtp_lim_it_ar[6] "Limited intermediate throttle area curve computed from \"A.C.T.A\" strategy" UWORD _CNV_A_R_LINEAR_____144_CM 1 0. 0. 3.90619e-003 ECU_ADDRESS 0xd000509c FORMAT "%11.9" /end MEASUREMENT
/begin MEASUREMENT Vtp_lim_it_ar[7] "Limited intermediate throttle area curve computed from \"A.C.T.A\" strategy" UWORD _CNV_A_R_LINEAR_____144_CM 1 0. 0. 3.90619e-003 ECU_ADDRESS 0xd000509e FORMAT "%11.9" /end MEASUREMENT
/begin MEASUREMENT Vtp_lim_it_ar[8] "Limited intermediate throttle area curve computed from \"A.C.T.A\" strategy" UWORD _CNV_A_R_LINEAR_____144_CM 1 0. 0. 3.90619e-003 ECU_ADDRESS 0xd00050a0 FORMAT "%11.9" /end MEASUREMENT
/begin MEASUREMENT Vtp_lim_it_ar[9] "Limited intermediate throttle area curve computed from \"A.C.T.A\" strategy" UWORD _CNV_A_R_LINEAR_____144_CM 1 0. 0. 3.90619e-003 ECU_ADDRESS 0xd00050a2 FORMAT "%11.9" /end MEASUREMENT
/begin MEASUREMENT Vtp_lim_it_ar[10] "Limited intermediate throttle area curve computed from \"A.C.T.A\" strategy" UWORD _CNV_A_R_LINEAR_____144_CM 1 0. 0. 3.90619e-003 ECU_ADDRESS 0xd00050a4 FORMAT "%11.9" /end MEASUREMENT
/begin MEASUREMENT Vtp_lim_it_ar[11] "Limited intermediate throttle area curve computed from \"A.C.T.A\" strategy" UWORD _CNV_A_R_LINEAR_____144_CM 1 0. 0. 3.90619e-003 ECU_ADDRESS 0xd00050a6 FORMAT "%11.9" /end MEASUREMENT
/begin MEASUREMENT Vtp_lim_it_ar[12] "Limited intermediate throttle area curve computed from \"A.C.T.A\" strategy" UWORD _CNV_A_R_LINEAR_____144_CM 1 0. 0. 3.90619e-003 ECU_ADDRESS 0xd00050a8 FORMAT "%11.9" /end MEASUREMENT
/begin MEASUREMENT Vtp_lim_it_ar[13] "Limited intermediate throttle area curve computed from \"A.C.T.A\" strategy" UWORD _CNV_A_R_LINEAR_____144_CM 1 0. 0. 3.90619e-003 ECU_ADDRESS 0xd00050aa FORMAT "%11.9" /end MEASUREMENT
/begin MEASUREMENT Vtp_lim_it_ar[14] "Limited intermediate throttle area curve computed from \"A.C.T.A\" strategy" UWORD _CNV_A_R_LINEAR_____144_CM 1 0. 0. 3.90619e-003 ECU_ADDRESS 0xd00050ac FORMAT "%11.9" /end MEASUREMENT
/begin MEASUREMENT Vtp_lim_it_ar[15] "Limited intermediate throttle area curve computed from \"A.C.T.A\" strategy" UWORD _CNV_A_R_LINEAR_____144_CM 1 0. 0. 3.90619e-003 ECU_ADDRESS 0xd00050ae FORMAT "%11.9" /end MEASUREMENT
/begin MEASUREMENT Vtp_lim_it_ar[16] "Limited intermediate throttle area curve computed from \"A.C.T.A\" strategy" UWORD _CNV_A_R_LINEAR_____144_CM 1 0. 0. 3.90619e-003 ECU_ADDRESS 0xd00050b0 FORMAT "%11.9" /end MEASUREMENT
/begin MEASUREMENT Vtx_fac_cor_it_adj[0] "Vector of correction values for throttle area curve" UWORD _CNV_A_R_LINEAR_____151_CM 1 0. 0.9 1.099996948 ECU_ADDRESS 0xd00050b4 FORMAT "%16.12" /end MEASUREMENT
/begin MEASUREMENT Vtx_fac_cor_it_adj[1] "Vector of correction values for throttle area curve" UWORD _CNV_A_R_LINEAR_____151_CM 1 0. 0.9 1.099996948 ECU_ADDRESS 0xd00050b6 FORMAT "%16.12" /end MEASUREMENT
/begin MEASUREMENT Vtx_fac_cor_it_adj[2] "Vector of correction values for throttle area curve" UWORD _CNV_A_R_LINEAR_____151_CM 1 0. 0.9 1.099996948 ECU_ADDRESS 0xd00050b8 FORMAT "%16.12" /end MEASUREMENT
/begin MEASUREMENT Vtx_fac_cor_it_adj[3] "Vector of correction values for throttle area curve" UWORD _CNV_A_R_LINEAR_____151_CM 1 0. 0.9 1.099996948 ECU_ADDRESS 0xd00050ba FORMAT "%16.12" /end MEASUREMENT
/begin MEASUREMENT Vtx_fac_cor_it_adj[4] "Vector of correction values for throttle area curve" UWORD _CNV_A_R_LINEAR_____151_CM 1 0. 0.9 1.099996948 ECU_ADDRESS 0xd00050bc FORMAT "%16.12" /end MEASUREMENT
/begin MEASUREMENT Vtx_fac_cor_it_adj[5] "Vector of correction values for throttle area curve" UWORD _CNV_A_R_LINEAR_____151_CM 1 0. 0.9 1.099996948 ECU_ADDRESS 0xd00050be FORMAT "%16.12" /end MEASUREMENT
/begin MEASUREMENT Vtx_fac_cor_it_adj[6] "Vector of correction values for throttle area curve" UWORD _CNV_A_R_LINEAR_____151_CM 1 0. 0.9 1.099996948 ECU_ADDRESS 0xd00050c0 FORMAT "%16.12" /end MEASUREMENT
/begin MEASUREMENT Vtx_fac_cor_it_adj[7] "Vector of correction values for throttle area curve" UWORD _CNV_A_R_LINEAR_____151_CM 1 0. 0.9 1.099996948 ECU_ADDRESS 0xd00050c2 FORMAT "%16.12" /end MEASUREMENT
/begin MEASUREMENT Vtx_fac_cor_it_adj[8] "Vector of correction values for throttle area curve" UWORD _CNV_A_R_LINEAR_____151_CM 1 0. 0.9 1.099996948 ECU_ADDRESS 0xd00050c4 FORMAT "%16.12" /end MEASUREMENT
/begin MEASUREMENT Vtx_fac_cor_it_adj[9] "Vector of correction values for throttle area curve" UWORD _CNV_A_R_LINEAR_____151_CM 1 0. 0.9 1.099996948 ECU_ADDRESS 0xd00050c6 FORMAT "%16.12" /end MEASUREMENT
/begin MEASUREMENT Vtx_fac_cor_it_adj[10] "Vector of correction values for throttle area curve" UWORD _CNV_A_R_LINEAR_____151_CM 1 0. 0.9 1.099996948 ECU_ADDRESS 0xd00050c8 FORMAT "%16.12" /end MEASUREMENT
/begin MEASUREMENT Vtx_fac_cor_it_adj[11] "Vector of correction values for throttle area curve" UWORD _CNV_A_R_LINEAR_____151_CM 1 0. 0.9 1.099996948 ECU_ADDRESS 0xd00050ca FORMAT "%16.12" /end MEASUREMENT
/begin MEASUREMENT Vtx_fac_cor_it_adj[12] "Vector of correction values for throttle area curve" UWORD _CNV_A_R_LINEAR_____151_CM 1 0. 0.9 1.099996948 ECU_ADDRESS 0xd00050cc FORMAT "%16.12" /end MEASUREMENT
/begin MEASUREMENT Vtx_fac_cor_it_adj[13] "Vector of correction values for throttle area curve" UWORD _CNV_A_R_LINEAR_____151_CM 1 0. 0.9 1.099996948 ECU_ADDRESS 0xd00050ce FORMAT "%16.12" /end MEASUREMENT
/begin MEASUREMENT Vtx_fac_cor_it_adj[14] "Vector of correction values for throttle area curve" UWORD _CNV_A_R_LINEAR_____151_CM 1 0. 0.9 1.099996948 ECU_ADDRESS 0xd00050d0 FORMAT "%16.12" /end MEASUREMENT
/begin MEASUREMENT Vtx_fac_cor_it_adj[15] "Vector of correction values for throttle area curve" UWORD _CNV_A_R_LINEAR_____151_CM 1 0. 0.9 1.099996948 ECU_ADDRESS 0xd00050d2 FORMAT "%16.12" /end MEASUREMENT
/begin MEASUREMENT Vtx_fac_cor_it_adj[16] "Vector of correction values for throttle area curve" UWORD _CNV_A_R_LINEAR_____151_CM 1 0. 0.9 1.099996948 ECU_ADDRESS 0xd00050d4 FORMAT "%16.12" /end MEASUREMENT
/begin MEASUREMENT Vxx_fil_fac_cor_it_adj "Filtered corrective value computed from M.A.P error between measured and modelised values" UWORD _CNV_A_R_LINEAR_____152_CM 1 0. -0.1 9.999694824218749e-002 ECU_ADDRESS 0xd00050d6 FORMAT "%16.12" /end MEASUREMENT
/begin MEASUREMENT Vxx_raw_fac_cor_it_adj "Raw value computed from M.A.P error between measured and modelised values" UWORD _CNV_A_R_LINEAR_____152_CM 1 0. -0.1 9.999694824218749e-002 ECU_ADDRESS 0xd00050d8 FORMAT "%16.12" /end MEASUREMENT
/begin CHARACTERISTIC Cbx_bch_cp_it_adj "Bench mode to activate the strategy independently to canister purge phase" VALUE 0xa0020c8e _REC_S1VAL_20_u1 1. _CNV_S_2_RANGE______3_CM 0. 1. /end CHARACTERISTIC
/begin CHARACTERISTIC Cbx_bch_dsb_it_adj "Bench mode to inhibit \"A.C.T.A\" strategy" VALUE 0xa0020c8f _REC_S1VAL_20_u1 1. _CNV_S_2_RANGE______3_CM 0. 1. /end CHARACTERISTIC
/begin CHARACTERISTIC Cbx_bch_dsb_it_adj_val "General bench mode value activating (On) or deactivating (Off) the strategy" VALUE 0xa0020c90 _REC_S1VAL_20_u1 1. _CNV_S_2_RANGE______3_CM 0. 1. /end CHARACTERISTIC
/begin CHARACTERISTIC Cbx_bch_rst_it_adj "Bench mode to reset the corrected throttle area computed from \"A.C.T.A\" strategy" VALUE 0xa0020c91 _REC_S1VAL_20_u1 1. _CNV_S_2_RANGE______3_CM 0. 1. /end CHARACTERISTIC
/begin CHARACTERISTIC Cbx_ena_appl_it_adj "Bench mode to enable the corrected throttle area computed from \"A.C.T.A\" strategy" VALUE 0xa0020c92 _REC_S1VAL_20_u1 1. _CNV_S_2_RANGE______3_CM 0. 1. /end CHARACTERISTIC
/begin CHARACTERISTIC Ctb_it_ar[0] "Reference throttle area curve tuned with reference throttle and engine" VALUE 0xa0025010 _REC_S1VAL_20_u2 3.906190395355219e-003 _CNV_A_R_LINEAR_____148_CM 0. 3.90619039535522e-003 FORMAT "%16.12" /end CHARACTERISTIC
/begin CHARACTERISTIC Ctb_it_ar[1] "Reference throttle area curve tuned with reference throttle and engine" VALUE 0xa0025012 _REC_S1VAL_20_u2 3.906190395355219e-003 _CNV_A_R_LINEAR_____148_CM 0. 3.90619039535522e-003 FORMAT "%16.12" /end CHARACTERISTIC
/begin CHARACTERISTIC Ctb_it_ar[2] "Reference throttle area curve tuned with reference throttle and engine" VALUE 0xa0025014 _REC_S1VAL_20_u2 3.906190395355219e-003 _CNV_A_R_LINEAR_____148_CM 0. 3.90619039535522e-003 FORMAT "%16.12" /end CHARACTERISTIC
/begin CHARACTERISTIC Ctb_it_ar[3] "Reference throttle area curve tuned with reference throttle and engine" VALUE 0xa0025016 _REC_S1VAL_20_u2 3.906190395355219e-003 _CNV_A_R_LINEAR_____148_CM 0. 3.90619039535522e-003 FORMAT "%16.12" /end CHARACTERISTIC
/begin CHARACTERISTIC Ctb_it_ar[4] "Reference throttle area curve tuned with reference throttle and engine" VALUE 0xa0025018 _REC_S1VAL_20_u2 3.906190395355219e-003 _CNV_A_R_LINEAR_____148_CM 0. 3.90619039535522e-003 FORMAT "%16.12" /end CHARACTERISTIC
/begin CHARACTERISTIC Ctb_it_ar[5] "Reference throttle area curve tuned with reference throttle and engine" VALUE 0xa002501a _REC_S1VAL_20_u2 3.906190395355219e-003 _CNV_A_R_LINEAR_____148_CM 0. 3.90619039535522e-003 FORMAT "%16.12" /end CHARACTERISTIC
/begin CHARACTERISTIC Ctb_it_ar[6] "Reference throttle area curve tuned with reference throttle and engine" VALUE 0xa002501c _REC_S1VAL_20_u2 3.906190395355219e-003 _CNV_A_R_LINEAR_____148_CM 0. 3.90619039535522e-003 FORMAT "%16.12" /end CHARACTERISTIC
/begin CHARACTERISTIC Ctb_it_ar[7] "Reference throttle area curve tuned with reference throttle and engine" VALUE 0xa002501e _REC_S1VAL_20_u2 3.906190395355219e-003 _CNV_A_R_LINEAR_____148_CM 0. 3.90619039535522e-003 FORMAT "%16.12" /end CHARACTERISTIC
/begin CHARACTERISTIC Ctb_it_ar[8] "Reference throttle area curve tuned with reference throttle and engine" VALUE 0xa0025020 _REC_S1VAL_20_u2 3.906190395355219e-003 _CNV_A_R_LINEAR_____148_CM 0. 3.90619039535522e-003 FORMAT "%16.12" /end CHARACTERISTIC
/begin CHARACTERISTIC Ctb_it_ar[9] "Reference throttle area curve tuned with reference throttle and engine" VALUE 0xa0025022 _REC_S1VAL_20_u2 3.906190395355219e-003 _CNV_A_R_LINEAR_____148_CM 0. 3.90619039535522e-003 FORMAT "%16.12" /end CHARACTERISTIC
/begin CHARACTERISTIC Ctb_it_ar[10] "Reference throttle area curve tuned with reference throttle and engine" VALUE 0xa0025024 _REC_S1VAL_20_u2 3.906190395355219e-003 _CNV_A_R_LINEAR_____148_CM 0. 3.90619039535522e-003 FORMAT "%16.12" /end CHARACTERISTIC
/begin CHARACTERISTIC Ctb_it_ar[11] "Reference throttle area curve tuned with reference throttle and engine" VALUE 0xa0025026 _REC_S1VAL_20_u2 3.906190395355219e-003 _CNV_A_R_LINEAR_____148_CM 0. 3.90619039535522e-003 FORMAT "%16.12" /end CHARACTERISTIC
/begin CHARACTERISTIC Ctb_it_ar[12] "Reference throttle area curve tuned with reference throttle and engine" VALUE 0xa0025028 _REC_S1VAL_20_u2 3.906190395355219e-003 _CNV_A_R_LINEAR_____148_CM 0. 3.90619039535522e-003 FORMAT "%16.12" /end CHARACTERISTIC
/begin CHARACTERISTIC Ctb_it_ar[13] "Reference throttle area curve tuned with reference throttle and engine" VALUE 0xa002502a _REC_S1VAL_20_u2 3.906190395355219e-003 _CNV_A_R_LINEAR_____148_CM 0. 3.90619039535522e-003 FORMAT "%16.12" /end CHARACTERISTIC
/begin CHARACTERISTIC Ctb_it_ar[14] "Reference throttle area curve tuned with reference throttle and engine" VALUE 0xa002502c _REC_S1VAL_20_u2 3.906190395355219e-003 _CNV_A_R_LINEAR_____148_CM 0. 3.90619039535522e-003 FORMAT "%16.12" /end CHARACTERISTIC
/begin CHARACTERISTIC Ctb_it_ar[15] "Reference throttle area curve tuned with reference throttle and engine" VALUE 0xa002502e _REC_S1VAL_20_u2 3.906190395355219e-003 _CNV_A_R_LINEAR_____148_CM 0. 3.90619039535522e-003 FORMAT "%16.12" /end CHARACTERISTIC
/begin CHARACTERISTIC Ctb_it_ar[16] "Reference throttle area curve tuned with reference throttle and engine" VALUE 0xa0025030 _REC_S1VAL_20_u2 3.906190395355219e-003 _CNV_A_R_LINEAR_____148_CM 0. 3.90619039535522e-003 FORMAT "%16.12" /end CHARACTERISTIC
/begin CHARACTERISTIC Ctx_fac_cor_it_ar_max[0] "Table of gain on reference throttle area curve to define minimum throttle area curve" VALUE 0xa0025034 _REC_S1VAL_20_u2 0.99609375 _CNV_A_R_LINEAR_____153_CM 1. 1.99609375 FORMAT "%10.8" /end CHARACTERISTIC
/begin CHARACTERISTIC Ctx_fac_cor_it_ar_max[1] "Table of gain on reference throttle area curve to define minimum throttle area curve" VALUE 0xa0025036 _REC_S1VAL_20_u2 0.99609375 _CNV_A_R_LINEAR_____153_CM 1. 1.99609375 FORMAT "%10.8" /end CHARACTERISTIC
/begin CHARACTERISTIC Ctx_fac_cor_it_ar_max[2] "Table of gain on reference throttle area curve to define minimum throttle area curve" VALUE 0xa0025038 _REC_S1VAL_20_u2 0.99609375 _CNV_A_R_LINEAR_____153_CM 1. 1.99609375 FORMAT "%10.8" /end CHARACTERISTIC
/begin CHARACTERISTIC Ctx_fac_cor_it_ar_max[3] "Table of gain on reference throttle area curve to define minimum throttle area curve" VALUE 0xa002503a _REC_S1VAL_20_u2 0.99609375 _CNV_A_R_LINEAR_____153_CM 1. 1.99609375 FORMAT "%10.8" /end CHARACTERISTIC
/begin CHARACTERISTIC Ctx_fac_cor_it_ar_max[4] "Table of gain on reference throttle area curve to define minimum throttle area curve" VALUE 0xa002503c _REC_S1VAL_20_u2 0.99609375 _CNV_A_R_LINEAR_____153_CM 1. 1.99609375 FORMAT "%10.8" /end CHARACTERISTIC
/begin CHARACTERISTIC Ctx_fac_cor_it_ar_max[5] "Table of gain on reference throttle area curve to define minimum throttle area curve" VALUE 0xa002503e _REC_S1VAL_20_u2 0.99609375 _CNV_A_R_LINEAR_____153_CM 1. 1.99609375 FORMAT "%10.8" /end CHARACTERISTIC
/begin CHARACTERISTIC Ctx_fac_cor_it_ar_max[6] "Table of gain on reference throttle area curve to define minimum throttle area curve" VALUE 0xa0025040 _REC_S1VAL_20_u2 0.99609375 _CNV_A_R_LINEAR_____153_CM 1. 1.99609375 FORMAT "%10.8" /end CHARACTERISTIC
/begin CHARACTERISTIC Ctx_fac_cor_it_ar_max[7] "Table of gain on reference throttle area curve to define minimum throttle area curve" VALUE 0xa0025042 _REC_S1VAL_20_u2 0.99609375 _CNV_A_R_LINEAR_____153_CM 1. 1.99609375 FORMAT "%10.8" /end CHARACTERISTIC
/begin CHARACTERISTIC Ctx_fac_cor_it_ar_max[8] "Table of gain on reference throttle area curve to define minimum throttle area curve" VALUE 0xa0025044 _REC_S1VAL_20_u2 0.99609375 _CNV_A_R_LINEAR_____153_CM 1. 1.99609375 FORMAT "%10.8" /end CHARACTERISTIC
/begin CHARACTERISTIC Ctx_fac_cor_it_ar_max[9] "Table of gain on reference throttle area curve to define minimum throttle area curve" VALUE 0xa0025046 _REC_S1VAL_20_u2 0.99609375 _CNV_A_R_LINEAR_____153_CM 1. 1.99609375 FORMAT "%10.8" /end CHARACTERISTIC
/begin CHARACTERISTIC Ctx_fac_cor_it_ar_max[10] "Table of gain on reference throttle area curve to define minimum throttle area curve" VALUE 0xa0025048 _REC_S1VAL_20_u2 0.99609375 _CNV_A_R_LINEAR_____153_CM 1. 1.99609375 FORMAT "%10.8" /end CHARACTERISTIC
/begin CHARACTERISTIC Ctx_fac_cor_it_ar_max[11] "Table of gain on reference throttle area curve to define minimum throttle area curve" VALUE 0xa002504a _REC_S1VAL_20_u2 0.99609375 _CNV_A_R_LINEAR_____153_CM 1. 1.99609375 FORMAT "%10.8" /end CHARACTERISTIC
/begin CHARACTERISTIC Ctx_fac_cor_it_ar_max[12] "Table of gain on reference throttle area curve to define minimum throttle area curve" VALUE 0xa002504c _REC_S1VAL_20_u2 0.99609375 _CNV_A_R_LINEAR_____153_CM 1. 1.99609375 FORMAT "%10.8" /end CHARACTERISTIC
/begin CHARACTERISTIC Ctx_fac_cor_it_ar_max[13] "Table of gain on reference throttle area curve to define minimum throttle area curve" VALUE 0xa002504e _REC_S1VAL_20_u2 0.99609375 _CNV_A_R_LINEAR_____153_CM 1. 1.99609375 FORMAT "%10.8" /end CHARACTERISTIC
/begin CHARACTERISTIC Ctx_fac_cor_it_ar_max[14] "Table of gain on reference throttle area curve to define minimum throttle area curve" VALUE 0xa0025050 _REC_S1VAL_20_u2 0.99609375 _CNV_A_R_LINEAR_____153_CM 1. 1.99609375 FORMAT "%10.8" /end CHARACTERISTIC
/begin CHARACTERISTIC Ctx_fac_cor_it_ar_max[15] "Table of gain on reference throttle area curve to define minimum throttle area curve" VALUE 0xa0025052 _REC_S1VAL_20_u2 0.99609375 _CNV_A_R_LINEAR_____153_CM 1. 1.99609375 FORMAT "%10.8" /end CHARACTERISTIC
/begin CHARACTERISTIC Ctx_fac_cor_it_ar_max[16] "Table of gain on reference throttle area curve to define minimum throttle area curve" VALUE 0xa0025054 _REC_S1VAL_20_u2 0.99609375 _CNV_A_R_LINEAR_____153_CM 1. 1.99609375 FORMAT "%10.8" /end CHARACTERISTIC
/begin CHARACTERISTIC Ctx_fac_cor_it_ar_min[0] "Table of gain on reference throttle area curve to define minimum throttle area curve" VALUE 0xa0025058 _REC_S1VAL_20_u2 0.99609375 _CNV_A_R_LINEAR_____29_CM 0. 0.99609375 FORMAT "%10.8" /end CHARACTERISTIC
/begin CHARACTERISTIC Ctx_fac_cor_it_ar_min[1] "Table of gain on reference throttle area curve to define minimum throttle area curve" VALUE 0xa002505a _REC_S1VAL_20_u2 0.99609375 _CNV_A_R_LINEAR_____29_CM 0. 0.99609375 FORMAT "%10.8" /end CHARACTERISTIC
/begin CHARACTERISTIC Ctx_fac_cor_it_ar_min[2] "Table of gain on reference throttle area curve to define minimum throttle area curve" VALUE 0xa002505c _REC_S1VAL_20_u2 0.99609375 _CNV_A_R_LINEAR_____29_CM 0. 0.99609375 FORMAT "%10.8" /end CHARACTERISTIC
/begin CHARACTERISTIC Ctx_fac_cor_it_ar_min[3] "Table of gain on reference throttle area curve to define minimum throttle area curve" VALUE 0xa002505e _REC_S1VAL_20_u2 0.99609375 _CNV_A_R_LINEAR_____29_CM 0. 0.99609375 FORMAT "%10.8" /end CHARACTERISTIC
/begin CHARACTERISTIC Ctx_fac_cor_it_ar_min[4] "Table of gain on reference throttle area curve to define minimum throttle area curve" VALUE 0xa0025060 _REC_S1VAL_20_u2 0.99609375 _CNV_A_R_LINEAR_____29_CM 0. 0.99609375 FORMAT "%10.8" /end CHARACTERISTIC
/begin CHARACTERISTIC Ctx_fac_cor_it_ar_min[5] "Table of gain on reference throttle area curve to define minimum throttle area curve" VALUE 0xa0025062 _REC_S1VAL_20_u2 0.99609375 _CNV_A_R_LINEAR_____29_CM 0. 0.99609375 FORMAT "%10.8" /end CHARACTERISTIC
/begin CHARACTERISTIC Ctx_fac_cor_it_ar_min[6] "Table of gain on reference throttle area curve to define minimum throttle area curve" VALUE 0xa0025064 _REC_S1VAL_20_u2 0.99609375 _CNV_A_R_LINEAR_____29_CM 0. 0.99609375 FORMAT "%10.8" /end CHARACTERISTIC
/begin CHARACTERISTIC Ctx_fac_cor_it_ar_min[7] "Table of gain on reference throttle area curve to define minimum throttle area curve" VALUE 0xa0025066 _REC_S1VAL_20_u2 0.99609375 _CNV_A_R_LINEAR_____29_CM 0. 0.99609375 FORMAT "%10.8" /end CHARACTERISTIC
/begin CHARACTERISTIC Ctx_fac_cor_it_ar_min[8] "Table of gain on reference throttle area curve to define minimum throttle area curve" VALUE 0xa0025068 _REC_S1VAL_20_u2 0.99609375 _CNV_A_R_LINEAR_____29_CM 0. 0.99609375 FORMAT "%10.8" /end CHARACTERISTIC
/begin CHARACTERISTIC Ctx_fac_cor_it_ar_min[9] "Table of gain on reference throttle area curve to define minimum throttle area curve" VALUE 0xa002506a _REC_S1VAL_20_u2 0.99609375 _CNV_A_R_LINEAR_____29_CM 0. 0.99609375 FORMAT "%10.8" /end CHARACTERISTIC
/begin CHARACTERISTIC Ctx_fac_cor_it_ar_min[10] "Table of gain on reference throttle area curve to define minimum throttle area curve" VALUE 0xa002506c _REC_S1VAL_20_u2 0.99609375 _CNV_A_R_LINEAR_____29_CM 0. 0.99609375 FORMAT "%10.8" /end CHARACTERISTIC
/begin CHARACTERISTIC Ctx_fac_cor_it_ar_min[11] "Table of gain on reference throttle area curve to define minimum throttle area curve" VALUE 0xa002506e _REC_S1VAL_20_u2 0.99609375 _CNV_A_R_LINEAR_____29_CM 0. 0.99609375 FORMAT "%10.8" /end CHARACTERISTIC
/begin CHARACTERISTIC Ctx_fac_cor_it_ar_min[12] "Table of gain on reference throttle area curve to define minimum throttle area curve" VALUE 0xa0025070 _REC_S1VAL_20_u2 0.99609375 _CNV_A_R_LINEAR_____29_CM 0. 0.99609375 FORMAT "%10.8" /end CHARACTERISTIC
/begin CHARACTERISTIC Ctx_fac_cor_it_ar_min[13] "Table of gain on reference throttle area curve to define minimum throttle area curve" VALUE 0xa0025072 _REC_S1VAL_20_u2 0.99609375 _CNV_A_R_LINEAR_____29_CM 0. 0.99609375 FORMAT "%10.8" /end CHARACTERISTIC
/begin CHARACTERISTIC Ctx_fac_cor_it_ar_min[14] "Table of gain on reference throttle area curve to define minimum throttle area curve" VALUE 0xa0025074 _REC_S1VAL_20_u2 0.99609375 _CNV_A_R_LINEAR_____29_CM 0. 0.99609375 FORMAT "%10.8" /end CHARACTERISTIC
/begin CHARACTERISTIC Ctx_fac_cor_it_ar_min[15] "Table of gain on reference throttle area curve to define minimum throttle area curve" VALUE 0xa0025076 _REC_S1VAL_20_u2 0.99609375 _CNV_A_R_LINEAR_____29_CM 0. 0.99609375 FORMAT "%10.8" /end CHARACTERISTIC
/begin CHARACTERISTIC Ctx_fac_cor_it_ar_min[16] "Table of gain on reference throttle area curve to define minimum throttle area curve" VALUE 0xa0025078 _REC_S1VAL_20_u2 0.99609375 _CNV_A_R_LINEAR_____29_CM 0. 0.99609375 FORMAT "%10.8" /end CHARACTERISTIC
/begin CHARACTERISTIC Cxx_adj_fac_it_adj "\"Gradual term\" to compute the corrective vector (< length of throttle table curve)" VALUE 0xa0020c93 _REC_S1VAL_20_u1 254. _CNV_A_R_ECME_LINEA_0_CM 1. 255. FORMAT "%1.0" /end CHARACTERISTIC
/begin CHARACTERISTIC Cxx_amp_upd_t_rst "Timing value after altimetric pressure reactualization to enable \"A.C.T.A\" computing" VALUE 0xa0020c68 _REC_S1VAL_20_u2 6553.5 _CNV_A_R_LINEAR_____58_CM 0. 6553.5 FORMAT "%6.1" /end CHARACTERISTIC
/begin CHARACTERISTIC Cxx_cor_it_adj_ftc "Filtering factor for raw corrective \"ACTA\" value" VALUE 0xa0020c6a _REC_S1VAL_20_u2 655.35 _CNV_A_R_LINEAR_____32_CM 0. 655.35 FORMAT "%6.2" /end CHARACTERISTIC
/begin CHARACTERISTIC Cxx_fac_cor_it_adj "Gain value on error between measured and modelised pressure" VALUE 0xa0020c6c _REC_S1VAL_20_u2 0.9999847412109381 _CNV_A_R_LINEAR_____7_CM 0. 0.9999847412109381 FORMAT "%16.12" /end CHARACTERISTIC
/begin CHARACTERISTIC Cxx_map_min_it_adj "Minimum M.A.P value to activate \"A.C.T.A\" computing" VALUE 0xa0020c6e _REC_S1VAL_20_u2 20000. _CNV_A_R_LINEAR_____115_CM 0. 20000. FORMAT "%1.0" /end CHARACTERISTIC
/begin CHARACTERISTIC Cxx_map_rat_max_it_adj "Maximum M.A.P ratio to activate \"A.C.T.A\" computing" VALUE 0xa0020c70 _REC_S1VAL_20_u2 0.9999847412109381 _CNV_A_R_LINEAR_____7_CM 0. 0.9999847412109381 FORMAT "%16.12" /end CHARACTERISTIC
/begin CHARACTERISTIC Cxx_mat_max_it_adj "Threshold max of air temperature for \"A.C.T.A\" computing conditions" VALUE 0xa0020c72 _REC_S1VAL_20_u2 240. _CNV_A_R_LINEAR_____110_CM -40. 200. FORMAT "%5.1" /end CHARACTERISTIC
/begin CHARACTERISTIC Cxx_mat_min_it_adj "Threshold min of air temperature for \"A.C.T.A\" computing conditions" VALUE 0xa0020c74 _REC_S1VAL_20_u2 240. _CNV_A_R_LINEAR_____110_CM -40. 200. FORMAT "%5.1" /end CHARACTERISTIC
/begin CHARACTERISTIC Cxx_min_ar_grd_it_adj "Minimum area between two modified breakpoints in the throttle area curve" VALUE 0xa0020c76 _REC_S1VAL_20_u4 3.90625e-003 _CNV_A_R_LINEAR_____154_CM 0. 3.90625e-003 FORMAT "%16.12" /end CHARACTERISTIC
/begin CHARACTERISTIC Cxx_min_it_ar "Minimum available throttle area" VALUE 0xa0020c7a _REC_S1VAL_20_u4 3.90625e-003 _CNV_A_R_LINEAR_____154_CM 0. 3.90625e-003 FORMAT "%16.12" /end CHARACTERISTIC
/begin CHARACTERISTIC Cxx_n_max_it_adj "Maximum engine speed value to activate \"A.C.T.A\" computing" VALUE 0xa0020c7e _REC_S1VAL_20_u2 16383.75 _CNV_A_R_ENSD_LINEA_22_CM 0. 16383.75 FORMAT "%8.2" /end CHARACTERISTIC
/begin CHARACTERISTIC Cxx_n_min_it_adj "Minimum engine speed value to activate \"A.C.T.A\" computing" VALUE 0xa0020c80 _REC_S1VAL_20_u2 16383.75 _CNV_A_R_ENSD_LINEA_22_CM 0. 16383.75 FORMAT "%8.2" /end CHARACTERISTIC
/begin CHARACTERISTIC Cxx_thd_map_in_it_adj "Threshold min of M.A.P error for \"A.C.T.A\" computing activation" VALUE 0xa0020c82 _REC_S1VAL_20_u2 20000. _CNV_A_R_LINEAR_____115_CM 0. 20000. FORMAT "%1.0" /end CHARACTERISTIC
/begin CHARACTERISTIC Cxx_thd_map_out_it_adj "Threshold max of M.A.P error for \"A.C.T.A\" computing activation" VALUE 0xa0020c84 _REC_S1VAL_20_u2 20000. _CNV_A_R_LINEAR_____115_CM 0. 20000. FORMAT "%1.0" /end CHARACTERISTIC
/begin CHARACTERISTIC Cxx_thd_n_in_it_adj "Threshold min of engine speed error for \"A.C.T.A\" computing activation" VALUE 0xa0020c86 _REC_S1VAL_20_u2 16383.75 _CNV_A_R_ENSD_LINEA_22_CM 0. 16383.75 FORMAT "%8.2" /end CHARACTERISTIC
/begin CHARACTERISTIC Cxx_thd_n_out_it_adj "Threshold max of engine speed error for \"A.C.T.A\" computing activation" VALUE 0xa0020c88 _REC_S1VAL_20_u2 16383.75 _CNV_A_R_ENSD_LINEA_22_CM 0. 16383.75 FORMAT "%8.2" /end CHARACTERISTIC
/begin CHARACTERISTIC Cxx_thd_pos_max_it_adj "Threshold max of throttle position for \"A.C.T.A\" computing activation" VALUE 0xa0020c8a _REC_S1VAL_20_u2 100. _CNV_A_R_LINEAR_____150_CM 0. 100. FORMAT "%4.2" /end CHARACTERISTIC
/begin CHARACTERISTIC Cxx_thd_pos_min_it_adj "Threshold min of throttle position for \"A.C.T.A\" computing activation" VALUE 0xa0020c8c _REC_S1VAL_20_u2 100. _CNV_A_R_LINEAR_____150_CM 0. 100. FORMAT "%4.2" /end CHARACTERISTIC
/begin CHARACTERISTIC Ctp_ctl_lomap_int "Gain of the integrator in function of the engine speed" CURVE 0xa002507c _REC_A1CUR_20_u2_u2 5.96037352806888 _CNV_A_R_LINEAR_____155_CM 0. 5.96037352806888 FORMAT "%16.12"
 /begin AXIS_DESCR COM_AXIS Vxx_n _CNV_A_R_ENSD_LINEA_22_CM 9 0. 16383.75 FORMAT "%8.2" AXIS_PTS_REF Ctb_n2 /end AXIS_DESCR
/end CHARACTERISTIC
/begin MEASUREMENT Vbx_map_ctl_int_act "Flag of activation condition of the manifold pressure controler" UBYTE _CNV_S_2_RANGE______3_CM 1 0. 0. 1. ECU_ADDRESS 0xd00064a4 BIT_MASK 0x1 /end MEASUREMENT
/begin MEASUREMENT Vxx_map_ctl_cor_ar "throttle area correction by manifold pressure controler" SWORD _CNV_A_R_LINEAR_____156_CM 1 0. -4.883e-004 4.8822e-004 ECU_ADDRESS 0xd0003e4a FORMAT "%12.9" /end MEASUREMENT
/begin MEASUREMENT Vxx_map_ctl_int_fac "Gain of the integrator multiplied by dt" UWORD _CNV_A_R_LINEAR_____157_CM 1 0. 0. 5.96037352806889e-008 ECU_ADDRESS 0xd0003e4c FORMAT "%16.12" /end MEASUREMENT
/begin MEASUREMENT Vxx_map_ctl_int_raw "throttle area correction by manifold pressure integrator" SWORD _CNV_A_R_LINEAR_____156_CM 1 0. -4.883e-004 4.8822e-004 ECU_ADDRESS 0xd0003e4e FORMAT "%12.9" /end MEASUREMENT
/begin MEASUREMENT Vxx_map_err "Difference between the manifold pressure and the reference manifold pressure" UWORD _CNV_A_R_LINEAR_____158_CM 1 0. -10000. 10000. ECU_ADDRESS 0xd0003e50 FORMAT "%6.0" /end MEASUREMENT
/begin CHARACTERISTIC Cbx_map_ctl_int_cfm "Boolean to activate the manifold pressure controler" VALUE 0xa0020c96 _REC_S1VAL_20_u1 1. _CNV_S_2_RANGE______3_CM 0. 1. /end CHARACTERISTIC
/begin CHARACTERISTIC Cbx_map_ctl_int_tkof_cfm "Boolean to activate the manifold pressure controler in the take off state" VALUE 0xa0020c97 _REC_S1VAL_20_u1 1. _CNV_S_2_RANGE______3_CM 0. 1. /end CHARACTERISTIC
/begin CHARACTERISTIC Cxx_map_ctl_int_ftc_rst "filtering time constant when the controler is disabled" VALUE 0xa0020c98 _REC_S1VAL_20_u1 2.55 _CNV_A_R_LINEAR_____32_CM 0. 2.55 FORMAT "%4.2" /end CHARACTERISTIC
/begin CHARACTERISTIC Cxx_map_ctl_int_map_thd "Manifold pressure threshold" VALUE 0xa0020c94 _REC_S1VAL_20_u2 20000. _CNV_A_R_LINEAR_____115_CM 0. 20000. FORMAT "%5.0" /end CHARACTERISTIC
/begin CHARACTERISTIC Cxx_map_ctl_int_sat_prct_min "Ratio for minimal saturation according to the section throttle applied" VALUE 0xa0020c99 _REC_S1VAL_20_u1 0.99609375 _CNV_A_R_LINEAR_____29_CM 0. 0.99609375 FORMAT "%5.3" /end CHARACTERISTIC
/begin MEASUREMENT Vxx_ti_alco_cor "Final alcohol adaptive" UWORD _CNV_A_R_LINEAR_____159_CM 1 0. 0. 100. DISPLAY_IDENTIFIER CbSpvCms_NVM.Vxx_ti_alco_cor_NVM ECU_ADDRESS 0xd0005160 FORMAT "%12.8" /end MEASUREMENT
/begin MEASUREMENT Vxx_ti_alco_cor_h "High limit of the adaptive" UWORD _CNV_A_R_LINEAR_____159_CM 1 0. 0. 100. DISPLAY_IDENTIFIER CbSpvCms_NVM.Vxx_ti_alco_cor_h_NVM ECU_ADDRESS 0xd0005162 FORMAT "%12.8" /end MEASUREMENT
/begin MEASUREMENT Vxx_ti_alco_cor_l "Low limit of the adaptive" UWORD _CNV_A_R_LINEAR_____159_CM 1 0. 0. 100. DISPLAY_IDENTIFIER CbSpvCms_NVM.Vxx_ti_alco_cor_l_NVM ECU_ADDRESS 0xd0005164 FORMAT "%12.8" /end MEASUREMENT
/begin MEASUREMENT Vxx_blow_ctr_mem "Memorized value of the blow by counter" UWORD _CNV_A_R_ECME_LINEA_0_CM 1 0. 0. 65535. DISPLAY_IDENTIFIER CbSpvCms_NVM.Vxx_blow_ctr_mem_NVM ECU_ADDRESS 0xd0005166 FORMAT "%5.0" /end MEASUREMENT
/begin MEASUREMENT Vxx_blow_thd_mem "Memorized value of the blow by threshold" UWORD _CNV_A_R_LINEAR_____159_CM 1 0. 0. 100. DISPLAY_IDENTIFIER CbSpvCms_NVM.Vxx_blow_thd_mem_NVM ECU_ADDRESS 0xd0005168 FORMAT "%12.8" /end MEASUREMENT
/begin MEASUREMENT Vxx_stt_cnt_high "Number of high state condition." UWORD _CNV_A_R_ECME_LINEA_0_CM 1 0. 0. 65535. DISPLAY_IDENTIFIER CbSpvCms_NVM.Vxx_stt_cnt_high_NVM ECU_ADDRESS 0xd000516a FORMAT "%5.0" /end MEASUREMENT
/begin MEASUREMENT Vxx_stt_cnt_low "Number of low state condition." UWORD _CNV_A_R_ECME_LINEA_0_CM 1 0. 0. 65535. DISPLAY_IDENTIFIER CbSpvCms_NVM.Vxx_stt_cnt_low_NVM ECU_ADDRESS 0xd000516c FORMAT "%5.0" /end MEASUREMENT
/begin MEASUREMENT Vxx_stt_cnt_midh "Number of mid high state condition." UWORD _CNV_A_R_ECME_LINEA_0_CM 1 0. 0. 65535. DISPLAY_IDENTIFIER CbSpvCms_NVM.Vxx_stt_cnt_midh_NVM ECU_ADDRESS 0xd000516e FORMAT "%5.0" /end MEASUREMENT
/begin MEASUREMENT Vxx_stt_cnt_midl "Number of mid low state condition." UWORD _CNV_A_R_ECME_LINEA_0_CM 1 0. 0. 65535. DISPLAY_IDENTIFIER CbSpvCms_NVM.Vxx_stt_cnt_midl_NVM ECU_ADDRESS 0xd0005170 FORMAT "%5.0" /end MEASUREMENT
/begin MEASUREMENT Vxx_fuel_fill_max_ctr "Counter of trips when fuel gauge is at its maximum" UBYTE _CNV_A_R_ECME_LINEA_0_CM 1 0. 0. 255. DISPLAY_IDENTIFIER CbSpvCms_NVM.Vxx_fuel_fill_max_ctr_NVM ECU_ADDRESS 0xd0005172 FORMAT "%3.0" /end MEASUREMENT
/begin MEASUREMENT Vxx_alco_ad_ctr "Current value of the counter of slow alcohol adaptive computing phases" UBYTE _CNV_A_R_ECME_LINEA_0_CM 1 0. 0. 255. DISPLAY_IDENTIFIER CbSpvCms_NVM.Vxx_alco_ad_ctr_NVM ECU_ADDRESS 0xd0005173 FORMAT "%3.0" /end MEASUREMENT
/begin MEASUREMENT Vsx_fuel_ign_cho "Fuel ignition advance state." UBYTE _CNV_S_4_FUEL_IGN_A_160_CM 1 0. 0. 3. DISPLAY_IDENTIFIER CbSpvCms_NVM.Vsx_fuel_ign_cho_NVM ECU_ADDRESS 0xd0005174 /end MEASUREMENT
/begin AXIS_PTS Ctb_polu_alco_cor "Table of 11 breakpoints dedicated to the pollution adjustment" 0xa002a6dc Vxx_ti_alco_cor _REC_A2AXS_20_u2 100. _CNV_A_R_LINEAR_____159_CM 11 0. 100. FORMAT "%12.8" /end AXIS_PTS
/begin AXIS_PTS Ctb_sta_tq_alco_cor "Table of 11 breakpoints dedicated to the start torque adjustment" 0xa002a6f4 Vxx_ti_alco_cor _REC_A2AXS_20_u2 100. _CNV_A_R_LINEAR_____159_CM 11 0. 100. FORMAT "%12.8" /end AXIS_PTS
/begin AXIS_PTS Ctb_ti_alco_cor "Table of 11 breakpoints for alcohol corrections adjustment" 0xa002a70c Vxx_ti_alco_cor _REC_A2AXS_20_u2 100. _CNV_A_R_LINEAR_____159_CM 11 0. 100. FORMAT "%12.8" /end AXIS_PTS
/begin AXIS_PTS Ctb_ti_fuel_typ_rat_raw "Table of 11 breakpoints dedicated to correction of the non-linearity between alcohol rate and injection time" 0xa002a724 Vxx_ti_fuel_typ_rat_raw _REC_A2AXS_20_u2 1. _CNV_A_R_LINEAR_____161_CM 11 0. 1. FORMAT "%9.7" /end AXIS_PTS
/begin AXIS_PTS Ctb_wet_alco_cor "Table of 11 breakpoints dedicated to the wetting correction adjustment" 0xa002a73c Vxx_ti_alco_cor _REC_A2AXS_20_u2 100. _CNV_A_R_LINEAR_____159_CM 11 0. 100. FORMAT "%12.8" /end AXIS_PTS
/begin AXIS_PTS Ctb_wup_alco_cor "Table of 11 breakpoints dedicated to the warm up adjustment" 0xa002a754 Vxx_ti_alco_cor _REC_A2AXS_20_u2 100. _CNV_A_R_LINEAR_____159_CM 11 0. 100. FORMAT "%12.8" /end AXIS_PTS
/begin CHARACTERISTIC Ctp_ajs_alco_rat "Table converting the alcohol correction into a ratio dedicated to the anti-jerk strategy" CURVE 0xa002a76c _REC_A1CUR_20_u2_u2 1. _CNV_A_R_LINEAR_____161_CM 0. 1.
 /begin AXIS_DESCR COM_AXIS Vxx_ti_alco_cor _CNV_A_R_LINEAR_____159_CM 11 0. 100. FORMAT "%12.8" AXIS_PTS_REF Ctb_ti_alco_cor /end AXIS_DESCR
/end CHARACTERISTIC
/begin CHARACTERISTIC Ctp_is_alco_rat "Table converting the alcohol correction into a ratio dedicated to the idle speed regulation" CURVE 0xa002a784 _REC_A1CUR_20_u2_u2 1. _CNV_A_R_LINEAR_____161_CM 0. 1.
 /begin AXIS_DESCR COM_AXIS Vxx_ti_alco_cor _CNV_A_R_LINEAR_____159_CM 11 0. 100. FORMAT "%12.8" AXIS_PTS_REF Ctb_ti_alco_cor /end AXIS_DESCR
/end CHARACTERISTIC
/begin CHARACTERISTIC Ctp_polu_alco_rat "Table converting the alcohol correction into a ratio dedicated to the pollution adjustment" CURVE 0xa002a79c _REC_A1CUR_20_u2_u2 1. _CNV_A_R_LINEAR_____161_CM 0. 1. FORMAT "%9.7"
 /begin AXIS_DESCR COM_AXIS Vxx_ti_alco_cor _CNV_A_R_LINEAR_____159_CM 11 0. 100. FORMAT "%12.8" AXIS_PTS_REF Ctb_polu_alco_cor /end AXIS_DESCR
/end CHARACTERISTIC
/begin CHARACTERISTIC Ctp_sta_alco_rat "Table converting the alcohol correction into a ratio dedicated to the start adjustment" CURVE 0xa002a7b4 _REC_A1CUR_20_u2_u2 1. _CNV_A_R_LINEAR_____161_CM 0. 1. FORMAT "%9.7"
 /begin AXIS_DESCR COM_AXIS Vxx_ti_alco_cor _CNV_A_R_LINEAR_____159_CM 11 0. 100. FORMAT "%12.8" AXIS_PTS_REF Ctb_ti_alco_cor /end AXIS_DESCR
/end CHARACTERISTIC
/begin CHARACTERISTIC Ctp_sta_tq_alco_rat "Table converting the alcohol correction into a ratio dedicated to the start torque adjustment" CURVE 0xa002a7cc _REC_A1CUR_20_u2_u2 1. _CNV_A_R_LINEAR_____161_CM 0. 1. FORMAT "%9.7"
 /begin AXIS_DESCR COM_AXIS Vxx_ti_alco_cor _CNV_A_R_LINEAR_____159_CM 11 0. 100. FORMAT "%12.8" AXIS_PTS_REF Ctb_sta_tq_alco_cor /end AXIS_DESCR
/end CHARACTERISTIC
/begin CHARACTERISTIC Ctp_ti_fuel_typ_rat "Table used to correct the non-linearity between alcohol rate and injection time" CURVE 0xa002a7e4 _REC_A1CUR_20_u2_u2 1. _CNV_A_R_LINEAR_____161_CM 0. 1.
 /begin AXIS_DESCR COM_AXIS Vxx_ti_fuel_typ_rat_raw _CNV_A_R_LINEAR_____161_CM 11 0. 1. FORMAT "%9.7" AXIS_PTS_REF Ctb_ti_fuel_typ_rat_raw /end AXIS_DESCR
/end CHARACTERISTIC
/begin CHARACTERISTIC Ctp_tq_alco_rat "Table converting the alcohol correction into a ratio dedicated to the torque management adjustment" CURVE 0xa002a7fc _REC_A1CUR_20_u2_u2 1. _CNV_A_R_LINEAR_____161_CM 0. 1. FORMAT "%9.7"
 /begin AXIS_DESCR COM_AXIS Vxx_ti_alco_cor _CNV_A_R_LINEAR_____159_CM 11 0. 100. FORMAT "%12.8" AXIS_PTS_REF Ctb_ti_alco_cor /end AXIS_DESCR
/end CHARACTERISTIC
/begin CHARACTERISTIC Ctp_tq_max_alco_rat "Table converting the alcohol correction into a ratio dedicated to the Max torque management adjustment" CURVE 0xa002a814 _REC_A1CUR_20_u2_u2 1. _CNV_A_R_LINEAR_____161_CM 0. 1.
 /begin AXIS_DESCR COM_AXIS Vxx_ti_alco_cor _CNV_A_R_LINEAR_____159_CM 11 0. 100. FORMAT "%12.8" AXIS_PTS_REF Ctb_ti_alco_cor /end AXIS_DESCR
/end CHARACTERISTIC
/begin CHARACTERISTIC Ctp_wet_alco_rat "Table converting the alcohol correction into a ratio dedicated to the wetting correction adjustment" CURVE 0xa002a82c _REC_A1CUR_20_u2_u2 1. _CNV_A_R_LINEAR_____161_CM 0. 1. FORMAT "%9.7"
 /begin AXIS_DESCR COM_AXIS Vxx_ti_alco_cor _CNV_A_R_LINEAR_____159_CM 11 0. 100. FORMAT "%12.8" AXIS_PTS_REF Ctb_wet_alco_cor /end AXIS_DESCR
/end CHARACTERISTIC
/begin CHARACTERISTIC Ctp_wg_alco_rat "Table converting the alcohol correction into a ratio dedicated to the boost pressure adjustment" CURVE 0xa002a844 _REC_A1CUR_20_u2_u2 1. _CNV_A_R_LINEAR_____161_CM 0. 1. FORMAT "%9.7"
 /begin AXIS_DESCR COM_AXIS Vxx_ti_alco_cor _CNV_A_R_LINEAR_____159_CM 11 0. 100. FORMAT "%12.8" AXIS_PTS_REF Ctb_ti_alco_cor /end AXIS_DESCR
/end CHARACTERISTIC
/begin CHARACTERISTIC Ctp_wup_alco_rat "Table converting the alcohol correction into a ratio dedicated to the warm up adjustment" CURVE 0xa002a85c _REC_A1CUR_20_u2_u2 1. _CNV_A_R_LINEAR_____161_CM 0. 1. FORMAT "%9.7"
 /begin AXIS_DESCR COM_AXIS Vxx_ti_alco_cor _CNV_A_R_LINEAR_____159_CM 11 0. 100. FORMAT "%12.8" AXIS_PTS_REF Ctb_wup_alco_cor /end AXIS_DESCR
/end CHARACTERISTIC
/begin MEASUREMENT Vbx_lpg_gas_lpg_trs "Fuelling transcient mode gasoline to LPG / CNG" UBYTE _CNV_S_2_RANGE______3_CM 1 0. 0. 1. ECU_ADDRESS 0xd00067c8 BIT_MASK 0x1 /end MEASUREMENT
/begin MEASUREMENT Vbx_lpg_gas_mod "Normal LPG/GAS running mode" UBYTE _CNV_S_2_RANGE______3_CM 1 0. 0. 1. ECU_ADDRESS 0xd00067c9 BIT_MASK 0x1 /end MEASUREMENT
/begin MEASUREMENT Vbx_lpg_lpg_gas_trs "Normal LPG / GAS running mode" UBYTE _CNV_S_2_RANGE______3_CM 1 0. 0. 1. ECU_ADDRESS 0xd00067ca BIT_MASK 0x1 /end MEASUREMENT
/begin MEASUREMENT Vbx_lpg_lpg_mod "Normal LPG/CNG running mode" UBYTE _CNV_S_2_RANGE______3_CM 1 0. 0. 1. ECU_ADDRESS 0xd00067cb BIT_MASK 0x1 /end MEASUREMENT
/begin MEASUREMENT Vsx_wup_fuel_typ "Determinate the warm up zone" UBYTE _CNV_A_R_ECME_LINEA_0_CM 1 0. 0. 255. ECU_ADDRESS 0xd0007822 FORMAT "%3.0" /end MEASUREMENT
/begin MEASUREMENT Vxx_ajs_fuel_typ_rat "Ratio dedicated to the anti-jerk strategy according to fuel type" UWORD _CNV_A_R_LINEAR_____161_CM 1 0. 0. 1. ECU_ADDRESS 0xd00040c2 /end MEASUREMENT
/begin MEASUREMENT Vxx_alco_rat "Alcohol rate for the after sell" UWORD _CNV_A_R_LINEAR_____159_CM 1 0. 0. 100. ECU_ADDRESS 0xd0005180 FORMAT "%12.8" /end MEASUREMENT
/begin MEASUREMENT Vxx_is_fuel_typ_rat "Ratio dedicated to the idle speed regulation" UWORD _CNV_A_R_LINEAR_____161_CM 1 0. 0. 1. ECU_ADDRESS 0xd00040c4 /end MEASUREMENT
/begin MEASUREMENT Vxx_polu_fuel_typ_rat "Ratio dedicated to the pollution adjustment" UWORD _CNV_A_R_LINEAR_____161_CM 1 0. 0. 1. ECU_ADDRESS 0xd00040c6 /end MEASUREMENT
/begin MEASUREMENT Vxx_sta_fuel_typ_rat "Ratio dedicated to the start adjustment" UWORD _CNV_A_R_LINEAR_____161_CM 1 0. 0. 1. ECU_ADDRESS 0xd00040c8 /end MEASUREMENT
/begin MEASUREMENT Vxx_sta_tq_fuel_typ_rat "Ratio dedicated to the start adjustment" UWORD _CNV_A_R_LINEAR_____161_CM 1 0. 0. 1. ECU_ADDRESS 0xd00040ca /end MEASUREMENT
/begin MEASUREMENT Vxx_ti_alco_cor_tq_max "Final alcohol adaptative correction for Max torque adjustment strategy" UWORD _CNV_A_R_LINEAR_____159_CM 1 0. 0. 100. ECU_ADDRESS 0xd0005182 FORMAT "%12.8" /end MEASUREMENT
/begin MEASUREMENT Vxx_ti_fuel_typ_rat "Ratio dedicated to the time injection and stochiometry adjustment" UWORD _CNV_A_R_LINEAR_____161_CM 1 0. 0. 1. ECU_ADDRESS 0xd00040cc FORMAT "%5.3" /end MEASUREMENT
/begin MEASUREMENT Vxx_ti_fuel_typ_rat_raw "Raw ratio dedicated to the time injection and stoechiometry adjustment" UWORD _CNV_A_R_LINEAR_____161_CM 1 0. 0. 1. ECU_ADDRESS 0xd0005184 /end MEASUREMENT
/begin MEASUREMENT Vxx_tq_fuel_typ_rat "Ratio dedicated to the torque management adjustment" UWORD _CNV_A_R_LINEAR_____161_CM 1 0. 0. 1. ECU_ADDRESS 0xd00040ce /end MEASUREMENT
/begin MEASUREMENT Vxx_tq_max_fuel_typ_rat "Ratio dedicated to Max Torque adjustement strategy" UWORD _CNV_A_R_LINEAR_____161_CM 1 0. 0. 1. ECU_ADDRESS 0xd0005186 /end MEASUREMENT
/begin MEASUREMENT Vxx_tq_max_fuel_typ_rat_raw "Raw ratio dedicated to Max Torque adjustement strategy before consolidation" UWORD _CNV_A_R_LINEAR_____161_CM 1 0. 0. 1. ECU_ADDRESS 0xd0005188 /end MEASUREMENT
/begin MEASUREMENT Vxx_wet_fuel_typ_rat "Ratio dedicated to the welling correction adjustment" UWORD _CNV_A_R_LINEAR_____161_CM 1 0. 0. 1. ECU_ADDRESS 0xd00040d0 /end MEASUREMENT
/begin MEASUREMENT Vxx_wg_fuel_typ_rat "Ratio dedicated to the boost pressure correction adjustment" UWORD _CNV_A_R_LINEAR_____161_CM 1 0. 0. 1. ECU_ADDRESS 0xd00040d2 /end MEASUREMENT
/begin MEASUREMENT Vxx_wup_fuel_typ_rat "Ratio dedicated to the warm up adjustment according to fuel type" UWORD _CNV_A_R_LINEAR_____161_CM 1 0. 0. 1. ECU_ADDRESS 0xd00040d4 /end MEASUREMENT
/begin CHARACTERISTIC Cbx_lpg_gas_lpg_trs "Calibrated value for fuelling transcient mode gasoline to LPG / CNG" VALUE 0xa0021070 _REC_S1VAL_20_u1 1. _CNV_A_R_ECME_LINEA_0_CM 0. 1. FORMAT "%1.0" BIT_MASK 0x1 /end CHARACTERISTIC
/begin CHARACTERISTIC Cbx_lpg_gas_mod "Normal LPG/GAS running mode calibration" VALUE 0xa0021071 _REC_S1VAL_20_u1 1. _CNV_A_R_ECME_LINEA_0_CM 0. 1. FORMAT "%1.0" BIT_MASK 0x1 /end CHARACTERISTIC
/begin CHARACTERISTIC Cbx_lpg_lpg_gas_trs "Calibratied value for fuelling transcient mode LPG / CNG to gasoline" VALUE 0xa0021072 _REC_S1VAL_20_u1 1. _CNV_A_R_ECME_LINEA_0_CM 0. 1. FORMAT "%1.0" BIT_MASK 0x1 /end CHARACTERISTIC
/begin CHARACTERISTIC Cbx_lpg_lpg_mod "Calibrated value for \"Normal LPG/CNG running mode\"." VALUE 0xa0021073 _REC_S1VAL_20_u1 1. _CNV_A_R_ECME_LINEA_0_CM 0. 1. FORMAT "%1.0" BIT_MASK 0x1 /end CHARACTERISTIC
/begin CHARACTERISTIC Cbx_ti_alco_lim_tq_max "Use of final alcohol adaptative limitations for Max Torque adjustment strategy" VALUE 0xa0021074 _REC_S1VAL_20_u1 1. _CNV_A_R_ECME_LINEA_0_CM 0. 1. FORMAT "%1.0" BIT_MASK 0x1 /end CHARACTERISTIC
/begin CHARACTERISTIC Cxx_alco_rat "Factor in the computing of the alcohol rate for after sell" VALUE 0xa0021075 _REC_S1VAL_20_u1 1. _CNV_A_R_LINEAR_____162_CM 0. 1. FORMAT "%9.7" /end CHARACTERISTIC
/begin CHARACTERISTIC Cxx_ti_alco_cor_max "Maximal value of the final alcohol adaptive" VALUE 0xa0021062 _REC_S1VAL_20_u2 100. _CNV_A_R_LINEAR_____159_CM 0. 100. FORMAT "%12.8" /end CHARACTERISTIC
/begin CHARACTERISTIC Cxx_ti_alco_cor_zon_1 "Threshold bounding the first warm up zone" VALUE 0xa0021064 _REC_S1VAL_20_u2 100. _CNV_A_R_LINEAR_____159_CM 0. 100. FORMAT "%12.8" /end CHARACTERISTIC
/begin CHARACTERISTIC Cxx_ti_alco_cor_zon_2 "Threshold bounding the third warm up zone" VALUE 0xa0021066 _REC_S1VAL_20_u2 100. _CNV_A_R_LINEAR_____159_CM 0. 100. FORMAT "%12.8" /end CHARACTERISTIC
/begin CHARACTERISTIC Cxx_tq_max_fuel_typ_dft_neg "Negative slope to the consolidation of the ratio dedicated to the Max Torque when alcohol validity status isn't good" VALUE 0xa0021068 _REC_S1VAL_20_u2 1. _CNV_A_R_LINEAR_____163_CM -1. 0. FORMAT "%7.3" /end CHARACTERISTIC
/begin CHARACTERISTIC Cxx_tq_max_fuel_typ_dft_pos "Positive slope to the consolidation of the ratio dedicated to the Max Torque when alcohol validity status isn't good" VALUE 0xa002106a _REC_S1VAL_20_u2 1. _CNV_A_R_LINEAR_____164_CM 0. 1. FORMAT "%6.5" /end CHARACTERISTIC
/begin CHARACTERISTIC Cxx_tq_max_fuel_typ_neg "Negative slope to the consolidation of the ratio dedicated to the Max Torque" VALUE 0xa002106c _REC_S1VAL_20_u2 1. _CNV_A_R_LINEAR_____163_CM -1. 0. FORMAT "%7.3" /end CHARACTERISTIC
/begin CHARACTERISTIC Cxx_tq_max_fuel_typ_pos "Positive slope to the consolidation of the ratio dedicated to the Max Torque" VALUE 0xa002106e _REC_S1VAL_20_u2 1. _CNV_A_R_LINEAR_____164_CM 0. 1. FORMAT "%6.5" /end CHARACTERISTIC
/begin MEASUREMENT Vbx_eng_aut_down "The engine quits its autonomous state" UBYTE _CNV_S_2_RANGE______3_CM 1 0. 0. 1. ECU_ADDRESS 0xd0007808 BIT_MASK 0x1 /end MEASUREMENT
/begin MEASUREMENT Vxx_alco_ad_stal_cor "Alcohol correction applied when an engine stal occurs because of the fuel" UBYTE _CNV_A_R_LINEAR_____165_CM 1 0. 0. 100. ECU_ADDRESS 0xd0007809 FORMAT "%12.8" /end MEASUREMENT
/begin MEASUREMENT Vxx_ti_alco_cor_max "Maximal value applied on the final alcohol adaptive" UWORD _CNV_A_R_LINEAR_____159_CM 1 0. 0. 100. ECU_ADDRESS 0xd000513e FORMAT "%12.8" /end MEASUREMENT
/begin MEASUREMENT Vxx_ti_alco_cor_min "Minimal value applied on the final alcohol adaptive" UWORD _CNV_A_R_LINEAR_____159_CM 1 0. 0. 100. ECU_ADDRESS 0xd0005140 FORMAT "%12.8" /end MEASUREMENT
/begin MEASUREMENT Vxx_ti_alco_cor_stop "Value of the final alcohol adaptive at engine stop" UWORD _CNV_A_R_LINEAR_____159_CM 1 0. 0. 100. ECU_ADDRESS 0xd0005142 FORMAT "%12.8" /end MEASUREMENT
/begin CHARACTERISTIC Cbx_alco_ad_ena "The alcohol adaptive computing is enabled" VALUE 0xa002100a _REC_S1VAL_20_u1 1. _CNV_A_R_ECME_LINEA_0_CM 0. 1. FORMAT "%1.0" BIT_MASK 0x1 /end CHARACTERISTIC
/begin CHARACTERISTIC Cbx_alco_conf "Total Flex Fuel configuration" VALUE 0xa002100b _REC_S1VAL_20_u1 1. _CNV_A_R_ECME_LINEA_0_CM 0. 1. FORMAT "%1.0" BIT_MASK 0x1 /end CHARACTERISTIC
/begin CHARACTERISTIC Cbx_fill_det_act "The influences of a tank filling detection are activated" VALUE 0xa002100c _REC_S1VAL_20_u1 1. _CNV_A_R_ECME_LINEA_0_CM 0. 1. FORMAT "%1.0" BIT_MASK 0x1 /end CHARACTERISTIC
/begin CHARACTERISTIC Cbx_fuel_fill_det_bch "Bench mode for the fuel filling detection" VALUE 0xa002100d _REC_S1VAL_20_u1 1. _CNV_A_R_ECME_LINEA_0_CM 0. 1. FORMAT "%1.0" BIT_MASK 0x1 /end CHARACTERISTIC
/begin CHARACTERISTIC Cxx_alco_ad_cold_mem_dly "Time necessary to memorised 100% of the final alcohol adaptive. Used if a fast correction has occured during the driving cycle" VALUE 0xa0020ff8 _REC_S1VAL_20_u2 65535. _CNV_A_R_LINEAR_____68_CM 0. 65535. FORMAT "%5.0" /end CHARACTERISTIC
/begin CHARACTERISTIC Cxx_alco_ad_cold_mem_fac "Factor influencing the memorization if a fast correction has occured during the driving cycle" VALUE 0xa002100e _REC_S1VAL_20_u1 1. _CNV_A_R_LINEAR_____162_CM 0. 1. FORMAT "%9.7" /end CHARACTERISTIC
/begin CHARACTERISTIC Cxx_alco_ad_lbup_dft "Theshold on the upstream sensor voltage under which the sensor is potentially out of order. No correction applied" VALUE 0xa0020ffa _REC_S1VAL_20_u2 25000. _CNV_A_R_LINEAR_____107_CM 0. 25000. FORMAT "%5.0" /end CHARACTERISTIC
/begin CHARACTERISTIC Cxx_alco_ad_stal_cor "Correction applied when an engine stal occurs because the fuel" VALUE 0xa002100f _REC_S1VAL_20_u1 100. _CNV_A_R_LINEAR_____165_CM 0. 100. FORMAT "%12.8" /end CHARACTERISTIC
/begin CHARACTERISTIC Cxx_alco_ad_stal_dly "Time after an engine start during which the stalling correction can be applied" VALUE 0xa0021010 _REC_S1VAL_20_u1 255. _CNV_A_R_LINEAR_____68_CM 0. 255. FORMAT "%3.0" /end CHARACTERISTIC
/begin CHARACTERISTIC Cxx_alco_ad_stal_tco "Threshold on tco under which the stalling correction is applied" VALUE 0xa0020ffc _REC_S1VAL_20_u2 240. _CNV_A_R_LINEAR_____110_CM -40. 200. FORMAT "%5.1" /end CHARACTERISTIC
/begin CHARACTERISTIC Cxx_blow_ctr_thd "Threshold on the blow by counter evolution, above which the adaptive learned during the driving cycle isn't taken into account for the" VALUE 0xa0021011 _REC_S1VAL_20_u1 1. _CNV_A_R_LINEAR_____162_CM 0. 1. FORMAT "%9.7" /end CHARACTERISTIC
/begin CHARACTERISTIC Cxx_fuel_lvl_stop "Value of the fuel level at stop, in bench mode" VALUE 0xa0021012 _REC_S1VAL_20_u1 80. _CNV_A_R_LINEAR_____65_CM 0. 80. FORMAT "%3.0" /end CHARACTERISTIC
/begin CHARACTERISTIC Cxx_ti_alco_cor_dft "Initial value of the NV memory" VALUE 0xa0020ffe _REC_S1VAL_20_u2 100. _CNV_A_R_LINEAR_____159_CM 0. 100. FORMAT "%12.8" /end CHARACTERISTIC
/begin CHARACTERISTIC Cxx_ti_alco_cor_h "Maximal value of the final alcohol adaptive used in the calculation of the high limit" VALUE 0xa0021000 _REC_S1VAL_20_u2 100. _CNV_A_R_LINEAR_____159_CM 0. 100. FORMAT "%12.8" /end CHARACTERISTIC
/begin CHARACTERISTIC Cxx_ti_alco_cor_h_ofs "Offset applied on the calculated high limit" VALUE 0xa0021002 _REC_S1VAL_20_u2 100. _CNV_A_R_LINEAR_____159_CM 0. 100. FORMAT "%12.8" /end CHARACTERISTIC
/begin CHARACTERISTIC Cxx_ti_alco_cor_l_ofs "Offset applied on the calculated low limit" VALUE 0xa0021004 _REC_S1VAL_20_u2 100. _CNV_A_R_LINEAR_____159_CM 0. 100. FORMAT "%12.8" /end CHARACTERISTIC
/begin CHARACTERISTIC Cxx_ti_alco_cor_min "Minimal value of the final alcohol adaptive" VALUE 0xa0021006 _REC_S1VAL_20_u2 100. _CNV_A_R_LINEAR_____159_CM 0. 100. FORMAT "%12.8" /end CHARACTERISTIC
/begin CHARACTERISTIC Cxx_ti_gas_cor_max "Maximal value of the alcohol adaptive in a non Flex Fuel configuration" VALUE 0xa0021008 _REC_S1VAL_20_u2 100. _CNV_A_R_LINEAR_____159_CM 0. 100. FORMAT "%12.8" /end CHARACTERISTIC
/begin AXIS_PTS Ctb_amp_alco "Table of 9 breakpoints for the atmospheric pressure, dedicated to the alcohol adaptive" 0xa002a874 Vxx_amp _REC_A2AXS_20_u2 20000. _CNV_A_R_LINEAR_____115_CM 9 0. 20000. FORMAT "%5.0" /end AXIS_PTS
/begin AXIS_PTS Ctb_map_alco "Table of 4 breakpoints for the manifold pressure, dedicated to the alcohol adaptive" 0xa002a888 Vxx_pred_map _REC_A2AXS_20_u2 20000. _CNV_A_R_LINEAR_____115_CM 4 0. 20000. FORMAT "%5.0" /end AXIS_PTS
/begin AXIS_PTS Ctb_mat_alco "Table of 9 breakpoints of the air temperature, dedicated to the alcohol adaptive" 0xa002a894 Vxx_mat _REC_A2AXS_20_u2 240. _CNV_A_R_LINEAR_____110_CM 9 -40. 200. FORMAT "%6.1" /end AXIS_PTS
/begin AXIS_PTS Ctb_n_alco "Table of 4 breakpoints for the engine speed, dedicated to the alcohol adaptive" 0xa002a8a8 Vxx_n _REC_A2AXS_20_u2 16383.75 _CNV_A_R_ENSD_LINEA_22_CM 4 0. 16383.75 FORMAT "%8.2" /end AXIS_PTS
/begin AXIS_PTS Ctb_tco_alco "Table of 9 breakpoints of the coolant temperature, dedicated to the alcohol adaptive" 0xa002a8b4 Vxx_tco _REC_A2AXS_20_u2 240. _CNV_A_R_LINEAR_____110_CM 9 -40. 200. FORMAT "%6.1" /end AXIS_PTS
/begin CHARACTERISTIC Cmp_n_prs_alco_ad_fac_down "Factor applied to the drift of Vxx_mv_cl_ti_fac to compute the slow correction toward gasoline" MAP 0xa002a8c8 _REC_A1MAP_20_u2_u2_u2 100. _CNV_A_R_LINEAR_____166_CM 0. 100. FORMAT "%12.8"
 /begin AXIS_DESCR COM_AXIS Vxx_n _CNV_A_R_ENSD_LINEA_22_CM 4 0. 16383.75 FORMAT "%8.2" AXIS_PTS_REF Ctb_n_alco /end AXIS_DESCR
 /begin AXIS_DESCR COM_AXIS Vxx_pred_map _CNV_A_R_LINEAR_____115_CM 4 0. 20000. FORMAT "%5.0" AXIS_PTS_REF Ctb_map_alco /end AXIS_DESCR
/end CHARACTERISTIC
/begin CHARACTERISTIC Cmp_n_prs_alco_ad_fac_up "Factor applied to the drift of Vxx_mv_cl_ti_fac to compute the slow correction toward alcohol" MAP 0xa002a8e8 _REC_A1MAP_20_u2_u2_u2 100. _CNV_A_R_LINEAR_____166_CM 0. 100. FORMAT "%12.8"
 /begin AXIS_DESCR COM_AXIS Vxx_n _CNV_A_R_ENSD_LINEA_22_CM 4 0. 16383.75 FORMAT "%8.2" AXIS_PTS_REF Ctb_n_alco /end AXIS_DESCR
 /begin AXIS_DESCR COM_AXIS Vxx_pred_map _CNV_A_R_LINEAR_____115_CM 4 0. 20000. FORMAT "%5.0" AXIS_PTS_REF Ctb_map_alco /end AXIS_DESCR
/end CHARACTERISTIC
/begin CHARACTERISTIC Cmp_n_prs_alco_ad_mv_cl_thd_h "Values of the high threshold, before corrections" MAP 0xa002a908 _REC_A1MAP_20_u2_u2_u2 0.333328247070313 _CNV_A_R_LINEAR_____167_CM 0. 0.333328247070313 FORMAT "%8.6"
 /begin AXIS_DESCR COM_AXIS Vxx_n _CNV_A_R_ENSD_LINEA_22_CM 4 0. 16383.75 FORMAT "%8.2" AXIS_PTS_REF Ctb_n_alco /end AXIS_DESCR
 /begin AXIS_DESCR COM_AXIS Vxx_pred_map _CNV_A_R_LINEAR_____115_CM 4 0. 20000. FORMAT "%5.0" AXIS_PTS_REF Ctb_map_alco /end AXIS_DESCR
/end CHARACTERISTIC
/begin CHARACTERISTIC Cmp_n_prs_alco_ad_mv_cl_thd_l "Values of the low threshold, before corrections" MAP 0xa002a928 _REC_A1MAP_20_u2_u2_u2 0.333328247070313 _CNV_A_R_LINEAR_____167_CM 0. 0.333328247070313 FORMAT "%8.6"
 /begin AXIS_DESCR COM_AXIS Vxx_n _CNV_A_R_ENSD_LINEA_22_CM 4 0. 16383.75 FORMAT "%8.2" AXIS_PTS_REF Ctb_n_alco /end AXIS_DESCR
 /begin AXIS_DESCR COM_AXIS Vxx_pred_map _CNV_A_R_LINEAR_____115_CM 4 0. 20000. FORMAT "%5.0" AXIS_PTS_REF Ctb_map_alco /end AXIS_DESCR
/end CHARACTERISTIC
/begin CHARACTERISTIC Ctp_amp_alco_ad_mv_cl_fac "Table of factors on the thresholds, depending on the atmospheric pressure" CURVE 0xa002a948 _REC_A1CUR_20_u1_u2 1. _CNV_A_R_LINEAR_____162_CM 0. 1. FORMAT "%9.7"
 /begin AXIS_DESCR COM_AXIS Vxx_amp _CNV_A_R_LINEAR_____115_CM 9 0. 20000. FORMAT "%5.0" AXIS_PTS_REF Ctb_amp_alco /end AXIS_DESCR
/end CHARACTERISTIC
/begin CHARACTERISTIC Ctp_mat_alco_ad_mv_cl_fac "Table of factors on the thresholds, depending on the air temperature" CURVE 0xa002a954 _REC_A1CUR_20_u1_u2 1. _CNV_A_R_LINEAR_____162_CM 0. 1. FORMAT "%9.7"
 /begin AXIS_DESCR COM_AXIS Vxx_mat _CNV_A_R_LINEAR_____110_CM 9 -40. 200. FORMAT "%6.1" AXIS_PTS_REF Ctb_mat_alco /end AXIS_DESCR
/end CHARACTERISTIC
/begin CHARACTERISTIC Ctp_tco_alco_ad_mv_cl_fac "Table of factors on the thresholds, depending on the coolant temperature" CURVE 0xa002a960 _REC_A1CUR_20_u1_u2 1. _CNV_A_R_LINEAR_____162_CM 0. 1. FORMAT "%9.7"
 /begin AXIS_DESCR COM_AXIS Vxx_tco _CNV_A_R_LINEAR_____110_CM 9 -40. 200. FORMAT "%6.1" AXIS_PTS_REF Ctb_tco_alco /end AXIS_DESCR
/end CHARACTERISTIC
/begin MEASUREMENT Vbx_alco_ad "The slow alcohol adaptive is computing" UBYTE _CNV_S_2_RANGE______3_CM 1 0. 0. 1. ECU_ADDRESS 0xd000782d BIT_MASK 0x1 /end MEASUREMENT
/begin MEASUREMENT Vbx_alco_ad_cdn "All the engine conditions are satisfied for the application of the slow correction" UBYTE _CNV_S_2_RANGE______3_CM 1 0. 0. 1. ECU_ADDRESS 0xd000782e BIT_MASK 0x1 /end MEASUREMENT
/begin MEASUREMENT Vbx_alco_ad_done "A phase of a slow alcohol adaptive computing has been done during the driving cycle" UBYTE _CNV_S_2_RANGE______3_CM 1 0. 0. 1. ECU_ADDRESS 0xd000782f BIT_MASK 0x1 /end MEASUREMENT
/begin MEASUREMENT Vbx_alco_ad_done_mem "A slow correction phase has been fully completed during this or a former driving cycle" UBYTE _CNV_S_2_RANGE______3_CM 1 0. 0. 1. ECU_ADDRESS 0xd0007830 BIT_MASK 0x1 /end MEASUREMENT
/begin MEASUREMENT Vbx_alco_ad_ena "The slow alcohol adaptive computing is enabled" UBYTE _CNV_S_2_RANGE______3_CM 1 0. 0. 1. ECU_ADDRESS 0xd0007831 BIT_MASK 0x1 /end MEASUREMENT
/begin MEASUREMENT Vbx_alco_ad_fuel_max "Adaptative correction is authorized because of fuel gauge defined at its maximum" UBYTE _CNV_S_2_RANGE______3_CM 1 0. 0. 1. ECU_ADDRESS 0xd0007832 BIT_MASK 0x1 /end MEASUREMENT
/begin MEASUREMENT Vbx_alco_ad_is_down_cdn "The conditions are satisfied to compute the slow correction in idle speed toward gasoline" UBYTE _CNV_S_2_RANGE______3_CM 1 0. 0. 1. ECU_ADDRESS 0xd0007833 BIT_MASK 0x1 /end MEASUREMENT
/begin MEASUREMENT Vbx_alco_ad_is_up_cdn "The conditions are satisfied to compute the slow correction in idle speed toward alcohol" UBYTE _CNV_S_2_RANGE______3_CM 1 0. 0. 1. ECU_ADDRESS 0xd0007834 BIT_MASK 0x1 /end MEASUREMENT
/begin MEASUREMENT Vbx_alco_ad_req "A new phase of slow alcohol adaptive computing is required" UBYTE _CNV_S_2_RANGE______3_CM 1 0. 0. 1. ECU_ADDRESS 0xd0007835 BIT_MASK 0x1 /end MEASUREMENT
/begin MEASUREMENT Vbx_alco_rich_ad_ena "The richness adaptive computing and the canister purge activation are enabled" UBYTE _CNV_S_2_RANGE______3_CM 1 0. 0. 1. ECU_ADDRESS 0xd0007836 BIT_MASK 0x1 /end MEASUREMENT
/begin MEASUREMENT Vxx_alco_ad_cdn_t "Time passed in the slow adaptative conditions" UWORD _CNV_A_R_LINEAR_____68_CM 1 0. 0. 65535. ECU_ADDRESS 0xd000518c FORMAT "%5.0" /end MEASUREMENT
/begin MEASUREMENT Vxx_alco_ad_cdn_t_raw "Time passed in the slow adaptative conditions before the high limitation" UWORD _CNV_A_R_LINEAR_____68_CM 1 0. 0. 65535. ECU_ADDRESS 0xd000518e FORMAT "%5.0" /end MEASUREMENT
/begin MEASUREMENT Vxx_alco_ad_cor "Value of the slow alcohol correction" SWORD _CNV_A_R_LINEAR_____168_CM 1 0. -200. 200. ECU_ADDRESS 0xd0005190 FORMAT "%7.2" /end MEASUREMENT
/begin MEASUREMENT Vxx_alco_ad_fac_down "Factor applied on the drift of Vxx_mv_cl_ti_fac to compute the slow adaptive toward gasoline" UWORD _CNV_A_R_LINEAR_____166_CM 1 0. 0. 100. ECU_ADDRESS 0xd0005192 FORMAT "%12.8" /end MEASUREMENT
/begin MEASUREMENT Vxx_alco_ad_fac_up "Factor applied on the drift of Vxx_mv_cl_ti_fac to compute the slow adaptive toward alcohol" UWORD _CNV_A_R_LINEAR_____166_CM 1 0. 0. 100. ECU_ADDRESS 0xd0005194 FORMAT "%12.8" /end MEASUREMENT
/begin MEASUREMENT Vxx_alco_ad_mv_cl_thd_h "Applied value of the high threshold" UWORD _CNV_A_R_LINEAR_____167_CM 1 0. 0. 0.333328247070313 ECU_ADDRESS 0xd0005196 FORMAT "%8.6" /end MEASUREMENT
/begin MEASUREMENT Vxx_alco_ad_mv_cl_thd_h_ofs "Offset applied on the high threshold" UWORD _CNV_A_R_LINEAR_____167_CM 1 0. 0. 0.333328247070313 ECU_ADDRESS 0xd0005198 FORMAT "%8.6" /end MEASUREMENT
/begin MEASUREMENT Vxx_alco_ad_mv_cl_thd_h_raw "Raw value of the high threshold" UWORD _CNV_A_R_LINEAR_____167_CM 1 0. 0. 0.333328247070313 ECU_ADDRESS 0xd000519a FORMAT "%8.6" /end MEASUREMENT
/begin MEASUREMENT Vxx_alco_ad_mv_cl_thd_l "Applied value of the low threshold" UWORD _CNV_A_R_LINEAR_____167_CM 1 0. 0. 0.333328247070313 ECU_ADDRESS 0xd000519c FORMAT "%8.6" /end MEASUREMENT
/begin MEASUREMENT Vxx_alco_ad_mv_cl_thd_l_ofs "Offset applied on the low threshold" UWORD _CNV_A_R_LINEAR_____167_CM 1 0. 0. 0.333328247070313 ECU_ADDRESS 0xd000519e FORMAT "%8.6" /end MEASUREMENT
/begin MEASUREMENT Vxx_alco_ad_mv_cl_thd_l_raw "Raw value of the low threshold" UWORD _CNV_A_R_LINEAR_____167_CM 1 0. 0. 0.333328247070313 ECU_ADDRESS 0xd00051a0 FORMAT "%8.6" /end MEASUREMENT
/begin MEASUREMENT Vxx_alco_ad_t "Time of a slow alcohol adaptive computing phase" UWORD _CNV_A_R_LINEAR_____68_CM 1 0. 0. 65535. ECU_ADDRESS 0xd00051a2 FORMAT "%5.0" /end MEASUREMENT
/begin MEASUREMENT Vxx_alco_mv_cl_ofs_fac "Factor applied on blow-by thresholds offset" UBYTE _CNV_A_R_LINEAR_____162_CM 1 0. 0. 1. ECU_ADDRESS 0xd0007837 FORMAT "%9.7" /end MEASUREMENT
/begin MEASUREMENT Vxx_fac_dif_alco_ad_h "Limitation (high) of Vxx_mv_cl_ti_fac drift to allow newer adaptative corrections w or w/o refilling" UWORD _CNV_A_R_LINEAR_____167_CM 1 0. 0. 0.333328247070313 ECU_ADDRESS 0xd00051a4 FORMAT "%8.6" /end MEASUREMENT
/begin MEASUREMENT Vxx_fac_dif_alco_ad_l "Limitation (low) of Vxx_mv_cl_ti_fac drift to allow newer adaptative corrections w or w/o refilling" UWORD _CNV_A_R_LINEAR_____167_CM 1 0. 0. 0.333328247070313 ECU_ADDRESS 0xd00051a6 FORMAT "%8.6" /end MEASUREMENT
/begin CHARACTERISTIC Cbx_alco_ad_req_ena "Calibration to enable adaptative correction when mean value of multiplicative factor from richness closed loop is strongly decentered" VALUE 0xa00210a2 _REC_S1VAL_20_u1 1. _CNV_A_R_ECME_LINEA_0_CM 0. 1. FORMAT "%1.0" BIT_MASK 0x1 /end CHARACTERISTIC
/begin CHARACTERISTIC Cbx_fuel_det_max_ena "Calibration to enable adaptative correction every Cxx_fill_max_ctr_max trips when fuel gauge is at its maximum" VALUE 0xa00210a3 _REC_S1VAL_20_u1 1. _CNV_A_R_ECME_LINEA_0_CM 0. 1. FORMAT "%1.0" BIT_MASK 0x1 /end CHARACTERISTIC
/begin CHARACTERISTIC Cxx_aftr_alco_ad_dly "Minimal time between two phases of slow alcohol adaptative computing" VALUE 0xa0021078 _REC_S1VAL_20_u2 65535. _CNV_A_R_LINEAR_____68_CM 0. 65535. FORMAT "%5.0" /end CHARACTERISTIC
/begin CHARACTERISTIC Cxx_alco_ad_blow_ctr_thd "Calibration value to define threshold on blow-by counter" VALUE 0xa00210a4 _REC_S1VAL_20_u1 0.99609375 _CNV_A_R_LINEAR_____29_CM 0. 0.99609375 FORMAT "%5.3" /end CHARACTERISTIC
/begin CHARACTERISTIC Cxx_alco_ad_ctr_ini "Initial value of the counter of slow alcohol adaptive computing phases" VALUE 0xa00210a5 _REC_S1VAL_20_u1 255. _CNV_A_R_ECME_LINEA_0_CM 0. 255. FORMAT "%3.0" /end CHARACTERISTIC
/begin CHARACTERISTIC Cxx_alco_ad_dp_prs "Maximal distance between the predicted and the mean manifold pressure authorizing the slow correction" VALUE 0xa002107a _REC_S1VAL_20_u2 20000. _CNV_A_R_LINEAR_____115_CM 0. 20000. FORMAT "%5.0" /end CHARACTERISTIC
/begin CHARACTERISTIC Cxx_alco_ad_is_down_tco_thd "Minimal engine coolant temperature in idle speed conditions authorizing the slow correction toward gasoline" VALUE 0xa002107c _REC_S1VAL_20_u2 240. _CNV_A_R_LINEAR_____110_CM -40. 200. FORMAT "%6.1" /end CHARACTERISTIC
/begin CHARACTERISTIC Cxx_alco_ad_is_fac_down "Factor applied on the drift of Vxx_mv_cl_ti_fac, in idle speed, to computed the slow correction toward gasoline" VALUE 0xa002107e _REC_S1VAL_20_u2 100. _CNV_A_R_LINEAR_____166_CM 0. 100. FORMAT "%12.8" /end CHARACTERISTIC
/begin CHARACTERISTIC Cxx_alco_ad_is_fac_up "Factor applied on the drift of Vxx_mv_cl_ti_fac, in idle speed, to computed the slow correction toward alcohol" VALUE 0xa0021080 _REC_S1VAL_20_u2 100. _CNV_A_R_LINEAR_____166_CM 0. 100. FORMAT "%12.8" /end CHARACTERISTIC
/begin CHARACTERISTIC Cxx_alco_ad_is_mv_cl_thd_h "Value of the high threshold in idlle speed, before corrections" VALUE 0xa0021082 _REC_S1VAL_20_u2 0.333328247070313 _CNV_A_R_LINEAR_____167_CM 0. 0.333328247070313 FORMAT "%8.6" /end CHARACTERISTIC
/begin CHARACTERISTIC Cxx_alco_ad_is_mv_cl_thd_l "Value of the low threshold in idlle speed, before corrections" VALUE 0xa0021084 _REC_S1VAL_20_u2 0.333328247070313 _CNV_A_R_LINEAR_____167_CM 0. 0.333328247070313 FORMAT "%8.6" /end CHARACTERISTIC
/begin CHARACTERISTIC Cxx_alco_ad_is_up_tco_thd "Minimal engine coolant temperature in idle speed conditions authorizing the slow correction toward alcohol" VALUE 0xa0021086 _REC_S1VAL_20_u2 240. _CNV_A_R_LINEAR_____110_CM -40. 200. FORMAT "%6.1" /end CHARACTERISTIC
/begin CHARACTERISTIC Cxx_alco_ad_map_max "Maximal manifold pressure authorizing the slow correction" VALUE 0xa0021088 _REC_S1VAL_20_u2 20000. _CNV_A_R_LINEAR_____115_CM 0. 20000. FORMAT "%5.0" /end CHARACTERISTIC
/begin CHARACTERISTIC Cxx_alco_ad_map_min "Minimal manifold pressure authorizing the slow correction" VALUE 0xa002108a _REC_S1VAL_20_u2 20000. _CNV_A_R_LINEAR_____115_CM 0. 20000. FORMAT "%5.0" /end CHARACTERISTIC
/begin CHARACTERISTIC Cxx_alco_ad_mv_cl_thd_h_ofs "Maximal offset that can be applied on the high threshold" VALUE 0xa002108c _REC_S1VAL_20_u2 0.333328247070313 _CNV_A_R_LINEAR_____167_CM 0. 0.333328247070313 FORMAT "%8.6" /end CHARACTERISTIC
/begin CHARACTERISTIC Cxx_alco_ad_mv_cl_thd_l_ofs "Maximal offset that can be applied on the low threshold" VALUE 0xa002108e _REC_S1VAL_20_u2 0.333328247070313 _CNV_A_R_LINEAR_____167_CM 0. 0.333328247070313 FORMAT "%8.6" /end CHARACTERISTIC
/begin CHARACTERISTIC Cxx_alco_ad_mv_cl_thd_slop "Value of the slew rate when both thresholds are going to 0" VALUE 0xa0021090 _REC_S1VAL_20_u2 0.333328247070313 _CNV_A_R_LINEAR_____167_CM 0. 0.333328247070313 FORMAT "%8.6" /end CHARACTERISTIC
/begin CHARACTERISTIC Cxx_alco_ad_mv_cl_thd_slop_neg "Value of the slew rate when the low threshold is going to 0.33333333" VALUE 0xa0021092 _REC_S1VAL_20_u2 0.333328247070313 _CNV_A_R_LINEAR_____167_CM 0. 0.333328247070313 FORMAT "%8.6" /end CHARACTERISTIC
/begin CHARACTERISTIC Cxx_alco_ad_mv_cl_thd_slop_pos "Value of the slew rate when the high threshold is going to 0.33333333" VALUE 0xa0021094 _REC_S1VAL_20_u2 0.333328247070313 _CNV_A_R_LINEAR_____167_CM 0. 0.333328247070313 FORMAT "%8.6" /end CHARACTERISTIC
/begin CHARACTERISTIC Cxx_alco_ad_n_max "Maximal engine speed authorizing the slow correction" VALUE 0xa0021096 _REC_S1VAL_20_u2 16383.75 _CNV_A_R_ENSD_LINEA_22_CM 0. 16383.75 FORMAT "%8.2" /end CHARACTERISTIC
/begin CHARACTERISTIC Cxx_alco_ad_n_min "Minimal engine speed authorizing the slow correction" VALUE 0xa0021098 _REC_S1VAL_20_u2 16383.75 _CNV_A_R_ENSD_LINEA_22_CM 0. 16383.75 FORMAT "%8.2" /end CHARACTERISTIC
/begin CHARACTERISTIC Cxx_alco_ad_t "Duration of a phase of slow alcohol adaptive computing" VALUE 0xa002109a _REC_S1VAL_20_u2 65535. _CNV_A_R_LINEAR_____68_CM 0. 65535. FORMAT "%5.0" /end CHARACTERISTIC
/begin CHARACTERISTIC Cxx_alco_ad_tco_thd "Minimal engine coolant temperature authorizing the slow correction" VALUE 0xa002109c _REC_S1VAL_20_u2 240. _CNV_A_R_LINEAR_____110_CM -40. 200. FORMAT "%6.1" /end CHARACTERISTIC
/begin CHARACTERISTIC Cxx_alco_rich "Calibration value to convert % into - or to inhibit blow-by dependency for low threshold" VALUE 0xa00210a6 _REC_S1VAL_20_u1 0.99609375 _CNV_A_R_LINEAR_____29_CM 0. 0.99609375 FORMAT "%5.3" /end CHARACTERISTIC
/begin CHARACTERISTIC Cxx_fac_dif_alco_ad_fac "Calibration value for slow adaptative correction defining offset for re-adaptation threshold" VALUE 0xa00210a7 _REC_S1VAL_20_u1 1. _CNV_A_R_LINEAR_____162_CM 0. 1. FORMAT "%9.7" /end CHARACTERISTIC
/begin CHARACTERISTIC Cxx_fac_dif_alco_ad_ofs_h "Offset for slow adaptative correction high threshold" VALUE 0xa002109e _REC_S1VAL_20_u2 0.333328247070313 _CNV_A_R_LINEAR_____167_CM 0. 0.333328247070313 FORMAT "%8.6" /end CHARACTERISTIC
/begin CHARACTERISTIC Cxx_fac_dif_alco_ad_ofs_l "Offset for slow adaptative correction low threshold" VALUE 0xa00210a0 _REC_S1VAL_20_u2 0.333328247070313 _CNV_A_R_LINEAR_____167_CM 0. 0.333328247070313 FORMAT "%8.6" /end CHARACTERISTIC
/begin CHARACTERISTIC Cxx_fuel_det_max_ctr_ini "Initial value of the counter of trips when fuel gauge is at its maximum" VALUE 0xa00210a8 _REC_S1VAL_20_u1 255. _CNV_A_R_ECME_LINEA_0_CM 0. 255. FORMAT "%3.0" /end CHARACTERISTIC
/begin CHARACTERISTIC Cxx_fuel_det_max_ctr_max "Number of trips left between two adaptive corrections when fuel gauge is at its maximum" VALUE 0xa00210a9 _REC_S1VAL_20_u1 255. _CNV_A_R_ECME_LINEA_0_CM 0. 255. FORMAT "%3.0" /end CHARACTERISTIC
/begin AXIS_PTS Ntb_alco_ad_lbup_v_fil_ftc "Table of breakpoints for the filter of the lambda upstream sensor voltage depending on the exhaust gas air flow" 0xa002a6b4 Vxx_cp_pwm_appl _REC_A2AXS_20_u2 100. _CNV_A_R_LINEAR_____159_CM 9 0. 100. READ_ONLY FORMAT "%12.8" /end AXIS_PTS
/begin CHARACTERISTIC Ctp_alco_ad_lbup_v_fil_ftc "Coefficients of the filter of the lambda upstream sensor voltage depending on the exhaust gas air flow" CURVE 0xa002a6c8 _REC_A1CUR_20_u2_u2 6553.5 _CNV_A_R_LINEAR_____58_CM 0. 6553.5 FORMAT "%6.1"
 /begin AXIS_DESCR COM_AXIS Vxx_cp_pwm_appl _CNV_A_R_LINEAR_____159_CM 9 0. 100. READ_ONLY FORMAT "%12.8" AXIS_PTS_REF Ntb_alco_ad_lbup_v_fil_ftc /end AXIS_DESCR
/end CHARACTERISTIC
/begin MEASUREMENT Vbx_alco_ad_cold_cdn "All the engine conditions are satisfied for the application of the fast correction" UBYTE _CNV_S_2_RANGE______3_CM 1 0. 0. 1. ECU_ADDRESS 0xd000781a BIT_MASK 0x1 /end MEASUREMENT
/begin MEASUREMENT Vbx_alco_ad_cold_cor_appl "A fast correction shot is applied" UBYTE _CNV_S_2_RANGE______3_CM 1 0. 0. 1. ECU_ADDRESS 0xd000781b BIT_MASK 0x1 /end MEASUREMENT
/begin MEASUREMENT Vbx_alco_ad_cold_ena "The fast correction is enabled" UBYTE _CNV_S_2_RANGE______3_CM 1 0. 0. 1. ECU_ADDRESS 0xd000781c BIT_MASK 0x1 /end MEASUREMENT
/begin MEASUREMENT Vbx_alco_ad_cold_frst "At least one fast correction shot has occured during the driving cycle" UBYTE _CNV_S_2_RANGE______3_CM 1 0. 0. 1. ECU_ADDRESS 0xd000781d BIT_MASK 0x1 /end MEASUREMENT
/begin MEASUREMENT Vxx_alco_ad_cold_cor "Value of the fast correction" UBYTE _CNV_A_R_LINEAR_____165_CM 1 0. 0. 100. ECU_ADDRESS 0xd000781e FORMAT "%12.8" /end MEASUREMENT
/begin MEASUREMENT Vxx_alco_ad_cold_dly "Value of the delay prohibiting another fast correction" UBYTE _CNV_A_R_LINEAR_____68_CM 1 0. 0. 255. ECU_ADDRESS 0xd000781f FORMAT "%3.0" /end MEASUREMENT
/begin MEASUREMENT Vxx_alco_ad_cold_dly_1 "Intermediate value of the delay prohibiting another fast correction" UBYTE _CNV_A_R_LINEAR_____68_CM 1 0. 0. 255. ECU_ADDRESS 0xd0007820 FORMAT "%3.0" /end MEASUREMENT
/begin MEASUREMENT Vxx_alco_ad_lbup_v_fil "Upstream sensor filtered voltage  for the fast alcohol correction" UWORD _CNV_A_R_LINEAR_____107_CM 1 0. 0. 25000. ECU_ADDRESS 0xd0005178 FORMAT "%5.0" /end MEASUREMENT
/begin MEASUREMENT Vxx_alco_ad_lbup_v_fil_ftc "Time constant for the filter of the upstream sensor voltage" UWORD _CNV_A_R_LINEAR_____58_CM 1 0. 0. 6553.5 ECU_ADDRESS 0xd000517a FORMAT "%6.1" /end MEASUREMENT
/begin MEASUREMENT Vxx_alco_ad_lbup_v_fil_thd "Dynamic threshold on the upstream sensor voltage" UWORD _CNV_A_R_LINEAR_____107_CM 1 0. 0. 25000. ECU_ADDRESS 0xd000517c FORMAT "%5.0" /end MEASUREMENT
/begin MEASUREMENT Vxx_alco_ad_prs_n_fil "Variable representing the exhaust gas air flow" UWORD _CNV_A_R_LINEAR_____159_CM 1 0. 0. 100. ECU_ADDRESS 0xd000517e FORMAT "%12.8" /end MEASUREMENT
/begin CHARACTERISTIC Cxx_alco_ad_cdn_t_max "Time passes in the slow alcohol adaptive conditions at the end of which the fast adaptive is prohibited" VALUE 0xa002103e _REC_S1VAL_20_u2 65535. _CNV_A_R_LINEAR_____68_CM 0. 65535. FORMAT "%5.0" /end CHARACTERISTIC
/begin CHARACTERISTIC Cxx_alco_ad_cold_appl_cl_thd "Threshold on the mean value of multiplicative factor from richness closed loop above which the fast correction is applied" VALUE 0xa0021040 _REC_S1VAL_20_u2 0.6666666000000001 _CNV_A_R_LINEAR_____169_CM 0.6666667 1.3333333 FORMAT "%10.8" /end CHARACTERISTIC
/begin CHARACTERISTIC Cxx_alco_ad_cold_dly "Time after one fast adaptive shot during which another shot is prohibited" VALUE 0xa002105c _REC_S1VAL_20_u1 255. _CNV_A_R_LINEAR_____68_CM 0. 255. FORMAT "%3.0" /end CHARACTERISTIC
/begin CHARACTERISTIC Cxx_alco_ad_cold_dp_prs "Maximal distance between the predicted and the mean manifold pressure authorizing the fast correction" VALUE 0xa0021042 _REC_S1VAL_20_u2 20000. _CNV_A_R_LINEAR_____115_CM 0. 20000. FORMAT "%5.0" /end CHARACTERISTIC
/begin CHARACTERISTIC Cxx_alco_ad_cold_ena_cl_thd "Threshold on the mean value of multiplicative factor from richness closed loop above which the fast correction is applied, if the filtered upstream sensor voltage authorize it" VALUE 0xa0021044 _REC_S1VAL_20_u2 0.6666666000000001 _CNV_A_R_LINEAR_____169_CM 0.6666667 1.3333333 FORMAT "%10.8" /end CHARACTERISTIC
/begin CHARACTERISTIC Cxx_alco_ad_cold_in_dly "Delay of time between the rising of the fast adaptive's conditions and its effective application" VALUE 0xa002105d _REC_S1VAL_20_u1 255. _CNV_A_R_LINEAR_____68_CM 0. 255. FORMAT "%3.0" /end CHARACTERISTIC
/begin CHARACTERISTIC Cxx_alco_ad_cold_inc "Corrective added to the final alcohol corrective when a fast correction occured" VALUE 0xa002105e _REC_S1VAL_20_u1 100. _CNV_A_R_LINEAR_____165_CM 0. 100. FORMAT "%12.8" /end CHARACTERISTIC
/begin CHARACTERISTIC Cxx_alco_ad_cold_kd_thd "Threshold on the full load richness factor above which the fast correction is authorized" VALUE 0xa002105f _REC_S1VAL_20_u1 1.328125 _CNV_A_R_LINEAR_____104_CM 0.6666666 1.9947916 FORMAT "%8.6" /end CHARACTERISTIC
/begin CHARACTERISTIC Cxx_alco_ad_cold_map_max "Maximal manifold pressure authorizing the fast correction" VALUE 0xa0021046 _REC_S1VAL_20_u2 20000. _CNV_A_R_LINEAR_____115_CM 0. 20000. FORMAT "%5.0" /end CHARACTERISTIC
/begin CHARACTERISTIC Cxx_alco_ad_cold_map_min "Minimal manifold pressure authorizing the fast correction" VALUE 0xa0021048 _REC_S1VAL_20_u2 20000. _CNV_A_R_LINEAR_____115_CM 0. 20000. FORMAT "%5.0" /end CHARACTERISTIC
/begin CHARACTERISTIC Cxx_alco_ad_cold_map_thd "Minimal manifold pressure value authorizing the increase of the lambda upstream sensor voltage threshold" VALUE 0xa002104a _REC_S1VAL_20_u2 20000. _CNV_A_R_LINEAR_____115_CM 0. 20000. FORMAT "%5.0" /end CHARACTERISTIC
/begin CHARACTERISTIC Cxx_alco_ad_cold_n_max "Maximal engine speed authorizing the fast correction" VALUE 0xa002104c _REC_S1VAL_20_u2 16383.75 _CNV_A_R_ENSD_LINEA_22_CM 0. 16383.75 FORMAT "%8.2" /end CHARACTERISTIC
/begin CHARACTERISTIC Cxx_alco_ad_cold_n_min "Minimal engine speed authorizing the fast correction" VALUE 0xa002104e _REC_S1VAL_20_u2 16383.75 _CNV_A_R_ENSD_LINEA_22_CM 0. 16383.75 FORMAT "%8.2" /end CHARACTERISTIC
/begin CHARACTERISTIC Cxx_alco_ad_cold_tco "Maximal engine coolant temperature authorizing the fast correction" VALUE 0xa0021050 _REC_S1VAL_20_u2 240. _CNV_A_R_LINEAR_____110_CM -40. 200. FORMAT "%5.1" /end CHARACTERISTIC
/begin CHARACTERISTIC Cxx_alco_ad_cold_tco_cor_thd "Threshold on the final richness factor in cold water temperature conditions above which the fast correction is authorized" VALUE 0xa0021052 _REC_S1VAL_20_u2 3.99993896484375 _CNV_A_R_LINEAR_____170_CM 0.5 4.49993896484375 FORMAT "%10.8" /end CHARACTERISTIC
/begin CHARACTERISTIC Cxx_alco_ad_lbup_inc "Increase value of the lambda upstream sensor voltage threshold for the application of the fast correction" VALUE 0xa0021054 _REC_S1VAL_20_u2 25000. _CNV_A_R_LINEAR_____107_CM 0. 25000. FORMAT "%5.0" /end CHARACTERISTIC
/begin CHARACTERISTIC Cxx_alco_ad_lbup_inc_thd_h "Maximal value of the lambda upstream sensor voltage threshold for the application of the fast correction" VALUE 0xa0021056 _REC_S1VAL_20_u2 25000. _CNV_A_R_LINEAR_____107_CM 0. 25000. FORMAT "%5.0" /end CHARACTERISTIC
/begin CHARACTERISTIC Cxx_alco_ad_lbup_inc_thd_l "Minimal value of the lambda upstream sensor voltage threshold for the application of the fast correction" VALUE 0xa0021058 _REC_S1VAL_20_u2 25000. _CNV_A_R_LINEAR_____107_CM 0. 25000. FORMAT "%5.0" /end CHARACTERISTIC
/begin CHARACTERISTIC Cxx_alco_ad_lbup_v_fil_ini "Initial value of the filtered upstream sensor voltage" VALUE 0xa002105a _REC_S1VAL_20_u2 25000. _CNV_A_R_LINEAR_____107_CM 0. 25000. FORMAT "%5.0" /end CHARACTERISTIC
/begin CHARACTERISTIC Cxx_alco_ad_n_prs_fil "Coefficient used to adapt the value of Vxx_alco_ad_prs_n_fil" VALUE 0xa0021060 _REC_S1VAL_20_u1 127500. _CNV_A_R_LINEAR_____171_CM 500. 128000. FORMAT "%6.0" /end CHARACTERISTIC
/begin CHARACTERISTIC Ctp_max_pump_maf "Maximum mass air flow pumped depending on engine speed to protect engine and supercharger." CURVE 0xa0024b38 _REC_A1CUR_20_u2_u2 3000. _CNV_A_R_LINEAR_____172_CM 0. 3000. FORMAT "%7.2"
 /begin AXIS_DESCR COM_AXIS Vxx_n _CNV_A_R_ENSD_LINEA_22_CM 20 0. 16383.75 FORMAT "%8.2" AXIS_PTS_REF Ctb_n /end AXIS_DESCR
/end CHARACTERISTIC
/begin CHARACTERISTIC Ctp_max_rel_map_sp "Maximum relative boost pressure depending on engine spped to protect engine and supercharger" CURVE 0xa0024b60 _REC_A1CUR_20_u2_u2 20000. _CNV_A_R_LINEAR_____115_CM 0. 20000. FORMAT "%5.0"
 /begin AXIS_DESCR COM_AXIS Vxx_n _CNV_A_R_ENSD_LINEA_22_CM 20 0. 16383.75 FORMAT "%8.2" AXIS_PTS_REF Ctb_n /end AXIS_DESCR
/end CHARACTERISTIC
/begin MEASUREMENT Vxx_max_spg_prs "Maximum boost pressure to protect engine and supercharger" UWORD _CNV_A_R_LINEAR_____115_CM 1 0. 0. 20000. ECU_ADDRESS 0xd0003dd2 FORMAT "%5.0" /end MEASUREMENT
/begin MEASUREMENT Vxx_pump_max_maf "Maximum mass air flow pumped by the engine to protect engine and supercharger" UWORD _CNV_A_R_LINEAR_____172_CM 1 0. 0. 3000. ECU_ADDRESS 0xd0003dd4 FORMAT "%7.2" /end MEASUREMENT
/begin CHARACTERISTIC Ctp_max_map_inj_cut "Table giving the manifold pressure threshold for injection cut" CURVE 0xa0024b88 _REC_A1CUR_20_u2_u2 20000. _CNV_A_R_LINEAR_____115_CM 0. 20000. FORMAT "%5.0"
 /begin AXIS_DESCR COM_AXIS Vxx_n _CNV_A_R_ENSD_LINEA_22_CM 9 0. 16383.75 FORMAT "%8.2" AXIS_PTS_REF Ctb_n2 /end AXIS_DESCR
/end CHARACTERISTIC
/begin MEASUREMENT Vbx_ovp_inj_cut "Full injector cut request due to manifold overpressure" UBYTE _CNV_S_2_RANGE______3_CM 1 0. 0. 1. ECU_ADDRESS 0xd000648d BIT_MASK 0x1 /end MEASUREMENT
/begin MEASUREMENT Vxx_dly_inj_cut "TDC number since entry in manifold overpressure cut conditions" UWORD _CNV_A_R_LINEAR_____101_CM 1 0. 0. 65535. ECU_ADDRESS 0xd0003dd8 FORMAT "%5.0" /end MEASUREMENT
/begin MEASUREMENT Vxx_map_drv "Derivate of manifold air pressure" SWORD _CNV_A_R_LINEAR_____173_CM 1 0. -100000. 100000. ECU_ADDRESS 0xd0003dda FORMAT "%7.0" /end MEASUREMENT
/begin MEASUREMENT Vxx_map_thd_inj_cut "Manifold pressure threshold over which the monitoring of manifold overpressure cut condition is made" UWORD _CNV_A_R_LINEAR_____115_CM 1 0. 0. 20000. ECU_ADDRESS 0xd0003ddc FORMAT "%5.0" /end MEASUREMENT
/begin MEASUREMENT Vxx_max_map_inj_cut "Manifold pressure threshold for overpressure cut condition" UWORD _CNV_A_R_LINEAR_____115_CM 1 0. 0. 20000. ECU_ADDRESS 0xd0003dde FORMAT "%5.0" /end MEASUREMENT
/begin CHARACTERISTIC Cxx_map_drv_inj_cut "Limite of manifold pressure derivate to detect overpressure cut condition" VALUE 0xa0020c0a _REC_S1VAL_20_s2 1560000. _CNV_A_R_LINEAR_____174_CM -780000. 780000. FORMAT "%7.0" /end CHARACTERISTIC
/begin CHARACTERISTIC Cxx_nr_tdc_inj_cut "TDC delay before reactivating manifold overpressure cut" VALUE 0xa0020c0c _REC_S1VAL_20_u2 65535. _CNV_A_R_LINEAR_____101_CM 0. 65535. FORMAT "%5.0" /end CHARACTERISTIC
/begin CHARACTERISTIC Cxx_prs_thd_inj_cut "Offset de pression sur la pression maximum de coupure injection." VALUE 0xa0020c0e _REC_S1VAL_20_u2 20000. _CNV_A_R_LINEAR_____115_CM 0. 20000. FORMAT "%5.0" /end CHARACTERISTIC
/begin AXIS_PTS Ctb_spg_ol_map_sp "9 breakpoint table for the manifold pressure setpoint" 0xa0024b9c Vxx_alti_cor_map_sp _REC_A2AXS_20_u2 20000. _CNV_A_R_LINEAR_____115_CM 9 0. 20000. FORMAT "%5.0" /end AXIS_PTS
/begin AXIS_PTS Ctb_spg_prs_err "9 breakpoint table for boost pressure error" 0xa0024bb0 Vxx_spg_fil_prs_err _REC_A2AXS_20_u2 20000. _CNV_A_R_LINEAR_____158_CM 9 -10000. 10000. FORMAT "%6.0" /end AXIS_PTS
/begin AXIS_PTS Ctb_spg_prs_err_drv "9 breakpoint table for the derivate of boost pressure error." 0xa0024bc4 Vxx_spg_raw_fil_prs_err_drv _REC_A2AXS_20_u2 20000. _CNV_A_R_LINEAR_____158_CM 9 -10000. 10000. FORMAT "%6.0" /end AXIS_PTS
/begin AXIS_PTS Ctb_thr_psn "9 breakpoint table for the throttle position" 0xa0024bd8 Vxx_fil1_it_psn_sp _REC_A2AXS_20_u2 200. _CNV_A_R_LINEAR_____146_CM 9 0. 200. FORMAT "%6.2" /end AXIS_PTS
/begin CHARACTERISTIC Cmp_spg_i_pwm_fac "Integral term gain for the wastegate regulation" MAP 0xa0024bec _REC_A1MAP_20_u1_u2_u1 1.31484375e-002 _CNV_A_R_LINEAR_____175_CM 0. 1.31484375e-002 FORMAT "%10.8"
 /begin AXIS_DESCR COM_AXIS Vxx_spg_fil_prs_err _CNV_A_R_LINEAR_____158_CM 9 -10000. 10000. FORMAT "%6.0" AXIS_PTS_REF Ctb_spg_prs_err /end AXIS_DESCR
 /begin AXIS_DESCR COM_AXIS Vxx_gear _CNV_A_R_LINEAR_____145_CM 8 -1. 6. READ_ONLY FORMAT "%2.0" AXIS_PTS_REF Ntb_gear /end AXIS_DESCR
/end CHARACTERISTIC
/begin CHARACTERISTIC Cmp_spg_ol_pwm "PWM setpoint for the wastegate command" MAP 0xa0024c34 _REC_A1MAP_20_u1_u2_u2 100. _CNV_A_R_LINEAR_____165_CM 0. 100. FORMAT "%12.8"
 /begin AXIS_DESCR COM_AXIS Vxx_n _CNV_A_R_ENSD_LINEA_22_CM 9 0. 16383.75 FORMAT "%8.2" AXIS_PTS_REF Ctb_n2 /end AXIS_DESCR
 /begin AXIS_DESCR COM_AXIS Vxx_alti_cor_map_sp _CNV_A_R_LINEAR_____115_CM 9 0. 20000. FORMAT "%5.0" AXIS_PTS_REF Ctb_spg_ol_map_sp /end AXIS_DESCR
/end CHARACTERISTIC
/begin CHARACTERISTIC Cmp_spg_ol_pwm_thr_n "Wastegate PWM command depending on revs and throttle position setpoint" MAP 0xa0024c88 _REC_A1MAP_20_u1_u2_u2 100. _CNV_A_R_LINEAR_____165_CM 0. 100. FORMAT "%12.8"
 /begin AXIS_DESCR COM_AXIS Vxx_n _CNV_A_R_ENSD_LINEA_22_CM 9 0. 16383.75 FORMAT "%8.2" AXIS_PTS_REF Ctb_n2 /end AXIS_DESCR
 /begin AXIS_DESCR COM_AXIS Vxx_fil1_it_psn_sp _CNV_A_R_LINEAR_____146_CM 9 0. 200. FORMAT "%6.2" AXIS_PTS_REF Ctb_thr_psn /end AXIS_DESCR
/end CHARACTERISTIC
/begin CHARACTERISTIC Cmp_spg_prop_pwm_fac "Proportional term gain for the wastegate regulation" MAP 0xa0024cdc _REC_A1MAP_20_u1_u2_u1 0.420650390625 _CNV_A_R_LINEAR_____176_CM 0. 0.420650390625 FORMAT "%9.7"
 /begin AXIS_DESCR COM_AXIS Vxx_spg_fil_prs_err _CNV_A_R_LINEAR_____158_CM 9 -10000. 10000. FORMAT "%6.0" AXIS_PTS_REF Ctb_spg_prs_err /end AXIS_DESCR
 /begin AXIS_DESCR COM_AXIS Vxx_gear _CNV_A_R_LINEAR_____145_CM 8 -1. 6. READ_ONLY FORMAT "%2.0" AXIS_PTS_REF Ntb_gear /end AXIS_DESCR
/end CHARACTERISTIC
/begin CHARACTERISTIC Ctp_spg_cl_spg_prs_thd "Wastegate command start pressure." CURVE 0xa0024d24 _REC_A1CUR_20_u2_u2 20000. _CNV_A_R_LINEAR_____115_CM 0. 20000. FORMAT "%5.0"
 /begin AXIS_DESCR COM_AXIS Vxx_n _CNV_A_R_ENSD_LINEA_22_CM 9 0. 16383.75 FORMAT "%8.2" AXIS_PTS_REF Ctb_n2 /end AXIS_DESCR
/end CHARACTERISTIC
/begin CHARACTERISTIC Ctp_spg_drv_pwm_fac "Derivative term gain for the wastegate regulation" CURVE 0xa0024d38 _REC_A1CUR_20_u1_u2 3.984375 _CNV_A_R_LINEAR_____177_CM 0. 3.984375 FORMAT "%8.6"
 /begin AXIS_DESCR COM_AXIS Vxx_spg_raw_fil_prs_err_drv _CNV_A_R_LINEAR_____158_CM 9 -10000. 10000. FORMAT "%6.0" AXIS_PTS_REF Ctb_spg_prs_err_drv /end AXIS_DESCR
/end CHARACTERISTIC
/begin CHARACTERISTIC Ctp_spg_prs_dif_thd_trs "Pressure error threshold for transiant detection" CURVE 0xa0024d44 _REC_A1CUR_20_u2_u2 20000. _CNV_A_R_LINEAR_____115_CM 0. 20000. FORMAT "%5.0"
 /begin AXIS_DESCR COM_AXIS Vxx_n _CNV_A_R_ENSD_LINEA_22_CM 9 0. 16383.75 FORMAT "%8.2" AXIS_PTS_REF Ctb_n2 /end AXIS_DESCR
/end CHARACTERISTIC
/begin MEASUREMENT Vbx_spg_ad_cdn "Boost adaptative conditions" UBYTE _CNV_S_2_RANGE______3_CM 1 0. 0. 1. ECU_ADDRESS 0xd0007724 BIT_MASK 0x1 /end MEASUREMENT
/begin MEASUREMENT Vbx_spg_cl_cdn "Wastegate regulation conditions" UBYTE _CNV_S_2_RANGE______3_CM 1 0. 0. 1. ECU_ADDRESS 0xd0007725 BIT_MASK 0x1 /end MEASUREMENT
/begin MEASUREMENT Vbx_spg_i_frz "Freezing of the integral term on boost control." UBYTE _CNV_S_2_RANGE______3_CM 1 0. 0. 1. ECU_ADDRESS 0xd0007726 BIT_MASK 0x1 /end MEASUREMENT
/begin MEASUREMENT Vbx_spg_ol_cdn "Enables open loop command of the wastegate" UBYTE _CNV_S_2_RANGE______3_CM 1 0. 0. 1. ECU_ADDRESS 0xd000648f BIT_MASK 0x1 /end MEASUREMENT
/begin MEASUREMENT Vbx_spg_pwm_dsb_req "Wastegate command driver disable request" UBYTE _CNV_S_2_RANGE______3_CM 1 0. 0. 1. ECU_ADDRESS 0xd0006490 BIT_MASK 0x1 /end MEASUREMENT
/begin MEASUREMENT Vbx_spg_trs "Wastegate transiant" UBYTE _CNV_S_2_RANGE______3_CM 1 0. 0. 1. ECU_ADDRESS 0xd0006491 BIT_MASK 0x1 /end MEASUREMENT
/begin MEASUREMENT Vxx_alti_cor_map_sp "Boost pressure setpoint corrected by alto pressure." UWORD _CNV_A_R_LINEAR_____115_CM 1 0. 0. 20000. ECU_ADDRESS 0xd0004fe2 FORMAT "%5.0" /end MEASUREMENT
/begin MEASUREMENT Vxx_ol_spg_pwm "PWM open loop setpoint for the wastegate." UBYTE _CNV_A_R_LINEAR_____165_CM 1 0. 0. 100. ECU_ADDRESS 0xd0007727 FORMAT "%12.8" /end MEASUREMENT
/begin MEASUREMENT Vxx_spg_ad_pwm_inc "Raw value of adaptative increment" SWORD _CNV_A_R_LINEAR_____82_CM 1 0. -50. 49.9984741210938 ECU_ADDRESS 0xd0004fe4 FORMAT "%7.3" /end MEASUREMENT
/begin MEASUREMENT Vxx_spg_alti_ofs "Altimetric pressure correction for the wastegate regulation" SWORD _CNV_A_R_LINEAR_____115_CM 1 0. -10000. 10000. ECU_ADDRESS 0xd0004fe6 FORMAT "%6.0" /end MEASUREMENT
/begin MEASUREMENT Vxx_spg_cl_pwm "Closed loop corretion for the wastegate regulation" SWORD _CNV_A_R_LINEAR_____82_CM 1 0. -50. 49.9984741210938 ECU_ADDRESS 0xd0004fe8 FORMAT "%7.3" /end MEASUREMENT
/begin MEASUREMENT Vxx_spg_d_pwm "Derivative term for the wastegate regulation" SWORD _CNV_A_R_LINEAR_____82_CM 1 0. -50. 49.9984741210938 ECU_ADDRESS 0xd0004fea FORMAT "%7.3" /end MEASUREMENT
/begin MEASUREMENT Vxx_spg_fil_prs_err "Boost pressure error" SWORD _CNV_A_R_LINEAR_____115_CM 1 0. -10000. 10000. ECU_ADDRESS 0xd0004fec FORMAT "%6.0" /end MEASUREMENT
/begin MEASUREMENT Vxx_spg_fil_prs_err_drv "Filtered derivate of the boost pressure error" SWORD _CNV_A_R_LINEAR_____115_CM 1 0. -10000. 10000. ECU_ADDRESS 0xd0004fee FORMAT "%6.0" /end MEASUREMENT
/begin MEASUREMENT Vxx_spg_i_aw_cor "Integral term anti wind up correction" SWORD _CNV_A_R_LINEAR_____82_CM 1 0. -50. 49.9984741210938 ECU_ADDRESS 0xd0004ff0 FORMAT "%7.3" /end MEASUREMENT
/begin MEASUREMENT Vxx_spg_i_pwm "Integral term for the wastegate regulation" SWORD _CNV_A_R_LINEAR_____82_CM 1 0. -50. 49.9984741210938 ECU_ADDRESS 0xd0004ff2 FORMAT "%7.3" /end MEASUREMENT
/begin MEASUREMENT Vxx_spg_p_pwm "Proportional term for the wastegate regulation" SWORD _CNV_A_R_LINEAR_____82_CM 1 0. -50. 49.9984741210938 ECU_ADDRESS 0xd0004ff4 FORMAT "%7.3" /end MEASUREMENT
/begin MEASUREMENT Vxx_spg_prs_err "Boost pressure error for the wastegate control" SWORD _CNV_A_R_LINEAR_____115_CM 1 0. -10000. 10000. ECU_ADDRESS 0xd0003de4 FORMAT "%6.0" /end MEASUREMENT
/begin MEASUREMENT Vxx_spg_pwm_sp "RCO setpoint of the wastegate" UBYTE _CNV_A_R_LINEAR_____165_CM 1 0. 0. 100. ECU_ADDRESS 0xd0006492 FORMAT "%12.8" /end MEASUREMENT
/begin MEASUREMENT Vxx_spg_raw_fil_prs_err_drv "Raw derivate of the boost pressure error" SWORD _CNV_A_R_LINEAR_____115_CM 1 0. -10000. 10000. ECU_ADDRESS 0xd0004ff6 FORMAT "%6.0" /end MEASUREMENT
/begin CHARACTERISTIC Cbx_spg_bch_mod "Bench mode for wastegate command" VALUE 0xa0020c3c _REC_S1VAL_20_u1 1. _CNV_A_R_ECME_LINEA_0_CM 0. 1. FORMAT "%1.0" BIT_MASK 0x1 /end CHARACTERISTIC
/begin CHARACTERISTIC Cbx_spg_rams_cfm "Strategy choice : Turbocharger failure (1) or spg sensor failure (0)" VALUE 0xa0020c3d _REC_S1VAL_20_u1 1. _CNV_A_R_ECME_LINEA_0_CM 0. 1. FORMAT "%1.0" BIT_MASK 0x1 /end CHARACTERISTIC
/begin CHARACTERISTIC Cbx_spg_tq_off_mod "disables the revs - Throttle area cartography" VALUE 0xa0020c3e _REC_S1VAL_20_u1 1. _CNV_A_R_ECME_LINEA_0_CM 0. 1. FORMAT "%1.0" BIT_MASK 0x1 /end CHARACTERISTIC
/begin CHARACTERISTIC Cxx_spg_ad_alti_thd "Atmospheric pressure threshold underwhich there is no adaptation" VALUE 0xa0020c10 _REC_S1VAL_20_u2 20000. _CNV_A_R_LINEAR_____115_CM 0. 20000. FORMAT "%5.0" /end CHARACTERISTIC
/begin CHARACTERISTIC Cxx_spg_ad_down_vb_thd "Battery voltage underwich no adaptation is done" VALUE 0xa0020c12 _REC_S1VAL_20_u2 25000. _CNV_A_R_LINEAR_____107_CM 0. 25000. FORMAT "%5.0" /end CHARACTERISTIC
/begin CHARACTERISTIC Cxx_spg_ad_n_thd "Engine speed threshold overwhich no adaptation is done" VALUE 0xa0020c14 _REC_S1VAL_20_u2 16383.75 _CNV_A_R_ENSD_LINEA_22_CM 0. 16383.75 FORMAT "%8.2" /end CHARACTERISTIC
/begin CHARACTERISTIC Cxx_spg_ad_pwm_fac "Filter factor of the mean PWM when calculating the adaptation value" VALUE 0xa0020c3f _REC_S1VAL_20_u1 0.99609375 _CNV_A_R_LINEAR_____29_CM 0. 0.99609375 FORMAT "%5.3" /end CHARACTERISTIC
/begin CHARACTERISTIC Cxx_spg_ad_pwm_max_cor "Maximum adaptative term for the wastegate regulation" VALUE 0xa0020c16 _REC_S1VAL_20_s2 99.99847412109381 _CNV_A_R_LINEAR_____82_CM -50. 49.9984741210938 FORMAT "%7.3" /end CHARACTERISTIC
/begin CHARACTERISTIC Cxx_spg_ad_pwm_min_cor "Minimum adaptative term for the wastegate regulation" VALUE 0xa0020c18 _REC_S1VAL_20_s2 99.99847412109381 _CNV_A_R_LINEAR_____82_CM -50. 49.9984741210938 FORMAT "%7.3" /end CHARACTERISTIC
/begin CHARACTERISTIC Cxx_spg_ad_spg_thd "Pressure threshold underwhich no adaptation is done" VALUE 0xa0020c1a _REC_S1VAL_20_u2 20000. _CNV_A_R_LINEAR_____115_CM 0. 20000. FORMAT "%5.0" /end CHARACTERISTIC
/begin CHARACTERISTIC Cxx_spg_ad_stab_prs_thd "Stabilized pressure detection threshold" VALUE 0xa0020c1c _REC_S1VAL_20_u2 20000. _CNV_A_R_LINEAR_____115_CM 0. 20000. FORMAT "%5.0" /end CHARACTERISTIC
/begin CHARACTERISTIC Cxx_spg_ad_up_vb_thd "Battery voltage over which no adpation is done" VALUE 0xa0020c1e _REC_S1VAL_20_u2 25000. _CNV_A_R_LINEAR_____107_CM 0. 25000. FORMAT "%5.0" /end CHARACTERISTIC
/begin CHARACTERISTIC Cxx_spg_alti_ofs_fac "Correction gain on the altimetric pressure for the boost pressure regulation." VALUE 0xa0020c40 _REC_S1VAL_20_u1 1.9921875 _CNV_A_R_LINEAR_____42_CM 0. 1.9921875 FORMAT "%8.6" /end CHARACTERISTIC
/begin CHARACTERISTIC Cxx_spg_alti_ofs_ofs "Offset for the altimetric pressure correction. For the boost pressure regulation" VALUE 0xa0020c20 _REC_S1VAL_20_u2 20000. _CNV_A_R_LINEAR_____115_CM 0. 20000. FORMAT "%5.0" /end CHARACTERISTIC
/begin CHARACTERISTIC Cxx_spg_alti_ol_pwm_fac "Altmospheric pressure correction for wastegate PWM" VALUE 0xa0020c41 _REC_S1VAL_20_u1 1.9921875 _CNV_A_R_LINEAR_____42_CM 0. 1.9921875 FORMAT "%8.6" /end CHARACTERISTIC
/begin CHARACTERISTIC Cxx_spg_cl_tco_thd "Coolant temperature threshold for wastegate control" VALUE 0xa0020c22 _REC_S1VAL_20_u2 240. _CNV_A_R_LINEAR_____110_CM -40. 200. FORMAT "%5.1" /end CHARACTERISTIC
/begin CHARACTERISTIC Cxx_spg_down_ad_dz "Minimum deadzone for adaptative term of wastegate" VALUE 0xa0020c24 _REC_S1VAL_20_s2 99.99847412109381 _CNV_A_R_LINEAR_____82_CM -50. 49.9984741210938 FORMAT "%7.3" /end CHARACTERISTIC
/begin CHARACTERISTIC Cxx_spg_err_down_thd_drv "Boost pressure threshold under which cerrection is canceled" VALUE 0xa0020c26 _REC_S1VAL_20_s2 20000. _CNV_A_R_LINEAR_____115_CM -10000. 10000. FORMAT "%6.0" /end CHARACTERISTIC
/begin CHARACTERISTIC Cxx_spg_err_drv_ftc "Filter time constant for the boost pressure error" VALUE 0xa0020c28 _REC_S1VAL_20_u2 655.35 _CNV_A_R_LINEAR_____32_CM 0. 655.35 FORMAT "%6.2" /end CHARACTERISTIC
/begin CHARACTERISTIC Cxx_spg_err_up_thd_drv "Boost pressure error threshold over which derivate correction is canceled" VALUE 0xa0020c2a _REC_S1VAL_20_s2 20000. _CNV_A_R_LINEAR_____115_CM -10000. 10000. FORMAT "%6.0" /end CHARACTERISTIC
/begin CHARACTERISTIC Cxx_spg_i_aw_fac "Anti wind up Corrective gain" VALUE 0xa0020c42 _REC_S1VAL_20_u1 1. _CNV_A_R_LINEAR_____162_CM 0. 1. FORMAT "%9.7" /end CHARACTERISTIC
/begin CHARACTERISTIC Cxx_spg_i_pwm_max_cor "maximum Integral term for the wastegate regulation" VALUE 0xa0020c2c _REC_S1VAL_20_s2 99.99847412109381 _CNV_A_R_LINEAR_____82_CM -50. 49.9984741210938 FORMAT "%7.3" /end CHARACTERISTIC
/begin CHARACTERISTIC Cxx_spg_i_pwm_min_cor "minimum integral term for the wastegate regulation" VALUE 0xa0020c2e _REC_S1VAL_20_s2 99.99847412109381 _CNV_A_R_LINEAR_____82_CM -50. 49.9984741210938 FORMAT "%7.3" /end CHARACTERISTIC
/begin CHARACTERISTIC Cxx_spg_i_pwm_sp "Setpoint for the integral term of the wastegate regulation" VALUE 0xa0020c30 _REC_S1VAL_20_s2 99.99847412109381 _CNV_A_R_LINEAR_____82_CM -50. 49.9984741210938 FORMAT "%7.3" /end CHARACTERISTIC
/begin CHARACTERISTIC Cxx_spg_max_err_drv "Maximum value for boost pressure error derivate" VALUE 0xa0020c32 _REC_S1VAL_20_s2 20000. _CNV_A_R_LINEAR_____115_CM -10000. 10000. FORMAT "%6.0" /end CHARACTERISTIC
/begin CHARACTERISTIC Cxx_spg_max_pwm "Maximum threshold for the PWM saturation detection" VALUE 0xa0020c43 _REC_S1VAL_20_u1 100. _CNV_A_R_LINEAR_____165_CM 0. 100. FORMAT "%12.8" /end CHARACTERISTIC
/begin CHARACTERISTIC Cxx_spg_max_pwm_aw "Maximum threshold for the application of the anti wind up correction on integral term" VALUE 0xa0020c44 _REC_S1VAL_20_u1 100. _CNV_A_R_LINEAR_____165_CM 0. 100. FORMAT "%12.8" /end CHARACTERISTIC
/begin CHARACTERISTIC Cxx_spg_min_err_drv "Minimum value for boost pressure error derivate" VALUE 0xa0020c34 _REC_S1VAL_20_s2 20000. _CNV_A_R_LINEAR_____115_CM -10000. 10000. FORMAT "%6.0" /end CHARACTERISTIC
/begin CHARACTERISTIC Cxx_spg_min_pwm "Minimum threshold for the PWM saturation detection" VALUE 0xa0020c45 _REC_S1VAL_20_u1 100. _CNV_A_R_LINEAR_____165_CM 0. 100. FORMAT "%12.8" /end CHARACTERISTIC
/begin CHARACTERISTIC Cxx_spg_min_pwm_aw "Minimum threshold for the application of the anti wind up correction on integral term" VALUE 0xa0020c46 _REC_S1VAL_20_u1 100. _CNV_A_R_LINEAR_____165_CM 0. 100. FORMAT "%12.8" /end CHARACTERISTIC
/begin CHARACTERISTIC Cxx_spg_ol_spg_sp_thd "Pressure threshold under which open loop term is applied." VALUE 0xa0020c36 _REC_S1VAL_20_u2 20000. _CNV_A_R_LINEAR_____115_CM 0. 20000. FORMAT "%5.0" /end CHARACTERISTIC
/begin CHARACTERISTIC Cxx_spg_prop_dz "Deadzone within which proportional term is canceled." VALUE 0xa0020c38 _REC_S1VAL_20_u2 20000. _CNV_A_R_LINEAR_____115_CM 0. 20000. FORMAT "%5.0" /end CHARACTERISTIC
/begin CHARACTERISTIC Cxx_spg_pwm_bch_mod_val "Bench mode value for wastegate PWM" VALUE 0xa0020c47 _REC_S1VAL_20_u1 100. _CNV_A_R_LINEAR_____165_CM 0. 100. FORMAT "%12.8" /end CHARACTERISTIC
/begin CHARACTERISTIC Cxx_spg_pwm_dif_trt_ad "Difference between setpoint and limits under which learning is disabled." VALUE 0xa0020c48 _REC_S1VAL_20_u1 100. _CNV_A_R_LINEAR_____165_CM 0. 100. FORMAT "%12.8" /end CHARACTERISTIC
/begin CHARACTERISTIC Cxx_spg_up_ad_dz "Maximum deadzone value for the adaptative term" VALUE 0xa0020c3a _REC_S1VAL_20_s2 99.99847412109381 _CNV_A_R_LINEAR_____82_CM -50. 49.9984741210938 FORMAT "%7.3" /end CHARACTERISTIC
/begin MEASUREMENT Sxx_spg_ad_pwm_NVM "Slow adaptive term of the wastegate control" SWORD _CNV_A_R_LINEAR_____82_CM 1 0. -50. 49.9984741210938 DISPLAY_IDENTIFIER AsBstCtl_NVM.Sxx_spg_ad_pwm_NVM ECU_ADDRESS 0xd0004fe0 FORMAT "%7.3" /end MEASUREMENT
/begin AXIS_PTS Ctb_eal "16 breakpoint table for Engine air load" 0xa002b7f4 Vxx_eal _REC_A2AXS_20_u2 3.99993896484375 _CNV_A_R_LINEAR_____53_CM 16 0. 3.99993896484375 FORMAT "%10.8" /end AXIS_PTS
/begin AXIS_PTS Ctp_it_ar_psn "Throttle position setpoint depending on effective area." 0xa002c8f8 Vxx_mv_it_rel_psn _REC_A2AXS_20_u2 100. _CNV_A_R_LINEAR_____150_CM 17 0. 100. FORMAT "%6.2" /end AXIS_PTS
/begin AXIS_PTS Ctb_tco "16 engine coolant temperature breakpoints" 0xa002d4ac Vxx_tco _REC_A2AXS_20_u2 240. _CNV_A_R_LINEAR_____110_CM 16 -40. 200. FORMAT "%5.1" /end AXIS_PTS
/begin AXIS_PTS Ctb_tco2 "Engine coolant temperature breakpoints" 0xa002d4d0 Vxx_tco _REC_A2AXS_20_u2 240. _CNV_A_R_LINEAR_____110_CM 9 -40. 200. FORMAT "%5.1" /end AXIS_PTS
/begin AXIS_PTS Ctb_n_noi_lim "9 programmable engine speed breakpoints map for acoustic limitation" 0xa0035918 Vxx_n_mv _REC_A2AXS_20_u2 16383.75 _CNV_A_R_ENSD_LINEA_22_CM 9 0. 16383.75 FORMAT "%8.2" /end AXIS_PTS
/begin AXIS_PTS Ctb_n "20 programmable engine speed breakpoints map" 0xa002db74 Vxx_n _REC_A2AXS_20_u2 16383.75 _CNV_A_R_ENSD_LINEA_22_CM 20 0. 16383.75 FORMAT "%8.2" /end AXIS_PTS
/begin AXIS_PTS Ctb_n2 "9 programmable engine speed breakpoints table" 0xa002dba0 Vxx_n _REC_A2AXS_20_u2 16383.75 _CNV_A_R_ENSD_LINEA_22_CM 9 0. 16383.75 FORMAT "%8.2" /end AXIS_PTS
/begin MEASUREMENT Vbx_cp_ad_ena "Adaptive canister purge authorized" UBYTE _CNV_S_2_RANGE______3_CM 1 0. 0. 1. ECU_ADDRESS 0xd00067b9 BIT_MASK 0x1 /end MEASUREMENT
/begin MEASUREMENT Vbx_cp_is_ena "Idle speed canister purge condition" UBYTE _CNV_S_2_RANGE______3_CM 1 0. 0. 1. ECU_ADDRESS 0xd00067ba BIT_MASK 0x1 /end MEASUREMENT
/begin MEASUREMENT Vbx_cp_lsm_ad_ena "Adaptive less square enable" UBYTE _CNV_S_2_RANGE______3_CM 1 0. 0. 1. ECU_ADDRESS 0xd00067bb BIT_MASK 0x1 /end MEASUREMENT
/begin MEASUREMENT Vbx_cp_rich_cge "Engine richness is perturbted by the canister purge" UBYTE _CNV_S_2_RANGE______3_CM 1 0. 0. 1. ECU_ADDRESS 0xd00067bc BIT_MASK 0x1 /end MEASUREMENT
/begin MEASUREMENT Vbx_prev_cp "Last canister purge functioning" UBYTE _CNV_S_2_RANGE______3_CM 1 0. 0. 1. ECU_ADDRESS 0xd00067bd BIT_MASK 0x1 /end MEASUREMENT
/begin MEASUREMENT Vxx_cp_egr_sta_dly "Delay - Canister purge" UWORD _CNV_A_R_LINEAR_____32_CM 1 0. 0. 655.35 ECU_ADDRESS 0xd0005154 FORMAT "%6.2" /end MEASUREMENT
/begin MEASUREMENT Vxx_cp_egr_stop_dly "Delay - Canister purge" UWORD _CNV_A_R_LINEAR_____32_CM 1 0. 0. 655.35 ECU_ADDRESS 0xd0005156 FORMAT "%6.2" /end MEASUREMENT
/begin CHARACTERISTIC Cxx_cp_lamb_fac_mv_thd_1 "Mini threshold to authorize the functioning of the canister purge" VALUE 0xa0021026 _REC_S1VAL_20_u2 0.6666666000000001 _CNV_A_R_LINEAR_____169_CM 0.6666667 1.3333333 FORMAT "%10.8" /end CHARACTERISTIC
/begin CHARACTERISTIC Cxx_cp_lamb_fac_mv_thd_2 "Maxi threshold to authorize the functioning of the canister purge" VALUE 0xa0021028 _REC_S1VAL_20_u2 0.6666666000000001 _CNV_A_R_LINEAR_____169_CM 0.6666667 1.3333333 FORMAT "%10.8" /end CHARACTERISTIC
/begin CHARACTERISTIC Cxx_cp_t_off "Canister purge begin functioning duration" VALUE 0xa002102a _REC_S1VAL_20_u2 655.35 _CNV_A_R_LINEAR_____32_CM 0. 655.35 FORMAT "%6.2" /end CHARACTERISTIC
/begin CHARACTERISTIC Cxx_cp_t_on "Canister purge end functioning duration" VALUE 0xa002102c _REC_S1VAL_20_u2 655.35 _CNV_A_R_LINEAR_____32_CM 0. 655.35 FORMAT "%6.2" /end CHARACTERISTIC
/begin AXIS_PTS Ctb_n_cp "Filtering factor table for canister charge correction applied" 0xa002a694 Vxx_n _REC_A2AXS_20_u2 16383.75 _CNV_A_R_ENSD_LINEA_22_CM 9 0. 16383.75 FORMAT "%8.2" /end AXIS_PTS
/begin CHARACTERISTIC Ctp_n_cp "Filtering factor breakpoints for canister charge correction applied" CURVE 0xa002a6a8 _REC_A1CUR_20_u1_u2 1. _CNV_A_R_LINEAR_____162_CM 0. 1. FORMAT "%9.7"
 /begin AXIS_DESCR COM_AXIS Vxx_n _CNV_A_R_ENSD_LINEA_22_CM 9 0. 16383.75 FORMAT "%8.2" AXIS_PTS_REF Ctb_n_cp /end AXIS_DESCR
/end CHARACTERISTIC
/begin MEASUREMENT Vbx_cp_ad "Canister charge is currently learned" UBYTE _CNV_S_2_RANGE______3_CM 1 0. 0. 1. ECU_ADDRESS 0xd00067c3 BIT_MASK 0x1 /end MEASUREMENT
/begin MEASUREMENT Vbx_cp_rich_cor_lean_cond "Lean condition for the richness correction" UBYTE _CNV_S_2_RANGE______3_CM 1 0. 0. 1. ECU_ADDRESS 0xd00067c4 BIT_MASK 0x1 /end MEASUREMENT
/begin MEASUREMENT Vbx_cp_rich_cor_rich_cond "Rich condition for the richness correction" UBYTE _CNV_S_2_RANGE______3_CM 1 0. 0. 1. ECU_ADDRESS 0xd00067c5 BIT_MASK 0x1 /end MEASUREMENT
/begin MEASUREMENT Vxx_cp_fim_fac "Corrective factor depending on \"exotic fuel\" quantity. For ignition-linked phenomena." UBYTE _CNV_A_R_LINEAR_____42_CM 1 0. 0. 1.9921875 ECU_ADDRESS 0xd0007815 FORMAT "%8.6" /end MEASUREMENT
/begin MEASUREMENT Vxx_cp_mv_cl_ti_fac "Mean value of the multiplicative factor from richness closed loop applied on injcted fuel mas quantity" UWORD _CNV_A_R_LINEAR_____100_CM 1 0. 0.6666666 1.33332309414063 ECU_ADDRESS 0xd000515a FORMAT "%8.7" /end MEASUREMENT
/begin MEASUREMENT Vxx_cp_rich_cor "Canister charge" UWORD _CNV_A_R_LINEAR_____50_CM 1 0. 0. 0.666656494140625 ECU_ADDRESS 0xd000515c FORMAT "%8.7" /end MEASUREMENT
/begin MEASUREMENT Vxx_cp_rich_cor_appl "Canister charge correction applied" UBYTE _CNV_A_R_LINEAR_____298_CM 1 0. 0.501953125 1. ECU_ADDRESS 0xd00067c6 FORMAT "%3.1" /end MEASUREMENT
/begin MEASUREMENT Vxx_cp_rich_cor_clc "Canister charge correction" UBYTE _CNV_A_R_LINEAR_____162_CM 1 0. 0. 1. ECU_ADDRESS 0xd0007816 FORMAT "%9.7" /end MEASUREMENT
/begin MEASUREMENT Vxx_cp_rich_int_cor "Integral factor to be applied on Vxx_cl_ti_fac in canister charge learning conditions" UBYTE _CNV_A_R_LINEAR_____50_CM 1 0. 0. 2.593994140625e-003 ECU_ADDRESS 0xd00067c7 FORMAT "%10.8" /end MEASUREMENT
/begin CHARACTERISTIC Cxx_cp_fac_rel "Format factor of the canister charge" VALUE 0xa002102e _REC_S1VAL_20_u2 1. _CNV_A_R_LINEAR_____143_CM 0. 1. FORMAT "%11.9" /end CHARACTERISTIC
/begin CHARACTERISTIC Cxx_cp_fil_cl_ti_fac "Filtering coefficient for the close loop in order to learn the canister load" VALUE 0xa0021030 _REC_S1VAL_20_u2 1. _CNV_A_R_LINEAR_____143_CM 0. 1. FORMAT "%11.9" /end CHARACTERISTIC
/begin CHARACTERISTIC Cxx_cp_grd_fac "Factor for the calculation of the canister charge integration" VALUE 0xa0021032 _REC_S1VAL_20_u2 6.5535e-007 _CNV_A_R_LINEAR_____394_CM 0. 6.5535e-007 FORMAT "%13.11" /end CHARACTERISTIC
/begin CHARACTERISTIC Cxx_cp_inc_ad "Incrementation of the canister charge in case of open loop" VALUE 0xa0021034 _REC_S1VAL_20_u2 1. _CNV_A_R_LINEAR_____143_CM 0. 1. FORMAT "%11.9" /end CHARACTERISTIC
/begin CHARACTERISTIC Cxx_cp_max_ad "Maximum value of the canister charge correction" VALUE 0xa0021036 _REC_S1VAL_20_u2 1. _CNV_A_R_LINEAR_____143_CM 0. 1. FORMAT "%11.9" /end CHARACTERISTIC
/begin CHARACTERISTIC Cxx_cp_ol_rich_cor_appl "Canister charge correction applied in case of open loop phase for canister purge" VALUE 0xa002103c _REC_S1VAL_20_u1 0.498046875 _CNV_A_R_LINEAR_____298_CM 0.501953125 1. FORMAT "%3.1" /end CHARACTERISTIC
/begin CHARACTERISTIC Cxx_cp_rel_step_lamb_fac "The close loop corrective must be centred when the canister purge is closed" VALUE 0xa0021038 _REC_S1VAL_20_u2 0.666656494140625 _CNV_A_R_LINEAR_____50_CM 0. 0.666656494140625 FORMAT "%8.7" /end CHARACTERISTIC
/begin CHARACTERISTIC Cxx_cp_step_lamb_fac "The close loop corrective must be centred when the canister purge is closed" VALUE 0xa002103a _REC_S1VAL_20_s2 1.333309575 _CNV_A_R_LINEAR_____136_CM -0.66666496 0.6666446150000001 FORMAT "%7.5" /end CHARACTERISTIC
/begin MEASUREMENT Vsx_ti_alco_cor_vld "Final alcohol adaptive validity status" UBYTE _CNV_S_8_STATUS_OK__234_CM 1 0. 0. 7. ECU_ADDRESS 0xd0007801 /end MEASUREMENT
/begin AXIS_PTS Ctb_alco_cor_blow_thd_fac "4-breakpoint table to specify blow-by threshold initial value depending on alcohol adaptative correction" 0xa002a618 Vxx_ti_alco_cor_stop _REC_A2AXS_20_u2 100. _CNV_A_R_LINEAR_____159_CM 4 0. 100. FORMAT "%12.8" /end AXIS_PTS
/begin AXIS_PTS Ctb_tco_blow_ctr "Table of 9 breakpoints for the blow by counter" 0xa002a624 Vxx_sta_tco _REC_A2AXS_20_u2 240. _CNV_A_R_LINEAR_____110_CM 9 -40. 200. FORMAT "%6.1" /end AXIS_PTS
/begin AXIS_PTS Ctb_tco_blow_thd "Table of 9 breakpoint for the blow by threshold" 0xa002a638 Vxx_sta_tco _REC_A2AXS_20_u2 240. _CNV_A_R_LINEAR_____110_CM 9 -40. 200. FORMAT "%6.1" /end AXIS_PTS
/begin CHARACTERISTIC Cmp_blow_ctr_dec "Decrementation of the blow by counter" MAP 0xa002a64c _REC_A1MAP_20_u1_u2_u2 255. _CNV_A_R_ECME_LINEA_0_CM 0. 255. FORMAT "%3.0"
 /begin AXIS_DESCR COM_AXIS Vxx_n _CNV_A_R_ENSD_LINEA_22_CM 4 0. 16383.75 FORMAT "%8.2" AXIS_PTS_REF Ctb_n_alco /end AXIS_DESCR
 /begin AXIS_DESCR COM_AXIS Vxx_pred_map _CNV_A_R_LINEAR_____115_CM 4 0. 20000. FORMAT "%5.0" AXIS_PTS_REF Ctb_map_alco /end AXIS_DESCR
/end CHARACTERISTIC
/begin CHARACTERISTIC Cmp_blow_thd_fac "Correction applied on the blow by threshold" MAP 0xa002a65c _REC_A1MAP_20_u1_u2_u2 1. _CNV_A_R_LINEAR_____162_CM 0. 1. FORMAT "%9.7"
 /begin AXIS_DESCR COM_AXIS Vxx_n _CNV_A_R_ENSD_LINEA_22_CM 4 0. 16383.75 FORMAT "%8.2" AXIS_PTS_REF Ctb_n_alco /end AXIS_DESCR
 /begin AXIS_DESCR COM_AXIS Vxx_pred_map _CNV_A_R_LINEAR_____115_CM 4 0. 20000. FORMAT "%5.0" AXIS_PTS_REF Ctb_map_alco /end AXIS_DESCR
/end CHARACTERISTIC
/begin CHARACTERISTIC Ctp_alco_cor_blow_thd_fac "4-breakpoint table for alcool dependence on blowby threshold" CURVE 0xa0021014 _REC_A1CUR_20_u1_u2 1. _CNV_A_R_LINEAR_____162_CM 0. 1. FORMAT "%9.7"
 /begin AXIS_DESCR COM_AXIS Vxx_ti_alco_cor_stop _CNV_A_R_LINEAR_____159_CM 4 0. 100. FORMAT "%12.8" AXIS_PTS_REF Ctb_alco_cor_blow_thd_fac /end AXIS_DESCR
/end CHARACTERISTIC
/begin CHARACTERISTIC Ctp_tco_blow_ctr "Initial value of the blow by counter, without taking into account the memorization" CURVE 0xa002a66c _REC_A1CUR_20_u2_u2 65535. _CNV_A_R_ECME_LINEA_0_CM 0. 65535. FORMAT "%5.0"
 /begin AXIS_DESCR COM_AXIS Vxx_sta_tco _CNV_A_R_LINEAR_____110_CM 9 -40. 200. FORMAT "%6.1" AXIS_PTS_REF Ctb_tco_blow_ctr /end AXIS_DESCR
/end CHARACTERISTIC
/begin CHARACTERISTIC Ctp_tco_blow_thd "Initial value of the blow by threshold, without taking into account the memorization" CURVE 0xa002a680 _REC_A1CUR_20_u2_u2 100. _CNV_A_R_LINEAR_____159_CM 0. 100. FORMAT "%12.8"
 /begin AXIS_DESCR COM_AXIS Vxx_sta_tco _CNV_A_R_LINEAR_____110_CM 9 -40. 200. FORMAT "%6.1" AXIS_PTS_REF Ctb_tco_blow_thd /end AXIS_DESCR
/end CHARACTERISTIC
/begin MEASUREMENT Vbx_blow_ctr_cdn "Blow by phenomenon conditions are satisfied" UBYTE _CNV_S_2_RANGE______3_CM 1 0. 0. 1. ECU_ADDRESS 0xd000780e BIT_MASK 0x1 /end MEASUREMENT
/begin MEASUREMENT Vbx_blow_ctr_cdn_mem "The blow by counter has been activated during the driving cycle" UBYTE _CNV_S_2_RANGE______3_CM 1 0. 0. 1. ECU_ADDRESS 0xd000780f BIT_MASK 0x1 /end MEASUREMENT
/begin MEASUREMENT Vbx_blow_det "The blow by phenomenon is detected" UBYTE _CNV_S_2_RANGE______3_CM 1 0. 0. 1. ECU_ADDRESS 0xd0007810 BIT_MASK 0x1 /end MEASUREMENT
/begin MEASUREMENT Vbx_blow_det_alco "Blowby phenomenon is detected for alcool adaptative strategy" UBYTE _CNV_S_2_RANGE______3_CM 1 0. 0. 1. ECU_ADDRESS 0xd0007811 BIT_MASK 0x1 /end MEASUREMENT
/begin MEASUREMENT Vbx_blow_det_mem "The blow by phenomenon has been detected during the driving cycle" UBYTE _CNV_S_2_RANGE______3_CM 1 0. 0. 1. ECU_ADDRESS 0xd0007812 BIT_MASK 0x1 /end MEASUREMENT
/begin MEASUREMENT Vbx_eng_aut_alco "Engine in autonomous state" UBYTE _CNV_S_2_RANGE______3_CM 1 0. 0. 1. ECU_ADDRESS 0xd0007813 BIT_MASK 0x1 /end MEASUREMENT
/begin MEASUREMENT Vxx_blow_ctr "Current value of the blow by counter" UWORD _CNV_A_R_ECME_LINEA_0_CM 1 0. 0. 65535. ECU_ADDRESS 0xd0005148 FORMAT "%5.0" /end MEASUREMENT
/begin MEASUREMENT Vxx_blow_ctr_dec "Current decrementation value of the blow by counter" UBYTE _CNV_A_R_ECME_LINEA_0_CM 1 0. 0. 255. ECU_ADDRESS 0xd0007814 FORMAT "%3.0" /end MEASUREMENT
/begin MEASUREMENT Vxx_blow_ctr_ini "Initial value of the blow by counter" UWORD _CNV_A_R_ECME_LINEA_0_CM 1 0. 0. 65535. ECU_ADDRESS 0xd000514a FORMAT "%5.0" /end MEASUREMENT
/begin MEASUREMENT Vxx_blow_thd "Current value of the blow by threshold" UWORD _CNV_A_R_LINEAR_____159_CM 1 0. 0. 100. ECU_ADDRESS 0xd000514c FORMAT "%12.8" /end MEASUREMENT
/begin MEASUREMENT Vxx_blow_thd_ini "Initial value of the blow by threshold" UWORD _CNV_A_R_LINEAR_____159_CM 1 0. 0. 100. ECU_ADDRESS 0xd000514e FORMAT "%12.8" /end MEASUREMENT
/begin MEASUREMENT Vxx_blow_thd_slop_neg "Current value of the negative slope of the blow by threshold" UWORD _CNV_A_R_LINEAR_____159_CM 1 0. 0. 100. ECU_ADDRESS 0xd0005150 FORMAT "%12.8" /end MEASUREMENT
/begin MEASUREMENT Vxx_blow_thd_slop_pos "Current value of the positive slope of the blow by threshold" UWORD _CNV_A_R_LINEAR_____159_CM 1 0. 0. 100. ECU_ADDRESS 0xd0005152 FORMAT "%12.8" /end MEASUREMENT
/begin CHARACTERISTIC Cxx_alco_ad_thd "Threshold on the final alcohol adaptive under which there is never a blow by phenomenon detection" VALUE 0xa0021018 _REC_S1VAL_20_u2 100. _CNV_A_R_LINEAR_____159_CM 0. 100. FORMAT "%12.8" /end CHARACTERISTIC
/begin CHARACTERISTIC Cxx_blow_ctr_tco_thd "Threshold on the coolant temperature above which the blow by phenomenon begins" VALUE 0xa002101a _REC_S1VAL_20_u2 240. _CNV_A_R_LINEAR_____110_CM -40. 200. FORMAT "%6.1" /end CHARACTERISTIC
/begin CHARACTERISTIC Cxx_blow_thd_max "Maximal value of the blow by threshold" VALUE 0xa002101c _REC_S1VAL_20_u2 100. _CNV_A_R_LINEAR_____159_CM 0. 100. FORMAT "%12.8" /end CHARACTERISTIC
/begin CHARACTERISTIC Cxx_blow_thd_slop_neg "Value of the negative slop of the slew rate applied on the blow by threshold" VALUE 0xa002101e _REC_S1VAL_20_u2 100. _CNV_A_R_LINEAR_____159_CM 0. 100. FORMAT "%12.8" /end CHARACTERISTIC
/begin CHARACTERISTIC Cxx_blow_thd_slop_pos "Value of the positive slop of the slew rate applied on the blow by threshold" VALUE 0xa0021020 _REC_S1VAL_20_u2 100. _CNV_A_R_LINEAR_____159_CM 0. 100. FORMAT "%12.8" /end CHARACTERISTIC
/begin CHARACTERISTIC Cxx_tco_blow_ctr "Initial value of the blow by counter in case of tco default" VALUE 0xa0021022 _REC_S1VAL_20_u2 65535. _CNV_A_R_ECME_LINEA_0_CM 0. 65535. FORMAT "%5.0" /end CHARACTERISTIC
/begin CHARACTERISTIC Cxx_tco_blow_thd "Value of the initial blow by threshold in case of tco default" VALUE 0xa0021024 _REC_S1VAL_20_u2 100. _CNV_A_R_LINEAR_____159_CM 0. 100. FORMAT "%12.8" /end CHARACTERISTIC
/begin MEASUREMENT Vbx_adoc_cfm "ADOC configuration" UBYTE _CNV_S_2_RANGE______3_CM 1 0. 0. 1. ECU_ADDRESS 0xd0007823 BIT_MASK 0x1 /end MEASUREMENT
/begin MEASUREMENT Vbx_alco_typ_cfm "Flex Fuel configuration" UBYTE _CNV_S_2_RANGE______3_CM 1 0. 0. 1. ECU_ADDRESS 0xd0007824 BIT_MASK 0x1 /end MEASUREMENT
/begin CHARACTERISTIC Cbx_adoc_cfm "Choice of ADOC configuration" VALUE 0xa0021076 _REC_S1VAL_20_u1 1. _CNV_A_R_ECME_LINEA_0_CM 0. 1. FORMAT "%1.0" BIT_MASK 0x1 /end CHARACTERISTIC
/begin CHARACTERISTIC Cbx_alco_typ_cfm "Choice of Flex Fuel configuration" VALUE 0xa0021077 _REC_S1VAL_20_u1 1. _CNV_A_R_ECME_LINEA_0_CM 0. 1. FORMAT "%1.0" BIT_MASK 0x1 /end CHARACTERISTIC
/begin MEASUREMENT Vsx_fuel_ign_cho_mem "Memorized Fuel ignition advance state." UBYTE _CNV_S_4_FUEL_IGN_A_160_CM 1 0. 0. 3. ECU_ADDRESS 0xd0007800 /end MEASUREMENT
/begin CHARACTERISTIC Csx_fuel_ign_ini "Initial Value Fuel ignition advance state." VALUE 0xa0020ff6 _REC_S1VAL_20_u1 3. _CNV_S_4_FUEL_IGN_A_160_CM 0. 3. /end CHARACTERISTIC
/begin AXIS_PTS Ntb_gear "Gearbox ratio breakpoint" 0xa002da28 Vxx_gear _REC_A2AXS_20_u1 7. _CNV_A_R_LINEAR_____145_CM 8 -1. 6. READ_ONLY FORMAT "%2.0" /end AXIS_PTS
/begin COMPU_METHOD _CNV_A_R_ECME_LINEA_0_CM "" RAT_FUNC "%6.3" "-" COEFFS 0 1. 0. 0 0 1 /end COMPU_METHOD
/begin COMPU_METHOD _CNV_A_R_LINEAR_____2_CM "" RAT_FUNC "%6.3" "rpm" COEFFS 0 3.125e-002 0. 0 0 1 /end COMPU_METHOD
/begin COMPU_METHOD _CNV_S_2_RANGE______3_CM "" TAB_VERB "%6.3" "-" COMPU_TAB_REF _CNV_S_2_RANGE______3 /end COMPU_METHOD
/begin COMPU_VTAB _CNV_S_2_RANGE______3 "" TAB_VERB 2 0 "0" 1 "1" /end COMPU_VTAB
/begin COMPU_METHOD _CNV_A_R_CPULOAD__0_5_CM "" RAT_FUNC "%6.3" "%" COEFFS 0 10.24 0. 0 0 1 /end COMPU_METHOD
/begin COMPU_METHOD _CNV_A_R_LINEAR_____7_CM "" RAT_FUNC "%6.3" "-" COEFFS 0 65535.99999999996 0. 0 0 1 /end COMPU_METHOD
/begin COMPU_METHOD _CNV_A_R_ENSD_LINEA_22_CM "" RAT_FUNC "%6.3" "rpm" COEFFS 0 4. 0. 0 0 1 /end COMPU_METHOD
/begin COMPU_METHOD _CNV_A_R_LINEAR_____29_CM "" RAT_FUNC "%6.3" "-" COEFFS 0 256. 0. 0 0 1 /end COMPU_METHOD
/begin COMPU_METHOD _CNV_A_R_LINEAR_____32_CM "" RAT_FUNC "%6.3" "s" COEFFS 0 100. 0. 0 0 1 /end COMPU_METHOD
/begin COMPU_METHOD _CNV_A_R_LINEAR_____42_CM "" RAT_FUNC "%6.3" "-" COEFFS 0 128. 0. 0 0 1 /end COMPU_METHOD
/begin COMPU_METHOD _CNV_A_R_LINEAR_____50_CM "" RAT_FUNC "%6.3" "-" COEFFS 0 98304. 0. 0 0 1 /end COMPU_METHOD
/begin COMPU_METHOD _CNV_A_R_LINEAR_____53_CM "" RAT_FUNC "%6.3" "-" COEFFS 0 16384. 0. 0 0 1 /end COMPU_METHOD
/begin COMPU_METHOD _CNV_A_R_LINEAR_____58_CM "" RAT_FUNC "%6.3" "s" COEFFS 0 10. 0. 0 0 1 /end COMPU_METHOD
/begin COMPU_METHOD _CNV_A_R_LINEAR_____65_CM "" RAT_FUNC "%6.3" "l" COEFFS 0 1. 0. 0 0 1 /end COMPU_METHOD
/begin COMPU_METHOD _CNV_A_R_LINEAR_____68_CM "" RAT_FUNC "%6.3" "s" COEFFS 0 1. 0. 0 0 1 /end COMPU_METHOD
/begin COMPU_METHOD _CNV_A_R_LINEAR_____82_CM "" RAT_FUNC "%6.3" "%" COEFFS 0 655.3599999999997 -1.455191522836685e-011 0 0 1 /end COMPU_METHOD
/begin COMPU_METHOD _CNV_A_R_LINEAR_____100_CM "" RAT_FUNC "%6.3" "-" COEFFS 0 98303.99999999926 -65535.99344639951 0 0 1 /end COMPU_METHOD
/begin COMPU_METHOD _CNV_A_R_LINEAR_____101_CM "" RAT_FUNC "%6.3" "TDC" COEFFS 0 1. 0. 0 0 1 /end COMPU_METHOD
/begin COMPU_METHOD _CNV_A_R_LINEAR_____104_CM "" RAT_FUNC "%6.3" "-" COEFFS 0 192. -127.9999872 0 0 1 /end COMPU_METHOD
/begin COMPU_METHOD _CNV_A_R_LINEAR_____107_CM "" RAT_FUNC "%6.3" "mV" COEFFS 0 1. 0. 0 0 1 /end COMPU_METHOD
/begin COMPU_METHOD _CNV_A_R_LINEAR_____108_CM "" RAT_FUNC "%6.3" "-" COEFFS 0 98304.00002810937 32768.00000000001 0 0 1 /end COMPU_METHOD
/begin COMPU_METHOD _CNV_A_R_LINEAR_____109_CM "" RAT_FUNC "%6.3" "-" COEFFS 0 768. 0. 0 0 1 /end COMPU_METHOD
/begin COMPU_METHOD _CNV_A_R_LINEAR_____110_CM "" RAT_FUNC "%6.3" "°C" COEFFS 0 10. 400. 0 0 1 /end COMPU_METHOD
/begin COMPU_METHOD _CNV_A_R_LINEAR_____111_CM "" RAT_FUNC "%6.3" "%" COEFFS 0 0.1 0. 0 0 1 /end COMPU_METHOD
/begin COMPU_METHOD _CNV_A_R_LINEAR_____112_CM "" RAT_FUNC "%6.3" "-" COEFFS 0 2560. 0. 0 0 1 /end COMPU_METHOD
/begin COMPU_METHOD _CNV_A_R_LINEAR_____113_CM "" RAT_FUNC "%6.3" "-" COEFFS 0 500. 0. 0 0 1 /end COMPU_METHOD
/begin COMPU_METHOD _CNV_A_R_LINEAR_____114_CM "" RAT_FUNC "%6.3" "mg" COEFFS 0 10. 0. 0 0 1 /end COMPU_METHOD
/begin COMPU_METHOD _CNV_A_R_LINEAR_____115_CM "" RAT_FUNC "%6.3" "hPa" COEFFS 0 1. 0. 0 0 1 /end COMPU_METHOD
/begin COMPU_METHOD _CNV_A_R_LINEAR_____125_CM "" RAT_FUNC "%6.3" "km/h" COEFFS 0 100. 0. 0 0 1 /end COMPU_METHOD
/begin COMPU_METHOD _CNV_A_R_LINEAR_____136_CM "" RAT_FUNC "%6.3" "[-]" COEFFS 0 49152.12582944213 0. 0 0 1 /end COMPU_METHOD
/begin COMPU_METHOD _CNV_A_R_LINEAR_____139_CM "" RAT_FUNC "%6.3" "1/°CRK" COEFFS 0 8533.333333333332 0. 0 0 1 /end COMPU_METHOD
/begin COMPU_METHOD _CNV_A_R_LINEAR_____140_CM "" RAT_FUNC "%6.3" "s" COEFFS 0 3276.75 0. 0 0 1 /end COMPU_METHOD
/begin COMPU_METHOD _CNV_A_R_LINEAR_____141_CM "" RAT_FUNC "%6.3" "s/m.K^0.5" COEFFS 0 1048576.005464147 0. 0 0 1 /end COMPU_METHOD
/begin COMPU_METHOD _CNV_A_R_LINEAR_____142_CM "" RAT_FUNC "%6.3" "kg/h/m²" COEFFS 0 3.555555555555556e-002 0. 0 0 1 /end COMPU_METHOD
/begin COMPU_METHOD _CNV_A_R_LINEAR_____143_CM "" RAT_FUNC "%6.3" "-" COEFFS 0 65535. 0. 0 0 1 /end COMPU_METHOD
/begin COMPU_METHOD _CNV_A_R_LINEAR_____144_CM "" RAT_FUNC "%6.3" "m²" COEFFS 0 16777217.69806384 0. 0 0 1 /end COMPU_METHOD
/begin COMPU_METHOD _CNV_A_R_LINEAR_____145_CM "" RAT_FUNC "%6.3" "-" COEFFS 0 1. 1. 0 0 1 /end COMPU_METHOD
/begin COMPU_METHOD _CNV_A_R_LINEAR_____146_CM "" RAT_FUNC "%6.3" "%" COEFFS 0 100. 0. 0 0 1 /end COMPU_METHOD
/begin COMPU_METHOD _CNV_A_R_LINEAR_____147_CM "" RAT_FUNC "%6.3" "-" COEFFS 0 32768.0000069121 0. 0 0 1 /end COMPU_METHOD
/begin COMPU_METHOD _CNV_A_R_LINEAR_____148_CM "" RAT_FUNC "%6.3" "m²" COEFFS 0 16777216.00000002 0. 0 0 1 /end COMPU_METHOD
/begin COMPU_METHOD _CNV_A_R_LINEAR_____149_CM "" RAT_FUNC "%6.3" "-" COEFFS 0 2048. 0. 0 0 1 /end COMPU_METHOD
/begin COMPU_METHOD _CNV_A_R_LINEAR_____150_CM "" RAT_FUNC "%6.3" "%" COEFFS 0 20. 0. 0 0 1 /end COMPU_METHOD
/begin COMPU_METHOD _CNV_A_R_LINEAR_____151_CM "" RAT_FUNC "%6.3" "-" COEFFS 0 327680.0003968061 -294912.0003571255 0 0 1 /end COMPU_METHOD
/begin COMPU_METHOD _CNV_A_R_LINEAR_____152_CM "" RAT_FUNC "%6.3" "-" COEFFS 0 327680. 32768. 0 0 1 /end COMPU_METHOD
/begin COMPU_METHOD _CNV_A_R_LINEAR_____153_CM "" RAT_FUNC "%6.3" "-" COEFFS 0 256. -256. 0 0 1 /end COMPU_METHOD
/begin COMPU_METHOD _CNV_A_R_LINEAR_____154_CM "" RAT_FUNC "%6.3" "m²" COEFFS 0 16777216. 0. 0 0 1 /end COMPU_METHOD
/begin COMPU_METHOD _CNV_A_R_LINEAR_____155_CM "" RAT_FUNC "%6.3" "[mm2/hPa/s]" COEFFS 0 10995.11627776001 0. 0 0 1 /end COMPU_METHOD
/begin COMPU_METHOD _CNV_A_R_LINEAR_____156_CM "" RAT_FUNC "%6.3" "m²" COEFFS 0 16777216.00000002 3.456079866737127e-011 0 0 1 /end COMPU_METHOD
/begin COMPU_METHOD _CNV_A_R_LINEAR_____157_CM "" RAT_FUNC "%6.3" "[m2/hPa]" COEFFS 0 1099511627775.999 0. 0 0 1 /end COMPU_METHOD
/begin COMPU_METHOD _CNV_A_R_LINEAR_____158_CM "" RAT_FUNC "%6.3" "hPa" COEFFS 0 1. 10000. 0 0 1 /end COMPU_METHOD
/begin COMPU_METHOD _CNV_A_R_LINEAR_____159_CM "" RAT_FUNC "%6.3" "%" COEFFS 0 655.35 0. 0 0 1 /end COMPU_METHOD
/begin COMPU_METHOD _CNV_S_4_FUEL_IGN_A_160_CM "" TAB_VERB "%6.3" "-" COMPU_TAB_REF _CNV_S_4_FUEL_IGN_A_160 /end COMPU_METHOD
/begin COMPU_VTAB _CNV_S_4_FUEL_IGN_A_160 "" TAB_VERB 4 0 "Nsx_fuel_ign_high" 1 "Nsx_fuel_ign_midh" 2 "Nsx_fuel_ign_midl" 3 "Nsx_fuel_ign_low" /end COMPU_VTAB
/begin COMPU_METHOD _CNV_A_R_LINEAR_____161_CM "" RAT_FUNC "%6.3" "-" COEFFS 0 1000. 0. 0 0 1 /end COMPU_METHOD
/begin COMPU_METHOD _CNV_A_R_LINEAR_____162_CM "" RAT_FUNC "%6.3" "-" COEFFS 0 255. 0. 0 0 1 /end COMPU_METHOD
/begin COMPU_METHOD _CNV_A_R_LINEAR_____163_CM "" RAT_FUNC "%6.3" "1/s" COEFFS 0 -1000. 0. 0 0 1 /end COMPU_METHOD
/begin COMPU_METHOD _CNV_A_R_LINEAR_____164_CM "" RAT_FUNC "%6.3" "1/s" COEFFS 0 1000. 0. 0 0 1 /end COMPU_METHOD
/begin COMPU_METHOD _CNV_A_R_LINEAR_____165_CM "" RAT_FUNC "%6.3" "%" COEFFS 0 2.55 0. 0 0 1 /end COMPU_METHOD
/begin COMPU_METHOD _CNV_A_R_LINEAR_____166_CM "" RAT_FUNC "%6.3" "-" COEFFS 0 655.35 0. 0 0 1 /end COMPU_METHOD
/begin COMPU_METHOD _CNV_A_R_LINEAR_____167_CM "" RAT_FUNC "%6.3" "-" COEFFS 0 196607.9999999997 0. 0 0 1 /end COMPU_METHOD
/begin COMPU_METHOD _CNV_A_R_LINEAR_____168_CM "" RAT_FUNC "%6.3" "%" COEFFS 0 99.99999999999999 -3.637978807091713e-012 0 0 1 /end COMPU_METHOD
/begin COMPU_METHOD _CNV_A_R_LINEAR_____169_CM "" RAT_FUNC "%6.3" "-" COEFFS 0 98302.50983025097 -65535.00983025097 0 0 1 /end COMPU_METHOD
/begin COMPU_METHOD _CNV_A_R_LINEAR_____170_CM "" RAT_FUNC "%6.3" "-" COEFFS 0 16384. -8192. 0 0 1 /end COMPU_METHOD
/begin COMPU_METHOD _CNV_A_R_LINEAR_____171_CM "" RAT_FUNC "%6.3" "%/(hPa*rpm)" COEFFS 0 2.e-003 -1. 0 0 1 /end COMPU_METHOD
/begin COMPU_METHOD _CNV_A_R_LINEAR_____172_CM "" RAT_FUNC "%6.3" "kg/h" COEFFS 0 20. 0. 0 0 1 /end COMPU_METHOD
/begin COMPU_METHOD _CNV_A_R_LINEAR_____173_CM "" RAT_FUNC "%6.3" "hPa/s" COEFFS 0 0.1 0. 0 0 1 /end COMPU_METHOD
/begin COMPU_METHOD _CNV_A_R_LINEAR_____174_CM "" RAT_FUNC "%6.3" "hPa/s" COEFFS 0 3.333333333333333e-002 0. 0 0 1 /end COMPU_METHOD
/begin COMPU_METHOD _CNV_A_R_LINEAR_____175_CM "" RAT_FUNC "%6.3" "%/hPa" COEFFS 0 19393.93939393939 0. 0 0 1 /end COMPU_METHOD
/begin COMPU_METHOD _CNV_A_R_LINEAR_____176_CM "" RAT_FUNC "%6.3" "%/hPa" COEFFS 0 606.2041202936301 0. 0 0 1 /end COMPU_METHOD
/begin COMPU_METHOD _CNV_A_R_LINEAR_____177_CM "" RAT_FUNC "%6.3" "%/hPa" COEFFS 0 64. 0. 0 0 1 /end COMPU_METHOD
/begin COMPU_METHOD _CNV_S_8_STATUS_OK__234_CM "" TAB_VERB "%6.3" "-" COMPU_TAB_REF _CNV_S_8_STATUS_OK__234 /end COMPU_METHOD
/begin COMPU_VTAB _CNV_S_8_STATUS_OK__234 "" TAB_VERB 8 0 "Nsx_vld_nok_0" 1 "Nsx_vld_ok_1" 2 "Nsx_vld_fail_2" 3 "Nsx_vld_fail_3" 4 "Nsx_vld_fail_4" 5 "Nsx_vld_fail_5" 6 "Nsx_vld_fail_6" 7 "Nsx_vld_fail_7" /end COMPU_VTAB
/begin COMPU_METHOD _CNV_A_R_LINEAR_____298_CM "" RAT_FUNC "%6.3" "-" COEFFS 0 512. -257. 0 0 1 /end COMPU_METHOD
/begin COMPU_METHOD _CNV_A_R_LINEAR_____394_CM "" RAT_FUNC "%6.3" "1/rpm" COEFFS 0 100000000000. 0. 0 0 1 /end COMPU_METHOD
/begin RECORD_LAYOUT _REC_S1VAL_20_u4 FNC_VALUES 1 ULONG COLUMN_DIR DIRECT /end RECORD_LAYOUT
/begin RECORD_LAYOUT _REC_S1VAL_20_u1 FNC_VALUES 1 UBYTE COLUMN_DIR DIRECT /end RECORD_LAYOUT
/begin RECORD_LAYOUT _REC_A2AXS_20_u1 NO_AXIS_PTS_X 1 UBYTE AXIS_PTS_X 2 UBYTE INDEX_INCR DIRECT /end RECORD_LAYOUT
/begin RECORD_LAYOUT _REC_S1VAL_20_u2 FNC_VALUES 1 UWORD COLUMN_DIR DIRECT /end RECORD_LAYOUT
/begin RECORD_LAYOUT _REC_S1VAL_20_s2 FNC_VALUES 1 SWORD COLUMN_DIR DIRECT /end RECORD_LAYOUT
/begin RECORD_LAYOUT _REC_A2AXS_20_u2 NO_AXIS_PTS_X 1 UWORD AXIS_PTS_X 2 UWORD INDEX_INCR DIRECT /end RECORD_LAYOUT
/begin RECORD_LAYOUT _REC_A1CUR_20_u1_u2 FNC_VALUES 1 UBYTE COLUMN_DIR DIRECT /end RECORD_LAYOUT
/begin RECORD_LAYOUT _REC_A1MAP_20_u2_u2_u2 FNC_VALUES 1 UWORD COLUMN_DIR DIRECT /end RECORD_LAYOUT
/begin RECORD_LAYOUT _REC_A1CUR_20_u2_u2 FNC_VALUES 1 UWORD COLUMN_DIR DIRECT /end RECORD_LAYOUT
/begin RECORD_LAYOUT _REC_A1MAP_20_u2_u2_u1 FNC_VALUES 1 UWORD COLUMN_DIR DIRECT /end RECORD_LAYOUT
/begin RECORD_LAYOUT _REC_A1MAP_20_u1_u2_u2 FNC_VALUES 1 UBYTE COLUMN_DIR DIRECT /end RECORD_LAYOUT
/begin RECORD_LAYOUT _REC_A1MAP_20_u1_u2_u1 FNC_VALUES 1 UBYTE COLUMN_DIR DIRECT /end RECORD_LAYOUT
/begin FUNCTION CbRicCtl_Alcoxxx ""
 /begin DEF_CHARACTERISTIC Cmp_eal_n_lamb_v_alco Cmp_n_eal_ti_ofs1_alco Cmp_n_eal_ti_ofs2_alco Cmp_n_eal_ti_p_cor_alco Cmp_n_tco_eal_fl_thd_alco Cmp_wet_dep_fac_tco00_alco Cmp_wet_dep_fac_tco20_alco Cmp_wet_dep_fac_tco40_alco Cmp_wet_dep_fac_tco60_alco Cmp_wet_dep_fac_tco80_alco Cmp_wet_fil_fac_tco00_alco Cmp_wet_fil_fac_tco20_alco Cmp_wet_fil_fac_tco40_alco Cmp_wet_fil_fac_tco60_alco Cmp_wet_fil_fac_tco80_alco Ctp_cl_t_alco Ctp_eal_l_ti_i_cor_alco Ctp_eal_l_ti_i_cor_lean_alco Ctp_n_dly_ofs_dly_alco Ctp_n_l_ti_i_alco Ctp_n_l_ti_i_lean_alco Ctp_tco_cl2_ena_ctr_alco Ctp_wet_acel_cor_fac_alco Ctp_wet_decl_cor_fac_alco Ctp_wet_decl_fil_fac_alco Ctp_wet_ini_acel_cor_ofs_alco Ctp_wet_vol_dif_thd_acel_alco Ctp_wet_vol_dif_thd_decl_alco Ctp_wet_vol_dif_thd_sta_alco Cbx_tco_vlv_temp_cl_off /end DEF_CHARACTERISTIC
 /begin OUT_MEASUREMENT Vxx_cl_t_alco Vxx_dly_ofs_dly_alco Vxx_eal_fl_thd_alco Vxx_eal_n_lamb_v_alco Vxx_rich_cl_eal_i_cor_alco Vxx_rich_cl_eal_i_cor_lean_alco Vxx_rich_cl_n_i_alco Vxx_rich_cl_n_i_lean_alco Vxx_rich_cl_p_cor_alco Vxx_rich_cl_ti_ofs1_alco Vxx_rich_cl_ti_ofs2_alco Vxx_tco_cl2_ena_ctr_alco Vxx_wet_acel_cor_fac_alco Vxx_wet_decl_cor_fac_alco Vxx_wet_dep_fac_alco Vxx_wet_fil_fac_acel_alco Vxx_wet_fil_fac_decl_alco Vxx_wet_ini_acel_cor_ofs_alco Vxx_wet_vol_dif_thd_acel_alco Vxx_wet_vol_dif_thd_decl_alco Vxx_wet_vol_dif_thd_sta_alco /end OUT_MEASUREMENT
/end FUNCTION
/begin FUNCTION CbRicSpt "" /begin SUB_FUNCTION CbRicSpt_Flstpxx CbRicSpt_Wupdstb CbRicSpt_Alcoxxx /end SUB_FUNCTION /end FUNCTION
/begin FUNCTION CbRicSpt_Flstpxx ""
 /begin DEF_CHARACTERISTIC Cmp_n_eal_rich_sp_h Cmp_n_eal_rich_sp_l Cmp_n_eal_rich_sp_midh Cmp_n_eal_rich_sp_midl Ctp_n_kd_rich_fac Cxx_cold_loop_kd_rich_fac Cxx_rich_cor_ena_n_thd Cxx_tia_kd_rich_cor_fac Cxx_tkof_fl_rich_fac Cxx_tkof_fl_rich_fac_alco /end DEF_CHARACTERISTIC
 /begin OUT_MEASUREMENT Vxx_bas_rich_fac Vxx_kd_rich_fac Vxx_kd_rich_fac_itl Vxx_n_eal_rich_sp_h Vxx_n_eal_rich_sp_l Vxx_n_eal_rich_sp_midh Vxx_n_eal_rich_sp_midl Vxx_n_kd_rich_fac /end OUT_MEASUREMENT
/end FUNCTION
/begin FUNCTION CbRicSpt_Wupdstb ""
 /begin DEF_CHARACTERISTIC Cxx_dstb_cyl1_fim_fac_is Cxx_dstb_cyl1_fim_fac_is_alco Cxx_dstb_cyl1_h_fim_fac Cxx_dstb_cyl1_h_fim_fac_alco Cxx_dstb_cyl1_l_fim_fac Cxx_dstb_cyl1_l_fim_fac_alco Cxx_dstb_cyl2_fim_fac_is Cxx_dstb_cyl2_fim_fac_is_alco Cxx_dstb_cyl2_h_fim_fac Cxx_dstb_cyl2_h_fim_fac_alco Cxx_dstb_cyl2_l_fim_fac Cxx_dstb_cyl2_l_fim_fac_alco Cxx_dstb_cyl3_fim_fac_is Cxx_dstb_cyl3_fim_fac_is_alco Cxx_dstb_cyl3_h_fim_fac Cxx_dstb_cyl3_h_fim_fac_alco Cxx_dstb_cyl3_l_fim_fac Cxx_dstb_cyl3_l_fim_fac_alco Cxx_dstb_cyl4_fim_fac_is Cxx_dstb_cyl4_fim_fac_is_alco Cxx_dstb_cyl4_h_fim_fac Cxx_dstb_cyl4_h_fim_fac_alco Cxx_dstb_cyl4_l_fim_fac Cxx_dstb_cyl4_l_fim_fac_alco /end DEF_CHARACTERISTIC
 /begin OUT_MEASUREMENT Vtx_dstb_cylx_fim_fac[0] Vtx_dstb_cylx_fim_fac[1] Vtx_dstb_cylx_fim_fac[2] Vtx_dstb_cylx_fim_fac[3] Vtx_dstb_cylx_fim_fac_is[0] Vtx_dstb_cylx_fim_fac_is[1] Vtx_dstb_cylx_fim_fac_is[2] Vtx_dstb_cylx_fim_fac_is[3] Vxx_cata_rich_dstb_cyl1_fac Vxx_cata_rich_dstb_cyl2_fac Vxx_cata_rich_dstb_cyl3_fac Vxx_cata_rich_dstb_cyl4_fac /end OUT_MEASUREMENT
/end FUNCTION
/begin FUNCTION CbRicSpt_Alcoxxx "" /begin DEF_CHARACTERISTIC Cmp_n_eal_rich_sp_alco Ctp_n_kd_rich_fac_alco /end DEF_CHARACTERISTIC /begin OUT_MEASUREMENT Vxx_n_eal_rich_sp_alco Vxx_n_kd_rich_fac_alco /end OUT_MEASUREMENT /end FUNCTION
/begin FUNCTION AsMafCtl "" /begin SUB_FUNCTION AsMafCtl_Itsptxx AsMafCtl_Itfloxx /end SUB_FUNCTION /end FUNCTION
/begin FUNCTION AsMafCtl_Itsptxx ""
 /begin DEF_CHARACTERISTIC Cmp_n_gear_noi_max_it_ar Ctp_cold_stop_it_psn_sp Ctp_n_min_map_it_ar Ctp_n_min_map_it_ar_fac Ctp_n_noi_max_it_ar Ctp_tco_clos_it_t Cbx_clos_it_dsb Cbx_it_bch_cfm Cbx_it_ped_bch_cfm Cxx_clos_it_mat_min Cxx_clos_it_n_max Cxx_clos_it_n_min Cxx_clos_it_vs_max Cxx_eng_stop_it_psn_sp Cxx_ffig_it_psn_sp Cxx_fl_max_it_ar Cxx_it_pos_ped_fac_bch Cxx_it_pos_sc_bch Cxx_it_pos_sc_l_thd_bch Cxx_l_it_ar /end DEF_CHARACTERISTIC
 /begin OUT_MEASUREMENT Vbx_clos_it_dly_stop Vbx_clos_it_stop Vxx_fil1_it_psn_sp Vxx_it_ar_sp Vxx_it_psn_sp Vxx_raw_it_psn_sp Vxx_tq_it_ar_sp /end OUT_MEASUREMENT
/end FUNCTION
/begin FUNCTION AsMafCtl_Itfloxx ""
 /begin DEF_CHARACTERISTIC Ctb_prs_rat Ctp_it_prs_rat_fil_ftc Ctp_prs_tmp_flr_val Cbx_prs_sp_dsb_cfm /end DEF_CHARACTERISTIC
 /begin OUT_MEASUREMENT Vxx_ar_flr_tmp_val Vxx_it_ar_maf Vxx_it_prs_rat_fil Vxx_raw_prs_rat /end OUT_MEASUREMENT
/end FUNCTION
/begin FUNCTION AsMapCtl "" /begin SUB_FUNCTION AsMapCtl_Actacxx_xxxxxg AsMapCtl_Iomapxx /end SUB_FUNCTION /end FUNCTION
/begin FUNCTION AsMapCtl_Actacxx_xxxxxg ""
 /begin DEF_CHARACTERISTIC Ctb_no_it_psn Cbx_bch_cp_it_adj Cbx_bch_dsb_it_adj Cbx_bch_dsb_it_adj_val Cbx_bch_rst_it_adj Cbx_ena_appl_it_adj Ctb_it_ar[0] Ctb_it_ar[1] Ctb_it_ar[2] Ctb_it_ar[3] Ctb_it_ar[4] Ctb_it_ar[5] Ctb_it_ar[6] Ctb_it_ar[7] Ctb_it_ar[8] Ctb_it_ar[9] Ctb_it_ar[10] Ctb_it_ar[11] Ctb_it_ar[12] Ctb_it_ar[13] Ctb_it_ar[14] Ctb_it_ar[15] Ctb_it_ar[16] Ctx_fac_cor_it_ar_max[0] Ctx_fac_cor_it_ar_max[1] Ctx_fac_cor_it_ar_max[2] Ctx_fac_cor_it_ar_max[3] Ctx_fac_cor_it_ar_max[4] Ctx_fac_cor_it_ar_max[5] Ctx_fac_cor_it_ar_max[6] Ctx_fac_cor_it_ar_max[7] Ctx_fac_cor_it_ar_max[8] Ctx_fac_cor_it_ar_max[9] Ctx_fac_cor_it_ar_max[10] Ctx_fac_cor_it_ar_max[11] Ctx_fac_cor_it_ar_max[12] Ctx_fac_cor_it_ar_max[13] Ctx_fac_cor_it_ar_max[14] Ctx_fac_cor_it_ar_max[15] Ctx_fac_cor_it_ar_max[16] Ctx_fac_cor_it_ar_min[0] Ctx_fac_cor_it_ar_min[1] Ctx_fac_cor_it_ar_min[2] Ctx_fac_cor_it_ar_min[3] Ctx_fac_cor_it_ar_min[4] Ctx_fac_cor_it_ar_min[5] Ctx_fac_cor_it_ar_min[6] Ctx_fac_cor_it_ar_min[7] Ctx_fac_cor_it_ar_min[8] Ctx_fac_cor_it_ar_min[9] Ctx_fac_cor_it_ar_min[10] Ctx_fac_cor_it_ar_min[11] Ctx_fac_cor_it_ar_min[12] Ctx_fac_cor_it_ar_min[13] Ctx_fac_cor_it_ar_min[14] Ctx_fac_cor_it_ar_min[15] Ctx_fac_cor_it_ar_min[16] Cxx_adj_fac_it_adj Cxx_amp_upd_t_rst Cxx_cor_it_adj_ftc Cxx_fac_cor_it_adj Cxx_map_min_it_adj Cxx_map_rat_max_it_adj Cxx_mat_max_it_adj Cxx_mat_min_it_adj Cxx_min_ar_grd_it_adj Cxx_min_it_ar Cxx_n_max_it_adj Cxx_n_min_it_adj Cxx_thd_map_in_it_adj Cxx_thd_map_out_it_adj Cxx_thd_n_in_it_adj Cxx_thd_n_out_it_adj Cxx_thd_pos_max_it_adj Cxx_thd_pos_min_it_adj /end DEF_CHARACTERISTIC
 /begin OUT_MEASUREMENT Vtp_it_ar[0] Vtp_it_ar[1] Vtp_it_ar[2] Vtp_it_ar[3] Vtp_it_ar[4] Vtp_it_ar[5] Vtp_it_ar[6] Vtp_it_ar[7] Vtp_it_ar[8] Vtp_it_ar[9] Vtp_it_ar[10] Vtp_it_ar[11] Vtp_it_ar[12] Vtp_it_ar[13] Vtp_it_ar[14] Vtp_it_ar[15] Vtp_it_ar[16] Vbx_act1_cor_it_adj Vbx_act2_cor_it_adj Vbx_act_cor_it_adj Vbx_cor_map_it_adj Vbx_cor_n_it_adj Vbx_rst_cor_it_adj Vtp_cor_it_ar[0] Vtp_cor_it_ar[1] Vtp_cor_it_ar[2] Vtp_cor_it_ar[3] Vtp_cor_it_ar[4] Vtp_cor_it_ar[5] Vtp_cor_it_ar[6] Vtp_cor_it_ar[7] Vtp_cor_it_ar[8] Vtp_cor_it_ar[9] Vtp_cor_it_ar[10] Vtp_cor_it_ar[11] Vtp_cor_it_ar[12] Vtp_cor_it_ar[13] Vtp_cor_it_ar[14] Vtp_cor_it_ar[15] Vtp_cor_it_ar[16] Vtp_int_it_ar[0] Vtp_int_it_ar[1] Vtp_int_it_ar[2] Vtp_int_it_ar[3] Vtp_int_it_ar[4] Vtp_int_it_ar[5] Vtp_int_it_ar[6] Vtp_int_it_ar[7] Vtp_int_it_ar[8] Vtp_int_it_ar[9] Vtp_int_it_ar[10] Vtp_int_it_ar[11] Vtp_int_it_ar[12] Vtp_int_it_ar[13] Vtp_int_it_ar[14] Vtp_int_it_ar[15] Vtp_int_it_ar[16] Vtp_it_ar_raw[0] Vtp_it_ar_raw[1] Vtp_it_ar_raw[2] Vtp_it_ar_raw[3] Vtp_it_ar_raw[4] Vtp_it_ar_raw[5] Vtp_it_ar_raw[6] Vtp_it_ar_raw[7] Vtp_it_ar_raw[8] Vtp_it_ar_raw[9] Vtp_it_ar_raw[10] Vtp_it_ar_raw[11] Vtp_it_ar_raw[12] Vtp_it_ar_raw[13] Vtp_it_ar_raw[14] Vtp_it_ar_raw[15] Vtp_it_ar_raw[16] Vtp_lim_it_ar[0] Vtp_lim_it_ar[1] Vtp_lim_it_ar[2] Vtp_lim_it_ar[3] Vtp_lim_it_ar[4] Vtp_lim_it_ar[5] Vtp_lim_it_ar[6] Vtp_lim_it_ar[7] Vtp_lim_it_ar[8] Vtp_lim_it_ar[9] Vtp_lim_it_ar[10] Vtp_lim_it_ar[11] Vtp_lim_it_ar[12] Vtp_lim_it_ar[13] Vtp_lim_it_ar[14] Vtp_lim_it_ar[15] Vtp_lim_it_ar[16] Vtx_fac_cor_it_adj[0] Vtx_fac_cor_it_adj[1] Vtx_fac_cor_it_adj[2] Vtx_fac_cor_it_adj[3] Vtx_fac_cor_it_adj[4] Vtx_fac_cor_it_adj[5] Vtx_fac_cor_it_adj[6] Vtx_fac_cor_it_adj[7] Vtx_fac_cor_it_adj[8] Vtx_fac_cor_it_adj[9] Vtx_fac_cor_it_adj[10] Vtx_fac_cor_it_adj[11] Vtx_fac_cor_it_adj[12] Vtx_fac_cor_it_adj[13] Vtx_fac_cor_it_adj[14] Vtx_fac_cor_it_adj[15] Vtx_fac_cor_it_adj[16] Vxx_fil_fac_cor_it_adj Vxx_raw_fac_cor_it_adj /end OUT_MEASUREMENT
/end FUNCTION
/begin FUNCTION AsMapCtl_Iomapxx ""
 /begin DEF_CHARACTERISTIC Ctp_ctl_lomap_int Cbx_map_ctl_int_cfm Cbx_map_ctl_int_tkof_cfm Cxx_map_ctl_int_ftc_rst Cxx_map_ctl_int_map_thd Cxx_map_ctl_int_sat_prct_min /end DEF_CHARACTERISTIC
 /begin OUT_MEASUREMENT Vbx_map_ctl_int_act Vxx_map_ctl_cor_ar Vxx_map_ctl_int_fac Vxx_map_ctl_int_raw Vxx_map_err /end OUT_MEASUREMENT
/end FUNCTION
/begin FUNCTION CbSpvCms ""
 /begin OUT_MEASUREMENT Vxx_ti_alco_cor Vxx_ti_alco_cor_h Vxx_ti_alco_cor_l Vxx_blow_ctr_mem Vxx_blow_thd_mem Vxx_stt_cnt_high Vxx_stt_cnt_low Vxx_stt_cnt_midh Vxx_stt_cnt_midl Vxx_fuel_fill_max_ctr Vxx_alco_ad_ctr Vsx_fuel_ign_cho /end OUT_MEASUREMENT
 /begin SUB_FUNCTION CbSpvCms_Fuetyxx CbSpvCms_Cpricor CbSpvCms_Cpmanxx CbSpvCms_Alcovld CbSpvCms_Schxxxx CbSpvCms_Alcoxcs CbSpvCms_Sloalco CbSpvCms_Fasalco CbSpvCms_Blowbyx CbSpvCms_Adocxxx /end SUB_FUNCTION
/end FUNCTION
/begin FUNCTION CbSpvCms_Fuetyxx ""
 /begin DEF_CHARACTERISTIC Ctb_polu_alco_cor Ctb_sta_tq_alco_cor Ctb_ti_alco_cor Ctb_ti_fuel_typ_rat_raw Ctb_wet_alco_cor Ctb_wup_alco_cor Ctp_ajs_alco_rat Ctp_is_alco_rat Ctp_polu_alco_rat Ctp_sta_alco_rat Ctp_sta_tq_alco_rat Ctp_ti_fuel_typ_rat Ctp_tq_alco_rat Ctp_tq_max_alco_rat Ctp_wet_alco_rat Ctp_wg_alco_rat Ctp_wup_alco_rat Cbx_lpg_gas_lpg_trs Cbx_lpg_gas_mod Cbx_lpg_lpg_gas_trs Cbx_lpg_lpg_mod Cbx_ti_alco_lim_tq_max Cxx_alco_rat Cxx_ti_alco_cor_max Cxx_ti_alco_cor_zon_1 Cxx_ti_alco_cor_zon_2 Cxx_tq_max_fuel_typ_dft_neg Cxx_tq_max_fuel_typ_dft_pos Cxx_tq_max_fuel_typ_neg Cxx_tq_max_fuel_typ_pos /end DEF_CHARACTERISTIC
 /begin OUT_MEASUREMENT Vbx_lpg_gas_lpg_trs Vbx_lpg_gas_mod Vbx_lpg_lpg_gas_trs Vbx_lpg_lpg_mod Vsx_wup_fuel_typ Vxx_ajs_fuel_typ_rat Vxx_alco_rat Vxx_is_fuel_typ_rat Vxx_polu_fuel_typ_rat Vxx_sta_fuel_typ_rat Vxx_sta_tq_fuel_typ_rat Vxx_ti_alco_cor_tq_max Vxx_ti_fuel_typ_rat Vxx_ti_fuel_typ_rat_raw Vxx_tq_fuel_typ_rat Vxx_tq_max_fuel_typ_rat Vxx_tq_max_fuel_typ_rat_raw Vxx_wet_fuel_typ_rat Vxx_wg_fuel_typ_rat Vxx_wup_fuel_typ_rat /end OUT_MEASUREMENT
/end FUNCTION
/begin FUNCTION CbSpvCms_Cpricor ""
 /begin DEF_CHARACTERISTIC Ctb_n_cp Ctp_n_cp Cxx_cp_fac_rel Cxx_cp_fil_cl_ti_fac Cxx_cp_grd_fac Cxx_cp_inc_ad Cxx_cp_max_ad Cxx_cp_ol_rich_cor_appl Cxx_cp_rel_step_lamb_fac Cxx_cp_step_lamb_fac /end DEF_CHARACTERISTIC
 /begin OUT_MEASUREMENT Vbx_cp_ad Vbx_cp_rich_cor_lean_cond Vbx_cp_rich_cor_rich_cond Vxx_cp_fim_fac Vxx_cp_mv_cl_ti_fac Vxx_cp_rich_cor Vxx_cp_rich_cor_appl Vxx_cp_rich_cor_clc Vxx_cp_rich_int_cor /end OUT_MEASUREMENT
/end FUNCTION
/begin FUNCTION CbSpvCms_Cpmanxx ""
 /begin DEF_CHARACTERISTIC Cxx_cp_lamb_fac_mv_thd_1 Cxx_cp_lamb_fac_mv_thd_2 Cxx_cp_t_off Cxx_cp_t_on /end DEF_CHARACTERISTIC
 /begin OUT_MEASUREMENT Vbx_cp_ad_ena Vbx_cp_is_ena Vbx_cp_lsm_ad_ena Vbx_cp_rich_cge Vbx_prev_cp Vxx_cp_egr_sta_dly Vxx_cp_egr_stop_dly /end OUT_MEASUREMENT
/end FUNCTION
/begin FUNCTION CbSpvCms_Alcovld "" /begin OUT_MEASUREMENT Vsx_ti_alco_cor_vld /end OUT_MEASUREMENT /end FUNCTION
/begin FUNCTION CbSpvCms_Schxxxx "" /begin DEF_CHARACTERISTIC Cbx_adoc_cfm Cbx_alco_typ_cfm /end DEF_CHARACTERISTIC /begin OUT_MEASUREMENT Vbx_adoc_cfm Vbx_alco_typ_cfm /end OUT_MEASUREMENT /end FUNCTION
/begin FUNCTION CbSpvCms_Alcoxcs ""
 /begin DEF_CHARACTERISTIC Cbx_alco_ad_ena Cbx_alco_conf Cbx_fill_det_act Cbx_fuel_fill_det_bch Cxx_alco_ad_cold_mem_dly Cxx_alco_ad_cold_mem_fac Cxx_alco_ad_lbup_dft Cxx_alco_ad_stal_cor Cxx_alco_ad_stal_dly Cxx_alco_ad_stal_tco Cxx_blow_ctr_thd Cxx_fuel_lvl_stop Cxx_ti_alco_cor_dft Cxx_ti_alco_cor_h Cxx_ti_alco_cor_h_ofs Cxx_ti_alco_cor_l_ofs Cxx_ti_alco_cor_min Cxx_ti_gas_cor_max /end DEF_CHARACTERISTIC
 /begin OUT_MEASUREMENT Vbx_eng_aut_down Vxx_alco_ad_stal_cor Vxx_ti_alco_cor_max Vxx_ti_alco_cor_min Vxx_ti_alco_cor_stop /end OUT_MEASUREMENT
/end FUNCTION
/begin FUNCTION CbSpvCms_Sloalco ""
 /begin DEF_CHARACTERISTIC Ctb_amp_alco Ctb_map_alco Ctb_mat_alco Ctb_n_alco Ctb_tco_alco Cmp_n_prs_alco_ad_fac_down Cmp_n_prs_alco_ad_fac_up Cmp_n_prs_alco_ad_mv_cl_thd_h Cmp_n_prs_alco_ad_mv_cl_thd_l Ctp_amp_alco_ad_mv_cl_fac Ctp_mat_alco_ad_mv_cl_fac Ctp_tco_alco_ad_mv_cl_fac Cbx_alco_ad_req_ena Cbx_fuel_det_max_ena Cxx_aftr_alco_ad_dly Cxx_alco_ad_blow_ctr_thd Cxx_alco_ad_ctr_ini Cxx_alco_ad_dp_prs Cxx_alco_ad_is_down_tco_thd Cxx_alco_ad_is_fac_down Cxx_alco_ad_is_fac_up Cxx_alco_ad_is_mv_cl_thd_h Cxx_alco_ad_is_mv_cl_thd_l Cxx_alco_ad_is_up_tco_thd Cxx_alco_ad_map_max Cxx_alco_ad_map_min Cxx_alco_ad_mv_cl_thd_h_ofs Cxx_alco_ad_mv_cl_thd_l_ofs Cxx_alco_ad_mv_cl_thd_slop Cxx_alco_ad_mv_cl_thd_slop_neg Cxx_alco_ad_mv_cl_thd_slop_pos Cxx_alco_ad_n_max Cxx_alco_ad_n_min Cxx_alco_ad_t Cxx_alco_ad_tco_thd Cxx_alco_rich Cxx_fac_dif_alco_ad_fac Cxx_fac_dif_alco_ad_ofs_h Cxx_fac_dif_alco_ad_ofs_l Cxx_fuel_det_max_ctr_ini Cxx_fuel_det_max_ctr_max /end DEF_CHARACTERISTIC
 /begin OUT_MEASUREMENT Vbx_alco_ad Vbx_alco_ad_cdn Vbx_alco_ad_done Vbx_alco_ad_done_mem Vbx_alco_ad_ena Vbx_alco_ad_fuel_max Vbx_alco_ad_is_down_cdn Vbx_alco_ad_is_up_cdn Vbx_alco_ad_req Vbx_alco_rich_ad_ena Vxx_alco_ad_cdn_t Vxx_alco_ad_cdn_t_raw Vxx_alco_ad_cor Vxx_alco_ad_fac_down Vxx_alco_ad_fac_up Vxx_alco_ad_mv_cl_thd_h Vxx_alco_ad_mv_cl_thd_h_ofs Vxx_alco_ad_mv_cl_thd_h_raw Vxx_alco_ad_mv_cl_thd_l Vxx_alco_ad_mv_cl_thd_l_ofs Vxx_alco_ad_mv_cl_thd_l_raw Vxx_alco_ad_t Vxx_alco_mv_cl_ofs_fac Vxx_fac_dif_alco_ad_h Vxx_fac_dif_alco_ad_l /end OUT_MEASUREMENT
/end FUNCTION
/begin FUNCTION CbSpvCms_Fasalco ""
 /begin DEF_CHARACTERISTIC Ntb_alco_ad_lbup_v_fil_ftc Ctp_alco_ad_lbup_v_fil_ftc Cxx_alco_ad_cdn_t_max Cxx_alco_ad_cold_appl_cl_thd Cxx_alco_ad_cold_dly Cxx_alco_ad_cold_dp_prs Cxx_alco_ad_cold_ena_cl_thd Cxx_alco_ad_cold_in_dly Cxx_alco_ad_cold_inc Cxx_alco_ad_cold_kd_thd Cxx_alco_ad_cold_map_max Cxx_alco_ad_cold_map_min Cxx_alco_ad_cold_map_thd Cxx_alco_ad_cold_n_max Cxx_alco_ad_cold_n_min Cxx_alco_ad_cold_tco Cxx_alco_ad_cold_tco_cor_thd Cxx_alco_ad_lbup_inc Cxx_alco_ad_lbup_inc_thd_h Cxx_alco_ad_lbup_inc_thd_l Cxx_alco_ad_lbup_v_fil_ini Cxx_alco_ad_n_prs_fil /end DEF_CHARACTERISTIC
 /begin OUT_MEASUREMENT Vbx_alco_ad_cold_cdn Vbx_alco_ad_cold_cor_appl Vbx_alco_ad_cold_ena Vbx_alco_ad_cold_frst Vxx_alco_ad_cold_cor Vxx_alco_ad_cold_dly Vxx_alco_ad_cold_dly_1 Vxx_alco_ad_lbup_v_fil Vxx_alco_ad_lbup_v_fil_ftc Vxx_alco_ad_lbup_v_fil_thd Vxx_alco_ad_prs_n_fil /end OUT_MEASUREMENT
/end FUNCTION
/begin FUNCTION CbSpvCms_Blowbyx ""
 /begin DEF_CHARACTERISTIC Ctb_alco_cor_blow_thd_fac Ctb_tco_blow_ctr Ctb_tco_blow_thd Cmp_blow_ctr_dec Cmp_blow_thd_fac Ctp_alco_cor_blow_thd_fac Ctp_tco_blow_ctr Ctp_tco_blow_thd Cxx_alco_ad_thd Cxx_blow_ctr_tco_thd Cxx_blow_thd_max Cxx_blow_thd_slop_neg Cxx_blow_thd_slop_pos Cxx_tco_blow_ctr Cxx_tco_blow_thd /end DEF_CHARACTERISTIC
 /begin OUT_MEASUREMENT Vbx_blow_ctr_cdn Vbx_blow_ctr_cdn_mem Vbx_blow_det Vbx_blow_det_alco Vbx_blow_det_mem Vbx_eng_aut_alco Vxx_blow_ctr Vxx_blow_ctr_dec Vxx_blow_ctr_ini Vxx_blow_thd Vxx_blow_thd_ini Vxx_blow_thd_slop_neg Vxx_blow_thd_slop_pos /end OUT_MEASUREMENT
/end FUNCTION
/begin FUNCTION CbSpvCms_Adocxxx "" /begin DEF_CHARACTERISTIC Csx_fuel_ign_ini /end DEF_CHARACTERISTIC /begin OUT_MEASUREMENT Vsx_fuel_ign_cho_mem /end OUT_MEASUREMENT /end FUNCTION
/begin FUNCTION AsBstCtl "" /begin OUT_MEASUREMENT Sxx_spg_ad_pwm_NVM /end OUT_MEASUREMENT
 /begin SUB_FUNCTION AsBstCtl_Wgsptxx AsBstCtl_Limitxx AsBstCtl_Prsctxx AsBstCtl_Bpcdmxx AsBstCtl_Alcoxxx /end SUB_FUNCTION
/end FUNCTION
/begin FUNCTION AsBstCtl_Wgsptxx ""
 /begin DEF_CHARACTERISTIC Ctb_spg_ol_map_sp Ctb_spg_prs_err Ctb_spg_prs_err_drv Ctb_thr_psn Cmp_spg_i_pwm_fac Cmp_spg_ol_pwm Cmp_spg_ol_pwm_thr_n Cmp_spg_prop_pwm_fac Ctp_spg_cl_spg_prs_thd Ctp_spg_drv_pwm_fac Ctp_spg_prs_dif_thd_trs Cbx_spg_bch_mod Cbx_spg_rams_cfm Cbx_spg_tq_off_mod Cxx_spg_ad_alti_thd Cxx_spg_ad_down_vb_thd Cxx_spg_ad_n_thd Cxx_spg_ad_pwm_fac Cxx_spg_ad_pwm_max_cor Cxx_spg_ad_pwm_min_cor Cxx_spg_ad_spg_thd Cxx_spg_ad_stab_prs_thd Cxx_spg_ad_up_vb_thd Cxx_spg_alti_ofs_fac Cxx_spg_alti_ofs_ofs Cxx_spg_alti_ol_pwm_fac Cxx_spg_cl_tco_thd Cxx_spg_down_ad_dz Cxx_spg_err_down_thd_drv Cxx_spg_err_drv_ftc Cxx_spg_err_up_thd_drv Cxx_spg_i_aw_fac Cxx_spg_i_pwm_max_cor Cxx_spg_i_pwm_min_cor Cxx_spg_i_pwm_sp Cxx_spg_max_err_drv Cxx_spg_max_pwm Cxx_spg_max_pwm_aw Cxx_spg_min_err_drv Cxx_spg_min_pwm Cxx_spg_min_pwm_aw Cxx_spg_ol_spg_sp_thd Cxx_spg_prop_dz Cxx_spg_pwm_bch_mod_val Cxx_spg_pwm_dif_trt_ad Cxx_spg_up_ad_dz /end DEF_CHARACTERISTIC
 /begin OUT_MEASUREMENT Vbx_spg_ad_cdn Vbx_spg_cl_cdn Vbx_spg_i_frz Vbx_spg_ol_cdn Vbx_spg_pwm_dsb_req Vbx_spg_trs Vxx_alti_cor_map_sp Vxx_ol_spg_pwm Vxx_spg_ad_pwm_inc Vxx_spg_alti_ofs Vxx_spg_cl_pwm Vxx_spg_d_pwm Vxx_spg_fil_prs_err Vxx_spg_fil_prs_err_drv Vxx_spg_i_aw_cor Vxx_spg_i_pwm Vxx_spg_p_pwm Vxx_spg_prs_err Vxx_spg_pwm_sp Vxx_spg_raw_fil_prs_err_drv /end OUT_MEASUREMENT
/end FUNCTION
/begin FUNCTION AsBstCtl_Limitxx "" /begin DEF_CHARACTERISTIC Ctp_max_pump_maf Ctp_max_rel_map_sp /end DEF_CHARACTERISTIC /begin OUT_MEASUREMENT Vxx_max_spg_prs Vxx_pump_max_maf /end OUT_MEASUREMENT /end FUNCTION
/begin FUNCTION AsBstCtl_Prsctxx ""
 /begin DEF_CHARACTERISTIC Ctp_max_map_inj_cut Cxx_map_drv_inj_cut Cxx_nr_tdc_inj_cut Cxx_prs_thd_inj_cut /end DEF_CHARACTERISTIC
 /begin OUT_MEASUREMENT Vbx_ovp_inj_cut Vxx_dly_inj_cut Vxx_map_drv Vxx_map_thd_inj_cut Vxx_max_map_inj_cut /end OUT_MEASUREMENT
/end FUNCTION
/end MODULE
/end PROJECT
