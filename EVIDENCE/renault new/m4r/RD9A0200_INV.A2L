ASAP2_VERSION 1 41
/begin PROJECT RD8 "_default_ProjectLongIdentifier"
/begin HEADER "_default_HeaderComment" PROJECT_NO RD9 /end HEADER
/begin MODULE _default_ModuleName "_default_ModuleLongIdentifier"
/begin MOD_COMMON "_default_ModCommonComment" DEPOSIT ABSOLUTE BYTE_ORDER MSB_LAST ALIGNMENT_BYTE 1 ALIGNMENT_WORD 2 ALIGNMENT_LONG 2 ALIGNMENT_FLOAT32_IEEE 2 ALIGNMENT_FLOAT64_IEEE 4 /end MOD_COMMON
/begin MEASUREMENT lv_end_diag_win_fsd_1 "" UBYTE _CNV_S_2_RANGE______3_CM 1 0. 0. 1. ECU_ADDRESS 0xd0007538 /end MEASUREMENT
/begin MEASUREMENT lv_end_diag_win_fsd_2 "" UBYTE _CNV_S_2_RANGE______3_CM 1 0. 0. 1. ECU_ADDRESS 0xd0007539 /end MEASUREMENT
/begin MEASUREMENT lv_end_diag_win_fsd_lam_lim_1 "" UBYTE _CNV_S_2_RANGE______3_CM 1 0. 0. 1. ECU_ADDRESS 0xd000753a /end MEASUREMENT
/begin MEASUREMENT lv_end_diag_win_fsd_lam_lim_2 "" UBYTE _CNV_S_2_RANGE______3_CM 1 0. 0. 1. ECU_ADDRESS 0xd000753b /end MEASUREMENT
/begin MEASUREMENT lv_eol_obd_dc "" UBYTE _CNV_A_R_ECME_LINEA_0_CM 1 0. 0. 1. ECU_ADDRESS 0xd00074e7 FORMAT "%1.0" /end MEASUREMENT
/begin MEASUREMENT inh_iv_mis "" UBYTE _CNV_A_R_ECME_LINEA_0_CM 1 0. 0. 255. ECU_ADDRESS 0xd000753d FORMAT "%3.0" /end MEASUREMENT
/begin MEASUREMENT lv_inh_iv_mis_a "At least one cylinder is shutt-off by a CARB A misfire criterion confirmed." UBYTE _CNV_S_2_RANGE______3_CM 1 0. 0. 1. ECU_ADDRESS 0xd000753c /end MEASUREMENT
/begin MEASUREMENT sym_cyl_mis_a "" UWORD _CNV_S_15_RANGE_SYM__4_CM 1 0. 0. 8192. ECU_ADDRESS 0xd0004ce8 /end MEASUREMENT
/begin MEASUREMENT sym_cyl_mis_b1 "" UWORD _CNV_S_15_RANGE_SYM__4_CM 1 0. 0. 8192. ECU_ADDRESS 0xd0004cea /end MEASUREMENT
/begin MEASUREMENT sym_cyl_mis_b4 "" UWORD _CNV_S_15_RANGE_SYM__4_CM 1 0. 0. 8192. ECU_ADDRESS 0xd0004cec /end MEASUREMENT
/begin CHARACTERISTIC c_ccp_pt_act "Security pattern to activate the CCP on powertrain CAN" VALUE 0xa00222c8 _REC_S1VAL_20_u2 65535. _CNV_A_R_ECME_LINEA_0_CM 0. 65535. FORMAT "%5.0" /end CHARACTERISTIC
/begin MEASUREMENT pv "" UWORD _CNV_A_R_CPULOAD__0_5_CM 1 0. 0. 99.90234375 ECU_ADDRESS 0xd0004ce6 FORMAT "%5.2" /end MEASUREMENT
/begin MEASUREMENT daq_ovld "DAQ overload indication" UBYTE _CNV_A_R_ECME_LINEA_0_CM 1 0. 0. 255. ECU_ADDRESS 0xd000758b FORMAT "%3.0" /end MEASUREMENT
/begin CHARACTERISTIC c_ensd_eng_dyn_conf "" VALUE 0xa002079d _REC_S1VAL_20_u1 1. _CNV_A_R_LINEAR_____31_CM 1. 2. FORMAT "%3.0" /end CHARACTERISTIC
/begin MEASUREMENT lv_err_el_sov_scp "Boolean for error short circuit to battery currently present on canister shut off valve command signal." UBYTE _CNV_S_2_RANGE______3_CM 1 0. 0. 1. ECU_ADDRESS 0xd0006364 BIT_MASK 0x1 /end MEASUREMENT
/begin MEASUREMENT ctr_vld_block "" UWORD _CNV_A_R_ECME_LINEA_0_CM 1 0. 0. 65535. DISPLAY_IDENTIFIER BoVfoSup_NVM.ctr_vld_block_NVM ECU_ADDRESS 0xd0004fb8 FORMAT "%5.0" /end MEASUREMENT
/begin MEASUREMENT lv_warm_rst "Flag which indicates a hot reset occured" UBYTE _CNV_S_2_RANGE______3_CM 1 0. 0. 1. ECU_ADDRESS 0xd00065b9 BIT_MASK 0x1 /end MEASUREMENT
/begin MEASUREMENT vp_map "Voltage of the intake manifold pressure sensor" UWORD _CNV_A_R_LINEAR_____14_CM 1 0. 0. 4.99984741210938 ECU_ADDRESS 0xd0003eaa FORMAT "%6.4" /end MEASUREMENT
/begin MEASUREMENT vp_put "digitalized voltage of air Pressure Upstream Throttle data acquisition" UWORD _CNV_A_R_LINEAR_____14_CM 1 0. 0. 4.99984741210938 ECU_ADDRESS 0xd0003ea6 FORMAT "%6.4" /end MEASUREMENT
/begin MEASUREMENT Vxx_sens_it_v_1 "Raw voltage of inlet throttle sensor 1 position" UWORD _CNV_A_R_LINEAR_____107_CM 1 0. 0. 25000. ECU_ADDRESS 0xd0003ed2 FORMAT "%5.0" /end MEASUREMENT
/begin MEASUREMENT Vxx_sens_it_v_2 "Raw voltage of inlet throttle sensor 2 position" UWORD _CNV_A_R_LINEAR_____107_CM 1 0. 0. 25000. ECU_ADDRESS 0xd0003ed4 FORMAT "%5.0" /end MEASUREMENT
/begin MEASUREMENT vp_tps_1_bas "Raw voltage throttle position sensor 1" SWORD _CNV_A_R_LINEAR_____204_CM 1 0. -5. 4.99984741210938 ECU_ADDRESS 0xd0003ece FORMAT "%7.4" /end MEASUREMENT
/begin MEASUREMENT vp_tps_2_bas "Raw voltage throttle position sensor 2" SWORD _CNV_A_R_LINEAR_____204_CM 1 0. -5. 4.99984741210938 ECU_ADDRESS 0xd0003ed0 FORMAT "%7.4" /end MEASUREMENT
/begin MEASUREMENT err_sym_tco_el "Symptom for coolant temperature signal range error" UBYTE _CNV_S_16_RANGE_ERR__206_CM 1 0. 0. 15. ECU_ADDRESS 0xd0007734 /end MEASUREMENT
/begin MEASUREMENT lv_cdn_diag_tco_el "Boolean for coolant temperature signal range diagnosis conditions" UBYTE _CNV_S_2_RANGE______3_CM 1 0. 0. 1. ECU_ADDRESS 0xd00064f0 BIT_MASK 0x1 /end MEASUREMENT
/begin MEASUREMENT tco_mes "Measured coolant temperature" UBYTE _CNV_A_R_LINEAR_____41_CM 1 0. -48. 142.5 ECU_ADDRESS 0xd0007735 FORMAT "%6.2" /end MEASUREMENT
/begin MEASUREMENT vp_tco[0] "Coolant temperature sensor raw acquisition." UWORD _CNV_A_R_LINEAR_____14_CM 1 0. 0. 4.99984741210938 ECU_ADDRESS 0xd00050e0 FORMAT "%6.4" /end MEASUREMENT
/begin MEASUREMENT lv_igk "" UBYTE _CNV_A_R_ECME_LINEA_0_CM 1 0. 0. 255. ECU_ADDRESS 0xd0006506 FORMAT "%3.0" /end MEASUREMENT
/begin MEASUREMENT lv_igk_bas "Basic ignition key detection" UBYTE _CNV_S_2_RANGE______3_CM 1 0. 0. 1. ECU_ADDRESS 0xd000773b BIT_MASK 0x1 /end MEASUREMENT
/begin MEASUREMENT v_igk_mes "Acquisition of after key battery voltage" UWORD _CNV_A_R_LINEAR_____17_CM 1 0. 0. 40.99937 ECU_ADDRESS 0xd0003ef6 FORMAT "%7.4" /end MEASUREMENT
/begin MEASUREMENT err_sym_rly_main_plaus_on "Detected symptom for main relay on output plausibility" UBYTE _CNV_S_16_RANGE_ERR__206_CM 1 0. 0. 15. ECU_ADDRESS 0xd000650d /end MEASUREMENT
/begin MEASUREMENT err_sym_vcc_1 "symptom:  failure without filtering of diagnosis for VCC_1 " UBYTE _CNV_S_16_RANGE_ERR__206_CM 1 0. 0. 15. ECU_ADDRESS 0xd000650a /end MEASUREMENT
/begin MEASUREMENT err_sym_vcc_2 "symptom:  failure without filtering of diagnosis for VCC_2 " UBYTE _CNV_S_16_RANGE_ERR__206_CM 1 0. 0. 15. ECU_ADDRESS 0xd000650b /end MEASUREMENT
/begin MEASUREMENT err_sym_vcc_3 "symptom:  failure without filtering of diagnosis for VCC_3" UBYTE _CNV_S_16_RANGE_ERR__206_CM 1 0. 0. 15. ECU_ADDRESS 0xd000650c /end MEASUREMENT
/begin MEASUREMENT lv_cdn_diag_rly_main_plaus_on "Diagnosis condition for main relay on output plausibility (set to 1 when condition is fulfilled)" UBYTE _CNV_S_2_RANGE______3_CM 1 0. 0. 1. ECU_ADDRESS 0xd0006513 BIT_MASK 0x1 /end MEASUREMENT
/begin MEASUREMENT lv_cdn_diag_vcc_1 "Condition for VCC1 diagnosis" UBYTE _CNV_S_2_RANGE______3_CM 1 0. 0. 1. ECU_ADDRESS 0xd0006510 BIT_MASK 0x1 /end MEASUREMENT
/begin MEASUREMENT lv_cdn_diag_vcc_2 "Condition for VCC2 diagnosis" UBYTE _CNV_S_2_RANGE______3_CM 1 0. 0. 1. ECU_ADDRESS 0xd0006511 BIT_MASK 0x1 /end MEASUREMENT
/begin MEASUREMENT lv_cdn_diag_vcc_3 "Condition for VCC3 diagnosis" UBYTE _CNV_S_2_RANGE______3_CM 1 0. 0. 1. ECU_ADDRESS 0xd0006512 BIT_MASK 0x1 /end MEASUREMENT
/begin MEASUREMENT lv_cdn_vb_min_diag "Boolean for battery voltage condition fulfilled for sensor diagnosis" UBYTE _CNV_S_2_RANGE______3_CM 1 0. 0. 1. ECU_ADDRESS 0xd000650f BIT_MASK 0x1 /end MEASUREMENT
/begin MEASUREMENT lv_cdn_vb_obd1 "" UBYTE _CNV_S_2_RANGE______3_CM 1 0. 0. 1. ECU_ADDRESS 0xd0006514 /end MEASUREMENT
/begin MEASUREMENT lv_cdn_vb_obd2 "boolean for battery voltage condition fulfilled for OBD diagnosis" UBYTE _CNV_S_2_RANGE______3_CM 1 0. 0. 1. ECU_ADDRESS 0xd0006516 /end MEASUREMENT
/begin MEASUREMENT lv_vb_cdn_obd_1 "" UBYTE _CNV_S_2_RANGE______3_CM 1 0. 0. 1. ECU_ADDRESS 0xd0006515 /end MEASUREMENT
/begin MEASUREMENT lv_vb_inh_diag "Flag inhibiting diagnosis because of a raw VB too low" UBYTE _CNV_S_2_RANGE______3_CM 1 0. 0. 1. ECU_ADDRESS 0xd000650e BIT_MASK 0x1 /end MEASUREMENT
/begin MEASUREMENT v_rly_main_mes "Acquisition of after relay battery voltage" UWORD _CNV_A_R_LINEAR_____17_CM 1 0. 0. 40.99937 ECU_ADDRESS 0xd0003ef8 FORMAT "%7.4" /end MEASUREMENT
/begin MEASUREMENT vb "Battery voltage" UBYTE _CNV_A_R_LINEAR_____40_CM 1 0. 0. 25.8984375 ECU_ADDRESS 0xd0006508 FORMAT "%9.6" /end MEASUREMENT
/begin MEASUREMENT vb_raw "Raw battery voltage" UBYTE _CNV_A_R_LINEAR_____40_CM 1 0. 0. 25.8984375 ECU_ADDRESS 0xd0006509 FORMAT "%9.6" /end MEASUREMENT
/begin MEASUREMENT vcc_1 "Sensors power supply voltage raw acquisition (x  = 1 or 2 versus the voltage supply)" UWORD _CNV_A_R_LINEAR_____207_CM 1 0. 0. 10. ECU_ADDRESS 0xd0003efa FORMAT "%7.4" /end MEASUREMENT
/begin MEASUREMENT vcc_2 "Sensors power supply voltage raw acquisition (x  = 1 or 2 versus the voltage supply)" UWORD _CNV_A_R_LINEAR_____207_CM 1 0. 0. 10. ECU_ADDRESS 0xd0003efc FORMAT "%7.4" /end MEASUREMENT
/begin MEASUREMENT vcc_3 "Sensors power supply voltage raw acquisition (x  = 1, 2 or 3 versus the voltage supply)" UWORD _CNV_A_R_LINEAR_____207_CM 1 0. 0. 10. ECU_ADDRESS 0xd0003efe FORMAT "%7.4" /end MEASUREMENT
/begin MEASUREMENT vp_vcc_1 "Sensors power supply voltage raw acquisition (x  = 1 or 2 versus the voltage supply)" UWORD _CNV_A_R_LINEAR_____14_CM 1 0. 0. 4.99984741210938 ECU_ADDRESS 0xd0003f00 FORMAT "%6.4" /end MEASUREMENT
/begin MEASUREMENT vp_vcc_2 "Sensors power supply voltage raw acquisition (x  = 1 or 2 versus the voltage supply)" UWORD _CNV_A_R_LINEAR_____14_CM 1 0. 0. 4.99984741210938 ECU_ADDRESS 0xd0003f02 FORMAT "%6.4" /end MEASUREMENT
/begin MEASUREMENT vp_vcc_3 "Sensors power supply voltage raw acquisition (x  = 3 versus the voltage supply)" UWORD _CNV_A_R_LINEAR_____14_CM 1 0. 0. 4.99984741210938 ECU_ADDRESS 0xd0003f04 FORMAT "%6.4" /end MEASUREMENT
/begin AXIS_PTS ldp_vb__pwm_cor "" 0xa00237f8 NO_INPUT_QUANTITY _REC_A2AXS_20_u1 25.8984375 _CNV_A_R_LINEAR_____40_CM 8 0. 25.8984375 FORMAT "%9.6" /end AXIS_PTS
/begin CHARACTERISTIC ip_pwm_cor "Interpolation table for voltage battery compensation" CURVE 0xa0024568 _REC_A1CUR_20_u2_u1 27.777 _CNV_A_R_LINEAR_____210_CM 0. 27.777 FORMAT "%11.8"
 /begin AXIS_DESCR COM_AXIS NO_INPUT_QUANTITY _CNV_A_R_LINEAR_____40_CM 8 0. 25.8984375 FORMAT "%9.6" AXIS_PTS_REF ldp_vb__pwm_cor /end AXIS_DESCR
/end CHARACTERISTIC
/begin MEASUREMENT lv_inh_diag_etc_dr "Inhibition condition for the power stage diagnosis based on SF" UBYTE _CNV_S_2_RANGE______3_CM 1 0. 0. 1. ECU_ADDRESS 0xd000652f /end MEASUREMENT
/begin MEASUREMENT lv_mtc_cur_off "The logical variable indicate the state of the ETC Power stage" UBYTE _CNV_S_2_RANGE______3_CM 1 0. 0. 1. ECU_ADDRESS 0xd000652e /end MEASUREMENT
/begin MEASUREMENT pwm_etc "PWM for the H-bridge" SWORD _CNV_A_R_LINEAR_____211_CM 1 0. -100. 99.9969482421875 ECU_ADDRESS 0xd0003f0e FORMAT "%8.3" /end MEASUREMENT
/begin CHARACTERISTIC c_vb_min_etc_dr_diag "Battery voltage threshold to inhibit the ETC power stage diagnosis" VALUE 0xa0020b47 _REC_S1VAL_20_u1 25.8984375 _CNV_A_R_LINEAR_____40_CM 0. 25.8984375 FORMAT "%9.6" /end CHARACTERISTIC
/begin MEASUREMENT DiagFuelGauge "Received CAN parameter" UBYTE _CNV_A_R_ECME_LINEA_0_CM 1 0. 0. 3. ECU_ADDRESS 0xd000760c FORMAT "%1.0" /end MEASUREMENT
/begin MEASUREMENT Sbx_rdn_obd_eva_fcap_abn_cple "" UBYTE _CNV_S_2_RANGE______3_CM 1 0. 0. 1. ECU_ADDRESS 0xd0007611 BIT_MASK 0x1 /end MEASUREMENT
/begin MEASUREMENT Sbx_rdn_obd_eva_fcap_no_lk "" UBYTE _CNV_S_2_RANGE______3_CM 1 0. 0. 1. ECU_ADDRESS 0xd0007612 BIT_MASK 0x1 /end MEASUREMENT
/begin MEASUREMENT Sbx_rdn_obd_evap_chr "" UBYTE _CNV_S_2_RANGE______3_CM 1 0. 0. 1. ECU_ADDRESS 0xd0007613 BIT_MASK 0x1 /end MEASUREMENT
/begin MEASUREMENT Sbx_rdn_obd_evap_lkg "" UBYTE _CNV_S_2_RANGE______3_CM 1 0. 0. 1. ECU_ADDRESS 0xd0007614 BIT_MASK 0x1 /end MEASUREMENT
/begin MEASUREMENT Vbx_ecm_mon_rst_req "ECU reset request due to an ecm_mon failure" UBYTE _CNV_S_2_RANGE______3_CM 1 0. 0. 1. ECU_ADDRESS 0xd0007615 BIT_MASK 0x1 /end MEASUREMENT
/begin MEASUREMENT Vbx_etc_ack "ETC frame acknowledgment bit." UBYTE _CNV_S_2_RANGE______3_CM 1 0. 0. 1. ECU_ADDRESS 0xd0007616 BIT_MASK 0x1 /end MEASUREMENT
/begin MEASUREMENT Vbx_etc_cfm "Electromagnetic Traction Control configuration boolean (1 = ETC present)" UBYTE _CNV_S_2_RANGE______3_CM 1 0. 0. 1. ECU_ADDRESS 0xd0007617 BIT_MASK 0x1 /end MEASUREMENT
/begin MEASUREMENT Vbx_it_ofs_clos_frst "Indicates if the next closed thrust learning is the first one or not. Stored in Sbx_it_ofs_clos_frst" UBYTE _CNV_S_2_RANGE______3_CM 1 0. 0. 1. ECU_ADDRESS 0xd00062a0 BIT_MASK 0x1 /end MEASUREMENT
/begin MEASUREMENT Vbx_it_ofs_open_frst "Indicates wether the current open thrust learning is the first learning or not." UBYTE _CNV_S_2_RANGE______3_CM 1 0. 0. 1. ECU_ADDRESS 0xd00062a1 BIT_MASK 0x1 /end MEASUREMENT
/begin MEASUREMENT Vbx_lpg_cyl1_cut "Active when an  injection cut is done on  cylinder 1." UBYTE _CNV_S_2_RANGE______3_CM 1 0. 0. 1. ECU_ADDRESS 0xd00062a2 BIT_MASK 0x1 /end MEASUREMENT
/begin MEASUREMENT Vbx_lpg_cyl2_cut "Active when an  injection cut is done on  cylinder 2." UBYTE _CNV_S_2_RANGE______3_CM 1 0. 0. 1. ECU_ADDRESS 0xd00062a3 BIT_MASK 0x1 /end MEASUREMENT
/begin MEASUREMENT Vbx_lpg_cyl3_cut "Active when an  injection cut is done on  cylinder 3." UBYTE _CNV_S_2_RANGE______3_CM 1 0. 0. 1. ECU_ADDRESS 0xd00062a4 BIT_MASK 0x1 /end MEASUREMENT
/begin MEASUREMENT Vbx_lpg_cyl4_cut "Active when an  injection cut is done on  cylinder 4." UBYTE _CNV_S_2_RANGE______3_CM 1 0. 0. 1. ECU_ADDRESS 0xd00062a5 BIT_MASK 0x1 /end MEASUREMENT
/begin MEASUREMENT Vbx_lpg_min_lpg_lvl "Etat mini carburant GPL" UBYTE _CNV_S_2_RANGE______3_CM 1 0. 0. 1. ECU_ADDRESS 0xd00062a6 BIT_MASK 0x1 /end MEASUREMENT
/begin MEASUREMENT Vbx_mvac_cut_req "Mastervac accessories deactivation" UBYTE _CNV_S_2_RANGE______3_CM 1 0. 0. 1. ECU_ADDRESS 0xd0007618 BIT_MASK 0x1 /end MEASUREMENT
/begin MEASUREMENT Vbx_owe_dil_warn "This bit is set if the oil dilution level is higher than Cxx_owe_oil_dil_thd" UBYTE _CNV_S_2_RANGE______3_CM 1 0. 0. 1. ECU_ADDRESS 0xd00062a7 BIT_MASK 0x1 /end MEASUREMENT
/begin MEASUREMENT Vbx_owe_osr_warn "This bit is set if the oil soot level is higher than Cxx_owe_oil_osr_thd" UBYTE _CNV_S_2_RANGE______3_CM 1 0. 0. 1. ECU_ADDRESS 0xd00062a8 BIT_MASK 0x1 /end MEASUREMENT
/begin MEASUREMENT Vbx_pwst_prs_stt "Power steering manostat activation" UBYTE _CNV_S_2_RANGE______3_CM 1 0. 0. 1. ECU_ADDRESS 0xd00062a9 BIT_MASK 0x1 /end MEASUREMENT
/begin MEASUREMENT Vbx_vb_flot_dsb "" UBYTE _CNV_S_2_RANGE______3_CM 1 0. 0. 1. ECU_ADDRESS 0xd00062aa BIT_MASK 0x1 /end MEASUREMENT
/begin MEASUREMENT Vbx_wup_cmd "Preheating lamp illumination command (diesel engine only)" UBYTE _CNV_S_2_RANGE______3_CM 1 0. 0. 1. ECU_ADDRESS 0xd00062ab BIT_MASK 0x1 /end MEASUREMENT
/begin MEASUREMENT Vbx_wup_req "Preheating diesel to be done (diesel engine only)" UBYTE _CNV_S_2_RANGE______3_CM 1 0. 0. 1. ECU_ADDRESS 0xd00062ac BIT_MASK 0x1 /end MEASUREMENT
/begin MEASUREMENT Vsx_etc_coup_stt "" UBYTE _CNV_S_3_RANGE_ETC__270_CM 1 0. 0. 2. ECU_ADDRESS 0xd00062ad /end MEASUREMENT
/begin MEASUREMENT Vsx_pft_stt_rgn "CSF statemachine actual state" UBYTE _CNV_S_8_RANGE_STAT_271_CM 1 0. 0. 80. ECU_ADDRESS 0xd000760d /end MEASUREMENT
/begin MEASUREMENT Vsx_pft_utp_reg_mod "Command mode for CSF upstream temperature regulation" UBYTE _CNV_A_R_ECME_LINEA_0_CM 1 0. 0. 3. ECU_ADDRESS 0xd000760e FORMAT "%1.0" /end MEASUREMENT
/begin MEASUREMENT Vxx_aftr_crsh_dly "After crash temporization to allow the engine restart" UWORD _CNV_A_R_LINEAR_____58_CM 1 0. 0. 70. ECU_ADDRESS 0xd0004fbe FORMAT "%6.1" /end MEASUREMENT
/begin MEASUREMENT Vxx_alt_neg_slop_req "Alternator negative power gradient authorized by ECM" UBYTE _CNV_A_R_LINEAR_____272_CM 1 0. 0. 10200. ECU_ADDRESS 0xd000760f FORMAT "%5.0" /end MEASUREMENT
/begin MEASUREMENT Vxx_driv_spt_fac "Driver sportivity factor, including 'slow' and 'fast' adaptation algorithms" UBYTE _CNV_A_R_LINEAR_____162_CM 1 0. 0. 70. ECU_ADDRESS 0xd00062ae FORMAT "%9.7" /end MEASUREMENT
/begin MEASUREMENT Vxx_emtv_clos_rat "OBD ratio indicating the number of measured postions under the turbo threshold" UBYTE _CNV_A_R_LINEAR_____123_CM 1 0. 0. 70. ECU_ADDRESS 0xd00062af FORMAT "%4.2" /end MEASUREMENT
/begin MEASUREMENT Vxx_etc_max_tqe_tgt "ETC target torque limitation sent to torque arbitration" SLONG _CNV_A_R_LINEAR_____181_CM 1 0. -400. 1647.96875 ECU_ADDRESS 0xd0004fc0 FORMAT "%9.5" /end MEASUREMENT
/begin MEASUREMENT Vxx_mux_eng_stop_req_ssg "Engine stop requested by SSG received on the CAN network" UBYTE _CNV_A_R_ECME_LINEA_0_CM 1 0. 0. 255. ECU_ADDRESS 0xd00062b0 FORMAT "%3.0" /end MEASUREMENT
/begin MEASUREMENT Vxx_opmp_cmd "Useful distance for oil evaporation since last regeneration failure to allow regeneration" UWORD _CNV_A_R_LINEAR_____146_CM 1 0. 0. 100. ECU_ADDRESS 0xd0004fc4 FORMAT "%6.2" /end MEASUREMENT
/begin MEASUREMENT Vxx_owe_dil_osr_fac_raw "Interpolation raw factor from oil dilution to oil soot" UWORD _CNV_R_R_RB_CONV_1__273_CM 1 0. 0. 1. ECU_ADDRESS 0xd0004fc6 FORMAT "%6.6" /end MEASUREMENT
/begin MEASUREMENT Vxx_owe_oxy_dil_fac_raw "Interpolation raw factor" UWORD _CNV_R_R_RB_CONV_1__273_CM 1 0. 0. 1. ECU_ADDRESS 0xd0004fc8 FORMAT "%6.6" /end MEASUREMENT
/begin MEASUREMENT Vxx_pft_rgn_err_t_ctr "Useful time for oil evaporation since last regeneration failure to allow regeneration" ULONG _CNV_A_R_LINEAR_____58_CM 1 0. 0. 65535. ECU_ADDRESS 0xd00033f8 FORMAT "%11.1" /end MEASUREMENT
/begin MEASUREMENT Vxx_pft_rgn_err_vh_dist "Useful distance for oil evaporation since last regeneration failure to allow regeneration" UWORD _CNV_A_R_LINEAR_____274_CM 1 0. 0. 65535. ECU_ADDRESS 0xd0004fca FORMAT "%5.0" /end MEASUREMENT
/begin MEASUREMENT Vxx_prim_sha_n_rat "Primary shaft speed/Engine speed ratio" UBYTE _CNV_A_R_LINEAR_____42_CM 1 0. 0. 1.9921875 ECU_ADDRESS 0xd00062b1 FORMAT "%8.6" /end MEASUREMENT
/begin MEASUREMENT Vxx_raw_sens_tia "Raw Intake air temperature" UWORD _CNV_A_R_LINEAR_____110_CM 1 0. -40. 200. ECU_ADDRESS 0xd0004fcc FORMAT "%6.1" /end MEASUREMENT
/begin MEASUREMENT Vxx_tkof_ass_fac "Take off assistance factor" UBYTE _CNV_A_R_LINEAR_____275_CM 1 0. 0. 1. ECU_ADDRESS 0xd0007610 FORMAT "%5.3" /end MEASUREMENT
/begin CHARACTERISTIC Cbx_rs_cfm "Renault Sport application: disable rs specific functions when equal to 0" VALUE 0xa00207f6 _REC_S1VAL_20_u1 1. _CNV_A_R_ECME_LINEA_0_CM 0. 1. FORMAT "%1.0" BIT_MASK 0x1 /end CHARACTERISTIC
/begin CHARACTERISTIC Cbx_vb_flot_dsb "Calibration for battery voltage floating inhibition" VALUE 0xa00207f7 _REC_S1VAL_20_u1 1. _CNV_A_R_ECME_LINEA_0_CM 0. 1. FORMAT "%1.0" BIT_MASK 0x1 /end CHARACTERISTIC
/begin CHARACTERISTIC Cxx_owe_dil_osr_fac_raw "Calibration of the interpolation raw factor from oil dilution to oil soot" VALUE 0xa00207f0 _REC_S1VAL_20_u2 1. _CNV_R_R_RB_CONV_1__273_CM 0. 1. FORMAT "%6.6" BIT_MASK 0x1 /end CHARACTERISTIC
/begin CHARACTERISTIC Cxx_owe_oxy_dil_fac_raw "Calibration of the interpolation raw factor" VALUE 0xa00207f2 _REC_S1VAL_20_u2 1. _CNV_R_R_RB_CONV_1__273_CM 0. 1. FORMAT "%6.6" BIT_MASK 0x1 /end CHARACTERISTIC
/begin CHARACTERISTIC c_ofs_ref_inj "value of offset for progressive shift of injection" VALUE 0xa0020ad2 _REC_S1VAL_20_u2 720. _CNV_A_R_LINEAR_____23_CM 0. 720. FORMAT "%7.3" /end CHARACTERISTIC
/begin MEASUREMENT err_sym_bas_knk[0] "Symptom error on basic knock signal" UBYTE _CNV_S_16_RANGE_ERR__206_CM 1 0. 0. 15. ECU_ADDRESS 0xd0007522 /end MEASUREMENT
/begin MEASUREMENT err_sym_crk_oc "Symptom of the crankshaft sensor failure open or short circuit" UBYTE _CNV_S_16_RANGE_ERR__206_CM 1 0. 0. 15. ECU_ADDRESS 0xd0007528 /end MEASUREMENT
/begin MEASUREMENT err_sym_crk_plaus "" UBYTE _CNV_S_16_RANGE_ERR__206_CM 1 0. 0. 15. ECU_ADDRESS 0xd0007527 /end MEASUREMENT
/begin MEASUREMENT err_sym_crk_syn "" UBYTE _CNV_S_16_RANGE_ERR__206_CM 1 0. 0. 15. ECU_ADDRESS 0xd0007526 /end MEASUREMENT
/begin MEASUREMENT err_sym_crk_tooth "" UBYTE _CNV_S_16_RANGE_ERR__206_CM 1 0. 0. 15. ECU_ADDRESS 0xd0007524 /end MEASUREMENT
/begin MEASUREMENT err_sym_crk_tooth_per "" UBYTE _CNV_S_16_RANGE_ERR__206_CM 1 0. 0. 15. ECU_ADDRESS 0xd0007525 /end MEASUREMENT
/begin MEASUREMENT err_sym_igc_ol[0] "" UBYTE _CNV_S_16_RANGE_ERR__206_CM 1 0. 0. 15. ECU_ADDRESS 0xd00074fc /end MEASUREMENT
/begin MEASUREMENT err_sym_igc_ol[1] "" UBYTE _CNV_S_16_RANGE_ERR__206_CM 1 0. 0. 15. ECU_ADDRESS 0xd00074fd /end MEASUREMENT
/begin MEASUREMENT err_sym_igc_ol[2] "" UBYTE _CNV_S_16_RANGE_ERR__206_CM 1 0. 0. 15. ECU_ADDRESS 0xd00074fe /end MEASUREMENT
/begin MEASUREMENT err_sym_igc_ol[3] "" UBYTE _CNV_S_16_RANGE_ERR__206_CM 1 0. 0. 15. ECU_ADDRESS 0xd00074ff /end MEASUREMENT
/begin MEASUREMENT err_sym_igc_scg[0] "" UBYTE _CNV_S_16_RANGE_ERR__206_CM 1 0. 0. 15. ECU_ADDRESS 0xd00074f8 /end MEASUREMENT
/begin MEASUREMENT err_sym_igc_scg[1] "" UBYTE _CNV_S_16_RANGE_ERR__206_CM 1 0. 0. 15. ECU_ADDRESS 0xd00074f9 /end MEASUREMENT
/begin MEASUREMENT err_sym_igc_scg[2] "" UBYTE _CNV_S_16_RANGE_ERR__206_CM 1 0. 0. 15. ECU_ADDRESS 0xd00074fa /end MEASUREMENT
/begin MEASUREMENT err_sym_igc_scg[3] "" UBYTE _CNV_S_16_RANGE_ERR__206_CM 1 0. 0. 15. ECU_ADDRESS 0xd00074fb /end MEASUREMENT
/begin MEASUREMENT err_sym_igc_scp[0] "" UBYTE _CNV_S_16_RANGE_ERR__206_CM 1 0. 0. 15. ECU_ADDRESS 0xd00074f4 /end MEASUREMENT
/begin MEASUREMENT err_sym_igc_scp[1] "" UBYTE _CNV_S_16_RANGE_ERR__206_CM 1 0. 0. 15. ECU_ADDRESS 0xd00074f5 /end MEASUREMENT
/begin MEASUREMENT err_sym_igc_scp[2] "" UBYTE _CNV_S_16_RANGE_ERR__206_CM 1 0. 0. 15. ECU_ADDRESS 0xd00074f6 /end MEASUREMENT
/begin MEASUREMENT err_sym_igc_scp[3] "" UBYTE _CNV_S_16_RANGE_ERR__206_CM 1 0. 0. 15. ECU_ADDRESS 0xd00074f7 /end MEASUREMENT
/begin MEASUREMENT err_sym_per_cam_in[0] "" UBYTE _CNV_S_16_RANGE_ERR__206_CM 1 0. 0. 15. ECU_ADDRESS 0xd0007529 /end MEASUREMENT
/begin MEASUREMENT err_sym_plaus_cam_in[0] "" UBYTE _CNV_S_16_RANGE_ERR__206_CM 1 0. 0. 15. ECU_ADDRESS 0xd000752c /end MEASUREMENT
/begin MEASUREMENT err_sym_ref_crk_cam_in[0] "" UBYTE _CNV_S_16_RANGE_ERR__206_CM 1 0. 0. 15. ECU_ADDRESS 0xd000752b /end MEASUREMENT
/begin MEASUREMENT err_sym_rel_knk[0] "Symptom error on relative knock signal" UBYTE _CNV_S_16_RANGE_ERR__206_CM 1 0. 0. 15. ECU_ADDRESS 0xd0007523 /end MEASUREMENT
/begin MEASUREMENT err_sym_syn_cam_in[0] "" UBYTE _CNV_S_16_RANGE_ERR__206_CM 1 0. 0. 15. ECU_ADDRESS 0xd000752a /end MEASUREMENT
/begin MEASUREMENT err_sym_syn_crk_cam_in[0] "" UBYTE _CNV_S_16_RANGE_ERR__206_CM 1 0. 0. 15. ECU_ADDRESS 0xd000752d /end MEASUREMENT
/begin MEASUREMENT lv_cdn_diag_bas_knk[0] "Engine state condition to authorise the basic diagnosis" UBYTE _CNV_S_2_RANGE______3_CM 1 0. 0. 1. ECU_ADDRESS 0xd0007501 /end MEASUREMENT
/begin MEASUREMENT lv_cdn_diag_crk_oc "Diagnosis condition" UBYTE _CNV_S_2_RANGE______3_CM 1 0. 0. 1. ECU_ADDRESS 0xd000750d BIT_MASK 0x1 /end MEASUREMENT
/begin MEASUREMENT lv_cdn_diag_crk_plaus "" UBYTE _CNV_S_2_RANGE______3_CM 1 0. 0. 1. ECU_ADDRESS 0xd000750b BIT_MASK 0x1 /end MEASUREMENT
/begin MEASUREMENT lv_cdn_diag_crk_syn "" UBYTE _CNV_S_2_RANGE______3_CM 1 0. 0. 1. ECU_ADDRESS 0xd0007509 BIT_MASK 0x1 /end MEASUREMENT
/begin MEASUREMENT lv_cdn_diag_crk_tooth "" UBYTE _CNV_S_2_RANGE______3_CM 1 0. 0. 1. ECU_ADDRESS 0xd0007505 BIT_MASK 0x1 /end MEASUREMENT
/begin MEASUREMENT lv_cdn_diag_crk_tooth_per "" UBYTE _CNV_S_2_RANGE______3_CM 1 0. 0. 1. ECU_ADDRESS 0xd0007507 BIT_MASK 0x1 /end MEASUREMENT
/begin MEASUREMENT lv_cdn_diag_igc_ol[0] "" UBYTE _CNV_S_2_RANGE______3_CM 1 0. 0. 1. ECU_ADDRESS 0xd00074f0 /end MEASUREMENT
/begin MEASUREMENT lv_cdn_diag_igc_ol[1] "" UBYTE _CNV_S_2_RANGE______3_CM 1 0. 0. 1. ECU_ADDRESS 0xd00074f1 /end MEASUREMENT
/begin MEASUREMENT lv_cdn_diag_igc_ol[2] "" UBYTE _CNV_S_2_RANGE______3_CM 1 0. 0. 1. ECU_ADDRESS 0xd00074f2 /end MEASUREMENT
/begin MEASUREMENT lv_cdn_diag_igc_ol[3] "" UBYTE _CNV_S_2_RANGE______3_CM 1 0. 0. 1. ECU_ADDRESS 0xd00074f3 /end MEASUREMENT
/begin MEASUREMENT lv_cdn_diag_igc_scg[0] "" UBYTE _CNV_S_2_RANGE______3_CM 1 0. 0. 1. ECU_ADDRESS 0xd00074ec /end MEASUREMENT
/begin MEASUREMENT lv_cdn_diag_igc_scg[1] "" UBYTE _CNV_S_2_RANGE______3_CM 1 0. 0. 1. ECU_ADDRESS 0xd00074ed /end MEASUREMENT
/begin MEASUREMENT lv_cdn_diag_igc_scg[2] "" UBYTE _CNV_S_2_RANGE______3_CM 1 0. 0. 1. ECU_ADDRESS 0xd00074ee /end MEASUREMENT
/begin MEASUREMENT lv_cdn_diag_igc_scg[3] "" UBYTE _CNV_S_2_RANGE______3_CM 1 0. 0. 1. ECU_ADDRESS 0xd00074ef /end MEASUREMENT
/begin MEASUREMENT lv_cdn_diag_igc_scp[0] "" UBYTE _CNV_S_2_RANGE______3_CM 1 0. 0. 1. ECU_ADDRESS 0xd00074e8 /end MEASUREMENT
/begin MEASUREMENT lv_cdn_diag_igc_scp[1] "" UBYTE _CNV_S_2_RANGE______3_CM 1 0. 0. 1. ECU_ADDRESS 0xd00074e9 /end MEASUREMENT
/begin MEASUREMENT lv_cdn_diag_igc_scp[2] "" UBYTE _CNV_S_2_RANGE______3_CM 1 0. 0. 1. ECU_ADDRESS 0xd00074ea /end MEASUREMENT
/begin MEASUREMENT lv_cdn_diag_igc_scp[3] "" UBYTE _CNV_S_2_RANGE______3_CM 1 0. 0. 1. ECU_ADDRESS 0xd00074eb /end MEASUREMENT
/begin MEASUREMENT lv_cdn_diag_per_cam_in[0] "" UBYTE _CNV_S_2_RANGE______3_CM 1 0. 0. 1. ECU_ADDRESS 0xd000750e BIT_MASK 0x1 /end MEASUREMENT
/begin MEASUREMENT lv_cdn_diag_plaus_cam_in[0] "" UBYTE _CNV_S_2_RANGE______3_CM 1 0. 0. 1. ECU_ADDRESS 0xd0007514 BIT_MASK 0x1 /end MEASUREMENT
/begin MEASUREMENT lv_cdn_diag_ref_crk_cam_in[0] "" UBYTE _CNV_S_2_RANGE______3_CM 1 0. 0. 1. ECU_ADDRESS 0xd0007512 BIT_MASK 0x1 /end MEASUREMENT
/begin MEASUREMENT lv_cdn_diag_rel_knk[0] "Engine state condition to authorise the relative diagnosis" UBYTE _CNV_S_2_RANGE______3_CM 1 0. 0. 1. ECU_ADDRESS 0xd0007502 /end MEASUREMENT
/begin MEASUREMENT lv_cdn_diag_syn_cam_in[0] "" UBYTE _CNV_S_2_RANGE______3_CM 1 0. 0. 1. ECU_ADDRESS 0xd0007510 BIT_MASK 0x1 /end MEASUREMENT
/begin MEASUREMENT lv_cdn_diag_syn_crk_cam_in[0] "" UBYTE _CNV_S_2_RANGE______3_CM 1 0. 0. 1. ECU_ADDRESS 0xd0007516 BIT_MASK 0x1 /end MEASUREMENT
/begin MEASUREMENT err_sym_map "Detected symptom MAP sensor" UBYTE _CNV_S_16_RANGE_ERR__62_CM 1 0. 0. 15. ECU_ADDRESS 0xd00062b5 /end MEASUREMENT
/begin MEASUREMENT err_sym_put "Detected symptom PUT sensor" UBYTE _CNV_S_16_RANGE_ERR__62_CM 1 0. 0. 15. ECU_ADDRESS 0xd00062b6 /end MEASUREMENT
/begin MEASUREMENT fac_fq_st_ad "Adaptation factor for fuel quality adaptation" UBYTE _CNV_A_R_LINEAR_____42_CM 1 0. 0. 1.9921875 ECU_ADDRESS 0xd00062b8 FORMAT "%8.6" /end MEASUREMENT
/begin MEASUREMENT flow_dly_mmv_cp "Lowpass filter: filtered value of FLOW_DLY_CP" UWORD _CNV_A_R_LINEAR_____55_CM 1 0. 0. 7.9998779296875 ECU_ADDRESS 0xd0004fce FORMAT "%6.4" /end MEASUREMENT
/begin MEASUREMENT iga_av_shift_rng_1 "Ignition angle at cylinder 1" UBYTE _CNV_A_R_IGRE_LINEA_47_CM 1 0. -23.625 72. ECU_ADDRESS 0xd00062b9 FORMAT "%7.3" /end MEASUREMENT
/begin MEASUREMENT iga_av_shift_rng_2 "Ignition angle at cylinder 2" UBYTE _CNV_A_R_IGRE_LINEA_47_CM 1 0. -23.625 72. ECU_ADDRESS 0xd00062ba FORMAT "%7.3" /end MEASUREMENT
/begin MEASUREMENT iga_av_shift_rng_3 "ignition angle at cylinder 3" UBYTE _CNV_A_R_IGRE_LINEA_47_CM 1 0. -23.625 72. ECU_ADDRESS 0xd00062bb FORMAT "%7.3" /end MEASUREMENT
/begin MEASUREMENT iga_av_shift_rng_4 "ignition angle at cylinder 4" UBYTE _CNV_A_R_IGRE_LINEA_47_CM 1 0. -23.625 72. ECU_ADDRESS 0xd00062bc FORMAT "%7.3" /end MEASUREMENT
/begin MEASUREMENT lv_cdn_diag_map "Status od diagnosis for MAP sensor" UBYTE _CNV_S_2_RANGE______3_CM 1 0. 0. 1. ECU_ADDRESS 0xd00062df BIT_MASK 0x1 /end MEASUREMENT
/begin MEASUREMENT lv_cdn_diag_put "Status od diagnosis for PUT sensor" UBYTE _CNV_S_2_RANGE______3_CM 1 0. 0. 1. ECU_ADDRESS 0xd00062e0 BIT_MASK 0x1 /end MEASUREMENT
/begin MEASUREMENT lv_cppwm_ext_adj "Activation of external adjustment of CPPWM by InputOutputControl" UBYTE _CNV_S_2_RANGE______3_CM 1 0. 0. 1. ECU_ADDRESS 0xd0007620 BIT_MASK 0x1 /end MEASUREMENT
/begin MEASUREMENT lv_diagcp_act_ext_adj "Dummy value, no external tool" UBYTE _CNV_S_2_RANGE______3_CM 1 0. 0. 1. ECU_ADDRESS 0xd0007621 BIT_MASK 0x1 /end MEASUREMENT
/begin MEASUREMENT lv_diagcp_auth "Boolean for Leak detection authorization by OBD 2 sequencer" UBYTE _CNV_S_2_RANGE______3_CM 1 0. 0. 1. ECU_ADDRESS 0xd0007622 BIT_MASK 0x1 /end MEASUREMENT
/begin MEASUREMENT lv_end_diag "" UBYTE _CNV_S_2_RANGE______3_CM 1 0. 0. 1. ECU_ADDRESS 0xd00062f7 BIT_MASK 0x1 /end MEASUREMENT
/begin MEASUREMENT lv_err_load_plaus "Boolean that indicates that load sensor is faulty" UBYTE _CNV_S_2_RANGE______3_CM 1 0. 0. 1. ECU_ADDRESS 0xd0007624 BIT_MASK 0x1 /end MEASUREMENT
/begin MEASUREMENT lv_err_load_tps_plaus "Boolean that indicates inconsistencies between actual load and throttle position (if set)" UBYTE _CNV_S_2_RANGE______3_CM 1 0. 0. 1. ECU_ADDRESS 0xd0007625 BIT_MASK 0x1 /end MEASUREMENT
/begin MEASUREMENT lv_fac_lam_lim_min[0] "Lower limit of lambda controller output reached" UBYTE _CNV_S_2_RANGE______3_CM 1 0. 0. 1. ECU_ADDRESS 0xd0007627 BIT_MASK 0x1 /end MEASUREMENT
/begin MEASUREMENT lv_fq_st_ad_end "End of  adaptation (but not end the fuel quality function)" UBYTE _CNV_S_2_RANGE______3_CM 1 0. 0. 1. ECU_ADDRESS 0xd00062e2 BIT_MASK 0x1 /end MEASUREMENT
/begin MEASUREMENT lv_igk_on "Key-on Flag" UBYTE _CNV_S_2_RANGE______3_CM 1 0. 0. 1. ECU_ADDRESS 0xd00062e3 BIT_MASK 0x1 /end MEASUREMENT
/begin MEASUREMENT lv_lsh_down "Heater driver ON/OFF; acquired also by BSW" UBYTE _CNV_S_2_RANGE______3_CM 1 0. 0. 1. ECU_ADDRESS 0xd00062e6 BIT_MASK 0x1 /end MEASUREMENT
/begin MEASUREMENT lv_lsh_up "Heater driver ON/OFF, acquired also by BSW" UBYTE _CNV_S_2_RANGE______3_CM 1 0. 0. 1. ECU_ADDRESS 0xd00062e7 BIT_MASK 0x1 /end MEASUREMENT
/begin MEASUREMENT lv_sov_act_ext_adj "Flag to activate SOV Actuator Test" UBYTE _CNV_S_2_RANGE______3_CM 1 0. 0. 1. ECU_ADDRESS 0xd0007628 BIT_MASK 0x1 /end MEASUREMENT
/begin MEASUREMENT lv_sov_ext_adj "Status of shut off valve of evaporator requested by service tool" UBYTE _CNV_S_2_RANGE______3_CM 1 0. 0. 1. ECU_ADDRESS 0xd0007629 BIT_MASK 0x1 /end MEASUREMENT
/begin MEASUREMENT lv_st_end "end of the engine operating state \"start\"" UBYTE _CNV_S_2_RANGE______3_CM 1 0. 0. 1. ECU_ADDRESS 0xd00062ea /end MEASUREMENT
/begin MEASUREMENT lv_syn_vld_wout_cam "" UBYTE _CNV_S_2_RANGE______3_CM 1 0. 0. 1. ECU_ADDRESS 0xd00062ed BIT_MASK 0x1 /end MEASUREMENT
/begin MEASUREMENT lv_vs_run "Boolean for running vehicle" UBYTE _CNV_S_2_RANGE______3_CM 1 0. 0. 1. ECU_ADDRESS 0xd00062f6 BIT_MASK 0x1 /end MEASUREMENT
/begin MEASUREMENT lv_wup_cyc "Warm-up cycle status flag" UBYTE _CNV_S_2_RANGE______3_CM 1 0. 0. 1. ECU_ADDRESS 0xd000762b BIT_MASK 0x1 /end MEASUREMENT
/begin MEASUREMENT maf_dly_mmv_cp "Lowpass filter: filtered value of MAF_DLY_CP" UWORD _CNV_A_R_LINEAR_____56_CM 1 0. 0. 2047.96875 ECU_ADDRESS 0xd0004fd0 FORMAT "%10.5" /end MEASUREMENT
/begin MEASUREMENT maf_hb "Air mass (predicted) for calculation of basic fuel injection (lower resol)" UBYTE _CNV_A_R_LINEAR_____77_CM 1 0. 0. 1389. ECU_ADDRESS 0xd0002389 FORMAT "%13.8" /end MEASUREMENT
/begin MEASUREMENT state_tam_mdl_upd "TAM model value update information: 0 = no update / 1 = update at cold start / 2 = update for engine warm" UBYTE _CNV_S_3_TAM_MODEL_347_CM 1 0. 0. 2. ECU_ADDRESS 0xd000761d /end MEASUREMENT
/begin MEASUREMENT t_es "Engine off duration time" UWORD _CNV_A_R_LINEAR_____95_CM 1 0. 0. 65535. ECU_ADDRESS 0xd0004fd4 FORMAT "%5.0" /end MEASUREMENT
/begin MEASUREMENT tco "coolant temperature" UBYTE _CNV_A_R_LINEAR_____41_CM 1 0. -48. 142.5 ECU_ADDRESS 0xd00062be FORMAT "%6.2" /end MEASUREMENT
/begin CHARACTERISTIC c_raf_clc_cp "stoiciometric fuel constant: ca. 14,7" VALUE 0xa00207f8 _REC_S1VAL_20_u2 255.99609375 _CNV_A_R_LINEAR_____29_CM 0. 255.99609375 FORMAT "%10.6" /end CHARACTERISTIC
/begin CHARACTERISTIC lc_eng_pha_upd_req "Configuration of pre-injection type (=1 Renault Configuration ie Full group and launch after x teeth valid" VALUE 0xa00207fa _REC_S1VAL_20_u1 1. _CNV_S_2_RANGE______3_CM 0. 1. /end CHARACTERISTIC
/begin MEASUREMENT Vsx_maf_fct_vld "Validity indicator for the whole mass air flow to throttle setpoint conversion function" UBYTE _CNV_S_3_STATUS_OK__179_CM 1 0. 0. 2. ECU_ADDRESS 0xd000649a /end MEASUREMENT
/begin MEASUREMENT lv_cam_lock_ref_pos_ivvt_in "VVTC detected in default position (information used by the basic software for CAM/CRAN coherence diagnosis)" UBYTE _CNV_S_2_RANGE______3_CM 1 0. 0. 1. ECU_ADDRESS 0xd0006505 BIT_MASK 0x1 /end MEASUREMENT
/begin MEASUREMENT lv_eng_pha_upd_req "Flag to request an engine phasing update" UBYTE _CNV_S_2_RANGE______3_CM 1 0. 0. 1. ECU_ADDRESS 0xd0006504 BIT_MASK 0x1 /end MEASUREMENT
/begin MEASUREMENT toil "Oil temperature" UWORD _CNV_A_R_LINEAR_____110_CM 1 0. -40. 200. ECU_ADDRESS 0xd00050e2 FORMAT "%6.1" /end MEASUREMENT
/begin MEASUREMENT lv_emul "" UBYTE _CNV_S_2_RANGE______3_CM 1 0. 0. 1. ECU_ADDRESS 0xd00063fa /end MEASUREMENT
/begin MEASUREMENT Vxx_ovt_acel_pdl_dif "Accelerator pedal ratio difference for driver overtorque request condition" UWORD _CNV_A_R_LINEAR_____267_CM 1 0. 0. 1.25 ECU_ADDRESS 0xd0004708 FORMAT "%7.5" /end MEASUREMENT
/begin CHARACTERISTIC Cxx_uhil_2_uhil_thd "Torque threshold to pass from uphill 2 mod to uphill mod" VALUE 0xa0022284 _REC_S1VAL_Normal_s2 65535. _CNV_R_R_VA_F_1_p0__515_CM -32768. 32767. FORMAT "%9.2" /end CHARACTERISTIC
/begin CHARACTERISTIC Cxx_uhil_uhil_2_thd "Torque threshold to pass from uphill mod to uphill 2 mod" VALUE 0xa0022288 _REC_S1VAL_Normal_s2 65535. _CNV_R_R_VA_F_1_p0__515_CM -32768. 32767. FORMAT "%9.2" /end CHARACTERISTIC
/begin MEASUREMENT Vxx_gear_cge_max_ofs "Gearshift offset chosen by the Renault Sport display" UWORD _CNV_A_R_ENSD_LINEA_22_CM 1 0. 0. 16383.75 ECU_ADDRESS 0xd00043ea FORMAT "%8.2" /end MEASUREMENT
/begin MEASUREMENT ctr_loss_tsk_ecu_run_cyc "Number of task losses within the ECU running cycle. The ECU running cycle corresponds to the time between end of reset phase and the end of the power latch phase. This counter does not overrun." UWORD _CNV_A_R_ECME_LINEA_0_CM 1 0. 0. 65535. ECU_ADDRESS 0xd0003cd2 FORMAT "%5.0" /end MEASUREMENT
/begin MEASUREMENT ctr_loss_tsk_sw_cyc "Number of task losses within the SW life cycle or since erasing. This counter does not overrun." UWORD _CNV_A_R_ECME_LINEA_0_CM 1 0. 0. 65535. ECU_ADDRESS 0xd0003cd4 FORMAT "%5.0" /end MEASUREMENT
/begin MEASUREMENT lf_state_os_tsk_loss_ecu_cyc[0] "Operating system status information: Bitfield indicating which task activations are lost within the current ECU running cycle. The ECU running cycle corresponds to the time since power up." ULONG _CNV_A_R_A_105_CM 1 0. 0. 4294967295. ECU_ADDRESS 0xd0002470 /end MEASUREMENT
/begin MEASUREMENT lf_state_os_tsk_loss_prev[0] "Operating system status information: Bitfield indicating the task activation which is is lost last within the current ECU running cycle. In case no task is lost within the current ECU running cycle no bit is set." ULONG _CNV_A_R_A_105_CM 1 0. 0. 4294967295. ECU_ADDRESS 0xd0002474 /end MEASUREMENT
/begin MEASUREMENT lf_state_os_tsk_loss_sw_cyc[0] "Operating system status information: Bitfield indicating which task activations are lost within the SW life cycle or since erasing. The SW life cycle corresponds to the time since the last SW reprogramming." ULONG _CNV_A_R_A_105_CM 1 0. 0. 4294967295. ECU_ADDRESS 0xd0002478 /end MEASUREMENT
/begin MEASUREMENT stack_cns[0] "Table of maximum used stack in percent" UBYTE _CNV_A_R_LINEAR_____165_CM 1 0. 0. 100. ECU_ADDRESS 0xd0006294 FORMAT "%3.1" /end MEASUREMENT
/begin MEASUREMENT stack_cns[1] "Table of maximum used stack in percent" UBYTE _CNV_A_R_LINEAR_____165_CM 1 0. 0. 100. ECU_ADDRESS 0xd0006295 FORMAT "%3.1" /end MEASUREMENT
/begin MEASUREMENT ctr_wrt_fly "" UBYTE _CNV_A_R_ECME_LINEA_0_CM 1 0. 0. 255. ECU_ADDRESS 0xd00063fb FORMAT "%3.0" /end MEASUREMENT
/begin MEASUREMENT ctr_wrt_fly_swt "Counter to stop write-on the fly on bank switch" ULONG _CNV_A_R_A_105_CM 1 0. 0. 16777215. ECU_ADDRESS 0xd0002484 /end MEASUREMENT
/begin MEASUREMENT lv_cru_wrt_req "Writing request in the fly zone" UBYTE _CNV_S_2_RANGE______3_CM 1 0. 0. 1. ECU_ADDRESS 0xd00063fc /end MEASUREMENT
/begin MEASUREMENT switch_type " = 0 : No switch" UBYTE _CNV_A_R_ECME_LINEA_0_CM 1 0. 0. 2. ECU_ADDRESS 0xd00076fd FORMAT "%1.0" /end MEASUREMENT
/begin MEASUREMENT Vbx_moni_xx_req[0] "" UBYTE _CNV_A_R_A_105_CM 1 0. 0. 255. ECU_ADDRESS 0xd000723c /end MEASUREMENT
/begin MEASUREMENT Vbx_moni_xx_req[2] "" UBYTE _CNV_A_R_A_105_CM 1 0. 0. 255. ECU_ADDRESS 0xd000723e /end MEASUREMENT
/begin MEASUREMENT Vbx_moni_xx_req[4] "" UBYTE _CNV_A_R_A_105_CM 1 0. 0. 255. ECU_ADDRESS 0xd0007240 /end MEASUREMENT
/begin MEASUREMENT Vbx_moni_xx_req[5] "" UBYTE _CNV_A_R_A_105_CM 1 0. 0. 255. ECU_ADDRESS 0xd0007241 /end MEASUREMENT
/begin MEASUREMENT Vbx_moni_xx_req[7] "" UBYTE _CNV_A_R_A_105_CM 1 0. 0. 255. ECU_ADDRESS 0xd0007243 /end MEASUREMENT
/begin MEASUREMENT Vbx_moni_xx_req[8] "" UBYTE _CNV_A_R_A_105_CM 1 0. 0. 255. ECU_ADDRESS 0xd0007244 /end MEASUREMENT
/begin MEASUREMENT Vbx_moni_xx_req[9] "" UBYTE _CNV_A_R_A_105_CM 1 0. 0. 255. ECU_ADDRESS 0xd0007245 /end MEASUREMENT
/begin MEASUREMENT Vbx_moni_xx_req[11] "" UBYTE _CNV_A_R_A_105_CM 1 0. 0. 255. ECU_ADDRESS 0xd0007247 /end MEASUREMENT
/begin MEASUREMENT Vbx_moni_xx_req[12] "" UBYTE _CNV_A_R_A_105_CM 1 0. 0. 255. ECU_ADDRESS 0xd0007248 /end MEASUREMENT
/begin MEASUREMENT Vbx_moni_xx_req[13] "" UBYTE _CNV_A_R_A_105_CM 1 0. 0. 255. ECU_ADDRESS 0xd0007249 /end MEASUREMENT
/begin MEASUREMENT Vbx_moni_xx_req[14] "" UBYTE _CNV_A_R_A_105_CM 1 0. 0. 255. ECU_ADDRESS 0xd000724a /end MEASUREMENT
/begin MEASUREMENT Vbx_moni_xx_req[15] "" UBYTE _CNV_A_R_A_105_CM 1 0. 0. 255. ECU_ADDRESS 0xd000724b /end MEASUREMENT
/begin MEASUREMENT Vbx_moni_xx_req[18] "" UBYTE _CNV_A_R_A_105_CM 1 0. 0. 255. ECU_ADDRESS 0xd000724e /end MEASUREMENT
/begin MEASUREMENT Vbx_moni_xx_req[21] "" UBYTE _CNV_A_R_A_105_CM 1 0. 0. 255. ECU_ADDRESS 0xd0007251 /end MEASUREMENT
/begin MEASUREMENT Vbx_moni_xx_req[22] "" UBYTE _CNV_A_R_A_105_CM 1 0. 0. 255. ECU_ADDRESS 0xd0007252 /end MEASUREMENT
/begin MEASUREMENT Vbx_moni_xx_req[23] "" UBYTE _CNV_A_R_A_105_CM 1 0. 0. 255. ECU_ADDRESS 0xd0007253 /end MEASUREMENT
/begin MEASUREMENT Vbx_moni_xx_req[34] "" UBYTE _CNV_A_R_A_105_CM 1 0. 0. 255. ECU_ADDRESS 0xd000725e /end MEASUREMENT
/begin MEASUREMENT Vbx_moni_xx_req[35] "" UBYTE _CNV_A_R_A_105_CM 1 0. 0. 255. ECU_ADDRESS 0xd000725f /end MEASUREMENT
/begin MEASUREMENT Vbx_moni_xx_req[36] "" UBYTE _CNV_A_R_A_105_CM 1 0. 0. 255. ECU_ADDRESS 0xd0007260 /end MEASUREMENT
/begin MEASUREMENT Vbx_moni_xx_req[39] "" UBYTE _CNV_A_R_A_105_CM 1 0. 0. 255. ECU_ADDRESS 0xd0007263 /end MEASUREMENT
/begin MEASUREMENT Vbx_moni_xx_req[40] "" UBYTE _CNV_A_R_A_105_CM 1 0. 0. 255. ECU_ADDRESS 0xd0007264 /end MEASUREMENT
/begin MEASUREMENT Vbx_moni_xx_req[42] "" UBYTE _CNV_A_R_A_105_CM 1 0. 0. 255. ECU_ADDRESS 0xd0007266 /end MEASUREMENT
/begin MEASUREMENT Vbx_moni_xx_req[46] "" UBYTE _CNV_A_R_A_105_CM 1 0. 0. 255. ECU_ADDRESS 0xd000726a /end MEASUREMENT
/begin MEASUREMENT Vbx_moni_xx_req[47] "" UBYTE _CNV_A_R_A_105_CM 1 0. 0. 255. ECU_ADDRESS 0xd000726b /end MEASUREMENT
/begin MEASUREMENT Vbx_moni_xx_req[63] "" UBYTE _CNV_A_R_A_105_CM 1 0. 0. 255. ECU_ADDRESS 0xd000727b /end MEASUREMENT
/begin MEASUREMENT Vbx_moni_xx_req[65] "" UBYTE _CNV_A_R_A_105_CM 1 0. 0. 255. ECU_ADDRESS 0xd000727d /end MEASUREMENT
/begin MEASUREMENT Vbx_moni_xx_req[66] "" UBYTE _CNV_A_R_A_105_CM 1 0. 0. 255. ECU_ADDRESS 0xd000727e /end MEASUREMENT
/begin MEASUREMENT Vbx_moni_xx_req[69] "" UBYTE _CNV_A_R_A_105_CM 1 0. 0. 255. ECU_ADDRESS 0xd0007281 /end MEASUREMENT
/begin MEASUREMENT Vbx_moni_xx_req[80] "" UBYTE _CNV_A_R_A_105_CM 1 0. 0. 255. ECU_ADDRESS 0xd000728c /end MEASUREMENT
/begin MEASUREMENT Vbx_moni_xx_req[83] "" UBYTE _CNV_A_R_A_105_CM 1 0. 0. 255. ECU_ADDRESS 0xd000728f /end MEASUREMENT
/begin MEASUREMENT Vbx_moni_xx_req[84] "" UBYTE _CNV_A_R_A_105_CM 1 0. 0. 255. ECU_ADDRESS 0xd0007290 /end MEASUREMENT
/begin MEASUREMENT Vbx_moni_xx_req[85] "" UBYTE _CNV_A_R_A_105_CM 1 0. 0. 255. ECU_ADDRESS 0xd0007291 /end MEASUREMENT
/begin MEASUREMENT Vbx_moni_xx_req[86] "" UBYTE _CNV_A_R_A_105_CM 1 0. 0. 255. ECU_ADDRESS 0xd0007292 /end MEASUREMENT
/begin MEASUREMENT Vbx_moni_xx_req[87] "" UBYTE _CNV_A_R_A_105_CM 1 0. 0. 255. ECU_ADDRESS 0xd0007293 /end MEASUREMENT
/begin MEASUREMENT Vbx_moni_xx_req[88] "" UBYTE _CNV_A_R_A_105_CM 1 0. 0. 255. ECU_ADDRESS 0xd0007294 /end MEASUREMENT
/begin MEASUREMENT Vbx_moni_xx_req[89] "" UBYTE _CNV_A_R_A_105_CM 1 0. 0. 255. ECU_ADDRESS 0xd0007295 /end MEASUREMENT
/begin MEASUREMENT Vbx_moni_xx_req[90] "" UBYTE _CNV_A_R_A_105_CM 1 0. 0. 255. ECU_ADDRESS 0xd0007296 /end MEASUREMENT
/begin MEASUREMENT Vbx_moni_xx_req[91] "" UBYTE _CNV_A_R_A_105_CM 1 0. 0. 255. ECU_ADDRESS 0xd0007297 /end MEASUREMENT
/begin MEASUREMENT Vbx_moni_xx_req[92] "" UBYTE _CNV_A_R_A_105_CM 1 0. 0. 255. ECU_ADDRESS 0xd0007298 /end MEASUREMENT
/begin MEASUREMENT Vbx_moni_xx_req[93] "" UBYTE _CNV_A_R_A_105_CM 1 0. 0. 255. ECU_ADDRESS 0xd0007299 /end MEASUREMENT
/begin MEASUREMENT Vbx_moni_xx_req[94] "" UBYTE _CNV_A_R_A_105_CM 1 0. 0. 255. ECU_ADDRESS 0xd000729a /end MEASUREMENT
/begin MEASUREMENT Vbx_moni_xx_req[95] "" UBYTE _CNV_A_R_A_105_CM 1 0. 0. 255. ECU_ADDRESS 0xd000729b /end MEASUREMENT
/begin MEASUREMENT Vbx_moni_xx_req[114] "" UBYTE _CNV_A_R_A_105_CM 1 0. 0. 255. ECU_ADDRESS 0xd00072ae /end MEASUREMENT
/begin MEASUREMENT Vbx_moni_xx_req[115] "" UBYTE _CNV_A_R_A_105_CM 1 0. 0. 255. ECU_ADDRESS 0xd00072af /end MEASUREMENT
/begin MEASUREMENT Vbx_moni_xx_req[116] "" UBYTE _CNV_A_R_A_105_CM 1 0. 0. 255. ECU_ADDRESS 0xd00072b0 /end MEASUREMENT
/begin MEASUREMENT Vbx_moni_xx_req[117] "" UBYTE _CNV_A_R_A_105_CM 1 0. 0. 255. ECU_ADDRESS 0xd00072b1 /end MEASUREMENT
/begin MEASUREMENT Vbx_moni_xx_req[118] "" UBYTE _CNV_A_R_A_105_CM 1 0. 0. 255. ECU_ADDRESS 0xd00072b2 /end MEASUREMENT
/begin MEASUREMENT Vbx_moni_xx_req[119] "" UBYTE _CNV_A_R_A_105_CM 1 0. 0. 255. ECU_ADDRESS 0xd00072b3 /end MEASUREMENT
/begin MEASUREMENT Vbx_moni_xx_req[120] "" UBYTE _CNV_A_R_A_105_CM 1 0. 0. 255. ECU_ADDRESS 0xd00072b4 /end MEASUREMENT
/begin MEASUREMENT Vbx_moni_xx_req[122] "" UBYTE _CNV_A_R_A_105_CM 1 0. 0. 255. ECU_ADDRESS 0xd00072b6 /end MEASUREMENT
/begin MEASUREMENT Vbx_moni_xx_req[123] "" UBYTE _CNV_A_R_A_105_CM 1 0. 0. 255. ECU_ADDRESS 0xd00072b7 /end MEASUREMENT
/begin MEASUREMENT Vbx_moni_xx_req[124] "" UBYTE _CNV_A_R_A_105_CM 1 0. 0. 255. ECU_ADDRESS 0xd00072b8 /end MEASUREMENT
/begin MEASUREMENT Vbx_moni_xx_req[125] "" UBYTE _CNV_A_R_A_105_CM 1 0. 0. 255. ECU_ADDRESS 0xd00072b9 /end MEASUREMENT
/begin MEASUREMENT Vbx_moni_xx_req[126] "" UBYTE _CNV_A_R_A_105_CM 1 0. 0. 255. ECU_ADDRESS 0xd00072ba /end MEASUREMENT
/begin MEASUREMENT Vbx_moni_xx_req[127] "" UBYTE _CNV_A_R_A_105_CM 1 0. 0. 255. ECU_ADDRESS 0xd00072bb /end MEASUREMENT
/begin MEASUREMENT Vbx_moni_xx_req[128] "" UBYTE _CNV_A_R_A_105_CM 1 0. 0. 255. ECU_ADDRESS 0xd00072bc /end MEASUREMENT
/begin AXIS_PTS Ctb_sfty_esti_tqi "Map of indicated torque breakpoints (for safety)" 0xa0022a20 Vxx_sfty_tqi_sp _REC_A2AXS_20_u2 2047.96875 _CNV_A_R_LINEAR_____181_CM 17 0. 2047.96875 FORMAT "%10.5" /end AXIS_PTS
/begin AXIS_PTS Ctb_sfty_tqi_req "Map of indicated torque breakpoints (for safety)" 0xa0022a44 Vxx_sfty_tqi_sp _REC_A2AXS_20_u2 2047.96875 _CNV_A_R_LINEAR_____181_CM 17 0. 2047.96875 FORMAT "%10.5" /end AXIS_PTS
/begin CHARACTERISTIC Ctp_sfty_esti_tqi_pos_err "Map of maximum positive error authorised between realized and safe torque for safety" CURVE 0xa0022a68 _REC_A1CUR_20_u2_u2 2047.96875 _CNV_A_R_LINEAR_____181_CM 0. 2047.96875 FORMAT "%10.5"
 /begin AXIS_DESCR COM_AXIS Vxx_sfty_tqi_sp _CNV_A_R_LINEAR_____181_CM 17 0. 2047.96875 FORMAT "%10.5" AXIS_PTS_REF Ctb_sfty_esti_tqi /end AXIS_DESCR
/end CHARACTERISTIC
/begin CHARACTERISTIC Ctp_sfty_tqi_req_pos_err "Map of maximum positive error authorised between main and safe torque for safety" CURVE 0xa0022a8c _REC_A1CUR_20_u2_u2 2047.96875 _CNV_A_R_LINEAR_____181_CM 0. 2047.96875 FORMAT "%10.5"
 /begin AXIS_DESCR COM_AXIS Vxx_sfty_tqi_sp _CNV_A_R_LINEAR_____181_CM 17 0. 2047.96875 FORMAT "%10.5" AXIS_PTS_REF Ctb_sfty_tqi_req /end AXIS_DESCR
/end CHARACTERISTIC
/begin MEASUREMENT Vbx_df_sfty_tq_chr "ECM torque plausibility detected failure" UBYTE _CNV_S_2_RANGE______3_CM 1 0. 0. 1. ECU_ADDRESS 0xd00080f8 BIT_MASK 0x1 /end MEASUREMENT
/begin MEASUREMENT Vbx_df_sfty_tq_clc_chr "ECM torque calculation plausibility detected failure" UBYTE _CNV_S_2_RANGE______3_CM 1 0. 0. 1. ECU_ADDRESS 0xd00080f9 BIT_MASK 0x1 /end MEASUREMENT
/begin MEASUREMENT Vbx_df_sfty_tq_lih_chr "throttle limp home for safety detected failure" UBYTE _CNV_S_2_RANGE______3_CM 1 0. 0. 1. ECU_ADDRESS 0xd00080fa BIT_MASK 0x1 /end MEASUREMENT
/begin MEASUREMENT Vbx_prev_df_sfty_tq_chr "Previous value of ECM torque plausibility detected failure" UBYTE _CNV_S_2_RANGE______3_CM 1 0. 0. 1. ECU_ADDRESS 0xd00080fb BIT_MASK 0x1 /end MEASUREMENT
/begin MEASUREMENT Vbx_sfty_aftr_rst "After an ECU reset requested safety monitoring" UBYTE _CNV_S_2_RANGE______3_CM 1 0. 0. 1. ECU_ADDRESS 0xd00080fc BIT_MASK 0x1 /end MEASUREMENT
/begin MEASUREMENT Vbx_sfty_aftr_rst_ini "In the initial period after an ECU reset requested safety monitoring" UBYTE _CNV_S_2_RANGE______3_CM 1 0. 0. 1. ECU_ADDRESS 0xd00080fd BIT_MASK 0x1 /end MEASUREMENT
/begin MEASUREMENT Vbx_sfty_aftr_rst_mem "After an ECU reset requested safety monitoring (stored in hot-reset proof memory)" UBYTE _CNV_S_2_RANGE______3_CM 1 0. 0. 1. ECU_ADDRESS 0xd00080fe BIT_MASK 0x1 /end MEASUREMENT
/begin MEASUREMENT Vbx_sfty_diag_ena_tqi "boolean which indicates that the diagnosis conditions are ok" UBYTE _CNV_S_2_RANGE______3_CM 1 0. 0. 1. ECU_ADDRESS 0xd00080ff BIT_MASK 0x1 /end MEASUREMENT
/begin MEASUREMENT Vbx_sfty_esti_tqi_nok "boolean which indicates that torque realization is not coherent with safe torque" UBYTE _CNV_S_2_RANGE______3_CM 1 0. 0. 1. ECU_ADDRESS 0xd0008100 BIT_MASK 0x1 /end MEASUREMENT
/begin MEASUREMENT Vbx_sfty_esti_tqi_nok_tmp "boolean which indicates that torque realization is temporarly not coherent with safe torque" UBYTE _CNV_S_2_RANGE______3_CM 1 0. 0. 1. ECU_ADDRESS 0xd0008101 BIT_MASK 0x1 /end MEASUREMENT
/begin MEASUREMENT Vbx_sfty_lih_mon_ena "Throttle limp home monitoring enabled" UBYTE _CNV_S_2_RANGE______3_CM 1 0. 0. 1. ECU_ADDRESS 0xd0008102 BIT_MASK 0x1 /end MEASUREMENT
/begin MEASUREMENT Vbx_sfty_moni_bch_ok "Monitool or bench mode are active" UBYTE _CNV_S_2_RANGE______3_CM 1 0. 0. 1. ECU_ADDRESS 0xd0008103 BIT_MASK 0x1 /end MEASUREMENT
/begin MEASUREMENT Vbx_sfty_rst_req "ECU reset request by safety monitoring" UBYTE _CNV_S_2_RANGE______3_CM 1 0. 0. 1. ECU_ADDRESS 0xd0008104 BIT_MASK 0x1 /end MEASUREMENT
/begin MEASUREMENT Vbx_sfty_stop_req "Engine stop request by safety monitoring" UBYTE _CNV_S_2_RANGE______3_CM 1 0. 0. 1. ECU_ADDRESS 0xd0008105 BIT_MASK 0x1 /end MEASUREMENT
/begin MEASUREMENT Vbx_sfty_stop_req_aftr_rst "Engine stop request by safety monitoring (sfter reset value)" UBYTE _CNV_S_2_RANGE______3_CM 1 0. 0. 1. ECU_ADDRESS 0xd0008106 BIT_MASK 0x1 /end MEASUREMENT
/begin MEASUREMENT Vbx_sfty_stop_req_mem "Engine stop request by safety monitoring (stored in hot-reset proof memory)" UBYTE _CNV_S_2_RANGE______3_CM 1 0. 0. 1. ECU_ADDRESS 0xd0008107 BIT_MASK 0x1 /end MEASUREMENT
/begin MEASUREMENT Vbx_sfty_thr_lih_mon_nok_fil "throttle limp home doesn't execut correctly for safety (filtered)" UBYTE _CNV_S_2_RANGE______3_CM 1 0. 0. 1. ECU_ADDRESS 0xd0008108 BIT_MASK 0x1 /end MEASUREMENT
/begin MEASUREMENT Vbx_sfty_tq_mon_nok "boolean which indicates a failure detection in the torque structure for safety" UBYTE _CNV_S_2_RANGE______3_CM 1 0. 0. 1. ECU_ADDRESS 0xd0008109 BIT_MASK 0x1 /end MEASUREMENT
/begin MEASUREMENT Vbx_sfty_tqi_sp_nok "Boolean which indicates that main torque request is not coherent with safe torque request" UBYTE _CNV_S_2_RANGE______3_CM 1 0. 0. 1. ECU_ADDRESS 0xd000810a BIT_MASK 0x1 /end MEASUREMENT
/begin MEASUREMENT Vbx_sfty_tqi_sp_nok_tmp "Boolean which indicates that main torque request is temporarly not coherent with safe torque request" UBYTE _CNV_S_2_RANGE______3_CM 1 0. 0. 1. ECU_ADDRESS 0xd000810b BIT_MASK 0x1 /end MEASUREMENT
/begin MEASUREMENT Vbx_sfty_vs_dsb "Inhibition of safety monitoring on vehicle speed conditions" UBYTE _CNV_S_2_RANGE______3_CM 1 0. 0. 1. ECU_ADDRESS 0xd000810c BIT_MASK 0x1 /end MEASUREMENT
/begin MEASUREMENT Vsx_sfty_tq_mon_vld "Safety torque monitoring validity status" UBYTE _CNV_S_2_STATUS_OK__269_CM 1 0. 0. 1. ECU_ADDRESS 0xd000810d /end MEASUREMENT
/begin MEASUREMENT Vxx_sfty_esti_err "Positive error authorised between main and safe torque for safety" UWORD _CNV_A_R_LINEAR_____181_CM 1 0. 0. 2047.96875 ECU_ADDRESS 0xd00080ee FORMAT "%10.5" /end MEASUREMENT
/begin MEASUREMENT Vxx_sfty_esti_err_max "Positive error authorised between main and safe torque for safety (max-over-time filtered)" UWORD _CNV_A_R_LINEAR_____181_CM 1 0. 0. 2047.96875 ECU_ADDRESS 0xd00080f0 FORMAT "%10.5" /end MEASUREMENT
/begin MEASUREMENT Vxx_sfty_esti_tqi_t_fil_min "Positive error authorised between main and safe torque for safety (min-over-time filtered)" UWORD _CNV_A_R_LINEAR_____181_CM 1 0. 0. 2047.96875 ECU_ADDRESS 0xd00080f2 FORMAT "%10.5" /end MEASUREMENT
/begin MEASUREMENT Vxx_sfty_tq_ffm_data_sf "Torque safety monitoring status flags for snapshot data" UBYTE _CNV_A_R_ECME_LINEA_0_CM 1 0. 0. 255. ECU_ADDRESS 0xd000810e FORMAT "%3.0" /end MEASUREMENT
/begin MEASUREMENT Vxx_sfty_tqi_sp_t_fil_max "Final indicated setpoint torque for safety (max-over-time filtered)" UWORD _CNV_A_R_LINEAR_____181_CM 1 0. 0. 2047.96875 ECU_ADDRESS 0xd00080f4 FORMAT "%10.5" /end MEASUREMENT
/begin MEASUREMENT Vxx_tqi_esti_sp_dif "Difference between safety estimation of realized torque and safety estimation of torque setpoint" UWORD _CNV_A_R_LINEAR_____181_CM 1 0. 0. 2047.96875 ECU_ADDRESS 0xd00080f6 FORMAT "%10.5" /end MEASUREMENT
/begin CHARACTERISTIC Cxx_dfdec_sfty_tq_chr "ECM torque plausibility detected failure counter decrement" VALUE 0xa002233c _REC_S1VAL_20_u2 65535. _CNV_A_R_ECME_LINEA_0_CM 0. 65535. FORMAT "%5.0" /end CHARACTERISTIC
/begin CHARACTERISTIC Cxx_dfdec_sfty_tq_clc_chr "ECM torque calculation plausibility detected failure counter decrement" VALUE 0xa002233e _REC_S1VAL_20_u2 65535. _CNV_A_R_ECME_LINEA_0_CM 0. 65535. FORMAT "%5.0" /end CHARACTERISTIC
/begin CHARACTERISTIC Cxx_dfdec_sfty_tq_lih_chr "throttle limp home for safety detected failure counter decrement" VALUE 0xa0022340 _REC_S1VAL_20_u2 65535. _CNV_A_R_ECME_LINEA_0_CM 0. 65535. FORMAT "%5.0" /end CHARACTERISTIC
/begin CHARACTERISTIC Cxx_dfinc_sfty_tq_chr "ECM torque plausibility detected failure counter increment" VALUE 0xa0022342 _REC_S1VAL_20_u2 65535. _CNV_A_R_ECME_LINEA_0_CM 0. 65535. FORMAT "%5.0" /end CHARACTERISTIC
/begin CHARACTERISTIC Cxx_dfinc_sfty_tq_clc_chr "ECM torque calculation plausibility detected failure counter increment" VALUE 0xa0022344 _REC_S1VAL_20_u2 65535. _CNV_A_R_ECME_LINEA_0_CM 0. 65535. FORMAT "%5.0" /end CHARACTERISTIC
/begin CHARACTERISTIC Cxx_dfinc_sfty_tq_lih_chr "throttle limp home for safety detected failure counter increment" VALUE 0xa0022346 _REC_S1VAL_20_u2 65535. _CNV_A_R_ECME_LINEA_0_CM 0. 65535. FORMAT "%5.0" /end CHARACTERISTIC
/begin CHARACTERISTIC Cxx_sfty_cyl_nr "Copy of number of cylinder for safety monitoring" VALUE 0xa0022348 _REC_S1VAL_20_u1 12. _CNV_A_R_ECME_LINEA_0_CM 0. 12. FORMAT "%2.0" /end CHARACTERISTIC
/begin CHARACTERISTIC Cxx_sfty_diag_ena_cata_dly "Diagnostic inhibition delay after catalyst warm up" VALUE 0xa0022349 _REC_S1VAL_20_u1 255. _CNV_A_R_LINEAR_____68_CM 0. 255. FORMAT "%3.0" /end CHARACTERISTIC
/begin CHARACTERISTIC Cxx_sfty_diag_ena_cata_dly_rst "Diagnostic inhibition delay after catalyst warm up (after safety reset)" VALUE 0xa002234a _REC_S1VAL_20_u1 255. _CNV_A_R_LINEAR_____68_CM 0. 255. FORMAT "%3.0" /end CHARACTERISTIC
/begin CHARACTERISTIC Cxx_sfty_diag_ena_eng_dly "Diagnostic inhibition delay after autonomous engine" VALUE 0xa002234b _REC_S1VAL_20_u1 255. _CNV_A_R_LINEAR_____68_CM 0. 255. FORMAT "%3.0" /end CHARACTERISTIC
/begin CHARACTERISTIC Cxx_sfty_diag_ena_eng_dly_rst "Diagnostic inhibition delay after autonomous engine (after safety reset)" VALUE 0xa002234c _REC_S1VAL_20_u1 255. _CNV_A_R_LINEAR_____68_CM 0. 255. FORMAT "%3.0" /end CHARACTERISTIC
/begin CHARACTERISTIC Cxx_sfty_diag_ena_n_thd "engine speed value to authorize the diagnostic" VALUE 0xa002234d _REC_S1VAL_20_u1 8160. _CNV_A_R_LINEAR_____2_CM 0. 8160. FORMAT "%4.0" /end CHARACTERISTIC
/begin CHARACTERISTIC Cxx_sfty_diag_ena_tco_thd "coolant temperature value to authorize the diagnostic" VALUE 0xa002234e _REC_S1VAL_20_u1 240. _CNV_A_R_LINEAR_____280_CM -40. 200. FORMAT "%3.0" /end CHARACTERISTIC
/begin CHARACTERISTIC Cxx_sfty_err_esti_t_fil_step "Number of steps for time filtering of estimation error" VALUE 0xa002234f _REC_S1VAL_20_u1 255. _CNV_A_R_ECME_LINEA_0_CM 0. 255. FORMAT "%3.0" /end CHARACTERISTIC
/begin CHARACTERISTIC Cxx_sfty_esti_tqi_deb_dec "Decrement value for safety torque realization failure detection" VALUE 0xa0022350 _REC_S1VAL_20_u1 255. _CNV_A_R_ECME_LINEA_0_CM 0. 255. FORMAT "%3.0" /end CHARACTERISTIC
/begin CHARACTERISTIC Cxx_sfty_esti_tqi_deb_thd "Threshold for safety torque realization failure detection" VALUE 0xa0022351 _REC_S1VAL_20_u1 255. _CNV_A_R_ECME_LINEA_0_CM 0. 255. FORMAT "%3.0" /end CHARACTERISTIC
/begin CHARACTERISTIC Cxx_sfty_esti_tqi_t_fil_step "Number of steps for time filtering of Vxx_sfty_esti_tqi" VALUE 0xa0022352 _REC_S1VAL_20_u1 255. _CNV_A_R_ECME_LINEA_0_CM 0. 255. FORMAT "%3.0" /end CHARACTERISTIC
/begin CHARACTERISTIC Cxx_sfty_ext_ctrl_bch_vs_thd "Vehicle speed threshold for external controls and bench mode safety monitoring" VALUE 0xa0022353 _REC_S1VAL_20_u1 255. _CNV_A_R_LINEAR_____71_CM 0. 255. FORMAT "%3.0" /end CHARACTERISTIC
/begin CHARACTERISTIC Cxx_sfty_ext_ctrl_t "External controls exit phase duration" VALUE 0xa0022354 _REC_S1VAL_20_u1 10.2 _CNV_A_R_LINEAR_____208_CM 0. 10.2 FORMAT "%4.2" /end CHARACTERISTIC
/begin CHARACTERISTIC Cxx_sfty_gear_cge_dec_dly "Time required for safety monitoring inhibition after the end of a manual gear shift (due to target torque provision)" VALUE 0xa0022355 _REC_S1VAL_20_u1 10.2 _CNV_A_R_LINEAR_____208_CM 0. 10.2 FORMAT "%4.2" /end CHARACTERISTIC
/begin CHARACTERISTIC Cxx_sfty_gear_cge_dec_dly_rst "Time required for safety monitoring inhibition after the end of a manual gear shift (due to target torque provision) (after safety reset)" VALUE 0xa0022356 _REC_S1VAL_20_u1 10.2 _CNV_A_R_LINEAR_____208_CM 0. 10.2 FORMAT "%4.2" /end CHARACTERISTIC
/begin CHARACTERISTIC Cxx_sfty_rst_t "Duration of safety after-reset period" VALUE 0xa0022357 _REC_S1VAL_20_u1 10.2 _CNV_A_R_LINEAR_____208_CM 0. 10.2 FORMAT "%4.2" /end CHARACTERISTIC
/begin CHARACTERISTIC Cxx_sfty_stop_req_igk_rst_t "key-off confirmation time to reauthorize engine start (for safety monitoring)" VALUE 0xa0022358 _REC_S1VAL_20_u1 10.2 _CNV_A_R_LINEAR_____208_CM 0. 10.2 FORMAT "%4.2" /end CHARACTERISTIC
/begin CHARACTERISTIC Cxx_sfty_thr_lih_mon_deb_dec "Decrement value for throttle limp-home failure detection" VALUE 0xa0022359 _REC_S1VAL_20_u1 255. _CNV_A_R_ECME_LINEA_0_CM 0. 255. FORMAT "%3.0" /end CHARACTERISTIC
/begin CHARACTERISTIC Cxx_sfty_thr_lih_mon_deb_thd "Threshold for throttle limp-home failure detection debouncing" VALUE 0xa002235a _REC_S1VAL_20_u1 255. _CNV_A_R_ECME_LINEA_0_CM 0. 255. FORMAT "%3.0" /end CHARACTERISTIC
/begin CHARACTERISTIC Cxx_sfty_tqi_sp_deb_dec "Decrement value for safety torque setpoint failure detection" VALUE 0xa002235b _REC_S1VAL_20_u1 255. _CNV_A_R_ECME_LINEA_0_CM 0. 255. FORMAT "%3.0" /end CHARACTERISTIC
/begin CHARACTERISTIC Cxx_sfty_tqi_sp_deb_thd "Threshold for safety torque setpoint failure detection" VALUE 0xa002235c _REC_S1VAL_20_u1 255. _CNV_A_R_ECME_LINEA_0_CM 0. 255. FORMAT "%3.0" /end CHARACTERISTIC
/begin CHARACTERISTIC Cxx_sfty_tqi_sp_t_fil_step "Number of steps for time filtering of Vxx_sfty_tqi_sp" VALUE 0xa002235d _REC_S1VAL_20_u1 255. _CNV_A_R_ECME_LINEA_0_CM 0. 255. FORMAT "%3.0" /end CHARACTERISTIC
/begin CHARACTERISTIC Cxx_sfty_vs_dsb_t "Low vehicle speed exit phase duration" VALUE 0xa002235e _REC_S1VAL_20_u1 10.2 _CNV_A_R_LINEAR_____208_CM 0. 10.2 FORMAT "%4.2" /end CHARACTERISTIC
/begin CHARACTERISTIC Cxx_sfty_vs_dsb_vs_thd "Vehicle speed threshold for safety monitoring" VALUE 0xa002235f _REC_S1VAL_20_u1 255. _CNV_A_R_LINEAR_____71_CM 0. 255. FORMAT "%3.0" /end CHARACTERISTIC
/begin MEASUREMENT amp "Atmospheric pressure" UWORD _CNV_A_R_LINEAR_____51_CM 1 0. 0. 5434. ECU_ADDRESS 0xd0003f1e FORMAT "%8.3" /end MEASUREMENT
/begin MEASUREMENT fac_lam_cor "Limited lambda controller output plus pre control correction" SWORD _CNV_A_R_LINEAR_____82_CM 1 0. -50. 49.9984741210938 ECU_ADDRESS 0xd0003f2a FORMAT "%12.8" /end MEASUREMENT
/begin MEASUREMENT fac_lam_dif_cp "Canister charge." UWORD _CNV_A_R_LINEAR_____50_CM 1 0. 0. 0.666656494140625 ECU_ADDRESS 0xd0003f20 FORMAT "%8.7" /end MEASUREMENT
/begin MEASUREMENT fac_lam_mv_mmv "FAC_LAM_MV average value" SWORD _CNV_A_R_LINEAR_____82_CM 1 0. -50. 49.9984741210938 ECU_ADDRESS 0xd0003f2c FORMAT "%12.8" /end MEASUREMENT
/begin MEASUREMENT fac_pq_maf_cps "Theoretical mass air flow per unit of the effective surface valve of the canister purge" UWORD _CNV_A_R_LINEAR_____231_CM 1 0. 0. 510. ECU_ADDRESS 0xd0003f22 FORMAT "%11.7" /end MEASUREMENT
/begin MEASUREMENT ftl_diagcp_rsa "Fuel level used for EVAM calculation (temporary RSA variable)" UBYTE _CNV_A_R_LINEAR_____65_CM 1 0. 0. 100. ECU_ADDRESS 0xd00065e7 FORMAT "%3.0" /end MEASUREMENT
/begin MEASUREMENT lamb_sp "Lambda setpoint" UWORD _CNV_A_R_LINEAR_____53_CM 1 0. 0. 1.99993896484375 ECU_ADDRESS 0xd0003f24 FORMAT "%7.5" /end MEASUREMENT
/begin MEASUREMENT lv_err_el_cps "Logical value for present electrical canister purge valve failure" UBYTE _CNV_S_2_RANGE______3_CM 1 0. 0. 1. ECU_ADDRESS 0xd00065be BIT_MASK 0x1 /end MEASUREMENT
/begin MEASUREMENT lv_err_el_sov "Boolean for error currently present on canister shut off valve command signal" UBYTE _CNV_S_2_RANGE______3_CM 1 0. 0. 1. ECU_ADDRESS 0xd00065bf BIT_MASK 0x1 /end MEASUREMENT
/begin MEASUREMENT lv_err_fsd "fuel system diagnosis error" UBYTE _CNV_S_2_RANGE______3_CM 1 0. 0. 1. ECU_ADDRESS 0xd00065c2 BIT_MASK 0x1 /end MEASUREMENT
/begin MEASUREMENT lv_err_ftl "Boolean that indicates that an error is present on Fuel Tank Level information" UBYTE _CNV_S_2_RANGE______3_CM 1 0. 0. 1. ECU_ADDRESS 0xd00065c3 BIT_MASK 0x1 /end MEASUREMENT
/begin MEASUREMENT lv_err_isc "Boolean for fault memory Idle Control System" UBYTE _CNV_S_2_RANGE______3_CM 1 0. 0. 1. ECU_ADDRESS 0xd00065c6 BIT_MASK 0x1 /end MEASUREMENT
/begin MEASUREMENT lv_err_ls_up "Boolean error flag, fault currently present on upstream oxygen sensor signal" UBYTE _CNV_S_2_RANGE______3_CM 1 0. 0. 1. ECU_ADDRESS 0xd00065c8 BIT_MASK 0x1 /end MEASUREMENT
/begin MEASUREMENT lv_err_lsh_up "Error flag for upstream heater diagnosis" UBYTE _CNV_S_2_RANGE______3_CM 1 0. 0. 1. ECU_ADDRESS 0xd00065c7 BIT_MASK 0x1 /end MEASUREMENT
/begin MEASUREMENT lv_err_maf "Error flag for manifold air flow diagnosis" UBYTE _CNV_S_2_RANGE______3_CM 1 0. 0. 1. ECU_ADDRESS 0xd00065c9 BIT_MASK 0x1 /end MEASUREMENT
/begin MEASUREMENT lv_err_rly_main "Boolean for error detected at the main relay" UBYTE _CNV_S_2_RANGE______3_CM 1 0. 0. 1. ECU_ADDRESS 0xd00065cc BIT_MASK 0x1 /end MEASUREMENT
/begin MEASUREMENT lv_err_tco_grd "Boolean for coolant temperature signal gradient error" UBYTE _CNV_S_2_RANGE______3_CM 1 0. 0. 1. ECU_ADDRESS 0xd00065cd BIT_MASK 0x1 /end MEASUREMENT
/begin MEASUREMENT lv_err_tco_plaus "Boolean for coolant temperature plausibility error" UBYTE _CNV_S_2_RANGE______3_CM 1 0. 0. 1. ECU_ADDRESS 0xd00065ce BIT_MASK 0x1 /end MEASUREMENT
/begin MEASUREMENT lv_err_tco_stuck "TCO Stuck signal detected" UBYTE _CNV_S_2_RANGE______3_CM 1 0. 0. 1. ECU_ADDRESS 0xd00065cf BIT_MASK 0x1 /end MEASUREMENT
/begin MEASUREMENT lv_err_tia "Boolean for Electrical error currently present on TIA sensor" UBYTE _CNV_S_2_RANGE______3_CM 1 0. 0. 1. ECU_ADDRESS 0xd00065d0 BIT_MASK 0x1 /end MEASUREMENT
/begin MEASUREMENT lv_err_tia_thr "Boolean for error currently present which might affect temperature TIA_THR" UBYTE _CNV_S_2_RANGE______3_CM 1 0. 0. 1. ECU_ADDRESS 0xd00065d1 BIT_MASK 0x1 /end MEASUREMENT
/begin MEASUREMENT lv_err_tps "Boolean that indicates that a TPS error is present" UBYTE _CNV_S_2_RANGE______3_CM 1 0. 0. 1. ECU_ADDRESS 0xd00065d2 BIT_MASK 0x1 /end MEASUREMENT
/begin MEASUREMENT lv_err_tps_plaus "Boolean that indicates that TPS sensor is faulty" UBYTE _CNV_S_2_RANGE______3_CM 1 0. 0. 1. ECU_ADDRESS 0xd00065d3 BIT_MASK 0x1 /end MEASUREMENT
/begin MEASUREMENT lv_err_tps_ratio "Logic variable is set, if a TPS ratio error is present" UBYTE _CNV_S_2_RANGE______3_CM 1 0. 0. 1. ECU_ADDRESS 0xd00065d4 BIT_MASK 0x1 /end MEASUREMENT
/begin MEASUREMENT lv_err_vb "Present failure after filtering of diagnosis of battery voltage" UBYTE _CNV_S_2_RANGE______3_CM 1 0. 0. 1. ECU_ADDRESS 0xd00065d5 BIT_MASK 0x1 /end MEASUREMENT
/begin MEASUREMENT lv_err_vs "Vehicle speed sensor error detected" UBYTE _CNV_S_2_RANGE______3_CM 1 0. 0. 1. ECU_ADDRESS 0xd00065d6 BIT_MASK 0x1 /end MEASUREMENT
/begin MEASUREMENT lv_evap_pres "Evap diagnosis activated" UBYTE _CNV_S_2_RANGE______3_CM 1 0. 0. 1. ECU_ADDRESS 0xd00065d7 BIT_MASK 0x1 /end MEASUREMENT
/begin MEASUREMENT lv_fac_lam_diagcp_end "Flag indicating controller shift caused by EVAP diagnosis was carried out" UBYTE _CNV_S_2_RANGE______3_CM 1 0. 0. 1. ECU_ADDRESS 0xd00065d8 BIT_MASK 0x1 /end MEASUREMENT
/begin MEASUREMENT lv_frq_req_cp "Frequency command selection of the canister purge" UBYTE _CNV_S_2_RANGE______3_CM 1 0. 0. 1. ECU_ADDRESS 0xd00065d9 BIT_MASK 0x1 /end MEASUREMENT
/begin MEASUREMENT lv_is "Engine operating state (Idle Speed)" UBYTE _CNV_S_2_RANGE______3_CM 1 0. 0. 1. ECU_ADDRESS 0xd00065da BIT_MASK 0x1 /end MEASUREMENT
/begin MEASUREMENT lv_lam_lscl "Activation flag of lambda control" UBYTE _CNV_S_2_RANGE______3_CM 1 0. 0. 1. ECU_ADDRESS 0xd00065db BIT_MASK 0x1 /end MEASUREMENT
/begin MEASUREMENT lv_mis_state_a "CARB A misfire criterion confirmed (debounced)" UBYTE _CNV_S_2_RANGE______3_CM 1 0. 0. 1. ECU_ADDRESS 0xd00065dc BIT_MASK 0x1 /end MEASUREMENT
/begin MEASUREMENT lv_mis_state_b1 "CARB B1 misfire criterion confirmed" UBYTE _CNV_S_2_RANGE______3_CM 1 0. 0. 1. ECU_ADDRESS 0xd00065dd BIT_MASK 0x1 /end MEASUREMENT
/begin MEASUREMENT lv_mis_state_b4 "CARB B4 misfire criterion confirmed (debounced)" UBYTE _CNV_S_2_RANGE______3_CM 1 0. 0. 1. ECU_ADDRESS 0xd00065de BIT_MASK 0x1 /end MEASUREMENT
/begin MEASUREMENT lv_state_rr "Boolean for state of rough road detection (No : Yes)." UBYTE _CNV_S_2_RANGE______3_CM 1 0. 0. 1. ECU_ADDRESS 0xd00065df BIT_MASK 0x1 /end MEASUREMENT
/begin MEASUREMENT lv_tps_not_act "(LV = 1) no powertrain setpoint requested by real (pedal) and virtual (ACC/CC/SL) drivers" UBYTE _CNV_S_2_RANGE______3_CM 1 0. 0. 1. ECU_ADDRESS 0xd00065e0 BIT_MASK 0x1 /end MEASUREMENT
/begin MEASUREMENT maf_cps "Canister purge mass air flow for EVAP calculation" UWORD _CNV_A_R_LINEAR_____55_CM 1 0. 0. 7.9998779296875 ECU_ADDRESS 0xd0003f26 FORMAT "%9.7" /end MEASUREMENT
/begin MEASUREMENT map "Manifold pressure value" UWORD _CNV_A_R_LINEAR_____51_CM 1 0. 0. 5434. ECU_ADDRESS 0xd0003f28 FORMAT "%8.3" /end MEASUREMENT
/begin MEASUREMENT state_cp_rsa "Canister purge state machine" UBYTE _CNV_S_5_CANISTER_P_393_CM 1 0. 0. 8. ECU_ADDRESS 0xd00065e2 /end MEASUREMENT
/begin MEASUREMENT state_err_iv "Error pattern after debouncing for all injectors" UBYTE _CNV_A_R_ECME_LINEA_0_CM 1 0. 0. 255. ECU_ADDRESS 0xd00065e3 FORMAT "%3.0" /end MEASUREMENT
/begin MEASUREMENT tco_st "Starting coolant temperature" UBYTE _CNV_A_R_LINEAR_____41_CM 1 0. -48. 142.5 ECU_ADDRESS 0xd00065e4 FORMAT "%6.2" /end MEASUREMENT
/begin MEASUREMENT tia "Air intake temperature" UBYTE _CNV_A_R_LINEAR_____41_CM 1 0. -48. 142.5 ECU_ADDRESS 0xd00065e5 FORMAT "%6.2" /end MEASUREMENT
/begin MEASUREMENT vs "Vehicle speed" UBYTE _CNV_A_R_LINEAR_____71_CM 1 0. 0. 255. ECU_ADDRESS 0xd00065e6 FORMAT "%3.0" /end MEASUREMENT
/begin MEASUREMENT Vbx_df_cp_blk_open "Canister purge valve stuck in open position detected failure" UBYTE _CNV_S_2_RANGE______3_CM 1 0. 0. 1. ECU_ADDRESS 0xd00065ea BIT_MASK 0x1 /end MEASUREMENT
/begin MEASUREMENT Vbx_df_eva_fcap_abn_cple "Fuel cap missing (during evaporative system monitoring) detected failure" UBYTE _CNV_S_2_RANGE______3_CM 1 0. 0. 1. ECU_ADDRESS 0xd00065eb BIT_MASK 0x1 /end MEASUREMENT
/begin MEASUREMENT Vbx_df_eva_fcap_no_lk "Fuel cap missing (out of evaporative system monitoring) detected failure" UBYTE _CNV_S_2_RANGE______3_CM 1 0. 0. 1. ECU_ADDRESS 0xd00065ec BIT_MASK 0x1 /end MEASUREMENT
/begin MEASUREMENT Vbx_df_eva_sldv_blk_clos "Shut-off valve stuck in closed position detected failure" UBYTE _CNV_S_2_RANGE______3_CM 1 0. 0. 1. ECU_ADDRESS 0xd00065ed BIT_MASK 0x1 /end MEASUREMENT
/begin MEASUREMENT Vbx_df_evap_chr "1mm leak in evap system detected failure" UBYTE _CNV_S_2_RANGE______3_CM 1 0. 0. 1. ECU_ADDRESS 0xd00065ee BIT_MASK 0x1 /end MEASUREMENT
/begin MEASUREMENT Vbx_df_evap_lkg "Large leak in evap system detected failure" UBYTE _CNV_S_2_RANGE______3_CM 1 0. 0. 1. ECU_ADDRESS 0xd00065ef BIT_MASK 0x1 /end MEASUREMENT
/begin MEASUREMENT Vbx_diag_ena_cp_blk_open "Canister purge valve stuck in open position diagnosis information available" UBYTE _CNV_S_2_RANGE______3_CM 1 0. 0. 1. ECU_ADDRESS 0xd00065f0 BIT_MASK 0x1 /end MEASUREMENT
/begin MEASUREMENT Vbx_diag_ena_eva_fcap_abn_cple "Fuel cap missing (during evaporative system monitoring) diagnosis authorization" UBYTE _CNV_S_2_RANGE______3_CM 1 0. 0. 1. ECU_ADDRESS 0xd00065f1 BIT_MASK 0x1 /end MEASUREMENT
/begin MEASUREMENT Vbx_diag_ena_eva_fcap_no_lk "Fuel cap missing (during evaporative system monitoring) diagnosis authorization" UBYTE _CNV_S_2_RANGE______3_CM 1 0. 0. 1. ECU_ADDRESS 0xd00065f2 BIT_MASK 0x1 /end MEASUREMENT
/begin MEASUREMENT Vbx_diag_ena_eva_sldv_blk_clos "Fuel cap missing (out of evaporative system monitoring) diagnosis authorization" UBYTE _CNV_S_2_RANGE______3_CM 1 0. 0. 1. ECU_ADDRESS 0xd00065f3 BIT_MASK 0x1 /end MEASUREMENT
/begin MEASUREMENT Vbx_diag_ena_evap_chr "1mm leak in evap system diagnosis information available" UBYTE _CNV_S_2_RANGE______3_CM 1 0. 0. 1. ECU_ADDRESS 0xd00065f4 BIT_MASK 0x1 /end MEASUREMENT
/begin MEASUREMENT Vbx_diag_ena_evap_lkg "Fuel cap missing (out of evaporative system monitoring) diagnosis information available" UBYTE _CNV_S_2_RANGE______3_CM 1 0. 0. 1. ECU_ADDRESS 0xd00065f5 BIT_MASK 0x1 /end MEASUREMENT
/begin CHARACTERISTIC Cxx_dfdec_cp_blk_open "Canister purge valve stuck in open position detected failure counter decrement" VALUE 0xa0020d00 _REC_S1VAL_20_u2 65535. _CNV_A_R_ECME_LINEA_0_CM 0. 65535. FORMAT "%5.0" /end CHARACTERISTIC
/begin CHARACTERISTIC Cxx_dfdec_eva_fcap_abn_cple "Fuel cap missing (during evaporative system monitoring) detected failure counter decrement" VALUE 0xa0020d02 _REC_S1VAL_20_u2 65535. _CNV_A_R_ECME_LINEA_0_CM 0. 65535. FORMAT "%5.0" /end CHARACTERISTIC
/begin CHARACTERISTIC Cxx_dfdec_eva_fcap_no_lk "Fuel cap missing (out of evaporative system monitoring) detected failure counter decrement" VALUE 0xa0020d04 _REC_S1VAL_20_u2 65535. _CNV_A_R_ECME_LINEA_0_CM 0. 65535. FORMAT "%5.0" /end CHARACTERISTIC
/begin CHARACTERISTIC Cxx_dfdec_eva_sldv_blk_clos "Large leak in evap system detected failure counter decrement" VALUE 0xa0020d06 _REC_S1VAL_20_u2 65535. _CNV_A_R_ECME_LINEA_0_CM 0. 65535. FORMAT "%5.0" /end CHARACTERISTIC
/begin CHARACTERISTIC Cxx_dfdec_evap_chr "1mm leak in evap system detected failure counter decrement" VALUE 0xa0020d08 _REC_S1VAL_20_u2 65535. _CNV_A_R_ECME_LINEA_0_CM 0. 65535. FORMAT "%5.0" /end CHARACTERISTIC
/begin CHARACTERISTIC Cxx_dfdec_evap_lkg "Fuel cap missing (out of evaporative system monitoring) detected failure counter decrement" VALUE 0xa0020d0a _REC_S1VAL_20_u2 65535. _CNV_A_R_ECME_LINEA_0_CM 0. 65535. FORMAT "%5.0" /end CHARACTERISTIC
/begin CHARACTERISTIC Cxx_dfinc_cp_blk_open "Canister purge valve stuck in open position detected failure counter increment" VALUE 0xa0020d0c _REC_S1VAL_20_u2 65535. _CNV_A_R_ECME_LINEA_0_CM 0. 65535. FORMAT "%5.0" /end CHARACTERISTIC
/begin CHARACTERISTIC Cxx_dfinc_eva_fcap_abn_cple "Fuel cap missing (during evaporative system monitoring) detected failure counter increment" VALUE 0xa0020d0e _REC_S1VAL_20_u2 65535. _CNV_A_R_ECME_LINEA_0_CM 0. 65535. FORMAT "%5.0" /end CHARACTERISTIC
/begin CHARACTERISTIC Cxx_dfinc_eva_fcap_no_lk "Fuel cap missing (out of evaporative system monitoring) detected failure counter increment" VALUE 0xa0020d10 _REC_S1VAL_20_u2 65535. _CNV_A_R_ECME_LINEA_0_CM 0. 65535. FORMAT "%5.0" /end CHARACTERISTIC
/begin CHARACTERISTIC Cxx_dfinc_eva_sldv_blk_clos "Shut-off valve stuck in closed position detected failure counter increment" VALUE 0xa0020d12 _REC_S1VAL_20_u2 65535. _CNV_A_R_ECME_LINEA_0_CM 0. 65535. FORMAT "%5.0" /end CHARACTERISTIC
/begin CHARACTERISTIC Cxx_dfinc_evap_chr "1mm leak in evap system detected failure counter increment" VALUE 0xa0020d14 _REC_S1VAL_20_u2 65535. _CNV_A_R_ECME_LINEA_0_CM 0. 65535. FORMAT "%5.0" /end CHARACTERISTIC
/begin CHARACTERISTIC Cxx_dfinc_evap_lkg "Large leak in evap system detected failure counter increment" VALUE 0xa0020d16 _REC_S1VAL_20_u2 65535. _CNV_A_R_ECME_LINEA_0_CM 0. 65535. FORMAT "%5.0" /end CHARACTERISTIC
/begin MEASUREMENT Vbx_evap_dgn "Flag indicating canister purge not active and DIAGCP active (1), or the opposite (0)" UBYTE _CNV_S_2_RANGE______3_CM 1 0. 0. 1. ECU_ADDRESS 0xd00065f6 BIT_MASK 0x1 /end MEASUREMENT
/begin MEASUREMENT Vbx_evap_dgn_cl_ti_fac "Richness closed loop reset request at EVAM diagnosis ending" UBYTE _CNV_S_2_RANGE______3_CM 1 0. 0. 1. ECU_ADDRESS 0xd00065f7 BIT_MASK 0x1 /end MEASUREMENT
/begin MEASUREMENT Vbx_evap_dgn_cp "Flag indicating canister valve is controlled by evaporation diagnosis function" UBYTE _CNV_S_2_RANGE______3_CM 1 0. 0. 1. ECU_ADDRESS 0xd00065f8 BIT_MASK 0x1 /end MEASUREMENT
/begin MEASUREMENT Vsx_eva_dgn "EVAP Diagnosis state" UBYTE _CNV_S_17_STATUS_EVA_549_CM 1 0. 0. 16. ECU_ADDRESS 0xd00065f9 /end MEASUREMENT
/begin MEASUREMENT Vsx_evap_vld "Evap diagnosis validity status" UBYTE _CNV_S_4_STATUS_OK__180_CM 1 0. 0. 3. ECU_ADDRESS 0xd00065fa /end MEASUREMENT
/begin MEASUREMENT Vsx_evap_vld_state_flow "Evap diagnosis validity status (internal)" UBYTE _CNV_A_R_ECME_LINEA_0_CM 1 0. 0. 3. ECU_ADDRESS 0xd00065fb FORMAT "%1.0" /end MEASUREMENT
/begin MEASUREMENT Vxx_eva_fcap_abn_cple_max "Threshold for detection of fuel cap missing" SWORD _CNV_A_R_LINEAR_____61_CM 1 0. -40.96 40.95875 ECU_ADDRESS 0xd0003f2e FORMAT "%9.5" /end MEASUREMENT
/begin MEASUREMENT Vxx_eva_fcap_abn_cple_val "Pressure difference during evacuation stored for MOD 06-communication" SWORD _CNV_A_R_LINEAR_____61_CM 1 0. -40.96 40.95875 ECU_ADDRESS 0xd0003f30 FORMAT "%9.5" /end MEASUREMENT
/begin MEASUREMENT Vxx_eva_fcap_no_lk_max "Thresold pressure difference during FUC_MISS diagnosis stored for mode 06-communication" SWORD _CNV_A_R_LINEAR_____61_CM 1 0. -40.96 40.95875 ECU_ADDRESS 0xd0003f32 FORMAT "%9.5" /end MEASUREMENT
/begin MEASUREMENT Vxx_eva_fcap_no_lk_val "Pressure difference during FUC_MISS diagnosis stored for mode 06-communication" SWORD _CNV_A_R_LINEAR_____61_CM 1 0. -40.96 40.95875 ECU_ADDRESS 0xd0003f34 FORMAT "%9.5" /end MEASUREMENT
/begin MEASUREMENT Vxx_evap_chr_max "Maximum threshold for leakage detection" UBYTE _CNV_A_R_EVAM_LINEA_63_CM 1 0. 0. 4.127 ECU_ADDRESS 0xd00065fc FORMAT "%8.6" /end MEASUREMENT
/begin MEASUREMENT Vxx_evap_chr_val "Reduced leakage diameter stored for mode 06-communication" UBYTE _CNV_A_R_EVAM_LINEA_63_CM 1 0. 0. 4.127 ECU_ADDRESS 0xd00065fd FORMAT "%8.6" /end MEASUREMENT
/begin MEASUREMENT Vxx_evap_dgn_cp_pwm "PWM for the canister purge valve required by the evaporation diagnosis function" UWORD _CNV_A_R_LINEAR_____159_CM 1 0. 0. 100. ECU_ADDRESS 0xd0003f36 FORMAT "%12.8" /end MEASUREMENT
/begin MEASUREMENT Vxx_evap_dgn_fim_cor "Injected fuel mass correction during evaporation diagnosis" ULONG _CNV_A_R_LINEAR_____550_CM 1 0. 0. 4800. ECU_ADDRESS 0xd00024bc FORMAT "%13.5" /end MEASUREMENT
/begin MEASUREMENT Vxx_evap_dgn_mem_cl_ti_fac "Memorized factor from richness closed loop at the beginning of EVAP diagnosis" UWORD _CNV_A_R_LINEAR_____100_CM 1 0. 0.6666666 1.33332309414063 ECU_ADDRESS 0xd0003f38 FORMAT "%8.7" /end MEASUREMENT
/begin MEASUREMENT Vxx_evap_lkg_max "Required pressure-drop to finish evacuation period" SWORD _CNV_A_R_LINEAR_____61_CM 1 0. -40.96 40.95875 ECU_ADDRESS 0xd0003f3a FORMAT "%9.5" /end MEASUREMENT
/begin MEASUREMENT Vxx_evap_lkg_val "Pressure difference during evacuation stored for MOD 06-communication" SWORD _CNV_A_R_LINEAR_____61_CM 1 0. -40.96 40.95875 ECU_ADDRESS 0xd0003f3c FORMAT "%9.5" /end MEASUREMENT
/begin MEASUREMENT Vbx_evap_cfm "Evap diagnosis activated" UBYTE _CNV_S_2_RANGE______3_CM 1 0. 0. 1. ECU_ADDRESS 0xd00065e9 BIT_MASK 0x1 /end MEASUREMENT
/begin CHARACTERISTIC Cbx_evap_cfm "(=1) Evap diagnosis activated" VALUE 0xa0020cfe _REC_S1VAL_20_u1 1. _CNV_A_R_ECME_LINEA_0_CM 0. 1. FORMAT "%1.0" BIT_MASK 0x1 /end CHARACTERISTIC
/begin MEASUREMENT ctr_err_ecc "ECC Error counter" UBYTE _CNV_A_R_ECME_LINEA_0_CM 1 0. 0. 255. ECU_ADDRESS 0xd0006428 FORMAT "%3.0" /end MEASUREMENT
/begin MEASUREMENT ctr_err_nvmy "NVMY error counter" UBYTE _CNV_A_R_ECME_LINEA_0_CM 1 0. 0. 255. ECU_ADDRESS 0xd0006429 FORMAT "%3.0" /end MEASUREMENT
/begin MEASUREMENT ctr_err_nvmy_dec "NVMY error counter decrement" UBYTE _CNV_A_R_ECME_LINEA_0_CM 1 0. 0. 255. ECU_ADDRESS 0xd000642a FORMAT "%3.0" /end MEASUREMENT
/begin MEASUREMENT ctr_err_ram "RAM error counter" UBYTE _CNV_A_R_ECME_LINEA_0_CM 1 0. 0. 255. ECU_ADDRESS 0xd000642b FORMAT "%3.0" /end MEASUREMENT
/begin MEASUREMENT ctr_err_rom "ROM error counter" UBYTE _CNV_A_R_ECME_LINEA_0_CM 1 0. 0. 255. ECU_ADDRESS 0xd000642c FORMAT "%3.0" /end MEASUREMENT
/begin MEASUREMENT ctr_err_spi "SPI error counter" UBYTE _CNV_A_R_ECME_LINEA_0_CM 1 0. 0. 255. ECU_ADDRESS 0xd000642d FORMAT "%3.0" /end MEASUREMENT
/begin MEASUREMENT ctr_err_ver "VER Error counter" UBYTE _CNV_A_R_ECME_LINEA_0_CM 1 0. 0. 255. ECU_ADDRESS 0xd000642e FORMAT "%3.0" /end MEASUREMENT
/begin MEASUREMENT ctr_rst "Reset counter (WARM, COLD, WTD)" UWORD _CNV_A_R_ECME_LINEA_0_CM 1 0. 0. 65535. ECU_ADDRESS 0xd0003d98 FORMAT "%5.0" /end MEASUREMENT
/begin MEASUREMENT ctr_rst_cold "Cold Reset counter (COLD)" UWORD _CNV_A_R_ECME_LINEA_0_CM 1 0. 0. 65535. ECU_ADDRESS 0xd000de2a FORMAT "%5.0" /end MEASUREMENT
/begin MEASUREMENT ctr_rst_warm "Warm Reset counter (WARM)" UWORD _CNV_A_R_ECME_LINEA_0_CM 1 0. 0. 65535. ECU_ADDRESS 0xd000de26 FORMAT "%5.0" /end MEASUREMENT
/begin MEASUREMENT ctr_rst_warm_5vr "Warm reset counter related to 5V reset" UWORD _CNV_A_R_ECME_LINEA_0_CM 1 0. 0. 65535. ECU_ADDRESS 0xd000de3e FORMAT "%5.0" /end MEASUREMENT
/begin MEASUREMENT ctr_rst_warm_ecm2 "Warm reset counter related to EMC2 MC reset" UWORD _CNV_A_R_ECME_LINEA_0_CM 1 0. 0. 65535. ECU_ADDRESS 0xd000de4a FORMAT "%5.0" /end MEASUREMENT
/begin MEASUREMENT ctr_rst_warm_nvmy "Warm reset counter related to key-on detection during PWL" UWORD _CNV_A_R_ECME_LINEA_0_CM 1 0. 0. 65535. ECU_ADDRESS 0xd000de3a FORMAT "%5.0" /end MEASUREMENT
/begin MEASUREMENT ctr_rst_warm_reprog "Warm reset counter related to cust. reprog." UWORD _CNV_A_R_ECME_LINEA_0_CM 1 0. 0. 65535. ECU_ADDRESS 0xd000de32 FORMAT "%5.0" /end MEASUREMENT
/begin MEASUREMENT ctr_rst_warm_rly_diag "Warm reset counter related to main rly diagnosis" UWORD _CNV_A_R_ECME_LINEA_0_CM 1 0. 0. 65535. ECU_ADDRESS 0xd000de46 FORMAT "%5.0" /end MEASUREMENT
/begin MEASUREMENT ctr_rst_warm_stu "Warm reset counter related to TRAP reset" UWORD _CNV_A_R_ECME_LINEA_0_CM 1 0. 0. 65535. ECU_ADDRESS 0xd000de42 FORMAT "%5.0" /end MEASUREMENT
/begin MEASUREMENT ctr_rst_warm_supram "Warm reset counter related to supram" UWORD _CNV_A_R_ECME_LINEA_0_CM 1 0. 0. 65535. ECU_ADDRESS 0xd000de36 FORMAT "%5.0" /end MEASUREMENT
/begin MEASUREMENT ctr_rst_wtd "Watchdog Reset counter (WTD)" UWORD _CNV_A_R_ECME_LINEA_0_CM 1 0. 0. 65535. ECU_ADDRESS 0xd000de2e FORMAT "%5.0" /end MEASUREMENT
/begin MEASUREMENT err_sym_ecu_1 "symptoms of the diagnosis instance ECU 1 (level 1) not leading to the ECU dismantlings" UBYTE _CNV_A_R_ECME_LINEA_0_CM 1 0. 0. 255. ECU_ADDRESS 0xd000642f FORMAT "%3.0" /end MEASUREMENT
/begin MEASUREMENT err_sym_ecu_2 "symptoms of the diagnosis instance ECU 2 (level 2) not leading to the ECU dismantlings" UWORD _CNV_A_R_ECME_LINEA_0_CM 1 0. 0. 65535. ECU_ADDRESS 0xd0003d9a FORMAT "%5.0" /end MEASUREMENT
/begin MEASUREMENT err_sym_nvmy "symptoms of the diagnosis instance NVMY (here a FLASH EEPROM emulation)" UBYTE _CNV_S_6_RANGE_ERR__551_CM 1 0. 0. 15. ECU_ADDRESS 0xd0006430 /end MEASUREMENT
/begin MEASUREMENT err_sym_ram "symptoms of the diagnosis instance RAM" UBYTE _CNV_S_6_RANGE_ERR__551_CM 1 0. 0. 15. ECU_ADDRESS 0xd0006431 /end MEASUREMENT
/begin MEASUREMENT err_sym_rom "symptoms of the diagnosis instance ROM" UBYTE _CNV_S_6_RANGE_ERR__551_CM 1 0. 0. 15. ECU_ADDRESS 0xd0006432 /end MEASUREMENT
/begin MEASUREMENT err_sym_spi "symptoms of the diagnosis instance SPI resulting from the detailed SPI_xxx symptoms" UBYTE _CNV_S_6_RANGE_ERR__551_CM 1 0. 0. 15. ECU_ADDRESS 0xd0006433 /end MEASUREMENT
/begin MEASUREMENT err_sym_spi_mps "symptoms of the diagnosis instance SPI_MPS" UBYTE _CNV_S_6_RANGE_ERR__551_CM 1 0. 0. 15. ECU_ADDRESS 0xd0006434 /end MEASUREMENT
/begin MEASUREMENT err_sym_spi_qps "symptoms of the diagnosis instance SPI_QPS" UBYTE _CNV_S_6_RANGE_ERR__551_CM 1 0. 0. 15. ECU_ADDRESS 0xd0006435 /end MEASUREMENT
/begin MEASUREMENT fls_reg "Flash Status Register" ULONG _CNV_A_R_ECME_LINEA_0_CM 1 0. 0. 4294967295. ECU_ADDRESS 0xd0002490 FORMAT "%10.0" /end MEASUREMENT
/begin MEASUREMENT lv_cdn_diag_ecu "diagnosis condition for diagnosis instance ECU 1 and 2" UBYTE _CNV_S_2_RANGE______3_CM 1 0. 0. 1. ECU_ADDRESS 0xd0006437 BIT_MASK 0x1 /end MEASUREMENT
/begin MEASUREMENT lv_cdn_diag_nvmy "diagnosis condition for diagnosis instance NVMY (here a FLASH EEPROM emulation)" UBYTE _CNV_S_2_RANGE______3_CM 1 0. 0. 1. ECU_ADDRESS 0xd0006438 BIT_MASK 0x1 /end MEASUREMENT
/begin MEASUREMENT lv_cdn_diag_ram "diagnosis condition for diagnosis instance RAM" UBYTE _CNV_S_2_RANGE______3_CM 1 0. 0. 1. ECU_ADDRESS 0xd0006439 BIT_MASK 0x1 /end MEASUREMENT
/begin MEASUREMENT lv_cdn_diag_rom "diagnosis condition for diagnosis instance ROM" UBYTE _CNV_S_2_RANGE______3_CM 1 0. 0. 1. ECU_ADDRESS 0xd000643a BIT_MASK 0x1 /end MEASUREMENT
/begin MEASUREMENT lv_cdn_diag_spi_mps "diagnosis condition for diagnosis instance SPI_MPS" UBYTE _CNV_S_2_RANGE______3_CM 1 0. 0. 1. ECU_ADDRESS 0xd000643b BIT_MASK 0x1 /end MEASUREMENT
/begin MEASUREMENT lv_cdn_diag_spi_qps "diagnosis condition for diagnosis instance SPI_QPS" UBYTE _CNV_S_2_RANGE______3_CM 1 0. 0. 1. ECU_ADDRESS 0xd000643c BIT_MASK 0x1 /end MEASUREMENT
/begin MEASUREMENT lv_end_diag_rom "ROM diagnosis performed" UBYTE _CNV_S_2_RANGE______3_CM 1 0. 0. 1. ECU_ADDRESS 0xd000643d BIT_MASK 0x1 /end MEASUREMENT
/begin MEASUREMENT lv_err_ecu_1 "error flag to indicate a level 1- ECU failure" UBYTE _CNV_S_2_RANGE______3_CM 1 0. 0. 1. ECU_ADDRESS 0xd000643e BIT_MASK 0x1 /end MEASUREMENT
/begin MEASUREMENT lv_err_ecu_2 "error flag to indicate a level 2- ECU failure" UBYTE _CNV_S_2_RANGE______3_CM 1 0. 0. 1. ECU_ADDRESS 0xd000643f BIT_MASK 0x1 /end MEASUREMENT
/begin MEASUREMENT lv_err_nvmy "Error flag for NVMY diagnosis" UBYTE _CNV_S_2_RANGE______3_CM 1 0. 0. 1. ECU_ADDRESS 0xd0006440 BIT_MASK 0x1 /end MEASUREMENT
/begin MEASUREMENT lv_err_ram "Error flag for RAM diagnosis" UBYTE _CNV_S_2_RANGE______3_CM 1 0. 0. 1. ECU_ADDRESS 0xd0006441 BIT_MASK 0x1 /end MEASUREMENT
/begin MEASUREMENT lv_err_rom "Error flag for ROM diagnosis" UBYTE _CNV_S_2_RANGE______3_CM 1 0. 0. 1. ECU_ADDRESS 0xd0006442 BIT_MASK 0x1 /end MEASUREMENT
/begin MEASUREMENT lv_err_spi "Error flag for SPI_xxx diagnosis" UBYTE _CNV_S_2_RANGE______3_CM 1 0. 0. 1. ECU_ADDRESS 0xd0006443 BIT_MASK 0x1 /end MEASUREMENT
/begin MEASUREMENT lv_nvmy_init_old "Flag indicating that the NVMY did not retreive the last saved data" UBYTE _CNV_S_2_RANGE______3_CM 1 0. 0. 1. ECU_ADDRESS 0xd00074be BIT_MASK 0x1 /end MEASUREMENT
/begin MEASUREMENT rst_reason "Reset reason: additional information when rst_type = FCTM_DBG_WARM_RESET" ULONG _CNV_A_R_ECME_LINEA_0_CM 1 0. 0. 4294967295. ECU_ADDRESS 0xd0006424 FORMAT "%10.0" /end MEASUREMENT
/begin MEASUREMENT rst_type "Reset type: WARM, COLD, WTD" UBYTE _CNV_S_4_RANGE______552_CM 1 0. 0. 3. ECU_ADDRESS 0xd0006436 /end MEASUREMENT
/begin MEASUREMENT trap_addr_caller "Address of the function that calls the function that generates the TRAP" ULONG _CNV_A_R_ECME_LINEA_0_CM 1 0. 0. 4294967295. ECU_ADDRESS 0xd000de5a FORMAT "%10.0" /end MEASUREMENT
/begin MEASUREMENT trap_addr_instr "Address of the instruction that generates the TRAP " ULONG _CNV_A_R_ECME_LINEA_0_CM 1 0. 0. 4294967295. ECU_ADDRESS 0xd000de52 FORMAT "%10.0" /end MEASUREMENT
/begin MEASUREMENT trap_inf "Additional info on TRAP (Trap class + TIN)" UWORD _CNV_A_R_ECME_LINEA_0_CM 1 0. 0. 65535. ECU_ADDRESS 0xd000de4e FORMAT "%5.0" /end MEASUREMENT
/begin CHARACTERISTIC c_ctr_err_nvmy_max "Calibration of the maximum number of NVMY error allowed" VALUE 0xa0020b93 _REC_S1VAL_20_u1 255. _CNV_A_R_ECME_LINEA_0_CM 0. 255. FORMAT "%3.0" /end CHARACTERISTIC
/begin CHARACTERISTIC c_ctr_err_ram_max "Calibration of the maximum number of RAM error allowed" VALUE 0xa0020b94 _REC_S1VAL_20_u1 255. _CNV_A_R_ECME_LINEA_0_CM 0. 255. FORMAT "%3.0" /end CHARACTERISTIC
/begin CHARACTERISTIC c_ctr_err_rom_max "Calibration of the maximum number of ROM error allowed" VALUE 0xa0020b95 _REC_S1VAL_20_u1 255. _CNV_A_R_ECME_LINEA_0_CM 0. 255. FORMAT "%3.0" /end CHARACTERISTIC
/begin CHARACTERISTIC c_ctr_err_spi_max "Calibration of the maximum number of SPI error allowed" VALUE 0xa0020b96 _REC_S1VAL_20_u1 255. _CNV_A_R_ECME_LINEA_0_CM 0. 255. FORMAT "%3.0" /end CHARACTERISTIC
/begin CHARACTERISTIC lc_spi_mps_drv_avl "MPS Driver (ATIC39) available on the project" VALUE 0xa0020b97 _REC_S1VAL_20_u1 1. _CNV_S_2_RANGE______3_CM 0. 1. BIT_MASK 0x1 /end CHARACTERISTIC
/begin CHARACTERISTIC lc_spi_qps_drv_avl "QPS Driver (ATM36, 38) available on the project" VALUE 0xa0020b98 _REC_S1VAL_20_u1 1. _CNV_S_2_RANGE______3_CM 0. 1. BIT_MASK 0x1 /end CHARACTERISTIC
/begin MEASUREMENT ctr_rst_eru "engine running reset counter (with engine synchronized and engine speed above NC_N_RST_ERU_DET threshold)" UWORD _CNV_A_R_ECME_LINEA_0_CM 1 0. 0. 65535. ECU_ADDRESS 0xd0003d8a FORMAT "%5.0" /end MEASUREMENT
/begin MEASUREMENT ctr_rst_eru_n_l "engine running reset counter (with engine synchronized and engine speed below NC_N_RST_ERU_DET threshold)" UWORD _CNV_A_R_ECME_LINEA_0_CM 1 0. 0. 65535. ECU_ADDRESS 0xd0003d8c FORMAT "%5.0" /end MEASUREMENT
/begin MEASUREMENT lv_ctr_rst_eru_det "engine running reset detection enable" UBYTE _CNV_S_2_RANGE______3_CM 1 0. 0. 1. ECU_ADDRESS 0xd0006420 BIT_MASK 0x1 /end MEASUREMENT
/begin MEASUREMENT n_rst_eru "engine speed calculated during detection of reset engine running with engine speed above NC_N_RST_ERU_DET threshold" UWORD _CNV_A_R_LINEAR_____19_CM 1 0. 0. 8160. ECU_ADDRESS 0xd0003d8e FORMAT "%4.0" /end MEASUREMENT
/begin MEASUREMENT n_rst_eru_n_l "engine speed calculated during detection of reset engine running with engine speed below NC_N_RST_ERU_DET threshold" UWORD _CNV_A_R_LINEAR_____19_CM 1 0. 0. 8160. ECU_ADDRESS 0xd0003d90 FORMAT "%4.0" /end MEASUREMENT
/begin MEASUREMENT t_rst_eru_det "timer to check first valid tooth and engine speed for detection of reset engine running" UWORD _CNV_A_R_ECME_LINEA_0_CM 1 0. 0. 65535. ECU_ADDRESS 0xd0003d92 FORMAT "%5.0" /end MEASUREMENT
/begin MEASUREMENT lv_test_run_ign_0 "" UBYTE _CNV_S_2_RANGE______3_CM 1 0. 0. 1. DISPLAY_IDENTIFIER test_eol_ign_0.lv_test_run_x ECU_ADDRESS 0xd000640d BIT_MASK 0x8 /end MEASUREMENT
/begin MEASUREMENT lv_test_out_ign_0 "" UBYTE _CNV_S_2_RANGE______3_CM 1 0. 0. 1. DISPLAY_IDENTIFIER test_eol_ign_0.lv_test_out_x ECU_ADDRESS 0xd000640d BIT_MASK 0x4 /end MEASUREMENT
/begin MEASUREMENT test_eol_ign_0.lv_test_out_cus_x "" UBYTE _CNV_S_2_RANGE______3_CM 1 0. 0. 1. ECU_ADDRESS 0xd000640d BIT_MASK 0x2 /end MEASUREMENT
/begin MEASUREMENT lv_test_req_ign_0 "" UBYTE _CNV_S_2_RANGE______3_CM 1 0. 0. 1. DISPLAY_IDENTIFIER test_eol_ign_0.lv_test_req_x ECU_ADDRESS 0xd000640d BIT_MASK 0x1 /end MEASUREMENT
/begin MEASUREMENT test_eol_ign_0.lv_adj_out_x "" UBYTE _CNV_S_2_RANGE______3_CM 1 0. 0. 1. ECU_ADDRESS 0xd000640d BIT_MASK 0x10 /end MEASUREMENT
/begin MEASUREMENT test_eol_ign_0.lv_adj_dec_x "" UBYTE _CNV_S_2_RANGE______3_CM 1 0. 0. 1. ECU_ADDRESS 0xd000640d BIT_MASK 0x20 /end MEASUREMENT
/begin MEASUREMENT test_eol_ign_0.lv_adj_inc_x "" UBYTE _CNV_S_2_RANGE______3_CM 1 0. 0. 1. ECU_ADDRESS 0xd000640d BIT_MASK 0x40 /end MEASUREMENT
/begin MEASUREMENT test_eol_ign_0.lv_adj_save_x "" UBYTE _CNV_S_2_RANGE______3_CM 1 0. 0. 1. ECU_ADDRESS 0xd000640d BIT_MASK 0x80 /end MEASUREMENT
/begin MEASUREMENT lv_test_run_ign_1 "" UBYTE _CNV_S_2_RANGE______3_CM 1 0. 0. 1. DISPLAY_IDENTIFIER test_eol_ign_1.lv_test_run_x ECU_ADDRESS 0xd000640e BIT_MASK 0x8 /end MEASUREMENT
/begin MEASUREMENT lv_test_out_ign_1 "" UBYTE _CNV_S_2_RANGE______3_CM 1 0. 0. 1. DISPLAY_IDENTIFIER test_eol_ign_1.lv_test_out_x ECU_ADDRESS 0xd000640e BIT_MASK 0x4 /end MEASUREMENT
/begin MEASUREMENT test_eol_ign_1.lv_test_out_cus_x "" UBYTE _CNV_S_2_RANGE______3_CM 1 0. 0. 1. ECU_ADDRESS 0xd000640e BIT_MASK 0x2 /end MEASUREMENT
/begin MEASUREMENT lv_test_req_ign_1 "" UBYTE _CNV_S_2_RANGE______3_CM 1 0. 0. 1. DISPLAY_IDENTIFIER test_eol_ign_1.lv_test_req_x ECU_ADDRESS 0xd000640e BIT_MASK 0x1 /end MEASUREMENT
/begin MEASUREMENT test_eol_ign_1.lv_adj_out_x "" UBYTE _CNV_S_2_RANGE______3_CM 1 0. 0. 1. ECU_ADDRESS 0xd000640e BIT_MASK 0x10 /end MEASUREMENT
/begin MEASUREMENT test_eol_ign_1.lv_adj_dec_x "" UBYTE _CNV_S_2_RANGE______3_CM 1 0. 0. 1. ECU_ADDRESS 0xd000640e BIT_MASK 0x20 /end MEASUREMENT
/begin MEASUREMENT test_eol_ign_1.lv_adj_inc_x "" UBYTE _CNV_S_2_RANGE______3_CM 1 0. 0. 1. ECU_ADDRESS 0xd000640e BIT_MASK 0x40 /end MEASUREMENT
/begin MEASUREMENT test_eol_ign_1.lv_adj_save_x "" UBYTE _CNV_S_2_RANGE______3_CM 1 0. 0. 1. ECU_ADDRESS 0xd000640e BIT_MASK 0x80 /end MEASUREMENT
/begin MEASUREMENT lv_test_run_ign_2 "" UBYTE _CNV_S_2_RANGE______3_CM 1 0. 0. 1. DISPLAY_IDENTIFIER test_eol_ign_2.lv_test_run_x ECU_ADDRESS 0xd000640f BIT_MASK 0x8 /end MEASUREMENT
/begin MEASUREMENT lv_test_out_ign_2 "" UBYTE _CNV_S_2_RANGE______3_CM 1 0. 0. 1. DISPLAY_IDENTIFIER test_eol_ign_2.lv_test_out_x ECU_ADDRESS 0xd000640f BIT_MASK 0x4 /end MEASUREMENT
/begin MEASUREMENT test_eol_ign_2.lv_test_out_cus_x "" UBYTE _CNV_S_2_RANGE______3_CM 1 0. 0. 1. ECU_ADDRESS 0xd000640f BIT_MASK 0x2 /end MEASUREMENT
/begin MEASUREMENT lv_test_req_ign_2 "" UBYTE _CNV_S_2_RANGE______3_CM 1 0. 0. 1. DISPLAY_IDENTIFIER test_eol_ign_2.lv_test_req_x ECU_ADDRESS 0xd000640f BIT_MASK 0x1 /end MEASUREMENT
/begin MEASUREMENT test_eol_ign_2.lv_adj_out_x "" UBYTE _CNV_S_2_RANGE______3_CM 1 0. 0. 1. ECU_ADDRESS 0xd000640f BIT_MASK 0x10 /end MEASUREMENT
/begin MEASUREMENT test_eol_ign_2.lv_adj_dec_x "" UBYTE _CNV_S_2_RANGE______3_CM 1 0. 0. 1. ECU_ADDRESS 0xd000640f BIT_MASK 0x20 /end MEASUREMENT
/begin MEASUREMENT test_eol_ign_2.lv_adj_inc_x "" UBYTE _CNV_S_2_RANGE______3_CM 1 0. 0. 1. ECU_ADDRESS 0xd000640f BIT_MASK 0x40 /end MEASUREMENT
/begin MEASUREMENT test_eol_ign_2.lv_adj_save_x "" UBYTE _CNV_S_2_RANGE______3_CM 1 0. 0. 1. ECU_ADDRESS 0xd000640f BIT_MASK 0x80 /end MEASUREMENT
/begin MEASUREMENT lv_test_run_ign_3 "" UBYTE _CNV_S_2_RANGE______3_CM 1 0. 0. 1. DISPLAY_IDENTIFIER test_eol_ign_3.lv_test_run_x ECU_ADDRESS 0xd0006410 BIT_MASK 0x8 /end MEASUREMENT
/begin MEASUREMENT lv_test_out_ign_3 "" UBYTE _CNV_S_2_RANGE______3_CM 1 0. 0. 1. DISPLAY_IDENTIFIER test_eol_ign_3.lv_test_out_x ECU_ADDRESS 0xd0006410 BIT_MASK 0x4 /end MEASUREMENT
/begin MEASUREMENT test_eol_ign_3.lv_test_out_cus_x "" UBYTE _CNV_S_2_RANGE______3_CM 1 0. 0. 1. ECU_ADDRESS 0xd0006410 BIT_MASK 0x2 /end MEASUREMENT
/begin MEASUREMENT lv_test_req_ign_3 "" UBYTE _CNV_S_2_RANGE______3_CM 1 0. 0. 1. DISPLAY_IDENTIFIER test_eol_ign_3.lv_test_req_x ECU_ADDRESS 0xd0006410 BIT_MASK 0x1 /end MEASUREMENT
/begin MEASUREMENT test_eol_ign_3.lv_adj_out_x "" UBYTE _CNV_S_2_RANGE______3_CM 1 0. 0. 1. ECU_ADDRESS 0xd0006410 BIT_MASK 0x10 /end MEASUREMENT
/begin MEASUREMENT test_eol_ign_3.lv_adj_dec_x "" UBYTE _CNV_S_2_RANGE______3_CM 1 0. 0. 1. ECU_ADDRESS 0xd0006410 BIT_MASK 0x20 /end MEASUREMENT
/begin MEASUREMENT test_eol_ign_3.lv_adj_inc_x "" UBYTE _CNV_S_2_RANGE______3_CM 1 0. 0. 1. ECU_ADDRESS 0xd0006410 BIT_MASK 0x40 /end MEASUREMENT
/begin MEASUREMENT test_eol_ign_3.lv_adj_save_x "" UBYTE _CNV_S_2_RANGE______3_CM 1 0. 0. 1. ECU_ADDRESS 0xd0006410 BIT_MASK 0x80 /end MEASUREMENT
/begin MEASUREMENT lv_test_run_inj_0 "" UBYTE _CNV_S_2_RANGE______3_CM 1 0. 0. 1. DISPLAY_IDENTIFIER test_eol_inj_0.lv_test_run_x ECU_ADDRESS 0xd0006409 BIT_MASK 0x8 /end MEASUREMENT
/begin MEASUREMENT lv_test_out_inj_0 "" UBYTE _CNV_S_2_RANGE______3_CM 1 0. 0. 1. DISPLAY_IDENTIFIER test_eol_inj_0.lv_test_out_x ECU_ADDRESS 0xd0006409 BIT_MASK 0x4 /end MEASUREMENT
/begin MEASUREMENT test_eol_inj_0.lv_test_out_cus_x "" UBYTE _CNV_S_2_RANGE______3_CM 1 0. 0. 1. ECU_ADDRESS 0xd0006409 BIT_MASK 0x2 /end MEASUREMENT
/begin MEASUREMENT lv_test_req_inj_0 "" UBYTE _CNV_S_2_RANGE______3_CM 1 0. 0. 1. DISPLAY_IDENTIFIER test_eol_inj_0.lv_test_req_x ECU_ADDRESS 0xd0006409 BIT_MASK 0x1 /end MEASUREMENT
/begin MEASUREMENT test_eol_inj_0.lv_adj_out_x "" UBYTE _CNV_S_2_RANGE______3_CM 1 0. 0. 1. ECU_ADDRESS 0xd0006409 BIT_MASK 0x10 /end MEASUREMENT
/begin MEASUREMENT test_eol_inj_0.lv_adj_dec_x "" UBYTE _CNV_S_2_RANGE______3_CM 1 0. 0. 1. ECU_ADDRESS 0xd0006409 BIT_MASK 0x20 /end MEASUREMENT
/begin MEASUREMENT test_eol_inj_0.lv_adj_inc_x "" UBYTE _CNV_S_2_RANGE______3_CM 1 0. 0. 1. ECU_ADDRESS 0xd0006409 BIT_MASK 0x40 /end MEASUREMENT
/begin MEASUREMENT test_eol_inj_0.lv_adj_save_x "" UBYTE _CNV_S_2_RANGE______3_CM 1 0. 0. 1. ECU_ADDRESS 0xd0006409 BIT_MASK 0x80 /end MEASUREMENT
/begin MEASUREMENT lv_test_run_inj_1 "" UBYTE _CNV_S_2_RANGE______3_CM 1 0. 0. 1. DISPLAY_IDENTIFIER test_eol_inj_1.lv_test_run_x ECU_ADDRESS 0xd000640a BIT_MASK 0x8 /end MEASUREMENT
/begin MEASUREMENT lv_test_out_inj_1 "" UBYTE _CNV_S_2_RANGE______3_CM 1 0. 0. 1. DISPLAY_IDENTIFIER test_eol_inj_1.lv_test_out_x ECU_ADDRESS 0xd000640a BIT_MASK 0x4 /end MEASUREMENT
/begin MEASUREMENT test_eol_inj_1.lv_test_out_cus_x "" UBYTE _CNV_S_2_RANGE______3_CM 1 0. 0. 1. ECU_ADDRESS 0xd000640a BIT_MASK 0x2 /end MEASUREMENT
/begin MEASUREMENT lv_test_req_inj_1 "" UBYTE _CNV_S_2_RANGE______3_CM 1 0. 0. 1. DISPLAY_IDENTIFIER test_eol_inj_1.lv_test_req_x ECU_ADDRESS 0xd000640a BIT_MASK 0x1 /end MEASUREMENT
/begin MEASUREMENT test_eol_inj_1.lv_adj_out_x "" UBYTE _CNV_S_2_RANGE______3_CM 1 0. 0. 1. ECU_ADDRESS 0xd000640a BIT_MASK 0x10 /end MEASUREMENT
/begin MEASUREMENT test_eol_inj_1.lv_adj_dec_x "" UBYTE _CNV_S_2_RANGE______3_CM 1 0. 0. 1. ECU_ADDRESS 0xd000640a BIT_MASK 0x20 /end MEASUREMENT
/begin MEASUREMENT test_eol_inj_1.lv_adj_inc_x "" UBYTE _CNV_S_2_RANGE______3_CM 1 0. 0. 1. ECU_ADDRESS 0xd000640a BIT_MASK 0x40 /end MEASUREMENT
/begin MEASUREMENT test_eol_inj_1.lv_adj_save_x "" UBYTE _CNV_S_2_RANGE______3_CM 1 0. 0. 1. ECU_ADDRESS 0xd000640a BIT_MASK 0x80 /end MEASUREMENT
/begin MEASUREMENT lv_test_run_inj_2 "" UBYTE _CNV_S_2_RANGE______3_CM 1 0. 0. 1. DISPLAY_IDENTIFIER test_eol_inj_2.lv_test_run_x ECU_ADDRESS 0xd000640b BIT_MASK 0x8 /end MEASUREMENT
/begin MEASUREMENT lv_test_out_inj_2 "" UBYTE _CNV_S_2_RANGE______3_CM 1 0. 0. 1. DISPLAY_IDENTIFIER test_eol_inj_2.lv_test_out_x ECU_ADDRESS 0xd000640b BIT_MASK 0x4 /end MEASUREMENT
/begin MEASUREMENT test_eol_inj_2.lv_test_out_cus_x "" UBYTE _CNV_S_2_RANGE______3_CM 1 0. 0. 1. ECU_ADDRESS 0xd000640b BIT_MASK 0x2 /end MEASUREMENT
/begin MEASUREMENT lv_test_req_inj_2 "" UBYTE _CNV_S_2_RANGE______3_CM 1 0. 0. 1. DISPLAY_IDENTIFIER test_eol_inj_2.lv_test_req_x ECU_ADDRESS 0xd000640b BIT_MASK 0x1 /end MEASUREMENT
/begin MEASUREMENT test_eol_inj_2.lv_adj_out_x "" UBYTE _CNV_S_2_RANGE______3_CM 1 0. 0. 1. ECU_ADDRESS 0xd000640b BIT_MASK 0x10 /end MEASUREMENT
/begin MEASUREMENT test_eol_inj_2.lv_adj_dec_x "" UBYTE _CNV_S_2_RANGE______3_CM 1 0. 0. 1. ECU_ADDRESS 0xd000640b BIT_MASK 0x20 /end MEASUREMENT
/begin MEASUREMENT test_eol_inj_2.lv_adj_inc_x "" UBYTE _CNV_S_2_RANGE______3_CM 1 0. 0. 1. ECU_ADDRESS 0xd000640b BIT_MASK 0x40 /end MEASUREMENT
/begin MEASUREMENT test_eol_inj_2.lv_adj_save_x "" UBYTE _CNV_S_2_RANGE______3_CM 1 0. 0. 1. ECU_ADDRESS 0xd000640b BIT_MASK 0x80 /end MEASUREMENT
/begin MEASUREMENT lv_test_run_inj_3 "" UBYTE _CNV_S_2_RANGE______3_CM 1 0. 0. 1. DISPLAY_IDENTIFIER test_eol_inj_3.lv_test_run_x ECU_ADDRESS 0xd000640c BIT_MASK 0x8 /end MEASUREMENT
/begin MEASUREMENT lv_test_out_inj_3 "" UBYTE _CNV_S_2_RANGE______3_CM 1 0. 0. 1. DISPLAY_IDENTIFIER test_eol_inj_3.lv_test_out_x ECU_ADDRESS 0xd000640c BIT_MASK 0x4 /end MEASUREMENT
/begin MEASUREMENT test_eol_inj_3.lv_test_out_cus_x "" UBYTE _CNV_S_2_RANGE______3_CM 1 0. 0. 1. ECU_ADDRESS 0xd000640c BIT_MASK 0x2 /end MEASUREMENT
/begin MEASUREMENT lv_test_req_inj_3 "" UBYTE _CNV_S_2_RANGE______3_CM 1 0. 0. 1. DISPLAY_IDENTIFIER test_eol_inj_3.lv_test_req_x ECU_ADDRESS 0xd000640c BIT_MASK 0x1 /end MEASUREMENT
/begin MEASUREMENT test_eol_inj_3.lv_adj_out_x "" UBYTE _CNV_S_2_RANGE______3_CM 1 0. 0. 1. ECU_ADDRESS 0xd000640c BIT_MASK 0x10 /end MEASUREMENT
/begin MEASUREMENT test_eol_inj_3.lv_adj_dec_x "" UBYTE _CNV_S_2_RANGE______3_CM 1 0. 0. 1. ECU_ADDRESS 0xd000640c BIT_MASK 0x20 /end MEASUREMENT
/begin MEASUREMENT test_eol_inj_3.lv_adj_inc_x "" UBYTE _CNV_S_2_RANGE______3_CM 1 0. 0. 1. ECU_ADDRESS 0xd000640c BIT_MASK 0x40 /end MEASUREMENT
/begin MEASUREMENT test_eol_inj_3.lv_adj_save_x "" UBYTE _CNV_S_2_RANGE______3_CM 1 0. 0. 1. ECU_ADDRESS 0xd000640c BIT_MASK 0x80 /end MEASUREMENT
/begin MEASUREMENT igc_x_ext_adj[0] "Boolean indicating Ignition Actuator tests request" UBYTE _CNV_S_2_RANGE______3_CM 1 0. 0. 1. ECU_ADDRESS 0xd0006402 BIT_MASK 0x1 /end MEASUREMENT
/begin MEASUREMENT igc_x_ext_adj[1] "Boolean indicating Ignition Actuator tests request" UBYTE _CNV_S_2_RANGE______3_CM 1 0. 0. 1. ECU_ADDRESS 0xd0006403 BIT_MASK 0x1 /end MEASUREMENT
/begin MEASUREMENT igc_x_ext_adj[2] "Boolean indicating Ignition Actuator tests request" UBYTE _CNV_S_2_RANGE______3_CM 1 0. 0. 1. ECU_ADDRESS 0xd0006404 BIT_MASK 0x1 /end MEASUREMENT
/begin MEASUREMENT igc_x_ext_adj[3] "Boolean indicating Ignition Actuator tests request" UBYTE _CNV_S_2_RANGE______3_CM 1 0. 0. 1. ECU_ADDRESS 0xd0006405 BIT_MASK 0x1 /end MEASUREMENT
/begin MEASUREMENT lv_cdn_test_eol_ena "booleean that indicates if conditions are set to activate EOL test" UBYTE _CNV_S_2_RANGE______3_CM 1 0. 0. 1. ECU_ADDRESS 0xd0006419 /end MEASUREMENT
/begin MEASUREMENT lv_end_test_req "Exit request for parallel EOL test or unitary test of the actuator x" UBYTE _CNV_S_2_RANGE______3_CM 1 0. 0. 1. ECU_ADDRESS 0xd000641c /end MEASUREMENT
/begin MEASUREMENT lv_eol_act "Flag for end of line test active" UBYTE _CNV_S_2_RANGE______3_CM 1 0. 0. 1. ECU_ADDRESS 0xd000641e /end MEASUREMENT
/begin MEASUREMENT lv_igc_x_ext_adj[0] "Boolean indicating Ignition Actuator tests request" UBYTE _CNV_S_2_RANGE______3_CM 1 0. 0. 1. ECU_ADDRESS 0xd00063fe BIT_MASK 0x1 /end MEASUREMENT
/begin MEASUREMENT lv_igc_x_ext_adj[1] "Boolean indicating Ignition Actuator tests request" UBYTE _CNV_S_2_RANGE______3_CM 1 0. 0. 1. ECU_ADDRESS 0xd00063ff BIT_MASK 0x1 /end MEASUREMENT
/begin MEASUREMENT lv_igc_x_ext_adj[2] "Boolean indicating Ignition Actuator tests request" UBYTE _CNV_S_2_RANGE______3_CM 1 0. 0. 1. ECU_ADDRESS 0xd0006400 BIT_MASK 0x1 /end MEASUREMENT
/begin MEASUREMENT lv_igc_x_ext_adj[3] "Boolean indicating Ignition Actuator tests request" UBYTE _CNV_S_2_RANGE______3_CM 1 0. 0. 1. ECU_ADDRESS 0xd0006401 BIT_MASK 0x1 /end MEASUREMENT
/begin MEASUREMENT lv_stop_test_req "Abord request for parallel EOL test or unitary test of the actuator x" UBYTE _CNV_S_2_RANGE______3_CM 1 0. 0. 1. ECU_ADDRESS 0xd000641d /end MEASUREMENT
/begin MEASUREMENT lv_test_out_eol "Flag for parallel test at EOL" UBYTE _CNV_S_2_RANGE______3_CM 1 0. 0. 1. ECU_ADDRESS 0xd000641b /end MEASUREMENT
/begin MEASUREMENT lv_test_out_eol_end "End of the EOL test or end of the unitary test" UBYTE _CNV_S_2_RANGE______3_CM 1 0. 0. 1. ECU_ADDRESS 0xd000641f /end MEASUREMENT
/begin MEASUREMENT test_out_ign_0 "Required command of the IGNition coil 0 during a test sequence" UBYTE _CNV_S_2_RANGE______3_CM 1 0. 0. 1. ECU_ADDRESS 0xd0006411 /end MEASUREMENT
/begin MEASUREMENT test_out_ign_1 "Required command of the IGNition coil 1 during a test sequence" UBYTE _CNV_S_2_RANGE______3_CM 1 0. 0. 1. ECU_ADDRESS 0xd0006412 /end MEASUREMENT
/begin MEASUREMENT test_out_ign_2 "Required command of the IGNition coil 2 during a test sequence" UBYTE _CNV_S_2_RANGE______3_CM 1 0. 0. 1. ECU_ADDRESS 0xd0006413 /end MEASUREMENT
/begin MEASUREMENT test_out_ign_3 "Required command of the IGNition coil 3 during a test sequence" UBYTE _CNV_S_2_RANGE______3_CM 1 0. 0. 1. ECU_ADDRESS 0xd0006414 /end MEASUREMENT
/begin MEASUREMENT test_out_inj_0 "Required command of the INJector 0 during a test sequence" UBYTE _CNV_S_2_RANGE______3_CM 1 0. 0. 1. ECU_ADDRESS 0xd0006415 /end MEASUREMENT
/begin MEASUREMENT test_out_inj_1 "Required command of the INJector 1 during a test sequence" UBYTE _CNV_S_2_RANGE______3_CM 1 0. 0. 1. ECU_ADDRESS 0xd0006416 /end MEASUREMENT
/begin MEASUREMENT test_out_inj_2 "Required command of the INJector 2 during a test sequence" UBYTE _CNV_S_2_RANGE______3_CM 1 0. 0. 1. ECU_ADDRESS 0xd0006417 /end MEASUREMENT
/begin MEASUREMENT test_out_inj_3 "Required command of the INJector 3 during a test sequencee" UBYTE _CNV_S_2_RANGE______3_CM 1 0. 0. 1. ECU_ADDRESS 0xd0006418 /end MEASUREMENT
/begin CHARACTERISTIC c_t_ini_test_ign_0 "Time of the initial period of the test sequence of the IGNition coil 0" VALUE 0xa0020b52 _REC_S1VAL_20_u2 655350. _CNV_A_R_LINEAR_____39_CM 0. 655350. FORMAT "%4.0" /end CHARACTERISTIC
/begin CHARACTERISTIC c_t_ini_test_ign_1 "Time of the initial period of the test sequence of the IGNition coil 1" VALUE 0xa0020b54 _REC_S1VAL_20_u2 655350. _CNV_A_R_LINEAR_____39_CM 0. 655350. FORMAT "%4.0" /end CHARACTERISTIC
/begin CHARACTERISTIC c_t_ini_test_ign_2 "Time of the initial period of the test sequence of the IGNition coil 2" VALUE 0xa0020b56 _REC_S1VAL_20_u2 655350. _CNV_A_R_LINEAR_____39_CM 0. 655350. FORMAT "%4.0" /end CHARACTERISTIC
/begin CHARACTERISTIC c_t_ini_test_ign_3 "Time of the initial period of the test sequence of the IGNition coil 3" VALUE 0xa0020b58 _REC_S1VAL_20_u2 655350. _CNV_A_R_LINEAR_____39_CM 0. 655350. FORMAT "%4.0" /end CHARACTERISTIC
/begin CHARACTERISTIC c_t_ini_test_inj_0 "Time of the initial period of the test sequence of the INJector 0" VALUE 0xa0020b5a _REC_S1VAL_20_u2 655350. _CNV_A_R_LINEAR_____39_CM 0. 655350. FORMAT "%4.0" /end CHARACTERISTIC
/begin CHARACTERISTIC c_t_ini_test_inj_1 "Time of the initial period of the test sequence of the INJector 1" VALUE 0xa0020b5c _REC_S1VAL_20_u2 655350. _CNV_A_R_LINEAR_____39_CM 0. 655350. FORMAT "%4.0" /end CHARACTERISTIC
/begin CHARACTERISTIC c_t_ini_test_inj_2 "Time of the initial period of the test sequence of the INJector 2" VALUE 0xa0020b5e _REC_S1VAL_20_u2 655350. _CNV_A_R_LINEAR_____39_CM 0. 655350. FORMAT "%4.0" /end CHARACTERISTIC
/begin CHARACTERISTIC c_t_ini_test_inj_3 "Time of the initial period of the test sequence of the INJector 3" VALUE 0xa0020b60 _REC_S1VAL_20_u2 655350. _CNV_A_R_LINEAR_____39_CM 0. 655350. FORMAT "%4.0" /end CHARACTERISTIC
/begin CHARACTERISTIC c_t_off_test_ign_0 "Time OFF for the test sequence of the IGNition coil 0" VALUE 0xa0020b62 _REC_S1VAL_20_u2 655350. _CNV_A_R_LINEAR_____39_CM 0. 655350. FORMAT "%4.0" /end CHARACTERISTIC
/begin CHARACTERISTIC c_t_off_test_ign_1 "Time OFF for the test sequence of the IGNition coil 1" VALUE 0xa0020b64 _REC_S1VAL_20_u2 655350. _CNV_A_R_LINEAR_____39_CM 0. 655350. FORMAT "%4.0" /end CHARACTERISTIC
/begin CHARACTERISTIC c_t_off_test_ign_2 "Time OFF for the test sequence of the IGNition coil 2" VALUE 0xa0020b66 _REC_S1VAL_20_u2 655350. _CNV_A_R_LINEAR_____39_CM 0. 655350. FORMAT "%4.0" /end CHARACTERISTIC
/begin CHARACTERISTIC c_t_off_test_ign_3 "Time OFF for the test sequence of the IGNition coil 3" VALUE 0xa0020b68 _REC_S1VAL_20_u2 655350. _CNV_A_R_LINEAR_____39_CM 0. 655350. FORMAT "%4.0" /end CHARACTERISTIC
/begin CHARACTERISTIC c_t_off_test_inj_0 "Time OFF for the test sequence of the INJector 0" VALUE 0xa0020b6a _REC_S1VAL_20_u2 655350. _CNV_A_R_LINEAR_____39_CM 0. 655350. FORMAT "%4.0" /end CHARACTERISTIC
/begin CHARACTERISTIC c_t_off_test_inj_1 "Time OFF for the test sequence of the INJector 1" VALUE 0xa0020b6c _REC_S1VAL_20_u2 655350. _CNV_A_R_LINEAR_____39_CM 0. 655350. FORMAT "%4.0" /end CHARACTERISTIC
/begin CHARACTERISTIC c_t_off_test_inj_2 "Time OFF for the test sequence of the INJector 2" VALUE 0xa0020b6e _REC_S1VAL_20_u2 655350. _CNV_A_R_LINEAR_____39_CM 0. 655350. FORMAT "%4.0" /end CHARACTERISTIC
/begin CHARACTERISTIC c_t_off_test_inj_3 "Time OFF for the test sequence of the INJector 3" VALUE 0xa0020b70 _REC_S1VAL_20_u2 655350. _CNV_A_R_LINEAR_____39_CM 0. 655350. FORMAT "%4.0" /end CHARACTERISTIC
/begin CHARACTERISTIC c_t_on_test_ign_0 "Time ON for the test sequence of the IGNition coil 0" VALUE 0xa0020b72 _REC_S1VAL_20_u2 655350. _CNV_A_R_LINEAR_____39_CM 0. 655350. FORMAT "%4.0" /end CHARACTERISTIC
/begin CHARACTERISTIC c_t_on_test_ign_1 "Time ON for the test sequence of the IGNition coil 1" VALUE 0xa0020b74 _REC_S1VAL_20_u2 655350. _CNV_A_R_LINEAR_____39_CM 0. 655350. FORMAT "%4.0" /end CHARACTERISTIC
/begin CHARACTERISTIC c_t_on_test_ign_2 "Time ON for the test sequence of the IGNition coil 2" VALUE 0xa0020b76 _REC_S1VAL_20_u2 655350. _CNV_A_R_LINEAR_____39_CM 0. 655350. FORMAT "%4.0" /end CHARACTERISTIC
/begin CHARACTERISTIC c_t_on_test_ign_3 "Time ON for the test sequence of the IGNition coil 3" VALUE 0xa0020b78 _REC_S1VAL_20_u2 655350. _CNV_A_R_LINEAR_____39_CM 0. 655350. FORMAT "%4.0" /end CHARACTERISTIC
/begin CHARACTERISTIC c_t_on_test_inj_0 "Time ON for the test sequence of the INJector 0" VALUE 0xa0020b7a _REC_S1VAL_20_u2 655350. _CNV_A_R_LINEAR_____39_CM 0. 655350. FORMAT "%4.0" /end CHARACTERISTIC
/begin CHARACTERISTIC c_t_on_test_inj_1 "Time ON for the test sequence of the INJector 1" VALUE 0xa0020b7c _REC_S1VAL_20_u2 655350. _CNV_A_R_LINEAR_____39_CM 0. 655350. FORMAT "%4.0" /end CHARACTERISTIC
/begin CHARACTERISTIC c_t_on_test_inj_2 "Time ON for the test sequence of the INJector 2" VALUE 0xa0020b7e _REC_S1VAL_20_u2 655350. _CNV_A_R_LINEAR_____39_CM 0. 655350. FORMAT "%4.0" /end CHARACTERISTIC
/begin CHARACTERISTIC c_t_on_test_inj_3 "Time ON for the test sequence of the INJector 3" VALUE 0xa0020b80 _REC_S1VAL_20_u2 655350. _CNV_A_R_LINEAR_____39_CM 0. 655350. FORMAT "%4.0" /end CHARACTERISTIC
/begin CHARACTERISTIC c_test_out_cyc_ign_0 "Number of test cycle for the IGNition coil 0" VALUE 0xa0020b82 _REC_S1VAL_20_u1 255. _CNV_A_R_ECME_LINEA_0_CM 0. 255. FORMAT "%3.0" /end CHARACTERISTIC
/begin CHARACTERISTIC c_test_out_cyc_ign_1 "Number of test cycle for the IGNition coil 1" VALUE 0xa0020b83 _REC_S1VAL_20_u1 255. _CNV_A_R_ECME_LINEA_0_CM 0. 255. FORMAT "%3.0" /end CHARACTERISTIC
/begin CHARACTERISTIC c_test_out_cyc_ign_2 "Number of test cycle for the IGNition coil 2" VALUE 0xa0020b84 _REC_S1VAL_20_u1 255. _CNV_A_R_ECME_LINEA_0_CM 0. 255. FORMAT "%3.0" /end CHARACTERISTIC
/begin CHARACTERISTIC c_test_out_cyc_ign_3 "Number of test cycle for the IGNition coil 3" VALUE 0xa0020b85 _REC_S1VAL_20_u1 255. _CNV_A_R_ECME_LINEA_0_CM 0. 255. FORMAT "%3.0" /end CHARACTERISTIC
/begin CHARACTERISTIC c_test_out_cyc_inj_0 "Number of test cycle for the INJector 0" VALUE 0xa0020b86 _REC_S1VAL_20_u1 255. _CNV_A_R_ECME_LINEA_0_CM 0. 255. FORMAT "%3.0" /end CHARACTERISTIC
/begin CHARACTERISTIC c_test_out_cyc_inj_1 "Number of test cycle for the INJector 1" VALUE 0xa0020b87 _REC_S1VAL_20_u1 255. _CNV_A_R_ECME_LINEA_0_CM 0. 255. FORMAT "%3.0" /end CHARACTERISTIC
/begin CHARACTERISTIC c_test_out_cyc_inj_2 "Number of test cycle for the INJector 2" VALUE 0xa0020b88 _REC_S1VAL_20_u1 255. _CNV_A_R_ECME_LINEA_0_CM 0. 255. FORMAT "%3.0" /end CHARACTERISTIC
/begin CHARACTERISTIC c_test_out_cyc_inj_3 "Number of test cycle for the INJector 3" VALUE 0xa0020b89 _REC_S1VAL_20_u1 255. _CNV_A_R_ECME_LINEA_0_CM 0. 255. FORMAT "%3.0" /end CHARACTERISTIC
/begin CHARACTERISTIC c_vs_eol_diag_max "Maximum VS to authorize self test" VALUE 0xa0020b8a _REC_S1VAL_20_u1 255. _CNV_A_R_LINEAR_____71_CM 0. 255. FORMAT "%3.0" /end CHARACTERISTIC
/begin CHARACTERISTIC lc_test_out_eol_ign_0 "Authorisation of the EOL test for the IGNition coil 0" VALUE 0xa0020b8b _REC_S1VAL_20_u1 1. _CNV_A_R_ECME_LINEA_0_CM 0. 1. FORMAT "%1.0" /end CHARACTERISTIC
/begin CHARACTERISTIC lc_test_out_eol_ign_1 "Authorisation of the EOL test for the IGNition coil 1" VALUE 0xa0020b8c _REC_S1VAL_20_u1 1. _CNV_A_R_ECME_LINEA_0_CM 0. 1. FORMAT "%1.0" /end CHARACTERISTIC
/begin CHARACTERISTIC lc_test_out_eol_ign_2 "Authorisation of the EOL test for the IGNition coil 2" VALUE 0xa0020b8d _REC_S1VAL_20_u1 1. _CNV_A_R_ECME_LINEA_0_CM 0. 1. FORMAT "%1.0" /end CHARACTERISTIC
/begin CHARACTERISTIC lc_test_out_eol_ign_3 "Authorisation of the EOL test for the IGNition coil 3" VALUE 0xa0020b8e _REC_S1VAL_20_u1 1. _CNV_A_R_ECME_LINEA_0_CM 0. 1. FORMAT "%1.0" /end CHARACTERISTIC
/begin CHARACTERISTIC lc_test_out_eol_inj_0 "Authorisation of the EOL test for the INJector 0" VALUE 0xa0020b8f _REC_S1VAL_20_u1 1. _CNV_A_R_ECME_LINEA_0_CM 0. 1. FORMAT "%1.0" /end CHARACTERISTIC
/begin CHARACTERISTIC lc_test_out_eol_inj_1 "Authorisation of the EOL test for the INJector 1" VALUE 0xa0020b90 _REC_S1VAL_20_u1 1. _CNV_A_R_ECME_LINEA_0_CM 0. 1. FORMAT "%1.0" /end CHARACTERISTIC
/begin CHARACTERISTIC lc_test_out_eol_inj_2 "Authorisation of the EOL test for the INJector 2" VALUE 0xa0020b91 _REC_S1VAL_20_u1 1. _CNV_A_R_ECME_LINEA_0_CM 0. 1. FORMAT "%1.0" /end CHARACTERISTIC
/begin CHARACTERISTIC lc_test_out_eol_inj_3 "Authorisation of the EOL test for the INJector 3" VALUE 0xa0020b92 _REC_S1VAL_20_u1 1. _CNV_A_R_ECME_LINEA_0_CM 0. 1. FORMAT "%1.0" /end CHARACTERISTIC
/begin MEASUREMENT Vbx_df_ecm_err_itl "ECM performance internal error detected failure" UBYTE _CNV_S_2_RANGE______3_CM 1 0. 0. 1. ECU_ADDRESS 0xd00075e7 BIT_MASK 0x1 /end MEASUREMENT
/begin MEASUREMENT Vbx_df_inj_ecu_itl "Main CPU internal error detected failure" UBYTE _CNV_S_2_RANGE______3_CM 1 0. 0. 1. ECU_ADDRESS 0xd00075e8 BIT_MASK 0x1 /end MEASUREMENT
/begin MEASUREMENT Vbx_diag_ena_ecm_err_itl "ECM performance internal error diagnosis authorization" UBYTE _CNV_S_2_RANGE______3_CM 1 0. 0. 1. ECU_ADDRESS 0xd00075e9 BIT_MASK 0x1 /end MEASUREMENT
/begin MEASUREMENT Vbx_diag_ena_inj_ecu_itl "Main CPU internal error diagnosis authorization" UBYTE _CNV_S_2_RANGE______3_CM 1 0. 0. 1. ECU_ADDRESS 0xd00075ea BIT_MASK 0x1 /end MEASUREMENT
/begin MEASUREMENT Vsx_inj_ecu_vld "Engine control ECU validity status" UBYTE _CNV_S_8_STATUS_OK__234_CM 1 0. 0. 7. ECU_ADDRESS 0xd00075eb /end MEASUREMENT
/begin MEASUREMENT Vsx_inj_ecu_vld_1 "Engine control ECU validity status" UBYTE _CNV_S_8_STATUS_OK__234_CM 1 0. 0. 7. ECU_ADDRESS 0xd00075ec /end MEASUREMENT
/begin MEASUREMENT Vsx_inj_ecu_vld_init "Engine control ECU validity status" UBYTE _CNV_S_8_STATUS_OK__234_CM 1 0. 0. 7. ECU_ADDRESS 0xd00075ed /end MEASUREMENT
/begin CHARACTERISTIC Cxx_dfdec_ecm_err_itl "ECM performance internal error detected failure counter decrement" VALUE 0xa0020724 _REC_S1VAL_20_u2 65535. _CNV_A_R_ECME_LINEA_0_CM 0. 65535. FORMAT "%5.0" /end CHARACTERISTIC
/begin CHARACTERISTIC Cxx_dfdec_inj_ecu_itl "Main CPU internal error detected failure counter decrement" VALUE 0xa0020726 _REC_S1VAL_20_u2 65535. _CNV_A_R_ECME_LINEA_0_CM 0. 65535. FORMAT "%5.0" /end CHARACTERISTIC
/begin CHARACTERISTIC Cxx_dfinc_ecm_err_itl "ECM performance internal error detected failure counter increment" VALUE 0xa0020728 _REC_S1VAL_20_u2 65535. _CNV_A_R_ECME_LINEA_0_CM 0. 65535. FORMAT "%5.0" /end CHARACTERISTIC
/begin CHARACTERISTIC Cxx_dfinc_inj_ecu_itl "Main CPU internal error detected failure counter increment" VALUE 0xa002072a _REC_S1VAL_20_u2 65535. _CNV_A_R_ECME_LINEA_0_CM 0. 65535. FORMAT "%5.0" /end CHARACTERISTIC
/begin MEASUREMENT Vbx_df_ecm_adc_tron "Engine Control Module Analogic / Numeric Convertor failure detected failure" UBYTE _CNV_S_2_RANGE______3_CM 1 0. 0. 1. ECU_ADDRESS 0xd00075ee BIT_MASK 0x1 /end MEASUREMENT
/begin MEASUREMENT Vbx_df_ecm_mon_secu_1 "Internal Control Module Monitoring Processor Performance Safety case 1 detected failure" UBYTE _CNV_S_2_RANGE______3_CM 1 0. 0. 1. ECU_ADDRESS 0xd00075ef BIT_MASK 0x1 /end MEASUREMENT
/begin MEASUREMENT Vbx_df_ecm_mon_secu_2 "Internal Control Module Monitoring Processor Performance Safety case 2 detected failure" UBYTE _CNV_S_2_RANGE______3_CM 1 0. 0. 1. ECU_ADDRESS 0xd00075f0 BIT_MASK 0x1 /end MEASUREMENT
/begin MEASUREMENT Vbx_df_ecm_mon_tron "Internal Control Module Monitoring Processor Performance Internal Circuit failure detected failure" UBYTE _CNV_S_2_RANGE______3_CM 1 0. 0. 1. ECU_ADDRESS 0xd00075f1 BIT_MASK 0x1 /end MEASUREMENT
/begin MEASUREMENT Vbx_df_vb_clc_chr "System Voltage Algorithm Based Calculation Failure detected failure" UBYTE _CNV_S_2_RANGE______3_CM 1 0. 0. 1. ECU_ADDRESS 0xd000623e BIT_MASK 0x1 /end MEASUREMENT
/begin MEASUREMENT Vsx_ecm_mon_vld "Internal Control Module Monitoring Processor Performance validity status" UBYTE _CNV_S_8_STATUS_OK__234_CM 1 0. 0. 7. ECU_ADDRESS 0xd000623f /end MEASUREMENT
/begin CHARACTERISTIC Cxx_dfdec_ecm_adc_tron "a_dg_ecu_sft_sfthwfm/Engine control module Analogic / Numeric Converter failure detected failure counter decrement" VALUE 0xa002072c _REC_S1VAL_20_u2 65535. _CNV_A_R_ECME_LINEA_0_CM 0. 65535. FORMAT "%5.0" /end CHARACTERISTIC
/begin CHARACTERISTIC Cxx_dfdec_ecm_mon_secu_1 "a_dg_ecu_sft_sfthwfm/Internal Control Module Monitoring Processor Performance Safety Case 1 detected failure counter decrement" VALUE 0xa002072e _REC_S1VAL_20_u2 65535. _CNV_A_R_ECME_LINEA_0_CM 0. 65535. FORMAT "%5.0" /end CHARACTERISTIC
/begin CHARACTERISTIC Cxx_dfdec_ecm_mon_secu_2 "a_dg_ecu_sft_sfthwfm/Internal Control Module Monitoring Processor Performance Safety Case 2 detected failure counter decrement" VALUE 0xa0020730 _REC_S1VAL_20_u2 65535. _CNV_A_R_ECME_LINEA_0_CM 0. 65535. FORMAT "%5.0" /end CHARACTERISTIC
/begin CHARACTERISTIC Cxx_dfdec_ecm_mon_tron "a_dg_ecu_sft_sfthwfm/Internal Control Module Monitoring Processor Performance Internal Circuit Failure detected failure counter decrement" VALUE 0xa0020732 _REC_S1VAL_20_u2 65535. _CNV_A_R_ECME_LINEA_0_CM 0. 65535. FORMAT "%5.0" /end CHARACTERISTIC
/begin CHARACTERISTIC Cxx_dfdec_vb_clc_chr "a_dg_ecu_sft_sfthwfm/System Voltage Algorithm Based Calculation Failure detected failure counter decrement" VALUE 0xa0020734 _REC_S1VAL_20_u2 65535. _CNV_A_R_ECME_LINEA_0_CM 0. 65535. FORMAT "%5.0" /end CHARACTERISTIC
/begin CHARACTERISTIC Cxx_dfinc_ecm_adc_tron "a_dg_ecu_sft_sfthwfm/Engine control module Analogic / Numeric Converter failure detected failure counter increment" VALUE 0xa0020736 _REC_S1VAL_20_u2 65535. _CNV_A_R_ECME_LINEA_0_CM 0. 65535. FORMAT "%5.0" /end CHARACTERISTIC
/begin CHARACTERISTIC Cxx_dfinc_ecm_mon_secu_1 "a_dg_ecu_sft_sfthwfm/Internal Control Module Monitoring Processor Performance Safety Case 1 detected failure counter increment" VALUE 0xa0020738 _REC_S1VAL_20_u2 65535. _CNV_A_R_ECME_LINEA_0_CM 0. 65535. FORMAT "%5.0" /end CHARACTERISTIC
/begin CHARACTERISTIC Cxx_dfinc_ecm_mon_secu_2 "a_dg_ecu_sft_sfthwfm/Internal Control Module Monitoring Processor Performance Safety Case 2 detected failure counter increment" VALUE 0xa002073a _REC_S1VAL_20_u2 65535. _CNV_A_R_ECME_LINEA_0_CM 0. 65535. FORMAT "%5.0" /end CHARACTERISTIC
/begin CHARACTERISTIC Cxx_dfinc_ecm_mon_tron "a_dg_ecu_sft_sfthwfm/Internal Control Module Monitoring Processor Performance Internal Circuit Failure detected failure counter increment" VALUE 0xa002073c _REC_S1VAL_20_u2 65535. _CNV_A_R_ECME_LINEA_0_CM 0. 65535. FORMAT "%5.0" /end CHARACTERISTIC
/begin CHARACTERISTIC Cxx_dfinc_vb_clc_chr "a_dg_ecu_sft_sfthwfm/System Voltage Algorithm Based Calculation Failure detected failure counter increment" VALUE 0xa002073e _REC_S1VAL_20_u2 65535. _CNV_A_R_ECME_LINEA_0_CM 0. 65535. FORMAT "%5.0" /end CHARACTERISTIC
/begin AXIS_PTS Ctb_owe_alco_rat "\"Ctp_owe_alco_rat\"_breakpoints" 0xa0036f30 Vxx_alco_rat _REC_A2AXS_20_u2 100. _CNV_R_R_RB_CONV_10_553_CM 8 0. 100. FORMAT "%23.17" /end AXIS_PTS
/begin AXIS_PTS Ctb_owe_oil_dil "Ctp_owe_dil _breakpoints" 0xa0036e9c Vxx_oil_dil _REC_A2AXS_20_u2 100. _CNV_R_R_RB_CONV_10_553_CM 8 0. 100. FORMAT "%6.6" /end AXIS_PTS
/begin AXIS_PTS Ctb_owe_toil "Ctp_owe_toil breakpoints" 0xa0036eb0 Vxx_toil _REC_A2AXS_20_u2 240. _CNV_R_R_RB_CONV_De_554_CM 8 -40. 200. FORMAT "%8.2" /end AXIS_PTS
/begin AXIS_PTS Ctb_owe_toil_fac "Ctp_owe_toil_fac  breakpoints" 0xa0036ec4 Vxx_owe_toil_tco _REC_A2AXS_20_u2 240. _CNV_R_R_RB_CONV_De_554_CM 8 -40. 200. FORMAT "%8.2" /end AXIS_PTS
/begin AXIS_PTS Ctb_owe_toil_off "Cmp_owe_toil_prev_crkg  X breakpoints" 0xa0036ed8 Vxx_owe_toil_eng_off_prev _REC_A2AXS_20_u2 240. _CNV_R_R_RB_CONV_De_554_CM 8 -40. 200. FORMAT "%8.2" /end AXIS_PTS
/begin AXIS_PTS Ctb_owe_toil_sta "Cmp_owe_toil_prev_crkg  Y breakpoints" 0xa0036eec Vxx_owe_toil_sta _REC_A2AXS_20_u2 240. _CNV_R_R_RB_CONV_De_554_CM 8 -40. 200. FORMAT "%8.2" /end AXIS_PTS
/begin MEASUREMENT Vbx_owe_ini_0 "Type of initialisation when the state of the counter is  0" UBYTE _CNV_R_R_VA_I_16_503_CM 1 0. 0. 1. DISPLAY_IDENTIFIER ClLubWea_NVM.Vbx_owe_ini_0_NVM ECU_ADDRESS 0xd0003636 FORMAT "%6.2" BIT_MASK 0x1 /end MEASUREMENT
/begin MEASUREMENT Vbx_owe_ini_1 "Type of initialisation when the state of the counter is  1" UBYTE _CNV_R_R_VA_I_16_503_CM 1 0. 0. 1. DISPLAY_IDENTIFIER ClLubWea_NVM.Vbx_owe_ini_1_NVM ECU_ADDRESS 0xd0003637 FORMAT "%6.2" BIT_MASK 0x1 /end MEASUREMENT
/begin MEASUREMENT Vbx_owe_ini_2 "Type of initialisation when the state of the counter is  2" UBYTE _CNV_R_R_VA_I_16_503_CM 1 0. 0. 1. DISPLAY_IDENTIFIER ClLubWea_NVM.Vbx_owe_ini_2_NVM ECU_ADDRESS 0xd0003638 FORMAT "%6.2" BIT_MASK 0x1 /end MEASUREMENT
/begin MEASUREMENT Vbx_owe_ini_3 "Type of initialisation when the state of the counter is  3" UBYTE _CNV_R_R_VA_I_16_503_CM 1 0. 0. 1. DISPLAY_IDENTIFIER ClLubWea_NVM.Vbx_owe_ini_3_NVM ECU_ADDRESS 0xd0003639 FORMAT "%6.2" BIT_MASK 0x1 /end MEASUREMENT
/begin MEASUREMENT Vbx_owe_ini_prev "State of the previous initialisation of the strategy (0 = after sales department)" UBYTE _CNV_R_R_VA_I_16_503_CM 1 0. 0. 1. DISPLAY_IDENTIFIER ClLubWea_NVM.Vbx_owe_ini_prev_NVM ECU_ADDRESS 0xd000363a FORMAT "%6.2" BIT_MASK 0x1 /end MEASUREMENT
/begin MEASUREMENT Vsx_owe_act_zon "Actual geographical zon" UBYTE _CNV_R_R_VA_I_16_503_CM 1 0. 1. 5. DISPLAY_IDENTIFIER ClLubWea_NVM.Vsx_owe_act_zon_NVM ECU_ADDRESS 0xd0003635 FORMAT "%6.2" /end MEASUREMENT
/begin MEASUREMENT Vxx_oil_dil_raw "Current oil dilution rate" ULONG _CNV_R_R_RB_CONV_00_555_CM 1 0. 0. 100. DISPLAY_IDENTIFIER ClLubWea_NVM.Vxx_oil_dil_raw_NVM ECU_ADDRESS 0xd0003614 FORMAT "%10.10" /end MEASUREMENT
/begin MEASUREMENT Vxx_oil_dil_rij "Current normal mode oil dilution rate" ULONG _CNV_R_R_RB_CONV_00_556_CM 1 0. 0. 42.94 DISPLAY_IDENTIFIER ClLubWea_NVM.Vxx_oil_dil_rij_NVM ECU_ADDRESS 0xd0003618 FORMAT "%10.10" /end MEASUREMENT
/begin MEASUREMENT Vxx_osr "Oil soot rate" ULONG _CNV_R_R_WI_1._6415_557_CM 1 0. 0. 5. DISPLAY_IDENTIFIER ClLubWea_NVM.Vxx_osr_NVM ECU_ADDRESS 0xd000361c FORMAT "%10.0" /end MEASUREMENT
/begin MEASUREMENT Vxx_owe_ctr_stt "Counter state stored on EEPROM" UBYTE _CNV_R_R_VA_I_16_503_CM 1 0. 0. 3. DISPLAY_IDENTIFIER ClLubWea_NVM.Vxx_owe_ctr_stt_NVM ECU_ADDRESS 0xd0003634 FORMAT "%6.2" /end MEASUREMENT
/begin MEASUREMENT Vxx_owe_dil_osr_req_km "Vehilcle kilometers when the alert appears" ULONG _CNV_R_R_RB_CONV_Di_558_CM 1 0. 0. 16777215. DISPLAY_IDENTIFIER ClLubWea_NVM.Vxx_owe_dil_osr_req_km_NVM ECU_ADDRESS 0xd0003624 FORMAT "%8.0" /end MEASUREMENT
/begin MEASUREMENT Vxx_owe_dil_req_km "Total vehicle distance when the oil dilution becomes to high stored on EEPROM" ULONG _CNV_R_R_RB_CONV_Di_558_CM 1 0. 0. 16777215. DISPLAY_IDENTIFIER ClLubWea_NVM.Vxx_owe_dil_req_km_NVM ECU_ADDRESS 0xd00035e8 FORMAT "%12.2" /end MEASUREMENT
/begin MEASUREMENT Vxx_owe_eng_rev_act_sum_0 "Number of engine turns on initialisation when the state of the counter is 0 (on EEPROM)" ULONG _CNV_R_R_RB_CONV_1T_559_CM 1 0. 0. 300000000. DISPLAY_IDENTIFIER ClLubWea_NVM.Vxx_owe_eng_rev_act_sum_0_NVM ECU_ADDRESS 0xd0003600 FORMAT "%12.2" /end MEASUREMENT
/begin MEASUREMENT Vxx_owe_eng_rev_act_sum_1 "Number of engine turns on initialisation when the state of the counter is 1 (on EEPROM)" ULONG _CNV_R_R_RB_CONV_1T_559_CM 1 0. 0. 300000000. DISPLAY_IDENTIFIER ClLubWea_NVM.Vxx_owe_eng_rev_act_sum_1_NVM ECU_ADDRESS 0xd0003604 FORMAT "%12.2" /end MEASUREMENT
/begin MEASUREMENT Vxx_owe_eng_rev_act_sum_2 "Number of engine turns on initialisation when the state of the counter is 2 (on EEPROM)" ULONG _CNV_R_R_RB_CONV_1T_559_CM 1 0. 0. 300000000. DISPLAY_IDENTIFIER ClLubWea_NVM.Vxx_owe_eng_rev_act_sum_2_NVM ECU_ADDRESS 0xd0003608 FORMAT "%12.2" /end MEASUREMENT
/begin MEASUREMENT Vxx_owe_eng_rev_act_sum_3 "Number of engine turns on initialisation when the state of the counter is 3 (on EEPROM)" ULONG _CNV_R_R_RB_CONV_1T_559_CM 1 0. 0. 300000000. DISPLAY_IDENTIFIER ClLubWea_NVM.Vxx_owe_eng_rev_act_sum_3_NVM ECU_ADDRESS 0xd000360c FORMAT "%12.2" /end MEASUREMENT
/begin MEASUREMENT Vxx_owe_eng_rev_prev_sum "Previous engine revolutions sum stored in EEPROM" ULONG _CNV_R_R_RB_CONV_1T_559_CM 1 0. 0. 300000000. DISPLAY_IDENTIFIER ClLubWea_NVM.Vxx_owe_eng_rev_prev_sum_NVM ECU_ADDRESS 0xd0003610 FORMAT "%12.2" /end MEASUREMENT
/begin MEASUREMENT Vxx_owe_km_0 "Number of kilometers travelled on initialisation when the state of the counter is 0 (on EEPROM)" ULONG _CNV_R_R_RB_CONV_Di_558_CM 1 0. 0. 16777215. DISPLAY_IDENTIFIER ClLubWea_NVM.Vxx_owe_km_0_NVM ECU_ADDRESS 0xd00035f0 FORMAT "%12.2" /end MEASUREMENT
/begin MEASUREMENT Vxx_owe_km_1 "Number of kilometers travelled on initialisation when the state of the counter is 1 (on EEPROM)" ULONG _CNV_R_R_RB_CONV_Di_558_CM 1 0. 0. 16777215. DISPLAY_IDENTIFIER ClLubWea_NVM.Vxx_owe_km_1_NVM ECU_ADDRESS 0xd00035f4 FORMAT "%12.2" /end MEASUREMENT
/begin MEASUREMENT Vxx_owe_km_2 "Number of kilometers travelled on initialisation when the state of the counter is  2  (on EEPROM)" ULONG _CNV_R_R_RB_CONV_Di_558_CM 1 0. 0. 16777215. DISPLAY_IDENTIFIER ClLubWea_NVM.Vxx_owe_km_2_NVM ECU_ADDRESS 0xd00035f8 FORMAT "%12.2" /end MEASUREMENT
/begin MEASUREMENT Vxx_owe_km_3 "Number of kilometers travelled on initialisation when the state of the counter is  3  (on EEPROM)" ULONG _CNV_R_R_RB_CONV_Di_558_CM 1 0. 0. 16777215. DISPLAY_IDENTIFIER ClLubWea_NVM.Vxx_owe_km_3_NVM ECU_ADDRESS 0xd00035fc FORMAT "%12.2" /end MEASUREMENT
/begin MEASUREMENT Vxx_owe_osr_req_km "Total vehicle distance when the oil soot becomes to high stored on EEPROM" ULONG _CNV_R_R_RB_CONV_Di_558_CM 1 0. 0. 16777215. DISPLAY_IDENTIFIER ClLubWea_NVM.Vxx_owe_osr_req_km_NVM ECU_ADDRESS 0xd0003620 FORMAT "%8.0" /end MEASUREMENT
/begin MEASUREMENT Vxx_owe_pot_km_0 "Potential kilometer storred when the counter is 0 (on EEPROM)" UWORD _CNV_R_R_VA_I_16_503_CM 1 0. 0. 65535. DISPLAY_IDENTIFIER ClLubWea_NVM.Vxx_owe_pot_km_0_NVM ECU_ADDRESS 0xd000362a FORMAT "%6.2" /end MEASUREMENT
/begin MEASUREMENT Vxx_owe_pot_km_1 "Potential kilometer storred when the counter is 1 (on EEPROM)" UWORD _CNV_R_R_VA_I_16_503_CM 1 0. 0. 65535. DISPLAY_IDENTIFIER ClLubWea_NVM.Vxx_owe_pot_km_1_NVM ECU_ADDRESS 0xd000362c FORMAT "%6.2" /end MEASUREMENT
/begin MEASUREMENT Vxx_owe_pot_km_2 "Potential kilometer storred when the counter is 2 (on EEPROM)" UWORD _CNV_R_R_VA_I_16_503_CM 1 0. 0. 65535. DISPLAY_IDENTIFIER ClLubWea_NVM.Vxx_owe_pot_km_2_NVM ECU_ADDRESS 0xd000362e FORMAT "%6.2" /end MEASUREMENT
/begin MEASUREMENT Vxx_owe_pot_km_3 "Potential kilometer storred when the counter is 3 (on EEPROM)" UWORD _CNV_R_R_VA_I_16_503_CM 1 0. 0. 65535. DISPLAY_IDENTIFIER ClLubWea_NVM.Vxx_owe_pot_km_3_NVM ECU_ADDRESS 0xd0003630 FORMAT "%6.2" /end MEASUREMENT
/begin MEASUREMENT Vxx_owe_prev_ini_km "Vehicle kilometers on the previous oil drain" ULONG _CNV_R_R_RB_CONV_Di_558_CM 1 0. 0. 16777215. DISPLAY_IDENTIFIER ClLubWea_NVM.Vxx_owe_prev_ini_km_NVM ECU_ADDRESS 0xd00035e4 FORMAT "%12.2" /end MEASUREMENT
/begin MEASUREMENT Vxx_owe_toil_eng_off_prev "Oil temperature for oil wear estimation strategy (with saturation) on previous engine off" UWORD _CNV_R_R_RB_CONV_De_554_CM 1 0. -40. 200. DISPLAY_IDENTIFIER ClLubWea_NVM.Vxx_owe_toil_eng_off_prev_NVM ECU_ADDRESS 0xd0003628 FORMAT "%8.2" /end MEASUREMENT
/begin MEASUREMENT Vxx_owe_warn_req_km "Vehilcle kilometers when the pre alert appear" ULONG _CNV_R_R_RB_CONV_Di_558_CM 1 0. 0. 16777215. DISPLAY_IDENTIFIER ClLubWea_NVM.Vxx_owe_warn_req_km_NVM ECU_ADDRESS 0xd00035ec FORMAT "%12.2" /end MEASUREMENT
/begin MEASUREMENT Vxx_pft_oil_dil_max "Maximum oil dilution rate during the calibrated distance" UWORD _CNV_R_R_RB_CONV_10_553_CM 1 0. 0. 100. DISPLAY_IDENTIFIER ClLubWea_NVM.Vxx_pft_oil_dil_max_NVM ECU_ADDRESS 0xd0003632 FORMAT "%6.6" /end MEASUREMENT
/begin CHARACTERISTIC Cmp_owe_toil_prev_sta "This map produce a number of engine turn in function of cranking oil temperature and engine stop" MAP 0xa0036e1c _REC_A1MAP_20_u2_u2_u2 500000. _CNV_R_R_RB_CONV_10_560_CM 0. 500000. FORMAT "%8.3"
 /begin AXIS_DESCR COM_AXIS Vxx_owe_toil_eng_off_prev _CNV_R_R_RB_CONV_De_554_CM 8 -40. 200. FORMAT "%8.2" AXIS_PTS_REF Ctb_owe_toil_off /end AXIS_DESCR
 /begin AXIS_DESCR COM_AXIS Vxx_owe_toil_sta _CNV_R_R_RB_CONV_De_554_CM 8 -40. 200. FORMAT "%8.2" AXIS_PTS_REF Ctb_owe_toil_sta /end AXIS_DESCR
/end CHARACTERISTIC
/begin CHARACTERISTIC Ctp_owe_alco_rat "Alcool effect ratio table" CURVE 0xa0036f44 _REC_A1CUR_20_u2_u2 10. _CNV_R_R_RB_CONV_Re_561_CM 0. 10. FORMAT "%9.3"
 /begin AXIS_DESCR COM_AXIS Vxx_alco_rat _CNV_R_R_RB_CONV_10_553_CM 8 0. 100. FORMAT "%23.17" AXIS_PTS_REF Ctb_owe_alco_rat /end AXIS_DESCR
/end CHARACTERISTIC
/begin CHARACTERISTIC Ctp_owe_dil "Oil dilution effect table" CURVE 0xa0036f00 _REC_A1CUR_20_u2_u2 10. _CNV_R_R_RB_CONV_Re_561_CM 0. 10. FORMAT "%6.4"
 /begin AXIS_DESCR COM_AXIS Vxx_oil_dil _CNV_R_R_RB_CONV_10_553_CM 8 0. 100. FORMAT "%6.6" AXIS_PTS_REF Ctb_owe_oil_dil /end AXIS_DESCR
/end CHARACTERISTIC
/begin CHARACTERISTIC Ctp_owe_toil "PWM to oil temperature conversion table" CURVE 0xa0036f10 _REC_A1CUR_20_u2_u2 240. _CNV_R_R_RB_CONV_De_554_CM -40. 200. FORMAT "%8.2"
 /begin AXIS_DESCR COM_AXIS Vxx_toil _CNV_R_R_RB_CONV_De_554_CM 8 -40. 200. FORMAT "%8.2" AXIS_PTS_REF Ctb_owe_toil /end AXIS_DESCR
/end CHARACTERISTIC
/begin CHARACTERISTIC Ctp_owe_toil_fac "Oil temperature effect table" CURVE 0xa0036f20 _REC_A1CUR_20_u2_u2 10. _CNV_R_R_RB_CONV_Re_561_CM 0. 10. FORMAT "%6.4"
 /begin AXIS_DESCR COM_AXIS Vxx_owe_toil_tco _CNV_R_R_RB_CONV_De_554_CM 8 -40. 200. FORMAT "%8.2" AXIS_PTS_REF Ctb_owe_toil_fac /end AXIS_DESCR
/end CHARACTERISTIC
/begin MEASUREMENT Vbx_owe_eng_aut "Engine in autonomous state" UBYTE _CNV_R_R_VA_I_16_503_CM 1 0. 0. 1. ECU_ADDRESS 0xd0007d01 FORMAT "%6.2" BIT_MASK 0x1 /end MEASUREMENT
/begin MEASUREMENT Vbx_owe_eng_aut_dly "Set when the engine is autonomous and the delay is expired" UBYTE _CNV_R_R_VA_I_16_503_CM 1 0. 0. 1. ECU_ADDRESS 0xd0007d02 FORMAT "%6.2" BIT_MASK 0x1 /end MEASUREMENT
/begin MEASUREMENT Vbx_owe_fac_toil_act "Output of the SR_Flip_Flop" UBYTE _CNV_R_R_VA_I_16_503_CM 1 0. 0. 1. ECU_ADDRESS 0xd0007d03 FORMAT "%6.2" BIT_MASK 0x1 /end MEASUREMENT
/begin MEASUREMENT Vbx_owe_ini_0_trg "Writing trigger for the type of initialisation (asd or not) for EEPROM memorisation" UBYTE _CNV_R_R_VA_I_16_503_CM 1 0. 0. 1. ECU_ADDRESS 0xd0007cf9 FORMAT "%6.2" BIT_MASK 0x1 /end MEASUREMENT
/begin MEASUREMENT Vbx_owe_ini_1_trg "Writing trigger for the type of initialisation (asd or not) for EEPROM memorisation" UBYTE _CNV_R_R_VA_I_16_503_CM 1 0. 0. 1. ECU_ADDRESS 0xd0007cfa FORMAT "%6.2" BIT_MASK 0x1 /end MEASUREMENT
/begin MEASUREMENT Vbx_owe_ini_2_trg "Writing trigger for the type of initialisation (asd or not) for EEPROM memorisation" UBYTE _CNV_R_R_VA_I_16_503_CM 1 0. 0. 1. ECU_ADDRESS 0xd0007cfb FORMAT "%6.2" BIT_MASK 0x1 /end MEASUREMENT
/begin MEASUREMENT Vbx_owe_ini_3_trg "Writing trigger for the type of initialisation (asd or not) for EEPROM memorisation" UBYTE _CNV_R_R_VA_I_16_503_CM 1 0. 0. 1. ECU_ADDRESS 0xd0007cfc FORMAT "%6.2" BIT_MASK 0x1 /end MEASUREMENT
/begin MEASUREMENT Vbx_owe_off "Set if the oil wear estimation is inibited" UBYTE _CNV_R_R_VA_I_16_503_CM 1 0. 0. 1. ECU_ADDRESS 0xd0007cff FORMAT "%6.2" BIT_MASK 0x1 /end MEASUREMENT
/begin MEASUREMENT Vbx_owe_off_not "Set if the oil wear estimation is not inibited" UBYTE _CNV_R_R_VA_I_16_503_CM 1 0. 0. 1. ECU_ADDRESS 0xd0007d04 FORMAT "%1.0" /end MEASUREMENT
/begin MEASUREMENT Vbx_owe_zon_writ "Boolean set when a geographical zon is wroten" UBYTE _CNV_R_R_VA_I_16_503_CM 1 0. 0. 1. ECU_ADDRESS 0xd0007d00 FORMAT "%6.2" BIT_MASK 0x1 /end MEASUREMENT
/begin MEASUREMENT Vsx_osr_vld "Oil soot rate validity status" UBYTE _CNV_S_3_STATUS_OK__412_CM 1 0. 0. 2. ECU_ADDRESS 0xd0007cfe /end MEASUREMENT
/begin MEASUREMENT Vsx_owe_prev_drn_dist_vld "Travelled distance from the last oil drain validity status" UBYTE _CNV_S_2_WI_Vsx_oil_562_CM 1 0. 0. 1. ECU_ADDRESS 0xd0007232 /end MEASUREMENT
/begin MEASUREMENT Vxx_oil_dil "Current oil dilution rate" UWORD _CNV_R_R_RB_CONV_10_553_CM 1 0. 0. 100. ECU_ADDRESS 0xd00060f6 FORMAT "%6.6" /end MEASUREMENT
/begin MEASUREMENT Vxx_osr_cor "Corrected oil soot rate" ULONG _CNV_R_R_WI_1._6415_557_CM 1 0. 0. 5. ECU_ADDRESS 0xd0003644 FORMAT "%10.0" /end MEASUREMENT
/begin MEASUREMENT Vxx_owe_alco_cor "Alcohol ratio factor" UWORD _CNV_R_R_RB_CONV_Re_561_CM 1 0. 0. 10. ECU_ADDRESS 0xd000610e FORMAT "%9.3" /end MEASUREMENT
/begin MEASUREMENT Vxx_owe_cmp_toil "Value of the output of the  CMP_owe_toil_prev_sta" UWORD _CNV_R_R_RB_CONV_10_560_CM 1 0. 0. 500000. ECU_ADDRESS 0xd000610c FORMAT "%8.3" /end MEASUREMENT
/begin MEASUREMENT Vxx_owe_ctp_alco "Value of the output of the \" Ctp_owe_alco_rat\" table" UWORD _CNV_R_R_RB_CONV_Re_561_CM 1 0. 0. 10. ECU_ADDRESS 0xd0006110 FORMAT "%9.3" /end MEASUREMENT
/begin MEASUREMENT Vxx_owe_ctp_dil "Value of the output of the   Ctp_owe_dil  table" UWORD _CNV_R_R_RB_CONV_Re_561_CM 1 0. 0. 10. ECU_ADDRESS 0xd0006104 FORMAT "%6.4" /end MEASUREMENT
/begin MEASUREMENT Vxx_owe_ctp_toil "Value of the output of the   Ctp_owe_toil  table" UWORD _CNV_R_R_RB_CONV_Re_561_CM 1 0. 0. 10. ECU_ADDRESS 0xd0006106 FORMAT "%6.4" /end MEASUREMENT
/begin MEASUREMENT Vxx_owe_eng_rev_act_sum "Actual engine revolution sum for the oil wear estimation strategy" ULONG _CNV_R_R_RB_CONV_1T_559_CM 1 0. 0. 300000000. ECU_ADDRESS 0xd0003658 FORMAT "%12.2" /end MEASUREMENT
/begin MEASUREMENT Vxx_owe_eng_rev_act_sum_mem "Memorized actual engine revolution sum for the oil wear estimation strategy" ULONG _CNV_R_R_RB_CONV_1T_559_CM 1 0. 0. 300000000. ECU_ADDRESS 0xd0003640 FORMAT "%12.2" /end MEASUREMENT
/begin MEASUREMENT Vxx_owe_fac_toil_act "Actual oil temperatrure factor" ULONG _CNV_R_R_RB_CONV_1T_559_CM 1 0. 0. 500000. ECU_ADDRESS 0xd000365c FORMAT "%12.2" /end MEASUREMENT
/begin MEASUREMENT Vxx_owe_fac_toil_tot "Total oil temperature factor" ULONG _CNV_R_R_RB_CONV_1T_559_CM 1 0. 0. 500000. ECU_ADDRESS 0xd0003660 FORMAT "%12.2" /end MEASUREMENT
/begin MEASUREMENT Vxx_owe_ini "Type of initialisation word" UBYTE _CNV_R_R_VA_I_16_503_CM 1 0. 0. 255. ECU_ADDRESS 0xd0007cfd FORMAT "%6.2" /end MEASUREMENT
/begin MEASUREMENT Vxx_owe_km_pot "Potential kilometers" UWORD _CNV_R_R_RB_CONV_Di_558_CM 1 0. 0. 65535. ECU_ADDRESS 0xd00060f8 FORMAT "%12.2" /end MEASUREMENT
/begin MEASUREMENT Vxx_owe_max_drn_km "Maximal travelled kilometer between oil drain" UWORD _CNV_R_R_RB_CONV_Di_558_CM 1 0. 0. 65535. ECU_ADDRESS 0xd00060fa FORMAT "%12.2" /end MEASUREMENT
/begin MEASUREMENT Vxx_owe_min_drn_km "Minimal travelled kilometer between oil drain" UWORD _CNV_R_R_RB_CONV_Di_558_CM 1 0. 0. 20000. ECU_ADDRESS 0xd00060fc FORMAT "%12.2" /end MEASUREMENT
/begin MEASUREMENT Vxx_owe_n_aut "Number engine revolutions per time" ULONG _CNV_R_R_RB_CONV_Re_563_CM 1 0. 0. 20. ECU_ADDRESS 0xd0003664 FORMAT "%6.6" /end MEASUREMENT
/begin MEASUREMENT Vxx_owe_n_mnl_asd "Maximal number of engine revolutions" ULONG _CNV_R_R_RB_CONV_1T_559_CM 1 0. 0. 300000000. ECU_ADDRESS 0xd0003648 FORMAT "%12.2" /end MEASUREMENT
/begin MEASUREMENT Vxx_owe_n_toil_dil_u32 "Actual engine revolution sum (since the last  engine on time)" ULONG _CNV_R_R_RB_CONV_Tr_564_CM 1 0. 0. 109951162. ECU_ADDRESS 0xd0003668 FORMAT "%8.3" /end MEASUREMENT
/begin MEASUREMENT Vxx_owe_prev_drn_dist "Travelled distance from the last oil drain" UWORD _CNV_R_R_RB_CONV_Di_558_CM 1 0. 0. 65535. ECU_ADDRESS 0xd0004bd6 FORMAT "%12.2" /end MEASUREMENT
/begin MEASUREMENT Vxx_owe_toil_sta "Oil temperature for oil wear estimation strategy (with saturation) on engine cranking" UWORD _CNV_R_R_RB_CONV_De_554_CM 1 0. -40. 200. ECU_ADDRESS 0xd0006108 FORMAT "%8.2" /end MEASUREMENT
/begin MEASUREMENT Vxx_owe_toil_tco "Oil temperature for oil wear estimation strategy (with saturation)" UWORD _CNV_R_R_RB_CONV_De_554_CM 1 0. -40. 200. ECU_ADDRESS 0xd000610a FORMAT "%8.2" /end MEASUREMENT
/begin CHARACTERISTIC Cbx_owe_toil_tco "Calibration to choose between Oil and Colant temperature (0 is for oil)" VALUE 0xa00220fc _REC_S1VAL_Normal_u1 1. _CNV_R_R_VA_I_16_503_CM 0. 1. FORMAT "%6.2" /end CHARACTERISTIC
/begin CHARACTERISTIC Cxx_owe_alco_fail_cor "Alcohol factor in case of variable failure" VALUE 0xa00220f8 _REC_S1VAL_Normal_u2 10. _CNV_R_R_RB_CONV_Re_561_CM 0. 10. FORMAT "%9.3" /end CHARACTERISTIC
/begin CHARACTERISTIC Cxx_owe_alco_sta_cor "Alcohol corrective factor at engine start" VALUE 0xa00220fa _REC_S1VAL_Normal_u2 10. _CNV_R_R_RB_CONV_Re_561_CM 0. 10. FORMAT "%9.3" /end CHARACTERISTIC
/begin CHARACTERISTIC Cxx_owe_eng_aut_dly "Delay time before the first value of the engine oil temperature" VALUE 0xa00220f2 _REC_S1VAL_Normal_u2 6553.5 _CNV_R_R_RB_CONV_Ti_565_CM 0. 6553.5 FORMAT "%8.2" /end CHARACTERISTIC
/begin CHARACTERISTIC Cxx_owe_km_pot_1 "Potential kilometer on initialisation for zone 1" VALUE 0xa00220da _REC_S1VAL_Normal_u2 65535. _CNV_R_R_RB_CONV_Di_558_CM 0. 65535. FORMAT "%12.2" /end CHARACTERISTIC
/begin CHARACTERISTIC Cxx_owe_km_pot_2 "Potential kilometer on initialisation for zone 2" VALUE 0xa00220dc _REC_S1VAL_Normal_u2 65535. _CNV_R_R_RB_CONV_Di_558_CM 0. 65535. FORMAT "%12.2" /end CHARACTERISTIC
/begin CHARACTERISTIC Cxx_owe_km_pot_3 "Potential kilometer on initialisation for zone 3" VALUE 0xa00220de _REC_S1VAL_Normal_u2 65535. _CNV_R_R_RB_CONV_Di_558_CM 0. 65535. FORMAT "%12.2" /end CHARACTERISTIC
/begin CHARACTERISTIC Cxx_owe_km_pot_4 "Potential kilometer on initialisation for zone 4" VALUE 0xa00220e0 _REC_S1VAL_Normal_u2 65535. _CNV_R_R_RB_CONV_Di_558_CM 0. 65535. FORMAT "%12.2" /end CHARACTERISTIC
/begin CHARACTERISTIC Cxx_owe_max_drn_km_1 "Calibration to activate the drain request if the travelled distance is to big on zone 1" VALUE 0xa00220e2 _REC_S1VAL_Normal_u2 65535. _CNV_R_R_RB_CONV_Di_558_CM 0. 65535. FORMAT "%12.2" /end CHARACTERISTIC
/begin CHARACTERISTIC Cxx_owe_max_drn_km_2 "Calibration to activate the drain request if the travelled distance is to big on zone 2" VALUE 0xa00220e4 _REC_S1VAL_Normal_u2 65535. _CNV_R_R_RB_CONV_Di_558_CM 0. 65535. FORMAT "%12.2" /end CHARACTERISTIC
/begin CHARACTERISTIC Cxx_owe_max_drn_km_3 "Calibration to activate the drain request if the travelled distance is to big on zone 3" VALUE 0xa00220e6 _REC_S1VAL_Normal_u2 65535. _CNV_R_R_RB_CONV_Di_558_CM 0. 65535. FORMAT "%12.2" /end CHARACTERISTIC
/begin CHARACTERISTIC Cxx_owe_max_drn_km_4 "Calibration to activate the drain request if the travelled distance is to big on zone 4" VALUE 0xa00220e8 _REC_S1VAL_Normal_u2 65535. _CNV_R_R_RB_CONV_Di_558_CM 0. 65535. FORMAT "%12.2" /end CHARACTERISTIC
/begin CHARACTERISTIC Cxx_owe_min_drn_km_1 "Calibration to forbid the drain request if the travelled distance is to small on zone 1" VALUE 0xa00220ea _REC_S1VAL_Normal_u2 20000. _CNV_R_R_RB_CONV_Di_558_CM 0. 20000. FORMAT "%12.2" /end CHARACTERISTIC
/begin CHARACTERISTIC Cxx_owe_min_drn_km_2 "Calibration to forbid the drain request if the travelled distance is to small on zone 2" VALUE 0xa00220ec _REC_S1VAL_Normal_u2 20000. _CNV_R_R_RB_CONV_Di_558_CM 0. 20000. FORMAT "%12.2" /end CHARACTERISTIC
/begin CHARACTERISTIC Cxx_owe_min_drn_km_3 "Calibration to forbid the drain request if the travelled distance is to small on zone 3" VALUE 0xa00220ee _REC_S1VAL_Normal_u2 20000. _CNV_R_R_RB_CONV_Di_558_CM 0. 20000. FORMAT "%12.2" /end CHARACTERISTIC
/begin CHARACTERISTIC Cxx_owe_min_drn_km_4 "Calibration to forbid the drain request if the travelled distance is to small on zone 4" VALUE 0xa00220f0 _REC_S1VAL_Normal_u2 20000. _CNV_R_R_RB_CONV_Di_558_CM 0. 20000. FORMAT "%12.2" /end CHARACTERISTIC
/begin CHARACTERISTIC Cxx_owe_n_mnl_asd_1 "Maximal number of engine revolutions on zone 1" VALUE 0xa00220ca _REC_S1VAL_Normal_u4 300000000. _CNV_R_R_RB_CONV_1T_559_CM 0. 300000000. FORMAT "%12.2" /end CHARACTERISTIC
/begin CHARACTERISTIC Cxx_owe_n_mnl_asd_2 "Maximal number of engine revolutions on zone 2" VALUE 0xa00220ce _REC_S1VAL_Normal_u4 300000000. _CNV_R_R_RB_CONV_1T_559_CM 0. 300000000. FORMAT "%12.2" /end CHARACTERISTIC
/begin CHARACTERISTIC Cxx_owe_n_mnl_asd_3 "Maximal number of engine revolutions on zone 3" VALUE 0xa00220d2 _REC_S1VAL_Normal_u4 300000000. _CNV_R_R_RB_CONV_1T_559_CM 0. 300000000. FORMAT "%12.2" /end CHARACTERISTIC
/begin CHARACTERISTIC Cxx_owe_n_mnl_asd_4 "Maximal number of engine revolutions on zone 4" VALUE 0xa00220d6 _REC_S1VAL_Normal_u4 300000000. _CNV_R_R_RB_CONV_1T_559_CM 0. 300000000. FORMAT "%12.2" /end CHARACTERISTIC
/begin CHARACTERISTIC Cxx_owe_tco_sub "Coolant substitution value in case of failure" VALUE 0xa00220f4 _REC_S1VAL_Normal_u2 240. _CNV_R_R_RB_CONV_De_554_CM -40. 200. FORMAT "%8.2" /end CHARACTERISTIC
/begin CHARACTERISTIC Cxx_owe_toil_sub "Substitute value of oil temperature if the sensor is failed" VALUE 0xa00220f6 _REC_S1VAL_Normal_u2 240. _CNV_R_R_RB_CONV_De_554_CM -40. 200. FORMAT "%8.2" /end CHARACTERISTIC
/begin MEASUREMENT Vbx_owe_dil_req_km_2_clc "Boolean set if the oil dilution threshold is passed" UBYTE _CNV_R_R_VA_I_16_503_CM 1 0. 0. 1. DISPLAY_IDENTIFIER OuCloLuo_NVM.Vbx_owe_dil_req_km_2_clc_NVM ECU_ADDRESS 0xd0003688 FORMAT "%6.2" BIT_MASK 0x1 /end MEASUREMENT
/begin MEASUREMENT Vbx_owe_oil_drn_req_2 "Oil drain requested by the strategy (level 2)" UBYTE _CNV_R_R_VA_I_16_503_CM 1 0. 0. 1. DISPLAY_IDENTIFIER OuCloLuo_NVM.Vbx_owe_oil_drn_req_2_NVM ECU_ADDRESS 0xd0003689 FORMAT "%6.2" BIT_MASK 0x1 /end MEASUREMENT
/begin MEASUREMENT Vbx_owe_oil_drn_req "Oil drain requested by the strategy" UBYTE _CNV_R_R_VA_I_16_503_CM 1 0. 0. 1. DISPLAY_IDENTIFIER OuCloLuo_NVM.Vbx_owe_oil_drn_req_NVM ECU_ADDRESS 0xd000368a FORMAT "%6.2" BIT_MASK 0x1 /end MEASUREMENT
/begin MEASUREMENT Vbx_owe_warn_req_km_mem "Vehicle kilometers memorisation trigger before rising edge" UBYTE _CNV_R_R_VA_I_16_503_CM 1 0. 0. 1. DISPLAY_IDENTIFIER OuCloLuo_NVM.Vbx_owe_warn_req_km_mem_NVM ECU_ADDRESS 0xd000368b FORMAT "%6.2" BIT_MASK 0x1 /end MEASUREMENT
/begin MEASUREMENT Vxx_owe_dil "Current oil dilution rate for oil wear estimation" UWORD _CNV_R_R_RB_CONV_10_553_CM 1 0. 0. 100. DISPLAY_IDENTIFIER OuCloLuo_NVM.Vxx_owe_dil_NVM ECU_ADDRESS 0xd000367c FORMAT "%6.4" /end MEASUREMENT
/begin MEASUREMENT Vxx_owe_km1 "Oil kilometer value for the first reference point" UWORD _CNV_R_R_RB_CONV_Di_558_CM 1 0. 0. 65535. DISPLAY_IDENTIFIER OuCloLuo_NVM.Vxx_owe_km1_NVM ECU_ADDRESS 0xd0003674 FORMAT "%12.2" /end MEASUREMENT
/begin MEASUREMENT Vxx_owe_km1_dil "Oil kilometer value for the first reference point for dilution potential kilometer calculation" UWORD _CNV_R_R_RB_CONV_Di_558_CM 1 0. 0. 65535. DISPLAY_IDENTIFIER OuCloLuo_NVM.Vxx_owe_km1_dil_NVM ECU_ADDRESS 0xd0003686 FORMAT "%12.2" /end MEASUREMENT
/begin MEASUREMENT Vxx_owe_km2 "Oil kilometer value for the second reference point" UWORD _CNV_R_R_RB_CONV_Di_558_CM 1 0. 0. 65535. DISPLAY_IDENTIFIER OuCloLuo_NVM.Vxx_owe_km2_NVM ECU_ADDRESS 0xd0003678 FORMAT "%12.2" /end MEASUREMENT
/begin MEASUREMENT Vxx_owe_km2_dil "Oil kilometer value for the second reference point for dilution potential kilometer calculation" UWORD _CNV_R_R_RB_CONV_Di_558_CM 1 0. 0. 65535. DISPLAY_IDENTIFIER OuCloLuo_NVM.Vxx_owe_km2_dil_NVM ECU_ADDRESS 0xd000367e FORMAT "%12.2" /end MEASUREMENT
/begin MEASUREMENT Vxx_owe_oxy_dil_fac_raw "Interpolation raw factor" UWORD _CNV_R_R_RB_CONV_1__273_CM 1 0. 0. 1. DISPLAY_IDENTIFIER OuCloLuo_NVM.Vxx_owe_oxy_dil_fac_raw_NVM ECU_ADDRESS 0xd0003684 FORMAT "%6.6" /end MEASUREMENT
/begin MEASUREMENT Vxx_owe_pot_km_pot "Oil potential meters" ULONG _CNV_R_R_RB_CONV_di_566_CM 1 0. 0. 65535000. DISPLAY_IDENTIFIER OuCloLuo_NVM.Vxx_owe_pot_km_pot_NVM ECU_ADDRESS 0xd000366c FORMAT "%12.2" /end MEASUREMENT
/begin MEASUREMENT Vxx_owe_pot_km_rnd_dil "Rounded oil dilution potential meters" ULONG _CNV_R_R_RB_CONV_di_566_CM 1 0. 0. 65535000. DISPLAY_IDENTIFIER OuCloLuo_NVM.Vxx_owe_pot_km_rnd_dil_NVM ECU_ADDRESS 0xd0003670 FORMAT "%12.2" /end MEASUREMENT
/begin MEASUREMENT Vxx_owe_wea1 "Oil wear when the first point is learned" UWORD _CNV_R_R_RB_CONV_1__273_CM 1 0. 0. 1. DISPLAY_IDENTIFIER OuCloLuo_NVM.Vxx_owe_wea1_NVM ECU_ADDRESS 0xd0003676 FORMAT "%6.6" /end MEASUREMENT
/begin MEASUREMENT Vxx_owe_wea1_dil "Oil dilution wear when the first point is learned" UWORD _CNV_R_R_RB_CONV_1__273_CM 1 0. 0. 1. DISPLAY_IDENTIFIER OuCloLuo_NVM.Vxx_owe_wea1_dil_NVM ECU_ADDRESS 0xd0003682 FORMAT "%6.6" /end MEASUREMENT
/begin MEASUREMENT Vxx_owe_wea2 "Oil wear when the second point is learned" UWORD _CNV_R_R_RB_CONV_1__273_CM 1 0. 0. 1. DISPLAY_IDENTIFIER OuCloLuo_NVM.Vxx_owe_wea2_NVM ECU_ADDRESS 0xd000367a FORMAT "%6.6" /end MEASUREMENT
/begin MEASUREMENT Vxx_owe_wea2_dil "Oil dilution wear when the second point is learned" UWORD _CNV_R_R_RB_CONV_1__273_CM 1 0. 0. 1. DISPLAY_IDENTIFIER OuCloLuo_NVM.Vxx_owe_wea2_dil_NVM ECU_ADDRESS 0xd0003680 FORMAT "%6.6" /end MEASUREMENT
/begin MEASUREMENT Vbx_oil_heat_abst_pres_cho "Presence of oil heater vapours conf choice" UBYTE _CNV_R_R_VA_I_16_503_CM 1 0. 0. 1. ECU_ADDRESS 0xd0007d3d FORMAT "%6.2" BIT_MASK 0x1 /end MEASUREMENT
/begin MEASUREMENT Vbx_owe_dil_req_km "This bit is set if the oil dilution level is higher than  Cxx_owe_oil_dil_thd" UBYTE _CNV_R_R_VA_I_16_503_CM 1 0. 0. 1. ECU_ADDRESS 0xd0007d19 FORMAT "%6.2" BIT_MASK 0x1 /end MEASUREMENT
/begin MEASUREMENT Vbx_owe_dil_req_km_1_clc "Boolean set if the oil dilution threshold is passed" UBYTE _CNV_R_R_VA_I_16_503_CM 1 0. 0. 1. ECU_ADDRESS 0xd0007d35 FORMAT "%6.2" BIT_MASK 0x1 /end MEASUREMENT
/begin MEASUREMENT Vbx_owe_drn_req "Oil drain requested" UBYTE _CNV_R_R_VA_I_16_503_CM 1 0. 0. 1. ECU_ADDRESS 0xd0007d31 FORMAT "%6.2" BIT_MASK 0x1 /end MEASUREMENT
/begin MEASUREMENT Vbx_owe_drn_req_ok_2 "Equivalent to  Vbx_owe_drn_req_ok_1   plus the initialisation request condition" UBYTE _CNV_R_R_VA_I_16_503_CM 1 0. 0. 1. ECU_ADDRESS 0xd0007d32 FORMAT "%6.2" BIT_MASK 0x1 /end MEASUREMENT
/begin MEASUREMENT Vbx_owe_drn_req_rst "Reset condition of the SR Fip Flop" UBYTE _CNV_R_R_VA_I_16_503_CM 1 0. 0. 1. ECU_ADDRESS 0xd0007d33 FORMAT "%6.2" BIT_MASK 0x1 /end MEASUREMENT
/begin MEASUREMENT Vbx_owe_hmi_warn_emb_cho "Warning or kilometers alert conf choice" UBYTE _CNV_R_R_VA_I_16_503_CM 1 0. 0. 1. ECU_ADDRESS 0xd0007d3c FORMAT "%6.2" BIT_MASK 0x1 /end MEASUREMENT
/begin MEASUREMENT Vbx_owe_ini_req_tmp "Initialisation request (manual or after sale department) accepted rising edge widened" UBYTE _CNV_R_R_VA_I_16_503_CM 1 0. 0. 1. ECU_ADDRESS 0xd0007d25 FORMAT "%6.2" BIT_MASK 0x1 /end MEASUREMENT
/begin MEASUREMENT Vbx_owe_n_drn_req "This bit is set when the oxidation level of the oil is to high" UBYTE _CNV_R_R_VA_I_16_503_CM 1 0. 0. 1. ECU_ADDRESS 0xd0007d34 FORMAT "%6.2" BIT_MASK 0x1 /end MEASUREMENT
/begin MEASUREMENT Vbx_owe_oil_drn_req_2_clc "Oil drain requested by the strategy (level 2)" UBYTE _CNV_R_R_VA_I_16_503_CM 1 0. 0. 1. ECU_ADDRESS 0xd0007d2e FORMAT "%6.2" BIT_MASK 0x1 /end MEASUREMENT
/begin MEASUREMENT Vbx_owe_oil_drn_req_2_mux "Oil drain requested by the strategy (level 2) sent on can interface" UBYTE _CNV_R_R_VA_I_16_503_CM 1 0. 0. 1. ECU_ADDRESS 0xd0007d1a FORMAT "%6.2" BIT_MASK 0x1 /end MEASUREMENT
/begin MEASUREMENT Vbx_owe_oil_drn_req_2_mux_raw "Oil drain requested by the strategy before replacement value" UBYTE _CNV_R_R_VA_I_16_503_CM 1 0. 0. 1. ECU_ADDRESS 0xd0007d36 FORMAT "%6.2" BIT_MASK 0x1 /end MEASUREMENT
/begin MEASUREMENT Vbx_owe_oil_drn_req_clc "Oil drain requested by the strategy" UBYTE _CNV_R_R_VA_I_16_503_CM 1 0. 0. 1. ECU_ADDRESS 0xd0007d2f FORMAT "%6.2" BIT_MASK 0x1 /end MEASUREMENT
/begin MEASUREMENT Vbx_owe_oil_drn_req_mux "Oil drain requested by the strategy sent on can interface" UBYTE _CNV_R_R_VA_I_16_503_CM 1 0. 0. 1. ECU_ADDRESS 0xd0007d1b FORMAT "%6.2" BIT_MASK 0x1 /end MEASUREMENT
/begin MEASUREMENT Vbx_owe_oil_drn_req_mux_raw "Oil drain requested by the strategy (level 2) before replacement value" UBYTE _CNV_R_R_VA_I_16_503_CM 1 0. 0. 1. ECU_ADDRESS 0xd0007d37 FORMAT "%6.2" BIT_MASK 0x1 /end MEASUREMENT
/begin MEASUREMENT Vbx_owe_prg "Boolean variable to forbid an OCS event after an ECU reprogrammation" UBYTE _CNV_R_R_VA_I_16_503_CM 1 0. 0. 1. ECU_ADDRESS 0xd0007d38 FORMAT "%6.2" BIT_MASK 0x1 /end MEASUREMENT
/begin MEASUREMENT Vbx_owe_ref_2_ok "Point 2 learned" UBYTE _CNV_R_R_VA_I_16_503_CM 1 0. 0. 1. ECU_ADDRESS 0xd0007d26 FORMAT "%6.2" BIT_MASK 0x1 /end MEASUREMENT
/begin MEASUREMENT Vbx_owe_ref_2_upd "Point 2 up-dated" UBYTE _CNV_R_R_VA_I_16_503_CM 1 0. 0. 1. ECU_ADDRESS 0xd0007d27 FORMAT "%6.2" BIT_MASK 0x1 /end MEASUREMENT
/begin MEASUREMENT Vbx_owe_req_km_2_clc "Boolean set if the oil dilution threshold is passed" UBYTE _CNV_R_R_VA_I_16_503_CM 1 0. 0. 1. ECU_ADDRESS 0xd0007d1d FORMAT "%6.2" BIT_MASK 0x1 /end MEASUREMENT
/begin MEASUREMENT Vbx_owe_warn_req "Set when the pre-alert is requered to memorize the vehicle kilometers." UBYTE _CNV_R_R_VA_I_16_503_CM 1 0. 0. 1. ECU_ADDRESS 0xd0007d1c FORMAT "%6.2" BIT_MASK 0x1 /end MEASUREMENT
/begin MEASUREMENT Vbx_owe_warn_req_km_clc "Set when the pre-alert is requered to memorize the vehicle kilometers. (calculated value)" UBYTE _CNV_R_R_VA_I_16_503_CM 1 0. 0. 1. ECU_ADDRESS 0xd0007d30 FORMAT "%6.2" BIT_MASK 0x1 /end MEASUREMENT
/begin MEASUREMENT Vbx_ptc_rov "Turbo water cooling pump command before monitool" UBYTE _CNV_R_R_VA_I_16_503_CM 1 0. 0. 1. ECU_ADDRESS 0xd0007d3b FORMAT "%6.2" BIT_MASK 0x1 /end MEASUREMENT
/begin MEASUREMENT Vbx_ptc_rov_cmd "PTC anti-icing output state" UBYTE _CNV_R_R_VA_I_16_503_CM 1 0. 0. 1. ECU_ADDRESS 0xd0007d3a FORMAT "%6.2" BIT_MASK 0x1 /end MEASUREMENT
/begin MEASUREMENT Vxx_owe_ant "Anticipation factor to converge to the  one by one  kilometer decrement" UWORD _CNV_R_R_RB_CONV_Di_558_CM 1 0. 0. 65535. ECU_ADDRESS 0xd000611e FORMAT "%12.2" /end MEASUREMENT
/begin MEASUREMENT Vxx_owe_km1_prev "Previous oil kilometer value for the first reference point" UWORD _CNV_R_R_RB_CONV_Di_558_CM 1 0. 0. 65535. ECU_ADDRESS 0xd0006120 FORMAT "%12.2" /end MEASUREMENT
/begin MEASUREMENT Vxx_owe_km2_prev "Previous oil kilometer value for the second reference point" UWORD _CNV_R_R_RB_CONV_Di_558_CM 1 0. 0. 65535. ECU_ADDRESS 0xd0006122 FORMAT "%12.2" /end MEASUREMENT
/begin MEASUREMENT Vxx_owe_km_sat_max "Oil potential kilometer maximal saturation value" UWORD _CNV_R_R_RB_CONV_Di_558_CM 1 0. 0. 65535. ECU_ADDRESS 0xd0006118 FORMAT "%12.2" /end MEASUREMENT
/begin MEASUREMENT Vxx_owe_km_slop "Slop of the remainig kilometers" UWORD _CNV_R_R_RB_CONV_00_567_CM 1 0. 0. 196.605 ECU_ADDRESS 0xd0006124 /end MEASUREMENT
/begin MEASUREMENT Vxx_owe_km_var1 "Smoothed kilometer intermediary variable" ULONG _CNV_R_R_RB_CONV_di_566_CM 1 0. 0. 65535000. ECU_ADDRESS 0xd000368c FORMAT "%12.2" /end MEASUREMENT
/begin MEASUREMENT Vxx_owe_km_var2 "Smoothed kilometer intermediary variable" ULONG _CNV_R_R_RB_CONV_di_566_CM 1 0. 0. 65535000. ECU_ADDRESS 0xd0003690 FORMAT "%12.2" /end MEASUREMENT
/begin MEASUREMENT Vxx_owe_km_var3 "Smoothed kilometer intermediary variable" UWORD _CNV_R_R_RB_CONV_di_568_CM 1 0. 0. 196605. ECU_ADDRESS 0xd000613c FORMAT "%12.2" /end MEASUREMENT
/begin MEASUREMENT Vxx_owe_pot_km "Oil potential kilometers calculated" UWORD _CNV_R_R_RB_CONV_Di_558_CM 1 0. 0. 65535. ECU_ADDRESS 0xd0006116 FORMAT "%12.2" /end MEASUREMENT
/begin MEASUREMENT Vxx_owe_pot_km_clc "Oil potential kilometers calculated" UWORD _CNV_R_R_RB_CONV_Di_558_CM 1 0. 0. 65535. ECU_ADDRESS 0xd000611c FORMAT "%12.2" /end MEASUREMENT
/begin MEASUREMENT Vxx_owe_pot_km_clc_2 "Oil potential kilometers calculated" UWORD _CNV_R_R_RB_CONV_Di_558_CM 1 0. 0. 65535. ECU_ADDRESS 0xd000611a FORMAT "%12.2" /end MEASUREMENT
/begin MEASUREMENT Vxx_owe_pot_km_pot_oxy_dil "Oil potential kilometers from oil oxidation and dilution factor" UWORD _CNV_R_R_RB_CONV_Di_558_CM 1 0. 0. 65535. ECU_ADDRESS 0xd0006144 FORMAT "%12.2" /end MEASUREMENT
/begin MEASUREMENT Vxx_owe_pot_km_prev "Previous oil potential kilometers" UWORD _CNV_R_R_RB_CONV_Di_558_CM 1 0. 0. 65535. ECU_ADDRESS 0xd0006126 FORMAT "%12.2" /end MEASUREMENT
/begin MEASUREMENT Vxx_owe_pot_km_rnd "Rounded oil potential meters" ULONG _CNV_R_R_RB_CONV_di_566_CM 1 0. 0. 65535000. ECU_ADDRESS 0xd0003694 FORMAT "%12.2" /end MEASUREMENT
/begin MEASUREMENT Vxx_owe_pot_km_step "Potential kilometer  one by one  decremented" UWORD _CNV_R_R_RB_CONV_Di_558_CM 1 0. 0. 65535. ECU_ADDRESS 0xd0006128 FORMAT "%12.2" /end MEASUREMENT
/begin MEASUREMENT Vxx_owe_prev_drn_dist_prev "Previous rounded oil kilometers" UWORD _CNV_R_R_RB_CONV_Di_558_CM 1 0. 0. 65535. ECU_ADDRESS 0xd000612a FORMAT "%12.2" /end MEASUREMENT
/begin MEASUREMENT Vxx_owe_raw_pot_km "Raw oil potential kilometers" UWORD _CNV_R_R_RB_CONV_Di_558_CM 1 0. 0. 65535. ECU_ADDRESS 0xd000612c FORMAT "%12.2" /end MEASUREMENT
/begin MEASUREMENT Vxx_owe_raw_pot_km_prev "Previous raw oil potential kilometers" UWORD _CNV_R_R_RB_CONV_Di_558_CM 1 0. 0. 65535. ECU_ADDRESS 0xd000612e FORMAT "%12.2" /end MEASUREMENT
/begin MEASUREMENT Vxx_owe_wea1_prev "Previous oil wear when the first point is learned" UWORD _CNV_R_R_RB_CONV_1__273_CM 1 0. 0. 1. ECU_ADDRESS 0xd0006130 FORMAT "%6.6" /end MEASUREMENT
/begin MEASUREMENT Vxx_owe_wea2_prev "Previous oil wear when the second point is learned" UWORD _CNV_R_R_RB_CONV_1__273_CM 1 0. 0. 1. ECU_ADDRESS 0xd0006132 FORMAT "%6.6" /end MEASUREMENT
/begin MEASUREMENT Vxx_owe_wea_act "Actual oil wear" UWORD _CNV_R_R_RB_CONV_1__273_CM 1 0. 0. 1. ECU_ADDRESS 0xd0006134 FORMAT "%6.6" /end MEASUREMENT
/begin MEASUREMENT Vxx_owe_wea_act_pot "Actual potential oil wear" UWORD _CNV_R_R_RB_CONV_1__273_CM 1 0. 0. 1. ECU_ADDRESS 0xd0006136 FORMAT "%6.6" /end MEASUREMENT
/begin MEASUREMENT Vxx_owe_wea_act_prev "Previous actual potential oil wear" UWORD _CNV_R_R_RB_CONV_1__273_CM 1 0. 0. 1. ECU_ADDRESS 0xd0006138 FORMAT "%6.6" /end MEASUREMENT
/begin MEASUREMENT Vxx_owe_wea_spd "Oil wearing speed" UWORD _CNV_R_R_RB_CONV_00_569_CM 1 0. 0. 6.5535e-003 ECU_ADDRESS 0xd000613a FORMAT "%6.8" /end MEASUREMENT
/begin CHARACTERISTIC Cbx_oil_heat_abst_pres_cho "Choice manager of presence of oil vapours heater" VALUE 0xa0022209 _REC_S1VAL_Normal_u1 1. _CNV_R_R_VA_I_16_503_CM 0. 1. FORMAT "%6.2" /end CHARACTERISTIC
/begin CHARACTERISTIC Cbx_owe_avl "Calibration to send on can when the function is  off" VALUE 0xa00221ec _REC_S1VAL_Normal_u1 1. _CNV_R_R_VA_I_16_503_CM 0. 1. FORMAT "%6.2" /end CHARACTERISTIC
/begin CHARACTERISTIC Cbx_owe_avl_2 "Calibration to send on can when the function is  off" VALUE 0xa00221ed _REC_S1VAL_Normal_u1 1. _CNV_R_R_VA_I_16_503_CM 0. 1. FORMAT "%6.2" /end CHARACTERISTIC
/begin CHARACTERISTIC Cbx_owe_dil_req_2_ena "Calibration to enable the dasboard alert on dilution condition" VALUE 0xa00221ee _REC_S1VAL_Normal_u1 1. _CNV_R_R_VA_I_16_503_CM 0. 1. FORMAT "%6.2" /end CHARACTERISTIC
/begin CHARACTERISTIC Cbx_owe_ena_1 "Calibration of the output bits truth table" VALUE 0xa00221ef _REC_S1VAL_Normal_u1 1. _CNV_R_R_VA_I_16_503_CM 0. 1. FORMAT "%6.2" /end CHARACTERISTIC
/begin CHARACTERISTIC Cbx_owe_ena_2 "Calibration of the output bits truth table" VALUE 0xa00221f0 _REC_S1VAL_Normal_u1 1. _CNV_R_R_VA_I_16_503_CM 0. 1. FORMAT "%6.2" /end CHARACTERISTIC
/begin CHARACTERISTIC Cbx_owe_ena_3 "Calibration of the output bits truth table" VALUE 0xa00221f1 _REC_S1VAL_Normal_u1 1. _CNV_R_R_VA_I_16_503_CM 0. 1. FORMAT "%6.2" /end CHARACTERISTIC
/begin CHARACTERISTIC Cbx_owe_ena_4 "Calibration of the output bits truth table" VALUE 0xa00221f2 _REC_S1VAL_Normal_u1 1. _CNV_R_R_VA_I_16_503_CM 0. 1. FORMAT "%6.2" /end CHARACTERISTIC
/begin CHARACTERISTIC Cbx_owe_ena_5 "Calibration of the output bits truth table" VALUE 0xa00221f3 _REC_S1VAL_Normal_u1 1. _CNV_R_R_VA_I_16_503_CM 0. 1. FORMAT "%6.2" /end CHARACTERISTIC
/begin CHARACTERISTIC Cbx_owe_ena_6 "Calibration of the output bits truth table" VALUE 0xa00221f4 _REC_S1VAL_Normal_u1 1. _CNV_R_R_VA_I_16_503_CM 0. 1. FORMAT "%6.2" /end CHARACTERISTIC
/begin CHARACTERISTIC Cbx_owe_ena_7 "Calibration of the output bits truth table" VALUE 0xa00221f5 _REC_S1VAL_Normal_u1 1. _CNV_R_R_VA_I_16_503_CM 0. 1. FORMAT "%6.2" /end CHARACTERISTIC
/begin CHARACTERISTIC Cbx_owe_ena_8 "Calibration of the output bits truth table" VALUE 0xa00221f6 _REC_S1VAL_Normal_u1 1. _CNV_R_R_VA_I_16_503_CM 0. 1. FORMAT "%6.2" /end CHARACTERISTIC
/begin CHARACTERISTIC Cbx_owe_hmi_warn "Choice manager of alert pre-alert hmi" VALUE 0xa0022208 _REC_S1VAL_Normal_u1 1. _CNV_R_R_VA_I_16_503_CM 0. 1. FORMAT "%6.2" /end CHARACTERISTIC
/begin CHARACTERISTIC Cbx_owe_sat_ena "Calibration to enable the saturation made by the initial potential kilometer" VALUE 0xa00221d8 _REC_S1VAL_Normal_u1 1. _CNV_R_R_VA_I_16_503_CM 0. 1. FORMAT "%6.2" /end CHARACTERISTIC
/begin CHARACTERISTIC Cxx_dfdec_ptc_rov_oc "ou_clo_luo_ptcgixx/Circuit Open of oil vapors heater detected failure counter decrement" VALUE 0xa00221f8 _REC_S1VAL_Normal_u2 65535. _CNV_R_R_VA_I_16_503_CM 0. 65535. FORMAT "%6.2" /end CHARACTERISTIC
/begin CHARACTERISTIC Cxx_dfdec_ptc_rov_scg "ou_clo_luo_ptcgixx Circuit Short to Ground of oil vapors heater detected failure counter decrement" VALUE 0xa00221fa _REC_S1VAL_Normal_u2 65535. _CNV_R_R_VA_I_16_503_CM 0. 65535. FORMAT "%6.2" /end CHARACTERISTIC
/begin CHARACTERISTIC Cxx_dfdec_ptc_rov_scw "ou_clo_luo_ptcgixx Circuit Short to Battery of oil vapors heater detected failure counter decrement" VALUE 0xa00221fc _REC_S1VAL_Normal_u2 65535. _CNV_R_R_VA_I_16_503_CM 0. 65535. FORMAT "%6.2" /end CHARACTERISTIC
/begin CHARACTERISTIC Cxx_dfinc_ptc_rov_oc "ou_clo_luo_ptcgixx Circuit Open of oil vapors heater detected failure counter increment" VALUE 0xa00221fe _REC_S1VAL_Normal_u2 65535. _CNV_R_R_VA_I_16_503_CM 0. 65535. FORMAT "%6.2" /end CHARACTERISTIC
/begin CHARACTERISTIC Cxx_dfinc_ptc_rov_scg "ou_clo_luo_ptcgixx Circuit Short to Ground of oil vapors heater detected failure counter increment" VALUE 0xa0022200 _REC_S1VAL_Normal_u2 65535. _CNV_R_R_VA_I_16_503_CM 0. 65535. FORMAT "%6.2" /end CHARACTERISTIC
/begin CHARACTERISTIC Cxx_dfinc_ptc_rov_scw "ou_clo_luo_ptcgixx Circuit Short to Battery of oil vapors heater detected failure counter increment" VALUE 0xa0022202 _REC_S1VAL_Normal_u2 65535. _CNV_R_R_VA_I_16_503_CM 0. 65535. FORMAT "%6.2" /end CHARACTERISTIC
/begin CHARACTERISTIC Cxx_owe_avl "Calibration to send on can when the function is  off" VALUE 0xa00221ce _REC_S1VAL_Normal_u2 65535. _CNV_R_R_RB_CONV_Di_558_CM 0. 65535. FORMAT "%12.2" /end CHARACTERISTIC
/begin CHARACTERISTIC Cxx_owe_drn_dist_max_prg "Calibration to forbid an OCS event after an ECU reprogrammation" VALUE 0xa00221ea _REC_S1VAL_Normal_u2 65535. _CNV_R_R_RB_CONV_Di_558_CM 0. 65535. FORMAT "%12.2" /end CHARACTERISTIC
/begin CHARACTERISTIC Cxx_owe_drn_req_dly "Calibration of the duration to maintain the drain request signal." VALUE 0xa00221e8 _REC_S1VAL_Normal_u2 6553.5 _CNV_R_R_RB_CONV_Ti_565_CM 0. 6553.5 FORMAT "%8.2" /end CHARACTERISTIC
/begin CHARACTERISTIC Cxx_owe_km1 "Kilometer threshold to learn the first point" VALUE 0xa00221da _REC_S1VAL_Normal_u2 65535. _CNV_R_R_RB_CONV_Di_558_CM 0. 65535. FORMAT "%12.2" /end CHARACTERISTIC
/begin CHARACTERISTIC Cxx_owe_km2 "Kilometer threshold to learn the second point (first time)" VALUE 0xa00221dc _REC_S1VAL_Normal_u2 65535. _CNV_R_R_RB_CONV_Di_558_CM 0. 65535. FORMAT "%12.2" /end CHARACTERISTIC
/begin CHARACTERISTIC Cxx_owe_km3 "Potential kilometers before switching to  one by one  kilometer decrement" VALUE 0xa00221de _REC_S1VAL_Normal_u2 65535. _CNV_R_R_RB_CONV_Di_558_CM 0. 65535. FORMAT "%12.2" /end CHARACTERISTIC
/begin CHARACTERISTIC Cxx_owe_km4 "Potential kilometer to convergne to the  one by one  decrement in the end of potential" VALUE 0xa00221e0 _REC_S1VAL_Normal_u2 65535. _CNV_R_R_RB_CONV_Di_558_CM 0. 65535. FORMAT "%12.2" /end CHARACTERISTIC
/begin CHARACTERISTIC Cxx_owe_km5 "Potential kilometer when the remainnig km is converged to the  one by one" VALUE 0xa00221e2 _REC_S1VAL_Normal_u2 65535. _CNV_R_R_RB_CONV_Di_558_CM 0. 65535. FORMAT "%12.2" /end CHARACTERISTIC
/begin CHARACTERISTIC Cxx_owe_km7 "Saturation of the potential kilometer" VALUE 0xa00221d0 _REC_S1VAL_Normal_u2 65535. _CNV_R_R_RB_CONV_Di_558_CM 0. 65535. FORMAT "%12.2" /end CHARACTERISTIC
/begin CHARACTERISTIC Cxx_owe_km_slop_max "Maximal slope of the potential km sended to the customer" VALUE 0xa00221e4 _REC_S1VAL_Normal_u2 196.605 _CNV_R_R_RB_CONV_00_567_CM 0. 196.605 /end CHARACTERISTIC
/begin CHARACTERISTIC Cxx_owe_km_slop_min "Minimal slope of the potential km sended to the customer" VALUE 0xa00221e6 _REC_S1VAL_Normal_u2 196.605 _CNV_R_R_RB_CONV_00_567_CM 0. 196.605 /end CHARACTERISTIC
/begin CHARACTERISTIC Cxx_owe_oil_dil_max_km "Maximal traveled kilometers to allow  oil dilution alert" VALUE 0xa00221d2 _REC_S1VAL_Normal_u2 65535. _CNV_R_R_RB_CONV_Di_558_CM 0. 65535. FORMAT "%12.2" /end CHARACTERISTIC
/begin CHARACTERISTIC Cxx_owe_oil_dil_min_km "Minimal traveled kilometers to allow  oil dilution alert" VALUE 0xa00221d4 _REC_S1VAL_Normal_u2 65535. _CNV_R_R_RB_CONV_Di_558_CM 0. 65535. FORMAT "%12.2" /end CHARACTERISTIC
/begin CHARACTERISTIC Cxx_owe_oil_dil_thd "Maximal oil dilution rate" VALUE 0xa00221d6 _REC_S1VAL_Normal_u2 100. _CNV_R_R_RB_CONV_10_553_CM 0. 100. FORMAT "%6.4" /end CHARACTERISTIC
/begin CHARACTERISTIC Cxx_ptc_rov_tia_hys "Air temperature hysterisis for PTC anti-icing command" VALUE 0xa0022204 _REC_S1VAL_Normal_u2 240. _CNV_R_R_RB_CONV_De_554_CM -40. 200. FORMAT "%8.2" /end CHARACTERISTIC
/begin CHARACTERISTIC Cxx_ptc_rov_tia_thd "Air temperature threshold for PTC anti-icing command" VALUE 0xa0022206 _REC_S1VAL_Normal_u2 240. _CNV_R_R_RB_CONV_De_554_CM -40. 200. FORMAT "%8.2" /end CHARACTERISTIC
/begin MEASUREMENT Vbx_df_ptc_rov_oc "Circuit Open of oil vapors heater detected failure" UBYTE _CNV_S_2_RANGE______3_CM 1 0. 0. 1. ECU_ADDRESS 0xd000659a BIT_MASK 0x1 /end MEASUREMENT
/begin MEASUREMENT Vbx_df_ptc_rov_scg "Circuit Short to Ground of oil vapors heater detected failure" UBYTE _CNV_S_2_RANGE______3_CM 1 0. 0. 1. ECU_ADDRESS 0xd0006599 BIT_MASK 0x1 /end MEASUREMENT
/begin MEASUREMENT Vbx_df_ptc_rov_scw "Circuit Short to Battery of oil vapors heater detected failure" UBYTE _CNV_S_2_RANGE______3_CM 1 0. 0. 1. ECU_ADDRESS 0xd0006598 BIT_MASK 0x1 /end MEASUREMENT
/begin MEASUREMENT Vbx_diag_ena_ptc_rov_oc "Circuit Open of oil vapors heater diagnosis authorization" UBYTE _CNV_S_2_RANGE______3_CM 1 0. 0. 1. ECU_ADDRESS 0xd000659d BIT_MASK 0x1 /end MEASUREMENT
/begin MEASUREMENT Vbx_diag_ena_ptc_rov_scg "Circuit Short to Ground of oil vapors heater diagnosis authorization" UBYTE _CNV_S_2_RANGE______3_CM 1 0. 0. 1. ECU_ADDRESS 0xd000659c BIT_MASK 0x1 /end MEASUREMENT
/begin MEASUREMENT Vbx_diag_ena_ptc_rov_scw "Circuit Short to Battery of oil vapors heater diagnosis authorization" UBYTE _CNV_S_2_RANGE______3_CM 1 0. 0. 1. ECU_ADDRESS 0xd000659b BIT_MASK 0x1 /end MEASUREMENT
/begin MEASUREMENT lv_oil_heat "Oil heater control command state" UBYTE _CNV_S_2_RANGE______3_CM 1 0. 0. 1. ECU_ADDRESS 0xd0006596 BIT_MASK 0x1 /end MEASUREMENT
/begin MEASUREMENT lv_oil_heat_pres "Presence of oil heater vapours" UBYTE _CNV_S_2_RANGE______3_CM 1 0. 0. 1. ECU_ADDRESS 0xd0006597 BIT_MASK 0x1 /end MEASUREMENT
/begin MEASUREMENT dur_work_ecu "Utilization duration of the ECM" ULONG _CNV_A_R_LINEAR_____570_CM 1 0. 0. 2048000000. ECU_ADDRESS 0xd000248c FORMAT "%12.0" /end MEASUREMENT
/begin MEASUREMENT t_on_ecu "Key ON duration" UWORD _CNV_A_R_LINEAR_____571_CM 1 0. 0. 65535. ECU_ADDRESS 0xd0003d96 FORMAT "%5.0" /end MEASUREMENT
/begin MEASUREMENT lv_immo_unlock_auth "Flag to indicate if unlock is authorized" UBYTE _CNV_S_2_RANGE______3_CM 1 0. 0. 1. ECU_ADDRESS 0xd00013e3 BIT_MASK 0x1 /end MEASUREMENT
/begin MEASUREMENT Vbx_dyn_mod_req "Sport mode request" UBYTE _CNV_S_2_WI_0_1_Boo_572_CM 1 0. 0. 1. ECU_ADDRESS 0xd0007d09 BIT_MASK 0x1 /end MEASUREMENT
/begin MEASUREMENT Vbx_mux_dyn_mod_req "Sport mode request received on the CAN." UBYTE _CNV_S_2_WI_0_1_Boo_572_CM 1 0. 0. 1. ECU_ADDRESS 0xd0007d0a BIT_MASK 0x1 /end MEASUREMENT
/begin MEASUREMENT Vbx_rs_dyn_mod_cfm "RS Sport Mode Strategy configuration boolean." UBYTE _CNV_S_2_WI_0_1_Boo_572_CM 1 0. 0. 1. ECU_ADDRESS 0xd000740a BIT_MASK 0x1 /end MEASUREMENT
/begin MEASUREMENT Vbx_wf_dyn_mod_req "Sport mode request wire frame." UBYTE _CNV_S_2_WI_0_1_Boo_572_CM 1 0. 0. 1. ECU_ADDRESS 0xd0007d14 BIT_MASK 0x1 /end MEASUREMENT
/begin MEASUREMENT Vxx_rs_dspl_pdl_spt_fac "Pedal progressivity maps chosen by the Renault Sport Display." UBYTE _CNV_R_R_WI_1_os_0__573_CM 1 0. 0. 15. ECU_ADDRESS 0xd0007d13 FORMAT "%2.0" /end MEASUREMENT
/begin CHARACTERISTIC Cxx_rs_dspl_pdl_act_dly "Delay before taking into account the RS Display pedal progressivity map request." VALUE 0xa00221cd _REC_S1VAL_Normal_u1 2.55 _CNV_R_R_WI_0point0_574_CM 0. 2.55 FORMAT "%6.2" /end CHARACTERISTIC
/begin CHARACTERISTIC Cxx_spg_diag_dsb "Threshold of Vxx_amp to forbid the diagnosis of Vxx_spg" VALUE 0xa00207f4 _REC_S1VAL_20_u2 20000. _CNV_A_R_LINEAR_____115_CM 0. 20000. FORMAT "%5.0" /end CHARACTERISTIC
/begin COMPU_METHOD _CNV_A_R_ECME_LINEA_0_CM "" RAT_FUNC "%6.3" "-" COEFFS 0 1. 0. 0 0 1 /end COMPU_METHOD
/begin COMPU_METHOD _CNV_A_R_LINEAR_____2_CM "" RAT_FUNC "%6.3" "rpm" COEFFS 0 3.125e-002 0. 0 0 1 /end COMPU_METHOD
/begin COMPU_METHOD _CNV_S_2_RANGE______3_CM "" TAB_VERB "%6.3" "-" COMPU_TAB_REF _CNV_S_2_RANGE______3 /end COMPU_METHOD
/begin COMPU_VTAB _CNV_S_2_RANGE______3 "" TAB_VERB 2 0 "0" 1 "1" /end COMPU_VTAB
/begin COMPU_METHOD _CNV_S_15_RANGE_SYM__4_CM "" TAB_VERB "%6.3" "-" COMPU_TAB_REF _CNV_S_15_RANGE_SYM__4 /end COMPU_METHOD
/begin COMPU_VTAB _CNV_S_15_RANGE_SYM__4 "" TAB_VERB 15 0 "NO_SYM" 1 "CYL_0" 2 "CYL_1" 4 "CYL_2" 8 "CYL_3" 16 "CYL_4" 32 "CYL_5" 64 "CYL_6" 128 "CYL_7" 256 "CYL_8" 512 "CYL_9" 1024 "CYL_10" 2048 "CYL_11" 4096 "RND" 8192 "MPL" /end COMPU_VTAB
/begin COMPU_METHOD _CNV_A_R_CPULOAD__0_5_CM "" RAT_FUNC "%6.3" "%" COEFFS 0 10.24 0. 0 0 1 /end COMPU_METHOD
/begin COMPU_METHOD _CNV_A_R_LINEAR_____14_CM "" RAT_FUNC "%6.3" "V" COEFFS 0 6553.599999999993 0. 0 0 1 /end COMPU_METHOD
/begin COMPU_METHOD _CNV_A_R_LINEAR_____17_CM "" RAT_FUNC "%6.3" "V" COEFFS 0 1598.439195529102 0. 0 0 1 /end COMPU_METHOD
/begin COMPU_METHOD _CNV_A_R_LINEAR_____19_CM "" RAT_FUNC "%6.3" "rpm" COEFFS 0 1. 0. 0 0 1 /end COMPU_METHOD
/begin COMPU_METHOD _CNV_A_R_ENSD_LINEA_22_CM "" RAT_FUNC "%6.3" "rpm" COEFFS 0 4. 0. 0 0 1 /end COMPU_METHOD
/begin COMPU_METHOD _CNV_A_R_LINEAR_____23_CM "" RAT_FUNC "%6.3" "°CRK" COEFFS 0 2.666666666666667 0. 0 0 1 /end COMPU_METHOD
/begin COMPU_METHOD _CNV_A_R_LINEAR_____29_CM "" RAT_FUNC "%6.3" "-" COEFFS 0 256. 0. 0 0 1 /end COMPU_METHOD
/begin COMPU_METHOD _CNV_A_R_LINEAR_____31_CM "" RAT_FUNC "%6.3" "-" COEFFS 0 1. -1. 0 0 1 /end COMPU_METHOD
/begin COMPU_METHOD _CNV_A_R_LINEAR_____39_CM "" RAT_FUNC "%6.3" "ms" COEFFS 0 0.1 0. 0 0 1 /end COMPU_METHOD
/begin COMPU_METHOD _CNV_A_R_LINEAR_____40_CM "" RAT_FUNC "%6.3" "V" COEFFS 0 9.846153846153847 0. 0 0 1 /end COMPU_METHOD
/begin COMPU_METHOD _CNV_A_R_LINEAR_____41_CM "" RAT_FUNC "%6.3" "°C" COEFFS 0 1.333333333333333 64. 0 0 1 /end COMPU_METHOD
/begin COMPU_METHOD _CNV_A_R_LINEAR_____42_CM "" RAT_FUNC "%6.3" "-" COEFFS 0 128. 0. 0 0 1 /end COMPU_METHOD
/begin COMPU_METHOD _CNV_A_R_IGRE_LINEA_47_CM "" RAT_FUNC "%6.3" "°CRK" COEFFS 0 2.666666666666667 63. 0 0 1 /end COMPU_METHOD
/begin COMPU_METHOD _CNV_A_R_LINEAR_____50_CM "" RAT_FUNC "%6.3" "-" COEFFS 0 98304. 0. 0 0 1 /end COMPU_METHOD
/begin COMPU_METHOD _CNV_A_R_LINEAR_____51_CM "" RAT_FUNC "%6.3" "hPa" COEFFS 0 12.06017666543982 0. 0 0 1 /end COMPU_METHOD
/begin COMPU_METHOD _CNV_A_R_LINEAR_____53_CM "" RAT_FUNC "%6.3" "-" COEFFS 0 16384. 0. 0 0 1 /end COMPU_METHOD
/begin COMPU_METHOD _CNV_A_R_LINEAR_____55_CM "" RAT_FUNC "%6.3" "kg/h" COEFFS 0 8192. 0. 0 0 1 /end COMPU_METHOD
/begin COMPU_METHOD _CNV_A_R_LINEAR_____56_CM "" RAT_FUNC "%6.3" "kg/h" COEFFS 0 32. 0. 0 0 1 /end COMPU_METHOD
/begin COMPU_METHOD _CNV_A_R_LINEAR_____58_CM "" RAT_FUNC "%6.3" "s" COEFFS 0 10. 0. 0 0 1 /end COMPU_METHOD
/begin COMPU_METHOD _CNV_A_R_LINEAR_____61_CM "" RAT_FUNC "%6.3" "hPa" COEFFS 0 800. 0. 0 0 1 /end COMPU_METHOD
/begin COMPU_METHOD _CNV_S_16_RANGE_ERR__62_CM "" TAB_VERB "%6.3" "-" COMPU_TAB_REF _CNV_S_16_RANGE_ERR__62 /end COMPU_METHOD
/begin COMPU_VTAB _CNV_S_16_RANGE_ERR__62 "" TAB_VERB 16 0 "NO_SYM" 1 "SYM_0" 2 "SYM_1" 3 "SYM_0, SYM_1" 4 "SYM_2" 5 "SYM_0, SYM_2" 6 "SYM_1, SYM_2" 7 "SYM_0, SYM_1, SYM_2" 8 "SYM_3" 9 "SYM_0, SYM_3" 10 "SYM_1, SYM_3" 11 "SYM_0, SYM_1,SYM_3" 12 "SYM_2, SYM_3" 13 "SYM_0, SYM_2, SYM_3" 14 "SYM_1, SYM_2, SYM_3" 15 "SYM_0, SYM_1, SYM_2, SYM_3" /end COMPU_VTAB
/begin COMPU_METHOD _CNV_A_R_EVAM_LINEA_63_CM "" RAT_FUNC "%6.3" "mm" COEFFS 0 61.78822389144658 0. 0 0 1 /end COMPU_METHOD
/begin COMPU_METHOD _CNV_A_R_LINEAR_____65_CM "" RAT_FUNC "%6.3" "l" COEFFS 0 1. 0. 0 0 1 /end COMPU_METHOD
/begin COMPU_METHOD _CNV_A_R_LINEAR_____68_CM "" RAT_FUNC "%6.3" "s" COEFFS 0 1. 0. 0 0 1 /end COMPU_METHOD
/begin COMPU_METHOD _CNV_A_R_LINEAR_____71_CM "" RAT_FUNC "%6.3" "km/h" COEFFS 0 1. 0. 0 0 1 /end COMPU_METHOD
/begin COMPU_METHOD _CNV_A_R_LINEAR_____77_CM "" RAT_FUNC "%6.3" "mg/stk" COEFFS 0 0.183585313174946 0. 0 0 1 /end COMPU_METHOD
/begin COMPU_METHOD _CNV_A_R_LINEAR_____82_CM "" RAT_FUNC "%6.3" "%" COEFFS 0 655.3599999999997 -1.455191522836685e-011 0 0 1 /end COMPU_METHOD
/begin COMPU_METHOD _CNV_A_R_LINEAR_____95_CM "" RAT_FUNC "%6.3" "min" COEFFS 0 1. 0. 0 0 1 /end COMPU_METHOD
/begin COMPU_METHOD _CNV_A_R_LINEAR_____100_CM "" RAT_FUNC "%6.3" "-" COEFFS 0 98303.99999999926 -65535.99344639951 0 0 1 /end COMPU_METHOD
/begin COMPU_METHOD _CNV_A_R_A_105_CM "" RAT_FUNC "%6.3" "" COEFFS 0 1. 0. 0 0 1 /end COMPU_METHOD
/begin COMPU_METHOD _CNV_A_R_LINEAR_____107_CM "" RAT_FUNC "%6.3" "mV" COEFFS 0 1. 0. 0 0 1 /end COMPU_METHOD
/begin COMPU_METHOD _CNV_A_R_LINEAR_____110_CM "" RAT_FUNC "%6.3" "°C" COEFFS 0 10. 400. 0 0 1 /end COMPU_METHOD
/begin COMPU_METHOD _CNV_A_R_LINEAR_____115_CM "" RAT_FUNC "%6.3" "hPa" COEFFS 0 1. 0. 0 0 1 /end COMPU_METHOD
/begin COMPU_METHOD _CNV_A_R_LINEAR_____123_CM "" RAT_FUNC "%6.3" "-" COEFFS 0 100. 0. 0 0 1 /end COMPU_METHOD
/begin COMPU_METHOD _CNV_A_R_LINEAR_____146_CM "" RAT_FUNC "%6.3" "%" COEFFS 0 100. 0. 0 0 1 /end COMPU_METHOD
/begin COMPU_METHOD _CNV_A_R_LINEAR_____159_CM "" RAT_FUNC "%6.3" "%" COEFFS 0 655.35 0. 0 0 1 /end COMPU_METHOD
/begin COMPU_METHOD _CNV_A_R_LINEAR_____162_CM "" RAT_FUNC "%6.3" "-" COEFFS 0 255. 0. 0 0 1 /end COMPU_METHOD
/begin COMPU_METHOD _CNV_A_R_LINEAR_____165_CM "" RAT_FUNC "%6.3" "%" COEFFS 0 2.55 0. 0 0 1 /end COMPU_METHOD
/begin COMPU_METHOD _CNV_S_3_STATUS_OK__179_CM "" TAB_VERB "%6.3" "-" COMPU_TAB_REF _CNV_S_3_STATUS_OK__179 /end COMPU_METHOD
/begin COMPU_VTAB _CNV_S_3_STATUS_OK__179 "" TAB_VERB 3 0 "Nsx_vld_nok_0" 1 "Nsx_vld_ok_1" 2 "Nsx_vld_fail_2" /end COMPU_VTAB
/begin COMPU_METHOD _CNV_S_4_STATUS_OK__180_CM "" TAB_VERB "%6.3" "-" COMPU_TAB_REF _CNV_S_4_STATUS_OK__180 /end COMPU_METHOD
/begin COMPU_VTAB _CNV_S_4_STATUS_OK__180 "" TAB_VERB 4 0 "Nsx_vld_nok_0" 1 "Nsx_vld_ok_1" 2 "Nsx_vld_fail_2" 3 "Nsx_vld_fail_3" /end COMPU_VTAB
/begin COMPU_METHOD _CNV_A_R_LINEAR_____181_CM "" RAT_FUNC "%6.3" "Nm" COEFFS 0 32. 0. 0 0 1 /end COMPU_METHOD
/begin COMPU_METHOD _CNV_A_R_LINEAR_____204_CM "" RAT_FUNC "%6.3" "V" COEFFS 0 6553.599999999997 -1.455191522836685e-011 0 0 1 /end COMPU_METHOD
/begin COMPU_METHOD _CNV_S_16_RANGE_ERR__206_CM "" TAB_VERB "%6.3" "" COMPU_TAB_REF _CNV_S_16_RANGE_ERR__206 /end COMPU_METHOD
/begin COMPU_VTAB _CNV_S_16_RANGE_ERR__206 "" TAB_VERB 16 0 "NO_SYM" 1 "SYM_0" 2 "SYM_1" 3 "SYM_0, SYM_1" 4 "SYM_2" 5 "SYM_0, SYM_2" 6 "SYM_1, SYM_2" 7 "SYM_0, SYM_1, SYM_2" 8 "SYM_3" 9 "SYM_0, SYM_3" 10 "SYM_1, SYM_3" 11 "SYM_0, SYM_1,SYM_3" 12 "SYM_2, SYM_3" 13 "SYM_0, SYM_2, SYM_3" 14 "SYM_1, SYM_2, SYM_3" 15 "SYM_0, SYM_1, SYM_2, SYM_3" /end COMPU_VTAB
/begin COMPU_METHOD _CNV_A_R_LINEAR_____207_CM "" RAT_FUNC "%6.3" "V" COEFFS 0 102.4 0. 0 0 1 /end COMPU_METHOD
/begin COMPU_METHOD _CNV_A_R_LINEAR_____208_CM "" RAT_FUNC "%6.3" "s" COEFFS 0 25. 0. 0 0 1 /end COMPU_METHOD
/begin COMPU_METHOD _CNV_A_R_LINEAR_____210_CM "" RAT_FUNC "%6.3" "%" COEFFS 0 2359.326061129711 0. 0 0 1 /end COMPU_METHOD
/begin COMPU_METHOD _CNV_A_R_LINEAR_____211_CM "" RAT_FUNC "%6.3" "%" COEFFS 0 327.68 0. 0 0 1 /end COMPU_METHOD
/begin COMPU_METHOD _CNV_A_R_LINEAR_____231_CM "" RAT_FUNC "%6.3" "kg/(s*m²)" COEFFS 0 128. 0. 0 0 1 /end COMPU_METHOD
/begin COMPU_METHOD _CNV_S_8_STATUS_OK__234_CM "" TAB_VERB "%6.3" "-" COMPU_TAB_REF _CNV_S_8_STATUS_OK__234 /end COMPU_METHOD
/begin COMPU_VTAB _CNV_S_8_STATUS_OK__234 "" TAB_VERB 8 0 "Nsx_vld_nok_0" 1 "Nsx_vld_ok_1" 2 "Nsx_vld_fail_2" 3 "Nsx_vld_fail_3" 4 "Nsx_vld_fail_4" 5 "Nsx_vld_fail_5" 6 "Nsx_vld_fail_6" 7 "Nsx_vld_fail_7" /end COMPU_VTAB
/begin COMPU_METHOD _CNV_A_R_LINEAR_____267_CM "" RAT_FUNC "%6.3" "%" COEFFS 0 800. 0. 0 0 1 /end COMPU_METHOD
/begin COMPU_METHOD _CNV_S_2_STATUS_OK__269_CM "" TAB_VERB "%6.3" "-" COMPU_TAB_REF _CNV_S_2_STATUS_OK__269 /end COMPU_METHOD
/begin COMPU_VTAB _CNV_S_2_STATUS_OK__269 "" TAB_VERB 2 0 "Nsx_vld_nok_0" 1 "Nsx_vld_ok_1" /end COMPU_VTAB
/begin COMPU_METHOD _CNV_S_3_RANGE_ETC__270_CM "" TAB_VERB "%6.3" "-" COMPU_TAB_REF _CNV_S_3_RANGE_ETC__270 /end COMPU_METHOD
/begin COMPU_VTAB _CNV_S_3_RANGE_ETC__270 "" TAB_VERB 3 0 "Nsx_etc_coup_open" 1 "Nsx_etc_coup_sli" 2 "Nsx_etc_coup_clos" /end COMPU_VTAB
/begin COMPU_METHOD _CNV_S_8_RANGE_STAT_271_CM "" TAB_VERB "%6.3" "-" COMPU_TAB_REF _CNV_S_8_RANGE_STAT_271 /end COMPU_METHOD
/begin COMPU_VTAB _CNV_S_8_RANGE_STAT_271 "" TAB_VERB 8 0 "Nsx_pft_load" 8 "Nsx_pft_spd_req" 16 "Nsx_pft_chk_temp" 24 "Nsx_pft_cata_hot" 32 "Nsx_pft_rgn_req" 56 "Nsx_pft_rgn_rest" 64 "Nsx_pft_rgn_ok" 80 "Nsx_pft_rgn_fail" /end COMPU_VTAB
/begin COMPU_METHOD _CNV_A_R_LINEAR_____272_CM "" RAT_FUNC "%6.3" "W/s" COEFFS 0 2.5e-002 0. 0 0 1 /end COMPU_METHOD
/begin COMPU_METHOD _CNV_R_R_RB_CONV_1__273_CM "" RAT_FUNC "%6.3" "wu" COEFFS 0. 65535. 0. 0. 0. 1. /end COMPU_METHOD
/begin COMPU_METHOD _CNV_A_R_LINEAR_____274_CM "" RAT_FUNC "%6.3" "km" COEFFS 0 1. 0. 0 0 1 /end COMPU_METHOD
/begin COMPU_METHOD _CNV_A_R_LINEAR_____275_CM "" RAT_FUNC "%6.3" "ratio" COEFFS 0 255. 0. 0 0 1 /end COMPU_METHOD
/begin COMPU_METHOD _CNV_A_R_LINEAR_____280_CM "" RAT_FUNC "%6.3" "°C" COEFFS 0 1. 40. 0 0 1 /end COMPU_METHOD
/begin COMPU_METHOD _CNV_S_3_TAM_MODEL_347_CM "" TAB_VERB "%6.3" "-" COMPU_TAB_REF _CNV_S_3_TAM_MODEL_347 /end COMPU_METHOD
/begin COMPU_VTAB _CNV_S_3_TAM_MODEL_347 "" TAB_VERB 3 0 "NO" 1 "COLD" 2 "HOT" /end COMPU_VTAB
/begin COMPU_METHOD _CNV_S_5_CANISTER_P_393_CM "" TAB_VERB "%6.3" "-" COMPU_TAB_REF _CNV_S_5_CANISTER_P_393 /end COMPU_METHOD
/begin COMPU_VTAB _CNV_S_5_CANISTER_P_393 "" TAB_VERB 5 0 "Nsx_cp_ini" 1 "Nsx_cp_out" 2 "Nsx_cp_ad" 4 "Nsx_cp_nom" 8 "Nsx_cp_ol" /end COMPU_VTAB
/begin COMPU_METHOD _CNV_S_3_STATUS_OK__412_CM "" TAB_VERB "%6.3" "[-]" COMPU_TAB_REF _CNV_S_3_STATUS_OK__412 /end COMPU_METHOD
/begin COMPU_VTAB _CNV_S_3_STATUS_OK__412 "" TAB_VERB 3 0 "Nsx_vld_nok_0" 1 "Nsx_vld_ok_1" 2 "Nsx_vld_fail_2" /end COMPU_VTAB
/begin COMPU_METHOD _CNV_R_R_VA_I_16_503_CM "" RAT_FUNC "%6.3" "-" COEFFS 0. 1. 0. 0. 0. 1. /end COMPU_METHOD
/begin COMPU_METHOD _CNV_R_R_VA_F_1_p0__515_CM "" RAT_FUNC "%6.3" "N.m" COEFFS 0. 1. 0. 0. 0. 1. /end COMPU_METHOD
/begin COMPU_METHOD _CNV_S_17_STATUS_EVA_549_CM "" TAB_VERB "%6.3" "-" COMPU_TAB_REF _CNV_S_17_STATUS_EVA_549 /end COMPU_METHOD
/begin COMPU_VTAB _CNV_S_17_STATUS_EVA_549 "" TAB_VERB 17 0 "Nsx_eva_dgn_sta" 1 "Nsx_eva_dgn_prs_dyn" 2 "Nsx_eva_dgn_can_clos" 3 "Nsx_eva_dgn_sov_clos_dly" 4 "Nsx_eva_dgn_sov_clos" 5 "Nsx_eva_dgn_prs_lrn" 6 "Nsx_eva_dgn_eva" 7 "Nsx_eva_dgn_lamb_lrn" 8 "Nsx_eva_dgn_purg" 9 "Nsx_eva_dgn_dly" 10 "Nsx_eva_dgn" 11 "Nsx_eva_dgn_eva_aftr_dly" 12 "Nsx_eva_dgn_eva_aftr" 13 "Nsx_eva_dgn_done" 14 "Nsx_eva_dgn_done_can_clos" 15 "Nsx_eva_dgn_rst_wait" 16 "Nsx_eva_dgn_end" /end COMPU_VTAB
/begin COMPU_METHOD _CNV_A_R_LINEAR_____550_CM "" RAT_FUNC "%6.3" "mg/strk" COEFFS 0 390.625 0. 0 0 1 /end COMPU_METHOD
/begin COMPU_METHOD _CNV_S_6_RANGE_ERR__551_CM "" TAB_VERB "%6.3" "" COMPU_TAB_REF _CNV_S_6_RANGE_ERR__551 /end COMPU_METHOD
/begin COMPU_VTAB _CNV_S_6_RANGE_ERR__551 "" TAB_VERB 6 0 "NO_SYM" 1 "SYM_0" 2 "SYM_1" 4 "SYM_2" 8 "SYM_3" 15 "BENCH_MODE" /end COMPU_VTAB
/begin COMPU_METHOD _CNV_S_4_RANGE______552_CM "" TAB_VERB "%6.3" "" COMPU_TAB_REF _CNV_S_4_RANGE______552 /end COMPU_METHOD
/begin COMPU_VTAB _CNV_S_4_RANGE______552 "" TAB_VERB 4 0 "NO_RST" 1 "WARM_RST" 2 "COLD_RST" 3 "WTD_RST" /end COMPU_VTAB
/begin COMPU_METHOD _CNV_R_R_RB_CONV_10_553_CM "" RAT_FUNC "%6.3" "%" COEFFS 0. 65535. 0. 0. 0. 100. /end COMPU_METHOD
/begin COMPU_METHOD _CNV_R_R_RB_CONV_De_554_CM "" RAT_FUNC "%6.3" "deg C" COEFFS 0. 10. 400. 0. 0. 1. /end COMPU_METHOD
/begin COMPU_METHOD _CNV_R_R_RB_CONV_00_555_CM "" RAT_FUNC "%6.3" "%" COEFFS 0. 1000000. 0. 0. 0. 1. /end COMPU_METHOD
/begin COMPU_METHOD _CNV_R_R_RB_CONV_00_556_CM "" RAT_FUNC "%6.3" "%" COEFFS 0. 100000000. 0. 0. 0. 1. /end COMPU_METHOD
/begin COMPU_METHOD _CNV_R_R_WI_1._6415_557_CM "Variables and calibration compute method" RAT_FUNC "%6.3" "[%]" COEFFS 0. 858993500. 0. 0. 0. 1. /end COMPU_METHOD
/begin COMPU_METHOD _CNV_R_R_RB_CONV_Di_558_CM "" RAT_FUNC "%6.3" "km" COEFFS 0. 1. 0. 0. 0. 1. /end COMPU_METHOD
/begin COMPU_METHOD _CNV_R_R_RB_CONV_1T_559_CM "" RAT_FUNC "%6.3" "trs" COEFFS 0. 1. 0. 0. 0. 1. /end COMPU_METHOD
/begin COMPU_METHOD _CNV_R_R_RB_CONV_10_560_CM "" RAT_FUNC "%6.3" "trs" COEFFS 0. 1. 0. 0. 0. 10. /end COMPU_METHOD
/begin COMPU_METHOD _CNV_R_R_RB_CONV_Re_561_CM "" RAT_FUNC "%6.3" "-" COEFFS 0. 1000. 0. 0. 0. 1. /end COMPU_METHOD
/begin COMPU_METHOD _CNV_S_2_WI_Vsx_oil_562_CM "Variables and calibration compute method" TAB_VERB "%6.3" "[-]" COMPU_TAB_REF _CNV_S_2_WI_Vsx_oil_562 /end COMPU_METHOD
/begin COMPU_VTAB _CNV_S_2_WI_Vsx_oil_562 "Variables and calibration compute method" TAB_VERB 2 0 "Nsx_vld_nok_0" 1 "Nsx_vld_ok_1" /end COMPU_VTAB
/begin COMPU_METHOD _CNV_R_R_RB_CONV_Re_563_CM "" RAT_FUNC "%6.3" "-" COEFFS 0. 10000. 0. 0. 0. 1. /end COMPU_METHOD
/begin COMPU_METHOD _CNV_R_R_RB_CONV_Tr_564_CM "" RAT_FUNC "%6.3" "trs" COEFFS 0. 10. 0. 0. 0. 1. /end COMPU_METHOD
/begin COMPU_METHOD _CNV_R_R_RB_CONV_Ti_565_CM "" RAT_FUNC "%6.3" "s" COEFFS 0. 10. 0. 0. 0. 1. /end COMPU_METHOD
/begin COMPU_METHOD _CNV_R_R_RB_CONV_di_566_CM "" RAT_FUNC "%6.3" "m" COEFFS 0. 1. 0. 0. 0. 1. /end COMPU_METHOD
/begin COMPU_METHOD _CNV_R_R_RB_CONV_00_567_CM "" RAT_FUNC "%6.3" "km/km" COEFFS 0. 1000. 0. 0. 0. 3. /end COMPU_METHOD
/begin COMPU_METHOD _CNV_R_R_RB_CONV_di_568_CM "" RAT_FUNC "%6.3" "m" COEFFS 0. 1. 0. 0. 0. 3. /end COMPU_METHOD
/begin COMPU_METHOD _CNV_R_R_RB_CONV_00_569_CM "" RAT_FUNC "%6.3" "1/km" COEFFS 0. 1. 0. 0. 0. 1.e-007 /end COMPU_METHOD
/begin COMPU_METHOD _CNV_A_R_LINEAR_____570_CM "" RAT_FUNC "%6.3" "[min]" COEFFS 0 1. 0. 0 0 1 /end COMPU_METHOD
/begin COMPU_METHOD _CNV_A_R_LINEAR_____571_CM "" RAT_FUNC "%6.3" "[s]" COEFFS 0 1. 0. 0 0 1 /end COMPU_METHOD
/begin COMPU_METHOD _CNV_S_2_WI_0_1_Boo_572_CM "method for boolean variables" TAB_VERB "%6.3" "[-]" COMPU_TAB_REF _CNV_S_2_WI_0_1_Boo_572 /end COMPU_METHOD
/begin COMPU_VTAB _CNV_S_2_WI_0_1_Boo_572 "method for boolean variables" TAB_VERB 2 0 "0" 1 "1" /end COMPU_VTAB
/begin COMPU_METHOD _CNV_R_R_WI_1_os_0__573_CM "Variables and calibration compute method" RAT_FUNC "%6.3" "[wu]" COEFFS 0. 1. 0. 0. 0. 1. /end COMPU_METHOD
/begin COMPU_METHOD _CNV_R_R_WI_0point0_574_CM "Variables and calibration compute method" RAT_FUNC "%6.3" "[s]" COEFFS 0. 100. 0. 0. 0. 1. /end COMPU_METHOD
/begin RECORD_LAYOUT _REC_S1VAL_20_u1 FNC_VALUES 1 UBYTE COLUMN_DIR DIRECT /end RECORD_LAYOUT
/begin RECORD_LAYOUT _REC_A2AXS_20_u1 NO_AXIS_PTS_X 1 UBYTE AXIS_PTS_X 2 UBYTE INDEX_INCR DIRECT /end RECORD_LAYOUT
/begin RECORD_LAYOUT _REC_S1VAL_20_u2 FNC_VALUES 1 UWORD COLUMN_DIR DIRECT /end RECORD_LAYOUT
/begin RECORD_LAYOUT _REC_A2AXS_20_u2 NO_AXIS_PTS_X 1 UWORD AXIS_PTS_X 2 UWORD INDEX_INCR DIRECT /end RECORD_LAYOUT
/begin RECORD_LAYOUT _REC_A1CUR_20_u2_u1 FNC_VALUES 1 UWORD COLUMN_DIR DIRECT /end RECORD_LAYOUT
/begin RECORD_LAYOUT _REC_A1MAP_20_u2_u2_u2 FNC_VALUES 1 UWORD COLUMN_DIR DIRECT /end RECORD_LAYOUT
/begin RECORD_LAYOUT _REC_A1CUR_20_u2_u2 FNC_VALUES 1 UWORD COLUMN_DIR DIRECT /end RECORD_LAYOUT
/begin RECORD_LAYOUT _REC_S1VAL_Normal_u1 FNC_VALUES 1 UBYTE COLUMN_DIR DIRECT /end RECORD_LAYOUT
/begin RECORD_LAYOUT _REC_S1VAL_Normal_u2 FNC_VALUES 1 UWORD COLUMN_DIR DIRECT /end RECORD_LAYOUT
/begin RECORD_LAYOUT _REC_S1VAL_Normal_s2 FNC_VALUES 1 SWORD COLUMN_DIR DIRECT /end RECORD_LAYOUT
/begin RECORD_LAYOUT _REC_S1VAL_Normal_u4 FNC_VALUES 1 ULONG COLUMN_DIR DIRECT /end RECORD_LAYOUT
/begin FUNCTION TqSafTsm_TqMonxx ""
 /begin DEF_CHARACTERISTIC Ctb_sfty_esti_tqi Ctb_sfty_tqi_req Ctp_sfty_esti_tqi_pos_err Ctp_sfty_tqi_req_pos_err Cxx_dfdec_sfty_tq_chr Cxx_dfdec_sfty_tq_clc_chr Cxx_dfdec_sfty_tq_lih_chr Cxx_dfinc_sfty_tq_chr Cxx_dfinc_sfty_tq_clc_chr Cxx_dfinc_sfty_tq_lih_chr Cxx_sfty_cyl_nr Cxx_sfty_diag_ena_cata_dly Cxx_sfty_diag_ena_cata_dly_rst Cxx_sfty_diag_ena_eng_dly Cxx_sfty_diag_ena_eng_dly_rst Cxx_sfty_diag_ena_n_thd Cxx_sfty_diag_ena_tco_thd Cxx_sfty_err_esti_t_fil_step Cxx_sfty_esti_tqi_deb_dec Cxx_sfty_esti_tqi_deb_thd Cxx_sfty_esti_tqi_t_fil_step Cxx_sfty_ext_ctrl_bch_vs_thd Cxx_sfty_ext_ctrl_t Cxx_sfty_gear_cge_dec_dly Cxx_sfty_gear_cge_dec_dly_rst Cxx_sfty_rst_t Cxx_sfty_stop_req_igk_rst_t Cxx_sfty_thr_lih_mon_deb_dec Cxx_sfty_thr_lih_mon_deb_thd Cxx_sfty_tqi_sp_deb_dec Cxx_sfty_tqi_sp_deb_thd Cxx_sfty_tqi_sp_t_fil_step Cxx_sfty_vs_dsb_t Cxx_sfty_vs_dsb_vs_thd /end DEF_CHARACTERISTIC
 /begin OUT_MEASUREMENT Vbx_df_sfty_tq_chr Vbx_df_sfty_tq_clc_chr Vbx_df_sfty_tq_lih_chr Vbx_prev_df_sfty_tq_chr Vbx_sfty_aftr_rst Vbx_sfty_aftr_rst_ini Vbx_sfty_aftr_rst_mem Vbx_sfty_diag_ena_tqi Vbx_sfty_esti_tqi_nok Vbx_sfty_esti_tqi_nok_tmp Vbx_sfty_lih_mon_ena Vbx_sfty_moni_bch_ok Vbx_sfty_rst_req Vbx_sfty_stop_req Vbx_sfty_stop_req_aftr_rst Vbx_sfty_stop_req_mem Vbx_sfty_thr_lih_mon_nok_fil Vbx_sfty_tq_mon_nok Vbx_sfty_tqi_sp_nok Vbx_sfty_tqi_sp_nok_tmp Vbx_sfty_vs_dsb Vsx_sfty_tq_mon_vld Vxx_sfty_esti_err Vxx_sfty_esti_err_max Vxx_sfty_esti_tqi_t_fil_min Vxx_sfty_tq_ffm_data_sf Vxx_sfty_tqi_sp_t_fil_max Vxx_tqi_esti_sp_dif /end OUT_MEASUREMENT
/end FUNCTION
/begin FUNCTION CbEvaDgn ""
 /begin SUB_FUNCTION CbEvaDgn_Rsasvxx CbEvaDgn_Svrsa1x CbEvaDgn_Svrsa2x CbEvaDgn_Svrsa3x CbEvaDgn_Schxxxx /end SUB_FUNCTION
/end FUNCTION
/begin FUNCTION CbEvaDgn_Rsasvxx ""
 /begin OUT_MEASUREMENT amp fac_lam_cor fac_lam_dif_cp fac_lam_mv_mmv fac_pq_maf_cps ftl_diagcp_rsa lamb_sp lv_err_el_cps lv_err_el_sov lv_err_fsd lv_err_ftl lv_err_isc lv_err_ls_up lv_err_lsh_up lv_err_maf lv_err_rly_main lv_err_tco_grd lv_err_tco_plaus lv_err_tco_stuck lv_err_tia lv_err_tia_thr lv_err_tps lv_err_tps_plaus lv_err_tps_ratio lv_err_vb lv_err_vs lv_evap_pres lv_fac_lam_diagcp_end lv_frq_req_cp lv_is lv_lam_lscl lv_mis_state_a lv_mis_state_b1 lv_mis_state_b4 lv_state_rr lv_tps_not_act maf_cps map state_cp_rsa state_err_iv tco_st tia vs /end OUT_MEASUREMENT
/end FUNCTION
/begin FUNCTION CbEvaDgn_Svrsa1x ""
 /begin OUT_MEASUREMENT Vbx_df_cp_blk_open Vbx_df_eva_fcap_abn_cple Vbx_df_eva_fcap_no_lk Vbx_df_eva_sldv_blk_clos Vbx_df_evap_chr Vbx_df_evap_lkg Vbx_diag_ena_cp_blk_open Vbx_diag_ena_eva_fcap_abn_cple Vbx_diag_ena_eva_fcap_no_lk Vbx_diag_ena_eva_sldv_blk_clos Vbx_diag_ena_evap_chr Vbx_diag_ena_evap_lkg /end OUT_MEASUREMENT
/end FUNCTION
/begin FUNCTION CbEvaDgn_Svrsa2x ""
 /begin DEF_CHARACTERISTIC Cxx_dfdec_cp_blk_open Cxx_dfdec_eva_fcap_abn_cple Cxx_dfdec_eva_fcap_no_lk Cxx_dfdec_eva_sldv_blk_clos Cxx_dfdec_evap_chr Cxx_dfdec_evap_lkg Cxx_dfinc_cp_blk_open Cxx_dfinc_eva_fcap_abn_cple Cxx_dfinc_eva_fcap_no_lk Cxx_dfinc_eva_sldv_blk_clos Cxx_dfinc_evap_chr Cxx_dfinc_evap_lkg /end DEF_CHARACTERISTIC
/end FUNCTION
/begin FUNCTION CbEvaDgn_Svrsa3x ""
 /begin OUT_MEASUREMENT Vbx_evap_dgn Vbx_evap_dgn_cl_ti_fac Vbx_evap_dgn_cp Vsx_eva_dgn Vsx_evap_vld Vsx_evap_vld_state_flow Vxx_eva_fcap_abn_cple_max Vxx_eva_fcap_abn_cple_val Vxx_eva_fcap_no_lk_max Vxx_eva_fcap_no_lk_val Vxx_evap_chr_max Vxx_evap_chr_val Vxx_evap_dgn_cp_pwm Vxx_evap_dgn_fim_cor Vxx_evap_dgn_mem_cl_ti_fac Vxx_evap_lkg_max Vxx_evap_lkg_val /end OUT_MEASUREMENT
/end FUNCTION
/begin FUNCTION CbEvaDgn_Schxxxx "" /begin DEF_CHARACTERISTIC Cbx_evap_cfm /end DEF_CHARACTERISTIC /begin OUT_MEASUREMENT Vbx_evap_cfm /end OUT_MEASUREMENT /end FUNCTION
/begin FUNCTION DgEcuDft "" /begin SUB_FUNCTION DgEcuDft_Ecuhwfm DgEcuDft_Dataxxx /end SUB_FUNCTION /end FUNCTION
/begin FUNCTION DgEcuDft_Ecuhwfm ""
 /begin DEF_CHARACTERISTIC Cxx_dfdec_ecm_err_itl Cxx_dfdec_inj_ecu_itl Cxx_dfinc_ecm_err_itl Cxx_dfinc_inj_ecu_itl /end DEF_CHARACTERISTIC
 /begin OUT_MEASUREMENT Vsx_inj_ecu_vld Vsx_inj_ecu_vld_1 Vsx_inj_ecu_vld_init /end OUT_MEASUREMENT
/end FUNCTION
/begin FUNCTION DgEcuDft_Dataxxx ""
 /begin OUT_MEASUREMENT Vbx_df_ecm_err_itl Vbx_df_inj_ecu_itl Vbx_diag_ena_ecm_err_itl Vbx_diag_ena_inj_ecu_itl /end OUT_MEASUREMENT
/end FUNCTION
/begin FUNCTION DgEcuSaf "" /begin SUB_FUNCTION DgEcuSaf_Dataxxx DgEcuSaf_Sfthwfm /end SUB_FUNCTION /end FUNCTION
/begin FUNCTION DgEcuSaf_Dataxxx ""
 /begin OUT_MEASUREMENT Vbx_df_ecm_adc_tron Vbx_df_ecm_mon_secu_1 Vbx_df_ecm_mon_secu_2 Vbx_df_ecm_mon_tron Vbx_df_vb_clc_chr /end OUT_MEASUREMENT
/end FUNCTION
/begin FUNCTION DgEcuSaf_Sfthwfm ""
 /begin DEF_CHARACTERISTIC Cxx_dfdec_ecm_adc_tron Cxx_dfdec_ecm_mon_secu_1 Cxx_dfdec_ecm_mon_secu_2 Cxx_dfdec_ecm_mon_tron Cxx_dfdec_vb_clc_chr Cxx_dfinc_ecm_adc_tron Cxx_dfinc_ecm_mon_secu_1 Cxx_dfinc_ecm_mon_secu_2 Cxx_dfinc_ecm_mon_tron Cxx_dfinc_vb_clc_chr /end DEF_CHARACTERISTIC
 /begin OUT_MEASUREMENT Vsx_ecm_mon_vld /end OUT_MEASUREMENT
/end FUNCTION
/begin FUNCTION cllubwea "" /begin OUT_MEASUREMENT Vxx_oil_dil_rij Vxx_owe_dil_osr_req_km Vxx_owe_osr_req_km /end OUT_MEASUREMENT
 /begin SUB_FUNCTION cllubwea_owhisxx cllubwea_oildilx cllubwea_owzoncs cllubwea_oxixxxx ClLubWea_Owosrxx /end SUB_FUNCTION
/end FUNCTION
/begin FUNCTION cllubwea_owhisxx "Oil Wear Estimation History function"
 /begin OUT_MEASUREMENT Vbx_owe_ini_0 Vbx_owe_ini_1 Vbx_owe_ini_2 Vbx_owe_ini_3 Vbx_owe_ini_prev Vxx_owe_ctr_stt Vxx_owe_dil_req_km Vxx_owe_eng_rev_act_sum_0 Vxx_owe_eng_rev_act_sum_1 Vxx_owe_eng_rev_act_sum_2 Vxx_owe_eng_rev_act_sum_3 Vxx_owe_km_0 Vxx_owe_km_1 Vxx_owe_km_2 Vxx_owe_km_3 Vxx_owe_pot_km_0 Vxx_owe_pot_km_1 Vxx_owe_pot_km_2 Vxx_owe_pot_km_3 Vxx_owe_prev_ini_km Vxx_owe_warn_req_km Vbx_owe_ini_0_trg Vbx_owe_ini_1_trg Vbx_owe_ini_2_trg Vbx_owe_ini_3_trg Vsx_owe_prev_drn_dist_vld Vxx_owe_eng_rev_act_sum_mem Vxx_owe_ini Vxx_owe_prev_drn_dist /end OUT_MEASUREMENT
/end FUNCTION
/begin FUNCTION cllubwea_oildilx "Oil dilution model" /begin OUT_MEASUREMENT Vxx_oil_dil_raw Vxx_pft_oil_dil_max Vxx_oil_dil /end OUT_MEASUREMENT /end FUNCTION
/begin FUNCTION cllubwea_owzoncs "Oil Wear Estimation Geographic area selection"
 /begin DEF_CHARACTERISTIC Cxx_owe_km_pot_1 Cxx_owe_km_pot_2 Cxx_owe_km_pot_3 Cxx_owe_km_pot_4 Cxx_owe_max_drn_km_1 Cxx_owe_max_drn_km_2 Cxx_owe_max_drn_km_3 Cxx_owe_max_drn_km_4 Cxx_owe_min_drn_km_1 Cxx_owe_min_drn_km_2 Cxx_owe_min_drn_km_3 Cxx_owe_min_drn_km_4 Cxx_owe_n_mnl_asd_1 Cxx_owe_n_mnl_asd_2 Cxx_owe_n_mnl_asd_3 Cxx_owe_n_mnl_asd_4 /end DEF_CHARACTERISTIC
 /begin OUT_MEASUREMENT Vsx_owe_act_zon Vbx_owe_off Vbx_owe_zon_writ Vxx_owe_km_pot Vxx_owe_max_drn_km Vxx_owe_min_drn_km Vxx_owe_n_mnl_asd /end OUT_MEASUREMENT
/end FUNCTION
/begin FUNCTION cllubwea_oxixxxx "Oil Wear Estimation lubricant oxydation with engine revolutions count"
 /begin DEF_CHARACTERISTIC Ctb_owe_alco_rat Ctb_owe_oil_dil Ctb_owe_toil Ctb_owe_toil_fac Ctb_owe_toil_off Ctb_owe_toil_sta Cmp_owe_toil_prev_sta Ctp_owe_alco_rat Ctp_owe_dil Ctp_owe_toil Ctp_owe_toil_fac Cbx_owe_toil_tco Cxx_owe_alco_fail_cor Cxx_owe_alco_sta_cor Cxx_owe_eng_aut_dly Cxx_owe_tco_sub Cxx_owe_toil_sub /end DEF_CHARACTERISTIC
 /begin OUT_MEASUREMENT Vxx_owe_eng_rev_prev_sum Vxx_owe_toil_eng_off_prev Vbx_owe_eng_aut Vbx_owe_eng_aut_dly Vbx_owe_fac_toil_act Vbx_owe_off_not Vxx_owe_alco_cor Vxx_owe_cmp_toil Vxx_owe_ctp_alco Vxx_owe_ctp_dil Vxx_owe_ctp_toil Vxx_owe_eng_rev_act_sum Vxx_owe_fac_toil_act Vxx_owe_fac_toil_tot Vxx_owe_n_aut Vxx_owe_n_toil_dil_u32 Vxx_owe_toil_sta Vxx_owe_toil_tco /end OUT_MEASUREMENT
/end FUNCTION
/begin FUNCTION ClLubWea_Owosrxx "" /begin OUT_MEASUREMENT Vxx_osr Vsx_osr_vld Vxx_osr_cor /end OUT_MEASUREMENT /end FUNCTION
/begin FUNCTION oucloluo ""
 /begin SUB_FUNCTION oucloluo_owkmdil oucloluo_schxxxx oucloluo_owkmwir oucloluo_ptcgixx oucloluo_owihmcs oucloluo_owihmpa oucloluo_owihmkm /end SUB_FUNCTION
/end FUNCTION
/begin FUNCTION oucloluo_owkmdil "Oil Wear Estimation remaining kilometers interface with dilution parameters"
 /begin OUT_MEASUREMENT Vxx_owe_dil Vxx_owe_km1_dil Vxx_owe_km2_dil Vxx_owe_oxy_dil_fac_raw Vxx_owe_pot_km_rnd_dil Vxx_owe_wea1_dil Vxx_owe_wea2_dil /end OUT_MEASUREMENT
/end FUNCTION
/begin FUNCTION oucloluo_schxxxx "Output cooling lubrification schedulers" /begin DEF_CHARACTERISTIC Cbx_oil_heat_abst_pres_cho Cbx_owe_hmi_warn /end DEF_CHARACTERISTIC /begin OUT_MEASUREMENT Vbx_oil_heat_abst_pres_cho Vbx_owe_hmi_warn_emb_cho /end OUT_MEASUREMENT /end FUNCTION
/begin FUNCTION oucloluo_owkmwir "Oil wear estimation wire" /begin OUT_MEASUREMENT Vxx_owe_pot_km_pot_oxy_dil /end OUT_MEASUREMENT /end FUNCTION
/begin FUNCTION oucloluo_ptcgixx "PTC command of the circuit of reabsorption of oil vapours"
 /begin DEF_CHARACTERISTIC Cxx_dfdec_ptc_rov_oc Cxx_dfdec_ptc_rov_scg Cxx_dfdec_ptc_rov_scw Cxx_dfinc_ptc_rov_oc Cxx_dfinc_ptc_rov_scg Cxx_dfinc_ptc_rov_scw Cxx_ptc_rov_tia_hys Cxx_ptc_rov_tia_thd /end DEF_CHARACTERISTIC
 /begin OUT_MEASUREMENT Vbx_ptc_rov_cmd /end OUT_MEASUREMENT
 /begin LOC_MEASUREMENT Vbx_ptc_rov /end LOC_MEASUREMENT
/end FUNCTION
/begin FUNCTION oucloluo_owihmcs "Oil Wear Estimation Dashboard interface configuration"
 /begin DEF_CHARACTERISTIC Cbx_owe_sat_ena Cxx_owe_avl Cxx_owe_km7 Cxx_owe_oil_dil_max_km /end DEF_CHARACTERISTIC
 /begin OUT_MEASUREMENT Vbx_owe_dil_req_km_2_clc Vbx_owe_dil_req_km Vbx_owe_oil_drn_req_2_mux Vbx_owe_oil_drn_req_mux Vbx_owe_warn_req Vxx_owe_pot_km /end OUT_MEASUREMENT
 /begin LOC_MEASUREMENT Vbx_owe_req_km_2_clc Vxx_owe_km_sat_max Vxx_owe_pot_km_clc_2 /end LOC_MEASUREMENT
/end FUNCTION
/begin FUNCTION oucloluo_owihmpa "Oil Wear Estimation pre-alert/alert interface"
 /begin DEF_CHARACTERISTIC Cbx_owe_avl Cbx_owe_avl_2 Cbx_owe_dil_req_2_ena Cbx_owe_ena_1 Cbx_owe_ena_2 Cbx_owe_ena_3 Cbx_owe_ena_4 Cbx_owe_ena_5 Cbx_owe_ena_6 Cbx_owe_ena_7 Cbx_owe_ena_8 Cxx_owe_drn_dist_max_prg Cxx_owe_drn_req_dly Cxx_owe_oil_dil_min_km Cxx_owe_oil_dil_thd /end DEF_CHARACTERISTIC
 /begin OUT_MEASUREMENT Vbx_owe_oil_drn_req_2 Vbx_owe_oil_drn_req Vbx_owe_warn_req_km_mem Vbx_owe_dil_req_km_1_clc Vbx_owe_oil_drn_req_2_clc Vbx_owe_oil_drn_req_clc Vbx_owe_warn_req_km_clc /end OUT_MEASUREMENT
 /begin LOC_MEASUREMENT Vbx_owe_drn_req Vbx_owe_drn_req_ok_2 Vbx_owe_drn_req_rst Vbx_owe_n_drn_req Vbx_owe_oil_drn_req_2_mux_raw Vbx_owe_oil_drn_req_mux_raw Vbx_owe_prg /end LOC_MEASUREMENT
/end FUNCTION
/begin FUNCTION oucloluo_owihmkm "Oil Wear Estimation remaining kilometers interface"
 /begin DEF_CHARACTERISTIC Cxx_owe_km1 Cxx_owe_km2 Cxx_owe_km3 Cxx_owe_km4 Cxx_owe_km5 Cxx_owe_km_slop_max Cxx_owe_km_slop_min /end DEF_CHARACTERISTIC
 /begin OUT_MEASUREMENT Vxx_owe_km1 Vxx_owe_km2 Vxx_owe_pot_km_pot Vxx_owe_wea1 Vxx_owe_wea2 Vxx_owe_pot_km_clc /end OUT_MEASUREMENT
 /begin LOC_MEASUREMENT Vbx_owe_ini_req_tmp Vbx_owe_ref_2_ok Vbx_owe_ref_2_upd Vxx_owe_ant Vxx_owe_km1_prev Vxx_owe_km2_prev Vxx_owe_km_slop Vxx_owe_km_var1 Vxx_owe_km_var2 Vxx_owe_km_var3 Vxx_owe_pot_km_prev Vxx_owe_pot_km_rnd Vxx_owe_pot_km_step Vxx_owe_prev_drn_dist_prev Vxx_owe_raw_pot_km Vxx_owe_raw_pot_km_prev Vxx_owe_wea1_prev Vxx_owe_wea2_prev Vxx_owe_wea_act Vxx_owe_wea_act_pot Vxx_owe_wea_act_prev Vxx_owe_wea_spd /end LOC_MEASUREMENT
/end FUNCTION
/begin FUNCTION BoCloLuo ""
 /begin OUT_MEASUREMENT Vbx_df_ptc_rov_oc Vbx_df_ptc_rov_scg Vbx_df_ptc_rov_scw Vbx_diag_ena_ptc_rov_oc Vbx_diag_ena_ptc_rov_scg Vbx_diag_ena_ptc_rov_scw lv_oil_heat lv_oil_heat_pres /end OUT_MEASUREMENT
/end FUNCTION
/begin FUNCTION C_4_SYS_VAR "" /begin SUB_FUNCTION SYS_VAR_ATIMER /end SUB_FUNCTION /end FUNCTION
/begin FUNCTION SYS_VAR_ATIMER "" /begin OUT_MEASUREMENT dur_work_ecu t_on_ecu /end OUT_MEASUREMENT /end FUNCTION
/begin FUNCTION iastuce "" /begin OUT_MEASUREMENT lv_immo_unlock_auth /end OUT_MEASUREMENT /end FUNCTION
/begin FUNCTION InPciDsi ""
 /begin SUB_FUNCTION InPciDsi_Dynmocs__100ms InPciDsi_Rsbtncs__100ms InPciDsi_Rsdspcs__100ms InPciDsi_Schxxxx InPciDsi_Spbtnsr /end SUB_FUNCTION
/end FUNCTION
/begin FUNCTION InPciDsi_Dynmocs__100ms "" /begin OUT_MEASUREMENT Vbx_dyn_mod_req /end OUT_MEASUREMENT /end FUNCTION
/begin FUNCTION InPciDsi_Rsbtncs__100ms "" /begin OUT_MEASUREMENT Vbx_mux_dyn_mod_req /end OUT_MEASUREMENT /end FUNCTION
/begin FUNCTION InPciDsi_Rsdspcs__100ms "" /begin DEF_CHARACTERISTIC Cxx_rs_dspl_pdl_act_dly /end DEF_CHARACTERISTIC /begin OUT_MEASUREMENT Vxx_rs_dspl_pdl_spt_fac /end OUT_MEASUREMENT /end FUNCTION
/begin FUNCTION InPciDsi_Schxxxx "" /begin OUT_MEASUREMENT Vbx_rs_dyn_mod_cfm /end OUT_MEASUREMENT /end FUNCTION
/begin FUNCTION InPciDsi_Spbtnsr "" /begin OUT_MEASUREMENT Vbx_wf_dyn_mod_req /end OUT_MEASUREMENT /end FUNCTION
/begin FUNCTION __DDS_EXPA2_DEFAULT_FUNC__ "__DDS_EXPA2_DEFAULT_FUNC__"
 /begin DEF_CHARACTERISTIC c_ccp_pt_act c_ensd_eng_dyn_conf ldp_vb__pwm_cor ip_pwm_cor c_vb_min_etc_dr_diag Cbx_rs_cfm Cbx_vb_flot_dsb Cxx_owe_dil_osr_fac_raw Cxx_owe_oxy_dil_fac_raw c_ofs_ref_inj c_raf_clc_cp lc_eng_pha_upd_req Cxx_uhil_2_uhil_thd Cxx_uhil_uhil_2_thd c_ctr_err_nvmy_max c_ctr_err_ram_max c_ctr_err_rom_max c_ctr_err_spi_max lc_spi_mps_drv_avl lc_spi_qps_drv_avl c_t_ini_test_ign_0 c_t_ini_test_ign_1 c_t_ini_test_ign_2 c_t_ini_test_ign_3 c_t_ini_test_inj_0 c_t_ini_test_inj_1 c_t_ini_test_inj_2 c_t_ini_test_inj_3 c_t_off_test_ign_0 c_t_off_test_ign_1 c_t_off_test_ign_2 c_t_off_test_ign_3 c_t_off_test_inj_0 c_t_off_test_inj_1 c_t_off_test_inj_2 c_t_off_test_inj_3 c_t_on_test_ign_0 c_t_on_test_ign_1 c_t_on_test_ign_2 c_t_on_test_ign_3 c_t_on_test_inj_0 c_t_on_test_inj_1 c_t_on_test_inj_2 c_t_on_test_inj_3 c_test_out_cyc_ign_0 c_test_out_cyc_ign_1 c_test_out_cyc_ign_2 c_test_out_cyc_ign_3 c_test_out_cyc_inj_0 c_test_out_cyc_inj_1 c_test_out_cyc_inj_2 c_test_out_cyc_inj_3 c_vs_eol_diag_max lc_test_out_eol_ign_0 lc_test_out_eol_ign_1 lc_test_out_eol_ign_2 lc_test_out_eol_ign_3 lc_test_out_eol_inj_0 lc_test_out_eol_inj_1 lc_test_out_eol_inj_2 lc_test_out_eol_inj_3 Cxx_spg_diag_dsb /end DEF_CHARACTERISTIC
 /begin OUT_MEASUREMENT lv_end_diag_win_fsd_1 lv_end_diag_win_fsd_2 lv_end_diag_win_fsd_lam_lim_1 lv_end_diag_win_fsd_lam_lim_2 lv_eol_obd_dc inh_iv_mis lv_inh_iv_mis_a sym_cyl_mis_a sym_cyl_mis_b1 sym_cyl_mis_b4 pv daq_ovld lv_err_el_sov_scp ctr_vld_block lv_warm_rst vp_map vp_put Vxx_sens_it_v_1 Vxx_sens_it_v_2 vp_tps_1_bas vp_tps_2_bas err_sym_tco_el lv_cdn_diag_tco_el tco_mes vp_tco[0] lv_igk lv_igk_bas v_igk_mes err_sym_rly_main_plaus_on err_sym_vcc_1 err_sym_vcc_2 err_sym_vcc_3 lv_cdn_diag_rly_main_plaus_on lv_cdn_diag_vcc_1 lv_cdn_diag_vcc_2 lv_cdn_diag_vcc_3 lv_cdn_vb_min_diag lv_cdn_vb_obd1 lv_cdn_vb_obd2 lv_vb_cdn_obd_1 lv_vb_inh_diag v_rly_main_mes vb vb_raw vcc_1 vcc_2 vcc_3 vp_vcc_1 vp_vcc_2 vp_vcc_3 lv_inh_diag_etc_dr lv_mtc_cur_off pwm_etc DiagFuelGauge Sbx_rdn_obd_eva_fcap_abn_cple Sbx_rdn_obd_eva_fcap_no_lk Sbx_rdn_obd_evap_chr Sbx_rdn_obd_evap_lkg Vbx_ecm_mon_rst_req Vbx_etc_ack Vbx_etc_cfm Vbx_it_ofs_clos_frst Vbx_it_ofs_open_frst Vbx_lpg_cyl1_cut Vbx_lpg_cyl2_cut Vbx_lpg_cyl3_cut Vbx_lpg_cyl4_cut Vbx_lpg_min_lpg_lvl Vbx_mvac_cut_req Vbx_owe_dil_warn Vbx_owe_osr_warn Vbx_pwst_prs_stt Vbx_vb_flot_dsb Vbx_wup_cmd Vbx_wup_req Vsx_etc_coup_stt Vsx_pft_stt_rgn Vsx_pft_utp_reg_mod Vxx_aftr_crsh_dly Vxx_alt_neg_slop_req Vxx_driv_spt_fac Vxx_emtv_clos_rat Vxx_etc_max_tqe_tgt Vxx_mux_eng_stop_req_ssg Vxx_opmp_cmd Vxx_owe_dil_osr_fac_raw Vxx_owe_oxy_dil_fac_raw Vxx_pft_rgn_err_t_ctr Vxx_pft_rgn_err_vh_dist Vxx_prim_sha_n_rat Vxx_raw_sens_tia Vxx_tkof_ass_fac err_sym_bas_knk[0] err_sym_crk_oc err_sym_crk_plaus err_sym_crk_syn err_sym_crk_tooth err_sym_crk_tooth_per err_sym_igc_ol[0] err_sym_igc_ol[1] err_sym_igc_ol[2] err_sym_igc_ol[3] err_sym_igc_scg[0] err_sym_igc_scg[1] err_sym_igc_scg[2] err_sym_igc_scg[3] err_sym_igc_scp[0] err_sym_igc_scp[1] err_sym_igc_scp[2] err_sym_igc_scp[3] err_sym_per_cam_in[0] err_sym_plaus_cam_in[0] err_sym_ref_crk_cam_in[0] err_sym_rel_knk[0] err_sym_syn_cam_in[0] err_sym_syn_crk_cam_in[0] lv_cdn_diag_bas_knk[0] lv_cdn_diag_crk_oc lv_cdn_diag_crk_plaus lv_cdn_diag_crk_syn lv_cdn_diag_crk_tooth lv_cdn_diag_crk_tooth_per lv_cdn_diag_igc_ol[0] lv_cdn_diag_igc_ol[1] lv_cdn_diag_igc_ol[2] lv_cdn_diag_igc_ol[3] lv_cdn_diag_igc_scg[0] lv_cdn_diag_igc_scg[1] lv_cdn_diag_igc_scg[2] lv_cdn_diag_igc_scg[3] lv_cdn_diag_igc_scp[0] lv_cdn_diag_igc_scp[1] lv_cdn_diag_igc_scp[2] lv_cdn_diag_igc_scp[3] lv_cdn_diag_per_cam_in[0] lv_cdn_diag_plaus_cam_in[0] lv_cdn_diag_ref_crk_cam_in[0] lv_cdn_diag_rel_knk[0] lv_cdn_diag_syn_cam_in[0] lv_cdn_diag_syn_crk_cam_in[0] err_sym_map err_sym_put fac_fq_st_ad flow_dly_mmv_cp iga_av_shift_rng_1 iga_av_shift_rng_2 iga_av_shift_rng_3 iga_av_shift_rng_4 lv_cdn_diag_map lv_cdn_diag_put lv_cppwm_ext_adj lv_diagcp_act_ext_adj lv_diagcp_auth lv_end_diag lv_err_load_plaus lv_err_load_tps_plaus lv_fac_lam_lim_min[0] lv_fq_st_ad_end lv_igk_on lv_lsh_down lv_lsh_up lv_sov_act_ext_adj lv_sov_ext_adj lv_st_end lv_syn_vld_wout_cam lv_vs_run lv_wup_cyc maf_dly_mmv_cp maf_hb state_tam_mdl_upd t_es tco Vsx_maf_fct_vld lv_cam_lock_ref_pos_ivvt_in lv_eng_pha_upd_req toil lv_emul Vxx_ovt_acel_pdl_dif ctr_loss_tsk_ecu_run_cyc ctr_loss_tsk_sw_cyc lf_state_os_tsk_loss_ecu_cyc[0] lf_state_os_tsk_loss_prev[0] lf_state_os_tsk_loss_sw_cyc[0] stack_cns[0] stack_cns[1] ctr_wrt_fly ctr_wrt_fly_swt lv_cru_wrt_req switch_type Vbx_moni_xx_req[0] Vbx_moni_xx_req[2] Vbx_moni_xx_req[4] Vbx_moni_xx_req[5] Vbx_moni_xx_req[7] Vbx_moni_xx_req[8] Vbx_moni_xx_req[9] Vbx_moni_xx_req[11] Vbx_moni_xx_req[12] Vbx_moni_xx_req[13] Vbx_moni_xx_req[14] Vbx_moni_xx_req[15] Vbx_moni_xx_req[18] Vbx_moni_xx_req[21] Vbx_moni_xx_req[22] Vbx_moni_xx_req[23] Vbx_moni_xx_req[34] Vbx_moni_xx_req[35] Vbx_moni_xx_req[36] Vbx_moni_xx_req[39] Vbx_moni_xx_req[40] Vbx_moni_xx_req[42] Vbx_moni_xx_req[46] Vbx_moni_xx_req[47] Vbx_moni_xx_req[63] Vbx_moni_xx_req[65] Vbx_moni_xx_req[66] Vbx_moni_xx_req[69] Vbx_moni_xx_req[80] Vbx_moni_xx_req[83] Vbx_moni_xx_req[84] Vbx_moni_xx_req[85] Vbx_moni_xx_req[86] Vbx_moni_xx_req[87] Vbx_moni_xx_req[88] Vbx_moni_xx_req[89] Vbx_moni_xx_req[90] Vbx_moni_xx_req[91] Vbx_moni_xx_req[92] Vbx_moni_xx_req[93] Vbx_moni_xx_req[94] Vbx_moni_xx_req[95] Vbx_moni_xx_req[114] Vbx_moni_xx_req[115] Vbx_moni_xx_req[116] Vbx_moni_xx_req[117] Vbx_moni_xx_req[118] Vbx_moni_xx_req[119] Vbx_moni_xx_req[120] Vbx_moni_xx_req[122] Vbx_moni_xx_req[123] Vbx_moni_xx_req[124] Vbx_moni_xx_req[125] Vbx_moni_xx_req[126] Vbx_moni_xx_req[127] Vbx_moni_xx_req[128] ctr_err_ecc ctr_err_nvmy ctr_err_nvmy_dec ctr_err_ram ctr_err_rom ctr_err_spi ctr_err_ver ctr_rst ctr_rst_cold ctr_rst_warm ctr_rst_warm_5vr ctr_rst_warm_ecm2 ctr_rst_warm_nvmy ctr_rst_warm_reprog ctr_rst_warm_rly_diag ctr_rst_warm_stu ctr_rst_warm_supram ctr_rst_wtd err_sym_ecu_1 err_sym_ecu_2 err_sym_nvmy err_sym_ram err_sym_rom err_sym_spi err_sym_spi_mps err_sym_spi_qps fls_reg lv_cdn_diag_ecu lv_cdn_diag_nvmy lv_cdn_diag_ram lv_cdn_diag_rom lv_cdn_diag_spi_mps lv_cdn_diag_spi_qps lv_end_diag_rom lv_err_ecu_1 lv_err_ecu_2 lv_err_nvmy lv_err_ram lv_err_rom lv_err_spi lv_nvmy_init_old rst_reason rst_type trap_addr_caller trap_addr_instr trap_inf ctr_rst_eru ctr_rst_eru_n_l lv_ctr_rst_eru_det n_rst_eru n_rst_eru_n_l t_rst_eru_det lv_test_run_ign_0 lv_test_out_ign_0 test_eol_ign_0.lv_test_out_cus_x lv_test_req_ign_0 test_eol_ign_0.lv_adj_out_x test_eol_ign_0.lv_adj_dec_x test_eol_ign_0.lv_adj_inc_x test_eol_ign_0.lv_adj_save_x lv_test_run_ign_1 lv_test_out_ign_1 test_eol_ign_1.lv_test_out_cus_x lv_test_req_ign_1 test_eol_ign_1.lv_adj_out_x test_eol_ign_1.lv_adj_dec_x test_eol_ign_1.lv_adj_inc_x test_eol_ign_1.lv_adj_save_x lv_test_run_ign_2 lv_test_out_ign_2 test_eol_ign_2.lv_test_out_cus_x lv_test_req_ign_2 test_eol_ign_2.lv_adj_out_x test_eol_ign_2.lv_adj_dec_x test_eol_ign_2.lv_adj_inc_x test_eol_ign_2.lv_adj_save_x lv_test_run_ign_3 lv_test_out_ign_3 test_eol_ign_3.lv_test_out_cus_x lv_test_req_ign_3 test_eol_ign_3.lv_adj_out_x test_eol_ign_3.lv_adj_dec_x test_eol_ign_3.lv_adj_inc_x test_eol_ign_3.lv_adj_save_x lv_test_run_inj_0 lv_test_out_inj_0 test_eol_inj_0.lv_test_out_cus_x lv_test_req_inj_0 test_eol_inj_0.lv_adj_out_x test_eol_inj_0.lv_adj_dec_x test_eol_inj_0.lv_adj_inc_x test_eol_inj_0.lv_adj_save_x lv_test_run_inj_1 lv_test_out_inj_1 test_eol_inj_1.lv_test_out_cus_x lv_test_req_inj_1 test_eol_inj_1.lv_adj_out_x test_eol_inj_1.lv_adj_dec_x test_eol_inj_1.lv_adj_inc_x test_eol_inj_1.lv_adj_save_x lv_test_run_inj_2 lv_test_out_inj_2 test_eol_inj_2.lv_test_out_cus_x lv_test_req_inj_2 test_eol_inj_2.lv_adj_out_x test_eol_inj_2.lv_adj_dec_x test_eol_inj_2.lv_adj_inc_x test_eol_inj_2.lv_adj_save_x lv_test_run_inj_3 lv_test_out_inj_3 test_eol_inj_3.lv_test_out_cus_x lv_test_req_inj_3 test_eol_inj_3.lv_adj_out_x test_eol_inj_3.lv_adj_dec_x test_eol_inj_3.lv_adj_inc_x test_eol_inj_3.lv_adj_save_x igc_x_ext_adj[0] igc_x_ext_adj[1] igc_x_ext_adj[2] igc_x_ext_adj[3] lv_cdn_test_eol_ena lv_end_test_req lv_eol_act lv_igc_x_ext_adj[0] lv_igc_x_ext_adj[1] lv_igc_x_ext_adj[2] lv_igc_x_ext_adj[3] lv_stop_test_req lv_test_out_eol lv_test_out_eol_end test_out_ign_0 test_out_ign_1 test_out_ign_2 test_out_ign_3 test_out_inj_0 test_out_inj_1 test_out_inj_2 test_out_inj_3 /end OUT_MEASUREMENT
/end FUNCTION
/end MODULE
/end PROJECT
