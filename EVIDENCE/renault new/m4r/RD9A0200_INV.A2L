ASAP2_VERSION 1 41
/begin PROJECT RD8 "_default_ProjectLongIdentifier"
/begin HEADER "_default_HeaderComment" PROJECT_NO RD9 /end HEADER
/begin MODULE _default_ModuleName "_default_ModuleLongIdentifier"
/begin MOD_COMMON "_default_ModCommonComment" DEPOSIT ABSOLUTE BYTE_ORDER MSB_LAST ALIGNMENT_BYTE 1 ALIGNMENT_WORD 2 ALIGNMENT_LONG 2 ALIGNMENT_FLOAT32_IEEE 2 ALIGNMENT_FLOAT64_IEEE 4 /end MOD_COMMON
/begin AXIS_PTS Ctb_eal2 "9 breakpoint table for Engine air load" 0xa0028f60 Vxx_eal _REC_A2AXS_20_u2 3.99993896484375 _CNV_A_R_LINEAR_____53_CM 9 0. 3.99993896484375 FORMAT "%10.8" /end AXIS_PTS
/begin AXIS_PTS Ctb_eal "16 breakpoint table for Engine air load" 0xa002b7f4 Vxx_eal _REC_A2AXS_20_u2 3.99993896484375 _CNV_A_R_LINEAR_____53_CM 16 0. 3.99993896484375 FORMAT "%10.8" /end AXIS_PTS
/begin AXIS_PTS Ctb_sta_tco "Coolant temperature breakpoints for starting set point tables" 0xa002d498 Vxx_tco _REC_A2AXS_20_u2 240. _CNV_A_R_LINEAR_____110_CM 8 -40. 200. FORMAT "%5.1" /end AXIS_PTS
/begin AXIS_PTS Ctb_tco "16 engine coolant temperature breakpoints" 0xa002d4ac Vxx_tco _REC_A2AXS_20_u2 240. _CNV_A_R_LINEAR_____110_CM 16 -40. 200. FORMAT "%5.1" /end AXIS_PTS
/begin AXIS_PTS Ctb_prs "" 0xa002c9e8 Vxx_map _REC_A2AXS_20_u2 20000. _CNV_A_R_LINEAR_____115_CM 17 0. 20000. FORMAT "%5.0" /end AXIS_PTS
/begin AXIS_PTS Ctb_rich_sp "richness setpoint breakpoints" 0xa00367e8 Vxx_rich_sp _REC_A2AXS_20_u2 1.99996948242188 _CNV_A_R_LINEAR_____48_CM 9 0. 1.99996948242188 FORMAT "%7.5" /end AXIS_PTS
/begin MEASUREMENT Vxx_maf_frh_eng_sp "fresh mass air flow (engine)" UWORD _CNV_A_R_LINEAR_____172_CM 1 0. 0. 3000. ECU_ADDRESS 0xd0004ad0 FORMAT "%7.2" /end MEASUREMENT
/begin MEASUREMENT Vxx_maf_frh_it_sp "fresh mass air flow (throttle)" UWORD _CNV_A_R_LINEAR_____172_CM 1 0. 0. 3000. ECU_ADDRESS 0xd0004ad2 FORMAT "%7.2" /end MEASUREMENT
/begin MEASUREMENT Vxx_pow_ant "anticipated power setpoint" UWORD _CNV_A_R_LINEAR_____186_CM 1 0. 0. 655350. ECU_ADDRESS 0xd0004ad4 FORMAT "%6.0" /end MEASUREMENT
/begin MEASUREMENT Vxx_pow_tgt "target power setpoint" UWORD _CNV_A_R_LINEAR_____186_CM 1 0. 0. 655350. ECU_ADDRESS 0xd0004ad6 FORMAT "%6.0" /end MEASUREMENT
/begin MEASUREMENT Vxx_tq_ant_is_cor "torque correction for idle speed activation" UWORD _CNV_A_R_LINEAR_____181_CM 1 0. 0. 2047.96875 ECU_ADDRESS 0xd0004ad8 FORMAT "%10.5" /end MEASUREMENT
/begin MEASUREMENT Vxx_tqi_ant "final indicated anticipated torque" UWORD _CNV_A_R_LINEAR_____181_CM 1 0. 0. 2047.96875 ECU_ADDRESS 0xd0004ada FORMAT "%10.5" /end MEASUREMENT
/begin CHARACTERISTIC Cbx_ant_is_cor_cfm "Enable torque correction for idle speed activation" VALUE 0xa0021f6e _REC_S1VAL_20_u1 1. _CNV_A_R_ECME_LINEA_0_CM 0. 1. FORMAT "%1.0" BIT_MASK 0x1 /end CHARACTERISTIC
/begin CHARACTERISTIC Cxx_ant_is_drv_thd "derivate of engine speed threshold" VALUE 0xa0021f6c _REC_S1VAL_20_s2 16383. _CNV_A_R_LINEAR_____21_CM -8192. 8191. FORMAT "%5.0" /end CHARACTERISTIC
/begin CHARACTERISTIC Cxx_ant_is_tq_fac "factor" VALUE 0xa0021f6f _REC_S1VAL_20_u1 19.921875 _CNV_A_R_LINEAR_____300_CM 0. 19.921875 FORMAT "%8.6" /end CHARACTERISTIC
/begin CHARACTERISTIC Cxx_ant_is_tq_n_drv_ftc "filtering time for derivate of engine speed" VALUE 0xa0021f70 _REC_S1VAL_20_u1 2.55 _CNV_A_R_LINEAR_____32_CM 0. 2.55 FORMAT "%4.2" /end CHARACTERISTIC
/begin CHARACTERISTIC Cmp_iga_efv_degr_a "Coefficient a of the advance parabola function of engine speed and engine air load" MAP 0xa00363ac _REC_A1MAP_20_u2_u2_u2 1.99996948242187e-003 _CNV_A_R_LINEAR_____222_CM 0. 1.99996948242187e-003 FORMAT "%9.8"
 /begin AXIS_DESCR COM_AXIS Vxx_n _CNV_A_R_ENSD_LINEA_22_CM 20 0. 16383.75 FORMAT "%8.2" AXIS_PTS_REF Ctb_n /end AXIS_DESCR
 /begin AXIS_DESCR COM_AXIS Vxx_eal _CNV_A_R_LINEAR_____53_CM 16 0. 3.99993896484375 FORMAT "%10.8" AXIS_PTS_REF Ctb_eal /end AXIS_DESCR
/end CHARACTERISTIC
/begin MEASUREMENT Vxx_iga_efv_degr_a "Coefficient a of the advance parabola" UWORD _CNV_A_R_LINEAR_____222_CM 1 0. 0. 1.99996948242187e-003 ECU_ADDRESS 0xd0004b30 FORMAT "%9.8" /end MEASUREMENT
/begin MEASUREMENT Vxx_max_iga_efy "torque efficiency corresponding to maximum ignition advance" UWORD _CNV_A_R_LINEAR_____183_CM 1 0. 0. 1. ECU_ADDRESS 0xd0004b32 FORMAT "%11.9" /end MEASUREMENT
/begin MEASUREMENT Vxx_min_iga_efy "torque efficiency corresponding to minimum ignition advance" UWORD _CNV_A_R_LINEAR_____183_CM 1 0. 0. 1. ECU_ADDRESS 0xd0004b34 FORMAT "%11.9" /end MEASUREMENT
/begin MEASUREMENT Vxx_stat_min_iga_efy "torque efficiency corresponding to minimum static ignition advance" UWORD _CNV_A_R_LINEAR_____183_CM 1 0. 0. 1. ECU_ADDRESS 0xd0004b36 FORMAT "%11.9" /end MEASUREMENT
/begin AXIS_PTS Ctb_is_eal "Engine air load breakpoints for idle speed" 0xa003662c Vxx_eal _REC_A2AXS_20_u2 3.99993896484375 _CNV_A_R_LINEAR_____53_CM 9 0. 3.99993896484375 FORMAT "%10.8" /end AXIS_PTS
/begin AXIS_PTS Ctb_is_n "engine speed breakpoints for idle speed" 0xa0036640 Vxx_is_n_sp _REC_A2AXS_20_u2 16383.75 _CNV_A_R_ENSD_LINEA_22_CM 9 0. 16383.75 FORMAT "%8.2" /end AXIS_PTS
/begin CHARACTERISTIC Cmp_n_eal_is_efy "Torque efficiency for idle speed" MAP 0xa0036654 _REC_A1MAP_20_u2_u2_u2 1. _CNV_A_R_LINEAR_____183_CM 0. 1. FORMAT "%11.9"
 /begin AXIS_DESCR COM_AXIS Vxx_is_n_sp _CNV_A_R_ENSD_LINEA_22_CM 9 0. 16383.75 FORMAT "%8.2" AXIS_PTS_REF Ctb_is_n /end AXIS_DESCR
 /begin AXIS_DESCR COM_AXIS Vxx_eal _CNV_A_R_LINEAR_____53_CM 9 0. 3.99993896484375 FORMAT "%10.8" AXIS_PTS_REF Ctb_is_eal /end AXIS_DESCR
/end CHARACTERISTIC
/begin MEASUREMENT Vxx_is_efy "torque efficiency for idle speed controller" UWORD _CNV_A_R_LINEAR_____183_CM 1 0. 0. 1. ECU_ADDRESS 0xd0004b3c FORMAT "%11.9" /end MEASUREMENT
/begin MEASUREMENT Vxx_n_eal_is_efy "Torque efficiency for idle speed for gasoline" UWORD _CNV_A_R_LINEAR_____183_CM 1 0. 0. 1. ECU_ADDRESS 0xd0004b3e FORMAT "%11.9" /end MEASUREMENT
/begin MEASUREMENT Vxx_raw_is_efy "raw torque efficiency for idle speed controller" UWORD _CNV_A_R_LINEAR_____183_CM 1 0. 0. 1. ECU_ADDRESS 0xd0004b40 FORMAT "%11.8" /end MEASUREMENT
/begin CHARACTERISTIC Cxx_is_efy_slop "maximum slop on idle speed efficiency" VALUE 0xa0021f74 _REC_S1VAL_20_u2 100. _CNV_A_R_LINEAR_____301_CM 0. 100. FORMAT "%4.2" /end CHARACTERISTIC
/begin AXIS_PTS Ctb_n_wup "Engine speed breakpoints for catalyst warm-up" 0xa0036950 Vxx_n_mv _REC_A2AXS_20_u2 16383.75 _CNV_A_R_ENSD_LINEA_22_CM 9 0. 16383.75 FORMAT "%8.2" /end AXIS_PTS
/begin AXIS_PTS Ctb_wup_h_l_iga_efy_ctr "Breakpoints of number of TDC" 0xa0036964 Vxx_cata_wup_ctr _REC_A2AXS_20_u2 65535. _CNV_A_R_LINEAR_____101_CM 9 0. 65535. FORMAT "%5.0" /end AXIS_PTS
/begin AXIS_PTS Ctb_wup_tq_rel "9 programmable relative torque ratio breakpoints linked to catalyst warm-up" 0xa0036978 Vxx_tq_rel _REC_A2AXS_20_u2 4. _CNV_A_R_LINEAR_____285_CM 9 -2. 2. FORMAT "%7.4" /end AXIS_PTS
/begin CHARACTERISTIC Cmp_n_tq_rel_wup_cold_iga_efy "Torque efficiency correction for catalyst warm-up in cold start conditions" MAP 0xa003698c _REC_A1MAP_20_u2_u2_u2 1. _CNV_A_R_LINEAR_____183_CM 0. 1. FORMAT "%11.9"
 /begin AXIS_DESCR COM_AXIS Vxx_n_mv _CNV_A_R_ENSD_LINEA_22_CM 9 0. 16383.75 FORMAT "%8.2" AXIS_PTS_REF Ctb_n_wup /end AXIS_DESCR
 /begin AXIS_DESCR COM_AXIS Vxx_tq_rel _CNV_A_R_LINEAR_____285_CM 9 -2. 2. FORMAT "%7.4" AXIS_PTS_REF Ctb_wup_tq_rel /end AXIS_DESCR
/end CHARACTERISTIC
/begin CHARACTERISTIC Cmp_n_tq_rel_wup_h_iga_efy "High torque efficiency correction for catalyst warm-up" MAP 0xa0036a30 _REC_A1MAP_20_u2_u2_u2 1. _CNV_A_R_LINEAR_____183_CM 0. 1. FORMAT "%11.9"
 /begin AXIS_DESCR COM_AXIS Vxx_n_mv _CNV_A_R_ENSD_LINEA_22_CM 9 0. 16383.75 FORMAT "%8.2" AXIS_PTS_REF Ctb_n_wup /end AXIS_DESCR
 /begin AXIS_DESCR COM_AXIS Vxx_tq_rel _CNV_A_R_LINEAR_____285_CM 9 -2. 2. FORMAT "%7.4" AXIS_PTS_REF Ctb_wup_tq_rel /end AXIS_DESCR
/end CHARACTERISTIC
/begin CHARACTERISTIC Cmp_n_tq_rel_wup_l_iga_efy "\"Low\" torque efficiency correction for catalyst warm-up" MAP 0xa0036ad4 _REC_A1MAP_20_u2_u2_u2 1. _CNV_A_R_LINEAR_____183_CM 0. 1. FORMAT "%11.9"
 /begin AXIS_DESCR COM_AXIS Vxx_n_mv _CNV_A_R_ENSD_LINEA_22_CM 9 0. 16383.75 FORMAT "%8.2" AXIS_PTS_REF Ctb_n_wup /end AXIS_DESCR
 /begin AXIS_DESCR COM_AXIS Vxx_tq_rel _CNV_A_R_LINEAR_____285_CM 9 -2. 2. FORMAT "%7.4" AXIS_PTS_REF Ctb_wup_tq_rel /end AXIS_DESCR
/end CHARACTERISTIC
/begin CHARACTERISTIC Ctp_wup_h_l_iga_efy_ctr "Factor to switch between the \"high\" parameters and the \"low\" parameters during the catalyst warm-up" CURVE 0xa0036b78 _REC_A1CUR_20_u2_u2 1. _CNV_A_R_LINEAR_____183_CM 0. 1. FORMAT "%11.9"
 /begin AXIS_DESCR COM_AXIS Vxx_cata_wup_ctr _CNV_A_R_LINEAR_____101_CM 9 0. 65535. FORMAT "%5.0" AXIS_PTS_REF Ctb_wup_h_l_iga_efy_ctr /end AXIS_DESCR
/end CHARACTERISTIC
/begin MEASUREMENT Vxx_tq_rel "Relative torque ratio" UWORD _CNV_A_R_LINEAR_____285_CM 1 0. -2. 2. ECU_ADDRESS 0xd0004b56 FORMAT "%7.4" /end MEASUREMENT
/begin MEASUREMENT Vxx_wup_cold_efy_cor "Torque efficiency correction for catalyst warm-up in cold start conditions" UWORD _CNV_A_R_LINEAR_____183_CM 1 0. 0. 1. ECU_ADDRESS 0xd0004b58 FORMAT "%11.9" /end MEASUREMENT
/begin MEASUREMENT Vxx_wup_efy "warm up efficiency correction" UWORD _CNV_A_R_LINEAR_____183_CM 1 0. 0. 1. ECU_ADDRESS 0xd0004b5a FORMAT "%11.9" /end MEASUREMENT
/begin MEASUREMENT Vxx_wup_efy_cor "Torque efficiency correction for catalyst warm-up with no cold start conditions" UWORD _CNV_A_R_LINEAR_____183_CM 1 0. 0. 1. ECU_ADDRESS 0xd0004b5c FORMAT "%11.9" /end MEASUREMENT
/begin MEASUREMENT Vxx_wup_efy_fil_fac "Factor to filter the efficiency correction in entry and exit of the catalyst warm-up" UWORD _CNV_A_R_LINEAR_____183_CM 1 0. 0. 1. ECU_ADDRESS 0xd0004b5e FORMAT "%11.9" /end MEASUREMENT
/begin MEASUREMENT Vxx_wup_h_l_ctr "Counter to switch between the \"high\" parameters and the \"low\" parameters during the catalyst warm-up" UWORD _CNV_A_R_LINEAR_____183_CM 1 0. 0. 1. ECU_ADDRESS 0xd0004b60 FORMAT "%11.9" /end MEASUREMENT
/begin CHARACTERISTIC Cxx_diag_sta_cata_lbup_wup_efy "Final torque efficiency correction during diagnostic of catalyst or upstream lambda sensor in after sales" VALUE 0xa0021f7a _REC_S1VAL_20_u2 1. _CNV_A_R_LINEAR_____183_CM 0. 1. FORMAT "%11.9" /end CHARACTERISTIC
/begin CHARACTERISTIC Cxx_wup_cold_fil_pos_slop "Positive maximum slope parameter per second in cold start conditions" VALUE 0xa0021f7c _REC_S1VAL_20_u1 50. _CNV_A_R_LINEAR_____302_CM 0. 50. FORMAT "%5.1" /end CHARACTERISTIC
/begin CHARACTERISTIC Cxx_wup_efy_ftc "Time constant of the filter on the torque efficiency in catalyst warm-up" VALUE 0xa0021f7d _REC_S1VAL_20_u1 2.55 _CNV_A_R_LINEAR_____32_CM 0. 2.55 FORMAT "%4.2" /end CHARACTERISTIC
/begin CHARACTERISTIC Cxx_wup_fil_neg_slop "Negative maximum slope parameter per second" VALUE 0xa0021f7e _REC_S1VAL_20_u1 50. _CNV_A_R_LINEAR_____303_CM -50. 0. FORMAT "%5.1" /end CHARACTERISTIC
/begin CHARACTERISTIC Cxx_wup_fil_pos_slop "Positive maximum slope parameter per second" VALUE 0xa0021f7f _REC_S1VAL_20_u1 50. _CNV_A_R_LINEAR_____302_CM 0. 50. FORMAT "%5.1" /end CHARACTERISTIC
/begin AXIS_PTS Ctb_is_cata_wup_efy_ctr "Breakpoints use for catalyst warm-up advance efficiency without cold start conditions" 0xa00366f8 Vxx_cata_wup_ctr _REC_A2AXS_20_u2 65535. _CNV_A_R_LINEAR_____101_CM 23 0. 65535. FORMAT "%5.0" /end AXIS_PTS
/begin CHARACTERISTIC Ctp_is_wup_cold_dri_efy_cor "Torque efficiency correction for catalyst warm-up in idle speed" CURVE 0xa0036728 _REC_A1CUR_20_u2_u2 1. _CNV_A_R_LINEAR_____183_CM 0. 1. FORMAT "%11.9"
 /begin AXIS_DESCR COM_AXIS Vxx_cata_wup_ctr _CNV_A_R_LINEAR_____101_CM 23 0. 65535. FORMAT "%5.0" AXIS_PTS_REF Ctb_is_cata_wup_efy_ctr /end AXIS_DESCR
/end CHARACTERISTIC
/begin CHARACTERISTIC Ctp_is_wup_cold_neut_efy_cor "Torque efficiency correction for catalyst warm-up in idle speed" CURVE 0xa0036758 _REC_A1CUR_20_u2_u2 1. _CNV_A_R_LINEAR_____183_CM 0. 1. FORMAT "%11.9"
 /begin AXIS_DESCR COM_AXIS Vxx_cata_wup_ctr _CNV_A_R_LINEAR_____101_CM 23 0. 65535. FORMAT "%5.0" AXIS_PTS_REF Ctb_is_cata_wup_efy_ctr /end AXIS_DESCR
/end CHARACTERISTIC
/begin CHARACTERISTIC Ctp_is_wup_dri_efy_cor "Torque efficiency correction for catalyst warm-up in idle speed" CURVE 0xa0036788 _REC_A1CUR_20_u2_u2 1. _CNV_A_R_LINEAR_____183_CM 0. 1. FORMAT "%11.9"
 /begin AXIS_DESCR COM_AXIS Vxx_cata_wup_ctr _CNV_A_R_LINEAR_____101_CM 23 0. 65535. FORMAT "%5.0" AXIS_PTS_REF Ctb_is_cata_wup_efy_ctr /end AXIS_DESCR
/end CHARACTERISTIC
/begin CHARACTERISTIC Ctp_is_wup_neut_efy_cor "Torque efficiency correction for catalyst warm-up in idle speed" CURVE 0xa00367b8 _REC_A1CUR_20_u2_u2 1. _CNV_A_R_LINEAR_____183_CM 0. 1. FORMAT "%11.9"
 /begin AXIS_DESCR COM_AXIS Vxx_cata_wup_ctr _CNV_A_R_LINEAR_____101_CM 23 0. 65535. FORMAT "%5.0" AXIS_PTS_REF Ctb_is_cata_wup_efy_ctr /end AXIS_DESCR
/end CHARACTERISTIC
/begin MEASUREMENT Vbx_not_cold_sta_tco "Vxx_sta_tco is superior to Cxx_cold_sta_tco" UBYTE _CNV_S_2_RANGE______3_CM 1 0. 0. 1. ECU_ADDRESS 0xd00071b4 BIT_MASK 0x1 /end MEASUREMENT
/begin MEASUREMENT Vxx_is_wup_cold_neut_efy_cor "Torque efficiency correction for catalyst warm-up in idle speed and with a manual gearbox or in neutral state (AT)" UWORD _CNV_A_R_LINEAR_____183_CM 1 0. 0. 1. ECU_ADDRESS 0xd0004b44 FORMAT "%11.9" /end MEASUREMENT
/begin MEASUREMENT Vxx_is_wup_dri_efy_cor "Torque efficiency correction for catalyst warm-up in idle speed and in Drive state (AT)" UWORD _CNV_A_R_LINEAR_____183_CM 1 0. 0. 1. ECU_ADDRESS 0xd0004b46 FORMAT "%11.9" /end MEASUREMENT
/begin MEASUREMENT Vxx_is_wup_efy "Torque efficiency correction for catalyst warm-up in idle speed" UWORD _CNV_A_R_LINEAR_____183_CM 1 0. 0. 1. ECU_ADDRESS 0xd0004b48 FORMAT "%11.9" /end MEASUREMENT
/begin MEASUREMENT Vxx_is_wup_efy_fil_fac "Factor to filter the torque efficiency correction in entry and exit of the catalyst warm-up in idle speed" UWORD _CNV_A_R_LINEAR_____183_CM 1 0. 0. 1. ECU_ADDRESS 0xd0004b4a FORMAT "%11.9" /end MEASUREMENT
/begin MEASUREMENT Vxx_is_wup_neut_efy_cor "Torque efficiency correction for catalyst warm-up in idle speed and with a manual gearbox or in neutral state (AT)" UWORD _CNV_A_R_LINEAR_____183_CM 1 0. 0. 1. ECU_ADDRESS 0xd0004b4c FORMAT "%11.9" /end MEASUREMENT
/begin CHARACTERISTIC Cxx_is_wup_fil_neg_slop "Negative maximum slope parameter per second" VALUE 0xa0021f76 _REC_S1VAL_20_u1 50. _CNV_A_R_LINEAR_____303_CM -50. 0. FORMAT "%5.1" /end CHARACTERISTIC
/begin CHARACTERISTIC Cxx_is_wup_fil_pos_slop "Positive maximum slope parameter per second" VALUE 0xa0021f77 _REC_S1VAL_20_u1 50. _CNV_A_R_LINEAR_____302_CM 0. 50. FORMAT "%5.1" /end CHARACTERISTIC
/begin AXIS_PTS Ctb_wup_h_l_iga_efy_ctr_alco "Breakpoints of number of TDC" 0xa0035cc0 Vxx_cata_wup_ctr _REC_A2AXS_20_u2 65535. _CNV_A_R_LINEAR_____101_CM 9 0. 65535. FORMAT "%5.0" /end AXIS_PTS
/begin CHARACTERISTIC Cmp_iga_efv_degr_a_alco "Coefficient a of the advance parabola function of engine speed and engine air load for flex-fuel" MAP 0xa0035cd4 _REC_A1MAP_20_u2_u2_u2 1.99996948242187e-003 _CNV_A_R_LINEAR_____222_CM 0. 1.99996948242187e-003 FORMAT "%9.8"
 /begin AXIS_DESCR COM_AXIS Vxx_n _CNV_A_R_ENSD_LINEA_22_CM 20 0. 16383.75 FORMAT "%8.2" AXIS_PTS_REF Ctb_n /end AXIS_DESCR
 /begin AXIS_DESCR COM_AXIS Vxx_eal _CNV_A_R_LINEAR_____53_CM 16 0. 3.99993896484375 FORMAT "%10.8" AXIS_PTS_REF Ctb_eal /end AXIS_DESCR
/end CHARACTERISTIC
/begin CHARACTERISTIC Cmp_n_eal_is_efy_alco "Torque efficiency for idle speed for alcohol" MAP 0xa0035f54 _REC_A1MAP_20_u2_u2_u2 1. _CNV_A_R_LINEAR_____183_CM 0. 1. FORMAT "%11.9"
 /begin AXIS_DESCR COM_AXIS Vxx_is_n_sp _CNV_A_R_ENSD_LINEA_22_CM 9 0. 16383.75 FORMAT "%8.2" AXIS_PTS_REF Ctb_is_n /end AXIS_DESCR
 /begin AXIS_DESCR COM_AXIS Vxx_eal _CNV_A_R_LINEAR_____53_CM 9 0. 3.99993896484375 FORMAT "%10.8" AXIS_PTS_REF Ctb_is_eal /end AXIS_DESCR
/end CHARACTERISTIC
/begin CHARACTERISTIC Cmp_n_eal_otl_tqi_fac_alco "Massic hp indicated torque factor depending on engine air load and engine speed" MAP 0xa0035ff8 _REC_A1MAP_20_u1_u2_u2 0.498046875 _CNV_A_R_LINEAR_____298_CM 0.501953125 1. FORMAT "%11.9"
 /begin AXIS_DESCR COM_AXIS Vxx_n _CNV_A_R_ENSD_LINEA_22_CM 20 0. 16383.75 FORMAT "%8.2" AXIS_PTS_REF Ctb_n /end AXIS_DESCR
 /begin AXIS_DESCR COM_AXIS Vxx_eal _CNV_A_R_LINEAR_____53_CM 16 0. 3.99993896484375 FORMAT "%10.8" AXIS_PTS_REF Ctb_eal /end AXIS_DESCR
/end CHARACTERISTIC
/begin CHARACTERISTIC Cmp_n_tq_wup_cold_efy_alco "Torque efficiency correction for catalyst warm-up in cold start conditions" MAP 0xa0036138 _REC_A1MAP_20_u2_u2_u2 1. _CNV_A_R_LINEAR_____183_CM 0. 1. FORMAT "%11.9"
 /begin AXIS_DESCR COM_AXIS Vxx_n_mv _CNV_A_R_ENSD_LINEA_22_CM 9 0. 16383.75 FORMAT "%8.2" AXIS_PTS_REF Ctb_n_wup /end AXIS_DESCR
 /begin AXIS_DESCR COM_AXIS Vxx_tq_rel _CNV_A_R_LINEAR_____285_CM 9 -2. 2. FORMAT "%7.4" AXIS_PTS_REF Ctb_wup_tq_rel /end AXIS_DESCR
/end CHARACTERISTIC
/begin CHARACTERISTIC Cmp_n_tq_wup_h_iga_efy_alco "\"High\" torque efficiency correction for catalyst warm-up" MAP 0xa00361dc _REC_A1MAP_20_u2_u2_u2 1. _CNV_A_R_LINEAR_____183_CM 0. 1. FORMAT "%11.9"
 /begin AXIS_DESCR COM_AXIS Vxx_n_mv _CNV_A_R_ENSD_LINEA_22_CM 9 0. 16383.75 FORMAT "%8.2" AXIS_PTS_REF Ctb_n_wup /end AXIS_DESCR
 /begin AXIS_DESCR COM_AXIS Vxx_tq_rel _CNV_A_R_LINEAR_____285_CM 9 -2. 2. FORMAT "%7.4" AXIS_PTS_REF Ctb_wup_tq_rel /end AXIS_DESCR
/end CHARACTERISTIC
/begin CHARACTERISTIC Cmp_n_tq_wup_l_iga_efy_alco "\"Low\" torque efficiency correction for catalyst warm-up" MAP 0xa0036280 _REC_A1MAP_20_u2_u2_u2 1. _CNV_A_R_LINEAR_____183_CM 0. 1. FORMAT "%11.9"
 /begin AXIS_DESCR COM_AXIS Vxx_n_mv _CNV_A_R_ENSD_LINEA_22_CM 9 0. 16383.75 FORMAT "%8.2" AXIS_PTS_REF Ctb_n_wup /end AXIS_DESCR
 /begin AXIS_DESCR COM_AXIS Vxx_tq_rel _CNV_A_R_LINEAR_____285_CM 9 -2. 2. FORMAT "%7.4" AXIS_PTS_REF Ctb_wup_tq_rel /end AXIS_DESCR
/end CHARACTERISTIC
/begin CHARACTERISTIC Ctp_is_wup_cold_neut_efy_alco "Torque efficiency correction for catalyst warm-up in idle speed" CURVE 0xa0036324 _REC_A1CUR_20_u2_u2 1. _CNV_A_R_LINEAR_____183_CM 0. 1. FORMAT "%11.9"
 /begin AXIS_DESCR COM_AXIS Vxx_cata_wup_ctr _CNV_A_R_LINEAR_____101_CM 23 0. 65535. FORMAT "%5.0" AXIS_PTS_REF Ctb_is_cata_wup_efy_ctr /end AXIS_DESCR
/end CHARACTERISTIC
/begin CHARACTERISTIC Ctp_is_wup_neut_efy_alco "Torque efficiency correction for catalyst warm-up in idle speed." CURVE 0xa0036354 _REC_A1CUR_20_u2_u2 1. _CNV_A_R_LINEAR_____183_CM 0. 1. FORMAT "%11.9"
 /begin AXIS_DESCR COM_AXIS Vxx_cata_wup_ctr _CNV_A_R_LINEAR_____101_CM 23 0. 65535. FORMAT "%5.0" AXIS_PTS_REF Ctb_is_cata_wup_efy_ctr /end AXIS_DESCR
/end CHARACTERISTIC
/begin CHARACTERISTIC Ctp_rich_otl_iga_tqi_fac_alco "Massic hp indicated torque factor depending on Air/fuel ratio target for flex-fuel." CURVE 0xa0036384 _REC_A1CUR_20_u2_u2 2. _CNV_A_R_LINEAR_____183_CM 0. 2. FORMAT "%11.8"
 /begin AXIS_DESCR COM_AXIS Vxx_rich_sp _CNV_A_R_LINEAR_____48_CM 9 0. 1.99996948242188 FORMAT "%7.5" AXIS_PTS_REF Ctb_rich_sp /end AXIS_DESCR
/end CHARACTERISTIC
/begin CHARACTERISTIC Ctp_wup_h_l_iga_efy_ctr_alco "Factor to switch between the \"high\" parameters and the \"low\" parameters during the catalyst warm-up" CURVE 0xa0036398 _REC_A1CUR_20_u2_u2 1. _CNV_A_R_LINEAR_____183_CM 0. 1. FORMAT "%11.9"
 /begin AXIS_DESCR COM_AXIS Vxx_cata_wup_ctr _CNV_A_R_LINEAR_____101_CM 9 0. 65535. FORMAT "%5.0" AXIS_PTS_REF Ctb_wup_h_l_iga_efy_ctr_alco /end AXIS_DESCR
/end CHARACTERISTIC
/begin MEASUREMENT Vxx_iga_efv_degr_a_alco "Coefficient a of the advance parabola for flex-fuel" UWORD _CNV_A_R_LINEAR_____222_CM 1 0. 0. 1.99996948242187e-003 ECU_ADDRESS 0xd0004adc FORMAT "%9.8" /end MEASUREMENT
/begin MEASUREMENT Vxx_is_wup_cold_neut_efy_alco "Torque efficiency correction for catalyst warm-up in idle speed and with alcohol" UWORD _CNV_A_R_LINEAR_____183_CM 1 0. 0. 1. ECU_ADDRESS 0xd0004ade FORMAT "%11.9" /end MEASUREMENT
/begin MEASUREMENT Vxx_is_wup_neut_efy_alco "Torque efficiency correction for catalyst warm-up in idle speed, with MGB or in neutral state (AT), with alcohol" UWORD _CNV_A_R_LINEAR_____183_CM 1 0. 0. 1. ECU_ADDRESS 0xd0004ae0 FORMAT "%11.9" /end MEASUREMENT
/begin MEASUREMENT Vxx_n_eal_is_efy_alco "Torque efficiency for idle speed for alcohol" UWORD _CNV_A_R_LINEAR_____183_CM 1 0. 0. 1. ECU_ADDRESS 0xd0004ae2 FORMAT "%11.9" /end MEASUREMENT
/begin MEASUREMENT Vxx_otl_iga_mv_tqi_alco "HP indicated torque for 1kg of air at optimal advance for flex-fuel." UWORD _CNV_A_R_LINEAR_____299_CM 1 0. 0. 524280. ECU_ADDRESS 0xd000609a FORMAT "%6.0" /end MEASUREMENT
/begin MEASUREMENT Vxx_wup_cold_efy_cor_alco "Torque efficiency correction for catalyst warm-up in cold start conditions" UWORD _CNV_A_R_LINEAR_____183_CM 1 0. 0. 1. ECU_ADDRESS 0xd0004ae4 FORMAT "%11.9" /end MEASUREMENT
/begin MEASUREMENT Vxx_wup_efy_cor_alco "Torque efficiency correction for catalyst warm-up with no cold start conditions" UWORD _CNV_A_R_LINEAR_____183_CM 1 0. 0. 1. ECU_ADDRESS 0xd0004ae6 FORMAT "%11.9" /end MEASUREMENT
/begin MEASUREMENT Vxx_wup_h_l_ctr_alco "Counter to switch between the high parameters and the low parameters during the catalyst warm-up" UWORD _CNV_A_R_LINEAR_____183_CM 1 0. 0. 1. ECU_ADDRESS 0xd0002384 FORMAT "%11.8" /end MEASUREMENT
/begin CHARACTERISTIC Cxx_otl_iga_tqi_alco "massic hp indicated torque for flex-fuel." VALUE 0xa0021f72 _REC_S1VAL_20_u2 524280. _CNV_A_R_LINEAR_____299_CM 0. 524280. FORMAT "%6.0" /end CHARACTERISTIC
/begin AXIS_PTS Ctb_n_iga_tkof "9 programmable engine speed breakpoints map for ignition advance correction during take-off" 0xa0027904 Vxx_n _REC_A2AXS_20_u2 16383.75 _CNV_A_R_ENSD_LINEA_22_CM 9 0. 16383.75 FORMAT "%8.2" /end AXIS_PTS
/begin CHARACTERISTIC Cmp_n_map_cart_iga_bch "ignition advance map (bench mode only) function of engine speed and manifold pressure" MAP 0xa0027918 _REC_A1MAP_20_u1_u2_u2 95.625 _CNV_A_R_IGRE_LINEA_47_CM -23.625 72. FORMAT "%7.3"
 /begin AXIS_DESCR COM_AXIS Vxx_n _CNV_A_R_ENSD_LINEA_22_CM 20 0. 16383.75 FORMAT "%8.2" AXIS_PTS_REF Ctb_n /end AXIS_DESCR
 /begin AXIS_DESCR COM_AXIS Vxx_map _CNV_A_R_LINEAR_____115_CM 17 0. 20000. FORMAT "%5.0" AXIS_PTS_REF Ctb_prs /end AXIS_DESCR
/end CHARACTERISTIC
/begin CHARACTERISTIC Ctp_n_grd_driv_tqe_iga_cor "Value of effective engine torque requested gradient necessary to activate advance correction" CURVE 0xa0027a6c _REC_A1CUR_20_u2_u2 1300. _CNV_A_R_LINEAR_____304_CM -650. 650. FORMAT "%5.2"
 /begin AXIS_DESCR COM_AXIS Vxx_n _CNV_A_R_ENSD_LINEA_22_CM 9 0. 16383.75 FORMAT "%8.2" AXIS_PTS_REF Ctb_n_iga_tkof /end AXIS_DESCR
/end CHARACTERISTIC
/begin CHARACTERISTIC Ctp_n_grd_tqi_iga_cor "Value of torque gradient necessary to activate advance correction" CURVE 0xa0027a80 _REC_A1CUR_20_u2_u2 1300. _CNV_A_R_LINEAR_____304_CM -650. 650. FORMAT "%5.2"
 /begin AXIS_DESCR COM_AXIS Vxx_n _CNV_A_R_ENSD_LINEA_22_CM 9 0. 16383.75 FORMAT "%8.2" AXIS_PTS_REF Ctb_n_iga_tkof /end AXIS_DESCR
/end CHARACTERISTIC
/begin CHARACTERISTIC Ctp_n_iga_slwr_stop_1 "Table of value of slew rate to stop ignition advance correction during take-off in mode 1" CURVE 0xa0027a94 _REC_A1CUR_20_u1_u2 796.875 _CNV_A_R_LINEAR_____305_CM 0. 796.875 FORMAT "%7.3"
 /begin AXIS_DESCR COM_AXIS Vxx_n _CNV_A_R_ENSD_LINEA_22_CM 9 0. 16383.75 FORMAT "%8.2" AXIS_PTS_REF Ctb_n_iga_tkof /end AXIS_DESCR
/end CHARACTERISTIC
/begin CHARACTERISTIC Ctp_n_iga_slwr_stop_2 "Table of value of slew rate to stop ignition advance correction during take-off in mode 2" CURVE 0xa0027aa0 _REC_A1CUR_20_u1_u2 796.875 _CNV_A_R_LINEAR_____305_CM 0. 796.875 FORMAT "%7.3"
 /begin AXIS_DESCR COM_AXIS Vxx_n _CNV_A_R_ENSD_LINEA_22_CM 9 0. 16383.75 FORMAT "%8.2" AXIS_PTS_REF Ctb_n_iga_tkof /end AXIS_DESCR
/end CHARACTERISTIC
/begin CHARACTERISTIC Ctp_n_iga_tkof_abv_1 "Table of absolute value of ignition advance during take-off in mode 1" CURVE 0xa0027aac _REC_A1CUR_20_u1_u2 95.625 _CNV_A_R_IGRE_LINEA_47_CM -23.625 72. FORMAT "%7.3"
 /begin AXIS_DESCR COM_AXIS Vxx_n _CNV_A_R_ENSD_LINEA_22_CM 9 0. 16383.75 FORMAT "%8.2" AXIS_PTS_REF Ctb_n_iga_tkof /end AXIS_DESCR
/end CHARACTERISTIC
/begin CHARACTERISTIC Ctp_n_iga_tkof_abv_2 "Table of absolute value of ignition advance during take-off in mode 2" CURVE 0xa0027ab8 _REC_A1CUR_20_u1_u2 95.625 _CNV_A_R_IGRE_LINEA_47_CM -23.625 72. FORMAT "%7.3"
 /begin AXIS_DESCR COM_AXIS Vxx_n _CNV_A_R_ENSD_LINEA_22_CM 9 0. 16383.75 FORMAT "%8.2" AXIS_PTS_REF Ctb_n_iga_tkof /end AXIS_DESCR
/end CHARACTERISTIC
/begin CHARACTERISTIC Ctp_n_iga_tkof_t_1 "Table of duration of ignition advance correction during take-off in mode 1" CURVE 0xa0027ac4 _REC_A1CUR_20_u1_u2 2.55 _CNV_A_R_LINEAR_____32_CM 0. 2.55 FORMAT "%4.2"
 /begin AXIS_DESCR COM_AXIS Vxx_n _CNV_A_R_ENSD_LINEA_22_CM 9 0. 16383.75 FORMAT "%8.2" AXIS_PTS_REF Ctb_n_iga_tkof /end AXIS_DESCR
/end CHARACTERISTIC
/begin CHARACTERISTIC Ctp_n_iga_tkof_t_2 "Table of duration of ignition advance correction during take-off in mode 2" CURVE 0xa0027ad0 _REC_A1CUR_20_u1_u2 2.55 _CNV_A_R_LINEAR_____32_CM 0. 2.55 FORMAT "%4.2"
 /begin AXIS_DESCR COM_AXIS Vxx_n _CNV_A_R_ENSD_LINEA_22_CM 9 0. 16383.75 FORMAT "%8.2" AXIS_PTS_REF Ctb_n_iga_tkof /end AXIS_DESCR
/end CHARACTERISTIC
/begin MEASUREMENT Vbx_cor_iga_cdn_1 "Condition for ignition advance correction during take-off in mode 1" UBYTE _CNV_S_2_RANGE______3_CM 1 0. 0. 1. ECU_ADDRESS 0xd00066a2 BIT_MASK 0x1 /end MEASUREMENT
/begin MEASUREMENT Vbx_cor_iga_cdn_2 "Condition for ignition advance correction during take-off in mode 2" UBYTE _CNV_S_2_RANGE______3_CM 1 0. 0. 1. ECU_ADDRESS 0xd00066a3 BIT_MASK 0x1 /end MEASUREMENT
/begin MEASUREMENT Vtx_iga_appl_itl[0] "Intermediate vector to calculate Vxx_iga_appl and Vxx_iga_pred" UBYTE _CNV_A_R_IGRE_LINEA_47_CM 1 0. -23.625 72. ECU_ADDRESS 0xd00066a0 FORMAT "%7.3" /end MEASUREMENT
/begin MEASUREMENT Vtx_iga_appl_itl[1] "Intermediate vector to calculate Vxx_iga_appl and Vxx_iga_pred" UBYTE _CNV_A_R_IGRE_LINEA_47_CM 1 0. -23.625 72. ECU_ADDRESS 0xd00066a1 FORMAT "%7.3" /end MEASUREMENT
/begin MEASUREMENT Vxx_iga_appl "applied ignition advance after knock correction" UBYTE _CNV_A_R_IGRE_LINEA_47_CM 1 0. -23.625 72. ECU_ADDRESS 0xd00066a4 FORMAT "%7.3" /end MEASUREMENT
/begin MEASUREMENT Vxx_iga_pred "applied ignition advance after knock correction for next TDC" UBYTE _CNV_A_R_IGRE_LINEA_47_CM 1 0. -23.625 72. ECU_ADDRESS 0xd00066a5 FORMAT "%7.3" /end MEASUREMENT
/begin MEASUREMENT Vxx_n_iga_slwr_stop "Value of slew rate to stop ignition advance correction during take-off" UBYTE _CNV_A_R_LINEAR_____305_CM 1 0. 0. 796.875 ECU_ADDRESS 0xd00066a6 FORMAT "%7.3" /end MEASUREMENT
/begin MEASUREMENT Vxx_n_iga_tkof_abv "Absolute value of ignition advance during take-off" UBYTE _CNV_A_R_IGRE_LINEA_47_CM 1 0. -23.625 72. ECU_ADDRESS 0xd00066a7 FORMAT "%7.3" /end MEASUREMENT
/begin MEASUREMENT Vxx_n_iga_tkof_t "Duration of ignition advance correction during take-off" UBYTE _CNV_A_R_LINEAR_____32_CM 1 0. 0. 2.55 ECU_ADDRESS 0xd00066a8 FORMAT "%4.2" /end MEASUREMENT
/begin MEASUREMENT Vxx_nom_iga "applied ignition advance before knock correction" UBYTE _CNV_A_R_IGRE_LINEA_47_CM 1 0. -23.625 72. ECU_ADDRESS 0xd00066a9 FORMAT "%7.3" /end MEASUREMENT
/begin CHARACTERISTIC Cbx_cart_iga_bch_cfm "bench mode for ignition (map)" VALUE 0xa0020d9a _REC_S1VAL_20_u1 1. _CNV_A_R_ECME_LINEA_0_CM 0. 1. FORMAT "%1.0" BIT_MASK 0x1 /end CHARACTERISTIC
/begin CHARACTERISTIC Cbx_iga_bch_cfm "bench mode for ignition advance (calibration)" VALUE 0xa0020d9b _REC_S1VAL_20_u1 1. _CNV_A_R_ECME_LINEA_0_CM 0. 1. FORMAT "%1.0" BIT_MASK 0x1 /end CHARACTERISTIC
/begin CHARACTERISTIC Cbx_iga_ofs_bch_cfm "ignition adavance bench mode (offset cylinder to cylinder)" VALUE 0xa0020d9c _REC_S1VAL_20_u1 1. _CNV_A_R_ECME_LINEA_0_CM 0. 1. FORMAT "%1.0" BIT_MASK 0x1 /end CHARACTERISTIC
/begin CHARACTERISTIC Cbx_iga_tkof_cor "Boolean to activate ignition advance correction during take-off" VALUE 0xa0020d9d _REC_S1VAL_20_u1 1. _CNV_A_R_ECME_LINEA_0_CM 0. 1. FORMAT "%1.0" BIT_MASK 0x1 /end CHARACTERISTIC
/begin CHARACTERISTIC Cxx_eal_iga_cor_1 "Value max of engine air load for correction during take-off in mode 1" VALUE 0xa0020d8c _REC_S1VAL_20_u2 3.99993896484375 _CNV_A_R_LINEAR_____53_CM 0. 3.99993896484375 FORMAT "%10.8" /end CHARACTERISTIC
/begin CHARACTERISTIC Cxx_eal_iga_cor_2 "Value max of engine air load for correction during take-off in mode 2" VALUE 0xa0020d8e _REC_S1VAL_20_u2 3.99993896484375 _CNV_A_R_LINEAR_____53_CM 0. 3.99993896484375 FORMAT "%10.8" /end CHARACTERISTIC
/begin CHARACTERISTIC Cxx_ftc_grd_driv_tqe_iga_cor "Time constant for first order filter in effective engine torque requested gradient detection" VALUE 0xa0020d9e _REC_S1VAL_20_u1 5.1 _CNV_A_R_LINEAR_____131_CM 0. 5.1 FORMAT "%4.2" /end CHARACTERISTIC
/begin CHARACTERISTIC Cxx_ftc_grd_tqi_iga_cor "Time constant for first order filter in torque gradient detection" VALUE 0xa0020d9f _REC_S1VAL_20_u1 5.1 _CNV_A_R_LINEAR_____131_CM 0. 5.1 FORMAT "%4.2" /end CHARACTERISTIC
/begin CHARACTERISTIC Cxx_iga_appl_ini "Ignition advance initial value." VALUE 0xa0020da0 _REC_S1VAL_20_u1 95.625 _CNV_A_R_IGRE_LINEA_47_CM -23.625 72. FORMAT "%7.3" /end CHARACTERISTIC
/begin CHARACTERISTIC Cxx_iga_bch "ignition advance for bench mode" VALUE 0xa0020da1 _REC_S1VAL_20_u1 95.625 _CNV_A_R_IGRE_LINEA_47_CM -23.625 72. FORMAT "%7.3" /end CHARACTERISTIC
/begin CHARACTERISTIC Cxx_iga_ofs_cyl1 "ignition advance offset for bench mode (cylinder 1)" VALUE 0xa0020da2 _REC_S1VAL_20_u1 95.625 _CNV_A_R_IGRE_LINEA_47_CM -23.625 72. FORMAT "%7.3" /end CHARACTERISTIC
/begin CHARACTERISTIC Cxx_iga_ofs_cyl2 "ignition advance offset for bench mode (cylinder 2)" VALUE 0xa0020da3 _REC_S1VAL_20_u1 95.625 _CNV_A_R_IGRE_LINEA_47_CM -23.625 72. FORMAT "%7.3" /end CHARACTERISTIC
/begin CHARACTERISTIC Cxx_iga_ofs_cyl3 "ignition advance offset for bench mode (cylinder 3)" VALUE 0xa0020da4 _REC_S1VAL_20_u1 95.625 _CNV_A_R_IGRE_LINEA_47_CM -23.625 72. FORMAT "%7.3" /end CHARACTERISTIC
/begin CHARACTERISTIC Cxx_iga_ofs_cyl4 "ignition advance offset for bench mode (cylinder 4)" VALUE 0xa0020da5 _REC_S1VAL_20_u1 95.625 _CNV_A_R_IGRE_LINEA_47_CM -23.625 72. FORMAT "%7.3" /end CHARACTERISTIC
/begin CHARACTERISTIC Cxx_mat_iga_cor_1 "Value of manifold air temperature for correction during take-off in mode 1" VALUE 0xa0020d90 _REC_S1VAL_20_u2 240. _CNV_A_R_LINEAR_____110_CM -40. 200. FORMAT "%5.1" /end CHARACTERISTIC
/begin CHARACTERISTIC Cxx_mat_iga_cor_2 "Value of manifold air temperature for correction during take-off in mode 2" VALUE 0xa0020d92 _REC_S1VAL_20_u2 240. _CNV_A_R_LINEAR_____110_CM -40. 200. FORMAT "%5.1" /end CHARACTERISTIC
/begin CHARACTERISTIC Cxx_n_prim_sha_spd_dif_2 "Value max of difference between engine speed and turbine speed to activate correction in mode 2" VALUE 0xa0020d94 _REC_S1VAL_20_s2 16383.75 _CNV_A_R_ENSD_LINEA_22_CM -8192. 8191.75 FORMAT "%8.2" /end CHARACTERISTIC
/begin CHARACTERISTIC Cxx_tco_iga_cor_1 "Value of coolant temperature for correction during take-off in mode 1" VALUE 0xa0020d96 _REC_S1VAL_20_u2 240. _CNV_A_R_LINEAR_____110_CM -40. 200. FORMAT "%5.1" /end CHARACTERISTIC
/begin CHARACTERISTIC Cxx_tco_iga_cor_2 "Value of coolant temperature for correction during take-off in mode 2" VALUE 0xa0020d98 _REC_S1VAL_20_u2 240. _CNV_A_R_LINEAR_____110_CM -40. 200. FORMAT "%5.1" /end CHARACTERISTIC
/begin CHARACTERISTIC Cmp_n_tco_sta_iga "Starting advance Table - coolant temperature and engine speed dependant" MAP 0xa0027adc _REC_A1MAP_20_u1_u2_u2 95.625 _CNV_A_R_IGRE_LINEA_47_CM -23.625 72. FORMAT "%7.3"
 /begin AXIS_DESCR COM_AXIS Vxx_tco _CNV_A_R_LINEAR_____110_CM 8 -40. 200. FORMAT "%5.1" AXIS_PTS_REF Ctb_sta_tco /end AXIS_DESCR
 /begin AXIS_DESCR COM_AXIS Vxx_n _CNV_A_R_ENSD_LINEA_22_CM 8 0. 16383.75 FORMAT "%8.2" AXIS_PTS_REF Ctb_sta_n /end AXIS_DESCR
/end CHARACTERISTIC
/begin MEASUREMENT Vxx_sta_iga "start ignition advance" UBYTE _CNV_A_R_IGRE_LINEA_47_CM 1 0. -23.625 72. ECU_ADDRESS 0xd00066aa FORMAT "%7.3" /end MEASUREMENT
/begin CHARACTERISTIC Cmp_n_tco_sta_iga_alco "Starting advance Table - coolant temperature and engine speed dependant for flex-fuel" MAP 0xa00278c4 _REC_A1MAP_20_u1_u2_u2 95.625 _CNV_A_R_IGRE_LINEA_47_CM -23.625 72. FORMAT "%7.3"
 /begin AXIS_DESCR COM_AXIS Vxx_tco _CNV_A_R_LINEAR_____110_CM 8 -40. 200. FORMAT "%5.1" AXIS_PTS_REF Ctb_sta_tco /end AXIS_DESCR
 /begin AXIS_DESCR COM_AXIS Vxx_n _CNV_A_R_ENSD_LINEA_22_CM 8 0. 16383.75 FORMAT "%8.2" AXIS_PTS_REF Ctb_sta_n /end AXIS_DESCR
/end CHARACTERISTIC
/begin MEASUREMENT Vxx_n_tco_sta_iga_alco "start ignition advance for Flex Fuel." UBYTE _CNV_A_R_IGRE_LINEA_47_CM 1 0. -23.625 72. ECU_ADDRESS 0xd000669b FORMAT "%7.3" /end MEASUREMENT
/begin MEASUREMENT Vxx_knk_slow_cor_max_iga_NVM "Maximum ignition timing correction of the slow loop for all the cylinders" UBYTE _CNV_A_R_LINEAR_____23_CM 1 0. 0. 95.625 DISPLAY_IDENTIFIER CbIgnLim_NVM.Vxx_knk_slow_cor_max_iga_NVM ECU_ADDRESS 0xd0006678 /end MEASUREMENT
/begin MEASUREMENT Vxx_knk_slow_iga_zon1 "Mean Value of slow knk correction of the area 1." UBYTE _CNV_A_R_LINEAR_____306_CM 1 0. 0. 7.96875 DISPLAY_IDENTIFIER CbIgnLim_NVM.Vxx_knk_slow_iga_zon1_NVM ECU_ADDRESS 0xd0006679 FORMAT "%7.5" /end MEASUREMENT
/begin MEASUREMENT Vxx_knk_slow_iga_zon2 "Mean Value of slow knk correction of the area 2." UBYTE _CNV_A_R_LINEAR_____306_CM 1 0. 0. 7.96875 DISPLAY_IDENTIFIER CbIgnLim_NVM.Vxx_knk_slow_iga_zon2_NVM ECU_ADDRESS 0xd000667a FORMAT "%7.5" /end MEASUREMENT
/begin MEASUREMENT Vxx_knk_slow_iga_zon3 "Mean Value of slow knk correction of the area 3." UBYTE _CNV_A_R_LINEAR_____306_CM 1 0. 0. 7.96875 DISPLAY_IDENTIFIER CbIgnLim_NVM.Vxx_knk_slow_iga_zon3_NVM ECU_ADDRESS 0xd000667b FORMAT "%7.5" /end MEASUREMENT
/begin MEASUREMENT Vxx_knk_slow_iga_zon4 "Mean Value of slow knk correction of the area 4." UBYTE _CNV_A_R_LINEAR_____306_CM 1 0. 0. 7.96875 DISPLAY_IDENTIFIER CbIgnLim_NVM.Vxx_knk_slow_iga_zon4_NVM ECU_ADDRESS 0xd000667c FORMAT "%7.5" /end MEASUREMENT
/begin MEASUREMENT Vxx_knk_slow_iga_zon5 "Mean Value of slow knk correction of the area 5." UBYTE _CNV_A_R_LINEAR_____306_CM 1 0. 0. 7.96875 DISPLAY_IDENTIFIER CbIgnLim_NVM.Vxx_knk_slow_iga_zon5_NVM ECU_ADDRESS 0xd000667d FORMAT "%7.5" /end MEASUREMENT
/begin MEASUREMENT Vxx_knk_slow_iga_zon6 "Mean Value of slow knk correction of the area 6." UBYTE _CNV_A_R_LINEAR_____306_CM 1 0. 0. 7.96875 DISPLAY_IDENTIFIER CbIgnLim_NVM.Vxx_knk_slow_iga_zon6_NVM ECU_ADDRESS 0xd000667e FORMAT "%7.5" /end MEASUREMENT
/begin MEASUREMENT Vxx_knk_slow_iga_zon7 "Mean Value of slow knk correction of the area 7." UBYTE _CNV_A_R_LINEAR_____306_CM 1 0. 0. 7.96875 DISPLAY_IDENTIFIER CbIgnLim_NVM.Vxx_knk_slow_iga_zon7_NVM ECU_ADDRESS 0xd000667f FORMAT "%7.5" /end MEASUREMENT
/begin MEASUREMENT Vxx_knk_slow_iga_zon8 "Mean Value of slow knk correction of the area 8." UBYTE _CNV_A_R_LINEAR_____306_CM 1 0. 0. 7.96875 DISPLAY_IDENTIFIER CbIgnLim_NVM.Vxx_knk_slow_iga_zon8_NVM ECU_ADDRESS 0xd0006680 FORMAT "%7.5" /end MEASUREMENT
/begin MEASUREMENT Vxx_knk_slow_iga_zon9 "Mean Value of slow knk correction of the area 9." UBYTE _CNV_A_R_LINEAR_____306_CM 1 0. 0. 7.96875 DISPLAY_IDENTIFIER CbIgnLim_NVM.Vxx_knk_slow_iga_zon9_NVM ECU_ADDRESS 0xd0006681 FORMAT "%7.5" /end MEASUREMENT
/begin MEASUREMENT Vxx_knk_slow_iga_zon10 "Mean Value of slow knk correction of the area 10." UBYTE _CNV_A_R_LINEAR_____306_CM 1 0. 0. 7.96875 DISPLAY_IDENTIFIER CbIgnLim_NVM.Vxx_knk_slow_iga_zon10_NVM ECU_ADDRESS 0xd0006682 FORMAT "%7.5" /end MEASUREMENT
/begin MEASUREMENT Vxx_knk_slow_iga_zon11 "Mean Value of slow knk correction of the area 11." UBYTE _CNV_A_R_LINEAR_____306_CM 1 0. 0. 7.96875 DISPLAY_IDENTIFIER CbIgnLim_NVM.Vxx_knk_slow_iga_zon11_NVM ECU_ADDRESS 0xd0006683 FORMAT "%7.5" /end MEASUREMENT
/begin MEASUREMENT Vxx_knk_slow_iga_zon12 "Mean Value of slow knk correction of the area 12." UBYTE _CNV_A_R_LINEAR_____306_CM 1 0. 0. 7.96875 DISPLAY_IDENTIFIER CbIgnLim_NVM.Vxx_knk_slow_iga_zon12_NVM ECU_ADDRESS 0xd0006684 FORMAT "%7.5" /end MEASUREMENT
/begin MEASUREMENT Vxx_knk_slow_iga_zon13 "Mean Value of slow knk correction of the area 13." UBYTE _CNV_A_R_LINEAR_____306_CM 1 0. 0. 7.96875 DISPLAY_IDENTIFIER CbIgnLim_NVM.Vxx_knk_slow_iga_zon13_NVM ECU_ADDRESS 0xd0006685 FORMAT "%7.5" /end MEASUREMENT
/begin MEASUREMENT Vxx_knk_slow_iga_zon14 "Mean Value of slow knk correction of the area 14." UBYTE _CNV_A_R_LINEAR_____306_CM 1 0. 0. 7.96875 DISPLAY_IDENTIFIER CbIgnLim_NVM.Vxx_knk_slow_iga_zon14_NVM ECU_ADDRESS 0xd0006686 FORMAT "%7.5" /end MEASUREMENT
/begin MEASUREMENT Vxx_knk_slow_iga_zon15 "Mean Value of slow knk correction of the area 15." UBYTE _CNV_A_R_LINEAR_____306_CM 1 0. 0. 7.96875 DISPLAY_IDENTIFIER CbIgnLim_NVM.Vxx_knk_slow_iga_zon15_NVM ECU_ADDRESS 0xd0006687 FORMAT "%7.5" /end MEASUREMENT
/begin MEASUREMENT Vxx_knk_slow_iga_zon16 "Mean Value of slow knk correction of the area 16." UBYTE _CNV_A_R_LINEAR_____306_CM 1 0. 0. 7.96875 DISPLAY_IDENTIFIER CbIgnLim_NVM.Vxx_knk_slow_iga_zon16_NVM ECU_ADDRESS 0xd0006688 FORMAT "%7.5" /end MEASUREMENT
/begin MEASUREMENT Vtd_knk_slow_cor_iga_cyl[0] "Knock correction low bukle (4 composants vector)" UBYTE _CNV_A_R_LINEAR_____23_CM 1 0. 0. 95.625 DISPLAY_IDENTIFIER CbIgnLim_NVM.Vtd_knk_slow_cor_iga_cyl_NVM[0] ECU_ADDRESS 0xd000668a /end MEASUREMENT
/begin MEASUREMENT Vtd_knk_slow_cor_iga_cyl[1] "Knock correction low bukle (4 composants vector)" UBYTE _CNV_A_R_LINEAR_____23_CM 1 0. 0. 95.625 DISPLAY_IDENTIFIER CbIgnLim_NVM.Vtd_knk_slow_cor_iga_cyl_NVM[1] ECU_ADDRESS 0xd000668b /end MEASUREMENT
/begin MEASUREMENT Vtd_knk_slow_cor_iga_cyl[2] "Knock correction low bukle (4 composants vector)" UBYTE _CNV_A_R_LINEAR_____23_CM 1 0. 0. 95.625 DISPLAY_IDENTIFIER CbIgnLim_NVM.Vtd_knk_slow_cor_iga_cyl_NVM[2] ECU_ADDRESS 0xd000668c /end MEASUREMENT
/begin MEASUREMENT Vtd_knk_slow_cor_iga_cyl[3] "Knock correction low bukle (4 composants vector)" UBYTE _CNV_A_R_LINEAR_____23_CM 1 0. 0. 95.625 DISPLAY_IDENTIFIER CbIgnLim_NVM.Vtd_knk_slow_cor_iga_cyl_NVM[3] ECU_ADDRESS 0xd000668d /end MEASUREMENT
/begin MEASUREMENT Vbx_knk_2_cyl_min "Boolean indicating that the knock is detected on at least two cylinders" UBYTE _CNV_S_2_RANGE______3_CM 1 0. 0. 1. ECU_ADDRESS 0xd0006691 BIT_MASK 0x1 /end MEASUREMENT
/begin MEASUREMENT Vbx_knk_zon "Indicator of knock zone" UBYTE _CNV_S_2_RANGE______3_CM 1 0. 0. 1. ECU_ADDRESS 0xd0006692 BIT_MASK 0x1 /end MEASUREMENT
/begin MEASUREMENT Vtd_knk_slow_cor_iga_cyl_ini[0] "Initial values of knock correction low bukle (4 composants vector) (adoc)" UBYTE _CNV_A_R_LINEAR_____23_CM 1 0. 0. 95.625 ECU_ADDRESS 0xd00077a4 /end MEASUREMENT
/begin MEASUREMENT Vtd_knk_slow_cor_iga_cyl_ini[1] "Initial values of knock correction low bukle (4 composants vector) (adoc)" UBYTE _CNV_A_R_LINEAR_____23_CM 1 0. 0. 95.625 ECU_ADDRESS 0xd00077a5 /end MEASUREMENT
/begin MEASUREMENT Vtd_knk_slow_cor_iga_cyl_ini[2] "Initial values of knock correction low bukle (4 composants vector) (adoc)" UBYTE _CNV_A_R_LINEAR_____23_CM 1 0. 0. 95.625 ECU_ADDRESS 0xd00077a6 /end MEASUREMENT
/begin MEASUREMENT Vtd_knk_slow_cor_iga_cyl_ini[3] "Initial values of knock correction low bukle (4 composants vector) (adoc)" UBYTE _CNV_A_R_LINEAR_____23_CM 1 0. 0. 95.625 ECU_ADDRESS 0xd00077a7 /end MEASUREMENT
/begin MEASUREMENT Vxx_knk_slow_cor_ave "Mean Value of slow knk correction" UBYTE _CNV_A_R_LINEAR_____306_CM 1 0. 0. 7.96875 ECU_ADDRESS 0xd0006690 FORMAT "%7.5" /end MEASUREMENT
/begin MEASUREMENT Vxx_knk_slow_cor_max_iga_ini "Initial value of maximum ignition timing correction of the slow loop for all the cylinders" UBYTE _CNV_A_R_LINEAR_____23_CM 1 0. 0. 95.625 ECU_ADDRESS 0xd00077a8 /end MEASUREMENT
/begin CHARACTERISTIC Cxx_knk_1cyl_slow_cor_max "Maximum value for slow correction with knock detection on only one cylinder" VALUE 0xa0020d84 _REC_S1VAL_20_u1 95.625 _CNV_A_R_LINEAR_____23_CM 0. 95.625 /end CHARACTERISTIC
/begin CHARACTERISTIC Cxx_knk_2cyl_slow_dif_max "Maximum gap between several slow loops" VALUE 0xa0020d85 _REC_S1VAL_20_u1 95.625 _CNV_A_R_LINEAR_____23_CM 0. 95.625 /end CHARACTERISTIC
/begin CHARACTERISTIC Cxx_knk_slow_cor_dec_ctr "Threshold of the slow loop counter" VALUE 0xa0020d86 _REC_S1VAL_20_u1 255. _CNV_A_R_LINEAR_____68_CM 0. 255. FORMAT "%3.0" /end CHARACTERISTIC
/begin CHARACTERISTIC Cxx_knk_slow_cor_iga_inc "Increase value for slow loop" VALUE 0xa0020d87 _REC_S1VAL_20_u1 95.625 _CNV_A_R_LINEAR_____23_CM 0. 95.625 /end CHARACTERISTIC
/begin CHARACTERISTIC Cxx_knk_slow_cor_iga_max "Slow loop maximum value of the knock correction on timing" VALUE 0xa0020d88 _REC_S1VAL_20_u1 95.625 _CNV_A_R_LINEAR_____23_CM 0. 95.625 /end CHARACTERISTIC
/begin CHARACTERISTIC Cxx_knk_slow_cor_prs_dif "Maximum pressure gap for slow loop increase" VALUE 0xa0020d80 _REC_S1VAL_20_u2 20000. _CNV_A_R_LINEAR_____115_CM 0. 20000. FORMAT "%5.0" /end CHARACTERISTIC
/begin CHARACTERISTIC Cxx_knk_zon_tco_thd "Water temperature threshold above which critical zone can be" VALUE 0xa0020d82 _REC_S1VAL_20_u2 240. _CNV_A_R_LINEAR_____110_CM -40. 200. FORMAT "%6.1" /end CHARACTERISTIC
/begin CHARACTERISTIC Ctp_n_knk_fast_inc_iga "Map of increase values for fast loop depending on engine speed" CURVE 0xa0026584 _REC_A1CUR_20_u1_u2 95.625 _CNV_A_R_LINEAR_____23_CM 0. 95.625
 /begin AXIS_DESCR COM_AXIS Vxx_n _CNV_A_R_ENSD_LINEA_22_CM 20 0. 16383.75 FORMAT "%8.2" AXIS_PTS_REF Ctb_n /end AXIS_DESCR
/end CHARACTERISTIC
/begin MEASUREMENT Vtd_knk_det_err_cyl[0] "Wrong knock detection for each cylinder" UBYTE _CNV_S_2_RANGE______3_CM 1 0. 0. 1. ECU_ADDRESS 0xd000664c /end MEASUREMENT
/begin MEASUREMENT Vtd_knk_det_err_cyl[1] "Wrong knock detection for each cylinder" UBYTE _CNV_S_2_RANGE______3_CM 1 0. 0. 1. ECU_ADDRESS 0xd000664d /end MEASUREMENT
/begin MEASUREMENT Vtd_knk_det_err_cyl[2] "Wrong knock detection for each cylinder" UBYTE _CNV_S_2_RANGE______3_CM 1 0. 0. 1. ECU_ADDRESS 0xd000664e /end MEASUREMENT
/begin MEASUREMENT Vtd_knk_det_err_cyl[3] "Wrong knock detection for each cylinder" UBYTE _CNV_S_2_RANGE______3_CM 1 0. 0. 1. ECU_ADDRESS 0xd000664f /end MEASUREMENT
/begin MEASUREMENT Vtd_knk_fast_cor_cyl[0] "Timing correction from increase block for each cylinder" UBYTE _CNV_A_R_LINEAR_____23_CM 1 0. 0. 95.625 ECU_ADDRESS 0xd0006650 /end MEASUREMENT
/begin MEASUREMENT Vtd_knk_fast_cor_cyl[1] "Timing correction from increase block for each cylinder" UBYTE _CNV_A_R_LINEAR_____23_CM 1 0. 0. 95.625 ECU_ADDRESS 0xd0006651 /end MEASUREMENT
/begin MEASUREMENT Vtd_knk_fast_cor_cyl[2] "Timing correction from increase block for each cylinder" UBYTE _CNV_A_R_LINEAR_____23_CM 1 0. 0. 95.625 ECU_ADDRESS 0xd0006652 /end MEASUREMENT
/begin MEASUREMENT Vtd_knk_fast_cor_cyl[3] "Timing correction from increase block for each cylinder" UBYTE _CNV_A_R_LINEAR_____23_CM 1 0. 0. 95.625 ECU_ADDRESS 0xd0006653 /end MEASUREMENT
/begin MEASUREMENT Vtd_knk_fast_cor_iga_cyl[0] "Timing correction from fast loop for each cylinder" UBYTE _CNV_A_R_LINEAR_____23_CM 1 0. 0. 95.625 ECU_ADDRESS 0xd0006654 /end MEASUREMENT
/begin MEASUREMENT Vtd_knk_fast_cor_iga_cyl[1] "Timing correction from fast loop for each cylinder" UBYTE _CNV_A_R_LINEAR_____23_CM 1 0. 0. 95.625 ECU_ADDRESS 0xd0006655 /end MEASUREMENT
/begin MEASUREMENT Vtd_knk_fast_cor_iga_cyl[2] "Timing correction from fast loop for each cylinder" UBYTE _CNV_A_R_LINEAR_____23_CM 1 0. 0. 95.625 ECU_ADDRESS 0xd0006656 /end MEASUREMENT
/begin MEASUREMENT Vtd_knk_fast_cor_iga_cyl[3] "Timing correction from fast loop for each cylinder" UBYTE _CNV_A_R_LINEAR_____23_CM 1 0. 0. 95.625 ECU_ADDRESS 0xd0006657 /end MEASUREMENT
/begin MEASUREMENT Vxx_knk_fast_cor_iga_cyl1 "Timing correction from fast loop for cylinder 1" UBYTE _CNV_A_R_LINEAR_____23_CM 1 0. 0. 95.625 ECU_ADDRESS 0xd0006658 /end MEASUREMENT
/begin MEASUREMENT Vxx_knk_fast_cor_iga_cyl2 "Timing correction from fast loop for cylinder 2" UBYTE _CNV_A_R_LINEAR_____23_CM 1 0. 0. 95.625 ECU_ADDRESS 0xd0006659 /end MEASUREMENT
/begin MEASUREMENT Vxx_knk_fast_cor_iga_cyl3 "Timing correction from fast loop for cylinder 3" UBYTE _CNV_A_R_LINEAR_____23_CM 1 0. 0. 95.625 ECU_ADDRESS 0xd000665a /end MEASUREMENT
/begin MEASUREMENT Vxx_knk_fast_cor_iga_cyl4 "Timing correction from fast loop for cylinder 4" UBYTE _CNV_A_R_LINEAR_____23_CM 1 0. 0. 95.625 ECU_ADDRESS 0xd000665b /end MEASUREMENT
/begin MEASUREMENT Vxx_knk_fast_cor_iga_cyl_i1 "Timing correction from fast loop for cylinder 1 before wrong detection test" UBYTE _CNV_A_R_LINEAR_____23_CM 1 0. 0. 95.625 ECU_ADDRESS 0xd000665c /end MEASUREMENT
/begin MEASUREMENT Vxx_knk_fast_cor_iga_cyl_i2 "Timing correction from fast loop for cylinder 2 before wrong detection test" UBYTE _CNV_A_R_LINEAR_____23_CM 1 0. 0. 95.625 ECU_ADDRESS 0xd000665d /end MEASUREMENT
/begin MEASUREMENT Vxx_knk_fast_cor_iga_cyl_i3 "Timing correction from fast loop for cylinder 3 before wrong detection test" UBYTE _CNV_A_R_LINEAR_____23_CM 1 0. 0. 95.625 ECU_ADDRESS 0xd000665e /end MEASUREMENT
/begin MEASUREMENT Vxx_knk_fast_cor_iga_cyl_i4 "Timing correction from fast loop for cylinder 4 before wrong detection test" UBYTE _CNV_A_R_LINEAR_____23_CM 1 0. 0. 95.625 ECU_ADDRESS 0xd000665f /end MEASUREMENT
/begin MEASUREMENT Vxx_knk_fast_dec_ctr_cyl1 "Counter for the fast loop decrease for cylinder 1" UWORD _CNV_A_R_LINEAR_____32_CM 1 0. 0. 655.35 ECU_ADDRESS 0xd0003f76 FORMAT "%6.2" /end MEASUREMENT
/begin MEASUREMENT Vxx_knk_fast_dec_ctr_cyl2 "Counter for the fast loop decrease for cylinder 2" UWORD _CNV_A_R_LINEAR_____32_CM 1 0. 0. 655.35 ECU_ADDRESS 0xd0003f78 FORMAT "%6.2" /end MEASUREMENT
/begin MEASUREMENT Vxx_knk_fast_dec_ctr_cyl3 "Counter for the fast loop decrease for cylinder 3" UWORD _CNV_A_R_LINEAR_____32_CM 1 0. 0. 655.35 ECU_ADDRESS 0xd0003f7a FORMAT "%6.2" /end MEASUREMENT
/begin MEASUREMENT Vxx_knk_fast_dec_ctr_cyl4 "Counter for the fast loop decrease for cylinder 4" UWORD _CNV_A_R_LINEAR_____32_CM 1 0. 0. 655.35 ECU_ADDRESS 0xd0003f7c FORMAT "%6.2" /end MEASUREMENT
/begin MEASUREMENT Vxx_knk_iga_fast_cor_inc "Increase value for last loop" UBYTE _CNV_A_R_LINEAR_____23_CM 1 0. 0. 95.625 ECU_ADDRESS 0xd0006660 /end MEASUREMENT
/begin CHARACTERISTIC Cxx_fast_dec_step "Decrease step for fast loop" VALUE 0xa0020d6c _REC_S1VAL_20_u1 95.625 _CNV_A_R_LINEAR_____23_CM 0. 95.625 /end CHARACTERISTIC
/begin CHARACTERISTIC Cxx_knk_fast_cor_dec_ctr "Threshold of the fast loop counter" VALUE 0xa0020d6a _REC_S1VAL_20_u2 655.35 _CNV_A_R_LINEAR_____32_CM 0. 655.35 FORMAT "%6.2" /end CHARACTERISTIC
/begin CHARACTERISTIC Cxx_knk_fast_cor_iga_max "Fast loop maximum value of the knock correction on timing" VALUE 0xa0020d6d _REC_S1VAL_20_u1 95.625 _CNV_A_R_LINEAR_____23_CM 0. 95.625 /end CHARACTERISTIC
/begin CHARACTERISTIC Cxx_knk_fast_cor_iga_thd "Wrong detection threshold for the fast loop (knock correction)" VALUE 0xa0020d6e _REC_S1VAL_20_u1 95.625 _CNV_A_R_LINEAR_____23_CM 0. 95.625 /end CHARACTERISTIC
/begin MEASUREMENT Vtd_knk_iga_cor_appl_cyl[0] "Currative Knock correction cylinder to cylinder" UBYTE _CNV_A_R_LINEAR_____23_CM 1 0. 0. 95.625 ECU_ADDRESS 0xd0006662 /end MEASUREMENT
/begin MEASUREMENT Vtd_knk_iga_cor_appl_cyl[1] "Currative Knock correction cylinder to cylinder" UBYTE _CNV_A_R_LINEAR_____23_CM 1 0. 0. 95.625 ECU_ADDRESS 0xd0006663 /end MEASUREMENT
/begin MEASUREMENT Vtd_knk_iga_cor_appl_cyl[2] "Currative Knock correction cylinder to cylinder" UBYTE _CNV_A_R_LINEAR_____23_CM 1 0. 0. 95.625 ECU_ADDRESS 0xd0006664 /end MEASUREMENT
/begin MEASUREMENT Vtd_knk_iga_cor_appl_cyl[3] "Currative Knock correction cylinder to cylinder" UBYTE _CNV_A_R_LINEAR_____23_CM 1 0. 0. 95.625 ECU_ADDRESS 0xd0006665 /end MEASUREMENT
/begin CHARACTERISTIC Cbx_knk_cor_ave_ena "Enable to substract average slow loop correction into slow loop correction" VALUE 0xa0020d6f _REC_S1VAL_20_u1 1. _CNV_S_2_RANGE______3_CM 0. 1. BIT_MASK 0x1 /end CHARACTERISTIC
/begin CHARACTERISTIC Cxx_knk_iga_cor "Value of the anti-knock ignition timing correction in degrated mode" VALUE 0xa0020d70 _REC_S1VAL_20_u1 95.625 _CNV_A_R_LINEAR_____23_CM 0. 95.625 /end CHARACTERISTIC
/begin CHARACTERISTIC Cmp_tco_slow_comb_iga_cor "Advance correction for slow combustion (low temperature)." MAP 0xa00272b8 _REC_A1MAP_20_u1_u2_u2 95.625 _CNV_A_R_LINEAR_____28_CM -48. 47.625 FORMAT "%7.3"
 /begin AXIS_DESCR COM_AXIS Vxx_tco _CNV_A_R_LINEAR_____110_CM 16 -40. 200. FORMAT "%5.1" AXIS_PTS_REF Ctb_tco /end AXIS_DESCR
 /begin AXIS_DESCR COM_AXIS Vxx_eal _CNV_A_R_LINEAR_____53_CM 16 0. 3.99993896484375 FORMAT "%10.8" AXIS_PTS_REF Ctb_eal /end AXIS_DESCR
/end CHARACTERISTIC
/begin CHARACTERISTIC Ctp_n_slow_comb_fac "Factor depending on engine speed on slow combustion advance correction." CURVE 0xa00273b8 _REC_A1CUR_20_u1_u2 0.996078431372549 _CNV_A_R_LINEAR_____162_CM 3.92156862745098e-003 1. FORMAT "%9.7"
 /begin AXIS_DESCR COM_AXIS Vxx_n _CNV_A_R_ENSD_LINEA_22_CM 9 0. 16383.75 FORMAT "%8.2" AXIS_PTS_REF Ctb_n2 /end AXIS_DESCR
/end CHARACTERISTIC
/begin MEASUREMENT Vxx_slow_comb_iga_cor "Advance correction for slow combustion." SBYTE _CNV_A_R_LINEAR_____23_CM 1 0. -48. 47.625 ECU_ADDRESS 0xd00077ad FORMAT "%7.3" /end MEASUREMENT
/begin AXIS_PTS Ctb_knk_ant_mat_cor "breakpoints of corrected manifold air temperature for anticipted knk" 0xa0026e9c Vxx_mat _REC_A2AXS_20_u2 140. _CNV_A_R_LINEAR_____307_CM 16 -60. 80. FORMAT "%7.1" /end AXIS_PTS
/begin CHARACTERISTIC Cmp_n_eal_ol_knk_iga_cor "preventive knock correction function of engine speed and engine air load" MAP 0xa0026ec0 _REC_A1MAP_20_u1_u2_u2 95.625 _CNV_A_R_LINEAR_____28_CM -48. 47.625 FORMAT "%7.3"
 /begin AXIS_DESCR COM_AXIS Vxx_n _CNV_A_R_ENSD_LINEA_22_CM 20 0. 16383.75 FORMAT "%8.2" AXIS_PTS_REF Ctb_n /end AXIS_DESCR
 /begin AXIS_DESCR COM_AXIS Vxx_eal _CNV_A_R_LINEAR_____53_CM 16 0. 3.99993896484375 FORMAT "%10.8" AXIS_PTS_REF Ctb_eal /end AXIS_DESCR
/end CHARACTERISTIC
/begin CHARACTERISTIC Cmp_n_eal_ol_knk_mat_ref "Map of Reference manifold air temperature for the preventive knock correction." MAP 0xa0027000 _REC_A1MAP_20_u2_u2_u2 240. _CNV_A_R_LINEAR_____110_CM -40. 200. FORMAT "%6.1"
 /begin AXIS_DESCR COM_AXIS Vxx_n _CNV_A_R_ENSD_LINEA_22_CM 20 0. 16383.75 FORMAT "%8.2" AXIS_PTS_REF Ctb_n /end AXIS_DESCR
 /begin AXIS_DESCR COM_AXIS Vxx_eal _CNV_A_R_LINEAR_____53_CM 16 0. 3.99993896484375 FORMAT "%10.8" AXIS_PTS_REF Ctb_eal /end AXIS_DESCR
/end CHARACTERISTIC
/begin CHARACTERISTIC Ctp_ol_knk_mat_fac "Table of factor on preventive knock correction depending on manifold air temperature." CURVE 0xa0027280 _REC_A1CUR_20_u1_u2 2. _CNV_A_R_LINEAR_____308_CM -1. 1. FORMAT "%9.6"
 /begin AXIS_DESCR COM_AXIS Vxx_mat _CNV_A_R_LINEAR_____307_CM 16 -60. 80. FORMAT "%7.1" AXIS_PTS_REF Ctb_knk_ant_mat_cor /end AXIS_DESCR
/end CHARACTERISTIC
/begin MEASUREMENT Vxx_ol_knk_iga_cor "Advance correction to prevent knock for high air temperature" SBYTE _CNV_A_R_LINEAR_____23_CM 1 0. -48. 47.625 ECU_ADDRESS 0xd00077ac FORMAT "%7.3" /end MEASUREMENT
/begin CHARACTERISTIC Cxx_alco_pknk_fac "Alcohol factor on preventive knock correction" VALUE 0xa0020d89 _REC_S1VAL_20_u1 1. _CNV_A_R_LINEAR_____162_CM 0. 1. FORMAT "%9.7" /end CHARACTERISTIC
/begin AXIS_PTS Ntb_cyl_nr "Table of mumber of active cylinders  Ntb_cyl_nr = [2 3 4]" 0xa0020d76 Vxx_inj_cut_nr _REC_A2AXS_20_u1 4. _CNV_A_R_ECME_LINEA_0_CM 3 0. 4. READ_ONLY FORMAT "%1.0" /end AXIS_PTS
/begin CHARACTERISTIC Cmp_eal_n_min_iga_cor "Temporary advance correction applied on static minimal advance" MAP 0xa0026d3c _REC_A1MAP_20_u1_u2_u2 95.625 _CNV_A_R_IGRE_LINEA_47_CM -23.625 72. FORMAT "%7.3"
 /begin AXIS_DESCR COM_AXIS Vxx_eal _CNV_A_R_LINEAR_____53_CM 9 0. 3.99993896484375 FORMAT "%10.8" AXIS_PTS_REF Ctb_eal2 /end AXIS_DESCR
 /begin AXIS_DESCR COM_AXIS Vxx_n _CNV_A_R_ENSD_LINEA_22_CM 9 0. 16383.75 FORMAT "%8.2" AXIS_PTS_REF Ctb_n2 /end AXIS_DESCR
/end CHARACTERISTIC
/begin CHARACTERISTIC Cmp_iga_tco_cor "Minimal advance correction function of coolant temperature" MAP 0xa0026d90 _REC_A1MAP_20_u1_u2_u2 95.625 _CNV_A_R_LINEAR_____23_CM 0. 95.625
 /begin AXIS_DESCR COM_AXIS Vxx_eal _CNV_A_R_LINEAR_____53_CM 9 0. 3.99993896484375 FORMAT "%10.8" AXIS_PTS_REF Ctb_eal2 /end AXIS_DESCR
 /begin AXIS_DESCR COM_AXIS Vxx_tco _CNV_A_R_LINEAR_____110_CM 16 -40. 200. FORMAT "%5.1" AXIS_PTS_REF Ctb_tco /end AXIS_DESCR
/end CHARACTERISTIC
/begin CHARACTERISTIC Cmp_iga_tq_min "Minimal advance function of engine speed and engine air load" MAP 0xa0026e20 _REC_A1MAP_20_u1_u2_u2 95.625 _CNV_A_R_IGRE_LINEA_47_CM -23.625 72. FORMAT "%7.3"
 /begin AXIS_DESCR COM_AXIS Vxx_eal _CNV_A_R_LINEAR_____53_CM 9 0. 3.99993896484375 FORMAT "%10.8" AXIS_PTS_REF Ctb_eal2 /end AXIS_DESCR
 /begin AXIS_DESCR COM_AXIS Vxx_n _CNV_A_R_ENSD_LINEA_22_CM 9 0. 16383.75 FORMAT "%8.2" AXIS_PTS_REF Ctb_n2 /end AXIS_DESCR
/end CHARACTERISTIC
/begin CHARACTERISTIC Cmx_n_iga_tq_min_lih "minimal advance in case of a loss control of the throttle" MAP 0xa0026e74 _REC_A1MAP_20_u1_u1_u2 95.625 _CNV_A_R_IGRE_LINEA_47_CM -23.625 72. FORMAT "%7.3"
 /begin AXIS_DESCR COM_AXIS Vxx_inj_cut_nr _CNV_A_R_ECME_LINEA_0_CM 3 0. 4. READ_ONLY FORMAT "%1.0" AXIS_PTS_REF Ntb_cyl_nr /end AXIS_DESCR
 /begin AXIS_DESCR COM_AXIS Vxx_n _CNV_A_R_ENSD_LINEA_22_CM 9 0. 16383.75 FORMAT "%8.2" AXIS_PTS_REF Ctb_n2 /end AXIS_DESCR
/end CHARACTERISTIC
/begin CHARACTERISTIC Ctp_n_iga_cor "Minimum advance correction epending on engine speed." CURVE 0xa0026e90 _REC_A1CUR_20_u1_u2 95.625 _CNV_A_R_LINEAR_____23_CM 0. 95.625
 /begin AXIS_DESCR COM_AXIS Vxx_n _CNV_A_R_ENSD_LINEA_22_CM 9 0. 16383.75 FORMAT "%8.2" AXIS_PTS_REF Ctb_n2 /end AXIS_DESCR
/end CHARACTERISTIC
/begin MEASUREMENT Vbx_l_min_iga "advance setpoint below static minimal advance" UBYTE _CNV_S_2_RANGE______3_CM 1 0. 0. 1. ECU_ADDRESS 0xd0007794 BIT_MASK 0x1 /end MEASUREMENT
/begin MEASUREMENT Vbx_l_min_iga_ctr_thd "The time that can be spent below the minimal advance is reached" UBYTE _CNV_S_2_RANGE______3_CM 1 0. 0. 1. ECU_ADDRESS 0xd0007795 BIT_MASK 0x1 /end MEASUREMENT
/begin MEASUREMENT Vbx_min_iga_dsb "The minimal advance is limited" UBYTE _CNV_S_2_RANGE______3_CM 1 0. 0. 1. ECU_ADDRESS 0xd0007796 BIT_MASK 0x1 /end MEASUREMENT
/begin MEASUREMENT Vbx_minig_it_dft "limp home" UBYTE _CNV_S_2_RANGE______3_CM 1 0. 0. 1. ECU_ADDRESS 0xd0007797 BIT_MASK 0x1 /end MEASUREMENT
/begin MEASUREMENT Vxx_cor_min_iga "Corrected minimal advance" UBYTE _CNV_A_R_IGRE_LINEA_47_CM 1 0. -23.625 72. ECU_ADDRESS 0xd0007798 FORMAT "%7.3" /end MEASUREMENT
/begin MEASUREMENT Vxx_l_min_iga_ctr "activation counter of the offset on the static minimal advance" UBYTE _CNV_A_R_ECME_LINEA_0_CM 1 0. 0. 255. ECU_ADDRESS 0xd0007799 FORMAT "%3.0" /end MEASUREMENT
/begin MEASUREMENT Vxx_min_iga "minimum ignition advance" UBYTE _CNV_A_R_IGRE_LINEA_47_CM 1 0. -23.625 72. ECU_ADDRESS 0xd000779a FORMAT "%7.3" /end MEASUREMENT
/begin MEASUREMENT Vxx_min_iga_dsb_t "Remaining time of inhibition of a new temporary correction of minimal advance" UBYTE _CNV_A_R_LINEAR_____58_CM 1 0. 0. 25.5 ECU_ADDRESS 0xd000779b FORMAT "%4.1" /end MEASUREMENT
/begin MEASUREMENT Vxx_stat_min_iga "minimum static ignition advance" UBYTE _CNV_A_R_IGRE_LINEA_47_CM 1 0. -23.625 72. ECU_ADDRESS 0xd000779c FORMAT "%7.3" /end MEASUREMENT
/begin CHARACTERISTIC Cxx_l_min_iga_ctr_dec "Decrement of time counter past under the minimal static" VALUE 0xa0020d7a _REC_S1VAL_20_u1 255. _CNV_A_R_ECME_LINEA_0_CM 0. 255. FORMAT "%3.0" /end CHARACTERISTIC
/begin CHARACTERISTIC Cxx_l_min_iga_ctr_inc "Increment of time counter past under the minimal static" VALUE 0xa0020d7b _REC_S1VAL_20_u1 255. _CNV_A_R_ECME_LINEA_0_CM 0. 255. FORMAT "%3.0" /end CHARACTERISTIC
/begin CHARACTERISTIC Cxx_l_min_iga_ctr_thd "Counter threshold to forbit temporary minimal advance" VALUE 0xa0020d7c _REC_S1VAL_20_u1 255. _CNV_A_R_ECME_LINEA_0_CM 0. 255. FORMAT "%3.0" /end CHARACTERISTIC
/begin CHARACTERISTIC Cxx_l_min_iga_inc "Increment of the smoothing between the dynamic minimal advance and the static minimal advance" VALUE 0xa0020d7d _REC_S1VAL_20_u1 95.625 _CNV_A_R_LINEAR_____23_CM 0. 95.625 /end CHARACTERISTIC
/begin CHARACTERISTIC Cxx_min_iga_dsb_t "advance requests smaller than static minimal advance are forbidden during Cxx_min_iga_dsb_t" VALUE 0xa0020d7e _REC_S1VAL_20_u1 25.5 _CNV_A_R_LINEAR_____58_CM 0. 25.5 FORMAT "%4.1" /end CHARACTERISTIC
/begin AXIS_PTS Ntb_vvtc_rel_angl "9 equidistant VVT intake relative angle breakpoints map" 0xa0026598 NO_INPUT_QUANTITY _REC_A2AXS_20_u1 0.99609375 _CNV_A_R_LINEAR_____29_CM 9 0. 0.99609375 READ_ONLY FORMAT "%10.8" /end AXIS_PTS
/begin CHARACTERISTIC Cmp_n_eal_vvtc_iga_h "Map of maximal advance for a camshaft position corresponding to warm engine valve timings on state high" MAP 0xa00265a4 _REC_A1MAP_20_u1_u2_u2 95.625 _CNV_A_R_IGRE_LINEA_47_CM -23.625 72. FORMAT "%7.3"
 /begin AXIS_DESCR COM_AXIS Vxx_n _CNV_A_R_ENSD_LINEA_22_CM 20 0. 16383.75 FORMAT "%8.2" AXIS_PTS_REF Ctb_n /end AXIS_DESCR
 /begin AXIS_DESCR COM_AXIS Vxx_eal _CNV_A_R_LINEAR_____53_CM 16 0. 3.99993896484375 FORMAT "%10.8" AXIS_PTS_REF Ctb_eal /end AXIS_DESCR
/end CHARACTERISTIC
/begin CHARACTERISTIC Cmp_n_eal_vvtc_iga_l "Map of maximal advance for a camshaft position corresponding to warm engine valve timings on state low" MAP 0xa00266e4 _REC_A1MAP_20_u1_u2_u2 95.625 _CNV_A_R_IGRE_LINEA_47_CM -23.625 72. FORMAT "%7.3"
 /begin AXIS_DESCR COM_AXIS Vxx_n _CNV_A_R_ENSD_LINEA_22_CM 20 0. 16383.75 FORMAT "%8.2" AXIS_PTS_REF Ctb_n /end AXIS_DESCR
 /begin AXIS_DESCR COM_AXIS Vxx_eal _CNV_A_R_LINEAR_____53_CM 16 0. 3.99993896484375 FORMAT "%10.8" AXIS_PTS_REF Ctb_eal /end AXIS_DESCR
/end CHARACTERISTIC
/begin CHARACTERISTIC Cmp_n_eal_vvtc_iga_midh "Map of maximal advance for a camshaft position corresponding to warm engine valve timings on state mid high." MAP 0xa0026824 _REC_A1MAP_20_u1_u2_u2 95.625 _CNV_A_R_IGRE_LINEA_47_CM -23.625 72. FORMAT "%7.3"
 /begin AXIS_DESCR COM_AXIS Vxx_n _CNV_A_R_ENSD_LINEA_22_CM 20 0. 16383.75 FORMAT "%8.2" AXIS_PTS_REF Ctb_n /end AXIS_DESCR
 /begin AXIS_DESCR COM_AXIS Vxx_eal _CNV_A_R_LINEAR_____53_CM 16 0. 3.99993896484375 FORMAT "%10.8" AXIS_PTS_REF Ctb_eal /end AXIS_DESCR
/end CHARACTERISTIC
/begin CHARACTERISTIC Cmp_n_eal_vvtc_iga_midl "Map of maximal advance for a camshaft position corresponding to warm engine valve timings on state mid low." MAP 0xa0026964 _REC_A1MAP_20_u1_u2_u2 95.625 _CNV_A_R_IGRE_LINEA_47_CM -23.625 72. FORMAT "%7.3"
 /begin AXIS_DESCR COM_AXIS Vxx_n _CNV_A_R_ENSD_LINEA_22_CM 20 0. 16383.75 FORMAT "%8.2" AXIS_PTS_REF Ctb_n /end AXIS_DESCR
 /begin AXIS_DESCR COM_AXIS Vxx_eal _CNV_A_R_LINEAR_____53_CM 16 0. 3.99993896484375 FORMAT "%10.8" AXIS_PTS_REF Ctb_eal /end AXIS_DESCR
/end CHARACTERISTIC
/begin CHARACTERISTIC Cmp_n_eal_vvtc_off_iga_cor "Map of maximum advance correction depending on engine speed and air load for VVT minimal reference angle" MAP 0xa0026aa4 _REC_A1MAP_20_u1_u2_u2 95.625 _CNV_A_R_LINEAR_____28_CM -48. 47.625 FORMAT "%7.3"
 /begin AXIS_DESCR COM_AXIS Vxx_n _CNV_A_R_ENSD_LINEA_22_CM 20 0. 16383.75 FORMAT "%8.2" AXIS_PTS_REF Ctb_n /end AXIS_DESCR
 /begin AXIS_DESCR COM_AXIS Vxx_eal _CNV_A_R_LINEAR_____53_CM 16 0. 3.99993896484375 FORMAT "%10.8" AXIS_PTS_REF Ctb_eal /end AXIS_DESCR
/end CHARACTERISTIC
/begin CHARACTERISTIC Cmp_n_eal_vvtc_on_iga_cor "Map of maximum advance correction depending on engine speed and air load for VVT maximal reference angle" MAP 0xa0026be4 _REC_A1MAP_20_u1_u2_u2 95.625 _CNV_A_R_LINEAR_____28_CM -48. 47.625 FORMAT "%7.3"
 /begin AXIS_DESCR COM_AXIS Vxx_n _CNV_A_R_ENSD_LINEA_22_CM 20 0. 16383.75 FORMAT "%8.2" AXIS_PTS_REF Ctb_n /end AXIS_DESCR
 /begin AXIS_DESCR COM_AXIS Vxx_eal _CNV_A_R_LINEAR_____53_CM 16 0. 3.99993896484375 FORMAT "%10.8" AXIS_PTS_REF Ctb_eal /end AXIS_DESCR
/end CHARACTERISTIC
/begin CHARACTERISTIC Ctp_vvtc_angl_iga_fac1 "Map of optimal advance weighting between two map of two stalling depending on VVT intake angle" CURVE 0xa0026d24 _REC_A1CUR_20_u1_u1 0.99609375 _CNV_A_R_LINEAR_____29_CM 0. 0.99609375 FORMAT "%10.8"
 /begin AXIS_DESCR COM_AXIS NO_INPUT_QUANTITY _CNV_A_R_LINEAR_____29_CM 9 0. 0.99609375 READ_ONLY FORMAT "%10.8" AXIS_PTS_REF Ntb_vvtc_rel_angl /end AXIS_DESCR
/end CHARACTERISTIC
/begin CHARACTERISTIC Ctp_vvtc_angl_iga_fac2 "Map of optimal advance weighting between two map of two stalling depending on VVT intake angle" CURVE 0xa0026d30 _REC_A1CUR_20_u1_u1 0.99609375 _CNV_A_R_LINEAR_____29_CM 0. 0.99609375 FORMAT "%10.8"
 /begin AXIS_DESCR COM_AXIS NO_INPUT_QUANTITY _CNV_A_R_LINEAR_____29_CM 9 0. 0.99609375 READ_ONLY FORMAT "%10.8" AXIS_PTS_REF Ntb_vvtc_rel_angl /end AXIS_DESCR
/end CHARACTERISTIC
/begin MEASUREMENT Vxx_max_iga "maximum ignition advance" UBYTE _CNV_A_R_IGRE_LINEA_47_CM 1 0. -23.625 72. ECU_ADDRESS 0xd0006666 FORMAT "%7.3" /end MEASUREMENT
/begin MEASUREMENT Vxx_raw_max_iga "maximum ignition advance" UBYTE _CNV_A_R_IGRE_LINEA_47_CM 1 0. -23.625 72. ECU_ADDRESS 0xd0006667 FORMAT "%7.3" /end MEASUREMENT
/begin MEASUREMENT Vxx_raw_slow_max_iga "Raw maximum ignition advance with slow combustion correction." UBYTE _CNV_A_R_IGRE_LINEA_47_CM 1 0. -23.625 72. ECU_ADDRESS 0xd0006668 FORMAT "%7.3" /end MEASUREMENT
/begin MEASUREMENT Vxx_vvtc_iga "Maximuml advance for a camshaft position corresponding to warm engine valve timings" UBYTE _CNV_A_R_IGRE_LINEA_47_CM 1 0. -23.625 72. ECU_ADDRESS 0xd0006669 FORMAT "%7.3" /end MEASUREMENT
/begin MEASUREMENT Vxx_vvtc_iga_fac1 "Coef1 for optimal or nominal advance interpolation between the 3 ref MAPof optimal/nominal advances" UBYTE _CNV_A_R_LINEAR_____29_CM 1 0. 0. 0.99609375 ECU_ADDRESS 0xd000666a FORMAT "%10.8" /end MEASUREMENT
/begin MEASUREMENT Vxx_vvtc_iga_fac2 "Coef2 for optimal or nominal advance interpolation between the 3 ref MAPof optimal/nominal advances" UBYTE _CNV_A_R_LINEAR_____29_CM 1 0. 0. 0.99609375 ECU_ADDRESS 0xd000666b FORMAT "%10.8" /end MEASUREMENT
/begin MEASUREMENT Vxx_vvtc_off_iga "Maximum advance reference depending on engine speed and air load for VVT minimal reference angle" UBYTE _CNV_A_R_LINEAR_____28_CM 1 0. -48. 47.625 ECU_ADDRESS 0xd000666c FORMAT "%7.3" /end MEASUREMENT
/begin MEASUREMENT Vxx_vvtc_on_iga "Maximum advance reference depending on engine speed and air load for VVT maximal reference angle" UBYTE _CNV_A_R_LINEAR_____28_CM 1 0. -48. 47.625 ECU_ADDRESS 0xd000666d FORMAT "%7.3" /end MEASUREMENT
/begin CHARACTERISTIC Cxx_vvtc_h_trt "high stop of the camshaft" VALUE 0xa0020d72 _REC_S1VAL_20_u2 719.98 _CNV_A_R_LINEAR_____129_CM 0. 719.98 FORMAT "%6.2" /end CHARACTERISTIC
/begin CHARACTERISTIC Cxx_vvtc_min_iga_cor "dead zone where advance = advance for a camshaft position corresponding to warm engine valve timings" VALUE 0xa0020d74 _REC_S1VAL_20_u2 719.98 _CNV_A_R_LINEAR_____129_CM 0. 719.98 FORMAT "%6.2" /end CHARACTERISTIC
/begin CHARACTERISTIC Cmp_eal_n_min_iga_cor_alco "Temporary advance correction applied on static minimal adavance for flex-fuel." MAP 0xa00261f4 _REC_A1MAP_20_u1_u2_u2 95.625 _CNV_A_R_IGRE_LINEA_47_CM -23.625 72. FORMAT "%7.3"
 /begin AXIS_DESCR COM_AXIS Vxx_eal _CNV_A_R_LINEAR_____53_CM 9 0. 3.99993896484375 FORMAT "%10.8" AXIS_PTS_REF Ctb_eal2 /end AXIS_DESCR
 /begin AXIS_DESCR COM_AXIS Vxx_n _CNV_A_R_ENSD_LINEA_22_CM 9 0. 16383.75 FORMAT "%8.2" AXIS_PTS_REF Ctb_n2 /end AXIS_DESCR
/end CHARACTERISTIC
/begin CHARACTERISTIC Cmp_iga_tco_cor_alco "Minimum advance correction depending on coolant temperature ane engine air load for flex-fuel." MAP 0xa0026248 _REC_A1MAP_20_u1_u2_u2 95.625 _CNV_A_R_LINEAR_____23_CM 0. 95.625
 /begin AXIS_DESCR COM_AXIS Vxx_eal _CNV_A_R_LINEAR_____53_CM 9 0. 3.99993896484375 FORMAT "%10.8" AXIS_PTS_REF Ctb_eal2 /end AXIS_DESCR
 /begin AXIS_DESCR COM_AXIS Vxx_tco _CNV_A_R_LINEAR_____110_CM 16 -40. 200. FORMAT "%5.1" AXIS_PTS_REF Ctb_tco /end AXIS_DESCR
/end CHARACTERISTIC
/begin CHARACTERISTIC Cmp_iga_tq_min_alco "Minimal advance function of engine speed and engine air load for flex-fuel." MAP 0xa00262d8 _REC_A1MAP_20_u1_u2_u2 95.625 _CNV_A_R_IGRE_LINEA_47_CM -23.625 72. FORMAT "%7.3"
 /begin AXIS_DESCR COM_AXIS Vxx_eal _CNV_A_R_LINEAR_____53_CM 9 0. 3.99993896484375 FORMAT "%10.8" AXIS_PTS_REF Ctb_eal2 /end AXIS_DESCR
 /begin AXIS_DESCR COM_AXIS Vxx_n _CNV_A_R_ENSD_LINEA_22_CM 9 0. 16383.75 FORMAT "%8.2" AXIS_PTS_REF Ctb_n2 /end AXIS_DESCR
/end CHARACTERISTIC
/begin CHARACTERISTIC Cmp_n_eal_vvtc_iga_alco "Map of maximal advance for a camshaft position correcponding to warm engine valve timings for flex-fuel" MAP 0xa002632c _REC_A1MAP_20_u1_u2_u2 95.625 _CNV_A_R_LINEAR_____28_CM -48. 47.625 FORMAT "%7.3"
 /begin AXIS_DESCR COM_AXIS Vxx_n _CNV_A_R_ENSD_LINEA_22_CM 20 0. 16383.75 FORMAT "%8.2" AXIS_PTS_REF Ctb_n /end AXIS_DESCR
 /begin AXIS_DESCR COM_AXIS Vxx_eal _CNV_A_R_LINEAR_____53_CM 16 0. 3.99993896484375 FORMAT "%10.8" AXIS_PTS_REF Ctb_eal /end AXIS_DESCR
/end CHARACTERISTIC
/begin CHARACTERISTIC Cmp_tco_slow_comb_iga_cor_alco "Advance correction for slow combustion (low temperature) for Flex-fuel." MAP 0xa002646c _REC_A1MAP_20_u1_u2_u2 95.625 _CNV_A_R_LINEAR_____28_CM -48. 47.625 FORMAT "%7.3"
 /begin AXIS_DESCR COM_AXIS Vxx_tco _CNV_A_R_LINEAR_____110_CM 16 -40. 200. FORMAT "%5.1" AXIS_PTS_REF Ctb_tco /end AXIS_DESCR
 /begin AXIS_DESCR COM_AXIS Vxx_eal _CNV_A_R_LINEAR_____53_CM 16 0. 3.99993896484375 FORMAT "%10.8" AXIS_PTS_REF Ctb_eal /end AXIS_DESCR
/end CHARACTERISTIC
/begin CHARACTERISTIC Ctp_n_iga_cor_alco "Minimum advance correction depending on engine speed for flex-fuel." CURVE 0xa002656c _REC_A1CUR_20_u1_u2 95.625 _CNV_A_R_LINEAR_____23_CM 0. 95.625
 /begin AXIS_DESCR COM_AXIS Vxx_n _CNV_A_R_ENSD_LINEA_22_CM 9 0. 16383.75 FORMAT "%8.2" AXIS_PTS_REF Ctb_n2 /end AXIS_DESCR
/end CHARACTERISTIC
/begin CHARACTERISTIC Ctp_n_slow_comb_fac_alco "Factor depending on engine speed on slow combustion advance correction for Flex-fuel." CURVE 0xa0026578 _REC_A1CUR_20_u1_u2 0.996078431372549 _CNV_A_R_LINEAR_____162_CM 3.92156862745098e-003 1. FORMAT "%9.7"
 /begin AXIS_DESCR COM_AXIS Vxx_n _CNV_A_R_ENSD_LINEA_22_CM 9 0. 16383.75 FORMAT "%8.2" AXIS_PTS_REF Ctb_n2 /end AXIS_DESCR
/end CHARACTERISTIC
/begin MEASUREMENT Vxx_iga_tq_min_alco "Minimum static ignition advance for flex-fuel." UBYTE _CNV_A_R_IGRE_LINEA_47_CM 1 0. -23.625 72. ECU_ADDRESS 0xd0003f72 FORMAT "%7.3" /end MEASUREMENT
/begin MEASUREMENT Vxx_min_iga_cor_alco "Corrected minimal advance for flex-fuel." UBYTE _CNV_A_R_IGRE_LINEA_47_CM 1 0. -23.625 72. ECU_ADDRESS 0xd0003f73 FORMAT "%7.3" /end MEASUREMENT
/begin MEASUREMENT Vxx_n_tco_iga_cor_alco "Minimum advance correction for flex-fuel." UBYTE _CNV_A_R_LINEAR_____23_CM 1 0. 0. 95.625 ECU_ADDRESS 0xd0003f74 /end MEASUREMENT
/begin MEASUREMENT Vxx_slow_comb_iga_cor_alco "Advance correction for slow combustion for flex-fuel." SBYTE _CNV_A_R_LINEAR_____23_CM 1 0. -48. 47.625 ECU_ADDRESS 0xd000664a FORMAT "%7.3" /end MEASUREMENT
/begin MEASUREMENT Vxx_vvtc_iga_alco "Maximuml advance for a camshaft position corresponding to warm engine valve timings for flex-fuel." UBYTE _CNV_A_R_LINEAR_____28_CM 1 0. -48. 47.625 ECU_ADDRESS 0xd000664b FORMAT "%7.3" /end MEASUREMENT
/begin MEASUREMENT Vbx_knk_2_cyl_min_ml "Boolean indicating that the knock is detected on at least two cylinders (adoc)" UBYTE _CNV_S_2_RANGE______3_CM 1 0. 0. 1. ECU_ADDRESS 0xd00077a2 BIT_MASK 0x1 /end MEASUREMENT
/begin MEASUREMENT Vbx_knk_zon_ml "indicators of knock zone (adoc)" UBYTE _CNV_S_2_RANGE______3_CM 1 0. 0. 1. ECU_ADDRESS 0xd0006672 BIT_MASK 0x1 /end MEASUREMENT
/begin MEASUREMENT Vbx_trs_zon "Boolean indicating a transition of zone in knock zone" UBYTE _CNV_S_2_RANGE______3_CM 1 0. 0. 1. ECU_ADDRESS 0xd0006673 BIT_MASK 0x1 /end MEASUREMENT
/begin MEASUREMENT Vtd_knk_slow_cor_iga_cyl_ml[0] "Knock correction low buckle (4 composant vector) (adoc)" UBYTE _CNV_A_R_LINEAR_____23_CM 1 0. 0. 95.625 ECU_ADDRESS 0xd000779e /end MEASUREMENT
/begin MEASUREMENT Vtd_knk_slow_cor_iga_cyl_ml[1] "Knock correction low buckle (4 composant vector) (adoc)" UBYTE _CNV_A_R_LINEAR_____23_CM 1 0. 0. 95.625 ECU_ADDRESS 0xd000779f /end MEASUREMENT
/begin MEASUREMENT Vtd_knk_slow_cor_iga_cyl_ml[2] "Knock correction low buckle (4 composant vector) (adoc)" UBYTE _CNV_A_R_LINEAR_____23_CM 1 0. 0. 95.625 ECU_ADDRESS 0xd00077a0 /end MEASUREMENT
/begin MEASUREMENT Vtd_knk_slow_cor_iga_cyl_ml[3] "Knock correction low buckle (4 composant vector) (adoc)" UBYTE _CNV_A_R_LINEAR_____23_CM 1 0. 0. 95.625 ECU_ADDRESS 0xd00077a1 /end MEASUREMENT
/begin MEASUREMENT Vxx_knk_slow_cor_ave_ml "Mean Value of slow knk correction (adoc)" UBYTE _CNV_A_R_LINEAR_____306_CM 1 0. 0. 7.96875 ECU_ADDRESS 0xd0006674 FORMAT "%7.5" /end MEASUREMENT
/begin MEASUREMENT Vxx_knk_slow_cor_max_iga_ml "Maximum ignition timing correction of the slow loop for all the cylinders (adoc)" UBYTE _CNV_A_R_LINEAR_____23_CM 1 0. 0. 95.625 ECU_ADDRESS 0xd0006675 /end MEASUREMENT
/begin MEASUREMENT Vbx_knk_2_cyl_min_sl "Boolean indicating that the knock is detected on at least two cylinders for single zone" UBYTE _CNV_S_2_RANGE______3_CM 1 0. 0. 1. ECU_ADDRESS 0xd00077b6 BIT_MASK 0x1 /end MEASUREMENT
/begin MEASUREMENT Vbx_knk_slow_cyl "Incrementation of slow loop correction in process" UBYTE _CNV_S_2_RANGE______3_CM 1 0. 0. 1. ECU_ADDRESS 0xd00077b7 BIT_MASK 0x1 /end MEASUREMENT
/begin MEASUREMENT Vtd_knk_slow_cor_iga_cyl_sl[0] "Knock correction low bukle (4 composants vector) for single zone" UBYTE _CNV_A_R_LINEAR_____23_CM 1 0. 0. 95.625 ECU_ADDRESS 0xd00077ae /end MEASUREMENT
/begin MEASUREMENT Vtd_knk_slow_cor_iga_cyl_sl[1] "Knock correction low bukle (4 composants vector) for single zone" UBYTE _CNV_A_R_LINEAR_____23_CM 1 0. 0. 95.625 ECU_ADDRESS 0xd00077af /end MEASUREMENT
/begin MEASUREMENT Vtd_knk_slow_cor_iga_cyl_sl[2] "Knock correction low bukle (4 composants vector) for single zone" UBYTE _CNV_A_R_LINEAR_____23_CM 1 0. 0. 95.625 ECU_ADDRESS 0xd00077b0 /end MEASUREMENT
/begin MEASUREMENT Vtd_knk_slow_cor_iga_cyl_sl[3] "Knock correction low bukle (4 composants vector) for single zone" UBYTE _CNV_A_R_LINEAR_____23_CM 1 0. 0. 95.625 ECU_ADDRESS 0xd00077b1 /end MEASUREMENT
/begin MEASUREMENT Vtd_knk_slow_iga_cyl_no_sat[0] "Knock correction low bukle before saturation (4 composants vector)" UBYTE _CNV_A_R_LINEAR_____23_CM 1 0. 0. 95.625 ECU_ADDRESS 0xd00077b2 /end MEASUREMENT
/begin MEASUREMENT Vtd_knk_slow_iga_cyl_no_sat[1] "Knock correction low bukle before saturation (4 composants vector)" UBYTE _CNV_A_R_LINEAR_____23_CM 1 0. 0. 95.625 ECU_ADDRESS 0xd00077b3 /end MEASUREMENT
/begin MEASUREMENT Vtd_knk_slow_iga_cyl_no_sat[2] "Knock correction low bukle before saturation (4 composants vector)" UBYTE _CNV_A_R_LINEAR_____23_CM 1 0. 0. 95.625 ECU_ADDRESS 0xd00077b4 /end MEASUREMENT
/begin MEASUREMENT Vtd_knk_slow_iga_cyl_no_sat[3] "Knock correction low bukle before saturation (4 composants vector)" UBYTE _CNV_A_R_LINEAR_____23_CM 1 0. 0. 95.625 ECU_ADDRESS 0xd00077b5 /end MEASUREMENT
/begin MEASUREMENT Vxx_knk_slow_cor_ave_sl "Mean Value of slow knk correction for single zone" UBYTE _CNV_A_R_LINEAR_____306_CM 1 0. 0. 7.96875 ECU_ADDRESS 0xd00077b8 FORMAT "%7.5" /end MEASUREMENT
/begin MEASUREMENT Vxx_knk_slow_cor_dec_ctr "counter for the slow loop decrease" UBYTE _CNV_A_R_LINEAR_____68_CM 1 0. 0. 255. ECU_ADDRESS 0xd00077b9 FORMAT "%3.0" /end MEASUREMENT
/begin MEASUREMENT Vxx_knk_slow_cor_max_iga_sl "Maximum ignition timing correction of the slow loop for all the cylinders for single zone" UBYTE _CNV_A_R_LINEAR_____23_CM 1 0. 0. 95.625 ECU_ADDRESS 0xd00077ba /end MEASUREMENT
/begin MEASUREMENT Vxx_slow_ctr "Counter used to know the number of slow loop correction values different from 0" UBYTE _CNV_A_R_ECME_LINEA_0_CM 1 0. 0. 4. ECU_ADDRESS 0xd00077bb FORMAT "%3.0" /end MEASUREMENT
/begin CHARACTERISTIC Cxx_slow_dec_step "Decrease value for slow loop" VALUE 0xa0020d8a _REC_S1VAL_20_u1 95.625 _CNV_A_R_LINEAR_____23_CM 0. 95.625 /end CHARACTERISTIC
/begin CHARACTERISTIC Ctp_n_knk_zon "Pressure threshold to critical zone depending on engine speed" CURVE 0xa0027290 _REC_A1CUR_20_u2_u2 20000. _CNV_A_R_LINEAR_____115_CM 0. 20000. FORMAT "%5.0"
 /begin AXIS_DESCR COM_AXIS Vxx_n _CNV_A_R_ENSD_LINEA_22_CM 20 0. 16383.75 FORMAT "%8.2" AXIS_PTS_REF Ctb_n /end AXIS_DESCR
/end CHARACTERISTIC
/begin MEASUREMENT Vbx_knk_zon_sl "Indicator of knock zone for single zone" UBYTE _CNV_S_2_RANGE______3_CM 1 0. 0. 1. ECU_ADDRESS 0xd0006693 BIT_MASK 0x1 /end MEASUREMENT
/begin CHARACTERISTIC Cmp_eal_n_vvtc_off_otl_iga "Map of optimal advance depending on engine speed and air load for VVT minimal reference angle" MAP 0xa0027504 _REC_A1MAP_20_u1_u2_u2 95.625 _CNV_A_R_IGRE_LINEA_47_CM -23.625 72. FORMAT "%7.3"
 /begin AXIS_DESCR COM_AXIS Vxx_n _CNV_A_R_ENSD_LINEA_22_CM 20 0. 16383.75 FORMAT "%8.2" AXIS_PTS_REF Ctb_n /end AXIS_DESCR
 /begin AXIS_DESCR COM_AXIS Vxx_eal _CNV_A_R_LINEAR_____53_CM 16 0. 3.99993896484375 FORMAT "%10.8" AXIS_PTS_REF Ctb_eal /end AXIS_DESCR
/end CHARACTERISTIC
/begin CHARACTERISTIC Cmp_eal_n_vvtc_on_otl_iga "Map of optimal advance depending on engine speed and air load for VVT maximal reference angle" MAP 0xa0027644 _REC_A1MAP_20_u1_u2_u2 95.625 _CNV_A_R_IGRE_LINEA_47_CM -23.625 72. FORMAT "%7.3"
 /begin AXIS_DESCR COM_AXIS Vxx_n _CNV_A_R_ENSD_LINEA_22_CM 20 0. 16383.75 FORMAT "%8.2" AXIS_PTS_REF Ctb_n /end AXIS_DESCR
 /begin AXIS_DESCR COM_AXIS Vxx_eal _CNV_A_R_LINEAR_____53_CM 16 0. 3.99993896484375 FORMAT "%10.8" AXIS_PTS_REF Ctb_eal /end AXIS_DESCR
/end CHARACTERISTIC
/begin CHARACTERISTIC Cmp_eal_n_vvtc_otl_iga "Map of optimal advance for a camshaft position corresponding to warm engine valve timings" MAP 0xa0027784 _REC_A1MAP_20_u1_u2_u2 95.625 _CNV_A_R_IGRE_LINEA_47_CM -23.625 72. FORMAT "%7.3"
 /begin AXIS_DESCR COM_AXIS Vxx_n _CNV_A_R_ENSD_LINEA_22_CM 20 0. 16383.75 FORMAT "%8.2" AXIS_PTS_REF Ctb_n /end AXIS_DESCR
 /begin AXIS_DESCR COM_AXIS Vxx_eal _CNV_A_R_LINEAR_____53_CM 16 0. 3.99993896484375 FORMAT "%10.8" AXIS_PTS_REF Ctb_eal /end AXIS_DESCR
/end CHARACTERISTIC
/begin MEASUREMENT Vsx_otl_iga_vld "Optimal advance validity status" UBYTE _CNV_S_3_STATUS_OK__179_CM 1 0. 0. 2. ECU_ADDRESS 0xd0006695 /end MEASUREMENT
/begin MEASUREMENT Vxx_otl_iga "Optimal advance" UBYTE _CNV_A_R_IGRE_LINEA_47_CM 1 0. -23.625 72. ECU_ADDRESS 0xd0006696 FORMAT "%7.3" /end MEASUREMENT
/begin MEASUREMENT Vxx_raw_otl_iga "Optimal advance depending on engine speed, air load and VVT intake angle" UBYTE _CNV_A_R_IGRE_LINEA_47_CM 1 0. -23.625 72. ECU_ADDRESS 0xd0006697 FORMAT "%7.3" /end MEASUREMENT
/begin MEASUREMENT Vxx_vvtc_off_otl_iga "Optimal advance reference depending on engine speed and air load for VVT minimal reference angle" UBYTE _CNV_A_R_IGRE_LINEA_47_CM 1 0. -23.625 72. ECU_ADDRESS 0xd0006698 FORMAT "%7.3" /end MEASUREMENT
/begin MEASUREMENT Vxx_vvtc_on_otl_iga "Optimal advance reference depending on engine speed and air load for VVT maximal reference angle" UBYTE _CNV_A_R_IGRE_LINEA_47_CM 1 0. -23.625 72. ECU_ADDRESS 0xd0006699 FORMAT "%7.3" /end MEASUREMENT
/begin MEASUREMENT Vxx_vvtc_otl_iga "Optimal advance for a camshaft position corresponding to warm engine valve timings" UBYTE _CNV_A_R_IGRE_LINEA_47_CM 1 0. -23.625 72. ECU_ADDRESS 0xd000669a FORMAT "%7.3" /end MEASUREMENT
/begin CHARACTERISTIC Cmp_eal_n_vvtc_otl_iga_alco "Map of Optimal advance correction for a camshaft position corresponding to warm engine valve timings for flex-fuel." MAP 0xa00273c4 _REC_A1MAP_20_u1_u2_u2 95.625 _CNV_A_R_LINEAR_____28_CM -48. 47.625 FORMAT "%7.3"
 /begin AXIS_DESCR COM_AXIS Vxx_n _CNV_A_R_ENSD_LINEA_22_CM 20 0. 16383.75 FORMAT "%8.2" AXIS_PTS_REF Ctb_n /end AXIS_DESCR
 /begin AXIS_DESCR COM_AXIS Vxx_eal _CNV_A_R_LINEAR_____53_CM 16 0. 3.99993896484375 FORMAT "%10.8" AXIS_PTS_REF Ctb_eal /end AXIS_DESCR
/end CHARACTERISTIC
/begin MEASUREMENT Vxx_vvtc_otl_iga_alco "Optimal Advance correction for Flex Fuel." SBYTE _CNV_A_R_LINEAR_____23_CM 1 0. -48. 47.625 ECU_ADDRESS 0xd0006694 FORMAT "%7.3" /end MEASUREMENT
/begin MEASUREMENT Vbx_df_igc_1_oc "Open circuit of ignition coil 1 detected failure" UBYTE _CNV_S_2_RANGE______3_CM 1 0. 0. 1. ECU_ADDRESS 0xd0006223 BIT_MASK 0x1 /end MEASUREMENT
/begin MEASUREMENT Vbx_df_igc_1_scg "Short Circuit to Ground of ignition coil 1 detected failure" UBYTE _CNV_S_2_RANGE______3_CM 1 0. 0. 1. ECU_ADDRESS 0xd0006224 BIT_MASK 0x1 /end MEASUREMENT
/begin MEASUREMENT Vbx_df_igc_1_scw "Short Circuit to Battery of ignition coil 1 detected failure" UBYTE _CNV_S_2_RANGE______3_CM 1 0. 0. 1. ECU_ADDRESS 0xd0006225 BIT_MASK 0x1 /end MEASUREMENT
/begin MEASUREMENT Vbx_df_igc_2_oc "Open circuit of ignition coil 2 detected failure" UBYTE _CNV_S_2_RANGE______3_CM 1 0. 0. 1. ECU_ADDRESS 0xd0006226 BIT_MASK 0x1 /end MEASUREMENT
/begin MEASUREMENT Vbx_df_igc_2_scg "Short Circuit to Ground of ignition coil 2 detected failure" UBYTE _CNV_S_2_RANGE______3_CM 1 0. 0. 1. ECU_ADDRESS 0xd0006227 BIT_MASK 0x1 /end MEASUREMENT
/begin MEASUREMENT Vbx_df_igc_2_scw "Short Circuit to Battery of ignition coil 2 detected failure" UBYTE _CNV_S_2_RANGE______3_CM 1 0. 0. 1. ECU_ADDRESS 0xd0006228 BIT_MASK 0x1 /end MEASUREMENT
/begin MEASUREMENT Vbx_df_igc_3_oc "Open circuit of ignition coil 3 detected failure" UBYTE _CNV_S_2_RANGE______3_CM 1 0. 0. 1. ECU_ADDRESS 0xd0006229 BIT_MASK 0x1 /end MEASUREMENT
/begin MEASUREMENT Vbx_df_igc_3_scg "Short Circuit to Ground of ignition coil 3 detected failure" UBYTE _CNV_S_2_RANGE______3_CM 1 0. 0. 1. ECU_ADDRESS 0xd000622a BIT_MASK 0x1 /end MEASUREMENT
/begin MEASUREMENT Vbx_df_igc_3_scw "Short Circuit to Battery of ignition coil 3 detected failure" UBYTE _CNV_S_2_RANGE______3_CM 1 0. 0. 1. ECU_ADDRESS 0xd000622b BIT_MASK 0x1 /end MEASUREMENT
/begin MEASUREMENT Vbx_df_igc_4_oc "Open circuit of ignition coil 4 detected failure" UBYTE _CNV_S_2_RANGE______3_CM 1 0. 0. 1. ECU_ADDRESS 0xd000622c BIT_MASK 0x1 /end MEASUREMENT
/begin MEASUREMENT Vbx_df_igc_4_scg "Short Circuit to Ground of ignition coil 4 detected failure" UBYTE _CNV_S_2_RANGE______3_CM 1 0. 0. 1. ECU_ADDRESS 0xd000622d BIT_MASK 0x1 /end MEASUREMENT
/begin MEASUREMENT Vbx_df_igc_4_scw "Short Circuit to Battery of ignition coil 4 detected failure" UBYTE _CNV_S_2_RANGE______3_CM 1 0. 0. 1. ECU_ADDRESS 0xd000622e BIT_MASK 0x1 /end MEASUREMENT
/begin MEASUREMENT Vbx_diag_ena_igc_1_oc "Open Circuit of ignition coil 1 diagnosis authorization" UBYTE _CNV_S_2_RANGE______3_CM 1 0. 0. 1. ECU_ADDRESS 0xd000622f BIT_MASK 0x1 /end MEASUREMENT
/begin MEASUREMENT Vbx_diag_ena_igc_1_scg "Short Circuit to Ground of ignition coil 1 diagnosis authorization" UBYTE _CNV_S_2_RANGE______3_CM 1 0. 0. 1. ECU_ADDRESS 0xd0006230 BIT_MASK 0x1 /end MEASUREMENT
/begin MEASUREMENT Vbx_diag_ena_igc_1_scw "Short Circuit to Battery of ignition coil 1 diagnosis authorization" UBYTE _CNV_S_2_RANGE______3_CM 1 0. 0. 1. ECU_ADDRESS 0xd0006231 BIT_MASK 0x1 /end MEASUREMENT
/begin MEASUREMENT Vbx_diag_ena_igc_2_oc "Open Circuit of ignition coil 2 diagnosis authorization" UBYTE _CNV_S_2_RANGE______3_CM 1 0. 0. 1. ECU_ADDRESS 0xd0006232 BIT_MASK 0x1 /end MEASUREMENT
/begin MEASUREMENT Vbx_diag_ena_igc_2_scg "Short Circuit to Ground of ignition coil 2 diagnosis authorization" UBYTE _CNV_S_2_RANGE______3_CM 1 0. 0. 1. ECU_ADDRESS 0xd0006233 BIT_MASK 0x1 /end MEASUREMENT
/begin MEASUREMENT Vbx_diag_ena_igc_2_scw "Short Circuit to Battery of ignition coil 2 diagnosis authorization" UBYTE _CNV_S_2_RANGE______3_CM 1 0. 0. 1. ECU_ADDRESS 0xd0006234 BIT_MASK 0x1 /end MEASUREMENT
/begin MEASUREMENT Vbx_diag_ena_igc_3_oc "Open Circuit of ignition coil 3 diagnosis authorization" UBYTE _CNV_S_2_RANGE______3_CM 1 0. 0. 1. ECU_ADDRESS 0xd0006235 BIT_MASK 0x1 /end MEASUREMENT
/begin MEASUREMENT Vbx_diag_ena_igc_3_scg "Short Circuit to Ground of ignition coil 3 diagnosis authorization" UBYTE _CNV_S_2_RANGE______3_CM 1 0. 0. 1. ECU_ADDRESS 0xd0006236 BIT_MASK 0x1 /end MEASUREMENT
/begin MEASUREMENT Vbx_diag_ena_igc_3_scw "Short Circuit to Battery of ignition coil 3 diagnosis authorization" UBYTE _CNV_S_2_RANGE______3_CM 1 0. 0. 1. ECU_ADDRESS 0xd0006237 BIT_MASK 0x1 /end MEASUREMENT
/begin MEASUREMENT Vbx_diag_ena_igc_4_oc "Open Circuit of ignition coil 4 diagnosis authorization" UBYTE _CNV_S_2_RANGE______3_CM 1 0. 0. 1. ECU_ADDRESS 0xd0006238 BIT_MASK 0x1 /end MEASUREMENT
/begin MEASUREMENT Vbx_diag_ena_igc_4_scg "Short Circuit to Ground of ignition coil 4 diagnosis authorization" UBYTE _CNV_S_2_RANGE______3_CM 1 0. 0. 1. ECU_ADDRESS 0xd0006239 BIT_MASK 0x1 /end MEASUREMENT
/begin MEASUREMENT Vbx_diag_ena_igc_4_scw "Short Circuit to Battery of ignition coil 4 diagnosis authorization" UBYTE _CNV_S_2_RANGE______3_CM 1 0. 0. 1. ECU_ADDRESS 0xd000623a BIT_MASK 0x1 /end MEASUREMENT
/begin MEASUREMENT iga_av_shift_rng[0] "Applied ignition angle; all corrections, knock control, torque intervention and start management included. x equals to index cylinder index ie from 0 to NC_CYL_NR -1 with NC_CYL_NR = 4" UBYTE _CNV_A_R_IGRE_LINEA_47_CM 1 0. -23.625 72. ECU_ADDRESS 0xd0006554 FORMAT "%7.3" /end MEASUREMENT
/begin MEASUREMENT iga_av_shift_rng[1] "Applied ignition angle; all corrections, knock control, torque intervention and start management included. x equals to index cylinder index ie from 0 to NC_CYL_NR -1 with NC_CYL_NR = 4" UBYTE _CNV_A_R_IGRE_LINEA_47_CM 1 0. -23.625 72. ECU_ADDRESS 0xd0006555 FORMAT "%7.3" /end MEASUREMENT
/begin MEASUREMENT iga_av_shift_rng[2] "Applied ignition angle; all corrections, knock control, torque intervention and start management included. x equals to index cylinder index ie from 0 to NC_CYL_NR -1 with NC_CYL_NR = 4" UBYTE _CNV_A_R_IGRE_LINEA_47_CM 1 0. -23.625 72. ECU_ADDRESS 0xd0006556 FORMAT "%7.3" /end MEASUREMENT
/begin MEASUREMENT iga_av_shift_rng[3] "Applied ignition angle; all corrections, knock control, torque intervention and start management included. x equals to index cylinder index ie from 0 to NC_CYL_NR -1 with NC_CYL_NR = 4" UBYTE _CNV_A_R_IGRE_LINEA_47_CM 1 0. -23.625 72. ECU_ADDRESS 0xd0006557 FORMAT "%7.3" /end MEASUREMENT
/begin MEASUREMENT inh_igc_cus "Identification of cylinders shut off" UBYTE _CNV_A_R_ECME_LINEA_0_CM 1 0. 0. 255. ECU_ADDRESS 0xd0006558 FORMAT "%3.0" /end MEASUREMENT
/begin MEASUREMENT state_td_boost "State for the dwell time boost: 0=no dwell boost; 1=dwell time boost at start; 2=dwell time boost at transient" UBYTE _CNV_A_R_ECME_LINEA_0_CM 1 0. 0. 2. ECU_ADDRESS 0xd0006559 FORMAT "%3.0" /end MEASUREMENT
/begin AXIS_PTS ldp_tco_ip_eoi_min_pre_inj "Latest end of injection for pre injection" 0xa0020a86 tco _REC_A2AXS_20_u1 190.5 _CNV_A_R_LINEAR_____41_CM 4 -48. 142.5 FORMAT "%6.2" /end AXIS_PTS
/begin AXIS_PTS ldp_tco_ip_psn_dif_eng_syn_thd "Latest end of injection for pre injection" 0xa0020a8c tco _REC_A2AXS_20_u1 190.5 _CNV_A_R_LINEAR_____41_CM 4 -48. 142.5 FORMAT "%6.2" /end AXIS_PTS
/begin CHARACTERISTIC ip_eoi_min_pre_inj "Latest end of injection for pre injection" CURVE 0xa0020a70 _REC_A1CUR_20_u2_u1 720. _CNV_A_R_LINEAR_____23_CM 0. 720. FORMAT "%7.3"
 /begin AXIS_DESCR COM_AXIS tco _CNV_A_R_LINEAR_____41_CM 4 -48. 142.5 FORMAT "%6.2" AXIS_PTS_REF ldp_tco_ip_eoi_min_pre_inj /end AXIS_DESCR
/end CHARACTERISTIC
/begin CHARACTERISTIC ip_psn_dif_eng_syn_thd "Latest end of injection for pre injection" CURVE 0xa0020a78 _REC_A1CUR_20_u2_u1 720. _CNV_A_R_LINEAR_____23_CM 0. 720. FORMAT "%7.3"
 /begin AXIS_DESCR COM_AXIS tco _CNV_A_R_LINEAR_____41_CM 4 -48. 142.5 FORMAT "%6.2" AXIS_PTS_REF ldp_tco_ip_psn_dif_eng_syn_thd /end AXIS_DESCR
/end CHARACTERISTIC
/begin MEASUREMENT Vbx_df_inj1_oc "Diagnosis Injector 1 (symptome)" UBYTE _CNV_S_2_RANGE______3_CM 1 0. 0. 1. ECU_ADDRESS 0xd0006567 BIT_MASK 0x1 /end MEASUREMENT
/begin MEASUREMENT Vbx_df_inj1_scg "Diagnosis Injector 1 (symptome)" UBYTE _CNV_S_2_RANGE______3_CM 1 0. 0. 1. ECU_ADDRESS 0xd0006568 BIT_MASK 0x1 /end MEASUREMENT
/begin MEASUREMENT Vbx_df_inj1_scw "Diagnosis Injector 1 (symptome)" UBYTE _CNV_S_2_RANGE______3_CM 1 0. 0. 1. ECU_ADDRESS 0xd0006569 BIT_MASK 0x1 /end MEASUREMENT
/begin MEASUREMENT Vbx_df_inj2_oc "Diagnosis Injector 2 (symptome)" UBYTE _CNV_S_2_RANGE______3_CM 1 0. 0. 1. ECU_ADDRESS 0xd000656a BIT_MASK 0x1 /end MEASUREMENT
/begin MEASUREMENT Vbx_df_inj2_scg "Diagnosis Injector 2 (symptome)" UBYTE _CNV_S_2_RANGE______3_CM 1 0. 0. 1. ECU_ADDRESS 0xd000656b BIT_MASK 0x1 /end MEASUREMENT
/begin MEASUREMENT Vbx_df_inj2_scw "Diagnosis Injector 2 (symptome)" UBYTE _CNV_S_2_RANGE______3_CM 1 0. 0. 1. ECU_ADDRESS 0xd000656c BIT_MASK 0x1 /end MEASUREMENT
/begin MEASUREMENT Vbx_df_inj3_oc "Diagnosis Injector 3 (symptome)" UBYTE _CNV_S_2_RANGE______3_CM 1 0. 0. 1. ECU_ADDRESS 0xd000656d BIT_MASK 0x1 /end MEASUREMENT
/begin MEASUREMENT Vbx_df_inj3_scg "Diagnosis Injector 3 (symptome)" UBYTE _CNV_S_2_RANGE______3_CM 1 0. 0. 1. ECU_ADDRESS 0xd000656e BIT_MASK 0x1 /end MEASUREMENT
/begin MEASUREMENT Vbx_df_inj3_scw "Diagnosis Injector 3 (symptome)" UBYTE _CNV_S_2_RANGE______3_CM 1 0. 0. 1. ECU_ADDRESS 0xd000656f BIT_MASK 0x1 /end MEASUREMENT
/begin MEASUREMENT Vbx_df_inj4_oc "Diagnosis Injector 4 (symptome)" UBYTE _CNV_S_2_RANGE______3_CM 1 0. 0. 1. ECU_ADDRESS 0xd0006570 BIT_MASK 0x1 /end MEASUREMENT
/begin MEASUREMENT Vbx_df_inj4_scg "Diagnosis Injector 4 (symptome)" UBYTE _CNV_S_2_RANGE______3_CM 1 0. 0. 1. ECU_ADDRESS 0xd0006571 BIT_MASK 0x1 /end MEASUREMENT
/begin MEASUREMENT Vbx_df_inj4_scw "Diagnosis Injector 4 (symptome)" UBYTE _CNV_S_2_RANGE______3_CM 1 0. 0. 1. ECU_ADDRESS 0xd0006572 BIT_MASK 0x1 /end MEASUREMENT
/begin MEASUREMENT Vbx_diag_ena_inj1_oc "Diagnosis Injector 1 (diag condition)" UBYTE _CNV_S_2_RANGE______3_CM 1 0. 0. 1. ECU_ADDRESS 0xd0006573 BIT_MASK 0x1 /end MEASUREMENT
/begin MEASUREMENT Vbx_diag_ena_inj1_scg "Diagnosis Injector 1 (diag condition)" UBYTE _CNV_S_2_RANGE______3_CM 1 0. 0. 1. ECU_ADDRESS 0xd0006574 BIT_MASK 0x1 /end MEASUREMENT
/begin MEASUREMENT Vbx_diag_ena_inj1_scw "Diagnosis Injector 1 (diag condition)" UBYTE _CNV_S_2_RANGE______3_CM 1 0. 0. 1. ECU_ADDRESS 0xd0006575 BIT_MASK 0x1 /end MEASUREMENT
/begin MEASUREMENT Vbx_diag_ena_inj2_oc "Diagnosis Injector 2 (diag condition)" UBYTE _CNV_S_2_RANGE______3_CM 1 0. 0. 1. ECU_ADDRESS 0xd0006576 BIT_MASK 0x1 /end MEASUREMENT
/begin MEASUREMENT Vbx_diag_ena_inj2_scg "Diagnosis Injector 2 (diag condition)" UBYTE _CNV_S_2_RANGE______3_CM 1 0. 0. 1. ECU_ADDRESS 0xd0006577 BIT_MASK 0x1 /end MEASUREMENT
/begin MEASUREMENT Vbx_diag_ena_inj2_scw "Diagnosis Injector 2 (diag condition)" UBYTE _CNV_S_2_RANGE______3_CM 1 0. 0. 1. ECU_ADDRESS 0xd0006578 BIT_MASK 0x1 /end MEASUREMENT
/begin MEASUREMENT Vbx_diag_ena_inj3_oc "Diagnosis Injector 3 (diag condition)" UBYTE _CNV_S_2_RANGE______3_CM 1 0. 0. 1. ECU_ADDRESS 0xd0006579 BIT_MASK 0x1 /end MEASUREMENT
/begin MEASUREMENT Vbx_diag_ena_inj3_scg "Diagnosis Injector 3 (diag condition)" UBYTE _CNV_S_2_RANGE______3_CM 1 0. 0. 1. ECU_ADDRESS 0xd000657a BIT_MASK 0x1 /end MEASUREMENT
/begin MEASUREMENT Vbx_diag_ena_inj3_scw "Diagnosis Injector 3 (diag condition)" UBYTE _CNV_S_2_RANGE______3_CM 1 0. 0. 1. ECU_ADDRESS 0xd000657b BIT_MASK 0x1 /end MEASUREMENT
/begin MEASUREMENT Vbx_diag_ena_inj4_oc "Diagnosis Injector 4 (diag condition)" UBYTE _CNV_S_2_RANGE______3_CM 1 0. 0. 1. ECU_ADDRESS 0xd000657c BIT_MASK 0x1 /end MEASUREMENT
/begin MEASUREMENT Vbx_diag_ena_inj4_scg "Diagnosis Injector 4 (diag condition)" UBYTE _CNV_S_2_RANGE______3_CM 1 0. 0. 1. ECU_ADDRESS 0xd000657d BIT_MASK 0x1 /end MEASUREMENT
/begin MEASUREMENT Vbx_diag_ena_inj4_scw "Diagnosis Injector 4 (diag condition)" UBYTE _CNV_S_2_RANGE______3_CM 1 0. 0. 1. ECU_ADDRESS 0xd000657e BIT_MASK 0x1 /end MEASUREMENT
/begin MEASUREMENT Vbx_inj_open "One (ore more) injector is open." UBYTE _CNV_S_2_RANGE______3_CM 1 0. 0. 1. ECU_ADDRESS 0xd0006566 BIT_MASK 0x1 /end MEASUREMENT
/begin MEASUREMENT cdn_diag_iv[0] "Diagnosis condition for injector [x]" UBYTE _CNV_A_R_ECME_LINEA_0_CM 1 0. 0. 255. ECU_ADDRESS 0xd0006562 FORMAT "%3.0" /end MEASUREMENT
/begin MEASUREMENT cdn_diag_iv[1] "Diagnosis condition for injector [x]" UBYTE _CNV_A_R_ECME_LINEA_0_CM 1 0. 0. 255. ECU_ADDRESS 0xd0006563 FORMAT "%3.0" /end MEASUREMENT
/begin MEASUREMENT cdn_diag_iv[2] "Diagnosis condition for injector [x]" UBYTE _CNV_A_R_ECME_LINEA_0_CM 1 0. 0. 255. ECU_ADDRESS 0xd0006564 FORMAT "%3.0" /end MEASUREMENT
/begin MEASUREMENT cdn_diag_iv[3] "Diagnosis condition for injector [x]" UBYTE _CNV_A_R_ECME_LINEA_0_CM 1 0. 0. 255. ECU_ADDRESS 0xd0006565 FORMAT "%3.0" /end MEASUREMENT
/begin MEASUREMENT crk_ctr_tmp "Number of teeth valid to launch the pre-injection" UBYTE _CNV_A_R_ECME_LINEA_0_CM 1 0. 0. 255. ECU_ADDRESS 0xd0007772 FORMAT "%3.0" /end MEASUREMENT
/begin MEASUREMENT crk_inj_ofs_cor_tmp "Temporary offset for progressive shift" UWORD _CNV_A_R_LINEAR_____23_CM 1 0. 0. 720. ECU_ADDRESS 0xd0004f24 FORMAT "%7.3" /end MEASUREMENT
/begin MEASUREMENT cyl_av "Function parameter of TRL_TRIG_EOI_LIM, which indicate the actual logical cylinder number for that cylinder which EOI_LIM was reached." UBYTE _CNV_A_R_ECME_LINEA_0_CM 1 0. 0. 3. ECU_ADDRESS 0xd000776b FORMAT "%3.0" /end MEASUREMENT
/begin MEASUREMENT eoi_lim_pre_inj "Latest end of injection angle for pre injection" UWORD _CNV_A_R_LINEAR_____23_CM 1 0. 0. 720. ECU_ADDRESS 0xd0004f2a FORMAT "%7.3" /end MEASUREMENT
/begin MEASUREMENT err_sym_iv[0] "Error symptom for injector [x] filtered with CDN_DIAG_IV[nC_CYL_NR]" UBYTE _CNV_S_16_RANGE_ERR__206_CM 1 0. 0. 15. ECU_ADDRESS 0xd000655e /end MEASUREMENT
/begin MEASUREMENT err_sym_iv[1] "Error symptom for injector [x] filtered with CDN_DIAG_IV[nC_CYL_NR]" UBYTE _CNV_S_16_RANGE_ERR__206_CM 1 0. 0. 15. ECU_ADDRESS 0xd000655f /end MEASUREMENT
/begin MEASUREMENT err_sym_iv[2] "Error symptom for injector [x] filtered with CDN_DIAG_IV[nC_CYL_NR]" UBYTE _CNV_S_16_RANGE_ERR__206_CM 1 0. 0. 15. ECU_ADDRESS 0xd0006560 /end MEASUREMENT
/begin MEASUREMENT err_sym_iv[3] "Error symptom for injector [x] filtered with CDN_DIAG_IV[nC_CYL_NR]" UBYTE _CNV_S_16_RANGE_ERR__206_CM 1 0. 0. 15. ECU_ADDRESS 0xd0006561 /end MEASUREMENT
/begin MEASUREMENT inh_inj_tmp[0] "Temporary flag indicating that injection for cyl x is inhibited" UBYTE _CNV_S_2_RANGE______3_CM 1 0. 0. 1. ECU_ADDRESS 0xd000774e /end MEASUREMENT
/begin MEASUREMENT inh_inj_tmp[1] "Temporary flag indicating that injection for cyl x is inhibited" UBYTE _CNV_S_2_RANGE______3_CM 1 0. 0. 1. ECU_ADDRESS 0xd000774f /end MEASUREMENT
/begin MEASUREMENT inh_inj_tmp[2] "Temporary flag indicating that injection for cyl x is inhibited" UBYTE _CNV_S_2_RANGE______3_CM 1 0. 0. 1. ECU_ADDRESS 0xd0007750 /end MEASUREMENT
/begin MEASUREMENT inh_inj_tmp[3] "Temporary flag indicating that injection for cyl x is inhibited" UBYTE _CNV_S_2_RANGE______3_CM 1 0. 0. 1. ECU_ADDRESS 0xd0007751 /end MEASUREMENT
/begin MEASUREMENT lf_state_inj_clc_req "Bitfield that indicates the recurrence of the state- and the transitionmachine" UBYTE _CNV_A_R_ECME_LINEA_0_CM 1 0. 0. 255. ECU_ADDRESS 0xd000776f FORMAT "%3.0" /end MEASUREMENT
/begin MEASUREMENT lv_conf_pre_inj "Configuration of pre-injection type" UBYTE _CNV_S_2_RANGE______3_CM 1 0. 0. 1. ECU_ADDRESS 0xd000775e BIT_MASK 0x1 /end MEASUREMENT
/begin MEASUREMENT lv_crash_act "Flag indicates that a crash occurs" UBYTE _CNV_S_2_RANGE______3_CM 1 0. 0. 1. ECU_ADDRESS 0xd0007763 BIT_MASK 0x1 /end MEASUREMENT
/begin MEASUREMENT lv_inh_inj[0] "Flag that indicates if cylinder shut off is active or not" UBYTE _CNV_S_2_RANGE______3_CM 1 0. 0. 1. ECU_ADDRESS 0xd0007752 BIT_MASK 0x1 /end MEASUREMENT
/begin MEASUREMENT lv_inh_inj[1] "Flag that indicates if cylinder shut off is active or not" UBYTE _CNV_S_2_RANGE______3_CM 1 0. 0. 1. ECU_ADDRESS 0xd0007753 BIT_MASK 0x1 /end MEASUREMENT
/begin MEASUREMENT lv_inh_inj[2] "Flag that indicates if cylinder shut off is active or not" UBYTE _CNV_S_2_RANGE______3_CM 1 0. 0. 1. ECU_ADDRESS 0xd0007754 BIT_MASK 0x1 /end MEASUREMENT
/begin MEASUREMENT lv_inh_inj[3] "Flag that indicates if cylinder shut off is active or not" UBYTE _CNV_S_2_RANGE______3_CM 1 0. 0. 1. ECU_ADDRESS 0xd0007755 BIT_MASK 0x1 /end MEASUREMENT
/begin MEASUREMENT lv_inj_di_req "Bit that indicates that an disabling event has appeared" UBYTE _CNV_S_2_RANGE______3_CM 1 0. 0. 1. ECU_ADDRESS 0xd000775f BIT_MASK 0x1 /end MEASUREMENT
/begin MEASUREMENT lv_inj_ena_req "Bit that indicates that the enabling event has appeared" UBYTE _CNV_S_2_RANGE______3_CM 1 0. 0. 1. ECU_ADDRESS 0xd0007760 BIT_MASK 0x1 /end MEASUREMENT
/begin MEASUREMENT lv_inj_open "At least one injector has been opened since last reset or engine stalling event" UBYTE _CNV_S_2_RANGE______3_CM 1 0. 0. 1. ECU_ADDRESS 0xd0007761 BIT_MASK 0x1 /end MEASUREMENT
/begin MEASUREMENT lv_inj_open_drv_cycle "At least one injector has been opened in the driving cycle" UBYTE _CNV_S_2_RANGE______3_CM 1 0. 0. 1. ECU_ADDRESS 0xd0007765 BIT_MASK 0x1 /end MEASUREMENT
/begin MEASUREMENT lv_pre_inj_end[0] "Logical filed that indicates that a cylinder has finished its pre injection cylce" UBYTE _CNV_S_2_RANGE______3_CM 1 0. 0. 1. ECU_ADDRESS 0xd0007756 BIT_MASK 0x1 /end MEASUREMENT
/begin MEASUREMENT lv_pre_inj_end[1] "Logical filed that indicates that a cylinder has finished its pre injection cylce" UBYTE _CNV_S_2_RANGE______3_CM 1 0. 0. 1. ECU_ADDRESS 0xd0007757 BIT_MASK 0x1 /end MEASUREMENT
/begin MEASUREMENT lv_pre_inj_end[2] "Logical filed that indicates that a cylinder has finished its pre injection cylce" UBYTE _CNV_S_2_RANGE______3_CM 1 0. 0. 1. ECU_ADDRESS 0xd0007758 BIT_MASK 0x1 /end MEASUREMENT
/begin MEASUREMENT lv_pre_inj_end[3] "Logical filed that indicates that a cylinder has finished its pre injection cylce" UBYTE _CNV_S_2_RANGE______3_CM 1 0. 0. 1. ECU_ADDRESS 0xd0007759 BIT_MASK 0x1 /end MEASUREMENT
/begin MEASUREMENT lv_soi_lock_req "Indicates that the first SOI of a selected cylinder is locked to C_SOI_LOCK" UBYTE _CNV_S_2_RANGE______3_CM 1 0. 0. 1. ECU_ADDRESS 0xd0007762 BIT_MASK 0x1 /end MEASUREMENT
/begin MEASUREMENT lv_state_prev_iv[0] "Cylinder individuel flag which indicates whether last injection was activated or deactivated" UBYTE _CNV_S_2_RANGE______3_CM 1 0. 0. 1. ECU_ADDRESS 0xd000655a BIT_MASK 0x1 /end MEASUREMENT
/begin MEASUREMENT lv_state_prev_iv[1] "Cylinder individuel flag which indicates whether last injection was activated or deactivated" UBYTE _CNV_S_2_RANGE______3_CM 1 0. 0. 1. ECU_ADDRESS 0xd000655b BIT_MASK 0x1 /end MEASUREMENT
/begin MEASUREMENT lv_state_prev_iv[2] "Cylinder individuel flag which indicates whether last injection was activated or deactivated" UBYTE _CNV_S_2_RANGE______3_CM 1 0. 0. 1. ECU_ADDRESS 0xd000655c BIT_MASK 0x1 /end MEASUREMENT
/begin MEASUREMENT lv_state_prev_iv[3] "Cylinder individuel flag which indicates whether last injection was activated or deactivated" UBYTE _CNV_S_2_RANGE______3_CM 1 0. 0. 1. ECU_ADDRESS 0xd000655d BIT_MASK 0x1 /end MEASUREMENT
/begin MEASUREMENT lv_test_out_eol_fim_shrt "Forces a short ton min for the injector diagnosis (ATIC 39)." UBYTE _CNV_S_2_RANGE______3_CM 1 0. 0. 1. ECU_ADDRESS 0xd0007769 /end MEASUREMENT
/begin MEASUREMENT nr_cyl_first "Number of first cylinder to be injected while going to sequential mode" UBYTE _CNV_A_R_ECME_LINEA_0_CM 1 0. 0. 255. ECU_ADDRESS 0xd0007773 FORMAT "%3.0" /end MEASUREMENT
/begin MEASUREMENT nr_cyl_first_1 "Number of first cylinder to be injected while going to sequential mode" UBYTE _CNV_A_R_ECME_LINEA_0_CM 1 0. 0. 255. ECU_ADDRESS 0xd0007774 FORMAT "%3.0" /end MEASUREMENT
/begin MEASUREMENT nr_cyl_first_2 "Number of first cylinder +2 (in fireing order) to be injected while going to sequential mode" UBYTE _CNV_A_R_ECME_LINEA_0_CM 1 0. 0. 255. ECU_ADDRESS 0xd0007775 FORMAT "%3.0" /end MEASUREMENT
/begin MEASUREMENT nr_cyl_first_3 "Number of first  cylinder +3 (in fireing order) to be injected while going to sequential mode" UBYTE _CNV_A_R_ECME_LINEA_0_CM 1 0. 0. 255. ECU_ADDRESS 0xd0007776 FORMAT "%3.0" /end MEASUREMENT
/begin MEASUREMENT nr_tooth_pre_inj "Number of teeth valid to launch the pre-injection" UBYTE _CNV_A_R_ECME_LINEA_0_CM 1 0. 0. 255. ECU_ADDRESS 0xd0007771 FORMAT "%3.0" /end MEASUREMENT
/begin MEASUREMENT ofs_ctr "Temporary offset counter for progressive shift" UBYTE _CNV_A_R_ECME_LINEA_0_CM 1 0. 0. 255. ECU_ADDRESS 0xd000776c FORMAT "%3.0" /end MEASUREMENT
/begin MEASUREMENT ofs_ref_inj "Injection reference offset" UWORD _CNV_A_R_LINEAR_____23_CM 1 0. 0. 720. ECU_ADDRESS 0xd0004f34 FORMAT "%7.3" /end MEASUREMENT
/begin MEASUREMENT psn_dif_eng_syn "Difference of the min and max estimated engine position in the non syn. phase" UWORD _CNV_A_R_LINEAR_____23_CM 1 0. 0. 720. ECU_ADDRESS 0xd0004f2c FORMAT "%7.3" /end MEASUREMENT
/begin MEASUREMENT psn_dif_eng_syn_thd "Difference of the min and max estimated engine position in the non syn. phase to trigger a preinjection" UWORD _CNV_A_R_LINEAR_____23_CM 1 0. 0. 720. ECU_ADDRESS 0xd0004f2e FORMAT "%7.3" /end MEASUREMENT
/begin MEASUREMENT psn_dif_eng_syn_tmp "Difference of the min and max estimated engine position in the non syn. phase to trigger a preinjection. Temporary value." SWORD _CNV_A_R_LINEAR_____23_CM 1 0. -1440. 1440. ECU_ADDRESS 0xd0004f30 FORMAT "%5.3" /end MEASUREMENT
/begin MEASUREMENT soi_1_hom[0] "Start of injection for homogeneous mode, for the first injection - cylinder individual" UWORD _CNV_A_R_LINEAR_____23_CM 1 0. 0. 720. ECU_ADDRESS 0xd0004f0c FORMAT "%7.3" /end MEASUREMENT
/begin MEASUREMENT soi_1_hom[1] "Start of injection for homogeneous mode, for the first injection - cylinder individual" UWORD _CNV_A_R_LINEAR_____23_CM 1 0. 0. 720. ECU_ADDRESS 0xd0004f0e FORMAT "%7.3" /end MEASUREMENT
/begin MEASUREMENT soi_1_hom[2] "Start of injection for homogeneous mode, for the first injection - cylinder individual" UWORD _CNV_A_R_LINEAR_____23_CM 1 0. 0. 720. ECU_ADDRESS 0xd0004f10 FORMAT "%7.3" /end MEASUREMENT
/begin MEASUREMENT soi_1_hom[3] "Start of injection for homogeneous mode, for the first injection - cylinder individual" UWORD _CNV_A_R_LINEAR_____23_CM 1 0. 0. 720. ECU_ADDRESS 0xd0004f12 FORMAT "%7.3" /end MEASUREMENT
/begin MEASUREMENT soi_2_hom[0] "Start of injection for homogeneous mode, for the second injection - cylinder individual" UWORD _CNV_A_R_LINEAR_____23_CM 1 0. 0. 720. ECU_ADDRESS 0xd0004f14 FORMAT "%7.3" /end MEASUREMENT
/begin MEASUREMENT soi_2_hom[1] "Start of injection for homogeneous mode, for the second injection - cylinder individual" UWORD _CNV_A_R_LINEAR_____23_CM 1 0. 0. 720. ECU_ADDRESS 0xd0004f16 FORMAT "%7.3" /end MEASUREMENT
/begin MEASUREMENT soi_2_hom[2] "Start of injection for homogeneous mode, for the second injection - cylinder individual" UWORD _CNV_A_R_LINEAR_____23_CM 1 0. 0. 720. ECU_ADDRESS 0xd0004f18 FORMAT "%7.3" /end MEASUREMENT
/begin MEASUREMENT soi_2_hom[3] "Start of injection for homogeneous mode, for the second injection - cylinder individual" UWORD _CNV_A_R_LINEAR_____23_CM 1 0. 0. 720. ECU_ADDRESS 0xd0004f1a FORMAT "%7.3" /end MEASUREMENT
/begin MEASUREMENT soi_pre_inj[0] "Start of injection for preinjection" UWORD _CNV_A_R_LINEAR_____23_CM 1 0. 0. 720. ECU_ADDRESS 0xd0004f1c FORMAT "%7.3" /end MEASUREMENT
/begin MEASUREMENT soi_pre_inj[1] "Start of injection for preinjection" UWORD _CNV_A_R_LINEAR_____23_CM 1 0. 0. 720. ECU_ADDRESS 0xd0004f1e FORMAT "%7.3" /end MEASUREMENT
/begin MEASUREMENT soi_pre_inj[2] "Start of injection for preinjection" UWORD _CNV_A_R_LINEAR_____23_CM 1 0. 0. 720. ECU_ADDRESS 0xd0004f20 FORMAT "%7.3" /end MEASUREMENT
/begin MEASUREMENT soi_pre_inj[3] "Start of injection for preinjection" UWORD _CNV_A_R_LINEAR_____23_CM 1 0. 0. 720. ECU_ADDRESS 0xd0004f22 FORMAT "%7.3" /end MEASUREMENT
/begin MEASUREMENT soi_pre_inj_cor "Corrected Start of injection for first injection cycle" UWORD _CNV_A_R_LINEAR_____23_CM 1 0. 0. 720. ECU_ADDRESS 0xd0004f32 FORMAT "%7.3" /end MEASUREMENT
/begin MEASUREMENT state_inj_mod "Indicates the over all injection mode of the driver" UWORD _CNV_S_17_INJECTION__309_CM 1 0. 0. 20480. ECU_ADDRESS 0xd0004f26 /end MEASUREMENT
/begin MEASUREMENT state_inj_mod_tran "Application Software Injection Mode Transition State" UBYTE _CNV_S_18_INJECTION__310_CM 1 0. 0. 255. ECU_ADDRESS 0xd0007770 /end MEASUREMENT
/begin MEASUREMENT state_inj_upd_mod_cyl_ack "Feedback from IO-software of successful data transfer" UBYTE _CNV_A_R_ECME_LINEA_0_CM 1 0. 0. 255. ECU_ADDRESS 0xd000776e FORMAT "%3.0" /end MEASUREMENT
/begin MEASUREMENT tdc_ctr_prg_shift "Wait counter for next progressive shift event inside progressive shift mode." UBYTE _CNV_A_R_ECME_LINEA_0_CM 1 0. 0. 255. ECU_ADDRESS 0xd000776d FORMAT "%3.0" /end MEASUREMENT
/begin MEASUREMENT ti_1_hom[0] "Cylinder individual injection time, homogeneous mode, first pulse" UWORD _CNV_A_R_LINEAR_____43_CM 1 0. 0. 262.14 ECU_ADDRESS 0xd0004efc FORMAT "%7.3" /end MEASUREMENT
/begin MEASUREMENT ti_1_hom[1] "Cylinder individual injection time, homogeneous mode, first pulse" UWORD _CNV_A_R_LINEAR_____43_CM 1 0. 0. 262.14 ECU_ADDRESS 0xd0004efe FORMAT "%7.3" /end MEASUREMENT
/begin MEASUREMENT ti_1_hom[2] "Cylinder individual injection time, homogeneous mode, first pulse" UWORD _CNV_A_R_LINEAR_____43_CM 1 0. 0. 262.14 ECU_ADDRESS 0xd0004f00 FORMAT "%7.3" /end MEASUREMENT
/begin MEASUREMENT ti_1_hom[3] "Cylinder individual injection time, homogeneous mode, first pulse" UWORD _CNV_A_R_LINEAR_____43_CM 1 0. 0. 262.14 ECU_ADDRESS 0xd0004f02 FORMAT "%7.3" /end MEASUREMENT
/begin MEASUREMENT ti_2_hom[0] "Cylinder  individual injection time, homogeneous mode, second pulse" UWORD _CNV_A_R_LINEAR_____43_CM 1 0. 0. 262.14 ECU_ADDRESS 0xd0004f04 FORMAT "%7.3" /end MEASUREMENT
/begin MEASUREMENT ti_2_hom[1] "Cylinder  individual injection time, homogeneous mode, second pulse" UWORD _CNV_A_R_LINEAR_____43_CM 1 0. 0. 262.14 ECU_ADDRESS 0xd0004f06 FORMAT "%7.3" /end MEASUREMENT
/begin MEASUREMENT ti_2_hom[2] "Cylinder  individual injection time, homogeneous mode, second pulse" UWORD _CNV_A_R_LINEAR_____43_CM 1 0. 0. 262.14 ECU_ADDRESS 0xd0004f08 FORMAT "%7.3" /end MEASUREMENT
/begin MEASUREMENT ti_2_hom[3] "Cylinder  individual injection time, homogeneous mode, second pulse" UWORD _CNV_A_R_LINEAR_____43_CM 1 0. 0. 262.14 ECU_ADDRESS 0xd0004f0a FORMAT "%7.3" /end MEASUREMENT
/begin MEASUREMENT ti_pre_inj[0] "Pre-injection time" UWORD _CNV_A_R_LINEAR_____43_CM 1 0. 0. 262.14 ECU_ADDRESS 0xd0004ef4 FORMAT "%7.3" /end MEASUREMENT
/begin MEASUREMENT ti_pre_inj[1] "Pre-injection time" UWORD _CNV_A_R_LINEAR_____43_CM 1 0. 0. 262.14 ECU_ADDRESS 0xd0004ef6 FORMAT "%7.3" /end MEASUREMENT
/begin MEASUREMENT ti_pre_inj[2] "Pre-injection time" UWORD _CNV_A_R_LINEAR_____43_CM 1 0. 0. 262.14 ECU_ADDRESS 0xd0004ef8 FORMAT "%7.3" /end MEASUREMENT
/begin MEASUREMENT ti_pre_inj[3] "Pre-injection time" UWORD _CNV_A_R_LINEAR_____43_CM 1 0. 0. 262.14 ECU_ADDRESS 0xd0004efa FORMAT "%7.3" /end MEASUREMENT
/begin MEASUREMENT timer_pre_inj_fg "Temporary counter for FG pre injection" SWORD _CNV_A_R_ECME_LINEA_0_CM 1 0. -32768. 32767. ECU_ADDRESS 0xd0004f28 FORMAT "%6.0" /end MEASUREMENT
/begin CHARACTERISTIC c_cdn_diag_iv "Diagnosis recurrence function engine speed" VALUE 0xa0020b2f _REC_S1VAL_20_u1 8160. _CNV_A_R_LINEAR_____2_CM 0. 8160. FORMAT "%4.0" /end CHARACTERISTIC
/begin CHARACTERISTIC c_n_low_ena_pre_thd "The pre injection will be switched off if this engine speed threshold is exceeded" VALUE 0xa0020ace _REC_S1VAL_20_u2 8160. _CNV_A_R_LINEAR_____19_CM 0. 8160. FORMAT "%4.0" /end CHARACTERISTIC
/begin CHARACTERISTIC c_rec_diag_iv "Diagnosis recurrence" VALUE 0xa0020b3f _REC_S1VAL_20_u1 2800. _CNV_A_R_LINEAR_____311_CM 200. 3000. FORMAT "%4.0" /end CHARACTERISTIC
/begin CHARACTERISTIC c_soi_lock "SOI of first pulse of one cylinder will be locked to this value." VALUE 0xa0020ad4 _REC_S1VAL_20_u2 720. _CNV_A_R_LINEAR_____23_CM 0. 720. FORMAT "%7.3" /end CHARACTERISTIC
/begin CHARACTERISTIC c_tco_max_pre_inj_seq "Maximum coolant temperature for sequential TI_PRE_INJ application" VALUE 0xa0020b42 _REC_S1VAL_20_u1 190.5 _CNV_A_R_LINEAR_____41_CM -48. 142.5 FORMAT "%6.2" /end CHARACTERISTIC
/begin CHARACTERISTIC c_ti_eol "Time injection pulse for End Of Line test" VALUE 0xa0020ad6 _REC_S1VAL_20_u2 262.14 _CNV_A_R_LINEAR_____43_CM 0. 262.14 FORMAT "%7.3" /end CHARACTERISTIC
/begin CHARACTERISTIC lc_eoi_pre_inj_1_cor_ena "Enable to correct phasing of the 1st Pre-injection pulse" VALUE 0xa0020b4c _REC_S1VAL_20_u1 1. _CNV_S_2_RANGE______3_CM 0. 1. /end CHARACTERISTIC
/begin MEASUREMENT Vbx_sens_brk_pdl_open "(=1) Brake pedal pressed : information given by the opening brake signal." UBYTE _CNV_S_2_RANGE______3_CM 1 0. 0. 1. ECU_ADDRESS 0xd00061ec BIT_MASK 0x1 /end MEASUREMENT
/begin MEASUREMENT Vbx_sfty_sens_brk_pdl_open "Copy for safety monitoring of the information given by the opening brake signal ([=1] Brake pedal pressed)" UBYTE _CNV_S_2_RANGE______3_CM 1 0. 0. 1. ECU_ADDRESS 0xd0007eb8 BIT_MASK 0x1 /end MEASUREMENT
/begin MEASUREMENT lv_bls "Flag for brake active (1=active; 0=inactive)." UBYTE _CNV_S_2_RANGE______3_CM 1 0. 0. 1. ECU_ADDRESS 0xd00064f7 /end MEASUREMENT
/begin MEASUREMENT lv_bls_mon "Flag for safety brake active (1=active; 0=inactive)." UBYTE _CNV_S_2_RANGE______3_CM 1 0. 0. 1. ECU_ADDRESS 0xd0007f86 BIT_MASK 0x1 /end MEASUREMENT
/begin MEASUREMENT lv_bts "Flag for brake test switch (1=brake active; 0=brake inactive)." UBYTE _CNV_S_2_RANGE______3_CM 1 0. 0. 1. ECU_ADDRESS 0xd00064f8 /end MEASUREMENT
/begin MEASUREMENT lv_bts_mon "Flag for safety brake test switch (1=brake active; 0=brake inactive)." UBYTE _CNV_S_2_RANGE______3_CM 1 0. 0. 1. ECU_ADDRESS 0xd0007f85 BIT_MASK 0x1 /end MEASUREMENT
/begin MEASUREMENT lv_clu_swi "Boolean for clutch switch detection." UBYTE _CNV_S_2_RANGE______3_CM 1 0. 0. 1. ECU_ADDRESS 0xd00064f6 /end MEASUREMENT
/begin MEASUREMENT Vbx_raw_sens_bgin_clu_cnt "State of the begin of teh clutch pedal (0 = pedal released, 1 = pedal pressed)" UBYTE _CNV_S_2_RANGE______3_CM 1 0. 0. 1. ECU_ADDRESS 0xd00061ed BIT_MASK 0x1 /end MEASUREMENT
/begin AXIS_PTS Ctb_ajs_aux_tql "Breakpoints calibration for torque losses due to accessories, for Anti-Jerk Strategy" 0xa0030be4 Vxx_ajs_aux_tql _REC_A2AXS_20_u2 2047.96875 _CNV_A_R_LINEAR_____181_CM 8 0. 2047.96875 FORMAT "%10.5" /end AXIS_PTS
/begin AXIS_PTS Ctb_ajs_drag_tq_fac "Breakpoint calibration of normalized driver torque factor for drag error correction." 0xa0021c04 Vxx_ajs_spv_driv_tq_fac _REC_A2AXS_20_u1 1. _CNV_A_R_LINEAR_____123_CM 7 0. 1. FORMAT "%4.2" /end AXIS_PTS
/begin AXIS_PTS Ctb_ajs_modu_n "Breakpoint calibration of engine speed in AJMOD function" 0xa002f6f4 Vxx_ajs_modu_n_mv _REC_A2AXS_20_u2 16383.75 _CNV_A_R_ENSD_LINEA_22_CM 10 0. 16383.75 FORMAT "%8.2" /end AXIS_PTS
/begin AXIS_PTS Ctb_ajs_modu_tkof_spt_fac "Breakpoint calibration of sportivity factor during takeoff phase" 0xa0021c14 Vxx_tkof_ass_fac _REC_A2AXS_20_u1 1. _CNV_A_R_LINEAR_____275_CM 5 0. 1. FORMAT "%9.7" /end AXIS_PTS
/begin AXIS_PTS Ctb_ajs_tq_fac "Breakpoint calibration of normalized driver torque factor" 0xa0021c0c Vxx_ajs_spv_driv_tq_fac _REC_A2AXS_20_u1 1. _CNV_A_R_LINEAR_____123_CM 7 0. 1. FORMAT "%4.2" /end AXIS_PTS
/begin CHARACTERISTIC Cmp_ajs_acel_slk_dly_t1 "AJMOD cartography for selecting the delay of action of the slack effect for vehicle acceleration" MAP 0xa002f70c _REC_A1MAP_20_u2_u2_u2 65.535 _CNV_A_R_LINEAR_____116_CM 0. 65.535
 /begin AXIS_DESCR COM_AXIS Vxx_ajs_modu_n_mv _CNV_A_R_ENSD_LINEA_22_CM 10 0. 16383.75 FORMAT "%8.2" AXIS_PTS_REF Ctb_ajs_modu_n /end AXIS_DESCR
 /begin AXIS_DESCR COM_AXIS Vxx_ajs_dt_tq_rat _CNV_A_R_LINEAR_____313_CM 12 -10. 200. FORMAT "%6.2" AXIS_PTS_REF Ctb_ajs_dt_tq_rat /end AXIS_DESCR
/end CHARACTERISTIC
/begin CHARACTERISTIC Cmp_ajs_acel_slk_dly_t1_fac "AJMOD cartography for modulation factors of the delay of action of the slack effect for vehicle acceleration" MAP 0xa002f7fc _REC_A1MAP_20_u2_u1_u2 100. _CNV_A_R_LINEAR_____123_CM 0. 100.
 /begin AXIS_DESCR COM_AXIS Vxx_ajs_spv_driv_tq_fac _CNV_A_R_LINEAR_____123_CM 7 0. 1. FORMAT "%4.2" AXIS_PTS_REF Ctb_ajs_tq_fac /end AXIS_DESCR
 /begin AXIS_DESCR COM_AXIS Vxx_ajs_dt_tq_rat _CNV_A_R_LINEAR_____313_CM 12 -10. 200. FORMAT "%6.2" AXIS_PTS_REF Ctb_ajs_dt_tq_rat /end AXIS_DESCR
/end CHARACTERISTIC
/begin CHARACTERISTIC Cmp_ajs_acel_slk_t1_ini_max "AJMOD cartography for selectiong the initial time constant offset added during slack effect activation for vehicle acceleration" MAP 0xa002f8a4 _REC_A1MAP_20_u2_u2_u2 65.535 _CNV_A_R_LINEAR_____116_CM 0. 65.535
 /begin AXIS_DESCR COM_AXIS Vxx_ajs_modu_n_mv _CNV_A_R_ENSD_LINEA_22_CM 10 0. 16383.75 FORMAT "%8.2" AXIS_PTS_REF Ctb_ajs_modu_n /end AXIS_DESCR
 /begin AXIS_DESCR COM_AXIS Vxx_ajs_dt_tq_rat _CNV_A_R_LINEAR_____313_CM 12 -10. 200. FORMAT "%6.2" AXIS_PTS_REF Ctb_ajs_dt_tq_rat /end AXIS_DESCR
/end CHARACTERISTIC
/begin CHARACTERISTIC Cmp_ajs_acel_slk_t1_ini_max_fac "AJMOD cartography for modulation factors of the initial time constant offset added during slack effect activation for vehicle acceleration" MAP 0xa002f994 _REC_A1MAP_20_u2_u1_u2 100. _CNV_A_R_LINEAR_____123_CM 0. 100.
 /begin AXIS_DESCR COM_AXIS Vxx_ajs_spv_driv_tq_fac _CNV_A_R_LINEAR_____123_CM 7 0. 1. FORMAT "%4.2" AXIS_PTS_REF Ctb_ajs_tq_fac /end AXIS_DESCR
 /begin AXIS_DESCR COM_AXIS Vxx_ajs_dt_tq_rat _CNV_A_R_LINEAR_____313_CM 12 -10. 200. FORMAT "%6.2" AXIS_PTS_REF Ctb_ajs_dt_tq_rat /end AXIS_DESCR
/end CHARACTERISTIC
/begin CHARACTERISTIC Cmp_ajs_decl_slk_dly_t1 "AJMOD cartography for selecting the delay of action of the slack effect for vehicle deceleration" MAP 0xa002fa3c _REC_A1MAP_20_u2_u2_u2 65.535 _CNV_A_R_LINEAR_____116_CM 0. 65.535
 /begin AXIS_DESCR COM_AXIS Vxx_ajs_modu_n_mv _CNV_A_R_ENSD_LINEA_22_CM 10 0. 16383.75 FORMAT "%8.2" AXIS_PTS_REF Ctb_ajs_modu_n /end AXIS_DESCR
 /begin AXIS_DESCR COM_AXIS Vxx_ajs_dt_tq_rat _CNV_A_R_LINEAR_____313_CM 12 -10. 200. FORMAT "%6.2" AXIS_PTS_REF Ctb_ajs_dt_tq_rat /end AXIS_DESCR
/end CHARACTERISTIC
/begin CHARACTERISTIC Cmp_ajs_decl_slk_dly_t1_fac "AJMOD cartography for modulation factors of the delay of action of the slack effect for vehicle deceleration" MAP 0xa002fb2c _REC_A1MAP_20_u2_u1_u2 100. _CNV_A_R_LINEAR_____123_CM 0. 100.
 /begin AXIS_DESCR COM_AXIS Vxx_ajs_spv_driv_tq_fac _CNV_A_R_LINEAR_____123_CM 7 0. 1. FORMAT "%4.2" AXIS_PTS_REF Ctb_ajs_tq_fac /end AXIS_DESCR
 /begin AXIS_DESCR COM_AXIS Vxx_ajs_dt_tq_rat _CNV_A_R_LINEAR_____313_CM 12 -10. 200. FORMAT "%6.2" AXIS_PTS_REF Ctb_ajs_dt_tq_rat /end AXIS_DESCR
/end CHARACTERISTIC
/begin CHARACTERISTIC Cmp_ajs_decl_slk_t1_ini_max "AJMOD cartography for selectiong the initial time constant offset added during slack effect activation for vehicle deceleration" MAP 0xa002fbd4 _REC_A1MAP_20_u2_u2_u2 65.535 _CNV_A_R_LINEAR_____116_CM 0. 65.535
 /begin AXIS_DESCR COM_AXIS Vxx_ajs_modu_n_mv _CNV_A_R_ENSD_LINEA_22_CM 10 0. 16383.75 FORMAT "%8.2" AXIS_PTS_REF Ctb_ajs_modu_n /end AXIS_DESCR
 /begin AXIS_DESCR COM_AXIS Vxx_ajs_dt_tq_rat _CNV_A_R_LINEAR_____313_CM 12 -10. 200. FORMAT "%6.2" AXIS_PTS_REF Ctb_ajs_dt_tq_rat /end AXIS_DESCR
/end CHARACTERISTIC
/begin CHARACTERISTIC Cmp_ajs_decl_slk_t1_ini_max_fac "AJMOD cartography for modulation factors of the initial time constant offset added during slack effect activation for vehicle deceleration" MAP 0xa002fcc4 _REC_A1MAP_20_u2_u1_u2 100. _CNV_A_R_LINEAR_____123_CM 0. 100.
 /begin AXIS_DESCR COM_AXIS Vxx_ajs_spv_driv_tq_fac _CNV_A_R_LINEAR_____123_CM 7 0. 1. FORMAT "%4.2" AXIS_PTS_REF Ctb_ajs_tq_fac /end AXIS_DESCR
 /begin AXIS_DESCR COM_AXIS Vxx_ajs_dt_tq_rat _CNV_A_R_LINEAR_____313_CM 12 -10. 200. FORMAT "%6.2" AXIS_PTS_REF Ctb_ajs_dt_tq_rat /end AXIS_DESCR
/end CHARACTERISTIC
/begin CHARACTERISTIC Cmp_ajs_modu_t1_acel_driv_fac "AJMOD cartography for modulation factors of the filter time constant based on driver torque factor for vehicle acceleration" MAP 0xa002fd6c _REC_A1MAP_20_u2_u1_u2 100. _CNV_A_R_LINEAR_____123_CM 0. 100.
 /begin AXIS_DESCR COM_AXIS Vxx_ajs_spv_driv_tq_fac _CNV_A_R_LINEAR_____123_CM 7 0. 1. FORMAT "%4.2" AXIS_PTS_REF Ctb_ajs_tq_fac /end AXIS_DESCR
 /begin AXIS_DESCR COM_AXIS Vxx_ajs_dt_tq_rat _CNV_A_R_LINEAR_____313_CM 12 -10. 200. FORMAT "%6.2" AXIS_PTS_REF Ctb_ajs_dt_tq_rat /end AXIS_DESCR
/end CHARACTERISTIC
/begin CHARACTERISTIC Cmp_ajs_modu_t1_acel_dt_clos "AJMOD time constant cartography for vehicle acceleration when driveline is closed" MAP 0xa002fe14 _REC_A1MAP_20_u2_u2_u2 65.535 _CNV_A_R_LINEAR_____116_CM 0. 65.535
 /begin AXIS_DESCR COM_AXIS Vxx_ajs_modu_n_mv _CNV_A_R_ENSD_LINEA_22_CM 10 0. 16383.75 FORMAT "%8.2" AXIS_PTS_REF Ctb_ajs_modu_n /end AXIS_DESCR
 /begin AXIS_DESCR COM_AXIS Vxx_ajs_dt_tq_rat _CNV_A_R_LINEAR_____313_CM 12 -10. 200. FORMAT "%6.2" AXIS_PTS_REF Ctb_ajs_dt_tq_rat /end AXIS_DESCR
/end CHARACTERISTIC
/begin CHARACTERISTIC Cmp_ajs_modu_t1_acel_tql_fac "AJMOD cartography for modulation factors of filter time constant based on the torque losses due to accessories for vehicle acceleration" MAP 0xa002ff04 _REC_A1MAP_20_u2_u2_u2 100. _CNV_A_R_LINEAR_____123_CM 0. 100.
 /begin AXIS_DESCR COM_AXIS Vxx_ajs_aux_tql _CNV_A_R_LINEAR_____181_CM 8 0. 2047.96875 FORMAT "%10.5" AXIS_PTS_REF Ctb_ajs_aux_tql /end AXIS_DESCR
 /begin AXIS_DESCR COM_AXIS Vxx_ajs_dt_tq_rat _CNV_A_R_LINEAR_____313_CM 12 -10. 200. FORMAT "%6.2" AXIS_PTS_REF Ctb_ajs_dt_tq_rat /end AXIS_DESCR
/end CHARACTERISTIC
/begin CHARACTERISTIC Cmp_ajs_modu_t1_aftr_decl_n "AJMOD time constant cartography, based on engine speed, after slack effect activation, for vehicle deceleration." MAP 0xa002ffc4 _REC_A1MAP_20_u2_u2_u2 65.535 _CNV_A_R_LINEAR_____116_CM 0. 65.535
 /begin AXIS_DESCR COM_AXIS Vxx_ajs_modu_n_mv _CNV_A_R_ENSD_LINEA_22_CM 10 0. 16383.75 FORMAT "%8.2" AXIS_PTS_REF Ctb_ajs_modu_n /end AXIS_DESCR
 /begin AXIS_DESCR COM_AXIS Vxx_ajs_dt_tq_rat _CNV_A_R_LINEAR_____313_CM 12 -10. 200. FORMAT "%6.2" AXIS_PTS_REF Ctb_ajs_dt_tq_rat /end AXIS_DESCR
/end CHARACTERISTIC
/begin CHARACTERISTIC Cmp_ajs_modu_t1_aftr_decl_tq "AJMOD cartography for modulation factors of filter time constant, based on driver torque factor, after slack effect activation, for vehicle deceleration." MAP 0xa00300b4 _REC_A1MAP_20_u2_u1_u2 100. _CNV_A_R_LINEAR_____123_CM 0. 100. FORMAT "%6.2"
 /begin AXIS_DESCR COM_AXIS Vxx_ajs_spv_driv_tq_fac _CNV_A_R_LINEAR_____123_CM 7 0. 1. FORMAT "%4.2" AXIS_PTS_REF Ctb_ajs_tq_fac /end AXIS_DESCR
 /begin AXIS_DESCR COM_AXIS Vxx_ajs_dt_tq_rat _CNV_A_R_LINEAR_____313_CM 12 -10. 200. FORMAT "%6.2" AXIS_PTS_REF Ctb_ajs_dt_tq_rat /end AXIS_DESCR
/end CHARACTERISTIC
/begin CHARACTERISTIC Cmp_ajs_modu_t1_aftr_decl_tql "AJMOD cartography for modulation factors of filter time constant based on auxiliary torque losses, after slack effect activation, for vehicle deceleration." MAP 0xa003015c _REC_A1MAP_20_u2_u2_u2 100. _CNV_A_R_LINEAR_____123_CM 0. 100. FORMAT "%6.2"
 /begin AXIS_DESCR COM_AXIS Vxx_ajs_aux_tql _CNV_A_R_LINEAR_____181_CM 8 0. 2047.96875 FORMAT "%10.5" AXIS_PTS_REF Ctb_ajs_aux_tql /end AXIS_DESCR
 /begin AXIS_DESCR COM_AXIS Vxx_ajs_dt_tq_rat _CNV_A_R_LINEAR_____313_CM 12 -10. 200. FORMAT "%6.2" AXIS_PTS_REF Ctb_ajs_dt_tq_rat /end AXIS_DESCR
/end CHARACTERISTIC
/begin CHARACTERISTIC Cmp_ajs_modu_t1_bfr_acel_n "AJMOD time constant cartography, based on engine speed, before slack effect activation, for vehicle acceleration." MAP 0xa003021c _REC_A1MAP_20_u2_u2_u2 65.535 _CNV_A_R_LINEAR_____116_CM 0. 65.535
 /begin AXIS_DESCR COM_AXIS Vxx_ajs_modu_n_mv _CNV_A_R_ENSD_LINEA_22_CM 10 0. 16383.75 FORMAT "%8.2" AXIS_PTS_REF Ctb_ajs_modu_n /end AXIS_DESCR
 /begin AXIS_DESCR COM_AXIS Vxx_ajs_dt_tq_rat _CNV_A_R_LINEAR_____313_CM 12 -10. 200. FORMAT "%6.2" AXIS_PTS_REF Ctb_ajs_dt_tq_rat /end AXIS_DESCR
/end CHARACTERISTIC
/begin CHARACTERISTIC Cmp_ajs_modu_t1_bfr_acel_tq "AJMOD cartography for modulation factor of filter time constant, based on driver torque factor, before slack effect activation, for vehicle acceleration." MAP 0xa003030c _REC_A1MAP_20_u2_u1_u2 100. _CNV_A_R_LINEAR_____123_CM 0. 100. FORMAT "%6.2"
 /begin AXIS_DESCR COM_AXIS Vxx_ajs_spv_driv_tq_fac _CNV_A_R_LINEAR_____123_CM 7 0. 1. FORMAT "%4.2" AXIS_PTS_REF Ctb_ajs_tq_fac /end AXIS_DESCR
 /begin AXIS_DESCR COM_AXIS Vxx_ajs_dt_tq_rat _CNV_A_R_LINEAR_____313_CM 12 -10. 200. FORMAT "%6.2" AXIS_PTS_REF Ctb_ajs_dt_tq_rat /end AXIS_DESCR
/end CHARACTERISTIC
/begin CHARACTERISTIC Cmp_ajs_modu_t1_bfr_acel_tql "AJMOD cartography for modulation factors of filter time constant based on auxiliary torque losses, before slack effect activation, for vehicle acceleration." MAP 0xa00303b4 _REC_A1MAP_20_u2_u2_u2 100. _CNV_A_R_LINEAR_____123_CM 0. 100. FORMAT "%6.2"
 /begin AXIS_DESCR COM_AXIS Vxx_ajs_aux_tql _CNV_A_R_LINEAR_____181_CM 8 0. 2047.96875 FORMAT "%10.5" AXIS_PTS_REF Ctb_ajs_aux_tql /end AXIS_DESCR
 /begin AXIS_DESCR COM_AXIS Vxx_ajs_dt_tq_rat _CNV_A_R_LINEAR_____313_CM 12 -10. 200. FORMAT "%6.2" AXIS_PTS_REF Ctb_ajs_dt_tq_rat /end AXIS_DESCR
/end CHARACTERISTIC
/begin CHARACTERISTIC Cmp_ajs_modu_t1_decl_driv_fac "AJMOD cartography for modulation factors of the filter time constant based on driver torque factor for vehicle deceleration" MAP 0xa0030474 _REC_A1MAP_20_u2_u1_u2 100. _CNV_A_R_LINEAR_____123_CM 0. 100.
 /begin AXIS_DESCR COM_AXIS Vxx_ajs_spv_driv_tq_fac _CNV_A_R_LINEAR_____123_CM 7 0. 1. FORMAT "%4.2" AXIS_PTS_REF Ctb_ajs_tq_fac /end AXIS_DESCR
 /begin AXIS_DESCR COM_AXIS Vxx_ajs_dt_tq_rat _CNV_A_R_LINEAR_____313_CM 12 -10. 200. FORMAT "%6.2" AXIS_PTS_REF Ctb_ajs_dt_tq_rat /end AXIS_DESCR
/end CHARACTERISTIC
/begin CHARACTERISTIC Cmp_ajs_modu_t1_decl_dt_clos "AJMOD time constant cartography for vehicle deceleration when driveline is closed" MAP 0xa003051c _REC_A1MAP_20_u2_u2_u2 65.535 _CNV_A_R_LINEAR_____116_CM 0. 65.535
 /begin AXIS_DESCR COM_AXIS Vxx_ajs_modu_n_mv _CNV_A_R_ENSD_LINEA_22_CM 10 0. 16383.75 FORMAT "%8.2" AXIS_PTS_REF Ctb_ajs_modu_n /end AXIS_DESCR
 /begin AXIS_DESCR COM_AXIS Vxx_ajs_dt_tq_rat _CNV_A_R_LINEAR_____313_CM 12 -10. 200. FORMAT "%6.2" AXIS_PTS_REF Ctb_ajs_dt_tq_rat /end AXIS_DESCR
/end CHARACTERISTIC
/begin CHARACTERISTIC Cmp_ajs_modu_t1_decl_tql_fac "AJMOD cartography for modulation factors of filter time constant based on the torque losses due to accessories for vehicle deceleration" MAP 0xa003060c _REC_A1MAP_20_u2_u2_u2 100. _CNV_A_R_LINEAR_____123_CM 0. 100.
 /begin AXIS_DESCR COM_AXIS Vxx_ajs_aux_tql _CNV_A_R_LINEAR_____181_CM 8 0. 2047.96875 FORMAT "%10.5" AXIS_PTS_REF Ctb_ajs_aux_tql /end AXIS_DESCR
 /begin AXIS_DESCR COM_AXIS Vxx_ajs_dt_tq_rat _CNV_A_R_LINEAR_____313_CM 12 -10. 200. FORMAT "%6.2" AXIS_PTS_REF Ctb_ajs_dt_tq_rat /end AXIS_DESCR
/end CHARACTERISTIC
/begin CHARACTERISTIC Cmp_ajs_modu_td_acel_driv_fac "AJMOD cartography for modulation factors of the filter gain based on driver torque factor for vehicle acceleration" MAP 0xa00306cc _REC_A1MAP_20_u2_u1_u2 100. _CNV_A_R_LINEAR_____123_CM 0. 100.
 /begin AXIS_DESCR COM_AXIS Vxx_ajs_spv_driv_tq_fac _CNV_A_R_LINEAR_____123_CM 7 0. 1. FORMAT "%4.2" AXIS_PTS_REF Ctb_ajs_tq_fac /end AXIS_DESCR
 /begin AXIS_DESCR COM_AXIS Vxx_ajs_dt_tq_rat _CNV_A_R_LINEAR_____313_CM 12 -10. 200. FORMAT "%6.2" AXIS_PTS_REF Ctb_ajs_dt_tq_rat /end AXIS_DESCR
/end CHARACTERISTIC
/begin CHARACTERISTIC Cmp_ajs_modu_td_acel_dt_clos "AJMOD gain cartography for vehicle acceleration when driveline is closed" MAP 0xa0030774 _REC_A1MAP_20_u2_u2_u2 1. _CNV_A_R_LINEAR_____161_CM 0. 1. FORMAT "%5.3"
 /begin AXIS_DESCR COM_AXIS Vxx_ajs_modu_n_mv _CNV_A_R_ENSD_LINEA_22_CM 10 0. 16383.75 FORMAT "%8.2" AXIS_PTS_REF Ctb_ajs_modu_n /end AXIS_DESCR
 /begin AXIS_DESCR COM_AXIS Vxx_ajs_dt_tq_rat _CNV_A_R_LINEAR_____313_CM 12 -10. 200. FORMAT "%6.2" AXIS_PTS_REF Ctb_ajs_dt_tq_rat /end AXIS_DESCR
/end CHARACTERISTIC
/begin CHARACTERISTIC Cmp_ajs_modu_td_acel_tql_fac "AJMOD cartography for modulation factors of the filter gain based on the torque losses due to accessories for vehicle acceleration" MAP 0xa0030864 _REC_A1MAP_20_u2_u2_u2 100. _CNV_A_R_LINEAR_____123_CM 0. 100.
 /begin AXIS_DESCR COM_AXIS Vxx_ajs_aux_tql _CNV_A_R_LINEAR_____181_CM 8 0. 2047.96875 FORMAT "%10.5" AXIS_PTS_REF Ctb_ajs_aux_tql /end AXIS_DESCR
 /begin AXIS_DESCR COM_AXIS Vxx_ajs_dt_tq_rat _CNV_A_R_LINEAR_____313_CM 12 -10. 200. FORMAT "%6.2" AXIS_PTS_REF Ctb_ajs_dt_tq_rat /end AXIS_DESCR
/end CHARACTERISTIC
/begin CHARACTERISTIC Cmp_ajs_modu_td_decl_driv_fac "AJMOD cartography for modulation factors of the filter gain based on driver torque factor for vehicle deceleration" MAP 0xa0030924 _REC_A1MAP_20_u2_u1_u2 100. _CNV_A_R_LINEAR_____123_CM 0. 100.
 /begin AXIS_DESCR COM_AXIS Vxx_ajs_spv_driv_tq_fac _CNV_A_R_LINEAR_____123_CM 7 0. 1. FORMAT "%4.2" AXIS_PTS_REF Ctb_ajs_tq_fac /end AXIS_DESCR
 /begin AXIS_DESCR COM_AXIS Vxx_ajs_dt_tq_rat _CNV_A_R_LINEAR_____313_CM 12 -10. 200. FORMAT "%6.2" AXIS_PTS_REF Ctb_ajs_dt_tq_rat /end AXIS_DESCR
/end CHARACTERISTIC
/begin CHARACTERISTIC Cmp_ajs_modu_td_decl_dt_clos "AJMOD gain cartography for vehicle deceleration when driveline is closed" MAP 0xa00309cc _REC_A1MAP_20_u2_u2_u2 1. _CNV_A_R_LINEAR_____161_CM 0. 1. FORMAT "%5.3"
 /begin AXIS_DESCR COM_AXIS Vxx_ajs_modu_n_mv _CNV_A_R_ENSD_LINEA_22_CM 10 0. 16383.75 FORMAT "%8.2" AXIS_PTS_REF Ctb_ajs_modu_n /end AXIS_DESCR
 /begin AXIS_DESCR COM_AXIS Vxx_ajs_dt_tq_rat _CNV_A_R_LINEAR_____313_CM 12 -10. 200. FORMAT "%6.2" AXIS_PTS_REF Ctb_ajs_dt_tq_rat /end AXIS_DESCR
/end CHARACTERISTIC
/begin CHARACTERISTIC Cmp_ajs_modu_td_decl_tql_fac "AJMOD cartography for modulation factors of the filter gain based on the torque losses due to accessories for vehicle deceleration" MAP 0xa0030abc _REC_A1MAP_20_u2_u2_u2 100. _CNV_A_R_LINEAR_____123_CM 0. 100.
 /begin AXIS_DESCR COM_AXIS Vxx_ajs_aux_tql _CNV_A_R_LINEAR_____181_CM 8 0. 2047.96875 FORMAT "%10.5" AXIS_PTS_REF Ctb_ajs_aux_tql /end AXIS_DESCR
 /begin AXIS_DESCR COM_AXIS Vxx_ajs_dt_tq_rat _CNV_A_R_LINEAR_____313_CM 12 -10. 200. FORMAT "%6.2" AXIS_PTS_REF Ctb_ajs_dt_tq_rat /end AXIS_DESCR
/end CHARACTERISTIC
/begin CHARACTERISTIC Ctp_ajs_drag_t1_dly "Drag error correction delay for time constant modulation." CURVE 0xa0030b7c _REC_A1CUR_20_u2_u1 655.35 _CNV_A_R_LINEAR_____32_CM 0. 655.35 FORMAT "%6.2"
 /begin AXIS_DESCR COM_AXIS Vxx_ajs_spv_driv_tq_fac _CNV_A_R_LINEAR_____123_CM 7 0. 1. FORMAT "%4.2" AXIS_PTS_REF Ctb_ajs_drag_tq_fac /end AXIS_DESCR
/end CHARACTERISTIC
/begin CHARACTERISTIC Ctp_ajs_modu_t1_acel_dt_modu "AJMOD table of time constant values when driveline is in modulation mode for vehicle acceleration" CURVE 0xa0030b8c _REC_A1CUR_20_u2_u1 65.535 _CNV_A_R_LINEAR_____116_CM 0. 65.535
 /begin AXIS_DESCR COM_AXIS Vxx_ajs_spv_driv_tq_fac _CNV_A_R_LINEAR_____123_CM 7 0. 1. FORMAT "%4.2" AXIS_PTS_REF Ctb_ajs_tq_fac /end AXIS_DESCR
/end CHARACTERISTIC
/begin CHARACTERISTIC Ctp_ajs_modu_t1_acel_dt_open "AJMOD table of time constant values when driveline is open for vehicle acceleration" CURVE 0xa0030b9c _REC_A1CUR_20_u2_u1 65.535 _CNV_A_R_LINEAR_____116_CM 0. 65.535
 /begin AXIS_DESCR COM_AXIS Vxx_ajs_spv_driv_tq_fac _CNV_A_R_LINEAR_____123_CM 7 0. 1. FORMAT "%4.2" AXIS_PTS_REF Ctb_ajs_tq_fac /end AXIS_DESCR
/end CHARACTERISTIC
/begin CHARACTERISTIC Ctp_ajs_modu_t1_tkof_dt_open "AJMOD table for the filter time constant based on driver sportivity factor during takeoff state for vehicle acceleration" CURVE 0xa0030bac _REC_A1CUR_20_u2_u1 65.535 _CNV_A_R_LINEAR_____116_CM 0. 65.535
 /begin AXIS_DESCR COM_AXIS Vxx_tkof_ass_fac _CNV_A_R_LINEAR_____275_CM 5 0. 1. FORMAT "%9.7" AXIS_PTS_REF Ctb_ajs_modu_tkof_spt_fac /end AXIS_DESCR
/end CHARACTERISTIC
/begin CHARACTERISTIC Ctp_ajs_modu_td_acel_dt_modu "AJMOD table of gain values when driveline is in modulation mode for vehicle acceleration" CURVE 0xa0030bb8 _REC_A1CUR_20_u2_u1 1. _CNV_A_R_LINEAR_____161_CM 0. 1. FORMAT "%5.3"
 /begin AXIS_DESCR COM_AXIS Vxx_ajs_spv_driv_tq_fac _CNV_A_R_LINEAR_____123_CM 7 0. 1. FORMAT "%4.2" AXIS_PTS_REF Ctb_ajs_tq_fac /end AXIS_DESCR
/end CHARACTERISTIC
/begin CHARACTERISTIC Ctp_ajs_modu_td_acel_dt_open "AJMOD table of gain values when driveline is in modulation mode for vehicle acceleration" CURVE 0xa0030bc8 _REC_A1CUR_20_u2_u1 1. _CNV_A_R_LINEAR_____161_CM 0. 1. FORMAT "%5.3"
 /begin AXIS_DESCR COM_AXIS Vxx_ajs_spv_driv_tq_fac _CNV_A_R_LINEAR_____123_CM 7 0. 1. FORMAT "%4.2" AXIS_PTS_REF Ctb_ajs_tq_fac /end AXIS_DESCR
/end CHARACTERISTIC
/begin CHARACTERISTIC Ctp_ajs_modu_td_tkof_dt_open "AJMOD table for the filter gain based on driver sportivity factor during takeoff state for vehicle acceleration" CURVE 0xa0030bd8 _REC_A1CUR_20_u2_u1 1. _CNV_A_R_LINEAR_____161_CM 0. 1. FORMAT "%5.3"
 /begin AXIS_DESCR COM_AXIS Vxx_tkof_ass_fac _CNV_A_R_LINEAR_____275_CM 5 0. 1. FORMAT "%9.7" AXIS_PTS_REF Ctb_ajs_modu_tkof_spt_fac /end AXIS_DESCR
/end CHARACTERISTIC
/begin MEASUREMENT Vbx_ajs_modu_loss_fil_cut "Boolean variable to detect engine torque losses filtering" UBYTE _CNV_S_2_RANGE______3_CM 1 0. 0. 1. ECU_ADDRESS 0xd0007047 BIT_MASK 0x1 /end MEASUREMENT
/begin MEASUREMENT Vbx_ajs_modu_stt_cut "Boolean variable deactivating (1) AJMOD function" UBYTE _CNV_S_2_RANGE______3_CM 1 0. 0. 1. ECU_ADDRESS 0xd0007048 BIT_MASK 0x1 /end MEASUREMENT
/begin MEASUREMENT Vbx_ajs_modu_tkof_ena "Boolean to activate parameters modulation during takeoff phase" UBYTE _CNV_S_2_RANGE______3_CM 1 0. 0. 1. ECU_ADDRESS 0xd0007049 BIT_MASK 0x1 /end MEASUREMENT
/begin MEASUREMENT Vsx_ajs_modu_stt_para "State variable to select AJMOD parameters" UBYTE _CNV_A_R_ECME_LINEA_0_CM 1 0. 1. 5. ECU_ADDRESS 0xd000704a FORMAT "%1.0" /end MEASUREMENT
/begin MEASUREMENT Vxx_ajs_modu_init_fil "Torque sepoint value for AJMOD filter re-initialization on slack effect activation." UWORD _CNV_A_R_LINEAR_____216_CM 1 0. -400. 1647.96875 ECU_ADDRESS 0xd000475e FORMAT "%11.5" /end MEASUREMENT
/begin MEASUREMENT Vxx_ajs_modu_n_mv "Filtered engine speed after status validation" UWORD _CNV_A_R_ENSD_LINEA_22_CM 1 0. 0. 16383.75 ECU_ADDRESS 0xd0004760 FORMAT "%8.2" /end MEASUREMENT
/begin MEASUREMENT Vxx_ajs_modu_t1 "AJMOD time constant value before slack effect" UWORD _CNV_A_R_LINEAR_____116_CM 1 0. 0. 65.535 ECU_ADDRESS 0xd0004762 /end MEASUREMENT
/begin MEASUREMENT Vxx_ajs_modu_t1_acel "AJMOD time constant value calculated for vehicle acceleration" UWORD _CNV_A_R_LINEAR_____116_CM 1 0. 0. 65.535 ECU_ADDRESS 0xd0004764 /end MEASUREMENT
/begin MEASUREMENT Vxx_ajs_modu_t1_acel_dt_clos "AJMOD time constant value calculated when driveline is closed for vehicle acceleration" UWORD _CNV_A_R_LINEAR_____116_CM 1 0. 0. 65.535 ECU_ADDRESS 0xd0004766 /end MEASUREMENT
/begin MEASUREMENT Vxx_ajs_modu_t1_acel_dt_modu "AJMOD time constant value when driveline is in modulation mode for vehicle acceleration" UWORD _CNV_A_R_LINEAR_____116_CM 1 0. 0. 65.535 ECU_ADDRESS 0xd0004768 /end MEASUREMENT
/begin MEASUREMENT Vxx_ajs_modu_t1_acel_dt_open "AJMOD time constant value for the declutched state for vehicle acceleration" UWORD _CNV_A_R_LINEAR_____116_CM 1 0. 0. 65.535 ECU_ADDRESS 0xd000476a /end MEASUREMENT
/begin MEASUREMENT Vxx_ajs_modu_t1_acel_fac "AJMOD modulation factor for the filter time constant when driveline is closed for vehicle acceleration" UWORD _CNV_A_R_LINEAR_____123_CM 1 0. 0. 100. ECU_ADDRESS 0xd000476c /end MEASUREMENT
/begin MEASUREMENT Vxx_ajs_modu_t1_bfr_drag "AJMOD time constant value before drag error correction" UWORD _CNV_A_R_LINEAR_____116_CM 1 0. 0. 65.535 ECU_ADDRESS 0xd000476e /end MEASUREMENT
/begin MEASUREMENT Vxx_ajs_modu_t1_decl "AJMOD time constant value calculated for vehicle deceleration" UWORD _CNV_A_R_LINEAR_____116_CM 1 0. 0. 65.535 ECU_ADDRESS 0xd0004770 /end MEASUREMENT
/begin MEASUREMENT Vxx_ajs_modu_t1_decl_dt_clos "AJMOD time constant value calculated when driveline is closed for vehicle deceleration" UWORD _CNV_A_R_LINEAR_____116_CM 1 0. 0. 65.535 ECU_ADDRESS 0xd0004772 /end MEASUREMENT
/begin MEASUREMENT Vxx_ajs_modu_t1_decl_fac "AJMOD modulation factor for the filter time constant when driveline is closed for vehicle deceleration" UWORD _CNV_A_R_LINEAR_____123_CM 1 0. 0. 100. ECU_ADDRESS 0xd0004774 /end MEASUREMENT
/begin MEASUREMENT Vxx_ajs_modu_t1_sp "AJMOD time constant for filtering action on torque setpoint" UWORD _CNV_A_R_LINEAR_____116_CM 1 0. 0. 65.535 ECU_ADDRESS 0xd0004776 /end MEASUREMENT
/begin MEASUREMENT Vxx_ajs_modu_t1_tgt "AJMOD time constant for filtering action on torque target" UWORD _CNV_A_R_LINEAR_____116_CM 1 0. 0. 65.535 ECU_ADDRESS 0xd0004778 /end MEASUREMENT
/begin MEASUREMENT Vxx_ajs_modu_td "AJMOD gain value before slack effect" UWORD _CNV_A_R_LINEAR_____161_CM 1 0. 0. 1. ECU_ADDRESS 0xd000477a FORMAT "%5.3" /end MEASUREMENT
/begin MEASUREMENT Vxx_ajs_modu_td_acel "AJMOD gain value calculated for vehicle acceleration" UWORD _CNV_A_R_LINEAR_____161_CM 1 0. 0. 1. ECU_ADDRESS 0xd000477c FORMAT "%5.3" /end MEASUREMENT
/begin MEASUREMENT Vxx_ajs_modu_td_acel_dt_clos "AJMOD gain value calculated when driveline is closed for vehicle acceleration" UWORD _CNV_A_R_LINEAR_____161_CM 1 0. 0. 1. ECU_ADDRESS 0xd000477e FORMAT "%5.3" /end MEASUREMENT
/begin MEASUREMENT Vxx_ajs_modu_td_acel_dt_modu "AJMOD gain value when driveline is in modulation mode for vehicle acceleration" UWORD _CNV_A_R_LINEAR_____161_CM 1 0. 0. 1. ECU_ADDRESS 0xd0004780 FORMAT "%5.3" /end MEASUREMENT
/begin MEASUREMENT Vxx_ajs_modu_td_acel_dt_open "AJMOD gain value for the declutched state for vehicle acceleration" UWORD _CNV_A_R_LINEAR_____161_CM 1 0. 0. 1. ECU_ADDRESS 0xd0004782 FORMAT "%5.3" /end MEASUREMENT
/begin MEASUREMENT Vxx_ajs_modu_td_acel_fac "AJMOD modulation factor for the filter gain when driveline is closed for vehicle acceleration" UWORD _CNV_A_R_LINEAR_____123_CM 1 0. 0. 100. ECU_ADDRESS 0xd0004784 /end MEASUREMENT
/begin MEASUREMENT Vxx_ajs_modu_td_decl "AJMOD gain value calculated for vehicle deceleration" UWORD _CNV_A_R_LINEAR_____161_CM 1 0. 0. 1. ECU_ADDRESS 0xd0004786 FORMAT "%5.3" /end MEASUREMENT
/begin MEASUREMENT Vxx_ajs_modu_td_decl_dt_clos "AJMOD gain value calculated when driveline is closed for vehicle deceleration" UWORD _CNV_A_R_LINEAR_____161_CM 1 0. 0. 1. ECU_ADDRESS 0xd0004788 FORMAT "%9.7" /end MEASUREMENT
/begin MEASUREMENT Vxx_ajs_modu_td_decl_fac "AJMOD modulation factor for the filter gain when driveline is closed for vehicle deceleration" UWORD _CNV_A_R_LINEAR_____123_CM 1 0. 0. 100. ECU_ADDRESS 0xd000478a /end MEASUREMENT
/begin MEASUREMENT Vxx_ajs_modu_td_sp "AJMOD gain for filtering action on torque setpoint" UWORD _CNV_A_R_LINEAR_____161_CM 1 0. 0. 1. ECU_ADDRESS 0xd000478c FORMAT "%5.3" /end MEASUREMENT
/begin MEASUREMENT Vxx_ajs_modu_td_tgt "AJMOD gain for filtering action on torque target" UWORD _CNV_A_R_LINEAR_____161_CM 1 0. 0. 1. ECU_ADDRESS 0xd000478e FORMAT "%5.3" /end MEASUREMENT
/begin MEASUREMENT Vxx_ajs_modu_tqe_sp "Final torque setpoint after AJMOD action" UWORD _CNV_A_R_LINEAR_____216_CM 1 0. -400. 1647.96875 ECU_ADDRESS 0xd0004790 FORMAT "%10.5" /end MEASUREMENT
/begin MEASUREMENT Vxx_ajs_modu_tqe_sp_fil "Torque setpoint after AJMOD filtering action" UWORD _CNV_A_R_LINEAR_____216_CM 1 0. -400. 1647.96875 ECU_ADDRESS 0xd0004792 FORMAT "%11.5" /end MEASUREMENT
/begin MEASUREMENT Vxx_ajs_modu_tqe_tgt "Final Torque Target after AJS Modulation action" UWORD _CNV_A_R_LINEAR_____216_CM 1 0. -400. 1647.96875 ECU_ADDRESS 0xd0004794 FORMAT "%10.5" /end MEASUREMENT
/begin MEASUREMENT Vxx_ajs_modu_tqe_tgt_fil "Torque target after AJMOD filtering action" UWORD _CNV_A_R_LINEAR_____216_CM 1 0. -400. 1647.96875 ECU_ADDRESS 0xd0004796 FORMAT "%11.5" /end MEASUREMENT
/begin MEASUREMENT Vxx_ajs_slk_dly_t1 "Delay of action of the slack effect calculated" UWORD _CNV_A_R_LINEAR_____116_CM 1 0. 0. 65.535 ECU_ADDRESS 0xd0004798 /end MEASUREMENT
/begin MEASUREMENT Vxx_ajs_slk_t1_ini_max "Calculated value of filter time constant initial offset added by the slack at it's activation" UWORD _CNV_A_R_LINEAR_____116_CM 1 0. 0. 65.535 ECU_ADDRESS 0xd000479a /end MEASUREMENT
/begin CHARACTERISTIC Cbx_ajs_dt_slk_cfm "a_pc_paj_ctl_ajspvxx_xxx_xx_x_a/Boolean calibration to cut (0) slack effect strategy in AJMOD" VALUE 0xa0021c3c _REC_S1VAL_20_u1 1. _CNV_A_R_ECME_LINEA_0_CM 0. 1. FORMAT "%1.0" BIT_MASK 0x1 /end CHARACTERISTIC
/begin CHARACTERISTIC Cbx_ajs_modu_stt_cfm "Boolean calibration to deactivate AJMOD function (0) manually" VALUE 0xa0021c3d _REC_S1VAL_20_u1 1. _CNV_A_R_ECME_LINEA_0_CM 0. 1. FORMAT "%1.0" BIT_MASK 0x1 /end CHARACTERISTIC
/begin CHARACTERISTIC Cbx_ajs_modu_td_dec_cfm "Boolean calibration to block (=1) the decrease of td_acel in acceleration state, and so for td_decl" VALUE 0xa0021c3e _REC_S1VAL_20_u1 1. _CNV_A_R_ECME_LINEA_0_CM 0. 1. FORMAT "%1.0" BIT_MASK 0x1 /end CHARACTERISTIC
/begin CHARACTERISTIC Cbx_ajs_new_slk_cfm "Boolean calibration to activate (=1) new slack effect strategy." VALUE 0xa0021c3f _REC_S1VAL_20_u1 1. _CNV_A_R_ECME_LINEA_0_CM 0. 1. FORMAT "%1.0" BIT_MASK 0x1 /end CHARACTERISTIC
/begin CHARACTERISTIC Cbx_ajs_slk_td_cfm "Boolean calibration to autorize (1) manually the slack effect for td parameter" VALUE 0xa0021c40 _REC_S1VAL_20_u1 1. _CNV_A_R_ECME_LINEA_0_CM 0. 1. FORMAT "%1.0" BIT_MASK 0x1 /end CHARACTERISTIC
/begin CHARACTERISTIC Cxx_ajs_modu_loss_fil_cut_thd "Torque threshold for AJMOD engine torque losses filtering management" VALUE 0xa0021c1a _REC_S1VAL_20_u2 2047.96875 _CNV_A_R_LINEAR_____181_CM 0. 2047.96875 FORMAT "%10.5" /end CHARACTERISTIC
/begin CHARACTERISTIC Cxx_ajs_modu_slk_fil_t1_acel "Time constant for filtering the slack effect correction for vehicle acceleration" VALUE 0xa0021c1c _REC_S1VAL_20_u2 65.535 _CNV_A_R_LINEAR_____116_CM 0. 65.535 /end CHARACTERISTIC
/begin CHARACTERISTIC Cxx_ajs_modu_slk_fil_t1_decl "Time constant for filtering the slack effect correction for vehicle deceleration" VALUE 0xa0021c1e _REC_S1VAL_20_u2 65.535 _CNV_A_R_LINEAR_____116_CM 0. 65.535 /end CHARACTERISTIC
/begin CHARACTERISTIC Cxx_ajs_modu_t1_decl_dt_modu "AJMOD time constant value when driveline is in modulation mode for vehicle deceleration" VALUE 0xa0021c20 _REC_S1VAL_20_u2 65.535 _CNV_A_R_LINEAR_____116_CM 0. 65.535 /end CHARACTERISTIC
/begin CHARACTERISTIC Cxx_ajs_modu_t1_decl_dt_open "AJMOD time constant value when driveline is open for vehicle deceleration" VALUE 0xa0021c22 _REC_S1VAL_20_u2 65.535 _CNV_A_R_LINEAR_____116_CM 0. 65.535 /end CHARACTERISTIC
/begin CHARACTERISTIC Cxx_ajs_modu_t1_dt_clos_max "Maximum AJMOD time constant value when driveline is close" VALUE 0xa0021c24 _REC_S1VAL_20_u2 65.535 _CNV_A_R_LINEAR_____116_CM 0. 65.535 /end CHARACTERISTIC
/begin CHARACTERISTIC Cxx_ajs_modu_t1_dt_ini "AJMOD time constant value during initialisation" VALUE 0xa0021c26 _REC_S1VAL_20_u2 65.535 _CNV_A_R_LINEAR_____116_CM 0. 65.535 /end CHARACTERISTIC
/begin CHARACTERISTIC Cxx_ajs_modu_t1_fast_cor "AJMOD time constant value during a fast anti-jerk correction" VALUE 0xa0021c28 _REC_S1VAL_20_u2 655.35 _CNV_A_R_LINEAR_____32_CM 0. 655.35 FORMAT "%6.2" /end CHARACTERISTIC
/begin CHARACTERISTIC Cxx_ajs_modu_td_decl_dt_modu "AJMOD gain value when driveline is in modulation mode for vehicle deceleration" VALUE 0xa0021c2a _REC_S1VAL_20_u2 1. _CNV_A_R_LINEAR_____161_CM 0. 1. FORMAT "%5.3" /end CHARACTERISTIC
/begin CHARACTERISTIC Cxx_ajs_modu_td_decl_dt_open "AJMOD gain value when driveline is open for vehicle deceleration" VALUE 0xa0021c2c _REC_S1VAL_20_u2 1. _CNV_A_R_LINEAR_____161_CM 0. 1. FORMAT "%5.3" /end CHARACTERISTIC
/begin CHARACTERISTIC Cxx_ajs_modu_td_dt_ini "AJMOD gain value during initialisation" VALUE 0xa0021c2e _REC_S1VAL_20_u2 1. _CNV_A_R_LINEAR_____161_CM 0. 1. FORMAT "%5.3" /end CHARACTERISTIC
/begin CHARACTERISTIC Cxx_ajs_modu_td_fast_cor "AJMOD gain value during a fast anti-jerk correction" VALUE 0xa0021c30 _REC_S1VAL_20_u2 1. _CNV_A_R_LINEAR_____161_CM 0. 1. FORMAT "%5.3" /end CHARACTERISTIC
/begin CHARACTERISTIC Cxx_ajs_modu_tkof_vs_thd "Vehicule speed threshold to deactivate parameters modulation during takeoff phase" VALUE 0xa0021c32 _REC_S1VAL_20_u2 655.35 _CNV_A_R_LINEAR_____125_CM 0. 655.35 FORMAT "%6.2" /end CHARACTERISTIC
/begin CHARACTERISTIC Cxx_ajs_modu_vs_thd_off "Vehicule speed high threshold to deactivate AJMOD function" VALUE 0xa0021c34 _REC_S1VAL_20_u2 655.35 _CNV_A_R_LINEAR_____125_CM 0. 655.35 FORMAT "%6.2" /end CHARACTERISTIC
/begin CHARACTERISTIC Cxx_ajs_modu_vs_thd_on "Vehicule speed low threshold to deactivate AJMOD function" VALUE 0xa0021c36 _REC_S1VAL_20_u2 655.35 _CNV_A_R_LINEAR_____125_CM 0. 655.35 FORMAT "%6.2" /end CHARACTERISTIC
/begin CHARACTERISTIC Cxx_ajs_n_mv_dft "Engine speed replacement value for invalid engine speed measure" VALUE 0xa0021c38 _REC_S1VAL_20_u2 16383.75 _CNV_A_R_ENSD_LINEA_22_CM 0. 16383.75 FORMAT "%8.2" /end CHARACTERISTIC
/begin CHARACTERISTIC Cxx_ajs_slk_act_ctr "Number of permitted activations of slack effect" VALUE 0xa0021c41 _REC_S1VAL_20_u1 255. _CNV_A_R_ECME_LINEA_0_CM 0. 255. FORMAT "%3.0" /end CHARACTERISTIC
/begin CHARACTERISTIC Cxx_ajs_slk_td_ini_fac "Corrective factor of Td added by the slack effect" VALUE 0xa0021c3a _REC_S1VAL_20_u2 100. _CNV_A_R_LINEAR_____123_CM 0. 100. /end CHARACTERISTIC
/begin AXIS_PTS Ctb_sta_n "Engine speed breakpoints for starting set point tables" 0xa00354f0 Vxx_n _REC_A2AXS_20_u2 16383.75 _CNV_A_R_ENSD_LINEA_22_CM 8 0. 16383.75 FORMAT "%8.2" /end AXIS_PTS
/begin AXIS_PTS Ctb_n "20 programmable engine speed breakpoints map" 0xa002db74 Vxx_n _REC_A2AXS_20_u2 16383.75 _CNV_A_R_ENSD_LINEA_22_CM 20 0. 16383.75 FORMAT "%8.2" /end AXIS_PTS
/begin AXIS_PTS Ctb_n2 "9 programmable engine speed breakpoints table" 0xa002dba0 Vxx_n _REC_A2AXS_20_u2 16383.75 _CNV_A_R_ENSD_LINEA_22_CM 9 0. 16383.75 FORMAT "%8.2" /end AXIS_PTS
/begin AXIS_PTS Ctb_ajs_dt_tq_rat "a_sm_caj_ctl_ajcorxx_xxx_xx_x_a/Breakpoint calibration of driveline torque ratio" 0xa0033568 Vxx_ajs_dt_tq_rat _REC_A2AXS_20_u2 210. _CNV_A_R_LINEAR_____313_CM 12 -10. 200. FORMAT "%6.2" /end AXIS_PTS
/begin COMPU_METHOD _CNV_A_R_ECME_LINEA_0_CM "" RAT_FUNC "%6.3" "-" COEFFS 0 1. 0. 0 0 1 /end COMPU_METHOD
/begin COMPU_METHOD _CNV_A_R_LINEAR_____2_CM "" RAT_FUNC "%6.3" "rpm" COEFFS 0 3.125e-002 0. 0 0 1 /end COMPU_METHOD
/begin COMPU_METHOD _CNV_S_2_RANGE______3_CM "" TAB_VERB "%6.3" "-" COMPU_TAB_REF _CNV_S_2_RANGE______3 /end COMPU_METHOD
/begin COMPU_VTAB _CNV_S_2_RANGE______3 "" TAB_VERB 2 0 "0" 1 "1" /end COMPU_VTAB
/begin COMPU_METHOD _CNV_A_R_LINEAR_____19_CM "" RAT_FUNC "%6.3" "rpm" COEFFS 0 1. 0. 0 0 1 /end COMPU_METHOD
/begin COMPU_METHOD _CNV_A_R_LINEAR_____21_CM "" RAT_FUNC "%6.3" "rpm/s" COEFFS 0 1. 0. 0 0 1 /end COMPU_METHOD
/begin COMPU_METHOD _CNV_A_R_ENSD_LINEA_22_CM "" RAT_FUNC "%6.3" "rpm" COEFFS 0 4. 0. 0 0 1 /end COMPU_METHOD
/begin COMPU_METHOD _CNV_A_R_LINEAR_____23_CM "" RAT_FUNC "%6.3" "°CRK" COEFFS 0 2.666666666666667 0. 0 0 1 /end COMPU_METHOD
/begin COMPU_METHOD _CNV_A_R_LINEAR_____28_CM "" RAT_FUNC "%6.3" "°CRK" COEFFS 0 2.666666666666667 128. 0 0 1 /end COMPU_METHOD
/begin COMPU_METHOD _CNV_A_R_LINEAR_____29_CM "" RAT_FUNC "%6.3" "-" COEFFS 0 256. 0. 0 0 1 /end COMPU_METHOD
/begin COMPU_METHOD _CNV_A_R_LINEAR_____32_CM "" RAT_FUNC "%6.3" "s" COEFFS 0 100. 0. 0 0 1 /end COMPU_METHOD
/begin COMPU_METHOD _CNV_A_R_LINEAR_____41_CM "" RAT_FUNC "%6.3" "°C" COEFFS 0 1.333333333333333 64. 0 0 1 /end COMPU_METHOD
/begin COMPU_METHOD _CNV_A_R_LINEAR_____43_CM "" RAT_FUNC "%6.3" "ms" COEFFS 0 250. 0. 0 0 1 /end COMPU_METHOD
/begin COMPU_METHOD _CNV_A_R_IGRE_LINEA_47_CM "" RAT_FUNC "%6.3" "°CRK" COEFFS 0 2.666666666666667 63. 0 0 1 /end COMPU_METHOD
/begin COMPU_METHOD _CNV_A_R_LINEAR_____48_CM "" RAT_FUNC "%6.3" "-" COEFFS 0 32767.99999999992 0. 0 0 1 /end COMPU_METHOD
/begin COMPU_METHOD _CNV_A_R_LINEAR_____53_CM "" RAT_FUNC "%6.3" "-" COEFFS 0 16384. 0. 0 0 1 /end COMPU_METHOD
/begin COMPU_METHOD _CNV_A_R_LINEAR_____58_CM "" RAT_FUNC "%6.3" "s" COEFFS 0 10. 0. 0 0 1 /end COMPU_METHOD
/begin COMPU_METHOD _CNV_A_R_LINEAR_____68_CM "" RAT_FUNC "%6.3" "s" COEFFS 0 1. 0. 0 0 1 /end COMPU_METHOD
/begin COMPU_METHOD _CNV_A_R_LINEAR_____101_CM "" RAT_FUNC "%6.3" "TDC" COEFFS 0 1. 0. 0 0 1 /end COMPU_METHOD
/begin COMPU_METHOD _CNV_A_R_LINEAR_____110_CM "" RAT_FUNC "%6.3" "°C" COEFFS 0 10. 400. 0 0 1 /end COMPU_METHOD
/begin COMPU_METHOD _CNV_A_R_LINEAR_____115_CM "" RAT_FUNC "%6.3" "hPa" COEFFS 0 1. 0. 0 0 1 /end COMPU_METHOD
/begin COMPU_METHOD _CNV_A_R_LINEAR_____116_CM "" RAT_FUNC "%6.3" "s" COEFFS 0 1000. 0. 0 0 1 /end COMPU_METHOD
/begin COMPU_METHOD _CNV_A_R_LINEAR_____123_CM "" RAT_FUNC "%6.3" "-" COEFFS 0 100. 0. 0 0 1 /end COMPU_METHOD
/begin COMPU_METHOD _CNV_A_R_LINEAR_____125_CM "" RAT_FUNC "%6.3" "km/h" COEFFS 0 100. 0. 0 0 1 /end COMPU_METHOD
/begin COMPU_METHOD _CNV_A_R_LINEAR_____129_CM "" RAT_FUNC "%6.3" "°CRK" COEFFS 0 50. 0. 0 0 1 /end COMPU_METHOD
/begin COMPU_METHOD _CNV_A_R_LINEAR_____131_CM "" RAT_FUNC "%6.3" "s" COEFFS 0 50. 0. 0 0 1 /end COMPU_METHOD
/begin COMPU_METHOD _CNV_A_R_LINEAR_____161_CM "" RAT_FUNC "%6.3" "-" COEFFS 0 1000. 0. 0 0 1 /end COMPU_METHOD
/begin COMPU_METHOD _CNV_A_R_LINEAR_____162_CM "" RAT_FUNC "%6.3" "-" COEFFS 0 255. 0. 0 0 1 /end COMPU_METHOD
/begin COMPU_METHOD _CNV_A_R_LINEAR_____172_CM "" RAT_FUNC "%6.3" "kg/h" COEFFS 0 20. 0. 0 0 1 /end COMPU_METHOD
/begin COMPU_METHOD _CNV_S_3_STATUS_OK__179_CM "" TAB_VERB "%6.3" "-" COMPU_TAB_REF _CNV_S_3_STATUS_OK__179 /end COMPU_METHOD
/begin COMPU_VTAB _CNV_S_3_STATUS_OK__179 "" TAB_VERB 3 0 "Nsx_vld_nok_0" 1 "Nsx_vld_ok_1" 2 "Nsx_vld_fail_2" /end COMPU_VTAB
/begin COMPU_METHOD _CNV_A_R_LINEAR_____181_CM "" RAT_FUNC "%6.3" "Nm" COEFFS 0 32. 0. 0 0 1 /end COMPU_METHOD
/begin COMPU_METHOD _CNV_A_R_LINEAR_____183_CM "" RAT_FUNC "%6.3" "-" COEFFS 0 1024. 0. 0 0 1 /end COMPU_METHOD
/begin COMPU_METHOD _CNV_A_R_LINEAR_____186_CM "" RAT_FUNC "%6.3" "W" COEFFS 0 0.1 0. 0 0 1 /end COMPU_METHOD
/begin COMPU_METHOD _CNV_S_16_RANGE_ERR__206_CM "" TAB_VERB "%6.3" "" COMPU_TAB_REF _CNV_S_16_RANGE_ERR__206 /end COMPU_METHOD
/begin COMPU_VTAB _CNV_S_16_RANGE_ERR__206 "" TAB_VERB 16 0 "NO_SYM" 1 "SYM_0" 2 "SYM_1" 3 "SYM_0, SYM_1" 4 "SYM_2" 5 "SYM_0, SYM_2" 6 "SYM_1, SYM_2" 7 "SYM_0, SYM_1, SYM_2" 8 "SYM_3" 9 "SYM_0, SYM_3" 10 "SYM_1, SYM_3" 11 "SYM_0, SYM_1,SYM_3" 12 "SYM_2, SYM_3" 13 "SYM_0, SYM_2, SYM_3" 14 "SYM_1, SYM_2, SYM_3" 15 "SYM_0, SYM_1, SYM_2, SYM_3" /end COMPU_VTAB
/begin COMPU_METHOD _CNV_A_R_LINEAR_____216_CM "" RAT_FUNC "%6.3" "Nm" COEFFS 0 32. 12800. 0 0 1 /end COMPU_METHOD
/begin COMPU_METHOD _CNV_A_R_LINEAR_____222_CM "" RAT_FUNC "%6.3" "-" COEFFS 0 32768000.00000008 0. 0 0 1 /end COMPU_METHOD
/begin COMPU_METHOD _CNV_A_R_LINEAR_____275_CM "" RAT_FUNC "%6.3" "ratio" COEFFS 0 255. 0. 0 0 1 /end COMPU_METHOD
/begin COMPU_METHOD _CNV_A_R_LINEAR_____285_CM "" RAT_FUNC "%6.3" "-" COEFFS 0 1024. 32768. 0 0 1 /end COMPU_METHOD
/begin COMPU_METHOD _CNV_A_R_LINEAR_____298_CM "" RAT_FUNC "%6.3" "-" COEFFS 0 512. -257. 0 0 1 /end COMPU_METHOD
/begin COMPU_METHOD _CNV_A_R_LINEAR_____299_CM "" RAT_FUNC "%6.3" "Nm/kg" COEFFS 0 0.125 0. 0 0 1 /end COMPU_METHOD
/begin COMPU_METHOD _CNV_A_R_LINEAR_____300_CM "" RAT_FUNC "%6.3" "-" COEFFS 0 12.8 0. 0 0 1 /end COMPU_METHOD
/begin COMPU_METHOD _CNV_A_R_LINEAR_____301_CM "" RAT_FUNC "%6.3" "[1/s]" COEFFS 0 10.24 0. 0 0 1 /end COMPU_METHOD
/begin COMPU_METHOD _CNV_A_R_LINEAR_____302_CM "" RAT_FUNC "%6.3" "1/s" COEFFS 0 4. 0. 0 0 1 /end COMPU_METHOD
/begin COMPU_METHOD _CNV_A_R_LINEAR_____303_CM "" RAT_FUNC "%6.3" "1/s" COEFFS 0 4. 200. 0 0 1 /end COMPU_METHOD
/begin COMPU_METHOD _CNV_A_R_LINEAR_____304_CM "" RAT_FUNC "%6.3" "Nm/s" COEFFS 0 50. 32500. 0 0 1 /end COMPU_METHOD
/begin COMPU_METHOD _CNV_A_R_LINEAR_____305_CM "" RAT_FUNC "%6.3" "°CRK/s" COEFFS 0 0.32 0. 0 0 1 /end COMPU_METHOD
/begin COMPU_METHOD _CNV_A_R_LINEAR_____306_CM "" RAT_FUNC "%6.3" "°CRK" COEFFS 0 32. 0. 0 0 1 /end COMPU_METHOD
/begin COMPU_METHOD _CNV_A_R_LINEAR_____307_CM "" RAT_FUNC "%6.3" "°C" COEFFS 0 10. 12000. 0 0 1 /end COMPU_METHOD
/begin COMPU_METHOD _CNV_A_R_LINEAR_____308_CM "" RAT_FUNC "%6.3" "-" COEFFS 0 127.5 127.5 0 0 1 /end COMPU_METHOD
/begin COMPU_METHOD _CNV_S_17_INJECTION__309_CM "" TAB_VERB "%6.3" "" COMPU_TAB_REF _CNV_S_17_INJECTION__309 /end COMPU_METHOD
/begin COMPU_VTAB _CNV_S_17_INJECTION__309 "" TAB_VERB 17 0 "DI" 4096 "PRE_INJ_CUS" 4112 "PRE_INJ_CUS_FG" 4129 "PRE_INJ_CUS_SFG_D2_S2" 4130 "PRE_INJ_CUS_SFG_D3_S1" 4131 "PRE_INJ_CUS_SFG_D4_S0" 4145 "PRE_INJ_CUS_SEQ_D3_S1" 4146 "PRE_INJ_CUS_SEQ_D2_S2" 4147 "PRE_INJ_CUS_SEQ_D1_S3" 8192 "PRE_INJ" 8208 "PRE_INJ_WAIT4PRE" 8224 "PRE_INJ_WAIT4SEQ" 8240 "PRE_INJ_ACT" 12304 "SEQ_NORM" 12320 "SEQ_PROG_SHIFT" 16384 "CRASH" 20480 "TEST" /end COMPU_VTAB
/begin COMPU_METHOD _CNV_S_18_INJECTION__310_CM "" TAB_VERB "%6.3" "" COMPU_TAB_REF _CNV_S_18_INJECTION__310 /end COMPU_METHOD
/begin COMPU_VTAB _CNV_S_18_INJECTION__310 "" TAB_VERB 18 0 "NO_TRAN" 1 "TRAN_DI2TEST_MODE" 2 "TRAN_DI2PRE_INJ_CUS_FG" 3 "TRAN_PRE_INJ2SEQ" 4 "TRAN_PRE_INJ_CUS2SEQ" 5 "TRAN_2CRASH" 6 "TRAN_2SFG_D2_S2" 7 "TRAN_2SFG_D3_S1" 8 "TRAN_2SFG_D4_S0" 9 "TRAN_2SEQ_D3_S1" 10 "TRAN_2SEQ_D2_S2" 11 "TRAN_2SEQ_D1_S3" 12 "TRAN_PRG_SHIFT" 13 "TRAN_PRG_SHIFT2SEQ" 14 "TRAN_2PRE_INJ_WAIT4SEQ" 15 "TRAN_DI2PRE_INJ_WAIT4PRE" 16 "TRAN_PRE_INJ_WAIT4PRE2ACT_PRE" 255 "TRAN_2DI" /end COMPU_VTAB
/begin COMPU_METHOD _CNV_A_R_LINEAR_____311_CM "" RAT_FUNC "%6.3" "ms" COEFFS 0 5.e-003 0. 0 0 1 /end COMPU_METHOD
/begin COMPU_METHOD _CNV_A_R_LINEAR_____313_CM "" RAT_FUNC "%6.3" "-" COEFFS 0 100. 1000. 0 0 1 /end COMPU_METHOD
/begin RECORD_LAYOUT _REC_S1VAL_20_u1 FNC_VALUES 1 UBYTE COLUMN_DIR DIRECT /end RECORD_LAYOUT
/begin RECORD_LAYOUT _REC_A2AXS_20_u1 NO_AXIS_PTS_X 1 UBYTE AXIS_PTS_X 2 UBYTE INDEX_INCR DIRECT /end RECORD_LAYOUT
/begin RECORD_LAYOUT _REC_S1VAL_20_u2 FNC_VALUES 1 UWORD COLUMN_DIR DIRECT /end RECORD_LAYOUT
/begin RECORD_LAYOUT _REC_S1VAL_20_s2 FNC_VALUES 1 SWORD COLUMN_DIR DIRECT /end RECORD_LAYOUT
/begin RECORD_LAYOUT _REC_A2AXS_20_u2 NO_AXIS_PTS_X 1 UWORD AXIS_PTS_X 2 UWORD INDEX_INCR DIRECT /end RECORD_LAYOUT
/begin RECORD_LAYOUT _REC_A1CUR_20_u1_u2 FNC_VALUES 1 UBYTE COLUMN_DIR DIRECT /end RECORD_LAYOUT
/begin RECORD_LAYOUT _REC_A1CUR_20_u1_u1 FNC_VALUES 1 UBYTE COLUMN_DIR DIRECT /end RECORD_LAYOUT
/begin RECORD_LAYOUT _REC_A1CUR_20_u2_u1 FNC_VALUES 1 UWORD COLUMN_DIR DIRECT /end RECORD_LAYOUT
/begin RECORD_LAYOUT _REC_A1MAP_20_u2_u2_u2 FNC_VALUES 1 UWORD COLUMN_DIR DIRECT /end RECORD_LAYOUT
/begin RECORD_LAYOUT _REC_A1CUR_20_u2_u2 FNC_VALUES 1 UWORD COLUMN_DIR DIRECT /end RECORD_LAYOUT
/begin RECORD_LAYOUT _REC_A1MAP_20_u1_u1_u2 FNC_VALUES 1 UBYTE COLUMN_DIR DIRECT /end RECORD_LAYOUT
/begin RECORD_LAYOUT _REC_A1MAP_20_u1_u2_u2 FNC_VALUES 1 UBYTE COLUMN_DIR DIRECT /end RECORD_LAYOUT
/begin RECORD_LAYOUT _REC_A1MAP_20_u2_u1_u2 FNC_VALUES 1 UWORD COLUMN_DIR DIRECT /end RECORD_LAYOUT
/begin FUNCTION TqMdlSsp_Airspxx ""
 /begin DEF_CHARACTERISTIC Cbx_ant_is_cor_cfm Cxx_ant_is_drv_thd Cxx_ant_is_tq_fac Cxx_ant_is_tq_n_drv_ftc /end DEF_CHARACTERISTIC
 /begin OUT_MEASUREMENT Vxx_maf_frh_eng_sp Vxx_maf_frh_it_sp Vxx_pow_ant Vxx_pow_tgt Vxx_tq_ant_is_cor Vxx_tqi_ant /end OUT_MEASUREMENT
/end FUNCTION
/begin FUNCTION TqMdlSsp_Igefyxx "" /begin DEF_CHARACTERISTIC Cmp_iga_efv_degr_a /end DEF_CHARACTERISTIC
 /begin OUT_MEASUREMENT Vxx_iga_efv_degr_a Vxx_max_iga_efy Vxx_min_iga_efy Vxx_stat_min_iga_efy /end OUT_MEASUREMENT
/end FUNCTION
/begin FUNCTION TqMdlSsp_Isefyxx "" /begin DEF_CHARACTERISTIC Ctb_is_eal Ctb_is_n Cmp_n_eal_is_efy Cxx_is_efy_slop /end DEF_CHARACTERISTIC /begin OUT_MEASUREMENT Vxx_is_efy Vxx_n_eal_is_efy Vxx_raw_is_efy /end OUT_MEASUREMENT /end FUNCTION
/begin FUNCTION TqMdlSsp_Wuefyxx ""
 /begin DEF_CHARACTERISTIC Ctb_n_wup Ctb_wup_h_l_iga_efy_ctr Ctb_wup_tq_rel Cmp_n_tq_rel_wup_cold_iga_efy Cmp_n_tq_rel_wup_h_iga_efy Cmp_n_tq_rel_wup_l_iga_efy Ctp_wup_h_l_iga_efy_ctr Cxx_diag_sta_cata_lbup_wup_efy Cxx_wup_cold_fil_pos_slop Cxx_wup_efy_ftc Cxx_wup_fil_neg_slop Cxx_wup_fil_pos_slop /end DEF_CHARACTERISTIC
 /begin OUT_MEASUREMENT Vxx_tq_rel Vxx_wup_cold_efy_cor Vxx_wup_efy Vxx_wup_efy_cor Vxx_wup_efy_fil_fac Vxx_wup_h_l_ctr /end OUT_MEASUREMENT
/end FUNCTION
/begin FUNCTION TqMdlSsp_Iswuefy ""
 /begin DEF_CHARACTERISTIC Ctb_is_cata_wup_efy_ctr Ctp_is_wup_cold_dri_efy_cor Ctp_is_wup_cold_neut_efy_cor Ctp_is_wup_dri_efy_cor Ctp_is_wup_neut_efy_cor Cxx_is_wup_fil_neg_slop Cxx_is_wup_fil_pos_slop /end DEF_CHARACTERISTIC
 /begin OUT_MEASUREMENT Vbx_not_cold_sta_tco Vxx_is_wup_cold_neut_efy_cor Vxx_is_wup_dri_efy_cor Vxx_is_wup_efy Vxx_is_wup_efy_fil_fac Vxx_is_wup_neut_efy_cor /end OUT_MEASUREMENT
/end FUNCTION
/begin FUNCTION TqMdlSsp_Alcoxxx ""
 /begin DEF_CHARACTERISTIC Ctb_wup_h_l_iga_efy_ctr_alco Cmp_iga_efv_degr_a_alco Cmp_n_eal_is_efy_alco Cmp_n_eal_otl_tqi_fac_alco Cmp_n_tq_wup_cold_efy_alco Cmp_n_tq_wup_h_iga_efy_alco Cmp_n_tq_wup_l_iga_efy_alco Ctp_is_wup_cold_neut_efy_alco Ctp_is_wup_neut_efy_alco Ctp_rich_otl_iga_tqi_fac_alco Ctp_wup_h_l_iga_efy_ctr_alco Cxx_otl_iga_tqi_alco /end DEF_CHARACTERISTIC
 /begin OUT_MEASUREMENT Vxx_iga_efv_degr_a_alco Vxx_is_wup_cold_neut_efy_alco Vxx_is_wup_neut_efy_alco Vxx_n_eal_is_efy_alco Vxx_otl_iga_mv_tqi_alco Vxx_wup_cold_efy_cor_alco Vxx_wup_efy_cor_alco Vxx_wup_h_l_ctr_alco /end OUT_MEASUREMENT
/end FUNCTION
/begin FUNCTION CbIgnSpt "" /begin SUB_FUNCTION CbIgnSpt_Alcoxxx CbIgnSpt_Igfinxx CbIgnSpt_Igstaxx /end SUB_FUNCTION /end FUNCTION
/begin FUNCTION CbIgnSpt_Alcoxxx "" /begin DEF_CHARACTERISTIC Cmp_n_tco_sta_iga_alco /end DEF_CHARACTERISTIC /begin OUT_MEASUREMENT Vxx_n_tco_sta_iga_alco /end OUT_MEASUREMENT /end FUNCTION
/begin FUNCTION CbIgnSpt_Igfinxx ""
 /begin DEF_CHARACTERISTIC Ctb_n_iga_tkof Cmp_n_map_cart_iga_bch Ctp_n_grd_driv_tqe_iga_cor Ctp_n_grd_tqi_iga_cor Ctp_n_iga_slwr_stop_1 Ctp_n_iga_slwr_stop_2 Ctp_n_iga_tkof_abv_1 Ctp_n_iga_tkof_abv_2 Ctp_n_iga_tkof_t_1 Ctp_n_iga_tkof_t_2 Cbx_cart_iga_bch_cfm Cbx_iga_bch_cfm Cbx_iga_ofs_bch_cfm Cbx_iga_tkof_cor Cxx_eal_iga_cor_1 Cxx_eal_iga_cor_2 Cxx_ftc_grd_driv_tqe_iga_cor Cxx_ftc_grd_tqi_iga_cor Cxx_iga_appl_ini Cxx_iga_bch Cxx_iga_ofs_cyl1 Cxx_iga_ofs_cyl2 Cxx_iga_ofs_cyl3 Cxx_iga_ofs_cyl4 Cxx_mat_iga_cor_1 Cxx_mat_iga_cor_2 Cxx_n_prim_sha_spd_dif_2 Cxx_tco_iga_cor_1 Cxx_tco_iga_cor_2 /end DEF_CHARACTERISTIC
 /begin OUT_MEASUREMENT Vbx_cor_iga_cdn_1 Vbx_cor_iga_cdn_2 Vtx_iga_appl_itl[0] Vtx_iga_appl_itl[1] Vxx_iga_appl Vxx_iga_pred Vxx_n_iga_slwr_stop Vxx_n_iga_tkof_abv Vxx_n_iga_tkof_t Vxx_nom_iga /end OUT_MEASUREMENT
/end FUNCTION
/begin FUNCTION CbIgnSpt_Igstaxx "" /begin DEF_CHARACTERISTIC Cmp_n_tco_sta_iga /end DEF_CHARACTERISTIC /begin OUT_MEASUREMENT Vxx_sta_iga /end OUT_MEASUREMENT /end FUNCTION
/begin FUNCTION CbIgnLim ""
 /begin OUT_MEASUREMENT Vxx_knk_slow_cor_max_iga_NVM Vxx_knk_slow_iga_zon1 Vxx_knk_slow_iga_zon2 Vxx_knk_slow_iga_zon3 Vxx_knk_slow_iga_zon4 Vxx_knk_slow_iga_zon5 Vxx_knk_slow_iga_zon6 Vxx_knk_slow_iga_zon7 Vxx_knk_slow_iga_zon8 Vxx_knk_slow_iga_zon9 Vxx_knk_slow_iga_zon10 Vxx_knk_slow_iga_zon11 Vxx_knk_slow_iga_zon12 Vxx_knk_slow_iga_zon13 Vxx_knk_slow_iga_zon14 Vxx_knk_slow_iga_zon15 Vxx_knk_slow_iga_zon16 Vtd_knk_slow_cor_iga_cyl[0] Vtd_knk_slow_cor_iga_cyl[1] Vtd_knk_slow_cor_iga_cyl[2] Vtd_knk_slow_cor_iga_cyl[3] /end OUT_MEASUREMENT
 /begin SUB_FUNCTION CbIgnLim_Maxigxx CbIgnLim_Minigxx CbIgnLim_Pknkcxx CbIgnLim_Slcbcxx CbIgnLim_Alcoxxx CbIgnLim_Mplkxxx CbIgnLim_Sglkzon CbIgnLim_Kigaccs CbIgnLim_Mpsgcsx CbIgnLim_Fskigac CbIgnLim_Slkigac /end SUB_FUNCTION
/end FUNCTION
/begin FUNCTION CbIgnLim_Maxigxx ""
 /begin DEF_CHARACTERISTIC Ntb_vvtc_rel_angl Cmp_n_eal_vvtc_iga_h Cmp_n_eal_vvtc_iga_l Cmp_n_eal_vvtc_iga_midh Cmp_n_eal_vvtc_iga_midl Cmp_n_eal_vvtc_off_iga_cor Cmp_n_eal_vvtc_on_iga_cor Ctp_vvtc_angl_iga_fac1 Ctp_vvtc_angl_iga_fac2 Cxx_vvtc_h_trt Cxx_vvtc_min_iga_cor /end DEF_CHARACTERISTIC
 /begin OUT_MEASUREMENT Vxx_max_iga Vxx_raw_max_iga Vxx_raw_slow_max_iga Vxx_vvtc_iga Vxx_vvtc_iga_fac1 Vxx_vvtc_iga_fac2 Vxx_vvtc_off_iga Vxx_vvtc_on_iga /end OUT_MEASUREMENT
/end FUNCTION
/begin FUNCTION CbIgnLim_Minigxx ""
 /begin DEF_CHARACTERISTIC Ntb_cyl_nr Cmp_eal_n_min_iga_cor Cmp_iga_tco_cor Cmp_iga_tq_min Cmx_n_iga_tq_min_lih Ctp_n_iga_cor Cxx_l_min_iga_ctr_dec Cxx_l_min_iga_ctr_inc Cxx_l_min_iga_ctr_thd Cxx_l_min_iga_inc Cxx_min_iga_dsb_t /end DEF_CHARACTERISTIC
 /begin OUT_MEASUREMENT Vbx_l_min_iga Vbx_l_min_iga_ctr_thd Vbx_min_iga_dsb Vbx_minig_it_dft Vxx_cor_min_iga Vxx_l_min_iga_ctr Vxx_min_iga Vxx_min_iga_dsb_t Vxx_stat_min_iga /end OUT_MEASUREMENT
/end FUNCTION
/begin FUNCTION CbIgnLim_Pknkcxx ""
 /begin DEF_CHARACTERISTIC Ctb_knk_ant_mat_cor Cmp_n_eal_ol_knk_iga_cor Cmp_n_eal_ol_knk_mat_ref Ctp_ol_knk_mat_fac Cxx_alco_pknk_fac /end DEF_CHARACTERISTIC
 /begin OUT_MEASUREMENT Vxx_ol_knk_iga_cor /end OUT_MEASUREMENT
/end FUNCTION
/begin FUNCTION CbIgnLim_Slcbcxx "" /begin DEF_CHARACTERISTIC Cmp_tco_slow_comb_iga_cor Ctp_n_slow_comb_fac /end DEF_CHARACTERISTIC /begin OUT_MEASUREMENT Vxx_slow_comb_iga_cor /end OUT_MEASUREMENT /end FUNCTION
/begin FUNCTION CbIgnLim_Alcoxxx ""
 /begin DEF_CHARACTERISTIC Cmp_eal_n_min_iga_cor_alco Cmp_iga_tco_cor_alco Cmp_iga_tq_min_alco Cmp_n_eal_vvtc_iga_alco Cmp_tco_slow_comb_iga_cor_alco Ctp_n_iga_cor_alco Ctp_n_slow_comb_fac_alco /end DEF_CHARACTERISTIC
 /begin OUT_MEASUREMENT Vxx_iga_tq_min_alco Vxx_min_iga_cor_alco Vxx_n_tco_iga_cor_alco Vxx_slow_comb_iga_cor_alco Vxx_vvtc_iga_alco /end OUT_MEASUREMENT
/end FUNCTION
/begin FUNCTION CbIgnLim_Mplkxxx ""
 /begin OUT_MEASUREMENT Vbx_knk_2_cyl_min_ml Vbx_knk_zon_ml Vbx_trs_zon Vtd_knk_slow_cor_iga_cyl_ml[0] Vtd_knk_slow_cor_iga_cyl_ml[1] Vtd_knk_slow_cor_iga_cyl_ml[2] Vtd_knk_slow_cor_iga_cyl_ml[3] Vxx_knk_slow_cor_ave_ml Vxx_knk_slow_cor_max_iga_ml /end OUT_MEASUREMENT
/end FUNCTION
/begin FUNCTION CbIgnLim_Sglkzon "" /begin DEF_CHARACTERISTIC Ctp_n_knk_zon /end DEF_CHARACTERISTIC /begin OUT_MEASUREMENT Vbx_knk_zon_sl /end OUT_MEASUREMENT /end FUNCTION
/begin FUNCTION CbIgnLim_Kigaccs "" /begin DEF_CHARACTERISTIC Cbx_knk_cor_ave_ena Cxx_knk_iga_cor /end DEF_CHARACTERISTIC
 /begin OUT_MEASUREMENT Vtd_knk_iga_cor_appl_cyl[0] Vtd_knk_iga_cor_appl_cyl[1] Vtd_knk_iga_cor_appl_cyl[2] Vtd_knk_iga_cor_appl_cyl[3] /end OUT_MEASUREMENT
/end FUNCTION
/begin FUNCTION CbIgnLim_Mpsgcsx ""
 /begin DEF_CHARACTERISTIC Cxx_knk_1cyl_slow_cor_max Cxx_knk_2cyl_slow_dif_max Cxx_knk_slow_cor_dec_ctr Cxx_knk_slow_cor_iga_inc Cxx_knk_slow_cor_iga_max Cxx_knk_slow_cor_prs_dif Cxx_knk_zon_tco_thd /end DEF_CHARACTERISTIC
 /begin OUT_MEASUREMENT Vbx_knk_2_cyl_min Vbx_knk_zon Vtd_knk_slow_cor_iga_cyl_ini[0] Vtd_knk_slow_cor_iga_cyl_ini[1] Vtd_knk_slow_cor_iga_cyl_ini[2] Vtd_knk_slow_cor_iga_cyl_ini[3] Vxx_knk_slow_cor_ave Vxx_knk_slow_cor_max_iga_ini /end OUT_MEASUREMENT
/end FUNCTION
/begin FUNCTION CbIgnLim_Fskigac ""
 /begin DEF_CHARACTERISTIC Ctp_n_knk_fast_inc_iga Cxx_fast_dec_step Cxx_knk_fast_cor_dec_ctr Cxx_knk_fast_cor_iga_max Cxx_knk_fast_cor_iga_thd /end DEF_CHARACTERISTIC
 /begin OUT_MEASUREMENT Vtd_knk_det_err_cyl[0] Vtd_knk_det_err_cyl[1] Vtd_knk_det_err_cyl[2] Vtd_knk_det_err_cyl[3] Vtd_knk_fast_cor_cyl[0] Vtd_knk_fast_cor_cyl[1] Vtd_knk_fast_cor_cyl[2] Vtd_knk_fast_cor_cyl[3] Vtd_knk_fast_cor_iga_cyl[0] Vtd_knk_fast_cor_iga_cyl[1] Vtd_knk_fast_cor_iga_cyl[2] Vtd_knk_fast_cor_iga_cyl[3] Vxx_knk_fast_cor_iga_cyl1 Vxx_knk_fast_cor_iga_cyl2 Vxx_knk_fast_cor_iga_cyl3 Vxx_knk_fast_cor_iga_cyl4 Vxx_knk_fast_cor_iga_cyl_i1 Vxx_knk_fast_cor_iga_cyl_i2 Vxx_knk_fast_cor_iga_cyl_i3 Vxx_knk_fast_cor_iga_cyl_i4 Vxx_knk_fast_dec_ctr_cyl1 Vxx_knk_fast_dec_ctr_cyl2 Vxx_knk_fast_dec_ctr_cyl3 Vxx_knk_fast_dec_ctr_cyl4 Vxx_knk_iga_fast_cor_inc /end OUT_MEASUREMENT
/end FUNCTION
/begin FUNCTION CbIgnLim_Slkigac "" /begin DEF_CHARACTERISTIC Cxx_slow_dec_step /end DEF_CHARACTERISTIC
 /begin OUT_MEASUREMENT Vbx_knk_2_cyl_min_sl Vbx_knk_slow_cyl Vtd_knk_slow_cor_iga_cyl_sl[0] Vtd_knk_slow_cor_iga_cyl_sl[1] Vtd_knk_slow_cor_iga_cyl_sl[2] Vtd_knk_slow_cor_iga_cyl_sl[3] Vtd_knk_slow_iga_cyl_no_sat[0] Vtd_knk_slow_iga_cyl_no_sat[1] Vtd_knk_slow_iga_cyl_no_sat[2] Vtd_knk_slow_iga_cyl_no_sat[3] Vxx_knk_slow_cor_ave_sl Vxx_knk_slow_cor_dec_ctr Vxx_knk_slow_cor_max_iga_sl Vxx_slow_ctr /end OUT_MEASUREMENT
/end FUNCTION
/begin FUNCTION CbIgnOpt "" /begin SUB_FUNCTION CbIgnOpt_Optigxx CbIgnOpt_Alcoxxx /end SUB_FUNCTION /end FUNCTION
/begin FUNCTION CbIgnOpt_Optigxx ""
 /begin DEF_CHARACTERISTIC Cmp_eal_n_vvtc_off_otl_iga Cmp_eal_n_vvtc_on_otl_iga Cmp_eal_n_vvtc_otl_iga /end DEF_CHARACTERISTIC
 /begin OUT_MEASUREMENT Vsx_otl_iga_vld Vxx_otl_iga Vxx_raw_otl_iga Vxx_vvtc_off_otl_iga Vxx_vvtc_on_otl_iga Vxx_vvtc_otl_iga /end OUT_MEASUREMENT
/end FUNCTION
/begin FUNCTION CbIgnOpt_Alcoxxx "" /begin DEF_CHARACTERISTIC Cmp_eal_n_vvtc_otl_iga_alco /end DEF_CHARACTERISTIC /begin OUT_MEASUREMENT Vxx_vvtc_otl_iga_alco /end OUT_MEASUREMENT /end FUNCTION
/begin FUNCTION BoCboIgn ""
 /begin OUT_MEASUREMENT Vbx_df_igc_1_oc Vbx_df_igc_1_scg Vbx_df_igc_1_scw Vbx_df_igc_2_oc Vbx_df_igc_2_scg Vbx_df_igc_2_scw Vbx_df_igc_3_oc Vbx_df_igc_3_scg Vbx_df_igc_3_scw Vbx_df_igc_4_oc Vbx_df_igc_4_scg Vbx_df_igc_4_scw Vbx_diag_ena_igc_1_oc Vbx_diag_ena_igc_1_scg Vbx_diag_ena_igc_1_scw Vbx_diag_ena_igc_2_oc Vbx_diag_ena_igc_2_scg Vbx_diag_ena_igc_2_scw Vbx_diag_ena_igc_3_oc Vbx_diag_ena_igc_3_scg Vbx_diag_ena_igc_3_scw Vbx_diag_ena_igc_4_oc Vbx_diag_ena_igc_4_scg Vbx_diag_ena_igc_4_scw iga_av_shift_rng[0] iga_av_shift_rng[1] iga_av_shift_rng[2] iga_av_shift_rng[3] inh_igc_cus state_td_boost /end OUT_MEASUREMENT
/end FUNCTION
/begin FUNCTION BoCboInj ""
 /begin DEF_CHARACTERISTIC ldp_tco_ip_eoi_min_pre_inj ldp_tco_ip_psn_dif_eng_syn_thd ip_eoi_min_pre_inj ip_psn_dif_eng_syn_thd c_cdn_diag_iv c_n_low_ena_pre_thd c_rec_diag_iv c_soi_lock c_tco_max_pre_inj_seq c_ti_eol lc_eoi_pre_inj_1_cor_ena /end DEF_CHARACTERISTIC
 /begin OUT_MEASUREMENT Vbx_df_inj1_oc Vbx_df_inj1_scg Vbx_df_inj1_scw Vbx_df_inj2_oc Vbx_df_inj2_scg Vbx_df_inj2_scw Vbx_df_inj3_oc Vbx_df_inj3_scg Vbx_df_inj3_scw Vbx_df_inj4_oc Vbx_df_inj4_scg Vbx_df_inj4_scw Vbx_diag_ena_inj1_oc Vbx_diag_ena_inj1_scg Vbx_diag_ena_inj1_scw Vbx_diag_ena_inj2_oc Vbx_diag_ena_inj2_scg Vbx_diag_ena_inj2_scw Vbx_diag_ena_inj3_oc Vbx_diag_ena_inj3_scg Vbx_diag_ena_inj3_scw Vbx_diag_ena_inj4_oc Vbx_diag_ena_inj4_scg Vbx_diag_ena_inj4_scw Vbx_inj_open cdn_diag_iv[0] cdn_diag_iv[1] cdn_diag_iv[2] cdn_diag_iv[3] crk_ctr_tmp crk_inj_ofs_cor_tmp cyl_av eoi_lim_pre_inj err_sym_iv[0] err_sym_iv[1] err_sym_iv[2] err_sym_iv[3] inh_inj_tmp[0] inh_inj_tmp[1] inh_inj_tmp[2] inh_inj_tmp[3] lf_state_inj_clc_req lv_conf_pre_inj lv_crash_act lv_inh_inj[0] lv_inh_inj[1] lv_inh_inj[2] lv_inh_inj[3] lv_inj_di_req lv_inj_ena_req lv_inj_open lv_inj_open_drv_cycle lv_pre_inj_end[0] lv_pre_inj_end[1] lv_pre_inj_end[2] lv_pre_inj_end[3] lv_soi_lock_req lv_state_prev_iv[0] lv_state_prev_iv[1] lv_state_prev_iv[2] lv_state_prev_iv[3] lv_test_out_eol_fim_shrt nr_cyl_first nr_cyl_first_1 nr_cyl_first_2 nr_cyl_first_3 nr_tooth_pre_inj ofs_ctr ofs_ref_inj psn_dif_eng_syn psn_dif_eng_syn_thd psn_dif_eng_syn_tmp soi_1_hom[0] soi_1_hom[1] soi_1_hom[2] soi_1_hom[3] soi_2_hom[0] soi_2_hom[1] soi_2_hom[2] soi_2_hom[3] soi_pre_inj[0] soi_pre_inj[1] soi_pre_inj[2] soi_pre_inj[3] soi_pre_inj_cor state_inj_mod state_inj_mod_tran state_inj_upd_mod_cyl_ack tdc_ctr_prg_shift ti_1_hom[0] ti_1_hom[1] ti_1_hom[2] ti_1_hom[3] ti_2_hom[0] ti_2_hom[1] ti_2_hom[2] ti_2_hom[3] ti_pre_inj[0] ti_pre_inj[1] ti_pre_inj[2] ti_pre_inj[3] timer_pre_inj_fg /end OUT_MEASUREMENT
/end FUNCTION
/begin FUNCTION BiPciBki ""
 /begin OUT_MEASUREMENT Vbx_sens_brk_pdl_open Vbx_sfty_sens_brk_pdl_open lv_bls lv_bls_mon lv_bts lv_bts_mon lv_clu_swi /end OUT_MEASUREMENT
/end FUNCTION
/begin FUNCTION BiPciDls "" /begin OUT_MEASUREMENT Vbx_raw_sens_bgin_clu_cnt /end OUT_MEASUREMENT /end FUNCTION
/begin FUNCTION PcPajCtl ""
 /begin SUB_FUNCTION PcPajCtl_Ajmodxx PcPajCtl_Ajspvxx PcPajCtl_Estixxx PcPajCtl_Spccdxx PcPajCtl_Spcpaxx /end SUB_FUNCTION
/end FUNCTION
/begin FUNCTION PcPajCtl_Ajmodxx ""
 /begin DEF_CHARACTERISTIC Ctb_ajs_drag_tq_fac Ctb_ajs_modu_n Ctb_ajs_modu_tkof_spt_fac Ctb_ajs_tq_fac Cmp_ajs_acel_slk_dly_t1 Cmp_ajs_acel_slk_dly_t1_fac Cmp_ajs_acel_slk_t1_ini_max Cmp_ajs_acel_slk_t1_ini_max_fac Cmp_ajs_decl_slk_dly_t1 Cmp_ajs_decl_slk_dly_t1_fac Cmp_ajs_decl_slk_t1_ini_max Cmp_ajs_decl_slk_t1_ini_max_fac Cmp_ajs_modu_t1_acel_driv_fac Cmp_ajs_modu_t1_acel_dt_clos Cmp_ajs_modu_t1_acel_tql_fac Cmp_ajs_modu_t1_aftr_decl_n Cmp_ajs_modu_t1_aftr_decl_tq Cmp_ajs_modu_t1_aftr_decl_tql Cmp_ajs_modu_t1_bfr_acel_n Cmp_ajs_modu_t1_bfr_acel_tq Cmp_ajs_modu_t1_bfr_acel_tql Cmp_ajs_modu_t1_decl_driv_fac Cmp_ajs_modu_t1_decl_dt_clos Cmp_ajs_modu_t1_decl_tql_fac Cmp_ajs_modu_td_acel_driv_fac Cmp_ajs_modu_td_acel_dt_clos Cmp_ajs_modu_td_acel_tql_fac Cmp_ajs_modu_td_decl_driv_fac Cmp_ajs_modu_td_decl_dt_clos Cmp_ajs_modu_td_decl_tql_fac Ctp_ajs_drag_t1_dly Ctp_ajs_modu_t1_acel_dt_modu Ctp_ajs_modu_t1_acel_dt_open Ctp_ajs_modu_t1_tkof_dt_open Ctp_ajs_modu_td_acel_dt_modu Ctp_ajs_modu_td_acel_dt_open Ctp_ajs_modu_td_tkof_dt_open Cbx_ajs_dt_slk_cfm Cbx_ajs_modu_stt_cfm Cbx_ajs_modu_td_dec_cfm Cbx_ajs_new_slk_cfm Cbx_ajs_slk_td_cfm Cxx_ajs_modu_loss_fil_cut_thd Cxx_ajs_modu_slk_fil_t1_acel Cxx_ajs_modu_slk_fil_t1_decl Cxx_ajs_modu_t1_decl_dt_modu Cxx_ajs_modu_t1_decl_dt_open Cxx_ajs_modu_t1_dt_clos_max Cxx_ajs_modu_t1_dt_ini Cxx_ajs_modu_t1_fast_cor Cxx_ajs_modu_td_decl_dt_modu Cxx_ajs_modu_td_decl_dt_open Cxx_ajs_modu_td_dt_ini Cxx_ajs_modu_td_fast_cor Cxx_ajs_modu_tkof_vs_thd Cxx_ajs_modu_vs_thd_off Cxx_ajs_modu_vs_thd_on Cxx_ajs_n_mv_dft Cxx_ajs_slk_act_ctr Cxx_ajs_slk_td_ini_fac /end DEF_CHARACTERISTIC
 /begin OUT_MEASUREMENT Vbx_ajs_modu_loss_fil_cut Vbx_ajs_modu_stt_cut Vbx_ajs_modu_tkof_ena Vsx_ajs_modu_stt_para Vxx_ajs_modu_init_fil Vxx_ajs_modu_n_mv Vxx_ajs_modu_t1 Vxx_ajs_modu_t1_acel Vxx_ajs_modu_t1_acel_dt_clos Vxx_ajs_modu_t1_acel_dt_modu Vxx_ajs_modu_t1_acel_dt_open Vxx_ajs_modu_t1_acel_fac Vxx_ajs_modu_t1_bfr_drag Vxx_ajs_modu_t1_decl Vxx_ajs_modu_t1_decl_dt_clos Vxx_ajs_modu_t1_decl_fac Vxx_ajs_modu_t1_sp Vxx_ajs_modu_t1_tgt Vxx_ajs_modu_td Vxx_ajs_modu_td_acel Vxx_ajs_modu_td_acel_dt_clos Vxx_ajs_modu_td_acel_dt_modu Vxx_ajs_modu_td_acel_dt_open Vxx_ajs_modu_td_acel_fac Vxx_ajs_modu_td_decl Vxx_ajs_modu_td_decl_dt_clos Vxx_ajs_modu_td_decl_fac Vxx_ajs_modu_td_sp Vxx_ajs_modu_td_tgt Vxx_ajs_modu_tqe_sp Vxx_ajs_modu_tqe_sp_fil Vxx_ajs_modu_tqe_tgt Vxx_ajs_modu_tqe_tgt_fil Vxx_ajs_slk_dly_t1 Vxx_ajs_slk_t1_ini_max /end OUT_MEASUREMENT
/end FUNCTION
/end MODULE
/end PROJECT
