ASAP2_VERSION 1 41
/begin PROJECT RD8 "_default_ProjectLongIdentifier"
/begin HEADER "_default_HeaderComment" PROJECT_NO RD9 /end HEADER
/begin MODULE _default_ModuleName "_default_ModuleLongIdentifier"
/begin MOD_COMMON "_default_ModCommonComment" DEPOSIT ABSOLUTE BYTE_ORDER MSB_LAST ALIGNMENT_BYTE 1 ALIGNMENT_WORD 2 ALIGNMENT_LONG 2 ALIGNMENT_FLOAT32_IEEE 2 ALIGNMENT_FLOAT64_IEEE 4 /end MOD_COMMON
/begin AXIS_PTS Ctb_gear_fs "Ctb_gear_fs" 0xa002229c NO_INPUT_QUANTITY _REC_A2AXS_20_u1 5. _CNV_R_R_VA_F_1_p1__494_CM 6 1. 6. FORMAT "%9.2" /end AXIS_PTS
/begin AXIS_PTS Ctb_tq_dif_tco "Ctb_tq_dif_tco" 0xa00375c0 Vxx_tco _REC_A2AXS_20_u2 240. _CNV_R_R_VA_F_0v1_m_519_CM 6 -40. 200. FORMAT "%9.2" /end AXIS_PTS
/begin AXIS_PTS Ctb_tq_dif_vs "Ctb_tq_dif_vs" 0xa00375d0 Vxx_vs _REC_A2AXS_20_u2 655.35 _CNV_R_R_VA_F_0v01__500_CM 10 0. 655.35 FORMAT "%9.2" /end AXIS_PTS
/begin CHARACTERISTIC Ctp_tq_dif_tco_fac "Ctp_tq_dif_tco_fac" CURVE 0xa00222a4 _REC_A1CUR_20_u1_u2 1. _CNV_R_R_VA_F_0v004_520_CM 0. 1. FORMAT "%9.3"
 /begin AXIS_DESCR COM_AXIS Vxx_tco _CNV_R_R_VA_F_0v1_m_519_CM 6 -40. 200. FORMAT "%9.2" AXIS_PTS_REF Ctb_tq_dif_tco /end AXIS_DESCR
/end CHARACTERISTIC
/begin CHARACTERISTIC Ctp_tq_res "Ctp_tq_res" CURVE 0xa00375e8 _REC_A1CUR_20_u2_u2 32768. _CNV_R_R_VA_F_1_p0__515_CM 0. 32768. FORMAT "%9.2"
 /begin AXIS_DESCR COM_AXIS Vxx_vs _CNV_R_R_VA_F_0v01__500_CM 10 0. 655.35 FORMAT "%9.2" AXIS_PTS_REF Ctb_tq_dif_vs /end AXIS_DESCR
/end CHARACTERISTIC
/begin CHARACTERISTIC Ctp_vh_wht_eq "Ctp_vh_wht_eq" CURVE 0xa00375fc _REC_A1CUR_20_u2_u1 4096. _CNV_R_R_VA_F_1_p0__521_CM 0. 4096. FORMAT "%9.2"
 /begin AXIS_DESCR COM_AXIS NO_INPUT_QUANTITY _CNV_R_R_VA_F_1_p1__494_CM 6 1. 6. FORMAT "%9.2" AXIS_PTS_REF Ctb_gear_fs /end AXIS_DESCR
/end CHARACTERISTIC
/begin MEASUREMENT Vbx_fil_rst "Vbx_fil_rst" UBYTE _CNV_S_2_VA_Bool_ON_502_CM 1 0. 0. 1. ECU_ADDRESS 0xd000744d BIT_MASK 0x1 /end MEASUREMENT
/begin MEASUREMENT Vbx_frz "Vbx_frz" UBYTE _CNV_S_2_VA_Bool_ON_502_CM 1 0. 0. 1. ECU_ADDRESS 0xd000744e BIT_MASK 0x1 /end MEASUREMENT
/begin MEASUREMENT Vbx_sip_frz "Vbx_sip_frz" UBYTE _CNV_S_2_VA_Bool_ON_502_CM 1 0. 0. 1. ECU_ADDRESS 0xd0007450 BIT_MASK 0x1 /end MEASUREMENT
/begin MEASUREMENT Vsx_pow_r_vld "Vsx_pow_r_vld" UBYTE _CNV_R_R_VA_I_16_503_CM 1 0. 0. 255. ECU_ADDRESS 0xd0007442 FORMAT "%9.2" /end MEASUREMENT
/begin MEASUREMENT Vsx_tq_dif_vld "Vsx_tq_dif_vld" UBYTE _CNV_R_R_VA_I_16_503_CM 1 0. 0. 255. ECU_ADDRESS 0xd0007443 FORMAT "%9.2" /end MEASUREMENT
/begin MEASUREMENT Vxx_dly_pow_r "Vxx_dly_pow_r" SWORD _CNV_R_R_VA_F_10_p0_512_CM 1 0. -327680. 327670. ECU_ADDRESS 0xd0004ca6 FORMAT "%9.2" /end MEASUREMENT
/begin MEASUREMENT Vxx_dly_tq_dif "Vxx_dly_tq_dif" SWORD _CNV_R_R_VA_F_1_p0__515_CM 1 0. -32768. 32767. ECU_ADDRESS 0xd0004ca8 FORMAT "%9.2" /end MEASUREMENT
/begin MEASUREMENT Vxx_free_shf_acel "Vxx_free_shf_acel" SLONG _CNV_R_R_VA_F_0v000_496_CM 1 0. -858993.4592 858993.4588 ECU_ADDRESS 0xd0002cf0 FORMAT "%9.4" /end MEASUREMENT
/begin MEASUREMENT Vxx_gear_lim_tq_dif "Vxx_gear_lim_tq_dif" UBYTE _CNV_R_R_VA_F_1_p1__494_CM 1 0. 1. 256. ECU_ADDRESS 0xd0007446 FORMAT "%9.2" /end MEASUREMENT
/begin MEASUREMENT Vxx_pow_r "Vxx_pow_r" SWORD _CNV_R_R_VA_F_10_p0_512_CM 1 0. -327680. 327670. ECU_ADDRESS 0xd0004caa FORMAT "%9.2" /end MEASUREMENT
/begin MEASUREMENT Vxx_pow_r_fil "Vxx_pow_r_fil" SWORD _CNV_R_R_VA_F_10_p0_512_CM 1 0. -327680. 327670. ECU_ADDRESS 0xd0004cac FORMAT "%9.2" /end MEASUREMENT
/begin MEASUREMENT Vxx_pow_r_raw "Vxx_pow_r_raw" SWORD _CNV_R_R_VA_F_10_p0_512_CM 1 0. -327680. 327670. ECU_ADDRESS 0xd0004cb0 FORMAT "%9.2" /end MEASUREMENT
/begin MEASUREMENT Vxx_tq_dif "Vxx_tq_dif" SWORD _CNV_R_R_VA_F_1_p0__515_CM 1 0. -32768. 32767. ECU_ADDRESS 0xd0004cb2 FORMAT "%9.2" /end MEASUREMENT
/begin MEASUREMENT Vxx_tq_dif_esti_tqe_fil "Vxx_tq_dif_esti_tqe_fil" UWORD _CNV_R_R_VA_F_0v031_522_CM 1 0. -400. 1647.96875 ECU_ADDRESS 0xd0004cb8 FORMAT "%9.2" /end MEASUREMENT
/begin MEASUREMENT Vxx_tq_dif_fil "Vxx_tq_dif_fil" SWORD _CNV_R_R_VA_F_1_p0__515_CM 1 0. -32768. 32767. ECU_ADDRESS 0xd0004cb4 FORMAT "%9.2" /end MEASUREMENT
/begin CHARACTERISTIC Cxx_end_sip_ena_dly "Cxx_end_sip_ena_dly" VALUE 0xa00222aa _REC_S1VAL_Normal_u1 10.2 _CNV_R_R_VA_F_0v04__523_CM 0. 10.2 FORMAT "%9.2" /end CHARACTERISTIC
/begin CHARACTERISTIC Cxx_pow_r_fil "Cxx_pow_r_fil" VALUE 0xa00222ab _REC_S1VAL_Normal_u1 10.2 _CNV_R_R_VA_F_0v04__523_CM 0. 10.2 FORMAT "%9.2" /end CHARACTERISTIC
/begin CHARACTERISTIC Cxx_tq_dif_acel_dec_fil "Cxx_tq_dif_acel_dec_fil" VALUE 0xa00222ac _REC_S1VAL_Normal_u1 10.2 _CNV_R_R_VA_F_0v04__523_CM 0. 10.2 FORMAT "%9.2" /end CHARACTERISTIC
/begin CHARACTERISTIC Cxx_tq_dif_acel_inc_fil "Cxx_tq_dif_acel_inc_fil" VALUE 0xa00222ad _REC_S1VAL_Normal_u1 10.2 _CNV_R_R_VA_F_0v04__523_CM 0. 10.2 FORMAT "%9.2" /end CHARACTERISTIC
/begin CHARACTERISTIC Cxx_tq_dif_degr_fac "Cxx_tq_dif_degr_fac" VALUE 0xa00222b0 _REC_S1VAL_Normal_u1 1. _CNV_R_R_VA_F_0v004_520_CM 0. 1. FORMAT "%9.3" /end CHARACTERISTIC
/begin CHARACTERISTIC Cxx_tq_dif_esti_tqe_fil "Cxx_tq_dif_esti_tqe_fil" VALUE 0xa00222ae _REC_S1VAL_Normal_u1 10.2 _CNV_R_R_VA_F_0v04__523_CM 0. 10.2 FORMAT "%9.2" /end CHARACTERISTIC
/begin CHARACTERISTIC Cxx_tq_dif_fil "Cxx_tq_dif_fil" VALUE 0xa00222af _REC_S1VAL_Normal_u1 10.2 _CNV_R_R_VA_F_0v04__523_CM 0. 10.2 FORMAT "%9.2" /end CHARACTERISTIC
/begin CHARACTERISTIC Cxx_whl_rad "Cxx_whl_rad" VALUE 0xa00222b1 _REC_S1VAL_Normal_u1 0.25 _CNV_R_R_VA_F_0v001_524_CM 0.2 0.45 FORMAT "%9.3" /end CHARACTERISTIC
/begin MEASUREMENT Vbx_aut_eng_mil "Boolean indicating that the engine is in autonomous functioning" UBYTE _CNV_S_2_RANGE______3_CM 1 0. 0. 1. ECU_ADDRESS 0xd0007c6b BIT_MASK 0x1 /end MEASUREMENT
/begin MEASUREMENT Vxx_mux_mil_req_1 "MIL ignition state requested by MUX encoding" UBYTE _CNV_A_R_ECME_LINEA_0_CM 1 0. 0. 3. ECU_ADDRESS 0xd0007c6c FORMAT "%1.0" /end MEASUREMENT
/begin MEASUREMENT Vxx_mux_mil_req_2 "Readiness state indication by MIL" UBYTE _CNV_A_R_ECME_LINEA_0_CM 1 0. 0. 3. ECU_ADDRESS 0xd0007c6d FORMAT "%1.0" /end MEASUREMENT
/begin MEASUREMENT Vxx_mux_test_mil_dly "Current delay before readiness status check" UBYTE _CNV_A_R_LINEAR_____58_CM 1 0. 0. 25.5 ECU_ADDRESS 0xd0007c6e FORMAT "%4.1" /end MEASUREMENT
/begin MEASUREMENT Vxx_mux_test_rdn_mil_dly "MIL flashing current delay when readiness are not completed" UBYTE _CNV_A_R_LINEAR_____58_CM 1 0. 0. 25.5 ECU_ADDRESS 0xd0007c6f FORMAT "%4.1" /end MEASUREMENT
/begin CHARACTERISTIC Cbx_mux_mil_cfm "MIL configuration" VALUE 0xa0021b07 _REC_S1VAL_20_u1 1. _CNV_S_2_RANGE______3_CM 0. 1. /end CHARACTERISTIC
/begin CHARACTERISTIC Cxx_mux_test_mil_dly "Delay before readiness status check" VALUE 0xa0021b08 _REC_S1VAL_20_u1 25.5 _CNV_A_R_LINEAR_____58_CM 0. 25.5 FORMAT "%4.1" /end CHARACTERISTIC
/begin CHARACTERISTIC Cxx_mux_test_rdn_mil_dly "MIL flashing delay when readiness are not completed" VALUE 0xa0021b09 _REC_S1VAL_20_u1 25.5 _CNV_A_R_LINEAR_____58_CM 0. 25.5 FORMAT "%4.1" /end CHARACTERISTIC
/begin MEASUREMENT Vsx_egb_n_lim_vld "Engine speed limitation requested by EGB (CVT,...) validity status" UBYTE _CNV_S_3_STATUS_OK__179_CM 1 0. 0. 2. ECU_ADDRESS 0xd0006cbb /end MEASUREMENT
/begin MEASUREMENT Vxx_egb_n_lim "Engine speed limitation requested by EGB (CVT,...)" UWORD _CNV_A_R_ENSD_LINEA_22_CM 1 0. 0. 16383.75 ECU_ADDRESS 0xd00043e8 FORMAT "%8.2" /end MEASUREMENT
/begin CHARACTERISTIC Cxx_max_n_egb_dft "Maximum engine Speed when engine speed limitation requested by EGB (CVT,...) is not valid" VALUE 0xa002162e _REC_S1VAL_20_u2 16383.75 _CNV_A_R_ENSD_LINEA_22_CM 0. 16383.75 FORMAT "%8.2" /end CHARACTERISTIC
/begin MEASUREMENT ctr_rst_fmy "Number of SV ASA erease performed" UBYTE _CNV_A_R_A_105_CM 1 0. 0. 255. DISPLAY_IDENTIFIER Asa_NVM.ctr_rst_fmy_NVM ECU_ADDRESS 0xd0006154 /end MEASUREMENT
/begin MEASUREMENT lv_reset_frf_asa "The after sale freeze frames have been reseted after the end of manufacturing line" UBYTE _CNV_S_2_RANGE______3_CM 1 0. 0. 1. DISPLAY_IDENTIFIER Asa_NVM.lv_reset_frf_asa_NVM ECU_ADDRESS 0xd0006155 /end MEASUREMENT
/begin MEASUREMENT lv_inh_frf[0] "Inhibition of after supplier freeze frames data" UBYTE _CNV_S_2_RANGE______3_CM 1 0. 0. 1. DISPLAY_IDENTIFIER Asa_NVM.lv_inh_frf_NVM[0] ECU_ADDRESS 0xd0006158 /end MEASUREMENT
/begin MEASUREMENT lv_inh_frf[1] "Inhibition of after supplier freeze frames data" UBYTE _CNV_S_2_RANGE______3_CM 1 0. 0. 1. DISPLAY_IDENTIFIER Asa_NVM.lv_inh_frf_NVM[1] ECU_ADDRESS 0xd0006159 /end MEASUREMENT
/begin MEASUREMENT lv_inh_frf[2] "Inhibition of after supplier freeze frames data" UBYTE _CNV_S_2_RANGE______3_CM 1 0. 0. 1. DISPLAY_IDENTIFIER Asa_NVM.lv_inh_frf_NVM[2] ECU_ADDRESS 0xd000615a /end MEASUREMENT
/begin MEASUREMENT lv_inh_frf[3] "Inhibition of after supplier freeze frames data" UBYTE _CNV_S_2_RANGE______3_CM 1 0. 0. 1. DISPLAY_IDENTIFIER Asa_NVM.lv_inh_frf_NVM[3] ECU_ADDRESS 0xd000615b /end MEASUREMENT
/begin CHARACTERISTIC Cxx_tac_nc_io_01 "Number of cycles to complete the I/O control test of gazoline electronic throttle" VALUE 0xa0036f68 _REC_S1VAL_Normal_u1 255. _CNV_R_R_VA_I_16_503_CM 0. 255. DISPLAY_IDENTIFIER Tac_cal_set_01.Cxx_tac_nc_io_xx FORMAT "%3.0" /end CHARACTERISTIC
/begin CHARACTERISTIC Cxx_tac_tini_io_01 "Initialization time for an I/O control test of gazoline electronic throttle" VALUE 0xa0036f54 _REC_S1VAL_Normal_u2 65.535 _CNV_R_R_nCcfksc_mn_525_CM 0. 65.535 DISPLAY_IDENTIFIER Tac_cal_set_01.Cxx_tac_tini_io_xx FORMAT "%5.3" /end CHARACTERISTIC
/begin CHARACTERISTIC Cxx_tac_tini_stac_01 "Initialization time for a static test of gazoline electronic throttle" VALUE 0xa0036f5a _REC_S1VAL_Normal_u2 65.535 _CNV_R_R_nCcfksc_mn_525_CM 0. 65.535 DISPLAY_IDENTIFIER Tac_cal_set_01.Cxx_tac_tini_stac_xx FORMAT "%5.3" /end CHARACTERISTIC
/begin CHARACTERISTIC Cxx_tac_toff_io_01 "Deactivation time for an I/O control test of gazoline electronic throttle" VALUE 0xa0036f58 _REC_S1VAL_Normal_u2 65.535 _CNV_R_R_nCcfksc_mn_525_CM 0. 65.535 DISPLAY_IDENTIFIER Tac_cal_set_01.Cxx_tac_toff_io_xx FORMAT "%5.3" /end CHARACTERISTIC
/begin CHARACTERISTIC Cxx_tac_toff_stac_01 "Deactivation time for a static test of gazoline electronic throttle" VALUE 0xa0036f5e _REC_S1VAL_Normal_u2 65.535 _CNV_R_R_nCcfksc_mn_525_CM 0. 65.535 DISPLAY_IDENTIFIER Tac_cal_set_01.Cxx_tac_toff_stac_xx FORMAT "%5.3" /end CHARACTERISTIC
/begin CHARACTERISTIC Cxx_tac_ton_io_01 "Activation time for an I/O control test of gazoline electronic throttle" VALUE 0xa0036f56 _REC_S1VAL_Normal_u2 65.535 _CNV_R_R_nCcfksc_mn_525_CM 0. 65.535 DISPLAY_IDENTIFIER Tac_cal_set_01.Cxx_tac_ton_io_xx FORMAT "%5.3" /end CHARACTERISTIC
/begin CHARACTERISTIC Cxx_tac_ton_stac_01 "Activation time for a static test of gazoline electronic throttle" VALUE 0xa0036f5c _REC_S1VAL_Normal_u2 65.535 _CNV_R_R_nCcfksc_mn_525_CM 0. 65.535 DISPLAY_IDENTIFIER Tac_cal_set_01.Cxx_tac_ton_stac_xx FORMAT "%5.3" /end CHARACTERISTIC
/begin CHARACTERISTIC Cxx_tac_voff_io_01 "Lower substitution value for an I/O control test of gazoline electronic throttle" VALUE 0xa0036f62 _REC_S1VAL_Normal_u2 200. _CNV_R_R_gBspFma_cr_526_CM 0. 200. DISPLAY_IDENTIFIER Tac_cal_set_01.Cxx_tac_voff_io_xx FORMAT "%6.2" /end CHARACTERISTIC
/begin CHARACTERISTIC Cxx_tac_voff_stac_01 "Lower substitution value for the static test of gazoline electronic throttle" VALUE 0xa0036f66 _REC_S1VAL_Normal_u2 200. _CNV_R_R_gBspFma_cr_526_CM 0. 200. DISPLAY_IDENTIFIER Tac_cal_set_01.Cxx_tac_voff_stac_xx FORMAT "%6.2" /end CHARACTERISTIC
/begin CHARACTERISTIC Cxx_tac_von_io_01 "Higher substitution value for an I/O control test of gazoline electronic throttle" VALUE 0xa0036f60 _REC_S1VAL_Normal_u2 200. _CNV_R_R_gBspFma_cr_526_CM 0. 200. DISPLAY_IDENTIFIER Tac_cal_set_01.Cxx_tac_von_io_xx FORMAT "%6.2" /end CHARACTERISTIC
/begin CHARACTERISTIC Cxx_tac_von_stac_01 "Higher substitution value for the static test of gazoline electronic throttle" VALUE 0xa0036f64 _REC_S1VAL_Normal_u2 200. _CNV_R_R_gBspFma_cr_526_CM 0. 200. DISPLAY_IDENTIFIER Tac_cal_set_01.Cxx_tac_von_stac_xx FORMAT "%6.2" /end CHARACTERISTIC
/begin CHARACTERISTIC Cxx_tac_nc_io_02 "Number of cycles to complete the I/O control test of fuel pump or its relay" VALUE 0xa0036f80 _REC_S1VAL_Normal_u1 255. _CNV_R_R_VA_I_16_503_CM 0. 255. DISPLAY_IDENTIFIER Tac_cal_set_02.Cxx_tac_nc_io_xx FORMAT "%3.0" /end CHARACTERISTIC
/begin CHARACTERISTIC Cxx_tac_tini_io_02 "Initialization time for an I/O control test of fuel pump and its relay" VALUE 0xa0036f6c _REC_S1VAL_Normal_u2 65.535 _CNV_R_R_nCcfksc_mn_525_CM 0. 65.535 DISPLAY_IDENTIFIER Tac_cal_set_02.Cxx_tac_tini_io_xx FORMAT "%5.3" /end CHARACTERISTIC
/begin CHARACTERISTIC Cxx_tac_tini_stac_02 "Initialization time for a static test of fuel pump and its relay" VALUE 0xa0036f72 _REC_S1VAL_Normal_u2 65.535 _CNV_R_R_nCcfksc_mn_525_CM 0. 65.535 DISPLAY_IDENTIFIER Tac_cal_set_02.Cxx_tac_tini_stac_xx FORMAT "%5.3" /end CHARACTERISTIC
/begin CHARACTERISTIC Cxx_tac_toff_io_02 "Deactivation time for an I/O control test of fuel pump and its relay" VALUE 0xa0036f70 _REC_S1VAL_Normal_u2 65.535 _CNV_R_R_nCcfksc_mn_525_CM 0. 65.535 DISPLAY_IDENTIFIER Tac_cal_set_02.Cxx_tac_toff_io_xx FORMAT "%5.3" /end CHARACTERISTIC
/begin CHARACTERISTIC Cxx_tac_toff_stac_02 "Deactivation time for a static test of fuel pump and its relay" VALUE 0xa0036f76 _REC_S1VAL_Normal_u2 65.535 _CNV_R_R_nCcfksc_mn_525_CM 0. 65.535 DISPLAY_IDENTIFIER Tac_cal_set_02.Cxx_tac_toff_stac_xx FORMAT "%5.3" /end CHARACTERISTIC
/begin CHARACTERISTIC Cxx_tac_ton_io_02 "Activation time for an I/O control test of fuel pump and its relay" VALUE 0xa0036f6e _REC_S1VAL_Normal_u2 65.535 _CNV_R_R_nCcfksc_mn_525_CM 0. 65.535 DISPLAY_IDENTIFIER Tac_cal_set_02.Cxx_tac_ton_io_xx FORMAT "%5.3" /end CHARACTERISTIC
/begin CHARACTERISTIC Cxx_tac_ton_stac_02 "Activation time for a static test of fuel pump and its relay" VALUE 0xa0036f74 _REC_S1VAL_Normal_u2 65.535 _CNV_R_R_nCcfksc_mn_525_CM 0. 65.535 DISPLAY_IDENTIFIER Tac_cal_set_02.Cxx_tac_ton_stac_xx FORMAT "%5.3" /end CHARACTERISTIC
/begin CHARACTERISTIC Cxx_tac_nc_io_03 "Number of cycles to complete the I/O control test of FAN1 or its relay" VALUE 0xa0036f98 _REC_S1VAL_Normal_u1 255. _CNV_R_R_VA_I_16_503_CM 0. 255. DISPLAY_IDENTIFIER Tac_cal_set_03.Cxx_tac_nc_io_xx FORMAT "%3.0" /end CHARACTERISTIC
/begin CHARACTERISTIC Cxx_tac_tini_io_03 "Initialization time for an I/O control test of FAN1 and its relay" VALUE 0xa0036f84 _REC_S1VAL_Normal_u2 65.535 _CNV_R_R_nCcfksc_mn_525_CM 0. 65.535 DISPLAY_IDENTIFIER Tac_cal_set_03.Cxx_tac_tini_io_xx FORMAT "%5.3" /end CHARACTERISTIC
/begin CHARACTERISTIC Cxx_tac_tini_stac_03 "Initialization time for a static test of FAN1 and its relay" VALUE 0xa0036f8a _REC_S1VAL_Normal_u2 65.535 _CNV_R_R_nCcfksc_mn_525_CM 0. 65.535 DISPLAY_IDENTIFIER Tac_cal_set_03.Cxx_tac_tini_stac_xx FORMAT "%5.3" /end CHARACTERISTIC
/begin CHARACTERISTIC Cxx_tac_toff_io_03 "Deactivation time for an I/O control test of FAN1 and its relay" VALUE 0xa0036f88 _REC_S1VAL_Normal_u2 65.535 _CNV_R_R_nCcfksc_mn_525_CM 0. 65.535 DISPLAY_IDENTIFIER Tac_cal_set_03.Cxx_tac_toff_io_xx FORMAT "%5.3" /end CHARACTERISTIC
/begin CHARACTERISTIC Cxx_tac_toff_stac_03 "Deactivation time for a static test of FAN1 and its relay" VALUE 0xa0036f8e _REC_S1VAL_Normal_u2 65.535 _CNV_R_R_nCcfksc_mn_525_CM 0. 65.535 DISPLAY_IDENTIFIER Tac_cal_set_03.Cxx_tac_toff_stac_xx FORMAT "%5.3" /end CHARACTERISTIC
/begin CHARACTERISTIC Cxx_tac_ton_io_03 "Activation time for an I/O control test of FAN1 and its relay" VALUE 0xa0036f86 _REC_S1VAL_Normal_u2 65.535 _CNV_R_R_nCcfksc_mn_525_CM 0. 65.535 DISPLAY_IDENTIFIER Tac_cal_set_03.Cxx_tac_ton_io_xx FORMAT "%5.3" /end CHARACTERISTIC
/begin CHARACTERISTIC Cxx_tac_ton_stac_03 "Activation time for a static test of FAN1 and its relay" VALUE 0xa0036f8c _REC_S1VAL_Normal_u2 65.535 _CNV_R_R_nCcfksc_mn_525_CM 0. 65.535 DISPLAY_IDENTIFIER Tac_cal_set_03.Cxx_tac_ton_stac_xx FORMAT "%5.3" /end CHARACTERISTIC
/begin CHARACTERISTIC Cxx_tac_nc_io_04 "Number of cycles to complete the I/O control test of FAN2 or its relay" VALUE 0xa0036fb0 _REC_S1VAL_Normal_u1 255. _CNV_R_R_VA_I_16_503_CM 0. 255. DISPLAY_IDENTIFIER Tac_cal_set_04.Cxx_tac_nc_io_xx FORMAT "%3.0" /end CHARACTERISTIC
/begin CHARACTERISTIC Cxx_tac_tini_io_04 "Initialization time for an I/O control test of FAN2 and its relay" VALUE 0xa0036f9c _REC_S1VAL_Normal_u2 65.535 _CNV_R_R_nCcfksc_mn_525_CM 0. 65.535 DISPLAY_IDENTIFIER Tac_cal_set_04.Cxx_tac_tini_io_xx FORMAT "%5.3" /end CHARACTERISTIC
/begin CHARACTERISTIC Cxx_tac_tini_stac_04 "Initialization time for a static test of FAN2 and its relay" VALUE 0xa0036fa2 _REC_S1VAL_Normal_u2 65.535 _CNV_R_R_nCcfksc_mn_525_CM 0. 65.535 DISPLAY_IDENTIFIER Tac_cal_set_04.Cxx_tac_tini_stac_xx FORMAT "%5.3" /end CHARACTERISTIC
/begin CHARACTERISTIC Cxx_tac_toff_io_04 "Deactivation time for an I/O control test of FAN2 and its relay" VALUE 0xa0036fa0 _REC_S1VAL_Normal_u2 65.535 _CNV_R_R_nCcfksc_mn_525_CM 0. 65.535 DISPLAY_IDENTIFIER Tac_cal_set_04.Cxx_tac_toff_io_xx FORMAT "%5.3" /end CHARACTERISTIC
/begin CHARACTERISTIC Cxx_tac_toff_stac_04 "Deactivation time for a static test of FAN2 and its relay" VALUE 0xa0036fa6 _REC_S1VAL_Normal_u2 65.535 _CNV_R_R_nCcfksc_mn_525_CM 0. 65.535 DISPLAY_IDENTIFIER Tac_cal_set_04.Cxx_tac_toff_stac_xx FORMAT "%5.3" /end CHARACTERISTIC
/begin CHARACTERISTIC Cxx_tac_ton_io_04 "Activation time for an I/O control test of FAN2 and its relay" VALUE 0xa0036f9e _REC_S1VAL_Normal_u2 65.535 _CNV_R_R_nCcfksc_mn_525_CM 0. 65.535 DISPLAY_IDENTIFIER Tac_cal_set_04.Cxx_tac_ton_io_xx FORMAT "%5.3" /end CHARACTERISTIC
/begin CHARACTERISTIC Cxx_tac_ton_stac_04 "Activation time for a static test of FAN2 and its relay" VALUE 0xa0036fa4 _REC_S1VAL_Normal_u2 65.535 _CNV_R_R_nCcfksc_mn_525_CM 0. 65.535 DISPLAY_IDENTIFIER Tac_cal_set_04.Cxx_tac_ton_stac_xx FORMAT "%5.3" /end CHARACTERISTIC
/begin CHARACTERISTIC Cxx_tac_nc_io_05 "Number of cycles to complete the I/O control test of electronic water pump for turbocharger cooling" VALUE 0xa0036fc8 _REC_S1VAL_Normal_u1 255. _CNV_R_R_VA_I_16_503_CM 0. 255. DISPLAY_IDENTIFIER Tac_cal_set_05.Cxx_tac_nc_io_xx FORMAT "%3.0" /end CHARACTERISTIC
/begin CHARACTERISTIC Cxx_tac_tini_io_05 "Initialization time for an I/O control test of electronic water pump for turbocharger cooling" VALUE 0xa0036fb4 _REC_S1VAL_Normal_u2 65.535 _CNV_R_R_nCcfksc_mn_525_CM 0. 65.535 DISPLAY_IDENTIFIER Tac_cal_set_05.Cxx_tac_tini_io_xx FORMAT "%5.3" /end CHARACTERISTIC
/begin CHARACTERISTIC Cxx_tac_tini_stac_05 "Initialization time for a static test of electronic water pump for turbocharger cooling" VALUE 0xa0036fba _REC_S1VAL_Normal_u2 65.535 _CNV_R_R_nCcfksc_mn_525_CM 0. 65.535 DISPLAY_IDENTIFIER Tac_cal_set_05.Cxx_tac_tini_stac_xx FORMAT "%5.3" /end CHARACTERISTIC
/begin CHARACTERISTIC Cxx_tac_toff_io_05 "Deactivation time for an I/O control test of electronic water pump for turbocharger cooling" VALUE 0xa0036fb8 _REC_S1VAL_Normal_u2 65.535 _CNV_R_R_nCcfksc_mn_525_CM 0. 65.535 DISPLAY_IDENTIFIER Tac_cal_set_05.Cxx_tac_toff_io_xx FORMAT "%5.3" /end CHARACTERISTIC
/begin CHARACTERISTIC Cxx_tac_toff_stac_05 "Deactivation time for a static test of electronic water pump for turbocharger cooling" VALUE 0xa0036fbe _REC_S1VAL_Normal_u2 65.535 _CNV_R_R_nCcfksc_mn_525_CM 0. 65.535 DISPLAY_IDENTIFIER Tac_cal_set_05.Cxx_tac_toff_stac_xx FORMAT "%5.3" /end CHARACTERISTIC
/begin CHARACTERISTIC Cxx_tac_ton_io_05 "Activation time for an I/O control test of electronic water pump for turbocharger cooling" VALUE 0xa0036fb6 _REC_S1VAL_Normal_u2 65.535 _CNV_R_R_nCcfksc_mn_525_CM 0. 65.535 DISPLAY_IDENTIFIER Tac_cal_set_05.Cxx_tac_ton_io_xx FORMAT "%5.3" /end CHARACTERISTIC
/begin CHARACTERISTIC Cxx_tac_ton_stac_05 "Activation time for a static test of electronic water pump for turbocharger cooling" VALUE 0xa0036fbc _REC_S1VAL_Normal_u2 65.535 _CNV_R_R_nCcfksc_mn_525_CM 0. 65.535 DISPLAY_IDENTIFIER Tac_cal_set_05.Cxx_tac_ton_stac_xx FORMAT "%5.3" /end CHARACTERISTIC
/begin CHARACTERISTIC Cxx_tac_nc_io_06 "Number of cycles to complete the I/O control test of defrosting PTC" VALUE 0xa0036fe0 _REC_S1VAL_Normal_u1 255. _CNV_R_R_VA_I_16_503_CM 0. 255. DISPLAY_IDENTIFIER Tac_cal_set_06.Cxx_tac_nc_io_xx FORMAT "%3.0" /end CHARACTERISTIC
/begin CHARACTERISTIC Cxx_tac_tini_io_06 "Initialization time for an I/O control test of defrosting PTC" VALUE 0xa0036fcc _REC_S1VAL_Normal_u2 65.535 _CNV_R_R_nCcfksc_mn_525_CM 0. 65.535 DISPLAY_IDENTIFIER Tac_cal_set_06.Cxx_tac_tini_io_xx FORMAT "%5.3" /end CHARACTERISTIC
/begin CHARACTERISTIC Cxx_tac_tini_stac_06 "Initialization time for a static test of defrosting PTC" VALUE 0xa0036fd2 _REC_S1VAL_Normal_u2 65.535 _CNV_R_R_nCcfksc_mn_525_CM 0. 65.535 DISPLAY_IDENTIFIER Tac_cal_set_06.Cxx_tac_tini_stac_xx FORMAT "%5.3" /end CHARACTERISTIC
/begin CHARACTERISTIC Cxx_tac_toff_io_06 "Deactivation time for an I/O control test of defrosting PTC" VALUE 0xa0036fd0 _REC_S1VAL_Normal_u2 65.535 _CNV_R_R_nCcfksc_mn_525_CM 0. 65.535 DISPLAY_IDENTIFIER Tac_cal_set_06.Cxx_tac_toff_io_xx FORMAT "%5.3" /end CHARACTERISTIC
/begin CHARACTERISTIC Cxx_tac_toff_stac_06 "Deactivation time for a static test of defrosting PTC" VALUE 0xa0036fd6 _REC_S1VAL_Normal_u2 65.535 _CNV_R_R_nCcfksc_mn_525_CM 0. 65.535 DISPLAY_IDENTIFIER Tac_cal_set_06.Cxx_tac_toff_stac_xx FORMAT "%5.3" /end CHARACTERISTIC
/begin CHARACTERISTIC Cxx_tac_ton_io_06 "Activation time for an I/O control test of defrosting PTC" VALUE 0xa0036fce _REC_S1VAL_Normal_u2 65.535 _CNV_R_R_nCcfksc_mn_525_CM 0. 65.535 DISPLAY_IDENTIFIER Tac_cal_set_06.Cxx_tac_ton_io_xx FORMAT "%5.3" /end CHARACTERISTIC
/begin CHARACTERISTIC Cxx_tac_ton_stac_06 "Activation time for a static test of defrosting PTC" VALUE 0xa0036fd4 _REC_S1VAL_Normal_u2 65.535 _CNV_R_R_nCcfksc_mn_525_CM 0. 65.535 DISPLAY_IDENTIFIER Tac_cal_set_06.Cxx_tac_ton_stac_xx FORMAT "%5.3" /end CHARACTERISTIC
/begin CHARACTERISTIC Cxx_tac_nc_io_07 "Number of cycles to complete the I/O control test of VVT control solenoid" VALUE 0xa0036ff8 _REC_S1VAL_Normal_u1 255. _CNV_R_R_VA_I_16_503_CM 0. 255. DISPLAY_IDENTIFIER Tac_cal_set_07.Cxx_tac_nc_io_xx FORMAT "%3.0" /end CHARACTERISTIC
/begin CHARACTERISTIC Cxx_tac_tini_io_07 "Initialization time for an I/O control test of VVT control solenoid" VALUE 0xa0036fe4 _REC_S1VAL_Normal_u2 65.535 _CNV_R_R_nCcfksc_mn_525_CM 0. 65.535 DISPLAY_IDENTIFIER Tac_cal_set_07.Cxx_tac_tini_io_xx FORMAT "%5.3" /end CHARACTERISTIC
/begin CHARACTERISTIC Cxx_tac_tini_stac_07 "Initialization time for a static test of VVT control solenoid" VALUE 0xa0036fea _REC_S1VAL_Normal_u2 65.535 _CNV_R_R_nCcfksc_mn_525_CM 0. 65.535 DISPLAY_IDENTIFIER Tac_cal_set_07.Cxx_tac_tini_stac_xx FORMAT "%5.3" /end CHARACTERISTIC
/begin CHARACTERISTIC Cxx_tac_toff_io_07 "Deactivation time for an I/O control test of VVT control solenoid" VALUE 0xa0036fe8 _REC_S1VAL_Normal_u2 65.535 _CNV_R_R_nCcfksc_mn_525_CM 0. 65.535 DISPLAY_IDENTIFIER Tac_cal_set_07.Cxx_tac_toff_io_xx FORMAT "%5.3" /end CHARACTERISTIC
/begin CHARACTERISTIC Cxx_tac_toff_stac_07 "Deactivation time for a static test of VVT control solenoid" VALUE 0xa0036fee _REC_S1VAL_Normal_u2 65.535 _CNV_R_R_nCcfksc_mn_525_CM 0. 65.535 DISPLAY_IDENTIFIER Tac_cal_set_07.Cxx_tac_toff_stac_xx FORMAT "%5.3" /end CHARACTERISTIC
/begin CHARACTERISTIC Cxx_tac_ton_io_07 "Activation time for an I/O control test of VVT control solenoid" VALUE 0xa0036fe6 _REC_S1VAL_Normal_u2 65.535 _CNV_R_R_nCcfksc_mn_525_CM 0. 65.535 DISPLAY_IDENTIFIER Tac_cal_set_07.Cxx_tac_ton_io_xx FORMAT "%5.3" /end CHARACTERISTIC
/begin CHARACTERISTIC Cxx_tac_ton_stac_07 "Activation time for a static test of VVT control solenoid" VALUE 0xa0036fec _REC_S1VAL_Normal_u2 65.535 _CNV_R_R_nCcfksc_mn_525_CM 0. 65.535 DISPLAY_IDENTIFIER Tac_cal_set_07.Cxx_tac_ton_stac_xx FORMAT "%5.3" /end CHARACTERISTIC
/begin CHARACTERISTIC Cxx_tac_voff_io_07 "Lower substitution value for an I/O control test of VVT control solenoid" VALUE 0xa0036ff2 _REC_S1VAL_Normal_u2 200. _CNV_R_R_gBspFma_cr_526_CM 0. 200. DISPLAY_IDENTIFIER Tac_cal_set_07.Cxx_tac_voff_io_xx FORMAT "%6.2" /end CHARACTERISTIC
/begin CHARACTERISTIC Cxx_tac_voff_stac_07 "Lower substitution value for the static test of VVT control solenoid" VALUE 0xa0036ff6 _REC_S1VAL_Normal_u2 200. _CNV_R_R_gBspFma_cr_526_CM 0. 200. DISPLAY_IDENTIFIER Tac_cal_set_07.Cxx_tac_voff_stac_xx FORMAT "%6.2" /end CHARACTERISTIC
/begin CHARACTERISTIC Cxx_tac_von_io_07 "Higher substitution value for an I/O control test of VVT control solenoid" VALUE 0xa0036ff0 _REC_S1VAL_Normal_u2 200. _CNV_R_R_gBspFma_cr_526_CM 0. 200. DISPLAY_IDENTIFIER Tac_cal_set_07.Cxx_tac_von_io_xx FORMAT "%6.2" /end CHARACTERISTIC
/begin CHARACTERISTIC Cxx_tac_von_stac_07 "Higher substitution value for the static test of VVT control solenoid" VALUE 0xa0036ff4 _REC_S1VAL_Normal_u2 200. _CNV_R_R_gBspFma_cr_526_CM 0. 200. DISPLAY_IDENTIFIER Tac_cal_set_07.Cxx_tac_von_stac_xx FORMAT "%6.2" /end CHARACTERISTIC
/begin CHARACTERISTIC Cxx_tac_nc_io_08 "Number of cycles to complete the I/O control test of gazoline turbocharger command valve" VALUE 0xa0037010 _REC_S1VAL_Normal_u1 255. _CNV_R_R_VA_I_16_503_CM 0. 255. DISPLAY_IDENTIFIER Tac_cal_set_08.Cxx_tac_nc_io_xx FORMAT "%3.0" /end CHARACTERISTIC
/begin CHARACTERISTIC Cxx_tac_tini_io_08 "Initialization time for an I/O control test of gazoline turbocharger command valve" VALUE 0xa0036ffc _REC_S1VAL_Normal_u2 65.535 _CNV_R_R_nCcfksc_mn_525_CM 0. 65.535 DISPLAY_IDENTIFIER Tac_cal_set_08.Cxx_tac_tini_io_xx FORMAT "%5.3" /end CHARACTERISTIC
/begin CHARACTERISTIC Cxx_tac_tini_stac_08 "Initialization time for a static test of gazoline turbocharger command valve" VALUE 0xa0037002 _REC_S1VAL_Normal_u2 65.535 _CNV_R_R_nCcfksc_mn_525_CM 0. 65.535 DISPLAY_IDENTIFIER Tac_cal_set_08.Cxx_tac_tini_stac_xx FORMAT "%5.3" /end CHARACTERISTIC
/begin CHARACTERISTIC Cxx_tac_toff_io_08 "Deactivation time for an I/O control test of gazoline turbocharger command valve" VALUE 0xa0037000 _REC_S1VAL_Normal_u2 65.535 _CNV_R_R_nCcfksc_mn_525_CM 0. 65.535 DISPLAY_IDENTIFIER Tac_cal_set_08.Cxx_tac_toff_io_xx FORMAT "%5.3" /end CHARACTERISTIC
/begin CHARACTERISTIC Cxx_tac_toff_stac_08 "Deactivation time for a static test of gazoline turbocharger command valve" VALUE 0xa0037006 _REC_S1VAL_Normal_u2 65.535 _CNV_R_R_nCcfksc_mn_525_CM 0. 65.535 DISPLAY_IDENTIFIER Tac_cal_set_08.Cxx_tac_toff_stac_xx FORMAT "%5.3" /end CHARACTERISTIC
/begin CHARACTERISTIC Cxx_tac_ton_io_08 "Activation time for an I/O control test of gazoline turbocharger command valve" VALUE 0xa0036ffe _REC_S1VAL_Normal_u2 65.535 _CNV_R_R_nCcfksc_mn_525_CM 0. 65.535 DISPLAY_IDENTIFIER Tac_cal_set_08.Cxx_tac_ton_io_xx FORMAT "%5.3" /end CHARACTERISTIC
/begin CHARACTERISTIC Cxx_tac_ton_stac_08 "Activation time for a static test of gazoline turbocharger command valve" VALUE 0xa0037004 _REC_S1VAL_Normal_u2 65.535 _CNV_R_R_nCcfksc_mn_525_CM 0. 65.535 DISPLAY_IDENTIFIER Tac_cal_set_08.Cxx_tac_ton_stac_xx FORMAT "%5.3" /end CHARACTERISTIC
/begin CHARACTERISTIC Cxx_tac_voff_io_08 "Lower substitution value for an I/O control test of gazoline turbocharger command valve" VALUE 0xa003700a _REC_S1VAL_Normal_u2 100. _CNV_R_R_xytAqxd_qA_527_CM 0. 100. DISPLAY_IDENTIFIER Tac_cal_set_08.Cxx_tac_voff_io_xx FORMAT "%6.2" /end CHARACTERISTIC
/begin CHARACTERISTIC Cxx_tac_voff_stac_08 "Lower substitution value for the static test of gazoline turbocharger command valve" VALUE 0xa003700e _REC_S1VAL_Normal_u2 100. _CNV_R_R_xytAqxd_qA_527_CM 0. 100. DISPLAY_IDENTIFIER Tac_cal_set_08.Cxx_tac_voff_stac_xx FORMAT "%6.2" /end CHARACTERISTIC
/begin CHARACTERISTIC Cxx_tac_von_io_08 "Higher substitution value for an I/O control test of gazoline turbocharger command valve" VALUE 0xa0037008 _REC_S1VAL_Normal_u2 100. _CNV_R_R_xytAqxd_qA_527_CM 0. 100. DISPLAY_IDENTIFIER Tac_cal_set_08.Cxx_tac_von_io_xx FORMAT "%6.2" /end CHARACTERISTIC
/begin CHARACTERISTIC Cxx_tac_von_stac_08 "Higher substitution value for the static test of gazoline turbocharger command valve" VALUE 0xa003700c _REC_S1VAL_Normal_u2 100. _CNV_R_R_xytAqxd_qA_527_CM 0. 100. DISPLAY_IDENTIFIER Tac_cal_set_08.Cxx_tac_von_stac_xx FORMAT "%6.2" /end CHARACTERISTIC
/begin CHARACTERISTIC Cxx_tac_nc_io_09 "Number of cycles to complete the I/O control test of upstream oxygen lamda sensor (heater)" VALUE 0xa0037028 _REC_S1VAL_Normal_u1 255. _CNV_R_R_VA_I_16_503_CM 0. 255. DISPLAY_IDENTIFIER Tac_cal_set_09.Cxx_tac_nc_io_xx FORMAT "%3.0" /end CHARACTERISTIC
/begin CHARACTERISTIC Cxx_tac_tini_io_09 "Initialization time for an I/O control test of upstream oxygen lamda sensor (heater)" VALUE 0xa0037014 _REC_S1VAL_Normal_u2 65.535 _CNV_R_R_nCcfksc_mn_525_CM 0. 65.535 DISPLAY_IDENTIFIER Tac_cal_set_09.Cxx_tac_tini_io_xx FORMAT "%5.3" /end CHARACTERISTIC
/begin CHARACTERISTIC Cxx_tac_tini_stac_09 "Initialization time for a static test of upstream oxygen lamda sensor (heater)" VALUE 0xa003701a _REC_S1VAL_Normal_u2 65.535 _CNV_R_R_nCcfksc_mn_525_CM 0. 65.535 DISPLAY_IDENTIFIER Tac_cal_set_09.Cxx_tac_tini_stac_xx FORMAT "%5.3" /end CHARACTERISTIC
/begin CHARACTERISTIC Cxx_tac_toff_io_09 "Deactivation time for an I/O control test of upstream oxygen lamda sensor (heater)" VALUE 0xa0037018 _REC_S1VAL_Normal_u2 65.535 _CNV_R_R_nCcfksc_mn_525_CM 0. 65.535 DISPLAY_IDENTIFIER Tac_cal_set_09.Cxx_tac_toff_io_xx FORMAT "%5.3" /end CHARACTERISTIC
/begin CHARACTERISTIC Cxx_tac_toff_stac_09 "Deactivation time for a static test of upstream oxygen lamda sensor (heater)" VALUE 0xa003701e _REC_S1VAL_Normal_u2 65.535 _CNV_R_R_nCcfksc_mn_525_CM 0. 65.535 DISPLAY_IDENTIFIER Tac_cal_set_09.Cxx_tac_toff_stac_xx FORMAT "%5.3" /end CHARACTERISTIC
/begin CHARACTERISTIC Cxx_tac_ton_io_09 "Activation time for an I/O control test of upstream oxygen lamda sensor (heater)" VALUE 0xa0037016 _REC_S1VAL_Normal_u2 65.535 _CNV_R_R_nCcfksc_mn_525_CM 0. 65.535 DISPLAY_IDENTIFIER Tac_cal_set_09.Cxx_tac_ton_io_xx FORMAT "%5.3" /end CHARACTERISTIC
/begin CHARACTERISTIC Cxx_tac_ton_stac_09 "Activation time for a static test of upstream oxygen lamda sensor (heater)" VALUE 0xa003701c _REC_S1VAL_Normal_u2 65.535 _CNV_R_R_nCcfksc_mn_525_CM 0. 65.535 DISPLAY_IDENTIFIER Tac_cal_set_09.Cxx_tac_ton_stac_xx FORMAT "%5.3" /end CHARACTERISTIC
/begin CHARACTERISTIC Cxx_tac_voff_io_09 "Lower substitution value for an I/O control test of upstream oxygen lamda sensor (heater)" VALUE 0xa0037022 _REC_S1VAL_Normal_u2 100. _CNV_R_R_xytAqxd_qA_527_CM 0. 100. DISPLAY_IDENTIFIER Tac_cal_set_09.Cxx_tac_voff_io_xx FORMAT "%6.2" /end CHARACTERISTIC
/begin CHARACTERISTIC Cxx_tac_voff_stac_09 "Lower substitution value for the static test of upstream oxygen lamda sensor (heater)" VALUE 0xa0037026 _REC_S1VAL_Normal_u2 100. _CNV_R_R_xytAqxd_qA_527_CM 0. 100. DISPLAY_IDENTIFIER Tac_cal_set_09.Cxx_tac_voff_stac_xx FORMAT "%6.2" /end CHARACTERISTIC
/begin CHARACTERISTIC Cxx_tac_von_io_09 "Higher substitution value for an I/O control test of upstream oxygen lambda sensor (heater)" VALUE 0xa0037020 _REC_S1VAL_Normal_u2 100. _CNV_R_R_xytAqxd_qA_527_CM 0. 100. DISPLAY_IDENTIFIER Tac_cal_set_09.Cxx_tac_von_io_xx FORMAT "%6.2" /end CHARACTERISTIC
/begin CHARACTERISTIC Cxx_tac_von_stac_09 "Higher substitution value for the static test of upstream oxygen lamda sensor (heater)" VALUE 0xa0037024 _REC_S1VAL_Normal_u2 100. _CNV_R_R_xytAqxd_qA_527_CM 0. 100. DISPLAY_IDENTIFIER Tac_cal_set_09.Cxx_tac_von_stac_xx FORMAT "%6.2" /end CHARACTERISTIC
/begin CHARACTERISTIC Cxx_tac_nc_io_10 "Number of cycles to complete the I/O control test of downstream oxygen lamda sensor (heater)" VALUE 0xa0037040 _REC_S1VAL_Normal_u1 255. _CNV_R_R_VA_I_16_503_CM 0. 255. DISPLAY_IDENTIFIER Tac_cal_set_10.Cxx_tac_nc_io_xx FORMAT "%3.0" /end CHARACTERISTIC
/begin CHARACTERISTIC Cxx_tac_tini_io_10 "Initialization time for an I/O control test of downstream oxygen lamda sensor (heater)" VALUE 0xa003702c _REC_S1VAL_Normal_u2 65.535 _CNV_R_R_nCcfksc_mn_525_CM 0. 65.535 DISPLAY_IDENTIFIER Tac_cal_set_10.Cxx_tac_tini_io_xx FORMAT "%5.3" /end CHARACTERISTIC
/begin CHARACTERISTIC Cxx_tac_tini_stac_10 "Initialization time for a static test of downstream oxygen lamda sensor (heater)" VALUE 0xa0037032 _REC_S1VAL_Normal_u2 65.535 _CNV_R_R_nCcfksc_mn_525_CM 0. 65.535 DISPLAY_IDENTIFIER Tac_cal_set_10.Cxx_tac_tini_stac_xx FORMAT "%5.3" /end CHARACTERISTIC
/begin CHARACTERISTIC Cxx_tac_toff_io_10 "Deactivation time for an I/O control test of downstream oxygen lamda sensor (heater)" VALUE 0xa0037030 _REC_S1VAL_Normal_u2 65.535 _CNV_R_R_nCcfksc_mn_525_CM 0. 65.535 DISPLAY_IDENTIFIER Tac_cal_set_10.Cxx_tac_toff_io_xx FORMAT "%5.3" /end CHARACTERISTIC
/begin CHARACTERISTIC Cxx_tac_toff_stac_10 "Deactivation time for a static test of downstream oxygen lamda sensor (heater)" VALUE 0xa0037036 _REC_S1VAL_Normal_u2 65.535 _CNV_R_R_nCcfksc_mn_525_CM 0. 65.535 DISPLAY_IDENTIFIER Tac_cal_set_10.Cxx_tac_toff_stac_xx FORMAT "%5.3" /end CHARACTERISTIC
/begin CHARACTERISTIC Cxx_tac_ton_io_10 "Activation time for an I/O control test of downstream oxygen lamda sensor (heater)" VALUE 0xa003702e _REC_S1VAL_Normal_u2 65.535 _CNV_R_R_nCcfksc_mn_525_CM 0. 65.535 DISPLAY_IDENTIFIER Tac_cal_set_10.Cxx_tac_ton_io_xx FORMAT "%5.3" /end CHARACTERISTIC
/begin CHARACTERISTIC Cxx_tac_ton_stac_10 "Activation time for a static test of downstream oxygen lamda sensor (heater)" VALUE 0xa0037034 _REC_S1VAL_Normal_u2 65.535 _CNV_R_R_nCcfksc_mn_525_CM 0. 65.535 DISPLAY_IDENTIFIER Tac_cal_set_10.Cxx_tac_ton_stac_xx FORMAT "%5.3" /end CHARACTERISTIC
/begin CHARACTERISTIC Cxx_tac_voff_io_10 "Lower substitution value for an I/O control test of downstream oxygen lamda sensor (heater)" VALUE 0xa003703a _REC_S1VAL_Normal_u2 100. _CNV_R_R_xytAqxd_qA_527_CM 0. 100. DISPLAY_IDENTIFIER Tac_cal_set_10.Cxx_tac_voff_io_xx FORMAT "%6.2" /end CHARACTERISTIC
/begin CHARACTERISTIC Cxx_tac_voff_stac_10 "Lower substitution value for the static test of downstream oxygen lamda sensor (heater)" VALUE 0xa003703e _REC_S1VAL_Normal_u2 100. _CNV_R_R_xytAqxd_qA_527_CM 0. 100. DISPLAY_IDENTIFIER Tac_cal_set_10.Cxx_tac_voff_stac_xx FORMAT "%6.2" /end CHARACTERISTIC
/begin CHARACTERISTIC Cxx_tac_von_io_10 "Higher substitution value for an I/O control test of downstream oxygen lamda sensor (heater)" VALUE 0xa0037038 _REC_S1VAL_Normal_u2 100. _CNV_R_R_xytAqxd_qA_527_CM 0. 100. DISPLAY_IDENTIFIER Tac_cal_set_10.Cxx_tac_von_io_xx FORMAT "%6.2" /end CHARACTERISTIC
/begin CHARACTERISTIC Cxx_tac_von_stac_10 "Higher substitution value for the static test of downstream oxygen lamda sensor (heater)" VALUE 0xa003703c _REC_S1VAL_Normal_u2 100. _CNV_R_R_xytAqxd_qA_527_CM 0. 100. DISPLAY_IDENTIFIER Tac_cal_set_10.Cxx_tac_von_stac_xx FORMAT "%6.2" /end CHARACTERISTIC
/begin CHARACTERISTIC Cxx_tac_nc_io_20 "Number of cycles to complete the I/O control test of canister drain valve" VALUE 0xa0037058 _REC_S1VAL_Normal_u1 255. _CNV_R_R_VA_I_16_503_CM 0. 255. DISPLAY_IDENTIFIER Tac_cal_set_20.Cxx_tac_nc_io_xx FORMAT "%3.0" /end CHARACTERISTIC
/begin CHARACTERISTIC Cxx_tac_tini_io_20 "Initialization time for an I/O control test of canister drain valve" VALUE 0xa0037044 _REC_S1VAL_Normal_u2 65.535 _CNV_R_R_nCcfksc_mn_525_CM 0. 65.535 DISPLAY_IDENTIFIER Tac_cal_set_20.Cxx_tac_tini_io_xx FORMAT "%5.3" /end CHARACTERISTIC
/begin CHARACTERISTIC Cxx_tac_tini_stac_20 "Initialization time for a static test of canister drain valve" VALUE 0xa003704a _REC_S1VAL_Normal_u2 65.535 _CNV_R_R_nCcfksc_mn_525_CM 0. 65.535 DISPLAY_IDENTIFIER Tac_cal_set_20.Cxx_tac_tini_stac_xx FORMAT "%5.3" /end CHARACTERISTIC
/begin CHARACTERISTIC Cxx_tac_toff_io_20 "Deactivation time for an I/O control test of canister drain valve" VALUE 0xa0037048 _REC_S1VAL_Normal_u2 65.535 _CNV_R_R_nCcfksc_mn_525_CM 0. 65.535 DISPLAY_IDENTIFIER Tac_cal_set_20.Cxx_tac_toff_io_xx FORMAT "%5.3" /end CHARACTERISTIC
/begin CHARACTERISTIC Cxx_tac_toff_stac_20 "Deactivation time for a static test of canister drain valve" VALUE 0xa003704e _REC_S1VAL_Normal_u2 65.535 _CNV_R_R_nCcfksc_mn_525_CM 0. 65.535 DISPLAY_IDENTIFIER Tac_cal_set_20.Cxx_tac_toff_stac_xx FORMAT "%5.3" /end CHARACTERISTIC
/begin CHARACTERISTIC Cxx_tac_ton_io_20 "Activation time for an I/O control test of canister drain valve" VALUE 0xa0037046 _REC_S1VAL_Normal_u2 65.535 _CNV_R_R_nCcfksc_mn_525_CM 0. 65.535 DISPLAY_IDENTIFIER Tac_cal_set_20.Cxx_tac_ton_io_xx FORMAT "%5.3" /end CHARACTERISTIC
/begin CHARACTERISTIC Cxx_tac_ton_stac_20 "Activation time for a static test of canister drain valve" VALUE 0xa003704c _REC_S1VAL_Normal_u2 65.535 _CNV_R_R_nCcfksc_mn_525_CM 0. 65.535 DISPLAY_IDENTIFIER Tac_cal_set_20.Cxx_tac_ton_stac_xx FORMAT "%5.3" /end CHARACTERISTIC
/begin CHARACTERISTIC Cxx_tac_voff_io_20 "Lower substitution value for an I/O control test of canister drain valve" VALUE 0xa0037052 _REC_S1VAL_Normal_u2 100. _CNV_R_R_Edjqxvd_mq_528_CM 0. 100. DISPLAY_IDENTIFIER Tac_cal_set_20.Cxx_tac_voff_io_xx FORMAT "%6.2" /end CHARACTERISTIC
/begin CHARACTERISTIC Cxx_tac_voff_stac_20 "Lower substitution value for the static test of canister drain valve" VALUE 0xa0037056 _REC_S1VAL_Normal_u2 100. _CNV_R_R_Edjqxvd_mq_528_CM 0. 100. DISPLAY_IDENTIFIER Tac_cal_set_20.Cxx_tac_voff_stac_xx FORMAT "%6.2" /end CHARACTERISTIC
/begin CHARACTERISTIC Cxx_tac_von_io_20 "Higher substitution value for an I/O control test of canister drain valve" VALUE 0xa0037050 _REC_S1VAL_Normal_u2 100. _CNV_R_R_Edjqxvd_mq_528_CM 0. 100. DISPLAY_IDENTIFIER Tac_cal_set_20.Cxx_tac_von_io_xx FORMAT "%6.2" /end CHARACTERISTIC
/begin CHARACTERISTIC Cxx_tac_von_stac_20 "Higher substitution value for the static test of canister drain valve" VALUE 0xa0037054 _REC_S1VAL_Normal_u2 100. _CNV_R_R_Edjqxvd_mq_528_CM 0. 100. DISPLAY_IDENTIFIER Tac_cal_set_20.Cxx_tac_von_stac_xx FORMAT "%6.2" /end CHARACTERISTIC
/begin CHARACTERISTIC Cxx_tac_nc_io_49 "Number of cycles to complete the I/O control test of additional tank pump" VALUE 0xa0037070 _REC_S1VAL_Normal_u1 255. _CNV_R_R_VA_I_16_503_CM 0. 255. DISPLAY_IDENTIFIER Tac_cal_set_49.Cxx_tac_nc_io_xx FORMAT "%3.0" /end CHARACTERISTIC
/begin CHARACTERISTIC Cxx_tac_tini_io_49 "Initialization time for an I/O control test of additional tank pump" VALUE 0xa003705c _REC_S1VAL_Normal_u2 65.535 _CNV_R_R_nCcfksc_mn_525_CM 0. 65.535 DISPLAY_IDENTIFIER Tac_cal_set_49.Cxx_tac_tini_io_xx FORMAT "%5.3" /end CHARACTERISTIC
/begin CHARACTERISTIC Cxx_tac_tini_stac_49 "Initialization time for a static test of additional tank pump" VALUE 0xa0037062 _REC_S1VAL_Normal_u2 65.535 _CNV_R_R_nCcfksc_mn_525_CM 0. 65.535 DISPLAY_IDENTIFIER Tac_cal_set_49.Cxx_tac_tini_stac_xx FORMAT "%5.3" /end CHARACTERISTIC
/begin CHARACTERISTIC Cxx_tac_toff_io_49 "Deactivation time for an I/O control test of additional tank pump" VALUE 0xa0037060 _REC_S1VAL_Normal_u2 65.535 _CNV_R_R_nCcfksc_mn_525_CM 0. 65.535 DISPLAY_IDENTIFIER Tac_cal_set_49.Cxx_tac_toff_io_xx FORMAT "%5.3" /end CHARACTERISTIC
/begin CHARACTERISTIC Cxx_tac_toff_stac_49 "Deactivation time for a static test of additional tank pump" VALUE 0xa0037066 _REC_S1VAL_Normal_u2 65.535 _CNV_R_R_nCcfksc_mn_525_CM 0. 65.535 DISPLAY_IDENTIFIER Tac_cal_set_49.Cxx_tac_toff_stac_xx FORMAT "%5.3" /end CHARACTERISTIC
/begin CHARACTERISTIC Cxx_tac_ton_io_49 "Activation time for an I/O control test of additional tank pump" VALUE 0xa003705e _REC_S1VAL_Normal_u2 65.535 _CNV_R_R_nCcfksc_mn_525_CM 0. 65.535 DISPLAY_IDENTIFIER Tac_cal_set_49.Cxx_tac_ton_io_xx FORMAT "%5.3" /end CHARACTERISTIC
/begin CHARACTERISTIC Cxx_tac_ton_stac_49 "Activation time for a static test of additional tank pump" VALUE 0xa0037064 _REC_S1VAL_Normal_u2 65.535 _CNV_R_R_nCcfksc_mn_525_CM 0. 65.535 DISPLAY_IDENTIFIER Tac_cal_set_49.Cxx_tac_ton_stac_xx FORMAT "%5.3" /end CHARACTERISTIC
/begin CHARACTERISTIC Cxx_tac_nc_io_50 "Number of cycles to complete the I/O control test of electrovalve of additional tank" VALUE 0xa0037088 _REC_S1VAL_Normal_u1 255. _CNV_R_R_VA_I_16_503_CM 0. 255. DISPLAY_IDENTIFIER Tac_cal_set_50.Cxx_tac_nc_io_xx FORMAT "%3.0" /end CHARACTERISTIC
/begin CHARACTERISTIC Cxx_tac_tini_io_50 "Initialization time for an I/O control test of electrovalve of additional tank" VALUE 0xa0037074 _REC_S1VAL_Normal_u2 65.535 _CNV_R_R_nCcfksc_mn_525_CM 0. 65.535 DISPLAY_IDENTIFIER Tac_cal_set_50.Cxx_tac_tini_io_xx FORMAT "%5.3" /end CHARACTERISTIC
/begin CHARACTERISTIC Cxx_tac_tini_stac_50 "Initialization time for a static test of electrovalve of additional tank" VALUE 0xa003707a _REC_S1VAL_Normal_u2 65.535 _CNV_R_R_nCcfksc_mn_525_CM 0. 65.535 DISPLAY_IDENTIFIER Tac_cal_set_50.Cxx_tac_tini_stac_xx FORMAT "%5.3" /end CHARACTERISTIC
/begin CHARACTERISTIC Cxx_tac_toff_io_50 "Deactivation time for an I/O control test of electrovalve of additional tank" VALUE 0xa0037078 _REC_S1VAL_Normal_u2 65.535 _CNV_R_R_nCcfksc_mn_525_CM 0. 65.535 DISPLAY_IDENTIFIER Tac_cal_set_50.Cxx_tac_toff_io_xx FORMAT "%5.3" /end CHARACTERISTIC
/begin CHARACTERISTIC Cxx_tac_toff_stac_50 "Deactivation time for a static test of electrovalve of additional tank" VALUE 0xa003707e _REC_S1VAL_Normal_u2 65.535 _CNV_R_R_nCcfksc_mn_525_CM 0. 65.535 DISPLAY_IDENTIFIER Tac_cal_set_50.Cxx_tac_toff_stac_xx FORMAT "%5.3" /end CHARACTERISTIC
/begin CHARACTERISTIC Cxx_tac_ton_io_50 "Activation time for an I/O control test of electrovalve of additional tank" VALUE 0xa0037076 _REC_S1VAL_Normal_u2 65.535 _CNV_R_R_nCcfksc_mn_525_CM 0. 65.535 DISPLAY_IDENTIFIER Tac_cal_set_50.Cxx_tac_ton_io_xx FORMAT "%5.3" /end CHARACTERISTIC
/begin CHARACTERISTIC Cxx_tac_ton_stac_50 "Activation time for a static test of electrovalve of additional tank" VALUE 0xa003707c _REC_S1VAL_Normal_u2 65.535 _CNV_R_R_nCcfksc_mn_525_CM 0. 65.535 DISPLAY_IDENTIFIER Tac_cal_set_50.Cxx_tac_ton_stac_xx FORMAT "%5.3" /end CHARACTERISTIC
/begin CHARACTERISTIC Cxx_tac_voff_io_50 "Lower substitution value for an I/O control test of additionnal tank" VALUE 0xa0037082 _REC_S1VAL_Normal_u2 100. _CNV_R_R_xytAqxd_qA_527_CM 0. 100. DISPLAY_IDENTIFIER Tac_cal_set_50.Cxx_tac_voff_io_xx FORMAT "%5.2" /end CHARACTERISTIC
/begin CHARACTERISTIC Cxx_tac_voff_stac_50 "Lower substitution value for the static test of additionnal tank" VALUE 0xa0037086 _REC_S1VAL_Normal_u2 100. _CNV_R_R_xytAqxd_qA_527_CM 0. 100. DISPLAY_IDENTIFIER Tac_cal_set_50.Cxx_tac_voff_stac_xx FORMAT "%5.2" /end CHARACTERISTIC
/begin CHARACTERISTIC Cxx_tac_von_io_50 "Higher substitution value for an I/O control test of additionnal tank" VALUE 0xa0037080 _REC_S1VAL_Normal_u2 100. _CNV_R_R_xytAqxd_qA_527_CM 0. 100. DISPLAY_IDENTIFIER Tac_cal_set_50.Cxx_tac_von_io_xx FORMAT "%5.2" /end CHARACTERISTIC
/begin CHARACTERISTIC Cxx_tac_von_stac_50 "Higher substitution value for the static test of additionnal tank" VALUE 0xa0037084 _REC_S1VAL_Normal_u2 100. _CNV_R_R_xytAqxd_qA_527_CM 0. 100. DISPLAY_IDENTIFIER Tac_cal_set_50.Cxx_tac_von_stac_xx FORMAT "%5.2" /end CHARACTERISTIC
/begin MEASUREMENT Vbx_tac_01_req "Indicates if the I/O control test of gazoline electronic throttle is in porgress" UBYTE _CNV_S_2_RANGE______3_CM 1 0. 0. 1. DISPLAY_IDENTIFIER Tac_data_set_01.Vbx_tac_xx_req ECU_ADDRESS 0xd0007375 BIT_MASK 0x1 /end MEASUREMENT
/begin MEASUREMENT Vsx_tac_01_cdn "Gazoline electronic throttle intermediary status" UBYTE _CNV_S_3_DpjnsAb_Eh_529_CM 1 0. 0. 12. DISPLAY_IDENTIFIER Tac_data_set_01.Vsx_tac_xx_cdn ECU_ADDRESS 0xd0007374 /end MEASUREMENT
/begin MEASUREMENT Vbx_tac_02_req "Indicates if the I/O control test of fuel pump and its relay is in porgress" UBYTE _CNV_S_2_RANGE______3_CM 1 0. 0. 1. DISPLAY_IDENTIFIER Tac_data_set_02.Vbx_tac_xx_req ECU_ADDRESS 0xd000737d BIT_MASK 0x1 /end MEASUREMENT
/begin MEASUREMENT Vsx_tac_02_cdn "Fuel pump and its relay intermediary status" UBYTE _CNV_S_3_DpjnsAb_Eh_529_CM 1 0. 0. 12. DISPLAY_IDENTIFIER Tac_data_set_02.Vsx_tac_xx_cdn ECU_ADDRESS 0xd000737c /end MEASUREMENT
/begin MEASUREMENT Vbx_tac_03_req "Indicates if the I/O control test of FAN1 and its relay is in porgress" UBYTE _CNV_S_2_RANGE______3_CM 1 0. 0. 1. DISPLAY_IDENTIFIER Tac_data_set_03.Vbx_tac_xx_req ECU_ADDRESS 0xd0007385 BIT_MASK 0x1 /end MEASUREMENT
/begin MEASUREMENT Vsx_tac_03_cdn "FAN1 and its relay intermediary status" UBYTE _CNV_S_3_DpjnsAb_Eh_529_CM 1 0. 0. 12. DISPLAY_IDENTIFIER Tac_data_set_03.Vsx_tac_xx_cdn ECU_ADDRESS 0xd0007384 /end MEASUREMENT
/begin MEASUREMENT Vbx_tac_04_req "Indicates if the I/O control test of FAN2 and its relay is in porgress" UBYTE _CNV_S_2_RANGE______3_CM 1 0. 0. 1. DISPLAY_IDENTIFIER Tac_data_set_04.Vbx_tac_xx_req ECU_ADDRESS 0xd000738d BIT_MASK 0x1 /end MEASUREMENT
/begin MEASUREMENT Vsx_tac_04_cdn "FAN2 and its relay intermediary status" UBYTE _CNV_S_3_DpjnsAb_Eh_529_CM 1 0. 0. 12. DISPLAY_IDENTIFIER Tac_data_set_04.Vsx_tac_xx_cdn ECU_ADDRESS 0xd000738c /end MEASUREMENT
/begin MEASUREMENT Vbx_tac_05_req "Indicates if the I/O control test of electronic water pump for turbocharger cooling is in porgress" UBYTE _CNV_S_2_RANGE______3_CM 1 0. 0. 1. DISPLAY_IDENTIFIER Tac_data_set_05.Vbx_tac_xx_req ECU_ADDRESS 0xd0007395 BIT_MASK 0x1 /end MEASUREMENT
/begin MEASUREMENT Vsx_tac_05_cdn "Electronic water pump for turbocharger cooling intermediary status" UBYTE _CNV_S_3_DpjnsAb_Eh_529_CM 1 0. 0. 12. DISPLAY_IDENTIFIER Tac_data_set_05.Vsx_tac_xx_cdn ECU_ADDRESS 0xd0007394 /end MEASUREMENT
/begin MEASUREMENT Vbx_tac_06_req "Indicates if the I/O control test of defrosting PTC is in porgress" UBYTE _CNV_S_2_RANGE______3_CM 1 0. 0. 1. DISPLAY_IDENTIFIER Tac_data_set_06.Vbx_tac_xx_req ECU_ADDRESS 0xd000739d BIT_MASK 0x1 /end MEASUREMENT
/begin MEASUREMENT Vsx_tac_06_cdn "Defrosting PTC intermediary status" UBYTE _CNV_S_3_DpjnsAb_Eh_529_CM 1 0. 0. 12. DISPLAY_IDENTIFIER Tac_data_set_06.Vsx_tac_xx_cdn ECU_ADDRESS 0xd000739c /end MEASUREMENT
/begin MEASUREMENT Vbx_tac_07_req "Indicates if the I/O control test of VVT control solenoid is in porgress" UBYTE _CNV_S_2_RANGE______3_CM 1 0. 0. 1. DISPLAY_IDENTIFIER Tac_data_set_07.Vbx_tac_xx_req ECU_ADDRESS 0xd00073a5 BIT_MASK 0x1 /end MEASUREMENT
/begin MEASUREMENT Vsx_tac_07_cdn "VVT control solenoid intermediary status" UBYTE _CNV_S_3_DpjnsAb_Eh_529_CM 1 0. 0. 12. DISPLAY_IDENTIFIER Tac_data_set_07.Vsx_tac_xx_cdn ECU_ADDRESS 0xd00073a4 /end MEASUREMENT
/begin MEASUREMENT Vbx_tac_08_req "Indicates if the I/O control test of gazoline turbocharger command valve is in porgress" UBYTE _CNV_S_2_RANGE______3_CM 1 0. 0. 1. DISPLAY_IDENTIFIER Tac_data_set_08.Vbx_tac_xx_req ECU_ADDRESS 0xd00073ad BIT_MASK 0x1 /end MEASUREMENT
/begin MEASUREMENT Vsx_tac_08_cdn "Gazoline turbocharger command valve intermediary status" UBYTE _CNV_S_3_DpjnsAb_Eh_529_CM 1 0. 0. 12. DISPLAY_IDENTIFIER Tac_data_set_08.Vsx_tac_xx_cdn ECU_ADDRESS 0xd00073ac /end MEASUREMENT
/begin MEASUREMENT Vbx_tac_09_req "Indicates if the I/O control test of upstream oxygen lamda sensor (heater) is in porgress" UBYTE _CNV_S_2_RANGE______3_CM 1 0. 0. 1. DISPLAY_IDENTIFIER Tac_data_set_09.Vbx_tac_xx_req ECU_ADDRESS 0xd00073b5 BIT_MASK 0x1 /end MEASUREMENT
/begin MEASUREMENT Vsx_tac_09_cdn "Upstream oxygen lamda sensor (heater) intermediary status" UBYTE _CNV_S_3_DpjnsAb_Eh_529_CM 1 0. 0. 12. DISPLAY_IDENTIFIER Tac_data_set_09.Vsx_tac_xx_cdn ECU_ADDRESS 0xd00073b4 /end MEASUREMENT
/begin MEASUREMENT Vbx_tac_10_req "Indicates if the I/O control test of downstream oxygen lamda sensor (heater) is in porgress" UBYTE _CNV_S_2_RANGE______3_CM 1 0. 0. 1. DISPLAY_IDENTIFIER Tac_data_set_10.Vbx_tac_xx_req ECU_ADDRESS 0xd00073bd BIT_MASK 0x1 /end MEASUREMENT
/begin MEASUREMENT Vsx_tac_10_cdn "Downstream oxygen lamda sensor (heater) intermediary status" UBYTE _CNV_S_3_DpjnsAb_Eh_529_CM 1 0. 0. 12. DISPLAY_IDENTIFIER Tac_data_set_10.Vsx_tac_xx_cdn ECU_ADDRESS 0xd00073bc /end MEASUREMENT
/begin MEASUREMENT Vbx_tac_20_req "Indicates if the I/O control test of canister drain valve is in porgress" UBYTE _CNV_S_2_RANGE______3_CM 1 0. 0. 1. DISPLAY_IDENTIFIER Tac_data_set_20.Vbx_tac_xx_req ECU_ADDRESS 0xd00073c5 BIT_MASK 0x1 /end MEASUREMENT
/begin MEASUREMENT Vsx_tac_20_cdn "Canister drain valve intermediary status" UBYTE _CNV_S_3_DpjnsAb_Eh_529_CM 1 0. 0. 12. DISPLAY_IDENTIFIER Tac_data_set_20.Vsx_tac_xx_cdn ECU_ADDRESS 0xd00073c4 /end MEASUREMENT
/begin MEASUREMENT Vbx_tac_22_req "Indicates if the I/O control test of flow actuator (VCV) is in porgress" UBYTE _CNV_S_2_RANGE______3_CM 1 0. 0. 1. DISPLAY_IDENTIFIER Tac_data_set_22.Vbx_tac_xx_req ECU_ADDRESS 0xd00073cd BIT_MASK 0x1 /end MEASUREMENT
/begin MEASUREMENT Vsx_tac_22_cdn "Flow actuator (VCV) intermediary status" UBYTE _CNV_S_3_DpjnsAb_Eh_529_CM 1 0. 0. 12. DISPLAY_IDENTIFIER Tac_data_set_22.Vsx_tac_xx_cdn ECU_ADDRESS 0xd00073cc /end MEASUREMENT
/begin MEASUREMENT Vbx_tac_23_req "Indicates if the I/O control test of rail pressure regulator (PCV) is in porgress" UBYTE _CNV_S_2_RANGE______3_CM 1 0. 0. 1. DISPLAY_IDENTIFIER Tac_data_set_23.Vbx_tac_xx_req ECU_ADDRESS 0xd00073cf BIT_MASK 0x1 /end MEASUREMENT
/begin MEASUREMENT Vsx_tac_23_cdn "Rail pressure regulator (PCV) intermediary status" UBYTE _CNV_S_3_DpjnsAb_Eh_529_CM 1 0. 0. 12. DISPLAY_IDENTIFIER Tac_data_set_23.Vsx_tac_xx_cdn ECU_ADDRESS 0xd00073ce /end MEASUREMENT
/begin MEASUREMENT Vbx_tac_24_req "Indicates if the I/O control test of 02 upper sensor (heater) is in porgress" UBYTE _CNV_S_2_RANGE______3_CM 1 0. 0. 1. DISPLAY_IDENTIFIER Tac_data_set_24.Vbx_tac_xx_req ECU_ADDRESS 0xd00073d1 BIT_MASK 0x1 /end MEASUREMENT
/begin MEASUREMENT Vsx_tac_24_cdn "Oxygen upper sensor heater intermediary status" UBYTE _CNV_S_3_DpjnsAb_Eh_529_CM 1 0. 0. 12. DISPLAY_IDENTIFIER Tac_data_set_24.Vsx_tac_xx_cdn ECU_ADDRESS 0xd00073d0 /end MEASUREMENT
/begin MEASUREMENT Vbx_tac_25_req "Indicates if the I/O control test of 02 lower sensor (heater) is in porgress" UBYTE _CNV_S_2_RANGE______3_CM 1 0. 0. 1. DISPLAY_IDENTIFIER Tac_data_set_25.Vbx_tac_xx_req ECU_ADDRESS 0xd00073d3 BIT_MASK 0x1 /end MEASUREMENT
/begin MEASUREMENT Vsx_tac_25_cdn "Oxygen lower sensor heater intermediary status" UBYTE _CNV_S_3_DpjnsAb_Eh_529_CM 1 0. 0. 12. DISPLAY_IDENTIFIER Tac_data_set_25.Vsx_tac_xx_cdn ECU_ADDRESS 0xd00073d2 /end MEASUREMENT
/begin MEASUREMENT Vbx_tac_29_req "Indicates if the I/O control test of ignition coil 1 is in porgress" UBYTE _CNV_S_2_RANGE______3_CM 1 0. 0. 1. DISPLAY_IDENTIFIER Tac_data_set_29.Vbx_tac_xx_req ECU_ADDRESS 0xd00073d5 BIT_MASK 0x1 /end MEASUREMENT
/begin MEASUREMENT Vsx_tac_29_cdn "Ignition coil 1 intermediary status" UBYTE _CNV_S_3_DpjnsAb_Eh_529_CM 1 0. 0. 12. DISPLAY_IDENTIFIER Tac_data_set_29.Vsx_tac_xx_cdn ECU_ADDRESS 0xd00073d4 /end MEASUREMENT
/begin MEASUREMENT Vbx_tac_30_req "Indicates if the I/O control test of ignition coil 2 is in porgress" UBYTE _CNV_S_2_RANGE______3_CM 1 0. 0. 1. DISPLAY_IDENTIFIER Tac_data_set_30.Vbx_tac_xx_req ECU_ADDRESS 0xd00073d7 BIT_MASK 0x1 /end MEASUREMENT
/begin MEASUREMENT Vsx_tac_30_cdn "Ignition coil 2 intermediary status" UBYTE _CNV_S_3_DpjnsAb_Eh_529_CM 1 0. 0. 12. DISPLAY_IDENTIFIER Tac_data_set_30.Vsx_tac_xx_cdn ECU_ADDRESS 0xd00073d6 /end MEASUREMENT
/begin MEASUREMENT Vbx_tac_31_req "Indicates if the I/O control test of ignition coil 3 is in porgress" UBYTE _CNV_S_2_RANGE______3_CM 1 0. 0. 1. DISPLAY_IDENTIFIER Tac_data_set_31.Vbx_tac_xx_req ECU_ADDRESS 0xd00073d9 BIT_MASK 0x1 /end MEASUREMENT
/begin MEASUREMENT Vsx_tac_31_cdn "Ignition coil 3 intermediary status" UBYTE _CNV_S_3_DpjnsAb_Eh_529_CM 1 0. 0. 12. DISPLAY_IDENTIFIER Tac_data_set_31.Vsx_tac_xx_cdn ECU_ADDRESS 0xd00073d8 /end MEASUREMENT
/begin MEASUREMENT Vbx_tac_32_req "Indicates if the I/O control test of ignition coil 4 is in porgress" UBYTE _CNV_S_2_RANGE______3_CM 1 0. 0. 1. DISPLAY_IDENTIFIER Tac_data_set_32.Vbx_tac_xx_req ECU_ADDRESS 0xd00073db BIT_MASK 0x1 /end MEASUREMENT
/begin MEASUREMENT Vsx_tac_32_cdn "Ignition coil 4 intermediary status" UBYTE _CNV_S_3_DpjnsAb_Eh_529_CM 1 0. 0. 12. DISPLAY_IDENTIFIER Tac_data_set_32.Vsx_tac_xx_cdn ECU_ADDRESS 0xd00073da /end MEASUREMENT
/begin MEASUREMENT Vbx_tac_35_req "Indicates if the I/O control test of fuel injector 1 is in porgress" UBYTE _CNV_S_2_RANGE______3_CM 1 0. 0. 1. DISPLAY_IDENTIFIER Tac_data_set_35.Vbx_tac_xx_req ECU_ADDRESS 0xd00073dd BIT_MASK 0x1 /end MEASUREMENT
/begin MEASUREMENT Vsx_tac_35_cdn "Fuel injector 1 intermediary status" UBYTE _CNV_S_3_DpjnsAb_Eh_529_CM 1 0. 0. 12. DISPLAY_IDENTIFIER Tac_data_set_35.Vsx_tac_xx_cdn ECU_ADDRESS 0xd00073dc /end MEASUREMENT
/begin MEASUREMENT Vbx_tac_36_req "Indicates if the I/O control test of fuel injector 2 is in porgress" UBYTE _CNV_S_2_RANGE______3_CM 1 0. 0. 1. DISPLAY_IDENTIFIER Tac_data_set_36.Vbx_tac_xx_req ECU_ADDRESS 0xd00073df BIT_MASK 0x1 /end MEASUREMENT
/begin MEASUREMENT Vsx_tac_36_cdn "Fuel injector 2 intermediary status" UBYTE _CNV_S_3_DpjnsAb_Eh_529_CM 1 0. 0. 12. DISPLAY_IDENTIFIER Tac_data_set_36.Vsx_tac_xx_cdn ECU_ADDRESS 0xd00073de /end MEASUREMENT
/begin MEASUREMENT Vbx_tac_37_req "Indicates if the I/O control test of fuel injector 3 is in porgress" UBYTE _CNV_S_2_RANGE______3_CM 1 0. 0. 1. DISPLAY_IDENTIFIER Tac_data_set_37.Vbx_tac_xx_req ECU_ADDRESS 0xd00073e1 BIT_MASK 0x1 /end MEASUREMENT
/begin MEASUREMENT Vsx_tac_37_cdn "Fuel injector 3 intermediary status" UBYTE _CNV_S_3_DpjnsAb_Eh_529_CM 1 0. 0. 12. DISPLAY_IDENTIFIER Tac_data_set_37.Vsx_tac_xx_cdn ECU_ADDRESS 0xd00073e0 /end MEASUREMENT
/begin MEASUREMENT Vbx_tac_38_req "Indicates if the I/O control test of fuel injector 4 is in porgress" UBYTE _CNV_S_2_RANGE______3_CM 1 0. 0. 1. DISPLAY_IDENTIFIER Tac_data_set_38.Vbx_tac_xx_req ECU_ADDRESS 0xd00073e3 BIT_MASK 0x1 /end MEASUREMENT
/begin MEASUREMENT Vsx_tac_38_cdn "Fuel injector 4 intermediary status" UBYTE _CNV_S_3_DpjnsAb_Eh_529_CM 1 0. 0. 12. DISPLAY_IDENTIFIER Tac_data_set_38.Vsx_tac_xx_cdn ECU_ADDRESS 0xd00073e2 /end MEASUREMENT
/begin MEASUREMENT Vbx_tac_49_req "Indicates if the I/O control test of additional tank pump is in progress" UBYTE _CNV_S_2_RANGE______3_CM 1 0. 0. 1. DISPLAY_IDENTIFIER Tac_data_set_49.Vbx_tac_xx_req ECU_ADDRESS 0xd00073e5 BIT_MASK 0x1 /end MEASUREMENT
/begin MEASUREMENT Vsx_tac_49_cdn "additional tank pump intermediary status" UBYTE _CNV_S_3_DpjnsAb_Eh_529_CM 1 0. 0. 12. DISPLAY_IDENTIFIER Tac_data_set_49.Vsx_tac_xx_cdn ECU_ADDRESS 0xd00073e4 /end MEASUREMENT
/begin MEASUREMENT Vbx_tac_50_req "Indicates if the I/O control test of electrovalve of additional tank is in progress" UBYTE _CNV_S_2_RANGE______3_CM 1 0. 0. 1. DISPLAY_IDENTIFIER Tac_data_set_50.Vbx_tac_xx_req ECU_ADDRESS 0xd00073ed BIT_MASK 0x1 /end MEASUREMENT
/begin MEASUREMENT Vsx_tac_50_cdn "electrovalve of additional tank intermediary status" UBYTE _CNV_S_3_DpjnsAb_Eh_529_CM 1 0. 0. 12. DISPLAY_IDENTIFIER Tac_data_set_50.Vsx_tac_xx_cdn ECU_ADDRESS 0xd00073ec /end MEASUREMENT
/begin MEASUREMENT Vxx_tac_01_nc "Current number of cycles done for the I/O control of fuel pump and its relay" UBYTE _CNV_R_R_VA_I_16_503_CM 1 0. 0. 255. DISPLAY_IDENTIFIER Tac_data_set_rsa_01.Vxx_tac_xx_nc ECU_ADDRESS 0xd000737a FORMAT "%3.0" /end MEASUREMENT
/begin MEASUREMENT Vxx_tac_01_subval "Substitution value for a test of gazoline electronic throttle" UWORD _CNV_R_R_gBspFma_cr_526_CM 1 0. 0. 200. DISPLAY_IDENTIFIER Tac_data_set_rsa_01.Vxx_tac_xx_subval ECU_ADDRESS 0xd0007378 FORMAT "%6.2" /end MEASUREMENT
/begin MEASUREMENT Vxx_tmp_dly_01 "Signal generator timer for gazoline electronic throttle" UWORD _CNV_R_R_nCcfksc_mn_525_CM 1 0. 0. 65.535 DISPLAY_IDENTIFIER Tac_data_set_rsa_01.Vxx_tmp_dly_xx ECU_ADDRESS 0xd0007376 /end MEASUREMENT
/begin MEASUREMENT Vxx_tac_02_nc "Current number of cycles done for the I/O control of fuel pump and its relay" UBYTE _CNV_R_R_VA_I_16_503_CM 1 0. 0. 255. DISPLAY_IDENTIFIER Tac_data_set_rsa_02.Vxx_tac_xx_nc ECU_ADDRESS 0xd0007382 FORMAT "%3.0" /end MEASUREMENT
/begin MEASUREMENT Vxx_tac_02_subval "Substitution value for a test of fuel pump and its relay" UWORD _CNV_R_R_hdvlAid_gA_530_CM 1 0. 0. 65535. DISPLAY_IDENTIFIER Tac_data_set_rsa_02.Vxx_tac_xx_subval ECU_ADDRESS 0xd0007380 /end MEASUREMENT
/begin MEASUREMENT Vxx_tmp_dly_02 "Signal generator timer for fuel pump and its relay" UWORD _CNV_R_R_nCcfksc_mn_525_CM 1 0. 0. 65.535 DISPLAY_IDENTIFIER Tac_data_set_rsa_02.Vxx_tmp_dly_xx ECU_ADDRESS 0xd000737e /end MEASUREMENT
/begin MEASUREMENT Vxx_tac_03_nc "Current number of cycles done for the I/O control of FAN1 and its relay" UBYTE _CNV_R_R_VA_I_16_503_CM 1 0. 0. 255. DISPLAY_IDENTIFIER Tac_data_set_rsa_03.Vxx_tac_xx_nc ECU_ADDRESS 0xd000738a FORMAT "%3.0" /end MEASUREMENT
/begin MEASUREMENT Vxx_tac_03_subval "Substitution value for a test of FAN1 and its relay" UWORD _CNV_R_R_hdvlAid_gA_530_CM 1 0. 0. 65535. DISPLAY_IDENTIFIER Tac_data_set_rsa_03.Vxx_tac_xx_subval ECU_ADDRESS 0xd0007388 /end MEASUREMENT
/begin MEASUREMENT Vxx_tmp_dly_03 "Signal generator timer for FAN1 and its relay" UWORD _CNV_R_R_nCcfksc_mn_525_CM 1 0. 0. 65.535 DISPLAY_IDENTIFIER Tac_data_set_rsa_03.Vxx_tmp_dly_xx ECU_ADDRESS 0xd0007386 /end MEASUREMENT
/begin MEASUREMENT Vxx_tac_04_nc "Current number of cycles done for the I/O control of FAN2 and its relay" UBYTE _CNV_R_R_VA_I_16_503_CM 1 0. 0. 255. DISPLAY_IDENTIFIER Tac_data_set_rsa_04.Vxx_tac_xx_nc ECU_ADDRESS 0xd0007392 FORMAT "%3.0" /end MEASUREMENT
/begin MEASUREMENT Vxx_tac_04_subval "Substitution value for a test of FAN2 and its relay" UWORD _CNV_R_R_hdvlAid_gA_530_CM 1 0. 0. 65535. DISPLAY_IDENTIFIER Tac_data_set_rsa_04.Vxx_tac_xx_subval ECU_ADDRESS 0xd0007390 /end MEASUREMENT
/begin MEASUREMENT Vxx_tmp_dly_04 "Signal generator timer for FAN2 and its relay" UWORD _CNV_R_R_nCcfksc_mn_525_CM 1 0. 0. 65.535 DISPLAY_IDENTIFIER Tac_data_set_rsa_04.Vxx_tmp_dly_xx ECU_ADDRESS 0xd000738e /end MEASUREMENT
/begin MEASUREMENT Vxx_tac_05_nc "Current number of cycles done for the I/O control of electronic water pump for turbocharger cooling" UBYTE _CNV_R_R_VA_I_16_503_CM 1 0. 0. 255. DISPLAY_IDENTIFIER Tac_data_set_rsa_05.Vxx_tac_xx_nc ECU_ADDRESS 0xd000739a FORMAT "%3.0" /end MEASUREMENT
/begin MEASUREMENT Vxx_tac_05_subval "Substitution value for a test of electronic water pump for turbocharger cooling" UWORD _CNV_R_R_hdvlAid_gA_530_CM 1 0. 0. 65535. DISPLAY_IDENTIFIER Tac_data_set_rsa_05.Vxx_tac_xx_subval ECU_ADDRESS 0xd0007398 /end MEASUREMENT
/begin MEASUREMENT Vxx_tmp_dly_05 "Signal generator timer for electronic water pump for turbocharger cooling" UWORD _CNV_R_R_nCcfksc_mn_525_CM 1 0. 0. 65.535 DISPLAY_IDENTIFIER Tac_data_set_rsa_05.Vxx_tmp_dly_xx ECU_ADDRESS 0xd0007396 /end MEASUREMENT
/begin MEASUREMENT Vxx_tac_06_nc "Current number of cycles done for the I/O control of defrosting PTC" UBYTE _CNV_R_R_VA_I_16_503_CM 1 0. 0. 255. DISPLAY_IDENTIFIER Tac_data_set_rsa_06.Vxx_tac_xx_nc ECU_ADDRESS 0xd00073a2 FORMAT "%3.0" /end MEASUREMENT
/begin MEASUREMENT Vxx_tac_06_subval "Substitution value for a test of defrosting PTC" UWORD _CNV_R_R_hdvlAid_gA_530_CM 1 0. 0. 65535. DISPLAY_IDENTIFIER Tac_data_set_rsa_06.Vxx_tac_xx_subval ECU_ADDRESS 0xd00073a0 /end MEASUREMENT
/begin MEASUREMENT Vxx_tmp_dly_06 "Signal generator timer for defrosting PTC" UWORD _CNV_R_R_nCcfksc_mn_525_CM 1 0. 0. 65.535 DISPLAY_IDENTIFIER Tac_data_set_rsa_06.Vxx_tmp_dly_xx ECU_ADDRESS 0xd000739e /end MEASUREMENT
/begin MEASUREMENT Vxx_tac_07_nc "Current number of cycles done for the I/O control of VVT control solenoid" UBYTE _CNV_R_R_VA_I_16_503_CM 1 0. 0. 255. DISPLAY_IDENTIFIER Tac_data_set_rsa_07.Vxx_tac_xx_nc ECU_ADDRESS 0xd00073aa FORMAT "%3.0" /end MEASUREMENT
/begin MEASUREMENT Vxx_tac_07_subval "Substitution value for a test of VVT control solenoid" UWORD _CNV_R_R_gBspFma_cr_526_CM 1 0. 0. 200. DISPLAY_IDENTIFIER Tac_data_set_rsa_07.Vxx_tac_xx_subval ECU_ADDRESS 0xd00073a8 FORMAT "%6.2" /end MEASUREMENT
/begin MEASUREMENT Vxx_tmp_dly_07 "Signal generator timer for VVT control solenoid" UWORD _CNV_R_R_nCcfksc_mn_525_CM 1 0. 0. 65.535 DISPLAY_IDENTIFIER Tac_data_set_rsa_07.Vxx_tmp_dly_xx ECU_ADDRESS 0xd00073a6 /end MEASUREMENT
/begin MEASUREMENT Vxx_tac_08_nc "Current number of cycles done for the I/O control of gazoline turbocharger command valve" UBYTE _CNV_R_R_VA_I_16_503_CM 1 0. 0. 255. DISPLAY_IDENTIFIER Tac_data_set_rsa_08.Vxx_tac_xx_nc ECU_ADDRESS 0xd00073b2 FORMAT "%3.0" /end MEASUREMENT
/begin MEASUREMENT Vxx_tac_08_subval "Substitution value for a test of gazoline turbocharger command valve" UWORD _CNV_R_R_xytAqxd_qA_527_CM 1 0. 0. 100. DISPLAY_IDENTIFIER Tac_data_set_rsa_08.Vxx_tac_xx_subval ECU_ADDRESS 0xd00073b0 FORMAT "%6.2" /end MEASUREMENT
/begin MEASUREMENT Vxx_tmp_dly_08 "Signal generator timer for gazoline turbocharger command valve" UWORD _CNV_R_R_nCcfksc_mn_525_CM 1 0. 0. 65.535 DISPLAY_IDENTIFIER Tac_data_set_rsa_08.Vxx_tmp_dly_xx ECU_ADDRESS 0xd00073ae /end MEASUREMENT
/begin MEASUREMENT Vxx_tac_09_nc "Current number of cycles done for the I/O control of upstream oxygen lamda sensor (heater)" UBYTE _CNV_R_R_VA_I_16_503_CM 1 0. 0. 255. DISPLAY_IDENTIFIER Tac_data_set_rsa_09.Vxx_tac_xx_nc ECU_ADDRESS 0xd00073ba FORMAT "%3.0" /end MEASUREMENT
/begin MEASUREMENT Vxx_tac_09_subval "Substitution value for a test of upstream oxygen lambda sensor (heater)" UWORD _CNV_R_R_xytAqxd_qA_527_CM 1 0. 0. 100. DISPLAY_IDENTIFIER Tac_data_set_rsa_09.Vxx_tac_xx_subval ECU_ADDRESS 0xd00073b8 FORMAT "%6.2" /end MEASUREMENT
/begin MEASUREMENT Vxx_tmp_dly_09 "Signal generator timer for upstream oxygen lamda sensor (heater)" UWORD _CNV_R_R_nCcfksc_mn_525_CM 1 0. 0. 65.535 DISPLAY_IDENTIFIER Tac_data_set_rsa_09.Vxx_tmp_dly_xx ECU_ADDRESS 0xd00073b6 /end MEASUREMENT
/begin MEASUREMENT Vxx_tac_10_nc "Current number of cycles done for the I/O control of downstream oxygen lamda sensor (heater)" UBYTE _CNV_R_R_VA_I_16_503_CM 1 0. 0. 255. DISPLAY_IDENTIFIER Tac_data_set_rsa_10.Vxx_tac_xx_nc ECU_ADDRESS 0xd00073c2 FORMAT "%3.0" /end MEASUREMENT
/begin MEASUREMENT Vxx_tac_10_subval "Substitution value for a test of downstream oxygen lamda sensor (heater)" UWORD _CNV_R_R_xytAqxd_qA_527_CM 1 0. 0. 100. DISPLAY_IDENTIFIER Tac_data_set_rsa_10.Vxx_tac_xx_subval ECU_ADDRESS 0xd00073c0 FORMAT "%6.2" /end MEASUREMENT
/begin MEASUREMENT Vxx_tmp_dly_10 "Signal generator timer for downstream oxygen lamda sensor (heater)" UWORD _CNV_R_R_nCcfksc_mn_525_CM 1 0. 0. 65.535 DISPLAY_IDENTIFIER Tac_data_set_rsa_10.Vxx_tmp_dly_xx ECU_ADDRESS 0xd00073be /end MEASUREMENT
/begin MEASUREMENT Vxx_tac_20_nc "Current number of cycles done for the I/O control of canister drain valve" UBYTE _CNV_R_R_VA_I_16_503_CM 1 0. 0. 255. DISPLAY_IDENTIFIER Tac_data_set_rsa_20.Vxx_tac_xx_nc ECU_ADDRESS 0xd00073ca FORMAT "%3.0" /end MEASUREMENT
/begin MEASUREMENT Vxx_tac_20_subval "Substitution value for a test of canister drain valve" UWORD _CNV_R_R_Edjqxvd_mq_528_CM 1 0. 0. 100. DISPLAY_IDENTIFIER Tac_data_set_rsa_20.Vxx_tac_xx_subval ECU_ADDRESS 0xd00073c8 FORMAT "%6.2" /end MEASUREMENT
/begin MEASUREMENT Vxx_tmp_dly_20 "Signal generator timer for canister drain valve" UWORD _CNV_R_R_nCcfksc_mn_525_CM 1 0. 0. 65.535 DISPLAY_IDENTIFIER Tac_data_set_rsa_20.Vxx_tmp_dly_xx ECU_ADDRESS 0xd00073c6 /end MEASUREMENT
/begin MEASUREMENT Vxx_tac_49_nc "Current number of cycles done for the I/O control of additional tank pump" UBYTE _CNV_R_R_VA_I_16_503_CM 1 0. 0. 255. DISPLAY_IDENTIFIER Tac_data_set_rsa_49.Vxx_tac_xx_nc ECU_ADDRESS 0xd00073ea FORMAT "%3.0" /end MEASUREMENT
/begin MEASUREMENT Vxx_tac_49_subval "Substitution value for a test of additional tank pump" UWORD _CNV_R_R_VA_I_16_503_CM 1 0. 0. 1. DISPLAY_IDENTIFIER Tac_data_set_rsa_49.Vxx_tac_xx_subval ECU_ADDRESS 0xd00073e8 FORMAT "%1.0" /end MEASUREMENT
/begin MEASUREMENT Vxx_tmp_dly_49 "Signal generator timer for additional tank pump" UWORD _CNV_R_R_nCcfksc_mn_525_CM 1 0. 0. 65.535 DISPLAY_IDENTIFIER Tac_data_set_rsa_49.Vxx_tmp_dly_xx ECU_ADDRESS 0xd00073e6 /end MEASUREMENT
/begin MEASUREMENT Vxx_tac_50_nc "Current number of cycles done for the I/O control of electrovalve of additional tank" UBYTE _CNV_R_R_VA_I_16_503_CM 1 0. 0. 255. DISPLAY_IDENTIFIER Tac_data_set_rsa_50.Vxx_tac_xx_nc ECU_ADDRESS 0xd00073f2 FORMAT "%3.0" /end MEASUREMENT
/begin MEASUREMENT Vxx_tac_50_subval "Substitution value for a test of electrovalve of additional tank" UWORD _CNV_R_R_xytAqxd_qA_527_CM 1 0. 0. 100. DISPLAY_IDENTIFIER Tac_data_set_rsa_50.Vxx_tac_xx_subval ECU_ADDRESS 0xd00073f0 FORMAT "%5.2" /end MEASUREMENT
/begin MEASUREMENT Vxx_tmp_dly_50 "Signal generator timer for electrovalve of additional tank" UWORD _CNV_R_R_nCcfksc_mn_525_CM 1 0. 0. 65.535 DISPLAY_IDENTIFIER Tac_data_set_rsa_50.Vxx_tmp_dly_xx ECU_ADDRESS 0xd00073ee /end MEASUREMENT
/begin MEASUREMENT Vbx_byp_70_sub_val "Replacement value requested by Monitool to control identifier 70" UBYTE _CNV_S_2_RANGE______3_CM 1 0. 0. 1. ECU_ADDRESS 0xd00072ca BIT_MASK 0x1 /end MEASUREMENT
/begin MEASUREMENT Vbx_clock "Indicates if the number of the request (tool) is the same as the ECU" UBYTE _CNV_S_2_RANGE______3_CM 1 0. 0. 1. ECU_ADDRESS 0xd0007317 BIT_MASK 0x1 /end MEASUREMENT
/begin MEASUREMENT Vbx_com_err "Flag indicates if there is a security timeout or security clock problem" UBYTE _CNV_S_2_RANGE______3_CM 1 0. 0. 1. ECU_ADDRESS 0xd0007318 BIT_MASK 0x1 /end MEASUREMENT
/begin MEASUREMENT Vbx_diag_sta_moni_abrt "Monitool eabort" UBYTE _CNV_S_2_RANGE______3_CM 1 0. 0. 1. ECU_ADDRESS 0xd0007319 BIT_MASK 0x1 /end MEASUREMENT
/begin MEASUREMENT Vbx_diag_sta_moni_ena "Communication layer is authorizing Monitool" UBYTE _CNV_S_2_RANGE______3_CM 1 0. 0. 1. ECU_ADDRESS 0xd000731a BIT_MASK 0x1 /end MEASUREMENT
/begin MEASUREMENT Vbx_diag_sta_moni_end "Monitool end" UBYTE _CNV_S_2_RANGE______3_CM 1 0. 0. 1. ECU_ADDRESS 0xd000731b BIT_MASK 0x1 /end MEASUREMENT
/begin MEASUREMENT Vbx_diag_sta_stac_abrt "Static test routine aborted status" UBYTE _CNV_S_2_RANGE______3_CM 1 0. 0. 1. ECU_ADDRESS 0xd0007404 BIT_MASK 0x1 /end MEASUREMENT
/begin MEASUREMENT Vbx_diag_sta_stac_ena "Static test routine activation status" UBYTE _CNV_S_2_RANGE______3_CM 1 0. 0. 1. ECU_ADDRESS 0xd0007405 BIT_MASK 0x1 /end MEASUREMENT
/begin MEASUREMENT Vbx_diag_sta_stac_end "Static test routine completed status" UBYTE _CNV_S_2_RANGE______3_CM 1 0. 0. 1. ECU_ADDRESS 0xd0007406 BIT_MASK 0x1 /end MEASUREMENT
/begin MEASUREMENT Vbx_ext_ctrl_ena "External controls safety authorization flag" UBYTE _CNV_S_2_RANGE______3_CM 1 0. 0. 1. ECU_ADDRESS 0xd00072db BIT_MASK 0x1 /end MEASUREMENT
/begin MEASUREMENT Vbx_ext_ctrl_test_act "External controls tests activation" UBYTE _CNV_S_2_RANGE______3_CM 1 0. 0. 1. ECU_ADDRESS 0xd00072d9 BIT_MASK 0x1 /end MEASUREMENT
/begin MEASUREMENT Vbx_moni_appl_err "Applicative error flag" UBYTE _CNV_S_2_RANGE______3_CM 1 0. 0. 1. ECU_ADDRESS 0xd000731c BIT_MASK 0x1 /end MEASUREMENT
/begin MEASUREMENT Vbx_moni_dbl_nok "Indicates if an identifier is duplicated in the request" UBYTE _CNV_S_2_RANGE______3_CM 1 0. 0. 1. ECU_ADDRESS 0xd000731d BIT_MASK 0x1 /end MEASUREMENT
/begin MEASUREMENT Vbx_moni_id_nok "Indicates if the requested identifiers are not ok (not supported or duplicated)" UBYTE _CNV_S_2_RANGE______3_CM 1 0. 0. 1. ECU_ADDRESS 0xd000731e BIT_MASK 0x1 /end MEASUREMENT
/begin MEASUREMENT Vbx_moni_nr_tot_id_nok "Indicates if the number of the requested identifiers is higher than 15" UBYTE _CNV_S_2_RANGE______3_CM 1 0. 0. 1. ECU_ADDRESS 0xd000731f BIT_MASK 0x1 /end MEASUREMENT
/begin MEASUREMENT Vbx_moni_oor "Indicates whether at least a replacement value requested for a component is out of range" UBYTE _CNV_S_2_RANGE______3_CM 1 0. 0. 1. ECU_ADDRESS 0xd0007320 BIT_MASK 0x1 /end MEASUREMENT
/begin MEASUREMENT Vbx_moni_read_req_done "Indicates when the data extraction is finished" UBYTE _CNV_S_2_RANGE______3_CM 1 0. 0. 1. ECU_ADDRESS 0xd0007321 BIT_MASK 0x1 /end MEASUREMENT
/begin MEASUREMENT Vbx_moni_req_analyse "Trigger request analyse" UBYTE _CNV_S_2_RANGE______3_CM 1 0. 0. 1. ECU_ADDRESS 0xd0007322 BIT_MASK 0x1 /end MEASUREMENT
/begin MEASUREMENT Vbx_moni_req_data_changed "Request changed" UBYTE _CNV_S_2_RANGE______3_CM 1 0. 0. 1. ECU_ADDRESS 0xd0007323 BIT_MASK 0x1 /end MEASUREMENT
/begin MEASUREMENT Vbx_moni_stop_diag "Monitool requests to stop all required diagnostics" UBYTE _CNV_S_2_RANGE______3_CM 1 0. 0. 1. ECU_ADDRESS 0xd0007324 BIT_MASK 0x1 /end MEASUREMENT
/begin MEASUREMENT Vbx_moni_id_01_req "Activation of the identifier 01" UBYTE _CNV_S_2_RANGE______3_CM 1 0. 0. 1. DISPLAY_IDENTIFIER Vbx_moni_xx_req[1] ECU_ADDRESS 0xd000723d BIT_MASK 0x1 /end MEASUREMENT
/begin MEASUREMENT Vbx_byp_03_req "Activation of the identifier 03" UBYTE _CNV_S_2_RANGE______3_CM 1 0. 0. 1. DISPLAY_IDENTIFIER Vbx_moni_xx_req[3] ECU_ADDRESS 0xd000723f BIT_MASK 0x1 /end MEASUREMENT
/begin MEASUREMENT Vbx_byp_06_req "Activation of the identifier 06" UBYTE _CNV_S_2_RANGE______3_CM 1 0. 0. 1. DISPLAY_IDENTIFIER Vbx_moni_xx_req[6] ECU_ADDRESS 0xd0007242 BIT_MASK 0x1 /end MEASUREMENT
/begin MEASUREMENT Vbx_byp_0a_req "Activation of the identifier 0a" UBYTE _CNV_S_2_RANGE______3_CM 1 0. 0. 1. DISPLAY_IDENTIFIER Vbx_moni_xx_req[10] ECU_ADDRESS 0xd0007246 BIT_MASK 0x1 /end MEASUREMENT
/begin MEASUREMENT Vbx_moni_id_10_req "Activation of the identifier 10" UBYTE _CNV_S_2_RANGE______3_CM 1 0. 0. 1. DISPLAY_IDENTIFIER Vbx_moni_xx_req[16] ECU_ADDRESS 0xd000724c BIT_MASK 0x1 /end MEASUREMENT
/begin MEASUREMENT Vbx_moni_id_11_req "Activation of the identifier 11" UBYTE _CNV_S_2_RANGE______3_CM 1 0. 0. 1. DISPLAY_IDENTIFIER Vbx_moni_xx_req[17] ECU_ADDRESS 0xd000724d BIT_MASK 0x1 /end MEASUREMENT
/begin MEASUREMENT Vbx_moni_id_13_req "Activation of the identifier 13" UBYTE _CNV_S_2_RANGE______3_CM 1 0. 0. 1. DISPLAY_IDENTIFIER Vbx_moni_xx_req[19] ECU_ADDRESS 0xd000724f BIT_MASK 0x1 /end MEASUREMENT
/begin MEASUREMENT Vbx_moni_id_14_req "Activation of the identifier 14" UBYTE _CNV_S_2_RANGE______3_CM 1 0. 0. 1. DISPLAY_IDENTIFIER Vbx_moni_xx_req[20] ECU_ADDRESS 0xd0007250 BIT_MASK 0x1 /end MEASUREMENT
/begin MEASUREMENT Vbx_moni_id_18_req "Activation of the identifier 18" UBYTE _CNV_S_2_RANGE______3_CM 1 0. 0. 1. DISPLAY_IDENTIFIER Vbx_moni_xx_req[24] ECU_ADDRESS 0xd0007254 BIT_MASK 0x1 /end MEASUREMENT
/begin MEASUREMENT Vbx_byp_19_req "Activation of the identifier 19" UBYTE _CNV_S_2_RANGE______3_CM 1 0. 0. 1. DISPLAY_IDENTIFIER Vbx_moni_xx_req[25] ECU_ADDRESS 0xd0007255 BIT_MASK 0x1 /end MEASUREMENT
/begin MEASUREMENT Vbx_moni_id_1a_req "Activation of the identifier 1a" UBYTE _CNV_S_2_RANGE______3_CM 1 0. 0. 1. DISPLAY_IDENTIFIER Vbx_moni_xx_req[26] ECU_ADDRESS 0xd0007256 BIT_MASK 0x1 /end MEASUREMENT
/begin MEASUREMENT Vbx_moni_id_1b_req "Activation of the identifier 1b" UBYTE _CNV_S_2_RANGE______3_CM 1 0. 0. 1. DISPLAY_IDENTIFIER Vbx_moni_xx_req[27] ECU_ADDRESS 0xd0007257 BIT_MASK 0x1 /end MEASUREMENT
/begin MEASUREMENT Vbx_byp_1c_req "Activation of the identifier 1c" UBYTE _CNV_S_2_RANGE______3_CM 1 0. 0. 1. DISPLAY_IDENTIFIER Vbx_moni_xx_req[28] ECU_ADDRESS 0xd0007258 BIT_MASK 0x1 /end MEASUREMENT
/begin MEASUREMENT Vbx_byp_1d_req "Activation of the identifier 1d" UBYTE _CNV_S_2_RANGE______3_CM 1 0. 0. 1. DISPLAY_IDENTIFIER Vbx_moni_xx_req[29] ECU_ADDRESS 0xd0007259 BIT_MASK 0x1 /end MEASUREMENT
/begin MEASUREMENT Vbx_byp_1e_req "Activation of the identifier 1e" UBYTE _CNV_S_2_RANGE______3_CM 1 0. 0. 1. DISPLAY_IDENTIFIER Vbx_moni_xx_req[30] ECU_ADDRESS 0xd000725a BIT_MASK 0x1 /end MEASUREMENT
/begin MEASUREMENT Vbx_byp_1f_req "Activation of the identifier 1f" UBYTE _CNV_S_2_RANGE______3_CM 1 0. 0. 1. DISPLAY_IDENTIFIER Vbx_moni_xx_req[31] ECU_ADDRESS 0xd000725b BIT_MASK 0x1 /end MEASUREMENT
/begin MEASUREMENT Vbx_moni_id_20_req "Activation of the identifier 20" UBYTE _CNV_S_2_RANGE______3_CM 1 0. 0. 1. DISPLAY_IDENTIFIER Vbx_moni_xx_req[32] ECU_ADDRESS 0xd000725c BIT_MASK 0x1 /end MEASUREMENT
/begin MEASUREMENT Vbx_moni_id_21_req "Activation of the identifier 21" UBYTE _CNV_S_2_RANGE______3_CM 1 0. 0. 1. DISPLAY_IDENTIFIER Vbx_moni_xx_req[33] ECU_ADDRESS 0xd000725d BIT_MASK 0x1 /end MEASUREMENT
/begin MEASUREMENT Vbx_byp_25_req "Activation of the identifier 25" UBYTE _CNV_S_2_RANGE______3_CM 1 0. 0. 1. DISPLAY_IDENTIFIER Vbx_moni_xx_req[37] ECU_ADDRESS 0xd0007261 BIT_MASK 0x1 /end MEASUREMENT
/begin MEASUREMENT Vbx_byp_26_req "Activation of the identifier 26" UBYTE _CNV_S_2_RANGE______3_CM 1 0. 0. 1. DISPLAY_IDENTIFIER Vbx_moni_xx_req[38] ECU_ADDRESS 0xd0007262 BIT_MASK 0x1 /end MEASUREMENT
/begin MEASUREMENT Vbx_byp_29_req "Activation of the identifier 29" UBYTE _CNV_S_2_RANGE______3_CM 1 0. 0. 1. DISPLAY_IDENTIFIER Vbx_moni_xx_req[41] ECU_ADDRESS 0xd0007265 BIT_MASK 0x1 /end MEASUREMENT
/begin MEASUREMENT Vbx_byp_2b_req "Activation of the identifier 2b" UBYTE _CNV_S_2_RANGE______3_CM 1 0. 0. 1. DISPLAY_IDENTIFIER Vbx_moni_xx_req[43] ECU_ADDRESS 0xd0007267 BIT_MASK 0x1 /end MEASUREMENT
/begin MEASUREMENT Vbx_byp_2c_req "Activation of the identifier 2c" UBYTE _CNV_S_2_RANGE______3_CM 1 0. 0. 1. DISPLAY_IDENTIFIER Vbx_moni_xx_req[44] ECU_ADDRESS 0xd0007268 BIT_MASK 0x1 /end MEASUREMENT
/begin MEASUREMENT Vbx_byp_2d_req "Activation of the identifier 2d" UBYTE _CNV_S_2_RANGE______3_CM 1 0. 0. 1. DISPLAY_IDENTIFIER Vbx_moni_xx_req[45] ECU_ADDRESS 0xd0007269 BIT_MASK 0x1 /end MEASUREMENT
/begin MEASUREMENT Vbx_moni_id_30_req "Activation of the identifier 30" UBYTE _CNV_S_2_RANGE______3_CM 1 0. 0. 1. DISPLAY_IDENTIFIER Vbx_moni_xx_req[48] ECU_ADDRESS 0xd000726c BIT_MASK 0x1 /end MEASUREMENT
/begin MEASUREMENT Vbx_moni_id_31_req "Activation of the identifier 31" UBYTE _CNV_S_2_RANGE______3_CM 1 0. 0. 1. DISPLAY_IDENTIFIER Vbx_moni_xx_req[49] ECU_ADDRESS 0xd000726d BIT_MASK 0x1 /end MEASUREMENT
/begin MEASUREMENT Vbx_moni_id_32_req "Activation of the identifier 32" UBYTE _CNV_S_2_RANGE______3_CM 1 0. 0. 1. DISPLAY_IDENTIFIER Vbx_moni_xx_req[50] ECU_ADDRESS 0xd000726e BIT_MASK 0x1 /end MEASUREMENT
/begin MEASUREMENT Vbx_moni_id_33_req "Activation of the identifier 33" UBYTE _CNV_S_2_RANGE______3_CM 1 0. 0. 1. DISPLAY_IDENTIFIER Vbx_moni_xx_req[51] ECU_ADDRESS 0xd000726f BIT_MASK 0x1 /end MEASUREMENT
/begin MEASUREMENT Vbx_moni_id_34_req "Activation of the identifier 34" UBYTE _CNV_S_2_RANGE______3_CM 1 0. 0. 1. DISPLAY_IDENTIFIER Vbx_moni_xx_req[52] ECU_ADDRESS 0xd0007270 BIT_MASK 0x1 /end MEASUREMENT
/begin MEASUREMENT Vbx_moni_id_35_req "Activation of the identifier 35" UBYTE _CNV_S_2_RANGE______3_CM 1 0. 0. 1. DISPLAY_IDENTIFIER Vbx_moni_xx_req[53] ECU_ADDRESS 0xd0007271 BIT_MASK 0x1 /end MEASUREMENT
/begin MEASUREMENT Vbx_moni_id_36_req "Activation of the identifier 36" UBYTE _CNV_S_2_RANGE______3_CM 1 0. 0. 1. DISPLAY_IDENTIFIER Vbx_moni_xx_req[54] ECU_ADDRESS 0xd0007272 BIT_MASK 0x1 /end MEASUREMENT
/begin MEASUREMENT Vbx_moni_id_37_req "Activation of the identifier 37" UBYTE _CNV_S_2_RANGE______3_CM 1 0. 0. 1. DISPLAY_IDENTIFIER Vbx_moni_xx_req[55] ECU_ADDRESS 0xd0007273 BIT_MASK 0x1 /end MEASUREMENT
/begin MEASUREMENT Vbx_moni_id_38_req "Activation of the identifier 38" UBYTE _CNV_S_2_RANGE______3_CM 1 0. 0. 1. DISPLAY_IDENTIFIER Vbx_moni_xx_req[56] ECU_ADDRESS 0xd0007274 BIT_MASK 0x1 /end MEASUREMENT
/begin MEASUREMENT Vbx_moni_id_39_req "Activation of the identifier 39" UBYTE _CNV_S_2_RANGE______3_CM 1 0. 0. 1. DISPLAY_IDENTIFIER Vbx_moni_xx_req[57] ECU_ADDRESS 0xd0007275 BIT_MASK 0x1 /end MEASUREMENT
/begin MEASUREMENT Vbx_moni_id_3a_req "Activation of the identifier 3a" UBYTE _CNV_S_2_RANGE______3_CM 1 0. 0. 1. DISPLAY_IDENTIFIER Vbx_moni_xx_req[58] ECU_ADDRESS 0xd0007276 BIT_MASK 0x1 /end MEASUREMENT
/begin MEASUREMENT Vbx_moni_id_3b_req "Activation of the identifier 3b" UBYTE _CNV_S_2_RANGE______3_CM 1 0. 0. 1. DISPLAY_IDENTIFIER Vbx_moni_xx_req[59] ECU_ADDRESS 0xd0007277 BIT_MASK 0x1 /end MEASUREMENT
/begin MEASUREMENT Vbx_moni_id_3c_req "Activation of the identifier 3c" UBYTE _CNV_S_2_RANGE______3_CM 1 0. 0. 1. DISPLAY_IDENTIFIER Vbx_moni_xx_req[60] ECU_ADDRESS 0xd0007278 BIT_MASK 0x1 /end MEASUREMENT
/begin MEASUREMENT Vbx_byp_3d_req "Activation of the identifier 3d" UBYTE _CNV_S_2_RANGE______3_CM 1 0. 0. 1. DISPLAY_IDENTIFIER Vbx_moni_xx_req[61] ECU_ADDRESS 0xd0007279 BIT_MASK 0x1 /end MEASUREMENT
/begin MEASUREMENT Vbx_byp_3e_req "Activation of the identifier 3e" UBYTE _CNV_S_2_RANGE______3_CM 1 0. 0. 1. DISPLAY_IDENTIFIER Vbx_moni_xx_req[62] ECU_ADDRESS 0xd000727a BIT_MASK 0x1 /end MEASUREMENT
/begin MEASUREMENT Vbx_byp_40_req "Activation of the identifier 40" UBYTE _CNV_S_2_RANGE______3_CM 1 0. 0. 1. DISPLAY_IDENTIFIER Vbx_moni_xx_req[64] ECU_ADDRESS 0xd000727c BIT_MASK 0x1 /end MEASUREMENT
/begin MEASUREMENT Vbx_byp_43_req "Activation of the identifier 43" UBYTE _CNV_S_2_RANGE______3_CM 1 0. 0. 1. DISPLAY_IDENTIFIER Vbx_moni_xx_req[67] ECU_ADDRESS 0xd000727f BIT_MASK 0x1 /end MEASUREMENT
/begin MEASUREMENT Vbx_byp_44_req "Activation of the identifier 44" UBYTE _CNV_S_2_RANGE______3_CM 1 0. 0. 1. DISPLAY_IDENTIFIER Vbx_moni_xx_req[68] ECU_ADDRESS 0xd0007280 BIT_MASK 0x1 /end MEASUREMENT
/begin MEASUREMENT Vbx_byp_46_req "Activation of the identifier 46" UBYTE _CNV_S_2_RANGE______3_CM 1 0. 0. 1. DISPLAY_IDENTIFIER Vbx_moni_xx_req[70] ECU_ADDRESS 0xd0007282 BIT_MASK 0x1 /end MEASUREMENT
/begin MEASUREMENT Vbx_byp_47_req "Activation of the identifier 47" UBYTE _CNV_S_2_RANGE______3_CM 1 0. 0. 1. DISPLAY_IDENTIFIER Vbx_moni_xx_req[71] ECU_ADDRESS 0xd0007283 BIT_MASK 0x1 /end MEASUREMENT
/begin MEASUREMENT Vbx_byp_48_req "Activation of the identifier 48" UBYTE _CNV_S_2_RANGE______3_CM 1 0. 0. 1. DISPLAY_IDENTIFIER Vbx_moni_xx_req[72] ECU_ADDRESS 0xd0007284 BIT_MASK 0x1 /end MEASUREMENT
/begin MEASUREMENT Vbx_byp_49_req "Activation of the identifier 49" UBYTE _CNV_S_2_RANGE______3_CM 1 0. 0. 1. DISPLAY_IDENTIFIER Vbx_moni_xx_req[73] ECU_ADDRESS 0xd0007285 BIT_MASK 0x1 /end MEASUREMENT
/begin MEASUREMENT Vbx_byp_4a_req "Activation of the identifier 4a" UBYTE _CNV_S_2_RANGE______3_CM 1 0. 0. 1. DISPLAY_IDENTIFIER Vbx_moni_xx_req[74] ECU_ADDRESS 0xd0007286 BIT_MASK 0x1 /end MEASUREMENT
/begin MEASUREMENT Vbx_byp_4b_req "Activation of the identifier 4b" UBYTE _CNV_S_2_RANGE______3_CM 1 0. 0. 1. DISPLAY_IDENTIFIER Vbx_moni_xx_req[75] ECU_ADDRESS 0xd0007287 BIT_MASK 0x1 /end MEASUREMENT
/begin MEASUREMENT Vbx_byp_4c_req "Activation of the identifier 4c" UBYTE _CNV_S_2_RANGE______3_CM 1 0. 0. 1. DISPLAY_IDENTIFIER Vbx_moni_xx_req[76] ECU_ADDRESS 0xd0007288 BIT_MASK 0x1 /end MEASUREMENT
/begin MEASUREMENT Vbx_byp_4d_req "Activation of the identifier 4d" UBYTE _CNV_S_2_RANGE______3_CM 1 0. 0. 1. DISPLAY_IDENTIFIER Vbx_moni_xx_req[77] ECU_ADDRESS 0xd0007289 BIT_MASK 0x1 /end MEASUREMENT
/begin MEASUREMENT Vbx_byp_4e_req "Activation of the identifier 4e" UBYTE _CNV_S_2_RANGE______3_CM 1 0. 0. 1. DISPLAY_IDENTIFIER Vbx_moni_xx_req[78] ECU_ADDRESS 0xd000728a BIT_MASK 0x1 /end MEASUREMENT
/begin MEASUREMENT Vbx_byp_4f_req "Activation of identifier 4f control" UBYTE _CNV_S_2_RANGE______3_CM 1 0. 0. 1. DISPLAY_IDENTIFIER Vbx_moni_xx_req[79] ECU_ADDRESS 0xd000728b BIT_MASK 0x1 /end MEASUREMENT
/begin MEASUREMENT Vbx_byp_51_req "Activation of the identifier 51" UBYTE _CNV_S_2_RANGE______3_CM 1 0. 0. 1. DISPLAY_IDENTIFIER Vbx_moni_xx_req[81] ECU_ADDRESS 0xd000728d BIT_MASK 0x1 /end MEASUREMENT
/begin MEASUREMENT Vbx_byp_52_req "Activation of the identifier 52" UBYTE _CNV_S_2_RANGE______3_CM 1 0. 0. 1. DISPLAY_IDENTIFIER Vbx_moni_xx_req[82] ECU_ADDRESS 0xd000728e BIT_MASK 0x1 /end MEASUREMENT
/begin MEASUREMENT Vbx_byp_60_req "Activation of the identifier 60" UBYTE _CNV_S_2_RANGE______3_CM 1 0. 0. 1. DISPLAY_IDENTIFIER Vbx_moni_xx_req[96] ECU_ADDRESS 0xd000729c BIT_MASK 0x1 /end MEASUREMENT
/begin MEASUREMENT Vbx_byp_61_req "Activation of the identifier 61" UBYTE _CNV_S_2_RANGE______3_CM 1 0. 0. 1. DISPLAY_IDENTIFIER Vbx_moni_xx_req[97] ECU_ADDRESS 0xd000729d BIT_MASK 0x1 /end MEASUREMENT
/begin MEASUREMENT Vbx_byp_62_req "Activation of the identifier 62" UBYTE _CNV_S_2_RANGE______3_CM 1 0. 0. 1. DISPLAY_IDENTIFIER Vbx_moni_xx_req[98] ECU_ADDRESS 0xd000729e BIT_MASK 0x1 /end MEASUREMENT
/begin MEASUREMENT Vbx_byp_63_req "Activation of the identifier 63" UBYTE _CNV_S_2_RANGE______3_CM 1 0. 0. 1. DISPLAY_IDENTIFIER Vbx_moni_xx_req[99] ECU_ADDRESS 0xd000729f BIT_MASK 0x1 /end MEASUREMENT
/begin MEASUREMENT Vbx_byp_64_req "Activation of the identifier 64" UBYTE _CNV_S_2_RANGE______3_CM 1 0. 0. 1. DISPLAY_IDENTIFIER Vbx_moni_xx_req[100] ECU_ADDRESS 0xd00072a0 BIT_MASK 0x1 /end MEASUREMENT
/begin MEASUREMENT Vbx_byp_65_req "Activation of the identifier 65" UBYTE _CNV_S_2_RANGE______3_CM 1 0. 0. 1. DISPLAY_IDENTIFIER Vbx_moni_xx_req[101] ECU_ADDRESS 0xd00072a1 BIT_MASK 0x1 /end MEASUREMENT
/begin MEASUREMENT Vbx_byp_66_req "Activation of the identifier 66" UBYTE _CNV_S_2_RANGE______3_CM 1 0. 0. 1. DISPLAY_IDENTIFIER Vbx_moni_xx_req[102] ECU_ADDRESS 0xd00072a2 BIT_MASK 0x1 /end MEASUREMENT
/begin MEASUREMENT Vbx_byp_67_req "Activation of the identifier 67" UBYTE _CNV_S_2_RANGE______3_CM 1 0. 0. 1. DISPLAY_IDENTIFIER Vbx_moni_xx_req[103] ECU_ADDRESS 0xd00072a3 BIT_MASK 0x1 /end MEASUREMENT
/begin MEASUREMENT Vbx_byp_68_req "Activation of the identifier 68" UBYTE _CNV_S_2_RANGE______3_CM 1 0. 0. 1. DISPLAY_IDENTIFIER Vbx_moni_xx_req[104] ECU_ADDRESS 0xd00072a4 BIT_MASK 0x1 /end MEASUREMENT
/begin MEASUREMENT Vbx_byp_69_req "Activation of the identifier 69" UBYTE _CNV_S_2_RANGE______3_CM 1 0. 0. 1. DISPLAY_IDENTIFIER Vbx_moni_xx_req[105] ECU_ADDRESS 0xd00072a5 BIT_MASK 0x1 /end MEASUREMENT
/begin MEASUREMENT Vbx_byp_6a_req "Activation of the identifier 6a" UBYTE _CNV_S_2_RANGE______3_CM 1 0. 0. 1. DISPLAY_IDENTIFIER Vbx_moni_xx_req[106] ECU_ADDRESS 0xd00072a6 BIT_MASK 0x1 /end MEASUREMENT
/begin MEASUREMENT Vbx_byp_6b_req "Activation of the identifier 6b" UBYTE _CNV_S_2_RANGE______3_CM 1 0. 0. 1. DISPLAY_IDENTIFIER Vbx_moni_xx_req[107] ECU_ADDRESS 0xd00072a7 BIT_MASK 0x1 /end MEASUREMENT
/begin MEASUREMENT Vbx_byp_6c_req "Activation of the identifier 6c" UBYTE _CNV_S_2_RANGE______3_CM 1 0. 0. 1. DISPLAY_IDENTIFIER Vbx_moni_xx_req[108] ECU_ADDRESS 0xd00072a8 BIT_MASK 0x1 /end MEASUREMENT
/begin MEASUREMENT Vbx_byp_6d_req "Activation of the identifier 6d" UBYTE _CNV_S_2_RANGE______3_CM 1 0. 0. 1. DISPLAY_IDENTIFIER Vbx_moni_xx_req[109] ECU_ADDRESS 0xd00072a9 BIT_MASK 0x1 /end MEASUREMENT
/begin MEASUREMENT Vbx_byp_6e_req "Activation of the identifier 6e" UBYTE _CNV_S_2_RANGE______3_CM 1 0. 0. 1. DISPLAY_IDENTIFIER Vbx_moni_xx_req[110] ECU_ADDRESS 0xd00072aa BIT_MASK 0x1 /end MEASUREMENT
/begin MEASUREMENT Vbx_byp_6f_req "Activation of the identifier 6f" UBYTE _CNV_S_2_RANGE______3_CM 1 0. 0. 1. DISPLAY_IDENTIFIER Vbx_moni_xx_req[111] ECU_ADDRESS 0xd00072ab BIT_MASK 0x1 /end MEASUREMENT
/begin MEASUREMENT Vbx_byp_70_req "Activation of the identifier 70" UBYTE _CNV_S_2_RANGE______3_CM 1 0. 0. 1. DISPLAY_IDENTIFIER Vbx_moni_xx_req[112] ECU_ADDRESS 0xd00072ac BIT_MASK 0x1 /end MEASUREMENT
/begin MEASUREMENT Vbx_byp_71_req "Activation of the identifier 71" UBYTE _CNV_S_2_RANGE______3_CM 1 0. 0. 1. DISPLAY_IDENTIFIER Vbx_moni_xx_req[113] ECU_ADDRESS 0xd00072ad BIT_MASK 0x1 /end MEASUREMENT
/begin MEASUREMENT Vbx_byp_79_req "Activation of the identifier 79" UBYTE _CNV_S_2_RANGE______3_CM 1 0. 0. 1. DISPLAY_IDENTIFIER Vbx_moni_xx_req[121] ECU_ADDRESS 0xd00072b5 BIT_MASK 0x1 /end MEASUREMENT
/begin MEASUREMENT Vbx_byp_81_req "Activation of the identifier 81" UBYTE _CNV_S_2_RANGE______3_CM 1 0. 0. 1. DISPLAY_IDENTIFIER Vbx_moni_xx_req[129] ECU_ADDRESS 0xd00072bd BIT_MASK 0x1 /end MEASUREMENT
/begin MEASUREMENT Vbx_byp_82_req "Activation of the identifier 82" UBYTE _CNV_S_2_RANGE______3_CM 1 0. 0. 1. DISPLAY_IDENTIFIER Vbx_moni_xx_req[130] ECU_ADDRESS 0xd00072be BIT_MASK 0x1 /end MEASUREMENT
/begin MEASUREMENT Vbx_byp_83_req "Activation of the identifier 83" UBYTE _CNV_S_2_RANGE______3_CM 1 0. 0. 1. DISPLAY_IDENTIFIER Vbx_moni_xx_req[131] ECU_ADDRESS 0xd00072bf BIT_MASK 0x1 /end MEASUREMENT
/begin MEASUREMENT Vbx_byp_84_req "Activation of the identifier 84" UBYTE _CNV_S_2_RANGE______3_CM 1 0. 0. 1. DISPLAY_IDENTIFIER Vbx_moni_xx_req[132] ECU_ADDRESS 0xd00072c0 BIT_MASK 0x1 /end MEASUREMENT
/begin MEASUREMENT Vbx_byp_85_req "Activation of the identifier 85" UBYTE _CNV_S_2_RANGE______3_CM 1 0. 0. 1. DISPLAY_IDENTIFIER Vbx_moni_xx_req[133] ECU_ADDRESS 0xd00072c1 BIT_MASK 0x1 /end MEASUREMENT
/begin MEASUREMENT Vbx_byp_86_req "Activation of the identifier 86" UBYTE _CNV_S_2_RANGE______3_CM 1 0. 0. 1. DISPLAY_IDENTIFIER Vbx_moni_xx_req[134] ECU_ADDRESS 0xd00072c2 BIT_MASK 0x1 /end MEASUREMENT
/begin MEASUREMENT Vbx_byp_87_req "Activation of the identifier 87" UBYTE _CNV_S_2_RANGE______3_CM 1 0. 0. 1. DISPLAY_IDENTIFIER Vbx_moni_xx_req[135] ECU_ADDRESS 0xd00072c3 BIT_MASK 0x1 /end MEASUREMENT
/begin MEASUREMENT Vbx_byp_88_req "Activation of the identifier 88" UBYTE _CNV_S_2_RANGE______3_CM 1 0. 0. 1. DISPLAY_IDENTIFIER Vbx_moni_xx_req[136] ECU_ADDRESS 0xd00072c4 BIT_MASK 0x1 /end MEASUREMENT
/begin MEASUREMENT Vbx_rout_run_stt "Routine running state (1=one routine running 0=no routine running)" UBYTE _CNV_S_2_RANGE______3_CM 1 0. 0. 1. ECU_ADDRESS 0xd0007d05 BIT_MASK 0x1 /end MEASUREMENT
/begin MEASUREMENT Vbx_start_cdn "Routine start condtions satisfied (1=satisfied 0=not satisfied)" UBYTE _CNV_S_2_RANGE______3_CM 1 0. 0. 1. ECU_ADDRESS 0xd0007d06 BIT_MASK 0x1 /end MEASUREMENT
/begin MEASUREMENT Vbx_stop_cdn "Routine stop condtions satisfied (1=satisfied 0=not satisfied)" UBYTE _CNV_S_2_RANGE______3_CM 1 0. 0. 1. ECU_ADDRESS 0xd0007d07 BIT_MASK 0x1 /end MEASUREMENT
/begin MEASUREMENT Vbx_tac_cdn "Indicates if generic actuator test conditions are fulfilled" UBYTE _CNV_S_2_RANGE______3_CM 1 0. 0. 1. ECU_ADDRESS 0xd0007407 BIT_MASK 0x1 /end MEASUREMENT
/begin MEASUREMENT Vbx_tac_ena "Indicates if any I/O control is in progress" UBYTE _CNV_S_2_RANGE______3_CM 1 0. 0. 1. ECU_ADDRESS 0xd0007408 BIT_MASK 0x1 /end MEASUREMENT
/begin MEASUREMENT Vbx_tac_tout "Indicates if a timeout occurs when a supplier component is driven" UBYTE _CNV_S_2_RANGE______3_CM 1 0. 0. 1. ECU_ADDRESS 0xd0007409 BIT_MASK 0x1 /end MEASUREMENT
/begin MEASUREMENT Vbx_valid_req "Tool request validity (1=valid request 0=invalid request)" UBYTE _CNV_S_2_RANGE______3_CM 1 0. 0. 1. ECU_ADDRESS 0xd0007d08 BIT_MASK 0x1 /end MEASUREMENT
/begin MEASUREMENT Vsx_diag_sta_moni_stt "Monitool routine status" UBYTE _CNV_S_4_WI_Vsx_dia_531_CM 1 0. 0. 3. ECU_ADDRESS 0xd0007325 /end MEASUREMENT
/begin MEASUREMENT Vsx_diag_sta_stac_stt "Supplier actuator LID intermediary status" UBYTE _CNV_S_4_WI_Vsx_dia_531_CM 1 0. 0. 3. ECU_ADDRESS 0xd00073f4 /end MEASUREMENT
/begin MEASUREMENT Vsx_opt "Memorized option control" UBYTE _CNV_S_3_WI_Vsx_opt_532_CM 1 0. 0. 11. ECU_ADDRESS 0xd00073f5 /end MEASUREMENT
/begin MEASUREMENT Vsx_tac_22_stt "Supplier flow actuator (VCV) intermediary status" UBYTE _CNV_S_4_WI_Vsx_tac_533_CM 1 0. 1. 12. ECU_ADDRESS 0xd00073f6 /end MEASUREMENT
/begin MEASUREMENT Vsx_tac_23_stt "Supplier rail pressure regulator (PCV) intermediary status" UBYTE _CNV_S_4_WI_Vsx_tac_533_CM 1 0. 1. 12. ECU_ADDRESS 0xd00073f7 /end MEASUREMENT
/begin MEASUREMENT Vsx_tac_24_stt "Supplier oxygen upper sensor heater intermediary status" UBYTE _CNV_S_4_WI_Vsx_tac_533_CM 1 0. 1. 12. ECU_ADDRESS 0xd00073f8 /end MEASUREMENT
/begin MEASUREMENT Vsx_tac_25_stt "Supplier oxygen lower sensor heater intermediary status" UBYTE _CNV_S_4_WI_Vsx_tac_533_CM 1 0. 1. 12. ECU_ADDRESS 0xd00073f9 /end MEASUREMENT
/begin MEASUREMENT Vsx_tac_29_stt "Supplier ignition coil 1 intermediary status" UBYTE _CNV_S_4_WI_Vsx_tac_533_CM 1 0. 1. 12. ECU_ADDRESS 0xd00073fa /end MEASUREMENT
/begin MEASUREMENT Vsx_tac_30_stt "Supplier ignition coil 2 intermediary status" UBYTE _CNV_S_4_WI_Vsx_tac_533_CM 1 0. 1. 12. ECU_ADDRESS 0xd00073fb /end MEASUREMENT
/begin MEASUREMENT Vsx_tac_31_stt "Supplier ignition coil 3 intermediary status" UBYTE _CNV_S_4_WI_Vsx_tac_533_CM 1 0. 1. 12. ECU_ADDRESS 0xd00073fc /end MEASUREMENT
/begin MEASUREMENT Vsx_tac_32_stt "Supplier ignition coil 4 intermediary status" UBYTE _CNV_S_4_WI_Vsx_tac_533_CM 1 0. 1. 12. ECU_ADDRESS 0xd00073fd /end MEASUREMENT
/begin MEASUREMENT Vsx_tac_35_stt "Supplier fuel injector 1 intermediary status" UBYTE _CNV_S_4_WI_Vsx_tac_533_CM 1 0. 1. 12. ECU_ADDRESS 0xd00073fe /end MEASUREMENT
/begin MEASUREMENT Vsx_tac_36_stt "Supplier fuel injector 2 intermediary status" UBYTE _CNV_S_4_WI_Vsx_tac_533_CM 1 0. 1. 12. ECU_ADDRESS 0xd00073ff /end MEASUREMENT
/begin MEASUREMENT Vsx_tac_37_stt "Supplier fuel injector 3 intermediary status" UBYTE _CNV_S_4_WI_Vsx_tac_533_CM 1 0. 1. 12. ECU_ADDRESS 0xd0007400 /end MEASUREMENT
/begin MEASUREMENT Vsx_tac_38_stt "Supplier fuel injector 4 intermediary status" UBYTE _CNV_S_4_WI_Vsx_tac_533_CM 1 0. 1. 12. ECU_ADDRESS 0xd0007401 /end MEASUREMENT
/begin MEASUREMENT Vsx_tac_stt "Current component status returned to build positive or negative answer" UBYTE _CNV_S_6_WI_Vsx_tac_534_CM 1 0. 1. 22. ECU_ADDRESS 0xd0007402 /end MEASUREMENT
/begin MEASUREMENT Vxx_LID "Memorized requested actuator identifier" UBYTE _CNV_R_R_VA_I_16_503_CM 1 0. 0. 255. ECU_ADDRESS 0xd0007403 FORMAT "%3.0" /end MEASUREMENT
/begin MEASUREMENT Vxx_byp_06_sub_val "Replacement value requested to control identifier 06" UWORD _CNV_R_R_rkcmmwd_dn_535_CM 1 0. 0. 1. ECU_ADDRESS 0xd0004bd8 FORMAT "%5.3" /end MEASUREMENT
/begin MEASUREMENT Vxx_byp_0a_sub_val "Replacement value requested by Monitool to control identifier 0a" UBYTE _CNV_S_2_RANGE______3_CM 1 0. 0. 1. ECU_ADDRESS 0xd00072c5 BIT_MASK 0x1 /end MEASUREMENT
/begin MEASUREMENT Vxx_byp_19_sub_val "Replacement value requested to control identifier 19" UBYTE _CNV_R_R_jDCaqEa_tl_536_CM 1 0. 0. 100. ECU_ADDRESS 0xd00072cb FORMAT "%12.8" /end MEASUREMENT
/begin MEASUREMENT Vxx_byp_1c_sub_val "Replacement value requested to control identifier 1c" UWORD _CNV_R_R_gBspFma_cr_526_CM 1 0. 0. 200. ECU_ADDRESS 0xd0004bda FORMAT "%6.2" /end MEASUREMENT
/begin MEASUREMENT Vxx_byp_2b_sub_val "Replacement value requested by Monitool to control identifier 2b" UBYTE _CNV_S_2_RANGE______3_CM 1 0. 0. 1. ECU_ADDRESS 0xd00072c6 /end MEASUREMENT
/begin MEASUREMENT Vxx_byp_2c_sub_val "Replacement value requested to control identifier 2c" UWORD _CNV_R_R_qkkoDkb_kn_537_CM 1 0. 0. 720. ECU_ADDRESS 0xd0004bdc FORMAT "%5.2" /end MEASUREMENT
/begin MEASUREMENT Vxx_byp_2d_sub_val "Replacement value requested to control identifier 2d" UWORD _CNV_R_R_gBspFma_cr_526_CM 1 0. 0. 200. ECU_ADDRESS 0xd0004bde FORMAT "%5.2" /end MEASUREMENT
/begin MEASUREMENT Vxx_byp_44_sub_val "Replacement value requested by Monitool to control identifier 44" UBYTE _CNV_S_2_RANGE______3_CM 1 0. 0. 1. ECU_ADDRESS 0xd00072c7 BIT_MASK 0x1 /end MEASUREMENT
/begin MEASUREMENT Vxx_byp_46_sub_val "Replacement value requested by Monitool to control identifier 46" UBYTE _CNV_S_2_RANGE______3_CM 1 0. 0. 1. ECU_ADDRESS 0xd00072c8 BIT_MASK 0x1 /end MEASUREMENT
/begin MEASUREMENT Vxx_byp_47_sub_val "Replacement value requested by Monitool to control identifier 47" UBYTE _CNV_S_2_RANGE______3_CM 1 0. 0. 1. ECU_ADDRESS 0xd00072c9 BIT_MASK 0x1 /end MEASUREMENT
/begin MEASUREMENT Vxx_byp_51_sub_val "Replacement value requested by Monitool to control identifier 51" UBYTE _CNV_R_R_xytAqxd_qA_527_CM 1 0. 0. 100. ECU_ADDRESS 0xd00072cc FORMAT "%12.8" /end MEASUREMENT
/begin MEASUREMENT Vxx_byp_52_sub_val "Replacement value requested by Monitool to control identifier 52" UBYTE _CNV_R_R_xytAqxd_qA_527_CM 1 0. 0. 100. ECU_ADDRESS 0xd00072cd FORMAT "%12.8" /end MEASUREMENT
/begin MEASUREMENT Vxx_byp_60_sub_val "Replacement value requested by Monitool to control identifier 60" ULONG _CNV_R_R_CsFwmpa_Al_538_CM 1 0. 0. 500000. ECU_ADDRESS 0xd0002cc8 FORMAT "%6.0" /end MEASUREMENT
/begin MEASUREMENT Vxx_byp_61_sub_val "Replacement value requested by Monitool to control identifier 61" ULONG _CNV_R_R_CsFwmpa_Al_538_CM 1 0. 0. 500000. ECU_ADDRESS 0xd0002ccc FORMAT "%6.0" /end MEASUREMENT
/begin MEASUREMENT Vxx_byp_62_sub_val "Replacement value requested by Monitool to control identifier 62" ULONG _CNV_R_R_CsFwmpa_Al_538_CM 1 0. 0. 500000. ECU_ADDRESS 0xd0002cd0 FORMAT "%6.0" /end MEASUREMENT
/begin MEASUREMENT Vxx_byp_63_sub_val "Replacement value requested by Monitool to control identifier 63" ULONG _CNV_R_R_CsFwmpa_Al_538_CM 1 0. 0. 500000. ECU_ADDRESS 0xd0002cd4 FORMAT "%6.0" /end MEASUREMENT
/begin MEASUREMENT Vxx_byp_64_sub_val "Replacement value requested by Monitool to control identifier 64" ULONG _CNV_R_R_CsFwmpa_Al_538_CM 1 0. 0. 500000. ECU_ADDRESS 0xd0002cd8 FORMAT "%6.0" /end MEASUREMENT
/begin MEASUREMENT Vxx_byp_65_sub_val "Replacement value requested by Monitool to control identifier 65" ULONG _CNV_R_R_CsFwmpa_Al_538_CM 1 0. 0. 500000. ECU_ADDRESS 0xd0002cdc FORMAT "%6.0" /end MEASUREMENT
/begin MEASUREMENT Vxx_byp_66_sub_val "Replacement value requested by Monitool to control identifier 66" ULONG _CNV_R_R_CsFwmpa_Al_538_CM 1 0. 0. 500000. ECU_ADDRESS 0xd0002ce0 FORMAT "%6.0" /end MEASUREMENT
/begin MEASUREMENT Vxx_byp_67_sub_val "Replacement value requested by Monitool to control identifier 67" ULONG _CNV_R_R_CsFwmpa_Al_538_CM 1 0. 0. 500000. ECU_ADDRESS 0xd0002ce4 FORMAT "%6.0" /end MEASUREMENT
/begin MEASUREMENT Vxx_byp_68_sub_val "Replacement value requested by Monitool to control identifier 68" UBYTE _CNV_R_R_ilwggEa_nw_539_CM 1 0. 0. 765. ECU_ADDRESS 0xd00072ce FORMAT "%3.0" /end MEASUREMENT
/begin MEASUREMENT Vxx_byp_69_sub_val "Replacement value requested by Monitool to control identifier 69" UBYTE _CNV_R_R_ilwggEa_nw_539_CM 1 0. 0. 765. ECU_ADDRESS 0xd00072cf FORMAT "%3.0" /end MEASUREMENT
/begin MEASUREMENT Vxx_byp_6a_sub_val "Replacement value requested by Monitool to control identifier 6a" UBYTE _CNV_R_R_ilwggEa_nw_539_CM 1 0. 0. 765. ECU_ADDRESS 0xd00072d0 FORMAT "%3.0" /end MEASUREMENT
/begin MEASUREMENT Vxx_byp_6b_sub_val "Replacement value requested by Monitool to control identifier 6b" UBYTE _CNV_R_R_ilwggEa_nw_539_CM 1 0. 0. 765. ECU_ADDRESS 0xd00072d1 FORMAT "%3.0" /end MEASUREMENT
/begin MEASUREMENT Vxx_byp_6c_sub_val "Replacement value requested by Monitool to control identifier 6c" UBYTE _CNV_R_R_ilwggEa_nw_539_CM 1 0. 0. 765. ECU_ADDRESS 0xd00072d2 FORMAT "%3.0" /end MEASUREMENT
/begin MEASUREMENT Vxx_byp_6d_sub_val "Replacement value requested by Monitool to control identifier 6d" UBYTE _CNV_R_R_ilwggEa_nw_539_CM 1 0. 0. 765. ECU_ADDRESS 0xd00072d3 FORMAT "%3.0" /end MEASUREMENT
/begin MEASUREMENT Vxx_byp_6e_sub_val "Replacement value requested by Monitool to control identifier 6e" UBYTE _CNV_R_R_ilwggEa_nw_539_CM 1 0. 0. 765. ECU_ADDRESS 0xd00072d4 FORMAT "%3.0" /end MEASUREMENT
/begin MEASUREMENT Vxx_byp_6f_sub_val "Replacement value requested by Monitool to control identifier 6f" UBYTE _CNV_R_R_ilwggEa_nw_539_CM 1 0. 0. 765. ECU_ADDRESS 0xd00072d5 FORMAT "%3.0" /end MEASUREMENT
/begin MEASUREMENT Vxx_byp_71_sub_val "Replacement value requested by Monitool to control identifier 71" UBYTE _CNV_R_R_xytAqxd_qA_527_CM 1 0. 0. 100. ECU_ADDRESS 0xd00072d6 FORMAT "%12.8" /end MEASUREMENT
/begin MEASUREMENT Vxx_byp_79_sub_val "Replacement value requested by Monitool to control identifier 79" UWORD _CNV_R_R_Edjqxvd_mq_528_CM 1 0. 0. 100. ECU_ADDRESS 0xd0004be0 FORMAT "%12.8" /end MEASUREMENT
/begin MEASUREMENT Vxx_clock_ecu "Number of the trame in ECU" UBYTE _CNV_R_R_VA_I_16_503_CM 1 0. 0. 255. ECU_ADDRESS 0xd0007326 FORMAT "%3.0" /end MEASUREMENT
/begin MEASUREMENT Vxx_clock_init_timeout "Byte 5 of the request" UBYTE _CNV_R_R_VA_I_16_503_CM 1 0. 0. 255. ECU_ADDRESS 0xd0007327 FORMAT "%3.0" /end MEASUREMENT
/begin MEASUREMENT Vxx_ext_ctrl_eng_test_sf "External controls denial engine status flags" UWORD _CNV_R_R_VA_I_16_503_CM 1 0. 0. 65535. ECU_ADDRESS 0xd0004bea FORMAT "%5.0" /end MEASUREMENT
/begin MEASUREMENT Vxx_ext_ctrl_test_sf "External controls denial status flags" UWORD _CNV_R_R_VA_I_16_503_CM 1 0. 0. 65535. ECU_ADDRESS 0xd0006112 FORMAT "%5.0" /end MEASUREMENT
/begin MEASUREMENT Vxx_init_timeout "New timeout initialization request" UBYTE _CNV_R_R_VA_I_16_503_CM 1 0. 0. 255. ECU_ADDRESS 0xd0007328 FORMAT "%3.0" /end MEASUREMENT
/begin MEASUREMENT Vxx_moni_id_01_sub_val "Replacement value requested by Monitool to control identifier 01" UWORD _CNV_R_R_tAmwcfc_Da_540_CM 1 0. 0. 16383.75 ECU_ADDRESS 0xd0004be2 FORMAT "%8.2" /end MEASUREMENT
/begin MEASUREMENT Vxx_moni_nr_tot_id "Number of identifiers in the request" UBYTE _CNV_R_R_VA_I_16_503_CM 1 0. 0. 255. ECU_ADDRESS 0xd0007329 FORMAT "%3.0" /end MEASUREMENT
/begin MEASUREMENT Vxx_moni_sf_spv "Monitool supervisor status byte" UBYTE _CNV_R_R_VA_I_16_503_CM 1 0. 0. 255. ECU_ADDRESS 0xd000732a FORMAT "%3.0" /end MEASUREMENT
/begin MEASUREMENT Vxx_tac_tout_timer "Timeout timer" UWORD _CNV_R_R_nCcfksc_mn_525_CM 1 0. 0. 65.535 ECU_ADDRESS 0xd0004bec /end MEASUREMENT
/begin MEASUREMENT Vxx_timeout "Byte 4 of the request" UBYTE _CNV_R_R_VA_I_16_503_CM 1 0. 0. 255. ECU_ADDRESS 0xd000732b FORMAT "%3.0" /end MEASUREMENT
/begin CHARACTERISTIC Cbx_diag_in_vvtc_ena_cam_crk_df "VVTC (aftersales) actuation tests allowd with detected failure on camshaft or crankshaft sensors" VALUE 0xa00221a8 _REC_S1VAL_Normal_u1 1. _CNV_S_2_RANGE______3_CM 0. 1. /end CHARACTERISTIC
/begin CHARACTERISTIC Cbx_ext_ctrl_pdl_cdn_ena "Enable pedals safety conditions for external controls" VALUE 0xa0022196 _REC_S1VAL_Normal_u1 1. _CNV_S_2_RANGE______3_CM 0. 1. /end CHARACTERISTIC
/begin CHARACTERISTIC Cbx_ext_ctrl_sens_spg_dsb "Disable (for naturally aspirated engines) external controls condition on boost pressure" VALUE 0xa0022192 _REC_S1VAL_Normal_u1 1. _CNV_S_2_RANGE______3_CM 0. 1. /end CHARACTERISTIC
/begin CHARACTERISTIC Cbx_ext_ctrl_vh_cdn_dsb "Disable vehicle safety conditions for external controls" VALUE 0xa0022197 _REC_S1VAL_Normal_u1 1. _CNV_S_2_RANGE______3_CM 0. 1. /end CHARACTERISTIC
/begin CHARACTERISTIC Cbx_it_ofs_clos_frst_dsb "Disables offset closed learning condition to allow throttle control " VALUE 0xa00221bf _REC_S1VAL_Normal_u1 1. _CNV_S_2_RANGE______3_CM 0. 1. /end CHARACTERISTIC
/begin CHARACTERISTIC Cbx_it_ofs_open_frst_dsb "Disables offset open learning condition to allow throttle control " VALUE 0xa00221c0 _REC_S1VAL_Normal_u1 1. _CNV_S_2_RANGE______3_CM 0. 1. /end CHARACTERISTIC
/begin CHARACTERISTIC Csx_tac_01 "Allowed tests for gazoline electronic throttle" VALUE 0xa00221b2 _REC_S1VAL_Normal_u1 255. _CNV_R_R_VA_I_16_503_CM 0. 255. FORMAT "%3.0" /end CHARACTERISTIC
/begin CHARACTERISTIC Csx_tac_02 "Allowed tests for fuel pump and its relay" VALUE 0xa00221b3 _REC_S1VAL_Normal_u1 255. _CNV_R_R_VA_I_16_503_CM 0. 255. FORMAT "%3.0" /end CHARACTERISTIC
/begin CHARACTERISTIC Csx_tac_03 "Allowed tests for FAN1 and its relay" VALUE 0xa00221b4 _REC_S1VAL_Normal_u1 255. _CNV_R_R_VA_I_16_503_CM 0. 255. FORMAT "%3.0" /end CHARACTERISTIC
/begin CHARACTERISTIC Csx_tac_04 "Allowed tests for FAN2 and its relay" VALUE 0xa00221b5 _REC_S1VAL_Normal_u1 255. _CNV_R_R_VA_I_16_503_CM 0. 255. FORMAT "%3.0" /end CHARACTERISTIC
/begin CHARACTERISTIC Csx_tac_05 "Allowed tests for electronic water pump for turbocharger cooling" VALUE 0xa00221b6 _REC_S1VAL_Normal_u1 255. _CNV_R_R_VA_I_16_503_CM 0. 255. FORMAT "%3.0" /end CHARACTERISTIC
/begin CHARACTERISTIC Csx_tac_06 "Allowed tests for defrosting PTC" VALUE 0xa00221b7 _REC_S1VAL_Normal_u1 255. _CNV_R_R_VA_I_16_503_CM 0. 255. FORMAT "%3.0" /end CHARACTERISTIC
/begin CHARACTERISTIC Csx_tac_07 "Allowed tests for VVT control solenoid" VALUE 0xa00221b8 _REC_S1VAL_Normal_u1 255. _CNV_R_R_VA_I_16_503_CM 0. 255. FORMAT "%3.0" /end CHARACTERISTIC
/begin CHARACTERISTIC Csx_tac_08 "Allowed tests for gazoline turbocharger command valve" VALUE 0xa00221b9 _REC_S1VAL_Normal_u1 255. _CNV_R_R_VA_I_16_503_CM 0. 255. FORMAT "%3.0" /end CHARACTERISTIC
/begin CHARACTERISTIC Csx_tac_09 "Allowed tests for upstream oxygen lamda sensor" VALUE 0xa00221ba _REC_S1VAL_Normal_u1 255. _CNV_R_R_VA_I_16_503_CM 0. 255. FORMAT "%3.0" /end CHARACTERISTIC
/begin CHARACTERISTIC Csx_tac_10 "Allowed tests for downstream oxygen lamda sensor" VALUE 0xa00221bb _REC_S1VAL_Normal_u1 255. _CNV_R_R_VA_I_16_503_CM 0. 255. FORMAT "%3.0" /end CHARACTERISTIC
/begin CHARACTERISTIC Csx_tac_20 "Allowed test for Canister drain valve" VALUE 0xa00221bc _REC_S1VAL_Normal_u1 255. _CNV_R_R_VA_I_16_503_CM 0. 255. FORMAT "%3.0" /end CHARACTERISTIC
/begin CHARACTERISTIC Csx_tac_22 "Allowed test for flow actuator" VALUE 0xa00221c1 _REC_S1VAL_Normal_u1 255. _CNV_R_R_VA_I_16_503_CM 0. 255. FORMAT "%3.0" /end CHARACTERISTIC
/begin CHARACTERISTIC Csx_tac_23 "Allowed test for rail pressure regulator" VALUE 0xa00221c2 _REC_S1VAL_Normal_u1 255. _CNV_R_R_VA_I_16_503_CM 0. 255. FORMAT "%3.0" /end CHARACTERISTIC
/begin CHARACTERISTIC Csx_tac_24 "Allowed test for O2 upper sensor heater" VALUE 0xa00221c3 _REC_S1VAL_Normal_u1 255. _CNV_R_R_VA_I_16_503_CM 0. 255. FORMAT "%3.0" /end CHARACTERISTIC
/begin CHARACTERISTIC Csx_tac_25 "Allowed test for O2 lower sensor heater" VALUE 0xa00221c4 _REC_S1VAL_Normal_u1 255. _CNV_R_R_VA_I_16_503_CM 0. 255. FORMAT "%3.0" /end CHARACTERISTIC
/begin CHARACTERISTIC Csx_tac_29 "Allowed test for spark plug 1" VALUE 0xa00221c5 _REC_S1VAL_Normal_u1 255. _CNV_R_R_VA_I_16_503_CM 0. 255. FORMAT "%3.0" /end CHARACTERISTIC
/begin CHARACTERISTIC Csx_tac_30 "Allowed test for spark plug 2" VALUE 0xa00221c6 _REC_S1VAL_Normal_u1 255. _CNV_R_R_VA_I_16_503_CM 0. 255. FORMAT "%3.0" /end CHARACTERISTIC
/begin CHARACTERISTIC Csx_tac_31 "Allowed test for spark plug 3" VALUE 0xa00221c7 _REC_S1VAL_Normal_u1 255. _CNV_R_R_VA_I_16_503_CM 0. 255. FORMAT "%3.0" /end CHARACTERISTIC
/begin CHARACTERISTIC Csx_tac_32 "Allowed test for spark plug 4" VALUE 0xa00221c8 _REC_S1VAL_Normal_u1 255. _CNV_R_R_VA_I_16_503_CM 0. 255. FORMAT "%3.0" /end CHARACTERISTIC
/begin CHARACTERISTIC Csx_tac_35 "Allowed test for fuel injector 1" VALUE 0xa00221c9 _REC_S1VAL_Normal_u1 255. _CNV_R_R_VA_I_16_503_CM 0. 255. FORMAT "%3.0" /end CHARACTERISTIC
/begin CHARACTERISTIC Csx_tac_36 "Allowed test for fuel injector 2" VALUE 0xa00221ca _REC_S1VAL_Normal_u1 255. _CNV_R_R_VA_I_16_503_CM 0. 255. FORMAT "%3.0" /end CHARACTERISTIC
/begin CHARACTERISTIC Csx_tac_37 "Allowed test for fuel injector 3" VALUE 0xa00221cb _REC_S1VAL_Normal_u1 255. _CNV_R_R_VA_I_16_503_CM 0. 255. FORMAT "%3.0" /end CHARACTERISTIC
/begin CHARACTERISTIC Csx_tac_38 "Allowed test for fuel injector 4" VALUE 0xa00221cc _REC_S1VAL_Normal_u1 255. _CNV_R_R_VA_I_16_503_CM 0. 255. FORMAT "%3.0" /end CHARACTERISTIC
/begin CHARACTERISTIC Csx_tac_49 "Allowed tests for additional tank pump" VALUE 0xa00221bd _REC_S1VAL_Normal_u1 255. _CNV_R_R_VA_I_16_503_CM 0. 255. FORMAT "%3.0" /end CHARACTERISTIC
/begin CHARACTERISTIC Csx_tac_50 "Allowed tests for electrovalve of additional tank" VALUE 0xa00221be _REC_S1VAL_Normal_u1 255. _CNV_R_R_VA_I_16_503_CM 0. 255. FORMAT "%3.0" /end CHARACTERISTIC
/begin CHARACTERISTIC Cxx_diag_ffig_it_psn_min "Minimum ilet throttle measured position to allow ffig routine call" VALUE 0xa002219a _REC_S1VAL_Normal_u2 100. _CNV_R_R_Enocvxb_jc_541_CM 0. 100. FORMAT "%6.2" /end CHARACTERISTIC
/begin CHARACTERISTIC Cxx_diag_in_vvtc_tco_max "Maximum engine coolant temperature to allow VVT aftersales routine execution" VALUE 0xa002219c _REC_S1VAL_Normal_u2 240. _CNV_R_R_vbwtgvc_iB_542_CM -40. 200. FORMAT "%5.1" /end CHARACTERISTIC
/begin CHARACTERISTIC Cxx_diag_in_vvtc_tco_min "Minimum engine coolant temperature to allow VVT aftersales routine execution" VALUE 0xa002219e _REC_S1VAL_Normal_u2 240. _CNV_R_R_vbwtgvc_iB_542_CM -40. 200. FORMAT "%5.1" /end CHARACTERISTIC
/begin CHARACTERISTIC Cxx_diag_in_vvtc_toil_max "Maximum oil temperature to allow VVT aftersales routine execution" VALUE 0xa00221a0 _REC_S1VAL_Normal_u2 240. _CNV_R_R_vbwtgvc_iB_542_CM -40. 200. FORMAT "%5.1" /end CHARACTERISTIC
/begin CHARACTERISTIC Cxx_diag_in_vvtc_toil_min "Minimum oil temperature to allow VVT aftersales routine execution" VALUE 0xa00221a2 _REC_S1VAL_Normal_u2 240. _CNV_R_R_vbwtgvc_iB_542_CM -40. 200. FORMAT "%5.1" /end CHARACTERISTIC
/begin CHARACTERISTIC Cxx_diag_in_vvtc_vb_max "Maximum battery voltage to allow VVT aftersales routine execution" VALUE 0xa00221a4 _REC_S1VAL_Normal_u2 60. _CNV_R_R_Cngqitd_gu_543_CM 0. 60. FORMAT "%5.2" /end CHARACTERISTIC
/begin CHARACTERISTIC Cxx_diag_in_vvtc_vb_min "Minimum battery voltage to allow VVT aftersales routine execution" VALUE 0xa00221a6 _REC_S1VAL_Normal_u2 60. _CNV_R_R_Cngqitd_gu_543_CM 0. 60. FORMAT "%5.2" /end CHARACTERISTIC
/begin CHARACTERISTIC Cxx_ext_ctrl_acel_pdl_rat_thd "Accelerator pedal foot-off ratio threshold for external controls" VALUE 0xa0022194 _REC_S1VAL_Normal_u2 1.25 _CNV_R_R_omqfgpc_fb_544_CM 0. 1.25 FORMAT "%7.5" /end CHARACTERISTIC
/begin CHARACTERISTIC Cxx_ext_ctrl_max_n "Max engine speed for external controls" VALUE 0xa002218a _REC_S1VAL_Normal_u2 16383.75 _CNV_R_R_tAmwcfc_Da_540_CM 0. 16383.75 FORMAT "%8.2" /end CHARACTERISTIC
/begin CHARACTERISTIC Cxx_ext_ctrl_sens_spg_max "Maximum boost pressure measurement for external controls operation" VALUE 0xa002218c _REC_S1VAL_Normal_u2 20000. _CNV_R_R_fikncub_fA_545_CM 0. 20000. FORMAT "%5.0" /end CHARACTERISTIC
/begin CHARACTERISTIC Cxx_ext_ctrl_sens_spg_max_t "Filtration time of boost overpressure pressure for external controls operation" VALUE 0xa002218e _REC_S1VAL_Normal_u2 65.535 _CNV_R_R_nCcfksc_mn_525_CM 0. 65.535 /end CHARACTERISTIC
/begin CHARACTERISTIC Cxx_ext_ctrl_sens_tco_max "Maximum engine coolant temperature (sensor) for external controls operation" VALUE 0xa0022190 _REC_S1VAL_Normal_u2 240. _CNV_R_R_vbwtgvc_iB_542_CM -40. 200. FORMAT "%5.1" /end CHARACTERISTIC
/begin CHARACTERISTIC Cxx_ext_ctrl_vs_thd "Vehicle speed threshold to authorize external controls operation." VALUE 0xa0022198 _REC_S1VAL_Normal_u1 255. _CNV_R_R_FfBqnda_Bd_546_CM 0. 255. FORMAT "%3.0" /end CHARACTERISTIC
/begin CHARACTERISTIC Cxx_moni_id_01_max "Maximum value authorized for the replacement value of the identifier 01" VALUE 0xa00220fe _REC_S1VAL_Normal_u2 16383.75 _CNV_R_R_tAmwcfc_Da_540_CM 0. 16383.75 FORMAT "%8.2" /end CHARACTERISTIC
/begin CHARACTERISTIC Cxx_moni_id_01_min "Minimum value authorized for the replacement value of the identifier 01" VALUE 0xa0022100 _REC_S1VAL_Normal_u2 16383.75 _CNV_R_R_tAmwcfc_Da_540_CM 0. 16383.75 FORMAT "%8.2" /end CHARACTERISTIC
/begin CHARACTERISTIC Cxx_moni_id_06_max "Maximum value authorized for the replacement value of the identifier 06" VALUE 0xa0022102 _REC_S1VAL_Normal_u2 1. _CNV_R_R_rkcmmwd_dn_535_CM 0. 1. FORMAT "%5.3" /end CHARACTERISTIC
/begin CHARACTERISTIC Cxx_moni_id_06_min "Minimum value authorized for the replacement value of the identifier 06" VALUE 0xa0022104 _REC_S1VAL_Normal_u2 1. _CNV_R_R_rkcmmwd_dn_535_CM 0. 1. FORMAT "%5.3" /end CHARACTERISTIC
/begin CHARACTERISTIC Cxx_moni_id_0a_max "Maximum value authorized for the replacement value of the identifier 0a" VALUE 0xa0022176 _REC_S1VAL_Normal_u1 1. _CNV_S_2_RANGE______3_CM 0. 1. /end CHARACTERISTIC
/begin CHARACTERISTIC Cxx_moni_id_0a_min "Minimum value authorized for the replacement value of the identifier 0a" VALUE 0xa0022177 _REC_S1VAL_Normal_u1 1. _CNV_S_2_RANGE______3_CM 0. 1. /end CHARACTERISTIC
/begin CHARACTERISTIC Cxx_moni_id_19_max "Maximum value authorized for the replacement value of the identifier 19" VALUE 0xa0022178 _REC_S1VAL_Normal_u1 100. _CNV_R_R_xytAqxd_qA_527_CM 0. 100. FORMAT "%12.8" /end CHARACTERISTIC
/begin CHARACTERISTIC Cxx_moni_id_19_min "Minimum value authorized for the replacement value of the identifier 19" VALUE 0xa0022179 _REC_S1VAL_Normal_u1 100. _CNV_R_R_xytAqxd_qA_527_CM 0. 100. FORMAT "%12.8" /end CHARACTERISTIC
/begin CHARACTERISTIC Cxx_moni_id_1c_max "Maximum value authorized for the replacement value of the identifier 1c" VALUE 0xa0022106 _REC_S1VAL_Normal_u2 200. _CNV_R_R_gBspFma_cr_526_CM 0. 200. FORMAT "%4.2" /end CHARACTERISTIC
/begin CHARACTERISTIC Cxx_moni_id_1c_min "Minimum value authorized for the replacement value of the identifier 1c" VALUE 0xa0022108 _REC_S1VAL_Normal_u2 200. _CNV_R_R_gBspFma_cr_526_CM 0. 200. FORMAT "%4.2" /end CHARACTERISTIC
/begin CHARACTERISTIC Cxx_moni_id_2b_max "Maximum value authorized for the replacement value of the identifier 2b" VALUE 0xa002217a _REC_S1VAL_Normal_u1 1. _CNV_S_2_RANGE______3_CM 0. 1. /end CHARACTERISTIC
/begin CHARACTERISTIC Cxx_moni_id_2b_min "Minimum value authorized for the replacement value of the identifier 2b" VALUE 0xa002217b _REC_S1VAL_Normal_u1 1. _CNV_S_2_RANGE______3_CM 0. 1. /end CHARACTERISTIC
/begin CHARACTERISTIC Cxx_moni_id_2c_max "Maximum value authorized for the replacement value of the identifier 2c" VALUE 0xa002210a _REC_S1VAL_Normal_u2 720. _CNV_R_R_qkkoDkb_kn_537_CM 0. 720. FORMAT "%5.2" /end CHARACTERISTIC
/begin CHARACTERISTIC Cxx_moni_id_2c_min "Minimum value authorized for the replacement value of the identifier 2c" VALUE 0xa002210c _REC_S1VAL_Normal_u2 720. _CNV_R_R_qkkoDkb_kn_537_CM 0. 720. FORMAT "%5.2" /end CHARACTERISTIC
/begin CHARACTERISTIC Cxx_moni_id_2d_max "Maximum value authorized for the replacement value of the identifier 2d" VALUE 0xa002210e _REC_S1VAL_Normal_u2 200. _CNV_R_R_gBspFma_cr_526_CM 0. 200. FORMAT "%5.2" /end CHARACTERISTIC
/begin CHARACTERISTIC Cxx_moni_id_2d_min "Minimum value authorized for the replacement value of the identifier 2d" VALUE 0xa0022110 _REC_S1VAL_Normal_u2 200. _CNV_R_R_gBspFma_cr_526_CM 0. 200. FORMAT "%5.2" /end CHARACTERISTIC
/begin CHARACTERISTIC Cxx_moni_id_44_max "Maximum value authorized for the replacement value of the identifier 44" VALUE 0xa002217c _REC_S1VAL_Normal_u1 1. _CNV_S_2_RANGE______3_CM 0. 1. /end CHARACTERISTIC
/begin CHARACTERISTIC Cxx_moni_id_44_min "Minimum value authorized for the replacement value of the identifier 44" VALUE 0xa002217d _REC_S1VAL_Normal_u1 1. _CNV_S_2_RANGE______3_CM 0. 1. /end CHARACTERISTIC
/begin CHARACTERISTIC Cxx_moni_id_46_max "Maximum value authorized for the replacement value of the identifier 46" VALUE 0xa002217e _REC_S1VAL_Normal_u1 1. _CNV_S_2_RANGE______3_CM 0. 1. /end CHARACTERISTIC
/begin CHARACTERISTIC Cxx_moni_id_46_min "Minimum value authorized for the replacement value of the identifier 46" VALUE 0xa002217f _REC_S1VAL_Normal_u1 1. _CNV_S_2_RANGE______3_CM 0. 1. /end CHARACTERISTIC
/begin CHARACTERISTIC Cxx_moni_id_47_max "Maximum value authorized for the replacement value of the identifier 47" VALUE 0xa0022180 _REC_S1VAL_Normal_u1 1. _CNV_S_2_RANGE______3_CM 0. 1. /end CHARACTERISTIC
/begin CHARACTERISTIC Cxx_moni_id_47_min "Minimum value authorized for the replacement value of the identifier 47" VALUE 0xa0022181 _REC_S1VAL_Normal_u1 1. _CNV_S_2_RANGE______3_CM 0. 1. /end CHARACTERISTIC
/begin CHARACTERISTIC Cxx_moni_id_51_max "Maximum value authorized for the replacement value of the identifier 51" VALUE 0xa0022182 _REC_S1VAL_Normal_u1 100. _CNV_R_R_xytAqxd_qA_527_CM 0. 100. FORMAT "%12.8" /end CHARACTERISTIC
/begin CHARACTERISTIC Cxx_moni_id_51_min "Minimum value authorized for the replacement value of the identifier 51" VALUE 0xa0022183 _REC_S1VAL_Normal_u1 100. _CNV_R_R_xytAqxd_qA_527_CM 0. 100. FORMAT "%12.8" /end CHARACTERISTIC
/begin CHARACTERISTIC Cxx_moni_id_52_max "Maximum value authorized for the replacement value of the identifier 52" VALUE 0xa0022184 _REC_S1VAL_Normal_u1 100. _CNV_R_R_xytAqxd_qA_527_CM 0. 100. FORMAT "%12.8" /end CHARACTERISTIC
/begin CHARACTERISTIC Cxx_moni_id_52_min "Minimum value authorized for the replacement value of the identifier 52" VALUE 0xa0022185 _REC_S1VAL_Normal_u1 100. _CNV_R_R_xytAqxd_qA_527_CM 0. 100. FORMAT "%12.8" /end CHARACTERISTIC
/begin CHARACTERISTIC Cxx_moni_id_60_max "Maximum value authorized for the replacement value of the identifier 60" VALUE 0xa0022112 _REC_S1VAL_Normal_u4 500000. _CNV_R_R_CsFwmpa_Al_538_CM 0. 500000. FORMAT "%6.0" /end CHARACTERISTIC
/begin CHARACTERISTIC Cxx_moni_id_60_min "Minimum value authorized for the replacement value of the identifier 60" VALUE 0xa0022116 _REC_S1VAL_Normal_u4 500000. _CNV_R_R_CsFwmpa_Al_538_CM 0. 500000. FORMAT "%6.0" /end CHARACTERISTIC
/begin CHARACTERISTIC Cxx_moni_id_61_max "Maximum value authorized for the replacement value of the identifier 61" VALUE 0xa002211a _REC_S1VAL_Normal_u4 500000. _CNV_R_R_CsFwmpa_Al_538_CM 0. 500000. FORMAT "%6.0" /end CHARACTERISTIC
/begin CHARACTERISTIC Cxx_moni_id_61_min "Minimum value authorized for the replacement value of the identifier 61" VALUE 0xa002211e _REC_S1VAL_Normal_u4 500000. _CNV_R_R_CsFwmpa_Al_538_CM 0. 500000. FORMAT "%6.0" /end CHARACTERISTIC
/begin CHARACTERISTIC Cxx_moni_id_62_max "Maximum value authorized for the replacement value of the identifier 62" VALUE 0xa0022122 _REC_S1VAL_Normal_u4 500000. _CNV_R_R_CsFwmpa_Al_538_CM 0. 500000. FORMAT "%6.0" /end CHARACTERISTIC
/begin CHARACTERISTIC Cxx_moni_id_62_min "Minimum value authorized for the replacement value of the identifier 62" VALUE 0xa0022126 _REC_S1VAL_Normal_u4 500000. _CNV_R_R_CsFwmpa_Al_538_CM 0. 500000. FORMAT "%6.0" /end CHARACTERISTIC
/begin CHARACTERISTIC Cxx_moni_id_63_max "Maximum value authorized for the replacement value of the identifier 63" VALUE 0xa002212a _REC_S1VAL_Normal_u4 500000. _CNV_R_R_CsFwmpa_Al_538_CM 0. 500000. FORMAT "%6.0" /end CHARACTERISTIC
/begin CHARACTERISTIC Cxx_moni_id_63_min "Minimum value authorized for the replacement value of the identifier 63" VALUE 0xa002212e _REC_S1VAL_Normal_u4 500000. _CNV_R_R_CsFwmpa_Al_538_CM 0. 500000. FORMAT "%6.0" /end CHARACTERISTIC
/begin CHARACTERISTIC Cxx_moni_id_64_max "Maximum value authorized for the replacement value of the identifier 64" VALUE 0xa0022132 _REC_S1VAL_Normal_u4 500000. _CNV_R_R_CsFwmpa_Al_538_CM 0. 500000. FORMAT "%6.0" /end CHARACTERISTIC
/begin CHARACTERISTIC Cxx_moni_id_64_min "Minimum value authorized for the replacement value of the identifier 64" VALUE 0xa0022136 _REC_S1VAL_Normal_u4 500000. _CNV_R_R_CsFwmpa_Al_538_CM 0. 500000. FORMAT "%6.0" /end CHARACTERISTIC
/begin CHARACTERISTIC Cxx_moni_id_65_max "Maximum value authorized for the replacement value of the identifier 65" VALUE 0xa002213a _REC_S1VAL_Normal_u4 500000. _CNV_R_R_CsFwmpa_Al_538_CM 0. 500000. FORMAT "%6.0" /end CHARACTERISTIC
/begin CHARACTERISTIC Cxx_moni_id_65_min "Minimum value authorized for the replacement value of the identifier 65" VALUE 0xa002213e _REC_S1VAL_Normal_u4 500000. _CNV_R_R_CsFwmpa_Al_538_CM 0. 500000. FORMAT "%6.0" /end CHARACTERISTIC
/begin CHARACTERISTIC Cxx_moni_id_66_max "Maximum value authorized for the replacement value of the identifier 66" VALUE 0xa0022142 _REC_S1VAL_Normal_u4 500000. _CNV_R_R_CsFwmpa_Al_538_CM 0. 500000. FORMAT "%6.0" /end CHARACTERISTIC
/begin CHARACTERISTIC Cxx_moni_id_66_min "Minimum value authorized for the replacement value of the identifier 66" VALUE 0xa0022146 _REC_S1VAL_Normal_u4 500000. _CNV_R_R_CsFwmpa_Al_538_CM 0. 500000. FORMAT "%6.0" /end CHARACTERISTIC
/begin CHARACTERISTIC Cxx_moni_id_67_max "Maximum value authorized for the replacement value of the identifier 67" VALUE 0xa002214a _REC_S1VAL_Normal_u4 500000. _CNV_R_R_CsFwmpa_Al_538_CM 0. 500000. FORMAT "%6.0" /end CHARACTERISTIC
/begin CHARACTERISTIC Cxx_moni_id_67_min "Minimum value authorized for the replacement value of the identifier 67" VALUE 0xa002214e _REC_S1VAL_Normal_u4 500000. _CNV_R_R_CsFwmpa_Al_538_CM 0. 500000. FORMAT "%6.0" /end CHARACTERISTIC
/begin CHARACTERISTIC Cxx_moni_id_68_max "Maximum value authorized for the replacement value of the identifier 68" VALUE 0xa0022152 _REC_S1VAL_Normal_u2 765. _CNV_R_R_ilwggEa_nw_539_CM 0. 765. FORMAT "%3.0" /end CHARACTERISTIC
/begin CHARACTERISTIC Cxx_moni_id_68_min "Minimum value authorized for the replacement value of the identifier 68" VALUE 0xa0022154 _REC_S1VAL_Normal_u2 765. _CNV_R_R_ilwggEa_nw_539_CM 0. 765. FORMAT "%3.0" /end CHARACTERISTIC
/begin CHARACTERISTIC Cxx_moni_id_69_max "Maximum value authorized for the replacement value of the identifier 69" VALUE 0xa0022156 _REC_S1VAL_Normal_u2 765. _CNV_R_R_ilwggEa_nw_539_CM 0. 765. FORMAT "%3.0" /end CHARACTERISTIC
/begin CHARACTERISTIC Cxx_moni_id_69_min "Minimum value authorized for the replacement value of the identifier 69" VALUE 0xa0022158 _REC_S1VAL_Normal_u2 765. _CNV_R_R_ilwggEa_nw_539_CM 0. 765. FORMAT "%3.0" /end CHARACTERISTIC
/begin CHARACTERISTIC Cxx_moni_id_6a_max "Maximum value authorized for the replacement value of the identifier 6a" VALUE 0xa002215a _REC_S1VAL_Normal_u2 765. _CNV_R_R_ilwggEa_nw_539_CM 0. 765. FORMAT "%3.0" /end CHARACTERISTIC
/begin CHARACTERISTIC Cxx_moni_id_6a_min "Minimum value authorized for the replacement value of the identifier 6a" VALUE 0xa002215c _REC_S1VAL_Normal_u2 765. _CNV_R_R_ilwggEa_nw_539_CM 0. 765. FORMAT "%3.0" /end CHARACTERISTIC
/begin CHARACTERISTIC Cxx_moni_id_6b_max "Maximum value authorized for the replacement value of the identifier 6b" VALUE 0xa002215e _REC_S1VAL_Normal_u2 765. _CNV_R_R_ilwggEa_nw_539_CM 0. 765. FORMAT "%3.0" /end CHARACTERISTIC
/begin CHARACTERISTIC Cxx_moni_id_6b_min "Minimum value authorized for the replacement value of the identifier 6b" VALUE 0xa0022160 _REC_S1VAL_Normal_u2 765. _CNV_R_R_ilwggEa_nw_539_CM 0. 765. FORMAT "%3.0" /end CHARACTERISTIC
/begin CHARACTERISTIC Cxx_moni_id_6c_max "Maximum value authorized for the replacement value of the identifier 6c" VALUE 0xa0022162 _REC_S1VAL_Normal_u2 765. _CNV_R_R_ilwggEa_nw_539_CM 0. 765. FORMAT "%3.0" /end CHARACTERISTIC
/begin CHARACTERISTIC Cxx_moni_id_6c_min "Minimum value authorized for the replacement value of the identifier 6c" VALUE 0xa0022164 _REC_S1VAL_Normal_u2 765. _CNV_R_R_ilwggEa_nw_539_CM 0. 765. FORMAT "%3.0" /end CHARACTERISTIC
/begin CHARACTERISTIC Cxx_moni_id_6d_max "Maximum value authorized for the replacement value of the identifier 6d" VALUE 0xa0022166 _REC_S1VAL_Normal_u2 765. _CNV_R_R_ilwggEa_nw_539_CM 0. 765. FORMAT "%3.0" /end CHARACTERISTIC
/begin CHARACTERISTIC Cxx_moni_id_6d_min "Minimum value authorized for the replacement value of the identifier 6d" VALUE 0xa0022168 _REC_S1VAL_Normal_u2 765. _CNV_R_R_ilwggEa_nw_539_CM 0. 765. FORMAT "%3.0" /end CHARACTERISTIC
/begin CHARACTERISTIC Cxx_moni_id_6e_max "Maximum value authorized for the replacement value of the identifier 6e" VALUE 0xa002216a _REC_S1VAL_Normal_u2 765. _CNV_R_R_ilwggEa_nw_539_CM 0. 765. FORMAT "%3.0" /end CHARACTERISTIC
/begin CHARACTERISTIC Cxx_moni_id_6e_min "Minimum value authorized for the replacement value of the identifier 6e" VALUE 0xa002216c _REC_S1VAL_Normal_u2 765. _CNV_R_R_ilwggEa_nw_539_CM 0. 765. FORMAT "%3.0" /end CHARACTERISTIC
/begin CHARACTERISTIC Cxx_moni_id_6f_max "Maximum value authorized for the replacement value of the identifier 6f" VALUE 0xa002216e _REC_S1VAL_Normal_u2 765. _CNV_R_R_ilwggEa_nw_539_CM 0. 765. FORMAT "%3.0" /end CHARACTERISTIC
/begin CHARACTERISTIC Cxx_moni_id_6f_min "Minimum value authorized for the replacement value of the identifier 6f" VALUE 0xa0022170 _REC_S1VAL_Normal_u2 765. _CNV_R_R_ilwggEa_nw_539_CM 0. 765. FORMAT "%3.0" /end CHARACTERISTIC
/begin CHARACTERISTIC Cxx_moni_id_70_max "Maximum value authorized for the replacement value of the identifier 70" VALUE 0xa0022186 _REC_S1VAL_Normal_u1 1. _CNV_S_2_RANGE______3_CM 0. 1. /end CHARACTERISTIC
/begin CHARACTERISTIC Cxx_moni_id_70_min "Minimum value authorized for the replacement value of the identifier 70" VALUE 0xa0022187 _REC_S1VAL_Normal_u1 1. _CNV_S_2_RANGE______3_CM 0. 1. /end CHARACTERISTIC
/begin CHARACTERISTIC Cxx_moni_id_71_max "Maximum value authorized for the replacement value of the identifier 71" VALUE 0xa0022188 _REC_S1VAL_Normal_u1 100. _CNV_R_R_xytAqxd_qA_527_CM 0. 100. FORMAT "%12.8" /end CHARACTERISTIC
/begin CHARACTERISTIC Cxx_moni_id_71_min "Minimum value authorized for the replacement value of the identifier 71" VALUE 0xa0022189 _REC_S1VAL_Normal_u1 100. _CNV_R_R_xytAqxd_qA_527_CM 0. 100. FORMAT "%12.8" /end CHARACTERISTIC
/begin CHARACTERISTIC Cxx_moni_id_79_max "Maximum value authorized for the replacement value of the identifier 79" VALUE 0xa0022172 _REC_S1VAL_Normal_u2 100. _CNV_R_R_Edjqxvd_mq_528_CM 0. 100. FORMAT "%12.8" /end CHARACTERISTIC
/begin CHARACTERISTIC Cxx_moni_id_79_min "Minimum value authorized for the replacement value of the identifier 79" VALUE 0xa0022174 _REC_S1VAL_Normal_u2 100. _CNV_R_R_Edjqxvd_mq_528_CM 0. 100. FORMAT "%12.8" /end CHARACTERISTIC
/begin CHARACTERISTIC Cxx_moni_stop_diag_dly "Delay between Monitool deactivation and diagnosis reactivation" VALUE 0xa0022199 _REC_S1VAL_Normal_u1 255. _CNV_R_R_VA_I_16_503_CM 0. 255. FORMAT "%3.0" /end CHARACTERISTIC
/begin CHARACTERISTIC Cxx_tac_tout_timer_io "Delay to declare timeout when a supplier I/O control is executed" VALUE 0xa00221aa _REC_S1VAL_Normal_u2 65.535 _CNV_R_R_nCcfksc_mn_525_CM 0. 65.535 /end CHARACTERISTIC
/begin CHARACTERISTIC Cxx_tac_tout_timer_stac "Delay to declare timeout when a static test supplier control is executed" VALUE 0xa00221ac _REC_S1VAL_Normal_u2 65.535 _CNV_R_R_nCcfksc_mn_525_CM 0. 65.535 /end CHARACTERISTIC
/begin CHARACTERISTIC Cxx_tac_vb_max "Maximum battery voltage to allow heat glow control" VALUE 0xa00221ae _REC_S1VAL_Normal_u2 60. _CNV_R_R_Cngqitd_gu_543_CM 0. 60. FORMAT "%5.2" /end CHARACTERISTIC
/begin CHARACTERISTIC Cxx_tac_vb_min "Calibration value of the minimum battery voltage for static test" VALUE 0xa00221b0 _REC_S1VAL_Normal_u2 60. _CNV_R_R_Cngqitd_gu_543_CM 0. 60. FORMAT "%5.2" /end CHARACTERISTIC
/begin AXIS_PTS Ctb_sfty_sens_tco_v "coolant voltage signal breakpoints map (safety)" 0xa00224b8 NO_INPUT_QUANTITY _REC_A2AXS_20_u2 25000. _CNV_A_R_LINEAR_____107_CM 16 0. 25000. FORMAT "%5.0" /end AXIS_PTS
/begin CHARACTERISTIC Ctp_sfty_sens_tco "coolant sensor map (safety)" CURVE 0xa00224dc _REC_A1CUR_20_u1_u2 240. _CNV_A_R_LINEAR_____280_CM -40. 200. FORMAT "%3.0"
 /begin AXIS_DESCR COM_AXIS NO_INPUT_QUANTITY _CNV_A_R_LINEAR_____107_CM 16 0. 25000. FORMAT "%5.0" AXIS_PTS_REF Ctb_sfty_sens_tco_v /end AXIS_DESCR
/end CHARACTERISTIC
/begin MEASUREMENT Vxx_sfty_raw_sens_tco "Raw engine coolant temperature for safety" UBYTE _CNV_A_R_LINEAR_____280_CM 1 0. -40. 200. ECU_ADDRESS 0xd000800b FORMAT "%3.0" /end MEASUREMENT
/begin MEASUREMENT Vxx_sfty_tco "Engine coolant temperature for safety" UBYTE _CNV_A_R_LINEAR_____280_CM 1 0. -40. 200. ECU_ADDRESS 0xd000800c FORMAT "%3.0" /end MEASUREMENT
/begin CHARACTERISTIC Cxx_sfty_tco_inc "Max gradient of tco" VALUE 0xa002230c _REC_S1VAL_20_u2 30. _CNV_A_R_LINEAR_____243_CM 0. 30. FORMAT "%4.1" /end CHARACTERISTIC
/begin MEASUREMENT Vxx_sfty_n "engine speed for safety monitoring" UBYTE _CNV_A_R_LINEAR_____2_CM 1 0. 0. 8160. ECU_ADDRESS 0xd0008003 FORMAT "%4.0" /end MEASUREMENT
/begin AXIS_PTS Ctb_sfty_frn_tql_temp "Temperature breakpoints map for engine rubbing torque losses calculation for safety monitoring" 0xa00224ec Vxx_sfty_frn_tql_temp _REC_A2AXS_20_u1 240. _CNV_A_R_LINEAR_____280_CM 9 -40. 200. FORMAT "%3.0" /end AXIS_PTS
/begin AXIS_PTS Ctb_sfty_map "Maniflod pressure value break points" 0xa00224f8 Vxx_map _REC_A2AXS_20_u2 20000. _CNV_A_R_LINEAR_____115_CM 9 0. 20000. FORMAT "%5.0" /end AXIS_PTS
/begin AXIS_PTS Ctb_sfty_n "20 programmable engine speed breakpoints map" 0xa002250c Vxx_sfty_n _REC_A2AXS_20_u1 8160. _CNV_A_R_LINEAR_____2_CM 11 0. 8160. FORMAT "%4.0" /end AXIS_PTS
/begin CHARACTERISTIC Cmp_sfty_frn_tql "Copy of rubing engine torque losses map depending of engine speed and coolant temperature for safety monitoring" MAP 0xa0022518 _REC_A1MAP_20_u1_u1_u1 255. _CNV_A_R_LINEAR_____485_CM 0. 255. FORMAT "%3.0"
 /begin AXIS_DESCR COM_AXIS Vxx_sfty_frn_tql_temp _CNV_A_R_LINEAR_____280_CM 9 -40. 200. FORMAT "%3.0" AXIS_PTS_REF Ctb_sfty_frn_tql_temp /end AXIS_DESCR
 /begin AXIS_DESCR COM_AXIS Vxx_sfty_n _CNV_A_R_LINEAR_____2_CM 11 0. 8160. FORMAT "%4.0" AXIS_PTS_REF Ctb_sfty_n /end AXIS_DESCR
/end CHARACTERISTIC
/begin CHARACTERISTIC Cmp_sfty_pump_tql "Map of estimated pumping torque (for safety)" MAP 0xa002257c _REC_A1MAP_20_u1_u2_u1 255. _CNV_A_R_LINEAR_____485_CM 0. 255. FORMAT "%3.0"
 /begin AXIS_DESCR COM_AXIS Vxx_map _CNV_A_R_LINEAR_____115_CM 9 0. 20000. FORMAT "%5.0" AXIS_PTS_REF Ctb_sfty_map /end AXIS_DESCR
 /begin AXIS_DESCR COM_AXIS Vxx_sfty_n _CNV_A_R_LINEAR_____2_CM 11 0. 8160. FORMAT "%4.0" AXIS_PTS_REF Ctb_sfty_n /end AXIS_DESCR
/end CHARACTERISTIC
/begin MEASUREMENT Vxx_sfty_aux_tql_sp "torque losses due to accessories (for safety)" UBYTE _CNV_A_R_LINEAR_____485_CM 1 0. 0. 255. ECU_ADDRESS 0xd0008016 FORMAT "%3.0" /end MEASUREMENT
/begin MEASUREMENT Vxx_sfty_eng_tql "Engine torque losses for safety" UWORD _CNV_A_R_LINEAR_____181_CM 1 0. 0. 2047.96875 ECU_ADDRESS 0xd0008014 FORMAT "%10.5" /end MEASUREMENT
/begin MEASUREMENT Vxx_sfty_frn_tql "Estimated pumping torque (for safety)" UBYTE _CNV_A_R_LINEAR_____485_CM 1 0. 0. 255. ECU_ADDRESS 0xd0008017 FORMAT "%3.0" /end MEASUREMENT
/begin MEASUREMENT Vxx_sfty_frn_tql_temp "Temperature for engine rubbing torque losses calculation for safety monitoring" UBYTE _CNV_A_R_LINEAR_____280_CM 1 0. -40. 200. ECU_ADDRESS 0xd0008018 FORMAT "%3.0" /end MEASUREMENT
/begin MEASUREMENT Vxx_sfty_toil "Oil temperature for safety" UBYTE _CNV_A_R_LINEAR_____280_CM 1 0. -40. 200. ECU_ADDRESS 0xd0008019 FORMAT "%3.0" /end MEASUREMENT
/begin CHARACTERISTIC Cbx_sfty_is_ad_eng_tql_cmf "Add adaptive idle speed torque on engine torque losses or on minimum torque (for safety monitoring)" VALUE 0xa0022314 _REC_S1VAL_20_u1 1. _CNV_A_R_ECME_LINEA_0_CM 0. 1. FORMAT "%1.0" BIT_MASK 0x1 /end CHARACTERISTIC
/begin CHARACTERISTIC Cbx_sfty_tql_temp_cfm "Choice of water or oil temperature permited, according with technical engine definition (for safety monitoring)" VALUE 0xa0022315 _REC_S1VAL_20_u1 1. _CNV_A_R_ECME_LINEA_0_CM 0. 1. FORMAT "%1.0" BIT_MASK 0x1 /end CHARACTERISTIC
/begin CHARACTERISTIC Cxx_sfty_ac_pow_thd "maximum value of air conditioning absorbed power (compressor) for safety monitoring" VALUE 0xa0022316 _REC_S1VAL_20_u1 10200. _CNV_A_R_LINEAR_____547_CM 0. 10200. FORMAT "%5.0" /end CHARACTERISTIC
/begin CHARACTERISTIC Cxx_sfty_alt_pow_thd "maximum value of filtered alternator mechanical power for safety monitoring" VALUE 0xa0022317 _REC_S1VAL_20_u1 10200. _CNV_A_R_LINEAR_____547_CM 0. 10200. FORMAT "%5.0" /end CHARACTERISTIC
/begin CHARACTERISTIC Cxx_sfty_max_is_ad_tq "Maximum of adaptive correction of iddle speed for safety monitoring" VALUE 0xa0022310 _REC_S1VAL_20_s2 2047.96875 _CNV_A_R_LINEAR_____181_CM -1024. 1023.96875 FORMAT "%11.5" /end CHARACTERISTIC
/begin CHARACTERISTIC Cxx_sfty_min_is_ad_tq "Minimum of adaptive correction of iddle speed for safety monitoring" VALUE 0xa0022312 _REC_S1VAL_20_s2 2047.96875 _CNV_A_R_LINEAR_____181_CM -1024. 1023.96875 FORMAT "%11.5" /end CHARACTERISTIC
/begin CHARACTERISTIC Cxx_sfty_pump_tql_thd "maximum value of pump torque lossses for safety monitoring" VALUE 0xa0022318 _REC_S1VAL_20_u1 255. _CNV_A_R_LINEAR_____485_CM 0. 255. FORMAT "%3.0" /end CHARACTERISTIC
/begin CHARACTERISTIC Cxx_sfty_pwst_off_is_cor_dly "Inhibition time of the torque losses from power steering (for safety monitoring)" VALUE 0xa0022319 _REC_S1VAL_20_u1 10.2 _CNV_A_R_LINEAR_____208_CM 0. 10.2 FORMAT "%4.2" /end CHARACTERISTIC
/begin CHARACTERISTIC Cxx_sfty_pwst_prs_tql "Torque loss from power steering for safety" VALUE 0xa002231a _REC_S1VAL_20_u1 255. _CNV_A_R_LINEAR_____485_CM 0. 255. FORMAT "%3.0" /end CHARACTERISTIC
/begin MEASUREMENT Vbx_sfty_agb_tq_req "Recent AGB torque request" UBYTE _CNV_S_2_RANGE______3_CM 1 0. 0. 1. ECU_ADDRESS 0xd0007f98 BIT_MASK 0x1 /end MEASUREMENT
/begin MEASUREMENT Vbx_sfty_agb_tq_req_plau "Torque requests by AGB are plausible" UBYTE _CNV_S_2_RANGE______3_CM 1 0. 0. 1. ECU_ADDRESS 0xd0007f99 BIT_MASK 0x1 /end MEASUREMENT
/begin MEASUREMENT Vbx_sfty_msr_tq_req "Recent MSR torque request" UBYTE _CNV_S_2_RANGE______3_CM 1 0. 0. 1. ECU_ADDRESS 0xd0007f9a BIT_MASK 0x1 /end MEASUREMENT
/begin MEASUREMENT Vbx_sfty_msr_tq_req_plau "Torque requests by MSR are plausible" UBYTE _CNV_S_2_RANGE______3_CM 1 0. 0. 1. ECU_ADDRESS 0xd0007f9b BIT_MASK 0x1 /end MEASUREMENT
/begin CHARACTERISTIC Cxx_sfty_asr_tqe_sp_msr_raw "Raw value of ASR setpoint during MSR requests" VALUE 0xa00222dc _REC_S1VAL_20_u2 65535. _CNV_A_R_ECME_LINEA_0_CM 0. 65535. FORMAT "%5.0" /end CHARACTERISTIC
/begin CHARACTERISTIC Cxx_sfty_mux_agb_tqe_nok_raw "Raw invalid value of AGB torque requests" VALUE 0xa00222de _REC_S1VAL_20_u2 65535. _CNV_A_R_ECME_LINEA_0_CM 0. 65535. FORMAT "%5.0" /end CHARACTERISTIC
/begin CHARACTERISTIC Cxx_sfty_mux_asr_tqe_nok_raw "Raw invalid value of AGB torque requests" VALUE 0xa00222e0 _REC_S1VAL_20_u2 65535. _CNV_A_R_ECME_LINEA_0_CM 0. 65535. FORMAT "%5.0" /end CHARACTERISTIC
/begin MEASUREMENT Vbx_sfty_cru_brk "Brake pedal on for safety monitoring" UBYTE _CNV_S_2_RANGE______3_CM 1 0. 0. 1. ECU_ADDRESS 0xd0007fb9 BIT_MASK 0x1 /end MEASUREMENT
/begin MEASUREMENT Vbx_sfty_cru_brk_pdl_ok "Valid brake pedal for safety monitoring" UBYTE _CNV_S_2_RANGE______3_CM 1 0. 0. 1. ECU_ADDRESS 0xd0007fba BIT_MASK 0x1 /end MEASUREMENT
/begin MEASUREMENT Vbx_sfty_cru_brk_pdl_ok_tmp "Brake pedal information is valid" UBYTE _CNV_S_2_RANGE______3_CM 1 0. 0. 1. ECU_ADDRESS 0xd0007fbb BIT_MASK 0x1 /end MEASUREMENT
/begin MEASUREMENT Vbx_sfty_cru_forc_on "Cruise control requests force" UBYTE _CNV_S_2_RANGE______3_CM 1 0. 0. 1. ECU_ADDRESS 0xd0007fbc BIT_MASK 0x1 /end MEASUREMENT
/begin MEASUREMENT Vbx_sfty_cru_on "Cruise control is ON" UBYTE _CNV_S_2_RANGE______3_CM 1 0. 0. 1. ECU_ADDRESS 0xd0007fbd BIT_MASK 0x1 /end MEASUREMENT
/begin MEASUREMENT Vbx_sfty_cru_resu_acel_decl "Either resume, + or - cruise control switches are pressed" UBYTE _CNV_S_2_RANGE______3_CM 1 0. 0. 1. ECU_ADDRESS 0xd0007fbe BIT_MASK 0x1 /end MEASUREMENT
/begin MEASUREMENT Vbx_sfty_cru_stt_act "Cruise control is in active state" UBYTE _CNV_S_2_RANGE______3_CM 1 0. 0. 1. ECU_ADDRESS 0xd0007fbf BIT_MASK 0x1 /end MEASUREMENT
/begin MEASUREMENT Vbx_sfty_cru_tq_req_plau "A cruise control torque request is plausible" UBYTE _CNV_S_2_RANGE______3_CM 1 0. 0. 1. ECU_ADDRESS 0xd0007fc0 BIT_MASK 0x1 /end MEASUREMENT
/begin MEASUREMENT Vbx_sfty_cru_tq_req_plau_tmp_1 "A cruise control torque request is plausible (before debounce)" UBYTE _CNV_S_2_RANGE______3_CM 1 0. 0. 1. ECU_ADDRESS 0xd0007fc1 BIT_MASK 0x1 /end MEASUREMENT
/begin MEASUREMENT Vbx_sfty_cru_tq_req_plau_tmp_2 "A cruise control torque request is plausible (before debounce)" UBYTE _CNV_S_2_RANGE______3_CM 1 0. 0. 1. ECU_ADDRESS 0xd0007fc2 BIT_MASK 0x1 /end MEASUREMENT
/begin MEASUREMENT Vxx_sfty_cru_brk_t_1 "Short brake pedal first confirmation timer" UBYTE _CNV_A_R_LINEAR_____208_CM 1 0. 0. 10.2 ECU_ADDRESS 0xd0007fc3 FORMAT "%4.2" /end MEASUREMENT
/begin MEASUREMENT Vxx_sfty_cru_brk_t_2 "Short brake pedal second confirmation timer" UBYTE _CNV_A_R_LINEAR_____208_CM 1 0. 0. 10.2 ECU_ADDRESS 0xd0007fc4 FORMAT "%4.2" /end MEASUREMENT
/begin MEASUREMENT Vxx_sfty_cru_brk_t_long "Long brake pedal confirmation timer" UBYTE _CNV_A_R_LINEAR_____208_CM 1 0. 0. 10.2 ECU_ADDRESS 0xd0007fc5 FORMAT "%4.2" /end MEASUREMENT
/begin CHARACTERISTIC Cxx_sfty_cru_brk_nok_t "Invalid brake pedal confirmation time" VALUE 0xa00222e8 _REC_S1VAL_20_u1 10.2 _CNV_A_R_LINEAR_____208_CM 0. 10.2 FORMAT "%4.2" /end CHARACTERISTIC
/begin CHARACTERISTIC Cxx_sfty_cru_brk_tout_1 "Short brake pedal first confirmation time" VALUE 0xa00222e9 _REC_S1VAL_20_u1 10.2 _CNV_A_R_LINEAR_____208_CM 0. 10.2 FORMAT "%4.2" /end CHARACTERISTIC
/begin CHARACTERISTIC Cxx_sfty_cru_brk_tout_2 "Short brake pedal second confirmation time" VALUE 0xa00222ea _REC_S1VAL_20_u1 10.2 _CNV_A_R_LINEAR_____208_CM 0. 10.2 FORMAT "%4.2" /end CHARACTERISTIC
/begin CHARACTERISTIC Cxx_sfty_cru_brk_tout_long "Long brake pedal confirmation time" VALUE 0xa00222eb _REC_S1VAL_20_u1 10.2 _CNV_A_R_LINEAR_____208_CM 0. 10.2 FORMAT "%4.2" /end CHARACTERISTIC
/begin CHARACTERISTIC Cxx_sfty_cru_rest_max_v "Max voltage for wheel cruise control switch positions resume, +, or -" VALUE 0xa00222e4 _REC_S1VAL_20_u2 25000. _CNV_A_R_LINEAR_____107_CM 0. 25000. FORMAT "%5.0" /end CHARACTERISTIC
/begin CHARACTERISTIC Cxx_sfty_cru_rest_min_v "Min voltage for wheel cruise control switch positions resume, +, or -" VALUE 0xa00222e6 _REC_S1VAL_20_u2 25000. _CNV_A_R_LINEAR_____107_CM 0. 25000. FORMAT "%5.0" /end CHARACTERISTIC
/begin CHARACTERISTIC Cxx_sfty_cru_tq_req_t "Valid cruise control torque request debounce time" VALUE 0xa00222ec _REC_S1VAL_20_u1 10.2 _CNV_A_R_LINEAR_____208_CM 0. 10.2 FORMAT "%4.2" /end CHARACTERISTIC
/begin AXIS_PTS Ctb_sfty_acel_pdl_fmt "Pedal ratio breakpoints for pedal progressivity maps (for safety)" 0xa0022360 Vxx_sfty_acel_pdl_rat _REC_A2AXS_20_u2 1.25 _CNV_A_R_LINEAR_____319_CM 17 0. 1.25 FORMAT "%7.5" /end AXIS_PTS
/begin CHARACTERISTIC Ctp_sfty_acel_pdl_fmt_1 "Pedal progressivity map n°1 (for safety)" CURVE 0xa0022384 _REC_A1CUR_20_u2_u2 1. _CNV_A_R_LINEAR_____238_CM 0. 1. FORMAT "%7.5"
 /begin AXIS_DESCR COM_AXIS Vxx_sfty_acel_pdl_rat _CNV_A_R_LINEAR_____319_CM 17 0. 1.25 FORMAT "%7.5" AXIS_PTS_REF Ctb_sfty_acel_pdl_fmt /end AXIS_DESCR
/end CHARACTERISTIC
/begin CHARACTERISTIC Ctp_sfty_acel_pdl_fmt_2 "Pedal progressivity map n°2 (for safety)" CURVE 0xa00223a8 _REC_A1CUR_20_u2_u2 1. _CNV_A_R_LINEAR_____238_CM 0. 1. FORMAT "%7.5"
 /begin AXIS_DESCR COM_AXIS Vxx_sfty_acel_pdl_rat _CNV_A_R_LINEAR_____319_CM 17 0. 1.25 FORMAT "%7.5" AXIS_PTS_REF Ctb_sfty_acel_pdl_fmt /end AXIS_DESCR
/end CHARACTERISTIC
/begin MEASUREMENT Vxx_sfty_acel_pdl_pwt_sp "Powertrain setpoint (%) requested by the driver via the accelerator pedal (for safety)" UWORD _CNV_A_R_LINEAR_____238_CM 1 0. 0. 1. ECU_ADDRESS 0xd0007f8e FORMAT "%7.5" /end MEASUREMENT
/begin MEASUREMENT Vxx_sfty_driv_pwt_sp "Powertrain setpoint (%) requested by real (pedal) and virtual (ACC/CC/SL) drivers (for safety)" UWORD _CNV_A_R_LINEAR_____238_CM 1 0. 0. 1. ECU_ADDRESS 0xd0007f90 FORMAT "%7.5" /end MEASUREMENT
/begin CHARACTERISTIC Cxx_sfty_acel_pdl_fmt_rvr_fac "Pedal progressivity correction factor for reverse gear (for safety)" VALUE 0xa00222d8 _REC_S1VAL_20_u1 2.55 _CNV_A_R_LINEAR_____123_CM 0. 2.55 FORMAT "%4.2" /end CHARACTERISTIC
/begin CHARACTERISTIC Cxx_sfty_lih_off_t "Pedal limp home zero-request confirmation time (for safety monitoring)" VALUE 0xa00222d9 _REC_S1VAL_20_u1 10.2 _CNV_A_R_LINEAR_____208_CM 0. 10.2 FORMAT "%4.2" /end CHARACTERISTIC
/begin AXIS_PTS Ctb_sfty_ajs_n "9 programmables engine speed breakpoints map" 0xa00225e0 Vxx_sfty_n _REC_A2AXS_20_u1 8160. _CNV_A_R_LINEAR_____2_CM 9 0. 8160. FORMAT "%4.0" /end AXIS_PTS
/begin AXIS_PTS Ctb_sfty_driv_tqe_map_n "Engine speed breakpoints for engine torque setpoint map for safety" 0xa00225ec Vxx_sfty_n _REC_A2AXS_20_u1 8160. _CNV_A_R_LINEAR_____2_CM 20 0. 8160. FORMAT "%4.0" /end AXIS_PTS
/begin AXIS_PTS Ctb_sfty_driv_tqe_map_pwt_sp "Powertrain setpoint breakpoints for engine torque setpoint map for safety" 0xa0022604 Vxx_sfty_driv_pwt_sp _REC_A2AXS_20_u2 1. _CNV_A_R_LINEAR_____238_CM 17 0. 1. FORMAT "%7.5" /end AXIS_PTS
/begin AXIS_PTS Ctb_sfty_min_driv_tqe_pwt_sp "Powertrain setpoint breakpoints for minimum driver engine torque factor (for safety monitoring)" 0xa0022628 Vxx_sfty_driv_pwt_sp _REC_A2AXS_20_u2 1. _CNV_A_R_LINEAR_____238_CM 17 0. 1. FORMAT "%7.5" /end AXIS_PTS
/begin AXIS_PTS Ctb_sfty_min_tqe_n "Engine speed breakpoint" 0xa002231c Vxx_sfty_n_min_tqe_agb_fac _REC_A2AXS_20_u1 8160. _CNV_A_R_LINEAR_____2_CM 5 0. 8160. FORMAT "%4.0" /end AXIS_PTS
/begin CHARACTERISTIC Cmp_sfty_driv_tqe_map "Map giving effective engine torque setpoint from powertrain setpoint and engine speed for safety" MAP 0xa002264c _REC_A1MAP_20_u2_u2_u1 2047.96875 _CNV_A_R_LINEAR_____181_CM 0. 2047.96875 FORMAT "%10.5"
 /begin AXIS_DESCR COM_AXIS Vxx_sfty_driv_pwt_sp _CNV_A_R_LINEAR_____238_CM 17 0. 1. FORMAT "%7.5" AXIS_PTS_REF Ctb_sfty_driv_tqe_map_pwt_sp /end AXIS_DESCR
 /begin AXIS_DESCR COM_AXIS Vxx_sfty_n _CNV_A_R_LINEAR_____2_CM 20 0. 8160. FORMAT "%4.0" AXIS_PTS_REF Ctb_sfty_driv_tqe_map_n /end AXIS_DESCR
/end CHARACTERISTIC
/begin CHARACTERISTIC Ctp_sfty_driv_tq_fil_acel "filtering coefficient for driver torque request during acceleration phase (for safety)" CURVE 0xa00228f4 _REC_A1CUR_20_u1_u1 0.99609375 _CNV_A_R_LINEAR_____29_CM 0. 0.99609375 FORMAT "%5.3"
 /begin AXIS_DESCR COM_AXIS Vxx_sfty_n _CNV_A_R_LINEAR_____2_CM 9 0. 8160. FORMAT "%4.0" AXIS_PTS_REF Ctb_sfty_ajs_n /end AXIS_DESCR
/end CHARACTERISTIC
/begin CHARACTERISTIC Ctp_sfty_driv_tq_fil_decl "filtering coefficient for driver torque request during deceleration phase (for safety)" CURVE 0xa0022900 _REC_A1CUR_20_u1_u1 0.99609375 _CNV_A_R_LINEAR_____29_CM 0. 0.99609375 FORMAT "%5.3"
 /begin AXIS_DESCR COM_AXIS Vxx_sfty_n _CNV_A_R_LINEAR_____2_CM 9 0. 8160. FORMAT "%4.0" AXIS_PTS_REF Ctb_sfty_ajs_n /end AXIS_DESCR
/end CHARACTERISTIC
/begin CHARACTERISTIC Ctp_sfty_min_driv_tqe_map "Format the powertrain setpoint to disable the minimum driver engine torque (for safety monitoring)" CURVE 0xa002290c _REC_A1CUR_20_u2_u2 1. _CNV_A_R_LINEAR_____238_CM 0. 1. FORMAT "%7.5"
 /begin AXIS_DESCR COM_AXIS Vxx_sfty_driv_pwt_sp _CNV_A_R_LINEAR_____238_CM 17 0. 1. FORMAT "%7.5" AXIS_PTS_REF Ctb_sfty_min_driv_tqe_pwt_sp /end AXIS_DESCR
/end CHARACTERISTIC
/begin CHARACTERISTIC Ctp_sfty_min_tqe_agb_fac "automatic gearbox torque factor" CURVE 0xa0022322 _REC_A1CUR_20_u1_u1 0.99609375 _CNV_A_R_LINEAR_____29_CM 0. 0.99609375 FORMAT "%5.3"
 /begin AXIS_DESCR COM_AXIS Vxx_sfty_n_min_tqe_agb_fac _CNV_A_R_LINEAR_____2_CM 5 0. 8160. FORMAT "%4.0" AXIS_PTS_REF Ctb_sfty_min_tqe_n /end AXIS_DESCR
/end CHARACTERISTIC
/begin MEASUREMENT Vbx_ajs_cut_mon "Boolean variable to cut (1) the anti-jerk strategy for fuel cut off monitoring" UBYTE _CNV_S_2_RANGE______3_CM 1 0. 0. 1. ECU_ADDRESS 0xd000803a BIT_MASK 0x1 /end MEASUREMENT
/begin MEASUREMENT Vxx_sfty_ajs_modu_tqe "Final Torque after AJS Modulation action for safety" UWORD _CNV_A_R_LINEAR_____216_CM 1 0. -400. 1647.96875 ECU_ADDRESS 0xd000802e FORMAT "%10.5" /end MEASUREMENT
/begin MEASUREMENT Vxx_sfty_arb_tqe "Torque before AJS Correction action for safety" UWORD _CNV_A_R_LINEAR_____216_CM 1 0. -400. 1647.96875 ECU_ADDRESS 0xd0008030 FORMAT "%10.5" /end MEASUREMENT
/begin MEASUREMENT Vxx_sfty_driv_tqe_sp "Effective engine torque requested by real (pedal) and virtual (ACC/CC/SL) drivers for safety" UWORD _CNV_A_R_LINEAR_____216_CM 1 0. -400. 1647.96875 ECU_ADDRESS 0xd0008032 FORMAT "%10.5" /end MEASUREMENT
/begin MEASUREMENT Vxx_sfty_lim_driv_tqe "Effective engine torque requested by real (pedal) and virtual (ACC/CC/SL) drivers for safety" UWORD _CNV_A_R_LINEAR_____216_CM 1 0. -400. 1647.96875 ECU_ADDRESS 0xd0008034 FORMAT "%10.5" /end MEASUREMENT
/begin MEASUREMENT Vxx_sfty_min_avl_tqe "minimum available engine torque for safety" UWORD _CNV_A_R_LINEAR_____216_CM 1 0. -400. 1647.96875 ECU_ADDRESS 0xd0008036 FORMAT "%10.5" /end MEASUREMENT
/begin MEASUREMENT Vxx_sfty_n_min_tqe_agb_fac "Input variable for automatic gearbox torque calculation" UBYTE _CNV_A_R_LINEAR_____2_CM 1 0. 0. 8160. ECU_ADDRESS 0xd000803b FORMAT "%4.0" /end MEASUREMENT
/begin MEASUREMENT Vxx_sfty_tqi_sp "Final indicated setpoint torque for safety" UWORD _CNV_A_R_LINEAR_____181_CM 1 0. 0. 2047.96875 ECU_ADDRESS 0xd0008038 FORMAT "%10.5" /end MEASUREMENT
/begin CHARACTERISTIC Cxx_sfty_agb_max_tqe_cor "Value of maximum torque allowed for AT torque converter (for safety)" VALUE 0xa0022328 _REC_S1VAL_20_u2 2047.96875 _CNV_A_R_LINEAR_____181_CM 0. 2047.96875 FORMAT "%10.5" /end CHARACTERISTIC
/begin CHARACTERISTIC Cxx_sfty_is_n_t "Idle speed authorization exit time" VALUE 0xa0022334 _REC_S1VAL_20_u1 10.2 _CNV_A_R_LINEAR_____208_CM 0. 10.2 FORMAT "%4.2" /end CHARACTERISTIC
/begin CHARACTERISTIC Cxx_sfty_is_n_thd "maximum engine speed value for authorized idle speed torque for safety" VALUE 0xa0022335 _REC_S1VAL_20_u1 8160. _CNV_A_R_LINEAR_____2_CM 0. 8160. FORMAT "%4.0" /end CHARACTERISTIC
/begin CHARACTERISTIC Cxx_sfty_is_tqe_sp_max "maximum value for idle speed torque for safety" VALUE 0xa002232a _REC_S1VAL_20_s2 2047.96875 _CNV_A_R_LINEAR_____181_CM -1024. 1023.96875 FORMAT "%11.5" /end CHARACTERISTIC
/begin CHARACTERISTIC Cxx_sfty_max_is_n_sp "maximum value for Final idle speed setpoint for safety" VALUE 0xa0022336 _REC_S1VAL_20_u1 8160. _CNV_A_R_LINEAR_____2_CM 0. 8160. FORMAT "%4.0" /end CHARACTERISTIC
/begin CHARACTERISTIC Cxx_sfty_max_l_eng_tq "Max value of low engine minimum torque (for safety monitoring)" VALUE 0xa002232c _REC_S1VAL_20_u2 2047.96875 _CNV_A_R_LINEAR_____181_CM 0. 2047.96875 FORMAT "%10.5" /end CHARACTERISTIC
/begin CHARACTERISTIC Cxx_sfty_tkof_end_vs_thd "Threshold of vehicle speed to exit of take off state (for safety monitoring)" VALUE 0xa002232e _REC_S1VAL_20_u2 655.35 _CNV_A_R_LINEAR_____125_CM 0. 655.35 FORMAT "%6.2" /end CHARACTERISTIC
/begin CHARACTERISTIC Cxx_sfty_tkof_n_thd "Engine speed threshold below which take off correction is applied (for safety)" VALUE 0xa0022337 _REC_S1VAL_20_u1 8160. _CNV_A_R_LINEAR_____2_CM 0. 8160. FORMAT "%4.0" /end CHARACTERISTIC
/begin CHARACTERISTIC Cxx_sfty_tkof_pwt_sp_thd "Powertrain setpoint threshold for take off" VALUE 0xa0022330 _REC_S1VAL_20_u2 1. _CNV_A_R_LINEAR_____238_CM 0. 1. FORMAT "%7.5" /end CHARACTERISTIC
/begin CHARACTERISTIC Cxx_sfty_tkof_tqe_cor "torque correction for take off (for safety)" VALUE 0xa0022332 _REC_S1VAL_20_u2 2047.96875 _CNV_A_R_LINEAR_____216_CM -400. 1647.96875 FORMAT "%10.5" /end CHARACTERISTIC
/begin MEASUREMENT Vbx_sfty_acel_pdl_fil_sens_v1 "Accelerator pedal sensor track 1 evolution condition for safety" UBYTE _CNV_S_2_RANGE______3_CM 1 0. 0. 1. ECU_ADDRESS 0xd0007ff4 BIT_MASK 0x1 /end MEASUREMENT
/begin MEASUREMENT Vbx_sfty_acel_pdl_fil_sens_v2 "Accelerator pedal sensor track 2 evolution condition for safety" UBYTE _CNV_S_2_RANGE______3_CM 1 0. 0. 1. ECU_ADDRESS 0xd0007ff5 BIT_MASK 0x1 /end MEASUREMENT
/begin MEASUREMENT Vxx_sfty_acel_pdl_fil_sens_v1 "Filtered accelerator pedal sensor output voltage : track 1 for safety" UWORD _CNV_A_R_LINEAR_____183_CM 1 0. 0. 0.9990234375 ECU_ADDRESS 0xd0007fea FORMAT "%11.9" /end MEASUREMENT
/begin MEASUREMENT Vxx_sfty_acel_pdl_fil_sens_v2 "Filtered accelerator pedal sensor output voltage : track 2 for safety" UWORD _CNV_A_R_LINEAR_____183_CM 1 0. 0. 0.9990234375 ECU_ADDRESS 0xd0007fec FORMAT "%11.9" /end MEASUREMENT
/begin MEASUREMENT Vxx_sfty_acel_pdl_rat "Normalised accelerator pedal position (for safety)" UWORD _CNV_A_R_LINEAR_____319_CM 1 0. 0. 1.25 ECU_ADDRESS 0xd0007fee FORMAT "%7.5" /end MEASUREMENT
/begin MEASUREMENT Vxx_sfty_acel_pdl_sens_rat1 "Accelerator pedal sensor output voltage ratio : track 1 for safety" UWORD _CNV_A_R_LINEAR_____183_CM 1 0. 0. 0.9990234375 ECU_ADDRESS 0xd0007ff0 FORMAT "%11.9" /end MEASUREMENT
/begin MEASUREMENT Vxx_sfty_acel_pdl_sens_rat2 "Accelerator pedal sensor output voltage ratio : track 2 for safety" UWORD _CNV_A_R_LINEAR_____183_CM 1 0. 0. 0.9990234375 ECU_ADDRESS 0xd0007ff2 FORMAT "%11.9" /end MEASUREMENT
/begin CHARACTERISTIC Cxx_sfty_acel_pdl_0_rat_v1 "Uref ratio value defining 0 pedal ratio position (for safety)" VALUE 0xa0022300 _REC_S1VAL_20_u2 0.9990234375 _CNV_A_R_LINEAR_____183_CM 0. 0.9990234375 FORMAT "%11.9" /end CHARACTERISTIC
/begin CHARACTERISTIC Cxx_sfty_acel_pdl_0_rat_v2 "Uref ratio value defining 0 pedal ratio position of track 2 (for safety)" VALUE 0xa0022302 _REC_S1VAL_20_u2 0.9990234375 _CNV_A_R_LINEAR_____183_CM 0. 0.9990234375 FORMAT "%11.9" /end CHARACTERISTIC
/begin CHARACTERISTIC Cxx_sfty_acel_pdl_100_rat_v1 "Uref ratio value defining 1 pedal ratio position (for safety)" VALUE 0xa0022304 _REC_S1VAL_20_u2 0.9990234375 _CNV_A_R_LINEAR_____183_CM 0. 0.9990234375 FORMAT "%11.9" /end CHARACTERISTIC
/begin CHARACTERISTIC Cxx_sfty_acel_pdl_100_rat_v2 "Uref ratio value defining 1 pedal ratio position of track 2 (for safety)" VALUE 0xa0022306 _REC_S1VAL_20_u2 0.9990234375 _CNV_A_R_LINEAR_____183_CM 0. 0.9990234375 FORMAT "%11.9" /end CHARACTERISTIC
/begin CHARACTERISTIC Cxx_sfty_acel_pdl_sens_pws "Accelerator pedal sensor power supply for safety" VALUE 0xa0022308 _REC_S1VAL_20_u2 25000. _CNV_A_R_LINEAR_____107_CM 0. 25000. FORMAT "%5.0" /end CHARACTERISTIC
/begin CHARACTERISTIC Cxx_sfty_acel_pdl_stab_thd "Accelerator pedal signal stabilization threshold for safety" VALUE 0xa002230a _REC_S1VAL_20_u2 0.9990234375 _CNV_A_R_LINEAR_____183_CM 0. 0.9990234375 FORMAT "%11.9" /end CHARACTERISTIC
/begin MEASUREMENT Vxx_sfty_mux_agb_tqe_sp "Automatic transmission fast-acting torque setting acquired on the CAN ( for saffety monitoring)" UWORD _CNV_A_R_LINEAR_____216_CM 1 0. -400. 1647.96875 ECU_ADDRESS 0xd0007ffe FORMAT "%10.5" /end MEASUREMENT
/begin MEASUREMENT Vxx_sfty_mux_msr_tqe_sp "MSR torque setting acquired on the MUX ( for safety monitoring)" UWORD _CNV_A_R_LINEAR_____216_CM 1 0. -400. 1647.96875 ECU_ADDRESS 0xd0008000 FORMAT "%10.5" /end MEASUREMENT
/begin AXIS_PTS Ctb_sfty_acel_pdl_fmt_fac_vs "Vehicle speed breakpoints for map giving transition factor between 2 progressivity maps (for safety torque monitoring)" 0xa00223d8 Vxx_vs _REC_A2AXS_20_u2 655.35 _CNV_A_R_LINEAR_____125_CM 9 0. 655.35 FORMAT "%6.2" /end AXIS_PTS
/begin MEASUREMENT Vbx_sfty_mux_dyn_mod_req "Sport mode request received on the CAN (for safety monitoring)" UBYTE _CNV_S_2_RANGE______3_CM 1 0. 0. 1. ECU_ADDRESS 0xd0007ff8 BIT_MASK 0x1 /end MEASUREMENT
/begin MEASUREMENT Vxx_sfty_mux_rs_dspl_spt_fac "Pedal progressivity maps chosen by the Renault Sport Display received on the CAN (for safety monitoring)" UBYTE _CNV_A_R_ECME_LINEA_0_CM 1 0. 0. 15. ECU_ADDRESS 0xd0007ff9 FORMAT "%2.0" /end MEASUREMENT
/begin AXIS_PTS Ctb_sfty_acel_fmt_tkof_fac_vs "Vehicle speed breakpoints for \"take off map\" giving transition factor between 2 progressivity maps (for safety torque monitoring)" 0xa00223cc Vxx_vs _REC_A2AXS_20_u2 655.35 _CNV_A_R_LINEAR_____125_CM 5 0. 655.35 FORMAT "%6.2" /end AXIS_PTS
/begin AXIS_PTS Ctb_sfty_acel_tkof_fac_driv "take off assistance factor breakpoints for \"take off map\" giving transition factor between 2 progressivity maps (for safety torque" 0xa00222f0 Vxx_tkof_ass_fac _REC_A2AXS_20_u1 1. _CNV_A_R_LINEAR_____275_CM 5 0. 1. FORMAT "%5.3" /end AXIS_PTS
/begin AXIS_PTS Ntb_sfty_rs_dspl_pdl_spt_fac "Renault Sport Display factor breakpoints for \"sportivity map\" giving transition factor between 2 progressivity maps" 0xa00223ec Vxx_sfty_rs_dspl_pdl_fac_cfm _REC_A2AXS_20_u1 14. _CNV_A_R_ECME_LINEA_0_CM 15 1. 15. READ_ONLY FORMAT "%2.0" /end AXIS_PTS
/begin CHARACTERISTIC Cmp_sfty_acel_fmt_rs_dspl_fac "Renault Sport Display factor map giving transition between 2 progressivity maps (for safety torque monitoring)" MAP 0xa00223fc _REC_A1MAP_20_u1_u2_u1 0.99609375 _CNV_A_R_LINEAR_____29_CM 0. 0.99609375 FORMAT "%5.3"
 /begin AXIS_DESCR COM_AXIS Vxx_vs _CNV_A_R_LINEAR_____125_CM 9 0. 655.35 FORMAT "%6.2" AXIS_PTS_REF Ctb_sfty_acel_pdl_fmt_fac_vs /end AXIS_DESCR
 /begin AXIS_DESCR COM_AXIS Vxx_sfty_rs_dspl_pdl_fac_cfm _CNV_A_R_ECME_LINEA_0_CM 15 1. 15. READ_ONLY FORMAT "%2.0" AXIS_PTS_REF Ntb_sfty_rs_dspl_pdl_spt_fac /end AXIS_DESCR
/end CHARACTERISTIC
/begin CHARACTERISTIC Cmp_sfty_acel_pdl_fmt_fac "Vehicle speed and driving style map giving transition factor between 2 progressivity maps (for safety)" MAP 0xa0022484 _REC_A1MAP_20_u1_u2_u1 0.99609375 _CNV_A_R_LINEAR_____29_CM 0. 0.99609375 FORMAT "%5.3"
 /begin AXIS_DESCR COM_AXIS Vxx_vs _CNV_A_R_LINEAR_____125_CM 5 0. 655.35 FORMAT "%6.2" AXIS_PTS_REF Ctb_sfty_acel_fmt_tkof_fac_vs /end AXIS_DESCR
 /begin AXIS_DESCR COM_AXIS Vxx_tkof_ass_fac _CNV_A_R_LINEAR_____275_CM 5 0. 1. FORMAT "%5.3" AXIS_PTS_REF Ctb_sfty_acel_tkof_fac_driv /end AXIS_DESCR
/end CHARACTERISTIC
/begin CHARACTERISTIC Ctp_sfty_acel_pdl_fmt_fac "Vehicle speed map giving nominal factor between 2 progressivity maps (for torque safety monitoring)" CURVE 0xa00224a0 _REC_A1CUR_20_u1_u2 0.99609375 _CNV_A_R_LINEAR_____29_CM 0. 0.99609375 FORMAT "%5.3"
 /begin AXIS_DESCR COM_AXIS Vxx_vs _CNV_A_R_LINEAR_____125_CM 9 0. 655.35 FORMAT "%6.2" AXIS_PTS_REF Ctb_sfty_acel_pdl_fmt_fac_vs /end AXIS_DESCR
/end CHARACTERISTIC
/begin CHARACTERISTIC Ctp_sfty_acel_pdl_fmt_spt_fac "Vehicle speed map giving sportivity factor between 2 progressivity maps (for safety torque monitoring)" CURVE 0xa00224ac _REC_A1CUR_20_u1_u2 0.99609375 _CNV_A_R_LINEAR_____29_CM 0. 0.99609375 FORMAT "%5.3"
 /begin AXIS_DESCR COM_AXIS Vxx_vs _CNV_A_R_LINEAR_____125_CM 9 0. 655.35 FORMAT "%6.2" AXIS_PTS_REF Ctb_sfty_acel_pdl_fmt_fac_vs /end AXIS_DESCR
/end CHARACTERISTIC
/begin MEASUREMENT Vxx_sfty_acel_pdl_fmt_fac "Interpolation factor between pedal progressivity maps (0<=>map1, 1<=>map2) (for safety torque monitoring)" UBYTE _CNV_A_R_LINEAR_____29_CM 1 0. 0. 0.99609375 ECU_ADDRESS 0xd0007fde FORMAT "%5.3" /end MEASUREMENT
/begin MEASUREMENT Vxx_sfty_acel_pdl_fmt_nom_fac "Interpolation factor in nominal mode between pedal progressivity maps (0<=>map1, 1<=>map2) (for safety torque monitoring)" UBYTE _CNV_A_R_LINEAR_____29_CM 1 0. 0. 0.99609375 ECU_ADDRESS 0xd0007fdf FORMAT "%5.3" /end MEASUREMENT
/begin MEASUREMENT Vxx_sfty_acel_pdl_fmt_spt_fac "Interpolation factor in sport mode between pedal progressivity maps (0<=>map1, 1<=>map2) (for safety torque monitoring)" UBYTE _CNV_A_R_LINEAR_____29_CM 1 0. 0. 0.99609375 ECU_ADDRESS 0xd0007fe0 FORMAT "%5.3" /end MEASUREMENT
/begin MEASUREMENT Vxx_sfty_rs_dspl_pdl_fac_cfm "Confirmed pedal progressivity maps chosen by the Renault Sport Display (for safety torque monitoring)" UBYTE _CNV_A_R_ECME_LINEA_0_CM 1 0. 0. 15. ECU_ADDRESS 0xd0007fe1 FORMAT "%2.0" /end MEASUREMENT
/begin MEASUREMENT Vxx_sfty_rs_dspl_pdl_spt_fac "Pedal progressivity maps chosen by the Renault Sport Display (for safety torque monitoring)" UBYTE _CNV_A_R_ECME_LINEA_0_CM 1 0. 0. 15. ECU_ADDRESS 0xd0007fe2 FORMAT "%2.0" /end MEASUREMENT
/begin CHARACTERISTIC Cxx_sfty_pdl_fmt_slop_down "Slope constant used during the change of progressivity maps, when decreasing (for safety torque monitoring)" VALUE 0xa00222fa _REC_S1VAL_20_u1 0.99609375 _CNV_A_R_LINEAR_____548_CM 0. 0.99609375 FORMAT "%5.3" /end CHARACTERISTIC
/begin CHARACTERISTIC Cxx_sfty_pdl_fmt_slop_up "Slope constant used during the change of progressivity maps, when increasing (for safety torque monitoring)" VALUE 0xa00222fb _REC_S1VAL_20_u1 0.99609375 _CNV_A_R_LINEAR_____548_CM 0. 0.99609375 FORMAT "%5.3" /end CHARACTERISTIC
/begin CHARACTERISTIC Cxx_sfty_rs_dspl_pdl_act_dly "Delay before taking into account the RS Display pedal progressivity map request (for safety torque monitoring)" VALUE 0xa00222fc _REC_S1VAL_20_u1 10.2 _CNV_A_R_LINEAR_____208_CM 0. 10.2 FORMAT "%5.2" /end CHARACTERISTIC
/begin CHARACTERISTIC Cxx_sfty_tkof_cdn_vs_max "Maximum vehicule speed to detect that the vehicules is in take off conditions (for safety torque monitoring)" VALUE 0xa00222f6 _REC_S1VAL_20_u2 655.35 _CNV_A_R_LINEAR_____125_CM 0. 655.35 FORMAT "%6.2" /end CHARACTERISTIC
/begin CHARACTERISTIC Cxx_sfty_tkof_stop_vs "Limit vehicule speed that determines the end of a take off (for safety torque monitoring)" VALUE 0xa00222f8 _REC_S1VAL_20_u2 655.35 _CNV_A_R_LINEAR_____125_CM 0. 655.35 FORMAT "%6.2" /end CHARACTERISTIC
/begin CHARACTERISTIC Cmp_sfty_map_n_esti_tqi "Map of estimated engine indicated torque from manifold air pressure (for safety)" MAP 0xa0022930 _REC_A1MAP_20_u2_u2_u1 2047.96875 _CNV_A_R_LINEAR_____181_CM 0. 2047.96875 FORMAT "%10.5"
 /begin AXIS_DESCR COM_AXIS Vxx_map _CNV_A_R_LINEAR_____115_CM 9 0. 20000. FORMAT "%5.0" AXIS_PTS_REF Ctb_sfty_map /end AXIS_DESCR
 /begin AXIS_DESCR COM_AXIS Vxx_sfty_n _CNV_A_R_LINEAR_____2_CM 11 0. 8160. FORMAT "%4.0" AXIS_PTS_REF Ctb_sfty_n /end AXIS_DESCR
/end CHARACTERISTIC
/begin MEASUREMENT Vxx_sfty_esti_tqi "Estimated indicated torque from manifold air pressure (for safety)" UWORD _CNV_A_R_LINEAR_____181_CM 1 0. 0. 2047.96875 ECU_ADDRESS 0xd000803e FORMAT "%10.5" /end MEASUREMENT
/begin MEASUREMENT Vxx_sfty_esti_tqi_ctr "Counter of near-failures of torque realization check" UWORD _CNV_A_R_ECME_LINEA_0_CM 1 0. 0. 65535. DISPLAY_IDENTIFIER TqSafTsm_NVM.Vxx_sfty_esti_tqi_ctr_NVM ECU_ADDRESS 0xd0004b62 FORMAT "%5.0" /end MEASUREMENT
/begin MEASUREMENT Vxx_sfty_tqi_sp_ctr "Counter of near-failures of torque request check" UWORD _CNV_A_R_ECME_LINEA_0_CM 1 0. 0. 65535. DISPLAY_IDENTIFIER TqSafTsm_NVM.Vxx_sfty_tqi_sp_ctr_NVM ECU_ADDRESS 0xd0004b64 FORMAT "%5.0" /end MEASUREMENT
/begin MEASUREMENT Vbx_sfty_esti_tqi_ctr_inc_tmp "Near-failure of torque estimation before debouncing" UBYTE _CNV_S_2_RANGE______3_CM 1 0. 0. 1. ECU_ADDRESS 0xd0007cc6 BIT_MASK 0x1 /end MEASUREMENT
/begin MEASUREMENT Vbx_sfty_tqi_sp_ctr_inc_tmp "Near-failure of torque request before debouncing" UBYTE _CNV_S_2_RANGE______3_CM 1 0. 0. 1. ECU_ADDRESS 0xd0007cc7 BIT_MASK 0x1 /end MEASUREMENT
/begin MEASUREMENT Vxx_sfty_esti_tqi_ctr_inc "Near-failure of torque estimation" UBYTE _CNV_A_R_ECME_LINEA_0_CM 1 0. 0. 1. ECU_ADDRESS 0xd0007cc8 FORMAT "%1.0" /end MEASUREMENT
/begin MEASUREMENT Vxx_sfty_esti_tqi_ctr_last "Last value of Counter of near-failures of torque realization check" UWORD _CNV_A_R_ECME_LINEA_0_CM 1 0. 0. 65535. ECU_ADDRESS 0xd00060a2 FORMAT "%5.0" /end MEASUREMENT
/begin MEASUREMENT Vxx_sfty_esti_tqi_deb_thd2 "Threshold for safety torque realization near-failure detection" UWORD _CNV_A_R_ECME_LINEA_0_CM 1 0. 0. 65535. ECU_ADDRESS 0xd00060a4 FORMAT "%5.0" /end MEASUREMENT
/begin MEASUREMENT Vxx_sfty_tqi_sp_ctr_inc "Near-failure of torque request" UBYTE _CNV_A_R_ECME_LINEA_0_CM 1 0. 0. 1. ECU_ADDRESS 0xd0007cc9 FORMAT "%1.0" /end MEASUREMENT
/begin MEASUREMENT Vxx_sfty_tqi_sp_ctr_last "Last value of counter of near-failures of torque request check" UWORD _CNV_A_R_ECME_LINEA_0_CM 1 0. 0. 65535. ECU_ADDRESS 0xd00060a6 FORMAT "%5.0" /end MEASUREMENT
/begin MEASUREMENT Vxx_sfty_tqi_sp_deb_thd2 "Threshold for safety torque setpoint near-failure detection" UWORD _CNV_A_R_ECME_LINEA_0_CM 1 0. 0. 65535. ECU_ADDRESS 0xd00060a8 FORMAT "%5.0" /end MEASUREMENT
/begin CHARACTERISTIC Cxx_sfty_esti_tqi_deb_thd_ofs "Offset of threshold for safety torque realization failure detection" VALUE 0xa0021f80 _REC_S1VAL_20_u2 65535. _CNV_A_R_ECME_LINEA_0_CM 0. 65535. FORMAT "%5.0" /end CHARACTERISTIC
/begin CHARACTERISTIC Cxx_sfty_esti_tqi_pos_err_ofs "Torque margin used for torque realization near-failure counter (for safety)" VALUE 0xa0021f82 _REC_S1VAL_20_u2 2047.96875 _CNV_A_R_LINEAR_____181_CM 0. 2047.96875 FORMAT "%10.5" /end CHARACTERISTIC
/begin CHARACTERISTIC Cxx_sfty_tqi_req_pos_err_ofs "Torque margin used for torque request near-failure counter (for safety)" VALUE 0xa0021f84 _REC_S1VAL_20_u2 2047.96875 _CNV_A_R_LINEAR_____181_CM 0. 2047.96875 FORMAT "%10.5" /end CHARACTERISTIC
/begin CHARACTERISTIC Cxx_sfty_tqi_sp_deb_thd_ofs "Offset of threshold for safety torque setpoint failure detection" VALUE 0xa0021f86 _REC_S1VAL_20_u2 65535. _CNV_A_R_ECME_LINEA_0_CM 0. 65535. FORMAT "%5.0" /end CHARACTERISTIC
/begin AXIS_PTS Ctb_sfty_thr_lih_n "12 programmable engine speed breakpoints map" 0xa00229f8 Vxx_sfty_n _REC_A2AXS_20_u1 8160. _CNV_A_R_LINEAR_____2_CM 12 0. 8160. FORMAT "%4.0" /end AXIS_PTS
/begin CHARACTERISTIC Ctp_sfty_thr_lih_map "breakpoint for manifold pressure value during throttle limp home" CURVE 0xa0022a08 _REC_A1CUR_20_u2_u1 20000. _CNV_A_R_LINEAR_____115_CM 0. 20000. FORMAT "%5.0"
 /begin AXIS_DESCR COM_AXIS Vxx_sfty_n _CNV_A_R_LINEAR_____2_CM 12 0. 8160. FORMAT "%4.0" AXIS_PTS_REF Ctb_sfty_thr_lih_n /end AXIS_DESCR
/end CHARACTERISTIC
/begin MEASUREMENT Vbx_sfty_thr_lih_mon_nok "boolean which indicates that the throttle limp home doesn't execut correctly for safety" UBYTE _CNV_S_2_RANGE______3_CM 1 0. 0. 1. ECU_ADDRESS 0xd0008045 BIT_MASK 0x1 /end MEASUREMENT
/begin CHARACTERISTIC Cxx_sfty_map_thd "manifold pressure threshold for detection that the throttle limp home doesn't execut correctly" VALUE 0xa0022338 _REC_S1VAL_20_u2 20000. _CNV_A_R_LINEAR_____115_CM 0. 20000. FORMAT "%5.0" /end CHARACTERISTIC
/begin CHARACTERISTIC Cxx_sfty_thr_lih_mon_ini_dly "Initialization time of the throttle limp home manifold pressure failure detection" VALUE 0xa002233a _REC_S1VAL_20_u1 10.2 _CNV_A_R_LINEAR_____208_CM 0. 10.2 FORMAT "%4.2" /end CHARACTERISTIC
/begin COMPU_METHOD _CNV_A_R_ECME_LINEA_0_CM "" RAT_FUNC "%6.3" "-" COEFFS 0 1. 0. 0 0 1 /end COMPU_METHOD
/begin COMPU_METHOD _CNV_A_R_LINEAR_____2_CM "" RAT_FUNC "%6.3" "rpm" COEFFS 0 3.125e-002 0. 0 0 1 /end COMPU_METHOD
/begin COMPU_METHOD _CNV_S_2_RANGE______3_CM "" TAB_VERB "%6.3" "-" COMPU_TAB_REF _CNV_S_2_RANGE______3 /end COMPU_METHOD
/begin COMPU_VTAB _CNV_S_2_RANGE______3 "" TAB_VERB 2 0 "0" 1 "1" /end COMPU_VTAB
/begin COMPU_METHOD _CNV_A_R_ENSD_LINEA_22_CM "" RAT_FUNC "%6.3" "rpm" COEFFS 0 4. 0. 0 0 1 /end COMPU_METHOD
/begin COMPU_METHOD _CNV_A_R_LINEAR_____29_CM "" RAT_FUNC "%6.3" "-" COEFFS 0 256. 0. 0 0 1 /end COMPU_METHOD
/begin COMPU_METHOD _CNV_A_R_LINEAR_____58_CM "" RAT_FUNC "%6.3" "s" COEFFS 0 10. 0. 0 0 1 /end COMPU_METHOD
/begin COMPU_METHOD _CNV_A_R_A_105_CM "" RAT_FUNC "%6.3" "" COEFFS 0 1. 0. 0 0 1 /end COMPU_METHOD
/begin COMPU_METHOD _CNV_A_R_LINEAR_____107_CM "" RAT_FUNC "%6.3" "mV" COEFFS 0 1. 0. 0 0 1 /end COMPU_METHOD
/begin COMPU_METHOD _CNV_A_R_LINEAR_____115_CM "" RAT_FUNC "%6.3" "hPa" COEFFS 0 1. 0. 0 0 1 /end COMPU_METHOD
/begin COMPU_METHOD _CNV_A_R_LINEAR_____123_CM "" RAT_FUNC "%6.3" "-" COEFFS 0 100. 0. 0 0 1 /end COMPU_METHOD
/begin COMPU_METHOD _CNV_A_R_LINEAR_____125_CM "" RAT_FUNC "%6.3" "km/h" COEFFS 0 100. 0. 0 0 1 /end COMPU_METHOD
/begin COMPU_METHOD _CNV_S_3_STATUS_OK__179_CM "" TAB_VERB "%6.3" "-" COMPU_TAB_REF _CNV_S_3_STATUS_OK__179 /end COMPU_METHOD
/begin COMPU_VTAB _CNV_S_3_STATUS_OK__179 "" TAB_VERB 3 0 "Nsx_vld_nok_0" 1 "Nsx_vld_ok_1" 2 "Nsx_vld_fail_2" /end COMPU_VTAB
/begin COMPU_METHOD _CNV_A_R_LINEAR_____181_CM "" RAT_FUNC "%6.3" "Nm" COEFFS 0 32. 0. 0 0 1 /end COMPU_METHOD
/begin COMPU_METHOD _CNV_A_R_LINEAR_____183_CM "" RAT_FUNC "%6.3" "-" COEFFS 0 1024. 0. 0 0 1 /end COMPU_METHOD
/begin COMPU_METHOD _CNV_A_R_LINEAR_____208_CM "" RAT_FUNC "%6.3" "s" COEFFS 0 25. 0. 0 0 1 /end COMPU_METHOD
/begin COMPU_METHOD _CNV_A_R_LINEAR_____216_CM "" RAT_FUNC "%6.3" "Nm" COEFFS 0 32. 12800. 0 0 1 /end COMPU_METHOD
/begin COMPU_METHOD _CNV_A_R_LINEAR_____238_CM "" RAT_FUNC "%6.3" "-" COEFFS 0 800. 0. 0 0 1 /end COMPU_METHOD
/begin COMPU_METHOD _CNV_A_R_LINEAR_____243_CM "" RAT_FUNC "%6.3" "°C/s" COEFFS 0 10. 0. 0 0 1 /end COMPU_METHOD
/begin COMPU_METHOD _CNV_A_R_LINEAR_____275_CM "" RAT_FUNC "%6.3" "ratio" COEFFS 0 255. 0. 0 0 1 /end COMPU_METHOD
/begin COMPU_METHOD _CNV_A_R_LINEAR_____280_CM "" RAT_FUNC "%6.3" "°C" COEFFS 0 1. 40. 0 0 1 /end COMPU_METHOD
/begin COMPU_METHOD _CNV_A_R_LINEAR_____319_CM "" RAT_FUNC "%6.3" "ratio" COEFFS 0 800. 0. 0 0 1 /end COMPU_METHOD
/begin COMPU_METHOD _CNV_A_R_LINEAR_____485_CM "" RAT_FUNC "%6.3" "Nm" COEFFS 0 1. 0. 0 0 1 /end COMPU_METHOD
/begin COMPU_METHOD _CNV_R_R_VA_F_1_p1__494_CM "" RAT_FUNC "%6.3" "-" COEFFS 0. 1. -1. 0. 0. 1. /end COMPU_METHOD
/begin COMPU_METHOD _CNV_R_R_VA_F_0v000_496_CM "" RAT_FUNC "%6.3" "m/s2" COEFFS 0. 1. 0. 0. 0. 4.e-004 /end COMPU_METHOD
/begin COMPU_METHOD _CNV_R_R_VA_F_0v01__500_CM "" RAT_FUNC "%6.3" "km/h" COEFFS 0. 1. 0. 0. 0. 1.e-002 /end COMPU_METHOD
/begin COMPU_METHOD _CNV_S_2_VA_Bool_ON_502_CM "" TAB_VERB "%6.3" "." COMPU_TAB_REF _CNV_S_2_VA_Bool_ON_502 /end COMPU_METHOD
/begin COMPU_VTAB _CNV_S_2_VA_Bool_ON_502 "" TAB_VERB 2 0 "OFF" 1 "ON" /end COMPU_VTAB
/begin COMPU_METHOD _CNV_R_R_VA_I_16_503_CM "" RAT_FUNC "%6.3" "-" COEFFS 0. 1. 0. 0. 0. 1. /end COMPU_METHOD
/begin COMPU_METHOD _CNV_R_R_VA_F_10_p0_512_CM "" RAT_FUNC "%6.3" "W" COEFFS 0. 1. 0. 0. 0. 10. /end COMPU_METHOD
/begin COMPU_METHOD _CNV_R_R_VA_F_1_p0__515_CM "" RAT_FUNC "%6.3" "N.m" COEFFS 0. 1. 0. 0. 0. 1. /end COMPU_METHOD
/begin COMPU_METHOD _CNV_R_R_VA_F_0v1_m_519_CM "" RAT_FUNC "%6.3" "C" COEFFS 0. 1. 40. 0. 0. 0.1 /end COMPU_METHOD
/begin COMPU_METHOD _CNV_R_R_VA_F_0v004_520_CM "" RAT_FUNC "%6.3" "-" COEFFS 0. 1. 0. 0. 0. 4.e-003 /end COMPU_METHOD
/begin COMPU_METHOD _CNV_R_R_VA_F_1_p0__521_CM "" RAT_FUNC "%6.3" "kg" COEFFS 0. 1. 0. 0. 0. 1. /end COMPU_METHOD
/begin COMPU_METHOD _CNV_R_R_VA_F_0v031_522_CM "" RAT_FUNC "%6.3" "N.m" COEFFS 0. 1. 400. 0. 0. 3.125e-002 /end COMPU_METHOD
/begin COMPU_METHOD _CNV_R_R_VA_F_0v04__523_CM "" RAT_FUNC "%6.3" "s" COEFFS 0. 1. 0. 0. 0. 4.e-002 /end COMPU_METHOD
/begin COMPU_METHOD _CNV_R_R_VA_F_0v001_524_CM "" RAT_FUNC "%6.3" "m" COEFFS 0. 1. -0.2 0. 0. 1.e-003 /end COMPU_METHOD
/begin COMPU_METHOD _CNV_R_R_nCcfksc_mn_525_CM "LINEAR     [0.000000, 0H] [65.5350000, FFFFH]" RAT_FUNC "%6.3" "s" COEFFS 0. 1000. 0. 0. 0. 1. /end COMPU_METHOD
/begin COMPU_METHOD _CNV_R_R_gBspFma_cr_526_CM "LINEAR     [-200.000000, B1E0H] [200.000000,4E20H]" RAT_FUNC "%6.3" "%" COEFFS 0. 100. 0. 0. 0. 1. /end COMPU_METHOD
/begin COMPU_METHOD _CNV_R_R_xytAqxd_qA_527_CM "LINEAR     [0.000000, 0H] [100.000000, FFH]" RAT_FUNC "%6.3" "%" COEFFS 0. 2.55 0. 0. 0. 1. /end COMPU_METHOD
/begin COMPU_METHOD _CNV_R_R_Edjqxvd_mq_528_CM "LINEAR     [0.000000, 0H] [100.000000, FFFFH]" RAT_FUNC "%6.3" "%" COEFFS 0. 655.35 0. 0. 0. 1. /end COMPU_METHOD
/begin COMPU_METHOD _CNV_S_3_DpjnsAb_Eh_529_CM "ACTUATOR_TEST_STATUS" TAB_VERB "%6.3" "[-]" COMPU_TAB_REF _CNV_S_3_DpjnsAb_Eh_529 /end COMPU_METHOD
/begin COMPU_VTAB _CNV_S_3_DpjnsAb_Eh_529 "ACTUATOR_TEST_STATUS" TAB_VERB 3 0 "Nsx_tac_wait" 2 "Nsx_tac_end" 12 "Nsx_tac_abrt" /end COMPU_VTAB
/begin COMPU_METHOD _CNV_R_R_hdvlAid_gA_530_CM "[VIT_DDS]ArtificialDDSConversion" RAT_FUNC "%6.3" "" COEFFS 0. 1. 0. 0. 0. 1. /end COMPU_METHOD
/begin COMPU_METHOD _CNV_S_4_WI_Vsx_dia_531_CM "Variables and calibration compute method" TAB_VERB "%6.3" "[-]" COMPU_TAB_REF _CNV_S_4_WI_Vsx_dia_531 /end COMPU_METHOD
/begin COMPU_VTAB _CNV_S_4_WI_Vsx_dia_531 "Variables and calibration compute method" TAB_VERB 4 0 "Nsx_diag_sta_disa_stt" 1 "Nsx_diag_sta_run_stt" 2 "Nsx_diag_sta_end_stt" 3 "Nsx_diag_sta_abrt_stt" /end COMPU_VTAB
/begin COMPU_METHOD _CNV_S_3_WI_Vsx_opt_532_CM "Variables and calibration compute method" TAB_VERB "%6.3" "[-]" COMPU_TAB_REF _CNV_S_3_WI_Vsx_opt_532 /end COMPU_METHOD
/begin COMPU_VTAB _CNV_S_3_WI_Vsx_opt_532 "Variables and calibration compute method" TAB_VERB 3 0 "Nsx_opt_sta" 1 "Nsx_opt_stt" 11 "Nsx_opt_stop" /end COMPU_VTAB
/begin COMPU_METHOD _CNV_S_4_WI_Vsx_tac_533_CM "Variables and calibration compute method" TAB_VERB "%6.3" "[-]" COMPU_TAB_REF _CNV_S_4_WI_Vsx_tac_533 /end COMPU_METHOD
/begin COMPU_VTAB _CNV_S_4_WI_Vsx_tac_533 "Variables and calibration compute method" TAB_VERB 4 1 "Nsx_tac_stt_run" 2 "Nsx_tac_stt_end" 11 "Nsx_tac_stt_stop" 12 "Nsx_tac_stt_abrt" /end COMPU_VTAB
/begin COMPU_METHOD _CNV_S_6_WI_Vsx_tac_534_CM "Variables and calibration compute method" TAB_VERB "%6.3" "[-]" COMPU_TAB_REF _CNV_S_6_WI_Vsx_tac_534 /end COMPU_METHOD
/begin COMPU_VTAB _CNV_S_6_WI_Vsx_tac_534 "Variables and calibration compute method" TAB_VERB 6 1 "Nsx_tac_stt_run" 2 "Nsx_tac_stt_end" 11 "Nsx_tac_stt_stop" 12 "Nsx_tac_stt_abrt" 20 "Nsx_tac_stt_no_chr" 22 "Nsx_tac_stt_no_sta_cdn" /end COMPU_VTAB
/begin COMPU_METHOD _CNV_R_R_rkcmmwd_dn_535_CM "LINEAR     [0.000000, 0H] [1.000000, 320H]" RAT_FUNC "%6.3" "[-]" COEFFS 0. 800. 0. 0. 0. 1. /end COMPU_METHOD
/begin COMPU_METHOD _CNV_R_R_jDCaqEa_tl_536_CM "LINEAR     [0.000000, 0H] [100.000000, FFH]" RAT_FUNC "%6.3" "-" COEFFS 0. 2.55 0. 0. 0. 1. /end COMPU_METHOD
/begin COMPU_METHOD _CNV_R_R_qkkoDkb_kn_537_CM "LINEAR     [-655.360000, 8000H] [655.340000, 7FFFH]" RAT_FUNC "%6.3" "Â°CRK" COEFFS 0. 50. 0. 0. 0. 1. /end COMPU_METHOD
/begin COMPU_METHOD _CNV_R_R_CsFwmpa_Al_538_CM "LINEAR     [0.000000, 0H] [500000.00, 1E848H]" RAT_FUNC "%6.3" "Âµs" COEFFS 0. 0.25 0. 0. 0. 1. /end COMPU_METHOD
/begin COMPU_METHOD _CNV_R_R_ilwggEa_nw_539_CM "LINEAR     [0.000000, 0H] [765.000000, FFH]" RAT_FUNC "%6.3" "Â°CRK" COEFFS 0. 0.333333333333333 0. 0. 0. 1. /end COMPU_METHOD
/begin COMPU_METHOD _CNV_R_R_tAmwcfc_Da_540_CM "LINEAR     [0.000000, 0H] [8160.000000, 7F80H]" RAT_FUNC "%6.3" "rpm" COEFFS 0. 4. 0. 0. 0. 1. /end COMPU_METHOD
/begin COMPU_METHOD _CNV_R_R_Enocvxb_jc_541_CM "LINEAR     [0.000000, 0H] [100.000000, 7D0H]" RAT_FUNC "%6.3" "%" COEFFS 0. 20. 0. 0. 0. 1. /end COMPU_METHOD
/begin COMPU_METHOD _CNV_R_R_vbwtgvc_iB_542_CM "LINEAR     [-40.000000, 0H] [200.000000, 960H]" RAT_FUNC "%6.3" "Â°C" COEFFS 0. 10. 400. 0. 0. 1. /end COMPU_METHOD
/begin COMPU_METHOD _CNV_R_R_Cngqitd_gu_543_CM "LINEAR     [0.000000, 0H] [60.000000, 1770H]" RAT_FUNC "%6.3" "V" COEFFS 0. 100. 0. 0. 0. 1. /end COMPU_METHOD
/begin COMPU_METHOD _CNV_R_R_omqfgpc_fb_544_CM "LINEAR     [0.000000, 0H] [1.250000, 3E8H]" RAT_FUNC "%6.3" "%" COEFFS 0. 800. 0. 0. 0. 1. /end COMPU_METHOD
/begin COMPU_METHOD _CNV_R_R_fikncub_fA_545_CM "LINEAR     [-10000.000000, D8F0H] [10000.000000, 2710H]" RAT_FUNC "%6.3" "hPa" COEFFS 0. 1. 0. 0. 0. 1. /end COMPU_METHOD
/begin COMPU_METHOD _CNV_R_R_FfBqnda_Bd_546_CM "LINEAR     [0.000000, 0H] [255.000000, FFH]" RAT_FUNC "%6.3" "km/h" COEFFS 0. 1. 0. 0. 0. 1. /end COMPU_METHOD
/begin COMPU_METHOD _CNV_A_R_LINEAR_____547_CM "" RAT_FUNC "%6.3" "W" COEFFS 0 2.5e-002 0. 0 0 1 /end COMPU_METHOD
/begin COMPU_METHOD _CNV_A_R_LINEAR_____548_CM "" RAT_FUNC "%6.3" "ratio/s" COEFFS 0 256. 0. 0 0 1 /end COMPU_METHOD
/begin RECORD_LAYOUT _REC_S1VAL_20_u1 FNC_VALUES 1 UBYTE COLUMN_DIR DIRECT /end RECORD_LAYOUT
/begin RECORD_LAYOUT _REC_A2AXS_20_u1 NO_AXIS_PTS_X 1 UBYTE AXIS_PTS_X 2 UBYTE INDEX_INCR DIRECT /end RECORD_LAYOUT
/begin RECORD_LAYOUT _REC_S1VAL_20_u2 FNC_VALUES 1 UWORD COLUMN_DIR DIRECT /end RECORD_LAYOUT
/begin RECORD_LAYOUT _REC_S1VAL_20_s2 FNC_VALUES 1 SWORD COLUMN_DIR DIRECT /end RECORD_LAYOUT
/begin RECORD_LAYOUT _REC_A2AXS_20_u2 NO_AXIS_PTS_X 1 UWORD AXIS_PTS_X 2 UWORD INDEX_INCR DIRECT /end RECORD_LAYOUT
/begin RECORD_LAYOUT _REC_A1CUR_20_u1_u2 FNC_VALUES 1 UBYTE COLUMN_DIR DIRECT /end RECORD_LAYOUT
/begin RECORD_LAYOUT _REC_A1CUR_20_u1_u1 FNC_VALUES 1 UBYTE COLUMN_DIR DIRECT /end RECORD_LAYOUT
/begin RECORD_LAYOUT _REC_A1CUR_20_u2_u1 FNC_VALUES 1 UWORD COLUMN_DIR DIRECT /end RECORD_LAYOUT
/begin RECORD_LAYOUT _REC_A1MAP_20_u1_u1_u1 FNC_VALUES 1 UBYTE COLUMN_DIR DIRECT /end RECORD_LAYOUT
/begin RECORD_LAYOUT _REC_A1CUR_20_u2_u2 FNC_VALUES 1 UWORD COLUMN_DIR DIRECT /end RECORD_LAYOUT
/begin RECORD_LAYOUT _REC_A1MAP_20_u2_u2_u1 FNC_VALUES 1 UWORD COLUMN_DIR DIRECT /end RECORD_LAYOUT
/begin RECORD_LAYOUT _REC_A1MAP_20_u1_u2_u1 FNC_VALUES 1 UBYTE COLUMN_DIR DIRECT /end RECORD_LAYOUT
/begin RECORD_LAYOUT _REC_S1VAL_Normal_u1 FNC_VALUES 1 UBYTE COLUMN_DIR DIRECT /end RECORD_LAYOUT
/begin RECORD_LAYOUT _REC_S1VAL_Normal_u2 FNC_VALUES 1 UWORD COLUMN_DIR DIRECT /end RECORD_LAYOUT
/begin RECORD_LAYOUT _REC_S1VAL_Normal_u4 FNC_VALUES 1 ULONG COLUMN_DIR DIRECT /end RECORD_LAYOUT
/begin FUNCTION PcDrCRds_Fstqdxx_xxxxxx ""
 /begin DEF_CHARACTERISTIC Ctb_gear_fs Ctb_tq_dif_tco Ctb_tq_dif_vs Ctp_tq_dif_tco_fac Ctp_tq_res Ctp_vh_wht_eq Cxx_end_sip_ena_dly Cxx_pow_r_fil Cxx_tq_dif_acel_dec_fil Cxx_tq_dif_acel_inc_fil Cxx_tq_dif_degr_fac Cxx_tq_dif_esti_tqe_fil Cxx_tq_dif_fil Cxx_whl_rad /end DEF_CHARACTERISTIC
 /begin OUT_MEASUREMENT Vbx_fil_rst Vbx_frz Vbx_sip_frz Vsx_pow_r_vld Vsx_tq_dif_vld Vxx_dly_pow_r Vxx_dly_tq_dif Vxx_free_shf_acel Vxx_gear_lim_tq_dif Vxx_pow_r Vxx_pow_r_fil Vxx_pow_r_raw Vxx_tq_dif Vxx_tq_dif_esti_tqe_fil Vxx_tq_dif_fil /end OUT_MEASUREMENT
/end FUNCTION
/begin FUNCTION OuDgoLmp "" /begin SUB_FUNCTION OuDgoLmp_Milmgtx /end SUB_FUNCTION /end FUNCTION
/begin FUNCTION OuDgoLmp_Milmgtx ""
 /begin DEF_CHARACTERISTIC Cbx_mux_mil_cfm Cxx_mux_test_mil_dly Cxx_mux_test_rdn_mil_dly /end DEF_CHARACTERISTIC
 /begin OUT_MEASUREMENT Vbx_aut_eng_mil Vxx_mux_mil_req_1 Vxx_mux_mil_req_2 Vxx_mux_test_mil_dly Vxx_mux_test_rdn_mil_dly /end OUT_MEASUREMENT
/end FUNCTION
/begin FUNCTION InSmiLim "" /begin SUB_FUNCTION InSmiLim_Egbnlim /end SUB_FUNCTION /end FUNCTION
/begin FUNCTION InSmiLim_Egbnlim "" /begin DEF_CHARACTERISTIC Cxx_max_n_egb_dft /end DEF_CHARACTERISTIC /begin OUT_MEASUREMENT Vsx_egb_n_lim_vld Vxx_egb_n_lim /end OUT_MEASUREMENT /end FUNCTION
/begin FUNCTION Asa ""
 /begin OUT_MEASUREMENT ctr_rst_fmy lv_reset_frf_asa lv_inh_frf[0] lv_inh_frf[1] lv_inh_frf[2] lv_inh_frf[3] /end OUT_MEASUREMENT
/end FUNCTION
/begin FUNCTION DgDgtMon ""
 /begin SUB_FUNCTION DgDgtMon_Bypmngx DgDgtMon_Engsftx DgDgtMon_Evntmgr DgDgtMon_Monisft DgDgtMon_Monispv DgDgtMon_Routmng DgDgtMon_Tacmngx /end SUB_FUNCTION
/end FUNCTION
/begin FUNCTION DgDgtMon_Bypmngx ""
 /begin DEF_CHARACTERISTIC Cxx_moni_id_01_max Cxx_moni_id_01_min Cxx_moni_id_06_max Cxx_moni_id_06_min Cxx_moni_id_0a_max Cxx_moni_id_0a_min Cxx_moni_id_19_max Cxx_moni_id_19_min Cxx_moni_id_1c_max Cxx_moni_id_1c_min Cxx_moni_id_2b_max Cxx_moni_id_2b_min Cxx_moni_id_2c_max Cxx_moni_id_2c_min Cxx_moni_id_2d_max Cxx_moni_id_2d_min Cxx_moni_id_44_max Cxx_moni_id_44_min Cxx_moni_id_46_max Cxx_moni_id_46_min Cxx_moni_id_47_max Cxx_moni_id_47_min Cxx_moni_id_51_max Cxx_moni_id_51_min Cxx_moni_id_52_max Cxx_moni_id_52_min Cxx_moni_id_60_max Cxx_moni_id_60_min Cxx_moni_id_61_max Cxx_moni_id_61_min Cxx_moni_id_62_max Cxx_moni_id_62_min Cxx_moni_id_63_max Cxx_moni_id_63_min Cxx_moni_id_64_max Cxx_moni_id_64_min Cxx_moni_id_65_max Cxx_moni_id_65_min Cxx_moni_id_66_max Cxx_moni_id_66_min Cxx_moni_id_67_max Cxx_moni_id_67_min Cxx_moni_id_68_max Cxx_moni_id_68_min Cxx_moni_id_69_max Cxx_moni_id_69_min Cxx_moni_id_6a_max Cxx_moni_id_6a_min Cxx_moni_id_6b_max Cxx_moni_id_6b_min Cxx_moni_id_6c_max Cxx_moni_id_6c_min Cxx_moni_id_6d_max Cxx_moni_id_6d_min Cxx_moni_id_6e_max Cxx_moni_id_6e_min Cxx_moni_id_6f_max Cxx_moni_id_6f_min Cxx_moni_id_70_max Cxx_moni_id_70_min Cxx_moni_id_71_max Cxx_moni_id_71_min Cxx_moni_id_79_max Cxx_moni_id_79_min /end DEF_CHARACTERISTIC
 /begin OUT_MEASUREMENT Vbx_byp_70_sub_val Vbx_moni_id_01_req Vbx_byp_03_req Vbx_byp_06_req Vbx_byp_0a_req Vbx_moni_id_10_req Vbx_moni_id_11_req Vbx_moni_id_13_req Vbx_moni_id_14_req Vbx_moni_id_18_req Vbx_byp_19_req Vbx_moni_id_1a_req Vbx_moni_id_1b_req Vbx_byp_1c_req Vbx_byp_1d_req Vbx_byp_1e_req Vbx_byp_1f_req Vbx_moni_id_20_req Vbx_moni_id_21_req Vbx_byp_25_req Vbx_byp_26_req Vbx_byp_29_req Vbx_byp_2b_req Vbx_byp_2c_req Vbx_byp_2d_req Vbx_moni_id_30_req Vbx_moni_id_31_req Vbx_moni_id_32_req Vbx_moni_id_33_req Vbx_moni_id_34_req Vbx_moni_id_35_req Vbx_moni_id_36_req Vbx_moni_id_37_req Vbx_moni_id_38_req Vbx_moni_id_39_req Vbx_moni_id_3a_req Vbx_moni_id_3b_req Vbx_moni_id_3c_req Vbx_byp_3d_req Vbx_byp_3e_req Vbx_byp_40_req Vbx_byp_43_req Vbx_byp_44_req Vbx_byp_46_req Vbx_byp_47_req Vbx_byp_48_req Vbx_byp_49_req Vbx_byp_4a_req Vbx_byp_4b_req Vbx_byp_4c_req Vbx_byp_4d_req Vbx_byp_4e_req Vbx_byp_4f_req Vbx_byp_51_req Vbx_byp_52_req Vbx_byp_60_req Vbx_byp_61_req Vbx_byp_62_req Vbx_byp_63_req Vbx_byp_64_req Vbx_byp_65_req Vbx_byp_66_req Vbx_byp_67_req Vbx_byp_68_req Vbx_byp_69_req Vbx_byp_6a_req Vbx_byp_6b_req Vbx_byp_6c_req Vbx_byp_6d_req Vbx_byp_6e_req Vbx_byp_6f_req Vbx_byp_70_req Vbx_byp_71_req Vbx_byp_79_req Vbx_byp_81_req Vbx_byp_82_req Vbx_byp_83_req Vbx_byp_84_req Vbx_byp_85_req Vbx_byp_86_req Vbx_byp_87_req Vbx_byp_88_req Vxx_byp_06_sub_val Vxx_byp_0a_sub_val Vxx_byp_19_sub_val Vxx_byp_1c_sub_val Vxx_byp_2b_sub_val Vxx_byp_2c_sub_val Vxx_byp_2d_sub_val Vxx_byp_44_sub_val Vxx_byp_46_sub_val Vxx_byp_47_sub_val Vxx_byp_51_sub_val Vxx_byp_52_sub_val Vxx_byp_60_sub_val Vxx_byp_61_sub_val Vxx_byp_62_sub_val Vxx_byp_63_sub_val Vxx_byp_64_sub_val Vxx_byp_65_sub_val Vxx_byp_66_sub_val Vxx_byp_67_sub_val Vxx_byp_68_sub_val Vxx_byp_69_sub_val Vxx_byp_6a_sub_val Vxx_byp_6b_sub_val Vxx_byp_6c_sub_val Vxx_byp_6d_sub_val Vxx_byp_6e_sub_val Vxx_byp_6f_sub_val Vxx_byp_71_sub_val Vxx_byp_79_sub_val Vxx_moni_id_01_sub_val /end OUT_MEASUREMENT
/end FUNCTION
/begin FUNCTION DgDgtMon_Engsftx ""
 /begin DEF_CHARACTERISTIC Cbx_ext_ctrl_sens_spg_dsb Cxx_ext_ctrl_max_n Cxx_ext_ctrl_sens_spg_max Cxx_ext_ctrl_sens_spg_max_t Cxx_ext_ctrl_sens_tco_max /end DEF_CHARACTERISTIC
 /begin OUT_MEASUREMENT Vxx_ext_ctrl_eng_test_sf /end OUT_MEASUREMENT
/end FUNCTION
/begin FUNCTION DgDgtMon_Evntmgr "" /begin OUT_MEASUREMENT Vbx_ext_ctrl_test_act /end OUT_MEASUREMENT /end FUNCTION
/begin FUNCTION DgDgtMon_Monisft ""
 /begin DEF_CHARACTERISTIC Cbx_ext_ctrl_pdl_cdn_ena Cbx_ext_ctrl_vh_cdn_dsb Cxx_ext_ctrl_acel_pdl_rat_thd Cxx_ext_ctrl_vs_thd /end DEF_CHARACTERISTIC
 /begin OUT_MEASUREMENT Vbx_ext_ctrl_ena Vxx_ext_ctrl_test_sf /end OUT_MEASUREMENT
/end FUNCTION
/begin FUNCTION DgDgtMon_Monispv "" /begin DEF_CHARACTERISTIC Cxx_moni_stop_diag_dly /end DEF_CHARACTERISTIC
 /begin OUT_MEASUREMENT Vbx_clock Vbx_com_err Vbx_diag_sta_moni_abrt Vbx_diag_sta_moni_ena Vbx_diag_sta_moni_end Vbx_moni_appl_err Vbx_moni_dbl_nok Vbx_moni_id_nok Vbx_moni_nr_tot_id_nok Vbx_moni_oor Vbx_moni_read_req_done Vbx_moni_req_analyse Vbx_moni_req_data_changed Vbx_moni_stop_diag Vsx_diag_sta_moni_stt Vxx_clock_ecu Vxx_clock_init_timeout Vxx_init_timeout Vxx_moni_nr_tot_id Vxx_moni_sf_spv Vxx_timeout /end OUT_MEASUREMENT
/end FUNCTION
/begin FUNCTION DgDgtMon_Routmng ""
 /begin DEF_CHARACTERISTIC Cbx_diag_in_vvtc_ena_cam_crk_df Cxx_diag_ffig_it_psn_min Cxx_diag_in_vvtc_tco_max Cxx_diag_in_vvtc_tco_min Cxx_diag_in_vvtc_toil_max Cxx_diag_in_vvtc_toil_min Cxx_diag_in_vvtc_vb_max Cxx_diag_in_vvtc_vb_min /end DEF_CHARACTERISTIC
 /begin OUT_MEASUREMENT Vbx_rout_run_stt Vbx_start_cdn Vbx_stop_cdn Vbx_valid_req /end OUT_MEASUREMENT
/end FUNCTION
/begin FUNCTION DgDgtMon_Tacmngx ""
 /begin DEF_CHARACTERISTIC Cxx_tac_nc_io_01 Cxx_tac_tini_io_01 Cxx_tac_tini_stac_01 Cxx_tac_toff_io_01 Cxx_tac_toff_stac_01 Cxx_tac_ton_io_01 Cxx_tac_ton_stac_01 Cxx_tac_voff_io_01 Cxx_tac_voff_stac_01 Cxx_tac_von_io_01 Cxx_tac_von_stac_01 Cxx_tac_nc_io_02 Cxx_tac_tini_io_02 Cxx_tac_tini_stac_02 Cxx_tac_toff_io_02 Cxx_tac_toff_stac_02 Cxx_tac_ton_io_02 Cxx_tac_ton_stac_02 Cxx_tac_nc_io_03 Cxx_tac_tini_io_03 Cxx_tac_tini_stac_03 Cxx_tac_toff_io_03 Cxx_tac_toff_stac_03 Cxx_tac_ton_io_03 Cxx_tac_ton_stac_03 Cxx_tac_nc_io_04 Cxx_tac_tini_io_04 Cxx_tac_tini_stac_04 Cxx_tac_toff_io_04 Cxx_tac_toff_stac_04 Cxx_tac_ton_io_04 Cxx_tac_ton_stac_04 Cxx_tac_nc_io_05 Cxx_tac_tini_io_05 Cxx_tac_tini_stac_05 Cxx_tac_toff_io_05 Cxx_tac_toff_stac_05 Cxx_tac_ton_io_05 Cxx_tac_ton_stac_05 Cxx_tac_nc_io_06 Cxx_tac_tini_io_06 Cxx_tac_tini_stac_06 Cxx_tac_toff_io_06 Cxx_tac_toff_stac_06 Cxx_tac_ton_io_06 Cxx_tac_ton_stac_06 Cxx_tac_nc_io_07 Cxx_tac_tini_io_07 Cxx_tac_tini_stac_07 Cxx_tac_toff_io_07 Cxx_tac_toff_stac_07 Cxx_tac_ton_io_07 Cxx_tac_ton_stac_07 Cxx_tac_voff_io_07 Cxx_tac_voff_stac_07 Cxx_tac_von_io_07 Cxx_tac_von_stac_07 Cxx_tac_nc_io_08 Cxx_tac_tini_io_08 Cxx_tac_tini_stac_08 Cxx_tac_toff_io_08 Cxx_tac_toff_stac_08 Cxx_tac_ton_io_08 Cxx_tac_ton_stac_08 Cxx_tac_voff_io_08 Cxx_tac_voff_stac_08 Cxx_tac_von_io_08 Cxx_tac_von_stac_08 Cxx_tac_nc_io_09 Cxx_tac_tini_io_09 Cxx_tac_tini_stac_09 Cxx_tac_toff_io_09 Cxx_tac_toff_stac_09 Cxx_tac_ton_io_09 Cxx_tac_ton_stac_09 Cxx_tac_voff_io_09 Cxx_tac_voff_stac_09 Cxx_tac_von_io_09 Cxx_tac_von_stac_09 Cxx_tac_nc_io_10 Cxx_tac_tini_io_10 Cxx_tac_tini_stac_10 Cxx_tac_toff_io_10 Cxx_tac_toff_stac_10 Cxx_tac_ton_io_10 Cxx_tac_ton_stac_10 Cxx_tac_voff_io_10 Cxx_tac_voff_stac_10 Cxx_tac_von_io_10 Cxx_tac_von_stac_10 Cxx_tac_nc_io_20 Cxx_tac_tini_io_20 Cxx_tac_tini_stac_20 Cxx_tac_toff_io_20 Cxx_tac_toff_stac_20 Cxx_tac_ton_io_20 Cxx_tac_ton_stac_20 Cxx_tac_voff_io_20 Cxx_tac_voff_stac_20 Cxx_tac_von_io_20 Cxx_tac_von_stac_20 Cxx_tac_nc_io_49 Cxx_tac_tini_io_49 Cxx_tac_tini_stac_49 Cxx_tac_toff_io_49 Cxx_tac_toff_stac_49 Cxx_tac_ton_io_49 Cxx_tac_ton_stac_49 Cxx_tac_nc_io_50 Cxx_tac_tini_io_50 Cxx_tac_tini_stac_50 Cxx_tac_toff_io_50 Cxx_tac_toff_stac_50 Cxx_tac_ton_io_50 Cxx_tac_ton_stac_50 Cxx_tac_voff_io_50 Cxx_tac_voff_stac_50 Cxx_tac_von_io_50 Cxx_tac_von_stac_50 Cbx_it_ofs_clos_frst_dsb Cbx_it_ofs_open_frst_dsb Csx_tac_01 Csx_tac_02 Csx_tac_03 Csx_tac_04 Csx_tac_05 Csx_tac_06 Csx_tac_07 Csx_tac_08 Csx_tac_09 Csx_tac_10 Csx_tac_20 Csx_tac_22 Csx_tac_23 Csx_tac_24 Csx_tac_25 Csx_tac_29 Csx_tac_30 Csx_tac_31 Csx_tac_32 Csx_tac_35 Csx_tac_36 Csx_tac_37 Csx_tac_38 Csx_tac_49 Csx_tac_50 Cxx_tac_tout_timer_io Cxx_tac_tout_timer_stac Cxx_tac_vb_max Cxx_tac_vb_min /end DEF_CHARACTERISTIC
 /begin OUT_MEASUREMENT Vbx_tac_01_req Vsx_tac_01_cdn Vbx_tac_02_req Vsx_tac_02_cdn Vbx_tac_03_req Vsx_tac_03_cdn Vbx_tac_04_req Vsx_tac_04_cdn Vbx_tac_05_req Vsx_tac_05_cdn Vbx_tac_06_req Vsx_tac_06_cdn Vbx_tac_07_req Vsx_tac_07_cdn Vbx_tac_08_req Vsx_tac_08_cdn Vbx_tac_09_req Vsx_tac_09_cdn Vbx_tac_10_req Vsx_tac_10_cdn Vbx_tac_20_req Vsx_tac_20_cdn Vbx_tac_22_req Vsx_tac_22_cdn Vbx_tac_23_req Vsx_tac_23_cdn Vbx_tac_24_req Vsx_tac_24_cdn Vbx_tac_25_req Vsx_tac_25_cdn Vbx_tac_29_req Vsx_tac_29_cdn Vbx_tac_30_req Vsx_tac_30_cdn Vbx_tac_31_req Vsx_tac_31_cdn Vbx_tac_32_req Vsx_tac_32_cdn Vbx_tac_35_req Vsx_tac_35_cdn Vbx_tac_36_req Vsx_tac_36_cdn Vbx_tac_37_req Vsx_tac_37_cdn Vbx_tac_38_req Vsx_tac_38_cdn Vbx_tac_49_req Vsx_tac_49_cdn Vbx_tac_50_req Vsx_tac_50_cdn Vxx_tac_01_nc Vxx_tac_01_subval Vxx_tmp_dly_01 Vxx_tac_02_nc Vxx_tac_02_subval Vxx_tmp_dly_02 Vxx_tac_03_nc Vxx_tac_03_subval Vxx_tmp_dly_03 Vxx_tac_04_nc Vxx_tac_04_subval Vxx_tmp_dly_04 Vxx_tac_05_nc Vxx_tac_05_subval Vxx_tmp_dly_05 Vxx_tac_06_nc Vxx_tac_06_subval Vxx_tmp_dly_06 Vxx_tac_07_nc Vxx_tac_07_subval Vxx_tmp_dly_07 Vxx_tac_08_nc Vxx_tac_08_subval Vxx_tmp_dly_08 Vxx_tac_09_nc Vxx_tac_09_subval Vxx_tmp_dly_09 Vxx_tac_10_nc Vxx_tac_10_subval Vxx_tmp_dly_10 Vxx_tac_20_nc Vxx_tac_20_subval Vxx_tmp_dly_20 Vxx_tac_49_nc Vxx_tac_49_subval Vxx_tmp_dly_49 Vxx_tac_50_nc Vxx_tac_50_subval Vxx_tmp_dly_50 Vbx_diag_sta_stac_abrt Vbx_diag_sta_stac_ena Vbx_diag_sta_stac_end Vbx_tac_cdn Vbx_tac_ena Vbx_tac_tout Vsx_diag_sta_stac_stt Vsx_opt Vsx_tac_22_stt Vsx_tac_23_stt Vsx_tac_24_stt Vsx_tac_25_stt Vsx_tac_29_stt Vsx_tac_30_stt Vsx_tac_31_stt Vsx_tac_32_stt Vsx_tac_35_stt Vsx_tac_36_stt Vsx_tac_37_stt Vsx_tac_38_stt Vsx_tac_stt Vxx_LID Vxx_tac_tout_timer /end OUT_MEASUREMENT
/end FUNCTION
/begin FUNCTION TqSafTdm ""
 /begin SUB_FUNCTION TqSafTdm_Inacelp TqSafTdm_Ccmonxx TqSafTdm_Canmonx TqSafTdm_Acelpdl TqSafTdm_Tqitgtx TqSafTdm_Lossxxx TqSafTdm_Intcoxx TqSafTdm_Inspexx TqSafTdm_Incanxx TqSafTdm_Incanrs TqSafTdm_Dynfmxx /end SUB_FUNCTION
/end FUNCTION
/begin FUNCTION TqSafTdm_Inacelp ""
 /begin DEF_CHARACTERISTIC Cxx_sfty_acel_pdl_0_rat_v1 Cxx_sfty_acel_pdl_0_rat_v2 Cxx_sfty_acel_pdl_100_rat_v1 Cxx_sfty_acel_pdl_100_rat_v2 Cxx_sfty_acel_pdl_sens_pws Cxx_sfty_acel_pdl_stab_thd /end DEF_CHARACTERISTIC
 /begin OUT_MEASUREMENT Vbx_sfty_acel_pdl_fil_sens_v1 Vbx_sfty_acel_pdl_fil_sens_v2 Vxx_sfty_acel_pdl_fil_sens_v1 Vxx_sfty_acel_pdl_fil_sens_v2 Vxx_sfty_acel_pdl_rat Vxx_sfty_acel_pdl_sens_rat1 Vxx_sfty_acel_pdl_sens_rat2 /end OUT_MEASUREMENT
/end FUNCTION
/begin FUNCTION TqSafTdm_Ccmonxx ""
 /begin DEF_CHARACTERISTIC Cxx_sfty_cru_brk_nok_t Cxx_sfty_cru_brk_tout_1 Cxx_sfty_cru_brk_tout_2 Cxx_sfty_cru_brk_tout_long Cxx_sfty_cru_rest_max_v Cxx_sfty_cru_rest_min_v Cxx_sfty_cru_tq_req_t /end DEF_CHARACTERISTIC
 /begin OUT_MEASUREMENT Vbx_sfty_cru_brk Vbx_sfty_cru_brk_pdl_ok Vbx_sfty_cru_brk_pdl_ok_tmp Vbx_sfty_cru_forc_on Vbx_sfty_cru_on Vbx_sfty_cru_resu_acel_decl Vbx_sfty_cru_stt_act Vbx_sfty_cru_tq_req_plau Vbx_sfty_cru_tq_req_plau_tmp_1 Vbx_sfty_cru_tq_req_plau_tmp_2 Vxx_sfty_cru_brk_t_1 Vxx_sfty_cru_brk_t_2 Vxx_sfty_cru_brk_t_long /end OUT_MEASUREMENT
/end FUNCTION
/begin FUNCTION TqSafTdm_Canmonx ""
 /begin DEF_CHARACTERISTIC Cxx_sfty_asr_tqe_sp_msr_raw Cxx_sfty_mux_agb_tqe_nok_raw Cxx_sfty_mux_asr_tqe_nok_raw /end DEF_CHARACTERISTIC
 /begin OUT_MEASUREMENT Vbx_sfty_agb_tq_req Vbx_sfty_agb_tq_req_plau Vbx_sfty_msr_tq_req Vbx_sfty_msr_tq_req_plau /end OUT_MEASUREMENT
/end FUNCTION
/begin FUNCTION TqSafTdm_Acelpdl ""
 /begin DEF_CHARACTERISTIC Ctb_sfty_acel_pdl_fmt Ctp_sfty_acel_pdl_fmt_1 Ctp_sfty_acel_pdl_fmt_2 Cxx_sfty_acel_pdl_fmt_rvr_fac Cxx_sfty_lih_off_t /end DEF_CHARACTERISTIC
 /begin OUT_MEASUREMENT Vxx_sfty_acel_pdl_pwt_sp Vxx_sfty_driv_pwt_sp /end OUT_MEASUREMENT
/end FUNCTION
/begin FUNCTION TqSafTdm_Tqitgtx ""
 /begin DEF_CHARACTERISTIC Ctb_sfty_ajs_n Ctb_sfty_driv_tqe_map_n Ctb_sfty_driv_tqe_map_pwt_sp Ctb_sfty_min_driv_tqe_pwt_sp Ctb_sfty_min_tqe_n Cmp_sfty_driv_tqe_map Ctp_sfty_driv_tq_fil_acel Ctp_sfty_driv_tq_fil_decl Ctp_sfty_min_driv_tqe_map Ctp_sfty_min_tqe_agb_fac Cxx_sfty_agb_max_tqe_cor Cxx_sfty_is_n_t Cxx_sfty_is_n_thd Cxx_sfty_is_tqe_sp_max Cxx_sfty_max_is_n_sp Cxx_sfty_max_l_eng_tq Cxx_sfty_tkof_end_vs_thd Cxx_sfty_tkof_n_thd Cxx_sfty_tkof_pwt_sp_thd Cxx_sfty_tkof_tqe_cor /end DEF_CHARACTERISTIC
 /begin OUT_MEASUREMENT Vbx_ajs_cut_mon Vxx_sfty_ajs_modu_tqe Vxx_sfty_arb_tqe Vxx_sfty_driv_tqe_sp Vxx_sfty_lim_driv_tqe Vxx_sfty_min_avl_tqe Vxx_sfty_n_min_tqe_agb_fac Vxx_sfty_tqi_sp /end OUT_MEASUREMENT
/end FUNCTION
/begin FUNCTION TqSafTdm_Lossxxx ""
 /begin DEF_CHARACTERISTIC Ctb_sfty_frn_tql_temp Ctb_sfty_map Ctb_sfty_n Cmp_sfty_frn_tql Cmp_sfty_pump_tql Cbx_sfty_is_ad_eng_tql_cmf Cbx_sfty_tql_temp_cfm Cxx_sfty_ac_pow_thd Cxx_sfty_alt_pow_thd Cxx_sfty_max_is_ad_tq Cxx_sfty_min_is_ad_tq Cxx_sfty_pump_tql_thd Cxx_sfty_pwst_off_is_cor_dly Cxx_sfty_pwst_prs_tql /end DEF_CHARACTERISTIC
 /begin OUT_MEASUREMENT Vxx_sfty_aux_tql_sp Vxx_sfty_eng_tql Vxx_sfty_frn_tql Vxx_sfty_frn_tql_temp Vxx_sfty_toil /end OUT_MEASUREMENT
/end FUNCTION
/begin FUNCTION TqSafTdm_Intcoxx "" /begin DEF_CHARACTERISTIC Ctb_sfty_sens_tco_v Ctp_sfty_sens_tco Cxx_sfty_tco_inc /end DEF_CHARACTERISTIC /begin OUT_MEASUREMENT Vxx_sfty_raw_sens_tco Vxx_sfty_tco /end OUT_MEASUREMENT /end FUNCTION
/begin FUNCTION TqSafTdm_Inspexx "" /begin OUT_MEASUREMENT Vxx_sfty_n /end OUT_MEASUREMENT /end FUNCTION
/begin FUNCTION TqSafTdm_Incanxx "" /begin OUT_MEASUREMENT Vxx_sfty_mux_agb_tqe_sp Vxx_sfty_mux_msr_tqe_sp /end OUT_MEASUREMENT /end FUNCTION
/begin FUNCTION TqSafTdm_Incanrs "" /begin OUT_MEASUREMENT Vbx_sfty_mux_dyn_mod_req Vxx_sfty_mux_rs_dspl_spt_fac /end OUT_MEASUREMENT /end FUNCTION
/begin FUNCTION TqSafTdm_Dynfmxx ""
 /begin DEF_CHARACTERISTIC Ctb_sfty_acel_pdl_fmt_fac_vs Ctb_sfty_acel_fmt_tkof_fac_vs Ctb_sfty_acel_tkof_fac_driv Ntb_sfty_rs_dspl_pdl_spt_fac Cmp_sfty_acel_fmt_rs_dspl_fac Cmp_sfty_acel_pdl_fmt_fac Ctp_sfty_acel_pdl_fmt_fac Ctp_sfty_acel_pdl_fmt_spt_fac Cxx_sfty_pdl_fmt_slop_down Cxx_sfty_pdl_fmt_slop_up Cxx_sfty_rs_dspl_pdl_act_dly Cxx_sfty_tkof_cdn_vs_max Cxx_sfty_tkof_stop_vs /end DEF_CHARACTERISTIC
 /begin OUT_MEASUREMENT Vxx_sfty_acel_pdl_fmt_fac Vxx_sfty_acel_pdl_fmt_nom_fac Vxx_sfty_acel_pdl_fmt_spt_fac Vxx_sfty_rs_dspl_pdl_fac_cfm Vxx_sfty_rs_dspl_pdl_spt_fac /end OUT_MEASUREMENT
/end FUNCTION
/begin FUNCTION TqSafTrm "" /begin SUB_FUNCTION TqSafTrm_Estixxx /end SUB_FUNCTION /end FUNCTION
/begin FUNCTION TqSafTrm_Estixxx "" /begin DEF_CHARACTERISTIC Cmp_sfty_map_n_esti_tqi /end DEF_CHARACTERISTIC /begin OUT_MEASUREMENT Vxx_sfty_esti_tqi /end OUT_MEASUREMENT /end FUNCTION
/begin FUNCTION TqSafTsm "" /begin SUB_FUNCTION TqSafTsm_Lihmonx TqSafTsm_TqCtrxx TqSafTsm_TqMonxx /end SUB_FUNCTION /end FUNCTION
/begin FUNCTION TqSafTsm_Lihmonx ""
 /begin DEF_CHARACTERISTIC Ctb_sfty_thr_lih_n Ctp_sfty_thr_lih_map Cxx_sfty_map_thd Cxx_sfty_thr_lih_mon_ini_dly /end DEF_CHARACTERISTIC
 /begin OUT_MEASUREMENT Vbx_sfty_thr_lih_mon_nok /end OUT_MEASUREMENT
/end FUNCTION
/begin FUNCTION TqSafTsm_TqCtrxx ""
 /begin DEF_CHARACTERISTIC Cxx_sfty_esti_tqi_deb_thd_ofs Cxx_sfty_esti_tqi_pos_err_ofs Cxx_sfty_tqi_req_pos_err_ofs Cxx_sfty_tqi_sp_deb_thd_ofs /end DEF_CHARACTERISTIC
 /begin OUT_MEASUREMENT Vxx_sfty_esti_tqi_ctr Vxx_sfty_tqi_sp_ctr Vbx_sfty_esti_tqi_ctr_inc_tmp Vbx_sfty_tqi_sp_ctr_inc_tmp Vxx_sfty_esti_tqi_ctr_inc Vxx_sfty_esti_tqi_ctr_last Vxx_sfty_esti_tqi_deb_thd2 Vxx_sfty_tqi_sp_ctr_inc Vxx_sfty_tqi_sp_ctr_last Vxx_sfty_tqi_sp_deb_thd2 /end OUT_MEASUREMENT
/end FUNCTION
/end MODULE
/end PROJECT
