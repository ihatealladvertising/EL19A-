ASAP2_VERSION 1 41
/begin PROJECT RD8 "_default_ProjectLongIdentifier"
/begin HEADER "_default_HeaderComment" PROJECT_NO RD9 /end HEADER
/begin MODULE _default_ModuleName "_default_ModuleLongIdentifier"
/begin MOD_COMMON "_default_ModCommonComment" DEPOSIT ABSOLUTE BYTE_ORDER MSB_LAST ALIGNMENT_BYTE 1 ALIGNMENT_WORD 2 ALIGNMENT_LONG 2 ALIGNMENT_FLOAT32_IEEE 2 ALIGNMENT_FLOAT64_IEEE 4 /end MOD_COMMON
/begin AXIS_PTS Ctb_eal "16 breakpoint table for Engine air load" 0xa002b7f4 Vxx_eal _REC_A2AXS_20_u2 3.99993896484375 _CNV_A_R_LINEAR_____53_CM 16 0. 3.99993896484375 FORMAT "%10.8" /end AXIS_PTS
/begin AXIS_PTS Ctb_sta_tco "Coolant temperature breakpoints for starting set point tables" 0xa002d498 Vxx_tco _REC_A2AXS_20_u2 240. _CNV_A_R_LINEAR_____110_CM 8 -40. 200. FORMAT "%5.1" /end AXIS_PTS
/begin AXIS_PTS Ctb_tco "16 engine coolant temperature breakpoints" 0xa002d4ac Vxx_tco _REC_A2AXS_20_u2 240. _CNV_A_R_LINEAR_____110_CM 16 -40. 200. FORMAT "%5.1" /end AXIS_PTS
/begin AXIS_PTS Ctb_tco2 "Engine coolant temperature breakpoints" 0xa002d4d0 Vxx_tco _REC_A2AXS_20_u2 240. _CNV_A_R_LINEAR_____110_CM 9 -40. 200. FORMAT "%5.1" /end AXIS_PTS
/begin AXIS_PTS Ctb_ajs_aux_tql "Breakpoints calibration for torque losses due to accessories, for Anti-Jerk Strategy" 0xa0030be4 Vxx_ajs_aux_tql _REC_A2AXS_20_u2 2047.96875 _CNV_A_R_LINEAR_____181_CM 8 0. 2047.96875 FORMAT "%10.5" /end AXIS_PTS
/begin AXIS_PTS Ctb_ajs_driv_tq_drv "Breakpoint calibration of derivated driver torque" 0xa0030bf8 Vxx_ajs_driv_tq_drv _REC_A2AXS_20_u2 10000. _CNV_A_R_LINEAR_____312_CM 7 -5000. 5000. FORMAT "%8.2" /end AXIS_PTS
/begin AXIS_PTS Ctb_ajs_gear_rat "Breakpoint calibration of \"vehicle_speed / rotary_engine_speed\" ratio" 0xa0030c08 Vxx_ajs_gear_rat_n _REC_A2AXS_20_u2 210. _CNV_A_R_LINEAR_____313_CM 8 -10. 200. FORMAT "%6.2" /end AXIS_PTS
/begin AXIS_PTS Ctb_ajs_slk_n "Breakpoint calibration of engine speed for slack effect strategy." 0xa0030c1c Vxx_n_mv _REC_A2AXS_20_u2 16383.75 _CNV_A_R_ENSD_LINEA_22_CM 12 0. 16383.75 FORMAT "%8.2" /end AXIS_PTS
/begin AXIS_PTS Ctb_ajs_slk_tco "Breakpoint table of engine coolant temperature for slack effect strategy." 0xa0030c38 Vxx_tco _REC_A2AXS_20_u2 240. _CNV_A_R_LINEAR_____110_CM 6 -40. 200. FORMAT "%5.1" /end AXIS_PTS
/begin AXIS_PTS Ctb_ajs_slk_tq_fac "Breakpoint calibration of normalized driver torque factor for slack effect strategy." 0xa0021c44 Vxx_ajs_spv_driv_tq_fac _REC_A2AXS_20_u1 1. _CNV_A_R_LINEAR_____123_CM 7 0. 1. FORMAT "%4.2" /end AXIS_PTS
/begin AXIS_PTS Ctb_ajs_spv_drag_tq_fac "Breakpoint calibration of normalized driver torque factor for drag error correction." 0xa0021c4c Vxx_ajs_spv_driv_tq_fac _REC_A2AXS_20_u1 1. _CNV_A_R_LINEAR_____123_CM 7 0. 1. FORMAT "%4.2" /end AXIS_PTS
/begin AXIS_PTS Ctb_ajs_spv_n "Breakpoint calibration of engine speed in AJSPV function" 0xa0030c48 Vxx_n_mv _REC_A2AXS_20_u2 16383.75 _CNV_A_R_ENSD_LINEA_22_CM 7 0. 16383.75 FORMAT "%8.2" /end AXIS_PTS
/begin AXIS_PTS Ctb_ajs_spv_n_drv "Breakpoint table of derivative engine speed." 0xa0030c58 Vxx_ajs_n_drv_raw _REC_A2AXS_20_u2 16383.75 _CNV_A_R_LINEAR_____314_CM 7 -8192. 8191.75 FORMAT "%8.2" /end AXIS_PTS
/begin AXIS_PTS Ctb_ajs_spv_tq_fac "Breakpoint calibration of normalized driver torque factor" 0xa0021c54 Vxx_ajs_spv_driv_tq_fac _REC_A2AXS_20_u1 1. _CNV_A_R_LINEAR_____123_CM 7 0. 1. FORMAT "%4.2" /end AXIS_PTS
/begin CHARACTERISTIC Cmp_ajs_slk_tqe_acel_gear_n "Torque threshold to activate the slack effect for vehicle acceleleration, considering gear ratio and engine speed." MAP 0xa0030c68 _REC_A1MAP_20_u2_u2_u2 2047.96875 _CNV_A_R_LINEAR_____216_CM -400. 1647.96875 FORMAT "%11.5"
 /begin AXIS_DESCR COM_AXIS Vxx_ajs_dt_tq_rat _CNV_A_R_LINEAR_____313_CM 12 -10. 200. FORMAT "%6.2" AXIS_PTS_REF Ctb_ajs_dt_tq_rat /end AXIS_DESCR
 /begin AXIS_DESCR COM_AXIS Vxx_n_mv _CNV_A_R_ENSD_LINEA_22_CM 12 0. 16383.75 FORMAT "%8.2" AXIS_PTS_REF Ctb_ajs_slk_n /end AXIS_DESCR
/end CHARACTERISTIC
/begin CHARACTERISTIC Cmp_ajs_slk_tqe_acel_gear_tq "Torque threshold to activate the slack effect for vehicle acceleration, considering gear ratio and driver torque factor." MAP 0xa0030d88 _REC_A1MAP_20_u2_u2_u1 2047.96875 _CNV_A_R_LINEAR_____216_CM -400. 1647.96875 FORMAT "%11.5"
 /begin AXIS_DESCR COM_AXIS Vxx_ajs_dt_tq_rat _CNV_A_R_LINEAR_____313_CM 12 -10. 200. FORMAT "%6.2" AXIS_PTS_REF Ctb_ajs_dt_tq_rat /end AXIS_DESCR
 /begin AXIS_DESCR COM_AXIS Vxx_ajs_spv_driv_tq_fac _CNV_A_R_LINEAR_____123_CM 7 0. 1. FORMAT "%4.2" AXIS_PTS_REF Ctb_ajs_slk_tq_fac /end AXIS_DESCR
/end CHARACTERISTIC
/begin CHARACTERISTIC Cmp_ajs_slk_tqe_acel_gear_tql "Torque threshold to activate the slack effect for vehicle acceleration, considering gear ratio and auxiliary torque losses." MAP 0xa0030e30 _REC_A1MAP_20_u2_u2_u2 2047.96875 _CNV_A_R_LINEAR_____216_CM -400. 1647.96875 FORMAT "%11.5"
 /begin AXIS_DESCR COM_AXIS Vxx_ajs_dt_tq_rat _CNV_A_R_LINEAR_____313_CM 12 -10. 200. FORMAT "%6.2" AXIS_PTS_REF Ctb_ajs_dt_tq_rat /end AXIS_DESCR
 /begin AXIS_DESCR COM_AXIS Vxx_ajs_aux_tql _CNV_A_R_LINEAR_____181_CM 8 0. 2047.96875 FORMAT "%10.5" AXIS_PTS_REF Ctb_ajs_aux_tql /end AXIS_DESCR
/end CHARACTERISTIC
/begin CHARACTERISTIC Cmp_ajs_slk_tqe_acel_n_tco "Torque threshold to activate the slack effect for vehicle acceleration, considering engine speed and coolant temperature." MAP 0xa0030ef0 _REC_A1MAP_20_u2_u2_u2 2047.96875 _CNV_A_R_LINEAR_____216_CM -400. 1647.96875 FORMAT "%11.5"
 /begin AXIS_DESCR COM_AXIS Vxx_n_mv _CNV_A_R_ENSD_LINEA_22_CM 12 0. 16383.75 FORMAT "%8.2" AXIS_PTS_REF Ctb_ajs_slk_n /end AXIS_DESCR
 /begin AXIS_DESCR COM_AXIS Vxx_tco _CNV_A_R_LINEAR_____110_CM 6 -40. 200. FORMAT "%5.1" AXIS_PTS_REF Ctb_ajs_slk_tco /end AXIS_DESCR
/end CHARACTERISTIC
/begin CHARACTERISTIC Cmp_ajs_slk_tqe_acel_n_tql "Torque threshold to activate the slack effect for vehicle acceleration, considering engine speed and auxiliary torque losses." MAP 0xa0030f80 _REC_A1MAP_20_u2_u2_u2 2047.96875 _CNV_A_R_LINEAR_____216_CM -400. 1647.96875 FORMAT "%11.5"
 /begin AXIS_DESCR COM_AXIS Vxx_n_mv _CNV_A_R_ENSD_LINEA_22_CM 12 0. 16383.75 FORMAT "%8.2" AXIS_PTS_REF Ctb_ajs_slk_n /end AXIS_DESCR
 /begin AXIS_DESCR COM_AXIS Vxx_ajs_aux_tql _CNV_A_R_LINEAR_____181_CM 8 0. 2047.96875 FORMAT "%10.5" AXIS_PTS_REF Ctb_ajs_aux_tql /end AXIS_DESCR
/end CHARACTERISTIC
/begin CHARACTERISTIC Cmp_ajs_slk_tqe_decl_gear_n "Torque threshold to activate the slack effect for vehicle deceleration, considering gear ratio and engine speed." MAP 0xa0031040 _REC_A1MAP_20_u2_u2_u2 2047.96875 _CNV_A_R_LINEAR_____216_CM -400. 1647.96875 FORMAT "%11.5"
 /begin AXIS_DESCR COM_AXIS Vxx_ajs_dt_tq_rat _CNV_A_R_LINEAR_____313_CM 12 -10. 200. FORMAT "%6.2" AXIS_PTS_REF Ctb_ajs_dt_tq_rat /end AXIS_DESCR
 /begin AXIS_DESCR COM_AXIS Vxx_n_mv _CNV_A_R_ENSD_LINEA_22_CM 12 0. 16383.75 FORMAT "%8.2" AXIS_PTS_REF Ctb_ajs_slk_n /end AXIS_DESCR
/end CHARACTERISTIC
/begin CHARACTERISTIC Cmp_ajs_slk_tqe_decl_gear_tq "Torque threshold to activate the slack effect for vehicle deceleration, considering gear ratio and driver torque factor." MAP 0xa0031160 _REC_A1MAP_20_u2_u2_u1 2047.96875 _CNV_A_R_LINEAR_____216_CM -400. 1647.96875 FORMAT "%11.5"
 /begin AXIS_DESCR COM_AXIS Vxx_ajs_dt_tq_rat _CNV_A_R_LINEAR_____313_CM 12 -10. 200. FORMAT "%6.2" AXIS_PTS_REF Ctb_ajs_dt_tq_rat /end AXIS_DESCR
 /begin AXIS_DESCR COM_AXIS Vxx_ajs_spv_driv_tq_fac _CNV_A_R_LINEAR_____123_CM 7 0. 1. FORMAT "%4.2" AXIS_PTS_REF Ctb_ajs_slk_tq_fac /end AXIS_DESCR
/end CHARACTERISTIC
/begin CHARACTERISTIC Cmp_ajs_slk_tqe_decl_gear_tql "Torque threshold to activate the slack effect for vehicle deceleration, considering gear ratio and auxiliary torque losses." MAP 0xa0031208 _REC_A1MAP_20_u2_u2_u2 2047.96875 _CNV_A_R_LINEAR_____216_CM -400. 1647.96875 FORMAT "%11.5"
 /begin AXIS_DESCR COM_AXIS Vxx_ajs_dt_tq_rat _CNV_A_R_LINEAR_____313_CM 12 -10. 200. FORMAT "%6.2" AXIS_PTS_REF Ctb_ajs_dt_tq_rat /end AXIS_DESCR
 /begin AXIS_DESCR COM_AXIS Vxx_ajs_aux_tql _CNV_A_R_LINEAR_____181_CM 8 0. 2047.96875 FORMAT "%10.5" AXIS_PTS_REF Ctb_ajs_aux_tql /end AXIS_DESCR
/end CHARACTERISTIC
/begin CHARACTERISTIC Cmp_ajs_slk_tqe_decl_n_tco "Torque threshold to activate the slack effect for vehicle deceleration, considering engine speed and coolant temperature." MAP 0xa00312c8 _REC_A1MAP_20_u2_u2_u2 2047.96875 _CNV_A_R_LINEAR_____216_CM -400. 1647.96875 FORMAT "%11.5"
 /begin AXIS_DESCR COM_AXIS Vxx_n_mv _CNV_A_R_ENSD_LINEA_22_CM 12 0. 16383.75 FORMAT "%8.2" AXIS_PTS_REF Ctb_ajs_slk_n /end AXIS_DESCR
 /begin AXIS_DESCR COM_AXIS Vxx_tco _CNV_A_R_LINEAR_____110_CM 6 -40. 200. FORMAT "%5.1" AXIS_PTS_REF Ctb_ajs_slk_tco /end AXIS_DESCR
/end CHARACTERISTIC
/begin CHARACTERISTIC Cmp_ajs_slk_tqe_decl_n_tql "Torque threshold to activate the slack effect for vehicle deceleration, considering engine speed and auxiliary torque losses." MAP 0xa0031358 _REC_A1MAP_20_u2_u2_u2 2047.96875 _CNV_A_R_LINEAR_____216_CM -400. 1647.96875 FORMAT "%11.5"
 /begin AXIS_DESCR COM_AXIS Vxx_n_mv _CNV_A_R_ENSD_LINEA_22_CM 12 0. 16383.75 FORMAT "%8.2" AXIS_PTS_REF Ctb_ajs_slk_n /end AXIS_DESCR
 /begin AXIS_DESCR COM_AXIS Vxx_ajs_aux_tql _CNV_A_R_LINEAR_____181_CM 8 0. 2047.96875 FORMAT "%10.5" AXIS_PTS_REF Ctb_ajs_aux_tql /end AXIS_DESCR
/end CHARACTERISTIC
/begin CHARACTERISTIC Cmp_ajs_slk_tqe_off_acel "Torque high threshold to deactivate the slack effect for vehicle acceleration" MAP 0xa0031418 _REC_A1MAP_20_u2_u2_u2 2047.96875 _CNV_A_R_LINEAR_____216_CM -400. 1647.96875 FORMAT "%11.5"
 /begin AXIS_DESCR COM_AXIS Vxx_ajs_dt_tq_rat _CNV_A_R_LINEAR_____313_CM 12 -10. 200. FORMAT "%6.2" AXIS_PTS_REF Ctb_ajs_dt_tq_rat /end AXIS_DESCR
 /begin AXIS_DESCR COM_AXIS Vxx_ajs_aux_tql _CNV_A_R_LINEAR_____181_CM 8 0. 2047.96875 FORMAT "%10.5" AXIS_PTS_REF Ctb_ajs_aux_tql /end AXIS_DESCR
/end CHARACTERISTIC
/begin CHARACTERISTIC Cmp_ajs_slk_tqe_off_decl "Torque high threshold to deactivate the slack effect for vehicle deceleration" MAP 0xa00314d8 _REC_A1MAP_20_u2_u2_u2 2047.96875 _CNV_A_R_LINEAR_____216_CM -400. 1647.96875 FORMAT "%11.5"
 /begin AXIS_DESCR COM_AXIS Vxx_ajs_dt_tq_rat _CNV_A_R_LINEAR_____313_CM 12 -10. 200. FORMAT "%6.2" AXIS_PTS_REF Ctb_ajs_dt_tq_rat /end AXIS_DESCR
 /begin AXIS_DESCR COM_AXIS Vxx_ajs_aux_tql _CNV_A_R_LINEAR_____181_CM 8 0. 2047.96875 FORMAT "%10.5" AXIS_PTS_REF Ctb_ajs_aux_tql /end AXIS_DESCR
/end CHARACTERISTIC
/begin CHARACTERISTIC Cmp_ajs_spd_diff_thd_on_acel "Speed difference low threshold to deactivate the slack effect for vehicle acceleration" MAP 0xa0031598 _REC_A1MAP_20_u2_u2_u1 16383.75 _CNV_A_R_LINEAR_____182_CM -8192. 8191.75 FORMAT "%8.2"
 /begin AXIS_DESCR COM_AXIS Vxx_ajs_dt_tq_rat _CNV_A_R_LINEAR_____313_CM 12 -10. 200. FORMAT "%6.2" AXIS_PTS_REF Ctb_ajs_dt_tq_rat /end AXIS_DESCR
 /begin AXIS_DESCR COM_AXIS Vxx_ajs_spv_driv_tq_fac _CNV_A_R_LINEAR_____123_CM 7 0. 1. FORMAT "%4.2" AXIS_PTS_REF Ctb_ajs_slk_tq_fac /end AXIS_DESCR
/end CHARACTERISTIC
/begin CHARACTERISTIC Cmp_ajs_spv_fast_cor_dly "Cartography to select the maximum time for the application of the boost of the curative anti-jerk function." MAP 0xa0031640 _REC_A1MAP_20_u2_u2_u1 655.35 _CNV_A_R_LINEAR_____32_CM 0. 655.35 FORMAT "%6.2"
 /begin AXIS_DESCR COM_AXIS Vxx_n_mv _CNV_A_R_ENSD_LINEA_22_CM 7 0. 16383.75 FORMAT "%8.2" AXIS_PTS_REF Ctb_ajs_spv_n /end AXIS_DESCR
 /begin AXIS_DESCR COM_AXIS Vxx_ajs_spv_driv_tq_fac _CNV_A_R_LINEAR_____123_CM 7 0. 1. FORMAT "%4.2" AXIS_PTS_REF Ctb_ajs_spv_tq_fac /end AXIS_DESCR
/end CHARACTERISTIC
/begin CHARACTERISTIC Ctp_ajs_coup_grip_rat "Cartography that converts transmission coupler state into coupler torque grip ratio" CURVE 0xa0021c5c _REC_A1CUR_20_u1_u1 1. _CNV_A_R_LINEAR_____297_CM 0. 1. FORMAT "%3.1"
 /begin AXIS_DESCR COM_AXIS Vxx_ant_coup _CNV_A_R_ECME_LINEA_0_CM 3 0. 255. FORMAT "%3.0" AXIS_PTS_REF Ctb_coup /end AXIS_DESCR
/end CHARACTERISTIC
/begin CHARACTERISTIC Ctp_ajs_drag_acel_tq_diff_thd "Torque threshold to activate the drag error correction during acceleration." CURVE 0xa00316a4 _REC_A1CUR_20_u2_u1 2047.96875 _CNV_A_R_LINEAR_____216_CM -400. 1647.96875 FORMAT "%11.5"
 /begin AXIS_DESCR COM_AXIS Vxx_ajs_spv_driv_tq_fac _CNV_A_R_LINEAR_____123_CM 7 0. 1. FORMAT "%4.2" AXIS_PTS_REF Ctb_ajs_spv_drag_tq_fac /end AXIS_DESCR
/end CHARACTERISTIC
/begin CHARACTERISTIC Ctp_ajs_drag_decl_tq_diff_thd "Torque threshold to activate the drag error correction during deceleration." CURVE 0xa00316b4 _REC_A1CUR_20_u2_u1 2047.96875 _CNV_A_R_LINEAR_____216_CM -400. 1647.96875 FORMAT "%11.5"
 /begin AXIS_DESCR COM_AXIS Vxx_ajs_spv_driv_tq_fac _CNV_A_R_LINEAR_____123_CM 7 0. 1. FORMAT "%4.2" AXIS_PTS_REF Ctb_ajs_spv_drag_tq_fac /end AXIS_DESCR
/end CHARACTERISTIC
/begin CHARACTERISTIC Ctp_ajs_etc_coup_clos "Cartography that converts V/N ratio, when etc coupler is closed." CURVE 0xa00316c4 _REC_A1CUR_20_u2_u2 210. _CNV_A_R_LINEAR_____313_CM -10. 200. FORMAT "%6.2"
 /begin AXIS_DESCR COM_AXIS Vxx_ajs_gear_rat_n _CNV_A_R_LINEAR_____313_CM 8 -10. 200. FORMAT "%6.2" AXIS_PTS_REF Ctb_ajs_gear_rat /end AXIS_DESCR
/end CHARACTERISTIC
/begin CHARACTERISTIC Ctp_ajs_etc_coup_sli "Cartography that converts V/N ratio, when etc coupler is sliding." CURVE 0xa00316d4 _REC_A1CUR_20_u2_u2 210. _CNV_A_R_LINEAR_____313_CM -10. 200. FORMAT "%6.2"
 /begin AXIS_DESCR COM_AXIS Vxx_ajs_gear_rat_n _CNV_A_R_LINEAR_____313_CM 8 -10. 200. FORMAT "%6.2" AXIS_PTS_REF Ctb_ajs_gear_rat /end AXIS_DESCR
/end CHARACTERISTIC
/begin CHARACTERISTIC Ctp_ajs_gear_rat "Cartography that converts gear into vehicle_speed/rotary_engine_speed ratio for manual transmissions" CURVE 0xa00316e4 _REC_A1CUR_20_u2_u1 210. _CNV_A_R_LINEAR_____313_CM -10. 200. FORMAT "%6.2"
 /begin AXIS_DESCR COM_AXIS Vxx_gear _CNV_A_R_LINEAR_____145_CM 8 -1. 6. READ_ONLY FORMAT "%2.0" AXIS_PTS_REF Ntb_gear /end AXIS_DESCR
/end CHARACTERISTIC
/begin CHARACTERISTIC Ctp_ajs_spd_diff_thd_on_decl "Speed difference low threshold to deactivate the slack effect for vehicle deceleration" CURVE 0xa00316f4 _REC_A1CUR_20_u2_u2 16383.75 _CNV_A_R_LINEAR_____182_CM -8192. 8191.75 FORMAT "%8.2"
 /begin AXIS_DESCR COM_AXIS Vxx_ajs_dt_tq_rat _CNV_A_R_LINEAR_____313_CM 12 -10. 200. FORMAT "%6.2" AXIS_PTS_REF Ctb_ajs_dt_tq_rat /end AXIS_DESCR
/end CHARACTERISTIC
/begin CHARACTERISTIC Ctp_ajs_spv_driv_tq_drv "Cartography that converts the derivated driver torque into unit ratio [-1 ; 1]" CURVE 0xa0021c60 _REC_A1CUR_20_u1_u2 2. _CNV_A_R_LINEAR_____315_CM -1. 1. FORMAT "%4.2"
 /begin AXIS_DESCR COM_AXIS Vxx_ajs_driv_tq_drv _CNV_A_R_LINEAR_____312_CM 7 -5000. 5000. FORMAT "%8.2" AXIS_PTS_REF Ctb_ajs_driv_tq_drv /end AXIS_DESCR
/end CHARACTERISTIC
/begin CHARACTERISTIC Ctp_ajs_spv_fast_cor_dly_fac "Table for the modulation of the maximum time to enable the boost of the curative anti-jerk function." CURVE 0xa003170c _REC_A1CUR_20_u2_u2 100. _CNV_A_R_LINEAR_____123_CM 0. 100.
 /begin AXIS_DESCR COM_AXIS Vxx_ajs_dt_tq_rat _CNV_A_R_LINEAR_____313_CM 12 -10. 200. FORMAT "%6.2" AXIS_PTS_REF Ctb_ajs_dt_tq_rat /end AXIS_DESCR
/end CHARACTERISTIC
/begin CHARACTERISTIC Ctp_ajs_spv_n_drv "Table that converts derivative engine speed into unit ratio [-1 ; 1] ." CURVE 0xa0021c68 _REC_A1CUR_20_u1_u2 2. _CNV_A_R_LINEAR_____315_CM -1. 1. FORMAT "%4.2"
 /begin AXIS_DESCR COM_AXIS Vxx_ajs_n_drv_raw _CNV_A_R_LINEAR_____314_CM 7 -8192. 8191.75 FORMAT "%8.2" AXIS_PTS_REF Ctb_ajs_spv_n_drv /end AXIS_DESCR
/end CHARACTERISTIC
/begin MEASUREMENT Vbx_ajs_acel_decl_stt "Acceleration (1) or deceleration (0) vehicle state" UBYTE _CNV_S_2_RANGE______3_CM 1 0. 0. 1. ECU_ADDRESS 0xd0007069 BIT_MASK 0x1 /end MEASUREMENT
/begin MEASUREMENT Vbx_ajs_cut_cdn_on "Boolean to enable the observation of driver demand condtions to enable the boost of the curative anti-jerk function." UBYTE _CNV_S_2_RANGE______3_CM 1 0. 0. 1. ECU_ADDRESS 0xd000706a BIT_MASK 0x1 /end MEASUREMENT
/begin MEASUREMENT Vbx_ajs_fast_cor_on "Boolean to activate the boost of the curative anti-jerk function." UBYTE _CNV_S_2_RANGE______3_CM 1 0. 0. 1. ECU_ADDRESS 0xd000706b BIT_MASK 0x1 /end MEASUREMENT
/begin MEASUREMENT Vbx_ajs_no_drag "Boolean variable activating the drag error correction" UBYTE _CNV_S_2_RANGE______3_CM 1 0. 0. 1. ECU_ADDRESS 0xd000706c BIT_MASK 0x1 /end MEASUREMENT
/begin MEASUREMENT Vbx_ajs_pdl_cdn_on "Boolean to activate the boost of the curative anti-jerk function based on the driver pedal observation." UBYTE _CNV_S_2_RANGE______3_CM 1 0. 0. 1. ECU_ADDRESS 0xd000706d BIT_MASK 0x1 /end MEASUREMENT
/begin MEASUREMENT Vbx_ajs_slk_aftr_decl_on "Boolean variable to indicate if filtered torque setpoint is after (=1) slack torque threshold, for vehicle deceration." UBYTE _CNV_S_2_RANGE______3_CM 1 0. 0. 1. ECU_ADDRESS 0xd000706e BIT_MASK 0x1 /end MEASUREMENT
/begin MEASUREMENT Vbx_ajs_slk_bfr_acel_on "Boolean variable to indicate if filtered torque setpoint is before (=1) slack torque threshold, for vehicle acceleration." UBYTE _CNV_S_2_RANGE______3_CM 1 0. 0. 1. ECU_ADDRESS 0xd000706f BIT_MASK 0x1 /end MEASUREMENT
/begin MEASUREMENT Vbx_ajs_slk_cdn_on "Boolean variable to enable (=1) slack effect when the conditions are fulfilled." UBYTE _CNV_S_2_RANGE______3_CM 1 0. 0. 1. ECU_ADDRESS 0xd0007070 BIT_MASK 0x1 /end MEASUREMENT
/begin MEASUREMENT Vbx_ajs_slk_decl_off "Boolean variable to detect crossing slack torque low threshold during vehicle deceleration" UBYTE _CNV_S_2_RANGE______3_CM 1 0. 0. 1. ECU_ADDRESS 0xd0007071 BIT_MASK 0x1 /end MEASUREMENT
/begin MEASUREMENT Vbx_ajs_slk_decl_on "Boolean variable to detect crossing slack torque high threshold during vehicle deceleration" UBYTE _CNV_S_2_RANGE______3_CM 1 0. 0. 1. ECU_ADDRESS 0xd0007072 BIT_MASK 0x1 /end MEASUREMENT
/begin MEASUREMENT Vbx_ajs_slk_on "Boolean variable activating the slack effect" UBYTE _CNV_S_2_RANGE______3_CM 1 0. 0. 1. ECU_ADDRESS 0xd0007073 BIT_MASK 0x1 /end MEASUREMENT
/begin MEASUREMENT Vbx_ajs_slk_on_prev "Previous value of the boolean variable activating the slack effect" UBYTE _CNV_S_2_RANGE______3_CM 1 0. 0. 1. ECU_ADDRESS 0xd0007074 BIT_MASK 0x1 /end MEASUREMENT
/begin MEASUREMENT Vbx_ajs_slk_open_on "Boolean variable activating the slack effect with an open driveline" UBYTE _CNV_S_2_RANGE______3_CM 1 0. 0. 1. ECU_ADDRESS 0xd0007075 BIT_MASK 0x1 /end MEASUREMENT
/begin MEASUREMENT Vbx_ajs_slk_tqe_decl_out "Boolean variable detecting the end of the slack effect correction during vehicle deceleration" UBYTE _CNV_S_2_RANGE______3_CM 1 0. 0. 1. ECU_ADDRESS 0xd0007076 BIT_MASK 0x1 /end MEASUREMENT
/begin MEASUREMENT Vbx_ajs_slk_tqe_off "Boolean variable to detect crossing of the slack torque deactivation threshold" UBYTE _CNV_S_2_RANGE______3_CM 1 0. 0. 1. ECU_ADDRESS 0xd0007077 BIT_MASK 0x1 /end MEASUREMENT
/begin MEASUREMENT Vbx_ajs_slk_tqe_on "Boolean variable to detect crossing of the slack torque activation threshold" UBYTE _CNV_S_2_RANGE______3_CM 1 0. 0. 1. ECU_ADDRESS 0xd0007078 BIT_MASK 0x1 /end MEASUREMENT
/begin MEASUREMENT Vbx_ajs_spv_aftr_slk_tqe_on "Boolean variable to indicate if filtered torque setpoint is after (=1) slack torque threshold." UBYTE _CNV_S_2_RANGE______3_CM 1 0. 0. 1. ECU_ADDRESS 0xd0007079 BIT_MASK 0x1 /end MEASUREMENT
/begin MEASUREMENT Vbx_ajs_spv_stt_cut "Preventive and curative anti-jerk functions are deactivated" UBYTE _CNV_S_2_RANGE______3_CM 1 0. 0. 1. ECU_ADDRESS 0xd000707a BIT_MASK 0x1 /end MEASUREMENT
/begin MEASUREMENT Vbx_ajs_tq_cdn_on "Boolean to enable the boost of the curative anti-jerk function based on the driver torque observation." UBYTE _CNV_S_2_RANGE______3_CM 1 0. 0. 1. ECU_ADDRESS 0xd000707b BIT_MASK 0x1 /end MEASUREMENT
/begin MEASUREMENT Vbx_vs_n_rat_fil_on "Filtered value of Vehicle Speed/Neng ratio is used (1) to calculate the gear ratio" UBYTE _CNV_S_2_RANGE______3_CM 1 0. 0. 1. ECU_ADDRESS 0xd000707c BIT_MASK 0x1 /end MEASUREMENT
/begin MEASUREMENT Vsx_ajs_dt_tq_rat_vld "Gear torque ratio : wheel_torque/engine_torque (tuned with gear ratio) validity status" UBYTE _CNV_S_3_STATUS_OK__179_CM 1 0. 0. 2. ECU_ADDRESS 0xd000707d /end MEASUREMENT
/begin MEASUREMENT Vsx_ajs_spv_stt_para "State variable to select anti-jerk parameters" UBYTE _CNV_A_R_ECME_LINEA_0_CM 1 0. 1. 5. ECU_ADDRESS 0xd000707e FORMAT "%1.0" /end MEASUREMENT
/begin MEASUREMENT Vxx_ajs_aux_tql "Torque losses due to accessories, for Anti-Jerk Strategy" UWORD _CNV_A_R_LINEAR_____181_CM 1 0. 0. 2047.96875 ECU_ADDRESS 0xd00047b2 FORMAT "%10.5" /end MEASUREMENT
/begin MEASUREMENT Vxx_ajs_coup_grip_rat "Coupler grip ratio (tuned with coupler state)" UBYTE _CNV_A_R_LINEAR_____297_CM 1 0. 0. 1. ECU_ADDRESS 0xd000707f FORMAT "%3.1" /end MEASUREMENT
/begin MEASUREMENT Vxx_ajs_driv_pwt_sp_grd "Driver powertrain setpoint derivative used in the anti-jerk strategy" UWORD _CNV_A_R_LINEAR_____316_CM 1 0. 0. 100. ECU_ADDRESS 0xd00047b4 FORMAT "%8.3" /end MEASUREMENT
/begin MEASUREMENT Vxx_ajs_driv_tq_drv "Derivative of the driver torque demand" UWORD _CNV_A_R_LINEAR_____312_CM 1 0. -5000. 5000. ECU_ADDRESS 0xd00047b6 FORMAT "%8.2" /end MEASUREMENT
/begin MEASUREMENT Vxx_ajs_dt_grip_rat "Driveline grip ratio (integrates coupler grip ratio and calculated declutch state)" UBYTE _CNV_A_R_LINEAR_____317_CM 1 0. 0. 1. ECU_ADDRESS 0xd0007080 FORMAT "%4.2" /end MEASUREMENT
/begin MEASUREMENT Vxx_ajs_dt_tq_rat "Driveline torque ratio : wheel_torque/engine_torque" UWORD _CNV_A_R_LINEAR_____313_CM 1 0. -10. 200. ECU_ADDRESS 0xd00047b8 FORMAT "%6.2" /end MEASUREMENT
/begin MEASUREMENT Vxx_ajs_gear_rat_n "Gear rotary speed ratio : wheel_speed/engine_speed (tuned with gear state)" UWORD _CNV_A_R_LINEAR_____313_CM 1 0. -10. 200. ECU_ADDRESS 0xd00047ba FORMAT "%6.2" /end MEASUREMENT
/begin MEASUREMENT Vxx_ajs_n_drv "Normed derivative engine speed for AJS," UBYTE _CNV_A_R_LINEAR_____123_CM 1 0. 0. 1. ECU_ADDRESS 0xd0007081 FORMAT "%4.2" /end MEASUREMENT
/begin MEASUREMENT Vxx_ajs_n_drv_raw "Raw derivative engine speed for AJS." UWORD _CNV_A_R_LINEAR_____314_CM 1 0. -8192. 8191.75 ECU_ADDRESS 0xd00047bc FORMAT "%8.2" /end MEASUREMENT
/begin MEASUREMENT Vxx_ajs_slk_tqe_on_acel "Slack activation torque threshold, for vehicle acceleration." UWORD _CNV_A_R_LINEAR_____216_CM 1 0. -400. 1647.96875 ECU_ADDRESS 0xd00047be FORMAT "%11.5" /end MEASUREMENT
/begin MEASUREMENT Vxx_ajs_slk_tqe_on_acel_hld "Slack activation torque threshold, held during vehicle acceleration." UWORD _CNV_A_R_LINEAR_____216_CM 1 0. -400. 1647.96875 ECU_ADDRESS 0xd00047c0 FORMAT "%11.5" /end MEASUREMENT
/begin MEASUREMENT Vxx_ajs_slk_tqe_on_decl "Slack activation torque threshold, for vehicle deceleration." UWORD _CNV_A_R_LINEAR_____216_CM 1 0. -400. 1647.96875 ECU_ADDRESS 0xd00047c2 FORMAT "%11.5" /end MEASUREMENT
/begin MEASUREMENT Vxx_ajs_slk_tqe_on_decl_hld "Slack activation torque threshold, held during vehicle deceleration." UWORD _CNV_A_R_LINEAR_____216_CM 1 0. -400. 1647.96875 ECU_ADDRESS 0xd00047c4 FORMAT "%11.5" /end MEASUREMENT
/begin MEASUREMENT Vxx_ajs_slk_tqe_on_hld "Slack activation held torque threshold." UWORD _CNV_A_R_LINEAR_____216_CM 1 0. -400. 1647.96875 ECU_ADDRESS 0xd00047c6 FORMAT "%11.5" /end MEASUREMENT
/begin MEASUREMENT Vxx_ajs_slk_tqe_sp "Effective engine torque selected for the slack effect activation" UWORD _CNV_A_R_LINEAR_____216_CM 1 0. -400. 1647.96875 ECU_ADDRESS 0xd00047c8 FORMAT "%10.5" /end MEASUREMENT
/begin MEASUREMENT Vxx_ajs_spd_diff "Difference between engine speed and primary shaft speed." SWORD _CNV_A_R_ENSD_LINEA_22_CM 1 0. -8192. 8191.75 ECU_ADDRESS 0xd00047ca FORMAT "%6.2" /end MEASUREMENT
/begin MEASUREMENT Vxx_ajs_spv_driv_tq_drv "Formated derivative of driver torque demand" UBYTE _CNV_A_R_LINEAR_____123_CM 1 0. 0. 1. ECU_ADDRESS 0xd0007082 FORMAT "%4.2" /end MEASUREMENT
/begin MEASUREMENT Vxx_ajs_spv_driv_tq_fac "Normalized driver torque factor" UBYTE _CNV_A_R_LINEAR_____123_CM 1 0. 0. 1. ECU_ADDRESS 0xd0007083 FORMAT "%4.2" /end MEASUREMENT
/begin MEASUREMENT Vxx_ajs_spv_driv_tq_rat "Torque ratio between the driver demand and the available torque" SBYTE _CNV_A_R_LINEAR_____318_CM 1 0. -1. 1. ECU_ADDRESS 0xd0007084 FORMAT "%8.5" /end MEASUREMENT
/begin MEASUREMENT Vxx_ajs_spv_fast_cor_dly "Maximum time for the application of the boost of the curative anti-jerk" UWORD _CNV_A_R_LINEAR_____32_CM 1 0. 0. 655.35 ECU_ADDRESS 0xd00047cc FORMAT "%6.2" /end MEASUREMENT
/begin CHARACTERISTIC Cbx_ajs_dt_open_slk_cfm "Boolean calibration to allow (=1) slack effect strategy with an open drivetrain (AJSPV 3 & 4 states)." VALUE 0xa0021c9a _REC_S1VAL_20_u1 1. _CNV_A_R_ECME_LINEA_0_CM 0. 1. FORMAT "%1.0" BIT_MASK 0x1 /end CHARACTERISTIC
/begin CHARACTERISTIC Cbx_ajs_fast_cor_cfm "Boolean calibration to deactivate (=0) the boost of the curative anti-jerk function." VALUE 0xa0021c9b _REC_S1VAL_20_u1 1. _CNV_A_R_ECME_LINEA_0_CM 0. 1. FORMAT "%1.0" BIT_MASK 0x1 /end CHARACTERISTIC
/begin CHARACTERISTIC Cbx_ajs_no_drag_cfm "Boolean calibration to deactivate (=0) the strategy for drag error correction." VALUE 0xa0021c9c _REC_S1VAL_20_u1 1. _CNV_A_R_ECME_LINEA_0_CM 0. 1. FORMAT "%1.0" BIT_MASK 0x1 /end CHARACTERISTIC
/begin CHARACTERISTIC Cbx_ajs_spv_cut_cfm "Boolean calibration to select the tip-in condition in the case of a re-injection (=1) to enable the boost of the curative anti-jerk function." VALUE 0xa0021c9d _REC_S1VAL_20_u1 1. _CNV_A_R_ECME_LINEA_0_CM 0. 1. FORMAT "%1.0" BIT_MASK 0x1 /end CHARACTERISTIC
/begin CHARACTERISTIC Cbx_ajs_spv_grd_cfm "Boolean calibration to select the driver conditions (=1 based on torque observation, = 0 based on pedal observation) to enable the boost of the curative anti-jerk function." VALUE 0xa0021c9e _REC_S1VAL_20_u1 1. _CNV_A_R_ECME_LINEA_0_CM 0. 1. FORMAT "%1.0" BIT_MASK 0x1 /end CHARACTERISTIC
/begin CHARACTERISTIC Cbx_ajs_spv_stt_cfm "Boolean calibration to deactivate (=0) preventive et curative anti-jerk functions" VALUE 0xa0021c9f _REC_S1VAL_20_u1 1. _CNV_A_R_ECME_LINEA_0_CM 0. 1. FORMAT "%1.0" BIT_MASK 0x1 /end CHARACTERISTIC
/begin CHARACTERISTIC Cbx_ajs_tqe_slk_cfm "Boolean calibration to select the torque observed (=1 to select an estimation of the engine torque, =0 the filtered torque setpoint) to activate the slack-effect strategy." VALUE 0xa0021ca0 _REC_S1VAL_20_u1 1. _CNV_A_R_ECME_LINEA_0_CM 0. 1. FORMAT "%1.0" BIT_MASK 0x1 /end CHARACTERISTIC
/begin CHARACTERISTIC Cbx_dt_tq_rat_grip_cfm "Boolean calibration permits to choose the driveline torque ratio calculation" VALUE 0xa0021ca1 _REC_S1VAL_20_u1 1. _CNV_A_R_ECME_LINEA_0_CM 0. 1. FORMAT "%1.0" BIT_MASK 0x1 /end CHARACTERISTIC
/begin CHARACTERISTIC Csx_ajs_spv_tq_rat_drv_acel_cfm "Boolean calibration to choose the driver torque factor calculation, for vehicle acceleration." VALUE 0xa0021ca2 _REC_S1VAL_20_u1 3. _CNV_A_R_ECME_LINEA_0_CM 0. 3. FORMAT "%1.0" /end CHARACTERISTIC
/begin CHARACTERISTIC Csx_ajs_spv_tq_rat_drv_decl_cfm "Boolean calibration to choose the driver torque factor calculation, for vehicle deceleration." VALUE 0xa0021ca3 _REC_S1VAL_20_u1 3. _CNV_A_R_ECME_LINEA_0_CM 0. 3. FORMAT "%1.0" /end CHARACTERISTIC
/begin CHARACTERISTIC Cxx_ajs_acel_tq_thd "Torque variation threshold to consider the engine in acceleration state" VALUE 0xa0021c70 _REC_S1VAL_20_u2 2047.96875 _CNV_A_R_LINEAR_____216_CM -400. 1647.96875 FORMAT "%11.5" /end CHARACTERISTIC
/begin CHARACTERISTIC Cxx_ajs_decl_tq_thd "Torque variation threshold to consider the engine in deceleration state" VALUE 0xa0021c72 _REC_S1VAL_20_u2 2047.96875 _CNV_A_R_LINEAR_____216_CM -400. 1647.96875 FORMAT "%11.5" /end CHARACTERISTIC
/begin CHARACTERISTIC Cxx_ajs_drag_pwt_sp_thd "Threshold for powertrain setpoint to enable the drag error correction." VALUE 0xa0021c74 _REC_S1VAL_20_u2 1. _CNV_A_R_LINEAR_____319_CM 0. 1. FORMAT "%8.5" /end CHARACTERISTIC
/begin CHARACTERISTIC Cxx_ajs_drag_tq_drv_hys "Hysteresis for driver torque derivative threshold to disable the drag error correction." VALUE 0xa0021ca4 _REC_S1VAL_20_u1 1. _CNV_A_R_LINEAR_____123_CM 0. 1. FORMAT "%4.2" /end CHARACTERISTIC
/begin CHARACTERISTIC Cxx_ajs_drag_tq_drv_thd "Threshold for driver torque derivative to disable the drag error correction." VALUE 0xa0021ca5 _REC_S1VAL_20_u1 1. _CNV_A_R_LINEAR_____123_CM 0. 1. FORMAT "%4.2" /end CHARACTERISTIC
/begin CHARACTERISTIC Cxx_ajs_driv_pwt_sp_fil "Filter time constant for filtering of the driver powertrain setpoint derivate" VALUE 0xa0021c76 _REC_S1VAL_20_u2 65.535 _CNV_A_R_LINEAR_____116_CM 0. 65.535 /end CHARACTERISTIC
/begin CHARACTERISTIC Cxx_ajs_driv_pwt_sp_grd_hys "Driver powertrain setpoint derivative hysteresis used in antijerk strategy" VALUE 0xa0021c78 _REC_S1VAL_20_u2 100. _CNV_A_R_LINEAR_____316_CM 0. 100. FORMAT "%8.3" /end CHARACTERISTIC
/begin CHARACTERISTIC Cxx_ajs_driv_pwt_sp_grd_thd "Threshold for powertrain setpoint derivative to enable the boost of the curative anti-jerk function." VALUE 0xa0021c7a _REC_S1VAL_20_u2 100. _CNV_A_R_LINEAR_____316_CM 0. 100. FORMAT "%8.3" /end CHARACTERISTIC
/begin CHARACTERISTIC Cxx_ajs_driv_pwt_sp_thd "Threshold for powertrain setpoint to enable the boost of the curative anti-jerk function." VALUE 0xa0021c7c _REC_S1VAL_20_u2 1. _CNV_A_R_LINEAR_____319_CM 0. 1. FORMAT "%8.5" /end CHARACTERISTIC
/begin CHARACTERISTIC Cxx_ajs_dt_grip_rat_clos "Value of coupler torque grip ratio to consider the driveline closed" VALUE 0xa0021ca6 _REC_S1VAL_20_u1 1. _CNV_A_R_LINEAR_____317_CM 0. 1. FORMAT "%4.2" /end CHARACTERISTIC
/begin CHARACTERISTIC Cxx_ajs_dt_grip_rat_open "Value of coupler torque grip ratio to consider the driveline open" VALUE 0xa0021ca7 _REC_S1VAL_20_u1 1. _CNV_A_R_LINEAR_____317_CM 0. 1. FORMAT "%4.2" /end CHARACTERISTIC
/begin CHARACTERISTIC Cxx_ajs_slk_drv_tq_thd_off "Normalized driver torque factor high threshold to deactivate the slack effect" VALUE 0xa0021ca8 _REC_S1VAL_20_u1 1. _CNV_A_R_LINEAR_____123_CM 0. 1. FORMAT "%4.2" /end CHARACTERISTIC
/begin CHARACTERISTIC Cxx_ajs_slk_drv_tq_thd_on "Normalized driver torque factor low threshold to deactivate the slack effect" VALUE 0xa0021ca9 _REC_S1VAL_20_u1 1. _CNV_A_R_LINEAR_____123_CM 0. 1. FORMAT "%4.2" /end CHARACTERISTIC
/begin CHARACTERISTIC Cxx_ajs_spd_diff_thd_off_acel "Speed difference high threshold to deactivate the slack effect for vehicle acceleration" VALUE 0xa0021c7e _REC_S1VAL_20_s2 16383.75 _CNV_A_R_ENSD_LINEA_22_CM -8192. 8191.75 FORMAT "%6.2" /end CHARACTERISTIC
/begin CHARACTERISTIC Cxx_ajs_spd_diff_thd_off_decl "Speed difference high threshold to deactivate the slack effect for vehicle deceleration" VALUE 0xa0021c80 _REC_S1VAL_20_s2 16383.75 _CNV_A_R_ENSD_LINEA_22_CM -8192. 8191.75 FORMAT "%6.2" /end CHARACTERISTIC
/begin CHARACTERISTIC Cxx_ajs_spv_driv_tq_t1_fil "Filter time constant for calculation of the driver torque factor" VALUE 0xa0021c82 _REC_S1VAL_20_u2 65.535 _CNV_A_R_LINEAR_____116_CM 0. 65.535 /end CHARACTERISTIC
/begin CHARACTERISTIC Cxx_ajs_spv_n_drv_t1_fil_acel "Filter time constant of derivative engine speed, for vehicle acceleration." VALUE 0xa0021c84 _REC_S1VAL_20_u2 655.35 _CNV_A_R_LINEAR_____32_CM 0. 655.35 FORMAT "%6.2" /end CHARACTERISTIC
/begin CHARACTERISTIC Cxx_ajs_spv_n_drv_t1_fil_decl "Filter time constant of derivative engine speed, for vehicle deceleration." VALUE 0xa0021c86 _REC_S1VAL_20_u2 655.35 _CNV_A_R_LINEAR_____32_CM 0. 655.35 FORMAT "%6.2" /end CHARACTERISTIC
/begin CHARACTERISTIC Cxx_ajs_spv_n_mv_thd "Engine speed threshold to enable the boost of the curative anti-jerk function." VALUE 0xa0021c88 _REC_S1VAL_20_u2 16383.75 _CNV_A_R_ENSD_LINEA_22_CM 0. 16383.75 FORMAT "%8.2" /end CHARACTERISTIC
/begin CHARACTERISTIC Cxx_ajs_spv_pwt_t1_fil_acel "Filter time constant for filtering of the driver powertrain setpoint for vehicle acceleration" VALUE 0xa0021c8a _REC_S1VAL_20_u2 655.35 _CNV_A_R_LINEAR_____32_CM 0. 655.35 FORMAT "%6.2" /end CHARACTERISTIC
/begin CHARACTERISTIC Cxx_ajs_spv_pwt_t1_fil_decl "Filter time constant for filtering of the driver powertrain setpoint for vehicle deceleration" VALUE 0xa0021c8c _REC_S1VAL_20_u2 655.35 _CNV_A_R_LINEAR_____32_CM 0. 655.35 FORMAT "%6.2" /end CHARACTERISTIC
/begin CHARACTERISTIC Cxx_ajs_spv_slk_decl_dly "Time delay to detect the end of the slack effect correction during vehicle deceleration" VALUE 0xa0021c8e _REC_S1VAL_20_u2 655.35 _CNV_A_R_LINEAR_____32_CM 0. 655.35 FORMAT "%6.2" /end CHARACTERISTIC
/begin CHARACTERISTIC Cxx_ajs_spv_tco_thd "Engine temperature threshold to enable the boost of the curative anti-jerk function." VALUE 0xa0021c90 _REC_S1VAL_20_u2 240. _CNV_A_R_LINEAR_____110_CM -40. 200. FORMAT "%5.1" /end CHARACTERISTIC
/begin CHARACTERISTIC Cxx_ajs_spv_tq_drv_hys "hysteresis for Driver torque derivative threshold to enable the boost of the curative anti-jerk function." VALUE 0xa0021caa _REC_S1VAL_20_u1 1. _CNV_A_R_LINEAR_____123_CM 0. 1. FORMAT "%4.2" /end CHARACTERISTIC
/begin CHARACTERISTIC Cxx_ajs_spv_tq_drv_thd "Driver torque derivative threshold to enable the boost of the curative anti-jerk function." VALUE 0xa0021cab _REC_S1VAL_20_u1 1. _CNV_A_R_LINEAR_____123_CM 0. 1. FORMAT "%4.2" /end CHARACTERISTIC
/begin CHARACTERISTIC Cxx_ajs_spv_tq_rat_t1_fil_acel "Filter time constant for filtering of the driver torque ratio for vehicle acceleration" VALUE 0xa0021c92 _REC_S1VAL_20_u2 655.35 _CNV_A_R_LINEAR_____32_CM 0. 655.35 FORMAT "%6.2" /end CHARACTERISTIC
/begin CHARACTERISTIC Cxx_ajs_spv_tq_rat_t1_fil_decl "Filter time constant for filtering of the driver torque ratio for vehicle deceleration" VALUE 0xa0021c94 _REC_S1VAL_20_u2 655.35 _CNV_A_R_LINEAR_____32_CM 0. 655.35 FORMAT "%6.2" /end CHARACTERISTIC
/begin CHARACTERISTIC Cxx_ajs_spv_tqe_tgt_thd "Driver torque threshold to enable the boost of the curative anti-jerk function." VALUE 0xa0021c96 _REC_S1VAL_20_u2 2047.96875 _CNV_A_R_LINEAR_____216_CM -400. 1647.96875 FORMAT "%10.5" /end CHARACTERISTIC
/begin CHARACTERISTIC Cxx_ajs_spv_wait_dly "Maximum time for the observation of driver pedal or torque conditions to enable the boost of the curative the anti-jerk function." VALUE 0xa0021c98 _REC_S1VAL_20_u2 655.35 _CNV_A_R_LINEAR_____32_CM 0. 655.35 FORMAT "%6.2" /end CHARACTERISTIC
/begin AXIS_PTS Ctb_ajs_modu_n "Breakpoint calibration of engine speed in AJMOD function" 0xa002f6f4 Vxx_ajs_modu_n_mv _REC_A2AXS_20_u2 16383.75 _CNV_A_R_ENSD_LINEA_22_CM 10 0. 16383.75 FORMAT "%8.2" /end AXIS_PTS
/begin AXIS_PTS Ctb_ajs_tq_fac "Breakpoint calibration of normalized driver torque factor" 0xa0021c0c Vxx_ajs_spv_driv_tq_fac _REC_A2AXS_20_u1 1. _CNV_A_R_LINEAR_____123_CM 7 0. 1. FORMAT "%4.2" /end AXIS_PTS
/begin MEASUREMENT Vxx_ajs_esti_tqe "Estimated effective engine torque used in the anti-jerk strategy" UWORD _CNV_A_R_LINEAR_____216_CM 1 0. -400. 1647.96875 ECU_ADDRESS 0xd00047ce FORMAT "%10.5" /end MEASUREMENT
/begin AXIS_PTS Ctb_ajs_tco "9 engine coolant temperature breakpoints for AJS" 0xa0031724 Vxx_tco _REC_A2AXS_20_u2 240. _CNV_A_R_LINEAR_____110_CM 9 -40. 200. FORMAT "%5.1" /end AXIS_PTS
/begin CHARACTERISTIC Cmp_ajs_acel_slk_dly_fac_spc "Specific cartography for modulation factors of the delay of action of the slack effect for vehicle acceleration" MAP 0xa0031738 _REC_A1MAP_20_u2_u1_u2 100. _CNV_A_R_LINEAR_____123_CM 0. 100.
 /begin AXIS_DESCR COM_AXIS Vxx_ajs_spv_driv_tq_fac _CNV_A_R_LINEAR_____123_CM 7 0. 1. FORMAT "%4.2" AXIS_PTS_REF Ctb_ajs_tq_fac /end AXIS_DESCR
 /begin AXIS_DESCR COM_AXIS Vxx_ajs_dt_tq_rat _CNV_A_R_LINEAR_____313_CM 12 -10. 200. FORMAT "%6.2" AXIS_PTS_REF Ctb_ajs_dt_tq_rat /end AXIS_DESCR
/end CHARACTERISTIC
/begin CHARACTERISTIC Cmp_ajs_acel_slk_dly_spc "Specific cartography for selecting the delay of action of the slack effect for vehicle acceleration" MAP 0xa00317e0 _REC_A1MAP_20_u2_u2_u2 65.535 _CNV_A_R_LINEAR_____116_CM 0. 65.535
 /begin AXIS_DESCR COM_AXIS Vxx_ajs_modu_n_mv _CNV_A_R_ENSD_LINEA_22_CM 10 0. 16383.75 FORMAT "%8.2" AXIS_PTS_REF Ctb_ajs_modu_n /end AXIS_DESCR
 /begin AXIS_DESCR COM_AXIS Vxx_ajs_dt_tq_rat _CNV_A_R_LINEAR_____313_CM 12 -10. 200. FORMAT "%6.2" AXIS_PTS_REF Ctb_ajs_dt_tq_rat /end AXIS_DESCR
/end CHARACTERISTIC
/begin CHARACTERISTIC Cmp_ajs_acel_slk_t1_fac_spc "Specific cartography for modulation factors of the initial time constant offset added during slack effect activation for vehicle acceleration" MAP 0xa00318d0 _REC_A1MAP_20_u2_u1_u2 100. _CNV_A_R_LINEAR_____123_CM 0. 100.
 /begin AXIS_DESCR COM_AXIS Vxx_ajs_spv_driv_tq_fac _CNV_A_R_LINEAR_____123_CM 7 0. 1. FORMAT "%4.2" AXIS_PTS_REF Ctb_ajs_tq_fac /end AXIS_DESCR
 /begin AXIS_DESCR COM_AXIS Vxx_ajs_dt_tq_rat _CNV_A_R_LINEAR_____313_CM 12 -10. 200. FORMAT "%6.2" AXIS_PTS_REF Ctb_ajs_dt_tq_rat /end AXIS_DESCR
/end CHARACTERISTIC
/begin CHARACTERISTIC Cmp_ajs_acel_slk_t1_max_spc "Specific cartography for selecting the initial time constant offset added during slack effect activation for vehicle acceleration" MAP 0xa0031978 _REC_A1MAP_20_u2_u2_u2 65.535 _CNV_A_R_LINEAR_____116_CM 0. 65.535
 /begin AXIS_DESCR COM_AXIS Vxx_ajs_modu_n_mv _CNV_A_R_ENSD_LINEA_22_CM 10 0. 16383.75 FORMAT "%8.2" AXIS_PTS_REF Ctb_ajs_modu_n /end AXIS_DESCR
 /begin AXIS_DESCR COM_AXIS Vxx_ajs_dt_tq_rat _CNV_A_R_LINEAR_____313_CM 12 -10. 200. FORMAT "%6.2" AXIS_PTS_REF Ctb_ajs_dt_tq_rat /end AXIS_DESCR
/end CHARACTERISTIC
/begin CHARACTERISTIC Cmp_ajs_decl_slk_dly_fac_spc "Specific cartography for modulation factors of the delay of action of the slack effect for vehicle deceleration" MAP 0xa0031a68 _REC_A1MAP_20_u2_u1_u2 100. _CNV_A_R_LINEAR_____123_CM 0. 100.
 /begin AXIS_DESCR COM_AXIS Vxx_ajs_spv_driv_tq_fac _CNV_A_R_LINEAR_____123_CM 7 0. 1. FORMAT "%4.2" AXIS_PTS_REF Ctb_ajs_tq_fac /end AXIS_DESCR
 /begin AXIS_DESCR COM_AXIS Vxx_ajs_dt_tq_rat _CNV_A_R_LINEAR_____313_CM 12 -10. 200. FORMAT "%6.2" AXIS_PTS_REF Ctb_ajs_dt_tq_rat /end AXIS_DESCR
/end CHARACTERISTIC
/begin CHARACTERISTIC Cmp_ajs_decl_slk_dly_spc "Specific cartography for selecting the delay of action of the slack effect for vehicle deceleration" MAP 0xa0031b10 _REC_A1MAP_20_u2_u2_u2 65.535 _CNV_A_R_LINEAR_____116_CM 0. 65.535
 /begin AXIS_DESCR COM_AXIS Vxx_ajs_modu_n_mv _CNV_A_R_ENSD_LINEA_22_CM 10 0. 16383.75 FORMAT "%8.2" AXIS_PTS_REF Ctb_ajs_modu_n /end AXIS_DESCR
 /begin AXIS_DESCR COM_AXIS Vxx_ajs_dt_tq_rat _CNV_A_R_LINEAR_____313_CM 12 -10. 200. FORMAT "%6.2" AXIS_PTS_REF Ctb_ajs_dt_tq_rat /end AXIS_DESCR
/end CHARACTERISTIC
/begin CHARACTERISTIC Cmp_ajs_decl_slk_t1_fac_spc "Specific cartography for modulation factors of the initial time constant offset added during slack effect activation for vehicle deceleration" MAP 0xa0031c00 _REC_A1MAP_20_u2_u1_u2 100. _CNV_A_R_LINEAR_____123_CM 0. 100.
 /begin AXIS_DESCR COM_AXIS Vxx_ajs_spv_driv_tq_fac _CNV_A_R_LINEAR_____123_CM 7 0. 1. FORMAT "%4.2" AXIS_PTS_REF Ctb_ajs_tq_fac /end AXIS_DESCR
 /begin AXIS_DESCR COM_AXIS Vxx_ajs_dt_tq_rat _CNV_A_R_LINEAR_____313_CM 12 -10. 200. FORMAT "%6.2" AXIS_PTS_REF Ctb_ajs_dt_tq_rat /end AXIS_DESCR
/end CHARACTERISTIC
/begin CHARACTERISTIC Cmp_ajs_decl_slk_t1_max_spc "Specific cartography for selecting the initial time constant offset added during slack effect activation for vehicle deceleration" MAP 0xa0031ca8 _REC_A1MAP_20_u2_u2_u2 65.535 _CNV_A_R_LINEAR_____116_CM 0. 65.535
 /begin AXIS_DESCR COM_AXIS Vxx_ajs_modu_n_mv _CNV_A_R_ENSD_LINEA_22_CM 10 0. 16383.75 FORMAT "%8.2" AXIS_PTS_REF Ctb_ajs_modu_n /end AXIS_DESCR
 /begin AXIS_DESCR COM_AXIS Vxx_ajs_dt_tq_rat _CNV_A_R_LINEAR_____313_CM 12 -10. 200. FORMAT "%6.2" AXIS_PTS_REF Ctb_ajs_dt_tq_rat /end AXIS_DESCR
/end CHARACTERISTIC
/begin CHARACTERISTIC Cmp_ajs_modu_t1_acel_clos_spc "Specific time constant cartography for vehicle acceleration when driveline is closed" MAP 0xa0031d98 _REC_A1MAP_20_u2_u2_u2 65.535 _CNV_A_R_LINEAR_____116_CM 0. 65.535
 /begin AXIS_DESCR COM_AXIS Vxx_ajs_modu_n_mv _CNV_A_R_ENSD_LINEA_22_CM 10 0. 16383.75 FORMAT "%8.2" AXIS_PTS_REF Ctb_ajs_modu_n /end AXIS_DESCR
 /begin AXIS_DESCR COM_AXIS Vxx_ajs_dt_tq_rat _CNV_A_R_LINEAR_____313_CM 12 -10. 200. FORMAT "%6.2" AXIS_PTS_REF Ctb_ajs_dt_tq_rat /end AXIS_DESCR
/end CHARACTERISTIC
/begin CHARACTERISTIC Cmp_ajs_modu_t1_acel_fac_spc "Specific cartography for modulation factors of the filter time constant based on driver torque factor for vehicle acceleration" MAP 0xa0031e88 _REC_A1MAP_20_u2_u1_u2 100. _CNV_A_R_LINEAR_____123_CM 0. 100.
 /begin AXIS_DESCR COM_AXIS Vxx_ajs_spv_driv_tq_fac _CNV_A_R_LINEAR_____123_CM 7 0. 1. FORMAT "%4.2" AXIS_PTS_REF Ctb_ajs_tq_fac /end AXIS_DESCR
 /begin AXIS_DESCR COM_AXIS Vxx_ajs_dt_tq_rat _CNV_A_R_LINEAR_____313_CM 12 -10. 200. FORMAT "%6.2" AXIS_PTS_REF Ctb_ajs_dt_tq_rat /end AXIS_DESCR
/end CHARACTERISTIC
/begin CHARACTERISTIC Cmp_ajs_modu_t1_acel_tql_spc "Specific cartography for modulation factors of filter time constant based on the torque losses due to accessories for vehicle acceleration" MAP 0xa0031f30 _REC_A1MAP_20_u2_u2_u2 100. _CNV_A_R_LINEAR_____123_CM 0. 100.
 /begin AXIS_DESCR COM_AXIS Vxx_ajs_aux_tql _CNV_A_R_LINEAR_____181_CM 8 0. 2047.96875 FORMAT "%10.5" AXIS_PTS_REF Ctb_ajs_aux_tql /end AXIS_DESCR
 /begin AXIS_DESCR COM_AXIS Vxx_ajs_dt_tq_rat _CNV_A_R_LINEAR_____313_CM 12 -10. 200. FORMAT "%6.2" AXIS_PTS_REF Ctb_ajs_dt_tq_rat /end AXIS_DESCR
/end CHARACTERISTIC
/begin CHARACTERISTIC Cmp_ajs_modu_t1_aftr_n_spc "Specific time constant cartography, based on engine speed, after slack effect activation, for vehicle deceleration." MAP 0xa0031ff0 _REC_A1MAP_20_u2_u2_u2 65.535 _CNV_A_R_LINEAR_____116_CM 0. 65.535
 /begin AXIS_DESCR COM_AXIS Vxx_ajs_modu_n_mv _CNV_A_R_ENSD_LINEA_22_CM 10 0. 16383.75 FORMAT "%8.2" AXIS_PTS_REF Ctb_ajs_modu_n /end AXIS_DESCR
 /begin AXIS_DESCR COM_AXIS Vxx_ajs_dt_tq_rat _CNV_A_R_LINEAR_____313_CM 12 -10. 200. FORMAT "%6.2" AXIS_PTS_REF Ctb_ajs_dt_tq_rat /end AXIS_DESCR
/end CHARACTERISTIC
/begin CHARACTERISTIC Cmp_ajs_modu_t1_aftr_tq_spc "Specific cartography for modulation factors of filter time constant, based on driver torque factor, after slack effect activation, for vehicle deceleration." MAP 0xa00320e0 _REC_A1MAP_20_u2_u1_u2 100. _CNV_A_R_LINEAR_____123_CM 0. 100.
 /begin AXIS_DESCR COM_AXIS Vxx_ajs_spv_driv_tq_fac _CNV_A_R_LINEAR_____123_CM 7 0. 1. FORMAT "%4.2" AXIS_PTS_REF Ctb_ajs_tq_fac /end AXIS_DESCR
 /begin AXIS_DESCR COM_AXIS Vxx_ajs_dt_tq_rat _CNV_A_R_LINEAR_____313_CM 12 -10. 200. FORMAT "%6.2" AXIS_PTS_REF Ctb_ajs_dt_tq_rat /end AXIS_DESCR
/end CHARACTERISTIC
/begin CHARACTERISTIC Cmp_ajs_modu_t1_aftr_tql_spc "Specific cartography for modulation factors of filter time constant based on auxiliary torque losses, after slack effect activation, for vehicle deceleration." MAP 0xa0032188 _REC_A1MAP_20_u2_u2_u2 100. _CNV_A_R_LINEAR_____123_CM 0. 100.
 /begin AXIS_DESCR COM_AXIS Vxx_ajs_aux_tql _CNV_A_R_LINEAR_____181_CM 8 0. 2047.96875 FORMAT "%10.5" AXIS_PTS_REF Ctb_ajs_aux_tql /end AXIS_DESCR
 /begin AXIS_DESCR COM_AXIS Vxx_ajs_dt_tq_rat _CNV_A_R_LINEAR_____313_CM 12 -10. 200. FORMAT "%6.2" AXIS_PTS_REF Ctb_ajs_dt_tq_rat /end AXIS_DESCR
/end CHARACTERISTIC
/begin CHARACTERISTIC Cmp_ajs_modu_t1_bfr_n_spc "Specific time constant cartography, based on engine speed, before slack effect activation, for vehicle acceleration." MAP 0xa0032248 _REC_A1MAP_20_u2_u2_u2 65.535 _CNV_A_R_LINEAR_____116_CM 0. 65.535
 /begin AXIS_DESCR COM_AXIS Vxx_ajs_modu_n_mv _CNV_A_R_ENSD_LINEA_22_CM 10 0. 16383.75 FORMAT "%8.2" AXIS_PTS_REF Ctb_ajs_modu_n /end AXIS_DESCR
 /begin AXIS_DESCR COM_AXIS Vxx_ajs_dt_tq_rat _CNV_A_R_LINEAR_____313_CM 12 -10. 200. FORMAT "%6.2" AXIS_PTS_REF Ctb_ajs_dt_tq_rat /end AXIS_DESCR
/end CHARACTERISTIC
/begin CHARACTERISTIC Cmp_ajs_modu_t1_bfr_tq_spc "Specific cartography for modulation factors of filter time constant, based on driver torque factor, before slack effect activation, for vehicle acceleration." MAP 0xa0032338 _REC_A1MAP_20_u2_u1_u2 100. _CNV_A_R_LINEAR_____123_CM 0. 100.
 /begin AXIS_DESCR COM_AXIS Vxx_ajs_spv_driv_tq_fac _CNV_A_R_LINEAR_____123_CM 7 0. 1. FORMAT "%4.2" AXIS_PTS_REF Ctb_ajs_tq_fac /end AXIS_DESCR
 /begin AXIS_DESCR COM_AXIS Vxx_ajs_dt_tq_rat _CNV_A_R_LINEAR_____313_CM 12 -10. 200. FORMAT "%6.2" AXIS_PTS_REF Ctb_ajs_dt_tq_rat /end AXIS_DESCR
/end CHARACTERISTIC
/begin CHARACTERISTIC Cmp_ajs_modu_t1_bfr_tql_spc "Specific cartography for modulation factors of filter time constant based on auxiliary torque losses, before slack effect activation, for vehicle acceleration." MAP 0xa00323e0 _REC_A1MAP_20_u2_u2_u2 100. _CNV_A_R_LINEAR_____123_CM 0. 100.
 /begin AXIS_DESCR COM_AXIS Vxx_ajs_aux_tql _CNV_A_R_LINEAR_____181_CM 8 0. 2047.96875 FORMAT "%10.5" AXIS_PTS_REF Ctb_ajs_aux_tql /end AXIS_DESCR
 /begin AXIS_DESCR COM_AXIS Vxx_ajs_dt_tq_rat _CNV_A_R_LINEAR_____313_CM 12 -10. 200. FORMAT "%6.2" AXIS_PTS_REF Ctb_ajs_dt_tq_rat /end AXIS_DESCR
/end CHARACTERISTIC
/begin CHARACTERISTIC Cmp_ajs_modu_t1_decl_clos_spc "Specific time constant cartography for vehicle deceleration when driveline is closed" MAP 0xa00324a0 _REC_A1MAP_20_u2_u2_u2 65.535 _CNV_A_R_LINEAR_____116_CM 0. 65.535
 /begin AXIS_DESCR COM_AXIS Vxx_ajs_modu_n_mv _CNV_A_R_ENSD_LINEA_22_CM 10 0. 16383.75 FORMAT "%8.2" AXIS_PTS_REF Ctb_ajs_modu_n /end AXIS_DESCR
 /begin AXIS_DESCR COM_AXIS Vxx_ajs_dt_tq_rat _CNV_A_R_LINEAR_____313_CM 12 -10. 200. FORMAT "%6.2" AXIS_PTS_REF Ctb_ajs_dt_tq_rat /end AXIS_DESCR
/end CHARACTERISTIC
/begin CHARACTERISTIC Cmp_ajs_modu_t1_decl_fac_spc "Specific cartography for modulation factors of the filter time constant based on driver torque factor for vehicle deceleration" MAP 0xa0032590 _REC_A1MAP_20_u2_u1_u2 100. _CNV_A_R_LINEAR_____123_CM 0. 100.
 /begin AXIS_DESCR COM_AXIS Vxx_ajs_spv_driv_tq_fac _CNV_A_R_LINEAR_____123_CM 7 0. 1. FORMAT "%4.2" AXIS_PTS_REF Ctb_ajs_tq_fac /end AXIS_DESCR
 /begin AXIS_DESCR COM_AXIS Vxx_ajs_dt_tq_rat _CNV_A_R_LINEAR_____313_CM 12 -10. 200. FORMAT "%6.2" AXIS_PTS_REF Ctb_ajs_dt_tq_rat /end AXIS_DESCR
/end CHARACTERISTIC
/begin CHARACTERISTIC Cmp_ajs_modu_t1_decl_tql_spc "Specific cartography for modulation factors of filter time constant based on the torque losses due to accessories for vehicle deceleration" MAP 0xa0032638 _REC_A1MAP_20_u2_u2_u2 100. _CNV_A_R_LINEAR_____123_CM 0. 100.
 /begin AXIS_DESCR COM_AXIS Vxx_ajs_aux_tql _CNV_A_R_LINEAR_____181_CM 8 0. 2047.96875 FORMAT "%10.5" AXIS_PTS_REF Ctb_ajs_aux_tql /end AXIS_DESCR
 /begin AXIS_DESCR COM_AXIS Vxx_ajs_dt_tq_rat _CNV_A_R_LINEAR_____313_CM 12 -10. 200. FORMAT "%6.2" AXIS_PTS_REF Ctb_ajs_dt_tq_rat /end AXIS_DESCR
/end CHARACTERISTIC
/begin CHARACTERISTIC Cmp_ajs_modu_td_acel_clos_spc "Specific gain cartography for vehicle acceleration when driveline is closed" MAP 0xa00326f8 _REC_A1MAP_20_u2_u2_u2 1. _CNV_A_R_LINEAR_____161_CM 0. 1. FORMAT "%5.3"
 /begin AXIS_DESCR COM_AXIS Vxx_ajs_modu_n_mv _CNV_A_R_ENSD_LINEA_22_CM 10 0. 16383.75 FORMAT "%8.2" AXIS_PTS_REF Ctb_ajs_modu_n /end AXIS_DESCR
 /begin AXIS_DESCR COM_AXIS Vxx_ajs_dt_tq_rat _CNV_A_R_LINEAR_____313_CM 12 -10. 200. FORMAT "%6.2" AXIS_PTS_REF Ctb_ajs_dt_tq_rat /end AXIS_DESCR
/end CHARACTERISTIC
/begin CHARACTERISTIC Cmp_ajs_modu_td_acel_fac_spc "Specific cartography for modulation factors of the filter gain based on driver torque factor for vehicle acceleration" MAP 0xa00327e8 _REC_A1MAP_20_u2_u1_u2 100. _CNV_A_R_LINEAR_____123_CM 0. 100.
 /begin AXIS_DESCR COM_AXIS Vxx_ajs_spv_driv_tq_fac _CNV_A_R_LINEAR_____123_CM 7 0. 1. FORMAT "%4.2" AXIS_PTS_REF Ctb_ajs_tq_fac /end AXIS_DESCR
 /begin AXIS_DESCR COM_AXIS Vxx_ajs_dt_tq_rat _CNV_A_R_LINEAR_____313_CM 12 -10. 200. FORMAT "%6.2" AXIS_PTS_REF Ctb_ajs_dt_tq_rat /end AXIS_DESCR
/end CHARACTERISTIC
/begin CHARACTERISTIC Cmp_ajs_modu_td_acel_tql_spc "Specific cartography for modulation factors of the filter gain based on the torque losses due to accessories for vehicle acceleration" MAP 0xa0032890 _REC_A1MAP_20_u2_u2_u2 100. _CNV_A_R_LINEAR_____123_CM 0. 100.
 /begin AXIS_DESCR COM_AXIS Vxx_ajs_aux_tql _CNV_A_R_LINEAR_____181_CM 8 0. 2047.96875 FORMAT "%10.5" AXIS_PTS_REF Ctb_ajs_aux_tql /end AXIS_DESCR
 /begin AXIS_DESCR COM_AXIS Vxx_ajs_dt_tq_rat _CNV_A_R_LINEAR_____313_CM 12 -10. 200. FORMAT "%6.2" AXIS_PTS_REF Ctb_ajs_dt_tq_rat /end AXIS_DESCR
/end CHARACTERISTIC
/begin CHARACTERISTIC Cmp_ajs_modu_td_decl_clos_spc "Specific gain cartography for vehicle deceleration when driveline is closed" MAP 0xa0032950 _REC_A1MAP_20_u2_u2_u2 1. _CNV_A_R_LINEAR_____161_CM 0. 1. FORMAT "%5.3"
 /begin AXIS_DESCR COM_AXIS Vxx_ajs_modu_n_mv _CNV_A_R_ENSD_LINEA_22_CM 10 0. 16383.75 FORMAT "%8.2" AXIS_PTS_REF Ctb_ajs_modu_n /end AXIS_DESCR
 /begin AXIS_DESCR COM_AXIS Vxx_ajs_dt_tq_rat _CNV_A_R_LINEAR_____313_CM 12 -10. 200. FORMAT "%6.2" AXIS_PTS_REF Ctb_ajs_dt_tq_rat /end AXIS_DESCR
/end CHARACTERISTIC
/begin CHARACTERISTIC Cmp_ajs_modu_td_decl_fac_spc "Specific cartography for modulation factors of the filter gain based on driver torque factor for vehicle deceleration" MAP 0xa0032a40 _REC_A1MAP_20_u2_u1_u2 100. _CNV_A_R_LINEAR_____123_CM 0. 100.
 /begin AXIS_DESCR COM_AXIS Vxx_ajs_spv_driv_tq_fac _CNV_A_R_LINEAR_____123_CM 7 0. 1. FORMAT "%4.2" AXIS_PTS_REF Ctb_ajs_tq_fac /end AXIS_DESCR
 /begin AXIS_DESCR COM_AXIS Vxx_ajs_dt_tq_rat _CNV_A_R_LINEAR_____313_CM 12 -10. 200. FORMAT "%6.2" AXIS_PTS_REF Ctb_ajs_dt_tq_rat /end AXIS_DESCR
/end CHARACTERISTIC
/begin CHARACTERISTIC Cmp_ajs_modu_td_decl_tql_spc "Specific cartography for modulation factors of the filter gain based on the torque losses due to accessories for vehicle deceleration" MAP 0xa0032ae8 _REC_A1MAP_20_u2_u2_u2 100. _CNV_A_R_LINEAR_____123_CM 0. 100.
 /begin AXIS_DESCR COM_AXIS Vxx_ajs_aux_tql _CNV_A_R_LINEAR_____181_CM 8 0. 2047.96875 FORMAT "%10.5" AXIS_PTS_REF Ctb_ajs_aux_tql /end AXIS_DESCR
 /begin AXIS_DESCR COM_AXIS Vxx_ajs_dt_tq_rat _CNV_A_R_LINEAR_____313_CM 12 -10. 200. FORMAT "%6.2" AXIS_PTS_REF Ctb_ajs_dt_tq_rat /end AXIS_DESCR
/end CHARACTERISTIC
/begin CHARACTERISTIC Cmp_ajs_slk_acel_gear_n_spc "Specific torque threshold to activate the slack effect for vehicle acceleleration, considering gear ratio and engine speed." MAP 0xa0032ba8 _REC_A1MAP_20_u2_u2_u2 2047.96875 _CNV_A_R_LINEAR_____216_CM -400. 1647.96875 FORMAT "%10.5"
 /begin AXIS_DESCR COM_AXIS Vxx_ajs_dt_tq_rat _CNV_A_R_LINEAR_____313_CM 12 -10. 200. FORMAT "%6.2" AXIS_PTS_REF Ctb_ajs_dt_tq_rat /end AXIS_DESCR
 /begin AXIS_DESCR COM_AXIS Vxx_n_mv _CNV_A_R_ENSD_LINEA_22_CM 12 0. 16383.75 FORMAT "%8.2" AXIS_PTS_REF Ctb_ajs_slk_n /end AXIS_DESCR
/end CHARACTERISTIC
/begin CHARACTERISTIC Cmp_ajs_slk_acel_gear_tq_spc "Specific torque threshold to activate the slack effect for vehicle acceleration, considering gear ratio and driver torque factor." MAP 0xa0032cc8 _REC_A1MAP_20_u2_u2_u1 2047.96875 _CNV_A_R_LINEAR_____216_CM -400. 1647.96875 FORMAT "%10.5"
 /begin AXIS_DESCR COM_AXIS Vxx_ajs_dt_tq_rat _CNV_A_R_LINEAR_____313_CM 12 -10. 200. FORMAT "%6.2" AXIS_PTS_REF Ctb_ajs_dt_tq_rat /end AXIS_DESCR
 /begin AXIS_DESCR COM_AXIS Vxx_ajs_spv_driv_tq_fac _CNV_A_R_LINEAR_____123_CM 7 0. 1. FORMAT "%4.2" AXIS_PTS_REF Ctb_ajs_slk_tq_fac /end AXIS_DESCR
/end CHARACTERISTIC
/begin CHARACTERISTIC Cmp_ajs_slk_acel_gear_tql_spc "Specific torque threshold to activate the slack effect for vehicle acceleration, considering gear ratio and auxiliary torque losses." MAP 0xa0032d70 _REC_A1MAP_20_u2_u2_u2 2047.96875 _CNV_A_R_LINEAR_____216_CM -400. 1647.96875 FORMAT "%10.5"
 /begin AXIS_DESCR COM_AXIS Vxx_ajs_dt_tq_rat _CNV_A_R_LINEAR_____313_CM 12 -10. 200. FORMAT "%6.2" AXIS_PTS_REF Ctb_ajs_dt_tq_rat /end AXIS_DESCR
 /begin AXIS_DESCR COM_AXIS Vxx_ajs_aux_tql _CNV_A_R_LINEAR_____181_CM 8 0. 2047.96875 FORMAT "%10.5" AXIS_PTS_REF Ctb_ajs_aux_tql /end AXIS_DESCR
/end CHARACTERISTIC
/begin CHARACTERISTIC Cmp_ajs_slk_acel_n_tco_spc "Specific torque threshold to activate the slack effect for vehicle acceleration, considering engine speed and coolant temperature." MAP 0xa0032e30 _REC_A1MAP_20_u2_u2_u2 2047.96875 _CNV_A_R_LINEAR_____216_CM -400. 1647.96875 FORMAT "%10.5"
 /begin AXIS_DESCR COM_AXIS Vxx_n_mv _CNV_A_R_ENSD_LINEA_22_CM 12 0. 16383.75 FORMAT "%8.2" AXIS_PTS_REF Ctb_ajs_slk_n /end AXIS_DESCR
 /begin AXIS_DESCR COM_AXIS Vxx_tco _CNV_A_R_LINEAR_____110_CM 6 -40. 200. FORMAT "%5.1" AXIS_PTS_REF Ctb_ajs_slk_tco /end AXIS_DESCR
/end CHARACTERISTIC
/begin CHARACTERISTIC Cmp_ajs_slk_acel_n_tql_spc "Specific torque threshold to activate the slack effect for vehicle acceleration, considering engine speed and auxiliary torque losses." MAP 0xa0032ec0 _REC_A1MAP_20_u2_u2_u2 2047.96875 _CNV_A_R_LINEAR_____216_CM -400. 1647.96875 FORMAT "%10.5"
 /begin AXIS_DESCR COM_AXIS Vxx_n_mv _CNV_A_R_ENSD_LINEA_22_CM 12 0. 16383.75 FORMAT "%8.2" AXIS_PTS_REF Ctb_ajs_slk_n /end AXIS_DESCR
 /begin AXIS_DESCR COM_AXIS Vxx_ajs_aux_tql _CNV_A_R_LINEAR_____181_CM 8 0. 2047.96875 FORMAT "%10.5" AXIS_PTS_REF Ctb_ajs_aux_tql /end AXIS_DESCR
/end CHARACTERISTIC
/begin CHARACTERISTIC Cmp_ajs_slk_decl_gear_n_spc "Specific torque threshold to activate the slack effect for vehicle deceleration, considering gear ratio and engine speed." MAP 0xa0032f80 _REC_A1MAP_20_u2_u2_u2 2047.96875 _CNV_A_R_LINEAR_____216_CM -400. 1647.96875 FORMAT "%10.5"
 /begin AXIS_DESCR COM_AXIS Vxx_ajs_dt_tq_rat _CNV_A_R_LINEAR_____313_CM 12 -10. 200. FORMAT "%6.2" AXIS_PTS_REF Ctb_ajs_dt_tq_rat /end AXIS_DESCR
 /begin AXIS_DESCR COM_AXIS Vxx_n_mv _CNV_A_R_ENSD_LINEA_22_CM 12 0. 16383.75 FORMAT "%8.2" AXIS_PTS_REF Ctb_ajs_slk_n /end AXIS_DESCR
/end CHARACTERISTIC
/begin CHARACTERISTIC Cmp_ajs_slk_decl_gear_tq_spc "Specific torque threshold to activate the slack effect for vehicle deceleration, considering gear ratio and driver torque factor." MAP 0xa00330a0 _REC_A1MAP_20_u2_u2_u1 2047.96875 _CNV_A_R_LINEAR_____216_CM -400. 1647.96875 FORMAT "%10.5"
 /begin AXIS_DESCR COM_AXIS Vxx_ajs_dt_tq_rat _CNV_A_R_LINEAR_____313_CM 12 -10. 200. FORMAT "%6.2" AXIS_PTS_REF Ctb_ajs_dt_tq_rat /end AXIS_DESCR
 /begin AXIS_DESCR COM_AXIS Vxx_ajs_spv_driv_tq_fac _CNV_A_R_LINEAR_____123_CM 7 0. 1. FORMAT "%4.2" AXIS_PTS_REF Ctb_ajs_slk_tq_fac /end AXIS_DESCR
/end CHARACTERISTIC
/begin CHARACTERISTIC Cmp_ajs_slk_decl_gear_tql_spc "Specific torque threshold to activate the slack effect for vehicle deceleration, considering gear ratio and auxiliary torque losses." MAP 0xa0033148 _REC_A1MAP_20_u2_u2_u2 2047.96875 _CNV_A_R_LINEAR_____216_CM -400. 1647.96875 FORMAT "%10.5"
 /begin AXIS_DESCR COM_AXIS Vxx_ajs_dt_tq_rat _CNV_A_R_LINEAR_____313_CM 12 -10. 200. FORMAT "%6.2" AXIS_PTS_REF Ctb_ajs_dt_tq_rat /end AXIS_DESCR
 /begin AXIS_DESCR COM_AXIS Vxx_ajs_aux_tql _CNV_A_R_LINEAR_____181_CM 8 0. 2047.96875 FORMAT "%10.5" AXIS_PTS_REF Ctb_ajs_aux_tql /end AXIS_DESCR
/end CHARACTERISTIC
/begin CHARACTERISTIC Cmp_ajs_slk_decl_n_tco_spc "Specific torque threshold to activate the slack effect for vehicle deceleration, considering engine speed and coolant temperature." MAP 0xa0033208 _REC_A1MAP_20_u2_u2_u2 2047.96875 _CNV_A_R_LINEAR_____216_CM -400. 1647.96875 FORMAT "%10.5"
 /begin AXIS_DESCR COM_AXIS Vxx_n_mv _CNV_A_R_ENSD_LINEA_22_CM 12 0. 16383.75 FORMAT "%8.2" AXIS_PTS_REF Ctb_ajs_slk_n /end AXIS_DESCR
 /begin AXIS_DESCR COM_AXIS Vxx_tco _CNV_A_R_LINEAR_____110_CM 6 -40. 200. FORMAT "%5.1" AXIS_PTS_REF Ctb_ajs_slk_tco /end AXIS_DESCR
/end CHARACTERISTIC
/begin CHARACTERISTIC Cmp_ajs_slk_decl_n_tql_spc "Specific torque threshold to activate the slack effect for vehicle deceleration, considering engine speed and auxiliary torque losses." MAP 0xa0033298 _REC_A1MAP_20_u2_u2_u2 2047.96875 _CNV_A_R_LINEAR_____216_CM -400. 1647.96875 FORMAT "%10.5"
 /begin AXIS_DESCR COM_AXIS Vxx_n_mv _CNV_A_R_ENSD_LINEA_22_CM 12 0. 16383.75 FORMAT "%8.2" AXIS_PTS_REF Ctb_ajs_slk_n /end AXIS_DESCR
 /begin AXIS_DESCR COM_AXIS Vxx_ajs_aux_tql _CNV_A_R_LINEAR_____181_CM 8 0. 2047.96875 FORMAT "%10.5" AXIS_PTS_REF Ctb_ajs_aux_tql /end AXIS_DESCR
/end CHARACTERISTIC
/begin CHARACTERISTIC Cmp_ajs_slk_tqe_off_acel_spc "Specific torque high threshold to deactivate the slack effect for vehicle acceleration" MAP 0xa0033358 _REC_A1MAP_20_u2_u2_u2 2047.96875 _CNV_A_R_LINEAR_____216_CM -400. 1647.96875 FORMAT "%10.5"
 /begin AXIS_DESCR COM_AXIS Vxx_ajs_dt_tq_rat _CNV_A_R_LINEAR_____313_CM 12 -10. 200. FORMAT "%6.2" AXIS_PTS_REF Ctb_ajs_dt_tq_rat /end AXIS_DESCR
 /begin AXIS_DESCR COM_AXIS Vxx_ajs_aux_tql _CNV_A_R_LINEAR_____181_CM 8 0. 2047.96875 FORMAT "%10.5" AXIS_PTS_REF Ctb_ajs_aux_tql /end AXIS_DESCR
/end CHARACTERISTIC
/begin CHARACTERISTIC Cmp_ajs_slk_tqe_off_decl_spc "Specific torque high threshold to deactivate the slack effect for vehicle deceleration" MAP 0xa0033418 _REC_A1MAP_20_u2_u2_u2 2047.96875 _CNV_A_R_LINEAR_____216_CM -400. 1647.96875 FORMAT "%10.5"
 /begin AXIS_DESCR COM_AXIS Vxx_ajs_dt_tq_rat _CNV_A_R_LINEAR_____313_CM 12 -10. 200. FORMAT "%6.2" AXIS_PTS_REF Ctb_ajs_dt_tq_rat /end AXIS_DESCR
 /begin AXIS_DESCR COM_AXIS Vxx_ajs_aux_tql _CNV_A_R_LINEAR_____181_CM 8 0. 2047.96875 FORMAT "%10.5" AXIS_PTS_REF Ctb_ajs_aux_tql /end AXIS_DESCR
/end CHARACTERISTIC
/begin CHARACTERISTIC Ctp_ajs_t1_acel_tco_fac "Table of modulation factors for the specific AJMOD time constant based on engine coolant temperature during vehicle acceleration" CURVE 0xa00334d8 _REC_A1CUR_20_u1_u2 1. _CNV_A_R_LINEAR_____162_CM 0. 1. FORMAT "%9.7"
 /begin AXIS_DESCR COM_AXIS Vxx_tco _CNV_A_R_LINEAR_____110_CM 9 -40. 200. FORMAT "%5.1" AXIS_PTS_REF Ctb_ajs_tco /end AXIS_DESCR
/end CHARACTERISTIC
/begin CHARACTERISTIC Ctp_ajs_t1_aftr_tco_fac "Table of modulation factors for the specific AJMOD time constant based on engine coolant temperature during vehicle deceleration, after slack effect activation." CURVE 0xa00334e4 _REC_A1CUR_20_u1_u2 1. _CNV_A_R_LINEAR_____162_CM 0. 1. FORMAT "%9.7"
 /begin AXIS_DESCR COM_AXIS Vxx_tco _CNV_A_R_LINEAR_____110_CM 9 -40. 200. FORMAT "%5.1" AXIS_PTS_REF Ctb_ajs_tco /end AXIS_DESCR
/end CHARACTERISTIC
/begin CHARACTERISTIC Ctp_ajs_t1_bfr_tco_fac "Table of modulation factors for the specific AJMOD time constant based on engine coolant temperature during vehicle acceleration, before slack effect activation." CURVE 0xa00334f0 _REC_A1CUR_20_u1_u2 1. _CNV_A_R_LINEAR_____162_CM 0. 1. FORMAT "%9.7"
 /begin AXIS_DESCR COM_AXIS Vxx_tco _CNV_A_R_LINEAR_____110_CM 9 -40. 200. FORMAT "%5.1" AXIS_PTS_REF Ctb_ajs_tco /end AXIS_DESCR
/end CHARACTERISTIC
/begin CHARACTERISTIC Ctp_ajs_t1_decl_tco_fac "Table of modulation factors for the specific AJMOD time constant based on engine coolant temperature during vehicle deceleration" CURVE 0xa00334fc _REC_A1CUR_20_u1_u2 1. _CNV_A_R_LINEAR_____162_CM 0. 1. FORMAT "%9.7"
 /begin AXIS_DESCR COM_AXIS Vxx_tco _CNV_A_R_LINEAR_____110_CM 9 -40. 200. FORMAT "%5.1" AXIS_PTS_REF Ctb_ajs_tco /end AXIS_DESCR
/end CHARACTERISTIC
/begin CHARACTERISTIC Ctp_ajs_td_acel_tco_fac "Table of modulation factors for the specific AJMOD gain based on engine coolant temperature during vehicle acceleration" CURVE 0xa0033508 _REC_A1CUR_20_u1_u2 1. _CNV_A_R_LINEAR_____162_CM 0. 1. FORMAT "%9.7"
 /begin AXIS_DESCR COM_AXIS Vxx_tco _CNV_A_R_LINEAR_____110_CM 9 -40. 200. FORMAT "%5.1" AXIS_PTS_REF Ctb_ajs_tco /end AXIS_DESCR
/end CHARACTERISTIC
/begin CHARACTERISTIC Ctp_ajs_td_decl_tco_fac "Table of modulation factors for the specific AJMOD gain based on engine coolant temperature during vehicle deceleration" CURVE 0xa0033514 _REC_A1CUR_20_u1_u2 1. _CNV_A_R_LINEAR_____162_CM 0. 1. FORMAT "%9.7"
 /begin AXIS_DESCR COM_AXIS Vxx_tco _CNV_A_R_LINEAR_____110_CM 9 -40. 200. FORMAT "%5.1" AXIS_PTS_REF Ctb_ajs_tco /end AXIS_DESCR
/end CHARACTERISTIC
/begin MEASUREMENT Vxx_ajs_modu_n_mv_spc "Specific filtered engine speed after status validation" UWORD _CNV_A_R_ENSD_LINEA_22_CM 1 0. 0. 16383.75 ECU_ADDRESS 0xd00047d2 FORMAT "%8.2" /end MEASUREMENT
/begin MEASUREMENT Vxx_ajs_modu_t1_acel_spc "Specific time constant value calculated for vehicle acceleration" UWORD _CNV_A_R_LINEAR_____116_CM 1 0. 0. 65.535 ECU_ADDRESS 0xd00047d4 /end MEASUREMENT
/begin MEASUREMENT Vxx_ajs_modu_t1_aftr_decl_spc "Specific time constant value after slack effect activation, for vehicle deceleration." UWORD _CNV_A_R_LINEAR_____116_CM 1 0. 0. 65.535 ECU_ADDRESS 0xd00047d6 /end MEASUREMENT
/begin MEASUREMENT Vxx_ajs_modu_t1_bfr_acel_spc "Specific time constant value before slack effect activation, for vehicle acceleration." UWORD _CNV_A_R_LINEAR_____116_CM 1 0. 0. 65.535 ECU_ADDRESS 0xd00047d8 /end MEASUREMENT
/begin MEASUREMENT Vxx_ajs_modu_t1_decl_spc "Specific time constant value calculated for vehicle deceleration" UWORD _CNV_A_R_LINEAR_____116_CM 1 0. 0. 65.535 ECU_ADDRESS 0xd00047da /end MEASUREMENT
/begin MEASUREMENT Vxx_ajs_modu_td_acel_spc "Specific gain value calculated for vehicle acceleration" UWORD _CNV_A_R_LINEAR_____161_CM 1 0. 0. 1. ECU_ADDRESS 0xd00047dc FORMAT "%5.3" /end MEASUREMENT
/begin MEASUREMENT Vxx_ajs_modu_td_decl_spc "Specific gain value calculated for vehicle deceleration" UWORD _CNV_A_R_LINEAR_____161_CM 1 0. 0. 1. ECU_ADDRESS 0xd00047de FORMAT "%5.3" /end MEASUREMENT
/begin MEASUREMENT Vxx_ajs_slk_dly_t1_spc "Specific delay of action of the slack effect calculated" UWORD _CNV_A_R_LINEAR_____116_CM 1 0. 0. 65.535 ECU_ADDRESS 0xd00047e0 /end MEASUREMENT
/begin MEASUREMENT Vxx_ajs_slk_t1_ini_max_spc "Specific calculated value of filter time constant initial offset added by the slack at its activation" UWORD _CNV_A_R_LINEAR_____116_CM 1 0. 0. 65.535 ECU_ADDRESS 0xd00047e2 /end MEASUREMENT
/begin MEASUREMENT Vxx_ajs_slk_tqe_off_acel_spc "Specific torque high threshold to deactivate the slack effect for vehicle acceleration" UWORD _CNV_A_R_LINEAR_____216_CM 1 0. -400. 1647.96875 ECU_ADDRESS 0xd00047e4 FORMAT "%10.5" /end MEASUREMENT
/begin MEASUREMENT Vxx_ajs_slk_tqe_off_decl_spc "Specific torque high threshold to deactivate the slack effect for vehicle deceleration" UWORD _CNV_A_R_LINEAR_____216_CM 1 0. -400. 1647.96875 ECU_ADDRESS 0xd00047e6 FORMAT "%10.5" /end MEASUREMENT
/begin MEASUREMENT Vxx_ajs_slk_tqe_on_acel_spc "Specific torque low threshold to deactivate the slack effect for vehicle acceleration" UWORD _CNV_A_R_LINEAR_____216_CM 1 0. -400. 1647.96875 ECU_ADDRESS 0xd00047e8 FORMAT "%10.5" /end MEASUREMENT
/begin MEASUREMENT Vxx_ajs_slk_tqe_on_decl_spc "Specific torque low threshold to deactivate the slack effect for vehicle deceleration" UWORD _CNV_A_R_LINEAR_____216_CM 1 0. -400. 1647.96875 ECU_ADDRESS 0xd00047ea FORMAT "%10.5" /end MEASUREMENT
/begin MEASUREMENT Vxx_ajs_slk_tqe_raw_acel_spc "Specific torque low threshold to deactivate the slack effect for vehicle acceleration, not held on accel/decel state." UWORD _CNV_A_R_LINEAR_____216_CM 1 0. -400. 1647.96875 ECU_ADDRESS 0xd00047ec FORMAT "%10.5" /end MEASUREMENT
/begin MEASUREMENT Vxx_ajs_slk_tqe_raw_decl_spc "Specific torque low threshold to deactivate the slack effect for vehicle deceleration, not held on accel/decel state." UWORD _CNV_A_R_LINEAR_____216_CM 1 0. -400. 1647.96875 ECU_ADDRESS 0xd00047ee FORMAT "%10.5" /end MEASUREMENT
/begin MEASUREMENT Vxx_ajs_spc_rat "Specific ratio for Anti Jerk parameters interpolation" UWORD _CNV_A_R_LINEAR_____161_CM 1 0. 0. 1. ECU_ADDRESS 0xd00047d0 FORMAT "%5.3" /end MEASUREMENT
/begin MEASUREMENT Vbx_sta_inj_stt "Vbx_sta_inj_stt : Boolean for the starting mode" UBYTE _CNV_S_2_RANGE______3_CM 1 0. 0. 1. DISPLAY_IDENTIFIER SmCrkCtl_NVM.Vbx_sta_inj_stt_NVM ECU_ADDRESS 0xd000486c BIT_MASK 0x1 /end MEASUREMENT
/begin MEASUREMENT Vbx_rest_stal "Restart after engine stall detected" UBYTE _CNV_S_2_RANGE______3_CM 1 0. 0. 1. DISPLAY_IDENTIFIER SmCrkCtl_NVM.Vbx_rest_stal_NVM ECU_ADDRESS 0xd000486d BIT_MASK 0x1 /end MEASUREMENT
/begin MEASUREMENT Vbx_rest_cdn "Indicator of restart condition" UBYTE _CNV_S_2_RANGE______3_CM 1 0. 0. 1. DISPLAY_IDENTIFIER SmCrkCtl_NVM.Vbx_rest_cdn_NVM ECU_ADDRESS 0xd000486e BIT_MASK 0x1 /end MEASUREMENT
/begin MEASUREMENT Vxx_inj_sta_dly "Vxx_inj_sta_dly : Maximum duration before out of Injection Start State" UBYTE _CNV_A_R_LINEAR_____58_CM 1 0. 0. 25.5 DISPLAY_IDENTIFIER SmCrkCtl_NVM.Vxx_inj_sta_dly_NVM ECU_ADDRESS 0xd000486f FORMAT "%4.1" /end MEASUREMENT
/begin MEASUREMENT Vxx_rest_ufld_ctr "Unflooding counter" UBYTE _CNV_A_R_ECME_LINEA_0_CM 1 0. 0. 255. DISPLAY_IDENTIFIER SmCrkCtl_NVM.Vxx_rest_ufld_ctr_NVM ECU_ADDRESS 0xd0004870 FORMAT "%3.0" /end MEASUREMENT
/begin MEASUREMENT Vxx_mem_rest_cor "Memorized (EEPROM) fuel Injection Mass correction factor for Re-Start" UWORD _CNV_A_R_LINEAR_____183_CM 1 0. 0. 1. DISPLAY_IDENTIFIER SmCrkCtl_NVM.Vxx_mem_rest_cor_NVM ECU_ADDRESS 0xd0004872 FORMAT "%11.9" /end MEASUREMENT
/begin MEASUREMENT Vxx_mem_rest_tco "Memorized (EEPROM) engine coolant temperature" UWORD _CNV_A_R_LINEAR_____110_CM 1 0. -40. 200. DISPLAY_IDENTIFIER SmCrkCtl_NVM.Vxx_mem_rest_tco_NVM ECU_ADDRESS 0xd0004874 FORMAT "%5.1" /end MEASUREMENT
/begin CHARACTERISTIC Ctp_tco_inj_sta_dly "Ctp_tco_inj_sta_dly : Maximum duration of Injection Start State coolant temperature dependant table" CURVE 0xa0034548 _REC_A1CUR_20_u1_u2 25.5 _CNV_A_R_LINEAR_____58_CM 0. 25.5 FORMAT "%4.1"
 /begin AXIS_DESCR COM_AXIS Vxx_tco _CNV_A_R_LINEAR_____110_CM 9 -40. 200. FORMAT "%5.1" AXIS_PTS_REF Ctb_tco2 /end AXIS_DESCR
/end CHARACTERISTIC
/begin CHARACTERISTIC Ctp_tco_out_inj_sta_n_thd "Engine speed threshold for out of injection starting state" CURVE 0xa0034554 _REC_A1CUR_20_u2_u2 16383.75 _CNV_A_R_ENSD_LINEA_22_CM 0. 16383.75 FORMAT "%8.2"
 /begin AXIS_DESCR COM_AXIS Vxx_tco _CNV_A_R_LINEAR_____110_CM 8 -40. 200. FORMAT "%5.1" AXIS_PTS_REF Ctb_sta_tco /end AXIS_DESCR
/end CHARACTERISTIC
/begin AXIS_PTS Ctb_rest_ufld_ctr "Unflooding counter breakpoints" 0xa0034524 Vxx_rest_ufld_ctr _REC_A2AXS_20_u1 255. _CNV_A_R_ECME_LINEA_0_CM 9 0. 255. FORMAT "%3.0" /end AXIS_PTS
/begin CHARACTERISTIC Ctp_tco_min_rest_cor "Additive correction to the restart correction factor to avoid a too powerfull injection correction" CURVE 0xa0034530 _REC_A1CUR_20_u1_u2 0.99609375 _CNV_A_R_LINEAR_____130_CM 3.90625e-003 1. FORMAT "%12.8"
 /begin AXIS_DESCR COM_AXIS Vxx_tco _CNV_A_R_LINEAR_____110_CM 9 -40. 200. FORMAT "%5.1" AXIS_PTS_REF Ctb_tco2 /end AXIS_DESCR
/end CHARACTERISTIC
/begin CHARACTERISTIC Ctp_ufld_rest_cor "Additive correction to the restart correction factor table dependant on the unflooding counter" CURVE 0xa003453c _REC_A1CUR_20_u1_u1 0.99609375 _CNV_A_R_LINEAR_____29_CM 0. 0.99609375 FORMAT "%10.8"
 /begin AXIS_DESCR COM_AXIS Vxx_rest_ufld_ctr _CNV_A_R_ECME_LINEA_0_CM 9 0. 255. FORMAT "%3.0" AXIS_PTS_REF Ctb_rest_ufld_ctr /end AXIS_DESCR
/end CHARACTERISTIC
/begin MEASUREMENT Vbx_ctr_act "Reactivation of the unflooding counter during starting state" UBYTE _CNV_S_2_RANGE______3_CM 1 0. 0. 1. ECU_ADDRESS 0xd00070a0 BIT_MASK 0x1 /end MEASUREMENT
/begin MEASUREMENT Vbx_equ_tco "Boolean indicates that TCO had not change a lot since the last engine start." UBYTE _CNV_S_2_RANGE______3_CM 1 0. 0. 1. ECU_ADDRESS 0xd00070a1 BIT_MASK 0x1 /end MEASUREMENT
/begin MEASUREMENT Vbx_rest_set_pws "Retention of the power supply for restart" UBYTE _CNV_S_2_RANGE______3_CM 1 0. 0. 1. ECU_ADDRESS 0xd00070a2 BIT_MASK 0x1 /end MEASUREMENT
/begin MEASUREMENT Vbx_t_ufld_ctr "Boolean indicating that the unflooding counter incrementation is temporal." UBYTE _CNV_S_2_RANGE______3_CM 1 0. 0. 1. ECU_ADDRESS 0xd00070a3 BIT_MASK 0x1 /end MEASUREMENT
/begin MEASUREMENT Vbx_tdc_ufld_ctr "Boolean indicating that the unflooding counter incrementation is by tdc." UBYTE _CNV_S_2_RANGE______3_CM 1 0. 0. 1. ECU_ADDRESS 0xd00070a4 BIT_MASK 0x1 /end MEASUREMENT
/begin MEASUREMENT Vsx_rst "Restart strategy States" UBYTE _CNV_S_4_RANGE_RESE_320_CM 1 0. 2. 16. ECU_ADDRESS 0xd00070a5 /end MEASUREMENT
/begin MEASUREMENT Vxx_appl_rest_cor "Fuel Injection Mass correction factor for Re-Start" UWORD _CNV_A_R_LINEAR_____183_CM 1 0. 0. 1. ECU_ADDRESS 0xd000709c FORMAT "%11.9" /end MEASUREMENT
/begin MEASUREMENT Vxx_ref_rest_cor "Fuel Injection Mass reference correction factor for Re-Start" UWORD _CNV_A_R_LINEAR_____183_CM 1 0. 0. 1. ECU_ADDRESS 0xd000709e FORMAT "%11.9" /end MEASUREMENT
/begin CHARACTERISTIC Cxx_rest1_ufld_cor "First start correction factor" VALUE 0xa0021ce2 _REC_S1VAL_20_u1 0.99609375 _CNV_A_R_LINEAR_____130_CM 3.90625e-003 1. FORMAT "%12.8" /end CHARACTERISTIC
/begin CHARACTERISTIC Cxx_rest1_ufld_cor_alco "First start correction factor for flex fuel" VALUE 0xa0021ce3 _REC_S1VAL_20_u1 0.99609375 _CNV_A_R_LINEAR_____130_CM 3.90625e-003 1. FORMAT "%12.8" /end CHARACTERISTIC
/begin CHARACTERISTIC Cxx_rest_tco_l_ofs "Low tco offset on the memorized tco to detect tco evolution since last engine start" VALUE 0xa0021cdc _REC_S1VAL_20_u2 240. _CNV_A_R_LINEAR_____110_CM -40. 200. FORMAT "%5.1" /end CHARACTERISTIC
/begin CHARACTERISTIC Cxx_rest_tco_up_ofs "High tco offset on the memorized tco to detect tco evolution since last engine start" VALUE 0xa0021cde _REC_S1VAL_20_u2 240. _CNV_A_R_LINEAR_____110_CM -40. 200. FORMAT "%5.1" /end CHARACTERISTIC
/begin CHARACTERISTIC Cxx_rest_ufld_cor "Successive restarts correction factor" VALUE 0xa0021ce4 _REC_S1VAL_20_u1 0.99609375 _CNV_A_R_LINEAR_____130_CM 3.90625e-003 1. FORMAT "%12.8" /end CHARACTERISTIC
/begin CHARACTERISTIC Cxx_rest_ufld_cor_alco "Successive restarts correction factor for flex fuel" VALUE 0xa0021ce5 _REC_S1VAL_20_u1 0.99609375 _CNV_A_R_LINEAR_____130_CM 3.90625e-003 1. FORMAT "%12.8" /end CHARACTERISTIC
/begin CHARACTERISTIC Cxx_run_ufld_ctr_inc1 "Number of tdc to count between two unflooding counter incrementations (validity during the beginning of running only)" VALUE 0xa0021ce6 _REC_S1VAL_20_u1 255. _CNV_A_R_LINEAR_____101_CM 0. 255. FORMAT "%3.0" /end CHARACTERISTIC
/begin CHARACTERISTIC Cxx_run_ufld_ctr_inc1_alco "Number of tdc to count between two unflooding counter incrementations for flex fuel" VALUE 0xa0021ce7 _REC_S1VAL_20_u1 255. _CNV_A_R_LINEAR_____101_CM 0. 255. FORMAT "%3.0" /end CHARACTERISTIC
/begin CHARACTERISTIC Cxx_run_ufld_ctr_inc2 "Number of tdc to count between two unflooding counter incrementations (valid only after a delay)" VALUE 0xa0021ce8 _REC_S1VAL_20_u1 255. _CNV_A_R_LINEAR_____101_CM 0. 255. FORMAT "%3.0" /end CHARACTERISTIC
/begin CHARACTERISTIC Cxx_run_ufld_ctr_inc2_alco "Number of tdc to count between two unflooding counter incrementations for flex fuel" VALUE 0xa0021ce9 _REC_S1VAL_20_u1 255. _CNV_A_R_LINEAR_____101_CM 0. 255. FORMAT "%3.0" /end CHARACTERISTIC
/begin CHARACTERISTIC Cxx_stal_rest_fac "Specific restart correction after engine stall" VALUE 0xa0021cea _REC_S1VAL_20_u1 0.99609375 _CNV_A_R_LINEAR_____130_CM 3.90625e-003 1. FORMAT "%12.8" /end CHARACTERISTIC
/begin CHARACTERISTIC Cxx_stop_rest_tco_thd "TCO value inhibiting the restart strategy" VALUE 0xa0021ce0 _REC_S1VAL_20_u2 240. _CNV_A_R_LINEAR_____110_CM -40. 200. FORMAT "%5.1" /end CHARACTERISTIC
/begin CHARACTERISTIC Cxx_stop_rest_ufld_thd "Unflooding counter value inhibiting the specific maintain of ECU power supply " VALUE 0xa0021ceb _REC_S1VAL_20_u1 255. _CNV_A_R_ECME_LINEA_0_CM 0. 255. FORMAT "%3.0" /end CHARACTERISTIC
/begin CHARACTERISTIC Cxx_stop_ufld_ctr_inc "Time to count between two unflooding counter incrementations (when engine is not running)" VALUE 0xa0021cec _REC_S1VAL_20_u1 51. _CNV_A_R_LINEAR_____321_CM 0. 51. FORMAT "%4.1" /end CHARACTERISTIC
/begin CHARACTERISTIC Ctp_tco_min_rest_cor_alco "Additive correction to the restart correction factor to avoid a too powerfull injection correction for flex-fuel" CURVE 0xa0034518 _REC_A1CUR_20_u1_u2 0.99609375 _CNV_A_R_LINEAR_____130_CM 3.90625e-003 1. FORMAT "%12.8"
 /begin AXIS_DESCR COM_AXIS Vxx_tco _CNV_A_R_LINEAR_____110_CM 9 -40. 200. FORMAT "%5.1" AXIS_PTS_REF Ctb_tco2 /end AXIS_DESCR
/end CHARACTERISTIC
/begin MEASUREMENT Vxx_tco_min_rest_cor_alco "Additive correction to the restart correction factor to avoid a too powerfull injection correction for flex-fuel" UBYTE _CNV_A_R_LINEAR_____130_CM 1 0. 3.90625e-003 1. ECU_ADDRESS 0xd0007096 FORMAT "%12.8" /end MEASUREMENT
/begin AXIS_PTS Ntb_mat "air temperature breakpoints table (17 breakpoints) [-40 -30 -20 -10 0 10 20 30 40 50 60 70 80 90 100 110 120]" 0xa0025eb4 Vxx_mat _REC_A2AXS_20_u2 240. _CNV_A_R_LINEAR_____110_CM 17 -40. 200. READ_ONLY FORMAT "%5.1" /end AXIS_PTS
/begin AXIS_PTS Ntb_tco "water temperature breakpoints table (17 breakpoints) [-40 -30 -20 -10 0 10 20 30 40 50 60 70 80 90 100 110 120]" 0xa0025ed8 Vxx_tco _REC_A2AXS_20_u2 240. _CNV_A_R_LINEAR_____110_CM 17 -40. 200. READ_ONLY FORMAT "%5.1" /end AXIS_PTS
/begin CHARACTERISTIC Cmp_n_prs_lean_ti_ofs "MAP giving the richness offset for the lean mode" MAP 0xa0025efc _REC_A1MAP_20_u1_u2_u2 0.99609375 _CNV_A_R_LINEAR_____322_CM -0.5 0.49609375 FORMAT "%9.6"
 /begin AXIS_DESCR COM_AXIS Vxx_n _CNV_A_R_ENSD_LINEA_22_CM 20 0. 16383.75 FORMAT "%8.2" AXIS_PTS_REF Ctb_n /end AXIS_DESCR
 /begin AXIS_DESCR COM_AXIS Vxx_eal _CNV_A_R_LINEAR_____53_CM 16 0. 3.99993896484375 FORMAT "%10.8" AXIS_PTS_REF Ctb_eal /end AXIS_DESCR
/end CHARACTERISTIC
/begin CHARACTERISTIC Cmp_n_prs_tco_ti_fac "MAP giving the the correction factor for the K offset depending on RPM and EAL" MAP 0xa002603c _REC_A1MAP_20_u1_u2_u2 1.9921875 _CNV_A_R_LINEAR_____240_CM -1. 0.9921875 FORMAT "%9.6"
 /begin AXIS_DESCR COM_AXIS Vxx_n _CNV_A_R_ENSD_LINEA_22_CM 20 0. 16383.75 FORMAT "%8.2" AXIS_PTS_REF Ctb_n /end AXIS_DESCR
 /begin AXIS_DESCR COM_AXIS Vxx_eal _CNV_A_R_LINEAR_____53_CM 16 0. 3.99993896484375 FORMAT "%10.8" AXIS_PTS_REF Ctb_eal /end AXIS_DESCR
/end CHARACTERISTIC
/begin CHARACTERISTIC Ctp_tco_lean_ti_ofs "additionnal offset depending on the water temperature for the lean mode" CURVE 0xa002617c _REC_A1CUR_20_u1_u2 0.99609375 _CNV_A_R_LINEAR_____322_CM -0.5 0.49609375 FORMAT "%9.6"
 /begin AXIS_DESCR COM_AXIS Vxx_tco _CNV_A_R_LINEAR_____110_CM 17 -40. 200. READ_ONLY FORMAT "%5.1" AXIS_PTS_REF Ntb_tco /end AXIS_DESCR
/end CHARACTERISTIC
/begin CHARACTERISTIC Ctp_tco_sta_rich_dec "Table giving the number of tdc between 2 decrease of the A offset (if initialized with the water temperature)" CURVE 0xa0026190 _REC_A1CUR_20_u1_u2 255. _CNV_A_R_LINEAR_____101_CM 0. 255. FORMAT "%3.0"
 /begin AXIS_DESCR COM_AXIS Vxx_tco _CNV_A_R_LINEAR_____110_CM 17 -40. 200. READ_ONLY FORMAT "%5.1" AXIS_PTS_REF Ntb_tco /end AXIS_DESCR
/end CHARACTERISTIC
/begin CHARACTERISTIC Ctp_tco_sta_ti_ofs "table giving the initial A offset depending on the water temperature" CURVE 0xa00261a4 _REC_A1CUR_20_u1_u2 1.9921875 _CNV_A_R_LINEAR_____42_CM 0. 1.9921875 FORMAT "%8.6"
 /begin AXIS_DESCR COM_AXIS Vxx_tco _CNV_A_R_LINEAR_____110_CM 17 -40. 200. READ_ONLY FORMAT "%5.1" AXIS_PTS_REF Ntb_tco /end AXIS_DESCR
/end CHARACTERISTIC
/begin CHARACTERISTIC Ctp_tco_ti_ofs1 "Table giving the B offset depending on the water temperature" CURVE 0xa00261b8 _REC_A1CUR_20_u1_u2 1.9921875 _CNV_A_R_LINEAR_____42_CM 0. 1.9921875 FORMAT "%8.6"
 /begin AXIS_DESCR COM_AXIS Vxx_tco _CNV_A_R_LINEAR_____110_CM 17 -40. 200. READ_ONLY FORMAT "%5.1" AXIS_PTS_REF Ntb_tco /end AXIS_DESCR
/end CHARACTERISTIC
/begin CHARACTERISTIC Ctp_tco_ti_ofs2 "Table giving the K offset depending on the water temperature" CURVE 0xa00261cc _REC_A1CUR_20_u1_u2 0.99609375 _CNV_A_R_LINEAR_____29_CM 0. 0.99609375 FORMAT "%5.3"
 /begin AXIS_DESCR COM_AXIS Vxx_tco _CNV_A_R_LINEAR_____110_CM 17 -40. 200. READ_ONLY FORMAT "%5.1" AXIS_PTS_REF Ntb_tco /end AXIS_DESCR
/end CHARACTERISTIC
/begin CHARACTERISTIC Ctp_tia_sta_ti_ofs "table giving the initial A offset depending on the air temperature" CURVE 0xa00261e0 _REC_A1CUR_20_u1_u2 1.9921875 _CNV_A_R_LINEAR_____42_CM 0. 1.9921875 FORMAT "%8.6"
 /begin AXIS_DESCR COM_AXIS Vxx_mat _CNV_A_R_LINEAR_____110_CM 17 -40. 200. READ_ONLY FORMAT "%5.1" AXIS_PTS_REF Ntb_mat /end AXIS_DESCR
/end CHARACTERISTIC
/begin MEASUREMENT Vbx_cata_wup_lean "Boolean of learn burn catalyst heating conditions" UBYTE _CNV_S_2_RANGE______3_CM 1 0. 0. 1. ECU_ADDRESS 0xd0006643 BIT_MASK 0x1 /end MEASUREMENT
/begin MEASUREMENT Vbx_sta_tco_ti_ofs_mod "choice to initialize the A factor with a term depending on the water temperature " UBYTE _CNV_S_2_RANGE______3_CM 1 0. 0. 1. ECU_ADDRESS 0xd0007790 BIT_MASK 0x1 /end MEASUREMENT
/begin MEASUREMENT Vbx_ti_cor_rest_pws_set "request of maintaining the microcontroller power suplly for a specific richness correction in case of restart" UBYTE _CNV_S_2_RANGE______3_CM 1 0. 0. 1. ECU_ADDRESS 0xd0006644 BIT_MASK 0x1 /end MEASUREMENT
/begin MEASUREMENT Vxx_sta_rich_tdc_dec_nr "frequency of A offset decrementation (every X tdc)" UBYTE _CNV_A_R_LINEAR_____101_CM 1 0. 0. 255. ECU_ADDRESS 0xd0006645 FORMAT "%3.0" /end MEASUREMENT
/begin MEASUREMENT Vxx_sta_tco_ti_ofs "after start richness factor" UWORD _CNV_A_R_LINEAR_____48_CM 1 0. 0. 1.99996948242188 ECU_ADDRESS 0xd0003f68 FORMAT "%7.5" /end MEASUREMENT
/begin MEASUREMENT Vxx_sta_tco_ti_ofs_init "Initial A offset after the starting mode" UBYTE _CNV_A_R_LINEAR_____42_CM 1 0. 0. 1.9921875 ECU_ADDRESS 0xd0006646 FORMAT "%8.6" /end MEASUREMENT
/begin MEASUREMENT Vxx_tco_lean_ti_fac "final richness factor in lean mode" UBYTE _CNV_A_R_LINEAR_____42_CM 1 0. 0. 1.9921875 ECU_ADDRESS 0xd0006647 FORMAT "%8.6" /end MEASUREMENT
/begin MEASUREMENT Vxx_tco_rich_ti_fac "final richness factor in rich mode" UWORD _CNV_A_R_LINEAR_____170_CM 1 0. 0.5 4.49993896484375 ECU_ADDRESS 0xd0003f6a FORMAT "%10.8" /end MEASUREMENT
/begin MEASUREMENT Vxx_tco_ti_cor "final richness factor in cold water temperature conditions" UWORD _CNV_A_R_LINEAR_____170_CM 1 0. 0.5 4.49993896484375 ECU_ADDRESS 0xd0003f6c FORMAT "%10.8" /end MEASUREMENT
/begin MEASUREMENT Vxx_tco_ti_cor_fil_ctr "transition factor for the lean mode <--> rich mode transition" UBYTE _CNV_A_R_LINEAR_____162_CM 1 0. 0. 1. ECU_ADDRESS 0xd0006648 FORMAT "%9.7" /end MEASUREMENT
/begin MEASUREMENT Vxx_tco_ti_fac "C factor" UBYTE _CNV_A_R_LINEAR_____240_CM 1 0. -1. 0.9921875 ECU_ADDRESS 0xd0006649 FORMAT "%9.6" /end MEASUREMENT
/begin MEASUREMENT Vxx_tco_ti_ofs1 "B offset" UBYTE _CNV_A_R_LINEAR_____42_CM 1 0. 0. 1.9921875 ECU_ADDRESS 0xd0007791 FORMAT "%8.6" /end MEASUREMENT
/begin MEASUREMENT Vxx_tco_ti_ofs2 "K offset" UBYTE _CNV_A_R_LINEAR_____29_CM 1 0. 0. 0.99609375 ECU_ADDRESS 0xd0007792 FORMAT "%5.3" /end MEASUREMENT
/begin CHARACTERISTIC Cxx_aper_rich_sta_tco_thd "water temperature under wich an overrichness is wanted (if no percolation stop)" VALUE 0xa0020d58 _REC_S1VAL_20_u2 240. _CNV_A_R_LINEAR_____110_CM -40. 200. FORMAT "%5.1" /end CHARACTERISTIC
/begin CHARACTERISTIC Cxx_aper_rich_sta_tia_thd "air temperature over which an overrichness is wanted (if percolation stop)" VALUE 0xa0020d5a _REC_S1VAL_20_u2 240. _CNV_A_R_LINEAR_____110_CM -40. 200. FORMAT "%5.1" /end CHARACTERISTIC
/begin CHARACTERISTIC Cxx_rest_mod_dsb_max_dly "maximum delay during which the A offset can't be initialized with the water temperature richness table if the anti-percolation fonction hasn't be enabled" VALUE 0xa0020d5c _REC_S1VAL_20_u2 6553.5 _CNV_A_R_LINEAR_____58_CM 0. 6553.5 FORMAT "%6.1" /end CHARACTERISTIC
/begin CHARACTERISTIC Cxx_rest_mod_dsb_tco_thd "Water temperature under which the engine can restart with the air temperature richness table" VALUE 0xa0020d5e _REC_S1VAL_20_u2 240. _CNV_A_R_LINEAR_____110_CM -40. 200. FORMAT "%5.1" /end CHARACTERISTIC
/begin CHARACTERISTIC Cxx_rich_sta_tco_thd "water temperature over wich an overrichness is wanted (if percolation stop)" VALUE 0xa0020d60 _REC_S1VAL_20_u2 240. _CNV_A_R_LINEAR_____110_CM -40. 200. FORMAT "%5.1" /end CHARACTERISTIC
/begin CHARACTERISTIC Cxx_rich_tia_thd "air temperature over wich an overrichness is wanted (if no percolation stop)" VALUE 0xa0020d62 _REC_S1VAL_20_u2 240. _CNV_A_R_LINEAR_____110_CM -40. 200. FORMAT "%5.1" /end CHARACTERISTIC
/begin CHARACTERISTIC Cxx_sta_rich_dec_nr "Number of tdc between 2 decrease of the A offset (if initialized with the air temperature)" VALUE 0xa0020d64 _REC_S1VAL_20_u1 255. _CNV_A_R_LINEAR_____101_CM 0. 255. FORMAT "%3.0" /end CHARACTERISTIC
/begin CHARACTERISTIC Cxx_sta_tco_ti_dec_fac "decreasing factor for the calculation of the A offset" VALUE 0xa0020d65 _REC_S1VAL_20_u1 0.99609375 _CNV_A_R_LINEAR_____29_CM 0. 0.99609375 FORMAT "%10.8" /end CHARACTERISTIC
/begin CHARACTERISTIC Cxx_sta_tco_ti_dec_fac_alco "decreasing factor for the calculation of the A offset for flex-fuel." VALUE 0xa0020d66 _REC_S1VAL_20_u1 0.99609375 _CNV_A_R_LINEAR_____29_CM 0. 0.99609375 FORMAT "%10.8" /end CHARACTERISTIC
/begin CHARACTERISTIC Cxx_sta_tco_ti_dec_rest_fac "Weight factor on the restart correction of the A-offset decrease (after Start)" VALUE 0xa0020d67 _REC_S1VAL_20_u1 1.9921875 _CNV_A_R_LINEAR_____240_CM -1. 0.9921875 FORMAT "%9.6" /end CHARACTERISTIC
/begin CHARACTERISTIC Cxx_sta_tco_ti_rest_fac "Ponderation factor applied on the correction factor for Re-start (Vxx_appl_rest_cor)" VALUE 0xa0020d68 _REC_S1VAL_20_u1 0.99609375 _CNV_A_R_LINEAR_____29_CM 0. 0.99609375 FORMAT "%10.8" /end CHARACTERISTIC
/begin CHARACTERISTIC Cxx_tco_ti_fil_nr "Value of decrease for the lean richness factor" VALUE 0xa0020d69 _REC_S1VAL_20_u1 0.99609375 _CNV_A_R_LINEAR_____29_CM 0. 0.99609375 FORMAT "%10.8" /end CHARACTERISTIC
/begin AXIS_PTS Ctb_n_sta "Engine speed breakpoints for the fuel injection mass calculation during start" 0xa0025e54 Vxx_n _REC_A2AXS_20_u2 16383.75 _CNV_A_R_ENSD_LINEA_22_CM 9 0. 16383.75 FORMAT "%8.2" /end AXIS_PTS
/begin CHARACTERISTIC Ctp_n_sta_fim_fac "Engine speed dependant correction for fuel injection mass calculation during start" CURVE 0xa0025e68 _REC_A1CUR_20_u1_u2 0.99609375 _CNV_A_R_LINEAR_____29_CM 0. 0.99609375 FORMAT "%5.3"
 /begin AXIS_DESCR COM_AXIS Vxx_n _CNV_A_R_ENSD_LINEA_22_CM 9 0. 16383.75 FORMAT "%8.2" AXIS_PTS_REF Ctb_n_sta /end AXIS_DESCR
/end CHARACTERISTIC
/begin CHARACTERISTIC Ctp_tco_dec_sta_fim "Cooling temperature dependant decrementation value of Fuel Injection Mass just after start" CURVE 0xa0025e74 _REC_A1CUR_20_u2_u2 167.7696 _CNV_A_R_LINEAR_____133_CM 0. 167.7696 FORMAT "%9.5"
 /begin AXIS_DESCR COM_AXIS Vxx_tco _CNV_A_R_LINEAR_____110_CM 16 -40. 200. FORMAT "%5.1" AXIS_PTS_REF Ctb_tco /end AXIS_DESCR
/end CHARACTERISTIC
/begin CHARACTERISTIC Ctp_tco_sta_fim "Cooling temperature dependant table for Fuel Injection Mass during start" CURVE 0xa0025e94 _REC_A1CUR_20_u2_u2 4799.93856 _CNV_A_R_LINEAR_____323_CM 0. 4799.93856 FORMAT "%7.2"
 /begin AXIS_DESCR COM_AXIS Vxx_tco _CNV_A_R_LINEAR_____110_CM 16 -40. 200. FORMAT "%5.1" AXIS_PTS_REF Ctb_tco /end AXIS_DESCR
/end CHARACTERISTIC
/begin MEASUREMENT Vbx_tdc_sta_fim_ena "Boolean enabling sta_fim decrementation at TDC" UBYTE _CNV_S_2_RANGE______3_CM 1 0. 0. 1. ECU_ADDRESS 0xd0006634 BIT_MASK 0x1 /end MEASUREMENT
/begin MEASUREMENT Vxx_dec_sta_fim "Fuel injection Mass decrementation just after start" UWORD _CNV_A_R_LINEAR_____133_CM 1 0. 0. 167.7696 ECU_ADDRESS 0xd0003f62 FORMAT "%9.5" /end MEASUREMENT
/begin MEASUREMENT Vxx_sta_fim "Injected fuel mass setpoint disrigarding cylinder (wall wetting to be added) for start" ULONG _CNV_A_R_LINEAR_____133_CM 1 0. 0. 4800. ECU_ADDRESS 0xd00024e8 FORMAT "%14.5" /end MEASUREMENT
/begin CHARACTERISTIC Cxx_dec_sta_ti_rest_fac "Starting fuel mass Decrementation restart factor" VALUE 0xa0020d56 _REC_S1VAL_20_u1 1.9921875 _CNV_A_R_LINEAR_____240_CM -1. 0.9921875 FORMAT "%9.6" /end CHARACTERISTIC
/begin AXIS_PTS Ctb_eal_cylr "Table of 17 eal breakpoints specific for cylinder recognition" 0xa0025c6c Vxx_eal _REC_A2AXS_20_u2 3.99993896484375 _CNV_A_R_LINEAR_____53_CM 17 0. 3.99993896484375 FORMAT "%7.5" /end AXIS_PTS
/begin AXIS_PTS Ctb_n_cylr "Table of 9 engine speed breakpoints specific for cylinder recognition" 0xa0025c90 Vxx_n _REC_A2AXS_20_u2 16383.75 _CNV_A_R_ENSD_LINEA_22_CM 9 0. 16383.75 FORMAT "%8.2" /end AXIS_PTS
/begin AXIS_PTS Ctb_tco_ti_fac2 "A 9 water enrichment factor breackpoints table " 0xa0025ca4 Vxx_tco_ti_cor _REC_A2AXS_20_u2 3.99993896484375 _CNV_A_R_LINEAR_____170_CM 9 0.5 4.49993896484375 FORMAT "%10.8" /end AXIS_PTS
/begin CHARACTERISTIC Cmp_eal_n_lean_cylr "Map of the lean richness factor during cylinder recognition" MAP 0xa0025cb8 _REC_A1MAP_20_u1_u2_u2 0.99609375 _CNV_A_R_LINEAR_____130_CM 3.90625e-003 1. FORMAT "%12.8"
 /begin AXIS_DESCR COM_AXIS Vxx_eal _CNV_A_R_LINEAR_____53_CM 17 0. 3.99993896484375 FORMAT "%7.5" AXIS_PTS_REF Ctb_eal_cylr /end AXIS_DESCR
 /begin AXIS_DESCR COM_AXIS Vxx_n _CNV_A_R_ENSD_LINEA_22_CM 9 0. 16383.75 FORMAT "%8.2" AXIS_PTS_REF Ctb_n_cylr /end AXIS_DESCR
/end CHARACTERISTIC
/begin CHARACTERISTIC Cmp_eal_n_rich_cylr "Map of the rich richness factor during cylinder recognition" MAP 0xa0025d54 _REC_A1MAP_20_u1_u2_u2 0.99609375 _CNV_A_R_LINEAR_____153_CM 1. 1.99609375 FORMAT "%10.8"
 /begin AXIS_DESCR COM_AXIS Vxx_eal _CNV_A_R_LINEAR_____53_CM 17 0. 3.99993896484375 FORMAT "%7.5" AXIS_PTS_REF Ctb_eal_cylr /end AXIS_DESCR
 /begin AXIS_DESCR COM_AXIS Vxx_n _CNV_A_R_ENSD_LINEA_22_CM 9 0. 16383.75 FORMAT "%8.2" AXIS_PTS_REF Ctb_n_cylr /end AXIS_DESCR
/end CHARACTERISTIC
/begin CHARACTERISTIC Ctp_cl_is_lean_cylr "Richness factor for lean cylinders during cylinder recognition, Iddle Speed and closed loop" CURVE 0xa0025df0 _REC_A1CUR_20_u1_u2 0.99609375 _CNV_A_R_LINEAR_____130_CM 3.90625e-003 1. FORMAT "%12.8"
 /begin AXIS_DESCR COM_AXIS Vxx_tco _CNV_A_R_LINEAR_____110_CM 9 -40. 200. FORMAT "%5.1" AXIS_PTS_REF Ctb_tco2 /end AXIS_DESCR
/end CHARACTERISTIC
/begin CHARACTERISTIC Ctp_cl_is_rich_cylr "Richness factor for rich cylinders during cylinder recognition, Iddle Speed and closed loop" CURVE 0xa0025dfc _REC_A1CUR_20_u1_u2 0.99609375 _CNV_A_R_LINEAR_____153_CM 1. 1.99609375 FORMAT "%10.8"
 /begin AXIS_DESCR COM_AXIS Vxx_tco _CNV_A_R_LINEAR_____110_CM 9 -40. 200. FORMAT "%5.1" AXIS_PTS_REF Ctb_tco2 /end AXIS_DESCR
/end CHARACTERISTIC
/begin CHARACTERISTIC Ctp_ol_is_lean_cylr "Richness factor for lean cylinders during cylinder recognition, Iddle Speed and open loop" CURVE 0xa0025e08 _REC_A1CUR_20_u1_u2 0.99609375 _CNV_A_R_LINEAR_____130_CM 3.90625e-003 1. FORMAT "%12.8"
 /begin AXIS_DESCR COM_AXIS Vxx_tco _CNV_A_R_LINEAR_____110_CM 9 -40. 200. FORMAT "%5.1" AXIS_PTS_REF Ctb_tco2 /end AXIS_DESCR
/end CHARACTERISTIC
/begin CHARACTERISTIC Ctp_ol_is_rich_cylr "Richness factor for rich cylinders during cylinder recognition, Iddle Speed and open loop" CURVE 0xa0025e14 _REC_A1CUR_20_u1_u2 0.99609375 _CNV_A_R_LINEAR_____153_CM 1. 1.99609375 FORMAT "%10.8"
 /begin AXIS_DESCR COM_AXIS Vxx_tco _CNV_A_R_LINEAR_____110_CM 9 -40. 200. FORMAT "%5.1" AXIS_PTS_REF Ctb_tco2 /end AXIS_DESCR
/end CHARACTERISTIC
/begin CHARACTERISTIC Ctp_tco_lean_cylr "Richness factor for lean cylinders during cylinder recognition, engine cold and open loop" CURVE 0xa0025e20 _REC_A1CUR_20_u1_u2 0.99609375 _CNV_A_R_LINEAR_____130_CM 3.90625e-003 1. FORMAT "%12.8"
 /begin AXIS_DESCR COM_AXIS Vxx_tco_ti_cor _CNV_A_R_LINEAR_____170_CM 9 0.5 4.49993896484375 FORMAT "%10.8" AXIS_PTS_REF Ctb_tco_ti_fac2 /end AXIS_DESCR
/end CHARACTERISTIC
/begin CHARACTERISTIC Ctp_tco_rich_cylr "Richness factor for rich cylinders during cylinder recognition, Engine cold and open loop" CURVE 0xa0025e2c _REC_A1CUR_20_u1_u2 0.99609375 _CNV_A_R_LINEAR_____153_CM 1. 1.99609375 FORMAT "%10.8"
 /begin AXIS_DESCR COM_AXIS Vxx_tco_ti_cor _CNV_A_R_LINEAR_____170_CM 9 0.5 4.49993896484375 FORMAT "%10.8" AXIS_PTS_REF Ctb_tco_ti_fac2 /end AXIS_DESCR
/end CHARACTERISTIC
/begin CHARACTERISTIC Ctp_tco_sta_out_sfg_dly "Table giving the number of TDC  between start mode exit and first sequential transition" CURVE 0xa0025e38 _REC_A1CUR_20_u1_u2 255. _CNV_A_R_LINEAR_____101_CM 0. 255. FORMAT "%3.0"
 /begin AXIS_DESCR COM_AXIS Vxx_tco _CNV_A_R_LINEAR_____110_CM 9 -40. 200. FORMAT "%5.1" AXIS_PTS_REF Ctb_tco2 /end AXIS_DESCR
/end CHARACTERISTIC
/begin MEASUREMENT Vbx_inj_efv_seq "Boolean indicating that sequential mode is activated on all cylinders" UBYTE _CNV_S_2_RANGE______3_CM 1 0. 0. 1. ECU_ADDRESS 0xd0006624 BIT_MASK 0x1 /end MEASUREMENT
/begin MEASUREMENT Vsx_inj_stt "Injection mode." UWORD _CNV_A_R_ECME_LINEA_0_CM 1 0. 0. 65535. ECU_ADDRESS 0xd0003f54 FORMAT "%5.0" /end MEASUREMENT
/begin MEASUREMENT Vsx_inj_stt_cyl1 "Injection mode for cylinder 1." UWORD _CNV_A_R_ECME_LINEA_0_CM 1 0. 0. 65535. ECU_ADDRESS 0xd0003f56 FORMAT "%5.0" /end MEASUREMENT
/begin MEASUREMENT Vsx_inj_stt_cyl2 "Injection mode for cylinder 2." UWORD _CNV_A_R_ECME_LINEA_0_CM 1 0. 0. 65535. ECU_ADDRESS 0xd0003f58 FORMAT "%5.0" /end MEASUREMENT
/begin MEASUREMENT Vsx_inj_stt_cyl3 "Injection mode for cylinder 3." UWORD _CNV_A_R_ECME_LINEA_0_CM 1 0. 0. 65535. ECU_ADDRESS 0xd0003f5a FORMAT "%5.0" /end MEASUREMENT
/begin MEASUREMENT Vsx_inj_stt_cyl4 "Injection mode for cylinder 4." UWORD _CNV_A_R_ECME_LINEA_0_CM 1 0. 0. 65535. ECU_ADDRESS 0xd0003f5c FORMAT "%5.0" /end MEASUREMENT
/begin MEASUREMENT Vxx_adac_fim "Injected fuel mass for ADAC (fuel consumption)" ULONG _CNV_A_R_LINEAR_____133_CM 1 0. 0. 4800. ECU_ADDRESS 0xd00024c4 FORMAT "%12.3" /end MEASUREMENT
/begin MEASUREMENT Vxx_cyl1_fim1 "Injected fuel mass on cylinder 1, first injection" ULONG _CNV_A_R_LINEAR_____133_CM 1 0. 0. 4800. ECU_ADDRESS 0xd00024c8 FORMAT "%12.3" /end MEASUREMENT
/begin MEASUREMENT Vxx_cyl1_fim2 "Injected fuel mass on cylinder 1, second injection" ULONG _CNV_A_R_LINEAR_____133_CM 1 0. 0. 4800. ECU_ADDRESS 0xd00024cc FORMAT "%12.3" /end MEASUREMENT
/begin MEASUREMENT Vxx_cyl2_fim1 "Injected fuel mass on cylinder 2, first injection" ULONG _CNV_A_R_LINEAR_____133_CM 1 0. 0. 4800. ECU_ADDRESS 0xd00024d0 FORMAT "%12.3" /end MEASUREMENT
/begin MEASUREMENT Vxx_cyl2_fim2 "Injected fuel mass on cylinder 2, second injection" ULONG _CNV_A_R_LINEAR_____133_CM 1 0. 0. 4800. ECU_ADDRESS 0xd00024d4 FORMAT "%12.3" /end MEASUREMENT
/begin MEASUREMENT Vxx_cyl3_fim1 "Injected fuel mass on cylinder 3, first injection" ULONG _CNV_A_R_LINEAR_____133_CM 1 0. 0. 4800. ECU_ADDRESS 0xd00024d8 FORMAT "%12.3" /end MEASUREMENT
/begin MEASUREMENT Vxx_cyl3_fim2 "Injected fuel mass on cylinder 3, second injection" ULONG _CNV_A_R_LINEAR_____133_CM 1 0. 0. 4800. ECU_ADDRESS 0xd00024dc FORMAT "%12.3" /end MEASUREMENT
/begin MEASUREMENT Vxx_cyl4_fim1 "Injected fuel mass on cylinder 4, first injection" ULONG _CNV_A_R_LINEAR_____133_CM 1 0. 0. 4800. ECU_ADDRESS 0xd00024e0 FORMAT "%12.3" /end MEASUREMENT
/begin MEASUREMENT Vxx_cyl4_fim2 "Injected fuel mass on cylinder 4, second injection" ULONG _CNV_A_R_LINEAR_____133_CM 1 0. 0. 4800. ECU_ADDRESS 0xd00024e4 FORMAT "%12.3" /end MEASUREMENT
/begin MEASUREMENT Vxx_cylr_lean_fac "Internal variable giving the lean richness factor depending on engine state for cyl reco." UBYTE _CNV_A_R_LINEAR_____130_CM 1 0. 3.90625e-003 1. ECU_ADDRESS 0xd0006625 FORMAT "%12.8" /end MEASUREMENT
/begin MEASUREMENT Vxx_cylr_rich_fac "Internal variable giving the rich richness factor depending on engine state for cyl reco." UBYTE _CNV_A_R_LINEAR_____153_CM 1 0. 1. 1.99609375 ECU_ADDRESS 0xd0006626 FORMAT "%10.8" /end MEASUREMENT
/begin MEASUREMENT Vxx_sfg_seq_trs_ctr "TDC counter between the sfg to sequential transitions." UBYTE _CNV_A_R_LINEAR_____101_CM 1 0. 0. 255. ECU_ADDRESS 0xd0006627 FORMAT "%3.0" /end MEASUREMENT
/begin MEASUREMENT Vxx_sta_out_sfg_ti_ctr "TDC counter between start phase exit and first transition sfg to sequential" UBYTE _CNV_A_R_LINEAR_____101_CM 1 0. 0. 255. ECU_ADDRESS 0xd0006628 FORMAT "%3.0" /end MEASUREMENT
/begin MEASUREMENT Vxx_sta_out_sfg_ti_ctr_ini "Init value for the TDC counter between start phase exit and first transition sfg to sequential" UBYTE _CNV_A_R_LINEAR_____101_CM 1 0. 0. 255. ECU_ADDRESS 0xd0006629 FORMAT "%3.0" /end MEASUREMENT
/begin CHARACTERISTIC Cbx_inj_seq_sta "Engine will start in sequential injection mode instead of pre-inj & semi full group" VALUE 0xa0020d3a _REC_S1VAL_20_u1 1. _CNV_A_R_ECME_LINEA_0_CM 0. 1. FORMAT "%1.0" BIT_MASK 0x1 /end CHARACTERISTIC
/begin CHARACTERISTIC Cbx_inj_stt_tdc_ena "Activation of the computation of injection patterns at the event_tdc before sequential mode" VALUE 0xa0020d3b _REC_S1VAL_20_u1 1. _CNV_A_R_ECME_LINEA_0_CM 0. 1. FORMAT "%1.0" BIT_MASK 0x1 /end CHARACTERISTIC
/begin CHARACTERISTIC Cbx_sfg_bch_cfm "Disables the sequential mode after start" VALUE 0xa0020d3c _REC_S1VAL_20_u1 1. _CNV_A_R_ECME_LINEA_0_CM 0. 1. FORMAT "%1.0" BIT_MASK 0x1 /end CHARACTERISTIC
/begin CHARACTERISTIC Cxx_cyl_nr "Number of cylinders" VALUE 0xa0020d3d _REC_S1VAL_20_u1 12. _CNV_A_R_ECME_LINEA_0_CM 0. 12. FORMAT "%2.0" /end CHARACTERISTIC
/begin CHARACTERISTIC Cxx_cylr_tco_thd "Coolant temp threshold underwhich cylinder recognition is in cold settings." VALUE 0xa0020d36 _REC_S1VAL_20_u2 240. _CNV_A_R_LINEAR_____110_CM -40. 200. FORMAT "%5.1" /end CHARACTERISTIC
/begin CHARACTERISTIC Cxx_sfg_seq_trs_ctr "Number of TDC during sfg to sequential transition on each cylinder" VALUE 0xa0020d3e _REC_S1VAL_20_u1 252. _CNV_A_R_LINEAR_____324_CM 0. 252. FORMAT "%4.0" /end CHARACTERISTIC
/begin CHARACTERISTIC Cxx_sfg_seq_trs_fim_fac "Factor applied on first injection during the transition cycle on an injector" VALUE 0xa0020d3f _REC_S1VAL_20_u1 0.99609375 _CNV_A_R_LINEAR_____29_CM 0. 0.99609375 FORMAT "%10.8" /end CHARACTERISTIC
/begin CHARACTERISTIC Cxx_sfg_seq_trs_n_thd "Engine speed threshold over which sfg to sequential transition is authorized" VALUE 0xa0020d38 _REC_S1VAL_20_u2 16383.75 _CNV_A_R_ENSD_LINEA_22_CM 0. 16383.75 FORMAT "%8.2" /end CHARACTERISTIC
/begin CHARACTERISTIC Cxx_tco_fail_sta_out_sfg_dly "Number of TDC between start mode exit and first sequential transition when failure on TCO" VALUE 0xa0020d40 _REC_S1VAL_20_u1 255. _CNV_A_R_LINEAR_____101_CM 0. 255. FORMAT "%3.0" /end CHARACTERISTIC
/begin AXIS_PTS Ctb_vvtc_angl "16 breakpoints table for vvtc angle" 0xa0025878 Vxx_in_vvtc_angl _REC_A2AXS_20_u2 719.98 _CNV_A_R_LINEAR_____129_CM 6 0. 719.98 FORMAT "%6.2" /end AXIS_PTS
/begin CHARACTERISTIC Cmp_perf_inj_clos_angl "Engine speed and vvt angle dependant Injector Closure advance optimized for engine performance" MAP 0xa0025888 _REC_A1MAP_20_u1_u2_u2 765. _CNV_A_R_LINEAR_____325_CM 0. 765. FORMAT "%3.0"
 /begin AXIS_DESCR COM_AXIS Vxx_n _CNV_A_R_ENSD_LINEA_22_CM 20 0. 16383.75 FORMAT "%8.2" AXIS_PTS_REF Ctb_n /end AXIS_DESCR
 /begin AXIS_DESCR COM_AXIS Vxx_in_vvtc_angl _CNV_A_R_LINEAR_____129_CM 6 0. 719.98 FORMAT "%6.2" AXIS_PTS_REF Ctb_vvtc_angl /end AXIS_DESCR
/end CHARACTERISTIC
/begin CHARACTERISTIC Cmp_polu_inj_clos_angl "Engine speed and vvtc angle dependant Injector Closure advance optimized to minimize polution" MAP 0xa0025900 _REC_A1MAP_20_u1_u2_u2 765. _CNV_A_R_LINEAR_____325_CM 0. 765. FORMAT "%3.0"
 /begin AXIS_DESCR COM_AXIS Vxx_n _CNV_A_R_ENSD_LINEA_22_CM 20 0. 16383.75 FORMAT "%8.2" AXIS_PTS_REF Ctb_n /end AXIS_DESCR
 /begin AXIS_DESCR COM_AXIS Vxx_in_vvtc_angl _CNV_A_R_LINEAR_____129_CM 6 0. 719.98 FORMAT "%6.2" AXIS_PTS_REF Ctb_vvtc_angl /end AXIS_DESCR
/end CHARACTERISTIC
/begin CHARACTERISTIC Ctp_n_clos_angl_tq_rat_thd "Table depending on engine speed giving the torque ratio threshold to " CURVE 0xa0025978 _REC_A1CUR_20_u2_u2 1. _CNV_A_R_LINEAR_____183_CM 0. 1. FORMAT "%11.9"
 /begin AXIS_DESCR COM_AXIS Vxx_n _CNV_A_R_ENSD_LINEA_22_CM 20 0. 16383.75 FORMAT "%8.2" AXIS_PTS_REF Ctb_n /end AXIS_DESCR
/end CHARACTERISTIC
/begin MEASUREMENT Vxx_fil_inj_clos_angl_fac "Filtering factor to switch between polu and perfo closure advance tables" SWORD _CNV_A_R_LINEAR_____29_CM 1 0. 0. 1. ECU_ADDRESS 0xd0003f4a FORMAT "%9.6" /end MEASUREMENT
/begin MEASUREMENT Vxx_fil_inj_clos_angl_fac_inc "Filtering factor incrementation (or dec.) to switch between perfo and polu closure advance tables" SWORD _CNV_A_R_LINEAR_____29_CM 1 0. -1. 1. ECU_ADDRESS 0xd0003f4c FORMAT "%9.6" /end MEASUREMENT
/begin MEASUREMENT Vxx_inj_clos_angl "Injector closure advance set point" UBYTE _CNV_A_R_LINEAR_____325_CM 1 0. 0. 765. ECU_ADDRESS 0xd0006608 FORMAT "%3.0" /end MEASUREMENT
/begin CHARACTERISTIC Cbx_inj_clos_angl_bch_cfm "Bench mode selection for injector closure advance" VALUE 0xa0020d26 _REC_S1VAL_20_u1 1. _CNV_A_R_ECME_LINEA_0_CM 0. 1. FORMAT "%1.0" BIT_MASK 0x1 /end CHARACTERISTIC
/begin CHARACTERISTIC Cxx_fil_perf_clos_angl_tdc_nr "TDC number to count in order to switch from polu to perfo injector closure advance tables" VALUE 0xa0020d20 _REC_S1VAL_20_u2 255. _CNV_A_R_ECME_LINEA_0_CM 1. 256. FORMAT "%5.0" /end CHARACTERISTIC
/begin CHARACTERISTIC Cxx_fil_polu_clos_angl_tdc_nr "TDC number to count in order to switch from perfo to polu injector closure advance tables" VALUE 0xa0020d22 _REC_S1VAL_20_u2 255. _CNV_A_R_ECME_LINEA_0_CM 1. 256. FORMAT "%5.0" /end CHARACTERISTIC
/begin CHARACTERISTIC Cxx_inj_clos_angl_bch "Injector closure advance for bench mode" VALUE 0xa0020d27 _REC_S1VAL_20_u1 765. _CNV_A_R_LINEAR_____325_CM 0. 765. FORMAT "%3.0" /end CHARACTERISTIC
/begin CHARACTERISTIC Cxx_perf_inj_tco_thd "Minimum coolant temperature available for using perfo Injector Closure advance table" VALUE 0xa0020d24 _REC_S1VAL_20_u2 240. _CNV_A_R_LINEAR_____110_CM -40. 200. FORMAT "%5.1" /end CHARACTERISTIC
/begin MEASUREMENT Vxx_fim_sp "Injected fuel mass setpoint disrigarding cylinder (wall wetting to be added)" ULONG _CNV_A_R_LINEAR_____133_CM 1 0. 0. 4800. ECU_ADDRESS 0xd00024c0 FORMAT "%12.3" /end MEASUREMENT
/begin MEASUREMENT Vxx_rich_sp "Estimated richness setpoint." UWORD _CNV_A_R_LINEAR_____48_CM 1 0. 0. 1.99996948242188 ECU_ADDRESS 0xd0003f52 FORMAT "%7.5" /end MEASUREMENT
/begin CHARACTERISTIC Cbx_fim_bch "Bench mode activation for Vxx_fim_sp" VALUE 0xa0020d2c _REC_S1VAL_20_u1 1. _CNV_A_R_ECME_LINEA_0_CM 0. 1. FORMAT "%1.0" BIT_MASK 0x1 /end CHARACTERISTIC
/begin CHARACTERISTIC Cxx_fim_bch "Fuel mass bench mode (Vxx_fim_sp)" VALUE 0xa0020d28 _REC_S1VAL_20_u4 4800. _CNV_A_R_LINEAR_____133_CM 0. 4800. FORMAT "%12.3" /end CHARACTERISTIC
/begin CHARACTERISTIC Cxx_stoe_rat "Stoechiometric ratio for gazoline" VALUE 0xa0020d2d _REC_S1VAL_20_u1 19.921875 _CNV_A_R_LINEAR_____326_CM 7.8125e-002 20. FORMAT "%8.6" /end CHARACTERISTIC
/begin CHARACTERISTIC Cxx_stoe_rat_alco "Stoechiometric ratio for exotic fuel" VALUE 0xa0020d2e _REC_S1VAL_20_u1 19.921875 _CNV_A_R_LINEAR_____326_CM 7.8125e-002 20. FORMAT "%8.6" /end CHARACTERISTIC
/begin AXIS_PTS Ctb_prs_dif_ti "breakpoints for injector nozzle pressure difference" 0xa00259a0 Vxx_prs_dif_ti _REC_A2AXS_20_u2 20000. _CNV_A_R_LINEAR_____158_CM 17 -10000. 10000. FORMAT "%6.0" /end AXIS_PTS
/begin CHARACTERISTIC Cmp_prs_dif_ti_cor "injection time correction factor according to the injector pressure difference" MAP 0xa00259c4 _REC_A1MAP_20_u2_u2_u2 1.999969482 _CNV_A_R_LINEAR_____147_CM 0. 1.999969482 FORMAT "%10.8"
 /begin AXIS_DESCR COM_AXIS Vxx_n _CNV_A_R_ENSD_LINEA_22_CM 20 0. 16383.75 FORMAT "%8.2" AXIS_PTS_REF Ctb_n /end AXIS_DESCR
 /begin AXIS_DESCR COM_AXIS Vxx_prs_dif_ti _CNV_A_R_LINEAR_____158_CM 17 -10000. 10000. FORMAT "%6.0" AXIS_PTS_REF Ctb_prs_dif_ti /end AXIS_DESCR
/end CHARACTERISTIC
/begin MEASUREMENT Vxx_prs_dif_ti "injector nozzle pressure difference" UWORD _CNV_A_R_LINEAR_____158_CM 1 0. -10000. 10000. ECU_ADDRESS 0xd0003f4e FORMAT "%6.0" /end MEASUREMENT
/begin MEASUREMENT Vxx_prs_dif_ti_cor "Nozzle pressure correction factor" UWORD _CNV_A_R_LINEAR_____147_CM 1 0. 0. 1.999969482 ECU_ADDRESS 0xd0003f50 FORMAT "%10.8" /end MEASUREMENT
/begin MEASUREMENT Vbx_dft_inj1_cut "Injector of cylinder 1 deactivated due to a default on the cylinder (spark, coil, injector...)" UBYTE _CNV_S_2_RANGE______3_CM 1 0. 0. 1. ECU_ADDRESS 0xd000660b BIT_MASK 0x1 /end MEASUREMENT
/begin MEASUREMENT Vbx_dft_inj2_cut "Injector of cylinder 2 deactivated due to a default on the cylinder (spark, coil, injector...)" UBYTE _CNV_S_2_RANGE______3_CM 1 0. 0. 1. ECU_ADDRESS 0xd000660c BIT_MASK 0x1 /end MEASUREMENT
/begin MEASUREMENT Vbx_dft_inj3_cut "Injector of cylinder 3 deactivated due to a default on the cylinder (spark, coil, injector...)" UBYTE _CNV_S_2_RANGE______3_CM 1 0. 0. 1. ECU_ADDRESS 0xd000660d BIT_MASK 0x1 /end MEASUREMENT
/begin MEASUREMENT Vbx_dft_inj4_cut "Injector of cylinder 4 deactivated due to a default on the cylinder (spark, coil, injector...)" UBYTE _CNV_S_2_RANGE______3_CM 1 0. 0. 1. ECU_ADDRESS 0xd000660e BIT_MASK 0x1 /end MEASUREMENT
/begin MEASUREMENT Vbx_inj1_cut "Cut command for cylinder 1 injector. Applied on next opening." UBYTE _CNV_S_2_RANGE______3_CM 1 0. 0. 1. ECU_ADDRESS 0xd000660f BIT_MASK 0x1 /end MEASUREMENT
/begin MEASUREMENT Vbx_inj1_cut_req "Cut request for injector 1 not related to limp home or defaults" UBYTE _CNV_S_2_RANGE______3_CM 1 0. 0. 1. ECU_ADDRESS 0xd0006610 BIT_MASK 0x1 /end MEASUREMENT
/begin MEASUREMENT Vbx_inj2_cut "Cut command for cylinder 2 injector. Applied on next opening." UBYTE _CNV_S_2_RANGE______3_CM 1 0. 0. 1. ECU_ADDRESS 0xd0006611 BIT_MASK 0x1 /end MEASUREMENT
/begin MEASUREMENT Vbx_inj2_cut_req "Cut request for injector 2 not related to limp home or defaults" UBYTE _CNV_S_2_RANGE______3_CM 1 0. 0. 1. ECU_ADDRESS 0xd0006612 BIT_MASK 0x1 /end MEASUREMENT
/begin MEASUREMENT Vbx_inj3_cut "Cut command for cylinder 3 injector. Applied on next opening." UBYTE _CNV_S_2_RANGE______3_CM 1 0. 0. 1. ECU_ADDRESS 0xd0006613 BIT_MASK 0x1 /end MEASUREMENT
/begin MEASUREMENT Vbx_inj3_cut_req "Cut request for injector 3 not related to limp home or defaults" UBYTE _CNV_S_2_RANGE______3_CM 1 0. 0. 1. ECU_ADDRESS 0xd0006614 BIT_MASK 0x1 /end MEASUREMENT
/begin MEASUREMENT Vbx_inj4_cut "Cut command for cylinder 4 injector. Applied on next opening." UBYTE _CNV_S_2_RANGE______3_CM 1 0. 0. 1. ECU_ADDRESS 0xd0006615 BIT_MASK 0x1 /end MEASUREMENT
/begin MEASUREMENT Vbx_inj4_cut_req "Cut request for injector 4 not related to limp home or defaults" UBYTE _CNV_S_2_RANGE______3_CM 1 0. 0. 1. ECU_ADDRESS 0xd0006616 BIT_MASK 0x1 /end MEASUREMENT
/begin MEASUREMENT Vbx_inj_cut_rst "Reset on key of the injectors cut requests" UBYTE _CNV_S_2_RANGE______3_CM 1 0. 0. 1. ECU_ADDRESS 0xd0006617 BIT_MASK 0x1 /end MEASUREMENT
/begin MEASUREMENT Vbx_inj_ena "Indicator of injection authorization (not cut)" UBYTE _CNV_S_2_RANGE______3_CM 1 0. 0. 1. ECU_ADDRESS 0xd0006618 BIT_MASK 0x1 /end MEASUREMENT
/begin MEASUREMENT Vbx_lih_inj1_cut_req "Limp home cut request for cylinder 1" UBYTE _CNV_S_2_RANGE______3_CM 1 0. 0. 1. ECU_ADDRESS 0xd0006619 BIT_MASK 0x1 /end MEASUREMENT
/begin MEASUREMENT Vbx_lih_inj2_cut_req "Limp home cut request for cylinder 2" UBYTE _CNV_S_2_RANGE______3_CM 1 0. 0. 1. ECU_ADDRESS 0xd000661a BIT_MASK 0x1 /end MEASUREMENT
/begin MEASUREMENT Vbx_lih_inj3_cut_req "Limp home cut request for cylinder 3" UBYTE _CNV_S_2_RANGE______3_CM 1 0. 0. 1. ECU_ADDRESS 0xd000661b BIT_MASK 0x1 /end MEASUREMENT
/begin MEASUREMENT Vbx_lih_inj4_cut_req "Limp home cut request for cylinder 4" UBYTE _CNV_S_2_RANGE______3_CM 1 0. 0. 1. ECU_ADDRESS 0xd000661c BIT_MASK 0x1 /end MEASUREMENT
/begin MEASUREMENT Vxx_efv_inj_cut_nr "Effective number of injector currently disabled." UBYTE _CNV_A_R_ECME_LINEA_0_CM 1 0. 0. 12. ECU_ADDRESS 0xd000661d FORMAT "%2.0" /end MEASUREMENT
/begin MEASUREMENT Vxx_efv_req_inj_cut_nr "Number of cylinder" UBYTE _CNV_A_R_ECME_LINEA_0_CM 1 0. 0. 12. ECU_ADDRESS 0xd000661e FORMAT "%2.0" /end MEASUREMENT
/begin MEASUREMENT Vxx_inj_avl_nr "Number of available cylinders. (Only failures decrease the number)" UBYTE _CNV_A_R_ECME_LINEA_0_CM 1 0. 0. 12. ECU_ADDRESS 0xd000661f FORMAT "%2.0" /end MEASUREMENT
/begin MEASUREMENT Vxx_inj_cut_nr "Number of cylinder cut" UBYTE _CNV_A_R_ECME_LINEA_0_CM 1 0. 0. 12. ECU_ADDRESS 0xd0006620 FORMAT "%2.0" /end MEASUREMENT
/begin MEASUREMENT Vxx_next_inj_cut_tdc_nr "Number of the next injector that can be cut." UBYTE _CNV_A_R_ECME_LINEA_0_CM 1 0. 0. 12. ECU_ADDRESS 0xd0006621 FORMAT "%2.0" /end MEASUREMENT
/begin MEASUREMENT Vxx_next_inj_open_tdc_nr "Number of the next injector that can be opened." UBYTE _CNV_A_R_ECME_LINEA_0_CM 1 0. 0. 12. ECU_ADDRESS 0xd0006622 FORMAT "%2.0" /end MEASUREMENT
/begin MEASUREMENT Vxx_prev_inj_cut_nr "Number of the last injector that was cut." UBYTE _CNV_A_R_ECME_LINEA_0_CM 1 0. 0. 12. ECU_ADDRESS 0xd0006623 FORMAT "%2.0" /end MEASUREMENT
/begin CHARACTERISTIC Cbx_bch_inj1_cut_req "Bench mode to cut injector on cylinder1" VALUE 0xa0020d2f _REC_S1VAL_20_u1 1. _CNV_A_R_ECME_LINEA_0_CM 0. 1. FORMAT "%1.0" BIT_MASK 0x1 /end CHARACTERISTIC
/begin CHARACTERISTIC Cbx_bch_inj2_cut_req "Bench mode to cut injector on cylinder2" VALUE 0xa0020d30 _REC_S1VAL_20_u1 1. _CNV_A_R_ECME_LINEA_0_CM 0. 1. FORMAT "%1.0" BIT_MASK 0x1 /end CHARACTERISTIC
/begin CHARACTERISTIC Cbx_bch_inj3_cut_req "Bench mode to cut injector on cylinder3" VALUE 0xa0020d31 _REC_S1VAL_20_u1 1. _CNV_A_R_ECME_LINEA_0_CM 0. 1. FORMAT "%1.0" BIT_MASK 0x1 /end CHARACTERISTIC
/begin CHARACTERISTIC Cbx_bch_inj4_cut_req "Bench mode to cut injector on cylinder4" VALUE 0xa0020d32 _REC_S1VAL_20_u1 1. _CNV_A_R_ECME_LINEA_0_CM 0. 1. FORMAT "%1.0" BIT_MASK 0x1 /end CHARACTERISTIC
/begin CHARACTERISTIC Cbx_inj_cut_seq "If ON, injectors will be disabled by following ignition sequence strictly, not randomly." VALUE 0xa0020d33 _REC_S1VAL_20_u1 1. _CNV_A_R_ECME_LINEA_0_CM 0. 1. FORMAT "%1.0" BIT_MASK 0x1 /end CHARACTERISTIC
/begin CHARACTERISTIC Cbx_wet_bch_mod "Bench mode wall wetting correction" VALUE 0xa0020d34 _REC_S1VAL_20_u1 1. _CNV_A_R_ECME_LINEA_0_CM 0. 1. FORMAT "%1.0" BIT_MASK 0x1 /end CHARACTERISTIC
/begin CHARACTERISTIC Cbx_wet_ti_cut_bch_mod "Bench mode for injection pulse" VALUE 0xa0020d35 _REC_S1VAL_20_u1 1. _CNV_A_R_ECME_LINEA_0_CM 0. 1. FORMAT "%1.0" BIT_MASK 0x1 /end CHARACTERISTIC
/begin CHARACTERISTIC Ctp_tco_amp_pinj_cor_fac "Multiplicativ factor of altimetric depression for Fuel Injection Mass correction during start" CURVE 0xa0020d44 _REC_A1CUR_20_u1_u2 1.9921875 _CNV_A_R_LINEAR_____42_CM 0. 1.9921875 FORMAT "%8.6"
 /begin AXIS_DESCR COM_AXIS Vxx_tco _CNV_A_R_LINEAR_____110_CM 8 -40. 200. FORMAT "%5.1" AXIS_PTS_REF Ctb_sta_tco /end AXIS_DESCR
/end CHARACTERISTIC
/begin CHARACTERISTIC Ctp_tco_pinj_fim "Pre-injection fuel mass setpoint table, dependant on coolant temperature" CURVE 0xa0025e44 _REC_A1CUR_20_u2_u2 6553.5 _CNV_A_R_LINEAR_____220_CM 0. 6553.5 FORMAT "%6.1"
 /begin AXIS_DESCR COM_AXIS Vxx_tco _CNV_A_R_LINEAR_____110_CM 8 -40. 200. FORMAT "%5.1" AXIS_PTS_REF Ctb_sta_tco /end AXIS_DESCR
/end CHARACTERISTIC
/begin MEASUREMENT Vbx_ecu_rst_pinj_dsb "Boolean indicating that the pre-injection is inhibited after an abnormal ECU reset" UBYTE _CNV_S_2_RANGE______3_CM 1 0. 0. 1. ECU_ADDRESS 0xd000662a BIT_MASK 0x1 /end MEASUREMENT
/begin MEASUREMENT Vbx_ecu_rst_pinj_ena "Boolean indicating that the pre-injection is not any more inhibited after an abnormal ECU reset" UBYTE _CNV_S_2_RANGE______3_CM 1 0. 0. 1. ECU_ADDRESS 0xd000662b BIT_MASK 0x1 /end MEASUREMENT
/begin MEASUREMENT Vbx_pinj "Pre-injection authorization" UBYTE _CNV_S_2_RANGE______3_CM 1 0. 0. 1. ECU_ADDRESS 0xd000662c BIT_MASK 0x1 /end MEASUREMENT
/begin MEASUREMENT Vbx_pinj_seq_cfm "Preinjection configuration : 1 = sequential preinjection, with opening angle set point" UBYTE _CNV_S_2_RANGE______3_CM 1 0. 0. 1. ECU_ADDRESS 0xd000662d BIT_MASK 0x1 /end MEASUREMENT
/begin MEASUREMENT Vxx_inj1_pinj_clos_angl "Pre-injection closure angle set point for injector n°1" UBYTE _CNV_A_R_LINEAR_____325_CM 1 0. 0. 765. ECU_ADDRESS 0xd000662e FORMAT "%3.0" /end MEASUREMENT
/begin MEASUREMENT Vxx_inj2_pinj_clos_angl "Pre-injection closure angle set point for injector n°2" UBYTE _CNV_A_R_LINEAR_____325_CM 1 0. 0. 765. ECU_ADDRESS 0xd000662f FORMAT "%3.0" /end MEASUREMENT
/begin MEASUREMENT Vxx_inj3_pinj_clos_angl "Pre-injection closure angle set point for injector n°3" UBYTE _CNV_A_R_LINEAR_____325_CM 1 0. 0. 765. ECU_ADDRESS 0xd0006630 FORMAT "%3.0" /end MEASUREMENT
/begin MEASUREMENT Vxx_inj4_pinj_clos_angl "Pre-injection closure angle set point for injector n°4" UBYTE _CNV_A_R_LINEAR_____325_CM 1 0. 0. 765. ECU_ADDRESS 0xd0006631 FORMAT "%3.0" /end MEASUREMENT
/begin MEASUREMENT Vxx_pinj_fim "Pre-injection fuel mass setpoint disrigarding cylinder" UWORD _CNV_A_R_LINEAR_____220_CM 1 0. 0. 6553.5 ECU_ADDRESS 0xd0003f5e FORMAT "%6.1" /end MEASUREMENT
/begin MEASUREMENT Vxx_sta_pinj_toth_nr "Crankshaft teeth number to count before first injection authorization" UBYTE _CNV_A_R_ECME_LINEA_0_CM 1 0. 0. 255. ECU_ADDRESS 0xd0006632 FORMAT "%3.0" /end MEASUREMENT
/begin MEASUREMENT Vxx_vld_tco "Engine coolant temperature" UWORD _CNV_A_R_LINEAR_____110_CM 1 0. -40. 200. ECU_ADDRESS 0xd0003f60 FORMAT "%5.1" /end MEASUREMENT
/begin CHARACTERISTIC Cbx_pinj_seq_cfm "Preinjection configuration : 1 = sequential preinjection, with opening angle set point" VALUE 0xa0020d50 _REC_S1VAL_20_u1 1. _CNV_A_R_ECME_LINEA_0_CM 0. 1. FORMAT "%1.0" BIT_MASK 0x1 /end CHARACTERISTIC
/begin CHARACTERISTIC Cxx_inj1_pinj_clos_angl "Pre-injection closure angle for injector n°1" VALUE 0xa0020d51 _REC_S1VAL_20_u1 765. _CNV_A_R_LINEAR_____325_CM 0. 765. FORMAT "%3.0" /end CHARACTERISTIC
/begin CHARACTERISTIC Cxx_inj2_pinj_clos_angl "Pre-injection closure angle for injector n°2" VALUE 0xa0020d52 _REC_S1VAL_20_u1 765. _CNV_A_R_LINEAR_____325_CM 0. 765. FORMAT "%3.0" /end CHARACTERISTIC
/begin CHARACTERISTIC Cxx_inj3_pinj_clos_angl "Pre-injection closure angle for injector n°3" VALUE 0xa0020d53 _REC_S1VAL_20_u1 765. _CNV_A_R_LINEAR_____325_CM 0. 765. FORMAT "%3.0" /end CHARACTERISTIC
/begin CHARACTERISTIC Cxx_inj4_pinj_clos_angl "Pre-injection closure angle for injector n°4" VALUE 0xa0020d54 _REC_S1VAL_20_u1 765. _CNV_A_R_LINEAR_____325_CM 0. 765. FORMAT "%3.0" /end CHARACTERISTIC
/begin CHARACTERISTIC Cxx_rest_pinj_cor_fac "Pre-injection Fuel Mass correction factor for restart" VALUE 0xa0020d4c _REC_S1VAL_20_u2 1. _CNV_A_R_LINEAR_____183_CM 0. 1. FORMAT "%11.9" /end CHARACTERISTIC
/begin CHARACTERISTIC Cxx_sta_pinj_toth_nr "Crankshaft teeth number to count before first injection authorization" VALUE 0xa0020d55 _REC_S1VAL_20_u1 255. _CNV_A_R_ECME_LINEA_0_CM 0. 255. FORMAT "%3.0" /end CHARACTERISTIC
/begin CHARACTERISTIC Cxx_sta_tco_vld_nok "Engine coolant temperature replacement value in case of default" VALUE 0xa0020d4e _REC_S1VAL_20_u2 240. _CNV_A_R_LINEAR_____110_CM -40. 200. FORMAT "%5.1" /end CHARACTERISTIC
/begin AXIS_PTS Ctb_alco_rat_sp "BKP of setpoint of alcohol rate for engine start" 0xa0025510 Vxx_alco_rat_sp _REC_A2AXS_20_u2 1. _CNV_A_R_LINEAR_____161_CM 9 0. 1. FORMAT "%5.3" /end AXIS_PTS
/begin CHARACTERISTIC Cmp_n_prs_lean_ti_ofs_alco "MAP giving the richness offset for the lean mode for flex-fuel" MAP 0xa0025524 _REC_A1MAP_20_u1_u2_u2 0.99609375 _CNV_A_R_LINEAR_____322_CM -0.5 0.49609375 FORMAT "%9.6"
 /begin AXIS_DESCR COM_AXIS Vxx_n _CNV_A_R_ENSD_LINEA_22_CM 20 0. 16383.75 FORMAT "%8.2" AXIS_PTS_REF Ctb_n /end AXIS_DESCR
 /begin AXIS_DESCR COM_AXIS Vxx_eal _CNV_A_R_LINEAR_____53_CM 16 0. 3.99993896484375 FORMAT "%10.8" AXIS_PTS_REF Ctb_eal /end AXIS_DESCR
/end CHARACTERISTIC
/begin CHARACTERISTIC Cmp_n_prs_tco_ti_fac_alco "MAP giving the correction factor for the K offset depending on RPM and EAL for flex-fuel" MAP 0xa0025664 _REC_A1MAP_20_u1_u2_u2 1.9921875 _CNV_A_R_LINEAR_____240_CM -1. 0.9921875 FORMAT "%9.6"
 /begin AXIS_DESCR COM_AXIS Vxx_n _CNV_A_R_ENSD_LINEA_22_CM 20 0. 16383.75 FORMAT "%8.2" AXIS_PTS_REF Ctb_n /end AXIS_DESCR
 /begin AXIS_DESCR COM_AXIS Vxx_eal _CNV_A_R_LINEAR_____53_CM 16 0. 3.99993896484375 FORMAT "%10.8" AXIS_PTS_REF Ctb_eal /end AXIS_DESCR
/end CHARACTERISTIC
/begin CHARACTERISTIC Ctp_n_sta_fim_fac_alco "Engine speed dependant correction for fuel injection mass calculation during start for flex-fuel." CURVE 0xa00257a4 _REC_A1CUR_20_u1_u2 0.99609375 _CNV_A_R_LINEAR_____29_CM 0. 0.99609375 FORMAT "%10.8"
 /begin AXIS_DESCR COM_AXIS Vxx_n _CNV_A_R_ENSD_LINEA_22_CM 9 0. 16383.75 FORMAT "%8.2" AXIS_PTS_REF Ctb_n_sta /end AXIS_DESCR
/end CHARACTERISTIC
/begin CHARACTERISTIC Ctp_sta_gaz_pump_fim_fac "Starting fuel mass correction in case of additionnal tank pump activation" CURVE 0xa00257b0 _REC_A1CUR_20_u2_u2 2. _CNV_A_R_LINEAR_____183_CM 0. 2. FORMAT "%10.8"
 /begin AXIS_DESCR COM_AXIS Vxx_alco_rat_sp _CNV_A_R_LINEAR_____161_CM 9 0. 1. FORMAT "%5.3" AXIS_PTS_REF Ctb_alco_rat_sp /end AXIS_DESCR
/end CHARACTERISTIC
/begin CHARACTERISTIC Ctp_tco_dec_sta_fim_alco "Cooling temperature dependant decrementation value of Fuel Injection Mass just after start for flex-fuel. " CURVE 0xa00257c4 _REC_A1CUR_20_u2_u2 167.7696 _CNV_A_R_LINEAR_____133_CM 0. 167.7696 FORMAT "%9.5"
 /begin AXIS_DESCR COM_AXIS Vxx_tco _CNV_A_R_LINEAR_____110_CM 16 -40. 200. FORMAT "%5.1" AXIS_PTS_REF Ctb_tco /end AXIS_DESCR
/end CHARACTERISTIC
/begin CHARACTERISTIC Ctp_tco_lean_ti_ofs_alco "additionnal offset depending on the water temperature for the lean mode for flex-fuel" CURVE 0xa00257e4 _REC_A1CUR_20_u1_u2 0.99609375 _CNV_A_R_LINEAR_____322_CM -0.5 0.49609375 FORMAT "%9.6"
 /begin AXIS_DESCR COM_AXIS Vxx_tco _CNV_A_R_LINEAR_____110_CM 17 -40. 200. READ_ONLY FORMAT "%5.1" AXIS_PTS_REF Ntb_tco /end AXIS_DESCR
/end CHARACTERISTIC
/begin CHARACTERISTIC Ctp_tco_pinj_fim_alco "Pre-injection fuel mass setpoint table, dependant on coolant temperature for flex-fuel." CURVE 0xa00257f8 _REC_A1CUR_20_u2_u2 6553.5 _CNV_A_R_LINEAR_____220_CM 0. 6553.5 FORMAT "%6.1"
 /begin AXIS_DESCR COM_AXIS Vxx_tco _CNV_A_R_LINEAR_____110_CM 8 -40. 200. FORMAT "%5.1" AXIS_PTS_REF Ctb_sta_tco /end AXIS_DESCR
/end CHARACTERISTIC
/begin CHARACTERISTIC Ctp_tco_sta_fim_alco "Table of Fuel mass injection. during start depending on coolant temperature for flex-fuel." CURVE 0xa0025808 _REC_A1CUR_20_u2_u2 4799.91808 _CNV_A_R_LINEAR_____323_CM 0. 4799.91808 FORMAT "%7.2"
 /begin AXIS_DESCR COM_AXIS Vxx_tco _CNV_A_R_LINEAR_____110_CM 16 -40. 200. FORMAT "%5.1" AXIS_PTS_REF Ctb_tco /end AXIS_DESCR
/end CHARACTERISTIC
/begin CHARACTERISTIC Ctp_tco_sta_rich_dec_alco "Table giving the number of tdc between 2 decrease of the A offset (if initialized with the water temperature) for flex-fuel." CURVE 0xa0025828 _REC_A1CUR_20_u1_u2 255. _CNV_A_R_LINEAR_____101_CM 0. 255. FORMAT "%3.0"
 /begin AXIS_DESCR COM_AXIS Vxx_tco _CNV_A_R_LINEAR_____110_CM 17 -40. 200. READ_ONLY FORMAT "%5.1" AXIS_PTS_REF Ntb_tco /end AXIS_DESCR
/end CHARACTERISTIC
/begin CHARACTERISTIC Ctp_tco_sta_ti_ofs_alco "Table giving the initial A offset depending on the water temperature for flex-fuel." CURVE 0xa002583c _REC_A1CUR_20_u1_u2 1.9921875 _CNV_A_R_LINEAR_____42_CM 0. 1.9921875 FORMAT "%8.6"
 /begin AXIS_DESCR COM_AXIS Vxx_tco _CNV_A_R_LINEAR_____110_CM 17 -40. 200. READ_ONLY FORMAT "%5.1" AXIS_PTS_REF Ntb_tco /end AXIS_DESCR
/end CHARACTERISTIC
/begin CHARACTERISTIC Ctp_tco_ti_ofs1_alco "Table giving the B offset depending on the water temperature for flex-fuel." CURVE 0xa0025850 _REC_A1CUR_20_u1_u2 1.9921875 _CNV_A_R_LINEAR_____42_CM 0. 1.9921875 FORMAT "%8.6"
 /begin AXIS_DESCR COM_AXIS Vxx_tco _CNV_A_R_LINEAR_____110_CM 17 -40. 200. READ_ONLY FORMAT "%5.1" AXIS_PTS_REF Ntb_tco /end AXIS_DESCR
/end CHARACTERISTIC
/begin CHARACTERISTIC Ctp_tco_ti_ofs2_alco "Table giving the K offset depending on the water temperature for flex-fuel." CURVE 0xa0025864 _REC_A1CUR_20_u1_u2 0.99609375 _CNV_A_R_LINEAR_____29_CM 0. 0.99609375 FORMAT "%10.8"
 /begin AXIS_DESCR COM_AXIS Vxx_tco _CNV_A_R_LINEAR_____110_CM 17 -40. 200. READ_ONLY FORMAT "%5.1" AXIS_PTS_REF Ntb_tco /end AXIS_DESCR
/end CHARACTERISTIC
/begin MEASUREMENT Vbx_tdc_alco_sta_fim_ena "Boolean enabling sta_fim decrementation at TDC" UBYTE _CNV_S_2_RANGE______3_CM 1 0. 0. 1. ECU_ADDRESS 0xd0006600 BIT_MASK 0x1 /end MEASUREMENT
/begin MEASUREMENT Vxx_n_tco_sta_fim_alco "Fuel injection Mass during start depending on engine speed and tco for flex-fuel" UWORD _CNV_A_R_LINEAR_____323_CM 1 0. 0. 4799.91808 ECU_ADDRESS 0xd0003f40 FORMAT "%7.2" /end MEASUREMENT
/begin MEASUREMENT Vxx_sta_gaz_pump_fim_fac "Starting fuel mass correction in case of additionnal tank pump activation" UWORD _CNV_A_R_LINEAR_____183_CM 1 0. 0. 2. ECU_ADDRESS 0xd0003f42 FORMAT "%10.8" /end MEASUREMENT
/begin MEASUREMENT Vxx_tco_dec_sta_fim_alco "Fuel injection Mass decrementation just after start for flex-fuel." UWORD _CNV_A_R_LINEAR_____133_CM 1 0. 0. 167.7696 ECU_ADDRESS 0xd0003f44 FORMAT "%9.5" /end MEASUREMENT
/begin MEASUREMENT Vxx_tco_lean_ti_fac_alco "Final richness factor in lean mode for flex fuel" UBYTE _CNV_A_R_LINEAR_____42_CM 1 0. 0. 1.9921875 ECU_ADDRESS 0xd0006601 FORMAT "%8.6" /end MEASUREMENT
/begin MEASUREMENT Vxx_tco_pinj_fim_alco "Pre-injection fuel mass setpoint for flex-fuel" UWORD _CNV_A_R_LINEAR_____220_CM 1 0. 0. 6553.5 ECU_ADDRESS 0xd0003f46 FORMAT "%6.1" /end MEASUREMENT
/begin MEASUREMENT Vxx_tco_sta_rich_dec_alco "Number of tdc between 2 decrease of the A offset for flex-fuel" UBYTE _CNV_A_R_LINEAR_____101_CM 1 0. 0. 255. ECU_ADDRESS 0xd0006602 FORMAT "%3.0" /end MEASUREMENT
/begin MEASUREMENT Vxx_tco_sta_ti_ofs_alco "Initial A offset depending on the water temperature for flex-fuel" UBYTE _CNV_A_R_LINEAR_____42_CM 1 0. 0. 1.9921875 ECU_ADDRESS 0xd0006603 FORMAT "%8.6" /end MEASUREMENT
/begin MEASUREMENT Vxx_tco_ti_fac_alco "C factor for flex-fuel" UBYTE _CNV_A_R_LINEAR_____240_CM 1 0. -1. 0.9921875 ECU_ADDRESS 0xd0006604 FORMAT "%9.6" /end MEASUREMENT
/begin MEASUREMENT Vxx_tco_ti_fac_alco_fac "Gain to inhibit or not C factor" UBYTE _CNV_A_R_LINEAR_____162_CM 1 0. 0. 1. ECU_ADDRESS 0xd0006605 FORMAT "%9.7" /end MEASUREMENT
/begin MEASUREMENT Vxx_tco_ti_ofs1_alco "B offset for flex-fuel." UBYTE _CNV_A_R_LINEAR_____42_CM 1 0. 0. 1.9921875 ECU_ADDRESS 0xd0006606 FORMAT "%8.6" /end MEASUREMENT
/begin MEASUREMENT Vxx_tco_ti_ofs2_alco "K offset for flex-fuel" UBYTE _CNV_A_R_LINEAR_____29_CM 1 0. 0. 0.99609375 ECU_ADDRESS 0xd0006607 FORMAT "%5.3" /end MEASUREMENT
/begin MEASUREMENT Vxx_vld_tco_alco "Engine coolant temperature" UWORD _CNV_A_R_LINEAR_____110_CM 1 0. -40. 200. ECU_ADDRESS 0xd0003f48 FORMAT "%5.1" /end MEASUREMENT
/begin CHARACTERISTIC Cbx_tco_ti_fac_dsb "Boolean to inhibit C factor in idle speed regulation" VALUE 0xa0020d1c _REC_S1VAL_20_u1 1. _CNV_A_R_ECME_LINEA_0_CM 0. 1. FORMAT "%1.0" BIT_MASK 0x1 /end CHARACTERISTIC
/begin CHARACTERISTIC Cxx_pinj_pump_alco_fac "Pre-injection Fuel Mass correction factor in case of add. tanker activation (E100)" VALUE 0xa0020d1a _REC_S1VAL_20_u2 1. _CNV_A_R_LINEAR_____183_CM 0. 1. FORMAT "%11.9" /end CHARACTERISTIC
/begin CHARACTERISTIC Cxx_trs_tco_ti_fac_down "Factor of transition to decrease C factor" VALUE 0xa0020d1d _REC_S1VAL_20_u1 1. _CNV_A_R_LINEAR_____327_CM 0. 1. FORMAT "%9.7" /end CHARACTERISTIC
/begin CHARACTERISTIC Cxx_trs_tco_ti_fac_up "Factor of transition to increase C factor" VALUE 0xa0020d1e _REC_S1VAL_20_u1 1. _CNV_A_R_LINEAR_____327_CM 0. 1. FORMAT "%9.7" /end CHARACTERISTIC
/begin AXIS_PTS Ctb_dt_tq_rat "Breakpoint calibration of driveline torque ratio" 0xa00352ec Vxx_dt_tq_rat _REC_A2AXS_20_u2 210. _CNV_A_R_LINEAR_____313_CM 8 -10. 200. FORMAT "%6.2" /end AXIS_PTS
/begin AXIS_PTS Ctb_inj_cut_n "Breakpoint calibration of engine speed" 0xa0035300 Vxx_n_mv _REC_A2AXS_20_u2 16383.75 _CNV_A_R_ENSD_LINEA_22_CM 7 0. 16383.75 FORMAT "%8.2" /end AXIS_PTS
/begin AXIS_PTS Ctb_min_tqe_n "engine speed breakpoint for minimum torque" 0xa0035310 Vxx_n_dif_tq _REC_A2AXS_20_u2 16383.75 _CNV_A_R_ENSD_LINEA_22_CM 10 0. 16383.75 FORMAT "%8.2" /end AXIS_PTS
/begin CHARACTERISTIC Cmp_cut_fil_fac "Cartography for torque slope limitation during injection cut" MAP 0xa0035328 _REC_A1MAP_20_u2_u2_u2 65535. _CNV_A_R_LINEAR_____292_CM -65535. 0. FORMAT "%6.0"
 /begin AXIS_DESCR COM_AXIS Vxx_n_mv _CNV_A_R_ENSD_LINEA_22_CM 7 0. 16383.75 FORMAT "%8.2" AXIS_PTS_REF Ctb_inj_cut_n /end AXIS_DESCR
 /begin AXIS_DESCR COM_AXIS Vxx_dt_tq_rat _CNV_A_R_LINEAR_____313_CM 8 -10. 200. FORMAT "%6.2" AXIS_PTS_REF Ctb_dt_tq_rat /end AXIS_DESCR
/end CHARACTERISTIC
/begin CHARACTERISTIC Cmp_driv_swi_fil_fac "Cartography for torque slope limitation during re-injection on powertrain setpoint request" MAP 0xa0035398 _REC_A1MAP_20_u2_u2_u2 65535. _CNV_A_R_LINEAR_____293_CM 0. 65535. FORMAT "%5.0"
 /begin AXIS_DESCR COM_AXIS Vxx_n_mv _CNV_A_R_ENSD_LINEA_22_CM 7 0. 16383.75 FORMAT "%8.2" AXIS_PTS_REF Ctb_inj_cut_n /end AXIS_DESCR
 /begin AXIS_DESCR COM_AXIS Vxx_dt_tq_rat _CNV_A_R_LINEAR_____313_CM 8 -10. 200. FORMAT "%6.2" AXIS_PTS_REF Ctb_dt_tq_rat /end AXIS_DESCR
/end CHARACTERISTIC
/begin CHARACTERISTIC Cmp_n_tco_min_tq_fmt "Corrective factor on minimum driver torque." MAP 0xa0035408 _REC_A1MAP_20_u2_u2_u2 1. _CNV_A_R_LINEAR_____149_CM 0. 1. FORMAT "%11.9"
 /begin AXIS_DESCR COM_AXIS Vxx_n_dif_tq _CNV_A_R_ENSD_LINEA_22_CM 10 0. 16383.75 FORMAT "%8.2" AXIS_PTS_REF Ctb_min_tqe_n /end AXIS_DESCR
 /begin AXIS_DESCR COM_AXIS Vxx_tco _CNV_A_R_LINEAR_____110_CM 9 -40. 200. FORMAT "%5.1" AXIS_PTS_REF Ctb_tco2 /end AXIS_DESCR
/end CHARACTERISTIC
/begin CHARACTERISTIC Ctd_coup_grip_rat "Cartography that converts transmission coupler state into coupler torque grip ratio" CURVE 0xa0021ec4 _REC_A1CUR_20_u1_u1 1. _CNV_A_R_LINEAR_____297_CM 0. 1. FORMAT "%4.1"
 /begin AXIS_DESCR COM_AXIS Vxx_ant_coup _CNV_A_R_ECME_LINEA_0_CM 3 0. 255. FORMAT "%3.0" AXIS_PTS_REF Ctb_coup /end AXIS_DESCR
/end CHARACTERISTIC
/begin CHARACTERISTIC Ctd_gear_min_driv_tqe_ftc "Filtering time constant for minimum driver engine torque" CURVE 0xa0021ebc _REC_A1CUR_20_u1_u1 2.55 _CNV_A_R_LINEAR_____32_CM 0. 2.55 FORMAT "%4.2"
 /begin AXIS_DESCR COM_AXIS Vxx_gear _CNV_A_R_LINEAR_____145_CM 8 -1. 6. READ_ONLY FORMAT "%2.0" AXIS_PTS_REF Ntb_gear /end AXIS_DESCR
/end CHARACTERISTIC
/begin CHARACTERISTIC Ctd_gear_tq_rat "Cartography that converts \"vehicle_speed / rotary_engine_speed\" ratio into driveline torque ratio" CURVE 0xa00354bc _REC_A1CUR_20_u2_u1 210. _CNV_A_R_LINEAR_____313_CM -10. 200. FORMAT "%6.2"
 /begin AXIS_DESCR COM_AXIS Vxx_gear _CNV_A_R_LINEAR_____145_CM 8 -1. 6. READ_ONLY FORMAT "%2.0" AXIS_PTS_REF Ntb_gear /end AXIS_DESCR
/end CHARACTERISTIC
/begin CHARACTERISTIC Ctp_min_tq_tco_ofs "Torque offset to estimate the minimum torque in idle speed zone depending of the coolant temperature." CURVE 0xa00354cc _REC_A1CUR_20_u2_u2 2047.96875 _CNV_A_R_LINEAR_____216_CM -400. 1647.96875 FORMAT "%11.5"
 /begin AXIS_DESCR COM_AXIS Vxx_tco _CNV_A_R_LINEAR_____110_CM 9 -40. 200. FORMAT "%5.1" AXIS_PTS_REF Ctb_tco2 /end AXIS_DESCR
/end CHARACTERISTIC
/begin CHARACTERISTIC Ctp_swi_fil_fac "Table for torque slope limitation during natural re-injection" CURVE 0xa00354e0 _REC_A1CUR_20_u2_u2 65535. _CNV_A_R_LINEAR_____293_CM 0. 65535. FORMAT "%5.0"
 /begin AXIS_DESCR COM_AXIS Vxx_dt_tq_rat _CNV_A_R_LINEAR_____313_CM 8 -10. 200. FORMAT "%6.2" AXIS_PTS_REF Ctb_dt_tq_rat /end AXIS_DESCR
/end CHARACTERISTIC
/begin MEASUREMENT Vbx_l_eng_tqe "The minmum torque isn't saturated by the low engine minimum torque." UBYTE _CNV_S_2_RANGE______3_CM 1 0. 0. 1. ECU_ADDRESS 0xd0007cb4 BIT_MASK 0x1 /end MEASUREMENT
/begin MEASUREMENT Vbx_sta_min_tq "Flag to detect the staring mode." UBYTE _CNV_S_2_RANGE______3_CM 1 0. 0. 1. ECU_ADDRESS 0xd0007cb5 BIT_MASK 0x1 /end MEASUREMENT
/begin MEASUREMENT Vxx_cut_fil_fac "Torque slope limitation for injection cut" UWORD _CNV_A_R_LINEAR_____292_CM 1 0. -65535. 0. ECU_ADDRESS 0xd0004998 FORMAT "%6.0" /end MEASUREMENT
/begin MEASUREMENT Vxx_cut_tq_cor_fil "Correction to the minimum driver engine torque during injection cut or re-injection" UWORD _CNV_A_R_LINEAR_____216_CM 1 0. -400. 1647.96875 ECU_ADDRESS 0xd000499a FORMAT "%11.5" /end MEASUREMENT
/begin MEASUREMENT Vxx_dt_tq_rat "Gear rotary speed ratio : wheel_speed/engine_speed (tuned with gear state)" UWORD _CNV_A_R_LINEAR_____313_CM 1 0. -10. 200. ECU_ADDRESS 0xd000499c FORMAT "%6.2" /end MEASUREMENT
/begin MEASUREMENT Vxx_min_agb_tqe "coupler torque losses" UWORD _CNV_A_R_LINEAR_____216_CM 1 0. -400. 1647.96875 ECU_ADDRESS 0xd000499e FORMAT "%11.5" /end MEASUREMENT
/begin MEASUREMENT Vxx_min_avl_tqe "minimum available engine torque" UWORD _CNV_A_R_LINEAR_____216_CM 1 0. -400. 1647.96875 ECU_ADDRESS 0xd00049a0 FORMAT "%11.5" /end MEASUREMENT
/begin MEASUREMENT Vxx_min_avl_tqe_raw "Minimum available engine torque before saturation with minimun driver engine torque." UWORD _CNV_A_R_LINEAR_____216_CM 1 0. -400. 1647.96875 ECU_ADDRESS 0xd00049a2 FORMAT "%11.5" /end MEASUREMENT
/begin MEASUREMENT Vxx_min_bas_agb_tqe "minimum basic engine torque with AT torque losses" UWORD _CNV_A_R_LINEAR_____216_CM 1 0. -400. 1647.96875 ECU_ADDRESS 0xd00049a4 FORMAT "%11.5" /end MEASUREMENT
/begin MEASUREMENT Vxx_min_bas_tqe "minimum basic engine torque" UWORD _CNV_A_R_LINEAR_____216_CM 1 0. -400. 1647.96875 ECU_ADDRESS 0xd00049a6 FORMAT "%11.5" /end MEASUREMENT
/begin MEASUREMENT Vxx_min_bas_tqe_raw "minimum basic engine torque without BVA constraints" UWORD _CNV_A_R_LINEAR_____216_CM 1 0. -400. 1647.96875 ECU_ADDRESS 0xd00049a8 FORMAT "%11.5" /end MEASUREMENT
/begin MEASUREMENT Vxx_min_driv_tqe "minimum driver engine torque" UWORD _CNV_A_R_LINEAR_____216_CM 1 0. -400. 1647.96875 ECU_ADDRESS 0xd00049aa FORMAT "%11.5" /end MEASUREMENT
/begin MEASUREMENT Vxx_min_driv_tqe_raw "Raw minimum driver engine torque" UWORD _CNV_A_R_LINEAR_____216_CM 1 0. -400. 1647.96875 ECU_ADDRESS 0xd00049ac FORMAT "%11.5" /end MEASUREMENT
/begin MEASUREMENT Vxx_min_driv_tqe_wit_inj_cut "minimum driver engine torque with injection cut" UWORD _CNV_A_R_LINEAR_____216_CM 1 0. -400. 1647.96875 ECU_ADDRESS 0xd00049ae FORMAT "%11.5" /end MEASUREMENT
/begin MEASUREMENT Vxx_min_is_tql "minimum hyperbolic engine torque" UWORD _CNV_A_R_LINEAR_____216_CM 1 0. -400. 1647.96875 ECU_ADDRESS 0xd00049b0 FORMAT "%11.5" /end MEASUREMENT
/begin MEASUREMENT Vxx_n_dif_tq "Minimal saturation of filtered engine speed for the minimal torque calculation" UWORD _CNV_A_R_ENSD_LINEA_22_CM 1 0. 0. 16383.75 ECU_ADDRESS 0xd00049b2 FORMAT "%8.2" /end MEASUREMENT
/begin MEASUREMENT Vxx_n_mv_min_driv_tqe "Filtered engine speed used for minimum driver torque calculation" UWORD _CNV_A_R_ENSD_LINEA_22_CM 1 0. 0. 16383.75 ECU_ADDRESS 0xd00049b4 FORMAT "%8.2" /end MEASUREMENT
/begin MEASUREMENT Vxx_n_mv_min_driv_tqe_raw "Mean engine speed" UWORD _CNV_A_R_ENSD_LINEA_22_CM 1 0. 0. 16383.75 ECU_ADDRESS 0xd00049b6 FORMAT "%8.2" /end MEASUREMENT
/begin MEASUREMENT Vxx_swi_fil_fac "Torque slope limitation for re-injection" UWORD _CNV_A_R_LINEAR_____293_CM 1 0. 0. 65535. ECU_ADDRESS 0xd00049b8 FORMAT "%5.0" /end MEASUREMENT
/begin CHARACTERISTIC Cbx_min_avl_tqe_raw_cfm "Boolean calibration to change the minimum available torque: equal to engine torque losses (=0)" VALUE 0xa0021ed6 _REC_S1VAL_20_u1 1. _CNV_A_R_ECME_LINEA_0_CM 0. 1. FORMAT "%1.0" BIT_MASK 0x1 /end CHARACTERISTIC
/begin CHARACTERISTIC Cbx_min_driv_tqe_cfm "Boolean calibration to deactivate the use of Vxx_min_driv_tqe in AJMOD filter" VALUE 0xa0021ed7 _REC_S1VAL_20_u1 1. _CNV_A_R_ECME_LINEA_0_CM 0. 1. FORMAT "%1.0" BIT_MASK 0x1 /end CHARACTERISTIC
/begin CHARACTERISTIC Cbx_min_tq_mod_cfm "Boolean to active the minimum torque in the diesel configuration." VALUE 0xa0021ed8 _REC_S1VAL_20_u1 1. _CNV_S_2_RANGE______3_CM 0. 1. BIT_MASK 0x1 /end CHARACTERISTIC
/begin CHARACTERISTIC Cbx_n_mv_n_cfm "Boolean calibration to choose between a filtered raw engine speed (=1) or filtered engine speed (=0)" VALUE 0xa0021ed9 _REC_S1VAL_20_u1 1. _CNV_A_R_ECME_LINEA_0_CM 0. 1. FORMAT "%1.0" BIT_MASK 0x1 /end CHARACTERISTIC
/begin CHARACTERISTIC Cxx_agb_max_tqe_cor "Value of maximum torque allowed for AT torque converter" VALUE 0xa0021ec8 _REC_S1VAL_20_u2 2047.96875 _CNV_A_R_LINEAR_____181_CM 0. 2047.96875 FORMAT "%10.5" /end CHARACTERISTIC
/begin CHARACTERISTIC Cxx_agb_min_tqe_fac "Factor which allows adapting the final level of AT converter torque, according to the engine speed." VALUE 0xa0021eda _REC_S1VAL_20_u1 3.984375 _CNV_A_R_LINEAR_____83_CM 0. 3.984375 FORMAT "%8.6" /end CHARACTERISTIC
/begin CHARACTERISTIC Cxx_fil_fac_dft "Default factor for torque slope limitation" VALUE 0xa0021eca _REC_S1VAL_20_u2 65535. _CNV_A_R_LINEAR_____293_CM 0. 65535. FORMAT "%5.0" /end CHARACTERISTIC
/begin CHARACTERISTIC Cxx_min_is_n "engine speed threshold" VALUE 0xa0021ecc _REC_S1VAL_20_u2 16383.75 _CNV_A_R_ENSD_LINEA_22_CM 0. 16383.75 FORMAT "%8.2" /end CHARACTERISTIC
/begin CHARACTERISTIC Cxx_min_l_eng_tqe_tqe_hys "Hysteresis to detect the saturation of minimum torque by the low engine torque" VALUE 0xa0021ece _REC_S1VAL_20_u2 2047.96875 _CNV_A_R_LINEAR_____181_CM 0. 2047.96875 FORMAT "%10.5" /end CHARACTERISTIC
/begin CHARACTERISTIC Cxx_min_n_thd_min_tq "Minimum engine speed threshold for the smoothing between the low engine minimum effective torque and the hyperbolic minimun torque" VALUE 0xa0021ed0 _REC_S1VAL_20_s2 16383.75 _CNV_A_R_ENSD_LINEA_22_CM -8192. 8191.75 FORMAT "%8.2" /end CHARACTERISTIC
/begin CHARACTERISTIC Cxx_min_n_tq_grd "Torque gradient to set to the minimum torque on the engine torque losses" VALUE 0xa0021ed2 _REC_S1VAL_20_u2 7.9998779296875 _CNV_A_R_LINEAR_____193_CM 0. 7.9998779296875 FORMAT "%4.2" /end CHARACTERISTIC
/begin CHARACTERISTIC Cxx_min_n_tq_grd_sta "Torque gradient to set to the minimum torque on the engine torque losses in the starting mode" VALUE 0xa0021ed4 _REC_S1VAL_20_u2 7.9998779296875 _CNV_A_R_LINEAR_____193_CM 0. 7.9998779296875 FORMAT "%4.2" /end CHARACTERISTIC
/begin CHARACTERISTIC Cxx_min_tq_ast_dsb_dly "Maximum delay to disable the minimun torque after the starting mode." VALUE 0xa0021edb _REC_S1VAL_20_u1 25.4 _CNV_A_R_LINEAR_____58_CM 0. 25.4 FORMAT "%4.1" /end CHARACTERISTIC
/begin CHARACTERISTIC Ctp_l_eng_map_n "Ratio for the minimum maniflod pressure, in function of the engine speed" CURVE 0xa00352b8 _REC_A1CUR_20_u2_u2 1.99609375 _CNV_A_R_LINEAR_____29_CM 0. 1.99609375 FORMAT "%5.3"
 /begin AXIS_DESCR COM_AXIS Vxx_n _CNV_A_R_ENSD_LINEA_22_CM 9 0. 16383.75 FORMAT "%8.2" AXIS_PTS_REF Ctb_n2 /end AXIS_DESCR
/end CHARACTERISTIC
/begin CHARACTERISTIC Ctp_l_eng_map_tco "Minimum maniflod pressure in function of the coolant temperature" CURVE 0xa00352cc _REC_A1CUR_20_u2_u2 20000. _CNV_A_R_LINEAR_____115_CM 0. 20000. FORMAT "%5.0"
 /begin AXIS_DESCR COM_AXIS Vxx_tco _CNV_A_R_LINEAR_____110_CM 16 -40. 200. FORMAT "%5.1" AXIS_PTS_REF Ctb_tco /end AXIS_DESCR
/end CHARACTERISTIC
/begin MEASUREMENT Vxx_l_eng_map "Minimun manifold pressure" UWORD _CNV_A_R_LINEAR_____115_CM 1 0. 0. 20000. ECU_ADDRESS 0xd000497c FORMAT "%5.0" /end MEASUREMENT
/begin MEASUREMENT Vxx_l_eng_tq "low engine minimum torque" UWORD _CNV_A_R_LINEAR_____181_CM 1 0. 0. 2047.96875 ECU_ADDRESS 0xd000497e FORMAT "%10.5" /end MEASUREMENT
/begin MEASUREMENT Vxx_l_eng_tqe "low engine minimum effective torque" UWORD _CNV_A_R_LINEAR_____216_CM 1 0. -400. 1647.96875 ECU_ADDRESS 0xd0004980 FORMAT "%10.5" /end MEASUREMENT
/begin CHARACTERISTIC Cxx_l_eng_map_dft "Pressure offset if manifold pressure is failing" VALUE 0xa0021eb8 _REC_S1VAL_20_u2 20000. _CNV_A_R_LINEAR_____115_CM 0. 20000. FORMAT "%5.0" /end CHARACTERISTIC
/begin AXIS_PTS Ctb_sta_n "Engine speed breakpoints for starting set point tables" 0xa00354f0 Vxx_n _REC_A2AXS_20_u2 16383.75 _CNV_A_R_ENSD_LINEA_22_CM 8 0. 16383.75 FORMAT "%8.2" /end AXIS_PTS
/begin CHARACTERISTIC Cmp_n_tco_sta_tq "Starting Torque Table - coolant temperature and engine speed dependant" MAP 0xa0035504 _REC_A1MAP_20_u2_u2_u2 2047.96875 _CNV_A_R_LINEAR_____181_CM 0. 2047.96875 FORMAT "%10.5"
 /begin AXIS_DESCR COM_AXIS Vxx_n _CNV_A_R_ENSD_LINEA_22_CM 8 0. 16383.75 FORMAT "%8.2" AXIS_PTS_REF Ctb_sta_n /end AXIS_DESCR
 /begin AXIS_DESCR COM_AXIS Vxx_tco _CNV_A_R_LINEAR_____110_CM 8 -40. 200. FORMAT "%5.1" AXIS_PTS_REF Ctb_sta_tco /end AXIS_DESCR
/end CHARACTERISTIC
/begin CHARACTERISTIC Ctp_tco_sta_is_trs_dly "" CURVE 0xa0035584 _REC_A1CUR_20_u2_u2 655.35 _CNV_A_R_LINEAR_____32_CM 0. 655.35 FORMAT "%6.2"
 /begin AXIS_DESCR COM_AXIS Vxx_tco _CNV_A_R_LINEAR_____110_CM 8 -40. 200. FORMAT "%5.1" AXIS_PTS_REF Ctb_sta_tco /end AXIS_DESCR
/end CHARACTERISTIC
/begin MEASUREMENT Vxx_raw_sta_tq "Raw Starting Torque" UWORD _CNV_A_R_LINEAR_____181_CM 1 0. 0. 2047.96875 ECU_ADDRESS 0xd00049ba FORMAT "%10.5" /end MEASUREMENT
/begin MEASUREMENT Vxx_sta_is_fil_fac "Variable of transition between Start Torque and Current Torque Set Point of Torque Structure" UWORD _CNV_A_R_LINEAR_____183_CM 1 0. 0. 1. ECU_ADDRESS 0xd00049bc FORMAT "%11.9" /end MEASUREMENT
/begin MEASUREMENT Vxx_sta_tq "Start Torque Set Point" UWORD _CNV_A_R_LINEAR_____181_CM 1 0. 0. 2047.96875 ECU_ADDRESS 0xd00049be FORMAT "%10.5" /end MEASUREMENT
/begin CHARACTERISTIC Cxx_sta_tq_inc "Starting torque ramp value for difficult start" VALUE 0xa0021ede _REC_S1VAL_20_u1 255. _CNV_A_R_LINEAR_____293_CM 0. 255. FORMAT "%3.0" /end CHARACTERISTIC
/begin CHARACTERISTIC Cxx_sta_tq_inc_dly "Delay before starting torque ramp activation" VALUE 0xa0021edc _REC_S1VAL_20_u2 655.35 _CNV_A_R_LINEAR_____32_CM 0. 655.35 FORMAT "%6.2" /end CHARACTERISTIC
/begin AXIS_PTS Ctb_sta_tco_alco "Coolant temperature breakpoints for starting set point table in alcool" 0xa00351f0 Vxx_tco _REC_A2AXS_20_u2 240. _CNV_A_R_LINEAR_____110_CM 11 -40. 200. FORMAT "%5.1" /end AXIS_PTS
/begin CHARACTERISTIC Cmp_n_tco_sta_tq_alco "Starting Torque Table for ALCOOL" MAP 0xa0035208 _REC_A1MAP_20_u2_u2_u2 2047.96875 _CNV_A_R_LINEAR_____181_CM 0. 2047.96875 FORMAT "%10.5"
 /begin AXIS_DESCR COM_AXIS Vxx_n _CNV_A_R_ENSD_LINEA_22_CM 8 0. 16383.75 FORMAT "%8.2" AXIS_PTS_REF Ctb_sta_n /end AXIS_DESCR
 /begin AXIS_DESCR COM_AXIS Vxx_tco _CNV_A_R_LINEAR_____110_CM 11 -40. 200. FORMAT "%5.1" AXIS_PTS_REF Ctb_sta_tco_alco /end AXIS_DESCR
/end CHARACTERISTIC
/begin MEASUREMENT Vxx_n_tco_sta_tq_alco "Starting Torque for ALCOOL" UWORD _CNV_A_R_LINEAR_____181_CM 1 0. 0. 2047.96875 ECU_ADDRESS 0xd0004976 FORMAT "%10.5" /end MEASUREMENT
/begin MEASUREMENT Vbx_tq_req_stt_10 "Torque request status set to 10b" UBYTE _CNV_S_2_RANGE______3_CM 1 0. 0. 1. ECU_ADDRESS 0xd0006f1c BIT_MASK 0x1 /end MEASUREMENT
/begin MEASUREMENT Vbx_tq_req_stt_01 "Torque request status set to 01b" UBYTE _CNV_S_2_RANGE______3_CM 1 0. 0. 1. ECU_ADDRESS 0xd0006f19 BIT_MASK 0x1 /end MEASUREMENT
/begin MEASUREMENT Vbx_tq_req_stt_11 "Torque request status set to 11b" UBYTE _CNV_S_2_RANGE______3_CM 1 0. 0. 1. ECU_ADDRESS 0xd0006f1a BIT_MASK 0x1 /end MEASUREMENT
/begin MEASUREMENT Vsx_mux_tq_req_ans "Show to all systems how a regulation can be done (nominal, precision less or no regulation)" UBYTE _CNV_S_4_RANGE_STAT_328_CM 1 0. 0. 3. ECU_ADDRESS 0xd0006f1b /end MEASUREMENT
/begin MEASUREMENT Vxx_lbup_per_mv_max_rtn "Backup value of the oxygen sensor failure threshold" UWORD _CNV_A_R_LINEAR_____32_CM 1 0. 0. 655.35 DISPLAY_IDENTIFIER InCbiUli_NVM.Vxx_lbup_per_mv_max_rtn_NVM ECU_ADDRESS 0xd00042b4 FORMAT "%6.2" /end MEASUREMENT
/begin MEASUREMENT Vxx_lbup_per_tot_mv_rtn "Backup value of the oxygen sensor diagnostic criteria" UWORD _CNV_A_R_LINEAR_____32_CM 1 0. 0. 655.35 DISPLAY_IDENTIFIER InCbiUli_NVM.Vxx_lbup_per_tot_mv_rtn_NVM ECU_ADDRESS 0xd00042b6 FORMAT "%6.2" /end MEASUREMENT
/begin MEASUREMENT Vtx_in_mem_lbup_cpt[0] "Number of times the system enters in each diagnosis conditions" UWORD _CNV_A_R_ECME_LINEA_0_CM 1 0. 0. 65535. DISPLAY_IDENTIFIER InCbiUli_NVM.Vtx_in_mem_lbup_cpt_NVM[0] ECU_ADDRESS 0xd00042b8 FORMAT "%5.0" /end MEASUREMENT
/begin MEASUREMENT Vtx_in_mem_lbup_cpt[1] "Number of times the system enters in each diagnosis conditions" UWORD _CNV_A_R_ECME_LINEA_0_CM 1 0. 0. 65535. DISPLAY_IDENTIFIER InCbiUli_NVM.Vtx_in_mem_lbup_cpt_NVM[1] ECU_ADDRESS 0xd00042ba FORMAT "%5.0" /end MEASUREMENT
/begin MEASUREMENT Vtx_in_mem_lbup_cpt[2] "Number of times the system enters in each diagnosis conditions" UWORD _CNV_A_R_ECME_LINEA_0_CM 1 0. 0. 65535. DISPLAY_IDENTIFIER InCbiUli_NVM.Vtx_in_mem_lbup_cpt_NVM[2] ECU_ADDRESS 0xd00042bc FORMAT "%5.0" /end MEASUREMENT
/begin MEASUREMENT Vtx_in_mem_lbup_cpt[3] "Number of times the system enters in each diagnosis conditions" UWORD _CNV_A_R_ECME_LINEA_0_CM 1 0. 0. 65535. DISPLAY_IDENTIFIER InCbiUli_NVM.Vtx_in_mem_lbup_cpt_NVM[3] ECU_ADDRESS 0xd00042be FORMAT "%5.0" /end MEASUREMENT
/begin MEASUREMENT Vtx_in_mem_lbup_cpt[4] "Number of times the system enters in each diagnosis conditions" UWORD _CNV_A_R_ECME_LINEA_0_CM 1 0. 0. 65535. DISPLAY_IDENTIFIER InCbiUli_NVM.Vtx_in_mem_lbup_cpt_NVM[4] ECU_ADDRESS 0xd00042c0 FORMAT "%5.0" /end MEASUREMENT
/begin MEASUREMENT Vtx_mem_crit_lbup_cpt[0] "Number of criteria calculated by resolution" UWORD _CNV_A_R_ECME_LINEA_0_CM 1 0. 0. 65535. DISPLAY_IDENTIFIER InCbiUli_NVM.Vtx_mem_crit_lbup_cpt_NVM[0] ECU_ADDRESS 0xd00042c4 FORMAT "%5.0" /end MEASUREMENT
/begin MEASUREMENT Vtx_mem_crit_lbup_cpt[1] "Number of criteria calculated by resolution" UWORD _CNV_A_R_ECME_LINEA_0_CM 1 0. 0. 65535. DISPLAY_IDENTIFIER InCbiUli_NVM.Vtx_mem_crit_lbup_cpt_NVM[1] ECU_ADDRESS 0xd00042c6 FORMAT "%5.0" /end MEASUREMENT
/begin MEASUREMENT Vtx_mem_crit_lbup_cpt[2] "Number of criteria calculated by resolution" UWORD _CNV_A_R_ECME_LINEA_0_CM 1 0. 0. 65535. DISPLAY_IDENTIFIER InCbiUli_NVM.Vtx_mem_crit_lbup_cpt_NVM[2] ECU_ADDRESS 0xd00042c8 FORMAT "%5.0" /end MEASUREMENT
/begin MEASUREMENT Vtx_mem_crit_lbup_cpt[3] "Number of criteria calculated by resolution" UWORD _CNV_A_R_ECME_LINEA_0_CM 1 0. 0. 65535. DISPLAY_IDENTIFIER InCbiUli_NVM.Vtx_mem_crit_lbup_cpt_NVM[3] ECU_ADDRESS 0xd00042ca FORMAT "%5.0" /end MEASUREMENT
/begin MEASUREMENT Vtx_mem_crit_lbup_cpt[4] "Number of criteria calculated by resolution" UWORD _CNV_A_R_ECME_LINEA_0_CM 1 0. 0. 65535. DISPLAY_IDENTIFIER InCbiUli_NVM.Vtx_mem_crit_lbup_cpt_NVM[4] ECU_ADDRESS 0xd00042cc FORMAT "%5.0" /end MEASUREMENT
/begin MEASUREMENT Vtx_mem_crit_lbup_cpt[5] "Number of criteria calculated by resolution" UWORD _CNV_A_R_ECME_LINEA_0_CM 1 0. 0. 65535. DISPLAY_IDENTIFIER InCbiUli_NVM.Vtx_mem_crit_lbup_cpt_NVM[5] ECU_ADDRESS 0xd00042ce FORMAT "%5.0" /end MEASUREMENT
/begin MEASUREMENT Vtx_mem_crit_lbup_cpt[6] "Number of criteria calculated by resolution" UWORD _CNV_A_R_ECME_LINEA_0_CM 1 0. 0. 65535. DISPLAY_IDENTIFIER InCbiUli_NVM.Vtx_mem_crit_lbup_cpt_NVM[6] ECU_ADDRESS 0xd00042d0 FORMAT "%5.0" /end MEASUREMENT
/begin MEASUREMENT Vtx_out_mem_lbup_cpt[0] "Number of times the system quits each diagnosis conditions" UWORD _CNV_A_R_ECME_LINEA_0_CM 1 0. 0. 65535. DISPLAY_IDENTIFIER InCbiUli_NVM.Vtx_out_mem_lbup_cpt_NVM[0] ECU_ADDRESS 0xd00042d4 FORMAT "%5.0" /end MEASUREMENT
/begin MEASUREMENT Vtx_out_mem_lbup_cpt[1] "Number of times the system quits each diagnosis conditions" UWORD _CNV_A_R_ECME_LINEA_0_CM 1 0. 0. 65535. DISPLAY_IDENTIFIER InCbiUli_NVM.Vtx_out_mem_lbup_cpt_NVM[1] ECU_ADDRESS 0xd00042d6 FORMAT "%5.0" /end MEASUREMENT
/begin MEASUREMENT Vtx_out_mem_lbup_cpt[2] "Number of times the system quits each diagnosis conditions" UWORD _CNV_A_R_ECME_LINEA_0_CM 1 0. 0. 65535. DISPLAY_IDENTIFIER InCbiUli_NVM.Vtx_out_mem_lbup_cpt_NVM[2] ECU_ADDRESS 0xd00042d8 FORMAT "%5.0" /end MEASUREMENT
/begin MEASUREMENT Vtx_out_mem_lbup_cpt[3] "Number of times the system quits each diagnosis conditions" UWORD _CNV_A_R_ECME_LINEA_0_CM 1 0. 0. 65535. DISPLAY_IDENTIFIER InCbiUli_NVM.Vtx_out_mem_lbup_cpt_NVM[3] ECU_ADDRESS 0xd00042da FORMAT "%5.0" /end MEASUREMENT
/begin MEASUREMENT Vtx_out_mem_lbup_cpt[4] "Number of times the system quits each diagnosis conditions" UWORD _CNV_A_R_ECME_LINEA_0_CM 1 0. 0. 65535. DISPLAY_IDENTIFIER InCbiUli_NVM.Vtx_out_mem_lbup_cpt_NVM[4] ECU_ADDRESS 0xd00042dc FORMAT "%5.0" /end MEASUREMENT
/begin MEASUREMENT Vxx_nr_dc_cdn_ok_lbup_cpt "Number of driving cycle with diagnosis done" UWORD _CNV_A_R_ECME_LINEA_0_CM 1 0. 0. 65535. DISPLAY_IDENTIFIER InCbiUli_NVM.Vxx_nr_dc_cdn_ok_lbup_cpt_NVM ECU_ADDRESS 0xd00042de FORMAT "%5.0" /end MEASUREMENT
/begin MEASUREMENT Vxx_t_mv_cdn_ok_lbup_cpt "Average of the maximum durations in diagnosis conditions without diagnosis done" UBYTE _CNV_A_R_LINEAR_____329_CM 1 0. 0. 63.75 DISPLAY_IDENTIFIER InCbiUli_NVM.Vxx_t_mv_cdn_ok_lbup_cpt_NVM ECU_ADDRESS 0xd00042e0 FORMAT "%5.2" /end MEASUREMENT
/begin MEASUREMENT Vbx_avl_lbup "Boolean indicating that upstream lambda sensor is ready for closed loop." UBYTE _CNV_S_2_RANGE______3_CM 1 0. 0. 1. ECU_ADDRESS 0xd0006b5d BIT_MASK 0x1 /end MEASUREMENT
/begin MEASUREMENT Vbx_df_inj_ecu_lbup_icp "Main CPU Lambda Sensor (up) pumping current detected failure" UBYTE _CNV_S_2_RANGE______3_CM 1 0. 0. 1. ECU_ADDRESS 0xd0006b5e BIT_MASK 0x1 /end MEASUREMENT
/begin MEASUREMENT Vbx_df_lbup_hot_apl_down "Front Oxygen Sensor (L/R) functionnal diagnosis before closing loop detected failure." UBYTE _CNV_S_2_RANGE______3_CM 1 0. 0. 1. ECU_ADDRESS 0xd0006b5f BIT_MASK 0x1 /end MEASUREMENT
/begin MEASUREMENT Vbx_df_lbup_nok "Front Oxygen Sensor (L/R) functionnal diagnosis after closing loop detected failure." UBYTE _CNV_S_2_RANGE______3_CM 1 0. 0. 1. ECU_ADDRESS 0xd0006b60 BIT_MASK 0x1 /end MEASUREMENT
/begin MEASUREMENT Vbx_df_lbup_oc "Front Oxygen Sensor (L/R) Open circuit detected failure" UBYTE _CNV_S_2_RANGE______3_CM 1 0. 0. 1. ECU_ADDRESS 0xd0006b61 BIT_MASK 0x1 /end MEASUREMENT
/begin MEASUREMENT Vbx_df_lbup_scg "Front Oxygen Sensor (L/R) Short circuit to ground detected failure" UBYTE _CNV_S_2_RANGE______3_CM 1 0. 0. 1. ECU_ADDRESS 0xd0006b62 BIT_MASK 0x1 /end MEASUREMENT
/begin MEASUREMENT Vbx_df_lbup_scw "Front Oxygen Sensor (L/R) Short circuit at battery + detected failure" UBYTE _CNV_S_2_RANGE______3_CM 1 0. 0. 1. ECU_ADDRESS 0xd0006b63 BIT_MASK 0x1 /end MEASUREMENT
/begin MEASUREMENT Vbx_diag_ena_inj_ecu_lbup_icp "Main CPU Lambda Sensor (up) pumping current diagnostic authorisation" UBYTE _CNV_S_2_RANGE______3_CM 1 0. 0. 1. ECU_ADDRESS 0xd0006b64 BIT_MASK 0x1 /end MEASUREMENT
/begin MEASUREMENT Vbx_diag_ena_lbup_hot_apl_down "Front Oxygen Sensor (L/R) functionnal diagnosis before closing loop authorisation." UBYTE _CNV_S_2_RANGE______3_CM 1 0. 0. 1. ECU_ADDRESS 0xd0006b65 BIT_MASK 0x1 /end MEASUREMENT
/begin MEASUREMENT Vbx_diag_ena_lbup_nok "Front Oxygen Sensor (L/R) functionnal diagnosis after closing loop authorisation." UBYTE _CNV_S_2_RANGE______3_CM 1 0. 0. 1. ECU_ADDRESS 0xd0006b66 BIT_MASK 0x1 /end MEASUREMENT
/begin MEASUREMENT Vbx_diag_ena_lbup_oc "Front Oxygen Sensor (L/R) Open circuit diagnostic authorisation" UBYTE _CNV_S_2_RANGE______3_CM 1 0. 0. 1. ECU_ADDRESS 0xd0006b67 BIT_MASK 0x1 /end MEASUREMENT
/begin MEASUREMENT Vbx_diag_ena_lbup_scg "Front Oxygen Sensor (L/R) Short circuit to ground diagnostic authorisation" UBYTE _CNV_S_2_RANGE______3_CM 1 0. 0. 1. ECU_ADDRESS 0xd0006b68 BIT_MASK 0x1 /end MEASUREMENT
/begin MEASUREMENT Vbx_diag_ena_lbup_scw "Front Oxygen Sensor (L/R) Shor circuit at battery + diagnostic authorisation" UBYTE _CNV_S_2_RANGE______3_CM 1 0. 0. 1. ECU_ADDRESS 0xd0006b69 BIT_MASK 0x1 /end MEASUREMENT
/begin MEASUREMENT Vbx_ini_temp_oc "Event of reinitialisation of retaining time for the detection of the open circuit on upstream sensor" UBYTE _CNV_S_2_RANGE______3_CM 1 0. 0. 1. ECU_ADDRESS 0xd0006b6a BIT_MASK 0x1 /end MEASUREMENT
/begin MEASUREMENT Vbx_lbup_diag_ena "Meter associated to the indicator of (warm) ready probe for the diagnoses of upstream sensor" UBYTE _CNV_S_2_RANGE______3_CM 1 0. 0. 1. ECU_ADDRESS 0xd0006b6b BIT_MASK 0x1 /end MEASUREMENT
/begin MEASUREMENT Vbx_lbup_frst_thd_hot "Indicate that the sensor signal have already been out of the min-max thd with a hot sensor." UBYTE _CNV_S_2_RANGE______3_CM 1 0. 0. 1. ECU_ADDRESS 0xd0006b6c BIT_MASK 0x1 /end MEASUREMENT
/begin MEASUREMENT Vbx_lbup_in_out_thd "Indicate if the sensor signal is in the min-max range define by calibration." UBYTE _CNV_S_2_RANGE______3_CM 1 0. 0. 1. ECU_ADDRESS 0xd0006b6d BIT_MASK 0x1 /end MEASUREMENT
/begin MEASUREMENT Vsx_lbup_vld "Front Oxygen Sensor (L/R) validity status" UBYTE _CNV_A_R_ECME_LINEA_0_CM 1 0. 0. 2. ECU_ADDRESS 0xd0006b6e FORMAT "%1.0" /end MEASUREMENT
/begin MEASUREMENT Vxx_lbup_diag_ena "Meter associated to the indicator of (warm) ready probe for the diagnoses of upstream sensor" UWORD _CNV_A_R_LINEAR_____32_CM 1 0. 0. 655.35 ECU_ADDRESS 0xd0004300 FORMAT "%6.2" /end MEASUREMENT
/begin MEASUREMENT Vxx_lbup_oc_t "Retaining time used for the detection of an open circuit defect on upstream sensor" UWORD _CNV_A_R_LINEAR_____32_CM 1 0. 0. 655.35 ECU_ADDRESS 0xd0004302 FORMAT "%6.2" /end MEASUREMENT
/begin MEASUREMENT Vxx_lbup_oc_trs_ctr "Meter of the number of transitions without taking out of the strip of detection of an open circuit on upstream sensor" UBYTE _CNV_A_R_ECME_LINEA_0_CM 1 0. 0. 255. ECU_ADDRESS 0xd0006b6f FORMAT "%3.0" /end MEASUREMENT
/begin MEASUREMENT Vxx_lbup_pump_crt_t "Time after which we make the diagnosis of the upstream sensor pumping current" UWORD _CNV_A_R_LINEAR_____32_CM 1 0. 0. 655.35 ECU_ADDRESS 0xd0004304 FORMAT "%6.2" /end MEASUREMENT
/begin MEASUREMENT Vxx_sens_lbup_v_old "Tension sounds amont measured at the moment t-1 used for the diagnosis of the open circuit" UWORD _CNV_A_R_LINEAR_____107_CM 1 0. 0. 25000. ECU_ADDRESS 0xd0004306 FORMAT "%5.0" /end MEASUREMENT
/begin CHARACTERISTIC Cbx_avl_lbup_scw_rdn "Activation of the SCW diagnosis to concider an available upstream sensor" VALUE 0xa0021416 _REC_S1VAL_20_u1 1. _CNV_S_2_RANGE______3_CM 0. 1. BIT_MASK 0x1 /end CHARACTERISTIC
/begin CHARACTERISTIC Cbx_lbup_osp_conf "Boolean of configuration to select an upstream sensor of type OSP+ (Cbx_lbup_osp_typ = one)" VALUE 0xa0021417 _REC_S1VAL_20_u1 1. _CNV_A_R_ECME_LINEA_0_CM 0. 1. FORMAT "%1.0" BIT_MASK 0x1 /end CHARACTERISTIC
/begin CHARACTERISTIC Cxx_dfdec_inj_ecu_lbup_icp "Main CPU Lambda Sensor (up) pumping current detected failure counter decrement" VALUE 0xa00213e0 _REC_S1VAL_20_u2 65535. _CNV_A_R_ECME_LINEA_0_CM 0. 65535. FORMAT "%5.0" /end CHARACTERISTIC
/begin CHARACTERISTIC Cxx_dfdec_lbup_hot_apl_down "Front Oxygen Sensor (L/R) functionnal error detected (before closing loop) failure counter decrement." VALUE 0xa00213e2 _REC_S1VAL_20_u2 65535. _CNV_A_R_ECME_LINEA_0_CM 0. 65535. FORMAT "%5.0" /end CHARACTERISTIC
/begin CHARACTERISTIC Cxx_dfdec_lbup_nok "Front Oxygen Sensor (L/R) functionnal error detected (after closing loop) failure counter decrement." VALUE 0xa00213e4 _REC_S1VAL_20_u2 65535. _CNV_A_R_ECME_LINEA_0_CM 0. 65535. FORMAT "%5.0" /end CHARACTERISTIC
/begin CHARACTERISTIC Cxx_dfdec_lbup_oc "Front Oxygen Sensor (L/R) Open circuit detected failure counter decrement" VALUE 0xa00213e6 _REC_S1VAL_20_u2 65535. _CNV_A_R_ECME_LINEA_0_CM 0. 65535. FORMAT "%5.0" /end CHARACTERISTIC
/begin CHARACTERISTIC Cxx_dfdec_lbup_scg "Front Oxygen Sensor (L/R) Short circuit to ground detected failure counter decrement" VALUE 0xa00213e8 _REC_S1VAL_20_u2 65535. _CNV_A_R_ECME_LINEA_0_CM 0. 65535. FORMAT "%5.0" /end CHARACTERISTIC
/begin CHARACTERISTIC Cxx_dfdec_lbup_scw "Front Oxygen Sensor (L/R) Short circuit at battery + detected failure counter decrement" VALUE 0xa00213ea _REC_S1VAL_20_u2 65535. _CNV_A_R_ECME_LINEA_0_CM 0. 65535. FORMAT "%5.0" /end CHARACTERISTIC
/begin CHARACTERISTIC Cxx_dfinc_inj_ecu_lbup_icp "Main CPU Lambda Sensor (up) pumping current detected failure counter increment" VALUE 0xa00213ec _REC_S1VAL_20_u2 65535. _CNV_A_R_ECME_LINEA_0_CM 0. 65535. FORMAT "%5.0" /end CHARACTERISTIC
/begin CHARACTERISTIC Cxx_dfinc_lbup_hot_apl_down "Front Oxygen Sensor (L/R) functionnal error detected (before closing loop) failure counter increment." VALUE 0xa00213ee _REC_S1VAL_20_u2 65535. _CNV_A_R_ECME_LINEA_0_CM 0. 65535. FORMAT "%5.0" /end CHARACTERISTIC
/begin CHARACTERISTIC Cxx_dfinc_lbup_nok "Front Oxygen Sensor (L/R) functionnal error detected (after closing loop) failure counter increment." VALUE 0xa00213f0 _REC_S1VAL_20_u2 65535. _CNV_A_R_ECME_LINEA_0_CM 0. 65535. FORMAT "%5.0" /end CHARACTERISTIC
/begin CHARACTERISTIC Cxx_dfinc_lbup_oc "Front Oxygen Sensor (L/R) Open circuit detected failure counter increment" VALUE 0xa00213f2 _REC_S1VAL_20_u2 65535. _CNV_A_R_ECME_LINEA_0_CM 0. 65535. FORMAT "%5.0" /end CHARACTERISTIC
/begin CHARACTERISTIC Cxx_dfinc_lbup_scg "Front Oxygen Sensor (L/R) Short circuit to ground detected failure counter increment" VALUE 0xa00213f4 _REC_S1VAL_20_u2 65535. _CNV_A_R_ECME_LINEA_0_CM 0. 65535. FORMAT "%5.0" /end CHARACTERISTIC
/begin CHARACTERISTIC Cxx_dfinc_lbup_scw "Front Oxygen Sensor (L/R) Short circuit at battery + detected failure counter increment" VALUE 0xa00213f6 _REC_S1VAL_20_u2 65535. _CNV_A_R_ECME_LINEA_0_CM 0. 65535. FORMAT "%5.0" /end CHARACTERISTIC
/begin CHARACTERISTIC Cxx_l_v_lamb_thd "Tension threshold over which lambda sensor is considered to hot and ready" VALUE 0xa00213f8 _REC_S1VAL_20_u2 25000. _CNV_A_R_LINEAR_____107_CM 0. 25000. FORMAT "%5.0" /end CHARACTERISTIC
/begin CHARACTERISTIC Cxx_lbup_hot_stt_t "Duration, after starting up, beyond which we consider the amont warm probe" VALUE 0xa00213fa _REC_S1VAL_20_u2 655.35 _CNV_A_R_LINEAR_____32_CM 0. 655.35 FORMAT "%6.2" /end CHARACTERISTIC
/begin CHARACTERISTIC Cxx_lbup_oc_det_h_v "High threshold of frame of the tension of polarization upstream sensor for the detection open circuit" VALUE 0xa00213fc _REC_S1VAL_20_u2 25000. _CNV_A_R_LINEAR_____107_CM 0. 25000. FORMAT "%5.0" /end CHARACTERISTIC
/begin CHARACTERISTIC Cxx_lbup_oc_det_l_v "Low threshold of frame of the tension of polarization upstream sensor for the detection open circuit" VALUE 0xa00213fe _REC_S1VAL_20_u2 25000. _CNV_A_R_LINEAR_____107_CM 0. 25000. FORMAT "%5.0" /end CHARACTERISTIC
/begin CHARACTERISTIC Cxx_lbup_oc_t "Lasted in the strip of detection beyond which we declare a defect opened circuit" VALUE 0xa0021400 _REC_S1VAL_20_u2 655.35 _CNV_A_R_LINEAR_____32_CM 0. 655.35 FORMAT "%6.2" /end CHARACTERISTIC
/begin CHARACTERISTIC Cxx_lbup_oc_trs_ctr "Number of transitions without taking out of the strip of detection of open circuit probe amont." VALUE 0xa0021418 _REC_S1VAL_20_u1 255. _CNV_A_R_ECME_LINEA_0_CM 0. 255. FORMAT "%3.0" /end CHARACTERISTIC
/begin CHARACTERISTIC Cxx_lbup_osp_oc_det_h_v "High threshold of frame tension of OSP+ upstream sensor polarization for detection open circuit" VALUE 0xa0021402 _REC_S1VAL_20_u2 25000. _CNV_A_R_LINEAR_____107_CM 0. 25000. FORMAT "%5.0" /end CHARACTERISTIC
/begin CHARACTERISTIC Cxx_lbup_osp_oc_det_l_v "Low threshold of frame tension of OSP+ upstream sensor polarization for detection open circuit" VALUE 0xa0021404 _REC_S1VAL_20_u2 25000. _CNV_A_R_LINEAR_____107_CM 0. 25000. FORMAT "%5.0" /end CHARACTERISTIC
/begin CHARACTERISTIC Cxx_lbup_osp_scg_det_v "Low threshold of OSP+ upstream sensor tension to discover the defect short circuit in the ground (closed loop)" VALUE 0xa0021406 _REC_S1VAL_20_u2 25000. _CNV_A_R_LINEAR_____107_CM 0. 25000. FORMAT "%5.0" /end CHARACTERISTIC
/begin CHARACTERISTIC Cxx_lbup_osp_scw_det_v "Threshold of OSP+ upsream sensor tension beyond which we discover a short circuit in + battery" VALUE 0xa0021408 _REC_S1VAL_20_u2 25000. _CNV_A_R_LINEAR_____107_CM 0. 25000. FORMAT "%5.0" /end CHARACTERISTIC
/begin CHARACTERISTIC Cxx_lbup_pump_crt_t "Lasted in the course of which we make the diagnosis of the upstream sensor pumping current" VALUE 0xa002140a _REC_S1VAL_20_u2 655.35 _CNV_A_R_LINEAR_____32_CM 0. 655.35 FORMAT "%6.2" /end CHARACTERISTIC
/begin CHARACTERISTIC Cxx_lbup_pump_crt_v_thd "Threshold of tension beyond of which we discover a breakdown of the upstream sensor pumping current" VALUE 0xa002140c _REC_S1VAL_20_u2 25000. _CNV_A_R_LINEAR_____107_CM 0. 25000. FORMAT "%5.0" /end CHARACTERISTIC
/begin CHARACTERISTIC Cxx_lbup_scg_det_v "Threshold tension sounds amont under which we discover the defect short circuit in the ground (closed loop)" VALUE 0xa002140e _REC_S1VAL_20_u2 25000. _CNV_A_R_LINEAR_____107_CM 0. 25000. FORMAT "%5.0" /end CHARACTERISTIC
/begin CHARACTERISTIC Cxx_lbup_scw_det_v "Threshold of upstream sensor tension beyond which we discover a defect short circuit in + battery" VALUE 0xa0021410 _REC_S1VAL_20_u2 25000. _CNV_A_R_LINEAR_____107_CM 0. 25000. FORMAT "%5.0" /end CHARACTERISTIC
/begin CHARACTERISTIC Cxx_lbup_v_thd "Threshold of reflation of the temporization of breakdown open circuit" VALUE 0xa0021412 _REC_S1VAL_20_u2 25000. _CNV_A_R_LINEAR_____107_CM 0. 25000. FORMAT "%5.0" /end CHARACTERISTIC
/begin CHARACTERISTIC Cxx_up_v_lamb_thd "Tension threshold under which lambda sensor is considered hot and ready" VALUE 0xa0021414 _REC_S1VAL_20_u2 25000. _CNV_A_R_LINEAR_____107_CM 0. 25000. FORMAT "%5.0" /end CHARACTERISTIC
/begin AXIS_PTS Ntb_lbup_maf "17 Break point for the \"Vxx_pump_maf_fil_lbup\" interpolation" 0xa002d1d0 Vxx_pump_maf_lbup_mv _REC_A2AXS_20_u2 3000. _CNV_A_R_LINEAR_____172_CM 17 0. 3000. READ_ONLY FORMAT "%7.2" /end AXIS_PTS
/begin CHARACTERISTIC Ctp_lbup_per_max "The oxigène sensor failure threshold" CURVE 0xa002d1f4 _REC_A1CUR_20_u2_u2 655.35 _CNV_A_R_LINEAR_____32_CM 0. 655.35 FORMAT "%6.2"
 /begin AXIS_DESCR COM_AXIS Vxx_pump_maf_lbup_mv _CNV_A_R_LINEAR_____172_CM 17 0. 3000. READ_ONLY FORMAT "%7.2" AXIS_PTS_REF Ntb_lbup_maf /end AXIS_DESCR
/end CHARACTERISTIC
/begin MEASUREMENT Vbx_df_lbup_cpt "Front Oxygen Sensor (L/R) Component diagnostic detected failure" UBYTE _CNV_S_2_RANGE______3_CM 1 0. 0. 1. ECU_ADDRESS 0xd0006b4a BIT_MASK 0x1 /end MEASUREMENT
/begin MEASUREMENT Vbx_diag_ena_lbup_cpt "Front Oxygen Sensor (L/R) Component diagnostic authorization" UBYTE _CNV_S_2_RANGE______3_CM 1 0. 0. 1. ECU_ADDRESS 0xd0006b4b BIT_MASK 0x1 /end MEASUREMENT
/begin MEASUREMENT Vbx_diag_sta_lbup_abrt "Lambda routine aborded status" UBYTE _CNV_S_2_RANGE______3_CM 1 0. 0. 1. ECU_ADDRESS 0xd0007b80 BIT_MASK 0x1 /end MEASUREMENT
/begin MEASUREMENT Vbx_diag_sta_lbup_ena "Lambda routine activation status" UBYTE _CNV_S_2_RANGE______3_CM 1 0. 0. 1. ECU_ADDRESS 0xd0006b4c BIT_MASK 0x1 /end MEASUREMENT
/begin MEASUREMENT Vbx_diag_sta_lbup_end "Lambda routine completed status" UBYTE _CNV_S_2_RANGE______3_CM 1 0. 0. 1. ECU_ADDRESS 0xd0007b81 BIT_MASK 0x1 /end MEASUREMENT
/begin MEASUREMENT Vbx_ena_diag_lbup "OBD Lambda diagnosis autorisation" UBYTE _CNV_S_2_RANGE______3_CM 1 0. 0. 1. ECU_ADDRESS 0xd0006b4d BIT_MASK 0x1 /end MEASUREMENT
/begin MEASUREMENT Vbx_inhi_ena_diag_lbup "Inhibition condition for lambda diagnostic" UBYTE _CNV_S_2_RANGE______3_CM 1 0. 0. 1. ECU_ADDRESS 0xd0006b4e BIT_MASK 0x1 /end MEASUREMENT
/begin MEASUREMENT Vbx_lbup_diag_stop "Lambda diagnostic is complete" UBYTE _CNV_S_2_RANGE______3_CM 1 0. 0. 1. ECU_ADDRESS 0xd0006b4f BIT_MASK 0x1 /end MEASUREMENT
/begin MEASUREMENT Vbx_lbup_dsb_ad_rich "Lambda diagnostic asks for the inhibition of the richness adaptative" UBYTE _CNV_S_2_RANGE______3_CM 1 0. 0. 1. ECU_ADDRESS 0xd0006b50 BIT_MASK 0x1 /end MEASUREMENT
/begin MEASUREMENT Vbx_lbup_dsb_cp "OBD lambda diagnostic request" UBYTE _CNV_S_2_RANGE______3_CM 1 0. 0. 1. ECU_ADDRESS 0xd0006b51 BIT_MASK 0x1 /end MEASUREMENT
/begin MEASUREMENT Vbx_lbup_mes "Lambda diagnostic mesure is complete" UBYTE _CNV_S_2_RANGE______3_CM 1 0. 0. 1. ECU_ADDRESS 0xd0006b52 BIT_MASK 0x1 /end MEASUREMENT
/begin MEASUREMENT Vbx_lbup_per_dly_acq_max "Maximum duration of reached acquisition" UBYTE _CNV_S_2_RANGE______3_CM 1 0. 0. 1. ECU_ADDRESS 0xd0006b53 BIT_MASK 0x1 /end MEASUREMENT
/begin MEASUREMENT Vbx_lbup_req "OBD lambda diagnostic request" UBYTE _CNV_S_2_RANGE______3_CM 1 0. 0. 1. ECU_ADDRESS 0xd0006b54 BIT_MASK 0x1 /end MEASUREMENT
/begin MEASUREMENT Vbx_phy_ena_diag_lbup "Physical condition for lambda diagnostic" UBYTE _CNV_S_2_RANGE______3_CM 1 0. 0. 1. ECU_ADDRESS 0xd0006b55 BIT_MASK 0x1 /end MEASUREMENT
/begin MEASUREMENT Vbx_sw_ena_diag_lbup "Softxare condition for lambda diagnostic" UBYTE _CNV_S_2_RANGE______3_CM 1 0. 0. 1. ECU_ADDRESS 0xd0006b56 BIT_MASK 0x1 /end MEASUREMENT
/begin MEASUREMENT Vsx_diag_sta_lbup_stt "Lambda routine status" UBYTE _CNV_A_R_ECME_LINEA_0_CM 1 0. 0. 255. ECU_ADDRESS 0xd0006b40 FORMAT "%3.0" /end MEASUREMENT
/begin MEASUREMENT Vsx_lbup_stt "Lambda diagnostic states" UBYTE _CNV_A_R_ECME_LINEA_0_CM 1 0. 0. 60. ECU_ADDRESS 0xd0006b41 FORMAT "%2.0" /end MEASUREMENT
/begin MEASUREMENT Vxx_edic_lbup_dly "Timer for minimal waiting between two diagnosis for edic needs" UWORD _CNV_A_R_LINEAR_____32_CM 1 0. 0. 655.35 ECU_ADDRESS 0xd00042e4 FORMAT "%6.2" /end MEASUREMENT
/begin MEASUREMENT Vxx_lbup_asd_diag_ctr "Counter of diagnostic in after sale mode" UBYTE _CNV_A_R_ECME_LINEA_0_CM 1 0. 0. 255. ECU_ADDRESS 0xd0006b42 FORMAT "%3.0" /end MEASUREMENT
/begin MEASUREMENT Vxx_lbup_asd_sf "Lambda state for after sale mode" UBYTE _CNV_A_R_ECME_LINEA_0_CM 1 0. 0. 3. ECU_ADDRESS 0xd0006b43 FORMAT "%1.0" /end MEASUREMENT
/begin MEASUREMENT Vxx_lbup_asd_sf_ctr "Counter of diagnostic result consecutive in the same state for after sale diagnostic" UBYTE _CNV_A_R_ECME_LINEA_0_CM 1 0. 0. 255. ECU_ADDRESS 0xd0006b44 FORMAT "%3.0" /end MEASUREMENT
/begin MEASUREMENT Vxx_lbup_asd_tout_dly "Time out for after sale diagnostic if the request can't switch to on" UWORD _CNV_A_R_LINEAR_____32_CM 1 0. 0. 655.35 ECU_ADDRESS 0xd00042e6 FORMAT "%6.2" /end MEASUREMENT
/begin MEASUREMENT Vxx_lbup_in_ctr "Counter of transition Nsx_lbup_cpt_dg_dsb to Nsx_lbup_cpt_stab" UBYTE _CNV_A_R_ECME_LINEA_0_CM 1 0. 0. 255. ECU_ADDRESS 0xd0006b45 FORMAT "%3.0" /end MEASUREMENT
/begin MEASUREMENT Vxx_lbup_jerk_nr "Number of bad transition" UBYTE _CNV_A_R_ECME_LINEA_0_CM 1 0. 0. 255. ECU_ADDRESS 0xd0006b46 FORMAT "%3.0" /end MEASUREMENT
/begin MEASUREMENT Vxx_lbup_per_ctr "Counter of the periode duration" UWORD _CNV_A_R_LINEAR_____32_CM 1 0. 0. 655.35 ECU_ADDRESS 0xd00042e8 FORMAT "%6.2" /end MEASUREMENT
/begin MEASUREMENT Vxx_lbup_per_dly_acq "Result of the elementary mesure acquisition" UWORD _CNV_A_R_LINEAR_____32_CM 1 0. 0. 655.35 ECU_ADDRESS 0xd00042ea FORMAT "%6.2" /end MEASUREMENT
/begin MEASUREMENT Vxx_lbup_per_dly_tot "Result of the total mesure acquisition" UWORD _CNV_A_R_LINEAR_____32_CM 1 0. 0. 655.35 ECU_ADDRESS 0xd00042ec FORMAT "%6.2" /end MEASUREMENT
/begin MEASUREMENT Vxx_lbup_per_mv "The average période elementary" UWORD _CNV_A_R_LINEAR_____32_CM 1 0. 0. 655.35 ECU_ADDRESS 0xd00042ee FORMAT "%6.2" /end MEASUREMENT
/begin MEASUREMENT Vxx_lbup_per_mv_max "The oxygen sensor failure threshold" UWORD _CNV_A_R_LINEAR_____32_CM 1 0. 0. 655.35 ECU_ADDRESS 0xd00042f0 FORMAT "%6.2" /end MEASUREMENT
/begin MEASUREMENT Vxx_lbup_per_nr "Number of periode during elementary acquisition" UBYTE _CNV_A_R_ECME_LINEA_0_CM 1 0. 0. 255. ECU_ADDRESS 0xd0006b47 FORMAT "%3.0" /end MEASUREMENT
/begin MEASUREMENT Vxx_lbup_per_nr_tot "Number of total periode for the diagnostic" UBYTE _CNV_A_R_ECME_LINEA_0_CM 1 0. 0. 255. ECU_ADDRESS 0xd0006b48 FORMAT "%3.0" /end MEASUREMENT
/begin MEASUREMENT Vxx_lbup_per_out_mes "Number of transition poor/rich before mesure" UBYTE _CNV_A_R_ECME_LINEA_0_CM 1 0. 0. 255. ECU_ADDRESS 0xd0006b49 FORMAT "%3.0" /end MEASUREMENT
/begin MEASUREMENT Vxx_lbup_per_tot_mv "The average période total for the diagnostic" UWORD _CNV_A_R_LINEAR_____32_CM 1 0. 0. 655.35 ECU_ADDRESS 0xd00042f2 FORMAT "%6.2" /end MEASUREMENT
/begin MEASUREMENT Vxx_lbup_stab_dly "Timer for stabilisation before mesure" UWORD _CNV_A_R_LINEAR_____32_CM 1 0. 0. 655.35 ECU_ADDRESS 0xd00042f4 FORMAT "%6.2" /end MEASUREMENT
/begin MEASUREMENT Vxx_lgl_dly_diag_lbup "Timer before catalyst diagnosis" UWORD _CNV_A_R_LINEAR_____58_CM 1 0. 0. 6553.5 ECU_ADDRESS 0xd00042f6 FORMAT "%6.1" /end MEASUREMENT
/begin MEASUREMENT Vxx_pump_maf_lbup_mem "Amount of air pumped into cylinder memorised for the diagnostic stability" UWORD _CNV_A_R_LINEAR_____172_CM 1 0. 0. 3000. ECU_ADDRESS 0xd00042f8 FORMAT "%7.2" /end MEASUREMENT
/begin MEASUREMENT Vxx_pump_maf_lbup_mv "Amount of air pumped into cylinder for lambda diagnostic" UWORD _CNV_A_R_LINEAR_____172_CM 1 0. 0. 3000. ECU_ADDRESS 0xd00042fa FORMAT "%7.2" /end MEASUREMENT
/begin MEASUREMENT Vxx_pump_maf_lbup_prop_per "Amount of air pumped into cylinder memorised during the elementary mesure * number of elementary période" UWORD _CNV_A_R_LINEAR_____172_CM 1 0. 0. 3000. ECU_ADDRESS 0xd00042fc FORMAT "%7.2" /end MEASUREMENT
/begin CHARACTERISTIC Cxx_conf_diag_lbup "Lambda Diagnostic is: 0=forbidden; 1=conventional mode; 2=bench mode" VALUE 0xa00213d6 _REC_S1VAL_20_u1 3. _CNV_A_R_ECME_LINEA_0_CM 0. 3. FORMAT "%1.0" /end CHARACTERISTIC
/begin CHARACTERISTIC Cxx_dfdec_lbup_cpt "Front Oxygen Sensor (L/R) Component detected failure counter decrement" VALUE 0xa00213ae _REC_S1VAL_20_u2 65535. _CNV_A_R_ECME_LINEA_0_CM 0. 65535. FORMAT "%5.0" /end CHARACTERISTIC
/begin CHARACTERISTIC Cxx_dfinc_lbup_cpt "Front Oxygen Sensor (L/R) Component detected failure counter increment" VALUE 0xa00213b0 _REC_S1VAL_20_u2 65535. _CNV_A_R_ECME_LINEA_0_CM 0. 65535. FORMAT "%5.0" /end CHARACTERISTIC
/begin CHARACTERISTIC Cxx_edic_lbup_dly "Minimum duration waiting between two diagnosis for edic needs" VALUE 0xa00213b2 _REC_S1VAL_20_u2 655.35 _CNV_A_R_LINEAR_____32_CM 0. 655.35 FORMAT "%6.2" /end CHARACTERISTIC
/begin CHARACTERISTIC Cxx_lbup_asd_diag_nr "Maximum number of diagnostic in after sale mode" VALUE 0xa00213d7 _REC_S1VAL_20_u1 255. _CNV_A_R_ECME_LINEA_0_CM 0. 255. FORMAT "%3.0" /end CHARACTERISTIC
/begin CHARACTERISTIC Cxx_lbup_asd_in_nr "Number of attempt for diagnosis in after sale mode" VALUE 0xa00213d8 _REC_S1VAL_20_u1 255. _CNV_A_R_ECME_LINEA_0_CM 0. 255. FORMAT "%3.0" /end CHARACTERISTIC
/begin CHARACTERISTIC Cxx_lbup_asd_sf_nr "Number of diagnostic result consecutive in the same state for after sale diagnostic" VALUE 0xa00213d9 _REC_S1VAL_20_u1 255. _CNV_A_R_ECME_LINEA_0_CM 0. 255. FORMAT "%3.0" /end CHARACTERISTIC
/begin CHARACTERISTIC Cxx_lbup_asd_tout_dly "Time out for after sale diagnostic if the request can't switch to on" VALUE 0xa00213b4 _REC_S1VAL_20_u2 655.35 _CNV_A_R_LINEAR_____32_CM 0. 655.35 FORMAT "%6.2" /end CHARACTERISTIC
/begin CHARACTERISTIC Cxx_lbup_diag_gear "Gear engaged ([-1 0 1 2 3 4 5 6]) for Lambda diagnosis authorization" VALUE 0xa00213da _REC_S1VAL_20_u1 7. _CNV_A_R_LINEAR_____145_CM -1. 6. FORMAT "%2.0" /end CHARACTERISTIC
/begin CHARACTERISTIC Cxx_lbup_fuel_typ_rat_max_1 "First maximum rate of exotic fuel to authorize the diagnosis of the oxygen sensor" VALUE 0xa00213b6 _REC_S1VAL_20_u2 1. _CNV_A_R_LINEAR_____161_CM 0. 1. FORMAT "%5.3" /end CHARACTERISTIC
/begin CHARACTERISTIC Cxx_lbup_fuel_typ_rat_max_2 "Second maximum rate of exotic fuel to authorize the diagnosis of the oxygen sensor" VALUE 0xa00213b8 _REC_S1VAL_20_u2 1. _CNV_A_R_LINEAR_____161_CM 0. 1. FORMAT "%5.3" /end CHARACTERISTIC
/begin CHARACTERISTIC Cxx_lbup_fuel_typ_rat_min_1 "First minimum rate of exotic fuel to authorize the diagnosis of the oxygen sensor" VALUE 0xa00213ba _REC_S1VAL_20_u2 1. _CNV_A_R_LINEAR_____161_CM 0. 1. FORMAT "%5.3" /end CHARACTERISTIC
/begin CHARACTERISTIC Cxx_lbup_fuel_typ_rat_min_2 "Second minimum rate of exotic fuel to authorize the diagnosis of the oxygen sensor" VALUE 0xa00213bc _REC_S1VAL_20_u2 1. _CNV_A_R_LINEAR_____161_CM 0. 1. FORMAT "%5.3" /end CHARACTERISTIC
/begin CHARACTERISTIC Cxx_lbup_hys_maf "Hysteresis on amount of air pumped into cylinder for diagnosis conditions." VALUE 0xa00213be _REC_S1VAL_20_u2 3000. _CNV_A_R_LINEAR_____172_CM 0. 3000. FORMAT "%7.2" /end CHARACTERISTIC
/begin CHARACTERISTIC Cxx_lbup_hys_n "Hysteresis on engine speed for diagnostic conditions" VALUE 0xa00213c0 _REC_S1VAL_20_u2 16383.75 _CNV_A_R_ENSD_LINEA_22_CM 0. 16383.75 FORMAT "%8.2" /end CHARACTERISTIC
/begin CHARACTERISTIC Cxx_lbup_in_nr "Number of attempt for diagnostis" VALUE 0xa00213db _REC_S1VAL_20_u1 255. _CNV_A_R_ECME_LINEA_0_CM 0. 255. FORMAT "%3.0" /end CHARACTERISTIC
/begin CHARACTERISTIC Cxx_lbup_maf_dif_max "Maximum variation of aount of air pumped into cylinder for diagnosis cnditions" VALUE 0xa00213c2 _REC_S1VAL_20_u2 3000. _CNV_A_R_LINEAR_____172_CM 0. 3000. FORMAT "%7.2" /end CHARACTERISTIC
/begin CHARACTERISTIC Cxx_lbup_maf_max "Maximum value of aount of air pumped into cylinder for diagnosis cnditions" VALUE 0xa00213c4 _REC_S1VAL_20_u2 3000. _CNV_A_R_LINEAR_____172_CM 0. 3000. FORMAT "%7.2" /end CHARACTERISTIC
/begin CHARACTERISTIC Cxx_lbup_maf_mes_max "Maximum drift of aount of air pumped into cylinder for diagnosis cnditions" VALUE 0xa00213c6 _REC_S1VAL_20_u2 3000. _CNV_A_R_LINEAR_____172_CM 0. 3000. FORMAT "%7.2" /end CHARACTERISTIC
/begin CHARACTERISTIC Cxx_lbup_maf_min "Minimum value of aount of air pumped into cylinder for diagnosis cnditions" VALUE 0xa00213c8 _REC_S1VAL_20_u2 3000. _CNV_A_R_LINEAR_____172_CM 0. 3000. FORMAT "%7.2" /end CHARACTERISTIC
/begin CHARACTERISTIC Cxx_lbup_n_max "Maximum value of engine speed for diagnosis condition" VALUE 0xa00213ca _REC_S1VAL_20_u2 16383.75 _CNV_A_R_ENSD_LINEA_22_CM 0. 16383.75 FORMAT "%8.2" /end CHARACTERISTIC
/begin CHARACTERISTIC Cxx_lbup_n_min "Minimum value of engine speed for diagnosis condition" VALUE 0xa00213cc _REC_S1VAL_20_u2 16383.75 _CNV_A_R_ENSD_LINEA_22_CM 0. 16383.75 FORMAT "%8.2" /end CHARACTERISTIC
/begin CHARACTERISTIC Cxx_lbup_per_dly "Maximum duration for one periode." VALUE 0xa00213ce _REC_S1VAL_20_u2 655.35 _CNV_A_R_LINEAR_____330_CM 2. 657.35 FORMAT "%6.2" /end CHARACTERISTIC
/begin CHARACTERISTIC Cxx_lbup_per_nr_min "Minimum number of periode for evry acquisitions." VALUE 0xa00213dc _REC_S1VAL_20_u1 255. _CNV_A_R_ECME_LINEA_0_CM 0. 255. FORMAT "%3.0" /end CHARACTERISTIC
/begin CHARACTERISTIC Cxx_lbup_per_nr_tot "Number of total periode for the diagnostic needs" VALUE 0xa00213dd _REC_S1VAL_20_u1 255. _CNV_A_R_ECME_LINEA_0_CM 0. 255. FORMAT "%3.0" /end CHARACTERISTIC
/begin CHARACTERISTIC Cxx_lbup_per_swi_nr "Number of transition poor/rich needs before mesure" VALUE 0xa00213de _REC_S1VAL_20_u1 255. _CNV_A_R_ECME_LINEA_0_CM 0. 255. FORMAT "%3.0" /end CHARACTERISTIC
/begin CHARACTERISTIC Cxx_lbup_stab_dly "Duration of the stabilisation before mesure" VALUE 0xa00213d0 _REC_S1VAL_20_u2 655.35 _CNV_A_R_LINEAR_____32_CM 0. 655.35 FORMAT "%6.2" /end CHARACTERISTIC
/begin CHARACTERISTIC Cxx_lbup_tco_min "Minimum value of engine coolant temperature for diagnosis conditions." VALUE 0xa00213d2 _REC_S1VAL_20_u2 240. _CNV_A_R_LINEAR_____110_CM -40. 200. FORMAT "%5.1" /end CHARACTERISTIC
/begin CHARACTERISTIC Cxx_lgl_dly_diag_lbup "Duration before catalyst diagnosis" VALUE 0xa00213d4 _REC_S1VAL_20_u2 6553.5 _CNV_A_R_LINEAR_____58_CM 0. 6553.5 FORMAT "%6.1" /end CHARACTERISTIC
/begin CHARACTERISTIC Cmp_n_eal_lbup_v_thd "Map of upstream lambda tension threshold for richness control. function of engine speed and engine air load" MAP 0xa002d218 _REC_A1MAP_20_u2_u2_u2 25000. _CNV_A_R_LINEAR_____107_CM 0. 25000. FORMAT "%5.0"
 /begin AXIS_DESCR COM_AXIS Vxx_n _CNV_A_R_ENSD_LINEA_22_CM 20 0. 16383.75 FORMAT "%8.2" AXIS_PTS_REF Ctb_n /end AXIS_DESCR
 /begin AXIS_DESCR COM_AXIS Vxx_eal _CNV_A_R_LINEAR_____53_CM 16 0. 3.99993896484375 FORMAT "%10.8" AXIS_PTS_REF Ctb_eal /end AXIS_DESCR
/end CHARACTERISTIC
/begin MEASUREMENT Vbx_diag_lbup_down_stt "Low state confirmed by the upstream sensor for the diagnosis OBD of sensor" UBYTE _CNV_S_2_RANGE______3_CM 1 0. 0. 1. ECU_ADDRESS 0xd0006b78 BIT_MASK 0x1 /end MEASUREMENT
/begin MEASUREMENT Vbx_diag_lbup_up_stt "High state confirmed by the upstream sensor for the diagnosis OBD of sensor" UBYTE _CNV_S_2_RANGE______3_CM 1 0. 0. 1. ECU_ADDRESS 0xd0006b79 BIT_MASK 0x1 /end MEASUREMENT
/begin MEASUREMENT Vbx_lbup_down_stt "Low state confirmed by the sensor" UBYTE _CNV_S_2_RANGE______3_CM 1 0. 0. 1. ECU_ADDRESS 0xd0006b7a BIT_MASK 0x1 /end MEASUREMENT
/begin MEASUREMENT Vbx_lbup_efv_stt "Real state of the sensor with regard to lambda" UBYTE _CNV_S_2_RANGE______3_CM 1 0. 0. 1. ECU_ADDRESS 0xd0006b7b BIT_MASK 0x1 /end MEASUREMENT
/begin MEASUREMENT Vbx_lbup_fail_trs "Glitch discovered for pc" UBYTE _CNV_S_2_RANGE______3_CM 1 0. 0. 1. ECU_ADDRESS 0xd0006b7c BIT_MASK 0x1 /end MEASUREMENT
/begin MEASUREMENT Vbx_lbup_igk_off_on "Ignition off on key signal for lbup" UBYTE _CNV_S_2_RANGE______3_CM 1 0. 0. 1. ECU_ADDRESS 0xd0006b7d BIT_MASK 0x1 /end MEASUREMENT
/begin MEASUREMENT Vbx_lbup_lean_rich_trs "Rich / poor transition" UBYTE _CNV_S_2_RANGE______3_CM 1 0. 0. 1. ECU_ADDRESS 0xd0006b7e BIT_MASK 0x1 /end MEASUREMENT
/begin MEASUREMENT Vbx_lbup_stt "The current rich or poor state of the upstream sensor" UBYTE _CNV_S_2_RANGE______3_CM 1 0. 0. 1. ECU_ADDRESS 0xd0006b7f BIT_MASK 0x1 /end MEASUREMENT
/begin MEASUREMENT Vbx_lbup_sw_stt "Software state (delayed or no lead) the upstream sensor with regard to lambda" UBYTE _CNV_S_2_RANGE______3_CM 1 0. 0. 1. ECU_ADDRESS 0xd0006b80 BIT_MASK 0x1 /end MEASUREMENT
/begin MEASUREMENT Vbx_lbup_trs "Transition sensor" UBYTE _CNV_S_2_RANGE______3_CM 1 0. 0. 1. ECU_ADDRESS 0xd0006b81 BIT_MASK 0x1 /end MEASUREMENT
/begin MEASUREMENT Vbx_lbup_up_stt "High state confirmed by the probe" UBYTE _CNV_S_2_RANGE______3_CM 1 0. 0. 1. ECU_ADDRESS 0xd0006b82 BIT_MASK 0x1 /end MEASUREMENT
/begin MEASUREMENT Vbx_obd_lbup_fail_trs "Glitch discovered for OBD" UBYTE _CNV_S_2_RANGE______3_CM 1 0. 0. 1. ECU_ADDRESS 0xd0006b83 BIT_MASK 0x1 /end MEASUREMENT
/begin MEASUREMENT Vxx_lbup_trs_dly "Temporization of delay in the transition of the upstream sensor" UBYTE _CNV_A_R_LINEAR_____32_CM 1 0. 0. 2.55 ECU_ADDRESS 0xd0006b84 FORMAT "%4.2" /end MEASUREMENT
/begin CHARACTERISTIC Cbx_lbup_sw_dly_req "With or without software delay" VALUE 0xa002142a _REC_S1VAL_20_u1 1. _CNV_A_R_ECME_LINEA_0_CM 0. 1. FORMAT "%1.0" BIT_MASK 0x1 /end CHARACTERISTIC
/begin CHARACTERISTIC Cxx_cp_trs_h_thd "High threshold between 2 transitions poor / rich to validate a period for the bleeding to canister" VALUE 0xa002141a _REC_S1VAL_20_u2 25000. _CNV_A_R_LINEAR_____107_CM 0. 25000. FORMAT "%5.0" /end CHARACTERISTIC
/begin CHARACTERISTIC Cxx_cp_trs_l_thd "Low threshold between 2 transitions poor / rich to validate a period for the bleeding to canister" VALUE 0xa002141c _REC_S1VAL_20_u2 25000. _CNV_A_R_LINEAR_____107_CM 0. 25000. FORMAT "%5.0" /end CHARACTERISTIC
/begin CHARACTERISTIC Cxx_diag_trs_h_thd "High threshold between 2 transitions poor / rich to validate a period for the diagnosis sensor" VALUE 0xa002141e _REC_S1VAL_20_u2 25000. _CNV_A_R_LINEAR_____107_CM 0. 25000. FORMAT "%5.0" /end CHARACTERISTIC
/begin CHARACTERISTIC Cxx_diag_trs_l_thd "Low threshold between 2 transitions poor / rich to validate a period for the diagnosis sensor" VALUE 0xa0021420 _REC_S1VAL_20_u2 25000. _CNV_A_R_LINEAR_____107_CM 0. 25000. FORMAT "%5.0" /end CHARACTERISTIC
/begin CHARACTERISTIC Cxx_lbup_v_eal_dft "Replacement value in case of defect of the pressure sensor" VALUE 0xa0021422 _REC_S1VAL_20_u2 25000. _CNV_A_R_LINEAR_____107_CM 0. 25000. FORMAT "%5.0" /end CHARACTERISTIC
/begin CHARACTERISTIC Cxx_lbup_v_max_thd "Maximum tension threshold for upstream sensor overwhich richness control is not accurate." VALUE 0xa0021424 _REC_S1VAL_20_u2 25000. _CNV_A_R_LINEAR_____107_CM 0. 25000. FORMAT "%5.0" /end CHARACTERISTIC
/begin CHARACTERISTIC Cxx_lbup_v_min_thd "Minimu tension threshold for upstream sensor underwhich richness control is not accurate." VALUE 0xa0021426 _REC_S1VAL_20_u2 25000. _CNV_A_R_LINEAR_____107_CM 0. 25000. FORMAT "%5.0" /end CHARACTERISTIC
/begin CHARACTERISTIC Cxx_lean_rich_trs_dly "Duration of the delay in the rich / poor transition in mode bench diagnosis sensor" VALUE 0xa002142b _REC_S1VAL_20_u1 2.55 _CNV_A_R_LINEAR_____32_CM 0. 2.55 FORMAT "%4.2" /end CHARACTERISTIC
/begin CHARACTERISTIC Cxx_rich_lean_trs_dly "Duration of the delay in the poor / rich transition in mode bench diagnosis sensor" VALUE 0xa002142c _REC_S1VAL_20_u1 2.55 _CNV_A_R_LINEAR_____32_CM 0. 2.55 FORMAT "%4.2" /end CHARACTERISTIC
/begin CHARACTERISTIC Cxx_trs_thd "Threshold of transition rich / poor" VALUE 0xa0021428 _REC_S1VAL_20_u2 25000. _CNV_A_R_LINEAR_____107_CM 0. 25000. FORMAT "%5.0" /end CHARACTERISTIC
/begin AXIS_PTS Ctb_n "20 programmable engine speed breakpoints map" 0xa002db74 Vxx_n _REC_A2AXS_20_u2 16383.75 _CNV_A_R_ENSD_LINEA_22_CM 20 0. 16383.75 FORMAT "%8.2" /end AXIS_PTS
/begin AXIS_PTS Ctb_n2 "9 programmable engine speed breakpoints table" 0xa002dba0 Vxx_n _REC_A2AXS_20_u2 16383.75 _CNV_A_R_ENSD_LINEA_22_CM 9 0. 16383.75 FORMAT "%8.2" /end AXIS_PTS
/begin AXIS_PTS Ctb_coup "Breakpoint calibration of transmission coupler states" 0xa00215ba Vxx_ant_coup _REC_A2AXS_20_u1 255. _CNV_A_R_ECME_LINEA_0_CM 3 0. 255. FORMAT "%3.0" /end AXIS_PTS
/begin AXIS_PTS Ntb_gear "Gearbox ratio breakpoint" 0xa002da28 Vxx_gear _REC_A2AXS_20_u1 7. _CNV_A_R_LINEAR_____145_CM 8 -1. 6. READ_ONLY FORMAT "%2.0" /end AXIS_PTS
/begin AXIS_PTS Ctb_ajs_dt_tq_rat "a_sm_caj_ctl_ajcorxx_xxx_xx_x_a/Breakpoint calibration of driveline torque ratio" 0xa0033568 Vxx_ajs_dt_tq_rat _REC_A2AXS_20_u2 210. _CNV_A_R_LINEAR_____313_CM 12 -10. 200. FORMAT "%6.2" /end AXIS_PTS
/begin COMPU_METHOD _CNV_A_R_ECME_LINEA_0_CM "" RAT_FUNC "%6.3" "-" COEFFS 0 1. 0. 0 0 1 /end COMPU_METHOD
/begin COMPU_METHOD _CNV_S_2_RANGE______3_CM "" TAB_VERB "%6.3" "-" COMPU_TAB_REF _CNV_S_2_RANGE______3 /end COMPU_METHOD
/begin COMPU_VTAB _CNV_S_2_RANGE______3 "" TAB_VERB 2 0 "0" 1 "1" /end COMPU_VTAB
/begin COMPU_METHOD _CNV_A_R_ENSD_LINEA_22_CM "" RAT_FUNC "%6.3" "rpm" COEFFS 0 4. 0. 0 0 1 /end COMPU_METHOD
/begin COMPU_METHOD _CNV_A_R_LINEAR_____29_CM "" RAT_FUNC "%6.3" "-" COEFFS 0 256. 0. 0 0 1 /end COMPU_METHOD
/begin COMPU_METHOD _CNV_A_R_LINEAR_____32_CM "" RAT_FUNC "%6.3" "s" COEFFS 0 100. 0. 0 0 1 /end COMPU_METHOD
/begin COMPU_METHOD _CNV_A_R_LINEAR_____42_CM "" RAT_FUNC "%6.3" "-" COEFFS 0 128. 0. 0 0 1 /end COMPU_METHOD
/begin COMPU_METHOD _CNV_A_R_LINEAR_____48_CM "" RAT_FUNC "%6.3" "-" COEFFS 0 32767.99999999992 0. 0 0 1 /end COMPU_METHOD
/begin COMPU_METHOD _CNV_A_R_LINEAR_____53_CM "" RAT_FUNC "%6.3" "-" COEFFS 0 16384. 0. 0 0 1 /end COMPU_METHOD
/begin COMPU_METHOD _CNV_A_R_LINEAR_____58_CM "" RAT_FUNC "%6.3" "s" COEFFS 0 10. 0. 0 0 1 /end COMPU_METHOD
/begin COMPU_METHOD _CNV_A_R_LINEAR_____83_CM "" RAT_FUNC "%6.3" "-" COEFFS 0 64. 0. 0 0 1 /end COMPU_METHOD
/begin COMPU_METHOD _CNV_A_R_LINEAR_____101_CM "" RAT_FUNC "%6.3" "TDC" COEFFS 0 1. 0. 0 0 1 /end COMPU_METHOD
/begin COMPU_METHOD _CNV_A_R_LINEAR_____107_CM "" RAT_FUNC "%6.3" "mV" COEFFS 0 1. 0. 0 0 1 /end COMPU_METHOD
/begin COMPU_METHOD _CNV_A_R_LINEAR_____110_CM "" RAT_FUNC "%6.3" "°C" COEFFS 0 10. 400. 0 0 1 /end COMPU_METHOD
/begin COMPU_METHOD _CNV_A_R_LINEAR_____115_CM "" RAT_FUNC "%6.3" "hPa" COEFFS 0 1. 0. 0 0 1 /end COMPU_METHOD
/begin COMPU_METHOD _CNV_A_R_LINEAR_____116_CM "" RAT_FUNC "%6.3" "s" COEFFS 0 1000. 0. 0 0 1 /end COMPU_METHOD
/begin COMPU_METHOD _CNV_A_R_LINEAR_____123_CM "" RAT_FUNC "%6.3" "-" COEFFS 0 100. 0. 0 0 1 /end COMPU_METHOD
/begin COMPU_METHOD _CNV_A_R_LINEAR_____129_CM "" RAT_FUNC "%6.3" "°CRK" COEFFS 0 50. 0. 0 0 1 /end COMPU_METHOD
/begin COMPU_METHOD _CNV_A_R_LINEAR_____130_CM "" RAT_FUNC "%6.3" "-" COEFFS 0 256. -1. 0 0 1 /end COMPU_METHOD
/begin COMPU_METHOD _CNV_A_R_LINEAR_____133_CM "" RAT_FUNC "%6.3" "mg/stk" COEFFS 0 390.625 0. 0 0 1 /end COMPU_METHOD
/begin COMPU_METHOD _CNV_A_R_LINEAR_____145_CM "" RAT_FUNC "%6.3" "-" COEFFS 0 1. 1. 0 0 1 /end COMPU_METHOD
/begin COMPU_METHOD _CNV_A_R_LINEAR_____147_CM "" RAT_FUNC "%6.3" "-" COEFFS 0 32768.0000069121 0. 0 0 1 /end COMPU_METHOD
/begin COMPU_METHOD _CNV_A_R_LINEAR_____149_CM "" RAT_FUNC "%6.3" "-" COEFFS 0 2048. 0. 0 0 1 /end COMPU_METHOD
/begin COMPU_METHOD _CNV_A_R_LINEAR_____153_CM "" RAT_FUNC "%6.3" "-" COEFFS 0 256. -256. 0 0 1 /end COMPU_METHOD
/begin COMPU_METHOD _CNV_A_R_LINEAR_____158_CM "" RAT_FUNC "%6.3" "hPa" COEFFS 0 1. 10000. 0 0 1 /end COMPU_METHOD
/begin COMPU_METHOD _CNV_A_R_LINEAR_____161_CM "" RAT_FUNC "%6.3" "-" COEFFS 0 1000. 0. 0 0 1 /end COMPU_METHOD
/begin COMPU_METHOD _CNV_A_R_LINEAR_____162_CM "" RAT_FUNC "%6.3" "-" COEFFS 0 255. 0. 0 0 1 /end COMPU_METHOD
/begin COMPU_METHOD _CNV_A_R_LINEAR_____170_CM "" RAT_FUNC "%6.3" "-" COEFFS 0 16384. -8192. 0 0 1 /end COMPU_METHOD
/begin COMPU_METHOD _CNV_A_R_LINEAR_____172_CM "" RAT_FUNC "%6.3" "kg/h" COEFFS 0 20. 0. 0 0 1 /end COMPU_METHOD
/begin COMPU_METHOD _CNV_S_3_STATUS_OK__179_CM "" TAB_VERB "%6.3" "-" COMPU_TAB_REF _CNV_S_3_STATUS_OK__179 /end COMPU_METHOD
/begin COMPU_VTAB _CNV_S_3_STATUS_OK__179 "" TAB_VERB 3 0 "Nsx_vld_nok_0" 1 "Nsx_vld_ok_1" 2 "Nsx_vld_fail_2" /end COMPU_VTAB
/begin COMPU_METHOD _CNV_A_R_LINEAR_____181_CM "" RAT_FUNC "%6.3" "Nm" COEFFS 0 32. 0. 0 0 1 /end COMPU_METHOD
/begin COMPU_METHOD _CNV_A_R_LINEAR_____182_CM "" RAT_FUNC "%6.3" "rpm" COEFFS 0 4. 32768. 0 0 1 /end COMPU_METHOD
/begin COMPU_METHOD _CNV_A_R_LINEAR_____183_CM "" RAT_FUNC "%6.3" "-" COEFFS 0 1024. 0. 0 0 1 /end COMPU_METHOD
/begin COMPU_METHOD _CNV_A_R_LINEAR_____193_CM "" RAT_FUNC "%6.3" "Nm/rpm" COEFFS 0 8192. 0. 0 0 1 /end COMPU_METHOD
/begin COMPU_METHOD _CNV_A_R_LINEAR_____216_CM "" RAT_FUNC "%6.3" "Nm" COEFFS 0 32. 12800. 0 0 1 /end COMPU_METHOD
/begin COMPU_METHOD _CNV_A_R_LINEAR_____220_CM "" RAT_FUNC "%6.3" "mg/stk" COEFFS 0 10. 0. 0 0 1 /end COMPU_METHOD
/begin COMPU_METHOD _CNV_A_R_LINEAR_____240_CM "" RAT_FUNC "%6.3" "-" COEFFS 0 128. 128. 0 0 1 /end COMPU_METHOD
/begin COMPU_METHOD _CNV_A_R_LINEAR_____292_CM "" RAT_FUNC "%6.3" "Nm/s" COEFFS 0 -1. 0. 0 0 1 /end COMPU_METHOD
/begin COMPU_METHOD _CNV_A_R_LINEAR_____293_CM "" RAT_FUNC "%6.3" "Nm/s" COEFFS 0 1. 0. 0 0 1 /end COMPU_METHOD
/begin COMPU_METHOD _CNV_A_R_LINEAR_____297_CM "" RAT_FUNC "%6.3" "-" COEFFS 0 10. 0. 0 0 1 /end COMPU_METHOD
/begin COMPU_METHOD _CNV_A_R_LINEAR_____312_CM "" RAT_FUNC "%6.3" "-" COEFFS 0 4. 20000. 0 0 1 /end COMPU_METHOD
/begin COMPU_METHOD _CNV_A_R_LINEAR_____313_CM "" RAT_FUNC "%6.3" "-" COEFFS 0 100. 1000. 0 0 1 /end COMPU_METHOD
/begin COMPU_METHOD _CNV_A_R_LINEAR_____314_CM "" RAT_FUNC "%6.3" "rpm/s" COEFFS 0 4. 32768. 0 0 1 /end COMPU_METHOD
/begin COMPU_METHOD _CNV_A_R_LINEAR_____315_CM "" RAT_FUNC "%6.3" "-" COEFFS 0 100. 100. 0 0 1 /end COMPU_METHOD
/begin COMPU_METHOD _CNV_A_R_LINEAR_____316_CM "" RAT_FUNC "%6.3" "ratio/s" COEFFS 0 8. 0. 0 0 1 /end COMPU_METHOD
/begin COMPU_METHOD _CNV_A_R_LINEAR_____317_CM "" RAT_FUNC "%6.3" "-" COEFFS 0 20. 0. 0 0 1 /end COMPU_METHOD
/begin COMPU_METHOD _CNV_A_R_LINEAR_____318_CM "" RAT_FUNC "%6.3" "-" COEFFS 0 32. 0. 0 0 1 /end COMPU_METHOD
/begin COMPU_METHOD _CNV_A_R_LINEAR_____319_CM "" RAT_FUNC "%6.3" "ratio" COEFFS 0 800. 0. 0 0 1 /end COMPU_METHOD
/begin COMPU_METHOD _CNV_S_4_RANGE_RESE_320_CM "" TAB_VERB "%6.3" "" COMPU_TAB_REF _CNV_S_4_RANGE_RESE_320 /end COMPU_METHOD
/begin COMPU_VTAB _CNV_S_4_RANGE_RESE_320 "" TAB_VERB 4 2 "Nsx_rst_igk_on" 4 "Nsx_rst_inj_sta" 8 "Nsx_rst_eng_run" 16 "Nsx_rst_igk_off" /end COMPU_VTAB
/begin COMPU_METHOD _CNV_A_R_LINEAR_____321_CM "" RAT_FUNC "%6.3" "s" COEFFS 0 5. 0. 0 0 1 /end COMPU_METHOD
/begin COMPU_METHOD _CNV_A_R_LINEAR_____322_CM "" RAT_FUNC "%6.3" "-" COEFFS 0 256. 128. 0 0 1 /end COMPU_METHOD
/begin COMPU_METHOD _CNV_A_R_LINEAR_____323_CM "" RAT_FUNC "%6.3" "mg/stk" COEFFS 0 12.20703125 0. 0 0 1 /end COMPU_METHOD
/begin COMPU_METHOD _CNV_A_R_LINEAR_____324_CM "" RAT_FUNC "%6.3" "TDC" COEFFS 0 0.25 0. 0 0 1 /end COMPU_METHOD
/begin COMPU_METHOD _CNV_A_R_LINEAR_____325_CM "" RAT_FUNC "%6.3" "°CRK" COEFFS 0 0.3333333333333333 0. 0 0 1 /end COMPU_METHOD
/begin COMPU_METHOD _CNV_A_R_LINEAR_____326_CM "" RAT_FUNC "%6.3" "-" COEFFS 0 12.8 -1. 0 0 1 /end COMPU_METHOD
/begin COMPU_METHOD _CNV_A_R_LINEAR_____327_CM "" RAT_FUNC "%6.3" "1/s" COEFFS 0 255. 0. 0 0 1 /end COMPU_METHOD
/begin COMPU_METHOD _CNV_S_4_RANGE_STAT_328_CM "" TAB_VERB "%6.3" "-" COMPU_TAB_REF _CNV_S_4_RANGE_STAT_328 /end COMPU_METHOD
/begin COMPU_VTAB _CNV_S_4_RANGE_STAT_328 "" TAB_VERB 4 0 "Nsx_eng_tq_nom" 1 "Nsx_eng_tq_bad_acry" 2 "Nsx_eng_tq_trs_mod" 3 "Nsx_eng_tq_no_ans" /end COMPU_VTAB
/begin COMPU_METHOD _CNV_A_R_LINEAR_____329_CM "" RAT_FUNC "%6.3" "s" COEFFS 0 4. 0. 0 0 1 /end COMPU_METHOD
/begin COMPU_METHOD _CNV_A_R_LINEAR_____330_CM "" RAT_FUNC "%6.3" "s" COEFFS 0 100. -200. 0 0 1 /end COMPU_METHOD
/begin RECORD_LAYOUT _REC_S1VAL_20_u4 FNC_VALUES 1 ULONG COLUMN_DIR DIRECT /end RECORD_LAYOUT
/begin RECORD_LAYOUT _REC_S1VAL_20_u1 FNC_VALUES 1 UBYTE COLUMN_DIR DIRECT /end RECORD_LAYOUT
/begin RECORD_LAYOUT _REC_A2AXS_20_u1 NO_AXIS_PTS_X 1 UBYTE AXIS_PTS_X 2 UBYTE INDEX_INCR DIRECT /end RECORD_LAYOUT
/begin RECORD_LAYOUT _REC_S1VAL_20_u2 FNC_VALUES 1 UWORD COLUMN_DIR DIRECT /end RECORD_LAYOUT
/begin RECORD_LAYOUT _REC_S1VAL_20_s2 FNC_VALUES 1 SWORD COLUMN_DIR DIRECT /end RECORD_LAYOUT
/begin RECORD_LAYOUT _REC_A2AXS_20_u2 NO_AXIS_PTS_X 1 UWORD AXIS_PTS_X 2 UWORD INDEX_INCR DIRECT /end RECORD_LAYOUT
/begin RECORD_LAYOUT _REC_A1CUR_20_u1_u2 FNC_VALUES 1 UBYTE COLUMN_DIR DIRECT /end RECORD_LAYOUT
/begin RECORD_LAYOUT _REC_A1CUR_20_u1_u1 FNC_VALUES 1 UBYTE COLUMN_DIR DIRECT /end RECORD_LAYOUT
/begin RECORD_LAYOUT _REC_A1CUR_20_u2_u1 FNC_VALUES 1 UWORD COLUMN_DIR DIRECT /end RECORD_LAYOUT
/begin RECORD_LAYOUT _REC_A1MAP_20_u2_u2_u2 FNC_VALUES 1 UWORD COLUMN_DIR DIRECT /end RECORD_LAYOUT
/begin RECORD_LAYOUT _REC_A1CUR_20_u2_u2 FNC_VALUES 1 UWORD COLUMN_DIR DIRECT /end RECORD_LAYOUT
/begin RECORD_LAYOUT _REC_A1MAP_20_u2_u2_u1 FNC_VALUES 1 UWORD COLUMN_DIR DIRECT /end RECORD_LAYOUT
/begin RECORD_LAYOUT _REC_A1MAP_20_u1_u2_u2 FNC_VALUES 1 UBYTE COLUMN_DIR DIRECT /end RECORD_LAYOUT
/begin RECORD_LAYOUT _REC_A1MAP_20_u2_u1_u2 FNC_VALUES 1 UWORD COLUMN_DIR DIRECT /end RECORD_LAYOUT
/begin FUNCTION PcPajCtl_Ajspvxx ""
 /begin DEF_CHARACTERISTIC Ctb_ajs_aux_tql Ctb_ajs_driv_tq_drv Ctb_ajs_gear_rat Ctb_ajs_slk_n Ctb_ajs_slk_tco Ctb_ajs_slk_tq_fac Ctb_ajs_spv_drag_tq_fac Ctb_ajs_spv_n Ctb_ajs_spv_n_drv Ctb_ajs_spv_tq_fac Cmp_ajs_slk_tqe_acel_gear_n Cmp_ajs_slk_tqe_acel_gear_tq Cmp_ajs_slk_tqe_acel_gear_tql Cmp_ajs_slk_tqe_acel_n_tco Cmp_ajs_slk_tqe_acel_n_tql Cmp_ajs_slk_tqe_decl_gear_n Cmp_ajs_slk_tqe_decl_gear_tq Cmp_ajs_slk_tqe_decl_gear_tql Cmp_ajs_slk_tqe_decl_n_tco Cmp_ajs_slk_tqe_decl_n_tql Cmp_ajs_slk_tqe_off_acel Cmp_ajs_slk_tqe_off_decl Cmp_ajs_spd_diff_thd_on_acel Cmp_ajs_spv_fast_cor_dly Ctp_ajs_coup_grip_rat Ctp_ajs_drag_acel_tq_diff_thd Ctp_ajs_drag_decl_tq_diff_thd Ctp_ajs_etc_coup_clos Ctp_ajs_etc_coup_sli Ctp_ajs_gear_rat Ctp_ajs_spd_diff_thd_on_decl Ctp_ajs_spv_driv_tq_drv Ctp_ajs_spv_fast_cor_dly_fac Ctp_ajs_spv_n_drv Cbx_ajs_dt_open_slk_cfm Cbx_ajs_fast_cor_cfm Cbx_ajs_no_drag_cfm Cbx_ajs_spv_cut_cfm Cbx_ajs_spv_grd_cfm Cbx_ajs_spv_stt_cfm Cbx_ajs_tqe_slk_cfm Cbx_dt_tq_rat_grip_cfm Csx_ajs_spv_tq_rat_drv_acel_cfm Csx_ajs_spv_tq_rat_drv_decl_cfm Cxx_ajs_acel_tq_thd Cxx_ajs_decl_tq_thd Cxx_ajs_drag_pwt_sp_thd Cxx_ajs_drag_tq_drv_hys Cxx_ajs_drag_tq_drv_thd Cxx_ajs_driv_pwt_sp_fil Cxx_ajs_driv_pwt_sp_grd_hys Cxx_ajs_driv_pwt_sp_grd_thd Cxx_ajs_driv_pwt_sp_thd Cxx_ajs_dt_grip_rat_clos Cxx_ajs_dt_grip_rat_open Cxx_ajs_slk_drv_tq_thd_off Cxx_ajs_slk_drv_tq_thd_on Cxx_ajs_spd_diff_thd_off_acel Cxx_ajs_spd_diff_thd_off_decl Cxx_ajs_spv_driv_tq_t1_fil Cxx_ajs_spv_n_drv_t1_fil_acel Cxx_ajs_spv_n_drv_t1_fil_decl Cxx_ajs_spv_n_mv_thd Cxx_ajs_spv_pwt_t1_fil_acel Cxx_ajs_spv_pwt_t1_fil_decl Cxx_ajs_spv_slk_decl_dly Cxx_ajs_spv_tco_thd Cxx_ajs_spv_tq_drv_hys Cxx_ajs_spv_tq_drv_thd Cxx_ajs_spv_tq_rat_t1_fil_acel Cxx_ajs_spv_tq_rat_t1_fil_decl Cxx_ajs_spv_tqe_tgt_thd Cxx_ajs_spv_wait_dly /end DEF_CHARACTERISTIC
 /begin OUT_MEASUREMENT Vbx_ajs_acel_decl_stt Vbx_ajs_cut_cdn_on Vbx_ajs_fast_cor_on Vbx_ajs_no_drag Vbx_ajs_pdl_cdn_on Vbx_ajs_slk_aftr_decl_on Vbx_ajs_slk_bfr_acel_on Vbx_ajs_slk_cdn_on Vbx_ajs_slk_decl_off Vbx_ajs_slk_decl_on Vbx_ajs_slk_on Vbx_ajs_slk_on_prev Vbx_ajs_slk_open_on Vbx_ajs_slk_tqe_decl_out Vbx_ajs_slk_tqe_off Vbx_ajs_slk_tqe_on Vbx_ajs_spv_aftr_slk_tqe_on Vbx_ajs_spv_stt_cut Vbx_ajs_tq_cdn_on Vbx_vs_n_rat_fil_on Vsx_ajs_dt_tq_rat_vld Vsx_ajs_spv_stt_para Vxx_ajs_aux_tql Vxx_ajs_coup_grip_rat Vxx_ajs_driv_pwt_sp_grd Vxx_ajs_driv_tq_drv Vxx_ajs_dt_grip_rat Vxx_ajs_dt_tq_rat Vxx_ajs_gear_rat_n Vxx_ajs_n_drv Vxx_ajs_n_drv_raw Vxx_ajs_slk_tqe_on_acel Vxx_ajs_slk_tqe_on_acel_hld Vxx_ajs_slk_tqe_on_decl Vxx_ajs_slk_tqe_on_decl_hld Vxx_ajs_slk_tqe_on_hld Vxx_ajs_slk_tqe_sp Vxx_ajs_spd_diff Vxx_ajs_spv_driv_tq_drv Vxx_ajs_spv_driv_tq_fac Vxx_ajs_spv_driv_tq_rat Vxx_ajs_spv_fast_cor_dly /end OUT_MEASUREMENT
/end FUNCTION
/begin FUNCTION PcPajCtl_Estixxx "" /begin OUT_MEASUREMENT Vxx_ajs_esti_tqe /end OUT_MEASUREMENT /end FUNCTION
/begin FUNCTION PcPajCtl_Spccdxx "" /begin OUT_MEASUREMENT Vxx_ajs_spc_rat /end OUT_MEASUREMENT /end FUNCTION
/begin FUNCTION PcPajCtl_Spcpaxx ""
 /begin DEF_CHARACTERISTIC Ctb_ajs_tco Cmp_ajs_acel_slk_dly_fac_spc Cmp_ajs_acel_slk_dly_spc Cmp_ajs_acel_slk_t1_fac_spc Cmp_ajs_acel_slk_t1_max_spc Cmp_ajs_decl_slk_dly_fac_spc Cmp_ajs_decl_slk_dly_spc Cmp_ajs_decl_slk_t1_fac_spc Cmp_ajs_decl_slk_t1_max_spc Cmp_ajs_modu_t1_acel_clos_spc Cmp_ajs_modu_t1_acel_fac_spc Cmp_ajs_modu_t1_acel_tql_spc Cmp_ajs_modu_t1_aftr_n_spc Cmp_ajs_modu_t1_aftr_tq_spc Cmp_ajs_modu_t1_aftr_tql_spc Cmp_ajs_modu_t1_bfr_n_spc Cmp_ajs_modu_t1_bfr_tq_spc Cmp_ajs_modu_t1_bfr_tql_spc Cmp_ajs_modu_t1_decl_clos_spc Cmp_ajs_modu_t1_decl_fac_spc Cmp_ajs_modu_t1_decl_tql_spc Cmp_ajs_modu_td_acel_clos_spc Cmp_ajs_modu_td_acel_fac_spc Cmp_ajs_modu_td_acel_tql_spc Cmp_ajs_modu_td_decl_clos_spc Cmp_ajs_modu_td_decl_fac_spc Cmp_ajs_modu_td_decl_tql_spc Cmp_ajs_slk_acel_gear_n_spc Cmp_ajs_slk_acel_gear_tq_spc Cmp_ajs_slk_acel_gear_tql_spc Cmp_ajs_slk_acel_n_tco_spc Cmp_ajs_slk_acel_n_tql_spc Cmp_ajs_slk_decl_gear_n_spc Cmp_ajs_slk_decl_gear_tq_spc Cmp_ajs_slk_decl_gear_tql_spc Cmp_ajs_slk_decl_n_tco_spc Cmp_ajs_slk_decl_n_tql_spc Cmp_ajs_slk_tqe_off_acel_spc Cmp_ajs_slk_tqe_off_decl_spc Ctp_ajs_t1_acel_tco_fac Ctp_ajs_t1_aftr_tco_fac Ctp_ajs_t1_bfr_tco_fac Ctp_ajs_t1_decl_tco_fac Ctp_ajs_td_acel_tco_fac Ctp_ajs_td_decl_tco_fac /end DEF_CHARACTERISTIC
 /begin OUT_MEASUREMENT Vxx_ajs_modu_n_mv_spc Vxx_ajs_modu_t1_acel_spc Vxx_ajs_modu_t1_aftr_decl_spc Vxx_ajs_modu_t1_bfr_acel_spc Vxx_ajs_modu_t1_decl_spc Vxx_ajs_modu_td_acel_spc Vxx_ajs_modu_td_decl_spc Vxx_ajs_slk_dly_t1_spc Vxx_ajs_slk_t1_ini_max_spc Vxx_ajs_slk_tqe_off_acel_spc Vxx_ajs_slk_tqe_off_decl_spc Vxx_ajs_slk_tqe_on_acel_spc Vxx_ajs_slk_tqe_on_decl_spc Vxx_ajs_slk_tqe_raw_acel_spc Vxx_ajs_slk_tqe_raw_decl_spc /end OUT_MEASUREMENT
/end FUNCTION
/begin FUNCTION SmCrkCtl ""
 /begin OUT_MEASUREMENT Vbx_sta_inj_stt Vbx_rest_stal Vbx_rest_cdn Vxx_inj_sta_dly Vxx_rest_ufld_ctr Vxx_mem_rest_cor Vxx_mem_rest_tco /end OUT_MEASUREMENT
 /begin SUB_FUNCTION SmCrkCtl_Rstxxxx SmCrkCtl_Ststtxx SmCrkCtl_Alcoxxx /end SUB_FUNCTION
/end FUNCTION
/begin FUNCTION SmCrkCtl_Rstxxxx ""
 /begin DEF_CHARACTERISTIC Ctb_rest_ufld_ctr Ctp_tco_min_rest_cor Ctp_ufld_rest_cor Cxx_rest1_ufld_cor Cxx_rest1_ufld_cor_alco Cxx_rest_tco_l_ofs Cxx_rest_tco_up_ofs Cxx_rest_ufld_cor Cxx_rest_ufld_cor_alco Cxx_run_ufld_ctr_inc1 Cxx_run_ufld_ctr_inc1_alco Cxx_run_ufld_ctr_inc2 Cxx_run_ufld_ctr_inc2_alco Cxx_stal_rest_fac Cxx_stop_rest_tco_thd Cxx_stop_rest_ufld_thd Cxx_stop_ufld_ctr_inc /end DEF_CHARACTERISTIC
 /begin OUT_MEASUREMENT Vbx_ctr_act Vbx_equ_tco Vbx_rest_set_pws Vbx_t_ufld_ctr Vbx_tdc_ufld_ctr Vsx_rst Vxx_appl_rest_cor Vxx_ref_rest_cor /end OUT_MEASUREMENT
/end FUNCTION
/begin FUNCTION SmCrkCtl_Ststtxx "" /begin DEF_CHARACTERISTIC Ctp_tco_inj_sta_dly Ctp_tco_out_inj_sta_n_thd /end DEF_CHARACTERISTIC /end FUNCTION
/begin FUNCTION SmCrkCtl_Alcoxxx "" /begin DEF_CHARACTERISTIC Ctp_tco_min_rest_cor_alco /end DEF_CHARACTERISTIC /begin OUT_MEASUREMENT Vxx_tco_min_rest_cor_alco /end OUT_MEASUREMENT /end FUNCTION
/begin FUNCTION CbFfwTsp ""
 /begin SUB_FUNCTION CbFfwTsp_Clangxx CbFfwTsp_Fimspxx CbFfwTsp_Injstxx CbFfwTsp_Stfimxx CbFfwTsp_Waterxx CbFfwTsp_Dpresxx CbFfwTsp_Injctxx CbFfwTsp_Pinjxxx CbFfwTsp_Alcoxxx /end SUB_FUNCTION
/end FUNCTION
/begin FUNCTION CbFfwTsp_Clangxx ""
 /begin DEF_CHARACTERISTIC Ctb_vvtc_angl Cmp_perf_inj_clos_angl Cmp_polu_inj_clos_angl Ctp_n_clos_angl_tq_rat_thd Cbx_inj_clos_angl_bch_cfm Cxx_fil_perf_clos_angl_tdc_nr Cxx_fil_polu_clos_angl_tdc_nr Cxx_inj_clos_angl_bch Cxx_perf_inj_tco_thd /end DEF_CHARACTERISTIC
 /begin OUT_MEASUREMENT Vxx_fil_inj_clos_angl_fac Vxx_fil_inj_clos_angl_fac_inc Vxx_inj_clos_angl /end OUT_MEASUREMENT
/end FUNCTION
/begin FUNCTION CbFfwTsp_Fimspxx "" /begin DEF_CHARACTERISTIC Cbx_fim_bch Cxx_fim_bch Cxx_stoe_rat Cxx_stoe_rat_alco /end DEF_CHARACTERISTIC /begin OUT_MEASUREMENT Vxx_fim_sp Vxx_rich_sp /end OUT_MEASUREMENT /end FUNCTION
/begin FUNCTION CbFfwTsp_Injstxx ""
 /begin DEF_CHARACTERISTIC Ctb_eal_cylr Ctb_n_cylr Ctb_tco_ti_fac2 Cmp_eal_n_lean_cylr Cmp_eal_n_rich_cylr Ctp_cl_is_lean_cylr Ctp_cl_is_rich_cylr Ctp_ol_is_lean_cylr Ctp_ol_is_rich_cylr Ctp_tco_lean_cylr Ctp_tco_rich_cylr Ctp_tco_sta_out_sfg_dly Cbx_inj_seq_sta Cbx_inj_stt_tdc_ena Cbx_sfg_bch_cfm Cxx_cyl_nr Cxx_cylr_tco_thd Cxx_sfg_seq_trs_ctr Cxx_sfg_seq_trs_fim_fac Cxx_sfg_seq_trs_n_thd Cxx_tco_fail_sta_out_sfg_dly /end DEF_CHARACTERISTIC
 /begin OUT_MEASUREMENT Vbx_inj_efv_seq Vsx_inj_stt Vsx_inj_stt_cyl1 Vsx_inj_stt_cyl2 Vsx_inj_stt_cyl3 Vsx_inj_stt_cyl4 Vxx_adac_fim Vxx_cyl1_fim1 Vxx_cyl1_fim2 Vxx_cyl2_fim1 Vxx_cyl2_fim2 Vxx_cyl3_fim1 Vxx_cyl3_fim2 Vxx_cyl4_fim1 Vxx_cyl4_fim2 Vxx_cylr_lean_fac Vxx_cylr_rich_fac Vxx_sfg_seq_trs_ctr Vxx_sta_out_sfg_ti_ctr Vxx_sta_out_sfg_ti_ctr_ini /end OUT_MEASUREMENT
/end FUNCTION
/begin FUNCTION CbFfwTsp_Stfimxx ""
 /begin DEF_CHARACTERISTIC Ctb_n_sta Ctp_n_sta_fim_fac Ctp_tco_dec_sta_fim Ctp_tco_sta_fim Cxx_dec_sta_ti_rest_fac /end DEF_CHARACTERISTIC
 /begin OUT_MEASUREMENT Vbx_tdc_sta_fim_ena Vxx_dec_sta_fim Vxx_sta_fim /end OUT_MEASUREMENT
/end FUNCTION
/begin FUNCTION CbFfwTsp_Waterxx ""
 /begin DEF_CHARACTERISTIC Ntb_mat Ntb_tco Cmp_n_prs_lean_ti_ofs Cmp_n_prs_tco_ti_fac Ctp_tco_lean_ti_ofs Ctp_tco_sta_rich_dec Ctp_tco_sta_ti_ofs Ctp_tco_ti_ofs1 Ctp_tco_ti_ofs2 Ctp_tia_sta_ti_ofs Cxx_aper_rich_sta_tco_thd Cxx_aper_rich_sta_tia_thd Cxx_rest_mod_dsb_max_dly Cxx_rest_mod_dsb_tco_thd Cxx_rich_sta_tco_thd Cxx_rich_tia_thd Cxx_sta_rich_dec_nr Cxx_sta_tco_ti_dec_fac Cxx_sta_tco_ti_dec_fac_alco Cxx_sta_tco_ti_dec_rest_fac Cxx_sta_tco_ti_rest_fac Cxx_tco_ti_fil_nr /end DEF_CHARACTERISTIC
 /begin OUT_MEASUREMENT Vbx_cata_wup_lean Vbx_sta_tco_ti_ofs_mod Vbx_ti_cor_rest_pws_set Vxx_sta_rich_tdc_dec_nr Vxx_sta_tco_ti_ofs Vxx_sta_tco_ti_ofs_init Vxx_tco_lean_ti_fac Vxx_tco_rich_ti_fac Vxx_tco_ti_cor Vxx_tco_ti_cor_fil_ctr Vxx_tco_ti_fac Vxx_tco_ti_ofs1 Vxx_tco_ti_ofs2 /end OUT_MEASUREMENT
/end FUNCTION
/begin FUNCTION CbFfwTsp_Dpresxx "" /begin DEF_CHARACTERISTIC Ctb_prs_dif_ti Cmp_prs_dif_ti_cor /end DEF_CHARACTERISTIC /begin OUT_MEASUREMENT Vxx_prs_dif_ti Vxx_prs_dif_ti_cor /end OUT_MEASUREMENT /end FUNCTION
/begin FUNCTION CbFfwTsp_Injctxx ""
 /begin DEF_CHARACTERISTIC Cbx_bch_inj1_cut_req Cbx_bch_inj2_cut_req Cbx_bch_inj3_cut_req Cbx_bch_inj4_cut_req Cbx_inj_cut_seq Cbx_wet_bch_mod Cbx_wet_ti_cut_bch_mod /end DEF_CHARACTERISTIC
 /begin OUT_MEASUREMENT Vbx_dft_inj1_cut Vbx_dft_inj2_cut Vbx_dft_inj3_cut Vbx_dft_inj4_cut Vbx_inj1_cut Vbx_inj1_cut_req Vbx_inj2_cut Vbx_inj2_cut_req Vbx_inj3_cut Vbx_inj3_cut_req Vbx_inj4_cut Vbx_inj4_cut_req Vbx_inj_cut_rst Vbx_inj_ena Vbx_lih_inj1_cut_req Vbx_lih_inj2_cut_req Vbx_lih_inj3_cut_req Vbx_lih_inj4_cut_req Vxx_efv_inj_cut_nr Vxx_efv_req_inj_cut_nr Vxx_inj_avl_nr Vxx_inj_cut_nr Vxx_next_inj_cut_tdc_nr Vxx_next_inj_open_tdc_nr Vxx_prev_inj_cut_nr /end OUT_MEASUREMENT
/end FUNCTION
/begin FUNCTION CbFfwTsp_Pinjxxx ""
 /begin DEF_CHARACTERISTIC Ctp_tco_amp_pinj_cor_fac Ctp_tco_pinj_fim Cbx_pinj_seq_cfm Cxx_inj1_pinj_clos_angl Cxx_inj2_pinj_clos_angl Cxx_inj3_pinj_clos_angl Cxx_inj4_pinj_clos_angl Cxx_rest_pinj_cor_fac Cxx_sta_pinj_toth_nr Cxx_sta_tco_vld_nok /end DEF_CHARACTERISTIC
 /begin OUT_MEASUREMENT Vbx_ecu_rst_pinj_dsb Vbx_ecu_rst_pinj_ena Vbx_pinj Vbx_pinj_seq_cfm Vxx_inj1_pinj_clos_angl Vxx_inj2_pinj_clos_angl Vxx_inj3_pinj_clos_angl Vxx_inj4_pinj_clos_angl Vxx_pinj_fim Vxx_sta_pinj_toth_nr Vxx_vld_tco /end OUT_MEASUREMENT
/end FUNCTION
/begin FUNCTION CbFfwTsp_Alcoxxx ""
 /begin DEF_CHARACTERISTIC Ctb_alco_rat_sp Cmp_n_prs_lean_ti_ofs_alco Cmp_n_prs_tco_ti_fac_alco Ctp_n_sta_fim_fac_alco Ctp_sta_gaz_pump_fim_fac Ctp_tco_dec_sta_fim_alco Ctp_tco_lean_ti_ofs_alco Ctp_tco_pinj_fim_alco Ctp_tco_sta_fim_alco Ctp_tco_sta_rich_dec_alco Ctp_tco_sta_ti_ofs_alco Ctp_tco_ti_ofs1_alco Ctp_tco_ti_ofs2_alco Cbx_tco_ti_fac_dsb Cxx_pinj_pump_alco_fac Cxx_trs_tco_ti_fac_down Cxx_trs_tco_ti_fac_up /end DEF_CHARACTERISTIC
 /begin OUT_MEASUREMENT Vbx_tdc_alco_sta_fim_ena Vxx_n_tco_sta_fim_alco Vxx_sta_gaz_pump_fim_fac Vxx_tco_dec_sta_fim_alco Vxx_tco_lean_ti_fac_alco Vxx_tco_pinj_fim_alco Vxx_tco_sta_rich_dec_alco Vxx_tco_sta_ti_ofs_alco Vxx_tco_ti_fac_alco Vxx_tco_ti_fac_alco_fac Vxx_tco_ti_ofs1_alco Vxx_tco_ti_ofs2_alco Vxx_vld_tco_alco /end OUT_MEASUREMENT
/end FUNCTION
/begin FUNCTION TqLimMnt ""
 /begin SUB_FUNCTION TqLimMnt_Mintqxx TqLimMnt_Statqxx TqLimMnt_Engtqxx TqLimMnt_Alcoxxx /end SUB_FUNCTION
/end FUNCTION
/begin FUNCTION TqLimMnt_Mintqxx ""
 /begin DEF_CHARACTERISTIC Ctb_dt_tq_rat Ctb_inj_cut_n Ctb_min_tqe_n Cmp_cut_fil_fac Cmp_driv_swi_fil_fac Cmp_n_tco_min_tq_fmt Ctd_coup_grip_rat Ctd_gear_min_driv_tqe_ftc Ctd_gear_tq_rat Ctp_min_tq_tco_ofs Ctp_swi_fil_fac Cbx_min_avl_tqe_raw_cfm Cbx_min_driv_tqe_cfm Cbx_min_tq_mod_cfm Cbx_n_mv_n_cfm Cxx_agb_max_tqe_cor Cxx_agb_min_tqe_fac Cxx_fil_fac_dft Cxx_min_is_n Cxx_min_l_eng_tqe_tqe_hys Cxx_min_n_thd_min_tq Cxx_min_n_tq_grd Cxx_min_n_tq_grd_sta Cxx_min_tq_ast_dsb_dly /end DEF_CHARACTERISTIC
 /begin OUT_MEASUREMENT Vbx_l_eng_tqe Vbx_sta_min_tq Vxx_cut_fil_fac Vxx_cut_tq_cor_fil Vxx_dt_tq_rat Vxx_min_agb_tqe Vxx_min_avl_tqe Vxx_min_avl_tqe_raw Vxx_min_bas_agb_tqe Vxx_min_bas_tqe Vxx_min_bas_tqe_raw Vxx_min_driv_tqe Vxx_min_driv_tqe_raw Vxx_min_driv_tqe_wit_inj_cut Vxx_min_is_tql Vxx_n_dif_tq Vxx_n_mv_min_driv_tqe Vxx_n_mv_min_driv_tqe_raw Vxx_swi_fil_fac /end OUT_MEASUREMENT
/end FUNCTION
/begin FUNCTION TqLimMnt_Statqxx ""
 /begin DEF_CHARACTERISTIC Ctb_sta_n Cmp_n_tco_sta_tq Ctp_tco_sta_is_trs_dly Cxx_sta_tq_inc Cxx_sta_tq_inc_dly /end DEF_CHARACTERISTIC
 /begin OUT_MEASUREMENT Vxx_raw_sta_tq Vxx_sta_is_fil_fac Vxx_sta_tq /end OUT_MEASUREMENT
/end FUNCTION
/begin FUNCTION TqLimMnt_Engtqxx "" /begin DEF_CHARACTERISTIC Ctp_l_eng_map_n Ctp_l_eng_map_tco Cxx_l_eng_map_dft /end DEF_CHARACTERISTIC /begin OUT_MEASUREMENT Vxx_l_eng_map Vxx_l_eng_tq Vxx_l_eng_tqe /end OUT_MEASUREMENT /end FUNCTION
/begin FUNCTION TqLimMnt_Alcoxxx "" /begin DEF_CHARACTERISTIC Ctb_sta_tco_alco Cmp_n_tco_sta_tq_alco /end DEF_CHARACTERISTIC /begin OUT_MEASUREMENT Vxx_n_tco_sta_tq_alco /end OUT_MEASUREMENT /end FUNCTION
/begin FUNCTION OuTqoTqd "" /begin SUB_FUNCTION OuTqoTqd_Tqrqstt_xxxxxx OuTqoTqd_Trnstrs_stbxxg /end SUB_FUNCTION /end FUNCTION
/begin FUNCTION OuTqoTqd_Tqrqstt_xxxxxx "" /begin OUT_MEASUREMENT Vbx_tq_req_stt_01 Vbx_tq_req_stt_11 Vsx_mux_tq_req_ans /end OUT_MEASUREMENT /end FUNCTION
/begin FUNCTION OuTqoTqd_Trnstrs_stbxxg "" /begin OUT_MEASUREMENT Vbx_tq_req_stt_10 /end OUT_MEASUREMENT /end FUNCTION
/begin FUNCTION InCbiUli ""
 /begin OUT_MEASUREMENT Vxx_lbup_per_mv_max_rtn Vxx_lbup_per_tot_mv_rtn Vtx_in_mem_lbup_cpt[0] Vtx_in_mem_lbup_cpt[1] Vtx_in_mem_lbup_cpt[2] Vtx_in_mem_lbup_cpt[3] Vtx_in_mem_lbup_cpt[4] Vtx_mem_crit_lbup_cpt[0] Vtx_mem_crit_lbup_cpt[1] Vtx_mem_crit_lbup_cpt[2] Vtx_mem_crit_lbup_cpt[3] Vtx_mem_crit_lbup_cpt[4] Vtx_mem_crit_lbup_cpt[5] Vtx_mem_crit_lbup_cpt[6] Vtx_out_mem_lbup_cpt[0] Vtx_out_mem_lbup_cpt[1] Vtx_out_mem_lbup_cpt[2] Vtx_out_mem_lbup_cpt[3] Vtx_out_mem_lbup_cpt[4] Vxx_nr_dc_cdn_ok_lbup_cpt Vxx_t_mv_cdn_ok_lbup_cpt /end OUT_MEASUREMENT
 /begin SUB_FUNCTION InCbiUli_So2upsr InCbiUli_Obdlbup InCbiUli_Alcoxxx InCbiUli_Lbupshf /end SUB_FUNCTION
/end FUNCTION
/begin FUNCTION InCbiUli_So2upsr ""
 /begin DEF_CHARACTERISTIC Cbx_avl_lbup_scw_rdn Cbx_lbup_osp_conf Cxx_dfdec_inj_ecu_lbup_icp Cxx_dfdec_lbup_hot_apl_down Cxx_dfdec_lbup_nok Cxx_dfdec_lbup_oc Cxx_dfdec_lbup_scg Cxx_dfdec_lbup_scw Cxx_dfinc_inj_ecu_lbup_icp Cxx_dfinc_lbup_hot_apl_down Cxx_dfinc_lbup_nok Cxx_dfinc_lbup_oc Cxx_dfinc_lbup_scg Cxx_dfinc_lbup_scw Cxx_l_v_lamb_thd Cxx_lbup_hot_stt_t Cxx_lbup_oc_det_h_v Cxx_lbup_oc_det_l_v Cxx_lbup_oc_t Cxx_lbup_oc_trs_ctr Cxx_lbup_osp_oc_det_h_v Cxx_lbup_osp_oc_det_l_v Cxx_lbup_osp_scg_det_v Cxx_lbup_osp_scw_det_v Cxx_lbup_pump_crt_t Cxx_lbup_pump_crt_v_thd Cxx_lbup_scg_det_v Cxx_lbup_scw_det_v Cxx_lbup_v_thd Cxx_up_v_lamb_thd Cmp_n_eal_lbup_v_thd Cbx_lbup_sw_dly_req Cxx_cp_trs_h_thd Cxx_cp_trs_l_thd Cxx_diag_trs_h_thd Cxx_diag_trs_l_thd Cxx_lbup_v_eal_dft Cxx_lbup_v_max_thd Cxx_lbup_v_min_thd Cxx_lean_rich_trs_dly Cxx_rich_lean_trs_dly Cxx_trs_thd /end DEF_CHARACTERISTIC
 /begin OUT_MEASUREMENT Vbx_avl_lbup Vbx_df_inj_ecu_lbup_icp Vbx_df_lbup_hot_apl_down Vbx_df_lbup_nok Vbx_df_lbup_oc Vbx_df_lbup_scg Vbx_df_lbup_scw Vbx_diag_ena_inj_ecu_lbup_icp Vbx_diag_ena_lbup_hot_apl_down Vbx_diag_ena_lbup_nok Vbx_diag_ena_lbup_oc Vbx_diag_ena_lbup_scg Vbx_diag_ena_lbup_scw Vbx_ini_temp_oc Vbx_lbup_diag_ena Vbx_lbup_frst_thd_hot Vbx_lbup_in_out_thd Vsx_lbup_vld Vxx_lbup_diag_ena Vxx_lbup_oc_t Vxx_lbup_oc_trs_ctr Vxx_lbup_pump_crt_t Vxx_sens_lbup_v_old Vbx_diag_lbup_down_stt Vbx_diag_lbup_up_stt Vbx_lbup_down_stt Vbx_lbup_efv_stt Vbx_lbup_fail_trs Vbx_lbup_igk_off_on Vbx_lbup_lean_rich_trs Vbx_lbup_stt Vbx_lbup_sw_stt Vbx_lbup_trs Vbx_lbup_up_stt Vbx_obd_lbup_fail_trs Vxx_lbup_trs_dly /end OUT_MEASUREMENT
/end FUNCTION
/begin FUNCTION InCbiUli_Obdlbup ""
 /begin DEF_CHARACTERISTIC Ntb_lbup_maf Ctp_lbup_per_max Cxx_conf_diag_lbup Cxx_dfdec_lbup_cpt Cxx_dfinc_lbup_cpt Cxx_edic_lbup_dly Cxx_lbup_asd_diag_nr Cxx_lbup_asd_in_nr Cxx_lbup_asd_sf_nr Cxx_lbup_asd_tout_dly Cxx_lbup_diag_gear Cxx_lbup_fuel_typ_rat_max_1 Cxx_lbup_fuel_typ_rat_max_2 Cxx_lbup_fuel_typ_rat_min_1 Cxx_lbup_fuel_typ_rat_min_2 Cxx_lbup_hys_maf Cxx_lbup_hys_n Cxx_lbup_in_nr Cxx_lbup_maf_dif_max Cxx_lbup_maf_max Cxx_lbup_maf_mes_max Cxx_lbup_maf_min Cxx_lbup_n_max Cxx_lbup_n_min Cxx_lbup_per_dly Cxx_lbup_per_nr_min Cxx_lbup_per_nr_tot Cxx_lbup_per_swi_nr Cxx_lbup_stab_dly Cxx_lbup_tco_min Cxx_lgl_dly_diag_lbup /end DEF_CHARACTERISTIC
 /begin OUT_MEASUREMENT Vbx_df_lbup_cpt Vbx_diag_ena_lbup_cpt Vbx_diag_sta_lbup_abrt Vbx_diag_sta_lbup_ena Vbx_diag_sta_lbup_end Vbx_ena_diag_lbup Vbx_inhi_ena_diag_lbup Vbx_lbup_diag_stop Vbx_lbup_dsb_ad_rich Vbx_lbup_dsb_cp Vbx_lbup_mes Vbx_lbup_per_dly_acq_max Vbx_lbup_req Vbx_phy_ena_diag_lbup Vbx_sw_ena_diag_lbup Vsx_diag_sta_lbup_stt Vsx_lbup_stt Vxx_edic_lbup_dly Vxx_lbup_asd_diag_ctr Vxx_lbup_asd_sf Vxx_lbup_asd_sf_ctr Vxx_lbup_asd_tout_dly Vxx_lbup_in_ctr Vxx_lbup_jerk_nr Vxx_lbup_per_ctr Vxx_lbup_per_dly_acq Vxx_lbup_per_dly_tot Vxx_lbup_per_mv Vxx_lbup_per_mv_max Vxx_lbup_per_nr Vxx_lbup_per_nr_tot Vxx_lbup_per_out_mes Vxx_lbup_per_tot_mv Vxx_lbup_stab_dly Vxx_lgl_dly_diag_lbup Vxx_pump_maf_lbup_mem Vxx_pump_maf_lbup_mv Vxx_pump_maf_lbup_prop_per /end OUT_MEASUREMENT
/end FUNCTION
/end MODULE
/end PROJECT
