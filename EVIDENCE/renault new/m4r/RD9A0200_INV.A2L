ASAP2_VERSION 1 41
/begin PROJECT RD8 "_default_ProjectLongIdentifier"
/begin HEADER "_default_HeaderComment" PROJECT_NO RD9 /end HEADER
/begin MODULE _default_ModuleName "_default_ModuleLongIdentifier"
/begin MOD_COMMON "_default_ModCommonComment" DEPOSIT ABSOLUTE BYTE_ORDER MSB_LAST ALIGNMENT_BYTE 1 ALIGNMENT_WORD 2 ALIGNMENT_LONG 2 ALIGNMENT_FLOAT32_IEEE 2 ALIGNMENT_FLOAT64_IEEE 4 /end MOD_COMMON
/begin AXIS_PTS ldp_ar_cp_sp "" 0xa0022b9c ar_cp_sp _REC_A2AXS_20_u2 2.4414e-004 _CNV_A_R_LINEAR_____49_CM 8 0. 2.4414e-004 FORMAT "%14.12" /end AXIS_PTS
/begin AXIS_PTS ldp_fac_lam_dif_cp "" 0xa0022c38 fac_lam_dif_cp _REC_A2AXS_20_u2 0.666656494140625 _CNV_A_R_LINEAR_____50_CM 8 0. 0.666656494140625 FORMAT "%8.7" /end AXIS_PTS
/begin AXIS_PTS ldp_map_ip_fac_cl_mmv "" 0xa0022c98 map _REC_A2AXS_20_u2 5434. _CNV_A_R_LINEAR_____51_CM 8 0. 5434. FORMAT "%7.2" /end AXIS_PTS
/begin CHARACTERISTIC ip_cppwm_sp_1 "Canister purge set point for frequency command 1 (reverse Ctp_pwm_cp_efv_ar1 map)" CURVE 0xa0020814 _REC_A1CUR_20_u1_u2 99.609375 _CNV_A_R_LINEAR_____52_CM 0. 99.609375 FORMAT "%9.6"
 /begin AXIS_DESCR COM_AXIS ar_cp_sp _CNV_A_R_LINEAR_____49_CM 8 0. 2.4414e-004 FORMAT "%14.12" AXIS_PTS_REF ldp_ar_cp_sp /end AXIS_DESCR
/end CHARACTERISTIC
/begin CHARACTERISTIC ip_cppwm_sp_2 "Canister purge set point for frequency command 2 (reverse Ctp_pwm_cp_efv_ar2 map)" CURVE 0xa002081c _REC_A1CUR_20_u1_u2 99.609375 _CNV_A_R_LINEAR_____52_CM 0. 99.609375 FORMAT "%9.6"
 /begin AXIS_DESCR COM_AXIS ar_cp_sp _CNV_A_R_LINEAR_____49_CM 8 0. 2.4414e-004 FORMAT "%14.12" AXIS_PTS_REF ldp_ar_cp_sp /end AXIS_DESCR
/end CHARACTERISTIC
/begin CHARACTERISTIC ip_fac_cl_mmv "Canister load correction map" MAP 0xa0022dd4 _REC_A1MAP_20_u2_u2_u2 3.99993896484375 _CNV_A_R_LINEAR_____53_CM 0. 3.99993896484375 FORMAT "%7.5"
 /begin AXIS_DESCR COM_AXIS map _CNV_A_R_LINEAR_____51_CM 8 0. 5434. FORMAT "%7.2" AXIS_PTS_REF ldp_map_ip_fac_cl_mmv /end AXIS_DESCR
 /begin AXIS_DESCR COM_AXIS fac_lam_dif_cp _CNV_A_R_LINEAR_____50_CM 8 0. 0.666656494140625 FORMAT "%8.7" AXIS_PTS_REF ldp_fac_lam_dif_cp /end AXIS_DESCR
/end CHARACTERISTIC
/begin MEASUREMENT amp_ad "Adapted ambient pressure" UWORD _CNV_A_R_LINEAR_____51_CM 1 0. 0. 5434. ECU_ADDRESS 0xd0003cea FORMAT "%7.2" /end MEASUREMENT
/begin MEASUREMENT ar_cp_sp "Canister purge area for PWM set-point" UWORD _CNV_A_R_LINEAR_____49_CM 1 0. 0. 2.4414e-004 ECU_ADDRESS 0xd0003cec FORMAT "%14.12" /end MEASUREMENT
/begin MEASUREMENT cl_mmv "Moving mean value of the canister load CL" UWORD _CNV_A_R_LINEAR_____48_CM 1 0. 0. 1.99996948242188 ECU_ADDRESS 0xd0003cee FORMAT "%7.5" /end MEASUREMENT
/begin MEASUREMENT cl_mmv_clc_end "Canister load at RO, ROF and MaxP" UWORD _CNV_A_R_LINEAR_____48_CM 1 0. 0. 1.99996948242188 ECU_ADDRESS 0xd0003cf0 FORMAT "%7.5" /end MEASUREMENT
/begin MEASUREMENT cppwm_diagcp "Canister purge PWM set-point by EVAM" UBYTE _CNV_A_R_LINEAR_____52_CM 1 0. 0. 99.609375 ECU_ADDRESS 0xd0006366 FORMAT "%9.6" /end MEASUREMENT
/begin MEASUREMENT dtp_raw_rsa "Raw differential pressure tank-ambient for RSA service tool" UBYTE _CNV_A_R_LINEAR_____54_CM 1 0. -41. 22.75 ECU_ADDRESS 0xd0006369 FORMAT "%5.2" /end MEASUREMENT
/begin MEASUREMENT flow_cps "flow from tank-system into manifold through CPS" UWORD _CNV_A_R_LINEAR_____55_CM 1 0. 0. 7.9998779296875 ECU_ADDRESS 0xd0003d18 FORMAT "%6.4" /end MEASUREMENT
/begin MEASUREMENT flow_sp_cps "CPS flow setpoint, after merge of all flow requests" UWORD _CNV_A_R_LINEAR_____55_CM 1 0. 0. 7.9998779296875 ECU_ADDRESS 0xd0003d1a FORMAT "%6.4" /end MEASUREMENT
/begin MEASUREMENT lv_pl "Engine operating state „Part Load\"" UBYTE _CNV_S_2_RANGE______3_CM 1 0. 0. 1. ECU_ADDRESS 0xd0002392 BIT_MASK 0x1 /end MEASUREMENT
/begin MEASUREMENT maf_cp_kgh "(MAF throttle) MAF_THR + (MAF through the canister purge valve) MAF_CPS" UWORD _CNV_A_R_LINEAR_____56_CM 1 0. 0. 2047.96875 ECU_ADDRESS 0xd0004d94 FORMAT "%10.5" /end MEASUREMENT
/begin MEASUREMENT state_cp "State of Evaporative  Emission Control Function" UBYTE _CNV_S_9_EVAM_RANGE_57_CM 1 0. 0. 11. ECU_ADDRESS 0xd0006372 /end MEASUREMENT
/begin MEASUREMENT t_dly_state_cp_mod "Timer before MAX_PURGE state switch" UWORD _CNV_A_R_LINEAR_____58_CM 1 0. 0. 6553.5 ECU_ADDRESS 0xd0004dae FORMAT "%6.1" /end MEASUREMENT
/begin MEASUREMENT tco_stop "Coolant temperature at transition to engine stop (ES)" UBYTE _CNV_A_R_LINEAR_____41_CM 1 0. -48. 142.5 ECU_ADDRESS 0xd000637a FORMAT "%6.2" /end MEASUREMENT
/begin MEASUREMENT v_dtp_rsa "Differential fuel tank pressure sensor for RSA service tool" UBYTE _CNV_A_R_LINEAR_____59_CM 1 0. 0. 4.98046875 ECU_ADDRESS 0xd000637c FORMAT "%10.8" /end MEASUREMENT
/begin CHARACTERISTIC c_ar_cp_sp_min "Minimum canister purge area for PWM set-point" VALUE 0xa002087e _REC_S1VAL_20_u2 2.4414e-004 _CNV_A_R_LINEAR_____49_CM 0. 2.4414e-004 FORMAT "%14.12" /end CHARACTERISTIC
/begin CHARACTERISTIC c_fac_lam_dif_cp_max "FAC_LAM_DIF_CP max value" VALUE 0xa00208d2 _REC_S1VAL_20_u2 0.666656494140625 _CNV_A_R_LINEAR_____60_CM 0.5 1.166656494140625 FORMAT "%8.6" /end CHARACTERISTIC
/begin CHARACTERISTIC c_flow_cps_min_cl_mmv "Minimum canister flow value for canister charge calculation" VALUE 0xa00208ee _REC_S1VAL_20_u2 7.9998779296875 _CNV_A_R_LINEAR_____55_CM 0. 7.9998779296875 FORMAT "%6.4" /end CHARACTERISTIC
/begin CHARACTERISTIC c_flow_cps_sp_min "Minimum canister flow for canister flow set-point equivalence" VALUE 0xa00208fe _REC_S1VAL_20_u2 7.9998779296875 _CNV_A_R_LINEAR_____55_CM 0. 7.9998779296875 FORMAT "%6.4" /end CHARACTERISTIC
/begin CHARACTERISTIC c_state_cp_rsa_adapt "STATE_CP_RSA value in \"Purge adaptative\" state" VALUE 0xa002095b _REC_S1VAL_20_u1 255. _CNV_A_R_ECME_LINEA_0_CM 0. 255. FORMAT "%3.0" /end CHARACTERISTIC
/begin CHARACTERISTIC c_state_cp_rsa_init "STATE_CP_RSA value in \"Init\" state" VALUE 0xa002095c _REC_S1VAL_20_u1 255. _CNV_A_R_ECME_LINEA_0_CM 0. 255. FORMAT "%3.0" /end CHARACTERISTIC
/begin CHARACTERISTIC c_state_cp_rsa_nom "STATE_CP_RSA value in \"Purge nominale\" state" VALUE 0xa002095d _REC_S1VAL_20_u1 255. _CNV_A_R_ECME_LINEA_0_CM 0. 255. FORMAT "%3.0" /end CHARACTERISTIC
/begin CHARACTERISTIC c_state_cp_rsa_not_cl "STATE_CP_RSA value in \"Purge non bouclée\" state" VALUE 0xa002095e _REC_S1VAL_20_u1 255. _CNV_A_R_ECME_LINEA_0_CM 0. 255. FORMAT "%3.0" /end CHARACTERISTIC
/begin CHARACTERISTIC c_state_cp_rsa_out_purge "STATE_CP_RSA value in \"Hors purge\" state" VALUE 0xa002095f _REC_S1VAL_20_u1 255. _CNV_A_R_ECME_LINEA_0_CM 0. 255. FORMAT "%3.0" /end CHARACTERISTIC
/begin CHARACTERISTIC c_t_dly_state_cp "Time out value during adaptive RSA purge operation" VALUE 0xa002091c _REC_S1VAL_20_u2 6553.5 _CNV_A_R_LINEAR_____58_CM 0. 6553.5 FORMAT "%6.1" /end CHARACTERISTIC
/begin CHARACTERISTIC lc_swi_state_cp_mod "switch to force MAX_PURGE mode after a defined adaptive delay" VALUE 0xa0020989 _REC_S1VAL_20_u1 1. _CNV_A_R_ECME_LINEA_0_CM 0. 1. FORMAT "%1.0" BIT_MASK 0x1 /end CHARACTERISTIC
/begin MEASUREMENT dtp_fuc_miss_1_thd_mod_6 "Thresold pressure difference during FUC_MISS diagnosis stored for mode 06-communication" SWORD _CNV_A_R_LINEAR_____61_CM 1 0. -40.96 40.95875 ECU_ADDRESS 0xd0003d04 FORMAT "%9.5" /end MEASUREMENT
/begin MEASUREMENT err_sym_evap_leak_1 "Error symptom for 0.5 mm leak error" UBYTE _CNV_S_16_RANGE_ERR__62_CM 1 0. 0. 15. ECU_ADDRESS 0xd0007533 /end MEASUREMENT
/begin MEASUREMENT err_sym_evap_leak_10 "Error symptom for large leak error" UBYTE _CNV_S_16_RANGE_ERR__62_CM 1 0. 0. 15. ECU_ADDRESS 0xd0007535 /end MEASUREMENT
/begin MEASUREMENT err_sym_evap_leak_2 "Error symptom for 1 mm leak error" UBYTE _CNV_S_16_RANGE_ERR__62_CM 1 0. 0. 15. ECU_ADDRESS 0xd0007534 /end MEASUREMENT
/begin MEASUREMENT err_sym_fuc_miss "Error symptom for fuel cap missing during evaporative system monitoring" UBYTE _CNV_S_16_RANGE_ERR__62_CM 1 0. 0. 15. ECU_ADDRESS 0xd0007536 /end MEASUREMENT
/begin MEASUREMENT err_sym_fuc_miss_1 "Error symptom for fuel cap missing (detection out of EVAP algorithm)" UBYTE _CNV_S_16_RANGE_ERR__62_CM 1 0. 0. 15. ECU_ADDRESS 0xd0007537 /end MEASUREMENT
/begin MEASUREMENT err_sym_mec_open_cps "Error symptom for MEC_OPEN_CPS diagnosis" UBYTE _CNV_S_16_RANGE_ERR__62_CM 1 0. 0. 15. ECU_ADDRESS 0xd0007531 /end MEASUREMENT
/begin MEASUREMENT lv_cdn_diag_evap_leak_1 "Diagnosis condition for 0.5 mm leak error detection" UBYTE _CNV_S_2_RANGE______3_CM 1 0. 0. 1. ECU_ADDRESS 0xd000751d BIT_MASK 0x1 /end MEASUREMENT
/begin MEASUREMENT lv_cdn_diag_evap_leak_10 "Diagnosis condition for large leak error detection" UBYTE _CNV_S_2_RANGE______3_CM 1 0. 0. 1. ECU_ADDRESS 0xd000751f BIT_MASK 0x1 /end MEASUREMENT
/begin MEASUREMENT lv_cdn_diag_evap_leak_2 "Diagnosis condition for 1 mm leak error detection" UBYTE _CNV_S_2_RANGE______3_CM 1 0. 0. 1. ECU_ADDRESS 0xd000751e BIT_MASK 0x1 /end MEASUREMENT
/begin MEASUREMENT lv_cdn_diag_fuc_miss "Diagnosis condition for fuel cap missing (detected during evaporative system monitoring)" UBYTE _CNV_S_2_RANGE______3_CM 1 0. 0. 1. ECU_ADDRESS 0xd0007520 BIT_MASK 0x1 /end MEASUREMENT
/begin MEASUREMENT lv_cdn_diag_fuc_miss_1 "Diagnosis condition for fuel cap missing (detection out of EVAP algorithm)" UBYTE _CNV_S_2_RANGE______3_CM 1 0. 0. 1. ECU_ADDRESS 0xd0007521 BIT_MASK 0x1 /end MEASUREMENT
/begin MEASUREMENT lv_cdn_diag_mec_open_cps "Diagnosis condition for mechanical cps error diagnosis" UBYTE _CNV_S_2_RANGE______3_CM 1 0. 0. 1. ECU_ADDRESS 0xd000751b BIT_MASK 0x1 /end MEASUREMENT
/begin MEASUREMENT lv_diagcp_cdn_not_ok_pas "Global pas flag for tester in case of high vapor" UBYTE _CNV_S_2_RANGE______3_CM 1 0. 0. 1. ECU_ADDRESS 0xd0006337 /end MEASUREMENT
/begin MEASUREMENT lv_end_diag_evap_leak_10 "End of diagnosis for large leak error detection" UBYTE _CNV_S_2_RANGE______3_CM 1 0. 0. 1. ECU_ADDRESS 0xd0006342 BIT_MASK 0x1 /end MEASUREMENT
/begin MEASUREMENT lv_end_diag_evap_leak_2 "End of diagnosis for 1 mm leak error detection" UBYTE _CNV_S_2_RANGE______3_CM 1 0. 0. 1. ECU_ADDRESS 0xd0006343 BIT_MASK 0x1 /end MEASUREMENT
/begin MEASUREMENT lv_end_diag_fuc_miss "End of diagnosis for for fuel cap missing (detected during evaporative system monitoring)" UBYTE _CNV_S_2_RANGE______3_CM 1 0. 0. 1. ECU_ADDRESS 0xd0006344 BIT_MASK 0x1 /end MEASUREMENT
/begin MEASUREMENT lv_end_diag_fuc_miss_1 "End of diagnosis for for fuel cap missing (detection out of EVAP algorithm)" UBYTE _CNV_S_2_RANGE______3_CM 1 0. 0. 1. ECU_ADDRESS 0xd0006345 BIT_MASK 0x1 /end MEASUREMENT
/begin MEASUREMENT lv_err_diagcp_2 "Global error flag for missing fuel cap (can be used to illuminate special lamp)" UBYTE _CNV_S_2_RANGE______3_CM 1 0. 0. 1. ECU_ADDRESS 0xd0006346 /end MEASUREMENT
/begin MEASUREMENT lv_err_evap_leak_1 "Flag indicating a 0.5 mm leak in the evap system" UBYTE _CNV_S_2_RANGE______3_CM 1 0. 0. 1. ECU_ADDRESS 0xd000634b /end MEASUREMENT
/begin MEASUREMENT lv_err_evap_leak_10 "Flag indicating a large leak" UBYTE _CNV_S_2_RANGE______3_CM 1 0. 0. 1. ECU_ADDRESS 0xd000634c BIT_MASK 0x1 /end MEASUREMENT
/begin MEASUREMENT lv_err_evap_leak_2 "Flag indicating a 1 mm leak in the evap system" UBYTE _CNV_S_2_RANGE______3_CM 1 0. 0. 1. ECU_ADDRESS 0xd000634d BIT_MASK 0x1 /end MEASUREMENT
/begin MEASUREMENT lv_err_fuc_miss "Flag indicating fuel cap missing" UBYTE _CNV_S_2_RANGE______3_CM 1 0. 0. 1. ECU_ADDRESS 0xd000634e BIT_MASK 0x1 /end MEASUREMENT
/begin MEASUREMENT lv_err_fuc_miss_1 "Flag indicating a fuel cap missing (out of EVAP algorithm), reversible" UBYTE _CNV_S_2_RANGE______3_CM 1 0. 0. 1. ECU_ADDRESS 0xd000634f BIT_MASK 0x1 /end MEASUREMENT
/begin MEASUREMENT lv_err_mec_open_cps "Mechanical failure on canister purge valve" UBYTE _CNV_S_2_RANGE______3_CM 1 0. 0. 1. ECU_ADDRESS 0xd0006351 BIT_MASK 0x1 /end MEASUREMENT
/begin CHARACTERISTIC c_diam_diagcp_max "" VALUE 0xa002093b _REC_S1VAL_20_u1 4.127 _CNV_A_R_EVAM_LINEA_63_CM 0. 4.127 FORMAT "%5.3" /end CHARACTERISTIC
/begin CHARACTERISTIC c_diam_diagcp_min "" VALUE 0xa002093d _REC_S1VAL_20_u1 4.127 _CNV_A_R_EVAM_LINEA_63_CM 0. 4.127 FORMAT "%5.3" /end CHARACTERISTIC
/begin CHARACTERISTIC c_diam_diagcp_min_eol "Minimum treshhold for leakage detection during EOL test" VALUE 0xa002093e _REC_S1VAL_20_u1 4.127 _CNV_A_R_EVAM_LINEA_63_CM 0. 4.127 FORMAT "%5.3" /end CHARACTERISTIC
/begin CHARACTERISTIC c_dtp_dif_cps_diagcp "Pressure threshold for mechanical CPS error" VALUE 0xa00208a6 _REC_S1VAL_20_s2 81.92 _CNV_P_3_EVAM_LINEA_I_64_CM -40.96 40.96 FORMAT "%8.5" /end CHARACTERISTIC
/begin CHARACTERISTIC c_dtp_dif_min_diagcp "" VALUE 0xa00208ac _REC_S1VAL_20_s2 81.92 _CNV_P_3_EVAM_LINEA_I_64_CM -40.96 40.96 FORMAT "%8.5" /end CHARACTERISTIC
/begin CHARACTERISTIC lc_diagcp_slop "Configuration bit to change \"05mm error management\"  depending on DTP_SLOP during evacuation" VALUE 0xa0020981 _REC_S1VAL_20_u1 1. _CNV_A_R_ECME_LINEA_0_CM 0. 1. FORMAT "%1.0" /end CHARACTERISTIC
/begin CHARACTERISTIC lc_fmy_act_fuc_miss_diag "Activate failure memory: YES/NO" VALUE 0xa0020982 _REC_S1VAL_20_u1 1. _CNV_A_R_ECME_LINEA_0_CM 0. 1. FORMAT "%1.0" /end CHARACTERISTIC
/begin AXIS_PTS ldp_dtp_thd_fuc_miss "" 0xa0020854 ftl_diagcp _REC_A2AXS_20_u1 100. _CNV_A_R_LINEAR_____65_CM 4 0. 100. FORMAT "%3.0" /end AXIS_PTS
/begin CHARACTERISTIC ip_dtp_thd_fuc_miss "Pressure threshold for \"Fuel cap missing detection\", depending on fuel tank level" CURVE 0xa0020824 _REC_A1CUR_20_u2_u1 81.92 _CNV_P_3_EVAM_LINEA_I_66_CM -40.96 40.96 FORMAT "%8.5"
 /begin AXIS_DESCR COM_AXIS ftl_diagcp _CNV_A_R_LINEAR_____65_CM 4 0. 100. FORMAT "%3.0" AXIS_PTS_REF ldp_dtp_thd_fuc_miss /end AXIS_DESCR
/end CHARACTERISTIC
/begin MEASUREMENT ctr_cyc_fuc_miss_diag "Total number of completed FUC_MISS_DIAG cycles" UBYTE _CNV_A_R_ECME_LINEA_0_CM 1 0. 0. 255. ECU_ADDRESS 0xd0007686 FORMAT "%3.0" /end MEASUREMENT
/begin MEASUREMENT ctr_cyc_fuc_miss_intr_diag "Total number of FUC_MISS_DIAG interruptions before completing cycle" UBYTE _CNV_A_R_ECME_LINEA_0_CM 1 0. 0. 255. ECU_ADDRESS 0xd0007687 FORMAT "%3.0" /end MEASUREMENT
/begin MEASUREMENT lv_fuc_miss_chk_mpl_diag "Multiple check active" UBYTE _CNV_S_2_RANGE______3_CM 1 0. 0. 1. ECU_ADDRESS 0xd0007679 BIT_MASK 0x1 /end MEASUREMENT
/begin MEASUREMENT lv_fuc_miss_diag "FUC_MISS diagnosis is in process" UBYTE _CNV_S_2_RANGE______3_CM 1 0. 0. 1. ECU_ADDRESS 0xd0006354 BIT_MASK 0x1 /end MEASUREMENT
/begin MEASUREMENT lv_fuc_miss_diag_end "FUC_MISS diagnosis completed" UBYTE _CNV_S_2_RANGE______3_CM 1 0. 0. 1. ECU_ADDRESS 0xd0006355 BIT_MASK 0x1 /end MEASUREMENT
/begin MEASUREMENT lv_fuc_miss_diag_ready "FUC_MISS diagnosis is finished" UBYTE _CNV_S_2_RANGE______3_CM 1 0. 0. 1. ECU_ADDRESS 0xd0006356 BIT_MASK 0x1 /end MEASUREMENT
/begin MEASUREMENT lv_sov_req_1 "Request for switching the SOV valve (for FUC_MISS diag)" UBYTE _CNV_S_2_RANGE______3_CM 1 0. 0. 1. ECU_ADDRESS 0xd0006361 BIT_MASK 0x1 /end MEASUREMENT
/begin MEASUREMENT t_dly_1_fuc_miss_diag "Delay time after conditions for FUC_MISS diagnosis are fullfilled" UWORD _CNV_A_R_EVAM_LINEA_67_CM 1 0. 0. 3276.75 ECU_ADDRESS 0xd0003d24 FORMAT "%7.2" /end MEASUREMENT
/begin MEASUREMENT t_dly_2_fuc_miss_diag "Time during FUC_MISS diagnosis is in process" UWORD _CNV_A_R_EVAM_LINEA_67_CM 1 0. 0. 3276.75 ECU_ADDRESS 0xd0003d26 FORMAT "%7.2" /end MEASUREMENT
/begin MEASUREMENT t_dly_3_fuc_miss_diag "Time duration in idle speed" UWORD _CNV_A_R_LINEAR_____58_CM 1 0. 0. 6553.5 ECU_ADDRESS 0xd0004dac FORMAT "%6.1" /end MEASUREMENT
/begin CHARACTERISTIC c_nr_cyc_fuc_miss_diag_max "Maximum number of FUC_MIS_DIAG cycles per driving cycle" VALUE 0xa0020954 _REC_S1VAL_20_u1 255. _CNV_A_R_ECME_LINEA_0_CM 0. 255. FORMAT "%3.0" /end CHARACTERISTIC
/begin CHARACTERISTIC c_nr_cyc_intr_fuc_miss_diag "Maximum number of FUC_MISS_DIAG diagnosis interruptions" VALUE 0xa0020955 _REC_S1VAL_20_u1 255. _CNV_A_R_ECME_LINEA_0_CM 0. 255. FORMAT "%3.0" /end CHARACTERISTIC
/begin CHARACTERISTIC c_t_dly_1_fuc_miss_diag "Min. delay time after STATE_CDN_DIAGCP= STATE_CDN_FUC_MISS_DIAGCP, to start FUC_MISS diagnosis" VALUE 0xa0020912 _REC_S1VAL_20_u2 3276.75 _CNV_A_R_EVAM_LINEA_67_CM 0. 3276.75 FORMAT "%7.2" /end CHARACTERISTIC
/begin CHARACTERISTIC c_t_dly_2_fuc_miss_diag "Time for the duration of the FUC_MISS diagnosis" VALUE 0xa0020914 _REC_S1VAL_20_u2 3276.75 _CNV_A_R_EVAM_LINEA_67_CM 0. 3276.75 FORMAT "%7.2" /end CHARACTERISTIC
/begin CHARACTERISTIC c_t_dly_3_fuc_miss_diag "Time for Idle State Duration due to trigger a next  FUC_MISS diagnosis" VALUE 0xa0020918 _REC_S1VAL_20_u2 6553.5 _CNV_A_R_LINEAR_____58_CM 0. 6553.5 FORMAT "%6.1" /end CHARACTERISTIC
/begin CHARACTERISTIC c_t_dly_4_fuc_miss_diag "Time duration between two  FUC_MISS diagnosis cycles" VALUE 0xa002091a _REC_S1VAL_20_u2 6553.5 _CNV_A_R_LINEAR_____58_CM 0. 6553.5 FORMAT "%6.1" /end CHARACTERISTIC
/begin AXIS_PTS ldp_fac_fq_st_ad "" 0xa0022c2c fac_fq_st_ad _REC_A2AXS_20_u1 1.9921875 _CNV_A_R_LINEAR_____42_CM 8 0. 1.9921875 FORMAT "%8.6" /end AXIS_PTS
/begin CHARACTERISTIC ip_fac_fq_st_ad_diagcp "Weighted fuel quality factor for evaporative system monitoring" CURVE 0xa002082c _REC_A1CUR_20_u1_u1 1.9921875 _CNV_A_R_LINEAR_____42_CM 0. 1.9921875 FORMAT "%8.6"
 /begin AXIS_DESCR COM_AXIS fac_fq_st_ad _CNV_A_R_LINEAR_____42_CM 8 0. 1.9921875 FORMAT "%8.6" AXIS_PTS_REF ldp_fac_fq_st_ad /end AXIS_DESCR
/end CHARACTERISTIC
/begin MEASUREMENT fac_ti_st_ad_diagcp "Fuel quality correction factor" UBYTE _CNV_A_R_LINEAR_____42_CM 1 0. 0. 1.9921875 ECU_ADDRESS 0xd000636b FORMAT "%8.6" /end MEASUREMENT
/begin MEASUREMENT fac_ti_st_ad_diagcp_old "Saved fuel quality correction factor" UBYTE _CNV_A_R_LINEAR_____42_CM 1 0. 0. 1.9921875 ECU_ADDRESS 0xd000636c FORMAT "%8.6" /end MEASUREMENT
/begin MEASUREMENT ftl_diagcp "Fuel level used for EVAM calculation" UBYTE _CNV_A_R_LINEAR_____65_CM 1 0. 0. 255. ECU_ADDRESS 0xd000636d FORMAT "%3.0" /end MEASUREMENT
/begin MEASUREMENT t_ast_cor "Corrected time after start" SWORD _CNV_A_R_LINEAR_____68_CM 1 0. -32768. 32767. ECU_ADDRESS 0xd0003d22 FORMAT "%6.0" /end MEASUREMENT
/begin MEASUREMENT temp_fuel_cor_diagcp "Temperature correction dependent on fuel temperature" UBYTE _CNV_A_R_LINEAR_____41_CM 1 0. -48. 142.5 ECU_ADDRESS 0xd000637b FORMAT "%6.2" /end MEASUREMENT
/begin CHARACTERISTIC c_ftl_sub_diagcp "Substitute value of FTL in case of no FTL available" VALUE 0xa0020951 _REC_S1VAL_20_u1 100. _CNV_A_R_LINEAR_____65_CM 0. 100. FORMAT "%3.0" /end CHARACTERISTIC
/begin CHARACTERISTIC c_tco_st_max_st_ad_diagcp "Maximum TCO_ST threshold" VALUE 0xa0020974 _REC_S1VAL_20_u1 190.5 _CNV_A_R_LINEAR_____41_CM -48. 142.5 FORMAT "%6.2" /end CHARACTERISTIC
/begin CHARACTERISTIC c_tco_st_min_st_ad_diagcp "Minimum TCO_ST threshold" VALUE 0xa0020977 _REC_S1VAL_20_u1 190.5 _CNV_A_R_LINEAR_____41_CM -48. 142.5 FORMAT "%6.2" /end CHARACTERISTIC
/begin CHARACTERISTIC c_temp_fuel_sub_diagcp "Substitute value of fuel temperature " VALUE 0xa002097a _REC_S1VAL_20_u1 190.5 _CNV_A_R_LINEAR_____41_CM -48. 142.5 FORMAT "%6.2" /end CHARACTERISTIC
/begin MEASUREMENT cdn_diag_el_sov "Diagnosis condition for each symptom of SOV" UBYTE _CNV_A_R_ECME_LINEA_0_CM 1 0. 0. 255. ECU_ADDRESS 0xd0006365 FORMAT "%3.0" /end MEASUREMENT
/begin MEASUREMENT err_sym_el_sov "Symptom of electrical failure on Canister Shut-Off Valve (SOV)" UBYTE _CNV_S_16_RANGE_ERR__62_CM 1 0. 0. 15. ECU_ADDRESS 0xd000636a /end MEASUREMENT
/begin MEASUREMENT err_sym_mec_close_sov "Symptom of the failure" UBYTE _CNV_S_16_RANGE_ERR__62_CM 1 0. 0. 15. ECU_ADDRESS 0xd0007532 /end MEASUREMENT
/begin MEASUREMENT lv_cdn_diag_mec_close_sov "Boolean for the activations/deactivation conditions of the CLOSE SOV mechanical diagnosis" UBYTE _CNV_S_2_RANGE______3_CM 1 0. 0. 1. ECU_ADDRESS 0xd000751c BIT_MASK 0x1 /end MEASUREMENT
/begin MEASUREMENT lv_diag_el_sov "Logical feedback of SOV discret stage" UBYTE _CNV_S_2_RANGE______3_CM 1 0. 0. 1. ECU_ADDRESS 0xd0007674 /end MEASUREMENT
/begin MEASUREMENT lv_err_mec_close_sov "Boolean for error currently present due to canister shut off valve stuck in closed position" UBYTE _CNV_S_2_RANGE______3_CM 1 0. 0. 1. ECU_ADDRESS 0xd0006350 BIT_MASK 0x1 /end MEASUREMENT
/begin MEASUREMENT lv_pulse_ack_sov "Flag to indicate that the pulse acquisition is done" UBYTE _CNV_S_2_RANGE______3_CM 1 0. 0. 1. ECU_ADDRESS 0xd000767d /end MEASUREMENT
/begin MEASUREMENT lv_pulse_req_sov "Request for pulse generation at key-on " UBYTE _CNV_S_2_RANGE______3_CM 1 0. 0. 1. ECU_ADDRESS 0xd000767e /end MEASUREMENT
/begin MEASUREMENT lv_sta_mem_sov "Memorization of SOV state" UBYTE _CNV_S_2_RANGE______3_CM 1 0. 0. 1. ECU_ADDRESS 0xd0006362 /end MEASUREMENT
/begin MEASUREMENT v_adc_pulse_sov "Raw signal acquisition during the pulse at key on" UWORD _CNV_A_R_LINEAR_____69_CM 1 0. 0. 11.992722 ECU_ADDRESS 0xd0007672 FORMAT "%9.7" /end MEASUREMENT
/begin MEASUREMENT v_diag_el_sov "Raw value for SOV control diagnosis" UWORD _CNV_A_R_LINEAR_____69_CM 1 0. 0. 11.992722 ECU_ADDRESS 0xd0004dbc FORMAT "%9.7" /end MEASUREMENT
/begin MEASUREMENT vp_diag_el_sov "Raw signal voltage of SOV discret stage" UWORD _CNV_A_R_LINEAR_____69_CM 1 0. 0. 11.992722 ECU_ADDRESS 0xd0004dc2 FORMAT "%9.7" /end MEASUREMENT
/begin CHARACTERISTIC c_diag_el_sov_off_0 "Threshold for diagnosis when the output is OFF" VALUE 0xa0020890 _REC_S1VAL_20_u2 11.992722 _CNV_A_R_LINEAR_____69_CM 0. 11.992722 FORMAT "%9.7" /end CHARACTERISTIC
/begin CHARACTERISTIC c_diag_el_sov_off_1 "Threshold for diagnosis when the output is OFF" VALUE 0xa0020892 _REC_S1VAL_20_u2 11.992722 _CNV_A_R_LINEAR_____69_CM 0. 11.992722 FORMAT "%9.7" /end CHARACTERISTIC
/begin CHARACTERISTIC c_diag_el_sov_off_2 "Threshold for diagnosis when the output is OFF" VALUE 0xa0020894 _REC_S1VAL_20_u2 11.992722 _CNV_A_R_LINEAR_____69_CM 0. 11.992722 FORMAT "%9.7" /end CHARACTERISTIC
/begin CHARACTERISTIC c_diag_el_sov_off_3 "Threshold for diagnosis when the output is OFF" VALUE 0xa0020896 _REC_S1VAL_20_u2 11.992722 _CNV_A_R_LINEAR_____69_CM 0. 11.992722 FORMAT "%9.7" /end CHARACTERISTIC
/begin CHARACTERISTIC c_diag_el_sov_on_0 "Threshold for diagnosis when the output is ON" VALUE 0xa0020898 _REC_S1VAL_20_u2 11.992722 _CNV_A_R_LINEAR_____69_CM 0. 11.992722 FORMAT "%9.7" /end CHARACTERISTIC
/begin CHARACTERISTIC c_diag_el_sov_on_1 "Threshold for diagnosis when the output is ON" VALUE 0xa002089a _REC_S1VAL_20_u2 11.992722 _CNV_A_R_LINEAR_____69_CM 0. 11.992722 FORMAT "%9.7" /end CHARACTERISTIC
/begin CHARACTERISTIC c_diag_el_sov_on_2 "Threshold for diagnosis when the output is ON" VALUE 0xa002089c _REC_S1VAL_20_u2 11.992722 _CNV_A_R_LINEAR_____69_CM 0. 11.992722 FORMAT "%9.7" /end CHARACTERISTIC
/begin CHARACTERISTIC c_dtp_raw_min_sov "" VALUE 0xa00208c4 _REC_S1VAL_20_s2 81.92 _CNV_P_3_EVAM_LINEA_I_64_CM -40.96 40.96 FORMAT "%8.5" /end CHARACTERISTIC
/begin CHARACTERISTIC c_ftl_max_mec_close_sov "Maximum fuel level to start the SOV stuck diagnosis" VALUE 0xa002094d _REC_S1VAL_20_u1 100. _CNV_A_R_LINEAR_____65_CM 0. 100. FORMAT "%3.0" /end CHARACTERISTIC
/begin MEASUREMENT err_sym_dtp_con "Symptom of the DTP constant detection" UBYTE _CNV_S_16_RANGE_ERR__62_CM 1 0. 0. 15. ECU_ADDRESS 0xd000752f /end MEASUREMENT
/begin MEASUREMENT err_sym_dtp_el "Symptom of the DTP electrical failure" UBYTE _CNV_S_16_RANGE_ERR__62_CM 1 0. 0. 15. ECU_ADDRESS 0xd000752e /end MEASUREMENT
/begin MEASUREMENT err_sym_dtp_noise "Symptom of the DTP noisy signal detection" UBYTE _CNV_S_16_RANGE_ERR__62_CM 1 0. 0. 15. ECU_ADDRESS 0xd0007530 /end MEASUREMENT
/begin MEASUREMENT flow_cps_dif_diagcp "" UWORD _CNV_A_R_LINEAR_____55_CM 1 0. 0. 7.9998779296875 ECU_ADDRESS 0xd0004d8e FORMAT "%6.4" /end MEASUREMENT
/begin MEASUREMENT flow_cps_max_diagcp "" UWORD _CNV_A_R_LINEAR_____55_CM 1 0. 0. 7.9998779296875 ECU_ADDRESS 0xd0004d90 FORMAT "%6.4" /end MEASUREMENT
/begin MEASUREMENT flow_cps_min_diagcp "" UWORD _CNV_A_R_LINEAR_____55_CM 1 0. 0. 7.9998779296875 ECU_ADDRESS 0xd0004d92 FORMAT "%6.4" /end MEASUREMENT
/begin MEASUREMENT lv_cdn_diag_dtp_con "Activation (1) or Deactivation (0) of the DTP constant detection" UBYTE _CNV_S_2_RANGE______3_CM 1 0. 0. 1. ECU_ADDRESS 0xd0007519 BIT_MASK 0x1 /end MEASUREMENT
/begin MEASUREMENT lv_cdn_diag_dtp_el "Activation (1) or Deactivation (0) of the DTP electrical diagnosis" UBYTE _CNV_S_2_RANGE______3_CM 1 0. 0. 1. ECU_ADDRESS 0xd0007518 BIT_MASK 0x1 /end MEASUREMENT
/begin MEASUREMENT lv_cdn_diag_dtp_noise "Activation (1) or Deactivation (0) of the DTP noisy signal detection" UBYTE _CNV_S_2_RANGE______3_CM 1 0. 0. 1. ECU_ADDRESS 0xd000751a BIT_MASK 0x1 /end MEASUREMENT
/begin MEASUREMENT lv_dtp_dif_dtp_diag "" UBYTE _CNV_S_2_RANGE______3_CM 1 0. 0. 1. ECU_ADDRESS 0xd000633e /end MEASUREMENT
/begin MEASUREMENT lv_dtp_slop_dtp_diag "" UBYTE _CNV_S_2_RANGE______3_CM 1 0. 0. 1. ECU_ADDRESS 0xd0006340 /end MEASUREMENT
/begin MEASUREMENT lv_err_dtp_con "" UBYTE _CNV_S_2_RANGE______3_CM 1 0. 0. 1. ECU_ADDRESS 0xd0006347 BIT_MASK 0x1 /end MEASUREMENT
/begin MEASUREMENT lv_err_dtp_el "" UBYTE _CNV_S_2_RANGE______3_CM 1 0. 0. 1. ECU_ADDRESS 0xd0006348 BIT_MASK 0x1 /end MEASUREMENT
/begin MEASUREMENT lv_err_dtp_noise "" UBYTE _CNV_S_2_RANGE______3_CM 1 0. 0. 1. ECU_ADDRESS 0xd0006349 BIT_MASK 0x1 /end MEASUREMENT
/begin MEASUREMENT nr_dtp_con_dtp_diag_sample "" UWORD _CNV_A_R_ECME_LINEA_0_CM 1 0. 0. 65535. ECU_ADDRESS 0xd0004da4 FORMAT "%5.0" /end MEASUREMENT
/begin MEASUREMENT v_dtp_dif_dtp_diag "" UWORD _CNV_A_R_LINEAR_____70_CM 1 0. 0. 4.9951171875 ECU_ADDRESS 0xd0003d2e FORMAT "%5.3" /end MEASUREMENT
/begin MEASUREMENT v_dtp_max_dtp_diag "" UWORD _CNV_A_R_LINEAR_____70_CM 1 0. 0. 4.9951171875 ECU_ADDRESS 0xd0004dbe FORMAT "%5.3" /end MEASUREMENT
/begin MEASUREMENT v_dtp_min_dtp_diag "" UWORD _CNV_A_R_LINEAR_____70_CM 1 0. 0. 4.9951171875 ECU_ADDRESS 0xd0004dc0 FORMAT "%5.3" /end MEASUREMENT
/begin MEASUREMENT vs_dtp_max_dtp_diag "" UBYTE _CNV_A_R_LINEAR_____71_CM 1 0. 0. 255. ECU_ADDRESS 0xd0004dc4 FORMAT "%3.0" /end MEASUREMENT
/begin CHARACTERISTIC c_flow_cps_dif_min "" VALUE 0xa00208ea _REC_S1VAL_20_u2 7.9998779296875 _CNV_A_R_LINEAR_____55_CM 0. 7.9998779296875 FORMAT "%6.4" /end CHARACTERISTIC
/begin CHARACTERISTIC c_ftl_max_dtp_con "Maximum fuel level to start the constant signal diagnosis (DTP)" VALUE 0xa002094a _REC_S1VAL_20_u1 100. _CNV_A_R_LINEAR_____65_CM 0. 100. FORMAT "%3.0" /end CHARACTERISTIC
/begin CHARACTERISTIC c_ftl_max_dtp_noise "Maximum fuel level to start the noisy signal diagnosis (DTP)" VALUE 0xa002094b _REC_S1VAL_20_u1 100. _CNV_A_R_LINEAR_____65_CM 0. 100. FORMAT "%3.0" /end CHARACTERISTIC
/begin CHARACTERISTIC c_nr_dtp_con_diag_sample "" VALUE 0xa0020956 _REC_S1VAL_20_u1 255. _CNV_A_R_ECME_LINEA_0_CM 0. 255. FORMAT "%3.0" /end CHARACTERISTIC
/begin CHARACTERISTIC c_v_dtp_max_dtp_diag "" VALUE 0xa0020930 _REC_S1VAL_20_u2 4.9951171875 _CNV_A_R_LINEAR_____70_CM 0. 4.9951171875 FORMAT "%5.3" /end CHARACTERISTIC
/begin CHARACTERISTIC c_v_dtp_min_con_diag "" VALUE 0xa0020932 _REC_S1VAL_20_u2 4.9951171875 _CNV_A_R_LINEAR_____70_CM 0. 4.9951171875 FORMAT "%5.3" /end CHARACTERISTIC
/begin CHARACTERISTIC c_v_dtp_min_dtp_diag "" VALUE 0xa0020934 _REC_S1VAL_20_u2 4.9951171875 _CNV_A_R_LINEAR_____70_CM 0. 4.9951171875 FORMAT "%5.3" /end CHARACTERISTIC
/begin CHARACTERISTIC c_v_dtp_plaus_con_diag "" VALUE 0xa0020936 _REC_S1VAL_20_u2 4.9951171875 _CNV_A_R_LINEAR_____70_CM 0. 4.9951171875 FORMAT "%5.3" /end CHARACTERISTIC
/begin CHARACTERISTIC c_vs_dtp_diag "" VALUE 0xa002097b _REC_S1VAL_20_u1 255. _CNV_A_R_LINEAR_____71_CM 0. 255. FORMAT "%3.0" /end CHARACTERISTIC
/begin AXIS_PTS ldp_amp_ip_amp_sqrt "" 0xa0022b8c amp _REC_A2AXS_20_u2 5434. _CNV_A_R_LINEAR_____51_CM 6 0. 5434. FORMAT "%7.2" /end AXIS_PTS
/begin AXIS_PTS ldp_ar_leak_diagcp "" 0xa0022bb0 ar_leak_diagcp _REC_A2AXS_20_u2 1.348e-003 _CNV_A_R_EVAM_LINEA_73_CM 20 0. 1.348e-003 FORMAT "%10.8" /end AXIS_PTS
/begin AXIS_PTS ldp_dtp_ip_dtp_mdl_diagcp "" 0xa0022bf0 dtp _REC_A2AXS_20_u2 81.92 _CNV_P_3_EVAM_LINEA_I_66_CM 20 -40.96 40.96 FORMAT "%8.5" /end AXIS_PTS
/begin AXIS_PTS ldp_dtp_mff_ip_mff_diagcp "" 0xa0022c1c dtp_mff _REC_A2AXS_20_u2 81.92 _CNV_P_3_EVAM_LINEA_I_66_CM 6 -40.96 40.96 FORMAT "%8.5" /end AXIS_PTS
/begin AXIS_PTS ldp_fac_lam_dif_diagcp_ip_diagcp "" 0xa0022c4c fac_lam_dif_diagcp _REC_A2AXS_20_u2 99.99847412109381 _CNV_A_R_LINEAR_____74_CM 6 -50. 49.9984741210938 FORMAT "%7.3" /end AXIS_PTS
/begin AXIS_PTS ldp_fac_mdl_bas_estim_diagcp "" 0xa0022c68 fac_mdl_bas_diagcp _REC_A2AXS_20_u2 0.467 _CNV_A_R_EVAM_LINEA_75_CM 4 0. 0.467 FORMAT "%8.6" /end AXIS_PTS
/begin AXIS_PTS ldp_ftl_vol_cor_diagcp "" 0xa002085a ftl_vol_cor_diagcp _REC_A2AXS_20_u1 99.609375 _CNV_A_R_LINEAR_____76_CM 4 0. 99.609375 /end AXIS_PTS
/begin AXIS_PTS ldp_ftl_vol_estim_diagcp "" 0xa0022c80 ftl_vol_estim_diagcp _REC_A2AXS_20_u1 99.609375 _CNV_A_R_LINEAR_____52_CM 8 0. 99.609375 FORMAT "%9.6" /end AXIS_PTS
/begin AXIS_PTS ldp_maf_ip_cl_crlc_ramp_open "" 0xa0022c8c maf _REC_A2AXS_20_u1 1389. _CNV_A_R_LINEAR_____77_CM 8 0. 1389. FORMAT "%4.0" /end AXIS_PTS
/begin AXIS_PTS ldp_n_32_ip_cl_crlc_ramp_open "" 0xa0022cac n_32 _REC_A2AXS_20_u1 8160. _CNV_A_R_LINEAR_____2_CM 8 0. 8160. FORMAT "%4.0" /end AXIS_PTS
/begin AXIS_PTS ldp_tam_ip_fac_mdl_estim_diagcp "" 0xa0020860 tam _REC_A2AXS_20_u1 190.5 _CNV_A_R_LINEAR_____41_CM 6 -48. 142.5 FORMAT "%6.2" /end AXIS_PTS
/begin AXIS_PTS ldp_tam_ip_fac_tam_diagcp "" 0xa0020868 tam _REC_A2AXS_20_u1 190.5 _CNV_A_R_LINEAR_____41_CM 4 -48. 142.5 FORMAT "%6.2" /end AXIS_PTS
/begin CHARACTERISTIC ip_amp_sqrt "" CURVE 0xa0022d14 _REC_A1CUR_20_u2_u2 34.641 _CNV_A_R_EVAM_LINEA_78_CM 0. 34.641 FORMAT "%8.6"
 /begin AXIS_DESCR COM_AXIS amp _CNV_A_R_LINEAR_____51_CM 6 0. 5434. FORMAT "%7.2" AXIS_PTS_REF ldp_amp_ip_amp_sqrt /end AXIS_DESCR
/end CHARACTERISTIC
/begin CHARACTERISTIC ip_cl_crlc_ramp_open_vap_chk "" MAP 0xa0022d20 _REC_A1MAP_20_u2_u1_u1 0.9999847412109381 _CNV_A_R_LINEAR_____7_CM 0. 0.9999847412109381 FORMAT "%7.5"
 /begin AXIS_DESCR COM_AXIS n_32 _CNV_A_R_LINEAR_____2_CM 8 0. 8160. FORMAT "%4.0" AXIS_PTS_REF ldp_n_32_ip_cl_crlc_ramp_open /end AXIS_DESCR
 /begin AXIS_DESCR COM_AXIS maf _CNV_A_R_LINEAR_____77_CM 8 0. 1389. FORMAT "%4.0" AXIS_PTS_REF ldp_maf_ip_cl_crlc_ramp_open /end AXIS_DESCR
/end CHARACTERISTIC
/begin CHARACTERISTIC ip_dtp_mdl_diagcp "" CURVE 0xa0022dac _REC_A1CUR_20_u2_u2 12.754 _CNV_P_3_EVAM_LINEA_I_79_CM -6.377 6.377 FORMAT "%7.4"
 /begin AXIS_DESCR COM_AXIS dtp _CNV_P_3_EVAM_LINEA_I_66_CM 20 -40.96 40.96 FORMAT "%8.5" AXIS_PTS_REF ldp_dtp_ip_dtp_mdl_diagcp /end AXIS_DESCR
/end CHARACTERISTIC
/begin CHARACTERISTIC ip_fac_mdl_estim_diagcp "" MAP 0xa0022e54 _REC_A1MAP_20_u2_u2_u1 0.467 _CNV_A_R_EVAM_LINEA_75_CM 0. 0.467 FORMAT "%8.6"
 /begin AXIS_DESCR COM_AXIS fac_mdl_bas_diagcp _CNV_A_R_EVAM_LINEA_75_CM 4 0. 0.467 FORMAT "%8.6" AXIS_PTS_REF ldp_fac_mdl_bas_estim_diagcp /end AXIS_DESCR
 /begin AXIS_DESCR COM_AXIS tam _CNV_A_R_LINEAR_____41_CM 6 -48. 142.5 FORMAT "%6.2" AXIS_PTS_REF ldp_tam_ip_fac_mdl_estim_diagcp /end AXIS_DESCR
/end CHARACTERISTIC
/begin CHARACTERISTIC ip_fac_sqrt_ar_leak_diagcp "" CURVE 0xa0022e84 _REC_A1CUR_20_u1_u2 4.127 _CNV_A_R_EVAM_LINEA_63_CM 0. 4.127 FORMAT "%5.3"
 /begin AXIS_DESCR COM_AXIS ar_leak_diagcp _CNV_A_R_EVAM_LINEA_73_CM 20 0. 1.348e-003 FORMAT "%10.8" AXIS_PTS_REF ldp_ar_leak_diagcp /end AXIS_DESCR
/end CHARACTERISTIC
/begin CHARACTERISTIC ip_fac_tam_diagcp "" CURVE 0xa0020872 _REC_A1CUR_20_u1_u1 0.99609375 _CNV_A_R_LINEAR_____29_CM 0. 0.99609375 FORMAT "%5.3"
 /begin AXIS_DESCR COM_AXIS tam _CNV_A_R_LINEAR_____41_CM 4 -48. 142.5 FORMAT "%6.2" AXIS_PTS_REF ldp_tam_ip_fac_tam_diagcp /end AXIS_DESCR
/end CHARACTERISTIC
/begin CHARACTERISTIC ip_flow_cps_sp_vap_chk "" CURVE 0xa0020834 _REC_A1CUR_20_u2_u1 7.9998779296875 _CNV_A_R_LINEAR_____55_CM 0. 7.9998779296875 FORMAT "%6.4"
 /begin AXIS_DESCR COM_AXIS ftl_vol_cor_diagcp _CNV_A_R_LINEAR_____76_CM 4 0. 99.609375 AXIS_PTS_REF ldp_ftl_vol_cor_diagcp /end AXIS_DESCR
/end CHARACTERISTIC
/begin CHARACTERISTIC ip_ftl_vol_cor_diagcp "" CURVE 0xa0020844 _REC_A1CUR_20_u1_u1 99.609375 _CNV_A_R_LINEAR_____76_CM 0. 99.609375
 /begin AXIS_DESCR COM_AXIS ftl_vol_estim_diagcp _CNV_A_R_LINEAR_____52_CM 8 0. 99.609375 FORMAT "%9.6" AXIS_PTS_REF ldp_ftl_vol_estim_diagcp /end AXIS_DESCR
/end CHARACTERISTIC
/begin CHARACTERISTIC ip_mff_add_dtp_diagcp "" CURVE 0xa0022e98 _REC_A1CUR_20_u2_u2 1389. _CNV_A_R_LINEAR_____80_CM 0. 1389. FORMAT "%7.2"
 /begin AXIS_DESCR COM_AXIS dtp_mff _CNV_P_3_EVAM_LINEA_I_66_CM 6 -40.96 40.96 FORMAT "%8.5" AXIS_PTS_REF ldp_dtp_mff_ip_mff_diagcp /end AXIS_DESCR
/end CHARACTERISTIC
/begin CHARACTERISTIC ip_mff_add_lam_diagcp "" CURVE 0xa0022ea4 _REC_A1CUR_20_u2_u2 1389. _CNV_A_R_LINEAR_____80_CM 0. 1389. FORMAT "%7.2"
 /begin AXIS_DESCR COM_AXIS fac_lam_dif_diagcp _CNV_A_R_LINEAR_____74_CM 6 -50. 49.9984741210938 FORMAT "%7.3" AXIS_PTS_REF ldp_fac_lam_dif_diagcp_ip_diagcp /end AXIS_DESCR
/end CHARACTERISTIC
/begin MEASUREMENT ar_leak_diagcp "" UWORD _CNV_A_R_EVAM_LINEA_73_CM 1 0. 0. 1.348e-003 ECU_ADDRESS 0xd0004d4e FORMAT "%10.8" /end MEASUREMENT
/begin MEASUREMENT cl_mmv_vap_chk "" UWORD _CNV_A_R_LINEAR_____48_CM 1 0. 0. 1.99996948242188 ECU_ADDRESS 0xd0004d50 FORMAT "%7.5" /end MEASUREMENT
/begin MEASUREMENT cl_mmv_vap_chk_grd "" UWORD _CNV_A_R_LINEAR_____48_CM 1 0. 0. 1.99996948242188 ECU_ADDRESS 0xd0004d52 FORMAT "%7.5" /end MEASUREMENT
/begin MEASUREMENT cl_mmv_vap_chk_grd_sum "" UWORD _CNV_A_R_LINEAR_____48_CM 1 0. 0. 1.99996948242188 ECU_ADDRESS 0xd0004d54 FORMAT "%7.5" /end MEASUREMENT
/begin MEASUREMENT cl_vap_chk "" UWORD _CNV_A_R_LINEAR_____48_CM 1 0. 0. 1.99996948242188 ECU_ADDRESS 0xd0004d56 FORMAT "%7.5" /end MEASUREMENT
/begin MEASUREMENT cl_vap_chk_tmp "" UWORD _CNV_A_R_LINEAR_____48_CM 1 0. 0. 1.99996948242188 ECU_ADDRESS 0xd0004d58 FORMAT "%7.5" /end MEASUREMENT
/begin MEASUREMENT ctr_cyc_cdn_diagcp "" UBYTE _CNV_A_R_ECME_LINEA_0_CM 1 0. 0. 255. ECU_ADDRESS 0xd0007684 FORMAT "%3.0" /end MEASUREMENT
/begin MEASUREMENT ctr_cyc_diagcp "" UBYTE _CNV_A_R_ECME_LINEA_0_CM 1 0. 0. 255. ECU_ADDRESS 0xd0007685 FORMAT "%3.0" /end MEASUREMENT
/begin MEASUREMENT ctr_cyc_intr_diagcp "" UBYTE _CNV_A_R_ECME_LINEA_0_CM 1 0. 0. 255. ECU_ADDRESS 0xd0007688 FORMAT "%3.0" /end MEASUREMENT
/begin MEASUREMENT ctr_sum_dtp "" UWORD _CNV_A_R_ECME_LINEA_0_CM 1 0. 0. 65535. ECU_ADDRESS 0xd0004d5a FORMAT "%5.0" /end MEASUREMENT
/begin MEASUREMENT diam_diagcp "" UBYTE _CNV_A_R_EVAM_LINEA_63_CM 1 0. 0. 4.127 ECU_ADDRESS 0xd0006367 FORMAT "%5.3" /end MEASUREMENT
/begin MEASUREMENT diam_diagcp_mod_6 "" UBYTE _CNV_A_R_EVAM_LINEA_63_CM 1 0. 0. 4.127 ECU_ADDRESS 0xd0006368 FORMAT "%5.3" /end MEASUREMENT
/begin MEASUREMENT dtp_dif_act_mod_6 "" SWORD _CNV_P_3_EVAM_LINEA_I_64_CM 1 0. -40.96 40.96 ECU_ADDRESS 0xd0003cf8 FORMAT "%8.5" /end MEASUREMENT
/begin MEASUREMENT dtp_mff "" SWORD _CNV_P_3_EVAM_LINEA_I_64_CM 1 0. -40.96 40.96 ECU_ADDRESS 0xd0004d68 FORMAT "%8.5" /end MEASUREMENT
/begin MEASUREMENT dtp_mff_add_diagcp_ofs "" SWORD _CNV_P_3_EVAM_LINEA_I_64_CM 1 0. -40.96 40.96 ECU_ADDRESS 0xd0004d6a FORMAT "%8.5" /end MEASUREMENT
/begin MEASUREMENT dtp_tot_dif_bas "" SLONG _CNV_P_3_EVAM_LINEA_I_81_CM 1 0. -417900. 417900. ECU_ADDRESS 0xd000342c FORMAT "%10.6" /end MEASUREMENT
/begin MEASUREMENT dtp_tot_dif_diag "" SLONG _CNV_P_3_EVAM_LINEA_I_81_CM 1 0. -417900. 417900. ECU_ADDRESS 0xd0003430 FORMAT "%10.6" /end MEASUREMENT
/begin MEASUREMENT dtp_tot_sum "" UWORD _CNV_A_R_ECME_LINEA_0_CM 1 0. 0. 65535. ECU_ADDRESS 0xd0004d7e FORMAT "%5.0" /end MEASUREMENT
/begin MEASUREMENT fac_lam_0_cp_vap_chk "" SWORD _CNV_A_R_LINEAR_____82_CM 1 0. -50. 49.9984741210938 ECU_ADDRESS 0xd0004d80 FORMAT "%7.3" /end MEASUREMENT
/begin MEASUREMENT fac_lam_cor_mmv_diagcp "" SWORD _CNV_A_R_LINEAR_____82_CM 1 0. -50. 49.9984741210938 ECU_ADDRESS 0xd0004d82 FORMAT "%7.3" /end MEASUREMENT
/begin MEASUREMENT fac_lam_diagcp[0] "" SWORD _CNV_A_R_LINEAR_____82_CM 1 0. -50. 49.9984741210938 ECU_ADDRESS 0xd0003d12 FORMAT "%7.3" /end MEASUREMENT
/begin MEASUREMENT fac_lam_dif_cp_vap_chk "" SWORD _CNV_A_R_LINEAR_____82_CM 1 0. -50. 49.9984741210938 ECU_ADDRESS 0xd0004d84 FORMAT "%7.3" /end MEASUREMENT
/begin MEASUREMENT fac_lam_dif_diagcp "" SWORD _CNV_A_R_LINEAR_____82_CM 1 0. -50. 49.9984741210938 ECU_ADDRESS 0xd0004d86 FORMAT "%7.3" /end MEASUREMENT
/begin MEASUREMENT fac_lam_sp_diagcp "" SWORD _CNV_A_R_LINEAR_____82_CM 1 0. -50. 49.9984741210938 ECU_ADDRESS 0xd0004d88 FORMAT "%7.3" /end MEASUREMENT
/begin MEASUREMENT fac_mdl_bas_diagcp "" UWORD _CNV_A_R_EVAM_LINEA_75_CM 1 0. 0. 0.467 ECU_ADDRESS 0xd0003d14 FORMAT "%8.6" /end MEASUREMENT
/begin MEASUREMENT fac_mdl_diag_diagcp "" UWORD _CNV_A_R_EVAM_LINEA_75_CM 1 0. 0. 0.467 ECU_ADDRESS 0xd0004d8a FORMAT "%8.6" /end MEASUREMENT
/begin MEASUREMENT fac_mdl_end_diagcp "" UWORD _CNV_A_R_EVAM_LINEA_75_CM 1 0. 0. 0.467 ECU_ADDRESS 0xd0004d8c FORMAT "%8.6" /end MEASUREMENT
/begin MEASUREMENT fac_mdl_estim_diagcp "" UWORD _CNV_A_R_EVAM_LINEA_75_CM 1 0. 0. 0.467 ECU_ADDRESS 0xd0003d16 FORMAT "%8.6" /end MEASUREMENT
/begin MEASUREMENT fac_ti_vap_chk_diagcp "" UBYTE _CNV_A_R_LINEAR_____83_CM 1 0. 0. 3.984375 ECU_ADDRESS 0xd0007689 FORMAT "%8.6" /end MEASUREMENT
/begin MEASUREMENT flow_sp_cps_evap "" UWORD _CNV_A_R_LINEAR_____55_CM 1 0. 0. 7.9998779296875 ECU_ADDRESS 0xd0003d1c FORMAT "%6.4" /end MEASUREMENT
/begin MEASUREMENT ftl_vol_cor_diagcp "" UBYTE _CNV_A_R_LINEAR_____76_CM 1 0. 0. 99.609375 ECU_ADDRESS 0xd000636e /end MEASUREMENT
/begin MEASUREMENT lv_diagcp_act "" UBYTE _CNV_S_2_RANGE______3_CM 1 0. 0. 1. ECU_ADDRESS 0xd0006335 BIT_MASK 0x1 /end MEASUREMENT
/begin MEASUREMENT lv_diagcp_cdn_not_ok "" UBYTE _CNV_S_2_RANGE______3_CM 1 0. 0. 1. ECU_ADDRESS 0xd0006336 BIT_MASK 0x1 /end MEASUREMENT
/begin MEASUREMENT lv_diagcp_chk_mpl "" UBYTE _CNV_S_2_RANGE______3_CM 1 0. 0. 1. ECU_ADDRESS 0xd0007675 BIT_MASK 0x1 /end MEASUREMENT
/begin MEASUREMENT lv_diagcp_cps_act "" UBYTE _CNV_S_2_RANGE______3_CM 1 0. 0. 1. ECU_ADDRESS 0xd0006338 BIT_MASK 0x1 /end MEASUREMENT
/begin MEASUREMENT lv_diagcp_end "" UBYTE _CNV_S_2_RANGE______3_CM 1 0. 0. 1. ECU_ADDRESS 0xd0006339 BIT_MASK 0x1 /end MEASUREMENT
/begin MEASUREMENT lv_diagcp_req_wait "" UBYTE _CNV_S_2_RANGE______3_CM 1 0. 0. 1. ECU_ADDRESS 0xd000633c BIT_MASK 0x1 /end MEASUREMENT
/begin MEASUREMENT lv_fac_diagcp_mdl "" UBYTE _CNV_S_2_RANGE______3_CM 1 0. 0. 1. ECU_ADDRESS 0xd0007677 BIT_MASK 0x1 /end MEASUREMENT
/begin MEASUREMENT lv_fac_lam_diagcp "" UBYTE _CNV_S_2_RANGE______3_CM 1 0. 0. 1. ECU_ADDRESS 0xd0006352 BIT_MASK 0x1 /end MEASUREMENT
/begin MEASUREMENT lv_fac_lam_diagcp_cmpl "" UBYTE _CNV_S_2_RANGE______3_CM 1 0. 0. 1. ECU_ADDRESS 0xd0007678 BIT_MASK 0x1 /end MEASUREMENT
/begin MEASUREMENT lv_mff_add_ofs_end "" UBYTE _CNV_S_2_RANGE______3_CM 1 0. 0. 1. ECU_ADDRESS 0xd000767c BIT_MASK 0x1 /end MEASUREMENT
/begin MEASUREMENT lv_sov_req "" UBYTE _CNV_S_2_RANGE______3_CM 1 0. 0. 1. ECU_ADDRESS 0xd0006360 BIT_MASK 0x1 /end MEASUREMENT
/begin MEASUREMENT lv_vap_chk_end "" UBYTE _CNV_S_2_RANGE______3_CM 1 0. 0. 1. ECU_ADDRESS 0xd0007680 BIT_MASK 0x1 /end MEASUREMENT
/begin MEASUREMENT maf_mmv_diagcp "" UWORD _CNV_A_R_LINEAR_____80_CM 1 0. 0. 1389. ECU_ADDRESS 0xd0004d96 FORMAT "%7.2" /end MEASUREMENT
/begin MEASUREMENT mff_add_dec_diagcp "" UWORD _CNV_A_R_LINEAR_____80_CM 1 0. 0. 1389. ECU_ADDRESS 0xd0004d98 FORMAT "%7.2" /end MEASUREMENT
/begin MEASUREMENT mff_add_diagcp "" UWORD _CNV_A_R_LINEAR_____80_CM 1 0. 0. 1389. ECU_ADDRESS 0xd0003d1e FORMAT "%7.2" /end MEASUREMENT
/begin MEASUREMENT mff_add_dtp_diagcp "" UWORD _CNV_A_R_LINEAR_____80_CM 1 0. 0. 1389. ECU_ADDRESS 0xd0004d9a FORMAT "%7.2" /end MEASUREMENT
/begin MEASUREMENT mff_add_dtp_ofs_diagcp "" UWORD _CNV_A_R_LINEAR_____80_CM 1 0. 0. 1389. ECU_ADDRESS 0xd0004d9c FORMAT "%7.2" /end MEASUREMENT
/begin MEASUREMENT mff_add_lam_diagcp "" UWORD _CNV_A_R_LINEAR_____80_CM 1 0. 0. 1389. ECU_ADDRESS 0xd0004d9e FORMAT "%7.2" /end MEASUREMENT
/begin MEASUREMENT mff_add_ofs_diagcp "" UWORD _CNV_A_R_LINEAR_____80_CM 1 0. 0. 1389. ECU_ADDRESS 0xd0004da0 FORMAT "%7.2" /end MEASUREMENT
/begin MEASUREMENT mff_vap_chk_diagcp "" SWORD _CNV_P_3_EVAM_LINEA_I_84_CM 1 0. -8. 7.99976 ECU_ADDRESS 0xd0004da2 FORMAT "%8.6" /end MEASUREMENT
/begin MEASUREMENT state_diagcp "" UBYTE _CNV_S_17_EVAM_RANGE_85_CM 1 0. 0. 16. ECU_ADDRESS 0xd0006373 /end MEASUREMENT
/begin MEASUREMENT state_eol_diagcp "" UBYTE _CNV_S_3_EVAM_RANGE_86_CM 1 0. 0. 2. ECU_ADDRESS 0xd0006374 /end MEASUREMENT
/begin MEASUREMENT state_intr_diagcp "" UWORD _CNV_A_R_ECME_LINEA_0_CM 1 0. 0. 65535. ECU_ADDRESS 0xd0003d20 FORMAT "%5.0" /end MEASUREMENT
/begin MEASUREMENT t_diagcp "" UWORD _CNV_A_R_EVAM_LINEA_67_CM 1 0. 0. 3276.75 ECU_ADDRESS 0xd0004daa FORMAT "%7.2" /end MEASUREMENT
/begin MEASUREMENT t_dly_eol_diagcp "" UBYTE _CNV_A_R_LINEAR_____68_CM 1 0. 0. 255. ECU_ADDRESS 0xd0006378 FORMAT "%3.0" /end MEASUREMENT
/begin MEASUREMENT t_dtp_grd_vap_chk "" UBYTE _CNV_A_R_EVAM_LINEA_67_CM 1 0. 0. 12.75 ECU_ADDRESS 0xd000768a FORMAT "%5.2" /end MEASUREMENT
/begin MEASUREMENT t_mff_add_dly_1_diagcp "" UWORD _CNV_A_R_EVAM_LINEA_67_CM 1 0. 0. 3276.75 ECU_ADDRESS 0xd0004db2 FORMAT "%7.2" /end MEASUREMENT
/begin MEASUREMENT t_mff_add_dly_1_diagcp_ofs "" UWORD _CNV_A_R_EVAM_LINEA_67_CM 1 0. 0. 3276.75 ECU_ADDRESS 0xd0004db4 FORMAT "%7.2" /end MEASUREMENT
/begin MEASUREMENT t_mff_add_dly_2_diagcp_ofs "" UWORD _CNV_A_R_EVAM_LINEA_67_CM 1 0. 0. 3276.75 ECU_ADDRESS 0xd0004db6 FORMAT "%7.2" /end MEASUREMENT
/begin MEASUREMENT t_vap_chk "" UBYTE _CNV_A_R_EVAM_LINEA_67_CM 1 0. 0. 12.75 ECU_ADDRESS 0xd000768d FORMAT "%5.2" /end MEASUREMENT
/begin MEASUREMENT vs_max_diagcp "" UBYTE _CNV_A_R_LINEAR_____71_CM 1 0. 0. 255. ECU_ADDRESS 0xd000637d FORMAT "%3.0" /end MEASUREMENT
/begin CHARACTERISTIC c_cl_max_vap_chk "" VALUE 0xa0020880 _REC_S1VAL_20_u2 1.99996948242188 _CNV_A_R_LINEAR_____48_CM 0. 1.99996948242188 FORMAT "%7.5" /end CHARACTERISTIC
/begin CHARACTERISTIC c_cl_mmv_end_diagcp "Maximum canister load for SMALL LEAK  condition" VALUE 0xa0020882 _REC_S1VAL_20_u2 1.99996948242188 _CNV_A_R_LINEAR_____48_CM 0. 1.99996948242188 FORMAT "%7.5" /end CHARACTERISTIC
/begin CHARACTERISTIC c_cl_mmv_grd_max_vap_chk "" VALUE 0xa0020888 _REC_S1VAL_20_u2 1.99996948242188 _CNV_A_R_LINEAR_____48_CM 0. 1.99996948242188 FORMAT "%7.5" /end CHARACTERISTIC
/begin CHARACTERISTIC c_cl_vap_chk_max "" VALUE 0xa002088e _REC_S1VAL_20_u2 1.99996948242188 _CNV_A_R_LINEAR_____48_CM 0. 1.99996948242188 FORMAT "%7.5" /end CHARACTERISTIC
/begin CHARACTERISTIC c_ctr_cyc_cdn_diagcp "" VALUE 0xa0020938 _REC_S1VAL_20_u1 255. _CNV_A_R_ECME_LINEA_0_CM 0. 255. FORMAT "%3.0" /end CHARACTERISTIC
/begin CHARACTERISTIC c_ctr_cyc_diagcp_max "" VALUE 0xa0020939 _REC_S1VAL_20_u1 255. _CNV_A_R_ECME_LINEA_0_CM 0. 255. FORMAT "%3.0" /end CHARACTERISTIC
/begin CHARACTERISTIC c_ctr_cyc_intr_diagcp_max "" VALUE 0xa002093a _REC_S1VAL_20_u1 255. _CNV_A_R_ECME_LINEA_0_CM 0. 255. FORMAT "%3.0" /end CHARACTERISTIC
/begin CHARACTERISTIC c_diam_diagcp_max_vap_chk "" VALUE 0xa002093c _REC_S1VAL_20_u1 4.127 _CNV_A_R_EVAM_LINEA_63_CM 0. 4.127 FORMAT "%5.3" /end CHARACTERISTIC
/begin CHARACTERISTIC c_diam_diagcp_min_vap_chk "" VALUE 0xa002093f _REC_S1VAL_20_u1 4.127 _CNV_A_R_EVAM_LINEA_63_CM 0. 4.127 FORMAT "%5.3" /end CHARACTERISTIC
/begin CHARACTERISTIC c_dtp_diagcp "" VALUE 0xa00208a0 _REC_S1VAL_20_s2 81.92 _CNV_P_3_EVAM_LINEA_I_64_CM -40.96 40.96 FORMAT "%8.5" /end CHARACTERISTIC
/begin CHARACTERISTIC c_dtp_dif_diagcp "" VALUE 0xa00208a8 _REC_S1VAL_20_s2 81.92 _CNV_P_3_EVAM_LINEA_I_64_CM -40.96 40.96 FORMAT "%8.5" /end CHARACTERISTIC
/begin CHARACTERISTIC c_dtp_max_rec_diagcp "" VALUE 0xa0020941 _REC_S1VAL_20_u1 254. _CNV_A_R_ECME_LINEA_0_CM 1. 255. FORMAT "%3.0" /end CHARACTERISTIC
/begin CHARACTERISTIC c_dtp_mv_min_diagcp "" VALUE 0xa00208c2 _REC_S1VAL_20_s2 81.92 _CNV_P_3_EVAM_LINEA_I_64_CM -40.96 40.96 FORMAT "%8.5" /end CHARACTERISTIC
/begin CHARACTERISTIC c_dtp_slop_end_min "" VALUE 0xa00208c8 _REC_S1VAL_20_s2 819.2000000000001 _CNV_P_3_EVAM_LINEA_I_87_CM -409.6 409.6 FORMAT "%8.4" /end CHARACTERISTIC
/begin CHARACTERISTIC c_fac_lam_cor_fil_diagcp "" VALUE 0xa00208ca _REC_S1VAL_20_u2 0.9999847412109381 _CNV_A_R_LINEAR_____7_CM 0. 0.9999847412109381 FORMAT "%7.5" /end CHARACTERISTIC
/begin CHARACTERISTIC c_fac_lam_cor_max_vap_chk "" VALUE 0xa00208cc _REC_S1VAL_20_s2 99.99847412109381 _CNV_A_R_LINEAR_____82_CM -50. 49.9984741210938 FORMAT "%7.3" /end CHARACTERISTIC
/begin CHARACTERISTIC c_fac_lam_cor_min_vap_chk "" VALUE 0xa00208ce _REC_S1VAL_20_s2 99.99847412109381 _CNV_A_R_LINEAR_____82_CM -50. 49.9984741210938 FORMAT "%7.3" /end CHARACTERISTIC
/begin CHARACTERISTIC c_fac_lam_diagcp_as "" VALUE 0xa00208d0 _REC_S1VAL_20_s2 99.99847412109381 _CNV_A_R_LINEAR_____82_CM -50. 49.9984741210938 FORMAT "%7.3" /end CHARACTERISTIC
/begin CHARACTERISTIC c_fac_lam_dif_diagcp "" VALUE 0xa00208d4 _REC_S1VAL_20_s2 99.99847412109381 _CNV_A_R_LINEAR_____82_CM -50. 49.9984741210938 FORMAT "%7.3" /end CHARACTERISTIC
/begin CHARACTERISTIC c_fac_lam_dif_diagcp_max "" VALUE 0xa00208d6 _REC_S1VAL_20_s2 99.99847412109381 _CNV_A_R_LINEAR_____82_CM -50. 49.9984741210938 FORMAT "%7.3" /end CHARACTERISTIC
/begin CHARACTERISTIC c_fac_lam_fil_diagcp "" VALUE 0xa00208d8 _REC_S1VAL_20_u2 0.9999847412109381 _CNV_A_R_LINEAR_____7_CM 0. 0.9999847412109381 FORMAT "%7.5" /end CHARACTERISTIC
/begin CHARACTERISTIC c_fac_lam_max_vap_chk "" VALUE 0xa00208da _REC_S1VAL_20_s2 99.99847412109381 _CNV_A_R_LINEAR_____82_CM -50. 49.9984741210938 FORMAT "%7.3" /end CHARACTERISTIC
/begin CHARACTERISTIC c_fac_lam_min_diagcp "" VALUE 0xa00208dc _REC_S1VAL_20_s2 99.99847412109381 _CNV_A_R_LINEAR_____82_CM -50. 49.9984741210938 FORMAT "%7.3" /end CHARACTERISTIC
/begin CHARACTERISTIC c_fac_lam_min_vap_chk "" VALUE 0xa00208de _REC_S1VAL_20_s2 99.99847412109381 _CNV_A_R_LINEAR_____82_CM -50. 49.9984741210938 FORMAT "%7.3" /end CHARACTERISTIC
/begin CHARACTERISTIC c_fac_mdl_bas_diagcp_max "" VALUE 0xa00208e0 _REC_S1VAL_20_u2 0.467 _CNV_A_R_EVAM_LINEA_75_CM 0. 0.467 FORMAT "%8.6" /end CHARACTERISTIC
/begin CHARACTERISTIC c_fac_mdl_bas_diagcp_max_eol "Maximum allowed leakage parameter for LARGE LEAK during vapour generation period during EOL" VALUE 0xa00208e2 _REC_S1VAL_20_u2 0.467 _CNV_A_R_EVAM_LINEA_75_CM 0. 0.467 FORMAT "%8.6" /end CHARACTERISTIC
/begin CHARACTERISTIC c_fac_mdl_bas_diagcp_min "" VALUE 0xa00208e4 _REC_S1VAL_20_u2 0.467 _CNV_A_R_EVAM_LINEA_75_CM 0. 0.467 FORMAT "%8.6" /end CHARACTERISTIC
/begin CHARACTERISTIC c_fac_mdl_bas_diagcp_min_eol "Minimum allowed leakage parameter for SMALL LEAK detection during vapour generation period during EOL" VALUE 0xa00208e6 _REC_S1VAL_20_u2 0.467 _CNV_A_R_EVAM_LINEA_75_CM 0. 0.467 FORMAT "%8.6" /end CHARACTERISTIC
/begin CHARACTERISTIC c_fac_mdl_bas_diagcp_vap_chk "" VALUE 0xa00208e8 _REC_S1VAL_20_u2 0.467 _CNV_A_R_EVAM_LINEA_75_CM 0. 0.467 FORMAT "%8.6" /end CHARACTERISTIC
/begin CHARACTERISTIC c_fac_mff_add_ofs_diagcp "" VALUE 0xa0020944 _REC_S1VAL_20_u1 0.99609375 _CNV_A_R_LINEAR_____29_CM 0. 0.99609375 FORMAT "%5.3" /end CHARACTERISTIC
/begin CHARACTERISTIC c_fac_ti_diagcp "" VALUE 0xa0020945 _REC_S1VAL_20_u1 3.984375 _CNV_A_R_LINEAR_____83_CM 0. 3.984375 FORMAT "%8.6" /end CHARACTERISTIC
/begin CHARACTERISTIC c_fac_ti_vap_chk_diagcp_1 "" VALUE 0xa0020946 _REC_S1VAL_20_u1 3.984375 _CNV_A_R_LINEAR_____83_CM 0. 3.984375 FORMAT "%8.6" /end CHARACTERISTIC
/begin CHARACTERISTIC c_fac_ti_vap_chk_diagcp_2 "" VALUE 0xa0020947 _REC_S1VAL_20_u1 3.984375 _CNV_A_R_LINEAR_____83_CM 0. 3.984375 FORMAT "%8.6" /end CHARACTERISTIC
/begin CHARACTERISTIC c_flow_cps_sp_dec_diagcp "" VALUE 0xa00208f4 _REC_S1VAL_20_u2 7.9998779296875 _CNV_A_R_LINEAR_____88_CM 0. 7.9998779296875 FORMAT "%6.4" /end CHARACTERISTIC
/begin CHARACTERISTIC c_flow_cps_sp_dec_vap_chk "" VALUE 0xa00208f6 _REC_S1VAL_20_u2 7.9998779296875 _CNV_A_R_LINEAR_____88_CM 0. 7.9998779296875 FORMAT "%6.4" /end CHARACTERISTIC
/begin CHARACTERISTIC c_flow_cps_sp_diagcp "" VALUE 0xa00208f8 _REC_S1VAL_20_u2 7.9998779296875 _CNV_A_R_LINEAR_____88_CM 0. 7.9998779296875 FORMAT "%6.4" /end CHARACTERISTIC
/begin CHARACTERISTIC c_flow_cps_sp_inc_diagcp "" VALUE 0xa00208fa _REC_S1VAL_20_u2 7.9998779296875 _CNV_A_R_LINEAR_____88_CM 0. 7.9998779296875 FORMAT "%6.4" /end CHARACTERISTIC
/begin CHARACTERISTIC c_flow_cps_sp_inc_vap_chk "" VALUE 0xa00208fc _REC_S1VAL_20_u2 7.9998779296875 _CNV_A_R_LINEAR_____88_CM 0. 7.9998779296875 FORMAT "%6.4" /end CHARACTERISTIC
/begin CHARACTERISTIC c_ftl_max "" VALUE 0xa0020948 _REC_S1VAL_20_u1 99.609375 _CNV_A_R_LINEAR_____52_CM 0. 99.609375 FORMAT "%9.6" /end CHARACTERISTIC
/begin CHARACTERISTIC c_ftl_min "" VALUE 0xa002094e _REC_S1VAL_20_u1 99.609375 _CNV_A_R_LINEAR_____52_CM 0. 99.609375 FORMAT "%9.6" /end CHARACTERISTIC
/begin CHARACTERISTIC c_maf_mmv_crlc_diagcp "" VALUE 0xa0020952 _REC_S1VAL_20_u1 0.99609375 _CNV_A_R_LINEAR_____29_CM 0. 0.99609375 FORMAT "%5.3" /end CHARACTERISTIC
/begin CHARACTERISTIC c_maf_mmv_diagcp "" VALUE 0xa0020900 _REC_S1VAL_20_u2 1389. _CNV_A_R_LINEAR_____80_CM 0. 1389. FORMAT "%7.2" /end CHARACTERISTIC
/begin CHARACTERISTIC c_mff_add_diagcp_vap_max "" VALUE 0xa0020902 _REC_S1VAL_20_u2 1389. _CNV_A_R_LINEAR_____80_CM 0. 1389. FORMAT "%7.2" /end CHARACTERISTIC
/begin CHARACTERISTIC c_mff_add_step_diagcp "" VALUE 0xa0020904 _REC_S1VAL_20_u2 1389. _CNV_A_R_LINEAR_____80_CM 0. 1389. FORMAT "%7.2" /end CHARACTERISTIC
/begin CHARACTERISTIC c_state_conf_diagcp "" VALUE 0xa002095a _REC_S1VAL_20_u1 2. _CNV_A_R_ECME_LINEA_0_CM 0. 2. FORMAT "%3.0" /end CHARACTERISTIC
/begin CHARACTERISTIC c_t_1_diagcp "" VALUE 0xa0020960 _REC_S1VAL_20_u1 25.4 _CNV_A_R_LINEAR_____58_CM 0.1 25.5 FORMAT "%4.1" /end CHARACTERISTIC
/begin CHARACTERISTIC c_t_2_diagcp "" VALUE 0xa0020962 _REC_S1VAL_20_u1 25.4 _CNV_A_R_LINEAR_____58_CM 0.1 25.5 FORMAT "%4.1" /end CHARACTERISTIC
/begin CHARACTERISTIC c_t_close_cps_diagcp "" VALUE 0xa0020964 _REC_S1VAL_20_u1 25.4 _CNV_A_R_LINEAR_____58_CM 0.1 25.5 FORMAT "%4.1" /end CHARACTERISTIC
/begin CHARACTERISTIC c_t_dly_3_diagcp "" VALUE 0xa0020916 _REC_S1VAL_20_u2 6553.4 _CNV_A_R_LINEAR_____58_CM 0.1 6553.5 FORMAT "%6.1" /end CHARACTERISTIC
/begin CHARACTERISTIC c_t_dly_close_sov_diagcp "" VALUE 0xa0020965 _REC_S1VAL_20_u1 25.4 _CNV_A_R_LINEAR_____58_CM 0.1 25.5 FORMAT "%4.1" /end CHARACTERISTIC
/begin CHARACTERISTIC c_t_dly_cor_beg_diagcp "" VALUE 0xa0020966 _REC_S1VAL_20_u1 25.4 _CNV_A_R_LINEAR_____58_CM 0.1 25.5 FORMAT "%4.1" /end CHARACTERISTIC
/begin CHARACTERISTIC c_t_dly_eol_diagcp "Time delay to avtivate normal Evap.diagnosis after EOL test." VALUE 0xa0020967 _REC_S1VAL_20_u1 255. _CNV_A_R_LINEAR_____68_CM 0. 255. FORMAT "%3.0" /end CHARACTERISTIC
/begin CHARACTERISTIC c_t_dly_vap_chk "" VALUE 0xa0020968 _REC_S1VAL_20_u1 25.4 _CNV_A_R_LINEAR_____58_CM 0.1 25.5 FORMAT "%4.1" /end CHARACTERISTIC
/begin CHARACTERISTIC c_t_dtp_grd_vap_chk "" VALUE 0xa0020969 _REC_S1VAL_20_u1 12.75 _CNV_A_R_EVAM_LINEA_67_CM 0. 12.75 FORMAT "%5.2" /end CHARACTERISTIC
/begin CHARACTERISTIC c_t_max_cps "" VALUE 0xa002096a _REC_S1VAL_20_u1 25.4 _CNV_A_R_LINEAR_____58_CM 0.1 25.5 FORMAT "%4.1" /end CHARACTERISTIC
/begin CHARACTERISTIC c_t_max_cps_vap_chk "" VALUE 0xa002096b _REC_S1VAL_20_u1 12.75 _CNV_A_R_EVAM_LINEA_67_CM 0. 12.75 FORMAT "%5.2" /end CHARACTERISTIC
/begin CHARACTERISTIC c_t_mff_add_diagcp_1 "" VALUE 0xa0020924 _REC_S1VAL_20_u2 3276.65 _CNV_A_R_EVAM_LINEA_67_CM 0.1 3276.75 FORMAT "%7.2" /end CHARACTERISTIC
/begin CHARACTERISTIC c_t_mff_add_diagcp_2 "" VALUE 0xa0020926 _REC_S1VAL_20_u2 3276.65 _CNV_A_R_EVAM_LINEA_67_CM 0.1 3276.75 FORMAT "%7.2" /end CHARACTERISTIC
/begin CHARACTERISTIC c_t_mff_add_diagcp_3 "" VALUE 0xa0020928 _REC_S1VAL_20_u2 3276.65 _CNV_A_R_EVAM_LINEA_67_CM 0.1 3276.75 FORMAT "%7.2" /end CHARACTERISTIC
/begin CHARACTERISTIC c_t_mff_add_diagcp_4 "" VALUE 0xa002092a _REC_S1VAL_20_u2 3276.65 _CNV_A_R_EVAM_LINEA_67_CM 0.1 3276.75 FORMAT "%7.2" /end CHARACTERISTIC
/begin CHARACTERISTIC lc_diagcp_cbk "" VALUE 0xa002097f _REC_S1VAL_20_u1 1. _CNV_A_R_ECME_LINEA_0_CM 0. 1. FORMAT "%1.0" /end CHARACTERISTIC
/begin AXIS_PTS ldp_dtp_grd "" 0xa0022bdc dtp_grd _REC_A2AXS_20_u2 102.4 _CNV_P_3_EVAM_LINEA_I_89_CM 8 -51.2 51.2 FORMAT "%10.5" /end AXIS_PTS
/begin AXIS_PTS ldp_fac_mdl_bas_diagcp "" 0xa0022c5c fac_mdl_bas_diagcp _REC_A2AXS_20_u2 0.467 _CNV_A_R_EVAM_LINEA_75_CM 4 0. 0.467 FORMAT "%8.6" /end AXIS_PTS
/begin AXIS_PTS ldp_ftl_diagcp_ip_ftl_diagcp "" 0xa0022c74 ftl_diagcp _REC_A2AXS_20_u1 100. _CNV_A_R_LINEAR_____65_CM 8 0. 100. FORMAT "%3.0" /end AXIS_PTS
/begin CHARACTERISTIC ip_fac_ftl_vol_estim_diagcp "" CURVE 0xa002086e _REC_A1CUR_20_u1_u2 1.9921875 _CNV_A_R_LINEAR_____42_CM 0. 1.9921875 FORMAT "%8.6"
 /begin AXIS_DESCR COM_AXIS fac_mdl_bas_diagcp _CNV_A_R_EVAM_LINEA_75_CM 4 0. 0.467 FORMAT "%8.6" AXIS_PTS_REF ldp_fac_mdl_bas_diagcp /end AXIS_DESCR
/end CHARACTERISTIC
/begin CHARACTERISTIC ip_ftl_diagcp "" CURVE 0xa002083c _REC_A1CUR_20_u1_u1 99.609375 _CNV_A_R_LINEAR_____52_CM 0. 99.609375 FORMAT "%9.6"
 /begin AXIS_DESCR COM_AXIS ftl_diagcp _CNV_A_R_LINEAR_____65_CM 8 0. 100. FORMAT "%3.0" AXIS_PTS_REF ldp_ftl_diagcp_ip_ftl_diagcp /end AXIS_DESCR
/end CHARACTERISTIC
/begin CHARACTERISTIC ip_ftl_vol_estim_diagcp "" CURVE 0xa002084c _REC_A1CUR_20_u1_u2 99.609375 _CNV_A_R_LINEAR_____52_CM 0. 99.609375 FORMAT "%9.6"
 /begin AXIS_DESCR COM_AXIS dtp_grd _CNV_P_3_EVAM_LINEA_I_89_CM 8 -51.2 51.2 FORMAT "%10.5" AXIS_PTS_REF ldp_dtp_grd /end AXIS_DESCR
/end CHARACTERISTIC
/begin MEASUREMENT ctr_dtp_max_rec_diagcp "" UBYTE _CNV_A_R_ECME_LINEA_0_CM 1 0. 0. 255. ECU_ADDRESS 0xd0003d30 FORMAT "%3.0" /end MEASUREMENT
/begin MEASUREMENT dtp "" SWORD _CNV_P_3_EVAM_LINEA_I_64_CM 1 0. -40.96 40.96 ECU_ADDRESS 0xd0003cf2 FORMAT "%8.5" /end MEASUREMENT
/begin MEASUREMENT dtp_beg_diagcp "" SWORD _CNV_P_3_EVAM_LINEA_I_64_CM 1 0. -40.96 40.96 ECU_ADDRESS 0xd0003cf4 FORMAT "%8.5" /end MEASUREMENT
/begin MEASUREMENT dtp_cor "" SWORD _CNV_P_3_EVAM_LINEA_I_64_CM 1 0. -40.96 40.96 ECU_ADDRESS 0xd0004d5c FORMAT "%8.5" /end MEASUREMENT
/begin MEASUREMENT dtp_dif_act "" SWORD _CNV_P_3_EVAM_LINEA_I_64_CM 1 0. -40.96 40.96 ECU_ADDRESS 0xd0003cf6 FORMAT "%8.5" /end MEASUREMENT
/begin MEASUREMENT dtp_dif_act_grd_diagcp "" SWORD _CNV_P_3_EVAM_LINEA_I_64_CM 1 0. -40.96 40.96 ECU_ADDRESS 0xd0004d5e FORMAT "%8.5" /end MEASUREMENT
/begin MEASUREMENT dtp_dif_cor "" SWORD _CNV_P_3_EVAM_LINEA_I_64_CM 1 0. -40.96 40.96 ECU_ADDRESS 0xd0004d60 FORMAT "%8.5" /end MEASUREMENT
/begin MEASUREMENT dtp_dif_cor_mod_6 "" SWORD _CNV_P_3_EVAM_LINEA_I_64_CM 1 0. -40.96 40.96 ECU_ADDRESS 0xd0003cfa FORMAT "%8.5" /end MEASUREMENT
/begin MEASUREMENT dtp_dif_dyw "" SWORD _CNV_P_3_EVAM_LINEA_I_64_CM 1 0. -40.96 40.96 ECU_ADDRESS 0xd0004d62 FORMAT "%8.5" /end MEASUREMENT
/begin MEASUREMENT dtp_dif_fuc_miss_diag "" SWORD _CNV_P_3_EVAM_LINEA_I_64_CM 1 0. -40.96 40.96 ECU_ADDRESS 0xd0003cfc FORMAT "%8.5" /end MEASUREMENT
/begin MEASUREMENT dtp_dif_fuc_miss_diag_mod_6 "" SWORD _CNV_P_3_EVAM_LINEA_I_64_CM 1 0. -40.96 40.96 ECU_ADDRESS 0xd0003cfe FORMAT "%8.5" /end MEASUREMENT
/begin MEASUREMENT dtp_dif_prs_dyn "" SWORD _CNV_P_3_EVAM_LINEA_I_64_CM 1 0. -40.96 40.96 ECU_ADDRESS 0xd0003d00 FORMAT "%8.5" /end MEASUREMENT
/begin MEASUREMENT dtp_dif_prs_dyn_mod_6 "" SWORD _CNV_P_3_EVAM_LINEA_I_64_CM 1 0. -40.96 40.96 ECU_ADDRESS 0xd0003d02 FORMAT "%8.5" /end MEASUREMENT
/begin MEASUREMENT dtp_grd "" SWORD _CNV_P_3_EVAM_LINEA_I_90_CM 1 0. -51.2 51.2 ECU_ADDRESS 0xd0004d64 FORMAT "%10.5" /end MEASUREMENT
/begin MEASUREMENT dtp_max "" SWORD _CNV_P_3_EVAM_LINEA_I_64_CM 1 0. -40.96 40.96 ECU_ADDRESS 0xd0004d66 FORMAT "%8.5" /end MEASUREMENT
/begin MEASUREMENT dtp_min "" SWORD _CNV_P_3_EVAM_LINEA_I_64_CM 1 0. -40.96 40.96 ECU_ADDRESS 0xd0004d6c FORMAT "%8.5" /end MEASUREMENT
/begin MEASUREMENT dtp_mmv "" SWORD _CNV_P_3_EVAM_LINEA_I_64_CM 1 0. -40.96 40.96 ECU_ADDRESS 0xd0003d06 FORMAT "%8.5" /end MEASUREMENT
/begin MEASUREMENT dtp_mv "" SWORD _CNV_P_3_EVAM_LINEA_I_64_CM 1 0. -40.96 40.96 ECU_ADDRESS 0xd0003d08 FORMAT "%8.5" /end MEASUREMENT
/begin MEASUREMENT dtp_mv_dyw "" SWORD _CNV_P_3_EVAM_LINEA_I_64_CM 1 0. -40.96 40.96 ECU_ADDRESS 0xd0004d6e FORMAT "%8.5" /end MEASUREMENT
/begin MEASUREMENT dtp_mv_fuc_miss_diag "" SWORD _CNV_P_3_EVAM_LINEA_I_64_CM 1 0. -40.96 40.96 ECU_ADDRESS 0xd0004d70 FORMAT "%8.5" /end MEASUREMENT
/begin MEASUREMENT dtp_mv_mod_6 "" SWORD _CNV_P_3_EVAM_LINEA_I_64_CM 1 0. -40.96 40.96 ECU_ADDRESS 0xd0003d0a FORMAT "%8.5" /end MEASUREMENT
/begin MEASUREMENT dtp_mv_per "" SWORD _CNV_P_3_EVAM_LINEA_I_64_CM 1 0. -40.96 40.96 ECU_ADDRESS 0xd0003d0c FORMAT "%8.5" /end MEASUREMENT
/begin MEASUREMENT dtp_ofs "" SWORD _CNV_P_3_EVAM_LINEA_I_64_CM 1 0. -40.96 40.96 ECU_ADDRESS 0xd0004d72 FORMAT "%8.5" /end MEASUREMENT
/begin MEASUREMENT dtp_slop "" SWORD _CNV_P_3_EVAM_LINEA_I_87_CM 1 0. -409.6 409.6 ECU_ADDRESS 0xd0004d74 FORMAT "%8.4" /end MEASUREMENT
/begin MEASUREMENT dtp_slop_end "" SWORD _CNV_P_3_EVAM_LINEA_I_87_CM 1 0. -409.6 409.6 ECU_ADDRESS 0xd0003d10 FORMAT "%8.4" /end MEASUREMENT
/begin MEASUREMENT dtp_slop_mmv "" SWORD _CNV_P_3_EVAM_LINEA_I_87_CM 1 0. -409.6 409.6 ECU_ADDRESS 0xd0004d76 FORMAT "%8.4" /end MEASUREMENT
/begin MEASUREMENT dtp_slop_mmv_dif "" UWORD _CNV_A_R_EVAM_LINEA_91_CM 1 0. 0. 819.2000000000001 ECU_ADDRESS 0xd0004d78 FORMAT "%8.4" /end MEASUREMENT
/begin MEASUREMENT dtp_slop_mmv_max "" SWORD _CNV_P_3_EVAM_LINEA_I_87_CM 1 0. -409.6 409.6 ECU_ADDRESS 0xd0004d7a FORMAT "%8.4" /end MEASUREMENT
/begin MEASUREMENT dtp_slop_mmv_min "" SWORD _CNV_P_3_EVAM_LINEA_I_87_CM 1 0. -409.6 409.6 ECU_ADDRESS 0xd0004d7c FORMAT "%8.4" /end MEASUREMENT
/begin MEASUREMENT ftl_vol_estim_diagcp "" UBYTE _CNV_A_R_LINEAR_____52_CM 1 0. 0. 99.609375 ECU_ADDRESS 0xd000636f FORMAT "%9.6" /end MEASUREMENT
/begin MEASUREMENT lv_dtp_diagcp_lim_dyn "" UBYTE _CNV_S_2_RANGE______3_CM 1 0. 0. 1. ECU_ADDRESS 0xd000633d BIT_MASK 0x1 /end MEASUREMENT
/begin MEASUREMENT lv_dtp_slop "" UBYTE _CNV_S_2_RANGE______3_CM 1 0. 0. 1. ECU_ADDRESS 0xd000633f BIT_MASK 0x1 /end MEASUREMENT
/begin MEASUREMENT state_cdn_dtp_noise_diagcp "" UBYTE _CNV_S_3_EVAM_RANGE_92_CM 1 0. 0. 2. ECU_ADDRESS 0xd0006371 /end MEASUREMENT
/begin MEASUREMENT t_dtp_grd_diagcp "" UWORD _CNV_A_R_EVAM_LINEA_67_CM 1 0. 0. 3276.75 ECU_ADDRESS 0xd0003d2a FORMAT "%7.2" /end MEASUREMENT
/begin MEASUREMENT t_prs_max_dyn_diagcp "" UBYTE _CNV_A_R_ECME_LINEA_0_CM 1 0. 0. 255. ECU_ADDRESS 0xd000768b FORMAT "%3.0" /end MEASUREMENT
/begin MEASUREMENT t_prs_min_dyn_diagcp "" UBYTE _CNV_A_R_ECME_LINEA_0_CM 1 0. 0. 255. ECU_ADDRESS 0xd000768c FORMAT "%3.0" /end MEASUREMENT
/begin CHARACTERISTIC c_dtp_bas_cor "" VALUE 0xa002089e _REC_S1VAL_20_s2 81.92 _CNV_P_3_EVAM_LINEA_I_64_CM -40.96 40.96 FORMAT "%8.5" /end CHARACTERISTIC
/begin CHARACTERISTIC c_dtp_diagcp_hys_neg "" VALUE 0xa00208a2 _REC_S1VAL_20_s2 81.92 _CNV_P_3_EVAM_LINEA_I_64_CM -40.96 40.96 FORMAT "%8.5" /end CHARACTERISTIC
/begin CHARACTERISTIC c_dtp_diagcp_hys_pos "" VALUE 0xa00208a4 _REC_S1VAL_20_s2 81.92 _CNV_P_3_EVAM_LINEA_I_64_CM -40.96 40.96 FORMAT "%8.5" /end CHARACTERISTIC
/begin CHARACTERISTIC c_dtp_dif_max_diagcp "" VALUE 0xa00208aa _REC_S1VAL_20_s2 81.92 _CNV_P_3_EVAM_LINEA_I_64_CM -40.96 40.96 FORMAT "%8.5" /end CHARACTERISTIC
/begin CHARACTERISTIC c_dtp_dyw_1 "" VALUE 0xa00208ae _REC_S1VAL_20_u2 40.96 _CNV_A_R_EVAM_LINEA_93_CM 0. 40.96 FORMAT "%8.5" /end CHARACTERISTIC
/begin CHARACTERISTIC c_dtp_dyw_2 "" VALUE 0xa00208b0 _REC_S1VAL_20_u2 40.96 _CNV_A_R_EVAM_LINEA_93_CM 0. 40.96 FORMAT "%8.5" /end CHARACTERISTIC
/begin CHARACTERISTIC c_dtp_dyw_3 "" VALUE 0xa00208b2 _REC_S1VAL_20_u2 40.96 _CNV_A_R_EVAM_LINEA_93_CM 0. 40.96 FORMAT "%8.5" /end CHARACTERISTIC
/begin CHARACTERISTIC c_dtp_dyw_4 "" VALUE 0xa00208b4 _REC_S1VAL_20_u2 40.96 _CNV_A_R_EVAM_LINEA_93_CM 0. 40.96 FORMAT "%8.5" /end CHARACTERISTIC
/begin CHARACTERISTIC c_dtp_max_dif_slop_mmv "" VALUE 0xa00208b8 _REC_S1VAL_20_u2 819.2000000000001 _CNV_A_R_EVAM_LINEA_91_CM 0. 819.2000000000001 FORMAT "%8.4" /end CHARACTERISTIC
/begin CHARACTERISTIC c_dtp_mmv_crlc "" VALUE 0xa0020942 _REC_S1VAL_20_u1 0.99609375 _CNV_A_R_LINEAR_____29_CM 0. 0.99609375 FORMAT "%5.3" /end CHARACTERISTIC
/begin CHARACTERISTIC c_dtp_slop_end_max "" VALUE 0xa00208c6 _REC_S1VAL_20_s2 819.2000000000001 _CNV_P_3_EVAM_LINEA_I_87_CM -409.6 409.6 FORMAT "%8.4" /end CHARACTERISTIC
/begin CHARACTERISTIC c_dtp_slop_mmv_crlc "" VALUE 0xa0020943 _REC_S1VAL_20_u1 0.99609375 _CNV_A_R_LINEAR_____29_CM 0. 0.99609375 FORMAT "%5.3" /end CHARACTERISTIC
/begin CHARACTERISTIC c_prs_max_dyn_diagcp "" VALUE 0xa0020957 _REC_S1VAL_20_u1 253. _CNV_A_R_ECME_LINEA_0_CM 2. 255. FORMAT "%3.0" /end CHARACTERISTIC
/begin CHARACTERISTIC c_prs_min_dyn_diagcp "" VALUE 0xa0020958 _REC_S1VAL_20_u1 253. _CNV_A_R_ECME_LINEA_0_CM 2. 255. FORMAT "%3.0" /end CHARACTERISTIC
/begin CHARACTERISTIC c_t_1_dif_diagcp "" VALUE 0xa0020961 _REC_S1VAL_20_u1 25.4 _CNV_A_R_LINEAR_____58_CM 0.1 25.5 FORMAT "%4.1" /end CHARACTERISTIC
/begin CHARACTERISTIC c_t_2_dif_diagcp "" VALUE 0xa0020963 _REC_S1VAL_20_u1 25.4 _CNV_A_R_LINEAR_____58_CM 0.1 25.5 FORMAT "%4.1" /end CHARACTERISTIC
/begin CHARACTERISTIC c_t_dtp_grd_diagcp "" VALUE 0xa002091e _REC_S1VAL_20_u2 3276.75 _CNV_A_R_EVAM_LINEA_67_CM 0. 3276.75 FORMAT "%7.2" /end CHARACTERISTIC
/begin CHARACTERISTIC c_t_max_fac_slop_mmv "" VALUE 0xa002096c _REC_S1VAL_20_u1 25.5 _CNV_A_R_LINEAR_____58_CM 0. 25.5 FORMAT "%4.1" /end CHARACTERISTIC
/begin CHARACTERISTIC lc_ftl_diagcp "FTL gauge information is used (1) or not (0) for function activation" VALUE 0xa0020983 _REC_S1VAL_20_u1 1. _CNV_A_R_ECME_LINEA_0_CM 0. 1. FORMAT "%1.0" /end CHARACTERISTIC
/begin CHARACTERISTIC lc_ftl_vol_estim_diagcp "Gradient method is used (1) or not (0) for leakage size estimation" VALUE 0xa0020984 _REC_S1VAL_20_u1 1. _CNV_A_R_ECME_LINEA_0_CM 0. 1. FORMAT "%1.0" /end CHARACTERISTIC
/begin MEASUREMENT lv_inh_diag_mec_close_sov "Boolean for SOV diagnosis inihibition conditions" UBYTE _CNV_S_2_RANGE______3_CM 1 0. 0. 1. ECU_ADDRESS 0xd000635c BIT_MASK 0x1 /end MEASUREMENT
/begin MEASUREMENT lv_inh_diag_dtp_con "Boolean for DTP stuck sensor diagnosis inihibition conditions" UBYTE _CNV_S_2_RANGE______3_CM 1 0. 0. 1. ECU_ADDRESS 0xd000635a /end MEASUREMENT
/begin MEASUREMENT lv_inh_diag_dtp_noise "Boolean for DTP noisy sensor diagnosis inihibition conditions" UBYTE _CNV_S_2_RANGE______3_CM 1 0. 0. 1. ECU_ADDRESS 0xd000635b /end MEASUREMENT
/begin AXIS_PTS ldp_amp_id_amp_temp_fuel "" 0xa0022b78 amp _REC_A2AXS_20_u2 5434. _CNV_A_R_LINEAR_____51_CM 8 0. 5434. FORMAT "%7.2" /end AXIS_PTS
/begin AXIS_PTS ldp_temp_fuel_cor_id_amp "" 0xa0022cb8 temp_fuel_cor_diagcp _REC_A2AXS_20_u1 190.5 _CNV_A_R_LINEAR_____41_CM 8 -48. 142.5 FORMAT "%6.2" /end AXIS_PTS
/begin CHARACTERISTIC id_amp_temp_fuel "Map due to inhibit DIAGCP in case of high fuel temperature and high altitude" MAP 0xa0022cd4 _REC_A1MAP_20_u1_u1_u2 1. _CNV_A_R_ECME_LINEA_0_CM 0. 1. FORMAT "%1.0"
 /begin AXIS_DESCR COM_AXIS temp_fuel_cor_diagcp _CNV_A_R_LINEAR_____41_CM 8 -48. 142.5 FORMAT "%6.2" AXIS_PTS_REF ldp_temp_fuel_cor_id_amp /end AXIS_DESCR
 /begin AXIS_DESCR COM_AXIS amp _CNV_A_R_LINEAR_____51_CM 8 0. 5434. FORMAT "%7.2" AXIS_PTS_REF ldp_amp_id_amp_temp_fuel /end AXIS_DESCR
/end CHARACTERISTIC
/begin MEASUREMENT amp_grd "Ambient pressure gradient" SWORD _CNV_A_R_LINEAR_____94_CM 1 0. -2717.04145876249 2716.95854123751 ECU_ADDRESS 0xd0004d4a FORMAT "%8.2" /end MEASUREMENT
/begin MEASUREMENT amp_old "Ambient pressure value - old" UWORD _CNV_A_R_LINEAR_____51_CM 1 0. 0. 5434. ECU_ADDRESS 0xd0004d4c FORMAT "%7.2" /end MEASUREMENT
/begin MEASUREMENT eng_off_time_act "ENG_OFF_TIME at DC begin" UWORD _CNV_A_R_LINEAR_____95_CM 1 0. 0. 65535. ECU_ADDRESS 0xd0007682 FORMAT "%5.0" /end MEASUREMENT
/begin MEASUREMENT lv_diagcp_fct_mod_8 "Boolean for diagnostic - dummy flag." UBYTE _CNV_S_2_RANGE______3_CM 1 0. 0. 1. ECU_ADDRESS 0xd0007676 /end MEASUREMENT
/begin MEASUREMENT lv_diagcp_req_eol "Request from the communication to active evaporative system diagnosis" UBYTE _CNV_S_2_RANGE______3_CM 1 0. 0. 1. ECU_ADDRESS 0xd000633b BIT_MASK 0x1 /end MEASUREMENT
/begin MEASUREMENT lv_end_diag_evap_1 "Boolean for leak errors diagnosis achievement" UBYTE _CNV_S_2_RANGE______3_CM 1 0. 0. 1. ECU_ADDRESS 0xd0006341 /end MEASUREMENT
/begin MEASUREMENT lv_err_evap_1 "Boolean - OBD2 present failure - leak errors" UBYTE _CNV_S_2_RANGE______3_CM 1 0. 0. 1. ECU_ADDRESS 0xd000634a /end MEASUREMENT
/begin MEASUREMENT lv_fq_st_ad_end_1_evap "" UBYTE _CNV_S_2_RANGE______3_CM 1 0. 0. 1. ECU_ADDRESS 0xd0006353 /end MEASUREMENT
/begin MEASUREMENT lv_inh_amp_grd_diagcp "Boolean for EVAP System monitoring inhibition in case of a high ambient pressure gradient" UBYTE _CNV_S_2_RANGE______3_CM 1 0. 0. 1. ECU_ADDRESS 0xd0006357 /end MEASUREMENT
/begin MEASUREMENT lv_inh_amp_temp_fuel_diagcp "Boolean for EVAP System monitoring inhibition in case of high fuel temperature and high altitude" UBYTE _CNV_S_2_RANGE______3_CM 1 0. 0. 1. ECU_ADDRESS 0xd0006358 /end MEASUREMENT
/begin MEASUREMENT lv_inh_diag_diagcp "Boolean for EVAP System monitoring inhibition due to failures" UBYTE _CNV_S_2_RANGE______3_CM 1 0. 0. 1. ECU_ADDRESS 0xd0006359 /end MEASUREMENT
/begin MEASUREMENT lv_inh_diagcp_ext_adj "Boolean for EVAP System monitoring inhibition due to external services" UBYTE _CNV_S_2_RANGE______3_CM 1 0. 0. 1. ECU_ADDRESS 0xd000635d /end MEASUREMENT
/begin MEASUREMENT lv_inh_diagcp_ext_fct "Boolean for EVAP System monitoring inhibition by Additional functions" UBYTE _CNV_S_2_RANGE______3_CM 1 0. 0. 1. ECU_ADDRESS 0xd000635e /end MEASUREMENT
/begin MEASUREMENT lv_inh_t_eru_diagcp "Boolean for EVAP System monitoring inhibition due to long engine running time" UBYTE _CNV_S_2_RANGE______3_CM 1 0. 0. 1. ECU_ADDRESS 0xd000767a /end MEASUREMENT
/begin MEASUREMENT lv_inh_t_eru_old_diagcp "Saved Boolean for EVAP System monitoring inhibition due to long engine running time" UBYTE _CNV_S_2_RANGE______3_CM 1 0. 0. 1. ECU_ADDRESS 0xd000767b /end MEASUREMENT
/begin MEASUREMENT lv_state_rbm_evap_bit_2 "Boolean to indicate that individual RBM conditions for EVAP Monitoring are fullfilled" UBYTE _CNV_S_2_RANGE______3_CM 1 0. 0. 1. ECU_ADDRESS 0xd0006363 /end MEASUREMENT
/begin MEASUREMENT state_rbm_cus_cps_mec "Interface of monitor CPS Mechanical failure for the rate based monitoring statistics" UBYTE _CNV_A_R_ECME_LINEA_0_CM 1 0. 0. 7. ECU_ADDRESS 0xd0006375 FORMAT "%3.0" /end MEASUREMENT
/begin MEASUREMENT state_rbm_cus_fuc "Interface of monitor EVAP Large Leakage for the rate based monitoring statistics" UBYTE _CNV_A_R_ECME_LINEA_0_CM 1 0. 0. 7. ECU_ADDRESS 0xd0006376 FORMAT "%3.0" /end MEASUREMENT
/begin MEASUREMENT state_rbm_evap "Interface of monitor EVAP Small Leakage for the rate based monitoring statistics" UBYTE _CNV_A_R_ECME_LINEA_0_CM 1 0. 0. 7. ECU_ADDRESS 0xd0006377 FORMAT "%3.0" /end MEASUREMENT
/begin MEASUREMENT t_amp_grd_sum "Timer between two AMP measurements" UWORD _CNV_A_R_LINEAR_____68_CM 1 0. 0. 65535. ECU_ADDRESS 0xd0004da6 FORMAT "%5.0" /end MEASUREMENT
/begin MEASUREMENT t_ast_evap_rbm "Comulative time (depending on ambient temperature) since engine start" UWORD _CNV_A_R_LINEAR_____68_CM 1 0. 0. 65535. ECU_ADDRESS 0xd0004da8 FORMAT "%5.0" /end MEASUREMENT
/begin MEASUREMENT t_inh_diagcp_amp_grd "Timer for disabling DIAGCP" UWORD _CNV_A_R_LINEAR_____68_CM 1 0. 0. 65535. ECU_ADDRESS 0xd0004db0 FORMAT "%5.0" /end MEASUREMENT
/begin MEASUREMENT t_vs_min_ini_diagcp "Timer for VS-condition fulfilled after start of DC" UWORD _CNV_A_R_LINEAR_____68_CM 1 0. 0. 65535. ECU_ADDRESS 0xd0004dba FORMAT "%5.0" /end MEASUREMENT
/begin MEASUREMENT temp_cor_grd "Temperature correction gradient" SBYTE _CNV_P_3_EVAM_LINEA_I_96_CM 1 0. -96. 95.25 ECU_ADDRESS 0xd000768e FORMAT "%6.2" /end MEASUREMENT
/begin MEASUREMENT temp_cor_old "Temperature correction value - old" UBYTE _CNV_A_R_LINEAR_____41_CM 1 0. -48. 142.5 ECU_ADDRESS 0xd000768f FORMAT "%6.2" /end MEASUREMENT
/begin CHARACTERISTIC c_amp_grd_max_diagcp "Maximum AMP_GRD for leak detection function" VALUE 0xa0020878 _REC_S1VAL_20_s2 5434. _CNV_A_R_LINEAR_____94_CM -2717.04145876249 2716.95854123751 FORMAT "%8.2" /end CHARACTERISTIC
/begin CHARACTERISTIC c_amp_grd_min_diagcp "Minimum AMP_GRD for leak detection function" VALUE 0xa002087a _REC_S1VAL_20_s2 5434. _CNV_A_R_LINEAR_____94_CM -2717.04145876249 2716.95854123751 FORMAT "%8.2" /end CHARACTERISTIC
/begin CHARACTERISTIC c_t_amp_grd_sum_max "Time between two AMP measurements" VALUE 0xa002090a _REC_S1VAL_20_u2 65535. _CNV_A_R_LINEAR_____68_CM 0. 65535. FORMAT "%5.0" /end CHARACTERISTIC
/begin CHARACTERISTIC c_t_ast_cor_max_eru "Maximum allowed engine running time" VALUE 0xa002090c _REC_S1VAL_20_s2 65535. _CNV_A_R_LINEAR_____68_CM -32768. 32767. FORMAT "%6.0" /end CHARACTERISTIC
/begin CHARACTERISTIC c_t_ast_evap_rbm "Minimum comulative time since engine start for incrementation of the evaporative system monitor denominator" VALUE 0xa002090e _REC_S1VAL_20_u2 65535. _CNV_A_R_LINEAR_____68_CM 0. 65535. FORMAT "%5.0" /end CHARACTERISTIC
/begin CHARACTERISTIC c_t_ast_ini_diagcp "Time threshold for initialisation after start" VALUE 0xa0020910 _REC_S1VAL_20_u2 6553.5 _CNV_A_R_LINEAR_____58_CM 0. 6553.5 FORMAT "%6.1" /end CHARACTERISTIC
/begin CHARACTERISTIC c_t_inh_amp_grd_diagcp "Inhibit time for leak detection function" VALUE 0xa0020920 _REC_S1VAL_20_u2 65535. _CNV_A_R_LINEAR_____68_CM 0. 65535. FORMAT "%5.0" /end CHARACTERISTIC
/begin CHARACTERISTIC c_t_max_stop_eru "Maximum engine stop time" VALUE 0xa0020922 _REC_S1VAL_20_u2 65535. _CNV_A_R_LINEAR_____95_CM 0. 65535. FORMAT "%5.0" /end CHARACTERISTIC
/begin CHARACTERISTIC c_t_vs_min_ini_diagcp "Maximum time threshold for initialisation" VALUE 0xa002092e _REC_S1VAL_20_u2 65535. _CNV_A_R_LINEAR_____68_CM 0. 65535. FORMAT "%5.0" /end CHARACTERISTIC
/begin CHARACTERISTIC c_tam_max_evap_rbm "Maximum ambient temperature threshold for EVAP_RBM" VALUE 0xa002096d _REC_S1VAL_20_u1 190.5 _CNV_A_R_LINEAR_____41_CM -48. 142.5 FORMAT "%6.2" /end CHARACTERISTIC
/begin CHARACTERISTIC c_tam_min_evap_rbm "Minimum ambient temperature threshold for EVAP_RBM" VALUE 0xa002096e _REC_S1VAL_20_u1 190.5 _CNV_A_R_LINEAR_____41_CM -48. 142.5 FORMAT "%6.2" /end CHARACTERISTIC
/begin CHARACTERISTIC c_tam_st_hys_evap_rbm "Ambient temperature hysteresis for EVAP_RBM" VALUE 0xa002096f _REC_S1VAL_20_u1 190.5 _CNV_A_R_LINEAR_____97_CM 0. 190.5 FORMAT "%6.2" /end CHARACTERISTIC
/begin CHARACTERISTIC c_tco_st_max_evap_rbm "Maximum engine start temperature threshold for EVAP_RBM" VALUE 0xa0020973 _REC_S1VAL_20_u1 190.5 _CNV_A_R_LINEAR_____41_CM -48. 142.5 FORMAT "%6.2" /end CHARACTERISTIC
/begin CHARACTERISTIC c_tco_st_min_evap_rbm "Minimum engine start temperature threshold for EVAP_RBM" VALUE 0xa0020976 _REC_S1VAL_20_u1 190.5 _CNV_A_R_LINEAR_____41_CM -48. 142.5 FORMAT "%6.2" /end CHARACTERISTIC
/begin CHARACTERISTIC c_temp_cor_grd_max_diagcp "Maximal temperature correction gradient" VALUE 0xa0020978 _REC_S1VAL_20_s1 191.25 _CNV_P_3_EVAM_LINEA_I_96_CM -96. 95.25 FORMAT "%6.2" /end CHARACTERISTIC
/begin CHARACTERISTIC c_temp_cor_grd_min_diagcp "Minimal temperature correction gradient" VALUE 0xa0020979 _REC_S1VAL_20_s1 191.25 _CNV_P_3_EVAM_LINEA_I_96_CM -96. 95.25 FORMAT "%6.2" /end CHARACTERISTIC
/begin CHARACTERISTIC c_vs_min_ini_diagcp "VS threshold for initialisation" VALUE 0xa002097e _REC_S1VAL_20_u1 255. _CNV_A_R_LINEAR_____71_CM 0. 255. FORMAT "%3.0" /end CHARACTERISTIC
/begin CHARACTERISTIC lc_state_eol_diagcp "Calibration bit to activate the LV_DIAGCP_REQ_EOL" VALUE 0xa0020986 _REC_S1VAL_20_u1 1. _CNV_A_R_ECME_LINEA_0_CM 0. 1. FORMAT "%1.0" /end CHARACTERISTIC
/begin AXIS_PTS ldp_tco_ip_tam_ofs "" 0xa00207fc tco _REC_A2AXS_20_u1 190.5 _CNV_A_R_LINEAR_____41_CM 6 -48. 142.5 FORMAT "%6.2" /end AXIS_PTS
/begin AXIS_PTS ldp_vs_ip_tam_ofs "" 0xa0020804 vs _REC_A2AXS_20_u1 255. _CNV_A_R_LINEAR_____71_CM 6 0. 255. FORMAT "%3.0" /end AXIS_PTS
/begin CHARACTERISTIC ip_tam_ofs__tco__vs "Temperature offset map between TIA and TAM" MAP 0xa0022b30 _REC_A1MAP_20_u2_u1_u1 190.5 _CNV_A_R_LINEAR_____98_CM -48. 142.5 FORMAT "%5.1"
 /begin AXIS_DESCR COM_AXIS tco _CNV_A_R_LINEAR_____41_CM 6 -48. 142.5 FORMAT "%6.2" AXIS_PTS_REF ldp_tco_ip_tam_ofs /end AXIS_DESCR
 /begin AXIS_DESCR COM_AXIS vs _CNV_A_R_LINEAR_____71_CM 6 0. 255. FORMAT "%3.0" AXIS_PTS_REF ldp_vs_ip_tam_ofs /end AXIS_DESCR
/end CHARACTERISTIC
/begin MEASUREMENT lv_err_tam "Boolean for error currently present which might affect temperature TAM (after debounce)" UBYTE _CNV_S_2_RANGE______3_CM 1 0. 0. 1. ECU_ADDRESS 0xd00062fa BIT_MASK 0x1 /end MEASUREMENT
/begin MEASUREMENT t_tam1 "first timer" UBYTE _CNV_A_R_LINEAR_____68_CM 1 0. 0. 255. ECU_ADDRESS 0xd000762d FORMAT "%3.0" /end MEASUREMENT
/begin MEASUREMENT t_tam2 "second timer" UBYTE _CNV_A_R_LINEAR_____68_CM 1 0. 0. 255. ECU_ADDRESS 0xd000762e FORMAT "%3.0" /end MEASUREMENT
/begin MEASUREMENT tam "ambient air temperature" UBYTE _CNV_A_R_LINEAR_____41_CM 1 0. -48. 142.5 ECU_ADDRESS 0xd00062f8 FORMAT "%6.2" /end MEASUREMENT
/begin MEASUREMENT tam_mdl "ambient air temperature modeled" UBYTE _CNV_A_R_LINEAR_____41_CM 1 0. -48. 142.5 ECU_ADDRESS 0xd000762f FORMAT "%6.2" /end MEASUREMENT
/begin MEASUREMENT tam_st "ambient air temperature at start" UBYTE _CNV_A_R_LINEAR_____41_CM 1 0. -48. 142.5 ECU_ADDRESS 0xd00062f9 FORMAT "%6.2" /end MEASUREMENT
/begin CHARACTERISTIC c_t_tam1 "Time threshold to correct TAM" VALUE 0xa002080b _REC_S1VAL_20_u1 255. _CNV_A_R_LINEAR_____68_CM 0. 255. FORMAT "%3.0" /end CHARACTERISTIC
/begin CHARACTERISTIC c_t_tam2 "Time threshold vehicle speed condition can be violated without reset of timer t_tam1" VALUE 0xa002080c _REC_S1VAL_20_u1 255. _CNV_A_R_LINEAR_____68_CM 0. 255. FORMAT "%3.0" /end CHARACTERISTIC
/begin CHARACTERISTIC c_tam_clc_bol "Lower limit of TAM" VALUE 0xa002080d _REC_S1VAL_20_u1 190.5 _CNV_A_R_LINEAR_____41_CM -48. 142.5 FORMAT "%6.2" /end CHARACTERISTIC
/begin CHARACTERISTIC c_tam_clc_tol "Upper limit of TAM" VALUE 0xa002080e _REC_S1VAL_20_u1 190.5 _CNV_A_R_LINEAR_____41_CM -48. 142.5 FORMAT "%6.2" /end CHARACTERISTIC
/begin CHARACTERISTIC c_vs_tam_min "Min. vehicle speed to calculate TAM" VALUE 0xa002080f _REC_S1VAL_20_u1 255. _CNV_A_R_LINEAR_____71_CM 0. 255. FORMAT "%3.0" /end CHARACTERISTIC
/begin MEASUREMENT Vxx_rich_i_bar_apl "Integral term applied during the BAR." SWORD _CNV_A_R_LINEAR_____99_CM 1 0. -0.333333333238019 0.33332316071198 DISPLAY_IDENTIFIER CbRicCtl_NVM.Vxx_rich_i_bar_apl_NVM ECU_ADDRESS 0xd0003fe0 FORMAT "%8.5" /end MEASUREMENT
/begin MEASUREMENT Vxx_cl_t "" UWORD _CNV_A_R_LINEAR_____58_CM 1 0. 0. 6553.5 DISPLAY_IDENTIFIER CbRicCtl_NVM.Vxx_cl_t_NVM ECU_ADDRESS 0xd0003fe2 FORMAT "%6.1" /end MEASUREMENT
/begin MEASUREMENT Vxx_dly_ocl_dly "Delay before full load application." UWORD _CNV_A_R_LINEAR_____58_CM 1 0. 0. 6553.5 DISPLAY_IDENTIFIER CbRicCtl_NVM.Vxx_dly_ocl_dly_NVM ECU_ADDRESS 0xd0003fe4 FORMAT "%6.1" /end MEASUREMENT
/begin MEASUREMENT Vxx_fl_dsb_dly "" UWORD _CNV_A_R_LINEAR_____58_CM 1 0. 0. 6553.5 DISPLAY_IDENTIFIER CbRicCtl_NVM.Vxx_fl_dsb_dly_NVM ECU_ADDRESS 0xd0003fe6 FORMAT "%6.1" /end MEASUREMENT
/begin MEASUREMENT Vxx_mv_ad_lsm_ctr "Learning  counter to adaptative least square method" UWORD _CNV_A_R_ECME_LINEA_0_CM 1 0. 0. 65535. DISPLAY_IDENTIFIER CbRicCtl_NVM.Vxx_mv_ad_lsm_ctr_NVM ECU_ADDRESS 0xd0003fe8 FORMAT "%5.0" /end MEASUREMENT
/begin MEASUREMENT Vxx_trs_cl_ti_fac_mem "Memory of Vxx_cl_ti_fac value at the last lambda switch." UWORD _CNV_A_R_LINEAR_____100_CM 1 0. 0.6666666 1.33332309414063 DISPLAY_IDENTIFIER CbRicCtl_NVM.Vxx_trs_cl_ti_fac_mem_NVM ECU_ADDRESS 0xd0003fea FORMAT "%8.7" /end MEASUREMENT
/begin MEASUREMENT Vxx_cl_ti_fac_fast_slop_sta "Vxx_cl_ti_fac at the begining of the fast slope." UWORD _CNV_A_R_LINEAR_____100_CM 1 0. 0.6666666 1.33332309414063 DISPLAY_IDENTIFIER CbRicCtl_NVM.Vxx_cl_ti_fac_fast_slop_sta_NVM ECU_ADDRESS 0xd0003fec FORMAT "%8.7" /end MEASUREMENT
/begin MEASUREMENT Vxx_trs_cl_ti_fac_bar_mem "Value of Vxx_cl_ti_fac at the entry of the BAR phase" UWORD _CNV_A_R_LINEAR_____100_CM 1 0. 0.6666666 1.33332309414063 DISPLAY_IDENTIFIER CbRicCtl_NVM.Vxx_trs_cl_ti_fac_bar_mem_NVM ECU_ADDRESS 0xd0003fee FORMAT "%8.7" /end MEASUREMENT
/begin MEASUREMENT Vxx_mv_cl_ti_fac "Mean value of multiplicative factor from richness closed loop." UWORD _CNV_A_R_LINEAR_____100_CM 1 0. 0.6666666 1.33332309414063 DISPLAY_IDENTIFIER CbRicCtl_NVM.Vxx_mv_cl_ti_fac_NVM ECU_ADDRESS 0xd0003ff0 FORMAT "%8.7" /end MEASUREMENT
/begin MEASUREMENT Vxx_spc_slop_ctr "TDC counter used to get in or out of specific slope." UWORD _CNV_A_R_LINEAR_____101_CM 1 0. 0. 65535. DISPLAY_IDENTIFIER CbRicCtl_NVM.Vxx_spc_slop_ctr_NVM ECU_ADDRESS 0xd0003ff2 FORMAT "%5.0" /end MEASUREMENT
/begin MEASUREMENT Vxx_ti_p_cor_fast_slop "Proportional correction to compensate fast slope." UWORD _CNV_A_R_LINEAR_____50_CM 1 0. 0. 0.666656494140625 DISPLAY_IDENTIFIER CbRicCtl_NVM.Vxx_ti_p_cor_fast_slop_NVM ECU_ADDRESS 0xd0003ff4 FORMAT "%8.7" /end MEASUREMENT
/begin MEASUREMENT Vxx_cl_ti_fac "Multiplicative factor from richness closed loop applied on injected fuel mass quantity." UWORD _CNV_A_R_LINEAR_____100_CM 1 0. 0.6666666 1.33332309414063 DISPLAY_IDENTIFIER CbRicCtl_NVM.Vxx_cl_ti_fac_NVM ECU_ADDRESS 0xd0003ff6 FORMAT "%8.7" /end MEASUREMENT
/begin MEASUREMENT Vxx_mv_ti_ad_ofs "Mean adaptation offset on injection time" SBYTE _CNV_A_R_LINEAR_____102_CM 1 0. -512. 508. DISPLAY_IDENTIFIER CbRicCtl_NVM.Vxx_mv_ti_ad_ofs_NVM ECU_ADDRESS 0xd0003ff8 FORMAT "%4.0" /end MEASUREMENT
/begin MEASUREMENT Vxx_mv_ti_ad_fac "Mean adaptation factor on injection time" UBYTE _CNV_A_R_LINEAR_____103_CM 1 0. 0.6666667 1.3307292 DISPLAY_IDENTIFIER CbRicCtl_NVM.Vxx_mv_ti_ad_fac_NVM ECU_ADDRESS 0xd0003ff9 FORMAT "%5.3" /end MEASUREMENT
/begin MEASUREMENT Vtd_max_ti_b[0] "Maximum gap compared to the initial  linear" UBYTE _CNV_A_R_ECME_LINEA_0_CM 1 0. 0. 255. DISPLAY_IDENTIFIER CbRicCtl_NVM.Vtd_max_ti_b_NVM[0] ECU_ADDRESS 0xd0003ffa FORMAT "%3.0" /end MEASUREMENT
/begin MEASUREMENT Vtd_max_ti_b[1] "Maximum gap compared to the initial  linear" UBYTE _CNV_A_R_ECME_LINEA_0_CM 1 0. 0. 255. DISPLAY_IDENTIFIER CbRicCtl_NVM.Vtd_max_ti_b_NVM[1] ECU_ADDRESS 0xd0003ffb FORMAT "%3.0" /end MEASUREMENT
/begin MEASUREMENT Vtd_max_ti_b[2] "Maximum gap compared to the initial  linear" UBYTE _CNV_A_R_ECME_LINEA_0_CM 1 0. 0. 255. DISPLAY_IDENTIFIER CbRicCtl_NVM.Vtd_max_ti_b_NVM[2] ECU_ADDRESS 0xd0003ffc FORMAT "%3.0" /end MEASUREMENT
/begin MEASUREMENT Vtd_max_ti_b[3] "Maximum gap compared to the initial  linear" UBYTE _CNV_A_R_ECME_LINEA_0_CM 1 0. 0. 255. DISPLAY_IDENTIFIER CbRicCtl_NVM.Vtd_max_ti_b_NVM[3] ECU_ADDRESS 0xd0003ffd FORMAT "%3.0" /end MEASUREMENT
/begin MEASUREMENT Vtd_max_ti_b[4] "Maximum gap compared to the initial  linear" UBYTE _CNV_A_R_ECME_LINEA_0_CM 1 0. 0. 255. DISPLAY_IDENTIFIER CbRicCtl_NVM.Vtd_max_ti_b_NVM[4] ECU_ADDRESS 0xd0003ffe FORMAT "%3.0" /end MEASUREMENT
/begin MEASUREMENT Vtd_min_ti_b[0] "Minimum gap compared to the initial  linear" UBYTE _CNV_A_R_ECME_LINEA_0_CM 1 0. 0. 255. DISPLAY_IDENTIFIER CbRicCtl_NVM.Vtd_min_ti_b_NVM[0] ECU_ADDRESS 0xd0004000 FORMAT "%3.0" /end MEASUREMENT
/begin MEASUREMENT Vtd_min_ti_b[1] "Minimum gap compared to the initial  linear" UBYTE _CNV_A_R_ECME_LINEA_0_CM 1 0. 0. 255. DISPLAY_IDENTIFIER CbRicCtl_NVM.Vtd_min_ti_b_NVM[1] ECU_ADDRESS 0xd0004001 FORMAT "%3.0" /end MEASUREMENT
/begin MEASUREMENT Vtd_min_ti_b[2] "Minimum gap compared to the initial  linear" UBYTE _CNV_A_R_ECME_LINEA_0_CM 1 0. 0. 255. DISPLAY_IDENTIFIER CbRicCtl_NVM.Vtd_min_ti_b_NVM[2] ECU_ADDRESS 0xd0004002 FORMAT "%3.0" /end MEASUREMENT
/begin MEASUREMENT Vtd_min_ti_b[3] "Minimum gap compared to the initial  linear" UBYTE _CNV_A_R_ECME_LINEA_0_CM 1 0. 0. 255. DISPLAY_IDENTIFIER CbRicCtl_NVM.Vtd_min_ti_b_NVM[3] ECU_ADDRESS 0xd0004003 FORMAT "%3.0" /end MEASUREMENT
/begin MEASUREMENT Vtd_min_ti_b[4] "Minimum gap compared to the initial  linear" UBYTE _CNV_A_R_ECME_LINEA_0_CM 1 0. 0. 255. DISPLAY_IDENTIFIER CbRicCtl_NVM.Vtd_min_ti_b_NVM[4] ECU_ADDRESS 0xd0004004 FORMAT "%3.0" /end MEASUREMENT
/begin MEASUREMENT Vxx_ol_ti_fac "" UBYTE _CNV_A_R_LINEAR_____104_CM 1 0. 0.6666666 1.9947916 DISPLAY_IDENTIFIER CbRicCtl_NVM.Vxx_ol_ti_fac_NVM ECU_ADDRESS 0xd0004005 FORMAT "%8.6" /end MEASUREMENT
/begin MEASUREMENT Vxx_bfr_cl_ctr "" UBYTE _CNV_A_R_LINEAR_____101_CM 1 0. 0. 255. DISPLAY_IDENTIFIER CbRicCtl_NVM.Vxx_bfr_cl_ctr_NVM ECU_ADDRESS 0xd0004006 FORMAT "%3.0" /end MEASUREMENT
/begin MEASUREMENT Vsx_rich_stt "Phase of the richness state machine." UBYTE _CNV_A_R_A_105_CM 1 0. 0. 255. DISPLAY_IDENTIFIER CbRicCtl_NVM.Vsx_rich_stt_NVM ECU_ADDRESS 0xd0004007 /end MEASUREMENT
/begin MEASUREMENT Vxx_appl_ti_ofs_ctr "TDC counter to apply offset." UBYTE _CNV_A_R_LINEAR_____101_CM 1 0. 0. 255. DISPLAY_IDENTIFIER CbRicCtl_NVM.Vxx_appl_ti_ofs_ctr_NVM ECU_ADDRESS 0xd0004008 FORMAT "%3.0" /end MEASUREMENT
/begin MEASUREMENT Vxx_last_ti_p_cor "Last proportional correction without fast slope. unsigned." UBYTE _CNV_A_R_LINEAR_____106_CM 1 0. 0. 0.6640625 DISPLAY_IDENTIFIER CbRicCtl_NVM.Vxx_last_ti_p_cor_NVM ECU_ADDRESS 0xd0004009 FORMAT "%8.6" /end MEASUREMENT
/begin MEASUREMENT Vxx_lamb_swi_ctr "Countdown of lambda switch used for filter time constant after loop closing and fats slope." UBYTE _CNV_A_R_ECME_LINEA_0_CM 1 0. 0. 255. DISPLAY_IDENTIFIER CbRicCtl_NVM.Vxx_lamb_swi_ctr_NVM ECU_ADDRESS 0xd000400a FORMAT "%3.0" /end MEASUREMENT
/begin MEASUREMENT Vxx_cl_lean_ctr "Glitch counter" UBYTE _CNV_A_R_LINEAR_____32_CM 1 0. 0. 2.55 DISPLAY_IDENTIFIER CbRicCtl_NVM.Vxx_cl_lean_ctr_NVM ECU_ADDRESS 0xd000400b FORMAT "%4.2" /end MEASUREMENT
/begin MEASUREMENT Vbx_ti_ad4_zon "4 of the 5 zones engine learned" UBYTE _CNV_S_2_RANGE______3_CM 1 0. 0. 1. DISPLAY_IDENTIFIER CbRicCtl_NVM.Vbx_ti_ad4_zon_NVM ECU_ADDRESS 0xd000400c BIT_MASK 0x1 /end MEASUREMENT
/begin MEASUREMENT Vtd_ti_ad1_zon[0] "Boolean information \"at least one learning in the zone\"" UBYTE _CNV_S_2_RANGE______3_CM 1 0. 0. 1. DISPLAY_IDENTIFIER CbRicCtl_NVM.Vtd_ti_ad1_zon_NVM[0] ECU_ADDRESS 0xd000400e /end MEASUREMENT
/begin MEASUREMENT Vtd_ti_ad1_zon[1] "Boolean information \"at least one learning in the zone\"" UBYTE _CNV_S_2_RANGE______3_CM 1 0. 0. 1. DISPLAY_IDENTIFIER CbRicCtl_NVM.Vtd_ti_ad1_zon_NVM[1] ECU_ADDRESS 0xd000400f /end MEASUREMENT
/begin MEASUREMENT Vtd_ti_ad1_zon[2] "Boolean information \"at least one learning in the zone\"" UBYTE _CNV_S_2_RANGE______3_CM 1 0. 0. 1. DISPLAY_IDENTIFIER CbRicCtl_NVM.Vtd_ti_ad1_zon_NVM[2] ECU_ADDRESS 0xd0004010 /end MEASUREMENT
/begin MEASUREMENT Vtd_ti_ad1_zon[3] "Boolean information \"at least one learning in the zone\"" UBYTE _CNV_S_2_RANGE______3_CM 1 0. 0. 1. DISPLAY_IDENTIFIER CbRicCtl_NVM.Vtd_ti_ad1_zon_NVM[3] ECU_ADDRESS 0xd0004011 /end MEASUREMENT
/begin MEASUREMENT Vtd_ti_ad1_zon[4] "Boolean information \"at least one learning in the zone\"" UBYTE _CNV_S_2_RANGE______3_CM 1 0. 0. 1. DISPLAY_IDENTIFIER CbRicCtl_NVM.Vtd_ti_ad1_zon_NVM[4] ECU_ADDRESS 0xd0004012 /end MEASUREMENT
/begin CHARACTERISTIC Cmp_eal_n_lamb_v "Map of command voltage of the loop down (fonction of engine air load and engine speed)" MAP 0xa0028e14 _REC_A1MAP_20_u2_u2_u2 25000. _CNV_A_R_LINEAR_____107_CM 0. 25000. FORMAT "%5.0"
 /begin AXIS_DESCR COM_AXIS Vxx_eal _CNV_A_R_LINEAR_____53_CM 16 0. 3.99993896484375 FORMAT "%10.8" AXIS_PTS_REF Ctb_eal /end AXIS_DESCR
 /begin AXIS_DESCR COM_AXIS Vxx_n _CNV_A_R_ENSD_LINEA_22_CM 9 0. 16383.75 FORMAT "%8.2" AXIS_PTS_REF Ctb_n2 /end AXIS_DESCR
/end CHARACTERISTIC
/begin CHARACTERISTIC Ctp_tco_cl2_ena_ctr "Table of the necessary tdc number to warm up the catalyst" CURVE 0xa0028f34 _REC_A1CUR_20_u2_u2 65535. _CNV_A_R_ECME_LINEA_0_CM 0. 65535. FORMAT "%5.0"
 /begin AXIS_DESCR COM_AXIS Vxx_tco _CNV_A_R_LINEAR_____110_CM 9 -40. 200. FORMAT "%5.1" AXIS_PTS_REF Ctb_tco2 /end AXIS_DESCR
/end CHARACTERISTIC
/begin MEASUREMENT Vbx_ofs2_ena "The calculation conditions of mean offset double loop are satisfied (=1)." UBYTE _CNV_S_2_RANGE______3_CM 1 0. 0. 1. ECU_ADDRESS 0xd00077dc BIT_MASK 0x1 /end MEASUREMENT
/begin MEASUREMENT Vbx_ti_cl2_act "Double loop activated" UBYTE _CNV_S_2_RANGE______3_CM 1 0. 0. 1. ECU_ADDRESS 0xd00077dd BIT_MASK 0x1 /end MEASUREMENT
/begin MEASUREMENT Vxx_cl2_act_ctr "Activation time of the double loop." UWORD _CNV_A_R_LINEAR_____58_CM 1 0. 0. 6553.5 ECU_ADDRESS 0xd000511a FORMAT "%6.1" /end MEASUREMENT
/begin MEASUREMENT Vxx_cl2_ena_ctr "TDC counter before the activation of the double loop" UWORD _CNV_A_R_LINEAR_____101_CM 1 0. 0. 65535. ECU_ADDRESS 0xd0004014 FORMAT "%5.0" /end MEASUREMENT
/begin MEASUREMENT Vxx_dbl_lbdw_v_fil "Lambda down voltage filtered for the double loop" UWORD _CNV_A_R_LINEAR_____107_CM 1 0. 0. 25000. ECU_ADDRESS 0xd000511c FORMAT "%5.0" /end MEASUREMENT
/begin MEASUREMENT Vxx_lbdw_v_sp "Command voltage of the down double loop" UWORD _CNV_A_R_LINEAR_____107_CM 1 0. 0. 25000. ECU_ADDRESS 0xd000511e FORMAT "%5.0" /end MEASUREMENT
/begin MEASUREMENT Vxx_mv_ti_ofs2_cor "Mean offset of the double loop." SWORD _CNV_A_R_LINEAR_____99_CM 1 0. -0.333333333238019 0.33332316071198 ECU_ADDRESS 0xd0005120 FORMAT "%8.5" /end MEASUREMENT
/begin MEASUREMENT Vxx_ti_i2_cor "Integral term of the double loop regulator." SWORD _CNV_A_R_LINEAR_____99_CM 1 0. -0.333333333238019 0.33332316071198 ECU_ADDRESS 0xd0005122 FORMAT "%8.5" /end MEASUREMENT
/begin MEASUREMENT Vxx_ti_ofs2_cor "Double loop offset." SWORD _CNV_A_R_LINEAR_____99_CM 1 0. -0.333333333238019 0.33332316071198 ECU_ADDRESS 0xd0005124 FORMAT "%8.5" /end MEASUREMENT
/begin MEASUREMENT Vxx_ti_p2_cor "Proportional term of the double loop regulator" SWORD _CNV_A_R_LINEAR_____99_CM 1 0. -0.333333333238019 0.33332316071198 ECU_ADDRESS 0xd0005126 FORMAT "%8.5" /end MEASUREMENT
/begin CHARACTERISTIC Cbx_ti_cl2_cfm "Soft configuration with double loop" VALUE 0xa0020e9e _REC_S1VAL_20_u1 1. _CNV_A_R_ECME_LINEA_0_CM 0. 1. FORMAT "%1.0" BIT_MASK 0x1 /end CHARACTERISTIC
/begin CHARACTERISTIC Cxx_cl2_act_ctr "Conditions time of the activated double loop." VALUE 0xa0020e7c _REC_S1VAL_20_u2 6553.5 _CNV_A_R_LINEAR_____58_CM 0. 6553.5 FORMAT "%6.1" /end CHARACTERISTIC
/begin CHARACTERISTIC Cxx_cl2_asd_map_thd "Minimum manifold pressure to satisfy the double loop conditions in After-Sales Department" VALUE 0xa0020e7e _REC_S1VAL_20_u2 20000. _CNV_A_R_LINEAR_____115_CM 0. 20000. FORMAT "%5.0" /end CHARACTERISTIC
/begin CHARACTERISTIC Cxx_cl2_map_thd "Minimum manifold pressure to start the double loop" VALUE 0xa0020e80 _REC_S1VAL_20_u2 20000. _CNV_A_R_LINEAR_____115_CM 0. 20000. FORMAT "%5.0" /end CHARACTERISTIC
/begin CHARACTERISTIC Cxx_cl2_n_thd "Minimum engine speed to start the double loop" VALUE 0xa0020e9f _REC_S1VAL_20_u1 8160. _CNV_A_R_LINEAR_____2_CM 0. 8160. FORMAT "%4.0" /end CHARACTERISTIC
/begin CHARACTERISTIC Cxx_diag_fil_ti_ofs2_fac2 "Filter factor of the mean offset double loop in condition of the diagnostic" VALUE 0xa0020ea0 _REC_S1VAL_20_u1 0.99609375 _CNV_A_R_LINEAR_____29_CM 0. 0.99609375 FORMAT "%5.3" /end CHARACTERISTIC
/begin CHARACTERISTIC Cxx_dyn_prs_fil_ofs2 "Max manifold pressure stability in order to filter the offset double loop." VALUE 0xa0020e82 _REC_S1VAL_20_u2 20000. _CNV_A_R_LINEAR_____115_CM 0. 20000. FORMAT "%5.0" /end CHARACTERISTIC
/begin CHARACTERISTIC Cxx_fil_ti_ofs2_fac "Filter factor of the mean offset double loop out of the diagnostic conditions." VALUE 0xa0020ea1 _REC_S1VAL_20_u1 0.99609375 _CNV_A_R_LINEAR_____29_CM 0. 0.99609375 FORMAT "%5.3" /end CHARACTERISTIC
/begin CHARACTERISTIC Cxx_lbdw_fil_fac "Calibration of time constant for the first order filter" VALUE 0xa0020e84 _REC_S1VAL_20_u2 65.535 _CNV_A_R_LINEAR_____116_CM 0. 65.535 FORMAT "%5.3" /end CHARACTERISTIC
/begin CHARACTERISTIC Cxx_max_diag_ti_ofs1 "High limit of Vxx_ti_ofs2_cor (Offset Double Loop) in \"Measures\" state of the lambda diagnostic (PHDGSO2=30)" VALUE 0xa0020e86 _REC_S1VAL_20_s2 0.666656493949999 _CNV_A_R_LINEAR_____99_CM -0.333333333238019 0.33332316071198 FORMAT "%8.5" /end CHARACTERISTIC
/begin CHARACTERISTIC Cxx_max_is_ti_ofs2 "High limit of Vxx_ti_ofs2_cor (Offset Double Loop) in \"Measures\" state of the lambda diagnostic (PHDGSO2=30)" VALUE 0xa0020e88 _REC_S1VAL_20_s2 0.666656493949999 _CNV_A_R_LINEAR_____99_CM -0.333333333238019 0.33332316071198 FORMAT "%8.5" /end CHARACTERISTIC
/begin CHARACTERISTIC Cxx_max_n_fil_ofs2 "High limit of Vxx_ti_ofs2_cor (Offset Double Loop) in idle speed" VALUE 0xa0020e8a _REC_S1VAL_20_u2 16383.75 _CNV_A_R_ENSD_LINEA_22_CM 0. 16383.75 FORMAT "%8.2" /end CHARACTERISTIC
/begin CHARACTERISTIC Cxx_max_prs_fil_ofs2 "Maximum predicted pressure for the offset double loop filter." VALUE 0xa0020e8c _REC_S1VAL_20_u2 20000. _CNV_A_R_LINEAR_____115_CM 0. 20000. FORMAT "%5.0" /end CHARACTERISTIC
/begin CHARACTERISTIC Cxx_max_tco_fil_ofs2 "Maximum coolant temperature for the offset double loop filter." VALUE 0xa0020e8e _REC_S1VAL_20_u2 240. _CNV_A_R_LINEAR_____110_CM -40. 200. FORMAT "%5.1" /end CHARACTERISTIC
/begin CHARACTERISTIC Cxx_max_ti_ofs1 "High limit of the offset double loop (Vxx_ti_ofs2_cor)" VALUE 0xa0020e90 _REC_S1VAL_20_s2 0.666656493949999 _CNV_A_R_LINEAR_____99_CM -0.333333333238019 0.33332316071198 FORMAT "%8.5" /end CHARACTERISTIC
/begin CHARACTERISTIC Cxx_min_diag_ti_ofs2 "Low limit of the offset double loop (Vxx_ti_ofs2_cor) in \"Measures\" state of the lambda diagnostic (PHDGSO2=30)" VALUE 0xa0020e92 _REC_S1VAL_20_s2 0.666656493949999 _CNV_A_R_LINEAR_____99_CM -0.333333333238019 0.33332316071198 FORMAT "%8.5" /end CHARACTERISTIC
/begin CHARACTERISTIC Cxx_min_is_ti_ofs2 "Low limit of the offset double loop (Vxx_ti_ofs2_cor) in \"Measures\" state of the lambda diagnostic (PHDGSO2=30)" VALUE 0xa0020e94 _REC_S1VAL_20_s2 0.666656493949999 _CNV_A_R_LINEAR_____99_CM -0.333333333238019 0.33332316071198 FORMAT "%8.5" /end CHARACTERISTIC
/begin CHARACTERISTIC Cxx_min_n_fil_ofs2 "Low limit of the offset double loop (Vxx_ti_ofs2_cor) in idle speed" VALUE 0xa0020e96 _REC_S1VAL_20_u2 16383.75 _CNV_A_R_ENSD_LINEA_22_CM 0. 16383.75 FORMAT "%8.2" /end CHARACTERISTIC
/begin CHARACTERISTIC Cxx_min_prs_fil_ofs2 "Minmum predicted pressure for the offset double loop filter." VALUE 0xa0020e98 _REC_S1VAL_20_u2 20000. _CNV_A_R_LINEAR_____115_CM 0. 20000. FORMAT "%5.0" /end CHARACTERISTIC
/begin CHARACTERISTIC Cxx_min_tco_fil_ofs2 "Minimum coolant temperature for the offset double loop filter." VALUE 0xa0020e9a _REC_S1VAL_20_u2 240. _CNV_A_R_LINEAR_____110_CM -40. 200. FORMAT "%5.1" /end CHARACTERISTIC
/begin CHARACTERISTIC Cxx_min_ti_ofs2 "Low limit of the offset double loop (Vxx_ti_ofs2_cor)" VALUE 0xa0020e9c _REC_S1VAL_20_s2 0.666656493949999 _CNV_A_R_LINEAR_____99_CM -0.333333333238019 0.33332316071198 FORMAT "%8.5" /end CHARACTERISTIC
/begin CHARACTERISTIC Cxx_ti_i2_cor_fac "Gain intÃ©gral du correcteur double boucle" VALUE 0xa0020ea2 _REC_S1VAL_20_u1 9.960937500000001e-007 _CNV_A_R_LINEAR_____117_CM 0. 9.960937500000001e-007 FORMAT "%11.9" /end CHARACTERISTIC
/begin CHARACTERISTIC Cxx_ti_p2_cor_fac "Gain proportionnel du correcteur double boucle." VALUE 0xa0020ea3 _REC_S1VAL_20_u1 2.98828125e-004 _CNV_A_R_LINEAR_____118_CM 0. 2.98828125e-004 FORMAT "%8.6" /end CHARACTERISTIC
/begin AXIS_PTS Ctb_eal2 "9 breakpoint table for Engine air load" 0xa0028f60 Vxx_eal _REC_A2AXS_20_u2 3.99993896484375 _CNV_A_R_LINEAR_____53_CM 9 0. 3.99993896484375 FORMAT "%10.8" /end AXIS_PTS
/begin CHARACTERISTIC Cmp_n_eal_ti_ofs1 "Map of offset to be applied on richness closed loop. Vehicule stopped." MAP 0xa0028f74 _REC_A1MAP_20_u2_u2_u2 0.666656493949999 _CNV_A_R_LINEAR_____108_CM -0.333333333238019 0.33332316071198 FORMAT "%8.5"
 /begin AXIS_DESCR COM_AXIS Vxx_eal _CNV_A_R_LINEAR_____53_CM 16 0. 3.99993896484375 FORMAT "%10.8" AXIS_PTS_REF Ctb_eal /end AXIS_DESCR
 /begin AXIS_DESCR COM_AXIS Vxx_n _CNV_A_R_ENSD_LINEA_22_CM 9 0. 16383.75 FORMAT "%8.2" AXIS_PTS_REF Ctb_n2 /end AXIS_DESCR
/end CHARACTERISTIC
/begin CHARACTERISTIC Cmp_n_eal_ti_ofs2 "Map of offset to be applied on richness closed loop. Vehicule running." MAP 0xa0029094 _REC_A1MAP_20_u2_u2_u2 0.666656493949999 _CNV_A_R_LINEAR_____108_CM -0.333333333238019 0.33332316071198 FORMAT "%8.5"
 /begin AXIS_DESCR COM_AXIS Vxx_eal _CNV_A_R_LINEAR_____53_CM 16 0. 3.99993896484375 FORMAT "%10.8" AXIS_PTS_REF Ctb_eal /end AXIS_DESCR
 /begin AXIS_DESCR COM_AXIS Vxx_n _CNV_A_R_ENSD_LINEA_22_CM 9 0. 16383.75 FORMAT "%8.2" AXIS_PTS_REF Ctb_n2 /end AXIS_DESCR
/end CHARACTERISTIC
/begin CHARACTERISTIC Cmp_n_eal_ti_p_cor "Proportional term for Vxx_cl_ti_fac _fct(n,eal)" MAP 0xa00291b4 _REC_A1MAP_20_u1_u2_u2 0.33203125 _CNV_A_R_LINEAR_____109_CM 0. 0.33203125 FORMAT "%8.6"
 /begin AXIS_DESCR COM_AXIS Vxx_n _CNV_A_R_ENSD_LINEA_22_CM 9 0. 16383.75 FORMAT "%8.2" AXIS_PTS_REF Ctb_n2 /end AXIS_DESCR
 /begin AXIS_DESCR COM_AXIS Vxx_eal _CNV_A_R_LINEAR_____53_CM 9 0. 3.99993896484375 FORMAT "%10.8" AXIS_PTS_REF Ctb_eal2 /end AXIS_DESCR
/end CHARACTERISTIC
/begin CHARACTERISTIC Ctp_acel_n_ti_p_cor "Specific slope proportional when accelerating" CURVE 0xa0029208 _REC_A1CUR_20_u1_u2 0.33203125 _CNV_A_R_LINEAR_____109_CM 0. 0.33203125 FORMAT "%8.6"
 /begin AXIS_DESCR COM_AXIS Vxx_n _CNV_A_R_ENSD_LINEA_22_CM 9 0. 16383.75 FORMAT "%8.2" AXIS_PTS_REF Ctb_n2 /end AXIS_DESCR
/end CHARACTERISTIC
/begin CHARACTERISTIC Ctp_cl_lean_sta "Table giving number of TDC to get in lean settings depending on coolant temp at start." CURVE 0xa0029214 _REC_A1CUR_20_u2_u2 65535. _CNV_A_R_LINEAR_____101_CM 0. 65535. FORMAT "%5.0"
 /begin AXIS_DESCR COM_AXIS Vxx_tco _CNV_A_R_LINEAR_____110_CM 9 -40. 200. FORMAT "%5.1" AXIS_PTS_REF Ctb_tco2 /end AXIS_DESCR
/end CHARACTERISTIC
/begin CHARACTERISTIC Ctp_cl_lean_stop "Table giving number of TDC to get out of lean settings depending on coolant temp at start." CURVE 0xa0029228 _REC_A1CUR_20_u2_u2 65535. _CNV_A_R_LINEAR_____101_CM 0. 65535. FORMAT "%5.0"
 /begin AXIS_DESCR COM_AXIS Vxx_tco _CNV_A_R_LINEAR_____110_CM 9 -40. 200. FORMAT "%5.1" AXIS_PTS_REF Ctb_tco2 /end AXIS_DESCR
/end CHARACTERISTIC
/begin CHARACTERISTIC Ctp_decl_n_ti_p_cor "Specific slope proportional when decelerating" CURVE 0xa002923c _REC_A1CUR_20_u1_u2 0.33203125 _CNV_A_R_LINEAR_____109_CM 0. 0.33203125 FORMAT "%8.6"
 /begin AXIS_DESCR COM_AXIS Vxx_n _CNV_A_R_ENSD_LINEA_22_CM 9 0. 16383.75 FORMAT "%8.2" AXIS_PTS_REF Ctb_n2 /end AXIS_DESCR
/end CHARACTERISTIC
/begin CHARACTERISTIC Ctp_eal_l_ti_i_cor "Corrective factor depending on engine air load for integral term." CURVE 0xa0029248 _REC_A1CUR_20_u1_u2 1.9921875 _CNV_A_R_LINEAR_____42_CM 0. 1.9921875 FORMAT "%8.6"
 /begin AXIS_DESCR COM_AXIS Vxx_eal _CNV_A_R_LINEAR_____53_CM 16 0. 3.99993896484375 FORMAT "%10.8" AXIS_PTS_REF Ctb_eal /end AXIS_DESCR
/end CHARACTERISTIC
/begin CHARACTERISTIC Ctp_eal_l_ti_i_cor_lean "Corrective factor depending on engine air load for integral term. in lean settings" CURVE 0xa0029258 _REC_A1CUR_20_u1_u2 1.9921875 _CNV_A_R_LINEAR_____42_CM 0. 1.9921875 FORMAT "%8.6"
 /begin AXIS_DESCR COM_AXIS Vxx_eal _CNV_A_R_LINEAR_____53_CM 16 0. 3.99993896484375 FORMAT "%10.8" AXIS_PTS_REF Ctb_eal /end AXIS_DESCR
/end CHARACTERISTIC
/begin CHARACTERISTIC Ctp_eal_ti_bar_add_p "Big proportional setting for cut offs when BAR was not activated at the next torque request" CURVE 0xa0029268 _REC_A1CUR_20_u1_u2 0.6640625 _CNV_A_R_LINEAR_____106_CM 0. 0.6640625 FORMAT "%8.6"
 /begin AXIS_DESCR COM_AXIS Vxx_eal _CNV_A_R_LINEAR_____53_CM 9 0. 3.99993896484375 FORMAT "%10.8" AXIS_PTS_REF Ctb_eal2 /end AXIS_DESCR
/end CHARACTERISTIC
/begin CHARACTERISTIC Ctp_eal_ti_bar_add_p_eal_disa "Big proportional term when BAR is canceled due to high engine load" CURVE 0xa0029274 _REC_A1CUR_20_u1_u2 0.6640625 _CNV_A_R_LINEAR_____106_CM 0. 0.6640625 FORMAT "%8.6"
 /begin AXIS_DESCR COM_AXIS Vxx_eal _CNV_A_R_LINEAR_____53_CM 9 0. 3.99993896484375 FORMAT "%10.8" AXIS_PTS_REF Ctb_eal2 /end AXIS_DESCR
/end CHARACTERISTIC
/begin CHARACTERISTIC Ctp_eal_ti_bar_lbdw_lean_in "Voltage threshold to enter in lean BAR mode." CURVE 0xa0029280 _REC_A1CUR_20_u2_u2 25000. _CNV_A_R_LINEAR_____107_CM 0. 25000. FORMAT "%5.0"
 /begin AXIS_DESCR COM_AXIS Vxx_eal _CNV_A_R_LINEAR_____53_CM 9 0. 3.99993896484375 FORMAT "%10.8" AXIS_PTS_REF Ctb_eal2 /end AXIS_DESCR
/end CHARACTERISTIC
/begin CHARACTERISTIC Ctp_eal_ti_bar_lbdw_lean_out "Voltage threshold to exit lean BAR mode." CURVE 0xa0029294 _REC_A1CUR_20_u2_u2 25000. _CNV_A_R_LINEAR_____107_CM 0. 25000. FORMAT "%5.0"
 /begin AXIS_DESCR COM_AXIS Vxx_eal _CNV_A_R_LINEAR_____53_CM 9 0. 3.99993896484375 FORMAT "%10.8" AXIS_PTS_REF Ctb_eal2 /end AXIS_DESCR
/end CHARACTERISTIC
/begin CHARACTERISTIC Ctp_eal_ti_bar_max "Maximum enrichment during BAR mode depending on engine load" CURVE 0xa00292a8 _REC_A1CUR_20_u2_u2 0.666656494140625 _CNV_A_R_LINEAR_____50_CM 0. 0.666656494140625 FORMAT "%8.7"
 /begin AXIS_DESCR COM_AXIS Vxx_eal _CNV_A_R_LINEAR_____53_CM 9 0. 3.99993896484375 FORMAT "%10.8" AXIS_PTS_REF Ctb_eal2 /end AXIS_DESCR
/end CHARACTERISTIC
/begin CHARACTERISTIC Ctp_eal_ti_bar_min "Maximum enleanment during BAR mode depending on engine load" CURVE 0xa00292bc _REC_A1CUR_20_u2_u2 0.666656 _CNV_A_R_LINEAR_____119_CM -0.666656 0. FORMAT "%10.7"
 /begin AXIS_DESCR COM_AXIS Vxx_eal _CNV_A_R_LINEAR_____53_CM 9 0. 3.99993896484375 FORMAT "%10.8" AXIS_PTS_REF Ctb_eal2 /end AXIS_DESCR
/end CHARACTERISTIC
/begin CHARACTERISTIC Ctp_n_l_ti_i "Table of Integral factor to be applied on Vxx_cl_ti_fac in normal conditions." CURVE 0xa00292d0 _REC_A1CUR_20_u1_u2 2.593994140625e-003 _CNV_A_R_LINEAR_____50_CM 0. 2.593994140625e-003 FORMAT "%10.8"
 /begin AXIS_DESCR COM_AXIS Vxx_n _CNV_A_R_ENSD_LINEA_22_CM 9 0. 16383.75 FORMAT "%8.2" AXIS_PTS_REF Ctb_n2 /end AXIS_DESCR
/end CHARACTERISTIC
/begin CHARACTERISTIC Ctp_n_l_ti_i_lean "Table of Integral factor to be applied on Vxx_cl_ti_fac in lean conditions." CURVE 0xa00292dc _REC_A1CUR_20_u1_u2 2.593994140625e-003 _CNV_A_R_LINEAR_____50_CM 0. 2.593994140625e-003 FORMAT "%10.8"
 /begin AXIS_DESCR COM_AXIS Vxx_n _CNV_A_R_ENSD_LINEA_22_CM 9 0. 16383.75 FORMAT "%8.2" AXIS_PTS_REF Ctb_n2 /end AXIS_DESCR
/end CHARACTERISTIC
/begin CHARACTERISTIC Ctp_n_ti_p_cor_lean1 "Proportional term depending on engine speed in lean settings towards lean." CURVE 0xa00292e8 _REC_A1CUR_20_u1_u2 0.33203125 _CNV_A_R_LINEAR_____109_CM 0. 0.33203125 FORMAT "%8.6"
 /begin AXIS_DESCR COM_AXIS Vxx_n _CNV_A_R_ENSD_LINEA_22_CM 9 0. 16383.75 FORMAT "%8.2" AXIS_PTS_REF Ctb_n2 /end AXIS_DESCR
/end CHARACTERISTIC
/begin CHARACTERISTIC Ctp_n_ti_p_cor_lean2 "Proportional term depending on engine speed in lean settings toward rich." CURVE 0xa00292f4 _REC_A1CUR_20_u1_u2 0.33203125 _CNV_A_R_LINEAR_____109_CM 0. 0.33203125 FORMAT "%8.6"
 /begin AXIS_DESCR COM_AXIS Vxx_n _CNV_A_R_ENSD_LINEA_22_CM 9 0. 16383.75 FORMAT "%8.2" AXIS_PTS_REF Ctb_n2 /end AXIS_DESCR
/end CHARACTERISTIC
/begin CHARACTERISTIC Ctp_spc_slop_in "Table giving number of TDC to get in specific slope mode depending on coolant temp at start." CURVE 0xa0029300 _REC_A1CUR_20_u2_u2 65535. _CNV_A_R_LINEAR_____101_CM 0. 65535. FORMAT "%5.0"
 /begin AXIS_DESCR COM_AXIS Vxx_tco _CNV_A_R_LINEAR_____110_CM 9 -40. 200. FORMAT "%5.1" AXIS_PTS_REF Ctb_tco2 /end AXIS_DESCR
/end CHARACTERISTIC
/begin CHARACTERISTIC Ctp_spc_slop_out "Table giving number of TDC to get out of specific slope mode depending on coolant temp at start." CURVE 0xa0029314 _REC_A1CUR_20_u2_u2 65535. _CNV_A_R_LINEAR_____101_CM 0. 65535. FORMAT "%5.0"
 /begin AXIS_DESCR COM_AXIS Vxx_tco _CNV_A_R_LINEAR_____110_CM 9 -40. 200. FORMAT "%5.1" AXIS_PTS_REF Ctb_tco2 /end AXIS_DESCR
/end CHARACTERISTIC
/begin MEASUREMENT Vbx_cl_lean_cdn "Richness closed loop lean settings conditions." UBYTE _CNV_S_2_RANGE______3_CM 1 0. 0. 1. ECU_ADDRESS 0xd0006776 BIT_MASK 0x1 /end MEASUREMENT
/begin MEASUREMENT Vbx_evap_dgn_cl_ti_fac_ok "Richness closed loop reset achievement at EVAM diagnosis ending" UBYTE _CNV_S_2_RANGE______3_CM 1 0. 0. 1. ECU_ADDRESS 0xd0006777 BIT_MASK 0x1 /end MEASUREMENT
/begin MEASUREMENT Vbx_spc_slop "Boolean indicating that the richness fast slope is activated." UBYTE _CNV_S_2_RANGE______3_CM 1 0. 0. 1. ECU_ADDRESS 0xd0006778 BIT_MASK 0x1 /end MEASUREMENT
/begin MEASUREMENT Vbx_ti_bar_add_p_no_bar "Indicates if BAR was not activated during the calibrated time after no torque request" UBYTE _CNV_S_2_RANGE______3_CM 1 0. 0. 1. ECU_ADDRESS 0xd0006779 BIT_MASK 0x1 /end MEASUREMENT
/begin MEASUREMENT Vbx_ti_bar_cdn "BAR activation conditions" UBYTE _CNV_S_2_RANGE______3_CM 1 0. 0. 1. ECU_ADDRESS 0xd000677a BIT_MASK 0x1 /end MEASUREMENT
/begin MEASUREMENT Vbx_ti_bar_end "BAR duration over." UBYTE _CNV_S_2_RANGE______3_CM 1 0. 0. 1. ECU_ADDRESS 0xd000677b BIT_MASK 0x1 /end MEASUREMENT
/begin MEASUREMENT Vsx_rich_cl "State of the richness closed loop state machine." UWORD _CNV_S_14_RANGE_STAT_120_CM 1 0. 0. 4096. ECU_ADDRESS 0xd0004032 /end MEASUREMENT
/begin MEASUREMENT Vxx_last_p_cor "Last proportional term applied to Vxx_cl_ti_fac." SBYTE _CNV_A_R_LINEAR_____121_CM 1 0. -0.333333333333166 0.330729166666501 ECU_ADDRESS 0xd000677c FORMAT "%8.5" /end MEASUREMENT
/begin MEASUREMENT Vxx_rich_i_appl "Sum of integral terms applied to Vxx_cl_ti_fac since last lambda switch." UWORD _CNV_A_R_LINEAR_____50_CM 1 0. 0. 0.666656494140625 ECU_ADDRESS 0xd0004034 FORMAT "%8.7" /end MEASUREMENT
/begin MEASUREMENT Vxx_slop_eal_dif "Difference between Engine air load and its filtered value." SWORD _CNV_A_R_LINEAR_____53_CM 1 0. -2. 1.99993896484375 ECU_ADDRESS 0xd0004036 FORMAT "%8.5" /end MEASUREMENT
/begin MEASUREMENT Vxx_slop_eal_mmv "Engine air load filtered for richness fast slope." UWORD _CNV_A_R_LINEAR_____53_CM 1 0. 0. 3.99993896484375 ECU_ADDRESS 0xd0004038 FORMAT "%7.5" /end MEASUREMENT
/begin MEASUREMENT Vxx_ti_bar_add_p_act_dly "Delay before activating a big proportional after no torque request" UWORD _CNV_A_R_LINEAR_____32_CM 1 0. 0. 655.35 ECU_ADDRESS 0xd000403a FORMAT "%6.2" /end MEASUREMENT
/begin MEASUREMENT Vxx_ti_bar_add_p_eal_disa_t "timer before disabling the big proportional when BAR is canceled due to high engine load" UWORD _CNV_A_R_LINEAR_____32_CM 1 0. 0. 655.35 ECU_ADDRESS 0xd000403c FORMAT "%6.2" /end MEASUREMENT
/begin MEASUREMENT Vxx_ti_bar_add_p_t "Timing during which if the BAR is deactivated, there will be a big proportional at take off" UWORD _CNV_A_R_LINEAR_____32_CM 1 0. 0. 655.35 ECU_ADDRESS 0xd000403e FORMAT "%6.2" /end MEASUREMENT
/begin MEASUREMENT Vxx_ti_i_cor "Integral factor to be applied on Vxx_cl_ti_fac in normal conditions." UBYTE _CNV_A_R_LINEAR_____50_CM 1 0. 0. 2.593994140625e-003 ECU_ADDRESS 0xd000677d FORMAT "%10.8" /end MEASUREMENT
/begin MEASUREMENT Vxx_ti_i_cor_fast_slop "Integral factor to be applied on Vxx_cl_ti_fac in specific slope conditions." UBYTE _CNV_A_R_LINEAR_____50_CM 1 0. 0. 2.593994140625e-003 ECU_ADDRESS 0xd000677e FORMAT "%10.8" /end MEASUREMENT
/begin MEASUREMENT Vxx_ti_i_cor_lean "Integral factor to be applied on Vxx_cl_ti_fac in lean conditions." UBYTE _CNV_A_R_LINEAR_____50_CM 1 0. 0. 2.593994140625e-003 ECU_ADDRESS 0xd000677f FORMAT "%10.8" /end MEASUREMENT
/begin MEASUREMENT Vxx_ti_ofs_cor "offset applied on richness closed loop." SWORD _CNV_A_R_LINEAR_____99_CM 1 0. -0.333333333238019 0.33332316071198 ECU_ADDRESS 0xd0004040 FORMAT "%8.5" /end MEASUREMENT
/begin MEASUREMENT Vxx_ti_p_cor "Proportional term that will be applied to Vxx_cl_ti_fac at next lambda switch." UBYTE _CNV_A_R_LINEAR_____109_CM 1 0. 0. 0.33203125 ECU_ADDRESS 0xd0006780 FORMAT "%8.6" /end MEASUREMENT
/begin MEASUREMENT Vxx_ti_p_cor_lean1 "Proportional term that will be substracted to Vxx_cl_ti_fac at next lambda switch, in lean mode." UBYTE _CNV_A_R_LINEAR_____109_CM 1 0. 0. 0.33203125 ECU_ADDRESS 0xd0006781 FORMAT "%8.6" /end MEASUREMENT
/begin MEASUREMENT Vxx_ti_p_cor_lean2 "Proportional term that will be added to Vxx_cl_ti_fac at next lambda switch, in lean mode." UBYTE _CNV_A_R_LINEAR_____109_CM 1 0. 0. 0.33203125 ECU_ADDRESS 0xd0006782 FORMAT "%8.6" /end MEASUREMENT
/begin CHARACTERISTIC Cbx_ti_bar_add_p "Activates the strategies of big proportional when BAR is insuficient" VALUE 0xa0020f14 _REC_S1VAL_20_u1 1. _CNV_A_R_ECME_LINEA_0_CM 0. 1. FORMAT "%1.0" BIT_MASK 0x1 /end CHARACTERISTIC
/begin CHARACTERISTIC Cbx_ti_bar_ena "Activation of the BAR strategy (Fast downstream richness loop)" VALUE 0xa0020f15 _REC_S1VAL_20_u1 1. _CNV_A_R_ECME_LINEA_0_CM 0. 1. FORMAT "%1.0" BIT_MASK 0x1 /end CHARACTERISTIC
/begin CHARACTERISTIC Csx_bar_rst_eva_stt "This value corresponds to the phase of EVAP Diagnosis where the BAR must restart. (refer to Vsx_eva_dgn states)" VALUE 0xa0020f16 _REC_S1VAL_20_u1 16. _CNV_A_R_ECME_LINEA_0_CM 0. 16. FORMAT "%2.0" /end CHARACTERISTIC
/begin CHARACTERISTIC Csx_bar_stop_eva_stt "This value corresponds to the phase of EVAP Diagnosis where the BAR must stop. (refer to Vsx_eva_dgn states)" VALUE 0xa0020f17 _REC_S1VAL_20_u1 16. _CNV_A_R_ECME_LINEA_0_CM 0. 16. FORMAT "%2.0" /end CHARACTERISTIC
/begin CHARACTERISTIC Cxx_acel_spc_slop "Specific slope gain applied on standard integral parameter. When accelerating." VALUE 0xa0020f18 _REC_S1VAL_20_u1 7.96875 _CNV_A_R_LINEAR_____122_CM 1. 8.96875 FORMAT "%5.4" /end CHARACTERISTIC
/begin CHARACTERISTIC Cxx_acel_spc_slop_lean "Specific slope gain applied on standard integral parameter. When accelerating in lean settings." VALUE 0xa0020f19 _REC_S1VAL_20_u1 7.96875 _CNV_A_R_LINEAR_____122_CM 1. 8.96875 FORMAT "%5.4" /end CHARACTERISTIC
/begin CHARACTERISTIC Cxx_appl_ti_ofs_ctr "Initial value TDC counter to apply offset." VALUE 0xa0020f1a _REC_S1VAL_20_u1 255. _CNV_A_R_LINEAR_____101_CM 0. 255. FORMAT "%3.0" /end CHARACTERISTIC
/begin CHARACTERISTIC Cxx_appl_ti_ofs_ctr_alco "Initial value TDC counter to apply offset. for exotic fuel" VALUE 0xa0020f1b _REC_S1VAL_20_u1 255. _CNV_A_R_LINEAR_____101_CM 0. 255. FORMAT "%3.0" /end CHARACTERISTIC
/begin CHARACTERISTIC Cxx_bar_stop_eva_dly "Delay before disabling the BAR strategy after reaching the EVAP diag state" VALUE 0xa0020ede _REC_S1VAL_20_u2 655.35 _CNV_A_R_LINEAR_____123_CM 0. 655.35 FORMAT "%6.2" /end CHARACTERISTIC
/begin CHARACTERISTIC Cxx_cl_lean_ctr "Anti Glitch counter initial value." VALUE 0xa0020f1c _REC_S1VAL_20_u1 2.55 _CNV_A_R_LINEAR_____32_CM 0. 2.55 FORMAT "%4.2" /end CHARACTERISTIC
/begin CHARACTERISTIC Cxx_cl_ti_fac_ftc "Filter time constant for Vxx_cl_ti_fac." VALUE 0xa0020ee0 _REC_S1VAL_20_u2 655.35 _CNV_A_R_LINEAR_____32_CM 0. 655.35 FORMAT "%6.2" /end CHARACTERISTIC
/begin CHARACTERISTIC Cxx_cl_ti_fac_ftc_alco "Filter time constant for Vxx_cl_ti_fac. For exotic fuel" VALUE 0xa0020ee2 _REC_S1VAL_20_u2 655.35 _CNV_A_R_LINEAR_____32_CM 0. 655.35 FORMAT "%6.2" /end CHARACTERISTIC
/begin CHARACTERISTIC Cxx_cl_ti_fac_ol_dec "Max decrementation by step of Vxx_cl_ti_fac when returning to neutral value" VALUE 0xa0020ee4 _REC_S1VAL_20_u2 0.666656494140625 _CNV_A_R_LINEAR_____50_CM 0. 0.666656494140625 FORMAT "%8.7" /end CHARACTERISTIC
/begin CHARACTERISTIC Cxx_cl_ti_fac_ol_inc "Max increment by step of Vxx_cl_ti_fac when returning to neutral value" VALUE 0xa0020ee6 _REC_S1VAL_20_u2 0.666656494140625 _CNV_A_R_LINEAR_____50_CM 0. 0.666656494140625 FORMAT "%8.7" /end CHARACTERISTIC
/begin CHARACTERISTIC Cxx_decl_spc_slop "Specific slope gain applied on standard integral parameter. When decelerating." VALUE 0xa0020f1d _REC_S1VAL_20_u1 7.96875 _CNV_A_R_LINEAR_____122_CM 1. 8.96875 FORMAT "%5.4" /end CHARACTERISTIC
/begin CHARACTERISTIC Cxx_decl_spc_slop_lean "Specific slope gain applied on standard integral parameter. When decelerating in lean settings." VALUE 0xa0020f1e _REC_S1VAL_20_u1 7.96875 _CNV_A_R_LINEAR_____122_CM 1. 8.96875 FORMAT "%5.4" /end CHARACTERISTIC
/begin CHARACTERISTIC Cxx_dstb_ti_ofs_cor "offset correction added on richness closed loop. during richness repartition" VALUE 0xa0020ee8 _REC_S1VAL_20_s2 0.666656493949999 _CNV_A_R_LINEAR_____99_CM -0.333333333238019 0.33332316071198 FORMAT "%8.5" /end CHARACTERISTIC
/begin CHARACTERISTIC Cxx_dstb_ti_ofs_cor_alco "offset correction added on richness closed loop. during richness repartition. for alcohol" VALUE 0xa0020eea _REC_S1VAL_20_s2 0.666656493949999 _CNV_A_R_LINEAR_____99_CM -0.333333333238019 0.33332316071198 FORMAT "%8.5" /end CHARACTERISTIC
/begin CHARACTERISTIC Cxx_dstb_ti_p_cor "Proportional term correction that will be added. during richness distribution." VALUE 0xa0020f1f _REC_S1VAL_20_u1 0.33203125 _CNV_A_R_LINEAR_____109_CM 0. 0.33203125 FORMAT "%8.6" /end CHARACTERISTIC
/begin CHARACTERISTIC Cxx_dstb_ti_p_cor_alco "Proportional term correction that will be added. during richness distribution for alcohol." VALUE 0xa0020f20 _REC_S1VAL_20_u1 0.33203125 _CNV_A_R_LINEAR_____109_CM 0. 0.33203125 FORMAT "%8.6" /end CHARACTERISTIC
/begin CHARACTERISTIC Cxx_h_ti_fast_slop_thd "Enrichment threshold that activates fast slope settings" VALUE 0xa0020f21 _REC_S1VAL_20_u1 0.6640625 _CNV_A_R_LINEAR_____106_CM 0. 0.6640625 FORMAT "%8.6" /end CHARACTERISTIC
/begin CHARACTERISTIC Cxx_h_ti_fast_slop_thd_alco "Enrichment threshold that activates fast slope settings for exotic fuel" VALUE 0xa0020f22 _REC_S1VAL_20_u1 0.6640625 _CNV_A_R_LINEAR_____106_CM 0. 0.6640625 FORMAT "%8.6" /end CHARACTERISTIC
/begin CHARACTERISTIC Cxx_h_ti_fast_slop_thd_lean "Enrichment threshold that activates fast slope settings in lean configuration." VALUE 0xa0020f23 _REC_S1VAL_20_u1 0.6640625 _CNV_A_R_LINEAR_____106_CM 0. 0.6640625 FORMAT "%8.6" /end CHARACTERISTIC
/begin CHARACTERISTIC Cxx_is_ti_i_cor "Integral term used during iddle speed regulation." VALUE 0xa0020f24 _REC_S1VAL_20_u1 2.593994140625e-003 _CNV_A_R_LINEAR_____50_CM 0. 2.593994140625e-003 FORMAT "%10.8" /end CHARACTERISTIC
/begin CHARACTERISTIC Cxx_is_ti_i_cor_alco "Integral term used during iddle speed regulation. for exotic fuel" VALUE 0xa0020f25 _REC_S1VAL_20_u1 2.593994140625e-003 _CNV_A_R_LINEAR_____50_CM 0. 2.593994140625e-003 FORMAT "%10.8" /end CHARACTERISTIC
/begin CHARACTERISTIC Cxx_is_ti_i_cor_lean "Integral term used during iddle speed regulation. during lean configuration" VALUE 0xa0020f26 _REC_S1VAL_20_u1 2.593994140625e-003 _CNV_A_R_LINEAR_____50_CM 0. 2.593994140625e-003 FORMAT "%10.8" /end CHARACTERISTIC
/begin CHARACTERISTIC Cxx_is_ti_p_cor "Proportional term applied during iddle speed regulation" VALUE 0xa0020f27 _REC_S1VAL_20_u1 0.33203125 _CNV_A_R_LINEAR_____109_CM 0. 0.33203125 FORMAT "%8.6" /end CHARACTERISTIC
/begin CHARACTERISTIC Cxx_is_ti_p_cor_alco "Proportional term applied during iddle speed regulation for exotic fuel" VALUE 0xa0020f28 _REC_S1VAL_20_u1 0.33203125 _CNV_A_R_LINEAR_____109_CM 0. 0.33203125 FORMAT "%8.6" /end CHARACTERISTIC
/begin CHARACTERISTIC Cxx_is_ti_p_cor_lean1 "Positive proportional term applied during iddle speed regulation, lean configuration" VALUE 0xa0020f29 _REC_S1VAL_20_u1 0.33203125 _CNV_A_R_LINEAR_____109_CM 0. 0.33203125 FORMAT "%8.6" /end CHARACTERISTIC
/begin CHARACTERISTIC Cxx_is_ti_p_cor_lean2 "Negative proportional term applied during iddle speed regulation, lean configuration" VALUE 0xa0020f2a _REC_S1VAL_20_u1 0.33203125 _CNV_A_R_LINEAR_____109_CM 0. 0.33203125 FORMAT "%8.6" /end CHARACTERISTIC
/begin CHARACTERISTIC Cxx_l_ti_fast_slop_thd "Threshold of enleanment on Vxx_cl_ti_fac under which fast slope is activated." VALUE 0xa0020f2b _REC_S1VAL_20_u1 0.6640625 _CNV_A_R_LINEAR_____106_CM 0. 0.6640625 FORMAT "%8.6" /end CHARACTERISTIC
/begin CHARACTERISTIC Cxx_l_ti_fast_slop_thd_alco "Threshold of enleanment on Vxx_cl_ti_fac under which fast slope is activated. for exotic fuel" VALUE 0xa0020f2c _REC_S1VAL_20_u1 0.6640625 _CNV_A_R_LINEAR_____106_CM 0. 0.6640625 FORMAT "%8.6" /end CHARACTERISTIC
/begin CHARACTERISTIC Cxx_l_ti_fast_slop_thd_lean "Threshold of enleanment on Vxx_cl_ti_fac under which fast slope is activated. In lean configuration" VALUE 0xa0020f2d _REC_S1VAL_20_u1 0.6640625 _CNV_A_R_LINEAR_____106_CM 0. 0.6640625 FORMAT "%8.6" /end CHARACTERISTIC
/begin CHARACTERISTIC Cxx_lamb_swi_ctr_ini "Initial value for countdown of lambda switch used for filter time constant after loop closing and fast slope." VALUE 0xa0020f2e _REC_S1VAL_20_u1 255. _CNV_A_R_ECME_LINEA_0_CM 0. 255. FORMAT "%3.0" /end CHARACTERISTIC
/begin CHARACTERISTIC Cxx_lamb_swi_ctr_ini_alco "Initial value for countdown of lambda switch used for filter time constant after loop closing and fast slope. for exotic fuel" VALUE 0xa0020f2f _REC_S1VAL_20_u1 255. _CNV_A_R_ECME_LINEA_0_CM 0. 255. FORMAT "%3.0" /end CHARACTERISTIC
/begin CHARACTERISTIC Cxx_max_spc_slop_ctr "Value for TDC counter used to get out of specific slope." VALUE 0xa0020eec _REC_S1VAL_20_u2 65535. _CNV_A_R_LINEAR_____101_CM 0. 65535. FORMAT "%5.0" /end CHARACTERISTIC
/begin CHARACTERISTIC Cxx_max_ti_p_cor_fast_slop "Maximum value of compensation of fast slope." VALUE 0xa0020eee _REC_S1VAL_20_u2 0.666656494140625 _CNV_A_R_LINEAR_____50_CM 0. 0.666656494140625 FORMAT "%8.7" /end CHARACTERISTIC
/begin CHARACTERISTIC Cxx_max_ti_p_cor_fast_slop_alco "Maximum value of compensation of fast slope. for exotic fuel" VALUE 0xa0020ef0 _REC_S1VAL_20_u2 0.666656494140625 _CNV_A_R_LINEAR_____50_CM 0. 0.666656494140625 FORMAT "%8.7" /end CHARACTERISTIC
/begin CHARACTERISTIC Cxx_spc_slop_eal_ftc "Filter time constant applied on EAL for the specific slope." VALUE 0xa0020ef2 _REC_S1VAL_20_u2 65.535 _CNV_A_R_LINEAR_____116_CM 0. 65.535 FORMAT "%5.3" /end CHARACTERISTIC
/begin CHARACTERISTIC Cxx_spc_slop_eal_h_thd "Difference between Engine air load and its filtered value over which specific slope can be activated" VALUE 0xa0020ef4 _REC_S1VAL_20_s2 1.99993896484375 _CNV_A_R_LINEAR_____53_CM 0. 1.99993896484375 FORMAT "%8.5" /end CHARACTERISTIC
/begin CHARACTERISTIC Cxx_spc_slop_eal_l_thd "Difference between Engine air load and its filtered value under which specific slope can be activated" VALUE 0xa0020ef6 _REC_S1VAL_20_s2 2. _CNV_A_R_LINEAR_____53_CM -2. 0. FORMAT "%8.5" /end CHARACTERISTIC
/begin CHARACTERISTIC Cxx_ti_bar_add_p_act_dly "Delay before activating a big proportional after no torque request" VALUE 0xa0020ef8 _REC_S1VAL_20_u2 655.35 _CNV_A_R_LINEAR_____32_CM 0. 655.35 FORMAT "%6.2" /end CHARACTERISTIC
/begin CHARACTERISTIC Cxx_ti_bar_add_p_dly "Delay before disabling the big proportional when take off is asked and no BAR has been activated yet" VALUE 0xa0020efa _REC_S1VAL_20_u2 655.35 _CNV_A_R_LINEAR_____32_CM 0. 655.35 FORMAT "%6.2" /end CHARACTERISTIC
/begin CHARACTERISTIC Cxx_ti_bar_add_p_eal_disa_dly "Delay before disabling the big proportional when BAR is canceled due to high engine load" VALUE 0xa0020efc _REC_S1VAL_20_u2 655.35 _CNV_A_R_LINEAR_____32_CM 0. 655.35 FORMAT "%6.2" /end CHARACTERISTIC
/begin CHARACTERISTIC Cxx_ti_bar_dly "Deactivation delay of the BAR strategy." VALUE 0xa0020efe _REC_S1VAL_20_u2 6553.5 _CNV_A_R_LINEAR_____58_CM 0. 6553.5 FORMAT "%6.1" /end CHARACTERISTIC
/begin CHARACTERISTIC Cxx_ti_bar_eal_max "Maximum eal for BAR activation" VALUE 0xa0020f00 _REC_S1VAL_20_u2 3.99993896484375 _CNV_A_R_LINEAR_____53_CM 0. 3.99993896484375 FORMAT "%10.8" /end CHARACTERISTIC
/begin CHARACTERISTIC Cxx_ti_bar_eal_min "Minimum eal for BAR activation" VALUE 0xa0020f02 _REC_S1VAL_20_u2 3.99993896484375 _CNV_A_R_LINEAR_____53_CM 0. 3.99993896484375 FORMAT "%10.8" /end CHARACTERISTIC
/begin CHARACTERISTIC Cxx_ti_bar_lbdw_rich_in "Voltage threshold to enter in rich BAR mode." VALUE 0xa0020f04 _REC_S1VAL_20_u2 25000. _CNV_A_R_LINEAR_____107_CM 0. 25000. FORMAT "%5.0" /end CHARACTERISTIC
/begin CHARACTERISTIC Cxx_ti_bar_lbdw_rich_out "Voltage threshold to exit rich BAR mode." VALUE 0xa0020f06 _REC_S1VAL_20_u2 25000. _CNV_A_R_LINEAR_____107_CM 0. 25000. FORMAT "%5.0" /end CHARACTERISTIC
/begin CHARACTERISTIC Cxx_ti_bar_n_max "Maximum engine speed to activate BAR." VALUE 0xa0020f08 _REC_S1VAL_20_u2 16383.75 _CNV_A_R_ENSD_LINEA_22_CM 0. 16383.75 FORMAT "%8.2" /end CHARACTERISTIC
/begin CHARACTERISTIC Cxx_ti_bar_n_min "Minimum engine speed to activate BAR" VALUE 0xa0020f0a _REC_S1VAL_20_u2 16383.75 _CNV_A_R_ENSD_LINEA_22_CM 0. 16383.75 FORMAT "%8.2" /end CHARACTERISTIC
/begin CHARACTERISTIC Cxx_ti_bar_tco_min "Minimum coolant temperature to activate BAR" VALUE 0xa0020f0c _REC_S1VAL_20_u2 240. _CNV_A_R_LINEAR_____110_CM -40. 200. FORMAT "%5.1" /end CHARACTERISTIC
/begin CHARACTERISTIC Cxx_ti_i_fast_slop_fac "Factor appplied to rpm to obtain the fast slop integral value." VALUE 0xa0020f30 _REC_S1VAL_20_u1 5.06639480594806e-006 _CNV_A_R_LINEAR_____124_CM 0. 5.06639480594806e-006 FORMAT "%11.9" /end CHARACTERISTIC
/begin CHARACTERISTIC Cxx_ti_i_fast_slop_fac_alco "Factor appplied to rpm to obtain the fast slop integral value. (exotic fuel setting)" VALUE 0xa0020f31 _REC_S1VAL_20_u1 5.06639480594806e-006 _CNV_A_R_LINEAR_____124_CM 0. 5.06639480594806e-006 FORMAT "%11.9" /end CHARACTERISTIC
/begin CHARACTERISTIC Cxx_ti_ofs_vs_thd "Vehicle speed threshold to switch between offset settings." VALUE 0xa0020f0e _REC_S1VAL_20_u2 655.35 _CNV_A_R_LINEAR_____125_CM 0. 655.35 FORMAT "%6.2" /end CHARACTERISTIC
/begin CHARACTERISTIC Cxx_ti_ofs_vs_thd_alco "Vehicle speed threshold to switch between offset settings. for exotic fuel" VALUE 0xa0020f10 _REC_S1VAL_20_u2 655.35 _CNV_A_R_LINEAR_____125_CM 0. 655.35 FORMAT "%6.2" /end CHARACTERISTIC
/begin CHARACTERISTIC Cxx_ti_p_eal_thd "Engine air load threshold to have a small proportional out of Iddle State Regulation" VALUE 0xa0020f12 _REC_S1VAL_20_u2 3.99993896484375 _CNV_A_R_LINEAR_____53_CM 0. 3.99993896484375 FORMAT "%7.5" /end CHARACTERISTIC
/begin AXIS_PTS Ctb_n_cl_rich_sp_bkp "engine speed breackpoints for the richness applied when low engine speed during richness closed loop" 0xa0029328 Vxx_n _REC_A2AXS_20_u2 16383.75 _CNV_A_R_ENSD_LINEA_22_CM 4 0. 16383.75 FORMAT "%8.2" /end AXIS_PTS
/begin AXIS_PTS Ctb_tco_cl_off "13 breakpoint table for richness closed loop" 0xa0029334 Vxx_tco _REC_A2AXS_20_u2 240. _CNV_A_R_LINEAR_____110_CM 13 -40. 200. FORMAT "%5.1" /end AXIS_PTS
/begin CHARACTERISTIC Cmp_n_tco_eal_fl_thd_h "Map of EAL inducing full load conditions, depending on engine speed and water temp. (high RON or when no ADOC)" MAP 0xa0029350 _REC_A1MAP_20_u2_u2_u2 3.99993896484375 _CNV_A_R_LINEAR_____53_CM 0. 3.99993896484375 FORMAT "%7.5"
 /begin AXIS_DESCR COM_AXIS Vxx_tco _CNV_A_R_LINEAR_____110_CM 13 -40. 200. FORMAT "%5.1" AXIS_PTS_REF Ctb_tco_cl_off /end AXIS_DESCR
 /begin AXIS_DESCR COM_AXIS Vxx_n _CNV_A_R_ENSD_LINEA_22_CM 20 0. 16383.75 FORMAT "%8.2" AXIS_PTS_REF Ctb_n /end AXIS_DESCR
/end CHARACTERISTIC
/begin CHARACTERISTIC Cmp_n_tco_eal_fl_thd_l "Map of EAL inducing full load conditions, depending on engine speed and water temp. (low RON setting)" MAP 0xa0029558 _REC_A1MAP_20_u2_u2_u2 3.99993896484375 _CNV_A_R_LINEAR_____53_CM 0. 3.99993896484375 FORMAT "%7.5"
 /begin AXIS_DESCR COM_AXIS Vxx_tco _CNV_A_R_LINEAR_____110_CM 13 -40. 200. FORMAT "%5.1" AXIS_PTS_REF Ctb_tco_cl_off /end AXIS_DESCR
 /begin AXIS_DESCR COM_AXIS Vxx_n _CNV_A_R_ENSD_LINEA_22_CM 20 0. 16383.75 FORMAT "%8.2" AXIS_PTS_REF Ctb_n /end AXIS_DESCR
/end CHARACTERISTIC
/begin CHARACTERISTIC Cmp_n_tco_eal_fl_thd_midh "Map of EAL inducing full load conditions, depending on engine speed and water temp. (mid high RON setting)" MAP 0xa0029760 _REC_A1MAP_20_u2_u2_u2 3.99993896484375 _CNV_A_R_LINEAR_____53_CM 0. 3.99993896484375 FORMAT "%7.5"
 /begin AXIS_DESCR COM_AXIS Vxx_tco _CNV_A_R_LINEAR_____110_CM 13 -40. 200. FORMAT "%5.1" AXIS_PTS_REF Ctb_tco_cl_off /end AXIS_DESCR
 /begin AXIS_DESCR COM_AXIS Vxx_n _CNV_A_R_ENSD_LINEA_22_CM 20 0. 16383.75 FORMAT "%8.2" AXIS_PTS_REF Ctb_n /end AXIS_DESCR
/end CHARACTERISTIC
/begin CHARACTERISTIC Cmp_n_tco_eal_fl_thd_midl "Map of EAL inducing full load conditions, depending on engine speed and water temp. (mid low RON setting)" MAP 0xa0029968 _REC_A1MAP_20_u2_u2_u2 3.99993896484375 _CNV_A_R_LINEAR_____53_CM 0. 3.99993896484375 FORMAT "%7.5"
 /begin AXIS_DESCR COM_AXIS Vxx_tco _CNV_A_R_LINEAR_____110_CM 13 -40. 200. FORMAT "%5.1" AXIS_PTS_REF Ctb_tco_cl_off /end AXIS_DESCR
 /begin AXIS_DESCR COM_AXIS Vxx_n _CNV_A_R_ENSD_LINEA_22_CM 20 0. 16383.75 FORMAT "%8.2" AXIS_PTS_REF Ctb_n /end AXIS_DESCR
/end CHARACTERISTIC
/begin CHARACTERISTIC Ctp_cl_t "Table giving the delay before closing the richness loop after start, depending on water temp." CURVE 0xa0029b70 _REC_A1CUR_20_u2_u2 6553.5 _CNV_A_R_LINEAR_____58_CM 0. 6553.5 FORMAT "%6.1"
 /begin AXIS_DESCR COM_AXIS Vxx_tco _CNV_A_R_LINEAR_____110_CM 13 -40. 200. FORMAT "%5.1" AXIS_PTS_REF Ctb_tco_cl_off /end AXIS_DESCR
/end CHARACTERISTIC
/begin CHARACTERISTIC Ctp_n_cl_rich_sp "richness setpoint for low engine speeds during richness closed loop" CURVE 0xa0020f34 _REC_A1CUR_20_u2_u2 0.9947916670000001 _CNV_A_R_LINEAR_____126_CM 1. 1.994791667 FORMAT "%7.3"
 /begin AXIS_DESCR COM_AXIS Vxx_n _CNV_A_R_ENSD_LINEA_22_CM 4 0. 16383.75 FORMAT "%8.2" AXIS_PTS_REF Ctb_n_cl_rich_sp_bkp /end AXIS_DESCR
/end CHARACTERISTIC
/begin CHARACTERISTIC Ctp_n_dly_ofs_dly "Table indicating delay before full load application." CURVE 0xa0029b8c _REC_A1CUR_20_u2_u2 6553.5 _CNV_A_R_LINEAR_____58_CM 0. 6553.5 FORMAT "%6.1"
 /begin AXIS_DESCR COM_AXIS Vxx_n _CNV_A_R_ENSD_LINEA_22_CM 9 0. 16383.75 FORMAT "%8.2" AXIS_PTS_REF Ctb_n2 /end AXIS_DESCR
/end CHARACTERISTIC
/begin CHARACTERISTIC Ctp_n_eal_fl_ocl_ofs "EAL offset added to Vxx_eal_fl_ocl to authorize full load." CURVE 0xa0029ba0 _REC_A1CUR_20_u2_u2 3.99993896484375 _CNV_A_R_LINEAR_____53_CM 0. 3.99993896484375 FORMAT "%7.5"
 /begin AXIS_DESCR COM_AXIS Vxx_n _CNV_A_R_ENSD_LINEA_22_CM 20 0. 16383.75 FORMAT "%8.2" AXIS_PTS_REF Ctb_n /end AXIS_DESCR
/end CHARACTERISTIC
/begin CHARACTERISTIC Ctp_n_iga_eal_fl_thd "Loop opening threshold for each cranckshaft degree of ignition correction." CURVE 0xa0029bc8 _REC_A1CUR_20_u2_u2 3.99993896484375 _CNV_A_R_LINEAR_____127_CM 0. 3.99993896484375 FORMAT "%7.5"
 /begin AXIS_DESCR COM_AXIS Vxx_n _CNV_A_R_ENSD_LINEA_22_CM 20 0. 16383.75 FORMAT "%8.2" AXIS_PTS_REF Ctb_n /end AXIS_DESCR
/end CHARACTERISTIC
/begin MEASUREMENT Vbx_cl_cdn "Closed loop conditions." UBYTE _CNV_S_2_RANGE______3_CM 1 0. 0. 1. ECU_ADDRESS 0xd00077e9 BIT_MASK 0x1 /end MEASUREMENT
/begin MEASUREMENT Vbx_cl_phs "Richness regulation condition" UBYTE _CNV_S_2_RANGE______3_CM 1 0. 0. 1. ECU_ADDRESS 0xd0006783 BIT_MASK 0x1 /end MEASUREMENT
/begin MEASUREMENT Vbx_dly_ocl_cdn "Postponed open loop conditions." UBYTE _CNV_S_2_RANGE______3_CM 1 0. 0. 1. ECU_ADDRESS 0xd00077ea BIT_MASK 0x1 /end MEASUREMENT
/begin MEASUREMENT Vbx_fl_cdn "Full load conditions for richness" UBYTE _CNV_S_2_RANGE______3_CM 1 0. 0. 1. ECU_ADDRESS 0xd00077eb BIT_MASK 0x1 /end MEASUREMENT
/begin MEASUREMENT Vbx_fl_ena "Full load authorized" UBYTE _CNV_S_2_RANGE______3_CM 1 0. 0. 1. ECU_ADDRESS 0xd0006784 BIT_MASK 0x1 /end MEASUREMENT
/begin MEASUREMENT Vxx_eal_fl_ocl "EAL over which richness loop is opened." UWORD _CNV_A_R_LINEAR_____53_CM 1 0. 0. 3.99993896484375 ECU_ADDRESS 0xd000512a FORMAT "%7.5" /end MEASUREMENT
/begin CHARACTERISTIC Cbx_fl_kd_thr_conf "Disable the postponed loop opening when full throttle." VALUE 0xa0020f5a _REC_S1VAL_20_u1 1. _CNV_A_R_ECME_LINEA_0_CM 0. 1. FORMAT "%1.0" BIT_MASK 0x1 /end CHARACTERISTIC
/begin CHARACTERISTIC Cbx_lbup_conf "Enables closed loop (set to OFF when no sensor)" VALUE 0xa0020f5b _REC_S1VAL_20_u1 1. _CNV_A_R_ECME_LINEA_0_CM 0. 1. FORMAT "%1.0" BIT_MASK 0x1 /end CHARACTERISTIC
/begin CHARACTERISTIC Cxx_bfr_cl_ctr "Number of TDC required before richness loop closing when conditions are present." VALUE 0xa0020f5c _REC_S1VAL_20_u1 255. _CNV_A_R_LINEAR_____101_CM 0. 255. FORMAT "%3.0" /end CHARACTERISTIC
/begin CHARACTERISTIC Cxx_bfr_cl_ctr_alco "Number of TDC required before richness loop closing when conditions are present.(alcohol setting)" VALUE 0xa0020f5d _REC_S1VAL_20_u1 255. _CNV_A_R_LINEAR_____101_CM 0. 255. FORMAT "%3.0" /end CHARACTERISTIC
/begin CHARACTERISTIC Cxx_cl_off_n_thd "Engine speed threshold over which richness closed loop is disabled." VALUE 0xa0020f3c _REC_S1VAL_20_u2 16383.75 _CNV_A_R_ENSD_LINEA_22_CM 0. 16383.75 FORMAT "%8.2" /end CHARACTERISTIC
/begin CHARACTERISTIC Cxx_cl_run_eal_thd "Engine air load threshold under which open loop is set, vehicle moving." VALUE 0xa0020f3e _REC_S1VAL_20_u2 3.99993896484375 _CNV_A_R_LINEAR_____53_CM 0. 3.99993896484375 FORMAT "%7.5" /end CHARACTERISTIC
/begin CHARACTERISTIC Cxx_cl_stop_eal_thd "Engine air load threshold under which open loop is set, vehicle stopped." VALUE 0xa0020f40 _REC_S1VAL_20_u2 3.99993896484375 _CNV_A_R_LINEAR_____53_CM 0. 3.99993896484375 FORMAT "%7.5" /end CHARACTERISTIC
/begin CHARACTERISTIC Cxx_ct_pdl_tco_thd "Water temperature threshold when throttle off." VALUE 0xa0020f42 _REC_S1VAL_20_u2 240. _CNV_A_R_LINEAR_____110_CM -40. 200. FORMAT "%5.1" /end CHARACTERISTIC
/begin CHARACTERISTIC Cxx_dly_ocl_amp_thd "Atmospheric pressure under which postponed open loop is disabled." VALUE 0xa0020f44 _REC_S1VAL_20_u2 20000. _CNV_A_R_LINEAR_____115_CM 0. 20000. FORMAT "%5.0" /end CHARACTERISTIC
/begin CHARACTERISTIC Cxx_dly_ocl_l_n_thd "Engine speed under which postponed open loop is disabled. (take off)" VALUE 0xa0020f46 _REC_S1VAL_20_u2 16383.75 _CNV_A_R_ENSD_LINEA_22_CM 0. 16383.75 FORMAT "%8.2" /end CHARACTERISTIC
/begin CHARACTERISTIC Cxx_dly_ocl_up_n_thd "Engine speed over which postponed open loop is disabled. (thermic protection)" VALUE 0xa0020f48 _REC_S1VAL_20_u2 16383.75 _CNV_A_R_ENSD_LINEA_22_CM 0. 16383.75 FORMAT "%8.2" /end CHARACTERISTIC
/begin CHARACTERISTIC Cxx_fl_ena_n_thd "Engine speed under which full load enrichment is disabled." VALUE 0xa0020f4a _REC_S1VAL_20_u2 16383.75 _CNV_A_R_ENSD_LINEA_22_CM 0. 16383.75 FORMAT "%8.2" /end CHARACTERISTIC
/begin CHARACTERISTIC Cxx_fl_n_thd "Engine speed under which we exit full load conditions." VALUE 0xa0020f4c _REC_S1VAL_20_u2 16383.75 _CNV_A_R_ENSD_LINEA_22_CM 0. 16383.75 FORMAT "%8.2" /end CHARACTERISTIC
/begin CHARACTERISTIC Cxx_fl_n_thd_hys "Hysteresis on Engine speed for full load conditions." VALUE 0xa0020f4e _REC_S1VAL_20_u2 16383.75 _CNV_A_R_ENSD_LINEA_22_CM 0. 16383.75 FORMAT "%8.2" /end CHARACTERISTIC
/begin CHARACTERISTIC Cxx_h_dly_ocl_tco_thd "Coolant temperature over which postponed open loop is disabled." VALUE 0xa0020f50 _REC_S1VAL_20_u2 240. _CNV_A_R_LINEAR_____110_CM -40. 200. FORMAT "%5.1" /end CHARACTERISTIC
/begin CHARACTERISTIC Cxx_l_dly_ocl_tco_thd "Engine coolant temperature under which postponed open loop is disabled." VALUE 0xa0020f52 _REC_S1VAL_20_u2 240. _CNV_A_R_LINEAR_____110_CM -40. 200. FORMAT "%5.1" /end CHARACTERISTIC
/begin CHARACTERISTIC Cxx_ol_ti_fac_dec "Maximum decrementation of richness open loop factor during return to closed loop(per step)." VALUE 0xa0020f5e _REC_S1VAL_20_u1 1.328125 _CNV_A_R_LINEAR_____126_CM 0. 1.328125 FORMAT "%8.6" /end CHARACTERISTIC
/begin CHARACTERISTIC Cxx_ol_ti_fac_inc "Maximum increment of richness open loop factor during exit of closed loop(per step)." VALUE 0xa0020f5f _REC_S1VAL_20_u1 1.328125 _CNV_A_R_LINEAR_____126_CM 0. 1.328125 FORMAT "%8.6" /end CHARACTERISTIC
/begin CHARACTERISTIC Cxx_rich_cl_tco_thd "Engine coolant temperature under which Richness closed loop is forbidden." VALUE 0xa0020f54 _REC_S1VAL_20_u2 240. _CNV_A_R_LINEAR_____110_CM -40. 200. FORMAT "%5.1" /end CHARACTERISTIC
/begin CHARACTERISTIC Cxx_rich_ol_fim_thd "Injected fuel mass under which richness closed loop is forbidden." VALUE 0xa0020f60 _REC_S1VAL_20_u1 41.7792 _CNV_A_R_LINEAR_____128_CM 0. 41.7792 FORMAT "%8.5" /end CHARACTERISTIC
/begin CHARACTERISTIC Cxx_sta_fl_off_dly "Init value of delay before allowing richness full load phase." VALUE 0xa0020f56 _REC_S1VAL_20_u2 6553.5 _CNV_A_R_LINEAR_____58_CM 0. 6553.5 FORMAT "%6.1" /end CHARACTERISTIC
/begin CHARACTERISTIC Cxx_sta_fl_off_dly_alco "Init value of delay before allowing richness full load phase. (alcohol setting)" VALUE 0xa0020f58 _REC_S1VAL_20_u2 6553.5 _CNV_A_R_LINEAR_____58_CM 0. 6553.5 FORMAT "%6.1" /end CHARACTERISTIC
/begin AXIS_PTS Ctb_vvtc_wet_fst_tco "Coolant temperature breakpoints for cold vvtc correction" 0xa0029bf0 Vxx_tco _REC_A2AXS_20_u2 240. _CNV_A_R_LINEAR_____110_CM 5 -40. 200. FORMAT "%5.1" /end AXIS_PTS
/begin AXIS_PTS Ctb_wet_eal "9 eal breakpoints table for wall wetting" 0xa0029bfc Vxx_eal _REC_A2AXS_20_u2 3.99993896484375 _CNV_A_R_LINEAR_____53_CM 9 0. 3.99993896484375 FORMAT "%7.5" /end AXIS_PTS
/begin AXIS_PTS Ctb_wet_in_vvtc_angl "5 VVTC position breackpoints table for wall wetting" 0xa0029c10 Vxx_in_vvtc_angl _REC_A2AXS_20_u2 719.98 _CNV_A_R_LINEAR_____129_CM 5 0. 719.98 FORMAT "%6.2" /end AXIS_PTS
/begin AXIS_PTS Ctb_wet_n "5 RPM breakpoints table for wall wetting" 0xa0029c1c Vxx_n _REC_A2AXS_20_u2 16383.75 _CNV_A_R_ENSD_LINEA_22_CM 5 0. 16383.75 FORMAT "%8.2" /end AXIS_PTS
/begin AXIS_PTS Ctb_wet_tco_17 "17 water temperature breakpoints table for wall wetting" 0xa0029c28 Vxx_tco _REC_A2AXS_20_u2 240. _CNV_A_R_LINEAR_____110_CM 17 -40. 200. FORMAT "%5.1" /end AXIS_PTS
/begin AXIS_PTS Ctb_wet_tco_9 "9 water temperature breakpoints table for wall wetting" 0xa0029c4c Vxx_tco _REC_A2AXS_20_u2 240. _CNV_A_R_LINEAR_____110_CM 9 -40. 200. FORMAT "%5.1" /end AXIS_PTS
/begin CHARACTERISTIC Cmp_wet_dep_fac_tco00 "map of fuel film factor for a 0Â°C water tempÃ©rature" MAP 0xa0029c60 _REC_A1MAP_20_u1_u2_u2 2550. _CNV_A_R_LINEAR_____111_CM 0. 2550. FORMAT "%4.0"
 /begin AXIS_DESCR COM_AXIS Vxx_eal _CNV_A_R_LINEAR_____53_CM 9 0. 3.99993896484375 FORMAT "%7.5" AXIS_PTS_REF Ctb_wet_eal /end AXIS_DESCR
 /begin AXIS_DESCR COM_AXIS Vxx_n _CNV_A_R_ENSD_LINEA_22_CM 5 0. 16383.75 FORMAT "%8.2" AXIS_PTS_REF Ctb_wet_n /end AXIS_DESCR
/end CHARACTERISTIC
/begin CHARACTERISTIC Cmp_wet_dep_fac_tco20 "map of fuel film factor for a 20Â°C water temperature" MAP 0xa0029c90 _REC_A1MAP_20_u1_u2_u2 2550. _CNV_A_R_LINEAR_____111_CM 0. 2550. FORMAT "%4.0"
 /begin AXIS_DESCR COM_AXIS Vxx_eal _CNV_A_R_LINEAR_____53_CM 9 0. 3.99993896484375 FORMAT "%7.5" AXIS_PTS_REF Ctb_wet_eal /end AXIS_DESCR
 /begin AXIS_DESCR COM_AXIS Vxx_n _CNV_A_R_ENSD_LINEA_22_CM 5 0. 16383.75 FORMAT "%8.2" AXIS_PTS_REF Ctb_wet_n /end AXIS_DESCR
/end CHARACTERISTIC
/begin CHARACTERISTIC Cmp_wet_dep_fac_tco40 "map of fuel film factor for a 40Â°C water temperature" MAP 0xa0029cc0 _REC_A1MAP_20_u1_u2_u2 2550. _CNV_A_R_LINEAR_____111_CM 0. 2550. FORMAT "%4.0"
 /begin AXIS_DESCR COM_AXIS Vxx_eal _CNV_A_R_LINEAR_____53_CM 9 0. 3.99993896484375 FORMAT "%7.5" AXIS_PTS_REF Ctb_wet_eal /end AXIS_DESCR
 /begin AXIS_DESCR COM_AXIS Vxx_n _CNV_A_R_ENSD_LINEA_22_CM 5 0. 16383.75 FORMAT "%8.2" AXIS_PTS_REF Ctb_wet_n /end AXIS_DESCR
/end CHARACTERISTIC
/begin CHARACTERISTIC Cmp_wet_dep_fac_tco60 "map of fuel film factor for a 60Â°C water temperature" MAP 0xa0029cf0 _REC_A1MAP_20_u1_u2_u2 2550. _CNV_A_R_LINEAR_____111_CM 0. 2550. FORMAT "%4.0"
 /begin AXIS_DESCR COM_AXIS Vxx_eal _CNV_A_R_LINEAR_____53_CM 9 0. 3.99993896484375 FORMAT "%7.5" AXIS_PTS_REF Ctb_wet_eal /end AXIS_DESCR
 /begin AXIS_DESCR COM_AXIS Vxx_n _CNV_A_R_ENSD_LINEA_22_CM 5 0. 16383.75 FORMAT "%8.2" AXIS_PTS_REF Ctb_wet_n /end AXIS_DESCR
/end CHARACTERISTIC
/begin CHARACTERISTIC Cmp_wet_dep_fac_tco80 "map of fuel film factor for a 80Â°C water temperature" MAP 0xa0029d20 _REC_A1MAP_20_u1_u2_u2 2550. _CNV_A_R_LINEAR_____111_CM 0. 2550. FORMAT "%4.0"
 /begin AXIS_DESCR COM_AXIS Vxx_eal _CNV_A_R_LINEAR_____53_CM 9 0. 3.99993896484375 FORMAT "%7.5" AXIS_PTS_REF Ctb_wet_eal /end AXIS_DESCR
 /begin AXIS_DESCR COM_AXIS Vxx_n _CNV_A_R_ENSD_LINEA_22_CM 5 0. 16383.75 FORMAT "%8.2" AXIS_PTS_REF Ctb_wet_n /end AXIS_DESCR
/end CHARACTERISTIC
/begin CHARACTERISTIC Cmp_wet_fil_fac_tco00 "map of dynamic filter factors in acceleration for a 0Â°C water temperature" MAP 0xa0029d50 _REC_A1MAP_20_u1_u2_u2 9.9609375e-002 _CNV_A_R_LINEAR_____112_CM 0. 9.9609375e-002 FORMAT "%5.4"
 /begin AXIS_DESCR COM_AXIS Vxx_eal _CNV_A_R_LINEAR_____53_CM 9 0. 3.99993896484375 FORMAT "%7.5" AXIS_PTS_REF Ctb_wet_eal /end AXIS_DESCR
 /begin AXIS_DESCR COM_AXIS Vxx_n _CNV_A_R_ENSD_LINEA_22_CM 5 0. 16383.75 FORMAT "%8.2" AXIS_PTS_REF Ctb_wet_n /end AXIS_DESCR
/end CHARACTERISTIC
/begin CHARACTERISTIC Cmp_wet_fil_fac_tco20 "map of dynamic filter factors in acceleration for a 20Â°C water temperature" MAP 0xa0029d80 _REC_A1MAP_20_u1_u2_u2 9.9609375e-002 _CNV_A_R_LINEAR_____112_CM 0. 9.9609375e-002 FORMAT "%5.4"
 /begin AXIS_DESCR COM_AXIS Vxx_eal _CNV_A_R_LINEAR_____53_CM 9 0. 3.99993896484375 FORMAT "%7.5" AXIS_PTS_REF Ctb_wet_eal /end AXIS_DESCR
 /begin AXIS_DESCR COM_AXIS Vxx_n _CNV_A_R_ENSD_LINEA_22_CM 5 0. 16383.75 FORMAT "%8.2" AXIS_PTS_REF Ctb_wet_n /end AXIS_DESCR
/end CHARACTERISTIC
/begin CHARACTERISTIC Cmp_wet_fil_fac_tco40 "map of dynamic filter factors in acceleration for a 40Â°C water temperature" MAP 0xa0029db0 _REC_A1MAP_20_u1_u2_u2 9.9609375e-002 _CNV_A_R_LINEAR_____112_CM 0. 9.9609375e-002 FORMAT "%5.4"
 /begin AXIS_DESCR COM_AXIS Vxx_eal _CNV_A_R_LINEAR_____53_CM 9 0. 3.99993896484375 FORMAT "%7.5" AXIS_PTS_REF Ctb_wet_eal /end AXIS_DESCR
 /begin AXIS_DESCR COM_AXIS Vxx_n _CNV_A_R_ENSD_LINEA_22_CM 5 0. 16383.75 FORMAT "%8.2" AXIS_PTS_REF Ctb_wet_n /end AXIS_DESCR
/end CHARACTERISTIC
/begin CHARACTERISTIC Cmp_wet_fil_fac_tco60 "map of dynamic filter factors in acceleration for a 60Â°C water temperature" MAP 0xa0029de0 _REC_A1MAP_20_u1_u2_u2 9.9609375e-002 _CNV_A_R_LINEAR_____112_CM 0. 9.9609375e-002 FORMAT "%5.4"
 /begin AXIS_DESCR COM_AXIS Vxx_eal _CNV_A_R_LINEAR_____53_CM 9 0. 3.99993896484375 FORMAT "%7.5" AXIS_PTS_REF Ctb_wet_eal /end AXIS_DESCR
 /begin AXIS_DESCR COM_AXIS Vxx_n _CNV_A_R_ENSD_LINEA_22_CM 5 0. 16383.75 FORMAT "%8.2" AXIS_PTS_REF Ctb_wet_n /end AXIS_DESCR
/end CHARACTERISTIC
/begin CHARACTERISTIC Cmp_wet_fil_fac_tco80 "map of dynamic filter factors in acceleration for a 80Â°C water temperature" MAP 0xa0029e10 _REC_A1MAP_20_u1_u2_u2 9.9609375e-002 _CNV_A_R_LINEAR_____112_CM 0. 9.9609375e-002 FORMAT "%5.4"
 /begin AXIS_DESCR COM_AXIS Vxx_eal _CNV_A_R_LINEAR_____53_CM 9 0. 3.99993896484375 FORMAT "%7.5" AXIS_PTS_REF Ctb_wet_eal /end AXIS_DESCR
 /begin AXIS_DESCR COM_AXIS Vxx_n _CNV_A_R_ENSD_LINEA_22_CM 5 0. 16383.75 FORMAT "%8.2" AXIS_PTS_REF Ctb_wet_n /end AXIS_DESCR
/end CHARACTERISTIC
/begin CHARACTERISTIC Cmp_wet_in_vvtc_cor_fac "map of corrective gain depending on VVTC position for the calculation of the stabilized fuel film mass" MAP 0xa0029e40 _REC_A1MAP_20_u1_u2_u2 1.9921875 _CNV_A_R_LINEAR_____42_CM 0. 1.9921875 FORMAT "%8.6"
 /begin AXIS_DESCR COM_AXIS Vxx_tco _CNV_A_R_LINEAR_____110_CM 9 -40. 200. FORMAT "%5.1" AXIS_PTS_REF Ctb_wet_tco_9 /end AXIS_DESCR
 /begin AXIS_DESCR COM_AXIS Vxx_in_vvtc_angl _CNV_A_R_LINEAR_____129_CM 5 0. 719.98 FORMAT "%6.2" AXIS_PTS_REF Ctb_wet_in_vvtc_angl /end AXIS_DESCR
/end CHARACTERISTIC
/begin CHARACTERISTIC Ctp_tco_vvtc_wet_fst_fac "Gain to build cold vvtc factor" CURVE 0xa0020f62 _REC_A1CUR_20_u1_u2 0.99609375 _CNV_A_R_LINEAR_____130_CM 3.90625e-003 1. FORMAT "%12.8"
 /begin AXIS_DESCR COM_AXIS Vxx_tco _CNV_A_R_LINEAR_____110_CM 5 -40. 200. FORMAT "%5.1" AXIS_PTS_REF Ctb_vvtc_wet_fst_tco /end AXIS_DESCR
/end CHARACTERISTIC
/begin CHARACTERISTIC Ctp_ti_vvtc_neg_cor_dly "Table of time left after start to build vvtc correction factor" CURVE 0xa0029e70 _REC_A1CUR_20_u2_u2 1310.7 _CNV_A_R_LINEAR_____131_CM 0. 1310.7 FORMAT "%7.2"
 /begin AXIS_DESCR COM_AXIS Vxx_tco _CNV_A_R_LINEAR_____110_CM 8 -40. 200. FORMAT "%5.1" AXIS_PTS_REF Ctb_sta_tco /end AXIS_DESCR
/end CHARACTERISTIC
/begin CHARACTERISTIC Ctp_ti_vvtc_neg_cor_fac "Table of factor after detection to build vvtc correction factor" CURVE 0xa0029e80 _REC_A1CUR_20_u2_u2 1310.7 _CNV_A_R_LINEAR_____131_CM 0. 1310.7 FORMAT "%7.2"
 /begin AXIS_DESCR COM_AXIS Vxx_tco _CNV_A_R_LINEAR_____110_CM 8 -40. 200. FORMAT "%5.1" AXIS_PTS_REF Ctb_sta_tco /end AXIS_DESCR
/end CHARACTERISTIC
/begin CHARACTERISTIC Ctp_wet_acel_cor_fac "Table of corrective factors in acceleration" CURVE 0xa0029e90 _REC_A1CUR_20_u2_u2 65.536 _CNV_A_R_LINEAR_____113_CM 0. 65.536 FORMAT "%5.4"
 /begin AXIS_DESCR COM_AXIS Vxx_tco _CNV_A_R_LINEAR_____110_CM 17 -40. 200. FORMAT "%5.1" AXIS_PTS_REF Ctb_wet_tco_17 /end AXIS_DESCR
/end CHARACTERISTIC
/begin CHARACTERISTIC Ctp_wet_decl_cor_fac "Table of corrective factors in deceleration" CURVE 0xa0029eb4 _REC_A1CUR_20_u2_u2 65.536 _CNV_A_R_LINEAR_____113_CM 0. 65.536 FORMAT "%5.4"
 /begin AXIS_DESCR COM_AXIS Vxx_tco _CNV_A_R_LINEAR_____110_CM 17 -40. 200. FORMAT "%5.1" AXIS_PTS_REF Ctb_wet_tco_17 /end AXIS_DESCR
/end CHARACTERISTIC
/begin CHARACTERISTIC Ctp_wet_decl_fil_fac "table of dynamic filter factors in deceleration" CURVE 0xa0029ed8 _REC_A1CUR_20_u1_u2 9.9609375e-002 _CNV_A_R_LINEAR_____112_CM 0. 9.9609375e-002 FORMAT "%5.4"
 /begin AXIS_DESCR COM_AXIS Vxx_tco _CNV_A_R_LINEAR_____110_CM 17 -40. 200. FORMAT "%5.1" AXIS_PTS_REF Ctb_wet_tco_17 /end AXIS_DESCR
/end CHARACTERISTIC
/begin CHARACTERISTIC Ctp_wet_ini_acel_cor_ofs "Table of specific corrective offset in case of first acceleration" CURVE 0xa0029eec _REC_A1CUR_20_u2_u2 65.53400000000001 _CNV_A_R_LINEAR_____132_CM 0. 65.53400000000001
 /begin AXIS_DESCR COM_AXIS Vxx_tco _CNV_A_R_LINEAR_____110_CM 17 -40. 200. FORMAT "%5.1" AXIS_PTS_REF Ctb_wet_tco_17 /end AXIS_DESCR
/end CHARACTERISTIC
/begin CHARACTERISTIC Ctp_wet_vol_dif_thd_acel "Threshold to apply the wall wetting correction in acceleration" CURVE 0xa0029f10 _REC_A1CUR_20_u2_u2 1000. _CNV_A_R_LINEAR_____114_CM 0. 1000. FORMAT "%6.1"
 /begin AXIS_DESCR COM_AXIS Vxx_tco _CNV_A_R_LINEAR_____110_CM 9 -40. 200. FORMAT "%5.1" AXIS_PTS_REF Ctb_wet_tco_9 /end AXIS_DESCR
/end CHARACTERISTIC
/begin CHARACTERISTIC Ctp_wet_vol_dif_thd_decl "Threshold to apply the wall wetting correction in deceleration" CURVE 0xa0029f24 _REC_A1CUR_20_u2_u2 1000. _CNV_A_R_LINEAR_____114_CM 0. 1000. FORMAT "%6.1"
 /begin AXIS_DESCR COM_AXIS Vxx_tco _CNV_A_R_LINEAR_____110_CM 9 -40. 200. FORMAT "%5.1" AXIS_PTS_REF Ctb_wet_tco_9 /end AXIS_DESCR
/end CHARACTERISTIC
/begin CHARACTERISTIC Ctp_wet_vol_dif_thd_ini "Threshold to autorize first acceleration detection" CURVE 0xa0029f38 _REC_A1CUR_20_u2_u2 1000. _CNV_A_R_LINEAR_____114_CM 0. 1000. FORMAT "%6.1"
 /begin AXIS_DESCR COM_AXIS Vxx_tco _CNV_A_R_LINEAR_____110_CM 9 -40. 200. FORMAT "%5.1" AXIS_PTS_REF Ctb_wet_tco_9 /end AXIS_DESCR
/end CHARACTERISTIC
/begin CHARACTERISTIC Ctp_wet_vol_dif_thd_sta "Threshold to apply the wall wetting correction in a specific after start time" CURVE 0xa0029f4c _REC_A1CUR_20_u2_u2 1000. _CNV_A_R_LINEAR_____114_CM 0. 1000. FORMAT "%6.1"
 /begin AXIS_DESCR COM_AXIS Vxx_tco _CNV_A_R_LINEAR_____110_CM 9 -40. 200. FORMAT "%5.1" AXIS_PTS_REF Ctb_wet_tco_9 /end AXIS_DESCR
/end CHARACTERISTIC
/begin CHARACTERISTIC Ctp_wet_vol_dif_thd_sta_t "Table of time left after start for a specific after start threshold" CURVE 0xa0029f60 _REC_A1CUR_20_u1_u2 255. _CNV_A_R_LINEAR_____68_CM 0. 255. FORMAT "%3.0"
 /begin AXIS_DESCR COM_AXIS Vxx_tco _CNV_A_R_LINEAR_____110_CM 9 -40. 200. FORMAT "%5.1" AXIS_PTS_REF Ctb_wet_tco_9 /end AXIS_DESCR
/end CHARACTERISTIC
/begin MEASUREMENT Vbx_decl_prs_lean_ena "Autorization of lean mixture in deceleration" UBYTE _CNV_S_2_RANGE______3_CM 1 0. 0. 1. ECU_ADDRESS 0xd000678e BIT_MASK 0x1 /end MEASUREMENT
/begin MEASUREMENT Vbx_wet_ini_acel_cdn "Indicates that first acceleration has been detected" UBYTE _CNV_S_2_RANGE______3_CM 1 0. 0. 1. ECU_ADDRESS 0xd00077f0 BIT_MASK 0x1 /end MEASUREMENT
/begin MEASUREMENT Vbx_wet_ini_acel_rest_cdn "Indicator of restart conditions when the key ON is detected" UBYTE _CNV_S_2_RANGE______3_CM 1 0. 0. 1. ECU_ADDRESS 0xd000678f BIT_MASK 0x1 /end MEASUREMENT
/begin MEASUREMENT Vbx_wet_ti_clc_ena "Injection time is computed." UBYTE _CNV_S_2_RANGE______3_CM 1 0. 0. 1. ECU_ADDRESS 0xd0006790 BIT_MASK 0x1 /end MEASUREMENT
/begin MEASUREMENT Vxx_cold_vvtc_cor_fac "Cold vvtc correction factor" UBYTE _CNV_A_R_LINEAR_____130_CM 1 0. 3.90625e-003 1. ECU_ADDRESS 0xd0006791 FORMAT "%12.8" /end MEASUREMENT
/begin MEASUREMENT Vxx_decl_prs_lean_dsb_dly "Time after start when lean mixture in deceleration is forbidden" UBYTE _CNV_A_R_LINEAR_____68_CM 1 0. 0. 255. ECU_ADDRESS 0xd0006792 FORMAT "%3.0" /end MEASUREMENT
/begin MEASUREMENT Vxx_fim "Average injected fuel mass disrigarding cylinder number or injection phase (1 or 2)" ULONG _CNV_A_R_LINEAR_____133_CM 1 0. 0. 4800. ECU_ADDRESS 0xd0002530 FORMAT "%10.6" /end MEASUREMENT
/begin MEASUREMENT Vxx_wet_acel_cor_fac "corrective factor for wall wetting correction and acceleration" UWORD _CNV_A_R_LINEAR_____113_CM 1 0. 0. 65.536 ECU_ADDRESS 0xd000404a FORMAT "%5.4" /end MEASUREMENT
/begin MEASUREMENT Vxx_wet_acel_decl_bch_cor_fac "Final corrective factor for wall wetting correction in bench mode" UWORD _CNV_A_R_LINEAR_____113_CM 1 0. 0. 131.07 ECU_ADDRESS 0xd000404c FORMAT "%4.3" /end MEASUREMENT
/begin MEASUREMENT Vxx_wet_acel_decl_cor_fac "Final corrective factor for wall wetting correction" UWORD _CNV_A_R_LINEAR_____113_CM 1 0. 0. 131.07 ECU_ADDRESS 0xd000404e FORMAT "%4.3" /end MEASUREMENT
/begin MEASUREMENT Vxx_wet_aftr_sta_t "Time left after start for a specific after start threshold" UWORD _CNV_A_R_LINEAR_____58_CM 1 0. 0. 6553.5 ECU_ADDRESS 0xd0004050 FORMAT "%6.1" /end MEASUREMENT
/begin MEASUREMENT Vxx_wet_aftr_sta_t_prev "Time left after start tor a specific after start threshold (previous time step)" UWORD _CNV_A_R_LINEAR_____58_CM 1 0. 0. 6553.5 ECU_ADDRESS 0xd0004052 FORMAT "%6.1" /end MEASUREMENT
/begin MEASUREMENT Vxx_wet_cor_ofs_itl "Specific corrective offset in case of first acceleration (internal)" UWORD _CNV_A_R_LINEAR_____132_CM 1 0. 0. 65.53400000000001 ECU_ADDRESS 0xd0004054 /end MEASUREMENT
/begin MEASUREMENT Vxx_wet_decl_cor_fac "corrective factor for wall wetting correction in deceleration" UWORD _CNV_A_R_LINEAR_____113_CM 1 0. 0. 65.536 ECU_ADDRESS 0xd0004056 FORMAT "%5.4" /end MEASUREMENT
/begin MEASUREMENT Vxx_wet_dep_fac "Gain for the calculation of the stabilized fuel film" UBYTE _CNV_A_R_LINEAR_____111_CM 1 0. 0. 2550. ECU_ADDRESS 0xd0006793 FORMAT "%4.0" /end MEASUREMENT
/begin MEASUREMENT Vxx_wet_dyn_vol "Physical fuel film mass in the intake ports" UWORD _CNV_A_R_LINEAR_____134_CM 1 0. 0. 8999.8626709 ECU_ADDRESS 0xd0004058 FORMAT "%6.5" /end MEASUREMENT
/begin MEASUREMENT Vxx_wet_dyn_vol_fil_fac "Dynamic filter factor of the fuel film" UBYTE _CNV_A_R_LINEAR_____112_CM 1 0. 0. 9.9609375e-002 ECU_ADDRESS 0xd0006794 FORMAT "%5.4" /end MEASUREMENT
/begin MEASUREMENT Vxx_wet_dyn_vol_prev "Physical fuel film mass in the intake ports (at the previous tdc)" UWORD _CNV_A_R_LINEAR_____134_CM 1 0. 0. 8999.8626709 ECU_ADDRESS 0xd000405a FORMAT "%6.5" /end MEASUREMENT
/begin MEASUREMENT Vxx_wet_in_vvtc_cor_fac "Corrective gain depending on VVTC position for the calculation of the stabilized fuel film mass" UBYTE _CNV_A_R_LINEAR_____42_CM 1 0. 0. 1.9921875 ECU_ADDRESS 0xd0006795 FORMAT "%8.6" /end MEASUREMENT
/begin MEASUREMENT Vxx_wet_ini_acel_cor_ofs "Specific corrective offset in case of first acceleration" UWORD _CNV_A_R_LINEAR_____132_CM 1 0. 0. 65.53400000000001 ECU_ADDRESS 0xd000405c /end MEASUREMENT
/begin MEASUREMENT Vxx_wet_ini_acel_sta_t "Time left after start to detect a first acceleration" UWORD _CNV_A_R_LINEAR_____32_CM 1 0. 0. 655.35 ECU_ADDRESS 0xd000405e FORMAT "%6.2" /end MEASUREMENT
/begin MEASUREMENT Vxx_wet_stat_vol "Fuel film mass in stabilized conditions" UWORD _CNV_A_R_LINEAR_____134_CM 1 0. 0. 8999.8626709 ECU_ADDRESS 0xd0004060 FORMAT "%6.5" /end MEASUREMENT
/begin MEASUREMENT Vxx_wet_ti_cut_ctr "Pulse counter" UBYTE _CNV_A_R_ECME_LINEA_0_CM 1 0. 0. 255. ECU_ADDRESS 0xd0006796 FORMAT "%3.0" /end MEASUREMENT
/begin MEASUREMENT Vxx_wet_ti_cut_tdc_ctr "Counter of injection time pulse TDC" UWORD _CNV_A_R_LINEAR_____101_CM 1 0. 0. 65535. ECU_ADDRESS 0xd0004062 FORMAT "%5.0" /end MEASUREMENT
/begin MEASUREMENT Vxx_wet_vol_dif_thd_acel "Threshold to apply the wall wetting correction in acceleration" UWORD _CNV_A_R_LINEAR_____114_CM 1 0. 0. 1000. ECU_ADDRESS 0xd0004064 FORMAT "%6.1" /end MEASUREMENT
/begin MEASUREMENT Vxx_wet_vol_dif_thd_decl "Threshold to apply the wall wetting correction in deceleration" UWORD _CNV_A_R_LINEAR_____114_CM 1 0. 0. 1000. ECU_ADDRESS 0xd0004066 FORMAT "%6.1" /end MEASUREMENT
/begin MEASUREMENT Vxx_wet_wht_cor "Wall wetting final correction" SLONG _CNV_A_R_LINEAR_____135_CM 1 0. -4800. 4800. ECU_ADDRESS 0xd0002534 FORMAT "%11.7" /end MEASUREMENT
/begin CHARACTERISTIC Cbx_wet_stat_cor_bch_mod "Bench mode stabilized fuel film calculation" VALUE 0xa0020f7e _REC_S1VAL_20_u1 1. _CNV_A_R_ECME_LINEA_0_CM 0. 1. FORMAT "%1.0" BIT_MASK 0x1 /end CHARACTERISTIC
/begin CHARACTERISTIC Cbx_wet_vol_dif_thd_sta_ena "Boolean to enable Ctp_wet_vol_dif_thd_sta as the threshold for first acceleration detection" VALUE 0xa0020f7f _REC_S1VAL_20_u1 1. _CNV_A_R_ECME_LINEA_0_CM 0. 1. FORMAT "%1.0" BIT_MASK 0x1 /end CHARACTERISTIC
/begin CHARACTERISTIC Cxx_cold_vvtc_angl_ti_cor_thd "Threshold of angular position to detect first vvtc activation" VALUE 0xa0020f68 _REC_S1VAL_20_u2 719.98 _CNV_A_R_LINEAR_____129_CM 0. 719.98 FORMAT "%6.2" /end CHARACTERISTIC
/begin CHARACTERISTIC Cxx_decl_lean_dsb_n_ofs "Width of hysteresis for activation of lean mixture in deceleration" VALUE 0xa0020f6a _REC_S1VAL_20_u2 16383.75 _CNV_A_R_ENSD_LINEA_22_CM 0. 16383.75 FORMAT "%8.2" /end CHARACTERISTIC
/begin CHARACTERISTIC Cxx_decl_lean_dsb_n_thd "Threshold for activation of lean mixture in deceleration" VALUE 0xa0020f6c _REC_S1VAL_20_u2 16383.75 _CNV_A_R_ENSD_LINEA_22_CM 0. 16383.75 FORMAT "%8.2" /end CHARACTERISTIC
/begin CHARACTERISTIC Cxx_decl_prs_lean_dsb_dly "Delay after start when lean mixture in deceleration is forbidden" VALUE 0xa0020f80 _REC_S1VAL_20_u1 255. _CNV_A_R_LINEAR_____68_CM 0. 255. FORMAT "%3.0" /end CHARACTERISTIC
/begin CHARACTERISTIC Cxx_tco_cold_vvtc_ti_cor_max "Maximum coolant temperature to allow cold vvtc correction" VALUE 0xa0020f6e _REC_S1VAL_20_u2 240. _CNV_A_R_LINEAR_____110_CM -40. 200. FORMAT "%5.1" /end CHARACTERISTIC
/begin CHARACTERISTIC Cxx_tco_cold_vvtc_ti_cor_min "Minimum coolant temperature to allow cold vvtc correction" VALUE 0xa0020f70 _REC_S1VAL_20_u2 240. _CNV_A_R_LINEAR_____110_CM -40. 200. FORMAT "%5.1" /end CHARACTERISTIC
/begin CHARACTERISTIC Cxx_ti_max_cor_cold_vvtc_act "Maximum value to reset cold vvtc correction factor to 1" VALUE 0xa0020f81 _REC_S1VAL_20_u1 0.99609375 _CNV_A_R_LINEAR_____29_CM 0. 0.99609375 FORMAT "%5.3" /end CHARACTERISTIC
/begin CHARACTERISTIC Cxx_vvtc_idle_dly "Delay in idle to allow cold vvtc correction" VALUE 0xa0020f72 _REC_S1VAL_20_u2 1310.7 _CNV_A_R_LINEAR_____131_CM 0. 1310.7 FORMAT "%7.2" /end CHARACTERISTIC
/begin CHARACTERISTIC Cxx_wet_acel_bch_cor_fac "Corrective factor for wall wetting correction in acceleration in bench mode conditions" VALUE 0xa0020f74 _REC_S1VAL_20_u2 131.07 _CNV_A_R_LINEAR_____113_CM 0. 131.07 FORMAT "%4.3" /end CHARACTERISTIC
/begin CHARACTERISTIC Cxx_wet_acel_bch_fil_fac "Dynamic filter factor of the fuel film in acceleration in bench mode conditions" VALUE 0xa0020f82 _REC_S1VAL_20_u1 9.9609375e-002 _CNV_A_R_LINEAR_____112_CM 0. 9.9609375e-002 FORMAT "%5.4" /end CHARACTERISTIC
/begin CHARACTERISTIC Cxx_wet_bch_dep_fac "Gain for the calculation of the stabilized fuel film in bench mode conditions" VALUE 0xa0020f83 _REC_S1VAL_20_u1 2550. _CNV_A_R_LINEAR_____111_CM 0. 2550. FORMAT "%4.0" /end CHARACTERISTIC
/begin CHARACTERISTIC Cxx_wet_decl_bch_cor_fac "Corrective factor for wall wetting correction in deceleration in bench mode conditions" VALUE 0xa0020f76 _REC_S1VAL_20_u2 131.07 _CNV_A_R_LINEAR_____113_CM 0. 131.07 FORMAT "%4.3" /end CHARACTERISTIC
/begin CHARACTERISTIC Cxx_wet_decl_bch_fil_fac "Dynamic filter factor of the fuel film in deceleration in bench mode conditions" VALUE 0xa0020f84 _REC_S1VAL_20_u1 9.9609375e-002 _CNV_A_R_LINEAR_____112_CM 0. 9.9609375e-002 FORMAT "%5.4" /end CHARACTERISTIC
/begin CHARACTERISTIC Cxx_wet_ini_acel_ofs_t "Time for the offset to reach zero after initialization" VALUE 0xa0020f78 _REC_S1VAL_20_u2 655.35 _CNV_A_R_LINEAR_____32_CM 0. 655.35 FORMAT "%6.2" /end CHARACTERISTIC
/begin CHARACTERISTIC Cxx_wet_ini_acel_sta_t "Maximum time left after start to detect a fisrt acceleration" VALUE 0xa0020f7a _REC_S1VAL_20_u2 655.35 _CNV_A_R_LINEAR_____32_CM 0. 655.35 FORMAT "%6.2" /end CHARACTERISTIC
/begin CHARACTERISTIC Cxx_wet_ti_cut_nr "Number of injection time pulse, in wall wetting bench mode" VALUE 0xa0020f85 _REC_S1VAL_20_u1 255. _CNV_A_R_ECME_LINEA_0_CM 0. 255. FORMAT "%3.0" /end CHARACTERISTIC
/begin CHARACTERISTIC Cxx_wet_ti_cut_tdc_nr "Width of injection time pulse, in wall wetting bench mode" VALUE 0xa0020f7c _REC_S1VAL_20_u2 65535. _CNV_A_R_LINEAR_____101_CM 0. 65535. FORMAT "%5.0" /end CHARACTERISTIC
/begin MEASUREMENT Vbx_ad_lsm_ena "Adaptive less square enable" UBYTE _CNV_S_2_RANGE______3_CM 1 0. 0. 1. ECU_ADDRESS 0xd0006751 BIT_MASK 0x1 /end MEASUREMENT
/begin MEASUREMENT Vbx_ad_lsm_req "Adaptive less square request" UBYTE _CNV_S_2_RANGE______3_CM 1 0. 0. 1. ECU_ADDRESS 0xd0006752 BIT_MASK 0x1 /end MEASUREMENT
/begin MEASUREMENT Vbx_is_hot_dly "Long time spent in idle speed regulation with hot engine" UBYTE _CNV_S_2_RANGE______3_CM 1 0. 0. 1. ECU_ADDRESS 0xd0006753 BIT_MASK 0x1 /end MEASUREMENT
/begin MEASUREMENT Vbx_ti_ad1_zon0 "At least one successful learning in zone 0" UBYTE _CNV_S_2_RANGE______3_CM 1 0. 0. 1. ECU_ADDRESS 0xd0006754 BIT_MASK 0x1 /end MEASUREMENT
/begin MEASUREMENT Vbx_ti_ad1_zon1 "At least one successful learning in zone 1" UBYTE _CNV_S_2_RANGE______3_CM 1 0. 0. 1. ECU_ADDRESS 0xd0006755 BIT_MASK 0x1 /end MEASUREMENT
/begin MEASUREMENT Vbx_ti_ad1_zon2 "At least one successful learning in zone 2" UBYTE _CNV_S_2_RANGE______3_CM 1 0. 0. 1. ECU_ADDRESS 0xd0006756 BIT_MASK 0x1 /end MEASUREMENT
/begin MEASUREMENT Vbx_ti_ad1_zon3 "At least one successful learning in zone 3" UBYTE _CNV_S_2_RANGE______3_CM 1 0. 0. 1. ECU_ADDRESS 0xd0006757 BIT_MASK 0x1 /end MEASUREMENT
/begin MEASUREMENT Vbx_ti_ad1_zon4 "At least one successful learning in zone 4" UBYTE _CNV_S_2_RANGE______3_CM 1 0. 0. 1. ECU_ADDRESS 0xd0006758 BIT_MASK 0x1 /end MEASUREMENT
/begin MEASUREMENT Vtd_ti_b[0] "Variation area of learning" UBYTE _CNV_A_R_ECME_LINEA_0_CM 1 0. 0. 255. ECU_ADDRESS 0xd000674c FORMAT "%3.0" /end MEASUREMENT
/begin MEASUREMENT Vtd_ti_b[1] "Variation area of learning" UBYTE _CNV_A_R_ECME_LINEA_0_CM 1 0. 0. 255. ECU_ADDRESS 0xd000674d FORMAT "%3.0" /end MEASUREMENT
/begin MEASUREMENT Vtd_ti_b[2] "Variation area of learning" UBYTE _CNV_A_R_ECME_LINEA_0_CM 1 0. 0. 255. ECU_ADDRESS 0xd000674e FORMAT "%3.0" /end MEASUREMENT
/begin MEASUREMENT Vtd_ti_b[3] "Variation area of learning" UBYTE _CNV_A_R_ECME_LINEA_0_CM 1 0. 0. 255. ECU_ADDRESS 0xd000674f FORMAT "%3.0" /end MEASUREMENT
/begin MEASUREMENT Vtd_ti_b[4] "Variation area of learning" UBYTE _CNV_A_R_ECME_LINEA_0_CM 1 0. 0. 255. ECU_ADDRESS 0xd0006750 FORMAT "%3.0" /end MEASUREMENT
/begin MEASUREMENT Vxx_ad_lamb_swi_ctr "Switch counter above and  down lambda one" UBYTE _CNV_A_R_ECME_LINEA_0_CM 1 0. 0. 255. ECU_ADDRESS 0xd0006759 FORMAT "%3.0" /end MEASUREMENT
/begin MEASUREMENT Vxx_imd_ti_ad_fac "Instantaneous adaptation factor on injection time" UBYTE _CNV_A_R_LINEAR_____103_CM 1 0. 0.6666667 1.3307292 ECU_ADDRESS 0xd000675a FORMAT "%5.3" /end MEASUREMENT
/begin MEASUREMENT Vxx_imd_ti_ad_ofs "Instantaneous adaptation offset on injection time" SBYTE _CNV_A_R_LINEAR_____102_CM 1 0. -512. 508. ECU_ADDRESS 0xd000675b FORMAT "%4.0" /end MEASUREMENT
/begin MEASUREMENT Vxx_imd_ti_ad_ofs_med "Instantaneous calculed adaptation offset on injection time" SBYTE _CNV_A_R_LINEAR_____102_CM 1 0. -512. 508. ECU_ADDRESS 0xd000675c FORMAT "%4.0" /end MEASUREMENT
/begin MEASUREMENT Vxx_is_hot_ti_cl_dly "Time spent in idle speed regulation with hot engine and with active richness regulation" UWORD _CNV_A_R_LINEAR_____58_CM 1 0. 0. 6553.5 ECU_ADDRESS 0xd000401a FORMAT "%6.1" /end MEASUREMENT
/begin MEASUREMENT Vxx_mv_ti_ad_ofs_med "Mean calculted adaptation offset on injection time" SBYTE _CNV_A_R_LINEAR_____102_CM 1 0. -512. 508. ECU_ADDRESS 0xd000675d FORMAT "%4.0" /end MEASUREMENT
/begin MEASUREMENT Vxx_ti_ad_fac "Adaptation factor on injection time" UBYTE _CNV_A_R_LINEAR_____103_CM 1 0. 0.6666667 1.3307292 ECU_ADDRESS 0xd000675e FORMAT "%5.3" /end MEASUREMENT
/begin MEASUREMENT Vxx_ti_ad_fac_med "Instantaneous calculated adaptation factor on injection time" UBYTE _CNV_A_R_LINEAR_____103_CM 1 0. 0.6666667 1.3307292 ECU_ADDRESS 0xd000675f FORMAT "%5.3" /end MEASUREMENT
/begin MEASUREMENT Vxx_ti_ad_facm_med "Mean calculated adaptation factor on injection time" UBYTE _CNV_A_R_LINEAR_____103_CM 1 0. 0.6666667 1.3307292 ECU_ADDRESS 0xd0006760 FORMAT "%5.3" /end MEASUREMENT
/begin MEASUREMENT Vxx_ti_ad_ofs "Adaptation offset on injection time" SBYTE _CNV_A_R_LINEAR_____102_CM 1 0. -512. 508. ECU_ADDRESS 0xd0006761 FORMAT "%4.0" /end MEASUREMENT
/begin MEASUREMENT Vxx_ti_b_med "Pattern of the misadjustment from Vxx_mv_cl_ti_fac" UBYTE _CNV_A_R_ECME_LINEA_0_CM 1 0. 0. 255. ECU_ADDRESS 0xd0006762 FORMAT "%3.0" /end MEASUREMENT
/begin MEASUREMENT Vxx_ti_zon_nr "Learning zone number" UBYTE _CNV_A_R_ECME_LINEA_0_CM 1 0. 0. 5. ECU_ADDRESS 0xd0006763 FORMAT "%1.0" /end MEASUREMENT
/begin CHARACTERISTIC Ctd_max_mv_cld_ad[0] "Maximum value of learning for each zone" VALUE 0xa0020ea4 _REC_S1VAL_20_u1 255. _CNV_A_R_ECME_LINEA_0_CM 0. 255. FORMAT "%3.0" /end CHARACTERISTIC
/begin CHARACTERISTIC Ctd_max_mv_cld_ad[1] "Maximum value of learning for each zone" VALUE 0xa0020ea5 _REC_S1VAL_20_u1 255. _CNV_A_R_ECME_LINEA_0_CM 0. 255. FORMAT "%3.0" /end CHARACTERISTIC
/begin CHARACTERISTIC Ctd_max_mv_cld_ad[2] "Maximum value of learning for each zone" VALUE 0xa0020ea6 _REC_S1VAL_20_u1 255. _CNV_A_R_ECME_LINEA_0_CM 0. 255. FORMAT "%3.0" /end CHARACTERISTIC
/begin CHARACTERISTIC Ctd_max_mv_cld_ad[3] "Maximum value of learning for each zone" VALUE 0xa0020ea7 _REC_S1VAL_20_u1 255. _CNV_A_R_ECME_LINEA_0_CM 0. 255. FORMAT "%3.0" /end CHARACTERISTIC
/begin CHARACTERISTIC Ctd_max_mv_cld_ad[4] "Maximum value of learning for each zone" VALUE 0xa0020ea8 _REC_S1VAL_20_u1 255. _CNV_A_R_ECME_LINEA_0_CM 0. 255. FORMAT "%3.0" /end CHARACTERISTIC
/begin CHARACTERISTIC Ctd_min_mv_cld_ad[0] "Minimum value of learning for each zone" VALUE 0xa0020eaa _REC_S1VAL_20_u1 255. _CNV_A_R_ECME_LINEA_0_CM 0. 255. FORMAT "%3.0" /end CHARACTERISTIC
/begin CHARACTERISTIC Ctd_min_mv_cld_ad[1] "Minimum value of learning for each zone" VALUE 0xa0020eab _REC_S1VAL_20_u1 255. _CNV_A_R_ECME_LINEA_0_CM 0. 255. FORMAT "%3.0" /end CHARACTERISTIC
/begin CHARACTERISTIC Ctd_min_mv_cld_ad[2] "Minimum value of learning for each zone" VALUE 0xa0020eac _REC_S1VAL_20_u1 255. _CNV_A_R_ECME_LINEA_0_CM 0. 255. FORMAT "%3.0" /end CHARACTERISTIC
/begin CHARACTERISTIC Ctd_min_mv_cld_ad[3] "Minimum value of learning for each zone" VALUE 0xa0020ead _REC_S1VAL_20_u1 255. _CNV_A_R_ECME_LINEA_0_CM 0. 255. FORMAT "%3.0" /end CHARACTERISTIC
/begin CHARACTERISTIC Ctd_min_mv_cld_ad[4] "Minimum value of learning for each zone" VALUE 0xa0020eae _REC_S1VAL_20_u1 255. _CNV_A_R_ECME_LINEA_0_CM 0. 255. FORMAT "%3.0" /end CHARACTERISTIC
/begin CHARACTERISTIC Ctd_ti_ad_fac_cor[0] "Factor used to calculate adaptation factor" VALUE 0xa0028f48 _REC_S1VAL_20_s2 1.333309575 _CNV_A_R_LINEAR_____136_CM -0.66666496 0.6666446150000001 FORMAT "%8.5" /end CHARACTERISTIC
/begin CHARACTERISTIC Ctd_ti_ad_fac_cor[1] "Factor used to calculate adaptation factor" VALUE 0xa0028f4a _REC_S1VAL_20_s2 1.333309575 _CNV_A_R_LINEAR_____136_CM -0.66666496 0.6666446150000001 FORMAT "%8.5" /end CHARACTERISTIC
/begin CHARACTERISTIC Ctd_ti_ad_fac_cor[2] "Factor used to calculate adaptation factor" VALUE 0xa0028f4c _REC_S1VAL_20_s2 1.333309575 _CNV_A_R_LINEAR_____136_CM -0.66666496 0.6666446150000001 FORMAT "%8.5" /end CHARACTERISTIC
/begin CHARACTERISTIC Ctd_ti_ad_fac_cor[3] "Factor used to calculate adaptation factor" VALUE 0xa0028f4e _REC_S1VAL_20_s2 1.333309575 _CNV_A_R_LINEAR_____136_CM -0.66666496 0.6666446150000001 FORMAT "%8.5" /end CHARACTERISTIC
/begin CHARACTERISTIC Ctd_ti_ad_fac_cor[4] "Factor used to calculate adaptation factor" VALUE 0xa0028f50 _REC_S1VAL_20_s2 1.333309575 _CNV_A_R_LINEAR_____136_CM -0.66666496 0.6666446150000001 FORMAT "%8.5" /end CHARACTERISTIC
/begin CHARACTERISTIC Ctd_ti_ad_ofs_cor[0] "Maximum value of learning for each zone" VALUE 0xa0028f54 _REC_S1VAL_20_s2 8191.875 _CNV_A_R_LINEAR_____137_CM -4096. 4095.875 FORMAT "%9.3" /end CHARACTERISTIC
/begin CHARACTERISTIC Ctd_ti_ad_ofs_cor[1] "Maximum value of learning for each zone" VALUE 0xa0028f56 _REC_S1VAL_20_s2 8191.875 _CNV_A_R_LINEAR_____137_CM -4096. 4095.875 FORMAT "%9.3" /end CHARACTERISTIC
/begin CHARACTERISTIC Ctd_ti_ad_ofs_cor[2] "Maximum value of learning for each zone" VALUE 0xa0028f58 _REC_S1VAL_20_s2 8191.875 _CNV_A_R_LINEAR_____137_CM -4096. 4095.875 FORMAT "%9.3" /end CHARACTERISTIC
/begin CHARACTERISTIC Ctd_ti_ad_ofs_cor[3] "Maximum value of learning for each zone" VALUE 0xa0028f5a _REC_S1VAL_20_s2 8191.875 _CNV_A_R_LINEAR_____137_CM -4096. 4095.875 FORMAT "%9.3" /end CHARACTERISTIC
/begin CHARACTERISTIC Ctd_ti_ad_ofs_cor[4] "Maximum value of learning for each zone" VALUE 0xa0028f5c _REC_S1VAL_20_s2 8191.875 _CNV_A_R_LINEAR_____137_CM -4096. 4095.875 FORMAT "%9.3" /end CHARACTERISTIC
/begin CHARACTERISTIC Ctd_ti_b_cor[0] "Factor used to calculate learning value" VALUE 0xa0020eb0 _REC_S1VAL_20_u1 0.498046875 _CNV_A_R_LINEAR_____138_CM 0. 0.498046875 FORMAT "%5.3" /end CHARACTERISTIC
/begin CHARACTERISTIC Ctd_ti_b_cor[1] "Factor used to calculate learning value" VALUE 0xa0020eb1 _REC_S1VAL_20_u1 0.498046875 _CNV_A_R_LINEAR_____138_CM 0. 0.498046875 FORMAT "%5.3" /end CHARACTERISTIC
/begin CHARACTERISTIC Ctd_ti_b_cor[2] "Factor used to calculate learning value" VALUE 0xa0020eb2 _REC_S1VAL_20_u1 0.498046875 _CNV_A_R_LINEAR_____138_CM 0. 0.498046875 FORMAT "%5.3" /end CHARACTERISTIC
/begin CHARACTERISTIC Ctd_ti_b_cor[3] "Factor used to calculate learning value" VALUE 0xa0020eb3 _REC_S1VAL_20_u1 0.498046875 _CNV_A_R_LINEAR_____138_CM 0. 0.498046875 FORMAT "%5.3" /end CHARACTERISTIC
/begin CHARACTERISTIC Ctd_ti_b_cor[4] "Factor used to calculate learning value" VALUE 0xa0020eb4 _REC_S1VAL_20_u1 0.498046875 _CNV_A_R_LINEAR_____138_CM 0. 0.498046875 FORMAT "%5.3" /end CHARACTERISTIC
/begin CHARACTERISTIC Cxx_ad_lamb_swi_ctr "Switch counter limit before adaptation calculation" VALUE 0xa0020eca _REC_S1VAL_20_u1 255. _CNV_A_R_ECME_LINEA_0_CM 0. 255. FORMAT "%3.0" /end CHARACTERISTIC
/begin CHARACTERISTIC Cxx_ad_off_ti_ad_fac "Adaptation factor in richness mode" VALUE 0xa0020ecb _REC_S1VAL_20_u1 0.6640625 _CNV_A_R_LINEAR_____103_CM 0.6666667 1.3307292 FORMAT "%5.3" /end CHARACTERISTIC
/begin CHARACTERISTIC Cxx_ad_off_ti_ad_ofs "Adaptation offset in richness mode" VALUE 0xa0020ecc _REC_S1VAL_20_s1 1020. _CNV_A_R_LINEAR_____102_CM -512. 508. FORMAT "%4.0" /end CHARACTERISTIC
/begin CHARACTERISTIC Cxx_cld_ad_nr "Number of learnings to refresh learning" VALUE 0xa0020eb6 _REC_S1VAL_20_u2 65535. _CNV_A_R_ECME_LINEA_0_CM 0. 65535. FORMAT "%5.0" /end CHARACTERISTIC
/begin CHARACTERISTIC Cxx_is_hot_tco_thd "Temperature threshold to declare that a long time has been spent in idle speed regulation with hot engine and with active richness regulation" VALUE 0xa0020eb8 _REC_S1VAL_20_u2 160. _CNV_A_R_LINEAR_____110_CM -40. 120. FORMAT "%5.1" /end CHARACTERISTIC
/begin CHARACTERISTIC Cxx_is_hot_ti_cl_dly "Time threshold to declare  that a long time has been spent in idle speed regulation with hot engine and with active richness regulation" VALUE 0xa0020eba _REC_S1VAL_20_u2 6553.5 _CNV_A_R_LINEAR_____58_CM 0. 6553.5 FORMAT "%6.1" /end CHARACTERISTIC
/begin CHARACTERISTIC Cxx_max_cld_fac_thd "Maximum threshold not to refresh adaptation factor" VALUE 0xa0020ecd _REC_S1VAL_20_u1 0.6640625 _CNV_A_R_LINEAR_____103_CM 0.6666667 1.3307292 FORMAT "%5.3" /end CHARACTERISTIC
/begin CHARACTERISTIC Cxx_max_cld_ofs_thd "Maximum threshold not to refresh adaptation offset" VALUE 0xa0020ece _REC_S1VAL_20_s1 1020. _CNV_A_R_LINEAR_____102_CM -512. 508. FORMAT "%4.0" /end CHARACTERISTIC
/begin CHARACTERISTIC Cxx_max_imd_ti_ad_fac "Maximum instantaneous value for the adaptation factor" VALUE 0xa0020ecf _REC_S1VAL_20_u1 0.6640625 _CNV_A_R_LINEAR_____103_CM 0.6666667 1.3307292 FORMAT "%5.3" /end CHARACTERISTIC
/begin CHARACTERISTIC Cxx_max_imd_ti_ad_ofs "Maximum instantaneous value for the adaptation offset" VALUE 0xa0020ed0 _REC_S1VAL_20_s1 1020. _CNV_A_R_LINEAR_____102_CM -512. 508. FORMAT "%4.0" /end CHARACTERISTIC
/begin CHARACTERISTIC Cxx_max_mv_ti_ad_fac "Maximum mean value for the adaptation factor" VALUE 0xa0020ed1 _REC_S1VAL_20_u1 0.6640625 _CNV_A_R_LINEAR_____103_CM 0.6666667 1.3307292 FORMAT "%5.3" /end CHARACTERISTIC
/begin CHARACTERISTIC Cxx_max_mv_ti_ad_ofs "Maximum mean value for the adaptation offset" VALUE 0xa0020ed2 _REC_S1VAL_20_s1 1020. _CNV_A_R_LINEAR_____102_CM -512. 508. FORMAT "%4.0" /end CHARACTERISTIC
/begin CHARACTERISTIC Cxx_min_ad_fac_thd "Minimum threshold to refresh adaptation factor" VALUE 0xa0020ed3 _REC_S1VAL_20_u1 0.6640625 _CNV_A_R_LINEAR_____106_CM 0. 0.6640625 FORMAT "%8.6" /end CHARACTERISTIC
/begin CHARACTERISTIC Cxx_min_ad_ofs_thd "Minimum threshold to refresh adaptation offset" VALUE 0xa0020ed4 _REC_S1VAL_20_u1 1020. _CNV_A_R_LINEAR_____102_CM 0. 1020. FORMAT "%4.0" /end CHARACTERISTIC
/begin CHARACTERISTIC Cxx_min_cld_fac_thd "Minimum threshold not to refresh adaptation factor" VALUE 0xa0020ed5 _REC_S1VAL_20_u1 0.6640625 _CNV_A_R_LINEAR_____103_CM 0.6666667 1.3307292 FORMAT "%5.3" /end CHARACTERISTIC
/begin CHARACTERISTIC Cxx_min_cld_ofs_thd "Minimum threshold not to refresh adaptation offset" VALUE 0xa0020ed6 _REC_S1VAL_20_s1 1020. _CNV_A_R_LINEAR_____102_CM -512. 508. FORMAT "%4.0" /end CHARACTERISTIC
/begin CHARACTERISTIC Cxx_min_dif_ti_b "Minimum learning values difference to update final learning value" VALUE 0xa0020ed7 _REC_S1VAL_20_u1 255. _CNV_A_R_ECME_LINEA_0_CM 0. 255. FORMAT "%3.0" /end CHARACTERISTIC
/begin CHARACTERISTIC Cxx_min_imd_ti_ad_fac "Minimum instantaneous value for the adaptation factor" VALUE 0xa0020ed8 _REC_S1VAL_20_u1 0.6640625 _CNV_A_R_LINEAR_____103_CM 0.6666667 1.3307292 FORMAT "%5.3" /end CHARACTERISTIC
/begin CHARACTERISTIC Cxx_min_imd_ti_ad_ofs "Minimum instantaneous value for the adaptation offset" VALUE 0xa0020ed9 _REC_S1VAL_20_s1 1020. _CNV_A_R_LINEAR_____102_CM -512. 508. FORMAT "%4.0" /end CHARACTERISTIC
/begin CHARACTERISTIC Cxx_min_mv_ti_ad_fac "Minimum mean value for the adaptation factor" VALUE 0xa0020eda _REC_S1VAL_20_u1 0.6640625 _CNV_A_R_LINEAR_____103_CM 0.6666667 1.3307292 FORMAT "%5.3" /end CHARACTERISTIC
/begin CHARACTERISTIC Cxx_min_mv_ti_ad_ofs "Minimum mean value for the adaptation offset" VALUE 0xa0020edb _REC_S1VAL_20_s1 1020. _CNV_A_R_LINEAR_____102_CM -512. 508. FORMAT "%4.0" /end CHARACTERISTIC
/begin CHARACTERISTIC Cxx_prs_zon "Pressure zone size (1, 2, 3)" VALUE 0xa0020ebc _REC_S1VAL_20_u2 20000. _CNV_A_R_LINEAR_____115_CM 0. 20000. FORMAT "%5.0" /end CHARACTERISTIC
/begin CHARACTERISTIC Cxx_prs_zon_st "Pressure first zone size (0)" VALUE 0xa0020ebe _REC_S1VAL_20_u2 20000. _CNV_A_R_LINEAR_____115_CM 0. 20000. FORMAT "%5.0" /end CHARACTERISTIC
/begin CHARACTERISTIC Cxx_ti_ad_max_n "Maximum engine speed threshold" VALUE 0xa0020ec0 _REC_S1VAL_20_u2 16383.75 _CNV_A_R_ENSD_LINEA_22_CM 0. 16383.75 FORMAT "%8.2" /end CHARACTERISTIC
/begin CHARACTERISTIC Cxx_ti_ad_prs_l_thd "Pressure down limit for the first zone" VALUE 0xa0020ec2 _REC_S1VAL_20_u2 20000. _CNV_A_R_LINEAR_____115_CM 0. 20000. FORMAT "%5.0" /end CHARACTERISTIC
/begin CHARACTERISTIC Cxx_ti_ad_prs_trs_thd "Pressure difference threshold limiting adaptation" VALUE 0xa0020ec4 _REC_S1VAL_20_u2 20000. _CNV_A_R_LINEAR_____115_CM 0. 20000. FORMAT "%5.0" /end CHARACTERISTIC
/begin CHARACTERISTIC Cxx_ti_ad_prs_up_thd "Pressure upper limit for the fifth zone" VALUE 0xa0020ec6 _REC_S1VAL_20_u2 20000. _CNV_A_R_LINEAR_____115_CM 0. 20000. FORMAT "%5.0" /end CHARACTERISTIC
/begin CHARACTERISTIC Cxx_ti_ad_tco_thd "Minimum water temperature to enable adaptation" VALUE 0xa0020ec8 _REC_S1VAL_20_u2 240. _CNV_A_R_LINEAR_____110_CM -40. 200. FORMAT "%5.1" /end CHARACTERISTIC
/begin CHARACTERISTIC Cxx_zon_dif_min_hys "Minimum hysteresis to refresh learnings" VALUE 0xa0020edc _REC_S1VAL_20_u1 255. _CNV_A_R_ECME_LINEA_0_CM 0. 255. FORMAT "%3.0" /end CHARACTERISTIC
/begin AXIS_PTS Ctb_eal "16 breakpoint table for Engine air load" 0xa002b7f4 Vxx_eal _REC_A2AXS_20_u2 3.99993896484375 _CNV_A_R_LINEAR_____53_CM 16 0. 3.99993896484375 FORMAT "%10.8" /end AXIS_PTS
/begin AXIS_PTS Ctb_sta_tco "Coolant temperature breakpoints for starting set point tables" 0xa002d498 Vxx_tco _REC_A2AXS_20_u2 240. _CNV_A_R_LINEAR_____110_CM 8 -40. 200. FORMAT "%5.1" /end AXIS_PTS
/begin AXIS_PTS Ctb_tco2 "Engine coolant temperature breakpoints" 0xa002d4d0 Vxx_tco _REC_A2AXS_20_u2 240. _CNV_A_R_LINEAR_____110_CM 9 -40. 200. FORMAT "%5.1" /end AXIS_PTS
/begin AXIS_PTS Ctb_n "20 programmable engine speed breakpoints map" 0xa002db74 Vxx_n _REC_A2AXS_20_u2 16383.75 _CNV_A_R_ENSD_LINEA_22_CM 20 0. 16383.75 FORMAT "%8.2" /end AXIS_PTS
/begin AXIS_PTS Ctb_n2 "9 programmable engine speed breakpoints table" 0xa002dba0 Vxx_n _REC_A2AXS_20_u2 16383.75 _CNV_A_R_ENSD_LINEA_22_CM 9 0. 16383.75 FORMAT "%8.2" /end AXIS_PTS
/begin COMPU_METHOD _CNV_A_R_ECME_LINEA_0_CM "" RAT_FUNC "%6.3" "-" COEFFS 0 1. 0. 0 0 1 /end COMPU_METHOD
/begin COMPU_METHOD _CNV_A_R_LINEAR_____2_CM "" RAT_FUNC "%6.3" "rpm" COEFFS 0 3.125e-002 0. 0 0 1 /end COMPU_METHOD
/begin COMPU_METHOD _CNV_S_2_RANGE______3_CM "" TAB_VERB "%6.3" "-" COMPU_TAB_REF _CNV_S_2_RANGE______3 /end COMPU_METHOD
/begin COMPU_VTAB _CNV_S_2_RANGE______3 "" TAB_VERB 2 0 "0" 1 "1" /end COMPU_VTAB
/begin COMPU_METHOD _CNV_A_R_LINEAR_____7_CM "" RAT_FUNC "%6.3" "-" COEFFS 0 65535.99999999996 0. 0 0 1 /end COMPU_METHOD
/begin COMPU_METHOD _CNV_A_R_ENSD_LINEA_22_CM "" RAT_FUNC "%6.3" "rpm" COEFFS 0 4. 0. 0 0 1 /end COMPU_METHOD
/begin COMPU_METHOD _CNV_A_R_LINEAR_____29_CM "" RAT_FUNC "%6.3" "-" COEFFS 0 256. 0. 0 0 1 /end COMPU_METHOD
/begin COMPU_METHOD _CNV_A_R_LINEAR_____32_CM "" RAT_FUNC "%6.3" "s" COEFFS 0 100. 0. 0 0 1 /end COMPU_METHOD
/begin COMPU_METHOD _CNV_A_R_LINEAR_____41_CM "" RAT_FUNC "%6.3" "°C" COEFFS 0 1.333333333333333 64. 0 0 1 /end COMPU_METHOD
/begin COMPU_METHOD _CNV_A_R_LINEAR_____42_CM "" RAT_FUNC "%6.3" "-" COEFFS 0 128. 0. 0 0 1 /end COMPU_METHOD
/begin COMPU_METHOD _CNV_A_R_LINEAR_____48_CM "" RAT_FUNC "%6.3" "-" COEFFS 0 32767.99999999992 0. 0 0 1 /end COMPU_METHOD
/begin COMPU_METHOD _CNV_A_R_LINEAR_____49_CM "" RAT_FUNC "%6.3" "m²" COEFFS 0 268432047.1860408 0. 0 0 1 /end COMPU_METHOD
/begin COMPU_METHOD _CNV_A_R_LINEAR_____50_CM "" RAT_FUNC "%6.3" "-" COEFFS 0 98304. 0. 0 0 1 /end COMPU_METHOD
/begin COMPU_METHOD _CNV_A_R_LINEAR_____51_CM "" RAT_FUNC "%6.3" "hPa" COEFFS 0 12.06017666543982 0. 0 0 1 /end COMPU_METHOD
/begin COMPU_METHOD _CNV_A_R_LINEAR_____52_CM "" RAT_FUNC "%6.3" "%" COEFFS 0 2.56 0. 0 0 1 /end COMPU_METHOD
/begin COMPU_METHOD _CNV_A_R_LINEAR_____53_CM "" RAT_FUNC "%6.3" "-" COEFFS 0 16384. 0. 0 0 1 /end COMPU_METHOD
/begin COMPU_METHOD _CNV_A_R_LINEAR_____54_CM "" RAT_FUNC "%6.3" "hPa" COEFFS 0 4. 164. 0 0 1 /end COMPU_METHOD
/begin COMPU_METHOD _CNV_A_R_LINEAR_____55_CM "" RAT_FUNC "%6.3" "kg/h" COEFFS 0 8192. 0. 0 0 1 /end COMPU_METHOD
/begin COMPU_METHOD _CNV_A_R_LINEAR_____56_CM "" RAT_FUNC "%6.3" "kg/h" COEFFS 0 32. 0. 0 0 1 /end COMPU_METHOD
/begin COMPU_METHOD _CNV_S_9_EVAM_RANGE_57_CM "" TAB_VERB "%6.3" "-" COMPU_TAB_REF _CNV_S_9_EVAM_RANGE_57 /end COMPU_METHOD
/begin COMPU_VTAB _CNV_S_9_EVAM_RANGE_57 "" TAB_VERB 9 0 "CP_NOT_ACTIVE" 1 "NO_PURGE" 2 "RAMP_TO_NO_PURGE" 3 "WAIT_RAMP_OPEN" 4 "MIN_PURGE" 8 "RAMP_OPEN" 9 "RAMP_OPEN_FAST" 10 "MAX_PURGE" 11 "RAMP_CLOSE" /end COMPU_VTAB
/begin COMPU_METHOD _CNV_A_R_LINEAR_____58_CM "" RAT_FUNC "%6.3" "s" COEFFS 0 10. 0. 0 0 1 /end COMPU_METHOD
/begin COMPU_METHOD _CNV_A_R_LINEAR_____59_CM "" RAT_FUNC "%6.3" "V" COEFFS 0 51.2 0. 0 0 1 /end COMPU_METHOD
/begin COMPU_METHOD _CNV_A_R_LINEAR_____60_CM "" RAT_FUNC "%6.3" "-" COEFFS 0 98304. -49152. 0 0 1 /end COMPU_METHOD
/begin COMPU_METHOD _CNV_A_R_LINEAR_____61_CM "" RAT_FUNC "%6.3" "hPa" COEFFS 0 800. 0. 0 0 1 /end COMPU_METHOD
/begin COMPU_METHOD _CNV_S_16_RANGE_ERR__62_CM "" TAB_VERB "%6.3" "-" COMPU_TAB_REF _CNV_S_16_RANGE_ERR__62 /end COMPU_METHOD
/begin COMPU_VTAB _CNV_S_16_RANGE_ERR__62 "" TAB_VERB 16 0 "NO_SYM" 1 "SYM_0" 2 "SYM_1" 3 "SYM_0, SYM_1" 4 "SYM_2" 5 "SYM_0, SYM_2" 6 "SYM_1, SYM_2" 7 "SYM_0, SYM_1, SYM_2" 8 "SYM_3" 9 "SYM_0, SYM_3" 10 "SYM_1, SYM_3" 11 "SYM_0, SYM_1,SYM_3" 12 "SYM_2, SYM_3" 13 "SYM_0, SYM_2, SYM_3" 14 "SYM_1, SYM_2, SYM_3" 15 "SYM_0, SYM_1, SYM_2, SYM_3" /end COMPU_VTAB
/begin COMPU_METHOD _CNV_A_R_EVAM_LINEA_63_CM "" RAT_FUNC "%6.3" "mm" COEFFS 0 61.78822389144658 0. 0 0 1 /end COMPU_METHOD
/begin COMPU_METHOD _CNV_P_3_EVAM_LINEA_I_64_CM "" TAB_INTP "%6.3" "hPa" COMPU_TAB_REF _CNV_P_3_EVAM_LINEA_I_64 /end COMPU_METHOD
/begin COMPU_TAB _CNV_P_3_EVAM_LINEA_I_64 "" TAB_INTP 3 -32768 -40.96 0 0. 32767 40.96 /end COMPU_TAB
/begin COMPU_METHOD _CNV_A_R_LINEAR_____65_CM "" RAT_FUNC "%6.3" "l" COEFFS 0 1. 0. 0 0 1 /end COMPU_METHOD
/begin COMPU_METHOD _CNV_P_3_EVAM_LINEA_I_66_CM "" TAB_INTP "%6.3" "hPa" COMPU_TAB_REF _CNV_P_3_EVAM_LINEA_I_66 /end COMPU_METHOD
/begin COMPU_TAB _CNV_P_3_EVAM_LINEA_I_66 "" TAB_INTP 3 0 -40.96 32768 0. 65535 40.96 /end COMPU_TAB
/begin COMPU_METHOD _CNV_A_R_EVAM_LINEA_67_CM "" RAT_FUNC "%6.3" "s" COEFFS 0 20. 0. 0 0 1 /end COMPU_METHOD
/begin COMPU_METHOD _CNV_A_R_LINEAR_____68_CM "" RAT_FUNC "%6.3" "s" COEFFS 0 1. 0. 0 0 1 /end COMPU_METHOD
/begin COMPU_METHOD _CNV_A_R_LINEAR_____69_CM "" RAT_FUNC "%6.3" "V" COEFFS 0 2732.24043715847 0. 0 0 1 /end COMPU_METHOD
/begin COMPU_METHOD _CNV_A_R_LINEAR_____70_CM "" RAT_FUNC "%6.3" "V" COEFFS 0 204.8 0. 0 0 1 /end COMPU_METHOD
/begin COMPU_METHOD _CNV_A_R_LINEAR_____71_CM "" RAT_FUNC "%6.3" "km/h" COEFFS 0 1. 0. 0 0 1 /end COMPU_METHOD
/begin COMPU_METHOD _CNV_A_R_EVAM_LINEA_73_CM "" RAT_FUNC "%6.3" "dm²" COEFFS 0 48616468.84272997 0. 0 0 1 /end COMPU_METHOD
/begin COMPU_METHOD _CNV_A_R_LINEAR_____74_CM "" RAT_FUNC "%6.3" "%" COEFFS 0 655.3599999999997 32767.99999999999 0 0 1 /end COMPU_METHOD
/begin COMPU_METHOD _CNV_A_R_EVAM_LINEA_75_CM "" RAT_FUNC "%6.3" "-" COEFFS 0 140331.9057815846 0. 0 0 1 /end COMPU_METHOD
/begin COMPU_METHOD _CNV_A_R_LINEAR_____76_CM "" RAT_FUNC "%6.3" "l" COEFFS 0 2.56 0. 0 0 1 /end COMPU_METHOD
/begin COMPU_METHOD _CNV_A_R_LINEAR_____77_CM "" RAT_FUNC "%6.3" "mg/stk" COEFFS 0 0.183585313174946 0. 0 0 1 /end COMPU_METHOD
/begin COMPU_METHOD _CNV_A_R_EVAM_LINEA_78_CM "" RAT_FUNC "%6.3" "(hpa)½" COEFFS 0 1891.833376634624 0. 0 0 1 /end COMPU_METHOD
/begin COMPU_METHOD _CNV_P_3_EVAM_LINEA_I_79_CM "" TAB_INTP "%6.3" "(hpa)½" COMPU_TAB_REF _CNV_P_3_EVAM_LINEA_I_79 /end COMPU_METHOD
/begin COMPU_TAB _CNV_P_3_EVAM_LINEA_I_79 "" TAB_INTP 3 0 -6.377 32768 0. 65535 6.377 /end COMPU_TAB
/begin COMPU_METHOD _CNV_A_R_LINEAR_____80_CM "" RAT_FUNC "%6.3" "mg/stk" COEFFS 0 47.18142548596112 0. 0 0 1 /end COMPU_METHOD
/begin COMPU_METHOD _CNV_P_3_EVAM_LINEA_I_81_CM "" TAB_INTP "%6.3" "-" COMPU_TAB_REF _CNV_P_3_EVAM_LINEA_I_81 /end COMPU_METHOD
/begin COMPU_TAB _CNV_P_3_EVAM_LINEA_I_81 "" TAB_INTP 3 -2147483648 -417900. 0 0. 2147483647 417900. /end COMPU_TAB
/begin COMPU_METHOD _CNV_A_R_LINEAR_____82_CM "" RAT_FUNC "%6.3" "%" COEFFS 0 655.3599999999997 -1.455191522836685e-011 0 0 1 /end COMPU_METHOD
/begin COMPU_METHOD _CNV_A_R_LINEAR_____83_CM "" RAT_FUNC "%6.3" "-" COEFFS 0 64. 0. 0 0 1 /end COMPU_METHOD
/begin COMPU_METHOD _CNV_P_3_EVAM_LINEA_I_84_CM "" TAB_INTP "%6.3" "kg/h" COMPU_TAB_REF _CNV_P_3_EVAM_LINEA_I_84 /end COMPU_METHOD
/begin COMPU_TAB _CNV_P_3_EVAM_LINEA_I_84 "" TAB_INTP 3 -32768 -8. 0 0. 32767 7.99976 /end COMPU_TAB
/begin COMPU_METHOD _CNV_S_17_EVAM_RANGE_85_CM "" TAB_VERB "%6.3" "-" COMPU_TAB_REF _CNV_S_17_EVAM_RANGE_85 /end COMPU_METHOD
/begin COMPU_VTAB _CNV_S_17_EVAM_RANGE_85 "" TAB_VERB 17 0 "ST" 1 "PRS_DYN" 2 "CLOSE_CPS" 3 "DLY_SOV" 4 "DLY_PRS_COR" 5 "PRS_COR_BEG" 6 "DTP_COR" 7 "PRS_EVAC_BEG" 8 "DTP_EVAC" 9 "DLY_DIAG" 10 "DTP_DIAG" 11 "DLY_VAP_CHK" 12 "VAP_CHK" 13 "PAS_DIAGCP" 14 "ERR_CLOSE_CPS" 15 "T_DLY_3" 16 "STOP_DIAGCP" /end COMPU_VTAB
/begin COMPU_METHOD _CNV_S_3_EVAM_RANGE_86_CM "" TAB_VERB "%6.3" "-" COMPU_TAB_REF _CNV_S_3_EVAM_RANGE_86 /end COMPU_METHOD
/begin COMPU_VTAB _CNV_S_3_EVAM_RANGE_86 "" TAB_VERB 3 0 "EOL_PAS" 1 "EOL_ACT" 2 "EOL_READY" /end COMPU_VTAB
/begin COMPU_METHOD _CNV_P_3_EVAM_LINEA_I_87_CM "" TAB_INTP "%6.3" "hPa/s" COMPU_TAB_REF _CNV_P_3_EVAM_LINEA_I_87 /end COMPU_METHOD
/begin COMPU_TAB _CNV_P_3_EVAM_LINEA_I_87 "" TAB_INTP 3 -32768 -409.6 0 0. 32767 409.6 /end COMPU_TAB
/begin COMPU_METHOD _CNV_A_R_LINEAR_____88_CM "" RAT_FUNC "%6.3" "-" COEFFS 0 8192. 0. 0 0 1 /end COMPU_METHOD
/begin COMPU_METHOD _CNV_P_3_EVAM_LINEA_I_89_CM "" TAB_INTP "%6.3" "hPa/s" COMPU_TAB_REF _CNV_P_3_EVAM_LINEA_I_89 /end COMPU_METHOD
/begin COMPU_TAB _CNV_P_3_EVAM_LINEA_I_89 "" TAB_INTP 3 0 -51.2 32768 0. 65535 51.2 /end COMPU_TAB
/begin COMPU_METHOD _CNV_P_3_EVAM_LINEA_I_90_CM "" TAB_INTP "%6.3" "hPa/s" COMPU_TAB_REF _CNV_P_3_EVAM_LINEA_I_90 /end COMPU_METHOD
/begin COMPU_TAB _CNV_P_3_EVAM_LINEA_I_90 "" TAB_INTP 3 -32768 -51.2 0 0. 32767 51.2 /end COMPU_TAB
/begin COMPU_METHOD _CNV_A_R_EVAM_LINEA_91_CM "" RAT_FUNC "%6.3" "hPa/s" COEFFS 0 79.998779296875 0. 0 0 1 /end COMPU_METHOD
/begin COMPU_METHOD _CNV_S_3_EVAM_RANGE_92_CM "" TAB_VERB "%6.3" "-" COMPU_TAB_REF _CNV_S_3_EVAM_RANGE_92 /end COMPU_METHOD
/begin COMPU_VTAB _CNV_S_3_EVAM_RANGE_92 "" TAB_VERB 3 0 "NOISE_START" 1 "NOISE_OK" 2 "NOISE_NOK" /end COMPU_VTAB
/begin COMPU_METHOD _CNV_A_R_EVAM_LINEA_93_CM "" RAT_FUNC "%6.3" "hPa" COEFFS 0 799.9755859375 0. 0 0 1 /end COMPU_METHOD
/begin COMPU_METHOD _CNV_A_R_LINEAR_____94_CM "" RAT_FUNC "%6.3" "hPa" COEFFS 0 12.06017666543982 -4.001776687800884e-011 0 0 1 /end COMPU_METHOD
/begin COMPU_METHOD _CNV_A_R_LINEAR_____95_CM "" RAT_FUNC "%6.3" "min" COEFFS 0 1. 0. 0 0 1 /end COMPU_METHOD
/begin COMPU_METHOD _CNV_P_3_EVAM_LINEA_I_96_CM "" TAB_INTP "%6.3" "°C" COMPU_TAB_REF _CNV_P_3_EVAM_LINEA_I_96 /end COMPU_METHOD
/begin COMPU_TAB _CNV_P_3_EVAM_LINEA_I_96 "" TAB_INTP 3 -128 -96. 0 0. 127 95.25 /end COMPU_TAB
/begin COMPU_METHOD _CNV_A_R_LINEAR_____97_CM "" RAT_FUNC "%6.3" "°C" COEFFS 0 1.333333333333333 0. 0 0 1 /end COMPU_METHOD
/begin COMPU_METHOD _CNV_A_R_LINEAR_____98_CM "" RAT_FUNC "%6.3" "°C" COEFFS 0 341.3333333333333 16384. 0 0 1 /end COMPU_METHOD
/begin COMPU_METHOD _CNV_A_R_LINEAR_____99_CM "" RAT_FUNC "%6.3" "-" COEFFS 0 98304.00002810937 7.275957614183426e-012 0 0 1 /end COMPU_METHOD
/begin COMPU_METHOD _CNV_A_R_LINEAR_____100_CM "" RAT_FUNC "%6.3" "-" COEFFS 0 98303.99999999926 -65535.99344639951 0 0 1 /end COMPU_METHOD
/begin COMPU_METHOD _CNV_A_R_LINEAR_____101_CM "" RAT_FUNC "%6.3" "TDC" COEFFS 0 1. 0. 0 0 1 /end COMPU_METHOD
/begin COMPU_METHOD _CNV_A_R_LINEAR_____102_CM "" RAT_FUNC "%6.3" "µs" COEFFS 0 0.25 0. 0 0 1 /end COMPU_METHOD
/begin COMPU_METHOD _CNV_A_R_LINEAR_____103_CM "" RAT_FUNC "%6.3" "[-]" COEFFS 0 384. -256.0000128 0 0 1 /end COMPU_METHOD
/begin COMPU_METHOD _CNV_A_R_LINEAR_____104_CM "" RAT_FUNC "%6.3" "-" COEFFS 0 192. -127.9999872 0 0 1 /end COMPU_METHOD
/begin COMPU_METHOD _CNV_A_R_A_105_CM "" RAT_FUNC "%6.3" "" COEFFS 0 1. 0. 0 0 1 /end COMPU_METHOD
/begin COMPU_METHOD _CNV_A_R_LINEAR_____106_CM "" RAT_FUNC "%6.3" "-" COEFFS 0 384. 0. 0 0 1 /end COMPU_METHOD
/begin COMPU_METHOD _CNV_A_R_LINEAR_____107_CM "" RAT_FUNC "%6.3" "mV" COEFFS 0 1. 0. 0 0 1 /end COMPU_METHOD
/begin COMPU_METHOD _CNV_A_R_LINEAR_____108_CM "" RAT_FUNC "%6.3" "-" COEFFS 0 98304.00002810937 32768.00000000001 0 0 1 /end COMPU_METHOD
/begin COMPU_METHOD _CNV_A_R_LINEAR_____109_CM "" RAT_FUNC "%6.3" "-" COEFFS 0 768. 0. 0 0 1 /end COMPU_METHOD
/begin COMPU_METHOD _CNV_A_R_LINEAR_____110_CM "" RAT_FUNC "%6.3" "°C" COEFFS 0 10. 400. 0 0 1 /end COMPU_METHOD
/begin COMPU_METHOD _CNV_A_R_LINEAR_____111_CM "" RAT_FUNC "%6.3" "%" COEFFS 0 0.1 0. 0 0 1 /end COMPU_METHOD
/begin COMPU_METHOD _CNV_A_R_LINEAR_____112_CM "" RAT_FUNC "%6.3" "-" COEFFS 0 2560. 0. 0 0 1 /end COMPU_METHOD
/begin COMPU_METHOD _CNV_A_R_LINEAR_____113_CM "" RAT_FUNC "%6.3" "-" COEFFS 0 500. 0. 0 0 1 /end COMPU_METHOD
/begin COMPU_METHOD _CNV_A_R_LINEAR_____114_CM "" RAT_FUNC "%6.3" "mg" COEFFS 0 10. 0. 0 0 1 /end COMPU_METHOD
/begin COMPU_METHOD _CNV_A_R_LINEAR_____115_CM "" RAT_FUNC "%6.3" "hPa" COEFFS 0 1. 0. 0 0 1 /end COMPU_METHOD
/begin COMPU_METHOD _CNV_A_R_LINEAR_____116_CM "" RAT_FUNC "%6.3" "s" COEFFS 0 1000. 0. 0 0 1 /end COMPU_METHOD
/begin COMPU_METHOD _CNV_A_R_LINEAR_____117_CM "" RAT_FUNC "%6.3" "1/mV" COEFFS 0 256000000. 0. 0 0 1 /end COMPU_METHOD
/begin COMPU_METHOD _CNV_A_R_LINEAR_____118_CM "" RAT_FUNC "%6.3" "1/mV" COEFFS 0 853333.3333333334 0. 0 0 1 /end COMPU_METHOD
/begin COMPU_METHOD _CNV_A_R_LINEAR_____119_CM "" RAT_FUNC "%6.3" "-" COEFFS 0 98304.07286516584 65535. 0 0 1 /end COMPU_METHOD
/begin COMPU_METHOD _CNV_S_14_RANGE_STAT_120_CM "" TAB_VERB "%6.3" "" COMPU_TAB_REF _CNV_S_14_RANGE_STAT_120 /end COMPU_METHOD
/begin COMPU_VTAB _CNV_S_14_RANGE_STAT_120 "" TAB_VERB 14 0 "CL_CATA_DIAG" 1 "CL_INI" 2 "CL_LEAN" 4 "CL_LEAN_INI" 8 "CL_LEAN_LEAN" 16 "CL_LEAN_LEAN_SLOP" 32 "CL_LEAN_RICH" 64 "CL_LEAN_RICH_SLOP" 128 "CL_LEAN_SLOP" 256 "CL_OFF" 512 "CL_RICH" 1024 "CL_RICH_SLOP" 2048 "CL_BAR_LEAN" 4096 "CL_BAR_RICH" /end COMPU_VTAB
/begin COMPU_METHOD _CNV_A_R_LINEAR_____121_CM "" RAT_FUNC "%6.3" "-" COEFFS 0 384.0000000001926 -5.684341886080802e-014 0 0 1 /end COMPU_METHOD
/begin COMPU_METHOD _CNV_A_R_LINEAR_____122_CM "" RAT_FUNC "%6.3" "-" COEFFS 0 32. -32. 0 0 1 /end COMPU_METHOD
/begin COMPU_METHOD _CNV_A_R_LINEAR_____123_CM "" RAT_FUNC "%6.3" "-" COEFFS 0 100. 0. 0 0 1 /end COMPU_METHOD
/begin COMPU_METHOD _CNV_A_R_LINEAR_____124_CM "" RAT_FUNC "%6.3" "min/rev" COEFFS 0 50331647.99960405 0. 0 0 1 /end COMPU_METHOD
/begin COMPU_METHOD _CNV_A_R_LINEAR_____125_CM "" RAT_FUNC "%6.3" "km/h" COEFFS 0 100. 0. 0 0 1 /end COMPU_METHOD
/begin COMPU_METHOD _CNV_A_R_LINEAR_____126_CM "" RAT_FUNC "%6.3" "-" COEFFS 0 192. 0. 0 0 1 /end COMPU_METHOD
/begin COMPU_METHOD _CNV_A_R_LINEAR_____127_CM "" RAT_FUNC "%6.3" "1/°CRK" COEFFS 0 16384. 0. 0 0 1 /end COMPU_METHOD
/begin COMPU_METHOD _CNV_A_R_LINEAR_____128_CM "" RAT_FUNC "%6.3" "mg/stk" COEFFS 0 6.103515625 0. 0 0 1 /end COMPU_METHOD
/begin COMPU_METHOD _CNV_A_R_LINEAR_____129_CM "" RAT_FUNC "%6.3" "°CRK" COEFFS 0 50. 0. 0 0 1 /end COMPU_METHOD
/begin COMPU_METHOD _CNV_A_R_LINEAR_____130_CM "" RAT_FUNC "%6.3" "-" COEFFS 0 256. -1. 0 0 1 /end COMPU_METHOD
/begin COMPU_METHOD _CNV_A_R_LINEAR_____131_CM "" RAT_FUNC "%6.3" "s" COEFFS 0 50. 0. 0 0 1 /end COMPU_METHOD
/begin COMPU_METHOD _CNV_A_R_LINEAR_____132_CM "" RAT_FUNC "%6.3" "-" COEFFS 0 499.9999999999999 0. 0 0 1 /end COMPU_METHOD
/begin COMPU_METHOD _CNV_A_R_LINEAR_____133_CM "" RAT_FUNC "%6.3" "mg/stk" COEFFS 0 390.625 0. 0 0 1 /end COMPU_METHOD
/begin COMPU_METHOD _CNV_A_R_LINEAR_____134_CM "" RAT_FUNC "%6.3" "mg" COEFFS 0 7.281777777776513 0. 0 0 1 /end COMPU_METHOD
/begin COMPU_METHOD _CNV_A_R_LINEAR_____135_CM "" RAT_FUNC "%6.3" "mg/stk" COEFFS 0 390.6250098679799 1.820735633373261e-007 0 0 1 /end COMPU_METHOD
/begin COMPU_METHOD _CNV_A_R_LINEAR_____136_CM "" RAT_FUNC "%6.3" "[-]" COEFFS 0 49152.12582944213 0. 0 0 1 /end COMPU_METHOD
/begin COMPU_METHOD _CNV_A_R_LINEAR_____137_CM "" RAT_FUNC "%6.3" "µs" COEFFS 0 8. 0. 0 0 1 /end COMPU_METHOD
/begin COMPU_METHOD _CNV_A_R_LINEAR_____138_CM "" RAT_FUNC "%6.3" "1/µs" COEFFS 0 512. 0. 0 0 1 /end COMPU_METHOD
/begin RECORD_LAYOUT _REC_S1VAL_20_u1 FNC_VALUES 1 UBYTE COLUMN_DIR DIRECT /end RECORD_LAYOUT
/begin RECORD_LAYOUT _REC_A2AXS_20_u1 NO_AXIS_PTS_X 1 UBYTE AXIS_PTS_X 2 UBYTE INDEX_INCR DIRECT /end RECORD_LAYOUT
/begin RECORD_LAYOUT _REC_S1VAL_20_u2 FNC_VALUES 1 UWORD COLUMN_DIR DIRECT /end RECORD_LAYOUT
/begin RECORD_LAYOUT _REC_S1VAL_20_s2 FNC_VALUES 1 SWORD COLUMN_DIR DIRECT /end RECORD_LAYOUT
/begin RECORD_LAYOUT _REC_A2AXS_20_u2 NO_AXIS_PTS_X 1 UWORD AXIS_PTS_X 2 UWORD INDEX_INCR DIRECT /end RECORD_LAYOUT
/begin RECORD_LAYOUT _REC_A1CUR_20_u1_u2 FNC_VALUES 1 UBYTE COLUMN_DIR DIRECT /end RECORD_LAYOUT
/begin RECORD_LAYOUT _REC_A1CUR_20_u1_u1 FNC_VALUES 1 UBYTE COLUMN_DIR DIRECT /end RECORD_LAYOUT
/begin RECORD_LAYOUT _REC_A1CUR_20_u2_u1 FNC_VALUES 1 UWORD COLUMN_DIR DIRECT /end RECORD_LAYOUT
/begin RECORD_LAYOUT _REC_A1MAP_20_u2_u1_u1 FNC_VALUES 1 UWORD COLUMN_DIR DIRECT /end RECORD_LAYOUT
/begin RECORD_LAYOUT _REC_A1MAP_20_u2_u2_u2 FNC_VALUES 1 UWORD COLUMN_DIR DIRECT /end RECORD_LAYOUT
/begin RECORD_LAYOUT _REC_A1CUR_20_u2_u2 FNC_VALUES 1 UWORD COLUMN_DIR DIRECT /end RECORD_LAYOUT
/begin RECORD_LAYOUT _REC_A1MAP_20_u2_u2_u1 FNC_VALUES 1 UWORD COLUMN_DIR DIRECT /end RECORD_LAYOUT
/begin RECORD_LAYOUT _REC_A1MAP_20_u1_u1_u2 FNC_VALUES 1 UBYTE COLUMN_DIR DIRECT /end RECORD_LAYOUT
/begin RECORD_LAYOUT _REC_S1VAL_20_s1 FNC_VALUES 1 SBYTE COLUMN_DIR DIRECT /end RECORD_LAYOUT
/begin RECORD_LAYOUT _REC_A1MAP_20_u1_u2_u2 FNC_VALUES 1 UBYTE COLUMN_DIR DIRECT /end RECORD_LAYOUT
/begin FUNCTION EVAM_system_monitoring ""
 /begin DEF_CHARACTERISTIC ldp_amp_ip_amp_sqrt ldp_ar_leak_diagcp ldp_dtp_ip_dtp_mdl_diagcp ldp_dtp_mff_ip_mff_diagcp ldp_fac_lam_dif_diagcp_ip_diagcp ldp_fac_mdl_bas_estim_diagcp ldp_ftl_vol_cor_diagcp ldp_ftl_vol_estim_diagcp ldp_maf_ip_cl_crlc_ramp_open ldp_n_32_ip_cl_crlc_ramp_open ldp_tam_ip_fac_mdl_estim_diagcp ldp_tam_ip_fac_tam_diagcp ip_amp_sqrt ip_cl_crlc_ramp_open_vap_chk ip_dtp_mdl_diagcp ip_fac_mdl_estim_diagcp ip_fac_sqrt_ar_leak_diagcp ip_fac_tam_diagcp ip_flow_cps_sp_vap_chk ip_ftl_vol_cor_diagcp ip_mff_add_dtp_diagcp ip_mff_add_lam_diagcp c_cl_max_vap_chk c_cl_mmv_end_diagcp c_cl_mmv_grd_max_vap_chk c_cl_vap_chk_max c_ctr_cyc_cdn_diagcp c_ctr_cyc_diagcp_max c_ctr_cyc_intr_diagcp_max c_diam_diagcp_max_vap_chk c_diam_diagcp_min_vap_chk c_dtp_diagcp c_dtp_dif_diagcp c_dtp_max_rec_diagcp c_dtp_mv_min_diagcp c_dtp_slop_end_min c_fac_lam_cor_fil_diagcp c_fac_lam_cor_max_vap_chk c_fac_lam_cor_min_vap_chk c_fac_lam_diagcp_as c_fac_lam_dif_diagcp c_fac_lam_dif_diagcp_max c_fac_lam_fil_diagcp c_fac_lam_max_vap_chk c_fac_lam_min_diagcp c_fac_lam_min_vap_chk c_fac_mdl_bas_diagcp_max c_fac_mdl_bas_diagcp_max_eol c_fac_mdl_bas_diagcp_min c_fac_mdl_bas_diagcp_min_eol c_fac_mdl_bas_diagcp_vap_chk c_fac_mff_add_ofs_diagcp c_fac_ti_diagcp c_fac_ti_vap_chk_diagcp_1 c_fac_ti_vap_chk_diagcp_2 c_flow_cps_sp_dec_diagcp c_flow_cps_sp_dec_vap_chk c_flow_cps_sp_diagcp c_flow_cps_sp_inc_diagcp c_flow_cps_sp_inc_vap_chk c_ftl_max c_ftl_min c_maf_mmv_crlc_diagcp c_maf_mmv_diagcp c_mff_add_diagcp_vap_max c_mff_add_step_diagcp c_state_conf_diagcp c_t_1_diagcp c_t_2_diagcp c_t_close_cps_diagcp c_t_dly_3_diagcp c_t_dly_close_sov_diagcp c_t_dly_cor_beg_diagcp c_t_dly_eol_diagcp c_t_dly_vap_chk c_t_dtp_grd_vap_chk c_t_max_cps c_t_max_cps_vap_chk c_t_mff_add_diagcp_1 c_t_mff_add_diagcp_2 c_t_mff_add_diagcp_3 c_t_mff_add_diagcp_4 lc_diagcp_cbk /end DEF_CHARACTERISTIC
 /begin OUT_MEASUREMENT ar_leak_diagcp cl_mmv_vap_chk cl_mmv_vap_chk_grd cl_mmv_vap_chk_grd_sum cl_vap_chk cl_vap_chk_tmp ctr_cyc_cdn_diagcp ctr_cyc_diagcp ctr_cyc_intr_diagcp ctr_sum_dtp diam_diagcp diam_diagcp_mod_6 dtp_dif_act_mod_6 dtp_mff dtp_mff_add_diagcp_ofs dtp_tot_dif_bas dtp_tot_dif_diag dtp_tot_sum fac_lam_0_cp_vap_chk fac_lam_cor_mmv_diagcp fac_lam_diagcp[0] fac_lam_dif_cp_vap_chk fac_lam_dif_diagcp fac_lam_sp_diagcp fac_mdl_bas_diagcp fac_mdl_diag_diagcp fac_mdl_end_diagcp fac_mdl_estim_diagcp fac_ti_vap_chk_diagcp flow_sp_cps_evap ftl_vol_cor_diagcp lv_diagcp_act lv_diagcp_cdn_not_ok lv_diagcp_chk_mpl lv_diagcp_cps_act lv_diagcp_end lv_diagcp_req_wait lv_fac_diagcp_mdl lv_fac_lam_diagcp lv_fac_lam_diagcp_cmpl lv_mff_add_ofs_end lv_sov_req lv_vap_chk_end maf_mmv_diagcp mff_add_dec_diagcp mff_add_diagcp mff_add_dtp_diagcp mff_add_dtp_ofs_diagcp mff_add_lam_diagcp mff_add_ofs_diagcp mff_vap_chk_diagcp state_diagcp state_eol_diagcp state_intr_diagcp t_diagcp t_dly_eol_diagcp t_dtp_grd_vap_chk t_mff_add_dly_1_diagcp t_mff_add_dly_1_diagcp_ofs t_mff_add_dly_2_diagcp_ofs t_vap_chk vs_max_diagcp /end OUT_MEASUREMENT
/end FUNCTION
/begin FUNCTION EVAM_DTP_calculation_for_monitoring ""
 /begin DEF_CHARACTERISTIC ldp_dtp_grd ldp_fac_mdl_bas_diagcp ldp_ftl_diagcp_ip_ftl_diagcp ip_fac_ftl_vol_estim_diagcp ip_ftl_diagcp ip_ftl_vol_estim_diagcp c_dtp_bas_cor c_dtp_diagcp_hys_neg c_dtp_diagcp_hys_pos c_dtp_dif_max_diagcp c_dtp_dyw_1 c_dtp_dyw_2 c_dtp_dyw_3 c_dtp_dyw_4 c_dtp_max_dif_slop_mmv c_dtp_mmv_crlc c_dtp_slop_end_max c_dtp_slop_mmv_crlc c_prs_max_dyn_diagcp c_prs_min_dyn_diagcp c_t_1_dif_diagcp c_t_2_dif_diagcp c_t_dtp_grd_diagcp c_t_max_fac_slop_mmv /end DEF_CHARACTERISTIC
 /begin OUT_MEASUREMENT ctr_dtp_max_rec_diagcp dtp dtp_beg_diagcp dtp_cor dtp_dif_act dtp_dif_act_grd_diagcp dtp_dif_cor dtp_dif_cor_mod_6 dtp_dif_dyw dtp_dif_fuc_miss_diag dtp_dif_fuc_miss_diag_mod_6 dtp_dif_prs_dyn dtp_dif_prs_dyn_mod_6 dtp_grd dtp_max dtp_min dtp_mmv dtp_mv dtp_mv_dyw dtp_mv_fuc_miss_diag dtp_mv_mod_6 dtp_mv_per dtp_ofs dtp_slop dtp_slop_end dtp_slop_mmv dtp_slop_mmv_dif dtp_slop_mmv_max dtp_slop_mmv_min ftl_vol_estim_diagcp lv_dtp_diagcp_lim_dyn lv_dtp_slop state_cdn_dtp_noise_diagcp t_dtp_grd_diagcp t_prs_max_dyn_diagcp t_prs_min_dyn_diagcp /end OUT_MEASUREMENT
/end FUNCTION
/begin FUNCTION EVAM_error_interface_management ""
 /begin DEF_CHARACTERISTIC c_diam_diagcp_max c_diam_diagcp_min c_diam_diagcp_min_eol c_dtp_dif_cps_diagcp c_dtp_dif_min_diagcp lc_diagcp_slop lc_fmy_act_fuc_miss_diag /end DEF_CHARACTERISTIC
 /begin OUT_MEASUREMENT dtp_fuc_miss_1_thd_mod_6 err_sym_evap_leak_1 err_sym_evap_leak_10 err_sym_evap_leak_2 err_sym_fuc_miss err_sym_fuc_miss_1 err_sym_mec_open_cps lv_cdn_diag_evap_leak_1 lv_cdn_diag_evap_leak_10 lv_cdn_diag_evap_leak_2 lv_cdn_diag_fuc_miss lv_cdn_diag_fuc_miss_1 lv_cdn_diag_mec_open_cps lv_diagcp_cdn_not_ok_pas lv_end_diag_evap_leak_10 lv_end_diag_evap_leak_2 lv_end_diag_fuc_miss lv_end_diag_fuc_miss_1 lv_err_diagcp_2 lv_err_evap_leak_1 lv_err_evap_leak_10 lv_err_evap_leak_2 lv_err_fuc_miss lv_err_fuc_miss_1 lv_err_mec_open_cps /end OUT_MEASUREMENT
/end FUNCTION
/begin FUNCTION EVAM_fuel_cap_missing_diagnosis ""
 /begin DEF_CHARACTERISTIC ldp_dtp_thd_fuc_miss ip_dtp_thd_fuc_miss c_nr_cyc_fuc_miss_diag_max c_nr_cyc_intr_fuc_miss_diag c_t_dly_1_fuc_miss_diag c_t_dly_2_fuc_miss_diag c_t_dly_3_fuc_miss_diag c_t_dly_4_fuc_miss_diag /end DEF_CHARACTERISTIC
 /begin OUT_MEASUREMENT ctr_cyc_fuc_miss_diag ctr_cyc_fuc_miss_intr_diag lv_fuc_miss_chk_mpl_diag lv_fuc_miss_diag lv_fuc_miss_diag_end lv_fuc_miss_diag_ready lv_sov_req_1 t_dly_1_fuc_miss_diag t_dly_2_fuc_miss_diag t_dly_3_fuc_miss_diag /end OUT_MEASUREMENT
/end FUNCTION
/begin FUNCTION EVAM_application_incidence_for_system_monitoring ""
 /begin DEF_CHARACTERISTIC lc_ftl_diagcp lc_ftl_vol_estim_diagcp ldp_amp_id_amp_temp_fuel ldp_temp_fuel_cor_id_amp id_amp_temp_fuel c_amp_grd_max_diagcp c_amp_grd_min_diagcp c_t_amp_grd_sum_max c_t_ast_cor_max_eru c_t_ast_evap_rbm c_t_ast_ini_diagcp c_t_inh_amp_grd_diagcp c_t_max_stop_eru c_t_vs_min_ini_diagcp c_tam_max_evap_rbm c_tam_min_evap_rbm c_tam_st_hys_evap_rbm c_tco_st_max_evap_rbm c_tco_st_min_evap_rbm c_temp_cor_grd_max_diagcp c_temp_cor_grd_min_diagcp c_vs_min_ini_diagcp lc_state_eol_diagcp /end DEF_CHARACTERISTIC
 /begin OUT_MEASUREMENT amp_grd amp_old eng_off_time_act lv_diagcp_fct_mod_8 lv_diagcp_req_eol lv_end_diag_evap_1 lv_err_evap_1 lv_fq_st_ad_end_1_evap lv_inh_amp_grd_diagcp lv_inh_amp_temp_fuel_diagcp lv_inh_diag_diagcp lv_inh_diagcp_ext_adj lv_inh_diagcp_ext_fct lv_inh_t_eru_diagcp lv_inh_t_eru_old_diagcp lv_state_rbm_evap_bit_2 state_rbm_cus_cps_mec state_rbm_cus_fuc state_rbm_evap t_amp_grd_sum t_ast_evap_rbm t_inh_diagcp_amp_grd t_vs_min_ini_diagcp temp_cor_grd temp_cor_old /end OUT_MEASUREMENT
/end FUNCTION
/begin FUNCTION EVAM_FTL_treatment_for_system_monitoring ""
 /begin DEF_CHARACTERISTIC ldp_fac_fq_st_ad ip_fac_fq_st_ad_diagcp c_ftl_sub_diagcp c_tco_st_max_st_ad_diagcp c_tco_st_min_st_ad_diagcp c_temp_fuel_sub_diagcp /end DEF_CHARACTERISTIC
 /begin OUT_MEASUREMENT fac_ti_st_ad_diagcp fac_ti_st_ad_diagcp_old ftl_diagcp t_ast_cor temp_fuel_cor_diagcp /end OUT_MEASUREMENT
/end FUNCTION
/begin FUNCTION C_A_EVAM ""
 /begin SUB_FUNCTION EVAM_DTP_sensor_diagnosis EVAM_application_incidence_DTP_sensor_diagnosis EVAM_application_incidence_SOV_diagnosis EVAM_SOV_diagnosis /end SUB_FUNCTION
/end FUNCTION
/begin FUNCTION EVAM_DTP_sensor_diagnosis ""
 /begin DEF_CHARACTERISTIC c_flow_cps_dif_min c_ftl_max_dtp_con c_ftl_max_dtp_noise c_nr_dtp_con_diag_sample c_v_dtp_max_dtp_diag c_v_dtp_min_con_diag c_v_dtp_min_dtp_diag c_v_dtp_plaus_con_diag c_vs_dtp_diag /end DEF_CHARACTERISTIC
 /begin OUT_MEASUREMENT err_sym_dtp_con err_sym_dtp_el err_sym_dtp_noise flow_cps_dif_diagcp flow_cps_max_diagcp flow_cps_min_diagcp lv_cdn_diag_dtp_con lv_cdn_diag_dtp_el lv_cdn_diag_dtp_noise lv_dtp_dif_dtp_diag lv_dtp_slop_dtp_diag lv_err_dtp_con lv_err_dtp_el lv_err_dtp_noise nr_dtp_con_dtp_diag_sample v_dtp_dif_dtp_diag v_dtp_max_dtp_diag v_dtp_min_dtp_diag vs_dtp_max_dtp_diag /end OUT_MEASUREMENT
/end FUNCTION
/begin FUNCTION EVAM_application_incidence_DTP_sensor_diagnosis "" /begin OUT_MEASUREMENT lv_inh_diag_dtp_con lv_inh_diag_dtp_noise /end OUT_MEASUREMENT /end FUNCTION
/begin FUNCTION EVAM_application_incidence_SOV_diagnosis "" /begin OUT_MEASUREMENT lv_inh_diag_mec_close_sov /end OUT_MEASUREMENT /end FUNCTION
/begin FUNCTION EVAM_SOV_diagnosis ""
 /begin DEF_CHARACTERISTIC c_diag_el_sov_off_0 c_diag_el_sov_off_1 c_diag_el_sov_off_2 c_diag_el_sov_off_3 c_diag_el_sov_on_0 c_diag_el_sov_on_1 c_diag_el_sov_on_2 c_dtp_raw_min_sov c_ftl_max_mec_close_sov /end DEF_CHARACTERISTIC
 /begin OUT_MEASUREMENT cdn_diag_el_sov err_sym_el_sov err_sym_mec_close_sov lv_cdn_diag_mec_close_sov lv_diag_el_sov lv_err_mec_close_sov lv_pulse_ack_sov lv_pulse_req_sov lv_sta_mem_sov v_adc_pulse_sov v_diag_el_sov vp_diag_el_sov /end OUT_MEASUREMENT
/end FUNCTION
/begin FUNCTION EVAM_adaptation_module ""
 /begin DEF_CHARACTERISTIC ldp_ar_cp_sp ldp_fac_lam_dif_cp ldp_map_ip_fac_cl_mmv ip_cppwm_sp_1 ip_cppwm_sp_2 ip_fac_cl_mmv c_ar_cp_sp_min c_fac_lam_dif_cp_max c_flow_cps_min_cl_mmv c_flow_cps_sp_min c_state_cp_rsa_adapt c_state_cp_rsa_init c_state_cp_rsa_nom c_state_cp_rsa_not_cl c_state_cp_rsa_out_purge c_t_dly_state_cp lc_swi_state_cp_mod /end DEF_CHARACTERISTIC
 /begin OUT_MEASUREMENT amp_ad ar_cp_sp cl_mmv cl_mmv_clc_end cppwm_diagcp dtp_raw_rsa flow_cps flow_sp_cps lv_pl maf_cp_kgh state_cp t_dly_state_cp_mod tco_stop v_dtp_rsa /end OUT_MEASUREMENT
/end FUNCTION
/begin FUNCTION C_4_AIRT "" /begin SUB_FUNCTION AIRT_ambient_air_temperature /end SUB_FUNCTION /end FUNCTION
/begin FUNCTION AIRT_ambient_air_temperature ""
 /begin DEF_CHARACTERISTIC ldp_tco_ip_tam_ofs ldp_vs_ip_tam_ofs ip_tam_ofs__tco__vs c_t_tam1 c_t_tam2 c_tam_clc_bol c_tam_clc_tol c_vs_tam_min /end DEF_CHARACTERISTIC
 /begin OUT_MEASUREMENT lv_err_tam t_tam1 t_tam2 tam tam_mdl tam_st /end OUT_MEASUREMENT
/end FUNCTION
/begin FUNCTION CbRicCtl ""
 /begin OUT_MEASUREMENT Vxx_rich_i_bar_apl Vxx_cl_t Vxx_dly_ocl_dly Vxx_fl_dsb_dly Vxx_mv_ad_lsm_ctr Vxx_trs_cl_ti_fac_mem Vxx_cl_ti_fac_fast_slop_sta Vxx_trs_cl_ti_fac_bar_mem Vxx_mv_cl_ti_fac Vxx_spc_slop_ctr Vxx_ti_p_cor_fast_slop Vxx_cl_ti_fac Vxx_mv_ti_ad_ofs Vxx_mv_ti_ad_fac Vtd_max_ti_b[0] Vtd_max_ti_b[1] Vtd_max_ti_b[2] Vtd_max_ti_b[3] Vtd_max_ti_b[4] Vtd_min_ti_b[0] Vtd_min_ti_b[1] Vtd_min_ti_b[2] Vtd_min_ti_b[3] Vtd_min_ti_b[4] Vxx_ol_ti_fac Vxx_bfr_cl_ctr Vsx_rich_stt Vxx_appl_ti_ofs_ctr Vxx_last_ti_p_cor Vxx_lamb_swi_ctr Vxx_cl_lean_ctr Vbx_ti_ad4_zon Vtd_ti_ad1_zon[0] Vtd_ti_ad1_zon[1] Vtd_ti_ad1_zon[2] Vtd_ti_ad1_zon[3] Vtd_ti_ad1_zon[4] /end OUT_MEASUREMENT
 /begin SUB_FUNCTION CbRicCtl_Wlwetxx CbRicCtl_Dbllpxx CbRicCtl_Ricclxx CbRicCtl_Ricloxx CbRicCtl_Ricadxx CbRicCtl_Alcoxxx /end SUB_FUNCTION
/end FUNCTION
/begin FUNCTION CbRicCtl_Wlwetxx ""
 /begin DEF_CHARACTERISTIC Ctb_vvtc_wet_fst_tco Ctb_wet_eal Ctb_wet_in_vvtc_angl Ctb_wet_n Ctb_wet_tco_17 Ctb_wet_tco_9 Cmp_wet_dep_fac_tco00 Cmp_wet_dep_fac_tco20 Cmp_wet_dep_fac_tco40 Cmp_wet_dep_fac_tco60 Cmp_wet_dep_fac_tco80 Cmp_wet_fil_fac_tco00 Cmp_wet_fil_fac_tco20 Cmp_wet_fil_fac_tco40 Cmp_wet_fil_fac_tco60 Cmp_wet_fil_fac_tco80 Cmp_wet_in_vvtc_cor_fac Ctp_tco_vvtc_wet_fst_fac Ctp_ti_vvtc_neg_cor_dly Ctp_ti_vvtc_neg_cor_fac Ctp_wet_acel_cor_fac Ctp_wet_decl_cor_fac Ctp_wet_decl_fil_fac Ctp_wet_ini_acel_cor_ofs Ctp_wet_vol_dif_thd_acel Ctp_wet_vol_dif_thd_decl Ctp_wet_vol_dif_thd_ini Ctp_wet_vol_dif_thd_sta Ctp_wet_vol_dif_thd_sta_t Cbx_wet_stat_cor_bch_mod Cbx_wet_vol_dif_thd_sta_ena Cxx_cold_vvtc_angl_ti_cor_thd Cxx_decl_lean_dsb_n_ofs Cxx_decl_lean_dsb_n_thd Cxx_decl_prs_lean_dsb_dly Cxx_tco_cold_vvtc_ti_cor_max Cxx_tco_cold_vvtc_ti_cor_min Cxx_ti_max_cor_cold_vvtc_act Cxx_vvtc_idle_dly Cxx_wet_acel_bch_cor_fac Cxx_wet_acel_bch_fil_fac Cxx_wet_bch_dep_fac Cxx_wet_decl_bch_cor_fac Cxx_wet_decl_bch_fil_fac Cxx_wet_ini_acel_ofs_t Cxx_wet_ini_acel_sta_t Cxx_wet_ti_cut_nr Cxx_wet_ti_cut_tdc_nr /end DEF_CHARACTERISTIC
 /begin OUT_MEASUREMENT Vbx_decl_prs_lean_ena Vbx_wet_ini_acel_cdn Vbx_wet_ini_acel_rest_cdn Vbx_wet_ti_clc_ena Vxx_cold_vvtc_cor_fac Vxx_decl_prs_lean_dsb_dly Vxx_fim Vxx_wet_acel_cor_fac Vxx_wet_acel_decl_bch_cor_fac Vxx_wet_acel_decl_cor_fac Vxx_wet_aftr_sta_t Vxx_wet_aftr_sta_t_prev Vxx_wet_cor_ofs_itl Vxx_wet_decl_cor_fac Vxx_wet_dep_fac Vxx_wet_dyn_vol Vxx_wet_dyn_vol_fil_fac Vxx_wet_dyn_vol_prev Vxx_wet_in_vvtc_cor_fac Vxx_wet_ini_acel_cor_ofs Vxx_wet_ini_acel_sta_t Vxx_wet_stat_vol Vxx_wet_ti_cut_ctr Vxx_wet_ti_cut_tdc_ctr Vxx_wet_vol_dif_thd_acel Vxx_wet_vol_dif_thd_decl Vxx_wet_wht_cor /end OUT_MEASUREMENT
/end FUNCTION
/begin FUNCTION CbRicCtl_Dbllpxx ""
 /begin DEF_CHARACTERISTIC Cmp_eal_n_lamb_v Ctp_tco_cl2_ena_ctr Cbx_ti_cl2_cfm Cxx_cl2_act_ctr Cxx_cl2_asd_map_thd Cxx_cl2_map_thd Cxx_cl2_n_thd Cxx_diag_fil_ti_ofs2_fac2 Cxx_dyn_prs_fil_ofs2 Cxx_fil_ti_ofs2_fac Cxx_lbdw_fil_fac Cxx_max_diag_ti_ofs1 Cxx_max_is_ti_ofs2 Cxx_max_n_fil_ofs2 Cxx_max_prs_fil_ofs2 Cxx_max_tco_fil_ofs2 Cxx_max_ti_ofs1 Cxx_min_diag_ti_ofs2 Cxx_min_is_ti_ofs2 Cxx_min_n_fil_ofs2 Cxx_min_prs_fil_ofs2 Cxx_min_tco_fil_ofs2 Cxx_min_ti_ofs2 Cxx_ti_i2_cor_fac Cxx_ti_p2_cor_fac /end DEF_CHARACTERISTIC
 /begin OUT_MEASUREMENT Vbx_ofs2_ena Vbx_ti_cl2_act Vxx_cl2_act_ctr Vxx_cl2_ena_ctr Vxx_dbl_lbdw_v_fil Vxx_lbdw_v_sp Vxx_mv_ti_ofs2_cor Vxx_ti_i2_cor Vxx_ti_ofs2_cor Vxx_ti_p2_cor /end OUT_MEASUREMENT
/end FUNCTION
/begin FUNCTION CbRicCtl_Ricclxx ""
 /begin DEF_CHARACTERISTIC Ctb_eal2 Cmp_n_eal_ti_ofs1 Cmp_n_eal_ti_ofs2 Cmp_n_eal_ti_p_cor Ctp_acel_n_ti_p_cor Ctp_cl_lean_sta Ctp_cl_lean_stop Ctp_decl_n_ti_p_cor Ctp_eal_l_ti_i_cor Ctp_eal_l_ti_i_cor_lean Ctp_eal_ti_bar_add_p Ctp_eal_ti_bar_add_p_eal_disa Ctp_eal_ti_bar_lbdw_lean_in Ctp_eal_ti_bar_lbdw_lean_out Ctp_eal_ti_bar_max Ctp_eal_ti_bar_min Ctp_n_l_ti_i Ctp_n_l_ti_i_lean Ctp_n_ti_p_cor_lean1 Ctp_n_ti_p_cor_lean2 Ctp_spc_slop_in Ctp_spc_slop_out Cbx_ti_bar_add_p Cbx_ti_bar_ena Csx_bar_rst_eva_stt Csx_bar_stop_eva_stt Cxx_acel_spc_slop Cxx_acel_spc_slop_lean Cxx_appl_ti_ofs_ctr Cxx_appl_ti_ofs_ctr_alco Cxx_bar_stop_eva_dly Cxx_cl_lean_ctr Cxx_cl_ti_fac_ftc Cxx_cl_ti_fac_ftc_alco Cxx_cl_ti_fac_ol_dec Cxx_cl_ti_fac_ol_inc Cxx_decl_spc_slop Cxx_decl_spc_slop_lean Cxx_dstb_ti_ofs_cor Cxx_dstb_ti_ofs_cor_alco Cxx_dstb_ti_p_cor Cxx_dstb_ti_p_cor_alco Cxx_h_ti_fast_slop_thd Cxx_h_ti_fast_slop_thd_alco Cxx_h_ti_fast_slop_thd_lean Cxx_is_ti_i_cor Cxx_is_ti_i_cor_alco Cxx_is_ti_i_cor_lean Cxx_is_ti_p_cor Cxx_is_ti_p_cor_alco Cxx_is_ti_p_cor_lean1 Cxx_is_ti_p_cor_lean2 Cxx_l_ti_fast_slop_thd Cxx_l_ti_fast_slop_thd_alco Cxx_l_ti_fast_slop_thd_lean Cxx_lamb_swi_ctr_ini Cxx_lamb_swi_ctr_ini_alco Cxx_max_spc_slop_ctr Cxx_max_ti_p_cor_fast_slop Cxx_max_ti_p_cor_fast_slop_alco Cxx_spc_slop_eal_ftc Cxx_spc_slop_eal_h_thd Cxx_spc_slop_eal_l_thd Cxx_ti_bar_add_p_act_dly Cxx_ti_bar_add_p_dly Cxx_ti_bar_add_p_eal_disa_dly Cxx_ti_bar_dly Cxx_ti_bar_eal_max Cxx_ti_bar_eal_min Cxx_ti_bar_lbdw_rich_in Cxx_ti_bar_lbdw_rich_out Cxx_ti_bar_n_max Cxx_ti_bar_n_min Cxx_ti_bar_tco_min Cxx_ti_i_fast_slop_fac Cxx_ti_i_fast_slop_fac_alco Cxx_ti_ofs_vs_thd Cxx_ti_ofs_vs_thd_alco Cxx_ti_p_eal_thd /end DEF_CHARACTERISTIC
 /begin OUT_MEASUREMENT Vbx_cl_lean_cdn Vbx_evap_dgn_cl_ti_fac_ok Vbx_spc_slop Vbx_ti_bar_add_p_no_bar Vbx_ti_bar_cdn Vbx_ti_bar_end Vsx_rich_cl Vxx_last_p_cor Vxx_rich_i_appl Vxx_slop_eal_dif Vxx_slop_eal_mmv Vxx_ti_bar_add_p_act_dly Vxx_ti_bar_add_p_eal_disa_t Vxx_ti_bar_add_p_t Vxx_ti_i_cor Vxx_ti_i_cor_fast_slop Vxx_ti_i_cor_lean Vxx_ti_ofs_cor Vxx_ti_p_cor Vxx_ti_p_cor_lean1 Vxx_ti_p_cor_lean2 /end OUT_MEASUREMENT
/end FUNCTION
/begin FUNCTION CbRicCtl_Ricloxx ""
 /begin DEF_CHARACTERISTIC Ctb_n_cl_rich_sp_bkp Ctb_tco_cl_off Cmp_n_tco_eal_fl_thd_h Cmp_n_tco_eal_fl_thd_l Cmp_n_tco_eal_fl_thd_midh Cmp_n_tco_eal_fl_thd_midl Ctp_cl_t Ctp_n_cl_rich_sp Ctp_n_dly_ofs_dly Ctp_n_eal_fl_ocl_ofs Ctp_n_iga_eal_fl_thd Cbx_fl_kd_thr_conf Cbx_lbup_conf Cxx_bfr_cl_ctr Cxx_bfr_cl_ctr_alco Cxx_cl_off_n_thd Cxx_cl_run_eal_thd Cxx_cl_stop_eal_thd Cxx_ct_pdl_tco_thd Cxx_dly_ocl_amp_thd Cxx_dly_ocl_l_n_thd Cxx_dly_ocl_up_n_thd Cxx_fl_ena_n_thd Cxx_fl_n_thd Cxx_fl_n_thd_hys Cxx_h_dly_ocl_tco_thd Cxx_l_dly_ocl_tco_thd Cxx_ol_ti_fac_dec Cxx_ol_ti_fac_inc Cxx_rich_cl_tco_thd Cxx_rich_ol_fim_thd Cxx_sta_fl_off_dly Cxx_sta_fl_off_dly_alco /end DEF_CHARACTERISTIC
 /begin OUT_MEASUREMENT Vbx_cl_cdn Vbx_cl_phs Vbx_dly_ocl_cdn Vbx_fl_cdn Vbx_fl_ena Vxx_eal_fl_ocl /end OUT_MEASUREMENT
/end FUNCTION
/begin FUNCTION CbRicCtl_Ricadxx ""
 /begin DEF_CHARACTERISTIC Ctd_max_mv_cld_ad[0] Ctd_max_mv_cld_ad[1] Ctd_max_mv_cld_ad[2] Ctd_max_mv_cld_ad[3] Ctd_max_mv_cld_ad[4] Ctd_min_mv_cld_ad[0] Ctd_min_mv_cld_ad[1] Ctd_min_mv_cld_ad[2] Ctd_min_mv_cld_ad[3] Ctd_min_mv_cld_ad[4] Ctd_ti_ad_fac_cor[0] Ctd_ti_ad_fac_cor[1] Ctd_ti_ad_fac_cor[2] Ctd_ti_ad_fac_cor[3] Ctd_ti_ad_fac_cor[4] Ctd_ti_ad_ofs_cor[0] Ctd_ti_ad_ofs_cor[1] Ctd_ti_ad_ofs_cor[2] Ctd_ti_ad_ofs_cor[3] Ctd_ti_ad_ofs_cor[4] Ctd_ti_b_cor[0] Ctd_ti_b_cor[1] Ctd_ti_b_cor[2] Ctd_ti_b_cor[3] Ctd_ti_b_cor[4] Cxx_ad_lamb_swi_ctr Cxx_ad_off_ti_ad_fac Cxx_ad_off_ti_ad_ofs Cxx_cld_ad_nr Cxx_is_hot_tco_thd Cxx_is_hot_ti_cl_dly Cxx_max_cld_fac_thd Cxx_max_cld_ofs_thd Cxx_max_imd_ti_ad_fac Cxx_max_imd_ti_ad_ofs Cxx_max_mv_ti_ad_fac Cxx_max_mv_ti_ad_ofs Cxx_min_ad_fac_thd Cxx_min_ad_ofs_thd Cxx_min_cld_fac_thd Cxx_min_cld_ofs_thd Cxx_min_dif_ti_b Cxx_min_imd_ti_ad_fac Cxx_min_imd_ti_ad_ofs Cxx_min_mv_ti_ad_fac Cxx_min_mv_ti_ad_ofs Cxx_prs_zon Cxx_prs_zon_st Cxx_ti_ad_max_n Cxx_ti_ad_prs_l_thd Cxx_ti_ad_prs_trs_thd Cxx_ti_ad_prs_up_thd Cxx_ti_ad_tco_thd Cxx_zon_dif_min_hys /end DEF_CHARACTERISTIC
 /begin OUT_MEASUREMENT Vbx_ad_lsm_ena Vbx_ad_lsm_req Vbx_is_hot_dly Vbx_ti_ad1_zon0 Vbx_ti_ad1_zon1 Vbx_ti_ad1_zon2 Vbx_ti_ad1_zon3 Vbx_ti_ad1_zon4 Vtd_ti_b[0] Vtd_ti_b[1] Vtd_ti_b[2] Vtd_ti_b[3] Vtd_ti_b[4] Vxx_ad_lamb_swi_ctr Vxx_imd_ti_ad_fac Vxx_imd_ti_ad_ofs Vxx_imd_ti_ad_ofs_med Vxx_is_hot_ti_cl_dly Vxx_mv_ti_ad_ofs_med Vxx_ti_ad_fac Vxx_ti_ad_fac_med Vxx_ti_ad_facm_med Vxx_ti_ad_ofs Vxx_ti_b_med Vxx_ti_zon_nr /end OUT_MEASUREMENT
/end FUNCTION
/end MODULE
/end PROJECT
