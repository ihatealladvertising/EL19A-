ASAP2_VERSION 1 41
/begin PROJECT RD8 "_default_ProjectLongIdentifier"
/begin HEADER "_default_HeaderComment" PROJECT_NO RD9 /end HEADER
/begin MODULE _default_ModuleName "_default_ModuleLongIdentifier"
/begin MOD_COMMON "_default_ModCommonComment" DEPOSIT ABSOLUTE BYTE_ORDER MSB_LAST ALIGNMENT_BYTE 1 ALIGNMENT_WORD 2 ALIGNMENT_LONG 2 ALIGNMENT_FLOAT32_IEEE 2 ALIGNMENT_FLOAT64_IEEE 4 /end MOD_COMMON
/begin CHARACTERISTIC Ctx_ffm_did_ac_prs[0] "" VALUE 0xa002a96c _REC_S1VAL_20_u2 65535. _CNV_A_R_A_105_CM 0. 65535. DISPLAY_IDENTIFIER Pxx_dgdftmng_dtc_ac_prs.Ctx_ffm_did_xxx[0] /end CHARACTERISTIC
/begin CHARACTERISTIC Ctx_ffm_did_ac_prs[1] "" VALUE 0xa002a96e _REC_S1VAL_20_u2 65535. _CNV_A_R_A_105_CM 0. 65535. DISPLAY_IDENTIFIER Pxx_dgdftmng_dtc_ac_prs.Ctx_ffm_did_xxx[1] /end CHARACTERISTIC
/begin CHARACTERISTIC Ctx_ffm_did_ac_prs[2] "" VALUE 0xa002a970 _REC_S1VAL_20_u2 65535. _CNV_A_R_A_105_CM 0. 65535. DISPLAY_IDENTIFIER Pxx_dgdftmng_dtc_ac_prs.Ctx_ffm_did_xxx[2] /end CHARACTERISTIC
/begin CHARACTERISTIC Ctx_ffm_did_ac_prs[3] "" VALUE 0xa002a972 _REC_S1VAL_20_u2 65535. _CNV_A_R_A_105_CM 0. 65535. DISPLAY_IDENTIFIER Pxx_dgdftmng_dtc_ac_prs.Ctx_ffm_did_xxx[3] /end CHARACTERISTIC
/begin CHARACTERISTIC Ctx_ffm_did_ac_prs[4] "" VALUE 0xa002a974 _REC_S1VAL_20_u2 65535. _CNV_A_R_A_105_CM 0. 65535. DISPLAY_IDENTIFIER Pxx_dgdftmng_dtc_ac_prs.Ctx_ffm_did_xxx[4] /end CHARACTERISTIC
/begin CHARACTERISTIC Cxx_dtc_hmb_ac_prs "" VALUE 0xa002a976 _REC_S1VAL_20_u2 65535. _CNV_A_R_A_105_CM 0. 65535. DISPLAY_IDENTIFIER Pxx_dgdftmng_dtc_ac_prs.Cxx_dtc_hmb_xxx /end CHARACTERISTIC
/begin CHARACTERISTIC Ctx_ffm_did_acel_pdl[0] "" VALUE 0xa002a978 _REC_S1VAL_20_u2 65535. _CNV_A_R_A_105_CM 0. 65535. DISPLAY_IDENTIFIER Pxx_dgdftmng_dtc_acel_pdl.Ctx_ffm_did_xxx[0] /end CHARACTERISTIC
/begin CHARACTERISTIC Ctx_ffm_did_acel_pdl[1] "" VALUE 0xa002a97a _REC_S1VAL_20_u2 65535. _CNV_A_R_A_105_CM 0. 65535. DISPLAY_IDENTIFIER Pxx_dgdftmng_dtc_acel_pdl.Ctx_ffm_did_xxx[1] /end CHARACTERISTIC
/begin CHARACTERISTIC Ctx_ffm_did_acel_pdl[2] "" VALUE 0xa002a97c _REC_S1VAL_20_u2 65535. _CNV_A_R_A_105_CM 0. 65535. DISPLAY_IDENTIFIER Pxx_dgdftmng_dtc_acel_pdl.Ctx_ffm_did_xxx[2] /end CHARACTERISTIC
/begin CHARACTERISTIC Ctx_ffm_did_acel_pdl[3] "" VALUE 0xa002a97e _REC_S1VAL_20_u2 65535. _CNV_A_R_A_105_CM 0. 65535. DISPLAY_IDENTIFIER Pxx_dgdftmng_dtc_acel_pdl.Ctx_ffm_did_xxx[3] /end CHARACTERISTIC
/begin CHARACTERISTIC Ctx_ffm_did_acel_pdl[4] "" VALUE 0xa002a980 _REC_S1VAL_20_u2 65535. _CNV_A_R_A_105_CM 0. 65535. DISPLAY_IDENTIFIER Pxx_dgdftmng_dtc_acel_pdl.Ctx_ffm_did_xxx[4] /end CHARACTERISTIC
/begin CHARACTERISTIC Cxx_dtc_hmb_acel_pdl "" VALUE 0xa002a982 _REC_S1VAL_20_u2 65535. _CNV_A_R_A_105_CM 0. 65535. DISPLAY_IDENTIFIER Pxx_dgdftmng_dtc_acel_pdl.Cxx_dtc_hmb_xxx /end CHARACTERISTIC
/begin CHARACTERISTIC Ctx_ffm_did_acel_pdl_v1[0] "" VALUE 0xa002a984 _REC_S1VAL_20_u2 65535. _CNV_A_R_A_105_CM 0. 65535. DISPLAY_IDENTIFIER Pxx_dgdftmng_dtc_acel_pdl_v1.Ctx_ffm_did_xxx[0] /end CHARACTERISTIC
/begin CHARACTERISTIC Ctx_ffm_did_acel_pdl_v1[1] "" VALUE 0xa002a986 _REC_S1VAL_20_u2 65535. _CNV_A_R_A_105_CM 0. 65535. DISPLAY_IDENTIFIER Pxx_dgdftmng_dtc_acel_pdl_v1.Ctx_ffm_did_xxx[1] /end CHARACTERISTIC
/begin CHARACTERISTIC Ctx_ffm_did_acel_pdl_v1[2] "" VALUE 0xa002a988 _REC_S1VAL_20_u2 65535. _CNV_A_R_A_105_CM 0. 65535. DISPLAY_IDENTIFIER Pxx_dgdftmng_dtc_acel_pdl_v1.Ctx_ffm_did_xxx[2] /end CHARACTERISTIC
/begin CHARACTERISTIC Ctx_ffm_did_acel_pdl_v1[3] "" VALUE 0xa002a98a _REC_S1VAL_20_u2 65535. _CNV_A_R_A_105_CM 0. 65535. DISPLAY_IDENTIFIER Pxx_dgdftmng_dtc_acel_pdl_v1.Ctx_ffm_did_xxx[3] /end CHARACTERISTIC
/begin CHARACTERISTIC Ctx_ffm_did_acel_pdl_v1[4] "" VALUE 0xa002a98c _REC_S1VAL_20_u2 65535. _CNV_A_R_A_105_CM 0. 65535. DISPLAY_IDENTIFIER Pxx_dgdftmng_dtc_acel_pdl_v1.Ctx_ffm_did_xxx[4] /end CHARACTERISTIC
/begin CHARACTERISTIC Cxx_dtc_hmb_acel_pdl_v1 "" VALUE 0xa002a98e _REC_S1VAL_20_u2 65535. _CNV_A_R_A_105_CM 0. 65535. DISPLAY_IDENTIFIER Pxx_dgdftmng_dtc_acel_pdl_v1.Cxx_dtc_hmb_xxx /end CHARACTERISTIC
/begin CHARACTERISTIC Ctx_ffm_did_acel_pdl_v2[0] "" VALUE 0xa002a990 _REC_S1VAL_20_u2 65535. _CNV_A_R_A_105_CM 0. 65535. DISPLAY_IDENTIFIER Pxx_dgdftmng_dtc_acel_pdl_v2.Ctx_ffm_did_xxx[0] /end CHARACTERISTIC
/begin CHARACTERISTIC Ctx_ffm_did_acel_pdl_v2[1] "" VALUE 0xa002a992 _REC_S1VAL_20_u2 65535. _CNV_A_R_A_105_CM 0. 65535. DISPLAY_IDENTIFIER Pxx_dgdftmng_dtc_acel_pdl_v2.Ctx_ffm_did_xxx[1] /end CHARACTERISTIC
/begin CHARACTERISTIC Ctx_ffm_did_acel_pdl_v2[2] "" VALUE 0xa002a994 _REC_S1VAL_20_u2 65535. _CNV_A_R_A_105_CM 0. 65535. DISPLAY_IDENTIFIER Pxx_dgdftmng_dtc_acel_pdl_v2.Ctx_ffm_did_xxx[2] /end CHARACTERISTIC
/begin CHARACTERISTIC Ctx_ffm_did_acel_pdl_v2[3] "" VALUE 0xa002a996 _REC_S1VAL_20_u2 65535. _CNV_A_R_A_105_CM 0. 65535. DISPLAY_IDENTIFIER Pxx_dgdftmng_dtc_acel_pdl_v2.Ctx_ffm_did_xxx[3] /end CHARACTERISTIC
/begin CHARACTERISTIC Ctx_ffm_did_acel_pdl_v2[4] "" VALUE 0xa002a998 _REC_S1VAL_20_u2 65535. _CNV_A_R_A_105_CM 0. 65535. DISPLAY_IDENTIFIER Pxx_dgdftmng_dtc_acel_pdl_v2.Ctx_ffm_did_xxx[4] /end CHARACTERISTIC
/begin CHARACTERISTIC Cxx_dtc_hmb_acel_pdl_v2 "" VALUE 0xa002a99a _REC_S1VAL_20_u2 65535. _CNV_A_R_A_105_CM 0. 65535. DISPLAY_IDENTIFIER Pxx_dgdftmng_dtc_acel_pdl_v2.Cxx_dtc_hmb_xxx /end CHARACTERISTIC
/begin CHARACTERISTIC Ctx_ffm_did_actr_rly[0] "" VALUE 0xa002a99c _REC_S1VAL_20_u2 65535. _CNV_A_R_A_105_CM 0. 65535. DISPLAY_IDENTIFIER Pxx_dgdftmng_dtc_actr_rly.Ctx_ffm_did_xxx[0] /end CHARACTERISTIC
/begin CHARACTERISTIC Ctx_ffm_did_actr_rly[1] "" VALUE 0xa002a99e _REC_S1VAL_20_u2 65535. _CNV_A_R_A_105_CM 0. 65535. DISPLAY_IDENTIFIER Pxx_dgdftmng_dtc_actr_rly.Ctx_ffm_did_xxx[1] /end CHARACTERISTIC
/begin CHARACTERISTIC Ctx_ffm_did_actr_rly[2] "" VALUE 0xa002a9a0 _REC_S1VAL_20_u2 65535. _CNV_A_R_A_105_CM 0. 65535. DISPLAY_IDENTIFIER Pxx_dgdftmng_dtc_actr_rly.Ctx_ffm_did_xxx[2] /end CHARACTERISTIC
/begin CHARACTERISTIC Ctx_ffm_did_actr_rly[3] "" VALUE 0xa002a9a2 _REC_S1VAL_20_u2 65535. _CNV_A_R_A_105_CM 0. 65535. DISPLAY_IDENTIFIER Pxx_dgdftmng_dtc_actr_rly.Ctx_ffm_did_xxx[3] /end CHARACTERISTIC
/begin CHARACTERISTIC Ctx_ffm_did_actr_rly[4] "" VALUE 0xa002a9a4 _REC_S1VAL_20_u2 65535. _CNV_A_R_A_105_CM 0. 65535. DISPLAY_IDENTIFIER Pxx_dgdftmng_dtc_actr_rly.Ctx_ffm_did_xxx[4] /end CHARACTERISTIC
/begin CHARACTERISTIC Cxx_dtc_hmb_actr_rly "" VALUE 0xa002a9a6 _REC_S1VAL_20_u2 65535. _CNV_A_R_A_105_CM 0. 65535. DISPLAY_IDENTIFIER Pxx_dgdftmng_dtc_actr_rly.Cxx_dtc_hmb_xxx /end CHARACTERISTIC
/begin CHARACTERISTIC Ctx_ffm_did_agb[0] "" VALUE 0xa002a9b4 _REC_S1VAL_20_u2 65535. _CNV_A_R_A_105_CM 0. 65535. DISPLAY_IDENTIFIER Pxx_dgdftmng_dtc_agb.Ctx_ffm_did_xxx[0] /end CHARACTERISTIC
/begin CHARACTERISTIC Ctx_ffm_did_agb[1] "" VALUE 0xa002a9b6 _REC_S1VAL_20_u2 65535. _CNV_A_R_A_105_CM 0. 65535. DISPLAY_IDENTIFIER Pxx_dgdftmng_dtc_agb.Ctx_ffm_did_xxx[1] /end CHARACTERISTIC
/begin CHARACTERISTIC Ctx_ffm_did_agb[2] "" VALUE 0xa002a9b8 _REC_S1VAL_20_u2 65535. _CNV_A_R_A_105_CM 0. 65535. DISPLAY_IDENTIFIER Pxx_dgdftmng_dtc_agb.Ctx_ffm_did_xxx[2] /end CHARACTERISTIC
/begin CHARACTERISTIC Ctx_ffm_did_agb[3] "" VALUE 0xa002a9ba _REC_S1VAL_20_u2 65535. _CNV_A_R_A_105_CM 0. 65535. DISPLAY_IDENTIFIER Pxx_dgdftmng_dtc_agb.Ctx_ffm_did_xxx[3] /end CHARACTERISTIC
/begin CHARACTERISTIC Ctx_ffm_did_agb[4] "" VALUE 0xa002a9bc _REC_S1VAL_20_u2 65535. _CNV_A_R_A_105_CM 0. 65535. DISPLAY_IDENTIFIER Pxx_dgdftmng_dtc_agb.Ctx_ffm_did_xxx[4] /end CHARACTERISTIC
/begin CHARACTERISTIC Cxx_dtc_hmb_agb "" VALUE 0xa002a9be _REC_S1VAL_20_u2 65535. _CNV_A_R_A_105_CM 0. 65535. DISPLAY_IDENTIFIER Pxx_dgdftmng_dtc_agb.Cxx_dtc_hmb_xxx /end CHARACTERISTIC
/begin CHARACTERISTIC Ctx_ffm_did_agb_data[0] "" VALUE 0xa002a9a8 _REC_S1VAL_20_u2 65535. _CNV_A_R_A_105_CM 0. 65535. DISPLAY_IDENTIFIER Pxx_dgdftmng_dtc_agb_data.Ctx_ffm_did_xxx[0] /end CHARACTERISTIC
/begin CHARACTERISTIC Ctx_ffm_did_agb_data[1] "" VALUE 0xa002a9aa _REC_S1VAL_20_u2 65535. _CNV_A_R_A_105_CM 0. 65535. DISPLAY_IDENTIFIER Pxx_dgdftmng_dtc_agb_data.Ctx_ffm_did_xxx[1] /end CHARACTERISTIC
/begin CHARACTERISTIC Ctx_ffm_did_agb_data[2] "" VALUE 0xa002a9ac _REC_S1VAL_20_u2 65535. _CNV_A_R_A_105_CM 0. 65535. DISPLAY_IDENTIFIER Pxx_dgdftmng_dtc_agb_data.Ctx_ffm_did_xxx[2] /end CHARACTERISTIC
/begin CHARACTERISTIC Ctx_ffm_did_agb_data[3] "" VALUE 0xa002a9ae _REC_S1VAL_20_u2 65535. _CNV_A_R_A_105_CM 0. 65535. DISPLAY_IDENTIFIER Pxx_dgdftmng_dtc_agb_data.Ctx_ffm_did_xxx[3] /end CHARACTERISTIC
/begin CHARACTERISTIC Ctx_ffm_did_agb_data[4] "" VALUE 0xa002a9b0 _REC_S1VAL_20_u2 65535. _CNV_A_R_A_105_CM 0. 65535. DISPLAY_IDENTIFIER Pxx_dgdftmng_dtc_agb_data.Ctx_ffm_did_xxx[4] /end CHARACTERISTIC
/begin CHARACTERISTIC Cxx_dtc_hmb_agb_data "" VALUE 0xa002a9b2 _REC_S1VAL_20_u2 65535. _CNV_A_R_A_105_CM 0. 65535. DISPLAY_IDENTIFIER Pxx_dgdftmng_dtc_agb_data.Cxx_dtc_hmb_xxx /end CHARACTERISTIC
/begin CHARACTERISTIC Ctx_ffm_did_bgin_clu[0] "" VALUE 0xa002ab40 _REC_S1VAL_20_u2 65535. _CNV_A_R_A_105_CM 0. 65535. DISPLAY_IDENTIFIER Pxx_dgdftmng_dtc_bgin_clu.Ctx_ffm_did_xxx[0] /end CHARACTERISTIC
/begin CHARACTERISTIC Ctx_ffm_did_bgin_clu[1] "" VALUE 0xa002ab42 _REC_S1VAL_20_u2 65535. _CNV_A_R_A_105_CM 0. 65535. DISPLAY_IDENTIFIER Pxx_dgdftmng_dtc_bgin_clu.Ctx_ffm_did_xxx[1] /end CHARACTERISTIC
/begin CHARACTERISTIC Ctx_ffm_did_bgin_clu[2] "" VALUE 0xa002ab44 _REC_S1VAL_20_u2 65535. _CNV_A_R_A_105_CM 0. 65535. DISPLAY_IDENTIFIER Pxx_dgdftmng_dtc_bgin_clu.Ctx_ffm_did_xxx[2] /end CHARACTERISTIC
/begin CHARACTERISTIC Ctx_ffm_did_bgin_clu[3] "" VALUE 0xa002ab46 _REC_S1VAL_20_u2 65535. _CNV_A_R_A_105_CM 0. 65535. DISPLAY_IDENTIFIER Pxx_dgdftmng_dtc_bgin_clu.Ctx_ffm_did_xxx[3] /end CHARACTERISTIC
/begin CHARACTERISTIC Ctx_ffm_did_bgin_clu[4] "" VALUE 0xa002ab48 _REC_S1VAL_20_u2 65535. _CNV_A_R_A_105_CM 0. 65535. DISPLAY_IDENTIFIER Pxx_dgdftmng_dtc_bgin_clu.Ctx_ffm_did_xxx[4] /end CHARACTERISTIC
/begin CHARACTERISTIC Cxx_dtc_hmb_bgin_clu "" VALUE 0xa002ab4a _REC_S1VAL_20_u2 65535. _CNV_A_R_A_105_CM 0. 65535. DISPLAY_IDENTIFIER Pxx_dgdftmng_dtc_bgin_clu.Cxx_dtc_hmb_xxx /end CHARACTERISTIC
/begin CHARACTERISTIC Ctx_ffm_did_brk_pdl[0] "" VALUE 0xa002ab4c _REC_S1VAL_20_u2 65535. _CNV_A_R_A_105_CM 0. 65535. DISPLAY_IDENTIFIER Pxx_dgdftmng_dtc_brk_pdl.Ctx_ffm_did_xxx[0] /end CHARACTERISTIC
/begin CHARACTERISTIC Ctx_ffm_did_brk_pdl[1] "" VALUE 0xa002ab4e _REC_S1VAL_20_u2 65535. _CNV_A_R_A_105_CM 0. 65535. DISPLAY_IDENTIFIER Pxx_dgdftmng_dtc_brk_pdl.Ctx_ffm_did_xxx[1] /end CHARACTERISTIC
/begin CHARACTERISTIC Ctx_ffm_did_brk_pdl[2] "" VALUE 0xa002ab50 _REC_S1VAL_20_u2 65535. _CNV_A_R_A_105_CM 0. 65535. DISPLAY_IDENTIFIER Pxx_dgdftmng_dtc_brk_pdl.Ctx_ffm_did_xxx[2] /end CHARACTERISTIC
/begin CHARACTERISTIC Ctx_ffm_did_brk_pdl[3] "" VALUE 0xa002ab52 _REC_S1VAL_20_u2 65535. _CNV_A_R_A_105_CM 0. 65535. DISPLAY_IDENTIFIER Pxx_dgdftmng_dtc_brk_pdl.Ctx_ffm_did_xxx[3] /end CHARACTERISTIC
/begin CHARACTERISTIC Ctx_ffm_did_brk_pdl[4] "" VALUE 0xa002ab54 _REC_S1VAL_20_u2 65535. _CNV_A_R_A_105_CM 0. 65535. DISPLAY_IDENTIFIER Pxx_dgdftmng_dtc_brk_pdl.Ctx_ffm_did_xxx[4] /end CHARACTERISTIC
/begin CHARACTERISTIC Cxx_dtc_hmb_brk_pdl "" VALUE 0xa002ab56 _REC_S1VAL_20_u2 65535. _CNV_A_R_A_105_CM 0. 65535. DISPLAY_IDENTIFIER Pxx_dgdftmng_dtc_brk_pdl.Cxx_dtc_hmb_xxx /end CHARACTERISTIC
/begin CHARACTERISTIC Ctx_ffm_did_cata[0] "" VALUE 0xa002a9c0 _REC_S1VAL_20_u2 65535. _CNV_A_R_A_105_CM 0. 65535. DISPLAY_IDENTIFIER Pxx_dgdftmng_dtc_cata.Ctx_ffm_did_xxx[0] /end CHARACTERISTIC
/begin CHARACTERISTIC Ctx_ffm_did_cata[1] "" VALUE 0xa002a9c2 _REC_S1VAL_20_u2 65535. _CNV_A_R_A_105_CM 0. 65535. DISPLAY_IDENTIFIER Pxx_dgdftmng_dtc_cata.Ctx_ffm_did_xxx[1] /end CHARACTERISTIC
/begin CHARACTERISTIC Ctx_ffm_did_cata[2] "" VALUE 0xa002a9c4 _REC_S1VAL_20_u2 65535. _CNV_A_R_A_105_CM 0. 65535. DISPLAY_IDENTIFIER Pxx_dgdftmng_dtc_cata.Ctx_ffm_did_xxx[2] /end CHARACTERISTIC
/begin CHARACTERISTIC Ctx_ffm_did_cata[3] "" VALUE 0xa002a9c6 _REC_S1VAL_20_u2 65535. _CNV_A_R_A_105_CM 0. 65535. DISPLAY_IDENTIFIER Pxx_dgdftmng_dtc_cata.Ctx_ffm_did_xxx[3] /end CHARACTERISTIC
/begin CHARACTERISTIC Ctx_ffm_did_cata[4] "" VALUE 0xa002a9c8 _REC_S1VAL_20_u2 65535. _CNV_A_R_A_105_CM 0. 65535. DISPLAY_IDENTIFIER Pxx_dgdftmng_dtc_cata.Ctx_ffm_did_xxx[4] /end CHARACTERISTIC
/begin CHARACTERISTIC Cxx_dtc_hmb_cata "" VALUE 0xa002a9ca _REC_S1VAL_20_u2 65535. _CNV_A_R_A_105_CM 0. 65535. DISPLAY_IDENTIFIER Pxx_dgdftmng_dtc_cata.Cxx_dtc_hmb_xxx /end CHARACTERISTIC
/begin CHARACTERISTIC Ctx_ffm_did_cl_rich[0] "" VALUE 0xa002ad80 _REC_S1VAL_20_u2 65535. _CNV_A_R_A_105_CM 0. 65535. DISPLAY_IDENTIFIER Pxx_dgdftmng_dtc_cl_rich.Ctx_ffm_did_xxx[0] /end CHARACTERISTIC
/begin CHARACTERISTIC Ctx_ffm_did_cl_rich[1] "" VALUE 0xa002ad82 _REC_S1VAL_20_u2 65535. _CNV_A_R_A_105_CM 0. 65535. DISPLAY_IDENTIFIER Pxx_dgdftmng_dtc_cl_rich.Ctx_ffm_did_xxx[1] /end CHARACTERISTIC
/begin CHARACTERISTIC Ctx_ffm_did_cl_rich[2] "" VALUE 0xa002ad84 _REC_S1VAL_20_u2 65535. _CNV_A_R_A_105_CM 0. 65535. DISPLAY_IDENTIFIER Pxx_dgdftmng_dtc_cl_rich.Ctx_ffm_did_xxx[2] /end CHARACTERISTIC
/begin CHARACTERISTIC Ctx_ffm_did_cl_rich[3] "" VALUE 0xa002ad86 _REC_S1VAL_20_u2 65535. _CNV_A_R_A_105_CM 0. 65535. DISPLAY_IDENTIFIER Pxx_dgdftmng_dtc_cl_rich.Ctx_ffm_did_xxx[3] /end CHARACTERISTIC
/begin CHARACTERISTIC Ctx_ffm_did_cl_rich[4] "" VALUE 0xa002ad88 _REC_S1VAL_20_u2 65535. _CNV_A_R_A_105_CM 0. 65535. DISPLAY_IDENTIFIER Pxx_dgdftmng_dtc_cl_rich.Ctx_ffm_did_xxx[4] /end CHARACTERISTIC
/begin CHARACTERISTIC Cxx_dtc_hmb_cl_rich "" VALUE 0xa002ad8a _REC_S1VAL_20_u2 65535. _CNV_A_R_A_105_CM 0. 65535. DISPLAY_IDENTIFIER Pxx_dgdftmng_dtc_cl_rich.Cxx_dtc_hmb_xxx /end CHARACTERISTIC
/begin CHARACTERISTIC Ctx_ffm_did_clu_cnt[0] "" VALUE 0xa002a9cc _REC_S1VAL_20_u2 65535. _CNV_A_R_A_105_CM 0. 65535. DISPLAY_IDENTIFIER Pxx_dgdftmng_dtc_clu_cnt.Ctx_ffm_did_xxx[0] /end CHARACTERISTIC
/begin CHARACTERISTIC Ctx_ffm_did_clu_cnt[1] "" VALUE 0xa002a9ce _REC_S1VAL_20_u2 65535. _CNV_A_R_A_105_CM 0. 65535. DISPLAY_IDENTIFIER Pxx_dgdftmng_dtc_clu_cnt.Ctx_ffm_did_xxx[1] /end CHARACTERISTIC
/begin CHARACTERISTIC Ctx_ffm_did_clu_cnt[2] "" VALUE 0xa002a9d0 _REC_S1VAL_20_u2 65535. _CNV_A_R_A_105_CM 0. 65535. DISPLAY_IDENTIFIER Pxx_dgdftmng_dtc_clu_cnt.Ctx_ffm_did_xxx[2] /end CHARACTERISTIC
/begin CHARACTERISTIC Ctx_ffm_did_clu_cnt[3] "" VALUE 0xa002a9d2 _REC_S1VAL_20_u2 65535. _CNV_A_R_A_105_CM 0. 65535. DISPLAY_IDENTIFIER Pxx_dgdftmng_dtc_clu_cnt.Ctx_ffm_did_xxx[3] /end CHARACTERISTIC
/begin CHARACTERISTIC Ctx_ffm_did_clu_cnt[4] "" VALUE 0xa002a9d4 _REC_S1VAL_20_u2 65535. _CNV_A_R_A_105_CM 0. 65535. DISPLAY_IDENTIFIER Pxx_dgdftmng_dtc_clu_cnt.Ctx_ffm_did_xxx[4] /end CHARACTERISTIC
/begin CHARACTERISTIC Cxx_dtc_hmb_clu_cnt "" VALUE 0xa002a9d6 _REC_S1VAL_20_u2 65535. _CNV_A_R_A_105_CM 0. 65535. DISPLAY_IDENTIFIER Pxx_dgdftmng_dtc_clu_cnt.Cxx_dtc_hmb_xxx /end CHARACTERISTIC
/begin CHARACTERISTIC Ctx_ffm_did_cp[0] "" VALUE 0xa002ab28 _REC_S1VAL_20_u2 65535. _CNV_A_R_A_105_CM 0. 65535. DISPLAY_IDENTIFIER Pxx_dgdftmng_dtc_cp.Ctx_ffm_did_xxx[0] /end CHARACTERISTIC
/begin CHARACTERISTIC Ctx_ffm_did_cp[1] "" VALUE 0xa002ab2a _REC_S1VAL_20_u2 65535. _CNV_A_R_A_105_CM 0. 65535. DISPLAY_IDENTIFIER Pxx_dgdftmng_dtc_cp.Ctx_ffm_did_xxx[1] /end CHARACTERISTIC
/begin CHARACTERISTIC Ctx_ffm_did_cp[2] "" VALUE 0xa002ab2c _REC_S1VAL_20_u2 65535. _CNV_A_R_A_105_CM 0. 65535. DISPLAY_IDENTIFIER Pxx_dgdftmng_dtc_cp.Ctx_ffm_did_xxx[2] /end CHARACTERISTIC
/begin CHARACTERISTIC Ctx_ffm_did_cp[3] "" VALUE 0xa002ab2e _REC_S1VAL_20_u2 65535. _CNV_A_R_A_105_CM 0. 65535. DISPLAY_IDENTIFIER Pxx_dgdftmng_dtc_cp.Ctx_ffm_did_xxx[3] /end CHARACTERISTIC
/begin CHARACTERISTIC Ctx_ffm_did_cp[4] "" VALUE 0xa002ab30 _REC_S1VAL_20_u2 65535. _CNV_A_R_A_105_CM 0. 65535. DISPLAY_IDENTIFIER Pxx_dgdftmng_dtc_cp.Ctx_ffm_did_xxx[4] /end CHARACTERISTIC
/begin CHARACTERISTIC Cxx_dtc_hmb_cp "" VALUE 0xa002ab32 _REC_S1VAL_20_u2 65535. _CNV_A_R_A_105_CM 0. 65535. DISPLAY_IDENTIFIER Pxx_dgdftmng_dtc_cp.Cxx_dtc_hmb_xxx /end CHARACTERISTIC
/begin CHARACTERISTIC Ctx_ffm_did_crk[0] "" VALUE 0xa002ac84 _REC_S1VAL_20_u2 65535. _CNV_A_R_A_105_CM 0. 65535. DISPLAY_IDENTIFIER Pxx_dgdftmng_dtc_crk.Ctx_ffm_did_xxx[0] /end CHARACTERISTIC
/begin CHARACTERISTIC Ctx_ffm_did_crk[1] "" VALUE 0xa002ac86 _REC_S1VAL_20_u2 65535. _CNV_A_R_A_105_CM 0. 65535. DISPLAY_IDENTIFIER Pxx_dgdftmng_dtc_crk.Ctx_ffm_did_xxx[1] /end CHARACTERISTIC
/begin CHARACTERISTIC Ctx_ffm_did_crk[2] "" VALUE 0xa002ac88 _REC_S1VAL_20_u2 65535. _CNV_A_R_A_105_CM 0. 65535. DISPLAY_IDENTIFIER Pxx_dgdftmng_dtc_crk.Ctx_ffm_did_xxx[2] /end CHARACTERISTIC
/begin CHARACTERISTIC Ctx_ffm_did_crk[3] "" VALUE 0xa002ac8a _REC_S1VAL_20_u2 65535. _CNV_A_R_A_105_CM 0. 65535. DISPLAY_IDENTIFIER Pxx_dgdftmng_dtc_crk.Ctx_ffm_did_xxx[3] /end CHARACTERISTIC
/begin MEASUREMENT Vbx_clf_inj_ecu_lbup_icp "" UBYTE _CNV_A_R_A_105_CM 1 0. 0. 255. DISPLAY_IDENTIFIER fm_sta_inj_ecu_lbup_icp.fm_static_bitfield.Vbx_clf_xxx ECU_ADDRESS 0xd0005274 BIT_MASK 0x2 /end MEASUREMENT
/begin MEASUREMENT Vbx_df_old_inj_ecu_lbup_icp "" UBYTE _CNV_A_R_A_105_CM 1 0. 0. 255. DISPLAY_IDENTIFIER fm_sta_inj_ecu_lbup_icp.fm_static_bitfield.Vbx_df_old_xxx ECU_ADDRESS 0xd0005274 BIT_MASK 0x4 /end MEASUREMENT
/begin MEASUREMENT Vbx_dfctr_sat_inj_ecu_lbup_icp "" UBYTE _CNV_A_R_A_105_CM 1 0. 0. 255. DISPLAY_IDENTIFIER fm_sta_inj_ecu_lbup_icp.fm_static_bitfield.Vbx_dfctr_sat_xxx ECU_ADDRESS 0xd0005274 BIT_MASK 0x8 /end MEASUREMENT
/begin MEASUREMENT Vbx_rdn_inj_ecu_lbup_icp "" UBYTE _CNV_A_R_A_105_CM 1 0. 0. 255. DISPLAY_IDENTIFIER fm_sta_inj_ecu_lbup_icp.fm_static_bitfield.Vbx_rdn_xxx ECU_ADDRESS 0xd0005274 BIT_MASK 0x40 /end MEASUREMENT
/begin MEASUREMENT Vxx_dtc_stt_inj_ecu_lbup_icp "" UBYTE _CNV_A_R_A_105_CM 1 0. 0. 255. DISPLAY_IDENTIFIER fm_sta_inj_ecu_lbup_icp.Vxx_dtc_stt_xxx ECU_ADDRESS 0xd0005275 /end MEASUREMENT
/begin MEASUREMENT Vxx_dfctr_ip_lght_tco_ovh "" UWORD _CNV_A_R_A_105_CM 1 0. 0. 65535. DISPLAY_IDENTIFIER fm_sta_ip_lght_tco_ovh.Vxx_dfctr_xxx ECU_ADDRESS 0xd0005546 /end MEASUREMENT
/begin MEASUREMENT Vxx_rdn_ip_lght_tco_ovh "" UWORD _CNV_A_R_A_105_CM 1 0. 0. 65535. DISPLAY_IDENTIFIER fm_sta_ip_lght_tco_ovh.Vxx_rdn_xxx ECU_ADDRESS 0xd0005548 /end MEASUREMENT
/begin MEASUREMENT Vbx_cf_ip_lght_tco_ovh "" UBYTE _CNV_A_R_A_105_CM 1 0. 0. 255. DISPLAY_IDENTIFIER fm_sta_ip_lght_tco_ovh.fm_static_bitfield.Vbx_cf_xxx ECU_ADDRESS 0xd000554a BIT_MASK 0x1 /end MEASUREMENT
/begin MEASUREMENT Vbx_clf_ip_lght_tco_ovh "" UBYTE _CNV_A_R_A_105_CM 1 0. 0. 255. DISPLAY_IDENTIFIER fm_sta_ip_lght_tco_ovh.fm_static_bitfield.Vbx_clf_xxx ECU_ADDRESS 0xd000554a BIT_MASK 0x2 /end MEASUREMENT
/begin MEASUREMENT Vbx_df_old_ip_lght_tco_ovh "" UBYTE _CNV_A_R_A_105_CM 1 0. 0. 255. DISPLAY_IDENTIFIER fm_sta_ip_lght_tco_ovh.fm_static_bitfield.Vbx_df_old_xxx ECU_ADDRESS 0xd000554a BIT_MASK 0x4 /end MEASUREMENT
/begin MEASUREMENT Vbx_dfctr_sat_ip_lght_tco_ovh "" UBYTE _CNV_A_R_A_105_CM 1 0. 0. 255. DISPLAY_IDENTIFIER fm_sta_ip_lght_tco_ovh.fm_static_bitfield.Vbx_dfctr_sat_xxx ECU_ADDRESS 0xd000554a BIT_MASK 0x8 /end MEASUREMENT
/begin MEASUREMENT Vbx_rdn_ip_lght_tco_ovh "" UBYTE _CNV_A_R_A_105_CM 1 0. 0. 255. DISPLAY_IDENTIFIER fm_sta_ip_lght_tco_ovh.fm_static_bitfield.Vbx_rdn_xxx ECU_ADDRESS 0xd000554a BIT_MASK 0x40 /end MEASUREMENT
/begin MEASUREMENT Vxx_dtc_stt_ip_lght_tco_ovh "" UBYTE _CNV_A_R_A_105_CM 1 0. 0. 255. DISPLAY_IDENTIFIER fm_sta_ip_lght_tco_ovh.Vxx_dtc_stt_xxx ECU_ADDRESS 0xd000554b /end MEASUREMENT
/begin MEASUREMENT Vxx_dfctr_isr_h_lvl "" UWORD _CNV_A_R_A_105_CM 1 0. 0. 65535. DISPLAY_IDENTIFIER fm_sta_isr_h_lvl.Vxx_dfctr_xxx ECU_ADDRESS 0xd0005642 /end MEASUREMENT
/begin MEASUREMENT Vxx_rdn_isr_h_lvl "" UWORD _CNV_A_R_A_105_CM 1 0. 0. 65535. DISPLAY_IDENTIFIER fm_sta_isr_h_lvl.Vxx_rdn_xxx ECU_ADDRESS 0xd0005644 /end MEASUREMENT
/begin MEASUREMENT Vbx_cf_isr_h_lvl "" UBYTE _CNV_A_R_A_105_CM 1 0. 0. 255. DISPLAY_IDENTIFIER fm_sta_isr_h_lvl.fm_static_bitfield.Vbx_cf_xxx ECU_ADDRESS 0xd0005646 BIT_MASK 0x1 /end MEASUREMENT
/begin MEASUREMENT Vbx_clf_isr_h_lvl "" UBYTE _CNV_A_R_A_105_CM 1 0. 0. 255. DISPLAY_IDENTIFIER fm_sta_isr_h_lvl.fm_static_bitfield.Vbx_clf_xxx ECU_ADDRESS 0xd0005646 BIT_MASK 0x2 /end MEASUREMENT
/begin MEASUREMENT Vbx_df_old_isr_h_lvl "" UBYTE _CNV_A_R_A_105_CM 1 0. 0. 255. DISPLAY_IDENTIFIER fm_sta_isr_h_lvl.fm_static_bitfield.Vbx_df_old_xxx ECU_ADDRESS 0xd0005646 BIT_MASK 0x4 /end MEASUREMENT
/begin MEASUREMENT Vbx_dfctr_sat_isr_h_lvl "" UBYTE _CNV_A_R_A_105_CM 1 0. 0. 255. DISPLAY_IDENTIFIER fm_sta_isr_h_lvl.fm_static_bitfield.Vbx_dfctr_sat_xxx ECU_ADDRESS 0xd0005646 BIT_MASK 0x8 /end MEASUREMENT
/begin MEASUREMENT Vbx_rdn_isr_h_lvl "" UBYTE _CNV_A_R_A_105_CM 1 0. 0. 255. DISPLAY_IDENTIFIER fm_sta_isr_h_lvl.fm_static_bitfield.Vbx_rdn_xxx ECU_ADDRESS 0xd0005646 BIT_MASK 0x40 /end MEASUREMENT
/begin MEASUREMENT Vxx_dtc_stt_isr_h_lvl "" UBYTE _CNV_A_R_A_105_CM 1 0. 0. 255. DISPLAY_IDENTIFIER fm_sta_isr_h_lvl.Vxx_dtc_stt_xxx ECU_ADDRESS 0xd0005647 /end MEASUREMENT
/begin MEASUREMENT Vxx_dfctr_isr_l_lvl "" UWORD _CNV_A_R_A_105_CM 1 0. 0. 65535. DISPLAY_IDENTIFIER fm_sta_isr_l_lvl.Vxx_dfctr_xxx ECU_ADDRESS 0xd0005648 /end MEASUREMENT
/begin MEASUREMENT Vxx_rdn_isr_l_lvl "" UWORD _CNV_A_R_A_105_CM 1 0. 0. 65535. DISPLAY_IDENTIFIER fm_sta_isr_l_lvl.Vxx_rdn_xxx ECU_ADDRESS 0xd000564a /end MEASUREMENT
/begin MEASUREMENT Vbx_cf_isr_l_lvl "" UBYTE _CNV_A_R_A_105_CM 1 0. 0. 255. DISPLAY_IDENTIFIER fm_sta_isr_l_lvl.fm_static_bitfield.Vbx_cf_xxx ECU_ADDRESS 0xd000564c BIT_MASK 0x1 /end MEASUREMENT
/begin MEASUREMENT Vbx_clf_isr_l_lvl "" UBYTE _CNV_A_R_A_105_CM 1 0. 0. 255. DISPLAY_IDENTIFIER fm_sta_isr_l_lvl.fm_static_bitfield.Vbx_clf_xxx ECU_ADDRESS 0xd000564c BIT_MASK 0x2 /end MEASUREMENT
/begin MEASUREMENT Vbx_df_old_isr_l_lvl "" UBYTE _CNV_A_R_A_105_CM 1 0. 0. 255. DISPLAY_IDENTIFIER fm_sta_isr_l_lvl.fm_static_bitfield.Vbx_df_old_xxx ECU_ADDRESS 0xd000564c BIT_MASK 0x4 /end MEASUREMENT
/begin MEASUREMENT Vbx_dfctr_sat_isr_l_lvl "" UBYTE _CNV_A_R_A_105_CM 1 0. 0. 255. DISPLAY_IDENTIFIER fm_sta_isr_l_lvl.fm_static_bitfield.Vbx_dfctr_sat_xxx ECU_ADDRESS 0xd000564c BIT_MASK 0x8 /end MEASUREMENT
/begin MEASUREMENT Vbx_rdn_isr_l_lvl "" UBYTE _CNV_A_R_A_105_CM 1 0. 0. 255. DISPLAY_IDENTIFIER fm_sta_isr_l_lvl.fm_static_bitfield.Vbx_rdn_xxx ECU_ADDRESS 0xd000564c BIT_MASK 0x40 /end MEASUREMENT
/begin MEASUREMENT Vxx_dtc_stt_isr_l_lvl "" UBYTE _CNV_A_R_A_105_CM 1 0. 0. 255. DISPLAY_IDENTIFIER fm_sta_isr_l_lvl.Vxx_dtc_stt_xxx ECU_ADDRESS 0xd000564d /end MEASUREMENT
/begin MEASUREMENT Vxx_dfctr_it_cmd_el "" UWORD _CNV_A_R_A_105_CM 1 0. 0. 65535. DISPLAY_IDENTIFIER fm_sta_it_cmd_el.Vxx_dfctr_xxx ECU_ADDRESS 0xd00052be /end MEASUREMENT
/begin MEASUREMENT Vxx_rdn_it_cmd_el "" UWORD _CNV_A_R_A_105_CM 1 0. 0. 65535. DISPLAY_IDENTIFIER fm_sta_it_cmd_el.Vxx_rdn_xxx ECU_ADDRESS 0xd00052c0 /end MEASUREMENT
/begin MEASUREMENT Vbx_cf_it_cmd_el "" UBYTE _CNV_A_R_A_105_CM 1 0. 0. 255. DISPLAY_IDENTIFIER fm_sta_it_cmd_el.fm_static_bitfield.Vbx_cf_xxx ECU_ADDRESS 0xd00052c2 BIT_MASK 0x1 /end MEASUREMENT
/begin MEASUREMENT Vbx_clf_it_cmd_el "" UBYTE _CNV_A_R_A_105_CM 1 0. 0. 255. DISPLAY_IDENTIFIER fm_sta_it_cmd_el.fm_static_bitfield.Vbx_clf_xxx ECU_ADDRESS 0xd00052c2 BIT_MASK 0x2 /end MEASUREMENT
/begin MEASUREMENT Vbx_df_old_it_cmd_el "" UBYTE _CNV_A_R_A_105_CM 1 0. 0. 255. DISPLAY_IDENTIFIER fm_sta_it_cmd_el.fm_static_bitfield.Vbx_df_old_xxx ECU_ADDRESS 0xd00052c2 BIT_MASK 0x4 /end MEASUREMENT
/begin MEASUREMENT Vbx_dfctr_sat_it_cmd_el "" UBYTE _CNV_A_R_A_105_CM 1 0. 0. 255. DISPLAY_IDENTIFIER fm_sta_it_cmd_el.fm_static_bitfield.Vbx_dfctr_sat_xxx ECU_ADDRESS 0xd00052c2 BIT_MASK 0x8 /end MEASUREMENT
/begin MEASUREMENT Vbx_rdn_it_cmd_el "" UBYTE _CNV_A_R_A_105_CM 1 0. 0. 255. DISPLAY_IDENTIFIER fm_sta_it_cmd_el.fm_static_bitfield.Vbx_rdn_xxx ECU_ADDRESS 0xd00052c2 BIT_MASK 0x40 /end MEASUREMENT
/begin MEASUREMENT Vxx_dtc_stt_it_cmd_el "" UBYTE _CNV_A_R_A_105_CM 1 0. 0. 255. DISPLAY_IDENTIFIER fm_sta_it_cmd_el.Vxx_dtc_stt_xxx ECU_ADDRESS 0xd00052c3 /end MEASUREMENT
/begin MEASUREMENT Vxx_dfctr_it_ofs_meca "" UWORD _CNV_A_R_A_105_CM 1 0. 0. 65535. DISPLAY_IDENTIFIER fm_sta_it_ofs_meca.Vxx_dfctr_xxx ECU_ADDRESS 0xd00052c4 /end MEASUREMENT
/begin MEASUREMENT Vxx_rdn_it_ofs_meca "" UWORD _CNV_A_R_A_105_CM 1 0. 0. 65535. DISPLAY_IDENTIFIER fm_sta_it_ofs_meca.Vxx_rdn_xxx ECU_ADDRESS 0xd00052c6 /end MEASUREMENT
/begin MEASUREMENT Vbx_cf_it_ofs_meca "" UBYTE _CNV_A_R_A_105_CM 1 0. 0. 255. DISPLAY_IDENTIFIER fm_sta_it_ofs_meca.fm_static_bitfield.Vbx_cf_xxx ECU_ADDRESS 0xd00052c8 BIT_MASK 0x1 /end MEASUREMENT
/begin MEASUREMENT Vbx_clf_it_ofs_meca "" UBYTE _CNV_A_R_A_105_CM 1 0. 0. 255. DISPLAY_IDENTIFIER fm_sta_it_ofs_meca.fm_static_bitfield.Vbx_clf_xxx ECU_ADDRESS 0xd00052c8 BIT_MASK 0x2 /end MEASUREMENT
/begin MEASUREMENT Vbx_df_old_it_ofs_meca "" UBYTE _CNV_A_R_A_105_CM 1 0. 0. 255. DISPLAY_IDENTIFIER fm_sta_it_ofs_meca.fm_static_bitfield.Vbx_df_old_xxx ECU_ADDRESS 0xd00052c8 BIT_MASK 0x4 /end MEASUREMENT
/begin MEASUREMENT Vbx_dfctr_sat_it_ofs_meca "" UBYTE _CNV_A_R_A_105_CM 1 0. 0. 255. DISPLAY_IDENTIFIER fm_sta_it_ofs_meca.fm_static_bitfield.Vbx_dfctr_sat_xxx ECU_ADDRESS 0xd00052c8 BIT_MASK 0x8 /end MEASUREMENT
/begin MEASUREMENT Vbx_rdn_it_ofs_meca "" UBYTE _CNV_A_R_A_105_CM 1 0. 0. 255. DISPLAY_IDENTIFIER fm_sta_it_ofs_meca.fm_static_bitfield.Vbx_rdn_xxx ECU_ADDRESS 0xd00052c8 BIT_MASK 0x40 /end MEASUREMENT
/begin MEASUREMENT Vxx_dtc_stt_it_ofs_meca "" UBYTE _CNV_A_R_A_105_CM 1 0. 0. 255. DISPLAY_IDENTIFIER fm_sta_it_ofs_meca.Vxx_dtc_stt_xxx ECU_ADDRESS 0xd00052c9 /end MEASUREMENT
/begin MEASUREMENT Vxx_dfctr_it_ofs_no_norm "" UWORD _CNV_A_R_A_105_CM 1 0. 0. 65535. DISPLAY_IDENTIFIER fm_sta_it_ofs_no_norm.Vxx_dfctr_xxx ECU_ADDRESS 0xd00052ca /end MEASUREMENT
/begin MEASUREMENT Vxx_rdn_it_ofs_no_norm "" UWORD _CNV_A_R_A_105_CM 1 0. 0. 65535. DISPLAY_IDENTIFIER fm_sta_it_ofs_no_norm.Vxx_rdn_xxx ECU_ADDRESS 0xd00052cc /end MEASUREMENT
/begin MEASUREMENT Vbx_cf_it_ofs_no_norm "" UBYTE _CNV_A_R_A_105_CM 1 0. 0. 255. DISPLAY_IDENTIFIER fm_sta_it_ofs_no_norm.fm_static_bitfield.Vbx_cf_xxx ECU_ADDRESS 0xd00052ce BIT_MASK 0x1 /end MEASUREMENT
/begin MEASUREMENT Vbx_clf_it_ofs_no_norm "" UBYTE _CNV_A_R_A_105_CM 1 0. 0. 255. DISPLAY_IDENTIFIER fm_sta_it_ofs_no_norm.fm_static_bitfield.Vbx_clf_xxx ECU_ADDRESS 0xd00052ce BIT_MASK 0x2 /end MEASUREMENT
/begin MEASUREMENT Vbx_df_old_it_ofs_no_norm "" UBYTE _CNV_A_R_A_105_CM 1 0. 0. 255. DISPLAY_IDENTIFIER fm_sta_it_ofs_no_norm.fm_static_bitfield.Vbx_df_old_xxx ECU_ADDRESS 0xd00052ce BIT_MASK 0x4 /end MEASUREMENT
/begin MEASUREMENT Vbx_dfctr_sat_it_ofs_no_norm "" UBYTE _CNV_A_R_A_105_CM 1 0. 0. 255. DISPLAY_IDENTIFIER fm_sta_it_ofs_no_norm.fm_static_bitfield.Vbx_dfctr_sat_xxx ECU_ADDRESS 0xd00052ce BIT_MASK 0x8 /end MEASUREMENT
/begin MEASUREMENT Vbx_rdn_it_ofs_no_norm "" UBYTE _CNV_A_R_A_105_CM 1 0. 0. 255. DISPLAY_IDENTIFIER fm_sta_it_ofs_no_norm.fm_static_bitfield.Vbx_rdn_xxx ECU_ADDRESS 0xd00052ce BIT_MASK 0x40 /end MEASUREMENT
/begin MEASUREMENT Vxx_dtc_stt_it_ofs_no_norm "" UBYTE _CNV_A_R_A_105_CM 1 0. 0. 255. DISPLAY_IDENTIFIER fm_sta_it_ofs_no_norm.Vxx_dtc_stt_xxx ECU_ADDRESS 0xd00052cf /end MEASUREMENT
/begin MEASUREMENT Vxx_dfctr_it_ofs_secu_nok "" UWORD _CNV_A_R_A_105_CM 1 0. 0. 65535. DISPLAY_IDENTIFIER fm_sta_it_ofs_secu_nok.Vxx_dfctr_xxx ECU_ADDRESS 0xd00052d0 /end MEASUREMENT
/begin MEASUREMENT Vxx_rdn_it_ofs_secu_nok "" UWORD _CNV_A_R_A_105_CM 1 0. 0. 65535. DISPLAY_IDENTIFIER fm_sta_it_ofs_secu_nok.Vxx_rdn_xxx ECU_ADDRESS 0xd00052d2 /end MEASUREMENT
/begin MEASUREMENT Vbx_cf_it_ofs_secu_nok "" UBYTE _CNV_A_R_A_105_CM 1 0. 0. 255. DISPLAY_IDENTIFIER fm_sta_it_ofs_secu_nok.fm_static_bitfield.Vbx_cf_xxx ECU_ADDRESS 0xd00052d4 BIT_MASK 0x1 /end MEASUREMENT
/begin MEASUREMENT Vbx_clf_it_ofs_secu_nok "" UBYTE _CNV_A_R_A_105_CM 1 0. 0. 255. DISPLAY_IDENTIFIER fm_sta_it_ofs_secu_nok.fm_static_bitfield.Vbx_clf_xxx ECU_ADDRESS 0xd00052d4 BIT_MASK 0x2 /end MEASUREMENT
/begin MEASUREMENT Vbx_df_old_it_ofs_secu_nok "" UBYTE _CNV_A_R_A_105_CM 1 0. 0. 255. DISPLAY_IDENTIFIER fm_sta_it_ofs_secu_nok.fm_static_bitfield.Vbx_df_old_xxx ECU_ADDRESS 0xd00052d4 BIT_MASK 0x4 /end MEASUREMENT
/begin MEASUREMENT Vbx_dfctr_sat_it_ofs_secu_nok "" UBYTE _CNV_A_R_A_105_CM 1 0. 0. 255. DISPLAY_IDENTIFIER fm_sta_it_ofs_secu_nok.fm_static_bitfield.Vbx_dfctr_sat_xxx ECU_ADDRESS 0xd00052d4 BIT_MASK 0x8 /end MEASUREMENT
/begin MEASUREMENT Vbx_rdn_it_ofs_secu_nok "" UBYTE _CNV_A_R_A_105_CM 1 0. 0. 255. DISPLAY_IDENTIFIER fm_sta_it_ofs_secu_nok.fm_static_bitfield.Vbx_rdn_xxx ECU_ADDRESS 0xd00052d4 BIT_MASK 0x40 /end MEASUREMENT
/begin MEASUREMENT Vxx_dtc_stt_it_ofs_secu_nok "" UBYTE _CNV_A_R_A_105_CM 1 0. 0. 255. DISPLAY_IDENTIFIER fm_sta_it_ofs_secu_nok.Vxx_dtc_stt_xxx ECU_ADDRESS 0xd00052d5 /end MEASUREMENT
/begin MEASUREMENT Vxx_dfctr_it_reg_blk "" UWORD _CNV_A_R_A_105_CM 1 0. 0. 65535. DISPLAY_IDENTIFIER fm_sta_it_reg_blk.Vxx_dfctr_xxx ECU_ADDRESS 0xd00052d6 /end MEASUREMENT
/begin MEASUREMENT Vxx_rdn_it_reg_blk "" UWORD _CNV_A_R_A_105_CM 1 0. 0. 65535. DISPLAY_IDENTIFIER fm_sta_it_reg_blk.Vxx_rdn_xxx ECU_ADDRESS 0xd00052d8 /end MEASUREMENT
/begin MEASUREMENT Vbx_cf_it_reg_blk "" UBYTE _CNV_A_R_A_105_CM 1 0. 0. 255. DISPLAY_IDENTIFIER fm_sta_it_reg_blk.fm_static_bitfield.Vbx_cf_xxx ECU_ADDRESS 0xd00052da BIT_MASK 0x1 /end MEASUREMENT
/begin MEASUREMENT Vbx_clf_it_reg_blk "" UBYTE _CNV_A_R_A_105_CM 1 0. 0. 255. DISPLAY_IDENTIFIER fm_sta_it_reg_blk.fm_static_bitfield.Vbx_clf_xxx ECU_ADDRESS 0xd00052da BIT_MASK 0x2 /end MEASUREMENT
/begin MEASUREMENT Vbx_df_old_it_reg_blk "" UBYTE _CNV_A_R_A_105_CM 1 0. 0. 255. DISPLAY_IDENTIFIER fm_sta_it_reg_blk.fm_static_bitfield.Vbx_df_old_xxx ECU_ADDRESS 0xd00052da BIT_MASK 0x4 /end MEASUREMENT
/begin MEASUREMENT Vbx_dfctr_sat_it_reg_blk "" UBYTE _CNV_A_R_A_105_CM 1 0. 0. 255. DISPLAY_IDENTIFIER fm_sta_it_reg_blk.fm_static_bitfield.Vbx_dfctr_sat_xxx ECU_ADDRESS 0xd00052da BIT_MASK 0x8 /end MEASUREMENT
/begin MEASUREMENT Vbx_rdn_it_reg_blk "" UBYTE _CNV_A_R_A_105_CM 1 0. 0. 255. DISPLAY_IDENTIFIER fm_sta_it_reg_blk.fm_static_bitfield.Vbx_rdn_xxx ECU_ADDRESS 0xd00052da BIT_MASK 0x40 /end MEASUREMENT
/begin MEASUREMENT Vxx_dtc_stt_it_reg_blk "" UBYTE _CNV_A_R_A_105_CM 1 0. 0. 255. DISPLAY_IDENTIFIER fm_sta_it_reg_blk.Vxx_dtc_stt_xxx ECU_ADDRESS 0xd00052db /end MEASUREMENT
/begin MEASUREMENT Vxx_dfctr_knk_oor "" UWORD _CNV_A_R_A_105_CM 1 0. 0. 65535. DISPLAY_IDENTIFIER fm_sta_knk_oor.Vxx_dfctr_xxx ECU_ADDRESS 0xd00052dc /end MEASUREMENT
/begin MEASUREMENT Vxx_rdn_knk_oor "" UWORD _CNV_A_R_A_105_CM 1 0. 0. 65535. DISPLAY_IDENTIFIER fm_sta_knk_oor.Vxx_rdn_xxx ECU_ADDRESS 0xd00052de /end MEASUREMENT
/begin MEASUREMENT Vbx_cf_knk_oor "" UBYTE _CNV_A_R_A_105_CM 1 0. 0. 255. DISPLAY_IDENTIFIER fm_sta_knk_oor.fm_static_bitfield.Vbx_cf_xxx ECU_ADDRESS 0xd00052e0 BIT_MASK 0x1 /end MEASUREMENT
/begin MEASUREMENT Vbx_clf_knk_oor "" UBYTE _CNV_A_R_A_105_CM 1 0. 0. 255. DISPLAY_IDENTIFIER fm_sta_knk_oor.fm_static_bitfield.Vbx_clf_xxx ECU_ADDRESS 0xd00052e0 BIT_MASK 0x2 /end MEASUREMENT
/begin MEASUREMENT Vbx_df_old_knk_oor "" UBYTE _CNV_A_R_A_105_CM 1 0. 0. 255. DISPLAY_IDENTIFIER fm_sta_knk_oor.fm_static_bitfield.Vbx_df_old_xxx ECU_ADDRESS 0xd00052e0 BIT_MASK 0x4 /end MEASUREMENT
/begin MEASUREMENT Vbx_dfctr_sat_knk_oor "" UBYTE _CNV_A_R_A_105_CM 1 0. 0. 255. DISPLAY_IDENTIFIER fm_sta_knk_oor.fm_static_bitfield.Vbx_dfctr_sat_xxx ECU_ADDRESS 0xd00052e0 BIT_MASK 0x8 /end MEASUREMENT
/begin MEASUREMENT Vbx_rdn_knk_oor "" UBYTE _CNV_A_R_A_105_CM 1 0. 0. 255. DISPLAY_IDENTIFIER fm_sta_knk_oor.fm_static_bitfield.Vbx_rdn_xxx ECU_ADDRESS 0xd00052e0 BIT_MASK 0x40 /end MEASUREMENT
/begin MEASUREMENT Vxx_dtc_stt_knk_oor "" UBYTE _CNV_A_R_A_105_CM 1 0. 0. 255. DISPLAY_IDENTIFIER fm_sta_knk_oor.Vxx_dtc_stt_xxx ECU_ADDRESS 0xd00052e1 /end MEASUREMENT
/begin MEASUREMENT Vxx_dfctr_knk_shp "" UWORD _CNV_A_R_A_105_CM 1 0. 0. 65535. DISPLAY_IDENTIFIER fm_sta_knk_shp.Vxx_dfctr_xxx ECU_ADDRESS 0xd00052e2 /end MEASUREMENT
/begin MEASUREMENT Vxx_rdn_knk_shp "" UWORD _CNV_A_R_A_105_CM 1 0. 0. 65535. DISPLAY_IDENTIFIER fm_sta_knk_shp.Vxx_rdn_xxx ECU_ADDRESS 0xd00052e4 /end MEASUREMENT
/begin MEASUREMENT Vbx_cf_knk_shp "" UBYTE _CNV_A_R_A_105_CM 1 0. 0. 255. DISPLAY_IDENTIFIER fm_sta_knk_shp.fm_static_bitfield.Vbx_cf_xxx ECU_ADDRESS 0xd00052e6 BIT_MASK 0x1 /end MEASUREMENT
/begin MEASUREMENT Vbx_clf_knk_shp "" UBYTE _CNV_A_R_A_105_CM 1 0. 0. 255. DISPLAY_IDENTIFIER fm_sta_knk_shp.fm_static_bitfield.Vbx_clf_xxx ECU_ADDRESS 0xd00052e6 BIT_MASK 0x2 /end MEASUREMENT
/begin MEASUREMENT Vbx_df_old_knk_shp "" UBYTE _CNV_A_R_A_105_CM 1 0. 0. 255. DISPLAY_IDENTIFIER fm_sta_knk_shp.fm_static_bitfield.Vbx_df_old_xxx ECU_ADDRESS 0xd00052e6 BIT_MASK 0x4 /end MEASUREMENT
/begin MEASUREMENT Vbx_dfctr_sat_knk_shp "" UBYTE _CNV_A_R_A_105_CM 1 0. 0. 255. DISPLAY_IDENTIFIER fm_sta_knk_shp.fm_static_bitfield.Vbx_dfctr_sat_xxx ECU_ADDRESS 0xd00052e6 BIT_MASK 0x8 /end MEASUREMENT
/begin MEASUREMENT Vbx_rdn_knk_shp "" UBYTE _CNV_A_R_A_105_CM 1 0. 0. 255. DISPLAY_IDENTIFIER fm_sta_knk_shp.fm_static_bitfield.Vbx_rdn_xxx ECU_ADDRESS 0xd00052e6 BIT_MASK 0x40 /end MEASUREMENT
/begin MEASUREMENT Vxx_dtc_stt_knk_shp "" UBYTE _CNV_A_R_A_105_CM 1 0. 0. 255. DISPLAY_IDENTIFIER fm_sta_knk_shp.Vxx_dtc_stt_xxx ECU_ADDRESS 0xd00052e7 /end MEASUREMENT
/begin MEASUREMENT Vxx_dfctr_lbdw_hot_dirt_lkg "" UWORD _CNV_A_R_A_105_CM 1 0. 0. 65535. DISPLAY_IDENTIFIER fm_sta_lbdw_hot_dirt_lkg.Vxx_dfctr_xxx ECU_ADDRESS 0xd0005654 /end MEASUREMENT
/begin MEASUREMENT Vxx_rdn_lbdw_hot_dirt_lkg "" UWORD _CNV_A_R_A_105_CM 1 0. 0. 65535. DISPLAY_IDENTIFIER fm_sta_lbdw_hot_dirt_lkg.Vxx_rdn_xxx ECU_ADDRESS 0xd0005656 /end MEASUREMENT
/begin MEASUREMENT Vbx_cf_lbdw_hot_dirt_lkg "" UBYTE _CNV_A_R_A_105_CM 1 0. 0. 255. DISPLAY_IDENTIFIER fm_sta_lbdw_hot_dirt_lkg.fm_static_bitfield.Vbx_cf_xxx ECU_ADDRESS 0xd0005658 BIT_MASK 0x1 /end MEASUREMENT
/begin MEASUREMENT Vbx_clf_lbdw_hot_dirt_lkg "" UBYTE _CNV_A_R_A_105_CM 1 0. 0. 255. DISPLAY_IDENTIFIER fm_sta_lbdw_hot_dirt_lkg.fm_static_bitfield.Vbx_clf_xxx ECU_ADDRESS 0xd0005658 BIT_MASK 0x2 /end MEASUREMENT
/begin MEASUREMENT Vbx_df_old_lbdw_hot_dirt_lkg "" UBYTE _CNV_A_R_A_105_CM 1 0. 0. 255. DISPLAY_IDENTIFIER fm_sta_lbdw_hot_dirt_lkg.fm_static_bitfield.Vbx_df_old_xxx ECU_ADDRESS 0xd0005658 BIT_MASK 0x4 /end MEASUREMENT
/begin MEASUREMENT Vbx_dfctr_sat_lbdw_hot_dirt_lkg "" UBYTE _CNV_A_R_A_105_CM 1 0. 0. 255. DISPLAY_IDENTIFIER fm_sta_lbdw_hot_dirt_lkg.fm_static_bitfield.Vbx_dfctr_sat_xxx ECU_ADDRESS 0xd0005658 BIT_MASK 0x8 /end MEASUREMENT
/begin MEASUREMENT Vbx_rdn_lbdw_hot_dirt_lkg "" UBYTE _CNV_A_R_A_105_CM 1 0. 0. 255. DISPLAY_IDENTIFIER fm_sta_lbdw_hot_dirt_lkg.fm_static_bitfield.Vbx_rdn_xxx ECU_ADDRESS 0xd0005658 BIT_MASK 0x40 /end MEASUREMENT
/begin MEASUREMENT Vxx_dtc_stt_lbdw_hot_dirt_lkg "" UBYTE _CNV_A_R_A_105_CM 1 0. 0. 255. DISPLAY_IDENTIFIER fm_sta_lbdw_hot_dirt_lkg.Vxx_dtc_stt_xxx ECU_ADDRESS 0xd0005659 /end MEASUREMENT
/begin MEASUREMENT Vxx_dfctr_lbdw_hot_oc "" UWORD _CNV_A_R_A_105_CM 1 0. 0. 65535. DISPLAY_IDENTIFIER fm_sta_lbdw_hot_oc.Vxx_dfctr_xxx ECU_ADDRESS 0xd00053f6 /end MEASUREMENT
/begin MEASUREMENT Vxx_rdn_lbdw_hot_oc "" UWORD _CNV_A_R_A_105_CM 1 0. 0. 65535. DISPLAY_IDENTIFIER fm_sta_lbdw_hot_oc.Vxx_rdn_xxx ECU_ADDRESS 0xd00053f8 /end MEASUREMENT
/begin MEASUREMENT Vbx_cf_lbdw_hot_oc "" UBYTE _CNV_A_R_A_105_CM 1 0. 0. 255. DISPLAY_IDENTIFIER fm_sta_lbdw_hot_oc.fm_static_bitfield.Vbx_cf_xxx ECU_ADDRESS 0xd00053fa BIT_MASK 0x1 /end MEASUREMENT
/begin MEASUREMENT Vbx_clf_lbdw_hot_oc "" UBYTE _CNV_A_R_A_105_CM 1 0. 0. 255. DISPLAY_IDENTIFIER fm_sta_lbdw_hot_oc.fm_static_bitfield.Vbx_clf_xxx ECU_ADDRESS 0xd00053fa BIT_MASK 0x2 /end MEASUREMENT
/begin MEASUREMENT Vbx_df_old_lbdw_hot_oc "" UBYTE _CNV_A_R_A_105_CM 1 0. 0. 255. DISPLAY_IDENTIFIER fm_sta_lbdw_hot_oc.fm_static_bitfield.Vbx_df_old_xxx ECU_ADDRESS 0xd00053fa BIT_MASK 0x4 /end MEASUREMENT
/begin MEASUREMENT Vbx_dfctr_sat_lbdw_hot_oc "" UBYTE _CNV_A_R_A_105_CM 1 0. 0. 255. DISPLAY_IDENTIFIER fm_sta_lbdw_hot_oc.fm_static_bitfield.Vbx_dfctr_sat_xxx ECU_ADDRESS 0xd00053fa BIT_MASK 0x8 /end MEASUREMENT
/begin MEASUREMENT Vbx_rdn_lbdw_hot_oc "" UBYTE _CNV_A_R_A_105_CM 1 0. 0. 255. DISPLAY_IDENTIFIER fm_sta_lbdw_hot_oc.fm_static_bitfield.Vbx_rdn_xxx ECU_ADDRESS 0xd00053fa BIT_MASK 0x40 /end MEASUREMENT
/begin MEASUREMENT Vxx_dtc_stt_lbdw_hot_oc "" UBYTE _CNV_A_R_A_105_CM 1 0. 0. 255. DISPLAY_IDENTIFIER fm_sta_lbdw_hot_oc.Vxx_dtc_stt_xxx ECU_ADDRESS 0xd00053fb /end MEASUREMENT
/begin MEASUREMENT Vxx_dfctr_lbdw_hot_scg "" UWORD _CNV_A_R_A_105_CM 1 0. 0. 65535. DISPLAY_IDENTIFIER fm_sta_lbdw_hot_scg.Vxx_dfctr_xxx ECU_ADDRESS 0xd00053fc /end MEASUREMENT
/begin MEASUREMENT Vxx_rdn_lbdw_hot_scg "" UWORD _CNV_A_R_A_105_CM 1 0. 0. 65535. DISPLAY_IDENTIFIER fm_sta_lbdw_hot_scg.Vxx_rdn_xxx ECU_ADDRESS 0xd00053fe /end MEASUREMENT
/begin MEASUREMENT Vbx_cf_lbdw_hot_scg "" UBYTE _CNV_A_R_A_105_CM 1 0. 0. 255. DISPLAY_IDENTIFIER fm_sta_lbdw_hot_scg.fm_static_bitfield.Vbx_cf_xxx ECU_ADDRESS 0xd0005400 BIT_MASK 0x1 /end MEASUREMENT
/begin MEASUREMENT Vbx_clf_lbdw_hot_scg "" UBYTE _CNV_A_R_A_105_CM 1 0. 0. 255. DISPLAY_IDENTIFIER fm_sta_lbdw_hot_scg.fm_static_bitfield.Vbx_clf_xxx ECU_ADDRESS 0xd0005400 BIT_MASK 0x2 /end MEASUREMENT
/begin MEASUREMENT Vbx_df_old_lbdw_hot_scg "" UBYTE _CNV_A_R_A_105_CM 1 0. 0. 255. DISPLAY_IDENTIFIER fm_sta_lbdw_hot_scg.fm_static_bitfield.Vbx_df_old_xxx ECU_ADDRESS 0xd0005400 BIT_MASK 0x4 /end MEASUREMENT
/begin MEASUREMENT Vbx_dfctr_sat_lbdw_hot_scg "" UBYTE _CNV_A_R_A_105_CM 1 0. 0. 255. DISPLAY_IDENTIFIER fm_sta_lbdw_hot_scg.fm_static_bitfield.Vbx_dfctr_sat_xxx ECU_ADDRESS 0xd0005400 BIT_MASK 0x8 /end MEASUREMENT
/begin MEASUREMENT Vbx_rdn_lbdw_hot_scg "" UBYTE _CNV_A_R_A_105_CM 1 0. 0. 255. DISPLAY_IDENTIFIER fm_sta_lbdw_hot_scg.fm_static_bitfield.Vbx_rdn_xxx ECU_ADDRESS 0xd0005400 BIT_MASK 0x40 /end MEASUREMENT
/begin MEASUREMENT Vxx_dtc_stt_lbdw_hot_scg "" UBYTE _CNV_A_R_A_105_CM 1 0. 0. 255. DISPLAY_IDENTIFIER fm_sta_lbdw_hot_scg.Vxx_dtc_stt_xxx ECU_ADDRESS 0xd0005401 /end MEASUREMENT
/begin MEASUREMENT Vxx_dfctr_lbdw_hot_scw "" UWORD _CNV_A_R_A_105_CM 1 0. 0. 65535. DISPLAY_IDENTIFIER fm_sta_lbdw_hot_scw.Vxx_dfctr_xxx ECU_ADDRESS 0xd0005402 /end MEASUREMENT
/begin MEASUREMENT Vxx_rdn_lbdw_hot_scw "" UWORD _CNV_A_R_A_105_CM 1 0. 0. 65535. DISPLAY_IDENTIFIER fm_sta_lbdw_hot_scw.Vxx_rdn_xxx ECU_ADDRESS 0xd0005404 /end MEASUREMENT
/begin MEASUREMENT Vbx_cf_lbdw_hot_scw "" UBYTE _CNV_A_R_A_105_CM 1 0. 0. 255. DISPLAY_IDENTIFIER fm_sta_lbdw_hot_scw.fm_static_bitfield.Vbx_cf_xxx ECU_ADDRESS 0xd0005406 BIT_MASK 0x1 /end MEASUREMENT
/begin MEASUREMENT Vbx_clf_lbdw_hot_scw "" UBYTE _CNV_A_R_A_105_CM 1 0. 0. 255. DISPLAY_IDENTIFIER fm_sta_lbdw_hot_scw.fm_static_bitfield.Vbx_clf_xxx ECU_ADDRESS 0xd0005406 BIT_MASK 0x2 /end MEASUREMENT
/begin MEASUREMENT Vbx_df_old_lbdw_hot_scw "" UBYTE _CNV_A_R_A_105_CM 1 0. 0. 255. DISPLAY_IDENTIFIER fm_sta_lbdw_hot_scw.fm_static_bitfield.Vbx_df_old_xxx ECU_ADDRESS 0xd0005406 BIT_MASK 0x4 /end MEASUREMENT
/begin MEASUREMENT Vbx_dfctr_sat_lbdw_hot_scw "" UBYTE _CNV_A_R_A_105_CM 1 0. 0. 255. DISPLAY_IDENTIFIER fm_sta_lbdw_hot_scw.fm_static_bitfield.Vbx_dfctr_sat_xxx ECU_ADDRESS 0xd0005406 BIT_MASK 0x8 /end MEASUREMENT
/begin MEASUREMENT Vbx_rdn_lbdw_hot_scw "" UBYTE _CNV_A_R_A_105_CM 1 0. 0. 255. DISPLAY_IDENTIFIER fm_sta_lbdw_hot_scw.fm_static_bitfield.Vbx_rdn_xxx ECU_ADDRESS 0xd0005406 BIT_MASK 0x40 /end MEASUREMENT
/begin MEASUREMENT Vxx_dtc_stt_lbdw_hot_scw "" UBYTE _CNV_A_R_A_105_CM 1 0. 0. 255. DISPLAY_IDENTIFIER fm_sta_lbdw_hot_scw.Vxx_dtc_stt_xxx ECU_ADDRESS 0xd0005407 /end MEASUREMENT
/begin MEASUREMENT Vxx_dfctr_lbdw_oc "" UWORD _CNV_A_R_A_105_CM 1 0. 0. 65535. DISPLAY_IDENTIFIER fm_sta_lbdw_oc.Vxx_dfctr_xxx ECU_ADDRESS 0xd00052e8 /end MEASUREMENT
/begin MEASUREMENT Vxx_rdn_lbdw_oc "" UWORD _CNV_A_R_A_105_CM 1 0. 0. 65535. DISPLAY_IDENTIFIER fm_sta_lbdw_oc.Vxx_rdn_xxx ECU_ADDRESS 0xd00052ea /end MEASUREMENT
/begin MEASUREMENT Vbx_cf_lbdw_oc "" UBYTE _CNV_A_R_A_105_CM 1 0. 0. 255. DISPLAY_IDENTIFIER fm_sta_lbdw_oc.fm_static_bitfield.Vbx_cf_xxx ECU_ADDRESS 0xd00052ec BIT_MASK 0x1 /end MEASUREMENT
/begin MEASUREMENT Vbx_clf_lbdw_oc "" UBYTE _CNV_A_R_A_105_CM 1 0. 0. 255. DISPLAY_IDENTIFIER fm_sta_lbdw_oc.fm_static_bitfield.Vbx_clf_xxx ECU_ADDRESS 0xd00052ec BIT_MASK 0x2 /end MEASUREMENT
/begin MEASUREMENT Vbx_df_old_lbdw_oc "" UBYTE _CNV_A_R_A_105_CM 1 0. 0. 255. DISPLAY_IDENTIFIER fm_sta_lbdw_oc.fm_static_bitfield.Vbx_df_old_xxx ECU_ADDRESS 0xd00052ec BIT_MASK 0x4 /end MEASUREMENT
/begin MEASUREMENT Vbx_dfctr_sat_lbdw_oc "" UBYTE _CNV_A_R_A_105_CM 1 0. 0. 255. DISPLAY_IDENTIFIER fm_sta_lbdw_oc.fm_static_bitfield.Vbx_dfctr_sat_xxx ECU_ADDRESS 0xd00052ec BIT_MASK 0x8 /end MEASUREMENT
/begin MEASUREMENT Vbx_rdn_lbdw_oc "" UBYTE _CNV_A_R_A_105_CM 1 0. 0. 255. DISPLAY_IDENTIFIER fm_sta_lbdw_oc.fm_static_bitfield.Vbx_rdn_xxx ECU_ADDRESS 0xd00052ec BIT_MASK 0x40 /end MEASUREMENT
/begin MEASUREMENT Vxx_dtc_stt_lbdw_oc "" UBYTE _CNV_A_R_A_105_CM 1 0. 0. 255. DISPLAY_IDENTIFIER fm_sta_lbdw_oc.Vxx_dtc_stt_xxx ECU_ADDRESS 0xd00052ed /end MEASUREMENT
/begin MEASUREMENT Vxx_dfctr_lbdw_scg "" UWORD _CNV_A_R_A_105_CM 1 0. 0. 65535. DISPLAY_IDENTIFIER fm_sta_lbdw_scg.Vxx_dfctr_xxx ECU_ADDRESS 0xd00052ee /end MEASUREMENT
/begin MEASUREMENT Vxx_rdn_lbdw_scg "" UWORD _CNV_A_R_A_105_CM 1 0. 0. 65535. DISPLAY_IDENTIFIER fm_sta_lbdw_scg.Vxx_rdn_xxx ECU_ADDRESS 0xd00052f0 /end MEASUREMENT
/begin MEASUREMENT Vbx_cf_lbdw_scg "" UBYTE _CNV_A_R_A_105_CM 1 0. 0. 255. DISPLAY_IDENTIFIER fm_sta_lbdw_scg.fm_static_bitfield.Vbx_cf_xxx ECU_ADDRESS 0xd00052f2 BIT_MASK 0x1 /end MEASUREMENT
/begin MEASUREMENT Vbx_clf_lbdw_scg "" UBYTE _CNV_A_R_A_105_CM 1 0. 0. 255. DISPLAY_IDENTIFIER fm_sta_lbdw_scg.fm_static_bitfield.Vbx_clf_xxx ECU_ADDRESS 0xd00052f2 BIT_MASK 0x2 /end MEASUREMENT
/begin MEASUREMENT Vbx_df_old_lbdw_scg "" UBYTE _CNV_A_R_A_105_CM 1 0. 0. 255. DISPLAY_IDENTIFIER fm_sta_lbdw_scg.fm_static_bitfield.Vbx_df_old_xxx ECU_ADDRESS 0xd00052f2 BIT_MASK 0x4 /end MEASUREMENT
/begin MEASUREMENT Vbx_dfctr_sat_lbdw_scg "" UBYTE _CNV_A_R_A_105_CM 1 0. 0. 255. DISPLAY_IDENTIFIER fm_sta_lbdw_scg.fm_static_bitfield.Vbx_dfctr_sat_xxx ECU_ADDRESS 0xd00052f2 BIT_MASK 0x8 /end MEASUREMENT
/begin MEASUREMENT Vbx_rdn_lbdw_scg "" UBYTE _CNV_A_R_A_105_CM 1 0. 0. 255. DISPLAY_IDENTIFIER fm_sta_lbdw_scg.fm_static_bitfield.Vbx_rdn_xxx ECU_ADDRESS 0xd00052f2 BIT_MASK 0x40 /end MEASUREMENT
/begin MEASUREMENT Vxx_dtc_stt_lbdw_scg "" UBYTE _CNV_A_R_A_105_CM 1 0. 0. 255. DISPLAY_IDENTIFIER fm_sta_lbdw_scg.Vxx_dtc_stt_xxx ECU_ADDRESS 0xd00052f3 /end MEASUREMENT
/begin MEASUREMENT Vxx_dfctr_lbdw_scw "" UWORD _CNV_A_R_A_105_CM 1 0. 0. 65535. DISPLAY_IDENTIFIER fm_sta_lbdw_scw.Vxx_dfctr_xxx ECU_ADDRESS 0xd00052f4 /end MEASUREMENT
/begin MEASUREMENT Vxx_rdn_lbdw_scw "" UWORD _CNV_A_R_A_105_CM 1 0. 0. 65535. DISPLAY_IDENTIFIER fm_sta_lbdw_scw.Vxx_rdn_xxx ECU_ADDRESS 0xd00052f6 /end MEASUREMENT
/begin MEASUREMENT Vbx_cf_lbdw_scw "" UBYTE _CNV_A_R_A_105_CM 1 0. 0. 255. DISPLAY_IDENTIFIER fm_sta_lbdw_scw.fm_static_bitfield.Vbx_cf_xxx ECU_ADDRESS 0xd00052f8 BIT_MASK 0x1 /end MEASUREMENT
/begin MEASUREMENT Vbx_clf_lbdw_scw "" UBYTE _CNV_A_R_A_105_CM 1 0. 0. 255. DISPLAY_IDENTIFIER fm_sta_lbdw_scw.fm_static_bitfield.Vbx_clf_xxx ECU_ADDRESS 0xd00052f8 BIT_MASK 0x2 /end MEASUREMENT
/begin MEASUREMENT Vbx_df_old_lbdw_scw "" UBYTE _CNV_A_R_A_105_CM 1 0. 0. 255. DISPLAY_IDENTIFIER fm_sta_lbdw_scw.fm_static_bitfield.Vbx_df_old_xxx ECU_ADDRESS 0xd00052f8 BIT_MASK 0x4 /end MEASUREMENT
/begin MEASUREMENT Vbx_dfctr_sat_lbdw_scw "" UBYTE _CNV_A_R_A_105_CM 1 0. 0. 255. DISPLAY_IDENTIFIER fm_sta_lbdw_scw.fm_static_bitfield.Vbx_dfctr_sat_xxx ECU_ADDRESS 0xd00052f8 BIT_MASK 0x8 /end MEASUREMENT
/begin MEASUREMENT Vbx_rdn_lbdw_scw "" UBYTE _CNV_A_R_A_105_CM 1 0. 0. 255. DISPLAY_IDENTIFIER fm_sta_lbdw_scw.fm_static_bitfield.Vbx_rdn_xxx ECU_ADDRESS 0xd00052f8 BIT_MASK 0x40 /end MEASUREMENT
/begin MEASUREMENT Vxx_dtc_stt_lbdw_scw "" UBYTE _CNV_A_R_A_105_CM 1 0. 0. 255. DISPLAY_IDENTIFIER fm_sta_lbdw_scw.Vxx_dtc_stt_xxx ECU_ADDRESS 0xd00052f9 /end MEASUREMENT
/begin MEASUREMENT Vxx_dfctr_lbup_cpt "" UWORD _CNV_A_R_A_105_CM 1 0. 0. 65535. DISPLAY_IDENTIFIER fm_sta_lbup_cpt.Vxx_dfctr_xxx ECU_ADDRESS 0xd0005516 /end MEASUREMENT
/begin MEASUREMENT Vxx_rdn_lbup_cpt "" UWORD _CNV_A_R_A_105_CM 1 0. 0. 65535. DISPLAY_IDENTIFIER fm_sta_lbup_cpt.Vxx_rdn_xxx ECU_ADDRESS 0xd0005518 /end MEASUREMENT
/begin MEASUREMENT Vbx_cf_lbup_cpt "" UBYTE _CNV_A_R_A_105_CM 1 0. 0. 255. DISPLAY_IDENTIFIER fm_sta_lbup_cpt.fm_static_bitfield.Vbx_cf_xxx ECU_ADDRESS 0xd000551a BIT_MASK 0x1 /end MEASUREMENT
/begin MEASUREMENT Vbx_clf_lbup_cpt "" UBYTE _CNV_A_R_A_105_CM 1 0. 0. 255. DISPLAY_IDENTIFIER fm_sta_lbup_cpt.fm_static_bitfield.Vbx_clf_xxx ECU_ADDRESS 0xd000551a BIT_MASK 0x2 /end MEASUREMENT
/begin MEASUREMENT Vbx_df_old_lbup_cpt "" UBYTE _CNV_A_R_A_105_CM 1 0. 0. 255. DISPLAY_IDENTIFIER fm_sta_lbup_cpt.fm_static_bitfield.Vbx_df_old_xxx ECU_ADDRESS 0xd000551a BIT_MASK 0x4 /end MEASUREMENT
/begin MEASUREMENT Vbx_dfctr_sat_lbup_cpt "" UBYTE _CNV_A_R_A_105_CM 1 0. 0. 255. DISPLAY_IDENTIFIER fm_sta_lbup_cpt.fm_static_bitfield.Vbx_dfctr_sat_xxx ECU_ADDRESS 0xd000551a BIT_MASK 0x8 /end MEASUREMENT
/begin MEASUREMENT Vbx_rdn_lbup_cpt "" UBYTE _CNV_A_R_A_105_CM 1 0. 0. 255. DISPLAY_IDENTIFIER fm_sta_lbup_cpt.fm_static_bitfield.Vbx_rdn_xxx ECU_ADDRESS 0xd000551a BIT_MASK 0x40 /end MEASUREMENT
/begin MEASUREMENT Vxx_dtc_stt_lbup_cpt "" UBYTE _CNV_A_R_A_105_CM 1 0. 0. 255. DISPLAY_IDENTIFIER fm_sta_lbup_cpt.Vxx_dtc_stt_xxx ECU_ADDRESS 0xd000551b /end MEASUREMENT
/begin MEASUREMENT Vxx_dfctr_lbup_hot_apl_down "" UWORD _CNV_A_R_A_105_CM 1 0. 0. 65535. DISPLAY_IDENTIFIER fm_sta_lbup_hot_apl_down.Vxx_dfctr_xxx ECU_ADDRESS 0xd000560c /end MEASUREMENT
/begin MEASUREMENT Vxx_rdn_lbup_hot_apl_down "" UWORD _CNV_A_R_A_105_CM 1 0. 0. 65535. DISPLAY_IDENTIFIER fm_sta_lbup_hot_apl_down.Vxx_rdn_xxx ECU_ADDRESS 0xd000560e /end MEASUREMENT
/begin MEASUREMENT Vbx_cf_lbup_hot_apl_down "" UBYTE _CNV_A_R_A_105_CM 1 0. 0. 255. DISPLAY_IDENTIFIER fm_sta_lbup_hot_apl_down.fm_static_bitfield.Vbx_cf_xxx ECU_ADDRESS 0xd0005610 BIT_MASK 0x1 /end MEASUREMENT
/begin MEASUREMENT Vbx_clf_lbup_hot_apl_down "" UBYTE _CNV_A_R_A_105_CM 1 0. 0. 255. DISPLAY_IDENTIFIER fm_sta_lbup_hot_apl_down.fm_static_bitfield.Vbx_clf_xxx ECU_ADDRESS 0xd0005610 BIT_MASK 0x2 /end MEASUREMENT
/begin MEASUREMENT Vbx_df_old_lbup_hot_apl_down "" UBYTE _CNV_A_R_A_105_CM 1 0. 0. 255. DISPLAY_IDENTIFIER fm_sta_lbup_hot_apl_down.fm_static_bitfield.Vbx_df_old_xxx ECU_ADDRESS 0xd0005610 BIT_MASK 0x4 /end MEASUREMENT
/begin MEASUREMENT Vbx_dfctr_sat_lbup_hot_apl_down "" UBYTE _CNV_A_R_A_105_CM 1 0. 0. 255. DISPLAY_IDENTIFIER fm_sta_lbup_hot_apl_down.fm_static_bitfield.Vbx_dfctr_sat_xxx ECU_ADDRESS 0xd0005610 BIT_MASK 0x8 /end MEASUREMENT
/begin MEASUREMENT Vbx_rdn_lbup_hot_apl_down "" UBYTE _CNV_A_R_A_105_CM 1 0. 0. 255. DISPLAY_IDENTIFIER fm_sta_lbup_hot_apl_down.fm_static_bitfield.Vbx_rdn_xxx ECU_ADDRESS 0xd0005610 BIT_MASK 0x40 /end MEASUREMENT
/begin MEASUREMENT Vxx_dtc_stt_lbup_hot_apl_down "" UBYTE _CNV_A_R_A_105_CM 1 0. 0. 255. DISPLAY_IDENTIFIER fm_sta_lbup_hot_apl_down.Vxx_dtc_stt_xxx ECU_ADDRESS 0xd0005611 /end MEASUREMENT
/begin MEASUREMENT Vxx_dfctr_lbup_hot_dirt_lkg "" UWORD _CNV_A_R_A_105_CM 1 0. 0. 65535. DISPLAY_IDENTIFIER fm_sta_lbup_hot_dirt_lkg.Vxx_dfctr_xxx ECU_ADDRESS 0xd000565a /end MEASUREMENT
/begin MEASUREMENT Vxx_rdn_lbup_hot_dirt_lkg "" UWORD _CNV_A_R_A_105_CM 1 0. 0. 65535. DISPLAY_IDENTIFIER fm_sta_lbup_hot_dirt_lkg.Vxx_rdn_xxx ECU_ADDRESS 0xd000565c /end MEASUREMENT
/begin MEASUREMENT Vbx_cf_lbup_hot_dirt_lkg "" UBYTE _CNV_A_R_A_105_CM 1 0. 0. 255. DISPLAY_IDENTIFIER fm_sta_lbup_hot_dirt_lkg.fm_static_bitfield.Vbx_cf_xxx ECU_ADDRESS 0xd000565e BIT_MASK 0x1 /end MEASUREMENT
/begin MEASUREMENT Vbx_clf_lbup_hot_dirt_lkg "" UBYTE _CNV_A_R_A_105_CM 1 0. 0. 255. DISPLAY_IDENTIFIER fm_sta_lbup_hot_dirt_lkg.fm_static_bitfield.Vbx_clf_xxx ECU_ADDRESS 0xd000565e BIT_MASK 0x2 /end MEASUREMENT
/begin MEASUREMENT Vbx_df_old_lbup_hot_dirt_lkg "" UBYTE _CNV_A_R_A_105_CM 1 0. 0. 255. DISPLAY_IDENTIFIER fm_sta_lbup_hot_dirt_lkg.fm_static_bitfield.Vbx_df_old_xxx ECU_ADDRESS 0xd000565e BIT_MASK 0x4 /end MEASUREMENT
/begin MEASUREMENT Vbx_dfctr_sat_lbup_hot_dirt_lkg "" UBYTE _CNV_A_R_A_105_CM 1 0. 0. 255. DISPLAY_IDENTIFIER fm_sta_lbup_hot_dirt_lkg.fm_static_bitfield.Vbx_dfctr_sat_xxx ECU_ADDRESS 0xd000565e BIT_MASK 0x8 /end MEASUREMENT
/begin MEASUREMENT Vbx_rdn_lbup_hot_dirt_lkg "" UBYTE _CNV_A_R_A_105_CM 1 0. 0. 255. DISPLAY_IDENTIFIER fm_sta_lbup_hot_dirt_lkg.fm_static_bitfield.Vbx_rdn_xxx ECU_ADDRESS 0xd000565e BIT_MASK 0x40 /end MEASUREMENT
/begin MEASUREMENT Vxx_dtc_stt_lbup_hot_dirt_lkg "" UBYTE _CNV_A_R_A_105_CM 1 0. 0. 255. DISPLAY_IDENTIFIER fm_sta_lbup_hot_dirt_lkg.Vxx_dtc_stt_xxx ECU_ADDRESS 0xd000565f /end MEASUREMENT
/begin MEASUREMENT Vxx_dfctr_lbup_hot_oc "" UWORD _CNV_A_R_A_105_CM 1 0. 0. 65535. DISPLAY_IDENTIFIER fm_sta_lbup_hot_oc.Vxx_dfctr_xxx ECU_ADDRESS 0xd0005408 /end MEASUREMENT
/begin MEASUREMENT Vxx_rdn_lbup_hot_oc "" UWORD _CNV_A_R_A_105_CM 1 0. 0. 65535. DISPLAY_IDENTIFIER fm_sta_lbup_hot_oc.Vxx_rdn_xxx ECU_ADDRESS 0xd000540a /end MEASUREMENT
/begin MEASUREMENT Vbx_cf_lbup_hot_oc "" UBYTE _CNV_A_R_A_105_CM 1 0. 0. 255. DISPLAY_IDENTIFIER fm_sta_lbup_hot_oc.fm_static_bitfield.Vbx_cf_xxx ECU_ADDRESS 0xd000540c BIT_MASK 0x1 /end MEASUREMENT
/begin MEASUREMENT Vbx_clf_lbup_hot_oc "" UBYTE _CNV_A_R_A_105_CM 1 0. 0. 255. DISPLAY_IDENTIFIER fm_sta_lbup_hot_oc.fm_static_bitfield.Vbx_clf_xxx ECU_ADDRESS 0xd000540c BIT_MASK 0x2 /end MEASUREMENT
/begin MEASUREMENT Vbx_df_old_lbup_hot_oc "" UBYTE _CNV_A_R_A_105_CM 1 0. 0. 255. DISPLAY_IDENTIFIER fm_sta_lbup_hot_oc.fm_static_bitfield.Vbx_df_old_xxx ECU_ADDRESS 0xd000540c BIT_MASK 0x4 /end MEASUREMENT
/begin MEASUREMENT Vbx_dfctr_sat_lbup_hot_oc "" UBYTE _CNV_A_R_A_105_CM 1 0. 0. 255. DISPLAY_IDENTIFIER fm_sta_lbup_hot_oc.fm_static_bitfield.Vbx_dfctr_sat_xxx ECU_ADDRESS 0xd000540c BIT_MASK 0x8 /end MEASUREMENT
/begin MEASUREMENT Vbx_rdn_lbup_hot_oc "" UBYTE _CNV_A_R_A_105_CM 1 0. 0. 255. DISPLAY_IDENTIFIER fm_sta_lbup_hot_oc.fm_static_bitfield.Vbx_rdn_xxx ECU_ADDRESS 0xd000540c BIT_MASK 0x40 /end MEASUREMENT
/begin MEASUREMENT Vxx_dtc_stt_lbup_hot_oc "" UBYTE _CNV_A_R_A_105_CM 1 0. 0. 255. DISPLAY_IDENTIFIER fm_sta_lbup_hot_oc.Vxx_dtc_stt_xxx ECU_ADDRESS 0xd000540d /end MEASUREMENT
/begin MEASUREMENT Vxx_dfctr_lbup_hot_scg "" UWORD _CNV_A_R_A_105_CM 1 0. 0. 65535. DISPLAY_IDENTIFIER fm_sta_lbup_hot_scg.Vxx_dfctr_xxx ECU_ADDRESS 0xd000540e /end MEASUREMENT
/begin MEASUREMENT Vxx_rdn_lbup_hot_scg "" UWORD _CNV_A_R_A_105_CM 1 0. 0. 65535. DISPLAY_IDENTIFIER fm_sta_lbup_hot_scg.Vxx_rdn_xxx ECU_ADDRESS 0xd0005410 /end MEASUREMENT
/begin MEASUREMENT Vbx_cf_lbup_hot_scg "" UBYTE _CNV_A_R_A_105_CM 1 0. 0. 255. DISPLAY_IDENTIFIER fm_sta_lbup_hot_scg.fm_static_bitfield.Vbx_cf_xxx ECU_ADDRESS 0xd0005412 BIT_MASK 0x1 /end MEASUREMENT
/begin MEASUREMENT Vbx_clf_lbup_hot_scg "" UBYTE _CNV_A_R_A_105_CM 1 0. 0. 255. DISPLAY_IDENTIFIER fm_sta_lbup_hot_scg.fm_static_bitfield.Vbx_clf_xxx ECU_ADDRESS 0xd0005412 BIT_MASK 0x2 /end MEASUREMENT
/begin MEASUREMENT Vbx_df_old_lbup_hot_scg "" UBYTE _CNV_A_R_A_105_CM 1 0. 0. 255. DISPLAY_IDENTIFIER fm_sta_lbup_hot_scg.fm_static_bitfield.Vbx_df_old_xxx ECU_ADDRESS 0xd0005412 BIT_MASK 0x4 /end MEASUREMENT
/begin MEASUREMENT Vbx_dfctr_sat_lbup_hot_scg "" UBYTE _CNV_A_R_A_105_CM 1 0. 0. 255. DISPLAY_IDENTIFIER fm_sta_lbup_hot_scg.fm_static_bitfield.Vbx_dfctr_sat_xxx ECU_ADDRESS 0xd0005412 BIT_MASK 0x8 /end MEASUREMENT
/begin MEASUREMENT Vbx_rdn_lbup_hot_scg "" UBYTE _CNV_A_R_A_105_CM 1 0. 0. 255. DISPLAY_IDENTIFIER fm_sta_lbup_hot_scg.fm_static_bitfield.Vbx_rdn_xxx ECU_ADDRESS 0xd0005412 BIT_MASK 0x40 /end MEASUREMENT
/begin MEASUREMENT Vxx_dtc_stt_lbup_hot_scg "" UBYTE _CNV_A_R_A_105_CM 1 0. 0. 255. DISPLAY_IDENTIFIER fm_sta_lbup_hot_scg.Vxx_dtc_stt_xxx ECU_ADDRESS 0xd0005413 /end MEASUREMENT
/begin MEASUREMENT Vxx_dfctr_lbup_hot_scw "" UWORD _CNV_A_R_A_105_CM 1 0. 0. 65535. DISPLAY_IDENTIFIER fm_sta_lbup_hot_scw.Vxx_dfctr_xxx ECU_ADDRESS 0xd0005414 /end MEASUREMENT
/begin MEASUREMENT Vxx_rdn_lbup_hot_scw "" UWORD _CNV_A_R_A_105_CM 1 0. 0. 65535. DISPLAY_IDENTIFIER fm_sta_lbup_hot_scw.Vxx_rdn_xxx ECU_ADDRESS 0xd0005416 /end MEASUREMENT
/begin MEASUREMENT Vbx_cf_lbup_hot_scw "" UBYTE _CNV_A_R_A_105_CM 1 0. 0. 255. DISPLAY_IDENTIFIER fm_sta_lbup_hot_scw.fm_static_bitfield.Vbx_cf_xxx ECU_ADDRESS 0xd0005418 BIT_MASK 0x1 /end MEASUREMENT
/begin MEASUREMENT Vbx_clf_lbup_hot_scw "" UBYTE _CNV_A_R_A_105_CM 1 0. 0. 255. DISPLAY_IDENTIFIER fm_sta_lbup_hot_scw.fm_static_bitfield.Vbx_clf_xxx ECU_ADDRESS 0xd0005418 BIT_MASK 0x2 /end MEASUREMENT
/begin MEASUREMENT Vbx_df_old_lbup_hot_scw "" UBYTE _CNV_A_R_A_105_CM 1 0. 0. 255. DISPLAY_IDENTIFIER fm_sta_lbup_hot_scw.fm_static_bitfield.Vbx_df_old_xxx ECU_ADDRESS 0xd0005418 BIT_MASK 0x4 /end MEASUREMENT
/begin MEASUREMENT Vbx_dfctr_sat_lbup_hot_scw "" UBYTE _CNV_A_R_A_105_CM 1 0. 0. 255. DISPLAY_IDENTIFIER fm_sta_lbup_hot_scw.fm_static_bitfield.Vbx_dfctr_sat_xxx ECU_ADDRESS 0xd0005418 BIT_MASK 0x8 /end MEASUREMENT
/begin MEASUREMENT Vbx_rdn_lbup_hot_scw "" UBYTE _CNV_A_R_A_105_CM 1 0. 0. 255. DISPLAY_IDENTIFIER fm_sta_lbup_hot_scw.fm_static_bitfield.Vbx_rdn_xxx ECU_ADDRESS 0xd0005418 BIT_MASK 0x40 /end MEASUREMENT
/begin MEASUREMENT Vxx_dtc_stt_lbup_hot_scw "" UBYTE _CNV_A_R_A_105_CM 1 0. 0. 255. DISPLAY_IDENTIFIER fm_sta_lbup_hot_scw.Vxx_dtc_stt_xxx ECU_ADDRESS 0xd0005419 /end MEASUREMENT
/begin MEASUREMENT Vxx_dfctr_lbup_nok "" UWORD _CNV_A_R_A_105_CM 1 0. 0. 65535. DISPLAY_IDENTIFIER fm_sta_lbup_nok.Vxx_dfctr_xxx ECU_ADDRESS 0xd0005606 /end MEASUREMENT
/begin MEASUREMENT Vxx_rdn_lbup_nok "" UWORD _CNV_A_R_A_105_CM 1 0. 0. 65535. DISPLAY_IDENTIFIER fm_sta_lbup_nok.Vxx_rdn_xxx ECU_ADDRESS 0xd0005608 /end MEASUREMENT
/begin MEASUREMENT Vbx_cf_lbup_nok "" UBYTE _CNV_A_R_A_105_CM 1 0. 0. 255. DISPLAY_IDENTIFIER fm_sta_lbup_nok.fm_static_bitfield.Vbx_cf_xxx ECU_ADDRESS 0xd000560a BIT_MASK 0x1 /end MEASUREMENT
/begin MEASUREMENT Vbx_clf_lbup_nok "" UBYTE _CNV_A_R_A_105_CM 1 0. 0. 255. DISPLAY_IDENTIFIER fm_sta_lbup_nok.fm_static_bitfield.Vbx_clf_xxx ECU_ADDRESS 0xd000560a BIT_MASK 0x2 /end MEASUREMENT
/begin MEASUREMENT Vbx_df_old_lbup_nok "" UBYTE _CNV_A_R_A_105_CM 1 0. 0. 255. DISPLAY_IDENTIFIER fm_sta_lbup_nok.fm_static_bitfield.Vbx_df_old_xxx ECU_ADDRESS 0xd000560a BIT_MASK 0x4 /end MEASUREMENT
/begin MEASUREMENT Vbx_dfctr_sat_lbup_nok "" UBYTE _CNV_A_R_A_105_CM 1 0. 0. 255. DISPLAY_IDENTIFIER fm_sta_lbup_nok.fm_static_bitfield.Vbx_dfctr_sat_xxx ECU_ADDRESS 0xd000560a BIT_MASK 0x8 /end MEASUREMENT
/begin MEASUREMENT Vbx_rdn_lbup_nok "" UBYTE _CNV_A_R_A_105_CM 1 0. 0. 255. DISPLAY_IDENTIFIER fm_sta_lbup_nok.fm_static_bitfield.Vbx_rdn_xxx ECU_ADDRESS 0xd000560a BIT_MASK 0x40 /end MEASUREMENT
/begin MEASUREMENT Vxx_dtc_stt_lbup_nok "" UBYTE _CNV_A_R_A_105_CM 1 0. 0. 255. DISPLAY_IDENTIFIER fm_sta_lbup_nok.Vxx_dtc_stt_xxx ECU_ADDRESS 0xd000560b /end MEASUREMENT
/begin MEASUREMENT Vxx_dfctr_lbup_oc "" UWORD _CNV_A_R_A_105_CM 1 0. 0. 65535. DISPLAY_IDENTIFIER fm_sta_lbup_oc.Vxx_dfctr_xxx ECU_ADDRESS 0xd00052fa /end MEASUREMENT
/begin MEASUREMENT Vxx_rdn_lbup_oc "" UWORD _CNV_A_R_A_105_CM 1 0. 0. 65535. DISPLAY_IDENTIFIER fm_sta_lbup_oc.Vxx_rdn_xxx ECU_ADDRESS 0xd00052fc /end MEASUREMENT
/begin MEASUREMENT Vbx_cf_lbup_oc "" UBYTE _CNV_A_R_A_105_CM 1 0. 0. 255. DISPLAY_IDENTIFIER fm_sta_lbup_oc.fm_static_bitfield.Vbx_cf_xxx ECU_ADDRESS 0xd00052fe BIT_MASK 0x1 /end MEASUREMENT
/begin MEASUREMENT Vbx_clf_lbup_oc "" UBYTE _CNV_A_R_A_105_CM 1 0. 0. 255. DISPLAY_IDENTIFIER fm_sta_lbup_oc.fm_static_bitfield.Vbx_clf_xxx ECU_ADDRESS 0xd00052fe BIT_MASK 0x2 /end MEASUREMENT
/begin MEASUREMENT Vbx_df_old_lbup_oc "" UBYTE _CNV_A_R_A_105_CM 1 0. 0. 255. DISPLAY_IDENTIFIER fm_sta_lbup_oc.fm_static_bitfield.Vbx_df_old_xxx ECU_ADDRESS 0xd00052fe BIT_MASK 0x4 /end MEASUREMENT
/begin MEASUREMENT Vbx_dfctr_sat_lbup_oc "" UBYTE _CNV_A_R_A_105_CM 1 0. 0. 255. DISPLAY_IDENTIFIER fm_sta_lbup_oc.fm_static_bitfield.Vbx_dfctr_sat_xxx ECU_ADDRESS 0xd00052fe BIT_MASK 0x8 /end MEASUREMENT
/begin MEASUREMENT Vbx_rdn_lbup_oc "" UBYTE _CNV_A_R_A_105_CM 1 0. 0. 255. DISPLAY_IDENTIFIER fm_sta_lbup_oc.fm_static_bitfield.Vbx_rdn_xxx ECU_ADDRESS 0xd00052fe BIT_MASK 0x40 /end MEASUREMENT
/begin MEASUREMENT Vxx_dtc_stt_lbup_oc "" UBYTE _CNV_A_R_A_105_CM 1 0. 0. 255. DISPLAY_IDENTIFIER fm_sta_lbup_oc.Vxx_dtc_stt_xxx ECU_ADDRESS 0xd00052ff /end MEASUREMENT
/begin MEASUREMENT Vxx_dfctr_lbup_scg "" UWORD _CNV_A_R_A_105_CM 1 0. 0. 65535. DISPLAY_IDENTIFIER fm_sta_lbup_scg.Vxx_dfctr_xxx ECU_ADDRESS 0xd0005300 /end MEASUREMENT
/begin MEASUREMENT Vxx_rdn_lbup_scg "" UWORD _CNV_A_R_A_105_CM 1 0. 0. 65535. DISPLAY_IDENTIFIER fm_sta_lbup_scg.Vxx_rdn_xxx ECU_ADDRESS 0xd0005302 /end MEASUREMENT
/begin MEASUREMENT Vbx_cf_lbup_scg "" UBYTE _CNV_A_R_A_105_CM 1 0. 0. 255. DISPLAY_IDENTIFIER fm_sta_lbup_scg.fm_static_bitfield.Vbx_cf_xxx ECU_ADDRESS 0xd0005304 BIT_MASK 0x1 /end MEASUREMENT
/begin MEASUREMENT Vbx_clf_lbup_scg "" UBYTE _CNV_A_R_A_105_CM 1 0. 0. 255. DISPLAY_IDENTIFIER fm_sta_lbup_scg.fm_static_bitfield.Vbx_clf_xxx ECU_ADDRESS 0xd0005304 BIT_MASK 0x2 /end MEASUREMENT
/begin MEASUREMENT Vbx_df_old_lbup_scg "" UBYTE _CNV_A_R_A_105_CM 1 0. 0. 255. DISPLAY_IDENTIFIER fm_sta_lbup_scg.fm_static_bitfield.Vbx_df_old_xxx ECU_ADDRESS 0xd0005304 BIT_MASK 0x4 /end MEASUREMENT
/begin MEASUREMENT Vbx_dfctr_sat_lbup_scg "" UBYTE _CNV_A_R_A_105_CM 1 0. 0. 255. DISPLAY_IDENTIFIER fm_sta_lbup_scg.fm_static_bitfield.Vbx_dfctr_sat_xxx ECU_ADDRESS 0xd0005304 BIT_MASK 0x8 /end MEASUREMENT
/begin MEASUREMENT Vbx_rdn_lbup_scg "" UBYTE _CNV_A_R_A_105_CM 1 0. 0. 255. DISPLAY_IDENTIFIER fm_sta_lbup_scg.fm_static_bitfield.Vbx_rdn_xxx ECU_ADDRESS 0xd0005304 BIT_MASK 0x40 /end MEASUREMENT
/begin MEASUREMENT Vxx_dtc_stt_lbup_scg "" UBYTE _CNV_A_R_A_105_CM 1 0. 0. 255. DISPLAY_IDENTIFIER fm_sta_lbup_scg.Vxx_dtc_stt_xxx ECU_ADDRESS 0xd0005305 /end MEASUREMENT
/begin MEASUREMENT Vxx_dfctr_lbup_scw "" UWORD _CNV_A_R_A_105_CM 1 0. 0. 65535. DISPLAY_IDENTIFIER fm_sta_lbup_scw.Vxx_dfctr_xxx ECU_ADDRESS 0xd0005306 /end MEASUREMENT
/begin MEASUREMENT Vxx_rdn_lbup_scw "" UWORD _CNV_A_R_A_105_CM 1 0. 0. 65535. DISPLAY_IDENTIFIER fm_sta_lbup_scw.Vxx_rdn_xxx ECU_ADDRESS 0xd0005308 /end MEASUREMENT
/begin MEASUREMENT Vbx_cf_lbup_scw "" UBYTE _CNV_A_R_A_105_CM 1 0. 0. 255. DISPLAY_IDENTIFIER fm_sta_lbup_scw.fm_static_bitfield.Vbx_cf_xxx ECU_ADDRESS 0xd000530a BIT_MASK 0x1 /end MEASUREMENT
/begin MEASUREMENT Vbx_clf_lbup_scw "" UBYTE _CNV_A_R_A_105_CM 1 0. 0. 255. DISPLAY_IDENTIFIER fm_sta_lbup_scw.fm_static_bitfield.Vbx_clf_xxx ECU_ADDRESS 0xd000530a BIT_MASK 0x2 /end MEASUREMENT
/begin MEASUREMENT Vbx_df_old_lbup_scw "" UBYTE _CNV_A_R_A_105_CM 1 0. 0. 255. DISPLAY_IDENTIFIER fm_sta_lbup_scw.fm_static_bitfield.Vbx_df_old_xxx ECU_ADDRESS 0xd000530a BIT_MASK 0x4 /end MEASUREMENT
/begin MEASUREMENT Vbx_dfctr_sat_lbup_scw "" UBYTE _CNV_A_R_A_105_CM 1 0. 0. 255. DISPLAY_IDENTIFIER fm_sta_lbup_scw.fm_static_bitfield.Vbx_dfctr_sat_xxx ECU_ADDRESS 0xd000530a BIT_MASK 0x8 /end MEASUREMENT
/begin MEASUREMENT Vbx_rdn_lbup_scw "" UBYTE _CNV_A_R_A_105_CM 1 0. 0. 255. DISPLAY_IDENTIFIER fm_sta_lbup_scw.fm_static_bitfield.Vbx_rdn_xxx ECU_ADDRESS 0xd000530a BIT_MASK 0x40 /end MEASUREMENT
/begin MEASUREMENT Vxx_dtc_stt_lbup_scw "" UBYTE _CNV_A_R_A_105_CM 1 0. 0. 255. DISPLAY_IDENTIFIER fm_sta_lbup_scw.Vxx_dtc_stt_xxx ECU_ADDRESS 0xd000530b /end MEASUREMENT
/begin MEASUREMENT Vxx_dfctr_lbup_shf_h "" UWORD _CNV_A_R_A_105_CM 1 0. 0. 65535. DISPLAY_IDENTIFIER fm_sta_lbup_shf_h.Vxx_dfctr_xxx ECU_ADDRESS 0xd0005690 /end MEASUREMENT
/begin MEASUREMENT Vxx_rdn_lbup_shf_h "" UWORD _CNV_A_R_A_105_CM 1 0. 0. 65535. DISPLAY_IDENTIFIER fm_sta_lbup_shf_h.Vxx_rdn_xxx ECU_ADDRESS 0xd0005692 /end MEASUREMENT
/begin MEASUREMENT Vbx_cf_lbup_shf_h "" UBYTE _CNV_A_R_A_105_CM 1 0. 0. 255. DISPLAY_IDENTIFIER fm_sta_lbup_shf_h.fm_static_bitfield.Vbx_cf_xxx ECU_ADDRESS 0xd0005694 BIT_MASK 0x1 /end MEASUREMENT
/begin MEASUREMENT Vbx_clf_lbup_shf_h "" UBYTE _CNV_A_R_A_105_CM 1 0. 0. 255. DISPLAY_IDENTIFIER fm_sta_lbup_shf_h.fm_static_bitfield.Vbx_clf_xxx ECU_ADDRESS 0xd0005694 BIT_MASK 0x2 /end MEASUREMENT
/begin MEASUREMENT Vbx_df_old_lbup_shf_h "" UBYTE _CNV_A_R_A_105_CM 1 0. 0. 255. DISPLAY_IDENTIFIER fm_sta_lbup_shf_h.fm_static_bitfield.Vbx_df_old_xxx ECU_ADDRESS 0xd0005694 BIT_MASK 0x4 /end MEASUREMENT
/begin MEASUREMENT Vbx_dfctr_sat_lbup_shf_h "" UBYTE _CNV_A_R_A_105_CM 1 0. 0. 255. DISPLAY_IDENTIFIER fm_sta_lbup_shf_h.fm_static_bitfield.Vbx_dfctr_sat_xxx ECU_ADDRESS 0xd0005694 BIT_MASK 0x8 /end MEASUREMENT
/begin MEASUREMENT Vbx_rdn_lbup_shf_h "" UBYTE _CNV_A_R_A_105_CM 1 0. 0. 255. DISPLAY_IDENTIFIER fm_sta_lbup_shf_h.fm_static_bitfield.Vbx_rdn_xxx ECU_ADDRESS 0xd0005694 BIT_MASK 0x40 /end MEASUREMENT
/begin MEASUREMENT Vxx_dtc_stt_lbup_shf_h "" UBYTE _CNV_A_R_A_105_CM 1 0. 0. 255. DISPLAY_IDENTIFIER fm_sta_lbup_shf_h.Vxx_dtc_stt_xxx ECU_ADDRESS 0xd0005695 /end MEASUREMENT
/begin MEASUREMENT Vxx_dfctr_lbup_shf_l "" UWORD _CNV_A_R_A_105_CM 1 0. 0. 65535. DISPLAY_IDENTIFIER fm_sta_lbup_shf_l.Vxx_dfctr_xxx ECU_ADDRESS 0xd0005696 /end MEASUREMENT
/begin MEASUREMENT Vxx_rdn_lbup_shf_l "" UWORD _CNV_A_R_A_105_CM 1 0. 0. 65535. DISPLAY_IDENTIFIER fm_sta_lbup_shf_l.Vxx_rdn_xxx ECU_ADDRESS 0xd0005698 /end MEASUREMENT
/begin MEASUREMENT Vbx_cf_lbup_shf_l "" UBYTE _CNV_A_R_A_105_CM 1 0. 0. 255. DISPLAY_IDENTIFIER fm_sta_lbup_shf_l.fm_static_bitfield.Vbx_cf_xxx ECU_ADDRESS 0xd000569a BIT_MASK 0x1 /end MEASUREMENT
/begin MEASUREMENT Vbx_clf_lbup_shf_l "" UBYTE _CNV_A_R_A_105_CM 1 0. 0. 255. DISPLAY_IDENTIFIER fm_sta_lbup_shf_l.fm_static_bitfield.Vbx_clf_xxx ECU_ADDRESS 0xd000569a BIT_MASK 0x2 /end MEASUREMENT
/begin MEASUREMENT Vbx_df_old_lbup_shf_l "" UBYTE _CNV_A_R_A_105_CM 1 0. 0. 255. DISPLAY_IDENTIFIER fm_sta_lbup_shf_l.fm_static_bitfield.Vbx_df_old_xxx ECU_ADDRESS 0xd000569a BIT_MASK 0x4 /end MEASUREMENT
/begin MEASUREMENT Vbx_dfctr_sat_lbup_shf_l "" UBYTE _CNV_A_R_A_105_CM 1 0. 0. 255. DISPLAY_IDENTIFIER fm_sta_lbup_shf_l.fm_static_bitfield.Vbx_dfctr_sat_xxx ECU_ADDRESS 0xd000569a BIT_MASK 0x8 /end MEASUREMENT
/begin MEASUREMENT Vbx_rdn_lbup_shf_l "" UBYTE _CNV_A_R_A_105_CM 1 0. 0. 255. DISPLAY_IDENTIFIER fm_sta_lbup_shf_l.fm_static_bitfield.Vbx_rdn_xxx ECU_ADDRESS 0xd000569a BIT_MASK 0x40 /end MEASUREMENT
/begin MEASUREMENT Vxx_dtc_stt_lbup_shf_l "" UBYTE _CNV_A_R_A_105_CM 1 0. 0. 255. DISPLAY_IDENTIFIER fm_sta_lbup_shf_l.Vxx_dtc_stt_xxx ECU_ADDRESS 0xd000569b /end MEASUREMENT
/begin MEASUREMENT Vxx_dfctr_map_chr "" UWORD _CNV_A_R_A_105_CM 1 0. 0. 65535. DISPLAY_IDENTIFIER fm_sta_map_chr.Vxx_dfctr_xxx ECU_ADDRESS 0xd000541a /end MEASUREMENT
/begin MEASUREMENT Vxx_rdn_map_chr "" UWORD _CNV_A_R_A_105_CM 1 0. 0. 65535. DISPLAY_IDENTIFIER fm_sta_map_chr.Vxx_rdn_xxx ECU_ADDRESS 0xd000541c /end MEASUREMENT
/begin MEASUREMENT Vbx_cf_map_chr "" UBYTE _CNV_A_R_A_105_CM 1 0. 0. 255. DISPLAY_IDENTIFIER fm_sta_map_chr.fm_static_bitfield.Vbx_cf_xxx ECU_ADDRESS 0xd000541e BIT_MASK 0x1 /end MEASUREMENT
/begin MEASUREMENT Vbx_clf_map_chr "" UBYTE _CNV_A_R_A_105_CM 1 0. 0. 255. DISPLAY_IDENTIFIER fm_sta_map_chr.fm_static_bitfield.Vbx_clf_xxx ECU_ADDRESS 0xd000541e BIT_MASK 0x2 /end MEASUREMENT
/begin MEASUREMENT Vbx_df_old_map_chr "" UBYTE _CNV_A_R_A_105_CM 1 0. 0. 255. DISPLAY_IDENTIFIER fm_sta_map_chr.fm_static_bitfield.Vbx_df_old_xxx ECU_ADDRESS 0xd000541e BIT_MASK 0x4 /end MEASUREMENT
/begin MEASUREMENT Vbx_dfctr_sat_map_chr "" UBYTE _CNV_A_R_A_105_CM 1 0. 0. 255. DISPLAY_IDENTIFIER fm_sta_map_chr.fm_static_bitfield.Vbx_dfctr_sat_xxx ECU_ADDRESS 0xd000541e BIT_MASK 0x8 /end MEASUREMENT
/begin MEASUREMENT Vbx_rdn_map_chr "" UBYTE _CNV_A_R_A_105_CM 1 0. 0. 255. DISPLAY_IDENTIFIER fm_sta_map_chr.fm_static_bitfield.Vbx_rdn_xxx ECU_ADDRESS 0xd000541e BIT_MASK 0x40 /end MEASUREMENT
/begin MEASUREMENT Vxx_dtc_stt_map_chr "" UBYTE _CNV_A_R_A_105_CM 1 0. 0. 255. DISPLAY_IDENTIFIER fm_sta_map_chr.Vxx_dtc_stt_xxx ECU_ADDRESS 0xd000541f /end MEASUREMENT
/begin MEASUREMENT Vxx_dfctr_map_oor "" UWORD _CNV_A_R_A_105_CM 1 0. 0. 65535. DISPLAY_IDENTIFIER fm_sta_map_oor.Vxx_dfctr_xxx ECU_ADDRESS 0xd0005420 /end MEASUREMENT
/begin MEASUREMENT Vxx_rdn_map_oor "" UWORD _CNV_A_R_A_105_CM 1 0. 0. 65535. DISPLAY_IDENTIFIER fm_sta_map_oor.Vxx_rdn_xxx ECU_ADDRESS 0xd0005422 /end MEASUREMENT
/begin MEASUREMENT Vbx_cf_map_oor "" UBYTE _CNV_A_R_A_105_CM 1 0. 0. 255. DISPLAY_IDENTIFIER fm_sta_map_oor.fm_static_bitfield.Vbx_cf_xxx ECU_ADDRESS 0xd0005424 BIT_MASK 0x1 /end MEASUREMENT
/begin MEASUREMENT Vbx_clf_map_oor "" UBYTE _CNV_A_R_A_105_CM 1 0. 0. 255. DISPLAY_IDENTIFIER fm_sta_map_oor.fm_static_bitfield.Vbx_clf_xxx ECU_ADDRESS 0xd0005424 BIT_MASK 0x2 /end MEASUREMENT
/begin MEASUREMENT Vbx_df_old_map_oor "" UBYTE _CNV_A_R_A_105_CM 1 0. 0. 255. DISPLAY_IDENTIFIER fm_sta_map_oor.fm_static_bitfield.Vbx_df_old_xxx ECU_ADDRESS 0xd0005424 BIT_MASK 0x4 /end MEASUREMENT
/begin MEASUREMENT Vbx_dfctr_sat_map_oor "" UBYTE _CNV_A_R_A_105_CM 1 0. 0. 255. DISPLAY_IDENTIFIER fm_sta_map_oor.fm_static_bitfield.Vbx_dfctr_sat_xxx ECU_ADDRESS 0xd0005424 BIT_MASK 0x8 /end MEASUREMENT
/begin MEASUREMENT Vbx_rdn_map_oor "" UBYTE _CNV_A_R_A_105_CM 1 0. 0. 255. DISPLAY_IDENTIFIER fm_sta_map_oor.fm_static_bitfield.Vbx_rdn_xxx ECU_ADDRESS 0xd0005424 BIT_MASK 0x40 /end MEASUREMENT
/begin MEASUREMENT Vxx_dtc_stt_map_oor "" UBYTE _CNV_A_R_A_105_CM 1 0. 0. 255. DISPLAY_IDENTIFIER fm_sta_map_oor.Vxx_dtc_stt_xxx ECU_ADDRESS 0xd0005425 /end MEASUREMENT
/begin MEASUREMENT Vxx_dfctr_mis_1_cata "" UWORD _CNV_A_R_A_105_CM 1 0. 0. 65535. DISPLAY_IDENTIFIER fm_sta_mis_1_cata.Vxx_dfctr_xxx ECU_ADDRESS 0xd0005426 /end MEASUREMENT
/begin MEASUREMENT Vxx_rdn_mis_1_cata "" UWORD _CNV_A_R_A_105_CM 1 0. 0. 65535. DISPLAY_IDENTIFIER fm_sta_mis_1_cata.Vxx_rdn_xxx ECU_ADDRESS 0xd0005428 /end MEASUREMENT
/begin MEASUREMENT Vbx_cf_mis_1_cata "" UBYTE _CNV_A_R_A_105_CM 1 0. 0. 255. DISPLAY_IDENTIFIER fm_sta_mis_1_cata.fm_static_bitfield.Vbx_cf_xxx ECU_ADDRESS 0xd000542a BIT_MASK 0x1 /end MEASUREMENT
/begin MEASUREMENT Vbx_clf_mis_1_cata "" UBYTE _CNV_A_R_A_105_CM 1 0. 0. 255. DISPLAY_IDENTIFIER fm_sta_mis_1_cata.fm_static_bitfield.Vbx_clf_xxx ECU_ADDRESS 0xd000542a BIT_MASK 0x2 /end MEASUREMENT
/begin MEASUREMENT Vbx_df_old_mis_1_cata "" UBYTE _CNV_A_R_A_105_CM 1 0. 0. 255. DISPLAY_IDENTIFIER fm_sta_mis_1_cata.fm_static_bitfield.Vbx_df_old_xxx ECU_ADDRESS 0xd000542a BIT_MASK 0x4 /end MEASUREMENT
/begin MEASUREMENT Vbx_dfctr_sat_mis_1_cata "" UBYTE _CNV_A_R_A_105_CM 1 0. 0. 255. DISPLAY_IDENTIFIER fm_sta_mis_1_cata.fm_static_bitfield.Vbx_dfctr_sat_xxx ECU_ADDRESS 0xd000542a BIT_MASK 0x8 /end MEASUREMENT
/begin MEASUREMENT Vbx_rdn_mis_1_cata "" UBYTE _CNV_A_R_A_105_CM 1 0. 0. 255. DISPLAY_IDENTIFIER fm_sta_mis_1_cata.fm_static_bitfield.Vbx_rdn_xxx ECU_ADDRESS 0xd000542a BIT_MASK 0x40 /end MEASUREMENT
/begin MEASUREMENT Vxx_dtc_stt_mis_1_cata "" UBYTE _CNV_A_R_A_105_CM 1 0. 0. 255. DISPLAY_IDENTIFIER fm_sta_mis_1_cata.Vxx_dtc_stt_xxx ECU_ADDRESS 0xd000542b /end MEASUREMENT
/begin MEASUREMENT Vxx_dfctr_mis_1_lpg_cata "" UWORD _CNV_A_R_A_105_CM 1 0. 0. 65535. DISPLAY_IDENTIFIER fm_sta_mis_1_lpg_cata.Vxx_dfctr_xxx ECU_ADDRESS 0xd000542c /end MEASUREMENT
/begin MEASUREMENT Vxx_rdn_mis_1_lpg_cata "" UWORD _CNV_A_R_A_105_CM 1 0. 0. 65535. DISPLAY_IDENTIFIER fm_sta_mis_1_lpg_cata.Vxx_rdn_xxx ECU_ADDRESS 0xd000542e /end MEASUREMENT
/begin MEASUREMENT Vbx_cf_mis_1_lpg_cata "" UBYTE _CNV_A_R_A_105_CM 1 0. 0. 255. DISPLAY_IDENTIFIER fm_sta_mis_1_lpg_cata.fm_static_bitfield.Vbx_cf_xxx ECU_ADDRESS 0xd0005430 BIT_MASK 0x1 /end MEASUREMENT
/begin MEASUREMENT Vbx_clf_mis_1_lpg_cata "" UBYTE _CNV_A_R_A_105_CM 1 0. 0. 255. DISPLAY_IDENTIFIER fm_sta_mis_1_lpg_cata.fm_static_bitfield.Vbx_clf_xxx ECU_ADDRESS 0xd0005430 BIT_MASK 0x2 /end MEASUREMENT
/begin MEASUREMENT Vbx_df_old_mis_1_lpg_cata "" UBYTE _CNV_A_R_A_105_CM 1 0. 0. 255. DISPLAY_IDENTIFIER fm_sta_mis_1_lpg_cata.fm_static_bitfield.Vbx_df_old_xxx ECU_ADDRESS 0xd0005430 BIT_MASK 0x4 /end MEASUREMENT
/begin MEASUREMENT Vbx_dfctr_sat_mis_1_lpg_cata "" UBYTE _CNV_A_R_A_105_CM 1 0. 0. 255. DISPLAY_IDENTIFIER fm_sta_mis_1_lpg_cata.fm_static_bitfield.Vbx_dfctr_sat_xxx ECU_ADDRESS 0xd0005430 BIT_MASK 0x8 /end MEASUREMENT
/begin MEASUREMENT Vbx_rdn_mis_1_lpg_cata "" UBYTE _CNV_A_R_A_105_CM 1 0. 0. 255. DISPLAY_IDENTIFIER fm_sta_mis_1_lpg_cata.fm_static_bitfield.Vbx_rdn_xxx ECU_ADDRESS 0xd0005430 BIT_MASK 0x40 /end MEASUREMENT
/begin MEASUREMENT Vxx_dtc_stt_mis_1_lpg_cata "" UBYTE _CNV_A_R_A_105_CM 1 0. 0. 255. DISPLAY_IDENTIFIER fm_sta_mis_1_lpg_cata.Vxx_dtc_stt_xxx ECU_ADDRESS 0xd0005431 /end MEASUREMENT
/begin MEASUREMENT Vxx_dfctr_mis_1_lpg_trs_h "" UWORD _CNV_A_R_A_105_CM 1 0. 0. 65535. DISPLAY_IDENTIFIER fm_sta_mis_1_lpg_trs_h.Vxx_dfctr_xxx ECU_ADDRESS 0xd0005432 /end MEASUREMENT
/begin MEASUREMENT Vxx_rdn_mis_1_lpg_trs_h "" UWORD _CNV_A_R_A_105_CM 1 0. 0. 65535. DISPLAY_IDENTIFIER fm_sta_mis_1_lpg_trs_h.Vxx_rdn_xxx ECU_ADDRESS 0xd0005434 /end MEASUREMENT
/begin MEASUREMENT Vbx_cf_mis_1_lpg_trs_h "" UBYTE _CNV_A_R_A_105_CM 1 0. 0. 255. DISPLAY_IDENTIFIER fm_sta_mis_1_lpg_trs_h.fm_static_bitfield.Vbx_cf_xxx ECU_ADDRESS 0xd0005436 BIT_MASK 0x1 /end MEASUREMENT
/begin MEASUREMENT Vbx_clf_mis_1_lpg_trs_h "" UBYTE _CNV_A_R_A_105_CM 1 0. 0. 255. DISPLAY_IDENTIFIER fm_sta_mis_1_lpg_trs_h.fm_static_bitfield.Vbx_clf_xxx ECU_ADDRESS 0xd0005436 BIT_MASK 0x2 /end MEASUREMENT
/begin MEASUREMENT Vbx_df_old_mis_1_lpg_trs_h "" UBYTE _CNV_A_R_A_105_CM 1 0. 0. 255. DISPLAY_IDENTIFIER fm_sta_mis_1_lpg_trs_h.fm_static_bitfield.Vbx_df_old_xxx ECU_ADDRESS 0xd0005436 BIT_MASK 0x4 /end MEASUREMENT
/begin MEASUREMENT Vbx_dfctr_sat_mis_1_lpg_trs_h "" UBYTE _CNV_A_R_A_105_CM 1 0. 0. 255. DISPLAY_IDENTIFIER fm_sta_mis_1_lpg_trs_h.fm_static_bitfield.Vbx_dfctr_sat_xxx ECU_ADDRESS 0xd0005436 BIT_MASK 0x8 /end MEASUREMENT
/begin MEASUREMENT Vbx_rdn_mis_1_lpg_trs_h "" UBYTE _CNV_A_R_A_105_CM 1 0. 0. 255. DISPLAY_IDENTIFIER fm_sta_mis_1_lpg_trs_h.fm_static_bitfield.Vbx_rdn_xxx ECU_ADDRESS 0xd0005436 BIT_MASK 0x40 /end MEASUREMENT
/begin MEASUREMENT Vxx_dtc_stt_mis_1_lpg_trs_h "" UBYTE _CNV_A_R_A_105_CM 1 0. 0. 255. DISPLAY_IDENTIFIER fm_sta_mis_1_lpg_trs_h.Vxx_dtc_stt_xxx ECU_ADDRESS 0xd0005437 /end MEASUREMENT
/begin MEASUREMENT Vxx_dfctr_mis_1_trs_h "" UWORD _CNV_A_R_A_105_CM 1 0. 0. 65535. DISPLAY_IDENTIFIER fm_sta_mis_1_trs_h.Vxx_dfctr_xxx ECU_ADDRESS 0xd0005438 /end MEASUREMENT
/begin MEASUREMENT Vxx_rdn_mis_1_trs_h "" UWORD _CNV_A_R_A_105_CM 1 0. 0. 65535. DISPLAY_IDENTIFIER fm_sta_mis_1_trs_h.Vxx_rdn_xxx ECU_ADDRESS 0xd000543a /end MEASUREMENT
/begin MEASUREMENT Vbx_cf_mis_1_trs_h "" UBYTE _CNV_A_R_A_105_CM 1 0. 0. 255. DISPLAY_IDENTIFIER fm_sta_mis_1_trs_h.fm_static_bitfield.Vbx_cf_xxx ECU_ADDRESS 0xd000543c BIT_MASK 0x1 /end MEASUREMENT
/begin MEASUREMENT Vbx_clf_mis_1_trs_h "" UBYTE _CNV_A_R_A_105_CM 1 0. 0. 255. DISPLAY_IDENTIFIER fm_sta_mis_1_trs_h.fm_static_bitfield.Vbx_clf_xxx ECU_ADDRESS 0xd000543c BIT_MASK 0x2 /end MEASUREMENT
/begin MEASUREMENT Vbx_df_old_mis_1_trs_h "" UBYTE _CNV_A_R_A_105_CM 1 0. 0. 255. DISPLAY_IDENTIFIER fm_sta_mis_1_trs_h.fm_static_bitfield.Vbx_df_old_xxx ECU_ADDRESS 0xd000543c BIT_MASK 0x4 /end MEASUREMENT
/begin MEASUREMENT Vbx_dfctr_sat_mis_1_trs_h "" UBYTE _CNV_A_R_A_105_CM 1 0. 0. 255. DISPLAY_IDENTIFIER fm_sta_mis_1_trs_h.fm_static_bitfield.Vbx_dfctr_sat_xxx ECU_ADDRESS 0xd000543c BIT_MASK 0x8 /end MEASUREMENT
/begin MEASUREMENT Vbx_rdn_mis_1_trs_h "" UBYTE _CNV_A_R_A_105_CM 1 0. 0. 255. DISPLAY_IDENTIFIER fm_sta_mis_1_trs_h.fm_static_bitfield.Vbx_rdn_xxx ECU_ADDRESS 0xd000543c BIT_MASK 0x40 /end MEASUREMENT
/begin MEASUREMENT Vxx_dtc_stt_mis_1_trs_h "" UBYTE _CNV_A_R_A_105_CM 1 0. 0. 255. DISPLAY_IDENTIFIER fm_sta_mis_1_trs_h.Vxx_dtc_stt_xxx ECU_ADDRESS 0xd000543d /end MEASUREMENT
/begin MEASUREMENT Vxx_dfctr_mis_2_cata "" UWORD _CNV_A_R_A_105_CM 1 0. 0. 65535. DISPLAY_IDENTIFIER fm_sta_mis_2_cata.Vxx_dfctr_xxx ECU_ADDRESS 0xd000543e /end MEASUREMENT
/begin MEASUREMENT Vxx_rdn_mis_2_cata "" UWORD _CNV_A_R_A_105_CM 1 0. 0. 65535. DISPLAY_IDENTIFIER fm_sta_mis_2_cata.Vxx_rdn_xxx ECU_ADDRESS 0xd0005440 /end MEASUREMENT
/begin MEASUREMENT Vbx_cf_mis_2_cata "" UBYTE _CNV_A_R_A_105_CM 1 0. 0. 255. DISPLAY_IDENTIFIER fm_sta_mis_2_cata.fm_static_bitfield.Vbx_cf_xxx ECU_ADDRESS 0xd0005442 BIT_MASK 0x1 /end MEASUREMENT
/begin MEASUREMENT Vbx_clf_mis_2_cata "" UBYTE _CNV_A_R_A_105_CM 1 0. 0. 255. DISPLAY_IDENTIFIER fm_sta_mis_2_cata.fm_static_bitfield.Vbx_clf_xxx ECU_ADDRESS 0xd0005442 BIT_MASK 0x2 /end MEASUREMENT
/begin MEASUREMENT Vbx_df_old_mis_2_cata "" UBYTE _CNV_A_R_A_105_CM 1 0. 0. 255. DISPLAY_IDENTIFIER fm_sta_mis_2_cata.fm_static_bitfield.Vbx_df_old_xxx ECU_ADDRESS 0xd0005442 BIT_MASK 0x4 /end MEASUREMENT
/begin MEASUREMENT Vbx_dfctr_sat_mis_2_cata "" UBYTE _CNV_A_R_A_105_CM 1 0. 0. 255. DISPLAY_IDENTIFIER fm_sta_mis_2_cata.fm_static_bitfield.Vbx_dfctr_sat_xxx ECU_ADDRESS 0xd0005442 BIT_MASK 0x8 /end MEASUREMENT
/begin MEASUREMENT Vbx_rdn_mis_2_cata "" UBYTE _CNV_A_R_A_105_CM 1 0. 0. 255. DISPLAY_IDENTIFIER fm_sta_mis_2_cata.fm_static_bitfield.Vbx_rdn_xxx ECU_ADDRESS 0xd0005442 BIT_MASK 0x40 /end MEASUREMENT
/begin MEASUREMENT Vxx_dtc_stt_mis_2_cata "" UBYTE _CNV_A_R_A_105_CM 1 0. 0. 255. DISPLAY_IDENTIFIER fm_sta_mis_2_cata.Vxx_dtc_stt_xxx ECU_ADDRESS 0xd0005443 /end MEASUREMENT
/begin MEASUREMENT Vxx_dfctr_mis_2_lpg_cata "" UWORD _CNV_A_R_A_105_CM 1 0. 0. 65535. DISPLAY_IDENTIFIER fm_sta_mis_2_lpg_cata.Vxx_dfctr_xxx ECU_ADDRESS 0xd0005444 /end MEASUREMENT
/begin MEASUREMENT Vxx_rdn_mis_2_lpg_cata "" UWORD _CNV_A_R_A_105_CM 1 0. 0. 65535. DISPLAY_IDENTIFIER fm_sta_mis_2_lpg_cata.Vxx_rdn_xxx ECU_ADDRESS 0xd0005446 /end MEASUREMENT
/begin MEASUREMENT Vbx_cf_mis_2_lpg_cata "" UBYTE _CNV_A_R_A_105_CM 1 0. 0. 255. DISPLAY_IDENTIFIER fm_sta_mis_2_lpg_cata.fm_static_bitfield.Vbx_cf_xxx ECU_ADDRESS 0xd0005448 BIT_MASK 0x1 /end MEASUREMENT
/begin MEASUREMENT Vbx_clf_mis_2_lpg_cata "" UBYTE _CNV_A_R_A_105_CM 1 0. 0. 255. DISPLAY_IDENTIFIER fm_sta_mis_2_lpg_cata.fm_static_bitfield.Vbx_clf_xxx ECU_ADDRESS 0xd0005448 BIT_MASK 0x2 /end MEASUREMENT
/begin MEASUREMENT Vbx_df_old_mis_2_lpg_cata "" UBYTE _CNV_A_R_A_105_CM 1 0. 0. 255. DISPLAY_IDENTIFIER fm_sta_mis_2_lpg_cata.fm_static_bitfield.Vbx_df_old_xxx ECU_ADDRESS 0xd0005448 BIT_MASK 0x4 /end MEASUREMENT
/begin MEASUREMENT Vbx_dfctr_sat_mis_2_lpg_cata "" UBYTE _CNV_A_R_A_105_CM 1 0. 0. 255. DISPLAY_IDENTIFIER fm_sta_mis_2_lpg_cata.fm_static_bitfield.Vbx_dfctr_sat_xxx ECU_ADDRESS 0xd0005448 BIT_MASK 0x8 /end MEASUREMENT
/begin MEASUREMENT Vbx_rdn_mis_2_lpg_cata "" UBYTE _CNV_A_R_A_105_CM 1 0. 0. 255. DISPLAY_IDENTIFIER fm_sta_mis_2_lpg_cata.fm_static_bitfield.Vbx_rdn_xxx ECU_ADDRESS 0xd0005448 BIT_MASK 0x40 /end MEASUREMENT
/begin MEASUREMENT Vxx_dtc_stt_mis_2_lpg_cata "" UBYTE _CNV_A_R_A_105_CM 1 0. 0. 255. DISPLAY_IDENTIFIER fm_sta_mis_2_lpg_cata.Vxx_dtc_stt_xxx ECU_ADDRESS 0xd0005449 /end MEASUREMENT
/begin MEASUREMENT Vxx_dfctr_mis_2_lpg_trs_h "" UWORD _CNV_A_R_A_105_CM 1 0. 0. 65535. DISPLAY_IDENTIFIER fm_sta_mis_2_lpg_trs_h.Vxx_dfctr_xxx ECU_ADDRESS 0xd000544a /end MEASUREMENT
/begin MEASUREMENT Vxx_rdn_mis_2_lpg_trs_h "" UWORD _CNV_A_R_A_105_CM 1 0. 0. 65535. DISPLAY_IDENTIFIER fm_sta_mis_2_lpg_trs_h.Vxx_rdn_xxx ECU_ADDRESS 0xd000544c /end MEASUREMENT
/begin MEASUREMENT Vbx_cf_mis_2_lpg_trs_h "" UBYTE _CNV_A_R_A_105_CM 1 0. 0. 255. DISPLAY_IDENTIFIER fm_sta_mis_2_lpg_trs_h.fm_static_bitfield.Vbx_cf_xxx ECU_ADDRESS 0xd000544e BIT_MASK 0x1 /end MEASUREMENT
/begin MEASUREMENT Vbx_clf_mis_2_lpg_trs_h "" UBYTE _CNV_A_R_A_105_CM 1 0. 0. 255. DISPLAY_IDENTIFIER fm_sta_mis_2_lpg_trs_h.fm_static_bitfield.Vbx_clf_xxx ECU_ADDRESS 0xd000544e BIT_MASK 0x2 /end MEASUREMENT
/begin MEASUREMENT Vbx_df_old_mis_2_lpg_trs_h "" UBYTE _CNV_A_R_A_105_CM 1 0. 0. 255. DISPLAY_IDENTIFIER fm_sta_mis_2_lpg_trs_h.fm_static_bitfield.Vbx_df_old_xxx ECU_ADDRESS 0xd000544e BIT_MASK 0x4 /end MEASUREMENT
/begin MEASUREMENT Vbx_dfctr_sat_mis_2_lpg_trs_h "" UBYTE _CNV_A_R_A_105_CM 1 0. 0. 255. DISPLAY_IDENTIFIER fm_sta_mis_2_lpg_trs_h.fm_static_bitfield.Vbx_dfctr_sat_xxx ECU_ADDRESS 0xd000544e BIT_MASK 0x8 /end MEASUREMENT
/begin MEASUREMENT Vbx_rdn_mis_2_lpg_trs_h "" UBYTE _CNV_A_R_A_105_CM 1 0. 0. 255. DISPLAY_IDENTIFIER fm_sta_mis_2_lpg_trs_h.fm_static_bitfield.Vbx_rdn_xxx ECU_ADDRESS 0xd000544e BIT_MASK 0x40 /end MEASUREMENT
/begin MEASUREMENT Vxx_dtc_stt_mis_2_lpg_trs_h "" UBYTE _CNV_A_R_A_105_CM 1 0. 0. 255. DISPLAY_IDENTIFIER fm_sta_mis_2_lpg_trs_h.Vxx_dtc_stt_xxx ECU_ADDRESS 0xd000544f /end MEASUREMENT
/begin MEASUREMENT Vxx_dfctr_mis_2_trs_h "" UWORD _CNV_A_R_A_105_CM 1 0. 0. 65535. DISPLAY_IDENTIFIER fm_sta_mis_2_trs_h.Vxx_dfctr_xxx ECU_ADDRESS 0xd0005450 /end MEASUREMENT
/begin MEASUREMENT Vxx_rdn_mis_2_trs_h "" UWORD _CNV_A_R_A_105_CM 1 0. 0. 65535. DISPLAY_IDENTIFIER fm_sta_mis_2_trs_h.Vxx_rdn_xxx ECU_ADDRESS 0xd0005452 /end MEASUREMENT
/begin MEASUREMENT Vbx_cf_mis_2_trs_h "" UBYTE _CNV_A_R_A_105_CM 1 0. 0. 255. DISPLAY_IDENTIFIER fm_sta_mis_2_trs_h.fm_static_bitfield.Vbx_cf_xxx ECU_ADDRESS 0xd0005454 BIT_MASK 0x1 /end MEASUREMENT
/begin MEASUREMENT Vbx_clf_mis_2_trs_h "" UBYTE _CNV_A_R_A_105_CM 1 0. 0. 255. DISPLAY_IDENTIFIER fm_sta_mis_2_trs_h.fm_static_bitfield.Vbx_clf_xxx ECU_ADDRESS 0xd0005454 BIT_MASK 0x2 /end MEASUREMENT
/begin MEASUREMENT Vbx_df_old_mis_2_trs_h "" UBYTE _CNV_A_R_A_105_CM 1 0. 0. 255. DISPLAY_IDENTIFIER fm_sta_mis_2_trs_h.fm_static_bitfield.Vbx_df_old_xxx ECU_ADDRESS 0xd0005454 BIT_MASK 0x4 /end MEASUREMENT
/begin MEASUREMENT Vbx_dfctr_sat_mis_2_trs_h "" UBYTE _CNV_A_R_A_105_CM 1 0. 0. 255. DISPLAY_IDENTIFIER fm_sta_mis_2_trs_h.fm_static_bitfield.Vbx_dfctr_sat_xxx ECU_ADDRESS 0xd0005454 BIT_MASK 0x8 /end MEASUREMENT
/begin MEASUREMENT Vbx_rdn_mis_2_trs_h "" UBYTE _CNV_A_R_A_105_CM 1 0. 0. 255. DISPLAY_IDENTIFIER fm_sta_mis_2_trs_h.fm_static_bitfield.Vbx_rdn_xxx ECU_ADDRESS 0xd0005454 BIT_MASK 0x40 /end MEASUREMENT
/begin MEASUREMENT Vxx_dtc_stt_mis_2_trs_h "" UBYTE _CNV_A_R_A_105_CM 1 0. 0. 255. DISPLAY_IDENTIFIER fm_sta_mis_2_trs_h.Vxx_dtc_stt_xxx ECU_ADDRESS 0xd0005455 /end MEASUREMENT
/begin MEASUREMENT Vxx_dfctr_mis_3_cata "" UWORD _CNV_A_R_A_105_CM 1 0. 0. 65535. DISPLAY_IDENTIFIER fm_sta_mis_3_cata.Vxx_dfctr_xxx ECU_ADDRESS 0xd0005456 /end MEASUREMENT
/begin MEASUREMENT Vxx_rdn_mis_3_cata "" UWORD _CNV_A_R_A_105_CM 1 0. 0. 65535. DISPLAY_IDENTIFIER fm_sta_mis_3_cata.Vxx_rdn_xxx ECU_ADDRESS 0xd0005458 /end MEASUREMENT
/begin MEASUREMENT Vbx_cf_mis_3_cata "" UBYTE _CNV_A_R_A_105_CM 1 0. 0. 255. DISPLAY_IDENTIFIER fm_sta_mis_3_cata.fm_static_bitfield.Vbx_cf_xxx ECU_ADDRESS 0xd000545a BIT_MASK 0x1 /end MEASUREMENT
/begin MEASUREMENT Vbx_clf_mis_3_cata "" UBYTE _CNV_A_R_A_105_CM 1 0. 0. 255. DISPLAY_IDENTIFIER fm_sta_mis_3_cata.fm_static_bitfield.Vbx_clf_xxx ECU_ADDRESS 0xd000545a BIT_MASK 0x2 /end MEASUREMENT
/begin MEASUREMENT Vbx_df_old_mis_3_cata "" UBYTE _CNV_A_R_A_105_CM 1 0. 0. 255. DISPLAY_IDENTIFIER fm_sta_mis_3_cata.fm_static_bitfield.Vbx_df_old_xxx ECU_ADDRESS 0xd000545a BIT_MASK 0x4 /end MEASUREMENT
/begin MEASUREMENT Vbx_dfctr_sat_mis_3_cata "" UBYTE _CNV_A_R_A_105_CM 1 0. 0. 255. DISPLAY_IDENTIFIER fm_sta_mis_3_cata.fm_static_bitfield.Vbx_dfctr_sat_xxx ECU_ADDRESS 0xd000545a BIT_MASK 0x8 /end MEASUREMENT
/begin MEASUREMENT Vbx_rdn_mis_3_cata "" UBYTE _CNV_A_R_A_105_CM 1 0. 0. 255. DISPLAY_IDENTIFIER fm_sta_mis_3_cata.fm_static_bitfield.Vbx_rdn_xxx ECU_ADDRESS 0xd000545a BIT_MASK 0x40 /end MEASUREMENT
/begin MEASUREMENT Vxx_dtc_stt_mis_3_cata "" UBYTE _CNV_A_R_A_105_CM 1 0. 0. 255. DISPLAY_IDENTIFIER fm_sta_mis_3_cata.Vxx_dtc_stt_xxx ECU_ADDRESS 0xd000545b /end MEASUREMENT
/begin MEASUREMENT Vxx_dfctr_mis_3_lpg_cata "" UWORD _CNV_A_R_A_105_CM 1 0. 0. 65535. DISPLAY_IDENTIFIER fm_sta_mis_3_lpg_cata.Vxx_dfctr_xxx ECU_ADDRESS 0xd000545c /end MEASUREMENT
/begin MEASUREMENT Vxx_rdn_mis_3_lpg_cata "" UWORD _CNV_A_R_A_105_CM 1 0. 0. 65535. DISPLAY_IDENTIFIER fm_sta_mis_3_lpg_cata.Vxx_rdn_xxx ECU_ADDRESS 0xd000545e /end MEASUREMENT
/begin MEASUREMENT Vbx_cf_mis_3_lpg_cata "" UBYTE _CNV_A_R_A_105_CM 1 0. 0. 255. DISPLAY_IDENTIFIER fm_sta_mis_3_lpg_cata.fm_static_bitfield.Vbx_cf_xxx ECU_ADDRESS 0xd0005460 BIT_MASK 0x1 /end MEASUREMENT
/begin MEASUREMENT Vbx_clf_mis_3_lpg_cata "" UBYTE _CNV_A_R_A_105_CM 1 0. 0. 255. DISPLAY_IDENTIFIER fm_sta_mis_3_lpg_cata.fm_static_bitfield.Vbx_clf_xxx ECU_ADDRESS 0xd0005460 BIT_MASK 0x2 /end MEASUREMENT
/begin MEASUREMENT Vbx_df_old_mis_3_lpg_cata "" UBYTE _CNV_A_R_A_105_CM 1 0. 0. 255. DISPLAY_IDENTIFIER fm_sta_mis_3_lpg_cata.fm_static_bitfield.Vbx_df_old_xxx ECU_ADDRESS 0xd0005460 BIT_MASK 0x4 /end MEASUREMENT
/begin MEASUREMENT Vbx_dfctr_sat_mis_3_lpg_cata "" UBYTE _CNV_A_R_A_105_CM 1 0. 0. 255. DISPLAY_IDENTIFIER fm_sta_mis_3_lpg_cata.fm_static_bitfield.Vbx_dfctr_sat_xxx ECU_ADDRESS 0xd0005460 BIT_MASK 0x8 /end MEASUREMENT
/begin MEASUREMENT Vbx_rdn_mis_3_lpg_cata "" UBYTE _CNV_A_R_A_105_CM 1 0. 0. 255. DISPLAY_IDENTIFIER fm_sta_mis_3_lpg_cata.fm_static_bitfield.Vbx_rdn_xxx ECU_ADDRESS 0xd0005460 BIT_MASK 0x40 /end MEASUREMENT
/begin MEASUREMENT Vxx_dtc_stt_mis_3_lpg_cata "" UBYTE _CNV_A_R_A_105_CM 1 0. 0. 255. DISPLAY_IDENTIFIER fm_sta_mis_3_lpg_cata.Vxx_dtc_stt_xxx ECU_ADDRESS 0xd0005461 /end MEASUREMENT
/begin MEASUREMENT Vxx_dfctr_mis_3_lpg_trs_h "" UWORD _CNV_A_R_A_105_CM 1 0. 0. 65535. DISPLAY_IDENTIFIER fm_sta_mis_3_lpg_trs_h.Vxx_dfctr_xxx ECU_ADDRESS 0xd0005462 /end MEASUREMENT
/begin MEASUREMENT Vxx_rdn_mis_3_lpg_trs_h "" UWORD _CNV_A_R_A_105_CM 1 0. 0. 65535. DISPLAY_IDENTIFIER fm_sta_mis_3_lpg_trs_h.Vxx_rdn_xxx ECU_ADDRESS 0xd0005464 /end MEASUREMENT
/begin MEASUREMENT Vbx_cf_mis_3_lpg_trs_h "" UBYTE _CNV_A_R_A_105_CM 1 0. 0. 255. DISPLAY_IDENTIFIER fm_sta_mis_3_lpg_trs_h.fm_static_bitfield.Vbx_cf_xxx ECU_ADDRESS 0xd0005466 BIT_MASK 0x1 /end MEASUREMENT
/begin MEASUREMENT Vbx_clf_mis_3_lpg_trs_h "" UBYTE _CNV_A_R_A_105_CM 1 0. 0. 255. DISPLAY_IDENTIFIER fm_sta_mis_3_lpg_trs_h.fm_static_bitfield.Vbx_clf_xxx ECU_ADDRESS 0xd0005466 BIT_MASK 0x2 /end MEASUREMENT
/begin MEASUREMENT Vbx_df_old_mis_3_lpg_trs_h "" UBYTE _CNV_A_R_A_105_CM 1 0. 0. 255. DISPLAY_IDENTIFIER fm_sta_mis_3_lpg_trs_h.fm_static_bitfield.Vbx_df_old_xxx ECU_ADDRESS 0xd0005466 BIT_MASK 0x4 /end MEASUREMENT
/begin MEASUREMENT Vbx_dfctr_sat_mis_3_lpg_trs_h "" UBYTE _CNV_A_R_A_105_CM 1 0. 0. 255. DISPLAY_IDENTIFIER fm_sta_mis_3_lpg_trs_h.fm_static_bitfield.Vbx_dfctr_sat_xxx ECU_ADDRESS 0xd0005466 BIT_MASK 0x8 /end MEASUREMENT
/begin MEASUREMENT Vbx_rdn_mis_3_lpg_trs_h "" UBYTE _CNV_A_R_A_105_CM 1 0. 0. 255. DISPLAY_IDENTIFIER fm_sta_mis_3_lpg_trs_h.fm_static_bitfield.Vbx_rdn_xxx ECU_ADDRESS 0xd0005466 BIT_MASK 0x40 /end MEASUREMENT
/begin MEASUREMENT Vxx_dtc_stt_mis_3_lpg_trs_h "" UBYTE _CNV_A_R_A_105_CM 1 0. 0. 255. DISPLAY_IDENTIFIER fm_sta_mis_3_lpg_trs_h.Vxx_dtc_stt_xxx ECU_ADDRESS 0xd0005467 /end MEASUREMENT
/begin MEASUREMENT Vxx_dfctr_mis_3_trs_h "" UWORD _CNV_A_R_A_105_CM 1 0. 0. 65535. DISPLAY_IDENTIFIER fm_sta_mis_3_trs_h.Vxx_dfctr_xxx ECU_ADDRESS 0xd0005468 /end MEASUREMENT
/begin MEASUREMENT Vxx_rdn_mis_3_trs_h "" UWORD _CNV_A_R_A_105_CM 1 0. 0. 65535. DISPLAY_IDENTIFIER fm_sta_mis_3_trs_h.Vxx_rdn_xxx ECU_ADDRESS 0xd000546a /end MEASUREMENT
/begin MEASUREMENT Vbx_cf_mis_3_trs_h "" UBYTE _CNV_A_R_A_105_CM 1 0. 0. 255. DISPLAY_IDENTIFIER fm_sta_mis_3_trs_h.fm_static_bitfield.Vbx_cf_xxx ECU_ADDRESS 0xd000546c BIT_MASK 0x1 /end MEASUREMENT
/begin MEASUREMENT Vbx_clf_mis_3_trs_h "" UBYTE _CNV_A_R_A_105_CM 1 0. 0. 255. DISPLAY_IDENTIFIER fm_sta_mis_3_trs_h.fm_static_bitfield.Vbx_clf_xxx ECU_ADDRESS 0xd000546c BIT_MASK 0x2 /end MEASUREMENT
/begin MEASUREMENT Vbx_df_old_mis_3_trs_h "" UBYTE _CNV_A_R_A_105_CM 1 0. 0. 255. DISPLAY_IDENTIFIER fm_sta_mis_3_trs_h.fm_static_bitfield.Vbx_df_old_xxx ECU_ADDRESS 0xd000546c BIT_MASK 0x4 /end MEASUREMENT
/begin MEASUREMENT Vbx_dfctr_sat_mis_3_trs_h "" UBYTE _CNV_A_R_A_105_CM 1 0. 0. 255. DISPLAY_IDENTIFIER fm_sta_mis_3_trs_h.fm_static_bitfield.Vbx_dfctr_sat_xxx ECU_ADDRESS 0xd000546c BIT_MASK 0x8 /end MEASUREMENT
/begin MEASUREMENT Vbx_rdn_mis_3_trs_h "" UBYTE _CNV_A_R_A_105_CM 1 0. 0. 255. DISPLAY_IDENTIFIER fm_sta_mis_3_trs_h.fm_static_bitfield.Vbx_rdn_xxx ECU_ADDRESS 0xd000546c BIT_MASK 0x40 /end MEASUREMENT
/begin MEASUREMENT Vxx_dtc_stt_mis_3_trs_h "" UBYTE _CNV_A_R_A_105_CM 1 0. 0. 255. DISPLAY_IDENTIFIER fm_sta_mis_3_trs_h.Vxx_dtc_stt_xxx ECU_ADDRESS 0xd000546d /end MEASUREMENT
/begin MEASUREMENT Vxx_dfctr_mis_4_cata "" UWORD _CNV_A_R_A_105_CM 1 0. 0. 65535. DISPLAY_IDENTIFIER fm_sta_mis_4_cata.Vxx_dfctr_xxx ECU_ADDRESS 0xd000546e /end MEASUREMENT
/begin MEASUREMENT Vxx_rdn_mis_4_cata "" UWORD _CNV_A_R_A_105_CM 1 0. 0. 65535. DISPLAY_IDENTIFIER fm_sta_mis_4_cata.Vxx_rdn_xxx ECU_ADDRESS 0xd0005470 /end MEASUREMENT
/begin MEASUREMENT Vbx_cf_mis_4_cata "" UBYTE _CNV_A_R_A_105_CM 1 0. 0. 255. DISPLAY_IDENTIFIER fm_sta_mis_4_cata.fm_static_bitfield.Vbx_cf_xxx ECU_ADDRESS 0xd0005472 BIT_MASK 0x1 /end MEASUREMENT
/begin MEASUREMENT Vbx_clf_mis_4_cata "" UBYTE _CNV_A_R_A_105_CM 1 0. 0. 255. DISPLAY_IDENTIFIER fm_sta_mis_4_cata.fm_static_bitfield.Vbx_clf_xxx ECU_ADDRESS 0xd0005472 BIT_MASK 0x2 /end MEASUREMENT
/begin MEASUREMENT Vbx_df_old_mis_4_cata "" UBYTE _CNV_A_R_A_105_CM 1 0. 0. 255. DISPLAY_IDENTIFIER fm_sta_mis_4_cata.fm_static_bitfield.Vbx_df_old_xxx ECU_ADDRESS 0xd0005472 BIT_MASK 0x4 /end MEASUREMENT
/begin MEASUREMENT Vbx_dfctr_sat_mis_4_cata "" UBYTE _CNV_A_R_A_105_CM 1 0. 0. 255. DISPLAY_IDENTIFIER fm_sta_mis_4_cata.fm_static_bitfield.Vbx_dfctr_sat_xxx ECU_ADDRESS 0xd0005472 BIT_MASK 0x8 /end MEASUREMENT
/begin MEASUREMENT Vbx_rdn_mis_4_cata "" UBYTE _CNV_A_R_A_105_CM 1 0. 0. 255. DISPLAY_IDENTIFIER fm_sta_mis_4_cata.fm_static_bitfield.Vbx_rdn_xxx ECU_ADDRESS 0xd0005472 BIT_MASK 0x40 /end MEASUREMENT
/begin MEASUREMENT Vxx_dtc_stt_mis_4_cata "" UBYTE _CNV_A_R_A_105_CM 1 0. 0. 255. DISPLAY_IDENTIFIER fm_sta_mis_4_cata.Vxx_dtc_stt_xxx ECU_ADDRESS 0xd0005473 /end MEASUREMENT
/begin MEASUREMENT Vxx_dfctr_mis_4_lpg_cata "" UWORD _CNV_A_R_A_105_CM 1 0. 0. 65535. DISPLAY_IDENTIFIER fm_sta_mis_4_lpg_cata.Vxx_dfctr_xxx ECU_ADDRESS 0xd0005474 /end MEASUREMENT
/begin MEASUREMENT Vxx_rdn_mis_4_lpg_cata "" UWORD _CNV_A_R_A_105_CM 1 0. 0. 65535. DISPLAY_IDENTIFIER fm_sta_mis_4_lpg_cata.Vxx_rdn_xxx ECU_ADDRESS 0xd0005476 /end MEASUREMENT
/begin MEASUREMENT Vbx_cf_mis_4_lpg_cata "" UBYTE _CNV_A_R_A_105_CM 1 0. 0. 255. DISPLAY_IDENTIFIER fm_sta_mis_4_lpg_cata.fm_static_bitfield.Vbx_cf_xxx ECU_ADDRESS 0xd0005478 BIT_MASK 0x1 /end MEASUREMENT
/begin MEASUREMENT Vbx_clf_mis_4_lpg_cata "" UBYTE _CNV_A_R_A_105_CM 1 0. 0. 255. DISPLAY_IDENTIFIER fm_sta_mis_4_lpg_cata.fm_static_bitfield.Vbx_clf_xxx ECU_ADDRESS 0xd0005478 BIT_MASK 0x2 /end MEASUREMENT
/begin MEASUREMENT Vbx_df_old_mis_4_lpg_cata "" UBYTE _CNV_A_R_A_105_CM 1 0. 0. 255. DISPLAY_IDENTIFIER fm_sta_mis_4_lpg_cata.fm_static_bitfield.Vbx_df_old_xxx ECU_ADDRESS 0xd0005478 BIT_MASK 0x4 /end MEASUREMENT
/begin MEASUREMENT Vbx_dfctr_sat_mis_4_lpg_cata "" UBYTE _CNV_A_R_A_105_CM 1 0. 0. 255. DISPLAY_IDENTIFIER fm_sta_mis_4_lpg_cata.fm_static_bitfield.Vbx_dfctr_sat_xxx ECU_ADDRESS 0xd0005478 BIT_MASK 0x8 /end MEASUREMENT
/begin MEASUREMENT Vbx_rdn_mis_4_lpg_cata "" UBYTE _CNV_A_R_A_105_CM 1 0. 0. 255. DISPLAY_IDENTIFIER fm_sta_mis_4_lpg_cata.fm_static_bitfield.Vbx_rdn_xxx ECU_ADDRESS 0xd0005478 BIT_MASK 0x40 /end MEASUREMENT
/begin MEASUREMENT Vxx_dtc_stt_mis_4_lpg_cata "" UBYTE _CNV_A_R_A_105_CM 1 0. 0. 255. DISPLAY_IDENTIFIER fm_sta_mis_4_lpg_cata.Vxx_dtc_stt_xxx ECU_ADDRESS 0xd0005479 /end MEASUREMENT
/begin MEASUREMENT Vxx_dfctr_mis_4_lpg_trs_h "" UWORD _CNV_A_R_A_105_CM 1 0. 0. 65535. DISPLAY_IDENTIFIER fm_sta_mis_4_lpg_trs_h.Vxx_dfctr_xxx ECU_ADDRESS 0xd000547a /end MEASUREMENT
/begin MEASUREMENT Vxx_rdn_mis_4_lpg_trs_h "" UWORD _CNV_A_R_A_105_CM 1 0. 0. 65535. DISPLAY_IDENTIFIER fm_sta_mis_4_lpg_trs_h.Vxx_rdn_xxx ECU_ADDRESS 0xd000547c /end MEASUREMENT
/begin MEASUREMENT Vbx_cf_mis_4_lpg_trs_h "" UBYTE _CNV_A_R_A_105_CM 1 0. 0. 255. DISPLAY_IDENTIFIER fm_sta_mis_4_lpg_trs_h.fm_static_bitfield.Vbx_cf_xxx ECU_ADDRESS 0xd000547e BIT_MASK 0x1 /end MEASUREMENT
/begin MEASUREMENT Vbx_clf_mis_4_lpg_trs_h "" UBYTE _CNV_A_R_A_105_CM 1 0. 0. 255. DISPLAY_IDENTIFIER fm_sta_mis_4_lpg_trs_h.fm_static_bitfield.Vbx_clf_xxx ECU_ADDRESS 0xd000547e BIT_MASK 0x2 /end MEASUREMENT
/begin MEASUREMENT Vbx_df_old_mis_4_lpg_trs_h "" UBYTE _CNV_A_R_A_105_CM 1 0. 0. 255. DISPLAY_IDENTIFIER fm_sta_mis_4_lpg_trs_h.fm_static_bitfield.Vbx_df_old_xxx ECU_ADDRESS 0xd000547e BIT_MASK 0x4 /end MEASUREMENT
/begin MEASUREMENT Vbx_dfctr_sat_mis_4_lpg_trs_h "" UBYTE _CNV_A_R_A_105_CM 1 0. 0. 255. DISPLAY_IDENTIFIER fm_sta_mis_4_lpg_trs_h.fm_static_bitfield.Vbx_dfctr_sat_xxx ECU_ADDRESS 0xd000547e BIT_MASK 0x8 /end MEASUREMENT
/begin MEASUREMENT Vbx_rdn_mis_4_lpg_trs_h "" UBYTE _CNV_A_R_A_105_CM 1 0. 0. 255. DISPLAY_IDENTIFIER fm_sta_mis_4_lpg_trs_h.fm_static_bitfield.Vbx_rdn_xxx ECU_ADDRESS 0xd000547e BIT_MASK 0x40 /end MEASUREMENT
/begin MEASUREMENT Vxx_dtc_stt_mis_4_lpg_trs_h "" UBYTE _CNV_A_R_A_105_CM 1 0. 0. 255. DISPLAY_IDENTIFIER fm_sta_mis_4_lpg_trs_h.Vxx_dtc_stt_xxx ECU_ADDRESS 0xd000547f /end MEASUREMENT
/begin MEASUREMENT Vxx_dfctr_mis_4_trs_h "" UWORD _CNV_A_R_A_105_CM 1 0. 0. 65535. DISPLAY_IDENTIFIER fm_sta_mis_4_trs_h.Vxx_dfctr_xxx ECU_ADDRESS 0xd0005480 /end MEASUREMENT
/begin MEASUREMENT Vxx_rdn_mis_4_trs_h "" UWORD _CNV_A_R_A_105_CM 1 0. 0. 65535. DISPLAY_IDENTIFIER fm_sta_mis_4_trs_h.Vxx_rdn_xxx ECU_ADDRESS 0xd0005482 /end MEASUREMENT
/begin MEASUREMENT Vbx_cf_mis_4_trs_h "" UBYTE _CNV_A_R_A_105_CM 1 0. 0. 255. DISPLAY_IDENTIFIER fm_sta_mis_4_trs_h.fm_static_bitfield.Vbx_cf_xxx ECU_ADDRESS 0xd0005484 BIT_MASK 0x1 /end MEASUREMENT
/begin MEASUREMENT Vbx_clf_mis_4_trs_h "" UBYTE _CNV_A_R_A_105_CM 1 0. 0. 255. DISPLAY_IDENTIFIER fm_sta_mis_4_trs_h.fm_static_bitfield.Vbx_clf_xxx ECU_ADDRESS 0xd0005484 BIT_MASK 0x2 /end MEASUREMENT
/begin MEASUREMENT Vbx_df_old_mis_4_trs_h "" UBYTE _CNV_A_R_A_105_CM 1 0. 0. 255. DISPLAY_IDENTIFIER fm_sta_mis_4_trs_h.fm_static_bitfield.Vbx_df_old_xxx ECU_ADDRESS 0xd0005484 BIT_MASK 0x4 /end MEASUREMENT
/begin MEASUREMENT Vbx_dfctr_sat_mis_4_trs_h "" UBYTE _CNV_A_R_A_105_CM 1 0. 0. 255. DISPLAY_IDENTIFIER fm_sta_mis_4_trs_h.fm_static_bitfield.Vbx_dfctr_sat_xxx ECU_ADDRESS 0xd0005484 BIT_MASK 0x8 /end MEASUREMENT
/begin MEASUREMENT Vbx_rdn_mis_4_trs_h "" UBYTE _CNV_A_R_A_105_CM 1 0. 0. 255. DISPLAY_IDENTIFIER fm_sta_mis_4_trs_h.fm_static_bitfield.Vbx_rdn_xxx ECU_ADDRESS 0xd0005484 BIT_MASK 0x40 /end MEASUREMENT
/begin MEASUREMENT Vxx_dtc_stt_mis_4_trs_h "" UBYTE _CNV_A_R_A_105_CM 1 0. 0. 255. DISPLAY_IDENTIFIER fm_sta_mis_4_trs_h.Vxx_dtc_stt_xxx ECU_ADDRESS 0xd0005485 /end MEASUREMENT
/begin MEASUREMENT Vxx_dfctr_mis_cata "" UWORD _CNV_A_R_A_105_CM 1 0. 0. 65535. DISPLAY_IDENTIFIER fm_sta_mis_cata.Vxx_dfctr_xxx ECU_ADDRESS 0xd0005486 /end MEASUREMENT
/begin MEASUREMENT Vxx_rdn_mis_cata "" UWORD _CNV_A_R_A_105_CM 1 0. 0. 65535. DISPLAY_IDENTIFIER fm_sta_mis_cata.Vxx_rdn_xxx ECU_ADDRESS 0xd0005488 /end MEASUREMENT
/begin MEASUREMENT Vbx_cf_mis_cata "" UBYTE _CNV_A_R_A_105_CM 1 0. 0. 255. DISPLAY_IDENTIFIER fm_sta_mis_cata.fm_static_bitfield.Vbx_cf_xxx ECU_ADDRESS 0xd000548a BIT_MASK 0x1 /end MEASUREMENT
/begin MEASUREMENT Vbx_clf_mis_cata "" UBYTE _CNV_A_R_A_105_CM 1 0. 0. 255. DISPLAY_IDENTIFIER fm_sta_mis_cata.fm_static_bitfield.Vbx_clf_xxx ECU_ADDRESS 0xd000548a BIT_MASK 0x2 /end MEASUREMENT
/begin MEASUREMENT Vbx_df_old_mis_cata "" UBYTE _CNV_A_R_A_105_CM 1 0. 0. 255. DISPLAY_IDENTIFIER fm_sta_mis_cata.fm_static_bitfield.Vbx_df_old_xxx ECU_ADDRESS 0xd000548a BIT_MASK 0x4 /end MEASUREMENT
/begin MEASUREMENT Vbx_dfctr_sat_mis_cata "" UBYTE _CNV_A_R_A_105_CM 1 0. 0. 255. DISPLAY_IDENTIFIER fm_sta_mis_cata.fm_static_bitfield.Vbx_dfctr_sat_xxx ECU_ADDRESS 0xd000548a BIT_MASK 0x8 /end MEASUREMENT
/begin MEASUREMENT Vbx_rdn_mis_cata "" UBYTE _CNV_A_R_A_105_CM 1 0. 0. 255. DISPLAY_IDENTIFIER fm_sta_mis_cata.fm_static_bitfield.Vbx_rdn_xxx ECU_ADDRESS 0xd000548a BIT_MASK 0x40 /end MEASUREMENT
/begin MEASUREMENT Vxx_dtc_stt_mis_cata "" UBYTE _CNV_A_R_A_105_CM 1 0. 0. 255. DISPLAY_IDENTIFIER fm_sta_mis_cata.Vxx_dtc_stt_xxx ECU_ADDRESS 0xd000548b /end MEASUREMENT
/begin MEASUREMENT Vxx_dfctr_mis_lpg_cata "" UWORD _CNV_A_R_A_105_CM 1 0. 0. 65535. DISPLAY_IDENTIFIER fm_sta_mis_lpg_cata.Vxx_dfctr_xxx ECU_ADDRESS 0xd000548c /end MEASUREMENT
/begin MEASUREMENT Vxx_rdn_mis_lpg_cata "" UWORD _CNV_A_R_A_105_CM 1 0. 0. 65535. DISPLAY_IDENTIFIER fm_sta_mis_lpg_cata.Vxx_rdn_xxx ECU_ADDRESS 0xd000548e /end MEASUREMENT
/begin MEASUREMENT Vbx_cf_mis_lpg_cata "" UBYTE _CNV_A_R_A_105_CM 1 0. 0. 255. DISPLAY_IDENTIFIER fm_sta_mis_lpg_cata.fm_static_bitfield.Vbx_cf_xxx ECU_ADDRESS 0xd0005490 BIT_MASK 0x1 /end MEASUREMENT
/begin MEASUREMENT Vbx_clf_mis_lpg_cata "" UBYTE _CNV_A_R_A_105_CM 1 0. 0. 255. DISPLAY_IDENTIFIER fm_sta_mis_lpg_cata.fm_static_bitfield.Vbx_clf_xxx ECU_ADDRESS 0xd0005490 BIT_MASK 0x2 /end MEASUREMENT
/begin MEASUREMENT Vbx_df_old_mis_lpg_cata "" UBYTE _CNV_A_R_A_105_CM 1 0. 0. 255. DISPLAY_IDENTIFIER fm_sta_mis_lpg_cata.fm_static_bitfield.Vbx_df_old_xxx ECU_ADDRESS 0xd0005490 BIT_MASK 0x4 /end MEASUREMENT
/begin MEASUREMENT Vbx_dfctr_sat_mis_lpg_cata "" UBYTE _CNV_A_R_A_105_CM 1 0. 0. 255. DISPLAY_IDENTIFIER fm_sta_mis_lpg_cata.fm_static_bitfield.Vbx_dfctr_sat_xxx ECU_ADDRESS 0xd0005490 BIT_MASK 0x8 /end MEASUREMENT
/begin MEASUREMENT Vbx_rdn_mis_lpg_cata "" UBYTE _CNV_A_R_A_105_CM 1 0. 0. 255. DISPLAY_IDENTIFIER fm_sta_mis_lpg_cata.fm_static_bitfield.Vbx_rdn_xxx ECU_ADDRESS 0xd0005490 BIT_MASK 0x40 /end MEASUREMENT
/begin MEASUREMENT Vxx_dtc_stt_mis_lpg_cata "" UBYTE _CNV_A_R_A_105_CM 1 0. 0. 255. DISPLAY_IDENTIFIER fm_sta_mis_lpg_cata.Vxx_dtc_stt_xxx ECU_ADDRESS 0xd0005491 /end MEASUREMENT
/begin MEASUREMENT Vxx_dfctr_mis_lpg_trs_h "" UWORD _CNV_A_R_A_105_CM 1 0. 0. 65535. DISPLAY_IDENTIFIER fm_sta_mis_lpg_trs_h.Vxx_dfctr_xxx ECU_ADDRESS 0xd0005492 /end MEASUREMENT
/begin MEASUREMENT Vxx_rdn_mis_lpg_trs_h "" UWORD _CNV_A_R_A_105_CM 1 0. 0. 65535. DISPLAY_IDENTIFIER fm_sta_mis_lpg_trs_h.Vxx_rdn_xxx ECU_ADDRESS 0xd0005494 /end MEASUREMENT
/begin MEASUREMENT Vbx_cf_mis_lpg_trs_h "" UBYTE _CNV_A_R_A_105_CM 1 0. 0. 255. DISPLAY_IDENTIFIER fm_sta_mis_lpg_trs_h.fm_static_bitfield.Vbx_cf_xxx ECU_ADDRESS 0xd0005496 BIT_MASK 0x1 /end MEASUREMENT
/begin MEASUREMENT Vbx_clf_mis_lpg_trs_h "" UBYTE _CNV_A_R_A_105_CM 1 0. 0. 255. DISPLAY_IDENTIFIER fm_sta_mis_lpg_trs_h.fm_static_bitfield.Vbx_clf_xxx ECU_ADDRESS 0xd0005496 BIT_MASK 0x2 /end MEASUREMENT
/begin MEASUREMENT Vbx_df_old_mis_lpg_trs_h "" UBYTE _CNV_A_R_A_105_CM 1 0. 0. 255. DISPLAY_IDENTIFIER fm_sta_mis_lpg_trs_h.fm_static_bitfield.Vbx_df_old_xxx ECU_ADDRESS 0xd0005496 BIT_MASK 0x4 /end MEASUREMENT
/begin MEASUREMENT Vbx_dfctr_sat_mis_lpg_trs_h "" UBYTE _CNV_A_R_A_105_CM 1 0. 0. 255. DISPLAY_IDENTIFIER fm_sta_mis_lpg_trs_h.fm_static_bitfield.Vbx_dfctr_sat_xxx ECU_ADDRESS 0xd0005496 BIT_MASK 0x8 /end MEASUREMENT
/begin MEASUREMENT Vbx_rdn_mis_lpg_trs_h "" UBYTE _CNV_A_R_A_105_CM 1 0. 0. 255. DISPLAY_IDENTIFIER fm_sta_mis_lpg_trs_h.fm_static_bitfield.Vbx_rdn_xxx ECU_ADDRESS 0xd0005496 BIT_MASK 0x40 /end MEASUREMENT
/begin MEASUREMENT Vxx_dtc_stt_mis_lpg_trs_h "" UBYTE _CNV_A_R_A_105_CM 1 0. 0. 255. DISPLAY_IDENTIFIER fm_sta_mis_lpg_trs_h.Vxx_dtc_stt_xxx ECU_ADDRESS 0xd0005497 /end MEASUREMENT
/begin MEASUREMENT Vxx_dfctr_mis_min_fuel_cata "" UWORD _CNV_A_R_A_105_CM 1 0. 0. 65535. DISPLAY_IDENTIFIER fm_sta_mis_min_fuel_cata.Vxx_dfctr_xxx ECU_ADDRESS 0xd0005498 /end MEASUREMENT
/begin MEASUREMENT Vxx_rdn_mis_min_fuel_cata "" UWORD _CNV_A_R_A_105_CM 1 0. 0. 65535. DISPLAY_IDENTIFIER fm_sta_mis_min_fuel_cata.Vxx_rdn_xxx ECU_ADDRESS 0xd000549a /end MEASUREMENT
/begin MEASUREMENT Vbx_cf_mis_min_fuel_cata "" UBYTE _CNV_A_R_A_105_CM 1 0. 0. 255. DISPLAY_IDENTIFIER fm_sta_mis_min_fuel_cata.fm_static_bitfield.Vbx_cf_xxx ECU_ADDRESS 0xd000549c BIT_MASK 0x1 /end MEASUREMENT
/begin MEASUREMENT Vbx_clf_mis_min_fuel_cata "" UBYTE _CNV_A_R_A_105_CM 1 0. 0. 255. DISPLAY_IDENTIFIER fm_sta_mis_min_fuel_cata.fm_static_bitfield.Vbx_clf_xxx ECU_ADDRESS 0xd000549c BIT_MASK 0x2 /end MEASUREMENT
/begin MEASUREMENT Vbx_df_old_mis_min_fuel_cata "" UBYTE _CNV_A_R_A_105_CM 1 0. 0. 255. DISPLAY_IDENTIFIER fm_sta_mis_min_fuel_cata.fm_static_bitfield.Vbx_df_old_xxx ECU_ADDRESS 0xd000549c BIT_MASK 0x4 /end MEASUREMENT
/begin MEASUREMENT Vbx_dfctr_sat_mis_min_fuel_cata "" UBYTE _CNV_A_R_A_105_CM 1 0. 0. 255. DISPLAY_IDENTIFIER fm_sta_mis_min_fuel_cata.fm_static_bitfield.Vbx_dfctr_sat_xxx ECU_ADDRESS 0xd000549c BIT_MASK 0x8 /end MEASUREMENT
/begin MEASUREMENT Vbx_rdn_mis_min_fuel_cata "" UBYTE _CNV_A_R_A_105_CM 1 0. 0. 255. DISPLAY_IDENTIFIER fm_sta_mis_min_fuel_cata.fm_static_bitfield.Vbx_rdn_xxx ECU_ADDRESS 0xd000549c BIT_MASK 0x40 /end MEASUREMENT
/begin MEASUREMENT Vxx_dtc_stt_mis_min_fuel_cata "" UBYTE _CNV_A_R_A_105_CM 1 0. 0. 255. DISPLAY_IDENTIFIER fm_sta_mis_min_fuel_cata.Vxx_dtc_stt_xxx ECU_ADDRESS 0xd000549d /end MEASUREMENT
/begin MEASUREMENT Vxx_dfctr_mis_min_fuel_trs_h "" UWORD _CNV_A_R_A_105_CM 1 0. 0. 65535. DISPLAY_IDENTIFIER fm_sta_mis_min_fuel_trs_h.Vxx_dfctr_xxx ECU_ADDRESS 0xd000549e /end MEASUREMENT
/begin MEASUREMENT Vxx_rdn_mis_min_fuel_trs_h "" UWORD _CNV_A_R_A_105_CM 1 0. 0. 65535. DISPLAY_IDENTIFIER fm_sta_mis_min_fuel_trs_h.Vxx_rdn_xxx ECU_ADDRESS 0xd00054a0 /end MEASUREMENT
/begin MEASUREMENT Vbx_cf_mis_min_fuel_trs_h "" UBYTE _CNV_A_R_A_105_CM 1 0. 0. 255. DISPLAY_IDENTIFIER fm_sta_mis_min_fuel_trs_h.fm_static_bitfield.Vbx_cf_xxx ECU_ADDRESS 0xd00054a2 BIT_MASK 0x1 /end MEASUREMENT
/begin MEASUREMENT Vbx_clf_mis_min_fuel_trs_h "" UBYTE _CNV_A_R_A_105_CM 1 0. 0. 255. DISPLAY_IDENTIFIER fm_sta_mis_min_fuel_trs_h.fm_static_bitfield.Vbx_clf_xxx ECU_ADDRESS 0xd00054a2 BIT_MASK 0x2 /end MEASUREMENT
/begin MEASUREMENT Vbx_df_old_mis_min_fuel_trs_h "" UBYTE _CNV_A_R_A_105_CM 1 0. 0. 255. DISPLAY_IDENTIFIER fm_sta_mis_min_fuel_trs_h.fm_static_bitfield.Vbx_df_old_xxx ECU_ADDRESS 0xd00054a2 BIT_MASK 0x4 /end MEASUREMENT
/begin MEASUREMENT Vbx_dfctr_sat_mis_min_fuel_trs_h "" UBYTE _CNV_A_R_A_105_CM 1 0. 0. 255. DISPLAY_IDENTIFIER fm_sta_mis_min_fuel_trs_h.fm_static_bitfield.Vbx_dfctr_sat_xxx ECU_ADDRESS 0xd00054a2 BIT_MASK 0x8 /end MEASUREMENT
/begin MEASUREMENT Vbx_rdn_mis_min_fuel_trs_h "" UBYTE _CNV_A_R_A_105_CM 1 0. 0. 255. DISPLAY_IDENTIFIER fm_sta_mis_min_fuel_trs_h.fm_static_bitfield.Vbx_rdn_xxx ECU_ADDRESS 0xd00054a2 BIT_MASK 0x40 /end MEASUREMENT
/begin MEASUREMENT Vxx_dtc_stt_mis_min_fuel_trs_h "" UBYTE _CNV_A_R_A_105_CM 1 0. 0. 255. DISPLAY_IDENTIFIER fm_sta_mis_min_fuel_trs_h.Vxx_dtc_stt_xxx ECU_ADDRESS 0xd00054a3 /end MEASUREMENT
/begin MEASUREMENT Vxx_dfctr_mis_trs_h "" UWORD _CNV_A_R_A_105_CM 1 0. 0. 65535. DISPLAY_IDENTIFIER fm_sta_mis_trs_h.Vxx_dfctr_xxx ECU_ADDRESS 0xd00054a4 /end MEASUREMENT
/begin MEASUREMENT Vxx_rdn_mis_trs_h "" UWORD _CNV_A_R_A_105_CM 1 0. 0. 65535. DISPLAY_IDENTIFIER fm_sta_mis_trs_h.Vxx_rdn_xxx ECU_ADDRESS 0xd00054a6 /end MEASUREMENT
/begin MEASUREMENT Vbx_cf_mis_trs_h "" UBYTE _CNV_A_R_A_105_CM 1 0. 0. 255. DISPLAY_IDENTIFIER fm_sta_mis_trs_h.fm_static_bitfield.Vbx_cf_xxx ECU_ADDRESS 0xd00054a8 BIT_MASK 0x1 /end MEASUREMENT
/begin MEASUREMENT Vbx_clf_mis_trs_h "" UBYTE _CNV_A_R_A_105_CM 1 0. 0. 255. DISPLAY_IDENTIFIER fm_sta_mis_trs_h.fm_static_bitfield.Vbx_clf_xxx ECU_ADDRESS 0xd00054a8 BIT_MASK 0x2 /end MEASUREMENT
/begin MEASUREMENT Vbx_df_old_mis_trs_h "" UBYTE _CNV_A_R_A_105_CM 1 0. 0. 255. DISPLAY_IDENTIFIER fm_sta_mis_trs_h.fm_static_bitfield.Vbx_df_old_xxx ECU_ADDRESS 0xd00054a8 BIT_MASK 0x4 /end MEASUREMENT
/begin MEASUREMENT Vbx_dfctr_sat_mis_trs_h "" UBYTE _CNV_A_R_A_105_CM 1 0. 0. 255. DISPLAY_IDENTIFIER fm_sta_mis_trs_h.fm_static_bitfield.Vbx_dfctr_sat_xxx ECU_ADDRESS 0xd00054a8 BIT_MASK 0x8 /end MEASUREMENT
/begin MEASUREMENT Vbx_rdn_mis_trs_h "" UBYTE _CNV_A_R_A_105_CM 1 0. 0. 255. DISPLAY_IDENTIFIER fm_sta_mis_trs_h.fm_static_bitfield.Vbx_rdn_xxx ECU_ADDRESS 0xd00054a8 BIT_MASK 0x40 /end MEASUREMENT
/begin MEASUREMENT Vxx_dtc_stt_mis_trs_h "" UBYTE _CNV_A_R_A_105_CM 1 0. 0. 255. DISPLAY_IDENTIFIER fm_sta_mis_trs_h.Vxx_dtc_stt_xxx ECU_ADDRESS 0xd00054a9 /end MEASUREMENT
/begin MEASUREMENT Vxx_dfctr_mis_unk_cata "" UWORD _CNV_A_R_A_105_CM 1 0. 0. 65535. DISPLAY_IDENTIFIER fm_sta_mis_unk_cata.Vxx_dfctr_xxx ECU_ADDRESS 0xd00054aa /end MEASUREMENT
/begin MEASUREMENT Vxx_rdn_mis_unk_cata "" UWORD _CNV_A_R_A_105_CM 1 0. 0. 65535. DISPLAY_IDENTIFIER fm_sta_mis_unk_cata.Vxx_rdn_xxx ECU_ADDRESS 0xd00054ac /end MEASUREMENT
/begin MEASUREMENT Vbx_cf_mis_unk_cata "" UBYTE _CNV_A_R_A_105_CM 1 0. 0. 255. DISPLAY_IDENTIFIER fm_sta_mis_unk_cata.fm_static_bitfield.Vbx_cf_xxx ECU_ADDRESS 0xd00054ae BIT_MASK 0x1 /end MEASUREMENT
/begin MEASUREMENT Vbx_clf_mis_unk_cata "" UBYTE _CNV_A_R_A_105_CM 1 0. 0. 255. DISPLAY_IDENTIFIER fm_sta_mis_unk_cata.fm_static_bitfield.Vbx_clf_xxx ECU_ADDRESS 0xd00054ae BIT_MASK 0x2 /end MEASUREMENT
/begin MEASUREMENT Vbx_df_old_mis_unk_cata "" UBYTE _CNV_A_R_A_105_CM 1 0. 0. 255. DISPLAY_IDENTIFIER fm_sta_mis_unk_cata.fm_static_bitfield.Vbx_df_old_xxx ECU_ADDRESS 0xd00054ae BIT_MASK 0x4 /end MEASUREMENT
/begin MEASUREMENT Vbx_dfctr_sat_mis_unk_cata "" UBYTE _CNV_A_R_A_105_CM 1 0. 0. 255. DISPLAY_IDENTIFIER fm_sta_mis_unk_cata.fm_static_bitfield.Vbx_dfctr_sat_xxx ECU_ADDRESS 0xd00054ae BIT_MASK 0x8 /end MEASUREMENT
/begin MEASUREMENT Vbx_rdn_mis_unk_cata "" UBYTE _CNV_A_R_A_105_CM 1 0. 0. 255. DISPLAY_IDENTIFIER fm_sta_mis_unk_cata.fm_static_bitfield.Vbx_rdn_xxx ECU_ADDRESS 0xd00054ae BIT_MASK 0x40 /end MEASUREMENT
/begin MEASUREMENT Vxx_dtc_stt_mis_unk_cata "" UBYTE _CNV_A_R_A_105_CM 1 0. 0. 255. DISPLAY_IDENTIFIER fm_sta_mis_unk_cata.Vxx_dtc_stt_xxx ECU_ADDRESS 0xd00054af /end MEASUREMENT
/begin MEASUREMENT Vxx_dfctr_mis_unk_lpg_cata "" UWORD _CNV_A_R_A_105_CM 1 0. 0. 65535. DISPLAY_IDENTIFIER fm_sta_mis_unk_lpg_cata.Vxx_dfctr_xxx ECU_ADDRESS 0xd00054b0 /end MEASUREMENT
/begin MEASUREMENT Vxx_rdn_mis_unk_lpg_cata "" UWORD _CNV_A_R_A_105_CM 1 0. 0. 65535. DISPLAY_IDENTIFIER fm_sta_mis_unk_lpg_cata.Vxx_rdn_xxx ECU_ADDRESS 0xd00054b2 /end MEASUREMENT
/begin MEASUREMENT Vbx_cf_mis_unk_lpg_cata "" UBYTE _CNV_A_R_A_105_CM 1 0. 0. 255. DISPLAY_IDENTIFIER fm_sta_mis_unk_lpg_cata.fm_static_bitfield.Vbx_cf_xxx ECU_ADDRESS 0xd00054b4 BIT_MASK 0x1 /end MEASUREMENT
/begin MEASUREMENT Vbx_clf_mis_unk_lpg_cata "" UBYTE _CNV_A_R_A_105_CM 1 0. 0. 255. DISPLAY_IDENTIFIER fm_sta_mis_unk_lpg_cata.fm_static_bitfield.Vbx_clf_xxx ECU_ADDRESS 0xd00054b4 BIT_MASK 0x2 /end MEASUREMENT
/begin MEASUREMENT Vbx_df_old_mis_unk_lpg_cata "" UBYTE _CNV_A_R_A_105_CM 1 0. 0. 255. DISPLAY_IDENTIFIER fm_sta_mis_unk_lpg_cata.fm_static_bitfield.Vbx_df_old_xxx ECU_ADDRESS 0xd00054b4 BIT_MASK 0x4 /end MEASUREMENT
/begin MEASUREMENT Vbx_dfctr_sat_mis_unk_lpg_cata "" UBYTE _CNV_A_R_A_105_CM 1 0. 0. 255. DISPLAY_IDENTIFIER fm_sta_mis_unk_lpg_cata.fm_static_bitfield.Vbx_dfctr_sat_xxx ECU_ADDRESS 0xd00054b4 BIT_MASK 0x8 /end MEASUREMENT
/begin MEASUREMENT Vbx_rdn_mis_unk_lpg_cata "" UBYTE _CNV_A_R_A_105_CM 1 0. 0. 255. DISPLAY_IDENTIFIER fm_sta_mis_unk_lpg_cata.fm_static_bitfield.Vbx_rdn_xxx ECU_ADDRESS 0xd00054b4 BIT_MASK 0x40 /end MEASUREMENT
/begin MEASUREMENT Vxx_dtc_stt_mis_unk_lpg_cata "" UBYTE _CNV_A_R_A_105_CM 1 0. 0. 255. DISPLAY_IDENTIFIER fm_sta_mis_unk_lpg_cata.Vxx_dtc_stt_xxx ECU_ADDRESS 0xd00054b5 /end MEASUREMENT
/begin MEASUREMENT Vxx_dfctr_mis_unk_lpg_trs_h "" UWORD _CNV_A_R_A_105_CM 1 0. 0. 65535. DISPLAY_IDENTIFIER fm_sta_mis_unk_lpg_trs_h.Vxx_dfctr_xxx ECU_ADDRESS 0xd00054b6 /end MEASUREMENT
/begin MEASUREMENT Vxx_rdn_mis_unk_lpg_trs_h "" UWORD _CNV_A_R_A_105_CM 1 0. 0. 65535. DISPLAY_IDENTIFIER fm_sta_mis_unk_lpg_trs_h.Vxx_rdn_xxx ECU_ADDRESS 0xd00054b8 /end MEASUREMENT
/begin MEASUREMENT Vbx_cf_mis_unk_lpg_trs_h "" UBYTE _CNV_A_R_A_105_CM 1 0. 0. 255. DISPLAY_IDENTIFIER fm_sta_mis_unk_lpg_trs_h.fm_static_bitfield.Vbx_cf_xxx ECU_ADDRESS 0xd00054ba BIT_MASK 0x1 /end MEASUREMENT
/begin MEASUREMENT Vbx_clf_mis_unk_lpg_trs_h "" UBYTE _CNV_A_R_A_105_CM 1 0. 0. 255. DISPLAY_IDENTIFIER fm_sta_mis_unk_lpg_trs_h.fm_static_bitfield.Vbx_clf_xxx ECU_ADDRESS 0xd00054ba BIT_MASK 0x2 /end MEASUREMENT
/begin MEASUREMENT Vbx_df_old_mis_unk_lpg_trs_h "" UBYTE _CNV_A_R_A_105_CM 1 0. 0. 255. DISPLAY_IDENTIFIER fm_sta_mis_unk_lpg_trs_h.fm_static_bitfield.Vbx_df_old_xxx ECU_ADDRESS 0xd00054ba BIT_MASK 0x4 /end MEASUREMENT
/begin MEASUREMENT Vbx_dfctr_sat_mis_unk_lpg_trs_h "" UBYTE _CNV_A_R_A_105_CM 1 0. 0. 255. DISPLAY_IDENTIFIER fm_sta_mis_unk_lpg_trs_h.fm_static_bitfield.Vbx_dfctr_sat_xxx ECU_ADDRESS 0xd00054ba BIT_MASK 0x8 /end MEASUREMENT
/begin MEASUREMENT Vbx_rdn_mis_unk_lpg_trs_h "" UBYTE _CNV_A_R_A_105_CM 1 0. 0. 255. DISPLAY_IDENTIFIER fm_sta_mis_unk_lpg_trs_h.fm_static_bitfield.Vbx_rdn_xxx ECU_ADDRESS 0xd00054ba BIT_MASK 0x40 /end MEASUREMENT
/begin MEASUREMENT Vxx_dtc_stt_mis_unk_lpg_trs_h "" UBYTE _CNV_A_R_A_105_CM 1 0. 0. 255. DISPLAY_IDENTIFIER fm_sta_mis_unk_lpg_trs_h.Vxx_dtc_stt_xxx ECU_ADDRESS 0xd00054bb /end MEASUREMENT
/begin MEASUREMENT Vxx_dfctr_mis_unk_trs_h "" UWORD _CNV_A_R_A_105_CM 1 0. 0. 65535. DISPLAY_IDENTIFIER fm_sta_mis_unk_trs_h.Vxx_dfctr_xxx ECU_ADDRESS 0xd00054bc /end MEASUREMENT
/begin MEASUREMENT Vxx_rdn_mis_unk_trs_h "" UWORD _CNV_A_R_A_105_CM 1 0. 0. 65535. DISPLAY_IDENTIFIER fm_sta_mis_unk_trs_h.Vxx_rdn_xxx ECU_ADDRESS 0xd00054be /end MEASUREMENT
/begin MEASUREMENT Vbx_cf_mis_unk_trs_h "" UBYTE _CNV_A_R_A_105_CM 1 0. 0. 255. DISPLAY_IDENTIFIER fm_sta_mis_unk_trs_h.fm_static_bitfield.Vbx_cf_xxx ECU_ADDRESS 0xd00054c0 BIT_MASK 0x1 /end MEASUREMENT
/begin MEASUREMENT Vbx_clf_mis_unk_trs_h "" UBYTE _CNV_A_R_A_105_CM 1 0. 0. 255. DISPLAY_IDENTIFIER fm_sta_mis_unk_trs_h.fm_static_bitfield.Vbx_clf_xxx ECU_ADDRESS 0xd00054c0 BIT_MASK 0x2 /end MEASUREMENT
/begin MEASUREMENT Vbx_df_old_mis_unk_trs_h "" UBYTE _CNV_A_R_A_105_CM 1 0. 0. 255. DISPLAY_IDENTIFIER fm_sta_mis_unk_trs_h.fm_static_bitfield.Vbx_df_old_xxx ECU_ADDRESS 0xd00054c0 BIT_MASK 0x4 /end MEASUREMENT
/begin MEASUREMENT Vbx_dfctr_sat_mis_unk_trs_h "" UBYTE _CNV_A_R_A_105_CM 1 0. 0. 255. DISPLAY_IDENTIFIER fm_sta_mis_unk_trs_h.fm_static_bitfield.Vbx_dfctr_sat_xxx ECU_ADDRESS 0xd00054c0 BIT_MASK 0x8 /end MEASUREMENT
/begin MEASUREMENT Vbx_rdn_mis_unk_trs_h "" UBYTE _CNV_A_R_A_105_CM 1 0. 0. 255. DISPLAY_IDENTIFIER fm_sta_mis_unk_trs_h.fm_static_bitfield.Vbx_rdn_xxx ECU_ADDRESS 0xd00054c0 BIT_MASK 0x40 /end MEASUREMENT
/begin MEASUREMENT Vxx_dtc_stt_mis_unk_trs_h "" UBYTE _CNV_A_R_A_105_CM 1 0. 0. 255. DISPLAY_IDENTIFIER fm_sta_mis_unk_trs_h.Vxx_dtc_stt_xxx ECU_ADDRESS 0xd00054c1 /end MEASUREMENT
/begin MEASUREMENT Vxx_dfctr_ptc_rov_oc "" UWORD _CNV_A_R_A_105_CM 1 0. 0. 65535. DISPLAY_IDENTIFIER fm_sta_ptc_rov_oc.Vxx_dfctr_xxx ECU_ADDRESS 0xd000554c /end MEASUREMENT
/begin MEASUREMENT Vxx_rdn_ptc_rov_oc "" UWORD _CNV_A_R_A_105_CM 1 0. 0. 65535. DISPLAY_IDENTIFIER fm_sta_ptc_rov_oc.Vxx_rdn_xxx ECU_ADDRESS 0xd000554e /end MEASUREMENT
/begin MEASUREMENT Vbx_cf_ptc_rov_oc "" UBYTE _CNV_A_R_A_105_CM 1 0. 0. 255. DISPLAY_IDENTIFIER fm_sta_ptc_rov_oc.fm_static_bitfield.Vbx_cf_xxx ECU_ADDRESS 0xd0005550 BIT_MASK 0x1 /end MEASUREMENT
/begin MEASUREMENT Vbx_clf_ptc_rov_oc "" UBYTE _CNV_A_R_A_105_CM 1 0. 0. 255. DISPLAY_IDENTIFIER fm_sta_ptc_rov_oc.fm_static_bitfield.Vbx_clf_xxx ECU_ADDRESS 0xd0005550 BIT_MASK 0x2 /end MEASUREMENT
/begin MEASUREMENT Vbx_df_old_ptc_rov_oc "" UBYTE _CNV_A_R_A_105_CM 1 0. 0. 255. DISPLAY_IDENTIFIER fm_sta_ptc_rov_oc.fm_static_bitfield.Vbx_df_old_xxx ECU_ADDRESS 0xd0005550 BIT_MASK 0x4 /end MEASUREMENT
/begin MEASUREMENT Vbx_dfctr_sat_ptc_rov_oc "" UBYTE _CNV_A_R_A_105_CM 1 0. 0. 255. DISPLAY_IDENTIFIER fm_sta_ptc_rov_oc.fm_static_bitfield.Vbx_dfctr_sat_xxx ECU_ADDRESS 0xd0005550 BIT_MASK 0x8 /end MEASUREMENT
/begin MEASUREMENT Vbx_rdn_ptc_rov_oc "" UBYTE _CNV_A_R_A_105_CM 1 0. 0. 255. DISPLAY_IDENTIFIER fm_sta_ptc_rov_oc.fm_static_bitfield.Vbx_rdn_xxx ECU_ADDRESS 0xd0005550 BIT_MASK 0x40 /end MEASUREMENT
/begin MEASUREMENT Vxx_dtc_stt_ptc_rov_oc "" UBYTE _CNV_A_R_A_105_CM 1 0. 0. 255. DISPLAY_IDENTIFIER fm_sta_ptc_rov_oc.Vxx_dtc_stt_xxx ECU_ADDRESS 0xd0005551 /end MEASUREMENT
/begin MEASUREMENT Vxx_dfctr_ptc_rov_scg "" UWORD _CNV_A_R_A_105_CM 1 0. 0. 65535. DISPLAY_IDENTIFIER fm_sta_ptc_rov_scg.Vxx_dfctr_xxx ECU_ADDRESS 0xd0005552 /end MEASUREMENT
/begin MEASUREMENT Vxx_rdn_ptc_rov_scg "" UWORD _CNV_A_R_A_105_CM 1 0. 0. 65535. DISPLAY_IDENTIFIER fm_sta_ptc_rov_scg.Vxx_rdn_xxx ECU_ADDRESS 0xd0005554 /end MEASUREMENT
/begin MEASUREMENT Vbx_cf_ptc_rov_scg "" UBYTE _CNV_A_R_A_105_CM 1 0. 0. 255. DISPLAY_IDENTIFIER fm_sta_ptc_rov_scg.fm_static_bitfield.Vbx_cf_xxx ECU_ADDRESS 0xd0005556 BIT_MASK 0x1 /end MEASUREMENT
/begin MEASUREMENT Vbx_clf_ptc_rov_scg "" UBYTE _CNV_A_R_A_105_CM 1 0. 0. 255. DISPLAY_IDENTIFIER fm_sta_ptc_rov_scg.fm_static_bitfield.Vbx_clf_xxx ECU_ADDRESS 0xd0005556 BIT_MASK 0x2 /end MEASUREMENT
/begin MEASUREMENT Vbx_df_old_ptc_rov_scg "" UBYTE _CNV_A_R_A_105_CM 1 0. 0. 255. DISPLAY_IDENTIFIER fm_sta_ptc_rov_scg.fm_static_bitfield.Vbx_df_old_xxx ECU_ADDRESS 0xd0005556 BIT_MASK 0x4 /end MEASUREMENT
/begin MEASUREMENT Vbx_dfctr_sat_ptc_rov_scg "" UBYTE _CNV_A_R_A_105_CM 1 0. 0. 255. DISPLAY_IDENTIFIER fm_sta_ptc_rov_scg.fm_static_bitfield.Vbx_dfctr_sat_xxx ECU_ADDRESS 0xd0005556 BIT_MASK 0x8 /end MEASUREMENT
/begin MEASUREMENT Vbx_rdn_ptc_rov_scg "" UBYTE _CNV_A_R_A_105_CM 1 0. 0. 255. DISPLAY_IDENTIFIER fm_sta_ptc_rov_scg.fm_static_bitfield.Vbx_rdn_xxx ECU_ADDRESS 0xd0005556 BIT_MASK 0x40 /end MEASUREMENT
/begin MEASUREMENT Vxx_dtc_stt_ptc_rov_scg "" UBYTE _CNV_A_R_A_105_CM 1 0. 0. 255. DISPLAY_IDENTIFIER fm_sta_ptc_rov_scg.Vxx_dtc_stt_xxx ECU_ADDRESS 0xd0005557 /end MEASUREMENT
/begin MEASUREMENT Vxx_dfctr_ptc_rov_scw "" UWORD _CNV_A_R_A_105_CM 1 0. 0. 65535. DISPLAY_IDENTIFIER fm_sta_ptc_rov_scw.Vxx_dfctr_xxx ECU_ADDRESS 0xd0005558 /end MEASUREMENT
/begin MEASUREMENT Vxx_rdn_ptc_rov_scw "" UWORD _CNV_A_R_A_105_CM 1 0. 0. 65535. DISPLAY_IDENTIFIER fm_sta_ptc_rov_scw.Vxx_rdn_xxx ECU_ADDRESS 0xd000555a /end MEASUREMENT
/begin MEASUREMENT Vbx_cf_ptc_rov_scw "" UBYTE _CNV_A_R_A_105_CM 1 0. 0. 255. DISPLAY_IDENTIFIER fm_sta_ptc_rov_scw.fm_static_bitfield.Vbx_cf_xxx ECU_ADDRESS 0xd000555c BIT_MASK 0x1 /end MEASUREMENT
/begin MEASUREMENT Vbx_clf_ptc_rov_scw "" UBYTE _CNV_A_R_A_105_CM 1 0. 0. 255. DISPLAY_IDENTIFIER fm_sta_ptc_rov_scw.fm_static_bitfield.Vbx_clf_xxx ECU_ADDRESS 0xd000555c BIT_MASK 0x2 /end MEASUREMENT
/begin MEASUREMENT Vbx_df_old_ptc_rov_scw "" UBYTE _CNV_A_R_A_105_CM 1 0. 0. 255. DISPLAY_IDENTIFIER fm_sta_ptc_rov_scw.fm_static_bitfield.Vbx_df_old_xxx ECU_ADDRESS 0xd000555c BIT_MASK 0x4 /end MEASUREMENT
/begin MEASUREMENT Vbx_dfctr_sat_ptc_rov_scw "" UBYTE _CNV_A_R_A_105_CM 1 0. 0. 255. DISPLAY_IDENTIFIER fm_sta_ptc_rov_scw.fm_static_bitfield.Vbx_dfctr_sat_xxx ECU_ADDRESS 0xd000555c BIT_MASK 0x8 /end MEASUREMENT
/begin MEASUREMENT Vbx_rdn_ptc_rov_scw "" UBYTE _CNV_A_R_A_105_CM 1 0. 0. 255. DISPLAY_IDENTIFIER fm_sta_ptc_rov_scw.fm_static_bitfield.Vbx_rdn_xxx ECU_ADDRESS 0xd000555c BIT_MASK 0x40 /end MEASUREMENT
/begin MEASUREMENT Vxx_dtc_stt_ptc_rov_scw "" UBYTE _CNV_A_R_A_105_CM 1 0. 0. 255. DISPLAY_IDENTIFIER fm_sta_ptc_rov_scw.Vxx_dtc_stt_xxx ECU_ADDRESS 0xd000555d /end MEASUREMENT
/begin MEASUREMENT Vxx_dfctr_pws_1_h "" UWORD _CNV_A_R_A_105_CM 1 0. 0. 65535. DISPLAY_IDENTIFIER fm_sta_pws_1_h.Vxx_dfctr_xxx ECU_ADDRESS 0xd000530c /end MEASUREMENT
/begin MEASUREMENT Vxx_rdn_pws_1_h "" UWORD _CNV_A_R_A_105_CM 1 0. 0. 65535. DISPLAY_IDENTIFIER fm_sta_pws_1_h.Vxx_rdn_xxx ECU_ADDRESS 0xd000530e /end MEASUREMENT
/begin MEASUREMENT Vbx_cf_pws_1_h "" UBYTE _CNV_A_R_A_105_CM 1 0. 0. 255. DISPLAY_IDENTIFIER fm_sta_pws_1_h.fm_static_bitfield.Vbx_cf_xxx ECU_ADDRESS 0xd0005310 BIT_MASK 0x1 /end MEASUREMENT
/begin MEASUREMENT Vbx_clf_pws_1_h "" UBYTE _CNV_A_R_A_105_CM 1 0. 0. 255. DISPLAY_IDENTIFIER fm_sta_pws_1_h.fm_static_bitfield.Vbx_clf_xxx ECU_ADDRESS 0xd0005310 BIT_MASK 0x2 /end MEASUREMENT
/begin MEASUREMENT Vbx_df_old_pws_1_h "" UBYTE _CNV_A_R_A_105_CM 1 0. 0. 255. DISPLAY_IDENTIFIER fm_sta_pws_1_h.fm_static_bitfield.Vbx_df_old_xxx ECU_ADDRESS 0xd0005310 BIT_MASK 0x4 /end MEASUREMENT
/begin MEASUREMENT Vbx_dfctr_sat_pws_1_h "" UBYTE _CNV_A_R_A_105_CM 1 0. 0. 255. DISPLAY_IDENTIFIER fm_sta_pws_1_h.fm_static_bitfield.Vbx_dfctr_sat_xxx ECU_ADDRESS 0xd0005310 BIT_MASK 0x8 /end MEASUREMENT
/begin MEASUREMENT Vbx_rdn_pws_1_h "" UBYTE _CNV_A_R_A_105_CM 1 0. 0. 255. DISPLAY_IDENTIFIER fm_sta_pws_1_h.fm_static_bitfield.Vbx_rdn_xxx ECU_ADDRESS 0xd0005310 BIT_MASK 0x40 /end MEASUREMENT
/begin MEASUREMENT Vxx_dtc_stt_pws_1_h "" UBYTE _CNV_A_R_A_105_CM 1 0. 0. 255. DISPLAY_IDENTIFIER fm_sta_pws_1_h.Vxx_dtc_stt_xxx ECU_ADDRESS 0xd0005311 /end MEASUREMENT
/begin MEASUREMENT Vxx_dfctr_pws_1_l "" UWORD _CNV_A_R_A_105_CM 1 0. 0. 65535. DISPLAY_IDENTIFIER fm_sta_pws_1_l.Vxx_dfctr_xxx ECU_ADDRESS 0xd0005312 /end MEASUREMENT
/begin MEASUREMENT Vxx_rdn_pws_1_l "" UWORD _CNV_A_R_A_105_CM 1 0. 0. 65535. DISPLAY_IDENTIFIER fm_sta_pws_1_l.Vxx_rdn_xxx ECU_ADDRESS 0xd0005314 /end MEASUREMENT
/begin MEASUREMENT Vbx_cf_pws_1_l "" UBYTE _CNV_A_R_A_105_CM 1 0. 0. 255. DISPLAY_IDENTIFIER fm_sta_pws_1_l.fm_static_bitfield.Vbx_cf_xxx ECU_ADDRESS 0xd0005316 BIT_MASK 0x1 /end MEASUREMENT
/begin MEASUREMENT Vbx_clf_pws_1_l "" UBYTE _CNV_A_R_A_105_CM 1 0. 0. 255. DISPLAY_IDENTIFIER fm_sta_pws_1_l.fm_static_bitfield.Vbx_clf_xxx ECU_ADDRESS 0xd0005316 BIT_MASK 0x2 /end MEASUREMENT
/begin MEASUREMENT Vbx_df_old_pws_1_l "" UBYTE _CNV_A_R_A_105_CM 1 0. 0. 255. DISPLAY_IDENTIFIER fm_sta_pws_1_l.fm_static_bitfield.Vbx_df_old_xxx ECU_ADDRESS 0xd0005316 BIT_MASK 0x4 /end MEASUREMENT
/begin MEASUREMENT Vbx_dfctr_sat_pws_1_l "" UBYTE _CNV_A_R_A_105_CM 1 0. 0. 255. DISPLAY_IDENTIFIER fm_sta_pws_1_l.fm_static_bitfield.Vbx_dfctr_sat_xxx ECU_ADDRESS 0xd0005316 BIT_MASK 0x8 /end MEASUREMENT
/begin MEASUREMENT Vbx_rdn_pws_1_l "" UBYTE _CNV_A_R_A_105_CM 1 0. 0. 255. DISPLAY_IDENTIFIER fm_sta_pws_1_l.fm_static_bitfield.Vbx_rdn_xxx ECU_ADDRESS 0xd0005316 BIT_MASK 0x40 /end MEASUREMENT
/begin MEASUREMENT Vxx_dtc_stt_pws_1_l "" UBYTE _CNV_A_R_A_105_CM 1 0. 0. 255. DISPLAY_IDENTIFIER fm_sta_pws_1_l.Vxx_dtc_stt_xxx ECU_ADDRESS 0xd0005317 /end MEASUREMENT
/begin MEASUREMENT Vxx_dfctr_pws_2_h "" UWORD _CNV_A_R_A_105_CM 1 0. 0. 65535. DISPLAY_IDENTIFIER fm_sta_pws_2_h.Vxx_dfctr_xxx ECU_ADDRESS 0xd0005318 /end MEASUREMENT
/begin MEASUREMENT Vxx_rdn_pws_2_h "" UWORD _CNV_A_R_A_105_CM 1 0. 0. 65535. DISPLAY_IDENTIFIER fm_sta_pws_2_h.Vxx_rdn_xxx ECU_ADDRESS 0xd000531a /end MEASUREMENT
/begin MEASUREMENT Vbx_cf_pws_2_h "" UBYTE _CNV_A_R_A_105_CM 1 0. 0. 255. DISPLAY_IDENTIFIER fm_sta_pws_2_h.fm_static_bitfield.Vbx_cf_xxx ECU_ADDRESS 0xd000531c BIT_MASK 0x1 /end MEASUREMENT
/begin MEASUREMENT Vbx_clf_pws_2_h "" UBYTE _CNV_A_R_A_105_CM 1 0. 0. 255. DISPLAY_IDENTIFIER fm_sta_pws_2_h.fm_static_bitfield.Vbx_clf_xxx ECU_ADDRESS 0xd000531c BIT_MASK 0x2 /end MEASUREMENT
/begin MEASUREMENT Vbx_df_old_pws_2_h "" UBYTE _CNV_A_R_A_105_CM 1 0. 0. 255. DISPLAY_IDENTIFIER fm_sta_pws_2_h.fm_static_bitfield.Vbx_df_old_xxx ECU_ADDRESS 0xd000531c BIT_MASK 0x4 /end MEASUREMENT
/begin MEASUREMENT Vbx_dfctr_sat_pws_2_h "" UBYTE _CNV_A_R_A_105_CM 1 0. 0. 255. DISPLAY_IDENTIFIER fm_sta_pws_2_h.fm_static_bitfield.Vbx_dfctr_sat_xxx ECU_ADDRESS 0xd000531c BIT_MASK 0x8 /end MEASUREMENT
/begin MEASUREMENT Vbx_rdn_pws_2_h "" UBYTE _CNV_A_R_A_105_CM 1 0. 0. 255. DISPLAY_IDENTIFIER fm_sta_pws_2_h.fm_static_bitfield.Vbx_rdn_xxx ECU_ADDRESS 0xd000531c BIT_MASK 0x40 /end MEASUREMENT
/begin MEASUREMENT Vxx_dtc_stt_pws_2_h "" UBYTE _CNV_A_R_A_105_CM 1 0. 0. 255. DISPLAY_IDENTIFIER fm_sta_pws_2_h.Vxx_dtc_stt_xxx ECU_ADDRESS 0xd000531d /end MEASUREMENT
/begin MEASUREMENT Vxx_dfctr_pws_2_l "" UWORD _CNV_A_R_A_105_CM 1 0. 0. 65535. DISPLAY_IDENTIFIER fm_sta_pws_2_l.Vxx_dfctr_xxx ECU_ADDRESS 0xd000531e /end MEASUREMENT
/begin MEASUREMENT Vxx_rdn_pws_2_l "" UWORD _CNV_A_R_A_105_CM 1 0. 0. 65535. DISPLAY_IDENTIFIER fm_sta_pws_2_l.Vxx_rdn_xxx ECU_ADDRESS 0xd0005320 /end MEASUREMENT
/begin MEASUREMENT Vbx_cf_pws_2_l "" UBYTE _CNV_A_R_A_105_CM 1 0. 0. 255. DISPLAY_IDENTIFIER fm_sta_pws_2_l.fm_static_bitfield.Vbx_cf_xxx ECU_ADDRESS 0xd0005322 BIT_MASK 0x1 /end MEASUREMENT
/begin MEASUREMENT Vbx_clf_pws_2_l "" UBYTE _CNV_A_R_A_105_CM 1 0. 0. 255. DISPLAY_IDENTIFIER fm_sta_pws_2_l.fm_static_bitfield.Vbx_clf_xxx ECU_ADDRESS 0xd0005322 BIT_MASK 0x2 /end MEASUREMENT
/begin MEASUREMENT Vbx_df_old_pws_2_l "" UBYTE _CNV_A_R_A_105_CM 1 0. 0. 255. DISPLAY_IDENTIFIER fm_sta_pws_2_l.fm_static_bitfield.Vbx_df_old_xxx ECU_ADDRESS 0xd0005322 BIT_MASK 0x4 /end MEASUREMENT
/begin MEASUREMENT Vbx_dfctr_sat_pws_2_l "" UBYTE _CNV_A_R_A_105_CM 1 0. 0. 255. DISPLAY_IDENTIFIER fm_sta_pws_2_l.fm_static_bitfield.Vbx_dfctr_sat_xxx ECU_ADDRESS 0xd0005322 BIT_MASK 0x8 /end MEASUREMENT
/begin MEASUREMENT Vbx_rdn_pws_2_l "" UBYTE _CNV_A_R_A_105_CM 1 0. 0. 255. DISPLAY_IDENTIFIER fm_sta_pws_2_l.fm_static_bitfield.Vbx_rdn_xxx ECU_ADDRESS 0xd0005322 BIT_MASK 0x40 /end MEASUREMENT
/begin MEASUREMENT Vxx_dtc_stt_pws_2_l "" UBYTE _CNV_A_R_A_105_CM 1 0. 0. 255. DISPLAY_IDENTIFIER fm_sta_pws_2_l.Vxx_dtc_stt_xxx ECU_ADDRESS 0xd0005323 /end MEASUREMENT
/begin MEASUREMENT Vxx_dfctr_pws_3_h "" UWORD _CNV_A_R_A_105_CM 1 0. 0. 65535. DISPLAY_IDENTIFIER fm_sta_pws_3_h.Vxx_dfctr_xxx ECU_ADDRESS 0xd0005324 /end MEASUREMENT
/begin MEASUREMENT Vxx_rdn_pws_3_h "" UWORD _CNV_A_R_A_105_CM 1 0. 0. 65535. DISPLAY_IDENTIFIER fm_sta_pws_3_h.Vxx_rdn_xxx ECU_ADDRESS 0xd0005326 /end MEASUREMENT
/begin MEASUREMENT Vbx_cf_pws_3_h "" UBYTE _CNV_A_R_A_105_CM 1 0. 0. 255. DISPLAY_IDENTIFIER fm_sta_pws_3_h.fm_static_bitfield.Vbx_cf_xxx ECU_ADDRESS 0xd0005328 BIT_MASK 0x1 /end MEASUREMENT
/begin MEASUREMENT Vbx_clf_pws_3_h "" UBYTE _CNV_A_R_A_105_CM 1 0. 0. 255. DISPLAY_IDENTIFIER fm_sta_pws_3_h.fm_static_bitfield.Vbx_clf_xxx ECU_ADDRESS 0xd0005328 BIT_MASK 0x2 /end MEASUREMENT
/begin MEASUREMENT Vbx_df_old_pws_3_h "" UBYTE _CNV_A_R_A_105_CM 1 0. 0. 255. DISPLAY_IDENTIFIER fm_sta_pws_3_h.fm_static_bitfield.Vbx_df_old_xxx ECU_ADDRESS 0xd0005328 BIT_MASK 0x4 /end MEASUREMENT
/begin MEASUREMENT Vbx_dfctr_sat_pws_3_h "" UBYTE _CNV_A_R_A_105_CM 1 0. 0. 255. DISPLAY_IDENTIFIER fm_sta_pws_3_h.fm_static_bitfield.Vbx_dfctr_sat_xxx ECU_ADDRESS 0xd0005328 BIT_MASK 0x8 /end MEASUREMENT
/begin MEASUREMENT Vbx_rdn_pws_3_h "" UBYTE _CNV_A_R_A_105_CM 1 0. 0. 255. DISPLAY_IDENTIFIER fm_sta_pws_3_h.fm_static_bitfield.Vbx_rdn_xxx ECU_ADDRESS 0xd0005328 BIT_MASK 0x40 /end MEASUREMENT
/begin MEASUREMENT Vxx_dtc_stt_pws_3_h "" UBYTE _CNV_A_R_A_105_CM 1 0. 0. 255. DISPLAY_IDENTIFIER fm_sta_pws_3_h.Vxx_dtc_stt_xxx ECU_ADDRESS 0xd0005329 /end MEASUREMENT
/begin MEASUREMENT Vxx_dfctr_pws_3_l "" UWORD _CNV_A_R_A_105_CM 1 0. 0. 65535. DISPLAY_IDENTIFIER fm_sta_pws_3_l.Vxx_dfctr_xxx ECU_ADDRESS 0xd000532a /end MEASUREMENT
/begin MEASUREMENT Vxx_rdn_pws_3_l "" UWORD _CNV_A_R_A_105_CM 1 0. 0. 65535. DISPLAY_IDENTIFIER fm_sta_pws_3_l.Vxx_rdn_xxx ECU_ADDRESS 0xd000532c /end MEASUREMENT
/begin MEASUREMENT Vbx_cf_pws_3_l "" UBYTE _CNV_A_R_A_105_CM 1 0. 0. 255. DISPLAY_IDENTIFIER fm_sta_pws_3_l.fm_static_bitfield.Vbx_cf_xxx ECU_ADDRESS 0xd000532e BIT_MASK 0x1 /end MEASUREMENT
/begin MEASUREMENT Vbx_clf_pws_3_l "" UBYTE _CNV_A_R_A_105_CM 1 0. 0. 255. DISPLAY_IDENTIFIER fm_sta_pws_3_l.fm_static_bitfield.Vbx_clf_xxx ECU_ADDRESS 0xd000532e BIT_MASK 0x2 /end MEASUREMENT
/begin MEASUREMENT Vbx_df_old_pws_3_l "" UBYTE _CNV_A_R_A_105_CM 1 0. 0. 255. DISPLAY_IDENTIFIER fm_sta_pws_3_l.fm_static_bitfield.Vbx_df_old_xxx ECU_ADDRESS 0xd000532e BIT_MASK 0x4 /end MEASUREMENT
/begin MEASUREMENT Vbx_dfctr_sat_pws_3_l "" UBYTE _CNV_A_R_A_105_CM 1 0. 0. 255. DISPLAY_IDENTIFIER fm_sta_pws_3_l.fm_static_bitfield.Vbx_dfctr_sat_xxx ECU_ADDRESS 0xd000532e BIT_MASK 0x8 /end MEASUREMENT
/begin MEASUREMENT Vbx_rdn_pws_3_l "" UBYTE _CNV_A_R_A_105_CM 1 0. 0. 255. DISPLAY_IDENTIFIER fm_sta_pws_3_l.fm_static_bitfield.Vbx_rdn_xxx ECU_ADDRESS 0xd000532e BIT_MASK 0x40 /end MEASUREMENT
/begin MEASUREMENT Vxx_dtc_stt_pws_3_l "" UBYTE _CNV_A_R_A_105_CM 1 0. 0. 255. DISPLAY_IDENTIFIER fm_sta_pws_3_l.Vxx_dtc_stt_xxx ECU_ADDRESS 0xd000532f /end MEASUREMENT
/begin MEASUREMENT Vxx_dfctr_sens_it_1_nok "" UWORD _CNV_A_R_A_105_CM 1 0. 0. 65535. DISPLAY_IDENTIFIER fm_sta_sens_it_1_nok.Vxx_dfctr_xxx ECU_ADDRESS 0xd0005330 /end MEASUREMENT
/begin MEASUREMENT Vxx_rdn_sens_it_1_nok "" UWORD _CNV_A_R_A_105_CM 1 0. 0. 65535. DISPLAY_IDENTIFIER fm_sta_sens_it_1_nok.Vxx_rdn_xxx ECU_ADDRESS 0xd0005332 /end MEASUREMENT
/begin MEASUREMENT Vbx_cf_sens_it_1_nok "" UBYTE _CNV_A_R_A_105_CM 1 0. 0. 255. DISPLAY_IDENTIFIER fm_sta_sens_it_1_nok.fm_static_bitfield.Vbx_cf_xxx ECU_ADDRESS 0xd0005334 BIT_MASK 0x1 /end MEASUREMENT
/begin MEASUREMENT Vbx_clf_sens_it_1_nok "" UBYTE _CNV_A_R_A_105_CM 1 0. 0. 255. DISPLAY_IDENTIFIER fm_sta_sens_it_1_nok.fm_static_bitfield.Vbx_clf_xxx ECU_ADDRESS 0xd0005334 BIT_MASK 0x2 /end MEASUREMENT
/begin MEASUREMENT Vbx_df_old_sens_it_1_nok "" UBYTE _CNV_A_R_A_105_CM 1 0. 0. 255. DISPLAY_IDENTIFIER fm_sta_sens_it_1_nok.fm_static_bitfield.Vbx_df_old_xxx ECU_ADDRESS 0xd0005334 BIT_MASK 0x4 /end MEASUREMENT
/begin MEASUREMENT Vbx_dfctr_sat_sens_it_1_nok "" UBYTE _CNV_A_R_A_105_CM 1 0. 0. 255. DISPLAY_IDENTIFIER fm_sta_sens_it_1_nok.fm_static_bitfield.Vbx_dfctr_sat_xxx ECU_ADDRESS 0xd0005334 BIT_MASK 0x8 /end MEASUREMENT
/begin MEASUREMENT Vbx_rdn_sens_it_1_nok "" UBYTE _CNV_A_R_A_105_CM 1 0. 0. 255. DISPLAY_IDENTIFIER fm_sta_sens_it_1_nok.fm_static_bitfield.Vbx_rdn_xxx ECU_ADDRESS 0xd0005334 BIT_MASK 0x40 /end MEASUREMENT
/begin MEASUREMENT Vxx_dtc_stt_sens_it_1_nok "" UBYTE _CNV_A_R_A_105_CM 1 0. 0. 255. DISPLAY_IDENTIFIER fm_sta_sens_it_1_nok.Vxx_dtc_stt_xxx ECU_ADDRESS 0xd0005335 /end MEASUREMENT
/begin MEASUREMENT Vxx_dfctr_sens_it_2_nok "" UWORD _CNV_A_R_A_105_CM 1 0. 0. 65535. DISPLAY_IDENTIFIER fm_sta_sens_it_2_nok.Vxx_dfctr_xxx ECU_ADDRESS 0xd0005336 /end MEASUREMENT
/begin MEASUREMENT Vxx_rdn_sens_it_2_nok "" UWORD _CNV_A_R_A_105_CM 1 0. 0. 65535. DISPLAY_IDENTIFIER fm_sta_sens_it_2_nok.Vxx_rdn_xxx ECU_ADDRESS 0xd0005338 /end MEASUREMENT
/begin MEASUREMENT Vbx_cf_sens_it_2_nok "" UBYTE _CNV_A_R_A_105_CM 1 0. 0. 255. DISPLAY_IDENTIFIER fm_sta_sens_it_2_nok.fm_static_bitfield.Vbx_cf_xxx ECU_ADDRESS 0xd000533a BIT_MASK 0x1 /end MEASUREMENT
/begin MEASUREMENT Vbx_clf_sens_it_2_nok "" UBYTE _CNV_A_R_A_105_CM 1 0. 0. 255. DISPLAY_IDENTIFIER fm_sta_sens_it_2_nok.fm_static_bitfield.Vbx_clf_xxx ECU_ADDRESS 0xd000533a BIT_MASK 0x2 /end MEASUREMENT
/begin MEASUREMENT Vbx_df_old_sens_it_2_nok "" UBYTE _CNV_A_R_A_105_CM 1 0. 0. 255. DISPLAY_IDENTIFIER fm_sta_sens_it_2_nok.fm_static_bitfield.Vbx_df_old_xxx ECU_ADDRESS 0xd000533a BIT_MASK 0x4 /end MEASUREMENT
/begin MEASUREMENT Vbx_dfctr_sat_sens_it_2_nok "" UBYTE _CNV_A_R_A_105_CM 1 0. 0. 255. DISPLAY_IDENTIFIER fm_sta_sens_it_2_nok.fm_static_bitfield.Vbx_dfctr_sat_xxx ECU_ADDRESS 0xd000533a BIT_MASK 0x8 /end MEASUREMENT
/begin MEASUREMENT Vbx_rdn_sens_it_2_nok "" UBYTE _CNV_A_R_A_105_CM 1 0. 0. 255. DISPLAY_IDENTIFIER fm_sta_sens_it_2_nok.fm_static_bitfield.Vbx_rdn_xxx ECU_ADDRESS 0xd000533a BIT_MASK 0x40 /end MEASUREMENT
/begin MEASUREMENT Vxx_dtc_stt_sens_it_2_nok "" UBYTE _CNV_A_R_A_105_CM 1 0. 0. 255. DISPLAY_IDENTIFIER fm_sta_sens_it_2_nok.Vxx_dtc_stt_xxx ECU_ADDRESS 0xd000533b /end MEASUREMENT
/begin MEASUREMENT Vxx_dfctr_sens_it_chr "" UWORD _CNV_A_R_A_105_CM 1 0. 0. 65535. DISPLAY_IDENTIFIER fm_sta_sens_it_chr.Vxx_dfctr_xxx ECU_ADDRESS 0xd000533c /end MEASUREMENT
/begin MEASUREMENT Vxx_rdn_sens_it_chr "" UWORD _CNV_A_R_A_105_CM 1 0. 0. 65535. DISPLAY_IDENTIFIER fm_sta_sens_it_chr.Vxx_rdn_xxx ECU_ADDRESS 0xd000533e /end MEASUREMENT
/begin MEASUREMENT Vbx_cf_sens_it_chr "" UBYTE _CNV_A_R_A_105_CM 1 0. 0. 255. DISPLAY_IDENTIFIER fm_sta_sens_it_chr.fm_static_bitfield.Vbx_cf_xxx ECU_ADDRESS 0xd0005340 BIT_MASK 0x1 /end MEASUREMENT
/begin MEASUREMENT Vbx_clf_sens_it_chr "" UBYTE _CNV_A_R_A_105_CM 1 0. 0. 255. DISPLAY_IDENTIFIER fm_sta_sens_it_chr.fm_static_bitfield.Vbx_clf_xxx ECU_ADDRESS 0xd0005340 BIT_MASK 0x2 /end MEASUREMENT
/begin MEASUREMENT Vbx_df_old_sens_it_chr "" UBYTE _CNV_A_R_A_105_CM 1 0. 0. 255. DISPLAY_IDENTIFIER fm_sta_sens_it_chr.fm_static_bitfield.Vbx_df_old_xxx ECU_ADDRESS 0xd0005340 BIT_MASK 0x4 /end MEASUREMENT
/begin MEASUREMENT Vbx_dfctr_sat_sens_it_chr "" UBYTE _CNV_A_R_A_105_CM 1 0. 0. 255. DISPLAY_IDENTIFIER fm_sta_sens_it_chr.fm_static_bitfield.Vbx_dfctr_sat_xxx ECU_ADDRESS 0xd0005340 BIT_MASK 0x8 /end MEASUREMENT
/begin MEASUREMENT Vbx_rdn_sens_it_chr "" UBYTE _CNV_A_R_A_105_CM 1 0. 0. 255. DISPLAY_IDENTIFIER fm_sta_sens_it_chr.fm_static_bitfield.Vbx_rdn_xxx ECU_ADDRESS 0xd0005340 BIT_MASK 0x40 /end MEASUREMENT
/begin MEASUREMENT Vxx_dtc_stt_sens_it_chr "" UBYTE _CNV_A_R_A_105_CM 1 0. 0. 255. DISPLAY_IDENTIFIER fm_sta_sens_it_chr.Vxx_dtc_stt_xxx ECU_ADDRESS 0xd0005341 /end MEASUREMENT
/begin MEASUREMENT Vxx_dfctr_sens_it_sig_mcut "" UWORD _CNV_A_R_A_105_CM 1 0. 0. 65535. DISPLAY_IDENTIFIER fm_sta_sens_it_sig_mcut.Vxx_dfctr_xxx ECU_ADDRESS 0xd0005342 /end MEASUREMENT
/begin MEASUREMENT Vxx_rdn_sens_it_sig_mcut "" UWORD _CNV_A_R_A_105_CM 1 0. 0. 65535. DISPLAY_IDENTIFIER fm_sta_sens_it_sig_mcut.Vxx_rdn_xxx ECU_ADDRESS 0xd0005344 /end MEASUREMENT
/begin MEASUREMENT Vbx_cf_sens_it_sig_mcut "" UBYTE _CNV_A_R_A_105_CM 1 0. 0. 255. DISPLAY_IDENTIFIER fm_sta_sens_it_sig_mcut.fm_static_bitfield.Vbx_cf_xxx ECU_ADDRESS 0xd0005346 BIT_MASK 0x1 /end MEASUREMENT
/begin MEASUREMENT Vbx_clf_sens_it_sig_mcut "" UBYTE _CNV_A_R_A_105_CM 1 0. 0. 255. DISPLAY_IDENTIFIER fm_sta_sens_it_sig_mcut.fm_static_bitfield.Vbx_clf_xxx ECU_ADDRESS 0xd0005346 BIT_MASK 0x2 /end MEASUREMENT
/begin MEASUREMENT Vbx_df_old_sens_it_sig_mcut "" UBYTE _CNV_A_R_A_105_CM 1 0. 0. 255. DISPLAY_IDENTIFIER fm_sta_sens_it_sig_mcut.fm_static_bitfield.Vbx_df_old_xxx ECU_ADDRESS 0xd0005346 BIT_MASK 0x4 /end MEASUREMENT
/begin MEASUREMENT Vbx_dfctr_sat_sens_it_sig_mcut "" UBYTE _CNV_A_R_A_105_CM 1 0. 0. 255. DISPLAY_IDENTIFIER fm_sta_sens_it_sig_mcut.fm_static_bitfield.Vbx_dfctr_sat_xxx ECU_ADDRESS 0xd0005346 BIT_MASK 0x8 /end MEASUREMENT
/begin MEASUREMENT Vbx_rdn_sens_it_sig_mcut "" UBYTE _CNV_A_R_A_105_CM 1 0. 0. 255. DISPLAY_IDENTIFIER fm_sta_sens_it_sig_mcut.fm_static_bitfield.Vbx_rdn_xxx ECU_ADDRESS 0xd0005346 BIT_MASK 0x40 /end MEASUREMENT
/begin MEASUREMENT Vxx_dtc_stt_sens_it_sig_mcut "" UBYTE _CNV_A_R_A_105_CM 1 0. 0. 255. DISPLAY_IDENTIFIER fm_sta_sens_it_sig_mcut.Vxx_dtc_stt_xxx ECU_ADDRESS 0xd0005347 /end MEASUREMENT
/begin MEASUREMENT Vxx_dfctr_sens_map_h "" UWORD _CNV_A_R_A_105_CM 1 0. 0. 65535. DISPLAY_IDENTIFIER fm_sta_sens_map_h.Vxx_dfctr_xxx ECU_ADDRESS 0xd0005348 /end MEASUREMENT
/begin MEASUREMENT Vxx_rdn_sens_map_h "" UWORD _CNV_A_R_A_105_CM 1 0. 0. 65535. DISPLAY_IDENTIFIER fm_sta_sens_map_h.Vxx_rdn_xxx ECU_ADDRESS 0xd000534a /end MEASUREMENT
/begin MEASUREMENT Vbx_cf_sens_map_h "" UBYTE _CNV_A_R_A_105_CM 1 0. 0. 255. DISPLAY_IDENTIFIER fm_sta_sens_map_h.fm_static_bitfield.Vbx_cf_xxx ECU_ADDRESS 0xd000534c BIT_MASK 0x1 /end MEASUREMENT
/begin MEASUREMENT Vbx_clf_sens_map_h "" UBYTE _CNV_A_R_A_105_CM 1 0. 0. 255. DISPLAY_IDENTIFIER fm_sta_sens_map_h.fm_static_bitfield.Vbx_clf_xxx ECU_ADDRESS 0xd000534c BIT_MASK 0x2 /end MEASUREMENT
/begin MEASUREMENT Vbx_df_old_sens_map_h "" UBYTE _CNV_A_R_A_105_CM 1 0. 0. 255. DISPLAY_IDENTIFIER fm_sta_sens_map_h.fm_static_bitfield.Vbx_df_old_xxx ECU_ADDRESS 0xd000534c BIT_MASK 0x4 /end MEASUREMENT
/begin MEASUREMENT Vbx_dfctr_sat_sens_map_h "" UBYTE _CNV_A_R_A_105_CM 1 0. 0. 255. DISPLAY_IDENTIFIER fm_sta_sens_map_h.fm_static_bitfield.Vbx_dfctr_sat_xxx ECU_ADDRESS 0xd000534c BIT_MASK 0x8 /end MEASUREMENT
/begin MEASUREMENT Vbx_rdn_sens_map_h "" UBYTE _CNV_A_R_A_105_CM 1 0. 0. 255. DISPLAY_IDENTIFIER fm_sta_sens_map_h.fm_static_bitfield.Vbx_rdn_xxx ECU_ADDRESS 0xd000534c BIT_MASK 0x40 /end MEASUREMENT
/begin MEASUREMENT Vxx_dtc_stt_sens_map_h "" UBYTE _CNV_A_R_A_105_CM 1 0. 0. 255. DISPLAY_IDENTIFIER fm_sta_sens_map_h.Vxx_dtc_stt_xxx ECU_ADDRESS 0xd000534d /end MEASUREMENT
/begin MEASUREMENT Vxx_dfctr_sens_map_l "" UWORD _CNV_A_R_A_105_CM 1 0. 0. 65535. DISPLAY_IDENTIFIER fm_sta_sens_map_l.Vxx_dfctr_xxx ECU_ADDRESS 0xd000534e /end MEASUREMENT
/begin MEASUREMENT Vxx_rdn_sens_map_l "" UWORD _CNV_A_R_A_105_CM 1 0. 0. 65535. DISPLAY_IDENTIFIER fm_sta_sens_map_l.Vxx_rdn_xxx ECU_ADDRESS 0xd0005350 /end MEASUREMENT
/begin MEASUREMENT Vbx_cf_sens_map_l "" UBYTE _CNV_A_R_A_105_CM 1 0. 0. 255. DISPLAY_IDENTIFIER fm_sta_sens_map_l.fm_static_bitfield.Vbx_cf_xxx ECU_ADDRESS 0xd0005352 BIT_MASK 0x1 /end MEASUREMENT
/begin MEASUREMENT Vbx_clf_sens_map_l "" UBYTE _CNV_A_R_A_105_CM 1 0. 0. 255. DISPLAY_IDENTIFIER fm_sta_sens_map_l.fm_static_bitfield.Vbx_clf_xxx ECU_ADDRESS 0xd0005352 BIT_MASK 0x2 /end MEASUREMENT
/begin MEASUREMENT Vbx_df_old_sens_map_l "" UBYTE _CNV_A_R_A_105_CM 1 0. 0. 255. DISPLAY_IDENTIFIER fm_sta_sens_map_l.fm_static_bitfield.Vbx_df_old_xxx ECU_ADDRESS 0xd0005352 BIT_MASK 0x4 /end MEASUREMENT
/begin MEASUREMENT Vbx_dfctr_sat_sens_map_l "" UBYTE _CNV_A_R_A_105_CM 1 0. 0. 255. DISPLAY_IDENTIFIER fm_sta_sens_map_l.fm_static_bitfield.Vbx_dfctr_sat_xxx ECU_ADDRESS 0xd0005352 BIT_MASK 0x8 /end MEASUREMENT
/begin MEASUREMENT Vbx_rdn_sens_map_l "" UBYTE _CNV_A_R_A_105_CM 1 0. 0. 255. DISPLAY_IDENTIFIER fm_sta_sens_map_l.fm_static_bitfield.Vbx_rdn_xxx ECU_ADDRESS 0xd0005352 BIT_MASK 0x40 /end MEASUREMENT
/begin MEASUREMENT Vxx_dtc_stt_sens_map_l "" UBYTE _CNV_A_R_A_105_CM 1 0. 0. 255. DISPLAY_IDENTIFIER fm_sta_sens_map_l.Vxx_dtc_stt_xxx ECU_ADDRESS 0xd0005353 /end MEASUREMENT
/begin MEASUREMENT Vxx_dfctr_sens_mat_h "" UWORD _CNV_A_R_A_105_CM 1 0. 0. 65535. DISPLAY_IDENTIFIER fm_sta_sens_mat_h.Vxx_dfctr_xxx ECU_ADDRESS 0xd00053a2 /end MEASUREMENT
/begin MEASUREMENT Vxx_rdn_sens_mat_h "" UWORD _CNV_A_R_A_105_CM 1 0. 0. 65535. DISPLAY_IDENTIFIER fm_sta_sens_mat_h.Vxx_rdn_xxx ECU_ADDRESS 0xd00053a4 /end MEASUREMENT
/begin MEASUREMENT Vbx_cf_sens_mat_h "" UBYTE _CNV_A_R_A_105_CM 1 0. 0. 255. DISPLAY_IDENTIFIER fm_sta_sens_mat_h.fm_static_bitfield.Vbx_cf_xxx ECU_ADDRESS 0xd00053a6 BIT_MASK 0x1 /end MEASUREMENT
/begin MEASUREMENT Vbx_clf_sens_mat_h "" UBYTE _CNV_A_R_A_105_CM 1 0. 0. 255. DISPLAY_IDENTIFIER fm_sta_sens_mat_h.fm_static_bitfield.Vbx_clf_xxx ECU_ADDRESS 0xd00053a6 BIT_MASK 0x2 /end MEASUREMENT
/begin MEASUREMENT Vbx_df_old_sens_mat_h "" UBYTE _CNV_A_R_A_105_CM 1 0. 0. 255. DISPLAY_IDENTIFIER fm_sta_sens_mat_h.fm_static_bitfield.Vbx_df_old_xxx ECU_ADDRESS 0xd00053a6 BIT_MASK 0x4 /end MEASUREMENT
/begin MEASUREMENT Vbx_dfctr_sat_sens_mat_h "" UBYTE _CNV_A_R_A_105_CM 1 0. 0. 255. DISPLAY_IDENTIFIER fm_sta_sens_mat_h.fm_static_bitfield.Vbx_dfctr_sat_xxx ECU_ADDRESS 0xd00053a6 BIT_MASK 0x8 /end MEASUREMENT
/begin MEASUREMENT Vbx_rdn_sens_mat_h "" UBYTE _CNV_A_R_A_105_CM 1 0. 0. 255. DISPLAY_IDENTIFIER fm_sta_sens_mat_h.fm_static_bitfield.Vbx_rdn_xxx ECU_ADDRESS 0xd00053a6 BIT_MASK 0x40 /end MEASUREMENT
/begin MEASUREMENT Vxx_dtc_stt_sens_mat_h "" UBYTE _CNV_A_R_A_105_CM 1 0. 0. 255. DISPLAY_IDENTIFIER fm_sta_sens_mat_h.Vxx_dtc_stt_xxx ECU_ADDRESS 0xd00053a7 /end MEASUREMENT
/begin MEASUREMENT Vxx_dfctr_sens_mat_l "" UWORD _CNV_A_R_A_105_CM 1 0. 0. 65535. DISPLAY_IDENTIFIER fm_sta_sens_mat_l.Vxx_dfctr_xxx ECU_ADDRESS 0xd00053a8 /end MEASUREMENT
/begin MEASUREMENT Vxx_rdn_sens_mat_l "" UWORD _CNV_A_R_A_105_CM 1 0. 0. 65535. DISPLAY_IDENTIFIER fm_sta_sens_mat_l.Vxx_rdn_xxx ECU_ADDRESS 0xd00053aa /end MEASUREMENT
/begin MEASUREMENT Vbx_cf_sens_mat_l "" UBYTE _CNV_A_R_A_105_CM 1 0. 0. 255. DISPLAY_IDENTIFIER fm_sta_sens_mat_l.fm_static_bitfield.Vbx_cf_xxx ECU_ADDRESS 0xd00053ac BIT_MASK 0x1 /end MEASUREMENT
/begin MEASUREMENT Vbx_clf_sens_mat_l "" UBYTE _CNV_A_R_A_105_CM 1 0. 0. 255. DISPLAY_IDENTIFIER fm_sta_sens_mat_l.fm_static_bitfield.Vbx_clf_xxx ECU_ADDRESS 0xd00053ac BIT_MASK 0x2 /end MEASUREMENT
/begin MEASUREMENT Vbx_df_old_sens_mat_l "" UBYTE _CNV_A_R_A_105_CM 1 0. 0. 255. DISPLAY_IDENTIFIER fm_sta_sens_mat_l.fm_static_bitfield.Vbx_df_old_xxx ECU_ADDRESS 0xd00053ac BIT_MASK 0x4 /end MEASUREMENT
/begin MEASUREMENT Vbx_dfctr_sat_sens_mat_l "" UBYTE _CNV_A_R_A_105_CM 1 0. 0. 255. DISPLAY_IDENTIFIER fm_sta_sens_mat_l.fm_static_bitfield.Vbx_dfctr_sat_xxx ECU_ADDRESS 0xd00053ac BIT_MASK 0x8 /end MEASUREMENT
/begin MEASUREMENT Vbx_rdn_sens_mat_l "" UBYTE _CNV_A_R_A_105_CM 1 0. 0. 255. DISPLAY_IDENTIFIER fm_sta_sens_mat_l.fm_static_bitfield.Vbx_rdn_xxx ECU_ADDRESS 0xd00053ac BIT_MASK 0x40 /end MEASUREMENT
/begin MEASUREMENT Vxx_dtc_stt_sens_mat_l "" UBYTE _CNV_A_R_A_105_CM 1 0. 0. 255. DISPLAY_IDENTIFIER fm_sta_sens_mat_l.Vxx_dtc_stt_xxx ECU_ADDRESS 0xd00053ad /end MEASUREMENT
/begin MEASUREMENT Vxx_dfctr_sens_rvc_h "" UWORD _CNV_A_R_A_105_CM 1 0. 0. 65535. DISPLAY_IDENTIFIER fm_sta_sens_rvc_h.Vxx_dfctr_xxx ECU_ADDRESS 0xd00055ee /end MEASUREMENT
/begin MEASUREMENT Vxx_rdn_sens_rvc_h "" UWORD _CNV_A_R_A_105_CM 1 0. 0. 65535. DISPLAY_IDENTIFIER fm_sta_sens_rvc_h.Vxx_rdn_xxx ECU_ADDRESS 0xd00055f0 /end MEASUREMENT
/begin MEASUREMENT Vbx_cf_sens_rvc_h "" UBYTE _CNV_A_R_A_105_CM 1 0. 0. 255. DISPLAY_IDENTIFIER fm_sta_sens_rvc_h.fm_static_bitfield.Vbx_cf_xxx ECU_ADDRESS 0xd00055f2 BIT_MASK 0x1 /end MEASUREMENT
/begin MEASUREMENT Vbx_clf_sens_rvc_h "" UBYTE _CNV_A_R_A_105_CM 1 0. 0. 255. DISPLAY_IDENTIFIER fm_sta_sens_rvc_h.fm_static_bitfield.Vbx_clf_xxx ECU_ADDRESS 0xd00055f2 BIT_MASK 0x2 /end MEASUREMENT
/begin MEASUREMENT Vbx_df_old_sens_rvc_h "" UBYTE _CNV_A_R_A_105_CM 1 0. 0. 255. DISPLAY_IDENTIFIER fm_sta_sens_rvc_h.fm_static_bitfield.Vbx_df_old_xxx ECU_ADDRESS 0xd00055f2 BIT_MASK 0x4 /end MEASUREMENT
/begin MEASUREMENT Vbx_dfctr_sat_sens_rvc_h "" UBYTE _CNV_A_R_A_105_CM 1 0. 0. 255. DISPLAY_IDENTIFIER fm_sta_sens_rvc_h.fm_static_bitfield.Vbx_dfctr_sat_xxx ECU_ADDRESS 0xd00055f2 BIT_MASK 0x8 /end MEASUREMENT
/begin MEASUREMENT Vbx_rdn_sens_rvc_h "" UBYTE _CNV_A_R_A_105_CM 1 0. 0. 255. DISPLAY_IDENTIFIER fm_sta_sens_rvc_h.fm_static_bitfield.Vbx_rdn_xxx ECU_ADDRESS 0xd00055f2 BIT_MASK 0x40 /end MEASUREMENT
/begin MEASUREMENT Vxx_dtc_stt_sens_rvc_h "" UBYTE _CNV_A_R_A_105_CM 1 0. 0. 255. DISPLAY_IDENTIFIER fm_sta_sens_rvc_h.Vxx_dtc_stt_xxx ECU_ADDRESS 0xd00055f3 /end MEASUREMENT
/begin MEASUREMENT Vxx_dfctr_sens_rvc_l "" UWORD _CNV_A_R_A_105_CM 1 0. 0. 65535. DISPLAY_IDENTIFIER fm_sta_sens_rvc_l.Vxx_dfctr_xxx ECU_ADDRESS 0xd00055f4 /end MEASUREMENT
/begin MEASUREMENT Vxx_rdn_sens_rvc_l "" UWORD _CNV_A_R_A_105_CM 1 0. 0. 65535. DISPLAY_IDENTIFIER fm_sta_sens_rvc_l.Vxx_rdn_xxx ECU_ADDRESS 0xd00055f6 /end MEASUREMENT
/begin MEASUREMENT Vbx_cf_sens_rvc_l "" UBYTE _CNV_A_R_A_105_CM 1 0. 0. 255. DISPLAY_IDENTIFIER fm_sta_sens_rvc_l.fm_static_bitfield.Vbx_cf_xxx ECU_ADDRESS 0xd00055f8 BIT_MASK 0x1 /end MEASUREMENT
/begin MEASUREMENT Vbx_clf_sens_rvc_l "" UBYTE _CNV_A_R_A_105_CM 1 0. 0. 255. DISPLAY_IDENTIFIER fm_sta_sens_rvc_l.fm_static_bitfield.Vbx_clf_xxx ECU_ADDRESS 0xd00055f8 BIT_MASK 0x2 /end MEASUREMENT
/begin MEASUREMENT Vbx_df_old_sens_rvc_l "" UBYTE _CNV_A_R_A_105_CM 1 0. 0. 255. DISPLAY_IDENTIFIER fm_sta_sens_rvc_l.fm_static_bitfield.Vbx_df_old_xxx ECU_ADDRESS 0xd00055f8 BIT_MASK 0x4 /end MEASUREMENT
/begin MEASUREMENT Vbx_dfctr_sat_sens_rvc_l "" UBYTE _CNV_A_R_A_105_CM 1 0. 0. 255. DISPLAY_IDENTIFIER fm_sta_sens_rvc_l.fm_static_bitfield.Vbx_dfctr_sat_xxx ECU_ADDRESS 0xd00055f8 BIT_MASK 0x8 /end MEASUREMENT
/begin MEASUREMENT Vbx_rdn_sens_rvc_l "" UBYTE _CNV_A_R_A_105_CM 1 0. 0. 255. DISPLAY_IDENTIFIER fm_sta_sens_rvc_l.fm_static_bitfield.Vbx_rdn_xxx ECU_ADDRESS 0xd00055f8 BIT_MASK 0x40 /end MEASUREMENT
/begin MEASUREMENT Vxx_dtc_stt_sens_rvc_l "" UBYTE _CNV_A_R_A_105_CM 1 0. 0. 255. DISPLAY_IDENTIFIER fm_sta_sens_rvc_l.Vxx_dtc_stt_xxx ECU_ADDRESS 0xd00055f9 /end MEASUREMENT
/begin MEASUREMENT Vxx_dfctr_sens_rvc_nok "" UWORD _CNV_A_R_A_105_CM 1 0. 0. 65535. DISPLAY_IDENTIFIER fm_sta_sens_rvc_nok.Vxx_dfctr_xxx ECU_ADDRESS 0xd00055fa /end MEASUREMENT
/begin MEASUREMENT Vxx_rdn_sens_rvc_nok "" UWORD _CNV_A_R_A_105_CM 1 0. 0. 65535. DISPLAY_IDENTIFIER fm_sta_sens_rvc_nok.Vxx_rdn_xxx ECU_ADDRESS 0xd00055fc /end MEASUREMENT
/begin MEASUREMENT Vbx_cf_sens_rvc_nok "" UBYTE _CNV_A_R_A_105_CM 1 0. 0. 255. DISPLAY_IDENTIFIER fm_sta_sens_rvc_nok.fm_static_bitfield.Vbx_cf_xxx ECU_ADDRESS 0xd00055fe BIT_MASK 0x1 /end MEASUREMENT
/begin MEASUREMENT Vbx_clf_sens_rvc_nok "" UBYTE _CNV_A_R_A_105_CM 1 0. 0. 255. DISPLAY_IDENTIFIER fm_sta_sens_rvc_nok.fm_static_bitfield.Vbx_clf_xxx ECU_ADDRESS 0xd00055fe BIT_MASK 0x2 /end MEASUREMENT
/begin MEASUREMENT Vbx_df_old_sens_rvc_nok "" UBYTE _CNV_A_R_A_105_CM 1 0. 0. 255. DISPLAY_IDENTIFIER fm_sta_sens_rvc_nok.fm_static_bitfield.Vbx_df_old_xxx ECU_ADDRESS 0xd00055fe BIT_MASK 0x4 /end MEASUREMENT
/begin MEASUREMENT Vbx_dfctr_sat_sens_rvc_nok "" UBYTE _CNV_A_R_A_105_CM 1 0. 0. 255. DISPLAY_IDENTIFIER fm_sta_sens_rvc_nok.fm_static_bitfield.Vbx_dfctr_sat_xxx ECU_ADDRESS 0xd00055fe BIT_MASK 0x8 /end MEASUREMENT
/begin MEASUREMENT Vbx_rdn_sens_rvc_nok "" UBYTE _CNV_A_R_A_105_CM 1 0. 0. 255. DISPLAY_IDENTIFIER fm_sta_sens_rvc_nok.fm_static_bitfield.Vbx_rdn_xxx ECU_ADDRESS 0xd00055fe BIT_MASK 0x40 /end MEASUREMENT
/begin MEASUREMENT Vxx_dtc_stt_sens_rvc_nok "" UBYTE _CNV_A_R_A_105_CM 1 0. 0. 255. DISPLAY_IDENTIFIER fm_sta_sens_rvc_nok.Vxx_dtc_stt_xxx ECU_ADDRESS 0xd00055ff /end MEASUREMENT
/begin MEASUREMENT Vxx_dfctr_sens_rvc_sig_mcut "" UWORD _CNV_A_R_A_105_CM 1 0. 0. 65535. DISPLAY_IDENTIFIER fm_sta_sens_rvc_sig_mcut.Vxx_dfctr_xxx ECU_ADDRESS 0xd0005600 /end MEASUREMENT
/begin MEASUREMENT Vxx_rdn_sens_rvc_sig_mcut "" UWORD _CNV_A_R_A_105_CM 1 0. 0. 65535. DISPLAY_IDENTIFIER fm_sta_sens_rvc_sig_mcut.Vxx_rdn_xxx ECU_ADDRESS 0xd0005602 /end MEASUREMENT
/begin MEASUREMENT Vbx_cf_sens_rvc_sig_mcut "" UBYTE _CNV_A_R_A_105_CM 1 0. 0. 255. DISPLAY_IDENTIFIER fm_sta_sens_rvc_sig_mcut.fm_static_bitfield.Vbx_cf_xxx ECU_ADDRESS 0xd0005604 BIT_MASK 0x1 /end MEASUREMENT
/begin MEASUREMENT Vbx_clf_sens_rvc_sig_mcut "" UBYTE _CNV_A_R_A_105_CM 1 0. 0. 255. DISPLAY_IDENTIFIER fm_sta_sens_rvc_sig_mcut.fm_static_bitfield.Vbx_clf_xxx ECU_ADDRESS 0xd0005604 BIT_MASK 0x2 /end MEASUREMENT
/begin MEASUREMENT Vbx_df_old_sens_rvc_sig_mcut "" UBYTE _CNV_A_R_A_105_CM 1 0. 0. 255. DISPLAY_IDENTIFIER fm_sta_sens_rvc_sig_mcut.fm_static_bitfield.Vbx_df_old_xxx ECU_ADDRESS 0xd0005604 BIT_MASK 0x4 /end MEASUREMENT
/begin MEASUREMENT Vbx_dfctr_sat_sens_rvc_sig_mcut "" UBYTE _CNV_A_R_A_105_CM 1 0. 0. 255. DISPLAY_IDENTIFIER fm_sta_sens_rvc_sig_mcut.fm_static_bitfield.Vbx_dfctr_sat_xxx ECU_ADDRESS 0xd0005604 BIT_MASK 0x8 /end MEASUREMENT
/begin MEASUREMENT Vbx_rdn_sens_rvc_sig_mcut "" UBYTE _CNV_A_R_A_105_CM 1 0. 0. 255. DISPLAY_IDENTIFIER fm_sta_sens_rvc_sig_mcut.fm_static_bitfield.Vbx_rdn_xxx ECU_ADDRESS 0xd0005604 BIT_MASK 0x40 /end MEASUREMENT
/begin MEASUREMENT Vxx_dtc_stt_sens_rvc_sig_mcut "" UBYTE _CNV_A_R_A_105_CM 1 0. 0. 255. DISPLAY_IDENTIFIER fm_sta_sens_rvc_sig_mcut.Vxx_dtc_stt_xxx ECU_ADDRESS 0xd0005605 /end MEASUREMENT
/begin MEASUREMENT Vxx_dfctr_sens_spg_h "" UWORD _CNV_A_R_A_105_CM 1 0. 0. 65535. DISPLAY_IDENTIFIER fm_sta_sens_spg_h.Vxx_dfctr_xxx ECU_ADDRESS 0xd0005354 /end MEASUREMENT
/begin MEASUREMENT Vxx_rdn_sens_spg_h "" UWORD _CNV_A_R_A_105_CM 1 0. 0. 65535. DISPLAY_IDENTIFIER fm_sta_sens_spg_h.Vxx_rdn_xxx ECU_ADDRESS 0xd0005356 /end MEASUREMENT
/begin MEASUREMENT Vbx_cf_sens_spg_h "" UBYTE _CNV_A_R_A_105_CM 1 0. 0. 255. DISPLAY_IDENTIFIER fm_sta_sens_spg_h.fm_static_bitfield.Vbx_cf_xxx ECU_ADDRESS 0xd0005358 BIT_MASK 0x1 /end MEASUREMENT
/begin MEASUREMENT Vbx_clf_sens_spg_h "" UBYTE _CNV_A_R_A_105_CM 1 0. 0. 255. DISPLAY_IDENTIFIER fm_sta_sens_spg_h.fm_static_bitfield.Vbx_clf_xxx ECU_ADDRESS 0xd0005358 BIT_MASK 0x2 /end MEASUREMENT
/begin MEASUREMENT Vbx_df_old_sens_spg_h "" UBYTE _CNV_A_R_A_105_CM 1 0. 0. 255. DISPLAY_IDENTIFIER fm_sta_sens_spg_h.fm_static_bitfield.Vbx_df_old_xxx ECU_ADDRESS 0xd0005358 BIT_MASK 0x4 /end MEASUREMENT
/begin MEASUREMENT Vbx_dfctr_sat_sens_spg_h "" UBYTE _CNV_A_R_A_105_CM 1 0. 0. 255. DISPLAY_IDENTIFIER fm_sta_sens_spg_h.fm_static_bitfield.Vbx_dfctr_sat_xxx ECU_ADDRESS 0xd0005358 BIT_MASK 0x8 /end MEASUREMENT
/begin MEASUREMENT Vbx_rdn_sens_spg_h "" UBYTE _CNV_A_R_A_105_CM 1 0. 0. 255. DISPLAY_IDENTIFIER fm_sta_sens_spg_h.fm_static_bitfield.Vbx_rdn_xxx ECU_ADDRESS 0xd0005358 BIT_MASK 0x40 /end MEASUREMENT
/begin MEASUREMENT Vxx_dtc_stt_sens_spg_h "" UBYTE _CNV_A_R_A_105_CM 1 0. 0. 255. DISPLAY_IDENTIFIER fm_sta_sens_spg_h.Vxx_dtc_stt_xxx ECU_ADDRESS 0xd0005359 /end MEASUREMENT
/begin MEASUREMENT Vxx_dfctr_sens_spg_l "" UWORD _CNV_A_R_A_105_CM 1 0. 0. 65535. DISPLAY_IDENTIFIER fm_sta_sens_spg_l.Vxx_dfctr_xxx ECU_ADDRESS 0xd000535a /end MEASUREMENT
/begin MEASUREMENT Vxx_rdn_sens_spg_l "" UWORD _CNV_A_R_A_105_CM 1 0. 0. 65535. DISPLAY_IDENTIFIER fm_sta_sens_spg_l.Vxx_rdn_xxx ECU_ADDRESS 0xd000535c /end MEASUREMENT
/begin MEASUREMENT Vbx_cf_sens_spg_l "" UBYTE _CNV_A_R_A_105_CM 1 0. 0. 255. DISPLAY_IDENTIFIER fm_sta_sens_spg_l.fm_static_bitfield.Vbx_cf_xxx ECU_ADDRESS 0xd000535e BIT_MASK 0x1 /end MEASUREMENT
/begin MEASUREMENT Vbx_clf_sens_spg_l "" UBYTE _CNV_A_R_A_105_CM 1 0. 0. 255. DISPLAY_IDENTIFIER fm_sta_sens_spg_l.fm_static_bitfield.Vbx_clf_xxx ECU_ADDRESS 0xd000535e BIT_MASK 0x2 /end MEASUREMENT
/begin MEASUREMENT Vbx_df_old_sens_spg_l "" UBYTE _CNV_A_R_A_105_CM 1 0. 0. 255. DISPLAY_IDENTIFIER fm_sta_sens_spg_l.fm_static_bitfield.Vbx_df_old_xxx ECU_ADDRESS 0xd000535e BIT_MASK 0x4 /end MEASUREMENT
/begin MEASUREMENT Vbx_dfctr_sat_sens_spg_l "" UBYTE _CNV_A_R_A_105_CM 1 0. 0. 255. DISPLAY_IDENTIFIER fm_sta_sens_spg_l.fm_static_bitfield.Vbx_dfctr_sat_xxx ECU_ADDRESS 0xd000535e BIT_MASK 0x8 /end MEASUREMENT
/begin MEASUREMENT Vbx_rdn_sens_spg_l "" UBYTE _CNV_A_R_A_105_CM 1 0. 0. 255. DISPLAY_IDENTIFIER fm_sta_sens_spg_l.fm_static_bitfield.Vbx_rdn_xxx ECU_ADDRESS 0xd000535e BIT_MASK 0x40 /end MEASUREMENT
/begin MEASUREMENT Vxx_dtc_stt_sens_spg_l "" UBYTE _CNV_A_R_A_105_CM 1 0. 0. 255. DISPLAY_IDENTIFIER fm_sta_sens_spg_l.Vxx_dtc_stt_xxx ECU_ADDRESS 0xd000535f /end MEASUREMENT
/begin MEASUREMENT Vxx_dfctr_sens_tco_h "" UWORD _CNV_A_R_A_105_CM 1 0. 0. 65535. DISPLAY_IDENTIFIER fm_sta_sens_tco_h.Vxx_dfctr_xxx ECU_ADDRESS 0xd0005360 /end MEASUREMENT
/begin MEASUREMENT Vxx_rdn_sens_tco_h "" UWORD _CNV_A_R_A_105_CM 1 0. 0. 65535. DISPLAY_IDENTIFIER fm_sta_sens_tco_h.Vxx_rdn_xxx ECU_ADDRESS 0xd0005362 /end MEASUREMENT
/begin MEASUREMENT Vbx_cf_sens_tco_h "" UBYTE _CNV_A_R_A_105_CM 1 0. 0. 255. DISPLAY_IDENTIFIER fm_sta_sens_tco_h.fm_static_bitfield.Vbx_cf_xxx ECU_ADDRESS 0xd0005364 BIT_MASK 0x1 /end MEASUREMENT
/begin MEASUREMENT Vbx_clf_sens_tco_h "" UBYTE _CNV_A_R_A_105_CM 1 0. 0. 255. DISPLAY_IDENTIFIER fm_sta_sens_tco_h.fm_static_bitfield.Vbx_clf_xxx ECU_ADDRESS 0xd0005364 BIT_MASK 0x2 /end MEASUREMENT
/begin MEASUREMENT Vbx_df_old_sens_tco_h "" UBYTE _CNV_A_R_A_105_CM 1 0. 0. 255. DISPLAY_IDENTIFIER fm_sta_sens_tco_h.fm_static_bitfield.Vbx_df_old_xxx ECU_ADDRESS 0xd0005364 BIT_MASK 0x4 /end MEASUREMENT
/begin MEASUREMENT Vbx_dfctr_sat_sens_tco_h "" UBYTE _CNV_A_R_A_105_CM 1 0. 0. 255. DISPLAY_IDENTIFIER fm_sta_sens_tco_h.fm_static_bitfield.Vbx_dfctr_sat_xxx ECU_ADDRESS 0xd0005364 BIT_MASK 0x8 /end MEASUREMENT
/begin MEASUREMENT Vbx_rdn_sens_tco_h "" UBYTE _CNV_A_R_A_105_CM 1 0. 0. 255. DISPLAY_IDENTIFIER fm_sta_sens_tco_h.fm_static_bitfield.Vbx_rdn_xxx ECU_ADDRESS 0xd0005364 BIT_MASK 0x40 /end MEASUREMENT
/begin MEASUREMENT Vxx_dtc_stt_sens_tco_h "" UBYTE _CNV_A_R_A_105_CM 1 0. 0. 255. DISPLAY_IDENTIFIER fm_sta_sens_tco_h.Vxx_dtc_stt_xxx ECU_ADDRESS 0xd0005365 /end MEASUREMENT
/begin MEASUREMENT Vxx_dfctr_sens_tco_l "" UWORD _CNV_A_R_A_105_CM 1 0. 0. 65535. DISPLAY_IDENTIFIER fm_sta_sens_tco_l.Vxx_dfctr_xxx ECU_ADDRESS 0xd0005366 /end MEASUREMENT
/begin MEASUREMENT Vxx_rdn_sens_tco_l "" UWORD _CNV_A_R_A_105_CM 1 0. 0. 65535. DISPLAY_IDENTIFIER fm_sta_sens_tco_l.Vxx_rdn_xxx ECU_ADDRESS 0xd0005368 /end MEASUREMENT
/begin MEASUREMENT Vbx_cf_sens_tco_l "" UBYTE _CNV_A_R_A_105_CM 1 0. 0. 255. DISPLAY_IDENTIFIER fm_sta_sens_tco_l.fm_static_bitfield.Vbx_cf_xxx ECU_ADDRESS 0xd000536a BIT_MASK 0x1 /end MEASUREMENT
/begin MEASUREMENT Vbx_clf_sens_tco_l "" UBYTE _CNV_A_R_A_105_CM 1 0. 0. 255. DISPLAY_IDENTIFIER fm_sta_sens_tco_l.fm_static_bitfield.Vbx_clf_xxx ECU_ADDRESS 0xd000536a BIT_MASK 0x2 /end MEASUREMENT
/begin MEASUREMENT Vbx_df_old_sens_tco_l "" UBYTE _CNV_A_R_A_105_CM 1 0. 0. 255. DISPLAY_IDENTIFIER fm_sta_sens_tco_l.fm_static_bitfield.Vbx_df_old_xxx ECU_ADDRESS 0xd000536a BIT_MASK 0x4 /end MEASUREMENT
/begin MEASUREMENT Vbx_dfctr_sat_sens_tco_l "" UBYTE _CNV_A_R_A_105_CM 1 0. 0. 255. DISPLAY_IDENTIFIER fm_sta_sens_tco_l.fm_static_bitfield.Vbx_dfctr_sat_xxx ECU_ADDRESS 0xd000536a BIT_MASK 0x8 /end MEASUREMENT
/begin MEASUREMENT Vbx_rdn_sens_tco_l "" UBYTE _CNV_A_R_A_105_CM 1 0. 0. 255. DISPLAY_IDENTIFIER fm_sta_sens_tco_l.fm_static_bitfield.Vbx_rdn_xxx ECU_ADDRESS 0xd000536a BIT_MASK 0x40 /end MEASUREMENT
/begin MEASUREMENT Vxx_dtc_stt_sens_tco_l "" UBYTE _CNV_A_R_A_105_CM 1 0. 0. 255. DISPLAY_IDENTIFIER fm_sta_sens_tco_l.Vxx_dtc_stt_xxx ECU_ADDRESS 0xd000536b /end MEASUREMENT
/begin MEASUREMENT Vxx_dfctr_sens_tco_sig_mcut "" UWORD _CNV_A_R_A_105_CM 1 0. 0. 65535. DISPLAY_IDENTIFIER fm_sta_sens_tco_sig_mcut.Vxx_dfctr_xxx ECU_ADDRESS 0xd0005594 /end MEASUREMENT
/begin MEASUREMENT Vxx_rdn_sens_tco_sig_mcut "" UWORD _CNV_A_R_A_105_CM 1 0. 0. 65535. DISPLAY_IDENTIFIER fm_sta_sens_tco_sig_mcut.Vxx_rdn_xxx ECU_ADDRESS 0xd0005596 /end MEASUREMENT
/begin MEASUREMENT Vbx_cf_sens_tco_sig_mcut "" UBYTE _CNV_A_R_A_105_CM 1 0. 0. 255. DISPLAY_IDENTIFIER fm_sta_sens_tco_sig_mcut.fm_static_bitfield.Vbx_cf_xxx ECU_ADDRESS 0xd0005598 BIT_MASK 0x1 /end MEASUREMENT
/begin MEASUREMENT Vbx_clf_sens_tco_sig_mcut "" UBYTE _CNV_A_R_A_105_CM 1 0. 0. 255. DISPLAY_IDENTIFIER fm_sta_sens_tco_sig_mcut.fm_static_bitfield.Vbx_clf_xxx ECU_ADDRESS 0xd0005598 BIT_MASK 0x2 /end MEASUREMENT
/begin MEASUREMENT Vbx_df_old_sens_tco_sig_mcut "" UBYTE _CNV_A_R_A_105_CM 1 0. 0. 255. DISPLAY_IDENTIFIER fm_sta_sens_tco_sig_mcut.fm_static_bitfield.Vbx_df_old_xxx ECU_ADDRESS 0xd0005598 BIT_MASK 0x4 /end MEASUREMENT
/begin MEASUREMENT Vbx_dfctr_sat_sens_tco_sig_mcut "" UBYTE _CNV_A_R_A_105_CM 1 0. 0. 255. DISPLAY_IDENTIFIER fm_sta_sens_tco_sig_mcut.fm_static_bitfield.Vbx_dfctr_sat_xxx ECU_ADDRESS 0xd0005598 BIT_MASK 0x8 /end MEASUREMENT
/begin MEASUREMENT Vbx_rdn_sens_tco_sig_mcut "" UBYTE _CNV_A_R_A_105_CM 1 0. 0. 255. DISPLAY_IDENTIFIER fm_sta_sens_tco_sig_mcut.fm_static_bitfield.Vbx_rdn_xxx ECU_ADDRESS 0xd0005598 BIT_MASK 0x40 /end MEASUREMENT
/begin MEASUREMENT Vxx_dtc_stt_sens_tco_sig_mcut "" UBYTE _CNV_A_R_A_105_CM 1 0. 0. 255. DISPLAY_IDENTIFIER fm_sta_sens_tco_sig_mcut.Vxx_dtc_stt_xxx ECU_ADDRESS 0xd0005599 /end MEASUREMENT
/begin MEASUREMENT Vxx_dfctr_sfty_tq_chr "" UWORD _CNV_A_R_A_105_CM 1 0. 0. 65535. DISPLAY_IDENTIFIER fm_sta_sfty_tq_chr.Vxx_dfctr_xxx ECU_ADDRESS 0xd000551c /end MEASUREMENT
/begin MEASUREMENT Vxx_rdn_sfty_tq_chr "" UWORD _CNV_A_R_A_105_CM 1 0. 0. 65535. DISPLAY_IDENTIFIER fm_sta_sfty_tq_chr.Vxx_rdn_xxx ECU_ADDRESS 0xd000551e /end MEASUREMENT
/begin MEASUREMENT Vbx_cf_sfty_tq_chr "" UBYTE _CNV_A_R_A_105_CM 1 0. 0. 255. DISPLAY_IDENTIFIER fm_sta_sfty_tq_chr.fm_static_bitfield.Vbx_cf_xxx ECU_ADDRESS 0xd0005520 BIT_MASK 0x1 /end MEASUREMENT
/begin MEASUREMENT Vbx_clf_sfty_tq_chr "" UBYTE _CNV_A_R_A_105_CM 1 0. 0. 255. DISPLAY_IDENTIFIER fm_sta_sfty_tq_chr.fm_static_bitfield.Vbx_clf_xxx ECU_ADDRESS 0xd0005520 BIT_MASK 0x2 /end MEASUREMENT
/begin MEASUREMENT Vbx_df_old_sfty_tq_chr "" UBYTE _CNV_A_R_A_105_CM 1 0. 0. 255. DISPLAY_IDENTIFIER fm_sta_sfty_tq_chr.fm_static_bitfield.Vbx_df_old_xxx ECU_ADDRESS 0xd0005520 BIT_MASK 0x4 /end MEASUREMENT
/begin MEASUREMENT Vbx_dfctr_sat_sfty_tq_chr "" UBYTE _CNV_A_R_A_105_CM 1 0. 0. 255. DISPLAY_IDENTIFIER fm_sta_sfty_tq_chr.fm_static_bitfield.Vbx_dfctr_sat_xxx ECU_ADDRESS 0xd0005520 BIT_MASK 0x8 /end MEASUREMENT
/begin MEASUREMENT Vbx_rdn_sfty_tq_chr "" UBYTE _CNV_A_R_A_105_CM 1 0. 0. 255. DISPLAY_IDENTIFIER fm_sta_sfty_tq_chr.fm_static_bitfield.Vbx_rdn_xxx ECU_ADDRESS 0xd0005520 BIT_MASK 0x40 /end MEASUREMENT
/begin MEASUREMENT Vxx_dtc_stt_sfty_tq_chr "" UBYTE _CNV_A_R_A_105_CM 1 0. 0. 255. DISPLAY_IDENTIFIER fm_sta_sfty_tq_chr.Vxx_dtc_stt_xxx ECU_ADDRESS 0xd0005521 /end MEASUREMENT
/begin MEASUREMENT Vxx_dfctr_sfty_tq_clc_chr "" UWORD _CNV_A_R_A_105_CM 1 0. 0. 65535. DISPLAY_IDENTIFIER fm_sta_sfty_tq_clc_chr.Vxx_dfctr_xxx ECU_ADDRESS 0xd0005522 /end MEASUREMENT
/begin MEASUREMENT Vxx_rdn_sfty_tq_clc_chr "" UWORD _CNV_A_R_A_105_CM 1 0. 0. 65535. DISPLAY_IDENTIFIER fm_sta_sfty_tq_clc_chr.Vxx_rdn_xxx ECU_ADDRESS 0xd0005524 /end MEASUREMENT
/begin MEASUREMENT Vbx_cf_sfty_tq_clc_chr "" UBYTE _CNV_A_R_A_105_CM 1 0. 0. 255. DISPLAY_IDENTIFIER fm_sta_sfty_tq_clc_chr.fm_static_bitfield.Vbx_cf_xxx ECU_ADDRESS 0xd0005526 BIT_MASK 0x1 /end MEASUREMENT
/begin MEASUREMENT Vbx_clf_sfty_tq_clc_chr "" UBYTE _CNV_A_R_A_105_CM 1 0. 0. 255. DISPLAY_IDENTIFIER fm_sta_sfty_tq_clc_chr.fm_static_bitfield.Vbx_clf_xxx ECU_ADDRESS 0xd0005526 BIT_MASK 0x2 /end MEASUREMENT
/begin MEASUREMENT Vbx_df_old_sfty_tq_clc_chr "" UBYTE _CNV_A_R_A_105_CM 1 0. 0. 255. DISPLAY_IDENTIFIER fm_sta_sfty_tq_clc_chr.fm_static_bitfield.Vbx_df_old_xxx ECU_ADDRESS 0xd0005526 BIT_MASK 0x4 /end MEASUREMENT
/begin MEASUREMENT Vbx_dfctr_sat_sfty_tq_clc_chr "" UBYTE _CNV_A_R_A_105_CM 1 0. 0. 255. DISPLAY_IDENTIFIER fm_sta_sfty_tq_clc_chr.fm_static_bitfield.Vbx_dfctr_sat_xxx ECU_ADDRESS 0xd0005526 BIT_MASK 0x8 /end MEASUREMENT
/begin MEASUREMENT Vbx_rdn_sfty_tq_clc_chr "" UBYTE _CNV_A_R_A_105_CM 1 0. 0. 255. DISPLAY_IDENTIFIER fm_sta_sfty_tq_clc_chr.fm_static_bitfield.Vbx_rdn_xxx ECU_ADDRESS 0xd0005526 BIT_MASK 0x40 /end MEASUREMENT
/begin MEASUREMENT Vxx_dtc_stt_sfty_tq_clc_chr "" UBYTE _CNV_A_R_A_105_CM 1 0. 0. 255. DISPLAY_IDENTIFIER fm_sta_sfty_tq_clc_chr.Vxx_dtc_stt_xxx ECU_ADDRESS 0xd0005527 /end MEASUREMENT
/begin MEASUREMENT Vxx_dfctr_sfty_tq_lih_chr "" UWORD _CNV_A_R_A_105_CM 1 0. 0. 65535. DISPLAY_IDENTIFIER fm_sta_sfty_tq_lih_chr.Vxx_dfctr_xxx ECU_ADDRESS 0xd0005528 /end MEASUREMENT
/begin MEASUREMENT Vxx_rdn_sfty_tq_lih_chr "" UWORD _CNV_A_R_A_105_CM 1 0. 0. 65535. DISPLAY_IDENTIFIER fm_sta_sfty_tq_lih_chr.Vxx_rdn_xxx ECU_ADDRESS 0xd000552a /end MEASUREMENT
/begin MEASUREMENT Vbx_cf_sfty_tq_lih_chr "" UBYTE _CNV_A_R_A_105_CM 1 0. 0. 255. DISPLAY_IDENTIFIER fm_sta_sfty_tq_lih_chr.fm_static_bitfield.Vbx_cf_xxx ECU_ADDRESS 0xd000552c BIT_MASK 0x1 /end MEASUREMENT
/begin MEASUREMENT Vbx_clf_sfty_tq_lih_chr "" UBYTE _CNV_A_R_A_105_CM 1 0. 0. 255. DISPLAY_IDENTIFIER fm_sta_sfty_tq_lih_chr.fm_static_bitfield.Vbx_clf_xxx ECU_ADDRESS 0xd000552c BIT_MASK 0x2 /end MEASUREMENT
/begin MEASUREMENT Vbx_df_old_sfty_tq_lih_chr "" UBYTE _CNV_A_R_A_105_CM 1 0. 0. 255. DISPLAY_IDENTIFIER fm_sta_sfty_tq_lih_chr.fm_static_bitfield.Vbx_df_old_xxx ECU_ADDRESS 0xd000552c BIT_MASK 0x4 /end MEASUREMENT
/begin MEASUREMENT Vbx_dfctr_sat_sfty_tq_lih_chr "" UBYTE _CNV_A_R_A_105_CM 1 0. 0. 255. DISPLAY_IDENTIFIER fm_sta_sfty_tq_lih_chr.fm_static_bitfield.Vbx_dfctr_sat_xxx ECU_ADDRESS 0xd000552c BIT_MASK 0x8 /end MEASUREMENT
/begin MEASUREMENT Vbx_rdn_sfty_tq_lih_chr "" UBYTE _CNV_A_R_A_105_CM 1 0. 0. 255. DISPLAY_IDENTIFIER fm_sta_sfty_tq_lih_chr.fm_static_bitfield.Vbx_rdn_xxx ECU_ADDRESS 0xd000552c BIT_MASK 0x40 /end MEASUREMENT
/begin MEASUREMENT Vxx_dtc_stt_sfty_tq_lih_chr "" UBYTE _CNV_A_R_A_105_CM 1 0. 0. 255. DISPLAY_IDENTIFIER fm_sta_sfty_tq_lih_chr.Vxx_dtc_stt_xxx ECU_ADDRESS 0xd000552d /end MEASUREMENT
/begin MEASUREMENT Vxx_dfctr_spg_oor "" UWORD _CNV_A_R_A_105_CM 1 0. 0. 65535. DISPLAY_IDENTIFIER fm_sta_spg_oor.Vxx_dfctr_xxx ECU_ADDRESS 0xd00054c2 /end MEASUREMENT
/begin MEASUREMENT Vxx_rdn_spg_oor "" UWORD _CNV_A_R_A_105_CM 1 0. 0. 65535. DISPLAY_IDENTIFIER fm_sta_spg_oor.Vxx_rdn_xxx ECU_ADDRESS 0xd00054c4 /end MEASUREMENT
/begin MEASUREMENT Vbx_cf_spg_oor "" UBYTE _CNV_A_R_A_105_CM 1 0. 0. 255. DISPLAY_IDENTIFIER fm_sta_spg_oor.fm_static_bitfield.Vbx_cf_xxx ECU_ADDRESS 0xd00054c6 BIT_MASK 0x1 /end MEASUREMENT
/begin MEASUREMENT Vbx_clf_spg_oor "" UBYTE _CNV_A_R_A_105_CM 1 0. 0. 255. DISPLAY_IDENTIFIER fm_sta_spg_oor.fm_static_bitfield.Vbx_clf_xxx ECU_ADDRESS 0xd00054c6 BIT_MASK 0x2 /end MEASUREMENT
/begin MEASUREMENT Vbx_df_old_spg_oor "" UBYTE _CNV_A_R_A_105_CM 1 0. 0. 255. DISPLAY_IDENTIFIER fm_sta_spg_oor.fm_static_bitfield.Vbx_df_old_xxx ECU_ADDRESS 0xd00054c6 BIT_MASK 0x4 /end MEASUREMENT
/begin MEASUREMENT Vbx_dfctr_sat_spg_oor "" UBYTE _CNV_A_R_A_105_CM 1 0. 0. 255. DISPLAY_IDENTIFIER fm_sta_spg_oor.fm_static_bitfield.Vbx_dfctr_sat_xxx ECU_ADDRESS 0xd00054c6 BIT_MASK 0x8 /end MEASUREMENT
/begin MEASUREMENT Vbx_rdn_spg_oor "" UBYTE _CNV_A_R_A_105_CM 1 0. 0. 255. DISPLAY_IDENTIFIER fm_sta_spg_oor.fm_static_bitfield.Vbx_rdn_xxx ECU_ADDRESS 0xd00054c6 BIT_MASK 0x40 /end MEASUREMENT
/begin MEASUREMENT Vxx_dtc_stt_spg_oor "" UBYTE _CNV_A_R_A_105_CM 1 0. 0. 255. DISPLAY_IDENTIFIER fm_sta_spg_oor.Vxx_dtc_stt_xxx ECU_ADDRESS 0xd00054c7 /end MEASUREMENT
/begin MEASUREMENT Vxx_dfctr_spg_reg_apl_down "" UWORD _CNV_A_R_A_105_CM 1 0. 0. 65535. DISPLAY_IDENTIFIER fm_sta_spg_reg_apl_down.Vxx_dfctr_xxx ECU_ADDRESS 0xd000536c /end MEASUREMENT
/begin MEASUREMENT Vxx_rdn_spg_reg_apl_down "" UWORD _CNV_A_R_A_105_CM 1 0. 0. 65535. DISPLAY_IDENTIFIER fm_sta_spg_reg_apl_down.Vxx_rdn_xxx ECU_ADDRESS 0xd000536e /end MEASUREMENT
/begin MEASUREMENT Vbx_cf_spg_reg_apl_down "" UBYTE _CNV_A_R_A_105_CM 1 0. 0. 255. DISPLAY_IDENTIFIER fm_sta_spg_reg_apl_down.fm_static_bitfield.Vbx_cf_xxx ECU_ADDRESS 0xd0005370 BIT_MASK 0x1 /end MEASUREMENT
/begin MEASUREMENT Vbx_clf_spg_reg_apl_down "" UBYTE _CNV_A_R_A_105_CM 1 0. 0. 255. DISPLAY_IDENTIFIER fm_sta_spg_reg_apl_down.fm_static_bitfield.Vbx_clf_xxx ECU_ADDRESS 0xd0005370 BIT_MASK 0x2 /end MEASUREMENT
/begin MEASUREMENT Vbx_df_old_spg_reg_apl_down "" UBYTE _CNV_A_R_A_105_CM 1 0. 0. 255. DISPLAY_IDENTIFIER fm_sta_spg_reg_apl_down.fm_static_bitfield.Vbx_df_old_xxx ECU_ADDRESS 0xd0005370 BIT_MASK 0x4 /end MEASUREMENT
/begin MEASUREMENT Vbx_dfctr_sat_spg_reg_apl_down "" UBYTE _CNV_A_R_A_105_CM 1 0. 0. 255. DISPLAY_IDENTIFIER fm_sta_spg_reg_apl_down.fm_static_bitfield.Vbx_dfctr_sat_xxx ECU_ADDRESS 0xd0005370 BIT_MASK 0x8 /end MEASUREMENT
/begin MEASUREMENT Vbx_rdn_spg_reg_apl_down "" UBYTE _CNV_A_R_A_105_CM 1 0. 0. 255. DISPLAY_IDENTIFIER fm_sta_spg_reg_apl_down.fm_static_bitfield.Vbx_rdn_xxx ECU_ADDRESS 0xd0005370 BIT_MASK 0x40 /end MEASUREMENT
/begin MEASUREMENT Vxx_dtc_stt_spg_reg_apl_down "" UBYTE _CNV_A_R_A_105_CM 1 0. 0. 255. DISPLAY_IDENTIFIER fm_sta_spg_reg_apl_down.Vxx_dtc_stt_xxx ECU_ADDRESS 0xd0005371 /end MEASUREMENT
/begin MEASUREMENT Vxx_dfctr_spg_reg_apl_up "" UWORD _CNV_A_R_A_105_CM 1 0. 0. 65535. DISPLAY_IDENTIFIER fm_sta_spg_reg_apl_up.Vxx_dfctr_xxx ECU_ADDRESS 0xd0005372 /end MEASUREMENT
/begin MEASUREMENT Vxx_rdn_spg_reg_apl_up "" UWORD _CNV_A_R_A_105_CM 1 0. 0. 65535. DISPLAY_IDENTIFIER fm_sta_spg_reg_apl_up.Vxx_rdn_xxx ECU_ADDRESS 0xd0005374 /end MEASUREMENT
/begin MEASUREMENT Vbx_cf_spg_reg_apl_up "" UBYTE _CNV_A_R_A_105_CM 1 0. 0. 255. DISPLAY_IDENTIFIER fm_sta_spg_reg_apl_up.fm_static_bitfield.Vbx_cf_xxx ECU_ADDRESS 0xd0005376 BIT_MASK 0x1 /end MEASUREMENT
/begin MEASUREMENT Vbx_clf_spg_reg_apl_up "" UBYTE _CNV_A_R_A_105_CM 1 0. 0. 255. DISPLAY_IDENTIFIER fm_sta_spg_reg_apl_up.fm_static_bitfield.Vbx_clf_xxx ECU_ADDRESS 0xd0005376 BIT_MASK 0x2 /end MEASUREMENT
/begin MEASUREMENT Vbx_df_old_spg_reg_apl_up "" UBYTE _CNV_A_R_A_105_CM 1 0. 0. 255. DISPLAY_IDENTIFIER fm_sta_spg_reg_apl_up.fm_static_bitfield.Vbx_df_old_xxx ECU_ADDRESS 0xd0005376 BIT_MASK 0x4 /end MEASUREMENT
/begin MEASUREMENT Vbx_dfctr_sat_spg_reg_apl_up "" UBYTE _CNV_A_R_A_105_CM 1 0. 0. 255. DISPLAY_IDENTIFIER fm_sta_spg_reg_apl_up.fm_static_bitfield.Vbx_dfctr_sat_xxx ECU_ADDRESS 0xd0005376 BIT_MASK 0x8 /end MEASUREMENT
/begin MEASUREMENT Vbx_rdn_spg_reg_apl_up "" UBYTE _CNV_A_R_A_105_CM 1 0. 0. 255. DISPLAY_IDENTIFIER fm_sta_spg_reg_apl_up.fm_static_bitfield.Vbx_rdn_xxx ECU_ADDRESS 0xd0005376 BIT_MASK 0x40 /end MEASUREMENT
/begin MEASUREMENT Vxx_dtc_stt_spg_reg_apl_up "" UBYTE _CNV_A_R_A_105_CM 1 0. 0. 255. DISPLAY_IDENTIFIER fm_sta_spg_reg_apl_up.Vxx_dtc_stt_xxx ECU_ADDRESS 0xd0005377 /end MEASUREMENT
/begin MEASUREMENT Vxx_dfctr_tco_cl_no_norm "" UWORD _CNV_A_R_A_105_CM 1 0. 0. 65535. DISPLAY_IDENTIFIER fm_sta_tco_cl_no_norm.Vxx_dfctr_xxx ECU_ADDRESS 0xd0005660 /end MEASUREMENT
/begin MEASUREMENT Vxx_rdn_tco_cl_no_norm "" UWORD _CNV_A_R_A_105_CM 1 0. 0. 65535. DISPLAY_IDENTIFIER fm_sta_tco_cl_no_norm.Vxx_rdn_xxx ECU_ADDRESS 0xd0005662 /end MEASUREMENT
/begin MEASUREMENT Vbx_cf_tco_cl_no_norm "" UBYTE _CNV_A_R_A_105_CM 1 0. 0. 255. DISPLAY_IDENTIFIER fm_sta_tco_cl_no_norm.fm_static_bitfield.Vbx_cf_xxx ECU_ADDRESS 0xd0005664 BIT_MASK 0x1 /end MEASUREMENT
/begin MEASUREMENT Vbx_clf_tco_cl_no_norm "" UBYTE _CNV_A_R_A_105_CM 1 0. 0. 255. DISPLAY_IDENTIFIER fm_sta_tco_cl_no_norm.fm_static_bitfield.Vbx_clf_xxx ECU_ADDRESS 0xd0005664 BIT_MASK 0x2 /end MEASUREMENT
/begin MEASUREMENT Vbx_df_old_tco_cl_no_norm "" UBYTE _CNV_A_R_A_105_CM 1 0. 0. 255. DISPLAY_IDENTIFIER fm_sta_tco_cl_no_norm.fm_static_bitfield.Vbx_df_old_xxx ECU_ADDRESS 0xd0005664 BIT_MASK 0x4 /end MEASUREMENT
/begin MEASUREMENT Vbx_dfctr_sat_tco_cl_no_norm "" UBYTE _CNV_A_R_A_105_CM 1 0. 0. 255. DISPLAY_IDENTIFIER fm_sta_tco_cl_no_norm.fm_static_bitfield.Vbx_dfctr_sat_xxx ECU_ADDRESS 0xd0005664 BIT_MASK 0x8 /end MEASUREMENT
/begin MEASUREMENT Vbx_rdn_tco_cl_no_norm "" UBYTE _CNV_A_R_A_105_CM 1 0. 0. 255. DISPLAY_IDENTIFIER fm_sta_tco_cl_no_norm.fm_static_bitfield.Vbx_rdn_xxx ECU_ADDRESS 0xd0005664 BIT_MASK 0x40 /end MEASUREMENT
/begin MEASUREMENT Vxx_dtc_stt_tco_cl_no_norm "" UBYTE _CNV_A_R_A_105_CM 1 0. 0. 255. DISPLAY_IDENTIFIER fm_sta_tco_cl_no_norm.Vxx_dtc_stt_xxx ECU_ADDRESS 0xd0005665 /end MEASUREMENT
/begin MEASUREMENT Vxx_dfctr_tlz_ad_b_cpt "" UWORD _CNV_A_R_A_105_CM 1 0. 0. 65535. DISPLAY_IDENTIFIER fm_sta_tlz_ad_b_cpt.Vxx_dfctr_xxx ECU_ADDRESS 0xd00054c8 /end MEASUREMENT
/begin MEASUREMENT Vxx_rdn_tlz_ad_b_cpt "" UWORD _CNV_A_R_A_105_CM 1 0. 0. 65535. DISPLAY_IDENTIFIER fm_sta_tlz_ad_b_cpt.Vxx_rdn_xxx ECU_ADDRESS 0xd00054ca /end MEASUREMENT
/begin MEASUREMENT Vbx_cf_tlz_ad_b_cpt "" UBYTE _CNV_A_R_A_105_CM 1 0. 0. 255. DISPLAY_IDENTIFIER fm_sta_tlz_ad_b_cpt.fm_static_bitfield.Vbx_cf_xxx ECU_ADDRESS 0xd00054cc BIT_MASK 0x1 /end MEASUREMENT
/begin MEASUREMENT Vbx_clf_tlz_ad_b_cpt "" UBYTE _CNV_A_R_A_105_CM 1 0. 0. 255. DISPLAY_IDENTIFIER fm_sta_tlz_ad_b_cpt.fm_static_bitfield.Vbx_clf_xxx ECU_ADDRESS 0xd00054cc BIT_MASK 0x2 /end MEASUREMENT
/begin MEASUREMENT Vbx_df_old_tlz_ad_b_cpt "" UBYTE _CNV_A_R_A_105_CM 1 0. 0. 255. DISPLAY_IDENTIFIER fm_sta_tlz_ad_b_cpt.fm_static_bitfield.Vbx_df_old_xxx ECU_ADDRESS 0xd00054cc BIT_MASK 0x4 /end MEASUREMENT
/begin MEASUREMENT Vbx_dfctr_sat_tlz_ad_b_cpt "" UBYTE _CNV_A_R_A_105_CM 1 0. 0. 255. DISPLAY_IDENTIFIER fm_sta_tlz_ad_b_cpt.fm_static_bitfield.Vbx_dfctr_sat_xxx ECU_ADDRESS 0xd00054cc BIT_MASK 0x8 /end MEASUREMENT
/begin MEASUREMENT Vbx_rdn_tlz_ad_b_cpt "" UBYTE _CNV_A_R_A_105_CM 1 0. 0. 255. DISPLAY_IDENTIFIER fm_sta_tlz_ad_b_cpt.fm_static_bitfield.Vbx_rdn_xxx ECU_ADDRESS 0xd00054cc BIT_MASK 0x40 /end MEASUREMENT
/begin MEASUREMENT Vxx_dtc_stt_tlz_ad_b_cpt "" UBYTE _CNV_A_R_A_105_CM 1 0. 0. 255. DISPLAY_IDENTIFIER fm_sta_tlz_ad_b_cpt.Vxx_dtc_stt_xxx ECU_ADDRESS 0xd00054cd /end MEASUREMENT
/begin MEASUREMENT Vxx_dfctr_tsta_reg_no_norm "" UWORD _CNV_A_R_A_105_CM 1 0. 0. 65535. DISPLAY_IDENTIFIER fm_sta_tsta_reg_no_norm.Vxx_dfctr_xxx ECU_ADDRESS 0xd0005666 /end MEASUREMENT
/begin MEASUREMENT Vxx_rdn_tsta_reg_no_norm "" UWORD _CNV_A_R_A_105_CM 1 0. 0. 65535. DISPLAY_IDENTIFIER fm_sta_tsta_reg_no_norm.Vxx_rdn_xxx ECU_ADDRESS 0xd0005668 /end MEASUREMENT
/begin MEASUREMENT Vbx_cf_tsta_reg_no_norm "" UBYTE _CNV_A_R_A_105_CM 1 0. 0. 255. DISPLAY_IDENTIFIER fm_sta_tsta_reg_no_norm.fm_static_bitfield.Vbx_cf_xxx ECU_ADDRESS 0xd000566a BIT_MASK 0x1 /end MEASUREMENT
/begin MEASUREMENT Vbx_clf_tsta_reg_no_norm "" UBYTE _CNV_A_R_A_105_CM 1 0. 0. 255. DISPLAY_IDENTIFIER fm_sta_tsta_reg_no_norm.fm_static_bitfield.Vbx_clf_xxx ECU_ADDRESS 0xd000566a BIT_MASK 0x2 /end MEASUREMENT
/begin MEASUREMENT Vbx_df_old_tsta_reg_no_norm "" UBYTE _CNV_A_R_A_105_CM 1 0. 0. 255. DISPLAY_IDENTIFIER fm_sta_tsta_reg_no_norm.fm_static_bitfield.Vbx_df_old_xxx ECU_ADDRESS 0xd000566a BIT_MASK 0x4 /end MEASUREMENT
/begin MEASUREMENT Vbx_dfctr_sat_tsta_reg_no_norm "" UBYTE _CNV_A_R_A_105_CM 1 0. 0. 255. DISPLAY_IDENTIFIER fm_sta_tsta_reg_no_norm.fm_static_bitfield.Vbx_dfctr_sat_xxx ECU_ADDRESS 0xd000566a BIT_MASK 0x8 /end MEASUREMENT
/begin MEASUREMENT Vbx_rdn_tsta_reg_no_norm "" UBYTE _CNV_A_R_A_105_CM 1 0. 0. 255. DISPLAY_IDENTIFIER fm_sta_tsta_reg_no_norm.fm_static_bitfield.Vbx_rdn_xxx ECU_ADDRESS 0xd000566a BIT_MASK 0x40 /end MEASUREMENT
/begin MEASUREMENT Vxx_dtc_stt_tsta_reg_no_norm "" UBYTE _CNV_A_R_A_105_CM 1 0. 0. 255. DISPLAY_IDENTIFIER fm_sta_tsta_reg_no_norm.Vxx_dtc_stt_xxx ECU_ADDRESS 0xd000566b /end MEASUREMENT
/begin MEASUREMENT Vxx_dfctr_vb_clc_chr "" UWORD _CNV_A_R_A_105_CM 1 0. 0. 65535. DISPLAY_IDENTIFIER fm_sta_vb_clc_chr.Vxx_dfctr_xxx ECU_ADDRESS 0xd000564e /end MEASUREMENT
/begin MEASUREMENT Vxx_rdn_vb_clc_chr "" UWORD _CNV_A_R_A_105_CM 1 0. 0. 65535. DISPLAY_IDENTIFIER fm_sta_vb_clc_chr.Vxx_rdn_xxx ECU_ADDRESS 0xd0005650 /end MEASUREMENT
/begin MEASUREMENT Vbx_cf_vb_clc_chr "" UBYTE _CNV_A_R_A_105_CM 1 0. 0. 255. DISPLAY_IDENTIFIER fm_sta_vb_clc_chr.fm_static_bitfield.Vbx_cf_xxx ECU_ADDRESS 0xd0005652 BIT_MASK 0x1 /end MEASUREMENT
/begin MEASUREMENT Vbx_clf_vb_clc_chr "" UBYTE _CNV_A_R_A_105_CM 1 0. 0. 255. DISPLAY_IDENTIFIER fm_sta_vb_clc_chr.fm_static_bitfield.Vbx_clf_xxx ECU_ADDRESS 0xd0005652 BIT_MASK 0x2 /end MEASUREMENT
/begin MEASUREMENT Vbx_df_old_vb_clc_chr "" UBYTE _CNV_A_R_A_105_CM 1 0. 0. 255. DISPLAY_IDENTIFIER fm_sta_vb_clc_chr.fm_static_bitfield.Vbx_df_old_xxx ECU_ADDRESS 0xd0005652 BIT_MASK 0x4 /end MEASUREMENT
/begin MEASUREMENT Vbx_dfctr_sat_vb_clc_chr "" UBYTE _CNV_A_R_A_105_CM 1 0. 0. 255. DISPLAY_IDENTIFIER fm_sta_vb_clc_chr.fm_static_bitfield.Vbx_dfctr_sat_xxx ECU_ADDRESS 0xd0005652 BIT_MASK 0x8 /end MEASUREMENT
/begin MEASUREMENT Vbx_rdn_vb_clc_chr "" UBYTE _CNV_A_R_A_105_CM 1 0. 0. 255. DISPLAY_IDENTIFIER fm_sta_vb_clc_chr.fm_static_bitfield.Vbx_rdn_xxx ECU_ADDRESS 0xd0005652 BIT_MASK 0x40 /end MEASUREMENT
/begin MEASUREMENT Vxx_dtc_stt_vb_clc_chr "" UBYTE _CNV_A_R_A_105_CM 1 0. 0. 255. DISPLAY_IDENTIFIER fm_sta_vb_clc_chr.Vxx_dtc_stt_xxx ECU_ADDRESS 0xd0005653 /end MEASUREMENT
/begin MEASUREMENT Vxx_dfctr_vb_h "" UWORD _CNV_A_R_A_105_CM 1 0. 0. 65535. DISPLAY_IDENTIFIER fm_sta_vb_h.Vxx_dfctr_xxx ECU_ADDRESS 0xd0005378 /end MEASUREMENT
/begin MEASUREMENT Vxx_rdn_vb_h "" UWORD _CNV_A_R_A_105_CM 1 0. 0. 65535. DISPLAY_IDENTIFIER fm_sta_vb_h.Vxx_rdn_xxx ECU_ADDRESS 0xd000537a /end MEASUREMENT
/begin MEASUREMENT Vbx_cf_vb_h "" UBYTE _CNV_A_R_A_105_CM 1 0. 0. 255. DISPLAY_IDENTIFIER fm_sta_vb_h.fm_static_bitfield.Vbx_cf_xxx ECU_ADDRESS 0xd000537c BIT_MASK 0x1 /end MEASUREMENT
/begin MEASUREMENT Vbx_clf_vb_h "" UBYTE _CNV_A_R_A_105_CM 1 0. 0. 255. DISPLAY_IDENTIFIER fm_sta_vb_h.fm_static_bitfield.Vbx_clf_xxx ECU_ADDRESS 0xd000537c BIT_MASK 0x2 /end MEASUREMENT
/begin MEASUREMENT Vbx_df_old_vb_h "" UBYTE _CNV_A_R_A_105_CM 1 0. 0. 255. DISPLAY_IDENTIFIER fm_sta_vb_h.fm_static_bitfield.Vbx_df_old_xxx ECU_ADDRESS 0xd000537c BIT_MASK 0x4 /end MEASUREMENT
/begin MEASUREMENT Vbx_dfctr_sat_vb_h "" UBYTE _CNV_A_R_A_105_CM 1 0. 0. 255. DISPLAY_IDENTIFIER fm_sta_vb_h.fm_static_bitfield.Vbx_dfctr_sat_xxx ECU_ADDRESS 0xd000537c BIT_MASK 0x8 /end MEASUREMENT
/begin MEASUREMENT Vbx_rdn_vb_h "" UBYTE _CNV_A_R_A_105_CM 1 0. 0. 255. DISPLAY_IDENTIFIER fm_sta_vb_h.fm_static_bitfield.Vbx_rdn_xxx ECU_ADDRESS 0xd000537c BIT_MASK 0x40 /end MEASUREMENT
/begin MEASUREMENT Vxx_dtc_stt_vb_h "" UBYTE _CNV_A_R_A_105_CM 1 0. 0. 255. DISPLAY_IDENTIFIER fm_sta_vb_h.Vxx_dtc_stt_xxx ECU_ADDRESS 0xd000537d /end MEASUREMENT
/begin MEASUREMENT Vxx_dfctr_vb_l "" UWORD _CNV_A_R_A_105_CM 1 0. 0. 65535. DISPLAY_IDENTIFIER fm_sta_vb_l.Vxx_dfctr_xxx ECU_ADDRESS 0xd000537e /end MEASUREMENT
/begin MEASUREMENT Vxx_rdn_vb_l "" UWORD _CNV_A_R_A_105_CM 1 0. 0. 65535. DISPLAY_IDENTIFIER fm_sta_vb_l.Vxx_rdn_xxx ECU_ADDRESS 0xd0005380 /end MEASUREMENT
/begin MEASUREMENT Vbx_cf_vb_l "" UBYTE _CNV_A_R_A_105_CM 1 0. 0. 255. DISPLAY_IDENTIFIER fm_sta_vb_l.fm_static_bitfield.Vbx_cf_xxx ECU_ADDRESS 0xd0005382 BIT_MASK 0x1 /end MEASUREMENT
/begin MEASUREMENT Vbx_clf_vb_l "" UBYTE _CNV_A_R_A_105_CM 1 0. 0. 255. DISPLAY_IDENTIFIER fm_sta_vb_l.fm_static_bitfield.Vbx_clf_xxx ECU_ADDRESS 0xd0005382 BIT_MASK 0x2 /end MEASUREMENT
/begin MEASUREMENT Vbx_df_old_vb_l "" UBYTE _CNV_A_R_A_105_CM 1 0. 0. 255. DISPLAY_IDENTIFIER fm_sta_vb_l.fm_static_bitfield.Vbx_df_old_xxx ECU_ADDRESS 0xd0005382 BIT_MASK 0x4 /end MEASUREMENT
/begin MEASUREMENT Vbx_dfctr_sat_vb_l "" UBYTE _CNV_A_R_A_105_CM 1 0. 0. 255. DISPLAY_IDENTIFIER fm_sta_vb_l.fm_static_bitfield.Vbx_dfctr_sat_xxx ECU_ADDRESS 0xd0005382 BIT_MASK 0x8 /end MEASUREMENT
/begin MEASUREMENT Vbx_rdn_vb_l "" UBYTE _CNV_A_R_A_105_CM 1 0. 0. 255. DISPLAY_IDENTIFIER fm_sta_vb_l.fm_static_bitfield.Vbx_rdn_xxx ECU_ADDRESS 0xd0005382 BIT_MASK 0x40 /end MEASUREMENT
/begin MEASUREMENT Vxx_dtc_stt_vb_l "" UBYTE _CNV_A_R_A_105_CM 1 0. 0. 255. DISPLAY_IDENTIFIER fm_sta_vb_l.Vxx_dtc_stt_xxx ECU_ADDRESS 0xd0005383 /end MEASUREMENT
/begin MEASUREMENT Vxx_dfctr_vb_rly_oc_scg "" UWORD _CNV_A_R_A_105_CM 1 0. 0. 65535. DISPLAY_IDENTIFIER fm_sta_vb_rly_oc_scg.Vxx_dfctr_xxx ECU_ADDRESS 0xd0005384 /end MEASUREMENT
/begin MEASUREMENT Vxx_rdn_vb_rly_oc_scg "" UWORD _CNV_A_R_A_105_CM 1 0. 0. 65535. DISPLAY_IDENTIFIER fm_sta_vb_rly_oc_scg.Vxx_rdn_xxx ECU_ADDRESS 0xd0005386 /end MEASUREMENT
/begin MEASUREMENT Vbx_cf_vb_rly_oc_scg "" UBYTE _CNV_A_R_A_105_CM 1 0. 0. 255. DISPLAY_IDENTIFIER fm_sta_vb_rly_oc_scg.fm_static_bitfield.Vbx_cf_xxx ECU_ADDRESS 0xd0005388 BIT_MASK 0x1 /end MEASUREMENT
/begin MEASUREMENT Vbx_clf_vb_rly_oc_scg "" UBYTE _CNV_A_R_A_105_CM 1 0. 0. 255. DISPLAY_IDENTIFIER fm_sta_vb_rly_oc_scg.fm_static_bitfield.Vbx_clf_xxx ECU_ADDRESS 0xd0005388 BIT_MASK 0x2 /end MEASUREMENT
/begin MEASUREMENT Vbx_df_old_vb_rly_oc_scg "" UBYTE _CNV_A_R_A_105_CM 1 0. 0. 255. DISPLAY_IDENTIFIER fm_sta_vb_rly_oc_scg.fm_static_bitfield.Vbx_df_old_xxx ECU_ADDRESS 0xd0005388 BIT_MASK 0x4 /end MEASUREMENT
/begin MEASUREMENT Vbx_dfctr_sat_vb_rly_oc_scg "" UBYTE _CNV_A_R_A_105_CM 1 0. 0. 255. DISPLAY_IDENTIFIER fm_sta_vb_rly_oc_scg.fm_static_bitfield.Vbx_dfctr_sat_xxx ECU_ADDRESS 0xd0005388 BIT_MASK 0x8 /end MEASUREMENT
/begin MEASUREMENT Vbx_rdn_vb_rly_oc_scg "" UBYTE _CNV_A_R_A_105_CM 1 0. 0. 255. DISPLAY_IDENTIFIER fm_sta_vb_rly_oc_scg.fm_static_bitfield.Vbx_rdn_xxx ECU_ADDRESS 0xd0005388 BIT_MASK 0x40 /end MEASUREMENT
/begin MEASUREMENT Vxx_dtc_stt_vb_rly_oc_scg "" UBYTE _CNV_A_R_A_105_CM 1 0. 0. 255. DISPLAY_IDENTIFIER fm_sta_vb_rly_oc_scg.Vxx_dtc_stt_xxx ECU_ADDRESS 0xd0005389 /end MEASUREMENT
/begin MEASUREMENT Vxx_dfctr_vb_rly_scw "" UWORD _CNV_A_R_A_105_CM 1 0. 0. 65535. DISPLAY_IDENTIFIER fm_sta_vb_rly_scw.Vxx_dfctr_xxx ECU_ADDRESS 0xd000538a /end MEASUREMENT
/begin MEASUREMENT Vxx_rdn_vb_rly_scw "" UWORD _CNV_A_R_A_105_CM 1 0. 0. 65535. DISPLAY_IDENTIFIER fm_sta_vb_rly_scw.Vxx_rdn_xxx ECU_ADDRESS 0xd000538c /end MEASUREMENT
/begin MEASUREMENT Vbx_cf_vb_rly_scw "" UBYTE _CNV_A_R_A_105_CM 1 0. 0. 255. DISPLAY_IDENTIFIER fm_sta_vb_rly_scw.fm_static_bitfield.Vbx_cf_xxx ECU_ADDRESS 0xd000538e BIT_MASK 0x1 /end MEASUREMENT
/begin MEASUREMENT Vbx_clf_vb_rly_scw "" UBYTE _CNV_A_R_A_105_CM 1 0. 0. 255. DISPLAY_IDENTIFIER fm_sta_vb_rly_scw.fm_static_bitfield.Vbx_clf_xxx ECU_ADDRESS 0xd000538e BIT_MASK 0x2 /end MEASUREMENT
/begin MEASUREMENT Vbx_df_old_vb_rly_scw "" UBYTE _CNV_A_R_A_105_CM 1 0. 0. 255. DISPLAY_IDENTIFIER fm_sta_vb_rly_scw.fm_static_bitfield.Vbx_df_old_xxx ECU_ADDRESS 0xd000538e BIT_MASK 0x4 /end MEASUREMENT
/begin MEASUREMENT Vbx_dfctr_sat_vb_rly_scw "" UBYTE _CNV_A_R_A_105_CM 1 0. 0. 255. DISPLAY_IDENTIFIER fm_sta_vb_rly_scw.fm_static_bitfield.Vbx_dfctr_sat_xxx ECU_ADDRESS 0xd000538e BIT_MASK 0x8 /end MEASUREMENT
/begin MEASUREMENT Vbx_rdn_vb_rly_scw "" UBYTE _CNV_A_R_A_105_CM 1 0. 0. 255. DISPLAY_IDENTIFIER fm_sta_vb_rly_scw.fm_static_bitfield.Vbx_rdn_xxx ECU_ADDRESS 0xd000538e BIT_MASK 0x40 /end MEASUREMENT
/begin MEASUREMENT Vxx_dtc_stt_vb_rly_scw "" UBYTE _CNV_A_R_A_105_CM 1 0. 0. 255. DISPLAY_IDENTIFIER fm_sta_vb_rly_scw.Vxx_dtc_stt_xxx ECU_ADDRESS 0xd000538f /end MEASUREMENT
/begin MEASUREMENT Vxx_dfctr_wgc_oc "" UWORD _CNV_A_R_A_105_CM 1 0. 0. 65535. DISPLAY_IDENTIFIER fm_sta_wgc_oc.Vxx_dfctr_xxx ECU_ADDRESS 0xd00054ce /end MEASUREMENT
/begin MEASUREMENT Vxx_rdn_wgc_oc "" UWORD _CNV_A_R_A_105_CM 1 0. 0. 65535. DISPLAY_IDENTIFIER fm_sta_wgc_oc.Vxx_rdn_xxx ECU_ADDRESS 0xd00054d0 /end MEASUREMENT
/begin MEASUREMENT Vbx_cf_wgc_oc "" UBYTE _CNV_A_R_A_105_CM 1 0. 0. 255. DISPLAY_IDENTIFIER fm_sta_wgc_oc.fm_static_bitfield.Vbx_cf_xxx ECU_ADDRESS 0xd00054d2 BIT_MASK 0x1 /end MEASUREMENT
/begin MEASUREMENT Vbx_clf_wgc_oc "" UBYTE _CNV_A_R_A_105_CM 1 0. 0. 255. DISPLAY_IDENTIFIER fm_sta_wgc_oc.fm_static_bitfield.Vbx_clf_xxx ECU_ADDRESS 0xd00054d2 BIT_MASK 0x2 /end MEASUREMENT
/begin MEASUREMENT Vbx_df_old_wgc_oc "" UBYTE _CNV_A_R_A_105_CM 1 0. 0. 255. DISPLAY_IDENTIFIER fm_sta_wgc_oc.fm_static_bitfield.Vbx_df_old_xxx ECU_ADDRESS 0xd00054d2 BIT_MASK 0x4 /end MEASUREMENT
/begin MEASUREMENT Vbx_dfctr_sat_wgc_oc "" UBYTE _CNV_A_R_A_105_CM 1 0. 0. 255. DISPLAY_IDENTIFIER fm_sta_wgc_oc.fm_static_bitfield.Vbx_dfctr_sat_xxx ECU_ADDRESS 0xd00054d2 BIT_MASK 0x8 /end MEASUREMENT
/begin MEASUREMENT Vbx_rdn_wgc_oc "" UBYTE _CNV_A_R_A_105_CM 1 0. 0. 255. DISPLAY_IDENTIFIER fm_sta_wgc_oc.fm_static_bitfield.Vbx_rdn_xxx ECU_ADDRESS 0xd00054d2 BIT_MASK 0x40 /end MEASUREMENT
/begin MEASUREMENT Vxx_dtc_stt_wgc_oc "" UBYTE _CNV_A_R_A_105_CM 1 0. 0. 255. DISPLAY_IDENTIFIER fm_sta_wgc_oc.Vxx_dtc_stt_xxx ECU_ADDRESS 0xd00054d3 /end MEASUREMENT
/begin MEASUREMENT Vxx_dfctr_wgc_scg "" UWORD _CNV_A_R_A_105_CM 1 0. 0. 65535. DISPLAY_IDENTIFIER fm_sta_wgc_scg.Vxx_dfctr_xxx ECU_ADDRESS 0xd00054d4 /end MEASUREMENT
/begin MEASUREMENT Vxx_rdn_wgc_scg "" UWORD _CNV_A_R_A_105_CM 1 0. 0. 65535. DISPLAY_IDENTIFIER fm_sta_wgc_scg.Vxx_rdn_xxx ECU_ADDRESS 0xd00054d6 /end MEASUREMENT
/begin MEASUREMENT Vbx_cf_wgc_scg "" UBYTE _CNV_A_R_A_105_CM 1 0. 0. 255. DISPLAY_IDENTIFIER fm_sta_wgc_scg.fm_static_bitfield.Vbx_cf_xxx ECU_ADDRESS 0xd00054d8 BIT_MASK 0x1 /end MEASUREMENT
/begin MEASUREMENT Vbx_clf_wgc_scg "" UBYTE _CNV_A_R_A_105_CM 1 0. 0. 255. DISPLAY_IDENTIFIER fm_sta_wgc_scg.fm_static_bitfield.Vbx_clf_xxx ECU_ADDRESS 0xd00054d8 BIT_MASK 0x2 /end MEASUREMENT
/begin MEASUREMENT Vbx_df_old_wgc_scg "" UBYTE _CNV_A_R_A_105_CM 1 0. 0. 255. DISPLAY_IDENTIFIER fm_sta_wgc_scg.fm_static_bitfield.Vbx_df_old_xxx ECU_ADDRESS 0xd00054d8 BIT_MASK 0x4 /end MEASUREMENT
/begin MEASUREMENT Vbx_dfctr_sat_wgc_scg "" UBYTE _CNV_A_R_A_105_CM 1 0. 0. 255. DISPLAY_IDENTIFIER fm_sta_wgc_scg.fm_static_bitfield.Vbx_dfctr_sat_xxx ECU_ADDRESS 0xd00054d8 BIT_MASK 0x8 /end MEASUREMENT
/begin MEASUREMENT Vbx_rdn_wgc_scg "" UBYTE _CNV_A_R_A_105_CM 1 0. 0. 255. DISPLAY_IDENTIFIER fm_sta_wgc_scg.fm_static_bitfield.Vbx_rdn_xxx ECU_ADDRESS 0xd00054d8 BIT_MASK 0x40 /end MEASUREMENT
/begin MEASUREMENT Vxx_dtc_stt_wgc_scg "" UBYTE _CNV_A_R_A_105_CM 1 0. 0. 255. DISPLAY_IDENTIFIER fm_sta_wgc_scg.Vxx_dtc_stt_xxx ECU_ADDRESS 0xd00054d9 /end MEASUREMENT
/begin MEASUREMENT Vxx_dfctr_wgc_scw "" UWORD _CNV_A_R_A_105_CM 1 0. 0. 65535. DISPLAY_IDENTIFIER fm_sta_wgc_scw.Vxx_dfctr_xxx ECU_ADDRESS 0xd00054da /end MEASUREMENT
/begin MEASUREMENT Vxx_rdn_wgc_scw "" UWORD _CNV_A_R_A_105_CM 1 0. 0. 65535. DISPLAY_IDENTIFIER fm_sta_wgc_scw.Vxx_rdn_xxx ECU_ADDRESS 0xd00054dc /end MEASUREMENT
/begin MEASUREMENT Vbx_cf_wgc_scw "" UBYTE _CNV_A_R_A_105_CM 1 0. 0. 255. DISPLAY_IDENTIFIER fm_sta_wgc_scw.fm_static_bitfield.Vbx_cf_xxx ECU_ADDRESS 0xd00054de BIT_MASK 0x1 /end MEASUREMENT
/begin MEASUREMENT Vbx_clf_wgc_scw "" UBYTE _CNV_A_R_A_105_CM 1 0. 0. 255. DISPLAY_IDENTIFIER fm_sta_wgc_scw.fm_static_bitfield.Vbx_clf_xxx ECU_ADDRESS 0xd00054de BIT_MASK 0x2 /end MEASUREMENT
/begin MEASUREMENT Vbx_df_old_wgc_scw "" UBYTE _CNV_A_R_A_105_CM 1 0. 0. 255. DISPLAY_IDENTIFIER fm_sta_wgc_scw.fm_static_bitfield.Vbx_df_old_xxx ECU_ADDRESS 0xd00054de BIT_MASK 0x4 /end MEASUREMENT
/begin MEASUREMENT Vbx_dfctr_sat_wgc_scw "" UBYTE _CNV_A_R_A_105_CM 1 0. 0. 255. DISPLAY_IDENTIFIER fm_sta_wgc_scw.fm_static_bitfield.Vbx_dfctr_sat_xxx ECU_ADDRESS 0xd00054de BIT_MASK 0x8 /end MEASUREMENT
/begin MEASUREMENT Vbx_rdn_wgc_scw "" UBYTE _CNV_A_R_A_105_CM 1 0. 0. 255. DISPLAY_IDENTIFIER fm_sta_wgc_scw.fm_static_bitfield.Vbx_rdn_xxx ECU_ADDRESS 0xd00054de BIT_MASK 0x40 /end MEASUREMENT
/begin MEASUREMENT Vxx_dtc_stt_wgc_scw "" UBYTE _CNV_A_R_A_105_CM 1 0. 0. 255. DISPLAY_IDENTIFIER fm_sta_wgc_scw.Vxx_dtc_stt_xxx ECU_ADDRESS 0xd00054df /end MEASUREMENT
/begin MEASUREMENT Vxx_dfctr_wpmp_tcr_blk "" UWORD _CNV_A_R_A_105_CM 1 0. 0. 65535. DISPLAY_IDENTIFIER fm_sta_wpmp_tcr_blk.Vxx_dfctr_xxx ECU_ADDRESS 0xd00055b2 /end MEASUREMENT
/begin MEASUREMENT Vxx_rdn_wpmp_tcr_blk "" UWORD _CNV_A_R_A_105_CM 1 0. 0. 65535. DISPLAY_IDENTIFIER fm_sta_wpmp_tcr_blk.Vxx_rdn_xxx ECU_ADDRESS 0xd00055b4 /end MEASUREMENT
/begin MEASUREMENT Vbx_cf_wpmp_tcr_blk "" UBYTE _CNV_A_R_A_105_CM 1 0. 0. 255. DISPLAY_IDENTIFIER fm_sta_wpmp_tcr_blk.fm_static_bitfield.Vbx_cf_xxx ECU_ADDRESS 0xd00055b6 BIT_MASK 0x1 /end MEASUREMENT
/begin MEASUREMENT Vbx_clf_wpmp_tcr_blk "" UBYTE _CNV_A_R_A_105_CM 1 0. 0. 255. DISPLAY_IDENTIFIER fm_sta_wpmp_tcr_blk.fm_static_bitfield.Vbx_clf_xxx ECU_ADDRESS 0xd00055b6 BIT_MASK 0x2 /end MEASUREMENT
/begin MEASUREMENT Vbx_df_old_wpmp_tcr_blk "" UBYTE _CNV_A_R_A_105_CM 1 0. 0. 255. DISPLAY_IDENTIFIER fm_sta_wpmp_tcr_blk.fm_static_bitfield.Vbx_df_old_xxx ECU_ADDRESS 0xd00055b6 BIT_MASK 0x4 /end MEASUREMENT
/begin MEASUREMENT Vbx_dfctr_sat_wpmp_tcr_blk "" UBYTE _CNV_A_R_A_105_CM 1 0. 0. 255. DISPLAY_IDENTIFIER fm_sta_wpmp_tcr_blk.fm_static_bitfield.Vbx_dfctr_sat_xxx ECU_ADDRESS 0xd00055b6 BIT_MASK 0x8 /end MEASUREMENT
/begin MEASUREMENT Vbx_rdn_wpmp_tcr_blk "" UBYTE _CNV_A_R_A_105_CM 1 0. 0. 255. DISPLAY_IDENTIFIER fm_sta_wpmp_tcr_blk.fm_static_bitfield.Vbx_rdn_xxx ECU_ADDRESS 0xd00055b6 BIT_MASK 0x40 /end MEASUREMENT
/begin MEASUREMENT Vxx_dtc_stt_wpmp_tcr_blk "" UBYTE _CNV_A_R_A_105_CM 1 0. 0. 255. DISPLAY_IDENTIFIER fm_sta_wpmp_tcr_blk.Vxx_dtc_stt_xxx ECU_ADDRESS 0xd00055b7 /end MEASUREMENT
/begin MEASUREMENT Vxx_dfctr_wpmp_tcr_oc "" UWORD _CNV_A_R_A_105_CM 1 0. 0. 65535. DISPLAY_IDENTIFIER fm_sta_wpmp_tcr_oc.Vxx_dfctr_xxx ECU_ADDRESS 0xd00054e0 /end MEASUREMENT
/begin MEASUREMENT Vxx_rdn_wpmp_tcr_oc "" UWORD _CNV_A_R_A_105_CM 1 0. 0. 65535. DISPLAY_IDENTIFIER fm_sta_wpmp_tcr_oc.Vxx_rdn_xxx ECU_ADDRESS 0xd00054e2 /end MEASUREMENT
/begin MEASUREMENT Vbx_cf_wpmp_tcr_oc "" UBYTE _CNV_A_R_A_105_CM 1 0. 0. 255. DISPLAY_IDENTIFIER fm_sta_wpmp_tcr_oc.fm_static_bitfield.Vbx_cf_xxx ECU_ADDRESS 0xd00054e4 BIT_MASK 0x1 /end MEASUREMENT
/begin MEASUREMENT Vbx_clf_wpmp_tcr_oc "" UBYTE _CNV_A_R_A_105_CM 1 0. 0. 255. DISPLAY_IDENTIFIER fm_sta_wpmp_tcr_oc.fm_static_bitfield.Vbx_clf_xxx ECU_ADDRESS 0xd00054e4 BIT_MASK 0x2 /end MEASUREMENT
/begin MEASUREMENT Vbx_df_old_wpmp_tcr_oc "" UBYTE _CNV_A_R_A_105_CM 1 0. 0. 255. DISPLAY_IDENTIFIER fm_sta_wpmp_tcr_oc.fm_static_bitfield.Vbx_df_old_xxx ECU_ADDRESS 0xd00054e4 BIT_MASK 0x4 /end MEASUREMENT
/begin MEASUREMENT Vbx_dfctr_sat_wpmp_tcr_oc "" UBYTE _CNV_A_R_A_105_CM 1 0. 0. 255. DISPLAY_IDENTIFIER fm_sta_wpmp_tcr_oc.fm_static_bitfield.Vbx_dfctr_sat_xxx ECU_ADDRESS 0xd00054e4 BIT_MASK 0x8 /end MEASUREMENT
/begin MEASUREMENT Vbx_rdn_wpmp_tcr_oc "" UBYTE _CNV_A_R_A_105_CM 1 0. 0. 255. DISPLAY_IDENTIFIER fm_sta_wpmp_tcr_oc.fm_static_bitfield.Vbx_rdn_xxx ECU_ADDRESS 0xd00054e4 BIT_MASK 0x40 /end MEASUREMENT
/begin MEASUREMENT Vxx_dtc_stt_wpmp_tcr_oc "" UBYTE _CNV_A_R_A_105_CM 1 0. 0. 255. DISPLAY_IDENTIFIER fm_sta_wpmp_tcr_oc.Vxx_dtc_stt_xxx ECU_ADDRESS 0xd00054e5 /end MEASUREMENT
/begin MEASUREMENT Vxx_dfctr_wpmp_tcr_scg "" UWORD _CNV_A_R_A_105_CM 1 0. 0. 65535. DISPLAY_IDENTIFIER fm_sta_wpmp_tcr_scg.Vxx_dfctr_xxx ECU_ADDRESS 0xd00054e6 /end MEASUREMENT
/begin MEASUREMENT Vxx_rdn_wpmp_tcr_scg "" UWORD _CNV_A_R_A_105_CM 1 0. 0. 65535. DISPLAY_IDENTIFIER fm_sta_wpmp_tcr_scg.Vxx_rdn_xxx ECU_ADDRESS 0xd00054e8 /end MEASUREMENT
/begin MEASUREMENT Vbx_cf_wpmp_tcr_scg "" UBYTE _CNV_A_R_A_105_CM 1 0. 0. 255. DISPLAY_IDENTIFIER fm_sta_wpmp_tcr_scg.fm_static_bitfield.Vbx_cf_xxx ECU_ADDRESS 0xd00054ea BIT_MASK 0x1 /end MEASUREMENT
/begin MEASUREMENT Vbx_clf_wpmp_tcr_scg "" UBYTE _CNV_A_R_A_105_CM 1 0. 0. 255. DISPLAY_IDENTIFIER fm_sta_wpmp_tcr_scg.fm_static_bitfield.Vbx_clf_xxx ECU_ADDRESS 0xd00054ea BIT_MASK 0x2 /end MEASUREMENT
/begin MEASUREMENT Vbx_df_old_wpmp_tcr_scg "" UBYTE _CNV_A_R_A_105_CM 1 0. 0. 255. DISPLAY_IDENTIFIER fm_sta_wpmp_tcr_scg.fm_static_bitfield.Vbx_df_old_xxx ECU_ADDRESS 0xd00054ea BIT_MASK 0x4 /end MEASUREMENT
/begin MEASUREMENT Vbx_dfctr_sat_wpmp_tcr_scg "" UBYTE _CNV_A_R_A_105_CM 1 0. 0. 255. DISPLAY_IDENTIFIER fm_sta_wpmp_tcr_scg.fm_static_bitfield.Vbx_dfctr_sat_xxx ECU_ADDRESS 0xd00054ea BIT_MASK 0x8 /end MEASUREMENT
/begin MEASUREMENT Vbx_rdn_wpmp_tcr_scg "" UBYTE _CNV_A_R_A_105_CM 1 0. 0. 255. DISPLAY_IDENTIFIER fm_sta_wpmp_tcr_scg.fm_static_bitfield.Vbx_rdn_xxx ECU_ADDRESS 0xd00054ea BIT_MASK 0x40 /end MEASUREMENT
/begin MEASUREMENT Vxx_dtc_stt_wpmp_tcr_scg "" UBYTE _CNV_A_R_A_105_CM 1 0. 0. 255. DISPLAY_IDENTIFIER fm_sta_wpmp_tcr_scg.Vxx_dtc_stt_xxx ECU_ADDRESS 0xd00054eb /end MEASUREMENT
/begin MEASUREMENT Vxx_dfctr_wpmp_tcr_scw "" UWORD _CNV_A_R_A_105_CM 1 0. 0. 65535. DISPLAY_IDENTIFIER fm_sta_wpmp_tcr_scw.Vxx_dfctr_xxx ECU_ADDRESS 0xd00054ec /end MEASUREMENT
/begin MEASUREMENT Vxx_rdn_wpmp_tcr_scw "" UWORD _CNV_A_R_A_105_CM 1 0. 0. 65535. DISPLAY_IDENTIFIER fm_sta_wpmp_tcr_scw.Vxx_rdn_xxx ECU_ADDRESS 0xd00054ee /end MEASUREMENT
/begin MEASUREMENT Vbx_cf_wpmp_tcr_scw "" UBYTE _CNV_A_R_A_105_CM 1 0. 0. 255. DISPLAY_IDENTIFIER fm_sta_wpmp_tcr_scw.fm_static_bitfield.Vbx_cf_xxx ECU_ADDRESS 0xd00054f0 BIT_MASK 0x1 /end MEASUREMENT
/begin MEASUREMENT Vbx_clf_wpmp_tcr_scw "" UBYTE _CNV_A_R_A_105_CM 1 0. 0. 255. DISPLAY_IDENTIFIER fm_sta_wpmp_tcr_scw.fm_static_bitfield.Vbx_clf_xxx ECU_ADDRESS 0xd00054f0 BIT_MASK 0x2 /end MEASUREMENT
/begin MEASUREMENT Vbx_df_old_wpmp_tcr_scw "" UBYTE _CNV_A_R_A_105_CM 1 0. 0. 255. DISPLAY_IDENTIFIER fm_sta_wpmp_tcr_scw.fm_static_bitfield.Vbx_df_old_xxx ECU_ADDRESS 0xd00054f0 BIT_MASK 0x4 /end MEASUREMENT
/begin MEASUREMENT Vbx_dfctr_sat_wpmp_tcr_scw "" UBYTE _CNV_A_R_A_105_CM 1 0. 0. 255. DISPLAY_IDENTIFIER fm_sta_wpmp_tcr_scw.fm_static_bitfield.Vbx_dfctr_sat_xxx ECU_ADDRESS 0xd00054f0 BIT_MASK 0x8 /end MEASUREMENT
/begin MEASUREMENT Vbx_rdn_wpmp_tcr_scw "" UBYTE _CNV_A_R_A_105_CM 1 0. 0. 255. DISPLAY_IDENTIFIER fm_sta_wpmp_tcr_scw.fm_static_bitfield.Vbx_rdn_xxx ECU_ADDRESS 0xd00054f0 BIT_MASK 0x40 /end MEASUREMENT
/begin MEASUREMENT Vxx_dtc_stt_wpmp_tcr_scw "" UBYTE _CNV_A_R_A_105_CM 1 0. 0. 255. DISPLAY_IDENTIFIER fm_sta_wpmp_tcr_scw.Vxx_dtc_stt_xxx ECU_ADDRESS 0xd00054f1 /end MEASUREMENT
/begin COMPU_METHOD _CNV_A_R_A_105_CM "" RAT_FUNC "%6.3" "" COEFFS 0 1. 0. 0 0 1 /end COMPU_METHOD
/begin RECORD_LAYOUT _REC_S1VAL_20_u2 FNC_VALUES 1 UWORD COLUMN_DIR DIRECT /end RECORD_LAYOUT
/begin FUNCTION DgDftCfg ""
 /begin DEF_CHARACTERISTIC Ctx_ffm_did_ac_prs[0] Ctx_ffm_did_ac_prs[1] Ctx_ffm_did_ac_prs[2] Ctx_ffm_did_ac_prs[3] Ctx_ffm_did_ac_prs[4] Cxx_dtc_hmb_ac_prs Ctx_ffm_did_acel_pdl[0] Ctx_ffm_did_acel_pdl[1] Ctx_ffm_did_acel_pdl[2] Ctx_ffm_did_acel_pdl[3] Ctx_ffm_did_acel_pdl[4] Cxx_dtc_hmb_acel_pdl Ctx_ffm_did_acel_pdl_v1[0] Ctx_ffm_did_acel_pdl_v1[1] Ctx_ffm_did_acel_pdl_v1[2] Ctx_ffm_did_acel_pdl_v1[3] Ctx_ffm_did_acel_pdl_v1[4] Cxx_dtc_hmb_acel_pdl_v1 Ctx_ffm_did_acel_pdl_v2[0] Ctx_ffm_did_acel_pdl_v2[1] Ctx_ffm_did_acel_pdl_v2[2] Ctx_ffm_did_acel_pdl_v2[3] Ctx_ffm_did_acel_pdl_v2[4] Cxx_dtc_hmb_acel_pdl_v2 Ctx_ffm_did_actr_rly[0] Ctx_ffm_did_actr_rly[1] Ctx_ffm_did_actr_rly[2] Ctx_ffm_did_actr_rly[3] Ctx_ffm_did_actr_rly[4] Cxx_dtc_hmb_actr_rly Ctx_ffm_did_agb[0] Ctx_ffm_did_agb[1] Ctx_ffm_did_agb[2] Ctx_ffm_did_agb[3] Ctx_ffm_did_agb[4] Cxx_dtc_hmb_agb Ctx_ffm_did_agb_data[0] Ctx_ffm_did_agb_data[1] Ctx_ffm_did_agb_data[2] Ctx_ffm_did_agb_data[3] Ctx_ffm_did_agb_data[4] Cxx_dtc_hmb_agb_data Ctx_ffm_did_bgin_clu[0] Ctx_ffm_did_bgin_clu[1] Ctx_ffm_did_bgin_clu[2] Ctx_ffm_did_bgin_clu[3] Ctx_ffm_did_bgin_clu[4] Cxx_dtc_hmb_bgin_clu Ctx_ffm_did_brk_pdl[0] Ctx_ffm_did_brk_pdl[1] Ctx_ffm_did_brk_pdl[2] Ctx_ffm_did_brk_pdl[3] Ctx_ffm_did_brk_pdl[4] Cxx_dtc_hmb_brk_pdl Ctx_ffm_did_cata[0] Ctx_ffm_did_cata[1] Ctx_ffm_did_cata[2] Ctx_ffm_did_cata[3] Ctx_ffm_did_cata[4] Cxx_dtc_hmb_cata Ctx_ffm_did_cl_rich[0] Ctx_ffm_did_cl_rich[1] Ctx_ffm_did_cl_rich[2] Ctx_ffm_did_cl_rich[3] Ctx_ffm_did_cl_rich[4] Cxx_dtc_hmb_cl_rich Ctx_ffm_did_clu_cnt[0] Ctx_ffm_did_clu_cnt[1] Ctx_ffm_did_clu_cnt[2] Ctx_ffm_did_clu_cnt[3] Ctx_ffm_did_clu_cnt[4] Cxx_dtc_hmb_clu_cnt Ctx_ffm_did_cp[0] Ctx_ffm_did_cp[1] Ctx_ffm_did_cp[2] Ctx_ffm_did_cp[3] Ctx_ffm_did_cp[4] Cxx_dtc_hmb_cp Ctx_ffm_did_crk[0] Ctx_ffm_did_crk[1] Ctx_ffm_did_crk[2] Ctx_ffm_did_crk[3] /end DEF_CHARACTERISTIC
 /begin OUT_MEASUREMENT Vbx_clf_inj_ecu_lbup_icp Vbx_df_old_inj_ecu_lbup_icp Vbx_dfctr_sat_inj_ecu_lbup_icp Vbx_rdn_inj_ecu_lbup_icp Vxx_dtc_stt_inj_ecu_lbup_icp Vxx_dfctr_ip_lght_tco_ovh Vxx_rdn_ip_lght_tco_ovh Vbx_cf_ip_lght_tco_ovh Vbx_clf_ip_lght_tco_ovh Vbx_df_old_ip_lght_tco_ovh Vbx_dfctr_sat_ip_lght_tco_ovh Vbx_rdn_ip_lght_tco_ovh Vxx_dtc_stt_ip_lght_tco_ovh Vxx_dfctr_isr_h_lvl Vxx_rdn_isr_h_lvl Vbx_cf_isr_h_lvl Vbx_clf_isr_h_lvl Vbx_df_old_isr_h_lvl Vbx_dfctr_sat_isr_h_lvl Vbx_rdn_isr_h_lvl Vxx_dtc_stt_isr_h_lvl Vxx_dfctr_isr_l_lvl Vxx_rdn_isr_l_lvl Vbx_cf_isr_l_lvl Vbx_clf_isr_l_lvl Vbx_df_old_isr_l_lvl Vbx_dfctr_sat_isr_l_lvl Vbx_rdn_isr_l_lvl Vxx_dtc_stt_isr_l_lvl Vxx_dfctr_it_cmd_el Vxx_rdn_it_cmd_el Vbx_cf_it_cmd_el Vbx_clf_it_cmd_el Vbx_df_old_it_cmd_el Vbx_dfctr_sat_it_cmd_el Vbx_rdn_it_cmd_el Vxx_dtc_stt_it_cmd_el Vxx_dfctr_it_ofs_meca Vxx_rdn_it_ofs_meca Vbx_cf_it_ofs_meca Vbx_clf_it_ofs_meca Vbx_df_old_it_ofs_meca Vbx_dfctr_sat_it_ofs_meca Vbx_rdn_it_ofs_meca Vxx_dtc_stt_it_ofs_meca Vxx_dfctr_it_ofs_no_norm Vxx_rdn_it_ofs_no_norm Vbx_cf_it_ofs_no_norm Vbx_clf_it_ofs_no_norm Vbx_df_old_it_ofs_no_norm Vbx_dfctr_sat_it_ofs_no_norm Vbx_rdn_it_ofs_no_norm Vxx_dtc_stt_it_ofs_no_norm Vxx_dfctr_it_ofs_secu_nok Vxx_rdn_it_ofs_secu_nok Vbx_cf_it_ofs_secu_nok Vbx_clf_it_ofs_secu_nok Vbx_df_old_it_ofs_secu_nok Vbx_dfctr_sat_it_ofs_secu_nok Vbx_rdn_it_ofs_secu_nok Vxx_dtc_stt_it_ofs_secu_nok Vxx_dfctr_it_reg_blk Vxx_rdn_it_reg_blk Vbx_cf_it_reg_blk Vbx_clf_it_reg_blk Vbx_df_old_it_reg_blk Vbx_dfctr_sat_it_reg_blk Vbx_rdn_it_reg_blk Vxx_dtc_stt_it_reg_blk Vxx_dfctr_knk_oor Vxx_rdn_knk_oor Vbx_cf_knk_oor Vbx_clf_knk_oor Vbx_df_old_knk_oor Vbx_dfctr_sat_knk_oor Vbx_rdn_knk_oor Vxx_dtc_stt_knk_oor Vxx_dfctr_knk_shp Vxx_rdn_knk_shp Vbx_cf_knk_shp Vbx_clf_knk_shp Vbx_df_old_knk_shp Vbx_dfctr_sat_knk_shp Vbx_rdn_knk_shp Vxx_dtc_stt_knk_shp Vxx_dfctr_lbdw_hot_dirt_lkg Vxx_rdn_lbdw_hot_dirt_lkg Vbx_cf_lbdw_hot_dirt_lkg Vbx_clf_lbdw_hot_dirt_lkg Vbx_df_old_lbdw_hot_dirt_lkg Vbx_dfctr_sat_lbdw_hot_dirt_lkg Vbx_rdn_lbdw_hot_dirt_lkg Vxx_dtc_stt_lbdw_hot_dirt_lkg Vxx_dfctr_lbdw_hot_oc Vxx_rdn_lbdw_hot_oc Vbx_cf_lbdw_hot_oc Vbx_clf_lbdw_hot_oc Vbx_df_old_lbdw_hot_oc Vbx_dfctr_sat_lbdw_hot_oc Vbx_rdn_lbdw_hot_oc Vxx_dtc_stt_lbdw_hot_oc Vxx_dfctr_lbdw_hot_scg Vxx_rdn_lbdw_hot_scg Vbx_cf_lbdw_hot_scg Vbx_clf_lbdw_hot_scg Vbx_df_old_lbdw_hot_scg Vbx_dfctr_sat_lbdw_hot_scg Vbx_rdn_lbdw_hot_scg Vxx_dtc_stt_lbdw_hot_scg Vxx_dfctr_lbdw_hot_scw Vxx_rdn_lbdw_hot_scw Vbx_cf_lbdw_hot_scw Vbx_clf_lbdw_hot_scw Vbx_df_old_lbdw_hot_scw Vbx_dfctr_sat_lbdw_hot_scw Vbx_rdn_lbdw_hot_scw Vxx_dtc_stt_lbdw_hot_scw Vxx_dfctr_lbdw_oc Vxx_rdn_lbdw_oc Vbx_cf_lbdw_oc Vbx_clf_lbdw_oc Vbx_df_old_lbdw_oc Vbx_dfctr_sat_lbdw_oc Vbx_rdn_lbdw_oc Vxx_dtc_stt_lbdw_oc Vxx_dfctr_lbdw_scg Vxx_rdn_lbdw_scg Vbx_cf_lbdw_scg Vbx_clf_lbdw_scg Vbx_df_old_lbdw_scg Vbx_dfctr_sat_lbdw_scg Vbx_rdn_lbdw_scg Vxx_dtc_stt_lbdw_scg Vxx_dfctr_lbdw_scw Vxx_rdn_lbdw_scw Vbx_cf_lbdw_scw Vbx_clf_lbdw_scw Vbx_df_old_lbdw_scw Vbx_dfctr_sat_lbdw_scw Vbx_rdn_lbdw_scw Vxx_dtc_stt_lbdw_scw Vxx_dfctr_lbup_cpt Vxx_rdn_lbup_cpt Vbx_cf_lbup_cpt Vbx_clf_lbup_cpt Vbx_df_old_lbup_cpt Vbx_dfctr_sat_lbup_cpt Vbx_rdn_lbup_cpt Vxx_dtc_stt_lbup_cpt Vxx_dfctr_lbup_hot_apl_down Vxx_rdn_lbup_hot_apl_down Vbx_cf_lbup_hot_apl_down Vbx_clf_lbup_hot_apl_down Vbx_df_old_lbup_hot_apl_down Vbx_dfctr_sat_lbup_hot_apl_down Vbx_rdn_lbup_hot_apl_down Vxx_dtc_stt_lbup_hot_apl_down Vxx_dfctr_lbup_hot_dirt_lkg Vxx_rdn_lbup_hot_dirt_lkg Vbx_cf_lbup_hot_dirt_lkg Vbx_clf_lbup_hot_dirt_lkg Vbx_df_old_lbup_hot_dirt_lkg Vbx_dfctr_sat_lbup_hot_dirt_lkg Vbx_rdn_lbup_hot_dirt_lkg Vxx_dtc_stt_lbup_hot_dirt_lkg Vxx_dfctr_lbup_hot_oc Vxx_rdn_lbup_hot_oc Vbx_cf_lbup_hot_oc Vbx_clf_lbup_hot_oc Vbx_df_old_lbup_hot_oc Vbx_dfctr_sat_lbup_hot_oc Vbx_rdn_lbup_hot_oc Vxx_dtc_stt_lbup_hot_oc Vxx_dfctr_lbup_hot_scg Vxx_rdn_lbup_hot_scg Vbx_cf_lbup_hot_scg Vbx_clf_lbup_hot_scg Vbx_df_old_lbup_hot_scg Vbx_dfctr_sat_lbup_hot_scg Vbx_rdn_lbup_hot_scg Vxx_dtc_stt_lbup_hot_scg Vxx_dfctr_lbup_hot_scw Vxx_rdn_lbup_hot_scw Vbx_cf_lbup_hot_scw Vbx_clf_lbup_hot_scw Vbx_df_old_lbup_hot_scw Vbx_dfctr_sat_lbup_hot_scw Vbx_rdn_lbup_hot_scw Vxx_dtc_stt_lbup_hot_scw Vxx_dfctr_lbup_nok Vxx_rdn_lbup_nok Vbx_cf_lbup_nok Vbx_clf_lbup_nok Vbx_df_old_lbup_nok Vbx_dfctr_sat_lbup_nok Vbx_rdn_lbup_nok Vxx_dtc_stt_lbup_nok Vxx_dfctr_lbup_oc Vxx_rdn_lbup_oc Vbx_cf_lbup_oc Vbx_clf_lbup_oc Vbx_df_old_lbup_oc Vbx_dfctr_sat_lbup_oc Vbx_rdn_lbup_oc Vxx_dtc_stt_lbup_oc Vxx_dfctr_lbup_scg Vxx_rdn_lbup_scg Vbx_cf_lbup_scg Vbx_clf_lbup_scg Vbx_df_old_lbup_scg Vbx_dfctr_sat_lbup_scg Vbx_rdn_lbup_scg Vxx_dtc_stt_lbup_scg Vxx_dfctr_lbup_scw Vxx_rdn_lbup_scw Vbx_cf_lbup_scw Vbx_clf_lbup_scw Vbx_df_old_lbup_scw Vbx_dfctr_sat_lbup_scw Vbx_rdn_lbup_scw Vxx_dtc_stt_lbup_scw Vxx_dfctr_lbup_shf_h Vxx_rdn_lbup_shf_h Vbx_cf_lbup_shf_h Vbx_clf_lbup_shf_h Vbx_df_old_lbup_shf_h Vbx_dfctr_sat_lbup_shf_h Vbx_rdn_lbup_shf_h Vxx_dtc_stt_lbup_shf_h Vxx_dfctr_lbup_shf_l Vxx_rdn_lbup_shf_l Vbx_cf_lbup_shf_l Vbx_clf_lbup_shf_l Vbx_df_old_lbup_shf_l Vbx_dfctr_sat_lbup_shf_l Vbx_rdn_lbup_shf_l Vxx_dtc_stt_lbup_shf_l Vxx_dfctr_map_chr Vxx_rdn_map_chr Vbx_cf_map_chr Vbx_clf_map_chr Vbx_df_old_map_chr Vbx_dfctr_sat_map_chr Vbx_rdn_map_chr Vxx_dtc_stt_map_chr Vxx_dfctr_map_oor Vxx_rdn_map_oor Vbx_cf_map_oor Vbx_clf_map_oor Vbx_df_old_map_oor Vbx_dfctr_sat_map_oor Vbx_rdn_map_oor Vxx_dtc_stt_map_oor Vxx_dfctr_mis_1_cata Vxx_rdn_mis_1_cata Vbx_cf_mis_1_cata Vbx_clf_mis_1_cata Vbx_df_old_mis_1_cata Vbx_dfctr_sat_mis_1_cata Vbx_rdn_mis_1_cata Vxx_dtc_stt_mis_1_cata Vxx_dfctr_mis_1_lpg_cata Vxx_rdn_mis_1_lpg_cata Vbx_cf_mis_1_lpg_cata Vbx_clf_mis_1_lpg_cata Vbx_df_old_mis_1_lpg_cata Vbx_dfctr_sat_mis_1_lpg_cata Vbx_rdn_mis_1_lpg_cata Vxx_dtc_stt_mis_1_lpg_cata Vxx_dfctr_mis_1_lpg_trs_h Vxx_rdn_mis_1_lpg_trs_h Vbx_cf_mis_1_lpg_trs_h Vbx_clf_mis_1_lpg_trs_h Vbx_df_old_mis_1_lpg_trs_h Vbx_dfctr_sat_mis_1_lpg_trs_h Vbx_rdn_mis_1_lpg_trs_h Vxx_dtc_stt_mis_1_lpg_trs_h Vxx_dfctr_mis_1_trs_h Vxx_rdn_mis_1_trs_h Vbx_cf_mis_1_trs_h Vbx_clf_mis_1_trs_h Vbx_df_old_mis_1_trs_h Vbx_dfctr_sat_mis_1_trs_h Vbx_rdn_mis_1_trs_h Vxx_dtc_stt_mis_1_trs_h Vxx_dfctr_mis_2_cata Vxx_rdn_mis_2_cata Vbx_cf_mis_2_cata Vbx_clf_mis_2_cata Vbx_df_old_mis_2_cata Vbx_dfctr_sat_mis_2_cata Vbx_rdn_mis_2_cata Vxx_dtc_stt_mis_2_cata Vxx_dfctr_mis_2_lpg_cata Vxx_rdn_mis_2_lpg_cata Vbx_cf_mis_2_lpg_cata Vbx_clf_mis_2_lpg_cata Vbx_df_old_mis_2_lpg_cata Vbx_dfctr_sat_mis_2_lpg_cata Vbx_rdn_mis_2_lpg_cata Vxx_dtc_stt_mis_2_lpg_cata Vxx_dfctr_mis_2_lpg_trs_h Vxx_rdn_mis_2_lpg_trs_h Vbx_cf_mis_2_lpg_trs_h Vbx_clf_mis_2_lpg_trs_h Vbx_df_old_mis_2_lpg_trs_h Vbx_dfctr_sat_mis_2_lpg_trs_h Vbx_rdn_mis_2_lpg_trs_h Vxx_dtc_stt_mis_2_lpg_trs_h Vxx_dfctr_mis_2_trs_h Vxx_rdn_mis_2_trs_h Vbx_cf_mis_2_trs_h Vbx_clf_mis_2_trs_h Vbx_df_old_mis_2_trs_h Vbx_dfctr_sat_mis_2_trs_h Vbx_rdn_mis_2_trs_h Vxx_dtc_stt_mis_2_trs_h Vxx_dfctr_mis_3_cata Vxx_rdn_mis_3_cata Vbx_cf_mis_3_cata Vbx_clf_mis_3_cata Vbx_df_old_mis_3_cata Vbx_dfctr_sat_mis_3_cata Vbx_rdn_mis_3_cata Vxx_dtc_stt_mis_3_cata Vxx_dfctr_mis_3_lpg_cata Vxx_rdn_mis_3_lpg_cata Vbx_cf_mis_3_lpg_cata Vbx_clf_mis_3_lpg_cata Vbx_df_old_mis_3_lpg_cata Vbx_dfctr_sat_mis_3_lpg_cata Vbx_rdn_mis_3_lpg_cata Vxx_dtc_stt_mis_3_lpg_cata Vxx_dfctr_mis_3_lpg_trs_h Vxx_rdn_mis_3_lpg_trs_h Vbx_cf_mis_3_lpg_trs_h Vbx_clf_mis_3_lpg_trs_h Vbx_df_old_mis_3_lpg_trs_h Vbx_dfctr_sat_mis_3_lpg_trs_h Vbx_rdn_mis_3_lpg_trs_h Vxx_dtc_stt_mis_3_lpg_trs_h Vxx_dfctr_mis_3_trs_h Vxx_rdn_mis_3_trs_h Vbx_cf_mis_3_trs_h Vbx_clf_mis_3_trs_h Vbx_df_old_mis_3_trs_h Vbx_dfctr_sat_mis_3_trs_h Vbx_rdn_mis_3_trs_h Vxx_dtc_stt_mis_3_trs_h Vxx_dfctr_mis_4_cata Vxx_rdn_mis_4_cata Vbx_cf_mis_4_cata Vbx_clf_mis_4_cata Vbx_df_old_mis_4_cata Vbx_dfctr_sat_mis_4_cata Vbx_rdn_mis_4_cata Vxx_dtc_stt_mis_4_cata Vxx_dfctr_mis_4_lpg_cata Vxx_rdn_mis_4_lpg_cata Vbx_cf_mis_4_lpg_cata Vbx_clf_mis_4_lpg_cata Vbx_df_old_mis_4_lpg_cata Vbx_dfctr_sat_mis_4_lpg_cata Vbx_rdn_mis_4_lpg_cata Vxx_dtc_stt_mis_4_lpg_cata Vxx_dfctr_mis_4_lpg_trs_h Vxx_rdn_mis_4_lpg_trs_h Vbx_cf_mis_4_lpg_trs_h Vbx_clf_mis_4_lpg_trs_h Vbx_df_old_mis_4_lpg_trs_h Vbx_dfctr_sat_mis_4_lpg_trs_h Vbx_rdn_mis_4_lpg_trs_h Vxx_dtc_stt_mis_4_lpg_trs_h Vxx_dfctr_mis_4_trs_h Vxx_rdn_mis_4_trs_h Vbx_cf_mis_4_trs_h Vbx_clf_mis_4_trs_h Vbx_df_old_mis_4_trs_h Vbx_dfctr_sat_mis_4_trs_h Vbx_rdn_mis_4_trs_h Vxx_dtc_stt_mis_4_trs_h Vxx_dfctr_mis_cata Vxx_rdn_mis_cata Vbx_cf_mis_cata Vbx_clf_mis_cata Vbx_df_old_mis_cata Vbx_dfctr_sat_mis_cata Vbx_rdn_mis_cata Vxx_dtc_stt_mis_cata Vxx_dfctr_mis_lpg_cata Vxx_rdn_mis_lpg_cata Vbx_cf_mis_lpg_cata Vbx_clf_mis_lpg_cata Vbx_df_old_mis_lpg_cata Vbx_dfctr_sat_mis_lpg_cata Vbx_rdn_mis_lpg_cata Vxx_dtc_stt_mis_lpg_cata Vxx_dfctr_mis_lpg_trs_h Vxx_rdn_mis_lpg_trs_h Vbx_cf_mis_lpg_trs_h Vbx_clf_mis_lpg_trs_h Vbx_df_old_mis_lpg_trs_h Vbx_dfctr_sat_mis_lpg_trs_h Vbx_rdn_mis_lpg_trs_h Vxx_dtc_stt_mis_lpg_trs_h Vxx_dfctr_mis_min_fuel_cata Vxx_rdn_mis_min_fuel_cata Vbx_cf_mis_min_fuel_cata Vbx_clf_mis_min_fuel_cata Vbx_df_old_mis_min_fuel_cata Vbx_dfctr_sat_mis_min_fuel_cata Vbx_rdn_mis_min_fuel_cata Vxx_dtc_stt_mis_min_fuel_cata Vxx_dfctr_mis_min_fuel_trs_h Vxx_rdn_mis_min_fuel_trs_h Vbx_cf_mis_min_fuel_trs_h Vbx_clf_mis_min_fuel_trs_h Vbx_df_old_mis_min_fuel_trs_h Vbx_dfctr_sat_mis_min_fuel_trs_h Vbx_rdn_mis_min_fuel_trs_h Vxx_dtc_stt_mis_min_fuel_trs_h Vxx_dfctr_mis_trs_h Vxx_rdn_mis_trs_h Vbx_cf_mis_trs_h Vbx_clf_mis_trs_h Vbx_df_old_mis_trs_h Vbx_dfctr_sat_mis_trs_h Vbx_rdn_mis_trs_h Vxx_dtc_stt_mis_trs_h Vxx_dfctr_mis_unk_cata Vxx_rdn_mis_unk_cata Vbx_cf_mis_unk_cata Vbx_clf_mis_unk_cata Vbx_df_old_mis_unk_cata Vbx_dfctr_sat_mis_unk_cata Vbx_rdn_mis_unk_cata Vxx_dtc_stt_mis_unk_cata Vxx_dfctr_mis_unk_lpg_cata Vxx_rdn_mis_unk_lpg_cata Vbx_cf_mis_unk_lpg_cata Vbx_clf_mis_unk_lpg_cata Vbx_df_old_mis_unk_lpg_cata Vbx_dfctr_sat_mis_unk_lpg_cata Vbx_rdn_mis_unk_lpg_cata Vxx_dtc_stt_mis_unk_lpg_cata Vxx_dfctr_mis_unk_lpg_trs_h Vxx_rdn_mis_unk_lpg_trs_h Vbx_cf_mis_unk_lpg_trs_h Vbx_clf_mis_unk_lpg_trs_h Vbx_df_old_mis_unk_lpg_trs_h Vbx_dfctr_sat_mis_unk_lpg_trs_h Vbx_rdn_mis_unk_lpg_trs_h Vxx_dtc_stt_mis_unk_lpg_trs_h Vxx_dfctr_mis_unk_trs_h Vxx_rdn_mis_unk_trs_h Vbx_cf_mis_unk_trs_h Vbx_clf_mis_unk_trs_h Vbx_df_old_mis_unk_trs_h Vbx_dfctr_sat_mis_unk_trs_h Vbx_rdn_mis_unk_trs_h Vxx_dtc_stt_mis_unk_trs_h Vxx_dfctr_ptc_rov_oc Vxx_rdn_ptc_rov_oc Vbx_cf_ptc_rov_oc Vbx_clf_ptc_rov_oc Vbx_df_old_ptc_rov_oc Vbx_dfctr_sat_ptc_rov_oc Vbx_rdn_ptc_rov_oc Vxx_dtc_stt_ptc_rov_oc Vxx_dfctr_ptc_rov_scg Vxx_rdn_ptc_rov_scg Vbx_cf_ptc_rov_scg Vbx_clf_ptc_rov_scg Vbx_df_old_ptc_rov_scg Vbx_dfctr_sat_ptc_rov_scg Vbx_rdn_ptc_rov_scg Vxx_dtc_stt_ptc_rov_scg Vxx_dfctr_ptc_rov_scw Vxx_rdn_ptc_rov_scw Vbx_cf_ptc_rov_scw Vbx_clf_ptc_rov_scw Vbx_df_old_ptc_rov_scw Vbx_dfctr_sat_ptc_rov_scw Vbx_rdn_ptc_rov_scw Vxx_dtc_stt_ptc_rov_scw Vxx_dfctr_pws_1_h Vxx_rdn_pws_1_h Vbx_cf_pws_1_h Vbx_clf_pws_1_h Vbx_df_old_pws_1_h Vbx_dfctr_sat_pws_1_h Vbx_rdn_pws_1_h Vxx_dtc_stt_pws_1_h Vxx_dfctr_pws_1_l Vxx_rdn_pws_1_l Vbx_cf_pws_1_l Vbx_clf_pws_1_l Vbx_df_old_pws_1_l Vbx_dfctr_sat_pws_1_l Vbx_rdn_pws_1_l Vxx_dtc_stt_pws_1_l Vxx_dfctr_pws_2_h Vxx_rdn_pws_2_h Vbx_cf_pws_2_h Vbx_clf_pws_2_h Vbx_df_old_pws_2_h Vbx_dfctr_sat_pws_2_h Vbx_rdn_pws_2_h Vxx_dtc_stt_pws_2_h Vxx_dfctr_pws_2_l Vxx_rdn_pws_2_l Vbx_cf_pws_2_l Vbx_clf_pws_2_l Vbx_df_old_pws_2_l Vbx_dfctr_sat_pws_2_l Vbx_rdn_pws_2_l Vxx_dtc_stt_pws_2_l Vxx_dfctr_pws_3_h Vxx_rdn_pws_3_h Vbx_cf_pws_3_h Vbx_clf_pws_3_h Vbx_df_old_pws_3_h Vbx_dfctr_sat_pws_3_h Vbx_rdn_pws_3_h Vxx_dtc_stt_pws_3_h Vxx_dfctr_pws_3_l Vxx_rdn_pws_3_l Vbx_cf_pws_3_l Vbx_clf_pws_3_l Vbx_df_old_pws_3_l Vbx_dfctr_sat_pws_3_l Vbx_rdn_pws_3_l Vxx_dtc_stt_pws_3_l Vxx_dfctr_sens_it_1_nok Vxx_rdn_sens_it_1_nok Vbx_cf_sens_it_1_nok Vbx_clf_sens_it_1_nok Vbx_df_old_sens_it_1_nok Vbx_dfctr_sat_sens_it_1_nok Vbx_rdn_sens_it_1_nok Vxx_dtc_stt_sens_it_1_nok Vxx_dfctr_sens_it_2_nok Vxx_rdn_sens_it_2_nok Vbx_cf_sens_it_2_nok Vbx_clf_sens_it_2_nok Vbx_df_old_sens_it_2_nok Vbx_dfctr_sat_sens_it_2_nok Vbx_rdn_sens_it_2_nok Vxx_dtc_stt_sens_it_2_nok Vxx_dfctr_sens_it_chr Vxx_rdn_sens_it_chr Vbx_cf_sens_it_chr Vbx_clf_sens_it_chr Vbx_df_old_sens_it_chr Vbx_dfctr_sat_sens_it_chr Vbx_rdn_sens_it_chr Vxx_dtc_stt_sens_it_chr Vxx_dfctr_sens_it_sig_mcut Vxx_rdn_sens_it_sig_mcut Vbx_cf_sens_it_sig_mcut Vbx_clf_sens_it_sig_mcut Vbx_df_old_sens_it_sig_mcut Vbx_dfctr_sat_sens_it_sig_mcut Vbx_rdn_sens_it_sig_mcut Vxx_dtc_stt_sens_it_sig_mcut Vxx_dfctr_sens_map_h Vxx_rdn_sens_map_h Vbx_cf_sens_map_h Vbx_clf_sens_map_h Vbx_df_old_sens_map_h Vbx_dfctr_sat_sens_map_h Vbx_rdn_sens_map_h Vxx_dtc_stt_sens_map_h Vxx_dfctr_sens_map_l Vxx_rdn_sens_map_l Vbx_cf_sens_map_l Vbx_clf_sens_map_l Vbx_df_old_sens_map_l Vbx_dfctr_sat_sens_map_l Vbx_rdn_sens_map_l Vxx_dtc_stt_sens_map_l Vxx_dfctr_sens_mat_h Vxx_rdn_sens_mat_h Vbx_cf_sens_mat_h Vbx_clf_sens_mat_h Vbx_df_old_sens_mat_h Vbx_dfctr_sat_sens_mat_h Vbx_rdn_sens_mat_h Vxx_dtc_stt_sens_mat_h Vxx_dfctr_sens_mat_l Vxx_rdn_sens_mat_l Vbx_cf_sens_mat_l Vbx_clf_sens_mat_l Vbx_df_old_sens_mat_l Vbx_dfctr_sat_sens_mat_l Vbx_rdn_sens_mat_l Vxx_dtc_stt_sens_mat_l Vxx_dfctr_sens_rvc_h Vxx_rdn_sens_rvc_h Vbx_cf_sens_rvc_h Vbx_clf_sens_rvc_h Vbx_df_old_sens_rvc_h Vbx_dfctr_sat_sens_rvc_h Vbx_rdn_sens_rvc_h Vxx_dtc_stt_sens_rvc_h Vxx_dfctr_sens_rvc_l Vxx_rdn_sens_rvc_l Vbx_cf_sens_rvc_l Vbx_clf_sens_rvc_l Vbx_df_old_sens_rvc_l Vbx_dfctr_sat_sens_rvc_l Vbx_rdn_sens_rvc_l Vxx_dtc_stt_sens_rvc_l Vxx_dfctr_sens_rvc_nok Vxx_rdn_sens_rvc_nok Vbx_cf_sens_rvc_nok Vbx_clf_sens_rvc_nok Vbx_df_old_sens_rvc_nok Vbx_dfctr_sat_sens_rvc_nok Vbx_rdn_sens_rvc_nok Vxx_dtc_stt_sens_rvc_nok Vxx_dfctr_sens_rvc_sig_mcut Vxx_rdn_sens_rvc_sig_mcut Vbx_cf_sens_rvc_sig_mcut Vbx_clf_sens_rvc_sig_mcut Vbx_df_old_sens_rvc_sig_mcut Vbx_dfctr_sat_sens_rvc_sig_mcut Vbx_rdn_sens_rvc_sig_mcut Vxx_dtc_stt_sens_rvc_sig_mcut Vxx_dfctr_sens_spg_h Vxx_rdn_sens_spg_h Vbx_cf_sens_spg_h Vbx_clf_sens_spg_h Vbx_df_old_sens_spg_h Vbx_dfctr_sat_sens_spg_h Vbx_rdn_sens_spg_h Vxx_dtc_stt_sens_spg_h Vxx_dfctr_sens_spg_l Vxx_rdn_sens_spg_l Vbx_cf_sens_spg_l Vbx_clf_sens_spg_l Vbx_df_old_sens_spg_l Vbx_dfctr_sat_sens_spg_l Vbx_rdn_sens_spg_l Vxx_dtc_stt_sens_spg_l Vxx_dfctr_sens_tco_h Vxx_rdn_sens_tco_h Vbx_cf_sens_tco_h Vbx_clf_sens_tco_h Vbx_df_old_sens_tco_h Vbx_dfctr_sat_sens_tco_h Vbx_rdn_sens_tco_h Vxx_dtc_stt_sens_tco_h Vxx_dfctr_sens_tco_l Vxx_rdn_sens_tco_l Vbx_cf_sens_tco_l Vbx_clf_sens_tco_l Vbx_df_old_sens_tco_l Vbx_dfctr_sat_sens_tco_l Vbx_rdn_sens_tco_l Vxx_dtc_stt_sens_tco_l Vxx_dfctr_sens_tco_sig_mcut Vxx_rdn_sens_tco_sig_mcut Vbx_cf_sens_tco_sig_mcut Vbx_clf_sens_tco_sig_mcut Vbx_df_old_sens_tco_sig_mcut Vbx_dfctr_sat_sens_tco_sig_mcut Vbx_rdn_sens_tco_sig_mcut Vxx_dtc_stt_sens_tco_sig_mcut Vxx_dfctr_sfty_tq_chr Vxx_rdn_sfty_tq_chr Vbx_cf_sfty_tq_chr Vbx_clf_sfty_tq_chr Vbx_df_old_sfty_tq_chr Vbx_dfctr_sat_sfty_tq_chr Vbx_rdn_sfty_tq_chr Vxx_dtc_stt_sfty_tq_chr Vxx_dfctr_sfty_tq_clc_chr Vxx_rdn_sfty_tq_clc_chr Vbx_cf_sfty_tq_clc_chr Vbx_clf_sfty_tq_clc_chr Vbx_df_old_sfty_tq_clc_chr Vbx_dfctr_sat_sfty_tq_clc_chr Vbx_rdn_sfty_tq_clc_chr Vxx_dtc_stt_sfty_tq_clc_chr Vxx_dfctr_sfty_tq_lih_chr Vxx_rdn_sfty_tq_lih_chr Vbx_cf_sfty_tq_lih_chr Vbx_clf_sfty_tq_lih_chr Vbx_df_old_sfty_tq_lih_chr Vbx_dfctr_sat_sfty_tq_lih_chr Vbx_rdn_sfty_tq_lih_chr Vxx_dtc_stt_sfty_tq_lih_chr Vxx_dfctr_spg_oor Vxx_rdn_spg_oor Vbx_cf_spg_oor Vbx_clf_spg_oor Vbx_df_old_spg_oor Vbx_dfctr_sat_spg_oor Vbx_rdn_spg_oor Vxx_dtc_stt_spg_oor Vxx_dfctr_spg_reg_apl_down Vxx_rdn_spg_reg_apl_down Vbx_cf_spg_reg_apl_down Vbx_clf_spg_reg_apl_down Vbx_df_old_spg_reg_apl_down Vbx_dfctr_sat_spg_reg_apl_down Vbx_rdn_spg_reg_apl_down Vxx_dtc_stt_spg_reg_apl_down Vxx_dfctr_spg_reg_apl_up Vxx_rdn_spg_reg_apl_up Vbx_cf_spg_reg_apl_up Vbx_clf_spg_reg_apl_up Vbx_df_old_spg_reg_apl_up Vbx_dfctr_sat_spg_reg_apl_up Vbx_rdn_spg_reg_apl_up Vxx_dtc_stt_spg_reg_apl_up Vxx_dfctr_tco_cl_no_norm Vxx_rdn_tco_cl_no_norm Vbx_cf_tco_cl_no_norm Vbx_clf_tco_cl_no_norm Vbx_df_old_tco_cl_no_norm Vbx_dfctr_sat_tco_cl_no_norm Vbx_rdn_tco_cl_no_norm Vxx_dtc_stt_tco_cl_no_norm Vxx_dfctr_tlz_ad_b_cpt Vxx_rdn_tlz_ad_b_cpt Vbx_cf_tlz_ad_b_cpt Vbx_clf_tlz_ad_b_cpt Vbx_df_old_tlz_ad_b_cpt Vbx_dfctr_sat_tlz_ad_b_cpt Vbx_rdn_tlz_ad_b_cpt Vxx_dtc_stt_tlz_ad_b_cpt Vxx_dfctr_tsta_reg_no_norm Vxx_rdn_tsta_reg_no_norm Vbx_cf_tsta_reg_no_norm Vbx_clf_tsta_reg_no_norm Vbx_df_old_tsta_reg_no_norm Vbx_dfctr_sat_tsta_reg_no_norm Vbx_rdn_tsta_reg_no_norm Vxx_dtc_stt_tsta_reg_no_norm Vxx_dfctr_vb_clc_chr Vxx_rdn_vb_clc_chr Vbx_cf_vb_clc_chr Vbx_clf_vb_clc_chr Vbx_df_old_vb_clc_chr Vbx_dfctr_sat_vb_clc_chr Vbx_rdn_vb_clc_chr Vxx_dtc_stt_vb_clc_chr Vxx_dfctr_vb_h Vxx_rdn_vb_h Vbx_cf_vb_h Vbx_clf_vb_h Vbx_df_old_vb_h Vbx_dfctr_sat_vb_h Vbx_rdn_vb_h Vxx_dtc_stt_vb_h Vxx_dfctr_vb_l Vxx_rdn_vb_l Vbx_cf_vb_l Vbx_clf_vb_l Vbx_df_old_vb_l Vbx_dfctr_sat_vb_l Vbx_rdn_vb_l Vxx_dtc_stt_vb_l Vxx_dfctr_vb_rly_oc_scg Vxx_rdn_vb_rly_oc_scg Vbx_cf_vb_rly_oc_scg Vbx_clf_vb_rly_oc_scg Vbx_df_old_vb_rly_oc_scg Vbx_dfctr_sat_vb_rly_oc_scg Vbx_rdn_vb_rly_oc_scg Vxx_dtc_stt_vb_rly_oc_scg Vxx_dfctr_vb_rly_scw Vxx_rdn_vb_rly_scw Vbx_cf_vb_rly_scw Vbx_clf_vb_rly_scw Vbx_df_old_vb_rly_scw Vbx_dfctr_sat_vb_rly_scw Vbx_rdn_vb_rly_scw Vxx_dtc_stt_vb_rly_scw Vxx_dfctr_wgc_oc Vxx_rdn_wgc_oc Vbx_cf_wgc_oc Vbx_clf_wgc_oc Vbx_df_old_wgc_oc Vbx_dfctr_sat_wgc_oc Vbx_rdn_wgc_oc Vxx_dtc_stt_wgc_oc Vxx_dfctr_wgc_scg Vxx_rdn_wgc_scg Vbx_cf_wgc_scg Vbx_clf_wgc_scg Vbx_df_old_wgc_scg Vbx_dfctr_sat_wgc_scg Vbx_rdn_wgc_scg Vxx_dtc_stt_wgc_scg Vxx_dfctr_wgc_scw Vxx_rdn_wgc_scw Vbx_cf_wgc_scw Vbx_clf_wgc_scw Vbx_df_old_wgc_scw Vbx_dfctr_sat_wgc_scw Vbx_rdn_wgc_scw Vxx_dtc_stt_wgc_scw Vxx_dfctr_wpmp_tcr_blk Vxx_rdn_wpmp_tcr_blk Vbx_cf_wpmp_tcr_blk Vbx_clf_wpmp_tcr_blk Vbx_df_old_wpmp_tcr_blk Vbx_dfctr_sat_wpmp_tcr_blk Vbx_rdn_wpmp_tcr_blk Vxx_dtc_stt_wpmp_tcr_blk Vxx_dfctr_wpmp_tcr_oc Vxx_rdn_wpmp_tcr_oc Vbx_cf_wpmp_tcr_oc Vbx_clf_wpmp_tcr_oc Vbx_df_old_wpmp_tcr_oc Vbx_dfctr_sat_wpmp_tcr_oc Vbx_rdn_wpmp_tcr_oc Vxx_dtc_stt_wpmp_tcr_oc Vxx_dfctr_wpmp_tcr_scg Vxx_rdn_wpmp_tcr_scg Vbx_cf_wpmp_tcr_scg Vbx_clf_wpmp_tcr_scg Vbx_df_old_wpmp_tcr_scg Vbx_dfctr_sat_wpmp_tcr_scg Vbx_rdn_wpmp_tcr_scg Vxx_dtc_stt_wpmp_tcr_scg Vxx_dfctr_wpmp_tcr_scw Vxx_rdn_wpmp_tcr_scw Vbx_cf_wpmp_tcr_scw Vbx_clf_wpmp_tcr_scw Vbx_df_old_wpmp_tcr_scw Vbx_dfctr_sat_wpmp_tcr_scw Vbx_rdn_wpmp_tcr_scw Vxx_dtc_stt_wpmp_tcr_scw /end OUT_MEASUREMENT
/end FUNCTION
/end MODULE
/end PROJECT
