ASAP2_VERSION 1 41
/begin PROJECT RD8 "_default_ProjectLongIdentifier"
/begin HEADER "_default_HeaderComment" PROJECT_NO RD9 /end HEADER
/begin MODULE _default_ModuleName "_default_ModuleLongIdentifier"
/begin MOD_COMMON "_default_ModCommonComment" DEPOSIT ABSOLUTE BYTE_ORDER MSB_LAST ALIGNMENT_BYTE 1 ALIGNMENT_WORD 2 ALIGNMENT_LONG 2 ALIGNMENT_FLOAT32_IEEE 2 ALIGNMENT_FLOAT64_IEEE 4 /end MOD_COMMON
/begin MEASUREMENT Sbx_rdn_inj3_oc "" UBYTE _CNV_A_R_A_105_CM 1 0. 0. 255. DISPLAY_IDENTIFIER fm_sta_eprm_inj3_oc.fm_static_eprm_bitfield.Sbx_rdn_xxx ECU_ADDRESS 0xd00056e6 BIT_MASK 0x10 /end MEASUREMENT
/begin MEASUREMENT Sbx_mf_inj3_oc "" UBYTE _CNV_A_R_A_105_CM 1 0. 0. 255. DISPLAY_IDENTIFIER fm_sta_eprm_inj3_oc.fm_static_eprm_bitfield.Sbx_mf_xxx ECU_ADDRESS 0xd00056e6 BIT_MASK 0x20 /end MEASUREMENT
/begin MEASUREMENT Sbx_cf_inj3_oc "" UBYTE _CNV_A_R_A_105_CM 1 0. 0. 255. DISPLAY_IDENTIFIER fm_sta_eprm_inj3_oc.fm_static_eprm_bitfield.Sbx_cf_xxx ECU_ADDRESS 0xd00056e6 BIT_MASK 0x80 /end MEASUREMENT
/begin MEASUREMENT Sbx_dyn_inj3_scg "" UBYTE _CNV_A_R_A_105_CM 1 0. 0. 255. DISPLAY_IDENTIFIER fm_sta_eprm_inj3_scg.fm_static_eprm_bitfield.Sbx_dyn_xxx ECU_ADDRESS 0xd00056e8 BIT_MASK 0x8 /end MEASUREMENT
/begin MEASUREMENT Sbx_rdn_inj3_scg "" UBYTE _CNV_A_R_A_105_CM 1 0. 0. 255. DISPLAY_IDENTIFIER fm_sta_eprm_inj3_scg.fm_static_eprm_bitfield.Sbx_rdn_xxx ECU_ADDRESS 0xd00056e8 BIT_MASK 0x10 /end MEASUREMENT
/begin MEASUREMENT Sbx_mf_inj3_scg "" UBYTE _CNV_A_R_A_105_CM 1 0. 0. 255. DISPLAY_IDENTIFIER fm_sta_eprm_inj3_scg.fm_static_eprm_bitfield.Sbx_mf_xxx ECU_ADDRESS 0xd00056e8 BIT_MASK 0x20 /end MEASUREMENT
/begin MEASUREMENT Sbx_cf_inj3_scg "" UBYTE _CNV_A_R_A_105_CM 1 0. 0. 255. DISPLAY_IDENTIFIER fm_sta_eprm_inj3_scg.fm_static_eprm_bitfield.Sbx_cf_xxx ECU_ADDRESS 0xd00056e8 BIT_MASK 0x80 /end MEASUREMENT
/begin MEASUREMENT Sbx_dyn_inj3_scw "" UBYTE _CNV_A_R_A_105_CM 1 0. 0. 255. DISPLAY_IDENTIFIER fm_sta_eprm_inj3_scw.fm_static_eprm_bitfield.Sbx_dyn_xxx ECU_ADDRESS 0xd00056ea BIT_MASK 0x8 /end MEASUREMENT
/begin MEASUREMENT Sbx_rdn_inj3_scw "" UBYTE _CNV_A_R_A_105_CM 1 0. 0. 255. DISPLAY_IDENTIFIER fm_sta_eprm_inj3_scw.fm_static_eprm_bitfield.Sbx_rdn_xxx ECU_ADDRESS 0xd00056ea BIT_MASK 0x10 /end MEASUREMENT
/begin MEASUREMENT Sbx_mf_inj3_scw "" UBYTE _CNV_A_R_A_105_CM 1 0. 0. 255. DISPLAY_IDENTIFIER fm_sta_eprm_inj3_scw.fm_static_eprm_bitfield.Sbx_mf_xxx ECU_ADDRESS 0xd00056ea BIT_MASK 0x20 /end MEASUREMENT
/begin MEASUREMENT Sbx_cf_inj3_scw "" UBYTE _CNV_A_R_A_105_CM 1 0. 0. 255. DISPLAY_IDENTIFIER fm_sta_eprm_inj3_scw.fm_static_eprm_bitfield.Sbx_cf_xxx ECU_ADDRESS 0xd00056ea BIT_MASK 0x80 /end MEASUREMENT
/begin MEASUREMENT Sbx_dyn_inj4_oc "" UBYTE _CNV_A_R_A_105_CM 1 0. 0. 255. DISPLAY_IDENTIFIER fm_sta_eprm_inj4_oc.fm_static_eprm_bitfield.Sbx_dyn_xxx ECU_ADDRESS 0xd00056ec BIT_MASK 0x8 /end MEASUREMENT
/begin MEASUREMENT Sbx_rdn_inj4_oc "" UBYTE _CNV_A_R_A_105_CM 1 0. 0. 255. DISPLAY_IDENTIFIER fm_sta_eprm_inj4_oc.fm_static_eprm_bitfield.Sbx_rdn_xxx ECU_ADDRESS 0xd00056ec BIT_MASK 0x10 /end MEASUREMENT
/begin MEASUREMENT Sbx_mf_inj4_oc "" UBYTE _CNV_A_R_A_105_CM 1 0. 0. 255. DISPLAY_IDENTIFIER fm_sta_eprm_inj4_oc.fm_static_eprm_bitfield.Sbx_mf_xxx ECU_ADDRESS 0xd00056ec BIT_MASK 0x20 /end MEASUREMENT
/begin MEASUREMENT Sbx_cf_inj4_oc "" UBYTE _CNV_A_R_A_105_CM 1 0. 0. 255. DISPLAY_IDENTIFIER fm_sta_eprm_inj4_oc.fm_static_eprm_bitfield.Sbx_cf_xxx ECU_ADDRESS 0xd00056ec BIT_MASK 0x80 /end MEASUREMENT
/begin MEASUREMENT Sbx_dyn_inj4_scg "" UBYTE _CNV_A_R_A_105_CM 1 0. 0. 255. DISPLAY_IDENTIFIER fm_sta_eprm_inj4_scg.fm_static_eprm_bitfield.Sbx_dyn_xxx ECU_ADDRESS 0xd00056ee BIT_MASK 0x8 /end MEASUREMENT
/begin MEASUREMENT Sbx_rdn_inj4_scg "" UBYTE _CNV_A_R_A_105_CM 1 0. 0. 255. DISPLAY_IDENTIFIER fm_sta_eprm_inj4_scg.fm_static_eprm_bitfield.Sbx_rdn_xxx ECU_ADDRESS 0xd00056ee BIT_MASK 0x10 /end MEASUREMENT
/begin MEASUREMENT Sbx_mf_inj4_scg "" UBYTE _CNV_A_R_A_105_CM 1 0. 0. 255. DISPLAY_IDENTIFIER fm_sta_eprm_inj4_scg.fm_static_eprm_bitfield.Sbx_mf_xxx ECU_ADDRESS 0xd00056ee BIT_MASK 0x20 /end MEASUREMENT
/begin MEASUREMENT Sbx_cf_inj4_scg "" UBYTE _CNV_A_R_A_105_CM 1 0. 0. 255. DISPLAY_IDENTIFIER fm_sta_eprm_inj4_scg.fm_static_eprm_bitfield.Sbx_cf_xxx ECU_ADDRESS 0xd00056ee BIT_MASK 0x80 /end MEASUREMENT
/begin MEASUREMENT Sbx_dyn_inj4_scw "" UBYTE _CNV_A_R_A_105_CM 1 0. 0. 255. DISPLAY_IDENTIFIER fm_sta_eprm_inj4_scw.fm_static_eprm_bitfield.Sbx_dyn_xxx ECU_ADDRESS 0xd00056f0 BIT_MASK 0x8 /end MEASUREMENT
/begin MEASUREMENT Sbx_rdn_inj4_scw "" UBYTE _CNV_A_R_A_105_CM 1 0. 0. 255. DISPLAY_IDENTIFIER fm_sta_eprm_inj4_scw.fm_static_eprm_bitfield.Sbx_rdn_xxx ECU_ADDRESS 0xd00056f0 BIT_MASK 0x10 /end MEASUREMENT
/begin MEASUREMENT Sbx_mf_inj4_scw "" UBYTE _CNV_A_R_A_105_CM 1 0. 0. 255. DISPLAY_IDENTIFIER fm_sta_eprm_inj4_scw.fm_static_eprm_bitfield.Sbx_mf_xxx ECU_ADDRESS 0xd00056f0 BIT_MASK 0x20 /end MEASUREMENT
/begin MEASUREMENT Sbx_cf_inj4_scw "" UBYTE _CNV_A_R_A_105_CM 1 0. 0. 255. DISPLAY_IDENTIFIER fm_sta_eprm_inj4_scw.fm_static_eprm_bitfield.Sbx_cf_xxx ECU_ADDRESS 0xd00056f0 BIT_MASK 0x80 /end MEASUREMENT
/begin MEASUREMENT Sbx_dyn_inj_ecu_itl "" UBYTE _CNV_A_R_A_105_CM 1 0. 0. 255. DISPLAY_IDENTIFIER fm_sta_eprm_inj_ecu_itl.fm_static_eprm_bitfield.Sbx_dyn_xxx ECU_ADDRESS 0xd00057c8 BIT_MASK 0x8 /end MEASUREMENT
/begin MEASUREMENT Sbx_rdn_inj_ecu_itl "" UBYTE _CNV_A_R_A_105_CM 1 0. 0. 255. DISPLAY_IDENTIFIER fm_sta_eprm_inj_ecu_itl.fm_static_eprm_bitfield.Sbx_rdn_xxx ECU_ADDRESS 0xd00057c8 BIT_MASK 0x10 /end MEASUREMENT
/begin MEASUREMENT Sbx_mf_inj_ecu_itl "" UBYTE _CNV_A_R_A_105_CM 1 0. 0. 255. DISPLAY_IDENTIFIER fm_sta_eprm_inj_ecu_itl.fm_static_eprm_bitfield.Sbx_mf_xxx ECU_ADDRESS 0xd00057c8 BIT_MASK 0x20 /end MEASUREMENT
/begin MEASUREMENT Sbx_cf_inj_ecu_itl "" UBYTE _CNV_A_R_A_105_CM 1 0. 0. 255. DISPLAY_IDENTIFIER fm_sta_eprm_inj_ecu_itl.fm_static_eprm_bitfield.Sbx_cf_xxx ECU_ADDRESS 0xd00057c8 BIT_MASK 0x80 /end MEASUREMENT
/begin MEASUREMENT Sbx_dyn_inj_ecu_lbdw_icp "" UBYTE _CNV_A_R_A_105_CM 1 0. 0. 255. DISPLAY_IDENTIFIER fm_sta_eprm_inj_ecu_lbdw_icp.fm_static_eprm_bitfield.Sbx_dyn_xxx ECU_ADDRESS 0xd00056d6 BIT_MASK 0x8 /end MEASUREMENT
/begin MEASUREMENT Sbx_rdn_inj_ecu_lbdw_icp "" UBYTE _CNV_A_R_A_105_CM 1 0. 0. 255. DISPLAY_IDENTIFIER fm_sta_eprm_inj_ecu_lbdw_icp.fm_static_eprm_bitfield.Sbx_rdn_xxx ECU_ADDRESS 0xd00056d6 BIT_MASK 0x10 /end MEASUREMENT
/begin MEASUREMENT Sbx_mf_inj_ecu_lbdw_icp "" UBYTE _CNV_A_R_A_105_CM 1 0. 0. 255. DISPLAY_IDENTIFIER fm_sta_eprm_inj_ecu_lbdw_icp.fm_static_eprm_bitfield.Sbx_mf_xxx ECU_ADDRESS 0xd00056d6 BIT_MASK 0x20 /end MEASUREMENT
/begin MEASUREMENT Sbx_cf_inj_ecu_lbdw_icp "" UBYTE _CNV_A_R_A_105_CM 1 0. 0. 255. DISPLAY_IDENTIFIER fm_sta_eprm_inj_ecu_lbdw_icp.fm_static_eprm_bitfield.Sbx_cf_xxx ECU_ADDRESS 0xd00056d6 BIT_MASK 0x80 /end MEASUREMENT
/begin MEASUREMENT Sbx_dyn_inj_ecu_lbup_icp "" UBYTE _CNV_A_R_A_105_CM 1 0. 0. 255. DISPLAY_IDENTIFIER fm_sta_eprm_inj_ecu_lbup_icp.fm_static_eprm_bitfield.Sbx_dyn_xxx ECU_ADDRESS 0xd00056d8 BIT_MASK 0x8 /end MEASUREMENT
/begin MEASUREMENT Sbx_rdn_inj_ecu_lbup_icp "" UBYTE _CNV_A_R_A_105_CM 1 0. 0. 255. DISPLAY_IDENTIFIER fm_sta_eprm_inj_ecu_lbup_icp.fm_static_eprm_bitfield.Sbx_rdn_xxx ECU_ADDRESS 0xd00056d8 BIT_MASK 0x10 /end MEASUREMENT
/begin MEASUREMENT Sbx_mf_inj_ecu_lbup_icp "" UBYTE _CNV_A_R_A_105_CM 1 0. 0. 255. DISPLAY_IDENTIFIER fm_sta_eprm_inj_ecu_lbup_icp.fm_static_eprm_bitfield.Sbx_mf_xxx ECU_ADDRESS 0xd00056d8 BIT_MASK 0x20 /end MEASUREMENT
/begin MEASUREMENT Sbx_cf_inj_ecu_lbup_icp "" UBYTE _CNV_A_R_A_105_CM 1 0. 0. 255. DISPLAY_IDENTIFIER fm_sta_eprm_inj_ecu_lbup_icp.fm_static_eprm_bitfield.Sbx_cf_xxx ECU_ADDRESS 0xd00056d8 BIT_MASK 0x80 /end MEASUREMENT
/begin MEASUREMENT Sbx_dyn_ip_lght_tco_ovh "" UBYTE _CNV_A_R_A_105_CM 1 0. 0. 255. DISPLAY_IDENTIFIER fm_sta_eprm_ip_lght_tco_ovh.fm_static_eprm_bitfield.Sbx_dyn_xxx ECU_ADDRESS 0xd00057ca BIT_MASK 0x8 /end MEASUREMENT
/begin MEASUREMENT Sbx_rdn_ip_lght_tco_ovh "" UBYTE _CNV_A_R_A_105_CM 1 0. 0. 255. DISPLAY_IDENTIFIER fm_sta_eprm_ip_lght_tco_ovh.fm_static_eprm_bitfield.Sbx_rdn_xxx ECU_ADDRESS 0xd00057ca BIT_MASK 0x10 /end MEASUREMENT
/begin MEASUREMENT Sbx_mf_ip_lght_tco_ovh "" UBYTE _CNV_A_R_A_105_CM 1 0. 0. 255. DISPLAY_IDENTIFIER fm_sta_eprm_ip_lght_tco_ovh.fm_static_eprm_bitfield.Sbx_mf_xxx ECU_ADDRESS 0xd00057ca BIT_MASK 0x20 /end MEASUREMENT
/begin MEASUREMENT Sbx_cf_ip_lght_tco_ovh "" UBYTE _CNV_A_R_A_105_CM 1 0. 0. 255. DISPLAY_IDENTIFIER fm_sta_eprm_ip_lght_tco_ovh.fm_static_eprm_bitfield.Sbx_cf_xxx ECU_ADDRESS 0xd00057ca BIT_MASK 0x80 /end MEASUREMENT
/begin MEASUREMENT Sbx_dyn_isr_h_lvl "" UBYTE _CNV_A_R_A_105_CM 1 0. 0. 255. DISPLAY_IDENTIFIER fm_sta_eprm_isr_h_lvl.fm_static_eprm_bitfield.Sbx_dyn_xxx ECU_ADDRESS 0xd000581e BIT_MASK 0x8 /end MEASUREMENT
/begin MEASUREMENT Sbx_rdn_isr_h_lvl "" UBYTE _CNV_A_R_A_105_CM 1 0. 0. 255. DISPLAY_IDENTIFIER fm_sta_eprm_isr_h_lvl.fm_static_eprm_bitfield.Sbx_rdn_xxx ECU_ADDRESS 0xd000581e BIT_MASK 0x10 /end MEASUREMENT
/begin MEASUREMENT Sbx_mf_isr_h_lvl "" UBYTE _CNV_A_R_A_105_CM 1 0. 0. 255. DISPLAY_IDENTIFIER fm_sta_eprm_isr_h_lvl.fm_static_eprm_bitfield.Sbx_mf_xxx ECU_ADDRESS 0xd000581e BIT_MASK 0x20 /end MEASUREMENT
/begin MEASUREMENT Sbx_cf_isr_h_lvl "" UBYTE _CNV_A_R_A_105_CM 1 0. 0. 255. DISPLAY_IDENTIFIER fm_sta_eprm_isr_h_lvl.fm_static_eprm_bitfield.Sbx_cf_xxx ECU_ADDRESS 0xd000581e BIT_MASK 0x80 /end MEASUREMENT
/begin MEASUREMENT Sbx_dyn_isr_l_lvl "" UBYTE _CNV_A_R_A_105_CM 1 0. 0. 255. DISPLAY_IDENTIFIER fm_sta_eprm_isr_l_lvl.fm_static_eprm_bitfield.Sbx_dyn_xxx ECU_ADDRESS 0xd0005820 BIT_MASK 0x8 /end MEASUREMENT
/begin MEASUREMENT Sbx_rdn_isr_l_lvl "" UBYTE _CNV_A_R_A_105_CM 1 0. 0. 255. DISPLAY_IDENTIFIER fm_sta_eprm_isr_l_lvl.fm_static_eprm_bitfield.Sbx_rdn_xxx ECU_ADDRESS 0xd0005820 BIT_MASK 0x10 /end MEASUREMENT
/begin MEASUREMENT Sbx_mf_isr_l_lvl "" UBYTE _CNV_A_R_A_105_CM 1 0. 0. 255. DISPLAY_IDENTIFIER fm_sta_eprm_isr_l_lvl.fm_static_eprm_bitfield.Sbx_mf_xxx ECU_ADDRESS 0xd0005820 BIT_MASK 0x20 /end MEASUREMENT
/begin MEASUREMENT Sbx_cf_isr_l_lvl "" UBYTE _CNV_A_R_A_105_CM 1 0. 0. 255. DISPLAY_IDENTIFIER fm_sta_eprm_isr_l_lvl.fm_static_eprm_bitfield.Sbx_cf_xxx ECU_ADDRESS 0xd0005820 BIT_MASK 0x80 /end MEASUREMENT
/begin MEASUREMENT Sbx_dyn_it_cmd_el "" UBYTE _CNV_A_R_A_105_CM 1 0. 0. 255. DISPLAY_IDENTIFIER fm_sta_eprm_it_cmd_el.fm_static_eprm_bitfield.Sbx_dyn_xxx ECU_ADDRESS 0xd00056f2 BIT_MASK 0x8 /end MEASUREMENT
/begin MEASUREMENT Sbx_rdn_it_cmd_el "" UBYTE _CNV_A_R_A_105_CM 1 0. 0. 255. DISPLAY_IDENTIFIER fm_sta_eprm_it_cmd_el.fm_static_eprm_bitfield.Sbx_rdn_xxx ECU_ADDRESS 0xd00056f2 BIT_MASK 0x10 /end MEASUREMENT
/begin MEASUREMENT Sbx_mf_it_cmd_el "" UBYTE _CNV_A_R_A_105_CM 1 0. 0. 255. DISPLAY_IDENTIFIER fm_sta_eprm_it_cmd_el.fm_static_eprm_bitfield.Sbx_mf_xxx ECU_ADDRESS 0xd00056f2 BIT_MASK 0x20 /end MEASUREMENT
/begin MEASUREMENT Sbx_cf_it_cmd_el "" UBYTE _CNV_A_R_A_105_CM 1 0. 0. 255. DISPLAY_IDENTIFIER fm_sta_eprm_it_cmd_el.fm_static_eprm_bitfield.Sbx_cf_xxx ECU_ADDRESS 0xd00056f2 BIT_MASK 0x80 /end MEASUREMENT
/begin MEASUREMENT Sbx_dyn_it_ofs_meca "" UBYTE _CNV_A_R_A_105_CM 1 0. 0. 255. DISPLAY_IDENTIFIER fm_sta_eprm_it_ofs_meca.fm_static_eprm_bitfield.Sbx_dyn_xxx ECU_ADDRESS 0xd00056f4 BIT_MASK 0x8 /end MEASUREMENT
/begin MEASUREMENT Sbx_rdn_it_ofs_meca "" UBYTE _CNV_A_R_A_105_CM 1 0. 0. 255. DISPLAY_IDENTIFIER fm_sta_eprm_it_ofs_meca.fm_static_eprm_bitfield.Sbx_rdn_xxx ECU_ADDRESS 0xd00056f4 BIT_MASK 0x10 /end MEASUREMENT
/begin MEASUREMENT Sbx_mf_it_ofs_meca "" UBYTE _CNV_A_R_A_105_CM 1 0. 0. 255. DISPLAY_IDENTIFIER fm_sta_eprm_it_ofs_meca.fm_static_eprm_bitfield.Sbx_mf_xxx ECU_ADDRESS 0xd00056f4 BIT_MASK 0x20 /end MEASUREMENT
/begin MEASUREMENT Sbx_cf_it_ofs_meca "" UBYTE _CNV_A_R_A_105_CM 1 0. 0. 255. DISPLAY_IDENTIFIER fm_sta_eprm_it_ofs_meca.fm_static_eprm_bitfield.Sbx_cf_xxx ECU_ADDRESS 0xd00056f4 BIT_MASK 0x80 /end MEASUREMENT
/begin MEASUREMENT Sbx_dyn_it_ofs_no_norm "" UBYTE _CNV_A_R_A_105_CM 1 0. 0. 255. DISPLAY_IDENTIFIER fm_sta_eprm_it_ofs_no_norm.fm_static_eprm_bitfield.Sbx_dyn_xxx ECU_ADDRESS 0xd00056f6 BIT_MASK 0x8 /end MEASUREMENT
/begin MEASUREMENT Sbx_rdn_it_ofs_no_norm "" UBYTE _CNV_A_R_A_105_CM 1 0. 0. 255. DISPLAY_IDENTIFIER fm_sta_eprm_it_ofs_no_norm.fm_static_eprm_bitfield.Sbx_rdn_xxx ECU_ADDRESS 0xd00056f6 BIT_MASK 0x10 /end MEASUREMENT
/begin MEASUREMENT Sbx_mf_it_ofs_no_norm "" UBYTE _CNV_A_R_A_105_CM 1 0. 0. 255. DISPLAY_IDENTIFIER fm_sta_eprm_it_ofs_no_norm.fm_static_eprm_bitfield.Sbx_mf_xxx ECU_ADDRESS 0xd00056f6 BIT_MASK 0x20 /end MEASUREMENT
/begin MEASUREMENT Sbx_cf_it_ofs_no_norm "" UBYTE _CNV_A_R_A_105_CM 1 0. 0. 255. DISPLAY_IDENTIFIER fm_sta_eprm_it_ofs_no_norm.fm_static_eprm_bitfield.Sbx_cf_xxx ECU_ADDRESS 0xd00056f6 BIT_MASK 0x80 /end MEASUREMENT
/begin MEASUREMENT Sbx_dyn_it_ofs_secu_nok "" UBYTE _CNV_A_R_A_105_CM 1 0. 0. 255. DISPLAY_IDENTIFIER fm_sta_eprm_it_ofs_secu_nok.fm_static_eprm_bitfield.Sbx_dyn_xxx ECU_ADDRESS 0xd00056f8 BIT_MASK 0x8 /end MEASUREMENT
/begin MEASUREMENT Sbx_rdn_it_ofs_secu_nok "" UBYTE _CNV_A_R_A_105_CM 1 0. 0. 255. DISPLAY_IDENTIFIER fm_sta_eprm_it_ofs_secu_nok.fm_static_eprm_bitfield.Sbx_rdn_xxx ECU_ADDRESS 0xd00056f8 BIT_MASK 0x10 /end MEASUREMENT
/begin MEASUREMENT Sbx_mf_it_ofs_secu_nok "" UBYTE _CNV_A_R_A_105_CM 1 0. 0. 255. DISPLAY_IDENTIFIER fm_sta_eprm_it_ofs_secu_nok.fm_static_eprm_bitfield.Sbx_mf_xxx ECU_ADDRESS 0xd00056f8 BIT_MASK 0x20 /end MEASUREMENT
/begin MEASUREMENT Sbx_cf_it_ofs_secu_nok "" UBYTE _CNV_A_R_A_105_CM 1 0. 0. 255. DISPLAY_IDENTIFIER fm_sta_eprm_it_ofs_secu_nok.fm_static_eprm_bitfield.Sbx_cf_xxx ECU_ADDRESS 0xd00056f8 BIT_MASK 0x80 /end MEASUREMENT
/begin MEASUREMENT Sbx_dyn_it_reg_blk "" UBYTE _CNV_A_R_A_105_CM 1 0. 0. 255. DISPLAY_IDENTIFIER fm_sta_eprm_it_reg_blk.fm_static_eprm_bitfield.Sbx_dyn_xxx ECU_ADDRESS 0xd00056fa BIT_MASK 0x8 /end MEASUREMENT
/begin MEASUREMENT Sbx_rdn_it_reg_blk "" UBYTE _CNV_A_R_A_105_CM 1 0. 0. 255. DISPLAY_IDENTIFIER fm_sta_eprm_it_reg_blk.fm_static_eprm_bitfield.Sbx_rdn_xxx ECU_ADDRESS 0xd00056fa BIT_MASK 0x10 /end MEASUREMENT
/begin MEASUREMENT Sbx_mf_it_reg_blk "" UBYTE _CNV_A_R_A_105_CM 1 0. 0. 255. DISPLAY_IDENTIFIER fm_sta_eprm_it_reg_blk.fm_static_eprm_bitfield.Sbx_mf_xxx ECU_ADDRESS 0xd00056fa BIT_MASK 0x20 /end MEASUREMENT
/begin MEASUREMENT Sbx_cf_it_reg_blk "" UBYTE _CNV_A_R_A_105_CM 1 0. 0. 255. DISPLAY_IDENTIFIER fm_sta_eprm_it_reg_blk.fm_static_eprm_bitfield.Sbx_cf_xxx ECU_ADDRESS 0xd00056fa BIT_MASK 0x80 /end MEASUREMENT
/begin MEASUREMENT Sbx_dyn_knk_oor "" UBYTE _CNV_A_R_A_105_CM 1 0. 0. 255. DISPLAY_IDENTIFIER fm_sta_eprm_knk_oor.fm_static_eprm_bitfield.Sbx_dyn_xxx ECU_ADDRESS 0xd00056fc BIT_MASK 0x8 /end MEASUREMENT
/begin MEASUREMENT Sbx_rdn_knk_oor "" UBYTE _CNV_A_R_A_105_CM 1 0. 0. 255. DISPLAY_IDENTIFIER fm_sta_eprm_knk_oor.fm_static_eprm_bitfield.Sbx_rdn_xxx ECU_ADDRESS 0xd00056fc BIT_MASK 0x10 /end MEASUREMENT
/begin MEASUREMENT Sbx_mf_knk_oor "" UBYTE _CNV_A_R_A_105_CM 1 0. 0. 255. DISPLAY_IDENTIFIER fm_sta_eprm_knk_oor.fm_static_eprm_bitfield.Sbx_mf_xxx ECU_ADDRESS 0xd00056fc BIT_MASK 0x20 /end MEASUREMENT
/begin MEASUREMENT Sbx_cf_knk_oor "" UBYTE _CNV_A_R_A_105_CM 1 0. 0. 255. DISPLAY_IDENTIFIER fm_sta_eprm_knk_oor.fm_static_eprm_bitfield.Sbx_cf_xxx ECU_ADDRESS 0xd00056fc BIT_MASK 0x80 /end MEASUREMENT
/begin MEASUREMENT Sbx_dyn_knk_shp "" UBYTE _CNV_A_R_A_105_CM 1 0. 0. 255. DISPLAY_IDENTIFIER fm_sta_eprm_knk_shp.fm_static_eprm_bitfield.Sbx_dyn_xxx ECU_ADDRESS 0xd00056fe BIT_MASK 0x8 /end MEASUREMENT
/begin MEASUREMENT Sbx_rdn_knk_shp "" UBYTE _CNV_A_R_A_105_CM 1 0. 0. 255. DISPLAY_IDENTIFIER fm_sta_eprm_knk_shp.fm_static_eprm_bitfield.Sbx_rdn_xxx ECU_ADDRESS 0xd00056fe BIT_MASK 0x10 /end MEASUREMENT
/begin MEASUREMENT Sbx_mf_knk_shp "" UBYTE _CNV_A_R_A_105_CM 1 0. 0. 255. DISPLAY_IDENTIFIER fm_sta_eprm_knk_shp.fm_static_eprm_bitfield.Sbx_mf_xxx ECU_ADDRESS 0xd00056fe BIT_MASK 0x20 /end MEASUREMENT
/begin MEASUREMENT Sbx_cf_knk_shp "" UBYTE _CNV_A_R_A_105_CM 1 0. 0. 255. DISPLAY_IDENTIFIER fm_sta_eprm_knk_shp.fm_static_eprm_bitfield.Sbx_cf_xxx ECU_ADDRESS 0xd00056fe BIT_MASK 0x80 /end MEASUREMENT
/begin MEASUREMENT Sbx_dyn_lbdw_hot_dirt_lkg "" UBYTE _CNV_A_R_A_105_CM 1 0. 0. 255. DISPLAY_IDENTIFIER fm_sta_eprm_lbdw_hot_dirt_lkg.fm_static_eprm_bitfield.Sbx_dyn_xxx ECU_ADDRESS 0xd0005824 BIT_MASK 0x8 /end MEASUREMENT
/begin MEASUREMENT Sbx_rdn_lbdw_hot_dirt_lkg "" UBYTE _CNV_A_R_A_105_CM 1 0. 0. 255. DISPLAY_IDENTIFIER fm_sta_eprm_lbdw_hot_dirt_lkg.fm_static_eprm_bitfield.Sbx_rdn_xxx ECU_ADDRESS 0xd0005824 BIT_MASK 0x10 /end MEASUREMENT
/begin MEASUREMENT Sbx_mf_lbdw_hot_dirt_lkg "" UBYTE _CNV_A_R_A_105_CM 1 0. 0. 255. DISPLAY_IDENTIFIER fm_sta_eprm_lbdw_hot_dirt_lkg.fm_static_eprm_bitfield.Sbx_mf_xxx ECU_ADDRESS 0xd0005824 BIT_MASK 0x20 /end MEASUREMENT
/begin MEASUREMENT Sbx_cf_lbdw_hot_dirt_lkg "" UBYTE _CNV_A_R_A_105_CM 1 0. 0. 255. DISPLAY_IDENTIFIER fm_sta_eprm_lbdw_hot_dirt_lkg.fm_static_eprm_bitfield.Sbx_cf_xxx ECU_ADDRESS 0xd0005824 BIT_MASK 0x80 /end MEASUREMENT
/begin MEASUREMENT Sbx_dyn_lbdw_hot_oc "" UBYTE _CNV_A_R_A_105_CM 1 0. 0. 255. DISPLAY_IDENTIFIER fm_sta_eprm_lbdw_hot_oc.fm_static_eprm_bitfield.Sbx_dyn_xxx ECU_ADDRESS 0xd000575a BIT_MASK 0x8 /end MEASUREMENT
/begin MEASUREMENT Sbx_rdn_lbdw_hot_oc "" UBYTE _CNV_A_R_A_105_CM 1 0. 0. 255. DISPLAY_IDENTIFIER fm_sta_eprm_lbdw_hot_oc.fm_static_eprm_bitfield.Sbx_rdn_xxx ECU_ADDRESS 0xd000575a BIT_MASK 0x10 /end MEASUREMENT
/begin MEASUREMENT Sbx_mf_lbdw_hot_oc "" UBYTE _CNV_A_R_A_105_CM 1 0. 0. 255. DISPLAY_IDENTIFIER fm_sta_eprm_lbdw_hot_oc.fm_static_eprm_bitfield.Sbx_mf_xxx ECU_ADDRESS 0xd000575a BIT_MASK 0x20 /end MEASUREMENT
/begin MEASUREMENT Sbx_cf_lbdw_hot_oc "" UBYTE _CNV_A_R_A_105_CM 1 0. 0. 255. DISPLAY_IDENTIFIER fm_sta_eprm_lbdw_hot_oc.fm_static_eprm_bitfield.Sbx_cf_xxx ECU_ADDRESS 0xd000575a BIT_MASK 0x80 /end MEASUREMENT
/begin MEASUREMENT Sbx_dyn_lbdw_hot_scg "" UBYTE _CNV_A_R_A_105_CM 1 0. 0. 255. DISPLAY_IDENTIFIER fm_sta_eprm_lbdw_hot_scg.fm_static_eprm_bitfield.Sbx_dyn_xxx ECU_ADDRESS 0xd000575c BIT_MASK 0x8 /end MEASUREMENT
/begin MEASUREMENT Sbx_rdn_lbdw_hot_scg "" UBYTE _CNV_A_R_A_105_CM 1 0. 0. 255. DISPLAY_IDENTIFIER fm_sta_eprm_lbdw_hot_scg.fm_static_eprm_bitfield.Sbx_rdn_xxx ECU_ADDRESS 0xd000575c BIT_MASK 0x10 /end MEASUREMENT
/begin MEASUREMENT Sbx_mf_lbdw_hot_scg "" UBYTE _CNV_A_R_A_105_CM 1 0. 0. 255. DISPLAY_IDENTIFIER fm_sta_eprm_lbdw_hot_scg.fm_static_eprm_bitfield.Sbx_mf_xxx ECU_ADDRESS 0xd000575c BIT_MASK 0x20 /end MEASUREMENT
/begin MEASUREMENT Sbx_cf_lbdw_hot_scg "" UBYTE _CNV_A_R_A_105_CM 1 0. 0. 255. DISPLAY_IDENTIFIER fm_sta_eprm_lbdw_hot_scg.fm_static_eprm_bitfield.Sbx_cf_xxx ECU_ADDRESS 0xd000575c BIT_MASK 0x80 /end MEASUREMENT
/begin MEASUREMENT Sbx_dyn_lbdw_hot_scw "" UBYTE _CNV_A_R_A_105_CM 1 0. 0. 255. DISPLAY_IDENTIFIER fm_sta_eprm_lbdw_hot_scw.fm_static_eprm_bitfield.Sbx_dyn_xxx ECU_ADDRESS 0xd000575e BIT_MASK 0x8 /end MEASUREMENT
/begin MEASUREMENT Sbx_rdn_lbdw_hot_scw "" UBYTE _CNV_A_R_A_105_CM 1 0. 0. 255. DISPLAY_IDENTIFIER fm_sta_eprm_lbdw_hot_scw.fm_static_eprm_bitfield.Sbx_rdn_xxx ECU_ADDRESS 0xd000575e BIT_MASK 0x10 /end MEASUREMENT
/begin MEASUREMENT Sbx_mf_lbdw_hot_scw "" UBYTE _CNV_A_R_A_105_CM 1 0. 0. 255. DISPLAY_IDENTIFIER fm_sta_eprm_lbdw_hot_scw.fm_static_eprm_bitfield.Sbx_mf_xxx ECU_ADDRESS 0xd000575e BIT_MASK 0x20 /end MEASUREMENT
/begin MEASUREMENT Sbx_cf_lbdw_hot_scw "" UBYTE _CNV_A_R_A_105_CM 1 0. 0. 255. DISPLAY_IDENTIFIER fm_sta_eprm_lbdw_hot_scw.fm_static_eprm_bitfield.Sbx_cf_xxx ECU_ADDRESS 0xd000575e BIT_MASK 0x80 /end MEASUREMENT
/begin MEASUREMENT Sbx_dyn_lbdw_oc "" UBYTE _CNV_A_R_A_105_CM 1 0. 0. 255. DISPLAY_IDENTIFIER fm_sta_eprm_lbdw_oc.fm_static_eprm_bitfield.Sbx_dyn_xxx ECU_ADDRESS 0xd0005700 BIT_MASK 0x8 /end MEASUREMENT
/begin MEASUREMENT Sbx_rdn_lbdw_oc "" UBYTE _CNV_A_R_A_105_CM 1 0. 0. 255. DISPLAY_IDENTIFIER fm_sta_eprm_lbdw_oc.fm_static_eprm_bitfield.Sbx_rdn_xxx ECU_ADDRESS 0xd0005700 BIT_MASK 0x10 /end MEASUREMENT
/begin MEASUREMENT Sbx_mf_lbdw_oc "" UBYTE _CNV_A_R_A_105_CM 1 0. 0. 255. DISPLAY_IDENTIFIER fm_sta_eprm_lbdw_oc.fm_static_eprm_bitfield.Sbx_mf_xxx ECU_ADDRESS 0xd0005700 BIT_MASK 0x20 /end MEASUREMENT
/begin MEASUREMENT Sbx_cf_lbdw_oc "" UBYTE _CNV_A_R_A_105_CM 1 0. 0. 255. DISPLAY_IDENTIFIER fm_sta_eprm_lbdw_oc.fm_static_eprm_bitfield.Sbx_cf_xxx ECU_ADDRESS 0xd0005700 BIT_MASK 0x80 /end MEASUREMENT
/begin MEASUREMENT Sbx_dyn_lbdw_scg "" UBYTE _CNV_A_R_A_105_CM 1 0. 0. 255. DISPLAY_IDENTIFIER fm_sta_eprm_lbdw_scg.fm_static_eprm_bitfield.Sbx_dyn_xxx ECU_ADDRESS 0xd0005702 BIT_MASK 0x8 /end MEASUREMENT
/begin MEASUREMENT Sbx_rdn_lbdw_scg "" UBYTE _CNV_A_R_A_105_CM 1 0. 0. 255. DISPLAY_IDENTIFIER fm_sta_eprm_lbdw_scg.fm_static_eprm_bitfield.Sbx_rdn_xxx ECU_ADDRESS 0xd0005702 BIT_MASK 0x10 /end MEASUREMENT
/begin MEASUREMENT Sbx_mf_lbdw_scg "" UBYTE _CNV_A_R_A_105_CM 1 0. 0. 255. DISPLAY_IDENTIFIER fm_sta_eprm_lbdw_scg.fm_static_eprm_bitfield.Sbx_mf_xxx ECU_ADDRESS 0xd0005702 BIT_MASK 0x20 /end MEASUREMENT
/begin MEASUREMENT Sbx_cf_lbdw_scg "" UBYTE _CNV_A_R_A_105_CM 1 0. 0. 255. DISPLAY_IDENTIFIER fm_sta_eprm_lbdw_scg.fm_static_eprm_bitfield.Sbx_cf_xxx ECU_ADDRESS 0xd0005702 BIT_MASK 0x80 /end MEASUREMENT
/begin MEASUREMENT Sbx_dyn_lbdw_scw "" UBYTE _CNV_A_R_A_105_CM 1 0. 0. 255. DISPLAY_IDENTIFIER fm_sta_eprm_lbdw_scw.fm_static_eprm_bitfield.Sbx_dyn_xxx ECU_ADDRESS 0xd0005704 BIT_MASK 0x8 /end MEASUREMENT
/begin MEASUREMENT Sbx_rdn_lbdw_scw "" UBYTE _CNV_A_R_A_105_CM 1 0. 0. 255. DISPLAY_IDENTIFIER fm_sta_eprm_lbdw_scw.fm_static_eprm_bitfield.Sbx_rdn_xxx ECU_ADDRESS 0xd0005704 BIT_MASK 0x10 /end MEASUREMENT
/begin MEASUREMENT Sbx_mf_lbdw_scw "" UBYTE _CNV_A_R_A_105_CM 1 0. 0. 255. DISPLAY_IDENTIFIER fm_sta_eprm_lbdw_scw.fm_static_eprm_bitfield.Sbx_mf_xxx ECU_ADDRESS 0xd0005704 BIT_MASK 0x20 /end MEASUREMENT
/begin MEASUREMENT Sbx_cf_lbdw_scw "" UBYTE _CNV_A_R_A_105_CM 1 0. 0. 255. DISPLAY_IDENTIFIER fm_sta_eprm_lbdw_scw.fm_static_eprm_bitfield.Sbx_cf_xxx ECU_ADDRESS 0xd0005704 BIT_MASK 0x80 /end MEASUREMENT
/begin MEASUREMENT Sbx_dyn_lbup_cpt "" UBYTE _CNV_A_R_A_105_CM 1 0. 0. 255. DISPLAY_IDENTIFIER fm_sta_eprm_lbup_cpt.fm_static_eprm_bitfield.Sbx_dyn_xxx ECU_ADDRESS 0xd00057ba BIT_MASK 0x8 /end MEASUREMENT
/begin MEASUREMENT Sbx_rdn_lbup_cpt "" UBYTE _CNV_A_R_A_105_CM 1 0. 0. 255. DISPLAY_IDENTIFIER fm_sta_eprm_lbup_cpt.fm_static_eprm_bitfield.Sbx_rdn_xxx ECU_ADDRESS 0xd00057ba BIT_MASK 0x10 /end MEASUREMENT
/begin MEASUREMENT Sbx_mf_lbup_cpt "" UBYTE _CNV_A_R_A_105_CM 1 0. 0. 255. DISPLAY_IDENTIFIER fm_sta_eprm_lbup_cpt.fm_static_eprm_bitfield.Sbx_mf_xxx ECU_ADDRESS 0xd00057ba BIT_MASK 0x20 /end MEASUREMENT
/begin MEASUREMENT Sbx_cf_lbup_cpt "" UBYTE _CNV_A_R_A_105_CM 1 0. 0. 255. DISPLAY_IDENTIFIER fm_sta_eprm_lbup_cpt.fm_static_eprm_bitfield.Sbx_cf_xxx ECU_ADDRESS 0xd00057ba BIT_MASK 0x80 /end MEASUREMENT
/begin MEASUREMENT Sbx_dyn_lbup_hot_apl_down "" UBYTE _CNV_A_R_A_105_CM 1 0. 0. 255. DISPLAY_IDENTIFIER fm_sta_eprm_lbup_hot_apl_down.fm_static_eprm_bitfield.Sbx_dyn_xxx ECU_ADDRESS 0xd000580c BIT_MASK 0x8 /end MEASUREMENT
/begin MEASUREMENT Sbx_rdn_lbup_hot_apl_down "" UBYTE _CNV_A_R_A_105_CM 1 0. 0. 255. DISPLAY_IDENTIFIER fm_sta_eprm_lbup_hot_apl_down.fm_static_eprm_bitfield.Sbx_rdn_xxx ECU_ADDRESS 0xd000580c BIT_MASK 0x10 /end MEASUREMENT
/begin MEASUREMENT Sbx_mf_lbup_hot_apl_down "" UBYTE _CNV_A_R_A_105_CM 1 0. 0. 255. DISPLAY_IDENTIFIER fm_sta_eprm_lbup_hot_apl_down.fm_static_eprm_bitfield.Sbx_mf_xxx ECU_ADDRESS 0xd000580c BIT_MASK 0x20 /end MEASUREMENT
/begin MEASUREMENT Sbx_cf_lbup_hot_apl_down "" UBYTE _CNV_A_R_A_105_CM 1 0. 0. 255. DISPLAY_IDENTIFIER fm_sta_eprm_lbup_hot_apl_down.fm_static_eprm_bitfield.Sbx_cf_xxx ECU_ADDRESS 0xd000580c BIT_MASK 0x80 /end MEASUREMENT
/begin MEASUREMENT Sbx_dyn_lbup_hot_dirt_lkg "" UBYTE _CNV_A_R_A_105_CM 1 0. 0. 255. DISPLAY_IDENTIFIER fm_sta_eprm_lbup_hot_dirt_lkg.fm_static_eprm_bitfield.Sbx_dyn_xxx ECU_ADDRESS 0xd0005826 BIT_MASK 0x8 /end MEASUREMENT
/begin MEASUREMENT Sbx_rdn_lbup_hot_dirt_lkg "" UBYTE _CNV_A_R_A_105_CM 1 0. 0. 255. DISPLAY_IDENTIFIER fm_sta_eprm_lbup_hot_dirt_lkg.fm_static_eprm_bitfield.Sbx_rdn_xxx ECU_ADDRESS 0xd0005826 BIT_MASK 0x10 /end MEASUREMENT
/begin MEASUREMENT Sbx_mf_lbup_hot_dirt_lkg "" UBYTE _CNV_A_R_A_105_CM 1 0. 0. 255. DISPLAY_IDENTIFIER fm_sta_eprm_lbup_hot_dirt_lkg.fm_static_eprm_bitfield.Sbx_mf_xxx ECU_ADDRESS 0xd0005826 BIT_MASK 0x20 /end MEASUREMENT
/begin MEASUREMENT Sbx_cf_lbup_hot_dirt_lkg "" UBYTE _CNV_A_R_A_105_CM 1 0. 0. 255. DISPLAY_IDENTIFIER fm_sta_eprm_lbup_hot_dirt_lkg.fm_static_eprm_bitfield.Sbx_cf_xxx ECU_ADDRESS 0xd0005826 BIT_MASK 0x80 /end MEASUREMENT
/begin MEASUREMENT Sbx_dyn_lbup_hot_oc "" UBYTE _CNV_A_R_A_105_CM 1 0. 0. 255. DISPLAY_IDENTIFIER fm_sta_eprm_lbup_hot_oc.fm_static_eprm_bitfield.Sbx_dyn_xxx ECU_ADDRESS 0xd0005760 BIT_MASK 0x8 /end MEASUREMENT
/begin MEASUREMENT Sbx_rdn_lbup_hot_oc "" UBYTE _CNV_A_R_A_105_CM 1 0. 0. 255. DISPLAY_IDENTIFIER fm_sta_eprm_lbup_hot_oc.fm_static_eprm_bitfield.Sbx_rdn_xxx ECU_ADDRESS 0xd0005760 BIT_MASK 0x10 /end MEASUREMENT
/begin MEASUREMENT Sbx_mf_lbup_hot_oc "" UBYTE _CNV_A_R_A_105_CM 1 0. 0. 255. DISPLAY_IDENTIFIER fm_sta_eprm_lbup_hot_oc.fm_static_eprm_bitfield.Sbx_mf_xxx ECU_ADDRESS 0xd0005760 BIT_MASK 0x20 /end MEASUREMENT
/begin MEASUREMENT Sbx_cf_lbup_hot_oc "" UBYTE _CNV_A_R_A_105_CM 1 0. 0. 255. DISPLAY_IDENTIFIER fm_sta_eprm_lbup_hot_oc.fm_static_eprm_bitfield.Sbx_cf_xxx ECU_ADDRESS 0xd0005760 BIT_MASK 0x80 /end MEASUREMENT
/begin MEASUREMENT Sbx_dyn_lbup_hot_scg "" UBYTE _CNV_A_R_A_105_CM 1 0. 0. 255. DISPLAY_IDENTIFIER fm_sta_eprm_lbup_hot_scg.fm_static_eprm_bitfield.Sbx_dyn_xxx ECU_ADDRESS 0xd0005762 BIT_MASK 0x8 /end MEASUREMENT
/begin MEASUREMENT Sbx_rdn_lbup_hot_scg "" UBYTE _CNV_A_R_A_105_CM 1 0. 0. 255. DISPLAY_IDENTIFIER fm_sta_eprm_lbup_hot_scg.fm_static_eprm_bitfield.Sbx_rdn_xxx ECU_ADDRESS 0xd0005762 BIT_MASK 0x10 /end MEASUREMENT
/begin MEASUREMENT Sbx_mf_lbup_hot_scg "" UBYTE _CNV_A_R_A_105_CM 1 0. 0. 255. DISPLAY_IDENTIFIER fm_sta_eprm_lbup_hot_scg.fm_static_eprm_bitfield.Sbx_mf_xxx ECU_ADDRESS 0xd0005762 BIT_MASK 0x20 /end MEASUREMENT
/begin MEASUREMENT Sbx_cf_lbup_hot_scg "" UBYTE _CNV_A_R_A_105_CM 1 0. 0. 255. DISPLAY_IDENTIFIER fm_sta_eprm_lbup_hot_scg.fm_static_eprm_bitfield.Sbx_cf_xxx ECU_ADDRESS 0xd0005762 BIT_MASK 0x80 /end MEASUREMENT
/begin MEASUREMENT Sbx_dyn_lbup_hot_scw "" UBYTE _CNV_A_R_A_105_CM 1 0. 0. 255. DISPLAY_IDENTIFIER fm_sta_eprm_lbup_hot_scw.fm_static_eprm_bitfield.Sbx_dyn_xxx ECU_ADDRESS 0xd0005764 BIT_MASK 0x8 /end MEASUREMENT
/begin MEASUREMENT Sbx_rdn_lbup_hot_scw "" UBYTE _CNV_A_R_A_105_CM 1 0. 0. 255. DISPLAY_IDENTIFIER fm_sta_eprm_lbup_hot_scw.fm_static_eprm_bitfield.Sbx_rdn_xxx ECU_ADDRESS 0xd0005764 BIT_MASK 0x10 /end MEASUREMENT
/begin MEASUREMENT Sbx_mf_lbup_hot_scw "" UBYTE _CNV_A_R_A_105_CM 1 0. 0. 255. DISPLAY_IDENTIFIER fm_sta_eprm_lbup_hot_scw.fm_static_eprm_bitfield.Sbx_mf_xxx ECU_ADDRESS 0xd0005764 BIT_MASK 0x20 /end MEASUREMENT
/begin MEASUREMENT Sbx_cf_lbup_hot_scw "" UBYTE _CNV_A_R_A_105_CM 1 0. 0. 255. DISPLAY_IDENTIFIER fm_sta_eprm_lbup_hot_scw.fm_static_eprm_bitfield.Sbx_cf_xxx ECU_ADDRESS 0xd0005764 BIT_MASK 0x80 /end MEASUREMENT
/begin MEASUREMENT Sbx_dyn_lbup_nok "" UBYTE _CNV_A_R_A_105_CM 1 0. 0. 255. DISPLAY_IDENTIFIER fm_sta_eprm_lbup_nok.fm_static_eprm_bitfield.Sbx_dyn_xxx ECU_ADDRESS 0xd000580a BIT_MASK 0x8 /end MEASUREMENT
/begin MEASUREMENT Sbx_rdn_lbup_nok "" UBYTE _CNV_A_R_A_105_CM 1 0. 0. 255. DISPLAY_IDENTIFIER fm_sta_eprm_lbup_nok.fm_static_eprm_bitfield.Sbx_rdn_xxx ECU_ADDRESS 0xd000580a BIT_MASK 0x10 /end MEASUREMENT
/begin MEASUREMENT Sbx_mf_lbup_nok "" UBYTE _CNV_A_R_A_105_CM 1 0. 0. 255. DISPLAY_IDENTIFIER fm_sta_eprm_lbup_nok.fm_static_eprm_bitfield.Sbx_mf_xxx ECU_ADDRESS 0xd000580a BIT_MASK 0x20 /end MEASUREMENT
/begin MEASUREMENT Sbx_cf_lbup_nok "" UBYTE _CNV_A_R_A_105_CM 1 0. 0. 255. DISPLAY_IDENTIFIER fm_sta_eprm_lbup_nok.fm_static_eprm_bitfield.Sbx_cf_xxx ECU_ADDRESS 0xd000580a BIT_MASK 0x80 /end MEASUREMENT
/begin MEASUREMENT Sbx_dyn_lbup_oc "" UBYTE _CNV_A_R_A_105_CM 1 0. 0. 255. DISPLAY_IDENTIFIER fm_sta_eprm_lbup_oc.fm_static_eprm_bitfield.Sbx_dyn_xxx ECU_ADDRESS 0xd0005706 BIT_MASK 0x8 /end MEASUREMENT
/begin MEASUREMENT Sbx_rdn_lbup_oc "" UBYTE _CNV_A_R_A_105_CM 1 0. 0. 255. DISPLAY_IDENTIFIER fm_sta_eprm_lbup_oc.fm_static_eprm_bitfield.Sbx_rdn_xxx ECU_ADDRESS 0xd0005706 BIT_MASK 0x10 /end MEASUREMENT
/begin MEASUREMENT Sbx_mf_lbup_oc "" UBYTE _CNV_A_R_A_105_CM 1 0. 0. 255. DISPLAY_IDENTIFIER fm_sta_eprm_lbup_oc.fm_static_eprm_bitfield.Sbx_mf_xxx ECU_ADDRESS 0xd0005706 BIT_MASK 0x20 /end MEASUREMENT
/begin MEASUREMENT Sbx_cf_lbup_oc "" UBYTE _CNV_A_R_A_105_CM 1 0. 0. 255. DISPLAY_IDENTIFIER fm_sta_eprm_lbup_oc.fm_static_eprm_bitfield.Sbx_cf_xxx ECU_ADDRESS 0xd0005706 BIT_MASK 0x80 /end MEASUREMENT
/begin MEASUREMENT Sbx_dyn_lbup_scg "" UBYTE _CNV_A_R_A_105_CM 1 0. 0. 255. DISPLAY_IDENTIFIER fm_sta_eprm_lbup_scg.fm_static_eprm_bitfield.Sbx_dyn_xxx ECU_ADDRESS 0xd0005708 BIT_MASK 0x8 /end MEASUREMENT
/begin MEASUREMENT Sbx_rdn_lbup_scg "" UBYTE _CNV_A_R_A_105_CM 1 0. 0. 255. DISPLAY_IDENTIFIER fm_sta_eprm_lbup_scg.fm_static_eprm_bitfield.Sbx_rdn_xxx ECU_ADDRESS 0xd0005708 BIT_MASK 0x10 /end MEASUREMENT
/begin MEASUREMENT Sbx_mf_lbup_scg "" UBYTE _CNV_A_R_A_105_CM 1 0. 0. 255. DISPLAY_IDENTIFIER fm_sta_eprm_lbup_scg.fm_static_eprm_bitfield.Sbx_mf_xxx ECU_ADDRESS 0xd0005708 BIT_MASK 0x20 /end MEASUREMENT
/begin MEASUREMENT Sbx_cf_lbup_scg "" UBYTE _CNV_A_R_A_105_CM 1 0. 0. 255. DISPLAY_IDENTIFIER fm_sta_eprm_lbup_scg.fm_static_eprm_bitfield.Sbx_cf_xxx ECU_ADDRESS 0xd0005708 BIT_MASK 0x80 /end MEASUREMENT
/begin MEASUREMENT Sbx_dyn_lbup_scw "" UBYTE _CNV_A_R_A_105_CM 1 0. 0. 255. DISPLAY_IDENTIFIER fm_sta_eprm_lbup_scw.fm_static_eprm_bitfield.Sbx_dyn_xxx ECU_ADDRESS 0xd000570a BIT_MASK 0x8 /end MEASUREMENT
/begin MEASUREMENT Sbx_rdn_lbup_scw "" UBYTE _CNV_A_R_A_105_CM 1 0. 0. 255. DISPLAY_IDENTIFIER fm_sta_eprm_lbup_scw.fm_static_eprm_bitfield.Sbx_rdn_xxx ECU_ADDRESS 0xd000570a BIT_MASK 0x10 /end MEASUREMENT
/begin MEASUREMENT Sbx_mf_lbup_scw "" UBYTE _CNV_A_R_A_105_CM 1 0. 0. 255. DISPLAY_IDENTIFIER fm_sta_eprm_lbup_scw.fm_static_eprm_bitfield.Sbx_mf_xxx ECU_ADDRESS 0xd000570a BIT_MASK 0x20 /end MEASUREMENT
/begin MEASUREMENT Sbx_cf_lbup_scw "" UBYTE _CNV_A_R_A_105_CM 1 0. 0. 255. DISPLAY_IDENTIFIER fm_sta_eprm_lbup_scw.fm_static_eprm_bitfield.Sbx_cf_xxx ECU_ADDRESS 0xd000570a BIT_MASK 0x80 /end MEASUREMENT
/begin MEASUREMENT Sbx_dyn_lbup_shf_h "" UBYTE _CNV_A_R_A_105_CM 1 0. 0. 255. DISPLAY_IDENTIFIER fm_sta_eprm_lbup_shf_h.fm_static_eprm_bitfield.Sbx_dyn_xxx ECU_ADDRESS 0xd0005838 BIT_MASK 0x8 /end MEASUREMENT
/begin MEASUREMENT Sbx_rdn_lbup_shf_h "" UBYTE _CNV_A_R_A_105_CM 1 0. 0. 255. DISPLAY_IDENTIFIER fm_sta_eprm_lbup_shf_h.fm_static_eprm_bitfield.Sbx_rdn_xxx ECU_ADDRESS 0xd0005838 BIT_MASK 0x10 /end MEASUREMENT
/begin MEASUREMENT Sbx_mf_lbup_shf_h "" UBYTE _CNV_A_R_A_105_CM 1 0. 0. 255. DISPLAY_IDENTIFIER fm_sta_eprm_lbup_shf_h.fm_static_eprm_bitfield.Sbx_mf_xxx ECU_ADDRESS 0xd0005838 BIT_MASK 0x20 /end MEASUREMENT
/begin MEASUREMENT Sbx_cf_lbup_shf_h "" UBYTE _CNV_A_R_A_105_CM 1 0. 0. 255. DISPLAY_IDENTIFIER fm_sta_eprm_lbup_shf_h.fm_static_eprm_bitfield.Sbx_cf_xxx ECU_ADDRESS 0xd0005838 BIT_MASK 0x80 /end MEASUREMENT
/begin MEASUREMENT Sbx_dyn_lbup_shf_l "" UBYTE _CNV_A_R_A_105_CM 1 0. 0. 255. DISPLAY_IDENTIFIER fm_sta_eprm_lbup_shf_l.fm_static_eprm_bitfield.Sbx_dyn_xxx ECU_ADDRESS 0xd000583a BIT_MASK 0x8 /end MEASUREMENT
/begin MEASUREMENT Sbx_rdn_lbup_shf_l "" UBYTE _CNV_A_R_A_105_CM 1 0. 0. 255. DISPLAY_IDENTIFIER fm_sta_eprm_lbup_shf_l.fm_static_eprm_bitfield.Sbx_rdn_xxx ECU_ADDRESS 0xd000583a BIT_MASK 0x10 /end MEASUREMENT
/begin MEASUREMENT Sbx_mf_lbup_shf_l "" UBYTE _CNV_A_R_A_105_CM 1 0. 0. 255. DISPLAY_IDENTIFIER fm_sta_eprm_lbup_shf_l.fm_static_eprm_bitfield.Sbx_mf_xxx ECU_ADDRESS 0xd000583a BIT_MASK 0x20 /end MEASUREMENT
/begin MEASUREMENT Sbx_cf_lbup_shf_l "" UBYTE _CNV_A_R_A_105_CM 1 0. 0. 255. DISPLAY_IDENTIFIER fm_sta_eprm_lbup_shf_l.fm_static_eprm_bitfield.Sbx_cf_xxx ECU_ADDRESS 0xd000583a BIT_MASK 0x80 /end MEASUREMENT
/begin MEASUREMENT Sbx_dyn_map_chr "" UBYTE _CNV_A_R_A_105_CM 1 0. 0. 255. DISPLAY_IDENTIFIER fm_sta_eprm_map_chr.fm_static_eprm_bitfield.Sbx_dyn_xxx ECU_ADDRESS 0xd0005766 BIT_MASK 0x8 /end MEASUREMENT
/begin MEASUREMENT Sbx_rdn_map_chr "" UBYTE _CNV_A_R_A_105_CM 1 0. 0. 255. DISPLAY_IDENTIFIER fm_sta_eprm_map_chr.fm_static_eprm_bitfield.Sbx_rdn_xxx ECU_ADDRESS 0xd0005766 BIT_MASK 0x10 /end MEASUREMENT
/begin MEASUREMENT Sbx_mf_map_chr "" UBYTE _CNV_A_R_A_105_CM 1 0. 0. 255. DISPLAY_IDENTIFIER fm_sta_eprm_map_chr.fm_static_eprm_bitfield.Sbx_mf_xxx ECU_ADDRESS 0xd0005766 BIT_MASK 0x20 /end MEASUREMENT
/begin MEASUREMENT Sbx_cf_map_chr "" UBYTE _CNV_A_R_A_105_CM 1 0. 0. 255. DISPLAY_IDENTIFIER fm_sta_eprm_map_chr.fm_static_eprm_bitfield.Sbx_cf_xxx ECU_ADDRESS 0xd0005766 BIT_MASK 0x80 /end MEASUREMENT
/begin MEASUREMENT Sbx_dyn_map_oor "" UBYTE _CNV_A_R_A_105_CM 1 0. 0. 255. DISPLAY_IDENTIFIER fm_sta_eprm_map_oor.fm_static_eprm_bitfield.Sbx_dyn_xxx ECU_ADDRESS 0xd0005768 BIT_MASK 0x8 /end MEASUREMENT
/begin MEASUREMENT Sbx_rdn_map_oor "" UBYTE _CNV_A_R_A_105_CM 1 0. 0. 255. DISPLAY_IDENTIFIER fm_sta_eprm_map_oor.fm_static_eprm_bitfield.Sbx_rdn_xxx ECU_ADDRESS 0xd0005768 BIT_MASK 0x10 /end MEASUREMENT
/begin MEASUREMENT Sbx_mf_map_oor "" UBYTE _CNV_A_R_A_105_CM 1 0. 0. 255. DISPLAY_IDENTIFIER fm_sta_eprm_map_oor.fm_static_eprm_bitfield.Sbx_mf_xxx ECU_ADDRESS 0xd0005768 BIT_MASK 0x20 /end MEASUREMENT
/begin MEASUREMENT Sbx_cf_map_oor "" UBYTE _CNV_A_R_A_105_CM 1 0. 0. 255. DISPLAY_IDENTIFIER fm_sta_eprm_map_oor.fm_static_eprm_bitfield.Sbx_cf_xxx ECU_ADDRESS 0xd0005768 BIT_MASK 0x80 /end MEASUREMENT
/begin MEASUREMENT Sbx_dyn_mis_1_cata "" UBYTE _CNV_A_R_A_105_CM 1 0. 0. 255. DISPLAY_IDENTIFIER fm_sta_eprm_mis_1_cata.fm_static_eprm_bitfield.Sbx_dyn_xxx ECU_ADDRESS 0xd000576a BIT_MASK 0x8 /end MEASUREMENT
/begin MEASUREMENT Sbx_rdn_mis_1_cata "" UBYTE _CNV_A_R_A_105_CM 1 0. 0. 255. DISPLAY_IDENTIFIER fm_sta_eprm_mis_1_cata.fm_static_eprm_bitfield.Sbx_rdn_xxx ECU_ADDRESS 0xd000576a BIT_MASK 0x10 /end MEASUREMENT
/begin MEASUREMENT Sbx_mf_mis_1_cata "" UBYTE _CNV_A_R_A_105_CM 1 0. 0. 255. DISPLAY_IDENTIFIER fm_sta_eprm_mis_1_cata.fm_static_eprm_bitfield.Sbx_mf_xxx ECU_ADDRESS 0xd000576a BIT_MASK 0x20 /end MEASUREMENT
/begin MEASUREMENT Sbx_cf_mis_1_cata "" UBYTE _CNV_A_R_A_105_CM 1 0. 0. 255. DISPLAY_IDENTIFIER fm_sta_eprm_mis_1_cata.fm_static_eprm_bitfield.Sbx_cf_xxx ECU_ADDRESS 0xd000576a BIT_MASK 0x80 /end MEASUREMENT
/begin MEASUREMENT Sbx_dyn_mis_1_lpg_cata "" UBYTE _CNV_A_R_A_105_CM 1 0. 0. 255. DISPLAY_IDENTIFIER fm_sta_eprm_mis_1_lpg_cata.fm_static_eprm_bitfield.Sbx_dyn_xxx ECU_ADDRESS 0xd000576c BIT_MASK 0x8 /end MEASUREMENT
/begin MEASUREMENT Sbx_rdn_mis_1_lpg_cata "" UBYTE _CNV_A_R_A_105_CM 1 0. 0. 255. DISPLAY_IDENTIFIER fm_sta_eprm_mis_1_lpg_cata.fm_static_eprm_bitfield.Sbx_rdn_xxx ECU_ADDRESS 0xd000576c BIT_MASK 0x10 /end MEASUREMENT
/begin MEASUREMENT Sbx_mf_mis_1_lpg_cata "" UBYTE _CNV_A_R_A_105_CM 1 0. 0. 255. DISPLAY_IDENTIFIER fm_sta_eprm_mis_1_lpg_cata.fm_static_eprm_bitfield.Sbx_mf_xxx ECU_ADDRESS 0xd000576c BIT_MASK 0x20 /end MEASUREMENT
/begin MEASUREMENT Sbx_cf_mis_1_lpg_cata "" UBYTE _CNV_A_R_A_105_CM 1 0. 0. 255. DISPLAY_IDENTIFIER fm_sta_eprm_mis_1_lpg_cata.fm_static_eprm_bitfield.Sbx_cf_xxx ECU_ADDRESS 0xd000576c BIT_MASK 0x80 /end MEASUREMENT
/begin MEASUREMENT Sbx_dyn_mis_1_lpg_trs_h "" UBYTE _CNV_A_R_A_105_CM 1 0. 0. 255. DISPLAY_IDENTIFIER fm_sta_eprm_mis_1_lpg_trs_h.fm_static_eprm_bitfield.Sbx_dyn_xxx ECU_ADDRESS 0xd000576e BIT_MASK 0x8 /end MEASUREMENT
/begin MEASUREMENT Sbx_rdn_mis_1_lpg_trs_h "" UBYTE _CNV_A_R_A_105_CM 1 0. 0. 255. DISPLAY_IDENTIFIER fm_sta_eprm_mis_1_lpg_trs_h.fm_static_eprm_bitfield.Sbx_rdn_xxx ECU_ADDRESS 0xd000576e BIT_MASK 0x10 /end MEASUREMENT
/begin MEASUREMENT Sbx_mf_mis_1_lpg_trs_h "" UBYTE _CNV_A_R_A_105_CM 1 0. 0. 255. DISPLAY_IDENTIFIER fm_sta_eprm_mis_1_lpg_trs_h.fm_static_eprm_bitfield.Sbx_mf_xxx ECU_ADDRESS 0xd000576e BIT_MASK 0x20 /end MEASUREMENT
/begin MEASUREMENT Sbx_cf_mis_1_lpg_trs_h "" UBYTE _CNV_A_R_A_105_CM 1 0. 0. 255. DISPLAY_IDENTIFIER fm_sta_eprm_mis_1_lpg_trs_h.fm_static_eprm_bitfield.Sbx_cf_xxx ECU_ADDRESS 0xd000576e BIT_MASK 0x80 /end MEASUREMENT
/begin MEASUREMENT Sbx_dyn_mis_1_trs_h "" UBYTE _CNV_A_R_A_105_CM 1 0. 0. 255. DISPLAY_IDENTIFIER fm_sta_eprm_mis_1_trs_h.fm_static_eprm_bitfield.Sbx_dyn_xxx ECU_ADDRESS 0xd0005770 BIT_MASK 0x8 /end MEASUREMENT
/begin MEASUREMENT Sbx_rdn_mis_1_trs_h "" UBYTE _CNV_A_R_A_105_CM 1 0. 0. 255. DISPLAY_IDENTIFIER fm_sta_eprm_mis_1_trs_h.fm_static_eprm_bitfield.Sbx_rdn_xxx ECU_ADDRESS 0xd0005770 BIT_MASK 0x10 /end MEASUREMENT
/begin MEASUREMENT Sbx_mf_mis_1_trs_h "" UBYTE _CNV_A_R_A_105_CM 1 0. 0. 255. DISPLAY_IDENTIFIER fm_sta_eprm_mis_1_trs_h.fm_static_eprm_bitfield.Sbx_mf_xxx ECU_ADDRESS 0xd0005770 BIT_MASK 0x20 /end MEASUREMENT
/begin MEASUREMENT Sbx_cf_mis_1_trs_h "" UBYTE _CNV_A_R_A_105_CM 1 0. 0. 255. DISPLAY_IDENTIFIER fm_sta_eprm_mis_1_trs_h.fm_static_eprm_bitfield.Sbx_cf_xxx ECU_ADDRESS 0xd0005770 BIT_MASK 0x80 /end MEASUREMENT
/begin MEASUREMENT Sbx_dyn_mis_2_cata "" UBYTE _CNV_A_R_A_105_CM 1 0. 0. 255. DISPLAY_IDENTIFIER fm_sta_eprm_mis_2_cata.fm_static_eprm_bitfield.Sbx_dyn_xxx ECU_ADDRESS 0xd0005772 BIT_MASK 0x8 /end MEASUREMENT
/begin MEASUREMENT Sbx_rdn_mis_2_cata "" UBYTE _CNV_A_R_A_105_CM 1 0. 0. 255. DISPLAY_IDENTIFIER fm_sta_eprm_mis_2_cata.fm_static_eprm_bitfield.Sbx_rdn_xxx ECU_ADDRESS 0xd0005772 BIT_MASK 0x10 /end MEASUREMENT
/begin MEASUREMENT Sbx_mf_mis_2_cata "" UBYTE _CNV_A_R_A_105_CM 1 0. 0. 255. DISPLAY_IDENTIFIER fm_sta_eprm_mis_2_cata.fm_static_eprm_bitfield.Sbx_mf_xxx ECU_ADDRESS 0xd0005772 BIT_MASK 0x20 /end MEASUREMENT
/begin MEASUREMENT Sbx_cf_mis_2_cata "" UBYTE _CNV_A_R_A_105_CM 1 0. 0. 255. DISPLAY_IDENTIFIER fm_sta_eprm_mis_2_cata.fm_static_eprm_bitfield.Sbx_cf_xxx ECU_ADDRESS 0xd0005772 BIT_MASK 0x80 /end MEASUREMENT
/begin MEASUREMENT Sbx_dyn_mis_2_lpg_cata "" UBYTE _CNV_A_R_A_105_CM 1 0. 0. 255. DISPLAY_IDENTIFIER fm_sta_eprm_mis_2_lpg_cata.fm_static_eprm_bitfield.Sbx_dyn_xxx ECU_ADDRESS 0xd0005774 BIT_MASK 0x8 /end MEASUREMENT
/begin MEASUREMENT Sbx_rdn_mis_2_lpg_cata "" UBYTE _CNV_A_R_A_105_CM 1 0. 0. 255. DISPLAY_IDENTIFIER fm_sta_eprm_mis_2_lpg_cata.fm_static_eprm_bitfield.Sbx_rdn_xxx ECU_ADDRESS 0xd0005774 BIT_MASK 0x10 /end MEASUREMENT
/begin MEASUREMENT Sbx_mf_mis_2_lpg_cata "" UBYTE _CNV_A_R_A_105_CM 1 0. 0. 255. DISPLAY_IDENTIFIER fm_sta_eprm_mis_2_lpg_cata.fm_static_eprm_bitfield.Sbx_mf_xxx ECU_ADDRESS 0xd0005774 BIT_MASK 0x20 /end MEASUREMENT
/begin MEASUREMENT Sbx_cf_mis_2_lpg_cata "" UBYTE _CNV_A_R_A_105_CM 1 0. 0. 255. DISPLAY_IDENTIFIER fm_sta_eprm_mis_2_lpg_cata.fm_static_eprm_bitfield.Sbx_cf_xxx ECU_ADDRESS 0xd0005774 BIT_MASK 0x80 /end MEASUREMENT
/begin MEASUREMENT Sbx_dyn_mis_2_lpg_trs_h "" UBYTE _CNV_A_R_A_105_CM 1 0. 0. 255. DISPLAY_IDENTIFIER fm_sta_eprm_mis_2_lpg_trs_h.fm_static_eprm_bitfield.Sbx_dyn_xxx ECU_ADDRESS 0xd0005776 BIT_MASK 0x8 /end MEASUREMENT
/begin MEASUREMENT Sbx_rdn_mis_2_lpg_trs_h "" UBYTE _CNV_A_R_A_105_CM 1 0. 0. 255. DISPLAY_IDENTIFIER fm_sta_eprm_mis_2_lpg_trs_h.fm_static_eprm_bitfield.Sbx_rdn_xxx ECU_ADDRESS 0xd0005776 BIT_MASK 0x10 /end MEASUREMENT
/begin MEASUREMENT Sbx_mf_mis_2_lpg_trs_h "" UBYTE _CNV_A_R_A_105_CM 1 0. 0. 255. DISPLAY_IDENTIFIER fm_sta_eprm_mis_2_lpg_trs_h.fm_static_eprm_bitfield.Sbx_mf_xxx ECU_ADDRESS 0xd0005776 BIT_MASK 0x20 /end MEASUREMENT
/begin MEASUREMENT Sbx_cf_mis_2_lpg_trs_h "" UBYTE _CNV_A_R_A_105_CM 1 0. 0. 255. DISPLAY_IDENTIFIER fm_sta_eprm_mis_2_lpg_trs_h.fm_static_eprm_bitfield.Sbx_cf_xxx ECU_ADDRESS 0xd0005776 BIT_MASK 0x80 /end MEASUREMENT
/begin MEASUREMENT Sbx_dyn_mis_2_trs_h "" UBYTE _CNV_A_R_A_105_CM 1 0. 0. 255. DISPLAY_IDENTIFIER fm_sta_eprm_mis_2_trs_h.fm_static_eprm_bitfield.Sbx_dyn_xxx ECU_ADDRESS 0xd0005778 BIT_MASK 0x8 /end MEASUREMENT
/begin MEASUREMENT Sbx_rdn_mis_2_trs_h "" UBYTE _CNV_A_R_A_105_CM 1 0. 0. 255. DISPLAY_IDENTIFIER fm_sta_eprm_mis_2_trs_h.fm_static_eprm_bitfield.Sbx_rdn_xxx ECU_ADDRESS 0xd0005778 BIT_MASK 0x10 /end MEASUREMENT
/begin MEASUREMENT Sbx_mf_mis_2_trs_h "" UBYTE _CNV_A_R_A_105_CM 1 0. 0. 255. DISPLAY_IDENTIFIER fm_sta_eprm_mis_2_trs_h.fm_static_eprm_bitfield.Sbx_mf_xxx ECU_ADDRESS 0xd0005778 BIT_MASK 0x20 /end MEASUREMENT
/begin MEASUREMENT Sbx_cf_mis_2_trs_h "" UBYTE _CNV_A_R_A_105_CM 1 0. 0. 255. DISPLAY_IDENTIFIER fm_sta_eprm_mis_2_trs_h.fm_static_eprm_bitfield.Sbx_cf_xxx ECU_ADDRESS 0xd0005778 BIT_MASK 0x80 /end MEASUREMENT
/begin MEASUREMENT Sbx_dyn_mis_3_cata "" UBYTE _CNV_A_R_A_105_CM 1 0. 0. 255. DISPLAY_IDENTIFIER fm_sta_eprm_mis_3_cata.fm_static_eprm_bitfield.Sbx_dyn_xxx ECU_ADDRESS 0xd000577a BIT_MASK 0x8 /end MEASUREMENT
/begin MEASUREMENT Sbx_rdn_mis_3_cata "" UBYTE _CNV_A_R_A_105_CM 1 0. 0. 255. DISPLAY_IDENTIFIER fm_sta_eprm_mis_3_cata.fm_static_eprm_bitfield.Sbx_rdn_xxx ECU_ADDRESS 0xd000577a BIT_MASK 0x10 /end MEASUREMENT
/begin MEASUREMENT Sbx_mf_mis_3_cata "" UBYTE _CNV_A_R_A_105_CM 1 0. 0. 255. DISPLAY_IDENTIFIER fm_sta_eprm_mis_3_cata.fm_static_eprm_bitfield.Sbx_mf_xxx ECU_ADDRESS 0xd000577a BIT_MASK 0x20 /end MEASUREMENT
/begin MEASUREMENT Sbx_cf_mis_3_cata "" UBYTE _CNV_A_R_A_105_CM 1 0. 0. 255. DISPLAY_IDENTIFIER fm_sta_eprm_mis_3_cata.fm_static_eprm_bitfield.Sbx_cf_xxx ECU_ADDRESS 0xd000577a BIT_MASK 0x80 /end MEASUREMENT
/begin MEASUREMENT Sbx_dyn_mis_3_lpg_cata "" UBYTE _CNV_A_R_A_105_CM 1 0. 0. 255. DISPLAY_IDENTIFIER fm_sta_eprm_mis_3_lpg_cata.fm_static_eprm_bitfield.Sbx_dyn_xxx ECU_ADDRESS 0xd000577c BIT_MASK 0x8 /end MEASUREMENT
/begin MEASUREMENT Sbx_rdn_mis_3_lpg_cata "" UBYTE _CNV_A_R_A_105_CM 1 0. 0. 255. DISPLAY_IDENTIFIER fm_sta_eprm_mis_3_lpg_cata.fm_static_eprm_bitfield.Sbx_rdn_xxx ECU_ADDRESS 0xd000577c BIT_MASK 0x10 /end MEASUREMENT
/begin MEASUREMENT Sbx_mf_mis_3_lpg_cata "" UBYTE _CNV_A_R_A_105_CM 1 0. 0. 255. DISPLAY_IDENTIFIER fm_sta_eprm_mis_3_lpg_cata.fm_static_eprm_bitfield.Sbx_mf_xxx ECU_ADDRESS 0xd000577c BIT_MASK 0x20 /end MEASUREMENT
/begin MEASUREMENT Sbx_cf_mis_3_lpg_cata "" UBYTE _CNV_A_R_A_105_CM 1 0. 0. 255. DISPLAY_IDENTIFIER fm_sta_eprm_mis_3_lpg_cata.fm_static_eprm_bitfield.Sbx_cf_xxx ECU_ADDRESS 0xd000577c BIT_MASK 0x80 /end MEASUREMENT
/begin MEASUREMENT Sbx_dyn_mis_3_lpg_trs_h "" UBYTE _CNV_A_R_A_105_CM 1 0. 0. 255. DISPLAY_IDENTIFIER fm_sta_eprm_mis_3_lpg_trs_h.fm_static_eprm_bitfield.Sbx_dyn_xxx ECU_ADDRESS 0xd000577e BIT_MASK 0x8 /end MEASUREMENT
/begin MEASUREMENT Sbx_rdn_mis_3_lpg_trs_h "" UBYTE _CNV_A_R_A_105_CM 1 0. 0. 255. DISPLAY_IDENTIFIER fm_sta_eprm_mis_3_lpg_trs_h.fm_static_eprm_bitfield.Sbx_rdn_xxx ECU_ADDRESS 0xd000577e BIT_MASK 0x10 /end MEASUREMENT
/begin MEASUREMENT Sbx_mf_mis_3_lpg_trs_h "" UBYTE _CNV_A_R_A_105_CM 1 0. 0. 255. DISPLAY_IDENTIFIER fm_sta_eprm_mis_3_lpg_trs_h.fm_static_eprm_bitfield.Sbx_mf_xxx ECU_ADDRESS 0xd000577e BIT_MASK 0x20 /end MEASUREMENT
/begin MEASUREMENT Sbx_cf_mis_3_lpg_trs_h "" UBYTE _CNV_A_R_A_105_CM 1 0. 0. 255. DISPLAY_IDENTIFIER fm_sta_eprm_mis_3_lpg_trs_h.fm_static_eprm_bitfield.Sbx_cf_xxx ECU_ADDRESS 0xd000577e BIT_MASK 0x80 /end MEASUREMENT
/begin MEASUREMENT Sbx_dyn_mis_3_trs_h "" UBYTE _CNV_A_R_A_105_CM 1 0. 0. 255. DISPLAY_IDENTIFIER fm_sta_eprm_mis_3_trs_h.fm_static_eprm_bitfield.Sbx_dyn_xxx ECU_ADDRESS 0xd0005780 BIT_MASK 0x8 /end MEASUREMENT
/begin MEASUREMENT Sbx_rdn_mis_3_trs_h "" UBYTE _CNV_A_R_A_105_CM 1 0. 0. 255. DISPLAY_IDENTIFIER fm_sta_eprm_mis_3_trs_h.fm_static_eprm_bitfield.Sbx_rdn_xxx ECU_ADDRESS 0xd0005780 BIT_MASK 0x10 /end MEASUREMENT
/begin MEASUREMENT Sbx_mf_mis_3_trs_h "" UBYTE _CNV_A_R_A_105_CM 1 0. 0. 255. DISPLAY_IDENTIFIER fm_sta_eprm_mis_3_trs_h.fm_static_eprm_bitfield.Sbx_mf_xxx ECU_ADDRESS 0xd0005780 BIT_MASK 0x20 /end MEASUREMENT
/begin MEASUREMENT Sbx_cf_mis_3_trs_h "" UBYTE _CNV_A_R_A_105_CM 1 0. 0. 255. DISPLAY_IDENTIFIER fm_sta_eprm_mis_3_trs_h.fm_static_eprm_bitfield.Sbx_cf_xxx ECU_ADDRESS 0xd0005780 BIT_MASK 0x80 /end MEASUREMENT
/begin MEASUREMENT Sbx_dyn_mis_4_cata "" UBYTE _CNV_A_R_A_105_CM 1 0. 0. 255. DISPLAY_IDENTIFIER fm_sta_eprm_mis_4_cata.fm_static_eprm_bitfield.Sbx_dyn_xxx ECU_ADDRESS 0xd0005782 BIT_MASK 0x8 /end MEASUREMENT
/begin MEASUREMENT Sbx_rdn_mis_4_cata "" UBYTE _CNV_A_R_A_105_CM 1 0. 0. 255. DISPLAY_IDENTIFIER fm_sta_eprm_mis_4_cata.fm_static_eprm_bitfield.Sbx_rdn_xxx ECU_ADDRESS 0xd0005782 BIT_MASK 0x10 /end MEASUREMENT
/begin MEASUREMENT Sbx_mf_mis_4_cata "" UBYTE _CNV_A_R_A_105_CM 1 0. 0. 255. DISPLAY_IDENTIFIER fm_sta_eprm_mis_4_cata.fm_static_eprm_bitfield.Sbx_mf_xxx ECU_ADDRESS 0xd0005782 BIT_MASK 0x20 /end MEASUREMENT
/begin MEASUREMENT Sbx_cf_mis_4_cata "" UBYTE _CNV_A_R_A_105_CM 1 0. 0. 255. DISPLAY_IDENTIFIER fm_sta_eprm_mis_4_cata.fm_static_eprm_bitfield.Sbx_cf_xxx ECU_ADDRESS 0xd0005782 BIT_MASK 0x80 /end MEASUREMENT
/begin MEASUREMENT Sbx_dyn_mis_4_lpg_cata "" UBYTE _CNV_A_R_A_105_CM 1 0. 0. 255. DISPLAY_IDENTIFIER fm_sta_eprm_mis_4_lpg_cata.fm_static_eprm_bitfield.Sbx_dyn_xxx ECU_ADDRESS 0xd0005784 BIT_MASK 0x8 /end MEASUREMENT
/begin MEASUREMENT Sbx_rdn_mis_4_lpg_cata "" UBYTE _CNV_A_R_A_105_CM 1 0. 0. 255. DISPLAY_IDENTIFIER fm_sta_eprm_mis_4_lpg_cata.fm_static_eprm_bitfield.Sbx_rdn_xxx ECU_ADDRESS 0xd0005784 BIT_MASK 0x10 /end MEASUREMENT
/begin MEASUREMENT Sbx_mf_mis_4_lpg_cata "" UBYTE _CNV_A_R_A_105_CM 1 0. 0. 255. DISPLAY_IDENTIFIER fm_sta_eprm_mis_4_lpg_cata.fm_static_eprm_bitfield.Sbx_mf_xxx ECU_ADDRESS 0xd0005784 BIT_MASK 0x20 /end MEASUREMENT
/begin MEASUREMENT Sbx_cf_mis_4_lpg_cata "" UBYTE _CNV_A_R_A_105_CM 1 0. 0. 255. DISPLAY_IDENTIFIER fm_sta_eprm_mis_4_lpg_cata.fm_static_eprm_bitfield.Sbx_cf_xxx ECU_ADDRESS 0xd0005784 BIT_MASK 0x80 /end MEASUREMENT
/begin MEASUREMENT Sbx_dyn_mis_4_lpg_trs_h "" UBYTE _CNV_A_R_A_105_CM 1 0. 0. 255. DISPLAY_IDENTIFIER fm_sta_eprm_mis_4_lpg_trs_h.fm_static_eprm_bitfield.Sbx_dyn_xxx ECU_ADDRESS 0xd0005786 BIT_MASK 0x8 /end MEASUREMENT
/begin MEASUREMENT Sbx_rdn_mis_4_lpg_trs_h "" UBYTE _CNV_A_R_A_105_CM 1 0. 0. 255. DISPLAY_IDENTIFIER fm_sta_eprm_mis_4_lpg_trs_h.fm_static_eprm_bitfield.Sbx_rdn_xxx ECU_ADDRESS 0xd0005786 BIT_MASK 0x10 /end MEASUREMENT
/begin MEASUREMENT Sbx_mf_mis_4_lpg_trs_h "" UBYTE _CNV_A_R_A_105_CM 1 0. 0. 255. DISPLAY_IDENTIFIER fm_sta_eprm_mis_4_lpg_trs_h.fm_static_eprm_bitfield.Sbx_mf_xxx ECU_ADDRESS 0xd0005786 BIT_MASK 0x20 /end MEASUREMENT
/begin MEASUREMENT Sbx_cf_mis_4_lpg_trs_h "" UBYTE _CNV_A_R_A_105_CM 1 0. 0. 255. DISPLAY_IDENTIFIER fm_sta_eprm_mis_4_lpg_trs_h.fm_static_eprm_bitfield.Sbx_cf_xxx ECU_ADDRESS 0xd0005786 BIT_MASK 0x80 /end MEASUREMENT
/begin MEASUREMENT Sbx_dyn_mis_4_trs_h "" UBYTE _CNV_A_R_A_105_CM 1 0. 0. 255. DISPLAY_IDENTIFIER fm_sta_eprm_mis_4_trs_h.fm_static_eprm_bitfield.Sbx_dyn_xxx ECU_ADDRESS 0xd0005788 BIT_MASK 0x8 /end MEASUREMENT
/begin MEASUREMENT Sbx_rdn_mis_4_trs_h "" UBYTE _CNV_A_R_A_105_CM 1 0. 0. 255. DISPLAY_IDENTIFIER fm_sta_eprm_mis_4_trs_h.fm_static_eprm_bitfield.Sbx_rdn_xxx ECU_ADDRESS 0xd0005788 BIT_MASK 0x10 /end MEASUREMENT
/begin MEASUREMENT Sbx_mf_mis_4_trs_h "" UBYTE _CNV_A_R_A_105_CM 1 0. 0. 255. DISPLAY_IDENTIFIER fm_sta_eprm_mis_4_trs_h.fm_static_eprm_bitfield.Sbx_mf_xxx ECU_ADDRESS 0xd0005788 BIT_MASK 0x20 /end MEASUREMENT
/begin MEASUREMENT Sbx_cf_mis_4_trs_h "" UBYTE _CNV_A_R_A_105_CM 1 0. 0. 255. DISPLAY_IDENTIFIER fm_sta_eprm_mis_4_trs_h.fm_static_eprm_bitfield.Sbx_cf_xxx ECU_ADDRESS 0xd0005788 BIT_MASK 0x80 /end MEASUREMENT
/begin MEASUREMENT Sbx_dyn_mis_cata "" UBYTE _CNV_A_R_A_105_CM 1 0. 0. 255. DISPLAY_IDENTIFIER fm_sta_eprm_mis_cata.fm_static_eprm_bitfield.Sbx_dyn_xxx ECU_ADDRESS 0xd000578a BIT_MASK 0x8 /end MEASUREMENT
/begin MEASUREMENT Sbx_rdn_mis_cata "" UBYTE _CNV_A_R_A_105_CM 1 0. 0. 255. DISPLAY_IDENTIFIER fm_sta_eprm_mis_cata.fm_static_eprm_bitfield.Sbx_rdn_xxx ECU_ADDRESS 0xd000578a BIT_MASK 0x10 /end MEASUREMENT
/begin MEASUREMENT Sbx_mf_mis_cata "" UBYTE _CNV_A_R_A_105_CM 1 0. 0. 255. DISPLAY_IDENTIFIER fm_sta_eprm_mis_cata.fm_static_eprm_bitfield.Sbx_mf_xxx ECU_ADDRESS 0xd000578a BIT_MASK 0x20 /end MEASUREMENT
/begin MEASUREMENT Sbx_cf_mis_cata "" UBYTE _CNV_A_R_A_105_CM 1 0. 0. 255. DISPLAY_IDENTIFIER fm_sta_eprm_mis_cata.fm_static_eprm_bitfield.Sbx_cf_xxx ECU_ADDRESS 0xd000578a BIT_MASK 0x80 /end MEASUREMENT
/begin MEASUREMENT Sbx_dyn_mis_lpg_cata "" UBYTE _CNV_A_R_A_105_CM 1 0. 0. 255. DISPLAY_IDENTIFIER fm_sta_eprm_mis_lpg_cata.fm_static_eprm_bitfield.Sbx_dyn_xxx ECU_ADDRESS 0xd000578c BIT_MASK 0x8 /end MEASUREMENT
/begin MEASUREMENT Sbx_rdn_mis_lpg_cata "" UBYTE _CNV_A_R_A_105_CM 1 0. 0. 255. DISPLAY_IDENTIFIER fm_sta_eprm_mis_lpg_cata.fm_static_eprm_bitfield.Sbx_rdn_xxx ECU_ADDRESS 0xd000578c BIT_MASK 0x10 /end MEASUREMENT
/begin MEASUREMENT Sbx_mf_mis_lpg_cata "" UBYTE _CNV_A_R_A_105_CM 1 0. 0. 255. DISPLAY_IDENTIFIER fm_sta_eprm_mis_lpg_cata.fm_static_eprm_bitfield.Sbx_mf_xxx ECU_ADDRESS 0xd000578c BIT_MASK 0x20 /end MEASUREMENT
/begin MEASUREMENT Sbx_cf_mis_lpg_cata "" UBYTE _CNV_A_R_A_105_CM 1 0. 0. 255. DISPLAY_IDENTIFIER fm_sta_eprm_mis_lpg_cata.fm_static_eprm_bitfield.Sbx_cf_xxx ECU_ADDRESS 0xd000578c BIT_MASK 0x80 /end MEASUREMENT
/begin MEASUREMENT Sbx_dyn_mis_lpg_trs_h "" UBYTE _CNV_A_R_A_105_CM 1 0. 0. 255. DISPLAY_IDENTIFIER fm_sta_eprm_mis_lpg_trs_h.fm_static_eprm_bitfield.Sbx_dyn_xxx ECU_ADDRESS 0xd000578e BIT_MASK 0x8 /end MEASUREMENT
/begin MEASUREMENT Sbx_rdn_mis_lpg_trs_h "" UBYTE _CNV_A_R_A_105_CM 1 0. 0. 255. DISPLAY_IDENTIFIER fm_sta_eprm_mis_lpg_trs_h.fm_static_eprm_bitfield.Sbx_rdn_xxx ECU_ADDRESS 0xd000578e BIT_MASK 0x10 /end MEASUREMENT
/begin MEASUREMENT Sbx_mf_mis_lpg_trs_h "" UBYTE _CNV_A_R_A_105_CM 1 0. 0. 255. DISPLAY_IDENTIFIER fm_sta_eprm_mis_lpg_trs_h.fm_static_eprm_bitfield.Sbx_mf_xxx ECU_ADDRESS 0xd000578e BIT_MASK 0x20 /end MEASUREMENT
/begin MEASUREMENT Sbx_cf_mis_lpg_trs_h "" UBYTE _CNV_A_R_A_105_CM 1 0. 0. 255. DISPLAY_IDENTIFIER fm_sta_eprm_mis_lpg_trs_h.fm_static_eprm_bitfield.Sbx_cf_xxx ECU_ADDRESS 0xd000578e BIT_MASK 0x80 /end MEASUREMENT
/begin MEASUREMENT Sbx_dyn_mis_min_fuel_cata "" UBYTE _CNV_A_R_A_105_CM 1 0. 0. 255. DISPLAY_IDENTIFIER fm_sta_eprm_mis_min_fuel_cata.fm_static_eprm_bitfield.Sbx_dyn_xxx ECU_ADDRESS 0xd0005790 BIT_MASK 0x8 /end MEASUREMENT
/begin MEASUREMENT Sbx_rdn_mis_min_fuel_cata "" UBYTE _CNV_A_R_A_105_CM 1 0. 0. 255. DISPLAY_IDENTIFIER fm_sta_eprm_mis_min_fuel_cata.fm_static_eprm_bitfield.Sbx_rdn_xxx ECU_ADDRESS 0xd0005790 BIT_MASK 0x10 /end MEASUREMENT
/begin MEASUREMENT Sbx_mf_mis_min_fuel_cata "" UBYTE _CNV_A_R_A_105_CM 1 0. 0. 255. DISPLAY_IDENTIFIER fm_sta_eprm_mis_min_fuel_cata.fm_static_eprm_bitfield.Sbx_mf_xxx ECU_ADDRESS 0xd0005790 BIT_MASK 0x20 /end MEASUREMENT
/begin MEASUREMENT Sbx_cf_mis_min_fuel_cata "" UBYTE _CNV_A_R_A_105_CM 1 0. 0. 255. DISPLAY_IDENTIFIER fm_sta_eprm_mis_min_fuel_cata.fm_static_eprm_bitfield.Sbx_cf_xxx ECU_ADDRESS 0xd0005790 BIT_MASK 0x80 /end MEASUREMENT
/begin MEASUREMENT Sbx_dyn_mis_min_fuel_trs_h "" UBYTE _CNV_A_R_A_105_CM 1 0. 0. 255. DISPLAY_IDENTIFIER fm_sta_eprm_mis_min_fuel_trs_h.fm_static_eprm_bitfield.Sbx_dyn_xxx ECU_ADDRESS 0xd0005792 BIT_MASK 0x8 /end MEASUREMENT
/begin MEASUREMENT Sbx_rdn_mis_min_fuel_trs_h "" UBYTE _CNV_A_R_A_105_CM 1 0. 0. 255. DISPLAY_IDENTIFIER fm_sta_eprm_mis_min_fuel_trs_h.fm_static_eprm_bitfield.Sbx_rdn_xxx ECU_ADDRESS 0xd0005792 BIT_MASK 0x10 /end MEASUREMENT
/begin MEASUREMENT Sbx_mf_mis_min_fuel_trs_h "" UBYTE _CNV_A_R_A_105_CM 1 0. 0. 255. DISPLAY_IDENTIFIER fm_sta_eprm_mis_min_fuel_trs_h.fm_static_eprm_bitfield.Sbx_mf_xxx ECU_ADDRESS 0xd0005792 BIT_MASK 0x20 /end MEASUREMENT
/begin MEASUREMENT Sbx_cf_mis_min_fuel_trs_h "" UBYTE _CNV_A_R_A_105_CM 1 0. 0. 255. DISPLAY_IDENTIFIER fm_sta_eprm_mis_min_fuel_trs_h.fm_static_eprm_bitfield.Sbx_cf_xxx ECU_ADDRESS 0xd0005792 BIT_MASK 0x80 /end MEASUREMENT
/begin MEASUREMENT Sbx_dyn_mis_trs_h "" UBYTE _CNV_A_R_A_105_CM 1 0. 0. 255. DISPLAY_IDENTIFIER fm_sta_eprm_mis_trs_h.fm_static_eprm_bitfield.Sbx_dyn_xxx ECU_ADDRESS 0xd0005794 BIT_MASK 0x8 /end MEASUREMENT
/begin MEASUREMENT Sbx_rdn_mis_trs_h "" UBYTE _CNV_A_R_A_105_CM 1 0. 0. 255. DISPLAY_IDENTIFIER fm_sta_eprm_mis_trs_h.fm_static_eprm_bitfield.Sbx_rdn_xxx ECU_ADDRESS 0xd0005794 BIT_MASK 0x10 /end MEASUREMENT
/begin MEASUREMENT Sbx_mf_mis_trs_h "" UBYTE _CNV_A_R_A_105_CM 1 0. 0. 255. DISPLAY_IDENTIFIER fm_sta_eprm_mis_trs_h.fm_static_eprm_bitfield.Sbx_mf_xxx ECU_ADDRESS 0xd0005794 BIT_MASK 0x20 /end MEASUREMENT
/begin MEASUREMENT Sbx_cf_mis_trs_h "" UBYTE _CNV_A_R_A_105_CM 1 0. 0. 255. DISPLAY_IDENTIFIER fm_sta_eprm_mis_trs_h.fm_static_eprm_bitfield.Sbx_cf_xxx ECU_ADDRESS 0xd0005794 BIT_MASK 0x80 /end MEASUREMENT
/begin MEASUREMENT Sbx_dyn_mis_unk_cata "" UBYTE _CNV_A_R_A_105_CM 1 0. 0. 255. DISPLAY_IDENTIFIER fm_sta_eprm_mis_unk_cata.fm_static_eprm_bitfield.Sbx_dyn_xxx ECU_ADDRESS 0xd0005796 BIT_MASK 0x8 /end MEASUREMENT
/begin MEASUREMENT Sbx_rdn_mis_unk_cata "" UBYTE _CNV_A_R_A_105_CM 1 0. 0. 255. DISPLAY_IDENTIFIER fm_sta_eprm_mis_unk_cata.fm_static_eprm_bitfield.Sbx_rdn_xxx ECU_ADDRESS 0xd0005796 BIT_MASK 0x10 /end MEASUREMENT
/begin MEASUREMENT Sbx_mf_mis_unk_cata "" UBYTE _CNV_A_R_A_105_CM 1 0. 0. 255. DISPLAY_IDENTIFIER fm_sta_eprm_mis_unk_cata.fm_static_eprm_bitfield.Sbx_mf_xxx ECU_ADDRESS 0xd0005796 BIT_MASK 0x20 /end MEASUREMENT
/begin MEASUREMENT Sbx_cf_mis_unk_cata "" UBYTE _CNV_A_R_A_105_CM 1 0. 0. 255. DISPLAY_IDENTIFIER fm_sta_eprm_mis_unk_cata.fm_static_eprm_bitfield.Sbx_cf_xxx ECU_ADDRESS 0xd0005796 BIT_MASK 0x80 /end MEASUREMENT
/begin MEASUREMENT Sbx_dyn_mis_unk_lpg_cata "" UBYTE _CNV_A_R_A_105_CM 1 0. 0. 255. DISPLAY_IDENTIFIER fm_sta_eprm_mis_unk_lpg_cata.fm_static_eprm_bitfield.Sbx_dyn_xxx ECU_ADDRESS 0xd0005798 BIT_MASK 0x8 /end MEASUREMENT
/begin MEASUREMENT Sbx_rdn_mis_unk_lpg_cata "" UBYTE _CNV_A_R_A_105_CM 1 0. 0. 255. DISPLAY_IDENTIFIER fm_sta_eprm_mis_unk_lpg_cata.fm_static_eprm_bitfield.Sbx_rdn_xxx ECU_ADDRESS 0xd0005798 BIT_MASK 0x10 /end MEASUREMENT
/begin MEASUREMENT Sbx_mf_mis_unk_lpg_cata "" UBYTE _CNV_A_R_A_105_CM 1 0. 0. 255. DISPLAY_IDENTIFIER fm_sta_eprm_mis_unk_lpg_cata.fm_static_eprm_bitfield.Sbx_mf_xxx ECU_ADDRESS 0xd0005798 BIT_MASK 0x20 /end MEASUREMENT
/begin MEASUREMENT Sbx_cf_mis_unk_lpg_cata "" UBYTE _CNV_A_R_A_105_CM 1 0. 0. 255. DISPLAY_IDENTIFIER fm_sta_eprm_mis_unk_lpg_cata.fm_static_eprm_bitfield.Sbx_cf_xxx ECU_ADDRESS 0xd0005798 BIT_MASK 0x80 /end MEASUREMENT
/begin MEASUREMENT Sbx_dyn_mis_unk_lpg_trs_h "" UBYTE _CNV_A_R_A_105_CM 1 0. 0. 255. DISPLAY_IDENTIFIER fm_sta_eprm_mis_unk_lpg_trs_h.fm_static_eprm_bitfield.Sbx_dyn_xxx ECU_ADDRESS 0xd000579a BIT_MASK 0x8 /end MEASUREMENT
/begin MEASUREMENT Sbx_rdn_mis_unk_lpg_trs_h "" UBYTE _CNV_A_R_A_105_CM 1 0. 0. 255. DISPLAY_IDENTIFIER fm_sta_eprm_mis_unk_lpg_trs_h.fm_static_eprm_bitfield.Sbx_rdn_xxx ECU_ADDRESS 0xd000579a BIT_MASK 0x10 /end MEASUREMENT
/begin MEASUREMENT Sbx_mf_mis_unk_lpg_trs_h "" UBYTE _CNV_A_R_A_105_CM 1 0. 0. 255. DISPLAY_IDENTIFIER fm_sta_eprm_mis_unk_lpg_trs_h.fm_static_eprm_bitfield.Sbx_mf_xxx ECU_ADDRESS 0xd000579a BIT_MASK 0x20 /end MEASUREMENT
/begin MEASUREMENT Sbx_cf_mis_unk_lpg_trs_h "" UBYTE _CNV_A_R_A_105_CM 1 0. 0. 255. DISPLAY_IDENTIFIER fm_sta_eprm_mis_unk_lpg_trs_h.fm_static_eprm_bitfield.Sbx_cf_xxx ECU_ADDRESS 0xd000579a BIT_MASK 0x80 /end MEASUREMENT
/begin MEASUREMENT Sbx_dyn_mis_unk_trs_h "" UBYTE _CNV_A_R_A_105_CM 1 0. 0. 255. DISPLAY_IDENTIFIER fm_sta_eprm_mis_unk_trs_h.fm_static_eprm_bitfield.Sbx_dyn_xxx ECU_ADDRESS 0xd000579c BIT_MASK 0x8 /end MEASUREMENT
/begin MEASUREMENT Sbx_rdn_mis_unk_trs_h "" UBYTE _CNV_A_R_A_105_CM 1 0. 0. 255. DISPLAY_IDENTIFIER fm_sta_eprm_mis_unk_trs_h.fm_static_eprm_bitfield.Sbx_rdn_xxx ECU_ADDRESS 0xd000579c BIT_MASK 0x10 /end MEASUREMENT
/begin MEASUREMENT Sbx_mf_mis_unk_trs_h "" UBYTE _CNV_A_R_A_105_CM 1 0. 0. 255. DISPLAY_IDENTIFIER fm_sta_eprm_mis_unk_trs_h.fm_static_eprm_bitfield.Sbx_mf_xxx ECU_ADDRESS 0xd000579c BIT_MASK 0x20 /end MEASUREMENT
/begin MEASUREMENT Sbx_cf_mis_unk_trs_h "" UBYTE _CNV_A_R_A_105_CM 1 0. 0. 255. DISPLAY_IDENTIFIER fm_sta_eprm_mis_unk_trs_h.fm_static_eprm_bitfield.Sbx_cf_xxx ECU_ADDRESS 0xd000579c BIT_MASK 0x80 /end MEASUREMENT
/begin MEASUREMENT Sbx_dyn_ptc_rov_oc "" UBYTE _CNV_A_R_A_105_CM 1 0. 0. 255. DISPLAY_IDENTIFIER fm_sta_eprm_ptc_rov_oc.fm_static_eprm_bitfield.Sbx_dyn_xxx ECU_ADDRESS 0xd00057cc BIT_MASK 0x8 /end MEASUREMENT
/begin MEASUREMENT Sbx_rdn_ptc_rov_oc "" UBYTE _CNV_A_R_A_105_CM 1 0. 0. 255. DISPLAY_IDENTIFIER fm_sta_eprm_ptc_rov_oc.fm_static_eprm_bitfield.Sbx_rdn_xxx ECU_ADDRESS 0xd00057cc BIT_MASK 0x10 /end MEASUREMENT
/begin MEASUREMENT Sbx_mf_ptc_rov_oc "" UBYTE _CNV_A_R_A_105_CM 1 0. 0. 255. DISPLAY_IDENTIFIER fm_sta_eprm_ptc_rov_oc.fm_static_eprm_bitfield.Sbx_mf_xxx ECU_ADDRESS 0xd00057cc BIT_MASK 0x20 /end MEASUREMENT
/begin MEASUREMENT Sbx_cf_ptc_rov_oc "" UBYTE _CNV_A_R_A_105_CM 1 0. 0. 255. DISPLAY_IDENTIFIER fm_sta_eprm_ptc_rov_oc.fm_static_eprm_bitfield.Sbx_cf_xxx ECU_ADDRESS 0xd00057cc BIT_MASK 0x80 /end MEASUREMENT
/begin MEASUREMENT Sbx_dyn_ptc_rov_scg "" UBYTE _CNV_A_R_A_105_CM 1 0. 0. 255. DISPLAY_IDENTIFIER fm_sta_eprm_ptc_rov_scg.fm_static_eprm_bitfield.Sbx_dyn_xxx ECU_ADDRESS 0xd00057ce BIT_MASK 0x8 /end MEASUREMENT
/begin MEASUREMENT Sbx_rdn_ptc_rov_scg "" UBYTE _CNV_A_R_A_105_CM 1 0. 0. 255. DISPLAY_IDENTIFIER fm_sta_eprm_ptc_rov_scg.fm_static_eprm_bitfield.Sbx_rdn_xxx ECU_ADDRESS 0xd00057ce BIT_MASK 0x10 /end MEASUREMENT
/begin MEASUREMENT Sbx_mf_ptc_rov_scg "" UBYTE _CNV_A_R_A_105_CM 1 0. 0. 255. DISPLAY_IDENTIFIER fm_sta_eprm_ptc_rov_scg.fm_static_eprm_bitfield.Sbx_mf_xxx ECU_ADDRESS 0xd00057ce BIT_MASK 0x20 /end MEASUREMENT
/begin MEASUREMENT Sbx_cf_ptc_rov_scg "" UBYTE _CNV_A_R_A_105_CM 1 0. 0. 255. DISPLAY_IDENTIFIER fm_sta_eprm_ptc_rov_scg.fm_static_eprm_bitfield.Sbx_cf_xxx ECU_ADDRESS 0xd00057ce BIT_MASK 0x80 /end MEASUREMENT
/begin MEASUREMENT Sbx_dyn_ptc_rov_scw "" UBYTE _CNV_A_R_A_105_CM 1 0. 0. 255. DISPLAY_IDENTIFIER fm_sta_eprm_ptc_rov_scw.fm_static_eprm_bitfield.Sbx_dyn_xxx ECU_ADDRESS 0xd00057d0 BIT_MASK 0x8 /end MEASUREMENT
/begin MEASUREMENT Sbx_rdn_ptc_rov_scw "" UBYTE _CNV_A_R_A_105_CM 1 0. 0. 255. DISPLAY_IDENTIFIER fm_sta_eprm_ptc_rov_scw.fm_static_eprm_bitfield.Sbx_rdn_xxx ECU_ADDRESS 0xd00057d0 BIT_MASK 0x10 /end MEASUREMENT
/begin MEASUREMENT Sbx_mf_ptc_rov_scw "" UBYTE _CNV_A_R_A_105_CM 1 0. 0. 255. DISPLAY_IDENTIFIER fm_sta_eprm_ptc_rov_scw.fm_static_eprm_bitfield.Sbx_mf_xxx ECU_ADDRESS 0xd00057d0 BIT_MASK 0x20 /end MEASUREMENT
/begin MEASUREMENT Sbx_cf_ptc_rov_scw "" UBYTE _CNV_A_R_A_105_CM 1 0. 0. 255. DISPLAY_IDENTIFIER fm_sta_eprm_ptc_rov_scw.fm_static_eprm_bitfield.Sbx_cf_xxx ECU_ADDRESS 0xd00057d0 BIT_MASK 0x80 /end MEASUREMENT
/begin MEASUREMENT Sbx_dyn_pws_1_h "" UBYTE _CNV_A_R_A_105_CM 1 0. 0. 255. DISPLAY_IDENTIFIER fm_sta_eprm_pws_1_h.fm_static_eprm_bitfield.Sbx_dyn_xxx ECU_ADDRESS 0xd000570c BIT_MASK 0x8 /end MEASUREMENT
/begin MEASUREMENT Sbx_rdn_pws_1_h "" UBYTE _CNV_A_R_A_105_CM 1 0. 0. 255. DISPLAY_IDENTIFIER fm_sta_eprm_pws_1_h.fm_static_eprm_bitfield.Sbx_rdn_xxx ECU_ADDRESS 0xd000570c BIT_MASK 0x10 /end MEASUREMENT
/begin MEASUREMENT Sbx_mf_pws_1_h "" UBYTE _CNV_A_R_A_105_CM 1 0. 0. 255. DISPLAY_IDENTIFIER fm_sta_eprm_pws_1_h.fm_static_eprm_bitfield.Sbx_mf_xxx ECU_ADDRESS 0xd000570c BIT_MASK 0x20 /end MEASUREMENT
/begin MEASUREMENT Sbx_cf_pws_1_h "" UBYTE _CNV_A_R_A_105_CM 1 0. 0. 255. DISPLAY_IDENTIFIER fm_sta_eprm_pws_1_h.fm_static_eprm_bitfield.Sbx_cf_xxx ECU_ADDRESS 0xd000570c BIT_MASK 0x80 /end MEASUREMENT
/begin MEASUREMENT Sbx_dyn_pws_1_l "" UBYTE _CNV_A_R_A_105_CM 1 0. 0. 255. DISPLAY_IDENTIFIER fm_sta_eprm_pws_1_l.fm_static_eprm_bitfield.Sbx_dyn_xxx ECU_ADDRESS 0xd000570e BIT_MASK 0x8 /end MEASUREMENT
/begin MEASUREMENT Sbx_rdn_pws_1_l "" UBYTE _CNV_A_R_A_105_CM 1 0. 0. 255. DISPLAY_IDENTIFIER fm_sta_eprm_pws_1_l.fm_static_eprm_bitfield.Sbx_rdn_xxx ECU_ADDRESS 0xd000570e BIT_MASK 0x10 /end MEASUREMENT
/begin MEASUREMENT Sbx_mf_pws_1_l "" UBYTE _CNV_A_R_A_105_CM 1 0. 0. 255. DISPLAY_IDENTIFIER fm_sta_eprm_pws_1_l.fm_static_eprm_bitfield.Sbx_mf_xxx ECU_ADDRESS 0xd000570e BIT_MASK 0x20 /end MEASUREMENT
/begin MEASUREMENT Sbx_cf_pws_1_l "" UBYTE _CNV_A_R_A_105_CM 1 0. 0. 255. DISPLAY_IDENTIFIER fm_sta_eprm_pws_1_l.fm_static_eprm_bitfield.Sbx_cf_xxx ECU_ADDRESS 0xd000570e BIT_MASK 0x80 /end MEASUREMENT
/begin MEASUREMENT Sbx_dyn_pws_2_h "" UBYTE _CNV_A_R_A_105_CM 1 0. 0. 255. DISPLAY_IDENTIFIER fm_sta_eprm_pws_2_h.fm_static_eprm_bitfield.Sbx_dyn_xxx ECU_ADDRESS 0xd0005710 BIT_MASK 0x8 /end MEASUREMENT
/begin MEASUREMENT Sbx_rdn_pws_2_h "" UBYTE _CNV_A_R_A_105_CM 1 0. 0. 255. DISPLAY_IDENTIFIER fm_sta_eprm_pws_2_h.fm_static_eprm_bitfield.Sbx_rdn_xxx ECU_ADDRESS 0xd0005710 BIT_MASK 0x10 /end MEASUREMENT
/begin MEASUREMENT Sbx_mf_pws_2_h "" UBYTE _CNV_A_R_A_105_CM 1 0. 0. 255. DISPLAY_IDENTIFIER fm_sta_eprm_pws_2_h.fm_static_eprm_bitfield.Sbx_mf_xxx ECU_ADDRESS 0xd0005710 BIT_MASK 0x20 /end MEASUREMENT
/begin MEASUREMENT Sbx_cf_pws_2_h "" UBYTE _CNV_A_R_A_105_CM 1 0. 0. 255. DISPLAY_IDENTIFIER fm_sta_eprm_pws_2_h.fm_static_eprm_bitfield.Sbx_cf_xxx ECU_ADDRESS 0xd0005710 BIT_MASK 0x80 /end MEASUREMENT
/begin MEASUREMENT Sbx_dyn_pws_2_l "" UBYTE _CNV_A_R_A_105_CM 1 0. 0. 255. DISPLAY_IDENTIFIER fm_sta_eprm_pws_2_l.fm_static_eprm_bitfield.Sbx_dyn_xxx ECU_ADDRESS 0xd0005712 BIT_MASK 0x8 /end MEASUREMENT
/begin MEASUREMENT Sbx_rdn_pws_2_l "" UBYTE _CNV_A_R_A_105_CM 1 0. 0. 255. DISPLAY_IDENTIFIER fm_sta_eprm_pws_2_l.fm_static_eprm_bitfield.Sbx_rdn_xxx ECU_ADDRESS 0xd0005712 BIT_MASK 0x10 /end MEASUREMENT
/begin MEASUREMENT Sbx_mf_pws_2_l "" UBYTE _CNV_A_R_A_105_CM 1 0. 0. 255. DISPLAY_IDENTIFIER fm_sta_eprm_pws_2_l.fm_static_eprm_bitfield.Sbx_mf_xxx ECU_ADDRESS 0xd0005712 BIT_MASK 0x20 /end MEASUREMENT
/begin MEASUREMENT Sbx_cf_pws_2_l "" UBYTE _CNV_A_R_A_105_CM 1 0. 0. 255. DISPLAY_IDENTIFIER fm_sta_eprm_pws_2_l.fm_static_eprm_bitfield.Sbx_cf_xxx ECU_ADDRESS 0xd0005712 BIT_MASK 0x80 /end MEASUREMENT
/begin MEASUREMENT Sbx_dyn_pws_3_h "" UBYTE _CNV_A_R_A_105_CM 1 0. 0. 255. DISPLAY_IDENTIFIER fm_sta_eprm_pws_3_h.fm_static_eprm_bitfield.Sbx_dyn_xxx ECU_ADDRESS 0xd0005714 BIT_MASK 0x8 /end MEASUREMENT
/begin MEASUREMENT Sbx_rdn_pws_3_h "" UBYTE _CNV_A_R_A_105_CM 1 0. 0. 255. DISPLAY_IDENTIFIER fm_sta_eprm_pws_3_h.fm_static_eprm_bitfield.Sbx_rdn_xxx ECU_ADDRESS 0xd0005714 BIT_MASK 0x10 /end MEASUREMENT
/begin MEASUREMENT Sbx_mf_pws_3_h "" UBYTE _CNV_A_R_A_105_CM 1 0. 0. 255. DISPLAY_IDENTIFIER fm_sta_eprm_pws_3_h.fm_static_eprm_bitfield.Sbx_mf_xxx ECU_ADDRESS 0xd0005714 BIT_MASK 0x20 /end MEASUREMENT
/begin MEASUREMENT Sbx_cf_pws_3_h "" UBYTE _CNV_A_R_A_105_CM 1 0. 0. 255. DISPLAY_IDENTIFIER fm_sta_eprm_pws_3_h.fm_static_eprm_bitfield.Sbx_cf_xxx ECU_ADDRESS 0xd0005714 BIT_MASK 0x80 /end MEASUREMENT
/begin MEASUREMENT Sbx_dyn_pws_3_l "" UBYTE _CNV_A_R_A_105_CM 1 0. 0. 255. DISPLAY_IDENTIFIER fm_sta_eprm_pws_3_l.fm_static_eprm_bitfield.Sbx_dyn_xxx ECU_ADDRESS 0xd0005716 BIT_MASK 0x8 /end MEASUREMENT
/begin MEASUREMENT Sbx_rdn_pws_3_l "" UBYTE _CNV_A_R_A_105_CM 1 0. 0. 255. DISPLAY_IDENTIFIER fm_sta_eprm_pws_3_l.fm_static_eprm_bitfield.Sbx_rdn_xxx ECU_ADDRESS 0xd0005716 BIT_MASK 0x10 /end MEASUREMENT
/begin MEASUREMENT Sbx_mf_pws_3_l "" UBYTE _CNV_A_R_A_105_CM 1 0. 0. 255. DISPLAY_IDENTIFIER fm_sta_eprm_pws_3_l.fm_static_eprm_bitfield.Sbx_mf_xxx ECU_ADDRESS 0xd0005716 BIT_MASK 0x20 /end MEASUREMENT
/begin MEASUREMENT Sbx_cf_pws_3_l "" UBYTE _CNV_A_R_A_105_CM 1 0. 0. 255. DISPLAY_IDENTIFIER fm_sta_eprm_pws_3_l.fm_static_eprm_bitfield.Sbx_cf_xxx ECU_ADDRESS 0xd0005716 BIT_MASK 0x80 /end MEASUREMENT
/begin MEASUREMENT Sbx_dyn_sens_it_1_nok "" UBYTE _CNV_A_R_A_105_CM 1 0. 0. 255. DISPLAY_IDENTIFIER fm_sta_eprm_sens_it_1_nok.fm_static_eprm_bitfield.Sbx_dyn_xxx ECU_ADDRESS 0xd0005718 BIT_MASK 0x8 /end MEASUREMENT
/begin MEASUREMENT Sbx_rdn_sens_it_1_nok "" UBYTE _CNV_A_R_A_105_CM 1 0. 0. 255. DISPLAY_IDENTIFIER fm_sta_eprm_sens_it_1_nok.fm_static_eprm_bitfield.Sbx_rdn_xxx ECU_ADDRESS 0xd0005718 BIT_MASK 0x10 /end MEASUREMENT
/begin MEASUREMENT Sbx_mf_sens_it_1_nok "" UBYTE _CNV_A_R_A_105_CM 1 0. 0. 255. DISPLAY_IDENTIFIER fm_sta_eprm_sens_it_1_nok.fm_static_eprm_bitfield.Sbx_mf_xxx ECU_ADDRESS 0xd0005718 BIT_MASK 0x20 /end MEASUREMENT
/begin MEASUREMENT Sbx_cf_sens_it_1_nok "" UBYTE _CNV_A_R_A_105_CM 1 0. 0. 255. DISPLAY_IDENTIFIER fm_sta_eprm_sens_it_1_nok.fm_static_eprm_bitfield.Sbx_cf_xxx ECU_ADDRESS 0xd0005718 BIT_MASK 0x80 /end MEASUREMENT
/begin MEASUREMENT Sbx_dyn_sens_it_2_nok "" UBYTE _CNV_A_R_A_105_CM 1 0. 0. 255. DISPLAY_IDENTIFIER fm_sta_eprm_sens_it_2_nok.fm_static_eprm_bitfield.Sbx_dyn_xxx ECU_ADDRESS 0xd000571a BIT_MASK 0x8 /end MEASUREMENT
/begin MEASUREMENT Sbx_rdn_sens_it_2_nok "" UBYTE _CNV_A_R_A_105_CM 1 0. 0. 255. DISPLAY_IDENTIFIER fm_sta_eprm_sens_it_2_nok.fm_static_eprm_bitfield.Sbx_rdn_xxx ECU_ADDRESS 0xd000571a BIT_MASK 0x10 /end MEASUREMENT
/begin MEASUREMENT Sbx_mf_sens_it_2_nok "" UBYTE _CNV_A_R_A_105_CM 1 0. 0. 255. DISPLAY_IDENTIFIER fm_sta_eprm_sens_it_2_nok.fm_static_eprm_bitfield.Sbx_mf_xxx ECU_ADDRESS 0xd000571a BIT_MASK 0x20 /end MEASUREMENT
/begin MEASUREMENT Sbx_cf_sens_it_2_nok "" UBYTE _CNV_A_R_A_105_CM 1 0. 0. 255. DISPLAY_IDENTIFIER fm_sta_eprm_sens_it_2_nok.fm_static_eprm_bitfield.Sbx_cf_xxx ECU_ADDRESS 0xd000571a BIT_MASK 0x80 /end MEASUREMENT
/begin MEASUREMENT Sbx_dyn_sens_it_chr "" UBYTE _CNV_A_R_A_105_CM 1 0. 0. 255. DISPLAY_IDENTIFIER fm_sta_eprm_sens_it_chr.fm_static_eprm_bitfield.Sbx_dyn_xxx ECU_ADDRESS 0xd000571c BIT_MASK 0x8 /end MEASUREMENT
/begin MEASUREMENT Sbx_rdn_sens_it_chr "" UBYTE _CNV_A_R_A_105_CM 1 0. 0. 255. DISPLAY_IDENTIFIER fm_sta_eprm_sens_it_chr.fm_static_eprm_bitfield.Sbx_rdn_xxx ECU_ADDRESS 0xd000571c BIT_MASK 0x10 /end MEASUREMENT
/begin MEASUREMENT Sbx_mf_sens_it_chr "" UBYTE _CNV_A_R_A_105_CM 1 0. 0. 255. DISPLAY_IDENTIFIER fm_sta_eprm_sens_it_chr.fm_static_eprm_bitfield.Sbx_mf_xxx ECU_ADDRESS 0xd000571c BIT_MASK 0x20 /end MEASUREMENT
/begin MEASUREMENT Sbx_cf_sens_it_chr "" UBYTE _CNV_A_R_A_105_CM 1 0. 0. 255. DISPLAY_IDENTIFIER fm_sta_eprm_sens_it_chr.fm_static_eprm_bitfield.Sbx_cf_xxx ECU_ADDRESS 0xd000571c BIT_MASK 0x80 /end MEASUREMENT
/begin MEASUREMENT Sbx_dyn_sens_it_sig_mcut "" UBYTE _CNV_A_R_A_105_CM 1 0. 0. 255. DISPLAY_IDENTIFIER fm_sta_eprm_sens_it_sig_mcut.fm_static_eprm_bitfield.Sbx_dyn_xxx ECU_ADDRESS 0xd000571e BIT_MASK 0x8 /end MEASUREMENT
/begin MEASUREMENT Sbx_rdn_sens_it_sig_mcut "" UBYTE _CNV_A_R_A_105_CM 1 0. 0. 255. DISPLAY_IDENTIFIER fm_sta_eprm_sens_it_sig_mcut.fm_static_eprm_bitfield.Sbx_rdn_xxx ECU_ADDRESS 0xd000571e BIT_MASK 0x10 /end MEASUREMENT
/begin MEASUREMENT Sbx_mf_sens_it_sig_mcut "" UBYTE _CNV_A_R_A_105_CM 1 0. 0. 255. DISPLAY_IDENTIFIER fm_sta_eprm_sens_it_sig_mcut.fm_static_eprm_bitfield.Sbx_mf_xxx ECU_ADDRESS 0xd000571e BIT_MASK 0x20 /end MEASUREMENT
/begin MEASUREMENT Sbx_cf_sens_it_sig_mcut "" UBYTE _CNV_A_R_A_105_CM 1 0. 0. 255. DISPLAY_IDENTIFIER fm_sta_eprm_sens_it_sig_mcut.fm_static_eprm_bitfield.Sbx_cf_xxx ECU_ADDRESS 0xd000571e BIT_MASK 0x80 /end MEASUREMENT
/begin MEASUREMENT Sbx_dyn_sens_map_h "" UBYTE _CNV_A_R_A_105_CM 1 0. 0. 255. DISPLAY_IDENTIFIER fm_sta_eprm_sens_map_h.fm_static_eprm_bitfield.Sbx_dyn_xxx ECU_ADDRESS 0xd0005720 BIT_MASK 0x8 /end MEASUREMENT
/begin MEASUREMENT Sbx_rdn_sens_map_h "" UBYTE _CNV_A_R_A_105_CM 1 0. 0. 255. DISPLAY_IDENTIFIER fm_sta_eprm_sens_map_h.fm_static_eprm_bitfield.Sbx_rdn_xxx ECU_ADDRESS 0xd0005720 BIT_MASK 0x10 /end MEASUREMENT
/begin MEASUREMENT Sbx_mf_sens_map_h "" UBYTE _CNV_A_R_A_105_CM 1 0. 0. 255. DISPLAY_IDENTIFIER fm_sta_eprm_sens_map_h.fm_static_eprm_bitfield.Sbx_mf_xxx ECU_ADDRESS 0xd0005720 BIT_MASK 0x20 /end MEASUREMENT
/begin MEASUREMENT Sbx_cf_sens_map_h "" UBYTE _CNV_A_R_A_105_CM 1 0. 0. 255. DISPLAY_IDENTIFIER fm_sta_eprm_sens_map_h.fm_static_eprm_bitfield.Sbx_cf_xxx ECU_ADDRESS 0xd0005720 BIT_MASK 0x80 /end MEASUREMENT
/begin MEASUREMENT Sbx_dyn_sens_map_l "" UBYTE _CNV_A_R_A_105_CM 1 0. 0. 255. DISPLAY_IDENTIFIER fm_sta_eprm_sens_map_l.fm_static_eprm_bitfield.Sbx_dyn_xxx ECU_ADDRESS 0xd0005722 BIT_MASK 0x8 /end MEASUREMENT
/begin MEASUREMENT Sbx_rdn_sens_map_l "" UBYTE _CNV_A_R_A_105_CM 1 0. 0. 255. DISPLAY_IDENTIFIER fm_sta_eprm_sens_map_l.fm_static_eprm_bitfield.Sbx_rdn_xxx ECU_ADDRESS 0xd0005722 BIT_MASK 0x10 /end MEASUREMENT
/begin MEASUREMENT Sbx_mf_sens_map_l "" UBYTE _CNV_A_R_A_105_CM 1 0. 0. 255. DISPLAY_IDENTIFIER fm_sta_eprm_sens_map_l.fm_static_eprm_bitfield.Sbx_mf_xxx ECU_ADDRESS 0xd0005722 BIT_MASK 0x20 /end MEASUREMENT
/begin MEASUREMENT Sbx_cf_sens_map_l "" UBYTE _CNV_A_R_A_105_CM 1 0. 0. 255. DISPLAY_IDENTIFIER fm_sta_eprm_sens_map_l.fm_static_eprm_bitfield.Sbx_cf_xxx ECU_ADDRESS 0xd0005722 BIT_MASK 0x80 /end MEASUREMENT
/begin MEASUREMENT Sbx_dyn_sens_mat_h "" UBYTE _CNV_A_R_A_105_CM 1 0. 0. 255. DISPLAY_IDENTIFIER fm_sta_eprm_sens_mat_h.fm_static_eprm_bitfield.Sbx_dyn_xxx ECU_ADDRESS 0xd000573e BIT_MASK 0x8 /end MEASUREMENT
/begin MEASUREMENT Sbx_rdn_sens_mat_h "" UBYTE _CNV_A_R_A_105_CM 1 0. 0. 255. DISPLAY_IDENTIFIER fm_sta_eprm_sens_mat_h.fm_static_eprm_bitfield.Sbx_rdn_xxx ECU_ADDRESS 0xd000573e BIT_MASK 0x10 /end MEASUREMENT
/begin MEASUREMENT Sbx_mf_sens_mat_h "" UBYTE _CNV_A_R_A_105_CM 1 0. 0. 255. DISPLAY_IDENTIFIER fm_sta_eprm_sens_mat_h.fm_static_eprm_bitfield.Sbx_mf_xxx ECU_ADDRESS 0xd000573e BIT_MASK 0x20 /end MEASUREMENT
/begin MEASUREMENT Sbx_cf_sens_mat_h "" UBYTE _CNV_A_R_A_105_CM 1 0. 0. 255. DISPLAY_IDENTIFIER fm_sta_eprm_sens_mat_h.fm_static_eprm_bitfield.Sbx_cf_xxx ECU_ADDRESS 0xd000573e BIT_MASK 0x80 /end MEASUREMENT
/begin MEASUREMENT Sbx_dyn_sens_mat_l "" UBYTE _CNV_A_R_A_105_CM 1 0. 0. 255. DISPLAY_IDENTIFIER fm_sta_eprm_sens_mat_l.fm_static_eprm_bitfield.Sbx_dyn_xxx ECU_ADDRESS 0xd0005740 BIT_MASK 0x8 /end MEASUREMENT
/begin MEASUREMENT Sbx_rdn_sens_mat_l "" UBYTE _CNV_A_R_A_105_CM 1 0. 0. 255. DISPLAY_IDENTIFIER fm_sta_eprm_sens_mat_l.fm_static_eprm_bitfield.Sbx_rdn_xxx ECU_ADDRESS 0xd0005740 BIT_MASK 0x10 /end MEASUREMENT
/begin MEASUREMENT Sbx_mf_sens_mat_l "" UBYTE _CNV_A_R_A_105_CM 1 0. 0. 255. DISPLAY_IDENTIFIER fm_sta_eprm_sens_mat_l.fm_static_eprm_bitfield.Sbx_mf_xxx ECU_ADDRESS 0xd0005740 BIT_MASK 0x20 /end MEASUREMENT
/begin MEASUREMENT Sbx_cf_sens_mat_l "" UBYTE _CNV_A_R_A_105_CM 1 0. 0. 255. DISPLAY_IDENTIFIER fm_sta_eprm_sens_mat_l.fm_static_eprm_bitfield.Sbx_cf_xxx ECU_ADDRESS 0xd0005740 BIT_MASK 0x80 /end MEASUREMENT
/begin MEASUREMENT Sbx_dyn_sens_rvc_h "" UBYTE _CNV_A_R_A_105_CM 1 0. 0. 255. DISPLAY_IDENTIFIER fm_sta_eprm_sens_rvc_h.fm_static_eprm_bitfield.Sbx_dyn_xxx ECU_ADDRESS 0xd0005802 BIT_MASK 0x8 /end MEASUREMENT
/begin MEASUREMENT Sbx_rdn_sens_rvc_h "" UBYTE _CNV_A_R_A_105_CM 1 0. 0. 255. DISPLAY_IDENTIFIER fm_sta_eprm_sens_rvc_h.fm_static_eprm_bitfield.Sbx_rdn_xxx ECU_ADDRESS 0xd0005802 BIT_MASK 0x10 /end MEASUREMENT
/begin MEASUREMENT Sbx_mf_sens_rvc_h "" UBYTE _CNV_A_R_A_105_CM 1 0. 0. 255. DISPLAY_IDENTIFIER fm_sta_eprm_sens_rvc_h.fm_static_eprm_bitfield.Sbx_mf_xxx ECU_ADDRESS 0xd0005802 BIT_MASK 0x20 /end MEASUREMENT
/begin MEASUREMENT Sbx_cf_sens_rvc_h "" UBYTE _CNV_A_R_A_105_CM 1 0. 0. 255. DISPLAY_IDENTIFIER fm_sta_eprm_sens_rvc_h.fm_static_eprm_bitfield.Sbx_cf_xxx ECU_ADDRESS 0xd0005802 BIT_MASK 0x80 /end MEASUREMENT
/begin MEASUREMENT Sbx_dyn_sens_rvc_l "" UBYTE _CNV_A_R_A_105_CM 1 0. 0. 255. DISPLAY_IDENTIFIER fm_sta_eprm_sens_rvc_l.fm_static_eprm_bitfield.Sbx_dyn_xxx ECU_ADDRESS 0xd0005804 BIT_MASK 0x8 /end MEASUREMENT
/begin MEASUREMENT Sbx_rdn_sens_rvc_l "" UBYTE _CNV_A_R_A_105_CM 1 0. 0. 255. DISPLAY_IDENTIFIER fm_sta_eprm_sens_rvc_l.fm_static_eprm_bitfield.Sbx_rdn_xxx ECU_ADDRESS 0xd0005804 BIT_MASK 0x10 /end MEASUREMENT
/begin MEASUREMENT Sbx_mf_sens_rvc_l "" UBYTE _CNV_A_R_A_105_CM 1 0. 0. 255. DISPLAY_IDENTIFIER fm_sta_eprm_sens_rvc_l.fm_static_eprm_bitfield.Sbx_mf_xxx ECU_ADDRESS 0xd0005804 BIT_MASK 0x20 /end MEASUREMENT
/begin MEASUREMENT Sbx_cf_sens_rvc_l "" UBYTE _CNV_A_R_A_105_CM 1 0. 0. 255. DISPLAY_IDENTIFIER fm_sta_eprm_sens_rvc_l.fm_static_eprm_bitfield.Sbx_cf_xxx ECU_ADDRESS 0xd0005804 BIT_MASK 0x80 /end MEASUREMENT
/begin MEASUREMENT Sbx_dyn_sens_rvc_nok "" UBYTE _CNV_A_R_A_105_CM 1 0. 0. 255. DISPLAY_IDENTIFIER fm_sta_eprm_sens_rvc_nok.fm_static_eprm_bitfield.Sbx_dyn_xxx ECU_ADDRESS 0xd0005806 BIT_MASK 0x8 /end MEASUREMENT
/begin MEASUREMENT Sbx_rdn_sens_rvc_nok "" UBYTE _CNV_A_R_A_105_CM 1 0. 0. 255. DISPLAY_IDENTIFIER fm_sta_eprm_sens_rvc_nok.fm_static_eprm_bitfield.Sbx_rdn_xxx ECU_ADDRESS 0xd0005806 BIT_MASK 0x10 /end MEASUREMENT
/begin MEASUREMENT Sbx_mf_sens_rvc_nok "" UBYTE _CNV_A_R_A_105_CM 1 0. 0. 255. DISPLAY_IDENTIFIER fm_sta_eprm_sens_rvc_nok.fm_static_eprm_bitfield.Sbx_mf_xxx ECU_ADDRESS 0xd0005806 BIT_MASK 0x20 /end MEASUREMENT
/begin MEASUREMENT Sbx_cf_sens_rvc_nok "" UBYTE _CNV_A_R_A_105_CM 1 0. 0. 255. DISPLAY_IDENTIFIER fm_sta_eprm_sens_rvc_nok.fm_static_eprm_bitfield.Sbx_cf_xxx ECU_ADDRESS 0xd0005806 BIT_MASK 0x80 /end MEASUREMENT
/begin MEASUREMENT Sbx_dyn_sens_rvc_sig_mcut "" UBYTE _CNV_A_R_A_105_CM 1 0. 0. 255. DISPLAY_IDENTIFIER fm_sta_eprm_sens_rvc_sig_mcut.fm_static_eprm_bitfield.Sbx_dyn_xxx ECU_ADDRESS 0xd0005808 BIT_MASK 0x8 /end MEASUREMENT
/begin MEASUREMENT Sbx_rdn_sens_rvc_sig_mcut "" UBYTE _CNV_A_R_A_105_CM 1 0. 0. 255. DISPLAY_IDENTIFIER fm_sta_eprm_sens_rvc_sig_mcut.fm_static_eprm_bitfield.Sbx_rdn_xxx ECU_ADDRESS 0xd0005808 BIT_MASK 0x10 /end MEASUREMENT
/begin MEASUREMENT Sbx_mf_sens_rvc_sig_mcut "" UBYTE _CNV_A_R_A_105_CM 1 0. 0. 255. DISPLAY_IDENTIFIER fm_sta_eprm_sens_rvc_sig_mcut.fm_static_eprm_bitfield.Sbx_mf_xxx ECU_ADDRESS 0xd0005808 BIT_MASK 0x20 /end MEASUREMENT
/begin MEASUREMENT Sbx_cf_sens_rvc_sig_mcut "" UBYTE _CNV_A_R_A_105_CM 1 0. 0. 255. DISPLAY_IDENTIFIER fm_sta_eprm_sens_rvc_sig_mcut.fm_static_eprm_bitfield.Sbx_cf_xxx ECU_ADDRESS 0xd0005808 BIT_MASK 0x80 /end MEASUREMENT
/begin MEASUREMENT Sbx_dyn_sens_spg_h "" UBYTE _CNV_A_R_A_105_CM 1 0. 0. 255. DISPLAY_IDENTIFIER fm_sta_eprm_sens_spg_h.fm_static_eprm_bitfield.Sbx_dyn_xxx ECU_ADDRESS 0xd0005724 BIT_MASK 0x8 /end MEASUREMENT
/begin MEASUREMENT Sbx_rdn_sens_spg_h "" UBYTE _CNV_A_R_A_105_CM 1 0. 0. 255. DISPLAY_IDENTIFIER fm_sta_eprm_sens_spg_h.fm_static_eprm_bitfield.Sbx_rdn_xxx ECU_ADDRESS 0xd0005724 BIT_MASK 0x10 /end MEASUREMENT
/begin MEASUREMENT Sbx_mf_sens_spg_h "" UBYTE _CNV_A_R_A_105_CM 1 0. 0. 255. DISPLAY_IDENTIFIER fm_sta_eprm_sens_spg_h.fm_static_eprm_bitfield.Sbx_mf_xxx ECU_ADDRESS 0xd0005724 BIT_MASK 0x20 /end MEASUREMENT
/begin MEASUREMENT Sbx_cf_sens_spg_h "" UBYTE _CNV_A_R_A_105_CM 1 0. 0. 255. DISPLAY_IDENTIFIER fm_sta_eprm_sens_spg_h.fm_static_eprm_bitfield.Sbx_cf_xxx ECU_ADDRESS 0xd0005724 BIT_MASK 0x80 /end MEASUREMENT
/begin MEASUREMENT Sbx_dyn_sens_spg_l "" UBYTE _CNV_A_R_A_105_CM 1 0. 0. 255. DISPLAY_IDENTIFIER fm_sta_eprm_sens_spg_l.fm_static_eprm_bitfield.Sbx_dyn_xxx ECU_ADDRESS 0xd0005726 BIT_MASK 0x8 /end MEASUREMENT
/begin MEASUREMENT Sbx_rdn_sens_spg_l "" UBYTE _CNV_A_R_A_105_CM 1 0. 0. 255. DISPLAY_IDENTIFIER fm_sta_eprm_sens_spg_l.fm_static_eprm_bitfield.Sbx_rdn_xxx ECU_ADDRESS 0xd0005726 BIT_MASK 0x10 /end MEASUREMENT
/begin MEASUREMENT Sbx_mf_sens_spg_l "" UBYTE _CNV_A_R_A_105_CM 1 0. 0. 255. DISPLAY_IDENTIFIER fm_sta_eprm_sens_spg_l.fm_static_eprm_bitfield.Sbx_mf_xxx ECU_ADDRESS 0xd0005726 BIT_MASK 0x20 /end MEASUREMENT
/begin MEASUREMENT Sbx_cf_sens_spg_l "" UBYTE _CNV_A_R_A_105_CM 1 0. 0. 255. DISPLAY_IDENTIFIER fm_sta_eprm_sens_spg_l.fm_static_eprm_bitfield.Sbx_cf_xxx ECU_ADDRESS 0xd0005726 BIT_MASK 0x80 /end MEASUREMENT
/begin MEASUREMENT Sbx_dyn_sens_tco_h "" UBYTE _CNV_A_R_A_105_CM 1 0. 0. 255. DISPLAY_IDENTIFIER fm_sta_eprm_sens_tco_h.fm_static_eprm_bitfield.Sbx_dyn_xxx ECU_ADDRESS 0xd0005728 BIT_MASK 0x8 /end MEASUREMENT
/begin MEASUREMENT Sbx_rdn_sens_tco_h "" UBYTE _CNV_A_R_A_105_CM 1 0. 0. 255. DISPLAY_IDENTIFIER fm_sta_eprm_sens_tco_h.fm_static_eprm_bitfield.Sbx_rdn_xxx ECU_ADDRESS 0xd0005728 BIT_MASK 0x10 /end MEASUREMENT
/begin MEASUREMENT Sbx_mf_sens_tco_h "" UBYTE _CNV_A_R_A_105_CM 1 0. 0. 255. DISPLAY_IDENTIFIER fm_sta_eprm_sens_tco_h.fm_static_eprm_bitfield.Sbx_mf_xxx ECU_ADDRESS 0xd0005728 BIT_MASK 0x20 /end MEASUREMENT
/begin MEASUREMENT Sbx_cf_sens_tco_h "" UBYTE _CNV_A_R_A_105_CM 1 0. 0. 255. DISPLAY_IDENTIFIER fm_sta_eprm_sens_tco_h.fm_static_eprm_bitfield.Sbx_cf_xxx ECU_ADDRESS 0xd0005728 BIT_MASK 0x80 /end MEASUREMENT
/begin MEASUREMENT Sbx_dyn_sens_tco_l "" UBYTE _CNV_A_R_A_105_CM 1 0. 0. 255. DISPLAY_IDENTIFIER fm_sta_eprm_sens_tco_l.fm_static_eprm_bitfield.Sbx_dyn_xxx ECU_ADDRESS 0xd000572a BIT_MASK 0x8 /end MEASUREMENT
/begin MEASUREMENT Sbx_rdn_sens_tco_l "" UBYTE _CNV_A_R_A_105_CM 1 0. 0. 255. DISPLAY_IDENTIFIER fm_sta_eprm_sens_tco_l.fm_static_eprm_bitfield.Sbx_rdn_xxx ECU_ADDRESS 0xd000572a BIT_MASK 0x10 /end MEASUREMENT
/begin MEASUREMENT Sbx_mf_sens_tco_l "" UBYTE _CNV_A_R_A_105_CM 1 0. 0. 255. DISPLAY_IDENTIFIER fm_sta_eprm_sens_tco_l.fm_static_eprm_bitfield.Sbx_mf_xxx ECU_ADDRESS 0xd000572a BIT_MASK 0x20 /end MEASUREMENT
/begin MEASUREMENT Sbx_cf_sens_tco_l "" UBYTE _CNV_A_R_A_105_CM 1 0. 0. 255. DISPLAY_IDENTIFIER fm_sta_eprm_sens_tco_l.fm_static_eprm_bitfield.Sbx_cf_xxx ECU_ADDRESS 0xd000572a BIT_MASK 0x80 /end MEASUREMENT
/begin MEASUREMENT Sbx_dyn_sens_tco_sig_mcut "" UBYTE _CNV_A_R_A_105_CM 1 0. 0. 255. DISPLAY_IDENTIFIER fm_sta_eprm_sens_tco_sig_mcut.fm_static_eprm_bitfield.Sbx_dyn_xxx ECU_ADDRESS 0xd00057e4 BIT_MASK 0x8 /end MEASUREMENT
/begin MEASUREMENT Sbx_rdn_sens_tco_sig_mcut "" UBYTE _CNV_A_R_A_105_CM 1 0. 0. 255. DISPLAY_IDENTIFIER fm_sta_eprm_sens_tco_sig_mcut.fm_static_eprm_bitfield.Sbx_rdn_xxx ECU_ADDRESS 0xd00057e4 BIT_MASK 0x10 /end MEASUREMENT
/begin MEASUREMENT Sbx_mf_sens_tco_sig_mcut "" UBYTE _CNV_A_R_A_105_CM 1 0. 0. 255. DISPLAY_IDENTIFIER fm_sta_eprm_sens_tco_sig_mcut.fm_static_eprm_bitfield.Sbx_mf_xxx ECU_ADDRESS 0xd00057e4 BIT_MASK 0x20 /end MEASUREMENT
/begin MEASUREMENT Sbx_cf_sens_tco_sig_mcut "" UBYTE _CNV_A_R_A_105_CM 1 0. 0. 255. DISPLAY_IDENTIFIER fm_sta_eprm_sens_tco_sig_mcut.fm_static_eprm_bitfield.Sbx_cf_xxx ECU_ADDRESS 0xd00057e4 BIT_MASK 0x80 /end MEASUREMENT
/begin MEASUREMENT Sbx_dyn_sfty_tq_chr "" UBYTE _CNV_A_R_A_105_CM 1 0. 0. 255. DISPLAY_IDENTIFIER fm_sta_eprm_sfty_tq_chr.fm_static_eprm_bitfield.Sbx_dyn_xxx ECU_ADDRESS 0xd00057bc BIT_MASK 0x8 /end MEASUREMENT
/begin MEASUREMENT Sbx_rdn_sfty_tq_chr "" UBYTE _CNV_A_R_A_105_CM 1 0. 0. 255. DISPLAY_IDENTIFIER fm_sta_eprm_sfty_tq_chr.fm_static_eprm_bitfield.Sbx_rdn_xxx ECU_ADDRESS 0xd00057bc BIT_MASK 0x10 /end MEASUREMENT
/begin MEASUREMENT Sbx_mf_sfty_tq_chr "" UBYTE _CNV_A_R_A_105_CM 1 0. 0. 255. DISPLAY_IDENTIFIER fm_sta_eprm_sfty_tq_chr.fm_static_eprm_bitfield.Sbx_mf_xxx ECU_ADDRESS 0xd00057bc BIT_MASK 0x20 /end MEASUREMENT
/begin MEASUREMENT Sbx_cf_sfty_tq_chr "" UBYTE _CNV_A_R_A_105_CM 1 0. 0. 255. DISPLAY_IDENTIFIER fm_sta_eprm_sfty_tq_chr.fm_static_eprm_bitfield.Sbx_cf_xxx ECU_ADDRESS 0xd00057bc BIT_MASK 0x80 /end MEASUREMENT
/begin MEASUREMENT Sbx_dyn_sfty_tq_clc_chr "" UBYTE _CNV_A_R_A_105_CM 1 0. 0. 255. DISPLAY_IDENTIFIER fm_sta_eprm_sfty_tq_clc_chr.fm_static_eprm_bitfield.Sbx_dyn_xxx ECU_ADDRESS 0xd00057be BIT_MASK 0x8 /end MEASUREMENT
/begin MEASUREMENT Sbx_rdn_sfty_tq_clc_chr "" UBYTE _CNV_A_R_A_105_CM 1 0. 0. 255. DISPLAY_IDENTIFIER fm_sta_eprm_sfty_tq_clc_chr.fm_static_eprm_bitfield.Sbx_rdn_xxx ECU_ADDRESS 0xd00057be BIT_MASK 0x10 /end MEASUREMENT
/begin MEASUREMENT Sbx_mf_sfty_tq_clc_chr "" UBYTE _CNV_A_R_A_105_CM 1 0. 0. 255. DISPLAY_IDENTIFIER fm_sta_eprm_sfty_tq_clc_chr.fm_static_eprm_bitfield.Sbx_mf_xxx ECU_ADDRESS 0xd00057be BIT_MASK 0x20 /end MEASUREMENT
/begin MEASUREMENT Sbx_cf_sfty_tq_clc_chr "" UBYTE _CNV_A_R_A_105_CM 1 0. 0. 255. DISPLAY_IDENTIFIER fm_sta_eprm_sfty_tq_clc_chr.fm_static_eprm_bitfield.Sbx_cf_xxx ECU_ADDRESS 0xd00057be BIT_MASK 0x80 /end MEASUREMENT
/begin MEASUREMENT Sbx_dyn_sfty_tq_lih_chr "" UBYTE _CNV_A_R_A_105_CM 1 0. 0. 255. DISPLAY_IDENTIFIER fm_sta_eprm_sfty_tq_lih_chr.fm_static_eprm_bitfield.Sbx_dyn_xxx ECU_ADDRESS 0xd00057c0 BIT_MASK 0x8 /end MEASUREMENT
/begin MEASUREMENT Sbx_rdn_sfty_tq_lih_chr "" UBYTE _CNV_A_R_A_105_CM 1 0. 0. 255. DISPLAY_IDENTIFIER fm_sta_eprm_sfty_tq_lih_chr.fm_static_eprm_bitfield.Sbx_rdn_xxx ECU_ADDRESS 0xd00057c0 BIT_MASK 0x10 /end MEASUREMENT
/begin MEASUREMENT Sbx_mf_sfty_tq_lih_chr "" UBYTE _CNV_A_R_A_105_CM 1 0. 0. 255. DISPLAY_IDENTIFIER fm_sta_eprm_sfty_tq_lih_chr.fm_static_eprm_bitfield.Sbx_mf_xxx ECU_ADDRESS 0xd00057c0 BIT_MASK 0x20 /end MEASUREMENT
/begin MEASUREMENT Sbx_cf_sfty_tq_lih_chr "" UBYTE _CNV_A_R_A_105_CM 1 0. 0. 255. DISPLAY_IDENTIFIER fm_sta_eprm_sfty_tq_lih_chr.fm_static_eprm_bitfield.Sbx_cf_xxx ECU_ADDRESS 0xd00057c0 BIT_MASK 0x80 /end MEASUREMENT
/begin MEASUREMENT Sbx_dyn_spg_oor "" UBYTE _CNV_A_R_A_105_CM 1 0. 0. 255. DISPLAY_IDENTIFIER fm_sta_eprm_spg_oor.fm_static_eprm_bitfield.Sbx_dyn_xxx ECU_ADDRESS 0xd000579e BIT_MASK 0x8 /end MEASUREMENT
/begin MEASUREMENT Sbx_rdn_spg_oor "" UBYTE _CNV_A_R_A_105_CM 1 0. 0. 255. DISPLAY_IDENTIFIER fm_sta_eprm_spg_oor.fm_static_eprm_bitfield.Sbx_rdn_xxx ECU_ADDRESS 0xd000579e BIT_MASK 0x10 /end MEASUREMENT
/begin MEASUREMENT Sbx_mf_spg_oor "" UBYTE _CNV_A_R_A_105_CM 1 0. 0. 255. DISPLAY_IDENTIFIER fm_sta_eprm_spg_oor.fm_static_eprm_bitfield.Sbx_mf_xxx ECU_ADDRESS 0xd000579e BIT_MASK 0x20 /end MEASUREMENT
/begin MEASUREMENT Sbx_cf_spg_oor "" UBYTE _CNV_A_R_A_105_CM 1 0. 0. 255. DISPLAY_IDENTIFIER fm_sta_eprm_spg_oor.fm_static_eprm_bitfield.Sbx_cf_xxx ECU_ADDRESS 0xd000579e BIT_MASK 0x80 /end MEASUREMENT
/begin MEASUREMENT Sbx_dyn_spg_reg_apl_down "" UBYTE _CNV_A_R_A_105_CM 1 0. 0. 255. DISPLAY_IDENTIFIER fm_sta_eprm_spg_reg_apl_down.fm_static_eprm_bitfield.Sbx_dyn_xxx ECU_ADDRESS 0xd000572c BIT_MASK 0x8 /end MEASUREMENT
/begin MEASUREMENT Sbx_rdn_spg_reg_apl_down "" UBYTE _CNV_A_R_A_105_CM 1 0. 0. 255. DISPLAY_IDENTIFIER fm_sta_eprm_spg_reg_apl_down.fm_static_eprm_bitfield.Sbx_rdn_xxx ECU_ADDRESS 0xd000572c BIT_MASK 0x10 /end MEASUREMENT
/begin MEASUREMENT Sbx_mf_spg_reg_apl_down "" UBYTE _CNV_A_R_A_105_CM 1 0. 0. 255. DISPLAY_IDENTIFIER fm_sta_eprm_spg_reg_apl_down.fm_static_eprm_bitfield.Sbx_mf_xxx ECU_ADDRESS 0xd000572c BIT_MASK 0x20 /end MEASUREMENT
/begin MEASUREMENT Sbx_cf_spg_reg_apl_down "" UBYTE _CNV_A_R_A_105_CM 1 0. 0. 255. DISPLAY_IDENTIFIER fm_sta_eprm_spg_reg_apl_down.fm_static_eprm_bitfield.Sbx_cf_xxx ECU_ADDRESS 0xd000572c BIT_MASK 0x80 /end MEASUREMENT
/begin MEASUREMENT Sbx_dyn_spg_reg_apl_up "" UBYTE _CNV_A_R_A_105_CM 1 0. 0. 255. DISPLAY_IDENTIFIER fm_sta_eprm_spg_reg_apl_up.fm_static_eprm_bitfield.Sbx_dyn_xxx ECU_ADDRESS 0xd000572e BIT_MASK 0x8 /end MEASUREMENT
/begin MEASUREMENT Sbx_rdn_spg_reg_apl_up "" UBYTE _CNV_A_R_A_105_CM 1 0. 0. 255. DISPLAY_IDENTIFIER fm_sta_eprm_spg_reg_apl_up.fm_static_eprm_bitfield.Sbx_rdn_xxx ECU_ADDRESS 0xd000572e BIT_MASK 0x10 /end MEASUREMENT
/begin MEASUREMENT Sbx_mf_spg_reg_apl_up "" UBYTE _CNV_A_R_A_105_CM 1 0. 0. 255. DISPLAY_IDENTIFIER fm_sta_eprm_spg_reg_apl_up.fm_static_eprm_bitfield.Sbx_mf_xxx ECU_ADDRESS 0xd000572e BIT_MASK 0x20 /end MEASUREMENT
/begin MEASUREMENT Sbx_cf_spg_reg_apl_up "" UBYTE _CNV_A_R_A_105_CM 1 0. 0. 255. DISPLAY_IDENTIFIER fm_sta_eprm_spg_reg_apl_up.fm_static_eprm_bitfield.Sbx_cf_xxx ECU_ADDRESS 0xd000572e BIT_MASK 0x80 /end MEASUREMENT
/begin MEASUREMENT Sbx_dyn_tco_cl_no_norm "" UBYTE _CNV_A_R_A_105_CM 1 0. 0. 255. DISPLAY_IDENTIFIER fm_sta_eprm_tco_cl_no_norm.fm_static_eprm_bitfield.Sbx_dyn_xxx ECU_ADDRESS 0xd0005828 BIT_MASK 0x8 /end MEASUREMENT
/begin MEASUREMENT Sbx_rdn_tco_cl_no_norm "" UBYTE _CNV_A_R_A_105_CM 1 0. 0. 255. DISPLAY_IDENTIFIER fm_sta_eprm_tco_cl_no_norm.fm_static_eprm_bitfield.Sbx_rdn_xxx ECU_ADDRESS 0xd0005828 BIT_MASK 0x10 /end MEASUREMENT
/begin MEASUREMENT Sbx_mf_tco_cl_no_norm "" UBYTE _CNV_A_R_A_105_CM 1 0. 0. 255. DISPLAY_IDENTIFIER fm_sta_eprm_tco_cl_no_norm.fm_static_eprm_bitfield.Sbx_mf_xxx ECU_ADDRESS 0xd0005828 BIT_MASK 0x20 /end MEASUREMENT
/begin MEASUREMENT Sbx_cf_tco_cl_no_norm "" UBYTE _CNV_A_R_A_105_CM 1 0. 0. 255. DISPLAY_IDENTIFIER fm_sta_eprm_tco_cl_no_norm.fm_static_eprm_bitfield.Sbx_cf_xxx ECU_ADDRESS 0xd0005828 BIT_MASK 0x80 /end MEASUREMENT
/begin MEASUREMENT Sbx_dyn_tlz_ad_b_cpt "" UBYTE _CNV_A_R_A_105_CM 1 0. 0. 255. DISPLAY_IDENTIFIER fm_sta_eprm_tlz_ad_b_cpt.fm_static_eprm_bitfield.Sbx_dyn_xxx ECU_ADDRESS 0xd00057a0 BIT_MASK 0x8 /end MEASUREMENT
/begin MEASUREMENT Sbx_rdn_tlz_ad_b_cpt "" UBYTE _CNV_A_R_A_105_CM 1 0. 0. 255. DISPLAY_IDENTIFIER fm_sta_eprm_tlz_ad_b_cpt.fm_static_eprm_bitfield.Sbx_rdn_xxx ECU_ADDRESS 0xd00057a0 BIT_MASK 0x10 /end MEASUREMENT
/begin MEASUREMENT Sbx_mf_tlz_ad_b_cpt "" UBYTE _CNV_A_R_A_105_CM 1 0. 0. 255. DISPLAY_IDENTIFIER fm_sta_eprm_tlz_ad_b_cpt.fm_static_eprm_bitfield.Sbx_mf_xxx ECU_ADDRESS 0xd00057a0 BIT_MASK 0x20 /end MEASUREMENT
/begin MEASUREMENT Sbx_cf_tlz_ad_b_cpt "" UBYTE _CNV_A_R_A_105_CM 1 0. 0. 255. DISPLAY_IDENTIFIER fm_sta_eprm_tlz_ad_b_cpt.fm_static_eprm_bitfield.Sbx_cf_xxx ECU_ADDRESS 0xd00057a0 BIT_MASK 0x80 /end MEASUREMENT
/begin MEASUREMENT Sbx_dyn_tsta_reg_no_norm "" UBYTE _CNV_A_R_A_105_CM 1 0. 0. 255. DISPLAY_IDENTIFIER fm_sta_eprm_tsta_reg_no_norm.fm_static_eprm_bitfield.Sbx_dyn_xxx ECU_ADDRESS 0xd000582a BIT_MASK 0x8 /end MEASUREMENT
/begin MEASUREMENT Sbx_rdn_tsta_reg_no_norm "" UBYTE _CNV_A_R_A_105_CM 1 0. 0. 255. DISPLAY_IDENTIFIER fm_sta_eprm_tsta_reg_no_norm.fm_static_eprm_bitfield.Sbx_rdn_xxx ECU_ADDRESS 0xd000582a BIT_MASK 0x10 /end MEASUREMENT
/begin MEASUREMENT Sbx_mf_tsta_reg_no_norm "" UBYTE _CNV_A_R_A_105_CM 1 0. 0. 255. DISPLAY_IDENTIFIER fm_sta_eprm_tsta_reg_no_norm.fm_static_eprm_bitfield.Sbx_mf_xxx ECU_ADDRESS 0xd000582a BIT_MASK 0x20 /end MEASUREMENT
/begin MEASUREMENT Sbx_cf_tsta_reg_no_norm "" UBYTE _CNV_A_R_A_105_CM 1 0. 0. 255. DISPLAY_IDENTIFIER fm_sta_eprm_tsta_reg_no_norm.fm_static_eprm_bitfield.Sbx_cf_xxx ECU_ADDRESS 0xd000582a BIT_MASK 0x80 /end MEASUREMENT
/begin MEASUREMENT Sbx_dyn_vb_clc_chr "" UBYTE _CNV_A_R_A_105_CM 1 0. 0. 255. DISPLAY_IDENTIFIER fm_sta_eprm_vb_clc_chr.fm_static_eprm_bitfield.Sbx_dyn_xxx ECU_ADDRESS 0xd0005822 BIT_MASK 0x8 /end MEASUREMENT
/begin MEASUREMENT Sbx_rdn_vb_clc_chr "" UBYTE _CNV_A_R_A_105_CM 1 0. 0. 255. DISPLAY_IDENTIFIER fm_sta_eprm_vb_clc_chr.fm_static_eprm_bitfield.Sbx_rdn_xxx ECU_ADDRESS 0xd0005822 BIT_MASK 0x10 /end MEASUREMENT
/begin MEASUREMENT Sbx_mf_vb_clc_chr "" UBYTE _CNV_A_R_A_105_CM 1 0. 0. 255. DISPLAY_IDENTIFIER fm_sta_eprm_vb_clc_chr.fm_static_eprm_bitfield.Sbx_mf_xxx ECU_ADDRESS 0xd0005822 BIT_MASK 0x20 /end MEASUREMENT
/begin MEASUREMENT Sbx_cf_vb_clc_chr "" UBYTE _CNV_A_R_A_105_CM 1 0. 0. 255. DISPLAY_IDENTIFIER fm_sta_eprm_vb_clc_chr.fm_static_eprm_bitfield.Sbx_cf_xxx ECU_ADDRESS 0xd0005822 BIT_MASK 0x80 /end MEASUREMENT
/begin MEASUREMENT Sbx_dyn_vb_h "" UBYTE _CNV_A_R_A_105_CM 1 0. 0. 255. DISPLAY_IDENTIFIER fm_sta_eprm_vb_h.fm_static_eprm_bitfield.Sbx_dyn_xxx ECU_ADDRESS 0xd0005730 BIT_MASK 0x8 /end MEASUREMENT
/begin MEASUREMENT Sbx_rdn_vb_h "" UBYTE _CNV_A_R_A_105_CM 1 0. 0. 255. DISPLAY_IDENTIFIER fm_sta_eprm_vb_h.fm_static_eprm_bitfield.Sbx_rdn_xxx ECU_ADDRESS 0xd0005730 BIT_MASK 0x10 /end MEASUREMENT
/begin MEASUREMENT Sbx_mf_vb_h "" UBYTE _CNV_A_R_A_105_CM 1 0. 0. 255. DISPLAY_IDENTIFIER fm_sta_eprm_vb_h.fm_static_eprm_bitfield.Sbx_mf_xxx ECU_ADDRESS 0xd0005730 BIT_MASK 0x20 /end MEASUREMENT
/begin MEASUREMENT Sbx_cf_vb_h "" UBYTE _CNV_A_R_A_105_CM 1 0. 0. 255. DISPLAY_IDENTIFIER fm_sta_eprm_vb_h.fm_static_eprm_bitfield.Sbx_cf_xxx ECU_ADDRESS 0xd0005730 BIT_MASK 0x80 /end MEASUREMENT
/begin MEASUREMENT Sbx_dyn_vb_l "" UBYTE _CNV_A_R_A_105_CM 1 0. 0. 255. DISPLAY_IDENTIFIER fm_sta_eprm_vb_l.fm_static_eprm_bitfield.Sbx_dyn_xxx ECU_ADDRESS 0xd0005732 BIT_MASK 0x8 /end MEASUREMENT
/begin MEASUREMENT Sbx_rdn_vb_l "" UBYTE _CNV_A_R_A_105_CM 1 0. 0. 255. DISPLAY_IDENTIFIER fm_sta_eprm_vb_l.fm_static_eprm_bitfield.Sbx_rdn_xxx ECU_ADDRESS 0xd0005732 BIT_MASK 0x10 /end MEASUREMENT
/begin MEASUREMENT Sbx_mf_vb_l "" UBYTE _CNV_A_R_A_105_CM 1 0. 0. 255. DISPLAY_IDENTIFIER fm_sta_eprm_vb_l.fm_static_eprm_bitfield.Sbx_mf_xxx ECU_ADDRESS 0xd0005732 BIT_MASK 0x20 /end MEASUREMENT
/begin MEASUREMENT Sbx_cf_vb_l "" UBYTE _CNV_A_R_A_105_CM 1 0. 0. 255. DISPLAY_IDENTIFIER fm_sta_eprm_vb_l.fm_static_eprm_bitfield.Sbx_cf_xxx ECU_ADDRESS 0xd0005732 BIT_MASK 0x80 /end MEASUREMENT
/begin MEASUREMENT Sbx_dyn_vb_rly_oc_scg "" UBYTE _CNV_A_R_A_105_CM 1 0. 0. 255. DISPLAY_IDENTIFIER fm_sta_eprm_vb_rly_oc_scg.fm_static_eprm_bitfield.Sbx_dyn_xxx ECU_ADDRESS 0xd0005734 BIT_MASK 0x8 /end MEASUREMENT
/begin MEASUREMENT Sbx_rdn_vb_rly_oc_scg "" UBYTE _CNV_A_R_A_105_CM 1 0. 0. 255. DISPLAY_IDENTIFIER fm_sta_eprm_vb_rly_oc_scg.fm_static_eprm_bitfield.Sbx_rdn_xxx ECU_ADDRESS 0xd0005734 BIT_MASK 0x10 /end MEASUREMENT
/begin MEASUREMENT Sbx_mf_vb_rly_oc_scg "" UBYTE _CNV_A_R_A_105_CM 1 0. 0. 255. DISPLAY_IDENTIFIER fm_sta_eprm_vb_rly_oc_scg.fm_static_eprm_bitfield.Sbx_mf_xxx ECU_ADDRESS 0xd0005734 BIT_MASK 0x20 /end MEASUREMENT
/begin MEASUREMENT Sbx_cf_vb_rly_oc_scg "" UBYTE _CNV_A_R_A_105_CM 1 0. 0. 255. DISPLAY_IDENTIFIER fm_sta_eprm_vb_rly_oc_scg.fm_static_eprm_bitfield.Sbx_cf_xxx ECU_ADDRESS 0xd0005734 BIT_MASK 0x80 /end MEASUREMENT
/begin MEASUREMENT Sbx_dyn_vb_rly_scw "" UBYTE _CNV_A_R_A_105_CM 1 0. 0. 255. DISPLAY_IDENTIFIER fm_sta_eprm_vb_rly_scw.fm_static_eprm_bitfield.Sbx_dyn_xxx ECU_ADDRESS 0xd0005736 BIT_MASK 0x8 /end MEASUREMENT
/begin MEASUREMENT Sbx_rdn_vb_rly_scw "" UBYTE _CNV_A_R_A_105_CM 1 0. 0. 255. DISPLAY_IDENTIFIER fm_sta_eprm_vb_rly_scw.fm_static_eprm_bitfield.Sbx_rdn_xxx ECU_ADDRESS 0xd0005736 BIT_MASK 0x10 /end MEASUREMENT
/begin MEASUREMENT Sbx_mf_vb_rly_scw "" UBYTE _CNV_A_R_A_105_CM 1 0. 0. 255. DISPLAY_IDENTIFIER fm_sta_eprm_vb_rly_scw.fm_static_eprm_bitfield.Sbx_mf_xxx ECU_ADDRESS 0xd0005736 BIT_MASK 0x20 /end MEASUREMENT
/begin MEASUREMENT Sbx_cf_vb_rly_scw "" UBYTE _CNV_A_R_A_105_CM 1 0. 0. 255. DISPLAY_IDENTIFIER fm_sta_eprm_vb_rly_scw.fm_static_eprm_bitfield.Sbx_cf_xxx ECU_ADDRESS 0xd0005736 BIT_MASK 0x80 /end MEASUREMENT
/begin MEASUREMENT Sbx_dyn_wgc_oc "" UBYTE _CNV_A_R_A_105_CM 1 0. 0. 255. DISPLAY_IDENTIFIER fm_sta_eprm_wgc_oc.fm_static_eprm_bitfield.Sbx_dyn_xxx ECU_ADDRESS 0xd00057a2 BIT_MASK 0x8 /end MEASUREMENT
/begin MEASUREMENT Sbx_rdn_wgc_oc "" UBYTE _CNV_A_R_A_105_CM 1 0. 0. 255. DISPLAY_IDENTIFIER fm_sta_eprm_wgc_oc.fm_static_eprm_bitfield.Sbx_rdn_xxx ECU_ADDRESS 0xd00057a2 BIT_MASK 0x10 /end MEASUREMENT
/begin MEASUREMENT Sbx_mf_wgc_oc "" UBYTE _CNV_A_R_A_105_CM 1 0. 0. 255. DISPLAY_IDENTIFIER fm_sta_eprm_wgc_oc.fm_static_eprm_bitfield.Sbx_mf_xxx ECU_ADDRESS 0xd00057a2 BIT_MASK 0x20 /end MEASUREMENT
/begin MEASUREMENT Sbx_cf_wgc_oc "" UBYTE _CNV_A_R_A_105_CM 1 0. 0. 255. DISPLAY_IDENTIFIER fm_sta_eprm_wgc_oc.fm_static_eprm_bitfield.Sbx_cf_xxx ECU_ADDRESS 0xd00057a2 BIT_MASK 0x80 /end MEASUREMENT
/begin MEASUREMENT Sbx_dyn_wgc_scg "" UBYTE _CNV_A_R_A_105_CM 1 0. 0. 255. DISPLAY_IDENTIFIER fm_sta_eprm_wgc_scg.fm_static_eprm_bitfield.Sbx_dyn_xxx ECU_ADDRESS 0xd00057a4 BIT_MASK 0x8 /end MEASUREMENT
/begin MEASUREMENT Sbx_rdn_wgc_scg "" UBYTE _CNV_A_R_A_105_CM 1 0. 0. 255. DISPLAY_IDENTIFIER fm_sta_eprm_wgc_scg.fm_static_eprm_bitfield.Sbx_rdn_xxx ECU_ADDRESS 0xd00057a4 BIT_MASK 0x10 /end MEASUREMENT
/begin MEASUREMENT Sbx_mf_wgc_scg "" UBYTE _CNV_A_R_A_105_CM 1 0. 0. 255. DISPLAY_IDENTIFIER fm_sta_eprm_wgc_scg.fm_static_eprm_bitfield.Sbx_mf_xxx ECU_ADDRESS 0xd00057a4 BIT_MASK 0x20 /end MEASUREMENT
/begin MEASUREMENT Sbx_cf_wgc_scg "" UBYTE _CNV_A_R_A_105_CM 1 0. 0. 255. DISPLAY_IDENTIFIER fm_sta_eprm_wgc_scg.fm_static_eprm_bitfield.Sbx_cf_xxx ECU_ADDRESS 0xd00057a4 BIT_MASK 0x80 /end MEASUREMENT
/begin MEASUREMENT Sbx_dyn_wgc_scw "" UBYTE _CNV_A_R_A_105_CM 1 0. 0. 255. DISPLAY_IDENTIFIER fm_sta_eprm_wgc_scw.fm_static_eprm_bitfield.Sbx_dyn_xxx ECU_ADDRESS 0xd00057a6 BIT_MASK 0x8 /end MEASUREMENT
/begin MEASUREMENT Sbx_rdn_wgc_scw "" UBYTE _CNV_A_R_A_105_CM 1 0. 0. 255. DISPLAY_IDENTIFIER fm_sta_eprm_wgc_scw.fm_static_eprm_bitfield.Sbx_rdn_xxx ECU_ADDRESS 0xd00057a6 BIT_MASK 0x10 /end MEASUREMENT
/begin MEASUREMENT Sbx_mf_wgc_scw "" UBYTE _CNV_A_R_A_105_CM 1 0. 0. 255. DISPLAY_IDENTIFIER fm_sta_eprm_wgc_scw.fm_static_eprm_bitfield.Sbx_mf_xxx ECU_ADDRESS 0xd00057a6 BIT_MASK 0x20 /end MEASUREMENT
/begin MEASUREMENT Sbx_cf_wgc_scw "" UBYTE _CNV_A_R_A_105_CM 1 0. 0. 255. DISPLAY_IDENTIFIER fm_sta_eprm_wgc_scw.fm_static_eprm_bitfield.Sbx_cf_xxx ECU_ADDRESS 0xd00057a6 BIT_MASK 0x80 /end MEASUREMENT
/begin MEASUREMENT Sbx_dyn_wpmp_tcr_blk "" UBYTE _CNV_A_R_A_105_CM 1 0. 0. 255. DISPLAY_IDENTIFIER fm_sta_eprm_wpmp_tcr_blk.fm_static_eprm_bitfield.Sbx_dyn_xxx ECU_ADDRESS 0xd00057ee BIT_MASK 0x8 /end MEASUREMENT
/begin MEASUREMENT Sbx_rdn_wpmp_tcr_blk "" UBYTE _CNV_A_R_A_105_CM 1 0. 0. 255. DISPLAY_IDENTIFIER fm_sta_eprm_wpmp_tcr_blk.fm_static_eprm_bitfield.Sbx_rdn_xxx ECU_ADDRESS 0xd00057ee BIT_MASK 0x10 /end MEASUREMENT
/begin MEASUREMENT Sbx_mf_wpmp_tcr_blk "" UBYTE _CNV_A_R_A_105_CM 1 0. 0. 255. DISPLAY_IDENTIFIER fm_sta_eprm_wpmp_tcr_blk.fm_static_eprm_bitfield.Sbx_mf_xxx ECU_ADDRESS 0xd00057ee BIT_MASK 0x20 /end MEASUREMENT
/begin MEASUREMENT Sbx_cf_wpmp_tcr_blk "" UBYTE _CNV_A_R_A_105_CM 1 0. 0. 255. DISPLAY_IDENTIFIER fm_sta_eprm_wpmp_tcr_blk.fm_static_eprm_bitfield.Sbx_cf_xxx ECU_ADDRESS 0xd00057ee BIT_MASK 0x80 /end MEASUREMENT
/begin MEASUREMENT Sbx_dyn_wpmp_tcr_oc "" UBYTE _CNV_A_R_A_105_CM 1 0. 0. 255. DISPLAY_IDENTIFIER fm_sta_eprm_wpmp_tcr_oc.fm_static_eprm_bitfield.Sbx_dyn_xxx ECU_ADDRESS 0xd00057a8 BIT_MASK 0x8 /end MEASUREMENT
/begin MEASUREMENT Sbx_rdn_wpmp_tcr_oc "" UBYTE _CNV_A_R_A_105_CM 1 0. 0. 255. DISPLAY_IDENTIFIER fm_sta_eprm_wpmp_tcr_oc.fm_static_eprm_bitfield.Sbx_rdn_xxx ECU_ADDRESS 0xd00057a8 BIT_MASK 0x10 /end MEASUREMENT
/begin MEASUREMENT Sbx_mf_wpmp_tcr_oc "" UBYTE _CNV_A_R_A_105_CM 1 0. 0. 255. DISPLAY_IDENTIFIER fm_sta_eprm_wpmp_tcr_oc.fm_static_eprm_bitfield.Sbx_mf_xxx ECU_ADDRESS 0xd00057a8 BIT_MASK 0x20 /end MEASUREMENT
/begin MEASUREMENT Sbx_cf_wpmp_tcr_oc "" UBYTE _CNV_A_R_A_105_CM 1 0. 0. 255. DISPLAY_IDENTIFIER fm_sta_eprm_wpmp_tcr_oc.fm_static_eprm_bitfield.Sbx_cf_xxx ECU_ADDRESS 0xd00057a8 BIT_MASK 0x80 /end MEASUREMENT
/begin MEASUREMENT Sbx_dyn_wpmp_tcr_scg "" UBYTE _CNV_A_R_A_105_CM 1 0. 0. 255. DISPLAY_IDENTIFIER fm_sta_eprm_wpmp_tcr_scg.fm_static_eprm_bitfield.Sbx_dyn_xxx ECU_ADDRESS 0xd00057aa BIT_MASK 0x8 /end MEASUREMENT
/begin MEASUREMENT Sbx_rdn_wpmp_tcr_scg "" UBYTE _CNV_A_R_A_105_CM 1 0. 0. 255. DISPLAY_IDENTIFIER fm_sta_eprm_wpmp_tcr_scg.fm_static_eprm_bitfield.Sbx_rdn_xxx ECU_ADDRESS 0xd00057aa BIT_MASK 0x10 /end MEASUREMENT
/begin MEASUREMENT Sbx_mf_wpmp_tcr_scg "" UBYTE _CNV_A_R_A_105_CM 1 0. 0. 255. DISPLAY_IDENTIFIER fm_sta_eprm_wpmp_tcr_scg.fm_static_eprm_bitfield.Sbx_mf_xxx ECU_ADDRESS 0xd00057aa BIT_MASK 0x20 /end MEASUREMENT
/begin MEASUREMENT Sbx_cf_wpmp_tcr_scg "" UBYTE _CNV_A_R_A_105_CM 1 0. 0. 255. DISPLAY_IDENTIFIER fm_sta_eprm_wpmp_tcr_scg.fm_static_eprm_bitfield.Sbx_cf_xxx ECU_ADDRESS 0xd00057aa BIT_MASK 0x80 /end MEASUREMENT
/begin MEASUREMENT Sbx_dyn_wpmp_tcr_scw "" UBYTE _CNV_A_R_A_105_CM 1 0. 0. 255. DISPLAY_IDENTIFIER fm_sta_eprm_wpmp_tcr_scw.fm_static_eprm_bitfield.Sbx_dyn_xxx ECU_ADDRESS 0xd00057ac BIT_MASK 0x8 /end MEASUREMENT
/begin MEASUREMENT Sbx_rdn_wpmp_tcr_scw "" UBYTE _CNV_A_R_A_105_CM 1 0. 0. 255. DISPLAY_IDENTIFIER fm_sta_eprm_wpmp_tcr_scw.fm_static_eprm_bitfield.Sbx_rdn_xxx ECU_ADDRESS 0xd00057ac BIT_MASK 0x10 /end MEASUREMENT
/begin MEASUREMENT Sbx_mf_wpmp_tcr_scw "" UBYTE _CNV_A_R_A_105_CM 1 0. 0. 255. DISPLAY_IDENTIFIER fm_sta_eprm_wpmp_tcr_scw.fm_static_eprm_bitfield.Sbx_mf_xxx ECU_ADDRESS 0xd00057ac BIT_MASK 0x20 /end MEASUREMENT
/begin MEASUREMENT Sbx_cf_wpmp_tcr_scw "" UBYTE _CNV_A_R_A_105_CM 1 0. 0. 255. DISPLAY_IDENTIFIER fm_sta_eprm_wpmp_tcr_scw.fm_static_eprm_bitfield.Sbx_cf_xxx ECU_ADDRESS 0xd00057ac BIT_MASK 0x80 /end MEASUREMENT
/begin MEASUREMENT Vxx_dfctr_esp_data_chr "" UWORD _CNV_A_R_A_105_CM 1 0. 0. 65535. DISPLAY_IDENTIFIER fm_sta_esp_data_chr.Vxx_dfctr_xxx ECU_ADDRESS 0xd0005228 /end MEASUREMENT
/begin MEASUREMENT Vxx_rdn_esp_data_chr "" UWORD _CNV_A_R_A_105_CM 1 0. 0. 65535. DISPLAY_IDENTIFIER fm_sta_esp_data_chr.Vxx_rdn_xxx ECU_ADDRESS 0xd000522a /end MEASUREMENT
/begin MEASUREMENT Vbx_cf_esp_data_chr "" UBYTE _CNV_A_R_A_105_CM 1 0. 0. 255. DISPLAY_IDENTIFIER fm_sta_esp_data_chr.fm_static_bitfield.Vbx_cf_xxx ECU_ADDRESS 0xd000522c BIT_MASK 0x1 /end MEASUREMENT
/begin MEASUREMENT Vbx_clf_esp_data_chr "" UBYTE _CNV_A_R_A_105_CM 1 0. 0. 255. DISPLAY_IDENTIFIER fm_sta_esp_data_chr.fm_static_bitfield.Vbx_clf_xxx ECU_ADDRESS 0xd000522c BIT_MASK 0x2 /end MEASUREMENT
/begin MEASUREMENT Vbx_df_old_esp_data_chr "" UBYTE _CNV_A_R_A_105_CM 1 0. 0. 255. DISPLAY_IDENTIFIER fm_sta_esp_data_chr.fm_static_bitfield.Vbx_df_old_xxx ECU_ADDRESS 0xd000522c BIT_MASK 0x4 /end MEASUREMENT
/begin MEASUREMENT Vbx_dfctr_sat_esp_data_chr "" UBYTE _CNV_A_R_A_105_CM 1 0. 0. 255. DISPLAY_IDENTIFIER fm_sta_esp_data_chr.fm_static_bitfield.Vbx_dfctr_sat_xxx ECU_ADDRESS 0xd000522c BIT_MASK 0x8 /end MEASUREMENT
/begin MEASUREMENT Vbx_rdn_esp_data_chr "" UBYTE _CNV_A_R_A_105_CM 1 0. 0. 255. DISPLAY_IDENTIFIER fm_sta_esp_data_chr.fm_static_bitfield.Vbx_rdn_xxx ECU_ADDRESS 0xd000522c BIT_MASK 0x40 /end MEASUREMENT
/begin MEASUREMENT Vxx_dtc_stt_esp_data_chr "" UBYTE _CNV_A_R_A_105_CM 1 0. 0. 255. DISPLAY_IDENTIFIER fm_sta_esp_data_chr.Vxx_dtc_stt_xxx ECU_ADDRESS 0xd000522d /end MEASUREMENT
/begin MEASUREMENT Vxx_dfctr_esp_data_seq_ctr "" UWORD _CNV_A_R_A_105_CM 1 0. 0. 65535. DISPLAY_IDENTIFIER fm_sta_esp_data_seq_ctr.Vxx_dfctr_xxx ECU_ADDRESS 0xd000522e /end MEASUREMENT
/begin MEASUREMENT Vxx_rdn_esp_data_seq_ctr "" UWORD _CNV_A_R_A_105_CM 1 0. 0. 65535. DISPLAY_IDENTIFIER fm_sta_esp_data_seq_ctr.Vxx_rdn_xxx ECU_ADDRESS 0xd0005230 /end MEASUREMENT
/begin MEASUREMENT Vbx_cf_esp_data_seq_ctr "" UBYTE _CNV_A_R_A_105_CM 1 0. 0. 255. DISPLAY_IDENTIFIER fm_sta_esp_data_seq_ctr.fm_static_bitfield.Vbx_cf_xxx ECU_ADDRESS 0xd0005232 BIT_MASK 0x1 /end MEASUREMENT
/begin MEASUREMENT Vbx_clf_esp_data_seq_ctr "" UBYTE _CNV_A_R_A_105_CM 1 0. 0. 255. DISPLAY_IDENTIFIER fm_sta_esp_data_seq_ctr.fm_static_bitfield.Vbx_clf_xxx ECU_ADDRESS 0xd0005232 BIT_MASK 0x2 /end MEASUREMENT
/begin MEASUREMENT Vbx_df_old_esp_data_seq_ctr "" UBYTE _CNV_A_R_A_105_CM 1 0. 0. 255. DISPLAY_IDENTIFIER fm_sta_esp_data_seq_ctr.fm_static_bitfield.Vbx_df_old_xxx ECU_ADDRESS 0xd0005232 BIT_MASK 0x4 /end MEASUREMENT
/begin MEASUREMENT Vbx_dfctr_sat_esp_data_seq_ctr "" UBYTE _CNV_A_R_A_105_CM 1 0. 0. 255. DISPLAY_IDENTIFIER fm_sta_esp_data_seq_ctr.fm_static_bitfield.Vbx_dfctr_sat_xxx ECU_ADDRESS 0xd0005232 BIT_MASK 0x8 /end MEASUREMENT
/begin MEASUREMENT Vbx_rdn_esp_data_seq_ctr "" UBYTE _CNV_A_R_A_105_CM 1 0. 0. 255. DISPLAY_IDENTIFIER fm_sta_esp_data_seq_ctr.fm_static_bitfield.Vbx_rdn_xxx ECU_ADDRESS 0xd0005232 BIT_MASK 0x40 /end MEASUREMENT
/begin MEASUREMENT Vxx_dtc_stt_esp_data_seq_ctr "" UBYTE _CNV_A_R_A_105_CM 1 0. 0. 255. DISPLAY_IDENTIFIER fm_sta_esp_data_seq_ctr.Vxx_dtc_stt_xxx ECU_ADDRESS 0xd0005233 /end MEASUREMENT
/begin MEASUREMENT Vxx_dfctr_esp_no_frm "" UWORD _CNV_A_R_A_105_CM 1 0. 0. 65535. DISPLAY_IDENTIFIER fm_sta_esp_no_frm.Vxx_dfctr_xxx ECU_ADDRESS 0xd0005234 /end MEASUREMENT
/begin MEASUREMENT Vxx_rdn_esp_no_frm "" UWORD _CNV_A_R_A_105_CM 1 0. 0. 65535. DISPLAY_IDENTIFIER fm_sta_esp_no_frm.Vxx_rdn_xxx ECU_ADDRESS 0xd0005236 /end MEASUREMENT
/begin MEASUREMENT Vbx_cf_esp_no_frm "" UBYTE _CNV_A_R_A_105_CM 1 0. 0. 255. DISPLAY_IDENTIFIER fm_sta_esp_no_frm.fm_static_bitfield.Vbx_cf_xxx ECU_ADDRESS 0xd0005238 BIT_MASK 0x1 /end MEASUREMENT
/begin MEASUREMENT Vbx_clf_esp_no_frm "" UBYTE _CNV_A_R_A_105_CM 1 0. 0. 255. DISPLAY_IDENTIFIER fm_sta_esp_no_frm.fm_static_bitfield.Vbx_clf_xxx ECU_ADDRESS 0xd0005238 BIT_MASK 0x2 /end MEASUREMENT
/begin MEASUREMENT Vbx_df_old_esp_no_frm "" UBYTE _CNV_A_R_A_105_CM 1 0. 0. 255. DISPLAY_IDENTIFIER fm_sta_esp_no_frm.fm_static_bitfield.Vbx_df_old_xxx ECU_ADDRESS 0xd0005238 BIT_MASK 0x4 /end MEASUREMENT
/begin MEASUREMENT Vbx_dfctr_sat_esp_no_frm "" UBYTE _CNV_A_R_A_105_CM 1 0. 0. 255. DISPLAY_IDENTIFIER fm_sta_esp_no_frm.fm_static_bitfield.Vbx_dfctr_sat_xxx ECU_ADDRESS 0xd0005238 BIT_MASK 0x8 /end MEASUREMENT
/begin MEASUREMENT Vbx_rdn_esp_no_frm "" UBYTE _CNV_A_R_A_105_CM 1 0. 0. 255. DISPLAY_IDENTIFIER fm_sta_esp_no_frm.fm_static_bitfield.Vbx_rdn_xxx ECU_ADDRESS 0xd0005238 BIT_MASK 0x40 /end MEASUREMENT
/begin MEASUREMENT Vxx_dtc_stt_esp_no_frm "" UBYTE _CNV_A_R_A_105_CM 1 0. 0. 255. DISPLAY_IDENTIFIER fm_sta_esp_no_frm.Vxx_dtc_stt_xxx ECU_ADDRESS 0xd0005239 /end MEASUREMENT
/begin MEASUREMENT Vxx_dfctr_eva_fcap_abn_cple "" UWORD _CNV_A_R_A_105_CM 1 0. 0. 65535. DISPLAY_IDENTIFIER fm_sta_eva_fcap_abn_cple.Vxx_dfctr_xxx ECU_ADDRESS 0xd00055c4 /end MEASUREMENT
/begin MEASUREMENT Vxx_rdn_eva_fcap_abn_cple "" UWORD _CNV_A_R_A_105_CM 1 0. 0. 65535. DISPLAY_IDENTIFIER fm_sta_eva_fcap_abn_cple.Vxx_rdn_xxx ECU_ADDRESS 0xd00055c6 /end MEASUREMENT
/begin MEASUREMENT Vbx_cf_eva_fcap_abn_cple "" UBYTE _CNV_A_R_A_105_CM 1 0. 0. 255. DISPLAY_IDENTIFIER fm_sta_eva_fcap_abn_cple.fm_static_bitfield.Vbx_cf_xxx ECU_ADDRESS 0xd00055c8 BIT_MASK 0x1 /end MEASUREMENT
/begin MEASUREMENT Vbx_clf_eva_fcap_abn_cple "" UBYTE _CNV_A_R_A_105_CM 1 0. 0. 255. DISPLAY_IDENTIFIER fm_sta_eva_fcap_abn_cple.fm_static_bitfield.Vbx_clf_xxx ECU_ADDRESS 0xd00055c8 BIT_MASK 0x2 /end MEASUREMENT
/begin MEASUREMENT Vbx_df_old_eva_fcap_abn_cple "" UBYTE _CNV_A_R_A_105_CM 1 0. 0. 255. DISPLAY_IDENTIFIER fm_sta_eva_fcap_abn_cple.fm_static_bitfield.Vbx_df_old_xxx ECU_ADDRESS 0xd00055c8 BIT_MASK 0x4 /end MEASUREMENT
/begin MEASUREMENT Vbx_dfctr_sat_eva_fcap_abn_cple "" UBYTE _CNV_A_R_A_105_CM 1 0. 0. 255. DISPLAY_IDENTIFIER fm_sta_eva_fcap_abn_cple.fm_static_bitfield.Vbx_dfctr_sat_xxx ECU_ADDRESS 0xd00055c8 BIT_MASK 0x8 /end MEASUREMENT
/begin MEASUREMENT Vbx_rdn_eva_fcap_abn_cple "" UBYTE _CNV_A_R_A_105_CM 1 0. 0. 255. DISPLAY_IDENTIFIER fm_sta_eva_fcap_abn_cple.fm_static_bitfield.Vbx_rdn_xxx ECU_ADDRESS 0xd00055c8 BIT_MASK 0x40 /end MEASUREMENT
/begin MEASUREMENT Vxx_dtc_stt_eva_fcap_abn_cple "" UBYTE _CNV_A_R_A_105_CM 1 0. 0. 255. DISPLAY_IDENTIFIER fm_sta_eva_fcap_abn_cple.Vxx_dtc_stt_xxx ECU_ADDRESS 0xd00055c9 /end MEASUREMENT
/begin MEASUREMENT Vxx_dfctr_eva_fcap_no_lk "" UWORD _CNV_A_R_A_105_CM 1 0. 0. 65535. DISPLAY_IDENTIFIER fm_sta_eva_fcap_no_lk.Vxx_dfctr_xxx ECU_ADDRESS 0xd00055ca /end MEASUREMENT
/begin MEASUREMENT Vxx_rdn_eva_fcap_no_lk "" UWORD _CNV_A_R_A_105_CM 1 0. 0. 65535. DISPLAY_IDENTIFIER fm_sta_eva_fcap_no_lk.Vxx_rdn_xxx ECU_ADDRESS 0xd00055cc /end MEASUREMENT
/begin MEASUREMENT Vbx_cf_eva_fcap_no_lk "" UBYTE _CNV_A_R_A_105_CM 1 0. 0. 255. DISPLAY_IDENTIFIER fm_sta_eva_fcap_no_lk.fm_static_bitfield.Vbx_cf_xxx ECU_ADDRESS 0xd00055ce BIT_MASK 0x1 /end MEASUREMENT
/begin MEASUREMENT Vbx_clf_eva_fcap_no_lk "" UBYTE _CNV_A_R_A_105_CM 1 0. 0. 255. DISPLAY_IDENTIFIER fm_sta_eva_fcap_no_lk.fm_static_bitfield.Vbx_clf_xxx ECU_ADDRESS 0xd00055ce BIT_MASK 0x2 /end MEASUREMENT
/begin MEASUREMENT Vbx_df_old_eva_fcap_no_lk "" UBYTE _CNV_A_R_A_105_CM 1 0. 0. 255. DISPLAY_IDENTIFIER fm_sta_eva_fcap_no_lk.fm_static_bitfield.Vbx_df_old_xxx ECU_ADDRESS 0xd00055ce BIT_MASK 0x4 /end MEASUREMENT
/begin MEASUREMENT Vbx_dfctr_sat_eva_fcap_no_lk "" UBYTE _CNV_A_R_A_105_CM 1 0. 0. 255. DISPLAY_IDENTIFIER fm_sta_eva_fcap_no_lk.fm_static_bitfield.Vbx_dfctr_sat_xxx ECU_ADDRESS 0xd00055ce BIT_MASK 0x8 /end MEASUREMENT
/begin MEASUREMENT Vbx_rdn_eva_fcap_no_lk "" UBYTE _CNV_A_R_A_105_CM 1 0. 0. 255. DISPLAY_IDENTIFIER fm_sta_eva_fcap_no_lk.fm_static_bitfield.Vbx_rdn_xxx ECU_ADDRESS 0xd00055ce BIT_MASK 0x40 /end MEASUREMENT
/begin MEASUREMENT Vxx_dtc_stt_eva_fcap_no_lk "" UBYTE _CNV_A_R_A_105_CM 1 0. 0. 255. DISPLAY_IDENTIFIER fm_sta_eva_fcap_no_lk.Vxx_dtc_stt_xxx ECU_ADDRESS 0xd00055cf /end MEASUREMENT
/begin MEASUREMENT Vxx_dfctr_eva_sldv_blk_clos "" UWORD _CNV_A_R_A_105_CM 1 0. 0. 65535. DISPLAY_IDENTIFIER fm_sta_eva_sldv_blk_clos.Vxx_dfctr_xxx ECU_ADDRESS 0xd00055d6 /end MEASUREMENT
/begin MEASUREMENT Vxx_rdn_eva_sldv_blk_clos "" UWORD _CNV_A_R_A_105_CM 1 0. 0. 65535. DISPLAY_IDENTIFIER fm_sta_eva_sldv_blk_clos.Vxx_rdn_xxx ECU_ADDRESS 0xd00055d8 /end MEASUREMENT
/begin MEASUREMENT Vbx_cf_eva_sldv_blk_clos "" UBYTE _CNV_A_R_A_105_CM 1 0. 0. 255. DISPLAY_IDENTIFIER fm_sta_eva_sldv_blk_clos.fm_static_bitfield.Vbx_cf_xxx ECU_ADDRESS 0xd00055da BIT_MASK 0x1 /end MEASUREMENT
/begin MEASUREMENT Vbx_clf_eva_sldv_blk_clos "" UBYTE _CNV_A_R_A_105_CM 1 0. 0. 255. DISPLAY_IDENTIFIER fm_sta_eva_sldv_blk_clos.fm_static_bitfield.Vbx_clf_xxx ECU_ADDRESS 0xd00055da BIT_MASK 0x2 /end MEASUREMENT
/begin MEASUREMENT Vbx_df_old_eva_sldv_blk_clos "" UBYTE _CNV_A_R_A_105_CM 1 0. 0. 255. DISPLAY_IDENTIFIER fm_sta_eva_sldv_blk_clos.fm_static_bitfield.Vbx_df_old_xxx ECU_ADDRESS 0xd00055da BIT_MASK 0x4 /end MEASUREMENT
/begin MEASUREMENT Vbx_dfctr_sat_eva_sldv_blk_clos "" UBYTE _CNV_A_R_A_105_CM 1 0. 0. 255. DISPLAY_IDENTIFIER fm_sta_eva_sldv_blk_clos.fm_static_bitfield.Vbx_dfctr_sat_xxx ECU_ADDRESS 0xd00055da BIT_MASK 0x8 /end MEASUREMENT
/begin MEASUREMENT Vbx_rdn_eva_sldv_blk_clos "" UBYTE _CNV_A_R_A_105_CM 1 0. 0. 255. DISPLAY_IDENTIFIER fm_sta_eva_sldv_blk_clos.fm_static_bitfield.Vbx_rdn_xxx ECU_ADDRESS 0xd00055da BIT_MASK 0x40 /end MEASUREMENT
/begin MEASUREMENT Vxx_dtc_stt_eva_sldv_blk_clos "" UBYTE _CNV_A_R_A_105_CM 1 0. 0. 255. DISPLAY_IDENTIFIER fm_sta_eva_sldv_blk_clos.Vxx_dtc_stt_xxx ECU_ADDRESS 0xd00055db /end MEASUREMENT
/begin MEASUREMENT Vxx_dfctr_eva_sldv_oc "" UWORD _CNV_A_R_A_105_CM 1 0. 0. 65535. DISPLAY_IDENTIFIER fm_sta_eva_sldv_oc.Vxx_dfctr_xxx ECU_ADDRESS 0xd00055dc /end MEASUREMENT
/begin MEASUREMENT Vxx_rdn_eva_sldv_oc "" UWORD _CNV_A_R_A_105_CM 1 0. 0. 65535. DISPLAY_IDENTIFIER fm_sta_eva_sldv_oc.Vxx_rdn_xxx ECU_ADDRESS 0xd00055de /end MEASUREMENT
/begin MEASUREMENT Vbx_cf_eva_sldv_oc "" UBYTE _CNV_A_R_A_105_CM 1 0. 0. 255. DISPLAY_IDENTIFIER fm_sta_eva_sldv_oc.fm_static_bitfield.Vbx_cf_xxx ECU_ADDRESS 0xd00055e0 BIT_MASK 0x1 /end MEASUREMENT
/begin MEASUREMENT Vbx_clf_eva_sldv_oc "" UBYTE _CNV_A_R_A_105_CM 1 0. 0. 255. DISPLAY_IDENTIFIER fm_sta_eva_sldv_oc.fm_static_bitfield.Vbx_clf_xxx ECU_ADDRESS 0xd00055e0 BIT_MASK 0x2 /end MEASUREMENT
/begin MEASUREMENT Vbx_df_old_eva_sldv_oc "" UBYTE _CNV_A_R_A_105_CM 1 0. 0. 255. DISPLAY_IDENTIFIER fm_sta_eva_sldv_oc.fm_static_bitfield.Vbx_df_old_xxx ECU_ADDRESS 0xd00055e0 BIT_MASK 0x4 /end MEASUREMENT
/begin MEASUREMENT Vbx_dfctr_sat_eva_sldv_oc "" UBYTE _CNV_A_R_A_105_CM 1 0. 0. 255. DISPLAY_IDENTIFIER fm_sta_eva_sldv_oc.fm_static_bitfield.Vbx_dfctr_sat_xxx ECU_ADDRESS 0xd00055e0 BIT_MASK 0x8 /end MEASUREMENT
/begin MEASUREMENT Vbx_rdn_eva_sldv_oc "" UBYTE _CNV_A_R_A_105_CM 1 0. 0. 255. DISPLAY_IDENTIFIER fm_sta_eva_sldv_oc.fm_static_bitfield.Vbx_rdn_xxx ECU_ADDRESS 0xd00055e0 BIT_MASK 0x40 /end MEASUREMENT
/begin MEASUREMENT Vxx_dtc_stt_eva_sldv_oc "" UBYTE _CNV_A_R_A_105_CM 1 0. 0. 255. DISPLAY_IDENTIFIER fm_sta_eva_sldv_oc.Vxx_dtc_stt_xxx ECU_ADDRESS 0xd00055e1 /end MEASUREMENT
/begin MEASUREMENT Vxx_dfctr_eva_sldv_scg "" UWORD _CNV_A_R_A_105_CM 1 0. 0. 65535. DISPLAY_IDENTIFIER fm_sta_eva_sldv_scg.Vxx_dfctr_xxx ECU_ADDRESS 0xd00055e2 /end MEASUREMENT
/begin MEASUREMENT Vxx_rdn_eva_sldv_scg "" UWORD _CNV_A_R_A_105_CM 1 0. 0. 65535. DISPLAY_IDENTIFIER fm_sta_eva_sldv_scg.Vxx_rdn_xxx ECU_ADDRESS 0xd00055e4 /end MEASUREMENT
/begin MEASUREMENT Vbx_cf_eva_sldv_scg "" UBYTE _CNV_A_R_A_105_CM 1 0. 0. 255. DISPLAY_IDENTIFIER fm_sta_eva_sldv_scg.fm_static_bitfield.Vbx_cf_xxx ECU_ADDRESS 0xd00055e6 BIT_MASK 0x1 /end MEASUREMENT
/begin MEASUREMENT Vbx_clf_eva_sldv_scg "" UBYTE _CNV_A_R_A_105_CM 1 0. 0. 255. DISPLAY_IDENTIFIER fm_sta_eva_sldv_scg.fm_static_bitfield.Vbx_clf_xxx ECU_ADDRESS 0xd00055e6 BIT_MASK 0x2 /end MEASUREMENT
/begin MEASUREMENT Vbx_df_old_eva_sldv_scg "" UBYTE _CNV_A_R_A_105_CM 1 0. 0. 255. DISPLAY_IDENTIFIER fm_sta_eva_sldv_scg.fm_static_bitfield.Vbx_df_old_xxx ECU_ADDRESS 0xd00055e6 BIT_MASK 0x4 /end MEASUREMENT
/begin MEASUREMENT Vbx_dfctr_sat_eva_sldv_scg "" UBYTE _CNV_A_R_A_105_CM 1 0. 0. 255. DISPLAY_IDENTIFIER fm_sta_eva_sldv_scg.fm_static_bitfield.Vbx_dfctr_sat_xxx ECU_ADDRESS 0xd00055e6 BIT_MASK 0x8 /end MEASUREMENT
/begin MEASUREMENT Vbx_rdn_eva_sldv_scg "" UBYTE _CNV_A_R_A_105_CM 1 0. 0. 255. DISPLAY_IDENTIFIER fm_sta_eva_sldv_scg.fm_static_bitfield.Vbx_rdn_xxx ECU_ADDRESS 0xd00055e6 BIT_MASK 0x40 /end MEASUREMENT
/begin MEASUREMENT Vxx_dtc_stt_eva_sldv_scg "" UBYTE _CNV_A_R_A_105_CM 1 0. 0. 255. DISPLAY_IDENTIFIER fm_sta_eva_sldv_scg.Vxx_dtc_stt_xxx ECU_ADDRESS 0xd00055e7 /end MEASUREMENT
/begin MEASUREMENT Vxx_dfctr_eva_sldv_scw "" UWORD _CNV_A_R_A_105_CM 1 0. 0. 65535. DISPLAY_IDENTIFIER fm_sta_eva_sldv_scw.Vxx_dfctr_xxx ECU_ADDRESS 0xd00055e8 /end MEASUREMENT
/begin MEASUREMENT Vxx_rdn_eva_sldv_scw "" UWORD _CNV_A_R_A_105_CM 1 0. 0. 65535. DISPLAY_IDENTIFIER fm_sta_eva_sldv_scw.Vxx_rdn_xxx ECU_ADDRESS 0xd00055ea /end MEASUREMENT
/begin MEASUREMENT Vbx_cf_eva_sldv_scw "" UBYTE _CNV_A_R_A_105_CM 1 0. 0. 255. DISPLAY_IDENTIFIER fm_sta_eva_sldv_scw.fm_static_bitfield.Vbx_cf_xxx ECU_ADDRESS 0xd00055ec BIT_MASK 0x1 /end MEASUREMENT
/begin MEASUREMENT Vbx_clf_eva_sldv_scw "" UBYTE _CNV_A_R_A_105_CM 1 0. 0. 255. DISPLAY_IDENTIFIER fm_sta_eva_sldv_scw.fm_static_bitfield.Vbx_clf_xxx ECU_ADDRESS 0xd00055ec BIT_MASK 0x2 /end MEASUREMENT
/begin MEASUREMENT Vbx_df_old_eva_sldv_scw "" UBYTE _CNV_A_R_A_105_CM 1 0. 0. 255. DISPLAY_IDENTIFIER fm_sta_eva_sldv_scw.fm_static_bitfield.Vbx_df_old_xxx ECU_ADDRESS 0xd00055ec BIT_MASK 0x4 /end MEASUREMENT
/begin MEASUREMENT Vbx_dfctr_sat_eva_sldv_scw "" UBYTE _CNV_A_R_A_105_CM 1 0. 0. 255. DISPLAY_IDENTIFIER fm_sta_eva_sldv_scw.fm_static_bitfield.Vbx_dfctr_sat_xxx ECU_ADDRESS 0xd00055ec BIT_MASK 0x8 /end MEASUREMENT
/begin MEASUREMENT Vbx_rdn_eva_sldv_scw "" UBYTE _CNV_A_R_A_105_CM 1 0. 0. 255. DISPLAY_IDENTIFIER fm_sta_eva_sldv_scw.fm_static_bitfield.Vbx_rdn_xxx ECU_ADDRESS 0xd00055ec BIT_MASK 0x40 /end MEASUREMENT
/begin MEASUREMENT Vxx_dtc_stt_eva_sldv_scw "" UBYTE _CNV_A_R_A_105_CM 1 0. 0. 255. DISPLAY_IDENTIFIER fm_sta_eva_sldv_scw.Vxx_dtc_stt_xxx ECU_ADDRESS 0xd00055ed /end MEASUREMENT
/begin MEASUREMENT Vxx_dfctr_evap_chr "" UWORD _CNV_A_R_A_105_CM 1 0. 0. 65535. DISPLAY_IDENTIFIER fm_sta_evap_chr.Vxx_dfctr_xxx ECU_ADDRESS 0xd00055be /end MEASUREMENT
/begin MEASUREMENT Vxx_rdn_evap_chr "" UWORD _CNV_A_R_A_105_CM 1 0. 0. 65535. DISPLAY_IDENTIFIER fm_sta_evap_chr.Vxx_rdn_xxx ECU_ADDRESS 0xd00055c0 /end MEASUREMENT
/begin MEASUREMENT Vbx_cf_evap_chr "" UBYTE _CNV_A_R_A_105_CM 1 0. 0. 255. DISPLAY_IDENTIFIER fm_sta_evap_chr.fm_static_bitfield.Vbx_cf_xxx ECU_ADDRESS 0xd00055c2 BIT_MASK 0x1 /end MEASUREMENT
/begin MEASUREMENT Vbx_clf_evap_chr "" UBYTE _CNV_A_R_A_105_CM 1 0. 0. 255. DISPLAY_IDENTIFIER fm_sta_evap_chr.fm_static_bitfield.Vbx_clf_xxx ECU_ADDRESS 0xd00055c2 BIT_MASK 0x2 /end MEASUREMENT
/begin MEASUREMENT Vbx_df_old_evap_chr "" UBYTE _CNV_A_R_A_105_CM 1 0. 0. 255. DISPLAY_IDENTIFIER fm_sta_evap_chr.fm_static_bitfield.Vbx_df_old_xxx ECU_ADDRESS 0xd00055c2 BIT_MASK 0x4 /end MEASUREMENT
/begin MEASUREMENT Vbx_dfctr_sat_evap_chr "" UBYTE _CNV_A_R_A_105_CM 1 0. 0. 255. DISPLAY_IDENTIFIER fm_sta_evap_chr.fm_static_bitfield.Vbx_dfctr_sat_xxx ECU_ADDRESS 0xd00055c2 BIT_MASK 0x8 /end MEASUREMENT
/begin MEASUREMENT Vbx_rdn_evap_chr "" UBYTE _CNV_A_R_A_105_CM 1 0. 0. 255. DISPLAY_IDENTIFIER fm_sta_evap_chr.fm_static_bitfield.Vbx_rdn_xxx ECU_ADDRESS 0xd00055c2 BIT_MASK 0x40 /end MEASUREMENT
/begin MEASUREMENT Vxx_dtc_stt_evap_chr "" UBYTE _CNV_A_R_A_105_CM 1 0. 0. 255. DISPLAY_IDENTIFIER fm_sta_evap_chr.Vxx_dtc_stt_xxx ECU_ADDRESS 0xd00055c3 /end MEASUREMENT
/begin MEASUREMENT Vxx_dfctr_evap_lkg "" UWORD _CNV_A_R_A_105_CM 1 0. 0. 65535. DISPLAY_IDENTIFIER fm_sta_evap_lkg.Vxx_dfctr_xxx ECU_ADDRESS 0xd00055d0 /end MEASUREMENT
/begin MEASUREMENT Vxx_rdn_evap_lkg "" UWORD _CNV_A_R_A_105_CM 1 0. 0. 65535. DISPLAY_IDENTIFIER fm_sta_evap_lkg.Vxx_rdn_xxx ECU_ADDRESS 0xd00055d2 /end MEASUREMENT
/begin MEASUREMENT Vbx_cf_evap_lkg "" UBYTE _CNV_A_R_A_105_CM 1 0. 0. 255. DISPLAY_IDENTIFIER fm_sta_evap_lkg.fm_static_bitfield.Vbx_cf_xxx ECU_ADDRESS 0xd00055d4 BIT_MASK 0x1 /end MEASUREMENT
/begin MEASUREMENT Vbx_clf_evap_lkg "" UBYTE _CNV_A_R_A_105_CM 1 0. 0. 255. DISPLAY_IDENTIFIER fm_sta_evap_lkg.fm_static_bitfield.Vbx_clf_xxx ECU_ADDRESS 0xd00055d4 BIT_MASK 0x2 /end MEASUREMENT
/begin MEASUREMENT Vbx_df_old_evap_lkg "" UBYTE _CNV_A_R_A_105_CM 1 0. 0. 255. DISPLAY_IDENTIFIER fm_sta_evap_lkg.fm_static_bitfield.Vbx_df_old_xxx ECU_ADDRESS 0xd00055d4 BIT_MASK 0x4 /end MEASUREMENT
/begin MEASUREMENT Vbx_dfctr_sat_evap_lkg "" UBYTE _CNV_A_R_A_105_CM 1 0. 0. 255. DISPLAY_IDENTIFIER fm_sta_evap_lkg.fm_static_bitfield.Vbx_dfctr_sat_xxx ECU_ADDRESS 0xd00055d4 BIT_MASK 0x8 /end MEASUREMENT
/begin MEASUREMENT Vbx_rdn_evap_lkg "" UBYTE _CNV_A_R_A_105_CM 1 0. 0. 255. DISPLAY_IDENTIFIER fm_sta_evap_lkg.fm_static_bitfield.Vbx_rdn_xxx ECU_ADDRESS 0xd00055d4 BIT_MASK 0x40 /end MEASUREMENT
/begin MEASUREMENT Vxx_dtc_stt_evap_lkg "" UBYTE _CNV_A_R_A_105_CM 1 0. 0. 255. DISPLAY_IDENTIFIER fm_sta_evap_lkg.Vxx_dtc_stt_xxx ECU_ADDRESS 0xd00055d5 /end MEASUREMENT
/begin MEASUREMENT Vxx_dfctr_fsys_cpt "" UWORD _CNV_A_R_A_105_CM 1 0. 0. 65535. DISPLAY_IDENTIFIER fm_sta_fsys_cpt.Vxx_dfctr_xxx ECU_ADDRESS 0xd00053f0 /end MEASUREMENT
/begin MEASUREMENT Vxx_rdn_fsys_cpt "" UWORD _CNV_A_R_A_105_CM 1 0. 0. 65535. DISPLAY_IDENTIFIER fm_sta_fsys_cpt.Vxx_rdn_xxx ECU_ADDRESS 0xd00053f2 /end MEASUREMENT
/begin MEASUREMENT Vbx_cf_fsys_cpt "" UBYTE _CNV_A_R_A_105_CM 1 0. 0. 255. DISPLAY_IDENTIFIER fm_sta_fsys_cpt.fm_static_bitfield.Vbx_cf_xxx ECU_ADDRESS 0xd00053f4 BIT_MASK 0x1 /end MEASUREMENT
/begin MEASUREMENT Vbx_clf_fsys_cpt "" UBYTE _CNV_A_R_A_105_CM 1 0. 0. 255. DISPLAY_IDENTIFIER fm_sta_fsys_cpt.fm_static_bitfield.Vbx_clf_xxx ECU_ADDRESS 0xd00053f4 BIT_MASK 0x2 /end MEASUREMENT
/begin MEASUREMENT Vbx_df_old_fsys_cpt "" UBYTE _CNV_A_R_A_105_CM 1 0. 0. 255. DISPLAY_IDENTIFIER fm_sta_fsys_cpt.fm_static_bitfield.Vbx_df_old_xxx ECU_ADDRESS 0xd00053f4 BIT_MASK 0x4 /end MEASUREMENT
/begin MEASUREMENT Vbx_dfctr_sat_fsys_cpt "" UBYTE _CNV_A_R_A_105_CM 1 0. 0. 255. DISPLAY_IDENTIFIER fm_sta_fsys_cpt.fm_static_bitfield.Vbx_dfctr_sat_xxx ECU_ADDRESS 0xd00053f4 BIT_MASK 0x8 /end MEASUREMENT
/begin MEASUREMENT Vbx_rdn_fsys_cpt "" UBYTE _CNV_A_R_A_105_CM 1 0. 0. 255. DISPLAY_IDENTIFIER fm_sta_fsys_cpt.fm_static_bitfield.Vbx_rdn_xxx ECU_ADDRESS 0xd00053f4 BIT_MASK 0x40 /end MEASUREMENT
/begin MEASUREMENT Vxx_dtc_stt_fsys_cpt "" UBYTE _CNV_A_R_A_105_CM 1 0. 0. 255. DISPLAY_IDENTIFIER fm_sta_fsys_cpt.Vxx_dtc_stt_xxx ECU_ADDRESS 0xd00053f5 /end MEASUREMENT
/begin MEASUREMENT Vxx_dfctr_gas_pump_2_oc "" UWORD _CNV_A_R_A_105_CM 1 0. 0. 65535. DISPLAY_IDENTIFIER fm_sta_gas_pump_2_oc.Vxx_dfctr_xxx ECU_ADDRESS 0xd000567e /end MEASUREMENT
/begin MEASUREMENT Vxx_rdn_gas_pump_2_oc "" UWORD _CNV_A_R_A_105_CM 1 0. 0. 65535. DISPLAY_IDENTIFIER fm_sta_gas_pump_2_oc.Vxx_rdn_xxx ECU_ADDRESS 0xd0005680 /end MEASUREMENT
/begin MEASUREMENT Vbx_cf_gas_pump_2_oc "" UBYTE _CNV_A_R_A_105_CM 1 0. 0. 255. DISPLAY_IDENTIFIER fm_sta_gas_pump_2_oc.fm_static_bitfield.Vbx_cf_xxx ECU_ADDRESS 0xd0005682 BIT_MASK 0x1 /end MEASUREMENT
/begin MEASUREMENT Vbx_clf_gas_pump_2_oc "" UBYTE _CNV_A_R_A_105_CM 1 0. 0. 255. DISPLAY_IDENTIFIER fm_sta_gas_pump_2_oc.fm_static_bitfield.Vbx_clf_xxx ECU_ADDRESS 0xd0005682 BIT_MASK 0x2 /end MEASUREMENT
/begin MEASUREMENT Vbx_df_old_gas_pump_2_oc "" UBYTE _CNV_A_R_A_105_CM 1 0. 0. 255. DISPLAY_IDENTIFIER fm_sta_gas_pump_2_oc.fm_static_bitfield.Vbx_df_old_xxx ECU_ADDRESS 0xd0005682 BIT_MASK 0x4 /end MEASUREMENT
/begin MEASUREMENT Vbx_dfctr_sat_gas_pump_2_oc "" UBYTE _CNV_A_R_A_105_CM 1 0. 0. 255. DISPLAY_IDENTIFIER fm_sta_gas_pump_2_oc.fm_static_bitfield.Vbx_dfctr_sat_xxx ECU_ADDRESS 0xd0005682 BIT_MASK 0x8 /end MEASUREMENT
/begin MEASUREMENT Vbx_rdn_gas_pump_2_oc "" UBYTE _CNV_A_R_A_105_CM 1 0. 0. 255. DISPLAY_IDENTIFIER fm_sta_gas_pump_2_oc.fm_static_bitfield.Vbx_rdn_xxx ECU_ADDRESS 0xd0005682 BIT_MASK 0x40 /end MEASUREMENT
/begin MEASUREMENT Vxx_dtc_stt_gas_pump_2_oc "" UBYTE _CNV_A_R_A_105_CM 1 0. 0. 255. DISPLAY_IDENTIFIER fm_sta_gas_pump_2_oc.Vxx_dtc_stt_xxx ECU_ADDRESS 0xd0005683 /end MEASUREMENT
/begin MEASUREMENT Vxx_dfctr_gas_pump_2_scg "" UWORD _CNV_A_R_A_105_CM 1 0. 0. 65535. DISPLAY_IDENTIFIER fm_sta_gas_pump_2_scg.Vxx_dfctr_xxx ECU_ADDRESS 0xd0005684 /end MEASUREMENT
/begin MEASUREMENT Vxx_rdn_gas_pump_2_scg "" UWORD _CNV_A_R_A_105_CM 1 0. 0. 65535. DISPLAY_IDENTIFIER fm_sta_gas_pump_2_scg.Vxx_rdn_xxx ECU_ADDRESS 0xd0005686 /end MEASUREMENT
/begin MEASUREMENT Vbx_cf_gas_pump_2_scg "" UBYTE _CNV_A_R_A_105_CM 1 0. 0. 255. DISPLAY_IDENTIFIER fm_sta_gas_pump_2_scg.fm_static_bitfield.Vbx_cf_xxx ECU_ADDRESS 0xd0005688 BIT_MASK 0x1 /end MEASUREMENT
/begin MEASUREMENT Vbx_clf_gas_pump_2_scg "" UBYTE _CNV_A_R_A_105_CM 1 0. 0. 255. DISPLAY_IDENTIFIER fm_sta_gas_pump_2_scg.fm_static_bitfield.Vbx_clf_xxx ECU_ADDRESS 0xd0005688 BIT_MASK 0x2 /end MEASUREMENT
/begin MEASUREMENT Vbx_df_old_gas_pump_2_scg "" UBYTE _CNV_A_R_A_105_CM 1 0. 0. 255. DISPLAY_IDENTIFIER fm_sta_gas_pump_2_scg.fm_static_bitfield.Vbx_df_old_xxx ECU_ADDRESS 0xd0005688 BIT_MASK 0x4 /end MEASUREMENT
/begin MEASUREMENT Vbx_dfctr_sat_gas_pump_2_scg "" UBYTE _CNV_A_R_A_105_CM 1 0. 0. 255. DISPLAY_IDENTIFIER fm_sta_gas_pump_2_scg.fm_static_bitfield.Vbx_dfctr_sat_xxx ECU_ADDRESS 0xd0005688 BIT_MASK 0x8 /end MEASUREMENT
/begin MEASUREMENT Vbx_rdn_gas_pump_2_scg "" UBYTE _CNV_A_R_A_105_CM 1 0. 0. 255. DISPLAY_IDENTIFIER fm_sta_gas_pump_2_scg.fm_static_bitfield.Vbx_rdn_xxx ECU_ADDRESS 0xd0005688 BIT_MASK 0x40 /end MEASUREMENT
/begin MEASUREMENT Vxx_dtc_stt_gas_pump_2_scg "" UBYTE _CNV_A_R_A_105_CM 1 0. 0. 255. DISPLAY_IDENTIFIER fm_sta_gas_pump_2_scg.Vxx_dtc_stt_xxx ECU_ADDRESS 0xd0005689 /end MEASUREMENT
/begin MEASUREMENT Vxx_dfctr_gas_pump_2_scw "" UWORD _CNV_A_R_A_105_CM 1 0. 0. 65535. DISPLAY_IDENTIFIER fm_sta_gas_pump_2_scw.Vxx_dfctr_xxx ECU_ADDRESS 0xd000568a /end MEASUREMENT
/begin MEASUREMENT Vxx_rdn_gas_pump_2_scw "" UWORD _CNV_A_R_A_105_CM 1 0. 0. 65535. DISPLAY_IDENTIFIER fm_sta_gas_pump_2_scw.Vxx_rdn_xxx ECU_ADDRESS 0xd000568c /end MEASUREMENT
/begin MEASUREMENT Vbx_cf_gas_pump_2_scw "" UBYTE _CNV_A_R_A_105_CM 1 0. 0. 255. DISPLAY_IDENTIFIER fm_sta_gas_pump_2_scw.fm_static_bitfield.Vbx_cf_xxx ECU_ADDRESS 0xd000568e BIT_MASK 0x1 /end MEASUREMENT
/begin MEASUREMENT Vbx_clf_gas_pump_2_scw "" UBYTE _CNV_A_R_A_105_CM 1 0. 0. 255. DISPLAY_IDENTIFIER fm_sta_gas_pump_2_scw.fm_static_bitfield.Vbx_clf_xxx ECU_ADDRESS 0xd000568e BIT_MASK 0x2 /end MEASUREMENT
/begin MEASUREMENT Vbx_df_old_gas_pump_2_scw "" UBYTE _CNV_A_R_A_105_CM 1 0. 0. 255. DISPLAY_IDENTIFIER fm_sta_gas_pump_2_scw.fm_static_bitfield.Vbx_df_old_xxx ECU_ADDRESS 0xd000568e BIT_MASK 0x4 /end MEASUREMENT
/begin MEASUREMENT Vbx_dfctr_sat_gas_pump_2_scw "" UBYTE _CNV_A_R_A_105_CM 1 0. 0. 255. DISPLAY_IDENTIFIER fm_sta_gas_pump_2_scw.fm_static_bitfield.Vbx_dfctr_sat_xxx ECU_ADDRESS 0xd000568e BIT_MASK 0x8 /end MEASUREMENT
/begin MEASUREMENT Vbx_rdn_gas_pump_2_scw "" UBYTE _CNV_A_R_A_105_CM 1 0. 0. 255. DISPLAY_IDENTIFIER fm_sta_gas_pump_2_scw.fm_static_bitfield.Vbx_rdn_xxx ECU_ADDRESS 0xd000568e BIT_MASK 0x40 /end MEASUREMENT
/begin MEASUREMENT Vxx_dtc_stt_gas_pump_2_scw "" UBYTE _CNV_A_R_A_105_CM 1 0. 0. 255. DISPLAY_IDENTIFIER fm_sta_gas_pump_2_scw.Vxx_dtc_stt_xxx ECU_ADDRESS 0xd000568f /end MEASUREMENT
/begin MEASUREMENT Vxx_dfctr_gas_pump_oc "" UWORD _CNV_A_R_A_105_CM 1 0. 0. 65535. DISPLAY_IDENTIFIER fm_sta_gas_pump_oc.Vxx_dfctr_xxx ECU_ADDRESS 0xd000523a /end MEASUREMENT
/begin MEASUREMENT Vxx_rdn_gas_pump_oc "" UWORD _CNV_A_R_A_105_CM 1 0. 0. 65535. DISPLAY_IDENTIFIER fm_sta_gas_pump_oc.Vxx_rdn_xxx ECU_ADDRESS 0xd000523c /end MEASUREMENT
/begin MEASUREMENT Vbx_cf_gas_pump_oc "" UBYTE _CNV_A_R_A_105_CM 1 0. 0. 255. DISPLAY_IDENTIFIER fm_sta_gas_pump_oc.fm_static_bitfield.Vbx_cf_xxx ECU_ADDRESS 0xd000523e BIT_MASK 0x1 /end MEASUREMENT
/begin MEASUREMENT Vbx_clf_gas_pump_oc "" UBYTE _CNV_A_R_A_105_CM 1 0. 0. 255. DISPLAY_IDENTIFIER fm_sta_gas_pump_oc.fm_static_bitfield.Vbx_clf_xxx ECU_ADDRESS 0xd000523e BIT_MASK 0x2 /end MEASUREMENT
/begin MEASUREMENT Vbx_df_old_gas_pump_oc "" UBYTE _CNV_A_R_A_105_CM 1 0. 0. 255. DISPLAY_IDENTIFIER fm_sta_gas_pump_oc.fm_static_bitfield.Vbx_df_old_xxx ECU_ADDRESS 0xd000523e BIT_MASK 0x4 /end MEASUREMENT
/begin MEASUREMENT Vbx_dfctr_sat_gas_pump_oc "" UBYTE _CNV_A_R_A_105_CM 1 0. 0. 255. DISPLAY_IDENTIFIER fm_sta_gas_pump_oc.fm_static_bitfield.Vbx_dfctr_sat_xxx ECU_ADDRESS 0xd000523e BIT_MASK 0x8 /end MEASUREMENT
/begin MEASUREMENT Vbx_rdn_gas_pump_oc "" UBYTE _CNV_A_R_A_105_CM 1 0. 0. 255. DISPLAY_IDENTIFIER fm_sta_gas_pump_oc.fm_static_bitfield.Vbx_rdn_xxx ECU_ADDRESS 0xd000523e BIT_MASK 0x40 /end MEASUREMENT
/begin MEASUREMENT Vxx_dtc_stt_gas_pump_oc "" UBYTE _CNV_A_R_A_105_CM 1 0. 0. 255. DISPLAY_IDENTIFIER fm_sta_gas_pump_oc.Vxx_dtc_stt_xxx ECU_ADDRESS 0xd000523f /end MEASUREMENT
/begin MEASUREMENT Vxx_dfctr_gas_pump_scg "" UWORD _CNV_A_R_A_105_CM 1 0. 0. 65535. DISPLAY_IDENTIFIER fm_sta_gas_pump_scg.Vxx_dfctr_xxx ECU_ADDRESS 0xd0005240 /end MEASUREMENT
/begin MEASUREMENT Vxx_rdn_gas_pump_scg "" UWORD _CNV_A_R_A_105_CM 1 0. 0. 65535. DISPLAY_IDENTIFIER fm_sta_gas_pump_scg.Vxx_rdn_xxx ECU_ADDRESS 0xd0005242 /end MEASUREMENT
/begin MEASUREMENT Vbx_cf_gas_pump_scg "" UBYTE _CNV_A_R_A_105_CM 1 0. 0. 255. DISPLAY_IDENTIFIER fm_sta_gas_pump_scg.fm_static_bitfield.Vbx_cf_xxx ECU_ADDRESS 0xd0005244 BIT_MASK 0x1 /end MEASUREMENT
/begin MEASUREMENT Vbx_clf_gas_pump_scg "" UBYTE _CNV_A_R_A_105_CM 1 0. 0. 255. DISPLAY_IDENTIFIER fm_sta_gas_pump_scg.fm_static_bitfield.Vbx_clf_xxx ECU_ADDRESS 0xd0005244 BIT_MASK 0x2 /end MEASUREMENT
/begin MEASUREMENT Vbx_df_old_gas_pump_scg "" UBYTE _CNV_A_R_A_105_CM 1 0. 0. 255. DISPLAY_IDENTIFIER fm_sta_gas_pump_scg.fm_static_bitfield.Vbx_df_old_xxx ECU_ADDRESS 0xd0005244 BIT_MASK 0x4 /end MEASUREMENT
/begin MEASUREMENT Vbx_dfctr_sat_gas_pump_scg "" UBYTE _CNV_A_R_A_105_CM 1 0. 0. 255. DISPLAY_IDENTIFIER fm_sta_gas_pump_scg.fm_static_bitfield.Vbx_dfctr_sat_xxx ECU_ADDRESS 0xd0005244 BIT_MASK 0x8 /end MEASUREMENT
/begin MEASUREMENT Vbx_rdn_gas_pump_scg "" UBYTE _CNV_A_R_A_105_CM 1 0. 0. 255. DISPLAY_IDENTIFIER fm_sta_gas_pump_scg.fm_static_bitfield.Vbx_rdn_xxx ECU_ADDRESS 0xd0005244 BIT_MASK 0x40 /end MEASUREMENT
/begin MEASUREMENT Vxx_dtc_stt_gas_pump_scg "" UBYTE _CNV_A_R_A_105_CM 1 0. 0. 255. DISPLAY_IDENTIFIER fm_sta_gas_pump_scg.Vxx_dtc_stt_xxx ECU_ADDRESS 0xd0005245 /end MEASUREMENT
/begin MEASUREMENT Vxx_dfctr_gas_pump_scw "" UWORD _CNV_A_R_A_105_CM 1 0. 0. 65535. DISPLAY_IDENTIFIER fm_sta_gas_pump_scw.Vxx_dfctr_xxx ECU_ADDRESS 0xd0005246 /end MEASUREMENT
/begin MEASUREMENT Vxx_rdn_gas_pump_scw "" UWORD _CNV_A_R_A_105_CM 1 0. 0. 65535. DISPLAY_IDENTIFIER fm_sta_gas_pump_scw.Vxx_rdn_xxx ECU_ADDRESS 0xd0005248 /end MEASUREMENT
/begin MEASUREMENT Vbx_cf_gas_pump_scw "" UBYTE _CNV_A_R_A_105_CM 1 0. 0. 255. DISPLAY_IDENTIFIER fm_sta_gas_pump_scw.fm_static_bitfield.Vbx_cf_xxx ECU_ADDRESS 0xd000524a BIT_MASK 0x1 /end MEASUREMENT
/begin MEASUREMENT Vbx_clf_gas_pump_scw "" UBYTE _CNV_A_R_A_105_CM 1 0. 0. 255. DISPLAY_IDENTIFIER fm_sta_gas_pump_scw.fm_static_bitfield.Vbx_clf_xxx ECU_ADDRESS 0xd000524a BIT_MASK 0x2 /end MEASUREMENT
/begin MEASUREMENT Vbx_df_old_gas_pump_scw "" UBYTE _CNV_A_R_A_105_CM 1 0. 0. 255. DISPLAY_IDENTIFIER fm_sta_gas_pump_scw.fm_static_bitfield.Vbx_df_old_xxx ECU_ADDRESS 0xd000524a BIT_MASK 0x4 /end MEASUREMENT
/begin MEASUREMENT Vbx_dfctr_sat_gas_pump_scw "" UBYTE _CNV_A_R_A_105_CM 1 0. 0. 255. DISPLAY_IDENTIFIER fm_sta_gas_pump_scw.fm_static_bitfield.Vbx_dfctr_sat_xxx ECU_ADDRESS 0xd000524a BIT_MASK 0x8 /end MEASUREMENT
/begin MEASUREMENT Vbx_rdn_gas_pump_scw "" UBYTE _CNV_A_R_A_105_CM 1 0. 0. 255. DISPLAY_IDENTIFIER fm_sta_gas_pump_scw.fm_static_bitfield.Vbx_rdn_xxx ECU_ADDRESS 0xd000524a BIT_MASK 0x40 /end MEASUREMENT
/begin MEASUREMENT Vxx_dtc_stt_gas_pump_scw "" UBYTE _CNV_A_R_A_105_CM 1 0. 0. 255. DISPLAY_IDENTIFIER fm_sta_gas_pump_scw.Vxx_dtc_stt_xxx ECU_ADDRESS 0xd000524b /end MEASUREMENT
/begin MEASUREMENT Vxx_dfctr_igc_1_oc "" UWORD _CNV_A_R_A_105_CM 1 0. 0. 65535. DISPLAY_IDENTIFIER fm_sta_igc_1_oc.Vxx_dfctr_xxx ECU_ADDRESS 0xd000559a /end MEASUREMENT
/begin MEASUREMENT Vxx_rdn_igc_1_oc "" UWORD _CNV_A_R_A_105_CM 1 0. 0. 65535. DISPLAY_IDENTIFIER fm_sta_igc_1_oc.Vxx_rdn_xxx ECU_ADDRESS 0xd000559c /end MEASUREMENT
/begin MEASUREMENT Vbx_cf_igc_1_oc "" UBYTE _CNV_A_R_A_105_CM 1 0. 0. 255. DISPLAY_IDENTIFIER fm_sta_igc_1_oc.fm_static_bitfield.Vbx_cf_xxx ECU_ADDRESS 0xd000559e BIT_MASK 0x1 /end MEASUREMENT
/begin MEASUREMENT Vbx_clf_igc_1_oc "" UBYTE _CNV_A_R_A_105_CM 1 0. 0. 255. DISPLAY_IDENTIFIER fm_sta_igc_1_oc.fm_static_bitfield.Vbx_clf_xxx ECU_ADDRESS 0xd000559e BIT_MASK 0x2 /end MEASUREMENT
/begin MEASUREMENT Vbx_df_old_igc_1_oc "" UBYTE _CNV_A_R_A_105_CM 1 0. 0. 255. DISPLAY_IDENTIFIER fm_sta_igc_1_oc.fm_static_bitfield.Vbx_df_old_xxx ECU_ADDRESS 0xd000559e BIT_MASK 0x4 /end MEASUREMENT
/begin MEASUREMENT Vbx_dfctr_sat_igc_1_oc "" UBYTE _CNV_A_R_A_105_CM 1 0. 0. 255. DISPLAY_IDENTIFIER fm_sta_igc_1_oc.fm_static_bitfield.Vbx_dfctr_sat_xxx ECU_ADDRESS 0xd000559e BIT_MASK 0x8 /end MEASUREMENT
/begin MEASUREMENT Vbx_rdn_igc_1_oc "" UBYTE _CNV_A_R_A_105_CM 1 0. 0. 255. DISPLAY_IDENTIFIER fm_sta_igc_1_oc.fm_static_bitfield.Vbx_rdn_xxx ECU_ADDRESS 0xd000559e BIT_MASK 0x40 /end MEASUREMENT
/begin MEASUREMENT Vxx_dtc_stt_igc_1_oc "" UBYTE _CNV_A_R_A_105_CM 1 0. 0. 255. DISPLAY_IDENTIFIER fm_sta_igc_1_oc.Vxx_dtc_stt_xxx ECU_ADDRESS 0xd000559f /end MEASUREMENT
/begin MEASUREMENT Vxx_dfctr_igc_1_scg "" UWORD _CNV_A_R_A_105_CM 1 0. 0. 65535. DISPLAY_IDENTIFIER fm_sta_igc_1_scg.Vxx_dfctr_xxx ECU_ADDRESS 0xd00055a0 /end MEASUREMENT
/begin MEASUREMENT Vxx_rdn_igc_1_scg "" UWORD _CNV_A_R_A_105_CM 1 0. 0. 65535. DISPLAY_IDENTIFIER fm_sta_igc_1_scg.Vxx_rdn_xxx ECU_ADDRESS 0xd00055a2 /end MEASUREMENT
/begin MEASUREMENT Vbx_cf_igc_1_scg "" UBYTE _CNV_A_R_A_105_CM 1 0. 0. 255. DISPLAY_IDENTIFIER fm_sta_igc_1_scg.fm_static_bitfield.Vbx_cf_xxx ECU_ADDRESS 0xd00055a4 BIT_MASK 0x1 /end MEASUREMENT
/begin MEASUREMENT Vbx_clf_igc_1_scg "" UBYTE _CNV_A_R_A_105_CM 1 0. 0. 255. DISPLAY_IDENTIFIER fm_sta_igc_1_scg.fm_static_bitfield.Vbx_clf_xxx ECU_ADDRESS 0xd00055a4 BIT_MASK 0x2 /end MEASUREMENT
/begin MEASUREMENT Vbx_df_old_igc_1_scg "" UBYTE _CNV_A_R_A_105_CM 1 0. 0. 255. DISPLAY_IDENTIFIER fm_sta_igc_1_scg.fm_static_bitfield.Vbx_df_old_xxx ECU_ADDRESS 0xd00055a4 BIT_MASK 0x4 /end MEASUREMENT
/begin MEASUREMENT Vbx_dfctr_sat_igc_1_scg "" UBYTE _CNV_A_R_A_105_CM 1 0. 0. 255. DISPLAY_IDENTIFIER fm_sta_igc_1_scg.fm_static_bitfield.Vbx_dfctr_sat_xxx ECU_ADDRESS 0xd00055a4 BIT_MASK 0x8 /end MEASUREMENT
/begin MEASUREMENT Vbx_rdn_igc_1_scg "" UBYTE _CNV_A_R_A_105_CM 1 0. 0. 255. DISPLAY_IDENTIFIER fm_sta_igc_1_scg.fm_static_bitfield.Vbx_rdn_xxx ECU_ADDRESS 0xd00055a4 BIT_MASK 0x40 /end MEASUREMENT
/begin MEASUREMENT Vxx_dtc_stt_igc_1_scg "" UBYTE _CNV_A_R_A_105_CM 1 0. 0. 255. DISPLAY_IDENTIFIER fm_sta_igc_1_scg.Vxx_dtc_stt_xxx ECU_ADDRESS 0xd00055a5 /end MEASUREMENT
/begin MEASUREMENT Vxx_dfctr_igc_1_scw "" UWORD _CNV_A_R_A_105_CM 1 0. 0. 65535. DISPLAY_IDENTIFIER fm_sta_igc_1_scw.Vxx_dfctr_xxx ECU_ADDRESS 0xd00055a6 /end MEASUREMENT
/begin MEASUREMENT Vxx_rdn_igc_1_scw "" UWORD _CNV_A_R_A_105_CM 1 0. 0. 65535. DISPLAY_IDENTIFIER fm_sta_igc_1_scw.Vxx_rdn_xxx ECU_ADDRESS 0xd00055a8 /end MEASUREMENT
/begin MEASUREMENT Vbx_cf_igc_1_scw "" UBYTE _CNV_A_R_A_105_CM 1 0. 0. 255. DISPLAY_IDENTIFIER fm_sta_igc_1_scw.fm_static_bitfield.Vbx_cf_xxx ECU_ADDRESS 0xd00055aa BIT_MASK 0x1 /end MEASUREMENT
/begin MEASUREMENT Vbx_clf_igc_1_scw "" UBYTE _CNV_A_R_A_105_CM 1 0. 0. 255. DISPLAY_IDENTIFIER fm_sta_igc_1_scw.fm_static_bitfield.Vbx_clf_xxx ECU_ADDRESS 0xd00055aa BIT_MASK 0x2 /end MEASUREMENT
/begin MEASUREMENT Vbx_df_old_igc_1_scw "" UBYTE _CNV_A_R_A_105_CM 1 0. 0. 255. DISPLAY_IDENTIFIER fm_sta_igc_1_scw.fm_static_bitfield.Vbx_df_old_xxx ECU_ADDRESS 0xd00055aa BIT_MASK 0x4 /end MEASUREMENT
/begin MEASUREMENT Vbx_dfctr_sat_igc_1_scw "" UBYTE _CNV_A_R_A_105_CM 1 0. 0. 255. DISPLAY_IDENTIFIER fm_sta_igc_1_scw.fm_static_bitfield.Vbx_dfctr_sat_xxx ECU_ADDRESS 0xd00055aa BIT_MASK 0x8 /end MEASUREMENT
/begin MEASUREMENT Vbx_rdn_igc_1_scw "" UBYTE _CNV_A_R_A_105_CM 1 0. 0. 255. DISPLAY_IDENTIFIER fm_sta_igc_1_scw.fm_static_bitfield.Vbx_rdn_xxx ECU_ADDRESS 0xd00055aa BIT_MASK 0x40 /end MEASUREMENT
/begin MEASUREMENT Vxx_dtc_stt_igc_1_scw "" UBYTE _CNV_A_R_A_105_CM 1 0. 0. 255. DISPLAY_IDENTIFIER fm_sta_igc_1_scw.Vxx_dtc_stt_xxx ECU_ADDRESS 0xd00055ab /end MEASUREMENT
/begin MEASUREMENT Vxx_dfctr_igc_2_oc "" UWORD _CNV_A_R_A_105_CM 1 0. 0. 65535. DISPLAY_IDENTIFIER fm_sta_igc_2_oc.Vxx_dfctr_xxx ECU_ADDRESS 0xd00055ac /end MEASUREMENT
/begin MEASUREMENT Vxx_rdn_igc_2_oc "" UWORD _CNV_A_R_A_105_CM 1 0. 0. 65535. DISPLAY_IDENTIFIER fm_sta_igc_2_oc.Vxx_rdn_xxx ECU_ADDRESS 0xd00055ae /end MEASUREMENT
/begin MEASUREMENT Vbx_cf_igc_2_oc "" UBYTE _CNV_A_R_A_105_CM 1 0. 0. 255. DISPLAY_IDENTIFIER fm_sta_igc_2_oc.fm_static_bitfield.Vbx_cf_xxx ECU_ADDRESS 0xd00055b0 BIT_MASK 0x1 /end MEASUREMENT
/begin MEASUREMENT Vbx_clf_igc_2_oc "" UBYTE _CNV_A_R_A_105_CM 1 0. 0. 255. DISPLAY_IDENTIFIER fm_sta_igc_2_oc.fm_static_bitfield.Vbx_clf_xxx ECU_ADDRESS 0xd00055b0 BIT_MASK 0x2 /end MEASUREMENT
/begin MEASUREMENT Vbx_df_old_igc_2_oc "" UBYTE _CNV_A_R_A_105_CM 1 0. 0. 255. DISPLAY_IDENTIFIER fm_sta_igc_2_oc.fm_static_bitfield.Vbx_df_old_xxx ECU_ADDRESS 0xd00055b0 BIT_MASK 0x4 /end MEASUREMENT
/begin MEASUREMENT Vbx_dfctr_sat_igc_2_oc "" UBYTE _CNV_A_R_A_105_CM 1 0. 0. 255. DISPLAY_IDENTIFIER fm_sta_igc_2_oc.fm_static_bitfield.Vbx_dfctr_sat_xxx ECU_ADDRESS 0xd00055b0 BIT_MASK 0x8 /end MEASUREMENT
/begin MEASUREMENT Vbx_rdn_igc_2_oc "" UBYTE _CNV_A_R_A_105_CM 1 0. 0. 255. DISPLAY_IDENTIFIER fm_sta_igc_2_oc.fm_static_bitfield.Vbx_rdn_xxx ECU_ADDRESS 0xd00055b0 BIT_MASK 0x40 /end MEASUREMENT
/begin MEASUREMENT Vxx_dtc_stt_igc_2_oc "" UBYTE _CNV_A_R_A_105_CM 1 0. 0. 255. DISPLAY_IDENTIFIER fm_sta_igc_2_oc.Vxx_dtc_stt_xxx ECU_ADDRESS 0xd00055b1 /end MEASUREMENT
/begin MEASUREMENT Vxx_dfctr_igc_2_scg "" UWORD _CNV_A_R_A_105_CM 1 0. 0. 65535. DISPLAY_IDENTIFIER fm_sta_igc_2_scg.Vxx_dfctr_xxx ECU_ADDRESS 0xd0005612 /end MEASUREMENT
/begin MEASUREMENT Vxx_rdn_igc_2_scg "" UWORD _CNV_A_R_A_105_CM 1 0. 0. 65535. DISPLAY_IDENTIFIER fm_sta_igc_2_scg.Vxx_rdn_xxx ECU_ADDRESS 0xd0005614 /end MEASUREMENT
/begin MEASUREMENT Vbx_cf_igc_2_scg "" UBYTE _CNV_A_R_A_105_CM 1 0. 0. 255. DISPLAY_IDENTIFIER fm_sta_igc_2_scg.fm_static_bitfield.Vbx_cf_xxx ECU_ADDRESS 0xd0005616 BIT_MASK 0x1 /end MEASUREMENT
/begin MEASUREMENT Vbx_clf_igc_2_scg "" UBYTE _CNV_A_R_A_105_CM 1 0. 0. 255. DISPLAY_IDENTIFIER fm_sta_igc_2_scg.fm_static_bitfield.Vbx_clf_xxx ECU_ADDRESS 0xd0005616 BIT_MASK 0x2 /end MEASUREMENT
/begin MEASUREMENT Vbx_df_old_igc_2_scg "" UBYTE _CNV_A_R_A_105_CM 1 0. 0. 255. DISPLAY_IDENTIFIER fm_sta_igc_2_scg.fm_static_bitfield.Vbx_df_old_xxx ECU_ADDRESS 0xd0005616 BIT_MASK 0x4 /end MEASUREMENT
/begin MEASUREMENT Vbx_dfctr_sat_igc_2_scg "" UBYTE _CNV_A_R_A_105_CM 1 0. 0. 255. DISPLAY_IDENTIFIER fm_sta_igc_2_scg.fm_static_bitfield.Vbx_dfctr_sat_xxx ECU_ADDRESS 0xd0005616 BIT_MASK 0x8 /end MEASUREMENT
/begin MEASUREMENT Vbx_rdn_igc_2_scg "" UBYTE _CNV_A_R_A_105_CM 1 0. 0. 255. DISPLAY_IDENTIFIER fm_sta_igc_2_scg.fm_static_bitfield.Vbx_rdn_xxx ECU_ADDRESS 0xd0005616 BIT_MASK 0x40 /end MEASUREMENT
/begin MEASUREMENT Vxx_dtc_stt_igc_2_scg "" UBYTE _CNV_A_R_A_105_CM 1 0. 0. 255. DISPLAY_IDENTIFIER fm_sta_igc_2_scg.Vxx_dtc_stt_xxx ECU_ADDRESS 0xd0005617 /end MEASUREMENT
/begin MEASUREMENT Vxx_dfctr_igc_2_scw "" UWORD _CNV_A_R_A_105_CM 1 0. 0. 65535. DISPLAY_IDENTIFIER fm_sta_igc_2_scw.Vxx_dfctr_xxx ECU_ADDRESS 0xd0005618 /end MEASUREMENT
/begin MEASUREMENT Vxx_rdn_igc_2_scw "" UWORD _CNV_A_R_A_105_CM 1 0. 0. 65535. DISPLAY_IDENTIFIER fm_sta_igc_2_scw.Vxx_rdn_xxx ECU_ADDRESS 0xd000561a /end MEASUREMENT
/begin MEASUREMENT Vbx_cf_igc_2_scw "" UBYTE _CNV_A_R_A_105_CM 1 0. 0. 255. DISPLAY_IDENTIFIER fm_sta_igc_2_scw.fm_static_bitfield.Vbx_cf_xxx ECU_ADDRESS 0xd000561c BIT_MASK 0x1 /end MEASUREMENT
/begin MEASUREMENT Vbx_clf_igc_2_scw "" UBYTE _CNV_A_R_A_105_CM 1 0. 0. 255. DISPLAY_IDENTIFIER fm_sta_igc_2_scw.fm_static_bitfield.Vbx_clf_xxx ECU_ADDRESS 0xd000561c BIT_MASK 0x2 /end MEASUREMENT
/begin MEASUREMENT Vbx_df_old_igc_2_scw "" UBYTE _CNV_A_R_A_105_CM 1 0. 0. 255. DISPLAY_IDENTIFIER fm_sta_igc_2_scw.fm_static_bitfield.Vbx_df_old_xxx ECU_ADDRESS 0xd000561c BIT_MASK 0x4 /end MEASUREMENT
/begin MEASUREMENT Vbx_dfctr_sat_igc_2_scw "" UBYTE _CNV_A_R_A_105_CM 1 0. 0. 255. DISPLAY_IDENTIFIER fm_sta_igc_2_scw.fm_static_bitfield.Vbx_dfctr_sat_xxx ECU_ADDRESS 0xd000561c BIT_MASK 0x8 /end MEASUREMENT
/begin MEASUREMENT Vbx_rdn_igc_2_scw "" UBYTE _CNV_A_R_A_105_CM 1 0. 0. 255. DISPLAY_IDENTIFIER fm_sta_igc_2_scw.fm_static_bitfield.Vbx_rdn_xxx ECU_ADDRESS 0xd000561c BIT_MASK 0x40 /end MEASUREMENT
/begin MEASUREMENT Vxx_dtc_stt_igc_2_scw "" UBYTE _CNV_A_R_A_105_CM 1 0. 0. 255. DISPLAY_IDENTIFIER fm_sta_igc_2_scw.Vxx_dtc_stt_xxx ECU_ADDRESS 0xd000561d /end MEASUREMENT
/begin MEASUREMENT Vxx_dfctr_igc_3_oc "" UWORD _CNV_A_R_A_105_CM 1 0. 0. 65535. DISPLAY_IDENTIFIER fm_sta_igc_3_oc.Vxx_dfctr_xxx ECU_ADDRESS 0xd000561e /end MEASUREMENT
/begin MEASUREMENT Vxx_rdn_igc_3_oc "" UWORD _CNV_A_R_A_105_CM 1 0. 0. 65535. DISPLAY_IDENTIFIER fm_sta_igc_3_oc.Vxx_rdn_xxx ECU_ADDRESS 0xd0005620 /end MEASUREMENT
/begin MEASUREMENT Vbx_cf_igc_3_oc "" UBYTE _CNV_A_R_A_105_CM 1 0. 0. 255. DISPLAY_IDENTIFIER fm_sta_igc_3_oc.fm_static_bitfield.Vbx_cf_xxx ECU_ADDRESS 0xd0005622 BIT_MASK 0x1 /end MEASUREMENT
/begin MEASUREMENT Vbx_clf_igc_3_oc "" UBYTE _CNV_A_R_A_105_CM 1 0. 0. 255. DISPLAY_IDENTIFIER fm_sta_igc_3_oc.fm_static_bitfield.Vbx_clf_xxx ECU_ADDRESS 0xd0005622 BIT_MASK 0x2 /end MEASUREMENT
/begin MEASUREMENT Vbx_df_old_igc_3_oc "" UBYTE _CNV_A_R_A_105_CM 1 0. 0. 255. DISPLAY_IDENTIFIER fm_sta_igc_3_oc.fm_static_bitfield.Vbx_df_old_xxx ECU_ADDRESS 0xd0005622 BIT_MASK 0x4 /end MEASUREMENT
/begin MEASUREMENT Vbx_dfctr_sat_igc_3_oc "" UBYTE _CNV_A_R_A_105_CM 1 0. 0. 255. DISPLAY_IDENTIFIER fm_sta_igc_3_oc.fm_static_bitfield.Vbx_dfctr_sat_xxx ECU_ADDRESS 0xd0005622 BIT_MASK 0x8 /end MEASUREMENT
/begin MEASUREMENT Vbx_rdn_igc_3_oc "" UBYTE _CNV_A_R_A_105_CM 1 0. 0. 255. DISPLAY_IDENTIFIER fm_sta_igc_3_oc.fm_static_bitfield.Vbx_rdn_xxx ECU_ADDRESS 0xd0005622 BIT_MASK 0x40 /end MEASUREMENT
/begin MEASUREMENT Vxx_dtc_stt_igc_3_oc "" UBYTE _CNV_A_R_A_105_CM 1 0. 0. 255. DISPLAY_IDENTIFIER fm_sta_igc_3_oc.Vxx_dtc_stt_xxx ECU_ADDRESS 0xd0005623 /end MEASUREMENT
/begin MEASUREMENT Vxx_dfctr_igc_3_scg "" UWORD _CNV_A_R_A_105_CM 1 0. 0. 65535. DISPLAY_IDENTIFIER fm_sta_igc_3_scg.Vxx_dfctr_xxx ECU_ADDRESS 0xd0005624 /end MEASUREMENT
/begin MEASUREMENT Vxx_rdn_igc_3_scg "" UWORD _CNV_A_R_A_105_CM 1 0. 0. 65535. DISPLAY_IDENTIFIER fm_sta_igc_3_scg.Vxx_rdn_xxx ECU_ADDRESS 0xd0005626 /end MEASUREMENT
/begin MEASUREMENT Vbx_cf_igc_3_scg "" UBYTE _CNV_A_R_A_105_CM 1 0. 0. 255. DISPLAY_IDENTIFIER fm_sta_igc_3_scg.fm_static_bitfield.Vbx_cf_xxx ECU_ADDRESS 0xd0005628 BIT_MASK 0x1 /end MEASUREMENT
/begin MEASUREMENT Vbx_clf_igc_3_scg "" UBYTE _CNV_A_R_A_105_CM 1 0. 0. 255. DISPLAY_IDENTIFIER fm_sta_igc_3_scg.fm_static_bitfield.Vbx_clf_xxx ECU_ADDRESS 0xd0005628 BIT_MASK 0x2 /end MEASUREMENT
/begin MEASUREMENT Vbx_df_old_igc_3_scg "" UBYTE _CNV_A_R_A_105_CM 1 0. 0. 255. DISPLAY_IDENTIFIER fm_sta_igc_3_scg.fm_static_bitfield.Vbx_df_old_xxx ECU_ADDRESS 0xd0005628 BIT_MASK 0x4 /end MEASUREMENT
/begin MEASUREMENT Vbx_dfctr_sat_igc_3_scg "" UBYTE _CNV_A_R_A_105_CM 1 0. 0. 255. DISPLAY_IDENTIFIER fm_sta_igc_3_scg.fm_static_bitfield.Vbx_dfctr_sat_xxx ECU_ADDRESS 0xd0005628 BIT_MASK 0x8 /end MEASUREMENT
/begin MEASUREMENT Vbx_rdn_igc_3_scg "" UBYTE _CNV_A_R_A_105_CM 1 0. 0. 255. DISPLAY_IDENTIFIER fm_sta_igc_3_scg.fm_static_bitfield.Vbx_rdn_xxx ECU_ADDRESS 0xd0005628 BIT_MASK 0x40 /end MEASUREMENT
/begin MEASUREMENT Vxx_dtc_stt_igc_3_scg "" UBYTE _CNV_A_R_A_105_CM 1 0. 0. 255. DISPLAY_IDENTIFIER fm_sta_igc_3_scg.Vxx_dtc_stt_xxx ECU_ADDRESS 0xd0005629 /end MEASUREMENT
/begin MEASUREMENT Vxx_dfctr_igc_3_scw "" UWORD _CNV_A_R_A_105_CM 1 0. 0. 65535. DISPLAY_IDENTIFIER fm_sta_igc_3_scw.Vxx_dfctr_xxx ECU_ADDRESS 0xd000562a /end MEASUREMENT
/begin MEASUREMENT Vxx_rdn_igc_3_scw "" UWORD _CNV_A_R_A_105_CM 1 0. 0. 65535. DISPLAY_IDENTIFIER fm_sta_igc_3_scw.Vxx_rdn_xxx ECU_ADDRESS 0xd000562c /end MEASUREMENT
/begin MEASUREMENT Vbx_cf_igc_3_scw "" UBYTE _CNV_A_R_A_105_CM 1 0. 0. 255. DISPLAY_IDENTIFIER fm_sta_igc_3_scw.fm_static_bitfield.Vbx_cf_xxx ECU_ADDRESS 0xd000562e BIT_MASK 0x1 /end MEASUREMENT
/begin MEASUREMENT Vbx_clf_igc_3_scw "" UBYTE _CNV_A_R_A_105_CM 1 0. 0. 255. DISPLAY_IDENTIFIER fm_sta_igc_3_scw.fm_static_bitfield.Vbx_clf_xxx ECU_ADDRESS 0xd000562e BIT_MASK 0x2 /end MEASUREMENT
/begin MEASUREMENT Vbx_df_old_igc_3_scw "" UBYTE _CNV_A_R_A_105_CM 1 0. 0. 255. DISPLAY_IDENTIFIER fm_sta_igc_3_scw.fm_static_bitfield.Vbx_df_old_xxx ECU_ADDRESS 0xd000562e BIT_MASK 0x4 /end MEASUREMENT
/begin MEASUREMENT Vbx_dfctr_sat_igc_3_scw "" UBYTE _CNV_A_R_A_105_CM 1 0. 0. 255. DISPLAY_IDENTIFIER fm_sta_igc_3_scw.fm_static_bitfield.Vbx_dfctr_sat_xxx ECU_ADDRESS 0xd000562e BIT_MASK 0x8 /end MEASUREMENT
/begin MEASUREMENT Vbx_rdn_igc_3_scw "" UBYTE _CNV_A_R_A_105_CM 1 0. 0. 255. DISPLAY_IDENTIFIER fm_sta_igc_3_scw.fm_static_bitfield.Vbx_rdn_xxx ECU_ADDRESS 0xd000562e BIT_MASK 0x40 /end MEASUREMENT
/begin MEASUREMENT Vxx_dtc_stt_igc_3_scw "" UBYTE _CNV_A_R_A_105_CM 1 0. 0. 255. DISPLAY_IDENTIFIER fm_sta_igc_3_scw.Vxx_dtc_stt_xxx ECU_ADDRESS 0xd000562f /end MEASUREMENT
/begin MEASUREMENT Vxx_dfctr_igc_4_oc "" UWORD _CNV_A_R_A_105_CM 1 0. 0. 65535. DISPLAY_IDENTIFIER fm_sta_igc_4_oc.Vxx_dfctr_xxx ECU_ADDRESS 0xd0005630 /end MEASUREMENT
/begin MEASUREMENT Vxx_rdn_igc_4_oc "" UWORD _CNV_A_R_A_105_CM 1 0. 0. 65535. DISPLAY_IDENTIFIER fm_sta_igc_4_oc.Vxx_rdn_xxx ECU_ADDRESS 0xd0005632 /end MEASUREMENT
/begin MEASUREMENT Vbx_cf_igc_4_oc "" UBYTE _CNV_A_R_A_105_CM 1 0. 0. 255. DISPLAY_IDENTIFIER fm_sta_igc_4_oc.fm_static_bitfield.Vbx_cf_xxx ECU_ADDRESS 0xd0005634 BIT_MASK 0x1 /end MEASUREMENT
/begin MEASUREMENT Vbx_clf_igc_4_oc "" UBYTE _CNV_A_R_A_105_CM 1 0. 0. 255. DISPLAY_IDENTIFIER fm_sta_igc_4_oc.fm_static_bitfield.Vbx_clf_xxx ECU_ADDRESS 0xd0005634 BIT_MASK 0x2 /end MEASUREMENT
/begin MEASUREMENT Vbx_df_old_igc_4_oc "" UBYTE _CNV_A_R_A_105_CM 1 0. 0. 255. DISPLAY_IDENTIFIER fm_sta_igc_4_oc.fm_static_bitfield.Vbx_df_old_xxx ECU_ADDRESS 0xd0005634 BIT_MASK 0x4 /end MEASUREMENT
/begin MEASUREMENT Vbx_dfctr_sat_igc_4_oc "" UBYTE _CNV_A_R_A_105_CM 1 0. 0. 255. DISPLAY_IDENTIFIER fm_sta_igc_4_oc.fm_static_bitfield.Vbx_dfctr_sat_xxx ECU_ADDRESS 0xd0005634 BIT_MASK 0x8 /end MEASUREMENT
/begin MEASUREMENT Vbx_rdn_igc_4_oc "" UBYTE _CNV_A_R_A_105_CM 1 0. 0. 255. DISPLAY_IDENTIFIER fm_sta_igc_4_oc.fm_static_bitfield.Vbx_rdn_xxx ECU_ADDRESS 0xd0005634 BIT_MASK 0x40 /end MEASUREMENT
/begin MEASUREMENT Vxx_dtc_stt_igc_4_oc "" UBYTE _CNV_A_R_A_105_CM 1 0. 0. 255. DISPLAY_IDENTIFIER fm_sta_igc_4_oc.Vxx_dtc_stt_xxx ECU_ADDRESS 0xd0005635 /end MEASUREMENT
/begin MEASUREMENT Vxx_dfctr_igc_4_scg "" UWORD _CNV_A_R_A_105_CM 1 0. 0. 65535. DISPLAY_IDENTIFIER fm_sta_igc_4_scg.Vxx_dfctr_xxx ECU_ADDRESS 0xd0005636 /end MEASUREMENT
/begin MEASUREMENT Vxx_rdn_igc_4_scg "" UWORD _CNV_A_R_A_105_CM 1 0. 0. 65535. DISPLAY_IDENTIFIER fm_sta_igc_4_scg.Vxx_rdn_xxx ECU_ADDRESS 0xd0005638 /end MEASUREMENT
/begin MEASUREMENT Vbx_cf_igc_4_scg "" UBYTE _CNV_A_R_A_105_CM 1 0. 0. 255. DISPLAY_IDENTIFIER fm_sta_igc_4_scg.fm_static_bitfield.Vbx_cf_xxx ECU_ADDRESS 0xd000563a BIT_MASK 0x1 /end MEASUREMENT
/begin MEASUREMENT Vbx_clf_igc_4_scg "" UBYTE _CNV_A_R_A_105_CM 1 0. 0. 255. DISPLAY_IDENTIFIER fm_sta_igc_4_scg.fm_static_bitfield.Vbx_clf_xxx ECU_ADDRESS 0xd000563a BIT_MASK 0x2 /end MEASUREMENT
/begin MEASUREMENT Vbx_df_old_igc_4_scg "" UBYTE _CNV_A_R_A_105_CM 1 0. 0. 255. DISPLAY_IDENTIFIER fm_sta_igc_4_scg.fm_static_bitfield.Vbx_df_old_xxx ECU_ADDRESS 0xd000563a BIT_MASK 0x4 /end MEASUREMENT
/begin MEASUREMENT Vbx_dfctr_sat_igc_4_scg "" UBYTE _CNV_A_R_A_105_CM 1 0. 0. 255. DISPLAY_IDENTIFIER fm_sta_igc_4_scg.fm_static_bitfield.Vbx_dfctr_sat_xxx ECU_ADDRESS 0xd000563a BIT_MASK 0x8 /end MEASUREMENT
/begin MEASUREMENT Vbx_rdn_igc_4_scg "" UBYTE _CNV_A_R_A_105_CM 1 0. 0. 255. DISPLAY_IDENTIFIER fm_sta_igc_4_scg.fm_static_bitfield.Vbx_rdn_xxx ECU_ADDRESS 0xd000563a BIT_MASK 0x40 /end MEASUREMENT
/begin MEASUREMENT Vxx_dtc_stt_igc_4_scg "" UBYTE _CNV_A_R_A_105_CM 1 0. 0. 255. DISPLAY_IDENTIFIER fm_sta_igc_4_scg.Vxx_dtc_stt_xxx ECU_ADDRESS 0xd000563b /end MEASUREMENT
/begin MEASUREMENT Vxx_dfctr_igc_4_scw "" UWORD _CNV_A_R_A_105_CM 1 0. 0. 65535. DISPLAY_IDENTIFIER fm_sta_igc_4_scw.Vxx_dfctr_xxx ECU_ADDRESS 0xd000563c /end MEASUREMENT
/begin MEASUREMENT Vxx_rdn_igc_4_scw "" UWORD _CNV_A_R_A_105_CM 1 0. 0. 65535. DISPLAY_IDENTIFIER fm_sta_igc_4_scw.Vxx_rdn_xxx ECU_ADDRESS 0xd000563e /end MEASUREMENT
/begin MEASUREMENT Vbx_cf_igc_4_scw "" UBYTE _CNV_A_R_A_105_CM 1 0. 0. 255. DISPLAY_IDENTIFIER fm_sta_igc_4_scw.fm_static_bitfield.Vbx_cf_xxx ECU_ADDRESS 0xd0005640 BIT_MASK 0x1 /end MEASUREMENT
/begin MEASUREMENT Vbx_clf_igc_4_scw "" UBYTE _CNV_A_R_A_105_CM 1 0. 0. 255. DISPLAY_IDENTIFIER fm_sta_igc_4_scw.fm_static_bitfield.Vbx_clf_xxx ECU_ADDRESS 0xd0005640 BIT_MASK 0x2 /end MEASUREMENT
/begin MEASUREMENT Vbx_df_old_igc_4_scw "" UBYTE _CNV_A_R_A_105_CM 1 0. 0. 255. DISPLAY_IDENTIFIER fm_sta_igc_4_scw.fm_static_bitfield.Vbx_df_old_xxx ECU_ADDRESS 0xd0005640 BIT_MASK 0x4 /end MEASUREMENT
/begin MEASUREMENT Vbx_dfctr_sat_igc_4_scw "" UBYTE _CNV_A_R_A_105_CM 1 0. 0. 255. DISPLAY_IDENTIFIER fm_sta_igc_4_scw.fm_static_bitfield.Vbx_dfctr_sat_xxx ECU_ADDRESS 0xd0005640 BIT_MASK 0x8 /end MEASUREMENT
/begin MEASUREMENT Vbx_rdn_igc_4_scw "" UBYTE _CNV_A_R_A_105_CM 1 0. 0. 255. DISPLAY_IDENTIFIER fm_sta_igc_4_scw.fm_static_bitfield.Vbx_rdn_xxx ECU_ADDRESS 0xd0005640 BIT_MASK 0x40 /end MEASUREMENT
/begin MEASUREMENT Vxx_dtc_stt_igc_4_scw "" UBYTE _CNV_A_R_A_105_CM 1 0. 0. 255. DISPLAY_IDENTIFIER fm_sta_igc_4_scw.Vxx_dtc_stt_xxx ECU_ADDRESS 0xd0005641 /end MEASUREMENT
/begin MEASUREMENT Vxx_dfctr_in_cam_chr "" UWORD _CNV_A_R_A_105_CM 1 0. 0. 65535. DISPLAY_IDENTIFIER fm_sta_in_cam_chr.Vxx_dfctr_xxx ECU_ADDRESS 0xd00054fe /end MEASUREMENT
/begin MEASUREMENT Vxx_rdn_in_cam_chr "" UWORD _CNV_A_R_A_105_CM 1 0. 0. 65535. DISPLAY_IDENTIFIER fm_sta_in_cam_chr.Vxx_rdn_xxx ECU_ADDRESS 0xd0005500 /end MEASUREMENT
/begin MEASUREMENT Vbx_cf_in_cam_chr "" UBYTE _CNV_A_R_A_105_CM 1 0. 0. 255. DISPLAY_IDENTIFIER fm_sta_in_cam_chr.fm_static_bitfield.Vbx_cf_xxx ECU_ADDRESS 0xd0005502 BIT_MASK 0x1 /end MEASUREMENT
/begin MEASUREMENT Vbx_clf_in_cam_chr "" UBYTE _CNV_A_R_A_105_CM 1 0. 0. 255. DISPLAY_IDENTIFIER fm_sta_in_cam_chr.fm_static_bitfield.Vbx_clf_xxx ECU_ADDRESS 0xd0005502 BIT_MASK 0x2 /end MEASUREMENT
/begin MEASUREMENT Vbx_df_old_in_cam_chr "" UBYTE _CNV_A_R_A_105_CM 1 0. 0. 255. DISPLAY_IDENTIFIER fm_sta_in_cam_chr.fm_static_bitfield.Vbx_df_old_xxx ECU_ADDRESS 0xd0005502 BIT_MASK 0x4 /end MEASUREMENT
/begin MEASUREMENT Vbx_dfctr_sat_in_cam_chr "" UBYTE _CNV_A_R_A_105_CM 1 0. 0. 255. DISPLAY_IDENTIFIER fm_sta_in_cam_chr.fm_static_bitfield.Vbx_dfctr_sat_xxx ECU_ADDRESS 0xd0005502 BIT_MASK 0x8 /end MEASUREMENT
/begin MEASUREMENT Vbx_rdn_in_cam_chr "" UBYTE _CNV_A_R_A_105_CM 1 0. 0. 255. DISPLAY_IDENTIFIER fm_sta_in_cam_chr.fm_static_bitfield.Vbx_rdn_xxx ECU_ADDRESS 0xd0005502 BIT_MASK 0x40 /end MEASUREMENT
/begin MEASUREMENT Vxx_dtc_stt_in_cam_chr "" UBYTE _CNV_A_R_A_105_CM 1 0. 0. 255. DISPLAY_IDENTIFIER fm_sta_in_cam_chr.Vxx_dtc_stt_xxx ECU_ADDRESS 0xd0005503 /end MEASUREMENT
/begin MEASUREMENT Vxx_dfctr_in_cam_crk_cmp "" UWORD _CNV_A_R_A_105_CM 1 0. 0. 65535. DISPLAY_IDENTIFIER fm_sta_in_cam_crk_cmp.Vxx_dfctr_xxx ECU_ADDRESS 0xd0005504 /end MEASUREMENT
/begin MEASUREMENT Vxx_rdn_in_cam_crk_cmp "" UWORD _CNV_A_R_A_105_CM 1 0. 0. 65535. DISPLAY_IDENTIFIER fm_sta_in_cam_crk_cmp.Vxx_rdn_xxx ECU_ADDRESS 0xd0005506 /end MEASUREMENT
/begin MEASUREMENT Vbx_cf_in_cam_crk_cmp "" UBYTE _CNV_A_R_A_105_CM 1 0. 0. 255. DISPLAY_IDENTIFIER fm_sta_in_cam_crk_cmp.fm_static_bitfield.Vbx_cf_xxx ECU_ADDRESS 0xd0005508 BIT_MASK 0x1 /end MEASUREMENT
/begin MEASUREMENT Vbx_clf_in_cam_crk_cmp "" UBYTE _CNV_A_R_A_105_CM 1 0. 0. 255. DISPLAY_IDENTIFIER fm_sta_in_cam_crk_cmp.fm_static_bitfield.Vbx_clf_xxx ECU_ADDRESS 0xd0005508 BIT_MASK 0x2 /end MEASUREMENT
/begin MEASUREMENT Vbx_df_old_in_cam_crk_cmp "" UBYTE _CNV_A_R_A_105_CM 1 0. 0. 255. DISPLAY_IDENTIFIER fm_sta_in_cam_crk_cmp.fm_static_bitfield.Vbx_df_old_xxx ECU_ADDRESS 0xd0005508 BIT_MASK 0x4 /end MEASUREMENT
/begin MEASUREMENT Vbx_dfctr_sat_in_cam_crk_cmp "" UBYTE _CNV_A_R_A_105_CM 1 0. 0. 255. DISPLAY_IDENTIFIER fm_sta_in_cam_crk_cmp.fm_static_bitfield.Vbx_dfctr_sat_xxx ECU_ADDRESS 0xd0005508 BIT_MASK 0x8 /end MEASUREMENT
/begin MEASUREMENT Vbx_rdn_in_cam_crk_cmp "" UBYTE _CNV_A_R_A_105_CM 1 0. 0. 255. DISPLAY_IDENTIFIER fm_sta_in_cam_crk_cmp.fm_static_bitfield.Vbx_rdn_xxx ECU_ADDRESS 0xd0005508 BIT_MASK 0x40 /end MEASUREMENT
/begin MEASUREMENT Vxx_dtc_stt_in_cam_crk_cmp "" UBYTE _CNV_A_R_A_105_CM 1 0. 0. 255. DISPLAY_IDENTIFIER fm_sta_in_cam_crk_cmp.Vxx_dtc_stt_xxx ECU_ADDRESS 0xd0005509 /end MEASUREMENT
/begin MEASUREMENT Vxx_dfctr_in_cam_cyc "" UWORD _CNV_A_R_A_105_CM 1 0. 0. 65535. DISPLAY_IDENTIFIER fm_sta_in_cam_cyc.Vxx_dfctr_xxx ECU_ADDRESS 0xd0005564 /end MEASUREMENT
/begin MEASUREMENT Vxx_rdn_in_cam_cyc "" UWORD _CNV_A_R_A_105_CM 1 0. 0. 65535. DISPLAY_IDENTIFIER fm_sta_in_cam_cyc.Vxx_rdn_xxx ECU_ADDRESS 0xd0005566 /end MEASUREMENT
/begin MEASUREMENT Vbx_cf_in_cam_cyc "" UBYTE _CNV_A_R_A_105_CM 1 0. 0. 255. DISPLAY_IDENTIFIER fm_sta_in_cam_cyc.fm_static_bitfield.Vbx_cf_xxx ECU_ADDRESS 0xd0005568 BIT_MASK 0x1 /end MEASUREMENT
/begin MEASUREMENT Vbx_clf_in_cam_cyc "" UBYTE _CNV_A_R_A_105_CM 1 0. 0. 255. DISPLAY_IDENTIFIER fm_sta_in_cam_cyc.fm_static_bitfield.Vbx_clf_xxx ECU_ADDRESS 0xd0005568 BIT_MASK 0x2 /end MEASUREMENT
/begin MEASUREMENT Vbx_df_old_in_cam_cyc "" UBYTE _CNV_A_R_A_105_CM 1 0. 0. 255. DISPLAY_IDENTIFIER fm_sta_in_cam_cyc.fm_static_bitfield.Vbx_df_old_xxx ECU_ADDRESS 0xd0005568 BIT_MASK 0x4 /end MEASUREMENT
/begin MEASUREMENT Vbx_dfctr_sat_in_cam_cyc "" UBYTE _CNV_A_R_A_105_CM 1 0. 0. 255. DISPLAY_IDENTIFIER fm_sta_in_cam_cyc.fm_static_bitfield.Vbx_dfctr_sat_xxx ECU_ADDRESS 0xd0005568 BIT_MASK 0x8 /end MEASUREMENT
/begin MEASUREMENT Vbx_rdn_in_cam_cyc "" UBYTE _CNV_A_R_A_105_CM 1 0. 0. 255. DISPLAY_IDENTIFIER fm_sta_in_cam_cyc.fm_static_bitfield.Vbx_rdn_xxx ECU_ADDRESS 0xd0005568 BIT_MASK 0x40 /end MEASUREMENT
/begin MEASUREMENT Vxx_dtc_stt_in_cam_cyc "" UBYTE _CNV_A_R_A_105_CM 1 0. 0. 255. DISPLAY_IDENTIFIER fm_sta_in_cam_cyc.Vxx_dtc_stt_xxx ECU_ADDRESS 0xd0005569 /end MEASUREMENT
/begin MEASUREMENT Vxx_dfctr_in_cam_no_sig "" UWORD _CNV_A_R_A_105_CM 1 0. 0. 65535. DISPLAY_IDENTIFIER fm_sta_in_cam_no_sig.Vxx_dfctr_xxx ECU_ADDRESS 0xd000550a /end MEASUREMENT
/begin MEASUREMENT Vxx_rdn_in_cam_no_sig "" UWORD _CNV_A_R_A_105_CM 1 0. 0. 65535. DISPLAY_IDENTIFIER fm_sta_in_cam_no_sig.Vxx_rdn_xxx ECU_ADDRESS 0xd000550c /end MEASUREMENT
/begin MEASUREMENT Vbx_cf_in_cam_no_sig "" UBYTE _CNV_A_R_A_105_CM 1 0. 0. 255. DISPLAY_IDENTIFIER fm_sta_in_cam_no_sig.fm_static_bitfield.Vbx_cf_xxx ECU_ADDRESS 0xd000550e BIT_MASK 0x1 /end MEASUREMENT
/begin MEASUREMENT Vbx_clf_in_cam_no_sig "" UBYTE _CNV_A_R_A_105_CM 1 0. 0. 255. DISPLAY_IDENTIFIER fm_sta_in_cam_no_sig.fm_static_bitfield.Vbx_clf_xxx ECU_ADDRESS 0xd000550e BIT_MASK 0x2 /end MEASUREMENT
/begin MEASUREMENT Vbx_df_old_in_cam_no_sig "" UBYTE _CNV_A_R_A_105_CM 1 0. 0. 255. DISPLAY_IDENTIFIER fm_sta_in_cam_no_sig.fm_static_bitfield.Vbx_df_old_xxx ECU_ADDRESS 0xd000550e BIT_MASK 0x4 /end MEASUREMENT
/begin MEASUREMENT Vbx_dfctr_sat_in_cam_no_sig "" UBYTE _CNV_A_R_A_105_CM 1 0. 0. 255. DISPLAY_IDENTIFIER fm_sta_in_cam_no_sig.fm_static_bitfield.Vbx_dfctr_sat_xxx ECU_ADDRESS 0xd000550e BIT_MASK 0x8 /end MEASUREMENT
/begin MEASUREMENT Vbx_rdn_in_cam_no_sig "" UBYTE _CNV_A_R_A_105_CM 1 0. 0. 255. DISPLAY_IDENTIFIER fm_sta_in_cam_no_sig.fm_static_bitfield.Vbx_rdn_xxx ECU_ADDRESS 0xd000550e BIT_MASK 0x40 /end MEASUREMENT
/begin MEASUREMENT Vxx_dtc_stt_in_cam_no_sig "" UBYTE _CNV_A_R_A_105_CM 1 0. 0. 255. DISPLAY_IDENTIFIER fm_sta_in_cam_no_sig.Vxx_dtc_stt_xxx ECU_ADDRESS 0xd000550f /end MEASUREMENT
/begin MEASUREMENT Vxx_dfctr_in_cam_nok "" UWORD _CNV_A_R_A_105_CM 1 0. 0. 65535. DISPLAY_IDENTIFIER fm_sta_in_cam_nok.Vxx_dfctr_xxx ECU_ADDRESS 0xd000555e /end MEASUREMENT
/begin MEASUREMENT Vxx_rdn_in_cam_nok "" UWORD _CNV_A_R_A_105_CM 1 0. 0. 65535. DISPLAY_IDENTIFIER fm_sta_in_cam_nok.Vxx_rdn_xxx ECU_ADDRESS 0xd0005560 /end MEASUREMENT
/begin MEASUREMENT Vbx_cf_in_cam_nok "" UBYTE _CNV_A_R_A_105_CM 1 0. 0. 255. DISPLAY_IDENTIFIER fm_sta_in_cam_nok.fm_static_bitfield.Vbx_cf_xxx ECU_ADDRESS 0xd0005562 BIT_MASK 0x1 /end MEASUREMENT
/begin MEASUREMENT Vbx_clf_in_cam_nok "" UBYTE _CNV_A_R_A_105_CM 1 0. 0. 255. DISPLAY_IDENTIFIER fm_sta_in_cam_nok.fm_static_bitfield.Vbx_clf_xxx ECU_ADDRESS 0xd0005562 BIT_MASK 0x2 /end MEASUREMENT
/begin MEASUREMENT Vbx_df_old_in_cam_nok "" UBYTE _CNV_A_R_A_105_CM 1 0. 0. 255. DISPLAY_IDENTIFIER fm_sta_in_cam_nok.fm_static_bitfield.Vbx_df_old_xxx ECU_ADDRESS 0xd0005562 BIT_MASK 0x4 /end MEASUREMENT
/begin MEASUREMENT Vbx_dfctr_sat_in_cam_nok "" UBYTE _CNV_A_R_A_105_CM 1 0. 0. 255. DISPLAY_IDENTIFIER fm_sta_in_cam_nok.fm_static_bitfield.Vbx_dfctr_sat_xxx ECU_ADDRESS 0xd0005562 BIT_MASK 0x8 /end MEASUREMENT
/begin MEASUREMENT Vbx_rdn_in_cam_nok "" UBYTE _CNV_A_R_A_105_CM 1 0. 0. 255. DISPLAY_IDENTIFIER fm_sta_in_cam_nok.fm_static_bitfield.Vbx_rdn_xxx ECU_ADDRESS 0xd0005562 BIT_MASK 0x40 /end MEASUREMENT
/begin MEASUREMENT Vxx_dtc_stt_in_cam_nok "" UBYTE _CNV_A_R_A_105_CM 1 0. 0. 255. DISPLAY_IDENTIFIER fm_sta_in_cam_nok.Vxx_dtc_stt_xxx ECU_ADDRESS 0xd0005563 /end MEASUREMENT
/begin MEASUREMENT Vxx_dfctr_in_vvtc_ad "" UWORD _CNV_A_R_A_105_CM 1 0. 0. 65535. DISPLAY_IDENTIFIER fm_sta_in_vvtc_ad.Vxx_dfctr_xxx ECU_ADDRESS 0xd0005510 /end MEASUREMENT
/begin MEASUREMENT Vxx_rdn_in_vvtc_ad "" UWORD _CNV_A_R_A_105_CM 1 0. 0. 65535. DISPLAY_IDENTIFIER fm_sta_in_vvtc_ad.Vxx_rdn_xxx ECU_ADDRESS 0xd0005512 /end MEASUREMENT
/begin MEASUREMENT Vbx_cf_in_vvtc_ad "" UBYTE _CNV_A_R_A_105_CM 1 0. 0. 255. DISPLAY_IDENTIFIER fm_sta_in_vvtc_ad.fm_static_bitfield.Vbx_cf_xxx ECU_ADDRESS 0xd0005514 BIT_MASK 0x1 /end MEASUREMENT
/begin MEASUREMENT Vbx_clf_in_vvtc_ad "" UBYTE _CNV_A_R_A_105_CM 1 0. 0. 255. DISPLAY_IDENTIFIER fm_sta_in_vvtc_ad.fm_static_bitfield.Vbx_clf_xxx ECU_ADDRESS 0xd0005514 BIT_MASK 0x2 /end MEASUREMENT
/begin MEASUREMENT Vbx_df_old_in_vvtc_ad "" UBYTE _CNV_A_R_A_105_CM 1 0. 0. 255. DISPLAY_IDENTIFIER fm_sta_in_vvtc_ad.fm_static_bitfield.Vbx_df_old_xxx ECU_ADDRESS 0xd0005514 BIT_MASK 0x4 /end MEASUREMENT
/begin MEASUREMENT Vbx_dfctr_sat_in_vvtc_ad "" UBYTE _CNV_A_R_A_105_CM 1 0. 0. 255. DISPLAY_IDENTIFIER fm_sta_in_vvtc_ad.fm_static_bitfield.Vbx_dfctr_sat_xxx ECU_ADDRESS 0xd0005514 BIT_MASK 0x8 /end MEASUREMENT
/begin MEASUREMENT Vbx_rdn_in_vvtc_ad "" UBYTE _CNV_A_R_A_105_CM 1 0. 0. 255. DISPLAY_IDENTIFIER fm_sta_in_vvtc_ad.fm_static_bitfield.Vbx_rdn_xxx ECU_ADDRESS 0xd0005514 BIT_MASK 0x40 /end MEASUREMENT
/begin MEASUREMENT Vxx_dtc_stt_in_vvtc_ad "" UBYTE _CNV_A_R_A_105_CM 1 0. 0. 255. DISPLAY_IDENTIFIER fm_sta_in_vvtc_ad.Vxx_dtc_stt_xxx ECU_ADDRESS 0xd0005515 /end MEASUREMENT
/begin MEASUREMENT Vxx_dfctr_in_vvtc_blk "" UWORD _CNV_A_R_A_105_CM 1 0. 0. 65535. DISPLAY_IDENTIFIER fm_sta_in_vvtc_blk.Vxx_dfctr_xxx ECU_ADDRESS 0xd000524c /end MEASUREMENT
/begin MEASUREMENT Vxx_rdn_in_vvtc_blk "" UWORD _CNV_A_R_A_105_CM 1 0. 0. 65535. DISPLAY_IDENTIFIER fm_sta_in_vvtc_blk.Vxx_rdn_xxx ECU_ADDRESS 0xd000524e /end MEASUREMENT
/begin MEASUREMENT Vbx_cf_in_vvtc_blk "" UBYTE _CNV_A_R_A_105_CM 1 0. 0. 255. DISPLAY_IDENTIFIER fm_sta_in_vvtc_blk.fm_static_bitfield.Vbx_cf_xxx ECU_ADDRESS 0xd0005250 BIT_MASK 0x1 /end MEASUREMENT
/begin MEASUREMENT Vbx_clf_in_vvtc_blk "" UBYTE _CNV_A_R_A_105_CM 1 0. 0. 255. DISPLAY_IDENTIFIER fm_sta_in_vvtc_blk.fm_static_bitfield.Vbx_clf_xxx ECU_ADDRESS 0xd0005250 BIT_MASK 0x2 /end MEASUREMENT
/begin MEASUREMENT Vbx_df_old_in_vvtc_blk "" UBYTE _CNV_A_R_A_105_CM 1 0. 0. 255. DISPLAY_IDENTIFIER fm_sta_in_vvtc_blk.fm_static_bitfield.Vbx_df_old_xxx ECU_ADDRESS 0xd0005250 BIT_MASK 0x4 /end MEASUREMENT
/begin MEASUREMENT Vbx_dfctr_sat_in_vvtc_blk "" UBYTE _CNV_A_R_A_105_CM 1 0. 0. 255. DISPLAY_IDENTIFIER fm_sta_in_vvtc_blk.fm_static_bitfield.Vbx_dfctr_sat_xxx ECU_ADDRESS 0xd0005250 BIT_MASK 0x8 /end MEASUREMENT
/begin MEASUREMENT Vbx_rdn_in_vvtc_blk "" UBYTE _CNV_A_R_A_105_CM 1 0. 0. 255. DISPLAY_IDENTIFIER fm_sta_in_vvtc_blk.fm_static_bitfield.Vbx_rdn_xxx ECU_ADDRESS 0xd0005250 BIT_MASK 0x40 /end MEASUREMENT
/begin MEASUREMENT Vxx_dtc_stt_in_vvtc_blk "" UBYTE _CNV_A_R_A_105_CM 1 0. 0. 255. DISPLAY_IDENTIFIER fm_sta_in_vvtc_blk.Vxx_dtc_stt_xxx ECU_ADDRESS 0xd0005251 /end MEASUREMENT
/begin MEASUREMENT Vxx_dfctr_in_vvtc_dirt_lkg "" UWORD _CNV_A_R_A_105_CM 1 0. 0. 65535. DISPLAY_IDENTIFIER fm_sta_in_vvtc_dirt_lkg.Vxx_dfctr_xxx ECU_ADDRESS 0xd0005252 /end MEASUREMENT
/begin MEASUREMENT Vxx_rdn_in_vvtc_dirt_lkg "" UWORD _CNV_A_R_A_105_CM 1 0. 0. 65535. DISPLAY_IDENTIFIER fm_sta_in_vvtc_dirt_lkg.Vxx_rdn_xxx ECU_ADDRESS 0xd0005254 /end MEASUREMENT
/begin MEASUREMENT Vbx_cf_in_vvtc_dirt_lkg "" UBYTE _CNV_A_R_A_105_CM 1 0. 0. 255. DISPLAY_IDENTIFIER fm_sta_in_vvtc_dirt_lkg.fm_static_bitfield.Vbx_cf_xxx ECU_ADDRESS 0xd0005256 BIT_MASK 0x1 /end MEASUREMENT
/begin MEASUREMENT Vbx_clf_in_vvtc_dirt_lkg "" UBYTE _CNV_A_R_A_105_CM 1 0. 0. 255. DISPLAY_IDENTIFIER fm_sta_in_vvtc_dirt_lkg.fm_static_bitfield.Vbx_clf_xxx ECU_ADDRESS 0xd0005256 BIT_MASK 0x2 /end MEASUREMENT
/begin MEASUREMENT Vbx_df_old_in_vvtc_dirt_lkg "" UBYTE _CNV_A_R_A_105_CM 1 0. 0. 255. DISPLAY_IDENTIFIER fm_sta_in_vvtc_dirt_lkg.fm_static_bitfield.Vbx_df_old_xxx ECU_ADDRESS 0xd0005256 BIT_MASK 0x4 /end MEASUREMENT
/begin MEASUREMENT Vbx_dfctr_sat_in_vvtc_dirt_lkg "" UBYTE _CNV_A_R_A_105_CM 1 0. 0. 255. DISPLAY_IDENTIFIER fm_sta_in_vvtc_dirt_lkg.fm_static_bitfield.Vbx_dfctr_sat_xxx ECU_ADDRESS 0xd0005256 BIT_MASK 0x8 /end MEASUREMENT
/begin MEASUREMENT Vbx_rdn_in_vvtc_dirt_lkg "" UBYTE _CNV_A_R_A_105_CM 1 0. 0. 255. DISPLAY_IDENTIFIER fm_sta_in_vvtc_dirt_lkg.fm_static_bitfield.Vbx_rdn_xxx ECU_ADDRESS 0xd0005256 BIT_MASK 0x40 /end MEASUREMENT
/begin MEASUREMENT Vxx_dtc_stt_in_vvtc_dirt_lkg "" UBYTE _CNV_A_R_A_105_CM 1 0. 0. 255. DISPLAY_IDENTIFIER fm_sta_in_vvtc_dirt_lkg.Vxx_dtc_stt_xxx ECU_ADDRESS 0xd0005257 /end MEASUREMENT
/begin MEASUREMENT Vxx_dfctr_in_vvtc_sldv_oc "" UWORD _CNV_A_R_A_105_CM 1 0. 0. 65535. DISPLAY_IDENTIFIER fm_sta_in_vvtc_sldv_oc.Vxx_dfctr_xxx ECU_ADDRESS 0xd0005258 /end MEASUREMENT
/begin MEASUREMENT Vxx_rdn_in_vvtc_sldv_oc "" UWORD _CNV_A_R_A_105_CM 1 0. 0. 65535. DISPLAY_IDENTIFIER fm_sta_in_vvtc_sldv_oc.Vxx_rdn_xxx ECU_ADDRESS 0xd000525a /end MEASUREMENT
/begin MEASUREMENT Vbx_cf_in_vvtc_sldv_oc "" UBYTE _CNV_A_R_A_105_CM 1 0. 0. 255. DISPLAY_IDENTIFIER fm_sta_in_vvtc_sldv_oc.fm_static_bitfield.Vbx_cf_xxx ECU_ADDRESS 0xd000525c BIT_MASK 0x1 /end MEASUREMENT
/begin MEASUREMENT Vbx_clf_in_vvtc_sldv_oc "" UBYTE _CNV_A_R_A_105_CM 1 0. 0. 255. DISPLAY_IDENTIFIER fm_sta_in_vvtc_sldv_oc.fm_static_bitfield.Vbx_clf_xxx ECU_ADDRESS 0xd000525c BIT_MASK 0x2 /end MEASUREMENT
/begin MEASUREMENT Vbx_df_old_in_vvtc_sldv_oc "" UBYTE _CNV_A_R_A_105_CM 1 0. 0. 255. DISPLAY_IDENTIFIER fm_sta_in_vvtc_sldv_oc.fm_static_bitfield.Vbx_df_old_xxx ECU_ADDRESS 0xd000525c BIT_MASK 0x4 /end MEASUREMENT
/begin MEASUREMENT Vbx_dfctr_sat_in_vvtc_sldv_oc "" UBYTE _CNV_A_R_A_105_CM 1 0. 0. 255. DISPLAY_IDENTIFIER fm_sta_in_vvtc_sldv_oc.fm_static_bitfield.Vbx_dfctr_sat_xxx ECU_ADDRESS 0xd000525c BIT_MASK 0x8 /end MEASUREMENT
/begin MEASUREMENT Vbx_rdn_in_vvtc_sldv_oc "" UBYTE _CNV_A_R_A_105_CM 1 0. 0. 255. DISPLAY_IDENTIFIER fm_sta_in_vvtc_sldv_oc.fm_static_bitfield.Vbx_rdn_xxx ECU_ADDRESS 0xd000525c BIT_MASK 0x40 /end MEASUREMENT
/begin MEASUREMENT Vxx_dtc_stt_in_vvtc_sldv_oc "" UBYTE _CNV_A_R_A_105_CM 1 0. 0. 255. DISPLAY_IDENTIFIER fm_sta_in_vvtc_sldv_oc.Vxx_dtc_stt_xxx ECU_ADDRESS 0xd000525d /end MEASUREMENT
/begin MEASUREMENT Vxx_dfctr_in_vvtc_sldv_scg "" UWORD _CNV_A_R_A_105_CM 1 0. 0. 65535. DISPLAY_IDENTIFIER fm_sta_in_vvtc_sldv_scg.Vxx_dfctr_xxx ECU_ADDRESS 0xd000525e /end MEASUREMENT
/begin MEASUREMENT Vxx_rdn_in_vvtc_sldv_scg "" UWORD _CNV_A_R_A_105_CM 1 0. 0. 65535. DISPLAY_IDENTIFIER fm_sta_in_vvtc_sldv_scg.Vxx_rdn_xxx ECU_ADDRESS 0xd0005260 /end MEASUREMENT
/begin MEASUREMENT Vbx_cf_in_vvtc_sldv_scg "" UBYTE _CNV_A_R_A_105_CM 1 0. 0. 255. DISPLAY_IDENTIFIER fm_sta_in_vvtc_sldv_scg.fm_static_bitfield.Vbx_cf_xxx ECU_ADDRESS 0xd0005262 BIT_MASK 0x1 /end MEASUREMENT
/begin MEASUREMENT Vbx_clf_in_vvtc_sldv_scg "" UBYTE _CNV_A_R_A_105_CM 1 0. 0. 255. DISPLAY_IDENTIFIER fm_sta_in_vvtc_sldv_scg.fm_static_bitfield.Vbx_clf_xxx ECU_ADDRESS 0xd0005262 BIT_MASK 0x2 /end MEASUREMENT
/begin MEASUREMENT Vbx_df_old_in_vvtc_sldv_scg "" UBYTE _CNV_A_R_A_105_CM 1 0. 0. 255. DISPLAY_IDENTIFIER fm_sta_in_vvtc_sldv_scg.fm_static_bitfield.Vbx_df_old_xxx ECU_ADDRESS 0xd0005262 BIT_MASK 0x4 /end MEASUREMENT
/begin MEASUREMENT Vbx_dfctr_sat_in_vvtc_sldv_scg "" UBYTE _CNV_A_R_A_105_CM 1 0. 0. 255. DISPLAY_IDENTIFIER fm_sta_in_vvtc_sldv_scg.fm_static_bitfield.Vbx_dfctr_sat_xxx ECU_ADDRESS 0xd0005262 BIT_MASK 0x8 /end MEASUREMENT
/begin MEASUREMENT Vbx_rdn_in_vvtc_sldv_scg "" UBYTE _CNV_A_R_A_105_CM 1 0. 0. 255. DISPLAY_IDENTIFIER fm_sta_in_vvtc_sldv_scg.fm_static_bitfield.Vbx_rdn_xxx ECU_ADDRESS 0xd0005262 BIT_MASK 0x40 /end MEASUREMENT
/begin MEASUREMENT Vxx_dtc_stt_in_vvtc_sldv_scg "" UBYTE _CNV_A_R_A_105_CM 1 0. 0. 255. DISPLAY_IDENTIFIER fm_sta_in_vvtc_sldv_scg.Vxx_dtc_stt_xxx ECU_ADDRESS 0xd0005263 /end MEASUREMENT
/begin MEASUREMENT Vxx_dfctr_in_vvtc_sldv_scw "" UWORD _CNV_A_R_A_105_CM 1 0. 0. 65535. DISPLAY_IDENTIFIER fm_sta_in_vvtc_sldv_scw.Vxx_dfctr_xxx ECU_ADDRESS 0xd0005264 /end MEASUREMENT
/begin MEASUREMENT Vxx_rdn_in_vvtc_sldv_scw "" UWORD _CNV_A_R_A_105_CM 1 0. 0. 65535. DISPLAY_IDENTIFIER fm_sta_in_vvtc_sldv_scw.Vxx_rdn_xxx ECU_ADDRESS 0xd0005266 /end MEASUREMENT
/begin MEASUREMENT Vbx_cf_in_vvtc_sldv_scw "" UBYTE _CNV_A_R_A_105_CM 1 0. 0. 255. DISPLAY_IDENTIFIER fm_sta_in_vvtc_sldv_scw.fm_static_bitfield.Vbx_cf_xxx ECU_ADDRESS 0xd0005268 BIT_MASK 0x1 /end MEASUREMENT
/begin MEASUREMENT Vbx_clf_in_vvtc_sldv_scw "" UBYTE _CNV_A_R_A_105_CM 1 0. 0. 255. DISPLAY_IDENTIFIER fm_sta_in_vvtc_sldv_scw.fm_static_bitfield.Vbx_clf_xxx ECU_ADDRESS 0xd0005268 BIT_MASK 0x2 /end MEASUREMENT
/begin MEASUREMENT Vbx_df_old_in_vvtc_sldv_scw "" UBYTE _CNV_A_R_A_105_CM 1 0. 0. 255. DISPLAY_IDENTIFIER fm_sta_in_vvtc_sldv_scw.fm_static_bitfield.Vbx_df_old_xxx ECU_ADDRESS 0xd0005268 BIT_MASK 0x4 /end MEASUREMENT
/begin MEASUREMENT Vbx_dfctr_sat_in_vvtc_sldv_scw "" UBYTE _CNV_A_R_A_105_CM 1 0. 0. 255. DISPLAY_IDENTIFIER fm_sta_in_vvtc_sldv_scw.fm_static_bitfield.Vbx_dfctr_sat_xxx ECU_ADDRESS 0xd0005268 BIT_MASK 0x8 /end MEASUREMENT
/begin MEASUREMENT Vbx_rdn_in_vvtc_sldv_scw "" UBYTE _CNV_A_R_A_105_CM 1 0. 0. 255. DISPLAY_IDENTIFIER fm_sta_in_vvtc_sldv_scw.fm_static_bitfield.Vbx_rdn_xxx ECU_ADDRESS 0xd0005268 BIT_MASK 0x40 /end MEASUREMENT
/begin MEASUREMENT Vxx_dtc_stt_in_vvtc_sldv_scw "" UBYTE _CNV_A_R_A_105_CM 1 0. 0. 255. DISPLAY_IDENTIFIER fm_sta_in_vvtc_sldv_scw.Vxx_dtc_stt_xxx ECU_ADDRESS 0xd0005269 /end MEASUREMENT
/begin MEASUREMENT Vxx_dfctr_inj1_oc "" UWORD _CNV_A_R_A_105_CM 1 0. 0. 65535. DISPLAY_IDENTIFIER fm_sta_inj1_oc.Vxx_dfctr_xxx ECU_ADDRESS 0xd0005276 /end MEASUREMENT
/begin MEASUREMENT Vxx_rdn_inj1_oc "" UWORD _CNV_A_R_A_105_CM 1 0. 0. 65535. DISPLAY_IDENTIFIER fm_sta_inj1_oc.Vxx_rdn_xxx ECU_ADDRESS 0xd0005278 /end MEASUREMENT
/begin MEASUREMENT Vbx_cf_inj1_oc "" UBYTE _CNV_A_R_A_105_CM 1 0. 0. 255. DISPLAY_IDENTIFIER fm_sta_inj1_oc.fm_static_bitfield.Vbx_cf_xxx ECU_ADDRESS 0xd000527a BIT_MASK 0x1 /end MEASUREMENT
/begin MEASUREMENT Vbx_clf_inj1_oc "" UBYTE _CNV_A_R_A_105_CM 1 0. 0. 255. DISPLAY_IDENTIFIER fm_sta_inj1_oc.fm_static_bitfield.Vbx_clf_xxx ECU_ADDRESS 0xd000527a BIT_MASK 0x2 /end MEASUREMENT
/begin MEASUREMENT Vbx_df_old_inj1_oc "" UBYTE _CNV_A_R_A_105_CM 1 0. 0. 255. DISPLAY_IDENTIFIER fm_sta_inj1_oc.fm_static_bitfield.Vbx_df_old_xxx ECU_ADDRESS 0xd000527a BIT_MASK 0x4 /end MEASUREMENT
/begin MEASUREMENT Vbx_dfctr_sat_inj1_oc "" UBYTE _CNV_A_R_A_105_CM 1 0. 0. 255. DISPLAY_IDENTIFIER fm_sta_inj1_oc.fm_static_bitfield.Vbx_dfctr_sat_xxx ECU_ADDRESS 0xd000527a BIT_MASK 0x8 /end MEASUREMENT
/begin MEASUREMENT Vbx_rdn_inj1_oc "" UBYTE _CNV_A_R_A_105_CM 1 0. 0. 255. DISPLAY_IDENTIFIER fm_sta_inj1_oc.fm_static_bitfield.Vbx_rdn_xxx ECU_ADDRESS 0xd000527a BIT_MASK 0x40 /end MEASUREMENT
/begin MEASUREMENT Vxx_dtc_stt_inj1_oc "" UBYTE _CNV_A_R_A_105_CM 1 0. 0. 255. DISPLAY_IDENTIFIER fm_sta_inj1_oc.Vxx_dtc_stt_xxx ECU_ADDRESS 0xd000527b /end MEASUREMENT
/begin MEASUREMENT Vxx_dfctr_inj1_scg "" UWORD _CNV_A_R_A_105_CM 1 0. 0. 65535. DISPLAY_IDENTIFIER fm_sta_inj1_scg.Vxx_dfctr_xxx ECU_ADDRESS 0xd000527c /end MEASUREMENT
/begin MEASUREMENT Vxx_rdn_inj1_scg "" UWORD _CNV_A_R_A_105_CM 1 0. 0. 65535. DISPLAY_IDENTIFIER fm_sta_inj1_scg.Vxx_rdn_xxx ECU_ADDRESS 0xd000527e /end MEASUREMENT
/begin MEASUREMENT Vbx_cf_inj1_scg "" UBYTE _CNV_A_R_A_105_CM 1 0. 0. 255. DISPLAY_IDENTIFIER fm_sta_inj1_scg.fm_static_bitfield.Vbx_cf_xxx ECU_ADDRESS 0xd0005280 BIT_MASK 0x1 /end MEASUREMENT
/begin MEASUREMENT Vbx_clf_inj1_scg "" UBYTE _CNV_A_R_A_105_CM 1 0. 0. 255. DISPLAY_IDENTIFIER fm_sta_inj1_scg.fm_static_bitfield.Vbx_clf_xxx ECU_ADDRESS 0xd0005280 BIT_MASK 0x2 /end MEASUREMENT
/begin MEASUREMENT Vbx_df_old_inj1_scg "" UBYTE _CNV_A_R_A_105_CM 1 0. 0. 255. DISPLAY_IDENTIFIER fm_sta_inj1_scg.fm_static_bitfield.Vbx_df_old_xxx ECU_ADDRESS 0xd0005280 BIT_MASK 0x4 /end MEASUREMENT
/begin MEASUREMENT Vbx_dfctr_sat_inj1_scg "" UBYTE _CNV_A_R_A_105_CM 1 0. 0. 255. DISPLAY_IDENTIFIER fm_sta_inj1_scg.fm_static_bitfield.Vbx_dfctr_sat_xxx ECU_ADDRESS 0xd0005280 BIT_MASK 0x8 /end MEASUREMENT
/begin MEASUREMENT Vbx_rdn_inj1_scg "" UBYTE _CNV_A_R_A_105_CM 1 0. 0. 255. DISPLAY_IDENTIFIER fm_sta_inj1_scg.fm_static_bitfield.Vbx_rdn_xxx ECU_ADDRESS 0xd0005280 BIT_MASK 0x40 /end MEASUREMENT
/begin MEASUREMENT Vxx_dtc_stt_inj1_scg "" UBYTE _CNV_A_R_A_105_CM 1 0. 0. 255. DISPLAY_IDENTIFIER fm_sta_inj1_scg.Vxx_dtc_stt_xxx ECU_ADDRESS 0xd0005281 /end MEASUREMENT
/begin MEASUREMENT Vxx_dfctr_inj1_scw "" UWORD _CNV_A_R_A_105_CM 1 0. 0. 65535. DISPLAY_IDENTIFIER fm_sta_inj1_scw.Vxx_dfctr_xxx ECU_ADDRESS 0xd0005282 /end MEASUREMENT
/begin MEASUREMENT Vxx_rdn_inj1_scw "" UWORD _CNV_A_R_A_105_CM 1 0. 0. 65535. DISPLAY_IDENTIFIER fm_sta_inj1_scw.Vxx_rdn_xxx ECU_ADDRESS 0xd0005284 /end MEASUREMENT
/begin MEASUREMENT Vbx_cf_inj1_scw "" UBYTE _CNV_A_R_A_105_CM 1 0. 0. 255. DISPLAY_IDENTIFIER fm_sta_inj1_scw.fm_static_bitfield.Vbx_cf_xxx ECU_ADDRESS 0xd0005286 BIT_MASK 0x1 /end MEASUREMENT
/begin MEASUREMENT Vbx_clf_inj1_scw "" UBYTE _CNV_A_R_A_105_CM 1 0. 0. 255. DISPLAY_IDENTIFIER fm_sta_inj1_scw.fm_static_bitfield.Vbx_clf_xxx ECU_ADDRESS 0xd0005286 BIT_MASK 0x2 /end MEASUREMENT
/begin MEASUREMENT Vbx_df_old_inj1_scw "" UBYTE _CNV_A_R_A_105_CM 1 0. 0. 255. DISPLAY_IDENTIFIER fm_sta_inj1_scw.fm_static_bitfield.Vbx_df_old_xxx ECU_ADDRESS 0xd0005286 BIT_MASK 0x4 /end MEASUREMENT
/begin MEASUREMENT Vbx_dfctr_sat_inj1_scw "" UBYTE _CNV_A_R_A_105_CM 1 0. 0. 255. DISPLAY_IDENTIFIER fm_sta_inj1_scw.fm_static_bitfield.Vbx_dfctr_sat_xxx ECU_ADDRESS 0xd0005286 BIT_MASK 0x8 /end MEASUREMENT
/begin MEASUREMENT Vbx_rdn_inj1_scw "" UBYTE _CNV_A_R_A_105_CM 1 0. 0. 255. DISPLAY_IDENTIFIER fm_sta_inj1_scw.fm_static_bitfield.Vbx_rdn_xxx ECU_ADDRESS 0xd0005286 BIT_MASK 0x40 /end MEASUREMENT
/begin MEASUREMENT Vxx_dtc_stt_inj1_scw "" UBYTE _CNV_A_R_A_105_CM 1 0. 0. 255. DISPLAY_IDENTIFIER fm_sta_inj1_scw.Vxx_dtc_stt_xxx ECU_ADDRESS 0xd0005287 /end MEASUREMENT
/begin MEASUREMENT Vxx_dfctr_inj2_oc "" UWORD _CNV_A_R_A_105_CM 1 0. 0. 65535. DISPLAY_IDENTIFIER fm_sta_inj2_oc.Vxx_dfctr_xxx ECU_ADDRESS 0xd0005288 /end MEASUREMENT
/begin MEASUREMENT Vxx_rdn_inj2_oc "" UWORD _CNV_A_R_A_105_CM 1 0. 0. 65535. DISPLAY_IDENTIFIER fm_sta_inj2_oc.Vxx_rdn_xxx ECU_ADDRESS 0xd000528a /end MEASUREMENT
/begin MEASUREMENT Vbx_cf_inj2_oc "" UBYTE _CNV_A_R_A_105_CM 1 0. 0. 255. DISPLAY_IDENTIFIER fm_sta_inj2_oc.fm_static_bitfield.Vbx_cf_xxx ECU_ADDRESS 0xd000528c BIT_MASK 0x1 /end MEASUREMENT
/begin MEASUREMENT Vbx_clf_inj2_oc "" UBYTE _CNV_A_R_A_105_CM 1 0. 0. 255. DISPLAY_IDENTIFIER fm_sta_inj2_oc.fm_static_bitfield.Vbx_clf_xxx ECU_ADDRESS 0xd000528c BIT_MASK 0x2 /end MEASUREMENT
/begin MEASUREMENT Vbx_df_old_inj2_oc "" UBYTE _CNV_A_R_A_105_CM 1 0. 0. 255. DISPLAY_IDENTIFIER fm_sta_inj2_oc.fm_static_bitfield.Vbx_df_old_xxx ECU_ADDRESS 0xd000528c BIT_MASK 0x4 /end MEASUREMENT
/begin MEASUREMENT Vbx_dfctr_sat_inj2_oc "" UBYTE _CNV_A_R_A_105_CM 1 0. 0. 255. DISPLAY_IDENTIFIER fm_sta_inj2_oc.fm_static_bitfield.Vbx_dfctr_sat_xxx ECU_ADDRESS 0xd000528c BIT_MASK 0x8 /end MEASUREMENT
/begin MEASUREMENT Vbx_rdn_inj2_oc "" UBYTE _CNV_A_R_A_105_CM 1 0. 0. 255. DISPLAY_IDENTIFIER fm_sta_inj2_oc.fm_static_bitfield.Vbx_rdn_xxx ECU_ADDRESS 0xd000528c BIT_MASK 0x40 /end MEASUREMENT
/begin MEASUREMENT Vxx_dtc_stt_inj2_oc "" UBYTE _CNV_A_R_A_105_CM 1 0. 0. 255. DISPLAY_IDENTIFIER fm_sta_inj2_oc.Vxx_dtc_stt_xxx ECU_ADDRESS 0xd000528d /end MEASUREMENT
/begin MEASUREMENT Vxx_dfctr_inj2_scg "" UWORD _CNV_A_R_A_105_CM 1 0. 0. 65535. DISPLAY_IDENTIFIER fm_sta_inj2_scg.Vxx_dfctr_xxx ECU_ADDRESS 0xd000528e /end MEASUREMENT
/begin MEASUREMENT Vxx_rdn_inj2_scg "" UWORD _CNV_A_R_A_105_CM 1 0. 0. 65535. DISPLAY_IDENTIFIER fm_sta_inj2_scg.Vxx_rdn_xxx ECU_ADDRESS 0xd0005290 /end MEASUREMENT
/begin MEASUREMENT Vbx_cf_inj2_scg "" UBYTE _CNV_A_R_A_105_CM 1 0. 0. 255. DISPLAY_IDENTIFIER fm_sta_inj2_scg.fm_static_bitfield.Vbx_cf_xxx ECU_ADDRESS 0xd0005292 BIT_MASK 0x1 /end MEASUREMENT
/begin MEASUREMENT Vbx_clf_inj2_scg "" UBYTE _CNV_A_R_A_105_CM 1 0. 0. 255. DISPLAY_IDENTIFIER fm_sta_inj2_scg.fm_static_bitfield.Vbx_clf_xxx ECU_ADDRESS 0xd0005292 BIT_MASK 0x2 /end MEASUREMENT
/begin MEASUREMENT Vbx_df_old_inj2_scg "" UBYTE _CNV_A_R_A_105_CM 1 0. 0. 255. DISPLAY_IDENTIFIER fm_sta_inj2_scg.fm_static_bitfield.Vbx_df_old_xxx ECU_ADDRESS 0xd0005292 BIT_MASK 0x4 /end MEASUREMENT
/begin MEASUREMENT Vbx_dfctr_sat_inj2_scg "" UBYTE _CNV_A_R_A_105_CM 1 0. 0. 255. DISPLAY_IDENTIFIER fm_sta_inj2_scg.fm_static_bitfield.Vbx_dfctr_sat_xxx ECU_ADDRESS 0xd0005292 BIT_MASK 0x8 /end MEASUREMENT
/begin MEASUREMENT Vbx_rdn_inj2_scg "" UBYTE _CNV_A_R_A_105_CM 1 0. 0. 255. DISPLAY_IDENTIFIER fm_sta_inj2_scg.fm_static_bitfield.Vbx_rdn_xxx ECU_ADDRESS 0xd0005292 BIT_MASK 0x40 /end MEASUREMENT
/begin MEASUREMENT Vxx_dtc_stt_inj2_scg "" UBYTE _CNV_A_R_A_105_CM 1 0. 0. 255. DISPLAY_IDENTIFIER fm_sta_inj2_scg.Vxx_dtc_stt_xxx ECU_ADDRESS 0xd0005293 /end MEASUREMENT
/begin MEASUREMENT Vxx_dfctr_inj2_scw "" UWORD _CNV_A_R_A_105_CM 1 0. 0. 65535. DISPLAY_IDENTIFIER fm_sta_inj2_scw.Vxx_dfctr_xxx ECU_ADDRESS 0xd0005294 /end MEASUREMENT
/begin MEASUREMENT Vxx_rdn_inj2_scw "" UWORD _CNV_A_R_A_105_CM 1 0. 0. 65535. DISPLAY_IDENTIFIER fm_sta_inj2_scw.Vxx_rdn_xxx ECU_ADDRESS 0xd0005296 /end MEASUREMENT
/begin MEASUREMENT Vbx_cf_inj2_scw "" UBYTE _CNV_A_R_A_105_CM 1 0. 0. 255. DISPLAY_IDENTIFIER fm_sta_inj2_scw.fm_static_bitfield.Vbx_cf_xxx ECU_ADDRESS 0xd0005298 BIT_MASK 0x1 /end MEASUREMENT
/begin MEASUREMENT Vbx_clf_inj2_scw "" UBYTE _CNV_A_R_A_105_CM 1 0. 0. 255. DISPLAY_IDENTIFIER fm_sta_inj2_scw.fm_static_bitfield.Vbx_clf_xxx ECU_ADDRESS 0xd0005298 BIT_MASK 0x2 /end MEASUREMENT
/begin MEASUREMENT Vbx_df_old_inj2_scw "" UBYTE _CNV_A_R_A_105_CM 1 0. 0. 255. DISPLAY_IDENTIFIER fm_sta_inj2_scw.fm_static_bitfield.Vbx_df_old_xxx ECU_ADDRESS 0xd0005298 BIT_MASK 0x4 /end MEASUREMENT
/begin MEASUREMENT Vbx_dfctr_sat_inj2_scw "" UBYTE _CNV_A_R_A_105_CM 1 0. 0. 255. DISPLAY_IDENTIFIER fm_sta_inj2_scw.fm_static_bitfield.Vbx_dfctr_sat_xxx ECU_ADDRESS 0xd0005298 BIT_MASK 0x8 /end MEASUREMENT
/begin MEASUREMENT Vbx_rdn_inj2_scw "" UBYTE _CNV_A_R_A_105_CM 1 0. 0. 255. DISPLAY_IDENTIFIER fm_sta_inj2_scw.fm_static_bitfield.Vbx_rdn_xxx ECU_ADDRESS 0xd0005298 BIT_MASK 0x40 /end MEASUREMENT
/begin MEASUREMENT Vxx_dtc_stt_inj2_scw "" UBYTE _CNV_A_R_A_105_CM 1 0. 0. 255. DISPLAY_IDENTIFIER fm_sta_inj2_scw.Vxx_dtc_stt_xxx ECU_ADDRESS 0xd0005299 /end MEASUREMENT
/begin MEASUREMENT Vxx_dfctr_inj3_oc "" UWORD _CNV_A_R_A_105_CM 1 0. 0. 65535. DISPLAY_IDENTIFIER fm_sta_inj3_oc.Vxx_dfctr_xxx ECU_ADDRESS 0xd000529a /end MEASUREMENT
/begin MEASUREMENT Vxx_rdn_inj3_oc "" UWORD _CNV_A_R_A_105_CM 1 0. 0. 65535. DISPLAY_IDENTIFIER fm_sta_inj3_oc.Vxx_rdn_xxx ECU_ADDRESS 0xd000529c /end MEASUREMENT
/begin MEASUREMENT Vbx_cf_inj3_oc "" UBYTE _CNV_A_R_A_105_CM 1 0. 0. 255. DISPLAY_IDENTIFIER fm_sta_inj3_oc.fm_static_bitfield.Vbx_cf_xxx ECU_ADDRESS 0xd000529e BIT_MASK 0x1 /end MEASUREMENT
/begin MEASUREMENT Vbx_clf_inj3_oc "" UBYTE _CNV_A_R_A_105_CM 1 0. 0. 255. DISPLAY_IDENTIFIER fm_sta_inj3_oc.fm_static_bitfield.Vbx_clf_xxx ECU_ADDRESS 0xd000529e BIT_MASK 0x2 /end MEASUREMENT
/begin MEASUREMENT Vbx_df_old_inj3_oc "" UBYTE _CNV_A_R_A_105_CM 1 0. 0. 255. DISPLAY_IDENTIFIER fm_sta_inj3_oc.fm_static_bitfield.Vbx_df_old_xxx ECU_ADDRESS 0xd000529e BIT_MASK 0x4 /end MEASUREMENT
/begin MEASUREMENT Vbx_dfctr_sat_inj3_oc "" UBYTE _CNV_A_R_A_105_CM 1 0. 0. 255. DISPLAY_IDENTIFIER fm_sta_inj3_oc.fm_static_bitfield.Vbx_dfctr_sat_xxx ECU_ADDRESS 0xd000529e BIT_MASK 0x8 /end MEASUREMENT
/begin MEASUREMENT Vbx_rdn_inj3_oc "" UBYTE _CNV_A_R_A_105_CM 1 0. 0. 255. DISPLAY_IDENTIFIER fm_sta_inj3_oc.fm_static_bitfield.Vbx_rdn_xxx ECU_ADDRESS 0xd000529e BIT_MASK 0x40 /end MEASUREMENT
/begin MEASUREMENT Vxx_dtc_stt_inj3_oc "" UBYTE _CNV_A_R_A_105_CM 1 0. 0. 255. DISPLAY_IDENTIFIER fm_sta_inj3_oc.Vxx_dtc_stt_xxx ECU_ADDRESS 0xd000529f /end MEASUREMENT
/begin MEASUREMENT Vxx_dfctr_inj3_scg "" UWORD _CNV_A_R_A_105_CM 1 0. 0. 65535. DISPLAY_IDENTIFIER fm_sta_inj3_scg.Vxx_dfctr_xxx ECU_ADDRESS 0xd00052a0 /end MEASUREMENT
/begin MEASUREMENT Vxx_rdn_inj3_scg "" UWORD _CNV_A_R_A_105_CM 1 0. 0. 65535. DISPLAY_IDENTIFIER fm_sta_inj3_scg.Vxx_rdn_xxx ECU_ADDRESS 0xd00052a2 /end MEASUREMENT
/begin MEASUREMENT Vbx_cf_inj3_scg "" UBYTE _CNV_A_R_A_105_CM 1 0. 0. 255. DISPLAY_IDENTIFIER fm_sta_inj3_scg.fm_static_bitfield.Vbx_cf_xxx ECU_ADDRESS 0xd00052a4 BIT_MASK 0x1 /end MEASUREMENT
/begin MEASUREMENT Vbx_clf_inj3_scg "" UBYTE _CNV_A_R_A_105_CM 1 0. 0. 255. DISPLAY_IDENTIFIER fm_sta_inj3_scg.fm_static_bitfield.Vbx_clf_xxx ECU_ADDRESS 0xd00052a4 BIT_MASK 0x2 /end MEASUREMENT
/begin MEASUREMENT Vbx_df_old_inj3_scg "" UBYTE _CNV_A_R_A_105_CM 1 0. 0. 255. DISPLAY_IDENTIFIER fm_sta_inj3_scg.fm_static_bitfield.Vbx_df_old_xxx ECU_ADDRESS 0xd00052a4 BIT_MASK 0x4 /end MEASUREMENT
/begin MEASUREMENT Vbx_dfctr_sat_inj3_scg "" UBYTE _CNV_A_R_A_105_CM 1 0. 0. 255. DISPLAY_IDENTIFIER fm_sta_inj3_scg.fm_static_bitfield.Vbx_dfctr_sat_xxx ECU_ADDRESS 0xd00052a4 BIT_MASK 0x8 /end MEASUREMENT
/begin MEASUREMENT Vbx_rdn_inj3_scg "" UBYTE _CNV_A_R_A_105_CM 1 0. 0. 255. DISPLAY_IDENTIFIER fm_sta_inj3_scg.fm_static_bitfield.Vbx_rdn_xxx ECU_ADDRESS 0xd00052a4 BIT_MASK 0x40 /end MEASUREMENT
/begin MEASUREMENT Vxx_dtc_stt_inj3_scg "" UBYTE _CNV_A_R_A_105_CM 1 0. 0. 255. DISPLAY_IDENTIFIER fm_sta_inj3_scg.Vxx_dtc_stt_xxx ECU_ADDRESS 0xd00052a5 /end MEASUREMENT
/begin MEASUREMENT Vxx_dfctr_inj3_scw "" UWORD _CNV_A_R_A_105_CM 1 0. 0. 65535. DISPLAY_IDENTIFIER fm_sta_inj3_scw.Vxx_dfctr_xxx ECU_ADDRESS 0xd00052a6 /end MEASUREMENT
/begin MEASUREMENT Vxx_rdn_inj3_scw "" UWORD _CNV_A_R_A_105_CM 1 0. 0. 65535. DISPLAY_IDENTIFIER fm_sta_inj3_scw.Vxx_rdn_xxx ECU_ADDRESS 0xd00052a8 /end MEASUREMENT
/begin MEASUREMENT Vbx_cf_inj3_scw "" UBYTE _CNV_A_R_A_105_CM 1 0. 0. 255. DISPLAY_IDENTIFIER fm_sta_inj3_scw.fm_static_bitfield.Vbx_cf_xxx ECU_ADDRESS 0xd00052aa BIT_MASK 0x1 /end MEASUREMENT
/begin MEASUREMENT Vbx_clf_inj3_scw "" UBYTE _CNV_A_R_A_105_CM 1 0. 0. 255. DISPLAY_IDENTIFIER fm_sta_inj3_scw.fm_static_bitfield.Vbx_clf_xxx ECU_ADDRESS 0xd00052aa BIT_MASK 0x2 /end MEASUREMENT
/begin MEASUREMENT Vbx_df_old_inj3_scw "" UBYTE _CNV_A_R_A_105_CM 1 0. 0. 255. DISPLAY_IDENTIFIER fm_sta_inj3_scw.fm_static_bitfield.Vbx_df_old_xxx ECU_ADDRESS 0xd00052aa BIT_MASK 0x4 /end MEASUREMENT
/begin MEASUREMENT Vbx_dfctr_sat_inj3_scw "" UBYTE _CNV_A_R_A_105_CM 1 0. 0. 255. DISPLAY_IDENTIFIER fm_sta_inj3_scw.fm_static_bitfield.Vbx_dfctr_sat_xxx ECU_ADDRESS 0xd00052aa BIT_MASK 0x8 /end MEASUREMENT
/begin MEASUREMENT Vbx_rdn_inj3_scw "" UBYTE _CNV_A_R_A_105_CM 1 0. 0. 255. DISPLAY_IDENTIFIER fm_sta_inj3_scw.fm_static_bitfield.Vbx_rdn_xxx ECU_ADDRESS 0xd00052aa BIT_MASK 0x40 /end MEASUREMENT
/begin MEASUREMENT Vxx_dtc_stt_inj3_scw "" UBYTE _CNV_A_R_A_105_CM 1 0. 0. 255. DISPLAY_IDENTIFIER fm_sta_inj3_scw.Vxx_dtc_stt_xxx ECU_ADDRESS 0xd00052ab /end MEASUREMENT
/begin MEASUREMENT Vxx_dfctr_inj4_oc "" UWORD _CNV_A_R_A_105_CM 1 0. 0. 65535. DISPLAY_IDENTIFIER fm_sta_inj4_oc.Vxx_dfctr_xxx ECU_ADDRESS 0xd00052ac /end MEASUREMENT
/begin MEASUREMENT Vxx_rdn_inj4_oc "" UWORD _CNV_A_R_A_105_CM 1 0. 0. 65535. DISPLAY_IDENTIFIER fm_sta_inj4_oc.Vxx_rdn_xxx ECU_ADDRESS 0xd00052ae /end MEASUREMENT
/begin MEASUREMENT Vbx_cf_inj4_oc "" UBYTE _CNV_A_R_A_105_CM 1 0. 0. 255. DISPLAY_IDENTIFIER fm_sta_inj4_oc.fm_static_bitfield.Vbx_cf_xxx ECU_ADDRESS 0xd00052b0 BIT_MASK 0x1 /end MEASUREMENT
/begin MEASUREMENT Vbx_clf_inj4_oc "" UBYTE _CNV_A_R_A_105_CM 1 0. 0. 255. DISPLAY_IDENTIFIER fm_sta_inj4_oc.fm_static_bitfield.Vbx_clf_xxx ECU_ADDRESS 0xd00052b0 BIT_MASK 0x2 /end MEASUREMENT
/begin MEASUREMENT Vbx_df_old_inj4_oc "" UBYTE _CNV_A_R_A_105_CM 1 0. 0. 255. DISPLAY_IDENTIFIER fm_sta_inj4_oc.fm_static_bitfield.Vbx_df_old_xxx ECU_ADDRESS 0xd00052b0 BIT_MASK 0x4 /end MEASUREMENT
/begin MEASUREMENT Vbx_dfctr_sat_inj4_oc "" UBYTE _CNV_A_R_A_105_CM 1 0. 0. 255. DISPLAY_IDENTIFIER fm_sta_inj4_oc.fm_static_bitfield.Vbx_dfctr_sat_xxx ECU_ADDRESS 0xd00052b0 BIT_MASK 0x8 /end MEASUREMENT
/begin MEASUREMENT Vbx_rdn_inj4_oc "" UBYTE _CNV_A_R_A_105_CM 1 0. 0. 255. DISPLAY_IDENTIFIER fm_sta_inj4_oc.fm_static_bitfield.Vbx_rdn_xxx ECU_ADDRESS 0xd00052b0 BIT_MASK 0x40 /end MEASUREMENT
/begin MEASUREMENT Vxx_dtc_stt_inj4_oc "" UBYTE _CNV_A_R_A_105_CM 1 0. 0. 255. DISPLAY_IDENTIFIER fm_sta_inj4_oc.Vxx_dtc_stt_xxx ECU_ADDRESS 0xd00052b1 /end MEASUREMENT
/begin MEASUREMENT Vxx_dfctr_inj4_scg "" UWORD _CNV_A_R_A_105_CM 1 0. 0. 65535. DISPLAY_IDENTIFIER fm_sta_inj4_scg.Vxx_dfctr_xxx ECU_ADDRESS 0xd00052b2 /end MEASUREMENT
/begin MEASUREMENT Vxx_rdn_inj4_scg "" UWORD _CNV_A_R_A_105_CM 1 0. 0. 65535. DISPLAY_IDENTIFIER fm_sta_inj4_scg.Vxx_rdn_xxx ECU_ADDRESS 0xd00052b4 /end MEASUREMENT
/begin MEASUREMENT Vbx_cf_inj4_scg "" UBYTE _CNV_A_R_A_105_CM 1 0. 0. 255. DISPLAY_IDENTIFIER fm_sta_inj4_scg.fm_static_bitfield.Vbx_cf_xxx ECU_ADDRESS 0xd00052b6 BIT_MASK 0x1 /end MEASUREMENT
/begin MEASUREMENT Vbx_clf_inj4_scg "" UBYTE _CNV_A_R_A_105_CM 1 0. 0. 255. DISPLAY_IDENTIFIER fm_sta_inj4_scg.fm_static_bitfield.Vbx_clf_xxx ECU_ADDRESS 0xd00052b6 BIT_MASK 0x2 /end MEASUREMENT
/begin MEASUREMENT Vbx_df_old_inj4_scg "" UBYTE _CNV_A_R_A_105_CM 1 0. 0. 255. DISPLAY_IDENTIFIER fm_sta_inj4_scg.fm_static_bitfield.Vbx_df_old_xxx ECU_ADDRESS 0xd00052b6 BIT_MASK 0x4 /end MEASUREMENT
/begin MEASUREMENT Vbx_dfctr_sat_inj4_scg "" UBYTE _CNV_A_R_A_105_CM 1 0. 0. 255. DISPLAY_IDENTIFIER fm_sta_inj4_scg.fm_static_bitfield.Vbx_dfctr_sat_xxx ECU_ADDRESS 0xd00052b6 BIT_MASK 0x8 /end MEASUREMENT
/begin MEASUREMENT Vbx_rdn_inj4_scg "" UBYTE _CNV_A_R_A_105_CM 1 0. 0. 255. DISPLAY_IDENTIFIER fm_sta_inj4_scg.fm_static_bitfield.Vbx_rdn_xxx ECU_ADDRESS 0xd00052b6 BIT_MASK 0x40 /end MEASUREMENT
/begin MEASUREMENT Vxx_dtc_stt_inj4_scg "" UBYTE _CNV_A_R_A_105_CM 1 0. 0. 255. DISPLAY_IDENTIFIER fm_sta_inj4_scg.Vxx_dtc_stt_xxx ECU_ADDRESS 0xd00052b7 /end MEASUREMENT
/begin MEASUREMENT Vxx_dfctr_inj4_scw "" UWORD _CNV_A_R_A_105_CM 1 0. 0. 65535. DISPLAY_IDENTIFIER fm_sta_inj4_scw.Vxx_dfctr_xxx ECU_ADDRESS 0xd00052b8 /end MEASUREMENT
/begin MEASUREMENT Vxx_rdn_inj4_scw "" UWORD _CNV_A_R_A_105_CM 1 0. 0. 65535. DISPLAY_IDENTIFIER fm_sta_inj4_scw.Vxx_rdn_xxx ECU_ADDRESS 0xd00052ba /end MEASUREMENT
/begin MEASUREMENT Vbx_cf_inj4_scw "" UBYTE _CNV_A_R_A_105_CM 1 0. 0. 255. DISPLAY_IDENTIFIER fm_sta_inj4_scw.fm_static_bitfield.Vbx_cf_xxx ECU_ADDRESS 0xd00052bc BIT_MASK 0x1 /end MEASUREMENT
/begin MEASUREMENT Vbx_clf_inj4_scw "" UBYTE _CNV_A_R_A_105_CM 1 0. 0. 255. DISPLAY_IDENTIFIER fm_sta_inj4_scw.fm_static_bitfield.Vbx_clf_xxx ECU_ADDRESS 0xd00052bc BIT_MASK 0x2 /end MEASUREMENT
/begin MEASUREMENT Vbx_df_old_inj4_scw "" UBYTE _CNV_A_R_A_105_CM 1 0. 0. 255. DISPLAY_IDENTIFIER fm_sta_inj4_scw.fm_static_bitfield.Vbx_df_old_xxx ECU_ADDRESS 0xd00052bc BIT_MASK 0x4 /end MEASUREMENT
/begin MEASUREMENT Vbx_dfctr_sat_inj4_scw "" UBYTE _CNV_A_R_A_105_CM 1 0. 0. 255. DISPLAY_IDENTIFIER fm_sta_inj4_scw.fm_static_bitfield.Vbx_dfctr_sat_xxx ECU_ADDRESS 0xd00052bc BIT_MASK 0x8 /end MEASUREMENT
/begin MEASUREMENT Vbx_rdn_inj4_scw "" UBYTE _CNV_A_R_A_105_CM 1 0. 0. 255. DISPLAY_IDENTIFIER fm_sta_inj4_scw.fm_static_bitfield.Vbx_rdn_xxx ECU_ADDRESS 0xd00052bc BIT_MASK 0x40 /end MEASUREMENT
/begin MEASUREMENT Vxx_dtc_stt_inj4_scw "" UBYTE _CNV_A_R_A_105_CM 1 0. 0. 255. DISPLAY_IDENTIFIER fm_sta_inj4_scw.Vxx_dtc_stt_xxx ECU_ADDRESS 0xd00052bd /end MEASUREMENT
/begin MEASUREMENT Vxx_dfctr_inj_ecu_itl "" UWORD _CNV_A_R_A_105_CM 1 0. 0. 65535. DISPLAY_IDENTIFIER fm_sta_inj_ecu_itl.Vxx_dfctr_xxx ECU_ADDRESS 0xd0005540 /end MEASUREMENT
/begin MEASUREMENT Vxx_rdn_inj_ecu_itl "" UWORD _CNV_A_R_A_105_CM 1 0. 0. 65535. DISPLAY_IDENTIFIER fm_sta_inj_ecu_itl.Vxx_rdn_xxx ECU_ADDRESS 0xd0005542 /end MEASUREMENT
/begin MEASUREMENT Vbx_cf_inj_ecu_itl "" UBYTE _CNV_A_R_A_105_CM 1 0. 0. 255. DISPLAY_IDENTIFIER fm_sta_inj_ecu_itl.fm_static_bitfield.Vbx_cf_xxx ECU_ADDRESS 0xd0005544 BIT_MASK 0x1 /end MEASUREMENT
/begin MEASUREMENT Vbx_clf_inj_ecu_itl "" UBYTE _CNV_A_R_A_105_CM 1 0. 0. 255. DISPLAY_IDENTIFIER fm_sta_inj_ecu_itl.fm_static_bitfield.Vbx_clf_xxx ECU_ADDRESS 0xd0005544 BIT_MASK 0x2 /end MEASUREMENT
/begin MEASUREMENT Vbx_df_old_inj_ecu_itl "" UBYTE _CNV_A_R_A_105_CM 1 0. 0. 255. DISPLAY_IDENTIFIER fm_sta_inj_ecu_itl.fm_static_bitfield.Vbx_df_old_xxx ECU_ADDRESS 0xd0005544 BIT_MASK 0x4 /end MEASUREMENT
/begin MEASUREMENT Vbx_dfctr_sat_inj_ecu_itl "" UBYTE _CNV_A_R_A_105_CM 1 0. 0. 255. DISPLAY_IDENTIFIER fm_sta_inj_ecu_itl.fm_static_bitfield.Vbx_dfctr_sat_xxx ECU_ADDRESS 0xd0005544 BIT_MASK 0x8 /end MEASUREMENT
/begin MEASUREMENT Vbx_rdn_inj_ecu_itl "" UBYTE _CNV_A_R_A_105_CM 1 0. 0. 255. DISPLAY_IDENTIFIER fm_sta_inj_ecu_itl.fm_static_bitfield.Vbx_rdn_xxx ECU_ADDRESS 0xd0005544 BIT_MASK 0x40 /end MEASUREMENT
/begin MEASUREMENT Vxx_dtc_stt_inj_ecu_itl "" UBYTE _CNV_A_R_A_105_CM 1 0. 0. 255. DISPLAY_IDENTIFIER fm_sta_inj_ecu_itl.Vxx_dtc_stt_xxx ECU_ADDRESS 0xd0005545 /end MEASUREMENT
/begin MEASUREMENT Vxx_dfctr_inj_ecu_lbdw_icp "" UWORD _CNV_A_R_A_105_CM 1 0. 0. 65535. DISPLAY_IDENTIFIER fm_sta_inj_ecu_lbdw_icp.Vxx_dfctr_xxx ECU_ADDRESS 0xd000526a /end MEASUREMENT
/begin MEASUREMENT Vxx_rdn_inj_ecu_lbdw_icp "" UWORD _CNV_A_R_A_105_CM 1 0. 0. 65535. DISPLAY_IDENTIFIER fm_sta_inj_ecu_lbdw_icp.Vxx_rdn_xxx ECU_ADDRESS 0xd000526c /end MEASUREMENT
/begin MEASUREMENT Vbx_cf_inj_ecu_lbdw_icp "" UBYTE _CNV_A_R_A_105_CM 1 0. 0. 255. DISPLAY_IDENTIFIER fm_sta_inj_ecu_lbdw_icp.fm_static_bitfield.Vbx_cf_xxx ECU_ADDRESS 0xd000526e BIT_MASK 0x1 /end MEASUREMENT
/begin MEASUREMENT Vbx_clf_inj_ecu_lbdw_icp "" UBYTE _CNV_A_R_A_105_CM 1 0. 0. 255. DISPLAY_IDENTIFIER fm_sta_inj_ecu_lbdw_icp.fm_static_bitfield.Vbx_clf_xxx ECU_ADDRESS 0xd000526e BIT_MASK 0x2 /end MEASUREMENT
/begin MEASUREMENT Vbx_df_old_inj_ecu_lbdw_icp "" UBYTE _CNV_A_R_A_105_CM 1 0. 0. 255. DISPLAY_IDENTIFIER fm_sta_inj_ecu_lbdw_icp.fm_static_bitfield.Vbx_df_old_xxx ECU_ADDRESS 0xd000526e BIT_MASK 0x4 /end MEASUREMENT
/begin MEASUREMENT Vbx_dfctr_sat_inj_ecu_lbdw_icp "" UBYTE _CNV_A_R_A_105_CM 1 0. 0. 255. DISPLAY_IDENTIFIER fm_sta_inj_ecu_lbdw_icp.fm_static_bitfield.Vbx_dfctr_sat_xxx ECU_ADDRESS 0xd000526e BIT_MASK 0x8 /end MEASUREMENT
/begin MEASUREMENT Vbx_rdn_inj_ecu_lbdw_icp "" UBYTE _CNV_A_R_A_105_CM 1 0. 0. 255. DISPLAY_IDENTIFIER fm_sta_inj_ecu_lbdw_icp.fm_static_bitfield.Vbx_rdn_xxx ECU_ADDRESS 0xd000526e BIT_MASK 0x40 /end MEASUREMENT
/begin MEASUREMENT Vxx_dtc_stt_inj_ecu_lbdw_icp "" UBYTE _CNV_A_R_A_105_CM 1 0. 0. 255. DISPLAY_IDENTIFIER fm_sta_inj_ecu_lbdw_icp.Vxx_dtc_stt_xxx ECU_ADDRESS 0xd000526f /end MEASUREMENT
/begin MEASUREMENT Vxx_dfctr_inj_ecu_lbup_icp "" UWORD _CNV_A_R_A_105_CM 1 0. 0. 65535. DISPLAY_IDENTIFIER fm_sta_inj_ecu_lbup_icp.Vxx_dfctr_xxx ECU_ADDRESS 0xd0005270 /end MEASUREMENT
/begin MEASUREMENT Vxx_rdn_inj_ecu_lbup_icp "" UWORD _CNV_A_R_A_105_CM 1 0. 0. 65535. DISPLAY_IDENTIFIER fm_sta_inj_ecu_lbup_icp.Vxx_rdn_xxx ECU_ADDRESS 0xd0005272 /end MEASUREMENT
/begin MEASUREMENT Vbx_cf_inj_ecu_lbup_icp "" UBYTE _CNV_A_R_A_105_CM 1 0. 0. 255. DISPLAY_IDENTIFIER fm_sta_inj_ecu_lbup_icp.fm_static_bitfield.Vbx_cf_xxx ECU_ADDRESS 0xd0005274 BIT_MASK 0x1 /end MEASUREMENT
/begin COMPU_METHOD _CNV_A_R_A_105_CM "" RAT_FUNC "%6.3" "" COEFFS 0 1. 0. 0 0 1 /end COMPU_METHOD
/begin FUNCTION DgDftCfg ""
 /begin OUT_MEASUREMENT Sbx_rdn_inj3_oc Sbx_mf_inj3_oc Sbx_cf_inj3_oc Sbx_dyn_inj3_scg Sbx_rdn_inj3_scg Sbx_mf_inj3_scg Sbx_cf_inj3_scg Sbx_dyn_inj3_scw Sbx_rdn_inj3_scw Sbx_mf_inj3_scw Sbx_cf_inj3_scw Sbx_dyn_inj4_oc Sbx_rdn_inj4_oc Sbx_mf_inj4_oc Sbx_cf_inj4_oc Sbx_dyn_inj4_scg Sbx_rdn_inj4_scg Sbx_mf_inj4_scg Sbx_cf_inj4_scg Sbx_dyn_inj4_scw Sbx_rdn_inj4_scw Sbx_mf_inj4_scw Sbx_cf_inj4_scw Sbx_dyn_inj_ecu_itl Sbx_rdn_inj_ecu_itl Sbx_mf_inj_ecu_itl Sbx_cf_inj_ecu_itl Sbx_dyn_inj_ecu_lbdw_icp Sbx_rdn_inj_ecu_lbdw_icp Sbx_mf_inj_ecu_lbdw_icp Sbx_cf_inj_ecu_lbdw_icp Sbx_dyn_inj_ecu_lbup_icp Sbx_rdn_inj_ecu_lbup_icp Sbx_mf_inj_ecu_lbup_icp Sbx_cf_inj_ecu_lbup_icp Sbx_dyn_ip_lght_tco_ovh Sbx_rdn_ip_lght_tco_ovh Sbx_mf_ip_lght_tco_ovh Sbx_cf_ip_lght_tco_ovh Sbx_dyn_isr_h_lvl Sbx_rdn_isr_h_lvl Sbx_mf_isr_h_lvl Sbx_cf_isr_h_lvl Sbx_dyn_isr_l_lvl Sbx_rdn_isr_l_lvl Sbx_mf_isr_l_lvl Sbx_cf_isr_l_lvl Sbx_dyn_it_cmd_el Sbx_rdn_it_cmd_el Sbx_mf_it_cmd_el Sbx_cf_it_cmd_el Sbx_dyn_it_ofs_meca Sbx_rdn_it_ofs_meca Sbx_mf_it_ofs_meca Sbx_cf_it_ofs_meca Sbx_dyn_it_ofs_no_norm Sbx_rdn_it_ofs_no_norm Sbx_mf_it_ofs_no_norm Sbx_cf_it_ofs_no_norm Sbx_dyn_it_ofs_secu_nok Sbx_rdn_it_ofs_secu_nok Sbx_mf_it_ofs_secu_nok Sbx_cf_it_ofs_secu_nok Sbx_dyn_it_reg_blk Sbx_rdn_it_reg_blk Sbx_mf_it_reg_blk Sbx_cf_it_reg_blk Sbx_dyn_knk_oor Sbx_rdn_knk_oor Sbx_mf_knk_oor Sbx_cf_knk_oor Sbx_dyn_knk_shp Sbx_rdn_knk_shp Sbx_mf_knk_shp Sbx_cf_knk_shp Sbx_dyn_lbdw_hot_dirt_lkg Sbx_rdn_lbdw_hot_dirt_lkg Sbx_mf_lbdw_hot_dirt_lkg Sbx_cf_lbdw_hot_dirt_lkg Sbx_dyn_lbdw_hot_oc Sbx_rdn_lbdw_hot_oc Sbx_mf_lbdw_hot_oc Sbx_cf_lbdw_hot_oc Sbx_dyn_lbdw_hot_scg Sbx_rdn_lbdw_hot_scg Sbx_mf_lbdw_hot_scg Sbx_cf_lbdw_hot_scg Sbx_dyn_lbdw_hot_scw Sbx_rdn_lbdw_hot_scw Sbx_mf_lbdw_hot_scw Sbx_cf_lbdw_hot_scw Sbx_dyn_lbdw_oc Sbx_rdn_lbdw_oc Sbx_mf_lbdw_oc Sbx_cf_lbdw_oc Sbx_dyn_lbdw_scg Sbx_rdn_lbdw_scg Sbx_mf_lbdw_scg Sbx_cf_lbdw_scg Sbx_dyn_lbdw_scw Sbx_rdn_lbdw_scw Sbx_mf_lbdw_scw Sbx_cf_lbdw_scw Sbx_dyn_lbup_cpt Sbx_rdn_lbup_cpt Sbx_mf_lbup_cpt Sbx_cf_lbup_cpt Sbx_dyn_lbup_hot_apl_down Sbx_rdn_lbup_hot_apl_down Sbx_mf_lbup_hot_apl_down Sbx_cf_lbup_hot_apl_down Sbx_dyn_lbup_hot_dirt_lkg Sbx_rdn_lbup_hot_dirt_lkg Sbx_mf_lbup_hot_dirt_lkg Sbx_cf_lbup_hot_dirt_lkg Sbx_dyn_lbup_hot_oc Sbx_rdn_lbup_hot_oc Sbx_mf_lbup_hot_oc Sbx_cf_lbup_hot_oc Sbx_dyn_lbup_hot_scg Sbx_rdn_lbup_hot_scg Sbx_mf_lbup_hot_scg Sbx_cf_lbup_hot_scg Sbx_dyn_lbup_hot_scw Sbx_rdn_lbup_hot_scw Sbx_mf_lbup_hot_scw Sbx_cf_lbup_hot_scw Sbx_dyn_lbup_nok Sbx_rdn_lbup_nok Sbx_mf_lbup_nok Sbx_cf_lbup_nok Sbx_dyn_lbup_oc Sbx_rdn_lbup_oc Sbx_mf_lbup_oc Sbx_cf_lbup_oc Sbx_dyn_lbup_scg Sbx_rdn_lbup_scg Sbx_mf_lbup_scg Sbx_cf_lbup_scg Sbx_dyn_lbup_scw Sbx_rdn_lbup_scw Sbx_mf_lbup_scw Sbx_cf_lbup_scw Sbx_dyn_lbup_shf_h Sbx_rdn_lbup_shf_h Sbx_mf_lbup_shf_h Sbx_cf_lbup_shf_h Sbx_dyn_lbup_shf_l Sbx_rdn_lbup_shf_l Sbx_mf_lbup_shf_l Sbx_cf_lbup_shf_l Sbx_dyn_map_chr Sbx_rdn_map_chr Sbx_mf_map_chr Sbx_cf_map_chr Sbx_dyn_map_oor Sbx_rdn_map_oor Sbx_mf_map_oor Sbx_cf_map_oor Sbx_dyn_mis_1_cata Sbx_rdn_mis_1_cata Sbx_mf_mis_1_cata Sbx_cf_mis_1_cata Sbx_dyn_mis_1_lpg_cata Sbx_rdn_mis_1_lpg_cata Sbx_mf_mis_1_lpg_cata Sbx_cf_mis_1_lpg_cata Sbx_dyn_mis_1_lpg_trs_h Sbx_rdn_mis_1_lpg_trs_h Sbx_mf_mis_1_lpg_trs_h Sbx_cf_mis_1_lpg_trs_h Sbx_dyn_mis_1_trs_h Sbx_rdn_mis_1_trs_h Sbx_mf_mis_1_trs_h Sbx_cf_mis_1_trs_h Sbx_dyn_mis_2_cata Sbx_rdn_mis_2_cata Sbx_mf_mis_2_cata Sbx_cf_mis_2_cata Sbx_dyn_mis_2_lpg_cata Sbx_rdn_mis_2_lpg_cata Sbx_mf_mis_2_lpg_cata Sbx_cf_mis_2_lpg_cata Sbx_dyn_mis_2_lpg_trs_h Sbx_rdn_mis_2_lpg_trs_h Sbx_mf_mis_2_lpg_trs_h Sbx_cf_mis_2_lpg_trs_h Sbx_dyn_mis_2_trs_h Sbx_rdn_mis_2_trs_h Sbx_mf_mis_2_trs_h Sbx_cf_mis_2_trs_h Sbx_dyn_mis_3_cata Sbx_rdn_mis_3_cata Sbx_mf_mis_3_cata Sbx_cf_mis_3_cata Sbx_dyn_mis_3_lpg_cata Sbx_rdn_mis_3_lpg_cata Sbx_mf_mis_3_lpg_cata Sbx_cf_mis_3_lpg_cata Sbx_dyn_mis_3_lpg_trs_h Sbx_rdn_mis_3_lpg_trs_h Sbx_mf_mis_3_lpg_trs_h Sbx_cf_mis_3_lpg_trs_h Sbx_dyn_mis_3_trs_h Sbx_rdn_mis_3_trs_h Sbx_mf_mis_3_trs_h Sbx_cf_mis_3_trs_h Sbx_dyn_mis_4_cata Sbx_rdn_mis_4_cata Sbx_mf_mis_4_cata Sbx_cf_mis_4_cata Sbx_dyn_mis_4_lpg_cata Sbx_rdn_mis_4_lpg_cata Sbx_mf_mis_4_lpg_cata Sbx_cf_mis_4_lpg_cata Sbx_dyn_mis_4_lpg_trs_h Sbx_rdn_mis_4_lpg_trs_h Sbx_mf_mis_4_lpg_trs_h Sbx_cf_mis_4_lpg_trs_h Sbx_dyn_mis_4_trs_h Sbx_rdn_mis_4_trs_h Sbx_mf_mis_4_trs_h Sbx_cf_mis_4_trs_h Sbx_dyn_mis_cata Sbx_rdn_mis_cata Sbx_mf_mis_cata Sbx_cf_mis_cata Sbx_dyn_mis_lpg_cata Sbx_rdn_mis_lpg_cata Sbx_mf_mis_lpg_cata Sbx_cf_mis_lpg_cata Sbx_dyn_mis_lpg_trs_h Sbx_rdn_mis_lpg_trs_h Sbx_mf_mis_lpg_trs_h Sbx_cf_mis_lpg_trs_h Sbx_dyn_mis_min_fuel_cata Sbx_rdn_mis_min_fuel_cata Sbx_mf_mis_min_fuel_cata Sbx_cf_mis_min_fuel_cata Sbx_dyn_mis_min_fuel_trs_h Sbx_rdn_mis_min_fuel_trs_h Sbx_mf_mis_min_fuel_trs_h Sbx_cf_mis_min_fuel_trs_h Sbx_dyn_mis_trs_h Sbx_rdn_mis_trs_h Sbx_mf_mis_trs_h Sbx_cf_mis_trs_h Sbx_dyn_mis_unk_cata Sbx_rdn_mis_unk_cata Sbx_mf_mis_unk_cata Sbx_cf_mis_unk_cata Sbx_dyn_mis_unk_lpg_cata Sbx_rdn_mis_unk_lpg_cata Sbx_mf_mis_unk_lpg_cata Sbx_cf_mis_unk_lpg_cata Sbx_dyn_mis_unk_lpg_trs_h Sbx_rdn_mis_unk_lpg_trs_h Sbx_mf_mis_unk_lpg_trs_h Sbx_cf_mis_unk_lpg_trs_h Sbx_dyn_mis_unk_trs_h Sbx_rdn_mis_unk_trs_h Sbx_mf_mis_unk_trs_h Sbx_cf_mis_unk_trs_h Sbx_dyn_ptc_rov_oc Sbx_rdn_ptc_rov_oc Sbx_mf_ptc_rov_oc Sbx_cf_ptc_rov_oc Sbx_dyn_ptc_rov_scg Sbx_rdn_ptc_rov_scg Sbx_mf_ptc_rov_scg Sbx_cf_ptc_rov_scg Sbx_dyn_ptc_rov_scw Sbx_rdn_ptc_rov_scw Sbx_mf_ptc_rov_scw Sbx_cf_ptc_rov_scw Sbx_dyn_pws_1_h Sbx_rdn_pws_1_h Sbx_mf_pws_1_h Sbx_cf_pws_1_h Sbx_dyn_pws_1_l Sbx_rdn_pws_1_l Sbx_mf_pws_1_l Sbx_cf_pws_1_l Sbx_dyn_pws_2_h Sbx_rdn_pws_2_h Sbx_mf_pws_2_h Sbx_cf_pws_2_h Sbx_dyn_pws_2_l Sbx_rdn_pws_2_l Sbx_mf_pws_2_l Sbx_cf_pws_2_l Sbx_dyn_pws_3_h Sbx_rdn_pws_3_h Sbx_mf_pws_3_h Sbx_cf_pws_3_h Sbx_dyn_pws_3_l Sbx_rdn_pws_3_l Sbx_mf_pws_3_l Sbx_cf_pws_3_l Sbx_dyn_sens_it_1_nok Sbx_rdn_sens_it_1_nok Sbx_mf_sens_it_1_nok Sbx_cf_sens_it_1_nok Sbx_dyn_sens_it_2_nok Sbx_rdn_sens_it_2_nok Sbx_mf_sens_it_2_nok Sbx_cf_sens_it_2_nok Sbx_dyn_sens_it_chr Sbx_rdn_sens_it_chr Sbx_mf_sens_it_chr Sbx_cf_sens_it_chr Sbx_dyn_sens_it_sig_mcut Sbx_rdn_sens_it_sig_mcut Sbx_mf_sens_it_sig_mcut Sbx_cf_sens_it_sig_mcut Sbx_dyn_sens_map_h Sbx_rdn_sens_map_h Sbx_mf_sens_map_h Sbx_cf_sens_map_h Sbx_dyn_sens_map_l Sbx_rdn_sens_map_l Sbx_mf_sens_map_l Sbx_cf_sens_map_l Sbx_dyn_sens_mat_h Sbx_rdn_sens_mat_h Sbx_mf_sens_mat_h Sbx_cf_sens_mat_h Sbx_dyn_sens_mat_l Sbx_rdn_sens_mat_l Sbx_mf_sens_mat_l Sbx_cf_sens_mat_l Sbx_dyn_sens_rvc_h Sbx_rdn_sens_rvc_h Sbx_mf_sens_rvc_h Sbx_cf_sens_rvc_h Sbx_dyn_sens_rvc_l Sbx_rdn_sens_rvc_l Sbx_mf_sens_rvc_l Sbx_cf_sens_rvc_l Sbx_dyn_sens_rvc_nok Sbx_rdn_sens_rvc_nok Sbx_mf_sens_rvc_nok Sbx_cf_sens_rvc_nok Sbx_dyn_sens_rvc_sig_mcut Sbx_rdn_sens_rvc_sig_mcut Sbx_mf_sens_rvc_sig_mcut Sbx_cf_sens_rvc_sig_mcut Sbx_dyn_sens_spg_h Sbx_rdn_sens_spg_h Sbx_mf_sens_spg_h Sbx_cf_sens_spg_h Sbx_dyn_sens_spg_l Sbx_rdn_sens_spg_l Sbx_mf_sens_spg_l Sbx_cf_sens_spg_l Sbx_dyn_sens_tco_h Sbx_rdn_sens_tco_h Sbx_mf_sens_tco_h Sbx_cf_sens_tco_h Sbx_dyn_sens_tco_l Sbx_rdn_sens_tco_l Sbx_mf_sens_tco_l Sbx_cf_sens_tco_l Sbx_dyn_sens_tco_sig_mcut Sbx_rdn_sens_tco_sig_mcut Sbx_mf_sens_tco_sig_mcut Sbx_cf_sens_tco_sig_mcut Sbx_dyn_sfty_tq_chr Sbx_rdn_sfty_tq_chr Sbx_mf_sfty_tq_chr Sbx_cf_sfty_tq_chr Sbx_dyn_sfty_tq_clc_chr Sbx_rdn_sfty_tq_clc_chr Sbx_mf_sfty_tq_clc_chr Sbx_cf_sfty_tq_clc_chr Sbx_dyn_sfty_tq_lih_chr Sbx_rdn_sfty_tq_lih_chr Sbx_mf_sfty_tq_lih_chr Sbx_cf_sfty_tq_lih_chr Sbx_dyn_spg_oor Sbx_rdn_spg_oor Sbx_mf_spg_oor Sbx_cf_spg_oor Sbx_dyn_spg_reg_apl_down Sbx_rdn_spg_reg_apl_down Sbx_mf_spg_reg_apl_down Sbx_cf_spg_reg_apl_down Sbx_dyn_spg_reg_apl_up Sbx_rdn_spg_reg_apl_up Sbx_mf_spg_reg_apl_up Sbx_cf_spg_reg_apl_up Sbx_dyn_tco_cl_no_norm Sbx_rdn_tco_cl_no_norm Sbx_mf_tco_cl_no_norm Sbx_cf_tco_cl_no_norm Sbx_dyn_tlz_ad_b_cpt Sbx_rdn_tlz_ad_b_cpt Sbx_mf_tlz_ad_b_cpt Sbx_cf_tlz_ad_b_cpt Sbx_dyn_tsta_reg_no_norm Sbx_rdn_tsta_reg_no_norm Sbx_mf_tsta_reg_no_norm Sbx_cf_tsta_reg_no_norm Sbx_dyn_vb_clc_chr Sbx_rdn_vb_clc_chr Sbx_mf_vb_clc_chr Sbx_cf_vb_clc_chr Sbx_dyn_vb_h Sbx_rdn_vb_h Sbx_mf_vb_h Sbx_cf_vb_h Sbx_dyn_vb_l Sbx_rdn_vb_l Sbx_mf_vb_l Sbx_cf_vb_l Sbx_dyn_vb_rly_oc_scg Sbx_rdn_vb_rly_oc_scg Sbx_mf_vb_rly_oc_scg Sbx_cf_vb_rly_oc_scg Sbx_dyn_vb_rly_scw Sbx_rdn_vb_rly_scw Sbx_mf_vb_rly_scw Sbx_cf_vb_rly_scw Sbx_dyn_wgc_oc Sbx_rdn_wgc_oc Sbx_mf_wgc_oc Sbx_cf_wgc_oc Sbx_dyn_wgc_scg Sbx_rdn_wgc_scg Sbx_mf_wgc_scg Sbx_cf_wgc_scg Sbx_dyn_wgc_scw Sbx_rdn_wgc_scw Sbx_mf_wgc_scw Sbx_cf_wgc_scw Sbx_dyn_wpmp_tcr_blk Sbx_rdn_wpmp_tcr_blk Sbx_mf_wpmp_tcr_blk Sbx_cf_wpmp_tcr_blk Sbx_dyn_wpmp_tcr_oc Sbx_rdn_wpmp_tcr_oc Sbx_mf_wpmp_tcr_oc Sbx_cf_wpmp_tcr_oc Sbx_dyn_wpmp_tcr_scg Sbx_rdn_wpmp_tcr_scg Sbx_mf_wpmp_tcr_scg Sbx_cf_wpmp_tcr_scg Sbx_dyn_wpmp_tcr_scw Sbx_rdn_wpmp_tcr_scw Sbx_mf_wpmp_tcr_scw Sbx_cf_wpmp_tcr_scw Vxx_dfctr_esp_data_chr Vxx_rdn_esp_data_chr Vbx_cf_esp_data_chr Vbx_clf_esp_data_chr Vbx_df_old_esp_data_chr Vbx_dfctr_sat_esp_data_chr Vbx_rdn_esp_data_chr Vxx_dtc_stt_esp_data_chr Vxx_dfctr_esp_data_seq_ctr Vxx_rdn_esp_data_seq_ctr Vbx_cf_esp_data_seq_ctr Vbx_clf_esp_data_seq_ctr Vbx_df_old_esp_data_seq_ctr Vbx_dfctr_sat_esp_data_seq_ctr Vbx_rdn_esp_data_seq_ctr Vxx_dtc_stt_esp_data_seq_ctr Vxx_dfctr_esp_no_frm Vxx_rdn_esp_no_frm Vbx_cf_esp_no_frm Vbx_clf_esp_no_frm Vbx_df_old_esp_no_frm Vbx_dfctr_sat_esp_no_frm Vbx_rdn_esp_no_frm Vxx_dtc_stt_esp_no_frm Vxx_dfctr_eva_fcap_abn_cple Vxx_rdn_eva_fcap_abn_cple Vbx_cf_eva_fcap_abn_cple Vbx_clf_eva_fcap_abn_cple Vbx_df_old_eva_fcap_abn_cple Vbx_dfctr_sat_eva_fcap_abn_cple Vbx_rdn_eva_fcap_abn_cple Vxx_dtc_stt_eva_fcap_abn_cple Vxx_dfctr_eva_fcap_no_lk Vxx_rdn_eva_fcap_no_lk Vbx_cf_eva_fcap_no_lk Vbx_clf_eva_fcap_no_lk Vbx_df_old_eva_fcap_no_lk Vbx_dfctr_sat_eva_fcap_no_lk Vbx_rdn_eva_fcap_no_lk Vxx_dtc_stt_eva_fcap_no_lk Vxx_dfctr_eva_sldv_blk_clos Vxx_rdn_eva_sldv_blk_clos Vbx_cf_eva_sldv_blk_clos Vbx_clf_eva_sldv_blk_clos Vbx_df_old_eva_sldv_blk_clos Vbx_dfctr_sat_eva_sldv_blk_clos Vbx_rdn_eva_sldv_blk_clos Vxx_dtc_stt_eva_sldv_blk_clos Vxx_dfctr_eva_sldv_oc Vxx_rdn_eva_sldv_oc Vbx_cf_eva_sldv_oc Vbx_clf_eva_sldv_oc Vbx_df_old_eva_sldv_oc Vbx_dfctr_sat_eva_sldv_oc Vbx_rdn_eva_sldv_oc Vxx_dtc_stt_eva_sldv_oc Vxx_dfctr_eva_sldv_scg Vxx_rdn_eva_sldv_scg Vbx_cf_eva_sldv_scg Vbx_clf_eva_sldv_scg Vbx_df_old_eva_sldv_scg Vbx_dfctr_sat_eva_sldv_scg Vbx_rdn_eva_sldv_scg Vxx_dtc_stt_eva_sldv_scg Vxx_dfctr_eva_sldv_scw Vxx_rdn_eva_sldv_scw Vbx_cf_eva_sldv_scw Vbx_clf_eva_sldv_scw Vbx_df_old_eva_sldv_scw Vbx_dfctr_sat_eva_sldv_scw Vbx_rdn_eva_sldv_scw Vxx_dtc_stt_eva_sldv_scw Vxx_dfctr_evap_chr Vxx_rdn_evap_chr Vbx_cf_evap_chr Vbx_clf_evap_chr Vbx_df_old_evap_chr Vbx_dfctr_sat_evap_chr Vbx_rdn_evap_chr Vxx_dtc_stt_evap_chr Vxx_dfctr_evap_lkg Vxx_rdn_evap_lkg Vbx_cf_evap_lkg Vbx_clf_evap_lkg Vbx_df_old_evap_lkg Vbx_dfctr_sat_evap_lkg Vbx_rdn_evap_lkg Vxx_dtc_stt_evap_lkg Vxx_dfctr_fsys_cpt Vxx_rdn_fsys_cpt Vbx_cf_fsys_cpt Vbx_clf_fsys_cpt Vbx_df_old_fsys_cpt Vbx_dfctr_sat_fsys_cpt Vbx_rdn_fsys_cpt Vxx_dtc_stt_fsys_cpt Vxx_dfctr_gas_pump_2_oc Vxx_rdn_gas_pump_2_oc Vbx_cf_gas_pump_2_oc Vbx_clf_gas_pump_2_oc Vbx_df_old_gas_pump_2_oc Vbx_dfctr_sat_gas_pump_2_oc Vbx_rdn_gas_pump_2_oc Vxx_dtc_stt_gas_pump_2_oc Vxx_dfctr_gas_pump_2_scg Vxx_rdn_gas_pump_2_scg Vbx_cf_gas_pump_2_scg Vbx_clf_gas_pump_2_scg Vbx_df_old_gas_pump_2_scg Vbx_dfctr_sat_gas_pump_2_scg Vbx_rdn_gas_pump_2_scg Vxx_dtc_stt_gas_pump_2_scg Vxx_dfctr_gas_pump_2_scw Vxx_rdn_gas_pump_2_scw Vbx_cf_gas_pump_2_scw Vbx_clf_gas_pump_2_scw Vbx_df_old_gas_pump_2_scw Vbx_dfctr_sat_gas_pump_2_scw Vbx_rdn_gas_pump_2_scw Vxx_dtc_stt_gas_pump_2_scw Vxx_dfctr_gas_pump_oc Vxx_rdn_gas_pump_oc Vbx_cf_gas_pump_oc Vbx_clf_gas_pump_oc Vbx_df_old_gas_pump_oc Vbx_dfctr_sat_gas_pump_oc Vbx_rdn_gas_pump_oc Vxx_dtc_stt_gas_pump_oc Vxx_dfctr_gas_pump_scg Vxx_rdn_gas_pump_scg Vbx_cf_gas_pump_scg Vbx_clf_gas_pump_scg Vbx_df_old_gas_pump_scg Vbx_dfctr_sat_gas_pump_scg Vbx_rdn_gas_pump_scg Vxx_dtc_stt_gas_pump_scg Vxx_dfctr_gas_pump_scw Vxx_rdn_gas_pump_scw Vbx_cf_gas_pump_scw Vbx_clf_gas_pump_scw Vbx_df_old_gas_pump_scw Vbx_dfctr_sat_gas_pump_scw Vbx_rdn_gas_pump_scw Vxx_dtc_stt_gas_pump_scw Vxx_dfctr_igc_1_oc Vxx_rdn_igc_1_oc Vbx_cf_igc_1_oc Vbx_clf_igc_1_oc Vbx_df_old_igc_1_oc Vbx_dfctr_sat_igc_1_oc Vbx_rdn_igc_1_oc Vxx_dtc_stt_igc_1_oc Vxx_dfctr_igc_1_scg Vxx_rdn_igc_1_scg Vbx_cf_igc_1_scg Vbx_clf_igc_1_scg Vbx_df_old_igc_1_scg Vbx_dfctr_sat_igc_1_scg Vbx_rdn_igc_1_scg Vxx_dtc_stt_igc_1_scg Vxx_dfctr_igc_1_scw Vxx_rdn_igc_1_scw Vbx_cf_igc_1_scw Vbx_clf_igc_1_scw Vbx_df_old_igc_1_scw Vbx_dfctr_sat_igc_1_scw Vbx_rdn_igc_1_scw Vxx_dtc_stt_igc_1_scw Vxx_dfctr_igc_2_oc Vxx_rdn_igc_2_oc Vbx_cf_igc_2_oc Vbx_clf_igc_2_oc Vbx_df_old_igc_2_oc Vbx_dfctr_sat_igc_2_oc Vbx_rdn_igc_2_oc Vxx_dtc_stt_igc_2_oc Vxx_dfctr_igc_2_scg Vxx_rdn_igc_2_scg Vbx_cf_igc_2_scg Vbx_clf_igc_2_scg Vbx_df_old_igc_2_scg Vbx_dfctr_sat_igc_2_scg Vbx_rdn_igc_2_scg Vxx_dtc_stt_igc_2_scg Vxx_dfctr_igc_2_scw Vxx_rdn_igc_2_scw Vbx_cf_igc_2_scw Vbx_clf_igc_2_scw Vbx_df_old_igc_2_scw Vbx_dfctr_sat_igc_2_scw Vbx_rdn_igc_2_scw Vxx_dtc_stt_igc_2_scw Vxx_dfctr_igc_3_oc Vxx_rdn_igc_3_oc Vbx_cf_igc_3_oc Vbx_clf_igc_3_oc Vbx_df_old_igc_3_oc Vbx_dfctr_sat_igc_3_oc Vbx_rdn_igc_3_oc Vxx_dtc_stt_igc_3_oc Vxx_dfctr_igc_3_scg Vxx_rdn_igc_3_scg Vbx_cf_igc_3_scg Vbx_clf_igc_3_scg Vbx_df_old_igc_3_scg Vbx_dfctr_sat_igc_3_scg Vbx_rdn_igc_3_scg Vxx_dtc_stt_igc_3_scg Vxx_dfctr_igc_3_scw Vxx_rdn_igc_3_scw Vbx_cf_igc_3_scw Vbx_clf_igc_3_scw Vbx_df_old_igc_3_scw Vbx_dfctr_sat_igc_3_scw Vbx_rdn_igc_3_scw Vxx_dtc_stt_igc_3_scw Vxx_dfctr_igc_4_oc Vxx_rdn_igc_4_oc Vbx_cf_igc_4_oc Vbx_clf_igc_4_oc Vbx_df_old_igc_4_oc Vbx_dfctr_sat_igc_4_oc Vbx_rdn_igc_4_oc Vxx_dtc_stt_igc_4_oc Vxx_dfctr_igc_4_scg Vxx_rdn_igc_4_scg Vbx_cf_igc_4_scg Vbx_clf_igc_4_scg Vbx_df_old_igc_4_scg Vbx_dfctr_sat_igc_4_scg Vbx_rdn_igc_4_scg Vxx_dtc_stt_igc_4_scg Vxx_dfctr_igc_4_scw Vxx_rdn_igc_4_scw Vbx_cf_igc_4_scw Vbx_clf_igc_4_scw Vbx_df_old_igc_4_scw Vbx_dfctr_sat_igc_4_scw Vbx_rdn_igc_4_scw Vxx_dtc_stt_igc_4_scw Vxx_dfctr_in_cam_chr Vxx_rdn_in_cam_chr Vbx_cf_in_cam_chr Vbx_clf_in_cam_chr Vbx_df_old_in_cam_chr Vbx_dfctr_sat_in_cam_chr Vbx_rdn_in_cam_chr Vxx_dtc_stt_in_cam_chr Vxx_dfctr_in_cam_crk_cmp Vxx_rdn_in_cam_crk_cmp Vbx_cf_in_cam_crk_cmp Vbx_clf_in_cam_crk_cmp Vbx_df_old_in_cam_crk_cmp Vbx_dfctr_sat_in_cam_crk_cmp Vbx_rdn_in_cam_crk_cmp Vxx_dtc_stt_in_cam_crk_cmp Vxx_dfctr_in_cam_cyc Vxx_rdn_in_cam_cyc Vbx_cf_in_cam_cyc Vbx_clf_in_cam_cyc Vbx_df_old_in_cam_cyc Vbx_dfctr_sat_in_cam_cyc Vbx_rdn_in_cam_cyc Vxx_dtc_stt_in_cam_cyc Vxx_dfctr_in_cam_no_sig Vxx_rdn_in_cam_no_sig Vbx_cf_in_cam_no_sig Vbx_clf_in_cam_no_sig Vbx_df_old_in_cam_no_sig Vbx_dfctr_sat_in_cam_no_sig Vbx_rdn_in_cam_no_sig Vxx_dtc_stt_in_cam_no_sig Vxx_dfctr_in_cam_nok Vxx_rdn_in_cam_nok Vbx_cf_in_cam_nok Vbx_clf_in_cam_nok Vbx_df_old_in_cam_nok Vbx_dfctr_sat_in_cam_nok Vbx_rdn_in_cam_nok Vxx_dtc_stt_in_cam_nok Vxx_dfctr_in_vvtc_ad Vxx_rdn_in_vvtc_ad Vbx_cf_in_vvtc_ad Vbx_clf_in_vvtc_ad Vbx_df_old_in_vvtc_ad Vbx_dfctr_sat_in_vvtc_ad Vbx_rdn_in_vvtc_ad Vxx_dtc_stt_in_vvtc_ad Vxx_dfctr_in_vvtc_blk Vxx_rdn_in_vvtc_blk Vbx_cf_in_vvtc_blk Vbx_clf_in_vvtc_blk Vbx_df_old_in_vvtc_blk Vbx_dfctr_sat_in_vvtc_blk Vbx_rdn_in_vvtc_blk Vxx_dtc_stt_in_vvtc_blk Vxx_dfctr_in_vvtc_dirt_lkg Vxx_rdn_in_vvtc_dirt_lkg Vbx_cf_in_vvtc_dirt_lkg Vbx_clf_in_vvtc_dirt_lkg Vbx_df_old_in_vvtc_dirt_lkg Vbx_dfctr_sat_in_vvtc_dirt_lkg Vbx_rdn_in_vvtc_dirt_lkg Vxx_dtc_stt_in_vvtc_dirt_lkg Vxx_dfctr_in_vvtc_sldv_oc Vxx_rdn_in_vvtc_sldv_oc Vbx_cf_in_vvtc_sldv_oc Vbx_clf_in_vvtc_sldv_oc Vbx_df_old_in_vvtc_sldv_oc Vbx_dfctr_sat_in_vvtc_sldv_oc Vbx_rdn_in_vvtc_sldv_oc Vxx_dtc_stt_in_vvtc_sldv_oc Vxx_dfctr_in_vvtc_sldv_scg Vxx_rdn_in_vvtc_sldv_scg Vbx_cf_in_vvtc_sldv_scg Vbx_clf_in_vvtc_sldv_scg Vbx_df_old_in_vvtc_sldv_scg Vbx_dfctr_sat_in_vvtc_sldv_scg Vbx_rdn_in_vvtc_sldv_scg Vxx_dtc_stt_in_vvtc_sldv_scg Vxx_dfctr_in_vvtc_sldv_scw Vxx_rdn_in_vvtc_sldv_scw Vbx_cf_in_vvtc_sldv_scw Vbx_clf_in_vvtc_sldv_scw Vbx_df_old_in_vvtc_sldv_scw Vbx_dfctr_sat_in_vvtc_sldv_scw Vbx_rdn_in_vvtc_sldv_scw Vxx_dtc_stt_in_vvtc_sldv_scw Vxx_dfctr_inj1_oc Vxx_rdn_inj1_oc Vbx_cf_inj1_oc Vbx_clf_inj1_oc Vbx_df_old_inj1_oc Vbx_dfctr_sat_inj1_oc Vbx_rdn_inj1_oc Vxx_dtc_stt_inj1_oc Vxx_dfctr_inj1_scg Vxx_rdn_inj1_scg Vbx_cf_inj1_scg Vbx_clf_inj1_scg Vbx_df_old_inj1_scg Vbx_dfctr_sat_inj1_scg Vbx_rdn_inj1_scg Vxx_dtc_stt_inj1_scg Vxx_dfctr_inj1_scw Vxx_rdn_inj1_scw Vbx_cf_inj1_scw Vbx_clf_inj1_scw Vbx_df_old_inj1_scw Vbx_dfctr_sat_inj1_scw Vbx_rdn_inj1_scw Vxx_dtc_stt_inj1_scw Vxx_dfctr_inj2_oc Vxx_rdn_inj2_oc Vbx_cf_inj2_oc Vbx_clf_inj2_oc Vbx_df_old_inj2_oc Vbx_dfctr_sat_inj2_oc Vbx_rdn_inj2_oc Vxx_dtc_stt_inj2_oc Vxx_dfctr_inj2_scg Vxx_rdn_inj2_scg Vbx_cf_inj2_scg Vbx_clf_inj2_scg Vbx_df_old_inj2_scg Vbx_dfctr_sat_inj2_scg Vbx_rdn_inj2_scg Vxx_dtc_stt_inj2_scg Vxx_dfctr_inj2_scw Vxx_rdn_inj2_scw Vbx_cf_inj2_scw Vbx_clf_inj2_scw Vbx_df_old_inj2_scw Vbx_dfctr_sat_inj2_scw Vbx_rdn_inj2_scw Vxx_dtc_stt_inj2_scw Vxx_dfctr_inj3_oc Vxx_rdn_inj3_oc Vbx_cf_inj3_oc Vbx_clf_inj3_oc Vbx_df_old_inj3_oc Vbx_dfctr_sat_inj3_oc Vbx_rdn_inj3_oc Vxx_dtc_stt_inj3_oc Vxx_dfctr_inj3_scg Vxx_rdn_inj3_scg Vbx_cf_inj3_scg Vbx_clf_inj3_scg Vbx_df_old_inj3_scg Vbx_dfctr_sat_inj3_scg Vbx_rdn_inj3_scg Vxx_dtc_stt_inj3_scg Vxx_dfctr_inj3_scw Vxx_rdn_inj3_scw Vbx_cf_inj3_scw Vbx_clf_inj3_scw Vbx_df_old_inj3_scw Vbx_dfctr_sat_inj3_scw Vbx_rdn_inj3_scw Vxx_dtc_stt_inj3_scw Vxx_dfctr_inj4_oc Vxx_rdn_inj4_oc Vbx_cf_inj4_oc Vbx_clf_inj4_oc Vbx_df_old_inj4_oc Vbx_dfctr_sat_inj4_oc Vbx_rdn_inj4_oc Vxx_dtc_stt_inj4_oc Vxx_dfctr_inj4_scg Vxx_rdn_inj4_scg Vbx_cf_inj4_scg Vbx_clf_inj4_scg Vbx_df_old_inj4_scg Vbx_dfctr_sat_inj4_scg Vbx_rdn_inj4_scg Vxx_dtc_stt_inj4_scg Vxx_dfctr_inj4_scw Vxx_rdn_inj4_scw Vbx_cf_inj4_scw Vbx_clf_inj4_scw Vbx_df_old_inj4_scw Vbx_dfctr_sat_inj4_scw Vbx_rdn_inj4_scw Vxx_dtc_stt_inj4_scw Vxx_dfctr_inj_ecu_itl Vxx_rdn_inj_ecu_itl Vbx_cf_inj_ecu_itl Vbx_clf_inj_ecu_itl Vbx_df_old_inj_ecu_itl Vbx_dfctr_sat_inj_ecu_itl Vbx_rdn_inj_ecu_itl Vxx_dtc_stt_inj_ecu_itl Vxx_dfctr_inj_ecu_lbdw_icp Vxx_rdn_inj_ecu_lbdw_icp Vbx_cf_inj_ecu_lbdw_icp Vbx_clf_inj_ecu_lbdw_icp Vbx_df_old_inj_ecu_lbdw_icp Vbx_dfctr_sat_inj_ecu_lbdw_icp Vbx_rdn_inj_ecu_lbdw_icp Vxx_dtc_stt_inj_ecu_lbdw_icp Vxx_dfctr_inj_ecu_lbup_icp Vxx_rdn_inj_ecu_lbup_icp Vbx_cf_inj_ecu_lbup_icp /end OUT_MEASUREMENT
/end FUNCTION
/end MODULE
/end PROJECT
