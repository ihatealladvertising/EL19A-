ASAP2_VERSION 1 41
/begin PROJECT RD8 "_default_ProjectLongIdentifier"
/begin HEADER "_default_HeaderComment" PROJECT_NO RD9 /end HEADER
/begin MODULE _default_ModuleName "_default_ModuleLongIdentifier"
/begin MOD_COMMON "_default_ModCommonComment" DEPOSIT ABSOLUTE BYTE_ORDER MSB_LAST ALIGNMENT_BYTE 1 ALIGNMENT_WORD 2 ALIGNMENT_LONG 2 ALIGNMENT_FLOAT32_IEEE 2 ALIGNMENT_FLOAT64_IEEE 4 /end MOD_COMMON
/begin AXIS_PTS Ctb_tco2 "Engine coolant temperature breakpoints" 0xa002d4d0 Vxx_tco _REC_A2AXS_20_u2 240. _CNV_A_R_LINEAR_____110_CM 9 -40. 200. FORMAT "%5.1" /end AXIS_PTS
/begin MEASUREMENT Vbx_df_in_vvtc_sldv_oc "VVTC control solenoïd valve open circuit detected failure" UBYTE _CNV_S_2_RANGE______3_CM 1 0. 0. 1. ECU_ADDRESS 0xd0006520 BIT_MASK 0x1 /end MEASUREMENT
/begin MEASUREMENT Vbx_df_in_vvtc_sldv_scg "VVTC control solenoïd valve short circuit to ground detected failure" UBYTE _CNV_S_2_RANGE______3_CM 1 0. 0. 1. ECU_ADDRESS 0xd0006521 BIT_MASK 0x1 /end MEASUREMENT
/begin MEASUREMENT Vbx_df_in_vvtc_sldv_scw "VVTC control solenoïd valve short circuit to battery detected failure" UBYTE _CNV_S_2_RANGE______3_CM 1 0. 0. 1. ECU_ADDRESS 0xd0006522 BIT_MASK 0x1 /end MEASUREMENT
/begin MEASUREMENT Vbx_diag_ena_in_vvtc_sldv_oc "VVTC control solenoïd valve open circuit diagnostic information available" UBYTE _CNV_S_2_RANGE______3_CM 1 0. 0. 1. ECU_ADDRESS 0xd0006523 BIT_MASK 0x1 /end MEASUREMENT
/begin MEASUREMENT Vbx_diag_ena_in_vvtc_sldv_scg "VVTC control solenoïd valve short circuit to ground diagnosis information available" UBYTE _CNV_S_2_RANGE______3_CM 1 0. 0. 1. ECU_ADDRESS 0xd0006524 BIT_MASK 0x1 /end MEASUREMENT
/begin MEASUREMENT Vbx_diag_ena_in_vvtc_sldv_scw "VVTC control solenoïd valve short circuit to battery diagnostic information available" UBYTE _CNV_S_2_RANGE______3_CM 1 0. 0. 1. ECU_ADDRESS 0xd0006525 BIT_MASK 0x1 /end MEASUREMENT
/begin MEASUREMENT cdn_diag_slv_ivvt_ex[0] "" UBYTE _CNV_A_R_ECME_LINEA_0_CM 1 0. 0. 7. ECU_ADDRESS 0xd000651d FORMAT "%1.0" /end MEASUREMENT
/begin MEASUREMENT cdn_diag_slv_ivvt_in[0] "" UBYTE _CNV_A_R_ECME_LINEA_0_CM 1 0. 0. 7. ECU_ADDRESS 0xd000651c FORMAT "%1.0" /end MEASUREMENT
/begin MEASUREMENT ctr_pulse_ivvt_dly "Time counter for pulse at key ON" UBYTE _CNV_A_R_LINEAR_____201_CM 1 0. 0. 255. ECU_ADDRESS 0xd000773f FORMAT "%3.0" /end MEASUREMENT
/begin MEASUREMENT err_diag_slv_ivvt_ex[0] "" UBYTE _CNV_S_16_RANGE_ERR__206_CM 1 0. 0. 15. ECU_ADDRESS 0xd000651f /end MEASUREMENT
/begin MEASUREMENT err_diag_slv_ivvt_in[0] "" UBYTE _CNV_S_16_RANGE_ERR__206_CM 1 0. 0. 15. ECU_ADDRESS 0xd000651e /end MEASUREMENT
/begin MEASUREMENT frq_ivvthpwm "Frequency of holding pulse with modulation; both inlet and exhaust" UWORD _CNV_A_R_LINEAR_____290_CM 1 0. 50. 500. ECU_ADDRESS 0xd0003f0c FORMAT "%3.0" /end MEASUREMENT
/begin MEASUREMENT lv_cam_sp_ref_ad_di_ivvt "1= reference position adaptation if setpoint in ref pos disabled, 0=not disabled" UBYTE _CNV_S_2_RANGE______3_CM 1 0. 0. 1. ECU_ADDRESS 0xd0006527 BIT_MASK 0x1 /end MEASUREMENT
/begin MEASUREMENT lv_di_ad_ref_cam_ivvt_in "Adaptation of inlet camshaft reference position : 0=enabled, 1=disabled" UBYTE _CNV_S_2_RANGE______3_CM 1 0. 0. 1. ECU_ADDRESS 0xd0006528 BIT_MASK 0x1 /end MEASUREMENT
/begin MEASUREMENT lv_pulse_ivvt "Flag to indicate that pulse at key on was done" UBYTE _CNV_S_2_RANGE______3_CM 1 0. 0. 1. ECU_ADDRESS 0xd0006526 BIT_MASK 0x1 /end MEASUREMENT
/begin MEASUREMENT lv_pulse_ivvt_tmp "Flag to indicate that pulse is working" UBYTE _CNV_S_2_RANGE______3_CM 1 0. 0. 1. ECU_ADDRESS 0xd0007741 BIT_MASK 0x1 /end MEASUREMENT
/begin MEASUREMENT vvtpwm "Flag to request an engine phasing update" UWORD _CNV_A_R_LINEAR_____146_CM 1 0. 0. 200. ECU_ADDRESS 0xd0003f0a FORMAT "%4.2" /end MEASUREMENT
/begin CHARACTERISTIC c_ctr_pulse_ivvt_dly "Time value for pulse at key ON" VALUE 0xa0020b36 _REC_S1VAL_20_u1 255. _CNV_A_R_LINEAR_____201_CM 0. 255. FORMAT "%3.0" /end CHARACTERISTIC
/begin CHARACTERISTIC c_frq_ivvthpwm "Frequency of holding pulse with modulation; both inlet and exhaust" VALUE 0xa0020aba _REC_S1VAL_20_u2 450. _CNV_A_R_LINEAR_____290_CM 50. 500. FORMAT "%3.0" /end CHARACTERISTIC
/begin CHARACTERISTIC c_maf_hb_max_ad_ref_di_ivvt "Maximum allowed engine load for IVVT reference position adaptation" VALUE 0xa0020b3b _REC_S1VAL_20_u1 1389. _CNV_A_R_LINEAR_____77_CM 0. 1389. FORMAT "%4.0" /end CHARACTERISTIC
/begin CHARACTERISTIC c_n_32_max_ad_ref_di_ivvt "Maximum required engine speed for IVVT reference position adaptation" VALUE 0xa0020b3c _REC_S1VAL_20_u1 8160. _CNV_A_R_LINEAR_____2_CM 0. 8160. FORMAT "%4.0" /end CHARACTERISTIC
/begin CHARACTERISTIC c_n_32_min_ad_ref_di_ivvt "Minimum required engine speed for IVVT reference position adaptation" VALUE 0xa0020b3d _REC_S1VAL_20_u1 8160. _CNV_A_R_LINEAR_____2_CM 0. 8160. FORMAT "%4.0" /end CHARACTERISTIC
/begin CHARACTERISTIC c_toil_max_ad_ref_di_ivvt "Maximum allowed oil temperature for IVVT reference position adaptation" VALUE 0xa0020b43 _REC_S1VAL_20_u1 200. _CNV_A_R_LINEAR_____280_CM -40. 160. FORMAT "%3.0" /end CHARACTERISTIC
/begin CHARACTERISTIC c_toil_min_ad_ref_di_ivvt "Minimum required oil temperature for IVVT reference position adaptation" VALUE 0xa0020b44 _REC_S1VAL_20_u1 200. _CNV_A_R_LINEAR_____280_CM -40. 160. FORMAT "%3.0" /end CHARACTERISTIC
/begin CHARACTERISTIC c_vvtpwm_diag_max_scg "Maximum threshold for SCG diagnosis window" VALUE 0xa0020afe _REC_S1VAL_20_u2 100. _CNV_A_R_LINEAR_____146_CM 0. 100. FORMAT "%6.2" /end CHARACTERISTIC
/begin CHARACTERISTIC c_vvtpwm_diag_min_oc "Minimum threshold for OC diagnosis window" VALUE 0xa0020b00 _REC_S1VAL_20_u2 100. _CNV_A_R_LINEAR_____146_CM 0. 100. FORMAT "%6.2" /end CHARACTERISTIC
/begin CHARACTERISTIC c_vvtpwm_diag_min_scp "Minimum threshold for SCP diagnosis window" VALUE 0xa0020b02 _REC_S1VAL_20_u2 100. _CNV_A_R_LINEAR_____146_CM 0. 100. FORMAT "%6.2" /end CHARACTERISTIC
/begin MEASUREMENT Vbx_df_in_vvtc_blk "VVTC defaut position blocking detected failure" UBYTE _CNV_S_2_RANGE______3_CM 1 0. 0. 1. ECU_ADDRESS 0xd0006de6 BIT_MASK 0x1 /end MEASUREMENT
/begin MEASUREMENT Vbx_df_in_vvtc_dirt_lkg "VVTC lost of controllability detected failure" UBYTE _CNV_S_2_RANGE______3_CM 1 0. 0. 1. ECU_ADDRESS 0xd0006de7 BIT_MASK 0x1 /end MEASUREMENT
/begin MEASUREMENT Vbx_diag_ena_in_vvtc_ad "VVTC first offset learning diagnostic information available" UBYTE _CNV_S_2_RANGE______3_CM 1 0. 0. 1. ECU_ADDRESS 0xd0006de8 BIT_MASK 0x1 /end MEASUREMENT
/begin MEASUREMENT Vbx_diag_ena_in_vvtc_blk "VVTC defaut position blocking diagnostic information available" UBYTE _CNV_S_2_RANGE______3_CM 1 0. 0. 1. ECU_ADDRESS 0xd0006de9 BIT_MASK 0x1 /end MEASUREMENT
/begin MEASUREMENT Vbx_diag_ena_in_vvtc_dirt_lkg "VVTC lost of controllability diagnostic information available" UBYTE _CNV_S_2_RANGE______3_CM 1 0. 0. 1. ECU_ADDRESS 0xd0006dea BIT_MASK 0x1 /end MEASUREMENT
/begin MEASUREMENT Vbx_in_vvtc_ctl_sat_det "Detect a saturation of the control in closed loop mode (=> VVTC not able to reach the setpoint)" UBYTE _CNV_S_2_RANGE______3_CM 1 0. 0. 1. ECU_ADDRESS 0xd0006deb BIT_MASK 0x1 /end MEASUREMENT
/begin MEASUREMENT Vbx_in_vvtc_ctl_sat_det_risk "Detect a saturation of the control in closed loop mode in the risk zon (=> VVTC not able to reach the setpoint)" UBYTE _CNV_S_2_RANGE______3_CM 1 0. 0. 1. ECU_ADDRESS 0xd0006dec BIT_MASK 0x1 /end MEASUREMENT
/begin MEASUREMENT Vbx_in_vvtc_ctl_sat_ini "Indicate that the control in closed loop mode is saturated (start timer decrementation)" UBYTE _CNV_S_2_RANGE______3_CM 1 0. 0. 1. ECU_ADDRESS 0xd0006ded BIT_MASK 0x1 /end MEASUREMENT
/begin MEASUREMENT Vbx_in_vvtc_ctl_sat_ini_risk "Indicate that the control in closed loop mode is saturated in the risk zon (start timer decrementation)" UBYTE _CNV_S_2_RANGE______3_CM 1 0. 0. 1. ECU_ADDRESS 0xd0006dee BIT_MASK 0x1 /end MEASUREMENT
/begin MEASUREMENT Vbx_in_vvtc_ena_diag "Enable diagnosis of the VVTC system (soleinoÃ¯d valve and phaser)" UBYTE _CNV_S_2_RANGE______3_CM 1 0. 0. 1. ECU_ADDRESS 0xd0006def BIT_MASK 0x1 /end MEASUREMENT
/begin MEASUREMENT Vbx_in_vvtc_fail_det "Detect a failure on the VVTC system (solenoÃ¯d valve or phaser)" UBYTE _CNV_S_2_RANGE______3_CM 1 0. 0. 1. ECU_ADDRESS 0xd0006df0 BIT_MASK 0x1 /end MEASUREMENT
/begin MEASUREMENT Vbx_in_vvtc_inh_risk_zon "Inhibition of the VVTC (limit behavior in risk zone)" UBYTE _CNV_S_2_RANGE______3_CM 1 0. 0. 1. ECU_ADDRESS 0xd0006df1 BIT_MASK 0x1 /end MEASUREMENT
/begin MEASUREMENT Vbx_in_vvtc_lim "Indicate a limit behavior of the system (because of a lack of oil pressure)" UBYTE _CNV_S_2_RANGE______3_CM 1 0. 0. 1. ECU_ADDRESS 0xd0006df2 BIT_MASK 0x1 /end MEASUREMENT
/begin MEASUREMENT Vbx_in_vvtc_reg_err_det "Detect a permanent position deviation (=> VVTC not able to reach the setpoint)" UBYTE _CNV_S_2_RANGE______3_CM 1 0. 0. 1. ECU_ADDRESS 0xd0006df3 BIT_MASK 0x1 /end MEASUREMENT
/begin MEASUREMENT Vbx_in_vvtc_reg_err_det_risk "Detect a permanent position deviation in the risk zon (=> VVTC not able to reach the setpoint)" UBYTE _CNV_S_2_RANGE______3_CM 1 0. 0. 1. ECU_ADDRESS 0xd0006df4 BIT_MASK 0x1 /end MEASUREMENT
/begin MEASUREMENT Vbx_in_vvtc_reg_err_ini "Indicate a regulation error (start timer decrementation)" UBYTE _CNV_S_2_RANGE______3_CM 1 0. 0. 1. ECU_ADDRESS 0xd0006df5 BIT_MASK 0x1 /end MEASUREMENT
/begin MEASUREMENT Vbx_in_vvtc_trt_psn_det "Indicate the system is in defaut stopper position during the confirmation of a failure" UBYTE _CNV_S_2_RANGE______3_CM 1 0. 0. 1. ECU_ADDRESS 0xd0006df6 BIT_MASK 0x1 /end MEASUREMENT
/begin MEASUREMENT Vsx_in_vvtc_vld "Intake VVTC actuator validity status" UBYTE _CNV_S_3_STATUS_OK__179_CM 1 0. 0. 2. ECU_ADDRESS 0xd0006df7 /end MEASUREMENT
/begin CHARACTERISTIC Cbx_diag_in_vvtc_ena_diag "Enable functionnal diagnosis duing the activation of the VVTC aftersales routine" VALUE 0xa002188e _REC_S1VAL_20_u1 1. _CNV_A_R_ECME_LINEA_0_CM 0. 1. FORMAT "%1.0" BIT_MASK 0x1 /end CHARACTERISTIC
/begin CHARACTERISTIC Cbx_in_vvtc_cho_ad_fail_mod "Select reversible/non reversible failure mode on a confirmed failure on camshaft wheel learning " VALUE 0xa002188f _REC_S1VAL_20_u1 1. _CNV_A_R_ECME_LINEA_0_CM 0. 1. FORMAT "%1.0" BIT_MASK 0x1 /end CHARACTERISTIC
/begin CHARACTERISTIC Cbx_in_vvtc_cho_blk_fail_mod "Select reversible/non reversible failure mode on a confirmed  bloking of VVTC system" VALUE 0xa0021890 _REC_S1VAL_20_u1 1. _CNV_A_R_ECME_LINEA_0_CM 0. 1. FORMAT "%1.0" BIT_MASK 0x1 /end CHARACTERISTIC
/begin CHARACTERISTIC Cbx_in_vvtc_ena_inh_risk_zon "Enable the inhibtion of the VVTC if a failure is detected in the risk zon" VALUE 0xa0021891 _REC_S1VAL_20_u1 1. _CNV_A_R_ECME_LINEA_0_CM 0. 1. FORMAT "%1.0" BIT_MASK 0x1 /end CHARACTERISTIC
/begin CHARACTERISTIC Cbx_in_vvtc_temp_cho_ena_diag "Select coolant or oil temperature to determine activation condition of the diagnosis at cold system operating" VALUE 0xa0021892 _REC_S1VAL_20_u1 1. _CNV_A_R_ECME_LINEA_0_CM 0. 1. FORMAT "%1.0" BIT_MASK 0x1 /end CHARACTERISTIC
/begin CHARACTERISTIC Cxx_dfdec_in_vvtc_ad "VVTC first offset learning detected failure counter decrement" VALUE 0xa0021858 _REC_S1VAL_20_u2 65535. _CNV_A_R_ECME_LINEA_0_CM 0. 65535. FORMAT "%5.0" /end CHARACTERISTIC
/begin CHARACTERISTIC Cxx_dfdec_in_vvtc_blk "VVTC defaut position blocking detected failure counter decrement" VALUE 0xa002185a _REC_S1VAL_20_u2 65535. _CNV_A_R_ECME_LINEA_0_CM 0. 65535. FORMAT "%5.0" /end CHARACTERISTIC
/begin CHARACTERISTIC Cxx_dfdec_in_vvtc_dirt_lkg "VVTC lost of controllability detected failure counter decrement" VALUE 0xa002185c _REC_S1VAL_20_u2 65535. _CNV_A_R_ECME_LINEA_0_CM 0. 65535. FORMAT "%5.0" /end CHARACTERISTIC
/begin CHARACTERISTIC Cxx_dfdec_in_vvtc_sldv_oc "detected failure counter decrement" VALUE 0xa002185e _REC_S1VAL_20_u2 65535. _CNV_A_R_ECME_LINEA_0_CM 0. 65535. FORMAT "%5.0" /end CHARACTERISTIC
/begin CHARACTERISTIC Cxx_dfdec_in_vvtc_sldv_scg "VVTC control solenoÃ¯d valve short circuit to ground detected failure counter decrement" VALUE 0xa0021860 _REC_S1VAL_20_u2 65535. _CNV_A_R_ECME_LINEA_0_CM 0. 65535. FORMAT "%5.0" /end CHARACTERISTIC
/begin CHARACTERISTIC Cxx_dfdec_in_vvtc_sldv_scw "VVTC control solenoÃ¯d valve short circuit to battery detected failure counter decrement" VALUE 0xa0021862 _REC_S1VAL_20_u2 65535. _CNV_A_R_ECME_LINEA_0_CM 0. 65535. FORMAT "%5.0" /end CHARACTERISTIC
/begin CHARACTERISTIC Cxx_dfinc_in_vvtc_ad "VVTC first offset learning detected failure counter increment" VALUE 0xa0021864 _REC_S1VAL_20_u2 65535. _CNV_A_R_ECME_LINEA_0_CM 0. 65535. FORMAT "%5.0" /end CHARACTERISTIC
/begin CHARACTERISTIC Cxx_dfinc_in_vvtc_blk "VVTC defaut position blocking detected failure counter increment" VALUE 0xa0021866 _REC_S1VAL_20_u2 65535. _CNV_A_R_ECME_LINEA_0_CM 0. 65535. FORMAT "%5.0" /end CHARACTERISTIC
/begin CHARACTERISTIC Cxx_dfinc_in_vvtc_dirt_lkg "VVTC lost of controllability detected failure counter increment" VALUE 0xa0021868 _REC_S1VAL_20_u2 65535. _CNV_A_R_ECME_LINEA_0_CM 0. 65535. FORMAT "%5.0" /end CHARACTERISTIC
/begin CHARACTERISTIC Cxx_dfinc_in_vvtc_sldv_oc "VVTC control solenoÃ¯d valve open circuit detected failure counter increment" VALUE 0xa002186a _REC_S1VAL_20_u2 65535. _CNV_A_R_ECME_LINEA_0_CM 0. 65535. FORMAT "%5.0" /end CHARACTERISTIC
/begin CHARACTERISTIC Cxx_dfinc_in_vvtc_sldv_scg "VVTC control solenoÃ¯d valve short circuit to ground detected failure counter increment" VALUE 0xa002186c _REC_S1VAL_20_u2 65535. _CNV_A_R_ECME_LINEA_0_CM 0. 65535. FORMAT "%5.0" /end CHARACTERISTIC
/begin CHARACTERISTIC Cxx_dfinc_in_vvtc_sldv_scw "VVTC control solenoÃ¯d valve short circuit to battery detected failure counter increment" VALUE 0xa002186e _REC_S1VAL_20_u2 65535. _CNV_A_R_ECME_LINEA_0_CM 0. 65535. FORMAT "%5.0" /end CHARACTERISTIC
/begin CHARACTERISTIC Cxx_in_vvtc_ctl_sat_inh_thd "Position theshold to inhib diagnosis near the stoppers" VALUE 0xa0021870 _REC_S1VAL_20_u2 719.98 _CNV_A_R_LINEAR_____129_CM 0. 719.98 FORMAT "%6.2" /end CHARACTERISTIC
/begin CHARACTERISTIC Cxx_in_vvtc_ctl_sat_max_thd "High threshold on the value of the closed loop control " VALUE 0xa0021872 _REC_S1VAL_20_u2 200. _CNV_A_R_LINEAR_____146_CM 0. 200. FORMAT "%6.2" /end CHARACTERISTIC
/begin CHARACTERISTIC Cxx_in_vvtc_ctl_sat_min_thd "Low threshold on the value of the closed loop control " VALUE 0xa0021874 _REC_S1VAL_20_u2 200. _CNV_A_R_LINEAR_____146_CM 0. 200. FORMAT "%6.2" /end CHARACTERISTIC
/begin CHARACTERISTIC Cxx_in_vvtc_ctl_sat_t "Delay to confirm a failure on the system (due to a saturation of the contol)" VALUE 0xa0021876 _REC_S1VAL_20_u2 655.35 _CNV_A_R_LINEAR_____32_CM 0. 655.35 FORMAT "%6.2" /end CHARACTERISTIC
/begin CHARACTERISTIC Cxx_in_vvtc_ctl_sat_t_risk_zon "Delay to confirm a failure on the system in the risk zon (due to a saturation of the contol)" VALUE 0xa0021878 _REC_S1VAL_20_u2 655.35 _CNV_A_R_LINEAR_____32_CM 0. 655.35 FORMAT "%6.2" /end CHARACTERISTIC
/begin CHARACTERISTIC Cxx_in_vvtc_n_min_ena_diag "Minimum engine speed to enable diagnosis of the system (solenoÃ¯d valve and phaser componensts)" VALUE 0xa002187a _REC_S1VAL_20_u2 16383.75 _CNV_A_R_ENSD_LINEA_22_CM 0. 16383.75 FORMAT "%8.2" /end CHARACTERISTIC
/begin CHARACTERISTIC Cxx_in_vvtc_reg_err_t "Delay to detect confirm permanent error" VALUE 0xa002187c _REC_S1VAL_20_u2 655.35 _CNV_A_R_LINEAR_____32_CM 0. 655.35 FORMAT "%6.2" /end CHARACTERISTIC
/begin CHARACTERISTIC Cxx_in_vvtc_reg_err_t_risk_zon "Delay to detect confirm permanent error in the risk zon" VALUE 0xa002187e _REC_S1VAL_20_u2 655.35 _CNV_A_R_LINEAR_____32_CM 0. 655.35 FORMAT "%6.2" /end CHARACTERISTIC
/begin CHARACTERISTIC Cxx_in_vvtc_reg_err_thd "Theshold to consider a regulation error" VALUE 0xa0021880 _REC_S1VAL_20_u2 719.98 _CNV_A_R_LINEAR_____129_CM 0. 719.98 FORMAT "%6.2" /end CHARACTERISTIC
/begin CHARACTERISTIC Cxx_in_vvtc_reg_err_thd_risk "Theshold to consider a regulation error in the risk zon" VALUE 0xa0021882 _REC_S1VAL_20_u2 719.98 _CNV_A_R_LINEAR_____129_CM 0. 719.98 FORMAT "%6.2" /end CHARACTERISTIC
/begin CHARACTERISTIC Cxx_in_vvtc_temp_min_ena_diag "Minimum engine coolant temperature to enable diagnosis of the system (solenoÃ¯d valve and phaser components)" VALUE 0xa0021884 _REC_S1VAL_20_u2 240. _CNV_A_R_LINEAR_____110_CM -40. 200. FORMAT "%5.1" /end CHARACTERISTIC
/begin CHARACTERISTIC Cxx_in_vvtc_trt_blk_dlt_t "Delay to reset the variable Vbx_df_in_vvtc_blk if the failure disappears" VALUE 0xa0021886 _REC_S1VAL_20_u2 655.35 _CNV_A_R_LINEAR_____32_CM 0. 655.35 FORMAT "%6.2" /end CHARACTERISTIC
/begin CHARACTERISTIC Cxx_in_vvtc_trt_oor_t "Delay to consider a movement out of the defaut stopper" VALUE 0xa0021888 _REC_S1VAL_20_u2 655.35 _CNV_A_R_LINEAR_____32_CM 0. 655.35 FORMAT "%6.2" /end CHARACTERISTIC
/begin CHARACTERISTIC Cxx_in_vvtc_trt_psn_thd "Theshold to consider the system in the defaut stopper position" VALUE 0xa002188a _REC_S1VAL_20_u2 719.98 _CNV_A_R_LINEAR_____129_CM 0. 719.98 FORMAT "%6.2" /end CHARACTERISTIC
/begin CHARACTERISTIC Cxx_in_vvtc_v_min_ena_diag "Minimum battery voltage to enable diagnosis of the system (solenoÃ¯d valve and phaser components)" VALUE 0xa002188c _REC_S1VAL_20_u2 60. _CNV_A_R_LINEAR_____205_CM 0. 60. FORMAT "%5.2" /end CHARACTERISTIC
/begin AXIS_PTS Ctb_in_vvtc_lck_cyc_t "Table of PWM breakpoints for each phase of the unlocking strategy mode" 0xa002180c Vxx_in_vvtc_lck_cyc_t _REC_A2AXS_20_u2 65.535 _CNV_A_R_LINEAR_____116_CM 3 0. 65.535 /end AXIS_PTS
/begin AXIS_PTS Ctb_in_vvtc_n_bkpt "Table of engine engine speed breakpoints used with the cartography Ctp_in_vvtc_awg" 0xa002ebe8 Vxx_n _REC_A2AXS_20_u2 16383.75 _CNV_A_R_ENSD_LINEA_22_CM 12 0. 16383.75 FORMAT "%8.2" /end AXIS_PTS
/begin CHARACTERISTIC Ctp_in_vvtc_awg "Cartography with gains for anti-windup action (to avoid saturation of the integral term)" CURVE 0xa002ec04 _REC_A1CUR_20_u2_u2 200. _CNV_A_R_LINEAR_____413_CM 0. 200. FORMAT "%10.6"
 /begin AXIS_DESCR COM_AXIS Vxx_n _CNV_A_R_ENSD_LINEA_22_CM 12 0. 16383.75 FORMAT "%8.2" AXIS_PTS_REF Ctb_in_vvtc_n_bkpt /end AXIS_DESCR
/end CHARACTERISTIC
/begin CHARACTERISTIC Ctp_in_vvtc_awg_max_thd "Cartography of high thresholds on the PWM control" CURVE 0xa002ec1c _REC_A1CUR_20_u2_u2 255.99609375 _CNV_A_R_LINEAR_____414_CM 0. 255.99609375 FORMAT "%6.2"
 /begin AXIS_DESCR COM_AXIS Vxx_n _CNV_A_R_ENSD_LINEA_22_CM 12 0. 16383.75 FORMAT "%8.2" AXIS_PTS_REF Ctb_in_vvtc_n_bkpt /end AXIS_DESCR
/end CHARACTERISTIC
/begin CHARACTERISTIC Ctp_in_vvtc_awg_min_thd "Cartography of low thresholds on the PWM control" CURVE 0xa002ec34 _REC_A1CUR_20_u2_u2 255.99609375 _CNV_A_R_LINEAR_____414_CM 0. 255.99609375 FORMAT "%6.2"
 /begin AXIS_DESCR COM_AXIS Vxx_n _CNV_A_R_ENSD_LINEA_22_CM 12 0. 16383.75 FORMAT "%8.2" AXIS_PTS_REF Ctb_in_vvtc_n_bkpt /end AXIS_DESCR
/end CHARACTERISTIC
/begin CHARACTERISTIC Ctp_in_vvtc_lck_pwm_thd "Cartography with PWM cycles peaks (RCO1 and RCO2) of the unlocking strategy mode" CURVE 0xa0021814 _REC_A1CUR_20_u2_u2 200. _CNV_A_R_LINEAR_____146_CM 0. 200. FORMAT "%6.2"
 /begin AXIS_DESCR COM_AXIS Vxx_in_vvtc_lck_cyc_t _CNV_A_R_LINEAR_____116_CM 3 0. 65.535 AXIS_PTS_REF Ctb_in_vvtc_lck_cyc_t /end AXIS_DESCR
/end CHARACTERISTIC
/begin CHARACTERISTIC Ctp_in_vvtc_pg "Cartography with the propotionnal gains of the controller" CURVE 0xa002ec4c _REC_A1CUR_20_u2_u2 200. _CNV_A_R_LINEAR_____415_CM 0. 200. FORMAT "%6.2"
 /begin AXIS_DESCR COM_AXIS Vxx_n _CNV_A_R_ENSD_LINEA_22_CM 12 0. 16383.75 FORMAT "%8.2" AXIS_PTS_REF Ctb_in_vvtc_n_bkpt /end AXIS_DESCR
/end CHARACTERISTIC
/begin MEASUREMENT Vbx_in_vvtc_ad_end "All learning finished (camshaft wheel and intergral term)" UBYTE _CNV_S_2_RANGE______3_CM 1 0. 0. 1. ECU_ADDRESS 0xd0006dce BIT_MASK 0x1 /end MEASUREMENT
/begin MEASUREMENT Vbx_in_vvtc_ad_int_val "Learning of integral term finished" UBYTE _CNV_S_2_RANGE______3_CM 1 0. 0. 1. ECU_ADDRESS 0xd0006dcf BIT_MASK 0x1 /end MEASUREMENT
/begin MEASUREMENT Vbx_in_vvtc_cl_ctl "VVTC system in closed loop control mode" UBYTE _CNV_S_2_RANGE______3_CM 1 0. 0. 1. ECU_ADDRESS 0xd0006dd0 BIT_MASK 0x1 /end MEASUREMENT
/begin MEASUREMENT Vbx_in_vvtc_cl_out_l_trt "VVTC system in closed loop control mode out of the low thrust" UBYTE _CNV_S_2_RANGE______3_CM 1 0. 0. 1. ECU_ADDRESS 0xd0006dd1 BIT_MASK 0x1 /end MEASUREMENT
/begin MEASUREMENT Vbx_in_vvtc_crk_syn "Indicate crankshaft synchronisation" UBYTE _CNV_S_2_RANGE______3_CM 1 0. 0. 1. ECU_ADDRESS 0xd0006dd2 BIT_MASK 0x1 /end MEASUREMENT
/begin MEASUREMENT Vbx_in_vvtc_int_val_ini "Initialisation of the integral term (at the beginning of the learning stage)" UBYTE _CNV_S_2_RANGE______3_CM 1 0. 0. 1. ECU_ADDRESS 0xd0006dd3 BIT_MASK 0x1 /end MEASUREMENT
/begin MEASUREMENT Vbx_in_vvtc_lck_act_sta_det "Detection of the start of the VVTC unlocking strategy mode" UBYTE _CNV_S_2_RANGE______3_CM 1 0. 0. 1. ECU_ADDRESS 0xd0006dd4 BIT_MASK 0x1 /end MEASUREMENT
/begin MEASUREMENT Vbx_in_vvtc_lck_cyc_sta_det "Detection of the start of each cycle of the VVTC unlocking strategy mode" UBYTE _CNV_S_2_RANGE______3_CM 1 0. 0. 1. ECU_ADDRESS 0xd0006dd5 BIT_MASK 0x1 /end MEASUREMENT
/begin MEASUREMENT Vxx_in_cam_toth_per_sat "Duration between two intake camshaft events (with Min/Max saturation)" UWORD _CNV_A_R_LINEAR_____202_CM 1 0. 0. 65535. ECU_ADDRESS 0xd0004520 FORMAT "%5.0" /end MEASUREMENT
/begin MEASUREMENT Vxx_in_cam_toth_per_sat_sq "Square value of the variable Vxx_in_cam_toth_per_sat" UWORD _CNV_A_R_LINEAR_____416_CM 1 0. 0. 4294836225. ECU_ADDRESS 0xd0004522 FORMAT "%9.8" /end MEASUREMENT
/begin MEASUREMENT Vxx_in_vvtc_angl_sp_1 "Correspond to the previous value of the variable Vxx_in_vvtc_angl_sp" UWORD _CNV_A_R_LINEAR_____129_CM 1 0. 0. 719.98 ECU_ADDRESS 0xd0004524 FORMAT "%6.2" /end MEASUREMENT
/begin MEASUREMENT Vxx_in_vvtc_angl_sp_2 "Correspond to the previous value of the variable Vxx_in_vvtc_angl_sp_1" UWORD _CNV_A_R_LINEAR_____129_CM 1 0. 0. 719.98 ECU_ADDRESS 0xd0004526 FORMAT "%6.2" /end MEASUREMENT
/begin MEASUREMENT Vxx_in_vvtc_angl_sp_lck "Angular position setpoint of the intake VVTC system after the unlocking strategy mode treatment" UWORD _CNV_A_R_LINEAR_____129_CM 1 0. 0. 719.98 ECU_ADDRESS 0xd0004528 FORMAT "%6.2" /end MEASUREMENT
/begin MEASUREMENT Vxx_in_vvtc_awg_lp "Value of the anti-windup correction" SWORD _CNV_A_R_LINEAR_____417_CM 1 0. -2048. 2047.9375 ECU_ADDRESS 0xd000452a FORMAT "%9.4" /end MEASUREMENT
/begin MEASUREMENT Vxx_in_vvtc_cl_cps "Internal variable used for the calculation of the closed loop compensation" UWORD _CNV_A_R_LINEAR_____418_CM 1 0. -256. 255.99 ECU_ADDRESS 0xd000452c FORMAT "%11.7" /end MEASUREMENT
/begin MEASUREMENT Vxx_in_vvtc_cl_cps_1 "Previous value of the variable Vxx_in_vvtc_cl_cps" UWORD _CNV_A_R_LINEAR_____419_CM 1 0. -256. 255.9921875 ECU_ADDRESS 0xd000452e FORMAT "%12.7" /end MEASUREMENT
/begin MEASUREMENT Vxx_in_vvtc_cl_cps_tmp "Internal variable used for the calculation of the closed loop compensation" ULONG _CNV_A_R_LINEAR_____420_CM 1 0. -256. 255.99999988079 ECU_ADDRESS 0xd00028b4 FORMAT "%12.8" /end MEASUREMENT
/begin MEASUREMENT Vxx_in_vvtc_cl_ctl "Closed loop control (output of the RST controller)" UWORD _CNV_A_R_LINEAR_____421_CM 1 0. -200. 200. ECU_ADDRESS 0xd0004530 FORMAT "%7.2" /end MEASUREMENT
/begin MEASUREMENT Vxx_in_vvtc_cl_ctl_dif "Value used for the calculation of the anti-windup action" UWORD _CNV_A_R_LINEAR_____418_CM 1 0. -256. 255.99 ECU_ADDRESS 0xd0004532 FORMAT "%11.7" /end MEASUREMENT
/begin MEASUREMENT Vxx_in_vvtc_cl_ctl_wio_sat "Closed loop control without saturations (used for the anti-windup action)" UWORD _CNV_A_R_LINEAR_____418_CM 1 0. -256. 255.99 ECU_ADDRESS 0xd0004534 FORMAT "%11.7" /end MEASUREMENT
/begin MEASUREMENT Vxx_in_vvtc_cl_ctl_wit_sat "Closed loop control with saturations (for the anti-windup action)" UWORD _CNV_A_R_LINEAR_____418_CM 1 0. -256. 255.99 ECU_ADDRESS 0xd0004536 FORMAT "%11.7" /end MEASUREMENT
/begin MEASUREMENT Vxx_in_vvtc_den_cl_cps_0 "Coefficient used for the calculation of the closed loop compensation" UWORD _CNV_A_R_LINEAR_____422_CM 1 0. 0. 15.999755859375 ECU_ADDRESS 0xd0004538 FORMAT "%11.8" /end MEASUREMENT
/begin MEASUREMENT Vxx_in_vvtc_den_cl_cps_1 "Coefficient used for the calculation of the closed loop compensation" UWORD _CNV_A_R_LINEAR_____422_CM 1 0. 0. 15.999755859375 ECU_ADDRESS 0xd000453a FORMAT "%11.8" /end MEASUREMENT
/begin MEASUREMENT Vxx_in_vvtc_den_cl_cps_tmp "Internal variable used for the calculation of the closed loop compensation" ULONG _CNV_A_R_LINEAR_____420_CM 1 0. -256. 255.99999988079 ECU_ADDRESS 0xd00028b8 FORMAT "%12.8" /end MEASUREMENT
/begin MEASUREMENT Vxx_in_vvtc_den_pcmd_tmp "Internal variable used for the calculation of the feedforward control" ULONG _CNV_A_R_LINEAR_____420_CM 1 0. -256. 255.99999988079 ECU_ADDRESS 0xd00028bc FORMAT "%12.8" /end MEASUREMENT
/begin MEASUREMENT Vxx_in_vvtc_den_pcmd_tmp_1 "Internal variable used for the calculation of the feedforward control" ULONG _CNV_A_R_LINEAR_____420_CM 1 0. -256. 255.99999988079 ECU_ADDRESS 0xd00028c0 FORMAT "%12.8" /end MEASUREMENT
/begin MEASUREMENT Vxx_in_vvtc_den_pcmd_tmp_2 "Internal variable used for the calculation of the feedforward control" ULONG _CNV_A_R_LINEAR_____420_CM 1 0. -256. 255.99999988079 ECU_ADDRESS 0xd00028c4 FORMAT "%12.8" /end MEASUREMENT
/begin MEASUREMENT Vxx_in_vvtc_den_tgt_sp_0 "Coefficient used for the calculation of the target setpoint" UWORD _CNV_A_R_LINEAR_____422_CM 1 0. 0. 15.999755859375 ECU_ADDRESS 0xd000453c FORMAT "%11.8" /end MEASUREMENT
/begin MEASUREMENT Vxx_in_vvtc_den_tgt_sp_1 "Coefficient used for the calculation of the target setpoint" UWORD _CNV_A_R_LINEAR_____422_CM 1 0. 0. 15.999755859375 ECU_ADDRESS 0xd000453e FORMAT "%11.8" /end MEASUREMENT
/begin MEASUREMENT Vxx_in_vvtc_den_tgt_sp_2 "Coefficient used for the calculation of the target setpoint" UWORD _CNV_A_R_LINEAR_____422_CM 1 0. 0. 15.999755859375 ECU_ADDRESS 0xd0004540 FORMAT "%11.8" /end MEASUREMENT
/begin MEASUREMENT Vxx_in_vvtc_den_tgt_sp_tmp "Internal variable used for the calculation of the target setpoint" SLONG _CNV_A_R_LINEAR_____423_CM 1 0. -256. 255.999999880791 ECU_ADDRESS 0xd00028c8 FORMAT "%16.12" /end MEASUREMENT
/begin MEASUREMENT Vxx_in_vvtc_den_tgt_sp_tmp_1 "Internal variable used for the calculation of the target setpoint" ULONG _CNV_A_R_LINEAR_____424_CM 1 0. 0. 255.999999940395 ECU_ADDRESS 0xd00028cc FORMAT "%12.8" /end MEASUREMENT
/begin MEASUREMENT Vxx_in_vvtc_den_tgt_sp_tmp_2 "Internal variable used for the calculation of the target setpoint" ULONG _CNV_A_R_LINEAR_____424_CM 1 0. 0. 255.999999940395 ECU_ADDRESS 0xd00028d0 FORMAT "%12.8" /end MEASUREMENT
/begin MEASUREMENT Vxx_in_vvtc_int_val "Integral term of the controller" UWORD _CNV_A_R_LINEAR_____419_CM 1 0. -256. 255.9921875 ECU_ADDRESS 0xd0004542 FORMAT "%12.7" /end MEASUREMENT
/begin MEASUREMENT Vxx_in_vvtc_int_val_tmp "Internal variable used for the calculation of the closed loop compensation" UWORD _CNV_A_R_LINEAR_____418_CM 1 0. -256. 255.99 ECU_ADDRESS 0xd0004544 FORMAT "%11.7" /end MEASUREMENT
/begin MEASUREMENT Vxx_in_vvtc_lck_cyc_t "VVTC unlocking strategy mode duration" UWORD _CNV_A_R_LINEAR_____116_CM 1 0. 0. 65.535 ECU_ADDRESS 0xd0004546 /end MEASUREMENT
/begin MEASUREMENT Vxx_in_vvtc_num_cl_cps_0 "Coefficient used for the calculation of the closed loop compensation" UWORD _CNV_A_R_LINEAR_____425_CM 1 0. -8. 7.999755859375 ECU_ADDRESS 0xd0004548 FORMAT "%10.8" /end MEASUREMENT
/begin MEASUREMENT Vxx_in_vvtc_num_cl_cps_1 "Coefficient used for the calculation of the closed loop compensation" UWORD _CNV_A_R_LINEAR_____425_CM 1 0. -8. 7.999755859375 ECU_ADDRESS 0xd000454a FORMAT "%10.8" /end MEASUREMENT
/begin MEASUREMENT Vxx_in_vvtc_num_cl_cps_tmp "Internal variable used for the calculation of the closed loop compensation" ULONG _CNV_A_R_LINEAR_____420_CM 1 0. -256. 255.99999988079 ECU_ADDRESS 0xd00028d4 FORMAT "%12.8" /end MEASUREMENT
/begin MEASUREMENT Vxx_in_vvtc_num_cl_cps_tmp_0 "Internal variable used for the calculation of the closed loop compensation" ULONG _CNV_A_R_LINEAR_____420_CM 1 0. -256. 255.99999988079 ECU_ADDRESS 0xd00028d8 FORMAT "%12.8" /end MEASUREMENT
/begin MEASUREMENT Vxx_in_vvtc_num_cl_cps_tmp_1 "Internal variable used for the calculation of the closed loop compensation" ULONG _CNV_A_R_LINEAR_____420_CM 1 0. -256. 255.99999988079 ECU_ADDRESS 0xd00028dc FORMAT "%12.8" /end MEASUREMENT
/begin MEASUREMENT Vxx_in_vvtc_num_pcmd_0 "Coefficient used for the calculation of the feedforward control" UWORD _CNV_A_R_LINEAR_____425_CM 1 0. -8. 7.999755859375 ECU_ADDRESS 0xd000454c FORMAT "%10.8" /end MEASUREMENT
/begin MEASUREMENT Vxx_in_vvtc_num_pcmd_1 "Coefficient used for the calculation of the feedforward control" UWORD _CNV_A_R_LINEAR_____425_CM 1 0. -8. 7.999755859375 ECU_ADDRESS 0xd000454e FORMAT "%10.8" /end MEASUREMENT
/begin MEASUREMENT Vxx_in_vvtc_num_pcmd_2 "Coefficient used for the calculation of the feedforward control" UWORD _CNV_A_R_LINEAR_____425_CM 1 0. -8. 7.999755859375 ECU_ADDRESS 0xd0004550 FORMAT "%10.8" /end MEASUREMENT
/begin MEASUREMENT Vxx_in_vvtc_num_pcmd_tmp "Internal variable used for the calculation of the feedforward control" ULONG _CNV_A_R_LINEAR_____420_CM 1 0. -256. 255.99999988079 ECU_ADDRESS 0xd00028e0 FORMAT "%12.8" /end MEASUREMENT
/begin MEASUREMENT Vxx_in_vvtc_num_pcmd_tmp_0 "Internal variable used for the calculation of the feedforward control" ULONG _CNV_A_R_LINEAR_____420_CM 1 0. -256. 255.99999988079 ECU_ADDRESS 0xd00028e4 FORMAT "%12.8" /end MEASUREMENT
/begin MEASUREMENT Vxx_in_vvtc_num_pcmd_tmp_1 "Internal variable used for the calculation of the feedforward control" ULONG _CNV_A_R_LINEAR_____420_CM 1 0. -256. 255.99999988079 ECU_ADDRESS 0xd00028e8 FORMAT "%12.8" /end MEASUREMENT
/begin MEASUREMENT Vxx_in_vvtc_num_pcmd_tmp_2 "Internal variable used for the calculation of the feedforward control" ULONG _CNV_A_R_LINEAR_____420_CM 1 0. -256. 255.99999988079 ECU_ADDRESS 0xd00028ec FORMAT "%12.8" /end MEASUREMENT
/begin MEASUREMENT Vxx_in_vvtc_num_tgt_sp_0 "Coefficient used for the calculation of the target setpoint" SWORD _CNV_A_R_LINEAR_____426_CM 1 0. -8. 7.999755859375 ECU_ADDRESS 0xd0004552 FORMAT "%10.8" /end MEASUREMENT
/begin MEASUREMENT Vxx_in_vvtc_num_tgt_sp_1 "Coefficient used for the calculation of the target setpoint" SWORD _CNV_A_R_LINEAR_____426_CM 1 0. -8. 7.999755859375 ECU_ADDRESS 0xd0004554 FORMAT "%10.8" /end MEASUREMENT
/begin MEASUREMENT Vxx_in_vvtc_num_tgt_sp_2 "Coefficient used for the calculation of the target setpoint" SWORD _CNV_A_R_LINEAR_____426_CM 1 0. -8. 7.999755859375 ECU_ADDRESS 0xd0004556 FORMAT "%10.8" /end MEASUREMENT
/begin MEASUREMENT Vxx_in_vvtc_num_tgt_sp_tmp "Internal variable used for the calculation of the target setpoint" SLONG _CNV_A_R_LINEAR_____423_CM 1 0. -256. 255.999999880791 ECU_ADDRESS 0xd00028f0 FORMAT "%16.12" /end MEASUREMENT
/begin MEASUREMENT Vxx_in_vvtc_num_tgt_sp_tmp_0 "Internal variable used for the calculation of the target setpoint" SLONG _CNV_A_R_LINEAR_____423_CM 1 0. -256. 255.999999880791 ECU_ADDRESS 0xd00028f4 FORMAT "%16.12" /end MEASUREMENT
/begin MEASUREMENT Vxx_in_vvtc_num_tgt_sp_tmp_1 "Internal variable used for the calculation of the target setpoint" SLONG _CNV_A_R_LINEAR_____423_CM 1 0. -256. 255.999999880791 ECU_ADDRESS 0xd00028f8 FORMAT "%16.12" /end MEASUREMENT
/begin MEASUREMENT Vxx_in_vvtc_num_tgt_sp_tmp_2 "Internal variable used for the calculation of the target setpoint" SLONG _CNV_A_R_LINEAR_____423_CM 1 0. -256. 255.999999880791 ECU_ADDRESS 0xd00028fc FORMAT "%16.12" /end MEASUREMENT
/begin MEASUREMENT Vxx_in_vvtc_p_val "Proporionnal term of the RST controller" UWORD _CNV_A_R_LINEAR_____418_CM 1 0. -256. 255.99 ECU_ADDRESS 0xd0004558 FORMAT "%11.7" /end MEASUREMENT
/begin MEASUREMENT Vxx_in_vvtc_pcmd "Value of the feedforward control" UWORD _CNV_A_R_LINEAR_____418_CM 1 0. -256. 255.99 ECU_ADDRESS 0xd000455a FORMAT "%11.7" /end MEASUREMENT
/begin MEASUREMENT Vxx_in_vvtc_pcmd_1 "Correspond to the previous value of the variable Vxx_in_vvtc_pcmd" UWORD _CNV_A_R_LINEAR_____419_CM 1 0. -256. 255.9921875 ECU_ADDRESS 0xd000455c FORMAT "%12.7" /end MEASUREMENT
/begin MEASUREMENT Vxx_in_vvtc_pcmd_2 "Correspond to the previous value of the variable Vxx_in_vvtc_pcmd_1" UWORD _CNV_A_R_LINEAR_____419_CM 1 0. -256. 255.9921875 ECU_ADDRESS 0xd000455e FORMAT "%12.7" /end MEASUREMENT
/begin MEASUREMENT Vxx_in_vvtc_pcmd_tmp "Internal variable for the calculation of the feedforward control" ULONG _CNV_A_R_LINEAR_____427_CM 1 0. -256. 255.99999988079 ECU_ADDRESS 0xd0002900 FORMAT "%12.8" /end MEASUREMENT
/begin MEASUREMENT Vxx_in_vvtc_pwm "PWM control applied to the driver of the VVTC Solenoid valve" UWORD _CNV_A_R_LINEAR_____146_CM 1 0. 0. 200. ECU_ADDRESS 0xd0004560 FORMAT "%6.2" /end MEASUREMENT
/begin MEASUREMENT Vxx_in_vvtc_pwm_val "Value of the PWM control with Min/Max saturation" UWORD _CNV_A_R_LINEAR_____146_CM 1 0. 0. 200. ECU_ADDRESS 0xd0004562 FORMAT "%6.2" /end MEASUREMENT
/begin MEASUREMENT Vxx_in_vvtc_pwm_vb_cps "PWM control with battery voltage compensation" UWORD _CNV_A_R_LINEAR_____146_CM 1 0. 0. 200. ECU_ADDRESS 0xd0004564 FORMAT "%6.2" /end MEASUREMENT
/begin MEASUREMENT Vxx_in_vvtc_reg_err "Regulation error (difference between setpoint and the actual angular position of the VVTC system)" UWORD _CNV_A_R_LINEAR_____428_CM 1 0. -360. 360. ECU_ADDRESS 0xd0004566 FORMAT "%7.2" /end MEASUREMENT
/begin MEASUREMENT Vxx_in_vvtc_reg_err_1 "Previous value of the varaible Vxx_in_vvtc_reg_err" UWORD _CNV_A_R_LINEAR_____428_CM 1 0. -360. 360. ECU_ADDRESS 0xd0004568 FORMAT "%7.2" /end MEASUREMENT
/begin MEASUREMENT Vxx_in_vvtc_sum_pint_val "Proportionnal and integral terms of the RST controller" UWORD _CNV_A_R_LINEAR_____418_CM 1 0. -256. 255.99 ECU_ADDRESS 0xd000456a FORMAT "%11.7" /end MEASUREMENT
/begin MEASUREMENT Vxx_in_vvtc_tgt_sp "Target setpoint for the closed loop control of the VVTC angular position" UWORD _CNV_A_R_LINEAR_____429_CM 1 0. 0. 127.998046875 ECU_ADDRESS 0xd000456c FORMAT "%10.6" /end MEASUREMENT
/begin MEASUREMENT Vxx_in_vvtc_tgt_sp_1 "Previous value of the variable Vxx_in_vvtc_angl_sp" UWORD _CNV_A_R_LINEAR_____429_CM 1 0. 0. 127.998046875 ECU_ADDRESS 0xd000456e FORMAT "%10.6" /end MEASUREMENT
/begin MEASUREMENT Vxx_in_vvtc_tgt_sp_2 "Previous value of the variable Vxx_in_vvtc_tgt_sp_1" UWORD _CNV_A_R_LINEAR_____429_CM 1 0. 0. 127.998046875 ECU_ADDRESS 0xd0004570 FORMAT "%10.6" /end MEASUREMENT
/begin MEASUREMENT Vxx_in_vvtc_tgt_sp_cho "Target setpoint for the closed loop control of the VVTC angular position" UWORD _CNV_A_R_LINEAR_____129_CM 1 0. 0. 719.98 ECU_ADDRESS 0xd0004572 FORMAT "%6.2" /end MEASUREMENT
/begin MEASUREMENT Vxx_in_vvtc_tgt_sp_ftc "Target setpoint from first order filter for the closed loop control of the VVTC angular position" UWORD _CNV_A_R_LINEAR_____129_CM 1 0. 0. 719.98 ECU_ADDRESS 0xd0004574 FORMAT "%6.2" /end MEASUREMENT
/begin MEASUREMENT Vxx_in_vvtc_tgt_sp_tmp "Internal variable for the calculation of the target setpoint" ULONG _CNV_A_R_LINEAR_____424_CM 1 0. 0. 255.999999940395 ECU_ADDRESS 0xd0002904 FORMAT "%12.8" /end MEASUREMENT
/begin MEASUREMENT Vxx_in_vvtc_vb_cps "Battery voltage compensation" UWORD _CNV_A_R_LINEAR_____166_CM 1 0. 0. 100. ECU_ADDRESS 0xd0004576 FORMAT "%12.8" /end MEASUREMENT
/begin MEASUREMENT Vxx_in_vvtc_vb_fil "Filtered battery voltage" UWORD _CNV_A_R_LINEAR_____205_CM 1 0. 0. 60. ECU_ADDRESS 0xd0004578 FORMAT "%5.2" /end MEASUREMENT
/begin CHARACTERISTIC Cbx_in_vvtc_cho_tgt_sp "Select filter for target setpoint computation (1 : 1st order filter ; 0 : RST filter)" VALUE 0xa0021852 _REC_S1VAL_20_u1 1. _CNV_A_R_ECME_LINEA_0_CM 0. 1. FORMAT "%1.0" BIT_MASK 0x1 /end CHARACTERISTIC
/begin CHARACTERISTIC Cbx_in_vvtc_ena_inh_cmd "Allow control inhibition of the VVTC system in the risk zon (limit behavior)" VALUE 0xa0021853 _REC_S1VAL_20_u1 1. _CNV_A_R_ECME_LINEA_0_CM 0. 1. FORMAT "%1.0" BIT_MASK 0x1 /end CHARACTERISTIC
/begin CHARACTERISTIC Cbx_in_vvtc_ena_int_ad "Allow learning of the integral term" VALUE 0xa0021854 _REC_S1VAL_20_u1 1. _CNV_A_R_ECME_LINEA_0_CM 0. 1. FORMAT "%1.0" BIT_MASK 0x1 /end CHARACTERISTIC
/begin CHARACTERISTIC Cbx_in_vvtc_ena_vb_cps "Enable compensation of the PWM control with regard to battery voltage" VALUE 0xa0021855 _REC_S1VAL_20_u1 1. _CNV_A_R_ECME_LINEA_0_CM 0. 1. FORMAT "%1.0" BIT_MASK 0x1 /end CHARACTERISTIC
/begin CHARACTERISTIC Cbx_in_vvtc_pwm_bch "Select open loop control" VALUE 0xa0021856 _REC_S1VAL_20_u1 1. _CNV_A_R_ECME_LINEA_0_CM 0. 1. FORMAT "%1.0" BIT_MASK 0x1 /end CHARACTERISTIC
/begin CHARACTERISTIC Cxx_in_cam_toth_per_max "Maximum duration between two intake camshaft events" VALUE 0xa002181a _REC_S1VAL_20_u2 65535. _CNV_A_R_LINEAR_____202_CM 0. 65535. FORMAT "%5.0" /end CHARACTERISTIC
/begin CHARACTERISTIC Cxx_in_cam_toth_per_min "Maximum duration between two intake camshaft events" VALUE 0xa002181c _REC_S1VAL_20_u2 65535. _CNV_A_R_LINEAR_____202_CM 0. 65535. FORMAT "%5.0" /end CHARACTERISTIC
/begin CHARACTERISTIC Cxx_in_vvtc_angl_max_str "Maximum angular displacement of the intake VVTC actuator (component characteristic)" VALUE 0xa002181e _REC_S1VAL_20_u2 719.98 _CNV_A_R_LINEAR_____129_CM 0. 719.98 FORMAT "%6.2" /end CHARACTERISTIC
/begin CHARACTERISTIC Cxx_in_vvtc_den_cl_cps_0 "RST controller parameter used for the calculation of the closed loop compensation" VALUE 0xa0021820 _REC_S1VAL_20_u2 511.99 _CNV_A_R_LINEAR_____430_CM 0. 511.99 FORMAT "%11.7" /end CHARACTERISTIC
/begin CHARACTERISTIC Cxx_in_vvtc_den_tgt_sp_1 "RST controller parameter used for the calculation of the target setpoint" VALUE 0xa0021822 _REC_S1VAL_20_u2 255.99609375 _CNV_A_R_LINEAR_____431_CM 0. 255.99609375 FORMAT "%9.8" /end CHARACTERISTIC
/begin CHARACTERISTIC Cxx_in_vvtc_ftc_vb "Time constante for filtering battery voltage" VALUE 0xa0021824 _REC_S1VAL_20_u2 65.535 _CNV_A_R_LINEAR_____116_CM 0. 65.535 /end CHARACTERISTIC
/begin CHARACTERISTIC Cxx_in_vvtc_h_psn_thd_ol_cl "High position threshold for which closed loop control = 100%" VALUE 0xa0021826 _REC_S1VAL_20_u2 719.98 _CNV_A_R_LINEAR_____129_CM 0. 719.98 FORMAT "%6.2" /end CHARACTERISTIC
/begin CHARACTERISTIC Cxx_in_vvtc_int_max_thd "Maximum integral value to end integral learning" VALUE 0xa0021828 _REC_S1VAL_20_u2 200. _CNV_A_R_LINEAR_____146_CM 0. 200. FORMAT "%6.2" /end CHARACTERISTIC
/begin CHARACTERISTIC Cxx_in_vvtc_int_val "Initial value of the integral terme when integral learning is disable" VALUE 0xa002182a _REC_S1VAL_20_u2 200. _CNV_A_R_LINEAR_____146_CM 0. 200. FORMAT "%6.2" /end CHARACTERISTIC
/begin CHARACTERISTIC Cxx_in_vvtc_int_val_inc "Value of the increment " VALUE 0xa002182c _REC_S1VAL_20_u2 200. _CNV_A_R_LINEAR_____146_CM 0. 200. FORMAT "%6.2" /end CHARACTERISTIC
/begin CHARACTERISTIC Cxx_in_vvtc_int_val_ini "Initial value of the integral terme before learning" VALUE 0xa002182e _REC_S1VAL_20_u2 200. _CNV_A_R_LINEAR_____146_CM 0. 200. FORMAT "%6.2" /end CHARACTERISTIC
/begin CHARACTERISTIC Cxx_in_vvtc_l_psn_thd_ol_cl "low position threshold for which closed loop control = 0%" VALUE 0xa0021830 _REC_S1VAL_20_u2 719.98 _CNV_A_R_LINEAR_____129_CM 0. 719.98 FORMAT "%6.2" /end CHARACTERISTIC
/begin CHARACTERISTIC Cxx_in_vvtc_lck_cyc_t_1 "Time of the rising slope of the specific RCO for unlocking strategy" VALUE 0xa0021832 _REC_S1VAL_20_u2 65.535 _CNV_A_R_LINEAR_____116_CM 0. 65.535 FORMAT "%5.3" /end CHARACTERISTIC
/begin CHARACTERISTIC Cxx_in_vvtc_lck_cyc_t_2 "Time of the decreasing slope of the specific RCO for unlocking strategy" VALUE 0xa0021834 _REC_S1VAL_20_u2 65.535 _CNV_A_R_LINEAR_____116_CM 0. 65.535 FORMAT "%5.3" /end CHARACTERISTIC
/begin CHARACTERISTIC Cxx_in_vvtc_mov_det_thd "Threshold to detect actuator movement" VALUE 0xa0021836 _REC_S1VAL_20_u2 719.98 _CNV_A_R_LINEAR_____129_CM 0. 719.98 FORMAT "%6.2" /end CHARACTERISTIC
/begin CHARACTERISTIC Cxx_in_vvtc_nom_vb "Nominal value of battery voltage " VALUE 0xa0021838 _REC_S1VAL_20_u2 60. _CNV_A_R_LINEAR_____205_CM 0. 60. FORMAT "%5.2" /end CHARACTERISTIC
/begin CHARACTERISTIC Cxx_in_vvtc_num_cl_cps_0 "RST controller parameter used for the calculation of the closed loop compensation" VALUE 0xa002183a _REC_S1VAL_20_u2 511.99 _CNV_A_R_LINEAR_____432_CM 0. 511.99 FORMAT "%9.8" /end CHARACTERISTIC
/begin CHARACTERISTIC Cxx_in_vvtc_num_cl_cps_1 "RST controller parameter used for the calculation of the closed loop compensation" VALUE 0xa002183c _REC_S1VAL_20_u2 15.999755859375 _CNV_A_R_LINEAR_____425_CM -8. 7.999755859375 FORMAT "%10.8" /end CHARACTERISTIC
/begin CHARACTERISTIC Cxx_in_vvtc_num_pcmd_0 "RST controller parameter used for the calculation of the feedforward control" VALUE 0xa002183e _REC_S1VAL_20_s2 511.99609375 _CNV_A_R_LINEAR_____433_CM -256. 255.99609375 FORMAT "%9.8" /end CHARACTERISTIC
/begin CHARACTERISTIC Cxx_in_vvtc_num_pcmd_1 "RST controller parameter used for the calculation of the feedforward control" VALUE 0xa0021840 _REC_S1VAL_20_s2 511.99609375 _CNV_A_R_LINEAR_____434_CM -256. 255.99609375 FORMAT "%9.8" /end CHARACTERISTIC
/begin CHARACTERISTIC Cxx_in_vvtc_num_pcmd_2 "RST controller parameter used for the calculation of the feedforward control" VALUE 0xa0021842 _REC_S1VAL_20_u2 15.999755859375 _CNV_A_R_LINEAR_____435_CM 0. 15.999755859375 FORMAT "%6.2" /end CHARACTERISTIC
/begin CHARACTERISTIC Cxx_in_vvtc_num_tgt_sp_0 "RST controller parameter used for the calculation of the target setpoint" VALUE 0xa0021844 _REC_S1VAL_20_u2 2047.96875 _CNV_A_R_LINEAR_____436_CM 0. 2047.96875 FORMAT "%9.8" /end CHARACTERISTIC
/begin CHARACTERISTIC Cxx_in_vvtc_num_tgt_sp_1 "RST controller parameter used for the calculation of the target setpoint" VALUE 0xa0021846 _REC_S1VAL_20_s2 255.99609375 _CNV_A_R_LINEAR_____431_CM -128. 127.99609375 FORMAT "%9.8" /end CHARACTERISTIC
/begin CHARACTERISTIC Cxx_in_vvtc_num_tgt_sp_2 "RST controller parameter used for the calculation of the target setpoint" VALUE 0xa0021848 _REC_S1VAL_20_u2 15.999755859375 _CNV_A_R_LINEAR_____422_CM 0. 15.999755859375 FORMAT "%11.8" /end CHARACTERISTIC
/begin CHARACTERISTIC Cxx_in_vvtc_pwm_bch "Value of PWM control applied in open loop" VALUE 0xa002184a _REC_S1VAL_20_u2 200. _CNV_A_R_LINEAR_____146_CM 0. 200. FORMAT "%6.2" /end CHARACTERISTIC
/begin CHARACTERISTIC Cxx_in_vvtc_t_sldv_cln_cyc "Maximum duration between two intake camshaft events" VALUE 0xa002184c _REC_S1VAL_20_u2 655.35 _CNV_A_R_LINEAR_____32_CM 0. 655.35 FORMAT "%6.2" /end CHARACTERISTIC
/begin CHARACTERISTIC Cxx_in_vvtc_t_sldv_cln_cyc_on "Duration of the solenoid valve autocleaning period while the PWM control is 100%" VALUE 0xa002184e _REC_S1VAL_20_u2 65.535 _CNV_A_R_LINEAR_____116_CM 0. 65.535 /end CHARACTERISTIC
/begin CHARACTERISTIC Cxx_in_vvtc_tgt_sp_ftc "Target setpoint from first order filter for the closed loop control of the VVTC angular position" VALUE 0xa0021850 _REC_S1VAL_20_u2 65.535 _CNV_A_R_LINEAR_____116_CM 0. 65.535 FORMAT "%5.3" /end CHARACTERISTIC
/begin CHARACTERISTIC Cbx_in_vvtc_lck_cfm "Configuration of the unlocking strategy mode (1 : present / 0 : missing)" VALUE 0xa00218a9 _REC_S1VAL_20_u1 1. _CNV_A_R_ECME_LINEA_0_CM 0. 1. FORMAT "%1.0" BIT_MASK 0x1 /end CHARACTERISTIC
/begin MEASUREMENT Vbx_in_vvtc_cdt_ena_lck "Unlocking strategy mode allowed by engine conditions" UBYTE _CNV_S_2_RANGE______3_CM 1 0. 0. 1. ECU_ADDRESS 0xd0006dfe BIT_MASK 0x1 /end MEASUREMENT
/begin MEASUREMENT Vbx_in_vvtc_ena_lck "All conditions gathered enabling the camshaft wheel unlocking strategy mode" UBYTE _CNV_S_2_RANGE______3_CM 1 0. 0. 1. ECU_ADDRESS 0xd0006dff BIT_MASK 0x1 /end MEASUREMENT
/begin MEASUREMENT Vbx_in_vvtc_ena_lck_act "Allow VVTC unlocking strategy mode" UBYTE _CNV_S_2_RANGE______3_CM 1 0. 0. 1. ECU_ADDRESS 0xd0006e00 BIT_MASK 0x1 /end MEASUREMENT
/begin MEASUREMENT Vbx_in_vvtc_vvtc_lck "Information the VVTC is locked in its default position" UBYTE _CNV_S_2_RANGE______3_CM 1 0. 0. 1. ECU_ADDRESS 0xd0006e01 BIT_MASK 0x1 /end MEASUREMENT
/begin CHARACTERISTIC Cbx_diag_in_vvtc_ena_lck "Allow to application of the unlocking strategyt during the activation of the VVTC actuation tests (after sale routine)" VALUE 0xa00218a6 _REC_S1VAL_20_u1 1. _CNV_A_R_ECME_LINEA_0_CM 0. 1. FORMAT "%1.0" BIT_MASK 0x1 /end CHARACTERISTIC
/begin CHARACTERISTIC Cbx_in_vvtc_lck_cho_tco_toil "Select coolant or oil temperature to determine the activation/deactivation condition of the VVTC unlocking strategy mode" VALUE 0xa00218a7 _REC_S1VAL_20_u1 1. _CNV_A_R_ECME_LINEA_0_CM 0. 1. FORMAT "%1.0" BIT_MASK 0x1 /end CHARACTERISTIC
/begin CHARACTERISTIC Cxx_in_vvtc_lck_cyc_nr "Number of the PWM phases for the VVTC unlocking strategy mode" VALUE 0xa00218a8 _REC_S1VAL_20_u1 25. _CNV_A_R_ECME_LINEA_0_CM 0. 25. FORMAT "%3.0" /end CHARACTERISTIC
/begin CHARACTERISTIC Cxx_in_vvtc_lck_load_h_thd "Traget torque ratio upper limit enabling the unlocking strategy mode" VALUE 0xa0021894 _REC_S1VAL_20_u2 1. _CNV_A_R_LINEAR_____183_CM 0. 1. FORMAT "%11.9" /end CHARACTERISTIC
/begin CHARACTERISTIC Cxx_in_vvtc_lck_load_l_thd "Traget torque ratio lower limit enabling the unlocking strategy mode" VALUE 0xa0021896 _REC_S1VAL_20_u2 1. _CNV_A_R_LINEAR_____183_CM 0. 1. FORMAT "%11.9" /end CHARACTERISTIC
/begin CHARACTERISTIC Cxx_in_vvtc_lck_n_h_thd "Engine speed upper limit enabling the unlocking strategy mode" VALUE 0xa0021898 _REC_S1VAL_20_u2 16383.75 _CNV_A_R_ENSD_LINEA_22_CM 0. 16383.75 FORMAT "%8.2" /end CHARACTERISTIC
/begin CHARACTERISTIC Cxx_in_vvtc_lck_n_l_thd "Engine speed lower limit enabling the unlocking strategy mode" VALUE 0xa002189a _REC_S1VAL_20_u2 16383.75 _CNV_A_R_ENSD_LINEA_22_CM 0. 16383.75 FORMAT "%8.2" /end CHARACTERISTIC
/begin CHARACTERISTIC Cxx_in_vvtc_lck_t_mes "Duration confirm the VVTC is locked in its default position" VALUE 0xa002189c _REC_S1VAL_20_u2 6553.5 _CNV_A_R_LINEAR_____58_CM 0. 6553.5 FORMAT "%6.1" /end CHARACTERISTIC
/begin CHARACTERISTIC Cxx_in_vvtc_lck_temp_h_thd "Oil and Coolant Temperature upper limit enabling the unlocking strategy mode" VALUE 0xa002189e _REC_S1VAL_20_u2 240. _CNV_A_R_LINEAR_____110_CM -40. 200. FORMAT "%5.1" /end CHARACTERISTIC
/begin CHARACTERISTIC Cxx_in_vvtc_lck_temp_l_thd "Oil and Coolant Temperature lower limit enabling the unlocking strategy mode" VALUE 0xa00218a0 _REC_S1VAL_20_u2 240. _CNV_A_R_LINEAR_____110_CM -40. 200. FORMAT "%5.1" /end CHARACTERISTIC
/begin CHARACTERISTIC Cxx_in_vvtc_lck_thd_angl_sp "Angular position setpoint threshold to confirm the lock of the VVT" VALUE 0xa00218a2 _REC_S1VAL_20_u2 719.98 _CNV_A_R_LINEAR_____129_CM 0. 719.98 FORMAT "%6.2" /end CHARACTERISTIC
/begin CHARACTERISTIC Cxx_in_vvtc_lck_thd_dft_psn "Angular VVTC measure threshold to confirm the VVTC is locked in its default position" VALUE 0xa00218a4 _REC_S1VAL_20_u2 719.98 _CNV_A_R_LINEAR_____129_CM 0. 719.98 FORMAT "%6.2" /end CHARACTERISTIC
/begin MEASUREMENT Vbx_df_wgc_oc "Open Circuit of wastegate detected failure" UBYTE _CNV_S_2_RANGE______3_CM 1 0. 0. 1. ECU_ADDRESS 0xd0006531 BIT_MASK 0x1 /end MEASUREMENT
/begin MEASUREMENT Vbx_df_wgc_scg "Short Circuit to ground of wastegate detected failure" UBYTE _CNV_S_2_RANGE______3_CM 1 0. 0. 1. ECU_ADDRESS 0xd0006532 BIT_MASK 0x1 /end MEASUREMENT
/begin MEASUREMENT Vbx_df_wgc_scw "Short Circuit to battery of wastegate detected failure" UBYTE _CNV_S_2_RANGE______3_CM 1 0. 0. 1. ECU_ADDRESS 0xd0006533 BIT_MASK 0x1 /end MEASUREMENT
/begin MEASUREMENT Vbx_diag_ena_wgc_oc "Open Circuit of wastegate diagnosis information available" UBYTE _CNV_S_2_RANGE______3_CM 1 0. 0. 1. ECU_ADDRESS 0xd0006534 BIT_MASK 0x1 /end MEASUREMENT
/begin MEASUREMENT Vbx_diag_ena_wgc_scg "Short Circuit to ground of wastegate diagnosis information available" UBYTE _CNV_S_2_RANGE______3_CM 1 0. 0. 1. ECU_ADDRESS 0xd0006535 BIT_MASK 0x1 /end MEASUREMENT
/begin MEASUREMENT Vbx_diag_ena_wgc_scw "Short Circuit to battery of wastegate diagnosis information available" UBYTE _CNV_S_2_RANGE______3_CM 1 0. 0. 1. ECU_ADDRESS 0xd0006536 BIT_MASK 0x1 /end MEASUREMENT
/begin MEASUREMENT CDN_DIAG_WG "Diagnosis condition for each symptom of WG electrical diagnosis" UBYTE _CNV_A_R_ECME_LINEA_0_CM 1 0. 0. 7. DISPLAY_IDENTIFIER cdn_diag_wg ECU_ADDRESS 0xd0006538 FORMAT "%1.0" /end MEASUREMENT
/begin MEASUREMENT ctr_pulse_wg_dly "Time counter for pulse at key ON" UBYTE _CNV_A_R_LINEAR_____201_CM 1 0. 0. 255. ECU_ADDRESS 0xd0007744 FORMAT "%3.0" /end MEASUREMENT
/begin MEASUREMENT ERR_DIAG_WG "Detected symptom for WG diagnosis" UBYTE _CNV_S_16_RANGE_ERR__206_CM 1 0. 0. 15. DISPLAY_IDENTIFIER err_diag_wg ECU_ADDRESS 0xd0006539 /end MEASUREMENT
/begin MEASUREMENT lv_pulse_wg "Flag to indicate that pulse at key on was done" UBYTE _CNV_S_2_RANGE______3_CM 1 0. 0. 1. ECU_ADDRESS 0xd0006537 BIT_MASK 0x1 /end MEASUREMENT
/begin MEASUREMENT lv_pulse_wg_tmp "Flag to indicate that pulse is working" UBYTE _CNV_S_2_RANGE______3_CM 1 0. 0. 1. ECU_ADDRESS 0xd0007746 BIT_MASK 0x1 /end MEASUREMENT
/begin MEASUREMENT pwm_wg "WG PWM command" UWORD _CNV_A_R_LINEAR_____146_CM 1 0. 0. 100. ECU_ADDRESS 0xd0003f12 FORMAT "%6.2" /end MEASUREMENT
/begin CHARACTERISTIC c_ctr_pulse_wg_dly "Time value for pulse key ON" VALUE 0xa0020b37 _REC_S1VAL_20_u1 255. _CNV_A_R_LINEAR_____201_CM 0. 255. FORMAT "%3.0" /end CHARACTERISTIC
/begin CHARACTERISTIC c_d4ft_ena "Calibration for Turbo configuration = 1" VALUE 0xa0020b38 _REC_S1VAL_20_u1 1. _CNV_S_2_RANGE______3_CM 0. 1. /end CHARACTERISTIC
/begin CHARACTERISTIC c_wgpwm_diag_max_scg "Maximum threshold for SCG diagnosis window" VALUE 0xa0020b04 _REC_S1VAL_20_u2 100. _CNV_A_R_LINEAR_____146_CM 0. 100. FORMAT "%6.2" /end CHARACTERISTIC
/begin CHARACTERISTIC c_wgpwm_diag_min_oc "Minimum threshold for OC diagnosis window" VALUE 0xa0020b06 _REC_S1VAL_20_u2 100. _CNV_A_R_LINEAR_____146_CM 0. 100. FORMAT "%6.2" /end CHARACTERISTIC
/begin CHARACTERISTIC c_wgpwm_diag_min_scp "Minimum threshold for SCP diagnosis window" VALUE 0xa0020b08 _REC_S1VAL_20_u2 100. _CNV_A_R_LINEAR_____146_CM 0. 100. FORMAT "%6.2" /end CHARACTERISTIC
/begin MEASUREMENT Vbx_in_cam_ena_cmp_eprm_psn "Allow comparision between measured angular positions of the camshaft wheel active edges and values stored in Eeprom " UBYTE _CNV_S_2_RANGE______3_CM 1 0. 0. 1. DISPLAY_IDENTIFIER InAsiAei_NVM.Vbx_in_cam_ena_cmp_eprm_psn_NVM ECU_ADDRESS 0xd0002550 BIT_MASK 0x1 /end MEASUREMENT
/begin MEASUREMENT Vxx_in_cam_eprm_psn_redg_0 "Angular position stored in Eeprom for the active edge n°0 (camshaft wheel)" UWORD _CNV_A_R_LINEAR_____129_CM 1 0. 0. 719.98 DISPLAY_IDENTIFIER InAsiAei_NVM.Vxx_in_cam_eprm_psn_redg_0_NVM ECU_ADDRESS 0xd0002552 FORMAT "%6.2" /end MEASUREMENT
/begin MEASUREMENT Vxx_in_cam_eprm_psn_redg_1 "Angular position stored in Eeprom for the active edge n°1 (camshaft wheel)" UWORD _CNV_A_R_LINEAR_____129_CM 1 0. 0. 719.98 DISPLAY_IDENTIFIER InAsiAei_NVM.Vxx_in_cam_eprm_psn_redg_1_NVM ECU_ADDRESS 0xd0002554 FORMAT "%6.2" /end MEASUREMENT
/begin MEASUREMENT Vxx_in_cam_eprm_psn_redg_2 "Angular position stored in Eeprom for the active edge n°2 (camshaft wheel)" UWORD _CNV_A_R_LINEAR_____129_CM 1 0. 0. 719.98 DISPLAY_IDENTIFIER InAsiAei_NVM.Vxx_in_cam_eprm_psn_redg_2_NVM ECU_ADDRESS 0xd0002556 FORMAT "%6.2" /end MEASUREMENT
/begin MEASUREMENT Vxx_in_cam_eprm_psn_redg_3 "Angular position stored in Eeprom for the active edge n°3 (camshaft wheel)" UWORD _CNV_A_R_LINEAR_____129_CM 1 0. 0. 719.98 DISPLAY_IDENTIFIER InAsiAei_NVM.Vxx_in_cam_eprm_psn_redg_3_NVM ECU_ADDRESS 0xd0002558 FORMAT "%6.2" /end MEASUREMENT
/begin AXIS_PTS Ctb_in_cam_angl_redg_n_bkp "Table of engine speed breakpoints used with the cartography Ctp_in_cam_angl_cps" 0xa002b7a0 Vxx_n _REC_A2AXS_20_u2 16383.75 _CNV_A_R_ENSD_LINEA_22_CM 20 0. 16383.75 FORMAT "%8.2" /end AXIS_PTS
/begin CHARACTERISTIC Ctp_in_cam_angl_redg_cps "Cartography used to compensate the engine speed effect on the VVTC angular position" CURVE 0xa002b7cc _REC_A1CUR_20_u2_u2 720. _CNV_A_R_LINEAR_____428_CM -360. 360. FORMAT "%7.2"
 /begin AXIS_DESCR COM_AXIS Vxx_n _CNV_A_R_ENSD_LINEA_22_CM 20 0. 16383.75 FORMAT "%8.2" AXIS_PTS_REF Ctb_in_cam_angl_redg_n_bkp /end AXIS_DESCR
/end CHARACTERISTIC
/begin MEASUREMENT Vbx_df_in_vvtc_ad "VVTC first offset learning detected failure" UBYTE _CNV_S_2_RANGE______3_CM 1 0. 0. 1. ECU_ADDRESS 0xd0006a9b BIT_MASK 0x1 /end MEASUREMENT
/begin MEASUREMENT Vbx_in_cam_ad_whl "Learning of the camshaft wheel finished" UBYTE _CNV_S_2_RANGE______3_CM 1 0. 0. 1. ECU_ADDRESS 0xd0006a9c BIT_MASK 0x1 /end MEASUREMENT
/begin MEASUREMENT Vbx_in_cam_crk_syn "Indicate crankshaft synchronization" UBYTE _CNV_S_2_RANGE______3_CM 1 0. 0. 1. ECU_ADDRESS 0xd0006a9d BIT_MASK 0x1 /end MEASUREMENT
/begin MEASUREMENT Vbx_in_cam_dft_ad_whl "Learning of the camshaft wheel failed" UBYTE _CNV_S_2_RANGE______3_CM 1 0. 0. 1. ECU_ADDRESS 0xd0006a9e BIT_MASK 0x1 /end MEASUREMENT
/begin MEASUREMENT Vbx_in_cam_dft_chr_cam_or_crk "Failure detected on the camshaft or on the crankshaft during camshaft wheel learning" UBYTE _CNV_S_2_RANGE______3_CM 1 0. 0. 1. ECU_ADDRESS 0xd0006a9f BIT_MASK 0x1 /end MEASUREMENT
/begin MEASUREMENT Vbx_in_cam_dft_eprm_cmp "Difference between measured angular positions of the camshaft wheel active edges and values stored in Eeprom" UBYTE _CNV_S_2_RANGE______3_CM 1 0. 0. 1. ECU_ADDRESS 0xd0006aa0 BIT_MASK 0x1 /end MEASUREMENT
/begin MEASUREMENT Vbx_in_cam_dft_phs_ad_whl "Failure detected during the learning stage of the camshaft wheel" UBYTE _CNV_S_2_RANGE______3_CM 1 0. 0. 1. ECU_ADDRESS 0xd0006aa1 BIT_MASK 0x1 /end MEASUREMENT
/begin MEASUREMENT Vbx_in_cam_dft_ref_cmp "Difference between measured angular positions of the camshaft wheel active edges and reference values" UBYTE _CNV_S_2_RANGE______3_CM 1 0. 0. 1. ECU_ADDRESS 0xd0006aa2 BIT_MASK 0x1 /end MEASUREMENT
/begin MEASUREMENT Vbx_in_cam_dsb_ad_whl "Inhib the use of the learned angular positions of the camshaft wheel active edges" UBYTE _CNV_S_2_RANGE______3_CM 1 0. 0. 1. ECU_ADDRESS 0xd0006aa3 BIT_MASK 0x1 /end MEASUREMENT
/begin MEASUREMENT Vbx_in_cam_ena_acq "Enable the learning stage of the camshaft wheel" UBYTE _CNV_S_2_RANGE______3_CM 1 0. 0. 1. ECU_ADDRESS 0xd0006aa4 BIT_MASK 0x1 /end MEASUREMENT
/begin MEASUREMENT Vbx_in_cam_ena_act_test "Allow VVTC open loop control after a first incoherent camshaft wheel learning" UBYTE _CNV_S_2_RANGE______3_CM 1 0. 0. 1. ECU_ADDRESS 0xd0006aa5 BIT_MASK 0x1 /end MEASUREMENT
/begin MEASUREMENT Vbx_in_cam_ena_cmp_ref_psn "Allow comparision between measured angular positions of the camshaft wheel active edges and pre-determined values (reference)" UBYTE _CNV_S_2_RANGE______3_CM 1 0. 0. 1. ECU_ADDRESS 0xd0006aa6 BIT_MASK 0x1 /end MEASUREMENT
/begin MEASUREMENT Vbx_in_cam_ena_diag_ad_whl "Allow diagnosis of the measured angular position of the camshaft wheel active edges" UBYTE _CNV_S_2_RANGE______3_CM 1 0. 0. 1. ECU_ADDRESS 0xd0006aa7 BIT_MASK 0x1 /end MEASUREMENT
/begin MEASUREMENT Vbx_in_cam_ena_new_ad_whl "Allow a new learning of the camshaft wheel active edges (engine running)" UBYTE _CNV_S_2_RANGE______3_CM 1 0. 0. 1. ECU_ADDRESS 0xd0006aa8 BIT_MASK 0x1 /end MEASUREMENT
/begin MEASUREMENT Vbx_in_cam_ena_writ_eprm "Allow the storage in Eeprom of the learned angular positions of camshaft wheel active edges" UBYTE _CNV_S_2_RANGE______3_CM 1 0. 0. 1. ECU_ADDRESS 0xd0006aa9 BIT_MASK 0x1 /end MEASUREMENT
/begin MEASUREMENT Vbx_in_cam_end_acq_phs_ad "Camshaft wheel learning stage finished" UBYTE _CNV_S_2_RANGE______3_CM 1 0. 0. 1. ECU_ADDRESS 0xd0006aaa BIT_MASK 0x1 /end MEASUREMENT
/begin MEASUREMENT Vbx_in_cam_end_act_test "VVTC open loop control after a first incoherent camshaft wheel learning finished" UBYTE _CNV_S_2_RANGE______3_CM 1 0. 0. 1. ECU_ADDRESS 0xd0006aab BIT_MASK 0x1 /end MEASUREMENT
/begin MEASUREMENT Vbx_in_cam_inh_ad_whl "Inhib the learned angular positions of the camshaft wheel active edges" UBYTE _CNV_S_2_RANGE______3_CM 1 0. 0. 1. ECU_ADDRESS 0xd0006aac BIT_MASK 0x1 /end MEASUREMENT
/begin MEASUREMENT Vbx_in_cam_ini_psn_redg "Indicate initialization of the angular position for each active edge of the camshaft wheel" UBYTE _CNV_S_2_RANGE______3_CM 1 0. 0. 1. ECU_ADDRESS 0xd0006aad BIT_MASK 0x1 /end MEASUREMENT
/begin MEASUREMENT Vbx_in_cam_stop_act_test "Open control after first camshaft wheel learning stopped" UBYTE _CNV_S_2_RANGE______3_CM 1 0. 0. 1. ECU_ADDRESS 0xd0006aae BIT_MASK 0x1 /end MEASUREMENT
/begin MEASUREMENT Vbx_in_cam_stop_new_ad_whl "Stop the learning stage of the camshaft wheel (a failure is detected or the VVTC is controlled)" UBYTE _CNV_S_2_RANGE______3_CM 1 0. 0. 1. ECU_ADDRESS 0xd0006aaf BIT_MASK 0x1 /end MEASUREMENT
/begin MEASUREMENT Vbx_in_vvtc_angl_mes_nok "Measured value of the VVTC angular position invalid (out of validity range)" UBYTE _CNV_S_2_RANGE______3_CM 1 0. 0. 1. ECU_ADDRESS 0xd0006ab0 BIT_MASK 0x1 /end MEASUREMENT
/begin MEASUREMENT Vbx_in_vvtc_dft_blk_frst_ad "Detection of a blocking of the VVTC during first camshaft wheel learning (out of the default position)" UBYTE _CNV_S_2_RANGE______3_CM 1 0. 0. 1. ECU_ADDRESS 0xd0006ab1 BIT_MASK 0x1 /end MEASUREMENT
/begin MEASUREMENT Vbx_in_vvtc_dft_mov_fsrt_ad "Detection of a movement of the VVTC during first camshaft wheel learning" UBYTE _CNV_S_2_RANGE______3_CM 1 0. 0. 1. ECU_ADDRESS 0xd0006ab2 BIT_MASK 0x1 /end MEASUREMENT
/begin MEASUREMENT Vbx_in_vvtc_dft_psn "VVTC detected in default position (information used by the basic software for CAM/CRAN coherence diagnosis)" UBYTE _CNV_S_2_RANGE______3_CM 1 0. 0. 1. ECU_ADDRESS 0xd0006ab3 BIT_MASK 0x1 /end MEASUREMENT
/begin MEASUREMENT Vbx_in_vvtc_nul_pwm "Indicate a nul PWM control during the duration Cxx_in_vvtc_t_pwm_nul" UBYTE _CNV_S_2_RANGE______3_CM 1 0. 0. 1. ECU_ADDRESS 0xd0006ab4 BIT_MASK 0x1 /end MEASUREMENT
/begin MEASUREMENT Vsx_in_vvtc_angl_vld "Intake VVTC angle validity status" UBYTE _CNV_S_3_STATUS_OK__213_CM 1 0. 0. 2. ECU_ADDRESS 0xd0006ab5 /end MEASUREMENT
/begin MEASUREMENT Vtx_in_cam_eprm_psn_redg[0] "Vector containing angular positions stored in Eeprom of the camshaft wheel active edges" UWORD _CNV_A_R_LINEAR_____129_CM 1 0. 0. 719.98 ECU_ADDRESS 0xd0005e94 FORMAT "%6.2" /end MEASUREMENT
/begin MEASUREMENT Vtx_in_cam_eprm_psn_redg[1] "Vector containing angular positions stored in Eeprom of the camshaft wheel active edges" UWORD _CNV_A_R_LINEAR_____129_CM 1 0. 0. 719.98 ECU_ADDRESS 0xd0005e96 FORMAT "%6.2" /end MEASUREMENT
/begin MEASUREMENT Vtx_in_cam_eprm_psn_redg[2] "Vector containing angular positions stored in Eeprom of the camshaft wheel active edges" UWORD _CNV_A_R_LINEAR_____129_CM 1 0. 0. 719.98 ECU_ADDRESS 0xd0005e98 FORMAT "%6.2" /end MEASUREMENT
/begin MEASUREMENT Vtx_in_cam_eprm_psn_redg[3] "Vector containing angular positions stored in Eeprom of the camshaft wheel active edges" UWORD _CNV_A_R_LINEAR_____129_CM 1 0. 0. 719.98 ECU_ADDRESS 0xd0005e9a FORMAT "%6.2" /end MEASUREMENT
/begin MEASUREMENT Vtx_in_cam_ini_psn_redg[0] "Initial values of the angular positions of the camshaft wheel active edges " UWORD _CNV_A_R_LINEAR_____129_CM 1 0. 0. 719.98 ECU_ADDRESS 0xd000414c FORMAT "%6.2" /end MEASUREMENT
/begin MEASUREMENT Vtx_in_cam_ini_psn_redg[1] "Initial values of the angular positions of the camshaft wheel active edges " UWORD _CNV_A_R_LINEAR_____129_CM 1 0. 0. 719.98 ECU_ADDRESS 0xd000414e FORMAT "%6.2" /end MEASUREMENT
/begin MEASUREMENT Vtx_in_cam_ini_psn_redg[2] "Initial values of the angular positions of the camshaft wheel active edges " UWORD _CNV_A_R_LINEAR_____129_CM 1 0. 0. 719.98 ECU_ADDRESS 0xd0004150 FORMAT "%6.2" /end MEASUREMENT
/begin MEASUREMENT Vtx_in_cam_ini_psn_redg[3] "Initial values of the angular positions of the camshaft wheel active edges " UWORD _CNV_A_R_LINEAR_____129_CM 1 0. 0. 719.98 ECU_ADDRESS 0xd0004152 FORMAT "%6.2" /end MEASUREMENT
/begin MEASUREMENT Vtx_in_cam_mes_psn_redg[0] "Vector with measured angular positions of the camshaft wheel active edges" UWORD _CNV_A_R_LINEAR_____129_CM 1 0. 0. 719.98 ECU_ADDRESS 0xd0004154 FORMAT "%6.2" /end MEASUREMENT
/begin MEASUREMENT Vtx_in_cam_mes_psn_redg[1] "Vector with measured angular positions of the camshaft wheel active edges" UWORD _CNV_A_R_LINEAR_____129_CM 1 0. 0. 719.98 ECU_ADDRESS 0xd0004156 FORMAT "%6.2" /end MEASUREMENT
/begin MEASUREMENT Vtx_in_cam_mes_psn_redg[2] "Vector with measured angular positions of the camshaft wheel active edges" UWORD _CNV_A_R_LINEAR_____129_CM 1 0. 0. 719.98 ECU_ADDRESS 0xd0004158 FORMAT "%6.2" /end MEASUREMENT
/begin MEASUREMENT Vtx_in_cam_mes_psn_redg[3] "Vector with measured angular positions of the camshaft wheel active edges" UWORD _CNV_A_R_LINEAR_____129_CM 1 0. 0. 719.98 ECU_ADDRESS 0xd000415a FORMAT "%6.2" /end MEASUREMENT
/begin MEASUREMENT Vtx_in_cam_mv_psn_redg[0] "Vector with mean values of the angular positions of the camshaft wheel active edges" UWORD _CNV_A_R_LINEAR_____129_CM 1 0. 0. 719.98 ECU_ADDRESS 0xd000415c FORMAT "%6.2" /end MEASUREMENT
/begin MEASUREMENT Vtx_in_cam_mv_psn_redg[1] "Vector with mean values of the angular positions of the camshaft wheel active edges" UWORD _CNV_A_R_LINEAR_____129_CM 1 0. 0. 719.98 ECU_ADDRESS 0xd000415e FORMAT "%6.2" /end MEASUREMENT
/begin MEASUREMENT Vtx_in_cam_mv_psn_redg[2] "Vector with mean values of the angular positions of the camshaft wheel active edges" UWORD _CNV_A_R_LINEAR_____129_CM 1 0. 0. 719.98 ECU_ADDRESS 0xd0004160 FORMAT "%6.2" /end MEASUREMENT
/begin MEASUREMENT Vtx_in_cam_mv_psn_redg[3] "Vector with mean values of the angular positions of the camshaft wheel active edges" UWORD _CNV_A_R_LINEAR_____129_CM 1 0. 0. 719.98 ECU_ADDRESS 0xd0004162 FORMAT "%6.2" /end MEASUREMENT
/begin MEASUREMENT Vtx_in_cam_sum_psn_redg[0] "Vector with sum of the angular position of each camshaft wheel active edge during learning stage " ULONG _CNV_A_R_LINEAR_____129_CM 1 0. 0. 184320. ECU_ADDRESS 0xd0002678 FORMAT "%4.2" /end MEASUREMENT
/begin MEASUREMENT Vtx_in_cam_sum_psn_redg[1] "Vector with sum of the angular position of each camshaft wheel active edge during learning stage " ULONG _CNV_A_R_LINEAR_____129_CM 1 0. 0. 184320. ECU_ADDRESS 0xd000267c FORMAT "%4.2" /end MEASUREMENT
/begin MEASUREMENT Vtx_in_cam_sum_psn_redg[2] "Vector with sum of the angular position of each camshaft wheel active edge during learning stage " ULONG _CNV_A_R_LINEAR_____129_CM 1 0. 0. 184320. ECU_ADDRESS 0xd0002680 FORMAT "%4.2" /end MEASUREMENT
/begin MEASUREMENT Vtx_in_cam_sum_psn_redg[3] "Vector with sum of the angular position of each camshaft wheel active edge during learning stage " ULONG _CNV_A_R_LINEAR_____129_CM 1 0. 0. 184320. ECU_ADDRESS 0xd0002684 FORMAT "%4.2" /end MEASUREMENT
/begin MEASUREMENT Vxx_in_cam_angl_redg "Angular position of an active edge of the camshaft wheel (obtained from the engine position)" UWORD _CNV_A_R_LINEAR_____129_CM 1 0. 0. 719.98 ECU_ADDRESS 0xd0004164 FORMAT "%6.2" /end MEASUREMENT
/begin MEASUREMENT Vxx_in_cam_ctr "Camshaft wheel tooth counter" UBYTE _CNV_A_R_ECME_LINEA_0_CM 1 0. 0. 3. ECU_ADDRESS 0xd0006ab6 FORMAT "%1.0" /end MEASUREMENT
/begin MEASUREMENT Vxx_in_cam_ctr_dft_psn "Counter of camshaft wheel learning with detection of the VVTC in default position" UBYTE _CNV_A_R_ECME_LINEA_0_CM 1 0. 0. 255. ECU_ADDRESS 0xd0006ab7 FORMAT "%3.0" /end MEASUREMENT
/begin MEASUREMENT Vxx_in_cam_ctr_phs_ad "Camshaft active edges during learning stage" UBYTE _CNV_A_R_ECME_LINEA_0_CM 1 0. 0. 255. ECU_ADDRESS 0xd0006ab8 FORMAT "%3.0" /end MEASUREMENT
/begin MEASUREMENT Vxx_in_cam_ctr_phs_ini_psn_redg "Counter used to detect one revolution of the camshaft during learning stage" UBYTE _CNV_A_R_ECME_LINEA_0_CM 1 0. 0. 3. ECU_ADDRESS 0xd0006ab9 FORMAT "%1.0" /end MEASUREMENT
/begin MEASUREMENT Vxx_in_cam_ctr_rest_ad_whl "Counter of camshaft wheel learning" UBYTE _CNV_A_R_ECME_LINEA_0_CM 1 0. 0. 255. ECU_ADDRESS 0xd0006aba FORMAT "%3.0" /end MEASUREMENT
/begin MEASUREMENT Vxx_in_cam_mes_psn_redg_0 "Measured angular position for active edge n°0 (camshaft wheel)" UWORD _CNV_A_R_LINEAR_____129_CM 1 0. 0. 719.98 ECU_ADDRESS 0xd0004166 FORMAT "%6.2" /end MEASUREMENT
/begin MEASUREMENT Vxx_in_cam_mes_psn_redg_1 "Measured angular position for active edge n°1 (camshaft wheel)" UWORD _CNV_A_R_LINEAR_____129_CM 1 0. 0. 719.98 ECU_ADDRESS 0xd0004168 FORMAT "%6.2" /end MEASUREMENT
/begin MEASUREMENT Vxx_in_cam_mes_psn_redg_2 "Measured angular position for active edge n°2 (camshaft wheel)" UWORD _CNV_A_R_LINEAR_____129_CM 1 0. 0. 719.98 ECU_ADDRESS 0xd000416a FORMAT "%6.2" /end MEASUREMENT
/begin MEASUREMENT Vxx_in_cam_mes_psn_redg_3 "Measured angular position for active edge n°3 (camshaft wheel)" UWORD _CNV_A_R_LINEAR_____129_CM 1 0. 0. 719.98 ECU_ADDRESS 0xd000416c FORMAT "%6.2" /end MEASUREMENT
/begin MEASUREMENT Vxx_in_cam_mv_psn_redg_0 "Mean value of angular position for active edge n°0 (camshaft wheel)" UWORD _CNV_A_R_LINEAR_____129_CM 1 0. 0. 719.98 ECU_ADDRESS 0xd000416e FORMAT "%6.2" /end MEASUREMENT
/begin MEASUREMENT Vxx_in_cam_mv_psn_redg_1 "Mean value of angular position for active edge n°1 (camshaft wheel)" UWORD _CNV_A_R_LINEAR_____129_CM 1 0. 0. 719.98 ECU_ADDRESS 0xd0004170 FORMAT "%6.2" /end MEASUREMENT
/begin MEASUREMENT Vxx_in_cam_mv_psn_redg_2 "Mean value of angular position for active edge n°2 (camshaft wheel)" UWORD _CNV_A_R_LINEAR_____129_CM 1 0. 0. 719.98 ECU_ADDRESS 0xd0004172 FORMAT "%6.2" /end MEASUREMENT
/begin MEASUREMENT Vxx_in_cam_mv_psn_redg_3 "Mean value of angular position for active edge n°3 (camshaft wheel)" UWORD _CNV_A_R_LINEAR_____129_CM 1 0. 0. 719.98 ECU_ADDRESS 0xd0004174 FORMAT "%6.2" /end MEASUREMENT
/begin MEASUREMENT Vxx_in_cam_sum_psn_redg_0 "Sum of the angular positions for active edge n°0 (camshaft wheel)" ULONG _CNV_A_R_LINEAR_____129_CM 1 0. 0. 184320. ECU_ADDRESS 0xd0002688 FORMAT "%4.2" /end MEASUREMENT
/begin MEASUREMENT Vxx_in_cam_sum_psn_redg_1 "Sum of the angular positions for active edge n°1 (camshaft wheel)" ULONG _CNV_A_R_LINEAR_____129_CM 1 0. 0. 184320. ECU_ADDRESS 0xd000268c FORMAT "%4.2" /end MEASUREMENT
/begin MEASUREMENT Vxx_in_cam_sum_psn_redg_2 "Sum of the angular positions for active edge n°2 (camshaft wheel)" ULONG _CNV_A_R_LINEAR_____129_CM 1 0. 0. 184320. ECU_ADDRESS 0xd0002690 FORMAT "%4.2" /end MEASUREMENT
/begin MEASUREMENT Vxx_in_cam_sum_psn_redg_3 "Sum of the angular positions for active edge n°3 (camshaft wheel)" ULONG _CNV_A_R_LINEAR_____129_CM 1 0. 0. 184320. ECU_ADDRESS 0xd0002694 FORMAT "%4.2" /end MEASUREMENT
/begin MEASUREMENT Vxx_in_cam_vvtc_ol_ctl "PWM control applied after first camshaft wheel learning" UWORD _CNV_A_R_LINEAR_____146_CM 1 0. 0. 200. ECU_ADDRESS 0xd0004176 FORMAT "%6.2" /end MEASUREMENT
/begin MEASUREMENT Vxx_in_vvtc_angl "Angular position of the VVTC system (with safe modes)" UWORD _CNV_A_R_LINEAR_____129_CM 1 0. 0. 719.98 ECU_ADDRESS 0xd0004178 FORMAT "%6.2" /end MEASUREMENT
/begin MEASUREMENT Vxx_in_vvtc_angl_fil "Filtered value of the angular position of the VVTC system" UWORD _CNV_A_R_LINEAR_____129_CM 1 0. 0. 719.98 ECU_ADDRESS 0xd000417a FORMAT "%6.2" /end MEASUREMENT
/begin MEASUREMENT Vxx_in_vvtc_angl_ftc "Time constant applied to filter the variable Vxx_in_vvtc_angl_mes_tmp" UWORD _CNV_A_R_LINEAR_____32_CM 1 0. 0. 655.35 ECU_ADDRESS 0xd000417c FORMAT "%6.2" /end MEASUREMENT
/begin MEASUREMENT Vxx_in_vvtc_angl_mes "Angular position of the intake VVTC system (for closed loop control)" UWORD _CNV_A_R_LINEAR_____129_CM 1 0. 0. 719.98 ECU_ADDRESS 0xd000417e FORMAT "%6.2" /end MEASUREMENT
/begin MEASUREMENT Vxx_in_vvtc_angl_mes_tmp "Intermediate variable to determine the angular position of the VVTC system (with safe modes)" UWORD _CNV_A_R_LINEAR_____129_CM 1 0. 0. 719.98 ECU_ADDRESS 0xd0004180 FORMAT "%6.2" /end MEASUREMENT
/begin MEASUREMENT Vxx_in_vvtc_angl_raw "Raw value of the (measured) angular position of the VVTC actuator" SWORD _CNV_A_R_LINEAR_____129_CM 1 0. -360. 360. ECU_ADDRESS 0xd0004182 FORMAT "%7.2" /end MEASUREMENT
/begin MEASUREMENT Vxx_in_vvtc_ctr_dft_blk_frst_ad "Counter of camshaft wheel learning with a detection of a blocked VVTC" UBYTE _CNV_A_R_ECME_LINEA_0_CM 1 0. 0. 255. ECU_ADDRESS 0xd0006abb FORMAT "%3.0" /end MEASUREMENT
/begin MEASUREMENT Vxx_in_vvtc_ctr_mov_phs_ad_whl "Counter of camshaft learning with VVTC movement detected" UBYTE _CNV_A_R_ECME_LINEA_0_CM 1 0. 0. 255. ECU_ADDRESS 0xd0006abc FORMAT "%3.0" /end MEASUREMENT
/begin CHARACTERISTIC Cbx_in_cam_conf_sens_sig "Configuration of the camshaft sensor (= 1 signal reversing/ = 0 none)" VALUE 0xa002122c _REC_S1VAL_20_u1 1. _CNV_S_2_RANGE______3_CM 0. 1. BIT_MASK 0x1 /end CHARACTERISTIC
/begin CHARACTERISTIC Cbx_in_cam_ena_new_eprm_writ "Allow an EEPROM write at each end of Power Latch" VALUE 0xa002122d _REC_S1VAL_20_u1 1. _CNV_S_2_RANGE______3_CM 0. 1. BIT_MASK 0x1 /end CHARACTERISTIC
/begin CHARACTERISTIC Cbx_in_cam_ena_rest_ad_whl "Allow to restart the learning of the angular position of the camshaft wheel active edges (if a failure occurs during the current one)" VALUE 0xa002122e _REC_S1VAL_20_u1 1. _CNV_S_2_RANGE______3_CM 0. 1. BIT_MASK 0x1 /end CHARACTERISTIC
/begin CHARACTERISTIC Cbx_in_cam_forc_ad_whl "Force the learning of the angular positions of the camshaft wheel active edges" VALUE 0xa002122f _REC_S1VAL_20_u1 1. _CNV_S_2_RANGE______3_CM 0. 1. BIT_MASK 0x1 /end CHARACTERISTIC
/begin CHARACTERISTIC Cbx_in_cam_inh_ad_whl "Inhib learning of the camshaft wheel" VALUE 0xa0021230 _REC_S1VAL_20_u1 1. _CNV_S_2_RANGE______3_CM 0. 1. BIT_MASK 0x1 /end CHARACTERISTIC
/begin CHARACTERISTIC Cbx_in_cam_inh_ad_whl_eng_resta "Inhibition of new learnings of the camshaft wheel at engine start when one is stored in EEPROM" VALUE 0xa0021231 _REC_S1VAL_20_u1 1. _CNV_S_2_RANGE______3_CM 0. 1. BIT_MASK 0x1 /end CHARACTERISTIC
/begin CHARACTERISTIC Cbx_in_cam_inh_cmp_aftr_frst_ad "Inhibition of the comparison of measured and reference values when a first storage in Eeprom  is performed" VALUE 0xa0021232 _REC_S1VAL_20_u1 1. _CNV_S_2_RANGE______3_CM 0. 1. BIT_MASK 0x1 /end CHARACTERISTIC
/begin CHARACTERISTIC Cbx_in_vvtc_actr_cfm "Retard/advance actuator configuration(=0 for retard / =1 for advance)" VALUE 0xa0021233 _REC_S1VAL_20_u1 1. _CNV_S_2_RANGE______3_CM 0. 1. BIT_MASK 0x1 /end CHARACTERISTIC
/begin CHARACTERISTIC Ctx_in_cam_ref_psn_redg[0] "Array with the reference (pre-determined) angular positions of the 4 camshaft wheel active edges" VALUE 0xa0021200 _REC_S1VAL_20_u2 719.98 _CNV_A_R_LINEAR_____129_CM 0. 719.98 FORMAT "%6.2" /end CHARACTERISTIC
/begin CHARACTERISTIC Ctx_in_cam_ref_psn_redg[1] "Array with the reference (pre-determined) angular positions of the 4 camshaft wheel active edges" VALUE 0xa0021202 _REC_S1VAL_20_u2 719.98 _CNV_A_R_LINEAR_____129_CM 0. 719.98 FORMAT "%6.2" /end CHARACTERISTIC
/begin CHARACTERISTIC Ctx_in_cam_ref_psn_redg[2] "Array with the reference (pre-determined) angular positions of the 4 camshaft wheel active edges" VALUE 0xa0021204 _REC_S1VAL_20_u2 719.98 _CNV_A_R_LINEAR_____129_CM 0. 719.98 FORMAT "%6.2" /end CHARACTERISTIC
/begin CHARACTERISTIC Ctx_in_cam_ref_psn_redg[3] "Array with the reference (pre-determined) angular positions of the 4 camshaft wheel active edges" VALUE 0xa0021206 _REC_S1VAL_20_u2 719.98 _CNV_A_R_LINEAR_____129_CM 0. 719.98 FORMAT "%6.2" /end CHARACTERISTIC
/begin CHARACTERISTIC Cxx_in_cam_angl_max_flu "Maximum fluctuation on the relative angular position of the VVTC during the learning stage of the camshaft wheel" VALUE 0xa0021208 _REC_S1VAL_20_u2 719.98 _CNV_A_R_LINEAR_____129_CM 0. 719.98 FORMAT "%6.2" /end CHARACTERISTIC
/begin CHARACTERISTIC Cxx_in_cam_angl_redg_shf "Offset to apply on the camshaft wheel actives angular position in order to avoid that the values cross the cranshaft reference position" VALUE 0xa002120a _REC_S1VAL_20_s2 720. _CNV_A_R_LINEAR_____129_CM -360. 360. FORMAT "%7.2" /end CHARACTERISTIC
/begin CHARACTERISTIC Cxx_in_cam_ctr_dft_psn "Number of camshaft wheel learnings before detecting a default position of the VVTC" VALUE 0xa0021234 _REC_S1VAL_20_u1 255. _CNV_A_R_ECME_LINEA_0_CM 0. 255. FORMAT "%3.0" /end CHARACTERISTIC
/begin CHARACTERISTIC Cxx_in_cam_dly_sta_ad_whl "Delay after engine start to allow learning of the angular positions of the camhaft wheel active edges" VALUE 0xa002120c _REC_S1VAL_20_u2 65.535 _CNV_A_R_LINEAR_____116_CM 0. 65.535 FORMAT "%5.3" /end CHARACTERISTIC
/begin CHARACTERISTIC Cxx_in_cam_eprm_psn_dev "Maximum difference between the measured angular positions of the camshaft wheel actives edges and the values stored in Eeprom" VALUE 0xa002120e _REC_S1VAL_20_u2 719.98 _CNV_A_R_LINEAR_____129_CM 0. 719.98 FORMAT "%6.2" /end CHARACTERISTIC
/begin CHARACTERISTIC Cxx_in_cam_max_n_inh_ad_whl "Maximun engine speed to inhib the learning of the camshaft wheel (when engine running)" VALUE 0xa0021210 _REC_S1VAL_20_u2 16383.75 _CNV_A_R_ENSD_LINEA_22_CM 0. 16383.75 FORMAT "%8.2" /end CHARACTERISTIC
/begin CHARACTERISTIC Cxx_in_cam_min_n_ena_ad_whl "Minimum engine speed, after start, to allow the learning of the camshaft wheel" VALUE 0xa0021212 _REC_S1VAL_20_u2 16383.75 _CNV_A_R_ENSD_LINEA_22_CM 0. 16383.75 FORMAT "%8.2" /end CHARACTERISTIC
/begin CHARACTERISTIC Cxx_in_cam_nr_rev "Number of camshaft revolutions (for learning stage)" VALUE 0xa0021235 _REC_S1VAL_20_u1 255. _CNV_A_R_ECME_LINEA_0_CM 0. 255. FORMAT "%3.0" /end CHARACTERISTIC
/begin CHARACTERISTIC Cxx_in_cam_ref_psn_dev "Maximum difference between the measured angular positions of the camshaft wheel actives edges and reference angular positions" VALUE 0xa0021214 _REC_S1VAL_20_u2 719.98 _CNV_A_R_LINEAR_____129_CM 0. 719.98 FORMAT "%6.2" /end CHARACTERISTIC
/begin CHARACTERISTIC Cxx_in_cam_t_new_ad_whl "Minimum period to allow a new learning of the camhaft wheel (with engine running)" VALUE 0xa0021216 _REC_S1VAL_20_u2 655.35 _CNV_A_R_LINEAR_____32_CM 0. 655.35 FORMAT "%6.2" /end CHARACTERISTIC
/begin CHARACTERISTIC Cxx_in_cam_tdc_ctr_0 "TDC counter of tooth (counter = zero) / calibration for CAM counter initialisation" VALUE 0xa0021236 _REC_S1VAL_20_u1 3. _CNV_A_R_ECME_LINEA_0_CM 0. 3. FORMAT "%1.0" /end CHARACTERISTIC
/begin CHARACTERISTIC Cxx_in_cam_tdc_ctr_1 "TDC counter of tooth (counter = one) / calibration for CAM counter initialisation" VALUE 0xa0021237 _REC_S1VAL_20_u1 3. _CNV_A_R_ECME_LINEA_0_CM 0. 3. FORMAT "%1.0" /end CHARACTERISTIC
/begin CHARACTERISTIC Cxx_in_cam_tdc_ctr_2 "TDC counter of tooth (counter = two) / calibration for CAM counter initialisation" VALUE 0xa0021238 _REC_S1VAL_20_u1 3. _CNV_A_R_ECME_LINEA_0_CM 0. 3. FORMAT "%1.0" /end CHARACTERISTIC
/begin CHARACTERISTIC Cxx_in_cam_tdc_ctr_3 "TDC counter of tooth (counter = three) / calibration for CAM counter initialisation" VALUE 0xa0021239 _REC_S1VAL_20_u1 3. _CNV_A_R_ECME_LINEA_0_CM 0. 3. FORMAT "%1.0" /end CHARACTERISTIC
/begin CHARACTERISTIC Cxx_in_cam_vvtc_ol_ctl_inc "Increment of the open control applied after first camshaft wheel learning" VALUE 0xa0021218 _REC_S1VAL_20_u2 200. _CNV_A_R_LINEAR_____146_CM 0. 200. FORMAT "%6.2" /end CHARACTERISTIC
/begin CHARACTERISTIC Cxx_in_vvtc_angl_mes_h_ftc "Time constant for high filtering in steady state of the VVTC angular position" VALUE 0xa002121a _REC_S1VAL_20_u2 655.35 _CNV_A_R_LINEAR_____32_CM 0. 655.35 FORMAT "%6.2" /end CHARACTERISTIC
/begin CHARACTERISTIC Cxx_in_vvtc_angl_mes_l_ftc "Time constant for low filtering in steady state of the VVTC angular position" VALUE 0xa002121c _REC_S1VAL_20_u2 655.35 _CNV_A_R_LINEAR_____32_CM 0. 655.35 FORMAT "%6.2" /end CHARACTERISTIC
/begin CHARACTERISTIC Cxx_in_vvtc_angl_mes_thd "Threshold to consider not valid the measured angular position of the VVTC" VALUE 0xa002121e _REC_S1VAL_20_u2 719.98 _CNV_A_R_LINEAR_____129_CM 0. 719.98 FORMAT "%6.2" /end CHARACTERISTIC
/begin CHARACTERISTIC Cxx_in_vvtc_ctr_dft_blk_fsrt_ad "Number of camshaft wheel learnings allowed with a blocked VVTC before detection of a failure" VALUE 0xa002123a _REC_S1VAL_20_u1 255. _CNV_A_R_ECME_LINEA_0_CM 0. 255. FORMAT "%3.0" /end CHARACTERISTIC
/begin CHARACTERISTIC Cxx_in_vvtc_ctr_mov_phs_ad_whl "Number of camshaft wheel learnings allowed with a VVTC movement before detection of a failure" VALUE 0xa002123b _REC_S1VAL_20_u1 255. _CNV_A_R_ECME_LINEA_0_CM 0. 255. FORMAT "%3.0" /end CHARACTERISTIC
/begin CHARACTERISTIC Cxx_in_vvtc_ftc_trs_thd "Threshold for enabling high filtering of the measured VVTC angular position" VALUE 0xa0021220 _REC_S1VAL_20_u2 719.98 _CNV_A_R_LINEAR_____129_CM 0. 719.98 FORMAT "%6.2" /end CHARACTERISTIC
/begin CHARACTERISTIC Cxx_in_vvtc_sp_ftc "Time constant to filter setpoint (to simulate VVTC transient dynamic)" VALUE 0xa0021222 _REC_S1VAL_20_u2 655.35 _CNV_A_R_LINEAR_____32_CM 0. 655.35 FORMAT "%6.2" /end CHARACTERISTIC
/begin CHARACTERISTIC Cxx_in_vvtc_t_dft_psn "Number of camshaft wheel learnings allowed with a VVTC movement before detection of a failure" VALUE 0xa0021224 _REC_S1VAL_20_u2 655.35 _CNV_A_R_LINEAR_____32_CM 0. 655.35 FORMAT "%6.2" /end CHARACTERISTIC
/begin CHARACTERISTIC Cxx_in_vvtc_t_pwm_nul "Duration without contol of the VVTC (the system can be considered in the default position stopper)" VALUE 0xa0021226 _REC_S1VAL_20_u2 655.35 _CNV_A_R_LINEAR_____32_CM 0. 655.35 FORMAT "%6.2" /end CHARACTERISTIC
/begin CHARACTERISTIC Cxx_in_vvtc_t_vld_dft_psn "Duration to confirm that VVTC is in its default position (information used by the basic software for CAM/CRAN coherence diagnosis)" VALUE 0xa0021228 _REC_S1VAL_20_u2 655.35 _CNV_A_R_LINEAR_____32_CM 0. 655.35 FORMAT "%6.2" /end CHARACTERISTIC
/begin CHARACTERISTIC Cxx_in_vvtc_thd_dft_psn "Threshold on the VVTC measured angular position to determinate the information \"VVTC in default position\"" VALUE 0xa002122a _REC_S1VAL_20_u2 719.98 _CNV_A_R_LINEAR_____129_CM 0. 719.98 FORMAT "%6.2" /end CHARACTERISTIC
/begin AXIS_PTS Ctb_cata_wup_sta_tco "Starting water temperature breakpoints for catalyst warm-up" 0xa0025114 Vxx_sta_tco _REC_A2AXS_20_u2 240. _CNV_A_R_LINEAR_____110_CM 10 -40. 200. FORMAT "%5.1" /end AXIS_PTS
/begin AXIS_PTS Ntb_cata_wup_phs_order "Breakpoints [1 2 3 4 5 6 7 8 9 10 11 12 13 14 15] for the order of the warm-up phases" 0xa0025500 Vxx_cata_wup_phs_nr _REC_A2AXS_20_u1 14. _CNV_A_R_ECME_LINEA_0_CM 15 1. 15. READ_ONLY FORMAT "%3.0" /end AXIS_PTS
/begin AXIS_PTS Ntb_fuel_typ_zon "Breakpoints for the zones of fuel type" 0xa0020cf8 Vsx_wup_fuel_typ _REC_A2AXS_20_u1 2. _CNV_A_R_ECME_LINEA_0_CM 3 1. 3. READ_ONLY FORMAT "%1.0" /end AXIS_PTS
/begin CHARACTERISTIC Cmp_cata_wup_fuel1 "Duration of the warm-up phase function of the initial water temperature in the fuel zone 1" MAP 0xa002512c _REC_A1MAP_20_u2_u1_u2 65535. _CNV_A_R_LINEAR_____101_CM 0. 65535. FORMAT "%5.0"
 /begin AXIS_DESCR COM_AXIS Vxx_cata_wup_phs_nr _CNV_A_R_ECME_LINEA_0_CM 15 1. 15. READ_ONLY FORMAT "%3.0" AXIS_PTS_REF Ntb_cata_wup_phs_order /end AXIS_DESCR
 /begin AXIS_DESCR COM_AXIS Vxx_sta_tco _CNV_A_R_LINEAR_____110_CM 10 -40. 200. FORMAT "%5.1" AXIS_PTS_REF Ctb_cata_wup_sta_tco /end AXIS_DESCR
/end CHARACTERISTIC
/begin CHARACTERISTIC Cmp_cata_wup_fuel2 "Duration of the warm-up phase function of the initial water temperature in the fuel zone 2" MAP 0xa0025258 _REC_A1MAP_20_u2_u1_u2 65535. _CNV_A_R_LINEAR_____101_CM 0. 65535. FORMAT "%5.0"
 /begin AXIS_DESCR COM_AXIS Vxx_cata_wup_phs_nr _CNV_A_R_ECME_LINEA_0_CM 15 1. 15. READ_ONLY FORMAT "%3.0" AXIS_PTS_REF Ntb_cata_wup_phs_order /end AXIS_DESCR
 /begin AXIS_DESCR COM_AXIS Vxx_sta_tco _CNV_A_R_LINEAR_____110_CM 10 -40. 200. FORMAT "%5.1" AXIS_PTS_REF Ctb_cata_wup_sta_tco /end AXIS_DESCR
/end CHARACTERISTIC
/begin CHARACTERISTIC Cmp_cata_wup_fuel3 "Duration of the warm-up phase function of the initial water temperature in the fuel zone 3" MAP 0xa0025384 _REC_A1MAP_20_u2_u1_u2 65535. _CNV_A_R_LINEAR_____101_CM 0. 65535. FORMAT "%5.0"
 /begin AXIS_DESCR COM_AXIS Vxx_cata_wup_phs_nr _CNV_A_R_ECME_LINEA_0_CM 15 1. 15. READ_ONLY FORMAT "%3.0" AXIS_PTS_REF Ntb_cata_wup_phs_order /end AXIS_DESCR
 /begin AXIS_DESCR COM_AXIS Vxx_sta_tco _CNV_A_R_LINEAR_____110_CM 10 -40. 200. FORMAT "%5.1" AXIS_PTS_REF Ctb_cata_wup_sta_tco /end AXIS_DESCR
/end CHARACTERISTIC
/begin CHARACTERISTIC Ctd_cata_wup_phs_fuel1 "Order of catalyst warm-up phases in fuel zone 1 for a start at 20 C" CURVE 0xa00254b0 _REC_A1CUR_20_u1_u1 70. _CNV_A_R_LINEAR_____437_CM 0. 70. FORMAT "%2.0"
 /begin AXIS_DESCR COM_AXIS Vxx_cata_wup_phs_nr _CNV_A_R_ECME_LINEA_0_CM 15 1. 15. READ_ONLY FORMAT "%3.0" AXIS_PTS_REF Ntb_cata_wup_phs_order /end AXIS_DESCR
/end CHARACTERISTIC
/begin CHARACTERISTIC Ctd_cata_wup_phs_fuel1_cold "Order of catalyst warm-up phases in fuel zone 1 for a start at -7 C" CURVE 0xa00254c0 _REC_A1CUR_20_u1_u1 70. _CNV_A_R_LINEAR_____437_CM 0. 70. FORMAT "%2.0"
 /begin AXIS_DESCR COM_AXIS Vxx_cata_wup_phs_nr _CNV_A_R_ECME_LINEA_0_CM 15 1. 15. READ_ONLY FORMAT "%3.0" AXIS_PTS_REF Ntb_cata_wup_phs_order /end AXIS_DESCR
/end CHARACTERISTIC
/begin CHARACTERISTIC Ctd_cata_wup_phs_fuel2 "Order of catalyst warm-up phases in fuel zone 2 for a start at 20 C" CURVE 0xa00254d0 _REC_A1CUR_20_u1_u1 70. _CNV_A_R_LINEAR_____437_CM 0. 70. FORMAT "%2.0"
 /begin AXIS_DESCR COM_AXIS Vxx_cata_wup_phs_nr _CNV_A_R_ECME_LINEA_0_CM 15 1. 15. READ_ONLY FORMAT "%3.0" AXIS_PTS_REF Ntb_cata_wup_phs_order /end AXIS_DESCR
/end CHARACTERISTIC
/begin CHARACTERISTIC Ctd_cata_wup_phs_fuel2_cold "Order of catalyst warm-up phases in fuel zone 2 for a start at -7 C" CURVE 0xa00254e0 _REC_A1CUR_20_u1_u1 70. _CNV_A_R_LINEAR_____437_CM 0. 70. FORMAT "%2.0"
 /begin AXIS_DESCR COM_AXIS Vxx_cata_wup_phs_nr _CNV_A_R_ECME_LINEA_0_CM 15 1. 15. READ_ONLY FORMAT "%3.0" AXIS_PTS_REF Ntb_cata_wup_phs_order /end AXIS_DESCR
/end CHARACTERISTIC
/begin CHARACTERISTIC Ctd_cata_wup_phs_fuel3 "Order of catalyst warm-up phases in fuel zone 3" CURVE 0xa00254f0 _REC_A1CUR_20_u1_u1 70. _CNV_A_R_LINEAR_____437_CM 0. 70. FORMAT "%2.0"
 /begin AXIS_DESCR COM_AXIS Vxx_cata_wup_phs_nr _CNV_A_R_ECME_LINEA_0_CM 15 1. 15. READ_ONLY FORMAT "%3.0" AXIS_PTS_REF Ntb_cata_wup_phs_order /end AXIS_DESCR
/end CHARACTERISTIC
/begin MEASUREMENT Vbx_cata_rich_dstb_efv "richness distribution between cylinders is enabled" UBYTE _CNV_S_2_RANGE______3_CM 1 0. 0. 1. ECU_ADDRESS 0xd000772c BIT_MASK 0x1 /end MEASUREMENT
/begin MEASUREMENT Vbx_cata_wup_phs_cge "Detection of change of warm-up phase" UBYTE _CNV_S_2_RANGE______3_CM 1 0. 0. 1. ECU_ADDRESS 0xd000772d BIT_MASK 0x1 /end MEASUREMENT
/begin MEASUREMENT Vsx_cata_wup_phs "State of catalist warm-up" UBYTE _CNV_A_R_ECME_LINEA_0_CM 1 0. 0. 70. ECU_ADDRESS 0xd00064c3 FORMAT "%3.0" /end MEASUREMENT
/begin MEASUREMENT Vsx_cata_wup_phs_req "Requested state of catalyst warm-up" UBYTE _CNV_A_R_ECME_LINEA_0_CM 1 0. 0. 70. ECU_ADDRESS 0xd000772e FORMAT "%3.0" /end MEASUREMENT
/begin MEASUREMENT Vxx_cata_wup_ctr "TDC counter used to manage warm up sequences." UWORD _CNV_A_R_LINEAR_____101_CM 1 0. 0. 65535. ECU_ADDRESS 0xd0003ea2 FORMAT "%5.0" /end MEASUREMENT
/begin MEASUREMENT Vxx_cata_wup_ctr_clc "TDC counter which represents the duration of each warm-up phase" UWORD _CNV_A_R_LINEAR_____101_CM 1 0. 0. 65535. ECU_ADDRESS 0xd00050dc FORMAT "%5.0" /end MEASUREMENT
/begin MEASUREMENT Vxx_cata_wup_phs_ctr "Total duration of the current warm-up phase" UWORD _CNV_A_R_LINEAR_____101_CM 1 0. 0. 65535. ECU_ADDRESS 0xd00050de FORMAT "%5.0" /end MEASUREMENT
/begin MEASUREMENT Vxx_cata_wup_phs_nr "Number of the current warm-up phase" UBYTE _CNV_A_R_ECME_LINEA_0_CM 1 0. 1. 15. ECU_ADDRESS 0xd000772f FORMAT "%3.0" /end MEASUREMENT
/begin CHARACTERISTIC Cbx_cata_wup_vvt_on "Activation of VVT strategy linked to catalyst warm-up" VALUE 0xa0020cfc _REC_S1VAL_20_u1 1. _CNV_S_2_RANGE______3_CM 0. 1. BIT_MASK 0x1 /end CHARACTERISTIC
/begin CHARACTERISTIC Cbx_wup_stop_ac "To authorize the exit ot the catalyst warm-up sequences on air conditioning request" VALUE 0xa0020cfd _REC_S1VAL_20_u1 1. _CNV_S_2_RANGE______3_CM 0. 1. BIT_MASK 0x1 /end CHARACTERISTIC
/begin CHARACTERISTIC Cxx_cata_wup_dstb_n_max1 "Maximun engine speed inhibiting the richness distribution for fuel zone 1" VALUE 0xa0020ce0 _REC_S1VAL_20_u2 16383.75 _CNV_A_R_ENSD_LINEA_22_CM 0. 16383.75 FORMAT "%8.2" /end CHARACTERISTIC
/begin CHARACTERISTIC Cxx_cata_wup_dstb_n_max2 "Maximun engine speed inhibiting the richness distribution for fuel zone 2" VALUE 0xa0020ce2 _REC_S1VAL_20_u2 16383.75 _CNV_A_R_ENSD_LINEA_22_CM 0. 16383.75 FORMAT "%8.2" /end CHARACTERISTIC
/begin CHARACTERISTIC Cxx_cata_wup_dstb_n_max3 "Maximun engine speed inhibiting the richness distribution for fuel zone 3" VALUE 0xa0020ce4 _REC_S1VAL_20_u2 16383.75 _CNV_A_R_ENSD_LINEA_22_CM 0. 16383.75 FORMAT "%8.2" /end CHARACTERISTIC
/begin CHARACTERISTIC Cxx_cata_wup_dstb_ofs1 "Offset to substract from the duration of the richness distribution phase when idle speed is active for fuel zone 1" VALUE 0xa0020ce6 _REC_S1VAL_20_u2 65535. _CNV_A_R_LINEAR_____101_CM 0. 65535. FORMAT "%5.0" /end CHARACTERISTIC
/begin CHARACTERISTIC Cxx_cata_wup_dstb_ofs2 "Offset to substract from the duration of the richness distribution phase when idle speed is active for fuel zone 2" VALUE 0xa0020ce8 _REC_S1VAL_20_u2 65535. _CNV_A_R_LINEAR_____101_CM 0. 65535. FORMAT "%5.0" /end CHARACTERISTIC
/begin CHARACTERISTIC Cxx_cata_wup_dstb_ofs3 "Offset to substract from the duration of the richness distribution phase when idle speed is active for fuel zone 3" VALUE 0xa0020cea _REC_S1VAL_20_u2 65535. _CNV_A_R_LINEAR_____101_CM 0. 65535. FORMAT "%5.0" /end CHARACTERISTIC
/begin CHARACTERISTIC Cxx_cata_wup_dstb_prs_max1 "Maximal manifold pressure inhibiting the richness distribution for fuel zone 1" VALUE 0xa0020cec _REC_S1VAL_20_u2 20000. _CNV_A_R_LINEAR_____115_CM 0. 20000. FORMAT "%5.0" /end CHARACTERISTIC
/begin CHARACTERISTIC Cxx_cata_wup_dstb_prs_max2 "Maximal manifold pressure inhibiting the richness distribution for fuel zone 2" VALUE 0xa0020cee _REC_S1VAL_20_u2 20000. _CNV_A_R_LINEAR_____115_CM 0. 20000. FORMAT "%5.0" /end CHARACTERISTIC
/begin CHARACTERISTIC Cxx_cata_wup_dstb_prs_max3 "Maximal manifold pressure inhibiting the richness distribution for fuel zone 3" VALUE 0xa0020cf0 _REC_S1VAL_20_u2 20000. _CNV_A_R_LINEAR_____115_CM 0. 20000. FORMAT "%5.0" /end CHARACTERISTIC
/begin CHARACTERISTIC Cxx_cata_wup_dstb_prs_min1 "Minimal manifold pressure inhibiting the richness distribution for fuel zone 1" VALUE 0xa0020cf2 _REC_S1VAL_20_u2 20000. _CNV_A_R_LINEAR_____115_CM 0. 20000. FORMAT "%5.0" /end CHARACTERISTIC
/begin CHARACTERISTIC Cxx_cata_wup_dstb_prs_min2 "Minimal manifold pressure inhibiting the richness distribution for fuel zone 2" VALUE 0xa0020cf4 _REC_S1VAL_20_u2 20000. _CNV_A_R_LINEAR_____115_CM 0. 20000. FORMAT "%5.0" /end CHARACTERISTIC
/begin CHARACTERISTIC Cxx_cata_wup_dstb_prs_min3 "Minimal manifold pressure inhibiting the richness distribution for fuel zone 3" VALUE 0xa0020cf6 _REC_S1VAL_20_u2 20000. _CNV_A_R_LINEAR_____115_CM 0. 20000. FORMAT "%5.0" /end CHARACTERISTIC
/begin MEASUREMENT Vxx_cata_lbdw_mes_rtn "Backup value of the catalyst diagnostic criteria" UWORD _CNV_A_R_ECME_LINEA_0_CM 1 0. 0. 65535. DISPLAY_IDENTIFIER AtCatDgn_NVM.Vxx_cata_lbdw_mes_rtn_NVM ECU_ADDRESS 0xd0003e58 FORMAT "%5.0" /end MEASUREMENT
/begin MEASUREMENT Vxx_cata_fail_thd_rtn "Backup value of the catalyst failure threshold" UBYTE _CNV_A_R_ECME_LINEA_0_CM 1 0. 0. 255. DISPLAY_IDENTIFIER AtCatDgn_NVM.Vxx_cata_fail_thd_rtn_NVM ECU_ADDRESS 0xd0003e5a FORMAT "%3.0" /end MEASUREMENT
/begin MEASUREMENT Vtx_in_mem_cata_cpt[0] "Number of times the system enters in each diagnosis conditions" UWORD _CNV_A_R_ECME_LINEA_0_CM 1 0. 0. 65535. DISPLAY_IDENTIFIER AtCatDgn_NVM.Vtx_in_mem_cata_cpt_NVM[0] ECU_ADDRESS 0xd0003e5c FORMAT "%5.0" /end MEASUREMENT
/begin MEASUREMENT Vtx_in_mem_cata_cpt[1] "Number of times the system enters in each diagnosis conditions" UWORD _CNV_A_R_ECME_LINEA_0_CM 1 0. 0. 65535. DISPLAY_IDENTIFIER AtCatDgn_NVM.Vtx_in_mem_cata_cpt_NVM[1] ECU_ADDRESS 0xd0003e5e FORMAT "%5.0" /end MEASUREMENT
/begin MEASUREMENT Vtx_in_mem_cata_cpt[2] "Number of times the system enters in each diagnosis conditions" UWORD _CNV_A_R_ECME_LINEA_0_CM 1 0. 0. 65535. DISPLAY_IDENTIFIER AtCatDgn_NVM.Vtx_in_mem_cata_cpt_NVM[2] ECU_ADDRESS 0xd0003e60 FORMAT "%5.0" /end MEASUREMENT
/begin MEASUREMENT Vtx_in_mem_cata_cpt[3] "Number of times the system enters in each diagnosis conditions" UWORD _CNV_A_R_ECME_LINEA_0_CM 1 0. 0. 65535. DISPLAY_IDENTIFIER AtCatDgn_NVM.Vtx_in_mem_cata_cpt_NVM[3] ECU_ADDRESS 0xd0003e62 FORMAT "%5.0" /end MEASUREMENT
/begin MEASUREMENT Vtx_in_mem_cata_cpt[4] "Number of times the system enters in each diagnosis conditions" UWORD _CNV_A_R_ECME_LINEA_0_CM 1 0. 0. 65535. DISPLAY_IDENTIFIER AtCatDgn_NVM.Vtx_in_mem_cata_cpt_NVM[4] ECU_ADDRESS 0xd0003e64 FORMAT "%5.0" /end MEASUREMENT
/begin MEASUREMENT Vtx_mem_crit_cata_cpt[0] "Number of criteria calculated by resolution" UWORD _CNV_A_R_ECME_LINEA_0_CM 1 0. 0. 65535. DISPLAY_IDENTIFIER AtCatDgn_NVM.Vtx_mem_crit_cata_cpt_NVM[0] ECU_ADDRESS 0xd0003e68 FORMAT "%5.0" /end MEASUREMENT
/begin MEASUREMENT Vtx_mem_crit_cata_cpt[1] "Number of criteria calculated by resolution" UWORD _CNV_A_R_ECME_LINEA_0_CM 1 0. 0. 65535. DISPLAY_IDENTIFIER AtCatDgn_NVM.Vtx_mem_crit_cata_cpt_NVM[1] ECU_ADDRESS 0xd0003e6a FORMAT "%5.0" /end MEASUREMENT
/begin MEASUREMENT Vtx_mem_crit_cata_cpt[2] "Number of criteria calculated by resolution" UWORD _CNV_A_R_ECME_LINEA_0_CM 1 0. 0. 65535. DISPLAY_IDENTIFIER AtCatDgn_NVM.Vtx_mem_crit_cata_cpt_NVM[2] ECU_ADDRESS 0xd0003e6c FORMAT "%5.0" /end MEASUREMENT
/begin MEASUREMENT Vtx_mem_crit_cata_cpt[3] "Number of criteria calculated by resolution" UWORD _CNV_A_R_ECME_LINEA_0_CM 1 0. 0. 65535. DISPLAY_IDENTIFIER AtCatDgn_NVM.Vtx_mem_crit_cata_cpt_NVM[3] ECU_ADDRESS 0xd0003e6e FORMAT "%5.0" /end MEASUREMENT
/begin MEASUREMENT Vtx_mem_crit_cata_cpt[4] "Number of criteria calculated by resolution" UWORD _CNV_A_R_ECME_LINEA_0_CM 1 0. 0. 65535. DISPLAY_IDENTIFIER AtCatDgn_NVM.Vtx_mem_crit_cata_cpt_NVM[4] ECU_ADDRESS 0xd0003e70 FORMAT "%5.0" /end MEASUREMENT
/begin MEASUREMENT Vtx_mem_crit_cata_cpt[5] "Number of criteria calculated by resolution" UWORD _CNV_A_R_ECME_LINEA_0_CM 1 0. 0. 65535. DISPLAY_IDENTIFIER AtCatDgn_NVM.Vtx_mem_crit_cata_cpt_NVM[5] ECU_ADDRESS 0xd0003e72 FORMAT "%5.0" /end MEASUREMENT
/begin MEASUREMENT Vtx_mem_crit_cata_cpt[6] "Number of criteria calculated by resolution" UWORD _CNV_A_R_ECME_LINEA_0_CM 1 0. 0. 65535. DISPLAY_IDENTIFIER AtCatDgn_NVM.Vtx_mem_crit_cata_cpt_NVM[6] ECU_ADDRESS 0xd0003e74 FORMAT "%5.0" /end MEASUREMENT
/begin MEASUREMENT Vtx_out_mem_cata_cpt[0] "Number of times the system quits each diagnosis conditions" UWORD _CNV_A_R_ECME_LINEA_0_CM 1 0. 0. 65535. DISPLAY_IDENTIFIER AtCatDgn_NVM.Vtx_out_mem_cata_cpt_NVM[0] ECU_ADDRESS 0xd0003e78 FORMAT "%5.0" /end MEASUREMENT
/begin MEASUREMENT Vtx_out_mem_cata_cpt[1] "Number of times the system quits each diagnosis conditions" UWORD _CNV_A_R_ECME_LINEA_0_CM 1 0. 0. 65535. DISPLAY_IDENTIFIER AtCatDgn_NVM.Vtx_out_mem_cata_cpt_NVM[1] ECU_ADDRESS 0xd0003e7a FORMAT "%5.0" /end MEASUREMENT
/begin MEASUREMENT Vtx_out_mem_cata_cpt[2] "Number of times the system quits each diagnosis conditions" UWORD _CNV_A_R_ECME_LINEA_0_CM 1 0. 0. 65535. DISPLAY_IDENTIFIER AtCatDgn_NVM.Vtx_out_mem_cata_cpt_NVM[2] ECU_ADDRESS 0xd0003e7c FORMAT "%5.0" /end MEASUREMENT
/begin MEASUREMENT Vtx_out_mem_cata_cpt[3] "Number of times the system quits each diagnosis conditions" UWORD _CNV_A_R_ECME_LINEA_0_CM 1 0. 0. 65535. DISPLAY_IDENTIFIER AtCatDgn_NVM.Vtx_out_mem_cata_cpt_NVM[3] ECU_ADDRESS 0xd0003e7e FORMAT "%5.0" /end MEASUREMENT
/begin MEASUREMENT Vtx_out_mem_cata_cpt[4] "Number of times the system quits each diagnosis conditions" UWORD _CNV_A_R_ECME_LINEA_0_CM 1 0. 0. 65535. DISPLAY_IDENTIFIER AtCatDgn_NVM.Vtx_out_mem_cata_cpt_NVM[4] ECU_ADDRESS 0xd0003e80 FORMAT "%5.0" /end MEASUREMENT
/begin MEASUREMENT Vxx_nr_dc_cdn_ok_cata_cpt_NVM "Number of driving cycle with diagnosis done" UWORD _CNV_A_R_ECME_LINEA_0_CM 1 0. 0. 65535. DISPLAY_IDENTIFIER AtCatDgn_NVM.Vxx_nr_dc_cdn_ok_cata_cpt_NVM ECU_ADDRESS 0xd0003e82 FORMAT "%5.0" /end MEASUREMENT
/begin MEASUREMENT Vxx_t_mv_cdn_ok_cata_cpt_NVM "Average of the maximum durations in diagnosis conditions without diagnosis done" UBYTE _CNV_A_R_LINEAR_____329_CM 1 0. 0. 63.75 DISPLAY_IDENTIFIER AtCatDgn_NVM.Vxx_t_mv_cdn_ok_cata_cpt_NVM ECU_ADDRESS 0xd0003e84 FORMAT "%5.2" /end MEASUREMENT
/begin AXIS_PTS Ntb_cata_maf "17 Break point for the \"Vxx_pump_maf_fil_cata\" interpolation" 0xa0025090 Vxx_pump_maf_fil_cata _REC_A2AXS_20_u2 3000. _CNV_A_R_LINEAR_____172_CM 17 0. 3000. READ_ONLY FORMAT "%4.3" /end AXIS_PTS
/begin CHARACTERISTIC Ctp_cata_lbdw_max_maf "Threshold of fault detection f(Filtered amount of air pumped into cylinder)" CURVE 0xa00250b4 _REC_A1CUR_20_u1_u2 255. _CNV_A_R_ECME_LINEA_0_CM 0. 255. FORMAT "%3.0"
 /begin AXIS_DESCR COM_AXIS Vxx_pump_maf_fil_cata _CNV_A_R_LINEAR_____172_CM 17 0. 3000. READ_ONLY FORMAT "%4.3" AXIS_PTS_REF Ntb_cata_maf /end AXIS_DESCR
/end CHARACTERISTIC
/begin CHARACTERISTIC Ctp_cata_lbdw_max_maf_alco "Threshold of fault detection f(Filtered amount of air pumped into cylinder) in alcohol" CURVE 0xa00250c8 _REC_A1CUR_20_u1_u2 255. _CNV_A_R_ECME_LINEA_0_CM 0. 255. FORMAT "%3.0"
 /begin AXIS_DESCR COM_AXIS Vxx_pump_maf_fil_cata _CNV_A_R_LINEAR_____172_CM 17 0. 3000. READ_ONLY FORMAT "%4.3" AXIS_PTS_REF Ntb_cata_maf /end AXIS_DESCR
/end CHARACTERISTIC
/begin CHARACTERISTIC Ctp_cata_ol_per_dly_maf "Duration of the half periode of the richness at the beginning of the open loop regulation." CURVE 0xa00250dc _REC_A1CUR_20_u1_u2 2.55 _CNV_A_R_LINEAR_____32_CM 0. 2.55 FORMAT "%4.2"
 /begin AXIS_DESCR COM_AXIS Vxx_pump_maf_fil_cata _CNV_A_R_LINEAR_____172_CM 17 0. 3000. READ_ONLY FORMAT "%4.3" AXIS_PTS_REF Ntb_cata_maf /end AXIS_DESCR
/end CHARACTERISTIC
/begin CHARACTERISTIC Ctp_cata_ol_per_dly_maf_alco "Duration of the half periode of the richness at the beginning of the open loop regulation in alcohol" CURVE 0xa00250f0 _REC_A1CUR_20_u2_u2 655.35 _CNV_A_R_LINEAR_____32_CM 0. 655.35 FORMAT "%6.2"
 /begin AXIS_DESCR COM_AXIS Vxx_pump_maf_fil_cata _CNV_A_R_LINEAR_____172_CM 17 0. 3000. READ_ONLY FORMAT "%4.3" AXIS_PTS_REF Ntb_cata_maf /end AXIS_DESCR
/end CHARACTERISTIC
/begin MEASUREMENT Vbx_cata_diag_stop "Catalyst diagnostic is complete" UBYTE _CNV_S_2_RANGE______3_CM 1 0. 0. 1. ECU_ADDRESS 0xd00064b2 BIT_MASK 0x1 /end MEASUREMENT
/begin MEASUREMENT Vbx_cata_dsb_ad_rich "Catalyst diagnostic asks for the inhibition of the richness adaptive" UBYTE _CNV_S_2_RANGE______3_CM 1 0. 0. 1. ECU_ADDRESS 0xd00064b3 BIT_MASK 0x1 /end MEASUREMENT
/begin MEASUREMENT Vbx_cata_dsb_cp "Catalyst diagnostic asks for the inhibition of the canister purge" UBYTE _CNV_S_2_RANGE______3_CM 1 0. 0. 1. ECU_ADDRESS 0xd00064b4 BIT_MASK 0x1 /end MEASUREMENT
/begin MEASUREMENT Vbx_cata_ol_cl_ti_fac "Boolean indicating that catalyst diag takes over richness regulation." UBYTE _CNV_S_2_RANGE______3_CM 1 0. 0. 1. ECU_ADDRESS 0xd00064b5 BIT_MASK 0x1 /end MEASUREMENT
/begin MEASUREMENT Vbx_cata_ol_stop "Command the exit of catalyst diag mode." UBYTE _CNV_S_2_RANGE______3_CM 1 0. 0. 1. ECU_ADDRESS 0xd00064b6 BIT_MASK 0x1 /end MEASUREMENT
/begin MEASUREMENT Vbx_cata_req "OBD Catalyst diagnosis request" UBYTE _CNV_S_2_RANGE______3_CM 1 0. 0. 1. ECU_ADDRESS 0xd00064b7 BIT_MASK 0x1 /end MEASUREMENT
/begin MEASUREMENT Vbx_cata_stab_rich "Richness is stabilized in catalyst window" UBYTE _CNV_S_2_RANGE______3_CM 1 0. 0. 1. ECU_ADDRESS 0xd00064b8 BIT_MASK 0x1 /end MEASUREMENT
/begin MEASUREMENT Vbx_cata_stab_rich_dsb "Impossibility to stabilize richness in catalyst window" UBYTE _CNV_S_2_RANGE______3_CM 1 0. 0. 1. ECU_ADDRESS 0xd00064b9 BIT_MASK 0x1 /end MEASUREMENT
/begin MEASUREMENT Vbx_df_cata_cpt "Lack efficiency of catalyst detected failure" UBYTE _CNV_S_2_RANGE______3_CM 1 0. 0. 1. ECU_ADDRESS 0xd00064ba BIT_MASK 0x1 /end MEASUREMENT
/begin MEASUREMENT Vbx_diag_ena_cata_cpt "Lack efficiency of catalyst diagnostic authorization" UBYTE _CNV_S_2_RANGE______3_CM 1 0. 0. 1. ECU_ADDRESS 0xd00064bb BIT_MASK 0x1 /end MEASUREMENT
/begin MEASUREMENT Vbx_diag_sta_cata_abrt "Catalyst routine aborted status" UBYTE _CNV_S_2_RANGE______3_CM 1 0. 0. 1. ECU_ADDRESS 0xd00064bc BIT_MASK 0x1 /end MEASUREMENT
/begin MEASUREMENT Vbx_diag_sta_cata_ena "Catalyst routine activation status" UBYTE _CNV_S_2_RANGE______3_CM 1 0. 0. 1. ECU_ADDRESS 0xd00064bd BIT_MASK 0x1 /end MEASUREMENT
/begin MEASUREMENT Vbx_diag_sta_cata_end "Catalyst routine completed status" UBYTE _CNV_S_2_RANGE______3_CM 1 0. 0. 1. ECU_ADDRESS 0xd00064be BIT_MASK 0x1 /end MEASUREMENT
/begin MEASUREMENT Vbx_ena_diag_cata "OBD Catalyst diagnosis authorization" UBYTE _CNV_S_2_RANGE______3_CM 1 0. 0. 1. ECU_ADDRESS 0xd00064bf BIT_MASK 0x1 /end MEASUREMENT
/begin MEASUREMENT Vbx_inhi_ena_diag_cata "Inibition condition" UBYTE _CNV_S_2_RANGE______3_CM 1 0. 0. 1. ECU_ADDRESS 0xd00064c0 BIT_MASK 0x1 /end MEASUREMENT
/begin MEASUREMENT Vbx_phy_ena_diag_cata "Physical condition" UBYTE _CNV_S_2_RANGE______3_CM 1 0. 0. 1. ECU_ADDRESS 0xd00064c1 BIT_MASK 0x1 /end MEASUREMENT
/begin MEASUREMENT Vbx_sw_ena_diag_cata "Software condition" UBYTE _CNV_S_2_RANGE______3_CM 1 0. 0. 1. ECU_ADDRESS 0xd00064c2 BIT_MASK 0x1 /end MEASUREMENT
/begin MEASUREMENT Vsx_cata_stt "Catalyst diagnostic states" UBYTE _CNV_A_R_ECME_LINEA_0_CM 1 0. 0. 255. ECU_ADDRESS 0xd00064a7 FORMAT "%3.0" /end MEASUREMENT
/begin MEASUREMENT Vsx_diag_sta_cata_stt "Catalyst routine status" UBYTE _CNV_A_R_ECME_LINEA_0_CM 1 0. 0. 255. ECU_ADDRESS 0xd00064a8 FORMAT "%3.0" /end MEASUREMENT
/begin MEASUREMENT Vxx_cata_asd_diag_ctr "counter of diagnostic in after sales mode" UBYTE _CNV_A_R_ECME_LINEA_0_CM 1 0. 0. 255. ECU_ADDRESS 0xd00064a9 FORMAT "%3.0" /end MEASUREMENT
/begin MEASUREMENT Vxx_cata_asd_sf "Catalyst efficiency for after sale mode" UBYTE _CNV_A_R_ECME_LINEA_0_CM 1 0. 0. 3. ECU_ADDRESS 0xd00064aa FORMAT "%1.0" /end MEASUREMENT
/begin MEASUREMENT Vxx_cata_asd_sf_ctr "Counter of diagnostic result consecutive in the same state for after sale diagnostic" UBYTE _CNV_A_R_ECME_LINEA_0_CM 1 0. 0. 255. ECU_ADDRESS 0xd00064ab FORMAT "%3.0" /end MEASUREMENT
/begin MEASUREMENT Vxx_cata_asd_tout_dly "Timeout for after sale diagnostic if the request can't switch to on" UWORD _CNV_A_R_LINEAR_____32_CM 1 0. 0. 655.35 ECU_ADDRESS 0xd0003e88 FORMAT "%6.2" /end MEASUREMENT
/begin MEASUREMENT Vxx_cata_fail_thd "Value of the catalyst failure threshold" UBYTE _CNV_A_R_ECME_LINEA_0_CM 1 0. 0. 255. ECU_ADDRESS 0xd00064ac FORMAT "%3.0" /end MEASUREMENT
/begin MEASUREMENT Vxx_cata_in_ctr "Counter of transition Nsx_cata_cpt_dg_dsb to Nsx_cata_cpt_stab_cl" UBYTE _CNV_A_R_ECME_LINEA_0_CM 1 0. 0. 255. ECU_ADDRESS 0xd00064ad FORMAT "%3.0" /end MEASUREMENT
/begin MEASUREMENT Vxx_cata_lbdw_h_fil_val "Filtered value of the tension downstream lambda sensor at the beginning of the open loop" UWORD _CNV_A_R_LINEAR_____107_CM 1 0. 0. 25000. ECU_ADDRESS 0xd0003e8a FORMAT "%5.0" /end MEASUREMENT
/begin MEASUREMENT Vxx_cata_lbdw_mes "Value of the catalyst diagnostic criteria" UWORD _CNV_A_R_ECME_LINEA_0_CM 1 0. 0. 65535. ECU_ADDRESS 0xd0003e8c FORMAT "%5.0" /end MEASUREMENT
/begin MEASUREMENT Vxx_cata_mem_ol_cl_ti_fac "Mean value of Vxx_cl_ti_fac at the begining of catalyst diag phase." UWORD _CNV_A_R_LINEAR_____438_CM 1 0. 0.66666667 1.33332316414063 ECU_ADDRESS 0xd0003e8e FORMAT "%10.8" /end MEASUREMENT
/begin MEASUREMENT Vxx_cata_ol_apl "Half amplitude of the richness correction for the open loop regulation" UWORD _CNV_A_R_LINEAR_____167_CM 1 0. 0. 0.333328247070313 ECU_ADDRESS 0xd0003e90 FORMAT "%8.6" /end MEASUREMENT
/begin MEASUREMENT Vxx_cata_ol_mv_cl_ti_fac "Middle value of Vxx_diag_cata_cl_ti_fac which is used for the catalyst diagnosis richness regulation" UWORD _CNV_A_R_LINEAR_____438_CM 1 0. 0.66666667 1.33332316414063 ECU_ADDRESS 0xd0003e92 FORMAT "%10.8" /end MEASUREMENT
/begin MEASUREMENT Vxx_cata_ol_per_ctr "Counter of half periode of the richness correction in the open loop regulation" UBYTE _CNV_A_R_ECME_LINEA_0_CM 1 0. 0. 255. ECU_ADDRESS 0xd00064ae FORMAT "%3.0" /end MEASUREMENT
/begin MEASUREMENT Vxx_cata_ol_per_dly "Timer of the half periode of the richness correction in the open loop regulation" UBYTE _CNV_A_R_LINEAR_____32_CM 1 0. 0. 2.55 ECU_ADDRESS 0xd00064af FORMAT "%4.2" /end MEASUREMENT
/begin MEASUREMENT Vxx_cata_ol_per_dly_clc "Calculation of duration of the half periode of the richness correction at the beginning of the open loop regulation." UBYTE _CNV_A_R_LINEAR_____32_CM 1 0. 0. 2.55 ECU_ADDRESS 0xd00064b0 FORMAT "%4.2" /end MEASUREMENT
/begin MEASUREMENT Vxx_cata_ol_stab_test "Counter of stabilzation attempt of the richness in the catalyst window during open loop regulation" UBYTE _CNV_A_R_ECME_LINEA_0_CM 1 0. 0. 255. ECU_ADDRESS 0xd00064b1 FORMAT "%3.0" /end MEASUREMENT
/begin MEASUREMENT Vxx_cata_stab_dly "Timer for stabilisation in closed loop" UWORD _CNV_A_R_LINEAR_____32_CM 1 0. 0. 655.35 ECU_ADDRESS 0xd0003e94 FORMAT "%6.2" /end MEASUREMENT
/begin MEASUREMENT Vxx_diag_cata_cl_ti_fac "Command value from catalyst diag applied on Vxx_cl_ti_fac. (when diag mode enabled)" UWORD _CNV_A_R_LINEAR_____438_CM 1 0. 0.66666667 1.33332316414063 ECU_ADDRESS 0xd0003e96 FORMAT "%10.8" /end MEASUREMENT
/begin MEASUREMENT Vxx_edic_cata_dly "Timer for minimal waiting between two diagnoses for edic needs" UWORD _CNV_A_R_LINEAR_____32_CM 1 0. 0. 655.35 ECU_ADDRESS 0xd0003e98 FORMAT "%6.2" /end MEASUREMENT
/begin MEASUREMENT Vxx_lbdw_h_lvl_fil_val_prev "Filtered value by the tension of dowstream lambda sensor to judge the level of richness at i-1" UWORD _CNV_A_R_LINEAR_____107_CM 1 0. 0. 25000. ECU_ADDRESS 0xd0003e9a FORMAT "%5.0" /end MEASUREMENT
/begin MEASUREMENT Vxx_lgl_dly_diag_cata "Timer before catalyst diagnosis" UWORD _CNV_A_R_LINEAR_____58_CM 1 0. 0. 6553.5 ECU_ADDRESS 0xd0003e9c FORMAT "%6.1" /end MEASUREMENT
/begin MEASUREMENT Vxx_pump_maf_cata_mem "Amount of air pumped into cylinder memorised for the diagnosis stability ." UWORD _CNV_A_R_LINEAR_____172_CM 1 0. 0. 3000. ECU_ADDRESS 0xd0003e9e FORMAT "%4.3" /end MEASUREMENT
/begin MEASUREMENT Vxx_pump_maf_fil_cata "Filtered amount of air pumped into cylinder for Ctp_cata_ol_per_dly_maf and Ctp_cata_lbdw_max_maf" UWORD _CNV_A_R_LINEAR_____172_CM 1 0. 0. 3000. ECU_ADDRESS 0xd0003ea0 FORMAT "%4.3" /end MEASUREMENT
/begin CHARACTERISTIC Cxx_cata_asd_diag_nr "Maximum number of diagnostic in after sales mode" VALUE 0xa0020cd0 _REC_S1VAL_20_u1 255. _CNV_A_R_ECME_LINEA_0_CM 0. 255. FORMAT "%3.0" /end CHARACTERISTIC
/begin CHARACTERISTIC Cxx_cata_asd_in_nr "Number of attempt for diagnosis in after sales mode" VALUE 0xa0020cd1 _REC_S1VAL_20_u1 255. _CNV_A_R_ECME_LINEA_0_CM 0. 255. FORMAT "%3.0" /end CHARACTERISTIC
/begin CHARACTERISTIC Cxx_cata_asd_sf_nr "Number of diagnostic result consecutive in the same state for after sale diagnostic" VALUE 0xa0020cd2 _REC_S1VAL_20_u1 255. _CNV_A_R_ECME_LINEA_0_CM 0. 255. FORMAT "%3.0" /end CHARACTERISTIC
/begin CHARACTERISTIC Cxx_cata_asd_tout_dly "Value of the timeout for after sale diagnostic if the request can't switch to on" VALUE 0xa0020c9c _REC_S1VAL_20_u2 655.35 _CNV_A_R_LINEAR_____32_CM 0. 655.35 FORMAT "%6.2" /end CHARACTERISTIC
/begin CHARACTERISTIC Cxx_cata_cl_stab_dly_min "Duration for stabilisation in closed loop" VALUE 0xa0020c9e _REC_S1VAL_20_u2 655.35 _CNV_A_R_LINEAR_____32_CM 0. 655.35 FORMAT "%6.2" /end CHARACTERISTIC
/begin CHARACTERISTIC Cxx_cata_diag_gear "Gear engaged ([-1 0 1 2 3 4 5 6]) for catalyst diagnostic autorisation" VALUE 0xa0020cd3 _REC_S1VAL_20_u1 7. _CNV_A_R_LINEAR_____145_CM -1. 6. FORMAT "%2.0" /end CHARACTERISTIC
/begin CHARACTERISTIC Cxx_cata_fuel_typ_rat_max_1 "First maximum rate of exotic fuel to authorize the diagnosis of the catalyst" VALUE 0xa0020ca0 _REC_S1VAL_20_u2 1. _CNV_A_R_LINEAR_____161_CM 0. 1. FORMAT "%5.3" /end CHARACTERISTIC
/begin CHARACTERISTIC Cxx_cata_fuel_typ_rat_max_2 "Second maximum rate of exotic fuel to authorize the diagnosis of the catalyst" VALUE 0xa0020ca2 _REC_S1VAL_20_u2 1. _CNV_A_R_LINEAR_____161_CM 0. 1. FORMAT "%5.3" /end CHARACTERISTIC
/begin CHARACTERISTIC Cxx_cata_fuel_typ_rat_min_1 "First minimum rate of exotic fuel to authorize the diagnosis of the catalyst" VALUE 0xa0020ca4 _REC_S1VAL_20_u2 1. _CNV_A_R_LINEAR_____161_CM 0. 1. FORMAT "%5.3" /end CHARACTERISTIC
/begin CHARACTERISTIC Cxx_cata_fuel_typ_rat_min_2 "Second minimum rate of exotic fuel to authorize the diagnosis of the catalyst" VALUE 0xa0020ca6 _REC_S1VAL_20_u2 1. _CNV_A_R_LINEAR_____161_CM 0. 1. FORMAT "%5.3" /end CHARACTERISTIC
/begin CHARACTERISTIC Cxx_cata_hys_maf "Hysteresis on Amount of air pumped into cylinder for diagnosis conditions" VALUE 0xa0020ca8 _REC_S1VAL_20_u2 3000. _CNV_A_R_LINEAR_____172_CM 0. 3000. FORMAT "%4.3" /end CHARACTERISTIC
/begin CHARACTERISTIC Cxx_cata_hys_n "Hysteresis on engine speed for diagnosis conditions" VALUE 0xa0020caa _REC_S1VAL_20_u2 16383.75 _CNV_A_R_ENSD_LINEA_22_CM 0. 16383.75 FORMAT "%8.2" /end CHARACTERISTIC
/begin CHARACTERISTIC Cxx_cata_in_nr "Number of attempt for diagnosis" VALUE 0xa0020cd4 _REC_S1VAL_20_u1 255. _CNV_A_R_ECME_LINEA_0_CM 0. 255. FORMAT "%3.0" /end CHARACTERISTIC
/begin CHARACTERISTIC Cxx_cata_maf_dif_max "Maximum variation of amount of air pumped into cylinder for diagnosis conditions." VALUE 0xa0020cac _REC_S1VAL_20_u2 3000. _CNV_A_R_LINEAR_____172_CM 0. 3000. FORMAT "%4.3" /end CHARACTERISTIC
/begin CHARACTERISTIC Cxx_cata_maf_max "Maximum value of amount of air pumped into cylinder for diagnosis conditions." VALUE 0xa0020cae _REC_S1VAL_20_u2 3000. _CNV_A_R_LINEAR_____172_CM 0. 3000. FORMAT "%4.3" /end CHARACTERISTIC
/begin CHARACTERISTIC Cxx_cata_maf_mes_max "Maximum drift of air pumped into cylinder for diagnosis condition in open loop regulation" VALUE 0xa0020cb0 _REC_S1VAL_20_u2 3000. _CNV_A_R_LINEAR_____172_CM 0. 3000. FORMAT "%4.3" /end CHARACTERISTIC
/begin CHARACTERISTIC Cxx_cata_maf_min "Minimum value of amount of air pumped into cylinder for diagnosis conditions." VALUE 0xa0020cb2 _REC_S1VAL_20_u2 3000. _CNV_A_R_LINEAR_____172_CM 0. 3000. FORMAT "%4.3" /end CHARACTERISTIC
/begin CHARACTERISTIC Cxx_cata_n_max "Maximum value of engine speed for diagnosis conditions." VALUE 0xa0020cb4 _REC_S1VAL_20_u2 16383.75 _CNV_A_R_ENSD_LINEA_22_CM 0. 16383.75 FORMAT "%8.2" /end CHARACTERISTIC
/begin CHARACTERISTIC Cxx_cata_n_min "Minimum value of engine speed for diagnosis conditions." VALUE 0xa0020cb6 _REC_S1VAL_20_u2 16383.75 _CNV_A_R_ENSD_LINEA_22_CM 0. 16383.75 FORMAT "%8.2" /end CHARACTERISTIC
/begin CHARACTERISTIC Cxx_cata_ofs_neg_1 "First negative offset applied on Vxx_cata_ol_mv_cl_ti_fac" VALUE 0xa0020cd5 _REC_S1VAL_20_u1 0.333323120948235 _CNV_A_R_LINEAR_____439_CM 0.666676879051765 1. FORMAT "%8.7" /end CHARACTERISTIC
/begin CHARACTERISTIC Cxx_cata_ofs_neg_2 "Second negative offset applied on Vxx_cata_ol_mv_cl_ti_fac" VALUE 0xa0020cd6 _REC_S1VAL_20_u1 0.333323120948235 _CNV_A_R_LINEAR_____439_CM 0.666676879051765 1. FORMAT "%8.7" /end CHARACTERISTIC
/begin CHARACTERISTIC Cxx_cata_ofs_ol_lbdw_fil "Offset on Cxx_cata_ol_thd_lbdw_fil" VALUE 0xa0020cb8 _REC_S1VAL_20_u2 25000. _CNV_A_R_LINEAR_____107_CM 0. 25000. FORMAT "%5.0" /end CHARACTERISTIC
/begin CHARACTERISTIC Cxx_cata_ofs_pos_1 "First positive offset applied on Vxx_cata_ol_mv_cl_ti_fac" VALUE 0xa0020cd7 _REC_S1VAL_20_u1 0.3320312999999999 _CNV_A_R_LINEAR_____440_CM 1. 1.3320313 FORMAT "%8.7" /end CHARACTERISTIC
/begin CHARACTERISTIC Cxx_cata_ofs_pos_2 "Second positive offset applied on Vxx_cata_ol_mv_cl_ti_fac" VALUE 0xa0020cd8 _REC_S1VAL_20_u1 0.3320312999999999 _CNV_A_R_LINEAR_____440_CM 1. 1.3320313 FORMAT "%8.7" /end CHARACTERISTIC
/begin CHARACTERISTIC Cxx_cata_ol_apl "Half amplitude of the richness correction for the open loop regulation" VALUE 0xa0020cba _REC_S1VAL_20_u2 0.333333333307501 _CNV_A_R_LINEAR_____441_CM 0. 0.333333333307501 FORMAT "%10.8" /end CHARACTERISTIC
/begin CHARACTERISTIC Cxx_cata_ol_apl_alco "Half amplitude of the richness correction for the open loop regulation in alcohol" VALUE 0xa0020cbc _REC_S1VAL_20_u2 0.333328247070313 _CNV_A_R_LINEAR_____167_CM 0. 0.333328247070313 FORMAT "%8.6" /end CHARACTERISTIC
/begin CHARACTERISTIC Cxx_cata_ol_per_dly_mes "Number of half periode of the richness correction for the open loop regulation in \"Measure state\"" VALUE 0xa0020cd9 _REC_S1VAL_20_u1 255. _CNV_A_R_ECME_LINEA_0_CM 0. 255. FORMAT "%3.0" /end CHARACTERISTIC
/begin CHARACTERISTIC Cxx_cata_ol_per_dly_stab "Number of half periode of the richness correction for the open loop regulation in \"Open loop stabilization state\"" VALUE 0xa0020cda _REC_S1VAL_20_u1 255. _CNV_A_R_ECME_LINEA_0_CM 0. 255. FORMAT "%3.0" /end CHARACTERISTIC
/begin CHARACTERISTIC Cxx_cata_ol_test_max_nr "Maximum number of attempt of stabilisation in open loop regulation" VALUE 0xa0020cdb _REC_S1VAL_20_u1 255. _CNV_A_R_ECME_LINEA_0_CM 0. 255. FORMAT "%3.0" /end CHARACTERISTIC
/begin CHARACTERISTIC Cxx_cata_ol_thd_lbdw_fil "threshold of strong filtering for the open loop regulation" VALUE 0xa0020cbe _REC_S1VAL_20_u2 25000. _CNV_A_R_LINEAR_____107_CM 0. 25000. FORMAT "%5.0" /end CHARACTERISTIC
/begin CHARACTERISTIC Cxx_cata_tco_min "Minimum value of engine coolant temperature for diagnosis conditions." VALUE 0xa0020cc0 _REC_S1VAL_20_u2 240. _CNV_A_R_LINEAR_____110_CM -40. 200. FORMAT "%5.1" /end CHARACTERISTIC
/begin CHARACTERISTIC Cxx_cata_win_max "High threshold of the catalyst windows" VALUE 0xa0020cc2 _REC_S1VAL_20_u2 25000. _CNV_A_R_LINEAR_____107_CM 0. 25000. FORMAT "%5.0" /end CHARACTERISTIC
/begin CHARACTERISTIC Cxx_cata_win_min "low threshold of the catalyst windows" VALUE 0xa0020cc4 _REC_S1VAL_20_u2 25000. _CNV_A_R_LINEAR_____107_CM 0. 25000. FORMAT "%5.0" /end CHARACTERISTIC
/begin CHARACTERISTIC Cxx_conf_diag_cata "Catalyst Diagnostic is: 0=forbidden; 1=conventional mode; 2=bench mode" VALUE 0xa0020cdc _REC_S1VAL_20_u1 3. _CNV_A_R_ECME_LINEA_0_CM 0. 3. FORMAT "%1.0" /end CHARACTERISTIC
/begin CHARACTERISTIC Cxx_dfdec_cata_cpt "Lack efficiency of catalyst detected failure counter decrement" VALUE 0xa0020cc6 _REC_S1VAL_20_u2 65535. _CNV_A_R_ECME_LINEA_0_CM 0. 65535. FORMAT "%5.0" /end CHARACTERISTIC
/begin CHARACTERISTIC Cxx_dfinc_cata_cpt "Lack efficiency of catalyst detected failure counter increment" VALUE 0xa0020cc8 _REC_S1VAL_20_u2 65535. _CNV_A_R_ECME_LINEA_0_CM 0. 65535. FORMAT "%5.0" /end CHARACTERISTIC
/begin CHARACTERISTIC Cxx_diag_sta_cata_lbup_pwt_sp "Powertrain set point requested by Catalyst or Lambda routines" VALUE 0xa0020cca _REC_S1VAL_20_u2 1. _CNV_A_R_LINEAR_____319_CM 0. 1. FORMAT "%8.5" /end CHARACTERISTIC
/begin CHARACTERISTIC Cxx_edic_cata_dly "Minimum duration waiting between two diagnoses for edic needs" VALUE 0xa0020ccc _REC_S1VAL_20_u2 655.35 _CNV_A_R_LINEAR_____32_CM 0. 655.35 FORMAT "%6.2" /end CHARACTERISTIC
/begin CHARACTERISTIC Cxx_ex_gaz_cata_max_temp "Max temp for diagnosis catalys autorisation" VALUE 0xa0020cdd _REC_S1VAL_20_u1 1020. _CNV_A_R_LINEAR_____442_CM -40. 980. FORMAT "%3.0" /end CHARACTERISTIC
/begin CHARACTERISTIC Cxx_ex_gaz_cata_min_temp "Min temp for diagnosis catalys autorisation" VALUE 0xa0020cde _REC_S1VAL_20_u1 1020. _CNV_A_R_LINEAR_____442_CM -40. 980. FORMAT "%3.0" /end CHARACTERISTIC
/begin CHARACTERISTIC Cxx_lgl_dly_diag_cata "Duration before catalyst diagnosis" VALUE 0xa0020cce _REC_S1VAL_20_u2 6553.5 _CNV_A_R_LINEAR_____58_CM 0. 6553.5 FORMAT "%6.1" /end CHARACTERISTIC
/begin MEASUREMENT Vbx_agb_tq_req_full_ctl "Requested AGB torque intervention of full control type (corresponding to shift in progress in M2S)" UBYTE _CNV_S_2_RANGE______3_CM 1 0. 0. 1. ECU_ADDRESS 0xd0006b8c BIT_MASK 0x1 /end MEASUREMENT
/begin MEASUREMENT Vbx_agb_tq_req_h_lim "Requested AGB torque intervention of upper limitation type" UBYTE _CNV_S_2_RANGE______3_CM 1 0. 0. 1. ECU_ADDRESS 0xd0006b8d BIT_MASK 0x1 /end MEASUREMENT
/begin MEASUREMENT Vbx_agb_tq_req_l_lim "Requested AGB torque intervention of lower limitation type" UBYTE _CNV_S_2_RANGE______3_CM 1 0. 0. 1. ECU_ADDRESS 0xd0006b8e BIT_MASK 0x1 /end MEASUREMENT
/begin AXIS_PTS Ctb_agb_tq_csm_is_n_sp "Breakpoint of the final idle speed setpoint" 0xa002d5c4 Vxx_is_n_sp _REC_A2AXS_20_u2 16383.75 _CNV_A_R_ENSD_LINEA_22_CM 5 0. 16383.75 FORMAT "%8.2" /end AXIS_PTS
/begin CHARACTERISTIC Cmp_agb_csm_tq_brk_pdl_cor "Temporary brake torque correction" MAP 0xa002d5d0 _REC_A1MAP_20_u2_u2_u2 2047.96875 _CNV_A_R_LINEAR_____181_CM 0. 2047.96875 FORMAT "%10.5"
 /begin AXIS_DESCR COM_AXIS Vxx_toil _CNV_A_R_LINEAR_____110_CM 16 -40. 200. FORMAT "%5.1" AXIS_PTS_REF Ctb_toil /end AXIS_DESCR
 /begin AXIS_DESCR COM_AXIS Vxx_is_n_sp _CNV_A_R_ENSD_LINEA_22_CM 5 0. 16383.75 FORMAT "%8.2" AXIS_PTS_REF Ctb_agb_tq_csm_is_n_sp /end AXIS_DESCR
/end CHARACTERISTIC
/begin CHARACTERISTIC Cmp_agb_csm_tq_drag_red_cor "Temporary drag reduction torque correction" MAP 0xa002d670 _REC_A1MAP_20_u2_u2_u2 2047.96875 _CNV_A_R_LINEAR_____181_CM 0. 2047.96875 FORMAT "%10.5"
 /begin AXIS_DESCR COM_AXIS Vxx_toil _CNV_A_R_LINEAR_____110_CM 16 -40. 200. FORMAT "%5.1" AXIS_PTS_REF Ctb_toil /end AXIS_DESCR
 /begin AXIS_DESCR COM_AXIS Vxx_is_n_sp _CNV_A_R_ENSD_LINEA_22_CM 5 0. 16383.75 FORMAT "%8.2" AXIS_PTS_REF Ctb_agb_tq_csm_is_n_sp /end AXIS_DESCR
/end CHARACTERISTIC
/begin CHARACTERISTIC Cmp_agb_csm_tq_neut_dri_cor "Temporary N->D torque correction" MAP 0xa002d710 _REC_A1MAP_20_u2_u2_u2 2047.96875 _CNV_A_R_LINEAR_____181_CM 0. 2047.96875 FORMAT "%10.5"
 /begin AXIS_DESCR COM_AXIS Vxx_toil _CNV_A_R_LINEAR_____110_CM 16 -40. 200. FORMAT "%5.1" AXIS_PTS_REF Ctb_toil /end AXIS_DESCR
 /begin AXIS_DESCR COM_AXIS Vxx_is_n_sp _CNV_A_R_ENSD_LINEA_22_CM 5 0. 16383.75 FORMAT "%8.2" AXIS_PTS_REF Ctb_agb_tq_csm_is_n_sp /end AXIS_DESCR
/end CHARACTERISTIC
/begin CHARACTERISTIC Ctp_agb_csm_brk_pdl_dly_cor "Duration of brake torque losses correction before decrementation" CURVE 0xa002d7b0 _REC_A1CUR_20_u2_u2 655.35 _CNV_A_R_LINEAR_____32_CM 0. 655.35 FORMAT "%6.2"
 /begin AXIS_DESCR COM_AXIS Vxx_toil _CNV_A_R_LINEAR_____110_CM 16 -40. 200. FORMAT "%5.1" AXIS_PTS_REF Ctb_toil /end AXIS_DESCR
/end CHARACTERISTIC
/begin CHARACTERISTIC Ctp_agb_csm_drag_red_dly_cor "Duration of drag reduction torque correction before decrementation" CURVE 0xa002d7d0 _REC_A1CUR_20_u2_u2 655.35 _CNV_A_R_LINEAR_____32_CM 0. 655.35 FORMAT "%6.2"
 /begin AXIS_DESCR COM_AXIS Vxx_toil _CNV_A_R_LINEAR_____110_CM 16 -40. 200. FORMAT "%5.1" AXIS_PTS_REF Ctb_toil /end AXIS_DESCR
/end CHARACTERISTIC
/begin CHARACTERISTIC Ctp_agb_csm_neut_dri_dly_cor "Duration of coupler torque losses correction before decrementation" CURVE 0xa002d7f0 _REC_A1CUR_20_u2_u2 655.35 _CNV_A_R_LINEAR_____32_CM 0. 655.35 FORMAT "%6.2"
 /begin AXIS_DESCR COM_AXIS Vxx_toil _CNV_A_R_LINEAR_____110_CM 16 -40. 200. FORMAT "%5.1" AXIS_PTS_REF Ctb_toil /end AXIS_DESCR
/end CHARACTERISTIC
/begin CHARACTERISTIC Ctp_agb_tq_stop_max_cor "Maximum value of Stop Vehicle troque correction" CURVE 0xa002d810 _REC_A1CUR_20_u2_u2 2047.96875 _CNV_A_R_LINEAR_____181_CM 0. 2047.96875 FORMAT "%10.5"
 /begin AXIS_DESCR COM_AXIS Vxx_tco _CNV_A_R_LINEAR_____110_CM 9 -40. 200. FORMAT "%5.1" AXIS_PTS_REF Ctb_tco2 /end AXIS_DESCR
/end CHARACTERISTIC
/begin CHARACTERISTIC Ctp_agb_tq_stop_min_cor "Minimum value of Stop Vehicle troque correction" CURVE 0xa002d824 _REC_A1CUR_20_u2_u2 2047.96875 _CNV_A_R_LINEAR_____181_CM 0. 2047.96875 FORMAT "%10.5"
 /begin AXIS_DESCR COM_AXIS Vxx_tco _CNV_A_R_LINEAR_____110_CM 9 -40. 200. FORMAT "%5.1" AXIS_PTS_REF Ctb_tco2 /end AXIS_DESCR
/end CHARACTERISTIC
/begin CHARACTERISTIC Ctp_agb_tq_stop_prim_drv_fac "Factor to calculate the Stop Vehicle torque correction in function of the primary shaft speed derivate" CURVE 0xa002d838 _REC_A1CUR_20_u2_u2 1.99996948242188 _CNV_A_R_LINEAR_____443_CM -1.99996948242188 0. FORMAT "%9.6"
 /begin AXIS_DESCR COM_AXIS Vxx_tco _CNV_A_R_LINEAR_____110_CM 9 -40. 200. FORMAT "%5.1" AXIS_PTS_REF Ctb_tco2 /end AXIS_DESCR
/end CHARACTERISTIC
/begin CHARACTERISTIC Ctp_egb_neut_dri_dly_cor "Temporization between the transition neutral -> Drive" CURVE 0xa002d84c _REC_A1CUR_20_u2_u2 655.35 _CNV_A_R_LINEAR_____32_CM 0. 655.35 FORMAT "%6.2"
 /begin AXIS_DESCR COM_AXIS Vxx_toil _CNV_A_R_LINEAR_____110_CM 16 -40. 200. FORMAT "%5.1" AXIS_PTS_REF Ctb_toil /end AXIS_DESCR
/end CHARACTERISTIC
/begin CHARACTERISTIC Ctp_egb_neut_rvr_dly_cor "Temporization between the transition neutral -> RvR" CURVE 0xa002d86c _REC_A1CUR_20_u2_u2 655.35 _CNV_A_R_LINEAR_____32_CM 0. 655.35 FORMAT "%6.2"
 /begin AXIS_DESCR COM_AXIS Vxx_toil _CNV_A_R_LINEAR_____110_CM 16 -40. 200. FORMAT "%5.1" AXIS_PTS_REF Ctb_toil /end AXIS_DESCR
/end CHARACTERISTIC
/begin MEASUREMENT Vbx_agb_tq_brk_pdl "Brake pedal off consolidated" UBYTE _CNV_S_2_RANGE______3_CM 1 0. 0. 1. ECU_ADDRESS 0xd0006b9c BIT_MASK 0x1 /end MEASUREMENT
/begin MEASUREMENT Vbx_agb_tq_brk_pdl_cor_act "Request for the brake pedal torque correction" UBYTE _CNV_S_2_RANGE______3_CM 1 0. 0. 1. ECU_ADDRESS 0xd0006b9d BIT_MASK 0x1 /end MEASUREMENT
/begin MEASUREMENT Vbx_agb_tq_drag_red_cor_act "Request for the drag reduction torque correction" UBYTE _CNV_S_2_RANGE______3_CM 1 0. 0. 1. ECU_ADDRESS 0xd0007bcb BIT_MASK 0x1 /end MEASUREMENT
/begin MEASUREMENT Vbx_agb_tq_is_vs_cdn_cor "Boolean to authorize the crack on vehicle speed and idle speed conditions" UBYTE _CNV_S_2_RANGE______3_CM 1 0. 0. 1. ECU_ADDRESS 0xd0006b9e BIT_MASK 0x1 /end MEASUREMENT
/begin MEASUREMENT Vbx_agb_tq_neut_dri_cor_act "Request for the coupler torque losses correction" UBYTE _CNV_S_2_RANGE______3_CM 1 0. 0. 1. ECU_ADDRESS 0xd0007bcc BIT_MASK 0x1 /end MEASUREMENT
/begin MEASUREMENT Vbx_agb_tq_stop_cor_act "Request for the stop vehicle torque losses correction (CVT)" UBYTE _CNV_S_2_RANGE______3_CM 1 0. 0. 1. ECU_ADDRESS 0xd0006b9f BIT_MASK 0x1 /end MEASUREMENT
/begin MEASUREMENT Vbx_n_egb_neut "Electronic gear box isn't in neutral position" UBYTE _CNV_S_2_RANGE______3_CM 1 0. 0. 1. ECU_ADDRESS 0xd0006ba0 BIT_MASK 0x1 /end MEASUREMENT
/begin MEASUREMENT Vbx_n_egb_neut_dly "Electronic gear box isn't in neutral position with a delay" UBYTE _CNV_S_2_RANGE______3_CM 1 0. 0. 1. ECU_ADDRESS 0xd0006ba1 BIT_MASK 0x1 /end MEASUREMENT
/begin MEASUREMENT Vxx_agb_csm_tq_brk_pdl_cor "Brake pedal torque correction" UWORD _CNV_A_R_LINEAR_____181_CM 1 0. 0. 2047.96875 ECU_ADDRESS 0xd0004334 FORMAT "%10.5" /end MEASUREMENT
/begin MEASUREMENT Vxx_agb_csm_tq_brk_pdl_cor_1 "Brake pedal torque correction with delay" UWORD _CNV_A_R_LINEAR_____181_CM 1 0. 0. 2047.96875 ECU_ADDRESS 0xd0004336 FORMAT "%10.5" /end MEASUREMENT
/begin MEASUREMENT Vxx_agb_csm_tq_cor "Agb torque correction for the idle speed regulation" UWORD _CNV_A_R_LINEAR_____181_CM 1 0. 0. 2047.96875 ECU_ADDRESS 0xd0004338 FORMAT "%10.5" /end MEASUREMENT
/begin MEASUREMENT Vxx_agb_csm_tq_drag_red_cor "Drag reduction torque correction" UWORD _CNV_A_R_LINEAR_____181_CM 1 0. 0. 2047.96875 ECU_ADDRESS 0xd0005f08 FORMAT "%10.5" /end MEASUREMENT
/begin MEASUREMENT Vxx_agb_csm_tq_drag_red_cor_1 "Drag reduction torque correction with delay" UWORD _CNV_A_R_LINEAR_____181_CM 1 0. 0. 2047.96875 ECU_ADDRESS 0xd0005f0a FORMAT "%10.5" /end MEASUREMENT
/begin MEASUREMENT Vxx_agb_csm_tq_neut_cor "Coupler torque losses correction" UWORD _CNV_A_R_LINEAR_____181_CM 1 0. 0. 2047.96875 ECU_ADDRESS 0xd0005f0c FORMAT "%10.5" /end MEASUREMENT
/begin MEASUREMENT Vxx_agb_csm_tq_neut_cor_1 "Coupler torque losses correction with delay" UWORD _CNV_A_R_LINEAR_____181_CM 1 0. 0. 2047.96875 ECU_ADDRESS 0xd0005f0e FORMAT "%10.5" /end MEASUREMENT
/begin MEASUREMENT Vxx_agb_tq_stop_cor "Stop Vehicle torque correction (CVT)" UWORD _CNV_A_R_LINEAR_____181_CM 1 0. 0. 2047.96875 ECU_ADDRESS 0xd000433a FORMAT "%10.5" /end MEASUREMENT
/begin MEASUREMENT Vxx_agb_tq_stop_cor_1 "Stop Vehicle torque correction with delay (CVT)" UWORD _CNV_A_R_LINEAR_____181_CM 1 0. 0. 2047.96875 ECU_ADDRESS 0xd000433c FORMAT "%10.5" /end MEASUREMENT
/begin MEASUREMENT Vxx_prim_sha_spd_drv "Primary shaft speed derivate" SWORD _CNV_A_R_LINEAR_____444_CM 1 0. -8192. 8191.75 ECU_ADDRESS 0xd000433e FORMAT "%8.2" /end MEASUREMENT
/begin MEASUREMENT Vxx_prim_sha_spd_drv_mv "filtered primary shaft speed derivate" SWORD _CNV_A_R_LINEAR_____444_CM 1 0. -8192. 8191.75 ECU_ADDRESS 0xd0004340 FORMAT "%8.2" /end MEASUREMENT
/begin CHARACTERISTIC Cbx_agb_csm_tq_cor_ad "Boolean, to add the torque correction on coupler torque losses. If false then maxinum with the AT_torque , if true additive on the AT_torque" VALUE 0xa00214d0 _REC_S1VAL_20_u1 1. _CNV_S_2_RANGE______3_CM 0. 1. BIT_MASK 0x1 /end CHARACTERISTIC
/begin CHARACTERISTIC Cxx_agb_csm_tq_neut_rvr_fac "Facter on the coupler torque losses correction if to reserve gear is engaged" VALUE 0xa00214d1 _REC_S1VAL_20_u1 3.984375 _CNV_A_R_LINEAR_____83_CM 0. 3.984375 FORMAT "%8.6" /end CHARACTERISTIC
/begin CHARACTERISTIC Cxx_agb_tq_brk_pdl_cor_slop "Brake torque correction slope" VALUE 0xa00214b2 _REC_S1VAL_20_u2 51199.21875 _CNV_A_R_LINEAR_____445_CM 0. 51199.21875 FORMAT "%11.5" /end CHARACTERISTIC
/begin CHARACTERISTIC Cxx_agb_tq_brk_pdl_n_hys "Engine speed hysteresis to disable the temporary brake torque correction" VALUE 0xa00214b4 _REC_S1VAL_20_u2 16383.75 _CNV_A_R_ENSD_LINEA_22_CM 0. 16383.75 FORMAT "%8.2" /end CHARACTERISTIC
/begin CHARACTERISTIC Cxx_agb_tq_brk_pdl_n_thd "Engine speed threshold to activate the temporary brake torque correction" VALUE 0xa00214b6 _REC_S1VAL_20_s2 16383.75 _CNV_A_R_ENSD_LINEA_22_CM -8192. 8191.75 FORMAT "%6.0" /end CHARACTERISTIC
/begin CHARACTERISTIC Cxx_agb_tq_brk_pdl_tco_thd "Engine coolant tempearture threshold to activate the temporary brake torque correction" VALUE 0xa00214b8 _REC_S1VAL_20_u2 240. _CNV_A_R_LINEAR_____110_CM -40. 200. FORMAT "%5.1" /end CHARACTERISTIC
/begin CHARACTERISTIC Cxx_agb_tq_drag_red_cor_slop "drag deduction torque correction slope" VALUE 0xa00214ba _REC_S1VAL_20_u2 51199.21875 _CNV_A_R_LINEAR_____445_CM 0. 51199.21875 FORMAT "%11.5" /end CHARACTERISTIC
/begin CHARACTERISTIC Cxx_agb_tq_neut_dri_cor_slop "Coupler torque losses correction slope" VALUE 0xa00214bc _REC_S1VAL_20_u2 51199.21875 _CNV_A_R_LINEAR_____445_CM 0. 51199.21875 FORMAT "%11.5" /end CHARACTERISTIC
/begin CHARACTERISTIC Cxx_agb_tq_stop_cor_slop "Stop Vehicle torque correction slope" VALUE 0xa00214be _REC_S1VAL_20_u2 51199.21875 _CNV_A_R_LINEAR_____445_CM 0. 51199.21875 FORMAT "%11.5" /end CHARACTERISTIC
/begin CHARACTERISTIC Cxx_agb_tq_stop_dly_cor "Duration of stop vehicle torque correction before decrementation (CVT)" VALUE 0xa00214c0 _REC_S1VAL_20_u2 655.35 _CNV_A_R_LINEAR_____32_CM 0. 655.35 FORMAT "%6.2" /end CHARACTERISTIC
/begin CHARACTERISTIC Cxx_agb_tq_stop_n_hys "Engine speed hysteresis to disable the temporary Stop Vehicle torque correction" VALUE 0xa00214c2 _REC_S1VAL_20_u2 16383.75 _CNV_A_R_ENSD_LINEA_22_CM 0. 16383.75 FORMAT "%8.2" /end CHARACTERISTIC
/begin CHARACTERISTIC Cxx_agb_tq_stop_n_thd "Engine speed threshold to disable the temporary Stop Vehicle torque correction" VALUE 0xa00214c4 _REC_S1VAL_20_u2 16383.75 _CNV_A_R_ENSD_LINEA_22_CM 0. 16383.75 FORMAT "%8.2" /end CHARACTERISTIC
/begin CHARACTERISTIC Cxx_agb_tq_stop_prim_drv_thd "Primary shaft speed derivate threshold to activate the Stop Vehicle torque correction" VALUE 0xa00214c6 _REC_S1VAL_20_s2 16383.75 _CNV_A_R_LINEAR_____444_CM -8192. 8191.75 FORMAT "%8.2" /end CHARACTERISTIC
/begin CHARACTERISTIC Cxx_agb_tq_stop_prim_max_ofs "Maximum threshold to activate the temporary Stop Vehicle torque correction" VALUE 0xa00214c8 _REC_S1VAL_20_s2 16383.75 _CNV_A_R_ENSD_LINEA_22_CM -8192. 8191.75 FORMAT "%8.2" /end CHARACTERISTIC
/begin CHARACTERISTIC Cxx_agb_tq_stop_prim_min_ofs "Miniimum threshold to activate the temporary Stop Vehicle torque correction" VALUE 0xa00214ca _REC_S1VAL_20_s2 16383.75 _CNV_A_R_ENSD_LINEA_22_CM -8192. 8191.75 FORMAT "%8.2" /end CHARACTERISTIC
/begin CHARACTERISTIC Cxx_agb_tq_stop_vs_thd "Vehicle speed threshold to authorize the Stop Vehicle torque correction" VALUE 0xa00214cc _REC_S1VAL_20_u2 655.35 _CNV_A_R_LINEAR_____125_CM 0. 655.35 FORMAT "%6.2" /end CHARACTERISTIC
/begin CHARACTERISTIC Cxx_prim_sha_spd_drv_ftc "Filtering time for primary shaft speed derivate" VALUE 0xa00214d2 _REC_S1VAL_20_u1 2.55 _CNV_A_R_LINEAR_____32_CM 0. 2.55 FORMAT "%4.2" /end CHARACTERISTIC
/begin CHARACTERISTIC Cxx_prim_sha_spd_drv_thd "Primary shaft speed derivate threshold" VALUE 0xa00214ce _REC_S1VAL_20_s2 16383.75 _CNV_A_R_ENSD_LINEA_22_CM -8192. 8191.75 FORMAT "%8.2" /end CHARACTERISTIC
/begin AXIS_PTS Ctb_agb_csm_tq_is_n_sp_dif "Breakpoint on the difference between nominal engine speed setpoint and the real setpoint" 0xa002d88c Vxx_is_n_sp_dif _REC_A2AXS_20_u2 16383.75 _CNV_A_R_ENSD_LINEA_22_CM 5 0. 16383.75 FORMAT "%8.2" /end AXIS_PTS
/begin AXIS_PTS Ctb_agb_tq_dif_n_is_n_sp "Breakpoint on the difference between the engine speed and the engine setpoint" 0xa002d898 Vxx_agb_tq_dif_n_is_n_sp _REC_A2AXS_20_u2 16383.75 _CNV_A_R_ENSD_LINEA_22_CM 9 0. 16383.75 FORMAT "%8.2" /end AXIS_PTS
/begin AXIS_PTS Ctb_agb_tq_vs "Breakpoint of Vehicle speed, to disable the coupler torque" 0xa002d8ac Vxx_vs _REC_A2AXS_20_u2 655.35 _CNV_A_R_LINEAR_____125_CM 9 0. 655.35 FORMAT "%6.2" /end AXIS_PTS
/begin CHARACTERISTIC Ctp_agb_csm_tq_drag_red_ofs "Torque offset to estimate the gearbox losses in the drag reduction mode" CURVE 0xa002d8c0 _REC_A1CUR_20_u2_u2 2047.96875 _CNV_A_R_LINEAR_____185_CM -1024. 1023.96875 FORMAT "%10.5"
 /begin AXIS_DESCR COM_AXIS Vxx_toil _CNV_A_R_LINEAR_____110_CM 16 -40. 200. FORMAT "%5.1" AXIS_PTS_REF Ctb_toil /end AXIS_DESCR
/end CHARACTERISTIC
/begin CHARACTERISTIC Ctp_agb_csm_tq_dri_ofs "Torque offset to estimate the gearbox losses in the drive mode" CURVE 0xa002d8e0 _REC_A1CUR_20_u2_u2 2047.96875 _CNV_A_R_LINEAR_____185_CM -1024. 1023.96875 FORMAT "%10.5"
 /begin AXIS_DESCR COM_AXIS Vxx_toil _CNV_A_R_LINEAR_____110_CM 16 -40. 200. FORMAT "%5.1" AXIS_PTS_REF Ctb_toil /end AXIS_DESCR
/end CHARACTERISTIC
/begin CHARACTERISTIC Ctp_agb_csm_tq_dri_ofs_dft "Degraded mode of the coupler torque losses in the drive mode" CURVE 0xa002d900 _REC_A1CUR_20_u2_u2 2047.96875 _CNV_A_R_LINEAR_____181_CM 0. 2047.96875 FORMAT "%10.5"
 /begin AXIS_DESCR COM_AXIS Vxx_toil _CNV_A_R_LINEAR_____110_CM 16 -40. 200. FORMAT "%5.1" AXIS_PTS_REF Ctb_toil /end AXIS_DESCR
/end CHARACTERISTIC
/begin CHARACTERISTIC Ctp_agb_csm_tq_ftc_temp_fast "Fast filter factor to coupler torque losses in the neutral position or the drag reduction mode (depending on engine coolant temperature)" CURVE 0xa002d920 _REC_A1CUR_20_u1_u2 2.55 _CNV_A_R_LINEAR_____32_CM 0. 2.55 FORMAT "%4.2"
 /begin AXIS_DESCR COM_AXIS Vxx_toil _CNV_A_R_LINEAR_____110_CM 16 -40. 200. FORMAT "%5.1" AXIS_PTS_REF Ctb_toil /end AXIS_DESCR
/end CHARACTERISTIC
/begin CHARACTERISTIC Ctp_agb_csm_tq_ftc_temp_slow "Slow filter factor to coupler torque losses in the neutral position or the drag reduction mode (depending on engine coolant temperature)" CURVE 0xa002d930 _REC_A1CUR_20_u1_u2 2.55 _CNV_A_R_LINEAR_____32_CM 0. 2.55 FORMAT "%4.2"
 /begin AXIS_DESCR COM_AXIS Vxx_toil _CNV_A_R_LINEAR_____110_CM 16 -40. 200. FORMAT "%5.1" AXIS_PTS_REF Ctb_toil /end AXIS_DESCR
/end CHARACTERISTIC
/begin CHARACTERISTIC Ctp_agb_csm_tq_is_n_sp_fac "Factor on torque converter losses according to the difference between the nominal engine speed setpoint and the real setpoint" CURVE 0xa00214d4 _REC_A1CUR_20_u1_u2 3.984375 _CNV_A_R_LINEAR_____83_CM 0. 3.984375 FORMAT "%8.6"
 /begin AXIS_DESCR COM_AXIS Vxx_is_n_sp_dif _CNV_A_R_ENSD_LINEA_22_CM 5 0. 16383.75 FORMAT "%8.2" AXIS_PTS_REF Ctb_agb_csm_tq_is_n_sp_dif /end AXIS_DESCR
/end CHARACTERISTIC
/begin CHARACTERISTIC Ctp_agb_csm_tq_n_fac "Factor to disable the coupler torque, depending of the engine speed" CURVE 0xa002d940 _REC_A1CUR_20_u1_u2 1. _CNV_A_R_LINEAR_____42_CM 0. 1. FORMAT "%9.7"
 /begin AXIS_DESCR COM_AXIS Vxx_agb_tq_dif_n_is_n_sp _CNV_A_R_ENSD_LINEA_22_CM 9 0. 16383.75 FORMAT "%8.2" AXIS_PTS_REF Ctb_agb_tq_dif_n_is_n_sp /end AXIS_DESCR
/end CHARACTERISTIC
/begin CHARACTERISTIC Ctp_agb_csm_tq_neut_ofs "Torque offset to estimate the gearbox losses in the neutral position or the park position" CURVE 0xa002d94c _REC_A1CUR_20_u2_u2 2047.96875 _CNV_A_R_LINEAR_____185_CM -1024. 1023.96875 FORMAT "%10.5"
 /begin AXIS_DESCR COM_AXIS Vxx_toil _CNV_A_R_LINEAR_____110_CM 16 -40. 200. FORMAT "%5.1" AXIS_PTS_REF Ctb_toil /end AXIS_DESCR
/end CHARACTERISTIC
/begin CHARACTERISTIC Ctp_agb_csm_tq_neut_ofs_dft "Degraded mode of the coupler torque losses in the neutral position" CURVE 0xa002d96c _REC_A1CUR_20_u2_u2 2047.96875 _CNV_A_R_LINEAR_____181_CM 0. 2047.96875 FORMAT "%10.5"
 /begin AXIS_DESCR COM_AXIS Vxx_toil _CNV_A_R_LINEAR_____110_CM 16 -40. 200. FORMAT "%5.1" AXIS_PTS_REF Ctb_toil /end AXIS_DESCR
/end CHARACTERISTIC
/begin CHARACTERISTIC Ctp_agb_csm_tq_vs_fac "Factor to disable the coupler torque, depending of the vehicle speed" CURVE 0xa002d98c _REC_A1CUR_20_u1_u2 1. _CNV_A_R_LINEAR_____42_CM 0. 1. FORMAT "%9.7"
 /begin AXIS_DESCR COM_AXIS Vxx_vs _CNV_A_R_LINEAR_____125_CM 9 0. 655.35 FORMAT "%6.2" AXIS_PTS_REF Ctb_agb_tq_vs /end AXIS_DESCR
/end CHARACTERISTIC
/begin CHARACTERISTIC Ctp_egb_dri_drag_red_dly_temp "Temporization between the transition Drive - > drag reduction" CURVE 0xa002d998 _REC_A1CUR_20_u2_u2 655.35 _CNV_A_R_LINEAR_____32_CM 0. 655.35 FORMAT "%6.2"
 /begin AXIS_DESCR COM_AXIS Vxx_toil _CNV_A_R_LINEAR_____110_CM 16 -40. 200. FORMAT "%5.1" AXIS_PTS_REF Ctb_toil /end AXIS_DESCR
/end CHARACTERISTIC
/begin CHARACTERISTIC Ctp_egb_dri_neut_dly_temp "Temporization between the transition Drive -> neutral" CURVE 0xa002d9b8 _REC_A1CUR_20_u2_u2 655.35 _CNV_A_R_LINEAR_____32_CM 0. 655.35 FORMAT "%6.2"
 /begin AXIS_DESCR COM_AXIS Vxx_toil _CNV_A_R_LINEAR_____110_CM 16 -40. 200. FORMAT "%5.1" AXIS_PTS_REF Ctb_toil /end AXIS_DESCR
/end CHARACTERISTIC
/begin MEASUREMENT Vbx_stat_drag_red_agb "Drag reduction mode with the temporization between Drive mode -> Drag reduction" UBYTE _CNV_S_2_RANGE______3_CM 1 0. 0. 1. ECU_ADDRESS 0xd0007bcd BIT_MASK 0x1 /end MEASUREMENT
/begin MEASUREMENT Vbx_stat_egb_neut "Electronic GearBox is in a configuration equivalent to Neutral for a manual gearbox, with the temporization between Drive -> Neut" UBYTE _CNV_S_2_RANGE______3_CM 1 0. 0. 1. ECU_ADDRESS 0xd0007bce BIT_MASK 0x1 /end MEASUREMENT
/begin MEASUREMENT Vsx_agb_csm_tq_vld "Converter friction torque validity status" UBYTE _CNV_S_3_STATUS_OK__179_CM 1 0. 0. 2. ECU_ADDRESS 0xd0006ba9 /end MEASUREMENT
/begin MEASUREMENT Vxx_agb_csm_tq "coupler torque losses" UWORD _CNV_A_R_LINEAR_____216_CM 1 0. -400. 1647.96875 ECU_ADDRESS 0xd0004352 FORMAT "%11.5" /end MEASUREMENT
/begin MEASUREMENT Vxx_agb_csm_tq_dft "coupler torque losses in degraded mode" UWORD _CNV_A_R_LINEAR_____181_CM 1 0. 0. 2047.96875 ECU_ADDRESS 0xd0005f10 FORMAT "%10.5" /end MEASUREMENT
/begin MEASUREMENT Vxx_agb_csm_tq_fil "coupler torque losses filtered" UWORD _CNV_A_R_LINEAR_____216_CM 1 0. -400. 1647.96875 ECU_ADDRESS 0xd0005f12 FORMAT "%10.5" /end MEASUREMENT
/begin MEASUREMENT Vxx_agb_csm_tq_is_n_fac "Factor on torque converter losses according to the difference between the nominal engine speed setpoint and the real setpoint" UBYTE _CNV_A_R_LINEAR_____83_CM 1 0. 0. 3.984375 ECU_ADDRESS 0xd0007bcf FORMAT "%8.6" /end MEASUREMENT
/begin MEASUREMENT Vxx_agb_csm_tq_ofs "Torque offset to estimate the gearbox losses" SWORD _CNV_A_R_LINEAR_____181_CM 1 0. -1024. 1023.96875 ECU_ADDRESS 0xd0005f14 FORMAT "%10.5" /end MEASUREMENT
/begin MEASUREMENT Vxx_agb_csm_tq_slop "coupler torque losses with the slew rate" UWORD _CNV_A_R_LINEAR_____216_CM 1 0. -400. 1647.96875 ECU_ADDRESS 0xd0005f16 FORMAT "%10.5" /end MEASUREMENT
/begin MEASUREMENT Vxx_agb_tq_dif_n_is_n_sp "Difference between the engine speed and the idle speed setpoint" UWORD _CNV_A_R_ENSD_LINEA_22_CM 1 0. 0. 16383.75 ECU_ADDRESS 0xd0004354 FORMAT "%8.2" /end MEASUREMENT
/begin MEASUREMENT Vxx_is_n_sp_dif "Difference between nomimal engine speed setpoint and the final setpoint" UWORD _CNV_A_R_ENSD_LINEA_22_CM 1 0. 0. 16383.75 ECU_ADDRESS 0xd0004356 FORMAT "%8.2" /end MEASUREMENT
/begin CHARACTERISTIC Cbx_agb_csm_ofs_cfm "Configuration boolean, To calculate the torque offset to estimate the gearbox losses" VALUE 0xa0021506 _REC_S1VAL_20_u1 1. _CNV_A_R_ECME_LINEA_0_CM 0. 1. FORMAT "%1.0" BIT_MASK 0x1 /end CHARACTERISTIC
/begin CHARACTERISTIC Cbx_agb_csm_slop_cfm "Flag to disable the slew rate on the converter torque losses" VALUE 0xa0021507 _REC_S1VAL_20_u1 1. _CNV_A_R_ECME_LINEA_0_CM 0. 1. FORMAT "%1.0" BIT_MASK 0x1 /end CHARACTERISTIC
/begin CHARACTERISTIC Cbx_agb_csm_tq_temp_cfm "Configuration boolean, To calculate the thermic dependence according to water temperature or oil temperature" VALUE 0xa0021508 _REC_S1VAL_20_u1 1. _CNV_A_R_ECME_LINEA_0_CM 0. 1. FORMAT "%1.0" BIT_MASK 0x1 /end CHARACTERISTIC
/begin CHARACTERISTIC Cxx_agb_csm_ofs_slop_neg "Negative slope on torque offset to estimate the gearbox losses" VALUE 0xa00214da _REC_S1VAL_20_u2 12799.8046875 _CNV_A_R_LINEAR_____446_CM -12799.8046875 0. FORMAT "%14.7" /end CHARACTERISTIC
/begin CHARACTERISTIC Cxx_agb_csm_ofs_slop_neg_dft "Negative slope on torque offset to estimate the gearbox losses in degraded mode" VALUE 0xa00214dc _REC_S1VAL_20_u2 12799.8046875 _CNV_A_R_LINEAR_____446_CM -12799.8046875 0. FORMAT "%14.7" /end CHARACTERISTIC
/begin CHARACTERISTIC Cxx_agb_csm_ofs_slop_pos "Positive slope on torque offset to estimate the gearbox losses" VALUE 0xa00214de _REC_S1VAL_20_u2 12799.8046875 _CNV_A_R_LINEAR_____447_CM 0. 12799.8046875 FORMAT "%13.7" /end CHARACTERISTIC
/begin CHARACTERISTIC Cxx_agb_csm_ofs_slop_pos_dft "Positive slope on torque offset to estimate the gearbox losses in degraded mode" VALUE 0xa00214e0 _REC_S1VAL_20_u2 12799.8046875 _CNV_A_R_LINEAR_____447_CM 0. 12799.8046875 FORMAT "%13.7" /end CHARACTERISTIC
/begin CHARACTERISTIC Cxx_agb_csm_tq_ftc_fast "Fast filter factor to coupler torque losses in the neutral position or the drag reduction mode" VALUE 0xa0021509 _REC_S1VAL_20_u1 2.55 _CNV_A_R_LINEAR_____32_CM 0. 2.55 FORMAT "%4.2" /end CHARACTERISTIC
/begin CHARACTERISTIC Cxx_agb_csm_tq_ftc_slow "Slow filter factor to coupler torque losses in the neutral position or the drag reduction mode" VALUE 0xa002150a _REC_S1VAL_20_u1 2.55 _CNV_A_R_LINEAR_____32_CM 0. 2.55 FORMAT "%4.2" /end CHARACTERISTIC
/begin CHARACTERISTIC Cxx_agb_csm_tq_ftc_vs_thd "Vehicle speed threshold to switch between a simple filter time or a depending on engine coolant temperature one" VALUE 0xa00214e2 _REC_S1VAL_20_u2 655.35 _CNV_A_R_LINEAR_____125_CM 0. 655.35 FORMAT "%6.2" /end CHARACTERISTIC
/begin CHARACTERISTIC Cxx_agb_csm_tq_is_n_hys "Engine speed hysteresis on the threshold of the idle speed regulation zone" VALUE 0xa00214e4 _REC_S1VAL_20_u2 16383.75 _CNV_A_R_ENSD_LINEA_22_CM 0. 16383.75 FORMAT "%8.2" /end CHARACTERISTIC
/begin CHARACTERISTIC Cxx_agb_csm_tq_is_n_thd "Engine speed threshold to bound the low zone and the high zone of idle speed regulation" VALUE 0xa00214e6 _REC_S1VAL_20_u2 16383.75 _CNV_A_R_ENSD_LINEA_22_CM 0. 16383.75 FORMAT "%8.2" /end CHARACTERISTIC
/begin CHARACTERISTIC Cxx_agb_csm_tq_slop_neg "Negative slope on torque converter losses in the low zone of idle speed" VALUE 0xa00214e8 _REC_S1VAL_20_u2 12799.8046875 _CNV_A_R_LINEAR_____446_CM -12799.8046875 0. FORMAT "%14.7" /end CHARACTERISTIC
/begin CHARACTERISTIC Cxx_agb_csm_tq_slop_neg_1 "Negative slope on torque converter losses in the high zone of idle speed" VALUE 0xa00214ea _REC_S1VAL_20_u2 12799.8046875 _CNV_A_R_LINEAR_____446_CM -12799.8046875 0. FORMAT "%14.7" /end CHARACTERISTIC
/begin CHARACTERISTIC Cxx_agb_csm_tq_slop_neg_1_rvr "Negative slope on torque converter losses in the high zone of idle speed, (reserve gear)" VALUE 0xa00214ec _REC_S1VAL_20_u2 12799.8046875 _CNV_A_R_LINEAR_____446_CM -12799.8046875 0. FORMAT "%14.7" /end CHARACTERISTIC
/begin CHARACTERISTIC Cxx_agb_csm_tq_slop_neg_2 "Negative slope on torque converter losses in the zone out of idle speed" VALUE 0xa00214ee _REC_S1VAL_20_u2 12799.8046875 _CNV_A_R_LINEAR_____446_CM -12799.8046875 0. FORMAT "%14.7" /end CHARACTERISTIC
/begin CHARACTERISTIC Cxx_agb_csm_tq_slop_neg_rvr "Negative slope on torque converter losses in the low zone of idle speed, (reserve gear)" VALUE 0xa00214f0 _REC_S1VAL_20_u2 12799.8046875 _CNV_A_R_LINEAR_____446_CM -12799.8046875 0. FORMAT "%14.7" /end CHARACTERISTIC
/begin CHARACTERISTIC Cxx_agb_csm_tq_slop_pos "Positive slope on torque converter losses in the low zone of idle speed" VALUE 0xa00214f2 _REC_S1VAL_20_u2 12799.8046875 _CNV_A_R_LINEAR_____447_CM 0. 12799.8046875 FORMAT "%13.7" /end CHARACTERISTIC
/begin CHARACTERISTIC Cxx_agb_csm_tq_slop_pos_1 "Positive slope on torque converter losses in the high zone of idle speed" VALUE 0xa00214f4 _REC_S1VAL_20_u2 12799.8046875 _CNV_A_R_LINEAR_____447_CM 0. 12799.8046875 FORMAT "%13.7" /end CHARACTERISTIC
/begin CHARACTERISTIC Cxx_agb_csm_tq_slop_pos_1_rvr "Positive slope on torque converter losses in the high zone of idle speed, (reserve gear)" VALUE 0xa00214f6 _REC_S1VAL_20_u2 12799.8046875 _CNV_A_R_LINEAR_____447_CM 0. 12799.8046875 FORMAT "%13.7" /end CHARACTERISTIC
/begin CHARACTERISTIC Cxx_agb_csm_tq_slop_pos_2 "Positive slope on torque converter losses in the zone out of idle speed" VALUE 0xa00214f8 _REC_S1VAL_20_u2 12799.8046875 _CNV_A_R_LINEAR_____447_CM 0. 12799.8046875 FORMAT "%13.7" /end CHARACTERISTIC
/begin CHARACTERISTIC Cxx_agb_csm_tq_slop_pos_rvr "Positive slope on torque converter losses in the low zone of idle speed, (reserve gear)" VALUE 0xa00214fa _REC_S1VAL_20_u2 12799.8046875 _CNV_A_R_LINEAR_____447_CM 0. 12799.8046875 FORMAT "%13.7" /end CHARACTERISTIC
/begin CHARACTERISTIC Cxx_agb_csm_tq_vs_thd "Vehicle speed threshold to authorize the egb torque correction" VALUE 0xa00214fc _REC_S1VAL_20_u2 655.35 _CNV_A_R_LINEAR_____125_CM 0. 655.35 FORMAT "%6.2" /end CHARACTERISTIC
/begin CHARACTERISTIC Cxx_agb_tq_slop_drag_red_neg "Negative slope on torque converter losses in the drag reduction mode" VALUE 0xa00214fe _REC_S1VAL_20_u2 12799.8046875 _CNV_A_R_LINEAR_____446_CM -12799.8046875 0. FORMAT "%14.7" /end CHARACTERISTIC
/begin CHARACTERISTIC Cxx_agb_tq_slop_drag_red_pos "Positive slope on torque converter losses in the drag reduction mode" VALUE 0xa0021500 _REC_S1VAL_20_u2 12799.8046875 _CNV_A_R_LINEAR_____447_CM 0. 12799.8046875 FORMAT "%13.7" /end CHARACTERISTIC
/begin CHARACTERISTIC Cxx_agb_tq_slop_dsb_neg "Negative slope to disable the Slew Rate on the AT_torque" VALUE 0xa0021502 _REC_S1VAL_20_u2 12799.8046875 _CNV_A_R_LINEAR_____446_CM -12799.8046875 0. FORMAT "%14.7" /end CHARACTERISTIC
/begin CHARACTERISTIC Cxx_agb_tq_slop_dsb_pos "Positive slope to disable the Slew Rate on the AT_torque" VALUE 0xa0021504 _REC_S1VAL_20_u2 12799.8046875 _CNV_A_R_LINEAR_____447_CM 0. 12799.8046875 FORMAT "%13.7" /end CHARACTERISTIC
/begin AXIS_PTS Ctb_agb_tqe_inc "Breakpoints for formatting of AGB torque increases for the integrator-based detection of excessive AGB torque requests" 0xa002d9d8 Vxx_agb_tqe_inc _REC_A2AXS_20_u2 2047.96875 _CNV_A_R_LINEAR_____216_CM 9 -400. 1647.96875 FORMAT "%11.5" /end AXIS_PTS
/begin CHARACTERISTIC Ctp_agb_tqe_inc_fmt "Formatting of AGB torque increases for the integrator-based detection of excessive AGB torque requests" CURVE 0xa002d9ec _REC_A1CUR_20_u2_u2 2047.96875 _CNV_A_R_LINEAR_____216_CM -400. 1647.96875 FORMAT "%11.5"
 /begin AXIS_DESCR COM_AXIS Vxx_agb_tqe_inc _CNV_A_R_LINEAR_____216_CM 9 -400. 1647.96875 FORMAT "%11.5" AXIS_PTS_REF Ctb_agb_tqe_inc /end AXIS_DESCR
/end CHARACTERISTIC
/begin MEASUREMENT Vbx_agb_ack "AT frame acknowledgment. This value is set to 1 if there is no torque request" UBYTE _CNV_S_2_RANGE______3_CM 1 0. 0. 1. ECU_ADDRESS 0xd0006bb2 BIT_MASK 0x1 /end MEASUREMENT
/begin MEASUREMENT Vbx_agb_clck_fail "the AT frame clock value is not coherent with the last AT frame clock" UBYTE _CNV_S_2_RANGE______3_CM 1 0. 0. 1. ECU_ADDRESS 0xd0006bb3 BIT_MASK 0x1 /end MEASUREMENT
/begin MEASUREMENT Vbx_agb_cmd "Validation of AT protocol conditions" UBYTE _CNV_S_2_RANGE______3_CM 1 0. 0. 1. ECU_ADDRESS 0xd0006bb4 BIT_MASK 0x1 /end MEASUREMENT
/begin MEASUREMENT Vbx_agb_dft "Protocol error detected (to activate slew rate)" UBYTE _CNV_S_2_RANGE______3_CM 1 0. 0. 1. ECU_ADDRESS 0xd0006bb5 BIT_MASK 0x1 /end MEASUREMENT
/begin MEASUREMENT Vbx_agb_gear_mod_ok "Boolean indicating that the AGB requests are authorized" UBYTE _CNV_S_2_RANGE______3_CM 1 0. 0. 1. ECU_ADDRESS 0xd0006bb6 BIT_MASK 0x1 /end MEASUREMENT
/begin MEASUREMENT Vbx_agb_tq_int_rst "Reset of AGB torque integretar diagnostic" UBYTE _CNV_S_2_RANGE______3_CM 1 0. 0. 1. ECU_ADDRESS 0xd0006bb7 BIT_MASK 0x1 /end MEASUREMENT
/begin MEASUREMENT Vbx_agb_tq_lim_dft "When this flag is set to 1, Agb torque limitation will be set to a default calibration" UBYTE _CNV_S_2_RANGE______3_CM 1 0. 0. 1. ECU_ADDRESS 0xd0006bb8 BIT_MASK 0x1 /end MEASUREMENT
/begin MEASUREMENT Vbx_agb_tq_req "Agb torque request in progress" UBYTE _CNV_S_2_RANGE______3_CM 1 0. 0. 1. ECU_ADDRESS 0xd0006bb9 BIT_MASK 0x1 /end MEASUREMENT
/begin MEASUREMENT Vbx_agb_tq_req_full_ctl_vld "Validated AGB torque intervention of full control type (corresponding to shift in progress in M2S)" UBYTE _CNV_S_2_RANGE______3_CM 1 0. 0. 1. ECU_ADDRESS 0xd0006bba BIT_MASK 0x1 /end MEASUREMENT
/begin MEASUREMENT Vbx_agb_tq_req_h_lim_vld "Validated AGB torque intervention of upper limitation type" UBYTE _CNV_S_2_RANGE______3_CM 1 0. 0. 1. ECU_ADDRESS 0xd0006bbb BIT_MASK 0x1 /end MEASUREMENT
/begin MEASUREMENT Vbx_agb_tq_req_l_lim_vld "Validated AGB torque intervention of lower limitation type" UBYTE _CNV_S_2_RANGE______3_CM 1 0. 0. 1. ECU_ADDRESS 0xd0006bbc BIT_MASK 0x1 /end MEASUREMENT
/begin MEASUREMENT Vbx_df_agb_data_chr "AGB data coherence detected failure" UBYTE _CNV_S_2_RANGE______3_CM 1 0. 0. 1. ECU_ADDRESS 0xd0006bbd BIT_MASK 0x1 /end MEASUREMENT
/begin MEASUREMENT Vbx_df_agb_data_seq_ctr "AGB data clock detected failure" UBYTE _CNV_S_2_RANGE______3_CM 1 0. 0. 1. ECU_ADDRESS 0xd0006bbe BIT_MASK 0x1 /end MEASUREMENT
/begin MEASUREMENT Vbx_df_agb_data_tout "AGB data time-out detected failure" UBYTE _CNV_S_2_RANGE______3_CM 1 0. 0. 1. ECU_ADDRESS 0xd0006bbf BIT_MASK 0x1 /end MEASUREMENT
/begin MEASUREMENT Vbx_df_agb_no_frm "AGB Missing Message detected failure" UBYTE _CNV_S_2_RANGE______3_CM 1 0. 0. 1. ECU_ADDRESS 0xd0006bc0 BIT_MASK 0x1 /end MEASUREMENT
/begin MEASUREMENT Vbx_egb_conf_ena "Booleen permettant d'activer le bloc de surveillance du protocole en couple avec une TA" UBYTE _CNV_S_2_RANGE______3_CM 1 0. 0. 1. ECU_ADDRESS 0xd0006bc1 BIT_MASK 0x1 /end MEASUREMENT
/begin MEASUREMENT Vbx_i_dsb "Integrator inhibit" UBYTE _CNV_S_2_RANGE______3_CM 1 0. 0. 1. ECU_ADDRESS 0xd0006bc2 BIT_MASK 0x1 /end MEASUREMENT
/begin MEASUREMENT Vxx_agb_10ms_t "Scheduler recurence" UBYTE _CNV_A_R_LINEAR_____116_CM 1 0. 0. 0.255 ECU_ADDRESS 0xd0007bd0 FORMAT "%5.3" /end MEASUREMENT
/begin MEASUREMENT Vxx_agb_int_t "Delay between two consecutive calls to SDFTA" UBYTE _CNV_A_R_LINEAR_____116_CM 1 0. 0. 0.255 ECU_ADDRESS 0xd0007bd1 FORMAT "%5.3" /end MEASUREMENT
/begin MEASUREMENT Vxx_agb_lim_tqe "AGB engine torque limitation" UWORD _CNV_A_R_LINEAR_____216_CM 1 0. -400. 1647.96875 ECU_ADDRESS 0xd0004364 FORMAT "%10.5" /end MEASUREMENT
/begin MEASUREMENT Vxx_agb_max_tqe_sp "setpoint request wich will be sent to torque arbitration in max bloc" UWORD _CNV_A_R_LINEAR_____216_CM 1 0. -400. 1647.96875 ECU_ADDRESS 0xd0004366 FORMAT "%10.5" /end MEASUREMENT
/begin MEASUREMENT Vxx_agb_max_tqe_tgt "Slow request wich will be sent to torque arbitration in max bloc" UWORD _CNV_A_R_LINEAR_____216_CM 1 0. -400. 1647.96875 ECU_ADDRESS 0xd0004368 FORMAT "%10.5" /end MEASUREMENT
/begin MEASUREMENT Vxx_agb_min_tqe_sp "Setpoint request wich will be sent to torque arbitration in min bloc" UWORD _CNV_A_R_LINEAR_____216_CM 1 0. -400. 1647.96875 ECU_ADDRESS 0xd000436a FORMAT "%10.5" /end MEASUREMENT
/begin MEASUREMENT Vxx_agb_min_tqe_tgt "Slow request wich will be sent to torque arbitration in min bloc" UWORD _CNV_A_R_LINEAR_____216_CM 1 0. -400. 1647.96875 ECU_ADDRESS 0xd000436c FORMAT "%10.5" /end MEASUREMENT
/begin MEASUREMENT Vxx_agb_tqe_inc "AGB torque increase relative to driver request" UWORD _CNV_A_R_LINEAR_____216_CM 1 0. -400. 1647.96875 ECU_ADDRESS 0xd000436e FORMAT "%11.5" /end MEASUREMENT
/begin CHARACTERISTIC Cbx_max_gear_cge_dly_ena_cfm "activation of max gear change delay diagnosis. Inactive only on bench (for tunning features)" VALUE 0xa0021522 _REC_S1VAL_20_u1 1. _CNV_A_R_ECME_LINEA_0_CM 0. 1. FORMAT "%1.0" BIT_MASK 0x1 /end CHARACTERISTIC
/begin CHARACTERISTIC Cbx_tq_cmd_typ_cfm "in_pci_agb_sdftaxx/Torque command type : 1 (new torque protocol) - Shift in progress : 0 (old torque protocol)" VALUE 0xa0021523 _REC_S1VAL_20_u1 1. _CNV_A_R_ECME_LINEA_0_CM 0. 1. FORMAT "%1.0" BIT_MASK 0x1 /end CHARACTERISTIC
/begin CHARACTERISTIC Cxx_agb_abst_dly "Maximum permitted time without frame, before fault detection" VALUE 0xa002150c _REC_S1VAL_20_u2 65.535 _CNV_A_R_LINEAR_____116_CM 0. 65.535 FORMAT "%5.3" /end CHARACTERISTIC
/begin CHARACTERISTIC Cxx_agb_clck_max_step "Maximum AGB clock step" VALUE 0xa0021524 _REC_S1VAL_20_u1 255. _CNV_A_R_ECME_LINEA_0_CM 0. 255. FORMAT "%3.0" /end CHARACTERISTIC
/begin CHARACTERISTIC Cxx_agb_ctr_max_thd "Failure counter threshold. It authorize N successive failures before downgraded mode activation" VALUE 0xa0021525 _REC_S1VAL_20_u1 15. _CNV_A_R_ECME_LINEA_0_CM 0. 15. FORMAT "%2.0" /end CHARACTERISTIC
/begin CHARACTERISTIC Cxx_agb_int_rst_t "Time after we reset the integrator after a shift" VALUE 0xa0021526 _REC_S1VAL_20_u1 255. _CNV_A_R_LINEAR_____68_CM 0. 255. FORMAT "%3.0" /end CHARACTERISTIC
/begin CHARACTERISTIC Cxx_agb_max_tqe "Max value which can be set in CAN message list for torque" VALUE 0xa002150e _REC_S1VAL_20_u2 2047.96875 _CNV_A_R_LINEAR_____216_CM -400. 1647.96875 FORMAT "%10.5" /end CHARACTERISTIC
/begin CHARACTERISTIC Cxx_agb_slwr_neg "Negative torque slew rate calibration in case of protocol error" VALUE 0xa0021510 _REC_S1VAL_20_u2 10235. _CNV_A_R_LINEAR_____217_CM -10235. 0. FORMAT "%6.0" /end CHARACTERISTIC
/begin CHARACTERISTIC Cxx_agb_slwr_pos "Positive torque slew rate calibration in case of protocol error" VALUE 0xa0021512 _REC_S1VAL_20_u2 10235. _CNV_A_R_LINEAR_____218_CM 0. 10235. FORMAT "%5.0" /end CHARACTERISTIC
/begin CHARACTERISTIC Cxx_dfdec_agb_data "AGB data detected failure counter decrement" VALUE 0xa0021514 _REC_S1VAL_20_u2 65535. _CNV_A_R_ECME_LINEA_0_CM 0. 65535. FORMAT "%5.0" /end CHARACTERISTIC
/begin CHARACTERISTIC Cxx_dfdec_agb_no_frm "AGB Missing Message detected failure counter decrement" VALUE 0xa0021516 _REC_S1VAL_20_u2 65535. _CNV_A_R_ECME_LINEA_0_CM 0. 65535. FORMAT "%5.0" /end CHARACTERISTIC
/begin CHARACTERISTIC Cxx_dfinc_agb_data "AGB data detected failure counter increment" VALUE 0xa0021518 _REC_S1VAL_20_u2 65535. _CNV_A_R_ECME_LINEA_0_CM 0. 65535. FORMAT "%5.0" /end CHARACTERISTIC
/begin CHARACTERISTIC Cxx_dfinc_agb_no_frm "AGB Missing Message detected failure counter increment" VALUE 0xa002151a _REC_S1VAL_20_u2 65535. _CNV_A_R_ECME_LINEA_0_CM 0. 65535. FORMAT "%5.0" /end CHARACTERISTIC
/begin CHARACTERISTIC Cxx_dft_agb_tq_sp_lim "torque limitation applied when a wrong gear request occurs" VALUE 0xa002151c _REC_S1VAL_20_u2 2047.96875 _CNV_A_R_LINEAR_____216_CM -400. 1647.96875 FORMAT "%10.5" /end CHARACTERISTIC
/begin CHARACTERISTIC Cxx_i_agb_driv_tq_thd "Upper threshold of torque integrator detecting irregular shifts" VALUE 0xa002151e _REC_S1VAL_20_u2 6553.5 _CNV_A_R_LINEAR_____448_CM 0. 6553.5 FORMAT "%6.4" /end CHARACTERISTIC
/begin CHARACTERISTIC Cxx_max_gear_cge_dly "Maximum time allowed for a gear shift" VALUE 0xa0021527 _REC_S1VAL_20_u1 255. _CNV_A_R_LINEAR_____68_CM 0. 255. FORMAT "%3.0" /end CHARACTERISTIC
/begin CHARACTERISTIC Cxx_mux_agb_tqe_nok_raw "Raw CAN invalid value for AGB torque" VALUE 0xa0021520 _REC_S1VAL_20_u2 4095. _CNV_A_R_ECME_LINEA_0_CM 0. 4095. FORMAT "%4.0" /end CHARACTERISTIC
/begin MEASUREMENT Vxx_agb_driv_spt_fac "Sportivity factor calculated by Automatic Transmission" UBYTE _CNV_A_R_LINEAR_____162_CM 1 0. 0. 1. ECU_ADDRESS 0xd0006bc3 FORMAT "%9.7" /end MEASUREMENT
/begin MEASUREMENT Vsx_ant_crt_slc "Anticipated current gear shift" UBYTE _CNV_S_3_STATUS_ANT_449_CM 1 0. 1. 3. ECU_ADDRESS 0xd0006b8a /end MEASUREMENT
/begin MEASUREMENT Vsx_ant_crt_slc_vld "Anticipated current gear shift validity status" UBYTE _CNV_S_8_STATUS_OK__234_CM 1 0. 0. 7. ECU_ADDRESS 0xd0006b8b /end MEASUREMENT
/begin CHARACTERISTIC Cbx_ant_crt_slc_pres_cfm "AnticipatedCurrentShift information is provided by CAN" VALUE 0xa00214b0 _REC_S1VAL_20_u1 1. _CNV_S_2_RANGE______3_CM 0. 1. BIT_MASK 0x1 /end CHARACTERISTIC
/begin MEASUREMENT Vsx_prim_sha_spd_vld "Primary shaft speed validity status" UBYTE _CNV_S_8_STATUS_OK__234_CM 1 0. 0. 7. ECU_ADDRESS 0xd0006bc4 /end MEASUREMENT
/begin MEASUREMENT Vxx_prim_sha_spd "Primary shaft speed" UWORD _CNV_A_R_ENSD_LINEA_22_CM 1 0. 0. 16383.75 ECU_ADDRESS 0xd0004370 FORMAT "%8.2" /end MEASUREMENT
/begin MEASUREMENT Vbx_prg_appl_key_stt "Diag bit indicating that the ECM is in serial production" UBYTE _CNV_S_2_RANGE______3_CM 1 0. 0. 1. ECU_ADDRESS 0xd000623b BIT_MASK 0x1 /end MEASUREMENT
/begin MEASUREMENT Vbx_prg_req "programming request" UBYTE _CNV_S_2_RANGE______3_CM 1 0. 0. 1. ECU_ADDRESS 0xd000623c BIT_MASK 0x1 /end MEASUREMENT
/begin MEASUREMENT Vxx_prg_appl_key "Application Key made available for further use" UWORD _CNV_A_R_ECME_LINEA_0_CM 1 0. 0. 65535. ECU_ADDRESS 0xd0003c82 FORMAT "%5.0" /end MEASUREMENT
/begin MEASUREMENT Vxx_prg_ecm_stt "Engine Control Management status for reprogramming (application operating or not)" UBYTE _CNV_A_R_ECME_LINEA_0_CM 1 0. 0. 255. ECU_ADDRESS 0xd000623d FORMAT "%3.0" /end MEASUREMENT
/begin MEASUREMENT Vxx_raw_ac_prs "Raw air conditioning pressure voltage" UWORD _CNV_A_R_LINEAR_____205_CM 1 0. 0. 60. ECU_ADDRESS 0xd0003c7e FORMAT "%5.2" /end MEASUREMENT
/begin MEASUREMENT v_acp "Air conditioning pressure voltage" UWORD _CNV_A_R_LINEAR_____14_CM 1 0. 0. 4.99984741210938 ECU_ADDRESS 0xd0003ef4 FORMAT "%6.4" /end MEASUREMENT
/begin MEASUREMENT Vbx_df_sens_rvc_h "Tank differential pressure sensor high signal detected failure" UBYTE _CNV_S_2_RANGE______3_CM 1 0. 0. 1. ECU_ADDRESS 0xd00064da BIT_MASK 0x1 /end MEASUREMENT
/begin MEASUREMENT Vbx_df_sens_rvc_l "Tank differential pressure sensor low signal detected failure" UBYTE _CNV_S_2_RANGE______3_CM 1 0. 0. 1. ECU_ADDRESS 0xd00064db BIT_MASK 0x1 /end MEASUREMENT
/begin MEASUREMENT Vbx_df_sens_rvc_nok "Tank differential pressure sensor noisy signal detected failure" UBYTE _CNV_S_2_RANGE______3_CM 1 0. 0. 1. ECU_ADDRESS 0xd00064dc BIT_MASK 0x1 /end MEASUREMENT
/begin MEASUREMENT Vbx_df_sens_rvc_sig_mcut "Tank differential pressure sensor constant signal detected failure" UBYTE _CNV_S_2_RANGE______3_CM 1 0. 0. 1. ECU_ADDRESS 0xd00064dd BIT_MASK 0x1 /end MEASUREMENT
/begin MEASUREMENT Vbx_diag_ena_sens_rvc_h "Tank differential pressure sensor high signal diagnosis information available" UBYTE _CNV_S_2_RANGE______3_CM 1 0. 0. 1. ECU_ADDRESS 0xd00064de BIT_MASK 0x1 /end MEASUREMENT
/begin MEASUREMENT Vbx_diag_ena_sens_rvc_l "Tank differential pressure sensor low signal diagnosis information available" UBYTE _CNV_S_2_RANGE______3_CM 1 0. 0. 1. ECU_ADDRESS 0xd00064df BIT_MASK 0x1 /end MEASUREMENT
/begin MEASUREMENT Vbx_diag_ena_sens_rvc_nok "Tank differential pressure sensor noisy signal diagnosis information available" UBYTE _CNV_S_2_RANGE______3_CM 1 0. 0. 1. ECU_ADDRESS 0xd00064e0 BIT_MASK 0x1 /end MEASUREMENT
/begin MEASUREMENT Vbx_diag_ena_sens_rvc_sig_mcut "Tank differential pressure sensor noisy signal diagnosis information available" UBYTE _CNV_S_2_RANGE______3_CM 1 0. 0. 1. ECU_ADDRESS 0xd00064e1 BIT_MASK 0x1 /end MEASUREMENT
/begin MEASUREMENT Vbx_raw_min_fuel2 "Raw information of the minimum level detection of the additional tank" UBYTE _CNV_S_2_RANGE______3_CM 1 0. 0. 1. ECU_ADDRESS 0xd00064e2 BIT_MASK 0x1 /end MEASUREMENT
/begin MEASUREMENT Vxx_raw_sens_rvac "Raw Tank differential pressure" SBYTE _CNV_A_R_LINEAR_____115_CM 1 0. -100. 100. ECU_ADDRESS 0xd00064d8 FORMAT "%4.0" /end MEASUREMENT
/begin MEASUREMENT Vbx_sens_bgin_clu_cnt_lk_stt "Begin clutch contactor connection status (1 = connected; 0 = not connected). Stored in EEPROM" UBYTE _CNV_S_2_RANGE______3_CM 1 0. 0. 1. DISPLAY_IDENTIFIER InPciDls_NVM.Vbx_sens_bgin_clu_cnt_lk_stt_NVM ECU_ADDRESS 0xd0006c4c BIT_MASK 0x1 /end MEASUREMENT
/begin MEASUREMENT Vxx_bgin_clu_off_no_chr_ctr_NVM "Number of incoherencies when the begin clutch contactor is OFF" UBYTE _CNV_A_R_ECME_LINEA_0_CM 1 0. 0. 255. DISPLAY_IDENTIFIER InPciDls_NVM.Vxx_bgin_clu_off_no_chr_ctr_NVM ECU_ADDRESS 0xd0006c4d FORMAT "%3.0" /end MEASUREMENT
/begin MEASUREMENT Vxx_bgin_clu_on_no_chr_ctr_NVM "Number of incoherencies when the begin clutch contactor is ON" UBYTE _CNV_A_R_ECME_LINEA_0_CM 1 0. 0. 255. DISPLAY_IDENTIFIER InPciDls_NVM.Vxx_bgin_clu_on_no_chr_ctr_NVM ECU_ADDRESS 0xd0006c4e FORMAT "%3.0" /end MEASUREMENT
/begin MEASUREMENT Vsx_end_str_clu_cnt "End stroke clutch pedal switch" UBYTE _CNV_S_3_CNT_INDICA_450_CM 1 0. 0. 2. ECU_ADDRESS 0xd0006c49 /end MEASUREMENT
/begin MEASUREMENT Vsx_neut_cnt "Neutral engaged switch for manual gearbox" UBYTE _CNV_A_R_ECME_LINEA_0_CM 1 0. 0. 2. ECU_ADDRESS 0xd0006c4a FORMAT "%1.0" /end MEASUREMENT
/begin MEASUREMENT Vsx_rvr_cnt " Reverse gear engaged switch for manual gearbox" UBYTE _CNV_A_R_ECME_LINEA_0_CM 1 0. 0. 2. ECU_ADDRESS 0xd0006c4b FORMAT "%1.0" /end MEASUREMENT
/begin AXIS_PTS Ctb_coup "Breakpoint calibration of transmission coupler states" 0xa00215ba Vxx_ant_coup _REC_A2AXS_20_u1 255. _CNV_A_R_ECME_LINEA_0_CM 3 0. 255. FORMAT "%3.0" /end AXIS_PTS
/begin AXIS_PTS Ntb_coup "Coupler state breakpoint (1=close; 2=sliding; 8=open)" 0xa00215be NO_INPUT_QUANTITY _REC_A2AXS_20_u1 255. _CNV_A_R_ECME_LINEA_0_CM 3 0. 255. READ_ONLY FORMAT "%3.0" /end AXIS_PTS
/begin AXIS_PTS Ntb_gear "Gearbox ratio breakpoint" 0xa002da28 Vxx_gear _REC_A2AXS_20_u1 7. _CNV_A_R_LINEAR_____145_CM 8 -1. 6. READ_ONLY FORMAT "%2.0" /end AXIS_PTS
/begin MEASUREMENT Vsx_ant_coup_vld "Anticipated (forecast) transmission coupler state validity status" UBYTE _CNV_A_R_ECME_LINEA_0_CM 1 0. 0. 2. ECU_ADDRESS 0xd0006c50 FORMAT "%1.0" /end MEASUREMENT
/begin MEASUREMENT Vsx_ant_gear "Anticipated gear engaged" UBYTE _CNV_A_R_LINEAR_____145_CM 1 0. -1. 6. ECU_ADDRESS 0xd0006c51 FORMAT "%2.0" /end MEASUREMENT
/begin MEASUREMENT Vsx_ant_gear_vld "Anticipated gear engaged validity status" UBYTE _CNV_A_R_ECME_LINEA_0_CM 1 0. 0. 2. ECU_ADDRESS 0xd0006c52 FORMAT "%1.0" /end MEASUREMENT
/begin MEASUREMENT Vsx_coup_vld "Coupler state (1 : closed ; 2 : sliding ; 8 : open) validity status" UBYTE _CNV_A_R_ECME_LINEA_0_CM 1 0. 0. 2. ECU_ADDRESS 0xd0006c53 FORMAT "%1.0" /end MEASUREMENT
/begin MEASUREMENT Vsx_dlin_conf "State data of driveline configuration (Transmission type)." UBYTE _CNV_A_R_ECME_LINEA_0_CM 1 0. 0. 255. ECU_ADDRESS 0xd0006c54 FORMAT "%3.0" /end MEASUREMENT
/begin MEASUREMENT Vsx_gear "Gear engaged" UBYTE _CNV_A_R_LINEAR_____145_CM 1 0. -1. 6. ECU_ADDRESS 0xd0006c55 FORMAT "%2.0" /end MEASUREMENT
/begin MEASUREMENT Vsx_gear_vld "Gear engaged ( [-1 0 1 2 3 4 5 6] ) validity status" UBYTE _CNV_A_R_ECME_LINEA_0_CM 1 0. 0. 2. ECU_ADDRESS 0xd0006c56 FORMAT "%1.0" /end MEASUREMENT
/begin MEASUREMENT Vxx_ant_coup "Anticipated (forecast) transmission coupler state" UBYTE _CNV_A_R_ECME_LINEA_0_CM 1 0. 0. 255. ECU_ADDRESS 0xd0006c57 FORMAT "%3.0" /end MEASUREMENT
/begin MEASUREMENT Vxx_ant_gear "Anticipated gear engaged" UBYTE _CNV_A_R_LINEAR_____145_CM 1 0. -1. 6. ECU_ADDRESS 0xd0006c58 FORMAT "%2.0" /end MEASUREMENT
/begin MEASUREMENT Vxx_coup "Coupler state (1 : closed ; 2 : sliding ; 8 : open)" UBYTE _CNV_A_R_ECME_LINEA_0_CM 1 0. 0. 255. ECU_ADDRESS 0xd0006c59 FORMAT "%3.0" /end MEASUREMENT
/begin MEASUREMENT Vxx_gear "Gear engaged ( [-1 0 1 2 3 4 5 6] )" UBYTE _CNV_A_R_LINEAR_____145_CM 1 0. -1. 6. ECU_ADDRESS 0xd0006c5a FORMAT "%2.0" /end MEASUREMENT
/begin CHARACTERISTIC Csx_dlin_conf "Calibration which specifies the type of the transmission (transmission configuration)" VALUE 0xa00215c2 _REC_S1VAL_20_u1 255. _CNV_A_R_ECME_LINEA_0_CM 0. 255. FORMAT "%3.0" /end CHARACTERISTIC
/begin MEASUREMENT Vbx_run_vh "Vehicle run detected" UBYTE _CNV_S_2_RANGE______3_CM 1 0. 0. 1. ECU_ADDRESS 0xd0006c5d BIT_MASK 0x1 /end MEASUREMENT
/begin MEASUREMENT Vsx_run_vh_vld "Vehicle run detected validity status" UBYTE _CNV_A_R_ECME_LINEA_0_CM 1 0. 0. 2. ECU_ADDRESS 0xd0006c5e FORMAT "%1.0" /end MEASUREMENT
/begin MEASUREMENT Vsx_vs_n_rat_fil_vld "Filtered Ratio validity status" UBYTE _CNV_A_R_ECME_LINEA_0_CM 1 0. 0. 2. ECU_ADDRESS 0xd0006c5f FORMAT "%1.0" /end MEASUREMENT
/begin MEASUREMENT Vxx_vs_n_rat "Non filtered but quantized and saturated value of V/Neng ratio. If equal to -10, ratio is incorrect" SWORD _CNV_A_R_LINEAR_____396_CM 1 0. -10. 200. ECU_ADDRESS 0xd00043ac FORMAT "%6.2" /end MEASUREMENT
/begin MEASUREMENT Vxx_vs_n_rat_fil "Vxx_vs_n_rat_fil : Filtered value of VehicleSpeed/Neng ratio. If equal to -10, ratio value is incoherent." UWORD _CNV_A_R_LINEAR_____197_CM 1 0. -10. 200. ECU_ADDRESS 0xd00043ae FORMAT "%6.2" /end MEASUREMENT
/begin CHARACTERISTIC Cxx_down_bkp_vs_neut "Down breakpoint on vehicle speed in order to detect a vehicle stop" VALUE 0xa00215c4 _REC_S1VAL_20_u2 655.35 _CNV_A_R_LINEAR_____125_CM 0. 655.35 FORMAT "%6.2" /end CHARACTERISTIC
/begin CHARACTERISTIC Cxx_vs_n_rat_dft_max "Max value of V/Neng ratio." VALUE 0xa00215c6 _REC_S1VAL_20_s2 210. _CNV_A_R_LINEAR_____396_CM -10. 200. FORMAT "%6.2" /end CHARACTERISTIC
/begin CHARACTERISTIC Cxx_vs_n_rat_dft_min "Default value of V/Neng ratio if calculation of real value can't be done." VALUE 0xa00215c8 _REC_S1VAL_20_s2 210. _CNV_A_R_LINEAR_____396_CM -10. 200. FORMAT "%6.2" /end CHARACTERISTIC
/begin CHARACTERISTIC Cxx_vs_n_rat_fil_fac1 "First time constant of second order numeric filter of ratio V/N" VALUE 0xa00215cc _REC_S1VAL_20_u1 2.55 _CNV_A_R_LINEAR_____32_CM 0. 2.55 FORMAT "%4.2" /end CHARACTERISTIC
/begin CHARACTERISTIC Cxx_vs_n_rat_fil_fac2 "Second time constant of second order numeric filter of ratio V/N" VALUE 0xa00215cd _REC_S1VAL_20_u1 2.55 _CNV_A_R_LINEAR_____32_CM 0. 2.55 FORMAT "%4.2" /end CHARACTERISTIC
/begin CHARACTERISTIC Cxx_vs_n_rat_min_n_bkp "Minimal engine speed that enables Vehicle_speed/Engine_speed ratio calculation" VALUE 0xa00215ca _REC_S1VAL_20_u2 16383.75 _CNV_A_R_ENSD_LINEA_22_CM 0. 16383.75 FORMAT "%8.2" /end CHARACTERISTIC
/begin MEASUREMENT Vsx_ant_rat_gear "Anticipated Ratio Gear: identified with large true range of the ratio Vspeed/Neng." UBYTE _CNV_A_R_LINEAR_____145_CM 1 0. -1. 6. ECU_ADDRESS 0xd0006c62 FORMAT "%2.0" /end MEASUREMENT
/begin MEASUREMENT Vsx_rat_gear "Ratio Gear:gearbox gear identified with thin true range of the ratio Vspeed/Neng." UBYTE _CNV_A_R_LINEAR_____145_CM 1 0. -1. 6. ECU_ADDRESS 0xd0006c63 FORMAT "%2.0" /end MEASUREMENT
/begin MEASUREMENT Vtx_gear_rat_tgt[0] "Calibration vector of gear ratio targets: Neutral, 1st_gear,..., 6th_gear." UWORD _CNV_A_R_LINEAR_____396_CM 1 0. 0. 200. ECU_ADDRESS 0xd00043b0 FORMAT "%6.2" /end MEASUREMENT
/begin MEASUREMENT Vtx_gear_rat_tgt[1] "Calibration vector of gear ratio targets: Neutral, 1st_gear,..., 6th_gear." UWORD _CNV_A_R_LINEAR_____396_CM 1 0. 0. 200. ECU_ADDRESS 0xd00043b2 FORMAT "%6.2" /end MEASUREMENT
/begin MEASUREMENT Vtx_gear_rat_tgt[2] "Calibration vector of gear ratio targets: Neutral, 1st_gear,..., 6th_gear." UWORD _CNV_A_R_LINEAR_____396_CM 1 0. 0. 200. ECU_ADDRESS 0xd00043b4 FORMAT "%6.2" /end MEASUREMENT
/begin MEASUREMENT Vtx_gear_rat_tgt[3] "Calibration vector of gear ratio targets: Neutral, 1st_gear,..., 6th_gear." UWORD _CNV_A_R_LINEAR_____396_CM 1 0. 0. 200. ECU_ADDRESS 0xd00043b6 FORMAT "%6.2" /end MEASUREMENT
/begin MEASUREMENT Vtx_gear_rat_tgt[4] "Calibration vector of gear ratio targets: Neutral, 1st_gear,..., 6th_gear." UWORD _CNV_A_R_LINEAR_____396_CM 1 0. 0. 200. ECU_ADDRESS 0xd00043b8 FORMAT "%6.2" /end MEASUREMENT
/begin MEASUREMENT Vtx_gear_rat_tgt[5] "Calibration vector of gear ratio targets: Neutral, 1st_gear,..., 6th_gear." UWORD _CNV_A_R_LINEAR_____396_CM 1 0. 0. 200. ECU_ADDRESS 0xd00043ba FORMAT "%6.2" /end MEASUREMENT
/begin MEASUREMENT Vtx_gear_rat_tgt[6] "Calibration vector of gear ratio targets: Neutral, 1st_gear,..., 6th_gear." UWORD _CNV_A_R_LINEAR_____396_CM 1 0. 0. 200. ECU_ADDRESS 0xd00043bc FORMAT "%6.2" /end MEASUREMENT
/begin MEASUREMENT Vxx_down_rat_gear_bkp_tgt "Down limit of true range for the current anticipated ratio gear." UWORD _CNV_A_R_LINEAR_____396_CM 1 0. 0. 200. ECU_ADDRESS 0xd00043be FORMAT "%6.2" /end MEASUREMENT
/begin MEASUREMENT Vxx_mv_1_2_gear_rat_tgt "Median value of gears ratio targets of the1st and the 2nd gears" UWORD _CNV_A_R_LINEAR_____396_CM 1 0. 0. 200. ECU_ADDRESS 0xd00043c0 FORMAT "%6.2" /end MEASUREMENT
/begin MEASUREMENT Vxx_mv_2_3_gear_rat_tgt "Median value of gears ratio targets of the 2nd and the 3rd gears" UWORD _CNV_A_R_LINEAR_____396_CM 1 0. 0. 200. ECU_ADDRESS 0xd00043c2 FORMAT "%6.2" /end MEASUREMENT
/begin MEASUREMENT Vxx_mv_3_4_gear_rat_tgt "Median value of gears ratio targets of the3rd and the 4th gears" UWORD _CNV_A_R_LINEAR_____396_CM 1 0. 0. 200. ECU_ADDRESS 0xd00043c4 FORMAT "%6.2" /end MEASUREMENT
/begin MEASUREMENT Vxx_mv_4_5_gear_rat_tgt "Median value of gears ratio targets of the 4th and the 5th gears" UWORD _CNV_A_R_LINEAR_____396_CM 1 0. 0. 200. ECU_ADDRESS 0xd00043c6 FORMAT "%6.2" /end MEASUREMENT
/begin MEASUREMENT Vxx_mv_5_6_gear_rat_tgt "Median value of gears ratio targets of the 5th and the 6th gears" UWORD _CNV_A_R_LINEAR_____396_CM 1 0. 0. 200. ECU_ADDRESS 0xd00043c8 FORMAT "%6.2" /end MEASUREMENT
/begin MEASUREMENT Vxx_rat_tgt "Gear ratio target of the current possible gear." UWORD _CNV_A_R_LINEAR_____396_CM 1 0. 0. 200. ECU_ADDRESS 0xd00043ca FORMAT "%6.2" /end MEASUREMENT
/begin MEASUREMENT Vxx_up_rat_gear_bkp_tgt "Up limit of true range for the current anticipated ratio gear." UWORD _CNV_A_R_LINEAR_____396_CM 1 0. 0. 200. ECU_ADDRESS 0xd00043cc FORMAT "%6.2" /end MEASUREMENT
/begin CHARACTERISTIC Cbx_no_ant_gear_fil_cfm "Boolean enabling the ratio filtering for ant gear detection" VALUE 0xa00215e6 _REC_S1VAL_20_u1 1. _CNV_A_R_ECME_LINEA_0_CM 0. 1. FORMAT "%1.0" BIT_MASK 0x1 /end CHARACTERISTIC
/begin CHARACTERISTIC Cxx_1_gear_rat_tgt "First gear ratio target" VALUE 0xa00215ce _REC_S1VAL_20_u2 200. _CNV_A_R_LINEAR_____396_CM 0. 200. FORMAT "%6.2" /end CHARACTERISTIC
/begin CHARACTERISTIC Cxx_2_gear_rat_tgt "Second gear ratio target" VALUE 0xa00215d0 _REC_S1VAL_20_u2 200. _CNV_A_R_LINEAR_____396_CM 0. 200. FORMAT "%6.2" /end CHARACTERISTIC
/begin CHARACTERISTIC Cxx_3_gear_rat_tgt "Third gear ratio target" VALUE 0xa00215d2 _REC_S1VAL_20_u2 200. _CNV_A_R_LINEAR_____396_CM 0. 200. FORMAT "%6.2" /end CHARACTERISTIC
/begin CHARACTERISTIC Cxx_4_gear_rat_tgt "Fourth gear ratio target" VALUE 0xa00215d4 _REC_S1VAL_20_u2 200. _CNV_A_R_LINEAR_____396_CM 0. 200. FORMAT "%6.2" /end CHARACTERISTIC
/begin CHARACTERISTIC Cxx_5_gear_rat_tgt "Fifth gear ratio target" VALUE 0xa00215d6 _REC_S1VAL_20_u2 200. _CNV_A_R_LINEAR_____396_CM 0. 200. FORMAT "%6.2" /end CHARACTERISTIC
/begin CHARACTERISTIC Cxx_6_gear_rat_tgt "Sixth gear ratio target" VALUE 0xa00215d8 _REC_S1VAL_20_u2 200. _CNV_A_R_LINEAR_____396_CM 0. 200. FORMAT "%6.2" /end CHARACTERISTIC
/begin CHARACTERISTIC Cxx_h_gear_win_thd " Window size calibration for detection of new gear engaged (high gears)" VALUE 0xa00215da _REC_S1VAL_20_u2 200. _CNV_A_R_LINEAR_____396_CM 0. 200. FORMAT "%6.2" /end CHARACTERISTIC
/begin CHARACTERISTIC Cxx_l_gear_max "Gear ratio to searate low gears engaged from high gears engaged" VALUE 0xa00215dc _REC_S1VAL_20_u2 200. _CNV_A_R_LINEAR_____396_CM 0. 200. FORMAT "%6.2" /end CHARACTERISTIC
/begin CHARACTERISTIC Cxx_l_gear_win_thd " Window size calibration for detection of new gear engaged (low gears)" VALUE 0xa00215de _REC_S1VAL_20_u2 200. _CNV_A_R_LINEAR_____396_CM 0. 200. FORMAT "%6.2" /end CHARACTERISTIC
/begin CHARACTERISTIC Cxx_max_vs_n_rat "Maximal Vspeed/Neng speed ratio before declaring that Rat Gear is Not Identified." VALUE 0xa00215e0 _REC_S1VAL_20_u2 200. _CNV_A_R_LINEAR_____396_CM 0. 200. FORMAT "%6.2" /end CHARACTERISTIC
/begin CHARACTERISTIC Cxx_min_vs_n_rat "Minimal Vspeed/Neng speed ratio before declaring that Rat Gear is Neutral." VALUE 0xa00215e2 _REC_S1VAL_20_u2 200. _CNV_A_R_LINEAR_____396_CM 0. 200. FORMAT "%6.2" /end CHARACTERISTIC
/begin CHARACTERISTIC Cxx_neut_gear_rat_tgt "Neutral gear ratio target" VALUE 0xa00215e4 _REC_S1VAL_20_u2 200. _CNV_A_R_LINEAR_____396_CM 0. 200. FORMAT "%6.2" /end CHARACTERISTIC
/begin CHARACTERISTIC Cxx_vs_n_rat_ant_gear_ftc1 "First time constant of second order numeric filter of ratio V/N for Ant Gear detection" VALUE 0xa00215e7 _REC_S1VAL_20_u1 2.55 _CNV_A_R_LINEAR_____32_CM 0. 2.55 FORMAT "%4.2" /end CHARACTERISTIC
/begin CHARACTERISTIC Cxx_vs_n_rat_ant_gear_ftc2 "Second time constant of second order numeric filter of ratio V/N for Ant Gear detection" VALUE 0xa00215e8 _REC_S1VAL_20_u1 2.55 _CNV_A_R_LINEAR_____32_CM 0. 2.55 FORMAT "%4.2" /end CHARACTERISTIC
/begin AXIS_PTS Ctb_toil "engine oil temperature breakpoints" 0xa002d4e4 Vxx_toil _REC_A2AXS_20_u2 240. _CNV_A_R_LINEAR_____110_CM 16 -40. 200. FORMAT "%5.1" /end AXIS_PTS
/begin COMPU_METHOD _CNV_A_R_ECME_LINEA_0_CM "" RAT_FUNC "%6.3" "-" COEFFS 0 1. 0. 0 0 1 /end COMPU_METHOD
/begin COMPU_METHOD _CNV_A_R_LINEAR_____2_CM "" RAT_FUNC "%6.3" "rpm" COEFFS 0 3.125e-002 0. 0 0 1 /end COMPU_METHOD
/begin COMPU_METHOD _CNV_S_2_RANGE______3_CM "" TAB_VERB "%6.3" "-" COMPU_TAB_REF _CNV_S_2_RANGE______3 /end COMPU_METHOD
/begin COMPU_VTAB _CNV_S_2_RANGE______3 "" TAB_VERB 2 0 "0" 1 "1" /end COMPU_VTAB
/begin COMPU_METHOD _CNV_A_R_LINEAR_____14_CM "" RAT_FUNC "%6.3" "V" COEFFS 0 6553.599999999993 0. 0 0 1 /end COMPU_METHOD
/begin COMPU_METHOD _CNV_A_R_ENSD_LINEA_22_CM "" RAT_FUNC "%6.3" "rpm" COEFFS 0 4. 0. 0 0 1 /end COMPU_METHOD
/begin COMPU_METHOD _CNV_A_R_LINEAR_____32_CM "" RAT_FUNC "%6.3" "s" COEFFS 0 100. 0. 0 0 1 /end COMPU_METHOD
/begin COMPU_METHOD _CNV_A_R_LINEAR_____42_CM "" RAT_FUNC "%6.3" "-" COEFFS 0 128. 0. 0 0 1 /end COMPU_METHOD
/begin COMPU_METHOD _CNV_A_R_LINEAR_____58_CM "" RAT_FUNC "%6.3" "s" COEFFS 0 10. 0. 0 0 1 /end COMPU_METHOD
/begin COMPU_METHOD _CNV_A_R_LINEAR_____68_CM "" RAT_FUNC "%6.3" "s" COEFFS 0 1. 0. 0 0 1 /end COMPU_METHOD
/begin COMPU_METHOD _CNV_A_R_LINEAR_____77_CM "" RAT_FUNC "%6.3" "mg/stk" COEFFS 0 0.183585313174946 0. 0 0 1 /end COMPU_METHOD
/begin COMPU_METHOD _CNV_A_R_LINEAR_____83_CM "" RAT_FUNC "%6.3" "-" COEFFS 0 64. 0. 0 0 1 /end COMPU_METHOD
/begin COMPU_METHOD _CNV_A_R_LINEAR_____101_CM "" RAT_FUNC "%6.3" "TDC" COEFFS 0 1. 0. 0 0 1 /end COMPU_METHOD
/begin COMPU_METHOD _CNV_A_R_LINEAR_____107_CM "" RAT_FUNC "%6.3" "mV" COEFFS 0 1. 0. 0 0 1 /end COMPU_METHOD
/begin COMPU_METHOD _CNV_A_R_LINEAR_____110_CM "" RAT_FUNC "%6.3" "°C" COEFFS 0 10. 400. 0 0 1 /end COMPU_METHOD
/begin COMPU_METHOD _CNV_A_R_LINEAR_____115_CM "" RAT_FUNC "%6.3" "hPa" COEFFS 0 1. 0. 0 0 1 /end COMPU_METHOD
/begin COMPU_METHOD _CNV_A_R_LINEAR_____116_CM "" RAT_FUNC "%6.3" "s" COEFFS 0 1000. 0. 0 0 1 /end COMPU_METHOD
/begin COMPU_METHOD _CNV_A_R_LINEAR_____125_CM "" RAT_FUNC "%6.3" "km/h" COEFFS 0 100. 0. 0 0 1 /end COMPU_METHOD
/begin COMPU_METHOD _CNV_A_R_LINEAR_____129_CM "" RAT_FUNC "%6.3" "°CRK" COEFFS 0 50. 0. 0 0 1 /end COMPU_METHOD
/begin COMPU_METHOD _CNV_A_R_LINEAR_____145_CM "" RAT_FUNC "%6.3" "-" COEFFS 0 1. 1. 0 0 1 /end COMPU_METHOD
/begin COMPU_METHOD _CNV_A_R_LINEAR_____146_CM "" RAT_FUNC "%6.3" "%" COEFFS 0 100. 0. 0 0 1 /end COMPU_METHOD
/begin COMPU_METHOD _CNV_A_R_LINEAR_____161_CM "" RAT_FUNC "%6.3" "-" COEFFS 0 1000. 0. 0 0 1 /end COMPU_METHOD
/begin COMPU_METHOD _CNV_A_R_LINEAR_____162_CM "" RAT_FUNC "%6.3" "-" COEFFS 0 255. 0. 0 0 1 /end COMPU_METHOD
/begin COMPU_METHOD _CNV_A_R_LINEAR_____166_CM "" RAT_FUNC "%6.3" "-" COEFFS 0 655.35 0. 0 0 1 /end COMPU_METHOD
/begin COMPU_METHOD _CNV_A_R_LINEAR_____167_CM "" RAT_FUNC "%6.3" "-" COEFFS 0 196607.9999999997 0. 0 0 1 /end COMPU_METHOD
/begin COMPU_METHOD _CNV_A_R_LINEAR_____172_CM "" RAT_FUNC "%6.3" "kg/h" COEFFS 0 20. 0. 0 0 1 /end COMPU_METHOD
/begin COMPU_METHOD _CNV_S_3_STATUS_OK__179_CM "" TAB_VERB "%6.3" "-" COMPU_TAB_REF _CNV_S_3_STATUS_OK__179 /end COMPU_METHOD
/begin COMPU_VTAB _CNV_S_3_STATUS_OK__179 "" TAB_VERB 3 0 "Nsx_vld_nok_0" 1 "Nsx_vld_ok_1" 2 "Nsx_vld_fail_2" /end COMPU_VTAB
/begin COMPU_METHOD _CNV_A_R_LINEAR_____181_CM "" RAT_FUNC "%6.3" "Nm" COEFFS 0 32. 0. 0 0 1 /end COMPU_METHOD
/begin COMPU_METHOD _CNV_A_R_LINEAR_____183_CM "" RAT_FUNC "%6.3" "-" COEFFS 0 1024. 0. 0 0 1 /end COMPU_METHOD
/begin COMPU_METHOD _CNV_A_R_LINEAR_____185_CM "" RAT_FUNC "%6.3" "Nm" COEFFS 0 32. 32768. 0 0 1 /end COMPU_METHOD
/begin COMPU_METHOD _CNV_A_R_LINEAR_____197_CM "" RAT_FUNC "%6.3" "(km/h)/K*rpm" COEFFS 0 100. 1000. 0 0 1 /end COMPU_METHOD
/begin COMPU_METHOD _CNV_A_R_LINEAR_____201_CM "" RAT_FUNC "%6.3" "ms" COEFFS 0 1. 0. 0 0 1 /end COMPU_METHOD
/begin COMPU_METHOD _CNV_A_R_LINEAR_____202_CM "" RAT_FUNC "%6.3" "µs" COEFFS 0 1. 0. 0 0 1 /end COMPU_METHOD
/begin COMPU_METHOD _CNV_A_R_LINEAR_____205_CM "" RAT_FUNC "%6.3" "V" COEFFS 0 100. 0. 0 0 1 /end COMPU_METHOD
/begin COMPU_METHOD _CNV_S_16_RANGE_ERR__206_CM "" TAB_VERB "%6.3" "" COMPU_TAB_REF _CNV_S_16_RANGE_ERR__206 /end COMPU_METHOD
/begin COMPU_VTAB _CNV_S_16_RANGE_ERR__206 "" TAB_VERB 16 0 "NO_SYM" 1 "SYM_0" 2 "SYM_1" 3 "SYM_0, SYM_1" 4 "SYM_2" 5 "SYM_0, SYM_2" 6 "SYM_1, SYM_2" 7 "SYM_0, SYM_1, SYM_2" 8 "SYM_3" 9 "SYM_0, SYM_3" 10 "SYM_1, SYM_3" 11 "SYM_0, SYM_1,SYM_3" 12 "SYM_2, SYM_3" 13 "SYM_0, SYM_2, SYM_3" 14 "SYM_1, SYM_2, SYM_3" 15 "SYM_0, SYM_1, SYM_2, SYM_3" /end COMPU_VTAB
/begin COMPU_METHOD _CNV_S_3_STATUS_OK__213_CM "" TAB_VERB "%6.3" "" COMPU_TAB_REF _CNV_S_3_STATUS_OK__213 /end COMPU_METHOD
/begin COMPU_VTAB _CNV_S_3_STATUS_OK__213 "" TAB_VERB 3 0 "Nsx_vld_nok_0" 1 "Nsx_vld_ok_1" 2 "Nsx_vld_fail_2" /end COMPU_VTAB
/begin COMPU_METHOD _CNV_A_R_LINEAR_____216_CM "" RAT_FUNC "%6.3" "Nm" COEFFS 0 32. 12800. 0 0 1 /end COMPU_METHOD
/begin COMPU_METHOD _CNV_A_R_LINEAR_____217_CM "" RAT_FUNC "%6.3" "Nm/s" COEFFS 0 -0.2 0. 0 0 1 /end COMPU_METHOD
/begin COMPU_METHOD _CNV_A_R_LINEAR_____218_CM "" RAT_FUNC "%6.3" "Nm/s" COEFFS 0 0.2 0. 0 0 1 /end COMPU_METHOD
/begin COMPU_METHOD _CNV_S_8_STATUS_OK__234_CM "" TAB_VERB "%6.3" "-" COMPU_TAB_REF _CNV_S_8_STATUS_OK__234 /end COMPU_METHOD
/begin COMPU_VTAB _CNV_S_8_STATUS_OK__234 "" TAB_VERB 8 0 "Nsx_vld_nok_0" 1 "Nsx_vld_ok_1" 2 "Nsx_vld_fail_2" 3 "Nsx_vld_fail_3" 4 "Nsx_vld_fail_4" 5 "Nsx_vld_fail_5" 6 "Nsx_vld_fail_6" 7 "Nsx_vld_fail_7" /end COMPU_VTAB
/begin COMPU_METHOD _CNV_A_R_LINEAR_____280_CM "" RAT_FUNC "%6.3" "°C" COEFFS 0 1. 40. 0 0 1 /end COMPU_METHOD
/begin COMPU_METHOD _CNV_A_R_LINEAR_____290_CM "" RAT_FUNC "%6.3" "Hz" COEFFS 0 1. 0. 0 0 1 /end COMPU_METHOD
/begin COMPU_METHOD _CNV_A_R_LINEAR_____319_CM "" RAT_FUNC "%6.3" "ratio" COEFFS 0 800. 0. 0 0 1 /end COMPU_METHOD
/begin COMPU_METHOD _CNV_A_R_LINEAR_____329_CM "" RAT_FUNC "%6.3" "s" COEFFS 0 4. 0. 0 0 1 /end COMPU_METHOD
/begin COMPU_METHOD _CNV_A_R_LINEAR_____396_CM "" RAT_FUNC "%6.3" "(km/h)/K*rpm" COEFFS 0 100. 0. 0 0 1 /end COMPU_METHOD
/begin COMPU_METHOD _CNV_A_R_LINEAR_____413_CM "" RAT_FUNC "%6.3" "1/s" COEFFS 0 100. 0. 0 0 1 /end COMPU_METHOD
/begin COMPU_METHOD _CNV_A_R_LINEAR_____414_CM "" RAT_FUNC "%6.3" "%" COEFFS 0 256. 0. 0 0 1 /end COMPU_METHOD
/begin COMPU_METHOD _CNV_A_R_LINEAR_____415_CM "" RAT_FUNC "%6.3" "%/°Crk" COEFFS 0 100. 0. 0 0 1 /end COMPU_METHOD
/begin COMPU_METHOD _CNV_A_R_LINEAR_____416_CM "" RAT_FUNC "%6.3" "µs²" COEFFS 0 1.525902189669642e-005 0. 0 0 1 /end COMPU_METHOD
/begin COMPU_METHOD _CNV_A_R_LINEAR_____417_CM "" RAT_FUNC "%6.3" "%/s" COEFFS 0 16. 0. 0 0 1 /end COMPU_METHOD
/begin COMPU_METHOD _CNV_A_R_LINEAR_____418_CM "" RAT_FUNC "%6.3" "%" COEFFS 0 128.0005468856814 32768.14000273443 0 0 1 /end COMPU_METHOD
/begin COMPU_METHOD _CNV_A_R_LINEAR_____419_CM "" RAT_FUNC "%6.3" "%" COEFFS 0 128. 32768. 0 0 1 /end COMPU_METHOD
/begin COMPU_METHOD _CNV_A_R_LINEAR_____420_CM "" RAT_FUNC "%6.3" "%" COEFFS 0 8388608.000000011 2147483648.000003 0 0 1 /end COMPU_METHOD
/begin COMPU_METHOD _CNV_A_R_LINEAR_____421_CM "" RAT_FUNC "%6.3" "%" COEFFS 0 100. 20000. 0 0 1 /end COMPU_METHOD
/begin COMPU_METHOD _CNV_A_R_LINEAR_____422_CM "" RAT_FUNC "%6.3" "-" COEFFS 0 4096. 0. 0 0 1 /end COMPU_METHOD
/begin COMPU_METHOD _CNV_A_R_LINEAR_____423_CM "" RAT_FUNC "%6.3" "°CRK" COEFFS 0 8388607.999999995 -1.192092895507813e-006 0 0 1 /end COMPU_METHOD
/begin COMPU_METHOD _CNV_A_R_LINEAR_____424_CM "" RAT_FUNC "%6.3" "°CRK" COEFFS 0 16777216.00000002 0. 0 0 1 /end COMPU_METHOD
/begin COMPU_METHOD _CNV_A_R_LINEAR_____425_CM "" RAT_FUNC "%6.3" "%/°Crk" COEFFS 0 4096. 32768. 0 0 1 /end COMPU_METHOD
/begin COMPU_METHOD _CNV_A_R_LINEAR_____426_CM "" RAT_FUNC "%6.3" "" COEFFS 0 4096. 0. 0 0 1 /end COMPU_METHOD
/begin COMPU_METHOD _CNV_A_R_LINEAR_____427_CM "" RAT_FUNC "%6.3" "-" COEFFS 0 8388608.000000011 2147483648.000003 0 0 1 /end COMPU_METHOD
/begin COMPU_METHOD _CNV_A_R_LINEAR_____428_CM "" RAT_FUNC "%6.3" "°CRK" COEFFS 0 50. 18000. 0 0 1 /end COMPU_METHOD
/begin COMPU_METHOD _CNV_A_R_LINEAR_____429_CM "" RAT_FUNC "%6.3" "°CRK" COEFFS 0 512. 0. 0 0 1 /end COMPU_METHOD
/begin COMPU_METHOD _CNV_A_R_LINEAR_____430_CM "" RAT_FUNC "%6.3" "1/s" COEFFS 0 128.0005468856814 0. 0 0 1 /end COMPU_METHOD
/begin COMPU_METHOD _CNV_A_R_LINEAR_____431_CM "" RAT_FUNC "%6.3" "[1/s]" COEFFS 0 256. 0. 0 0 1 /end COMPU_METHOD
/begin COMPU_METHOD _CNV_A_R_LINEAR_____432_CM "" RAT_FUNC "%6.3" "%/(°Crk*s)" COEFFS 0 128.0005468856814 0. 0 0 1 /end COMPU_METHOD
/begin COMPU_METHOD _CNV_A_R_LINEAR_____433_CM "" RAT_FUNC "%6.3" "%/(°Crk*s²)" COEFFS 0 127.9990234300494 -0.2500019073631847 0 0 1 /end COMPU_METHOD
/begin COMPU_METHOD _CNV_A_R_LINEAR_____434_CM "" RAT_FUNC "%6.3" "%/(°Crk*s)" COEFFS 0 127.9990234300494 -0.2500019073631847 0 0 1 /end COMPU_METHOD
/begin COMPU_METHOD _CNV_A_R_LINEAR_____435_CM "" RAT_FUNC "%6.3" "%/°Crk" COEFFS 0 4096. 0. 0 0 1 /end COMPU_METHOD
/begin COMPU_METHOD _CNV_A_R_LINEAR_____436_CM "" RAT_FUNC "%6.3" "[1/s²]" COEFFS 0 32. 0. 0 0 1 /end COMPU_METHOD
/begin COMPU_METHOD _CNV_A_R_LINEAR_____437_CM "" RAT_FUNC "%6.3" "-" COEFFS 0 0.1 0. 0 0 1 /end COMPU_METHOD
/begin COMPU_METHOD _CNV_A_R_LINEAR_____438_CM "" RAT_FUNC "%6.3" "-" COEFFS 0 98303.99999999926 -65536.0003276795 0 0 1 /end COMPU_METHOD
/begin COMPU_METHOD _CNV_A_R_LINEAR_____439_CM "" RAT_FUNC "%6.3" "-" COEFFS 0 762.0233462275968 -507.0233462275968 0 0 1 /end COMPU_METHOD
/begin COMPU_METHOD _CNV_A_R_LINEAR_____440_CM "" RAT_FUNC "%6.3" "-" COEFFS 0 767.9998843482529 -767.9998843482529 0 0 1 /end COMPU_METHOD
/begin COMPU_METHOD _CNV_A_R_LINEAR_____441_CM "" RAT_FUNC "%6.3" "-" COEFFS 0 196605.0000152363 0. 0 0 1 /end COMPU_METHOD
/begin COMPU_METHOD _CNV_A_R_LINEAR_____442_CM "" RAT_FUNC "%6.3" "°C" COEFFS 0 0.25 10. 0 0 1 /end COMPU_METHOD
/begin COMPU_METHOD _CNV_A_R_LINEAR_____443_CM "" RAT_FUNC "%6.3" "Nm/(rpm/s)" COEFFS 0 32767.99999999992 65535. 0 0 1 /end COMPU_METHOD
/begin COMPU_METHOD _CNV_A_R_LINEAR_____444_CM "" RAT_FUNC "%6.3" "rpm/s" COEFFS 0 4. 0. 0 0 1 /end COMPU_METHOD
/begin COMPU_METHOD _CNV_A_R_LINEAR_____445_CM "" RAT_FUNC "%6.3" "Nm/s" COEFFS 0 1.28 0. 0 0 1 /end COMPU_METHOD
/begin COMPU_METHOD _CNV_A_R_LINEAR_____446_CM "" RAT_FUNC "%6.3" "Nm/s" COEFFS 0 -5.12 0. 0 0 1 /end COMPU_METHOD
/begin COMPU_METHOD _CNV_A_R_LINEAR_____447_CM "" RAT_FUNC "%6.3" "Nm/s" COEFFS 0 5.12 0. 0 0 1 /end COMPU_METHOD
/begin COMPU_METHOD _CNV_A_R_LINEAR_____448_CM "" RAT_FUNC "%6.3" "Nms" COEFFS 0 10. 0. 0 0 1 /end COMPU_METHOD
/begin COMPU_METHOD _CNV_S_3_STATUS_ANT_449_CM "" TAB_VERB "%6.3" "-" COMPU_TAB_REF _CNV_S_3_STATUS_ANT_449 /end COMPU_METHOD
/begin COMPU_VTAB _CNV_S_3_STATUS_ANT_449 "" TAB_VERB 3 1 "Nsx_ant_neut" 2 "Nsx_ant_drag_red_agb" 3 "Nsx_ant_driv" /end COMPU_VTAB
/begin COMPU_METHOD _CNV_S_3_CNT_INDICA_450_CM "" TAB_VERB "%6.3" "" COMPU_TAB_REF _CNV_S_3_CNT_INDICA_450 /end COMPU_METHOD
/begin COMPU_VTAB _CNV_S_3_CNT_INDICA_450 "" TAB_VERB 3 0 "Nsx_cnt_off" 1 "Nsx_cnt_on" 2 "Nsx_no_cnt" /end COMPU_VTAB
/begin RECORD_LAYOUT _REC_S1VAL_20_u1 FNC_VALUES 1 UBYTE COLUMN_DIR DIRECT /end RECORD_LAYOUT
/begin RECORD_LAYOUT _REC_A2AXS_20_u1 NO_AXIS_PTS_X 1 UBYTE AXIS_PTS_X 2 UBYTE INDEX_INCR DIRECT /end RECORD_LAYOUT
/begin RECORD_LAYOUT _REC_S1VAL_20_u2 FNC_VALUES 1 UWORD COLUMN_DIR DIRECT /end RECORD_LAYOUT
/begin RECORD_LAYOUT _REC_S1VAL_20_s2 FNC_VALUES 1 SWORD COLUMN_DIR DIRECT /end RECORD_LAYOUT
/begin RECORD_LAYOUT _REC_A2AXS_20_u2 NO_AXIS_PTS_X 1 UWORD AXIS_PTS_X 2 UWORD INDEX_INCR DIRECT /end RECORD_LAYOUT
/begin RECORD_LAYOUT _REC_A1CUR_20_u1_u2 FNC_VALUES 1 UBYTE COLUMN_DIR DIRECT /end RECORD_LAYOUT
/begin RECORD_LAYOUT _REC_A1CUR_20_u1_u1 FNC_VALUES 1 UBYTE COLUMN_DIR DIRECT /end RECORD_LAYOUT
/begin RECORD_LAYOUT _REC_A1MAP_20_u2_u2_u2 FNC_VALUES 1 UWORD COLUMN_DIR DIRECT /end RECORD_LAYOUT
/begin RECORD_LAYOUT _REC_A1CUR_20_u2_u2 FNC_VALUES 1 UWORD COLUMN_DIR DIRECT /end RECORD_LAYOUT
/begin RECORD_LAYOUT _REC_A1MAP_20_u2_u1_u2 FNC_VALUES 1 UWORD COLUMN_DIR DIRECT /end RECORD_LAYOUT
/begin FUNCTION BoAsoAeo ""
 /begin DEF_CHARACTERISTIC c_ctr_pulse_ivvt_dly c_frq_ivvthpwm c_maf_hb_max_ad_ref_di_ivvt c_n_32_max_ad_ref_di_ivvt c_n_32_min_ad_ref_di_ivvt c_toil_max_ad_ref_di_ivvt c_toil_min_ad_ref_di_ivvt c_vvtpwm_diag_max_scg c_vvtpwm_diag_min_oc c_vvtpwm_diag_min_scp /end DEF_CHARACTERISTIC
 /begin OUT_MEASUREMENT Vbx_df_in_vvtc_sldv_oc Vbx_df_in_vvtc_sldv_scg Vbx_df_in_vvtc_sldv_scw Vbx_diag_ena_in_vvtc_sldv_oc Vbx_diag_ena_in_vvtc_sldv_scg Vbx_diag_ena_in_vvtc_sldv_scw cdn_diag_slv_ivvt_ex[0] cdn_diag_slv_ivvt_in[0] ctr_pulse_ivvt_dly err_diag_slv_ivvt_ex[0] err_diag_slv_ivvt_in[0] frq_ivvthpwm lv_cam_sp_ref_ad_di_ivvt lv_di_ad_ref_cam_ivvt_in lv_pulse_ivvt lv_pulse_ivvt_tmp vvtpwm /end OUT_MEASUREMENT
/end FUNCTION
/begin FUNCTION OuAsoAeo ""
 /begin SUB_FUNCTION OuAsoAeo_Schxxxx OuAsoAeo_Ivvtctl OuAsoAeo_Ivvtdgx OuAsoAeo_Ivvtlck /end SUB_FUNCTION
/end FUNCTION
/begin FUNCTION OuAsoAeo_Schxxxx "" /begin DEF_CHARACTERISTIC Cbx_in_vvtc_lck_cfm /end DEF_CHARACTERISTIC /end FUNCTION
/begin FUNCTION OuAsoAeo_Ivvtctl ""
 /begin DEF_CHARACTERISTIC Ctb_in_vvtc_lck_cyc_t Ctb_in_vvtc_n_bkpt Ctp_in_vvtc_awg Ctp_in_vvtc_awg_max_thd Ctp_in_vvtc_awg_min_thd Ctp_in_vvtc_lck_pwm_thd Ctp_in_vvtc_pg Cbx_in_vvtc_cho_tgt_sp Cbx_in_vvtc_ena_inh_cmd Cbx_in_vvtc_ena_int_ad Cbx_in_vvtc_ena_vb_cps Cbx_in_vvtc_pwm_bch Cxx_in_cam_toth_per_max Cxx_in_cam_toth_per_min Cxx_in_vvtc_angl_max_str Cxx_in_vvtc_den_cl_cps_0 Cxx_in_vvtc_den_tgt_sp_1 Cxx_in_vvtc_ftc_vb Cxx_in_vvtc_h_psn_thd_ol_cl Cxx_in_vvtc_int_max_thd Cxx_in_vvtc_int_val Cxx_in_vvtc_int_val_inc Cxx_in_vvtc_int_val_ini Cxx_in_vvtc_l_psn_thd_ol_cl Cxx_in_vvtc_lck_cyc_t_1 Cxx_in_vvtc_lck_cyc_t_2 Cxx_in_vvtc_mov_det_thd Cxx_in_vvtc_nom_vb Cxx_in_vvtc_num_cl_cps_0 Cxx_in_vvtc_num_cl_cps_1 Cxx_in_vvtc_num_pcmd_0 Cxx_in_vvtc_num_pcmd_1 Cxx_in_vvtc_num_pcmd_2 Cxx_in_vvtc_num_tgt_sp_0 Cxx_in_vvtc_num_tgt_sp_1 Cxx_in_vvtc_num_tgt_sp_2 Cxx_in_vvtc_pwm_bch Cxx_in_vvtc_t_sldv_cln_cyc Cxx_in_vvtc_t_sldv_cln_cyc_on Cxx_in_vvtc_tgt_sp_ftc /end DEF_CHARACTERISTIC
 /begin OUT_MEASUREMENT Vbx_in_vvtc_ad_end Vbx_in_vvtc_ad_int_val Vbx_in_vvtc_cl_ctl Vbx_in_vvtc_cl_out_l_trt Vbx_in_vvtc_crk_syn Vbx_in_vvtc_int_val_ini Vbx_in_vvtc_lck_act_sta_det Vbx_in_vvtc_lck_cyc_sta_det Vxx_in_cam_toth_per_sat Vxx_in_cam_toth_per_sat_sq Vxx_in_vvtc_angl_sp_1 Vxx_in_vvtc_angl_sp_2 Vxx_in_vvtc_angl_sp_lck Vxx_in_vvtc_awg_lp Vxx_in_vvtc_cl_cps Vxx_in_vvtc_cl_cps_1 Vxx_in_vvtc_cl_cps_tmp Vxx_in_vvtc_cl_ctl Vxx_in_vvtc_cl_ctl_dif Vxx_in_vvtc_cl_ctl_wio_sat Vxx_in_vvtc_cl_ctl_wit_sat Vxx_in_vvtc_den_cl_cps_0 Vxx_in_vvtc_den_cl_cps_1 Vxx_in_vvtc_den_cl_cps_tmp Vxx_in_vvtc_den_pcmd_tmp Vxx_in_vvtc_den_pcmd_tmp_1 Vxx_in_vvtc_den_pcmd_tmp_2 Vxx_in_vvtc_den_tgt_sp_0 Vxx_in_vvtc_den_tgt_sp_1 Vxx_in_vvtc_den_tgt_sp_2 Vxx_in_vvtc_den_tgt_sp_tmp Vxx_in_vvtc_den_tgt_sp_tmp_1 Vxx_in_vvtc_den_tgt_sp_tmp_2 Vxx_in_vvtc_int_val Vxx_in_vvtc_int_val_tmp Vxx_in_vvtc_lck_cyc_t Vxx_in_vvtc_num_cl_cps_0 Vxx_in_vvtc_num_cl_cps_1 Vxx_in_vvtc_num_cl_cps_tmp Vxx_in_vvtc_num_cl_cps_tmp_0 Vxx_in_vvtc_num_cl_cps_tmp_1 Vxx_in_vvtc_num_pcmd_0 Vxx_in_vvtc_num_pcmd_1 Vxx_in_vvtc_num_pcmd_2 Vxx_in_vvtc_num_pcmd_tmp Vxx_in_vvtc_num_pcmd_tmp_0 Vxx_in_vvtc_num_pcmd_tmp_1 Vxx_in_vvtc_num_pcmd_tmp_2 Vxx_in_vvtc_num_tgt_sp_0 Vxx_in_vvtc_num_tgt_sp_1 Vxx_in_vvtc_num_tgt_sp_2 Vxx_in_vvtc_num_tgt_sp_tmp Vxx_in_vvtc_num_tgt_sp_tmp_0 Vxx_in_vvtc_num_tgt_sp_tmp_1 Vxx_in_vvtc_num_tgt_sp_tmp_2 Vxx_in_vvtc_p_val Vxx_in_vvtc_pcmd Vxx_in_vvtc_pcmd_1 Vxx_in_vvtc_pcmd_2 Vxx_in_vvtc_pcmd_tmp Vxx_in_vvtc_pwm Vxx_in_vvtc_pwm_val Vxx_in_vvtc_pwm_vb_cps Vxx_in_vvtc_reg_err Vxx_in_vvtc_reg_err_1 Vxx_in_vvtc_sum_pint_val Vxx_in_vvtc_tgt_sp Vxx_in_vvtc_tgt_sp_1 Vxx_in_vvtc_tgt_sp_2 Vxx_in_vvtc_tgt_sp_cho Vxx_in_vvtc_tgt_sp_ftc Vxx_in_vvtc_tgt_sp_tmp Vxx_in_vvtc_vb_cps Vxx_in_vvtc_vb_fil /end OUT_MEASUREMENT
/end FUNCTION
/begin FUNCTION OuAsoAeo_Ivvtdgx ""
 /begin DEF_CHARACTERISTIC Cbx_diag_in_vvtc_ena_diag Cbx_in_vvtc_cho_ad_fail_mod Cbx_in_vvtc_cho_blk_fail_mod Cbx_in_vvtc_ena_inh_risk_zon Cbx_in_vvtc_temp_cho_ena_diag Cxx_dfdec_in_vvtc_ad Cxx_dfdec_in_vvtc_blk Cxx_dfdec_in_vvtc_dirt_lkg Cxx_dfdec_in_vvtc_sldv_oc Cxx_dfdec_in_vvtc_sldv_scg Cxx_dfdec_in_vvtc_sldv_scw Cxx_dfinc_in_vvtc_ad Cxx_dfinc_in_vvtc_blk Cxx_dfinc_in_vvtc_dirt_lkg Cxx_dfinc_in_vvtc_sldv_oc Cxx_dfinc_in_vvtc_sldv_scg Cxx_dfinc_in_vvtc_sldv_scw Cxx_in_vvtc_ctl_sat_inh_thd Cxx_in_vvtc_ctl_sat_max_thd Cxx_in_vvtc_ctl_sat_min_thd Cxx_in_vvtc_ctl_sat_t Cxx_in_vvtc_ctl_sat_t_risk_zon Cxx_in_vvtc_n_min_ena_diag Cxx_in_vvtc_reg_err_t Cxx_in_vvtc_reg_err_t_risk_zon Cxx_in_vvtc_reg_err_thd Cxx_in_vvtc_reg_err_thd_risk Cxx_in_vvtc_temp_min_ena_diag Cxx_in_vvtc_trt_blk_dlt_t Cxx_in_vvtc_trt_oor_t Cxx_in_vvtc_trt_psn_thd Cxx_in_vvtc_v_min_ena_diag /end DEF_CHARACTERISTIC
 /begin OUT_MEASUREMENT Vbx_df_in_vvtc_blk Vbx_df_in_vvtc_dirt_lkg Vbx_diag_ena_in_vvtc_ad Vbx_diag_ena_in_vvtc_blk Vbx_diag_ena_in_vvtc_dirt_lkg Vbx_in_vvtc_ctl_sat_det Vbx_in_vvtc_ctl_sat_det_risk Vbx_in_vvtc_ctl_sat_ini Vbx_in_vvtc_ctl_sat_ini_risk Vbx_in_vvtc_ena_diag Vbx_in_vvtc_fail_det Vbx_in_vvtc_inh_risk_zon Vbx_in_vvtc_lim Vbx_in_vvtc_reg_err_det Vbx_in_vvtc_reg_err_det_risk Vbx_in_vvtc_reg_err_ini Vbx_in_vvtc_trt_psn_det Vsx_in_vvtc_vld /end OUT_MEASUREMENT
/end FUNCTION
/begin FUNCTION OuAsoAeo_Ivvtlck ""
 /begin DEF_CHARACTERISTIC Cbx_diag_in_vvtc_ena_lck Cbx_in_vvtc_lck_cho_tco_toil Cxx_in_vvtc_lck_cyc_nr Cxx_in_vvtc_lck_load_h_thd Cxx_in_vvtc_lck_load_l_thd Cxx_in_vvtc_lck_n_h_thd Cxx_in_vvtc_lck_n_l_thd Cxx_in_vvtc_lck_t_mes Cxx_in_vvtc_lck_temp_h_thd Cxx_in_vvtc_lck_temp_l_thd Cxx_in_vvtc_lck_thd_angl_sp Cxx_in_vvtc_lck_thd_dft_psn /end DEF_CHARACTERISTIC
 /begin OUT_MEASUREMENT Vbx_in_vvtc_cdt_ena_lck Vbx_in_vvtc_ena_lck Vbx_in_vvtc_ena_lck_act Vbx_in_vvtc_vvtc_lck /end OUT_MEASUREMENT
/end FUNCTION
/begin FUNCTION BoAsoTco ""
 /begin DEF_CHARACTERISTIC c_ctr_pulse_wg_dly c_d4ft_ena c_wgpwm_diag_max_scg c_wgpwm_diag_min_oc c_wgpwm_diag_min_scp /end DEF_CHARACTERISTIC
 /begin OUT_MEASUREMENT Vbx_df_wgc_oc Vbx_df_wgc_scg Vbx_df_wgc_scw Vbx_diag_ena_wgc_oc Vbx_diag_ena_wgc_scg Vbx_diag_ena_wgc_scw CDN_DIAG_WG ctr_pulse_wg_dly ERR_DIAG_WG lv_pulse_wg lv_pulse_wg_tmp pwm_wg /end OUT_MEASUREMENT
/end FUNCTION
/begin FUNCTION InAsiAei ""
 /begin OUT_MEASUREMENT Vbx_in_cam_ena_cmp_eprm_psn Vxx_in_cam_eprm_psn_redg_0 Vxx_in_cam_eprm_psn_redg_1 Vxx_in_cam_eprm_psn_redg_2 Vxx_in_cam_eprm_psn_redg_3 /end OUT_MEASUREMENT
 /begin SUB_FUNCTION InAsiAei_Ivvtpsn /end SUB_FUNCTION
/end FUNCTION
/begin FUNCTION InAsiAei_Ivvtpsn ""
 /begin DEF_CHARACTERISTIC Ctb_in_cam_angl_redg_n_bkp Ctp_in_cam_angl_redg_cps Cbx_in_cam_conf_sens_sig Cbx_in_cam_ena_new_eprm_writ Cbx_in_cam_ena_rest_ad_whl Cbx_in_cam_forc_ad_whl Cbx_in_cam_inh_ad_whl Cbx_in_cam_inh_ad_whl_eng_resta Cbx_in_cam_inh_cmp_aftr_frst_ad Cbx_in_vvtc_actr_cfm Ctx_in_cam_ref_psn_redg[0] Ctx_in_cam_ref_psn_redg[1] Ctx_in_cam_ref_psn_redg[2] Ctx_in_cam_ref_psn_redg[3] Cxx_in_cam_angl_max_flu Cxx_in_cam_angl_redg_shf Cxx_in_cam_ctr_dft_psn Cxx_in_cam_dly_sta_ad_whl Cxx_in_cam_eprm_psn_dev Cxx_in_cam_max_n_inh_ad_whl Cxx_in_cam_min_n_ena_ad_whl Cxx_in_cam_nr_rev Cxx_in_cam_ref_psn_dev Cxx_in_cam_t_new_ad_whl Cxx_in_cam_tdc_ctr_0 Cxx_in_cam_tdc_ctr_1 Cxx_in_cam_tdc_ctr_2 Cxx_in_cam_tdc_ctr_3 Cxx_in_cam_vvtc_ol_ctl_inc Cxx_in_vvtc_angl_mes_h_ftc Cxx_in_vvtc_angl_mes_l_ftc Cxx_in_vvtc_angl_mes_thd Cxx_in_vvtc_ctr_dft_blk_fsrt_ad Cxx_in_vvtc_ctr_mov_phs_ad_whl Cxx_in_vvtc_ftc_trs_thd Cxx_in_vvtc_sp_ftc Cxx_in_vvtc_t_dft_psn Cxx_in_vvtc_t_pwm_nul Cxx_in_vvtc_t_vld_dft_psn Cxx_in_vvtc_thd_dft_psn /end DEF_CHARACTERISTIC
 /begin OUT_MEASUREMENT Vbx_df_in_vvtc_ad Vbx_in_cam_ad_whl Vbx_in_cam_crk_syn Vbx_in_cam_dft_ad_whl Vbx_in_cam_dft_chr_cam_or_crk Vbx_in_cam_dft_eprm_cmp Vbx_in_cam_dft_phs_ad_whl Vbx_in_cam_dft_ref_cmp Vbx_in_cam_dsb_ad_whl Vbx_in_cam_ena_acq Vbx_in_cam_ena_act_test Vbx_in_cam_ena_cmp_ref_psn Vbx_in_cam_ena_diag_ad_whl Vbx_in_cam_ena_new_ad_whl Vbx_in_cam_ena_writ_eprm Vbx_in_cam_end_acq_phs_ad Vbx_in_cam_end_act_test Vbx_in_cam_inh_ad_whl Vbx_in_cam_ini_psn_redg Vbx_in_cam_stop_act_test Vbx_in_cam_stop_new_ad_whl Vbx_in_vvtc_angl_mes_nok Vbx_in_vvtc_dft_blk_frst_ad Vbx_in_vvtc_dft_mov_fsrt_ad Vbx_in_vvtc_dft_psn Vbx_in_vvtc_nul_pwm Vsx_in_vvtc_angl_vld Vtx_in_cam_eprm_psn_redg[0] Vtx_in_cam_eprm_psn_redg[1] Vtx_in_cam_eprm_psn_redg[2] Vtx_in_cam_eprm_psn_redg[3] Vtx_in_cam_ini_psn_redg[0] Vtx_in_cam_ini_psn_redg[1] Vtx_in_cam_ini_psn_redg[2] Vtx_in_cam_ini_psn_redg[3] Vtx_in_cam_mes_psn_redg[0] Vtx_in_cam_mes_psn_redg[1] Vtx_in_cam_mes_psn_redg[2] Vtx_in_cam_mes_psn_redg[3] Vtx_in_cam_mv_psn_redg[0] Vtx_in_cam_mv_psn_redg[1] Vtx_in_cam_mv_psn_redg[2] Vtx_in_cam_mv_psn_redg[3] Vtx_in_cam_sum_psn_redg[0] Vtx_in_cam_sum_psn_redg[1] Vtx_in_cam_sum_psn_redg[2] Vtx_in_cam_sum_psn_redg[3] Vxx_in_cam_angl_redg Vxx_in_cam_ctr Vxx_in_cam_ctr_dft_psn Vxx_in_cam_ctr_phs_ad Vxx_in_cam_ctr_phs_ini_psn_redg Vxx_in_cam_ctr_rest_ad_whl Vxx_in_cam_mes_psn_redg_0 Vxx_in_cam_mes_psn_redg_1 Vxx_in_cam_mes_psn_redg_2 Vxx_in_cam_mes_psn_redg_3 Vxx_in_cam_mv_psn_redg_0 Vxx_in_cam_mv_psn_redg_1 Vxx_in_cam_mv_psn_redg_2 Vxx_in_cam_mv_psn_redg_3 Vxx_in_cam_sum_psn_redg_0 Vxx_in_cam_sum_psn_redg_1 Vxx_in_cam_sum_psn_redg_2 Vxx_in_cam_sum_psn_redg_3 Vxx_in_cam_vvtc_ol_ctl Vxx_in_vvtc_angl Vxx_in_vvtc_angl_fil Vxx_in_vvtc_angl_ftc Vxx_in_vvtc_angl_mes Vxx_in_vvtc_angl_mes_tmp Vxx_in_vvtc_angl_raw Vxx_in_vvtc_ctr_dft_blk_frst_ad Vxx_in_vvtc_ctr_mov_phs_ad_whl /end OUT_MEASUREMENT
/end FUNCTION
/begin FUNCTION AtCatMng "" /begin SUB_FUNCTION AtCatMng_Catawup /end SUB_FUNCTION /end FUNCTION
/begin FUNCTION AtCatMng_Catawup ""
 /begin DEF_CHARACTERISTIC Ctb_cata_wup_sta_tco Ntb_cata_wup_phs_order Ntb_fuel_typ_zon Cmp_cata_wup_fuel1 Cmp_cata_wup_fuel2 Cmp_cata_wup_fuel3 Ctd_cata_wup_phs_fuel1 Ctd_cata_wup_phs_fuel1_cold Ctd_cata_wup_phs_fuel2 Ctd_cata_wup_phs_fuel2_cold Ctd_cata_wup_phs_fuel3 Cbx_cata_wup_vvt_on Cbx_wup_stop_ac Cxx_cata_wup_dstb_n_max1 Cxx_cata_wup_dstb_n_max2 Cxx_cata_wup_dstb_n_max3 Cxx_cata_wup_dstb_ofs1 Cxx_cata_wup_dstb_ofs2 Cxx_cata_wup_dstb_ofs3 Cxx_cata_wup_dstb_prs_max1 Cxx_cata_wup_dstb_prs_max2 Cxx_cata_wup_dstb_prs_max3 Cxx_cata_wup_dstb_prs_min1 Cxx_cata_wup_dstb_prs_min2 Cxx_cata_wup_dstb_prs_min3 /end DEF_CHARACTERISTIC
 /begin OUT_MEASUREMENT Vbx_cata_rich_dstb_efv Vbx_cata_wup_phs_cge Vsx_cata_wup_phs Vsx_cata_wup_phs_req Vxx_cata_wup_ctr Vxx_cata_wup_ctr_clc Vxx_cata_wup_phs_ctr Vxx_cata_wup_phs_nr /end OUT_MEASUREMENT
/end FUNCTION
/begin FUNCTION AtCatDgn ""
 /begin OUT_MEASUREMENT Vxx_cata_lbdw_mes_rtn Vxx_cata_fail_thd_rtn Vtx_in_mem_cata_cpt[0] Vtx_in_mem_cata_cpt[1] Vtx_in_mem_cata_cpt[2] Vtx_in_mem_cata_cpt[3] Vtx_in_mem_cata_cpt[4] Vtx_mem_crit_cata_cpt[0] Vtx_mem_crit_cata_cpt[1] Vtx_mem_crit_cata_cpt[2] Vtx_mem_crit_cata_cpt[3] Vtx_mem_crit_cata_cpt[4] Vtx_mem_crit_cata_cpt[5] Vtx_out_mem_cata_cpt[0] Vtx_out_mem_cata_cpt[1] Vtx_out_mem_cata_cpt[2] Vtx_out_mem_cata_cpt[3] Vtx_out_mem_cata_cpt[4] Vxx_nr_dc_cdn_ok_cata_cpt_NVM Vxx_t_mv_cdn_ok_cata_cpt_NVM /end OUT_MEASUREMENT
 /begin SUB_FUNCTION AtCatDgn_Obdcata /end SUB_FUNCTION
/end FUNCTION
/begin FUNCTION AtCatDgn_Obdcata ""
 /begin DEF_CHARACTERISTIC Ntb_cata_maf Ctp_cata_lbdw_max_maf Ctp_cata_lbdw_max_maf_alco Ctp_cata_ol_per_dly_maf Ctp_cata_ol_per_dly_maf_alco Cxx_cata_asd_diag_nr Cxx_cata_asd_in_nr Cxx_cata_asd_sf_nr Cxx_cata_asd_tout_dly Cxx_cata_cl_stab_dly_min Cxx_cata_diag_gear Cxx_cata_fuel_typ_rat_max_1 Cxx_cata_fuel_typ_rat_max_2 Cxx_cata_fuel_typ_rat_min_1 Cxx_cata_fuel_typ_rat_min_2 Cxx_cata_hys_maf Cxx_cata_hys_n Cxx_cata_in_nr Cxx_cata_maf_dif_max Cxx_cata_maf_max Cxx_cata_maf_mes_max Cxx_cata_maf_min Cxx_cata_n_max Cxx_cata_n_min Cxx_cata_ofs_neg_1 Cxx_cata_ofs_neg_2 Cxx_cata_ofs_ol_lbdw_fil Cxx_cata_ofs_pos_1 Cxx_cata_ofs_pos_2 Cxx_cata_ol_apl Cxx_cata_ol_apl_alco Cxx_cata_ol_per_dly_mes Cxx_cata_ol_per_dly_stab Cxx_cata_ol_test_max_nr Cxx_cata_ol_thd_lbdw_fil Cxx_cata_tco_min Cxx_cata_win_max Cxx_cata_win_min Cxx_conf_diag_cata Cxx_dfdec_cata_cpt Cxx_dfinc_cata_cpt Cxx_diag_sta_cata_lbup_pwt_sp Cxx_edic_cata_dly Cxx_ex_gaz_cata_max_temp Cxx_ex_gaz_cata_min_temp Cxx_lgl_dly_diag_cata /end DEF_CHARACTERISTIC
 /begin OUT_MEASUREMENT Vtx_mem_crit_cata_cpt[6] Vbx_cata_diag_stop Vbx_cata_dsb_ad_rich Vbx_cata_dsb_cp Vbx_cata_ol_cl_ti_fac Vbx_cata_ol_stop Vbx_cata_req Vbx_cata_stab_rich Vbx_cata_stab_rich_dsb Vbx_df_cata_cpt Vbx_diag_ena_cata_cpt Vbx_diag_sta_cata_abrt Vbx_diag_sta_cata_ena Vbx_diag_sta_cata_end Vbx_ena_diag_cata Vbx_inhi_ena_diag_cata Vbx_phy_ena_diag_cata Vbx_sw_ena_diag_cata Vsx_cata_stt Vsx_diag_sta_cata_stt Vxx_cata_asd_diag_ctr Vxx_cata_asd_sf Vxx_cata_asd_sf_ctr Vxx_cata_asd_tout_dly Vxx_cata_fail_thd Vxx_cata_in_ctr Vxx_cata_lbdw_h_fil_val Vxx_cata_lbdw_mes Vxx_cata_mem_ol_cl_ti_fac Vxx_cata_ol_apl Vxx_cata_ol_mv_cl_ti_fac Vxx_cata_ol_per_ctr Vxx_cata_ol_per_dly Vxx_cata_ol_per_dly_clc Vxx_cata_ol_stab_test Vxx_cata_stab_dly Vxx_diag_cata_cl_ti_fac Vxx_edic_cata_dly Vxx_lbdw_h_lvl_fil_val_prev Vxx_lgl_dly_diag_cata Vxx_pump_maf_cata_mem Vxx_pump_maf_fil_cata /end OUT_MEASUREMENT
/end FUNCTION
/begin FUNCTION InPciAgb ""
 /begin SUB_FUNCTION InPciAgb_Atsipxx InPciAgb_Attqxcs InPciAgb_Sdftaxx InPciAgb_Spcxxcs InPciAgb_Attqxco InPciAgb_Antxxcs InPciAgb_Tbspdcs /end SUB_FUNCTION
/end FUNCTION
/begin FUNCTION InPciAgb_Atsipxx ""
 /begin OUT_MEASUREMENT Vbx_agb_tq_req_full_ctl Vbx_agb_tq_req_h_lim Vbx_agb_tq_req_l_lim /end OUT_MEASUREMENT
/end FUNCTION
/begin FUNCTION InPciAgb_Attqxcs ""
 /begin DEF_CHARACTERISTIC Ctb_agb_csm_tq_is_n_sp_dif Ctb_agb_tq_dif_n_is_n_sp Ctb_agb_tq_vs Ctp_agb_csm_tq_drag_red_ofs Ctp_agb_csm_tq_dri_ofs Ctp_agb_csm_tq_dri_ofs_dft Ctp_agb_csm_tq_ftc_temp_fast Ctp_agb_csm_tq_ftc_temp_slow Ctp_agb_csm_tq_is_n_sp_fac Ctp_agb_csm_tq_n_fac Ctp_agb_csm_tq_neut_ofs Ctp_agb_csm_tq_neut_ofs_dft Ctp_agb_csm_tq_vs_fac Ctp_egb_dri_drag_red_dly_temp Ctp_egb_dri_neut_dly_temp Cbx_agb_csm_ofs_cfm Cbx_agb_csm_slop_cfm Cbx_agb_csm_tq_temp_cfm Cxx_agb_csm_ofs_slop_neg Cxx_agb_csm_ofs_slop_neg_dft Cxx_agb_csm_ofs_slop_pos Cxx_agb_csm_ofs_slop_pos_dft Cxx_agb_csm_tq_ftc_fast Cxx_agb_csm_tq_ftc_slow Cxx_agb_csm_tq_ftc_vs_thd Cxx_agb_csm_tq_is_n_hys Cxx_agb_csm_tq_is_n_thd Cxx_agb_csm_tq_slop_neg Cxx_agb_csm_tq_slop_neg_1 Cxx_agb_csm_tq_slop_neg_1_rvr Cxx_agb_csm_tq_slop_neg_2 Cxx_agb_csm_tq_slop_neg_rvr Cxx_agb_csm_tq_slop_pos Cxx_agb_csm_tq_slop_pos_1 Cxx_agb_csm_tq_slop_pos_1_rvr Cxx_agb_csm_tq_slop_pos_2 Cxx_agb_csm_tq_slop_pos_rvr Cxx_agb_csm_tq_vs_thd Cxx_agb_tq_slop_drag_red_neg Cxx_agb_tq_slop_drag_red_pos Cxx_agb_tq_slop_dsb_neg Cxx_agb_tq_slop_dsb_pos /end DEF_CHARACTERISTIC
 /begin OUT_MEASUREMENT Vbx_stat_drag_red_agb Vbx_stat_egb_neut Vsx_agb_csm_tq_vld Vxx_agb_csm_tq Vxx_agb_csm_tq_dft Vxx_agb_csm_tq_fil Vxx_agb_csm_tq_is_n_fac Vxx_agb_csm_tq_ofs Vxx_agb_csm_tq_slop Vxx_agb_tq_dif_n_is_n_sp Vxx_is_n_sp_dif /end OUT_MEASUREMENT
/end FUNCTION
/begin FUNCTION InPciAgb_Sdftaxx ""
 /begin DEF_CHARACTERISTIC Ctb_agb_tqe_inc Ctp_agb_tqe_inc_fmt Cbx_max_gear_cge_dly_ena_cfm Cbx_tq_cmd_typ_cfm Cxx_agb_abst_dly Cxx_agb_clck_max_step Cxx_agb_ctr_max_thd Cxx_agb_int_rst_t Cxx_agb_max_tqe Cxx_agb_slwr_neg Cxx_agb_slwr_pos Cxx_dfdec_agb_data Cxx_dfdec_agb_no_frm Cxx_dfinc_agb_data Cxx_dfinc_agb_no_frm Cxx_dft_agb_tq_sp_lim Cxx_i_agb_driv_tq_thd Cxx_max_gear_cge_dly Cxx_mux_agb_tqe_nok_raw /end DEF_CHARACTERISTIC
 /begin OUT_MEASUREMENT Vbx_agb_ack Vbx_agb_clck_fail Vbx_agb_cmd Vbx_agb_dft Vbx_agb_gear_mod_ok Vbx_agb_tq_int_rst Vbx_agb_tq_lim_dft Vbx_agb_tq_req Vbx_agb_tq_req_full_ctl_vld Vbx_agb_tq_req_h_lim_vld Vbx_agb_tq_req_l_lim_vld Vbx_df_agb_data_chr Vbx_df_agb_data_seq_ctr Vbx_df_agb_data_tout Vbx_df_agb_no_frm Vbx_egb_conf_ena Vbx_i_dsb Vxx_agb_10ms_t Vxx_agb_int_t Vxx_agb_lim_tqe Vxx_agb_max_tqe_sp Vxx_agb_max_tqe_tgt Vxx_agb_min_tqe_sp Vxx_agb_min_tqe_tgt Vxx_agb_tqe_inc /end OUT_MEASUREMENT
/end FUNCTION
/begin FUNCTION InPciAgb_Spcxxcs "" /begin OUT_MEASUREMENT Vxx_agb_driv_spt_fac /end OUT_MEASUREMENT /end FUNCTION
/begin FUNCTION InPciAgb_Attqxco ""
 /begin DEF_CHARACTERISTIC Ctb_agb_tq_csm_is_n_sp Cmp_agb_csm_tq_brk_pdl_cor Cmp_agb_csm_tq_drag_red_cor Cmp_agb_csm_tq_neut_dri_cor Ctp_agb_csm_brk_pdl_dly_cor Ctp_agb_csm_drag_red_dly_cor Ctp_agb_csm_neut_dri_dly_cor Ctp_agb_tq_stop_max_cor Ctp_agb_tq_stop_min_cor Ctp_agb_tq_stop_prim_drv_fac Ctp_egb_neut_dri_dly_cor Ctp_egb_neut_rvr_dly_cor Cbx_agb_csm_tq_cor_ad Cxx_agb_csm_tq_neut_rvr_fac Cxx_agb_tq_brk_pdl_cor_slop Cxx_agb_tq_brk_pdl_n_hys Cxx_agb_tq_brk_pdl_n_thd Cxx_agb_tq_brk_pdl_tco_thd Cxx_agb_tq_drag_red_cor_slop Cxx_agb_tq_neut_dri_cor_slop Cxx_agb_tq_stop_cor_slop Cxx_agb_tq_stop_dly_cor Cxx_agb_tq_stop_n_hys Cxx_agb_tq_stop_n_thd Cxx_agb_tq_stop_prim_drv_thd Cxx_agb_tq_stop_prim_max_ofs Cxx_agb_tq_stop_prim_min_ofs Cxx_agb_tq_stop_vs_thd Cxx_prim_sha_spd_drv_ftc Cxx_prim_sha_spd_drv_thd /end DEF_CHARACTERISTIC
 /begin OUT_MEASUREMENT Vbx_agb_tq_brk_pdl Vbx_agb_tq_brk_pdl_cor_act Vbx_agb_tq_drag_red_cor_act Vbx_agb_tq_is_vs_cdn_cor Vbx_agb_tq_neut_dri_cor_act Vbx_agb_tq_stop_cor_act Vbx_n_egb_neut Vbx_n_egb_neut_dly Vxx_agb_csm_tq_brk_pdl_cor Vxx_agb_csm_tq_brk_pdl_cor_1 Vxx_agb_csm_tq_cor Vxx_agb_csm_tq_drag_red_cor Vxx_agb_csm_tq_drag_red_cor_1 Vxx_agb_csm_tq_neut_cor Vxx_agb_csm_tq_neut_cor_1 Vxx_agb_tq_stop_cor Vxx_agb_tq_stop_cor_1 Vxx_prim_sha_spd_drv Vxx_prim_sha_spd_drv_mv /end OUT_MEASUREMENT
/end FUNCTION
/begin FUNCTION InPciAgb_Antxxcs "" /begin DEF_CHARACTERISTIC Cbx_ant_crt_slc_pres_cfm /end DEF_CHARACTERISTIC /begin OUT_MEASUREMENT Vsx_ant_crt_slc Vsx_ant_crt_slc_vld /end OUT_MEASUREMENT /end FUNCTION
/begin FUNCTION InPciAgb_Tbspdcs "" /begin OUT_MEASUREMENT Vsx_prim_sha_spd_vld Vxx_prim_sha_spd /end OUT_MEASUREMENT /end FUNCTION
/begin FUNCTION DgDgtRpg "" /begin SUB_FUNCTION DgDgtRpg_Mngerxx_xxxxxx /end SUB_FUNCTION /end FUNCTION
/begin FUNCTION DgDgtRpg_Mngerxx_xxxxxx ""
 /begin OUT_MEASUREMENT Vbx_prg_appl_key_stt Vbx_prg_req Vxx_prg_appl_key Vxx_prg_ecm_stt /end OUT_MEASUREMENT
/end FUNCTION
/begin FUNCTION BiVfiAci "" /begin OUT_MEASUREMENT Vxx_raw_ac_prs v_acp /end OUT_MEASUREMENT /end FUNCTION
/begin FUNCTION BiCbiFui ""
 /begin OUT_MEASUREMENT Vbx_df_sens_rvc_h Vbx_df_sens_rvc_l Vbx_df_sens_rvc_nok Vbx_df_sens_rvc_sig_mcut Vbx_diag_ena_sens_rvc_h Vbx_diag_ena_sens_rvc_l Vbx_diag_ena_sens_rvc_nok Vbx_diag_ena_sens_rvc_sig_mcut Vbx_raw_min_fuel2 Vxx_raw_sens_rvac /end OUT_MEASUREMENT
/end FUNCTION
/begin FUNCTION InPciDls ""
 /begin OUT_MEASUREMENT Vbx_sens_bgin_clu_cnt_lk_stt Vxx_bgin_clu_off_no_chr_ctr_NVM Vxx_bgin_clu_on_no_chr_ctr_NVM /end OUT_MEASUREMENT
 /begin SUB_FUNCTION InPciDls_Clexxcs_xxxxxx InPciDls_Cnrvncs_xxxxxx InPciDls_Dlsttxx_xxxxxx InPciDls_Ratioxx_xxxxxx InPciDls_Rgearxx_xxxxxx InPciDls_Seclcxx_xxxxxx InPciDls_Tmdlsxx_xxxxxx InPciDls_Attcscs_xxxxxx InPciDls_Attrecs_xxxxxx InPciDls_Tadlsxx_xxxxxx InPciDls_Clb2xcs_xxxxxx InPciDls_Clbmucs_xxxxxx InPciDls_Clbsrcs_xxxxxx InPciDls_Clbxxsr_xxxxxx InPciDls_Clbdgxx_xxxxxx /end SUB_FUNCTION
/end FUNCTION
/begin FUNCTION InPciDls_Clexxcs_xxxxxx "" /begin OUT_MEASUREMENT Vsx_end_str_clu_cnt /end OUT_MEASUREMENT /end FUNCTION
/begin FUNCTION InPciDls_Cnrvncs_xxxxxx "" /begin OUT_MEASUREMENT Vsx_neut_cnt Vsx_rvr_cnt /end OUT_MEASUREMENT /end FUNCTION
/begin FUNCTION InPciDls_Dlsttxx_xxxxxx "" /begin DEF_CHARACTERISTIC Ctb_coup Ntb_coup Ntb_gear Csx_dlin_conf /end DEF_CHARACTERISTIC
 /begin OUT_MEASUREMENT Vsx_ant_coup_vld Vsx_ant_gear Vsx_ant_gear_vld Vsx_coup_vld Vsx_dlin_conf Vsx_gear Vsx_gear_vld Vxx_ant_coup Vxx_ant_gear Vxx_coup Vxx_gear /end OUT_MEASUREMENT
/end FUNCTION
/begin FUNCTION InPciDls_Ratioxx_xxxxxx ""
 /begin DEF_CHARACTERISTIC Cxx_down_bkp_vs_neut Cxx_vs_n_rat_dft_max Cxx_vs_n_rat_dft_min Cxx_vs_n_rat_fil_fac1 Cxx_vs_n_rat_fil_fac2 Cxx_vs_n_rat_min_n_bkp /end DEF_CHARACTERISTIC
 /begin OUT_MEASUREMENT Vbx_run_vh Vsx_run_vh_vld Vsx_vs_n_rat_fil_vld Vxx_vs_n_rat Vxx_vs_n_rat_fil /end OUT_MEASUREMENT
/end FUNCTION
/begin FUNCTION InPciDls_Rgearxx_xxxxxx ""
 /begin DEF_CHARACTERISTIC Cbx_no_ant_gear_fil_cfm Cxx_1_gear_rat_tgt Cxx_2_gear_rat_tgt Cxx_3_gear_rat_tgt Cxx_4_gear_rat_tgt Cxx_5_gear_rat_tgt Cxx_6_gear_rat_tgt Cxx_h_gear_win_thd Cxx_l_gear_max Cxx_l_gear_win_thd Cxx_max_vs_n_rat Cxx_min_vs_n_rat Cxx_neut_gear_rat_tgt Cxx_vs_n_rat_ant_gear_ftc1 Cxx_vs_n_rat_ant_gear_ftc2 /end DEF_CHARACTERISTIC
 /begin OUT_MEASUREMENT Vsx_ant_rat_gear Vsx_rat_gear Vtx_gear_rat_tgt[0] Vtx_gear_rat_tgt[1] Vtx_gear_rat_tgt[2] Vtx_gear_rat_tgt[3] Vtx_gear_rat_tgt[4] Vtx_gear_rat_tgt[5] Vtx_gear_rat_tgt[6] Vxx_down_rat_gear_bkp_tgt Vxx_mv_1_2_gear_rat_tgt Vxx_mv_2_3_gear_rat_tgt Vxx_mv_3_4_gear_rat_tgt Vxx_mv_4_5_gear_rat_tgt Vxx_mv_5_6_gear_rat_tgt Vxx_rat_tgt Vxx_up_rat_gear_bkp_tgt /end OUT_MEASUREMENT
/end FUNCTION
/end MODULE
/end PROJECT
