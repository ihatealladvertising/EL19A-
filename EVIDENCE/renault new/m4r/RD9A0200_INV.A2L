ASAP2_VERSION 1 41
/begin PROJECT RD8 "_default_ProjectLongIdentifier"
/begin HEADER "_default_HeaderComment" PROJECT_NO RD9 /end HEADER
/begin MODULE _default_ModuleName "_default_ModuleLongIdentifier"
/begin MOD_COMMON "_default_ModCommonComment" DEPOSIT ABSOLUTE BYTE_ORDER MSB_LAST ALIGNMENT_BYTE 1 ALIGNMENT_WORD 2 ALIGNMENT_LONG 2 ALIGNMENT_FLOAT32_IEEE 2 ALIGNMENT_FLOAT64_IEEE 4 /end MOD_COMMON
/begin AXIS_PTS Ctb_eal "16 breakpoint table for Engine air load" 0xa002b7f4 Vxx_eal _REC_A2AXS_20_u2 3.99993896484375 _CNV_A_R_LINEAR_____53_CM 16 0. 3.99993896484375 FORMAT "%10.8" /end AXIS_PTS
/begin AXIS_PTS Ctb_mat2 "Table of 9 programmable breakpoints of air temperature" 0xa002cb40 NO_INPUT_QUANTITY _REC_A2AXS_20_u2 240. _CNV_A_R_LINEAR_____110_CM 9 -40. 200. FORMAT "%5.1" /end AXIS_PTS
/begin AXIS_PTS Ctb_tco2 "Engine coolant temperature breakpoints" 0xa002d4d0 Vxx_tco _REC_A2AXS_20_u2 240. _CNV_A_R_LINEAR_____110_CM 9 -40. 200. FORMAT "%5.1" /end AXIS_PTS
/begin CHARACTERISTIC Cmp_n_eal_lbup_v_thd_alco "Map of upstream lambda tension threshold for acohol richness control. function of engine speed and engine air load" MAP 0xa002cf50 _REC_A1MAP_20_u2_u2_u2 25000. _CNV_A_R_LINEAR_____107_CM 0. 25000. FORMAT "%5.0"
 /begin AXIS_DESCR COM_AXIS Vxx_n _CNV_A_R_ENSD_LINEA_22_CM 20 0. 16383.75 FORMAT "%8.2" AXIS_PTS_REF Ctb_n /end AXIS_DESCR
 /begin AXIS_DESCR COM_AXIS Vxx_eal _CNV_A_R_LINEAR_____53_CM 16 0. 3.99993896484375 FORMAT "%10.8" AXIS_PTS_REF Ctb_eal /end AXIS_DESCR
/end CHARACTERISTIC
/begin MEASUREMENT Vxx_lbup_v_thd_alco "Threshold of transition rich / poor for alcohol fuel" UWORD _CNV_A_R_LINEAR_____107_CM 1 0. 0. 25000. ECU_ADDRESS 0xd00042b0 FORMAT "%5.0" /end MEASUREMENT
/begin MEASUREMENT Vbx_df_lbup_shf_h "O2 upstream sensor rich shift diagnosis detected failure" UBYTE _CNV_S_2_RANGE______3_CM 1 0. 0. 1. ECU_ADDRESS 0xd0007b6b BIT_MASK 0x1 /end MEASUREMENT
/begin MEASUREMENT Vbx_df_lbup_shf_l "O2 upstream sensor lean shift diagnosis detected failure" UBYTE _CNV_S_2_RANGE______3_CM 1 0. 0. 1. ECU_ADDRESS 0xd0007b6c BIT_MASK 0x1 /end MEASUREMENT
/begin MEASUREMENT Vbx_diag_ena_lbup_shf_h "O2 upstream sensor rich shift diagnosis authorization" UBYTE _CNV_S_2_RANGE______3_CM 1 0. 0. 1. ECU_ADDRESS 0xd0007b6d BIT_MASK 0x1 /end MEASUREMENT
/begin MEASUREMENT Vbx_diag_ena_lbup_shf_l "O2 upstream sensor lean shift diagnosis authorization" UBYTE _CNV_S_2_RANGE______3_CM 1 0. 0. 1. ECU_ADDRESS 0xd0007b6e BIT_MASK 0x1 /end MEASUREMENT
/begin MEASUREMENT Vbx_ena_diag_lbup_shf "02 usptream sensor lean shift diagnosis autorisation" UBYTE _CNV_S_2_RANGE______3_CM 1 0. 0. 1. ECU_ADDRESS 0xd0007b6f BIT_MASK 0x1 /end MEASUREMENT
/begin MEASUREMENT Vbx_inhi_ena_diag_lbup_shf "Inhibition condition for 02 upstream sensor shift diagnosis" UBYTE _CNV_S_2_RANGE______3_CM 1 0. 0. 1. ECU_ADDRESS 0xd0007b70 BIT_MASK 0x1 /end MEASUREMENT
/begin MEASUREMENT Vbx_lbup_shf_diag_stop "Lean/Rich shift O2 upstream sensor diagnosis done" UBYTE _CNV_S_2_RANGE______3_CM 1 0. 0. 1. ECU_ADDRESS 0xd0007b71 BIT_MASK 0x1 /end MEASUREMENT
/begin MEASUREMENT Vbx_lbup_shf_lean "Period in lean shift default (value take account at the end of the period)" UBYTE _CNV_S_2_RANGE______3_CM 1 0. 0. 1. ECU_ADDRESS 0xd0007b72 BIT_MASK 0x1 /end MEASUREMENT
/begin MEASUREMENT Vbx_lbup_shf_lean_mes "Lean shift diagnosis Measure done" UBYTE _CNV_S_2_RANGE______3_CM 1 0. 0. 1. ECU_ADDRESS 0xd0007b73 BIT_MASK 0x1 /end MEASUREMENT
/begin MEASUREMENT Vbx_lbup_shf_lean_per_ok "Number of periods for lean shift diagnosis reached" UBYTE _CNV_S_2_RANGE______3_CM 1 0. 0. 1. ECU_ADDRESS 0xd0007b74 BIT_MASK 0x1 /end MEASUREMENT
/begin MEASUREMENT Vbx_lbup_shf_rich "Period in rich shift default (value take account at the end of the period)" UBYTE _CNV_S_2_RANGE______3_CM 1 0. 0. 1. ECU_ADDRESS 0xd0007b75 BIT_MASK 0x1 /end MEASUREMENT
/begin MEASUREMENT Vbx_lbup_shf_rich_mes "Rich shift diagnosis Measure done" UBYTE _CNV_S_2_RANGE______3_CM 1 0. 0. 1. ECU_ADDRESS 0xd0007b76 BIT_MASK 0x1 /end MEASUREMENT
/begin MEASUREMENT Vbx_lbup_shf_rich_per_ok "Number of periods for rich shift diagnosis reached" UBYTE _CNV_S_2_RANGE______3_CM 1 0. 0. 1. ECU_ADDRESS 0xd0007b77 BIT_MASK 0x1 /end MEASUREMENT
/begin MEASUREMENT Vbx_phy_ena_diag_lbup_shf "Physical condition for 02 upstream sensor shift diagnosis" UBYTE _CNV_S_2_RANGE______3_CM 1 0. 0. 1. ECU_ADDRESS 0xd0007b78 BIT_MASK 0x1 /end MEASUREMENT
/begin MEASUREMENT Vbx_sw_ena_diag_lbup_shf "Software condition for 02 upstream sensor shift diagnosis" UBYTE _CNV_S_2_RANGE______3_CM 1 0. 0. 1. ECU_ADDRESS 0xd0007b79 BIT_MASK 0x1 /end MEASUREMENT
/begin MEASUREMENT Vsx_lbup_shf_stt "Lean/rich shift diagnosis states" UBYTE _CNV_S_4_STATUS_DSB_331_CM 1 0. 10. 40. ECU_ADDRESS 0xd0007b7a /end MEASUREMENT
/begin MEASUREMENT Vxx_lbup_shf_dly_ctr "Counter used to generate local Scheduler 100ms" UBYTE _CNV_A_R_LINEAR_____123_CM 1 0. 0. 1. ECU_ADDRESS 0xd0007b7b FORMAT "%4.2" /end MEASUREMENT
/begin MEASUREMENT Vxx_lbup_shf_lean_per_ctr "Counter of periods for the lean shift diagnosis" UBYTE _CNV_A_R_ECME_LINEA_0_CM 1 0. 0. 255. ECU_ADDRESS 0xd0007b7c FORMAT "%3.0" /end MEASUREMENT
/begin MEASUREMENT Vxx_lbup_shf_lean_per_dft_ctr "Counter of periods in default for the lean shift diagnosis" UBYTE _CNV_A_R_ECME_LINEA_0_CM 1 0. 0. 255. ECU_ADDRESS 0xd0007b7d FORMAT "%3.0" /end MEASUREMENT
/begin MEASUREMENT Vxx_lbup_shf_rich_per_ctr "Counter of periods for the rich shift diagnosis" UBYTE _CNV_A_R_ECME_LINEA_0_CM 1 0. 0. 255. ECU_ADDRESS 0xd0007b7e FORMAT "%3.0" /end MEASUREMENT
/begin MEASUREMENT Vxx_lbup_shf_rich_per_dft_ctr "Counter of periods in default for the rich shift diagnosis" UBYTE _CNV_A_R_ECME_LINEA_0_CM 1 0. 0. 255. ECU_ADDRESS 0xd0007b7f FORMAT "%3.0" /end MEASUREMENT
/begin MEASUREMENT Vxx_lbup_shf_stab_dly "Timer of the stabilisation before measure" UWORD _CNV_A_R_LINEAR_____32_CM 1 0. 0. 655.35 ECU_ADDRESS 0xd0005ebc FORMAT "%6.2" /end MEASUREMENT
/begin MEASUREMENT Vxx_lgl_dly_diag_lbup_shf "Timer before beginning 02 upstream sensor lean/rich shift diagnosis" UWORD _CNV_A_R_LINEAR_____58_CM 1 0. 0. 6553.5 ECU_ADDRESS 0xd0005ebe FORMAT "%6.1" /end MEASUREMENT
/begin CHARACTERISTIC Cxx_conf_diag_lbup_shf "Upstream O2 sensor rich/lean shift Diagnosis is: 0=forbidden; 1=conventional mode; 2=bench mode" VALUE 0xa00213a8 _REC_S1VAL_20_u1 2. _CNV_A_R_ECME_LINEA_0_CM 0. 2. FORMAT "%3.0" /end CHARACTERISTIC
/begin CHARACTERISTIC Cxx_dfdec_lbup_shf_h "O2 upstream sensor rich shift detected failure counter decrement" VALUE 0xa0021388 _REC_S1VAL_20_u2 65535. _CNV_A_R_ECME_LINEA_0_CM 0. 65535. FORMAT "%5.0" /end CHARACTERISTIC
/begin CHARACTERISTIC Cxx_dfdec_lbup_shf_l "O2 upstream sensor lean shift detected failure counter decrement" VALUE 0xa002138a _REC_S1VAL_20_u2 65535. _CNV_A_R_ECME_LINEA_0_CM 0. 65535. FORMAT "%5.0" /end CHARACTERISTIC
/begin CHARACTERISTIC Cxx_dfinc_lbup_shf_h "O2 upstream sensor rich shift detected failure counter increment" VALUE 0xa002138c _REC_S1VAL_20_u2 65535. _CNV_A_R_ECME_LINEA_0_CM 0. 65535. FORMAT "%5.0" /end CHARACTERISTIC
/begin CHARACTERISTIC Cxx_dfinc_lbup_shf_l "O2 upstream sensor lean shift detected failure counter increment" VALUE 0xa002138e _REC_S1VAL_20_u2 65535. _CNV_A_R_ECME_LINEA_0_CM 0. 65535. FORMAT "%5.0" /end CHARACTERISTIC
/begin CHARACTERISTIC Cxx_lbup_lean_min_thd_v "Minimum Voltage threshold for detection a lean shift period default" VALUE 0xa0021390 _REC_S1VAL_20_u2 25000. _CNV_A_R_LINEAR_____107_CM 0. 25000. FORMAT "%5.0" /end CHARACTERISTIC
/begin CHARACTERISTIC Cxx_lbup_rich_max_thd_v "Minimum Voltage threshold for detection a rich shift period default" VALUE 0xa0021392 _REC_S1VAL_20_u2 25000. _CNV_A_R_LINEAR_____107_CM 0. 25000. FORMAT "%5.0" /end CHARACTERISTIC
/begin CHARACTERISTIC Cxx_lbup_shf_diag_gear "Gear engaged for 02 usptream sensor shift diagnosis" VALUE 0xa00213a9 _REC_S1VAL_20_u1 7. _CNV_A_R_LINEAR_____145_CM -1. 6. FORMAT "%2.0" /end CHARACTERISTIC
/begin CHARACTERISTIC Cxx_lbup_shf_lean_per_nr "Number of period for the 02 usptream sensor lean shift diagnosis" VALUE 0xa00213aa _REC_S1VAL_20_u1 255. _CNV_A_R_ECME_LINEA_0_CM 0. 255. FORMAT "%3.0" /end CHARACTERISTIC
/begin CHARACTERISTIC Cxx_lbup_shf_lean_per_ok_v "Minimum Voltage threshold to take account the period for the 02 usptream sensor lean shift diagnosis" VALUE 0xa0021394 _REC_S1VAL_20_u2 25000. _CNV_A_R_LINEAR_____107_CM 0. 25000. FORMAT "%5.0" /end CHARACTERISTIC
/begin CHARACTERISTIC Cxx_lbup_shf_lean_thd_nr "Number of periods in default to detect a lean shift default" VALUE 0xa00213ab _REC_S1VAL_20_u1 255. _CNV_A_R_ECME_LINEA_0_CM 0. 255. FORMAT "%3.0" /end CHARACTERISTIC
/begin CHARACTERISTIC Cxx_lbup_shf_maf_dif_max "Maximum variation of amount of air pumped into cylinder for diagnosis condition" VALUE 0xa0021396 _REC_S1VAL_20_u2 3000. _CNV_A_R_LINEAR_____172_CM 0. 3000. FORMAT "%7.2" /end CHARACTERISTIC
/begin CHARACTERISTIC Cxx_lbup_shf_maf_max "Maximum value of amount of air pumped into cylinder for diagnosis condition" VALUE 0xa0021398 _REC_S1VAL_20_u2 3000. _CNV_A_R_LINEAR_____172_CM 0. 3000. FORMAT "%7.2" /end CHARACTERISTIC
/begin CHARACTERISTIC Cxx_lbup_shf_maf_min "Minimum value of amount of air pumped into cylinder for diagnosis condition" VALUE 0xa002139a _REC_S1VAL_20_u2 3000. _CNV_A_R_LINEAR_____172_CM 0. 3000. FORMAT "%7.2" /end CHARACTERISTIC
/begin CHARACTERISTIC Cxx_lbup_shf_n_max "Maximum value of engine speed for diagnosis condition" VALUE 0xa002139c _REC_S1VAL_20_u2 16383.75 _CNV_A_R_ENSD_LINEA_22_CM 0. 16383.75 FORMAT "%8.2" /end CHARACTERISTIC
/begin CHARACTERISTIC Cxx_lbup_shf_n_min "Minimum value of engine speed for diagnosis condition" VALUE 0xa002139e _REC_S1VAL_20_u2 16383.75 _CNV_A_R_ENSD_LINEA_22_CM 0. 16383.75 FORMAT "%8.2" /end CHARACTERISTIC
/begin CHARACTERISTIC Cxx_lbup_shf_rich_per_nr "Number of period for the 02 usptream sensor rich shift diagnosis" VALUE 0xa00213ac _REC_S1VAL_20_u1 255. _CNV_A_R_ECME_LINEA_0_CM 0. 255. FORMAT "%3.0" /end CHARACTERISTIC
/begin CHARACTERISTIC Cxx_lbup_shf_rich_per_ok_v "Minimum Voltage threshold to take account the period for the 02 usptream sensor rich shift diagnosis" VALUE 0xa00213a0 _REC_S1VAL_20_u2 25000. _CNV_A_R_LINEAR_____107_CM 0. 25000. FORMAT "%5.0" /end CHARACTERISTIC
/begin CHARACTERISTIC Cxx_lbup_shf_rich_thd_nr "Number of periods in default to detect a rich shift default" VALUE 0xa00213ad _REC_S1VAL_20_u1 255. _CNV_A_R_ECME_LINEA_0_CM 0. 255. FORMAT "%3.0" /end CHARACTERISTIC
/begin CHARACTERISTIC Cxx_lbup_shf_stab_dly "Duration of the stabilisation before measure" VALUE 0xa00213a2 _REC_S1VAL_20_u2 655.35 _CNV_A_R_LINEAR_____32_CM 0. 655.35 FORMAT "%6.2" /end CHARACTERISTIC
/begin CHARACTERISTIC Cxx_lbup_shf_tco_min "Miminum value of engine coolant temperature for diagnosis condition" VALUE 0xa00213a4 _REC_S1VAL_20_u2 240. _CNV_A_R_LINEAR_____110_CM -40. 200. FORMAT "%5.1" /end CHARACTERISTIC
/begin CHARACTERISTIC Cxx_lgl_dly_diag_lbup_shf "Duration before beginning 02 upstream sensor lean/rich shift diagnosis" VALUE 0xa00213a6 _REC_S1VAL_20_u2 6553.5 _CNV_A_R_LINEAR_____58_CM 0. 6553.5 FORMAT "%6.1" /end CHARACTERISTIC
/begin MEASUREMENT Vxx_sens_lbdw_v "" UWORD _CNV_A_R_LINEAR_____107_CM 1 0. 0. 25000. ECU_ADDRESS 0xd0003ed6 FORMAT "%5.0" /end MEASUREMENT
/begin MEASUREMENT ilsh_down "Downstream oxygen sensor heater current" UWORD _CNV_A_R_LINEAR_____289_CM 1 0. 0. 5.5 ECU_ADDRESS 0xd0003edc FORMAT "%6.4" /end MEASUREMENT
/begin MEASUREMENT vls_down[0] "Downstream sensor voltage measured." UWORD _CNV_A_R_LINEAR_____70_CM 1 0. 0. 4.9951171875 ECU_ADDRESS 0xd0003ed8 FORMAT "%5.3" /end MEASUREMENT
/begin MEASUREMENT vlsh_down "Downstream sensor heater voltage measured" UWORD _CNV_A_R_LINEAR_____70_CM 1 0. 0. 4.9951171875 ECU_ADDRESS 0xd0003eda FORMAT "%5.3" /end MEASUREMENT
/begin CHARACTERISTIC c_ilsh_down_gain "Gain for downstream oxygen sensor heater current acquisition" VALUE 0xa0020ac0 _REC_S1VAL_20_u2 1342.16 _CNV_A_R_LINEAR_____332_CM 0. 1342.16 FORMAT "%10.5" /end CHARACTERISTIC
/begin CHARACTERISTIC c_ilsh_down_ofs "Offset for downstream oxygen sensor heater current acquisition" VALUE 0xa0020ac2 _REC_S1VAL_20_u4 20. _CNV_A_R_LINEAR_____289_CM 0. 20. FORMAT "%6.4" /end CHARACTERISTIC
/begin MEASUREMENT Vxx_lim_driv_tqe_sp "Effective engine torque setpoint requested by real (pedal) and virtual (ACC/CC/SL) drivers" UWORD _CNV_A_R_LINEAR_____216_CM 1 0. -400. 1647.96875 ECU_ADDRESS 0xd0004824 FORMAT "%10.5" /end MEASUREMENT
/begin MEASUREMENT Vxx_lim_driv_tqe_tgt "Effective engine torque target requested by real (pedal) and virtual (ACC/CC/SL) drivers" UWORD _CNV_A_R_LINEAR_____216_CM 1 0. -400. 1647.96875 ECU_ADDRESS 0xd0004826 FORMAT "%10.5" /end MEASUREMENT
/begin MEASUREMENT Vbx_tq_trs_ctl_mux "Transient intersystem torque request in progress" UBYTE _CNV_S_2_RANGE______3_CM 1 0. 0. 1. ECU_ADDRESS 0xd0007086 BIT_MASK 0x1 /end MEASUREMENT
/begin MEASUREMENT Vbx_tq_trs_ctl_mux_act "Transient intersystem effective torque request in progress" UBYTE _CNV_S_2_RANGE______3_CM 1 0. 0. 1. ECU_ADDRESS 0xd0007087 BIT_MASK 0x1 /end MEASUREMENT
/begin MEASUREMENT Vxx_arb_agb_tqe_raw "Raw torque after agb arbitration." UWORD _CNV_A_R_LINEAR_____216_CM 1 0. -400. 1647.96875 ECU_ADDRESS 0xd0004802 FORMAT "%10.5" /end MEASUREMENT
/begin MEASUREMENT Vxx_arb_agb_tqe_sp "Torque setpoint after agb arbitration." UWORD _CNV_A_R_LINEAR_____216_CM 1 0. -400. 1647.96875 ECU_ADDRESS 0xd0004804 FORMAT "%10.5" /end MEASUREMENT
/begin MEASUREMENT Vxx_arb_agb_tqe_tgt "Target torque after agb arbitration." UWORD _CNV_A_R_LINEAR_____216_CM 1 0. -400. 1647.96875 ECU_ADDRESS 0xd0004806 FORMAT "%10.5" /end MEASUREMENT
/begin MEASUREMENT Vxx_arb_esp_tqe_raw "Raw tarque after esp arbitration." UWORD _CNV_A_R_LINEAR_____216_CM 1 0. -400. 1647.96875 ECU_ADDRESS 0xd0004808 FORMAT "%10.5" /end MEASUREMENT
/begin MEASUREMENT Vxx_arb_esp_tqe_sp "Torque setpoint after esp arbitration." UWORD _CNV_A_R_LINEAR_____216_CM 1 0. -400. 1647.96875 ECU_ADDRESS 0xd000480a FORMAT "%10.5" /end MEASUREMENT
/begin MEASUREMENT Vxx_arb_esp_tqe_tgt "Target torque after esp arbitration." UWORD _CNV_A_R_LINEAR_____216_CM 1 0. -400. 1647.96875 ECU_ADDRESS 0xd000480c FORMAT "%10.5" /end MEASUREMENT
/begin MEASUREMENT Vxx_arb_etc_tqe_raw "Raw torque after etc arbitration." UWORD _CNV_A_R_LINEAR_____216_CM 1 0. -400. 1647.96875 ECU_ADDRESS 0xd000480e FORMAT "%10.5" /end MEASUREMENT
/begin MEASUREMENT Vxx_arb_etc_tqe_sp "Torque setpoint after etc arbitration." UWORD _CNV_A_R_LINEAR_____216_CM 1 0. -400. 1647.96875 ECU_ADDRESS 0xd0004810 FORMAT "%10.5" /end MEASUREMENT
/begin MEASUREMENT Vxx_arb_etc_tqe_tgt "Target torque after etc arbitration." UWORD _CNV_A_R_LINEAR_____216_CM 1 0. -400. 1647.96875 ECU_ADDRESS 0xd0004812 FORMAT "%10.5" /end MEASUREMENT
/begin MEASUREMENT Vxx_arb_no_agb_tqe "torque request wihout agb request" UWORD _CNV_A_R_LINEAR_____216_CM 1 0. -400. 1647.96875 ECU_ADDRESS 0xd0004814 FORMAT "%10.5" /end MEASUREMENT
/begin MEASUREMENT Vxx_arb_tqe_raw "Slow torque withour AT request and without anti-jerk." UWORD _CNV_A_R_LINEAR_____216_CM 1 0. -400. 1647.96875 ECU_ADDRESS 0xd0004816 FORMAT "%10.5" /end MEASUREMENT
/begin MEASUREMENT Vxx_arb_tqe_sp "Torque Setpoint before AJS Correction action" UWORD _CNV_A_R_LINEAR_____216_CM 1 0. -400. 1647.96875 ECU_ADDRESS 0xd0004818 FORMAT "%10.5" /end MEASUREMENT
/begin MEASUREMENT Vxx_arb_tqe_tgt "Torque Target before AJS Correction action" UWORD _CNV_A_R_LINEAR_____216_CM 1 0. -400. 1647.96875 ECU_ADDRESS 0xd000481a FORMAT "%10.5" /end MEASUREMENT
/begin MEASUREMENT Vxx_raw_arb_no_agb_tqe "target torque request wihout agb request" UWORD _CNV_A_R_LINEAR_____216_CM 1 0. -400. 1647.96875 ECU_ADDRESS 0xd000481c FORMAT "%10.5" /end MEASUREMENT
/begin CHARACTERISTIC Cxx_ctl_mux_act_thd "Intersystem torque change threshold to detect an effective request." VALUE 0xa0021cac _REC_S1VAL_20_u2 1647.96875 _CNV_A_R_LINEAR_____181_CM 0. 1647.96875 FORMAT "%10.5" /end CHARACTERISTIC
/begin MEASUREMENT Vxx_gbx_max_tqe_sp "Gearbox setpoint request which will be sent to torque arbitration in max bloc." UWORD _CNV_A_R_LINEAR_____216_CM 1 0. -400. 1647.96875 ECU_ADDRESS 0xd0004828 FORMAT "%11.5" /end MEASUREMENT
/begin MEASUREMENT Vxx_gbx_max_tqe_tgt "Gearbox slow request which will be sent to torque arbitration in max bloc." UWORD _CNV_A_R_LINEAR_____216_CM 1 0. -400. 1647.96875 ECU_ADDRESS 0xd000482a FORMAT "%11.5" /end MEASUREMENT
/begin MEASUREMENT Vxx_gbx_min_tqe_sp "Gearbox setpoint request which will be sent to torque arbitration in min bloc." UWORD _CNV_A_R_LINEAR_____216_CM 1 0. -400. 1647.96875 ECU_ADDRESS 0xd000482c FORMAT "%11.5" /end MEASUREMENT
/begin MEASUREMENT Vxx_gbx_min_tqe_tgt "Gearbox slow request which will be sent to torque arbitration in min bloc." UWORD _CNV_A_R_LINEAR_____216_CM 1 0. -400. 1647.96875 ECU_ADDRESS 0xd000482e FORMAT "%11.5" /end MEASUREMENT
/begin MEASUREMENT Vxx_max_dyn_avl_tqi "Maximum indicated torque with dynamic limitation" UWORD _CNV_A_R_LINEAR_____181_CM 1 0. 0. 2047.96875 ECU_ADDRESS 0xd0004b66 FORMAT "%10.5" /end MEASUREMENT
/begin MEASUREMENT Vxx_max_stat_avl_tqi_ovn "Maximum absolute indicated torque with soft overspeed correction" UWORD _CNV_A_R_LINEAR_____181_CM 1 0. 0. 2047.96875 ECU_ADDRESS 0xd0004b68 FORMAT "%10.5" /end MEASUREMENT
/begin MEASUREMENT Vxx_tqi_rat_tgt "Final indicated target torque ratio" UWORD _CNV_A_R_LINEAR_____183_CM 1 0. 0. 1. ECU_ADDRESS 0xd0004b6a FORMAT "%11.9" /end MEASUREMENT
/begin MEASUREMENT Vxx_tqi_raw "final indicated torque raw" UWORD _CNV_A_R_LINEAR_____181_CM 1 0. 0. 2047.96875 ECU_ADDRESS 0xd0004b6c FORMAT "%10.5" /end MEASUREMENT
/begin MEASUREMENT Vxx_tqi_sp "Final indicated torque set point" UWORD _CNV_A_R_LINEAR_____181_CM 1 0. 0. 2047.96875 ECU_ADDRESS 0xd0004b6e FORMAT "%10.5" /end MEASUREMENT
/begin MEASUREMENT Vxx_tqi_sp_no_ajs "Final indicated torque set point without AJCOR correction" UWORD _CNV_A_R_LINEAR_____181_CM 1 0. 0. 2047.96875 ECU_ADDRESS 0xd0004b70 FORMAT "%10.5" /end MEASUREMENT
/begin MEASUREMENT Vxx_tqi_tgt "Final indicated target torque" UWORD _CNV_A_R_LINEAR_____181_CM 1 0. 0. 2047.96875 ECU_ADDRESS 0xd0004b72 FORMAT "%10.5" /end MEASUREMENT
/begin CHARACTERISTIC Cbx_ovn_nul_tqi_sp_cfm "Anti over-speed by torque modulation configuration : annulation of tqi_sp" VALUE 0xa0021ffe _REC_S1VAL_20_u1 1. _CNV_A_R_ECME_LINEA_0_CM 0. 1. FORMAT "%1.0" BIT_MASK 0x1 /end CHARACTERISTIC
/begin CHARACTERISTIC Cbx_tqi_raw_bch_cfm "Raw indicated torque bench mode" VALUE 0xa0021fff _REC_S1VAL_20_u1 1. _CNV_S_2_RANGE______3_CM 0. 1. BIT_MASK 0x1 /end CHARACTERISTIC
/begin CHARACTERISTIC Cbx_tqi_sp_bch_cfm "Setpoint indicated torque bench mode" VALUE 0xa0022000 _REC_S1VAL_20_u1 1. _CNV_S_2_RANGE______3_CM 0. 1. BIT_MASK 0x1 /end CHARACTERISTIC
/begin CHARACTERISTIC Cbx_tqi_tgt_bch_cfm "Target indicated torque bench mode" VALUE 0xa0022001 _REC_S1VAL_20_u1 1. _CNV_S_2_RANGE______3_CM 0. 1. BIT_MASK 0x1 /end CHARACTERISTIC
/begin CHARACTERISTIC Cxx_ajs_cor_lim_tq_ofs "Torque offset added to the maximum dynamic torque autorized for AJCOR" VALUE 0xa0021ff6 _REC_S1VAL_20_u2 2047.96875 _CNV_A_R_LINEAR_____181_CM 0. 2047.96875 FORMAT "%10.5" /end CHARACTERISTIC
/begin CHARACTERISTIC Cxx_tqi_raw_bch "Raw indicated torque bench value" VALUE 0xa0021ff8 _REC_S1VAL_20_u2 2047.96875 _CNV_A_R_LINEAR_____181_CM 0. 2047.96875 FORMAT "%10.5" /end CHARACTERISTIC
/begin CHARACTERISTIC Cxx_tqi_sp_bch "Setpoint indicated torque bench value" VALUE 0xa0021ffa _REC_S1VAL_20_u2 2047.96875 _CNV_A_R_LINEAR_____181_CM 0. 2047.96875 FORMAT "%10.5" /end CHARACTERISTIC
/begin CHARACTERISTIC Cxx_tqi_tgt_bch "Target indicated torque bench value" VALUE 0xa0021ffc _REC_S1VAL_20_u2 2047.96875 _CNV_A_R_LINEAR_____181_CM 0. 2047.96875 FORMAT "%10.5" /end CHARACTERISTIC
/begin CHARACTERISTIC Ctp_cut_decl_dly "Delay table between the injection cut condition and the injection cut request in fonction of the gearbox" CURVE 0xa0036cbc _REC_A1CUR_20_u2_u1 655.35 _CNV_A_R_LINEAR_____32_CM 0. 655.35 FORMAT "%6.2"
 /begin AXIS_DESCR COM_AXIS Vxx_gear _CNV_A_R_LINEAR_____145_CM 8 -1. 6. READ_ONLY FORMAT "%2.0" AXIS_PTS_REF Ntb_gear /end AXIS_DESCR
/end CHARACTERISTIC
/begin MEASUREMENT Vbx_cut_ct "Detected if the injection cut request is coming of powertrain torque setpoint" UBYTE _CNV_S_2_RANGE______3_CM 1 0. 0. 1. ECU_ADDRESS 0xd00071ca BIT_MASK 0x1 /end MEASUREMENT
/begin MEASUREMENT Vbx_cut_dly_off_trs_3 "transition 3" UBYTE _CNV_S_2_RANGE______3_CM 1 0. 0. 1. ECU_ADDRESS 0xd00071cb BIT_MASK 0x1 /end MEASUREMENT
/begin MEASUREMENT Vbx_cut_dly_on_trs_2 "transition 2" UBYTE _CNV_S_2_RANGE______3_CM 1 0. 0. 1. ECU_ADDRESS 0xd00071cc BIT_MASK 0x1 /end MEASUREMENT
/begin MEASUREMENT Vbx_cut_off_dly_trs_1 "transition 1" UBYTE _CNV_S_2_RANGE______3_CM 1 0. 0. 1. ECU_ADDRESS 0xd00071cd BIT_MASK 0x1 /end MEASUREMENT
/begin MEASUREMENT Vbx_swi_drv_cut "Detection of automatic switch on the high engine derivate condition" UBYTE _CNV_S_2_RANGE______3_CM 1 0. 0. 1. ECU_ADDRESS 0xd00071ce BIT_MASK 0x1 /end MEASUREMENT
/begin MEASUREMENT Vbx_swi_drv_cut_n "Detection that the engine speed is smaller that the engine speed threshold if engine derivative is high" UBYTE _CNV_S_2_RANGE______3_CM 1 0. 0. 1. ECU_ADDRESS 0xd00071cf BIT_MASK 0x1 /end MEASUREMENT
/begin MEASUREMENT Vsx_driv_cut_req "injection cut requested by driver" UBYTE _CNV_A_R_ECME_LINEA_0_CM 1 0. 0. 255. ECU_ADDRESS 0xd00071d0 FORMAT "%3.0" /end MEASUREMENT
/begin CHARACTERISTIC Cxx_cut_decl_dly_tq_rat "delay before injection cut during a gear ratio change" VALUE 0xa0022036 _REC_S1VAL_20_u2 655.35 _CNV_A_R_LINEAR_____32_CM 0. 655.35 FORMAT "%6.2" /end CHARACTERISTIC
/begin AXIS_PTS Ctb_tco_cut "Engine coolant temperature breakpoints for injection cut" 0xa0036c94 Vxx_tco _REC_A2AXS_20_u2 240. _CNV_A_R_LINEAR_____110_CM 9 -40. 200. FORMAT "%5.1" /end AXIS_PTS
/begin CHARACTERISTIC Ctp_tco_cut_decl_off_dly "delay table in function of coolant temperature" CURVE 0xa0036ca8 _REC_A1CUR_20_u2_u2 655.35 _CNV_A_R_LINEAR_____32_CM 0. 655.35 FORMAT "%6.2"
 /begin AXIS_DESCR COM_AXIS Vxx_tco _CNV_A_R_LINEAR_____110_CM 9 -40. 200. FORMAT "%5.1" AXIS_PTS_REF Ctb_tco_cut /end AXIS_DESCR
/end CHARACTERISTIC
/begin MEASUREMENT Vbx_ant_gear_coup_cut_ct_1 "First gear ratio is detected" UBYTE _CNV_S_2_RANGE______3_CM 1 0. 0. 1. ECU_ADDRESS 0xd00071c6 BIT_MASK 0x1 /end MEASUREMENT
/begin MEASUREMENT Vbx_cut_cdn "Flag of injection cut condition" UBYTE _CNV_S_2_RANGE______3_CM 1 0. 0. 1. ECU_ADDRESS 0xd00071c7 BIT_MASK 0x1 /end MEASUREMENT
/begin MEASUREMENT Vbx_swi_drv_n "Detection of the high engine derivate condition" UBYTE _CNV_S_2_RANGE______3_CM 1 0. 0. 1. ECU_ADDRESS 0xd00071c8 BIT_MASK 0x1 /end MEASUREMENT
/begin MEASUREMENT Vxx_ena_cut_n_ofs "enable cut engine offset" UWORD _CNV_A_R_ENSD_LINEA_22_CM 1 0. 0. 16383.75 ECU_ADDRESS 0xd0004b8e FORMAT "%8.2" /end MEASUREMENT
/begin MEASUREMENT Vxx_swi_cut_n_ofs "switch of injection cut engine speed offset" UWORD _CNV_A_R_ENSD_LINEA_22_CM 1 0. 0. 16383.75 ECU_ADDRESS 0xd0004b90 FORMAT "%8.2" /end MEASUREMENT
/begin MEASUREMENT Vxx_swi_drv_cut_n_ofs "switch of derivate injection cut offset" UWORD _CNV_A_R_ENSD_LINEA_22_CM 1 0. 0. 16383.75 ECU_ADDRESS 0xd0004b92 FORMAT "%8.2" /end MEASUREMENT
/begin MEASUREMENT Vxx_tq_fuel_typ_rat_cs "Ratio dedicated to the torque management adjustment with the validity status consolidation" UWORD _CNV_A_R_LINEAR_____161_CM 1 0. 0. 1. ECU_ADDRESS 0xd0004b94 FORMAT "%5.3" /end MEASUREMENT
/begin MEASUREMENT Vxx_tq_fuel_typ_rat_cs_1 "1 - flex-fuel ratio dedicated to the torque management adjustment with the validity status consolidation" UWORD _CNV_A_R_LINEAR_____161_CM 1 0. 0. 1. ECU_ADDRESS 0xd0004b96 FORMAT "%5.3" /end MEASUREMENT
/begin CHARACTERISTIC Cbx_ant_gear_coup_cut_ct_ena "Consolidation of the gearbox ratio with the coupler state in egb configuration" VALUE 0xa0022034 _REC_S1VAL_20_u1 1. _CNV_A_R_ECME_LINEA_0_CM 0. 1. FORMAT "%1.0" BIT_MASK 0x1 /end CHARACTERISTIC
/begin CHARACTERISTIC Cxx_aut_swi1_is_ofs "engine offset after cut, threshold is added of idle speed set point, if the first gear ratio is detected" VALUE 0xa0022002 _REC_S1VAL_20_u2 16383.75 _CNV_A_R_ENSD_LINEA_22_CM 0. 16383.75 FORMAT "%8.2" /end CHARACTERISTIC
/begin CHARACTERISTIC Cxx_aut_swi1_is_ofs_alco "engine offset after cut, threshold is added of idle speed set point, if the first gear ratio is detected for flex-fuel" VALUE 0xa0022004 _REC_S1VAL_20_u2 16383.75 _CNV_A_R_ENSD_LINEA_22_CM 0. 16383.75 FORMAT "%8.2" /end CHARACTERISTIC
/begin CHARACTERISTIC Cxx_aut_swi_is_ofs "engine offset after cut, threshold is added of idle speed set point, if gear ratio is different of first ratio" VALUE 0xa0022006 _REC_S1VAL_20_u2 16383.75 _CNV_A_R_ENSD_LINEA_22_CM 0. 16383.75 FORMAT "%8.2" /end CHARACTERISTIC
/begin CHARACTERISTIC Cxx_aut_swi_is_ofs_alco "engine offset after cut, threshold is added of idle speed set point, if gear ratio is different of first ratio for flex-fuel" VALUE 0xa0022008 _REC_S1VAL_20_u2 16383.75 _CNV_A_R_ENSD_LINEA_22_CM 0. 16383.75 FORMAT "%8.2" /end CHARACTERISTIC
/begin CHARACTERISTIC Cxx_cut_decl_tco_thd "injection cut deceleration coolant temperature threshold" VALUE 0xa002200a _REC_S1VAL_20_u2 240. _CNV_A_R_LINEAR_____110_CM -40. 200. FORMAT "%5.1" /end CHARACTERISTIC
/begin CHARACTERISTIC Cxx_cut_decl_tco_thd_alco "injection cut deceleration coolant temperature threshold for flex-fuel" VALUE 0xa002200c _REC_S1VAL_20_u2 240. _CNV_A_R_LINEAR_____110_CM -40. 200. FORMAT "%5.1" /end CHARACTERISTIC
/begin CHARACTERISTIC Cxx_cut_decl_tqi_thd "Torque threshold during the transient intersystem torque request , comparaison with the final indicated torque set point" VALUE 0xa002200e _REC_S1VAL_20_u2 2047.96875 _CNV_A_R_LINEAR_____181_CM 0. 2047.96875 FORMAT "%10.5" /end CHARACTERISTIC
/begin CHARACTERISTIC Cxx_cut_n_ofs "injection cut engine offset" VALUE 0xa0022010 _REC_S1VAL_20_u2 16383.75 _CNV_A_R_ENSD_LINEA_22_CM 0. 16383.75 FORMAT "%8.2" /end CHARACTERISTIC
/begin CHARACTERISTIC Cxx_cut_n_ofs2 "injection cut engine offset, if a powertrain torque setpoint is requested" VALUE 0xa0022012 _REC_S1VAL_20_u2 16383.75 _CNV_A_R_ENSD_LINEA_22_CM 0. 16383.75 FORMAT "%8.2" /end CHARACTERISTIC
/begin CHARACTERISTIC Cxx_cut_n_ofs2_alco "injection cut engine offset, if a powertrain torque setpoint is requested for flex-fuel" VALUE 0xa0022014 _REC_S1VAL_20_u2 16383.75 _CNV_A_R_ENSD_LINEA_22_CM 0. 16383.75 FORMAT "%8.2" /end CHARACTERISTIC
/begin CHARACTERISTIC Cxx_cut_n_ofs_alco "injection cut engine offset for flex-fuel" VALUE 0xa0022016 _REC_S1VAL_20_u2 16383.75 _CNV_A_R_ENSD_LINEA_22_CM 0. 16383.75 FORMAT "%8.2" /end CHARACTERISTIC
/begin CHARACTERISTIC Cxx_decl_cut_n_ac_ofs "Deceleration injection cut engine offset if air conditioning compressor is clutched" VALUE 0xa0022018 _REC_S1VAL_20_u2 16383.75 _CNV_A_R_ENSD_LINEA_22_CM 0. 16383.75 FORMAT "%8.2" /end CHARACTERISTIC
/begin CHARACTERISTIC Cxx_decl_cut_n_ac_ofs_alco "Deceleration injection cut engine offset if air conditioning compressor is clutched for flex-fuel." VALUE 0xa002201a _REC_S1VAL_20_u2 16383.75 _CNV_A_R_ENSD_LINEA_22_CM 0. 16383.75 FORMAT "%8.2" /end CHARACTERISTIC
/begin CHARACTERISTIC Cxx_decl_cut_n_ofs "deceleration injection cut engine offset" VALUE 0xa002201c _REC_S1VAL_20_u2 16383.75 _CNV_A_R_ENSD_LINEA_22_CM 0. 16383.75 FORMAT "%8.2" /end CHARACTERISTIC
/begin CHARACTERISTIC Cxx_decl_cut_n_ofs_alco "deceleration injection cut engine offset for flex-fuel" VALUE 0xa002201e _REC_S1VAL_20_u2 16383.75 _CNV_A_R_ENSD_LINEA_22_CM 0. 16383.75 FORMAT "%8.2" /end CHARACTERISTIC
/begin CHARACTERISTIC Cxx_kd_decl_cut_n_ac_alco "Deceleration injection cut engine offset, if a powertrain torque setpoint is requested and the AC is clutched for flex-fuel" VALUE 0xa0022020 _REC_S1VAL_20_u2 16383.75 _CNV_A_R_ENSD_LINEA_22_CM 0. 16383.75 FORMAT "%8.2" /end CHARACTERISTIC
/begin CHARACTERISTIC Cxx_kd_decl_cut_n_ac_ofs "Deceleration injection cut engine offset, if a powertrain torque setpoint is requested and the air conditioning compressor is clutched." VALUE 0xa0022022 _REC_S1VAL_20_u2 16383.75 _CNV_A_R_ENSD_LINEA_22_CM 0. 16383.75 FORMAT "%8.2" /end CHARACTERISTIC
/begin CHARACTERISTIC Cxx_kd_decl_cut_n_ofs "deceleration injection cut engine offset, if a powertrain torque setpoint is requested" VALUE 0xa0022024 _REC_S1VAL_20_u2 16383.75 _CNV_A_R_ENSD_LINEA_22_CM 0. 16383.75 FORMAT "%8.2" /end CHARACTERISTIC
/begin CHARACTERISTIC Cxx_kd_decl_cut_n_ofs_alco "deceleration injection cut engine offset, if a powertrain torque setpoint is requested for flex-fuel" VALUE 0xa0022026 _REC_S1VAL_20_u2 16383.75 _CNV_A_R_ENSD_LINEA_22_CM 0. 16383.75 FORMAT "%8.2" /end CHARACTERISTIC
/begin CHARACTERISTIC Cxx_swi_drv_is_ofs "engine offset after cut when engine derivate is low" VALUE 0xa0022028 _REC_S1VAL_20_u2 16383.75 _CNV_A_R_ENSD_LINEA_22_CM 0. 16383.75 FORMAT "%8.2" /end CHARACTERISTIC
/begin CHARACTERISTIC Cxx_swi_drv_is_ofs_alco "engine offset after cut when engine derivate is low for flex-fuel" VALUE 0xa002202a _REC_S1VAL_20_u2 16383.75 _CNV_A_R_ENSD_LINEA_22_CM 0. 16383.75 FORMAT "%8.2" /end CHARACTERISTIC
/begin CHARACTERISTIC Cxx_swi_drv_n_thd "switch derivate engine threshold" VALUE 0xa002202c _REC_S1VAL_20_s2 16383. _CNV_A_R_LINEAR_____21_CM -8192. 8191. FORMAT "%5.0" /end CHARACTERISTIC
/begin CHARACTERISTIC Cxx_swi_drv_n_thd_alco "switch derivate engine threshold for flex-fuel" VALUE 0xa002202e _REC_S1VAL_20_s2 16383. _CNV_A_R_LINEAR_____21_CM -8192. 8191. FORMAT "%5.0" /end CHARACTERISTIC
/begin CHARACTERISTIC Cxx_tq_fuel_typ_rat_cut_dft "Flex-fuel ratio if the final alcohol adaptive is failling for engine condition" VALUE 0xa0022030 _REC_S1VAL_20_u2 1. _CNV_A_R_LINEAR_____161_CM 0. 1. FORMAT "%5.3" /end CHARACTERISTIC
/begin CHARACTERISTIC Cxx_wet_fuel_typ_rat_cut_dft "Flex-fuel ratio if the final alcohol adaptive is failing for coolant temperature condition" VALUE 0xa0022032 _REC_S1VAL_20_u2 1. _CNV_A_R_LINEAR_____161_CM 0. 1. FORMAT "%5.3" /end CHARACTERISTIC
/begin CHARACTERISTIC Ctp_n_min_bas_cor_fac "raw torque correction factor" CURVE 0xa0036c88 _REC_A1CUR_20_u1_u2 0.99609375 _CNV_A_R_LINEAR_____29_CM 0. 0.99609375 FORMAT "%10.8"
 /begin AXIS_DESCR COM_AXIS Vxx_n _CNV_A_R_ENSD_LINEA_22_CM 9 0. 16383.75 FORMAT "%8.2" AXIS_PTS_REF Ctb_n2 /end AXIS_DESCR
/end CHARACTERISTIC
/begin MEASUREMENT Vxx_chk_arb_tqi_raw "Raw indicated torque after check" UWORD _CNV_A_R_LINEAR_____181_CM 1 0. 0. 2047.96875 ECU_ADDRESS 0xd0004b74 FORMAT "%10.5" /end MEASUREMENT
/begin MEASUREMENT Vxx_chk_arb_tqi_sp "Setpoint indicated torque after check" UWORD _CNV_A_R_LINEAR_____181_CM 1 0. 0. 2047.96875 ECU_ADDRESS 0xd0004b76 FORMAT "%10.5" /end MEASUREMENT
/begin MEASUREMENT Vxx_chk_arb_tqi_tgt "Target indicated torque after check" UWORD _CNV_A_R_LINEAR_____181_CM 1 0. 0. 2047.96875 ECU_ADDRESS 0xd0004b78 FORMAT "%10.5" /end MEASUREMENT
/begin MEASUREMENT Vxx_iga_arb_tqi_tgt "Target indicated torque after minimal ignition check" UWORD _CNV_A_R_LINEAR_____181_CM 1 0. 0. 2047.96875 ECU_ADDRESS 0xd0004b7a FORMAT "%10.5" /end MEASUREMENT
/begin MEASUREMENT Vxx_knk_arb_tqi_tgt "Target indicated torque after slow knock correction" UWORD _CNV_A_R_LINEAR_____181_CM 1 0. 0. 2047.96875 ECU_ADDRESS 0xd0004b7c FORMAT "%10.5" /end MEASUREMENT
/begin MEASUREMENT Vxx_min_arb_tqi[0] "Target indicated torque after idle speed correction" UWORD _CNV_A_R_LINEAR_____181_CM 1 0. 0. 2047.96875 ECU_ADDRESS 0xd0004b7e FORMAT "%10.5" /end MEASUREMENT
/begin MEASUREMENT Vxx_min_arb_tqi[1] "Target indicated torque after idle speed correction" UWORD _CNV_A_R_LINEAR_____181_CM 1 0. 0. 2047.96875 ECU_ADDRESS 0xd0004b80 FORMAT "%10.5" /end MEASUREMENT
/begin MEASUREMENT Vxx_raw_min_bas_tq_cor "Raw indicated torque correction for alternator, air conditionning, automatic gearbox, ..." SWORD _CNV_A_R_LINEAR_____181_CM 1 0. -1024. 1023.96875 ECU_ADDRESS 0xd0004b82 FORMAT "%11.5" /end MEASUREMENT
/begin MEASUREMENT Vxx_sta_tq_raw "Raw start torque setpoint" UWORD _CNV_A_R_LINEAR_____181_CM 1 0. 0. 2047.96875 ECU_ADDRESS 0xd0004b84 FORMAT "%10.5" /end MEASUREMENT
/begin MEASUREMENT Vxx_wup_arb_tqi_tgt "Target indicated torque after warm-up correction" UWORD _CNV_A_R_LINEAR_____181_CM 1 0. 0. 2047.96875 ECU_ADDRESS 0xd0004b86 FORMAT "%10.5" /end MEASUREMENT
/begin CHARACTERISTIC Ctp_n_h_thr_tq "Torque threshold above which we have to control the waste-gate" CURVE 0xa0036ccc _REC_A1CUR_20_u2_u2 2047.96875 _CNV_A_R_LINEAR_____181_CM 0. 2047.96875 FORMAT "%10.5"
 /begin AXIS_DESCR COM_AXIS Vxx_n _CNV_A_R_ENSD_LINEA_22_CM 20 0. 16383.75 FORMAT "%8.2" AXIS_PTS_REF Ctb_n /end AXIS_DESCR
/end CHARACTERISTIC
/begin MEASUREMENT Vbx_fl "Indicates that the full load is requested by the driver" UBYTE _CNV_S_2_RANGE______3_CM 1 0. 0. 1. ECU_ADDRESS 0xd00071d4 BIT_MASK 0x1 /end MEASUREMENT
/begin MEASUREMENT Vbx_kd_fl_ena "Indicates that the full load is requested by the driver on a kick down" UBYTE _CNV_S_2_RANGE______3_CM 1 0. 0. 1. ECU_ADDRESS 0xd00071d5 BIT_MASK 0x1 /end MEASUREMENT
/begin MEASUREMENT Vbx_spg_fl_ena "Indicates that the full load is requested by the driver in supercharging zone" UBYTE _CNV_S_2_RANGE______3_CM 1 0. 0. 1. ECU_ADDRESS 0xd00071d6 BIT_MASK 0x1 /end MEASUREMENT
/begin MEASUREMENT Vbx_ufld_fl_ena "Indicates that the full load is requested by the driver for the unflooding, during the start engine" UBYTE _CNV_S_2_RANGE______3_CM 1 0. 0. 1. ECU_ADDRESS 0xd00071d7 BIT_MASK 0x1 /end MEASUREMENT
/begin CHARACTERISTIC Cbx_spg_fl_cfm "Configuration : Full load in supercharging zone =1. Full load on driver kick down only = 0." VALUE 0xa0022044 _REC_S1VAL_20_u1 1. _CNV_A_R_ECME_LINEA_0_CM 0. 1. FORMAT "%1.0" BIT_MASK 0x1 /end CHARACTERISTIC
/begin CHARACTERISTIC Cbx_tq_trs_ctl_mux_efv_cfm "Configuration : every intersystem torque requests stop full load demand = 0. Only effective intersystem torque requests stop full load =\r1." VALUE 0xa0022045 _REC_S1VAL_20_u1 1. _CNV_A_R_ECME_LINEA_0_CM 0. 1. FORMAT "%1.0" BIT_MASK 0x1 /end CHARACTERISTIC
/begin CHARACTERISTIC Cxx_acel_pdl_ufld_it_hys "Accelerator pedal hysteresis for unflooding during the start engine" VALUE 0xa0022038 _REC_S1VAL_20_u2 1.25 _CNV_A_R_LINEAR_____319_CM 0. 1.25 FORMAT "%8.5" /end CHARACTERISTIC
/begin CHARACTERISTIC Cxx_acel_pdl_ufld_it_thd "Accelerator pedal threshold for unflooding during the start engine" VALUE 0xa002203a _REC_S1VAL_20_u2 1.25 _CNV_A_R_LINEAR_____319_CM 0. 1.25 FORMAT "%8.5" /end CHARACTERISTIC
/begin CHARACTERISTIC Cxx_fl_tq_hys "Torque hysteresis" VALUE 0xa002203c _REC_S1VAL_20_u2 2047.96875 _CNV_A_R_LINEAR_____181_CM 0. 2047.96875 FORMAT "%10.5" /end CHARACTERISTIC
/begin CHARACTERISTIC Cxx_fl_tq_hys2 "Torque hysteresis for full load" VALUE 0xa002203e _REC_S1VAL_20_u2 2047.96875 _CNV_A_R_LINEAR_____181_CM 0. 2047.96875 FORMAT "%10.5" /end CHARACTERISTIC
/begin CHARACTERISTIC Cxx_fl_tq_ofs "Torque offset" VALUE 0xa0022040 _REC_S1VAL_20_u2 2047.96875 _CNV_A_R_LINEAR_____181_CM 0. 2047.96875 FORMAT "%10.5" /end CHARACTERISTIC
/begin CHARACTERISTIC Cxx_fl_tq_spg_hys "Torque hysteresis for full load (supercharger only)" VALUE 0xa0022042 _REC_S1VAL_20_u2 2047.96875 _CNV_A_R_LINEAR_____181_CM 0. 2047.96875 FORMAT "%10.5" /end CHARACTERISTIC
/begin AXIS_PTS Ctb_knk_iga_slow_cor_mv "Breakpoint of mean slow knock correction on four cylinder" 0xa0022046 Vxx_knk_iga_slow_cor_mv _REC_A2AXS_20_u1 95.625 _CNV_A_R_LINEAR_____23_CM 6 0. 95.625 /end AXIS_PTS
/begin CHARACTERISTIC Cmp_knk_rel_tq_cor_max "Maximum correction of the relative torque to decrease the load in knock zone." MAP 0xa0036cf4 _REC_A1MAP_20_u2_u2_u1 1. _CNV_A_R_LINEAR_____183_CM 0. 1. FORMAT "%11.9"
 /begin AXIS_DESCR COM_AXIS Vxx_n _CNV_A_R_ENSD_LINEA_22_CM 9 0. 16383.75 FORMAT "%8.2" AXIS_PTS_REF Ctb_n2 /end AXIS_DESCR
 /begin AXIS_DESCR COM_AXIS Vxx_knk_iga_slow_cor_mv _CNV_A_R_LINEAR_____23_CM 6 0. 95.625 AXIS_PTS_REF Ctb_knk_iga_slow_cor_mv /end AXIS_DESCR
/end CHARACTERISTIC
/begin MEASUREMENT Vxx_knk_iga_cor_fil_mv "The filtered mean knock correction on four cylinder" UBYTE _CNV_A_R_LINEAR_____23_CM 1 0. 0. 95.625 ECU_ADDRESS 0xd0007cec /end MEASUREMENT
/begin MEASUREMENT Vxx_knk_iga_cor_mv "The mean knock correction on four cylinder" UBYTE _CNV_A_R_LINEAR_____23_CM 1 0. 0. 95.625 ECU_ADDRESS 0xd0007ced /end MEASUREMENT
/begin MEASUREMENT Vxx_knk_iga_slow_cor_mv "Mean slow knock correction on four cylinder" UBYTE _CNV_A_R_LINEAR_____23_CM 1 0. 0. 95.625 ECU_ADDRESS 0xd0007cee /end MEASUREMENT
/begin MEASUREMENT Vxx_knk_rel_tq_appl_cor "The applied relative torque correction for the load in knock zone" UWORD _CNV_A_R_LINEAR_____183_CM 1 0. 0. 1. ECU_ADDRESS 0xd0004ba0 FORMAT "%11.9" /end MEASUREMENT
/begin MEASUREMENT Vxx_knk_rel_tq_cor "The relative torque correction for the load in knock zone" UWORD _CNV_A_R_LINEAR_____183_CM 1 0. 0. 1. ECU_ADDRESS 0xd00060ea FORMAT "%11.9" /end MEASUREMENT
/begin MEASUREMENT Vxx_knk_rel_tq_cor_dec "decrease step for relative torque" UWORD _CNV_A_R_LINEAR_____183_CM 1 0. 0. 1. ECU_ADDRESS 0xd00060ec FORMAT "%11.9" /end MEASUREMENT
/begin MEASUREMENT Vxx_knk_rel_tq_cor_inc "increase step for relative torque" UWORD _CNV_A_R_LINEAR_____183_CM 1 0. 0. 1. ECU_ADDRESS 0xd00060ee FORMAT "%11.9" /end MEASUREMENT
/begin MEASUREMENT Vxx_knk_rel_tq_cor_max "Maximum relative torque correction decrease the load in the knock zone" UWORD _CNV_A_R_LINEAR_____183_CM 1 0. 0. 1. ECU_ADDRESS 0xd00060f0 FORMAT "%11.9" /end MEASUREMENT
/begin MEASUREMENT Vxx_knk_tq_cor_dec_dly "Current value of the timer to increase of one the step of relative torque in the knock zone" UWORD _CNV_A_R_LINEAR_____32_CM 1 0. 0. 655.35 ECU_ADDRESS 0xd00060f2 FORMAT "%6.2" /end MEASUREMENT
/begin MEASUREMENT Vxx_knk_tq_cor_inc_dly "Current value of the timer to decrease of one the step of relative torque in the knock zone" UWORD _CNV_A_R_LINEAR_____32_CM 1 0. 0. 655.35 ECU_ADDRESS 0xd00060f4 FORMAT "%6.2" /end MEASUREMENT
/begin CHARACTERISTIC Cbx_knk_out_tq_cor "Configuration boolean to enable the torque correction outside the knock zone" VALUE 0xa002205e _REC_S1VAL_20_u1 1. _CNV_S_2_RANGE______3_CM 0. 1. BIT_MASK 0x1 /end CHARACTERISTIC
/begin CHARACTERISTIC Cxx_knk_iga_cor_fil_ftc "Time constant for the ignition advance correction in knock zone" VALUE 0xa002204e _REC_S1VAL_20_u2 655.35 _CNV_A_R_LINEAR_____32_CM 0. 655.35 FORMAT "%6.2" /end CHARACTERISTIC
/begin CHARACTERISTIC Cxx_knk_slow_fil_mv_hys "Hysteresis on the ignition correction threshold, for the output and the input of the torque correction" VALUE 0xa002205f _REC_S1VAL_20_u1 95.625 _CNV_A_R_LINEAR_____23_CM 0. 95.625 /end CHARACTERISTIC
/begin CHARACTERISTIC Cxx_knk_slow_fil_mv_iga "The ignition correction threshold, for the output and the input of the torque correction" VALUE 0xa0022060 _REC_S1VAL_20_u1 95.625 _CNV_A_R_LINEAR_____23_CM 0. 95.625 /end CHARACTERISTIC
/begin CHARACTERISTIC Cxx_knk_slow_iga_efy "The ignition efficiency threshold, for the output and the input of the torque correction" VALUE 0xa0022050 _REC_S1VAL_20_u2 1. _CNV_A_R_LINEAR_____183_CM 0. 1. FORMAT "%11.9" /end CHARACTERISTIC
/begin CHARACTERISTIC Cxx_knk_slow_iga_efy_hys "Hysteresis on the ignition efficiency threshold, for the output and the input of the torque correction" VALUE 0xa0022061 _REC_S1VAL_20_u1 95.625 _CNV_A_R_LINEAR_____23_CM 0. 95.625 /end CHARACTERISTIC
/begin CHARACTERISTIC Cxx_knk_tq_cor_dec_dly "Temporal step to decrease of one the step of relative torque in knock zone" VALUE 0xa0022052 _REC_S1VAL_20_u2 655.35 _CNV_A_R_LINEAR_____32_CM 0. 655.35 FORMAT "%6.2" /end CHARACTERISTIC
/begin CHARACTERISTIC Cxx_knk_tq_cor_dec_fac "Gain of torque decrease step in function of the slow open loop (KSC)" VALUE 0xa0022054 _REC_S1VAL_20_u2 1. _CNV_A_R_LINEAR_____333_CM 0. 1. FORMAT "%11.9" /end CHARACTERISTIC
/begin CHARACTERISTIC Cxx_knk_tq_cor_dec_ofs "The step decrease threshold of relative torque" VALUE 0xa0022056 _REC_S1VAL_20_u2 1. _CNV_A_R_LINEAR_____183_CM 0. 1. FORMAT "%11.9" /end CHARACTERISTIC
/begin CHARACTERISTIC Cxx_knk_tq_cor_inc_dly "Temporal step to increase of one the step of relative torque in knock zone" VALUE 0xa0022058 _REC_S1VAL_20_u2 655.35 _CNV_A_R_LINEAR_____32_CM 0. 655.35 FORMAT "%6.2" /end CHARACTERISTIC
/begin CHARACTERISTIC Cxx_knk_tq_cor_inc_fac "Gain of torque increase step in function of the slow open loop (KSC)" VALUE 0xa002205a _REC_S1VAL_20_u2 1. _CNV_A_R_LINEAR_____333_CM 0. 1. FORMAT "%11.9" /end CHARACTERISTIC
/begin CHARACTERISTIC Cxx_knk_tq_cor_inc_ofs "The step increase threshold of relative torque" VALUE 0xa002205c _REC_S1VAL_20_u2 1. _CNV_A_R_LINEAR_____183_CM 0. 1. FORMAT "%11.9" /end CHARACTERISTIC
/begin MEASUREMENT Vbx_wg_abst_pres_cfm "Fixed nozzle turbine with wastegate present" UBYTE _CNV_S_2_RANGE______3_CM 1 0. 0. 1. ECU_ADDRESS 0xd0007cef BIT_MASK 0x1 /end MEASUREMENT
/begin CHARACTERISTIC Cbx_wg_abst_pres_cho_cfm "Fixed nozzle turbine with wastegate choice present or absent" VALUE 0xa002207a _REC_S1VAL_20_u1 1. _CNV_A_R_ECME_LINEA_0_CM 0. 1. FORMAT "%1.0" BIT_MASK 0x1 /end CHARACTERISTIC
/begin AXIS_PTS Ctb_rmb_ctr "Rumble counter Breakpoint for anti-rumble strategy" 0xa0036d60 Vxx_rmb_ctr _REC_A2AXS_20_u2 100. _CNV_A_R_LINEAR_____334_CM 6 0. 100. FORMAT "%8.4" /end AXIS_PTS
/begin AXIS_PTS Ctb_rmb_fil_iga_efy "Filtered final efficiency Breakpoint for anti-rumble strategy" 0xa0036d70 Vxx_rmb_fil_iga_efy _REC_A2AXS_20_u2 1. _CNV_A_R_LINEAR_____183_CM 6 0. 1. FORMAT "%11.9" /end AXIS_PTS
/begin AXIS_PTS Ctb_rmb_mat "Manifold air temp. Breakpoint for anti-rumble strategy" 0xa0036d80 Vxx_mat _REC_A2AXS_20_u2 240. _CNV_A_R_LINEAR_____110_CM 6 -40. 200. FORMAT "%5.1" /end AXIS_PTS
/begin AXIS_PTS Ctb_rmb_n_mv "Engine speed Breakpoint for anti-rumble strategy" 0xa0036d90 Vxx_n_mv _REC_A2AXS_20_u2 16383.75 _CNV_A_R_ENSD_LINEA_22_CM 6 0. 16383.75 FORMAT "%8.2" /end AXIS_PTS
/begin AXIS_PTS Ctb_rmb_tco "Coolant temp. Breakpoint for anti-rumble strategy" 0xa0036da0 Vxx_tco _REC_A2AXS_20_u2 240. _CNV_A_R_LINEAR_____110_CM 6 -40. 200. FORMAT "%5.1" /end AXIS_PTS
/begin CHARACTERISTIC Ctp_rmb_ctr_tq_cor "Rumble relative torque correction dependant on rumble counter" CURVE 0xa0036db0 _REC_A1CUR_20_u2_u2 30. _CNV_A_R_LINEAR_____183_CM 0. 30. FORMAT "%7.4"
 /begin AXIS_DESCR COM_AXIS Vxx_rmb_ctr _CNV_A_R_LINEAR_____334_CM 6 0. 100. FORMAT "%8.4" AXIS_PTS_REF Ctb_rmb_ctr /end AXIS_DESCR
/end CHARACTERISTIC
/begin CHARACTERISTIC Ctp_rmb_iga_efy_inc_prop_fac "Ignition efficiency dependant correction for rumble strategy prop. factor" CURVE 0xa0022062 _REC_A1CUR_20_u1_u2 1.992187 _CNV_A_R_LINEAR_____335_CM 0. 1.992187 FORMAT "%6.4"
 /begin AXIS_DESCR COM_AXIS Vxx_rmb_fil_iga_efy _CNV_A_R_LINEAR_____183_CM 6 0. 1. FORMAT "%11.9" AXIS_PTS_REF Ctb_rmb_fil_iga_efy /end AXIS_DESCR
/end CHARACTERISTIC
/begin CHARACTERISTIC Ctp_rmb_mat_inc_prop_fac "Manifold air dependant correction for rumble strategy prop. factor" CURVE 0xa0022068 _REC_A1CUR_20_u1_u2 1.992187 _CNV_A_R_LINEAR_____335_CM 0. 1.992187 FORMAT "%6.4"
 /begin AXIS_DESCR COM_AXIS Vxx_mat _CNV_A_R_LINEAR_____110_CM 6 -40. 200. FORMAT "%5.1" AXIS_PTS_REF Ctb_rmb_mat /end AXIS_DESCR
/end CHARACTERISTIC
/begin CHARACTERISTIC Ctp_rmb_n_mv_eal_lim "EAL threshold defining Rumble critical zone - dependant on filtered engine speed" CURVE 0xa0036dbc _REC_A1CUR_20_u2_u2 3.99993896484375 _CNV_A_R_LINEAR_____53_CM 0. 3.99993896484375 FORMAT "%7.5"
 /begin AXIS_DESCR COM_AXIS Vxx_n_mv _CNV_A_R_ENSD_LINEA_22_CM 6 0. 16383.75 FORMAT "%8.2" AXIS_PTS_REF Ctb_rmb_n_mv /end AXIS_DESCR
/end CHARACTERISTIC
/begin CHARACTERISTIC Ctp_rmb_n_tq_cor_max "Maximum rumble relative torque correction dependant on engine speed" CURVE 0xa0036dc8 _REC_A1CUR_20_u2_u2 1. _CNV_A_R_LINEAR_____183_CM 0. 1. FORMAT "%11.9"
 /begin AXIS_DESCR COM_AXIS Vxx_n_mv _CNV_A_R_ENSD_LINEA_22_CM 6 0. 16383.75 FORMAT "%8.2" AXIS_PTS_REF Ctb_rmb_n_mv /end AXIS_DESCR
/end CHARACTERISTIC
/begin CHARACTERISTIC Ctp_rmb_tco_inc_prop_fac "Coolant temp. dependant correction for rumble strategy prop. factor" CURVE 0xa002206e _REC_A1CUR_20_u1_u2 1.992187 _CNV_A_R_LINEAR_____335_CM 0. 1.992187 FORMAT "%6.4"
 /begin AXIS_DESCR COM_AXIS Vxx_tco _CNV_A_R_LINEAR_____110_CM 6 -40. 200. FORMAT "%5.1" AXIS_PTS_REF Ctb_rmb_tco /end AXIS_DESCR
/end CHARACTERISTIC
/begin MEASUREMENT Vxx_rmb_ctr "Rumble counter defining torque correction" UWORD _CNV_A_R_LINEAR_____334_CM 1 0. 0. 100. ECU_ADDRESS 0xd0004ba4 FORMAT "%8.4" /end MEASUREMENT
/begin MEASUREMENT Vxx_rmb_ctr_dif "Rumble counter increment (or decrement)" UWORD _CNV_A_R_LINEAR_____336_CM 1 0. -50. 50. ECU_ADDRESS 0xd0004ba6 FORMAT "%8.4" /end MEASUREMENT
/begin MEASUREMENT Vxx_rmb_eal_rel "Relative difference between slow torque demand and rumble zone torque threshold" UWORD _CNV_A_R_LINEAR_____337_CM 1 0. -8. 8. ECU_ADDRESS 0xd0004ba8 FORMAT "%8.5" /end MEASUREMENT
/begin MEASUREMENT Vxx_rmb_fil_eal "Filtered engine air load for anti-rumble strategy" UWORD _CNV_A_R_LINEAR_____53_CM 1 0. 0. 3.99993896484375 ECU_ADDRESS 0xd0004baa FORMAT "%7.5" /end MEASUREMENT
/begin MEASUREMENT Vxx_rmb_fil_iga_efy "Filtered final efficiency calculated by torque structure for anti-rumble strategy" UWORD _CNV_A_R_LINEAR_____183_CM 1 0. 0. 1. ECU_ADDRESS 0xd0004bac FORMAT "%11.9" /end MEASUREMENT
/begin MEASUREMENT Vxx_rmb_rel_tq_appl_cor "The applied relative torque correction for the load in rumble zone" UWORD _CNV_A_R_LINEAR_____183_CM 1 0. 0. 1. ECU_ADDRESS 0xd0004bae FORMAT "%11.9" /end MEASUREMENT
/begin CHARACTERISTIC Cxx_rmb_dec_prop "Proportionnal factor to decrease rumble counter" VALUE 0xa0022074 _REC_S1VAL_20_u2 32. _CNV_A_R_LINEAR_____183_CM 0. 32. FORMAT "%8.6" /end CHARACTERISTIC
/begin CHARACTERISTIC Cxx_rmb_eal_ftc "EAL filtering factor for anti-rumble strategy" VALUE 0xa0022078 _REC_S1VAL_20_u1 25.5 _CNV_A_R_LINEAR_____58_CM 0. 25.5 FORMAT "%4.1" /end CHARACTERISTIC
/begin CHARACTERISTIC Cxx_rmb_iga_efy_ftc "Filtering factor of ignition efficiency for rumble strategy" VALUE 0xa0022079 _REC_S1VAL_20_u1 25.5 _CNV_A_R_LINEAR_____58_CM 0. 25.5 FORMAT "%4.1" /end CHARACTERISTIC
/begin CHARACTERISTIC Cxx_rmb_inc_prop "Proportionnal factor to increase rumble counter" VALUE 0xa0022076 _REC_S1VAL_20_u2 32. _CNV_A_R_LINEAR_____183_CM 0. 32. FORMAT "%8.6" /end CHARACTERISTIC
/begin MEASUREMENT Vbx_igk "Ignition key signal" UBYTE _CNV_S_2_RANGE______3_CM 1 0. 0. 1. ECU_ADDRESS 0xd0006d87 BIT_MASK 0x1 /end MEASUREMENT
/begin MEASUREMENT Vbx_vh_key "Data indicating if the key vehicle is present (1=vehicle with key)" UBYTE _CNV_S_2_RANGE______3_CM 1 0. 0. 1. ECU_ADDRESS 0xd0006d88 BIT_MASK 0x1 /end MEASUREMENT
/begin MEASUREMENT Vsx_ena_sta_agb "AT Starter authorization or stop" UBYTE _CNV_A_R_ECME_LINEA_0_CM 1 0. 0. 255. ECU_ADDRESS 0xd0006d89 FORMAT "%3.0" /end MEASUREMENT
/begin MEASUREMENT Vsx_ena_sta_agb_vld "AT Starter authorization or stop validity status" UBYTE _CNV_S_4_STATUS_OK__338_CM 1 0. 0. 3. ECU_ADDRESS 0xd0006d8a /end MEASUREMENT
/begin MEASUREMENT Vsx_sta_stt_vld "Starter status validity status" UBYTE _CNV_S_4_STATUS_OK__338_CM 1 0. 0. 3. ECU_ADDRESS 0xd0006d8b /end MEASUREMENT
/begin MEASUREMENT Vxx_sta_stt "Starter status" UBYTE _CNV_A_R_ECME_LINEA_0_CM 1 0. 0. 3. ECU_ADDRESS 0xd0006d8c FORMAT "%1.0" /end MEASUREMENT
/begin AXIS_PTS Ctb_eng_amp "atmospheric pressure breakpoint of full load torque limitation." 0xa00357a8 Vxx_amp _REC_A2AXS_20_u2 20000. _CNV_A_R_LINEAR_____115_CM 6 0. 20000. FORMAT "%5.0" /end AXIS_PTS
/begin CHARACTERISTIC Cmp_amp_n_max_tqi_cor "Map of corrector coefficients (function of vacuum pressure and engine speed) working on the max IET." MAP 0xa00357b8 _REC_A1MAP_20_u1_u2_u2 0.99609375 _CNV_A_R_LINEAR_____339_CM 0.5 1.49609375 FORMAT "%10.8"
 /begin AXIS_DESCR COM_AXIS Vxx_amp _CNV_A_R_LINEAR_____115_CM 6 0. 20000. FORMAT "%5.0" AXIS_PTS_REF Ctb_eng_amp /end AXIS_DESCR
 /begin AXIS_DESCR COM_AXIS Vxx_n _CNV_A_R_ENSD_LINEA_22_CM 9 0. 16383.75 FORMAT "%8.2" AXIS_PTS_REF Ctb_n2 /end AXIS_DESCR
/end CHARACTERISTIC
/begin CHARACTERISTIC Cmp_mat_n_max_tqi_cor "Map of corrector coefficients (function of manifold air temperature and engine speed) for maximum torque" MAP 0xa00357f0 _REC_A1MAP_20_u1_u2_u2 0.99609375 _CNV_A_R_LINEAR_____339_CM 0.5 1.49609375 FORMAT "%10.8"
 /begin AXIS_DESCR COM_AXIS NO_INPUT_QUANTITY _CNV_A_R_LINEAR_____110_CM 9 -40. 200. FORMAT "%5.1" AXIS_PTS_REF Ctb_mat2 /end AXIS_DESCR
 /begin AXIS_DESCR COM_AXIS Vxx_n _CNV_A_R_ENSD_LINEA_22_CM 9 0. 16383.75 FORMAT "%8.2" AXIS_PTS_REF Ctb_n2 /end AXIS_DESCR
/end CHARACTERISTIC
/begin CHARACTERISTIC Ctp_n_gear_tqe_max_h "Corrector coefficient table for Max indicated engine torque in function of air temperature" CURVE 0xa0035844 _REC_A1CUR_20_u2_u2 2047.96875 _CNV_A_R_LINEAR_____216_CM -400. 1647.96875 FORMAT "%11.5"
 /begin AXIS_DESCR COM_AXIS Vxx_n _CNV_A_R_ENSD_LINEA_22_CM 20 0. 16383.75 FORMAT "%8.2" AXIS_PTS_REF Ctb_n /end AXIS_DESCR
/end CHARACTERISTIC
/begin CHARACTERISTIC Ctp_n_gear_tqe_max_l "Maximum effective torque for the low ratio" CURVE 0xa003586c _REC_A1CUR_20_u2_u2 2047.96875 _CNV_A_R_LINEAR_____216_CM -400. 1647.96875 FORMAT "%11.5"
 /begin AXIS_DESCR COM_AXIS Vxx_n _CNV_A_R_ENSD_LINEA_22_CM 20 0. 16383.75 FORMAT "%8.2" AXIS_PTS_REF Ctb_n /end AXIS_DESCR
/end CHARACTERISTIC
/begin CHARACTERISTIC Ctp_n_max_tq_rs "Maximum effective (or indicated) torque for Renault Sport Application, if Sport mode isn't activated" CURVE 0xa0035894 _REC_A1CUR_20_u2_u2 2047.96875 _CNV_A_R_LINEAR_____216_CM -400. 1647.96875 FORMAT "%11.5"
 /begin AXIS_DESCR COM_AXIS Vxx_n _CNV_A_R_ENSD_LINEA_22_CM 20 0. 16383.75 FORMAT "%8.2" AXIS_PTS_REF Ctb_n /end AXIS_DESCR
/end CHARACTERISTIC
/begin CHARACTERISTIC Ctp_n_max_tqi "Maximum HP Indicated mean torque in function of engine speed, under maximum supercharging pressure." CURVE 0xa00358bc _REC_A1CUR_20_u2_u2 2047.96875 _CNV_A_R_LINEAR_____181_CM 0. 2047.96875 FORMAT "%10.5"
 /begin AXIS_DESCR COM_AXIS Vxx_n _CNV_A_R_ENSD_LINEA_22_CM 20 0. 16383.75 FORMAT "%8.2" AXIS_PTS_REF Ctb_n /end AXIS_DESCR
/end CHARACTERISTIC
/begin CHARACTERISTIC Ctp_n_max_tqi_lih "Max HP Indicated mean torque in function of engine speed, with limp home position for the throttle" CURVE 0xa00358e4 _REC_A1CUR_20_u2_u2 2047.96875 _CNV_A_R_LINEAR_____181_CM 0. 2047.96875 FORMAT "%10.5"
 /begin AXIS_DESCR COM_AXIS Vxx_n _CNV_A_R_ENSD_LINEA_22_CM 20 0. 16383.75 FORMAT "%8.2" AXIS_PTS_REF Ctb_n /end AXIS_DESCR
/end CHARACTERISTIC
/begin CHARACTERISTIC Ctp_n_tqi_dyn_lim "Every 20ms torque increment enable Max Indic Engine Torque to limit its temporal dynamic." CURVE 0xa003590c _REC_A1CUR_20_u1_u2 255. _CNV_A_R_LINEAR_____293_CM 0. 255. FORMAT "%3.0"
 /begin AXIS_DESCR COM_AXIS Vxx_n _CNV_A_R_ENSD_LINEA_22_CM 9 0. 16383.75 FORMAT "%8.2" AXIS_PTS_REF Ctb_n2 /end AXIS_DESCR
/end CHARACTERISTIC
/begin MEASUREMENT Vxx_max_avl_tqe "Maximum effective engine torque at current engine speed." UWORD _CNV_A_R_LINEAR_____216_CM 1 0. -400. 1647.96875 ECU_ADDRESS 0xd00049d2 FORMAT "%10.5" /end MEASUREMENT
/begin MEASUREMENT Vxx_max_dyn_avl_tqe "Maximum available torque with dynamic limitation" UWORD _CNV_A_R_LINEAR_____216_CM 1 0. -400. 1647.96875 ECU_ADDRESS 0xd00049d4 FORMAT "%10.5" /end MEASUREMENT
/begin MEASUREMENT Vxx_max_gear_avl_tqe "Maximal effective engine torque according to the gearbox ratio" UWORD _CNV_A_R_LINEAR_____216_CM 1 0. -400. 1647.96875 ECU_ADDRESS 0xd00049d6 FORMAT "%10.5" /end MEASUREMENT
/begin MEASUREMENT Vxx_max_tq_dyn_mod_req "Sport mode request for the transition of RS maximum effective torque" UWORD _CNV_A_R_LINEAR_____149_CM 1 0. 0. 1. ECU_ADDRESS 0xd00049d8 FORMAT "%11.9" /end MEASUREMENT
/begin MEASUREMENT Vxx_max_tqi "Maximum (HP) Indicated engine torque available at current engine speed." UWORD _CNV_A_R_LINEAR_____181_CM 1 0. 0. 2047.96875 ECU_ADDRESS 0xd00049da FORMAT "%10.5" /end MEASUREMENT
/begin MEASUREMENT Vxx_max_tqi_alti_mat_cor "Maximum HP indicated engine torque corrected with altitude and air temperature functions." UWORD _CNV_A_R_LINEAR_____181_CM 1 0. 0. 2047.96875 ECU_ADDRESS 0xd00049dc FORMAT "%10.5" /end MEASUREMENT
/begin MEASUREMENT Vxx_max_tqi_cor "Factor to correct the maximum torque according to the air temperature the atmospheric pressure and the driving regime" UWORD _CNV_A_R_LINEAR_____29_CM 1 0. 0.25 2.24609375 ECU_ADDRESS 0xd00049de FORMAT "%10.6" /end MEASUREMENT
/begin MEASUREMENT Vxx_max_tqi_inj_cut "Maximum HP indicated engine torque corrected with the number of available cylindres." UWORD _CNV_A_R_LINEAR_____181_CM 1 0. 0. 2047.96875 ECU_ADDRESS 0xd00049e0 FORMAT "%10.5" /end MEASUREMENT
/begin MEASUREMENT Vxx_raw_max_tqi "Maximum HP indicated engine torque corrected with the number of available cylindres." UWORD _CNV_A_R_LINEAR_____181_CM 1 0. 0. 2047.96875 ECU_ADDRESS 0xd00049e2 FORMAT "%10.5" /end MEASUREMENT
/begin MEASUREMENT Vxx_tot_max_avl_tqe "Maximum effective engine torque" UWORD _CNV_A_R_LINEAR_____216_CM 1 0. -400. 1647.96875 ECU_ADDRESS 0xd00049e4 FORMAT "%10.5" /end MEASUREMENT
/begin MEASUREMENT Vxx_tqe_max_gear "Maximum effective torque in function of the gearbox" UWORD _CNV_A_R_LINEAR_____216_CM 1 0. -400. 1647.96875 ECU_ADDRESS 0xd00049e6 FORMAT "%10.5" /end MEASUREMENT
/begin MEASUREMENT Vxx_tqe_max_rs "Maximum effective torque after the RS limitation" UWORD _CNV_A_R_LINEAR_____216_CM 1 0. -400. 1647.96875 ECU_ADDRESS 0xd00049e8 FORMAT "%10.5" /end MEASUREMENT
/begin CHARACTERISTIC Cbx_tq_max_rs_tqi_or_tqe "Flag to limit the RS maximum torque in TQE if boolean =0 or TQI if boolean =1" VALUE 0xa0021ee6 _REC_S1VAL_20_u1 1. _CNV_A_R_ECME_LINEA_0_CM 0. 1. FORMAT "%1.0" BIT_MASK 0x1 /end CHARACTERISTIC
/begin CHARACTERISTIC Cxx_gear_max_tqe_h "Limit between the high ratio and the low ratio" VALUE 0xa0021ee7 _REC_S1VAL_20_u1 7. _CNV_A_R_LINEAR_____145_CM -1. 6. FORMAT "%2.0" /end CHARACTERISTIC
/begin CHARACTERISTIC Cxx_tq_max_rs_slop_neg "Negative slope during the transition of RS maximum effective torque" VALUE 0xa0021ee2 _REC_S1VAL_20_u2 50. _CNV_A_R_LINEAR_____340_CM -50. 0. FORMAT "%14.10" /end CHARACTERISTIC
/begin CHARACTERISTIC Cxx_tq_max_rs_slop_pos "Positive slope during the transition of RS maximum effective torque" VALUE 0xa0021ee4 _REC_S1VAL_20_u2 50. _CNV_A_R_LINEAR_____341_CM 0. 50. FORMAT "%13.10" /end CHARACTERISTIC
/begin CHARACTERISTIC Cxx_tqe_max_gear_slop_neg "Negative slope during the transmission sift" VALUE 0xa0021ee8 _REC_S1VAL_20_u1 255. _CNV_A_R_LINEAR_____292_CM -255. 0. FORMAT "%4.0" /end CHARACTERISTIC
/begin CHARACTERISTIC Cxx_tqe_max_gear_slop_pos "Positive slope during the transmission sift" VALUE 0xa0021ee9 _REC_S1VAL_20_u1 255. _CNV_A_R_LINEAR_____293_CM 0. 255. FORMAT "%3.0" /end CHARACTERISTIC
/begin AXIS_PTS Ctb_n_gb_clu_tq_lim "10 programmable engine speed breakpoints map" 0xa00356f0 Vxx_n _REC_A2AXS_20_u2 16383.75 _CNV_A_R_ENSD_LINEA_22_CM 10 0. 16383.75 FORMAT "%8.2" /end AXIS_PTS
/begin CHARACTERISTIC Cmp_n_gear_gb_clu_lim_tq "gearbox and clutch torque limitation" MAP 0xa0035708 _REC_A1MAP_20_u2_u2_u1 2047.96875 _CNV_A_R_LINEAR_____216_CM -400. 1647.96875 FORMAT "%10.5"
 /begin AXIS_DESCR COM_AXIS Vxx_n _CNV_A_R_ENSD_LINEA_22_CM 10 0. 16383.75 FORMAT "%8.2" AXIS_PTS_REF Ctb_n_gb_clu_tq_lim /end AXIS_DESCR
 /begin AXIS_DESCR COM_AXIS Vxx_gear _CNV_A_R_LINEAR_____145_CM 8 -1. 6. READ_ONLY FORMAT "%2.0" AXIS_PTS_REF Ntb_gear /end AXIS_DESCR
/end CHARACTERISTIC
/begin MEASUREMENT Vxx_max_agb_tqe "Maximum automatic gearbox torque." UWORD _CNV_A_R_LINEAR_____216_CM 1 0. -400. 1647.96875 ECU_ADDRESS 0xd0006088 FORMAT "%10.5" /end MEASUREMENT
/begin MEASUREMENT Vxx_max_gbx_tqe "Maximum torque to project gearbox from mechanical overload." UWORD _CNV_A_R_LINEAR_____216_CM 1 0. -400. 1647.96875 ECU_ADDRESS 0xd000608a FORMAT "%10.5" /end MEASUREMENT
/begin MEASUREMENT Vxx_max_mgb_tqe "Maximum gearbox available torque for mgb gearbox depending." UWORD _CNV_A_R_LINEAR_____216_CM 1 0. -400. 1647.96875 ECU_ADDRESS 0xd000608c FORMAT "%10.5" /end MEASUREMENT
/begin CHARACTERISTIC Cxx_gear_dft_lim_tq "Maximum torque to protect gearbox (default mode)" VALUE 0xa0021ee0 _REC_S1VAL_20_u2 2047.96875 _CNV_A_R_LINEAR_____216_CM -400. 1647.96875 FORMAT "%10.5" /end CHARACTERISTIC
/begin AXIS_PTS Ctb_ovh_n "engine speed breakpoints map for over heating" 0xa0035940 Vxx_n_mv _REC_A2AXS_20_u2 16383.75 _CNV_A_R_ENSD_LINEA_22_CM 5 0. 16383.75 FORMAT "%8.2" /end AXIS_PTS
/begin AXIS_PTS Ctb_ovh_tco "Coolant temperature breakpoints map for over heating" 0xa003594c Vxx_tco _REC_A2AXS_20_u2 240. _CNV_A_R_LINEAR_____110_CM 6 -40. 200. FORMAT "%5.1" /end AXIS_PTS
/begin AXIS_PTS Ctb_ovh_toil "Oil temperature breakpoints map for over heating" 0xa003595c Vxx_toil _REC_A2AXS_20_u2 240. _CNV_A_R_LINEAR_____110_CM 6 -40. 200. FORMAT "%5.1" /end AXIS_PTS
/begin AXIS_PTS Ctb_ovh_up_it_temp "Manifold air temperature breakpoints map for over heating" 0xa003596c Vxx_up_it_temp _REC_A2AXS_20_u2 240. _CNV_A_R_LINEAR_____110_CM 6 -40. 200. FORMAT "%5.1" /end AXIS_PTS
/begin AXIS_PTS Ctb_ovh_vs "Vehicle speed breakpoints map for over heating" 0xa0021efc Vxx_vs _REC_A2AXS_20_u1 255. _CNV_A_R_LINEAR_____71_CM 5 0. 255. FORMAT "%3.0" /end AXIS_PTS
/begin CHARACTERISTIC Cmp_n_vs_ovh_tq_fac "overheat protection factor versus vehicle speed and engine speed" MAP 0xa003597c _REC_A1MAP_20_u2_u2_u1 0.99609375 _CNV_A_R_LINEAR_____29_CM 3.90625e-003 1. FORMAT "%10.8"
 /begin AXIS_DESCR COM_AXIS Vxx_n_mv _CNV_A_R_ENSD_LINEA_22_CM 5 0. 16383.75 FORMAT "%8.2" AXIS_PTS_REF Ctb_ovh_n /end AXIS_DESCR
 /begin AXIS_DESCR COM_AXIS Vxx_vs _CNV_A_R_LINEAR_____71_CM 5 0. 255. FORMAT "%3.0" AXIS_PTS_REF Ctb_ovh_vs /end AXIS_DESCR
/end CHARACTERISTIC
/begin CHARACTERISTIC Ctp_n_ovh_tq_fac "overheat protection factor versus engine speed" CURVE 0xa00359b0 _REC_A1CUR_20_u2_u2 0.99609375 _CNV_A_R_LINEAR_____342_CM 3.90625e-003 1. FORMAT "%10.8"
 /begin AXIS_DESCR COM_AXIS Vxx_n_mv _CNV_A_R_ENSD_LINEA_22_CM 5 0. 16383.75 FORMAT "%8.2" AXIS_PTS_REF Ctb_ovh_n /end AXIS_DESCR
/end CHARACTERISTIC
/begin CHARACTERISTIC Ctp_tco_ovh_tq "torque offset for overheat protection versus coolant temperature" CURVE 0xa00359bc _REC_A1CUR_20_u2_u2 2047.96875 _CNV_A_R_LINEAR_____185_CM -1024. 1023.96875 FORMAT "%11.5"
 /begin AXIS_DESCR COM_AXIS Vxx_tco _CNV_A_R_LINEAR_____110_CM 6 -40. 200. FORMAT "%5.1" AXIS_PTS_REF Ctb_ovh_tco /end AXIS_DESCR
/end CHARACTERISTIC
/begin CHARACTERISTIC Ctp_temp_ovh_tq "torque offset for overheat protection versus air or oil temperature" CURVE 0xa00359c8 _REC_A1CUR_20_u2_u2 2047.96875 _CNV_A_R_LINEAR_____185_CM -1024. 1023.96875 FORMAT "%11.5"
 /begin AXIS_DESCR COM_AXIS Vxx_toil _CNV_A_R_LINEAR_____110_CM 6 -40. 200. FORMAT "%5.1" AXIS_PTS_REF Ctb_ovh_toil /end AXIS_DESCR
/end CHARACTERISTIC
/begin MEASUREMENT Vxx_ovh_prot_tq "Maximum indicated torque for overheat protection" SWORD _CNV_A_R_LINEAR_____181_CM 1 0. -1024. 1023.96875 ECU_ADDRESS 0xd0006092 FORMAT "%11.5" /end MEASUREMENT
/begin CHARACTERISTIC Cbx_ovh_temp_cfm "air or oil temperature for over heating protection" VALUE 0xa0021f02 _REC_S1VAL_20_u1 1. _CNV_S_2_RANGE______3_CM 0. 1. BIT_MASK 0x1 /end CHARACTERISTIC
/begin AXIS_PTS Ctb_tco_lim_tqi "Coolant temperature breakpoints for the maximum Pcyl" 0xa00359d4 Vxx_tco _REC_A2AXS_20_u2 240. _CNV_A_R_LINEAR_____110_CM 6 -40. 200. FORMAT "%5.1" /end AXIS_PTS
/begin CHARACTERISTIC Cmp_n_tco_lim_tqi "Maximum HP indicated mean torque in function of engine speed and coolant temperature to respect the CdC Pcyl." MAP 0xa00359e4 _REC_A1MAP_20_u2_u2_u2 2047.96875 _CNV_A_R_LINEAR_____181_CM 0. 2047.96875 FORMAT "%10.5"
 /begin AXIS_DESCR COM_AXIS Vxx_n _CNV_A_R_ENSD_LINEA_22_CM 20 0. 16383.75 FORMAT "%8.2" AXIS_PTS_REF Ctb_n /end AXIS_DESCR
 /begin AXIS_DESCR COM_AXIS Vxx_tco _CNV_A_R_LINEAR_____110_CM 6 -40. 200. FORMAT "%5.1" AXIS_PTS_REF Ctb_tco_lim_tqi /end AXIS_DESCR
/end CHARACTERISTIC
/begin CHARACTERISTIC Ctp_n_min_gas_lim_tq "Torque limitation value when gas tank is empty." CURVE 0xa0035ad4 _REC_A1CUR_20_u2_u2 2047.96875 _CNV_A_R_LINEAR_____216_CM -400. 1647.96875 FORMAT "%10.5"
 /begin AXIS_DESCR COM_AXIS Vxx_n _CNV_A_R_ENSD_LINEA_22_CM 9 0. 16383.75 FORMAT "%8.2" AXIS_PTS_REF Ctb_n2 /end AXIS_DESCR
/end CHARACTERISTIC
/begin MEASUREMENT Vxx_max_prot_tqe "Maximum effective engine torque for engine protection." UWORD _CNV_A_R_LINEAR_____216_CM 1 0. -400. 1647.96875 ECU_ADDRESS 0xd0006096 FORMAT "%10.5" /end MEASUREMENT
/begin MEASUREMENT Vxx_min_fuel "Minimum fuel level for torque protection" UWORD _CNV_A_R_LINEAR_____183_CM 1 0. 0. 1. ECU_ADDRESS 0xd0006098 FORMAT "%11.9" /end MEASUREMENT
/begin CHARACTERISTIC Cxx_min_gas_dec "value of negative gradient in case of torque limitation when the gas tank is empty" VALUE 0xa0021f04 _REC_S1VAL_20_u2 7.96875 _CNV_A_R_LINEAR_____343_CM -8. -3.125e-002 FORMAT "%11.5" /end CHARACTERISTIC
/begin CHARACTERISTIC Cxx_min_gas_inc "value of positive gradient in case of torque limitation when the gas tank is empty" VALUE 0xa0021f06 _REC_S1VAL_20_u2 7.96875 _CNV_A_R_LINEAR_____344_CM 3.125e-002 8. FORMAT "%10.5" /end CHARACTERISTIC
/begin MEASUREMENT Vxx_max_pow_tqe "Limitation effective torque for power " UWORD _CNV_A_R_LINEAR_____216_CM 1 0. -400. 1647.96875 ECU_ADDRESS 0xd0004a0a FORMAT "%10.5" /end MEASUREMENT
/begin MEASUREMENT Vxx_max_stat_avl_tqe "Maximum absolute effective torque" UWORD _CNV_A_R_LINEAR_____216_CM 1 0. -400. 1647.96875 ECU_ADDRESS 0xd0004a0c FORMAT "%10.5" /end MEASUREMENT
/begin CHARACTERISTIC Cxx_max_pow_gear "maximum power for power limitation." VALUE 0xa0021f08 _REC_S1VAL_20_u2 655350. _CNV_A_R_LINEAR_____186_CM 0. 655350. FORMAT "%6.0" /end CHARACTERISTIC
/begin AXIS_PTS Ctb_max_rams_tqe_3 "Breakpoints for the safety vehicle speed limitation converted in torque limitation level 3 (strong)" 0xa0035ae8 Vxx_vs _REC_A2AXS_20_u1 255. _CNV_A_R_LINEAR_____71_CM 12 0. 255. FORMAT "%3.0" /end AXIS_PTS
/begin AXIS_PTS Ctb_max_rams_tqi_1 "Breakpoints for the safety torque limitation level 1 (low)" 0xa0035af8 Vxx_n_mv _REC_A2AXS_20_u2 16383.75 _CNV_A_R_ENSD_LINEA_22_CM 12 0. 16383.75 FORMAT "%8.2" /end AXIS_PTS
/begin AXIS_PTS Ctb_max_rams_tqi_2 "Breakpoints for the safety torque limitation level 2 (mean)" 0xa0035b14 Vxx_n_mv _REC_A2AXS_20_u2 16383.75 _CNV_A_R_ENSD_LINEA_22_CM 12 0. 16383.75 FORMAT "%8.2" /end AXIS_PTS
/begin CHARACTERISTIC Ctp_max_rams_tqe_3 "Level 3 (strong) maximum effective torque allowed function of the vehicle speed" CURVE 0xa0035b30 _REC_A1CUR_20_u2_u1 2047.96875 _CNV_A_R_LINEAR_____216_CM -400. 1647.96875 FORMAT "%10.5"
 /begin AXIS_DESCR COM_AXIS Vxx_vs _CNV_A_R_LINEAR_____71_CM 12 0. 255. FORMAT "%3.0" AXIS_PTS_REF Ctb_max_rams_tqe_3 /end AXIS_DESCR
/end CHARACTERISTIC
/begin CHARACTERISTIC Ctp_max_rams_tqi_1 "Level 1 (low) maximum indicated torque allowed function of engine speed" CURVE 0xa0035b48 _REC_A1CUR_20_u2_u2 2047.96875 _CNV_A_R_LINEAR_____181_CM 0. 2047.96875 FORMAT "%10.5"
 /begin AXIS_DESCR COM_AXIS Vxx_n_mv _CNV_A_R_ENSD_LINEA_22_CM 12 0. 16383.75 FORMAT "%8.2" AXIS_PTS_REF Ctb_max_rams_tqi_1 /end AXIS_DESCR
/end CHARACTERISTIC
/begin CHARACTERISTIC Ctp_max_rams_tqi_2 "Level 2 (mean) maximum indicated torque allowed function of engine speed" CURVE 0xa0035b60 _REC_A1CUR_20_u2_u2 2047.96875 _CNV_A_R_LINEAR_____181_CM 0. 2047.96875 FORMAT "%10.5"
 /begin AXIS_DESCR COM_AXIS Vxx_n_mv _CNV_A_R_ENSD_LINEA_22_CM 12 0. 16383.75 FORMAT "%8.2" AXIS_PTS_REF Ctb_max_rams_tqi_2 /end AXIS_DESCR
/end CHARACTERISTIC
/begin MEASUREMENT Vbx_max_rams_tqe_1_on "Safety torque limitation level 1 activated" UBYTE _CNV_S_2_RANGE______3_CM 1 0. 0. 1. ECU_ADDRESS 0xd0007162 BIT_MASK 0x1 /end MEASUREMENT
/begin MEASUREMENT Vbx_max_rams_tqe_2_on "Safety torque limitation level 2 activated" UBYTE _CNV_S_2_RANGE______3_CM 1 0. 0. 1. ECU_ADDRESS 0xd0007163 BIT_MASK 0x1 /end MEASUREMENT
/begin MEASUREMENT Vbx_max_rams_tqe_3_on "Safety torque limitation level 3 activated" UBYTE _CNV_S_2_RANGE______3_CM 1 0. 0. 1. ECU_ADDRESS 0xd0007164 BIT_MASK 0x1 /end MEASUREMENT
/begin MEASUREMENT Vsx_tq_rams_lim_vld "Safety torque limitation validity status" UBYTE _CNV_S_2_STATUS_OK__241_CM 1 0. 0. 1. ECU_ADDRESS 0xd0007165 /end MEASUREMENT
/begin MEASUREMENT Vxx_lim_max_rams_tqe "Maximum torque allowed by the failsafe mode." UWORD _CNV_A_R_LINEAR_____216_CM 1 0. -400. 1647.96875 ECU_ADDRESS 0xd0004a0e FORMAT "%10.5" /end MEASUREMENT
/begin MEASUREMENT Vxx_max_rams_tqe_1 "Safety limited torque by level 1 limitation (low)" UWORD _CNV_A_R_LINEAR_____216_CM 1 0. -400. 1647.96875 ECU_ADDRESS 0xd0004a10 FORMAT "%10.5" /end MEASUREMENT
/begin MEASUREMENT Vxx_max_rams_tqe_2 "Safety limited torque by level 2 limitation (mean)" UWORD _CNV_A_R_LINEAR_____216_CM 1 0. -400. 1647.96875 ECU_ADDRESS 0xd0004a12 FORMAT "%10.5" /end MEASUREMENT
/begin MEASUREMENT Vxx_max_rams_tqe_3 "Safety limited vehicle speed converted in torque by level 3 limitation (strong)" UWORD _CNV_A_R_LINEAR_____216_CM 1 0. -400. 1647.96875 ECU_ADDRESS 0xd0004a14 FORMAT "%10.5" /end MEASUREMENT
/begin CHARACTERISTIC Cbx_tq_rams_lim_act_3_bch_cfm "Activation of safety vehicle speed limitation converted in torque limitation level 3 (strong) bench mode" VALUE 0xa0021f14 _REC_S1VAL_20_u1 1. _CNV_S_2_RANGE______3_CM 0. 1. BIT_MASK 0x1 /end CHARACTERISTIC
/begin CHARACTERISTIC Cxx_max_rams_tqe_1_slop "Slope to attend the safety torque limitation level 1 (low)" VALUE 0xa0021f0a _REC_S1VAL_20_u2 102398.4375 _CNV_A_R_LINEAR_____345_CM 0. 102398.4375 FORMAT "%11.4" /end CHARACTERISTIC
/begin CHARACTERISTIC Cxx_max_rams_tqe_2_slop "Slope to attend the safety torque limitation level 2 (mean)" VALUE 0xa0021f0c _REC_S1VAL_20_u2 102398.4375 _CNV_A_R_LINEAR_____345_CM 0. 102398.4375 FORMAT "%11.4" /end CHARACTERISTIC
/begin CHARACTERISTIC Cxx_max_rams_tqe_3_slop "Slope to attend the safety torque limitation level 3 (strong)" VALUE 0xa0021f0e _REC_S1VAL_20_u2 102398.4375 _CNV_A_R_LINEAR_____345_CM 0. 102398.4375 FORMAT "%11.4" /end CHARACTERISTIC
/begin CHARACTERISTIC Cxx_max_rams_tqe_3_srs "Safety limited torque level 3 (strong) if vehicle speed not valid" VALUE 0xa0021f10 _REC_S1VAL_20_u2 2047.96875 _CNV_A_R_LINEAR_____216_CM -400. 1647.96875 FORMAT "%10.5" /end CHARACTERISTIC
/begin CHARACTERISTIC Cxx_max_rams_tqe_sta_slop "Slope to attend the safety torque limitation level 1.2.3 during engine state isn't autonomous" VALUE 0xa0021f12 _REC_S1VAL_20_u2 102398.4375 _CNV_A_R_LINEAR_____345_CM 0. 102398.4375 FORMAT "%11.4" /end CHARACTERISTIC
/begin MEASUREMENT Vbx_tq_rams_lim_act_1 "Activation of safety torque limitation level 1 (low)" UBYTE _CNV_S_2_RANGE______3_CM 1 0. 0. 1. ECU_ADDRESS 0xd0007cbd BIT_MASK 0x1 /end MEASUREMENT
/begin MEASUREMENT Vbx_tq_rams_lim_act_2 "Activation of safety torque limitation level 2 (mean)" UBYTE _CNV_S_2_RANGE______3_CM 1 0. 0. 1. ECU_ADDRESS 0xd0007cbe BIT_MASK 0x1 /end MEASUREMENT
/begin MEASUREMENT Vbx_tq_rams_lim_act_3 "Activation of safety vehicle speed limitation converted in torque limitation level 3 (strong)" UBYTE _CNV_S_2_RANGE______3_CM 1 0. 0. 1. ECU_ADDRESS 0xd0007cbf BIT_MASK 0x1 /end MEASUREMENT
/begin CHARACTERISTIC Cxx_tq_lim_spg_reg_cfm "Activation of engine torque limitation by boost pressure regulation (0: no limitation, 1: limitation level 1, 2: limitation level 2)" VALUE 0xa0021edf _REC_S1VAL_20_u1 2. _CNV_A_R_ECME_LINEA_0_CM 0. 2. FORMAT "%1.0" /end CHARACTERISTIC
/begin MEASUREMENT Vbx_max_prot_spg_tqe_act "Maximum effective torque limitation for supercharger protection activated" UBYTE _CNV_S_2_RANGE______3_CM 1 0. 0. 1. ECU_ADDRESS 0xd0007cc1 BIT_MASK 0x1 /end MEASUREMENT
/begin MEASUREMENT Vxx_max_prot_spg_tqe "Maximum effective engine torque for supercharger protection" UWORD _CNV_A_R_LINEAR_____216_CM 1 0. -400. 1647.96875 ECU_ADDRESS 0xd0006094 FORMAT "%10.5" /end MEASUREMENT
/begin CHARACTERISTIC Cmp_amp_n_max_tqi_cor_alco "Map of corrector coefficients (function of vacuum pressure and engine speed) working on the max IET for flex-fuel" MAP 0xa0035594 _REC_A1MAP_20_u1_u2_u2 0.99609375 _CNV_A_R_LINEAR_____339_CM 0.5 1.49609375 FORMAT "%10.8"
 /begin AXIS_DESCR COM_AXIS Vxx_amp _CNV_A_R_LINEAR_____115_CM 6 0. 20000. FORMAT "%5.0" AXIS_PTS_REF Ctb_eng_amp /end AXIS_DESCR
 /begin AXIS_DESCR COM_AXIS Vxx_n _CNV_A_R_ENSD_LINEA_22_CM 9 0. 16383.75 FORMAT "%8.2" AXIS_PTS_REF Ctb_n2 /end AXIS_DESCR
/end CHARACTERISTIC
/begin CHARACTERISTIC Cmp_n_tco_lim_tqi_alco "Maximum HP Indicated mean torque in function of engine speed and coolant temperature to respect the CdC Pcyl, for flex-fuel" MAP 0xa00355cc _REC_A1MAP_20_u2_u2_u2 2047.96875 _CNV_A_R_LINEAR_____181_CM 0. 2047.96875 FORMAT "%10.5"
 /begin AXIS_DESCR COM_AXIS Vxx_n _CNV_A_R_ENSD_LINEA_22_CM 20 0. 16383.75 FORMAT "%8.2" AXIS_PTS_REF Ctb_n /end AXIS_DESCR
 /begin AXIS_DESCR COM_AXIS Vxx_tco _CNV_A_R_LINEAR_____110_CM 6 -40. 200. FORMAT "%5.1" AXIS_PTS_REF Ctb_tco_lim_tqi /end AXIS_DESCR
/end CHARACTERISTIC
/begin CHARACTERISTIC Ctp_mat_max_tqi_cor_alco "Corrector coefficient table for Max indicated engine torque in function of air temperature for flex-fuel" CURVE 0xa00356bc _REC_A1CUR_20_u1_u2 0.99609375 _CNV_A_R_LINEAR_____339_CM 0.5 1.49609375 FORMAT "%10.8"
 /begin AXIS_DESCR COM_AXIS NO_INPUT_QUANTITY _CNV_A_R_LINEAR_____110_CM 9 -40. 200. FORMAT "%5.1" AXIS_PTS_REF Ctb_mat2 /end AXIS_DESCR
/end CHARACTERISTIC
/begin CHARACTERISTIC Ctp_n_max_tqi_alco "Maximum HP Indicated mean torque in function of engine speed, under maximum supercharging pressure for flex-fuel" CURVE 0xa00356c8 _REC_A1CUR_20_u2_u2 2047.96875 _CNV_A_R_LINEAR_____181_CM 0. 2047.96875 FORMAT "%10.5"
 /begin AXIS_DESCR COM_AXIS Vxx_n _CNV_A_R_ENSD_LINEA_22_CM 20 0. 16383.75 FORMAT "%8.2" AXIS_PTS_REF Ctb_n /end AXIS_DESCR
/end CHARACTERISTIC
/begin MEASUREMENT Vxx_max_tqi_cor_alco "Factor to correct the maximum torque according to the air temperature the atmospheric pressure and the driving regime for flex-fuel" UWORD _CNV_A_R_LINEAR_____29_CM 1 0. 0.25 2.24609375 ECU_ADDRESS 0xd00049c0 FORMAT "%10.6" /end MEASUREMENT
/begin MEASUREMENT Vxx_n_max_tqi_alco "Maximum HP indicated mean torque in function of engine speed, under maximum supercharging pressure, for flex-fuel" UWORD _CNV_A_R_LINEAR_____181_CM 1 0. 0. 2047.96875 ECU_ADDRESS 0xd00049c2 FORMAT "%10.5" /end MEASUREMENT
/begin MEASUREMENT Vxx_n_tco_lim_tqi_alco "Maximum HP indicated mean torque in function of engine speed and coolant temperature to respect the CdC Pcyl, for flex-fuel" UWORD _CNV_A_R_LINEAR_____181_CM 1 0. 0. 2047.96875 ECU_ADDRESS 0xd00049c4 FORMAT "%10.5" /end MEASUREMENT
/begin AXIS_PTS Ctb_n_noi_lim "9 programmable engine speed breakpoints map for acoustic limitation" 0xa0035918 Vxx_n_mv _REC_A2AXS_20_u2 16383.75 _CNV_A_R_ENSD_LINEA_22_CM 9 0. 16383.75 FORMAT "%8.2" /end AXIS_PTS
/begin CHARACTERISTIC Ctp_n_max_tqe_noi "Maximum torque for noise limitation" CURVE 0xa003592c _REC_A1CUR_20_u2_u2 2047.96875 _CNV_A_R_LINEAR_____216_CM -400. 1647.96875 FORMAT "%10.5"
 /begin AXIS_DESCR COM_AXIS Vxx_n_mv _CNV_A_R_ENSD_LINEA_22_CM 9 0. 16383.75 FORMAT "%8.2" AXIS_PTS_REF Ctb_n_noi_lim /end AXIS_DESCR
/end CHARACTERISTIC
/begin MEASUREMENT Vbx_noi_lim_ena "Enable of noise limitation" UBYTE _CNV_S_2_RANGE______3_CM 1 0. 0. 1. ECU_ADDRESS 0xd0007cc0 BIT_MASK 0x1 /end MEASUREMENT
/begin MEASUREMENT Vxx_max_noi_tqe "Maximum effective engine torque for noise limitation" UWORD _CNV_A_R_LINEAR_____216_CM 1 0. -400. 1647.96875 ECU_ADDRESS 0xd00049f6 FORMAT "%10.5" /end MEASUREMENT
/begin MEASUREMENT Vxx_noi_lim_rat "Ratio to apply the noise limitation" UWORD _CNV_A_R_LINEAR_____183_CM 1 0. 0. 1. ECU_ADDRESS 0xd00049f8 FORMAT "%11.9" /end MEASUREMENT
/begin CHARACTERISTIC Cxx_noi_lim_amp_thd "Minimum atmospheric pressure to activate noise limitation" VALUE 0xa0021eea _REC_S1VAL_20_u2 20000. _CNV_A_R_LINEAR_____115_CM 0. 20000. FORMAT "%5.0" /end CHARACTERISTIC
/begin CHARACTERISTIC Cxx_noi_lim_dly_det "Minimum time of stabilized speed to activate noise limitation" VALUE 0xa0021ef8 _REC_S1VAL_20_u1 25.5 _CNV_A_R_LINEAR_____58_CM 0. 25.5 FORMAT "%4.1" /end CHARACTERISTIC
/begin CHARACTERISTIC Cxx_noi_lim_dly_max "Maximum time of noise limitation" VALUE 0xa0021ef9 _REC_S1VAL_20_u1 25.5 _CNV_A_R_LINEAR_____58_CM 0. 25.5 FORMAT "%4.1" /end CHARACTERISTIC
/begin CHARACTERISTIC Cxx_noi_lim_gear "Specific gear to activate noise limitation" VALUE 0xa0021efa _REC_S1VAL_20_u1 7. _CNV_A_R_LINEAR_____145_CM -1. 6. FORMAT "%2.0" /end CHARACTERISTIC
/begin CHARACTERISTIC Cxx_noi_lim_pdl_rat_hys "Accelerator pedal ratio hysteresis for noise limitation" VALUE 0xa0021eec _REC_S1VAL_20_u2 1.25 _CNV_A_R_LINEAR_____319_CM 0. 1.25 FORMAT "%7.5" /end CHARACTERISTIC
/begin CHARACTERISTIC Cxx_noi_lim_pdl_rat_thd "Accelerator pedal ratio threshold to activate noise limitation" VALUE 0xa0021eee _REC_S1VAL_20_u2 1.25 _CNV_A_R_LINEAR_____319_CM 0. 1.25 FORMAT "%7.5" /end CHARACTERISTIC
/begin CHARACTERISTIC Cxx_noi_lim_pos_neg "Negative slope for the disable noise limitation" VALUE 0xa0021ef0 _REC_S1VAL_20_u2 24.90234375 _CNV_A_R_LINEAR_____346_CM -25. -9.765625e-002 FORMAT "%14.8" /end CHARACTERISTIC
/begin CHARACTERISTIC Cxx_noi_lim_pos_slop "Positive slope for the disable noise limitation" VALUE 0xa0021ef2 _REC_S1VAL_20_u2 24.90234375 _CNV_A_R_LINEAR_____296_CM 9.765625e-002 25. FORMAT "%13.8" /end CHARACTERISTIC
/begin CHARACTERISTIC Cxx_noi_lim_thd_vs_max_thd "Threshold high of speed to activate noise limitation" VALUE 0xa0021ef4 _REC_S1VAL_20_u2 655.35 _CNV_A_R_LINEAR_____125_CM 0. 655.35 FORMAT "%6.2" /end CHARACTERISTIC
/begin CHARACTERISTIC Cxx_noi_lim_thd_vs_min_thd "Threshold low of speed to activate noise limitation" VALUE 0xa0021ef6 _REC_S1VAL_20_u2 655.35 _CNV_A_R_LINEAR_____125_CM 0. 655.35 FORMAT "%6.2" /end CHARACTERISTIC
/begin MEASUREMENT Vxx_sens_lbup_v "Tension upstream sensor" UWORD _CNV_A_R_LINEAR_____107_CM 1 0. 0. 25000. ECU_ADDRESS 0xd0003ede FORMAT "%5.0" /end MEASUREMENT
/begin MEASUREMENT ilsh_up "Upstream oxygen sensor heater current" UWORD _CNV_A_R_LINEAR_____289_CM 1 0. 0. 5.5 ECU_ADDRESS 0xd0003ee4 FORMAT "%6.4" /end MEASUREMENT
/begin MEASUREMENT vls_up_raw[0] "" UWORD _CNV_A_R_LINEAR_____70_CM 1 0. 0. 4.9951171875 ECU_ADDRESS 0xd0003ee0 FORMAT "%5.3" /end MEASUREMENT
/begin MEASUREMENT vlsh_up "Upstream sensor heater voltage measured" UWORD _CNV_A_R_LINEAR_____70_CM 1 0. 0. 4.9951171875 ECU_ADDRESS 0xd0003ee2 FORMAT "%5.3" /end MEASUREMENT
/begin CHARACTERISTIC c_ilsh_up_gain "Gain for upstream oxygen sensor heater current acquisition" VALUE 0xa0020ac6 _REC_S1VAL_20_u2 1342.16 _CNV_A_R_LINEAR_____332_CM 0. 1342.16 FORMAT "%10.5" /end CHARACTERISTIC
/begin CHARACTERISTIC c_ilsh_up_ofs "Offset for upstream oxygen sensor heater current acquisition" VALUE 0xa0020ac8 _REC_S1VAL_20_u4 20. _CNV_A_R_LINEAR_____289_CM 0. 20. FORMAT "%6.4" /end CHARACTERISTIC
/begin MEASUREMENT Vbx_ufld_cut "unflooding strategy available" UBYTE _CNV_S_2_RANGE______3_CM 1 0. 0. 1. ECU_ADDRESS 0xd000778f BIT_MASK 0x1 /end MEASUREMENT
/begin CHARACTERISTIC Cxx_ufld_tco_thd "coolant temperature maximum value for unflooding strategy application" VALUE 0xa0020d18 _REC_S1VAL_20_u2 240. _CNV_A_R_LINEAR_____110_CM -40. 200. FORMAT "%5.1" /end CHARACTERISTIC
/begin MEASUREMENT Vbx_eng_spc_acs_dsb "Accessories deactivation request for engine specific strategies" UBYTE _CNV_S_2_RANGE______3_CM 1 0. 0. 1. ECU_ADDRESS 0xd0007cca BIT_MASK 0x1 /end MEASUREMENT
/begin AXIS_PTS Ctb_n_alt "Engine speed breakpoints for alternator cartographies" 0xa0036b8c Vxx_n _REC_A2AXS_20_u2 16383.75 _CNV_A_R_ENSD_LINEA_22_CM 8 0. 16383.75 FORMAT "%8.2" /end AXIS_PTS
/begin AXIS_PTS Ctb_rbst_el_csm_dsb_amp "Atmospheric pressure breakpoints in engine robustness strategy" 0xa0036ba0 Vxx_amp _REC_A2AXS_20_u2 20000. _CNV_A_R_LINEAR_____115_CM 9 0. 20000. FORMAT "%5.0" /end AXIS_PTS
/begin CHARACTERISTIC Cmp_alt_slop_req "Cartography to compute alternator power gradient authorized by ECM" MAP 0xa0036bb4 _REC_A1MAP_20_u1_u2_u2 10200. _CNV_A_R_LINEAR_____272_CM 0. 10200. FORMAT "%5.0"
 /begin AXIS_DESCR COM_AXIS Vxx_n _CNV_A_R_ENSD_LINEA_22_CM 8 0. 16383.75 FORMAT "%8.2" AXIS_PTS_REF Ctb_n_alt /end AXIS_DESCR
 /begin AXIS_DESCR COM_AXIS Vxx_tco _CNV_A_R_LINEAR_____110_CM 9 -40. 200. FORMAT "%5.1" AXIS_PTS_REF Ctb_tco2 /end AXIS_DESCR
/end CHARACTERISTIC
/begin CHARACTERISTIC Ctd_rbst_el_csm_dsb_gear "Cartography to select gears on which electrical consumers deactivation is requested in engine robustness strategy" CURVE 0xa0021f88 _REC_A1CUR_20_u1_u1 1. _CNV_A_R_ECME_LINEA_0_CM 0. 1. FORMAT "%1.0" BIT_MASK 0x1
 /begin AXIS_DESCR COM_AXIS Vxx_gear _CNV_A_R_LINEAR_____145_CM 8 -1. 6. READ_ONLY FORMAT "%2.0" AXIS_PTS_REF Ntb_gear /end AXIS_DESCR
/end CHARACTERISTIC
/begin CHARACTERISTIC Ctp_perf_acs_dsb_max_avl_tqe "Cartography to compute the maximum value of maximum available torque to request accessories deactivation in performance restitution strategy" CURVE 0xa0036bfc _REC_A1CUR_20_u2_u2 2047.96875 _CNV_A_R_LINEAR_____216_CM -400. 1647.96875 FORMAT "%10.5"
 /begin AXIS_DESCR COM_AXIS Vxx_n _CNV_A_R_ENSD_LINEA_22_CM 20 0. 16383.75 FORMAT "%8.2" AXIS_PTS_REF Ctb_n /end AXIS_DESCR
/end CHARACTERISTIC
/begin CHARACTERISTIC Ctp_rbst_el_csm_dsb_tco_thd "Cartography to compute engine coolant temperature threshold in engine robustness strategy" CURVE 0xa0036c24 _REC_A1CUR_20_u2_u2 240. _CNV_A_R_LINEAR_____110_CM -40. 200. FORMAT "%5.1"
 /begin AXIS_DESCR COM_AXIS Vxx_amp _CNV_A_R_LINEAR_____115_CM 9 0. 20000. FORMAT "%5.0" AXIS_PTS_REF Ctb_rbst_el_csm_dsb_amp /end AXIS_DESCR
/end CHARACTERISTIC
/begin CHARACTERISTIC Ctp_sta_ac_ptc_dsb_dly "Cartography to compute air conditioning and PTC deactivation duration at engine start" CURVE 0xa0036c38 _REC_A1CUR_20_u2_u2 655.35 _CNV_A_R_LINEAR_____32_CM 0. 655.35 FORMAT "%6.2"
 /begin AXIS_DESCR COM_AXIS Vxx_tco _CNV_A_R_LINEAR_____110_CM 9 -40. 200. FORMAT "%5.1" AXIS_PTS_REF Ctb_tco2 /end AXIS_DESCR
/end CHARACTERISTIC
/begin CHARACTERISTIC Ctp_sta_alt_dsb_dly "Cartography to compute alternator deactivation duration at engine start" CURVE 0xa0036c4c _REC_A1CUR_20_u2_u2 655.35 _CNV_A_R_LINEAR_____32_CM 0. 655.35 FORMAT "%6.2"
 /begin AXIS_DESCR COM_AXIS Vxx_tco _CNV_A_R_LINEAR_____110_CM 9 -40. 200. FORMAT "%5.1" AXIS_PTS_REF Ctb_tco2 /end AXIS_DESCR
/end CHARACTERISTIC
/begin CHARACTERISTIC Ctp_stal_ac_dsb_n_ofs "Cartography to compute engine speed offset to start stalling anticipation in anti-stall strategy" CURVE 0xa0036c60 _REC_A1CUR_20_u2_u2 16383.75 _CNV_A_R_ENSD_LINEA_22_CM 0. 16383.75 FORMAT "%8.2"
 /begin AXIS_DESCR COM_AXIS Vxx_tco _CNV_A_R_LINEAR_____110_CM 9 -40. 200. FORMAT "%5.1" AXIS_PTS_REF Ctb_tco2 /end AXIS_DESCR
/end CHARACTERISTIC
/begin CHARACTERISTIC Ctp_stal_acs_dsb_n "Cartography to compute engine speed threshold to request accessories deactivation in anti-stall strategy" CURVE 0xa0036c74 _REC_A1CUR_20_u2_u2 16383.75 _CNV_A_R_ENSD_LINEA_22_CM 0. 16383.75 FORMAT "%8.2"
 /begin AXIS_DESCR COM_AXIS Vxx_tco _CNV_A_R_LINEAR_____110_CM 9 -40. 200. FORMAT "%5.1" AXIS_PTS_REF Ctb_tco2 /end AXIS_DESCR
/end CHARACTERISTIC
/begin MEASUREMENT Vbx_ac_dsb_req "Air conditioning deactivation request before coordination" UBYTE _CNV_S_2_RANGE______3_CM 1 0. 0. 1. ECU_ADDRESS 0xd0007cda BIT_MASK 0x1 /end MEASUREMENT
/begin MEASUREMENT Vbx_ac_eng_dsb "Air conditioning compressor inhibition request for engine needs" UBYTE _CNV_S_2_RANGE______3_CM 1 0. 0. 1. ECU_ADDRESS 0xd0007cdb BIT_MASK 0x1 /end MEASUREMENT
/begin MEASUREMENT Vbx_ac_eng_frz "Air conditioning compressor freezing request for engine needs" UBYTE _CNV_S_2_RANGE______3_CM 1 0. 0. 1. ECU_ADDRESS 0xd0007cdc BIT_MASK 0x1 /end MEASUREMENT
/begin MEASUREMENT Vbx_acel_is_ac_dsb "Air conditioning deactivation request for minimum idle speed at compressor clutching" UBYTE _CNV_S_2_RANGE______3_CM 1 0. 0. 1. ECU_ADDRESS 0xd0007cdd BIT_MASK 0x1 /end MEASUREMENT
/begin MEASUREMENT Vbx_acs_frz "Accessories freezing request before coordination" UBYTE _CNV_S_2_RANGE______3_CM 1 0. 0. 1. ECU_ADDRESS 0xd0007cde BIT_MASK 0x1 /end MEASUREMENT
/begin MEASUREMENT Vbx_alt_dsb_req "Alternator deactivation request before coordination" UBYTE _CNV_S_2_RANGE______3_CM 1 0. 0. 1. ECU_ADDRESS 0xd0007cdf BIT_MASK 0x1 /end MEASUREMENT
/begin MEASUREMENT Vbx_alt_eng_dsb "Alternator deactivation request after coordination" UBYTE _CNV_S_2_RANGE______3_CM 1 0. 0. 1. ECU_ADDRESS 0xd0007ce0 BIT_MASK 0x1 /end MEASUREMENT
/begin MEASUREMENT Vbx_perf_ac_dsb "Consolidated air conditioning deactivation request for performance restitution" UBYTE _CNV_S_2_RANGE______3_CM 1 0. 0. 1. ECU_ADDRESS 0xd00071b9 BIT_MASK 0x1 /end MEASUREMENT
/begin MEASUREMENT Vbx_perf_acs_dsb "Accessories deactivation request for performance restitution" UBYTE _CNV_S_2_RANGE______3_CM 1 0. 0. 1. ECU_ADDRESS 0xd0007ce1 BIT_MASK 0x1 /end MEASUREMENT
/begin MEASUREMENT Vbx_perf_el_csm_dsb "Consolidated electrical consumers deactivation request for performance restitution" UBYTE _CNV_S_2_RANGE______3_CM 1 0. 0. 1. ECU_ADDRESS 0xd00071ba BIT_MASK 0x1 /end MEASUREMENT
/begin MEASUREMENT Vbx_ptc_cut "Cut off condition, output of shut off and limitation conditions to the CAN Inj_Base_Rapide frame" UBYTE _CNV_S_2_RANGE______3_CM 1 0. 0. 1. ECU_ADDRESS 0xd0007ce2 BIT_MASK 0x1 /end MEASUREMENT
/begin MEASUREMENT Vbx_ptc_dsb_req "PTC deactivation request before coordination" UBYTE _CNV_S_2_RANGE______3_CM 1 0. 0. 1. ECU_ADDRESS 0xd0007ce3 BIT_MASK 0x1 /end MEASUREMENT
/begin MEASUREMENT Vbx_ptc_frz "Output of freeze condition, to the CAN INJ_Base_Rapide frame." UBYTE _CNV_S_2_RANGE______3_CM 1 0. 0. 1. ECU_ADDRESS 0xd0007ce4 BIT_MASK 0x1 /end MEASUREMENT
/begin MEASUREMENT Vbx_rbst_el_csm_dsb "Electrical consumers deactivation request for engine robustness" UBYTE _CNV_S_2_RANGE______3_CM 1 0. 0. 1. ECU_ADDRESS 0xd00071bb BIT_MASK 0x1 /end MEASUREMENT
/begin MEASUREMENT Vbx_sfty_acs_dsb "Accessories deactivation request for safety" UBYTE _CNV_S_2_RANGE______3_CM 1 0. 0. 1. ECU_ADDRESS 0xd0007ce5 BIT_MASK 0x1 /end MEASUREMENT
/begin MEASUREMENT Vbx_sta_ac_ptc_dsb "Air conditioning and PTC deactivation request for engine start" UBYTE _CNV_S_2_RANGE______3_CM 1 0. 0. 1. ECU_ADDRESS 0xd0007ce6 BIT_MASK 0x1 /end MEASUREMENT
/begin MEASUREMENT Vbx_sta_alt_dsb "Alternator deactivation request for engine start" UBYTE _CNV_S_2_RANGE______3_CM 1 0. 0. 1. ECU_ADDRESS 0xd0007ce7 BIT_MASK 0x1 /end MEASUREMENT
/begin MEASUREMENT Vbx_stal_acs_dsb "Accessories deactivation request for anti-stall" UBYTE _CNV_S_2_RANGE______3_CM 1 0. 0. 1. ECU_ADDRESS 0xd0007ce8 BIT_MASK 0x1 /end MEASUREMENT
/begin MEASUREMENT Vbx_stal_alt_ac_dsb "Consolidated alternator and air conditioning deactivation request for anti-stall" UBYTE _CNV_S_2_RANGE______3_CM 1 0. 0. 1. ECU_ADDRESS 0xd00071bc BIT_MASK 0x1 /end MEASUREMENT
/begin MEASUREMENT Vbx_stal_el_csm_dsb "Consolidated electrical consumers deactivation request for anti-stall" UBYTE _CNV_S_2_RANGE______3_CM 1 0. 0. 1. ECU_ADDRESS 0xd00071bd BIT_MASK 0x1 /end MEASUREMENT
/begin MEASUREMENT Vbx_thpl_dsb_req "Coolant heaters deactivation request before coordination" UBYTE _CNV_S_2_RANGE______3_CM 1 0. 0. 1. ECU_ADDRESS 0xd00071be BIT_MASK 0x1 /end MEASUREMENT
/begin MEASUREMENT Vbx_thpl_eng_dsb "Coolant heaters deactivation request for engine needs" UBYTE _CNV_S_2_RANGE______3_CM 1 0. 0. 1. ECU_ADDRESS 0xd00071bf BIT_MASK 0x1 /end MEASUREMENT
/begin MEASUREMENT Vbx_thpl_eng_frz "Coolant heaters freezing request for engine needs" UBYTE _CNV_S_2_RANGE______3_CM 1 0. 0. 1. ECU_ADDRESS 0xd00071c0 BIT_MASK 0x1 /end MEASUREMENT
/begin MEASUREMENT Vbx_tkof_acs_dsb "Accessories deactivation request for takeoff" UBYTE _CNV_S_2_RANGE______3_CM 1 0. 0. 1. ECU_ADDRESS 0xd0007ce9 BIT_MASK 0x1 /end MEASUREMENT
/begin MEASUREMENT Vbx_tkof_alt_ac_dsb "Consolidated alternator and air conditioning deactivation request for takeoff" UBYTE _CNV_S_2_RANGE______3_CM 1 0. 0. 1. ECU_ADDRESS 0xd00071c1 BIT_MASK 0x1 /end MEASUREMENT
/begin MEASUREMENT Vbx_tkof_el_csm_dsb "Consolidated electrical consumers deactivation request for takeoff" UBYTE _CNV_S_2_RANGE______3_CM 1 0. 0. 1. ECU_ADDRESS 0xd00071c2 BIT_MASK 0x1 /end MEASUREMENT
/begin MEASUREMENT Vsx_stal_acs_dsb_stt "Stalling state in anti-stall strategy" UBYTE _CNV_S_3_RANGE_STAT_348_CM 1 0. 0. 2. ECU_ADDRESS 0xd0007cea /end MEASUREMENT
/begin MEASUREMENT Vxx_ac_max_pow_ena "Air conditioning maximum power authorized by ECM" UWORD _CNV_A_R_LINEAR_____186_CM 1 0. 0. 655350. ECU_ADDRESS 0xd00060d0 FORMAT "%6.0" /end MEASUREMENT
/begin MEASUREMENT Vxx_acel_pdl_grd "Accelerator pedal gradient" SWORD _CNV_A_R_LINEAR_____349_CM 1 0. -64. 63.998046875 ECU_ADDRESS 0xd00060d2 FORMAT "%7.3" /end MEASUREMENT
/begin MEASUREMENT Vxx_acs_ena_dly "Accessories reactivation timer" UWORD _CNV_A_R_LINEAR_____32_CM 1 0. 0. 655.35 ECU_ADDRESS 0xd00060d4 FORMAT "%6.2" /end MEASUREMENT
/begin MEASUREMENT Vxx_alt_max_pow_ena "Alternator maximum power authorized by the ECM" UWORD _CNV_A_R_LINEAR_____186_CM 1 0. 0. 655350. ECU_ADDRESS 0xd00060d6 FORMAT "%6.0" /end MEASUREMENT
/begin MEASUREMENT Vxx_alt_slop_req "Power slope sent to the USM" UBYTE _CNV_A_R_LINEAR_____272_CM 1 0. 0. 10200. ECU_ADDRESS 0xd0007ceb FORMAT "%5.0" /end MEASUREMENT
/begin MEASUREMENT Vxx_ptc_max_pow_ena "PTC maximum power allowed" UWORD _CNV_A_R_LINEAR_____186_CM 1 0. 0. 655350. ECU_ADDRESS 0xd00060d8 FORMAT "%6.0" /end MEASUREMENT
/begin MEASUREMENT Vxx_stal_ac_ant_dsb_n "Stalling anticipation engine speed threshold" UWORD _CNV_A_R_ENSD_LINEA_22_CM 1 0. 0. 16383.75 ECU_ADDRESS 0xd00060da FORMAT "%8.2" /end MEASUREMENT
/begin MEASUREMENT Vxx_stal_ac_max_pow_ena "Consolidated air conditioning maximum power for anti-stall" UWORD _CNV_A_R_LINEAR_____186_CM 1 0. 0. 655350. ECU_ADDRESS 0xd00060dc FORMAT "%6.0" /end MEASUREMENT
/begin MEASUREMENT Vxx_stal_ac_max_pow_ena_clc "Air conditioning maximum power calculated in anti-stall strategy" UWORD _CNV_A_R_LINEAR_____186_CM 1 0. 0. 655350. ECU_ADDRESS 0xd00060de FORMAT "%6.0" /end MEASUREMENT
/begin MEASUREMENT Vxx_stal_ac_max_tq "Air conditioning maximum torque calculated in anti-stall strategy" UWORD _CNV_A_R_LINEAR_____181_CM 1 0. 0. 2047.96875 ECU_ADDRESS 0xd00060e0 FORMAT "%10.5" /end MEASUREMENT
/begin MEASUREMENT Vxx_stal_ac_max_tq_clc "Air conditioning maximum torque calculated from proportional and derivative corrections in anti-stall strategy" UWORD _CNV_A_R_LINEAR_____181_CM 1 0. 0. 2047.96875 ECU_ADDRESS 0xd00060e2 FORMAT "%10.5" /end MEASUREMENT
/begin MEASUREMENT Vxx_stal_acs_dsb_dly "Timer to leave stalling states in anti-stall strategy" UWORD _CNV_A_R_LINEAR_____32_CM 1 0. 0. 655.35 ECU_ADDRESS 0xd00060e4 FORMAT "%6.2" /end MEASUREMENT
/begin MEASUREMENT Vxx_stal_acs_dsb_n "Stalling engine speed threshold" UWORD _CNV_A_R_ENSD_LINEA_22_CM 1 0. 0. 16383.75 ECU_ADDRESS 0xd00060e6 FORMAT "%8.2" /end MEASUREMENT
/begin MEASUREMENT Vxx_tkof_acs_dsb_vs "Vehicle speed for takeoff strategy" UWORD _CNV_A_R_LINEAR_____125_CM 1 0. 0. 655.35 ECU_ADDRESS 0xd00060e8 FORMAT "%6.2" /end MEASUREMENT
/begin CHARACTERISTIC Cbx_ac_max_pow_ena_cfm "Activation of air conditioning power limitation strategy" VALUE 0xa0021fd8 _REC_S1VAL_20_u1 1. _CNV_S_2_RANGE______3_CM 0. 1. BIT_MASK 0x1 /end CHARACTERISTIC
/begin CHARACTERISTIC Cbx_acel_is_ac_dsb_cfm "Activation of air conditioning accelerated idle speed strategy" VALUE 0xa0021fd9 _REC_S1VAL_20_u1 1. _CNV_S_2_RANGE______3_CM 0. 1. BIT_MASK 0x1 /end CHARACTERISTIC
/begin CHARACTERISTIC Cbx_eng_spc_ac_dsb_cfm "Activation of engine specific strategy for air conditioning" VALUE 0xa0021fda _REC_S1VAL_20_u1 1. _CNV_S_2_RANGE______3_CM 0. 1. BIT_MASK 0x1 /end CHARACTERISTIC
/begin CHARACTERISTIC Cbx_eng_spc_alt_dsb_cfm "Activation of engine specific strategy for alternator" VALUE 0xa0021fdb _REC_S1VAL_20_u1 1. _CNV_S_2_RANGE______3_CM 0. 1. BIT_MASK 0x1 /end CHARACTERISTIC
/begin CHARACTERISTIC Cbx_eng_spc_ptc_dsb_cfm "Activation of engine specific strategy for PTC" VALUE 0xa0021fdc _REC_S1VAL_20_u1 1. _CNV_S_2_RANGE______3_CM 0. 1. BIT_MASK 0x1 /end CHARACTERISTIC
/begin CHARACTERISTIC Cbx_eng_spc_thpl_dsb_cfm "Activation of engine specific strategy for coolant heaters" VALUE 0xa0021fdd _REC_S1VAL_20_u1 1. _CNV_S_2_RANGE______3_CM 0. 1. BIT_MASK 0x1 /end CHARACTERISTIC
/begin CHARACTERISTIC Cbx_perf_ac_dsb_cfm "Activation of performance restitution strategy for air conditioning" VALUE 0xa0021fde _REC_S1VAL_20_u1 1. _CNV_S_2_RANGE______3_CM 0. 1. BIT_MASK 0x1 /end CHARACTERISTIC
/begin CHARACTERISTIC Cbx_perf_ptc_dsb_cfm "Activation of performance restitution strategy for PTC" VALUE 0xa0021fdf _REC_S1VAL_20_u1 1. _CNV_S_2_RANGE______3_CM 0. 1. BIT_MASK 0x1 /end CHARACTERISTIC
/begin CHARACTERISTIC Cbx_perf_thpl_dsb_cfm "Activation of performance restitution strategy for coolant heaters" VALUE 0xa0021fe0 _REC_S1VAL_20_u1 1. _CNV_S_2_RANGE______3_CM 0. 1. BIT_MASK 0x1 /end CHARACTERISTIC
/begin CHARACTERISTIC Cbx_rbst_ptc_dsb_cfm "Activation of engine robustness strategy for PTC" VALUE 0xa0021fe1 _REC_S1VAL_20_u1 1. _CNV_S_2_RANGE______3_CM 0. 1. BIT_MASK 0x1 /end CHARACTERISTIC
/begin CHARACTERISTIC Cbx_rbst_thpl_dsb_cfm "Activation of engine robustness strategy for coolant heaters" VALUE 0xa0021fe2 _REC_S1VAL_20_u1 1. _CNV_S_2_RANGE______3_CM 0. 1. BIT_MASK 0x1 /end CHARACTERISTIC
/begin CHARACTERISTIC Cbx_sta_thpl_dsb_cfm "Activation of engine start strategy for coolant heaters" VALUE 0xa0021fe3 _REC_S1VAL_20_u1 1. _CNV_S_2_RANGE______3_CM 0. 1. BIT_MASK 0x1 /end CHARACTERISTIC
/begin CHARACTERISTIC Cbx_stal_ac_dsb_cfm "Activation of anti-stall strategy for air conditioning" VALUE 0xa0021fe4 _REC_S1VAL_20_u1 1. _CNV_S_2_RANGE______3_CM 0. 1. BIT_MASK 0x1 /end CHARACTERISTIC
/begin CHARACTERISTIC Cbx_stal_ac_max_tq_prop_cfm "Proportional torque limitation configuration in anti-stall strategy" VALUE 0xa0021fe5 _REC_S1VAL_20_u1 1. _CNV_S_2_RANGE______3_CM 0. 1. BIT_MASK 0x1 /end CHARACTERISTIC
/begin CHARACTERISTIC Cbx_stal_alt_dsb_cfm "Activation of anti-stall strategy for alternator" VALUE 0xa0021fe6 _REC_S1VAL_20_u1 1. _CNV_S_2_RANGE______3_CM 0. 1. BIT_MASK 0x1 /end CHARACTERISTIC
/begin CHARACTERISTIC Cbx_stal_ptc_dsb_cfm "Activation of anti-stall strategy for PTC" VALUE 0xa0021fe7 _REC_S1VAL_20_u1 1. _CNV_S_2_RANGE______3_CM 0. 1. BIT_MASK 0x1 /end CHARACTERISTIC
/begin CHARACTERISTIC Cbx_stal_thpl_dsb_cfm "Activation of anti-stall strategy for coolant heaters" VALUE 0xa0021fe8 _REC_S1VAL_20_u1 1. _CNV_S_2_RANGE______3_CM 0. 1. BIT_MASK 0x1 /end CHARACTERISTIC
/begin CHARACTERISTIC Cbx_tkof_ac_dsb_cfm "Activation of takeoff strategy for air conditioning" VALUE 0xa0021fe9 _REC_S1VAL_20_u1 1. _CNV_S_2_RANGE______3_CM 0. 1. BIT_MASK 0x1 /end CHARACTERISTIC
/begin CHARACTERISTIC Cbx_tkof_acs_dsb_rwhs_cfm "Rear wheel speed configuration in takeoff vehicle speed calculation" VALUE 0xa0021fea _REC_S1VAL_20_u1 1. _CNV_S_2_RANGE______3_CM 0. 1. BIT_MASK 0x1 /end CHARACTERISTIC
/begin CHARACTERISTIC Cbx_tkof_alt_dsb_cfm "Activation of takeoff strategy for alternator" VALUE 0xa0021feb _REC_S1VAL_20_u1 1. _CNV_S_2_RANGE______3_CM 0. 1. BIT_MASK 0x1 /end CHARACTERISTIC
/begin CHARACTERISTIC Cbx_tkof_ptc_dsb_cfm "Activation of takeoff strategy for PTC" VALUE 0xa0021fec _REC_S1VAL_20_u1 1. _CNV_S_2_RANGE______3_CM 0. 1. BIT_MASK 0x1 /end CHARACTERISTIC
/begin CHARACTERISTIC Cbx_tkof_thpl_dsb_cfm "Activation of takeoff strategy for coolant heaters" VALUE 0xa0021fed _REC_S1VAL_20_u1 1. _CNV_S_2_RANGE______3_CM 0. 1. BIT_MASK 0x1 /end CHARACTERISTIC
/begin CHARACTERISTIC Cxx_acel_is_ac_dsb_dly "Minimum duration on accelerated idle speed before authorizing air conditioning compressor clutching" VALUE 0xa0021f90 _REC_S1VAL_20_u2 655.35 _CNV_A_R_LINEAR_____32_CM 0. 655.35 FORMAT "%6.2" /end CHARACTERISTIC
/begin CHARACTERISTIC Cxx_acel_is_ac_dsb_rat "Accelerated idle speed ratio to authorize air conditioning compressor clutching" VALUE 0xa0021fee _REC_S1VAL_20_u1 1. _CNV_A_R_LINEAR_____275_CM 0. 1. FORMAT "%5.3" /end CHARACTERISTIC
/begin CHARACTERISTIC Cxx_acs_amp_dft_val "Atmospheric pressure replacement value in case of invalid atmospheric pressure" VALUE 0xa0021f92 _REC_S1VAL_20_u2 20000. _CNV_A_R_LINEAR_____115_CM 0. 20000. FORMAT "%5.0" /end CHARACTERISTIC
/begin CHARACTERISTIC Cxx_acs_ena_dly "Minimum duration between accessories reactivations" VALUE 0xa0021f94 _REC_S1VAL_20_u2 655.35 _CNV_A_R_LINEAR_____32_CM 0. 655.35 FORMAT "%6.2" /end CHARACTERISTIC
/begin CHARACTERISTIC Cxx_alt_min_pow_ena "Alternator maximum power minimum value" VALUE 0xa0021f96 _REC_S1VAL_20_u2 655350. _CNV_A_R_LINEAR_____186_CM 0. 655350. FORMAT "%6.0" /end CHARACTERISTIC
/begin CHARACTERISTIC Cxx_perf_ac_amp_h_thd "Atmospheric pressure threshold to inhibit performance restitution strategy for air conditioning" VALUE 0xa0021f98 _REC_S1VAL_20_u2 20000. _CNV_A_R_LINEAR_____115_CM 0. 20000. FORMAT "%5.0" /end CHARACTERISTIC
/begin CHARACTERISTIC Cxx_perf_ac_amp_l_thd "Atmospheric pressure threshold to activate performance restitution strategy for air conditioning" VALUE 0xa0021f9a _REC_S1VAL_20_u2 20000. _CNV_A_R_LINEAR_____115_CM 0. 20000. FORMAT "%5.0" /end CHARACTERISTIC
/begin CHARACTERISTIC Cxx_perf_acs_dsb_dly "Maximum duration of accessories deactivation in performance restitution strategy" VALUE 0xa0021f9c _REC_S1VAL_20_u2 655.35 _CNV_A_R_LINEAR_____32_CM 0. 655.35 FORMAT "%6.2" /end CHARACTERISTIC
/begin CHARACTERISTIC Cxx_perf_acs_dsb_h_gear "Maximum gear to request accessories deactivation in performance restitution strategy" VALUE 0xa0021fef _REC_S1VAL_20_u1 7. _CNV_A_R_LINEAR_____145_CM -1. 6. FORMAT "%4.0" /end CHARACTERISTIC
/begin CHARACTERISTIC Cxx_perf_acs_dsb_l_gear "Minimum gear to request accessories deactivation in performance restitution strategy" VALUE 0xa0021ff0 _REC_S1VAL_20_u1 7. _CNV_A_R_LINEAR_____145_CM -1. 6. FORMAT "%4.0" /end CHARACTERISTIC
/begin CHARACTERISTIC Cxx_perf_acs_dsb_n "Maximum engine speed to request accessories deactivation in preformance restitution strategy" VALUE 0xa0021f9e _REC_S1VAL_20_u2 16383.75 _CNV_A_R_ENSD_LINEA_22_CM 0. 16383.75 FORMAT "%8.2" /end CHARACTERISTIC
/begin CHARACTERISTIC Cxx_perf_acs_dsb_pdl_grd "Minimum accelerator pedal gradient to request accessories deactivation in performance restitution strategy" VALUE 0xa0021fa0 _REC_S1VAL_20_s2 127.998046875 _CNV_A_R_LINEAR_____349_CM -64. 63.998046875 FORMAT "%7.3" /end CHARACTERISTIC
/begin CHARACTERISTIC Cxx_perf_acs_dsb_pdl_grd_t "Time constant of accelerator pedal gradient filter" VALUE 0xa0021ff1 _REC_S1VAL_20_u1 2.55 _CNV_A_R_LINEAR_____32_CM 0. 2.55 FORMAT "%4.2" /end CHARACTERISTIC
/begin CHARACTERISTIC Cxx_perf_acs_dsb_pdl_rat "Minimum accelerator pedal position to request accessories deactivation in performance restitution strategy" VALUE 0xa0021fa2 _REC_S1VAL_20_u2 1.25 _CNV_A_R_LINEAR_____319_CM 0. 1.25 FORMAT "%8.5" /end CHARACTERISTIC
/begin CHARACTERISTIC Cxx_perf_acs_dsb_tqe_dif "Maximum available torques difference to request accessories deactivation in performance restitution strategy" VALUE 0xa0021fa4 _REC_S1VAL_20_u2 2047.96875 _CNV_A_R_LINEAR_____216_CM -400. 1647.96875 FORMAT "%10.5" /end CHARACTERISTIC
/begin CHARACTERISTIC Cxx_perf_acs_ena_n "Minimum engine speed to request accessories reactivation in performance restitution strategy" VALUE 0xa0021fa6 _REC_S1VAL_20_u2 16383.75 _CNV_A_R_ENSD_LINEA_22_CM 0. 16383.75 FORMAT "%8.2" /end CHARACTERISTIC
/begin CHARACTERISTIC Cxx_perf_acs_ena_pdl_rat "Maximum accelerator pedal position to request accessories reactivation in performance restitution strategy" VALUE 0xa0021fa8 _REC_S1VAL_20_u2 1.25 _CNV_A_R_LINEAR_____319_CM 0. 1.25 FORMAT "%8.5" /end CHARACTERISTIC
/begin CHARACTERISTIC Cxx_rbst_el_csm_dsb_gear_dly "Turnoff delay on gear condition in engine robustness strategy" VALUE 0xa0021faa _REC_S1VAL_20_u2 655.35 _CNV_A_R_LINEAR_____32_CM 0. 655.35 FORMAT "%6.2" /end CHARACTERISTIC
/begin CHARACTERISTIC Cxx_rbst_el_csm_dsb_n "Engine speed threshold to request electrical consumers deactivation in engine robustness strategy" VALUE 0xa0021fac _REC_S1VAL_20_u2 16383.75 _CNV_A_R_ENSD_LINEA_22_CM 0. 16383.75 FORMAT "%8.2" /end CHARACTERISTIC
/begin CHARACTERISTIC Cxx_rbst_el_csm_dsb_tco_hys "Engine coolant temperature hysteresis in engine robustness strategy" VALUE 0xa0021fae _REC_S1VAL_20_u2 240. _CNV_A_R_LINEAR_____110_CM -40. 200. FORMAT "%5.1" /end CHARACTERISTIC
/begin CHARACTERISTIC Cxx_rbst_el_csm_ena_n "Engine speed threshold to request electrical consumers reactivation in engine robustness strategy" VALUE 0xa0021fb0 _REC_S1VAL_20_u2 16383.75 _CNV_A_R_ENSD_LINEA_22_CM 0. 16383.75 FORMAT "%8.2" /end CHARACTERISTIC
/begin CHARACTERISTIC Cxx_stal_ac_max_tq_d "Air conditioning maximum torque derivative factor in anti-stall strategy" VALUE 0xa0021fb2 _REC_S1VAL_20_u2 3.99993896484375 _CNV_A_R_LINEAR_____350_CM 0. 3.99993896484375 FORMAT "%7.5" /end CHARACTERISTIC
/begin CHARACTERISTIC Cxx_stal_ac_max_tq_dft_val "Air conditioning maximum torque default value in anti-stall strategy" VALUE 0xa0021fb4 _REC_S1VAL_20_u2 2047.96875 _CNV_A_R_LINEAR_____181_CM 0. 2047.96875 FORMAT "%10.5" /end CHARACTERISTIC
/begin CHARACTERISTIC Cxx_stal_ac_max_tq_p "Air conditioning maximum torque proportional factor in anti-stall strategy" VALUE 0xa0021fb6 _REC_S1VAL_20_u2 7.9998779296875 _CNV_A_R_LINEAR_____351_CM 0. 7.9998779296875 FORMAT "%6.4" /end CHARACTERISTIC
/begin CHARACTERISTIC Cxx_stal_ac_max_tq_ref "Air conditioning reference torque in anti-stall strategy" VALUE 0xa0021fb8 _REC_S1VAL_20_u2 2047.96875 _CNV_A_R_LINEAR_____181_CM 0. 2047.96875 FORMAT "%10.5" /end CHARACTERISTIC
/begin CHARACTERISTIC Cxx_stal_ac_max_tq_slop "Air conditioning maximum torque slew rate in anti-stall strategy" VALUE 0xa0021ff2 _REC_S1VAL_20_u1 127.5 _CNV_A_R_LINEAR_____352_CM 0. 127.5 FORMAT "%5.1" /end CHARACTERISTIC
/begin CHARACTERISTIC Cxx_stal_ac_max_tq_thd "Air conditioning maximum torque threshold in anti-stall strategy" VALUE 0xa0021fba _REC_S1VAL_20_u2 2047.96875 _CNV_A_R_LINEAR_____181_CM 0. 2047.96875 FORMAT "%10.5" /end CHARACTERISTIC
/begin CHARACTERISTIC Cxx_stal_acs_dsb_dly "Minimum duration before leaving stalling states in anti-stall strategy" VALUE 0xa0021fbc _REC_S1VAL_20_u2 655.35 _CNV_A_R_LINEAR_____32_CM 0. 655.35 FORMAT "%6.2" /end CHARACTERISTIC
/begin CHARACTERISTIC Cxx_stal_alt_ac_amp_h_thd "Atmospheric pressure threshold to inhibit anti-stall strategy for alternator and air conditioning" VALUE 0xa0021fbe _REC_S1VAL_20_u2 20000. _CNV_A_R_LINEAR_____115_CM 0. 20000. FORMAT "%5.0" /end CHARACTERISTIC
/begin CHARACTERISTIC Cxx_stal_alt_ac_amp_l_thd "Atmospheric pressure threshold to activate anti-stall strategy for alternator and air conditioning" VALUE 0xa0021fc0 _REC_S1VAL_20_u2 20000. _CNV_A_R_LINEAR_____115_CM 0. 20000. FORMAT "%5.0" /end CHARACTERISTIC
/begin CHARACTERISTIC Cxx_tkof_acs_dsb_coup_dly "Turnoff delay on coupler state in takeoff strategy" VALUE 0xa0021fc2 _REC_S1VAL_20_u2 655.35 _CNV_A_R_LINEAR_____32_CM 0. 655.35 FORMAT "%6.2" /end CHARACTERISTIC
/begin CHARACTERISTIC Cxx_tkof_acs_dsb_dly "Maximum duration of accessories deactivation in takeoff strategy" VALUE 0xa0021fc4 _REC_S1VAL_20_u2 655.35 _CNV_A_R_LINEAR_____32_CM 0. 655.35 FORMAT "%6.2" /end CHARACTERISTIC
/begin CHARACTERISTIC Cxx_tkof_acs_dsb_n "Minimum engine speed to request accessories deactivation in takeoff strategy" VALUE 0xa0021fc6 _REC_S1VAL_20_u2 16383.75 _CNV_A_R_ENSD_LINEA_22_CM 0. 16383.75 FORMAT "%8.2" /end CHARACTERISTIC
/begin CHARACTERISTIC Cxx_tkof_acs_dsb_pwt_sp "Minimum driver powertrain setpoint to request accessories deactivation in takeoff strategy" VALUE 0xa0021fc8 _REC_S1VAL_20_u2 1. _CNV_A_R_LINEAR_____319_CM 0. 1. FORMAT "%8.5" /end CHARACTERISTIC
/begin CHARACTERISTIC Cxx_tkof_acs_dsb_rwhs_t "Time constant of vehicle speed filter in rear wheel speed configuration" VALUE 0xa0021ff3 _REC_S1VAL_20_u1 2.55 _CNV_A_R_LINEAR_____32_CM 0. 2.55 FORMAT "%4.2" /end CHARACTERISTIC
/begin CHARACTERISTIC Cxx_tkof_acs_dsb_tqe_sp_rat "Minimum driver torque/maximum torque ratio to request accessories deactivation in takeoff strategy" VALUE 0xa0021fca _REC_S1VAL_20_u2 255.99609375 _CNV_A_R_LINEAR_____29_CM 0. 255.99609375 FORMAT "%10.6" /end CHARACTERISTIC
/begin CHARACTERISTIC Cxx_tkof_acs_dsb_vs "Maximum vehicle speed to request accessories deactivation in takeoff strategy" VALUE 0xa0021fcc _REC_S1VAL_20_u2 655.35 _CNV_A_R_LINEAR_____125_CM 0. 655.35 FORMAT "%6.2" /end CHARACTERISTIC
/begin CHARACTERISTIC Cxx_tkof_acs_dsb_vs_pos_slop "Maximum vehicle acceleration on takeoff" VALUE 0xa0021ff4 _REC_S1VAL_20_u1 255. _CNV_A_R_LINEAR_____353_CM 0. 255. FORMAT "%3.0" /end CHARACTERISTIC
/begin CHARACTERISTIC Cxx_tkof_acs_ena_pwt_sp "Maximum driver powertrain setpoint to request accessories reactivation in takeoff strategy" VALUE 0xa0021fce _REC_S1VAL_20_u2 1. _CNV_A_R_LINEAR_____319_CM 0. 1. FORMAT "%8.5" /end CHARACTERISTIC
/begin CHARACTERISTIC Cxx_tkof_acs_ena_vs "Minimum vehicle speed to request accessories reactivation in takeoff strategy" VALUE 0xa0021fd0 _REC_S1VAL_20_u2 655.35 _CNV_A_R_LINEAR_____125_CM 0. 655.35 FORMAT "%6.2" /end CHARACTERISTIC
/begin CHARACTERISTIC Cxx_tkof_acs_ena_zero_vs "Vehicle speed (0 km/h) to prevent accessories deactivation on no-load accelerations in takeoff strategy" VALUE 0xa0021fd2 _REC_S1VAL_20_u2 655.35 _CNV_A_R_LINEAR_____125_CM 0. 655.35 FORMAT "%6.2" /end CHARACTERISTIC
/begin CHARACTERISTIC Cxx_tkof_alt_ac_amp_h_thd "Atmospheric pressure threshold to inhibit takeoff strategy for alternator and air conditioning" VALUE 0xa0021fd4 _REC_S1VAL_20_u2 20000. _CNV_A_R_LINEAR_____115_CM 0. 20000. FORMAT "%5.0" /end CHARACTERISTIC
/begin CHARACTERISTIC Cxx_tkof_alt_ac_amp_l_thd "Atmospheric pressure threshold to activate takeoff strategy for alternator and air conditioning" VALUE 0xa0021fd6 _REC_S1VAL_20_u2 20000. _CNV_A_R_LINEAR_____115_CM 0. 20000. FORMAT "%5.0" /end CHARACTERISTIC
/begin MEASUREMENT Vxx_fuel_lvl_mem_NVM "Memorized value of the fuel level" UBYTE _CNV_A_R_LINEAR_____65_CM 1 0. 0. 80. DISPLAY_IDENTIFIER InCbiFui_NVM.Vxx_fuel_lvl_mem_NVM ECU_ADDRESS 0xd0007b49 FORMAT "%3.0" /end MEASUREMENT
/begin MEASUREMENT Vbx_min_fuel "Filtered minimum fuel level detected" UBYTE _CNV_S_2_RANGE______3_CM 1 0. 0. 1. ECU_ADDRESS 0xd0006b23 BIT_MASK 0x1 /end MEASUREMENT
/begin MEASUREMENT Vsx_min_fuel_vld "Minimum fuel level validity status" UBYTE _CNV_S_2_STATUS_OK__269_CM 1 0. 0. 1. ECU_ADDRESS 0xd0006b24 /end MEASUREMENT
/begin MEASUREMENT Vxx_min_fuel_dly "Temporization for the validation of minimum gas tank level" UWORD _CNV_A_R_LINEAR_____32_CM 1 0. 0. 655.35 ECU_ADDRESS 0xd0005eb6 FORMAT "%6.2" /end MEASUREMENT
/begin CHARACTERISTIC Cxx_min_fuel_dly "Minimum duration for the validation of minimum gas tank level" VALUE 0xa002135c _REC_S1VAL_20_u2 655.35 _CNV_A_R_LINEAR_____32_CM 0. 655.35 FORMAT "%6.2" /end CHARACTERISTIC
/begin CHARACTERISTIC Cxx_no_min_fuel_dly "Minimum duration for the devalidation of minimum gas tank level" VALUE 0xa002135e _REC_S1VAL_20_u2 655.35 _CNV_A_R_LINEAR_____32_CM 0. 655.35 FORMAT "%6.2" /end CHARACTERISTIC
/begin MEASUREMENT Vxx_pump_tql "pump torque losses" UWORD _CNV_A_R_LINEAR_____181_CM 1 0. 0. 2047.96875 ECU_ADDRESS 0xd0005eb8 FORMAT "%10.5" /end MEASUREMENT
/begin MEASUREMENT Vbx_sens_rvac_cfm "Differential tank pressure sensor present or not" UBYTE _CNV_S_2_RANGE______3_CM 1 0. 0. 1. ECU_ADDRESS 0xd0007b66 BIT_MASK 0x1 /end MEASUREMENT
/begin CHARACTERISTIC Cbx_sens_rvac_cfm "Differential tank pressure present or not" VALUE 0xa0021360 _REC_S1VAL_20_u1 1. _CNV_A_R_ECME_LINEA_0_CM 0. 1. FORMAT "%1.0" BIT_MASK 0x1 /end CHARACTERISTIC
/begin MEASUREMENT Vsx_fuel_lvl_vld "Petrol tank reserve validity status" UBYTE _CNV_S_8_STATUS_OK__234_CM 1 0. 0. 7. ECU_ADDRESS 0xd0007b5f /end MEASUREMENT
/begin MEASUREMENT Vxx_fuel_lvl "Petrol tank reserve" UBYTE _CNV_A_R_LINEAR_____65_CM 1 0. 0. 80. ECU_ADDRESS 0xd0007b60 FORMAT "%3.0" /end MEASUREMENT
/begin MEASUREMENT Vsx_sens_rvac_vld "Tank differential pressure sensor validity status" UBYTE _CNV_S_2_STATUS_OK__269_CM 1 0. 0. 1. ECU_ADDRESS 0xd0007b67 /end MEASUREMENT
/begin CHARACTERISTIC Cxx_dfdec_sens_rvc_h "Tank differential pressure sensor high signal detected failure counter decrement" VALUE 0xa0021362 _REC_S1VAL_20_u2 65535. _CNV_A_R_ECME_LINEA_0_CM 0. 65535. FORMAT "%5.0" /end CHARACTERISTIC
/begin CHARACTERISTIC Cxx_dfdec_sens_rvc_l "Tank differential pressure sensor low signal detected failure counter decrement" VALUE 0xa0021364 _REC_S1VAL_20_u2 65535. _CNV_A_R_ECME_LINEA_0_CM 0. 65535. FORMAT "%5.0" /end CHARACTERISTIC
/begin CHARACTERISTIC Cxx_dfdec_sens_rvc_nok "Tank differential pressure sensor noisy signal detected failure counter decrement" VALUE 0xa0021366 _REC_S1VAL_20_u2 65535. _CNV_A_R_ECME_LINEA_0_CM 0. 65535. FORMAT "%5.0" /end CHARACTERISTIC
/begin CHARACTERISTIC Cxx_dfdec_sens_rvc_sig_mcut "Tank differential pressure sensor constant signal detected failure counter decrement" VALUE 0xa0021368 _REC_S1VAL_20_u2 65535. _CNV_A_R_ECME_LINEA_0_CM 0. 65535. FORMAT "%5.0" /end CHARACTERISTIC
/begin CHARACTERISTIC Cxx_dfinc_sens_rvc_h "Tank differential pressure sensor high signal detected failure counter increment" VALUE 0xa002136a _REC_S1VAL_20_u2 65535. _CNV_A_R_ECME_LINEA_0_CM 0. 65535. FORMAT "%5.0" /end CHARACTERISTIC
/begin CHARACTERISTIC Cxx_dfinc_sens_rvc_l "Tank differential pressure sensor low signal detected failure counter increment" VALUE 0xa002136c _REC_S1VAL_20_u2 65535. _CNV_A_R_ECME_LINEA_0_CM 0. 65535. FORMAT "%5.0" /end CHARACTERISTIC
/begin CHARACTERISTIC Cxx_dfinc_sens_rvc_nok "Tank differential pressure sensor noisy signal detected failure counter increment" VALUE 0xa002136e _REC_S1VAL_20_u2 65535. _CNV_A_R_ECME_LINEA_0_CM 0. 65535. FORMAT "%5.0" /end CHARACTERISTIC
/begin CHARACTERISTIC Cxx_dfinc_sens_rvc_sig_mcut "Tank differential pressure sensor constant signal detected failure counter increment" VALUE 0xa0021370 _REC_S1VAL_20_u2 65535. _CNV_A_R_ECME_LINEA_0_CM 0. 65535. FORMAT "%5.0" /end CHARACTERISTIC
/begin MEASUREMENT Vbx_fuel_fill_det "Tank filling detected" UBYTE _CNV_S_2_RANGE______3_CM 1 0. 0. 1. ECU_ADDRESS 0xd0007b56 BIT_MASK 0x1 /end MEASUREMENT
/begin MEASUREMENT Vbx_fuel_fill_max "Fuel gauge is at its maximum" UBYTE _CNV_S_2_RANGE______3_CM 1 0. 0. 1. ECU_ADDRESS 0xd0007b57 BIT_MASK 0x1 /end MEASUREMENT
/begin MEASUREMENT Vbx_fuel_lvl_chk "Indicate that the fuel level is currently checked" UBYTE _CNV_S_2_RANGE______3_CM 1 0. 0. 1. ECU_ADDRESS 0xd0007b58 BIT_MASK 0x1 /end MEASUREMENT
/begin MEASUREMENT Vbx_fuel_lvl_stop_chk "The conditions are satisfied to update the fuel level _stop" UBYTE _CNV_S_2_RANGE______3_CM 1 0. 0. 1. ECU_ADDRESS 0xd0007b59 BIT_MASK 0x1 /end MEASUREMENT
/begin MEASUREMENT Vbx_vh_stop "Indicate that the vehicule is stabilized (strengthen information)" UBYTE _CNV_S_2_RANGE______3_CM 1 0. 0. 1. ECU_ADDRESS 0xd0007b5a BIT_MASK 0x1 /end MEASUREMENT
/begin MEASUREMENT Vsx_fuel_fill_det_vld "Filling detection validity status" UBYTE _CNV_S_8_STATUS_OK__234_CM 1 0. 0. 7. ECU_ADDRESS 0xd0007b5b /end MEASUREMENT
/begin MEASUREMENT Vxx_fuel_fill_det_thd "Tank filling detection threshold" UBYTE _CNV_A_R_LINEAR_____65_CM 1 0. 0. 80. ECU_ADDRESS 0xd0007b5c FORMAT "%3.0" /end MEASUREMENT
/begin MEASUREMENT Vxx_fuel_lvl_chk "Value of the fuel level at start or at take off" UBYTE _CNV_A_R_LINEAR_____65_CM 1 0. 0. 80. ECU_ADDRESS 0xd0007b5d FORMAT "%3.0" /end MEASUREMENT
/begin MEASUREMENT Vxx_fuel_lvl_stop "Value of the fuel level at stop, with stabilized vehicle" UBYTE _CNV_A_R_LINEAR_____65_CM 1 0. 0. 80. ECU_ADDRESS 0xd0007b5e FORMAT "%3.0" /end MEASUREMENT
/begin CHARACTERISTIC Cxx_aftr_sta_dly "Time after engine start during which the fuel level is checked" VALUE 0xa0021356 _REC_S1VAL_20_u1 102. _CNV_A_R_LINEAR_____354_CM 0. 102. FORMAT "%5.1" /end CHARACTERISTIC
/begin CHARACTERISTIC Cxx_fuel_fill_det_fac "Factor applied to the level at stop , to compute the fuel filling detection threshold" VALUE 0xa0021357 _REC_S1VAL_20_u1 0.99609375 _CNV_A_R_LINEAR_____153_CM 1. 1.99609375 FORMAT "%10.8" /end CHARACTERISTIC
/begin CHARACTERISTIC Cxx_fuel_fill_det_ofs "Offset applied to the level at stop, to compute the fuel filling detection threshold" VALUE 0xa0021358 _REC_S1VAL_20_u1 80. _CNV_A_R_LINEAR_____65_CM 0. 80. FORMAT "%3.0" /end CHARACTERISTIC
/begin CHARACTERISTIC Cxx_fuel_lvl_ini "Value of the fuel level after resets or programmings" VALUE 0xa0021359 _REC_S1VAL_20_u1 80. _CNV_A_R_LINEAR_____65_CM 0. 80. FORMAT "%3.0" /end CHARACTERISTIC
/begin CHARACTERISTIC Cxx_fuel_lvl_max "Max fuel level measurable by fuel gauge" VALUE 0xa002135a _REC_S1VAL_20_u1 80. _CNV_A_R_LINEAR_____65_CM 0. 80. FORMAT "%3.0" /end CHARACTERISTIC
/begin CHARACTERISTIC Cxx_is_stop_dly "Time to stay in idle speed before updated the level at take off" VALUE 0xa0021354 _REC_S1VAL_20_u2 26214. _CNV_A_R_LINEAR_____354_CM 0. 26214. FORMAT "%7.1" /end CHARACTERISTIC
/begin CHARACTERISTIC Cxx_vh_stop_dly "Time needed to consider that the fuel level is stabilized" VALUE 0xa002135b _REC_S1VAL_20_u1 102. _CNV_A_R_LINEAR_____354_CM 0. 102. FORMAT "%5.1" /end CHARACTERISTIC
/begin MEASUREMENT Vbx_min_fuel2 "Minimum fuel level of the additional tank detected" UBYTE _CNV_S_2_RANGE______3_CM 1 0. 0. 1. ECU_ADDRESS 0xd0007b48 BIT_MASK 0x1 /end MEASUREMENT
/begin AXIS_PTS Ctb_alt_n_fil_fac "Engine speed breakpoints to filter alternator torque and power" 0xa002dcd0 Vxx_n_mv _REC_A2AXS_20_u2 16383.75 _CNV_A_R_ENSD_LINEA_22_CM 8 0. 16383.75 FORMAT "%8.2" /end AXIS_PTS
/begin AXIS_PTS Ctb_alt_pow "Alternator power breakpoints" 0xa002dce4 Vxx_no_cor_raw_alt_pow _REC_A2AXS_20_u2 655350. _CNV_A_R_LINEAR_____186_CM 9 0. 655350. FORMAT "%6.0" /end AXIS_PTS
/begin AXIS_PTS Ctb_alt_pow_cor_n "Engine speed breakpoints for alternator power correction" 0xa002dcf8 Vxx_n_mv _REC_A2AXS_20_u2 16383.75 _CNV_A_R_ENSD_LINEA_22_CM 9 0. 16383.75 FORMAT "%8.2" /end AXIS_PTS
/begin CHARACTERISTIC Cmp_alt_pow_cor_val "Cartography to compute alternator power corrected value" MAP 0xa002dd0c _REC_A1MAP_20_u2_u2_u2 655350. _CNV_A_R_LINEAR_____186_CM 0. 655350. FORMAT "%6.0"
 /begin AXIS_DESCR COM_AXIS Vxx_no_cor_raw_alt_pow _CNV_A_R_LINEAR_____186_CM 9 0. 655350. FORMAT "%6.0" AXIS_PTS_REF Ctb_alt_pow /end AXIS_DESCR
 /begin AXIS_DESCR COM_AXIS Vxx_n_mv _CNV_A_R_ENSD_LINEA_22_CM 9 0. 16383.75 FORMAT "%8.2" AXIS_PTS_REF Ctb_alt_pow_cor_n /end AXIS_DESCR
/end CHARACTERISTIC
/begin CHARACTERISTIC Ctp_alt_pow_fil_fac "filter factor for alternator power" CURVE 0xa002ddb0 _REC_A1CUR_20_u2_u2 1. _CNV_A_R_LINEAR_____161_CM 0. 1. FORMAT "%5.3"
 /begin AXIS_DESCR COM_AXIS Vxx_n_mv _CNV_A_R_ENSD_LINEA_22_CM 8 0. 16383.75 FORMAT "%8.2" AXIS_PTS_REF Ctb_alt_n_fil_fac /end AXIS_DESCR
/end CHARACTERISTIC
/begin MEASUREMENT Vbx_alt_pow_trs "Alternator power transitional detection" UBYTE _CNV_S_2_RANGE______3_CM 1 0. 0. 1. ECU_ADDRESS 0xd0007c17 BIT_MASK 0x1 /end MEASUREMENT
/begin MEASUREMENT Vsx_alt_pow_vld "Alternator mechanical power validity status" UBYTE _CNV_S_3_STATUS_OK__179_CM 1 0. 0. 2. ECU_ADDRESS 0xd0007c18 /end MEASUREMENT
/begin MEASUREMENT Vsx_fil_alt_pow_vld "Filtered  Alternator torque load validity status" UBYTE _CNV_S_3_STATUS_OK__179_CM 1 0. 0. 2. ECU_ADDRESS 0xd0006d36 /end MEASUREMENT
/begin MEASUREMENT Vxx_alt_pow "Alternator mechanical power" UWORD _CNV_A_R_LINEAR_____186_CM 1 0. 0. 655350. ECU_ADDRESS 0xd0005f5a FORMAT "%6.0" /end MEASUREMENT
/begin MEASUREMENT Vxx_alt_pow_fil_fac "Alternator power filtering factor" UWORD _CNV_A_R_LINEAR_____161_CM 1 0. 0. 1. ECU_ADDRESS 0xd0005f5c FORMAT "%5.3" /end MEASUREMENT
/begin MEASUREMENT Vxx_alt_pow_load "Alternator power load" UWORD _CNV_A_R_LINEAR_____186_CM 1 0. 0. 655350. ECU_ADDRESS 0xd0005f5e FORMAT "%6.0" /end MEASUREMENT
/begin MEASUREMENT Vxx_fil_alt_pow "Filtered alternator mechanical power" UWORD _CNV_A_R_LINEAR_____186_CM 1 0. 0. 655350. ECU_ADDRESS 0xd0004490 FORMAT "%6.0" /end MEASUREMENT
/begin MEASUREMENT Vxx_fil_alt_pow_load_trs "Alternator filtered power used for transitional detection" UWORD _CNV_A_R_LINEAR_____186_CM 1 0. 0. 655350. ECU_ADDRESS 0xd0005f60 FORMAT "%6.0" /end MEASUREMENT
/begin MEASUREMENT Vxx_no_cor_raw_alt_pow "Not corrected alternator power" UWORD _CNV_A_R_LINEAR_____186_CM 1 0. 0. 655350. ECU_ADDRESS 0xd0004492 FORMAT "%6.0" /end MEASUREMENT
/begin CHARACTERISTIC Cbx_sens_alt_pwm_pres_cfm "Configuration of alternator with alternator load availability (DF alternator or BSS alternator type)" VALUE 0xa002170c _REC_S1VAL_20_u1 1. _CNV_A_R_ECME_LINEA_0_CM 0. 1. FORMAT "%1.0" BIT_MASK 0x1 /end CHARACTERISTIC
/begin CHARACTERISTIC Cxx_alt_pow_dsb_fil_fac "Value when the 1st filter is disabled" VALUE 0xa0021702 _REC_S1VAL_20_u2 1. _CNV_A_R_LINEAR_____161_CM 0. 1. FORMAT "%5.3" /end CHARACTERISTIC
/begin CHARACTERISTIC Cxx_alt_pow_trs_dif_thd "Alternator power transitional detection threshold" VALUE 0xa0021704 _REC_S1VAL_20_u2 655350. _CNV_A_R_LINEAR_____186_CM 0. 655350. FORMAT "%6.0" /end CHARACTERISTIC
/begin CHARACTERISTIC Cxx_alt_pow_trs_fil_dec "Filtering factor used to detect a decreasing alternator power value" VALUE 0xa0021706 _REC_S1VAL_20_u2 1. _CNV_A_R_LINEAR_____161_CM 0. 1. FORMAT "%5.3" /end CHARACTERISTIC
/begin CHARACTERISTIC Cxx_alt_pow_trs_fil_inc "Filtering factor used to detect an increasing alternator power value" VALUE 0xa0021708 _REC_S1VAL_20_u2 1. _CNV_A_R_LINEAR_____161_CM 0. 1. FORMAT "%5.3" /end CHARACTERISTIC
/begin CHARACTERISTIC Cxx_alt_slop_dly "Alternator power ramp on initialisation" VALUE 0xa002170a _REC_S1VAL_20_u2 655.35 _CNV_A_R_LINEAR_____32_CM 0. 655.35 FORMAT "%6.2" /end CHARACTERISTIC
/begin CHARACTERISTIC Cxx_sta_alt_dec "Alternator power min slew rate after start" VALUE 0xa002170d _REC_S1VAL_20_u1 2550. _CNV_A_R_LINEAR_____355_CM -2550. 0. FORMAT "%5.0" /end CHARACTERISTIC
/begin CHARACTERISTIC Cxx_sta_alt_inc "Alternator power max slew rate after start" VALUE 0xa002170e _REC_S1VAL_20_u1 2550. _CNV_A_R_LINEAR_____356_CM 0. 2550. FORMAT "%5.0" /end CHARACTERISTIC
/begin MEASUREMENT Vsx_mdl_alt_pow_vld "Modelised alternator power validity status" UBYTE _CNV_A_R_ECME_LINEA_0_CM 1 0. 0. 255. ECU_ADDRESS 0xd0006d37 FORMAT "%3.0" /end MEASUREMENT
/begin MEASUREMENT Vxx_mdl_alt_pow "Modelised alternator power calculated through lrotor" UWORD _CNV_A_R_LINEAR_____186_CM 1 0. 0. 655350. ECU_ADDRESS 0xd0004496 FORMAT "%6.0" /end MEASUREMENT
/begin AXIS_PTS Ctb_ac_pow "Air conditioning power breakpoints" 0xa002dbf0 Vxx_no_cor_raw_ac_pow _REC_A2AXS_20_u2 655350. _CNV_A_R_LINEAR_____186_CM 9 0. 655350. FORMAT "%6.0" /end AXIS_PTS
/begin AXIS_PTS Ctb_ac_pow_cor_n "Air conditioning power breakpoints" 0xa002dc04 Vxx_n _REC_A2AXS_20_u2 16383.75 _CNV_A_R_ENSD_LINEA_22_CM 9 0. 16383.75 FORMAT "%8.2" /end AXIS_PTS
/begin CHARACTERISTIC Cmp_ac_pow_cor_val "Cartography to compute air conditioning power corrected value" MAP 0xa002dc18 _REC_A1MAP_20_u2_u2_u2 655350. _CNV_A_R_LINEAR_____186_CM 0. 655350. FORMAT "%6.0"
 /begin AXIS_DESCR COM_AXIS Vxx_no_cor_raw_ac_pow _CNV_A_R_LINEAR_____186_CM 9 0. 655350. FORMAT "%6.0" AXIS_PTS_REF Ctb_ac_pow /end AXIS_DESCR
 /begin AXIS_DESCR COM_AXIS Vxx_n _CNV_A_R_ENSD_LINEA_22_CM 9 0. 16383.75 FORMAT "%8.2" AXIS_PTS_REF Ctb_ac_pow_cor_n /end AXIS_DESCR
/end CHARACTERISTIC
/begin CHARACTERISTIC Ctp_ac_pow_dft_val "Cartography to compute air conditioning power default value" CURVE 0xa002dcbc _REC_A1CUR_20_u2_u2 655350. _CNV_A_R_LINEAR_____186_CM 0. 655350. FORMAT "%6.0"
 /begin AXIS_DESCR COM_AXIS Vxx_n _CNV_A_R_ENSD_LINEA_22_CM 9 0. 16383.75 FORMAT "%8.2" AXIS_PTS_REF Ctb_n2 /end AXIS_DESCR
/end CHARACTERISTIC
/begin MEASUREMENT Vxx_ac_pow "Air conditioning absorbed power (compressor)" UWORD _CNV_A_R_LINEAR_____186_CM 1 0. 0. 655350. ECU_ADDRESS 0xd0004466 FORMAT "%6.0" /end MEASUREMENT
/begin MEASUREMENT Vxx_no_cor_raw_ac_pow "Not corrected air conditioning power" UWORD _CNV_A_R_LINEAR_____186_CM 1 0. 0. 655350. ECU_ADDRESS 0xd0004468 FORMAT "%6.0" /end MEASUREMENT
/begin MEASUREMENT Vxx_raw_ac_pow "Air conditioning power not taking into account compressor state" UWORD _CNV_A_R_LINEAR_____186_CM 1 0. 0. 655350. ECU_ADDRESS 0xd000446a FORMAT "%6.0" /end MEASUREMENT
/begin MEASUREMENT Vsx_mdl_ac_pow_vld "Air conditioning power received from model validity status" UBYTE _CNV_S_3_STATUS_OK__179_CM 1 0. 0. 2. ECU_ADDRESS 0xd0006d16 /end MEASUREMENT
/begin MEASUREMENT Vxx_mdl_ac_pow "Air conditioning power received from model" UWORD _CNV_A_R_LINEAR_____186_CM 1 0. 0. 655350. ECU_ADDRESS 0xd000446c FORMAT "%6.0" /end MEASUREMENT
/begin CHARACTERISTIC Cxx_ac_pow_max "Maximum AC absorbed power" VALUE 0xa00216ca _REC_S1VAL_20_u2 655350. _CNV_A_R_LINEAR_____186_CM 0. 655350. FORMAT "%6.0" /end CHARACTERISTIC
/begin CHARACTERISTIC Cxx_ac_pow_min "Minimum AC absorbed power" VALUE 0xa00216cc _REC_S1VAL_20_u2 655350. _CNV_A_R_LINEAR_____186_CM 0. 655350. FORMAT "%6.0" /end CHARACTERISTIC
/begin CHARACTERISTIC Cxx_ac_pow_n_fac "B coefficient to calculate the AC absorbed power" VALUE 0xa00216ce _REC_S1VAL_20_u2 4.99992370605469 _CNV_A_R_LINEAR_____357_CM 0. 4.99992370605469 FORMAT "%1.16" /end CHARACTERISTIC
/begin CHARACTERISTIC Cxx_ac_pow_prs_fac "A coefficient to calculate the AC absorbed power" VALUE 0xa00216d0 _REC_S1VAL_20_u2 6553.5 _CNV_A_R_LINEAR_____358_CM 0. 6553.5 FORMAT "%6.1" /end CHARACTERISTIC
/begin CHARACTERISTIC Cxx_ac_pow_prs_n_fac "C coefficient to calculate the AC absorbed power" VALUE 0xa00216d2 _REC_S1VAL_20_u2 4.99992370605469 _CNV_A_R_LINEAR_____359_CM 0. 4.99992370605469 FORMAT "%1.16" /end CHARACTERISTIC
/begin CHARACTERISTIC Cxx_acr_eng_fac "Compressor driving ratio (on engine)" VALUE 0xa00216d4 _REC_S1VAL_20_u1 2.55 _CNV_A_R_LINEAR_____123_CM 0. 2.55 FORMAT "%4.2" /end CHARACTERISTIC
/begin MEASUREMENT Vxx_el_csm_mdl_pow "Electrical consumer modelised power" UWORD _CNV_A_R_LINEAR_____186_CM 1 0. 0. 655350. ECU_ADDRESS 0xd0004494 FORMAT "%6.0" /end MEASUREMENT
/begin CHARACTERISTIC Cxx_alt_is_meca_pow "Alternator idle speed mechanical power" VALUE 0xa0021710 _REC_S1VAL_20_u2 655350. _CNV_A_R_LINEAR_____186_CM 0. 655350. FORMAT "%6.0" /end CHARACTERISTIC
/begin CHARACTERISTIC Cxx_el_bk_wind_meca_pow "Electric backlite mechanical power" VALUE 0xa0021712 _REC_S1VAL_20_u2 655350. _CNV_A_R_LINEAR_____186_CM 0. 655350. FORMAT "%6.0" /end CHARACTERISTIC
/begin CHARACTERISTIC Cxx_el_wind_meca_pow "Electrical windshield mechanical power" VALUE 0xa0021714 _REC_S1VAL_20_u2 655350. _CNV_A_R_LINEAR_____186_CM 0. 655350. FORMAT "%6.0" /end CHARACTERISTIC
/begin CHARACTERISTIC Cxx_eng_loss_pow_min "Minimum mechanical power due to electrical consumers" VALUE 0xa0021716 _REC_S1VAL_20_u2 655350. _CNV_A_R_LINEAR_____186_CM 0. 655350. FORMAT "%6.0" /end CHARACTERISTIC
/begin CHARACTERISTIC Cxx_mdf1_meca_pow "Power consumed by cooling fan moving in first speed" VALUE 0xa0021718 _REC_S1VAL_20_u2 655350. _CNV_A_R_LINEAR_____186_CM 0. 655350. FORMAT "%6.0" /end CHARACTERISTIC
/begin CHARACTERISTIC Cxx_mdf2_meca_pow "Power consumed by cooling fan moving in second speed" VALUE 0xa002171a _REC_S1VAL_20_u2 655350. _CNV_A_R_LINEAR_____186_CM 0. 655350. FORMAT "%6.0" /end CHARACTERISTIC
/begin CHARACTERISTIC Cxx_rgb_pump_meca_pow "Robotized gearbox electro hydraulical pump mechanical power" VALUE 0xa002171c _REC_S1VAL_20_u2 655350. _CNV_A_R_LINEAR_____186_CM 0. 655350. FORMAT "%6.0" /end CHARACTERISTIC
/begin MEASUREMENT Vxx_ptc_pow "PTC power consumed" UWORD _CNV_A_R_LINEAR_____186_CM 1 0. 0. 655350. ECU_ADDRESS 0xd0005f62 FORMAT "%6.0" /end MEASUREMENT
/begin AXIS_PTS Ctb_ac_pow_cor "Breakpoints to compute air conditioning power correction" 0xa002dbc8 Vxx_raw_ac_pow _REC_A2AXS_20_u2 655350. _CNV_A_R_LINEAR_____186_CM 9 0. 655350. FORMAT "%6.0" /end AXIS_PTS
/begin CHARACTERISTIC Ctp_ac_pow_cor "Cartography to compute air conditioning power correction" CURVE 0xa002dbdc _REC_A1CUR_20_u2_u2 655350. _CNV_A_R_LINEAR_____186_CM 0. 655350. FORMAT "%6.0"
 /begin AXIS_DESCR COM_AXIS Vxx_raw_ac_pow _CNV_A_R_LINEAR_____186_CM 9 0. 655350. FORMAT "%6.0" AXIS_PTS_REF Ctb_ac_pow_cor /end AXIS_DESCR
/end CHARACTERISTIC
/begin MEASUREMENT Vxx_ac_pow_cor "Air conditioning power correction for idle speed regulation" UWORD _CNV_A_R_LINEAR_____186_CM 1 0. 0. 655350. ECU_ADDRESS 0xd0004464 FORMAT "%6.0" /end MEASUREMENT
/begin CHARACTERISTIC Cxx_ac_pow_cor_dly "Air conditioning power correction slope" VALUE 0xa00216c6 _REC_S1VAL_20_u2 655.35 _CNV_A_R_LINEAR_____32_CM 0. 655.35 FORMAT "%6.2" /end CHARACTERISTIC
/begin CHARACTERISTIC Cxx_ac_pow_cor_slop "Duration of air conditioning power correction before decrementation" VALUE 0xa00216c8 _REC_S1VAL_20_u2 655350. _CNV_A_R_LINEAR_____356_CM 0. 655350. FORMAT "%6.0" /end CHARACTERISTIC
/begin MEASUREMENT Vbx_alt_pwm_dft "Alternator load failure" UBYTE _CNV_S_2_RANGE______3_CM 1 0. 0. 1. ECU_ADDRESS 0xd0007c13 BIT_MASK 0x1 /end MEASUREMENT
/begin MEASUREMENT Vbx_ptc_pow_dec "PTC power decrease detected. Leads to current PTC power correction interuption." UBYTE _CNV_S_2_RANGE______3_CM 1 0. 0. 1. ECU_ADDRESS 0xd0007c14 BIT_MASK 0x1 /end MEASUREMENT
/begin MEASUREMENT Vbx_ptc_pow_inc "PTC power increase detected. Leads to PTC power correction activation" UBYTE _CNV_S_2_RANGE______3_CM 1 0. 0. 1. ECU_ADDRESS 0xd0007c15 BIT_MASK 0x1 /end MEASUREMENT
/begin MEASUREMENT Vbx_pwst_off_dly "Vbx_pwst_prs_stt has been off since Cxx_pwst_off_is_cor_dly" UBYTE _CNV_S_2_RANGE______3_CM 1 0. 0. 1. ECU_ADDRESS 0xd0007c16 BIT_MASK 0x1 /end MEASUREMENT
/begin MEASUREMENT Vxx_alt_pow_cor "Electrical consumer modelised power correction for activation" UWORD _CNV_A_R_LINEAR_____186_CM 1 0. 0. 655350. ECU_ADDRESS 0xd0005f44 FORMAT "%6.0" /end MEASUREMENT
/begin MEASUREMENT Vxx_el_bk_pow_cor "Electric backlite power correction" UWORD _CNV_A_R_LINEAR_____186_CM 1 0. 0. 655350. ECU_ADDRESS 0xd0005f46 FORMAT "%6.0" /end MEASUREMENT
/begin MEASUREMENT Vxx_el_wind_pow_cor "Electric windshield power correction" UWORD _CNV_A_R_LINEAR_____186_CM 1 0. 0. 655350. ECU_ADDRESS 0xd0005f48 FORMAT "%6.0" /end MEASUREMENT
/begin MEASUREMENT Vxx_mdf1_pow_cor "low engine speed fan power correction" UWORD _CNV_A_R_LINEAR_____186_CM 1 0. 0. 655350. ECU_ADDRESS 0xd0005f4a FORMAT "%6.0" /end MEASUREMENT
/begin MEASUREMENT Vxx_mdf2_pow_cor "High engine speed fan power correction" UWORD _CNV_A_R_LINEAR_____186_CM 1 0. 0. 655350. ECU_ADDRESS 0xd0005f4c FORMAT "%6.0" /end MEASUREMENT
/begin MEASUREMENT Vxx_ptc_pow_cor "PTC power correction" UWORD _CNV_A_R_LINEAR_____186_CM 1 0. 0. 655350. ECU_ADDRESS 0xd0005f4e FORMAT "%6.0" /end MEASUREMENT
/begin MEASUREMENT Vxx_ptc_pow_cor_dly "Remaining duration of PTC power correction" UWORD _CNV_A_R_LINEAR_____32_CM 1 0. 0. 655.35 ECU_ADDRESS 0xd0005f50 FORMAT "%6.2" /end MEASUREMENT
/begin MEASUREMENT Vxx_ptc_pow_cor_dly1 "Remaining time before PTC power correction activation" UWORD _CNV_A_R_LINEAR_____32_CM 1 0. 0. 655.35 ECU_ADDRESS 0xd0005f52 FORMAT "%6.2" /end MEASUREMENT
/begin MEASUREMENT Vxx_ptc_pow_inc "PTC power increase value used to compute PTC power correction." UWORD _CNV_A_R_LINEAR_____186_CM 1 0. 0. 655350. ECU_ADDRESS 0xd0005f54 FORMAT "%6.0" /end MEASUREMENT
/begin MEASUREMENT Vxx_pwst_prs_pow_cor "Power steering manostat activation power correction" UWORD _CNV_A_R_LINEAR_____186_CM 1 0. 0. 655350. ECU_ADDRESS 0xd0005f56 FORMAT "%6.0" /end MEASUREMENT
/begin MEASUREMENT Vxx_rgb_pump_pow_cor "RGB power correction" UWORD _CNV_A_R_LINEAR_____186_CM 1 0. 0. 655350. ECU_ADDRESS 0xd0005f58 FORMAT "%6.0" /end MEASUREMENT
/begin CHARACTERISTIC Cxx_alt_pow_cor_slop "Alternator power correction slope" VALUE 0xa00216d6 _REC_S1VAL_20_u2 655350. _CNV_A_R_LINEAR_____356_CM 0. 655350. FORMAT "%6.0" /end CHARACTERISTIC
/begin CHARACTERISTIC Cxx_alt_pwm_dft_alt_pow_fac "Factor on alt.power corr. in case of alternator load failure" VALUE 0xa00216fe _REC_S1VAL_20_u1 1. _CNV_A_R_LINEAR_____162_CM 0. 1. FORMAT "%9.7" /end CHARACTERISTIC
/begin CHARACTERISTIC Cxx_alt_pwm_dft_pwst_pow_fac "Factor on PWSTpower corr. in case of alternator load failure" VALUE 0xa00216ff _REC_S1VAL_20_u1 1. _CNV_A_R_LINEAR_____162_CM 0. 1. FORMAT "%9.7" /end CHARACTERISTIC
/begin CHARACTERISTIC Cxx_el_bk_wind_dly "Duration before alternator (electric backlite) power correction activation" VALUE 0xa00216d8 _REC_S1VAL_20_u2 655.35 _CNV_A_R_LINEAR_____32_CM 0. 655.35 FORMAT "%6.2" /end CHARACTERISTIC
/begin CHARACTERISTIC Cxx_el_bk_wind_pow_cor "alternator power correction for electric backlite activation" VALUE 0xa00216da _REC_S1VAL_20_u2 655350. _CNV_A_R_LINEAR_____186_CM 0. 655350. FORMAT "%6.0" /end CHARACTERISTIC
/begin CHARACTERISTIC Cxx_el_bk_wind_pow_cor_dly "Duration of alternator (electric backlite) power correction before decrementation" VALUE 0xa00216dc _REC_S1VAL_20_u2 655.35 _CNV_A_R_LINEAR_____32_CM 0. 655.35 FORMAT "%6.2" /end CHARACTERISTIC
/begin CHARACTERISTIC Cxx_el_wind_dly "Duration before alternator (electric windshield) power correction activation" VALUE 0xa00216de _REC_S1VAL_20_u2 655.35 _CNV_A_R_LINEAR_____32_CM 0. 655.35 FORMAT "%6.2" /end CHARACTERISTIC
/begin CHARACTERISTIC Cxx_el_wind_pow_cor "alternator power correction for electric windshield activation" VALUE 0xa00216e0 _REC_S1VAL_20_u2 655350. _CNV_A_R_LINEAR_____186_CM 0. 655350. FORMAT "%6.0" /end CHARACTERISTIC
/begin CHARACTERISTIC Cxx_el_wind_pow_cor_dly "Duration of alternator (electric windshield) power correction before decrementation" VALUE 0xa00216e2 _REC_S1VAL_20_u2 655.35 _CNV_A_R_LINEAR_____32_CM 0. 655.35 FORMAT "%6.2" /end CHARACTERISTIC
/begin CHARACTERISTIC Cxx_mdf1_meca_pow_cor "alternator power correction for low engine speed fan activation" VALUE 0xa00216e4 _REC_S1VAL_20_u2 655350. _CNV_A_R_LINEAR_____186_CM 0. 655350. FORMAT "%6.0" /end CHARACTERISTIC
/begin CHARACTERISTIC Cxx_mdf1_meca_pow_cor_dly "Duration of alternator (MDF 1) power correction before decrementation" VALUE 0xa00216e6 _REC_S1VAL_20_u2 655.35 _CNV_A_R_LINEAR_____32_CM 0. 655.35 FORMAT "%6.2" /end CHARACTERISTIC
/begin CHARACTERISTIC Cxx_mdf2_meca_pow_cor "alternator power correction for high engine speed fan activation" VALUE 0xa00216e8 _REC_S1VAL_20_u2 655350. _CNV_A_R_LINEAR_____186_CM 0. 655350. FORMAT "%6.0" /end CHARACTERISTIC
/begin CHARACTERISTIC Cxx_mdf2_meca_pow_cor_dly "Duration of alternator (MDF 2) power correction before decrementation" VALUE 0xa00216ea _REC_S1VAL_20_u2 655.35 _CNV_A_R_LINEAR_____32_CM 0. 655.35 FORMAT "%6.2" /end CHARACTERISTIC
/begin CHARACTERISTIC Cxx_mdf_meca_pow_cor_dly1 "Duration before alternator (MDF) power correction activation" VALUE 0xa00216ec _REC_S1VAL_20_u2 655.35 _CNV_A_R_LINEAR_____32_CM 0. 655.35 FORMAT "%6.2" /end CHARACTERISTIC
/begin CHARACTERISTIC Cxx_ptc_meca_pow_cor_dly "Duration of alternator (PTC) power correction before decrementation" VALUE 0xa00216ee _REC_S1VAL_20_u2 655.35 _CNV_A_R_LINEAR_____32_CM 0. 655.35 FORMAT "%6.2" /end CHARACTERISTIC
/begin CHARACTERISTIC Cxx_ptc_meca_pow_cor_dly1 "Duration before alternator (PTC) power correction activation" VALUE 0xa00216f0 _REC_S1VAL_20_u2 655.35 _CNV_A_R_LINEAR_____32_CM 0. 655.35 FORMAT "%6.2" /end CHARACTERISTIC
/begin CHARACTERISTIC Cxx_ptc_meca_pow_cor_fac "Proportionnal factor on PTC power increase to compute alt.power corr. for PTC" VALUE 0xa0021700 _REC_S1VAL_20_u1 1. _CNV_A_R_LINEAR_____162_CM 0. 1. FORMAT "%9.7" /end CHARACTERISTIC
/begin CHARACTERISTIC Cxx_pwst_on_is_cor_dly "Duration of (PDA) power correction before decrementation" VALUE 0xa00216f2 _REC_S1VAL_20_u2 655.35 _CNV_A_R_LINEAR_____32_CM 0. 655.35 FORMAT "%6.2" /end CHARACTERISTIC
/begin CHARACTERISTIC Cxx_rgb_pump_pow_cor "alternator power correction for Robotized gearbox electro hydraulical pump activation" VALUE 0xa00216f4 _REC_S1VAL_20_u2 655350. _CNV_A_R_LINEAR_____186_CM 0. 655350. FORMAT "%6.0" /end CHARACTERISTIC
/begin CHARACTERISTIC Cxx_rgb_pump_pow_cor_dly "Duration of alternator (Robotized gearbox electro hydraulical pump) power correction before decrementation" VALUE 0xa00216f6 _REC_S1VAL_20_u2 655.35 _CNV_A_R_LINEAR_____32_CM 0. 655.35 FORMAT "%6.2" /end CHARACTERISTIC
/begin CHARACTERISTIC Cxx_rgb_pump_pow_cor_dly1 "Duration before alternator (RGB electro. hydrau. pump) power correction activation" VALUE 0xa00216f8 _REC_S1VAL_20_u2 655.35 _CNV_A_R_LINEAR_____32_CM 0. 655.35 FORMAT "%6.2" /end CHARACTERISTIC
/begin CHARACTERISTIC Cxx_vh_run_tmp_pwst_cor "Power correction for PDA, running vehicle" VALUE 0xa00216fa _REC_S1VAL_20_u2 655350. _CNV_A_R_LINEAR_____186_CM 0. 655350. FORMAT "%6.0" /end CHARACTERISTIC
/begin CHARACTERISTIC Cxx_vh_stop_tmp_pwst_cor "Power correction for PDA, stopped vehicle" VALUE 0xa00216fc _REC_S1VAL_20_u2 655350. _CNV_A_R_LINEAR_____186_CM 0. 655350. FORMAT "%6.0" /end CHARACTERISTIC
/begin MEASUREMENT Vbx_rgb_pump "Robotized gearbox pump activation" UBYTE _CNV_S_2_RANGE______3_CM 1 0. 0. 1. ECU_ADDRESS 0xd0006d3b BIT_MASK 0x1 /end MEASUREMENT
/begin CHARACTERISTIC Cxx_rgb_pump_act_dly "Delay before the authorization of the robotized gearbox pump activation." VALUE 0xa002171e _REC_S1VAL_20_u1 2.55 _CNV_A_R_LINEAR_____32_CM 0. 2.55 FORMAT "%4.2" /end CHARACTERISTIC
/begin MEASUREMENT Vxx_mdl_ptc_pow "Modelised PTC power" UWORD _CNV_A_R_LINEAR_____186_CM 1 0. 0. 655350. ECU_ADDRESS 0xd0005f64 FORMAT "%6.0" /end MEASUREMENT
/begin AXIS_PTS Ctb_min_max_forc_vs "Vehicle speed  breakpoints for mi/max force tables" 0xa002f0e4 Vxx_vs _REC_A2AXS_20_u2 655.35 _CNV_A_R_LINEAR_____125_CM 9 0. 655.35 FORMAT "%6.2" /end AXIS_PTS
/begin CHARACTERISTIC Ctp_max_forc "Max force table for force => powertrain setpoint conversion" CURVE 0xa002f0f8 _REC_A1CUR_20_u2_u2 131068. _CNV_A_R_LINEAR_____360_CM -20000. 111068. FORMAT "%6.0"
 /begin AXIS_DESCR COM_AXIS Vxx_vs _CNV_A_R_LINEAR_____125_CM 9 0. 655.35 FORMAT "%6.2" AXIS_PTS_REF Ctb_min_max_forc_vs /end AXIS_DESCR
/end CHARACTERISTIC
/begin CHARACTERISTIC Ctp_min_forc "Min force table for force => powertrain setpoint conversion" CURVE 0xa002f10c _REC_A1CUR_20_u2_u2 131068. _CNV_A_R_LINEAR_____360_CM -20000. 111068. FORMAT "%6.0"
 /begin AXIS_DESCR COM_AXIS Vxx_vs _CNV_A_R_LINEAR_____125_CM 9 0. 655.35 FORMAT "%6.2" AXIS_PTS_REF Ctb_min_max_forc_vs /end AXIS_DESCR
/end CHARACTERISTIC
/begin MEASUREMENT Vbx_cru_acc_virt_driv_on "Accelerator pedal request overrun by a cruise control virtual driver (CC/ACC only)" UBYTE _CNV_S_2_RANGE______3_CM 1 0. 0. 1. ECU_ADDRESS 0xd000700c BIT_MASK 0x1 /end MEASUREMENT
/begin MEASUREMENT Vbx_no_driv_pwt_sp "no powertrain setpoint requested by real (pedal) and virtual (ACC/CC/SL) drivers" UBYTE _CNV_S_2_RANGE______3_CM 1 0. 0. 1. ECU_ADDRESS 0xd000700d BIT_MASK 0x1 /end MEASUREMENT
/begin MEASUREMENT Vbx_virt_driv_on "Accelerator pedal request overrun by a virtual driver (CC/SL/ACC)" UBYTE _CNV_S_2_RANGE______3_CM 1 0. 0. 1. ECU_ADDRESS 0xd000700e BIT_MASK 0x1 /end MEASUREMENT
/begin MEASUREMENT Vsx_driv_pwt_sp_vld "Powertrain setpoint (%) requested by real (pedal) and virtual (ACC/CC/SL) drivers validity status" UBYTE _CNV_A_R_ECME_LINEA_0_CM 1 0. 0. 255. ECU_ADDRESS 0xd000700f FORMAT "%3.0" /end MEASUREMENT
/begin MEASUREMENT Vxx_acc_pwt_sp "Powertrain setpoint (%) requested by ACC" UWORD _CNV_A_R_LINEAR_____238_CM 1 0. 0. 1. ECU_ADDRESS 0xd000470a FORMAT "%7.5" /end MEASUREMENT
/begin MEASUREMENT Vxx_acel_pdl_forc_sp "Driving force requested by the driver via the accelerator pedal" SLONG _CNV_A_R_LINEAR_____361_CM 1 0. -20000. 111068. ECU_ADDRESS 0xd0002aa4 FORMAT "%6.0" /end MEASUREMENT
/begin MEASUREMENT Vxx_arb_driv_pwt_sp "Powertrain setpoint (%) requested by real (pedal) and virtual (ACC/CC/SL) drivers before foot-up correction" UWORD _CNV_A_R_LINEAR_____238_CM 1 0. 0. 1. ECU_ADDRESS 0xd000470c FORMAT "%7.5" /end MEASUREMENT
/begin MEASUREMENT Vxx_cru_pwt_sp "Powertrain setpoint (%) requested by Cruise Control" UWORD _CNV_A_R_LINEAR_____238_CM 1 0. 0. 1. ECU_ADDRESS 0xd000470e FORMAT "%7.5" /end MEASUREMENT
/begin MEASUREMENT Vxx_driv_pwt_sp "Powertrain setpoint (%) requested by real (pedal) and virtual (ACC/CC/SL) drivers" UWORD _CNV_A_R_LINEAR_____238_CM 1 0. 0. 1. ECU_ADDRESS 0xd0004710 FORMAT "%7.5" /end MEASUREMENT
/begin MEASUREMENT Vxx_max_forc "Longitudinal force equivalent to a 100% accelerator pedal demand" SLONG _CNV_A_R_LINEAR_____361_CM 1 0. -20000. 111068. ECU_ADDRESS 0xd0002aa8 FORMAT "%6.0" /end MEASUREMENT
/begin MEASUREMENT Vxx_min_forc "Longitudinal force equivalent to a 0% accelerator pedal demand" SLONG _CNV_A_R_LINEAR_____361_CM 1 0. -20000. 111068. ECU_ADDRESS 0xd0002aac FORMAT "%6.0" /end MEASUREMENT
/begin MEASUREMENT Vxx_sdl_pwt_sp "Powertrain setpoint (%) requested by SDL (Speed and distance limiter function located in ACC)" UWORD _CNV_A_R_LINEAR_____238_CM 1 0. 0. 1. ECU_ADDRESS 0xd0004712 FORMAT "%7.5" /end MEASUREMENT
/begin MEASUREMENT Vxx_sl_pwt_sp "Powertrain setpoint (%) requested by Speed Limiter" UWORD _CNV_A_R_LINEAR_____238_CM 1 0. 0. 1. ECU_ADDRESS 0xd0004714 FORMAT "%7.5" /end MEASUREMENT
/begin CHARACTERISTIC Cxx_no_driv_pwt_sp_hys "Hysteresis for no powertrain setpoint requested" VALUE 0xa0021bc4 _REC_S1VAL_20_u2 1. _CNV_A_R_LINEAR_____238_CM 0. 1. FORMAT "%7.5" /end CHARACTERISTIC
/begin CHARACTERISTIC Cxx_no_driv_pwt_sp_thd "Threshold for no powertrain setpoint resquested" VALUE 0xa0021bc6 _REC_S1VAL_20_u2 1. _CNV_A_R_LINEAR_____238_CM 0. 1. FORMAT "%7.5" /end CHARACTERISTIC
/begin CHARACTERISTIC Cxx_no_virt_driv_pwt_sp_hys "Hysteresis for no powertrain setpoint requested by virtual driver" VALUE 0xa0021bc8 _REC_S1VAL_20_u2 1. _CNV_A_R_LINEAR_____238_CM 0. 1. FORMAT "%7.5" /end CHARACTERISTIC
/begin CHARACTERISTIC Cxx_no_virt_driv_pwt_sp_thd "Threshold for no powertrain setpoint resquested by virtual driver" VALUE 0xa0021bca _REC_S1VAL_20_u2 1. _CNV_A_R_LINEAR_____238_CM 0. 1. FORMAT "%7.5" /end CHARACTERISTIC
/begin AXIS_PTS Ctb_driv_tqe_map_n "Engine speed breakpoints for engine torque setpoint map" 0xa002f120 Vxx_n_mv _REC_A2AXS_20_u2 16383.75 _CNV_A_R_ENSD_LINEA_22_CM 20 0. 16383.75 FORMAT "%8.2" /end AXIS_PTS
/begin AXIS_PTS Ctb_driv_tqe_map_pwt_sp "Powertrain setpoint breakpoints for engine torque setpoint map" 0xa002f14c Vxx_driv_pwt_sp _REC_A2AXS_20_u2 1. _CNV_A_R_LINEAR_____238_CM 17 0. 1. FORMAT "%7.5" /end AXIS_PTS
/begin AXIS_PTS Ctb_min_driv_tqe_pwt_sp "Powertrain setpoint breakpoints for minimum driver engine torque factor" 0xa002f170 Vxx_driv_pwt_sp _REC_A2AXS_20_u2 1. _CNV_A_R_LINEAR_____238_CM 17 0. 1. FORMAT "%7.5" /end AXIS_PTS
/begin CHARACTERISTIC Cmp_driv_tqe_map "Map giving effective engine torque setpoint from powertrain setpoint and engine speed (only positiv" MAP 0xa002f194 _REC_A1MAP_20_u2_u2_u2 2047.96875 _CNV_A_R_LINEAR_____181_CM 0. 2047.96875 FORMAT "%10.5"
 /begin AXIS_DESCR COM_AXIS Vxx_driv_pwt_sp _CNV_A_R_LINEAR_____238_CM 17 0. 1. FORMAT "%7.5" AXIS_PTS_REF Ctb_driv_tqe_map_pwt_sp /end AXIS_DESCR
 /begin AXIS_DESCR COM_AXIS Vxx_n_mv _CNV_A_R_ENSD_LINEA_22_CM 20 0. 16383.75 FORMAT "%8.2" AXIS_PTS_REF Ctb_driv_tqe_map_n /end AXIS_DESCR
/end CHARACTERISTIC
/begin CHARACTERISTIC Cmp_min_driv_tqe_map "Format the powertrain setpoint to disable the minimum driver engine torque" MAP 0xa002f43c _REC_A1MAP_20_u2_u2_u2 1. _CNV_A_R_LINEAR_____238_CM 0. 1. FORMAT "%7.5"
 /begin AXIS_DESCR COM_AXIS Vxx_driv_pwt_sp _CNV_A_R_LINEAR_____238_CM 17 0. 1. FORMAT "%7.5" AXIS_PTS_REF Ctb_min_driv_tqe_pwt_sp /end AXIS_DESCR
 /begin AXIS_DESCR COM_AXIS Vxx_tco _CNV_A_R_LINEAR_____110_CM 9 -40. 200. FORMAT "%5.1" AXIS_PTS_REF Ctb_tco2 /end AXIS_DESCR
/end CHARACTERISTIC
/begin MEASUREMENT Vxx_driv_tqe_sp "Effective engine torque requested by real (pedal) and virtual (ACC/CC/SL) drivers" UWORD _CNV_A_R_LINEAR_____216_CM 1 0. -400. 1647.96875 ECU_ADDRESS 0xd0004718 FORMAT "%10.5" /end MEASUREMENT
/begin MEASUREMENT Vxx_main_driv_tqe_sp "Driver engine torque setpoint without engine brake part (output of torque setpoint map)" UWORD _CNV_A_R_LINEAR_____216_CM 1 0. -400. 1647.96875 ECU_ADDRESS 0xd000471a FORMAT "%10.5" /end MEASUREMENT
/begin CHARACTERISTIC Cbx_ref_max_pow_cfm "Option selecting explicit power calculation of driver torque setpoint" VALUE 0xa0021bcc _REC_S1VAL_20_u1 1. _CNV_A_R_ECME_LINEA_0_CM 0. 1. FORMAT "%1.0" BIT_MASK 0x1 /end CHARACTERISTIC
/begin CHARACTERISTIC Cxx_ref_max_pow "Reference max power for powertrain setpoint normalisation" VALUE 0xa0021bcd _REC_S1VAL_20_u1 500000. _CNV_A_R_LINEAR_____362_CM 0. 500000. FORMAT "%6.0" /end CHARACTERISTIC
/begin AXIS_PTS Ctb_acel_pdl_fmt "Pedal ratio breakpoints for pedal progressivity maps" 0xa002f668 Vxx_acel_pdl_rat _REC_A2AXS_20_u2 1. _CNV_A_R_LINEAR_____319_CM 17 0. 1. FORMAT "%7.5" /end AXIS_PTS
/begin CHARACTERISTIC Ctp_acel_pdl_fmt_1 "Pedal progressivity map  n°1" CURVE 0xa002f68c _REC_A1CUR_20_u2_u2 1. _CNV_A_R_LINEAR_____363_CM 0. 1. FORMAT "%11.9"
 /begin AXIS_DESCR COM_AXIS Vxx_acel_pdl_rat _CNV_A_R_LINEAR_____319_CM 17 0. 1. FORMAT "%7.5" AXIS_PTS_REF Ctb_acel_pdl_fmt /end AXIS_DESCR
/end CHARACTERISTIC
/begin CHARACTERISTIC Ctp_acel_pdl_fmt_2 "Pedal progressivity map  n°2" CURVE 0xa002f6b0 _REC_A1CUR_20_u2_u2 1. _CNV_A_R_LINEAR_____363_CM 0. 1. FORMAT "%11.9"
 /begin AXIS_DESCR COM_AXIS Vxx_acel_pdl_rat _CNV_A_R_LINEAR_____319_CM 17 0. 1. FORMAT "%7.5" AXIS_PTS_REF Ctb_acel_pdl_fmt /end AXIS_DESCR
/end CHARACTERISTIC
/begin MEASUREMENT Vsx_acel_pdl_pwt_sp_vld "Powertrain setpoint (%) requested by the driver via the accelerator pedal validity status" UBYTE _CNV_S_3_STATUS_OK__179_CM 1 0. 0. 2. ECU_ADDRESS 0xd000701f /end MEASUREMENT
/begin MEASUREMENT Vxx_acel_pdl_pwt_sp "Powertrain setpoint (%) requested by the driver via the accelerator pedal" UWORD _CNV_A_R_LINEAR_____319_CM 1 0. 0. 1. ECU_ADDRESS 0xd0004726 FORMAT "%7.5" /end MEASUREMENT
/begin CHARACTERISTIC Cxx_acel_pdl_fmt_rvr_fac "Pedal progressivity correction factor for reverse gear" VALUE 0xa0021be1 _REC_S1VAL_20_u1 2.55 _CNV_A_R_LINEAR_____123_CM 0. 2.55 FORMAT "%4.2" /end CHARACTERISTIC
/begin CHARACTERISTIC Ctp_acel_pdl_lih_hys_n_h "Pedal limp home max admissible engine speed function of gear ratio" CURVE 0xa002f6d4 _REC_A1CUR_20_u2_u1 16383.75 _CNV_A_R_ENSD_LINEA_22_CM 0. 16383.75 FORMAT "%8.2"
 /begin AXIS_DESCR COM_AXIS Vxx_gear _CNV_A_R_LINEAR_____145_CM 8 -1. 6. READ_ONLY FORMAT "%2.0" AXIS_PTS_REF Ntb_gear /end AXIS_DESCR
/end CHARACTERISTIC
/begin CHARACTERISTIC Ctp_acel_pdl_lih_n_sp "Pedal limp home engine speed setpoint function of gear ratio" CURVE 0xa002f6e4 _REC_A1CUR_20_u2_u1 16383.75 _CNV_A_R_ENSD_LINEA_22_CM 0. 16383.75 FORMAT "%8.2"
 /begin AXIS_DESCR COM_AXIS Vxx_gear _CNV_A_R_LINEAR_____145_CM 8 -1. 6. READ_ONLY FORMAT "%2.0" AXIS_PTS_REF Ntb_gear /end AXIS_DESCR
/end CHARACTERISTIC
/begin MEASUREMENT Vbx_acel_pdl_lih_act "Accelerator pedal safety strategy activated" UBYTE _CNV_S_2_RANGE______3_CM 1 0. 0. 1. ECU_ADDRESS 0xd000702d BIT_MASK 0x1 /end MEASUREMENT
/begin MEASUREMENT Vbx_acel_pdl_lih_dft_act "Activation of the accelerator pedal limp home strategy" UBYTE _CNV_S_2_RANGE______3_CM 1 0. 0. 1. ECU_ADDRESS 0xd000702e BIT_MASK 0x1 /end MEASUREMENT
/begin MEASUREMENT Vbx_acel_pdl_lih_dft_prev "Pedal limp home downgraded mode at t-1" UBYTE _CNV_S_2_RANGE______3_CM 1 0. 0. 1. ECU_ADDRESS 0xd000702f BIT_MASK 0x1 /end MEASUREMENT
/begin MEASUREMENT Vbx_acel_pdl_lih_i_rst "Conditions to reset integral term of pedal limp home regulators" UBYTE _CNV_S_2_RANGE______3_CM 1 0. 0. 1. ECU_ADDRESS 0xd0007030 BIT_MASK 0x1 /end MEASUREMENT
/begin MEASUREMENT Vbx_acel_pdl_lih_min_cdn "Conditions to apply the minimum available engine torque in pedal limp home" UBYTE _CNV_S_2_RANGE______3_CM 1 0. 0. 1. ECU_ADDRESS 0xd0007031 BIT_MASK 0x1 /end MEASUREMENT
/begin MEASUREMENT Vbx_acel_pdl_lih_n_i_frz "Conditions to freeze the integral term of the engine speed regulator in pedal limp home" UBYTE _CNV_S_2_RANGE______3_CM 1 0. 0. 1. ECU_ADDRESS 0xd0007032 BIT_MASK 0x1 /end MEASUREMENT
/begin MEASUREMENT Vbx_acel_pdl_lih_n_tqe_h "The maximum torque allowed by the engine speed regulator in pedal limp home is reached" UBYTE _CNV_S_2_RANGE______3_CM 1 0. 0. 1. ECU_ADDRESS 0xd0007033 BIT_MASK 0x1 /end MEASUREMENT
/begin MEASUREMENT Vbx_acel_pdl_lih_n_tqe_l "The minimum torque allowed by the engine speed regulator in pedal limp home is reached" UBYTE _CNV_S_2_RANGE______3_CM 1 0. 0. 1. ECU_ADDRESS 0xd0007034 BIT_MASK 0x1 /end MEASUREMENT
/begin MEASUREMENT Vbx_acel_pdl_lih_reg_swi "(1) vehicle speed regulator activated. (0) engine speed regulator activated in pedal limp home." UBYTE _CNV_S_2_RANGE______3_CM 1 0. 0. 1. ECU_ADDRESS 0xd0007035 BIT_MASK 0x1 /end MEASUREMENT
/begin MEASUREMENT Vbx_acel_pdl_lih_sp_cdn "Conditions to initialize the engine and vehicle speed setpoints to their current value" UBYTE _CNV_S_2_RANGE______3_CM 1 0. 0. 1. ECU_ADDRESS 0xd0007036 BIT_MASK 0x1 /end MEASUREMENT
/begin MEASUREMENT Vbx_acel_pdl_lih_vs_i_frz "Conditions to freeze the integral term of vehicle speed regulator" UBYTE _CNV_S_2_RANGE______3_CM 1 0. 0. 1. ECU_ADDRESS 0xd0007037 BIT_MASK 0x1 /end MEASUREMENT
/begin MEASUREMENT Vbx_acel_pdl_lih_vs_p_rst "Conditions to reset proportionnal term of vehicle speed pedal limp home regulator" UBYTE _CNV_S_2_RANGE______3_CM 1 0. 0. 1. ECU_ADDRESS 0xd0007038 BIT_MASK 0x1 /end MEASUREMENT
/begin MEASUREMENT Vbx_acel_pdl_lih_vs_tqe_h "The maximum torque allowed by the vehicle speed regulator in pedal limp home is reached" UBYTE _CNV_S_2_RANGE______3_CM 1 0. 0. 1. ECU_ADDRESS 0xd0007039 BIT_MASK 0x1 /end MEASUREMENT
/begin MEASUREMENT Vbx_acel_pdl_lih_vs_tqe_l "The minimum torque allowed by the vehicle speed regulator in pedal limp home is reached" UBYTE _CNV_S_2_RANGE______3_CM 1 0. 0. 1. ECU_ADDRESS 0xd000703a BIT_MASK 0x1 /end MEASUREMENT
/begin MEASUREMENT Vxx_acel_pdl_lih_n_dif "Difference between engine speed setpoint and measured engine speed in pedal limp home" SWORD _CNV_A_R_ENSD_LINEA_22_CM 1 0. -8192. 8191.75 ECU_ADDRESS 0xd000473a FORMAT "%6.0" /end MEASUREMENT
/begin MEASUREMENT Vxx_acel_pdl_lih_n_i "Integrate term of engine speed regulator in pedal limp home" UWORD _CNV_A_R_LINEAR_____216_CM 1 0. -400. 1647.96875 ECU_ADDRESS 0xd000473c FORMAT "%11.5" /end MEASUREMENT
/begin MEASUREMENT Vxx_acel_pdl_lih_n_sp "Engine speed setpoint in pedal limp home (after slope)" UWORD _CNV_A_R_ENSD_LINEA_22_CM 1 0. 0. 16383.75 ECU_ADDRESS 0xd000473e FORMAT "%8.2" /end MEASUREMENT
/begin MEASUREMENT Vxx_acel_pdl_lih_n_tqe "Pedal limp home engine torque from the engine speed regulator" UWORD _CNV_A_R_LINEAR_____216_CM 1 0. -400. 1647.96875 ECU_ADDRESS 0xd0004740 FORMAT "%11.5" /end MEASUREMENT
/begin MEASUREMENT Vxx_acel_pdl_lih_pwt "Powertrain setpoint calculated by the regulators (before the application of the foot-up)" UWORD _CNV_A_R_LINEAR_____238_CM 1 0. 0. 1. ECU_ADDRESS 0xd0004742 FORMAT "%7.5" /end MEASUREMENT
/begin MEASUREMENT Vxx_acel_pdl_lih_pwt_load "Powertrain setpoint calculated by the regulators (transition with normal mode and pedal level)" UWORD _CNV_A_R_LINEAR_____238_CM 1 0. 0. 1. ECU_ADDRESS 0xd0004744 FORMAT "%7.5" /end MEASUREMENT
/begin MEASUREMENT Vxx_acel_pdl_lih_pwt_sp "Powertrain setpoint (%) requested by accelerator pedal safety strategy" UWORD _CNV_A_R_LINEAR_____238_CM 1 0. 0. 1. ECU_ADDRESS 0xd0004746 FORMAT "%7.5" /end MEASUREMENT
/begin MEASUREMENT Vxx_acel_pdl_lih_tqe_sp "Accelerator pedal limp home engine torque" UWORD _CNV_A_R_LINEAR_____216_CM 1 0. -400. 1647.96875 ECU_ADDRESS 0xd0004748 FORMAT "%11.5" /end MEASUREMENT
/begin MEASUREMENT Vxx_acel_pdl_lih_vs_dif "Difference between vehicle speed setpoint and measured vehicle speed in pedal limp home" SWORD _CNV_A_R_LINEAR_____125_CM 1 0. -255. 255. ECU_ADDRESS 0xd000474a FORMAT "%8.3" /end MEASUREMENT
/begin MEASUREMENT Vxx_acel_pdl_lih_vs_i "Integrate term of vehicle speed regulator in pedal limp home" UWORD _CNV_A_R_LINEAR_____216_CM 1 0. -400. 1647.96875 ECU_ADDRESS 0xd000474c FORMAT "%11.5" /end MEASUREMENT
/begin MEASUREMENT Vxx_acel_pdl_lih_vs_sp "Vehicle speed setpoint in pedal limp home (after slope)" UWORD _CNV_A_R_LINEAR_____125_CM 1 0. 0. 655.35 ECU_ADDRESS 0xd000474e FORMAT "%6.2" /end MEASUREMENT
/begin MEASUREMENT Vxx_acel_pdl_lih_vs_tqe "Pedal limp home engine torque from the vehicle speed regulator" UWORD _CNV_A_R_LINEAR_____216_CM 1 0. -400. 1647.96875 ECU_ADDRESS 0xd0004750 FORMAT "%11.5" /end MEASUREMENT
/begin CHARACTERISTIC Cbx_acel_pdl_lvl_cfm "Activation of a torque level to help in the calibration of the pedal limp home regulators" VALUE 0xa0021bf0 _REC_S1VAL_20_u1 1. _CNV_A_R_ECME_LINEA_0_CM 0. 1. FORMAT "%1.0" BIT_MASK 0x1 /end CHARACTERISTIC
/begin CHARACTERISTIC Cxx_acel_pdl_lih_hys_n_l "Difference of engine speed for the hysteresis on max admissible engine speed in pedal limp home" VALUE 0xa0021be2 _REC_S1VAL_20_u2 16383.75 _CNV_A_R_ENSD_LINEA_22_CM 0. 16383.75 FORMAT "%8.2" /end CHARACTERISTIC
/begin CHARACTERISTIC Cxx_acel_pdl_lih_hys_vs_h "High vehicle speed threshold for the hysteresis on the regulators switch in pedal limp home" VALUE 0xa0021bf1 _REC_S1VAL_20_u1 255. _CNV_A_R_LINEAR_____71_CM 0. 255. FORMAT "%3.0" /end CHARACTERISTIC
/begin CHARACTERISTIC Cxx_acel_pdl_lih_hys_vs_l "Low vehicle speed threshold for the hysteresis on the regulators switch in pedal limp home" VALUE 0xa0021bf2 _REC_S1VAL_20_u1 255. _CNV_A_R_LINEAR_____71_CM 0. 255. FORMAT "%3.0" /end CHARACTERISTIC
/begin CHARACTERISTIC Cxx_acel_pdl_lih_max_vs "Maximum vehicle speed allowed in pedal limp home" VALUE 0xa0021bf3 _REC_S1VAL_20_u1 255. _CNV_A_R_LINEAR_____71_CM 0. 255. FORMAT "%3.0" /end CHARACTERISTIC
/begin CHARACTERISTIC Cxx_acel_pdl_lih_min_l "Decreasing slope during the application of the foot-up accelerator pedal" VALUE 0xa0021bf4 _REC_S1VAL_20_u1 1. _CNV_A_R_LINEAR_____316_CM 0. 1. FORMAT "%12.9" /end CHARACTERISTIC
/begin CHARACTERISTIC Cxx_acel_pdl_lih_n_ig "Integrate factor of pedal limp home engine speed regulator" VALUE 0xa0021bf5 _REC_S1VAL_20_u1 25.5 _CNV_A_R_LINEAR_____58_CM 0. 25.5 FORMAT "%4.1" /end CHARACTERISTIC
/begin CHARACTERISTIC Cxx_acel_pdl_lih_n_pg "Proportional factor of pedal limp home engine speed regulator" VALUE 0xa0021bf6 _REC_S1VAL_20_u1 1. _CNV_A_R_LINEAR_____364_CM 0. 1. FORMAT "%8.3" /end CHARACTERISTIC
/begin CHARACTERISTIC Cxx_acel_pdl_lih_n_sp_bpk_on "Pedal limp home engine speed setpoint if brake parking is applied" VALUE 0xa0021be4 _REC_S1VAL_20_u2 16383.75 _CNV_A_R_ENSD_LINEA_22_CM 0. 16383.75 FORMAT "%8.2" /end CHARACTERISTIC
/begin CHARACTERISTIC Cxx_acel_pdl_lih_n_sp_srs "Pedal limp home engine speed setpoint if vehicle speed failure (safety setpoint)" VALUE 0xa0021be6 _REC_S1VAL_20_u2 16383.75 _CNV_A_R_ENSD_LINEA_22_CM 0. 16383.75 FORMAT "%8.2" /end CHARACTERISTIC
/begin CHARACTERISTIC Cxx_acel_pdl_lih_n_tqe_h "Maximum torque setpoint allowed for the pedal limp home engine speed regulator" VALUE 0xa0021be8 _REC_S1VAL_20_u2 2047.96875 _CNV_A_R_LINEAR_____216_CM -400. 1647.96875 FORMAT "%11.5" /end CHARACTERISTIC
/begin CHARACTERISTIC Cxx_acel_pdl_lih_slop_h1 "Slope for the low vehicle speed and for the increasing vehicle speed setpoint in pedal limp home" VALUE 0xa0021bf7 _REC_S1VAL_20_u1 255. _CNV_A_R_LINEAR_____353_CM 0. 255. FORMAT "%3.0" /end CHARACTERISTIC
/begin CHARACTERISTIC Cxx_acel_pdl_lih_slop_h2 "Slope for the high vehicle speed and for the increasing vehicle speed setpoint in pedal limp home" VALUE 0xa0021bf8 _REC_S1VAL_20_u1 255. _CNV_A_R_LINEAR_____353_CM 0. 255. FORMAT "%3.0" /end CHARACTERISTIC
/begin CHARACTERISTIC Cxx_acel_pdl_lih_slop_n_h "Slope for the increasing engine speed setpoint in pedal limp home" VALUE 0xa0021bf9 _REC_S1VAL_20_u1 25500. _CNV_A_R_LINEAR_____365_CM 0. 25500. FORMAT "%5.0" /end CHARACTERISTIC
/begin CHARACTERISTIC Cxx_acel_pdl_lih_slop_vs "Vehicle speed threshold for the change of the vehicle speed setpoint slope" VALUE 0xa0021bfa _REC_S1VAL_20_u1 255. _CNV_A_R_LINEAR_____71_CM 0. 255. FORMAT "%3.0" /end CHARACTERISTIC
/begin CHARACTERISTIC Cxx_acel_pdl_lih_vs_ig "Integrate factor of pedal limp home vehicle speed regulator" VALUE 0xa0021bfb _REC_S1VAL_20_u1 25.5 _CNV_A_R_LINEAR_____58_CM 0. 25.5 FORMAT "%4.1" /end CHARACTERISTIC
/begin CHARACTERISTIC Cxx_acel_pdl_lih_vs_pg "Proportional factor of pedal limp home vehicle speed regulator" VALUE 0xa0021bea _REC_S1VAL_20_u2 24.902343 _CNV_A_R_LINEAR_____366_CM 0. 24.902343 FORMAT "%6.2" /end CHARACTERISTIC
/begin CHARACTERISTIC Cxx_acel_pdl_lih_vs_rvr "Pedal limp home vehicle speed setpoint in reverse gear" VALUE 0xa0021bfc _REC_S1VAL_20_u1 255. _CNV_A_R_LINEAR_____71_CM 0. 255. FORMAT "%3.0" /end CHARACTERISTIC
/begin CHARACTERISTIC Cxx_acel_pdl_lih_vs_sp "Pedal limp home vehicle speed setpoint" VALUE 0xa0021bfd _REC_S1VAL_20_u1 255. _CNV_A_R_LINEAR_____71_CM 0. 255. FORMAT "%3.0" /end CHARACTERISTIC
/begin CHARACTERISTIC Cxx_acel_pdl_lih_vs_tqe_h "Maximum torque setpoint allowed for the pedal limp home vehicle speed regulator" VALUE 0xa0021bec _REC_S1VAL_20_u2 2047.96875 _CNV_A_R_LINEAR_____216_CM -400. 1647.96875 FORMAT "%11.5" /end CHARACTERISTIC
/begin CHARACTERISTIC Cxx_acel_pdl_lvl_tqe_thd "Imposed torque setpoint to help to the calibration of the accelerator pedal limp home regulators" VALUE 0xa0021bee _REC_S1VAL_20_u2 2047.96875 _CNV_A_R_LINEAR_____216_CM -400. 1647.96875 FORMAT "%10.5" /end CHARACTERISTIC
/begin CHARACTERISTIC Cxx_acel_pdl_trs_slop_neg "Pedal slope during the decreasing transitions : normal mode <=> accelerator pedal limp home" VALUE 0xa0021bfe _REC_S1VAL_20_u1 1. _CNV_A_R_LINEAR_____316_CM 0. 1. FORMAT "%12.9" /end CHARACTERISTIC
/begin CHARACTERISTIC Cxx_acel_pdl_trs_slop_pos "Pedal slope during the increasing transitions : normal mode <=> accelerator pedal limp home" VALUE 0xa0021bff _REC_S1VAL_20_u1 1. _CNV_A_R_LINEAR_____316_CM 0. 1. FORMAT "%12.9" /end CHARACTERISTIC
/begin CHARACTERISTIC Cxx_max_pow "Max power for accelerator pedal limp home powertrain setpoint" VALUE 0xa0021c00 _REC_S1VAL_20_u1 500000. _CNV_A_R_LINEAR_____362_CM 0. 500000. FORMAT "%6.0" /end CHARACTERISTIC
/begin MEASUREMENT Vbx_acel_pdl_lih_min_spc_cdn "Specific conditions to apply the minimum available engine torque in pedal limp home" UBYTE _CNV_S_2_RANGE______3_CM 1 0. 0. 1. ECU_ADDRESS 0xd000700b BIT_MASK 0x1 /end MEASUREMENT
/begin AXIS_PTS Ctb_acel_pdl_fmt_fac_vs "Vehicle speed breakpoints for map giving transition factor between 2 progressivity maps" 0xa002f570 Vxx_vs _REC_A2AXS_20_u2 655.35 _CNV_A_R_LINEAR_____125_CM 9 0. 655.35 FORMAT "%6.2" /end AXIS_PTS
/begin AXIS_PTS Ctb_acel_pdl_fmt_tkof_fac_driv "Take off assistance factor breakpoints for \"take off map\" giving transition factor between 2 progressivity maps" 0xa0021bce Vxx_tkof_ass_fac _REC_A2AXS_20_u1 1. _CNV_A_R_LINEAR_____275_CM 5 0. 1. FORMAT "%9.7" /end AXIS_PTS
/begin AXIS_PTS Ctb_acel_pdl_fmt_tkof_fac_vs "Vehicle speed breakpoints for \"take off map\" giving transition factor between 2 progressivity maps" 0xa002f584 Vxx_vs _REC_A2AXS_20_u2 655.35 _CNV_A_R_LINEAR_____125_CM 5 0. 655.35 FORMAT "%6.2" /end AXIS_PTS
/begin AXIS_PTS Ntb_rs_dspl_pdl_spt_fac "Renault Sport Display factor breakpoints for \"sportivity map\" giving transition factor between 2 progressivity maps" 0xa002f654 Vxx_rs_dspl_pdl_spt_fac _REC_A2AXS_20_u1 15. _CNV_A_R_ECME_LINEA_0_CM 16 0. 15. READ_ONLY FORMAT "%3.0" /end AXIS_PTS
/begin CHARACTERISTIC Cmp_acel_pdl_fmt_rs_dspl_fac "Renault Sport Display factor map giving transition between 2 progressivity maps" MAP 0xa002f590 _REC_A1MAP_20_u1_u2_u1 1. _CNV_A_R_LINEAR_____275_CM 0. 1. FORMAT "%9.7"
 /begin AXIS_DESCR COM_AXIS Vxx_vs _CNV_A_R_LINEAR_____125_CM 9 0. 655.35 FORMAT "%6.2" AXIS_PTS_REF Ctb_acel_pdl_fmt_fac_vs /end AXIS_DESCR
 /begin AXIS_DESCR COM_AXIS Vxx_rs_dspl_pdl_spt_fac _CNV_A_R_ECME_LINEA_0_CM 16 0. 15. READ_ONLY FORMAT "%3.0" AXIS_PTS_REF Ntb_rs_dspl_pdl_spt_fac /end AXIS_DESCR
/end CHARACTERISTIC
/begin CHARACTERISTIC Cmp_acel_pdl_fmt_tkof_fac "Vehicle speed and take off assistance factor map giving transition factor between 2 progressivity maps" MAP 0xa002f620 _REC_A1MAP_20_u1_u2_u1 1. _CNV_A_R_LINEAR_____275_CM 0. 1. FORMAT "%9.7"
 /begin AXIS_DESCR COM_AXIS Vxx_vs _CNV_A_R_LINEAR_____125_CM 5 0. 655.35 FORMAT "%6.2" AXIS_PTS_REF Ctb_acel_pdl_fmt_tkof_fac_vs /end AXIS_DESCR
 /begin AXIS_DESCR COM_AXIS Vxx_tkof_ass_fac _CNV_A_R_LINEAR_____275_CM 5 0. 1. FORMAT "%9.7" AXIS_PTS_REF Ctb_acel_pdl_fmt_tkof_fac_driv /end AXIS_DESCR
/end CHARACTERISTIC
/begin CHARACTERISTIC Ctp_acel_pdl_fmt_fac "Vehicle speed map giving nominal factor between 2 progressivity maps" CURVE 0xa002f63c _REC_A1CUR_20_u1_u2 1. _CNV_A_R_LINEAR_____275_CM 0. 1. FORMAT "%9.7"
 /begin AXIS_DESCR COM_AXIS Vxx_vs _CNV_A_R_LINEAR_____125_CM 9 0. 655.35 FORMAT "%6.2" AXIS_PTS_REF Ctb_acel_pdl_fmt_fac_vs /end AXIS_DESCR
/end CHARACTERISTIC
/begin CHARACTERISTIC Ctp_acel_pdl_fmt_spt_fac "Vehicle speed map giving sportivity factor between 2 progressivity maps" CURVE 0xa002f648 _REC_A1CUR_20_u1_u2 1. _CNV_A_R_LINEAR_____275_CM 0. 1. FORMAT "%9.7"
 /begin AXIS_DESCR COM_AXIS Vxx_vs _CNV_A_R_LINEAR_____125_CM 9 0. 655.35 FORMAT "%6.2" AXIS_PTS_REF Ctb_acel_pdl_fmt_fac_vs /end AXIS_DESCR
/end CHARACTERISTIC
/begin MEASUREMENT Vbx_acel_pdl_fmt_fac_med_req "Activation of pedal progressivity transition between nominal and sport mode" UBYTE _CNV_S_2_RANGE______3_CM 1 0. 0. 1. ECU_ADDRESS 0xd0007018 BIT_MASK 0x1 /end MEASUREMENT
/begin MEASUREMENT Vbx_acel_pdl_fmt_fac_spt_req "Activation of sport progressivity pedal." UBYTE _CNV_S_2_RANGE______3_CM 1 0. 0. 1. ECU_ADDRESS 0xd0007019 BIT_MASK 0x1 /end MEASUREMENT
/begin MEASUREMENT Vbx_acel_pdl_rat_mem_ok "Acceleration pedal ratio memorization flag when dynamic mode is requested" UBYTE _CNV_S_2_RANGE______3_CM 1 0. 0. 1. ECU_ADDRESS 0xd000701a BIT_MASK 0x1 /end MEASUREMENT
/begin MEASUREMENT Vxx_acel_pdl_fmt_fac "Interpolation factor between pedal progressivity maps (0<=>map1, 1<=>map2)" UBYTE _CNV_A_R_LINEAR_____275_CM 1 0. 0. 1. ECU_ADDRESS 0xd000701b FORMAT "%9.7" /end MEASUREMENT
/begin MEASUREMENT Vxx_acel_pdl_fmt_fac_spt_step "Progressivity factor step applied during transition between nominal <=> sport mode" SWORD _CNV_A_R_LINEAR_____275_CM 1 0. -1. 1. ECU_ADDRESS 0xd0004720 FORMAT "%12.7" /end MEASUREMENT
/begin MEASUREMENT Vxx_acel_pdl_fmt_med_fac "Interpolation factor in medium mode between pedal progressivity maps (0<=>map1, 1<=>map2)" UBYTE _CNV_A_R_LINEAR_____275_CM 1 0. 0. 1. ECU_ADDRESS 0xd000701c FORMAT "%9.7" /end MEASUREMENT
/begin MEASUREMENT Vxx_acel_pdl_fmt_nom_fac "Interpolation factor in nominal mode between pedal progressivity maps (0<=>map1, 1<=>map2)" UBYTE _CNV_A_R_LINEAR_____275_CM 1 0. 0. 1. ECU_ADDRESS 0xd000701d FORMAT "%9.7" /end MEASUREMENT
/begin MEASUREMENT Vxx_acel_pdl_fmt_spt_fac "Interpolation factor in sport mode between pedal progressivity maps (0<=>map1, 1<=>map2)" UBYTE _CNV_A_R_LINEAR_____275_CM 1 0. 0. 1. ECU_ADDRESS 0xd000701e FORMAT "%9.7" /end MEASUREMENT
/begin MEASUREMENT Vxx_acel_pdl_rat_dyn_mem "Memorized accelerator pedal position when dynamic mode is requested" UWORD _CNV_A_R_LINEAR_____319_CM 1 0. 0. 1. ECU_ADDRESS 0xd0004722 FORMAT "%8.5" /end MEASUREMENT
/begin MEASUREMENT Vxx_acel_pdl_rat_dyn_mem_ini "Memorized accelerator pedal position when dynamic mode is requested before consolidation" UWORD _CNV_A_R_LINEAR_____319_CM 1 0. 0. 1. ECU_ADDRESS 0xd0004724 FORMAT "%8.5" /end MEASUREMENT
/begin CHARACTERISTIC Cbx_acel_pdl_fmt_mnl_cfm "Selects a manual interpolation factor between pedal progressivity maps (for tuning purposes)" VALUE 0xa0021bda _REC_S1VAL_20_u1 1. _CNV_A_R_ECME_LINEA_0_CM 0. 1. FORMAT "%1.0" BIT_MASK 0x1 /end CHARACTERISTIC
/begin CHARACTERISTIC Cxx_acel_pdl_fac_spt_step_in "Progressivity factor step applied when dynamic mode is requested" VALUE 0xa0021bdb _REC_S1VAL_20_u1 1. _CNV_A_R_LINEAR_____275_CM 0. 1. FORMAT "%9.7" /end CHARACTERISTIC
/begin CHARACTERISTIC Cxx_acel_pdl_fac_spt_step_out "Progressivity factor step applied when dynamic mode is deactivated" VALUE 0xa0021bdc _REC_S1VAL_20_u1 1. _CNV_A_R_LINEAR_____275_CM 0. 1. FORMAT "%9.7" /end CHARACTERISTIC
/begin CHARACTERISTIC Cxx_acel_pdl_fmt_fac_delta "Difference of progressivity pedal factor used for nominal <=> sport transition" VALUE 0xa0021bdd _REC_S1VAL_20_u1 1. _CNV_A_R_LINEAR_____275_CM 0. 1. FORMAT "%9.7" /end CHARACTERISTIC
/begin CHARACTERISTIC Cxx_acel_pdl_fmt_mnl_fac "Manual interpolation factor between pedal progressivity maps (for tuning purposes)" VALUE 0xa0021bde _REC_S1VAL_20_u1 1. _CNV_A_R_LINEAR_____275_CM 0. 1. FORMAT "%9.7" /end CHARACTERISTIC
/begin CHARACTERISTIC Cxx_acel_pdl_rat_dyn_delta "Threshold for the detection of a positive accelerator pedal gradient" VALUE 0xa0021bd4 _REC_S1VAL_20_u2 1. _CNV_A_R_LINEAR_____319_CM 0. 1. FORMAT "%8.5" /end CHARACTERISTIC
/begin CHARACTERISTIC Cxx_pdl_fmt_fac_slop_swi_down "Slope constant used during the change of progressivity maps, when decreasing" VALUE 0xa0021bdf _REC_S1VAL_20_u1 1. _CNV_A_R_LINEAR_____367_CM 0. 1. FORMAT "%9.7" /end CHARACTERISTIC
/begin CHARACTERISTIC Cxx_pdl_fmt_fac_slop_swi_up "Slope constant used during the change of progressivity maps, when increasing" VALUE 0xa0021be0 _REC_S1VAL_20_u1 1. _CNV_A_R_LINEAR_____367_CM 0. 1. FORMAT "%9.7" /end CHARACTERISTIC
/begin CHARACTERISTIC Cxx_tkof_cdn_vs_max "Maximum vehicule speed to detect that the vehicules is in take off conditions" VALUE 0xa0021bd6 _REC_S1VAL_20_u2 655.35 _CNV_A_R_LINEAR_____125_CM 0. 655.35 FORMAT "%6.2" /end CHARACTERISTIC
/begin CHARACTERISTIC Cxx_tkof_stop_vs "Limit vehicule speed that determines the end of a take off" VALUE 0xa0021bd8 _REC_S1VAL_20_u2 655.35 _CNV_A_R_LINEAR_____125_CM 0. 655.35 FORMAT "%6.2" /end CHARACTERISTIC
/begin AXIS_PTS Ctb_n "20 programmable engine speed breakpoints map" 0xa002db74 Vxx_n _REC_A2AXS_20_u2 16383.75 _CNV_A_R_ENSD_LINEA_22_CM 20 0. 16383.75 FORMAT "%8.2" /end AXIS_PTS
/begin AXIS_PTS Ctb_n2 "9 programmable engine speed breakpoints table" 0xa002dba0 Vxx_n _REC_A2AXS_20_u2 16383.75 _CNV_A_R_ENSD_LINEA_22_CM 9 0. 16383.75 FORMAT "%8.2" /end AXIS_PTS
/begin AXIS_PTS Ntb_gear "Gearbox ratio breakpoint" 0xa002da28 Vxx_gear _REC_A2AXS_20_u1 7. _CNV_A_R_LINEAR_____145_CM 8 -1. 6. READ_ONLY FORMAT "%2.0" /end AXIS_PTS
/begin MEASUREMENT Vbx_rs_noi_lim_cfm "RS noise limitation Strategy configuration boolean." UBYTE _CNV_S_2_RANGE______3_CM 1 0. 0. 1. ECU_ADDRESS 0xd0007cc2 BIT_MASK 0x1 /end MEASUREMENT
/begin COMPU_METHOD _CNV_A_R_ECME_LINEA_0_CM "" RAT_FUNC "%6.3" "-" COEFFS 0 1. 0. 0 0 1 /end COMPU_METHOD
/begin COMPU_METHOD _CNV_S_2_RANGE______3_CM "" TAB_VERB "%6.3" "-" COMPU_TAB_REF _CNV_S_2_RANGE______3 /end COMPU_METHOD
/begin COMPU_VTAB _CNV_S_2_RANGE______3 "" TAB_VERB 2 0 "0" 1 "1" /end COMPU_VTAB
/begin COMPU_METHOD _CNV_A_R_LINEAR_____21_CM "" RAT_FUNC "%6.3" "rpm/s" COEFFS 0 1. 0. 0 0 1 /end COMPU_METHOD
/begin COMPU_METHOD _CNV_A_R_ENSD_LINEA_22_CM "" RAT_FUNC "%6.3" "rpm" COEFFS 0 4. 0. 0 0 1 /end COMPU_METHOD
/begin COMPU_METHOD _CNV_A_R_LINEAR_____23_CM "" RAT_FUNC "%6.3" "°CRK" COEFFS 0 2.666666666666667 0. 0 0 1 /end COMPU_METHOD
/begin COMPU_METHOD _CNV_A_R_LINEAR_____29_CM "" RAT_FUNC "%6.3" "-" COEFFS 0 256. 0. 0 0 1 /end COMPU_METHOD
/begin COMPU_METHOD _CNV_A_R_LINEAR_____32_CM "" RAT_FUNC "%6.3" "s" COEFFS 0 100. 0. 0 0 1 /end COMPU_METHOD
/begin COMPU_METHOD _CNV_A_R_LINEAR_____53_CM "" RAT_FUNC "%6.3" "-" COEFFS 0 16384. 0. 0 0 1 /end COMPU_METHOD
/begin COMPU_METHOD _CNV_A_R_LINEAR_____58_CM "" RAT_FUNC "%6.3" "s" COEFFS 0 10. 0. 0 0 1 /end COMPU_METHOD
/begin COMPU_METHOD _CNV_A_R_LINEAR_____65_CM "" RAT_FUNC "%6.3" "l" COEFFS 0 1. 0. 0 0 1 /end COMPU_METHOD
/begin COMPU_METHOD _CNV_A_R_LINEAR_____70_CM "" RAT_FUNC "%6.3" "V" COEFFS 0 204.8 0. 0 0 1 /end COMPU_METHOD
/begin COMPU_METHOD _CNV_A_R_LINEAR_____71_CM "" RAT_FUNC "%6.3" "km/h" COEFFS 0 1. 0. 0 0 1 /end COMPU_METHOD
/begin COMPU_METHOD _CNV_A_R_LINEAR_____107_CM "" RAT_FUNC "%6.3" "mV" COEFFS 0 1. 0. 0 0 1 /end COMPU_METHOD
/begin COMPU_METHOD _CNV_A_R_LINEAR_____110_CM "" RAT_FUNC "%6.3" "°C" COEFFS 0 10. 400. 0 0 1 /end COMPU_METHOD
/begin COMPU_METHOD _CNV_A_R_LINEAR_____115_CM "" RAT_FUNC "%6.3" "hPa" COEFFS 0 1. 0. 0 0 1 /end COMPU_METHOD
/begin COMPU_METHOD _CNV_A_R_LINEAR_____123_CM "" RAT_FUNC "%6.3" "-" COEFFS 0 100. 0. 0 0 1 /end COMPU_METHOD
/begin COMPU_METHOD _CNV_A_R_LINEAR_____125_CM "" RAT_FUNC "%6.3" "km/h" COEFFS 0 100. 0. 0 0 1 /end COMPU_METHOD
/begin COMPU_METHOD _CNV_A_R_LINEAR_____145_CM "" RAT_FUNC "%6.3" "-" COEFFS 0 1. 1. 0 0 1 /end COMPU_METHOD
/begin COMPU_METHOD _CNV_A_R_LINEAR_____149_CM "" RAT_FUNC "%6.3" "-" COEFFS 0 2048. 0. 0 0 1 /end COMPU_METHOD
/begin COMPU_METHOD _CNV_A_R_LINEAR_____153_CM "" RAT_FUNC "%6.3" "-" COEFFS 0 256. -256. 0 0 1 /end COMPU_METHOD
/begin COMPU_METHOD _CNV_A_R_LINEAR_____161_CM "" RAT_FUNC "%6.3" "-" COEFFS 0 1000. 0. 0 0 1 /end COMPU_METHOD
/begin COMPU_METHOD _CNV_A_R_LINEAR_____162_CM "" RAT_FUNC "%6.3" "-" COEFFS 0 255. 0. 0 0 1 /end COMPU_METHOD
/begin COMPU_METHOD _CNV_A_R_LINEAR_____172_CM "" RAT_FUNC "%6.3" "kg/h" COEFFS 0 20. 0. 0 0 1 /end COMPU_METHOD
/begin COMPU_METHOD _CNV_S_3_STATUS_OK__179_CM "" TAB_VERB "%6.3" "-" COMPU_TAB_REF _CNV_S_3_STATUS_OK__179 /end COMPU_METHOD
/begin COMPU_VTAB _CNV_S_3_STATUS_OK__179 "" TAB_VERB 3 0 "Nsx_vld_nok_0" 1 "Nsx_vld_ok_1" 2 "Nsx_vld_fail_2" /end COMPU_VTAB
/begin COMPU_METHOD _CNV_A_R_LINEAR_____181_CM "" RAT_FUNC "%6.3" "Nm" COEFFS 0 32. 0. 0 0 1 /end COMPU_METHOD
/begin COMPU_METHOD _CNV_A_R_LINEAR_____183_CM "" RAT_FUNC "%6.3" "-" COEFFS 0 1024. 0. 0 0 1 /end COMPU_METHOD
/begin COMPU_METHOD _CNV_A_R_LINEAR_____185_CM "" RAT_FUNC "%6.3" "Nm" COEFFS 0 32. 32768. 0 0 1 /end COMPU_METHOD
/begin COMPU_METHOD _CNV_A_R_LINEAR_____186_CM "" RAT_FUNC "%6.3" "W" COEFFS 0 0.1 0. 0 0 1 /end COMPU_METHOD
/begin COMPU_METHOD _CNV_A_R_LINEAR_____216_CM "" RAT_FUNC "%6.3" "Nm" COEFFS 0 32. 12800. 0 0 1 /end COMPU_METHOD
/begin COMPU_METHOD _CNV_S_8_STATUS_OK__234_CM "" TAB_VERB "%6.3" "-" COMPU_TAB_REF _CNV_S_8_STATUS_OK__234 /end COMPU_METHOD
/begin COMPU_VTAB _CNV_S_8_STATUS_OK__234 "" TAB_VERB 8 0 "Nsx_vld_nok_0" 1 "Nsx_vld_ok_1" 2 "Nsx_vld_fail_2" 3 "Nsx_vld_fail_3" 4 "Nsx_vld_fail_4" 5 "Nsx_vld_fail_5" 6 "Nsx_vld_fail_6" 7 "Nsx_vld_fail_7" /end COMPU_VTAB
/begin COMPU_METHOD _CNV_A_R_LINEAR_____238_CM "" RAT_FUNC "%6.3" "-" COEFFS 0 800. 0. 0 0 1 /end COMPU_METHOD
/begin COMPU_METHOD _CNV_S_2_STATUS_OK__241_CM "" TAB_VERB "%6.3" "" COMPU_TAB_REF _CNV_S_2_STATUS_OK__241 /end COMPU_METHOD
/begin COMPU_VTAB _CNV_S_2_STATUS_OK__241 "" TAB_VERB 2 0 "Nsx_vld_nok_0" 1 "Nsx_vld_ok_1" /end COMPU_VTAB
/begin COMPU_METHOD _CNV_S_2_STATUS_OK__269_CM "" TAB_VERB "%6.3" "-" COMPU_TAB_REF _CNV_S_2_STATUS_OK__269 /end COMPU_METHOD
/begin COMPU_VTAB _CNV_S_2_STATUS_OK__269 "" TAB_VERB 2 0 "Nsx_vld_nok_0" 1 "Nsx_vld_ok_1" /end COMPU_VTAB
/begin COMPU_METHOD _CNV_A_R_LINEAR_____272_CM "" RAT_FUNC "%6.3" "W/s" COEFFS 0 2.5e-002 0. 0 0 1 /end COMPU_METHOD
/begin COMPU_METHOD _CNV_A_R_LINEAR_____275_CM "" RAT_FUNC "%6.3" "ratio" COEFFS 0 255. 0. 0 0 1 /end COMPU_METHOD
/begin COMPU_METHOD _CNV_A_R_LINEAR_____289_CM "" RAT_FUNC "%6.3" "A" COEFFS 0 10000. 0. 0 0 1 /end COMPU_METHOD
/begin COMPU_METHOD _CNV_A_R_LINEAR_____292_CM "" RAT_FUNC "%6.3" "Nm/s" COEFFS 0 -1. 0. 0 0 1 /end COMPU_METHOD
/begin COMPU_METHOD _CNV_A_R_LINEAR_____293_CM "" RAT_FUNC "%6.3" "Nm/s" COEFFS 0 1. 0. 0 0 1 /end COMPU_METHOD
/begin COMPU_METHOD _CNV_A_R_LINEAR_____296_CM "" RAT_FUNC "%6.3" "1/s" COEFFS 0 10.24 0. 0 0 1 /end COMPU_METHOD
/begin COMPU_METHOD _CNV_A_R_LINEAR_____316_CM "" RAT_FUNC "%6.3" "ratio/s" COEFFS 0 8. 0. 0 0 1 /end COMPU_METHOD
/begin COMPU_METHOD _CNV_A_R_LINEAR_____319_CM "" RAT_FUNC "%6.3" "ratio" COEFFS 0 800. 0. 0 0 1 /end COMPU_METHOD
/begin COMPU_METHOD _CNV_S_4_STATUS_DSB_331_CM "" TAB_VERB "%6.3" "-" COMPU_TAB_REF _CNV_S_4_STATUS_DSB_331 /end COMPU_METHOD
/begin COMPU_VTAB _CNV_S_4_STATUS_DSB_331 "" TAB_VERB 4 10 "Nsx_lbup_shf_dg_dsb" 20 "Nsx_lbup_shf_stab" 30 "Nsx_lbup_shf_mes" 40 "Nsx_lbup_shf_dg_end" /end COMPU_VTAB
/begin COMPU_METHOD _CNV_A_R_LINEAR_____332_CM "" RAT_FUNC "%6.3" "1/Ohm" COEFFS 0 48.82800858317935 0. 0 0 1 /end COMPU_METHOD
/begin COMPU_METHOD _CNV_A_R_LINEAR_____333_CM "" RAT_FUNC "%6.3" "1/°CRK" COEFFS 0 1024. 0. 0 0 1 /end COMPU_METHOD
/begin COMPU_METHOD _CNV_A_R_LINEAR_____334_CM "" RAT_FUNC "%6.3" "-" COEFFS 0 327.68 0. 0 0 1 /end COMPU_METHOD
/begin COMPU_METHOD _CNV_A_R_LINEAR_____335_CM "" RAT_FUNC "%6.3" "-" COEFFS 0 128.0000321254983 0. 0 0 1 /end COMPU_METHOD
/begin COMPU_METHOD _CNV_A_R_LINEAR_____336_CM "" RAT_FUNC "%6.3" "-" COEFFS 0 327.68 16384. 0 0 1 /end COMPU_METHOD
/begin COMPU_METHOD _CNV_A_R_LINEAR_____337_CM "" RAT_FUNC "%6.3" "-" COEFFS 0 2048. 16384. 0 0 1 /end COMPU_METHOD
/begin COMPU_METHOD _CNV_S_4_STATUS_OK__338_CM "" TAB_VERB "%6.3" "" COMPU_TAB_REF _CNV_S_4_STATUS_OK__338 /end COMPU_METHOD
/begin COMPU_VTAB _CNV_S_4_STATUS_OK__338 "" TAB_VERB 4 0 "Nsx_vld_nok_0" 1 "Nsx_vld_ok_1" 2 "Nsx_vld_fail_2" 3 "Nsx_vld_fail_3" /end COMPU_VTAB
/begin COMPU_METHOD _CNV_A_R_LINEAR_____339_CM "" RAT_FUNC "%6.3" "-" COEFFS 0 256. -128. 0 0 1 /end COMPU_METHOD
/begin COMPU_METHOD _CNV_A_R_LINEAR_____340_CM "" RAT_FUNC "%6.3" "1/s" COEFFS 0 -1024. 0. 0 0 1 /end COMPU_METHOD
/begin COMPU_METHOD _CNV_A_R_LINEAR_____341_CM "" RAT_FUNC "%6.3" "1/s" COEFFS 0 1024. 0. 0 0 1 /end COMPU_METHOD
/begin COMPU_METHOD _CNV_A_R_LINEAR_____342_CM "" RAT_FUNC "%6.3" "" COEFFS 0 256. 0. 0 0 1 /end COMPU_METHOD
/begin COMPU_METHOD _CNV_A_R_LINEAR_____343_CM "" RAT_FUNC "%6.3" "1/s" COEFFS 0 -32. 0. 0 0 1 /end COMPU_METHOD
/begin COMPU_METHOD _CNV_A_R_LINEAR_____344_CM "" RAT_FUNC "%6.3" "1/s" COEFFS 0 32. 0. 0 0 1 /end COMPU_METHOD
/begin COMPU_METHOD _CNV_A_R_LINEAR_____345_CM "" RAT_FUNC "%6.3" "Nm/s" COEFFS 0 0.64 0. 0 0 1 /end COMPU_METHOD
/begin COMPU_METHOD _CNV_A_R_LINEAR_____346_CM "" RAT_FUNC "%6.3" "1/s" COEFFS 0 -10.24 0. 0 0 1 /end COMPU_METHOD
/begin COMPU_METHOD _CNV_S_3_RANGE_STAT_348_CM "" TAB_VERB "%6.3" "-" COMPU_TAB_REF _CNV_S_3_RANGE_STAT_348 /end COMPU_METHOD
/begin COMPU_VTAB _CNV_S_3_RANGE_STAT_348 "" TAB_VERB 3 0 "Nsx_stal_acs_ena" 1 "Nsx_stal_ac_ant_dsb" 2 "Nsx_stal_acs_dsb" /end COMPU_VTAB
/begin COMPU_METHOD _CNV_A_R_LINEAR_____349_CM "" RAT_FUNC "%6.3" "ratio/s" COEFFS 0 512. 0. 0 0 1 /end COMPU_METHOD
/begin COMPU_METHOD _CNV_A_R_LINEAR_____350_CM "" RAT_FUNC "%6.3" "s/rpm" COEFFS 0 16384. 0. 0 0 1 /end COMPU_METHOD
/begin COMPU_METHOD _CNV_A_R_LINEAR_____351_CM "" RAT_FUNC "%6.3" "1/rpm" COEFFS 0 8192. 0. 0 0 1 /end COMPU_METHOD
/begin COMPU_METHOD _CNV_A_R_LINEAR_____352_CM "" RAT_FUNC "%6.3" "Nm/s" COEFFS 0 2. 0. 0 0 1 /end COMPU_METHOD
/begin COMPU_METHOD _CNV_A_R_LINEAR_____353_CM "" RAT_FUNC "%6.3" "km/h/s" COEFFS 0 1. 0. 0 0 1 /end COMPU_METHOD
/begin COMPU_METHOD _CNV_A_R_LINEAR_____354_CM "" RAT_FUNC "%6.3" "s" COEFFS 0 2.5 0. 0 0 1 /end COMPU_METHOD
/begin COMPU_METHOD _CNV_A_R_LINEAR_____355_CM "" RAT_FUNC "%6.3" "W/s" COEFFS 0 -0.1 0. 0 0 1 /end COMPU_METHOD
/begin COMPU_METHOD _CNV_A_R_LINEAR_____356_CM "" RAT_FUNC "%6.3" "W/s" COEFFS 0 0.1 0. 0 0 1 /end COMPU_METHOD
/begin COMPU_METHOD _CNV_A_R_LINEAR_____357_CM "" RAT_FUNC "%6.3" "W/rpm" COEFFS 0 13107.19999999999 0. 0 0 1 /end COMPU_METHOD
/begin COMPU_METHOD _CNV_A_R_LINEAR_____358_CM "" RAT_FUNC "%6.3" "W/Bar" COEFFS 0 10. 0. 0 0 1 /end COMPU_METHOD
/begin COMPU_METHOD _CNV_A_R_LINEAR_____359_CM "" RAT_FUNC "%6.3" "W/rpm/Bar" COEFFS 0 13107.19999999999 0. 0 0 1 /end COMPU_METHOD
/begin COMPU_METHOD _CNV_A_R_LINEAR_____360_CM "" RAT_FUNC "%6.3" "N" COEFFS 0 0.5 10000. 0 0 1 /end COMPU_METHOD
/begin COMPU_METHOD _CNV_A_R_LINEAR_____361_CM "" RAT_FUNC "%6.3" "N" COEFFS 0 0.5 0. 0 0 1 /end COMPU_METHOD
/begin COMPU_METHOD _CNV_A_R_LINEAR_____362_CM "" RAT_FUNC "%6.3" "W" COEFFS 0 5.e-004 0. 0 0 1 /end COMPU_METHOD
/begin COMPU_METHOD _CNV_A_R_LINEAR_____363_CM "" RAT_FUNC "%6.3" "ratio" COEFFS 0 65535. 0. 0 0 1 /end COMPU_METHOD
/begin COMPU_METHOD _CNV_A_R_LINEAR_____364_CM "" RAT_FUNC "%6.3" "Nm/rpm" COEFFS 0 255. 0. 0 0 1 /end COMPU_METHOD
/begin COMPU_METHOD _CNV_A_R_LINEAR_____365_CM "" RAT_FUNC "%6.3" "rpm/s" COEFFS 0 1.e-002 0. 0 0 1 /end COMPU_METHOD
/begin COMPU_METHOD _CNV_A_R_LINEAR_____366_CM "" RAT_FUNC "%6.3" "Nm/km/h" COEFFS 0 10.28015717235924 0. 0 0 1 /end COMPU_METHOD
/begin COMPU_METHOD _CNV_A_R_LINEAR_____367_CM "" RAT_FUNC "%6.3" "ratio/s" COEFFS 0 255. 0. 0 0 1 /end COMPU_METHOD
/begin RECORD_LAYOUT _REC_S1VAL_20_u4 FNC_VALUES 1 ULONG COLUMN_DIR DIRECT /end RECORD_LAYOUT
/begin RECORD_LAYOUT _REC_S1VAL_20_u1 FNC_VALUES 1 UBYTE COLUMN_DIR DIRECT /end RECORD_LAYOUT
/begin RECORD_LAYOUT _REC_A2AXS_20_u1 NO_AXIS_PTS_X 1 UBYTE AXIS_PTS_X 2 UBYTE INDEX_INCR DIRECT /end RECORD_LAYOUT
/begin RECORD_LAYOUT _REC_S1VAL_20_u2 FNC_VALUES 1 UWORD COLUMN_DIR DIRECT /end RECORD_LAYOUT
/begin RECORD_LAYOUT _REC_S1VAL_20_s2 FNC_VALUES 1 SWORD COLUMN_DIR DIRECT /end RECORD_LAYOUT
/begin RECORD_LAYOUT _REC_A2AXS_20_u2 NO_AXIS_PTS_X 1 UWORD AXIS_PTS_X 2 UWORD INDEX_INCR DIRECT /end RECORD_LAYOUT
/begin RECORD_LAYOUT _REC_A1CUR_20_u1_u2 FNC_VALUES 1 UBYTE COLUMN_DIR DIRECT /end RECORD_LAYOUT
/begin RECORD_LAYOUT _REC_A1CUR_20_u1_u1 FNC_VALUES 1 UBYTE COLUMN_DIR DIRECT /end RECORD_LAYOUT
/begin RECORD_LAYOUT _REC_A1CUR_20_u2_u1 FNC_VALUES 1 UWORD COLUMN_DIR DIRECT /end RECORD_LAYOUT
/begin RECORD_LAYOUT _REC_A1MAP_20_u2_u2_u2 FNC_VALUES 1 UWORD COLUMN_DIR DIRECT /end RECORD_LAYOUT
/begin RECORD_LAYOUT _REC_A1CUR_20_u2_u2 FNC_VALUES 1 UWORD COLUMN_DIR DIRECT /end RECORD_LAYOUT
/begin RECORD_LAYOUT _REC_A1MAP_20_u2_u2_u1 FNC_VALUES 1 UWORD COLUMN_DIR DIRECT /end RECORD_LAYOUT
/begin RECORD_LAYOUT _REC_A1MAP_20_u1_u2_u2 FNC_VALUES 1 UBYTE COLUMN_DIR DIRECT /end RECORD_LAYOUT
/begin RECORD_LAYOUT _REC_A1MAP_20_u1_u2_u1 FNC_VALUES 1 UBYTE COLUMN_DIR DIRECT /end RECORD_LAYOUT
/begin FUNCTION InCbiUli_Alcoxxx "" /begin DEF_CHARACTERISTIC Cmp_n_eal_lbup_v_thd_alco /end DEF_CHARACTERISTIC /begin OUT_MEASUREMENT Vxx_lbup_v_thd_alco /end OUT_MEASUREMENT /end FUNCTION
/begin FUNCTION InCbiUli_Lbupshf ""
 /begin DEF_CHARACTERISTIC Cxx_conf_diag_lbup_shf Cxx_dfdec_lbup_shf_h Cxx_dfdec_lbup_shf_l Cxx_dfinc_lbup_shf_h Cxx_dfinc_lbup_shf_l Cxx_lbup_lean_min_thd_v Cxx_lbup_rich_max_thd_v Cxx_lbup_shf_diag_gear Cxx_lbup_shf_lean_per_nr Cxx_lbup_shf_lean_per_ok_v Cxx_lbup_shf_lean_thd_nr Cxx_lbup_shf_maf_dif_max Cxx_lbup_shf_maf_max Cxx_lbup_shf_maf_min Cxx_lbup_shf_n_max Cxx_lbup_shf_n_min Cxx_lbup_shf_rich_per_nr Cxx_lbup_shf_rich_per_ok_v Cxx_lbup_shf_rich_thd_nr Cxx_lbup_shf_stab_dly Cxx_lbup_shf_tco_min Cxx_lgl_dly_diag_lbup_shf /end DEF_CHARACTERISTIC
 /begin OUT_MEASUREMENT Vbx_df_lbup_shf_h Vbx_df_lbup_shf_l Vbx_diag_ena_lbup_shf_h Vbx_diag_ena_lbup_shf_l Vbx_ena_diag_lbup_shf Vbx_inhi_ena_diag_lbup_shf Vbx_lbup_shf_diag_stop Vbx_lbup_shf_lean Vbx_lbup_shf_lean_mes Vbx_lbup_shf_lean_per_ok Vbx_lbup_shf_rich Vbx_lbup_shf_rich_mes Vbx_lbup_shf_rich_per_ok Vbx_phy_ena_diag_lbup_shf Vbx_sw_ena_diag_lbup_shf Vsx_lbup_shf_stt Vxx_lbup_shf_dly_ctr Vxx_lbup_shf_lean_per_ctr Vxx_lbup_shf_lean_per_dft_ctr Vxx_lbup_shf_rich_per_ctr Vxx_lbup_shf_rich_per_dft_ctr Vxx_lbup_shf_stab_dly Vxx_lgl_dly_diag_lbup_shf /end OUT_MEASUREMENT
/end FUNCTION
/begin FUNCTION BiAtiDli "" /begin DEF_CHARACTERISTIC c_ilsh_down_gain c_ilsh_down_ofs /end DEF_CHARACTERISTIC /begin OUT_MEASUREMENT Vxx_sens_lbdw_v ilsh_down vls_down[0] vlsh_down /end OUT_MEASUREMENT /end FUNCTION
/begin FUNCTION PcTraArb "" /begin SUB_FUNCTION PcTraArb_Arbitxx PcTraArb_Drlimxx PcTraArb_Gbmatxx /end SUB_FUNCTION /end FUNCTION
/begin FUNCTION PcTraArb_Arbitxx "" /begin DEF_CHARACTERISTIC Cxx_ctl_mux_act_thd /end DEF_CHARACTERISTIC
 /begin OUT_MEASUREMENT Vbx_tq_trs_ctl_mux Vbx_tq_trs_ctl_mux_act Vxx_arb_agb_tqe_raw Vxx_arb_agb_tqe_sp Vxx_arb_agb_tqe_tgt Vxx_arb_esp_tqe_raw Vxx_arb_esp_tqe_sp Vxx_arb_esp_tqe_tgt Vxx_arb_etc_tqe_raw Vxx_arb_etc_tqe_sp Vxx_arb_etc_tqe_tgt Vxx_arb_no_agb_tqe Vxx_arb_tqe_raw Vxx_arb_tqe_sp Vxx_arb_tqe_tgt Vxx_raw_arb_no_agb_tqe /end OUT_MEASUREMENT
/end FUNCTION
/begin FUNCTION PcTraArb_Drlimxx "" /begin OUT_MEASUREMENT Vxx_lim_driv_tqe_sp Vxx_lim_driv_tqe_tgt /end OUT_MEASUREMENT /end FUNCTION
/begin FUNCTION PcTraArb_Gbmatxx ""
 /begin OUT_MEASUREMENT Vxx_gbx_max_tqe_sp Vxx_gbx_max_tqe_tgt Vxx_gbx_min_tqe_sp Vxx_gbx_min_tqe_tgt /end OUT_MEASUREMENT
/end FUNCTION
/begin FUNCTION TqSetFtr ""
 /begin SUB_FUNCTION TqSetFtr_Ajsisxx TqSetFtr_Drcutxx TqSetFtr_Checkxx TqSetFtr_Flcdnxx TqSetFtr_Knkscxx TqSetFtr_Schedul TqSetFtr_Drcutcd TqSetFtr_Rumblex /end SUB_FUNCTION
/end FUNCTION
/begin FUNCTION TqSetFtr_Ajsisxx ""
 /begin DEF_CHARACTERISTIC Cbx_ovn_nul_tqi_sp_cfm Cbx_tqi_raw_bch_cfm Cbx_tqi_sp_bch_cfm Cbx_tqi_tgt_bch_cfm Cxx_ajs_cor_lim_tq_ofs Cxx_tqi_raw_bch Cxx_tqi_sp_bch Cxx_tqi_tgt_bch /end DEF_CHARACTERISTIC
 /begin OUT_MEASUREMENT Vxx_max_dyn_avl_tqi Vxx_max_stat_avl_tqi_ovn Vxx_tqi_rat_tgt Vxx_tqi_raw Vxx_tqi_sp Vxx_tqi_sp_no_ajs Vxx_tqi_tgt /end OUT_MEASUREMENT
/end FUNCTION
/begin FUNCTION TqSetFtr_Drcutxx "" /begin DEF_CHARACTERISTIC Ctp_cut_decl_dly Cxx_cut_decl_dly_tq_rat /end DEF_CHARACTERISTIC
 /begin OUT_MEASUREMENT Vbx_cut_ct Vbx_cut_dly_off_trs_3 Vbx_cut_dly_on_trs_2 Vbx_cut_off_dly_trs_1 Vbx_swi_drv_cut Vbx_swi_drv_cut_n Vsx_driv_cut_req /end OUT_MEASUREMENT
/end FUNCTION
/begin FUNCTION TqSetFtr_Checkxx "" /begin DEF_CHARACTERISTIC Ctp_n_min_bas_cor_fac /end DEF_CHARACTERISTIC
 /begin OUT_MEASUREMENT Vxx_chk_arb_tqi_raw Vxx_chk_arb_tqi_sp Vxx_chk_arb_tqi_tgt Vxx_iga_arb_tqi_tgt Vxx_knk_arb_tqi_tgt Vxx_min_arb_tqi[0] Vxx_min_arb_tqi[1] Vxx_raw_min_bas_tq_cor Vxx_sta_tq_raw Vxx_wup_arb_tqi_tgt /end OUT_MEASUREMENT
/end FUNCTION
/begin FUNCTION TqSetFtr_Flcdnxx ""
 /begin DEF_CHARACTERISTIC Ctp_n_h_thr_tq Cbx_spg_fl_cfm Cbx_tq_trs_ctl_mux_efv_cfm Cxx_acel_pdl_ufld_it_hys Cxx_acel_pdl_ufld_it_thd Cxx_fl_tq_hys Cxx_fl_tq_hys2 Cxx_fl_tq_ofs Cxx_fl_tq_spg_hys /end DEF_CHARACTERISTIC
 /begin OUT_MEASUREMENT Vbx_fl Vbx_kd_fl_ena Vbx_spg_fl_ena Vbx_ufld_fl_ena /end OUT_MEASUREMENT
/end FUNCTION
/begin FUNCTION TqSetFtr_Knkscxx ""
 /begin DEF_CHARACTERISTIC Ctb_knk_iga_slow_cor_mv Cmp_knk_rel_tq_cor_max Cbx_knk_out_tq_cor Cxx_knk_iga_cor_fil_ftc Cxx_knk_slow_fil_mv_hys Cxx_knk_slow_fil_mv_iga Cxx_knk_slow_iga_efy Cxx_knk_slow_iga_efy_hys Cxx_knk_tq_cor_dec_dly Cxx_knk_tq_cor_dec_fac Cxx_knk_tq_cor_dec_ofs Cxx_knk_tq_cor_inc_dly Cxx_knk_tq_cor_inc_fac Cxx_knk_tq_cor_inc_ofs /end DEF_CHARACTERISTIC
 /begin OUT_MEASUREMENT Vxx_knk_iga_cor_fil_mv Vxx_knk_iga_cor_mv Vxx_knk_iga_slow_cor_mv Vxx_knk_rel_tq_appl_cor Vxx_knk_rel_tq_cor Vxx_knk_rel_tq_cor_dec Vxx_knk_rel_tq_cor_inc Vxx_knk_rel_tq_cor_max Vxx_knk_tq_cor_dec_dly Vxx_knk_tq_cor_inc_dly /end OUT_MEASUREMENT
/end FUNCTION
/begin FUNCTION TqSetFtr_Schedul "" /begin DEF_CHARACTERISTIC Cbx_wg_abst_pres_cho_cfm /end DEF_CHARACTERISTIC /begin OUT_MEASUREMENT Vbx_wg_abst_pres_cfm /end OUT_MEASUREMENT /end FUNCTION
/begin FUNCTION TqSetFtr_Drcutcd ""
 /begin DEF_CHARACTERISTIC Ctb_tco_cut Ctp_tco_cut_decl_off_dly Cbx_ant_gear_coup_cut_ct_ena Cxx_aut_swi1_is_ofs Cxx_aut_swi1_is_ofs_alco Cxx_aut_swi_is_ofs Cxx_aut_swi_is_ofs_alco Cxx_cut_decl_tco_thd Cxx_cut_decl_tco_thd_alco Cxx_cut_decl_tqi_thd Cxx_cut_n_ofs Cxx_cut_n_ofs2 Cxx_cut_n_ofs2_alco Cxx_cut_n_ofs_alco Cxx_decl_cut_n_ac_ofs Cxx_decl_cut_n_ac_ofs_alco Cxx_decl_cut_n_ofs Cxx_decl_cut_n_ofs_alco Cxx_kd_decl_cut_n_ac_alco Cxx_kd_decl_cut_n_ac_ofs Cxx_kd_decl_cut_n_ofs Cxx_kd_decl_cut_n_ofs_alco Cxx_swi_drv_is_ofs Cxx_swi_drv_is_ofs_alco Cxx_swi_drv_n_thd Cxx_swi_drv_n_thd_alco Cxx_tq_fuel_typ_rat_cut_dft Cxx_wet_fuel_typ_rat_cut_dft /end DEF_CHARACTERISTIC
 /begin OUT_MEASUREMENT Vbx_ant_gear_coup_cut_ct_1 Vbx_cut_cdn Vbx_swi_drv_n Vxx_ena_cut_n_ofs Vxx_swi_cut_n_ofs Vxx_swi_drv_cut_n_ofs Vxx_tq_fuel_typ_rat_cs Vxx_tq_fuel_typ_rat_cs_1 /end OUT_MEASUREMENT
/end FUNCTION
/begin FUNCTION TqSetFtr_Rumblex ""
 /begin DEF_CHARACTERISTIC Ctb_rmb_ctr Ctb_rmb_fil_iga_efy Ctb_rmb_mat Ctb_rmb_n_mv Ctb_rmb_tco Ctp_rmb_ctr_tq_cor Ctp_rmb_iga_efy_inc_prop_fac Ctp_rmb_mat_inc_prop_fac Ctp_rmb_n_mv_eal_lim Ctp_rmb_n_tq_cor_max Ctp_rmb_tco_inc_prop_fac Cxx_rmb_dec_prop Cxx_rmb_eal_ftc Cxx_rmb_iga_efy_ftc Cxx_rmb_inc_prop /end DEF_CHARACTERISTIC
 /begin OUT_MEASUREMENT Vxx_rmb_ctr Vxx_rmb_ctr_dif Vxx_rmb_eal_rel Vxx_rmb_fil_eal Vxx_rmb_fil_iga_efy Vxx_rmb_rel_tq_appl_cor /end OUT_MEASUREMENT
/end FUNCTION
/begin FUNCTION InVfiCri "" /begin SUB_FUNCTION InVfiCri_Keyxxxx InVfiCri_Mngtxcs /end SUB_FUNCTION /end FUNCTION
/begin FUNCTION InVfiCri_Keyxxxx "" /begin OUT_MEASUREMENT Vbx_igk /end OUT_MEASUREMENT /end FUNCTION
/begin FUNCTION InVfiCri_Mngtxcs ""
 /begin OUT_MEASUREMENT Vbx_vh_key Vsx_ena_sta_agb Vsx_ena_sta_agb_vld Vsx_sta_stt_vld Vxx_sta_stt /end OUT_MEASUREMENT
/end FUNCTION
/begin FUNCTION TqLimMxt ""
 /begin SUB_FUNCTION TqLimMxt_Gbxlixx TqLimMxt_Maxtqxx TqLimMxt_Ovhtqxx TqLimMxt_Protqxx TqLimMxt_Statlxx TqLimMxt_Tqramsx TqLimMxt_Fstqcfx TqLimMxt_Protcxx TqLimMxt_Alcoxxx TqLimMxt_Noitqxx TqLimMxt_Schedul /end SUB_FUNCTION
/end FUNCTION
/begin FUNCTION TqLimMxt_Gbxlixx ""
 /begin DEF_CHARACTERISTIC Ctb_n_gb_clu_tq_lim Cmp_n_gear_gb_clu_lim_tq Cxx_gear_dft_lim_tq /end DEF_CHARACTERISTIC
 /begin OUT_MEASUREMENT Vxx_max_agb_tqe Vxx_max_gbx_tqe Vxx_max_mgb_tqe /end OUT_MEASUREMENT
/end FUNCTION
/begin FUNCTION TqLimMxt_Maxtqxx ""
 /begin DEF_CHARACTERISTIC Ctb_eng_amp Cmp_amp_n_max_tqi_cor Cmp_mat_n_max_tqi_cor Ctp_n_gear_tqe_max_h Ctp_n_gear_tqe_max_l Ctp_n_max_tq_rs Ctp_n_max_tqi Ctp_n_max_tqi_lih Ctp_n_tqi_dyn_lim Cbx_tq_max_rs_tqi_or_tqe Cxx_gear_max_tqe_h Cxx_tq_max_rs_slop_neg Cxx_tq_max_rs_slop_pos Cxx_tqe_max_gear_slop_neg Cxx_tqe_max_gear_slop_pos /end DEF_CHARACTERISTIC
 /begin OUT_MEASUREMENT Vxx_max_avl_tqe Vxx_max_dyn_avl_tqe Vxx_max_gear_avl_tqe Vxx_max_tq_dyn_mod_req Vxx_max_tqi Vxx_max_tqi_alti_mat_cor Vxx_max_tqi_cor Vxx_max_tqi_inj_cut Vxx_raw_max_tqi Vxx_tot_max_avl_tqe Vxx_tqe_max_gear Vxx_tqe_max_rs /end OUT_MEASUREMENT
/end FUNCTION
/begin FUNCTION TqLimMxt_Ovhtqxx ""
 /begin DEF_CHARACTERISTIC Ctb_ovh_n Ctb_ovh_tco Ctb_ovh_toil Ctb_ovh_up_it_temp Ctb_ovh_vs Cmp_n_vs_ovh_tq_fac Ctp_n_ovh_tq_fac Ctp_tco_ovh_tq Ctp_temp_ovh_tq Cbx_ovh_temp_cfm /end DEF_CHARACTERISTIC
 /begin OUT_MEASUREMENT Vxx_ovh_prot_tq /end OUT_MEASUREMENT
/end FUNCTION
/begin FUNCTION TqLimMxt_Protqxx ""
 /begin DEF_CHARACTERISTIC Ctb_tco_lim_tqi Cmp_n_tco_lim_tqi Ctp_n_min_gas_lim_tq Cxx_min_gas_dec Cxx_min_gas_inc /end DEF_CHARACTERISTIC
 /begin OUT_MEASUREMENT Vxx_max_prot_tqe Vxx_min_fuel /end OUT_MEASUREMENT
/end FUNCTION
/begin FUNCTION TqLimMxt_Statlxx "" /begin DEF_CHARACTERISTIC Cxx_max_pow_gear /end DEF_CHARACTERISTIC /begin OUT_MEASUREMENT Vxx_max_pow_tqe Vxx_max_stat_avl_tqe /end OUT_MEASUREMENT /end FUNCTION
/begin FUNCTION TqLimMxt_Tqramsx ""
 /begin DEF_CHARACTERISTIC Ctb_max_rams_tqe_3 Ctb_max_rams_tqi_1 Ctb_max_rams_tqi_2 Ctp_max_rams_tqe_3 Ctp_max_rams_tqi_1 Ctp_max_rams_tqi_2 Cbx_tq_rams_lim_act_3_bch_cfm Cxx_max_rams_tqe_1_slop Cxx_max_rams_tqe_2_slop Cxx_max_rams_tqe_3_slop Cxx_max_rams_tqe_3_srs Cxx_max_rams_tqe_sta_slop /end DEF_CHARACTERISTIC
 /begin OUT_MEASUREMENT Vbx_max_rams_tqe_1_on Vbx_max_rams_tqe_2_on Vbx_max_rams_tqe_3_on Vsx_tq_rams_lim_vld Vxx_lim_max_rams_tqe Vxx_max_rams_tqe_1 Vxx_max_rams_tqe_2 Vxx_max_rams_tqe_3 /end OUT_MEASUREMENT
/end FUNCTION
/begin FUNCTION TqLimMxt_Fstqcfx "" /begin DEF_CHARACTERISTIC Cxx_tq_lim_spg_reg_cfm /end DEF_CHARACTERISTIC
 /begin OUT_MEASUREMENT Vbx_tq_rams_lim_act_1 Vbx_tq_rams_lim_act_2 Vbx_tq_rams_lim_act_3 /end OUT_MEASUREMENT
/end FUNCTION
/begin FUNCTION TqLimMxt_Protcxx "" /begin OUT_MEASUREMENT Vbx_max_prot_spg_tqe_act Vxx_max_prot_spg_tqe /end OUT_MEASUREMENT /end FUNCTION
/begin FUNCTION TqLimMxt_Alcoxxx ""
 /begin DEF_CHARACTERISTIC Cmp_amp_n_max_tqi_cor_alco Cmp_n_tco_lim_tqi_alco Ctp_mat_max_tqi_cor_alco Ctp_n_max_tqi_alco /end DEF_CHARACTERISTIC
 /begin OUT_MEASUREMENT Vxx_max_tqi_cor_alco Vxx_n_max_tqi_alco Vxx_n_tco_lim_tqi_alco /end OUT_MEASUREMENT
/end FUNCTION
/begin FUNCTION TqLimMxt_Noitqxx ""
 /begin DEF_CHARACTERISTIC Ctb_n_noi_lim Ctp_n_max_tqe_noi Cxx_noi_lim_amp_thd Cxx_noi_lim_dly_det Cxx_noi_lim_dly_max Cxx_noi_lim_gear Cxx_noi_lim_pdl_rat_hys Cxx_noi_lim_pdl_rat_thd Cxx_noi_lim_pos_neg Cxx_noi_lim_pos_slop Cxx_noi_lim_thd_vs_max_thd Cxx_noi_lim_thd_vs_min_thd /end DEF_CHARACTERISTIC
 /begin OUT_MEASUREMENT Vbx_noi_lim_ena Vxx_max_noi_tqe Vxx_noi_lim_rat /end OUT_MEASUREMENT
/end FUNCTION
/begin FUNCTION TqLimMxt_Schedul "" /begin OUT_MEASUREMENT Vbx_rs_noi_lim_cfm /end OUT_MEASUREMENT /end FUNCTION
/begin FUNCTION BiCbiUli "" /begin DEF_CHARACTERISTIC c_ilsh_up_gain c_ilsh_up_ofs /end DEF_CHARACTERISTIC /begin OUT_MEASUREMENT Vxx_sens_lbup_v ilsh_up vls_up_raw[0] vlsh_up /end OUT_MEASUREMENT /end FUNCTION
/begin FUNCTION CbFfwSck "" /begin SUB_FUNCTION CbFfwSck_Ufldxxx /end SUB_FUNCTION /end FUNCTION
/begin FUNCTION CbFfwSck_Ufldxxx "" /begin DEF_CHARACTERISTIC Cxx_ufld_tco_thd /end DEF_CHARACTERISTIC /begin OUT_MEASUREMENT Vbx_ufld_cut /end OUT_MEASUREMENT /end FUNCTION
/begin FUNCTION TqSetAcs "" /begin SUB_FUNCTION TqSetAcs_Mngtxbc TqSetAcs_Mngtxxx /end SUB_FUNCTION /end FUNCTION
/begin FUNCTION TqSetAcs_Mngtxbc "" /begin OUT_MEASUREMENT Vbx_eng_spc_acs_dsb /end OUT_MEASUREMENT /end FUNCTION
/begin FUNCTION TqSetAcs_Mngtxxx ""
 /begin DEF_CHARACTERISTIC Ctb_n_alt Ctb_rbst_el_csm_dsb_amp Cmp_alt_slop_req Ctd_rbst_el_csm_dsb_gear Ctp_perf_acs_dsb_max_avl_tqe Ctp_rbst_el_csm_dsb_tco_thd Ctp_sta_ac_ptc_dsb_dly Ctp_sta_alt_dsb_dly Ctp_stal_ac_dsb_n_ofs Ctp_stal_acs_dsb_n Cbx_ac_max_pow_ena_cfm Cbx_acel_is_ac_dsb_cfm Cbx_eng_spc_ac_dsb_cfm Cbx_eng_spc_alt_dsb_cfm Cbx_eng_spc_ptc_dsb_cfm Cbx_eng_spc_thpl_dsb_cfm Cbx_perf_ac_dsb_cfm Cbx_perf_ptc_dsb_cfm Cbx_perf_thpl_dsb_cfm Cbx_rbst_ptc_dsb_cfm Cbx_rbst_thpl_dsb_cfm Cbx_sta_thpl_dsb_cfm Cbx_stal_ac_dsb_cfm Cbx_stal_ac_max_tq_prop_cfm Cbx_stal_alt_dsb_cfm Cbx_stal_ptc_dsb_cfm Cbx_stal_thpl_dsb_cfm Cbx_tkof_ac_dsb_cfm Cbx_tkof_acs_dsb_rwhs_cfm Cbx_tkof_alt_dsb_cfm Cbx_tkof_ptc_dsb_cfm Cbx_tkof_thpl_dsb_cfm Cxx_acel_is_ac_dsb_dly Cxx_acel_is_ac_dsb_rat Cxx_acs_amp_dft_val Cxx_acs_ena_dly Cxx_alt_min_pow_ena Cxx_perf_ac_amp_h_thd Cxx_perf_ac_amp_l_thd Cxx_perf_acs_dsb_dly Cxx_perf_acs_dsb_h_gear Cxx_perf_acs_dsb_l_gear Cxx_perf_acs_dsb_n Cxx_perf_acs_dsb_pdl_grd Cxx_perf_acs_dsb_pdl_grd_t Cxx_perf_acs_dsb_pdl_rat Cxx_perf_acs_dsb_tqe_dif Cxx_perf_acs_ena_n Cxx_perf_acs_ena_pdl_rat Cxx_rbst_el_csm_dsb_gear_dly Cxx_rbst_el_csm_dsb_n Cxx_rbst_el_csm_dsb_tco_hys Cxx_rbst_el_csm_ena_n Cxx_stal_ac_max_tq_d Cxx_stal_ac_max_tq_dft_val Cxx_stal_ac_max_tq_p Cxx_stal_ac_max_tq_ref Cxx_stal_ac_max_tq_slop Cxx_stal_ac_max_tq_thd Cxx_stal_acs_dsb_dly Cxx_stal_alt_ac_amp_h_thd Cxx_stal_alt_ac_amp_l_thd Cxx_tkof_acs_dsb_coup_dly Cxx_tkof_acs_dsb_dly Cxx_tkof_acs_dsb_n Cxx_tkof_acs_dsb_pwt_sp Cxx_tkof_acs_dsb_rwhs_t Cxx_tkof_acs_dsb_tqe_sp_rat Cxx_tkof_acs_dsb_vs Cxx_tkof_acs_dsb_vs_pos_slop Cxx_tkof_acs_ena_pwt_sp Cxx_tkof_acs_ena_vs Cxx_tkof_acs_ena_zero_vs Cxx_tkof_alt_ac_amp_h_thd Cxx_tkof_alt_ac_amp_l_thd /end DEF_CHARACTERISTIC
 /begin OUT_MEASUREMENT Vbx_ac_dsb_req Vbx_ac_eng_dsb Vbx_ac_eng_frz Vbx_acel_is_ac_dsb Vbx_acs_frz Vbx_alt_dsb_req Vbx_alt_eng_dsb Vbx_perf_ac_dsb Vbx_perf_acs_dsb Vbx_perf_el_csm_dsb Vbx_ptc_cut Vbx_ptc_dsb_req Vbx_ptc_frz Vbx_rbst_el_csm_dsb Vbx_sfty_acs_dsb Vbx_sta_ac_ptc_dsb Vbx_sta_alt_dsb Vbx_stal_acs_dsb Vbx_stal_alt_ac_dsb Vbx_stal_el_csm_dsb Vbx_thpl_dsb_req Vbx_thpl_eng_dsb Vbx_thpl_eng_frz Vbx_tkof_acs_dsb Vbx_tkof_alt_ac_dsb Vbx_tkof_el_csm_dsb Vsx_stal_acs_dsb_stt Vxx_ac_max_pow_ena Vxx_acel_pdl_grd Vxx_acs_ena_dly Vxx_alt_max_pow_ena Vxx_alt_slop_req Vxx_ptc_max_pow_ena Vxx_stal_ac_ant_dsb_n Vxx_stal_ac_max_pow_ena Vxx_stal_ac_max_pow_ena_clc Vxx_stal_ac_max_tq Vxx_stal_ac_max_tq_clc Vxx_stal_acs_dsb_dly Vxx_stal_acs_dsb_n Vxx_tkof_acs_dsb_vs /end OUT_MEASUREMENT
/end FUNCTION
/begin FUNCTION InCbiFui "" /begin OUT_MEASUREMENT Vxx_fuel_lvl_mem_NVM /end OUT_MEASUREMENT
 /begin SUB_FUNCTION InCbiFui_Pumtqxx InCbiFui_Minfuxx InCbiFui_Schxxxx InCbiFui_Fulvlxx InCbiFui_Tkpress InCbiFui_Fldtfil InCbiFui_Admfldt /end SUB_FUNCTION
/end FUNCTION
/begin FUNCTION InCbiFui_Pumtqxx "" /begin OUT_MEASUREMENT Vxx_pump_tql /end OUT_MEASUREMENT /end FUNCTION
/begin FUNCTION InCbiFui_Minfuxx "" /begin DEF_CHARACTERISTIC Cxx_min_fuel_dly Cxx_no_min_fuel_dly /end DEF_CHARACTERISTIC /begin OUT_MEASUREMENT Vbx_min_fuel Vsx_min_fuel_vld Vxx_min_fuel_dly /end OUT_MEASUREMENT /end FUNCTION
/begin FUNCTION InCbiFui_Schxxxx "" /begin DEF_CHARACTERISTIC Cbx_sens_rvac_cfm /end DEF_CHARACTERISTIC /begin OUT_MEASUREMENT Vbx_sens_rvac_cfm /end OUT_MEASUREMENT /end FUNCTION
/begin FUNCTION InCbiFui_Fulvlxx "" /begin OUT_MEASUREMENT Vsx_fuel_lvl_vld Vxx_fuel_lvl /end OUT_MEASUREMENT /end FUNCTION
/begin FUNCTION InCbiFui_Tkpress ""
 /begin DEF_CHARACTERISTIC Cxx_dfdec_sens_rvc_h Cxx_dfdec_sens_rvc_l Cxx_dfdec_sens_rvc_nok Cxx_dfdec_sens_rvc_sig_mcut Cxx_dfinc_sens_rvc_h Cxx_dfinc_sens_rvc_l Cxx_dfinc_sens_rvc_nok Cxx_dfinc_sens_rvc_sig_mcut /end DEF_CHARACTERISTIC
 /begin OUT_MEASUREMENT Vsx_sens_rvac_vld /end OUT_MEASUREMENT
/end FUNCTION
/begin FUNCTION InCbiFui_Fldtfil ""
 /begin DEF_CHARACTERISTIC Cxx_aftr_sta_dly Cxx_fuel_fill_det_fac Cxx_fuel_fill_det_ofs Cxx_fuel_lvl_ini Cxx_fuel_lvl_max Cxx_is_stop_dly Cxx_vh_stop_dly /end DEF_CHARACTERISTIC
 /begin OUT_MEASUREMENT Vbx_fuel_fill_det Vbx_fuel_fill_max Vbx_fuel_lvl_chk Vbx_fuel_lvl_stop_chk Vbx_vh_stop Vsx_fuel_fill_det_vld Vxx_fuel_fill_det_thd Vxx_fuel_lvl_chk Vxx_fuel_lvl_stop /end OUT_MEASUREMENT
/end FUNCTION
/begin FUNCTION InCbiFui_Admfldt "" /begin OUT_MEASUREMENT Vbx_min_fuel2 /end OUT_MEASUREMENT /end FUNCTION
/begin FUNCTION InTqiAcs ""
 /begin SUB_FUNCTION InTqiAcs_Paltxcs InTqiAcs_Paltxmd InTqiAcs_Clmxxcs InTqiAcs_Clmxxmd InTqiAcs_Paltxfs InTqiAcs_Ptcpocs InTqiAcs_Clmcoxx InTqiAcs_Paltcox InTqiAcs_Rgbepcs InTqiAcs_Ptcxxmd /end SUB_FUNCTION
/end FUNCTION
/begin FUNCTION InTqiAcs_Paltxcs ""
 /begin DEF_CHARACTERISTIC Ctb_alt_n_fil_fac Ctb_alt_pow Ctb_alt_pow_cor_n Cmp_alt_pow_cor_val Ctp_alt_pow_fil_fac Cbx_sens_alt_pwm_pres_cfm Cxx_alt_pow_dsb_fil_fac Cxx_alt_pow_trs_dif_thd Cxx_alt_pow_trs_fil_dec Cxx_alt_pow_trs_fil_inc Cxx_alt_slop_dly Cxx_sta_alt_dec Cxx_sta_alt_inc /end DEF_CHARACTERISTIC
 /begin OUT_MEASUREMENT Vbx_alt_pow_trs Vsx_alt_pow_vld Vsx_fil_alt_pow_vld Vxx_alt_pow Vxx_alt_pow_fil_fac Vxx_alt_pow_load Vxx_fil_alt_pow Vxx_fil_alt_pow_load_trs Vxx_no_cor_raw_alt_pow /end OUT_MEASUREMENT
/end FUNCTION
/begin FUNCTION InTqiAcs_Paltxmd "" /begin OUT_MEASUREMENT Vsx_mdl_alt_pow_vld Vxx_mdl_alt_pow /end OUT_MEASUREMENT /end FUNCTION
/begin FUNCTION InTqiAcs_Clmxxcs ""
 /begin DEF_CHARACTERISTIC Ctb_ac_pow Ctb_ac_pow_cor_n Cmp_ac_pow_cor_val Ctp_ac_pow_dft_val /end DEF_CHARACTERISTIC
 /begin OUT_MEASUREMENT Vxx_ac_pow Vxx_no_cor_raw_ac_pow Vxx_raw_ac_pow /end OUT_MEASUREMENT
/end FUNCTION
/begin FUNCTION InTqiAcs_Clmxxmd ""
 /begin DEF_CHARACTERISTIC Cxx_ac_pow_max Cxx_ac_pow_min Cxx_ac_pow_n_fac Cxx_ac_pow_prs_fac Cxx_ac_pow_prs_n_fac Cxx_acr_eng_fac /end DEF_CHARACTERISTIC
 /begin OUT_MEASUREMENT Vsx_mdl_ac_pow_vld Vxx_mdl_ac_pow /end OUT_MEASUREMENT
/end FUNCTION
/begin FUNCTION InTqiAcs_Paltxfs ""
 /begin DEF_CHARACTERISTIC Cxx_alt_is_meca_pow Cxx_el_bk_wind_meca_pow Cxx_el_wind_meca_pow Cxx_eng_loss_pow_min Cxx_mdf1_meca_pow Cxx_mdf2_meca_pow Cxx_rgb_pump_meca_pow /end DEF_CHARACTERISTIC
 /begin OUT_MEASUREMENT Vxx_el_csm_mdl_pow /end OUT_MEASUREMENT
/end FUNCTION
/begin FUNCTION InTqiAcs_Ptcpocs "" /begin OUT_MEASUREMENT Vxx_ptc_pow /end OUT_MEASUREMENT /end FUNCTION
/begin FUNCTION InTqiAcs_Clmcoxx ""
 /begin DEF_CHARACTERISTIC Ctb_ac_pow_cor Ctp_ac_pow_cor Cxx_ac_pow_cor_dly Cxx_ac_pow_cor_slop /end DEF_CHARACTERISTIC
 /begin OUT_MEASUREMENT Vxx_ac_pow_cor /end OUT_MEASUREMENT
/end FUNCTION
/begin FUNCTION InTqiAcs_Paltcox ""
 /begin DEF_CHARACTERISTIC Cxx_alt_pow_cor_slop Cxx_alt_pwm_dft_alt_pow_fac Cxx_alt_pwm_dft_pwst_pow_fac Cxx_el_bk_wind_dly Cxx_el_bk_wind_pow_cor Cxx_el_bk_wind_pow_cor_dly Cxx_el_wind_dly Cxx_el_wind_pow_cor Cxx_el_wind_pow_cor_dly Cxx_mdf1_meca_pow_cor Cxx_mdf1_meca_pow_cor_dly Cxx_mdf2_meca_pow_cor Cxx_mdf2_meca_pow_cor_dly Cxx_mdf_meca_pow_cor_dly1 Cxx_ptc_meca_pow_cor_dly Cxx_ptc_meca_pow_cor_dly1 Cxx_ptc_meca_pow_cor_fac Cxx_pwst_on_is_cor_dly Cxx_rgb_pump_pow_cor Cxx_rgb_pump_pow_cor_dly Cxx_rgb_pump_pow_cor_dly1 Cxx_vh_run_tmp_pwst_cor Cxx_vh_stop_tmp_pwst_cor /end DEF_CHARACTERISTIC
 /begin OUT_MEASUREMENT Vbx_alt_pwm_dft Vbx_ptc_pow_dec Vbx_ptc_pow_inc Vbx_pwst_off_dly Vxx_alt_pow_cor Vxx_el_bk_pow_cor Vxx_el_wind_pow_cor Vxx_mdf1_pow_cor Vxx_mdf2_pow_cor Vxx_ptc_pow_cor Vxx_ptc_pow_cor_dly Vxx_ptc_pow_cor_dly1 Vxx_ptc_pow_inc Vxx_pwst_prs_pow_cor Vxx_rgb_pump_pow_cor /end OUT_MEASUREMENT
/end FUNCTION
/begin FUNCTION InTqiAcs_Rgbepcs "" /begin DEF_CHARACTERISTIC Cxx_rgb_pump_act_dly /end DEF_CHARACTERISTIC /begin OUT_MEASUREMENT Vbx_rgb_pump /end OUT_MEASUREMENT /end FUNCTION
/begin FUNCTION InTqiAcs_Ptcxxmd "" /begin OUT_MEASUREMENT Vxx_mdl_ptc_pow /end OUT_MEASUREMENT /end FUNCTION
/begin FUNCTION PcDrvDit ""
 /begin SUB_FUNCTION PcDrvDit_Pedlhxx PcDrvDit_Pedfmxx PcDrvDit_Drtqexx PcDrvDit_Drarbxx PcDrvDit_Ditcfxx PcDrvDit_Dynfmxx /end SUB_FUNCTION
/end FUNCTION
/begin FUNCTION PcDrvDit_Pedlhxx ""
 /begin DEF_CHARACTERISTIC Ctp_acel_pdl_lih_hys_n_h Ctp_acel_pdl_lih_n_sp Cbx_acel_pdl_lvl_cfm Cxx_acel_pdl_lih_hys_n_l Cxx_acel_pdl_lih_hys_vs_h Cxx_acel_pdl_lih_hys_vs_l Cxx_acel_pdl_lih_max_vs Cxx_acel_pdl_lih_min_l Cxx_acel_pdl_lih_n_ig Cxx_acel_pdl_lih_n_pg Cxx_acel_pdl_lih_n_sp_bpk_on Cxx_acel_pdl_lih_n_sp_srs Cxx_acel_pdl_lih_n_tqe_h Cxx_acel_pdl_lih_slop_h1 Cxx_acel_pdl_lih_slop_h2 Cxx_acel_pdl_lih_slop_n_h Cxx_acel_pdl_lih_slop_vs Cxx_acel_pdl_lih_vs_ig Cxx_acel_pdl_lih_vs_pg Cxx_acel_pdl_lih_vs_rvr Cxx_acel_pdl_lih_vs_sp Cxx_acel_pdl_lih_vs_tqe_h Cxx_acel_pdl_lvl_tqe_thd Cxx_acel_pdl_trs_slop_neg Cxx_acel_pdl_trs_slop_pos Cxx_max_pow /end DEF_CHARACTERISTIC
 /begin OUT_MEASUREMENT Vbx_acel_pdl_lih_act Vbx_acel_pdl_lih_dft_act Vbx_acel_pdl_lih_dft_prev Vbx_acel_pdl_lih_i_rst Vbx_acel_pdl_lih_min_cdn Vbx_acel_pdl_lih_n_i_frz Vbx_acel_pdl_lih_n_tqe_h Vbx_acel_pdl_lih_n_tqe_l Vbx_acel_pdl_lih_reg_swi Vbx_acel_pdl_lih_sp_cdn Vbx_acel_pdl_lih_vs_i_frz Vbx_acel_pdl_lih_vs_p_rst Vbx_acel_pdl_lih_vs_tqe_h Vbx_acel_pdl_lih_vs_tqe_l Vxx_acel_pdl_lih_n_dif Vxx_acel_pdl_lih_n_i Vxx_acel_pdl_lih_n_sp Vxx_acel_pdl_lih_n_tqe Vxx_acel_pdl_lih_pwt Vxx_acel_pdl_lih_pwt_load Vxx_acel_pdl_lih_pwt_sp Vxx_acel_pdl_lih_tqe_sp Vxx_acel_pdl_lih_vs_dif Vxx_acel_pdl_lih_vs_i Vxx_acel_pdl_lih_vs_sp Vxx_acel_pdl_lih_vs_tqe /end OUT_MEASUREMENT
/end FUNCTION
/begin FUNCTION PcDrvDit_Pedfmxx ""
 /begin DEF_CHARACTERISTIC Ctb_acel_pdl_fmt Ctp_acel_pdl_fmt_1 Ctp_acel_pdl_fmt_2 Cxx_acel_pdl_fmt_rvr_fac /end DEF_CHARACTERISTIC
 /begin OUT_MEASUREMENT Vsx_acel_pdl_pwt_sp_vld Vxx_acel_pdl_pwt_sp /end OUT_MEASUREMENT
/end FUNCTION
/begin FUNCTION PcDrvDit_Drtqexx ""
 /begin DEF_CHARACTERISTIC Ctb_driv_tqe_map_n Ctb_driv_tqe_map_pwt_sp Ctb_min_driv_tqe_pwt_sp Cmp_driv_tqe_map Cmp_min_driv_tqe_map Cbx_ref_max_pow_cfm Cxx_ref_max_pow /end DEF_CHARACTERISTIC
 /begin OUT_MEASUREMENT Vxx_driv_tqe_sp Vxx_main_driv_tqe_sp /end OUT_MEASUREMENT
/end FUNCTION
/begin FUNCTION PcDrvDit_Drarbxx ""
 /begin DEF_CHARACTERISTIC Ctb_min_max_forc_vs Ctp_max_forc Ctp_min_forc Cxx_no_driv_pwt_sp_hys Cxx_no_driv_pwt_sp_thd Cxx_no_virt_driv_pwt_sp_hys Cxx_no_virt_driv_pwt_sp_thd /end DEF_CHARACTERISTIC
 /begin OUT_MEASUREMENT Vbx_cru_acc_virt_driv_on Vbx_no_driv_pwt_sp Vbx_virt_driv_on Vsx_driv_pwt_sp_vld Vxx_acc_pwt_sp Vxx_acel_pdl_forc_sp Vxx_arb_driv_pwt_sp Vxx_cru_pwt_sp Vxx_driv_pwt_sp Vxx_max_forc Vxx_min_forc Vxx_sdl_pwt_sp Vxx_sl_pwt_sp /end OUT_MEASUREMENT
/end FUNCTION
/begin FUNCTION PcDrvDit_Ditcfxx "" /begin OUT_MEASUREMENT Vbx_acel_pdl_lih_min_spc_cdn /end OUT_MEASUREMENT /end FUNCTION
/begin FUNCTION PcDrvDit_Dynfmxx ""
 /begin DEF_CHARACTERISTIC Ctb_acel_pdl_fmt_fac_vs Ctb_acel_pdl_fmt_tkof_fac_driv Ctb_acel_pdl_fmt_tkof_fac_vs Ntb_rs_dspl_pdl_spt_fac Cmp_acel_pdl_fmt_rs_dspl_fac Cmp_acel_pdl_fmt_tkof_fac Ctp_acel_pdl_fmt_fac Ctp_acel_pdl_fmt_spt_fac Cbx_acel_pdl_fmt_mnl_cfm Cxx_acel_pdl_fac_spt_step_in Cxx_acel_pdl_fac_spt_step_out Cxx_acel_pdl_fmt_fac_delta Cxx_acel_pdl_fmt_mnl_fac Cxx_acel_pdl_rat_dyn_delta Cxx_pdl_fmt_fac_slop_swi_down Cxx_pdl_fmt_fac_slop_swi_up Cxx_tkof_cdn_vs_max Cxx_tkof_stop_vs /end DEF_CHARACTERISTIC
 /begin OUT_MEASUREMENT Vbx_acel_pdl_fmt_fac_med_req Vbx_acel_pdl_fmt_fac_spt_req Vbx_acel_pdl_rat_mem_ok Vxx_acel_pdl_fmt_fac Vxx_acel_pdl_fmt_fac_spt_step Vxx_acel_pdl_fmt_med_fac Vxx_acel_pdl_fmt_nom_fac Vxx_acel_pdl_fmt_spt_fac Vxx_acel_pdl_rat_dyn_mem Vxx_acel_pdl_rat_dyn_mem_ini /end OUT_MEASUREMENT
/end FUNCTION
/begin FUNCTION InTqiTrz "" /begin SUB_FUNCTION InTqiTrz_Corxxxx InTqiTrz_Mdlxxxx /end SUB_FUNCTION /end FUNCTION
/end MODULE
/end PROJECT
