ASAP2_VERSION 1 41
/begin PROJECT RD8 "_default_ProjectLongIdentifier"
/begin HEADER "_default_HeaderComment" PROJECT_NO RD9 /end HEADER
/begin MODULE _default_ModuleName "_default_ModuleLongIdentifier"
/begin MOD_COMMON "_default_ModCommonComment" DEPOSIT ABSOLUTE BYTE_ORDER MSB_LAST ALIGNMENT_BYTE 1 ALIGNMENT_WORD 2 ALIGNMENT_LONG 2 ALIGNMENT_FLOAT32_IEEE 2 ALIGNMENT_FLOAT64_IEEE 4 /end MOD_COMMON
/begin CHARACTERISTIC Cxx_dtc_obd_vb_rly_oc_scg "" VALUE 0xa002b146 _REC_S1VAL_20_u2 65535. _CNV_A_R_A_105_CM 0. 65535. DISPLAY_IDENTIFIER fm_cal_vb_rly_oc_scg.Cxx_dtc_obd_xxx /end CHARACTERISTIC
/begin CHARACTERISTIC Cxx_conf_wal_vb_rly_oc_scg "" VALUE 0xa002b148 _REC_S1VAL_20_u1 3. _CNV_A_R_A_105_CM 0. 3. DISPLAY_IDENTIFIER fm_cal_vb_rly_oc_scg.fm_static_bitfield.Cxx_conf_wal_xxx BIT_MASK 0x3 /end CHARACTERISTIC
/begin CHARACTERISTIC Cbx_obd_vb_rly_oc_scg "" VALUE 0xa002b148 _REC_S1VAL_20_u1 255. _CNV_A_R_A_105_CM 0. 255. DISPLAY_IDENTIFIER fm_cal_vb_rly_oc_scg.fm_static_bitfield.Cbx_obd_xxx BIT_MASK 0x4 /end CHARACTERISTIC
/begin CHARACTERISTIC Cbx_obd_mena_vb_rly_oc_scg "" VALUE 0xa002b148 _REC_S1VAL_20_u1 255. _CNV_A_R_A_105_CM 0. 255. DISPLAY_IDENTIFIER fm_cal_vb_rly_oc_scg.fm_static_bitfield.Cbx_obd_mena_xxx BIT_MASK 0x8 /end CHARACTERISTIC
/begin CHARACTERISTIC Cxx_dtc_lb_vb_rly_oc_scg "" VALUE 0xa002b149 _REC_S1VAL_20_u1 255. _CNV_A_R_A_105_CM 0. 255. DISPLAY_IDENTIFIER fm_cal_vb_rly_oc_scg.Cxx_dtc_lb_xxx /end CHARACTERISTIC
/begin CHARACTERISTIC Cxx_obd_dc_vb_rly_oc_scg "" VALUE 0xa002b14a _REC_S1VAL_20_u1 9. _CNV_A_R_A_105_CM 1. 10. DISPLAY_IDENTIFIER fm_cal_vb_rly_oc_scg.Cxx_obd_dc_xxx /end CHARACTERISTIC
/begin CHARACTERISTIC Cxx_obd_us_typ_vb_rly_oc_scg "" VALUE 0xa002b14b _REC_S1VAL_20_u1 255. _CNV_A_R_A_105_CM 0. 255. DISPLAY_IDENTIFIER fm_cal_vb_rly_oc_scg.Cxx_obd_us_typ_xxx /end CHARACTERISTIC
/begin CHARACTERISTIC Cxx_dtc_obd_vb_rly_scw "" VALUE 0xa002b152 _REC_S1VAL_20_u2 65535. _CNV_A_R_A_105_CM 0. 65535. DISPLAY_IDENTIFIER fm_cal_vb_rly_scw.Cxx_dtc_obd_xxx /end CHARACTERISTIC
/begin CHARACTERISTIC Cxx_conf_wal_vb_rly_scw "" VALUE 0xa002b154 _REC_S1VAL_20_u1 3. _CNV_A_R_A_105_CM 0. 3. DISPLAY_IDENTIFIER fm_cal_vb_rly_scw.fm_static_bitfield.Cxx_conf_wal_xxx BIT_MASK 0x3 /end CHARACTERISTIC
/begin CHARACTERISTIC Cbx_obd_vb_rly_scw "" VALUE 0xa002b154 _REC_S1VAL_20_u1 255. _CNV_A_R_A_105_CM 0. 255. DISPLAY_IDENTIFIER fm_cal_vb_rly_scw.fm_static_bitfield.Cbx_obd_xxx BIT_MASK 0x4 /end CHARACTERISTIC
/begin CHARACTERISTIC Cbx_obd_mena_vb_rly_scw "" VALUE 0xa002b154 _REC_S1VAL_20_u1 255. _CNV_A_R_A_105_CM 0. 255. DISPLAY_IDENTIFIER fm_cal_vb_rly_scw.fm_static_bitfield.Cbx_obd_mena_xxx BIT_MASK 0x8 /end CHARACTERISTIC
/begin CHARACTERISTIC Cxx_dtc_lb_vb_rly_scw "" VALUE 0xa002b155 _REC_S1VAL_20_u1 255. _CNV_A_R_A_105_CM 0. 255. DISPLAY_IDENTIFIER fm_cal_vb_rly_scw.Cxx_dtc_lb_xxx /end CHARACTERISTIC
/begin CHARACTERISTIC Cxx_obd_dc_vb_rly_scw "" VALUE 0xa002b156 _REC_S1VAL_20_u1 9. _CNV_A_R_A_105_CM 1. 10. DISPLAY_IDENTIFIER fm_cal_vb_rly_scw.Cxx_obd_dc_xxx /end CHARACTERISTIC
/begin CHARACTERISTIC Cxx_obd_us_typ_vb_rly_scw "" VALUE 0xa002b157 _REC_S1VAL_20_u1 255. _CNV_A_R_A_105_CM 0. 255. DISPLAY_IDENTIFIER fm_cal_vb_rly_scw.Cxx_obd_us_typ_xxx /end CHARACTERISTIC
/begin CHARACTERISTIC Cxx_dtc_obd_wgc_oc "" VALUE 0xa002b3da _REC_S1VAL_20_u2 65535. _CNV_A_R_A_105_CM 0. 65535. DISPLAY_IDENTIFIER fm_cal_wgc_oc.Cxx_dtc_obd_xxx /end CHARACTERISTIC
/begin CHARACTERISTIC Cxx_conf_wal_wgc_oc "" VALUE 0xa002b3dc _REC_S1VAL_20_u1 3. _CNV_A_R_A_105_CM 0. 3. DISPLAY_IDENTIFIER fm_cal_wgc_oc.fm_static_bitfield.Cxx_conf_wal_xxx BIT_MASK 0x3 /end CHARACTERISTIC
/begin CHARACTERISTIC Cbx_obd_wgc_oc "" VALUE 0xa002b3dc _REC_S1VAL_20_u1 255. _CNV_A_R_A_105_CM 0. 255. DISPLAY_IDENTIFIER fm_cal_wgc_oc.fm_static_bitfield.Cbx_obd_xxx BIT_MASK 0x4 /end CHARACTERISTIC
/begin CHARACTERISTIC Cbx_obd_mena_wgc_oc "" VALUE 0xa002b3dc _REC_S1VAL_20_u1 255. _CNV_A_R_A_105_CM 0. 255. DISPLAY_IDENTIFIER fm_cal_wgc_oc.fm_static_bitfield.Cbx_obd_mena_xxx BIT_MASK 0x8 /end CHARACTERISTIC
/begin CHARACTERISTIC Cxx_dtc_lb_wgc_oc "" VALUE 0xa002b3dd _REC_S1VAL_20_u1 255. _CNV_A_R_A_105_CM 0. 255. DISPLAY_IDENTIFIER fm_cal_wgc_oc.Cxx_dtc_lb_xxx /end CHARACTERISTIC
/begin CHARACTERISTIC Cxx_obd_dc_wgc_oc "" VALUE 0xa002b3de _REC_S1VAL_20_u1 9. _CNV_A_R_A_105_CM 1. 10. DISPLAY_IDENTIFIER fm_cal_wgc_oc.Cxx_obd_dc_xxx /end CHARACTERISTIC
/begin CHARACTERISTIC Cxx_obd_us_typ_wgc_oc "" VALUE 0xa002b3df _REC_S1VAL_20_u1 255. _CNV_A_R_A_105_CM 0. 255. DISPLAY_IDENTIFIER fm_cal_wgc_oc.Cxx_obd_us_typ_xxx /end CHARACTERISTIC
/begin CHARACTERISTIC Cxx_dtc_obd_wgc_scg "" VALUE 0xa002b3e6 _REC_S1VAL_20_u2 65535. _CNV_A_R_A_105_CM 0. 65535. DISPLAY_IDENTIFIER fm_cal_wgc_scg.Cxx_dtc_obd_xxx /end CHARACTERISTIC
/begin CHARACTERISTIC Cxx_conf_wal_wgc_scg "" VALUE 0xa002b3e8 _REC_S1VAL_20_u1 3. _CNV_A_R_A_105_CM 0. 3. DISPLAY_IDENTIFIER fm_cal_wgc_scg.fm_static_bitfield.Cxx_conf_wal_xxx BIT_MASK 0x3 /end CHARACTERISTIC
/begin CHARACTERISTIC Cbx_obd_wgc_scg "" VALUE 0xa002b3e8 _REC_S1VAL_20_u1 255. _CNV_A_R_A_105_CM 0. 255. DISPLAY_IDENTIFIER fm_cal_wgc_scg.fm_static_bitfield.Cbx_obd_xxx BIT_MASK 0x4 /end CHARACTERISTIC
/begin CHARACTERISTIC Cbx_obd_mena_wgc_scg "" VALUE 0xa002b3e8 _REC_S1VAL_20_u1 255. _CNV_A_R_A_105_CM 0. 255. DISPLAY_IDENTIFIER fm_cal_wgc_scg.fm_static_bitfield.Cbx_obd_mena_xxx BIT_MASK 0x8 /end CHARACTERISTIC
/begin CHARACTERISTIC Cxx_dtc_lb_wgc_scg "" VALUE 0xa002b3e9 _REC_S1VAL_20_u1 255. _CNV_A_R_A_105_CM 0. 255. DISPLAY_IDENTIFIER fm_cal_wgc_scg.Cxx_dtc_lb_xxx /end CHARACTERISTIC
/begin CHARACTERISTIC Cxx_obd_dc_wgc_scg "" VALUE 0xa002b3ea _REC_S1VAL_20_u1 9. _CNV_A_R_A_105_CM 1. 10. DISPLAY_IDENTIFIER fm_cal_wgc_scg.Cxx_obd_dc_xxx /end CHARACTERISTIC
/begin CHARACTERISTIC Cxx_obd_us_typ_wgc_scg "" VALUE 0xa002b3eb _REC_S1VAL_20_u1 255. _CNV_A_R_A_105_CM 0. 255. DISPLAY_IDENTIFIER fm_cal_wgc_scg.Cxx_obd_us_typ_xxx /end CHARACTERISTIC
/begin CHARACTERISTIC Cxx_dtc_obd_wgc_scw "" VALUE 0xa002b3f2 _REC_S1VAL_20_u2 65535. _CNV_A_R_A_105_CM 0. 65535. DISPLAY_IDENTIFIER fm_cal_wgc_scw.Cxx_dtc_obd_xxx /end CHARACTERISTIC
/begin CHARACTERISTIC Cxx_conf_wal_wgc_scw "" VALUE 0xa002b3f4 _REC_S1VAL_20_u1 3. _CNV_A_R_A_105_CM 0. 3. DISPLAY_IDENTIFIER fm_cal_wgc_scw.fm_static_bitfield.Cxx_conf_wal_xxx BIT_MASK 0x3 /end CHARACTERISTIC
/begin CHARACTERISTIC Cbx_obd_wgc_scw "" VALUE 0xa002b3f4 _REC_S1VAL_20_u1 255. _CNV_A_R_A_105_CM 0. 255. DISPLAY_IDENTIFIER fm_cal_wgc_scw.fm_static_bitfield.Cbx_obd_xxx BIT_MASK 0x4 /end CHARACTERISTIC
/begin CHARACTERISTIC Cbx_obd_mena_wgc_scw "" VALUE 0xa002b3f4 _REC_S1VAL_20_u1 255. _CNV_A_R_A_105_CM 0. 255. DISPLAY_IDENTIFIER fm_cal_wgc_scw.fm_static_bitfield.Cbx_obd_mena_xxx BIT_MASK 0x8 /end CHARACTERISTIC
/begin CHARACTERISTIC Cxx_dtc_lb_wgc_scw "" VALUE 0xa002b3f5 _REC_S1VAL_20_u1 255. _CNV_A_R_A_105_CM 0. 255. DISPLAY_IDENTIFIER fm_cal_wgc_scw.Cxx_dtc_lb_xxx /end CHARACTERISTIC
/begin CHARACTERISTIC Cxx_obd_dc_wgc_scw "" VALUE 0xa002b3f6 _REC_S1VAL_20_u1 9. _CNV_A_R_A_105_CM 1. 10. DISPLAY_IDENTIFIER fm_cal_wgc_scw.Cxx_obd_dc_xxx /end CHARACTERISTIC
/begin CHARACTERISTIC Cxx_obd_us_typ_wgc_scw "" VALUE 0xa002b3f7 _REC_S1VAL_20_u1 255. _CNV_A_R_A_105_CM 0. 255. DISPLAY_IDENTIFIER fm_cal_wgc_scw.Cxx_obd_us_typ_xxx /end CHARACTERISTIC
/begin CHARACTERISTIC Cxx_conf_wal_wpmp_tcr_blk "" VALUE 0xa002b5a4 _REC_S1VAL_20_u1 3. _CNV_A_R_A_105_CM 0. 3. DISPLAY_IDENTIFIER fm_cal_wpmp_tcr_blk.fm_static_bitfield.Cxx_conf_wal_xxx BIT_MASK 0x3 /end CHARACTERISTIC
/begin CHARACTERISTIC Cxx_dtc_lb_wpmp_tcr_blk "" VALUE 0xa002b5a5 _REC_S1VAL_20_u1 255. _CNV_A_R_A_105_CM 0. 255. DISPLAY_IDENTIFIER fm_cal_wpmp_tcr_blk.Cxx_dtc_lb_xxx /end CHARACTERISTIC
/begin CHARACTERISTIC Cxx_obd_us_typ_wpmp_tcr_blk "" VALUE 0xa002b5a7 _REC_S1VAL_20_u1 255. _CNV_A_R_A_105_CM 0. 255. DISPLAY_IDENTIFIER fm_cal_wpmp_tcr_blk.Cxx_obd_us_typ_xxx /end CHARACTERISTIC
/begin CHARACTERISTIC Cxx_conf_wal_wpmp_tcr_oc "" VALUE 0xa002b400 _REC_S1VAL_20_u1 3. _CNV_A_R_A_105_CM 0. 3. DISPLAY_IDENTIFIER fm_cal_wpmp_tcr_oc.fm_static_bitfield.Cxx_conf_wal_xxx BIT_MASK 0x3 /end CHARACTERISTIC
/begin CHARACTERISTIC Cxx_dtc_lb_wpmp_tcr_oc "" VALUE 0xa002b401 _REC_S1VAL_20_u1 255. _CNV_A_R_A_105_CM 0. 255. DISPLAY_IDENTIFIER fm_cal_wpmp_tcr_oc.Cxx_dtc_lb_xxx /end CHARACTERISTIC
/begin CHARACTERISTIC Cxx_obd_us_typ_wpmp_tcr_oc "" VALUE 0xa002b403 _REC_S1VAL_20_u1 255. _CNV_A_R_A_105_CM 0. 255. DISPLAY_IDENTIFIER fm_cal_wpmp_tcr_oc.Cxx_obd_us_typ_xxx /end CHARACTERISTIC
/begin CHARACTERISTIC Cxx_conf_wal_wpmp_tcr_scg "" VALUE 0xa002b40c _REC_S1VAL_20_u1 3. _CNV_A_R_A_105_CM 0. 3. DISPLAY_IDENTIFIER fm_cal_wpmp_tcr_scg.fm_static_bitfield.Cxx_conf_wal_xxx BIT_MASK 0x3 /end CHARACTERISTIC
/begin CHARACTERISTIC Cxx_dtc_lb_wpmp_tcr_scg "" VALUE 0xa002b40d _REC_S1VAL_20_u1 255. _CNV_A_R_A_105_CM 0. 255. DISPLAY_IDENTIFIER fm_cal_wpmp_tcr_scg.Cxx_dtc_lb_xxx /end CHARACTERISTIC
/begin CHARACTERISTIC Cxx_obd_us_typ_wpmp_tcr_scg "" VALUE 0xa002b40f _REC_S1VAL_20_u1 255. _CNV_A_R_A_105_CM 0. 255. DISPLAY_IDENTIFIER fm_cal_wpmp_tcr_scg.Cxx_obd_us_typ_xxx /end CHARACTERISTIC
/begin CHARACTERISTIC Cxx_conf_wal_wpmp_tcr_scw "" VALUE 0xa002b418 _REC_S1VAL_20_u1 3. _CNV_A_R_A_105_CM 0. 3. DISPLAY_IDENTIFIER fm_cal_wpmp_tcr_scw.fm_static_bitfield.Cxx_conf_wal_xxx BIT_MASK 0x3 /end CHARACTERISTIC
/begin CHARACTERISTIC Cxx_dtc_lb_wpmp_tcr_scw "" VALUE 0xa002b419 _REC_S1VAL_20_u1 255. _CNV_A_R_A_105_CM 0. 255. DISPLAY_IDENTIFIER fm_cal_wpmp_tcr_scw.Cxx_dtc_lb_xxx /end CHARACTERISTIC
/begin CHARACTERISTIC Cxx_obd_us_typ_wpmp_tcr_scw "" VALUE 0xa002b41b _REC_S1VAL_20_u1 255. _CNV_A_R_A_105_CM 0. 255. DISPLAY_IDENTIFIER fm_cal_wpmp_tcr_scw.Cxx_obd_us_typ_xxx /end CHARACTERISTIC
/begin MEASUREMENT Vtx_ind_dyn[0] "" UWORD _CNV_S_702_FM_RANGE_D_276_CM 1 0. 0. 701. ECU_ADDRESS 0xd000583c /end MEASUREMENT
/begin MEASUREMENT Vtx_ind_dyn[1] "" UWORD _CNV_S_702_FM_RANGE_D_276_CM 1 0. 0. 701. ECU_ADDRESS 0xd000583e /end MEASUREMENT
/begin MEASUREMENT Vtx_ind_dyn[2] "" UWORD _CNV_S_702_FM_RANGE_D_276_CM 1 0. 0. 701. ECU_ADDRESS 0xd0005840 /end MEASUREMENT
/begin MEASUREMENT Vtx_ind_dyn[3] "" UWORD _CNV_S_702_FM_RANGE_D_276_CM 1 0. 0. 701. ECU_ADDRESS 0xd0005842 /end MEASUREMENT
/begin MEASUREMENT Vtx_ind_dyn[4] "" UWORD _CNV_S_702_FM_RANGE_D_276_CM 1 0. 0. 701. ECU_ADDRESS 0xd0005844 /end MEASUREMENT
/begin MEASUREMENT Vtx_ind_dyn[5] "" UWORD _CNV_S_702_FM_RANGE_D_276_CM 1 0. 0. 701. ECU_ADDRESS 0xd0005846 /end MEASUREMENT
/begin MEASUREMENT Vtx_ind_dyn[6] "" UWORD _CNV_S_702_FM_RANGE_D_276_CM 1 0. 0. 701. ECU_ADDRESS 0xd0005848 /end MEASUREMENT
/begin MEASUREMENT Vtx_ind_dyn[7] "" UWORD _CNV_S_702_FM_RANGE_D_276_CM 1 0. 0. 701. ECU_ADDRESS 0xd000584a /end MEASUREMENT
/begin MEASUREMENT Vtx_ind_dyn[8] "" UWORD _CNV_S_702_FM_RANGE_D_276_CM 1 0. 0. 701. ECU_ADDRESS 0xd000584c /end MEASUREMENT
/begin MEASUREMENT Vtx_ind_dyn[9] "" UWORD _CNV_S_702_FM_RANGE_D_276_CM 1 0. 0. 701. ECU_ADDRESS 0xd000584e /end MEASUREMENT
/begin MEASUREMENT Sbx_obd_rdn_cata_cpt "" UBYTE _CNV_S_2_RANGE______277_CM 1 0. 0. 1. DISPLAY_IDENTIFIER DgDftMng_NVM.Sbx_obd_rdn_cata_cpt_NVM ECU_ADDRESS 0xd0007928 BIT_MASK 0x1 /end MEASUREMENT
/begin MEASUREMENT Sbx_obd_rdn_lbup_cpt "" UBYTE _CNV_S_2_RANGE______277_CM 1 0. 0. 1. DISPLAY_IDENTIFIER DgDftMng_NVM.Sbx_obd_rdn_lbup_cpt_NVM ECU_ADDRESS 0xd0007929 BIT_MASK 0x1 /end MEASUREMENT
/begin MEASUREMENT Sbx_obd_rdn_egr "" UBYTE _CNV_S_2_RANGE______277_CM 1 0. 0. 1. DISPLAY_IDENTIFIER DgDftMng_NVM.Sbx_obd_rdn_egr_NVM ECU_ADDRESS 0xd000792a BIT_MASK 0x1 /end MEASUREMENT
/begin MEASUREMENT Sbx_obd_rdn_cata "" UBYTE _CNV_S_2_RANGE______277_CM 1 0. 0. 1. DISPLAY_IDENTIFIER DgDftMng_NVM.Sbx_obd_rdn_cata_NVM ECU_ADDRESS 0xd000792b BIT_MASK 0x1 /end MEASUREMENT
/begin MEASUREMENT Sbx_obd_rdn_heat "" UBYTE _CNV_S_2_RANGE______277_CM 1 0. 0. 1. DISPLAY_IDENTIFIER DgDftMng_NVM.Sbx_obd_rdn_heat_NVM ECU_ADDRESS 0xd000792c BIT_MASK 0x1 /end MEASUREMENT
/begin MEASUREMENT Sbx_obd_rdn_evap "" UBYTE _CNV_S_2_RANGE______277_CM 1 0. 0. 1. DISPLAY_IDENTIFIER DgDftMng_NVM.Sbx_obd_rdn_evap_NVM ECU_ADDRESS 0xd000792d BIT_MASK 0x1 /end MEASUREMENT
/begin MEASUREMENT Sbx_obd_rdn_egr_vvt "" UBYTE _CNV_S_2_RANGE______277_CM 1 0. 0. 1. DISPLAY_IDENTIFIER DgDftMng_NVM.Sbx_obd_rdn_egr_vvt_NVM ECU_ADDRESS 0xd000792e BIT_MASK 0x1 /end MEASUREMENT
/begin MEASUREMENT Sbx_obd_rdn_fsys "" UBYTE _CNV_S_2_RANGE______277_CM 1 0. 0. 1. DISPLAY_IDENTIFIER DgDftMng_NVM.Sbx_obd_rdn_fsys_NVM ECU_ADDRESS 0xd000792f BIT_MASK 0x1 /end MEASUREMENT
/begin MEASUREMENT Sbx_obd_rdn_heat_cata "" UBYTE _CNV_S_2_RANGE______277_CM 1 0. 0. 1. DISPLAY_IDENTIFIER DgDftMng_NVM.Sbx_obd_rdn_heat_cata_NVM ECU_ADDRESS 0xd0007930 BIT_MASK 0x1 /end MEASUREMENT
/begin MEASUREMENT Sbx_obd_rdn_mis "" UBYTE _CNV_S_2_RANGE______277_CM 1 0. 0. 1. DISPLAY_IDENTIFIER DgDftMng_NVM.Sbx_obd_rdn_mis_NVM ECU_ADDRESS 0xd0007931 BIT_MASK 0x1 /end MEASUREMENT
/begin MEASUREMENT Sbx_obd_rdn_csf "" UBYTE _CNV_S_2_RANGE______277_CM 1 0. 0. 1. DISPLAY_IDENTIFIER DgDftMng_NVM.Sbx_obd_rdn_csf_NVM ECU_ADDRESS 0xd0007932 BIT_MASK 0x1 /end MEASUREMENT
/begin MEASUREMENT Sbx_obd_rdn_nt "" UBYTE _CNV_S_2_RANGE______277_CM 1 0. 0. 1. DISPLAY_IDENTIFIER DgDftMng_NVM.Sbx_obd_rdn_nt_NVM ECU_ADDRESS 0xd0007933 BIT_MASK 0x1 /end MEASUREMENT
/begin MEASUREMENT Sbx_obd_rdn_o2 "" UBYTE _CNV_S_2_RANGE______277_CM 1 0. 0. 1. DISPLAY_IDENTIFIER DgDftMng_NVM.Sbx_obd_rdn_o2_NVM ECU_ADDRESS 0xd0007934 BIT_MASK 0x1 /end MEASUREMENT
/begin MEASUREMENT Sbx_obd_rdn_spg "" UBYTE _CNV_S_2_RANGE______277_CM 1 0. 0. 1. DISPLAY_IDENTIFIER DgDftMng_NVM.Sbx_obd_rdn_spg_NVM ECU_ADDRESS 0xd0007935 BIT_MASK 0x1 /end MEASUREMENT
/begin MEASUREMENT Sbx_obd_rdn_cpt "" UBYTE _CNV_S_2_RANGE______277_CM 1 0. 0. 1. DISPLAY_IDENTIFIER DgDftMng_NVM.Sbx_obd_rdn_cpt_NVM ECU_ADDRESS 0xd0007936 BIT_MASK 0x1 /end MEASUREMENT
/begin MEASUREMENT Sxx_dist_fail_dyn_0 "" ULONG _CNV_A_R_LINEAR_____274_CM 1 0. 0. 16777215. DISPLAY_IDENTIFIER fm_dyn_eprm[0].Stx_dist_fail_dyn ECU_ADDRESS 0xd0005864 FORMAT "%10.0" /end MEASUREMENT
/begin MEASUREMENT Sxx_tmp_dist_dyn_0 "" ULONG _CNV_A_R_LINEAR_____274_CM 1 0. 0. 16777215. DISPLAY_IDENTIFIER fm_dyn_eprm[0].Stx_tmp_dist_dyn ECU_ADDRESS 0xd0005868 FORMAT "%10.0" /end MEASUREMENT
/begin MEASUREMENT Sxx_km_cf_dyn_0 "" ULONG _CNV_A_R_LINEAR_____274_CM 1 0. 0. 16777215. DISPLAY_IDENTIFIER fm_dyn_eprm[0].Stx_km_cf_dyn ECU_ADDRESS 0xd000586c FORMAT "%10.0" /end MEASUREMENT
/begin MEASUREMENT Sxx_km_mf_dyn_0 "" ULONG _CNV_A_R_LINEAR_____274_CM 1 0. 0. 16777215. DISPLAY_IDENTIFIER fm_dyn_eprm[0].Stx_km_mf_dyn ECU_ADDRESS 0xd0005870 FORMAT "%10.0" /end MEASUREMENT
/begin MEASUREMENT Sxx_km_pass_dyn_0 "" ULONG _CNV_A_R_LINEAR_____274_CM 1 0. 0. 16777215. DISPLAY_IDENTIFIER fm_dyn_eprm[0].Stx_km_pass_dyn ECU_ADDRESS 0xd0005874 FORMAT "%10.0" /end MEASUREMENT
/begin MEASUREMENT Sxx_ind_dyn_0 "" UWORD _CNV_A_R_ECME_LINEA_0_CM 1 0. 0. 65535. DISPLAY_IDENTIFIER fm_dyn_eprm[0].Stx_ind_dyn ECU_ADDRESS 0xd0005878 FORMAT "%5.0" /end MEASUREMENT
/begin MEASUREMENT Sxx_ffm_esti_tqe_dyn_0 "" UWORD _CNV_A_R_LINEAR_____216_CM 1 0. -400. 1647.96875 DISPLAY_IDENTIFIER fm_dyn_eprm[0].Stx_ffm_esti_tqe_dyn ECU_ADDRESS 0xd000587a FORMAT "%10.5" /end MEASUREMENT
/begin MEASUREMENT Sxx_ffm_esti_tqe_min_dyn_0 "" UWORD _CNV_A_R_LINEAR_____216_CM 1 0. -400. 1647.96875 DISPLAY_IDENTIFIER fm_dyn_eprm[0].Stx_ffm_esti_tqe_min_dyn ECU_ADDRESS 0xd000587c FORMAT "%10.5" /end MEASUREMENT
/begin MEASUREMENT Sxx_ffm_esti_tqe_max_dyn_0 "" UWORD _CNV_A_R_LINEAR_____216_CM 1 0. -400. 1647.96875 DISPLAY_IDENTIFIER fm_dyn_eprm[0].Stx_ffm_esti_tqe_max_dyn ECU_ADDRESS 0xd000587e FORMAT "%10.5" /end MEASUREMENT
/begin MEASUREMENT Sxx_ffm_n_dyn_0 "" UWORD _CNV_A_R_ENSD_LINEA_22_CM 1 0. 0. 16383.75 DISPLAY_IDENTIFIER fm_dyn_eprm[0].Stx_ffm_n_dyn ECU_ADDRESS 0xd0005880 FORMAT "%8.2" /end MEASUREMENT
/begin MEASUREMENT Sxx_ffm_n_min_dyn_0 "" UWORD _CNV_A_R_ENSD_LINEA_22_CM 1 0. 0. 16383.75 DISPLAY_IDENTIFIER fm_dyn_eprm[0].Stx_ffm_n_min_dyn ECU_ADDRESS 0xd0005882 FORMAT "%8.2" /end MEASUREMENT
/begin MEASUREMENT Sxx_ffm_n_max_dyn_0 "" UWORD _CNV_A_R_ENSD_LINEA_22_CM 1 0. 0. 16383.75 DISPLAY_IDENTIFIER fm_dyn_eprm[0].Stx_ffm_n_max_dyn ECU_ADDRESS 0xd0005884 FORMAT "%8.2" /end MEASUREMENT
/begin MEASUREMENT Sxx_ffm_tco_dyn_0 "" UWORD _CNV_A_R_LINEAR_____278_CM 1 0. -273. 6280.5 DISPLAY_IDENTIFIER fm_dyn_eprm[0].Stx_ffm_tco_dyn ECU_ADDRESS 0xd0005886 FORMAT "%6.1" /end MEASUREMENT
/begin MEASUREMENT Sxx_ffm_tco_min_dyn_0 "" UWORD _CNV_A_R_LINEAR_____278_CM 1 0. -273. 6280.5 DISPLAY_IDENTIFIER fm_dyn_eprm[0].Stx_ffm_tco_min_dyn ECU_ADDRESS 0xd0005888 FORMAT "%6.1" /end MEASUREMENT
/begin MEASUREMENT Sxx_ffm_tco_max_dyn_0 "" UWORD _CNV_A_R_LINEAR_____278_CM 1 0. -273. 6280.5 DISPLAY_IDENTIFIER fm_dyn_eprm[0].Stx_ffm_tco_max_dyn ECU_ADDRESS 0xd000588a FORMAT "%6.1" /end MEASUREMENT
/begin MEASUREMENT Sxx_ffm_vb_dyn_0 "" UWORD _CNV_A_R_LINEAR_____205_CM 1 0. 0. 655.35 DISPLAY_IDENTIFIER fm_dyn_eprm[0].Stx_ffm_vb_dyn ECU_ADDRESS 0xd000588c FORMAT "%6.2" /end MEASUREMENT
/begin MEASUREMENT Sxx_ffm_vb_min_dyn_0 "" UWORD _CNV_A_R_LINEAR_____205_CM 1 0. 0. 655.35 DISPLAY_IDENTIFIER fm_dyn_eprm[0].Stx_ffm_vb_min_dyn ECU_ADDRESS 0xd000588e FORMAT "%6.2" /end MEASUREMENT
/begin MEASUREMENT Sxx_ffm_vb_max_dyn_0 "" UWORD _CNV_A_R_LINEAR_____205_CM 1 0. 0. 655.35 DISPLAY_IDENTIFIER fm_dyn_eprm[0].Stx_ffm_vb_max_dyn ECU_ADDRESS 0xd0005890 FORMAT "%6.2" /end MEASUREMENT
/begin MEASUREMENT Sxx_ffm_vs_dyn_0 "" UWORD _CNV_A_R_LINEAR_____125_CM 1 0. 0. 655.35 DISPLAY_IDENTIFIER fm_dyn_eprm[0].Stx_ffm_vs_dyn ECU_ADDRESS 0xd0005892 FORMAT "%6.2" /end MEASUREMENT
/begin MEASUREMENT Sxx_ffm_vs_min_dyn_0 "" UWORD _CNV_A_R_LINEAR_____125_CM 1 0. 0. 655.35 DISPLAY_IDENTIFIER fm_dyn_eprm[0].Stx_ffm_vs_min_dyn ECU_ADDRESS 0xd0005894 FORMAT "%6.2" /end MEASUREMENT
/begin MEASUREMENT Sxx_ffm_vs_max_dyn_0 "" UWORD _CNV_A_R_LINEAR_____125_CM 1 0. 0. 655.35 DISPLAY_IDENTIFIER fm_dyn_eprm[0].Stx_ffm_vs_max_dyn ECU_ADDRESS 0xd0005896 FORMAT "%6.2" /end MEASUREMENT
/begin MEASUREMENT Sxx_ffm_did_1_dyn_0 "" UWORD _CNV_A_R_ECME_LINEA_0_CM 1 0. 0. 65535. DISPLAY_IDENTIFIER fm_dyn_eprm[0].Stx_ffm_did_X_dyn[0] ECU_ADDRESS 0xd0005898 FORMAT "%5.0" /end MEASUREMENT
/begin MEASUREMENT Sxx_ffm_did_2_dyn_0 "" UWORD _CNV_A_R_ECME_LINEA_0_CM 1 0. 0. 65535. DISPLAY_IDENTIFIER fm_dyn_eprm[0].Stx_ffm_did_X_dyn[1] ECU_ADDRESS 0xd000589a FORMAT "%5.0" /end MEASUREMENT
/begin MEASUREMENT Sxx_ffm_did_3_dyn_0 "" UWORD _CNV_A_R_ECME_LINEA_0_CM 1 0. 0. 65535. DISPLAY_IDENTIFIER fm_dyn_eprm[0].Stx_ffm_did_X_dyn[2] ECU_ADDRESS 0xd000589c FORMAT "%5.0" /end MEASUREMENT
/begin MEASUREMENT Sxx_ffm_did_4_dyn_0 "" UWORD _CNV_A_R_ECME_LINEA_0_CM 1 0. 0. 65535. DISPLAY_IDENTIFIER fm_dyn_eprm[0].Stx_ffm_did_X_dyn[3] ECU_ADDRESS 0xd000589e FORMAT "%5.0" /end MEASUREMENT
/begin MEASUREMENT Sxx_ffm_did_5_dyn_0 "" UWORD _CNV_A_R_ECME_LINEA_0_CM 1 0. 0. 65535. DISPLAY_IDENTIFIER fm_dyn_eprm[0].Stx_ffm_did_X_dyn[4] ECU_ADDRESS 0xd00058a0 FORMAT "%5.0" /end MEASUREMENT
/begin MEASUREMENT Sxx_ffm_did_1_max_dyn_0 "" UWORD _CNV_A_R_ECME_LINEA_0_CM 1 0. 0. 65535. DISPLAY_IDENTIFIER fm_dyn_eprm[0].Stx_ffm_did_X_max_dyn[0] ECU_ADDRESS 0xd00058a4 FORMAT "%5.0" /end MEASUREMENT
/begin MEASUREMENT Sxx_ffm_did_2_max_dyn_0 "" UWORD _CNV_A_R_ECME_LINEA_0_CM 1 0. 0. 65535. DISPLAY_IDENTIFIER fm_dyn_eprm[0].Stx_ffm_did_X_max_dyn[1] ECU_ADDRESS 0xd00058a6 FORMAT "%5.0" /end MEASUREMENT
/begin MEASUREMENT Sxx_ffm_did_3_max_dyn_0 "" UWORD _CNV_A_R_ECME_LINEA_0_CM 1 0. 0. 65535. DISPLAY_IDENTIFIER fm_dyn_eprm[0].Stx_ffm_did_X_max_dyn[2] ECU_ADDRESS 0xd00058a8 FORMAT "%5.0" /end MEASUREMENT
/begin MEASUREMENT Sxx_ffm_did_4_max_dyn_0 "" UWORD _CNV_A_R_ECME_LINEA_0_CM 1 0. 0. 65535. DISPLAY_IDENTIFIER fm_dyn_eprm[0].Stx_ffm_did_X_max_dyn[3] ECU_ADDRESS 0xd00058aa FORMAT "%5.0" /end MEASUREMENT
/begin MEASUREMENT Sxx_ffm_did_5_max_dyn_0 "" UWORD _CNV_A_R_ECME_LINEA_0_CM 1 0. 0. 65535. DISPLAY_IDENTIFIER fm_dyn_eprm[0].Stx_ffm_did_X_max_dyn[4] ECU_ADDRESS 0xd00058ac FORMAT "%5.0" /end MEASUREMENT
/begin MEASUREMENT Sxx_ffm_did_1_min_dyn_0 "" UWORD _CNV_A_R_ECME_LINEA_0_CM 1 0. 0. 65535. DISPLAY_IDENTIFIER fm_dyn_eprm[0].Stx_ffm_did_X_min_dyn[0] ECU_ADDRESS 0xd00058b0 FORMAT "%5.0" /end MEASUREMENT
/begin MEASUREMENT Sxx_ffm_did_2_min_dyn_0 "" UWORD _CNV_A_R_ECME_LINEA_0_CM 1 0. 0. 65535. DISPLAY_IDENTIFIER fm_dyn_eprm[0].Stx_ffm_did_X_min_dyn[1] ECU_ADDRESS 0xd00058b2 FORMAT "%5.0" /end MEASUREMENT
/begin MEASUREMENT Sxx_ffm_did_3_min_dyn_0 "" UWORD _CNV_A_R_ECME_LINEA_0_CM 1 0. 0. 65535. DISPLAY_IDENTIFIER fm_dyn_eprm[0].Stx_ffm_did_X_min_dyn[2] ECU_ADDRESS 0xd00058b4 FORMAT "%5.0" /end MEASUREMENT
/begin MEASUREMENT Sxx_ffm_did_4_min_dyn_0 "" UWORD _CNV_A_R_ECME_LINEA_0_CM 1 0. 0. 65535. DISPLAY_IDENTIFIER fm_dyn_eprm[0].Stx_ffm_did_X_min_dyn[3] ECU_ADDRESS 0xd00058b6 FORMAT "%5.0" /end MEASUREMENT
/begin MEASUREMENT Sxx_ffm_did_5_min_dyn_0 "" UWORD _CNV_A_R_ECME_LINEA_0_CM 1 0. 0. 65535. DISPLAY_IDENTIFIER fm_dyn_eprm[0].Stx_ffm_did_X_min_dyn[4] ECU_ADDRESS 0xd00058b8 FORMAT "%5.0" /end MEASUREMENT
/begin MEASUREMENT Sxx_obd_sc_n_dyn_0 "" UWORD _CNV_A_R_ENSD_LINEA_22_CM 1 0. 0. 16383.75 DISPLAY_IDENTIFIER fm_dyn_eprm[0].Stx_obd_sc_n_dyn ECU_ADDRESS 0xd00058ba FORMAT "%8.2" /end MEASUREMENT
/begin MEASUREMENT Sbx_pfo_dyn_0 "" UBYTE _CNV_A_R_A_105_CM 1 0. 0. 255. DISPLAY_IDENTIFIER fm_dyn_eprm[0].fm_dynamic_eprm_bitfield.Stx_pfo_dyn ECU_ADDRESS 0xd00058bc BIT_MASK 0x2 /end MEASUREMENT
/begin MEASUREMENT Sbx_mfo_dyn_0 "" UBYTE _CNV_A_R_A_105_CM 1 0. 0. 255. DISPLAY_IDENTIFIER fm_dyn_eprm[0].fm_dynamic_eprm_bitfield.Stx_mfo_dyn ECU_ADDRESS 0xd00058bc BIT_MASK 0x4 /end MEASUREMENT
/begin MEASUREMENT Sbx_obd_mreq_dyn_0 "" UBYTE _CNV_A_R_A_105_CM 1 0. 0. 255. DISPLAY_IDENTIFIER fm_dyn_eprm[0].fm_dynamic_eprm_bitfield.Stx_obd_mreq_dyn ECU_ADDRESS 0xd00058bc BIT_MASK 0x8 /end MEASUREMENT
/begin MEASUREMENT Sbx_obd_dc_rdn_dyn_0 "" UBYTE _CNV_A_R_A_105_CM 1 0. 0. 255. DISPLAY_IDENTIFIER fm_dyn_eprm[0].fm_dynamic_eprm_bitfield.Stx_obd_dc_rdn_dyn ECU_ADDRESS 0xd00058bc BIT_MASK 0x10 /end MEASUREMENT
/begin MEASUREMENT Sbx_fail_dc_dyn_0 "" UBYTE _CNV_A_R_A_105_CM 1 0. 0. 255. DISPLAY_IDENTIFIER fm_dyn_eprm[0].fm_dynamic_eprm_bitfield.Stx_fail_dc_dyn ECU_ADDRESS 0xd00058bc BIT_MASK 0x20 /end MEASUREMENT
/begin MEASUREMENT Sbx_obd_sc_pass_dyn_0 "" UBYTE _CNV_A_R_A_105_CM 1 0. 0. 255. DISPLAY_IDENTIFIER fm_dyn_eprm[0].fm_dynamic_eprm_bitfield.Stx_obd_sc_pass_dyn ECU_ADDRESS 0xd00058bc BIT_MASK 0x40 /end MEASUREMENT
/begin MEASUREMENT Sbx_obd_sc_wup_stt_dyn_0 "" UBYTE _CNV_A_R_A_105_CM 1 0. 0. 255. DISPLAY_IDENTIFIER fm_dyn_eprm[0].fm_dynamic_eprm_bitfield.Stx_obd_sc_wup_stt_dyn ECU_ADDRESS 0xd00058bc BIT_MASK 0x80 /end MEASUREMENT
/begin MEASUREMENT Sxx_obd_wctr_dyn_0 "" UBYTE _CNV_A_R_ECME_LINEA_0_CM 1 0. 0. 255. DISPLAY_IDENTIFIER fm_dyn_eprm[0].Stx_obd_wctr_dyn ECU_ADDRESS 0xd00058bd FORMAT "%3.0" /end MEASUREMENT
/begin MEASUREMENT Sxx_frq_dyn_0 "" UBYTE _CNV_A_R_ECME_LINEA_0_CM 1 0. 0. 255. DISPLAY_IDENTIFIER fm_dyn_eprm[0].Stx_frq_dyn ECU_ADDRESS 0xd00058be FORMAT "%3.0" /end MEASUREMENT
/begin MEASUREMENT Sxx_obd_clfctr_dyn_0 "" UBYTE _CNV_A_R_ECME_LINEA_0_CM 1 0. 0. 10. DISPLAY_IDENTIFIER fm_dyn_eprm[0].Stx_obd_clfctr_dyn ECU_ADDRESS 0xd00058bf FORMAT "%3.0" /end MEASUREMENT
/begin MEASUREMENT Sxx_esd_siz_dyn_0 "" UBYTE _CNV_A_R_ECME_LINEA_0_CM 1 0. 0. 255. DISPLAY_IDENTIFIER fm_dyn_eprm[0].Stx_esd_siz_dyn ECU_ADDRESS 0xd00058c0 FORMAT "%3.0" /end MEASUREMENT
/begin MEASUREMENT Sxx_obd_sc_ctr_dyn_0 "" UBYTE _CNV_A_R_ECME_LINEA_0_CM 1 0. 0. 255. DISPLAY_IDENTIFIER fm_dyn_eprm[0].Stx_obd_sc_ctr_dyn ECU_ADDRESS 0xd00058c1 FORMAT "%3.0" /end MEASUREMENT
/begin MEASUREMENT Sxx_obd_sc_load_dyn_0 "" UBYTE _CNV_A_R_LINEAR_____165_CM 1 0. 0. 100. DISPLAY_IDENTIFIER fm_dyn_eprm[0].Stx_obd_sc_load_dyn ECU_ADDRESS 0xd00058c2 FORMAT "%12.8" /end MEASUREMENT
/begin MEASUREMENT Sxx_pri_dyn_0 "" UBYTE _CNV_A_R_ECME_LINEA_0_CM 1 0. 0. 5. DISPLAY_IDENTIFIER fm_dyn_eprm[0].Stx_pri_dyn ECU_ADDRESS 0xd00058c3 FORMAT "%3.0" /end MEASUREMENT
/begin MEASUREMENT Sxx_dist_fail_dyn_1 "" ULONG _CNV_A_R_LINEAR_____274_CM 1 0. 0. 16777215. DISPLAY_IDENTIFIER fm_dyn_eprm[1].Stx_dist_fail_dyn ECU_ADDRESS 0xd00058c4 FORMAT "%10.0" /end MEASUREMENT
/begin MEASUREMENT Sxx_tmp_dist_dyn_1 "" ULONG _CNV_A_R_LINEAR_____274_CM 1 0. 0. 16777215. DISPLAY_IDENTIFIER fm_dyn_eprm[1].Stx_tmp_dist_dyn ECU_ADDRESS 0xd00058c8 FORMAT "%10.0" /end MEASUREMENT
/begin MEASUREMENT Sxx_km_cf_dyn_1 "" ULONG _CNV_A_R_LINEAR_____274_CM 1 0. 0. 16777215. DISPLAY_IDENTIFIER fm_dyn_eprm[1].Stx_km_cf_dyn ECU_ADDRESS 0xd00058cc FORMAT "%10.0" /end MEASUREMENT
/begin MEASUREMENT Sxx_km_mf_dyn_1 "" ULONG _CNV_A_R_LINEAR_____274_CM 1 0. 0. 16777215. DISPLAY_IDENTIFIER fm_dyn_eprm[1].Stx_km_mf_dyn ECU_ADDRESS 0xd00058d0 FORMAT "%10.0" /end MEASUREMENT
/begin MEASUREMENT Sxx_km_pass_dyn_1 "" ULONG _CNV_A_R_LINEAR_____274_CM 1 0. 0. 16777215. DISPLAY_IDENTIFIER fm_dyn_eprm[1].Stx_km_pass_dyn ECU_ADDRESS 0xd00058d4 FORMAT "%10.0" /end MEASUREMENT
/begin MEASUREMENT Sxx_ind_dyn_1 "" UWORD _CNV_A_R_ECME_LINEA_0_CM 1 0. 0. 65535. DISPLAY_IDENTIFIER fm_dyn_eprm[1].Stx_ind_dyn ECU_ADDRESS 0xd00058d8 FORMAT "%5.0" /end MEASUREMENT
/begin MEASUREMENT Sxx_ffm_esti_tqe_dyn_1 "" UWORD _CNV_A_R_LINEAR_____216_CM 1 0. -400. 1647.96875 DISPLAY_IDENTIFIER fm_dyn_eprm[1].Stx_ffm_esti_tqe_dyn ECU_ADDRESS 0xd00058da FORMAT "%10.5" /end MEASUREMENT
/begin MEASUREMENT Sxx_ffm_esti_tqe_min_dyn_1 "" UWORD _CNV_A_R_LINEAR_____216_CM 1 0. -400. 1647.96875 DISPLAY_IDENTIFIER fm_dyn_eprm[1].Stx_ffm_esti_tqe_min_dyn ECU_ADDRESS 0xd00058dc FORMAT "%10.5" /end MEASUREMENT
/begin MEASUREMENT Sxx_ffm_esti_tqe_max_dyn_1 "" UWORD _CNV_A_R_LINEAR_____216_CM 1 0. -400. 1647.96875 DISPLAY_IDENTIFIER fm_dyn_eprm[1].Stx_ffm_esti_tqe_max_dyn ECU_ADDRESS 0xd00058de FORMAT "%10.5" /end MEASUREMENT
/begin MEASUREMENT Sxx_ffm_n_dyn_1 "" UWORD _CNV_A_R_ENSD_LINEA_22_CM 1 0. 0. 16383.75 DISPLAY_IDENTIFIER fm_dyn_eprm[1].Stx_ffm_n_dyn ECU_ADDRESS 0xd00058e0 FORMAT "%8.2" /end MEASUREMENT
/begin MEASUREMENT Sxx_ffm_n_min_dyn_1 "" UWORD _CNV_A_R_ENSD_LINEA_22_CM 1 0. 0. 16383.75 DISPLAY_IDENTIFIER fm_dyn_eprm[1].Stx_ffm_n_min_dyn ECU_ADDRESS 0xd00058e2 FORMAT "%8.2" /end MEASUREMENT
/begin MEASUREMENT Sxx_ffm_n_max_dyn_1 "" UWORD _CNV_A_R_ENSD_LINEA_22_CM 1 0. 0. 16383.75 DISPLAY_IDENTIFIER fm_dyn_eprm[1].Stx_ffm_n_max_dyn ECU_ADDRESS 0xd00058e4 FORMAT "%8.2" /end MEASUREMENT
/begin MEASUREMENT Sxx_ffm_tco_dyn_1 "" UWORD _CNV_A_R_LINEAR_____278_CM 1 0. -273. 6280.5 DISPLAY_IDENTIFIER fm_dyn_eprm[1].Stx_ffm_tco_dyn ECU_ADDRESS 0xd00058e6 FORMAT "%6.1" /end MEASUREMENT
/begin MEASUREMENT Sxx_ffm_tco_min_dyn_1 "" UWORD _CNV_A_R_LINEAR_____278_CM 1 0. -273. 6280.5 DISPLAY_IDENTIFIER fm_dyn_eprm[1].Stx_ffm_tco_min_dyn ECU_ADDRESS 0xd00058e8 FORMAT "%6.1" /end MEASUREMENT
/begin MEASUREMENT Sxx_ffm_tco_max_dyn_1 "" UWORD _CNV_A_R_LINEAR_____278_CM 1 0. -273. 6280.5 DISPLAY_IDENTIFIER fm_dyn_eprm[1].Stx_ffm_tco_max_dyn ECU_ADDRESS 0xd00058ea FORMAT "%6.1" /end MEASUREMENT
/begin MEASUREMENT Sxx_ffm_vb_dyn_1 "" UWORD _CNV_A_R_LINEAR_____205_CM 1 0. 0. 655.35 DISPLAY_IDENTIFIER fm_dyn_eprm[1].Stx_ffm_vb_dyn ECU_ADDRESS 0xd00058ec FORMAT "%6.2" /end MEASUREMENT
/begin MEASUREMENT Sxx_ffm_vb_min_dyn_1 "" UWORD _CNV_A_R_LINEAR_____205_CM 1 0. 0. 655.35 DISPLAY_IDENTIFIER fm_dyn_eprm[1].Stx_ffm_vb_min_dyn ECU_ADDRESS 0xd00058ee FORMAT "%6.2" /end MEASUREMENT
/begin MEASUREMENT Sxx_ffm_vb_max_dyn_1 "" UWORD _CNV_A_R_LINEAR_____205_CM 1 0. 0. 655.35 DISPLAY_IDENTIFIER fm_dyn_eprm[1].Stx_ffm_vb_max_dyn ECU_ADDRESS 0xd00058f0 FORMAT "%6.2" /end MEASUREMENT
/begin MEASUREMENT Sxx_ffm_vs_dyn_1 "" UWORD _CNV_A_R_LINEAR_____125_CM 1 0. 0. 655.35 DISPLAY_IDENTIFIER fm_dyn_eprm[1].Stx_ffm_vs_dyn ECU_ADDRESS 0xd00058f2 FORMAT "%6.2" /end MEASUREMENT
/begin MEASUREMENT Sxx_ffm_vs_min_dyn_1 "" UWORD _CNV_A_R_LINEAR_____125_CM 1 0. 0. 655.35 DISPLAY_IDENTIFIER fm_dyn_eprm[1].Stx_ffm_vs_min_dyn ECU_ADDRESS 0xd00058f4 FORMAT "%6.2" /end MEASUREMENT
/begin MEASUREMENT Sxx_ffm_vs_max_dyn_1 "" UWORD _CNV_A_R_LINEAR_____125_CM 1 0. 0. 655.35 DISPLAY_IDENTIFIER fm_dyn_eprm[1].Stx_ffm_vs_max_dyn ECU_ADDRESS 0xd00058f6 FORMAT "%6.2" /end MEASUREMENT
/begin MEASUREMENT Sxx_ffm_did_1_dyn_1 "" UWORD _CNV_A_R_ECME_LINEA_0_CM 1 0. 0. 65535. DISPLAY_IDENTIFIER fm_dyn_eprm[1].Stx_ffm_did_X_dyn[0] ECU_ADDRESS 0xd00058f8 FORMAT "%5.0" /end MEASUREMENT
/begin MEASUREMENT Sxx_ffm_did_2_dyn_1 "" UWORD _CNV_A_R_ECME_LINEA_0_CM 1 0. 0. 65535. DISPLAY_IDENTIFIER fm_dyn_eprm[1].Stx_ffm_did_X_dyn[1] ECU_ADDRESS 0xd00058fa FORMAT "%5.0" /end MEASUREMENT
/begin MEASUREMENT Sxx_ffm_did_3_dyn_1 "" UWORD _CNV_A_R_ECME_LINEA_0_CM 1 0. 0. 65535. DISPLAY_IDENTIFIER fm_dyn_eprm[1].Stx_ffm_did_X_dyn[2] ECU_ADDRESS 0xd00058fc FORMAT "%5.0" /end MEASUREMENT
/begin MEASUREMENT Sxx_ffm_did_4_dyn_1 "" UWORD _CNV_A_R_ECME_LINEA_0_CM 1 0. 0. 65535. DISPLAY_IDENTIFIER fm_dyn_eprm[1].Stx_ffm_did_X_dyn[3] ECU_ADDRESS 0xd00058fe FORMAT "%5.0" /end MEASUREMENT
/begin MEASUREMENT Sxx_ffm_did_5_dyn_1 "" UWORD _CNV_A_R_ECME_LINEA_0_CM 1 0. 0. 65535. DISPLAY_IDENTIFIER fm_dyn_eprm[1].Stx_ffm_did_X_dyn[4] ECU_ADDRESS 0xd0005900 FORMAT "%5.0" /end MEASUREMENT
/begin MEASUREMENT Sxx_ffm_did_1_max_dyn_1 "" UWORD _CNV_A_R_ECME_LINEA_0_CM 1 0. 0. 65535. DISPLAY_IDENTIFIER fm_dyn_eprm[1].Stx_ffm_did_X_max_dyn[0] ECU_ADDRESS 0xd0005904 FORMAT "%5.0" /end MEASUREMENT
/begin MEASUREMENT Sxx_ffm_did_2_max_dyn_1 "" UWORD _CNV_A_R_ECME_LINEA_0_CM 1 0. 0. 65535. DISPLAY_IDENTIFIER fm_dyn_eprm[1].Stx_ffm_did_X_max_dyn[1] ECU_ADDRESS 0xd0005906 FORMAT "%5.0" /end MEASUREMENT
/begin MEASUREMENT Sxx_ffm_did_3_max_dyn_1 "" UWORD _CNV_A_R_ECME_LINEA_0_CM 1 0. 0. 65535. DISPLAY_IDENTIFIER fm_dyn_eprm[1].Stx_ffm_did_X_max_dyn[2] ECU_ADDRESS 0xd0005908 FORMAT "%5.0" /end MEASUREMENT
/begin MEASUREMENT Sxx_ffm_did_4_max_dyn_1 "" UWORD _CNV_A_R_ECME_LINEA_0_CM 1 0. 0. 65535. DISPLAY_IDENTIFIER fm_dyn_eprm[1].Stx_ffm_did_X_max_dyn[3] ECU_ADDRESS 0xd000590a FORMAT "%5.0" /end MEASUREMENT
/begin MEASUREMENT Sxx_ffm_did_5_max_dyn_1 "" UWORD _CNV_A_R_ECME_LINEA_0_CM 1 0. 0. 65535. DISPLAY_IDENTIFIER fm_dyn_eprm[1].Stx_ffm_did_X_max_dyn[4] ECU_ADDRESS 0xd000590c FORMAT "%5.0" /end MEASUREMENT
/begin MEASUREMENT Sxx_ffm_did_1_min_dyn_1 "" UWORD _CNV_A_R_ECME_LINEA_0_CM 1 0. 0. 65535. DISPLAY_IDENTIFIER fm_dyn_eprm[1].Stx_ffm_did_X_min_dyn[0] ECU_ADDRESS 0xd0005910 FORMAT "%5.0" /end MEASUREMENT
/begin MEASUREMENT Sxx_ffm_did_2_min_dyn_1 "" UWORD _CNV_A_R_ECME_LINEA_0_CM 1 0. 0. 65535. DISPLAY_IDENTIFIER fm_dyn_eprm[1].Stx_ffm_did_X_min_dyn[1] ECU_ADDRESS 0xd0005912 FORMAT "%5.0" /end MEASUREMENT
/begin MEASUREMENT Sxx_ffm_did_3_min_dyn_1 "" UWORD _CNV_A_R_ECME_LINEA_0_CM 1 0. 0. 65535. DISPLAY_IDENTIFIER fm_dyn_eprm[1].Stx_ffm_did_X_min_dyn[2] ECU_ADDRESS 0xd0005914 FORMAT "%5.0" /end MEASUREMENT
/begin MEASUREMENT Sxx_ffm_did_4_min_dyn_1 "" UWORD _CNV_A_R_ECME_LINEA_0_CM 1 0. 0. 65535. DISPLAY_IDENTIFIER fm_dyn_eprm[1].Stx_ffm_did_X_min_dyn[3] ECU_ADDRESS 0xd0005916 FORMAT "%5.0" /end MEASUREMENT
/begin MEASUREMENT Sxx_ffm_did_5_min_dyn_1 "" UWORD _CNV_A_R_ECME_LINEA_0_CM 1 0. 0. 65535. DISPLAY_IDENTIFIER fm_dyn_eprm[1].Stx_ffm_did_X_min_dyn[4] ECU_ADDRESS 0xd0005918 FORMAT "%5.0" /end MEASUREMENT
/begin MEASUREMENT Sxx_obd_sc_n_dyn_1 "" UWORD _CNV_A_R_ENSD_LINEA_22_CM 1 0. 0. 16383.75 DISPLAY_IDENTIFIER fm_dyn_eprm[1].Stx_obd_sc_n_dyn ECU_ADDRESS 0xd000591a FORMAT "%8.2" /end MEASUREMENT
/begin MEASUREMENT Sbx_pfo_dyn_1 "" UBYTE _CNV_A_R_A_105_CM 1 0. 0. 255. DISPLAY_IDENTIFIER fm_dyn_eprm[1].fm_dynamic_eprm_bitfield.Stx_pfo_dyn ECU_ADDRESS 0xd000591c BIT_MASK 0x2 /end MEASUREMENT
/begin MEASUREMENT Sbx_mfo_dyn_1 "" UBYTE _CNV_A_R_A_105_CM 1 0. 0. 255. DISPLAY_IDENTIFIER fm_dyn_eprm[1].fm_dynamic_eprm_bitfield.Stx_mfo_dyn ECU_ADDRESS 0xd000591c BIT_MASK 0x4 /end MEASUREMENT
/begin MEASUREMENT Sbx_obd_mreq_dyn_1 "" UBYTE _CNV_A_R_A_105_CM 1 0. 0. 255. DISPLAY_IDENTIFIER fm_dyn_eprm[1].fm_dynamic_eprm_bitfield.Stx_obd_mreq_dyn ECU_ADDRESS 0xd000591c BIT_MASK 0x8 /end MEASUREMENT
/begin MEASUREMENT Sbx_obd_dc_rdn_dyn_1 "" UBYTE _CNV_A_R_A_105_CM 1 0. 0. 255. DISPLAY_IDENTIFIER fm_dyn_eprm[1].fm_dynamic_eprm_bitfield.Stx_obd_dc_rdn_dyn ECU_ADDRESS 0xd000591c BIT_MASK 0x10 /end MEASUREMENT
/begin MEASUREMENT Sbx_fail_dc_dyn_1 "" UBYTE _CNV_A_R_A_105_CM 1 0. 0. 255. DISPLAY_IDENTIFIER fm_dyn_eprm[1].fm_dynamic_eprm_bitfield.Stx_fail_dc_dyn ECU_ADDRESS 0xd000591c BIT_MASK 0x20 /end MEASUREMENT
/begin MEASUREMENT Sbx_obd_sc_pass_dyn_1 "" UBYTE _CNV_A_R_A_105_CM 1 0. 0. 255. DISPLAY_IDENTIFIER fm_dyn_eprm[1].fm_dynamic_eprm_bitfield.Stx_obd_sc_pass_dyn ECU_ADDRESS 0xd000591c BIT_MASK 0x40 /end MEASUREMENT
/begin MEASUREMENT Sbx_obd_sc_wup_stt_dyn_1 "" UBYTE _CNV_A_R_A_105_CM 1 0. 0. 255. DISPLAY_IDENTIFIER fm_dyn_eprm[1].fm_dynamic_eprm_bitfield.Stx_obd_sc_wup_stt_dyn ECU_ADDRESS 0xd000591c BIT_MASK 0x80 /end MEASUREMENT
/begin MEASUREMENT Sxx_obd_wctr_dyn_1 "" UBYTE _CNV_A_R_ECME_LINEA_0_CM 1 0. 0. 255. DISPLAY_IDENTIFIER fm_dyn_eprm[1].Stx_obd_wctr_dyn ECU_ADDRESS 0xd000591d FORMAT "%3.0" /end MEASUREMENT
/begin MEASUREMENT Sxx_frq_dyn_1 "" UBYTE _CNV_A_R_ECME_LINEA_0_CM 1 0. 0. 255. DISPLAY_IDENTIFIER fm_dyn_eprm[1].Stx_frq_dyn ECU_ADDRESS 0xd000591e FORMAT "%3.0" /end MEASUREMENT
/begin MEASUREMENT Sxx_obd_clfctr_dyn_1 "" UBYTE _CNV_A_R_ECME_LINEA_0_CM 1 0. 0. 10. DISPLAY_IDENTIFIER fm_dyn_eprm[1].Stx_obd_clfctr_dyn ECU_ADDRESS 0xd000591f FORMAT "%3.0" /end MEASUREMENT
/begin MEASUREMENT Sxx_esd_siz_dyn_1 "" UBYTE _CNV_A_R_ECME_LINEA_0_CM 1 0. 0. 255. DISPLAY_IDENTIFIER fm_dyn_eprm[1].Stx_esd_siz_dyn ECU_ADDRESS 0xd0005920 FORMAT "%3.0" /end MEASUREMENT
/begin MEASUREMENT Sxx_obd_sc_ctr_dyn_1 "" UBYTE _CNV_A_R_ECME_LINEA_0_CM 1 0. 0. 255. DISPLAY_IDENTIFIER fm_dyn_eprm[1].Stx_obd_sc_ctr_dyn ECU_ADDRESS 0xd0005921 FORMAT "%3.0" /end MEASUREMENT
/begin MEASUREMENT Sxx_obd_sc_load_dyn_1 "" UBYTE _CNV_A_R_LINEAR_____165_CM 1 0. 0. 100. DISPLAY_IDENTIFIER fm_dyn_eprm[1].Stx_obd_sc_load_dyn ECU_ADDRESS 0xd0005922 FORMAT "%12.8" /end MEASUREMENT
/begin MEASUREMENT Sxx_pri_dyn_1 "" UBYTE _CNV_A_R_ECME_LINEA_0_CM 1 0. 0. 5. DISPLAY_IDENTIFIER fm_dyn_eprm[1].Stx_pri_dyn ECU_ADDRESS 0xd0005923 FORMAT "%3.0" /end MEASUREMENT
/begin MEASUREMENT Sxx_dist_fail_dyn_2 "" ULONG _CNV_A_R_LINEAR_____274_CM 1 0. 0. 16777215. DISPLAY_IDENTIFIER fm_dyn_eprm[2].Stx_dist_fail_dyn ECU_ADDRESS 0xd0005924 FORMAT "%10.0" /end MEASUREMENT
/begin MEASUREMENT Sxx_tmp_dist_dyn_2 "" ULONG _CNV_A_R_LINEAR_____274_CM 1 0. 0. 16777215. DISPLAY_IDENTIFIER fm_dyn_eprm[2].Stx_tmp_dist_dyn ECU_ADDRESS 0xd0005928 FORMAT "%10.0" /end MEASUREMENT
/begin MEASUREMENT Sxx_km_cf_dyn_2 "" ULONG _CNV_A_R_LINEAR_____274_CM 1 0. 0. 16777215. DISPLAY_IDENTIFIER fm_dyn_eprm[2].Stx_km_cf_dyn ECU_ADDRESS 0xd000592c FORMAT "%10.0" /end MEASUREMENT
/begin MEASUREMENT Sxx_km_mf_dyn_2 "" ULONG _CNV_A_R_LINEAR_____274_CM 1 0. 0. 16777215. DISPLAY_IDENTIFIER fm_dyn_eprm[2].Stx_km_mf_dyn ECU_ADDRESS 0xd0005930 FORMAT "%10.0" /end MEASUREMENT
/begin MEASUREMENT Sxx_km_pass_dyn_2 "" ULONG _CNV_A_R_LINEAR_____274_CM 1 0. 0. 16777215. DISPLAY_IDENTIFIER fm_dyn_eprm[2].Stx_km_pass_dyn ECU_ADDRESS 0xd0005934 FORMAT "%10.0" /end MEASUREMENT
/begin MEASUREMENT Sxx_ind_dyn_2 "" UWORD _CNV_A_R_ECME_LINEA_0_CM 1 0. 0. 65535. DISPLAY_IDENTIFIER fm_dyn_eprm[2].Stx_ind_dyn ECU_ADDRESS 0xd0005938 FORMAT "%5.0" /end MEASUREMENT
/begin MEASUREMENT Sxx_ffm_esti_tqe_dyn_2 "" UWORD _CNV_A_R_LINEAR_____216_CM 1 0. -400. 1647.96875 DISPLAY_IDENTIFIER fm_dyn_eprm[2].Stx_ffm_esti_tqe_dyn ECU_ADDRESS 0xd000593a FORMAT "%10.5" /end MEASUREMENT
/begin MEASUREMENT Sxx_ffm_esti_tqe_min_dyn_2 "" UWORD _CNV_A_R_LINEAR_____216_CM 1 0. -400. 1647.96875 DISPLAY_IDENTIFIER fm_dyn_eprm[2].Stx_ffm_esti_tqe_min_dyn ECU_ADDRESS 0xd000593c FORMAT "%10.5" /end MEASUREMENT
/begin MEASUREMENT Sxx_ffm_esti_tqe_max_dyn_2 "" UWORD _CNV_A_R_LINEAR_____216_CM 1 0. -400. 1647.96875 DISPLAY_IDENTIFIER fm_dyn_eprm[2].Stx_ffm_esti_tqe_max_dyn ECU_ADDRESS 0xd000593e FORMAT "%10.5" /end MEASUREMENT
/begin MEASUREMENT Sxx_ffm_n_dyn_2 "" UWORD _CNV_A_R_ENSD_LINEA_22_CM 1 0. 0. 16383.75 DISPLAY_IDENTIFIER fm_dyn_eprm[2].Stx_ffm_n_dyn ECU_ADDRESS 0xd0005940 FORMAT "%8.2" /end MEASUREMENT
/begin MEASUREMENT Sxx_ffm_n_min_dyn_2 "" UWORD _CNV_A_R_ENSD_LINEA_22_CM 1 0. 0. 16383.75 DISPLAY_IDENTIFIER fm_dyn_eprm[2].Stx_ffm_n_min_dyn ECU_ADDRESS 0xd0005942 FORMAT "%8.2" /end MEASUREMENT
/begin MEASUREMENT Sxx_ffm_n_max_dyn_2 "" UWORD _CNV_A_R_ENSD_LINEA_22_CM 1 0. 0. 16383.75 DISPLAY_IDENTIFIER fm_dyn_eprm[2].Stx_ffm_n_max_dyn ECU_ADDRESS 0xd0005944 FORMAT "%8.2" /end MEASUREMENT
/begin MEASUREMENT Sxx_ffm_tco_dyn_2 "" UWORD _CNV_A_R_LINEAR_____278_CM 1 0. -273. 6280.5 DISPLAY_IDENTIFIER fm_dyn_eprm[2].Stx_ffm_tco_dyn ECU_ADDRESS 0xd0005946 FORMAT "%6.1" /end MEASUREMENT
/begin MEASUREMENT Sxx_ffm_tco_min_dyn_2 "" UWORD _CNV_A_R_LINEAR_____278_CM 1 0. -273. 6280.5 DISPLAY_IDENTIFIER fm_dyn_eprm[2].Stx_ffm_tco_min_dyn ECU_ADDRESS 0xd0005948 FORMAT "%6.1" /end MEASUREMENT
/begin MEASUREMENT Sxx_ffm_tco_max_dyn_2 "" UWORD _CNV_A_R_LINEAR_____278_CM 1 0. -273. 6280.5 DISPLAY_IDENTIFIER fm_dyn_eprm[2].Stx_ffm_tco_max_dyn ECU_ADDRESS 0xd000594a FORMAT "%6.1" /end MEASUREMENT
/begin MEASUREMENT Sxx_ffm_vb_dyn_2 "" UWORD _CNV_A_R_LINEAR_____205_CM 1 0. 0. 655.35 DISPLAY_IDENTIFIER fm_dyn_eprm[2].Stx_ffm_vb_dyn ECU_ADDRESS 0xd000594c FORMAT "%6.2" /end MEASUREMENT
/begin MEASUREMENT Sxx_ffm_vb_min_dyn_2 "" UWORD _CNV_A_R_LINEAR_____205_CM 1 0. 0. 655.35 DISPLAY_IDENTIFIER fm_dyn_eprm[2].Stx_ffm_vb_min_dyn ECU_ADDRESS 0xd000594e FORMAT "%6.2" /end MEASUREMENT
/begin MEASUREMENT Sxx_ffm_vb_max_dyn_2 "" UWORD _CNV_A_R_LINEAR_____205_CM 1 0. 0. 655.35 DISPLAY_IDENTIFIER fm_dyn_eprm[2].Stx_ffm_vb_max_dyn ECU_ADDRESS 0xd0005950 FORMAT "%6.2" /end MEASUREMENT
/begin MEASUREMENT Sxx_ffm_vs_dyn_2 "" UWORD _CNV_A_R_LINEAR_____125_CM 1 0. 0. 655.35 DISPLAY_IDENTIFIER fm_dyn_eprm[2].Stx_ffm_vs_dyn ECU_ADDRESS 0xd0005952 FORMAT "%6.2" /end MEASUREMENT
/begin MEASUREMENT Sxx_ffm_vs_min_dyn_2 "" UWORD _CNV_A_R_LINEAR_____125_CM 1 0. 0. 655.35 DISPLAY_IDENTIFIER fm_dyn_eprm[2].Stx_ffm_vs_min_dyn ECU_ADDRESS 0xd0005954 FORMAT "%6.2" /end MEASUREMENT
/begin MEASUREMENT Sxx_ffm_vs_max_dyn_2 "" UWORD _CNV_A_R_LINEAR_____125_CM 1 0. 0. 655.35 DISPLAY_IDENTIFIER fm_dyn_eprm[2].Stx_ffm_vs_max_dyn ECU_ADDRESS 0xd0005956 FORMAT "%6.2" /end MEASUREMENT
/begin MEASUREMENT Sxx_ffm_did_1_dyn_2 "" UWORD _CNV_A_R_ECME_LINEA_0_CM 1 0. 0. 65535. DISPLAY_IDENTIFIER fm_dyn_eprm[2].Stx_ffm_did_X_dyn[0] ECU_ADDRESS 0xd0005958 FORMAT "%5.0" /end MEASUREMENT
/begin MEASUREMENT Sxx_ffm_did_2_dyn_2 "" UWORD _CNV_A_R_ECME_LINEA_0_CM 1 0. 0. 65535. DISPLAY_IDENTIFIER fm_dyn_eprm[2].Stx_ffm_did_X_dyn[1] ECU_ADDRESS 0xd000595a FORMAT "%5.0" /end MEASUREMENT
/begin MEASUREMENT Sxx_ffm_did_3_dyn_2 "" UWORD _CNV_A_R_ECME_LINEA_0_CM 1 0. 0. 65535. DISPLAY_IDENTIFIER fm_dyn_eprm[2].Stx_ffm_did_X_dyn[2] ECU_ADDRESS 0xd000595c FORMAT "%5.0" /end MEASUREMENT
/begin MEASUREMENT Sxx_ffm_did_4_dyn_2 "" UWORD _CNV_A_R_ECME_LINEA_0_CM 1 0. 0. 65535. DISPLAY_IDENTIFIER fm_dyn_eprm[2].Stx_ffm_did_X_dyn[3] ECU_ADDRESS 0xd000595e FORMAT "%5.0" /end MEASUREMENT
/begin MEASUREMENT Sxx_ffm_did_5_dyn_2 "" UWORD _CNV_A_R_ECME_LINEA_0_CM 1 0. 0. 65535. DISPLAY_IDENTIFIER fm_dyn_eprm[2].Stx_ffm_did_X_dyn[4] ECU_ADDRESS 0xd0005960 FORMAT "%5.0" /end MEASUREMENT
/begin MEASUREMENT Sxx_ffm_did_1_max_dyn_2 "" UWORD _CNV_A_R_ECME_LINEA_0_CM 1 0. 0. 65535. DISPLAY_IDENTIFIER fm_dyn_eprm[2].Stx_ffm_did_X_max_dyn[0] ECU_ADDRESS 0xd0005964 FORMAT "%5.0" /end MEASUREMENT
/begin MEASUREMENT Sxx_ffm_did_2_max_dyn_2 "" UWORD _CNV_A_R_ECME_LINEA_0_CM 1 0. 0. 65535. DISPLAY_IDENTIFIER fm_dyn_eprm[2].Stx_ffm_did_X_max_dyn[1] ECU_ADDRESS 0xd0005966 FORMAT "%5.0" /end MEASUREMENT
/begin MEASUREMENT Sxx_ffm_did_3_max_dyn_2 "" UWORD _CNV_A_R_ECME_LINEA_0_CM 1 0. 0. 65535. DISPLAY_IDENTIFIER fm_dyn_eprm[2].Stx_ffm_did_X_max_dyn[2] ECU_ADDRESS 0xd0005968 FORMAT "%5.0" /end MEASUREMENT
/begin MEASUREMENT Sxx_ffm_did_4_max_dyn_2 "" UWORD _CNV_A_R_ECME_LINEA_0_CM 1 0. 0. 65535. DISPLAY_IDENTIFIER fm_dyn_eprm[2].Stx_ffm_did_X_max_dyn[3] ECU_ADDRESS 0xd000596a FORMAT "%5.0" /end MEASUREMENT
/begin MEASUREMENT Sxx_ffm_did_5_max_dyn_2 "" UWORD _CNV_A_R_ECME_LINEA_0_CM 1 0. 0. 65535. DISPLAY_IDENTIFIER fm_dyn_eprm[2].Stx_ffm_did_X_max_dyn[4] ECU_ADDRESS 0xd000596c FORMAT "%5.0" /end MEASUREMENT
/begin MEASUREMENT Sxx_ffm_did_1_min_dyn_2 "" UWORD _CNV_A_R_ECME_LINEA_0_CM 1 0. 0. 65535. DISPLAY_IDENTIFIER fm_dyn_eprm[2].Stx_ffm_did_X_min_dyn[0] ECU_ADDRESS 0xd0005970 FORMAT "%5.0" /end MEASUREMENT
/begin MEASUREMENT Sxx_ffm_did_2_min_dyn_2 "" UWORD _CNV_A_R_ECME_LINEA_0_CM 1 0. 0. 65535. DISPLAY_IDENTIFIER fm_dyn_eprm[2].Stx_ffm_did_X_min_dyn[1] ECU_ADDRESS 0xd0005972 FORMAT "%5.0" /end MEASUREMENT
/begin MEASUREMENT Sxx_ffm_did_3_min_dyn_2 "" UWORD _CNV_A_R_ECME_LINEA_0_CM 1 0. 0. 65535. DISPLAY_IDENTIFIER fm_dyn_eprm[2].Stx_ffm_did_X_min_dyn[2] ECU_ADDRESS 0xd0005974 FORMAT "%5.0" /end MEASUREMENT
/begin MEASUREMENT Sxx_ffm_did_4_min_dyn_2 "" UWORD _CNV_A_R_ECME_LINEA_0_CM 1 0. 0. 65535. DISPLAY_IDENTIFIER fm_dyn_eprm[2].Stx_ffm_did_X_min_dyn[3] ECU_ADDRESS 0xd0005976 FORMAT "%5.0" /end MEASUREMENT
/begin MEASUREMENT Sxx_ffm_did_5_min_dyn_2 "" UWORD _CNV_A_R_ECME_LINEA_0_CM 1 0. 0. 65535. DISPLAY_IDENTIFIER fm_dyn_eprm[2].Stx_ffm_did_X_min_dyn[4] ECU_ADDRESS 0xd0005978 FORMAT "%5.0" /end MEASUREMENT
/begin MEASUREMENT Sxx_obd_sc_n_dyn_2 "" UWORD _CNV_A_R_ENSD_LINEA_22_CM 1 0. 0. 16383.75 DISPLAY_IDENTIFIER fm_dyn_eprm[2].Stx_obd_sc_n_dyn ECU_ADDRESS 0xd000597a FORMAT "%8.2" /end MEASUREMENT
/begin MEASUREMENT Sbx_pfo_dyn_2 "" UBYTE _CNV_A_R_A_105_CM 1 0. 0. 255. DISPLAY_IDENTIFIER fm_dyn_eprm[2].fm_dynamic_eprm_bitfield.Stx_pfo_dyn ECU_ADDRESS 0xd000597c BIT_MASK 0x2 /end MEASUREMENT
/begin MEASUREMENT Sbx_mfo_dyn_2 "" UBYTE _CNV_A_R_A_105_CM 1 0. 0. 255. DISPLAY_IDENTIFIER fm_dyn_eprm[2].fm_dynamic_eprm_bitfield.Stx_mfo_dyn ECU_ADDRESS 0xd000597c BIT_MASK 0x4 /end MEASUREMENT
/begin MEASUREMENT Sbx_obd_mreq_dyn_2 "" UBYTE _CNV_A_R_A_105_CM 1 0. 0. 255. DISPLAY_IDENTIFIER fm_dyn_eprm[2].fm_dynamic_eprm_bitfield.Stx_obd_mreq_dyn ECU_ADDRESS 0xd000597c BIT_MASK 0x8 /end MEASUREMENT
/begin MEASUREMENT Sbx_obd_dc_rdn_dyn_2 "" UBYTE _CNV_A_R_A_105_CM 1 0. 0. 255. DISPLAY_IDENTIFIER fm_dyn_eprm[2].fm_dynamic_eprm_bitfield.Stx_obd_dc_rdn_dyn ECU_ADDRESS 0xd000597c BIT_MASK 0x10 /end MEASUREMENT
/begin MEASUREMENT Sbx_fail_dc_dyn_2 "" UBYTE _CNV_A_R_A_105_CM 1 0. 0. 255. DISPLAY_IDENTIFIER fm_dyn_eprm[2].fm_dynamic_eprm_bitfield.Stx_fail_dc_dyn ECU_ADDRESS 0xd000597c BIT_MASK 0x20 /end MEASUREMENT
/begin MEASUREMENT Sbx_obd_sc_pass_dyn_2 "" UBYTE _CNV_A_R_A_105_CM 1 0. 0. 255. DISPLAY_IDENTIFIER fm_dyn_eprm[2].fm_dynamic_eprm_bitfield.Stx_obd_sc_pass_dyn ECU_ADDRESS 0xd000597c BIT_MASK 0x40 /end MEASUREMENT
/begin MEASUREMENT Sbx_obd_sc_wup_stt_dyn_2 "" UBYTE _CNV_A_R_A_105_CM 1 0. 0. 255. DISPLAY_IDENTIFIER fm_dyn_eprm[2].fm_dynamic_eprm_bitfield.Stx_obd_sc_wup_stt_dyn ECU_ADDRESS 0xd000597c BIT_MASK 0x80 /end MEASUREMENT
/begin MEASUREMENT Sxx_obd_wctr_dyn_2 "" UBYTE _CNV_A_R_ECME_LINEA_0_CM 1 0. 0. 255. DISPLAY_IDENTIFIER fm_dyn_eprm[2].Stx_obd_wctr_dyn ECU_ADDRESS 0xd000597d FORMAT "%3.0" /end MEASUREMENT
/begin MEASUREMENT Sxx_frq_dyn_2 "" UBYTE _CNV_A_R_ECME_LINEA_0_CM 1 0. 0. 255. DISPLAY_IDENTIFIER fm_dyn_eprm[2].Stx_frq_dyn ECU_ADDRESS 0xd000597e FORMAT "%3.0" /end MEASUREMENT
/begin MEASUREMENT Sxx_obd_clfctr_dyn_2 "" UBYTE _CNV_A_R_ECME_LINEA_0_CM 1 0. 0. 10. DISPLAY_IDENTIFIER fm_dyn_eprm[2].Stx_obd_clfctr_dyn ECU_ADDRESS 0xd000597f FORMAT "%3.0" /end MEASUREMENT
/begin MEASUREMENT Sxx_esd_siz_dyn_2 "" UBYTE _CNV_A_R_ECME_LINEA_0_CM 1 0. 0. 255. DISPLAY_IDENTIFIER fm_dyn_eprm[2].Stx_esd_siz_dyn ECU_ADDRESS 0xd0005980 FORMAT "%3.0" /end MEASUREMENT
/begin MEASUREMENT Sxx_obd_sc_ctr_dyn_2 "" UBYTE _CNV_A_R_ECME_LINEA_0_CM 1 0. 0. 255. DISPLAY_IDENTIFIER fm_dyn_eprm[2].Stx_obd_sc_ctr_dyn ECU_ADDRESS 0xd0005981 FORMAT "%3.0" /end MEASUREMENT
/begin MEASUREMENT Sxx_obd_sc_load_dyn_2 "" UBYTE _CNV_A_R_LINEAR_____165_CM 1 0. 0. 100. DISPLAY_IDENTIFIER fm_dyn_eprm[2].Stx_obd_sc_load_dyn ECU_ADDRESS 0xd0005982 FORMAT "%12.8" /end MEASUREMENT
/begin MEASUREMENT Sxx_pri_dyn_2 "" UBYTE _CNV_A_R_ECME_LINEA_0_CM 1 0. 0. 5. DISPLAY_IDENTIFIER fm_dyn_eprm[2].Stx_pri_dyn ECU_ADDRESS 0xd0005983 FORMAT "%3.0" /end MEASUREMENT
/begin MEASUREMENT Sxx_dist_fail_dyn_3 "" ULONG _CNV_A_R_LINEAR_____274_CM 1 0. 0. 16777215. DISPLAY_IDENTIFIER fm_dyn_eprm[3].Stx_dist_fail_dyn ECU_ADDRESS 0xd0005984 FORMAT "%10.0" /end MEASUREMENT
/begin MEASUREMENT Sxx_tmp_dist_dyn_3 "" ULONG _CNV_A_R_LINEAR_____274_CM 1 0. 0. 16777215. DISPLAY_IDENTIFIER fm_dyn_eprm[3].Stx_tmp_dist_dyn ECU_ADDRESS 0xd0005988 FORMAT "%10.0" /end MEASUREMENT
/begin MEASUREMENT Sxx_km_cf_dyn_3 "" ULONG _CNV_A_R_LINEAR_____274_CM 1 0. 0. 16777215. DISPLAY_IDENTIFIER fm_dyn_eprm[3].Stx_km_cf_dyn ECU_ADDRESS 0xd000598c FORMAT "%10.0" /end MEASUREMENT
/begin MEASUREMENT Sxx_km_mf_dyn_3 "" ULONG _CNV_A_R_LINEAR_____274_CM 1 0. 0. 16777215. DISPLAY_IDENTIFIER fm_dyn_eprm[3].Stx_km_mf_dyn ECU_ADDRESS 0xd0005990 FORMAT "%10.0" /end MEASUREMENT
/begin MEASUREMENT Sxx_km_pass_dyn_3 "" ULONG _CNV_A_R_LINEAR_____274_CM 1 0. 0. 16777215. DISPLAY_IDENTIFIER fm_dyn_eprm[3].Stx_km_pass_dyn ECU_ADDRESS 0xd0005994 FORMAT "%10.0" /end MEASUREMENT
/begin MEASUREMENT Sxx_ind_dyn_3 "" UWORD _CNV_A_R_ECME_LINEA_0_CM 1 0. 0. 65535. DISPLAY_IDENTIFIER fm_dyn_eprm[3].Stx_ind_dyn ECU_ADDRESS 0xd0005998 FORMAT "%5.0" /end MEASUREMENT
/begin MEASUREMENT Sxx_ffm_esti_tqe_dyn_3 "" UWORD _CNV_A_R_LINEAR_____216_CM 1 0. -400. 1647.96875 DISPLAY_IDENTIFIER fm_dyn_eprm[3].Stx_ffm_esti_tqe_dyn ECU_ADDRESS 0xd000599a FORMAT "%10.5" /end MEASUREMENT
/begin MEASUREMENT Sxx_ffm_esti_tqe_min_dyn_3 "" UWORD _CNV_A_R_LINEAR_____216_CM 1 0. -400. 1647.96875 DISPLAY_IDENTIFIER fm_dyn_eprm[3].Stx_ffm_esti_tqe_min_dyn ECU_ADDRESS 0xd000599c FORMAT "%10.5" /end MEASUREMENT
/begin MEASUREMENT Sxx_ffm_esti_tqe_max_dyn_3 "" UWORD _CNV_A_R_LINEAR_____216_CM 1 0. -400. 1647.96875 DISPLAY_IDENTIFIER fm_dyn_eprm[3].Stx_ffm_esti_tqe_max_dyn ECU_ADDRESS 0xd000599e FORMAT "%10.5" /end MEASUREMENT
/begin MEASUREMENT Sxx_ffm_n_dyn_3 "" UWORD _CNV_A_R_ENSD_LINEA_22_CM 1 0. 0. 16383.75 DISPLAY_IDENTIFIER fm_dyn_eprm[3].Stx_ffm_n_dyn ECU_ADDRESS 0xd00059a0 FORMAT "%8.2" /end MEASUREMENT
/begin MEASUREMENT Sxx_ffm_n_min_dyn_3 "" UWORD _CNV_A_R_ENSD_LINEA_22_CM 1 0. 0. 16383.75 DISPLAY_IDENTIFIER fm_dyn_eprm[3].Stx_ffm_n_min_dyn ECU_ADDRESS 0xd00059a2 FORMAT "%8.2" /end MEASUREMENT
/begin MEASUREMENT Sxx_ffm_n_max_dyn_3 "" UWORD _CNV_A_R_ENSD_LINEA_22_CM 1 0. 0. 16383.75 DISPLAY_IDENTIFIER fm_dyn_eprm[3].Stx_ffm_n_max_dyn ECU_ADDRESS 0xd00059a4 FORMAT "%8.2" /end MEASUREMENT
/begin MEASUREMENT Sxx_ffm_tco_dyn_3 "" UWORD _CNV_A_R_LINEAR_____278_CM 1 0. -273. 6280.5 DISPLAY_IDENTIFIER fm_dyn_eprm[3].Stx_ffm_tco_dyn ECU_ADDRESS 0xd00059a6 FORMAT "%6.1" /end MEASUREMENT
/begin MEASUREMENT Sxx_ffm_tco_min_dyn_3 "" UWORD _CNV_A_R_LINEAR_____278_CM 1 0. -273. 6280.5 DISPLAY_IDENTIFIER fm_dyn_eprm[3].Stx_ffm_tco_min_dyn ECU_ADDRESS 0xd00059a8 FORMAT "%6.1" /end MEASUREMENT
/begin MEASUREMENT Sxx_ffm_tco_max_dyn_3 "" UWORD _CNV_A_R_LINEAR_____278_CM 1 0. -273. 6280.5 DISPLAY_IDENTIFIER fm_dyn_eprm[3].Stx_ffm_tco_max_dyn ECU_ADDRESS 0xd00059aa FORMAT "%6.1" /end MEASUREMENT
/begin MEASUREMENT Sxx_ffm_vb_dyn_3 "" UWORD _CNV_A_R_LINEAR_____205_CM 1 0. 0. 655.35 DISPLAY_IDENTIFIER fm_dyn_eprm[3].Stx_ffm_vb_dyn ECU_ADDRESS 0xd00059ac FORMAT "%6.2" /end MEASUREMENT
/begin MEASUREMENT Sxx_ffm_vb_min_dyn_3 "" UWORD _CNV_A_R_LINEAR_____205_CM 1 0. 0. 655.35 DISPLAY_IDENTIFIER fm_dyn_eprm[3].Stx_ffm_vb_min_dyn ECU_ADDRESS 0xd00059ae FORMAT "%6.2" /end MEASUREMENT
/begin MEASUREMENT Sxx_ffm_vb_max_dyn_3 "" UWORD _CNV_A_R_LINEAR_____205_CM 1 0. 0. 655.35 DISPLAY_IDENTIFIER fm_dyn_eprm[3].Stx_ffm_vb_max_dyn ECU_ADDRESS 0xd00059b0 FORMAT "%6.2" /end MEASUREMENT
/begin MEASUREMENT Sxx_ffm_vs_dyn_3 "" UWORD _CNV_A_R_LINEAR_____125_CM 1 0. 0. 655.35 DISPLAY_IDENTIFIER fm_dyn_eprm[3].Stx_ffm_vs_dyn ECU_ADDRESS 0xd00059b2 FORMAT "%6.2" /end MEASUREMENT
/begin MEASUREMENT Sxx_ffm_vs_min_dyn_3 "" UWORD _CNV_A_R_LINEAR_____125_CM 1 0. 0. 655.35 DISPLAY_IDENTIFIER fm_dyn_eprm[3].Stx_ffm_vs_min_dyn ECU_ADDRESS 0xd00059b4 FORMAT "%6.2" /end MEASUREMENT
/begin MEASUREMENT Sxx_ffm_vs_max_dyn_3 "" UWORD _CNV_A_R_LINEAR_____125_CM 1 0. 0. 655.35 DISPLAY_IDENTIFIER fm_dyn_eprm[3].Stx_ffm_vs_max_dyn ECU_ADDRESS 0xd00059b6 FORMAT "%6.2" /end MEASUREMENT
/begin MEASUREMENT Sxx_ffm_did_1_dyn_3 "" UWORD _CNV_A_R_ECME_LINEA_0_CM 1 0. 0. 65535. DISPLAY_IDENTIFIER fm_dyn_eprm[3].Stx_ffm_did_X_dyn[0] ECU_ADDRESS 0xd00059b8 FORMAT "%5.0" /end MEASUREMENT
/begin MEASUREMENT Sxx_ffm_did_2_dyn_3 "" UWORD _CNV_A_R_ECME_LINEA_0_CM 1 0. 0. 65535. DISPLAY_IDENTIFIER fm_dyn_eprm[3].Stx_ffm_did_X_dyn[1] ECU_ADDRESS 0xd00059ba FORMAT "%5.0" /end MEASUREMENT
/begin MEASUREMENT Sxx_ffm_did_3_dyn_3 "" UWORD _CNV_A_R_ECME_LINEA_0_CM 1 0. 0. 65535. DISPLAY_IDENTIFIER fm_dyn_eprm[3].Stx_ffm_did_X_dyn[2] ECU_ADDRESS 0xd00059bc FORMAT "%5.0" /end MEASUREMENT
/begin MEASUREMENT Sxx_ffm_did_4_dyn_3 "" UWORD _CNV_A_R_ECME_LINEA_0_CM 1 0. 0. 65535. DISPLAY_IDENTIFIER fm_dyn_eprm[3].Stx_ffm_did_X_dyn[3] ECU_ADDRESS 0xd00059be FORMAT "%5.0" /end MEASUREMENT
/begin MEASUREMENT Sxx_ffm_did_5_dyn_3 "" UWORD _CNV_A_R_ECME_LINEA_0_CM 1 0. 0. 65535. DISPLAY_IDENTIFIER fm_dyn_eprm[3].Stx_ffm_did_X_dyn[4] ECU_ADDRESS 0xd00059c0 FORMAT "%5.0" /end MEASUREMENT
/begin MEASUREMENT Sxx_ffm_did_1_max_dyn_3 "" UWORD _CNV_A_R_ECME_LINEA_0_CM 1 0. 0. 65535. DISPLAY_IDENTIFIER fm_dyn_eprm[3].Stx_ffm_did_X_max_dyn[0] ECU_ADDRESS 0xd00059c4 FORMAT "%5.0" /end MEASUREMENT
/begin MEASUREMENT Sxx_ffm_did_2_max_dyn_3 "" UWORD _CNV_A_R_ECME_LINEA_0_CM 1 0. 0. 65535. DISPLAY_IDENTIFIER fm_dyn_eprm[3].Stx_ffm_did_X_max_dyn[1] ECU_ADDRESS 0xd00059c6 FORMAT "%5.0" /end MEASUREMENT
/begin MEASUREMENT Sxx_ffm_did_3_max_dyn_3 "" UWORD _CNV_A_R_ECME_LINEA_0_CM 1 0. 0. 65535. DISPLAY_IDENTIFIER fm_dyn_eprm[3].Stx_ffm_did_X_max_dyn[2] ECU_ADDRESS 0xd00059c8 FORMAT "%5.0" /end MEASUREMENT
/begin MEASUREMENT Sxx_ffm_did_4_max_dyn_3 "" UWORD _CNV_A_R_ECME_LINEA_0_CM 1 0. 0. 65535. DISPLAY_IDENTIFIER fm_dyn_eprm[3].Stx_ffm_did_X_max_dyn[3] ECU_ADDRESS 0xd00059ca FORMAT "%5.0" /end MEASUREMENT
/begin MEASUREMENT Sxx_ffm_did_5_max_dyn_3 "" UWORD _CNV_A_R_ECME_LINEA_0_CM 1 0. 0. 65535. DISPLAY_IDENTIFIER fm_dyn_eprm[3].Stx_ffm_did_X_max_dyn[4] ECU_ADDRESS 0xd00059cc FORMAT "%5.0" /end MEASUREMENT
/begin MEASUREMENT Sxx_ffm_did_1_min_dyn_3 "" UWORD _CNV_A_R_ECME_LINEA_0_CM 1 0. 0. 65535. DISPLAY_IDENTIFIER fm_dyn_eprm[3].Stx_ffm_did_X_min_dyn[0] ECU_ADDRESS 0xd00059d0 FORMAT "%5.0" /end MEASUREMENT
/begin MEASUREMENT Sxx_ffm_did_2_min_dyn_3 "" UWORD _CNV_A_R_ECME_LINEA_0_CM 1 0. 0. 65535. DISPLAY_IDENTIFIER fm_dyn_eprm[3].Stx_ffm_did_X_min_dyn[1] ECU_ADDRESS 0xd00059d2 FORMAT "%5.0" /end MEASUREMENT
/begin MEASUREMENT Sxx_ffm_did_3_min_dyn_3 "" UWORD _CNV_A_R_ECME_LINEA_0_CM 1 0. 0. 65535. DISPLAY_IDENTIFIER fm_dyn_eprm[3].Stx_ffm_did_X_min_dyn[2] ECU_ADDRESS 0xd00059d4 FORMAT "%5.0" /end MEASUREMENT
/begin MEASUREMENT Sxx_ffm_did_4_min_dyn_3 "" UWORD _CNV_A_R_ECME_LINEA_0_CM 1 0. 0. 65535. DISPLAY_IDENTIFIER fm_dyn_eprm[3].Stx_ffm_did_X_min_dyn[3] ECU_ADDRESS 0xd00059d6 FORMAT "%5.0" /end MEASUREMENT
/begin MEASUREMENT Sxx_ffm_did_5_min_dyn_3 "" UWORD _CNV_A_R_ECME_LINEA_0_CM 1 0. 0. 65535. DISPLAY_IDENTIFIER fm_dyn_eprm[3].Stx_ffm_did_X_min_dyn[4] ECU_ADDRESS 0xd00059d8 FORMAT "%5.0" /end MEASUREMENT
/begin MEASUREMENT Sxx_obd_sc_n_dyn_3 "" UWORD _CNV_A_R_ENSD_LINEA_22_CM 1 0. 0. 16383.75 DISPLAY_IDENTIFIER fm_dyn_eprm[3].Stx_obd_sc_n_dyn ECU_ADDRESS 0xd00059da FORMAT "%8.2" /end MEASUREMENT
/begin MEASUREMENT Sbx_pfo_dyn_3 "" UBYTE _CNV_A_R_A_105_CM 1 0. 0. 255. DISPLAY_IDENTIFIER fm_dyn_eprm[3].fm_dynamic_eprm_bitfield.Stx_pfo_dyn ECU_ADDRESS 0xd00059dc BIT_MASK 0x2 /end MEASUREMENT
/begin MEASUREMENT Sbx_mfo_dyn_3 "" UBYTE _CNV_A_R_A_105_CM 1 0. 0. 255. DISPLAY_IDENTIFIER fm_dyn_eprm[3].fm_dynamic_eprm_bitfield.Stx_mfo_dyn ECU_ADDRESS 0xd00059dc BIT_MASK 0x4 /end MEASUREMENT
/begin MEASUREMENT Sbx_obd_mreq_dyn_3 "" UBYTE _CNV_A_R_A_105_CM 1 0. 0. 255. DISPLAY_IDENTIFIER fm_dyn_eprm[3].fm_dynamic_eprm_bitfield.Stx_obd_mreq_dyn ECU_ADDRESS 0xd00059dc BIT_MASK 0x8 /end MEASUREMENT
/begin MEASUREMENT Sbx_obd_dc_rdn_dyn_3 "" UBYTE _CNV_A_R_A_105_CM 1 0. 0. 255. DISPLAY_IDENTIFIER fm_dyn_eprm[3].fm_dynamic_eprm_bitfield.Stx_obd_dc_rdn_dyn ECU_ADDRESS 0xd00059dc BIT_MASK 0x10 /end MEASUREMENT
/begin MEASUREMENT Sbx_fail_dc_dyn_3 "" UBYTE _CNV_A_R_A_105_CM 1 0. 0. 255. DISPLAY_IDENTIFIER fm_dyn_eprm[3].fm_dynamic_eprm_bitfield.Stx_fail_dc_dyn ECU_ADDRESS 0xd00059dc BIT_MASK 0x20 /end MEASUREMENT
/begin MEASUREMENT Sbx_obd_sc_pass_dyn_3 "" UBYTE _CNV_A_R_A_105_CM 1 0. 0. 255. DISPLAY_IDENTIFIER fm_dyn_eprm[3].fm_dynamic_eprm_bitfield.Stx_obd_sc_pass_dyn ECU_ADDRESS 0xd00059dc BIT_MASK 0x40 /end MEASUREMENT
/begin MEASUREMENT Sbx_obd_sc_wup_stt_dyn_3 "" UBYTE _CNV_A_R_A_105_CM 1 0. 0. 255. DISPLAY_IDENTIFIER fm_dyn_eprm[3].fm_dynamic_eprm_bitfield.Stx_obd_sc_wup_stt_dyn ECU_ADDRESS 0xd00059dc BIT_MASK 0x80 /end MEASUREMENT
/begin MEASUREMENT Sxx_obd_wctr_dyn_3 "" UBYTE _CNV_A_R_ECME_LINEA_0_CM 1 0. 0. 255. DISPLAY_IDENTIFIER fm_dyn_eprm[3].Stx_obd_wctr_dyn ECU_ADDRESS 0xd00059dd FORMAT "%3.0" /end MEASUREMENT
/begin MEASUREMENT Sxx_frq_dyn_3 "" UBYTE _CNV_A_R_ECME_LINEA_0_CM 1 0. 0. 255. DISPLAY_IDENTIFIER fm_dyn_eprm[3].Stx_frq_dyn ECU_ADDRESS 0xd00059de FORMAT "%3.0" /end MEASUREMENT
/begin MEASUREMENT Sxx_obd_clfctr_dyn_3 "" UBYTE _CNV_A_R_ECME_LINEA_0_CM 1 0. 0. 10. DISPLAY_IDENTIFIER fm_dyn_eprm[3].Stx_obd_clfctr_dyn ECU_ADDRESS 0xd00059df FORMAT "%3.0" /end MEASUREMENT
/begin MEASUREMENT Sxx_esd_siz_dyn_3 "" UBYTE _CNV_A_R_ECME_LINEA_0_CM 1 0. 0. 255. DISPLAY_IDENTIFIER fm_dyn_eprm[3].Stx_esd_siz_dyn ECU_ADDRESS 0xd00059e0 FORMAT "%3.0" /end MEASUREMENT
/begin MEASUREMENT Sxx_obd_sc_ctr_dyn_3 "" UBYTE _CNV_A_R_ECME_LINEA_0_CM 1 0. 0. 255. DISPLAY_IDENTIFIER fm_dyn_eprm[3].Stx_obd_sc_ctr_dyn ECU_ADDRESS 0xd00059e1 FORMAT "%3.0" /end MEASUREMENT
/begin MEASUREMENT Sxx_obd_sc_load_dyn_3 "" UBYTE _CNV_A_R_LINEAR_____165_CM 1 0. 0. 100. DISPLAY_IDENTIFIER fm_dyn_eprm[3].Stx_obd_sc_load_dyn ECU_ADDRESS 0xd00059e2 FORMAT "%12.8" /end MEASUREMENT
/begin MEASUREMENT Sxx_pri_dyn_3 "" UBYTE _CNV_A_R_ECME_LINEA_0_CM 1 0. 0. 5. DISPLAY_IDENTIFIER fm_dyn_eprm[3].Stx_pri_dyn ECU_ADDRESS 0xd00059e3 FORMAT "%3.0" /end MEASUREMENT
/begin MEASUREMENT Sxx_dist_fail_dyn_4 "" ULONG _CNV_A_R_LINEAR_____274_CM 1 0. 0. 16777215. DISPLAY_IDENTIFIER fm_dyn_eprm[4].Stx_dist_fail_dyn ECU_ADDRESS 0xd00059e4 FORMAT "%10.0" /end MEASUREMENT
/begin MEASUREMENT Sxx_tmp_dist_dyn_4 "" ULONG _CNV_A_R_LINEAR_____274_CM 1 0. 0. 16777215. DISPLAY_IDENTIFIER fm_dyn_eprm[4].Stx_tmp_dist_dyn ECU_ADDRESS 0xd00059e8 FORMAT "%10.0" /end MEASUREMENT
/begin MEASUREMENT Sxx_km_cf_dyn_4 "" ULONG _CNV_A_R_LINEAR_____274_CM 1 0. 0. 16777215. DISPLAY_IDENTIFIER fm_dyn_eprm[4].Stx_km_cf_dyn ECU_ADDRESS 0xd00059ec FORMAT "%10.0" /end MEASUREMENT
/begin MEASUREMENT Sxx_km_mf_dyn_4 "" ULONG _CNV_A_R_LINEAR_____274_CM 1 0. 0. 16777215. DISPLAY_IDENTIFIER fm_dyn_eprm[4].Stx_km_mf_dyn ECU_ADDRESS 0xd00059f0 FORMAT "%10.0" /end MEASUREMENT
/begin MEASUREMENT Sxx_km_pass_dyn_4 "" ULONG _CNV_A_R_LINEAR_____274_CM 1 0. 0. 16777215. DISPLAY_IDENTIFIER fm_dyn_eprm[4].Stx_km_pass_dyn ECU_ADDRESS 0xd00059f4 FORMAT "%10.0" /end MEASUREMENT
/begin MEASUREMENT Sxx_ind_dyn_4 "" UWORD _CNV_A_R_ECME_LINEA_0_CM 1 0. 0. 65535. DISPLAY_IDENTIFIER fm_dyn_eprm[4].Stx_ind_dyn ECU_ADDRESS 0xd00059f8 FORMAT "%5.0" /end MEASUREMENT
/begin MEASUREMENT Sxx_ffm_esti_tqe_dyn_4 "" UWORD _CNV_A_R_LINEAR_____216_CM 1 0. -400. 1647.96875 DISPLAY_IDENTIFIER fm_dyn_eprm[4].Stx_ffm_esti_tqe_dyn ECU_ADDRESS 0xd00059fa FORMAT "%10.5" /end MEASUREMENT
/begin MEASUREMENT Sxx_ffm_esti_tqe_min_dyn_4 "" UWORD _CNV_A_R_LINEAR_____216_CM 1 0. -400. 1647.96875 DISPLAY_IDENTIFIER fm_dyn_eprm[4].Stx_ffm_esti_tqe_min_dyn ECU_ADDRESS 0xd00059fc FORMAT "%10.5" /end MEASUREMENT
/begin MEASUREMENT Sxx_ffm_esti_tqe_max_dyn_4 "" UWORD _CNV_A_R_LINEAR_____216_CM 1 0. -400. 1647.96875 DISPLAY_IDENTIFIER fm_dyn_eprm[4].Stx_ffm_esti_tqe_max_dyn ECU_ADDRESS 0xd00059fe FORMAT "%10.5" /end MEASUREMENT
/begin MEASUREMENT Sxx_ffm_n_dyn_4 "" UWORD _CNV_A_R_ENSD_LINEA_22_CM 1 0. 0. 16383.75 DISPLAY_IDENTIFIER fm_dyn_eprm[4].Stx_ffm_n_dyn ECU_ADDRESS 0xd0005a00 FORMAT "%8.2" /end MEASUREMENT
/begin MEASUREMENT Sxx_ffm_n_min_dyn_4 "" UWORD _CNV_A_R_ENSD_LINEA_22_CM 1 0. 0. 16383.75 DISPLAY_IDENTIFIER fm_dyn_eprm[4].Stx_ffm_n_min_dyn ECU_ADDRESS 0xd0005a02 FORMAT "%8.2" /end MEASUREMENT
/begin MEASUREMENT Sxx_ffm_n_max_dyn_4 "" UWORD _CNV_A_R_ENSD_LINEA_22_CM 1 0. 0. 16383.75 DISPLAY_IDENTIFIER fm_dyn_eprm[4].Stx_ffm_n_max_dyn ECU_ADDRESS 0xd0005a04 FORMAT "%8.2" /end MEASUREMENT
/begin MEASUREMENT Sxx_ffm_tco_dyn_4 "" UWORD _CNV_A_R_LINEAR_____278_CM 1 0. -273. 6280.5 DISPLAY_IDENTIFIER fm_dyn_eprm[4].Stx_ffm_tco_dyn ECU_ADDRESS 0xd0005a06 FORMAT "%6.1" /end MEASUREMENT
/begin MEASUREMENT Sxx_ffm_tco_min_dyn_4 "" UWORD _CNV_A_R_LINEAR_____278_CM 1 0. -273. 6280.5 DISPLAY_IDENTIFIER fm_dyn_eprm[4].Stx_ffm_tco_min_dyn ECU_ADDRESS 0xd0005a08 FORMAT "%6.1" /end MEASUREMENT
/begin MEASUREMENT Sxx_ffm_tco_max_dyn_4 "" UWORD _CNV_A_R_LINEAR_____278_CM 1 0. -273. 6280.5 DISPLAY_IDENTIFIER fm_dyn_eprm[4].Stx_ffm_tco_max_dyn ECU_ADDRESS 0xd0005a0a FORMAT "%6.1" /end MEASUREMENT
/begin MEASUREMENT Sxx_ffm_vb_dyn_4 "" UWORD _CNV_A_R_LINEAR_____205_CM 1 0. 0. 655.35 DISPLAY_IDENTIFIER fm_dyn_eprm[4].Stx_ffm_vb_dyn ECU_ADDRESS 0xd0005a0c FORMAT "%6.2" /end MEASUREMENT
/begin MEASUREMENT Sxx_ffm_vb_min_dyn_4 "" UWORD _CNV_A_R_LINEAR_____205_CM 1 0. 0. 655.35 DISPLAY_IDENTIFIER fm_dyn_eprm[4].Stx_ffm_vb_min_dyn ECU_ADDRESS 0xd0005a0e FORMAT "%6.2" /end MEASUREMENT
/begin MEASUREMENT Sxx_ffm_vb_max_dyn_4 "" UWORD _CNV_A_R_LINEAR_____205_CM 1 0. 0. 655.35 DISPLAY_IDENTIFIER fm_dyn_eprm[4].Stx_ffm_vb_max_dyn ECU_ADDRESS 0xd0005a10 FORMAT "%6.2" /end MEASUREMENT
/begin MEASUREMENT Sxx_ffm_vs_dyn_4 "" UWORD _CNV_A_R_LINEAR_____125_CM 1 0. 0. 655.35 DISPLAY_IDENTIFIER fm_dyn_eprm[4].Stx_ffm_vs_dyn ECU_ADDRESS 0xd0005a12 FORMAT "%6.2" /end MEASUREMENT
/begin MEASUREMENT Sxx_ffm_vs_min_dyn_4 "" UWORD _CNV_A_R_LINEAR_____125_CM 1 0. 0. 655.35 DISPLAY_IDENTIFIER fm_dyn_eprm[4].Stx_ffm_vs_min_dyn ECU_ADDRESS 0xd0005a14 FORMAT "%6.2" /end MEASUREMENT
/begin MEASUREMENT Sxx_ffm_vs_max_dyn_4 "" UWORD _CNV_A_R_LINEAR_____125_CM 1 0. 0. 655.35 DISPLAY_IDENTIFIER fm_dyn_eprm[4].Stx_ffm_vs_max_dyn ECU_ADDRESS 0xd0005a16 FORMAT "%6.2" /end MEASUREMENT
/begin MEASUREMENT Sxx_ffm_did_1_dyn_4 "" UWORD _CNV_A_R_ECME_LINEA_0_CM 1 0. 0. 65535. DISPLAY_IDENTIFIER fm_dyn_eprm[4].Stx_ffm_did_X_dyn[0] ECU_ADDRESS 0xd0005a18 FORMAT "%5.0" /end MEASUREMENT
/begin MEASUREMENT Sxx_ffm_did_2_dyn_4 "" UWORD _CNV_A_R_ECME_LINEA_0_CM 1 0. 0. 65535. DISPLAY_IDENTIFIER fm_dyn_eprm[4].Stx_ffm_did_X_dyn[1] ECU_ADDRESS 0xd0005a1a FORMAT "%5.0" /end MEASUREMENT
/begin MEASUREMENT Sxx_ffm_did_3_dyn_4 "" UWORD _CNV_A_R_ECME_LINEA_0_CM 1 0. 0. 65535. DISPLAY_IDENTIFIER fm_dyn_eprm[4].Stx_ffm_did_X_dyn[2] ECU_ADDRESS 0xd0005a1c FORMAT "%5.0" /end MEASUREMENT
/begin MEASUREMENT Sxx_ffm_did_4_dyn_4 "" UWORD _CNV_A_R_ECME_LINEA_0_CM 1 0. 0. 65535. DISPLAY_IDENTIFIER fm_dyn_eprm[4].Stx_ffm_did_X_dyn[3] ECU_ADDRESS 0xd0005a1e FORMAT "%5.0" /end MEASUREMENT
/begin MEASUREMENT Sxx_ffm_did_5_dyn_4 "" UWORD _CNV_A_R_ECME_LINEA_0_CM 1 0. 0. 65535. DISPLAY_IDENTIFIER fm_dyn_eprm[4].Stx_ffm_did_X_dyn[4] ECU_ADDRESS 0xd0005a20 FORMAT "%5.0" /end MEASUREMENT
/begin MEASUREMENT Sxx_ffm_did_1_max_dyn_4 "" UWORD _CNV_A_R_ECME_LINEA_0_CM 1 0. 0. 65535. DISPLAY_IDENTIFIER fm_dyn_eprm[4].Stx_ffm_did_X_max_dyn[0] ECU_ADDRESS 0xd0005a24 FORMAT "%5.0" /end MEASUREMENT
/begin MEASUREMENT Sxx_ffm_did_2_max_dyn_4 "" UWORD _CNV_A_R_ECME_LINEA_0_CM 1 0. 0. 65535. DISPLAY_IDENTIFIER fm_dyn_eprm[4].Stx_ffm_did_X_max_dyn[1] ECU_ADDRESS 0xd0005a26 FORMAT "%5.0" /end MEASUREMENT
/begin MEASUREMENT Sxx_ffm_did_3_max_dyn_4 "" UWORD _CNV_A_R_ECME_LINEA_0_CM 1 0. 0. 65535. DISPLAY_IDENTIFIER fm_dyn_eprm[4].Stx_ffm_did_X_max_dyn[2] ECU_ADDRESS 0xd0005a28 FORMAT "%5.0" /end MEASUREMENT
/begin MEASUREMENT Sxx_ffm_did_4_max_dyn_4 "" UWORD _CNV_A_R_ECME_LINEA_0_CM 1 0. 0. 65535. DISPLAY_IDENTIFIER fm_dyn_eprm[4].Stx_ffm_did_X_max_dyn[3] ECU_ADDRESS 0xd0005a2a FORMAT "%5.0" /end MEASUREMENT
/begin MEASUREMENT Sxx_ffm_did_5_max_dyn_4 "" UWORD _CNV_A_R_ECME_LINEA_0_CM 1 0. 0. 65535. DISPLAY_IDENTIFIER fm_dyn_eprm[4].Stx_ffm_did_X_max_dyn[4] ECU_ADDRESS 0xd0005a2c FORMAT "%5.0" /end MEASUREMENT
/begin MEASUREMENT Sxx_ffm_did_1_min_dyn_4 "" UWORD _CNV_A_R_ECME_LINEA_0_CM 1 0. 0. 65535. DISPLAY_IDENTIFIER fm_dyn_eprm[4].Stx_ffm_did_X_min_dyn[0] ECU_ADDRESS 0xd0005a30 FORMAT "%5.0" /end MEASUREMENT
/begin MEASUREMENT Sxx_ffm_did_2_min_dyn_4 "" UWORD _CNV_A_R_ECME_LINEA_0_CM 1 0. 0. 65535. DISPLAY_IDENTIFIER fm_dyn_eprm[4].Stx_ffm_did_X_min_dyn[1] ECU_ADDRESS 0xd0005a32 FORMAT "%5.0" /end MEASUREMENT
/begin MEASUREMENT Sxx_ffm_did_3_min_dyn_4 "" UWORD _CNV_A_R_ECME_LINEA_0_CM 1 0. 0. 65535. DISPLAY_IDENTIFIER fm_dyn_eprm[4].Stx_ffm_did_X_min_dyn[2] ECU_ADDRESS 0xd0005a34 FORMAT "%5.0" /end MEASUREMENT
/begin MEASUREMENT Sxx_ffm_did_4_min_dyn_4 "" UWORD _CNV_A_R_ECME_LINEA_0_CM 1 0. 0. 65535. DISPLAY_IDENTIFIER fm_dyn_eprm[4].Stx_ffm_did_X_min_dyn[3] ECU_ADDRESS 0xd0005a36 FORMAT "%5.0" /end MEASUREMENT
/begin MEASUREMENT Sxx_ffm_did_5_min_dyn_4 "" UWORD _CNV_A_R_ECME_LINEA_0_CM 1 0. 0. 65535. DISPLAY_IDENTIFIER fm_dyn_eprm[4].Stx_ffm_did_X_min_dyn[4] ECU_ADDRESS 0xd0005a38 FORMAT "%5.0" /end MEASUREMENT
/begin MEASUREMENT Sxx_obd_sc_n_dyn_4 "" UWORD _CNV_A_R_ENSD_LINEA_22_CM 1 0. 0. 16383.75 DISPLAY_IDENTIFIER fm_dyn_eprm[4].Stx_obd_sc_n_dyn ECU_ADDRESS 0xd0005a3a FORMAT "%8.2" /end MEASUREMENT
/begin MEASUREMENT Sbx_pfo_dyn_4 "" UBYTE _CNV_A_R_A_105_CM 1 0. 0. 255. DISPLAY_IDENTIFIER fm_dyn_eprm[4].fm_dynamic_eprm_bitfield.Stx_pfo_dyn ECU_ADDRESS 0xd0005a3c BIT_MASK 0x2 /end MEASUREMENT
/begin MEASUREMENT Sbx_mfo_dyn_4 "" UBYTE _CNV_A_R_A_105_CM 1 0. 0. 255. DISPLAY_IDENTIFIER fm_dyn_eprm[4].fm_dynamic_eprm_bitfield.Stx_mfo_dyn ECU_ADDRESS 0xd0005a3c BIT_MASK 0x4 /end MEASUREMENT
/begin MEASUREMENT Sbx_obd_mreq_dyn_4 "" UBYTE _CNV_A_R_A_105_CM 1 0. 0. 255. DISPLAY_IDENTIFIER fm_dyn_eprm[4].fm_dynamic_eprm_bitfield.Stx_obd_mreq_dyn ECU_ADDRESS 0xd0005a3c BIT_MASK 0x8 /end MEASUREMENT
/begin MEASUREMENT Sbx_obd_dc_rdn_dyn_4 "" UBYTE _CNV_A_R_A_105_CM 1 0. 0. 255. DISPLAY_IDENTIFIER fm_dyn_eprm[4].fm_dynamic_eprm_bitfield.Stx_obd_dc_rdn_dyn ECU_ADDRESS 0xd0005a3c BIT_MASK 0x10 /end MEASUREMENT
/begin MEASUREMENT Sbx_fail_dc_dyn_4 "" UBYTE _CNV_A_R_A_105_CM 1 0. 0. 255. DISPLAY_IDENTIFIER fm_dyn_eprm[4].fm_dynamic_eprm_bitfield.Stx_fail_dc_dyn ECU_ADDRESS 0xd0005a3c BIT_MASK 0x20 /end MEASUREMENT
/begin MEASUREMENT Sbx_obd_sc_pass_dyn_4 "" UBYTE _CNV_A_R_A_105_CM 1 0. 0. 255. DISPLAY_IDENTIFIER fm_dyn_eprm[4].fm_dynamic_eprm_bitfield.Stx_obd_sc_pass_dyn ECU_ADDRESS 0xd0005a3c BIT_MASK 0x40 /end MEASUREMENT
/begin MEASUREMENT Sbx_obd_sc_wup_stt_dyn_4 "" UBYTE _CNV_A_R_A_105_CM 1 0. 0. 255. DISPLAY_IDENTIFIER fm_dyn_eprm[4].fm_dynamic_eprm_bitfield.Stx_obd_sc_wup_stt_dyn ECU_ADDRESS 0xd0005a3c BIT_MASK 0x80 /end MEASUREMENT
/begin MEASUREMENT Sxx_obd_wctr_dyn_4 "" UBYTE _CNV_A_R_ECME_LINEA_0_CM 1 0. 0. 255. DISPLAY_IDENTIFIER fm_dyn_eprm[4].Stx_obd_wctr_dyn ECU_ADDRESS 0xd0005a3d FORMAT "%3.0" /end MEASUREMENT
/begin MEASUREMENT Sxx_frq_dyn_4 "" UBYTE _CNV_A_R_ECME_LINEA_0_CM 1 0. 0. 255. DISPLAY_IDENTIFIER fm_dyn_eprm[4].Stx_frq_dyn ECU_ADDRESS 0xd0005a3e FORMAT "%3.0" /end MEASUREMENT
/begin MEASUREMENT Sxx_obd_clfctr_dyn_4 "" UBYTE _CNV_A_R_ECME_LINEA_0_CM 1 0. 0. 10. DISPLAY_IDENTIFIER fm_dyn_eprm[4].Stx_obd_clfctr_dyn ECU_ADDRESS 0xd0005a3f FORMAT "%3.0" /end MEASUREMENT
/begin MEASUREMENT Sxx_esd_siz_dyn_4 "" UBYTE _CNV_A_R_ECME_LINEA_0_CM 1 0. 0. 255. DISPLAY_IDENTIFIER fm_dyn_eprm[4].Stx_esd_siz_dyn ECU_ADDRESS 0xd0005a40 FORMAT "%3.0" /end MEASUREMENT
/begin MEASUREMENT Sxx_obd_sc_ctr_dyn_4 "" UBYTE _CNV_A_R_ECME_LINEA_0_CM 1 0. 0. 255. DISPLAY_IDENTIFIER fm_dyn_eprm[4].Stx_obd_sc_ctr_dyn ECU_ADDRESS 0xd0005a41 FORMAT "%3.0" /end MEASUREMENT
/begin MEASUREMENT Sxx_obd_sc_load_dyn_4 "" UBYTE _CNV_A_R_LINEAR_____165_CM 1 0. 0. 100. DISPLAY_IDENTIFIER fm_dyn_eprm[4].Stx_obd_sc_load_dyn ECU_ADDRESS 0xd0005a42 FORMAT "%12.8" /end MEASUREMENT
/begin MEASUREMENT Sxx_pri_dyn_4 "" UBYTE _CNV_A_R_ECME_LINEA_0_CM 1 0. 0. 5. DISPLAY_IDENTIFIER fm_dyn_eprm[4].Stx_pri_dyn ECU_ADDRESS 0xd0005a43 FORMAT "%3.0" /end MEASUREMENT
/begin MEASUREMENT Sxx_dist_fail_dyn_5 "" ULONG _CNV_A_R_LINEAR_____274_CM 1 0. 0. 16777215. DISPLAY_IDENTIFIER fm_dyn_eprm[5].Stx_dist_fail_dyn ECU_ADDRESS 0xd0005a44 FORMAT "%10.0" /end MEASUREMENT
/begin MEASUREMENT Sxx_tmp_dist_dyn_5 "" ULONG _CNV_A_R_LINEAR_____274_CM 1 0. 0. 16777215. DISPLAY_IDENTIFIER fm_dyn_eprm[5].Stx_tmp_dist_dyn ECU_ADDRESS 0xd0005a48 FORMAT "%10.0" /end MEASUREMENT
/begin MEASUREMENT Sxx_km_cf_dyn_5 "" ULONG _CNV_A_R_LINEAR_____274_CM 1 0. 0. 16777215. DISPLAY_IDENTIFIER fm_dyn_eprm[5].Stx_km_cf_dyn ECU_ADDRESS 0xd0005a4c FORMAT "%10.0" /end MEASUREMENT
/begin MEASUREMENT Sxx_km_mf_dyn_5 "" ULONG _CNV_A_R_LINEAR_____274_CM 1 0. 0. 16777215. DISPLAY_IDENTIFIER fm_dyn_eprm[5].Stx_km_mf_dyn ECU_ADDRESS 0xd0005a50 FORMAT "%10.0" /end MEASUREMENT
/begin MEASUREMENT Sxx_km_pass_dyn_5 "" ULONG _CNV_A_R_LINEAR_____274_CM 1 0. 0. 16777215. DISPLAY_IDENTIFIER fm_dyn_eprm[5].Stx_km_pass_dyn ECU_ADDRESS 0xd0005a54 FORMAT "%10.0" /end MEASUREMENT
/begin MEASUREMENT Sxx_ind_dyn_5 "" UWORD _CNV_A_R_ECME_LINEA_0_CM 1 0. 0. 65535. DISPLAY_IDENTIFIER fm_dyn_eprm[5].Stx_ind_dyn ECU_ADDRESS 0xd0005a58 FORMAT "%5.0" /end MEASUREMENT
/begin MEASUREMENT Sxx_ffm_esti_tqe_dyn_5 "" UWORD _CNV_A_R_LINEAR_____216_CM 1 0. -400. 1647.96875 DISPLAY_IDENTIFIER fm_dyn_eprm[5].Stx_ffm_esti_tqe_dyn ECU_ADDRESS 0xd0005a5a FORMAT "%10.5" /end MEASUREMENT
/begin MEASUREMENT Sxx_ffm_esti_tqe_min_dyn_5 "" UWORD _CNV_A_R_LINEAR_____216_CM 1 0. -400. 1647.96875 DISPLAY_IDENTIFIER fm_dyn_eprm[5].Stx_ffm_esti_tqe_min_dyn ECU_ADDRESS 0xd0005a5c FORMAT "%10.5" /end MEASUREMENT
/begin MEASUREMENT Sxx_ffm_esti_tqe_max_dyn_5 "" UWORD _CNV_A_R_LINEAR_____216_CM 1 0. -400. 1647.96875 DISPLAY_IDENTIFIER fm_dyn_eprm[5].Stx_ffm_esti_tqe_max_dyn ECU_ADDRESS 0xd0005a5e FORMAT "%10.5" /end MEASUREMENT
/begin MEASUREMENT Sxx_ffm_n_dyn_5 "" UWORD _CNV_A_R_ENSD_LINEA_22_CM 1 0. 0. 16383.75 DISPLAY_IDENTIFIER fm_dyn_eprm[5].Stx_ffm_n_dyn ECU_ADDRESS 0xd0005a60 FORMAT "%8.2" /end MEASUREMENT
/begin MEASUREMENT Sxx_ffm_n_min_dyn_5 "" UWORD _CNV_A_R_ENSD_LINEA_22_CM 1 0. 0. 16383.75 DISPLAY_IDENTIFIER fm_dyn_eprm[5].Stx_ffm_n_min_dyn ECU_ADDRESS 0xd0005a62 FORMAT "%8.2" /end MEASUREMENT
/begin MEASUREMENT Sxx_ffm_n_max_dyn_5 "" UWORD _CNV_A_R_ENSD_LINEA_22_CM 1 0. 0. 16383.75 DISPLAY_IDENTIFIER fm_dyn_eprm[5].Stx_ffm_n_max_dyn ECU_ADDRESS 0xd0005a64 FORMAT "%8.2" /end MEASUREMENT
/begin MEASUREMENT Sxx_ffm_tco_dyn_5 "" UWORD _CNV_A_R_LINEAR_____278_CM 1 0. -273. 6280.5 DISPLAY_IDENTIFIER fm_dyn_eprm[5].Stx_ffm_tco_dyn ECU_ADDRESS 0xd0005a66 FORMAT "%6.1" /end MEASUREMENT
/begin MEASUREMENT Sxx_ffm_tco_min_dyn_5 "" UWORD _CNV_A_R_LINEAR_____278_CM 1 0. -273. 6280.5 DISPLAY_IDENTIFIER fm_dyn_eprm[5].Stx_ffm_tco_min_dyn ECU_ADDRESS 0xd0005a68 FORMAT "%6.1" /end MEASUREMENT
/begin MEASUREMENT Sxx_ffm_tco_max_dyn_5 "" UWORD _CNV_A_R_LINEAR_____278_CM 1 0. -273. 6280.5 DISPLAY_IDENTIFIER fm_dyn_eprm[5].Stx_ffm_tco_max_dyn ECU_ADDRESS 0xd0005a6a FORMAT "%6.1" /end MEASUREMENT
/begin MEASUREMENT Sxx_ffm_vb_dyn_5 "" UWORD _CNV_A_R_LINEAR_____205_CM 1 0. 0. 655.35 DISPLAY_IDENTIFIER fm_dyn_eprm[5].Stx_ffm_vb_dyn ECU_ADDRESS 0xd0005a6c FORMAT "%6.2" /end MEASUREMENT
/begin MEASUREMENT Sxx_ffm_vb_min_dyn_5 "" UWORD _CNV_A_R_LINEAR_____205_CM 1 0. 0. 655.35 DISPLAY_IDENTIFIER fm_dyn_eprm[5].Stx_ffm_vb_min_dyn ECU_ADDRESS 0xd0005a6e FORMAT "%6.2" /end MEASUREMENT
/begin MEASUREMENT Sxx_ffm_vb_max_dyn_5 "" UWORD _CNV_A_R_LINEAR_____205_CM 1 0. 0. 655.35 DISPLAY_IDENTIFIER fm_dyn_eprm[5].Stx_ffm_vb_max_dyn ECU_ADDRESS 0xd0005a70 FORMAT "%6.2" /end MEASUREMENT
/begin MEASUREMENT Sxx_ffm_vs_dyn_5 "" UWORD _CNV_A_R_LINEAR_____125_CM 1 0. 0. 655.35 DISPLAY_IDENTIFIER fm_dyn_eprm[5].Stx_ffm_vs_dyn ECU_ADDRESS 0xd0005a72 FORMAT "%6.2" /end MEASUREMENT
/begin MEASUREMENT Sxx_ffm_vs_min_dyn_5 "" UWORD _CNV_A_R_LINEAR_____125_CM 1 0. 0. 655.35 DISPLAY_IDENTIFIER fm_dyn_eprm[5].Stx_ffm_vs_min_dyn ECU_ADDRESS 0xd0005a74 FORMAT "%6.2" /end MEASUREMENT
/begin MEASUREMENT Sxx_ffm_vs_max_dyn_5 "" UWORD _CNV_A_R_LINEAR_____125_CM 1 0. 0. 655.35 DISPLAY_IDENTIFIER fm_dyn_eprm[5].Stx_ffm_vs_max_dyn ECU_ADDRESS 0xd0005a76 FORMAT "%6.2" /end MEASUREMENT
/begin MEASUREMENT Sxx_ffm_did_1_dyn_5 "" UWORD _CNV_A_R_ECME_LINEA_0_CM 1 0. 0. 65535. DISPLAY_IDENTIFIER fm_dyn_eprm[5].Stx_ffm_did_X_dyn[0] ECU_ADDRESS 0xd0005a78 FORMAT "%5.0" /end MEASUREMENT
/begin MEASUREMENT Sxx_ffm_did_2_dyn_5 "" UWORD _CNV_A_R_ECME_LINEA_0_CM 1 0. 0. 65535. DISPLAY_IDENTIFIER fm_dyn_eprm[5].Stx_ffm_did_X_dyn[1] ECU_ADDRESS 0xd0005a7a FORMAT "%5.0" /end MEASUREMENT
/begin MEASUREMENT Sxx_ffm_did_3_dyn_5 "" UWORD _CNV_A_R_ECME_LINEA_0_CM 1 0. 0. 65535. DISPLAY_IDENTIFIER fm_dyn_eprm[5].Stx_ffm_did_X_dyn[2] ECU_ADDRESS 0xd0005a7c FORMAT "%5.0" /end MEASUREMENT
/begin MEASUREMENT Sxx_ffm_did_4_dyn_5 "" UWORD _CNV_A_R_ECME_LINEA_0_CM 1 0. 0. 65535. DISPLAY_IDENTIFIER fm_dyn_eprm[5].Stx_ffm_did_X_dyn[3] ECU_ADDRESS 0xd0005a7e FORMAT "%5.0" /end MEASUREMENT
/begin MEASUREMENT Sxx_ffm_did_5_dyn_5 "" UWORD _CNV_A_R_ECME_LINEA_0_CM 1 0. 0. 65535. DISPLAY_IDENTIFIER fm_dyn_eprm[5].Stx_ffm_did_X_dyn[4] ECU_ADDRESS 0xd0005a80 FORMAT "%5.0" /end MEASUREMENT
/begin MEASUREMENT Sxx_ffm_did_1_max_dyn_5 "" UWORD _CNV_A_R_ECME_LINEA_0_CM 1 0. 0. 65535. DISPLAY_IDENTIFIER fm_dyn_eprm[5].Stx_ffm_did_X_max_dyn[0] ECU_ADDRESS 0xd0005a84 FORMAT "%5.0" /end MEASUREMENT
/begin MEASUREMENT Sxx_ffm_did_2_max_dyn_5 "" UWORD _CNV_A_R_ECME_LINEA_0_CM 1 0. 0. 65535. DISPLAY_IDENTIFIER fm_dyn_eprm[5].Stx_ffm_did_X_max_dyn[1] ECU_ADDRESS 0xd0005a86 FORMAT "%5.0" /end MEASUREMENT
/begin MEASUREMENT Sxx_ffm_did_3_max_dyn_5 "" UWORD _CNV_A_R_ECME_LINEA_0_CM 1 0. 0. 65535. DISPLAY_IDENTIFIER fm_dyn_eprm[5].Stx_ffm_did_X_max_dyn[2] ECU_ADDRESS 0xd0005a88 FORMAT "%5.0" /end MEASUREMENT
/begin MEASUREMENT Sxx_ffm_did_4_max_dyn_5 "" UWORD _CNV_A_R_ECME_LINEA_0_CM 1 0. 0. 65535. DISPLAY_IDENTIFIER fm_dyn_eprm[5].Stx_ffm_did_X_max_dyn[3] ECU_ADDRESS 0xd0005a8a FORMAT "%5.0" /end MEASUREMENT
/begin MEASUREMENT Sxx_ffm_did_5_max_dyn_5 "" UWORD _CNV_A_R_ECME_LINEA_0_CM 1 0. 0. 65535. DISPLAY_IDENTIFIER fm_dyn_eprm[5].Stx_ffm_did_X_max_dyn[4] ECU_ADDRESS 0xd0005a8c FORMAT "%5.0" /end MEASUREMENT
/begin MEASUREMENT Sxx_ffm_did_1_min_dyn_5 "" UWORD _CNV_A_R_ECME_LINEA_0_CM 1 0. 0. 65535. DISPLAY_IDENTIFIER fm_dyn_eprm[5].Stx_ffm_did_X_min_dyn[0] ECU_ADDRESS 0xd0005a90 FORMAT "%5.0" /end MEASUREMENT
/begin MEASUREMENT Sxx_ffm_did_2_min_dyn_5 "" UWORD _CNV_A_R_ECME_LINEA_0_CM 1 0. 0. 65535. DISPLAY_IDENTIFIER fm_dyn_eprm[5].Stx_ffm_did_X_min_dyn[1] ECU_ADDRESS 0xd0005a92 FORMAT "%5.0" /end MEASUREMENT
/begin MEASUREMENT Sxx_ffm_did_3_min_dyn_5 "" UWORD _CNV_A_R_ECME_LINEA_0_CM 1 0. 0. 65535. DISPLAY_IDENTIFIER fm_dyn_eprm[5].Stx_ffm_did_X_min_dyn[2] ECU_ADDRESS 0xd0005a94 FORMAT "%5.0" /end MEASUREMENT
/begin MEASUREMENT Sxx_ffm_did_4_min_dyn_5 "" UWORD _CNV_A_R_ECME_LINEA_0_CM 1 0. 0. 65535. DISPLAY_IDENTIFIER fm_dyn_eprm[5].Stx_ffm_did_X_min_dyn[3] ECU_ADDRESS 0xd0005a96 FORMAT "%5.0" /end MEASUREMENT
/begin MEASUREMENT Sxx_ffm_did_5_min_dyn_5 "" UWORD _CNV_A_R_ECME_LINEA_0_CM 1 0. 0. 65535. DISPLAY_IDENTIFIER fm_dyn_eprm[5].Stx_ffm_did_X_min_dyn[4] ECU_ADDRESS 0xd0005a98 FORMAT "%5.0" /end MEASUREMENT
/begin MEASUREMENT Sxx_obd_sc_n_dyn_5 "" UWORD _CNV_A_R_ENSD_LINEA_22_CM 1 0. 0. 16383.75 DISPLAY_IDENTIFIER fm_dyn_eprm[5].Stx_obd_sc_n_dyn ECU_ADDRESS 0xd0005a9a FORMAT "%8.2" /end MEASUREMENT
/begin MEASUREMENT Sbx_pfo_dyn_5 "" UBYTE _CNV_A_R_A_105_CM 1 0. 0. 255. DISPLAY_IDENTIFIER fm_dyn_eprm[5].fm_dynamic_eprm_bitfield.Stx_pfo_dyn ECU_ADDRESS 0xd0005a9c BIT_MASK 0x2 /end MEASUREMENT
/begin MEASUREMENT Sbx_mfo_dyn_5 "" UBYTE _CNV_A_R_A_105_CM 1 0. 0. 255. DISPLAY_IDENTIFIER fm_dyn_eprm[5].fm_dynamic_eprm_bitfield.Stx_mfo_dyn ECU_ADDRESS 0xd0005a9c BIT_MASK 0x4 /end MEASUREMENT
/begin MEASUREMENT Sbx_obd_mreq_dyn_5 "" UBYTE _CNV_A_R_A_105_CM 1 0. 0. 255. DISPLAY_IDENTIFIER fm_dyn_eprm[5].fm_dynamic_eprm_bitfield.Stx_obd_mreq_dyn ECU_ADDRESS 0xd0005a9c BIT_MASK 0x8 /end MEASUREMENT
/begin MEASUREMENT Sbx_obd_dc_rdn_dyn_5 "" UBYTE _CNV_A_R_A_105_CM 1 0. 0. 255. DISPLAY_IDENTIFIER fm_dyn_eprm[5].fm_dynamic_eprm_bitfield.Stx_obd_dc_rdn_dyn ECU_ADDRESS 0xd0005a9c BIT_MASK 0x10 /end MEASUREMENT
/begin MEASUREMENT Sbx_fail_dc_dyn_5 "" UBYTE _CNV_A_R_A_105_CM 1 0. 0. 255. DISPLAY_IDENTIFIER fm_dyn_eprm[5].fm_dynamic_eprm_bitfield.Stx_fail_dc_dyn ECU_ADDRESS 0xd0005a9c BIT_MASK 0x20 /end MEASUREMENT
/begin MEASUREMENT Sbx_obd_sc_pass_dyn_5 "" UBYTE _CNV_A_R_A_105_CM 1 0. 0. 255. DISPLAY_IDENTIFIER fm_dyn_eprm[5].fm_dynamic_eprm_bitfield.Stx_obd_sc_pass_dyn ECU_ADDRESS 0xd0005a9c BIT_MASK 0x40 /end MEASUREMENT
/begin MEASUREMENT Sbx_obd_sc_wup_stt_dyn_5 "" UBYTE _CNV_A_R_A_105_CM 1 0. 0. 255. DISPLAY_IDENTIFIER fm_dyn_eprm[5].fm_dynamic_eprm_bitfield.Stx_obd_sc_wup_stt_dyn ECU_ADDRESS 0xd0005a9c BIT_MASK 0x80 /end MEASUREMENT
/begin MEASUREMENT Sxx_obd_wctr_dyn_5 "" UBYTE _CNV_A_R_ECME_LINEA_0_CM 1 0. 0. 255. DISPLAY_IDENTIFIER fm_dyn_eprm[5].Stx_obd_wctr_dyn ECU_ADDRESS 0xd0005a9d FORMAT "%3.0" /end MEASUREMENT
/begin MEASUREMENT Sxx_frq_dyn_5 "" UBYTE _CNV_A_R_ECME_LINEA_0_CM 1 0. 0. 255. DISPLAY_IDENTIFIER fm_dyn_eprm[5].Stx_frq_dyn ECU_ADDRESS 0xd0005a9e FORMAT "%3.0" /end MEASUREMENT
/begin MEASUREMENT Sxx_obd_clfctr_dyn_5 "" UBYTE _CNV_A_R_ECME_LINEA_0_CM 1 0. 0. 10. DISPLAY_IDENTIFIER fm_dyn_eprm[5].Stx_obd_clfctr_dyn ECU_ADDRESS 0xd0005a9f FORMAT "%3.0" /end MEASUREMENT
/begin MEASUREMENT Sxx_esd_siz_dyn_5 "" UBYTE _CNV_A_R_ECME_LINEA_0_CM 1 0. 0. 255. DISPLAY_IDENTIFIER fm_dyn_eprm[5].Stx_esd_siz_dyn ECU_ADDRESS 0xd0005aa0 FORMAT "%3.0" /end MEASUREMENT
/begin MEASUREMENT Sxx_obd_sc_ctr_dyn_5 "" UBYTE _CNV_A_R_ECME_LINEA_0_CM 1 0. 0. 255. DISPLAY_IDENTIFIER fm_dyn_eprm[5].Stx_obd_sc_ctr_dyn ECU_ADDRESS 0xd0005aa1 FORMAT "%3.0" /end MEASUREMENT
/begin MEASUREMENT Sxx_obd_sc_load_dyn_5 "" UBYTE _CNV_A_R_LINEAR_____165_CM 1 0. 0. 100. DISPLAY_IDENTIFIER fm_dyn_eprm[5].Stx_obd_sc_load_dyn ECU_ADDRESS 0xd0005aa2 FORMAT "%12.8" /end MEASUREMENT
/begin MEASUREMENT Sxx_pri_dyn_5 "" UBYTE _CNV_A_R_ECME_LINEA_0_CM 1 0. 0. 5. DISPLAY_IDENTIFIER fm_dyn_eprm[5].Stx_pri_dyn ECU_ADDRESS 0xd0005aa3 FORMAT "%3.0" /end MEASUREMENT
/begin MEASUREMENT Sxx_dist_fail_dyn_6 "" ULONG _CNV_A_R_LINEAR_____274_CM 1 0. 0. 16777215. DISPLAY_IDENTIFIER fm_dyn_eprm[6].Stx_dist_fail_dyn ECU_ADDRESS 0xd0005aa4 FORMAT "%10.0" /end MEASUREMENT
/begin MEASUREMENT Sxx_tmp_dist_dyn_6 "" ULONG _CNV_A_R_LINEAR_____274_CM 1 0. 0. 16777215. DISPLAY_IDENTIFIER fm_dyn_eprm[6].Stx_tmp_dist_dyn ECU_ADDRESS 0xd0005aa8 FORMAT "%10.0" /end MEASUREMENT
/begin MEASUREMENT Sxx_km_cf_dyn_6 "" ULONG _CNV_A_R_LINEAR_____274_CM 1 0. 0. 16777215. DISPLAY_IDENTIFIER fm_dyn_eprm[6].Stx_km_cf_dyn ECU_ADDRESS 0xd0005aac FORMAT "%10.0" /end MEASUREMENT
/begin MEASUREMENT Sxx_km_mf_dyn_6 "" ULONG _CNV_A_R_LINEAR_____274_CM 1 0. 0. 16777215. DISPLAY_IDENTIFIER fm_dyn_eprm[6].Stx_km_mf_dyn ECU_ADDRESS 0xd0005ab0 FORMAT "%10.0" /end MEASUREMENT
/begin MEASUREMENT Sxx_km_pass_dyn_6 "" ULONG _CNV_A_R_LINEAR_____274_CM 1 0. 0. 16777215. DISPLAY_IDENTIFIER fm_dyn_eprm[6].Stx_km_pass_dyn ECU_ADDRESS 0xd0005ab4 FORMAT "%10.0" /end MEASUREMENT
/begin MEASUREMENT Sxx_ind_dyn_6 "" UWORD _CNV_A_R_ECME_LINEA_0_CM 1 0. 0. 65535. DISPLAY_IDENTIFIER fm_dyn_eprm[6].Stx_ind_dyn ECU_ADDRESS 0xd0005ab8 FORMAT "%5.0" /end MEASUREMENT
/begin MEASUREMENT Sxx_ffm_esti_tqe_dyn_6 "" UWORD _CNV_A_R_LINEAR_____216_CM 1 0. -400. 1647.96875 DISPLAY_IDENTIFIER fm_dyn_eprm[6].Stx_ffm_esti_tqe_dyn ECU_ADDRESS 0xd0005aba FORMAT "%10.5" /end MEASUREMENT
/begin MEASUREMENT Sxx_ffm_esti_tqe_min_dyn_6 "" UWORD _CNV_A_R_LINEAR_____216_CM 1 0. -400. 1647.96875 DISPLAY_IDENTIFIER fm_dyn_eprm[6].Stx_ffm_esti_tqe_min_dyn ECU_ADDRESS 0xd0005abc FORMAT "%10.5" /end MEASUREMENT
/begin MEASUREMENT Sxx_ffm_esti_tqe_max_dyn_6 "" UWORD _CNV_A_R_LINEAR_____216_CM 1 0. -400. 1647.96875 DISPLAY_IDENTIFIER fm_dyn_eprm[6].Stx_ffm_esti_tqe_max_dyn ECU_ADDRESS 0xd0005abe FORMAT "%10.5" /end MEASUREMENT
/begin MEASUREMENT Sxx_ffm_n_dyn_6 "" UWORD _CNV_A_R_ENSD_LINEA_22_CM 1 0. 0. 16383.75 DISPLAY_IDENTIFIER fm_dyn_eprm[6].Stx_ffm_n_dyn ECU_ADDRESS 0xd0005ac0 FORMAT "%8.2" /end MEASUREMENT
/begin MEASUREMENT Sxx_ffm_n_min_dyn_6 "" UWORD _CNV_A_R_ENSD_LINEA_22_CM 1 0. 0. 16383.75 DISPLAY_IDENTIFIER fm_dyn_eprm[6].Stx_ffm_n_min_dyn ECU_ADDRESS 0xd0005ac2 FORMAT "%8.2" /end MEASUREMENT
/begin MEASUREMENT Sxx_ffm_n_max_dyn_6 "" UWORD _CNV_A_R_ENSD_LINEA_22_CM 1 0. 0. 16383.75 DISPLAY_IDENTIFIER fm_dyn_eprm[6].Stx_ffm_n_max_dyn ECU_ADDRESS 0xd0005ac4 FORMAT "%8.2" /end MEASUREMENT
/begin MEASUREMENT Sxx_ffm_tco_dyn_6 "" UWORD _CNV_A_R_LINEAR_____278_CM 1 0. -273. 6280.5 DISPLAY_IDENTIFIER fm_dyn_eprm[6].Stx_ffm_tco_dyn ECU_ADDRESS 0xd0005ac6 FORMAT "%6.1" /end MEASUREMENT
/begin MEASUREMENT Sxx_ffm_tco_min_dyn_6 "" UWORD _CNV_A_R_LINEAR_____278_CM 1 0. -273. 6280.5 DISPLAY_IDENTIFIER fm_dyn_eprm[6].Stx_ffm_tco_min_dyn ECU_ADDRESS 0xd0005ac8 FORMAT "%6.1" /end MEASUREMENT
/begin MEASUREMENT Sxx_ffm_tco_max_dyn_6 "" UWORD _CNV_A_R_LINEAR_____278_CM 1 0. -273. 6280.5 DISPLAY_IDENTIFIER fm_dyn_eprm[6].Stx_ffm_tco_max_dyn ECU_ADDRESS 0xd0005aca FORMAT "%6.1" /end MEASUREMENT
/begin MEASUREMENT Sxx_ffm_vb_dyn_6 "" UWORD _CNV_A_R_LINEAR_____205_CM 1 0. 0. 655.35 DISPLAY_IDENTIFIER fm_dyn_eprm[6].Stx_ffm_vb_dyn ECU_ADDRESS 0xd0005acc FORMAT "%6.2" /end MEASUREMENT
/begin MEASUREMENT Sxx_ffm_vb_min_dyn_6 "" UWORD _CNV_A_R_LINEAR_____205_CM 1 0. 0. 655.35 DISPLAY_IDENTIFIER fm_dyn_eprm[6].Stx_ffm_vb_min_dyn ECU_ADDRESS 0xd0005ace FORMAT "%6.2" /end MEASUREMENT
/begin MEASUREMENT Sxx_ffm_vb_max_dyn_6 "" UWORD _CNV_A_R_LINEAR_____205_CM 1 0. 0. 655.35 DISPLAY_IDENTIFIER fm_dyn_eprm[6].Stx_ffm_vb_max_dyn ECU_ADDRESS 0xd0005ad0 FORMAT "%6.2" /end MEASUREMENT
/begin MEASUREMENT Sxx_ffm_vs_dyn_6 "" UWORD _CNV_A_R_LINEAR_____125_CM 1 0. 0. 655.35 DISPLAY_IDENTIFIER fm_dyn_eprm[6].Stx_ffm_vs_dyn ECU_ADDRESS 0xd0005ad2 FORMAT "%6.2" /end MEASUREMENT
/begin MEASUREMENT Sxx_ffm_vs_min_dyn_6 "" UWORD _CNV_A_R_LINEAR_____125_CM 1 0. 0. 655.35 DISPLAY_IDENTIFIER fm_dyn_eprm[6].Stx_ffm_vs_min_dyn ECU_ADDRESS 0xd0005ad4 FORMAT "%6.2" /end MEASUREMENT
/begin MEASUREMENT Sxx_ffm_vs_max_dyn_6 "" UWORD _CNV_A_R_LINEAR_____125_CM 1 0. 0. 655.35 DISPLAY_IDENTIFIER fm_dyn_eprm[6].Stx_ffm_vs_max_dyn ECU_ADDRESS 0xd0005ad6 FORMAT "%6.2" /end MEASUREMENT
/begin MEASUREMENT Sxx_ffm_did_1_dyn_6 "" UWORD _CNV_A_R_ECME_LINEA_0_CM 1 0. 0. 65535. DISPLAY_IDENTIFIER fm_dyn_eprm[6].Stx_ffm_did_X_dyn[0] ECU_ADDRESS 0xd0005ad8 FORMAT "%5.0" /end MEASUREMENT
/begin MEASUREMENT Sxx_ffm_did_2_dyn_6 "" UWORD _CNV_A_R_ECME_LINEA_0_CM 1 0. 0. 65535. DISPLAY_IDENTIFIER fm_dyn_eprm[6].Stx_ffm_did_X_dyn[1] ECU_ADDRESS 0xd0005ada FORMAT "%5.0" /end MEASUREMENT
/begin MEASUREMENT Sxx_ffm_did_3_dyn_6 "" UWORD _CNV_A_R_ECME_LINEA_0_CM 1 0. 0. 65535. DISPLAY_IDENTIFIER fm_dyn_eprm[6].Stx_ffm_did_X_dyn[2] ECU_ADDRESS 0xd0005adc FORMAT "%5.0" /end MEASUREMENT
/begin MEASUREMENT Sxx_ffm_did_4_dyn_6 "" UWORD _CNV_A_R_ECME_LINEA_0_CM 1 0. 0. 65535. DISPLAY_IDENTIFIER fm_dyn_eprm[6].Stx_ffm_did_X_dyn[3] ECU_ADDRESS 0xd0005ade FORMAT "%5.0" /end MEASUREMENT
/begin MEASUREMENT Sxx_ffm_did_5_dyn_6 "" UWORD _CNV_A_R_ECME_LINEA_0_CM 1 0. 0. 65535. DISPLAY_IDENTIFIER fm_dyn_eprm[6].Stx_ffm_did_X_dyn[4] ECU_ADDRESS 0xd0005ae0 FORMAT "%5.0" /end MEASUREMENT
/begin MEASUREMENT Sxx_ffm_did_1_max_dyn_6 "" UWORD _CNV_A_R_ECME_LINEA_0_CM 1 0. 0. 65535. DISPLAY_IDENTIFIER fm_dyn_eprm[6].Stx_ffm_did_X_max_dyn[0] ECU_ADDRESS 0xd0005ae4 FORMAT "%5.0" /end MEASUREMENT
/begin MEASUREMENT Sxx_ffm_did_2_max_dyn_6 "" UWORD _CNV_A_R_ECME_LINEA_0_CM 1 0. 0. 65535. DISPLAY_IDENTIFIER fm_dyn_eprm[6].Stx_ffm_did_X_max_dyn[1] ECU_ADDRESS 0xd0005ae6 FORMAT "%5.0" /end MEASUREMENT
/begin MEASUREMENT Sxx_ffm_did_3_max_dyn_6 "" UWORD _CNV_A_R_ECME_LINEA_0_CM 1 0. 0. 65535. DISPLAY_IDENTIFIER fm_dyn_eprm[6].Stx_ffm_did_X_max_dyn[2] ECU_ADDRESS 0xd0005ae8 FORMAT "%5.0" /end MEASUREMENT
/begin MEASUREMENT Sxx_ffm_did_4_max_dyn_6 "" UWORD _CNV_A_R_ECME_LINEA_0_CM 1 0. 0. 65535. DISPLAY_IDENTIFIER fm_dyn_eprm[6].Stx_ffm_did_X_max_dyn[3] ECU_ADDRESS 0xd0005aea FORMAT "%5.0" /end MEASUREMENT
/begin MEASUREMENT Sxx_ffm_did_5_max_dyn_6 "" UWORD _CNV_A_R_ECME_LINEA_0_CM 1 0. 0. 65535. DISPLAY_IDENTIFIER fm_dyn_eprm[6].Stx_ffm_did_X_max_dyn[4] ECU_ADDRESS 0xd0005aec FORMAT "%5.0" /end MEASUREMENT
/begin MEASUREMENT Sxx_ffm_did_1_min_dyn_6 "" UWORD _CNV_A_R_ECME_LINEA_0_CM 1 0. 0. 65535. DISPLAY_IDENTIFIER fm_dyn_eprm[6].Stx_ffm_did_X_min_dyn[0] ECU_ADDRESS 0xd0005af0 FORMAT "%5.0" /end MEASUREMENT
/begin MEASUREMENT Sxx_ffm_did_2_min_dyn_6 "" UWORD _CNV_A_R_ECME_LINEA_0_CM 1 0. 0. 65535. DISPLAY_IDENTIFIER fm_dyn_eprm[6].Stx_ffm_did_X_min_dyn[1] ECU_ADDRESS 0xd0005af2 FORMAT "%5.0" /end MEASUREMENT
/begin MEASUREMENT Sxx_ffm_did_3_min_dyn_6 "" UWORD _CNV_A_R_ECME_LINEA_0_CM 1 0. 0. 65535. DISPLAY_IDENTIFIER fm_dyn_eprm[6].Stx_ffm_did_X_min_dyn[2] ECU_ADDRESS 0xd0005af4 FORMAT "%5.0" /end MEASUREMENT
/begin MEASUREMENT Sxx_ffm_did_4_min_dyn_6 "" UWORD _CNV_A_R_ECME_LINEA_0_CM 1 0. 0. 65535. DISPLAY_IDENTIFIER fm_dyn_eprm[6].Stx_ffm_did_X_min_dyn[3] ECU_ADDRESS 0xd0005af6 FORMAT "%5.0" /end MEASUREMENT
/begin MEASUREMENT Sxx_ffm_did_5_min_dyn_6 "" UWORD _CNV_A_R_ECME_LINEA_0_CM 1 0. 0. 65535. DISPLAY_IDENTIFIER fm_dyn_eprm[6].Stx_ffm_did_X_min_dyn[4] ECU_ADDRESS 0xd0005af8 FORMAT "%5.0" /end MEASUREMENT
/begin MEASUREMENT Sxx_obd_sc_n_dyn_6 "" UWORD _CNV_A_R_ENSD_LINEA_22_CM 1 0. 0. 16383.75 DISPLAY_IDENTIFIER fm_dyn_eprm[6].Stx_obd_sc_n_dyn ECU_ADDRESS 0xd0005afa FORMAT "%8.2" /end MEASUREMENT
/begin MEASUREMENT Sbx_pfo_dyn_6 "" UBYTE _CNV_A_R_A_105_CM 1 0. 0. 255. DISPLAY_IDENTIFIER fm_dyn_eprm[6].fm_dynamic_eprm_bitfield.Stx_pfo_dyn ECU_ADDRESS 0xd0005afc BIT_MASK 0x2 /end MEASUREMENT
/begin MEASUREMENT Sbx_mfo_dyn_6 "" UBYTE _CNV_A_R_A_105_CM 1 0. 0. 255. DISPLAY_IDENTIFIER fm_dyn_eprm[6].fm_dynamic_eprm_bitfield.Stx_mfo_dyn ECU_ADDRESS 0xd0005afc BIT_MASK 0x4 /end MEASUREMENT
/begin MEASUREMENT Sbx_obd_mreq_dyn_6 "" UBYTE _CNV_A_R_A_105_CM 1 0. 0. 255. DISPLAY_IDENTIFIER fm_dyn_eprm[6].fm_dynamic_eprm_bitfield.Stx_obd_mreq_dyn ECU_ADDRESS 0xd0005afc BIT_MASK 0x8 /end MEASUREMENT
/begin MEASUREMENT Sbx_obd_dc_rdn_dyn_6 "" UBYTE _CNV_A_R_A_105_CM 1 0. 0. 255. DISPLAY_IDENTIFIER fm_dyn_eprm[6].fm_dynamic_eprm_bitfield.Stx_obd_dc_rdn_dyn ECU_ADDRESS 0xd0005afc BIT_MASK 0x10 /end MEASUREMENT
/begin MEASUREMENT Sbx_fail_dc_dyn_6 "" UBYTE _CNV_A_R_A_105_CM 1 0. 0. 255. DISPLAY_IDENTIFIER fm_dyn_eprm[6].fm_dynamic_eprm_bitfield.Stx_fail_dc_dyn ECU_ADDRESS 0xd0005afc BIT_MASK 0x20 /end MEASUREMENT
/begin MEASUREMENT Sbx_obd_sc_pass_dyn_6 "" UBYTE _CNV_A_R_A_105_CM 1 0. 0. 255. DISPLAY_IDENTIFIER fm_dyn_eprm[6].fm_dynamic_eprm_bitfield.Stx_obd_sc_pass_dyn ECU_ADDRESS 0xd0005afc BIT_MASK 0x40 /end MEASUREMENT
/begin MEASUREMENT Sbx_obd_sc_wup_stt_dyn_6 "" UBYTE _CNV_A_R_A_105_CM 1 0. 0. 255. DISPLAY_IDENTIFIER fm_dyn_eprm[6].fm_dynamic_eprm_bitfield.Stx_obd_sc_wup_stt_dyn ECU_ADDRESS 0xd0005afc BIT_MASK 0x80 /end MEASUREMENT
/begin MEASUREMENT Sxx_obd_wctr_dyn_6 "" UBYTE _CNV_A_R_ECME_LINEA_0_CM 1 0. 0. 255. DISPLAY_IDENTIFIER fm_dyn_eprm[6].Stx_obd_wctr_dyn ECU_ADDRESS 0xd0005afd FORMAT "%3.0" /end MEASUREMENT
/begin MEASUREMENT Sxx_frq_dyn_6 "" UBYTE _CNV_A_R_ECME_LINEA_0_CM 1 0. 0. 255. DISPLAY_IDENTIFIER fm_dyn_eprm[6].Stx_frq_dyn ECU_ADDRESS 0xd0005afe FORMAT "%3.0" /end MEASUREMENT
/begin MEASUREMENT Sxx_obd_clfctr_dyn_6 "" UBYTE _CNV_A_R_ECME_LINEA_0_CM 1 0. 0. 10. DISPLAY_IDENTIFIER fm_dyn_eprm[6].Stx_obd_clfctr_dyn ECU_ADDRESS 0xd0005aff FORMAT "%3.0" /end MEASUREMENT
/begin MEASUREMENT Sxx_esd_siz_dyn_6 "" UBYTE _CNV_A_R_ECME_LINEA_0_CM 1 0. 0. 255. DISPLAY_IDENTIFIER fm_dyn_eprm[6].Stx_esd_siz_dyn ECU_ADDRESS 0xd0005b00 FORMAT "%3.0" /end MEASUREMENT
/begin MEASUREMENT Sxx_obd_sc_ctr_dyn_6 "" UBYTE _CNV_A_R_ECME_LINEA_0_CM 1 0. 0. 255. DISPLAY_IDENTIFIER fm_dyn_eprm[6].Stx_obd_sc_ctr_dyn ECU_ADDRESS 0xd0005b01 FORMAT "%3.0" /end MEASUREMENT
/begin MEASUREMENT Sxx_obd_sc_load_dyn_6 "" UBYTE _CNV_A_R_LINEAR_____165_CM 1 0. 0. 100. DISPLAY_IDENTIFIER fm_dyn_eprm[6].Stx_obd_sc_load_dyn ECU_ADDRESS 0xd0005b02 FORMAT "%12.8" /end MEASUREMENT
/begin MEASUREMENT Sxx_pri_dyn_6 "" UBYTE _CNV_A_R_ECME_LINEA_0_CM 1 0. 0. 5. DISPLAY_IDENTIFIER fm_dyn_eprm[6].Stx_pri_dyn ECU_ADDRESS 0xd0005b03 FORMAT "%3.0" /end MEASUREMENT
/begin MEASUREMENT Sxx_dist_fail_dyn_7 "" ULONG _CNV_A_R_LINEAR_____274_CM 1 0. 0. 16777215. DISPLAY_IDENTIFIER fm_dyn_eprm[7].Stx_dist_fail_dyn ECU_ADDRESS 0xd0005b04 FORMAT "%10.0" /end MEASUREMENT
/begin MEASUREMENT Sxx_tmp_dist_dyn_7 "" ULONG _CNV_A_R_LINEAR_____274_CM 1 0. 0. 16777215. DISPLAY_IDENTIFIER fm_dyn_eprm[7].Stx_tmp_dist_dyn ECU_ADDRESS 0xd0005b08 FORMAT "%10.0" /end MEASUREMENT
/begin MEASUREMENT Sxx_km_cf_dyn_7 "" ULONG _CNV_A_R_LINEAR_____274_CM 1 0. 0. 16777215. DISPLAY_IDENTIFIER fm_dyn_eprm[7].Stx_km_cf_dyn ECU_ADDRESS 0xd0005b0c FORMAT "%10.0" /end MEASUREMENT
/begin MEASUREMENT Sxx_km_mf_dyn_7 "" ULONG _CNV_A_R_LINEAR_____274_CM 1 0. 0. 16777215. DISPLAY_IDENTIFIER fm_dyn_eprm[7].Stx_km_mf_dyn ECU_ADDRESS 0xd0005b10 FORMAT "%10.0" /end MEASUREMENT
/begin MEASUREMENT Sxx_km_pass_dyn_7 "" ULONG _CNV_A_R_LINEAR_____274_CM 1 0. 0. 16777215. DISPLAY_IDENTIFIER fm_dyn_eprm[7].Stx_km_pass_dyn ECU_ADDRESS 0xd0005b14 FORMAT "%10.0" /end MEASUREMENT
/begin MEASUREMENT Sxx_ind_dyn_7 "" UWORD _CNV_A_R_ECME_LINEA_0_CM 1 0. 0. 65535. DISPLAY_IDENTIFIER fm_dyn_eprm[7].Stx_ind_dyn ECU_ADDRESS 0xd0005b18 FORMAT "%5.0" /end MEASUREMENT
/begin MEASUREMENT Sxx_ffm_esti_tqe_dyn_7 "" UWORD _CNV_A_R_LINEAR_____216_CM 1 0. -400. 1647.96875 DISPLAY_IDENTIFIER fm_dyn_eprm[7].Stx_ffm_esti_tqe_dyn ECU_ADDRESS 0xd0005b1a FORMAT "%10.5" /end MEASUREMENT
/begin MEASUREMENT Sxx_ffm_esti_tqe_min_dyn_7 "" UWORD _CNV_A_R_LINEAR_____216_CM 1 0. -400. 1647.96875 DISPLAY_IDENTIFIER fm_dyn_eprm[7].Stx_ffm_esti_tqe_min_dyn ECU_ADDRESS 0xd0005b1c FORMAT "%10.5" /end MEASUREMENT
/begin MEASUREMENT Sxx_ffm_esti_tqe_max_dyn_7 "" UWORD _CNV_A_R_LINEAR_____216_CM 1 0. -400. 1647.96875 DISPLAY_IDENTIFIER fm_dyn_eprm[7].Stx_ffm_esti_tqe_max_dyn ECU_ADDRESS 0xd0005b1e FORMAT "%10.5" /end MEASUREMENT
/begin MEASUREMENT Sxx_ffm_n_dyn_7 "" UWORD _CNV_A_R_ENSD_LINEA_22_CM 1 0. 0. 16383.75 DISPLAY_IDENTIFIER fm_dyn_eprm[7].Stx_ffm_n_dyn ECU_ADDRESS 0xd0005b20 FORMAT "%8.2" /end MEASUREMENT
/begin MEASUREMENT Sxx_ffm_n_min_dyn_7 "" UWORD _CNV_A_R_ENSD_LINEA_22_CM 1 0. 0. 16383.75 DISPLAY_IDENTIFIER fm_dyn_eprm[7].Stx_ffm_n_min_dyn ECU_ADDRESS 0xd0005b22 FORMAT "%8.2" /end MEASUREMENT
/begin MEASUREMENT Sxx_ffm_n_max_dyn_7 "" UWORD _CNV_A_R_ENSD_LINEA_22_CM 1 0. 0. 16383.75 DISPLAY_IDENTIFIER fm_dyn_eprm[7].Stx_ffm_n_max_dyn ECU_ADDRESS 0xd0005b24 FORMAT "%8.2" /end MEASUREMENT
/begin MEASUREMENT Sxx_ffm_tco_dyn_7 "" UWORD _CNV_A_R_LINEAR_____278_CM 1 0. -273. 6280.5 DISPLAY_IDENTIFIER fm_dyn_eprm[7].Stx_ffm_tco_dyn ECU_ADDRESS 0xd0005b26 FORMAT "%6.1" /end MEASUREMENT
/begin MEASUREMENT Sxx_ffm_tco_min_dyn_7 "" UWORD _CNV_A_R_LINEAR_____278_CM 1 0. -273. 6280.5 DISPLAY_IDENTIFIER fm_dyn_eprm[7].Stx_ffm_tco_min_dyn ECU_ADDRESS 0xd0005b28 FORMAT "%6.1" /end MEASUREMENT
/begin MEASUREMENT Sxx_ffm_tco_max_dyn_7 "" UWORD _CNV_A_R_LINEAR_____278_CM 1 0. -273. 6280.5 DISPLAY_IDENTIFIER fm_dyn_eprm[7].Stx_ffm_tco_max_dyn ECU_ADDRESS 0xd0005b2a FORMAT "%6.1" /end MEASUREMENT
/begin MEASUREMENT Sxx_ffm_vb_dyn_7 "" UWORD _CNV_A_R_LINEAR_____205_CM 1 0. 0. 655.35 DISPLAY_IDENTIFIER fm_dyn_eprm[7].Stx_ffm_vb_dyn ECU_ADDRESS 0xd0005b2c FORMAT "%6.2" /end MEASUREMENT
/begin MEASUREMENT Sxx_ffm_vb_min_dyn_7 "" UWORD _CNV_A_R_LINEAR_____205_CM 1 0. 0. 655.35 DISPLAY_IDENTIFIER fm_dyn_eprm[7].Stx_ffm_vb_min_dyn ECU_ADDRESS 0xd0005b2e FORMAT "%6.2" /end MEASUREMENT
/begin MEASUREMENT Sxx_ffm_vb_max_dyn_7 "" UWORD _CNV_A_R_LINEAR_____205_CM 1 0. 0. 655.35 DISPLAY_IDENTIFIER fm_dyn_eprm[7].Stx_ffm_vb_max_dyn ECU_ADDRESS 0xd0005b30 FORMAT "%6.2" /end MEASUREMENT
/begin MEASUREMENT Sxx_ffm_vs_dyn_7 "" UWORD _CNV_A_R_LINEAR_____125_CM 1 0. 0. 655.35 DISPLAY_IDENTIFIER fm_dyn_eprm[7].Stx_ffm_vs_dyn ECU_ADDRESS 0xd0005b32 FORMAT "%6.2" /end MEASUREMENT
/begin MEASUREMENT Sxx_ffm_vs_min_dyn_7 "" UWORD _CNV_A_R_LINEAR_____125_CM 1 0. 0. 655.35 DISPLAY_IDENTIFIER fm_dyn_eprm[7].Stx_ffm_vs_min_dyn ECU_ADDRESS 0xd0005b34 FORMAT "%6.2" /end MEASUREMENT
/begin MEASUREMENT Sxx_ffm_vs_max_dyn_7 "" UWORD _CNV_A_R_LINEAR_____125_CM 1 0. 0. 655.35 DISPLAY_IDENTIFIER fm_dyn_eprm[7].Stx_ffm_vs_max_dyn ECU_ADDRESS 0xd0005b36 FORMAT "%6.2" /end MEASUREMENT
/begin MEASUREMENT Sxx_ffm_did_1_dyn_7 "" UWORD _CNV_A_R_ECME_LINEA_0_CM 1 0. 0. 65535. DISPLAY_IDENTIFIER fm_dyn_eprm[7].Stx_ffm_did_X_dyn[0] ECU_ADDRESS 0xd0005b38 FORMAT "%5.0" /end MEASUREMENT
/begin MEASUREMENT Sxx_ffm_did_2_dyn_7 "" UWORD _CNV_A_R_ECME_LINEA_0_CM 1 0. 0. 65535. DISPLAY_IDENTIFIER fm_dyn_eprm[7].Stx_ffm_did_X_dyn[1] ECU_ADDRESS 0xd0005b3a FORMAT "%5.0" /end MEASUREMENT
/begin MEASUREMENT Sxx_ffm_did_3_dyn_7 "" UWORD _CNV_A_R_ECME_LINEA_0_CM 1 0. 0. 65535. DISPLAY_IDENTIFIER fm_dyn_eprm[7].Stx_ffm_did_X_dyn[2] ECU_ADDRESS 0xd0005b3c FORMAT "%5.0" /end MEASUREMENT
/begin MEASUREMENT Sxx_ffm_did_4_dyn_7 "" UWORD _CNV_A_R_ECME_LINEA_0_CM 1 0. 0. 65535. DISPLAY_IDENTIFIER fm_dyn_eprm[7].Stx_ffm_did_X_dyn[3] ECU_ADDRESS 0xd0005b3e FORMAT "%5.0" /end MEASUREMENT
/begin MEASUREMENT Sxx_ffm_did_5_dyn_7 "" UWORD _CNV_A_R_ECME_LINEA_0_CM 1 0. 0. 65535. DISPLAY_IDENTIFIER fm_dyn_eprm[7].Stx_ffm_did_X_dyn[4] ECU_ADDRESS 0xd0005b40 FORMAT "%5.0" /end MEASUREMENT
/begin MEASUREMENT Sxx_ffm_did_1_max_dyn_7 "" UWORD _CNV_A_R_ECME_LINEA_0_CM 1 0. 0. 65535. DISPLAY_IDENTIFIER fm_dyn_eprm[7].Stx_ffm_did_X_max_dyn[0] ECU_ADDRESS 0xd0005b44 FORMAT "%5.0" /end MEASUREMENT
/begin MEASUREMENT Sxx_ffm_did_2_max_dyn_7 "" UWORD _CNV_A_R_ECME_LINEA_0_CM 1 0. 0. 65535. DISPLAY_IDENTIFIER fm_dyn_eprm[7].Stx_ffm_did_X_max_dyn[1] ECU_ADDRESS 0xd0005b46 FORMAT "%5.0" /end MEASUREMENT
/begin MEASUREMENT Sxx_ffm_did_3_max_dyn_7 "" UWORD _CNV_A_R_ECME_LINEA_0_CM 1 0. 0. 65535. DISPLAY_IDENTIFIER fm_dyn_eprm[7].Stx_ffm_did_X_max_dyn[2] ECU_ADDRESS 0xd0005b48 FORMAT "%5.0" /end MEASUREMENT
/begin MEASUREMENT Sxx_ffm_did_4_max_dyn_7 "" UWORD _CNV_A_R_ECME_LINEA_0_CM 1 0. 0. 65535. DISPLAY_IDENTIFIER fm_dyn_eprm[7].Stx_ffm_did_X_max_dyn[3] ECU_ADDRESS 0xd0005b4a FORMAT "%5.0" /end MEASUREMENT
/begin MEASUREMENT Sxx_ffm_did_5_max_dyn_7 "" UWORD _CNV_A_R_ECME_LINEA_0_CM 1 0. 0. 65535. DISPLAY_IDENTIFIER fm_dyn_eprm[7].Stx_ffm_did_X_max_dyn[4] ECU_ADDRESS 0xd0005b4c FORMAT "%5.0" /end MEASUREMENT
/begin MEASUREMENT Sxx_ffm_did_1_min_dyn_7 "" UWORD _CNV_A_R_ECME_LINEA_0_CM 1 0. 0. 65535. DISPLAY_IDENTIFIER fm_dyn_eprm[7].Stx_ffm_did_X_min_dyn[0] ECU_ADDRESS 0xd0005b50 FORMAT "%5.0" /end MEASUREMENT
/begin MEASUREMENT Sxx_ffm_did_2_min_dyn_7 "" UWORD _CNV_A_R_ECME_LINEA_0_CM 1 0. 0. 65535. DISPLAY_IDENTIFIER fm_dyn_eprm[7].Stx_ffm_did_X_min_dyn[1] ECU_ADDRESS 0xd0005b52 FORMAT "%5.0" /end MEASUREMENT
/begin MEASUREMENT Sxx_ffm_did_3_min_dyn_7 "" UWORD _CNV_A_R_ECME_LINEA_0_CM 1 0. 0. 65535. DISPLAY_IDENTIFIER fm_dyn_eprm[7].Stx_ffm_did_X_min_dyn[2] ECU_ADDRESS 0xd0005b54 FORMAT "%5.0" /end MEASUREMENT
/begin MEASUREMENT Sxx_ffm_did_4_min_dyn_7 "" UWORD _CNV_A_R_ECME_LINEA_0_CM 1 0. 0. 65535. DISPLAY_IDENTIFIER fm_dyn_eprm[7].Stx_ffm_did_X_min_dyn[3] ECU_ADDRESS 0xd0005b56 FORMAT "%5.0" /end MEASUREMENT
/begin MEASUREMENT Sxx_ffm_did_5_min_dyn_7 "" UWORD _CNV_A_R_ECME_LINEA_0_CM 1 0. 0. 65535. DISPLAY_IDENTIFIER fm_dyn_eprm[7].Stx_ffm_did_X_min_dyn[4] ECU_ADDRESS 0xd0005b58 FORMAT "%5.0" /end MEASUREMENT
/begin MEASUREMENT Sxx_obd_sc_n_dyn_7 "" UWORD _CNV_A_R_ENSD_LINEA_22_CM 1 0. 0. 16383.75 DISPLAY_IDENTIFIER fm_dyn_eprm[7].Stx_obd_sc_n_dyn ECU_ADDRESS 0xd0005b5a FORMAT "%8.2" /end MEASUREMENT
/begin MEASUREMENT Sbx_pfo_dyn_7 "" UBYTE _CNV_A_R_A_105_CM 1 0. 0. 255. DISPLAY_IDENTIFIER fm_dyn_eprm[7].fm_dynamic_eprm_bitfield.Stx_pfo_dyn ECU_ADDRESS 0xd0005b5c BIT_MASK 0x2 /end MEASUREMENT
/begin MEASUREMENT Sbx_mfo_dyn_7 "" UBYTE _CNV_A_R_A_105_CM 1 0. 0. 255. DISPLAY_IDENTIFIER fm_dyn_eprm[7].fm_dynamic_eprm_bitfield.Stx_mfo_dyn ECU_ADDRESS 0xd0005b5c BIT_MASK 0x4 /end MEASUREMENT
/begin MEASUREMENT Sbx_obd_mreq_dyn_7 "" UBYTE _CNV_A_R_A_105_CM 1 0. 0. 255. DISPLAY_IDENTIFIER fm_dyn_eprm[7].fm_dynamic_eprm_bitfield.Stx_obd_mreq_dyn ECU_ADDRESS 0xd0005b5c BIT_MASK 0x8 /end MEASUREMENT
/begin MEASUREMENT Sbx_obd_dc_rdn_dyn_7 "" UBYTE _CNV_A_R_A_105_CM 1 0. 0. 255. DISPLAY_IDENTIFIER fm_dyn_eprm[7].fm_dynamic_eprm_bitfield.Stx_obd_dc_rdn_dyn ECU_ADDRESS 0xd0005b5c BIT_MASK 0x10 /end MEASUREMENT
/begin MEASUREMENT Sbx_fail_dc_dyn_7 "" UBYTE _CNV_A_R_A_105_CM 1 0. 0. 255. DISPLAY_IDENTIFIER fm_dyn_eprm[7].fm_dynamic_eprm_bitfield.Stx_fail_dc_dyn ECU_ADDRESS 0xd0005b5c BIT_MASK 0x20 /end MEASUREMENT
/begin MEASUREMENT Sbx_obd_sc_pass_dyn_7 "" UBYTE _CNV_A_R_A_105_CM 1 0. 0. 255. DISPLAY_IDENTIFIER fm_dyn_eprm[7].fm_dynamic_eprm_bitfield.Stx_obd_sc_pass_dyn ECU_ADDRESS 0xd0005b5c BIT_MASK 0x40 /end MEASUREMENT
/begin MEASUREMENT Sbx_obd_sc_wup_stt_dyn_7 "" UBYTE _CNV_A_R_A_105_CM 1 0. 0. 255. DISPLAY_IDENTIFIER fm_dyn_eprm[7].fm_dynamic_eprm_bitfield.Stx_obd_sc_wup_stt_dyn ECU_ADDRESS 0xd0005b5c BIT_MASK 0x80 /end MEASUREMENT
/begin MEASUREMENT Sxx_obd_wctr_dyn_7 "" UBYTE _CNV_A_R_ECME_LINEA_0_CM 1 0. 0. 255. DISPLAY_IDENTIFIER fm_dyn_eprm[7].Stx_obd_wctr_dyn ECU_ADDRESS 0xd0005b5d FORMAT "%3.0" /end MEASUREMENT
/begin MEASUREMENT Sxx_frq_dyn_7 "" UBYTE _CNV_A_R_ECME_LINEA_0_CM 1 0. 0. 255. DISPLAY_IDENTIFIER fm_dyn_eprm[7].Stx_frq_dyn ECU_ADDRESS 0xd0005b5e FORMAT "%3.0" /end MEASUREMENT
/begin MEASUREMENT Sxx_obd_clfctr_dyn_7 "" UBYTE _CNV_A_R_ECME_LINEA_0_CM 1 0. 0. 10. DISPLAY_IDENTIFIER fm_dyn_eprm[7].Stx_obd_clfctr_dyn ECU_ADDRESS 0xd0005b5f FORMAT "%3.0" /end MEASUREMENT
/begin MEASUREMENT Sxx_esd_siz_dyn_7 "" UBYTE _CNV_A_R_ECME_LINEA_0_CM 1 0. 0. 255. DISPLAY_IDENTIFIER fm_dyn_eprm[7].Stx_esd_siz_dyn ECU_ADDRESS 0xd0005b60 FORMAT "%3.0" /end MEASUREMENT
/begin MEASUREMENT Sxx_obd_sc_ctr_dyn_7 "" UBYTE _CNV_A_R_ECME_LINEA_0_CM 1 0. 0. 255. DISPLAY_IDENTIFIER fm_dyn_eprm[7].Stx_obd_sc_ctr_dyn ECU_ADDRESS 0xd0005b61 FORMAT "%3.0" /end MEASUREMENT
/begin MEASUREMENT Sxx_obd_sc_load_dyn_7 "" UBYTE _CNV_A_R_LINEAR_____165_CM 1 0. 0. 100. DISPLAY_IDENTIFIER fm_dyn_eprm[7].Stx_obd_sc_load_dyn ECU_ADDRESS 0xd0005b62 FORMAT "%12.8" /end MEASUREMENT
/begin MEASUREMENT Sxx_pri_dyn_7 "" UBYTE _CNV_A_R_ECME_LINEA_0_CM 1 0. 0. 5. DISPLAY_IDENTIFIER fm_dyn_eprm[7].Stx_pri_dyn ECU_ADDRESS 0xd0005b63 FORMAT "%3.0" /end MEASUREMENT
/begin MEASUREMENT Sxx_dist_fail_dyn_8 "" ULONG _CNV_A_R_LINEAR_____274_CM 1 0. 0. 16777215. DISPLAY_IDENTIFIER fm_dyn_eprm[8].Stx_dist_fail_dyn ECU_ADDRESS 0xd0005b64 FORMAT "%10.0" /end MEASUREMENT
/begin MEASUREMENT Sxx_tmp_dist_dyn_8 "" ULONG _CNV_A_R_LINEAR_____274_CM 1 0. 0. 16777215. DISPLAY_IDENTIFIER fm_dyn_eprm[8].Stx_tmp_dist_dyn ECU_ADDRESS 0xd0005b68 FORMAT "%10.0" /end MEASUREMENT
/begin MEASUREMENT Sxx_km_cf_dyn_8 "" ULONG _CNV_A_R_LINEAR_____274_CM 1 0. 0. 16777215. DISPLAY_IDENTIFIER fm_dyn_eprm[8].Stx_km_cf_dyn ECU_ADDRESS 0xd0005b6c FORMAT "%10.0" /end MEASUREMENT
/begin MEASUREMENT Sxx_km_mf_dyn_8 "" ULONG _CNV_A_R_LINEAR_____274_CM 1 0. 0. 16777215. DISPLAY_IDENTIFIER fm_dyn_eprm[8].Stx_km_mf_dyn ECU_ADDRESS 0xd0005b70 FORMAT "%10.0" /end MEASUREMENT
/begin MEASUREMENT Sxx_km_pass_dyn_8 "" ULONG _CNV_A_R_LINEAR_____274_CM 1 0. 0. 16777215. DISPLAY_IDENTIFIER fm_dyn_eprm[8].Stx_km_pass_dyn ECU_ADDRESS 0xd0005b74 FORMAT "%10.0" /end MEASUREMENT
/begin MEASUREMENT Sxx_ind_dyn_8 "" UWORD _CNV_A_R_ECME_LINEA_0_CM 1 0. 0. 65535. DISPLAY_IDENTIFIER fm_dyn_eprm[8].Stx_ind_dyn ECU_ADDRESS 0xd0005b78 FORMAT "%5.0" /end MEASUREMENT
/begin MEASUREMENT Sxx_ffm_esti_tqe_dyn_8 "" UWORD _CNV_A_R_LINEAR_____216_CM 1 0. -400. 1647.96875 DISPLAY_IDENTIFIER fm_dyn_eprm[8].Stx_ffm_esti_tqe_dyn ECU_ADDRESS 0xd0005b7a FORMAT "%10.5" /end MEASUREMENT
/begin MEASUREMENT Sxx_ffm_esti_tqe_min_dyn_8 "" UWORD _CNV_A_R_LINEAR_____216_CM 1 0. -400. 1647.96875 DISPLAY_IDENTIFIER fm_dyn_eprm[8].Stx_ffm_esti_tqe_min_dyn ECU_ADDRESS 0xd0005b7c FORMAT "%10.5" /end MEASUREMENT
/begin MEASUREMENT Sxx_ffm_esti_tqe_max_dyn_8 "" UWORD _CNV_A_R_LINEAR_____216_CM 1 0. -400. 1647.96875 DISPLAY_IDENTIFIER fm_dyn_eprm[8].Stx_ffm_esti_tqe_max_dyn ECU_ADDRESS 0xd0005b7e FORMAT "%10.5" /end MEASUREMENT
/begin MEASUREMENT Sxx_ffm_n_dyn_8 "" UWORD _CNV_A_R_ENSD_LINEA_22_CM 1 0. 0. 16383.75 DISPLAY_IDENTIFIER fm_dyn_eprm[8].Stx_ffm_n_dyn ECU_ADDRESS 0xd0005b80 FORMAT "%8.2" /end MEASUREMENT
/begin MEASUREMENT Sxx_ffm_n_min_dyn_8 "" UWORD _CNV_A_R_ENSD_LINEA_22_CM 1 0. 0. 16383.75 DISPLAY_IDENTIFIER fm_dyn_eprm[8].Stx_ffm_n_min_dyn ECU_ADDRESS 0xd0005b82 FORMAT "%8.2" /end MEASUREMENT
/begin MEASUREMENT Sxx_ffm_n_max_dyn_8 "" UWORD _CNV_A_R_ENSD_LINEA_22_CM 1 0. 0. 16383.75 DISPLAY_IDENTIFIER fm_dyn_eprm[8].Stx_ffm_n_max_dyn ECU_ADDRESS 0xd0005b84 FORMAT "%8.2" /end MEASUREMENT
/begin MEASUREMENT Sxx_ffm_tco_dyn_8 "" UWORD _CNV_A_R_LINEAR_____278_CM 1 0. -273. 6280.5 DISPLAY_IDENTIFIER fm_dyn_eprm[8].Stx_ffm_tco_dyn ECU_ADDRESS 0xd0005b86 FORMAT "%6.1" /end MEASUREMENT
/begin MEASUREMENT Sxx_ffm_tco_min_dyn_8 "" UWORD _CNV_A_R_LINEAR_____278_CM 1 0. -273. 6280.5 DISPLAY_IDENTIFIER fm_dyn_eprm[8].Stx_ffm_tco_min_dyn ECU_ADDRESS 0xd0005b88 FORMAT "%6.1" /end MEASUREMENT
/begin MEASUREMENT Sxx_ffm_tco_max_dyn_8 "" UWORD _CNV_A_R_LINEAR_____278_CM 1 0. -273. 6280.5 DISPLAY_IDENTIFIER fm_dyn_eprm[8].Stx_ffm_tco_max_dyn ECU_ADDRESS 0xd0005b8a FORMAT "%6.1" /end MEASUREMENT
/begin MEASUREMENT Sxx_ffm_vb_dyn_8 "" UWORD _CNV_A_R_LINEAR_____205_CM 1 0. 0. 655.35 DISPLAY_IDENTIFIER fm_dyn_eprm[8].Stx_ffm_vb_dyn ECU_ADDRESS 0xd0005b8c FORMAT "%6.2" /end MEASUREMENT
/begin MEASUREMENT Sxx_ffm_vb_min_dyn_8 "" UWORD _CNV_A_R_LINEAR_____205_CM 1 0. 0. 655.35 DISPLAY_IDENTIFIER fm_dyn_eprm[8].Stx_ffm_vb_min_dyn ECU_ADDRESS 0xd0005b8e FORMAT "%6.2" /end MEASUREMENT
/begin MEASUREMENT Sxx_ffm_vb_max_dyn_8 "" UWORD _CNV_A_R_LINEAR_____205_CM 1 0. 0. 655.35 DISPLAY_IDENTIFIER fm_dyn_eprm[8].Stx_ffm_vb_max_dyn ECU_ADDRESS 0xd0005b90 FORMAT "%6.2" /end MEASUREMENT
/begin MEASUREMENT Sxx_ffm_vs_dyn_8 "" UWORD _CNV_A_R_LINEAR_____125_CM 1 0. 0. 655.35 DISPLAY_IDENTIFIER fm_dyn_eprm[8].Stx_ffm_vs_dyn ECU_ADDRESS 0xd0005b92 FORMAT "%6.2" /end MEASUREMENT
/begin MEASUREMENT Sxx_ffm_vs_min_dyn_8 "" UWORD _CNV_A_R_LINEAR_____125_CM 1 0. 0. 655.35 DISPLAY_IDENTIFIER fm_dyn_eprm[8].Stx_ffm_vs_min_dyn ECU_ADDRESS 0xd0005b94 FORMAT "%6.2" /end MEASUREMENT
/begin MEASUREMENT Sxx_ffm_vs_max_dyn_8 "" UWORD _CNV_A_R_LINEAR_____125_CM 1 0. 0. 655.35 DISPLAY_IDENTIFIER fm_dyn_eprm[8].Stx_ffm_vs_max_dyn ECU_ADDRESS 0xd0005b96 FORMAT "%6.2" /end MEASUREMENT
/begin MEASUREMENT Sxx_ffm_did_1_dyn_8 "" UWORD _CNV_A_R_ECME_LINEA_0_CM 1 0. 0. 65535. DISPLAY_IDENTIFIER fm_dyn_eprm[8].Stx_ffm_did_X_dyn[0] ECU_ADDRESS 0xd0005b98 FORMAT "%5.0" /end MEASUREMENT
/begin MEASUREMENT Sxx_ffm_did_2_dyn_8 "" UWORD _CNV_A_R_ECME_LINEA_0_CM 1 0. 0. 65535. DISPLAY_IDENTIFIER fm_dyn_eprm[8].Stx_ffm_did_X_dyn[1] ECU_ADDRESS 0xd0005b9a FORMAT "%5.0" /end MEASUREMENT
/begin MEASUREMENT Sxx_ffm_did_3_dyn_8 "" UWORD _CNV_A_R_ECME_LINEA_0_CM 1 0. 0. 65535. DISPLAY_IDENTIFIER fm_dyn_eprm[8].Stx_ffm_did_X_dyn[2] ECU_ADDRESS 0xd0005b9c FORMAT "%5.0" /end MEASUREMENT
/begin MEASUREMENT Sxx_ffm_did_4_dyn_8 "" UWORD _CNV_A_R_ECME_LINEA_0_CM 1 0. 0. 65535. DISPLAY_IDENTIFIER fm_dyn_eprm[8].Stx_ffm_did_X_dyn[3] ECU_ADDRESS 0xd0005b9e FORMAT "%5.0" /end MEASUREMENT
/begin MEASUREMENT Sxx_ffm_did_5_dyn_8 "" UWORD _CNV_A_R_ECME_LINEA_0_CM 1 0. 0. 65535. DISPLAY_IDENTIFIER fm_dyn_eprm[8].Stx_ffm_did_X_dyn[4] ECU_ADDRESS 0xd0005ba0 FORMAT "%5.0" /end MEASUREMENT
/begin MEASUREMENT Sxx_ffm_did_1_max_dyn_8 "" UWORD _CNV_A_R_ECME_LINEA_0_CM 1 0. 0. 65535. DISPLAY_IDENTIFIER fm_dyn_eprm[8].Stx_ffm_did_X_max_dyn[0] ECU_ADDRESS 0xd0005ba4 FORMAT "%5.0" /end MEASUREMENT
/begin MEASUREMENT Sxx_ffm_did_2_max_dyn_8 "" UWORD _CNV_A_R_ECME_LINEA_0_CM 1 0. 0. 65535. DISPLAY_IDENTIFIER fm_dyn_eprm[8].Stx_ffm_did_X_max_dyn[1] ECU_ADDRESS 0xd0005ba6 FORMAT "%5.0" /end MEASUREMENT
/begin MEASUREMENT Sxx_ffm_did_3_max_dyn_8 "" UWORD _CNV_A_R_ECME_LINEA_0_CM 1 0. 0. 65535. DISPLAY_IDENTIFIER fm_dyn_eprm[8].Stx_ffm_did_X_max_dyn[2] ECU_ADDRESS 0xd0005ba8 FORMAT "%5.0" /end MEASUREMENT
/begin MEASUREMENT Sxx_ffm_did_4_max_dyn_8 "" UWORD _CNV_A_R_ECME_LINEA_0_CM 1 0. 0. 65535. DISPLAY_IDENTIFIER fm_dyn_eprm[8].Stx_ffm_did_X_max_dyn[3] ECU_ADDRESS 0xd0005baa FORMAT "%5.0" /end MEASUREMENT
/begin MEASUREMENT Sxx_ffm_did_5_max_dyn_8 "" UWORD _CNV_A_R_ECME_LINEA_0_CM 1 0. 0. 65535. DISPLAY_IDENTIFIER fm_dyn_eprm[8].Stx_ffm_did_X_max_dyn[4] ECU_ADDRESS 0xd0005bac FORMAT "%5.0" /end MEASUREMENT
/begin MEASUREMENT Sxx_ffm_did_1_min_dyn_8 "" UWORD _CNV_A_R_ECME_LINEA_0_CM 1 0. 0. 65535. DISPLAY_IDENTIFIER fm_dyn_eprm[8].Stx_ffm_did_X_min_dyn[0] ECU_ADDRESS 0xd0005bb0 FORMAT "%5.0" /end MEASUREMENT
/begin MEASUREMENT Sxx_ffm_did_2_min_dyn_8 "" UWORD _CNV_A_R_ECME_LINEA_0_CM 1 0. 0. 65535. DISPLAY_IDENTIFIER fm_dyn_eprm[8].Stx_ffm_did_X_min_dyn[1] ECU_ADDRESS 0xd0005bb2 FORMAT "%5.0" /end MEASUREMENT
/begin MEASUREMENT Sxx_ffm_did_3_min_dyn_8 "" UWORD _CNV_A_R_ECME_LINEA_0_CM 1 0. 0. 65535. DISPLAY_IDENTIFIER fm_dyn_eprm[8].Stx_ffm_did_X_min_dyn[2] ECU_ADDRESS 0xd0005bb4 FORMAT "%5.0" /end MEASUREMENT
/begin MEASUREMENT Sxx_ffm_did_4_min_dyn_8 "" UWORD _CNV_A_R_ECME_LINEA_0_CM 1 0. 0. 65535. DISPLAY_IDENTIFIER fm_dyn_eprm[8].Stx_ffm_did_X_min_dyn[3] ECU_ADDRESS 0xd0005bb6 FORMAT "%5.0" /end MEASUREMENT
/begin MEASUREMENT Sxx_ffm_did_5_min_dyn_8 "" UWORD _CNV_A_R_ECME_LINEA_0_CM 1 0. 0. 65535. DISPLAY_IDENTIFIER fm_dyn_eprm[8].Stx_ffm_did_X_min_dyn[4] ECU_ADDRESS 0xd0005bb8 FORMAT "%5.0" /end MEASUREMENT
/begin MEASUREMENT Sxx_obd_sc_n_dyn_8 "" UWORD _CNV_A_R_ENSD_LINEA_22_CM 1 0. 0. 16383.75 DISPLAY_IDENTIFIER fm_dyn_eprm[8].Stx_obd_sc_n_dyn ECU_ADDRESS 0xd0005bba FORMAT "%8.2" /end MEASUREMENT
/begin MEASUREMENT Sbx_pfo_dyn_8 "" UBYTE _CNV_A_R_A_105_CM 1 0. 0. 255. DISPLAY_IDENTIFIER fm_dyn_eprm[8].fm_dynamic_eprm_bitfield.Stx_pfo_dyn ECU_ADDRESS 0xd0005bbc BIT_MASK 0x2 /end MEASUREMENT
/begin MEASUREMENT Sbx_mfo_dyn_8 "" UBYTE _CNV_A_R_A_105_CM 1 0. 0. 255. DISPLAY_IDENTIFIER fm_dyn_eprm[8].fm_dynamic_eprm_bitfield.Stx_mfo_dyn ECU_ADDRESS 0xd0005bbc BIT_MASK 0x4 /end MEASUREMENT
/begin MEASUREMENT Sbx_obd_mreq_dyn_8 "" UBYTE _CNV_A_R_A_105_CM 1 0. 0. 255. DISPLAY_IDENTIFIER fm_dyn_eprm[8].fm_dynamic_eprm_bitfield.Stx_obd_mreq_dyn ECU_ADDRESS 0xd0005bbc BIT_MASK 0x8 /end MEASUREMENT
/begin MEASUREMENT Sbx_obd_dc_rdn_dyn_8 "" UBYTE _CNV_A_R_A_105_CM 1 0. 0. 255. DISPLAY_IDENTIFIER fm_dyn_eprm[8].fm_dynamic_eprm_bitfield.Stx_obd_dc_rdn_dyn ECU_ADDRESS 0xd0005bbc BIT_MASK 0x10 /end MEASUREMENT
/begin MEASUREMENT Sbx_fail_dc_dyn_8 "" UBYTE _CNV_A_R_A_105_CM 1 0. 0. 255. DISPLAY_IDENTIFIER fm_dyn_eprm[8].fm_dynamic_eprm_bitfield.Stx_fail_dc_dyn ECU_ADDRESS 0xd0005bbc BIT_MASK 0x20 /end MEASUREMENT
/begin MEASUREMENT Sbx_obd_sc_pass_dyn_8 "" UBYTE _CNV_A_R_A_105_CM 1 0. 0. 255. DISPLAY_IDENTIFIER fm_dyn_eprm[8].fm_dynamic_eprm_bitfield.Stx_obd_sc_pass_dyn ECU_ADDRESS 0xd0005bbc BIT_MASK 0x40 /end MEASUREMENT
/begin MEASUREMENT Sbx_obd_sc_wup_stt_dyn_8 "" UBYTE _CNV_A_R_A_105_CM 1 0. 0. 255. DISPLAY_IDENTIFIER fm_dyn_eprm[8].fm_dynamic_eprm_bitfield.Stx_obd_sc_wup_stt_dyn ECU_ADDRESS 0xd0005bbc BIT_MASK 0x80 /end MEASUREMENT
/begin MEASUREMENT Sxx_obd_wctr_dyn_8 "" UBYTE _CNV_A_R_ECME_LINEA_0_CM 1 0. 0. 255. DISPLAY_IDENTIFIER fm_dyn_eprm[8].Stx_obd_wctr_dyn ECU_ADDRESS 0xd0005bbd FORMAT "%3.0" /end MEASUREMENT
/begin MEASUREMENT Sxx_frq_dyn_8 "" UBYTE _CNV_A_R_ECME_LINEA_0_CM 1 0. 0. 255. DISPLAY_IDENTIFIER fm_dyn_eprm[8].Stx_frq_dyn ECU_ADDRESS 0xd0005bbe FORMAT "%3.0" /end MEASUREMENT
/begin MEASUREMENT Sxx_obd_clfctr_dyn_8 "" UBYTE _CNV_A_R_ECME_LINEA_0_CM 1 0. 0. 10. DISPLAY_IDENTIFIER fm_dyn_eprm[8].Stx_obd_clfctr_dyn ECU_ADDRESS 0xd0005bbf FORMAT "%3.0" /end MEASUREMENT
/begin MEASUREMENT Sxx_esd_siz_dyn_8 "" UBYTE _CNV_A_R_ECME_LINEA_0_CM 1 0. 0. 255. DISPLAY_IDENTIFIER fm_dyn_eprm[8].Stx_esd_siz_dyn ECU_ADDRESS 0xd0005bc0 FORMAT "%3.0" /end MEASUREMENT
/begin MEASUREMENT Sxx_obd_sc_ctr_dyn_8 "" UBYTE _CNV_A_R_ECME_LINEA_0_CM 1 0. 0. 255. DISPLAY_IDENTIFIER fm_dyn_eprm[8].Stx_obd_sc_ctr_dyn ECU_ADDRESS 0xd0005bc1 FORMAT "%3.0" /end MEASUREMENT
/begin MEASUREMENT Sxx_obd_sc_load_dyn_8 "" UBYTE _CNV_A_R_LINEAR_____165_CM 1 0. 0. 100. DISPLAY_IDENTIFIER fm_dyn_eprm[8].Stx_obd_sc_load_dyn ECU_ADDRESS 0xd0005bc2 FORMAT "%12.8" /end MEASUREMENT
/begin MEASUREMENT Sxx_pri_dyn_8 "" UBYTE _CNV_A_R_ECME_LINEA_0_CM 1 0. 0. 5. DISPLAY_IDENTIFIER fm_dyn_eprm[8].Stx_pri_dyn ECU_ADDRESS 0xd0005bc3 FORMAT "%3.0" /end MEASUREMENT
/begin MEASUREMENT Sxx_dist_fail_dyn_9 "" ULONG _CNV_A_R_LINEAR_____274_CM 1 0. 0. 16777215. DISPLAY_IDENTIFIER fm_dyn_eprm[9].Stx_dist_fail_dyn ECU_ADDRESS 0xd0005bc4 FORMAT "%10.0" /end MEASUREMENT
/begin MEASUREMENT Sxx_tmp_dist_dyn_9 "" ULONG _CNV_A_R_LINEAR_____274_CM 1 0. 0. 16777215. DISPLAY_IDENTIFIER fm_dyn_eprm[9].Stx_tmp_dist_dyn ECU_ADDRESS 0xd0005bc8 FORMAT "%10.0" /end MEASUREMENT
/begin MEASUREMENT Sxx_km_cf_dyn_9 "" ULONG _CNV_A_R_LINEAR_____274_CM 1 0. 0. 16777215. DISPLAY_IDENTIFIER fm_dyn_eprm[9].Stx_km_cf_dyn ECU_ADDRESS 0xd0005bcc FORMAT "%10.0" /end MEASUREMENT
/begin MEASUREMENT Sxx_km_mf_dyn_9 "" ULONG _CNV_A_R_LINEAR_____274_CM 1 0. 0. 16777215. DISPLAY_IDENTIFIER fm_dyn_eprm[9].Stx_km_mf_dyn ECU_ADDRESS 0xd0005bd0 FORMAT "%10.0" /end MEASUREMENT
/begin MEASUREMENT Sxx_km_pass_dyn_9 "" ULONG _CNV_A_R_LINEAR_____274_CM 1 0. 0. 16777215. DISPLAY_IDENTIFIER fm_dyn_eprm[9].Stx_km_pass_dyn ECU_ADDRESS 0xd0005bd4 FORMAT "%10.0" /end MEASUREMENT
/begin MEASUREMENT Sxx_ind_dyn_9 "" UWORD _CNV_A_R_ECME_LINEA_0_CM 1 0. 0. 65535. DISPLAY_IDENTIFIER fm_dyn_eprm[9].Stx_ind_dyn ECU_ADDRESS 0xd0005bd8 FORMAT "%5.0" /end MEASUREMENT
/begin MEASUREMENT Sxx_ffm_esti_tqe_dyn_9 "" UWORD _CNV_A_R_LINEAR_____216_CM 1 0. -400. 1647.96875 DISPLAY_IDENTIFIER fm_dyn_eprm[9].Stx_ffm_esti_tqe_dyn ECU_ADDRESS 0xd0005bda FORMAT "%10.5" /end MEASUREMENT
/begin MEASUREMENT Sxx_ffm_esti_tqe_min_dyn_9 "" UWORD _CNV_A_R_LINEAR_____216_CM 1 0. -400. 1647.96875 DISPLAY_IDENTIFIER fm_dyn_eprm[9].Stx_ffm_esti_tqe_min_dyn ECU_ADDRESS 0xd0005bdc FORMAT "%10.5" /end MEASUREMENT
/begin MEASUREMENT Sxx_ffm_esti_tqe_max_dyn_9 "" UWORD _CNV_A_R_LINEAR_____216_CM 1 0. -400. 1647.96875 DISPLAY_IDENTIFIER fm_dyn_eprm[9].Stx_ffm_esti_tqe_max_dyn ECU_ADDRESS 0xd0005bde FORMAT "%10.5" /end MEASUREMENT
/begin MEASUREMENT Sxx_ffm_n_dyn_9 "" UWORD _CNV_A_R_ENSD_LINEA_22_CM 1 0. 0. 16383.75 DISPLAY_IDENTIFIER fm_dyn_eprm[9].Stx_ffm_n_dyn ECU_ADDRESS 0xd0005be0 FORMAT "%8.2" /end MEASUREMENT
/begin MEASUREMENT Sxx_ffm_n_min_dyn_9 "" UWORD _CNV_A_R_ENSD_LINEA_22_CM 1 0. 0. 16383.75 DISPLAY_IDENTIFIER fm_dyn_eprm[9].Stx_ffm_n_min_dyn ECU_ADDRESS 0xd0005be2 FORMAT "%8.2" /end MEASUREMENT
/begin MEASUREMENT Sxx_ffm_n_max_dyn_9 "" UWORD _CNV_A_R_ENSD_LINEA_22_CM 1 0. 0. 16383.75 DISPLAY_IDENTIFIER fm_dyn_eprm[9].Stx_ffm_n_max_dyn ECU_ADDRESS 0xd0005be4 FORMAT "%8.2" /end MEASUREMENT
/begin MEASUREMENT Sxx_ffm_tco_dyn_9 "" UWORD _CNV_A_R_LINEAR_____278_CM 1 0. -273. 6280.5 DISPLAY_IDENTIFIER fm_dyn_eprm[9].Stx_ffm_tco_dyn ECU_ADDRESS 0xd0005be6 FORMAT "%6.1" /end MEASUREMENT
/begin MEASUREMENT Sxx_ffm_tco_min_dyn_9 "" UWORD _CNV_A_R_LINEAR_____278_CM 1 0. -273. 6280.5 DISPLAY_IDENTIFIER fm_dyn_eprm[9].Stx_ffm_tco_min_dyn ECU_ADDRESS 0xd0005be8 FORMAT "%6.1" /end MEASUREMENT
/begin MEASUREMENT Sxx_ffm_tco_max_dyn_9 "" UWORD _CNV_A_R_LINEAR_____278_CM 1 0. -273. 6280.5 DISPLAY_IDENTIFIER fm_dyn_eprm[9].Stx_ffm_tco_max_dyn ECU_ADDRESS 0xd0005bea FORMAT "%6.1" /end MEASUREMENT
/begin MEASUREMENT Sxx_ffm_vb_dyn_9 "" UWORD _CNV_A_R_LINEAR_____205_CM 1 0. 0. 655.35 DISPLAY_IDENTIFIER fm_dyn_eprm[9].Stx_ffm_vb_dyn ECU_ADDRESS 0xd0005bec FORMAT "%6.2" /end MEASUREMENT
/begin MEASUREMENT Sxx_ffm_vb_min_dyn_9 "" UWORD _CNV_A_R_LINEAR_____205_CM 1 0. 0. 655.35 DISPLAY_IDENTIFIER fm_dyn_eprm[9].Stx_ffm_vb_min_dyn ECU_ADDRESS 0xd0005bee FORMAT "%6.2" /end MEASUREMENT
/begin MEASUREMENT Sxx_ffm_vb_max_dyn_9 "" UWORD _CNV_A_R_LINEAR_____205_CM 1 0. 0. 655.35 DISPLAY_IDENTIFIER fm_dyn_eprm[9].Stx_ffm_vb_max_dyn ECU_ADDRESS 0xd0005bf0 FORMAT "%6.2" /end MEASUREMENT
/begin MEASUREMENT Sxx_ffm_vs_dyn_9 "" UWORD _CNV_A_R_LINEAR_____125_CM 1 0. 0. 655.35 DISPLAY_IDENTIFIER fm_dyn_eprm[9].Stx_ffm_vs_dyn ECU_ADDRESS 0xd0005bf2 FORMAT "%6.2" /end MEASUREMENT
/begin MEASUREMENT Sxx_ffm_vs_min_dyn_9 "" UWORD _CNV_A_R_LINEAR_____125_CM 1 0. 0. 655.35 DISPLAY_IDENTIFIER fm_dyn_eprm[9].Stx_ffm_vs_min_dyn ECU_ADDRESS 0xd0005bf4 FORMAT "%6.2" /end MEASUREMENT
/begin MEASUREMENT Sxx_ffm_vs_max_dyn_9 "" UWORD _CNV_A_R_LINEAR_____125_CM 1 0. 0. 655.35 DISPLAY_IDENTIFIER fm_dyn_eprm[9].Stx_ffm_vs_max_dyn ECU_ADDRESS 0xd0005bf6 FORMAT "%6.2" /end MEASUREMENT
/begin MEASUREMENT Sxx_ffm_did_1_dyn_9 "" UWORD _CNV_A_R_ECME_LINEA_0_CM 1 0. 0. 65535. DISPLAY_IDENTIFIER fm_dyn_eprm[9].Stx_ffm_did_X_dyn[0] ECU_ADDRESS 0xd0005bf8 FORMAT "%5.0" /end MEASUREMENT
/begin MEASUREMENT Sxx_ffm_did_2_dyn_9 "" UWORD _CNV_A_R_ECME_LINEA_0_CM 1 0. 0. 65535. DISPLAY_IDENTIFIER fm_dyn_eprm[9].Stx_ffm_did_X_dyn[1] ECU_ADDRESS 0xd0005bfa FORMAT "%5.0" /end MEASUREMENT
/begin MEASUREMENT Sxx_ffm_did_3_dyn_9 "" UWORD _CNV_A_R_ECME_LINEA_0_CM 1 0. 0. 65535. DISPLAY_IDENTIFIER fm_dyn_eprm[9].Stx_ffm_did_X_dyn[2] ECU_ADDRESS 0xd0005bfc FORMAT "%5.0" /end MEASUREMENT
/begin MEASUREMENT Sxx_ffm_did_4_dyn_9 "" UWORD _CNV_A_R_ECME_LINEA_0_CM 1 0. 0. 65535. DISPLAY_IDENTIFIER fm_dyn_eprm[9].Stx_ffm_did_X_dyn[3] ECU_ADDRESS 0xd0005bfe FORMAT "%5.0" /end MEASUREMENT
/begin MEASUREMENT Sxx_ffm_did_5_dyn_9 "" UWORD _CNV_A_R_ECME_LINEA_0_CM 1 0. 0. 65535. DISPLAY_IDENTIFIER fm_dyn_eprm[9].Stx_ffm_did_X_dyn[4] ECU_ADDRESS 0xd0005c00 FORMAT "%5.0" /end MEASUREMENT
/begin MEASUREMENT Sxx_ffm_did_1_max_dyn_9 "" UWORD _CNV_A_R_ECME_LINEA_0_CM 1 0. 0. 65535. DISPLAY_IDENTIFIER fm_dyn_eprm[9].Stx_ffm_did_X_max_dyn[0] ECU_ADDRESS 0xd0005c04 FORMAT "%5.0" /end MEASUREMENT
/begin MEASUREMENT Sxx_ffm_did_2_max_dyn_9 "" UWORD _CNV_A_R_ECME_LINEA_0_CM 1 0. 0. 65535. DISPLAY_IDENTIFIER fm_dyn_eprm[9].Stx_ffm_did_X_max_dyn[1] ECU_ADDRESS 0xd0005c06 FORMAT "%5.0" /end MEASUREMENT
/begin MEASUREMENT Sxx_ffm_did_3_max_dyn_9 "" UWORD _CNV_A_R_ECME_LINEA_0_CM 1 0. 0. 65535. DISPLAY_IDENTIFIER fm_dyn_eprm[9].Stx_ffm_did_X_max_dyn[2] ECU_ADDRESS 0xd0005c08 FORMAT "%5.0" /end MEASUREMENT
/begin MEASUREMENT Sxx_ffm_did_4_max_dyn_9 "" UWORD _CNV_A_R_ECME_LINEA_0_CM 1 0. 0. 65535. DISPLAY_IDENTIFIER fm_dyn_eprm[9].Stx_ffm_did_X_max_dyn[3] ECU_ADDRESS 0xd0005c0a FORMAT "%5.0" /end MEASUREMENT
/begin MEASUREMENT Sxx_ffm_did_5_max_dyn_9 "" UWORD _CNV_A_R_ECME_LINEA_0_CM 1 0. 0. 65535. DISPLAY_IDENTIFIER fm_dyn_eprm[9].Stx_ffm_did_X_max_dyn[4] ECU_ADDRESS 0xd0005c0c FORMAT "%5.0" /end MEASUREMENT
/begin MEASUREMENT Sxx_ffm_did_1_min_dyn_9 "" UWORD _CNV_A_R_ECME_LINEA_0_CM 1 0. 0. 65535. DISPLAY_IDENTIFIER fm_dyn_eprm[9].Stx_ffm_did_X_min_dyn[0] ECU_ADDRESS 0xd0005c10 FORMAT "%5.0" /end MEASUREMENT
/begin MEASUREMENT Sxx_ffm_did_2_min_dyn_9 "" UWORD _CNV_A_R_ECME_LINEA_0_CM 1 0. 0. 65535. DISPLAY_IDENTIFIER fm_dyn_eprm[9].Stx_ffm_did_X_min_dyn[1] ECU_ADDRESS 0xd0005c12 FORMAT "%5.0" /end MEASUREMENT
/begin MEASUREMENT Sxx_ffm_did_3_min_dyn_9 "" UWORD _CNV_A_R_ECME_LINEA_0_CM 1 0. 0. 65535. DISPLAY_IDENTIFIER fm_dyn_eprm[9].Stx_ffm_did_X_min_dyn[2] ECU_ADDRESS 0xd0005c14 FORMAT "%5.0" /end MEASUREMENT
/begin MEASUREMENT Sxx_ffm_did_4_min_dyn_9 "" UWORD _CNV_A_R_ECME_LINEA_0_CM 1 0. 0. 65535. DISPLAY_IDENTIFIER fm_dyn_eprm[9].Stx_ffm_did_X_min_dyn[3] ECU_ADDRESS 0xd0005c16 FORMAT "%5.0" /end MEASUREMENT
/begin MEASUREMENT Sxx_ffm_did_5_min_dyn_9 "" UWORD _CNV_A_R_ECME_LINEA_0_CM 1 0. 0. 65535. DISPLAY_IDENTIFIER fm_dyn_eprm[9].Stx_ffm_did_X_min_dyn[4] ECU_ADDRESS 0xd0005c18 FORMAT "%5.0" /end MEASUREMENT
/begin MEASUREMENT Sxx_obd_sc_n_dyn_9 "" UWORD _CNV_A_R_ENSD_LINEA_22_CM 1 0. 0. 16383.75 DISPLAY_IDENTIFIER fm_dyn_eprm[9].Stx_obd_sc_n_dyn ECU_ADDRESS 0xd0005c1a FORMAT "%8.2" /end MEASUREMENT
/begin MEASUREMENT Sbx_pfo_dyn_9 "" UBYTE _CNV_A_R_A_105_CM 1 0. 0. 255. DISPLAY_IDENTIFIER fm_dyn_eprm[9].fm_dynamic_eprm_bitfield.Stx_pfo_dyn ECU_ADDRESS 0xd0005c1c BIT_MASK 0x2 /end MEASUREMENT
/begin MEASUREMENT Sbx_mfo_dyn_9 "" UBYTE _CNV_A_R_A_105_CM 1 0. 0. 255. DISPLAY_IDENTIFIER fm_dyn_eprm[9].fm_dynamic_eprm_bitfield.Stx_mfo_dyn ECU_ADDRESS 0xd0005c1c BIT_MASK 0x4 /end MEASUREMENT
/begin MEASUREMENT Sbx_obd_mreq_dyn_9 "" UBYTE _CNV_A_R_A_105_CM 1 0. 0. 255. DISPLAY_IDENTIFIER fm_dyn_eprm[9].fm_dynamic_eprm_bitfield.Stx_obd_mreq_dyn ECU_ADDRESS 0xd0005c1c BIT_MASK 0x8 /end MEASUREMENT
/begin MEASUREMENT Sbx_obd_dc_rdn_dyn_9 "" UBYTE _CNV_A_R_A_105_CM 1 0. 0. 255. DISPLAY_IDENTIFIER fm_dyn_eprm[9].fm_dynamic_eprm_bitfield.Stx_obd_dc_rdn_dyn ECU_ADDRESS 0xd0005c1c BIT_MASK 0x10 /end MEASUREMENT
/begin MEASUREMENT Sbx_fail_dc_dyn_9 "" UBYTE _CNV_A_R_A_105_CM 1 0. 0. 255. DISPLAY_IDENTIFIER fm_dyn_eprm[9].fm_dynamic_eprm_bitfield.Stx_fail_dc_dyn ECU_ADDRESS 0xd0005c1c BIT_MASK 0x20 /end MEASUREMENT
/begin MEASUREMENT Sbx_obd_sc_pass_dyn_9 "" UBYTE _CNV_A_R_A_105_CM 1 0. 0. 255. DISPLAY_IDENTIFIER fm_dyn_eprm[9].fm_dynamic_eprm_bitfield.Stx_obd_sc_pass_dyn ECU_ADDRESS 0xd0005c1c BIT_MASK 0x40 /end MEASUREMENT
/begin MEASUREMENT Sbx_obd_sc_wup_stt_dyn_9 "" UBYTE _CNV_A_R_A_105_CM 1 0. 0. 255. DISPLAY_IDENTIFIER fm_dyn_eprm[9].fm_dynamic_eprm_bitfield.Stx_obd_sc_wup_stt_dyn ECU_ADDRESS 0xd0005c1c BIT_MASK 0x80 /end MEASUREMENT
/begin MEASUREMENT Sxx_obd_wctr_dyn_9 "" UBYTE _CNV_A_R_ECME_LINEA_0_CM 1 0. 0. 255. DISPLAY_IDENTIFIER fm_dyn_eprm[9].Stx_obd_wctr_dyn ECU_ADDRESS 0xd0005c1d FORMAT "%3.0" /end MEASUREMENT
/begin MEASUREMENT Sxx_frq_dyn_9 "" UBYTE _CNV_A_R_ECME_LINEA_0_CM 1 0. 0. 255. DISPLAY_IDENTIFIER fm_dyn_eprm[9].Stx_frq_dyn ECU_ADDRESS 0xd0005c1e FORMAT "%3.0" /end MEASUREMENT
/begin MEASUREMENT Sxx_obd_clfctr_dyn_9 "" UBYTE _CNV_A_R_ECME_LINEA_0_CM 1 0. 0. 10. DISPLAY_IDENTIFIER fm_dyn_eprm[9].Stx_obd_clfctr_dyn ECU_ADDRESS 0xd0005c1f FORMAT "%3.0" /end MEASUREMENT
/begin MEASUREMENT Sxx_esd_siz_dyn_9 "" UBYTE _CNV_A_R_ECME_LINEA_0_CM 1 0. 0. 255. DISPLAY_IDENTIFIER fm_dyn_eprm[9].Stx_esd_siz_dyn ECU_ADDRESS 0xd0005c20 FORMAT "%3.0" /end MEASUREMENT
/begin MEASUREMENT Sxx_obd_sc_ctr_dyn_9 "" UBYTE _CNV_A_R_ECME_LINEA_0_CM 1 0. 0. 255. DISPLAY_IDENTIFIER fm_dyn_eprm[9].Stx_obd_sc_ctr_dyn ECU_ADDRESS 0xd0005c21 FORMAT "%3.0" /end MEASUREMENT
/begin MEASUREMENT Sxx_obd_sc_load_dyn_9 "" UBYTE _CNV_A_R_LINEAR_____165_CM 1 0. 0. 100. DISPLAY_IDENTIFIER fm_dyn_eprm[9].Stx_obd_sc_load_dyn ECU_ADDRESS 0xd0005c22 FORMAT "%12.8" /end MEASUREMENT
/begin MEASUREMENT Sxx_pri_dyn_9 "" UBYTE _CNV_A_R_ECME_LINEA_0_CM 1 0. 0. 5. DISPLAY_IDENTIFIER fm_dyn_eprm[9].Stx_pri_dyn ECU_ADDRESS 0xd0005c23 FORMAT "%3.0" /end MEASUREMENT
/begin MEASUREMENT Stx_obd_iupr_den_0 "IUPR denominators table" UWORD _CNV_A_R_ECME_LINEA_0_CM 1 0. 0. 65535. DISPLAY_IDENTIFIER fm_iupr[0].Stx_obd_iupr_den ECU_ADDRESS 0xd0005c46 FORMAT "%5.0" /end MEASUREMENT
/begin MEASUREMENT Stx_obd_iupr_num_0 "IUPR numerators table" UWORD _CNV_A_R_ECME_LINEA_0_CM 1 0. 0. 65535. DISPLAY_IDENTIFIER fm_iupr[0].Stx_obd_iupr_num ECU_ADDRESS 0xd0005c48 FORMAT "%5.0" /end MEASUREMENT
/begin MEASUREMENT Stx_obd_iupr_num_upd_0 "IUPR numerators updating indicator table" UBYTE _CNV_S_2_RANGE______3_CM 1 0. 0. 1. DISPLAY_IDENTIFIER fm_iupr[0].Stx_obd_iupr_num_upd ECU_ADDRESS 0xd0005c4a /end MEASUREMENT
/begin MEASUREMENT Sbx_obd_wup "Warm-up cycle detection status" UBYTE _CNV_S_2_RANGE______3_CM 1 0. 0. 1. ECU_ADDRESS 0xd000794c /end MEASUREMENT
/begin MEASUREMENT Stx_esd[0] "Extended Snapshot Data table" UBYTE _CNV_A_R_ECME_LINEA_0_CM 1 0. 0. 255. ECU_ADDRESS 0xd0007957 FORMAT "%3.0" /end MEASUREMENT
/begin MEASUREMENT Sxx_clr_dist "Distance travelled since last clear" UWORD _CNV_A_R_LINEAR_____274_CM 1 0. 0. 65535. ECU_ADDRESS 0xd0005c4c FORMAT "%5.0" /end MEASUREMENT
/begin MEASUREMENT Sxx_clr_wup "Warm-up cycles counter since last clear" UBYTE _CNV_A_R_ECME_LINEA_0_CM 1 0. 0. 255. ECU_ADDRESS 0xd0007958 FORMAT "%3.0" /end MEASUREMENT
/begin MEASUREMENT Sxx_dyn_ctr "Failure structure index of the next diagnostic instance to be stored (number of stored failures)" UBYTE _CNV_A_R_ECME_LINEA_0_CM 1 0. 0. 10. ECU_ADDRESS 0xd0007959 FORMAT "%2.0" /end MEASUREMENT
/begin MEASUREMENT Sxx_last_incr_km "Vehicle mileage of last IUPR denominator incremenation" ULONG _CNV_A_R_LINEAR_____274_CM 1 0. 0. 16777215. ECU_ADDRESS 0xd00034d8 FORMAT "%10.0" /end MEASUREMENT
/begin MEASUREMENT Sxx_mil_on_km "Distance travelled while MIL is activated" UWORD _CNV_A_R_LINEAR_____274_CM 1 0. 0. 65535. ECU_ADDRESS 0xd0005c4e FORMAT "%5.0" /end MEASUREMENT
/begin MEASUREMENT Sxx_obd_gen_den "IUPR general denominator" UWORD _CNV_A_R_ECME_LINEA_0_CM 1 0. 0. 65535. ECU_ADDRESS 0xd0005c50 FORMAT "%5.0" /end MEASUREMENT
/begin MEASUREMENT Sxx_obd_ign_ctr "OBD ignition cycle counter" UWORD _CNV_A_R_ECME_LINEA_0_CM 1 0. 0. 65535. ECU_ADDRESS 0xd0005c52 FORMAT "%5.0" /end MEASUREMENT
/begin MEASUREMENT Sxx_tmp_dist_1 "Temporary distance used to calculate distance traveled while MIL is illuminated" ULONG _CNV_A_R_LINEAR_____274_CM 1 0. 0. 16777215. ECU_ADDRESS 0xd00034dc FORMAT "%8.0" /end MEASUREMENT
/begin MEASUREMENT Sxx_tmp_dist_2 "Temporary distance used to calculate distance traveled since last clear" ULONG _CNV_A_R_LINEAR_____274_CM 1 0. 0. 16777215. ECU_ADDRESS 0xd00034e0 FORMAT "%8.0" /end MEASUREMENT
/begin MEASUREMENT Vbx_eng_aut_fm "Current autonomous engine detection state" UBYTE _CNV_S_2_RANGE______3_CM 1 0. 0. 1. ECU_ADDRESS 0xd000794d BIT_MASK 0x1 /end MEASUREMENT
/begin MEASUREMENT Vbx_eng_stop "Current stopped engine detection state" UBYTE _CNV_S_2_RANGE______3_CM 1 0. 0. 1. ECU_ADDRESS 0xd000794e BIT_MASK 0x1 /end MEASUREMENT
/begin MEASUREMENT Vbx_mil_ecu_req "MIL activation request of engine control unit" UBYTE _CNV_S_2_RANGE______3_CM 1 0. 0. 1. ECU_ADDRESS 0xd000794f BIT_MASK 0x1 /end MEASUREMENT
/begin MEASUREMENT Vbx_mil_prmt_req "MIL illumination gobal request status (0 switch off, 1 switch on)" UBYTE _CNV_S_2_RANGE______3_CM 1 0. 0. 1. ECU_ADDRESS 0xd0007950 BIT_MASK 0x1 /end MEASUREMENT
/begin MEASUREMENT Vbx_obd_den_2_stt "IUPR denominator computing optional condition status indicator" UBYTE _CNV_S_2_RANGE______3_CM 1 0. 0. 1. ECU_ADDRESS 0xd0007951 BIT_MASK 0x1 /end MEASUREMENT
/begin MEASUREMENT Vbx_obd_den_main_stt "IUPR general demoninator conditions status indicator" UBYTE _CNV_S_2_RANGE______3_CM 1 0. 0. 1. ECU_ADDRESS 0xd0007952 BIT_MASK 0x1 /end MEASUREMENT
/begin MEASUREMENT Vbx_wal_1_req "Global warning lamp 1 activation request" UBYTE _CNV_S_2_RANGE______3_CM 1 0. 0. 1. ECU_ADDRESS 0xd0007953 BIT_MASK 0x1 /end MEASUREMENT
/begin MEASUREMENT Vbx_wal_2_req "Global warning lamp 2 activation request" UBYTE _CNV_S_2_RANGE______3_CM 1 0. 0. 1. ECU_ADDRESS 0xd0007954 BIT_MASK 0x1 /end MEASUREMENT
/begin MEASUREMENT Vbx_wup "Current warm-up detection state" UBYTE _CNV_S_2_RANGE______3_CM 1 0. 0. 1. ECU_ADDRESS 0xd0007955 BIT_MASK 0x1 /end MEASUREMENT
/begin MEASUREMENT Vtx_obd_cmd_on_stt[0] "IUPR denominator optional condition (commanded ON) status table" UBYTE _CNV_S_2_RANGE______3_CM 1 0. 0. 1. ECU_ADDRESS 0xd0007956 /end MEASUREMENT
/begin MEASUREMENT Vxx_dtc_hmb_cf_redg_edic "Diagnosis trouble code (device or function identifier) corresponding to the last confirmed failure raising edge event for EDIC" UWORD _CNV_A_R_ECME_LINEA_0_CM 1 0. 0. 65535. ECU_ADDRESS 0xd0005c54 FORMAT "%5.0" /end MEASUREMENT
/begin MEASUREMENT Vxx_dtc_lb_cf_redg_edic "Diagnosis trouble code (faulttype identifier) corresponding to the last confirmed failure rising edge event for EDIC" UBYTE _CNV_A_R_ECME_LINEA_0_CM 1 0. 0. 255. ECU_ADDRESS 0xd000795a FORMAT "%3.0" /end MEASUREMENT
/begin MEASUREMENT Vxx_esd_did_nr "RSA_API_ExtendedSnapshotData number of DID to store" UBYTE _CNV_A_R_ECME_LINEA_0_CM 1 0. 0. 255. ECU_ADDRESS 0xd000795b FORMAT "%3.0" /end MEASUREMENT
/begin MEASUREMENT Vxx_esd_ind "RSA_API_ExtendedSnapshotData calling diagnosis identifier" UWORD _CNV_A_R_ECME_LINEA_0_CM 1 0. 0. 65535. ECU_ADDRESS 0xd0005c56 FORMAT "%5.0" /end MEASUREMENT
/begin MEASUREMENT Vxx_esd_ind_ini "Current initial index to save requested data" UBYTE _CNV_A_R_ECME_LINEA_0_CM 1 0. 0. 255. ECU_ADDRESS 0xd000795c FORMAT "%3.0" /end MEASUREMENT
/begin MEASUREMENT Vxx_esd_ind_max "Initial index of free space in Extended Snapshot Data table" UBYTE _CNV_A_R_ECME_LINEA_0_CM 1 0. 0. 255. ECU_ADDRESS 0xd000795d FORMAT "%3.0" /end MEASUREMENT
/begin MEASUREMENT Vxx_esd_siz "Requested extended snapshot size in bytes to be saved" UBYTE _CNV_A_R_ECME_LINEA_0_CM 1 0. 0. 255. ECU_ADDRESS 0xd000795e FORMAT "%3.0" /end MEASUREMENT
/begin MEASUREMENT Vxx_ind_fail_redg "Diagnosis identifier associated to Vbx_cf_xxx rising edge event" UWORD _CNV_A_R_ECME_LINEA_0_CM 1 0. 0. 65535. ECU_ADDRESS 0xd0005c58 FORMAT "%5.0" /end MEASUREMENT
/begin MEASUREMENT Vxx_ind_mfo_redg "Diagnosis identifier of OBD confirmed failure rising edge" UWORD _CNV_A_R_ECME_LINEA_0_CM 1 0. 0. 65535. ECU_ADDRESS 0xd0005c5a FORMAT "%5.0" /end MEASUREMENT
/begin MEASUREMENT Vxx_ind_obd_clf_redg "Diagnosis identifier of OBD confirmed latched rising edge" UWORD _CNV_A_R_ECME_LINEA_0_CM 1 0. 0. 65535. ECU_ADDRESS 0xd0005c5c FORMAT "%5.0" /end MEASUREMENT
/begin MEASUREMENT Vxx_ind_obd_fedg "Diagnosis identifier of OBD pending or confirmed failure falling edge or overwriting" UWORD _CNV_A_R_ECME_LINEA_0_CM 1 0. 0. 65535. ECU_ADDRESS 0xd0005c5e FORMAT "%5.0" /end MEASUREMENT
/begin MEASUREMENT Vxx_ind_pfo_redg "Diagnosis identifier of OBD pending failure rising edge" UWORD _CNV_A_R_ECME_LINEA_0_CM 1 0. 0. 65535. ECU_ADDRESS 0xd0005c60 FORMAT "%5.0" /end MEASUREMENT
/begin MEASUREMENT Vxx_obd_den_main_1 "IUPR general denominator 1st condition counter" UWORD _CNV_A_R_ECME_LINEA_0_CM 1 0. 0. 600. ECU_ADDRESS 0xd0005c62 FORMAT "%5.0" /end MEASUREMENT
/begin MEASUREMENT Vxx_obd_den_main_2 "IUPR general denominator 2nd condition counter" UWORD _CNV_A_R_ECME_LINEA_0_CM 1 0. 0. 300. ECU_ADDRESS 0xd0005c64 FORMAT "%5.0" /end MEASUREMENT
/begin MEASUREMENT Vxx_obd_den_main_3 "IUPR general denominator 3rd condition counter" UBYTE _CNV_A_R_ECME_LINEA_0_CM 1 0. 0. 30. ECU_ADDRESS 0xd000795f FORMAT "%3.0" /end MEASUREMENT
/begin MEASUREMENT Vxx_tco_ini "Initial value of engine coolant temperature" UWORD _CNV_A_R_LINEAR_____110_CM 1 0. -40. 200. ECU_ADDRESS 0xd0005c66 FORMAT "%5.1" /end MEASUREMENT
/begin MEASUREMENT Vxx_tmp_pri "Temporary failure calculated priority" UBYTE _CNV_A_R_ECME_LINEA_0_CM 1 0. 0. 5. ECU_ADDRESS 0xd0007960 FORMAT "%1.0" /end MEASUREMENT
/begin MEASUREMENT Vxx_tot_nr_sw_diag "Total number of embeded software diagnoses" UWORD _CNV_A_R_ECME_LINEA_0_CM 1 0. 1. 1000. ECU_ADDRESS 0xd0005c68 FORMAT "%5.0" /end MEASUREMENT
/begin CHARACTERISTIC Cmx_obd_iupr_dsb_cfm_0_0_ "IUPR diagnoses inhibition matrix (rows : IUPR ; columns : all diag)" VALUE 0xa002b770 _REC_S1VAL_20_u1 255. _CNV_A_R_ECME_LINEA_0_CM 0. 255. DISPLAY_IDENTIFIER Cmx_obd_iupr_dsb_cfm[0][0] FORMAT "%3.0" /end CHARACTERISTIC
/begin CHARACTERISTIC Cmx_obd_iupr_dsb_cfm_0_1_ "IUPR diagnoses inhibition matrix (rows : IUPR ; columns : all diag)" VALUE 0xa002b771 _REC_S1VAL_20_u1 255. _CNV_A_R_ECME_LINEA_0_CM 0. 255. DISPLAY_IDENTIFIER Cmx_obd_iupr_dsb_cfm[0][1] FORMAT "%3.0" /end CHARACTERISTIC
/begin CHARACTERISTIC Cmx_obd_iupr_dsb_cfm_0_2_ "IUPR diagnoses inhibition matrix (rows : IUPR ; columns : all diag)" VALUE 0xa002b772 _REC_S1VAL_20_u1 255. _CNV_A_R_ECME_LINEA_0_CM 0. 255. DISPLAY_IDENTIFIER Cmx_obd_iupr_dsb_cfm[0][2] FORMAT "%3.0" /end CHARACTERISTIC
/begin CHARACTERISTIC Cmx_obd_iupr_dsb_cfm_0_3_ "IUPR diagnoses inhibition matrix (rows : IUPR ; columns : all diag)" VALUE 0xa002b773 _REC_S1VAL_20_u1 255. _CNV_A_R_ECME_LINEA_0_CM 0. 255. DISPLAY_IDENTIFIER Cmx_obd_iupr_dsb_cfm[0][3] FORMAT "%3.0" /end CHARACTERISTIC
/begin CHARACTERISTIC Cmx_obd_iupr_dsb_cfm_0_4_ "IUPR diagnoses inhibition matrix (rows : IUPR ; columns : all diag)" VALUE 0xa002b774 _REC_S1VAL_20_u1 255. _CNV_A_R_ECME_LINEA_0_CM 0. 255. DISPLAY_IDENTIFIER Cmx_obd_iupr_dsb_cfm[0][4] FORMAT "%3.0" /end CHARACTERISTIC
/begin CHARACTERISTIC Cmx_obd_iupr_dsb_cfm_0_5_ "IUPR diagnoses inhibition matrix (rows : IUPR ; columns : all diag)" VALUE 0xa002b775 _REC_S1VAL_20_u1 255. _CNV_A_R_ECME_LINEA_0_CM 0. 255. DISPLAY_IDENTIFIER Cmx_obd_iupr_dsb_cfm[0][5] FORMAT "%3.0" /end CHARACTERISTIC
/begin CHARACTERISTIC Cmx_obd_iupr_dsb_cfm_0_6_ "IUPR diagnoses inhibition matrix (rows : IUPR ; columns : all diag)" VALUE 0xa002b776 _REC_S1VAL_20_u1 255. _CNV_A_R_ECME_LINEA_0_CM 0. 255. DISPLAY_IDENTIFIER Cmx_obd_iupr_dsb_cfm[0][6] FORMAT "%3.0" /end CHARACTERISTIC
/begin CHARACTERISTIC Cmx_obd_iupr_dsb_cfm_0_7_ "IUPR diagnoses inhibition matrix (rows : IUPR ; columns : all diag)" VALUE 0xa002b777 _REC_S1VAL_20_u1 255. _CNV_A_R_ECME_LINEA_0_CM 0. 255. DISPLAY_IDENTIFIER Cmx_obd_iupr_dsb_cfm[0][7] FORMAT "%3.0" /end CHARACTERISTIC
/begin CHARACTERISTIC Cmx_obd_iupr_dsb_cfm_0_8_ "IUPR diagnoses inhibition matrix (rows : IUPR ; columns : all diag)" VALUE 0xa002b778 _REC_S1VAL_20_u1 255. _CNV_A_R_ECME_LINEA_0_CM 0. 255. DISPLAY_IDENTIFIER Cmx_obd_iupr_dsb_cfm[0][8] FORMAT "%3.0" /end CHARACTERISTIC
/begin CHARACTERISTIC Cmx_obd_iupr_dsb_cfm_0_9_ "IUPR diagnoses inhibition matrix (rows : IUPR ; columns : all diag)" VALUE 0xa002b779 _REC_S1VAL_20_u1 255. _CNV_A_R_ECME_LINEA_0_CM 0. 255. DISPLAY_IDENTIFIER Cmx_obd_iupr_dsb_cfm[0][9] FORMAT "%3.0" /end CHARACTERISTIC
/begin CHARACTERISTIC Cmx_obd_iupr_dsb_cfm_0_10_ "IUPR diagnoses inhibition matrix (rows : IUPR ; columns : all diag)" VALUE 0xa002b77a _REC_S1VAL_20_u1 255. _CNV_A_R_ECME_LINEA_0_CM 0. 255. DISPLAY_IDENTIFIER Cmx_obd_iupr_dsb_cfm[0][10] FORMAT "%3.0" /end CHARACTERISTIC
/begin CHARACTERISTIC Cmx_obd_iupr_dsb_cfm_0_11_ "IUPR diagnoses inhibition matrix (rows : IUPR ; columns : all diag)" VALUE 0xa002b77b _REC_S1VAL_20_u1 255. _CNV_A_R_ECME_LINEA_0_CM 0. 255. DISPLAY_IDENTIFIER Cmx_obd_iupr_dsb_cfm[0][11] FORMAT "%3.0" /end CHARACTERISTIC
/begin CHARACTERISTIC Cmx_obd_iupr_dsb_cfm_0_12_ "IUPR diagnoses inhibition matrix (rows : IUPR ; columns : all diag)" VALUE 0xa002b77c _REC_S1VAL_20_u1 255. _CNV_A_R_ECME_LINEA_0_CM 0. 255. DISPLAY_IDENTIFIER Cmx_obd_iupr_dsb_cfm[0][12] FORMAT "%3.0" /end CHARACTERISTIC
/begin CHARACTERISTIC Cmx_obd_iupr_dsb_cfm_0_13_ "IUPR diagnoses inhibition matrix (rows : IUPR ; columns : all diag)" VALUE 0xa002b77d _REC_S1VAL_20_u1 255. _CNV_A_R_ECME_LINEA_0_CM 0. 255. DISPLAY_IDENTIFIER Cmx_obd_iupr_dsb_cfm[0][13] FORMAT "%3.0" /end CHARACTERISTIC
/begin CHARACTERISTIC Cmx_obd_iupr_dsb_cfm_0_14_ "IUPR diagnoses inhibition matrix (rows : IUPR ; columns : all diag)" VALUE 0xa002b77e _REC_S1VAL_20_u1 255. _CNV_A_R_ECME_LINEA_0_CM 0. 255. DISPLAY_IDENTIFIER Cmx_obd_iupr_dsb_cfm[0][14] FORMAT "%3.0" /end CHARACTERISTIC
/begin CHARACTERISTIC Cmx_obd_iupr_dsb_cfm_0_15_ "IUPR diagnoses inhibition matrix (rows : IUPR ; columns : all diag)" VALUE 0xa002b77f _REC_S1VAL_20_u1 255. _CNV_A_R_ECME_LINEA_0_CM 0. 255. DISPLAY_IDENTIFIER Cmx_obd_iupr_dsb_cfm[0][15] FORMAT "%3.0" /end CHARACTERISTIC
/begin CHARACTERISTIC Cmx_obd_iupr_dsb_cfm_0_16_ "IUPR diagnoses inhibition matrix (rows : IUPR ; columns : all diag)" VALUE 0xa002b780 _REC_S1VAL_20_u1 255. _CNV_A_R_ECME_LINEA_0_CM 0. 255. DISPLAY_IDENTIFIER Cmx_obd_iupr_dsb_cfm[0][16] FORMAT "%3.0" /end CHARACTERISTIC
/begin CHARACTERISTIC Cmx_obd_iupr_dsb_cfm_0_17_ "IUPR diagnoses inhibition matrix (rows : IUPR ; columns : all diag)" VALUE 0xa002b781 _REC_S1VAL_20_u1 255. _CNV_A_R_ECME_LINEA_0_CM 0. 255. DISPLAY_IDENTIFIER Cmx_obd_iupr_dsb_cfm[0][17] FORMAT "%3.0" /end CHARACTERISTIC
/begin CHARACTERISTIC Cmx_obd_iupr_dsb_cfm_0_18_ "IUPR diagnoses inhibition matrix (rows : IUPR ; columns : all diag)" VALUE 0xa002b782 _REC_S1VAL_20_u1 255. _CNV_A_R_ECME_LINEA_0_CM 0. 255. DISPLAY_IDENTIFIER Cmx_obd_iupr_dsb_cfm[0][18] FORMAT "%3.0" /end CHARACTERISTIC
/begin CHARACTERISTIC Cmx_obd_iupr_dsb_cfm_0_19_ "IUPR diagnoses inhibition matrix (rows : IUPR ; columns : all diag)" VALUE 0xa002b783 _REC_S1VAL_20_u1 255. _CNV_A_R_ECME_LINEA_0_CM 0. 255. DISPLAY_IDENTIFIER Cmx_obd_iupr_dsb_cfm[0][19] FORMAT "%3.0" /end CHARACTERISTIC
/begin CHARACTERISTIC Cmx_obd_iupr_dsb_cfm_0_20_ "IUPR diagnoses inhibition matrix (rows : IUPR ; columns : all diag)" VALUE 0xa002b784 _REC_S1VAL_20_u1 255. _CNV_A_R_ECME_LINEA_0_CM 0. 255. DISPLAY_IDENTIFIER Cmx_obd_iupr_dsb_cfm[0][20] FORMAT "%3.0" /end CHARACTERISTIC
/begin CHARACTERISTIC Cmx_obd_iupr_dsb_cfm_0_21_ "IUPR diagnoses inhibition matrix (rows : IUPR ; columns : all diag)" VALUE 0xa002b785 _REC_S1VAL_20_u1 255. _CNV_A_R_ECME_LINEA_0_CM 0. 255. DISPLAY_IDENTIFIER Cmx_obd_iupr_dsb_cfm[0][21] FORMAT "%3.0" /end CHARACTERISTIC
/begin CHARACTERISTIC Cmx_obd_iupr_dsb_cfm_0_22_ "IUPR diagnoses inhibition matrix (rows : IUPR ; columns : all diag)" VALUE 0xa002b786 _REC_S1VAL_20_u1 255. _CNV_A_R_ECME_LINEA_0_CM 0. 255. DISPLAY_IDENTIFIER Cmx_obd_iupr_dsb_cfm[0][22] FORMAT "%3.0" /end CHARACTERISTIC
/begin CHARACTERISTIC Cmx_obd_iupr_dsb_cfm_0_23_ "IUPR diagnoses inhibition matrix (rows : IUPR ; columns : all diag)" VALUE 0xa002b787 _REC_S1VAL_20_u1 255. _CNV_A_R_ECME_LINEA_0_CM 0. 255. DISPLAY_IDENTIFIER Cmx_obd_iupr_dsb_cfm[0][23] FORMAT "%3.0" /end CHARACTERISTIC
/begin CHARACTERISTIC Cmx_obd_iupr_dsb_cfm_0_24_ "IUPR diagnoses inhibition matrix (rows : IUPR ; columns : all diag)" VALUE 0xa002b788 _REC_S1VAL_20_u1 255. _CNV_A_R_ECME_LINEA_0_CM 0. 255. DISPLAY_IDENTIFIER Cmx_obd_iupr_dsb_cfm[0][24] FORMAT "%3.0" /end CHARACTERISTIC
/begin CHARACTERISTIC Cmx_obd_iupr_dsb_cfm_0_25_ "IUPR diagnoses inhibition matrix (rows : IUPR ; columns : all diag)" VALUE 0xa002b789 _REC_S1VAL_20_u1 255. _CNV_A_R_ECME_LINEA_0_CM 0. 255. DISPLAY_IDENTIFIER Cmx_obd_iupr_dsb_cfm[0][25] FORMAT "%3.0" /end CHARACTERISTIC
/begin CHARACTERISTIC Cmx_obd_iupr_dsb_cfm_0_26_ "IUPR diagnoses inhibition matrix (rows : IUPR ; columns : all diag)" VALUE 0xa002b78a _REC_S1VAL_20_u1 255. _CNV_A_R_ECME_LINEA_0_CM 0. 255. DISPLAY_IDENTIFIER Cmx_obd_iupr_dsb_cfm[0][26] FORMAT "%3.0" /end CHARACTERISTIC
/begin CHARACTERISTIC Ctx_obd_iupr_ind_cfm[0] "IUPR diagnoses identifier table" VALUE 0xa002115c _REC_S1VAL_20_u2 65535. _CNV_A_R_ECME_LINEA_0_CM 0. 65535. FORMAT "%5.0" /end CHARACTERISTIC
/begin CHARACTERISTIC Cxx_dyn_thd "a_dg_dft_mng_failmgt/Dynamic storage capacity or dynamic failure structures index maximum value" VALUE 0xa002116a _REC_S1VAL_20_u1 9. _CNV_A_R_ECME_LINEA_0_CM 0. 9. FORMAT "%1.0" /end CHARACTERISTIC
/begin CHARACTERISTIC Cxx_obd_dc_off "Number of consecutive driving cycles without failure to switch off the MI" VALUE 0xa002116b _REC_S1VAL_20_u1 9. _CNV_A_R_ECME_LINEA_0_CM 1. 10. FORMAT "%2.0" /end CHARACTERISTIC
/begin CHARACTERISTIC Cxx_obd_iupr_den_vs_thd_1 "Vehicle speed threshold for 2nd general denominator condition" VALUE 0xa002115e _REC_S1VAL_20_u2 655.35 _CNV_A_R_LINEAR_____125_CM 0. 655.35 FORMAT "%6.2" /end CHARACTERISTIC
/begin CHARACTERISTIC Cxx_obd_iupr_den_vs_thd_2 "Vehicle speed threshold for 3rd general denominator condition" VALUE 0xa0021160 _REC_S1VAL_20_u2 655.35 _CNV_A_R_LINEAR_____125_CM 0. 655.35 FORMAT "%6.2" /end CHARACTERISTIC
/begin CHARACTERISTIC Cxx_obd_iupr_min_dist_thd "Traveled vehicle distance since last incrementation threshold" VALUE 0xa0021162 _REC_S1VAL_20_u4 16777215. _CNV_A_R_LINEAR_____274_CM 0. 16777215. FORMAT "%10.0" /end CHARACTERISTIC
/begin CHARACTERISTIC Cxx_obd_wup_thd "Number of consecutive warm-up cycles without failure to restore an OBD memorised failure" VALUE 0xa002116c _REC_S1VAL_20_u1 255. _CNV_A_R_ECME_LINEA_0_CM 0. 255. FORMAT "%3.0" /end CHARACTERISTIC
/begin CHARACTERISTIC Cxx_wup_dif_thd_tco "Minimum engine coolant temperature rising required to validate a warm-up cycle" VALUE 0xa0021166 _REC_S1VAL_20_u2 240. _CNV_A_R_LINEAR_____110_CM -40. 200. FORMAT "%5.1" /end CHARACTERISTIC
/begin CHARACTERISTIC Cxx_wup_thd_tco "Minimum engine coolant temperature required to validate a warm up cycle" VALUE 0xa0021168 _REC_S1VAL_20_u2 240. _CNV_A_R_LINEAR_____110_CM -40. 200. FORMAT "%5.1" /end CHARACTERISTIC
/begin MEASUREMENT Vxx_capture_all_nr "Current number of DTC matching the StatusMask by RSA_API_CaptureAllDTCStatus function call" UWORD _CNV_A_R_ECME_LINEA_0_CM 1 0. 0. 65535. ECU_ADDRESS 0xd0005e58 FORMAT "%5.0" /end MEASUREMENT
/begin MEASUREMENT Vxx_capture_all_pres_iter "Current last index updated by RSA_API_CaptureAllDTCStatus function" UWORD _CNV_A_R_ECME_LINEA_0_CM 1 0. 0. 65535. ECU_ADDRESS 0xd0005e5a FORMAT "%5.0" /end MEASUREMENT
/begin MEASUREMENT Vxx_capture_obd_nr "Current number of DTC matching the StatusMask by RSA_API_CaptureAllOBDDTCStatus function call" UWORD _CNV_A_R_ECME_LINEA_0_CM 1 0. 0. 65535. ECU_ADDRESS 0xd0005e5c FORMAT "%5.0" /end MEASUREMENT
/begin MEASUREMENT Vxx_capture_obd_pres_iter "Current last index updated by RSA_API_CaptureAllOBDDTCStatus function" UWORD _CNV_A_R_ECME_LINEA_0_CM 1 0. 0. 65535. ECU_ADDRESS 0xd0005e5e FORMAT "%5.0" /end MEASUREMENT
/begin MEASUREMENT Vxx_get_ind_pres_iter "Current last index scaned by RSA_API_GetIDXByDTC function" UWORD _CNV_A_R_ECME_LINEA_0_CM 1 0. 0. 65535. ECU_ADDRESS 0xd0005e60 FORMAT "%5.0" /end MEASUREMENT
/begin CHARACTERISTIC Ntx_data_avl_list[0] "List of supported extended data number" VALUE 0xa002117c _REC_S1VAL_20_u1 9. _CNV_A_R_ECME_LINEA_0_CM 128. 137. READ_ONLY FORMAT "%3.0" /end CHARACTERISTIC
/begin CHARACTERISTIC Ntx_data_avl_list[1] "List of supported extended data number" VALUE 0xa002117d _REC_S1VAL_20_u1 9. _CNV_A_R_ECME_LINEA_0_CM 128. 137. READ_ONLY FORMAT "%3.0" /end CHARACTERISTIC
/begin CHARACTERISTIC Ntx_data_avl_list[2] "List of supported extended data number" VALUE 0xa002117e _REC_S1VAL_20_u1 9. _CNV_A_R_ECME_LINEA_0_CM 128. 137. READ_ONLY FORMAT "%3.0" /end CHARACTERISTIC
/begin CHARACTERISTIC Ntx_data_avl_list[3] "List of supported extended data number" VALUE 0xa002117f _REC_S1VAL_20_u1 9. _CNV_A_R_ECME_LINEA_0_CM 128. 137. READ_ONLY FORMAT "%3.0" /end CHARACTERISTIC
/begin CHARACTERISTIC Ntx_data_avl_list[4] "List of supported extended data number" VALUE 0xa0021180 _REC_S1VAL_20_u1 9. _CNV_A_R_ECME_LINEA_0_CM 128. 137. READ_ONLY FORMAT "%3.0" /end CHARACTERISTIC
/begin CHARACTERISTIC Ntx_data_avl_list[5] "List of supported extended data number" VALUE 0xa0021181 _REC_S1VAL_20_u1 9. _CNV_A_R_ECME_LINEA_0_CM 128. 137. READ_ONLY FORMAT "%3.0" /end CHARACTERISTIC
/begin CHARACTERISTIC Ntx_data_avl_list[6] "List of supported extended data number" VALUE 0xa0021182 _REC_S1VAL_20_u1 9. _CNV_A_R_ECME_LINEA_0_CM 128. 137. READ_ONLY FORMAT "%3.0" /end CHARACTERISTIC
/begin CHARACTERISTIC Ntx_frm_avl_list[0] "List of supported snapshot number" VALUE 0xa0021184 _REC_S1VAL_20_u1 3. _CNV_A_R_ECME_LINEA_0_CM 1. 4. READ_ONLY FORMAT "%3.0" /end CHARACTERISTIC
/begin CHARACTERISTIC Ntx_frm_avl_list[1] "List of supported snapshot number" VALUE 0xa0021185 _REC_S1VAL_20_u1 3. _CNV_A_R_ECME_LINEA_0_CM 1. 4. READ_ONLY FORMAT "%3.0" /end CHARACTERISTIC
/begin CHARACTERISTIC Ntx_frm_avl_list[2] "List of supported snapshot number" VALUE 0xa0021186 _REC_S1VAL_20_u1 3. _CNV_A_R_ECME_LINEA_0_CM 1. 4. READ_ONLY FORMAT "%3.0" /end CHARACTERISTIC
/begin CHARACTERISTIC Ntx_frm_avl_list[3] "List of supported snapshot number" VALUE 0xa0021187 _REC_S1VAL_20_u1 3. _CNV_A_R_ECME_LINEA_0_CM 1. 4. READ_ONLY FORMAT "%3.0" /end CHARACTERISTIC
/begin COMPU_METHOD _CNV_A_R_ECME_LINEA_0_CM "" RAT_FUNC "%6.3" "-" COEFFS 0 1. 0. 0 0 1 /end COMPU_METHOD
/begin COMPU_METHOD _CNV_S_2_RANGE______3_CM "" TAB_VERB "%6.3" "-" COMPU_TAB_REF _CNV_S_2_RANGE______3 /end COMPU_METHOD
/begin COMPU_VTAB _CNV_S_2_RANGE______3 "" TAB_VERB 2 0 "0" 1 "1" /end COMPU_VTAB
/begin COMPU_METHOD _CNV_A_R_ENSD_LINEA_22_CM "" RAT_FUNC "%6.3" "rpm" COEFFS 0 4. 0. 0 0 1 /end COMPU_METHOD
/begin COMPU_METHOD _CNV_A_R_A_105_CM "" RAT_FUNC "%6.3" "" COEFFS 0 1. 0. 0 0 1 /end COMPU_METHOD
/begin COMPU_METHOD _CNV_A_R_LINEAR_____110_CM "" RAT_FUNC "%6.3" "°C" COEFFS 0 10. 400. 0 0 1 /end COMPU_METHOD
/begin COMPU_METHOD _CNV_A_R_LINEAR_____125_CM "" RAT_FUNC "%6.3" "km/h" COEFFS 0 100. 0. 0 0 1 /end COMPU_METHOD
/begin COMPU_METHOD _CNV_A_R_LINEAR_____165_CM "" RAT_FUNC "%6.3" "%" COEFFS 0 2.55 0. 0 0 1 /end COMPU_METHOD
/begin COMPU_METHOD _CNV_A_R_LINEAR_____205_CM "" RAT_FUNC "%6.3" "V" COEFFS 0 100. 0. 0 0 1 /end COMPU_METHOD
/begin COMPU_METHOD _CNV_A_R_LINEAR_____216_CM "" RAT_FUNC "%6.3" "Nm" COEFFS 0 32. 12800. 0 0 1 /end COMPU_METHOD
/begin COMPU_METHOD _CNV_A_R_LINEAR_____274_CM "" RAT_FUNC "%6.3" "km" COEFFS 0 1. 0. 0 0 1 /end COMPU_METHOD
/begin COMPU_METHOD _CNV_S_702_FM_RANGE_D_276_CM "" TAB_VERB "%6.3" "" COMPU_TAB_REF _CNV_S_702_FM_RANGE_D_276 /end COMPU_METHOD
/begin COMPU_VTAB _CNV_S_702_FM_RANGE_D_276 "" TAB_VERB 702 0 "NO_ERROR" 1 "ac_prs_h" 2 "ac_prs_l" 3 "acel_pdl_chr" 4 "acel_pdl_secu_1" 5 "acel_pdl_secu_2" 6 "acel_pdl_tot" 7 "acel_pdl_v1_h" 8 "acel_pdl_v1_l" 9 "acel_pdl_v2_h" 10 "acel_pdl_v2_l" 11 "actr_rly_oc" 12 "actr_rly_scg" 13 "actr_rly_scw" 14 "agb_data_chr" 15 "agb_data_seq_ctr" 16 "agb_data_tout" 17 "agb_no_frm" 18 "cata_dirt_lkg" 19 "cata_nok_cge" 20 "cata1_dirt_lkg" 21 "cata2_dirt_lkg" 22 "clu_cnt_nok" 23 "comb_trs_tout" 24 "doc1_utp_chr" 25 "doc1_utp_h" 26 "doc1_utp_l" 27 "doc2_utp_chr" 28 "doc2_utp_h" 29 "doc2_utp_l" 30 "doc2_utp_neg_dev" 31 "doc2_utp_pos_dev" 32 "efi_inj_oc" 33 "efi_inj_scg" 34 "efi_inj_scw" 35 "efi_pump_oc" 36 "efi_pump_scg" 37 "efi_pump_scw" 38 "egr_byp_oc" 39 "egr_byp_scg" 40 "egr_byp_scw" 41 "emtv_flow_meca" 42 "emtv_hbdg_el" 43 "emtv_hbdg_ovh" 44 "emtv_ofs_no_norm" 45 "emtv_reg_blk" 46 "emtv_reg_blk_open" 47 "emtv_reg_dirt" 48 "esp_data_chr" 49 "esp_data_seq_ctr" 50 "esp_no_frm" 51 "ex_prs_no_lk" 52 "ex_prs_nok" 53 "exh_temp_cmp" 54 "gas_pump_oc" 55 "gas_pump_scg" 56 "gas_pump_scw" 57 "glow_cmd_oc" 58 "glow_cmd_scg" 59 "glow_cmd_scw" 60 "igc_1_4_oc" 61 "igc_1_4_scg" 62 "igc_1_4_scw" 63 "igc_2_3_oc" 64 "igc_2_3_scg" 65 "igc_2_3_scw" 66 "in_vvtc_blk" 67 "in_vvtc_dirt_lkg" 68 "in_vvtc_sldv_oc" 69 "in_vvtc_sldv_scg" 70 "in_vvtc_sldv_scw" 71 "inj_ecu_lbdw_icp" 72 "inj_ecu_lbup_icp" 73 "inj1_oc" 74 "inj1_scg" 75 "inj1_scw" 76 "inj2_oc" 77 "inj2_scg" 78 "inj2_scw" 79 "inj3_oc" 80 "inj3_scg" 81 "inj3_scw" 82 "inj4_oc" 83 "inj4_scg" 84 "inj4_scw" 85 "it_cmd_el" 86 "it_hbdg_el" 87 "it_hbdg_ovh" 88 "it_ofs_meca" 89 "it_ofs_no_norm" 90 "it_ofs_secu_nok" 91 "it_reg_blk" 92 "it_reg_blk_clos" 93 "it_reg_blk_open" 94 "it_reg_dirt" 95 "knk_oor" 96 "knk_shp" 97 "lbdw_oc" 98 "lbdw_scg" 99 "lbdw_scw" 100 "lbup_oc" 101 "lbup_scg" 102 "lbup_scw" 103 "maf_reg_neg_err" 104 "mafs_plau_diag_h" 105 "mafs_plau_diag_l" 106 "oil_dil_ovs" 107 "pft_dirt" 108 "pft_dirt_lkg" 109 "pft_dp_chr" 110 "pft_dp_dirt_lkg" 111 "pft_dtp_chr" 112 "pft_dtp_h" 113 "pft_dtp_l" 114 "pft_dtp_ovh" 115 "pft_no_lk" 116 "pft_rgn_max_err" 117 "pft_utp_chr" 118 "pft_utp_h" 119 "pft_utp_l" 120 "pft_utp_neg_err" 121 "pft_utp_ovh" 122 "pft_utp_pos_err" 123 "pftrelprs_chr" 124 "pftrelprs_dirt_lkg" 125 "ps_toil_max_h_t" 126 "ps_toil_max_l_t" 127 "ps_toil_min_h_t" 128 "ps_toil_min_l_t" 129 "ps_toil_sig_nok" 130 "psoilprty_max_h_t" 131 "psoilprty_max_l_t" 132 "psoilprty_min_h_t" 133 "psoilprty_min_l_t" 134 "psoilprty_sig_nok" 135 "psoilvisc_max_h_t" 136 "psoilvisc_max_l_t" 137 "psoilvisc_min_h_t" 138 "psoilvisc_min_l_t" 139 "psoilvisc_sig_nok" 140 "pws_1_h" 141 "pws_1_l" 142 "pws_2_h" 143 "pws_2_l" 144 "pws_3_h" 145 "pws_3_l" 146 "sens_amp_h" 147 "sens_amp_l" 148 "sens_amp_reg_chr" 149 "sens_emtv_nok" 150 "sens_ex_prs_h" 151 "sens_ex_prs_l" 152 "sens_it_1_nok" 153 "sens_it_2_nok" 154 "sens_it_chr" 155 "sens_it_nok" 156 "sens_it_sig_mcut" 157 "sens_maf_h" 158 "sens_maf_l" 159 "sens_map_h" 160 "sens_map_l" 161 "sens_map_nok" 162 "sens_map_oc" 163 "sens_map_scg" 164 "sens_map_scw" 165 "sens_pft_dp_h" 166 "sens_pft_dp_l" 167 "sens_pft_dp_oor" 168 "sens_pftrelprs_h" 169 "sens_pftrelprs_l" 170 "sens_pftrelprs_oor" 171 "sens_spg_h" 172 "sens_spg_l" 173 "sens_spg_nok" 174 "sens_spg_oc" 175 "sens_spg_scg" 176 "sens_spg_scw" 177 "sens_tco_h" 178 "sens_tco_l" 179 "sens_tia_h" 180 "sens_tia_l" 181 "sens_toil_h" 182 "sens_toil_l" 183 "sens_up_it_temp_h" 184 "sens_up_it_temp_l" 185 "spg_reg_apl_down" 186 "spg_reg_apl_up" 187 "spg_reg_neg_err" 188 "spg_reg_pos_err" 189 "tbt_chr" 190 "tbt_h" 191 "tbt_l" 192 "tbt_reg_neg_err" 193 "tbt_reg_pos_err" 194 "thpl_cmd1_oc" 195 "thpl_cmd1_scg" 196 "thpl_cmd1_scw" 197 "thpl_cmd2_oc" 198 "thpl_cmd2_scg" 199 "thpl_cmd2_scw" 200 "thpl_cmd3_oc" 201 "thpl_cmd3_scg" 202 "thpl_cmd3_scw" 203 "vb_h" 204 "vb_l" 205 "vb_rly_oc_scg" 206 "vb_rly_scw" 207 "vnt_oc" 208 "vnt_scg" 209 "vnt_scw" 210 "cp_oc" 211 "cp_scg" 212 "cp_scw" 213 "sens_mat_h" 214 "sens_mat_l" 215 "egr_cool_dirt_lkg" 216 "fuel_temp_l" 217 "fuel_temp_plaus" 218 "fuel_temp_scg" 219 "fuel_temp_h" 220 "fuel_temp_sig_mcut" 221 "maf_reg_dirt_lkg" 222 "pcv_h" 223 "pcv_oc" 224 "pcv_scg" 225 "pcv_scw" 226 "rail_prs_plaus" 227 "rail_prs_h_lvl" 228 "rail_prs_l" 229 "rail_prs_scg" 230 "rail_prs_h" 231 "rail_prs_sig_mcut" 232 "sens_amp_oc" 233 "sens_amp_scg" 234 "sens_amp_scw" 235 "sens_ex_prs_no_lk" 236 "sens_ex_prs_nok" 237 "sens_maf_oc" 238 "sens_maf_scg" 239 "sens_maf_scw" 240 "sens_tia_oc" 241 "sens_tia_scg" 242 "sens_tia_scw" 243 "vcv_h" 244 "vcv_oc" 245 "vcv_scg" 246 "vcv_scw" 247 "bgin_clu_cmp" 248 "bgin_clu_nok" 249 "brk_pdl_chr" 250 "brk_pdl_clos_nok" 251 "brk_pdl_cmp" 252 "brk_pdl_no_norm" 253 "brk_pdl_open_nok" 254 "cata_cpt" 255 "cru_cmp" 256 "cru_sl_swi_chr" 257 "cru_sl_tot" 258 "cru_vs_cmp" 259 "cru_whl_cmd_nok" 260 "cru_whl_cmd_oc_scw" 261 "cru_whl_cmd_oor" 262 "cyl_bal_1_h_lvl" 263 "cyl_bal_1_l_lvl" 264 "cyl_bal_2_h_lvl" 265 "cyl_bal_2_l_lvl" 266 "cyl_bal_3_h_lvl" 267 "cyl_bal_3_l_lvl" 268 "cyl_bal_4_h_lvl" 269 "cyl_bal_4_l_lvl" 270 "efi_sldv_oc" 271 "efi_sldv_scg" 272 "efi_sldv_scw" 273 "ff_actr_blk_clos" 274 "ff_actr_blk_open" 275 "ff_actr_crt_up" 276 "ff_fct_dirt_lkg" 277 "ff_fct_h_lvl" 278 "ff_fct_l_lvl" 279 "ff_fct_neg_err" 280 "ff_fct_pos_err" 281 "ff_fct_shp" 282 "fprs_actr_blk_clos" 283 "fprs_actr_blk_open" 284 "fprs_actr_crt_up" 285 "fprs_fct_dirt_lkg" 286 "fprs_fct_h_lvl" 287 "fprs_fct_l_lvl" 288 "fprs_fct_neg_err" 289 "fprs_fct_pos_err" 290 "fprs_fct_shp" 291 "fprs_h_oor" 292 "fprs_l_oor" 293 "fsys_cpt" 294 "fsys_lpg_cpt" 295 "inj1_chk_sum" 296 "inj1_crt_intv" 297 "inj1_fast_trs" 298 "inj1_slow_trs" 299 "inj2_chk_sum" 300 "inj2_crt_intv" 301 "inj2_fast_trs" 302 "inj2_slow_trs" 303 "inj3_chk_sum" 304 "inj3_crt_intv" 305 "inj3_fast_trs" 306 "inj3_slow_trs" 307 "inj4_chk_sum" 308 "inj4_crt_intv" 309 "inj4_fast_trs" 310 "inj4_slow_trs" 311 "lbdw_hot_oc" 312 "lbdw_hot_scg" 313 "lbdw_hot_scw" 314 "lbup_hot_oc" 315 "lbup_hot_scg" 316 "lbup_hot_scw" 317 "map_chr" 318 "map_oor" 319 "mis_1_cata" 320 "mis_1_lpg_cata" 321 "mis_1_lpg_trs_h" 322 "mis_1_trs_h" 323 "mis_2_cata" 324 "mis_2_lpg_cata" 325 "mis_2_lpg_trs_h" 326 "mis_2_trs_h" 327 "mis_3_cata" 328 "mis_3_lpg_cata" 329 "mis_3_lpg_trs_h" 330 "mis_3_trs_h" 331 "mis_4_cata" 332 "mis_4_lpg_cata" 333 "mis_4_lpg_trs_h" 334 "mis_4_trs_h" 335 "mis_cata" 336 "mis_lpg_cata" 337 "mis_lpg_trs_h" 338 "mis_min_fuel_cata" 339 "mis_min_fuel_trs_h" 340 "mis_trs_h" 341 "mis_unk_cata" 342 "mis_unk_lpg_cata" 343 "mis_unk_lpg_trs_h" 344 "mis_unk_trs_h" 345 "sens_wfl_h" 346 "sens_wfl_l" 347 "spg_chr" 348 "spg_oor" 349 "tlz_ad_b_cpt" 350 "unk_thpl_chr" 351 "unk_thpl1_chr" 352 "unk_thpl2_chr" 353 "unk_thpl3_chr" 354 "unk_thpl4_chr" 355 "wgc_oc" 356 "wgc_scg" 357 "wgc_scw" 358 "wpmp_tcr_oc" 359 "wpmp_tcr_scg" 360 "wpmp_tcr_scw" 361 "crk_chr" 362 "crk_cyc" 363 "crk_el" 364 "crk_no_norm" 365 "crk_syn" 366 "ex_cam_chr" 367 "ex_cam_crk_cmp" 368 "ex_cam_l_puls" 369 "ex_cam_syn" 370 "in_cam_chr" 371 "in_cam_crk_cmp" 372 "in_cam_frq_h" 373 "in_cam_l_puls" 374 "in_cam_no_sig" 375 "in_cam_syn" 376 "in_vvtc_ad" 377 "it_reg_el" 378 "lbup_cpt" 379 "sens_pftrelprs_lkg" 380 "sens_pftrelprs_nok" 381 "sens_wfl_oc" 382 "ups_crt_intv" 383 "ups_heat_scg" 384 "ups_heat_scw" 385 "ups_hot_chr" 386 "ups_lamb_oc" 387 "ups_lamb_scg" 388 "ups_lamb_scw" 389 "ups_pump_oc" 390 "ups_pump_scg" 391 "ups_pump_scw" 392 "ups_shp" 393 "ups_slow_trs" 394 "ups_trim_oc" 395 "ups_trim_scg" 396 "ups_trim_scw" 397 "ups_virt_scg" 398 "ups_virt_scw" 399 "egr_byp_h" 400 "egr_byp_l" 401 "vnt_h" 402 "vnt_l" 403 "oit_hbdg_el" 404 "oit_hbdg_ovh" 405 "sit_hbdg_el" 406 "sit_hbdg_ovh" 407 "sit_reg_el" 408 "sit_reg_blk" 409 "sit_reg_blk_open" 410 "ff_actr_blk" 411 "fprs_actr_blk" 412 "sens_rup_l" 413 "sens_rup_h" 414 "rup_dirt_lkg" 415 "rup_nok" 416 "sfty_tq_chr" 417 "sfty_tq_clc_chr" 418 "sfty_tq_lih_chr" 419 "ff_actr_crt_down" 420 "fprs_actr_crt_down" 421 "fprs_fct_chr" 422 "tbt_reg_apl_up" 423 "crk_no_sig" 424 "crk_puls" 425 "crk_trs" 426 "ecm_err_itl" 427 "ecm_mon_tron" 428 "glow_cmd_cpt_blk" 429 "glow_cmd_fail" 430 "inj_ecu_itl" 431 "inj1_4_oor" 432 "inj1_freq_l" 433 "inj1_h_lvl" 434 "inj1_h_puls" 435 "inj1_l_lvl" 436 "inj1_l_puls" 437 "inj1_nok" 438 "inj1_r" 439 "inj1_shp" 440 "inj2_3_oor" 441 "inj2_freq_l" 442 "inj2_h_lvl" 443 "inj2_h_puls" 444 "inj2_l_lvl" 445 "inj2_l_puls" 446 "inj2_nok" 447 "inj2_r" 448 "inj2_shp" 449 "inj3_freq_l" 450 "inj3_h_lvl" 451 "inj3_h_puls" 452 "inj3_l_lvl" 453 "inj3_l_puls" 454 "inj3_nok" 455 "inj3_r" 456 "inj3_shp" 457 "inj4_freq_l" 458 "inj4_h_lvl" 459 "inj4_h_puls" 460 "inj4_l_lvl" 461 "inj4_l_puls" 462 "inj4_nok" 463 "inj4_r" 464 "inj4_shp" 465 "ip_lght_tco_ovh" 466 "map_nok" 467 "ptc_rov_oc" 468 "ptc_rov_scg" 469 "ptc_rov_scw" 470 "sens_alt_pwm_h" 471 "sens_alt_pwm_l" 472 "sfty_tq_lim" 473 "spg_nok" 474 "tbf_fct_apl_down" 475 "tbf_fct_apl_up" 476 "in_cam_nok" 477 "in_cam_cyc" 478 "crk_cmp" 479 "crk_shp" 480 "crk_oc" 481 "inj_oor" 482 "ecm_inj_bus_mcut" 483 "ecm_inj_ini" 484 "ecm_inj_oor" 485 "cl_rich_chr" 486 "ecm_mon_secu_1" 487 "ecm_mon_secu_2" 488 "ecm_adc_tron" 489 "wpmp_egr_oc" 490 "wpmp_egr_scg" 491 "wpmp_egr_scw" 492 "mdf1_oc" 493 "mdf1_scg" 494 "mdf1_scw" 495 "mdf2_oc" 496 "mdf2_scg" 497 "mdf2_scw" 498 "pft_nok_cge" 499 "tqi_cor_chr" 500 "fsys_apl_down" 501 "fsys_apl_up" 502 "fsys_h_lvl" 503 "ff_fct_chr" 504 "ff_fct_no_norm" 505 "ecm_inj_h" 506 "ecm_inj_l" 507 "ecm_inj_cpt_blk" 508 "ecm_it_nok" 509 "ecm_inj_no_norm" 510 "ecm_err_no_norm" 511 "ecm_inj_cmp" 512 "ecm_mcw_clc_chr" 513 "ecm_mcw_nok" 514 "ecm_mcw_seq_ctr" 515 "amp_reg_chr" 516 "ups_ro2_oor" 517 "ups_ro2_slow_trs" 518 "ups_tip_oor" 519 "sens_tco_sig_mcut" 520 "igc_1_oc" 521 "alt_pwm_apl_down" 522 "igc_1_scg" 523 "igc_1_scw" 524 "igc_2_oc" 525 "inj_cpt_blk" 526 "inj1_frq_l" 527 "inj2_frq_l" 528 "inj3_frq_l" 529 "inj4_frq_l" 530 "ff_actr_ovh" 531 "fprs_actr_ovh" 532 "ac_clu_oc" 533 "ac_clu_scg" 534 "ac_clu_scw" 535 "sfty_tq_supl" 536 "ups_uo2_oor" 537 "ups_ecu_oor" 538 "ups_ecu_itl" 539 "ups_ecu_chr" 540 "sens_ups_wire_scw" 541 "sens_ups_wire_oc" 542 "sens_ups_virt_oc" 543 "sens_ups_pump_oc" 544 "sens_ups_lamb_oc" 545 "sens_ups_heat_oc" 546 "sens_ups_heat_ovh" 547 "sens_ups_heat_scg" 548 "sens_ups_heat_scw" 549 "ecm_it_lih_chr" 550 "sens_ups_wire_scg" 551 "wpmp_tcr_blk" 552 "ecm_temp_nok" 553 "cp_blk_open" 554 "evap_chr" 555 "eva_fcap_abn_cple" 556 "eva_fcap_no_lk" 557 "evap_lkg" 558 "eva_sldv_blk_clos" 559 "eva_sldv_oc" 560 "eva_sldv_scg" 561 "eva_sldv_scw" 562 "sens_rvc_h" 563 "sens_rvc_l" 564 "sens_rvc_nok" 565 "sens_rvc_sig_mcut" 566 "lbup_nok" 567 "lbup_hot_apl_down" 568 "igc_2_scg" 569 "igc_2_scw" 570 "igc_3_oc" 571 "igc_3_scg" 572 "igc_3_scw" 573 "igc_4_oc" 574 "igc_4_scg" 575 "igc_4_scw" 576 "egr_byp_blk" 577 "isr_h_lvl" 578 "isr_l_lvl" 579 "sfty_tq_fail" 580 "vb_clc_chr" 581 "lbdw_hot_dirt_lkg" 582 "lbup_hot_dirt_lkg" 583 "spg_cmd_blk_clos" 584 "sens_egr_temp_h" 585 "sens_egr_temp_l" 586 "tco_cl_no_norm" 587 "tsta_reg_no_norm" 588 "dps_ecu_chr" 589 "dps_ecu_itl" 590 "dps_ecu_oor" 591 "dps_ro2_oor" 592 "dps_ro2_slow_trs" 593 "dps_tip_oor" 594 "dps_uo2_oor" 595 "sens_dps_heat_oc" 596 "sens_dps_heat_ovh" 597 "sens_dps_heat_scg" 598 "sens_dps_heat_scw" 599 "sens_dps_lamb_oc" 600 "sens_dps_pump_oc" 601 "sens_dps_virt_oc" 602 "sens_dps_wire_scg" 603 "sens_dps_wire_scw" 604 "it_reg_ad" 605 "mafs_apl_down" 606 "mafs_apl_up" 607 "mvac_pump_rly_h" 608 "mvac_pump_rly_l" 609 "mvac_sys_cpt" 610 "oil_dil_nok" 611 "pft_rgn_dirt" 612 "ptc1_oc" 613 "ptc1_scg" 614 "ptc1_scw" 615 "ptc2_oc" 616 "ptc2_scg" 617 "ptc2_scw" 618 "ptc3_oc" 619 "ptc3_scg" 620 "ptc3_scw" 621 "inj_ecu_bus_mcut" 622 "wpmp_egr_2_freq_h" 623 "wpmp_egr_2_freq_l" 624 "wpmp_egr_2_no_sig" 625 "wpmp_egr_2_oc" 626 "wpmp_egr_2_scg" 627 "wpmp_egr_2_scw" 628 "wpmp_egr_freq_h" 629 "wpmp_egr_freq_l" 630 "wpmp_egr_no_sig" 631 "wpmp_egr_2_frq_h" 632 "wpmp_egr_2_frq_l" 633 "wpmp_egr_frq_h" 634 "wpmp_egr_frq_l" 635 "efi_sldv_2_oc" 636 "efi_sldv_2_scg" 637 "efi_sldv_2_scw" 638 "et_hbdg_el" 639 "et_hbdg_ovh" 640 "et_ofs_no_norm" 641 "et_reg_blk" 642 "et_reg_blk_clos" 643 "et_reg_blk_open" 644 "et_reg_dirt" 645 "fuel_csm_h" 646 "fuel_csm_l" 647 "fuel_lvl_h" 648 "fuel_lvl_l" 649 "gas_pump_2_oc" 650 "gas_pump_2_scg" 651 "gas_pump_2_scw" 652 "lpev_flow_meca" 653 "lpev_hbdg_el" 654 "lpev_hbdg_ovh" 655 "lpev_ofs_no_norm" 656 "lpev_reg_blk" 657 "lpev_reg_blk_open" 658 "lpev_reg_dirt" 659 "sens_et_nok" 660 "sens_lpev_nok" 661 "sens_vs_chr" 662 "sens_vs_h_puls" 663 "sens_vs_l_puls" 664 "fuel_csm_oc" 665 "fuel_csm_scg" 666 "fuel_csm_scw" 667 "etc_chr" 668 "etc_no_frm" 669 "etc_seq_ctr" 670 "sens_swrl_nok" 671 "swrl_hbdg_el" 672 "swrl_hbdg_ovh" 673 "swrl_ofs_no_norm" 674 "swrl_reg_blk_clos" 675 "swrl_reg_blk_open" 676 "swrl_reg_dirt" 677 "ecm_pws_oor" 678 "fco_vlv_oc" 679 "fco_vlv_scg" 680 "fco_vlv_scw" 681 "gas_slv_oc" 682 "gas_slv_scg" 683 "gas_slv_scw" 684 "lp_egr_cool_dtp_h" 685 "lp_egr_cool_dtp_l" 686 "mil_h" 687 "mil_l" 688 "tbf_mon_ovh" 689 "glow_cmd_ovh" 690 "dps_ecu_r" 691 "fuel_pump_oc" 692 "fuel_pump_scg" 693 "gas_sldv_oc" 694 "gas_sldv_scg" 695 "gas_sldv_scw" 696 "hbn_ad_b_cpt" 697 "lbup_shf_h" 698 "lbup_shf_l" 699 "opmp_oc" 700 "opmp_scg" 701 "opmp_scw" /end COMPU_VTAB
/begin COMPU_METHOD _CNV_S_2_RANGE______277_CM "" TAB_VERB "%6.3" "-" COMPU_TAB_REF _CNV_S_2_RANGE______277 /end COMPU_METHOD
/begin COMPU_VTAB _CNV_S_2_RANGE______277 "" TAB_VERB 2 0 "COMPLETE" 1 "NO_COMPLETE" /end COMPU_VTAB
/begin COMPU_METHOD _CNV_A_R_LINEAR_____278_CM "" RAT_FUNC "%6.3" "°C" COEFFS 0 10. 2730. 0 0 1 /end COMPU_METHOD
/begin RECORD_LAYOUT _REC_S1VAL_20_u4 FNC_VALUES 1 ULONG COLUMN_DIR DIRECT /end RECORD_LAYOUT
/begin RECORD_LAYOUT _REC_S1VAL_20_u1 FNC_VALUES 1 UBYTE COLUMN_DIR DIRECT /end RECORD_LAYOUT
/begin RECORD_LAYOUT _REC_S1VAL_20_u2 FNC_VALUES 1 UWORD COLUMN_DIR DIRECT /end RECORD_LAYOUT
/begin FUNCTION DgDftCfg ""
 /begin DEF_CHARACTERISTIC Cxx_dtc_obd_vb_rly_oc_scg Cxx_conf_wal_vb_rly_oc_scg Cbx_obd_vb_rly_oc_scg Cbx_obd_mena_vb_rly_oc_scg Cxx_dtc_lb_vb_rly_oc_scg Cxx_obd_dc_vb_rly_oc_scg Cxx_obd_us_typ_vb_rly_oc_scg Cxx_dtc_obd_vb_rly_scw Cxx_conf_wal_vb_rly_scw Cbx_obd_vb_rly_scw Cbx_obd_mena_vb_rly_scw Cxx_dtc_lb_vb_rly_scw Cxx_obd_dc_vb_rly_scw Cxx_obd_us_typ_vb_rly_scw Cxx_dtc_obd_wgc_oc Cxx_conf_wal_wgc_oc Cbx_obd_wgc_oc Cbx_obd_mena_wgc_oc Cxx_dtc_lb_wgc_oc Cxx_obd_dc_wgc_oc Cxx_obd_us_typ_wgc_oc Cxx_dtc_obd_wgc_scg Cxx_conf_wal_wgc_scg Cbx_obd_wgc_scg Cbx_obd_mena_wgc_scg Cxx_dtc_lb_wgc_scg Cxx_obd_dc_wgc_scg Cxx_obd_us_typ_wgc_scg Cxx_dtc_obd_wgc_scw Cxx_conf_wal_wgc_scw Cbx_obd_wgc_scw Cbx_obd_mena_wgc_scw Cxx_dtc_lb_wgc_scw Cxx_obd_dc_wgc_scw Cxx_obd_us_typ_wgc_scw Cxx_conf_wal_wpmp_tcr_blk Cxx_dtc_lb_wpmp_tcr_blk Cxx_obd_us_typ_wpmp_tcr_blk Cxx_conf_wal_wpmp_tcr_oc Cxx_dtc_lb_wpmp_tcr_oc Cxx_obd_us_typ_wpmp_tcr_oc Cxx_conf_wal_wpmp_tcr_scg Cxx_dtc_lb_wpmp_tcr_scg Cxx_obd_us_typ_wpmp_tcr_scg Cxx_conf_wal_wpmp_tcr_scw Cxx_dtc_lb_wpmp_tcr_scw Cxx_obd_us_typ_wpmp_tcr_scw /end DEF_CHARACTERISTIC
/end FUNCTION
/begin FUNCTION DgDftCfg_Failxxx ""
 /begin OUT_MEASUREMENT Vtx_ind_dyn[0] Vtx_ind_dyn[1] Vtx_ind_dyn[2] Vtx_ind_dyn[3] Vtx_ind_dyn[4] Vtx_ind_dyn[5] Vtx_ind_dyn[6] Vtx_ind_dyn[7] Vtx_ind_dyn[8] Vtx_ind_dyn[9] /end OUT_MEASUREMENT
/end FUNCTION
/begin FUNCTION DgDftMng ""
 /begin OUT_MEASUREMENT Sbx_obd_rdn_cata_cpt Sbx_obd_rdn_lbup_cpt Sbx_obd_rdn_egr Sbx_obd_rdn_cata Sbx_obd_rdn_heat Sbx_obd_rdn_evap Sbx_obd_rdn_egr_vvt Sbx_obd_rdn_fsys Sbx_obd_rdn_heat_cata Sbx_obd_rdn_mis Sbx_obd_rdn_csf Sbx_obd_rdn_nt Sbx_obd_rdn_o2 Sbx_obd_rdn_spg Sbx_obd_rdn_cpt /end OUT_MEASUREMENT
 /begin SUB_FUNCTION DgDftMng_Failmgt DgDftMng_Svcecom DgDftMng_Obdfram DgDftMng_Obdenvx DgDftMng_Obdrdnx /end SUB_FUNCTION
/end FUNCTION
/begin FUNCTION DgDftMng_Failmgt ""
 /begin DEF_CHARACTERISTIC Cmx_obd_iupr_dsb_cfm_0_0_ Cmx_obd_iupr_dsb_cfm_0_1_ Cmx_obd_iupr_dsb_cfm_0_2_ Cmx_obd_iupr_dsb_cfm_0_3_ Cmx_obd_iupr_dsb_cfm_0_4_ Cmx_obd_iupr_dsb_cfm_0_5_ Cmx_obd_iupr_dsb_cfm_0_6_ Cmx_obd_iupr_dsb_cfm_0_7_ Cmx_obd_iupr_dsb_cfm_0_8_ Cmx_obd_iupr_dsb_cfm_0_9_ Cmx_obd_iupr_dsb_cfm_0_10_ Cmx_obd_iupr_dsb_cfm_0_11_ Cmx_obd_iupr_dsb_cfm_0_12_ Cmx_obd_iupr_dsb_cfm_0_13_ Cmx_obd_iupr_dsb_cfm_0_14_ Cmx_obd_iupr_dsb_cfm_0_15_ Cmx_obd_iupr_dsb_cfm_0_16_ Cmx_obd_iupr_dsb_cfm_0_17_ Cmx_obd_iupr_dsb_cfm_0_18_ Cmx_obd_iupr_dsb_cfm_0_19_ Cmx_obd_iupr_dsb_cfm_0_20_ Cmx_obd_iupr_dsb_cfm_0_21_ Cmx_obd_iupr_dsb_cfm_0_22_ Cmx_obd_iupr_dsb_cfm_0_23_ Cmx_obd_iupr_dsb_cfm_0_24_ Cmx_obd_iupr_dsb_cfm_0_25_ Cmx_obd_iupr_dsb_cfm_0_26_ Ctx_obd_iupr_ind_cfm[0] Cxx_dyn_thd Cxx_obd_dc_off Cxx_obd_iupr_den_vs_thd_1 Cxx_obd_iupr_den_vs_thd_2 Cxx_obd_iupr_min_dist_thd Cxx_obd_wup_thd Cxx_wup_dif_thd_tco Cxx_wup_thd_tco /end DEF_CHARACTERISTIC
 /begin OUT_MEASUREMENT Sxx_dist_fail_dyn_0 Sxx_tmp_dist_dyn_0 Sxx_km_cf_dyn_0 Sxx_km_mf_dyn_0 Sxx_km_pass_dyn_0 Sxx_ind_dyn_0 Sxx_ffm_esti_tqe_dyn_0 Sxx_ffm_esti_tqe_min_dyn_0 Sxx_ffm_esti_tqe_max_dyn_0 Sxx_ffm_n_dyn_0 Sxx_ffm_n_min_dyn_0 Sxx_ffm_n_max_dyn_0 Sxx_ffm_tco_dyn_0 Sxx_ffm_tco_min_dyn_0 Sxx_ffm_tco_max_dyn_0 Sxx_ffm_vb_dyn_0 Sxx_ffm_vb_min_dyn_0 Sxx_ffm_vb_max_dyn_0 Sxx_ffm_vs_dyn_0 Sxx_ffm_vs_min_dyn_0 Sxx_ffm_vs_max_dyn_0 Sxx_ffm_did_1_dyn_0 Sxx_ffm_did_2_dyn_0 Sxx_ffm_did_3_dyn_0 Sxx_ffm_did_4_dyn_0 Sxx_ffm_did_5_dyn_0 Sxx_ffm_did_1_max_dyn_0 Sxx_ffm_did_2_max_dyn_0 Sxx_ffm_did_3_max_dyn_0 Sxx_ffm_did_4_max_dyn_0 Sxx_ffm_did_5_max_dyn_0 Sxx_ffm_did_1_min_dyn_0 Sxx_ffm_did_2_min_dyn_0 Sxx_ffm_did_3_min_dyn_0 Sxx_ffm_did_4_min_dyn_0 Sxx_ffm_did_5_min_dyn_0 Sxx_obd_sc_n_dyn_0 Sbx_pfo_dyn_0 Sbx_mfo_dyn_0 Sbx_obd_mreq_dyn_0 Sbx_obd_dc_rdn_dyn_0 Sbx_fail_dc_dyn_0 Sbx_obd_sc_pass_dyn_0 Sbx_obd_sc_wup_stt_dyn_0 Sxx_obd_wctr_dyn_0 Sxx_frq_dyn_0 Sxx_obd_clfctr_dyn_0 Sxx_esd_siz_dyn_0 Sxx_obd_sc_ctr_dyn_0 Sxx_obd_sc_load_dyn_0 Sxx_pri_dyn_0 Sxx_dist_fail_dyn_1 Sxx_tmp_dist_dyn_1 Sxx_km_cf_dyn_1 Sxx_km_mf_dyn_1 Sxx_km_pass_dyn_1 Sxx_ind_dyn_1 Sxx_ffm_esti_tqe_dyn_1 Sxx_ffm_esti_tqe_min_dyn_1 Sxx_ffm_esti_tqe_max_dyn_1 Sxx_ffm_n_dyn_1 Sxx_ffm_n_min_dyn_1 Sxx_ffm_n_max_dyn_1 Sxx_ffm_tco_dyn_1 Sxx_ffm_tco_min_dyn_1 Sxx_ffm_tco_max_dyn_1 Sxx_ffm_vb_dyn_1 Sxx_ffm_vb_min_dyn_1 Sxx_ffm_vb_max_dyn_1 Sxx_ffm_vs_dyn_1 Sxx_ffm_vs_min_dyn_1 Sxx_ffm_vs_max_dyn_1 Sxx_ffm_did_1_dyn_1 Sxx_ffm_did_2_dyn_1 Sxx_ffm_did_3_dyn_1 Sxx_ffm_did_4_dyn_1 Sxx_ffm_did_5_dyn_1 Sxx_ffm_did_1_max_dyn_1 Sxx_ffm_did_2_max_dyn_1 Sxx_ffm_did_3_max_dyn_1 Sxx_ffm_did_4_max_dyn_1 Sxx_ffm_did_5_max_dyn_1 Sxx_ffm_did_1_min_dyn_1 Sxx_ffm_did_2_min_dyn_1 Sxx_ffm_did_3_min_dyn_1 Sxx_ffm_did_4_min_dyn_1 Sxx_ffm_did_5_min_dyn_1 Sxx_obd_sc_n_dyn_1 Sbx_pfo_dyn_1 Sbx_mfo_dyn_1 Sbx_obd_mreq_dyn_1 Sbx_obd_dc_rdn_dyn_1 Sbx_fail_dc_dyn_1 Sbx_obd_sc_pass_dyn_1 Sbx_obd_sc_wup_stt_dyn_1 Sxx_obd_wctr_dyn_1 Sxx_frq_dyn_1 Sxx_obd_clfctr_dyn_1 Sxx_esd_siz_dyn_1 Sxx_obd_sc_ctr_dyn_1 Sxx_obd_sc_load_dyn_1 Sxx_pri_dyn_1 Sxx_dist_fail_dyn_2 Sxx_tmp_dist_dyn_2 Sxx_km_cf_dyn_2 Sxx_km_mf_dyn_2 Sxx_km_pass_dyn_2 Sxx_ind_dyn_2 Sxx_ffm_esti_tqe_dyn_2 Sxx_ffm_esti_tqe_min_dyn_2 Sxx_ffm_esti_tqe_max_dyn_2 Sxx_ffm_n_dyn_2 Sxx_ffm_n_min_dyn_2 Sxx_ffm_n_max_dyn_2 Sxx_ffm_tco_dyn_2 Sxx_ffm_tco_min_dyn_2 Sxx_ffm_tco_max_dyn_2 Sxx_ffm_vb_dyn_2 Sxx_ffm_vb_min_dyn_2 Sxx_ffm_vb_max_dyn_2 Sxx_ffm_vs_dyn_2 Sxx_ffm_vs_min_dyn_2 Sxx_ffm_vs_max_dyn_2 Sxx_ffm_did_1_dyn_2 Sxx_ffm_did_2_dyn_2 Sxx_ffm_did_3_dyn_2 Sxx_ffm_did_4_dyn_2 Sxx_ffm_did_5_dyn_2 Sxx_ffm_did_1_max_dyn_2 Sxx_ffm_did_2_max_dyn_2 Sxx_ffm_did_3_max_dyn_2 Sxx_ffm_did_4_max_dyn_2 Sxx_ffm_did_5_max_dyn_2 Sxx_ffm_did_1_min_dyn_2 Sxx_ffm_did_2_min_dyn_2 Sxx_ffm_did_3_min_dyn_2 Sxx_ffm_did_4_min_dyn_2 Sxx_ffm_did_5_min_dyn_2 Sxx_obd_sc_n_dyn_2 Sbx_pfo_dyn_2 Sbx_mfo_dyn_2 Sbx_obd_mreq_dyn_2 Sbx_obd_dc_rdn_dyn_2 Sbx_fail_dc_dyn_2 Sbx_obd_sc_pass_dyn_2 Sbx_obd_sc_wup_stt_dyn_2 Sxx_obd_wctr_dyn_2 Sxx_frq_dyn_2 Sxx_obd_clfctr_dyn_2 Sxx_esd_siz_dyn_2 Sxx_obd_sc_ctr_dyn_2 Sxx_obd_sc_load_dyn_2 Sxx_pri_dyn_2 Sxx_dist_fail_dyn_3 Sxx_tmp_dist_dyn_3 Sxx_km_cf_dyn_3 Sxx_km_mf_dyn_3 Sxx_km_pass_dyn_3 Sxx_ind_dyn_3 Sxx_ffm_esti_tqe_dyn_3 Sxx_ffm_esti_tqe_min_dyn_3 Sxx_ffm_esti_tqe_max_dyn_3 Sxx_ffm_n_dyn_3 Sxx_ffm_n_min_dyn_3 Sxx_ffm_n_max_dyn_3 Sxx_ffm_tco_dyn_3 Sxx_ffm_tco_min_dyn_3 Sxx_ffm_tco_max_dyn_3 Sxx_ffm_vb_dyn_3 Sxx_ffm_vb_min_dyn_3 Sxx_ffm_vb_max_dyn_3 Sxx_ffm_vs_dyn_3 Sxx_ffm_vs_min_dyn_3 Sxx_ffm_vs_max_dyn_3 Sxx_ffm_did_1_dyn_3 Sxx_ffm_did_2_dyn_3 Sxx_ffm_did_3_dyn_3 Sxx_ffm_did_4_dyn_3 Sxx_ffm_did_5_dyn_3 Sxx_ffm_did_1_max_dyn_3 Sxx_ffm_did_2_max_dyn_3 Sxx_ffm_did_3_max_dyn_3 Sxx_ffm_did_4_max_dyn_3 Sxx_ffm_did_5_max_dyn_3 Sxx_ffm_did_1_min_dyn_3 Sxx_ffm_did_2_min_dyn_3 Sxx_ffm_did_3_min_dyn_3 Sxx_ffm_did_4_min_dyn_3 Sxx_ffm_did_5_min_dyn_3 Sxx_obd_sc_n_dyn_3 Sbx_pfo_dyn_3 Sbx_mfo_dyn_3 Sbx_obd_mreq_dyn_3 Sbx_obd_dc_rdn_dyn_3 Sbx_fail_dc_dyn_3 Sbx_obd_sc_pass_dyn_3 Sbx_obd_sc_wup_stt_dyn_3 Sxx_obd_wctr_dyn_3 Sxx_frq_dyn_3 Sxx_obd_clfctr_dyn_3 Sxx_esd_siz_dyn_3 Sxx_obd_sc_ctr_dyn_3 Sxx_obd_sc_load_dyn_3 Sxx_pri_dyn_3 Sxx_dist_fail_dyn_4 Sxx_tmp_dist_dyn_4 Sxx_km_cf_dyn_4 Sxx_km_mf_dyn_4 Sxx_km_pass_dyn_4 Sxx_ind_dyn_4 Sxx_ffm_esti_tqe_dyn_4 Sxx_ffm_esti_tqe_min_dyn_4 Sxx_ffm_esti_tqe_max_dyn_4 Sxx_ffm_n_dyn_4 Sxx_ffm_n_min_dyn_4 Sxx_ffm_n_max_dyn_4 Sxx_ffm_tco_dyn_4 Sxx_ffm_tco_min_dyn_4 Sxx_ffm_tco_max_dyn_4 Sxx_ffm_vb_dyn_4 Sxx_ffm_vb_min_dyn_4 Sxx_ffm_vb_max_dyn_4 Sxx_ffm_vs_dyn_4 Sxx_ffm_vs_min_dyn_4 Sxx_ffm_vs_max_dyn_4 Sxx_ffm_did_1_dyn_4 Sxx_ffm_did_2_dyn_4 Sxx_ffm_did_3_dyn_4 Sxx_ffm_did_4_dyn_4 Sxx_ffm_did_5_dyn_4 Sxx_ffm_did_1_max_dyn_4 Sxx_ffm_did_2_max_dyn_4 Sxx_ffm_did_3_max_dyn_4 Sxx_ffm_did_4_max_dyn_4 Sxx_ffm_did_5_max_dyn_4 Sxx_ffm_did_1_min_dyn_4 Sxx_ffm_did_2_min_dyn_4 Sxx_ffm_did_3_min_dyn_4 Sxx_ffm_did_4_min_dyn_4 Sxx_ffm_did_5_min_dyn_4 Sxx_obd_sc_n_dyn_4 Sbx_pfo_dyn_4 Sbx_mfo_dyn_4 Sbx_obd_mreq_dyn_4 Sbx_obd_dc_rdn_dyn_4 Sbx_fail_dc_dyn_4 Sbx_obd_sc_pass_dyn_4 Sbx_obd_sc_wup_stt_dyn_4 Sxx_obd_wctr_dyn_4 Sxx_frq_dyn_4 Sxx_obd_clfctr_dyn_4 Sxx_esd_siz_dyn_4 Sxx_obd_sc_ctr_dyn_4 Sxx_obd_sc_load_dyn_4 Sxx_pri_dyn_4 Sxx_dist_fail_dyn_5 Sxx_tmp_dist_dyn_5 Sxx_km_cf_dyn_5 Sxx_km_mf_dyn_5 Sxx_km_pass_dyn_5 Sxx_ind_dyn_5 Sxx_ffm_esti_tqe_dyn_5 Sxx_ffm_esti_tqe_min_dyn_5 Sxx_ffm_esti_tqe_max_dyn_5 Sxx_ffm_n_dyn_5 Sxx_ffm_n_min_dyn_5 Sxx_ffm_n_max_dyn_5 Sxx_ffm_tco_dyn_5 Sxx_ffm_tco_min_dyn_5 Sxx_ffm_tco_max_dyn_5 Sxx_ffm_vb_dyn_5 Sxx_ffm_vb_min_dyn_5 Sxx_ffm_vb_max_dyn_5 Sxx_ffm_vs_dyn_5 Sxx_ffm_vs_min_dyn_5 Sxx_ffm_vs_max_dyn_5 Sxx_ffm_did_1_dyn_5 Sxx_ffm_did_2_dyn_5 Sxx_ffm_did_3_dyn_5 Sxx_ffm_did_4_dyn_5 Sxx_ffm_did_5_dyn_5 Sxx_ffm_did_1_max_dyn_5 Sxx_ffm_did_2_max_dyn_5 Sxx_ffm_did_3_max_dyn_5 Sxx_ffm_did_4_max_dyn_5 Sxx_ffm_did_5_max_dyn_5 Sxx_ffm_did_1_min_dyn_5 Sxx_ffm_did_2_min_dyn_5 Sxx_ffm_did_3_min_dyn_5 Sxx_ffm_did_4_min_dyn_5 Sxx_ffm_did_5_min_dyn_5 Sxx_obd_sc_n_dyn_5 Sbx_pfo_dyn_5 Sbx_mfo_dyn_5 Sbx_obd_mreq_dyn_5 Sbx_obd_dc_rdn_dyn_5 Sbx_fail_dc_dyn_5 Sbx_obd_sc_pass_dyn_5 Sbx_obd_sc_wup_stt_dyn_5 Sxx_obd_wctr_dyn_5 Sxx_frq_dyn_5 Sxx_obd_clfctr_dyn_5 Sxx_esd_siz_dyn_5 Sxx_obd_sc_ctr_dyn_5 Sxx_obd_sc_load_dyn_5 Sxx_pri_dyn_5 Sxx_dist_fail_dyn_6 Sxx_tmp_dist_dyn_6 Sxx_km_cf_dyn_6 Sxx_km_mf_dyn_6 Sxx_km_pass_dyn_6 Sxx_ind_dyn_6 Sxx_ffm_esti_tqe_dyn_6 Sxx_ffm_esti_tqe_min_dyn_6 Sxx_ffm_esti_tqe_max_dyn_6 Sxx_ffm_n_dyn_6 Sxx_ffm_n_min_dyn_6 Sxx_ffm_n_max_dyn_6 Sxx_ffm_tco_dyn_6 Sxx_ffm_tco_min_dyn_6 Sxx_ffm_tco_max_dyn_6 Sxx_ffm_vb_dyn_6 Sxx_ffm_vb_min_dyn_6 Sxx_ffm_vb_max_dyn_6 Sxx_ffm_vs_dyn_6 Sxx_ffm_vs_min_dyn_6 Sxx_ffm_vs_max_dyn_6 Sxx_ffm_did_1_dyn_6 Sxx_ffm_did_2_dyn_6 Sxx_ffm_did_3_dyn_6 Sxx_ffm_did_4_dyn_6 Sxx_ffm_did_5_dyn_6 Sxx_ffm_did_1_max_dyn_6 Sxx_ffm_did_2_max_dyn_6 Sxx_ffm_did_3_max_dyn_6 Sxx_ffm_did_4_max_dyn_6 Sxx_ffm_did_5_max_dyn_6 Sxx_ffm_did_1_min_dyn_6 Sxx_ffm_did_2_min_dyn_6 Sxx_ffm_did_3_min_dyn_6 Sxx_ffm_did_4_min_dyn_6 Sxx_ffm_did_5_min_dyn_6 Sxx_obd_sc_n_dyn_6 Sbx_pfo_dyn_6 Sbx_mfo_dyn_6 Sbx_obd_mreq_dyn_6 Sbx_obd_dc_rdn_dyn_6 Sbx_fail_dc_dyn_6 Sbx_obd_sc_pass_dyn_6 Sbx_obd_sc_wup_stt_dyn_6 Sxx_obd_wctr_dyn_6 Sxx_frq_dyn_6 Sxx_obd_clfctr_dyn_6 Sxx_esd_siz_dyn_6 Sxx_obd_sc_ctr_dyn_6 Sxx_obd_sc_load_dyn_6 Sxx_pri_dyn_6 Sxx_dist_fail_dyn_7 Sxx_tmp_dist_dyn_7 Sxx_km_cf_dyn_7 Sxx_km_mf_dyn_7 Sxx_km_pass_dyn_7 Sxx_ind_dyn_7 Sxx_ffm_esti_tqe_dyn_7 Sxx_ffm_esti_tqe_min_dyn_7 Sxx_ffm_esti_tqe_max_dyn_7 Sxx_ffm_n_dyn_7 Sxx_ffm_n_min_dyn_7 Sxx_ffm_n_max_dyn_7 Sxx_ffm_tco_dyn_7 Sxx_ffm_tco_min_dyn_7 Sxx_ffm_tco_max_dyn_7 Sxx_ffm_vb_dyn_7 Sxx_ffm_vb_min_dyn_7 Sxx_ffm_vb_max_dyn_7 Sxx_ffm_vs_dyn_7 Sxx_ffm_vs_min_dyn_7 Sxx_ffm_vs_max_dyn_7 Sxx_ffm_did_1_dyn_7 Sxx_ffm_did_2_dyn_7 Sxx_ffm_did_3_dyn_7 Sxx_ffm_did_4_dyn_7 Sxx_ffm_did_5_dyn_7 Sxx_ffm_did_1_max_dyn_7 Sxx_ffm_did_2_max_dyn_7 Sxx_ffm_did_3_max_dyn_7 Sxx_ffm_did_4_max_dyn_7 Sxx_ffm_did_5_max_dyn_7 Sxx_ffm_did_1_min_dyn_7 Sxx_ffm_did_2_min_dyn_7 Sxx_ffm_did_3_min_dyn_7 Sxx_ffm_did_4_min_dyn_7 Sxx_ffm_did_5_min_dyn_7 Sxx_obd_sc_n_dyn_7 Sbx_pfo_dyn_7 Sbx_mfo_dyn_7 Sbx_obd_mreq_dyn_7 Sbx_obd_dc_rdn_dyn_7 Sbx_fail_dc_dyn_7 Sbx_obd_sc_pass_dyn_7 Sbx_obd_sc_wup_stt_dyn_7 Sxx_obd_wctr_dyn_7 Sxx_frq_dyn_7 Sxx_obd_clfctr_dyn_7 Sxx_esd_siz_dyn_7 Sxx_obd_sc_ctr_dyn_7 Sxx_obd_sc_load_dyn_7 Sxx_pri_dyn_7 Sxx_dist_fail_dyn_8 Sxx_tmp_dist_dyn_8 Sxx_km_cf_dyn_8 Sxx_km_mf_dyn_8 Sxx_km_pass_dyn_8 Sxx_ind_dyn_8 Sxx_ffm_esti_tqe_dyn_8 Sxx_ffm_esti_tqe_min_dyn_8 Sxx_ffm_esti_tqe_max_dyn_8 Sxx_ffm_n_dyn_8 Sxx_ffm_n_min_dyn_8 Sxx_ffm_n_max_dyn_8 Sxx_ffm_tco_dyn_8 Sxx_ffm_tco_min_dyn_8 Sxx_ffm_tco_max_dyn_8 Sxx_ffm_vb_dyn_8 Sxx_ffm_vb_min_dyn_8 Sxx_ffm_vb_max_dyn_8 Sxx_ffm_vs_dyn_8 Sxx_ffm_vs_min_dyn_8 Sxx_ffm_vs_max_dyn_8 Sxx_ffm_did_1_dyn_8 Sxx_ffm_did_2_dyn_8 Sxx_ffm_did_3_dyn_8 Sxx_ffm_did_4_dyn_8 Sxx_ffm_did_5_dyn_8 Sxx_ffm_did_1_max_dyn_8 Sxx_ffm_did_2_max_dyn_8 Sxx_ffm_did_3_max_dyn_8 Sxx_ffm_did_4_max_dyn_8 Sxx_ffm_did_5_max_dyn_8 Sxx_ffm_did_1_min_dyn_8 Sxx_ffm_did_2_min_dyn_8 Sxx_ffm_did_3_min_dyn_8 Sxx_ffm_did_4_min_dyn_8 Sxx_ffm_did_5_min_dyn_8 Sxx_obd_sc_n_dyn_8 Sbx_pfo_dyn_8 Sbx_mfo_dyn_8 Sbx_obd_mreq_dyn_8 Sbx_obd_dc_rdn_dyn_8 Sbx_fail_dc_dyn_8 Sbx_obd_sc_pass_dyn_8 Sbx_obd_sc_wup_stt_dyn_8 Sxx_obd_wctr_dyn_8 Sxx_frq_dyn_8 Sxx_obd_clfctr_dyn_8 Sxx_esd_siz_dyn_8 Sxx_obd_sc_ctr_dyn_8 Sxx_obd_sc_load_dyn_8 Sxx_pri_dyn_8 Sxx_dist_fail_dyn_9 Sxx_tmp_dist_dyn_9 Sxx_km_cf_dyn_9 Sxx_km_mf_dyn_9 Sxx_km_pass_dyn_9 Sxx_ind_dyn_9 Sxx_ffm_esti_tqe_dyn_9 Sxx_ffm_esti_tqe_min_dyn_9 Sxx_ffm_esti_tqe_max_dyn_9 Sxx_ffm_n_dyn_9 Sxx_ffm_n_min_dyn_9 Sxx_ffm_n_max_dyn_9 Sxx_ffm_tco_dyn_9 Sxx_ffm_tco_min_dyn_9 Sxx_ffm_tco_max_dyn_9 Sxx_ffm_vb_dyn_9 Sxx_ffm_vb_min_dyn_9 Sxx_ffm_vb_max_dyn_9 Sxx_ffm_vs_dyn_9 Sxx_ffm_vs_min_dyn_9 Sxx_ffm_vs_max_dyn_9 Sxx_ffm_did_1_dyn_9 Sxx_ffm_did_2_dyn_9 Sxx_ffm_did_3_dyn_9 Sxx_ffm_did_4_dyn_9 Sxx_ffm_did_5_dyn_9 Sxx_ffm_did_1_max_dyn_9 Sxx_ffm_did_2_max_dyn_9 Sxx_ffm_did_3_max_dyn_9 Sxx_ffm_did_4_max_dyn_9 Sxx_ffm_did_5_max_dyn_9 Sxx_ffm_did_1_min_dyn_9 Sxx_ffm_did_2_min_dyn_9 Sxx_ffm_did_3_min_dyn_9 Sxx_ffm_did_4_min_dyn_9 Sxx_ffm_did_5_min_dyn_9 Sxx_obd_sc_n_dyn_9 Sbx_pfo_dyn_9 Sbx_mfo_dyn_9 Sbx_obd_mreq_dyn_9 Sbx_obd_dc_rdn_dyn_9 Sbx_fail_dc_dyn_9 Sbx_obd_sc_pass_dyn_9 Sbx_obd_sc_wup_stt_dyn_9 Sxx_obd_wctr_dyn_9 Sxx_frq_dyn_9 Sxx_obd_clfctr_dyn_9 Sxx_esd_siz_dyn_9 Sxx_obd_sc_ctr_dyn_9 Sxx_obd_sc_load_dyn_9 Sxx_pri_dyn_9 Stx_obd_iupr_den_0 Stx_obd_iupr_num_0 Stx_obd_iupr_num_upd_0 Sbx_obd_wup Stx_esd[0] Sxx_clr_dist Sxx_clr_wup Sxx_dyn_ctr Sxx_last_incr_km Sxx_mil_on_km Sxx_obd_gen_den Sxx_obd_ign_ctr Sxx_tmp_dist_1 Sxx_tmp_dist_2 Vbx_eng_aut_fm Vbx_eng_stop Vbx_mil_ecu_req Vbx_mil_prmt_req Vbx_obd_den_2_stt Vbx_obd_den_main_stt Vbx_wal_1_req Vbx_wal_2_req Vbx_wup Vtx_obd_cmd_on_stt[0] Vxx_dtc_hmb_cf_redg_edic Vxx_dtc_lb_cf_redg_edic Vxx_esd_did_nr Vxx_esd_ind Vxx_esd_ind_ini Vxx_esd_ind_max Vxx_esd_siz Vxx_ind_fail_redg Vxx_ind_mfo_redg Vxx_ind_obd_clf_redg Vxx_ind_obd_fedg Vxx_ind_pfo_redg Vxx_obd_den_main_1 Vxx_obd_den_main_2 Vxx_obd_den_main_3 Vxx_tco_ini Vxx_tmp_pri Vxx_tot_nr_sw_diag /end OUT_MEASUREMENT
/end FUNCTION
/begin FUNCTION DgDftMng_Svcecom ""
 /begin DEF_CHARACTERISTIC Ntx_data_avl_list[0] Ntx_data_avl_list[1] Ntx_data_avl_list[2] Ntx_data_avl_list[3] Ntx_data_avl_list[4] Ntx_data_avl_list[5] Ntx_data_avl_list[6] Ntx_frm_avl_list[0] Ntx_frm_avl_list[1] Ntx_frm_avl_list[2] Ntx_frm_avl_list[3] /end DEF_CHARACTERISTIC
 /begin OUT_MEASUREMENT Vxx_capture_all_nr Vxx_capture_all_pres_iter Vxx_capture_obd_nr Vxx_capture_obd_pres_iter Vxx_get_ind_pres_iter /end OUT_MEASUREMENT
/end FUNCTION
/end MODULE
/end PROJECT
