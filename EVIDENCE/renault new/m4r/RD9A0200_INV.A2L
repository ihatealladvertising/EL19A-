ASAP2_VERSION 1 41
/begin PROJECT RD8 "_default_ProjectLongIdentifier"
/begin HEADER "_default_HeaderComment" PROJECT_NO RD9 /end HEADER
/begin MODULE _default_ModuleName "_default_ModuleLongIdentifier"
/begin MOD_COMMON "_default_ModCommonComment" DEPOSIT ABSOLUTE BYTE_ORDER MSB_LAST ALIGNMENT_BYTE 1 ALIGNMENT_WORD 2 ALIGNMENT_LONG 2 ALIGNMENT_FLOAT32_IEEE 2 ALIGNMENT_FLOAT64_IEEE 4 /end MOD_COMMON
/begin AXIS_PTS Ctb_eal "16 breakpoint table for Engine air load" 0xa002b7f4 Vxx_eal _REC_A2AXS_20_u2 3.99993896484375 _CNV_A_R_LINEAR_____53_CM 16 0. 3.99993896484375 FORMAT "%10.8" /end AXIS_PTS
/begin AXIS_PTS Ctb_tco "16 engine coolant temperature breakpoints" 0xa002d4ac Vxx_tco _REC_A2AXS_20_u2 240. _CNV_A_R_LINEAR_____110_CM 16 -40. 200. FORMAT "%5.1" /end AXIS_PTS
/begin MEASUREMENT Stx_frm_pool[0].Vxx_rtn_n01 "Stored engine speed" UWORD _CNV_A_R_ENSD_LINEA_22_CM 1 0. 0. 16383.75 ECU_ADDRESS 0xd0005c6c FORMAT "%8.2" /end MEASUREMENT
/begin MEASUREMENT Stx_frm_pool[0].Vxx_obd_fail_code "DTC that caused required freeze frame data storage" UWORD _CNV_A_R_ECME_LINEA_0_CM 1 0. 0. 65535. ECU_ADDRESS 0xd0005c6e FORMAT "%5.0" /end MEASUREMENT
/begin MEASUREMENT Stx_frm_pool[0].Vxx_rtn_eal "Stored calculated load value for the scantool." UBYTE _CNV_A_R_LINEAR_____165_CM 1 0. 0. 100. ECU_ADDRESS 0xd0005c70 FORMAT "%12.8" /end MEASUREMENT
/begin MEASUREMENT Stx_frm_pool[0].Vxx_rtn_vs "Stored filtered vehicule speed." UBYTE _CNV_A_R_LINEAR_____71_CM 1 0. 0. 255. ECU_ADDRESS 0xd0005c71 FORMAT "%3.0" /end MEASUREMENT
/begin MEASUREMENT Stx_frm_pool[0].Vxx_rtn_map "Stored Manifold pressure value measurement" UBYTE _CNV_A_R_LINEAR_____279_CM 1 0. 0. 255. ECU_ADDRESS 0xd0005c72 FORMAT "%3.0" /end MEASUREMENT
/begin MEASUREMENT Stx_frm_pool[0].Vxx_rtn_frm_tco "Stored engine coolant temperature." UBYTE _CNV_A_R_LINEAR_____280_CM 1 0. -40. 215. ECU_ADDRESS 0xd0005c73 FORMAT "%3.0" /end MEASUREMENT
/begin MEASUREMENT Stx_frm_pool[0].Vxx_rtn_mv_ad_fac "Stored mean effective gain applied on injected fuel mass quantity" UBYTE _CNV_A_R_LINEAR_____281_CM 1 0. -100. 99.21875 ECU_ADDRESS 0xd0005c74 FORMAT "%10.5" /end MEASUREMENT
/begin MEASUREMENT Stx_frm_pool[0].Vxx_rtn_rich_loop_ti_fac "Stored multiplicative factor from richness closed loop applied on injected fuel mass quantity" UBYTE _CNV_A_R_LINEAR_____281_CM 1 0. -100. 99.21875 ECU_ADDRESS 0xd0005c75 FORMAT "%10.5" /end MEASUREMENT
/begin MEASUREMENT Stx_frm_pool[0].Vbx_rtn_clos_o2_phs "Stored richness regulation condition" UBYTE _CNV_S_2_RANGE______3_CM 1 0. 0. 1. ECU_ADDRESS 0xd0005c76 BIT_MASK 0x1 /end MEASUREMENT
/begin MEASUREMENT Stx_frm_pool[0].Vxx_rtn_mat "Stored intake air temperature" UBYTE _CNV_A_R_LINEAR_____280_CM 1 0. -40. 215. ECU_ADDRESS 0xd0005c77 FORMAT "%3.0" /end MEASUREMENT
/begin MEASUREMENT Stx_frm_pool[0].Vxx_rtn_clr_dist "Stored distance travelled since last clear" UWORD _CNV_A_R_LINEAR_____274_CM 1 0. 0. 65535. ECU_ADDRESS 0xd0005c78 FORMAT "%5.0" /end MEASUREMENT
/begin MEASUREMENT Stx_frm_pool[0].Vxx_ind_xxx "static index" UWORD _CNV_A_R_ECME_LINEA_0_CM 1 0. 0. 65535. ECU_ADDRESS 0xd0005c7a FORMAT "%5.0" /end MEASUREMENT
/begin MEASUREMENT Stx_frm_pool[0].Vxx_rtn_maf "Stored Mass air flow" UWORD _CNV_A_R_LINEAR_____282_CM 1 0. 0. 655.35 ECU_ADDRESS 0xd0005c7c FORMAT "%6.2" /end MEASUREMENT
/begin MEASUREMENT Stx_frm_pool[0].Vxx_rtn_rail_prs "Stored Rail pressure measured" UWORD _CNV_A_R_LINEAR_____283_CM 1 0. 0. 655350. ECU_ADDRESS 0xd0005c7e FORMAT "%6.0" /end MEASUREMENT
/begin MEASUREMENT Stx_frm_pool[0].Vxx_rtn_tia "Stored intake air temperature" UBYTE _CNV_A_R_LINEAR_____280_CM 1 0. -40. 215. ECU_ADDRESS 0xd0005c80 FORMAT "%3.0" /end MEASUREMENT
/begin MEASUREMENT Stx_frm_pool[0].Vxx_dgdftmng_priority "Local frame priority" UBYTE _CNV_A_R_ECME_LINEA_0_CM 1 0. 0. 6. ECU_ADDRESS 0xd0005c81 FORMAT "%1.0" /end MEASUREMENT
/begin MEASUREMENT Stx_frm_pool[0].Vxx_rtn_rvac "Stored raw Tank differential pressure value for Scantool." SWORD _CNV_A_R_LINEAR_____284_CM 1 0. -8192. 8191.75 ECU_ADDRESS 0xd0005c82 FORMAT "%8.2" /end MEASUREMENT
/begin MEASUREMENT Stx_frm_pool[1].Vxx_rtn_n01 "Stored engine speed" UWORD _CNV_A_R_ENSD_LINEA_22_CM 1 0. 0. 16383.75 ECU_ADDRESS 0xd0005c84 FORMAT "%8.2" /end MEASUREMENT
/begin MEASUREMENT Stx_frm_pool[1].Vxx_obd_fail_code "DTC that caused required freeze frame data storage" UWORD _CNV_A_R_ECME_LINEA_0_CM 1 0. 0. 65535. ECU_ADDRESS 0xd0005c86 FORMAT "%5.0" /end MEASUREMENT
/begin MEASUREMENT Stx_frm_pool[1].Vxx_rtn_eal "Stored calculated load value for the scantool." UBYTE _CNV_A_R_LINEAR_____165_CM 1 0. 0. 100. ECU_ADDRESS 0xd0005c88 FORMAT "%12.8" /end MEASUREMENT
/begin MEASUREMENT Stx_frm_pool[1].Vxx_rtn_vs "Stored filtered vehicule speed." UBYTE _CNV_A_R_LINEAR_____71_CM 1 0. 0. 255. ECU_ADDRESS 0xd0005c89 FORMAT "%3.0" /end MEASUREMENT
/begin MEASUREMENT Stx_frm_pool[1].Vxx_rtn_map "Stored Manifold pressure value measurement" UBYTE _CNV_A_R_LINEAR_____279_CM 1 0. 0. 255. ECU_ADDRESS 0xd0005c8a FORMAT "%3.0" /end MEASUREMENT
/begin MEASUREMENT Stx_frm_pool[1].Vxx_rtn_frm_tco "Stored engine coolant temperature." UBYTE _CNV_A_R_LINEAR_____280_CM 1 0. -40. 215. ECU_ADDRESS 0xd0005c8b FORMAT "%3.0" /end MEASUREMENT
/begin MEASUREMENT Stx_frm_pool[1].Vxx_rtn_mv_ad_fac "Stored mean effective gain applied on injected fuel mass quantity" UBYTE _CNV_A_R_LINEAR_____281_CM 1 0. -100. 99.21875 ECU_ADDRESS 0xd0005c8c FORMAT "%10.5" /end MEASUREMENT
/begin MEASUREMENT Stx_frm_pool[1].Vxx_rtn_rich_loop_ti_fac "Stored multiplicative factor from richness closed loop applied on injected fuel mass quantity" UBYTE _CNV_A_R_LINEAR_____281_CM 1 0. -100. 99.21875 ECU_ADDRESS 0xd0005c8d FORMAT "%10.5" /end MEASUREMENT
/begin MEASUREMENT Stx_frm_pool[1].Vbx_rtn_clos_o2_phs "Stored richness regulation condition" UBYTE _CNV_S_2_RANGE______3_CM 1 0. 0. 1. ECU_ADDRESS 0xd0005c8e BIT_MASK 0x1 /end MEASUREMENT
/begin MEASUREMENT Stx_frm_pool[1].Vxx_rtn_mat "Stored intake air temperature" UBYTE _CNV_A_R_LINEAR_____280_CM 1 0. -40. 215. ECU_ADDRESS 0xd0005c8f FORMAT "%3.0" /end MEASUREMENT
/begin MEASUREMENT Stx_frm_pool[1].Vxx_rtn_clr_dist "Stored distance travelled since last clear" UWORD _CNV_A_R_LINEAR_____274_CM 1 0. 0. 65535. ECU_ADDRESS 0xd0005c90 FORMAT "%5.0" /end MEASUREMENT
/begin MEASUREMENT Stx_frm_pool[1].Vxx_ind_xxx "static index" UWORD _CNV_A_R_ECME_LINEA_0_CM 1 0. 0. 65535. ECU_ADDRESS 0xd0005c92 FORMAT "%5.0" /end MEASUREMENT
/begin MEASUREMENT Stx_frm_pool[1].Vxx_rtn_maf "Stored Mass air flow" UWORD _CNV_A_R_LINEAR_____282_CM 1 0. 0. 655.35 ECU_ADDRESS 0xd0005c94 FORMAT "%6.2" /end MEASUREMENT
/begin MEASUREMENT Stx_frm_pool[1].Vxx_rtn_rail_prs "Stored Rail pressure measured" UWORD _CNV_A_R_LINEAR_____283_CM 1 0. 0. 655350. ECU_ADDRESS 0xd0005c96 FORMAT "%6.0" /end MEASUREMENT
/begin MEASUREMENT Stx_frm_pool[1].Vxx_rtn_tia "Stored intake air temperature" UBYTE _CNV_A_R_LINEAR_____280_CM 1 0. -40. 215. ECU_ADDRESS 0xd0005c98 FORMAT "%3.0" /end MEASUREMENT
/begin MEASUREMENT Stx_frm_pool[1].Vxx_dgdftmng_priority "Local frame priority" UBYTE _CNV_A_R_ECME_LINEA_0_CM 1 0. 0. 6. ECU_ADDRESS 0xd0005c99 FORMAT "%1.0" /end MEASUREMENT
/begin MEASUREMENT Stx_frm_pool[1].Vxx_rtn_rvac "Stored raw Tank differential pressure value for Scantool." SWORD _CNV_A_R_LINEAR_____284_CM 1 0. -8192. 8191.75 ECU_ADDRESS 0xd0005c9a FORMAT "%8.2" /end MEASUREMENT
/begin MEASUREMENT Stx_frm_pool[2].Vxx_rtn_n01 "Stored engine speed" UWORD _CNV_A_R_ENSD_LINEA_22_CM 1 0. 0. 16383.75 ECU_ADDRESS 0xd0005c9c FORMAT "%8.2" /end MEASUREMENT
/begin MEASUREMENT Stx_frm_pool[2].Vxx_obd_fail_code "DTC that caused required freeze frame data storage" UWORD _CNV_A_R_ECME_LINEA_0_CM 1 0. 0. 65535. ECU_ADDRESS 0xd0005c9e FORMAT "%5.0" /end MEASUREMENT
/begin MEASUREMENT Stx_frm_pool[2].Vxx_rtn_eal "Stored calculated load value for the scantool." UBYTE _CNV_A_R_LINEAR_____165_CM 1 0. 0. 100. ECU_ADDRESS 0xd0005ca0 FORMAT "%12.8" /end MEASUREMENT
/begin MEASUREMENT Stx_frm_pool[2].Vxx_rtn_vs "Stored filtered vehicule speed." UBYTE _CNV_A_R_LINEAR_____71_CM 1 0. 0. 255. ECU_ADDRESS 0xd0005ca1 FORMAT "%3.0" /end MEASUREMENT
/begin MEASUREMENT Stx_frm_pool[2].Vxx_rtn_map "Stored Manifold pressure value measurement" UBYTE _CNV_A_R_LINEAR_____279_CM 1 0. 0. 255. ECU_ADDRESS 0xd0005ca2 FORMAT "%3.0" /end MEASUREMENT
/begin MEASUREMENT Stx_frm_pool[2].Vxx_rtn_frm_tco "Stored engine coolant temperature." UBYTE _CNV_A_R_LINEAR_____280_CM 1 0. -40. 215. ECU_ADDRESS 0xd0005ca3 FORMAT "%3.0" /end MEASUREMENT
/begin MEASUREMENT Stx_frm_pool[2].Vxx_rtn_mv_ad_fac "Stored mean effective gain applied on injected fuel mass quantity" UBYTE _CNV_A_R_LINEAR_____281_CM 1 0. -100. 99.21875 ECU_ADDRESS 0xd0005ca4 FORMAT "%10.5" /end MEASUREMENT
/begin MEASUREMENT Stx_frm_pool[2].Vxx_rtn_rich_loop_ti_fac "Stored multiplicative factor from richness closed loop applied on injected fuel mass quantity" UBYTE _CNV_A_R_LINEAR_____281_CM 1 0. -100. 99.21875 ECU_ADDRESS 0xd0005ca5 FORMAT "%10.5" /end MEASUREMENT
/begin MEASUREMENT Stx_frm_pool[2].Vbx_rtn_clos_o2_phs "Stored richness regulation condition" UBYTE _CNV_S_2_RANGE______3_CM 1 0. 0. 1. ECU_ADDRESS 0xd0005ca6 BIT_MASK 0x1 /end MEASUREMENT
/begin MEASUREMENT Stx_frm_pool[2].Vxx_rtn_mat "Stored intake air temperature" UBYTE _CNV_A_R_LINEAR_____280_CM 1 0. -40. 215. ECU_ADDRESS 0xd0005ca7 FORMAT "%3.0" /end MEASUREMENT
/begin MEASUREMENT Stx_frm_pool[2].Vxx_rtn_clr_dist "Stored distance travelled since last clear" UWORD _CNV_A_R_LINEAR_____274_CM 1 0. 0. 65535. ECU_ADDRESS 0xd0005ca8 FORMAT "%5.0" /end MEASUREMENT
/begin MEASUREMENT Stx_frm_pool[2].Vxx_ind_xxx "static index" UWORD _CNV_A_R_ECME_LINEA_0_CM 1 0. 0. 65535. ECU_ADDRESS 0xd0005caa FORMAT "%5.0" /end MEASUREMENT
/begin MEASUREMENT Stx_frm_pool[2].Vxx_rtn_maf "Stored Mass air flow" UWORD _CNV_A_R_LINEAR_____282_CM 1 0. 0. 655.35 ECU_ADDRESS 0xd0005cac FORMAT "%6.2" /end MEASUREMENT
/begin MEASUREMENT Stx_frm_pool[2].Vxx_rtn_rail_prs "Stored Rail pressure measured" UWORD _CNV_A_R_LINEAR_____283_CM 1 0. 0. 655350. ECU_ADDRESS 0xd0005cae FORMAT "%6.0" /end MEASUREMENT
/begin MEASUREMENT Stx_frm_pool[2].Vxx_rtn_tia "Stored intake air temperature" UBYTE _CNV_A_R_LINEAR_____280_CM 1 0. -40. 215. ECU_ADDRESS 0xd0005cb0 FORMAT "%3.0" /end MEASUREMENT
/begin MEASUREMENT Stx_frm_pool[2].Vxx_dgdftmng_priority "Local frame priority" UBYTE _CNV_A_R_ECME_LINEA_0_CM 1 0. 0. 6. ECU_ADDRESS 0xd0005cb1 FORMAT "%1.0" /end MEASUREMENT
/begin MEASUREMENT Stx_frm_pool[2].Vxx_rtn_rvac "Stored raw Tank differential pressure value for Scantool." SWORD _CNV_A_R_LINEAR_____284_CM 1 0. -8192. 8191.75 ECU_ADDRESS 0xd0005cb2 FORMAT "%8.2" /end MEASUREMENT
/begin MEASUREMENT Stx_frm_pool[3].Vxx_rtn_n01 "Stored engine speed" UWORD _CNV_A_R_ENSD_LINEA_22_CM 1 0. 0. 16383.75 ECU_ADDRESS 0xd0005cb4 FORMAT "%8.2" /end MEASUREMENT
/begin MEASUREMENT Stx_frm_pool[3].Vxx_obd_fail_code "DTC that caused required freeze frame data storage" UWORD _CNV_A_R_ECME_LINEA_0_CM 1 0. 0. 65535. ECU_ADDRESS 0xd0005cb6 FORMAT "%5.0" /end MEASUREMENT
/begin MEASUREMENT Stx_frm_pool[3].Vxx_rtn_eal "Stored calculated load value for the scantool." UBYTE _CNV_A_R_LINEAR_____165_CM 1 0. 0. 100. ECU_ADDRESS 0xd0005cb8 FORMAT "%12.8" /end MEASUREMENT
/begin MEASUREMENT Stx_frm_pool[3].Vxx_rtn_vs "Stored filtered vehicule speed." UBYTE _CNV_A_R_LINEAR_____71_CM 1 0. 0. 255. ECU_ADDRESS 0xd0005cb9 FORMAT "%3.0" /end MEASUREMENT
/begin MEASUREMENT Stx_frm_pool[3].Vxx_rtn_map "Stored Manifold pressure value measurement" UBYTE _CNV_A_R_LINEAR_____279_CM 1 0. 0. 255. ECU_ADDRESS 0xd0005cba FORMAT "%3.0" /end MEASUREMENT
/begin MEASUREMENT Stx_frm_pool[3].Vxx_rtn_frm_tco "Stored engine coolant temperature." UBYTE _CNV_A_R_LINEAR_____280_CM 1 0. -40. 215. ECU_ADDRESS 0xd0005cbb FORMAT "%3.0" /end MEASUREMENT
/begin MEASUREMENT Stx_frm_pool[3].Vxx_rtn_mv_ad_fac "Stored mean effective gain applied on injected fuel mass quantity" UBYTE _CNV_A_R_LINEAR_____281_CM 1 0. -100. 99.21875 ECU_ADDRESS 0xd0005cbc FORMAT "%10.5" /end MEASUREMENT
/begin MEASUREMENT Stx_frm_pool[3].Vxx_rtn_rich_loop_ti_fac "Stored multiplicative factor from richness closed loop applied on injected fuel mass quantity" UBYTE _CNV_A_R_LINEAR_____281_CM 1 0. -100. 99.21875 ECU_ADDRESS 0xd0005cbd FORMAT "%10.5" /end MEASUREMENT
/begin MEASUREMENT Stx_frm_pool[3].Vbx_rtn_clos_o2_phs "Stored richness regulation condition" UBYTE _CNV_S_2_RANGE______3_CM 1 0. 0. 1. ECU_ADDRESS 0xd0005cbe BIT_MASK 0x1 /end MEASUREMENT
/begin MEASUREMENT Stx_frm_pool[3].Vxx_rtn_mat "Stored intake air temperature" UBYTE _CNV_A_R_LINEAR_____280_CM 1 0. -40. 215. ECU_ADDRESS 0xd0005cbf FORMAT "%3.0" /end MEASUREMENT
/begin MEASUREMENT Stx_frm_pool[3].Vxx_rtn_clr_dist "Stored distance travelled since last clear" UWORD _CNV_A_R_LINEAR_____274_CM 1 0. 0. 65535. ECU_ADDRESS 0xd0005cc0 FORMAT "%5.0" /end MEASUREMENT
/begin MEASUREMENT Stx_frm_pool[3].Vxx_ind_xxx "static index" UWORD _CNV_A_R_ECME_LINEA_0_CM 1 0. 0. 65535. ECU_ADDRESS 0xd0005cc2 FORMAT "%5.0" /end MEASUREMENT
/begin MEASUREMENT Stx_frm_pool[3].Vxx_rtn_maf "Stored Mass air flow" UWORD _CNV_A_R_LINEAR_____282_CM 1 0. 0. 655.35 ECU_ADDRESS 0xd0005cc4 FORMAT "%6.2" /end MEASUREMENT
/begin MEASUREMENT Stx_frm_pool[3].Vxx_rtn_rail_prs "Stored Rail pressure measured" UWORD _CNV_A_R_LINEAR_____283_CM 1 0. 0. 655350. ECU_ADDRESS 0xd0005cc6 FORMAT "%6.0" /end MEASUREMENT
/begin MEASUREMENT Stx_frm_pool[3].Vxx_rtn_tia "Stored intake air temperature" UBYTE _CNV_A_R_LINEAR_____280_CM 1 0. -40. 215. ECU_ADDRESS 0xd0005cc8 FORMAT "%3.0" /end MEASUREMENT
/begin MEASUREMENT Stx_frm_pool[3].Vxx_dgdftmng_priority "Local frame priority" UBYTE _CNV_A_R_ECME_LINEA_0_CM 1 0. 0. 6. ECU_ADDRESS 0xd0005cc9 FORMAT "%1.0" /end MEASUREMENT
/begin MEASUREMENT Stx_frm_pool[3].Vxx_rtn_rvac "Stored raw Tank differential pressure value for Scantool." SWORD _CNV_A_R_LINEAR_____284_CM 1 0. -8192. 8191.75 ECU_ADDRESS 0xd0005cca FORMAT "%8.2" /end MEASUREMENT
/begin MEASUREMENT Stx_frm_pool[4].Vxx_rtn_n01 "Stored engine speed" UWORD _CNV_A_R_ENSD_LINEA_22_CM 1 0. 0. 16383.75 ECU_ADDRESS 0xd0005ccc FORMAT "%8.2" /end MEASUREMENT
/begin MEASUREMENT Stx_frm_pool[4].Vxx_obd_fail_code "DTC that caused required freeze frame data storage" UWORD _CNV_A_R_ECME_LINEA_0_CM 1 0. 0. 65535. ECU_ADDRESS 0xd0005cce FORMAT "%5.0" /end MEASUREMENT
/begin MEASUREMENT Stx_frm_pool[4].Vxx_rtn_eal "Stored calculated load value for the scantool." UBYTE _CNV_A_R_LINEAR_____165_CM 1 0. 0. 100. ECU_ADDRESS 0xd0005cd0 FORMAT "%12.8" /end MEASUREMENT
/begin MEASUREMENT Stx_frm_pool[4].Vxx_rtn_vs "Stored filtered vehicule speed." UBYTE _CNV_A_R_LINEAR_____71_CM 1 0. 0. 255. ECU_ADDRESS 0xd0005cd1 FORMAT "%3.0" /end MEASUREMENT
/begin MEASUREMENT Stx_frm_pool[4].Vxx_rtn_map "Stored Manifold pressure value measurement" UBYTE _CNV_A_R_LINEAR_____279_CM 1 0. 0. 255. ECU_ADDRESS 0xd0005cd2 FORMAT "%3.0" /end MEASUREMENT
/begin MEASUREMENT Stx_frm_pool[4].Vxx_rtn_frm_tco "Stored engine coolant temperature." UBYTE _CNV_A_R_LINEAR_____280_CM 1 0. -40. 215. ECU_ADDRESS 0xd0005cd3 FORMAT "%3.0" /end MEASUREMENT
/begin MEASUREMENT Stx_frm_pool[4].Vxx_rtn_mv_ad_fac "Stored mean effective gain applied on injected fuel mass quantity" UBYTE _CNV_A_R_LINEAR_____281_CM 1 0. -100. 99.21875 ECU_ADDRESS 0xd0005cd4 FORMAT "%10.5" /end MEASUREMENT
/begin MEASUREMENT Stx_frm_pool[4].Vxx_rtn_rich_loop_ti_fac "Stored multiplicative factor from richness closed loop applied on injected fuel mass quantity" UBYTE _CNV_A_R_LINEAR_____281_CM 1 0. -100. 99.21875 ECU_ADDRESS 0xd0005cd5 FORMAT "%10.5" /end MEASUREMENT
/begin MEASUREMENT Stx_frm_pool[4].Vbx_rtn_clos_o2_phs "Stored richness regulation condition" UBYTE _CNV_S_2_RANGE______3_CM 1 0. 0. 1. ECU_ADDRESS 0xd0005cd6 BIT_MASK 0x1 /end MEASUREMENT
/begin MEASUREMENT Stx_frm_pool[4].Vxx_rtn_mat "Stored intake air temperature" UBYTE _CNV_A_R_LINEAR_____280_CM 1 0. -40. 215. ECU_ADDRESS 0xd0005cd7 FORMAT "%3.0" /end MEASUREMENT
/begin MEASUREMENT Stx_frm_pool[4].Vxx_rtn_clr_dist "Stored distance travelled since last clear" UWORD _CNV_A_R_LINEAR_____274_CM 1 0. 0. 65535. ECU_ADDRESS 0xd0005cd8 FORMAT "%5.0" /end MEASUREMENT
/begin MEASUREMENT Stx_frm_pool[4].Vxx_ind_xxx "static index" UWORD _CNV_A_R_ECME_LINEA_0_CM 1 0. 0. 65535. ECU_ADDRESS 0xd0005cda FORMAT "%5.0" /end MEASUREMENT
/begin MEASUREMENT Stx_frm_pool[4].Vxx_rtn_maf "Stored Mass air flow" UWORD _CNV_A_R_LINEAR_____282_CM 1 0. 0. 655.35 ECU_ADDRESS 0xd0005cdc FORMAT "%6.2" /end MEASUREMENT
/begin MEASUREMENT Stx_frm_pool[4].Vxx_rtn_rail_prs "Stored Rail pressure measured" UWORD _CNV_A_R_LINEAR_____283_CM 1 0. 0. 655350. ECU_ADDRESS 0xd0005cde FORMAT "%6.0" /end MEASUREMENT
/begin MEASUREMENT Stx_frm_pool[4].Vxx_rtn_tia "Stored intake air temperature" UBYTE _CNV_A_R_LINEAR_____280_CM 1 0. -40. 215. ECU_ADDRESS 0xd0005ce0 FORMAT "%3.0" /end MEASUREMENT
/begin MEASUREMENT Stx_frm_pool[4].Vxx_dgdftmng_priority "Local frame priority" UBYTE _CNV_A_R_ECME_LINEA_0_CM 1 0. 0. 6. ECU_ADDRESS 0xd0005ce1 FORMAT "%1.0" /end MEASUREMENT
/begin MEASUREMENT Stx_frm_pool[4].Vxx_rtn_rvac "Stored raw Tank differential pressure value for Scantool." SWORD _CNV_A_R_LINEAR_____284_CM 1 0. -8192. 8191.75 ECU_ADDRESS 0xd0005ce2 FORMAT "%8.2" /end MEASUREMENT
/begin MEASUREMENT Stx_frm_pool[5].Vxx_rtn_n01 "Stored engine speed" UWORD _CNV_A_R_ENSD_LINEA_22_CM 1 0. 0. 16383.75 ECU_ADDRESS 0xd0005ce4 FORMAT "%8.2" /end MEASUREMENT
/begin MEASUREMENT Stx_frm_pool[5].Vxx_obd_fail_code "DTC that caused required freeze frame data storage" UWORD _CNV_A_R_ECME_LINEA_0_CM 1 0. 0. 65535. ECU_ADDRESS 0xd0005ce6 FORMAT "%5.0" /end MEASUREMENT
/begin MEASUREMENT Stx_frm_pool[5].Vxx_rtn_eal "Stored calculated load value for the scantool." UBYTE _CNV_A_R_LINEAR_____165_CM 1 0. 0. 100. ECU_ADDRESS 0xd0005ce8 FORMAT "%12.8" /end MEASUREMENT
/begin MEASUREMENT Stx_frm_pool[5].Vxx_rtn_vs "Stored filtered vehicule speed." UBYTE _CNV_A_R_LINEAR_____71_CM 1 0. 0. 255. ECU_ADDRESS 0xd0005ce9 FORMAT "%3.0" /end MEASUREMENT
/begin MEASUREMENT Stx_frm_pool[5].Vxx_rtn_map "Stored Manifold pressure value measurement" UBYTE _CNV_A_R_LINEAR_____279_CM 1 0. 0. 255. ECU_ADDRESS 0xd0005cea FORMAT "%3.0" /end MEASUREMENT
/begin MEASUREMENT Stx_frm_pool[5].Vxx_rtn_frm_tco "Stored engine coolant temperature." UBYTE _CNV_A_R_LINEAR_____280_CM 1 0. -40. 215. ECU_ADDRESS 0xd0005ceb FORMAT "%3.0" /end MEASUREMENT
/begin MEASUREMENT Stx_frm_pool[5].Vxx_rtn_mv_ad_fac "Stored mean effective gain applied on injected fuel mass quantity" UBYTE _CNV_A_R_LINEAR_____281_CM 1 0. -100. 99.21875 ECU_ADDRESS 0xd0005cec FORMAT "%10.5" /end MEASUREMENT
/begin MEASUREMENT Stx_frm_pool[5].Vxx_rtn_rich_loop_ti_fac "Stored multiplicative factor from richness closed loop applied on injected fuel mass quantity" UBYTE _CNV_A_R_LINEAR_____281_CM 1 0. -100. 99.21875 ECU_ADDRESS 0xd0005ced FORMAT "%10.5" /end MEASUREMENT
/begin MEASUREMENT Stx_frm_pool[5].Vbx_rtn_clos_o2_phs "Stored richness regulation condition" UBYTE _CNV_S_2_RANGE______3_CM 1 0. 0. 1. ECU_ADDRESS 0xd0005cee BIT_MASK 0x1 /end MEASUREMENT
/begin MEASUREMENT Stx_frm_pool[5].Vxx_rtn_mat "Stored intake air temperature" UBYTE _CNV_A_R_LINEAR_____280_CM 1 0. -40. 215. ECU_ADDRESS 0xd0005cef FORMAT "%3.0" /end MEASUREMENT
/begin MEASUREMENT Stx_frm_pool[5].Vxx_rtn_clr_dist "Stored distance travelled since last clear" UWORD _CNV_A_R_LINEAR_____274_CM 1 0. 0. 65535. ECU_ADDRESS 0xd0005cf0 FORMAT "%5.0" /end MEASUREMENT
/begin MEASUREMENT Stx_frm_pool[5].Vxx_ind_xxx "static index" UWORD _CNV_A_R_ECME_LINEA_0_CM 1 0. 0. 65535. ECU_ADDRESS 0xd0005cf2 FORMAT "%5.0" /end MEASUREMENT
/begin MEASUREMENT Stx_frm_pool[5].Vxx_rtn_maf "Stored Mass air flow" UWORD _CNV_A_R_LINEAR_____282_CM 1 0. 0. 655.35 ECU_ADDRESS 0xd0005cf4 FORMAT "%6.2" /end MEASUREMENT
/begin MEASUREMENT Stx_frm_pool[5].Vxx_rtn_rail_prs "Stored Rail pressure measured" UWORD _CNV_A_R_LINEAR_____283_CM 1 0. 0. 655350. ECU_ADDRESS 0xd0005cf6 FORMAT "%6.0" /end MEASUREMENT
/begin MEASUREMENT Stx_frm_pool[5].Vxx_rtn_tia "Stored intake air temperature" UBYTE _CNV_A_R_LINEAR_____280_CM 1 0. -40. 215. ECU_ADDRESS 0xd0005cf8 FORMAT "%3.0" /end MEASUREMENT
/begin MEASUREMENT Stx_frm_pool[5].Vxx_dgdftmng_priority "Local frame priority" UBYTE _CNV_A_R_ECME_LINEA_0_CM 1 0. 0. 6. ECU_ADDRESS 0xd0005cf9 FORMAT "%1.0" /end MEASUREMENT
/begin MEASUREMENT Stx_frm_pool[5].Vxx_rtn_rvac "Stored raw Tank differential pressure value for Scantool." SWORD _CNV_A_R_LINEAR_____284_CM 1 0. -8192. 8191.75 ECU_ADDRESS 0xd0005cfa FORMAT "%8.2" /end MEASUREMENT
/begin MEASUREMENT Stx_frm_pool[6].Vxx_rtn_n01 "Stored engine speed" UWORD _CNV_A_R_ENSD_LINEA_22_CM 1 0. 0. 16383.75 ECU_ADDRESS 0xd0005cfc FORMAT "%8.2" /end MEASUREMENT
/begin MEASUREMENT Stx_frm_pool[6].Vxx_obd_fail_code "DTC that caused required freeze frame data storage" UWORD _CNV_A_R_ECME_LINEA_0_CM 1 0. 0. 65535. ECU_ADDRESS 0xd0005cfe FORMAT "%5.0" /end MEASUREMENT
/begin MEASUREMENT Stx_frm_pool[6].Vxx_rtn_eal "Stored calculated load value for the scantool." UBYTE _CNV_A_R_LINEAR_____165_CM 1 0. 0. 100. ECU_ADDRESS 0xd0005d00 FORMAT "%12.8" /end MEASUREMENT
/begin MEASUREMENT Stx_frm_pool[6].Vxx_rtn_vs "Stored filtered vehicule speed." UBYTE _CNV_A_R_LINEAR_____71_CM 1 0. 0. 255. ECU_ADDRESS 0xd0005d01 FORMAT "%3.0" /end MEASUREMENT
/begin MEASUREMENT Stx_frm_pool[6].Vxx_rtn_map "Stored Manifold pressure value measurement" UBYTE _CNV_A_R_LINEAR_____279_CM 1 0. 0. 255. ECU_ADDRESS 0xd0005d02 FORMAT "%3.0" /end MEASUREMENT
/begin MEASUREMENT Stx_frm_pool[6].Vxx_rtn_frm_tco "Stored engine coolant temperature." UBYTE _CNV_A_R_LINEAR_____280_CM 1 0. -40. 215. ECU_ADDRESS 0xd0005d03 FORMAT "%3.0" /end MEASUREMENT
/begin MEASUREMENT Stx_frm_pool[6].Vxx_rtn_mv_ad_fac "Stored mean effective gain applied on injected fuel mass quantity" UBYTE _CNV_A_R_LINEAR_____281_CM 1 0. -100. 99.21875 ECU_ADDRESS 0xd0005d04 FORMAT "%10.5" /end MEASUREMENT
/begin MEASUREMENT Stx_frm_pool[6].Vxx_rtn_rich_loop_ti_fac "Stored multiplicative factor from richness closed loop applied on injected fuel mass quantity" UBYTE _CNV_A_R_LINEAR_____281_CM 1 0. -100. 99.21875 ECU_ADDRESS 0xd0005d05 FORMAT "%10.5" /end MEASUREMENT
/begin MEASUREMENT Stx_frm_pool[6].Vbx_rtn_clos_o2_phs "Stored richness regulation condition" UBYTE _CNV_S_2_RANGE______3_CM 1 0. 0. 1. ECU_ADDRESS 0xd0005d06 BIT_MASK 0x1 /end MEASUREMENT
/begin MEASUREMENT Stx_frm_pool[6].Vxx_rtn_mat "Stored intake air temperature" UBYTE _CNV_A_R_LINEAR_____280_CM 1 0. -40. 215. ECU_ADDRESS 0xd0005d07 FORMAT "%3.0" /end MEASUREMENT
/begin MEASUREMENT Stx_frm_pool[6].Vxx_rtn_clr_dist "Stored distance travelled since last clear" UWORD _CNV_A_R_LINEAR_____274_CM 1 0. 0. 65535. ECU_ADDRESS 0xd0005d08 FORMAT "%5.0" /end MEASUREMENT
/begin MEASUREMENT Stx_frm_pool[6].Vxx_ind_xxx "static index" UWORD _CNV_A_R_ECME_LINEA_0_CM 1 0. 0. 65535. ECU_ADDRESS 0xd0005d0a FORMAT "%5.0" /end MEASUREMENT
/begin MEASUREMENT Stx_frm_pool[6].Vxx_rtn_maf "Stored Mass air flow" UWORD _CNV_A_R_LINEAR_____282_CM 1 0. 0. 655.35 ECU_ADDRESS 0xd0005d0c FORMAT "%6.2" /end MEASUREMENT
/begin MEASUREMENT Stx_frm_pool[6].Vxx_rtn_rail_prs "Stored Rail pressure measured" UWORD _CNV_A_R_LINEAR_____283_CM 1 0. 0. 655350. ECU_ADDRESS 0xd0005d0e FORMAT "%6.0" /end MEASUREMENT
/begin MEASUREMENT Stx_frm_pool[6].Vxx_rtn_tia "Stored intake air temperature" UBYTE _CNV_A_R_LINEAR_____280_CM 1 0. -40. 215. ECU_ADDRESS 0xd0005d10 FORMAT "%3.0" /end MEASUREMENT
/begin MEASUREMENT Stx_frm_pool[6].Vxx_dgdftmng_priority "Local frame priority" UBYTE _CNV_A_R_ECME_LINEA_0_CM 1 0. 0. 6. ECU_ADDRESS 0xd0005d11 FORMAT "%1.0" /end MEASUREMENT
/begin MEASUREMENT Stx_frm_pool[6].Vxx_rtn_rvac "Stored raw Tank differential pressure value for Scantool." SWORD _CNV_A_R_LINEAR_____284_CM 1 0. -8192. 8191.75 ECU_ADDRESS 0xd0005d12 FORMAT "%8.2" /end MEASUREMENT
/begin MEASUREMENT Stx_frm_pool[7].Vxx_rtn_n01 "Stored engine speed" UWORD _CNV_A_R_ENSD_LINEA_22_CM 1 0. 0. 16383.75 ECU_ADDRESS 0xd0005d14 FORMAT "%8.2" /end MEASUREMENT
/begin MEASUREMENT Stx_frm_pool[7].Vxx_obd_fail_code "DTC that caused required freeze frame data storage" UWORD _CNV_A_R_ECME_LINEA_0_CM 1 0. 0. 65535. ECU_ADDRESS 0xd0005d16 FORMAT "%5.0" /end MEASUREMENT
/begin MEASUREMENT Stx_frm_pool[7].Vxx_rtn_eal "Stored calculated load value for the scantool." UBYTE _CNV_A_R_LINEAR_____165_CM 1 0. 0. 100. ECU_ADDRESS 0xd0005d18 FORMAT "%12.8" /end MEASUREMENT
/begin MEASUREMENT Stx_frm_pool[7].Vxx_rtn_vs "Stored filtered vehicule speed." UBYTE _CNV_A_R_LINEAR_____71_CM 1 0. 0. 255. ECU_ADDRESS 0xd0005d19 FORMAT "%3.0" /end MEASUREMENT
/begin MEASUREMENT Stx_frm_pool[7].Vxx_rtn_map "Stored Manifold pressure value measurement" UBYTE _CNV_A_R_LINEAR_____279_CM 1 0. 0. 255. ECU_ADDRESS 0xd0005d1a FORMAT "%3.0" /end MEASUREMENT
/begin MEASUREMENT Stx_frm_pool[7].Vxx_rtn_frm_tco "Stored engine coolant temperature." UBYTE _CNV_A_R_LINEAR_____280_CM 1 0. -40. 215. ECU_ADDRESS 0xd0005d1b FORMAT "%3.0" /end MEASUREMENT
/begin MEASUREMENT Stx_frm_pool[7].Vxx_rtn_mv_ad_fac "Stored mean effective gain applied on injected fuel mass quantity" UBYTE _CNV_A_R_LINEAR_____281_CM 1 0. -100. 99.21875 ECU_ADDRESS 0xd0005d1c FORMAT "%10.5" /end MEASUREMENT
/begin MEASUREMENT Stx_frm_pool[7].Vxx_rtn_rich_loop_ti_fac "Stored multiplicative factor from richness closed loop applied on injected fuel mass quantity" UBYTE _CNV_A_R_LINEAR_____281_CM 1 0. -100. 99.21875 ECU_ADDRESS 0xd0005d1d FORMAT "%10.5" /end MEASUREMENT
/begin MEASUREMENT Stx_frm_pool[7].Vbx_rtn_clos_o2_phs "Stored richness regulation condition" UBYTE _CNV_S_2_RANGE______3_CM 1 0. 0. 1. ECU_ADDRESS 0xd0005d1e BIT_MASK 0x1 /end MEASUREMENT
/begin MEASUREMENT Stx_frm_pool[7].Vxx_rtn_mat "Stored intake air temperature" UBYTE _CNV_A_R_LINEAR_____280_CM 1 0. -40. 215. ECU_ADDRESS 0xd0005d1f FORMAT "%3.0" /end MEASUREMENT
/begin MEASUREMENT Stx_frm_pool[7].Vxx_rtn_clr_dist "Stored distance travelled since last clear" UWORD _CNV_A_R_LINEAR_____274_CM 1 0. 0. 65535. ECU_ADDRESS 0xd0005d20 FORMAT "%5.0" /end MEASUREMENT
/begin MEASUREMENT Stx_frm_pool[7].Vxx_ind_xxx "static index" UWORD _CNV_A_R_ECME_LINEA_0_CM 1 0. 0. 65535. ECU_ADDRESS 0xd0005d22 FORMAT "%5.0" /end MEASUREMENT
/begin MEASUREMENT Stx_frm_pool[7].Vxx_rtn_maf "Stored Mass air flow" UWORD _CNV_A_R_LINEAR_____282_CM 1 0. 0. 655.35 ECU_ADDRESS 0xd0005d24 FORMAT "%6.2" /end MEASUREMENT
/begin MEASUREMENT Stx_frm_pool[7].Vxx_rtn_rail_prs "Stored Rail pressure measured" UWORD _CNV_A_R_LINEAR_____283_CM 1 0. 0. 655350. ECU_ADDRESS 0xd0005d26 FORMAT "%6.0" /end MEASUREMENT
/begin MEASUREMENT Stx_frm_pool[7].Vxx_rtn_tia "Stored intake air temperature" UBYTE _CNV_A_R_LINEAR_____280_CM 1 0. -40. 215. ECU_ADDRESS 0xd0005d28 FORMAT "%3.0" /end MEASUREMENT
/begin MEASUREMENT Stx_frm_pool[7].Vxx_dgdftmng_priority "Local frame priority" UBYTE _CNV_A_R_ECME_LINEA_0_CM 1 0. 0. 6. ECU_ADDRESS 0xd0005d29 FORMAT "%1.0" /end MEASUREMENT
/begin MEASUREMENT Stx_frm_pool[7].Vxx_rtn_rvac "Stored raw Tank differential pressure value for Scantool." SWORD _CNV_A_R_LINEAR_____284_CM 1 0. -8192. 8191.75 ECU_ADDRESS 0xd0005d2a FORMAT "%8.2" /end MEASUREMENT
/begin MEASUREMENT Stx_frm_pool[8].Vxx_rtn_n01 "Stored engine speed" UWORD _CNV_A_R_ENSD_LINEA_22_CM 1 0. 0. 16383.75 ECU_ADDRESS 0xd0005d2c FORMAT "%8.2" /end MEASUREMENT
/begin MEASUREMENT Stx_frm_pool[8].Vxx_obd_fail_code "DTC that caused required freeze frame data storage" UWORD _CNV_A_R_ECME_LINEA_0_CM 1 0. 0. 65535. ECU_ADDRESS 0xd0005d2e FORMAT "%5.0" /end MEASUREMENT
/begin MEASUREMENT Stx_frm_pool[8].Vxx_rtn_eal "Stored calculated load value for the scantool." UBYTE _CNV_A_R_LINEAR_____165_CM 1 0. 0. 100. ECU_ADDRESS 0xd0005d30 FORMAT "%12.8" /end MEASUREMENT
/begin MEASUREMENT Stx_frm_pool[8].Vxx_rtn_vs "Stored filtered vehicule speed." UBYTE _CNV_A_R_LINEAR_____71_CM 1 0. 0. 255. ECU_ADDRESS 0xd0005d31 FORMAT "%3.0" /end MEASUREMENT
/begin MEASUREMENT Stx_frm_pool[8].Vxx_rtn_map "Stored Manifold pressure value measurement" UBYTE _CNV_A_R_LINEAR_____279_CM 1 0. 0. 255. ECU_ADDRESS 0xd0005d32 FORMAT "%3.0" /end MEASUREMENT
/begin MEASUREMENT Stx_frm_pool[8].Vxx_rtn_frm_tco "Stored engine coolant temperature." UBYTE _CNV_A_R_LINEAR_____280_CM 1 0. -40. 215. ECU_ADDRESS 0xd0005d33 FORMAT "%3.0" /end MEASUREMENT
/begin MEASUREMENT Stx_frm_pool[8].Vxx_rtn_mv_ad_fac "Stored mean effective gain applied on injected fuel mass quantity" UBYTE _CNV_A_R_LINEAR_____281_CM 1 0. -100. 99.21875 ECU_ADDRESS 0xd0005d34 FORMAT "%10.5" /end MEASUREMENT
/begin MEASUREMENT Stx_frm_pool[8].Vxx_rtn_rich_loop_ti_fac "Stored multiplicative factor from richness closed loop applied on injected fuel mass quantity" UBYTE _CNV_A_R_LINEAR_____281_CM 1 0. -100. 99.21875 ECU_ADDRESS 0xd0005d35 FORMAT "%10.5" /end MEASUREMENT
/begin MEASUREMENT Stx_frm_pool[8].Vbx_rtn_clos_o2_phs "Stored richness regulation condition" UBYTE _CNV_S_2_RANGE______3_CM 1 0. 0. 1. ECU_ADDRESS 0xd0005d36 BIT_MASK 0x1 /end MEASUREMENT
/begin MEASUREMENT Stx_frm_pool[8].Vxx_rtn_mat "Stored intake air temperature" UBYTE _CNV_A_R_LINEAR_____280_CM 1 0. -40. 215. ECU_ADDRESS 0xd0005d37 FORMAT "%3.0" /end MEASUREMENT
/begin MEASUREMENT Stx_frm_pool[8].Vxx_rtn_clr_dist "Stored distance travelled since last clear" UWORD _CNV_A_R_LINEAR_____274_CM 1 0. 0. 65535. ECU_ADDRESS 0xd0005d38 FORMAT "%5.0" /end MEASUREMENT
/begin MEASUREMENT Stx_frm_pool[8].Vxx_ind_xxx "static index" UWORD _CNV_A_R_ECME_LINEA_0_CM 1 0. 0. 65535. ECU_ADDRESS 0xd0005d3a FORMAT "%5.0" /end MEASUREMENT
/begin MEASUREMENT Stx_frm_pool[8].Vxx_rtn_maf "Stored Mass air flow" UWORD _CNV_A_R_LINEAR_____282_CM 1 0. 0. 655.35 ECU_ADDRESS 0xd0005d3c FORMAT "%6.2" /end MEASUREMENT
/begin MEASUREMENT Stx_frm_pool[8].Vxx_rtn_rail_prs "Stored Rail pressure measured" UWORD _CNV_A_R_LINEAR_____283_CM 1 0. 0. 655350. ECU_ADDRESS 0xd0005d3e FORMAT "%6.0" /end MEASUREMENT
/begin MEASUREMENT Stx_frm_pool[8].Vxx_rtn_tia "Stored intake air temperature" UBYTE _CNV_A_R_LINEAR_____280_CM 1 0. -40. 215. ECU_ADDRESS 0xd0005d40 FORMAT "%3.0" /end MEASUREMENT
/begin MEASUREMENT Stx_frm_pool[8].Vxx_dgdftmng_priority "Local frame priority" UBYTE _CNV_A_R_ECME_LINEA_0_CM 1 0. 0. 6. ECU_ADDRESS 0xd0005d41 FORMAT "%1.0" /end MEASUREMENT
/begin MEASUREMENT Stx_frm_pool[8].Vxx_rtn_rvac "Stored raw Tank differential pressure value for Scantool." SWORD _CNV_A_R_LINEAR_____284_CM 1 0. -8192. 8191.75 ECU_ADDRESS 0xd0005d42 FORMAT "%8.2" /end MEASUREMENT
/begin MEASUREMENT Stx_frm_pool[9].Vxx_rtn_n01 "Stored engine speed" UWORD _CNV_A_R_ENSD_LINEA_22_CM 1 0. 0. 16383.75 ECU_ADDRESS 0xd0005d44 FORMAT "%8.2" /end MEASUREMENT
/begin MEASUREMENT Stx_frm_pool[9].Vxx_obd_fail_code "DTC that caused required freeze frame data storage" UWORD _CNV_A_R_ECME_LINEA_0_CM 1 0. 0. 65535. ECU_ADDRESS 0xd0005d46 FORMAT "%5.0" /end MEASUREMENT
/begin MEASUREMENT Stx_frm_pool[9].Vxx_rtn_eal "Stored calculated load value for the scantool." UBYTE _CNV_A_R_LINEAR_____165_CM 1 0. 0. 100. ECU_ADDRESS 0xd0005d48 FORMAT "%12.8" /end MEASUREMENT
/begin MEASUREMENT Stx_frm_pool[9].Vxx_rtn_vs "Stored filtered vehicule speed." UBYTE _CNV_A_R_LINEAR_____71_CM 1 0. 0. 255. ECU_ADDRESS 0xd0005d49 FORMAT "%3.0" /end MEASUREMENT
/begin MEASUREMENT Stx_frm_pool[9].Vxx_rtn_map "Stored Manifold pressure value measurement" UBYTE _CNV_A_R_LINEAR_____279_CM 1 0. 0. 255. ECU_ADDRESS 0xd0005d4a FORMAT "%3.0" /end MEASUREMENT
/begin MEASUREMENT Stx_frm_pool[9].Vxx_rtn_frm_tco "Stored engine coolant temperature." UBYTE _CNV_A_R_LINEAR_____280_CM 1 0. -40. 215. ECU_ADDRESS 0xd0005d4b FORMAT "%3.0" /end MEASUREMENT
/begin MEASUREMENT Stx_frm_pool[9].Vxx_rtn_mv_ad_fac "Stored mean effective gain applied on injected fuel mass quantity" UBYTE _CNV_A_R_LINEAR_____281_CM 1 0. -100. 99.21875 ECU_ADDRESS 0xd0005d4c FORMAT "%10.5" /end MEASUREMENT
/begin MEASUREMENT Stx_frm_pool[9].Vxx_rtn_rich_loop_ti_fac "Stored multiplicative factor from richness closed loop applied on injected fuel mass quantity" UBYTE _CNV_A_R_LINEAR_____281_CM 1 0. -100. 99.21875 ECU_ADDRESS 0xd0005d4d FORMAT "%10.5" /end MEASUREMENT
/begin MEASUREMENT Stx_frm_pool[9].Vbx_rtn_clos_o2_phs "Stored richness regulation condition" UBYTE _CNV_S_2_RANGE______3_CM 1 0. 0. 1. ECU_ADDRESS 0xd0005d4e BIT_MASK 0x1 /end MEASUREMENT
/begin MEASUREMENT Stx_frm_pool[9].Vxx_rtn_mat "Stored intake air temperature" UBYTE _CNV_A_R_LINEAR_____280_CM 1 0. -40. 215. ECU_ADDRESS 0xd0005d4f FORMAT "%3.0" /end MEASUREMENT
/begin MEASUREMENT Stx_frm_pool[9].Vxx_rtn_clr_dist "Stored distance travelled since last clear" UWORD _CNV_A_R_LINEAR_____274_CM 1 0. 0. 65535. ECU_ADDRESS 0xd0005d50 FORMAT "%5.0" /end MEASUREMENT
/begin MEASUREMENT Stx_frm_pool[9].Vxx_ind_xxx "static index" UWORD _CNV_A_R_ECME_LINEA_0_CM 1 0. 0. 65535. ECU_ADDRESS 0xd0005d52 FORMAT "%5.0" /end MEASUREMENT
/begin MEASUREMENT Stx_frm_pool[9].Vxx_rtn_maf "Stored Mass air flow" UWORD _CNV_A_R_LINEAR_____282_CM 1 0. 0. 655.35 ECU_ADDRESS 0xd0005d54 FORMAT "%6.2" /end MEASUREMENT
/begin MEASUREMENT Stx_frm_pool[9].Vxx_rtn_rail_prs "Stored Rail pressure measured" UWORD _CNV_A_R_LINEAR_____283_CM 1 0. 0. 655350. ECU_ADDRESS 0xd0005d56 FORMAT "%6.0" /end MEASUREMENT
/begin MEASUREMENT Stx_frm_pool[9].Vxx_rtn_tia "Stored intake air temperature" UBYTE _CNV_A_R_LINEAR_____280_CM 1 0. -40. 215. ECU_ADDRESS 0xd0005d58 FORMAT "%3.0" /end MEASUREMENT
/begin MEASUREMENT Stx_frm_pool[9].Vxx_dgdftmng_priority "Local frame priority" UBYTE _CNV_A_R_ECME_LINEA_0_CM 1 0. 0. 6. ECU_ADDRESS 0xd0005d59 FORMAT "%1.0" /end MEASUREMENT
/begin MEASUREMENT Stx_frm_pool[9].Vxx_rtn_rvac "Stored raw Tank differential pressure value for Scantool." SWORD _CNV_A_R_LINEAR_____284_CM 1 0. -8192. 8191.75 ECU_ADDRESS 0xd0005d5a FORMAT "%8.2" /end MEASUREMENT
/begin MEASUREMENT Vtx_frm[0].Vxx_rtn_n01 "Stored engine speed" UWORD _CNV_A_R_ENSD_LINEA_22_CM 1 0. 0. 16383.75 ECU_ADDRESS 0xd0005d5c FORMAT "%8.2" /end MEASUREMENT
/begin MEASUREMENT Vtx_frm[0].Vxx_obd_fail_code "DTC that caused required freeze frame data storage" UWORD _CNV_A_R_ECME_LINEA_0_CM 1 0. 0. 65535. ECU_ADDRESS 0xd0005d5e FORMAT "%5.0" /end MEASUREMENT
/begin MEASUREMENT Vtx_frm[0].Vxx_rtn_eal "Stored calculated load value for the scantool." UBYTE _CNV_A_R_LINEAR_____165_CM 1 0. 0. 100. ECU_ADDRESS 0xd0005d60 FORMAT "%12.8" /end MEASUREMENT
/begin MEASUREMENT Vtx_frm[0].Vxx_rtn_vs "Stored filtered vehicule speed." UBYTE _CNV_A_R_LINEAR_____71_CM 1 0. 0. 255. ECU_ADDRESS 0xd0005d61 FORMAT "%3.0" /end MEASUREMENT
/begin MEASUREMENT Vtx_frm[0].Vxx_rtn_map "Stored Manifold pressure value measurement" UBYTE _CNV_A_R_LINEAR_____279_CM 1 0. 0. 255. ECU_ADDRESS 0xd0005d62 FORMAT "%3.0" /end MEASUREMENT
/begin MEASUREMENT Vtx_frm[0].Vxx_rtn_frm_tco "Stored engine coolant temperature." UBYTE _CNV_A_R_LINEAR_____280_CM 1 0. -40. 215. ECU_ADDRESS 0xd0005d63 FORMAT "%3.0" /end MEASUREMENT
/begin MEASUREMENT Vtx_frm[0].Vxx_rtn_mv_ad_fac "Stored mean effective gain applied on injected fuel mass quantity" UBYTE _CNV_A_R_LINEAR_____281_CM 1 0. -100. 99.21875 ECU_ADDRESS 0xd0005d64 FORMAT "%10.5" /end MEASUREMENT
/begin MEASUREMENT Vtx_frm[0].Vxx_rtn_rich_loop_ti_fac "Stored multiplicative factor from richness closed loop applied on injected fuel mass quantity" UBYTE _CNV_A_R_LINEAR_____281_CM 1 0. -100. 99.21875 ECU_ADDRESS 0xd0005d65 FORMAT "%10.5" /end MEASUREMENT
/begin MEASUREMENT Vtx_frm[0].Vbx_rtn_clos_o2_phs "Stored richness regulation condition" UBYTE _CNV_S_2_RANGE______3_CM 1 0. 0. 1. ECU_ADDRESS 0xd0005d66 BIT_MASK 0x1 /end MEASUREMENT
/begin MEASUREMENT Vtx_frm[0].Vxx_rtn_mat "Stored intake air temperature" UBYTE _CNV_A_R_LINEAR_____280_CM 1 0. -40. 215. ECU_ADDRESS 0xd0005d67 FORMAT "%3.0" /end MEASUREMENT
/begin MEASUREMENT Vtx_frm[0].Vxx_rtn_clr_dist "Stored distance travelled since last clear" UWORD _CNV_A_R_LINEAR_____274_CM 1 0. 0. 65535. ECU_ADDRESS 0xd0005d68 FORMAT "%5.0" /end MEASUREMENT
/begin MEASUREMENT Vtx_frm[0].Vxx_ind_xxx "static index" UWORD _CNV_A_R_ECME_LINEA_0_CM 1 0. 0. 65535. ECU_ADDRESS 0xd0005d6a FORMAT "%5.0" /end MEASUREMENT
/begin MEASUREMENT Vtx_frm[0].Vxx_rtn_maf "Stored Mass air flow" UWORD _CNV_A_R_LINEAR_____282_CM 1 0. 0. 655.35 ECU_ADDRESS 0xd0005d6c FORMAT "%6.2" /end MEASUREMENT
/begin MEASUREMENT Vtx_frm[0].Vxx_rtn_rail_prs "Stored Rail pressure measured" UWORD _CNV_A_R_LINEAR_____283_CM 1 0. 0. 655350. ECU_ADDRESS 0xd0005d6e FORMAT "%6.0" /end MEASUREMENT
/begin MEASUREMENT Vtx_frm[0].Vxx_rtn_tia "Stored intake air temperature" UBYTE _CNV_A_R_LINEAR_____280_CM 1 0. -40. 215. ECU_ADDRESS 0xd0005d70 FORMAT "%3.0" /end MEASUREMENT
/begin MEASUREMENT Vtx_frm[0].Vxx_dgdftmng_priority "Local frame priority" UBYTE _CNV_A_R_ECME_LINEA_0_CM 1 0. 0. 6. ECU_ADDRESS 0xd0005d71 FORMAT "%1.0" /end MEASUREMENT
/begin MEASUREMENT Vtx_frm[0].Vxx_rtn_rvac "Stored raw Tank differential pressure value for Scantool." SWORD _CNV_A_R_LINEAR_____284_CM 1 0. -8192. 8191.75 ECU_ADDRESS 0xd0005d72 FORMAT "%8.2" /end MEASUREMENT
/begin MEASUREMENT Vtx_frm[1].Vxx_rtn_n01 "Stored engine speed" UWORD _CNV_A_R_ENSD_LINEA_22_CM 1 0. 0. 16383.75 ECU_ADDRESS 0xd0005d74 FORMAT "%8.2" /end MEASUREMENT
/begin MEASUREMENT Vtx_frm[1].Vxx_obd_fail_code "DTC that caused required freeze frame data storage" UWORD _CNV_A_R_ECME_LINEA_0_CM 1 0. 0. 65535. ECU_ADDRESS 0xd0005d76 FORMAT "%5.0" /end MEASUREMENT
/begin MEASUREMENT Vtx_frm[1].Vxx_rtn_eal "Stored calculated load value for the scantool." UBYTE _CNV_A_R_LINEAR_____165_CM 1 0. 0. 100. ECU_ADDRESS 0xd0005d78 FORMAT "%12.8" /end MEASUREMENT
/begin MEASUREMENT Vtx_frm[1].Vxx_rtn_vs "Stored filtered vehicule speed." UBYTE _CNV_A_R_LINEAR_____71_CM 1 0. 0. 255. ECU_ADDRESS 0xd0005d79 FORMAT "%3.0" /end MEASUREMENT
/begin MEASUREMENT Vtx_frm[1].Vxx_rtn_map "Stored Manifold pressure value measurement" UBYTE _CNV_A_R_LINEAR_____279_CM 1 0. 0. 255. ECU_ADDRESS 0xd0005d7a FORMAT "%3.0" /end MEASUREMENT
/begin MEASUREMENT Vtx_frm[1].Vxx_rtn_frm_tco "Stored engine coolant temperature." UBYTE _CNV_A_R_LINEAR_____280_CM 1 0. -40. 215. ECU_ADDRESS 0xd0005d7b FORMAT "%3.0" /end MEASUREMENT
/begin MEASUREMENT Vtx_frm[1].Vxx_rtn_mv_ad_fac "Stored mean effective gain applied on injected fuel mass quantity" UBYTE _CNV_A_R_LINEAR_____281_CM 1 0. -100. 99.21875 ECU_ADDRESS 0xd0005d7c FORMAT "%10.5" /end MEASUREMENT
/begin MEASUREMENT Vtx_frm[1].Vxx_rtn_rich_loop_ti_fac "Stored multiplicative factor from richness closed loop applied on injected fuel mass quantity" UBYTE _CNV_A_R_LINEAR_____281_CM 1 0. -100. 99.21875 ECU_ADDRESS 0xd0005d7d FORMAT "%10.5" /end MEASUREMENT
/begin MEASUREMENT Vtx_frm[1].Vbx_rtn_clos_o2_phs "Stored richness regulation condition" UBYTE _CNV_S_2_RANGE______3_CM 1 0. 0. 1. ECU_ADDRESS 0xd0005d7e BIT_MASK 0x1 /end MEASUREMENT
/begin MEASUREMENT Vtx_frm[1].Vxx_rtn_mat "Stored intake air temperature" UBYTE _CNV_A_R_LINEAR_____280_CM 1 0. -40. 215. ECU_ADDRESS 0xd0005d7f FORMAT "%3.0" /end MEASUREMENT
/begin MEASUREMENT Vtx_frm[1].Vxx_rtn_clr_dist "Stored distance travelled since last clear" UWORD _CNV_A_R_LINEAR_____274_CM 1 0. 0. 65535. ECU_ADDRESS 0xd0005d80 FORMAT "%5.0" /end MEASUREMENT
/begin MEASUREMENT Vtx_frm[1].Vxx_ind_xxx "static index" UWORD _CNV_A_R_ECME_LINEA_0_CM 1 0. 0. 65535. ECU_ADDRESS 0xd0005d82 FORMAT "%5.0" /end MEASUREMENT
/begin MEASUREMENT Vtx_frm[1].Vxx_rtn_maf "Stored Mass air flow" UWORD _CNV_A_R_LINEAR_____282_CM 1 0. 0. 655.35 ECU_ADDRESS 0xd0005d84 FORMAT "%6.2" /end MEASUREMENT
/begin MEASUREMENT Vtx_frm[1].Vxx_rtn_rail_prs "Stored Rail pressure measured" UWORD _CNV_A_R_LINEAR_____283_CM 1 0. 0. 655350. ECU_ADDRESS 0xd0005d86 FORMAT "%6.0" /end MEASUREMENT
/begin MEASUREMENT Vtx_frm[1].Vxx_rtn_tia "Stored intake air temperature" UBYTE _CNV_A_R_LINEAR_____280_CM 1 0. -40. 215. ECU_ADDRESS 0xd0005d88 FORMAT "%3.0" /end MEASUREMENT
/begin MEASUREMENT Vtx_frm[1].Vxx_dgdftmng_priority "Local frame priority" UBYTE _CNV_A_R_ECME_LINEA_0_CM 1 0. 0. 6. ECU_ADDRESS 0xd0005d89 FORMAT "%1.0" /end MEASUREMENT
/begin MEASUREMENT Vtx_frm[1].Vxx_rtn_rvac "Stored raw Tank differential pressure value for Scantool." SWORD _CNV_A_R_LINEAR_____284_CM 1 0. -8192. 8191.75 ECU_ADDRESS 0xd0005d8a FORMAT "%8.2" /end MEASUREMENT
/begin MEASUREMENT Vtx_frm[2].Vxx_rtn_n01 "Stored engine speed" UWORD _CNV_A_R_ENSD_LINEA_22_CM 1 0. 0. 16383.75 ECU_ADDRESS 0xd0005d8c FORMAT "%8.2" /end MEASUREMENT
/begin MEASUREMENT Vtx_frm[2].Vxx_obd_fail_code "DTC that caused required freeze frame data storage" UWORD _CNV_A_R_ECME_LINEA_0_CM 1 0. 0. 65535. ECU_ADDRESS 0xd0005d8e FORMAT "%5.0" /end MEASUREMENT
/begin MEASUREMENT Vtx_frm[2].Vxx_rtn_eal "Stored calculated load value for the scantool." UBYTE _CNV_A_R_LINEAR_____165_CM 1 0. 0. 100. ECU_ADDRESS 0xd0005d90 FORMAT "%12.8" /end MEASUREMENT
/begin MEASUREMENT Vtx_frm[2].Vxx_rtn_vs "Stored filtered vehicule speed." UBYTE _CNV_A_R_LINEAR_____71_CM 1 0. 0. 255. ECU_ADDRESS 0xd0005d91 FORMAT "%3.0" /end MEASUREMENT
/begin MEASUREMENT Vtx_frm[2].Vxx_rtn_map "Stored Manifold pressure value measurement" UBYTE _CNV_A_R_LINEAR_____279_CM 1 0. 0. 255. ECU_ADDRESS 0xd0005d92 FORMAT "%3.0" /end MEASUREMENT
/begin MEASUREMENT Vtx_frm[2].Vxx_rtn_frm_tco "Stored engine coolant temperature." UBYTE _CNV_A_R_LINEAR_____280_CM 1 0. -40. 215. ECU_ADDRESS 0xd0005d93 FORMAT "%3.0" /end MEASUREMENT
/begin MEASUREMENT Vtx_frm[2].Vxx_rtn_mv_ad_fac "Stored mean effective gain applied on injected fuel mass quantity" UBYTE _CNV_A_R_LINEAR_____281_CM 1 0. -100. 99.21875 ECU_ADDRESS 0xd0005d94 FORMAT "%10.5" /end MEASUREMENT
/begin MEASUREMENT Vtx_frm[2].Vxx_rtn_rich_loop_ti_fac "Stored multiplicative factor from richness closed loop applied on injected fuel mass quantity" UBYTE _CNV_A_R_LINEAR_____281_CM 1 0. -100. 99.21875 ECU_ADDRESS 0xd0005d95 FORMAT "%10.5" /end MEASUREMENT
/begin MEASUREMENT Vtx_frm[2].Vbx_rtn_clos_o2_phs "Stored richness regulation condition" UBYTE _CNV_S_2_RANGE______3_CM 1 0. 0. 1. ECU_ADDRESS 0xd0005d96 BIT_MASK 0x1 /end MEASUREMENT
/begin MEASUREMENT Vtx_frm[2].Vxx_rtn_mat "Stored intake air temperature" UBYTE _CNV_A_R_LINEAR_____280_CM 1 0. -40. 215. ECU_ADDRESS 0xd0005d97 FORMAT "%3.0" /end MEASUREMENT
/begin MEASUREMENT Vtx_frm[2].Vxx_rtn_clr_dist "Stored distance travelled since last clear" UWORD _CNV_A_R_LINEAR_____274_CM 1 0. 0. 65535. ECU_ADDRESS 0xd0005d98 FORMAT "%5.0" /end MEASUREMENT
/begin MEASUREMENT Vtx_frm[2].Vxx_ind_xxx "static index" UWORD _CNV_A_R_ECME_LINEA_0_CM 1 0. 0. 65535. ECU_ADDRESS 0xd0005d9a FORMAT "%5.0" /end MEASUREMENT
/begin MEASUREMENT Vtx_frm[2].Vxx_rtn_maf "Stored Mass air flow" UWORD _CNV_A_R_LINEAR_____282_CM 1 0. 0. 655.35 ECU_ADDRESS 0xd0005d9c FORMAT "%6.2" /end MEASUREMENT
/begin MEASUREMENT Vtx_frm[2].Vxx_rtn_rail_prs "Stored Rail pressure measured" UWORD _CNV_A_R_LINEAR_____283_CM 1 0. 0. 655350. ECU_ADDRESS 0xd0005d9e FORMAT "%6.0" /end MEASUREMENT
/begin MEASUREMENT Vtx_frm[2].Vxx_rtn_tia "Stored intake air temperature" UBYTE _CNV_A_R_LINEAR_____280_CM 1 0. -40. 215. ECU_ADDRESS 0xd0005da0 FORMAT "%3.0" /end MEASUREMENT
/begin MEASUREMENT Vtx_frm[2].Vxx_dgdftmng_priority "Local frame priority" UBYTE _CNV_A_R_ECME_LINEA_0_CM 1 0. 0. 6. ECU_ADDRESS 0xd0005da1 FORMAT "%1.0" /end MEASUREMENT
/begin MEASUREMENT Vtx_frm[2].Vxx_rtn_rvac "Stored raw Tank differential pressure value for Scantool." SWORD _CNV_A_R_LINEAR_____284_CM 1 0. -8192. 8191.75 ECU_ADDRESS 0xd0005da2 FORMAT "%8.2" /end MEASUREMENT
/begin MEASUREMENT Vtx_frm[3].Vxx_rtn_n01 "Stored engine speed" UWORD _CNV_A_R_ENSD_LINEA_22_CM 1 0. 0. 16383.75 ECU_ADDRESS 0xd0005da4 FORMAT "%8.2" /end MEASUREMENT
/begin MEASUREMENT Vtx_frm[3].Vxx_obd_fail_code "DTC that caused required freeze frame data storage" UWORD _CNV_A_R_ECME_LINEA_0_CM 1 0. 0. 65535. ECU_ADDRESS 0xd0005da6 FORMAT "%5.0" /end MEASUREMENT
/begin MEASUREMENT Vtx_frm[3].Vxx_rtn_eal "Stored calculated load value for the scantool." UBYTE _CNV_A_R_LINEAR_____165_CM 1 0. 0. 100. ECU_ADDRESS 0xd0005da8 FORMAT "%12.8" /end MEASUREMENT
/begin MEASUREMENT Vtx_frm[3].Vxx_rtn_vs "Stored filtered vehicule speed." UBYTE _CNV_A_R_LINEAR_____71_CM 1 0. 0. 255. ECU_ADDRESS 0xd0005da9 FORMAT "%3.0" /end MEASUREMENT
/begin MEASUREMENT Vtx_frm[3].Vxx_rtn_map "Stored Manifold pressure value measurement" UBYTE _CNV_A_R_LINEAR_____279_CM 1 0. 0. 255. ECU_ADDRESS 0xd0005daa FORMAT "%3.0" /end MEASUREMENT
/begin MEASUREMENT Vtx_frm[3].Vxx_rtn_frm_tco "Stored engine coolant temperature." UBYTE _CNV_A_R_LINEAR_____280_CM 1 0. -40. 215. ECU_ADDRESS 0xd0005dab FORMAT "%3.0" /end MEASUREMENT
/begin MEASUREMENT Vtx_frm[3].Vxx_rtn_mv_ad_fac "Stored mean effective gain applied on injected fuel mass quantity" UBYTE _CNV_A_R_LINEAR_____281_CM 1 0. -100. 99.21875 ECU_ADDRESS 0xd0005dac FORMAT "%10.5" /end MEASUREMENT
/begin MEASUREMENT Vtx_frm[3].Vxx_rtn_rich_loop_ti_fac "Stored multiplicative factor from richness closed loop applied on injected fuel mass quantity" UBYTE _CNV_A_R_LINEAR_____281_CM 1 0. -100. 99.21875 ECU_ADDRESS 0xd0005dad FORMAT "%10.5" /end MEASUREMENT
/begin MEASUREMENT Vtx_frm[3].Vbx_rtn_clos_o2_phs "Stored richness regulation condition" UBYTE _CNV_S_2_RANGE______3_CM 1 0. 0. 1. ECU_ADDRESS 0xd0005dae BIT_MASK 0x1 /end MEASUREMENT
/begin MEASUREMENT Vtx_frm[3].Vxx_rtn_mat "Stored intake air temperature" UBYTE _CNV_A_R_LINEAR_____280_CM 1 0. -40. 215. ECU_ADDRESS 0xd0005daf FORMAT "%3.0" /end MEASUREMENT
/begin MEASUREMENT Vtx_frm[3].Vxx_rtn_clr_dist "Stored distance travelled since last clear" UWORD _CNV_A_R_LINEAR_____274_CM 1 0. 0. 65535. ECU_ADDRESS 0xd0005db0 FORMAT "%5.0" /end MEASUREMENT
/begin MEASUREMENT Vtx_frm[3].Vxx_ind_xxx "static index" UWORD _CNV_A_R_ECME_LINEA_0_CM 1 0. 0. 65535. ECU_ADDRESS 0xd0005db2 FORMAT "%5.0" /end MEASUREMENT
/begin MEASUREMENT Vtx_frm[3].Vxx_rtn_maf "Stored Mass air flow" UWORD _CNV_A_R_LINEAR_____282_CM 1 0. 0. 655.35 ECU_ADDRESS 0xd0005db4 FORMAT "%6.2" /end MEASUREMENT
/begin MEASUREMENT Vtx_frm[3].Vxx_rtn_rail_prs "Stored Rail pressure measured" UWORD _CNV_A_R_LINEAR_____283_CM 1 0. 0. 655350. ECU_ADDRESS 0xd0005db6 FORMAT "%6.0" /end MEASUREMENT
/begin MEASUREMENT Vtx_frm[3].Vxx_rtn_tia "Stored intake air temperature" UBYTE _CNV_A_R_LINEAR_____280_CM 1 0. -40. 215. ECU_ADDRESS 0xd0005db8 FORMAT "%3.0" /end MEASUREMENT
/begin MEASUREMENT Vtx_frm[3].Vxx_dgdftmng_priority "Local frame priority" UBYTE _CNV_A_R_ECME_LINEA_0_CM 1 0. 0. 6. ECU_ADDRESS 0xd0005db9 FORMAT "%1.0" /end MEASUREMENT
/begin MEASUREMENT Vtx_frm[3].Vxx_rtn_rvac "Stored raw Tank differential pressure value for Scantool." SWORD _CNV_A_R_LINEAR_____284_CM 1 0. -8192. 8191.75 ECU_ADDRESS 0xd0005dba FORMAT "%8.2" /end MEASUREMENT
/begin MEASUREMENT Vtx_frm[4].Vxx_rtn_n01 "Stored engine speed" UWORD _CNV_A_R_ENSD_LINEA_22_CM 1 0. 0. 16383.75 ECU_ADDRESS 0xd0005dbc FORMAT "%8.2" /end MEASUREMENT
/begin MEASUREMENT Vtx_frm[4].Vxx_obd_fail_code "DTC that caused required freeze frame data storage" UWORD _CNV_A_R_ECME_LINEA_0_CM 1 0. 0. 65535. ECU_ADDRESS 0xd0005dbe FORMAT "%5.0" /end MEASUREMENT
/begin MEASUREMENT Vtx_frm[4].Vxx_rtn_eal "Stored calculated load value for the scantool." UBYTE _CNV_A_R_LINEAR_____165_CM 1 0. 0. 100. ECU_ADDRESS 0xd0005dc0 FORMAT "%12.8" /end MEASUREMENT
/begin MEASUREMENT Vtx_frm[4].Vxx_rtn_vs "Stored filtered vehicule speed." UBYTE _CNV_A_R_LINEAR_____71_CM 1 0. 0. 255. ECU_ADDRESS 0xd0005dc1 FORMAT "%3.0" /end MEASUREMENT
/begin MEASUREMENT Vtx_frm[4].Vxx_rtn_map "Stored Manifold pressure value measurement" UBYTE _CNV_A_R_LINEAR_____279_CM 1 0. 0. 255. ECU_ADDRESS 0xd0005dc2 FORMAT "%3.0" /end MEASUREMENT
/begin MEASUREMENT Vtx_frm[4].Vxx_rtn_frm_tco "Stored engine coolant temperature." UBYTE _CNV_A_R_LINEAR_____280_CM 1 0. -40. 215. ECU_ADDRESS 0xd0005dc3 FORMAT "%3.0" /end MEASUREMENT
/begin MEASUREMENT Vtx_frm[4].Vxx_rtn_mv_ad_fac "Stored mean effective gain applied on injected fuel mass quantity" UBYTE _CNV_A_R_LINEAR_____281_CM 1 0. -100. 99.21875 ECU_ADDRESS 0xd0005dc4 FORMAT "%10.5" /end MEASUREMENT
/begin MEASUREMENT Vtx_frm[4].Vxx_rtn_rich_loop_ti_fac "Stored multiplicative factor from richness closed loop applied on injected fuel mass quantity" UBYTE _CNV_A_R_LINEAR_____281_CM 1 0. -100. 99.21875 ECU_ADDRESS 0xd0005dc5 FORMAT "%10.5" /end MEASUREMENT
/begin MEASUREMENT Vtx_frm[4].Vbx_rtn_clos_o2_phs "Stored richness regulation condition" UBYTE _CNV_S_2_RANGE______3_CM 1 0. 0. 1. ECU_ADDRESS 0xd0005dc6 BIT_MASK 0x1 /end MEASUREMENT
/begin MEASUREMENT Vtx_frm[4].Vxx_rtn_mat "Stored intake air temperature" UBYTE _CNV_A_R_LINEAR_____280_CM 1 0. -40. 215. ECU_ADDRESS 0xd0005dc7 FORMAT "%3.0" /end MEASUREMENT
/begin MEASUREMENT Vtx_frm[4].Vxx_rtn_clr_dist "Stored distance travelled since last clear" UWORD _CNV_A_R_LINEAR_____274_CM 1 0. 0. 65535. ECU_ADDRESS 0xd0005dc8 FORMAT "%5.0" /end MEASUREMENT
/begin MEASUREMENT Vtx_frm[4].Vxx_ind_xxx "static index" UWORD _CNV_A_R_ECME_LINEA_0_CM 1 0. 0. 65535. ECU_ADDRESS 0xd0005dca FORMAT "%5.0" /end MEASUREMENT
/begin MEASUREMENT Vtx_frm[4].Vxx_rtn_maf "Stored Mass air flow" UWORD _CNV_A_R_LINEAR_____282_CM 1 0. 0. 655.35 ECU_ADDRESS 0xd0005dcc FORMAT "%6.2" /end MEASUREMENT
/begin MEASUREMENT Vtx_frm[4].Vxx_rtn_rail_prs "Stored Rail pressure measured" UWORD _CNV_A_R_LINEAR_____283_CM 1 0. 0. 655350. ECU_ADDRESS 0xd0005dce FORMAT "%6.0" /end MEASUREMENT
/begin MEASUREMENT Vtx_frm[4].Vxx_rtn_tia "Stored intake air temperature" UBYTE _CNV_A_R_LINEAR_____280_CM 1 0. -40. 215. ECU_ADDRESS 0xd0005dd0 FORMAT "%3.0" /end MEASUREMENT
/begin MEASUREMENT Vtx_frm[4].Vxx_dgdftmng_priority "Local frame priority" UBYTE _CNV_A_R_ECME_LINEA_0_CM 1 0. 0. 6. ECU_ADDRESS 0xd0005dd1 FORMAT "%1.0" /end MEASUREMENT
/begin MEASUREMENT Vtx_frm[4].Vxx_rtn_rvac "Stored raw Tank differential pressure value for Scantool." SWORD _CNV_A_R_LINEAR_____284_CM 1 0. -8192. 8191.75 ECU_ADDRESS 0xd0005dd2 FORMAT "%8.2" /end MEASUREMENT
/begin MEASUREMENT Vtx_frm[5].Vxx_rtn_n01 "Stored engine speed" UWORD _CNV_A_R_ENSD_LINEA_22_CM 1 0. 0. 16383.75 ECU_ADDRESS 0xd0005dd4 FORMAT "%8.2" /end MEASUREMENT
/begin MEASUREMENT Vtx_frm[5].Vxx_obd_fail_code "DTC that caused required freeze frame data storage" UWORD _CNV_A_R_ECME_LINEA_0_CM 1 0. 0. 65535. ECU_ADDRESS 0xd0005dd6 FORMAT "%5.0" /end MEASUREMENT
/begin MEASUREMENT Vtx_frm[5].Vxx_rtn_eal "Stored calculated load value for the scantool." UBYTE _CNV_A_R_LINEAR_____165_CM 1 0. 0. 100. ECU_ADDRESS 0xd0005dd8 FORMAT "%12.8" /end MEASUREMENT
/begin MEASUREMENT Vtx_frm[5].Vxx_rtn_vs "Stored filtered vehicule speed." UBYTE _CNV_A_R_LINEAR_____71_CM 1 0. 0. 255. ECU_ADDRESS 0xd0005dd9 FORMAT "%3.0" /end MEASUREMENT
/begin MEASUREMENT Vtx_frm[5].Vxx_rtn_map "Stored Manifold pressure value measurement" UBYTE _CNV_A_R_LINEAR_____279_CM 1 0. 0. 255. ECU_ADDRESS 0xd0005dda FORMAT "%3.0" /end MEASUREMENT
/begin MEASUREMENT Vtx_frm[5].Vxx_rtn_frm_tco "Stored engine coolant temperature." UBYTE _CNV_A_R_LINEAR_____280_CM 1 0. -40. 215. ECU_ADDRESS 0xd0005ddb FORMAT "%3.0" /end MEASUREMENT
/begin MEASUREMENT Vtx_frm[5].Vxx_rtn_mv_ad_fac "Stored mean effective gain applied on injected fuel mass quantity" UBYTE _CNV_A_R_LINEAR_____281_CM 1 0. -100. 99.21875 ECU_ADDRESS 0xd0005ddc FORMAT "%10.5" /end MEASUREMENT
/begin MEASUREMENT Vtx_frm[5].Vxx_rtn_rich_loop_ti_fac "Stored multiplicative factor from richness closed loop applied on injected fuel mass quantity" UBYTE _CNV_A_R_LINEAR_____281_CM 1 0. -100. 99.21875 ECU_ADDRESS 0xd0005ddd FORMAT "%10.5" /end MEASUREMENT
/begin MEASUREMENT Vtx_frm[5].Vbx_rtn_clos_o2_phs "Stored richness regulation condition" UBYTE _CNV_S_2_RANGE______3_CM 1 0. 0. 1. ECU_ADDRESS 0xd0005dde BIT_MASK 0x1 /end MEASUREMENT
/begin MEASUREMENT Vtx_frm[5].Vxx_rtn_mat "Stored intake air temperature" UBYTE _CNV_A_R_LINEAR_____280_CM 1 0. -40. 215. ECU_ADDRESS 0xd0005ddf FORMAT "%3.0" /end MEASUREMENT
/begin MEASUREMENT Vtx_frm[5].Vxx_rtn_clr_dist "Stored distance travelled since last clear" UWORD _CNV_A_R_LINEAR_____274_CM 1 0. 0. 65535. ECU_ADDRESS 0xd0005de0 FORMAT "%5.0" /end MEASUREMENT
/begin MEASUREMENT Vtx_frm[5].Vxx_ind_xxx "static index" UWORD _CNV_A_R_ECME_LINEA_0_CM 1 0. 0. 65535. ECU_ADDRESS 0xd0005de2 FORMAT "%5.0" /end MEASUREMENT
/begin MEASUREMENT Vtx_frm[5].Vxx_rtn_maf "Stored Mass air flow" UWORD _CNV_A_R_LINEAR_____282_CM 1 0. 0. 655.35 ECU_ADDRESS 0xd0005de4 FORMAT "%6.2" /end MEASUREMENT
/begin MEASUREMENT Vtx_frm[5].Vxx_rtn_rail_prs "Stored Rail pressure measured" UWORD _CNV_A_R_LINEAR_____283_CM 1 0. 0. 655350. ECU_ADDRESS 0xd0005de6 FORMAT "%6.0" /end MEASUREMENT
/begin MEASUREMENT Vtx_frm[5].Vxx_rtn_tia "Stored intake air temperature" UBYTE _CNV_A_R_LINEAR_____280_CM 1 0. -40. 215. ECU_ADDRESS 0xd0005de8 FORMAT "%3.0" /end MEASUREMENT
/begin MEASUREMENT Vtx_frm[5].Vxx_dgdftmng_priority "Local frame priority" UBYTE _CNV_A_R_ECME_LINEA_0_CM 1 0. 0. 6. ECU_ADDRESS 0xd0005de9 FORMAT "%1.0" /end MEASUREMENT
/begin MEASUREMENT Vtx_frm[5].Vxx_rtn_rvac "Stored raw Tank differential pressure value for Scantool." SWORD _CNV_A_R_LINEAR_____284_CM 1 0. -8192. 8191.75 ECU_ADDRESS 0xd0005dea FORMAT "%8.2" /end MEASUREMENT
/begin MEASUREMENT Vtx_frm[6].Vxx_rtn_n01 "Stored engine speed" UWORD _CNV_A_R_ENSD_LINEA_22_CM 1 0. 0. 16383.75 ECU_ADDRESS 0xd0005dec FORMAT "%8.2" /end MEASUREMENT
/begin MEASUREMENT Vtx_frm[6].Vxx_obd_fail_code "DTC that caused required freeze frame data storage" UWORD _CNV_A_R_ECME_LINEA_0_CM 1 0. 0. 65535. ECU_ADDRESS 0xd0005dee FORMAT "%5.0" /end MEASUREMENT
/begin MEASUREMENT Vtx_frm[6].Vxx_rtn_eal "Stored calculated load value for the scantool." UBYTE _CNV_A_R_LINEAR_____165_CM 1 0. 0. 100. ECU_ADDRESS 0xd0005df0 FORMAT "%12.8" /end MEASUREMENT
/begin MEASUREMENT Vtx_frm[6].Vxx_rtn_vs "Stored filtered vehicule speed." UBYTE _CNV_A_R_LINEAR_____71_CM 1 0. 0. 255. ECU_ADDRESS 0xd0005df1 FORMAT "%3.0" /end MEASUREMENT
/begin MEASUREMENT Vtx_frm[6].Vxx_rtn_map "Stored Manifold pressure value measurement" UBYTE _CNV_A_R_LINEAR_____279_CM 1 0. 0. 255. ECU_ADDRESS 0xd0005df2 FORMAT "%3.0" /end MEASUREMENT
/begin MEASUREMENT Vtx_frm[6].Vxx_rtn_frm_tco "Stored engine coolant temperature." UBYTE _CNV_A_R_LINEAR_____280_CM 1 0. -40. 215. ECU_ADDRESS 0xd0005df3 FORMAT "%3.0" /end MEASUREMENT
/begin MEASUREMENT Vtx_frm[6].Vxx_rtn_mv_ad_fac "Stored mean effective gain applied on injected fuel mass quantity" UBYTE _CNV_A_R_LINEAR_____281_CM 1 0. -100. 99.21875 ECU_ADDRESS 0xd0005df4 FORMAT "%10.5" /end MEASUREMENT
/begin MEASUREMENT Vtx_frm[6].Vxx_rtn_rich_loop_ti_fac "Stored multiplicative factor from richness closed loop applied on injected fuel mass quantity" UBYTE _CNV_A_R_LINEAR_____281_CM 1 0. -100. 99.21875 ECU_ADDRESS 0xd0005df5 FORMAT "%10.5" /end MEASUREMENT
/begin MEASUREMENT Vtx_frm[6].Vbx_rtn_clos_o2_phs "Stored richness regulation condition" UBYTE _CNV_S_2_RANGE______3_CM 1 0. 0. 1. ECU_ADDRESS 0xd0005df6 BIT_MASK 0x1 /end MEASUREMENT
/begin MEASUREMENT Vtx_frm[6].Vxx_rtn_mat "Stored intake air temperature" UBYTE _CNV_A_R_LINEAR_____280_CM 1 0. -40. 215. ECU_ADDRESS 0xd0005df7 FORMAT "%3.0" /end MEASUREMENT
/begin MEASUREMENT Vtx_frm[6].Vxx_rtn_clr_dist "Stored distance travelled since last clear" UWORD _CNV_A_R_LINEAR_____274_CM 1 0. 0. 65535. ECU_ADDRESS 0xd0005df8 FORMAT "%5.0" /end MEASUREMENT
/begin MEASUREMENT Vtx_frm[6].Vxx_ind_xxx "static index" UWORD _CNV_A_R_ECME_LINEA_0_CM 1 0. 0. 65535. ECU_ADDRESS 0xd0005dfa FORMAT "%5.0" /end MEASUREMENT
/begin MEASUREMENT Vtx_frm[6].Vxx_rtn_maf "Stored Mass air flow" UWORD _CNV_A_R_LINEAR_____282_CM 1 0. 0. 655.35 ECU_ADDRESS 0xd0005dfc FORMAT "%6.2" /end MEASUREMENT
/begin MEASUREMENT Vtx_frm[6].Vxx_rtn_rail_prs "Stored Rail pressure measured" UWORD _CNV_A_R_LINEAR_____283_CM 1 0. 0. 655350. ECU_ADDRESS 0xd0005dfe FORMAT "%6.0" /end MEASUREMENT
/begin MEASUREMENT Vtx_frm[6].Vxx_rtn_tia "Stored intake air temperature" UBYTE _CNV_A_R_LINEAR_____280_CM 1 0. -40. 215. ECU_ADDRESS 0xd0005e00 FORMAT "%3.0" /end MEASUREMENT
/begin MEASUREMENT Vtx_frm[6].Vxx_dgdftmng_priority "Local frame priority" UBYTE _CNV_A_R_ECME_LINEA_0_CM 1 0. 0. 6. ECU_ADDRESS 0xd0005e01 FORMAT "%1.0" /end MEASUREMENT
/begin MEASUREMENT Vtx_frm[6].Vxx_rtn_rvac "Stored raw Tank differential pressure value for Scantool." SWORD _CNV_A_R_LINEAR_____284_CM 1 0. -8192. 8191.75 ECU_ADDRESS 0xd0005e02 FORMAT "%8.2" /end MEASUREMENT
/begin MEASUREMENT Vtx_frm[7].Vxx_rtn_n01 "Stored engine speed" UWORD _CNV_A_R_ENSD_LINEA_22_CM 1 0. 0. 16383.75 ECU_ADDRESS 0xd0005e04 FORMAT "%8.2" /end MEASUREMENT
/begin MEASUREMENT Vtx_frm[7].Vxx_obd_fail_code "DTC that caused required freeze frame data storage" UWORD _CNV_A_R_ECME_LINEA_0_CM 1 0. 0. 65535. ECU_ADDRESS 0xd0005e06 FORMAT "%5.0" /end MEASUREMENT
/begin MEASUREMENT Vtx_frm[7].Vxx_rtn_eal "Stored calculated load value for the scantool." UBYTE _CNV_A_R_LINEAR_____165_CM 1 0. 0. 100. ECU_ADDRESS 0xd0005e08 FORMAT "%12.8" /end MEASUREMENT
/begin MEASUREMENT Vtx_frm[7].Vxx_rtn_vs "Stored filtered vehicule speed." UBYTE _CNV_A_R_LINEAR_____71_CM 1 0. 0. 255. ECU_ADDRESS 0xd0005e09 FORMAT "%3.0" /end MEASUREMENT
/begin MEASUREMENT Vtx_frm[7].Vxx_rtn_map "Stored Manifold pressure value measurement" UBYTE _CNV_A_R_LINEAR_____279_CM 1 0. 0. 255. ECU_ADDRESS 0xd0005e0a FORMAT "%3.0" /end MEASUREMENT
/begin MEASUREMENT Vtx_frm[7].Vxx_rtn_frm_tco "Stored engine coolant temperature." UBYTE _CNV_A_R_LINEAR_____280_CM 1 0. -40. 215. ECU_ADDRESS 0xd0005e0b FORMAT "%3.0" /end MEASUREMENT
/begin MEASUREMENT Vtx_frm[7].Vxx_rtn_mv_ad_fac "Stored mean effective gain applied on injected fuel mass quantity" UBYTE _CNV_A_R_LINEAR_____281_CM 1 0. -100. 99.21875 ECU_ADDRESS 0xd0005e0c FORMAT "%10.5" /end MEASUREMENT
/begin MEASUREMENT Vtx_frm[7].Vxx_rtn_rich_loop_ti_fac "Stored multiplicative factor from richness closed loop applied on injected fuel mass quantity" UBYTE _CNV_A_R_LINEAR_____281_CM 1 0. -100. 99.21875 ECU_ADDRESS 0xd0005e0d FORMAT "%10.5" /end MEASUREMENT
/begin MEASUREMENT Vtx_frm[7].Vbx_rtn_clos_o2_phs "Stored richness regulation condition" UBYTE _CNV_S_2_RANGE______3_CM 1 0. 0. 1. ECU_ADDRESS 0xd0005e0e BIT_MASK 0x1 /end MEASUREMENT
/begin MEASUREMENT Vtx_frm[7].Vxx_rtn_mat "Stored intake air temperature" UBYTE _CNV_A_R_LINEAR_____280_CM 1 0. -40. 215. ECU_ADDRESS 0xd0005e0f FORMAT "%3.0" /end MEASUREMENT
/begin MEASUREMENT Vtx_frm[7].Vxx_rtn_clr_dist "Stored distance travelled since last clear" UWORD _CNV_A_R_LINEAR_____274_CM 1 0. 0. 65535. ECU_ADDRESS 0xd0005e10 FORMAT "%5.0" /end MEASUREMENT
/begin MEASUREMENT Vtx_frm[7].Vxx_ind_xxx "static index" UWORD _CNV_A_R_ECME_LINEA_0_CM 1 0. 0. 65535. ECU_ADDRESS 0xd0005e12 FORMAT "%5.0" /end MEASUREMENT
/begin MEASUREMENT Vtx_frm[7].Vxx_rtn_maf "Stored Mass air flow" UWORD _CNV_A_R_LINEAR_____282_CM 1 0. 0. 655.35 ECU_ADDRESS 0xd0005e14 FORMAT "%6.2" /end MEASUREMENT
/begin MEASUREMENT Vtx_frm[7].Vxx_rtn_rail_prs "Stored Rail pressure measured" UWORD _CNV_A_R_LINEAR_____283_CM 1 0. 0. 655350. ECU_ADDRESS 0xd0005e16 FORMAT "%6.0" /end MEASUREMENT
/begin MEASUREMENT Vtx_frm[7].Vxx_rtn_tia "Stored intake air temperature" UBYTE _CNV_A_R_LINEAR_____280_CM 1 0. -40. 215. ECU_ADDRESS 0xd0005e18 FORMAT "%3.0" /end MEASUREMENT
/begin MEASUREMENT Vtx_frm[7].Vxx_dgdftmng_priority "Local frame priority" UBYTE _CNV_A_R_ECME_LINEA_0_CM 1 0. 0. 6. ECU_ADDRESS 0xd0005e19 FORMAT "%1.0" /end MEASUREMENT
/begin MEASUREMENT Vtx_frm[7].Vxx_rtn_rvac "Stored raw Tank differential pressure value for Scantool." SWORD _CNV_A_R_LINEAR_____284_CM 1 0. -8192. 8191.75 ECU_ADDRESS 0xd0005e1a FORMAT "%8.2" /end MEASUREMENT
/begin MEASUREMENT Vtx_frm[8].Vxx_rtn_n01 "Stored engine speed" UWORD _CNV_A_R_ENSD_LINEA_22_CM 1 0. 0. 16383.75 ECU_ADDRESS 0xd0005e1c FORMAT "%8.2" /end MEASUREMENT
/begin MEASUREMENT Vtx_frm[8].Vxx_obd_fail_code "DTC that caused required freeze frame data storage" UWORD _CNV_A_R_ECME_LINEA_0_CM 1 0. 0. 65535. ECU_ADDRESS 0xd0005e1e FORMAT "%5.0" /end MEASUREMENT
/begin MEASUREMENT Vtx_frm[8].Vxx_rtn_eal "Stored calculated load value for the scantool." UBYTE _CNV_A_R_LINEAR_____165_CM 1 0. 0. 100. ECU_ADDRESS 0xd0005e20 FORMAT "%12.8" /end MEASUREMENT
/begin MEASUREMENT Vtx_frm[8].Vxx_rtn_vs "Stored filtered vehicule speed." UBYTE _CNV_A_R_LINEAR_____71_CM 1 0. 0. 255. ECU_ADDRESS 0xd0005e21 FORMAT "%3.0" /end MEASUREMENT
/begin MEASUREMENT Vtx_frm[8].Vxx_rtn_map "Stored Manifold pressure value measurement" UBYTE _CNV_A_R_LINEAR_____279_CM 1 0. 0. 255. ECU_ADDRESS 0xd0005e22 FORMAT "%3.0" /end MEASUREMENT
/begin MEASUREMENT Vtx_frm[8].Vxx_rtn_frm_tco "Stored engine coolant temperature." UBYTE _CNV_A_R_LINEAR_____280_CM 1 0. -40. 215. ECU_ADDRESS 0xd0005e23 FORMAT "%3.0" /end MEASUREMENT
/begin MEASUREMENT Vtx_frm[8].Vxx_rtn_mv_ad_fac "Stored mean effective gain applied on injected fuel mass quantity" UBYTE _CNV_A_R_LINEAR_____281_CM 1 0. -100. 99.21875 ECU_ADDRESS 0xd0005e24 FORMAT "%10.5" /end MEASUREMENT
/begin MEASUREMENT Vtx_frm[8].Vxx_rtn_rich_loop_ti_fac "Stored multiplicative factor from richness closed loop applied on injected fuel mass quantity" UBYTE _CNV_A_R_LINEAR_____281_CM 1 0. -100. 99.21875 ECU_ADDRESS 0xd0005e25 FORMAT "%10.5" /end MEASUREMENT
/begin MEASUREMENT Vtx_frm[8].Vbx_rtn_clos_o2_phs "Stored richness regulation condition" UBYTE _CNV_S_2_RANGE______3_CM 1 0. 0. 1. ECU_ADDRESS 0xd0005e26 BIT_MASK 0x1 /end MEASUREMENT
/begin MEASUREMENT Vtx_frm[8].Vxx_rtn_mat "Stored intake air temperature" UBYTE _CNV_A_R_LINEAR_____280_CM 1 0. -40. 215. ECU_ADDRESS 0xd0005e27 FORMAT "%3.0" /end MEASUREMENT
/begin MEASUREMENT Vtx_frm[8].Vxx_rtn_clr_dist "Stored distance travelled since last clear" UWORD _CNV_A_R_LINEAR_____274_CM 1 0. 0. 65535. ECU_ADDRESS 0xd0005e28 FORMAT "%5.0" /end MEASUREMENT
/begin MEASUREMENT Vtx_frm[8].Vxx_ind_xxx "static index" UWORD _CNV_A_R_ECME_LINEA_0_CM 1 0. 0. 65535. ECU_ADDRESS 0xd0005e2a FORMAT "%5.0" /end MEASUREMENT
/begin MEASUREMENT Vtx_frm[8].Vxx_rtn_maf "Stored Mass air flow" UWORD _CNV_A_R_LINEAR_____282_CM 1 0. 0. 655.35 ECU_ADDRESS 0xd0005e2c FORMAT "%6.2" /end MEASUREMENT
/begin MEASUREMENT Vtx_frm[8].Vxx_rtn_rail_prs "Stored Rail pressure measured" UWORD _CNV_A_R_LINEAR_____283_CM 1 0. 0. 655350. ECU_ADDRESS 0xd0005e2e FORMAT "%6.0" /end MEASUREMENT
/begin MEASUREMENT Vtx_frm[8].Vxx_rtn_tia "Stored intake air temperature" UBYTE _CNV_A_R_LINEAR_____280_CM 1 0. -40. 215. ECU_ADDRESS 0xd0005e30 FORMAT "%3.0" /end MEASUREMENT
/begin MEASUREMENT Vtx_frm[8].Vxx_dgdftmng_priority "Local frame priority" UBYTE _CNV_A_R_ECME_LINEA_0_CM 1 0. 0. 6. ECU_ADDRESS 0xd0005e31 FORMAT "%1.0" /end MEASUREMENT
/begin MEASUREMENT Vtx_frm[8].Vxx_rtn_rvac "Stored raw Tank differential pressure value for Scantool." SWORD _CNV_A_R_LINEAR_____284_CM 1 0. -8192. 8191.75 ECU_ADDRESS 0xd0005e32 FORMAT "%8.2" /end MEASUREMENT
/begin MEASUREMENT Vtx_frm[9].Vxx_rtn_n01 "Stored engine speed" UWORD _CNV_A_R_ENSD_LINEA_22_CM 1 0. 0. 16383.75 ECU_ADDRESS 0xd0005e34 FORMAT "%8.2" /end MEASUREMENT
/begin MEASUREMENT Vtx_frm[9].Vxx_obd_fail_code "DTC that caused required freeze frame data storage" UWORD _CNV_A_R_ECME_LINEA_0_CM 1 0. 0. 65535. ECU_ADDRESS 0xd0005e36 FORMAT "%5.0" /end MEASUREMENT
/begin MEASUREMENT Vtx_frm[9].Vxx_rtn_eal "Stored calculated load value for the scantool." UBYTE _CNV_A_R_LINEAR_____165_CM 1 0. 0. 100. ECU_ADDRESS 0xd0005e38 FORMAT "%12.8" /end MEASUREMENT
/begin MEASUREMENT Vtx_frm[9].Vxx_rtn_vs "Stored filtered vehicule speed." UBYTE _CNV_A_R_LINEAR_____71_CM 1 0. 0. 255. ECU_ADDRESS 0xd0005e39 FORMAT "%3.0" /end MEASUREMENT
/begin MEASUREMENT Vtx_frm[9].Vxx_rtn_map "Stored Manifold pressure value measurement" UBYTE _CNV_A_R_LINEAR_____279_CM 1 0. 0. 255. ECU_ADDRESS 0xd0005e3a FORMAT "%3.0" /end MEASUREMENT
/begin MEASUREMENT Vtx_frm[9].Vxx_rtn_frm_tco "Stored engine coolant temperature." UBYTE _CNV_A_R_LINEAR_____280_CM 1 0. -40. 215. ECU_ADDRESS 0xd0005e3b FORMAT "%3.0" /end MEASUREMENT
/begin MEASUREMENT Vtx_frm[9].Vxx_rtn_mv_ad_fac "Stored mean effective gain applied on injected fuel mass quantity" UBYTE _CNV_A_R_LINEAR_____281_CM 1 0. -100. 99.21875 ECU_ADDRESS 0xd0005e3c FORMAT "%10.5" /end MEASUREMENT
/begin MEASUREMENT Vtx_frm[9].Vxx_rtn_rich_loop_ti_fac "Stored multiplicative factor from richness closed loop applied on injected fuel mass quantity" UBYTE _CNV_A_R_LINEAR_____281_CM 1 0. -100. 99.21875 ECU_ADDRESS 0xd0005e3d FORMAT "%10.5" /end MEASUREMENT
/begin MEASUREMENT Vtx_frm[9].Vbx_rtn_clos_o2_phs "Stored richness regulation condition" UBYTE _CNV_S_2_RANGE______3_CM 1 0. 0. 1. ECU_ADDRESS 0xd0005e3e BIT_MASK 0x1 /end MEASUREMENT
/begin MEASUREMENT Vtx_frm[9].Vxx_rtn_mat "Stored intake air temperature" UBYTE _CNV_A_R_LINEAR_____280_CM 1 0. -40. 215. ECU_ADDRESS 0xd0005e3f FORMAT "%3.0" /end MEASUREMENT
/begin MEASUREMENT Vtx_frm[9].Vxx_rtn_clr_dist "Stored distance travelled since last clear" UWORD _CNV_A_R_LINEAR_____274_CM 1 0. 0. 65535. ECU_ADDRESS 0xd0005e40 FORMAT "%5.0" /end MEASUREMENT
/begin MEASUREMENT Vtx_frm[9].Vxx_ind_xxx "static index" UWORD _CNV_A_R_ECME_LINEA_0_CM 1 0. 0. 65535. ECU_ADDRESS 0xd0005e42 FORMAT "%5.0" /end MEASUREMENT
/begin MEASUREMENT Vtx_frm[9].Vxx_rtn_maf "Stored Mass air flow" UWORD _CNV_A_R_LINEAR_____282_CM 1 0. 0. 655.35 ECU_ADDRESS 0xd0005e44 FORMAT "%6.2" /end MEASUREMENT
/begin MEASUREMENT Vtx_frm[9].Vxx_rtn_rail_prs "Stored Rail pressure measured" UWORD _CNV_A_R_LINEAR_____283_CM 1 0. 0. 655350. ECU_ADDRESS 0xd0005e46 FORMAT "%6.0" /end MEASUREMENT
/begin MEASUREMENT Vtx_frm[9].Vxx_rtn_tia "Stored intake air temperature" UBYTE _CNV_A_R_LINEAR_____280_CM 1 0. -40. 215. ECU_ADDRESS 0xd0005e48 FORMAT "%3.0" /end MEASUREMENT
/begin MEASUREMENT Vtx_frm[9].Vxx_dgdftmng_priority "Local frame priority" UBYTE _CNV_A_R_ECME_LINEA_0_CM 1 0. 0. 6. ECU_ADDRESS 0xd0005e49 FORMAT "%1.0" /end MEASUREMENT
/begin MEASUREMENT Vtx_frm[9].Vxx_rtn_rvac "Stored raw Tank differential pressure value for Scantool." SWORD _CNV_A_R_LINEAR_____284_CM 1 0. -8192. 8191.75 ECU_ADDRESS 0xd0005e4a FORMAT "%8.2" /end MEASUREMENT
/begin MEASUREMENT Sxx_sel_frm "Selected Legislative Freeze frame from the table of potential stored freeze frame" UBYTE _CNV_A_R_ECME_LINEA_0_CM 1 0. 0. 9. ECU_ADDRESS 0xd0007967 FORMAT "%3.0" /end MEASUREMENT
/begin MEASUREMENT Vbx_rtn_clos_o2_phs "Stored Richness regulation condition" UBYTE _CNV_S_2_RANGE______3_CM 1 0. 0. 1. ECU_ADDRESS 0xd0007970 BIT_MASK 0x1 /end MEASUREMENT
/begin MEASUREMENT Vxx_obd_fail_code "DTC that caused required freeze frame data storage" UWORD _CNV_A_R_ECME_LINEA_0_CM 1 0. 0. 65535. ECU_ADDRESS 0xd0005e4c FORMAT "%5.0" /end MEASUREMENT
/begin MEASUREMENT Vxx_rtn_clr_dist "Stored distance travelled since last clear" UWORD _CNV_A_R_LINEAR_____274_CM 1 0. 0. 65535. ECU_ADDRESS 0xd0005e4e FORMAT "%5.0" /end MEASUREMENT
/begin MEASUREMENT Vxx_rtn_eal "Stored calculated load value for the scantool." UBYTE _CNV_A_R_LINEAR_____165_CM 1 0. 0. 100. ECU_ADDRESS 0xd0007968 FORMAT "%12.8" /end MEASUREMENT
/begin MEASUREMENT Vxx_rtn_frm_tco "Stored engine coolant temperature." UBYTE _CNV_A_R_LINEAR_____280_CM 1 0. -40. 215. ECU_ADDRESS 0xd0007969 FORMAT "%3.0" /end MEASUREMENT
/begin MEASUREMENT Vxx_rtn_maf "Stored Mass air flow" UWORD _CNV_A_R_LINEAR_____282_CM 1 0. 0. 655.35 ECU_ADDRESS 0xd0005e50 FORMAT "%6.2" /end MEASUREMENT
/begin MEASUREMENT Vxx_rtn_map "Stored Manifold pressure value measurement" UBYTE _CNV_A_R_LINEAR_____279_CM 1 0. 0. 255. ECU_ADDRESS 0xd000796a FORMAT "%3.0" /end MEASUREMENT
/begin MEASUREMENT Vxx_rtn_mat "Stored intake air temperature" UBYTE _CNV_A_R_LINEAR_____280_CM 1 0. -40. 215. ECU_ADDRESS 0xd000796b FORMAT "%3.0" /end MEASUREMENT
/begin MEASUREMENT Vxx_rtn_mv_ad_fac "Stored Mean effective gain applied on injected fuel mass quantity" UBYTE _CNV_A_R_LINEAR_____281_CM 1 0. -100. 99.21875 ECU_ADDRESS 0xd000796c FORMAT "%10.5" /end MEASUREMENT
/begin MEASUREMENT Vxx_rtn_n01 "Stored engine speed" UWORD _CNV_A_R_ENSD_LINEA_22_CM 1 0. 0. 16383.75 ECU_ADDRESS 0xd0005e52 FORMAT "%8.2" /end MEASUREMENT
/begin MEASUREMENT Vxx_rtn_rail_prs "Stored Rail pressure measured" UWORD _CNV_A_R_LINEAR_____283_CM 1 0. 0. 655350. ECU_ADDRESS 0xd0005e54 FORMAT "%6.0" /end MEASUREMENT
/begin MEASUREMENT Vxx_rtn_rich_loop_ti_fac "Stored multiplicative factor from richness closed loop applied on injected fuel mass quantity" UBYTE _CNV_A_R_LINEAR_____281_CM 1 0. -100. 99.21875 ECU_ADDRESS 0xd000796d FORMAT "%10.5" /end MEASUREMENT
/begin MEASUREMENT Vxx_rtn_rvac "Stored raw Tank differential pressure value for Scantool." SWORD _CNV_A_R_LINEAR_____284_CM 1 0. -8192. 8191.75 ECU_ADDRESS 0xd0005e56 FORMAT "%8.2" /end MEASUREMENT
/begin MEASUREMENT Vxx_rtn_tia "Stored intake air temperature" UBYTE _CNV_A_R_LINEAR_____280_CM 1 0. -40. 215. ECU_ADDRESS 0xd000796e FORMAT "%3.0" /end MEASUREMENT
/begin MEASUREMENT Vxx_rtn_vs "Stored filtered vehicule speed." UBYTE _CNV_A_R_LINEAR_____71_CM 1 0. 0. 255. ECU_ADDRESS 0xd000796f FORMAT "%3.0" /end MEASUREMENT
/begin CHARACTERISTIC Cbx_obd_off_cfm "OBD system inhibition" VALUE 0xa0021178 _REC_S1VAL_20_u1 1. _CNV_S_2_RANGE______3_CM 0. 1. BIT_MASK 0x1 /end CHARACTERISTIC
/begin CHARACTERISTIC Cxx_dtc_lb_cata "Diagnostic trouble code faulttype identifier of destructive catalyst for priority rules" VALUE 0xa0021179 _REC_S1VAL_20_u1 255. _CNV_A_R_ECME_LINEA_0_CM 0. 255. FORMAT "%3.0" /end CHARACTERISTIC
/begin CHARACTERISTIC Cxx_dtc_lb_fsys "Diagnostic trouble code faulttype identifier of fuel system for priority rules" VALUE 0xa002117a _REC_S1VAL_20_u1 255. _CNV_A_R_ECME_LINEA_0_CM 0. 255. FORMAT "%3.0" /end CHARACTERISTIC
/begin CHARACTERISTIC Cxx_dtc_msb_fsys "Diagnostic trouble code device or function identifier of fuel system for priority rules" VALUE 0xa0021176 _REC_S1VAL_20_u2 65535. _CNV_A_R_ECME_LINEA_0_CM 0. 65535. FORMAT "%5.0" /end CHARACTERISTIC
/begin MEASUREMENT Vbx_amp_obd_diag_ena "Autorization OBD diagnosis in function of Atmospheric pressure" UBYTE _CNV_S_2_RANGE______3_CM 1 0. 0. 1. ECU_ADDRESS 0xd0007962 BIT_MASK 0x1 /end MEASUREMENT
/begin MEASUREMENT Vbx_min_fuel_obd_diag_ena "Autorization OBD diagnosis in function of Filtered minimum fuel level detected" UBYTE _CNV_S_2_RANGE______3_CM 1 0. 0. 1. ECU_ADDRESS 0xd0007963 BIT_MASK 0x1 /end MEASUREMENT
/begin MEASUREMENT Vbx_temp_obd_diag_ena "Autorization OBD diagnosis in function of temperature" UBYTE _CNV_S_2_RANGE______3_CM 1 0. 0. 1. ECU_ADDRESS 0xd0007964 BIT_MASK 0x1 /end MEASUREMENT
/begin MEASUREMENT Vbx_vb_obd_diag_ena "Autorization OBD diagnosis in function of Battery voltage" UBYTE _CNV_S_2_RANGE______3_CM 1 0. 0. 1. ECU_ADDRESS 0xd0007965 BIT_MASK 0x1 /end MEASUREMENT
/begin CHARACTERISTIC Cxx_amp_obd_diag_ena_thd "Atmospheric pressure threshold for autorization OBD diagnosis" VALUE 0xa002116e _REC_S1VAL_20_u2 20000. _CNV_A_R_LINEAR_____115_CM 0. 20000. FORMAT "%5.0" /end CHARACTERISTIC
/begin CHARACTERISTIC Cxx_mat_obd_diag_ena_thd "Manifold air temperature threshold for autorization OBD diagnosis " VALUE 0xa0021170 _REC_S1VAL_20_u2 240. _CNV_A_R_LINEAR_____110_CM -40. 200. FORMAT "%6.1" /end CHARACTERISTIC
/begin CHARACTERISTIC Cxx_tco_obd_diag_ena_thd "Engine coolant temperature threshold for autorization OBD diagnosis " VALUE 0xa0021172 _REC_S1VAL_20_u2 240. _CNV_A_R_LINEAR_____110_CM -40. 200. FORMAT "%6.1" /end CHARACTERISTIC
/begin CHARACTERISTIC Cxx_vb_obd_diag_ena_thd "Battery voltage threshold for autorization OBD diagnosis" VALUE 0xa0021174 _REC_S1VAL_20_u2 60. _CNV_A_R_LINEAR_____205_CM 0. 60. FORMAT "%6.2" /end CHARACTERISTIC
/begin MEASUREMENT Vbx_obd_rdn_cata_cpt "OBD completion status of catalyst class" UBYTE _CNV_S_2_RANGE______3_CM 1 0. 0. 1. ECU_ADDRESS 0xd0007983 BIT_MASK 0x1 /end MEASUREMENT
/begin MEASUREMENT Vbx_obd_rdn_cpt "OBD completion status of comprehensive component class" UBYTE _CNV_S_2_RANGE______3_CM 1 0. 0. 1. ECU_ADDRESS 0xd0007984 BIT_MASK 0x1 /end MEASUREMENT
/begin MEASUREMENT Vbx_obd_rdn_egr_vvt "OBD completion status of EFR/VVTclass" UBYTE _CNV_S_2_RANGE______3_CM 1 0. 0. 1. ECU_ADDRESS 0xd0007985 BIT_MASK 0x1 /end MEASUREMENT
/begin MEASUREMENT Vbx_obd_rdn_evap "OBD completion status of evaporative system class" UBYTE _CNV_S_2_RANGE______3_CM 1 0. 0. 1. ECU_ADDRESS 0xd0007986 BIT_MASK 0x1 /end MEASUREMENT
/begin MEASUREMENT Vbx_obd_rdn_fsys "OBD completion status of fuel system class" UBYTE _CNV_S_2_RANGE______3_CM 1 0. 0. 1. ECU_ADDRESS 0xd0007987 BIT_MASK 0x1 /end MEASUREMENT
/begin MEASUREMENT Vbx_obd_rdn_full "All readiness codes completion status flag" UBYTE _CNV_S_2_RANGE______3_CM 1 0. 0. 1. ECU_ADDRESS 0xd0007988 BIT_MASK 0x1 /end MEASUREMENT
/begin MEASUREMENT Vbx_obd_rdn_heat "OBD completion status of O2 sensor heater class" UBYTE _CNV_S_2_RANGE______3_CM 1 0. 0. 1. ECU_ADDRESS 0xd0007989 BIT_MASK 0x1 /end MEASUREMENT
/begin MEASUREMENT Vbx_obd_rdn_heat_cata "OBD completion status of catalyst heater class" UBYTE _CNV_S_2_RANGE______3_CM 1 0. 0. 1. ECU_ADDRESS 0xd000798a BIT_MASK 0x1 /end MEASUREMENT
/begin MEASUREMENT Vbx_obd_rdn_lbup_cpt "OBD completion status of oxygen sensor class" UBYTE _CNV_S_2_RANGE______3_CM 1 0. 0. 1. ECU_ADDRESS 0xd000798b BIT_MASK 0x1 /end MEASUREMENT
/begin MEASUREMENT Vbx_obd_rdn_mis "OBD completion status of misfire class" UBYTE _CNV_S_2_RANGE______3_CM 1 0. 0. 1. ECU_ADDRESS 0xd000798c BIT_MASK 0x1 /end MEASUREMENT
/begin MEASUREMENT Vbx_df_inj_ecu_lbdw_icp "Main CPU Lambda Sensor (down) pumping current detected failure" UBYTE _CNV_S_2_RANGE______3_CM 1 0. 0. 1. ECU_ADDRESS 0xd0006b19 BIT_MASK 0x1 /end MEASUREMENT
/begin MEASUREMENT Vbx_df_lbdw_oc "Rear Oxygen Sensor (L/R) Open circuit detected failure" UBYTE _CNV_S_2_RANGE______3_CM 1 0. 0. 1. ECU_ADDRESS 0xd0006b1a BIT_MASK 0x1 /end MEASUREMENT
/begin MEASUREMENT Vbx_df_lbdw_scg "Rear Oxygen Sensor (L/R) Short circuit to ground detected failure" UBYTE _CNV_S_2_RANGE______3_CM 1 0. 0. 1. ECU_ADDRESS 0xd0006b1b BIT_MASK 0x1 /end MEASUREMENT
/begin MEASUREMENT Vbx_df_lbdw_scw "Rear Oxygen Sensor (L/R) Short circuit at battery + detected failure" UBYTE _CNV_S_2_RANGE______3_CM 1 0. 0. 1. ECU_ADDRESS 0xd0006b1c BIT_MASK 0x1 /end MEASUREMENT
/begin MEASUREMENT Vbx_diag_ena_inj_ecu_lbdw_icp "Main CPU Lambda Sensor (down) pumping current  diagnostic authorisation" UBYTE _CNV_S_2_RANGE______3_CM 1 0. 0. 1. ECU_ADDRESS 0xd0006b1d BIT_MASK 0x1 /end MEASUREMENT
/begin MEASUREMENT Vbx_diag_ena_lbdw_oc "Rear Oxygen Sensor (L/R) Open circuit diagnostic authorisation" UBYTE _CNV_S_2_RANGE______3_CM 1 0. 0. 1. ECU_ADDRESS 0xd0006b1e BIT_MASK 0x1 /end MEASUREMENT
/begin MEASUREMENT Vbx_diag_ena_lbdw_scg "Rear Oxygen Sensor (L/R) Short circuit to ground  diagnostic authorisation" UBYTE _CNV_S_2_RANGE______3_CM 1 0. 0. 1. ECU_ADDRESS 0xd0006b1f BIT_MASK 0x1 /end MEASUREMENT
/begin MEASUREMENT Vbx_diag_ena_lbdw_scw "Rear Oxygen Sensor (L/R) Short circuit at battery + diagnostic authorisation" UBYTE _CNV_S_2_RANGE______3_CM 1 0. 0. 1. ECU_ADDRESS 0xd0006b20 BIT_MASK 0x1 /end MEASUREMENT
/begin MEASUREMENT Vbx_lbdw_diag_ena "Indicateur de sonde prète (chaude) pour les diagnostics sonde aval." UBYTE _CNV_S_2_RANGE______3_CM 1 0. 0. 1. ECU_ADDRESS 0xd0006b21 BIT_MASK 0x1 /end MEASUREMENT
/begin MEASUREMENT Vsx_lbdw_vld "Validity indicator of lambda down sensor" UBYTE _CNV_S_3_STATUS_OK__179_CM 1 0. 0. 2. ECU_ADDRESS 0xd0006b22 /end MEASUREMENT
/begin MEASUREMENT Vxx_cata_air_wht "Amount of air pumped into cylinder" UWORD _CNV_A_R_LINEAR_____172_CM 1 0. 0. 3000. ECU_ADDRESS 0xd0004284 FORMAT "%7.2" /end MEASUREMENT
/begin MEASUREMENT Vxx_lbdw_diag_ena "compteur associe a l'indicateur de sonde prete (chaude) pour les diagnostics sonde aval." UWORD _CNV_A_R_LINEAR_____32_CM 1 0. 0. 655.35 ECU_ADDRESS 0xd0004286 FORMAT "%6.2" /end MEASUREMENT
/begin MEASUREMENT Vxx_lbdw_pump_crt_t "Temps durant lequel on effectue le diagnostic du courant de pompage de la sonde aval" UWORD _CNV_A_R_LINEAR_____32_CM 1 0. 0. 655.35 ECU_ADDRESS 0xd0004288 FORMAT "%6.2" /end MEASUREMENT
/begin CHARACTERISTIC Cbx_lbdw_osp_conf "Booleen de configuration pour selectionner une sonde aval de type OSP+ (Cbx_lbdw_osp_typ = on)" VALUE 0xa0021350 _REC_S1VAL_20_u1 1. _CNV_A_R_ECME_LINEA_0_CM 0. 1. FORMAT "%1.0" BIT_MASK 0x1 /end CHARACTERISTIC
/begin CHARACTERISTIC Cxx_air_wht_fmt_fac "Facteur de formattage du debit d'air en masse d'air" VALUE 0xa0021351 _REC_S1VAL_20_u1 0.99609375 _CNV_A_R_LINEAR_____130_CM 3.90625e-003 1. FORMAT "%12.8" /end CHARACTERISTIC
/begin CHARACTERISTIC Cxx_dfdec_inj_ecu_lbdw_icp "Main CPU Lambda Sensor (down) pumping current detected failure counter decrement" VALUE 0xa002132a _REC_S1VAL_20_u2 65535. _CNV_A_R_ECME_LINEA_0_CM 0. 65535. FORMAT "%5.0" /end CHARACTERISTIC
/begin CHARACTERISTIC Cxx_dfdec_lbdw_oc "Rear Oxygen Sensor (L/R) Open circuit detected failure counter decrement" VALUE 0xa002132c _REC_S1VAL_20_u2 65535. _CNV_A_R_ECME_LINEA_0_CM 0. 65535. FORMAT "%5.0" /end CHARACTERISTIC
/begin CHARACTERISTIC Cxx_dfdec_lbdw_scg "Rear Oxygen Sensor (L/R) Short circuit to ground detected failure counter decrement" VALUE 0xa002132e _REC_S1VAL_20_u2 65535. _CNV_A_R_ECME_LINEA_0_CM 0. 65535. FORMAT "%5.0" /end CHARACTERISTIC
/begin CHARACTERISTIC Cxx_dfdec_lbdw_scw "Rear Oxygen Sensor (L/R) Short circuit at battery + detected failure counter decrement" VALUE 0xa0021330 _REC_S1VAL_20_u2 65535. _CNV_A_R_ECME_LINEA_0_CM 0. 65535. FORMAT "%5.0" /end CHARACTERISTIC
/begin CHARACTERISTIC Cxx_dfinc_inj_ecu_lbdw_icp "Main CPU Lambda Sensor (down) pumping current detected failure counter increment" VALUE 0xa0021332 _REC_S1VAL_20_u2 65535. _CNV_A_R_ECME_LINEA_0_CM 0. 65535. FORMAT "%5.0" /end CHARACTERISTIC
/begin CHARACTERISTIC Cxx_dfinc_lbdw_oc "Rear Oxygen Sensor (L/R) Open circuit detected failure counter increment" VALUE 0xa0021334 _REC_S1VAL_20_u2 65535. _CNV_A_R_ECME_LINEA_0_CM 0. 65535. FORMAT "%5.0" /end CHARACTERISTIC
/begin CHARACTERISTIC Cxx_dfinc_lbdw_scg "Rear Oxygen Sensor (L/R) Short circuit to ground detected failure counter increment" VALUE 0xa0021336 _REC_S1VAL_20_u2 65535. _CNV_A_R_ECME_LINEA_0_CM 0. 65535. FORMAT "%5.0" /end CHARACTERISTIC
/begin CHARACTERISTIC Cxx_dfinc_lbdw_scw "Rear Oxygen Sensor (L/R) Short circuit at battery + detected failure counter increment" VALUE 0xa0021338 _REC_S1VAL_20_u2 65535. _CNV_A_R_ECME_LINEA_0_CM 0. 65535. FORMAT "%5.0" /end CHARACTERISTIC
/begin CHARACTERISTIC Cxx_lbdw_hot_stt_t "Duree, apres demarrage, au-dela de laquelle on considere la sonde aval chaude" VALUE 0xa002133a _REC_S1VAL_20_u2 655.35 _CNV_A_R_LINEAR_____32_CM 0. 655.35 FORMAT "%6.2" /end CHARACTERISTIC
/begin CHARACTERISTIC Cxx_lbdw_oc_air_wht "Amount of air pumped into cylinder." VALUE 0xa002133c _REC_S1VAL_20_u2 3000. _CNV_A_R_LINEAR_____172_CM 0. 3000. FORMAT "%7.2" /end CHARACTERISTIC
/begin CHARACTERISTIC Cxx_lbdw_oc_det_h_v "Seuil maxi de tension sonde aval pour detecter un defaut circuit ouvert" VALUE 0xa002133e _REC_S1VAL_20_u2 25000. _CNV_A_R_LINEAR_____107_CM 0. 25000. FORMAT "%5.0" /end CHARACTERISTIC
/begin CHARACTERISTIC Cxx_lbdw_osp_oc_det_h_v "Seuil haut d'encadrement tension de polarisation sonde aval OSP+ pour detection circuit ouvert" VALUE 0xa0021340 _REC_S1VAL_20_u2 25000. _CNV_A_R_LINEAR_____107_CM 0. 25000. FORMAT "%5.0" /end CHARACTERISTIC
/begin CHARACTERISTIC Cxx_lbdw_osp_oc_det_l_v "Seuil bas d'encadrement de la tension de polarisation sonde aval OSP+ pour detection circuit ouvert" VALUE 0xa0021342 _REC_S1VAL_20_u2 25000. _CNV_A_R_LINEAR_____107_CM 0. 25000. FORMAT "%5.0" /end CHARACTERISTIC
/begin CHARACTERISTIC Cxx_lbdw_osp_scg_det_v "Seuil bas de tension sonde aval OSP+ pour detecter le defaut court-circuit a la masse" VALUE 0xa0021344 _REC_S1VAL_20_u2 25000. _CNV_A_R_LINEAR_____107_CM 0. 25000. FORMAT "%5.0" /end CHARACTERISTIC
/begin CHARACTERISTIC Cxx_lbdw_osp_scw_det_v "Seuil de tension sonde aval OSP+ au dela duquel on detecte un court-circuit au + batterie" VALUE 0xa0021346 _REC_S1VAL_20_u2 25000. _CNV_A_R_LINEAR_____107_CM 0. 25000. FORMAT "%5.0" /end CHARACTERISTIC
/begin CHARACTERISTIC Cxx_lbdw_pump_crt_t "Duree durant laquelle on effectue le diagnostic du courant de pompage de la sonde aval" VALUE 0xa0021348 _REC_S1VAL_20_u2 655.35 _CNV_A_R_LINEAR_____32_CM 0. 655.35 FORMAT "%6.2" /end CHARACTERISTIC
/begin CHARACTERISTIC Cxx_lbdw_pump_crt_v_thd "Seuil de tension au-dela duquel on detecte une panne du courant de pompage sonde aval" VALUE 0xa002134a _REC_S1VAL_20_u2 25000. _CNV_A_R_LINEAR_____107_CM 0. 25000. FORMAT "%5.0" /end CHARACTERISTIC
/begin CHARACTERISTIC Cxx_lbdw_scg_det_v "Seuil tension sonde aval sous lequel on detecte le defaut court-circuit a la masse (double boucle)" VALUE 0xa002134c _REC_S1VAL_20_u2 25000. _CNV_A_R_LINEAR_____107_CM 0. 25000. FORMAT "%5.0" /end CHARACTERISTIC
/begin CHARACTERISTIC Cxx_lbdw_scw_det_v "Seuil de tension sonde aval au dela duquel on detecte un defaut court-circuit au + batterie" VALUE 0xa002134e _REC_S1VAL_20_u2 25000. _CNV_A_R_LINEAR_____107_CM 0. 25000. FORMAT "%5.0" /end CHARACTERISTIC
/begin MEASUREMENT Vbx_stop_stal_eng "Indication of engine state (stop or stal)" UBYTE _CNV_S_2_RANGE______3_CM 1 0. 0. 1. ECU_ADDRESS 0xd0006b12 BIT_MASK 0x1 /end MEASUREMENT
/begin MEASUREMENT Vbx_stop_stal_eng_not_1 "Inverse indication of engine state (stop or stal) for filtering 1" UBYTE _CNV_S_2_RANGE______3_CM 1 0. 0. 1. ECU_ADDRESS 0xd0006b13 BIT_MASK 0x1 /end MEASUREMENT
/begin MEASUREMENT Vbx_stop_stal_eng_not_2 "Inverse indication of engine state (stop or stal) for filtering 2" UBYTE _CNV_S_2_RANGE______3_CM 1 0. 0. 1. ECU_ADDRESS 0xd0006b14 BIT_MASK 0x1 /end MEASUREMENT
/begin MEASUREMENT Vxx_lbdw_cata_fil_val "Filtered value by the tension of dowstream lambda sensor to AMPLIMOY (catalyst diagnosis)" UWORD _CNV_A_R_LINEAR_____107_CM 1 0. 0. 25000. ECU_ADDRESS 0xd0004280 FORMAT "%5.0" /end MEASUREMENT
/begin MEASUREMENT Vxx_lbdw_h_lvl_fil_val "Filtered value by the tension of dowstream lambda sensor to judge the level of richness" UWORD _CNV_A_R_LINEAR_____107_CM 1 0. 0. 25000. ECU_ADDRESS 0xd0004282 FORMAT "%5.0" /end MEASUREMENT
/begin CHARACTERISTIC Cxx_lbdw_cata_fil_ftc "Filtering time constant for filtered value by the tension of dowstream lambda sensor to AMPLMOY (catalyst diagnosis)" VALUE 0xa0021326 _REC_S1VAL_20_u2 65.535 _CNV_A_R_LINEAR_____116_CM 0. 65.535 /end CHARACTERISTIC
/begin CHARACTERISTIC Cxx_lbdw_h_lvl_fil_ftc "Filtering time constant for filtered value by the tension of dowstream lambda sensor to judge the level of richness" VALUE 0xa0021328 _REC_S1VAL_20_u2 65.535 _CNV_A_R_LINEAR_____116_CM 0. 65.535 /end CHARACTERISTIC
/begin AXIS_PTS Ctb_in_vvtc_angl_sp_ftc_n "Engine speed breakpoints used to calculate the time constant of the filter on the VVT position setpoint" 0xa0024680 Vxx_n_mv _REC_A2AXS_20_u2 16383.75 _CNV_A_R_ENSD_LINEA_22_CM 20 0. 16383.75 FORMAT "%8.2" /end AXIS_PTS
/begin AXIS_PTS Ctb_tq_rat "9 programmable torque ratio breakpoints" 0xa00246ac Vxx_tqi_rat_tgt _REC_A2AXS_20_u2 1. _CNV_A_R_LINEAR_____183_CM 9 0. 1. FORMAT "%11.9" /end AXIS_PTS
/begin CHARACTERISTIC Cmp_n_tq_cwup_vvtc_in_angl "Intake vvt relative angle setpoint map linked to catalyst warm-up" MAP 0xa00246c0 _REC_A1MAP_20_u2_u2_u2 719.98 _CNV_A_R_LINEAR_____129_CM 0. 719.98 FORMAT "%6.2"
 /begin AXIS_DESCR COM_AXIS Vxx_tq_rel _CNV_A_R_LINEAR_____285_CM 9 -2. 2. FORMAT "%7.4" AXIS_PTS_REF Ctb_wup_tq_rel /end AXIS_DESCR
 /begin AXIS_DESCR COM_AXIS Vxx_n _CNV_A_R_ENSD_LINEA_22_CM 20 0. 16383.75 FORMAT "%8.2" AXIS_PTS_REF Ctb_n /end AXIS_DESCR
/end CHARACTERISTIC
/begin CHARACTERISTIC Cmp_n_tq_vvtc_in_angl "Intake vvt relative angle setpoint map when engine is warm" MAP 0xa0024828 _REC_A1MAP_20_u2_u2_u2 719.98 _CNV_A_R_LINEAR_____129_CM 0. 719.98 FORMAT "%6.2"
 /begin AXIS_DESCR COM_AXIS Vxx_tqi_rat_tgt _CNV_A_R_LINEAR_____183_CM 9 0. 1. FORMAT "%11.9" AXIS_PTS_REF Ctb_tq_rat /end AXIS_DESCR
 /begin AXIS_DESCR COM_AXIS Vxx_n _CNV_A_R_ENSD_LINEA_22_CM 20 0. 16383.75 FORMAT "%8.2" AXIS_PTS_REF Ctb_n /end AXIS_DESCR
/end CHARACTERISTIC
/begin CHARACTERISTIC Ctp_in_vvtc_angl_sp_ftc "Time constant for the filter on the VVT position setpoint" CURVE 0xa0024990 _REC_A1CUR_20_u2_u2 655.35 _CNV_A_R_LINEAR_____32_CM 0. 655.35 FORMAT "%6.2"
 /begin AXIS_DESCR COM_AXIS Vxx_n_mv _CNV_A_R_ENSD_LINEA_22_CM 20 0. 16383.75 FORMAT "%8.2" AXIS_PTS_REF Ctb_in_vvtc_angl_sp_ftc_n /end AXIS_DESCR
/end CHARACTERISTIC
/begin CHARACTERISTIC Ctp_n_vvtc_trs_in_angl "Table of Intake VVT relative position setpoint in the transient of VVT" CURVE 0xa00249b8 _REC_A1CUR_20_u2_u2 719.98 _CNV_A_R_LINEAR_____129_CM 0. 719.98 FORMAT "%6.2"
 /begin AXIS_DESCR COM_AXIS Vxx_n _CNV_A_R_ENSD_LINEA_22_CM 20 0. 16383.75 FORMAT "%8.2" AXIS_PTS_REF Ctb_n /end AXIS_DESCR
/end CHARACTERISTIC
/begin CHARACTERISTIC Ctp_trs_in_vvtc_angl_sp_ftc "Time constant for the filter on the VVT position setpoint in transient" CURVE 0xa00249e0 _REC_A1CUR_20_u2_u2 655.35 _CNV_A_R_LINEAR_____32_CM 0. 655.35 FORMAT "%6.2"
 /begin AXIS_DESCR COM_AXIS Vxx_n_mv _CNV_A_R_ENSD_LINEA_22_CM 20 0. 16383.75 FORMAT "%8.2" AXIS_PTS_REF Ctb_in_vvtc_angl_sp_ftc_n /end AXIS_DESCR
/end CHARACTERISTIC
/begin MEASUREMENT Vbx_vvtc_spg_trs_cdn "Boolean indicating that conditions of transition for VVT particular setpoint are activated" UBYTE _CNV_S_2_RANGE______3_CM 1 0. 0. 1. ECU_ADDRESS 0xd000646e BIT_MASK 0x1 /end MEASUREMENT
/begin MEASUREMENT Vbx_vvtc_trs "Boolean indicating that Wastegate transition condition to the VVT is activated" UBYTE _CNV_S_2_RANGE______3_CM 1 0. 0. 1. ECU_ADDRESS 0xd000646f BIT_MASK 0x1 /end MEASUREMENT
/begin MEASUREMENT Vxx_cata_wup_vvtc_in_angl "Nominal intake VVT relative angle setpoint linked to catalyst warm-up" UWORD _CNV_A_R_LINEAR_____129_CM 1 0. 0. 719.98 ECU_ADDRESS 0xd0003db0 FORMAT "%6.2" /end MEASUREMENT
/begin MEASUREMENT Vxx_vvtc_in_angl_sp_nom "Intake vvt relative angle setpoint nominal" UWORD _CNV_A_R_LINEAR_____129_CM 1 0. 0. 719.98 ECU_ADDRESS 0xd0003db2 FORMAT "%6.2" /end MEASUREMENT
/begin MEASUREMENT Vxx_vvtc_in_angl_sp_tgt "Intake vvt relative angle target setpoint" UWORD _CNV_A_R_LINEAR_____129_CM 1 0. 0. 719.98 ECU_ADDRESS 0xd0003db4 FORMAT "%6.2" /end MEASUREMENT
/begin MEASUREMENT Vxx_vvtc_in_angl_sp_trs "Intake VVT relative angle setpoint in transient" UWORD _CNV_A_R_LINEAR_____129_CM 1 0. 0. 719.98 ECU_ADDRESS 0xd0003db6 FORMAT "%6.2" /end MEASUREMENT
/begin MEASUREMENT Vxx_vvtc_in_angl_sp_wup "Intake vvt relative angle target" UWORD _CNV_A_R_LINEAR_____129_CM 1 0. 0. 719.98 ECU_ADDRESS 0xd0003db8 FORMAT "%6.2" /end MEASUREMENT
/begin MEASUREMENT Vxx_vvtc_in_angl_sp_wup_raw "Intake vvt relative angle raw target" UWORD _CNV_A_R_LINEAR_____129_CM 1 0. 0. 719.98 ECU_ADDRESS 0xd0003dba FORMAT "%6.2" /end MEASUREMENT
/begin CHARACTERISTIC Cxx_vvtc_angl_dec_slop "Minimum VVT angle decrease slope during change of setpoint" VALUE 0xa0020bcc _REC_S1VAL_20_u2 720. _CNV_A_R_LINEAR_____286_CM -720. 0. FORMAT "%8.2" /end CHARACTERISTIC
/begin CHARACTERISTIC Cxx_vvtc_angl_inc_slop "Maximum VVT angle increase slope during change of setpoint" VALUE 0xa0020bce _REC_S1VAL_20_u2 720. _CNV_A_R_LINEAR_____287_CM 0. 720. FORMAT "%7.2" /end CHARACTERISTIC
/begin CHARACTERISTIC Cxx_vvtc_angl_trs_dly "Duration of the transition mode" VALUE 0xa0020bd0 _REC_S1VAL_20_u2 655.35 _CNV_A_R_LINEAR_____32_CM 0. 655.35 FORMAT "%6.2" /end CHARACTERISTIC
/begin CHARACTERISTIC Cxx_vvtc_trs_amp_thd "Threshold of the atmospheric pressure for the transition mode" VALUE 0xa0020bd2 _REC_S1VAL_20_u2 20000. _CNV_A_R_LINEAR_____115_CM 0. 20000. FORMAT "%5.0" /end CHARACTERISTIC
/begin CHARACTERISTIC Cxx_vvtc_trs_dly "Time during which the Wastegate transient is forced to off for the transient of VVT" VALUE 0xa0020bda _REC_S1VAL_20_u1 2.55 _CNV_A_R_LINEAR_____32_CM 0. 2.55 FORMAT "%4.2" /end CHARACTERISTIC
/begin CHARACTERISTIC Cxx_vvtc_trs_n_thd "Threshold of the engine speed for the transition mode" VALUE 0xa0020bd4 _REC_S1VAL_20_u2 16383.75 _CNV_A_R_ENSD_LINEA_22_CM 0. 16383.75 FORMAT "%8.2" /end CHARACTERISTIC
/begin CHARACTERISTIC Cxx_vvtc_trs_tco_thd "Threshold of the engine coolant temperature for the transition mode" VALUE 0xa0020bd6 _REC_S1VAL_20_u2 240. _CNV_A_R_LINEAR_____110_CM -40. 200. FORMAT "%5.1" /end CHARACTERISTIC
/begin CHARACTERISTIC Cxx_vvtc_trs_vs_thd "Threshold of the Vehicle speed for the transition mode" VALUE 0xa0020bd8 _REC_S1VAL_20_u2 655.35 _CNV_A_R_LINEAR_____125_CM 0. 655.35 FORMAT "%6.2" /end CHARACTERISTIC
/begin AXIS_PTS Ctb_in_vvtc_act_cold_temp_n_bkp "Table of engine speed used with cartographies Ctp_in_vvtc_act_cold_temp_thd" 0xa0024598 Vxx_n _REC_A2AXS_20_u2 16383.75 _CNV_A_R_ENSD_LINEA_22_CM 9 0. 16383.75 FORMAT "%8.2" /end AXIS_PTS
/begin AXIS_PTS Ctb_in_vvtc_act_hot_temp_n_bkp "Table of engine speed used with cartographies Ctp_in_vvtc_act_hot_temp_thd_1 and Ctp_in_vvtc_act_hot_temp_thd_2" 0xa00245ac Vxx_n _REC_A2AXS_20_u2 16383.75 _CNV_A_R_ENSD_LINEA_22_CM 9 0. 16383.75 FORMAT "%8.2" /end AXIS_PTS
/begin AXIS_PTS Ctb_in_vvtc_angl_sp_cyc_t_bkp "Table of duration breakpoints used with the cartography Ctp_in_vvtc_angl_sp_cyc" 0xa00245c0 Vxx_in_vvtc_angle_sp_cyc_t _REC_A2AXS_20_u2 655.35 _CNV_A_R_LINEAR_____32_CM 32 0. 655.35 FORMAT "%6.2" /end AXIS_PTS
/begin CHARACTERISTIC Ctp_in_vvtc_act_cold_temp_thd "Table of maximum (coolant or oil) temperature thresholds for the deactivation of the VVTC at cold running" CURVE 0xa0024604 _REC_A1CUR_20_u2_u2 240. _CNV_A_R_LINEAR_____110_CM -40. 200. FORMAT "%5.1"
 /begin AXIS_DESCR COM_AXIS Vxx_n _CNV_A_R_ENSD_LINEA_22_CM 9 0. 16383.75 FORMAT "%8.2" AXIS_PTS_REF Ctb_in_vvtc_act_cold_temp_n_bkp /end AXIS_DESCR
/end CHARACTERISTIC
/begin CHARACTERISTIC Ctp_in_vvtc_act_hot_thd_1 "Table of maximum (coolant or oil) temperature thresholds for the deactivation of the VVTC at hot running" CURVE 0xa0024618 _REC_A1CUR_20_u2_u2 240. _CNV_A_R_LINEAR_____110_CM -40. 200. FORMAT "%5.1"
 /begin AXIS_DESCR COM_AXIS Vxx_n _CNV_A_R_ENSD_LINEA_22_CM 9 0. 16383.75 FORMAT "%8.2" AXIS_PTS_REF Ctb_in_vvtc_act_hot_temp_n_bkp /end AXIS_DESCR
/end CHARACTERISTIC
/begin CHARACTERISTIC Ctp_in_vvtc_act_hot_thd_2 "Table of (coolant or oil) temperature thresholds to define the risk zon" CURVE 0xa002462c _REC_A1CUR_20_u2_u2 240. _CNV_A_R_LINEAR_____110_CM -40. 200. FORMAT "%5.1"
 /begin AXIS_DESCR COM_AXIS Vxx_n _CNV_A_R_ENSD_LINEA_22_CM 9 0. 16383.75 FORMAT "%8.2" AXIS_PTS_REF Ctb_in_vvtc_act_hot_temp_n_bkp /end AXIS_DESCR
/end CHARACTERISTIC
/begin CHARACTERISTIC Ctp_in_vvtc_angl_sp_cyc "Cartography with specific VVTC setpoints in bench mode " CURVE 0xa0024640 _REC_A1CUR_20_u2_u2 719.98 _CNV_A_R_LINEAR_____129_CM 0. 719.98 FORMAT "%6.2"
 /begin AXIS_DESCR COM_AXIS Vxx_in_vvtc_angle_sp_cyc_t _CNV_A_R_LINEAR_____32_CM 32 0. 655.35 FORMAT "%6.2" AXIS_PTS_REF Ctb_in_vvtc_angl_sp_cyc_t_bkp /end AXIS_DESCR
/end CHARACTERISTIC
/begin MEASUREMENT Vbx_in_vvtc_act_ena_vb "" UBYTE _CNV_S_2_RANGE______3_CM 1 0. 0. 1. ECU_ADDRESS 0xd0006454 BIT_MASK 0x1 /end MEASUREMENT
/begin MEASUREMENT Vbx_in_vvtc_ena_run "The VVTC system is operating (setpoint is applied)" UBYTE _CNV_S_2_RANGE______3_CM 1 0. 0. 1. ECU_ADDRESS 0xd0006455 BIT_MASK 0x1 /end MEASUREMENT
/begin MEASUREMENT Vbx_in_vvtc_ena_sldv_cln "Allow Oil Control Valve auto-cleaning mode" UBYTE _CNV_S_2_RANGE______3_CM 1 0. 0. 1. ECU_ADDRESS 0xd0006456 BIT_MASK 0x1 /end MEASUREMENT
/begin MEASUREMENT Vbx_in_vvtc_h_n_inh "The VVTC system is inhibited (setpoint is set to zero) at high engine speed" UBYTE _CNV_S_2_RANGE______3_CM 1 0. 0. 1. ECU_ADDRESS 0xd0006457 BIT_MASK 0x1 /end MEASUREMENT
/begin MEASUREMENT Vbx_in_vvtc_inh_zon "Indicate that VVTC is in the inhibition zone" UBYTE _CNV_S_2_RANGE______3_CM 1 0. 0. 1. ECU_ADDRESS 0xd0006458 BIT_MASK 0x1 /end MEASUREMENT
/begin MEASUREMENT Vbx_in_vvtc_risk_zon "Indicate that VVTC is operating in the risk zone" UBYTE _CNV_S_2_RANGE______3_CM 1 0. 0. 1. ECU_ADDRESS 0xd0006459 BIT_MASK 0x1 /end MEASUREMENT
/begin MEASUREMENT Vbx_in_vvtc_sp_fail "Failure mode on the VVTC set point" UBYTE _CNV_S_2_RANGE______3_CM 1 0. 0. 1. ECU_ADDRESS 0xd000645a BIT_MASK 0x1 /end MEASUREMENT
/begin MEASUREMENT Vxx_in_vvtc_act_ena_fac "Coefficient to smooth variations of setpoint during activation/deactivation transitions" UWORD _CNV_A_R_LINEAR_____159_CM 1 0. 0. 100. ECU_ADDRESS 0xd0003da2 FORMAT "%12.8" /end MEASUREMENT
/begin MEASUREMENT Vxx_in_vvtc_angl_sp "Angular position setpoint of the intake VVTC system" UWORD _CNV_A_R_LINEAR_____129_CM 1 0. 0. 719.98 ECU_ADDRESS 0xd0003da4 FORMAT "%6.2" /end MEASUREMENT
/begin MEASUREMENT Vxx_in_vvtc_angl_sp_bch "Value of the VVTC setpoint in bench mode" UWORD _CNV_A_R_LINEAR_____129_CM 1 0. 0. 719.98 ECU_ADDRESS 0xd0003da6 FORMAT "%6.2" /end MEASUREMENT
/begin MEASUREMENT Vxx_in_vvtc_angle_sp_cyc_t "VVTC setpoint cycle duration" UWORD _CNV_A_R_LINEAR_____32_CM 1 0. 0. 655.35 ECU_ADDRESS 0xd0003da8 FORMAT "%6.2" /end MEASUREMENT
/begin CHARACTERISTIC Cbx_in_vvtc_angl_sp_cho "Select value of the setpoint (=0 depend on engine need / =1 from bench mode)" VALUE 0xa0020bc4 _REC_S1VAL_20_u1 1. _CNV_A_R_ECME_LINEA_0_CM 0. 1. FORMAT "%1.0" BIT_MASK 0x1 /end CHARACTERISTIC
/begin CHARACTERISTIC Cbx_in_vvtc_angl_sp_cho_bch "Select value of the setpoint in bench mode (= 0 from a cartography / = 1 from a calibration)" VALUE 0xa0020bc5 _REC_S1VAL_20_u1 1. _CNV_A_R_ECME_LINEA_0_CM 0. 1. FORMAT "%1.0" BIT_MASK 0x1 /end CHARACTERISTIC
/begin CHARACTERISTIC Cbx_in_vvtc_cho_angl_vld "Consider or not the Cam/Crank angle validity status in the activation conditions of the OCV auto-cleaning" VALUE 0xa0020bc6 _REC_S1VAL_20_u1 1. _CNV_A_R_ECME_LINEA_0_CM 0. 1. FORMAT "%1.0" BIT_MASK 0x1 /end CHARACTERISTIC
/begin CHARACTERISTIC Cbx_in_vvtc_cho_sldv_vld "Consider or not the solenoid validity status in the activation conditions of the OCV auto-cleaning" VALUE 0xa0020bc7 _REC_S1VAL_20_u1 1. _CNV_A_R_ECME_LINEA_0_CM 0. 1. FORMAT "%1.0" BIT_MASK 0x1 /end CHARACTERISTIC
/begin CHARACTERISTIC Cbx_in_vvtc_cho_tco_toil_cold "Select coolant or oil temperature to determine the activation/deactivation condition when engine is cold" VALUE 0xa0020bc8 _REC_S1VAL_20_u1 1. _CNV_A_R_ECME_LINEA_0_CM 0. 1. FORMAT "%1.0" BIT_MASK 0x1 /end CHARACTERISTIC
/begin CHARACTERISTIC Cbx_in_vvtc_cho_tco_toil_hot "Select coolant or oil temperature to determine the activation/deactivation condition when engine is hot" VALUE 0xa0020bc9 _REC_S1VAL_20_u1 1. _CNV_A_R_ECME_LINEA_0_CM 0. 1. FORMAT "%1.0" BIT_MASK 0x1 /end CHARACTERISTIC
/begin CHARACTERISTIC Cbx_in_vvtc_cold_act_cdn "Indicates that there is an activation condition of the system depending on cooloant or oil temperature at engine cold running" VALUE 0xa0020bca _REC_S1VAL_20_u1 1. _CNV_A_R_ECME_LINEA_0_CM 0. 1. FORMAT "%1.0" BIT_MASK 0x1 /end CHARACTERISTIC
/begin CHARACTERISTIC Cbx_in_vvtc_hot_act_cdn "Indicates that there is an inhibition condition of the system depending on cooloant or oil temperature at engine hot running" VALUE 0xa0020bcb _REC_S1VAL_20_u1 1. _CNV_A_R_ECME_LINEA_0_CM 0. 1. FORMAT "%1.0" BIT_MASK 0x1 /end CHARACTERISTIC
/begin CHARACTERISTIC Cxx_in_vvtc_act_cold_temp_hys "Hysteresis on the minimum (coolant or oil) temperature threshold for the activation/deactivation of the VVTC" VALUE 0xa0020b9a _REC_S1VAL_20_u2 240. _CNV_A_R_LINEAR_____110_CM -40. 200. FORMAT "%5.1" /end CHARACTERISTIC
/begin CHARACTERISTIC Cxx_in_vvtc_act_ena_max_vb_thd "Maximum Battery Voltage for the activation of the VVTC" VALUE 0xa0020b9c _REC_S1VAL_20_u2 60. _CNV_A_R_LINEAR_____205_CM 0. 60. FORMAT "%5.2" /end CHARACTERISTIC
/begin CHARACTERISTIC Cxx_in_vvtc_act_ena_min_vb_thd "Minimum Battery Voltage for the activation of the VVTC" VALUE 0xa0020b9e _REC_S1VAL_20_u2 60. _CNV_A_R_LINEAR_____205_CM 0. 60. FORMAT "%5.2" /end CHARACTERISTIC
/begin CHARACTERISTIC Cxx_in_vvtc_act_ena_n_hys "Hysteresis on the engine speed hysteresis for the activation/deactivation of the VVTC" VALUE 0xa0020ba0 _REC_S1VAL_20_u2 16383.75 _CNV_A_R_ENSD_LINEA_22_CM 0. 16383.75 FORMAT "%8.2" /end CHARACTERISTIC
/begin CHARACTERISTIC Cxx_in_vvtc_act_ena_n_thd "Engine speed threshold for the activation of the VVTC" VALUE 0xa0020ba2 _REC_S1VAL_20_u2 16383.75 _CNV_A_R_ENSD_LINEA_22_CM 0. 16383.75 FORMAT "%8.2" /end CHARACTERISTIC
/begin CHARACTERISTIC Cxx_in_vvtc_act_ena_vb_hys "Battery Voltage Hysteresis for the activation of the VVTC" VALUE 0xa0020ba4 _REC_S1VAL_20_u2 60. _CNV_A_R_LINEAR_____205_CM 0. 60. FORMAT "%5.2" /end CHARACTERISTIC
/begin CHARACTERISTIC Cxx_in_vvtc_act_hot_temp_hys_1 "Hysteresis on the maximum (coolant or oil) tempeature threshold for VVTC activation/deactivation at hot" VALUE 0xa0020ba6 _REC_S1VAL_20_u2 240. _CNV_A_R_LINEAR_____110_CM -40. 200. FORMAT "%5.1" /end CHARACTERISTIC
/begin CHARACTERISTIC Cxx_in_vvtc_act_hot_temp_hys_2 "Hysteresis on (coolant or oil) temperature for the definition of the risk zone" VALUE 0xa0020ba8 _REC_S1VAL_20_u2 240. _CNV_A_R_LINEAR_____110_CM -40. 200. FORMAT "%5.1" /end CHARACTERISTIC
/begin CHARACTERISTIC Cxx_in_vvtc_angl_sp_bch "Setpoint applied in bench mode" VALUE 0xa0020baa _REC_S1VAL_20_u2 719.98 _CNV_A_R_LINEAR_____129_CM 0. 719.98 FORMAT "%6.2" /end CHARACTERISTIC
/begin CHARACTERISTIC Cxx_in_vvtc_angl_sp_cyc_t "Duration of the setpoint cycle" VALUE 0xa0020bac _REC_S1VAL_20_u2 655.35 _CNV_A_R_LINEAR_____32_CM 0. 655.35 FORMAT "%6.2" /end CHARACTERISTIC
/begin CHARACTERISTIC Cxx_in_vvtc_angl_sp_h_lim_thd "Threshold to limit the angular displacement of the intake VVTC actuator (solenoid valve reliability considerations)" VALUE 0xa0020bae _REC_S1VAL_20_u2 719.98 _CNV_A_R_LINEAR_____129_CM 0. 719.98 FORMAT "%6.2" /end CHARACTERISTIC
/begin CHARACTERISTIC Cxx_in_vvtc_dsb_ena_fil_inc "Value of the increment (per 10 ms) for the calculation of the smoothing coefficient" VALUE 0xa0020bb0 _REC_S1VAL_20_u2 100. _CNV_A_R_LINEAR_____159_CM 0. 100. FORMAT "%12.8" /end CHARACTERISTIC
/begin CHARACTERISTIC Cxx_in_vvtc_eng_wup_t "Duration after engine start to consider that the engine is warm" VALUE 0xa0020bb2 _REC_S1VAL_20_u2 6553.5 _CNV_A_R_LINEAR_____58_CM 0. 6553.5 FORMAT "%6.1" /end CHARACTERISTIC
/begin CHARACTERISTIC Cxx_in_vvtc_inh_h_n_hys "Hysteresis on the engine speed hysteresis for the VVTC inhibition at high engine speed" VALUE 0xa0020bb4 _REC_S1VAL_20_u2 16383.75 _CNV_A_R_ENSD_LINEA_22_CM 0. 16383.75 FORMAT "%8.2" /end CHARACTERISTIC
/begin CHARACTERISTIC Cxx_in_vvtc_inh_h_n_thd "Engine speed threshold for the VVTC inhibition at high engine speed" VALUE 0xa0020bb6 _REC_S1VAL_20_u2 16383.75 _CNV_A_R_ENSD_LINEA_22_CM 0. 16383.75 FORMAT "%8.2" /end CHARACTERISTIC
/begin CHARACTERISTIC Cxx_in_vvtc_n_thd_inh_hot "Engine speed threshold to inhibit the VVTC system if invalid coolant or oil temperature information at hot running" VALUE 0xa0020bb8 _REC_S1VAL_20_u2 16383.75 _CNV_A_R_ENSD_LINEA_22_CM 0. 16383.75 FORMAT "%8.2" /end CHARACTERISTIC
/begin CHARACTERISTIC Cxx_in_vvtc_sldv_ena_n_hys "Hysteresis on the engine speed for the activation/deactivation of the auto-cleaning mode" VALUE 0xa0020bba _REC_S1VAL_20_u2 16383.75 _CNV_A_R_ENSD_LINEA_22_CM 0. 16383.75 FORMAT "%8.2" /end CHARACTERISTIC
/begin CHARACTERISTIC Cxx_in_vvtc_sldv_ena_n_thd "Engine speed threshold for the activation of the auto-cleaning mode" VALUE 0xa0020bbc _REC_S1VAL_20_u2 16383.75 _CNV_A_R_ENSD_LINEA_22_CM 0. 16383.75 FORMAT "%8.2" /end CHARACTERISTIC
/begin CHARACTERISTIC Cxx_in_vvtc_t_ena_sldv_cyc "Duration of no VVTC movement to activate the auto-cleaning mode" VALUE 0xa0020bbe _REC_S1VAL_20_u2 6553.5 _CNV_A_R_LINEAR_____58_CM 0. 6553.5 FORMAT "%6.1" /end CHARACTERISTIC
/begin CHARACTERISTIC Cxx_in_vvtc_temp_thd_max_sldv "Condition on the maximum (coolant or oil) temperature for the activation/deactivation of the auto-cleaning mode" VALUE 0xa0020bc0 _REC_S1VAL_20_u2 240. _CNV_A_R_LINEAR_____110_CM -40. 200. FORMAT "%5.1" /end CHARACTERISTIC
/begin CHARACTERISTIC Cxx_in_vvtc_temp_thd_min_sldv "Condition on the minimum (coolant or oil) temperature for the activation/deactivation of the auto-cleaning mode" VALUE 0xa0020bc2 _REC_S1VAL_20_u2 240. _CNV_A_R_LINEAR_____110_CM -40. 200. FORMAT "%5.1" /end CHARACTERISTIC
/begin AXIS_PTS Ctb_diag_in_vvtc_sp_cyc_t_bkp "Table of duration breakpoints used with the cartography Ctp_diag_in_vvtc_angl_sp_cyc" 0xa0024a08 Vxx_diag_in_vvtc_sp_cyc_t _REC_A2AXS_20_u2 655.35 _CNV_A_R_LINEAR_____32_CM 32 0. 655.35 FORMAT "%6.2" /end AXIS_PTS
/begin CHARACTERISTIC Ctp_diag_in_vvtc_angl_sp_cyc "Cartography with specific VVTC setpoints used for aftersales routine" CURVE 0xa0024a4c _REC_A1CUR_20_u2_u2 719.98 _CNV_A_R_LINEAR_____129_CM 0. 719.98 FORMAT "%6.2"
 /begin AXIS_DESCR COM_AXIS Vxx_diag_in_vvtc_sp_cyc_t _CNV_A_R_LINEAR_____32_CM 32 0. 655.35 FORMAT "%6.2" AXIS_PTS_REF Ctb_diag_in_vvtc_sp_cyc_t_bkp /end AXIS_DESCR
/end CHARACTERISTIC
/begin MEASUREMENT Vbx_diag_in_vvtc_ena_bgin_test "Beginning of VVTC actuation test (aftersales routine)" UBYTE _CNV_S_2_RANGE______3_CM 1 0. 0. 1. ECU_ADDRESS 0xd0006478 BIT_MASK 0x1 /end MEASUREMENT
/begin MEASUREMENT Vbx_diag_in_vvtc_n_cdn_ok "Engine speed condition OK for VVTC actuation test (aftersales routine)" UBYTE _CNV_S_2_RANGE______3_CM 1 0. 0. 1. ECU_ADDRESS 0xd0006479 BIT_MASK 0x1 /end MEASUREMENT
/begin MEASUREMENT Vbx_diag_in_vvtc_nok_n_cdn "Engine speed condition NOK during VVTC actuation test (aftersales routine)" UBYTE _CNV_S_2_RANGE______3_CM 1 0. 0. 1. ECU_ADDRESS 0xd000647a BIT_MASK 0x1 /end MEASUREMENT
/begin MEASUREMENT Vbx_diag_in_vvtc_test_ok "VVTC actuation finished" UBYTE _CNV_S_2_RANGE______3_CM 1 0. 0. 1. ECU_ADDRESS 0xd000647b BIT_MASK 0x1 /end MEASUREMENT
/begin MEASUREMENT Vbx_diag_sta_vvtc_abrt "VVTC actuation test aborted (aftersales routine)" UBYTE _CNV_S_2_RANGE______3_CM 1 0. 0. 1. ECU_ADDRESS 0xd000647c BIT_MASK 0x1 /end MEASUREMENT
/begin MEASUREMENT Vbx_diag_sta_vvtc_ena "Activation of the VVTC routine" UBYTE _CNV_S_2_RANGE______3_CM 1 0. 0. 1. ECU_ADDRESS 0xd000647d BIT_MASK 0x1 /end MEASUREMENT
/begin MEASUREMENT Vbx_diag_sta_vvtc_end "End of the VVTC actuation test (aftersales routine)" UBYTE _CNV_S_2_RANGE______3_CM 1 0. 0. 1. ECU_ADDRESS 0xd000647e BIT_MASK 0x1 /end MEASUREMENT
/begin MEASUREMENT Vsx_diag_sta_vvtc_stt "VVT aftersales routine status" UBYTE _CNV_S_4_RANGE_ROUT_288_CM 1 0. 0. 3. ECU_ADDRESS 0xd000647f /end MEASUREMENT
/begin MEASUREMENT Vxx_diag_in_vvtc_n_sub_val "Engine speed substitute value for VVT actuation test (aftersales routine)" UWORD _CNV_A_R_ENSD_LINEA_22_CM 1 0. 0. 16383.75 ECU_ADDRESS 0xd0003dc2 FORMAT "%8.2" /end MEASUREMENT
/begin MEASUREMENT Vxx_diag_in_vvtc_sp_cyc_t "Variable used to display time for the cartographie Ctp_diag_in_vvtc_angl_sp_cyc" UWORD _CNV_A_R_LINEAR_____32_CM 1 0. 0. 655.35 ECU_ADDRESS 0xd0003dc4 FORMAT "%6.2" /end MEASUREMENT
/begin MEASUREMENT Vxx_diag_in_vvtc_sp_sub_val "Angular setpoint subsitute value for VVTC actuation test (with aftersales routine)" UWORD _CNV_A_R_LINEAR_____129_CM 1 0. 0. 719.98 ECU_ADDRESS 0xd0003dc6 FORMAT "%6.2" /end MEASUREMENT
/begin CHARACTERISTIC Cxx_diag_in_vvtc_n_ena_thd "Engine speed thershold to start VVTC actuation test" VALUE 0xa0020bdc _REC_S1VAL_20_u2 16383.75 _CNV_A_R_ENSD_LINEA_22_CM 0. 16383.75 FORMAT "%8.2" /end CHARACTERISTIC
/begin CHARACTERISTIC Cxx_diag_in_vvtc_n_nok_drg_test "Duration to detect that engine speed value not coherent with VVTC actuation test (aftersales routine)" VALUE 0xa0020bde _REC_S1VAL_20_u2 655.35 _CNV_A_R_LINEAR_____32_CM 0. 655.35 FORMAT "%6.2" /end CHARACTERISTIC
/begin CHARACTERISTIC Cxx_diag_in_vvtc_n_stab_t "Duration to consider that engine speed reached the stabilization value" VALUE 0xa0020be0 _REC_S1VAL_20_u2 655.35 _CNV_A_R_LINEAR_____32_CM 0. 655.35 FORMAT "%6.2" /end CHARACTERISTIC
/begin CHARACTERISTIC Cxx_diag_in_vvtc_n_sub_val "Engine speed substitute value for VVTC actuation test (aftersales routine)" VALUE 0xa0020be2 _REC_S1VAL_20_u2 16383.75 _CNV_A_R_ENSD_LINEA_22_CM 0. 16383.75 FORMAT "%8.2" /end CHARACTERISTIC
/begin CHARACTERISTIC Cxx_diag_in_vvtc_sp_cyc_t "VVTC actuation duration (aftersales routine)" VALUE 0xa0020be4 _REC_S1VAL_20_u2 655.35 _CNV_A_R_LINEAR_____32_CM 0. 655.35 FORMAT "%6.2" /end CHARACTERISTIC
/begin MEASUREMENT Vbx_df_lbup_hot_oc "" UBYTE _CNV_S_2_RANGE______3_CM 1 0. 0. 1. ECU_ADDRESS 0xd000657f BIT_MASK 0x1 /end MEASUREMENT
/begin MEASUREMENT Vbx_df_lbup_hot_scg "" UBYTE _CNV_S_2_RANGE______3_CM 1 0. 0. 1. ECU_ADDRESS 0xd0006580 BIT_MASK 0x1 /end MEASUREMENT
/begin MEASUREMENT Vbx_df_lbup_hot_scw "" UBYTE _CNV_S_2_RANGE______3_CM 1 0. 0. 1. ECU_ADDRESS 0xd0006581 BIT_MASK 0x1 /end MEASUREMENT
/begin MEASUREMENT Vbx_diag_ena_lbup_hot_oc "" UBYTE _CNV_S_2_RANGE______3_CM 1 0. 0. 1. ECU_ADDRESS 0xd0006582 BIT_MASK 0x1 /end MEASUREMENT
/begin MEASUREMENT Vbx_diag_ena_lbup_hot_scg "" UBYTE _CNV_S_2_RANGE______3_CM 1 0. 0. 1. ECU_ADDRESS 0xd0006583 BIT_MASK 0x1 /end MEASUREMENT
/begin MEASUREMENT Vbx_diag_ena_lbup_hot_scw "" UBYTE _CNV_S_2_RANGE______3_CM 1 0. 0. 1. ECU_ADDRESS 0xd0006584 BIT_MASK 0x1 /end MEASUREMENT
/begin MEASUREMENT Vxx_lbup_heat_crt "Heater current for upstream lambda sensor" UWORD _CNV_A_R_LINEAR_____289_CM 1 0. 0. 5.5 ECU_ADDRESS 0xd0003f16 FORMAT "%6.4" /end MEASUREMENT
/begin MEASUREMENT Vxx_lbup_heat_crt_prv "Heater current old for upstream lambda sensor" UWORD _CNV_A_R_LINEAR_____289_CM 1 0. 0. 5.5 ECU_ADDRESS 0xd0004f36 FORMAT "%6.4" /end MEASUREMENT
/begin MEASUREMENT cdn_diag_lsh_up "Diagnosis condition for each symptom of upstream heater diagnosis OBD I" UBYTE _CNV_A_R_ECME_LINEA_0_CM 1 0. 0. 7. ECU_ADDRESS 0xd0006586 FORMAT "%1.0" /end MEASUREMENT
/begin MEASUREMENT err_diag_lsh_up "raw value of error symptom for upstream heater diagnosis OBD I" UBYTE _CNV_S_16_RANGE_ERR__206_CM 1 0. 0. 15. ECU_ADDRESS 0xd0006585 /end MEASUREMENT
/begin MEASUREMENT Vbx_df_lbdw_hot_oc "" UBYTE _CNV_S_2_RANGE______3_CM 1 0. 0. 1. ECU_ADDRESS 0xd000653c BIT_MASK 0x1 /end MEASUREMENT
/begin MEASUREMENT Vbx_df_lbdw_hot_scg "" UBYTE _CNV_S_2_RANGE______3_CM 1 0. 0. 1. ECU_ADDRESS 0xd000653d BIT_MASK 0x1 /end MEASUREMENT
/begin MEASUREMENT Vbx_df_lbdw_hot_scw "" UBYTE _CNV_S_2_RANGE______3_CM 1 0. 0. 1. ECU_ADDRESS 0xd000653e BIT_MASK 0x1 /end MEASUREMENT
/begin MEASUREMENT Vbx_diag_ena_lbdw_hot_oc "" UBYTE _CNV_S_2_RANGE______3_CM 1 0. 0. 1. ECU_ADDRESS 0xd000653f BIT_MASK 0x1 /end MEASUREMENT
/begin MEASUREMENT Vbx_diag_ena_lbdw_hot_scg "" UBYTE _CNV_S_2_RANGE______3_CM 1 0. 0. 1. ECU_ADDRESS 0xd0006540 BIT_MASK 0x1 /end MEASUREMENT
/begin MEASUREMENT Vbx_diag_ena_lbdw_hot_scw "" UBYTE _CNV_S_2_RANGE______3_CM 1 0. 0. 1. ECU_ADDRESS 0xd0006541 BIT_MASK 0x1 /end MEASUREMENT
/begin MEASUREMENT Vxx_lbdw_heat_crt "Heater current for downstream lambda sensor" UWORD _CNV_A_R_LINEAR_____289_CM 1 0. 0. 5.5 ECU_ADDRESS 0xd0003f14 FORMAT "%6.4" /end MEASUREMENT
/begin MEASUREMENT Vxx_lbdw_heat_crt_prv "Heater current old for downstream lambda sensor" UWORD _CNV_A_R_LINEAR_____289_CM 1 0. 0. 5.5 ECU_ADDRESS 0xd0004eee FORMAT "%6.4" /end MEASUREMENT
/begin MEASUREMENT cdn_diag_lsh_down "Diagnosis condition for each symptom of downstream heater diagnosis OBD I" UBYTE _CNV_A_R_ECME_LINEA_0_CM 1 0. 0. 7. ECU_ADDRESS 0xd000653b FORMAT "%1.0" /end MEASUREMENT
/begin MEASUREMENT err_diag_lsh_down "Raw value of error symptom for downstream heater diagnosis OBD I" UBYTE _CNV_S_16_RANGE_ERR__206_CM 1 0. 0. 15. ECU_ADDRESS 0xd000653a /end MEASUREMENT
/begin MEASUREMENT Vbx_df_cp_oc "Short circuit to battery of canister purge detected failure" UBYTE _CNV_S_2_RANGE______3_CM 1 0. 0. 1. ECU_ADDRESS 0xd000620e BIT_MASK 0x1 /end MEASUREMENT
/begin MEASUREMENT Vbx_df_cp_scg "Short circuit to ground of canister purge detected failure" UBYTE _CNV_S_2_RANGE______3_CM 1 0. 0. 1. ECU_ADDRESS 0xd000620f BIT_MASK 0x1 /end MEASUREMENT
/begin MEASUREMENT Vbx_df_cp_scw "open circuit of canister purge detected failure" UBYTE _CNV_S_2_RANGE______3_CM 1 0. 0. 1. ECU_ADDRESS 0xd0006210 BIT_MASK 0x1 /end MEASUREMENT
/begin MEASUREMENT Vbx_df_efi_sldv_2_oc "Electrovalve for fuel additionnal tank open circuit detected failure" UBYTE _CNV_S_2_RANGE______3_CM 1 0. 0. 1. ECU_ADDRESS 0xd00075cb BIT_MASK 0x1 /end MEASUREMENT
/begin MEASUREMENT Vbx_df_efi_sldv_2_scg "Electrovalve for fuel additionnal tank short circuit to ground detected failure" UBYTE _CNV_S_2_RANGE______3_CM 1 0. 0. 1. ECU_ADDRESS 0xd00075cc BIT_MASK 0x1 /end MEASUREMENT
/begin MEASUREMENT Vbx_df_efi_sldv_2_scw "Electrovalve for fuel additionnal tank short circuit to power supply detected failure" UBYTE _CNV_S_2_RANGE______3_CM 1 0. 0. 1. ECU_ADDRESS 0xd00075cd BIT_MASK 0x1 /end MEASUREMENT
/begin MEASUREMENT Vbx_df_eva_sldv_oc "Open circuit on shut-off valve command detected failure" UBYTE _CNV_S_2_RANGE______3_CM 1 0. 0. 1. ECU_ADDRESS 0xd00075ce BIT_MASK 0x1 /end MEASUREMENT
/begin MEASUREMENT Vbx_df_eva_sldv_scg "Short circuit to ground on shut-off valve command detected failure" UBYTE _CNV_S_2_RANGE______3_CM 1 0. 0. 1. ECU_ADDRESS 0xd00075cf BIT_MASK 0x1 /end MEASUREMENT
/begin MEASUREMENT Vbx_df_eva_sldv_scw "Short circuit to battery on shut-off valve command detected failure" UBYTE _CNV_S_2_RANGE______3_CM 1 0. 0. 1. ECU_ADDRESS 0xd00075d0 BIT_MASK 0x1 /end MEASUREMENT
/begin MEASUREMENT Vbx_df_gas_pump_2_oc "Open Circuit of Additional Fuel Pump detected failure" UBYTE _CNV_S_2_RANGE______3_CM 1 0. 0. 1. ECU_ADDRESS 0xd00075d1 BIT_MASK 0x1 /end MEASUREMENT
/begin MEASUREMENT Vbx_df_gas_pump_2_scg "Short circuit to ground of Additional Fuel Pump detected failure" UBYTE _CNV_S_2_RANGE______3_CM 1 0. 0. 1. ECU_ADDRESS 0xd00075d2 BIT_MASK 0x1 /end MEASUREMENT
/begin MEASUREMENT Vbx_df_gas_pump_2_scw "Short Circuit to battery of Additional Fuel Pump detected failure" UBYTE _CNV_S_2_RANGE______3_CM 1 0. 0. 1. ECU_ADDRESS 0xd00075d3 BIT_MASK 0x1 /end MEASUREMENT
/begin MEASUREMENT Vbx_df_gas_pump_oc "Open circuit on gas pump detected failure" UBYTE _CNV_S_2_RANGE______3_CM 1 0. 0. 1. ECU_ADDRESS 0xd0006211 BIT_MASK 0x1 /end MEASUREMENT
/begin MEASUREMENT Vbx_df_gas_pump_scg "Short circuit to ground on gas pump detected failure" UBYTE _CNV_S_2_RANGE______3_CM 1 0. 0. 1. ECU_ADDRESS 0xd0006212 BIT_MASK 0x1 /end MEASUREMENT
/begin MEASUREMENT Vbx_df_gas_pump_scw "Short circuit to battery on gas pump detected failure" UBYTE _CNV_S_2_RANGE______3_CM 1 0. 0. 1. ECU_ADDRESS 0xd0006213 BIT_MASK 0x1 /end MEASUREMENT
/begin MEASUREMENT Vbx_diag_ena_cp_oc "Open circuit of canister purge diagnosis information available" UBYTE _CNV_S_2_RANGE______3_CM 1 0. 0. 1. ECU_ADDRESS 0xd0006214 BIT_MASK 0x1 /end MEASUREMENT
/begin MEASUREMENT Vbx_diag_ena_cp_scg "Short circuit to ground of canister diagnosis information available" UBYTE _CNV_S_2_RANGE______3_CM 1 0. 0. 1. ECU_ADDRESS 0xd0006215 BIT_MASK 0x1 /end MEASUREMENT
/begin MEASUREMENT Vbx_diag_ena_cp_scw "Short circuit to battery of canister purge diagnosis information available" UBYTE _CNV_S_2_RANGE______3_CM 1 0. 0. 1. ECU_ADDRESS 0xd0006216 BIT_MASK 0x1 /end MEASUREMENT
/begin MEASUREMENT Vbx_diag_ena_efi_sldv_2_oc "Electrovalve for fuel additionnal tank open circuit diagnosis information available" UBYTE _CNV_S_2_RANGE______3_CM 1 0. 0. 1. ECU_ADDRESS 0xd00075d4 BIT_MASK 0x1 /end MEASUREMENT
/begin MEASUREMENT Vbx_diag_ena_efi_sldv_2_scg "Electrovalve for fuel additionnal tank short circuit to ground diagnosis information available" UBYTE _CNV_S_2_RANGE______3_CM 1 0. 0. 1. ECU_ADDRESS 0xd00075d5 BIT_MASK 0x1 /end MEASUREMENT
/begin MEASUREMENT Vbx_diag_ena_efi_sldv_2_scw "Electrovalve for fuel additionnal tank short circuit to power supply diagnosis information available" UBYTE _CNV_S_2_RANGE______3_CM 1 0. 0. 1. ECU_ADDRESS 0xd00075d6 BIT_MASK 0x1 /end MEASUREMENT
/begin MEASUREMENT Vbx_diag_ena_eva_sldv_oc "Open circuit on shut-off valve command diagnosis authorization" UBYTE _CNV_S_2_RANGE______3_CM 1 0. 0. 1. ECU_ADDRESS 0xd00075d7 BIT_MASK 0x1 /end MEASUREMENT
/begin MEASUREMENT Vbx_diag_ena_eva_sldv_scg "Open circuit on shut-off valve command diagnosis authorization" UBYTE _CNV_S_2_RANGE______3_CM 1 0. 0. 1. ECU_ADDRESS 0xd00075d8 BIT_MASK 0x1 /end MEASUREMENT
/begin MEASUREMENT Vbx_diag_ena_eva_sldv_scw "Short circuit to battery on shut-off valve command diagnosis authorization" UBYTE _CNV_S_2_RANGE______3_CM 1 0. 0. 1. ECU_ADDRESS 0xd00075d9 BIT_MASK 0x1 /end MEASUREMENT
/begin MEASUREMENT Vbx_diag_ena_gas_pump_2_oc "Open Circuit of Additional Fuel Pump diagnosis information available" UBYTE _CNV_S_2_RANGE______3_CM 1 0. 0. 1. ECU_ADDRESS 0xd00075da BIT_MASK 0x1 /end MEASUREMENT
/begin MEASUREMENT Vbx_diag_ena_gas_pump_2_scg "Short circuit to ground of Additional Fuel Pump diagnosis information available" UBYTE _CNV_S_2_RANGE______3_CM 1 0. 0. 1. ECU_ADDRESS 0xd00075db BIT_MASK 0x1 /end MEASUREMENT
/begin MEASUREMENT Vbx_diag_ena_gas_pump_2_scw "Short Circuit to battery of Additional Fuel Pump diagnosis information available" UBYTE _CNV_S_2_RANGE______3_CM 1 0. 0. 1. ECU_ADDRESS 0xd00075dc BIT_MASK 0x1 /end MEASUREMENT
/begin MEASUREMENT Vbx_diag_ena_gas_pump_oc "Open circuit on gas pump diagnosis information available" UBYTE _CNV_S_2_RANGE______3_CM 1 0. 0. 1. ECU_ADDRESS 0xd0006217 BIT_MASK 0x1 /end MEASUREMENT
/begin MEASUREMENT Vbx_diag_ena_gas_pump_scg "Short circuit to ground on gas pump diagnosis information available" UBYTE _CNV_S_2_RANGE______3_CM 1 0. 0. 1. ECU_ADDRESS 0xd0006218 BIT_MASK 0x1 /end MEASUREMENT
/begin MEASUREMENT Vbx_diag_ena_gas_pump_scw "Short circuit to battery on gas pump diagnosis information available" UBYTE _CNV_S_2_RANGE______3_CM 1 0. 0. 1. ECU_ADDRESS 0xd0006219 BIT_MASK 0x1 /end MEASUREMENT
/begin MEASUREMENT cdn_diag_el_cps "Diagnosis condition for each symptom of CPS" UBYTE _CNV_A_R_ECME_LINEA_0_CM 1 0. 0. 7. ECU_ADDRESS 0xd0006543 FORMAT "%1.0" /end MEASUREMENT
/begin MEASUREMENT cdn_diag_elead_el "Diagnosis condition for each symptom of Additional fuel tank electrovalve diagnosis " UBYTE _CNV_A_R_ECME_LINEA_0_CM 1 0. 0. 7. ECU_ADDRESS 0xd00075e2 FORMAT "%1.0" /end MEASUREMENT
/begin MEASUREMENT cdn_diag_rly_fpmp_add_el "Diagnosis condition for each symptom of Additional Fuel Pump relay control electrical diagnosis Bit0:diagnosis condition for symptom SYM_0 Bit1:diagnosis condition for symptom SYM_1Bit2:diagnosis condition for symptom SYM_2" UBYTE _CNV_A_R_ECME_LINEA_0_CM 1 0. 0. 7. ECU_ADDRESS 0xd00075e3 FORMAT "%1.0" /end MEASUREMENT
/begin MEASUREMENT cdn_diag_rly_fpmp_el "Diagnosis condition for each symptom of fuel pump relay control electrical diagnosis" UBYTE _CNV_A_R_ECME_LINEA_0_CM 1 0. 0. 7. ECU_ADDRESS 0xd0006545 FORMAT "%1.0" /end MEASUREMENT
/begin MEASUREMENT ctr_err_elead_scp "Counter for SCP filtering" UBYTE _CNV_A_R_LINEAR_____201_CM 1 0. 0. 255. ECU_ADDRESS 0xd000621e FORMAT "%3.0" /end MEASUREMENT
/begin MEASUREMENT ctr_pulse_cps_dly "Time counter for pulse at key ON" UBYTE _CNV_A_R_LINEAR_____201_CM 1 0. 0. 255. ECU_ADDRESS 0xd0007749 FORMAT "%3.0" /end MEASUREMENT
/begin MEASUREMENT ctr_pulse_elead "Counter of pulse" UBYTE _CNV_A_R_LINEAR_____201_CM 1 0. 0. 255. ECU_ADDRESS 0xd000621f FORMAT "%3.0" /end MEASUREMENT
/begin MEASUREMENT elead_frq "Frequency of electrovalve command" UBYTE _CNV_A_R_LINEAR_____290_CM 1 0. 10. 255. ECU_ADDRESS 0xd0006220 FORMAT "%3.0" /end MEASUREMENT
/begin MEASUREMENT elead_frq_fil "Frequency of electrovalve command" UBYTE _CNV_A_R_LINEAR_____290_CM 1 0. 0. 255. ECU_ADDRESS 0xd00075e4 FORMAT "%3.0" /end MEASUREMENT
/begin MEASUREMENT eleadpwm "PWM command setpoint of additional fuel tank electrovalve" UBYTE _CNV_A_R_LINEAR_____165_CM 1 0. 0. 100. ECU_ADDRESS 0xd0006221 FORMAT "%12.8" /end MEASUREMENT
/begin MEASUREMENT err_diag_el_cps "Raw value of error symptom for CPS" UBYTE _CNV_S_16_RANGE_ERR__206_CM 1 0. 0. 15. ECU_ADDRESS 0xd0006544 /end MEASUREMENT
/begin MEASUREMENT err_diag_elead_el "Detected symptom for Additional fuel tank electrovalve diagnosis" UBYTE _CNV_S_16_RANGE_ERR__62_CM 1 0. 0. 15. ECU_ADDRESS 0xd00075e5 /end MEASUREMENT
/begin MEASUREMENT err_diag_rly_fpmp_add_el "Detected symptom for Additional Fuel Pump relay control diagnosis" UBYTE _CNV_S_16_RANGE_ERR__62_CM 1 0. 0. 15. ECU_ADDRESS 0xd00075e6 /end MEASUREMENT
/begin MEASUREMENT err_diag_rly_fpmp_el "Detected symptom for fuel pump relay control diagnosis" UBYTE _CNV_S_16_RANGE_ERR__206_CM 1 0. 0. 15. ECU_ADDRESS 0xd0006546 /end MEASUREMENT
/begin MEASUREMENT lv_aft_conf "Additional fuel tank is present or not" UBYTE _CNV_S_2_RANGE______3_CM 1 0. 0. 1. ECU_ADDRESS 0xd00075dd BIT_MASK 0x1 /end MEASUREMENT
/begin MEASUREMENT lv_diag_elead_scp_end "Boolean indication end of SCP detection strategy" UBYTE _CNV_S_2_RANGE______3_CM 1 0. 0. 1. ECU_ADDRESS 0xd00075de BIT_MASK 0x1 /end MEASUREMENT
/begin MEASUREMENT lv_efpump "Logical feedback of electrovalve discret stage" UBYTE _CNV_S_2_RANGE______3_CM 1 0. 0. 1. ECU_ADDRESS 0xd000621a BIT_MASK 0x1 /end MEASUREMENT
/begin MEASUREMENT lv_elead_off "Boolean indicating that electrovalve output is OFF" UBYTE _CNV_S_2_RANGE______3_CM 1 0. 0. 1. ECU_ADDRESS 0xd00075df BIT_MASK 0x1 /end MEASUREMENT
/begin MEASUREMENT lv_err_diag_elead_el_scp "detected SCP for additionnal fuel tank electrovalve diagnosis" UBYTE _CNV_S_2_RANGE______3_CM 1 0. 0. 1. ECU_ADDRESS 0xd000621b BIT_MASK 0x1 /end MEASUREMENT
/begin MEASUREMENT lv_ftl_add_low "Logical value indicating if level of fuel in additional tank is low" UBYTE _CNV_S_2_RANGE______3_CM 1 0. 0. 1. ECU_ADDRESS 0xd00075e0 BIT_MASK 0x1 /end MEASUREMENT
/begin MEASUREMENT lv_pulse_cps "Flag to indicate that the pulse at key on was done" UBYTE _CNV_S_2_RANGE______3_CM 1 0. 0. 1. ECU_ADDRESS 0xd0006542 BIT_MASK 0x1 /end MEASUREMENT
/begin MEASUREMENT lv_pulse_cps_tmp "Flag to indicate that pulse is working" UBYTE _CNV_S_2_RANGE______3_CM 1 0. 0. 1. ECU_ADDRESS 0xd000774b BIT_MASK 0x1 /end MEASUREMENT
/begin MEASUREMENT lv_pulse_elead_ack "Flag to indicate that the pulse is done" UBYTE _CNV_S_2_RANGE______3_CM 1 0. 0. 1. ECU_ADDRESS 0xd000621c BIT_MASK 0x1 /end MEASUREMENT
/begin MEASUREMENT lv_pulse_elead_end "Boolean indication end of pulse strategy" UBYTE _CNV_S_2_RANGE______3_CM 1 0. 0. 1. ECU_ADDRESS 0xd00075e1 BIT_MASK 0x1 /end MEASUREMENT
/begin MEASUREMENT lv_pulse_elead_req "Request for pulse generation at key-on " UBYTE _CNV_S_2_RANGE______3_CM 1 0. 0. 1. ECU_ADDRESS 0xd000621d BIT_MASK 0x1 /end MEASUREMENT
/begin MEASUREMENT lv_rly_fpmp_add "Additional Fuel Pump relay control" UBYTE _CNV_S_2_RANGE______3_CM 1 0. 0. 1. ECU_ADDRESS 0xd0006222 BIT_MASK 0x1 /end MEASUREMENT
/begin MEASUREMENT v_adc_pulse_elead "Raw signal acquisition during the pulse at key ON" UWORD _CNV_A_R_LINEAR_____69_CM 1 0. 0. 11.992722 ECU_ADDRESS 0xd0003c80 FORMAT "%9.7" /end MEASUREMENT
/begin MEASUREMENT v_diag_elead "Raw value for additional fuel tank electrovalve diagnosis" UWORD _CNV_A_R_LINEAR_____69_CM 1 0. 0. 11.992722 ECU_ADDRESS 0xd0004fb6 FORMAT "%9.7" /end MEASUREMENT
/begin MEASUREMENT vp_efpump "Raw signal voltage of electrovalve discret stage" UWORD _CNV_A_R_LINEAR_____69_CM 1 0. 0. 11.992722 ECU_ADDRESS 0xd000620c FORMAT "%9.7" /end MEASUREMENT
/begin CHARACTERISTIC Cxx_cp_frq_1 "Low frequency command for canister purge" VALUE 0xa0020720 _REC_S1VAL_20_u1 255. _CNV_A_R_LINEAR_____290_CM 0. 255. FORMAT "%3.0" /end CHARACTERISTIC
/begin CHARACTERISTIC Cxx_cp_frq_2 "High frequency command for canister purge" VALUE 0xa0020721 _REC_S1VAL_20_u1 255. _CNV_A_R_LINEAR_____290_CM 0. 255. FORMAT "%3.0" /end CHARACTERISTIC
/begin CHARACTERISTIC c_cppwm_diag_max_scg "Maximum threshold for SCG diagnosis window" VALUE 0xa0020b31 _REC_S1VAL_20_u1 99.609375 _CNV_A_R_LINEAR_____52_CM 0. 99.609375 FORMAT "%9.6" /end CHARACTERISTIC
/begin CHARACTERISTIC c_cppwm_diag_min_oc "Minimum threshold for OC diagnosis window" VALUE 0xa0020b32 _REC_S1VAL_20_u1 99.609375 _CNV_A_R_LINEAR_____52_CM 0. 99.609375 FORMAT "%9.6" /end CHARACTERISTIC
/begin CHARACTERISTIC c_cppwm_diag_min_scp "Minimum threshold for SCP diagnosis window" VALUE 0xa0020b33 _REC_S1VAL_20_u1 99.609375 _CNV_A_R_LINEAR_____52_CM 0. 99.609375 FORMAT "%9.6" /end CHARACTERISTIC
/begin CHARACTERISTIC c_ctr_pulse_cps_dly "Time value for pulse at key ON" VALUE 0xa0020b35 _REC_S1VAL_20_u1 255. _CNV_A_R_LINEAR_____201_CM 0. 255. FORMAT "%3.0" /end CHARACTERISTIC
/begin CHARACTERISTIC c_ctr_pulse_elead "Number of pulse requested for SCP diagnosis" VALUE 0xa0020722 _REC_S1VAL_20_u1 255. _CNV_A_R_ECME_LINEA_0_CM 0. 255. FORMAT "%3.0" /end CHARACTERISTIC
/begin CHARACTERISTIC c_diag_elead_el_off_0 "Threshold for diagnosis when the output is OFF" VALUE 0xa0020712 _REC_S1VAL_20_u2 11.992722 _CNV_A_R_LINEAR_____69_CM 0. 11.992722 FORMAT "%9.7" /end CHARACTERISTIC
/begin CHARACTERISTIC c_diag_elead_el_off_1 "Threshold for diagnosis when the output is OFF" VALUE 0xa0020714 _REC_S1VAL_20_u2 11.992722 _CNV_A_R_LINEAR_____69_CM 0. 11.992722 FORMAT "%9.7" /end CHARACTERISTIC
/begin CHARACTERISTIC c_diag_elead_el_off_2 "Threshold for diagnosis when the output is OFF" VALUE 0xa0020716 _REC_S1VAL_20_u2 11.992722 _CNV_A_R_LINEAR_____69_CM 0. 11.992722 FORMAT "%9.7" /end CHARACTERISTIC
/begin CHARACTERISTIC c_diag_elead_el_off_3 "Threshold for diagnosis when the output is OFF" VALUE 0xa0020718 _REC_S1VAL_20_u2 11.992722 _CNV_A_R_LINEAR_____69_CM 0. 11.992722 FORMAT "%9.7" /end CHARACTERISTIC
/begin CHARACTERISTIC c_diag_elead_el_off_4 "Threshold for diagnosis when the output is OFF" VALUE 0xa002071a _REC_S1VAL_20_u2 11.992722 _CNV_A_R_LINEAR_____69_CM 0. 11.992722 FORMAT "%9.7" /end CHARACTERISTIC
/begin CHARACTERISTIC c_diag_elead_el_off_5 "Threshold for diagnosis when the output is OFF" VALUE 0xa002071c _REC_S1VAL_20_u2 11.992722 _CNV_A_R_LINEAR_____69_CM 0. 11.992722 FORMAT "%9.7" /end CHARACTERISTIC
/begin CHARACTERISTIC c_diag_elead_el_on_0 "Threshold for diagnosis when the output is ON" VALUE 0xa002071e _REC_S1VAL_20_u2 11.992722 _CNV_A_R_LINEAR_____69_CM 0. 11.992722 FORMAT "%9.7" /end CHARACTERISTIC
/begin CHARACTERISTIC c_elead_frq_min "Additonal fuel tank electrovalve min (typical value 10Hz)" VALUE 0xa0020b3a _REC_S1VAL_20_u1 255. _CNV_A_R_LINEAR_____290_CM 0. 255. FORMAT "%3.0" /end CHARACTERISTIC
/begin CHARACTERISTIC c_max_err_elead_scp "Threshold for SCP diagnosis filtering" VALUE 0xa0020723 _REC_S1VAL_20_u1 255. _CNV_A_R_ECME_LINEA_0_CM 0. 255. FORMAT "%3.0" /end CHARACTERISTIC
/begin MEASUREMENT Vbx_eng_off_mdf1_mem "Mdf1 state saved from EEPROM" UBYTE _CNV_S_2_RANGE______3_CM 1 0. 0. 1. DISPLAY_IDENTIFIER ClCooCtl_NVM.Vbx_eng_off_mdf1_mem_NVM ECU_ADDRESS 0xd0007838 BIT_MASK 0x1 /end MEASUREMENT
/begin MEASUREMENT Vbx_eng_aut_fan "Engine in autonomous state" UBYTE _CNV_S_2_RANGE______3_CM 1 0. 0. 1. ECU_ADDRESS 0xd0007846 BIT_MASK 0x1 /end MEASUREMENT
/begin MEASUREMENT Vbx_eng_mdf1 "Fan 1 activation request from water temperature or engine management" UBYTE _CNV_S_2_RANGE______3_CM 1 0. 0. 1. ECU_ADDRESS 0xd0007847 BIT_MASK 0x1 /end MEASUREMENT
/begin MEASUREMENT Vbx_eng_mdf1_dly "Boolean to maintan the engine coolant ECU supply during watching for engine stop" UBYTE _CNV_S_2_RANGE______3_CM 1 0. 0. 1. ECU_ADDRESS 0xd0007848 BIT_MASK 0x1 /end MEASUREMENT
/begin MEASUREMENT Vbx_eng_mdf1_req "Fan 1 activation request from water temperature or engine management" UBYTE _CNV_S_2_RANGE______3_CM 1 0. 0. 1. ECU_ADDRESS 0xd0007849 BIT_MASK 0x1 /end MEASUREMENT
/begin MEASUREMENT Vbx_eng_mdf2 "Fan 2 activation request from water temperature or engine management" UBYTE _CNV_S_2_RANGE______3_CM 1 0. 0. 1. ECU_ADDRESS 0xd000784a BIT_MASK 0x1 /end MEASUREMENT
/begin MEASUREMENT Vbx_eng_mdf2_req "Fan 2 activation request from water temperature or engine management" UBYTE _CNV_S_2_RANGE______3_CM 1 0. 0. 1. ECU_ADDRESS 0xd000784b BIT_MASK 0x1 /end MEASUREMENT
/begin MEASUREMENT Vbx_eng_off_mdf1 "Fan 1 activation request (engine off)" UBYTE _CNV_S_2_RANGE______3_CM 1 0. 0. 1. ECU_ADDRESS 0xd000784c BIT_MASK 0x1 /end MEASUREMENT
/begin MEASUREMENT Vbx_mdf1 "Fan 1 activation request from water temperature or engine management" UBYTE _CNV_S_2_RANGE______3_CM 1 0. 0. 1. ECU_ADDRESS 0xd000784d BIT_MASK 0x1 /end MEASUREMENT
/begin MEASUREMENT Vbx_mdf2 "Fan 2 activation request from water temperature or engine management" UBYTE _CNV_S_2_RANGE______3_CM 1 0. 0. 1. ECU_ADDRESS 0xd000784e BIT_MASK 0x1 /end MEASUREMENT
/begin MEASUREMENT Vbx_mdf_pws "The engine coolant function wishes that the ECU remains supplied." UBYTE _CNV_S_2_RANGE______3_CM 1 0. 0. 1. ECU_ADDRESS 0xd000784f BIT_MASK 0x1 /end MEASUREMENT
/begin MEASUREMENT Vbx_tco_ac_dsb "Air conditioning deactivation request for engine thermal protection" UBYTE _CNV_S_2_RANGE______3_CM 1 0. 0. 1. ECU_ADDRESS 0xd0007850 BIT_MASK 0x1 /end MEASUREMENT
/begin CHARACTERISTIC Cbx_eng_stop_mdf_cho "Choice of fan 1 or 2 during PWL (true : fan 2)" VALUE 0xa00210d8 _REC_S1VAL_20_u1 1. _CNV_A_R_ECME_LINEA_0_CM 0. 1. FORMAT "%1.0" BIT_MASK 0x1 /end CHARACTERISTIC
/begin CHARACTERISTIC Cxx_ac_dsb_tco_thd "Offset on Cxx_mdf_1_cmd_ena_thd_tco for the Water Temp. threshold to disable the air conditioning system." VALUE 0xa00210aa _REC_S1VAL_20_u2 240. _CNV_A_R_LINEAR_____110_CM -40. 200. FORMAT "%5.1" /end CHARACTERISTIC
/begin CHARACTERISTIC Cxx_ac_dsb_tco_thd_h "Offset on Water Temp. to disable the air conditioning system on High Temp. regulation mode." VALUE 0xa00210ac _REC_S1VAL_20_u2 240. _CNV_A_R_LINEAR_____110_CM -40. 200. FORMAT "%5.1" /end CHARACTERISTIC
/begin CHARACTERISTIC Cxx_ac_ena_tco_thd "Offset on Cxx_mdf_1_cmd_ena_thd_tco to enable the air conditioning system." VALUE 0xa00210ae _REC_S1VAL_20_u2 240. _CNV_A_R_LINEAR_____110_CM -40. 200. FORMAT "%5.1" /end CHARACTERISTIC
/begin CHARACTERISTIC Cxx_ac_ena_tco_thd_h "Offset on Cxx_mdf_1_cmd_ena_thd_tco to enable the air conditioning system on High Temp. regulation mode." VALUE 0xa00210b0 _REC_S1VAL_20_u2 240. _CNV_A_R_LINEAR_____110_CM -40. 200. FORMAT "%5.1" /end CHARACTERISTIC
/begin CHARACTERISTIC Cxx_cmd_mdf_dly "Maximum duration of mdf1 activation (compromised between engine compartment cooling and electric balance)." VALUE 0xa00210b2 _REC_S1VAL_20_u2 65535. _CNV_A_R_LINEAR_____68_CM 0. 65535. FORMAT "%5.0" /end CHARACTERISTIC
/begin CHARACTERISTIC Cxx_mdf1_cmd_ena_thd_tco_h "Water temperature offset used to activate mdf1 on high temp mode." VALUE 0xa00210b4 _REC_S1VAL_20_u2 240. _CNV_A_R_LINEAR_____110_CM -40. 200. FORMAT "%5.1" /end CHARACTERISTIC
/begin CHARACTERISTIC Cxx_mdf1_off_tco_thd "Water temperature threshold used to desactivate mdf1 (engine stop)." VALUE 0xa00210b6 _REC_S1VAL_20_u2 240. _CNV_A_R_LINEAR_____110_CM -40. 200. FORMAT "%5.1" /end CHARACTERISTIC
/begin CHARACTERISTIC Cxx_mdf1_off_tco_thd_h "Water temperature offset used to deactivate mdf1 on high temp. mode (engine stop)." VALUE 0xa00210b8 _REC_S1VAL_20_u2 240. _CNV_A_R_LINEAR_____110_CM -40. 200. FORMAT "%5.1" /end CHARACTERISTIC
/begin CHARACTERISTIC Cxx_mdf1_on_tco_thd "Water temperature threshold used to activate mdf1 (engine stop)." VALUE 0xa00210ba _REC_S1VAL_20_u2 240. _CNV_A_R_LINEAR_____110_CM -40. 200. FORMAT "%5.1" /end CHARACTERISTIC
/begin CHARACTERISTIC Cxx_mdf1_on_tco_thd_h "Water temperature offset used to activate mdf1 on high temp mode (engine stop)." VALUE 0xa00210bc _REC_S1VAL_20_u2 240. _CNV_A_R_LINEAR_____110_CM -40. 200. FORMAT "%5.1" /end CHARACTERISTIC
/begin CHARACTERISTIC Cxx_mdf1_on_tco_thd_hys "Water temperature threshold used to maintain the power supply request (engine stop)." VALUE 0xa00210be _REC_S1VAL_20_u2 240. _CNV_A_R_LINEAR_____110_CM -40. 200. FORMAT "%5.1" /end CHARACTERISTIC
/begin CHARACTERISTIC Cxx_mdf1_on_tco_thd_hys_h "Water temperature offset used to maintain the power supply request on high temp mode (engine stop)." VALUE 0xa00210c0 _REC_S1VAL_20_u2 240. _CNV_A_R_LINEAR_____110_CM -40. 200. FORMAT "%5.1" /end CHARACTERISTIC
/begin CHARACTERISTIC Cxx_mdf2_off_tco_thd "Water temperature offset on Cxx_mdf_1_cmd_ena_thd_tco used to deactivate mdf2 (engine running)." VALUE 0xa00210c2 _REC_S1VAL_20_u2 240. _CNV_A_R_LINEAR_____110_CM -40. 200. FORMAT "%5.1" /end CHARACTERISTIC
/begin CHARACTERISTIC Cxx_mdf2_off_tco_thd_h "Water temperature offset used to deactivate mdf2 on high temp mode (engine running)." VALUE 0xa00210c4 _REC_S1VAL_20_u2 240. _CNV_A_R_LINEAR_____110_CM -40. 200. FORMAT "%5.1" /end CHARACTERISTIC
/begin CHARACTERISTIC Cxx_mdf2_on_tco_thd "Water temperature offset on Cxx_mdf_1_cmd_ena_thd_tco used to activate mdf2 (engine running)." VALUE 0xa00210c6 _REC_S1VAL_20_u2 240. _CNV_A_R_LINEAR_____110_CM -40. 200. FORMAT "%5.1" /end CHARACTERISTIC
/begin CHARACTERISTIC Cxx_mdf2_on_tco_thd_h "Water temperature offset used to activate mdf2 on high Temp. mode (engine running)." VALUE 0xa00210c8 _REC_S1VAL_20_u2 240. _CNV_A_R_LINEAR_____110_CM -40. 200. FORMAT "%5.1" /end CHARACTERISTIC
/begin CHARACTERISTIC Cxx_mdf_1_cmd_ena_thd_tco "Water temperature threshold used to activate mdf1 (engine running)" VALUE 0xa00210ca _REC_S1VAL_20_u2 240. _CNV_A_R_LINEAR_____110_CM -40. 200. FORMAT "%5.1" /end CHARACTERISTIC
/begin CHARACTERISTIC Cxx_mon_stop_tco_thd "Water Temperature threshold used to stop the power supply request." VALUE 0xa00210cc _REC_S1VAL_20_u2 240. _CNV_A_R_LINEAR_____110_CM -40. 200. FORMAT "%5.1" /end CHARACTERISTIC
/begin CHARACTERISTIC Cxx_mon_stop_tco_thd_h "Water Temperature threshold used to stop the power supply request on high temperature mode." VALUE 0xa00210ce _REC_S1VAL_20_u2 240. _CNV_A_R_LINEAR_____110_CM -40. 200. FORMAT "%5.1" /end CHARACTERISTIC
/begin CHARACTERISTIC Cxx_run_mdf1_off_tco_thd "Offset on Cxx_mdf_1_cmd_ena_thd_tco to deactivate mdf1 (engine running)." VALUE 0xa00210d0 _REC_S1VAL_20_u2 240. _CNV_A_R_LINEAR_____110_CM -40. 200. FORMAT "%5.1" /end CHARACTERISTIC
/begin CHARACTERISTIC Cxx_run_mdf1_off_tco_thd_h "Additive offset used to deactivate mdf1 on high temp. mode (engine running)." VALUE 0xa00210d2 _REC_S1VAL_20_u2 240. _CNV_A_R_LINEAR_____110_CM -40. 200. FORMAT "%5.1" /end CHARACTERISTIC
/begin CHARACTERISTIC Cxx_tco_fail_cmd_mdf_dly "Maximum duration of mdf1 activation (compromised between engine compartment cooling and electric balance)." VALUE 0xa00210d4 _REC_S1VAL_20_u2 65535. _CNV_A_R_LINEAR_____68_CM 0. 65535. FORMAT "%5.0" /end CHARACTERISTIC
/begin CHARACTERISTIC Cxx_tco_mdf_dly "Maximum duration of water temperature monitoring to activate mdf1 (compromised between engine compartment cooling and electric" VALUE 0xa00210d6 _REC_S1VAL_20_u2 65535. _CNV_A_R_LINEAR_____68_CM 0. 65535. FORMAT "%5.0" /end CHARACTERISTIC
/begin AXIS_PTS Ctb_n_ovt_tq "Overtorque map X breakpoint" 0xa0035b88 Vxx_n_mv _REC_A2AXS_20_u2 16383.75 _CNV_A_R_ENSD_LINEA_22_CM 9 0. 16383.75 FORMAT "%8.2" /end AXIS_PTS
/begin CHARACTERISTIC Cmp_ovt_tq "Overtorque calibration map" MAP 0xa0035b9c _REC_A1MAP_20_u2_u2_u1 2047.96875 _CNV_A_R_LINEAR_____181_CM 0. 2047.96875 FORMAT "%10.5"
 /begin AXIS_DESCR COM_AXIS Vxx_n_mv _CNV_A_R_ENSD_LINEA_22_CM 9 0. 16383.75 FORMAT "%8.2" AXIS_PTS_REF Ctb_n_ovt_tq /end AXIS_DESCR
 /begin AXIS_DESCR COM_AXIS Vxx_gear _CNV_A_R_LINEAR_____145_CM 8 -1. 6. READ_ONLY FORMAT "%2.0" AXIS_PTS_REF Ntb_gear /end AXIS_DESCR
/end CHARACTERISTIC
/begin CHARACTERISTIC Ctd_ovt_tq_t_max "Overtorque limitation in N.m.s, Time en Frequency" CURVE 0xa0035c2c _REC_A1CUR_20_u2_u1 2047.96875 _CNV_A_R_LINEAR_____291_CM 0. 2047.96875 FORMAT "%10.5"
 /begin AXIS_DESCR COM_AXIS Vxx_gear _CNV_A_R_LINEAR_____145_CM 8 -1. 6. READ_ONLY FORMAT "%2.0" AXIS_PTS_REF Ntb_gear /end AXIS_DESCR
/end CHARACTERISTIC
/begin CHARACTERISTIC Ctp_ovt_lim_amp "Atmospheric pressure limitation map" CURVE 0xa0021f1c _REC_A1CUR_20_u1_u2 1. _CNV_A_R_LINEAR_____42_CM 0. 1. FORMAT "%9.7"
 /begin AXIS_DESCR COM_AXIS Vxx_amp _CNV_A_R_LINEAR_____115_CM 6 0. 20000. FORMAT "%5.0" AXIS_PTS_REF Ctb_eng_amp /end AXIS_DESCR
/end CHARACTERISTIC
/begin CHARACTERISTIC Ctp_ovt_lim_mat "Manifold air temperature limitation map" CURVE 0xa0021f22 _REC_A1CUR_20_u1_u2 1. _CNV_A_R_LINEAR_____42_CM 0. 1. FORMAT "%9.7"
 /begin AXIS_DESCR COM_AXIS Vxx_up_it_temp _CNV_A_R_LINEAR_____110_CM 6 -40. 200. FORMAT "%5.1" AXIS_PTS_REF Ctb_ovh_up_it_temp /end AXIS_DESCR
/end CHARACTERISTIC
/begin CHARACTERISTIC Ctp_ovt_lim_tco "Engine coolant temperature limitation map" CURVE 0xa0021f28 _REC_A1CUR_20_u1_u2 1. _CNV_A_R_LINEAR_____42_CM 0. 1. FORMAT "%9.7"
 /begin AXIS_DESCR COM_AXIS Vxx_tco _CNV_A_R_LINEAR_____110_CM 6 -40. 200. FORMAT "%5.1" AXIS_PTS_REF Ctb_ovh_tco /end AXIS_DESCR
/end CHARACTERISTIC
/begin CHARACTERISTIC Ctp_ovt_lim_toil "Oil temperature limitation map" CURVE 0xa0021f2e _REC_A1CUR_20_u1_u2 1. _CNV_A_R_LINEAR_____42_CM 0. 1. FORMAT "%9.7"
 /begin AXIS_DESCR COM_AXIS Vxx_toil _CNV_A_R_LINEAR_____110_CM 6 -40. 200. FORMAT "%5.1" AXIS_PTS_REF Ctb_ovh_toil /end AXIS_DESCR
/end CHARACTERISTIC
/begin MEASUREMENT Vbx_ovt_ena "Set if the overtorque is active" UBYTE _CNV_S_2_RANGE______3_CM 1 0. 0. 1. ECU_ADDRESS 0xd000716b BIT_MASK 0x1 /end MEASUREMENT
/begin MEASUREMENT Vxx_ovt_egy_fac "Factor of the frequency limitation and the time limitation of overtorque potential" UWORD _CNV_A_R_LINEAR_____183_CM 1 0. 0. 1. ECU_ADDRESS 0xd0004a20 FORMAT "%11.9" /end MEASUREMENT
/begin MEASUREMENT Vxx_ovt_fac_dly "Factor of the frequency limitation and the time limitation of overtorque potential with one step of delay" UWORD _CNV_A_R_LINEAR_____183_CM 1 0. 0. 1. ECU_ADDRESS 0xd0004a22 FORMAT "%11.9" /end MEASUREMENT
/begin MEASUREMENT Vxx_ovt_fac_lim "Physical limitation factor" UBYTE _CNV_A_R_LINEAR_____42_CM 1 0. 0. 1. ECU_ADDRESS 0xd0004a2a FORMAT "%9.7" /end MEASUREMENT
/begin MEASUREMENT Vxx_ovt_tq_appl "Offset of overtorque after diagnosis block applied to the torq structure" UWORD _CNV_A_R_LINEAR_____181_CM 1 0. 0. 2047.96875 ECU_ADDRESS 0xd0004a24 FORMAT "%10.5" /end MEASUREMENT
/begin MEASUREMENT Vxx_ovt_tq_ofs_raw "Overtorque offset in fonction of the engine speed and the gear engaged" UWORD _CNV_A_R_LINEAR_____181_CM 1 0. 0. 2047.96875 ECU_ADDRESS 0xd0004a26 FORMAT "%10.5" /end MEASUREMENT
/begin MEASUREMENT Vxx_ovt_tq_raw "Overtorque offset with limitation factors" UWORD _CNV_A_R_LINEAR_____181_CM 1 0. 0. 2047.96875 ECU_ADDRESS 0xd0004a28 FORMAT "%10.5" /end MEASUREMENT
/begin CHARACTERISTIC Cxx_ovt_inc_neg "Coefficient to decrease the overtorque limitation factor" VALUE 0xa0021f34 _REC_S1VAL_20_u2 254.99609375 _CNV_A_R_LINEAR_____29_CM 1. 255.99609375 FORMAT "%12.8" /end CHARACTERISTIC
/begin CHARACTERISTIC Cxx_ovt_n_thd "Threshold of engine speed to cut the overtorque in the end of overtorque zone." VALUE 0xa0021f36 _REC_S1VAL_20_u2 16383.75 _CNV_A_R_ENSD_LINEA_22_CM 0. 16383.75 FORMAT "%8.2" /end CHARACTERISTIC
/begin CHARACTERISTIC Cxx_ovt_neg_fac "Recovery torque of the frequency integrator when the OVT is switched off." VALUE 0xa0021f38 _REC_S1VAL_20_s2 2047.96875 _CNV_A_R_LINEAR_____181_CM -1024. 1023.96875 FORMAT "%11.5" /end CHARACTERISTIC
/begin CHARACTERISTIC Cxx_ovt_ovn_ofs "engine speed threshold to cut the overtorque in the overspeed zone, in fonction of maximun engine speed" VALUE 0xa0021f3a _REC_S1VAL_20_u2 16383.75 _CNV_A_R_ENSD_LINEA_22_CM 0. 16383.75 FORMAT "%8.2" /end CHARACTERISTIC
/begin CHARACTERISTIC Cxx_ovt_tq_dly_max "Time limitation for the certification" VALUE 0xa0021f42 _REC_S1VAL_20_u1 255. _CNV_A_R_LINEAR_____68_CM 0. 255. FORMAT "%3.0" /end CHARACTERISTIC
/begin CHARACTERISTIC Cxx_ovt_tq_fac_thd "Minimum factor to enable the overtorque" VALUE 0xa0021f3c _REC_S1VAL_20_u2 1. _CNV_A_R_LINEAR_____183_CM 0. 1. FORMAT "%11.9" /end CHARACTERISTIC
/begin CHARACTERISTIC Cxx_ovt_tq_max "Maximal value of over-torque" VALUE 0xa0021f3e _REC_S1VAL_20_u2 2047.96875 _CNV_A_R_LINEAR_____181_CM 0. 2047.96875 FORMAT "%10.5" /end CHARACTERISTIC
/begin CHARACTERISTIC Cxx_ovt_tq_ofs_thd "Minimum offset to activate the overtorque" VALUE 0xa0021f40 _REC_S1VAL_20_u2 2047.96875 _CNV_A_R_LINEAR_____181_CM 0. 2047.96875 FORMAT "%10.5" /end CHARACTERISTIC
/begin CHARACTERISTIC Cxx_ovt_tq_slop_neg "Value of the negative gradient of overtorque in case of overtorque inhibiton" VALUE 0xa0021f43 _REC_S1VAL_20_u1 255. _CNV_A_R_LINEAR_____292_CM -255. 0. FORMAT "%4.0" /end CHARACTERISTIC
/begin CHARACTERISTIC Cxx_ovt_tq_slop_pos "Value of the positive gradient of overtorque in case of overtorque inhibiton" VALUE 0xa0021f44 _REC_S1VAL_20_u1 255. _CNV_A_R_LINEAR_____293_CM 0. 255. FORMAT "%3.0" /end CHARACTERISTIC
/begin AXIS_PTS Ctb_ovt_fuel_typ_rat "Flex fuel ratio breakpoints map" 0xa0035b78 Vxx_tq_max_fuel_typ_rat _REC_A2AXS_20_u2 1. _CNV_A_R_LINEAR_____161_CM 6 0. 1. FORMAT "%9.7" /end AXIS_PTS
/begin CHARACTERISTIC Ctp_ovt_lim_fuel_typ_rat "Flex fuel limitation map" CURVE 0xa0021f16 _REC_A1CUR_20_u1_u2 1. _CNV_A_R_LINEAR_____42_CM 0. 1. FORMAT "%9.7"
 /begin AXIS_DESCR COM_AXIS Vxx_tq_max_fuel_typ_rat _CNV_A_R_LINEAR_____161_CM 6 0. 1. FORMAT "%9.7" AXIS_PTS_REF Ctb_ovt_fuel_typ_rat /end AXIS_DESCR
/end CHARACTERISTIC
/begin MEASUREMENT Vxx_ovt_fuel_typ_fac "Flex fuel limitation for overtorque" UBYTE _CNV_A_R_LINEAR_____42_CM 1 0. 0. 1. ECU_ADDRESS 0xd0007166 FORMAT "%9.7" /end MEASUREMENT
/begin MEASUREMENT Vsx_eng_tql_vld "Engine torque losses validity status" UBYTE _CNV_S_2_STATUS_OK__269_CM 1 0. 0. 1. ECU_ADDRESS 0xd0007139 /end MEASUREMENT
/begin MEASUREMENT Vxx_aux_tql_sp "Torque losses due to accessories" UWORD _CNV_A_R_LINEAR_____181_CM 1 0. 0. 2047.96875 ECU_ADDRESS 0xd000496c FORMAT "%10.5" /end MEASUREMENT
/begin MEASUREMENT Vxx_eng_tql "Engine torque losses" UWORD _CNV_A_R_LINEAR_____181_CM 1 0. 0. 2047.96875 ECU_ADDRESS 0xd000496e FORMAT "%10.5" /end MEASUREMENT
/begin MEASUREMENT Vxx_is_tql "engine torque losses for idle" UWORD _CNV_A_R_LINEAR_____181_CM 1 0. 0. 2047.96875 ECU_ADDRESS 0xd0004970 FORMAT "%10.5" /end MEASUREMENT
/begin CHARACTERISTIC Cbx_is_ad_eng_tql_cmf "add adaptive idle speed torques on engine torque losses or on minimum torque" VALUE 0xa0021eae _REC_S1VAL_20_u1 1. _CNV_S_2_RANGE______3_CM 0. 1. /end CHARACTERISTIC
/begin CHARACTERISTIC Cxx_pwst_off_is_cor_dly "Inhibition time of the torque losses from power steering" VALUE 0xa0021eaa _REC_S1VAL_20_u2 655.35 _CNV_A_R_LINEAR_____32_CM 0. 655.35 FORMAT "%6.2" /end CHARACTERISTIC
/begin CHARACTERISTIC Cxx_pwst_prs_tql "Torque loss from power steering" VALUE 0xa0021eac _REC_S1VAL_20_u2 2047.96875 _CNV_A_R_LINEAR_____181_CM 0. 2047.96875 FORMAT "%10.5" /end CHARACTERISTIC
/begin CHARACTERISTIC Cmp_tql_eng_frn "Engine rubbing torque losses map dependent on engine speed and temperature" MAP 0xa0034f70 _REC_A1MAP_20_u2_u2_u2 2047.96875 _CNV_A_R_LINEAR_____181_CM 0. 2047.96875 FORMAT "%10.5"
 /begin AXIS_DESCR COM_AXIS Vxx_n _CNV_A_R_ENSD_LINEA_22_CM 20 0. 16383.75 FORMAT "%8.2" AXIS_PTS_REF Ctb_n /end AXIS_DESCR
 /begin AXIS_DESCR COM_AXIS Vxx_tco _CNV_A_R_LINEAR_____110_CM 16 -40. 200. FORMAT "%5.1" AXIS_PTS_REF Ctb_tco /end AXIS_DESCR
/end CHARACTERISTIC
/begin MEASUREMENT Vsx_tql_eng_frn_vld "Engine rubbing torque losses validity status" UBYTE _CNV_S_2_STATUS_OK__269_CM 1 0. 0. 1. ECU_ADDRESS 0xd0007140 /end MEASUREMENT
/begin MEASUREMENT Vxx_tql_eng_frn "Engine rubbing torque losses" UWORD _CNV_A_R_LINEAR_____181_CM 1 0. 0. 2047.96875 ECU_ADDRESS 0xd0004974 FORMAT "%10.5" /end MEASUREMENT
/begin CHARACTERISTIC Cbx_tql_temp_cfm "Choice of water or oil temperature permited, according with technical engine definition" VALUE 0xa0021eb7 _REC_S1VAL_20_u1 1. _CNV_S_2_RANGE______3_CM 0. 1. /end CHARACTERISTIC
/begin AXIS_PTS Ctb_ptq_dp_form_fac "Difference pressure axis for form factor map." 0xa0034f4c Vxx_dp_fil _REC_A2AXS_20_u2 20000. _CNV_A_R_LINEAR_____158_CM 10 -10000. 10000. FORMAT "%6.0" /end AXIS_PTS
/begin CHARACTERISTIC Ctp_ptq_dp_form_fac "Curve of form factor for pumping torque calculation. Value is signed,so it can be + or - with losse" CURVE 0xa0034f64 _REC_A1CUR_20_u1_u2 9.9609375 _CNV_A_R_LINEAR_____294_CM 0. 9.9609375 FORMAT "%9.7"
 /begin AXIS_DESCR COM_AXIS Vxx_dp_fil _CNV_A_R_LINEAR_____158_CM 10 -10000. 10000. FORMAT "%6.0" AXIS_PTS_REF Ctb_ptq_dp_form_fac /end AXIS_DESCR
/end CHARACTERISTIC
/begin MEASUREMENT Vsx_ptq_vld "Pumping torque validity status" UBYTE _CNV_S_2_STATUS_OK__269_CM 1 0. 0. 1. ECU_ADDRESS 0xd000713b /end MEASUREMENT
/begin MEASUREMENT Vxx_dp "Difference pressure between inlet manifold and in front of the turbine" SWORD _CNV_A_R_LINEAR_____115_CM 1 0. -10000. 10000. ECU_ADDRESS 0xd000607c FORMAT "%6.0" /end MEASUREMENT
/begin MEASUREMENT Vxx_dp_fil "Filtered difference pressure (between inlet manifold and in front of the turbine)" SWORD _CNV_A_R_LINEAR_____115_CM 1 0. -10000. 10000. ECU_ADDRESS 0xd000607e FORMAT "%6.0" /end MEASUREMENT
/begin MEASUREMENT Vxx_ptq "Value of the pumping torque" SWORD _CNV_A_R_LINEAR_____181_CM 1 0. -1024. 1023.96875 ECU_ADDRESS 0xd0004972 FORMAT "%11.5" /end MEASUREMENT
/begin CHARACTERISTIC Cbx_ptq_ex_prs_mdl_ok_cfm "Exhaust manifold pressure model is considered sufficient to estimate pumping torque if the sensor is failing" VALUE 0xa0021eb6 _REC_S1VAL_20_u1 1. _CNV_S_2_RANGE______3_CM 0. 1. /end CHARACTERISTIC
/begin CHARACTERISTIC Cxx_ptq_ftc "Time constant of difference pressure filtering curve" VALUE 0xa0021eb0 _REC_S1VAL_20_u2 655.35 _CNV_A_R_LINEAR_____32_CM 0. 655.35 FORMAT "%6.2" /end CHARACTERISTIC
/begin CHARACTERISTIC Cxx_ptq_max "Max value of the pumping torque" VALUE 0xa0021eb2 _REC_S1VAL_20_s2 2047.96875 _CNV_A_R_LINEAR_____181_CM -1024. 1023.96875 FORMAT "%11.5" /end CHARACTERISTIC
/begin CHARACTERISTIC Cxx_ptq_min "Minimum value of the pumping torque" VALUE 0xa0021eb4 _REC_S1VAL_20_s2 2047.96875 _CNV_A_R_LINEAR_____181_CM -1024. 1023.96875 FORMAT "%11.5" /end CHARACTERISTIC
/begin MEASUREMENT Vbx_df_wpmp_tcr_blk "Unable to move the component to the commanded position of turbo water pump detected failure" UBYTE _CNV_S_2_RANGE______3_CM 1 0. 0. 1. ECU_ADDRESS 0xd000658d BIT_MASK 0x1 /end MEASUREMENT
/begin MEASUREMENT Vbx_df_wpmp_tcr_oc "Circuit Open of turbo water pump detected failure" UBYTE _CNV_S_2_RANGE______3_CM 1 0. 0. 1. ECU_ADDRESS 0xd000658a BIT_MASK 0x1 /end MEASUREMENT
/begin MEASUREMENT Vbx_df_wpmp_tcr_scg "Circuit Short to Ground of turbo water pump detected failure" UBYTE _CNV_S_2_RANGE______3_CM 1 0. 0. 1. ECU_ADDRESS 0xd000658b BIT_MASK 0x1 /end MEASUREMENT
/begin MEASUREMENT Vbx_df_wpmp_tcr_scw "Circuit Short to Battery of turbo water pump detected failure" UBYTE _CNV_S_2_RANGE______3_CM 1 0. 0. 1. ECU_ADDRESS 0xd000658c BIT_MASK 0x1 /end MEASUREMENT
/begin MEASUREMENT Vbx_diag_ena_wpmp_tcr_blk "Unable to move the component to the commanded position of turbo water pump diagnosis authorization" UBYTE _CNV_S_2_RANGE______3_CM 1 0. 0. 1. ECU_ADDRESS 0xd0006591 BIT_MASK 0x1 /end MEASUREMENT
/begin MEASUREMENT Vbx_diag_ena_wpmp_tcr_oc "Circuit Open of turbo water pump diagnosis authorization" UBYTE _CNV_S_2_RANGE______3_CM 1 0. 0. 1. ECU_ADDRESS 0xd000658e BIT_MASK 0x1 /end MEASUREMENT
/begin MEASUREMENT Vbx_diag_ena_wpmp_tcr_scg "Circuit Short to Ground of turbo water pump diagnosis authorization" UBYTE _CNV_S_2_RANGE______3_CM 1 0. 0. 1. ECU_ADDRESS 0xd000658f BIT_MASK 0x1 /end MEASUREMENT
/begin MEASUREMENT Vbx_diag_ena_wpmp_tcr_scw "Circuit Short to Battery of turbo water pump diagnosis authorization" UBYTE _CNV_S_2_RANGE______3_CM 1 0. 0. 1. ECU_ADDRESS 0xd0006590 BIT_MASK 0x1 /end MEASUREMENT
/begin MEASUREMENT cdn_diag_oil_heat_el "Diagnosis condition for each symptom of upstream heater diagnosis OBD I" UBYTE _CNV_A_R_ECME_LINEA_0_CM 1 0. 0. 7. ECU_ADDRESS 0xd0006594 FORMAT "%1.0" /end MEASUREMENT
/begin MEASUREMENT cdn_diag_wpmp_el "Diagnosis condition for each symptom of water pump control electrical diagnosis" UBYTE _CNV_A_R_ECME_LINEA_0_CM 1 0. 0. 15. ECU_ADDRESS 0xd0006592 FORMAT "%2.0" /end MEASUREMENT
/begin MEASUREMENT ctr_swi_on "Counter of recurrence" UBYTE _CNV_A_R_ECME_LINEA_0_CM 1 0. 0. 255. ECU_ADDRESS 0xd0007782 FORMAT "%3.0" /end MEASUREMENT
/begin MEASUREMENT err_diag_oil_heat_el "Raw value of error symptom for upstream heater diagnosis OBD I" UBYTE _CNV_S_16_RANGE_ERR__206_CM 1 0. 0. 15. ECU_ADDRESS 0xd0006595 /end MEASUREMENT
/begin MEASUREMENT err_diag_wpmp_el "Detected symptom for water pump control diagnosis" UBYTE _CNV_S_16_RANGE_ERR__206_CM 1 0. 0. 15. ECU_ADDRESS 0xd0006593 /end MEASUREMENT
/begin MEASUREMENT lv_end_pump_stuck "Flag to indicate end of calculation of pump stuck detection" UBYTE _CNV_S_2_RANGE______3_CM 1 0. 0. 1. ECU_ADDRESS 0xd000778b BIT_MASK 0x1 /end MEASUREMENT
/begin MEASUREMENT lv_err_wpmp_el_scp "Short Cut to Plus confirmed failure on Water Pump" UBYTE _CNV_S_2_RANGE______3_CM 1 0. 0. 1. ECU_ADDRESS 0xd0006588 BIT_MASK 0x1 /end MEASUREMENT
/begin MEASUREMENT lv_pulse_ack "Flag to indicate that pulse acquisition is done" UBYTE _CNV_S_2_RANGE______3_CM 1 0. 0. 1. ECU_ADDRESS 0xd0007787 BIT_MASK 0x1 /end MEASUREMENT
/begin MEASUREMENT lv_pulse_req "Request for pulse generation at key ON" UBYTE _CNV_S_2_RANGE______3_CM 1 0. 0. 1. ECU_ADDRESS 0xd0007788 BIT_MASK 0x1 /end MEASUREMENT
/begin MEASUREMENT lv_sta_mem_wpmp "Memorization of water pump state" UBYTE _CNV_S_2_RANGE______3_CM 1 0. 0. 1. ECU_ADDRESS 0xd0007786 BIT_MASK 0x1 /end MEASUREMENT
/begin MEASUREMENT lv_start_pump_stuck "flag to indicate key transition ON to OFF" UBYTE _CNV_S_2_RANGE______3_CM 1 0. 0. 1. ECU_ADDRESS 0xd0007789 BIT_MASK 0x1 /end MEASUREMENT
/begin MEASUREMENT lv_wpmp_on "Flag indicating water pump state" UBYTE _CNV_S_2_RANGE______3_CM 1 0. 0. 1. ECU_ADDRESS 0xd0006589 BIT_MASK 0x1 /end MEASUREMENT
/begin MEASUREMENT lv_wpmp_position "Water Pump control command state (0H = pump shall be OFF, 1H = pump shall be ON)" UBYTE _CNV_S_2_RANGE______3_CM 1 0. 0. 1. ECU_ADDRESS 0xd0006587 BIT_MASK 0x1 /end MEASUREMENT
/begin MEASUREMENT lv_wpmp_swi_on "Flag to indicate that water pump is on since c_wpmp_swi_on recurrence" UBYTE _CNV_S_2_RANGE______3_CM 1 0. 0. 1. ECU_ADDRESS 0xd000778c BIT_MASK 0x1 /end MEASUREMENT
/begin MEASUREMENT lv_wtpump "logical feedback of water pump discret stage" UBYTE _CNV_S_2_RANGE______3_CM 1 0. 0. 1. ECU_ADDRESS 0xd000778a BIT_MASK 0x1 /end MEASUREMENT
/begin MEASUREMENT v_adc_pulse "Raw signal acquisition during the pulse at key ON" UWORD _CNV_A_R_LINEAR_____69_CM 1 0. 0. 11.992722 ECU_ADDRESS 0xd0004f3a FORMAT "%9.7" /end MEASUREMENT
/begin MEASUREMENT v_diag_stu_mv_1 "Mean of 18 acquisition of v_diag_wpmp (used for pump stuck diagnosis)" UWORD _CNV_A_R_LINEAR_____69_CM 1 0. 0. 11.992722 ECU_ADDRESS 0xd0004f3e FORMAT "%9.7" /end MEASUREMENT
/begin MEASUREMENT v_diag_stu_mv_2 "Mean of 20 acquisition of v_diag_wpmp (used for pump stuck diagnosis)" UWORD _CNV_A_R_LINEAR_____69_CM 1 0. 0. 11.992722 ECU_ADDRESS 0xd0004f40 FORMAT "%9.7" /end MEASUREMENT
/begin MEASUREMENT v_diag_wpmp "Raw value for water pump control diagnosis" UWORD _CNV_A_R_LINEAR_____69_CM 1 0. 0. 11.992722 ECU_ADDRESS 0xd0004f3c FORMAT "%9.7" /end MEASUREMENT
/begin MEASUREMENT vp_wtpump "raw signal voltage of water pump discret stage" UWORD _CNV_A_R_LINEAR_____69_CM 1 0. 0. 11.992722 ECU_ADDRESS 0xd0004f42 FORMAT "%9.7" /end MEASUREMENT
/begin CHARACTERISTIC c_diag_wpmp "Hardware threshold for diagnosis of pump stuck symptom" VALUE 0xa0020b39 _REC_S1VAL_20_u1 1. _CNV_A_R_LINEAR_____123_CM 0. 1. FORMAT "%4.2" /end CHARACTERISTIC
/begin CHARACTERISTIC c_wpmp_swi_on "Number of recurrence since water pump is switched ON" VALUE 0xa0020b4b _REC_S1VAL_20_u1 255. _CNV_A_R_ECME_LINEA_0_CM 0. 255. FORMAT "%3.0" /end CHARACTERISTIC
/begin AXIS_PTS Ctp_iga_dif "advance degradation with regard to the optimal advance" 0xa0035c3c NO_INPUT_QUANTITY _REC_A2AXS_20_u1 95.625 _CNV_A_R_LINEAR_____23_CM 33 0. 95.625 /end AXIS_PTS
/begin AXIS_PTS Ctp_iga_dif_sq "square of advance degradation" 0xa0035c60 NO_INPUT_QUANTITY _REC_A2AXS_20_u2 9215.859375 _CNV_A_R_LINEAR_____295_CM 33 0. 9215.859375 FORMAT "%11.6" /end AXIS_PTS
/begin MEASUREMENT Vxx_iga "final ignition advance calculated by torque structure" UBYTE _CNV_A_R_IGRE_LINEA_47_CM 1 0. -23.625 72. ECU_ADDRESS 0xd00071a1 FORMAT "%7.3" /end MEASUREMENT
/begin MEASUREMENT Vxx_raw_iga "final ignition advance calculated by torque structure without limitations" UBYTE _CNV_A_R_IGRE_LINEA_47_CM 1 0. -23.625 72. ECU_ADDRESS 0xd00071a2 FORMAT "%7.3" /end MEASUREMENT
/begin MEASUREMENT Vxx_iga_efy "Final efficiency calculated by torque structure" UWORD _CNV_A_R_LINEAR_____183_CM 1 0. 0. 1. ECU_ADDRESS 0xd0004ac4 FORMAT "%11.9" /end MEASUREMENT
/begin MEASUREMENT Vxx_raw_iga_efy "Raw efficiency calculated by torque structure" UWORD _CNV_A_R_LINEAR_____183_CM 1 0. 0. 1. ECU_ADDRESS 0xd0004ac6 FORMAT "%11.9" /end MEASUREMENT
/begin MEASUREMENT Vxx_appl_iga_efy "torque efficiency corresponding to applied advance" UWORD _CNV_A_R_LINEAR_____183_CM 1 0. 0. 1. ECU_ADDRESS 0xd0004ab4 FORMAT "%11.9" /end MEASUREMENT
/begin MEASUREMENT Vxx_appl_iga_efy_2 "torque efficiency corresponding to applied advance" UWORD _CNV_A_R_LINEAR_____183_CM 1 0. 0. 1. ECU_ADDRESS 0xd0004ab6 FORMAT "%11.9" /end MEASUREMENT
/begin MEASUREMENT Vxx_esti_tqe "Estimated effective engine torque" UWORD _CNV_A_R_LINEAR_____216_CM 1 0. -400. 1647.96875 ECU_ADDRESS 0xd0004ab8 FORMAT "%10.5" /end MEASUREMENT
/begin MEASUREMENT Vxx_esti_tqe_tgt "Estimated target effective engine torque (at maximum advance)" UWORD _CNV_A_R_LINEAR_____216_CM 1 0. -400. 1647.96875 ECU_ADDRESS 0xd0004aba FORMAT "%10.5" /end MEASUREMENT
/begin MEASUREMENT Vxx_esti_tqi "Estimated indicate engine torque" UWORD _CNV_A_R_LINEAR_____181_CM 1 0. 0. 2047.96875 ECU_ADDRESS 0xd0004abc FORMAT "%10.5" /end MEASUREMENT
/begin MEASUREMENT Vbx_is_maf_efy_ena "manifolf dynamic compensation activation flag functino of idle speed state" UBYTE _CNV_S_2_RANGE______3_CM 1 0. 0. 1. ECU_ADDRESS 0xd000717a BIT_MASK 0x1 /end MEASUREMENT
/begin MEASUREMENT Vbx_l_maf_coup_cdn "open coupler state or transient intersystem request" UBYTE _CNV_S_2_RANGE______3_CM 1 0. 0. 1. ECU_ADDRESS 0xd000717b BIT_MASK 0x1 /end MEASUREMENT
/begin MEASUREMENT Vxx_cdytq_air_dly_t "pure delay between the air intake and the supply of torque" UBYTE _CNV_A_R_LINEAR_____32_CM 1 0. 0. 2.55 ECU_ADDRESS 0xd000717c FORMAT "%4.2" /end MEASUREMENT
/begin MEASUREMENT Vxx_eng_maf_efy_cor "torque efficiency correction to commpensate the fact that the target torque request (or manifold flow) cannot be realized" UWORD _CNV_A_R_LINEAR_____183_CM 1 0. 0. 4. ECU_ADDRESS 0xd0004a54 FORMAT "%11.9" /end MEASUREMENT
/begin MEASUREMENT Vxx_h_maf_efy_thd "high threshold for manifold dynamic compensation efficiency" UWORD _CNV_A_R_LINEAR_____183_CM 1 0. 0. 4. ECU_ADDRESS 0xd0004a56 FORMAT "%11.9" /end MEASUREMENT
/begin MEASUREMENT Vxx_l_maf_efy_thd "low threshold for manifold dynamic compensation efficiency" UWORD _CNV_A_R_LINEAR_____183_CM 1 0. 0. 4. ECU_ADDRESS 0xd0004a58 FORMAT "%11.9" /end MEASUREMENT
/begin MEASUREMENT Vxx_maf_cyl_mdl "Modeled mass air flow pumped into cylinder" UWORD _CNV_A_R_LINEAR_____172_CM 1 0. 0. 3000. ECU_ADDRESS 0xd0004a5a FORMAT "%7.2" /end MEASUREMENT
/begin MEASUREMENT Vxx_maf_efy_cor "Torque efficiency correction to compensate the fact that the target torque request (or manifold flow) cannot be realized" UWORD _CNV_A_R_LINEAR_____183_CM 1 0. 0. 4. ECU_ADDRESS 0xd0004a5c FORMAT "%11.9" /end MEASUREMENT
/begin MEASUREMENT Vxx_maf_efy_ena_fac "factor to enable the compensation of manifold dynamic" UWORD _CNV_A_R_LINEAR_____183_CM 1 0. 0. 1. ECU_ADDRESS 0xd0004a5e FORMAT "%11.9" /end MEASUREMENT
/begin MEASUREMENT Vxx_maf_eng_mdl "Modeled mass air flow (manifold)" UWORD _CNV_A_R_LINEAR_____172_CM 1 0. 0. 3000. ECU_ADDRESS 0xd0004a60 FORMAT "%7.2" /end MEASUREMENT
/begin MEASUREMENT Vxx_maf_it_mdl "Modeled air flow (throttle)" UWORD _CNV_A_R_LINEAR_____172_CM 1 0. 0. 3000. ECU_ADDRESS 0xd0004a62 FORMAT "%7.2" /end MEASUREMENT
/begin MEASUREMENT Vxx_map_eng_mdl "modeled manifold pressure" UWORD _CNV_A_R_LINEAR_____115_CM 1 0. 0. 20000. ECU_ADDRESS 0xd0004a64 FORMAT "%5.0" /end MEASUREMENT
/begin MEASUREMENT Vxx_prs_rat_mdl "Filtered pressure rate Pmanifold/Pup_throttle" UWORD _CNV_A_R_LINEAR_____7_CM 1 0. 0. 0.9999847412109381 ECU_ADDRESS 0xd0004a66 FORMAT "%7.5" /end MEASUREMENT
/begin MEASUREMENT Vxx_raw_maf_cyl_mdl "Modeled mass air flow pumped into cylinder" UWORD _CNV_A_R_LINEAR_____172_CM 1 0. 0. 3000. ECU_ADDRESS 0xd0004a68 FORMAT "%7.2" /end MEASUREMENT
/begin MEASUREMENT Vxx_raw_maf_efy_cor "Raw torque efficiency correction to commpensate the fact that the target torque request (or manifold flow) cannot be realized" UWORD _CNV_A_R_LINEAR_____183_CM 1 0. 0. 4. ECU_ADDRESS 0xd0004a6a FORMAT "%11.9" /end MEASUREMENT
/begin MEASUREMENT Vxx_sat_maf_efy_cor "torque efficiency correction to compensate the fact that the target torque request (or manifold flow) cannot be realized" UWORD _CNV_A_R_LINEAR_____183_CM 1 0. 0. 4. ECU_ADDRESS 0xd0004a6c FORMAT "%11.9" /end MEASUREMENT
/begin CHARACTERISTIC Cbx_maf_efy_cor_ena_cfm "enable manifold dynamic compensation" VALUE 0xa0021f5c _REC_S1VAL_20_u1 1. _CNV_A_R_ECME_LINEA_0_CM 0. 1. FORMAT "%1.0" BIT_MASK 0x1 /end CHARACTERISTIC
/begin CHARACTERISTIC Cbx_maf_efy_tkof_cfm "enable the consideration of coupler state during take off" VALUE 0xa0021f5d _REC_S1VAL_20_u1 1. _CNV_A_R_ECME_LINEA_0_CM 0. 1. FORMAT "%1.0" BIT_MASK 0x1 /end CHARACTERISTIC
/begin CHARACTERISTIC Cbx_maf_efy_tq_trs_cfm "enable manifold dynamic compensation for transient intersystem torque request" VALUE 0xa0021f5e _REC_S1VAL_20_u1 1. _CNV_A_R_ECME_LINEA_0_CM 0. 1. FORMAT "%1.0" BIT_MASK 0x1 /end CHARACTERISTIC
/begin CHARACTERISTIC Cxx_eal_maf_efy_ena_thd "Engine air load threshold to enable the consideration of coupler state" VALUE 0xa0021f46 _REC_S1VAL_20_u2 3.99993896484375 _CNV_A_R_LINEAR_____53_CM 0. 3.99993896484375 FORMAT "%10.8" /end CHARACTERISTIC
/begin CHARACTERISTIC Cxx_h_maf_efy_thd "high threshold for manifold dynamic compensation efficiency" VALUE 0xa0021f48 _REC_S1VAL_20_u2 4. _CNV_A_R_LINEAR_____183_CM 0. 4. FORMAT "%11.9" /end CHARACTERISTIC
/begin CHARACTERISTIC Cxx_l_maf_efy_dly "delay to enable low threshold !=1" VALUE 0xa0021f5f _REC_S1VAL_20_u1 2.55 _CNV_A_R_LINEAR_____32_CM 0. 2.55 FORMAT "%4.2" /end CHARACTERISTIC
/begin CHARACTERISTIC Cxx_l_maf_efy_neg_slop "negative slope for manifold compensation dynamic efficiency" VALUE 0xa0021f4a _REC_S1VAL_20_s2 199.90234375 _CNV_A_R_LINEAR_____296_CM -100. 99.90234375 FORMAT "%11.6" /end CHARACTERISTIC
/begin CHARACTERISTIC Cxx_l_maf_efy_pos_slop "positive slope for manifold compensation dynamic efficiency" VALUE 0xa0021f4c _REC_S1VAL_20_s2 199.90234375 _CNV_A_R_LINEAR_____296_CM -100. 99.90234375 FORMAT "%11.6" /end CHARACTERISTIC
/begin CHARACTERISTIC Cxx_l_maf_efy_thd "low threshold for manifold dynamic compensation efficiency" VALUE 0xa0021f4e _REC_S1VAL_20_u2 4. _CNV_A_R_LINEAR_____183_CM 0. 4. FORMAT "%11.9" /end CHARACTERISTIC
/begin CHARACTERISTIC Cxx_maf_cor_efy_dz "Dead zone for manifold dynamic compensation efficiency" VALUE 0xa0021f50 _REC_S1VAL_20_u2 4. _CNV_A_R_LINEAR_____183_CM 0. 4. FORMAT "%11.9" /end CHARACTERISTIC
/begin CHARACTERISTIC Cxx_maf_efy_is_ena_thd "threshold on manifold dynamic compensation correction to stop correction during idle speed" VALUE 0xa0021f52 _REC_S1VAL_20_u2 4. _CNV_A_R_LINEAR_____183_CM 0. 4. FORMAT "%11.9" /end CHARACTERISTIC
/begin CHARACTERISTIC Cxx_maf_efy_neg_slop "negative slope for manifold compensation dynamic efficiency" VALUE 0xa0021f54 _REC_S1VAL_20_s2 199.90234375 _CNV_A_R_LINEAR_____296_CM -100. 99.90234375 FORMAT "%11.6" /end CHARACTERISTIC
/begin CHARACTERISTIC Cxx_mfld_vol_fac "Factor allowing to increase artificially manifold volume in order to amplify \"cdytq\" correction" VALUE 0xa0021f60 _REC_S1VAL_20_u1 25.5 _CNV_A_R_LINEAR_____297_CM 0. 25.5 FORMAT "%4.1" /end CHARACTERISTIC
/begin CHARACTERISTIC Cxx_n_maf_efy_ena_thd "engine speed threshold to enable torque efficiency correction" VALUE 0xa0021f56 _REC_S1VAL_20_u2 16383.75 _CNV_A_R_ENSD_LINEA_22_CM 0. 16383.75 FORMAT "%8.2" /end CHARACTERISTIC
/begin CHARACTERISTIC Cxx_sta_l_maf_efy_thd "low threshold for manifold dynamic compensation efficiency for start" VALUE 0xa0021f58 _REC_S1VAL_20_u2 4. _CNV_A_R_LINEAR_____183_CM 0. 4. FORMAT "%11.9" /end CHARACTERISTIC
/begin CHARACTERISTIC Cxx_tkof_h_maf_efy_thd "high threshold for manifold dynamic compensation efficiency (take off)" VALUE 0xa0021f5a _REC_S1VAL_20_u2 4. _CNV_A_R_LINEAR_____183_CM 0. 4. FORMAT "%11.9" /end CHARACTERISTIC
/begin MEASUREMENT Vbx_no_ajs_tq_efy_cut "Cut request if the final indicated target torque is inferior at the minimum torque threshold" UBYTE _CNV_S_2_RANGE______3_CM 1 0. 0. 1. ECU_ADDRESS 0xd00071ad BIT_MASK 0x1 /end MEASUREMENT
/begin MEASUREMENT Vxx_ajs_tq_efy "Torque efficiency correspond only to AJS" UWORD _CNV_A_R_LINEAR_____183_CM 1 0. 0. 4. ECU_ADDRESS 0xd0004ac8 FORMAT "%11.9" /end MEASUREMENT
/begin MEASUREMENT Vxx_no_ajs_tq_efy "Torque efficiency correspond to ratio between setpoint and target indicated torques (without AJS)" UWORD _CNV_A_R_LINEAR_____183_CM 1 0. 0. 4. ECU_ADDRESS 0xd0004aca FORMAT "%11.9" /end MEASUREMENT
/begin CHARACTERISTIC Cxx_dz_iga_efv "Cxx_dz_iga_efv : torque threshold under which the torque efficiency is set to 1 or 0." VALUE 0xa0021f68 _REC_S1VAL_20_u2 2047.96875 _CNV_A_R_LINEAR_____181_CM 0. 2047.96875 FORMAT "%10.5" /end CHARACTERISTIC
/begin MEASUREMENT Vxx_rich_dstb_cor_efy "Torque efficiency correction corresponding to richness correction for warm-up" UWORD _CNV_A_R_LINEAR_____183_CM 1 0. 0. 4. ECU_ADDRESS 0xd0004acc FORMAT "%11.9" /end MEASUREMENT
/begin CHARACTERISTIC Cxx_rich_dstb_cor_efy_fac "torque efficiency correction corresponding to richness correction for warm-up factor" VALUE 0xa0021f6a _REC_S1VAL_20_u1 1.9921875 _CNV_A_R_LINEAR_____240_CM -1. 0.9921875 FORMAT "%9.6" /end CHARACTERISTIC
/begin CHARACTERISTIC Cxx_rich_dstb_cor_efy_fac_alco "torque efficiency correction corresponding to richness correction for warm-up factor (alcool)" VALUE 0xa0021f6b _REC_S1VAL_20_u1 1.9921875 _CNV_A_R_LINEAR_____240_CM -1. 0.9921875 FORMAT "%9.6" /end CHARACTERISTIC
/begin AXIS_PTS Ntb_cyl "Cylinder number breakpoint [0 1 2 3 4 5 6 7]" 0xa0035ca4 Vxx_req_inj_cut_nr_1 _REC_A2AXS_20_u1 7. _CNV_A_R_ECME_LINEA_0_CM 8 0. 7. READ_ONLY FORMAT "%1.0" /end AXIS_PTS
/begin CHARACTERISTIC Ctd_inj_efy_dz "dead zone to authorize the activation of on injector (efficiency is function of number of cut cylinder)" CURVE 0xa0035cb0 _REC_A1CUR_20_u2_u1 4. _CNV_A_R_LINEAR_____183_CM 0. 4. FORMAT "%11.9"
 /begin AXIS_DESCR COM_AXIS Vxx_req_inj_cut_nr_1 _CNV_A_R_ECME_LINEA_0_CM 8 0. 7. READ_ONLY FORMAT "%1.0" AXIS_PTS_REF Ntb_cyl /end AXIS_DESCR
/end CHARACTERISTIC
/begin MEASUREMENT Vbx_cut "The active cut flag" UBYTE _CNV_S_2_RANGE______3_CM 1 0. 0. 1. ECU_ADDRESS 0xd00071a7 BIT_MASK 0x1 /end MEASUREMENT
/begin MEASUREMENT Vbx_cut_it_dft "limp home" UBYTE _CNV_S_2_RANGE______3_CM 1 0. 0. 1. ECU_ADDRESS 0xd00071a8 BIT_MASK 0x1 /end MEASUREMENT
/begin MEASUREMENT Vxx_cut_efy_dz "dead zone to authorize the cut of on injector" UWORD _CNV_A_R_LINEAR_____183_CM 1 0. 0. 4. ECU_ADDRESS 0xd0004abe FORMAT "%11.9" /end MEASUREMENT
/begin MEASUREMENT Vxx_cyl_cut_tq_efy "torque efficiency corrected by the number of cut cylinders" UWORD _CNV_A_R_LINEAR_____183_CM 1 0. 0. 4. ECU_ADDRESS 0xd0004ac0 FORMAT "%11.9" /end MEASUREMENT
/begin MEASUREMENT Vxx_h_req_inj_cut_nr "Maximum number of cylinders which can be cut" UBYTE _CNV_A_R_ECME_LINEA_0_CM 1 0. 0. 12. ECU_ADDRESS 0xd00071a9 FORMAT "%2.0" /end MEASUREMENT
/begin MEASUREMENT Vxx_inj_efy_dz "Dead zone to authorize the activation of on injector" UWORD _CNV_A_R_LINEAR_____183_CM 1 0. 0. 4. ECU_ADDRESS 0xd0004ac2 FORMAT "%11.9" /end MEASUREMENT
/begin MEASUREMENT Vxx_req_inj_cut_nr "Number of cylinder to cut" UBYTE _CNV_A_R_ECME_LINEA_0_CM 1 0. 0. 12. ECU_ADDRESS 0xd00071aa FORMAT "%2.0" /end MEASUREMENT
/begin MEASUREMENT Vxx_req_inj_cut_nr_1 "Number of cylinder to cut (i-1)" UBYTE _CNV_A_R_ECME_LINEA_0_CM 1 0. 0. 12. ECU_ADDRESS 0xd00071ab FORMAT "%2.0" /end MEASUREMENT
/begin CHARACTERISTIC Cxx_cut_efy_dz "dead zone to authorize the cut of on injector (only applied to cut the last cylinder)" VALUE 0xa0021f62 _REC_S1VAL_20_u2 4. _CNV_A_R_LINEAR_____183_CM 0. 4. FORMAT "%11.9" /end CHARACTERISTIC
/begin CHARACTERISTIC Cxx_lih_inj_cut_nr "" VALUE 0xa0021f64 _REC_S1VAL_20_u2 12. _CNV_A_R_ECME_LINEA_0_CM 0. 12. FORMAT "%2.0" /end CHARACTERISTIC
/begin MEASUREMENT Vsx_tq_fct_vld "Torque realization validity status" UBYTE _CNV_A_R_ECME_LINEA_0_CM 1 0. 0. 3. ECU_ADDRESS 0xd00071ac FORMAT "%1.0" /end MEASUREMENT
/begin CHARACTERISTIC Cbx_n_tq_fct_vld2_cfm "allow to choose torque validity level on Engine speed validity status" VALUE 0xa0021f66 _REC_S1VAL_20_u1 1. _CNV_A_R_ECME_LINEA_0_CM 0. 1. FORMAT "%1.0" BIT_MASK 0x1 /end CHARACTERISTIC
/begin AXIS_PTS Ctb_rich_sp "richness setpoint breakpoints" 0xa00367e8 Vxx_rich_sp _REC_A2AXS_20_u2 1.99996948242188 _CNV_A_R_LINEAR_____48_CM 9 0. 1.99996948242188 FORMAT "%7.5" /end AXIS_PTS
/begin CHARACTERISTIC Cmp_n_eal_otl_tqi_fac "Massic hp indicated torque factor depending on engine air load and engine speed" MAP 0xa00367fc _REC_A1MAP_20_u1_u2_u2 0.498046875 _CNV_A_R_LINEAR_____298_CM 0.501953125 1. FORMAT "%11.9"
 /begin AXIS_DESCR COM_AXIS Vxx_n _CNV_A_R_ENSD_LINEA_22_CM 20 0. 16383.75 FORMAT "%8.2" AXIS_PTS_REF Ctb_n /end AXIS_DESCR
 /begin AXIS_DESCR COM_AXIS Vxx_eal _CNV_A_R_LINEAR_____53_CM 16 0. 3.99993896484375 FORMAT "%10.8" AXIS_PTS_REF Ctb_eal /end AXIS_DESCR
/end CHARACTERISTIC
/begin CHARACTERISTIC Ctp_rich_otl_iga_tqi_fac "Massic hp indicated torque factor depending on Air/fuel ratio target" CURVE 0xa003693c _REC_A1CUR_20_u2_u2 2. _CNV_A_R_LINEAR_____183_CM 0. 2. FORMAT "%10.8"
 /begin AXIS_DESCR COM_AXIS Vxx_rich_sp _CNV_A_R_LINEAR_____48_CM 9 0. 1.99996948242188 FORMAT "%7.5" AXIS_PTS_REF Ctb_rich_sp /end AXIS_DESCR
/end CHARACTERISTIC
/begin MEASUREMENT Vsx_otl_iga_mv_tqi_vld "HP indicated torque for 1kg of air at optimal advance validity status" UBYTE _CNV_S_3_STATUS_OK__179_CM 1 0. 0. 2. ECU_ADDRESS 0xd00071b6 /end MEASUREMENT
/begin MEASUREMENT Vxx_otl_iga_mv_tqi "HP indicated torque for 1kg of air at optimal advance" UWORD _CNV_A_R_LINEAR_____299_CM 1 0. 0. 524280. ECU_ADDRESS 0xd0004b50 FORMAT "%6.0" /end MEASUREMENT
/begin MEASUREMENT Vxx_otl_iga_mv_tqi_gas "HP indicated torque for 1kg of air at optimal advance for gasoline" UWORD _CNV_A_R_LINEAR_____299_CM 1 0. 0. 524280. ECU_ADDRESS 0xd000609c FORMAT "%6.0" /end MEASUREMENT
/begin CHARACTERISTIC Cxx_otl_iga_tqi "massic hp indicated torque" VALUE 0xa0021f78 _REC_S1VAL_20_u2 524280. _CNV_A_R_LINEAR_____299_CM 0. 524280. FORMAT "%6.0" /end CHARACTERISTIC
/begin AXIS_PTS Ctb_wup_tq_rel "9 programmable relative torque ratio breakpoints linked to catalyst warm-up" 0xa0036978 Vxx_tq_rel _REC_A2AXS_20_u2 4. _CNV_A_R_LINEAR_____285_CM 9 -2. 2. FORMAT "%7.4" /end AXIS_PTS
/begin AXIS_PTS Ctb_eng_amp "atmospheric pressure breakpoint of full load torque limitation." 0xa00357a8 Vxx_amp _REC_A2AXS_20_u2 20000. _CNV_A_R_LINEAR_____115_CM 6 0. 20000. FORMAT "%5.0" /end AXIS_PTS
/begin AXIS_PTS Ctb_ovh_tco "Coolant temperature breakpoints map for over heating" 0xa003594c Vxx_tco _REC_A2AXS_20_u2 240. _CNV_A_R_LINEAR_____110_CM 6 -40. 200. FORMAT "%5.1" /end AXIS_PTS
/begin AXIS_PTS Ctb_ovh_toil "Oil temperature breakpoints map for over heating" 0xa003595c Vxx_toil _REC_A2AXS_20_u2 240. _CNV_A_R_LINEAR_____110_CM 6 -40. 200. FORMAT "%5.1" /end AXIS_PTS
/begin AXIS_PTS Ctb_ovh_up_it_temp "Manifold air temperature breakpoints map for over heating" 0xa003596c Vxx_up_it_temp _REC_A2AXS_20_u2 240. _CNV_A_R_LINEAR_____110_CM 6 -40. 200. FORMAT "%5.1" /end AXIS_PTS
/begin MEASUREMENT cppwm "PWM for the canister purge valve mass air flow" UBYTE _CNV_A_R_LINEAR_____52_CM 1 0. 0. 99.609375 ECU_ADDRESS 0xd0004fd6 FORMAT "%9.6" /end MEASUREMENT
/begin MEASUREMENT frq_req_cp "Frequency command of the canister purge" UBYTE _CNV_A_R_LINEAR_____290_CM 1 0. 0. 255. ECU_ADDRESS 0xd000761b FORMAT "%3.0" /end MEASUREMENT
/begin MEASUREMENT lv_rly_fpmp_position "Fuel pomp relay control command state (0 = relay shall be switched off, 1 = relay shall be switched on)" UBYTE _CNV_S_2_RANGE______3_CM 1 0. 0. 1. ECU_ADDRESS 0xd0002391 BIT_MASK 0x1 /end MEASUREMENT
/begin AXIS_PTS Ctb_n "20 programmable engine speed breakpoints map" 0xa002db74 Vxx_n _REC_A2AXS_20_u2 16383.75 _CNV_A_R_ENSD_LINEA_22_CM 20 0. 16383.75 FORMAT "%8.2" /end AXIS_PTS
/begin MEASUREMENT Vbx_eng_off_mdf1_on "Mdf1 sate saved(engine stop) in EEPROM" UBYTE _CNV_S_2_RANGE______3_CM 1 0. 0. 1. ECU_ADDRESS 0xd0007839 BIT_MASK 0x1 /end MEASUREMENT
/begin MEASUREMENT Vbx_mdf1_comb_mod_req "combustion mode fan 1 request" UBYTE _CNV_S_2_RANGE______3_CM 1 0. 0. 1. ECU_ADDRESS 0xd000783a BIT_MASK 0x1 /end MEASUREMENT
/begin MEASUREMENT Vbx_mdf2_comb_mod_req "combustion mode fan 2 request" UBYTE _CNV_S_2_RANGE______3_CM 1 0. 0. 1. ECU_ADDRESS 0xd000783b BIT_MASK 0x1 /end MEASUREMENT
/begin AXIS_PTS Ntb_gear "Gearbox ratio breakpoint" 0xa002da28 Vxx_gear _REC_A2AXS_20_u1 7. _CNV_A_R_LINEAR_____145_CM 8 -1. 6. READ_ONLY FORMAT "%2.0" /end AXIS_PTS
/begin COMPU_METHOD _CNV_A_R_ECME_LINEA_0_CM "" RAT_FUNC "%6.3" "-" COEFFS 0 1. 0. 0 0 1 /end COMPU_METHOD
/begin COMPU_METHOD _CNV_S_2_RANGE______3_CM "" TAB_VERB "%6.3" "-" COMPU_TAB_REF _CNV_S_2_RANGE______3 /end COMPU_METHOD
/begin COMPU_VTAB _CNV_S_2_RANGE______3 "" TAB_VERB 2 0 "0" 1 "1" /end COMPU_VTAB
/begin COMPU_METHOD _CNV_A_R_LINEAR_____7_CM "" RAT_FUNC "%6.3" "-" COEFFS 0 65535.99999999996 0. 0 0 1 /end COMPU_METHOD
/begin COMPU_METHOD _CNV_A_R_ENSD_LINEA_22_CM "" RAT_FUNC "%6.3" "rpm" COEFFS 0 4. 0. 0 0 1 /end COMPU_METHOD
/begin COMPU_METHOD _CNV_A_R_LINEAR_____23_CM "" RAT_FUNC "%6.3" "°CRK" COEFFS 0 2.666666666666667 0. 0 0 1 /end COMPU_METHOD
/begin COMPU_METHOD _CNV_A_R_LINEAR_____29_CM "" RAT_FUNC "%6.3" "-" COEFFS 0 256. 0. 0 0 1 /end COMPU_METHOD
/begin COMPU_METHOD _CNV_A_R_LINEAR_____32_CM "" RAT_FUNC "%6.3" "s" COEFFS 0 100. 0. 0 0 1 /end COMPU_METHOD
/begin COMPU_METHOD _CNV_A_R_LINEAR_____42_CM "" RAT_FUNC "%6.3" "-" COEFFS 0 128. 0. 0 0 1 /end COMPU_METHOD
/begin COMPU_METHOD _CNV_A_R_IGRE_LINEA_47_CM "" RAT_FUNC "%6.3" "°CRK" COEFFS 0 2.666666666666667 63. 0 0 1 /end COMPU_METHOD
/begin COMPU_METHOD _CNV_A_R_LINEAR_____48_CM "" RAT_FUNC "%6.3" "-" COEFFS 0 32767.99999999992 0. 0 0 1 /end COMPU_METHOD
/begin COMPU_METHOD _CNV_A_R_LINEAR_____52_CM "" RAT_FUNC "%6.3" "%" COEFFS 0 2.56 0. 0 0 1 /end COMPU_METHOD
/begin COMPU_METHOD _CNV_A_R_LINEAR_____53_CM "" RAT_FUNC "%6.3" "-" COEFFS 0 16384. 0. 0 0 1 /end COMPU_METHOD
/begin COMPU_METHOD _CNV_A_R_LINEAR_____58_CM "" RAT_FUNC "%6.3" "s" COEFFS 0 10. 0. 0 0 1 /end COMPU_METHOD
/begin COMPU_METHOD _CNV_S_16_RANGE_ERR__62_CM "" TAB_VERB "%6.3" "-" COMPU_TAB_REF _CNV_S_16_RANGE_ERR__62 /end COMPU_METHOD
/begin COMPU_VTAB _CNV_S_16_RANGE_ERR__62 "" TAB_VERB 16 0 "NO_SYM" 1 "SYM_0" 2 "SYM_1" 3 "SYM_0, SYM_1" 4 "SYM_2" 5 "SYM_0, SYM_2" 6 "SYM_1, SYM_2" 7 "SYM_0, SYM_1, SYM_2" 8 "SYM_3" 9 "SYM_0, SYM_3" 10 "SYM_1, SYM_3" 11 "SYM_0, SYM_1,SYM_3" 12 "SYM_2, SYM_3" 13 "SYM_0, SYM_2, SYM_3" 14 "SYM_1, SYM_2, SYM_3" 15 "SYM_0, SYM_1, SYM_2, SYM_3" /end COMPU_VTAB
/begin COMPU_METHOD _CNV_A_R_LINEAR_____68_CM "" RAT_FUNC "%6.3" "s" COEFFS 0 1. 0. 0 0 1 /end COMPU_METHOD
/begin COMPU_METHOD _CNV_A_R_LINEAR_____69_CM "" RAT_FUNC "%6.3" "V" COEFFS 0 2732.24043715847 0. 0 0 1 /end COMPU_METHOD
/begin COMPU_METHOD _CNV_A_R_LINEAR_____71_CM "" RAT_FUNC "%6.3" "km/h" COEFFS 0 1. 0. 0 0 1 /end COMPU_METHOD
/begin COMPU_METHOD _CNV_A_R_LINEAR_____107_CM "" RAT_FUNC "%6.3" "mV" COEFFS 0 1. 0. 0 0 1 /end COMPU_METHOD
/begin COMPU_METHOD _CNV_A_R_LINEAR_____110_CM "" RAT_FUNC "%6.3" "°C" COEFFS 0 10. 400. 0 0 1 /end COMPU_METHOD
/begin COMPU_METHOD _CNV_A_R_LINEAR_____115_CM "" RAT_FUNC "%6.3" "hPa" COEFFS 0 1. 0. 0 0 1 /end COMPU_METHOD
/begin COMPU_METHOD _CNV_A_R_LINEAR_____116_CM "" RAT_FUNC "%6.3" "s" COEFFS 0 1000. 0. 0 0 1 /end COMPU_METHOD
/begin COMPU_METHOD _CNV_A_R_LINEAR_____123_CM "" RAT_FUNC "%6.3" "-" COEFFS 0 100. 0. 0 0 1 /end COMPU_METHOD
/begin COMPU_METHOD _CNV_A_R_LINEAR_____125_CM "" RAT_FUNC "%6.3" "km/h" COEFFS 0 100. 0. 0 0 1 /end COMPU_METHOD
/begin COMPU_METHOD _CNV_A_R_LINEAR_____129_CM "" RAT_FUNC "%6.3" "°CRK" COEFFS 0 50. 0. 0 0 1 /end COMPU_METHOD
/begin COMPU_METHOD _CNV_A_R_LINEAR_____130_CM "" RAT_FUNC "%6.3" "-" COEFFS 0 256. -1. 0 0 1 /end COMPU_METHOD
/begin COMPU_METHOD _CNV_A_R_LINEAR_____145_CM "" RAT_FUNC "%6.3" "-" COEFFS 0 1. 1. 0 0 1 /end COMPU_METHOD
/begin COMPU_METHOD _CNV_A_R_LINEAR_____158_CM "" RAT_FUNC "%6.3" "hPa" COEFFS 0 1. 10000. 0 0 1 /end COMPU_METHOD
/begin COMPU_METHOD _CNV_A_R_LINEAR_____159_CM "" RAT_FUNC "%6.3" "%" COEFFS 0 655.35 0. 0 0 1 /end COMPU_METHOD
/begin COMPU_METHOD _CNV_A_R_LINEAR_____161_CM "" RAT_FUNC "%6.3" "-" COEFFS 0 1000. 0. 0 0 1 /end COMPU_METHOD
/begin COMPU_METHOD _CNV_A_R_LINEAR_____165_CM "" RAT_FUNC "%6.3" "%" COEFFS 0 2.55 0. 0 0 1 /end COMPU_METHOD
/begin COMPU_METHOD _CNV_A_R_LINEAR_____172_CM "" RAT_FUNC "%6.3" "kg/h" COEFFS 0 20. 0. 0 0 1 /end COMPU_METHOD
/begin COMPU_METHOD _CNV_S_3_STATUS_OK__179_CM "" TAB_VERB "%6.3" "-" COMPU_TAB_REF _CNV_S_3_STATUS_OK__179 /end COMPU_METHOD
/begin COMPU_VTAB _CNV_S_3_STATUS_OK__179 "" TAB_VERB 3 0 "Nsx_vld_nok_0" 1 "Nsx_vld_ok_1" 2 "Nsx_vld_fail_2" /end COMPU_VTAB
/begin COMPU_METHOD _CNV_A_R_LINEAR_____181_CM "" RAT_FUNC "%6.3" "Nm" COEFFS 0 32. 0. 0 0 1 /end COMPU_METHOD
/begin COMPU_METHOD _CNV_A_R_LINEAR_____183_CM "" RAT_FUNC "%6.3" "-" COEFFS 0 1024. 0. 0 0 1 /end COMPU_METHOD
/begin COMPU_METHOD _CNV_A_R_LINEAR_____201_CM "" RAT_FUNC "%6.3" "ms" COEFFS 0 1. 0. 0 0 1 /end COMPU_METHOD
/begin COMPU_METHOD _CNV_A_R_LINEAR_____205_CM "" RAT_FUNC "%6.3" "V" COEFFS 0 100. 0. 0 0 1 /end COMPU_METHOD
/begin COMPU_METHOD _CNV_S_16_RANGE_ERR__206_CM "" TAB_VERB "%6.3" "" COMPU_TAB_REF _CNV_S_16_RANGE_ERR__206 /end COMPU_METHOD
/begin COMPU_VTAB _CNV_S_16_RANGE_ERR__206 "" TAB_VERB 16 0 "NO_SYM" 1 "SYM_0" 2 "SYM_1" 3 "SYM_0, SYM_1" 4 "SYM_2" 5 "SYM_0, SYM_2" 6 "SYM_1, SYM_2" 7 "SYM_0, SYM_1, SYM_2" 8 "SYM_3" 9 "SYM_0, SYM_3" 10 "SYM_1, SYM_3" 11 "SYM_0, SYM_1,SYM_3" 12 "SYM_2, SYM_3" 13 "SYM_0, SYM_2, SYM_3" 14 "SYM_1, SYM_2, SYM_3" 15 "SYM_0, SYM_1, SYM_2, SYM_3" /end COMPU_VTAB
/begin COMPU_METHOD _CNV_A_R_LINEAR_____216_CM "" RAT_FUNC "%6.3" "Nm" COEFFS 0 32. 12800. 0 0 1 /end COMPU_METHOD
/begin COMPU_METHOD _CNV_A_R_LINEAR_____240_CM "" RAT_FUNC "%6.3" "-" COEFFS 0 128. 128. 0 0 1 /end COMPU_METHOD
/begin COMPU_METHOD _CNV_S_2_STATUS_OK__269_CM "" TAB_VERB "%6.3" "-" COMPU_TAB_REF _CNV_S_2_STATUS_OK__269 /end COMPU_METHOD
/begin COMPU_VTAB _CNV_S_2_STATUS_OK__269 "" TAB_VERB 2 0 "Nsx_vld_nok_0" 1 "Nsx_vld_ok_1" /end COMPU_VTAB
/begin COMPU_METHOD _CNV_A_R_LINEAR_____274_CM "" RAT_FUNC "%6.3" "km" COEFFS 0 1. 0. 0 0 1 /end COMPU_METHOD
/begin COMPU_METHOD _CNV_A_R_LINEAR_____279_CM "" RAT_FUNC "%6.3" "kPa" COEFFS 0 1. 0. 0 0 1 /end COMPU_METHOD
/begin COMPU_METHOD _CNV_A_R_LINEAR_____280_CM "" RAT_FUNC "%6.3" "°C" COEFFS 0 1. 40. 0 0 1 /end COMPU_METHOD
/begin COMPU_METHOD _CNV_A_R_LINEAR_____281_CM "" RAT_FUNC "%6.3" "%" COEFFS 0 1.28 128. 0 0 1 /end COMPU_METHOD
/begin COMPU_METHOD _CNV_A_R_LINEAR_____282_CM "" RAT_FUNC "%6.3" "g/s" COEFFS 0 100. 0. 0 0 1 /end COMPU_METHOD
/begin COMPU_METHOD _CNV_A_R_LINEAR_____283_CM "" RAT_FUNC "%6.3" "kPa" COEFFS 0 0.1 0. 0 0 1 /end COMPU_METHOD
/begin COMPU_METHOD _CNV_A_R_LINEAR_____284_CM "" RAT_FUNC "%6.3" "Pa" COEFFS 0 4. 0. 0 0 1 /end COMPU_METHOD
/begin COMPU_METHOD _CNV_A_R_LINEAR_____285_CM "" RAT_FUNC "%6.3" "-" COEFFS 0 1024. 32768. 0 0 1 /end COMPU_METHOD
/begin COMPU_METHOD _CNV_A_R_LINEAR_____286_CM "" RAT_FUNC "%6.3" "°CRK/s" COEFFS 0 -50. 0. 0 0 1 /end COMPU_METHOD
/begin COMPU_METHOD _CNV_A_R_LINEAR_____287_CM "" RAT_FUNC "%6.3" "°CRK/s" COEFFS 0 50. 0. 0 0 1 /end COMPU_METHOD
/begin COMPU_METHOD _CNV_S_4_RANGE_ROUT_288_CM "" TAB_VERB "%6.3" "-" COMPU_TAB_REF _CNV_S_4_RANGE_ROUT_288 /end COMPU_METHOD
/begin COMPU_VTAB _CNV_S_4_RANGE_ROUT_288 "" TAB_VERB 4 0 "Nsx_diag_sta_disa_stt" 1 "Nsx_diag_sta_run_stt" 2 "Nsx_diag_sta_end_stt" 3 "Nsx_diag_sta_abrt_stt" /end COMPU_VTAB
/begin COMPU_METHOD _CNV_A_R_LINEAR_____289_CM "" RAT_FUNC "%6.3" "A" COEFFS 0 10000. 0. 0 0 1 /end COMPU_METHOD
/begin COMPU_METHOD _CNV_A_R_LINEAR_____290_CM "" RAT_FUNC "%6.3" "Hz" COEFFS 0 1. 0. 0 0 1 /end COMPU_METHOD
/begin COMPU_METHOD _CNV_A_R_LINEAR_____291_CM "" RAT_FUNC "%6.3" "Nms" COEFFS 0 32. 0. 0 0 1 /end COMPU_METHOD
/begin COMPU_METHOD _CNV_A_R_LINEAR_____292_CM "" RAT_FUNC "%6.3" "Nm/s" COEFFS 0 -1. 0. 0 0 1 /end COMPU_METHOD
/begin COMPU_METHOD _CNV_A_R_LINEAR_____293_CM "" RAT_FUNC "%6.3" "Nm/s" COEFFS 0 1. 0. 0 0 1 /end COMPU_METHOD
/begin COMPU_METHOD _CNV_A_R_LINEAR_____294_CM "" RAT_FUNC "%6.3" "-" COEFFS 0 25.6 0. 0 0 1 /end COMPU_METHOD
/begin COMPU_METHOD _CNV_A_R_LINEAR_____295_CM "" RAT_FUNC "%6.3" "°CRK2" COEFFS 0 7.111111111111111 0. 0 0 1 /end COMPU_METHOD
/begin COMPU_METHOD _CNV_A_R_LINEAR_____296_CM "" RAT_FUNC "%6.3" "1/s" COEFFS 0 10.24 0. 0 0 1 /end COMPU_METHOD
/begin COMPU_METHOD _CNV_A_R_LINEAR_____297_CM "" RAT_FUNC "%6.3" "-" COEFFS 0 10. 0. 0 0 1 /end COMPU_METHOD
/begin COMPU_METHOD _CNV_A_R_LINEAR_____298_CM "" RAT_FUNC "%6.3" "-" COEFFS 0 512. -257. 0 0 1 /end COMPU_METHOD
/begin COMPU_METHOD _CNV_A_R_LINEAR_____299_CM "" RAT_FUNC "%6.3" "Nm/kg" COEFFS 0 0.125 0. 0 0 1 /end COMPU_METHOD
/begin RECORD_LAYOUT _REC_S1VAL_20_u1 FNC_VALUES 1 UBYTE COLUMN_DIR DIRECT /end RECORD_LAYOUT
/begin RECORD_LAYOUT _REC_A2AXS_20_u1 NO_AXIS_PTS_X 1 UBYTE AXIS_PTS_X 2 UBYTE INDEX_INCR DIRECT /end RECORD_LAYOUT
/begin RECORD_LAYOUT _REC_S1VAL_20_u2 FNC_VALUES 1 UWORD COLUMN_DIR DIRECT /end RECORD_LAYOUT
/begin RECORD_LAYOUT _REC_S1VAL_20_s2 FNC_VALUES 1 SWORD COLUMN_DIR DIRECT /end RECORD_LAYOUT
/begin RECORD_LAYOUT _REC_A2AXS_20_u2 NO_AXIS_PTS_X 1 UWORD AXIS_PTS_X 2 UWORD INDEX_INCR DIRECT /end RECORD_LAYOUT
/begin RECORD_LAYOUT _REC_A1CUR_20_u1_u2 FNC_VALUES 1 UBYTE COLUMN_DIR DIRECT /end RECORD_LAYOUT
/begin RECORD_LAYOUT _REC_A1CUR_20_u2_u1 FNC_VALUES 1 UWORD COLUMN_DIR DIRECT /end RECORD_LAYOUT
/begin RECORD_LAYOUT _REC_A1MAP_20_u2_u2_u2 FNC_VALUES 1 UWORD COLUMN_DIR DIRECT /end RECORD_LAYOUT
/begin RECORD_LAYOUT _REC_A1CUR_20_u2_u2 FNC_VALUES 1 UWORD COLUMN_DIR DIRECT /end RECORD_LAYOUT
/begin RECORD_LAYOUT _REC_A1MAP_20_u2_u2_u1 FNC_VALUES 1 UWORD COLUMN_DIR DIRECT /end RECORD_LAYOUT
/begin RECORD_LAYOUT _REC_A1MAP_20_u1_u2_u2 FNC_VALUES 1 UBYTE COLUMN_DIR DIRECT /end RECORD_LAYOUT
/begin FUNCTION DgDftMng_Obdfram ""
 /begin DEF_CHARACTERISTIC Cbx_obd_off_cfm Cxx_dtc_lb_cata Cxx_dtc_lb_fsys Cxx_dtc_msb_fsys /end DEF_CHARACTERISTIC
 /begin OUT_MEASUREMENT Stx_frm_pool[0].Vxx_rtn_n01 Stx_frm_pool[0].Vxx_obd_fail_code Stx_frm_pool[0].Vxx_rtn_eal Stx_frm_pool[0].Vxx_rtn_vs Stx_frm_pool[0].Vxx_rtn_map Stx_frm_pool[0].Vxx_rtn_frm_tco Stx_frm_pool[0].Vxx_rtn_mv_ad_fac Stx_frm_pool[0].Vxx_rtn_rich_loop_ti_fac Stx_frm_pool[0].Vbx_rtn_clos_o2_phs Stx_frm_pool[0].Vxx_rtn_mat Stx_frm_pool[0].Vxx_rtn_clr_dist Stx_frm_pool[0].Vxx_ind_xxx Stx_frm_pool[0].Vxx_rtn_maf Stx_frm_pool[0].Vxx_rtn_rail_prs Stx_frm_pool[0].Vxx_rtn_tia Stx_frm_pool[0].Vxx_dgdftmng_priority Stx_frm_pool[0].Vxx_rtn_rvac Stx_frm_pool[1].Vxx_rtn_n01 Stx_frm_pool[1].Vxx_obd_fail_code Stx_frm_pool[1].Vxx_rtn_eal Stx_frm_pool[1].Vxx_rtn_vs Stx_frm_pool[1].Vxx_rtn_map Stx_frm_pool[1].Vxx_rtn_frm_tco Stx_frm_pool[1].Vxx_rtn_mv_ad_fac Stx_frm_pool[1].Vxx_rtn_rich_loop_ti_fac Stx_frm_pool[1].Vbx_rtn_clos_o2_phs Stx_frm_pool[1].Vxx_rtn_mat Stx_frm_pool[1].Vxx_rtn_clr_dist Stx_frm_pool[1].Vxx_ind_xxx Stx_frm_pool[1].Vxx_rtn_maf Stx_frm_pool[1].Vxx_rtn_rail_prs Stx_frm_pool[1].Vxx_rtn_tia Stx_frm_pool[1].Vxx_dgdftmng_priority Stx_frm_pool[1].Vxx_rtn_rvac Stx_frm_pool[2].Vxx_rtn_n01 Stx_frm_pool[2].Vxx_obd_fail_code Stx_frm_pool[2].Vxx_rtn_eal Stx_frm_pool[2].Vxx_rtn_vs Stx_frm_pool[2].Vxx_rtn_map Stx_frm_pool[2].Vxx_rtn_frm_tco Stx_frm_pool[2].Vxx_rtn_mv_ad_fac Stx_frm_pool[2].Vxx_rtn_rich_loop_ti_fac Stx_frm_pool[2].Vbx_rtn_clos_o2_phs Stx_frm_pool[2].Vxx_rtn_mat Stx_frm_pool[2].Vxx_rtn_clr_dist Stx_frm_pool[2].Vxx_ind_xxx Stx_frm_pool[2].Vxx_rtn_maf Stx_frm_pool[2].Vxx_rtn_rail_prs Stx_frm_pool[2].Vxx_rtn_tia Stx_frm_pool[2].Vxx_dgdftmng_priority Stx_frm_pool[2].Vxx_rtn_rvac Stx_frm_pool[3].Vxx_rtn_n01 Stx_frm_pool[3].Vxx_obd_fail_code Stx_frm_pool[3].Vxx_rtn_eal Stx_frm_pool[3].Vxx_rtn_vs Stx_frm_pool[3].Vxx_rtn_map Stx_frm_pool[3].Vxx_rtn_frm_tco Stx_frm_pool[3].Vxx_rtn_mv_ad_fac Stx_frm_pool[3].Vxx_rtn_rich_loop_ti_fac Stx_frm_pool[3].Vbx_rtn_clos_o2_phs Stx_frm_pool[3].Vxx_rtn_mat Stx_frm_pool[3].Vxx_rtn_clr_dist Stx_frm_pool[3].Vxx_ind_xxx Stx_frm_pool[3].Vxx_rtn_maf Stx_frm_pool[3].Vxx_rtn_rail_prs Stx_frm_pool[3].Vxx_rtn_tia Stx_frm_pool[3].Vxx_dgdftmng_priority Stx_frm_pool[3].Vxx_rtn_rvac Stx_frm_pool[4].Vxx_rtn_n01 Stx_frm_pool[4].Vxx_obd_fail_code Stx_frm_pool[4].Vxx_rtn_eal Stx_frm_pool[4].Vxx_rtn_vs Stx_frm_pool[4].Vxx_rtn_map Stx_frm_pool[4].Vxx_rtn_frm_tco Stx_frm_pool[4].Vxx_rtn_mv_ad_fac Stx_frm_pool[4].Vxx_rtn_rich_loop_ti_fac Stx_frm_pool[4].Vbx_rtn_clos_o2_phs Stx_frm_pool[4].Vxx_rtn_mat Stx_frm_pool[4].Vxx_rtn_clr_dist Stx_frm_pool[4].Vxx_ind_xxx Stx_frm_pool[4].Vxx_rtn_maf Stx_frm_pool[4].Vxx_rtn_rail_prs Stx_frm_pool[4].Vxx_rtn_tia Stx_frm_pool[4].Vxx_dgdftmng_priority Stx_frm_pool[4].Vxx_rtn_rvac Stx_frm_pool[5].Vxx_rtn_n01 Stx_frm_pool[5].Vxx_obd_fail_code Stx_frm_pool[5].Vxx_rtn_eal Stx_frm_pool[5].Vxx_rtn_vs Stx_frm_pool[5].Vxx_rtn_map Stx_frm_pool[5].Vxx_rtn_frm_tco Stx_frm_pool[5].Vxx_rtn_mv_ad_fac Stx_frm_pool[5].Vxx_rtn_rich_loop_ti_fac Stx_frm_pool[5].Vbx_rtn_clos_o2_phs Stx_frm_pool[5].Vxx_rtn_mat Stx_frm_pool[5].Vxx_rtn_clr_dist Stx_frm_pool[5].Vxx_ind_xxx Stx_frm_pool[5].Vxx_rtn_maf Stx_frm_pool[5].Vxx_rtn_rail_prs Stx_frm_pool[5].Vxx_rtn_tia Stx_frm_pool[5].Vxx_dgdftmng_priority Stx_frm_pool[5].Vxx_rtn_rvac Stx_frm_pool[6].Vxx_rtn_n01 Stx_frm_pool[6].Vxx_obd_fail_code Stx_frm_pool[6].Vxx_rtn_eal Stx_frm_pool[6].Vxx_rtn_vs Stx_frm_pool[6].Vxx_rtn_map Stx_frm_pool[6].Vxx_rtn_frm_tco Stx_frm_pool[6].Vxx_rtn_mv_ad_fac Stx_frm_pool[6].Vxx_rtn_rich_loop_ti_fac Stx_frm_pool[6].Vbx_rtn_clos_o2_phs Stx_frm_pool[6].Vxx_rtn_mat Stx_frm_pool[6].Vxx_rtn_clr_dist Stx_frm_pool[6].Vxx_ind_xxx Stx_frm_pool[6].Vxx_rtn_maf Stx_frm_pool[6].Vxx_rtn_rail_prs Stx_frm_pool[6].Vxx_rtn_tia Stx_frm_pool[6].Vxx_dgdftmng_priority Stx_frm_pool[6].Vxx_rtn_rvac Stx_frm_pool[7].Vxx_rtn_n01 Stx_frm_pool[7].Vxx_obd_fail_code Stx_frm_pool[7].Vxx_rtn_eal Stx_frm_pool[7].Vxx_rtn_vs Stx_frm_pool[7].Vxx_rtn_map Stx_frm_pool[7].Vxx_rtn_frm_tco Stx_frm_pool[7].Vxx_rtn_mv_ad_fac Stx_frm_pool[7].Vxx_rtn_rich_loop_ti_fac Stx_frm_pool[7].Vbx_rtn_clos_o2_phs Stx_frm_pool[7].Vxx_rtn_mat Stx_frm_pool[7].Vxx_rtn_clr_dist Stx_frm_pool[7].Vxx_ind_xxx Stx_frm_pool[7].Vxx_rtn_maf Stx_frm_pool[7].Vxx_rtn_rail_prs Stx_frm_pool[7].Vxx_rtn_tia Stx_frm_pool[7].Vxx_dgdftmng_priority Stx_frm_pool[7].Vxx_rtn_rvac Stx_frm_pool[8].Vxx_rtn_n01 Stx_frm_pool[8].Vxx_obd_fail_code Stx_frm_pool[8].Vxx_rtn_eal Stx_frm_pool[8].Vxx_rtn_vs Stx_frm_pool[8].Vxx_rtn_map Stx_frm_pool[8].Vxx_rtn_frm_tco Stx_frm_pool[8].Vxx_rtn_mv_ad_fac Stx_frm_pool[8].Vxx_rtn_rich_loop_ti_fac Stx_frm_pool[8].Vbx_rtn_clos_o2_phs Stx_frm_pool[8].Vxx_rtn_mat Stx_frm_pool[8].Vxx_rtn_clr_dist Stx_frm_pool[8].Vxx_ind_xxx Stx_frm_pool[8].Vxx_rtn_maf Stx_frm_pool[8].Vxx_rtn_rail_prs Stx_frm_pool[8].Vxx_rtn_tia Stx_frm_pool[8].Vxx_dgdftmng_priority Stx_frm_pool[8].Vxx_rtn_rvac Stx_frm_pool[9].Vxx_rtn_n01 Stx_frm_pool[9].Vxx_obd_fail_code Stx_frm_pool[9].Vxx_rtn_eal Stx_frm_pool[9].Vxx_rtn_vs Stx_frm_pool[9].Vxx_rtn_map Stx_frm_pool[9].Vxx_rtn_frm_tco Stx_frm_pool[9].Vxx_rtn_mv_ad_fac Stx_frm_pool[9].Vxx_rtn_rich_loop_ti_fac Stx_frm_pool[9].Vbx_rtn_clos_o2_phs Stx_frm_pool[9].Vxx_rtn_mat Stx_frm_pool[9].Vxx_rtn_clr_dist Stx_frm_pool[9].Vxx_ind_xxx Stx_frm_pool[9].Vxx_rtn_maf Stx_frm_pool[9].Vxx_rtn_rail_prs Stx_frm_pool[9].Vxx_rtn_tia Stx_frm_pool[9].Vxx_dgdftmng_priority Stx_frm_pool[9].Vxx_rtn_rvac Vtx_frm[0].Vxx_rtn_n01 Vtx_frm[0].Vxx_obd_fail_code Vtx_frm[0].Vxx_rtn_eal Vtx_frm[0].Vxx_rtn_vs Vtx_frm[0].Vxx_rtn_map Vtx_frm[0].Vxx_rtn_frm_tco Vtx_frm[0].Vxx_rtn_mv_ad_fac Vtx_frm[0].Vxx_rtn_rich_loop_ti_fac Vtx_frm[0].Vbx_rtn_clos_o2_phs Vtx_frm[0].Vxx_rtn_mat Vtx_frm[0].Vxx_rtn_clr_dist Vtx_frm[0].Vxx_ind_xxx Vtx_frm[0].Vxx_rtn_maf Vtx_frm[0].Vxx_rtn_rail_prs Vtx_frm[0].Vxx_rtn_tia Vtx_frm[0].Vxx_dgdftmng_priority Vtx_frm[0].Vxx_rtn_rvac Vtx_frm[1].Vxx_rtn_n01 Vtx_frm[1].Vxx_obd_fail_code Vtx_frm[1].Vxx_rtn_eal Vtx_frm[1].Vxx_rtn_vs Vtx_frm[1].Vxx_rtn_map Vtx_frm[1].Vxx_rtn_frm_tco Vtx_frm[1].Vxx_rtn_mv_ad_fac Vtx_frm[1].Vxx_rtn_rich_loop_ti_fac Vtx_frm[1].Vbx_rtn_clos_o2_phs Vtx_frm[1].Vxx_rtn_mat Vtx_frm[1].Vxx_rtn_clr_dist Vtx_frm[1].Vxx_ind_xxx Vtx_frm[1].Vxx_rtn_maf Vtx_frm[1].Vxx_rtn_rail_prs Vtx_frm[1].Vxx_rtn_tia Vtx_frm[1].Vxx_dgdftmng_priority Vtx_frm[1].Vxx_rtn_rvac Vtx_frm[2].Vxx_rtn_n01 Vtx_frm[2].Vxx_obd_fail_code Vtx_frm[2].Vxx_rtn_eal Vtx_frm[2].Vxx_rtn_vs Vtx_frm[2].Vxx_rtn_map Vtx_frm[2].Vxx_rtn_frm_tco Vtx_frm[2].Vxx_rtn_mv_ad_fac Vtx_frm[2].Vxx_rtn_rich_loop_ti_fac Vtx_frm[2].Vbx_rtn_clos_o2_phs Vtx_frm[2].Vxx_rtn_mat Vtx_frm[2].Vxx_rtn_clr_dist Vtx_frm[2].Vxx_ind_xxx Vtx_frm[2].Vxx_rtn_maf Vtx_frm[2].Vxx_rtn_rail_prs Vtx_frm[2].Vxx_rtn_tia Vtx_frm[2].Vxx_dgdftmng_priority Vtx_frm[2].Vxx_rtn_rvac Vtx_frm[3].Vxx_rtn_n01 Vtx_frm[3].Vxx_obd_fail_code Vtx_frm[3].Vxx_rtn_eal Vtx_frm[3].Vxx_rtn_vs Vtx_frm[3].Vxx_rtn_map Vtx_frm[3].Vxx_rtn_frm_tco Vtx_frm[3].Vxx_rtn_mv_ad_fac Vtx_frm[3].Vxx_rtn_rich_loop_ti_fac Vtx_frm[3].Vbx_rtn_clos_o2_phs Vtx_frm[3].Vxx_rtn_mat Vtx_frm[3].Vxx_rtn_clr_dist Vtx_frm[3].Vxx_ind_xxx Vtx_frm[3].Vxx_rtn_maf Vtx_frm[3].Vxx_rtn_rail_prs Vtx_frm[3].Vxx_rtn_tia Vtx_frm[3].Vxx_dgdftmng_priority Vtx_frm[3].Vxx_rtn_rvac Vtx_frm[4].Vxx_rtn_n01 Vtx_frm[4].Vxx_obd_fail_code Vtx_frm[4].Vxx_rtn_eal Vtx_frm[4].Vxx_rtn_vs Vtx_frm[4].Vxx_rtn_map Vtx_frm[4].Vxx_rtn_frm_tco Vtx_frm[4].Vxx_rtn_mv_ad_fac Vtx_frm[4].Vxx_rtn_rich_loop_ti_fac Vtx_frm[4].Vbx_rtn_clos_o2_phs Vtx_frm[4].Vxx_rtn_mat Vtx_frm[4].Vxx_rtn_clr_dist Vtx_frm[4].Vxx_ind_xxx Vtx_frm[4].Vxx_rtn_maf Vtx_frm[4].Vxx_rtn_rail_prs Vtx_frm[4].Vxx_rtn_tia Vtx_frm[4].Vxx_dgdftmng_priority Vtx_frm[4].Vxx_rtn_rvac Vtx_frm[5].Vxx_rtn_n01 Vtx_frm[5].Vxx_obd_fail_code Vtx_frm[5].Vxx_rtn_eal Vtx_frm[5].Vxx_rtn_vs Vtx_frm[5].Vxx_rtn_map Vtx_frm[5].Vxx_rtn_frm_tco Vtx_frm[5].Vxx_rtn_mv_ad_fac Vtx_frm[5].Vxx_rtn_rich_loop_ti_fac Vtx_frm[5].Vbx_rtn_clos_o2_phs Vtx_frm[5].Vxx_rtn_mat Vtx_frm[5].Vxx_rtn_clr_dist Vtx_frm[5].Vxx_ind_xxx Vtx_frm[5].Vxx_rtn_maf Vtx_frm[5].Vxx_rtn_rail_prs Vtx_frm[5].Vxx_rtn_tia Vtx_frm[5].Vxx_dgdftmng_priority Vtx_frm[5].Vxx_rtn_rvac Vtx_frm[6].Vxx_rtn_n01 Vtx_frm[6].Vxx_obd_fail_code Vtx_frm[6].Vxx_rtn_eal Vtx_frm[6].Vxx_rtn_vs Vtx_frm[6].Vxx_rtn_map Vtx_frm[6].Vxx_rtn_frm_tco Vtx_frm[6].Vxx_rtn_mv_ad_fac Vtx_frm[6].Vxx_rtn_rich_loop_ti_fac Vtx_frm[6].Vbx_rtn_clos_o2_phs Vtx_frm[6].Vxx_rtn_mat Vtx_frm[6].Vxx_rtn_clr_dist Vtx_frm[6].Vxx_ind_xxx Vtx_frm[6].Vxx_rtn_maf Vtx_frm[6].Vxx_rtn_rail_prs Vtx_frm[6].Vxx_rtn_tia Vtx_frm[6].Vxx_dgdftmng_priority Vtx_frm[6].Vxx_rtn_rvac Vtx_frm[7].Vxx_rtn_n01 Vtx_frm[7].Vxx_obd_fail_code Vtx_frm[7].Vxx_rtn_eal Vtx_frm[7].Vxx_rtn_vs Vtx_frm[7].Vxx_rtn_map Vtx_frm[7].Vxx_rtn_frm_tco Vtx_frm[7].Vxx_rtn_mv_ad_fac Vtx_frm[7].Vxx_rtn_rich_loop_ti_fac Vtx_frm[7].Vbx_rtn_clos_o2_phs Vtx_frm[7].Vxx_rtn_mat Vtx_frm[7].Vxx_rtn_clr_dist Vtx_frm[7].Vxx_ind_xxx Vtx_frm[7].Vxx_rtn_maf Vtx_frm[7].Vxx_rtn_rail_prs Vtx_frm[7].Vxx_rtn_tia Vtx_frm[7].Vxx_dgdftmng_priority Vtx_frm[7].Vxx_rtn_rvac Vtx_frm[8].Vxx_rtn_n01 Vtx_frm[8].Vxx_obd_fail_code Vtx_frm[8].Vxx_rtn_eal Vtx_frm[8].Vxx_rtn_vs Vtx_frm[8].Vxx_rtn_map Vtx_frm[8].Vxx_rtn_frm_tco Vtx_frm[8].Vxx_rtn_mv_ad_fac Vtx_frm[8].Vxx_rtn_rich_loop_ti_fac Vtx_frm[8].Vbx_rtn_clos_o2_phs Vtx_frm[8].Vxx_rtn_mat Vtx_frm[8].Vxx_rtn_clr_dist Vtx_frm[8].Vxx_ind_xxx Vtx_frm[8].Vxx_rtn_maf Vtx_frm[8].Vxx_rtn_rail_prs Vtx_frm[8].Vxx_rtn_tia Vtx_frm[8].Vxx_dgdftmng_priority Vtx_frm[8].Vxx_rtn_rvac Vtx_frm[9].Vxx_rtn_n01 Vtx_frm[9].Vxx_obd_fail_code Vtx_frm[9].Vxx_rtn_eal Vtx_frm[9].Vxx_rtn_vs Vtx_frm[9].Vxx_rtn_map Vtx_frm[9].Vxx_rtn_frm_tco Vtx_frm[9].Vxx_rtn_mv_ad_fac Vtx_frm[9].Vxx_rtn_rich_loop_ti_fac Vtx_frm[9].Vbx_rtn_clos_o2_phs Vtx_frm[9].Vxx_rtn_mat Vtx_frm[9].Vxx_rtn_clr_dist Vtx_frm[9].Vxx_ind_xxx Vtx_frm[9].Vxx_rtn_maf Vtx_frm[9].Vxx_rtn_rail_prs Vtx_frm[9].Vxx_rtn_tia Vtx_frm[9].Vxx_dgdftmng_priority Vtx_frm[9].Vxx_rtn_rvac Sxx_sel_frm Vbx_rtn_clos_o2_phs Vxx_obd_fail_code Vxx_rtn_clr_dist Vxx_rtn_eal Vxx_rtn_frm_tco Vxx_rtn_maf Vxx_rtn_map Vxx_rtn_mat Vxx_rtn_mv_ad_fac Vxx_rtn_n01 Vxx_rtn_rail_prs Vxx_rtn_rich_loop_ti_fac Vxx_rtn_rvac Vxx_rtn_tia Vxx_rtn_vs /end OUT_MEASUREMENT
/end FUNCTION
/begin FUNCTION DgDftMng_Obdenvx ""
 /begin DEF_CHARACTERISTIC Cxx_amp_obd_diag_ena_thd Cxx_mat_obd_diag_ena_thd Cxx_tco_obd_diag_ena_thd Cxx_vb_obd_diag_ena_thd /end DEF_CHARACTERISTIC
 /begin OUT_MEASUREMENT Vbx_amp_obd_diag_ena Vbx_min_fuel_obd_diag_ena Vbx_temp_obd_diag_ena Vbx_vb_obd_diag_ena /end OUT_MEASUREMENT
/end FUNCTION
/begin FUNCTION DgDftMng_Obdrdnx ""
 /begin OUT_MEASUREMENT Vbx_obd_rdn_cata_cpt Vbx_obd_rdn_cpt Vbx_obd_rdn_egr_vvt Vbx_obd_rdn_evap Vbx_obd_rdn_fsys Vbx_obd_rdn_full Vbx_obd_rdn_heat Vbx_obd_rdn_heat_cata Vbx_obd_rdn_lbup_cpt Vbx_obd_rdn_mis /end OUT_MEASUREMENT
/end FUNCTION
/begin FUNCTION InAtiDli "" /begin SUB_FUNCTION InAtiDli_So2dwsr InAtiDli_Lbdwfil /end SUB_FUNCTION /end FUNCTION
/begin FUNCTION InAtiDli_So2dwsr ""
 /begin DEF_CHARACTERISTIC Cbx_lbdw_osp_conf Cxx_air_wht_fmt_fac Cxx_dfdec_inj_ecu_lbdw_icp Cxx_dfdec_lbdw_oc Cxx_dfdec_lbdw_scg Cxx_dfdec_lbdw_scw Cxx_dfinc_inj_ecu_lbdw_icp Cxx_dfinc_lbdw_oc Cxx_dfinc_lbdw_scg Cxx_dfinc_lbdw_scw Cxx_lbdw_hot_stt_t Cxx_lbdw_oc_air_wht Cxx_lbdw_oc_det_h_v Cxx_lbdw_osp_oc_det_h_v Cxx_lbdw_osp_oc_det_l_v Cxx_lbdw_osp_scg_det_v Cxx_lbdw_osp_scw_det_v Cxx_lbdw_pump_crt_t Cxx_lbdw_pump_crt_v_thd Cxx_lbdw_scg_det_v Cxx_lbdw_scw_det_v /end DEF_CHARACTERISTIC
 /begin OUT_MEASUREMENT Vbx_df_inj_ecu_lbdw_icp Vbx_df_lbdw_oc Vbx_df_lbdw_scg Vbx_df_lbdw_scw Vbx_diag_ena_inj_ecu_lbdw_icp Vbx_diag_ena_lbdw_oc Vbx_diag_ena_lbdw_scg Vbx_diag_ena_lbdw_scw Vbx_lbdw_diag_ena Vsx_lbdw_vld Vxx_cata_air_wht Vxx_lbdw_diag_ena Vxx_lbdw_pump_crt_t /end OUT_MEASUREMENT
/end FUNCTION
/begin FUNCTION InAtiDli_Lbdwfil "" /begin DEF_CHARACTERISTIC Cxx_lbdw_cata_fil_ftc Cxx_lbdw_h_lvl_fil_ftc /end DEF_CHARACTERISTIC
 /begin OUT_MEASUREMENT Vbx_stop_stal_eng Vbx_stop_stal_eng_not_1 Vbx_stop_stal_eng_not_2 Vxx_lbdw_cata_fil_val Vxx_lbdw_h_lvl_fil_val /end OUT_MEASUREMENT
/end FUNCTION
/begin FUNCTION AsAerVvt "VVT Command" /begin SUB_FUNCTION AsAerVvt_Inspxxx AsAerVvt_Inspclc AsAerVvt_Routmng /end SUB_FUNCTION /end FUNCTION
/begin FUNCTION AsAerVvt_Inspxxx ""
 /begin DEF_CHARACTERISTIC Ctb_in_vvtc_angl_sp_ftc_n Ctb_tq_rat Cmp_n_tq_cwup_vvtc_in_angl Cmp_n_tq_vvtc_in_angl Ctp_in_vvtc_angl_sp_ftc Ctp_n_vvtc_trs_in_angl Ctp_trs_in_vvtc_angl_sp_ftc Cxx_vvtc_angl_dec_slop Cxx_vvtc_angl_inc_slop Cxx_vvtc_angl_trs_dly Cxx_vvtc_trs_amp_thd Cxx_vvtc_trs_dly Cxx_vvtc_trs_n_thd Cxx_vvtc_trs_tco_thd Cxx_vvtc_trs_vs_thd /end DEF_CHARACTERISTIC
 /begin OUT_MEASUREMENT Vbx_vvtc_spg_trs_cdn Vbx_vvtc_trs Vxx_cata_wup_vvtc_in_angl Vxx_vvtc_in_angl_sp_nom Vxx_vvtc_in_angl_sp_tgt Vxx_vvtc_in_angl_sp_trs Vxx_vvtc_in_angl_sp_wup Vxx_vvtc_in_angl_sp_wup_raw /end OUT_MEASUREMENT
/end FUNCTION
/begin FUNCTION AsAerVvt_Inspclc ""
 /begin DEF_CHARACTERISTIC Ctb_in_vvtc_act_cold_temp_n_bkp Ctb_in_vvtc_act_hot_temp_n_bkp Ctb_in_vvtc_angl_sp_cyc_t_bkp Ctp_in_vvtc_act_cold_temp_thd Ctp_in_vvtc_act_hot_thd_1 Ctp_in_vvtc_act_hot_thd_2 Ctp_in_vvtc_angl_sp_cyc Cbx_in_vvtc_angl_sp_cho Cbx_in_vvtc_angl_sp_cho_bch Cbx_in_vvtc_cho_angl_vld Cbx_in_vvtc_cho_sldv_vld Cbx_in_vvtc_cho_tco_toil_cold Cbx_in_vvtc_cho_tco_toil_hot Cbx_in_vvtc_cold_act_cdn Cbx_in_vvtc_hot_act_cdn Cxx_in_vvtc_act_cold_temp_hys Cxx_in_vvtc_act_ena_max_vb_thd Cxx_in_vvtc_act_ena_min_vb_thd Cxx_in_vvtc_act_ena_n_hys Cxx_in_vvtc_act_ena_n_thd Cxx_in_vvtc_act_ena_vb_hys Cxx_in_vvtc_act_hot_temp_hys_1 Cxx_in_vvtc_act_hot_temp_hys_2 Cxx_in_vvtc_angl_sp_bch Cxx_in_vvtc_angl_sp_cyc_t Cxx_in_vvtc_angl_sp_h_lim_thd Cxx_in_vvtc_dsb_ena_fil_inc Cxx_in_vvtc_eng_wup_t Cxx_in_vvtc_inh_h_n_hys Cxx_in_vvtc_inh_h_n_thd Cxx_in_vvtc_n_thd_inh_hot Cxx_in_vvtc_sldv_ena_n_hys Cxx_in_vvtc_sldv_ena_n_thd Cxx_in_vvtc_t_ena_sldv_cyc Cxx_in_vvtc_temp_thd_max_sldv Cxx_in_vvtc_temp_thd_min_sldv /end DEF_CHARACTERISTIC
 /begin OUT_MEASUREMENT Vbx_in_vvtc_act_ena_vb Vbx_in_vvtc_ena_run Vbx_in_vvtc_ena_sldv_cln Vbx_in_vvtc_h_n_inh Vbx_in_vvtc_inh_zon Vbx_in_vvtc_risk_zon Vbx_in_vvtc_sp_fail Vxx_in_vvtc_act_ena_fac Vxx_in_vvtc_angl_sp Vxx_in_vvtc_angl_sp_bch Vxx_in_vvtc_angle_sp_cyc_t /end OUT_MEASUREMENT
/end FUNCTION
/begin FUNCTION AsAerVvt_Routmng ""
 /begin DEF_CHARACTERISTIC Ctb_diag_in_vvtc_sp_cyc_t_bkp Ctp_diag_in_vvtc_angl_sp_cyc Cxx_diag_in_vvtc_n_ena_thd Cxx_diag_in_vvtc_n_nok_drg_test Cxx_diag_in_vvtc_n_stab_t Cxx_diag_in_vvtc_n_sub_val Cxx_diag_in_vvtc_sp_cyc_t /end DEF_CHARACTERISTIC
 /begin OUT_MEASUREMENT Vbx_diag_in_vvtc_ena_bgin_test Vbx_diag_in_vvtc_n_cdn_ok Vbx_diag_in_vvtc_nok_n_cdn Vbx_diag_in_vvtc_test_ok Vbx_diag_sta_vvtc_abrt Vbx_diag_sta_vvtc_ena Vbx_diag_sta_vvtc_end Vsx_diag_sta_vvtc_stt Vxx_diag_in_vvtc_n_sub_val Vxx_diag_in_vvtc_sp_cyc_t Vxx_diag_in_vvtc_sp_sub_val /end OUT_MEASUREMENT
/end FUNCTION
/begin FUNCTION BoCboUlo ""
 /begin OUT_MEASUREMENT Vbx_df_lbup_hot_oc Vbx_df_lbup_hot_scg Vbx_df_lbup_hot_scw Vbx_diag_ena_lbup_hot_oc Vbx_diag_ena_lbup_hot_scg Vbx_diag_ena_lbup_hot_scw Vxx_lbup_heat_crt Vxx_lbup_heat_crt_prv cdn_diag_lsh_up err_diag_lsh_up /end OUT_MEASUREMENT
/end FUNCTION
/begin FUNCTION BoAtoDlo ""
 /begin OUT_MEASUREMENT Vbx_df_lbdw_hot_oc Vbx_df_lbdw_hot_scg Vbx_df_lbdw_hot_scw Vbx_diag_ena_lbdw_hot_oc Vbx_diag_ena_lbdw_hot_scg Vbx_diag_ena_lbdw_hot_scw Vxx_lbdw_heat_crt Vxx_lbdw_heat_crt_prv cdn_diag_lsh_down err_diag_lsh_down /end OUT_MEASUREMENT
/end FUNCTION
/begin FUNCTION BoCboFuo ""
 /begin DEF_CHARACTERISTIC Cxx_cp_frq_1 Cxx_cp_frq_2 c_cppwm_diag_max_scg c_cppwm_diag_min_oc c_cppwm_diag_min_scp c_ctr_pulse_cps_dly c_ctr_pulse_elead c_diag_elead_el_off_0 c_diag_elead_el_off_1 c_diag_elead_el_off_2 c_diag_elead_el_off_3 c_diag_elead_el_off_4 c_diag_elead_el_off_5 c_diag_elead_el_on_0 c_elead_frq_min c_max_err_elead_scp /end DEF_CHARACTERISTIC
 /begin OUT_MEASUREMENT Vbx_df_cp_oc Vbx_df_cp_scg Vbx_df_cp_scw Vbx_df_efi_sldv_2_oc Vbx_df_efi_sldv_2_scg Vbx_df_efi_sldv_2_scw Vbx_df_eva_sldv_oc Vbx_df_eva_sldv_scg Vbx_df_eva_sldv_scw Vbx_df_gas_pump_2_oc Vbx_df_gas_pump_2_scg Vbx_df_gas_pump_2_scw Vbx_df_gas_pump_oc Vbx_df_gas_pump_scg Vbx_df_gas_pump_scw Vbx_diag_ena_cp_oc Vbx_diag_ena_cp_scg Vbx_diag_ena_cp_scw Vbx_diag_ena_efi_sldv_2_oc Vbx_diag_ena_efi_sldv_2_scg Vbx_diag_ena_efi_sldv_2_scw Vbx_diag_ena_eva_sldv_oc Vbx_diag_ena_eva_sldv_scg Vbx_diag_ena_eva_sldv_scw Vbx_diag_ena_gas_pump_2_oc Vbx_diag_ena_gas_pump_2_scg Vbx_diag_ena_gas_pump_2_scw Vbx_diag_ena_gas_pump_oc Vbx_diag_ena_gas_pump_scg Vbx_diag_ena_gas_pump_scw cdn_diag_el_cps cdn_diag_elead_el cdn_diag_rly_fpmp_add_el cdn_diag_rly_fpmp_el ctr_err_elead_scp ctr_pulse_cps_dly ctr_pulse_elead elead_frq elead_frq_fil eleadpwm err_diag_el_cps err_diag_elead_el err_diag_rly_fpmp_add_el err_diag_rly_fpmp_el lv_aft_conf lv_diag_elead_scp_end lv_efpump lv_elead_off lv_err_diag_elead_el_scp lv_ftl_add_low lv_pulse_cps lv_pulse_cps_tmp lv_pulse_elead_ack lv_pulse_elead_end lv_pulse_elead_req lv_rly_fpmp_add v_adc_pulse_elead v_diag_elead vp_efpump cppwm frq_req_cp lv_rly_fpmp_position /end OUT_MEASUREMENT
/end FUNCTION
/begin FUNCTION ClCooCtl "" /begin OUT_MEASUREMENT Vbx_eng_off_mdf1_mem /end OUT_MEASUREMENT /begin SUB_FUNCTION ClCooCtl_Fanxxxx ClCooCtl_Fanmexx ClCooCtl_Fanrqbc /end SUB_FUNCTION /end FUNCTION
/begin FUNCTION ClCooCtl_Fanxxxx ""
 /begin DEF_CHARACTERISTIC Cbx_eng_stop_mdf_cho Cxx_ac_dsb_tco_thd Cxx_ac_dsb_tco_thd_h Cxx_ac_ena_tco_thd Cxx_ac_ena_tco_thd_h Cxx_cmd_mdf_dly Cxx_mdf1_cmd_ena_thd_tco_h Cxx_mdf1_off_tco_thd Cxx_mdf1_off_tco_thd_h Cxx_mdf1_on_tco_thd Cxx_mdf1_on_tco_thd_h Cxx_mdf1_on_tco_thd_hys Cxx_mdf1_on_tco_thd_hys_h Cxx_mdf2_off_tco_thd Cxx_mdf2_off_tco_thd_h Cxx_mdf2_on_tco_thd Cxx_mdf2_on_tco_thd_h Cxx_mdf_1_cmd_ena_thd_tco Cxx_mon_stop_tco_thd Cxx_mon_stop_tco_thd_h Cxx_run_mdf1_off_tco_thd Cxx_run_mdf1_off_tco_thd_h Cxx_tco_fail_cmd_mdf_dly Cxx_tco_mdf_dly /end DEF_CHARACTERISTIC
 /begin OUT_MEASUREMENT Vbx_eng_aut_fan Vbx_eng_mdf1 Vbx_eng_mdf1_dly Vbx_eng_mdf1_req Vbx_eng_mdf2 Vbx_eng_mdf2_req Vbx_eng_off_mdf1 Vbx_mdf1 Vbx_mdf2 Vbx_mdf_pws Vbx_tco_ac_dsb /end OUT_MEASUREMENT
/end FUNCTION
/begin FUNCTION ClCooCtl_Fanmexx "" /begin OUT_MEASUREMENT Vbx_eng_off_mdf1_on /end OUT_MEASUREMENT /end FUNCTION
/begin FUNCTION ClCooCtl_Fanrqbc "" /begin OUT_MEASUREMENT Vbx_mdf1_comb_mod_req Vbx_mdf2_comb_mod_req /end OUT_MEASUREMENT /end FUNCTION
/begin FUNCTION TqLimOvt "" /begin SUB_FUNCTION TqLimOvt_Ovetoxx TqLimOvt_Alcoxxx /end SUB_FUNCTION /end FUNCTION
/begin FUNCTION TqLimOvt_Ovetoxx ""
 /begin DEF_CHARACTERISTIC Ctb_n_ovt_tq Cmp_ovt_tq Ctd_ovt_tq_t_max Ctp_ovt_lim_amp Ctp_ovt_lim_mat Ctp_ovt_lim_tco Ctp_ovt_lim_toil Cxx_ovt_inc_neg Cxx_ovt_n_thd Cxx_ovt_neg_fac Cxx_ovt_ovn_ofs Cxx_ovt_tq_dly_max Cxx_ovt_tq_fac_thd Cxx_ovt_tq_max Cxx_ovt_tq_ofs_thd Cxx_ovt_tq_slop_neg Cxx_ovt_tq_slop_pos /end DEF_CHARACTERISTIC
 /begin OUT_MEASUREMENT Vbx_ovt_ena Vxx_ovt_egy_fac Vxx_ovt_fac_dly Vxx_ovt_fac_lim Vxx_ovt_tq_appl Vxx_ovt_tq_ofs_raw Vxx_ovt_tq_raw /end OUT_MEASUREMENT
/end FUNCTION
/begin FUNCTION TqLimOvt_Alcoxxx "" /begin DEF_CHARACTERISTIC Ctb_ovt_fuel_typ_rat Ctp_ovt_lim_fuel_typ_rat /end DEF_CHARACTERISTIC /begin OUT_MEASUREMENT Vxx_ovt_fuel_typ_fac /end OUT_MEASUREMENT /end FUNCTION
/begin FUNCTION TqLimLos "" /begin SUB_FUNCTION TqLimLos_Lossxxx TqLimLos_Rubtqxx TqLimLos_Ptqxxxx /end SUB_FUNCTION /end FUNCTION
/begin FUNCTION TqLimLos_Lossxxx ""
 /begin DEF_CHARACTERISTIC Cbx_is_ad_eng_tql_cmf Cxx_pwst_off_is_cor_dly Cxx_pwst_prs_tql /end DEF_CHARACTERISTIC
 /begin OUT_MEASUREMENT Vsx_eng_tql_vld Vxx_aux_tql_sp Vxx_eng_tql Vxx_is_tql /end OUT_MEASUREMENT
/end FUNCTION
/begin FUNCTION TqLimLos_Rubtqxx "" /begin DEF_CHARACTERISTIC Cmp_tql_eng_frn Cbx_tql_temp_cfm /end DEF_CHARACTERISTIC /begin OUT_MEASUREMENT Vsx_tql_eng_frn_vld Vxx_tql_eng_frn /end OUT_MEASUREMENT /end FUNCTION
/begin FUNCTION TqLimLos_Ptqxxxx ""
 /begin DEF_CHARACTERISTIC Ctb_ptq_dp_form_fac Ctp_ptq_dp_form_fac Cbx_ptq_ex_prs_mdl_ok_cfm Cxx_ptq_ftc Cxx_ptq_max Cxx_ptq_min /end DEF_CHARACTERISTIC
 /begin OUT_MEASUREMENT Vsx_ptq_vld Vxx_dp Vxx_dp_fil Vxx_ptq /end OUT_MEASUREMENT
/end FUNCTION
/begin FUNCTION BoCloCoo "" /begin DEF_CHARACTERISTIC c_diag_wpmp c_wpmp_swi_on /end DEF_CHARACTERISTIC
 /begin OUT_MEASUREMENT Vbx_df_wpmp_tcr_blk Vbx_df_wpmp_tcr_oc Vbx_df_wpmp_tcr_scg Vbx_df_wpmp_tcr_scw Vbx_diag_ena_wpmp_tcr_blk Vbx_diag_ena_wpmp_tcr_oc Vbx_diag_ena_wpmp_tcr_scg Vbx_diag_ena_wpmp_tcr_scw cdn_diag_oil_heat_el cdn_diag_wpmp_el ctr_swi_on err_diag_oil_heat_el err_diag_wpmp_el lv_end_pump_stuck lv_err_wpmp_el_scp lv_pulse_ack lv_pulse_req lv_sta_mem_wpmp lv_start_pump_stuck lv_wpmp_on lv_wpmp_position lv_wpmp_swi_on lv_wtpump v_adc_pulse v_diag_stu_mv_1 v_diag_stu_mv_2 v_diag_wpmp vp_wtpump /end OUT_MEASUREMENT
/end FUNCTION
/begin FUNCTION TqMdlFsp ""
 /begin SUB_FUNCTION TqMdlFsp_Efyigxx TqMdlFsp_Estixxx TqMdlFsp_Laefyxx TqMdlFsp_Tqefyxx TqMdlFsp_Injctxx TqMdlFsp_Cdytqxx TqMdlFsp_Ivltqxx TqMdlFsp_Wefrixx /end SUB_FUNCTION
/end FUNCTION
/begin FUNCTION TqMdlFsp_Efyigxx "" /begin DEF_CHARACTERISTIC Ctp_iga_dif Ctp_iga_dif_sq /end DEF_CHARACTERISTIC /begin OUT_MEASUREMENT Vxx_iga Vxx_raw_iga /end OUT_MEASUREMENT /end FUNCTION
/begin FUNCTION TqMdlFsp_Estixxx ""
 /begin OUT_MEASUREMENT Vxx_appl_iga_efy Vxx_appl_iga_efy_2 Vxx_esti_tqe Vxx_esti_tqe_tgt Vxx_esti_tqi /end OUT_MEASUREMENT
/end FUNCTION
/begin FUNCTION TqMdlFsp_Laefyxx "" /begin OUT_MEASUREMENT Vxx_iga_efy Vxx_raw_iga_efy /end OUT_MEASUREMENT /end FUNCTION
/begin FUNCTION TqMdlFsp_Tqefyxx "" /begin DEF_CHARACTERISTIC Cxx_dz_iga_efv /end DEF_CHARACTERISTIC /begin OUT_MEASUREMENT Vbx_no_ajs_tq_efy_cut Vxx_ajs_tq_efy Vxx_no_ajs_tq_efy /end OUT_MEASUREMENT /end FUNCTION
/begin FUNCTION TqMdlFsp_Injctxx "" /begin DEF_CHARACTERISTIC Ntb_cyl Ctd_inj_efy_dz Cxx_cut_efy_dz Cxx_lih_inj_cut_nr /end DEF_CHARACTERISTIC
 /begin OUT_MEASUREMENT Vbx_cut Vbx_cut_it_dft Vxx_cut_efy_dz Vxx_cyl_cut_tq_efy Vxx_h_req_inj_cut_nr Vxx_inj_efy_dz Vxx_req_inj_cut_nr Vxx_req_inj_cut_nr_1 /end OUT_MEASUREMENT
/end FUNCTION
/begin FUNCTION TqMdlFsp_Cdytqxx ""
 /begin DEF_CHARACTERISTIC Cbx_maf_efy_cor_ena_cfm Cbx_maf_efy_tkof_cfm Cbx_maf_efy_tq_trs_cfm Cxx_eal_maf_efy_ena_thd Cxx_h_maf_efy_thd Cxx_l_maf_efy_dly Cxx_l_maf_efy_neg_slop Cxx_l_maf_efy_pos_slop Cxx_l_maf_efy_thd Cxx_maf_cor_efy_dz Cxx_maf_efy_is_ena_thd Cxx_maf_efy_neg_slop Cxx_mfld_vol_fac Cxx_n_maf_efy_ena_thd Cxx_sta_l_maf_efy_thd Cxx_tkof_h_maf_efy_thd /end DEF_CHARACTERISTIC
 /begin OUT_MEASUREMENT Vbx_is_maf_efy_ena Vbx_l_maf_coup_cdn Vxx_cdytq_air_dly_t Vxx_eng_maf_efy_cor Vxx_h_maf_efy_thd Vxx_l_maf_efy_thd Vxx_maf_cyl_mdl Vxx_maf_efy_cor Vxx_maf_efy_ena_fac Vxx_maf_eng_mdl Vxx_maf_it_mdl Vxx_map_eng_mdl Vxx_prs_rat_mdl Vxx_raw_maf_cyl_mdl Vxx_raw_maf_efy_cor Vxx_sat_maf_efy_cor /end OUT_MEASUREMENT
/end FUNCTION
/begin FUNCTION TqMdlFsp_Ivltqxx "" /begin DEF_CHARACTERISTIC Cbx_n_tq_fct_vld2_cfm /end DEF_CHARACTERISTIC /begin OUT_MEASUREMENT Vsx_tq_fct_vld /end OUT_MEASUREMENT /end FUNCTION
/begin FUNCTION TqMdlFsp_Wefrixx "" /begin DEF_CHARACTERISTIC Cxx_rich_dstb_cor_efy_fac Cxx_rich_dstb_cor_efy_fac_alco /end DEF_CHARACTERISTIC /begin OUT_MEASUREMENT Vxx_rich_dstb_cor_efy /end OUT_MEASUREMENT /end FUNCTION
/begin FUNCTION TqMdlSsp ""
 /begin SUB_FUNCTION TqMdlSsp_Tqiopxx TqMdlSsp_Airspxx TqMdlSsp_Igefyxx TqMdlSsp_Isefyxx TqMdlSsp_Wuefyxx TqMdlSsp_Iswuefy TqMdlSsp_Alcoxxx /end SUB_FUNCTION
/end FUNCTION
/begin FUNCTION TqMdlSsp_Tqiopxx ""
 /begin DEF_CHARACTERISTIC Ctb_rich_sp Cmp_n_eal_otl_tqi_fac Ctp_rich_otl_iga_tqi_fac Cxx_otl_iga_tqi /end DEF_CHARACTERISTIC
 /begin OUT_MEASUREMENT Vsx_otl_iga_mv_tqi_vld Vxx_otl_iga_mv_tqi Vxx_otl_iga_mv_tqi_gas /end OUT_MEASUREMENT
/end FUNCTION
/end MODULE
/end PROJECT
