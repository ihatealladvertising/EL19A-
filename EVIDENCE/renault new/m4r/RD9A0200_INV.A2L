ASAP2_VERSION 1 41
/begin PROJECT RD8 "_default_ProjectLongIdentifier"
/begin HEADER "_default_HeaderComment" PROJECT_NO RD9 /end HEADER
/begin MODULE _default_ModuleName "_default_ModuleLongIdentifier"
/begin MOD_COMMON "_default_ModCommonComment" DEPOSIT ABSOLUTE BYTE_ORDER MSB_LAST ALIGNMENT_BYTE 1 ALIGNMENT_WORD 2 ALIGNMENT_LONG 2 ALIGNMENT_FLOAT32_IEEE 2 ALIGNMENT_FLOAT64_IEEE 4 /end MOD_COMMON
/begin AXIS_PTS Ntb_gear "Gearbox ratio breakpoint" 0xa002da28 Vxx_gear _REC_A2AXS_20_u1 7. _CNV_A_R_LINEAR_____145_CM 8 -1. 6. READ_ONLY FORMAT "%2.0" /end AXIS_PTS
/begin AXIS_PTS Ctb_cru_sl_vs "Speed breakpoints " 0xa002f0b0 Vxx_vs _REC_A2AXS_20_u1 255. _CNV_A_R_LINEAR_____71_CM 17 0. 255. FORMAT "%3.0" /end AXIS_PTS
/begin CHARACTERISTIC Ctp_dyn_forc "Cartography of resistive effort function of vehicle speed" CURVE 0xa002f0c4 _REC_A1CUR_20_u1_u1 6375. _CNV_A_R_LINEAR_____466_CM 0. 6375. FORMAT "%4.0"
 /begin AXIS_DESCR COM_AXIS Vxx_vs _CNV_A_R_LINEAR_____71_CM 17 0. 255. FORMAT "%3.0" AXIS_PTS_REF Ctb_cru_sl_vs /end AXIS_DESCR
/end CHARACTERISTIC
/begin MEASUREMENT Vbx_cru_act "Initialize the CC servo-control speed reference" UBYTE _CNV_S_2_RANGE______3_CM 1 0. 0. 1. ECU_ADDRESS 0xd0006f35 BIT_MASK 0x1 /end MEASUREMENT
/begin MEASUREMENT Vbx_cru_mstr "Arbitrated powertrain setpoint equal to Cruise Control setpoint" UBYTE _CNV_S_2_RANGE______3_CM 1 0. 0. 1. ECU_ADDRESS 0xd0006f36 BIT_MASK 0x1 /end MEASUREMENT
/begin MEASUREMENT Vbx_cru_mstr_prev "Arbitrated powertrain setpoint equal to Cruise Control setpoint" UBYTE _CNV_S_2_RANGE______3_CM 1 0. 0. 1. ECU_ADDRESS 0xd0006f37 BIT_MASK 0x1 /end MEASUREMENT
/begin MEASUREMENT Vbx_cru_sl_svkl_act "Control loop active" UBYTE _CNV_S_2_RANGE______3_CM 1 0. 0. 1. ECU_ADDRESS 0xd0006f38 BIT_MASK 0x1 /end MEASUREMENT
/begin MEASUREMENT Vbx_csl_mstr "Arbitrated powertrain setpoint equal to Costumer Speed limiter setpoint" UBYTE _CNV_S_2_RANGE______3_CM 1 0. 0. 1. ECU_ADDRESS 0xd0006f39 BIT_MASK 0x1 /end MEASUREMENT
/begin MEASUREMENT Vxx_cru_fil_vs_ref "CC filtred speed at the corrector input" UWORD _CNV_A_R_LINEAR_____125_CM 1 0. 0. 655.35 ECU_ADDRESS 0xd00046a8 FORMAT "%6.2" /end MEASUREMENT
/begin MEASUREMENT Vxx_cru_fil_vs_ref_init "First of previous CC filtred speed at the corrector input" UWORD _CNV_A_R_LINEAR_____125_CM 1 0. 0. 655.35 ECU_ADDRESS 0xd00046aa FORMAT "%6.2" /end MEASUREMENT
/begin MEASUREMENT Vxx_cru_fil_vs_ref_prev "Previous CC filtred speed at the corrector input" UWORD _CNV_A_R_LINEAR_____125_CM 1 0. 0. 655.35 ECU_ADDRESS 0xd00046ac FORMAT "%6.2" /end MEASUREMENT
/begin MEASUREMENT Vxx_cru_forc_sp_nom "Driving force requested by Cruise Control" SLONG _CNV_A_R_LINEAR_____361_CM 1 0. -20000. 111068. ECU_ADDRESS 0xd0002988 FORMAT "%6.0" /end MEASUREMENT
/begin MEASUREMENT Vxx_cru_sl_dyn_forc_ini "Initial resistive force (function of the vehicle speed)" UBYTE _CNV_A_R_LINEAR_____466_CM 1 0. 0. 6375. ECU_ADDRESS 0xd0006f3a FORMAT "%4.0" /end MEASUREMENT
/begin MEASUREMENT Vxx_cru_sl_fil_vs_ref "Filtered speed at the corrector input" UWORD _CNV_A_R_LINEAR_____125_CM 1 0. 0. 655.35 ECU_ADDRESS 0xd00046ae FORMAT "%6.2" /end MEASUREMENT
/begin MEASUREMENT Vxx_cru_sl_forc_ref "Force request delivred by the control loop of the cruise control and speed limiter strategy" SLONG _CNV_A_R_LINEAR_____361_CM 1 0. -20000. 111068. ECU_ADDRESS 0xd000298c FORMAT "%6.0" /end MEASUREMENT
/begin MEASUREMENT Vxx_cru_sl_svkl_acel_ref "Acceleration command delivred by the control loop" SWORD _CNV_A_R_LINEAR_____467_CM 1 0. -62.5 62.4980926513672 ECU_ADDRESS 0xd00046b0 FORMAT "%2.4" /end MEASUREMENT
/begin MEASUREMENT Vxx_cru_sl_svkl_forc "Force command delivered by the control loop" SWORD _CNV_A_R_LINEAR_____468_CM 1 0. -32768. 32767. ECU_ADDRESS 0xd00046b2 FORMAT "%10.0" /end MEASUREMENT
/begin MEASUREMENT Vxx_cru_sl_svkl_forc_ref "Total wheel force command delivered by the control loop" SWORD _CNV_A_R_LINEAR_____468_CM 1 0. -32768. 32767. ECU_ADDRESS 0xd00046b4 FORMAT "%5.0" /end MEASUREMENT
/begin MEASUREMENT Vxx_cru_sl_svkl_ig "Integral gain" UWORD _CNV_A_R_LINEAR_____469_CM 1 0. 0. 1953.09519763205 ECU_ADDRESS 0xd00046b6 FORMAT "%9.3" /end MEASUREMENT
/begin MEASUREMENT Vxx_cru_sl_svkl_max_i_cor "maximum value of the integral correction" SWORD _CNV_A_R_LINEAR_____467_CM 1 0. -62.5 62.4980926513672 ECU_ADDRESS 0xd00046b8 FORMAT "%4.1" /end MEASUREMENT
/begin MEASUREMENT Vxx_cru_sl_svkl_min_i_cor "Minimum value of the integral correction" SWORD _CNV_A_R_LINEAR_____467_CM 1 0. -62.5 62.4980926513672 ECU_ADDRESS 0xd00046ba FORMAT "%4.1" /end MEASUREMENT
/begin MEASUREMENT Vxx_cru_sl_svkl_p_cor "Propotional correction" SWORD _CNV_A_R_LINEAR_____467_CM 1 0. -62.5 62.4980926513672 ECU_ADDRESS 0xd00046bc FORMAT "%4.1" /end MEASUREMENT
/begin MEASUREMENT Vxx_cru_sl_svkl_pg "Proportional gain" UWORD _CNV_A_R_LINEAR_____470_CM 1 0. 0. 124.998092651367 ECU_ADDRESS 0xd00046be FORMAT "%9.6" /end MEASUREMENT
/begin MEASUREMENT Vxx_cru_sl_svkl_vs_i_cor "Integral correction" SLONG _CNV_A_R_LINEAR_____471_CM 1 0. -62.5 62.4999999708962 ECU_ADDRESS 0xd0002990 FORMAT "%4.1" /end MEASUREMENT
/begin MEASUREMENT Vxx_cru_sl_svkl_vs_i_cor_init "First or previous integral correction" SLONG _CNV_A_R_LINEAR_____471_CM 1 0. -62.5 62.4999999708962 ECU_ADDRESS 0xd0002994 FORMAT "%4.1" /end MEASUREMENT
/begin MEASUREMENT Vxx_cru_sl_svkl_vs_i_cor_prev "Previous integral correction" SLONG _CNV_A_R_LINEAR_____471_CM 1 0. -62.5 62.4999999708962 ECU_ADDRESS 0xd0002998 FORMAT "%4.1" /end MEASUREMENT
/begin MEASUREMENT Vxx_cru_vs_ref_ofs "Reference speed increment" UWORD _CNV_A_R_LINEAR_____472_CM 1 0. 0. 655.35 ECU_ADDRESS 0xd00046c0 FORMAT "%6.2" /end MEASUREMENT
/begin MEASUREMENT Vxx_csl_forc_sp_nom "Driving force requested by Costumer Speed Limiter" SLONG _CNV_A_R_LINEAR_____361_CM 1 0. -20000. 111068. ECU_ADDRESS 0xd000299c FORMAT "%6.0" /end MEASUREMENT
/begin MEASUREMENT Vxx_dyn_forc "Resistive force (function of the vehicle speed)" UBYTE _CNV_A_R_LINEAR_____466_CM 1 0. 0. 6375. ECU_ADDRESS 0xd0006f3b FORMAT "%4.0" /end MEASUREMENT
/begin CHARACTERISTIC Cbx_sl_max_i_cor "Enable (1) or disable (0) the ECE89 strategy" VALUE 0xa0021b54 _REC_S1VAL_20_u1 1. _CNV_S_2_RANGE______3_CM 0. 1. BIT_MASK 0x1 /end CHARACTERISTIC
/begin CHARACTERISTIC Cxx_cru_cmf_cut_forc_dec "Force decrement/s for comfortable cut-off of cruise control." VALUE 0xa0021b2e _REC_S1VAL_20_u2 131070. _CNV_A_R_LINEAR_____473_CM 0. 131070. FORMAT "%6.0" /end CHARACTERISTIC
/begin CHARACTERISTIC Cxx_cru_min_forc "Minimum saturation value of the force request (lesser than the minimum force feasible by the engine)" VALUE 0xa0021b30 _REC_S1VAL_20_s4 131068. _CNV_A_R_LINEAR_____361_CM -20000. 111068. FORMAT "%6.0" /end CHARACTERISTIC
/begin CHARACTERISTIC Cxx_cru_ref_vs_acel_grd "Acceleration gradient coefficient to calculatethe speed reference" VALUE 0xa0021b55 _REC_S1VAL_20_s1 0.255 _CNV_A_R_LINEAR_____164_CM -0.128 0.127 FORMAT "%5.3" /end CHARACTERISTIC
/begin CHARACTERISTIC Cxx_cru_ref_vs_acel_ofs "Acceleration gradient offset to calculate the speed reference for cruise control" VALUE 0xa0021b56 _REC_S1VAL_20_u1 6.375 _CNV_A_R_LINEAR_____474_CM 0. 6.375 FORMAT "%5.3" /end CHARACTERISTIC
/begin CHARACTERISTIC Cxx_cru_ref_vs_decl_grd "Deceleration gradient coefficient to calculate the speed reference" VALUE 0xa0021b57 _REC_S1VAL_20_s1 0.255 _CNV_A_R_LINEAR_____164_CM -0.128 0.127 FORMAT "%5.3" /end CHARACTERISTIC
/begin CHARACTERISTIC Cxx_cru_ref_vs_decl_ofs "Declaration gradient offset to calculate the speed reference for cruise control" VALUE 0xa0021b58 _REC_S1VAL_20_u1 6.375 _CNV_A_R_LINEAR_____474_CM 0. 6.375 FORMAT "%5.3" /end CHARACTERISTIC
/begin CHARACTERISTIC Cxx_cru_sp_acel_grd "Acceleration gradient coefficient to calculate the speed reference from the objective speed." VALUE 0xa0021b59 _REC_S1VAL_20_s1 0.255 _CNV_A_R_LINEAR_____164_CM -0.128 0.127 FORMAT "%5.3" /end CHARACTERISTIC
/begin CHARACTERISTIC Cxx_cru_sp_decl_grd "Deceleration gradient coefficient to calculate the speed reference from the objective speed" VALUE 0xa0021b5a _REC_S1VAL_20_s1 0.255 _CNV_A_R_LINEAR_____164_CM -0.128 0.127 FORMAT "%5.3" /end CHARACTERISTIC
/begin CHARACTERISTIC Cxx_cru_sp_max_forc_inc "Force gradient for comfortable cruise control activation" VALUE 0xa0021b34 _REC_S1VAL_20_u4 131070. _CNV_A_R_LINEAR_____473_CM 0. 131070. FORMAT "%6.0" /end CHARACTERISTIC
/begin CHARACTERISTIC Cxx_cru_svkl_ig "Cruise control integral gain" VALUE 0xa0021b38 _REC_S1VAL_20_u2 1953.09519763205 _CNV_A_R_LINEAR_____469_CM 0. 1953.09519763205 FORMAT "%6.1" /end CHARACTERISTIC
/begin CHARACTERISTIC Cxx_cru_svkl_max_i_cor "Maximum value of the integral correction for Cruise control " VALUE 0xa0021b3a _REC_S1VAL_20_s2 124.9980926513672 _CNV_A_R_LINEAR_____467_CM -62.5 62.4980926513672 FORMAT "%4.1" /end CHARACTERISTIC
/begin CHARACTERISTIC Cxx_cru_svkl_min_i_cor "Minimum value of the integral correction for Cruise control " VALUE 0xa0021b3c _REC_S1VAL_20_s2 124.9980926513672 _CNV_A_R_LINEAR_____467_CM -62.5 62.4980926513672 FORMAT "%4.1" /end CHARACTERISTIC
/begin CHARACTERISTIC Cxx_cru_svkl_pg "Cruise control proportinal gain" VALUE 0xa0021b3e _REC_S1VAL_20_u2 124.998092651367 _CNV_A_R_LINEAR_____470_CM 0. 124.998092651367 FORMAT "%10.6" /end CHARACTERISTIC
/begin CHARACTERISTIC Cxx_cru_svkl_vs_thd "Speed threshold to activate servo-control in case of the objective speed" VALUE 0xa0021b5b _REC_S1VAL_20_s1 255. _CNV_A_R_LINEAR_____71_CM -128. 127. FORMAT "%3.0" /end CHARACTERISTIC
/begin CHARACTERISTIC Cxx_sl_cmf_cut_forc_inc "Force increment/s for comfortable cut-of of speed limiter" VALUE 0xa0021b40 _REC_S1VAL_20_u2 131070. _CNV_A_R_LINEAR_____473_CM 0. 131070. FORMAT "%6.0" /end CHARACTERISTIC
/begin CHARACTERISTIC Cxx_sl_max_forc "Maximum saturation value of the force request (greater than the minimum force feasible by the engine)" VALUE 0xa0021b42 _REC_S1VAL_20_s4 131068. _CNV_A_R_LINEAR_____361_CM -20000. 111068. FORMAT "%6.0" /end CHARACTERISTIC
/begin CHARACTERISTIC Cxx_sl_sp_max_forc_dec "Force gradient  for comfortable speed limiter activation" VALUE 0xa0021b46 _REC_S1VAL_20_u4 131070. _CNV_A_R_LINEAR_____473_CM 0. 131070. FORMAT "%6.0" /end CHARACTERISTIC
/begin CHARACTERISTIC Cxx_sl_svkl_ig "speed limiter integral gain" VALUE 0xa0021b4a _REC_S1VAL_20_u2 1953.09519763205 _CNV_A_R_LINEAR_____469_CM 0. 1953.09519763205 FORMAT "%6.1" /end CHARACTERISTIC
/begin CHARACTERISTIC Cxx_sl_svkl_max_i_cor "Maximum value of the integral correction for speed limiter" VALUE 0xa0021b4c _REC_S1VAL_20_s2 124.9980926513672 _CNV_A_R_LINEAR_____467_CM -62.5 62.4980926513672 FORMAT "%4.1" /end CHARACTERISTIC
/begin CHARACTERISTIC Cxx_sl_svkl_min_i_cor "Minimal value of the integral correction for speed limiter" VALUE 0xa0021b4e _REC_S1VAL_20_s2 124.9980926513672 _CNV_A_R_LINEAR_____467_CM -62.5 62.4980926513672 FORMAT "%4.1" /end CHARACTERISTIC
/begin CHARACTERISTIC Cxx_sl_svkl_pg "Speed limiter proportinal gain" VALUE 0xa0021b50 _REC_S1VAL_20_u2 124.998092651367 _CNV_A_R_LINEAR_____470_CM 0. 124.998092651367 FORMAT "%10.6" /end CHARACTERISTIC
/begin CHARACTERISTIC Cxx_sl_svkl_vs_thd "Speed threshold to activate servoing in case of the speed limiter" VALUE 0xa0021b5c _REC_S1VAL_20_s1 255. _CNV_A_R_LINEAR_____71_CM -128. 127. FORMAT "%3.0" /end CHARACTERISTIC
/begin CHARACTERISTIC Cxx_vh_wht "Vehicle mass" VALUE 0xa0021b52 _REC_S1VAL_20_u2 2550. _CNV_A_R_LINEAR_____475_CM 450. 3000. FORMAT "%4.0" /end CHARACTERISTIC
/begin MEASUREMENT Vbx_sl_mstr "Arbitrated powertrain setpoint equal to Speed limiter setpoint" UBYTE _CNV_S_2_RANGE______3_CM 1 0. 0. 1. ECU_ADDRESS 0xd0006f3c BIT_MASK 0x1 /end MEASUREMENT
/begin MEASUREMENT Vxx_sl_forc_sp "Driving force requested by Speed Limiter" SLONG _CNV_A_R_LINEAR_____361_CM 1 0. -20000. 111068. ECU_ADDRESS 0xd00029a0 FORMAT "%6.0" /end MEASUREMENT
/begin MEASUREMENT Vbx_fsl_mstr "Arbitrated powertrain setpoint equal to Fixed Speed Limiter setpoint" UBYTE _CNV_S_2_RANGE______3_CM 1 0. 0. 1. ECU_ADDRESS 0xd0006f20 BIT_MASK 0x1 /end MEASUREMENT
/begin MEASUREMENT Vxx_fsl_forc_sp "Driving force requested by Fixed Speed Limiter" SLONG _CNV_A_R_LINEAR_____361_CM 1 0. -20000. 111068. ECU_ADDRESS 0xd000297c FORMAT "%6.0" /end MEASUREMENT
/begin AXIS_PTS Ntb_ex_gaz_temp "17 breakpoints for Ctp_ex_gaz_temp_ofs_maf (kg/h) and Ctp_ex_gaz_temp_ofs_maf_l (kg/h) " 0xa002ccac Vxx_pump_maf _REC_A2AXS_20_u2 3000. _CNV_A_R_LINEAR_____172_CM 17 0. 3000. READ_ONLY FORMAT "%4.3" /end AXIS_PTS
/begin AXIS_PTS Ntb_ex_gaz_temp_ofs_vs "9 breakpoints for Ctp_ex_gaz_temp_ofs_vs (km/h)" 0xa002ccd0 Vxx_vs _REC_A2AXS_20_u2 655.35 _CNV_A_R_LINEAR_____125_CM 9 0. 655.35 READ_ONLY FORMAT "%6.2" /end AXIS_PTS
/begin AXIS_PTS Ntb_map_cata_mdl_temp "17 breakpoints for Cmp_ex_gaz_map_n_temp" 0xa002cce4 Vxx_map _REC_A2AXS_20_u2 20000. _CNV_A_R_LINEAR_____115_CM 17 0. 20000. READ_ONLY FORMAT "%5.0" /end AXIS_PTS
/begin AXIS_PTS Ntb_n_cata_mdl_temp "17 breakpoints for Cmp_ex_gaz_map_n_temp (rpm)" 0xa002cd08 Vxx_n _REC_A2AXS_20_u2 16383.75 _CNV_A_R_ENSD_LINEA_22_CM 17 0. 16383.75 READ_ONLY FORMAT "%8.2" /end AXIS_PTS
/begin CHARACTERISTIC Cmp_ex_gaz_map_n_temp "Double interpolation between Ntb-map_cata_mdl_temp and Ntb_n_cata_mdl_temp" MAP 0xa002cd2c _REC_A1MAP_20_u1_u2_u2 1020. _CNV_A_R_LINEAR_____442_CM -40. 980. FORMAT "%3.0"
 /begin AXIS_DESCR COM_AXIS Vxx_map _CNV_A_R_LINEAR_____115_CM 17 0. 20000. READ_ONLY FORMAT "%5.0" AXIS_PTS_REF Ntb_map_cata_mdl_temp /end AXIS_DESCR
 /begin AXIS_DESCR COM_AXIS Vxx_n _CNV_A_R_ENSD_LINEA_22_CM 17 0. 16383.75 READ_ONLY FORMAT "%8.2" AXIS_PTS_REF Ntb_n_cata_mdl_temp /end AXIS_DESCR
/end CHARACTERISTIC
/begin CHARACTERISTIC Ctp_ex_gaz_temp_ofs_maf "Filter gain table of exhaust gaz temperature when the temperature is risen function of air flow" CURVE 0xa002ce50 _REC_A1CUR_20_u1_u2 1. _CNV_A_R_LINEAR_____162_CM 0. 1. FORMAT "%9.7"
 /begin AXIS_DESCR COM_AXIS Vxx_pump_maf _CNV_A_R_LINEAR_____172_CM 17 0. 3000. READ_ONLY FORMAT "%4.3" AXIS_PTS_REF Ntb_ex_gaz_temp /end AXIS_DESCR
/end CHARACTERISTIC
/begin CHARACTERISTIC Ctp_ex_gaz_temp_ofs_maf_l "Filter gain table of exhaust gaz temperature when the temperature is fallen function of air flow" CURVE 0xa002ce64 _REC_A1CUR_20_u1_u2 1. _CNV_A_R_LINEAR_____162_CM 0. 1. FORMAT "%9.7"
 /begin AXIS_DESCR COM_AXIS Vxx_pump_maf _CNV_A_R_LINEAR_____172_CM 17 0. 3000. READ_ONLY FORMAT "%4.3" AXIS_PTS_REF Ntb_ex_gaz_temp /end AXIS_DESCR
/end CHARACTERISTIC
/begin CHARACTERISTIC Ctp_ex_gaz_temp_ofs_vs "Offset table of exhaust gaz temperature in stabilized function of vehicle speed" CURVE 0xa002ce78 _REC_A1CUR_20_u1_u2 1020. _CNV_A_R_LINEAR_____476_CM 0. 1020. FORMAT "%4.0"
 /begin AXIS_DESCR COM_AXIS Vxx_vs _CNV_A_R_LINEAR_____125_CM 9 0. 655.35 READ_ONLY FORMAT "%6.2" AXIS_PTS_REF Ntb_ex_gaz_temp_ofs_vs /end AXIS_DESCR
/end CHARACTERISTIC
/begin MEASUREMENT Vbx_cata_temp_rise "Temperature catalyst is rising" UBYTE _CNV_S_2_RANGE______3_CM 1 0. 0. 1. ECU_ADDRESS 0xd0007b39 BIT_MASK 0x1 /end MEASUREMENT
/begin MEASUREMENT Vsx_ex_gaz_temp_fil_val_vld "Exhaust gaz temperature filter value validity status" UBYTE _CNV_S_3_STATUS_OK__179_CM 1 0. 0. 2. ECU_ADDRESS 0xd0007b3a /end MEASUREMENT
/begin MEASUREMENT Vxx_ex_gaz_fil_fac "Filter gain of exhaust gaz temperature" UBYTE _CNV_A_R_LINEAR_____162_CM 1 0. 0. 1. ECU_ADDRESS 0xd0007b3b FORMAT "%9.7" /end MEASUREMENT
/begin MEASUREMENT Vxx_ex_gaz_fil_fac_fall "Filter gain of exhaust gaz temperature when the temperature is fallen" UBYTE _CNV_A_R_LINEAR_____162_CM 1 0. 0. 1. ECU_ADDRESS 0xd0007b3c FORMAT "%9.7" /end MEASUREMENT
/begin MEASUREMENT Vxx_ex_gaz_fil_fac_inj_cut "Filter gain of exhaust gaz temperature when injection is cut" UBYTE _CNV_A_R_LINEAR_____162_CM 1 0. 0. 1. ECU_ADDRESS 0xd0007b3d FORMAT "%9.7" /end MEASUREMENT
/begin MEASUREMENT Vxx_ex_gaz_fil_fac_rise "Filter gain of exhaust gaz temperature when the temperature is risen" UBYTE _CNV_A_R_LINEAR_____162_CM 1 0. 0. 1. ECU_ADDRESS 0xd0007b3e FORMAT "%9.7" /end MEASUREMENT
/begin MEASUREMENT Vxx_ex_gaz_map_n_temp "Exhaust gaz temperature in fonction of pressure and engine speed" UBYTE _CNV_A_R_LINEAR_____442_CM 1 0. -40. 980. ECU_ADDRESS 0xd0007b3f FORMAT "%3.0" /end MEASUREMENT
/begin MEASUREMENT Vxx_ex_gaz_temp_fil_val "Exhaust gaz temperature filter value" UBYTE _CNV_A_R_LINEAR_____442_CM 1 0. -40. 980. ECU_ADDRESS 0xd0007b40 FORMAT "%3.0" /end MEASUREMENT
/begin MEASUREMENT Vxx_ex_gaz_temp_fil_val_aut "Exhaust gaz temperature filter value in engine autonomous state" UBYTE _CNV_A_R_LINEAR_____442_CM 1 0. -40. 980. ECU_ADDRESS 0xd0007b41 FORMAT "%3.0" /end MEASUREMENT
/begin MEASUREMENT Vxx_ex_gaz_temp_fil_val_hold "Exhaust gaz temperature filter value i-1" UBYTE _CNV_A_R_LINEAR_____442_CM 1 0. -40. 980. ECU_ADDRESS 0xd0007b42 FORMAT "%3.0" /end MEASUREMENT
/begin MEASUREMENT Vxx_ex_gaz_temp_fil_val_not_aut "Exhaust gaz temperature filter value in not engine autonomous state" UBYTE _CNV_A_R_LINEAR_____442_CM 1 0. -40. 980. ECU_ADDRESS 0xd0007b43 FORMAT "%3.0" /end MEASUREMENT
/begin MEASUREMENT Vxx_ex_gaz_temp_ofs_vs "Offset of exhaust gaz temperature in stabilized function of speed vehicle" UBYTE _CNV_A_R_LINEAR_____476_CM 1 0. 0. 1020. ECU_ADDRESS 0xd0007b44 FORMAT "%4.0" /end MEASUREMENT
/begin MEASUREMENT Vxx_ex_gaz_temp_val "Exhaust gaz temperature value" UBYTE _CNV_A_R_LINEAR_____442_CM 1 0. -40. 980. ECU_ADDRESS 0xd0007b45 FORMAT "%3.0" /end MEASUREMENT
/begin MEASUREMENT Vxx_ex_gaz_temp_val_aut "Exhaust gaz temperature value in autonomous engine state" UBYTE _CNV_A_R_LINEAR_____442_CM 1 0. -40. 980. ECU_ADDRESS 0xd0007b46 FORMAT "%3.0" /end MEASUREMENT
/begin MEASUREMENT Vxx_ex_gaz_temp_val_not_aut "Exhaust gaz temperature value in not engine autonomous state" UBYTE _CNV_A_R_LINEAR_____442_CM 1 0. -40. 980. ECU_ADDRESS 0xd0007b47 FORMAT "%3.0" /end MEASUREMENT
/begin CHARACTERISTIC Cxx_ex_gaz_fil_fac_inj "Filter gain of exhaust gaz temperature in injection cut calibration" VALUE 0xa0021352 _REC_S1VAL_20_u1 1. _CNV_A_R_LINEAR_____162_CM 0. 1. FORMAT "%9.7" /end CHARACTERISTIC
/begin AXIS_PTS Ctb_ovt_acel_pdl_dif_thd "Driver sportivy factor breakpoint table for overtorque pedal difference threshold" 0xa0021bae Vxx_driv_spt_fac _REC_A2AXS_20_u1 1. _CNV_A_R_LINEAR_____477_CM 5 0. 1. FORMAT "%9.7" /end AXIS_PTS
/begin CHARACTERISTIC Ctp_ovt_acel_pdl_dif_thd "Accelerator pedal difference threshold for driver overtorque request" CURVE 0xa002f0d8 _REC_A1CUR_20_u2_u1 1.25 _CNV_A_R_LINEAR_____267_CM 0. 1.25 FORMAT "%7.5"
 /begin AXIS_DESCR COM_AXIS Vxx_driv_spt_fac _CNV_A_R_LINEAR_____477_CM 5 0. 1. FORMAT "%9.7" AXIS_PTS_REF Ctb_ovt_acel_pdl_dif_thd /end AXIS_DESCR
/end CHARACTERISTIC
/begin MEASUREMENT Vbx_driv_ovt_req "Activation of overtorque function requested by driver actions" UBYTE _CNV_S_2_RANGE______3_CM 1 0. 0. 1. ECU_ADDRESS 0xd0007004 BIT_MASK 0x1 /end MEASUREMENT
/begin CHARACTERISTIC Cbx_driv_ovt_req_100_rat_cfm "Inhibition of systematic driver overtorque request when accel pedal depressed by 100% ratio" VALUE 0xa0021bb4 _REC_S1VAL_20_u1 1. _CNV_S_2_RANGE______3_CM 0. 1. /end CHARACTERISTIC
/begin CHARACTERISTIC Cbx_driv_ovt_req_dsb_cfm "Global inhibition of driver overtorque request" VALUE 0xa0021bb5 _REC_S1VAL_20_u1 1. _CNV_S_2_RANGE______3_CM 0. 1. /end CHARACTERISTIC
/begin CHARACTERISTIC Cbx_driv_ovt_req_kd_cfm "Inhibition of systematic overtorque request in KD" VALUE 0xa0021bb6 _REC_S1VAL_20_u1 1. _CNV_S_2_RANGE______3_CM 0. 1. /end CHARACTERISTIC
/begin CHARACTERISTIC Cxx_ovt_acel_pdl_dif_t "Characteristic time for accelerator pedal difference calculation (for driver overtorque request cond" VALUE 0xa0021bb7 _REC_S1VAL_20_u1 2.55 _CNV_A_R_LINEAR_____32_CM 0. 2.55 FORMAT "%4.2" /end CHARACTERISTIC
/begin MEASUREMENT Vbx_tkof_fl_ena "richness increase request for take off" UBYTE _CNV_S_2_RANGE______3_CM 1 0. 0. 1. ECU_ADDRESS 0xd0007007 BIT_MASK 0x1 /end MEASUREMENT
/begin MEASUREMENT Vbx_tkof_fl_map_cdn "Condition on manifold pressure value" UBYTE _CNV_S_2_RANGE______3_CM 1 0. 0. 1. ECU_ADDRESS 0xd0007008 BIT_MASK 0x1 /end MEASUREMENT
/begin MEASUREMENT Vbx_tkof_fl_mat_cdn "Condition on manifold temperature value" UBYTE _CNV_S_2_RANGE______3_CM 1 0. 0. 1. ECU_ADDRESS 0xd0007009 BIT_MASK 0x1 /end MEASUREMENT
/begin MEASUREMENT Vbx_tkof_fl_n_cdn "Condition on engine speed" UBYTE _CNV_S_2_RANGE______3_CM 1 0. 0. 1. ECU_ADDRESS 0xd000700a BIT_MASK 0x1 /end MEASUREMENT
/begin CHARACTERISTIC Cxx_tkof_fl_mat_thd "Manifold air temperature threshold" VALUE 0xa0021bb8 _REC_S1VAL_20_u2 240. _CNV_A_R_LINEAR_____110_CM -40. 200. FORMAT "%5.1" /end CHARACTERISTIC
/begin CHARACTERISTIC Cxx_tkof_map_hys "Manifold pressure value hysteresis" VALUE 0xa0021bba _REC_S1VAL_20_u2 20000. _CNV_A_R_LINEAR_____115_CM 0. 20000. FORMAT "%5.0" /end CHARACTERISTIC
/begin CHARACTERISTIC Cxx_tkof_map_thd "Manifold pressure value threshold" VALUE 0xa0021bbc _REC_S1VAL_20_u2 20000. _CNV_A_R_LINEAR_____115_CM 0. 20000. FORMAT "%5.0" /end CHARACTERISTIC
/begin CHARACTERISTIC Cxx_tkof_n_h_thd "Engine speed high threshold" VALUE 0xa0021bbe _REC_S1VAL_20_u2 16383.75 _CNV_A_R_ENSD_LINEA_22_CM 0. 16383.75 FORMAT "%8.2" /end CHARACTERISTIC
/begin CHARACTERISTIC Cxx_tkof_n_hys "Engine speed hysteresis" VALUE 0xa0021bc0 _REC_S1VAL_20_u2 16383.75 _CNV_A_R_ENSD_LINEA_22_CM 0. 16383.75 FORMAT "%8.2" /end CHARACTERISTIC
/begin CHARACTERISTIC Cxx_tkof_n_l_thd "Engine speed low threshold" VALUE 0xa0021bc2 _REC_S1VAL_20_u2 16383.75 _CNV_A_R_ENSD_LINEA_22_CM 0. 16383.75 FORMAT "%8.2" /end CHARACTERISTIC
/begin MEASUREMENT Vbx_gear_cge_spv_on "Boolean to indicate that the target torque provision is active" UBYTE _CNV_S_2_RANGE______3_CM 1 0. 0. 1. ECU_ADDRESS 0xd0006cb5 BIT_MASK 0x1 /end MEASUREMENT
/begin MEASUREMENT Vbx_gear_cge_tqe_sp_lim "Indication of a restriction on setpoint torque positive authority at the begining of the gearshift" UBYTE _CNV_S_2_RANGE______3_CM 1 0. 0. 1. ECU_ADDRESS 0xd0006cb6 BIT_MASK 0x1 /end MEASUREMENT
/begin MEASUREMENT Vbx_gear_cge_tqe_tgt "Boolean to indicate the activation (1) of a target torque provision during a manual gearshift" UBYTE _CNV_S_2_RANGE______3_CM 1 0. 0. 1. ECU_ADDRESS 0xd0006cb7 BIT_MASK 0x1 /end MEASUREMENT
/begin MEASUREMENT Vxx_gear_cge_fmt "Modulation factor for the target torque provision during a manual gear shift" UBYTE _CNV_A_R_LINEAR_____123_CM 1 0. 0. 1. ECU_ADDRESS 0xd0006cb8 FORMAT "%4.2" /end MEASUREMENT
/begin CHARACTERISTIC Cxx_gear_cge_dec_dly "Time required to modulate the target torque provision at the end of a manual gear shift" VALUE 0xa0021624 _REC_S1VAL_20_u2 655.35 _CNV_A_R_LINEAR_____32_CM 0. 655.35 FORMAT "%6.2" /end CHARACTERISTIC
/begin CHARACTERISTIC Cxx_gear_cge_sp_lim_dly "Maximum time for the limitation of positive target torque corrections of the anti-jerk compensator during a manual gear shift" VALUE 0xa0021626 _REC_S1VAL_20_u2 655.35 _CNV_A_R_LINEAR_____32_CM 0. 655.35 FORMAT "%6.2" /end CHARACTERISTIC
/begin CHARACTERISTIC Cxx_gear_cge_tqe_tgt_dly "Maximum time for the target torque provision during a manual gear shift" VALUE 0xa0021628 _REC_S1VAL_20_u2 655.35 _CNV_A_R_LINEAR_____32_CM 0. 655.35 FORMAT "%6.2" /end CHARACTERISTIC
/begin AXIS_PTS Ctb_gear_cge_n_mv "Engine speed breakpoints for the target torque provision" 0xa002da34 Vxx_n_mv _REC_A2AXS_20_u2 16383.75 _CNV_A_R_ENSD_LINEA_22_CM 8 0. 16383.75 FORMAT "%8.2" /end AXIS_PTS
/begin CHARACTERISTIC Cmp_gear_cge_tgt_tqe "Cartography for the target torque provision during a manual gear shift" MAP 0xa002da48 _REC_A1MAP_20_u2_u2_u1 2047.96875 _CNV_A_R_LINEAR_____216_CM -400. 1647.96875 FORMAT "%10.5"
 /begin AXIS_DESCR COM_AXIS Vxx_n_mv _CNV_A_R_ENSD_LINEA_22_CM 8 0. 16383.75 FORMAT "%8.2" AXIS_PTS_REF Ctb_gear_cge_n_mv /end AXIS_DESCR
 /begin AXIS_DESCR COM_AXIS Vxx_gear _CNV_A_R_LINEAR_____145_CM 8 -1. 6. READ_ONLY FORMAT "%2.0" AXIS_PTS_REF Ntb_gear /end AXIS_DESCR
/end CHARACTERISTIC
/begin MEASUREMENT Vbx_mgb_tqe_tgt_calc_on "Boolean to indicate that the target torque provision calculation is active" UBYTE _CNV_S_2_RANGE______3_CM 1 0. 0. 1. ECU_ADDRESS 0xd0006cba BIT_MASK 0x1 /end MEASUREMENT
/begin MEASUREMENT Vxx_mgb_max_tqe_tgt "Maximum target torque value during a manual gear shift" UWORD _CNV_A_R_LINEAR_____216_CM 1 0. -400. 1647.96875 ECU_ADDRESS 0xd00043e4 FORMAT "%10.5" /end MEASUREMENT
/begin MEASUREMENT Vxx_mgb_min_tqe_tgt "Minimum target torque value during a manual gear shift" UWORD _CNV_A_R_LINEAR_____216_CM 1 0. -400. 1647.96875 ECU_ADDRESS 0xd00043e6 FORMAT "%10.5" /end MEASUREMENT
/begin CHARACTERISTIC Cxx_mgb_max_tqe_tgt "Maximum calibrated target torque value during a manual gear shift" VALUE 0xa002162c _REC_S1VAL_20_u2 2047.96875 _CNV_A_R_LINEAR_____216_CM -400. 1647.96875 FORMAT "%10.5" /end CHARACTERISTIC
/begin MEASUREMENT Vbx_mgb_shf_ant_tq_cfm "Increase of anticipated torque during manual gearbox shift activated." UBYTE _CNV_S_2_RANGE______3_CM 1 0. 0. 1. ECU_ADDRESS 0xd0006cb9 BIT_MASK 0x1 /end MEASUREMENT
/begin CHARACTERISTIC Cbx_mgb_shf_ant_tq_cfm "(=1) Increase of anticipated torque during manual gearbox shift activated." VALUE 0xa002162a _REC_S1VAL_20_u1 1. _CNV_S_2_RANGE______3_CM 0. 1. /end CHARACTERISTIC
/begin MEASUREMENT Vxx_fsys_cpt_max "Memorized maximum threshold for mode 6." SWORD _CNV_A_R_LINEAR_____478_CM 1 0. -750. 749.977111816406 DISPLAY_IDENTIFIER CbRicDgn_NVM.Vxx_fsys_cpt_max_NVM ECU_ADDRESS 0xd0004068 FORMAT "%7.2" /end MEASUREMENT
/begin MEASUREMENT Vxx_fsys_cpt_min "Memorized minimum threshold for mode 6." SWORD _CNV_A_R_LINEAR_____478_CM 1 0. -750. 749.977111816406 DISPLAY_IDENTIFIER CbRicDgn_NVM.Vxx_fsys_cpt_min_NVM ECU_ADDRESS 0xd000406a FORMAT "%7.2" /end MEASUREMENT
/begin MEASUREMENT Vxx_fsys_cpt_val "Memorized diagnosis criteria for mode 6." SWORD _CNV_A_R_LINEAR_____478_CM 1 0. -750. 749.977111816406 DISPLAY_IDENTIFIER CbRicDgn_NVM.Vxx_fsys_cpt_val_NVM ECU_ADDRESS 0xd000406c FORMAT "%7.2" /end MEASUREMENT
/begin MEASUREMENT Sxx_fsys_cor_ti_fac "Corrected average ALFACL for memorized fuel system diagnostic" UWORD _CNV_A_R_LINEAR_____100_CM 1 0. 0.6666666 1.33332309414063 DISPLAY_IDENTIFIER CbRicDgn_NVM.Sxx_fsys_cor_ti_fac_NVM ECU_ADDRESS 0xd000406e FORMAT "%8.7" /end MEASUREMENT
/begin MEASUREMENT Sxx_fsys_cor_ti_fac_max "Max threshold for corrected average ALFACL for memorized fuel system diagnostic" UWORD _CNV_A_R_LINEAR_____100_CM 1 0. 0.6666666 1.33332309414063 DISPLAY_IDENTIFIER CbRicDgn_NVM.Sxx_fsys_cor_ti_fac_max_NVM ECU_ADDRESS 0xd0004070 FORMAT "%8.7" /end MEASUREMENT
/begin MEASUREMENT Sxx_fsys_cor_ti_fac_min "Min threshold for corrected average ALFACL for memorized fuel system diagnostic." UWORD _CNV_A_R_LINEAR_____100_CM 1 0. 0.6666666 1.33332309414063 DISPLAY_IDENTIFIER CbRicDgn_NVM.Sxx_fsys_cor_ti_fac_min_NVM ECU_ADDRESS 0xd0004072 FORMAT "%8.7" /end MEASUREMENT
/begin MEASUREMENT Vxx_cl_rich_chr_max "Threshold for the detection of the faillure saved in mode 6" UWORD _CNV_A_R_LINEAR_____58_CM 1 0. 0. 6553.5 DISPLAY_IDENTIFIER CbRicDgn_NVM.Vxx_cl_rich_chr_max_NVM ECU_ADDRESS 0xd0004074 FORMAT "%6.1" /end MEASUREMENT
/begin MEASUREMENT Vxx_cl_rich_chr_val "Diagnosis criterion for the detection of the faillure saved in mode 6" UWORD _CNV_A_R_LINEAR_____58_CM 1 0. 0. 6553.5 DISPLAY_IDENTIFIER CbRicDgn_NVM.Vxx_cl_rich_chr_val_NVM ECU_ADDRESS 0xd0004076 FORMAT "%6.1" /end MEASUREMENT
/begin AXIS_PTS Ctb_fsys_n_5 "Table of engine speed breakpoins for fuel system diagnosis cartographies." 0xa0029f98 Vxx_n _REC_A2AXS_20_u2 16383.75 _CNV_A_R_ENSD_LINEA_22_CM 5 0. 16383.75 FORMAT "%8.2" /end AXIS_PTS
/begin CHARACTERISTIC Ctp_fsys_eal_min "Table de masses d’air minimum = f(Vxx_n01 ) pour autorisation de diag fuel system" CURVE 0xa0029fa4 _REC_A1CUR_20_u2_u2 3.99993896484375 _CNV_A_R_LINEAR_____53_CM 0. 3.99993896484375 FORMAT "%7.5"
 /begin AXIS_DESCR COM_AXIS Vxx_n _CNV_A_R_ENSD_LINEA_22_CM 5 0. 16383.75 FORMAT "%8.2" AXIS_PTS_REF Ctb_fsys_n_5 /end AXIS_DESCR
/end CHARACTERISTIC
/begin MEASUREMENT Vbx_df_fsys_cpt "Fuel Trim Component detected failure" UBYTE _CNV_S_2_RANGE______3_CM 1 0. 0. 1. ECU_ADDRESS 0xd000679c BIT_MASK 0x1 /end MEASUREMENT
/begin MEASUREMENT Vbx_diag_ena_fsys_cpt "Fuel Trim Component diagnostic authorization" UBYTE _CNV_S_2_RANGE______3_CM 1 0. 0. 1. ECU_ADDRESS 0xd000679d BIT_MASK 0x1 /end MEASUREMENT
/begin MEASUREMENT Vbx_dsb_diag_fsys_cpt "Inhibition of fuel system diagnosis function of ivld state" UBYTE _CNV_S_2_RANGE______3_CM 1 0. 0. 1. ECU_ADDRESS 0xd000679e BIT_MASK 0x1 /end MEASUREMENT
/begin MEASUREMENT Vbx_fsys_cond "Software and physical conditions of autorization of the fuel system diagnosis" UBYTE _CNV_S_2_RANGE______3_CM 1 0. 0. 1. ECU_ADDRESS 0xd000679f BIT_MASK 0x1 /end MEASUREMENT
/begin MEASUREMENT Vbx_fsys_req "Autorization of the fuel system diagnosis" UBYTE _CNV_S_2_RANGE______3_CM 1 0. 0. 1. ECU_ADDRESS 0xd00067a0 BIT_MASK 0x1 /end MEASUREMENT
/begin MEASUREMENT Vbx_trans_clf_fsys_cpt "Detects when Vbx_clf_fsys_cpt turns on " UBYTE _CNV_S_2_RANGE______3_CM 1 0. 0. 1. ECU_ADDRESS 0xd00067a1 BIT_MASK 0x1 /end MEASUREMENT
/begin MEASUREMENT Vsx_fsys_stt "State of the statemachine of the fuel system diagnosis " UBYTE _CNV_A_R_ECME_LINEA_0_CM 1 0. 0. 255. ECU_ADDRESS 0xd00067a2 FORMAT "%3.0" /end MEASUREMENT
/begin MEASUREMENT Vsx_fsys_vld "Fuel System validity status" UBYTE _CNV_A_R_ECME_LINEA_0_CM 1 0. 0. 255. ECU_ADDRESS 0xd00067a3 FORMAT "%3.0" /end MEASUREMENT
/begin MEASUREMENT Vxx_diag_fsys_dsb_dly "Delay Inhibition FuelSystem Diagnostic after start" UWORD _CNV_A_R_LINEAR_____408_CM 1 0. 0. 32767.5 ECU_ADDRESS 0xd000407a FORMAT "%7.1" /end MEASUREMENT
/begin MEASUREMENT Vxx_fsys_cor_fac_max_1 "Maximum threshold when using alcohol to detect a failure in cold conditions" UWORD _CNV_A_R_LINEAR_____100_CM 1 0. 0.6666666 1.33332309414063 ECU_ADDRESS 0xd000407c FORMAT "%8.7" /end MEASUREMENT
/begin MEASUREMENT Vxx_fsys_cor_fac_max_2 "Maximum threshold when using alcohol to detect a failure in hot conditions" UWORD _CNV_A_R_LINEAR_____100_CM 1 0. 0.6666666 1.33332309414063 ECU_ADDRESS 0xd000407e FORMAT "%8.7" /end MEASUREMENT
/begin MEASUREMENT Vxx_fsys_cor_fac_min_1 "Minimum threshold when using alcohol to detect a failure in cold conditions" UWORD _CNV_A_R_LINEAR_____100_CM 1 0. 0.6666666 1.33332309414063 ECU_ADDRESS 0xd0004080 FORMAT "%8.7" /end MEASUREMENT
/begin MEASUREMENT Vxx_fsys_cor_fac_min_2 "Minimum threshold when using alcohol to detect a failure in hot conditions" UWORD _CNV_A_R_LINEAR_____100_CM 1 0. 0.6666666 1.33332309414063 ECU_ADDRESS 0xd0004082 FORMAT "%8.7" /end MEASUREMENT
/begin MEASUREMENT Vxx_fsys_cor_ti_fac "Corrected average ALFACL for the fuel system diagnosis" UWORD _CNV_A_R_LINEAR_____100_CM 1 0. 0.6666666 1.33332309414063 ECU_ADDRESS 0xd0004084 FORMAT "%8.7" /end MEASUREMENT
/begin MEASUREMENT Vxx_fsys_cor_ti_fac_clr "Erasing of Corrected average ALFACL for memorized fuel system diagnostic" UWORD _CNV_A_R_LINEAR_____100_CM 1 0. 0.6666666 1.33332309414063 ECU_ADDRESS 0xd0004086 FORMAT "%8.7" /end MEASUREMENT
/begin MEASUREMENT Vxx_fsys_cor_ti_fac_ini "Initializing of Corrected average ALFACL for memorized fuel system diagnostic" UWORD _CNV_A_R_LINEAR_____100_CM 1 0. 0.6666666 1.33332309414063 ECU_ADDRESS 0xd0004088 FORMAT "%8.7" /end MEASUREMENT
/begin MEASUREMENT Vxx_fsys_cor_ti_fac_max "Max threshold for corrected average ALFACL for fuel system diagnosis " UWORD _CNV_A_R_LINEAR_____100_CM 1 0. 0.6666666 1.33332309414063 ECU_ADDRESS 0xd000408a FORMAT "%8.7" /end MEASUREMENT
/begin MEASUREMENT Vxx_fsys_cor_ti_fac_max_clr "Erasing of Max threshold for corrected average ALFACL for memorized fuel system diagnostic" UWORD _CNV_A_R_LINEAR_____100_CM 1 0. 0.6666666 1.33332309414063 ECU_ADDRESS 0xd000408c FORMAT "%8.7" /end MEASUREMENT
/begin MEASUREMENT Vxx_fsys_cor_ti_fac_max_ini "Initializing of Max threshold for corrected average ALFACL for memorized fuel system diagnostic" UWORD _CNV_A_R_LINEAR_____100_CM 1 0. 0.6666666 1.33332309414063 ECU_ADDRESS 0xd000408e FORMAT "%8.7" /end MEASUREMENT
/begin MEASUREMENT Vxx_fsys_cor_ti_fac_min "Min threshold for corrected average ALFACL for fuel system diagnosis" UWORD _CNV_A_R_LINEAR_____100_CM 1 0. 0.6666666 1.33332309414063 ECU_ADDRESS 0xd0004090 FORMAT "%8.7" /end MEASUREMENT
/begin MEASUREMENT Vxx_fsys_cor_ti_fac_min_clr "Erasing of Min threshold for corrected average ALFACL for memorized fuel system diagnostic" UWORD _CNV_A_R_LINEAR_____100_CM 1 0. 0.6666666 1.33332309414063 ECU_ADDRESS 0xd0004092 FORMAT "%8.7" /end MEASUREMENT
/begin MEASUREMENT Vxx_fsys_cor_ti_fac_min_ini "Initializing of Min threshold for corrected average ALFACL for memorized fuel system diagnostic" UWORD _CNV_A_R_LINEAR_____100_CM 1 0. 0.6666666 1.33332309414063 ECU_ADDRESS 0xd0004094 FORMAT "%8.7" /end MEASUREMENT
/begin MEASUREMENT Vxx_fsys_crit_bal_1 "Ponderation in the calcul of diagnosis criteria" SBYTE _CNV_A_R_LINEAR_____294_CM 1 0. -5. 4.9609375 ECU_ADDRESS 0xd00067a4 FORMAT "%5.2" /end MEASUREMENT
/begin MEASUREMENT Vxx_fsys_crit_bal_2 "Ponderation in the calcul of diagnosis criteria" SBYTE _CNV_A_R_LINEAR_____294_CM 1 0. -5. 4.9609375 ECU_ADDRESS 0xd00067a5 FORMAT "%5.2" /end MEASUREMENT
/begin MEASUREMENT Vxx_fsys_crit_bal_3 "Ponderation in the calcul of diagnosis criteria" SBYTE _CNV_A_R_LINEAR_____294_CM 1 0. -5. 4.9609375 ECU_ADDRESS 0xd00067a6 FORMAT "%5.2" /end MEASUREMENT
/begin MEASUREMENT Vxx_fsys_crit_diag "Value of the diagnosis criteria of fuel system diagnosis when using new diagnosis." SWORD _CNV_A_R_LINEAR_____478_CM 1 0. -750. 749.977111816406 ECU_ADDRESS 0xd0004096 FORMAT "%7.2" /end MEASUREMENT
/begin MEASUREMENT Vxx_fsys_crit_diag_clr "Value of the diagnosis criteria of fuel system diagnosis when using new diagnosis in case of erasement request." SWORD _CNV_A_R_LINEAR_____478_CM 1 0. -750. 749.977111816406 ECU_ADDRESS 0xd0004098 FORMAT "%7.2" /end MEASUREMENT
/begin MEASUREMENT Vxx_fsys_crit_diag_ini "Initialisation of memorized new diagnosis criteria in case of initialization request." SWORD _CNV_A_R_LINEAR_____478_CM 1 0. -750. 749.977111816406 ECU_ADDRESS 0xd000409a FORMAT "%7.2" /end MEASUREMENT
/begin MEASUREMENT Vxx_fsys_crit_diag_max "Initialisation of memorized maximum threshold of new criteria in case of initialization request." SWORD _CNV_A_R_LINEAR_____478_CM 1 0. -750. 749.977111816406 ECU_ADDRESS 0xd000409c FORMAT "%7.2" /end MEASUREMENT
/begin MEASUREMENT Vxx_fsys_crit_diag_max_1 "Maximum threshold applies on the diagnosis criteria in cold condition to detect a failure when using the new diagnosis in cold" SWORD _CNV_A_R_LINEAR_____478_CM 1 0. -750. 749.977111816406 ECU_ADDRESS 0xd000409e FORMAT "%7.2" /end MEASUREMENT
/begin MEASUREMENT Vxx_fsys_crit_diag_max_2 "Maximum threshold applies on the diagnosis criteria in cold condition to detect a failure when using the new diagnosis in hot" SWORD _CNV_A_R_LINEAR_____478_CM 1 0. -750. 749.977111816406 ECU_ADDRESS 0xd00040a0 FORMAT "%7.2" /end MEASUREMENT
/begin MEASUREMENT Vxx_fsys_crit_diag_max_clr "Value of memorized maximum threshold of fuel system diagnosis when using new diagnosis in case of erasement request." SWORD _CNV_A_R_LINEAR_____478_CM 1 0. -750. 749.977111816406 ECU_ADDRESS 0xd00040a2 FORMAT "%7.2" /end MEASUREMENT
/begin MEASUREMENT Vxx_fsys_crit_diag_max_ini "Initialisation of memorized maximum threshold of new criteria in case of initialization request." SWORD _CNV_A_R_LINEAR_____478_CM 1 0. -750. 749.977111816406 ECU_ADDRESS 0xd00040a4 FORMAT "%7.2" /end MEASUREMENT
/begin MEASUREMENT Vxx_fsys_crit_diag_med "Temporary value of the new diagnosis criteria" SWORD _CNV_A_R_LINEAR_____478_CM 1 0. -750. 749.977111816406 ECU_ADDRESS 0xd00040a6 FORMAT "%7.2" /end MEASUREMENT
/begin MEASUREMENT Vxx_fsys_crit_diag_med_1 "First part of the new diagnosis criteria." SLONG _CNV_A_R_LINEAR_____479_CM 1 0. -250. 249.99999 ECU_ADDRESS 0xd000253c FORMAT "%12.5" /end MEASUREMENT
/begin MEASUREMENT Vxx_fsys_crit_diag_med_2 "Second part of the new diagnosis criteria." SLONG _CNV_A_R_LINEAR_____479_CM 1 0. -250. 249.99999 ECU_ADDRESS 0xd0002540 FORMAT "%12.5" /end MEASUREMENT
/begin MEASUREMENT Vxx_fsys_crit_diag_med_3 "Third part of the new diagnosis criteria." SLONG _CNV_A_R_LINEAR_____479_CM 1 0. -250. 249.99999 ECU_ADDRESS 0xd0002544 FORMAT "%12.5" /end MEASUREMENT
/begin MEASUREMENT Vxx_fsys_crit_diag_min "Initialisation of memorized minimum threshold of new criteria in case of initialization request." SWORD _CNV_A_R_LINEAR_____478_CM 1 0. -750. 749.977111816406 ECU_ADDRESS 0xd00040a8 FORMAT "%7.2" /end MEASUREMENT
/begin MEASUREMENT Vxx_fsys_crit_diag_min_1 "Minimum threshold applies on the diagnosis criteria in cold condition to detect a failure when using the new diagnosis" SWORD _CNV_A_R_LINEAR_____478_CM 1 0. -750. 749.977111816406 ECU_ADDRESS 0xd00040aa FORMAT "%7.2" /end MEASUREMENT
/begin MEASUREMENT Vxx_fsys_crit_diag_min_2 "Minimum threshold applies on the diagnosis criteria in hot condition to detect a failure when using the new diagnosis" SWORD _CNV_A_R_LINEAR_____478_CM 1 0. -750. 749.977111816406 ECU_ADDRESS 0xd00040ac FORMAT "%7.2" /end MEASUREMENT
/begin MEASUREMENT Vxx_fsys_crit_diag_min_clr "Value of memorized minimum threshold of fuel system diagnosis when using new diagnosis in case of erasement request." SWORD _CNV_A_R_LINEAR_____478_CM 1 0. -750. 749.977111816406 ECU_ADDRESS 0xd00040ae FORMAT "%7.2" /end MEASUREMENT
/begin MEASUREMENT Vxx_fsys_crit_diag_min_ini "Initialisation of memorized minimum threshold of new criteria in case of initialization request." SWORD _CNV_A_R_LINEAR_____478_CM 1 0. -750. 749.977111816406 ECU_ADDRESS 0xd00040b0 FORMAT "%7.2" /end MEASUREMENT
/begin MEASUREMENT Vxx_fsys_crit_diag_win "Value in the diagnosis criteria of fuel system diagnosis in each monitoring window when using new diagnosis." SWORD _CNV_A_R_LINEAR_____478_CM 1 0. -750. 749.977111816406 ECU_ADDRESS 0xd00040b2 FORMAT "%7.2" /end MEASUREMENT
/begin MEASUREMENT Vxx_fsys_dft_dly "Duration of temporal filtering to detect the presence of a default of OBD type on fuel system " UWORD _CNV_A_R_LINEAR_____32_CM 1 0. 0. 655.35 ECU_ADDRESS 0xd00040b4 FORMAT "%6.2" /end MEASUREMENT
/begin MEASUREMENT Vxx_fsys_dly "Duration of temporal filtering to detect the presence or the absence of a default of OBD type on fuel system" UWORD _CNV_A_R_LINEAR_____32_CM 1 0. 0. 655.35 ECU_ADDRESS 0xd00040b6 FORMAT "%6.2" /end MEASUREMENT
/begin MEASUREMENT Vxx_fsys_dly_1 "Duration of temporal filtering to detect the presence or the absence of a default of OBD type on fuel system in cold conditions" UWORD _CNV_A_R_LINEAR_____32_CM 1 0. 0. 655.35 ECU_ADDRESS 0xd00040b8 FORMAT "%6.2" /end MEASUREMENT
/begin MEASUREMENT Vxx_fsys_dly_2 "Duration of temporal filtering to detect the presence or the absence of a default of OBD type on fuel system in hot conditions" UWORD _CNV_A_R_LINEAR_____32_CM 1 0. 0. 655.35 ECU_ADDRESS 0xd00040ba FORMAT "%6.2" /end MEASUREMENT
/begin MEASUREMENT Vxx_fsys_no_dft_dly "Duration of temporal filtering to detect the absence of a default of OBD type on fuel system" UWORD _CNV_A_R_LINEAR_____32_CM 1 0. 0. 655.35 ECU_ADDRESS 0xd00040bc FORMAT "%6.2" /end MEASUREMENT
/begin MEASUREMENT Vxx_fsys_win_ctr "Number of windows before detecting a faillure." UBYTE _CNV_A_R_ECME_LINEA_0_CM 1 0. 0. 255. ECU_ADDRESS 0xd00067a7 FORMAT "%3.0" /end MEASUREMENT
/begin MEASUREMENT Vxx_fsys_win_nr_fail "number of folowing windows to detect a failure" UBYTE _CNV_A_R_ECME_LINEA_0_CM 1 0. 0. 255. ECU_ADDRESS 0xd00067a8 FORMAT "%3.0" /end MEASUREMENT
/begin CHARACTERISTIC Cbx_conf_schd_diag_fsys "Configuration Diagnostic Fuelsystem strategy" VALUE 0xa0020fca _REC_S1VAL_20_u1 1. _CNV_A_R_ECME_LINEA_0_CM 0. 1. FORMAT "%1.0" BIT_MASK 0x1 /end CHARACTERISTIC
/begin CHARACTERISTIC Cbx_fsys_diag_conf "Choice of the diagnosis to be used." VALUE 0xa0020fcb _REC_S1VAL_20_u1 1. _CNV_A_R_ECME_LINEA_0_CM 0. 1. FORMAT "%1.0" BIT_MASK 0x1 /end CHARACTERISTIC
/begin CHARACTERISTIC Cxx_dfdec_fsys_cpt "Fuel Trim Component detected failure counter decrement" VALUE 0xa0020f8c _REC_S1VAL_20_u2 65535. _CNV_A_R_ECME_LINEA_0_CM 0. 65535. FORMAT "%5.0" /end CHARACTERISTIC
/begin CHARACTERISTIC Cxx_dfinc_fsys_cpt "Fuel Trim Component detected failure counter increment" VALUE 0xa0020f8e _REC_S1VAL_20_u2 65535. _CNV_A_R_ECME_LINEA_0_CM 0. 65535. FORMAT "%5.0" /end CHARACTERISTIC
/begin CHARACTERISTIC Cxx_fsys_alco_dly_1 "Duration of temporal filtering, in case of alcohol using, to detect the presence or the absence of a failure of OBD type on fuel system in cold condition" VALUE 0xa0020f90 _REC_S1VAL_20_u2 655.35 _CNV_A_R_LINEAR_____32_CM 0. 655.35 FORMAT "%6.2" /end CHARACTERISTIC
/begin CHARACTERISTIC Cxx_fsys_alco_dly_2 "Duration of temporal filtering, in case of alcohol using, to detect the presence or the absence of a failure of OBD type on fuel system in hot conditions" VALUE 0xa0020f92 _REC_S1VAL_20_u2 655.35 _CNV_A_R_LINEAR_____32_CM 0. 655.35 FORMAT "%6.2" /end CHARACTERISTIC
/begin CHARACTERISTIC Cxx_fsys_cor_fac_alco_max_1 "Maximum threshold, applies on the diagnosis criteria in cold conditions to detect a failure (alcohol)" VALUE 0xa0020f94 _REC_S1VAL_20_u2 0.66665649414063 _CNV_A_R_LINEAR_____100_CM 0.6666666 1.33332309414063 FORMAT "%8.7" /end CHARACTERISTIC
/begin CHARACTERISTIC Cxx_fsys_cor_fac_alco_max_2 "Maximum threshold, applies on the diagnosis criteria in hot conditions to detect a failure (alcohol)" VALUE 0xa0020f96 _REC_S1VAL_20_u2 0.66665649414063 _CNV_A_R_LINEAR_____100_CM 0.6666666 1.33332309414063 FORMAT "%8.7" /end CHARACTERISTIC
/begin CHARACTERISTIC Cxx_fsys_cor_fac_alco_min_1 "Minimum threshold, applies on the diagnosis criteria in cold conditions to detect a failure (alcohol)" VALUE 0xa0020f98 _REC_S1VAL_20_u2 0.66665649414063 _CNV_A_R_LINEAR_____100_CM 0.6666666 1.33332309414063 FORMAT "%8.7" /end CHARACTERISTIC
/begin CHARACTERISTIC Cxx_fsys_cor_fac_alco_min_2 "Minimum threshold, applies on the diagnosis criteria in hot conditions to detect a failure (alcohol)" VALUE 0xa0020f9a _REC_S1VAL_20_u2 0.66665649414063 _CNV_A_R_LINEAR_____100_CM 0.6666666 1.33332309414063 FORMAT "%8.7" /end CHARACTERISTIC
/begin CHARACTERISTIC Cxx_fsys_cor_fac_max_1 "Maximum threshold applies on the diagnosis criteria in cold conditions to detect a failure (gazoline)" VALUE 0xa0020f9c _REC_S1VAL_20_u2 0.66665649414063 _CNV_A_R_LINEAR_____100_CM 0.6666666 1.33332309414063 FORMAT "%8.7" /end CHARACTERISTIC
/begin CHARACTERISTIC Cxx_fsys_cor_fac_max_2 "Maximum threshold applies on the diagnosis criteria in hot conditions to detect a failure (gazoline)" VALUE 0xa0020f9e _REC_S1VAL_20_u2 0.66665649414063 _CNV_A_R_LINEAR_____100_CM 0.6666666 1.33332309414063 FORMAT "%8.7" /end CHARACTERISTIC
/begin CHARACTERISTIC Cxx_fsys_cor_fac_min_1 "Minimum threshold applies on the diagnosis criteria in cold conditions to detect a failure (gazoline)" VALUE 0xa0020fa0 _REC_S1VAL_20_u2 0.66665649414063 _CNV_A_R_LINEAR_____100_CM 0.6666666 1.33332309414063 FORMAT "%8.7" /end CHARACTERISTIC
/begin CHARACTERISTIC Cxx_fsys_cor_fac_min_2 "Minimum threshold applies on the diagnosis criteria in hot conditions to detect a failure (gazoline)" VALUE 0xa0020fa2 _REC_S1VAL_20_u2 0.66665649414063 _CNV_A_R_LINEAR_____100_CM 0.6666666 1.33332309414063 FORMAT "%8.7" /end CHARACTERISTIC
/begin CHARACTERISTIC Cxx_fsys_crit_alco_bal_1 "Ponderation in the calcul of diagnosis criteria (alcohol)" VALUE 0xa0020fcc _REC_S1VAL_20_s1 9.9609375 _CNV_A_R_LINEAR_____480_CM -5. 4.9609375 FORMAT "%5.2" /end CHARACTERISTIC
/begin CHARACTERISTIC Cxx_fsys_crit_alco_bal_2 "Ponderation in the calcul of diagnosis criteria (alcohol)" VALUE 0xa0020fcd _REC_S1VAL_20_s1 9.9609375 _CNV_A_R_LINEAR_____480_CM -5. 4.9609375 FORMAT "%5.2" /end CHARACTERISTIC
/begin CHARACTERISTIC Cxx_fsys_crit_alco_bal_3 "Ponderation in the calcul of diagnosis criteria (alcohol)" VALUE 0xa0020fce _REC_S1VAL_20_s1 9.9609375 _CNV_A_R_LINEAR_____480_CM -5. 4.9609375 FORMAT "%5.2" /end CHARACTERISTIC
/begin CHARACTERISTIC Cxx_fsys_crit_bal_1 "Ponderation in the calcul of diagnosis criteria (gazoline)" VALUE 0xa0020fcf _REC_S1VAL_20_s1 9.9609375 _CNV_A_R_LINEAR_____480_CM -5. 4.9609375 FORMAT "%5.2" /end CHARACTERISTIC
/begin CHARACTERISTIC Cxx_fsys_crit_bal_2 "Ponderation in the calcul of diagnosis criteria (gazoline)" VALUE 0xa0020fd0 _REC_S1VAL_20_s1 9.9609375 _CNV_A_R_LINEAR_____294_CM -5. 4.9609375 FORMAT "%5.2" /end CHARACTERISTIC
/begin CHARACTERISTIC Cxx_fsys_crit_bal_3 "Ponderation in the calcul of diagnosis criteria (gazoline)" VALUE 0xa0020fd1 _REC_S1VAL_20_s1 9.9609375 _CNV_A_R_LINEAR_____480_CM -5. 4.9609375 FORMAT "%5.2" /end CHARACTERISTIC
/begin CHARACTERISTIC Cxx_fsys_crit_diag_alco_max_1 "Maximum threshold applies on the diagnosis criteria in cold condition to detect a failure when using the new diagnosis (alcohol)" VALUE 0xa0020fa4 _REC_S1VAL_20_s2 1499.977111816406 _CNV_A_R_LINEAR_____478_CM -750. 749.977111816406 FORMAT "%7.2" /end CHARACTERISTIC
/begin CHARACTERISTIC Cxx_fsys_crit_diag_alco_max_2 "Maximum threshold applies on the diagnosis criteria in hot condition to detect a failure when using the new diagnosis (alcohol)" VALUE 0xa0020fa6 _REC_S1VAL_20_s2 1499.977111816406 _CNV_A_R_LINEAR_____478_CM -750. 749.977111816406 FORMAT "%7.2" /end CHARACTERISTIC
/begin CHARACTERISTIC Cxx_fsys_crit_diag_alco_min_1 "Minimum threshold applies on the diagnosis criteria in cold condition to detect a failure when using the new diagnosis (alcohol)" VALUE 0xa0020fa8 _REC_S1VAL_20_s2 1499.977111816406 _CNV_A_R_LINEAR_____478_CM -750. 749.977111816406 FORMAT "%7.2" /end CHARACTERISTIC
/begin CHARACTERISTIC Cxx_fsys_crit_diag_alco_min_2 "Minimum threshold applies on the diagnosis criteria in hot condition to detect a failure when using the new diagnosis (alcohol)" VALUE 0xa0020faa _REC_S1VAL_20_s2 1499.977111816406 _CNV_A_R_LINEAR_____478_CM -750. 749.977111816406 FORMAT "%7.2" /end CHARACTERISTIC
/begin CHARACTERISTIC Cxx_fsys_crit_diag_max_1 "Maximum threshold applies on the diagnosis criteria in cold condition to detect a failure when using the new diagnosis (gazoline)" VALUE 0xa0020fac _REC_S1VAL_20_s2 1499.977111816406 _CNV_A_R_LINEAR_____478_CM -750. 749.977111816406 FORMAT "%7.2" /end CHARACTERISTIC
/begin CHARACTERISTIC Cxx_fsys_crit_diag_max_2 "Maximum threshold applies on the diagnosis criteria in hot condition to detect a failure when using the new diagnosis (gazoline)" VALUE 0xa0020fae _REC_S1VAL_20_s2 1499.977111816406 _CNV_A_R_LINEAR_____478_CM -750. 749.977111816406 FORMAT "%7.2" /end CHARACTERISTIC
/begin CHARACTERISTIC Cxx_fsys_crit_diag_min_1 "Minimum threshold applies on the diagnosis criteria in cold condition to detect a failure when using the new diagnosis (gazoline)" VALUE 0xa0020fb0 _REC_S1VAL_20_s2 1499.977111816406 _CNV_A_R_LINEAR_____478_CM -750. 749.977111816406 FORMAT "%7.2" /end CHARACTERISTIC
/begin CHARACTERISTIC Cxx_fsys_crit_diag_min_2 "Minimum threshold applies on the diagnosis criteria in hot condition to detect a failure when using the new diagnosis (gazoline)" VALUE 0xa0020fb2 _REC_S1VAL_20_s2 1499.977111816406 _CNV_A_R_LINEAR_____478_CM -750. 749.977111816406 FORMAT "%7.2" /end CHARACTERISTIC
/begin CHARACTERISTIC Cxx_fsys_dly_1 "Duration of temporal filtering to detect the presence or the absence of a default of OBD type on fuel system in cold conditions" VALUE 0xa0020fb4 _REC_S1VAL_20_u2 655.35 _CNV_A_R_LINEAR_____32_CM 0. 655.35 FORMAT "%6.2" /end CHARACTERISTIC
/begin CHARACTERISTIC Cxx_fsys_dly_2 "Duration of temporal filtering to detect the presence or the absence of a default of OBD type on fuel system in hot conditions (gazoline)" VALUE 0xa0020fb6 _REC_S1VAL_20_u2 655.35 _CNV_A_R_LINEAR_____32_CM 0. 655.35 FORMAT "%6.2" /end CHARACTERISTIC
/begin CHARACTERISTIC Cxx_fsys_eal_max_thd "Maximum threshold on engine air load to authorize fuel system diagnosis" VALUE 0xa0020fb8 _REC_S1VAL_20_u2 3.99993896484375 _CNV_A_R_LINEAR_____53_CM 0. 3.99993896484375 FORMAT "%7.5" /end CHARACTERISTIC
/begin CHARACTERISTIC Cxx_fsys_fuel_typ_rat_max_1 "First maximum rate of exotic fuel to authorize the diagnosis of the fuel system" VALUE 0xa0020fba _REC_S1VAL_20_u2 1. _CNV_A_R_LINEAR_____161_CM 0. 1. /end CHARACTERISTIC
/begin CHARACTERISTIC Cxx_fsys_fuel_typ_rat_max_2 "Second maximum rate of exotic fuel to authorize the diagnosis of the fuel system" VALUE 0xa0020fbc _REC_S1VAL_20_u2 1. _CNV_A_R_LINEAR_____161_CM 0. 1. /end CHARACTERISTIC
/begin CHARACTERISTIC Cxx_fsys_fuel_typ_rat_min_1 "First minimum rate of exotic fuel to authorize the diagnosis of the fuel system" VALUE 0xa0020fbe _REC_S1VAL_20_u2 1. _CNV_A_R_LINEAR_____161_CM 0. 1. /end CHARACTERISTIC
/begin CHARACTERISTIC Cxx_fsys_fuel_typ_rat_min_2 "Second minimum rate of exotic fuel to authorize the diagnosis of the fuel system" VALUE 0xa0020fc0 _REC_S1VAL_20_u2 1. _CNV_A_R_LINEAR_____161_CM 0. 1. /end CHARACTERISTIC
/begin CHARACTERISTIC Cxx_fsys_n_max_thd "Maximum threshold on engine speed to authorize fuel system diagnosis" VALUE 0xa0020fc2 _REC_S1VAL_20_u2 16383.75 _CNV_A_R_ENSD_LINEA_22_CM 0. 16383.75 FORMAT "%8.2" /end CHARACTERISTIC
/begin CHARACTERISTIC Cxx_fsys_n_min_thd "Minimum threshold on engine speed to authorize fuel system diagnosis" VALUE 0xa0020fc4 _REC_S1VAL_20_u2 16383.75 _CNV_A_R_ENSD_LINEA_22_CM 0. 16383.75 FORMAT "%8.2" /end CHARACTERISTIC
/begin CHARACTERISTIC Cxx_fsys_tco_min_thd "Threshold on engine coolant temperature to determine thesholds and filtering duration used in diagnosis strategy of the fuel system" VALUE 0xa0020fc6 _REC_S1VAL_20_u2 240. _CNV_A_R_LINEAR_____110_CM -40. 200. FORMAT "%5.1" /end CHARACTERISTIC
/begin CHARACTERISTIC Cxx_fsys_thd_ad_fac_max "Maximum threshold on instantaneous factor on injection time." VALUE 0xa0020fd2 _REC_S1VAL_20_u1 0.6640625 _CNV_A_R_LINEAR_____103_CM 0.6666667 1.3307292 FORMAT "%5.3" /end CHARACTERISTIC
/begin CHARACTERISTIC Cxx_fsys_thd_ad_fac_min "Minnimum threshold on instantaneous factor on injection time." VALUE 0xa0020fd3 _REC_S1VAL_20_u1 0.6640625 _CNV_A_R_LINEAR_____103_CM 0.6666667 1.3307292 FORMAT "%5.3" /end CHARACTERISTIC
/begin CHARACTERISTIC Cxx_fsys_thd_ad_ofs_max "Maximum threshold on instantaneous adaptation offset on injection time." VALUE 0xa0020fd4 _REC_S1VAL_20_s1 1020. _CNV_A_R_LINEAR_____102_CM -512. 508. FORMAT "%1.0" /end CHARACTERISTIC
/begin CHARACTERISTIC Cxx_fsys_thd_ad_ofs_min "Minimum threshold on instantaneous adaptation offset on injection time." VALUE 0xa0020fd5 _REC_S1VAL_20_s1 1020. _CNV_A_R_LINEAR_____102_CM -512. 508. FORMAT "%1.0" /end CHARACTERISTIC
/begin CHARACTERISTIC Cxx_fsys_win_nr_fail "Number of folowing windows to detect a failure." VALUE 0xa0020fd6 _REC_S1VAL_20_u1 255. _CNV_A_R_ECME_LINEA_0_CM 0. 255. FORMAT "%3.0" /end CHARACTERISTIC
/begin CHARACTERISTIC Cxx_fsys_win_nr_fail_alco "Number of following windows when using alcohol to detect a failure" VALUE 0xa0020fd7 _REC_S1VAL_20_u1 255. _CNV_A_R_ECME_LINEA_0_CM 0. 255. FORMAT "%3.0" /end CHARACTERISTIC
/begin CHARACTERISTIC Cxx_min_diag_fsys_dly "Delay Inhibition FuelSystem Diagnostic after start" VALUE 0xa0020fc8 _REC_S1VAL_20_u2 32767.5 _CNV_A_R_LINEAR_____408_CM 0. 32767.5 FORMAT "%4.1" /end CHARACTERISTIC
/begin AXIS_PTS Ctb_ctl_mon_tco "Table of engine coolant temperature breakpoints" 0xa0029f6c Vxx_tco _REC_A2AXS_20_u2 240. _CNV_A_R_LINEAR_____110_CM 10 -40. 200. FORMAT "%6.1" /end AXIS_PTS
/begin CHARACTERISTIC Ctp_ctl_mon_t_max "" CURVE 0xa0029f84 _REC_A1CUR_20_u2_u2 6553.5 _CNV_A_R_LINEAR_____58_CM 0. 6553.5 FORMAT "%6.1"
 /begin AXIS_DESCR COM_AXIS Vxx_tco _CNV_A_R_LINEAR_____110_CM 10 -40. 200. FORMAT "%6.1" AXIS_PTS_REF Ctb_ctl_mon_tco /end AXIS_DESCR
/end CHARACTERISTIC
/begin MEASUREMENT Vbx_cl_mon_end "End of the diagnosis if value=1" UBYTE _CNV_S_2_RANGE______3_CM 1 0. 0. 1. ECU_ADDRESS 0xd00077f1 BIT_MASK 0x1 /end MEASUREMENT
/begin MEASUREMENT Vbx_cl_mon_req "Authorization of the diagnosis of the richness regulation" UBYTE _CNV_S_2_RANGE______3_CM 1 0. 0. 1. ECU_ADDRESS 0xd00077f2 BIT_MASK 0x1 /end MEASUREMENT
/begin MEASUREMENT Vbx_df_cl_rich_chr "Faillure present on the richness regulation." UBYTE _CNV_S_2_RANGE______3_CM 1 0. 0. 1. ECU_ADDRESS 0xd00077f3 BIT_MASK 0x1 /end MEASUREMENT
/begin MEASUREMENT Vbx_diag_ena_cl_rich_chr "Authorisation of sending data to faillure manager" UBYTE _CNV_S_2_RANGE______3_CM 1 0. 0. 1. ECU_ADDRESS 0xd00077f4 BIT_MASK 0x1 /end MEASUREMENT
/begin MEASUREMENT Vsx_ctl_mon_stt "State of the diagnosis of the richness regulation" UBYTE _CNV_S_4_CTL_MON_DI_481_CM 1 0. 10. 40. ECU_ADDRESS 0xd00077f5 /end MEASUREMENT
/begin MEASUREMENT Vxx_cl_rich_chr_max_clr "Default value in case of erasement of the threshold for the detection of the faillure saved in mode 6" UWORD _CNV_A_R_LINEAR_____58_CM 1 0. 0. 6553.5 ECU_ADDRESS 0xd000512e FORMAT "%6.1" /end MEASUREMENT
/begin MEASUREMENT Vxx_cl_rich_chr_max_ini "Initialisation of the threshold for the diagnosis criterion of the faillure saved in mode 6" UWORD _CNV_A_R_LINEAR_____58_CM 1 0. 0. 6553.5 ECU_ADDRESS 0xd0005130 FORMAT "%6.1" /end MEASUREMENT
/begin MEASUREMENT Vxx_cl_rich_chr_val_clr "Default value in case of erasement of the criterion diagnosis for the detection of the faillure saved in mode 6" UWORD _CNV_A_R_LINEAR_____58_CM 1 0. 0. 6553.5 ECU_ADDRESS 0xd0005132 FORMAT "%6.1" /end MEASUREMENT
/begin MEASUREMENT Vxx_cl_rich_chr_val_ini "Initialisation of the threshold for the diagnosis criterion of the faillure saved in mode 6" UWORD _CNV_A_R_LINEAR_____58_CM 1 0. 0. 6553.5 ECU_ADDRESS 0xd0005134 FORMAT "%6.1" /end MEASUREMENT
/begin MEASUREMENT Vxx_ctl_mon_t "Diagnosis criterion: time passed in open loop regulation since engine start" UWORD _CNV_A_R_LINEAR_____58_CM 1 0. 0. 6553.5 ECU_ADDRESS 0xd0005136 FORMAT "%6.1" /end MEASUREMENT
/begin MEASUREMENT Vxx_ctl_mon_t_max "Maximum threshold to detect a faillure on richness regulation" UWORD _CNV_A_R_LINEAR_____58_CM 1 0. 0. 6553.5 ECU_ADDRESS 0xd0005138 FORMAT "%6.1" /end MEASUREMENT
/begin MEASUREMENT Vxx_ctl_mon_thd_max "Maximum time to declare a faillure in richness control" UWORD _CNV_A_R_LINEAR_____58_CM 1 0. 0. 6553.5 ECU_ADDRESS 0xd000513a FORMAT "%6.1" /end MEASUREMENT
/begin CHARACTERISTIC Cbx_conf_schd_diag_ctl_mon "Acitvation of the feedback control monitoring strategy" VALUE 0xa0020f8a _REC_S1VAL_20_u1 1. _CNV_A_R_ECME_LINEA_0_CM 0. 1. FORMAT "%1.0" BIT_MASK 0x1 /end CHARACTERISTIC
/begin CHARACTERISTIC Cxx_dfdec_cl_rich_chr "cb_ric_dgn_ctlmonx / Closed loop richness detected failure counter decrement" VALUE 0xa0020f86 _REC_S1VAL_20_u2 65535. _CNV_A_R_ECME_LINEA_0_CM 0. 65535. FORMAT "%5.0" /end CHARACTERISTIC
/begin CHARACTERISTIC Cxx_dfinc_cl_rich_chr "cb_ric_dgn_ctlmonx / Closed loop richness detected failure counter increment" VALUE 0xa0020f88 _REC_S1VAL_20_u2 65535. _CNV_A_R_ECME_LINEA_0_CM 0. 65535. FORMAT "%5.0" /end CHARACTERISTIC
/begin MEASUREMENT Vbx_rich_clos_loop_mon_cfm "Richness closed loop monitoring configuration" UBYTE _CNV_S_2_RANGE______3_CM 1 0. 0. 1. ECU_ADDRESS 0xd00077f6 BIT_MASK 0x1 /end MEASUREMENT
/begin CHARACTERISTIC Cbx_rich_clos_loop_mon_cfm "Richness closed loop monitoring activation" VALUE 0xa0020fd8 _REC_S1VAL_20_u1 1. _CNV_A_R_ECME_LINEA_0_CM 0. 1. FORMAT "%1.0" BIT_MASK 0x1 /end CHARACTERISTIC
/begin MEASUREMENT Vbx_tlz_ad_cor_ok "Booleen d'apprentissage valide défaut demi-tour" UBYTE _CNV_S_2_RANGE______3_CM 1 0. 0. 1. DISPLAY_IDENTIFIER InTqiTlz_NVM.Vbx_tlz_ad_cor_ok_NVM ECU_ADDRESS 0xd00027d8 BIT_MASK 0x1 /end MEASUREMENT
/begin MEASUREMENT Vbx_tlz_ad_b_done "" UBYTE _CNV_S_2_RANGE______3_CM 1 0. 0. 1. DISPLAY_IDENTIFIER InTqiTlz_NVM.Vbx_tlz_ad_b_done_NVM ECU_ADDRESS 0xd00027d9 BIT_MASK 0x1 /end MEASUREMENT
/begin MEASUREMENT Vbx_tlz_ad_b_clc "" UBYTE _CNV_S_2_RANGE______3_CM 1 0. 0. 1. DISPLAY_IDENTIFIER InTqiTlz_NVM.Vbx_tlz_ad_b_clc_NVM ECU_ADDRESS 0xd00027da BIT_MASK 0x1 /end MEASUREMENT
/begin MEASUREMENT Vxx_tlz_ad_b_ok "Status of target adaptive process" UBYTE _CNV_A_R_ECME_LINEA_0_CM 1 0. 0. 2. DISPLAY_IDENTIFIER InTqiTlz_NVM.Vxx_tlz_ad_b_ok_NVM ECU_ADDRESS 0xd00027db FORMAT "%1.0" /end MEASUREMENT
/begin MEASUREMENT Vxx_tlz_ad_bkp_last "Last achieved adaptive value." UBYTE _CNV_A_R_ECME_LINEA_0_CM 1 0. 0. 6. DISPLAY_IDENTIFIER InTqiTlz_NVM.Vxx_tlz_ad_bkp_last_NVM ECU_ADDRESS 0xd00027dc FORMAT "%1.0" /end MEASUREMENT
/begin MEASUREMENT Vxx_tlz_ad_b1_ctr_tdc "TDC counter for slow TLZBETA1 adaptive process" UWORD _CNV_A_R_LINEAR_____101_CM 1 0. 0. 65535. DISPLAY_IDENTIFIER InTqiTlz_NVM.Vxx_tlz_ad_b1_ctr_tdc_NVM ECU_ADDRESS 0xd00027de FORMAT "%5.0" /end MEASUREMENT
/begin MEASUREMENT Vxx_tlz_ad_b2_ctr_tdc "TDC counter for TLZBETA2 fast adaptive process" UWORD _CNV_A_R_LINEAR_____101_CM 1 0. 0. 65535. DISPLAY_IDENTIFIER InTqiTlz_NVM.Vxx_tlz_ad_b2_ctr_tdc_NVM ECU_ADDRESS 0xd00027e0 FORMAT "%5.0" /end MEASUREMENT
/begin MEASUREMENT Vxx_mis_n_max_thd_1_2 "Maximum engine speed for misfiringdetection strategy" UWORD _CNV_A_R_ENSD_LINEA_22_CM 1 0. 0. 16383.75 DISPLAY_IDENTIFIER InTqiTlz_NVM.Vxx_mis_n_max_thd_1_2_NVM ECU_ADDRESS 0xd00027e2 FORMAT "%8.2" /end MEASUREMENT
/begin MEASUREMENT Vxx_tlz_ad_cor_ctr_tdc "Compteur d'apprentissages défaut demi-tour réalisés" UWORD _CNV_A_R_LINEAR_____101_CM 1 0. 0. 65535. DISPLAY_IDENTIFIER InTqiTlz_NVM.Vxx_tlz_ad_cor_ctr_tdc_NVM ECU_ADDRESS 0xd00027e4 FORMAT "%5.0" /end MEASUREMENT
/begin MEASUREMENT Vxx_tlz_ad_cor_fil "Valeur apprise filtrée (correspondant à 8 * TLZCORAP)" SWORD _CNV_A_R_ECME_LINEA_0_CM 1 0. -32768. 32767. DISPLAY_IDENTIFIER InTqiTlz_NVM.Vxx_tlz_ad_cor_fil_NVM ECU_ADDRESS 0xd00027e6 FORMAT "%6.0" /end MEASUREMENT
/begin MEASUREMENT Vxx_tlz_ad_cor_val "TLZ adaptive correction" SWORD _CNV_A_R_ECME_LINEA_0_CM 1 0. -32768. 32767. DISPLAY_IDENTIFIER InTqiTlz_NVM.Vxx_tlz_ad_cor_val_NVM ECU_ADDRESS 0xd00027e8 FORMAT "%6.0" /end MEASUREMENT
/begin MEASUREMENT Vxx_mis_km_dly "Distance driven since torque meter init." ULONG _CNV_A_R_LINEAR_____482_CM 1 0. 0. 4660337.5 DISPLAY_IDENTIFIER InTqiTlz_NVM.Vxx_mis_km_dly_NVM ECU_ADDRESS 0xd00027ea FORMAT "%9.1" /end MEASUREMENT
/begin MEASUREMENT Vxx_tlz_ad_b2_fil_1 "Filtered adaptive value for cyl 2 and 3 in the first speed range" SLONG _CNV_A_R_ECME_LINEA_0_CM 1 0. -2147483648. 2147483647. DISPLAY_IDENTIFIER InTqiTlz_NVM.Vxx_tlz_ad_b2_fil_1_NVM ECU_ADDRESS 0xd00027ee FORMAT "%11.0" /end MEASUREMENT
/begin MEASUREMENT Vxx_tlz_ad_b1_fil_2 "Filtered adaptive value for cyl 1 and 4 in the second speed range" SLONG _CNV_A_R_ECME_LINEA_0_CM 1 0. -2147483648. 2147483647. DISPLAY_IDENTIFIER InTqiTlz_NVM.Vxx_tlz_ad_b1_fil_2_NVM ECU_ADDRESS 0xd00027f2 FORMAT "%11.0" /end MEASUREMENT
/begin MEASUREMENT Vxx_tlz_ad_b2_fil_2 "Filtered adaptive value for cyl 2 and 3 in the second speed range" SLONG _CNV_A_R_ECME_LINEA_0_CM 1 0. -2147483648. 2147483647. DISPLAY_IDENTIFIER InTqiTlz_NVM.Vxx_tlz_ad_b2_fil_2_NVM ECU_ADDRESS 0xd00027f6 FORMAT "%11.0" /end MEASUREMENT
/begin MEASUREMENT Vxx_tlz_ad_b1_fil_1 "Filtered adaptive value for cyl 1 and 4 in the first speed range" SLONG _CNV_A_R_ECME_LINEA_0_CM 1 0. -2147483648. 2147483647. DISPLAY_IDENTIFIER InTqiTlz_NVM.Vxx_tlz_ad_b1_fil_1_NVM ECU_ADDRESS 0xd00027fa FORMAT "%11.0" /end MEASUREMENT
/begin MEASUREMENT Vxx_tlz_ad_b2_fil_3 "Filtered adaptive value for cyl 2 and 3 in the third speed range" SLONG _CNV_A_R_ECME_LINEA_0_CM 1 0. -2147483648. 2147483647. DISPLAY_IDENTIFIER InTqiTlz_NVM.Vxx_tlz_ad_b2_fil_3_NVM ECU_ADDRESS 0xd00027fe FORMAT "%11.0" /end MEASUREMENT
/begin MEASUREMENT Vxx_tlz_ad_b1_fil_3 "Filtered adaptive value for cyl 1 and 4 in the third speed range" SLONG _CNV_A_R_ECME_LINEA_0_CM 1 0. -2147483648. 2147483647. DISPLAY_IDENTIFIER InTqiTlz_NVM.Vxx_tlz_ad_b1_fil_3_NVM ECU_ADDRESS 0xd0002802 FORMAT "%11.0" /end MEASUREMENT
/begin MEASUREMENT Vxx_tlz_ad_b2_fil_4 "Filtered adaptive value for cyl 2 and 3 in the 4th speed range" SLONG _CNV_A_R_ECME_LINEA_0_CM 1 0. -2147483648. 2147483647. DISPLAY_IDENTIFIER InTqiTlz_NVM.Vxx_tlz_ad_b2_fil_4_NVM ECU_ADDRESS 0xd0002806 FORMAT "%11.0" /end MEASUREMENT
/begin MEASUREMENT Vxx_tlz_ad_b1_fil_4 "Filtered adaptive value for cyl 1 and 4 in the 4th speed range" SLONG _CNV_A_R_ECME_LINEA_0_CM 1 0. -2147483648. 2147483647. DISPLAY_IDENTIFIER InTqiTlz_NVM.Vxx_tlz_ad_b1_fil_4_NVM ECU_ADDRESS 0xd000280a FORMAT "%11.0" /end MEASUREMENT
/begin MEASUREMENT Vxx_tlz_ad_b2_fil_5 "Filtered adaptive value for cyl 2 and 3 in the 5th speed range" SLONG _CNV_A_R_ECME_LINEA_0_CM 1 0. -2147483648. 2147483647. DISPLAY_IDENTIFIER InTqiTlz_NVM.Vxx_tlz_ad_b2_fil_5_NVM ECU_ADDRESS 0xd000280e FORMAT "%11.0" /end MEASUREMENT
/begin MEASUREMENT Vxx_tlz_ad_b1_fil_5 "Filtered adaptive value for cyl 1 and 4 in the 5th speed range" SLONG _CNV_A_R_ECME_LINEA_0_CM 1 0. -2147483648. 2147483647. DISPLAY_IDENTIFIER InTqiTlz_NVM.Vxx_tlz_ad_b1_fil_5_NVM ECU_ADDRESS 0xd0002812 FORMAT "%11.0" /end MEASUREMENT
/begin MEASUREMENT Vxx_tlz_ad_b1_fil_6 "Filtered adaptive value for cyl 1 and 4 in the 6th speed range" SLONG _CNV_A_R_ECME_LINEA_0_CM 1 0. -2147483648. 2147483647. DISPLAY_IDENTIFIER InTqiTlz_NVM.Vxx_tlz_ad_b1_fil_6_NVM ECU_ADDRESS 0xd0002816 FORMAT "%11.0" /end MEASUREMENT
/begin MEASUREMENT Vxx_tlz_ad_b2_fil_6 "Filtered adaptive value for cyl 2 and 3 in the 6th speed range" SLONG _CNV_A_R_ECME_LINEA_0_CM 1 0. -2147483648. 2147483647. DISPLAY_IDENTIFIER InTqiTlz_NVM.Vxx_tlz_ad_b2_fil_6_NVM ECU_ADDRESS 0xd000281a FORMAT "%11.0" /end MEASUREMENT
/begin MEASUREMENT Vxx_tlz_ad_b1_fil "Filtered adaptive value for cyl 1 and 4 during slow adaptive process" SLONG _CNV_A_R_ECME_LINEA_0_CM 1 0. -2147483648. 2147483647. DISPLAY_IDENTIFIER InTqiTlz_NVM.Vxx_tlz_ad_b1_fil_NVM ECU_ADDRESS 0xd000281e FORMAT "%11.0" /end MEASUREMENT
/begin MEASUREMENT Vxx_tlz_ad_b2_fil "Filtered adaptive value for cyl 2 and 3 during slow adaptive process" SLONG _CNV_A_R_ECME_LINEA_0_CM 1 0. -2147483648. 2147483647. DISPLAY_IDENTIFIER InTqiTlz_NVM.Vxx_tlz_ad_b2_fil_NVM ECU_ADDRESS 0xd0002822 FORMAT "%11.0" /end MEASUREMENT
/begin AXIS_PTS Ctb_n_tlz_ad_b "Breakpoints table for Ctp_tlz_ad_beta_grd_prs" 0xa002e248 Vxx_n _REC_A2AXS_20_u2 16383.75 _CNV_A_R_ENSD_LINEA_22_CM 6 0. 16383.75 FORMAT "%8.2" /end AXIS_PTS
/begin AXIS_PTS Ntb_7 "Table transforming the engine speed into the interval of interpolation." 0xa0021728 Vxx_tlz_ad_bkp_last _REC_A2AXS_20_u1 6. _CNV_A_R_ECME_LINEA_0_CM 7 0. 6. READ_ONLY FORMAT "%1.0" /end AXIS_PTS
/begin CHARACTERISTIC Ctd_mis_n_max_thd_1_2 "Table of maximum engine speed for misfiring detection strategy" CURVE 0xa002e258 _REC_A1CUR_20_u2_u1 16383.75 _CNV_A_R_ENSD_LINEA_22_CM 0. 16383.75 FORMAT "%8.2"
 /begin AXIS_DESCR COM_AXIS Vxx_tlz_ad_bkp_last _CNV_A_R_ECME_LINEA_0_CM 7 0. 6. READ_ONLY FORMAT "%1.0" AXIS_PTS_REF Ntb_7 /end AXIS_DESCR
/end CHARACTERISTIC
/begin CHARACTERISTIC Ctd_tlz_ad_b_ena "Indexed table  that enables the adaptive process on different gear ratios." CURVE 0xa0021720 _REC_A1CUR_20_u1_u1 1. _CNV_A_R_ECME_LINEA_0_CM 0. 1. FORMAT "%1.0"
 /begin AXIS_DESCR COM_AXIS Vxx_gear _CNV_A_R_LINEAR_____145_CM 8 -1. 6. READ_ONLY FORMAT "%2.0" AXIS_PTS_REF Ntb_gear /end AXIS_DESCR
/end CHARACTERISTIC
/begin CHARACTERISTIC Ctp_tlz_ad_b_grd_prs "Table: gradient of BETA depending on manifold presure." CURVE 0xa002e268 _REC_A1CUR_20_u2_u2 65535. _CNV_A_R_ECME_LINEA_0_CM 0. 65535. FORMAT "%5.0"
 /begin AXIS_DESCR COM_AXIS Vxx_n _CNV_A_R_ENSD_LINEA_22_CM 6 0. 16383.75 FORMAT "%8.2" AXIS_PTS_REF Ctb_n_tlz_ad_b /end AXIS_DESCR
/end CHARACTERISTIC
/begin MEASUREMENT Vbx_df_tlz_ad_b_cpt "Cranckshaft position system variation not learned  component detected failure" UBYTE _CNV_S_2_RANGE______3_CM 1 0. 0. 1. ECU_ADDRESS 0xd0006d3e BIT_MASK 0x1 /end MEASUREMENT
/begin MEASUREMENT Vbx_tlz_ad_b_ena "Engine conditions enable adaptive process" UBYTE _CNV_S_2_RANGE______3_CM 1 0. 0. 1. ECU_ADDRESS 0xd0006d3f BIT_MASK 0x1 /end MEASUREMENT
/begin MEASUREMENT Vbx_tlz_ad_b_fast_stt_ena "Fast BETA adaptive process enabled" UBYTE _CNV_S_2_RANGE______3_CM 1 0. 0. 1. ECU_ADDRESS 0xd0006d40 BIT_MASK 0x1 /end MEASUREMENT
/begin MEASUREMENT Vbx_tlz_ad_b_slow_stt_ena "Slow BETA adaptive process enabled" UBYTE _CNV_S_2_RANGE______3_CM 1 0. 0. 1. ECU_ADDRESS 0xd0006d41 BIT_MASK 0x1 /end MEASUREMENT
/begin MEASUREMENT Vbx_tlz_ad_b_wat_stt_ena "Adaptive process waiting for powertrain conditions" UBYTE _CNV_S_2_RANGE______3_CM 1 0. 0. 1. ECU_ADDRESS 0xd0006d42 BIT_MASK 0x1 /end MEASUREMENT
/begin MEASUREMENT Vbx_tlz_fast_ad_b_ena "Engine conditions enable slow adaptive process" UBYTE _CNV_S_2_RANGE______3_CM 1 0. 0. 1. ECU_ADDRESS 0xd0006d43 BIT_MASK 0x1 /end MEASUREMENT
/begin MEASUREMENT Vbx_tlz_slow_ad_b_dsb "Enagine conditions disable slow adaptive process" UBYTE _CNV_S_2_RANGE______3_CM 1 0. 0. 1. ECU_ADDRESS 0xd0006d44 BIT_MASK 0x1 /end MEASUREMENT
/begin MEASUREMENT Vbx_tlz_slow_ad_b_ena "Enagine conditions enable slow adaptive process" UBYTE _CNV_S_2_RANGE______3_CM 1 0. 0. 1. ECU_ADDRESS 0xd0006d45 BIT_MASK 0x1 /end MEASUREMENT
/begin MEASUREMENT Vsx_tlz_ad_b_stt "State of TLZBEAT adaptive process" UBYTE _CNV_S_3_RANGE_STAT_483_CM 1 0. 1. 3. ECU_ADDRESS 0xd0006d46 /end MEASUREMENT
/begin MEASUREMENT Vsx_tlz_ad_b_vld "Torquemeter TLZ adaptative correction  system validity status." UBYTE _CNV_S_3_STATUS_OK__213_CM 1 0. 0. 2. ECU_ADDRESS 0xd0006d47 /end MEASUREMENT
/begin MEASUREMENT Vxx_tlz_ad_b1_dif "Difference between previous value of Vxx_tlz_ad_beta1_fil and the best actual value" SLONG _CNV_A_R_ECME_LINEA_0_CM 1 0. -2147483648. 2147483647. ECU_ADDRESS 0xd00027b0 FORMAT "%11.0" /end MEASUREMENT
/begin MEASUREMENT Vxx_tlz_ad_b1_fil_prev "Previous value for variable Vxx_tlz_ad_b1_fil" SLONG _CNV_A_R_ECME_LINEA_0_CM 1 0. -2147483648. 2147483647. ECU_ADDRESS 0xd00027b4 FORMAT "%11.0" /end MEASUREMENT
/begin MEASUREMENT Vxx_tlz_ad_b2_dif "Difference between previous value of Vxx_tlz_ad_beta2_fil and the best actual value" SLONG _CNV_A_R_ECME_LINEA_0_CM 1 0. -2147483648. 2147483647. ECU_ADDRESS 0xd00027b8 FORMAT "%11.0" /end MEASUREMENT
/begin MEASUREMENT Vxx_tlz_ad_b2_fil_prev "Previous value fof variable Vxx_tlz_ad_b2_fil" SLONG _CNV_A_R_ECME_LINEA_0_CM 1 0. -2147483648. 2147483647. ECU_ADDRESS 0xd00027bc FORMAT "%11.0" /end MEASUREMENT
/begin MEASUREMENT Vxx_tlz_ad_b_ctr_tdc "temporary TDC counter for fast adaptive process" UWORD _CNV_A_R_LINEAR_____101_CM 1 0. 0. 65535. ECU_ADDRESS 0xd000449e FORMAT "%5.0" /end MEASUREMENT
/begin MEASUREMENT Vxx_tlz_ad_b_dif "Temporary difference bitween filtered value and the best actual value for the current cylindres" SLONG _CNV_A_R_ECME_LINEA_0_CM 1 0. -2147483648. 2147483647. ECU_ADDRESS 0xd00027c0 FORMAT "%11.0" /end MEASUREMENT
/begin MEASUREMENT Vxx_tlz_ad_b_fil "Temporary filtered adaptive TLZBETA value for the current cylinders" SLONG _CNV_A_R_ECME_LINEA_0_CM 1 0. -2147483648. 2147483647. ECU_ADDRESS 0xd00027c4 FORMAT "%11.0" /end MEASUREMENT
/begin MEASUREMENT Vxx_tlz_ad_b_slow_ctr_tdc "Number of TDC during  adaptive process on the current breakpoint." UBYTE _CNV_A_R_LINEAR_____101_CM 1 0. 0. 255. ECU_ADDRESS 0xd0006d48 FORMAT "%3.0" /end MEASUREMENT
/begin MEASUREMENT Vxx_tlz_ad_bkp "Current engine speed breakpoint for target adaptive process" UBYTE _CNV_A_R_ECME_LINEA_0_CM 1 0. 0. 6. ECU_ADDRESS 0xd0006d49 FORMAT "%1.0" /end MEASUREMENT
/begin CHARACTERISTIC Cbx_ad_ini_req "Reset the torque meter adapatative learning  values to specific values for tuning needs" VALUE 0xa002178e _REC_S1VAL_20_u1 1. _CNV_S_2_RANGE______3_CM 0. 1. BIT_MASK 0x1 /end CHARACTERISTIC
/begin CHARACTERISTIC Cbx_tq_ini_req "Reset the torque meter variables" VALUE 0xa002178f _REC_S1VAL_20_u1 1. _CNV_S_2_RANGE______3_CM 0. 1. BIT_MASK 0x1 /end CHARACTERISTIC
/begin CHARACTERISTIC Cxx_dfdec_tlz_ad_b_cpt "Crankshaft Position System Variation Not Learned Component detected failure counter decrement" VALUE 0xa0021730 _REC_S1VAL_20_u2 65535. _CNV_A_R_ECME_LINEA_0_CM 0. 65535. FORMAT "%5.0" /end CHARACTERISTIC
/begin CHARACTERISTIC Cxx_dfinc_tlz_ad_b_cpt "Crankshaft Position System Variation Not Learned Component detected failure counter increment" VALUE 0xa0021732 _REC_S1VAL_20_u2 65535. _CNV_A_R_ECME_LINEA_0_CM 0. 65535. FORMAT "%5.0" /end CHARACTERISTIC
/begin CHARACTERISTIC Cxx_tlz_ad_b_fil_fac "Filter gain for BETA adaptive process" VALUE 0xa0021790 _REC_S1VAL_20_u1 255. _CNV_A_R_ECME_LINEA_0_CM 0. 255. FORMAT "%3.0" /end CHARACTERISTIC
/begin CHARACTERISTIC Cxx_tlz_ad_b_max "Maximum value for calculated beta value." VALUE 0xa0021734 _REC_S1VAL_20_s4 4294967295. _CNV_A_R_ECME_LINEA_0_CM -2147483648. 2147483647. FORMAT "%11.0" /end CHARACTERISTIC
/begin CHARACTERISTIC Cxx_tlz_ad_b_max_1 "Maximum value of calculated beta value for the first range speed" VALUE 0xa002173c _REC_S1VAL_20_s4 4294967295. _CNV_A_R_ECME_LINEA_0_CM -2147483648. 2147483647. FORMAT "%11.0" /end CHARACTERISTIC
/begin CHARACTERISTIC Cxx_tlz_ad_b_max_2 "Maximum value of calculated beta value for the second range speed" VALUE 0xa0021740 _REC_S1VAL_20_s4 4294967295. _CNV_A_R_ECME_LINEA_0_CM -2147483648. 2147483647. FORMAT "%11.0" /end CHARACTERISTIC
/begin CHARACTERISTIC Cxx_tlz_ad_b_max_3 "Maximum value of calculated beta value for the third range speed" VALUE 0xa0021744 _REC_S1VAL_20_s4 4294967295. _CNV_A_R_ECME_LINEA_0_CM -2147483648. 2147483647. FORMAT "%11.0" /end CHARACTERISTIC
/begin CHARACTERISTIC Cxx_tlz_ad_b_max_4 "Maximum value of calculated beta value for the fourth range speed" VALUE 0xa0021748 _REC_S1VAL_20_s4 4294967295. _CNV_A_R_ECME_LINEA_0_CM -2147483648. 2147483647. FORMAT "%11.0" /end CHARACTERISTIC
/begin CHARACTERISTIC Cxx_tlz_ad_b_max_5 "Maximum value of calculated beta value for the fifth range speed" VALUE 0xa002174c _REC_S1VAL_20_s4 4294967295. _CNV_A_R_ECME_LINEA_0_CM -2147483648. 2147483647. FORMAT "%11.0" /end CHARACTERISTIC
/begin CHARACTERISTIC Cxx_tlz_ad_b_max_6 "Maximum value of calculated beta value for the sixth range speed" VALUE 0xa0021750 _REC_S1VAL_20_s4 4294967295. _CNV_A_R_ECME_LINEA_0_CM -2147483648. 2147483647. FORMAT "%11.0" /end CHARACTERISTIC
/begin CHARACTERISTIC Cxx_tlz_ad_b_min "Minimum value for calculated beta value." VALUE 0xa0021738 _REC_S1VAL_20_s4 4294967295. _CNV_A_R_ECME_LINEA_0_CM -2147483648. 2147483647. FORMAT "%11.0" /end CHARACTERISTIC
/begin CHARACTERISTIC Cxx_tlz_ad_b_min_1 "Minimum value of calculated beta value for the first range speed" VALUE 0xa0021754 _REC_S1VAL_20_s4 4294967295. _CNV_A_R_ECME_LINEA_0_CM -2147483648. 2147483647. FORMAT "%11.0" /end CHARACTERISTIC
/begin CHARACTERISTIC Cxx_tlz_ad_b_min_2 "Minimum value of calculated beta value for the second range speed" VALUE 0xa0021758 _REC_S1VAL_20_s4 4294967295. _CNV_A_R_ECME_LINEA_0_CM -2147483648. 2147483647. FORMAT "%11.0" /end CHARACTERISTIC
/begin CHARACTERISTIC Cxx_tlz_ad_b_min_3 "Minimum value of calculated beta value for the third range speed" VALUE 0xa002175c _REC_S1VAL_20_s4 4294967295. _CNV_A_R_ECME_LINEA_0_CM -2147483648. 2147483647. FORMAT "%11.0" /end CHARACTERISTIC
/begin CHARACTERISTIC Cxx_tlz_ad_b_min_4 "Minimum value of calculated beta value for the fourth range speed" VALUE 0xa0021760 _REC_S1VAL_20_s4 4294967295. _CNV_A_R_ECME_LINEA_0_CM -2147483648. 2147483647. FORMAT "%11.0" /end CHARACTERISTIC
/begin CHARACTERISTIC Cxx_tlz_ad_b_min_5 "Minimum value of calculated beta value for the fifth range speed" VALUE 0xa0021764 _REC_S1VAL_20_s4 4294967295. _CNV_A_R_ECME_LINEA_0_CM -2147483648. 2147483647. FORMAT "%11.0" /end CHARACTERISTIC
/begin CHARACTERISTIC Cxx_tlz_ad_b_min_6 "Minimum value of calculated beta value for the sixth range speed" VALUE 0xa0021768 _REC_S1VAL_20_s4 4294967295. _CNV_A_R_ECME_LINEA_0_CM -2147483648. 2147483647. FORMAT "%11.0" /end CHARACTERISTIC
/begin CHARACTERISTIC Cxx_tlz_ad_b_n_max "Max engine speed for slow adaptive process" VALUE 0xa002176c _REC_S1VAL_20_u2 16383.75 _CNV_A_R_ENSD_LINEA_22_CM 0. 16383.75 FORMAT "%8.2" /end CHARACTERISTIC
/begin CHARACTERISTIC Cxx_tlz_ad_b_n_max_1 "Upper threshold for first engine speed range for TLZBETA adaptive process" VALUE 0xa002176e _REC_S1VAL_20_u2 16383.75 _CNV_A_R_ENSD_LINEA_22_CM 0. 16383.75 FORMAT "%8.2" /end CHARACTERISTIC
/begin CHARACTERISTIC Cxx_tlz_ad_b_n_max_2 "Upper threshold for second engine speed range for TLZBETA adaptive process" VALUE 0xa0021770 _REC_S1VAL_20_u2 16383.75 _CNV_A_R_ENSD_LINEA_22_CM 0. 16383.75 FORMAT "%8.2" /end CHARACTERISTIC
/begin CHARACTERISTIC Cxx_tlz_ad_b_n_max_3 "Upper threshold for third engine speed range for TLZBETA adaptive process" VALUE 0xa0021772 _REC_S1VAL_20_u2 16383.75 _CNV_A_R_ENSD_LINEA_22_CM 0. 16383.75 FORMAT "%8.2" /end CHARACTERISTIC
/begin CHARACTERISTIC Cxx_tlz_ad_b_n_max_4 "Upper threshold for 4th engine speed range for TLZBETA adaptive process" VALUE 0xa0021774 _REC_S1VAL_20_u2 16383.75 _CNV_A_R_ENSD_LINEA_22_CM 0. 16383.75 FORMAT "%8.2" /end CHARACTERISTIC
/begin CHARACTERISTIC Cxx_tlz_ad_b_n_max_5 "Upper threshold for 5th engine speed range for TLZBETA adaptive process" VALUE 0xa0021776 _REC_S1VAL_20_u2 16383.75 _CNV_A_R_ENSD_LINEA_22_CM 0. 16383.75 FORMAT "%8.2" /end CHARACTERISTIC
/begin CHARACTERISTIC Cxx_tlz_ad_b_n_max_6 "Upper threshold for 6th engine speed range for TLZBETA adaptive process" VALUE 0xa0021778 _REC_S1VAL_20_u2 16383.75 _CNV_A_R_ENSD_LINEA_22_CM 0. 16383.75 FORMAT "%8.2" /end CHARACTERISTIC
/begin CHARACTERISTIC Cxx_tlz_ad_b_n_min "Minimum engine speed for slow TLZBETA adaptive process" VALUE 0xa002177a _REC_S1VAL_20_u2 16383.75 _CNV_A_R_ENSD_LINEA_22_CM 0. 16383.75 FORMAT "%8.2" /end CHARACTERISTIC
/begin CHARACTERISTIC Cxx_tlz_ad_b_n_min_1 "Lower threshold for firts engine speed range for TLZBETA adaptive process" VALUE 0xa002177c _REC_S1VAL_20_u2 16383.75 _CNV_A_R_ENSD_LINEA_22_CM 0. 16383.75 FORMAT "%8.2" /end CHARACTERISTIC
/begin CHARACTERISTIC Cxx_tlz_ad_b_n_min_2 "Lower threshold for second engine speed range for TLZBETA adaptive process" VALUE 0xa002177e _REC_S1VAL_20_u2 16383.75 _CNV_A_R_ENSD_LINEA_22_CM 0. 16383.75 FORMAT "%8.2" /end CHARACTERISTIC
/begin CHARACTERISTIC Cxx_tlz_ad_b_n_min_3 "Lower threshold for third engine speed range for TLZBETA adaptive process" VALUE 0xa0021780 _REC_S1VAL_20_u2 16383.75 _CNV_A_R_ENSD_LINEA_22_CM 0. 16383.75 FORMAT "%8.2" /end CHARACTERISTIC
/begin CHARACTERISTIC Cxx_tlz_ad_b_n_min_4 "Lower threshold for  4th engine speed range for TLZBETA adaptive process" VALUE 0xa0021782 _REC_S1VAL_20_u2 16383.75 _CNV_A_R_ENSD_LINEA_22_CM 0. 16383.75 FORMAT "%8.2" /end CHARACTERISTIC
/begin CHARACTERISTIC Cxx_tlz_ad_b_n_min_5 "Lower threshold for 5th engine speed range for TLZBETA adaptive process" VALUE 0xa0021784 _REC_S1VAL_20_u2 16383.75 _CNV_A_R_ENSD_LINEA_22_CM 0. 16383.75 FORMAT "%8.2" /end CHARACTERISTIC
/begin CHARACTERISTIC Cxx_tlz_ad_b_n_min_6 "Lower threshold for 6th engine speed range for TLZBETA adaptive process" VALUE 0xa0021786 _REC_S1VAL_20_u2 16383.75 _CNV_A_R_ENSD_LINEA_22_CM 0. 16383.75 FORMAT "%8.2" /end CHARACTERISTIC
/begin CHARACTERISTIC Cxx_tlz_ad_b_nr_tdc "Number of TDC for fast adaptive process." VALUE 0xa0021788 _REC_S1VAL_20_u2 65534. _CNV_A_R_LINEAR_____101_CM 1. 65535. FORMAT "%5.0" /end CHARACTERISTIC
/begin CHARACTERISTIC Cxx_tlz_ad_b_slow_nr_tdc "Minimum number of TDC for adaptive process on all breakpoints." VALUE 0xa0021791 _REC_S1VAL_20_u1 255. _CNV_A_R_LINEAR_____101_CM 0. 255. FORMAT "%3.0" /end CHARACTERISTIC
/begin CHARACTERISTIC Cxx_tlz_b_ini "Beta paramter for TLZ index" VALUE 0xa002178a _REC_S1VAL_20_s2 65535. _CNV_A_R_ECME_LINEA_0_CM -32768. 32767. FORMAT "%6.0" /end CHARACTERISTIC
/begin CHARACTERISTIC Cxx_vs_n_rat_dif_max "ration variation threshold (CVT) to inhibite the adaptative process" VALUE 0xa002178c _REC_S1VAL_20_u2 655.34 _CNV_A_R_LINEAR_____396_CM 0. 655.34 FORMAT "%6.2" /end CHARACTERISTIC
/begin CHARACTERISTIC Cxx_vs_n_rat_dif_max_dly "Delay to inhibit the adaptative process" VALUE 0xa0021792 _REC_S1VAL_20_u1 255. _CNV_A_R_LINEAR_____101_CM 0. 255. FORMAT "%3.0" /end CHARACTERISTIC
/begin MEASUREMENT Vbx_tlz_ad_cor_ena "conditions requeired for adaptive process fulfilled" UBYTE _CNV_S_2_RANGE______3_CM 1 0. 0. 1. ECU_ADDRESS 0xd0006d4b BIT_MASK 0x1 /end MEASUREMENT
/begin MEASUREMENT Vbx_tlz_ad_cor_ok_1 "Booleen d'apprentissage valide défaut demi-tour intermédiaire" UBYTE _CNV_S_2_RANGE______3_CM 1 0. 0. 1. ECU_ADDRESS 0xd0006d4c BIT_MASK 0x1 /end MEASUREMENT
/begin MEASUREMENT Vbx_tlz_stt_0_tmp "Internal Trig enable for tlz torque correction beta coefficient computation" UBYTE _CNV_S_2_RANGE______3_CM 1 0. 0. 1. ECU_ADDRESS 0xd0006d4d BIT_MASK 0x1 /end MEASUREMENT
/begin MEASUREMENT Vbx_tlz_stt_1_tmp "Internal Trig Enable for TLZ calculation" UBYTE _CNV_S_2_RANGE______3_CM 1 0. 0. 1. ECU_ADDRESS 0xd0006d4e BIT_MASK 0x1 /end MEASUREMENT
/begin MEASUREMENT Vbx_tlz_stt_2_tmp "Internal Trig Enable for TLZ calculation" UBYTE _CNV_S_2_RANGE______3_CM 1 0. 0. 1. ECU_ADDRESS 0xd0006d4f BIT_MASK 0x1 /end MEASUREMENT
/begin MEASUREMENT Vsx_tlz_ad_cor_stt "Curent state of the state machine for low frequency tlz correction" UBYTE _CNV_A_R_ECME_LINEA_0_CM 1 0. 0. 4. ECU_ADDRESS 0xd0006d50 FORMAT "%1.0" /end MEASUREMENT
/begin MEASUREMENT Vxx_tlz_ad_cor_dif "Différentiel entre la valeur de TLZCORAP précédente et sa valeur optimale actuelle" SLONG _CNV_A_R_ECME_LINEA_0_CM 1 0. -2147483648. 2147483647. ECU_ADDRESS 0xd00027c8 FORMAT "%11.0" /end MEASUREMENT
/begin CHARACTERISTIC Cbx_tlz_ad_cor_conf "Boolean for inhibition of the low frequency adaptive process" VALUE 0xa002179a _REC_S1VAL_20_u1 1. _CNV_S_2_RANGE______3_CM 0. 1. BIT_MASK 0x1 /end CHARACTERISTIC
/begin CHARACTERISTIC Cxx_tlz_ad_cor_fil_fac "Valeur de filtrage des corrections apprentissage défaut demi-tour" VALUE 0xa002179b _REC_S1VAL_20_u1 255. _CNV_A_R_ECME_LINEA_0_CM 0. 255. FORMAT "%3.0" /end CHARACTERISTIC
/begin CHARACTERISTIC Cxx_tlz_ad_cor_n_max "Valeur max de reg au dessus : apprentissage correction  inhibé.  Valeur defaut 2000 tr/mn" VALUE 0xa0021794 _REC_S1VAL_20_u2 16383.75 _CNV_A_R_ENSD_LINEA_22_CM 0. 16383.75 FORMAT "%8.2" /end CHARACTERISTIC
/begin CHARACTERISTIC Cxx_tlz_ad_cor_n_min "Valeur mini de reg en sous laquelle l'apprentissage correction  est inhibé. Valeur défaut 2400 tr/mn" VALUE 0xa0021796 _REC_S1VAL_20_u2 16383.75 _CNV_A_R_ENSD_LINEA_22_CM 0. 16383.75 FORMAT "%8.2" /end CHARACTERISTIC
/begin CHARACTERISTIC Cxx_tlz_ad_cor_nr_tdc "Nombre de PMH pour l'apprentissage rapide du défaut demi-tour" VALUE 0xa0021798 _REC_S1VAL_20_u2 65534. _CNV_A_R_LINEAR_____101_CM 1. 65535. FORMAT "%5.0" /end CHARACTERISTIC
/begin CHARACTERISTIC Cxx_tlz_max_rat_n_ena "Maximum value of primary shaft speed/Engine speed ratio to enable adaptative crankshaft learning strategy" VALUE 0xa002179c _REC_S1VAL_20_u1 1.9921875 _CNV_A_R_LINEAR_____42_CM 0. 1.9921875 FORMAT "%8.6" /end CHARACTERISTIC
/begin CHARACTERISTIC Cxx_tlz_min_rat_n_ena "Minimum value of primary shaft speed/Engine speed ratio to enable adaptative crankshaft learning strategy" VALUE 0xa002179d _REC_S1VAL_20_u1 1.9921875 _CNV_A_R_LINEAR_____42_CM 0. 1.9921875 FORMAT "%8.6" /end CHARACTERISTIC
/begin MEASUREMENT Vbx_tlz_b_clc_ena "Engine speed condition enables the calculation of beta" UBYTE _CNV_S_2_RANGE______3_CM 1 0. 0. 1. ECU_ADDRESS 0xd0006d51 BIT_MASK 0x1 /end MEASUREMENT
/begin MEASUREMENT Vtx_tlz_ad_b_val[0] "table with adaptive values on the curent half tone wheel." SWORD _CNV_A_R_ECME_LINEA_0_CM 1 0. -32768. 32767. ECU_ADDRESS 0xd00044a4 FORMAT "%6.0" /end MEASUREMENT
/begin MEASUREMENT Vtx_tlz_ad_b_val[1] "table with adaptive values on the curent half tone wheel." SWORD _CNV_A_R_ECME_LINEA_0_CM 1 0. -32768. 32767. ECU_ADDRESS 0xd00044a6 FORMAT "%6.0" /end MEASUREMENT
/begin MEASUREMENT Vtx_tlz_ad_b_val[2] "table with adaptive values on the curent half tone wheel." SWORD _CNV_A_R_ECME_LINEA_0_CM 1 0. -32768. 32767. ECU_ADDRESS 0xd00044a8 FORMAT "%6.0" /end MEASUREMENT
/begin MEASUREMENT Vtx_tlz_ad_b_val[3] "table with adaptive values on the curent half tone wheel." SWORD _CNV_A_R_ECME_LINEA_0_CM 1 0. -32768. 32767. ECU_ADDRESS 0xd00044aa FORMAT "%6.0" /end MEASUREMENT
/begin MEASUREMENT Vtx_tlz_ad_b_val[4] "table with adaptive values on the curent half tone wheel." SWORD _CNV_A_R_ECME_LINEA_0_CM 1 0. -32768. 32767. ECU_ADDRESS 0xd00044ac FORMAT "%6.0" /end MEASUREMENT
/begin MEASUREMENT Vtx_tlz_ad_b_val[5] "table with adaptive values on the curent half tone wheel." SWORD _CNV_A_R_ECME_LINEA_0_CM 1 0. -32768. 32767. ECU_ADDRESS 0xd00044ae FORMAT "%6.0" /end MEASUREMENT
/begin MEASUREMENT Vxx_tlz_b1_val "Value of the coefficient Beta calculated on the couple of cylinder 1-3" SWORD _CNV_A_R_ECME_LINEA_0_CM 1 0. -32768. 32767. ECU_ADDRESS 0xd00044b0 FORMAT "%6.0" /end MEASUREMENT
/begin MEASUREMENT Vxx_tlz_b2_val "Value of the coefficient Beta calculated on the couple of cylinder 2-3" SWORD _CNV_A_R_ECME_LINEA_0_CM 1 0. -32768. 32767. ECU_ADDRESS 0xd00044b2 FORMAT "%6.0" /end MEASUREMENT
/begin MEASUREMENT Vxx_tlz_b_val "Value of the coeficient beta calculated" SWORD _CNV_A_R_ECME_LINEA_0_CM 1 0. -32768. 32767. ECU_ADDRESS 0xd00044b4 FORMAT "%6.0" /end MEASUREMENT
/begin CHARACTERISTIC Cxx_tlz_n_max "Maximum engine speed for TLZ index calculation." VALUE 0xa002179e _REC_S1VAL_20_u2 16383.75 _CNV_A_R_ENSD_LINEA_22_CM 0. 16383.75 FORMAT "%8.2" /end CHARACTERISTIC
/begin CHARACTERISTIC Cxx_tlz_n_min "Minimum engine speed for TLZ index calculation." VALUE 0xa00217a0 _REC_S1VAL_20_u2 16383.75 _CNV_A_R_ENSD_LINEA_22_CM 0. 16383.75 FORMAT "%8.2" /end CHARACTERISTIC
/begin MEASUREMENT Vbx_tlz_clc "Flag for TLZCPL computation finished" UBYTE _CNV_S_2_RANGE______3_CM 1 0. 0. 1. ECU_ADDRESS 0xd0006d52 BIT_MASK 0x1 /end MEASUREMENT
/begin MEASUREMENT Vbx_tlz_err "Error while calculating TLZ value (variable overflow...)." UBYTE _CNV_S_2_RANGE______3_CM 1 0. 0. 1. ECU_ADDRESS 0xd0006d53 BIT_MASK 0x1 /end MEASUREMENT
/begin MEASUREMENT Vbx_tlz_l_n_clc_ena "Flag for engine speed in the range for low frequency correction." UBYTE _CNV_S_2_RANGE______3_CM 1 0. 0. 1. ECU_ADDRESS 0xd0006d54 BIT_MASK 0x1 /end MEASUREMENT
/begin MEASUREMENT Vbx_tlz_off_stt "Calculation of Tlz index not enabled" UBYTE _CNV_S_2_RANGE______3_CM 1 0. 0. 1. ECU_ADDRESS 0xd0006d55 BIT_MASK 0x1 /end MEASUREMENT
/begin MEASUREMENT Vbx_tlz_raw_clc "Flag for TLZBRUT computation finished." UBYTE _CNV_S_2_RANGE______3_CM 1 0. 0. 1. ECU_ADDRESS 0xd0006d56 BIT_MASK 0x1 /end MEASUREMENT
/begin MEASUREMENT Vbx_tlz_raw_err "overflow in calculation of TLZBRUT" UBYTE _CNV_S_2_RANGE______3_CM 1 0. 0. 1. ECU_ADDRESS 0xd0006d57 BIT_MASK 0x1 /end MEASUREMENT
/begin MEASUREMENT Vsx_tlz_clc_stt "TLZ index calculation state." UBYTE _CNV_S_2_RANGE_STAT_484_CM 1 0. 0. 1. ECU_ADDRESS 0xd0006d58 /end MEASUREMENT
/begin MEASUREMENT Vxx_tlz_b_cor "Coefficient TLZ béta corrigé" SLONG _CNV_A_R_LINEAR_____485_CM 1 0. -65535. 65535. ECU_ADDRESS 0xd00027cc FORMAT "%6.0" /end MEASUREMENT
/begin MEASUREMENT Vxx_tlz_cor_tmp "Intermediary value in TLZ calculation (low engine speed)" SLONG _CNV_A_R_ECME_LINEA_0_CM 1 0. -2147483648. 2147483647. ECU_ADDRESS 0xd00027d0 FORMAT "%11.0" /end MEASUREMENT
/begin MEASUREMENT Vxx_tlz_raw_val "Raw TLZ torque index" SWORD _CNV_A_R_LINEAR_____369_CM 1 0. -3276.8 3276.7 ECU_ADDRESS 0xd00044b6 FORMAT "%7.1" /end MEASUREMENT
/begin MEASUREMENT Vxx_tlz_val "TLZ torque index" SWORD _CNV_A_R_LINEAR_____369_CM 1 0. -3276.8 3276.7 ECU_ADDRESS 0xd00044b8 FORMAT "%6.1" /end MEASUREMENT
/begin MEASUREMENT Vxx_tlz_val_tmp "Intermediary value in TLZ calculation (high engine speed)" SLONG _CNV_A_R_ECME_LINEA_0_CM 1 0. -2147483648. 2147483647. ECU_ADDRESS 0xd00027d4 FORMAT "%11.0" /end MEASUREMENT
/begin CHARACTERISTIC Cxx_tlz_a "TLZ alpha parameter: depending on the inertia of rotating elements of the engine." VALUE 0xa00217a2 _REC_S1VAL_20_u2 65535. _CNV_A_R_ECME_LINEA_0_CM 0. 65535. FORMAT "%5.0" /end CHARACTERISTIC
/begin CHARACTERISTIC Cxx_tlz_cor_n_max "Maximum engine speed to enable  correction of TLZ index at low engine speed." VALUE 0xa00217a4 _REC_S1VAL_20_u2 16383.75 _CNV_A_R_ENSD_LINEA_22_CM 0. 16383.75 FORMAT "%8.2" /end CHARACTERISTIC
/begin AXIS_PTS Ctb_mis_tlz_cor_eal "Table of engine air load breakpoints for offset correction of TLZ torque index." 0xa002e274 Vxx_eal_tdc_2 _REC_A2AXS_20_u2 3.99993896484375 _CNV_A_R_LINEAR_____53_CM 9 0. 3.99993896484375 FORMAT "%7.5" /end AXIS_PTS
/begin AXIS_PTS Ctb_mis_tlz_cor_n "Table of engine speed breakpoints for offset correction of TLZ torque index." 0xa002e288 Vxx_n _REC_A2AXS_20_u2 16383.75 _CNV_A_R_ENSD_LINEA_22_CM 9 0. 16383.75 FORMAT "%8.2" /end AXIS_PTS
/begin CHARACTERISTIC Cmp_mis_tlz_cor_cyl_0 "carto of cylinder 0/cylinder3 offset." MAP 0xa002e29c _REC_A1MAP_20_u2_u2_u2 6553.5 _CNV_A_R_LINEAR_____486_CM -3276.8 3276.7 FORMAT "%7.1"
 /begin AXIS_DESCR COM_AXIS Vxx_eal_tdc_2 _CNV_A_R_LINEAR_____53_CM 9 0. 3.99993896484375 FORMAT "%7.5" AXIS_PTS_REF Ctb_mis_tlz_cor_eal /end AXIS_DESCR
 /begin AXIS_DESCR COM_AXIS Vxx_n _CNV_A_R_ENSD_LINEA_22_CM 9 0. 16383.75 FORMAT "%8.2" AXIS_PTS_REF Ctb_mis_tlz_cor_n /end AXIS_DESCR
/end CHARACTERISTIC
/begin CHARACTERISTIC Cmp_mis_tlz_cor_cyl_1 "carto of cylinder 1/cylinder3 offset." MAP 0xa002e340 _REC_A1MAP_20_u2_u2_u2 6553.5 _CNV_A_R_LINEAR_____486_CM -3276.8 3276.7 FORMAT "%7.1"
 /begin AXIS_DESCR COM_AXIS Vxx_eal_tdc_2 _CNV_A_R_LINEAR_____53_CM 9 0. 3.99993896484375 FORMAT "%7.5" AXIS_PTS_REF Ctb_mis_tlz_cor_eal /end AXIS_DESCR
 /begin AXIS_DESCR COM_AXIS Vxx_n _CNV_A_R_ENSD_LINEA_22_CM 9 0. 16383.75 FORMAT "%8.2" AXIS_PTS_REF Ctb_mis_tlz_cor_n /end AXIS_DESCR
/end CHARACTERISTIC
/begin CHARACTERISTIC Cmp_mis_tlz_cor_cyl_2 "carto of cylinder 2/cylinder3 offset." MAP 0xa002e3e4 _REC_A1MAP_20_u2_u2_u2 6553.5 _CNV_A_R_LINEAR_____486_CM -3276.8 3276.7 FORMAT "%7.1"
 /begin AXIS_DESCR COM_AXIS Vxx_eal_tdc_2 _CNV_A_R_LINEAR_____53_CM 9 0. 3.99993896484375 FORMAT "%7.5" AXIS_PTS_REF Ctb_mis_tlz_cor_eal /end AXIS_DESCR
 /begin AXIS_DESCR COM_AXIS Vxx_n _CNV_A_R_ENSD_LINEA_22_CM 9 0. 16383.75 FORMAT "%8.2" AXIS_PTS_REF Ctb_mis_tlz_cor_n /end AXIS_DESCR
/end CHARACTERISTIC
/begin MEASUREMENT Vbx_mis_km_ena " Application of torque correction enabled by driven distance" UBYTE _CNV_S_2_RANGE______3_CM 1 0. 0. 1. ECU_ADDRESS 0xd0006d59 BIT_MASK 0x1 /end MEASUREMENT
/begin MEASUREMENT Vbx_mis_tlz_cor_ena "Recognition success, and TLZ value calculated without errors" UBYTE _CNV_S_2_RANGE______3_CM 1 0. 0. 1. ECU_ADDRESS 0xd0006d5a BIT_MASK 0x1 /end MEASUREMENT
/begin MEASUREMENT Vxx_mis_tlz_cor "Value of applied offset correction." SWORD _CNV_A_R_LINEAR_____369_CM 1 0. -3276.8 3276.7 ECU_ADDRESS 0xd00044ba FORMAT "%6.1" /end MEASUREMENT
/begin MEASUREMENT Vxx_mis_tlz_val_cor "Corrected value of TLZ index for misfire detection" SWORD _CNV_A_R_LINEAR_____369_CM 1 0. -3276.8 3276.7 ECU_ADDRESS 0xd00044bc FORMAT "%6.1" /end MEASUREMENT
/begin CHARACTERISTIC Cxx_mis_km_dly "Minimum distance driven since torquemeter init to allow torque correction" VALUE 0xa00217a6 _REC_S1VAL_20_u4 4660337.5 _CNV_A_R_LINEAR_____482_CM 0. 4660337.5 FORMAT "%9.1" /end CHARACTERISTIC
/begin AXIS_PTS Ctb_dft_comb_eal "Table of engine air load breakpoins for misfire cartographies." 0xa002e488 Vxx_eal_tdc_2 _REC_A2AXS_20_u2 3.99993896484375 _CNV_A_R_LINEAR_____53_CM 17 0. 3.99993896484375 FORMAT "%7.5" /end AXIS_PTS
/begin AXIS_PTS Ctb_mis_n_17 "Table of 17 engine speed breakpoints for the misfire strategy" 0xa002e4ac Vxx_n_tdc_2 _REC_A2AXS_20_u2 16383.75 _CNV_A_R_ENSD_LINEA_22_CM 17 0. 16383.75 FORMAT "%8.2" /end AXIS_PTS
/begin CHARACTERISTIC Cmp_det_thd_tlz_dif "Cartography of the torque delta for misfire detection threshold" MAP 0xa002e4d0 _REC_A1MAP_20_u2_u2_u2 6553.5 _CNV_A_R_LINEAR_____369_CM 0. 6553.5 FORMAT "%6.1"
 /begin AXIS_DESCR COM_AXIS Vxx_n_tdc_2 _CNV_A_R_ENSD_LINEA_22_CM 17 0. 16383.75 FORMAT "%8.2" AXIS_PTS_REF Ctb_mis_n_17 /end AXIS_DESCR
 /begin AXIS_DESCR COM_AXIS Vxx_eal_tdc_2 _CNV_A_R_LINEAR_____53_CM 17 0. 3.99993896484375 FORMAT "%7.5" AXIS_PTS_REF Ctb_dft_comb_eal /end AXIS_DESCR
/end CHARACTERISTIC
/begin CHARACTERISTIC Cmp_det_thd_tlz_dif_agb "Cartography of the torque delta for misfire detection threshold in AGB unlocked" MAP 0xa002e714 _REC_A1MAP_20_u2_u2_u2 6553.5 _CNV_A_R_LINEAR_____369_CM 0. 6553.5 FORMAT "%6.1"
 /begin AXIS_DESCR COM_AXIS Vxx_n_tdc_2 _CNV_A_R_ENSD_LINEA_22_CM 17 0. 16383.75 FORMAT "%8.2" AXIS_PTS_REF Ctb_mis_n_17 /end AXIS_DESCR
 /begin AXIS_DESCR COM_AXIS Vxx_eal_tdc_2 _CNV_A_R_LINEAR_____53_CM 17 0. 3.99993896484375 FORMAT "%7.5" AXIS_PTS_REF Ctb_dft_comb_eal /end AXIS_DESCR
/end CHARACTERISTIC
/begin CHARACTERISTIC Cmp_det_thd_tlz_dif_lpg "Cartography of the torque delta for misfire detection threshold in LPG" MAP 0xa002e958 _REC_A1MAP_20_u2_u2_u2 6553.5 _CNV_A_R_LINEAR_____369_CM 0. 6553.5 FORMAT "%6.1"
 /begin AXIS_DESCR COM_AXIS Vxx_n_tdc_2 _CNV_A_R_ENSD_LINEA_22_CM 17 0. 16383.75 FORMAT "%8.2" AXIS_PTS_REF Ctb_mis_n_17 /end AXIS_DESCR
 /begin AXIS_DESCR COM_AXIS Vxx_eal_tdc_2 _CNV_A_R_LINEAR_____53_CM 17 0. 3.99993896484375 FORMAT "%7.5" AXIS_PTS_REF Ctb_dft_comb_eal /end AXIS_DESCR
/end CHARACTERISTIC
/begin CHARACTERISTIC Ctp_tlz_fil_fac "Filtering factors table of the TLZ torque" CURVE 0xa002eb9c _REC_A1CUR_20_u1_u2 0.99609375 _CNV_A_R_LINEAR_____29_CM 0. 0.99609375 FORMAT "%10.8"
 /begin AXIS_DESCR COM_AXIS Vxx_eal_tdc_2 _CNV_A_R_LINEAR_____53_CM 17 0. 3.99993896484375 FORMAT "%7.5" AXIS_PTS_REF Ctb_dft_comb_eal /end AXIS_DESCR
/end CHARACTERISTIC
/begin CHARACTERISTIC Ctp_tlz_fil_fac_lpg "Filtering factors table of the TLZ torque LPG" CURVE 0xa002ebb0 _REC_A1CUR_20_u1_u2 0.99609375 _CNV_A_R_LINEAR_____29_CM 0. 0.99609375 FORMAT "%10.8"
 /begin AXIS_DESCR COM_AXIS Vxx_eal_tdc_2 _CNV_A_R_LINEAR_____53_CM 17 0. 3.99993896484375 FORMAT "%7.5" AXIS_PTS_REF Ctb_dft_comb_eal /end AXIS_DESCR
/end CHARACTERISTIC
/begin CHARACTERISTIC Ctp_tlz_fil_rst_eal_dif "Delta of air mass for TLZ filter reset function of pressure in tdc(i-2)" CURVE 0xa002ebc4 _REC_A1CUR_20_u2_u2 3.99993896484375 _CNV_A_R_LINEAR_____53_CM 0. 3.99993896484375 FORMAT "%7.5"
 /begin AXIS_DESCR COM_AXIS Vxx_eal_tdc_2 _CNV_A_R_LINEAR_____53_CM 17 0. 3.99993896484375 FORMAT "%7.5" AXIS_PTS_REF Ctb_dft_comb_eal /end AXIS_DESCR
/end CHARACTERISTIC
/begin MEASUREMENT Vbx_mis_fil_rst_eal_dif "Detection of load delta filters reset TLZ (misfire diagnosis inhibition)" UBYTE _CNV_S_2_RANGE______3_CM 1 0. 0. 1. ECU_ADDRESS 0xd0006d60 BIT_MASK 0x1 /end MEASUREMENT
/begin MEASUREMENT Vbx_mis_fil_rst_eal_dif2 "Detection of engine speed delta reset filters TLZ i-2 (inhibition misfire diagnosis)" UBYTE _CNV_S_2_RANGE______3_CM 1 0. 0. 1. ECU_ADDRESS 0xd0006d61 BIT_MASK 0x1 /end MEASUREMENT
/begin MEASUREMENT Vbx_mis_fil_rst_n_dif "Detection of engine speed delta filters reset TLZ (misfire diagnosis inhibition)" UBYTE _CNV_S_2_RANGE______3_CM 1 0. 0. 1. ECU_ADDRESS 0xd0006d62 BIT_MASK 0x1 /end MEASUREMENT
/begin MEASUREMENT Vbx_mis_fil_rst_n_dif2 "Detection of engine speed delta reset filters TLZ i-2 (inhibition misfire diagnosis)" UBYTE _CNV_S_2_RANGE______3_CM 1 0. 0. 1. ECU_ADDRESS 0xd0006d63 BIT_MASK 0x1 /end MEASUREMENT
/begin MEASUREMENT Vbx_mis_stat_fil "TLZ filter blocking" UBYTE _CNV_S_2_RANGE______3_CM 1 0. 0. 1. ECU_ADDRESS 0xd0006d64 BIT_MASK 0x1 /end MEASUREMENT
/begin MEASUREMENT Vbx_mis_stat_fil4 "TLZ filter blocking in tdc(i-4)" UBYTE _CNV_S_2_RANGE______3_CM 1 0. 0. 1. ECU_ADDRESS 0xd0006d65 BIT_MASK 0x1 /end MEASUREMENT
/begin MEASUREMENT Vbx_mis_tlz_fil_rst "TLZ filter reset (misfire diagnosis inhibition)" UBYTE _CNV_S_2_RANGE______3_CM 1 0. 0. 1. ECU_ADDRESS 0xd0006d66 BIT_MASK 0x1 /end MEASUREMENT
/begin MEASUREMENT Vsx_mis_tlz_vld "Ivld TLZ pour le misfire" UBYTE _CNV_S_8_STATUS_OK__234_CM 1 0. 0. 7. ECU_ADDRESS 0xd0006d67 /end MEASUREMENT
/begin MEASUREMENT Vxx_mis_tlz_dif "Torque delta for misfire detection threshold" UWORD _CNV_A_R_LINEAR_____369_CM 1 0. 0. 6553.5 ECU_ADDRESS 0xd00044be FORMAT "%6.1" /end MEASUREMENT
/begin MEASUREMENT Vxx_mis_tlz_fil_mes "Torque gaz filtered at current tdc" SWORD _CNV_A_R_LINEAR_____369_CM 1 0. -3276.8 3276.7 ECU_ADDRESS 0xd00044c0 FORMAT "%6.1" /end MEASUREMENT
/begin MEASUREMENT Vxx_mis_tlz_fil_mes1 "Torque gaz filtered at tdc i-1" SWORD _CNV_A_R_LINEAR_____369_CM 1 0. -3276.8 3276.7 ECU_ADDRESS 0xd00044c2 FORMAT "%6.1" /end MEASUREMENT
/begin MEASUREMENT Vxx_mis_tlz_fil_mes2 "Torque gaz filtered at tdc i-2" SWORD _CNV_A_R_LINEAR_____369_CM 1 0. -3276.8 3276.7 ECU_ADDRESS 0xd00044c4 FORMAT "%6.1" /end MEASUREMENT
/begin MEASUREMENT Vxx_mis_tlz_fil_mes3 "Torque gaz filtered at tdc i-3" SWORD _CNV_A_R_LINEAR_____369_CM 1 0. -3276.8 3276.7 ECU_ADDRESS 0xd00044c6 FORMAT "%6.1" /end MEASUREMENT
/begin MEASUREMENT Vxx_mis_tlz_fil_mes4 "Torque gaz filtered at tdc i-4" SWORD _CNV_A_R_LINEAR_____369_CM 1 0. -3276.8 3276.7 ECU_ADDRESS 0xd00044c8 FORMAT "%6.1" /end MEASUREMENT
/begin CHARACTERISTIC Cxx_tlz_fil_rat "Reliable factor for the TLZ torque filtering" VALUE 0xa00217ac _REC_S1VAL_20_u1 0.99609375 _CNV_A_R_LINEAR_____29_CM 0. 0.99609375 FORMAT "%10.8" /end CHARACTERISTIC
/begin CHARACTERISTIC Cxx_tlz_fil_rat_lpg "Reliable factor for the TLZ torque filtering LPG" VALUE 0xa00217ad _REC_S1VAL_20_u1 0.99609375 _CNV_A_R_LINEAR_____29_CM 0. 0.99609375 FORMAT "%10.8" /end CHARACTERISTIC
/begin CHARACTERISTIC Cxx_tlz_fil_rst_n_dif_thd "Threshold of speed engine delta for TLZ torque reset" VALUE 0xa00217aa _REC_S1VAL_20_u2 16383.75 _CNV_A_R_ENSD_LINEA_22_CM 0. 16383.75 FORMAT "%8.2" /end CHARACTERISTIC
/begin CHARACTERISTIC Cmp_det_thd_tlz_dif_agb_alco "Cartography of the torque delta for misfire detection threshold in AGB unlocked : alcohol setting" MAP 0xa002ddc0 _REC_A1MAP_20_u2_u2_u2 6553.5 _CNV_A_R_LINEAR_____369_CM 0. 6553.5 FORMAT "%6.1"
 /begin AXIS_DESCR COM_AXIS Vxx_n_tdc_2 _CNV_A_R_ENSD_LINEA_22_CM 17 0. 16383.75 FORMAT "%8.2" AXIS_PTS_REF Ctb_mis_n_17 /end AXIS_DESCR
 /begin AXIS_DESCR COM_AXIS Vxx_eal_tdc_2 _CNV_A_R_LINEAR_____53_CM 17 0. 3.99993896484375 FORMAT "%7.5" AXIS_PTS_REF Ctb_dft_comb_eal /end AXIS_DESCR
/end CHARACTERISTIC
/begin CHARACTERISTIC Cmp_det_thd_tlz_dif_alco "Cartography of the torque delta for misfire detection threshold : alcohol setting" MAP 0xa002e004 _REC_A1MAP_20_u2_u2_u2 6553.5 _CNV_A_R_LINEAR_____369_CM 0. 6553.5 FORMAT "%6.1"
 /begin AXIS_DESCR COM_AXIS Vxx_n_tdc_2 _CNV_A_R_ENSD_LINEA_22_CM 17 0. 16383.75 FORMAT "%8.2" AXIS_PTS_REF Ctb_mis_n_17 /end AXIS_DESCR
 /begin AXIS_DESCR COM_AXIS Vxx_eal_tdc_2 _CNV_A_R_LINEAR_____53_CM 17 0. 3.99993896484375 FORMAT "%7.5" AXIS_PTS_REF Ctb_dft_comb_eal /end AXIS_DESCR
/end CHARACTERISTIC
/begin MEASUREMENT Vxx_det_thd_tlz_dif_agb_alco "Torque delta for misfire detection threshold in AGB unlocked : alcohol setting" UWORD _CNV_A_R_LINEAR_____369_CM 1 0. 0. 6553.5 ECU_ADDRESS 0xd0004498 FORMAT "%6.1" /end MEASUREMENT
/begin MEASUREMENT Vxx_det_thd_tlz_dif_alco "Torque delta for misfire detection threshold : alcohol setting" UWORD _CNV_A_R_LINEAR_____369_CM 1 0. 0. 6553.5 ECU_ADDRESS 0xd000449a FORMAT "%6.1" /end MEASUREMENT
/begin MEASUREMENT Vbx_tq_rams_lim_spc_act_1 "Specific activation of safety torque limitation level 1 (low)" UBYTE _CNV_S_2_RANGE______3_CM 1 0. 0. 1. ECU_ADDRESS 0xd0007cc3 BIT_MASK 0x1 /end MEASUREMENT
/begin MEASUREMENT Vbx_tq_rams_lim_spc_act_2 "Specific activation of safety torque limitation level 2 (mean)" UBYTE _CNV_S_2_RANGE______3_CM 1 0. 0. 1. ECU_ADDRESS 0xd0007cc4 BIT_MASK 0x1 /end MEASUREMENT
/begin MEASUREMENT Vbx_tq_rams_lim_spc_act_3 "Specific activation of safety vehicule speed converted in torque limitation level 3 (strong)" UBYTE _CNV_S_2_RANGE______3_CM 1 0. 0. 1. ECU_ADDRESS 0xd0007cc5 BIT_MASK 0x1 /end MEASUREMENT
/begin AXIS_PTS Ctb_cur_spd "Bkpts of turbine speed" 0xa0037140 Vxx_n _REC_A2AXS_20_u2 16383.75 _CNV_R_R_VA_F_0v25__491_CM 8 0. 16383.75 FORMAT "%9.2" /end AXIS_PTS
/begin AXIS_PTS Ctb_down_shf_pdl "Breakpoints of free shift pedal for down shift map" 0xa0037554 Vxx_free_shf_pdl _REC_A2AXS_20_u2 100. _CNV_R_R_VA_F_0v125_492_CM 11 0. 100. FORMAT "%9.2" /end AXIS_PTS
/begin AXIS_PTS Ctb_fast_off_pdl_grd "Pedal gradient breakpoints" 0xa0037154 Vxx_pdl_grd _REC_A2AXS_20_u2 4000. _CNV_R_R_VA_F_0v125_493_CM 5 -2000. 2000. FORMAT "%9.2" /end AXIS_PTS
/begin AXIS_PTS Ctb_law "Laws breakpoints (cata,eco,uphill, ...)" 0xa0022246 Vsx_law_sel _REC_A2AXS_20_u1 4. _CNV_R_R_VA_F_1_p1__494_CM 5 1. 5. FORMAT "%9.2" /end AXIS_PTS
/begin AXIS_PTS Ctb_n_apmp "Engine speed bkpts" 0xa003708c Vxx_n_gear _REC_A2AXS_20_u2 16383.75 _CNV_R_R_VA_F_0v25__495_CM 17 0. 16383.75 FORMAT "%9.2" /end AXIS_PTS
/begin AXIS_PTS Ctb_up_shf_pdl "Breakpoints of free shift pedal for up shift map" 0xa003756c Vxx_free_shf_pdl _REC_A2AXS_20_u2 100. _CNV_R_R_VA_F_0v125_492_CM 11 0. 100. FORMAT "%9.2" /end AXIS_PTS
/begin CHARACTERISTIC Cmp_cur_tra_acel_thd "Map of transverse acceleration function of the vehicle speed and gear" MAP 0xa00370e0 _REC_A1MAP_20_u2_u1_u2 13.5 _CNV_R_R_VA_F_0v000_496_CM 0. 13.5 FORMAT "%9.4"
 /begin AXIS_DESCR COM_AXIS NO_INPUT_QUANTITY _CNV_R_R_VA_F_1_p1__494_CM 6 1. 6. FORMAT "%9.2" AXIS_PTS_REF Ctb_gear_fs /end AXIS_DESCR
 /begin AXIS_DESCR COM_AXIS Vxx_n _CNV_R_R_VA_F_0v25__491_CM 8 0. 16383.75 FORMAT "%9.2" AXIS_PTS_REF Ctb_cur_spd /end AXIS_DESCR
/end CHARACTERISTIC
/begin CHARACTERISTIC Cmp_fast_off_law_pdl_grd_dly "Map of temporization values for the fast off function" MAP 0xa003716c _REC_A1MAP_20_u1_u1_u2 5.1 _CNV_R_R_VA_F_0v02__497_CM 0. 5.1 FORMAT "%9.2"
 /begin AXIS_DESCR COM_AXIS Vsx_law_sel _CNV_R_R_VA_F_1_p1__494_CM 5 1. 5. FORMAT "%9.2" AXIS_PTS_REF Ctb_law /end AXIS_DESCR
 /begin AXIS_DESCR COM_AXIS Vxx_pdl_grd _CNV_R_R_VA_F_0v125_493_CM 5 -2000. 2000. FORMAT "%9.2" AXIS_PTS_REF Ctb_fast_off_pdl_grd /end AXIS_DESCR
/end CHARACTERISTIC
/begin CHARACTERISTIC Ctp_apmp_max_pow "Theoretical maximum engine power at curent engine speed" CURVE 0xa00370bc _REC_A1CUR_20_u2_u2 655350. _CNV_R_R_VA_F_10_m3_498_CM -327680. 327670. FORMAT "%9.2"
 /begin AXIS_DESCR COM_AXIS Vxx_n_gear _CNV_R_R_VA_F_0v25__495_CM 17 0. 16383.75 FORMAT "%9.2" AXIS_PTS_REF Ctb_n_apmp /end AXIS_DESCR
/end CHARACTERISTIC
/begin CHARACTERISTIC Ctp_brk_ass_fac "Brake assistance gain for each gear ratio" CURVE 0xa0022274 _REC_A1CUR_20_u1_u1 25.5 _CNV_R_R_VA_F_0v1_p_499_CM 0. 25.5 FORMAT "%9.2"
 /begin AXIS_DESCR COM_AXIS NO_INPUT_QUANTITY _CNV_R_R_VA_F_1_p1__494_CM 6 1. 6. FORMAT "%9.2" AXIS_PTS_REF Ctb_gear_fs /end AXIS_DESCR
/end CHARACTERISTIC
/begin CHARACTERISTIC Ctp_cur_dly "Table of temporization function of the gear" CURVE 0xa0022216 _REC_A1CUR_20_u1_u1 5.1 _CNV_R_R_VA_F_0v02__497_CM 0. 5.1 FORMAT "%9.2"
 /begin AXIS_DESCR COM_AXIS NO_INPUT_QUANTITY _CNV_R_R_VA_F_1_p1__494_CM 6 1. 6. FORMAT "%9.2" AXIS_PTS_REF Ctb_gear_fs /end AXIS_DESCR
/end CHARACTERISTIC
/begin CHARACTERISTIC Ctp_dhil_n_up_shf_in_thd "Table of engine speed to enter in upshift state" CURVE 0xa0037584 _REC_A1CUR_20_u2_u1 16383.75 _CNV_R_R_VA_F_0v25__495_CM 0. 16383.75 FORMAT "%9.2"
 /begin AXIS_DESCR COM_AXIS NO_INPUT_QUANTITY _CNV_R_R_VA_F_1_p1__494_CM 6 1. 6. FORMAT "%9.2" AXIS_PTS_REF Ctb_gear_fs /end AXIS_DESCR
/end CHARACTERISTIC
/begin CHARACTERISTIC Ctp_dhil_n_up_shf_out_thd "Table of engine speed to exit the upshift state" CURVE 0xa0037590 _REC_A1CUR_20_u2_u1 16383.75 _CNV_R_R_VA_F_0v25__495_CM 0. 16383.75 FORMAT "%9.2"
 /begin AXIS_DESCR COM_AXIS NO_INPUT_QUANTITY _CNV_R_R_VA_F_1_p1__494_CM 6 1. 6. FORMAT "%9.2" AXIS_PTS_REF Ctb_gear_fs /end AXIS_DESCR
/end CHARACTERISTIC
/begin CHARACTERISTIC Ctp_dhil_vs_down_shf_thd "Table of vehicle speed thresholds for down shift recommendation" CURVE 0xa003759c _REC_A1CUR_20_u2_u1 655.35 _CNV_R_R_VA_F_0v01__500_CM 0. 655.35 FORMAT "%9.2"
 /begin AXIS_DESCR COM_AXIS NO_INPUT_QUANTITY _CNV_R_R_VA_F_1_p1__494_CM 6 1. 6. FORMAT "%9.2" AXIS_PTS_REF Ctb_gear_fs /end AXIS_DESCR
/end CHARACTERISTIC
/begin CHARACTERISTIC Ctp_fast_off_kd_n_thd "Map of engine speed values for kick" CURVE 0xa0037160 _REC_A1CUR_20_u2_u1 16383.75 _CNV_R_R_VA_F_0v25__495_CM 0. 16383.75 FORMAT "%9.2"
 /begin AXIS_DESCR COM_AXIS NO_INPUT_QUANTITY _CNV_R_R_VA_F_1_p1__494_CM 6 1. 6. FORMAT "%9.2" AXIS_PTS_REF Ctb_gear_fs /end AXIS_DESCR
/end CHARACTERISTIC
/begin CHARACTERISTIC Ctp_fast_off_no_pdl_dly "Map of temporization values for foot up" CURVE 0xa002224c _REC_A1CUR_20_u1_u1 5.1 _CNV_R_R_VA_F_0v02__497_CM 0. 5.1 FORMAT "%9.2"
 /begin AXIS_DESCR COM_AXIS NO_INPUT_QUANTITY _CNV_R_R_VA_F_1_p1__494_CM 6 1. 6. FORMAT "%9.2" AXIS_PTS_REF Ctb_gear_fs /end AXIS_DESCR
/end CHARACTERISTIC
/begin CHARACTERISTIC Ctp_gear_pdl_no_seq_dly "Map of temporization value for the up shift sequence control" CURVE 0xa0022232 _REC_A1CUR_20_u1_u1 5.1 _CNV_R_R_VA_F_0v02__497_CM 0. 5.1 FORMAT "%9.2"
 /begin AXIS_DESCR COM_AXIS NO_INPUT_QUANTITY _CNV_R_R_VA_F_1_p1__494_CM 6 1. 6. FORMAT "%9.2" AXIS_PTS_REF Ctb_gear_fs /end AXIS_DESCR
/end CHARACTERISTIC
/begin CHARACTERISTIC Ctp_law_eco_1_2 "Table of gear shifting form 1 to 2 for the eco law" CURVE 0xa0037188 _REC_A1CUR_20_u2_u2 655.35 _CNV_R_R_VA_F_0v01__500_CM 0. 655.35 FORMAT "%9.2"
 /begin AXIS_DESCR COM_AXIS Vxx_free_shf_pdl _CNV_R_R_VA_F_0v125_492_CM 11 0. 100. FORMAT "%9.2" AXIS_PTS_REF Ctb_up_shf_pdl /end AXIS_DESCR
/end CHARACTERISTIC
/begin CHARACTERISTIC Ctp_law_eco_2_1 "Table of gear shifting form 2 to 1 for the eco law" CURVE 0xa00371a0 _REC_A1CUR_20_u2_u2 655.35 _CNV_R_R_VA_F_0v01__500_CM 0. 655.35 FORMAT "%9.2"
 /begin AXIS_DESCR COM_AXIS Vxx_free_shf_pdl _CNV_R_R_VA_F_0v125_492_CM 11 0. 100. FORMAT "%9.2" AXIS_PTS_REF Ctb_down_shf_pdl /end AXIS_DESCR
/end CHARACTERISTIC
/begin CHARACTERISTIC Ctp_law_eco_2_3 "Table of gear shifting form 2 to 3 for the eco law" CURVE 0xa00371b8 _REC_A1CUR_20_u2_u2 655.35 _CNV_R_R_VA_F_0v01__500_CM 0. 655.35 FORMAT "%9.2"
 /begin AXIS_DESCR COM_AXIS Vxx_free_shf_pdl _CNV_R_R_VA_F_0v125_492_CM 11 0. 100. FORMAT "%9.2" AXIS_PTS_REF Ctb_up_shf_pdl /end AXIS_DESCR
/end CHARACTERISTIC
/begin CHARACTERISTIC Ctp_law_eco_3_2 "Table of gear shifting form 3 to 2 for the eco law" CURVE 0xa00371d0 _REC_A1CUR_20_u2_u2 655.35 _CNV_R_R_VA_F_0v01__500_CM 0. 655.35 FORMAT "%9.2"
 /begin AXIS_DESCR COM_AXIS Vxx_free_shf_pdl _CNV_R_R_VA_F_0v125_492_CM 11 0. 100. FORMAT "%9.2" AXIS_PTS_REF Ctb_down_shf_pdl /end AXIS_DESCR
/end CHARACTERISTIC
/begin CHARACTERISTIC Ctp_law_eco_3_4 "Table of gear shifting form 3 to 4 for the eco law" CURVE 0xa00371e8 _REC_A1CUR_20_u2_u2 655.35 _CNV_R_R_VA_F_0v01__500_CM 0. 655.35 FORMAT "%9.2"
 /begin AXIS_DESCR COM_AXIS Vxx_free_shf_pdl _CNV_R_R_VA_F_0v125_492_CM 11 0. 100. FORMAT "%9.2" AXIS_PTS_REF Ctb_up_shf_pdl /end AXIS_DESCR
/end CHARACTERISTIC
/begin CHARACTERISTIC Ctp_law_eco_4_3 "Table of gear shifting form 4 to 3 for the eco law" CURVE 0xa0037200 _REC_A1CUR_20_u2_u2 655.35 _CNV_R_R_VA_F_0v01__500_CM 0. 655.35 FORMAT "%9.2"
 /begin AXIS_DESCR COM_AXIS Vxx_free_shf_pdl _CNV_R_R_VA_F_0v125_492_CM 11 0. 100. FORMAT "%9.2" AXIS_PTS_REF Ctb_down_shf_pdl /end AXIS_DESCR
/end CHARACTERISTIC
/begin CHARACTERISTIC Ctp_law_eco_4_5 "Table of gear shifting form 4 to 5 for the eco law" CURVE 0xa0037218 _REC_A1CUR_20_u2_u2 655.35 _CNV_R_R_VA_F_0v01__500_CM 0. 655.35 FORMAT "%9.2"
 /begin AXIS_DESCR COM_AXIS Vxx_free_shf_pdl _CNV_R_R_VA_F_0v125_492_CM 11 0. 100. FORMAT "%9.2" AXIS_PTS_REF Ctb_up_shf_pdl /end AXIS_DESCR
/end CHARACTERISTIC
/begin CHARACTERISTIC Ctp_law_eco_5_4 "Table of gear shifting form 5 to 4 for the eco law" CURVE 0xa0037230 _REC_A1CUR_20_u2_u2 655.35 _CNV_R_R_VA_F_0v01__500_CM 0. 655.35 FORMAT "%9.2"
 /begin AXIS_DESCR COM_AXIS Vxx_free_shf_pdl _CNV_R_R_VA_F_0v125_492_CM 11 0. 100. FORMAT "%9.2" AXIS_PTS_REF Ctb_down_shf_pdl /end AXIS_DESCR
/end CHARACTERISTIC
/begin CHARACTERISTIC Ctp_law_eco_5_6 "Table of gear shifting form 5 to 6 for the eco law" CURVE 0xa0037248 _REC_A1CUR_20_u2_u2 655.35 _CNV_R_R_VA_F_0v01__500_CM 0. 655.35 FORMAT "%9.2"
 /begin AXIS_DESCR COM_AXIS Vxx_free_shf_pdl _CNV_R_R_VA_F_0v125_492_CM 11 0. 100. FORMAT "%9.2" AXIS_PTS_REF Ctb_up_shf_pdl /end AXIS_DESCR
/end CHARACTERISTIC
/begin CHARACTERISTIC Ctp_law_eco_6_5 "Table of gear shifting form 6 to 5 for the eco law" CURVE 0xa0037260 _REC_A1CUR_20_u2_u2 655.35 _CNV_R_R_VA_F_0v01__500_CM 0. 655.35 FORMAT "%9.2"
 /begin AXIS_DESCR COM_AXIS Vxx_free_shf_pdl _CNV_R_R_VA_F_0v125_492_CM 11 0. 100. FORMAT "%9.2" AXIS_PTS_REF Ctb_down_shf_pdl /end AXIS_DESCR
/end CHARACTERISTIC
/begin CHARACTERISTIC Ctp_law_uhil_1_2 "Table of gear shifting form 1 to 2 for the uphill law" CURVE 0xa0037278 _REC_A1CUR_20_u2_u2 655.35 _CNV_R_R_VA_F_0v01__500_CM 0. 655.35 FORMAT "%9.2"
 /begin AXIS_DESCR COM_AXIS Vxx_free_shf_pdl _CNV_R_R_VA_F_0v125_492_CM 11 0. 100. FORMAT "%9.2" AXIS_PTS_REF Ctb_up_shf_pdl /end AXIS_DESCR
/end CHARACTERISTIC
/begin CHARACTERISTIC Ctp_law_uhil_2_1 "Table of gear shifting form 2 to 1 for the uphill law" CURVE 0xa0037290 _REC_A1CUR_20_u2_u2 655.35 _CNV_R_R_VA_F_0v01__500_CM 0. 655.35 FORMAT "%9.2"
 /begin AXIS_DESCR COM_AXIS Vxx_free_shf_pdl _CNV_R_R_VA_F_0v125_492_CM 11 0. 100. FORMAT "%9.2" AXIS_PTS_REF Ctb_down_shf_pdl /end AXIS_DESCR
/end CHARACTERISTIC
/begin CHARACTERISTIC Ctp_law_uhil_2_3 "Table of gear shifting form 2 to 3 for the uphill law" CURVE 0xa00372a8 _REC_A1CUR_20_u2_u2 655.35 _CNV_R_R_VA_F_0v01__500_CM 0. 655.35 FORMAT "%9.2"
 /begin AXIS_DESCR COM_AXIS Vxx_free_shf_pdl _CNV_R_R_VA_F_0v125_492_CM 11 0. 100. FORMAT "%9.2" AXIS_PTS_REF Ctb_up_shf_pdl /end AXIS_DESCR
/end CHARACTERISTIC
/begin CHARACTERISTIC Ctp_law_uhil_3_2 "Table of gear shifting form 3 to 2 for the uphill law" CURVE 0xa00372c0 _REC_A1CUR_20_u2_u2 655.35 _CNV_R_R_VA_F_0v01__500_CM 0. 655.35 FORMAT "%9.2"
 /begin AXIS_DESCR COM_AXIS Vxx_free_shf_pdl _CNV_R_R_VA_F_0v125_492_CM 11 0. 100. FORMAT "%9.2" AXIS_PTS_REF Ctb_down_shf_pdl /end AXIS_DESCR
/end CHARACTERISTIC
/begin CHARACTERISTIC Ctp_law_uhil_3_4 "Table of gear shifting form 3 to 4 for the uphill law" CURVE 0xa00372d8 _REC_A1CUR_20_u2_u2 655.35 _CNV_R_R_VA_F_0v01__500_CM 0. 655.35 FORMAT "%9.2"
 /begin AXIS_DESCR COM_AXIS Vxx_free_shf_pdl _CNV_R_R_VA_F_0v125_492_CM 11 0. 100. FORMAT "%9.2" AXIS_PTS_REF Ctb_up_shf_pdl /end AXIS_DESCR
/end CHARACTERISTIC
/begin CHARACTERISTIC Ctp_law_uhil_4_3 "Table of gear shifting form 4 to 3 for the uphill law" CURVE 0xa00372f0 _REC_A1CUR_20_u2_u2 655.35 _CNV_R_R_VA_F_0v01__500_CM 0. 655.35 FORMAT "%9.2"
 /begin AXIS_DESCR COM_AXIS Vxx_free_shf_pdl _CNV_R_R_VA_F_0v125_492_CM 11 0. 100. FORMAT "%9.2" AXIS_PTS_REF Ctb_down_shf_pdl /end AXIS_DESCR
/end CHARACTERISTIC
/begin CHARACTERISTIC Ctp_law_uhil_4_5 "Table of gear shifting form 4 to 5 for the uphill law" CURVE 0xa0037308 _REC_A1CUR_20_u2_u2 655.35 _CNV_R_R_VA_F_0v01__500_CM 0. 655.35 FORMAT "%9.2"
 /begin AXIS_DESCR COM_AXIS Vxx_free_shf_pdl _CNV_R_R_VA_F_0v125_492_CM 11 0. 100. FORMAT "%9.2" AXIS_PTS_REF Ctb_up_shf_pdl /end AXIS_DESCR
/end CHARACTERISTIC
/begin CHARACTERISTIC Ctp_law_uhil_5_4 "Table of gear shifting form 5 to 4 for the uphill law" CURVE 0xa0037320 _REC_A1CUR_20_u2_u2 655.35 _CNV_R_R_VA_F_0v01__500_CM 0. 655.35 FORMAT "%9.2"
 /begin AXIS_DESCR COM_AXIS Vxx_free_shf_pdl _CNV_R_R_VA_F_0v125_492_CM 11 0. 100. FORMAT "%9.2" AXIS_PTS_REF Ctb_down_shf_pdl /end AXIS_DESCR
/end CHARACTERISTIC
/begin CHARACTERISTIC Ctp_law_uhil_5_6 "Table of gear shifting form 5 to 6 for the uphill law" CURVE 0xa0037338 _REC_A1CUR_20_u2_u2 655.35 _CNV_R_R_VA_F_0v01__500_CM 0. 655.35 FORMAT "%9.2"
 /begin AXIS_DESCR COM_AXIS Vxx_free_shf_pdl _CNV_R_R_VA_F_0v125_492_CM 11 0. 100. FORMAT "%9.2" AXIS_PTS_REF Ctb_up_shf_pdl /end AXIS_DESCR
/end CHARACTERISTIC
/begin CHARACTERISTIC Ctp_law_uhil_6_5 "Table of gear shifting form 6 to 5 for the uphill law" CURVE 0xa0037350 _REC_A1CUR_20_u2_u2 655.35 _CNV_R_R_VA_F_0v01__500_CM 0. 655.35 FORMAT "%9.2"
 /begin AXIS_DESCR COM_AXIS Vxx_free_shf_pdl _CNV_R_R_VA_F_0v125_492_CM 11 0. 100. FORMAT "%9.2" AXIS_PTS_REF Ctb_down_shf_pdl /end AXIS_DESCR
/end CHARACTERISTIC
/begin CHARACTERISTIC Ctp_law_wup_cata_1_2 "Table of gear shifting form 1 to 2 for the cata law" CURVE 0xa0037368 _REC_A1CUR_20_u2_u2 655.35 _CNV_R_R_VA_F_0v01__500_CM 0. 655.35 FORMAT "%9.2"
 /begin AXIS_DESCR COM_AXIS Vxx_free_shf_pdl _CNV_R_R_VA_F_0v125_492_CM 11 0. 100. FORMAT "%9.2" AXIS_PTS_REF Ctb_up_shf_pdl /end AXIS_DESCR
/end CHARACTERISTIC
/begin CHARACTERISTIC Ctp_law_wup_cata_2_1 "Table of gear shifting form 2 to 1 for the cata law" CURVE 0xa0037380 _REC_A1CUR_20_u2_u2 655.35 _CNV_R_R_VA_F_0v01__500_CM 0. 655.35 FORMAT "%9.2"
 /begin AXIS_DESCR COM_AXIS Vxx_free_shf_pdl _CNV_R_R_VA_F_0v125_492_CM 11 0. 100. FORMAT "%9.2" AXIS_PTS_REF Ctb_down_shf_pdl /end AXIS_DESCR
/end CHARACTERISTIC
/begin CHARACTERISTIC Ctp_law_wup_cata_2_3 "Table of gear shifting form 2 to 3 for the cata law" CURVE 0xa0037398 _REC_A1CUR_20_u2_u2 655.35 _CNV_R_R_VA_F_0v01__500_CM 0. 655.35 FORMAT "%9.2"
 /begin AXIS_DESCR COM_AXIS Vxx_free_shf_pdl _CNV_R_R_VA_F_0v125_492_CM 11 0. 100. FORMAT "%9.2" AXIS_PTS_REF Ctb_up_shf_pdl /end AXIS_DESCR
/end CHARACTERISTIC
/begin CHARACTERISTIC Ctp_law_wup_cata_3_2 "Table of gear shifting form 3 to 2 for the cata law" CURVE 0xa00373b0 _REC_A1CUR_20_u2_u2 655.35 _CNV_R_R_VA_F_0v01__500_CM 0. 655.35 FORMAT "%9.2"
 /begin AXIS_DESCR COM_AXIS Vxx_free_shf_pdl _CNV_R_R_VA_F_0v125_492_CM 11 0. 100. FORMAT "%9.2" AXIS_PTS_REF Ctb_down_shf_pdl /end AXIS_DESCR
/end CHARACTERISTIC
/begin CHARACTERISTIC Ctp_law_wup_cata_3_4 "Table of gear shifting form 3 to 4 for the cata law" CURVE 0xa00373c8 _REC_A1CUR_20_u2_u2 655.35 _CNV_R_R_VA_F_0v01__500_CM 0. 655.35 FORMAT "%9.2"
 /begin AXIS_DESCR COM_AXIS Vxx_free_shf_pdl _CNV_R_R_VA_F_0v125_492_CM 11 0. 100. FORMAT "%9.2" AXIS_PTS_REF Ctb_up_shf_pdl /end AXIS_DESCR
/end CHARACTERISTIC
/begin CHARACTERISTIC Ctp_law_wup_cata_4_3 "Table of gear shifting form 4 to 3 for the cata law" CURVE 0xa00373e0 _REC_A1CUR_20_u2_u2 655.35 _CNV_R_R_VA_F_0v01__500_CM 0. 655.35 FORMAT "%9.2"
 /begin AXIS_DESCR COM_AXIS Vxx_free_shf_pdl _CNV_R_R_VA_F_0v125_492_CM 11 0. 100. FORMAT "%9.2" AXIS_PTS_REF Ctb_down_shf_pdl /end AXIS_DESCR
/end CHARACTERISTIC
/begin CHARACTERISTIC Ctp_law_wup_cata_4_5 "Table of gear shifting form 4 to 5 for the cata law" CURVE 0xa00373f8 _REC_A1CUR_20_u2_u2 655.35 _CNV_R_R_VA_F_0v01__500_CM 0. 655.35 FORMAT "%9.2"
 /begin AXIS_DESCR COM_AXIS Vxx_free_shf_pdl _CNV_R_R_VA_F_0v125_492_CM 11 0. 100. FORMAT "%9.2" AXIS_PTS_REF Ctb_up_shf_pdl /end AXIS_DESCR
/end CHARACTERISTIC
/begin CHARACTERISTIC Ctp_law_wup_cata_5_4 "Table of gear shifting form 5 to 4 for the cata law" CURVE 0xa0037410 _REC_A1CUR_20_u2_u2 655.35 _CNV_R_R_VA_F_0v01__500_CM 0. 655.35 FORMAT "%9.2"
 /begin AXIS_DESCR COM_AXIS Vxx_free_shf_pdl _CNV_R_R_VA_F_0v125_492_CM 11 0. 100. FORMAT "%9.2" AXIS_PTS_REF Ctb_down_shf_pdl /end AXIS_DESCR
/end CHARACTERISTIC
/begin CHARACTERISTIC Ctp_law_wup_cata_5_6 "Table of gear shifting form 5 to 6 for the cata law" CURVE 0xa0037428 _REC_A1CUR_20_u2_u2 655.35 _CNV_R_R_VA_F_0v01__500_CM 0. 655.35 FORMAT "%9.2"
 /begin AXIS_DESCR COM_AXIS Vxx_free_shf_pdl _CNV_R_R_VA_F_0v125_492_CM 11 0. 100. FORMAT "%9.2" AXIS_PTS_REF Ctb_up_shf_pdl /end AXIS_DESCR
/end CHARACTERISTIC
/begin CHARACTERISTIC Ctp_law_wup_cata_6_5 "Table of gear shifting form 6 to 5 for the cata law" CURVE 0xa0037440 _REC_A1CUR_20_u2_u2 655.35 _CNV_R_R_VA_F_0v01__500_CM 0. 655.35 FORMAT "%9.2"
 /begin AXIS_DESCR COM_AXIS Vxx_free_shf_pdl _CNV_R_R_VA_F_0v125_492_CM 11 0. 100. FORMAT "%9.2" AXIS_PTS_REF Ctb_down_shf_pdl /end AXIS_DESCR
/end CHARACTERISTIC
/begin CHARACTERISTIC Ctp_law_xurb_1_2 "Table of gear shifting form 1 to 2 for the extra urban law" CURVE 0xa0037458 _REC_A1CUR_20_u2_u2 655.35 _CNV_R_R_VA_F_0v01__500_CM 0. 655.35 FORMAT "%9.2"
 /begin AXIS_DESCR COM_AXIS Vxx_free_shf_pdl _CNV_R_R_VA_F_0v125_492_CM 11 0. 100. FORMAT "%9.2" AXIS_PTS_REF Ctb_up_shf_pdl /end AXIS_DESCR
/end CHARACTERISTIC
/begin CHARACTERISTIC Ctp_law_xurb_2_1 "Table of gear shifting form 2 to 1 for the extra urban law" CURVE 0xa0037470 _REC_A1CUR_20_u2_u2 655.35 _CNV_R_R_VA_F_0v01__500_CM 0. 655.35 FORMAT "%9.2"
 /begin AXIS_DESCR COM_AXIS Vxx_free_shf_pdl _CNV_R_R_VA_F_0v125_492_CM 11 0. 100. FORMAT "%9.2" AXIS_PTS_REF Ctb_down_shf_pdl /end AXIS_DESCR
/end CHARACTERISTIC
/begin CHARACTERISTIC Ctp_law_xurb_2_3 "Table of gear shifting form 1 to 2 for the extra urban law" CURVE 0xa0037488 _REC_A1CUR_20_u2_u2 655.35 _CNV_R_R_VA_F_0v01__500_CM 0. 655.35 FORMAT "%9.2"
 /begin AXIS_DESCR COM_AXIS Vxx_free_shf_pdl _CNV_R_R_VA_F_0v125_492_CM 11 0. 100. FORMAT "%9.2" AXIS_PTS_REF Ctb_up_shf_pdl /end AXIS_DESCR
/end CHARACTERISTIC
/begin CHARACTERISTIC Ctp_law_xurb_3_2 "Table of gear shifting form 2 to 1 for the extra urban law" CURVE 0xa00374a0 _REC_A1CUR_20_u2_u2 655.35 _CNV_R_R_VA_F_0v01__500_CM 0. 655.35 FORMAT "%9.2"
 /begin AXIS_DESCR COM_AXIS Vxx_free_shf_pdl _CNV_R_R_VA_F_0v125_492_CM 11 0. 100. FORMAT "%9.2" AXIS_PTS_REF Ctb_down_shf_pdl /end AXIS_DESCR
/end CHARACTERISTIC
/begin CHARACTERISTIC Ctp_law_xurb_3_4 "Table of gear shifting form 1 to 2 for the extra urban law" CURVE 0xa00374b8 _REC_A1CUR_20_u2_u2 655.35 _CNV_R_R_VA_F_0v01__500_CM 0. 655.35 FORMAT "%9.2"
 /begin AXIS_DESCR COM_AXIS Vxx_free_shf_pdl _CNV_R_R_VA_F_0v125_492_CM 11 0. 100. FORMAT "%9.2" AXIS_PTS_REF Ctb_up_shf_pdl /end AXIS_DESCR
/end CHARACTERISTIC
/begin CHARACTERISTIC Ctp_law_xurb_4_3 "Table of gear shifting form 2 to 1 for the extra urban law" CURVE 0xa00374d0 _REC_A1CUR_20_u2_u2 655.35 _CNV_R_R_VA_F_0v01__500_CM 0. 655.35 FORMAT "%9.2"
 /begin AXIS_DESCR COM_AXIS Vxx_free_shf_pdl _CNV_R_R_VA_F_0v125_492_CM 11 0. 100. FORMAT "%9.2" AXIS_PTS_REF Ctb_down_shf_pdl /end AXIS_DESCR
/end CHARACTERISTIC
/begin CHARACTERISTIC Ctp_law_xurb_4_5 "Table of gear shifting form 1 to 2 for the extra urban law" CURVE 0xa00374e8 _REC_A1CUR_20_u2_u2 655.35 _CNV_R_R_VA_F_0v01__500_CM 0. 655.35 FORMAT "%9.2"
 /begin AXIS_DESCR COM_AXIS Vxx_free_shf_pdl _CNV_R_R_VA_F_0v125_492_CM 11 0. 100. FORMAT "%9.2" AXIS_PTS_REF Ctb_up_shf_pdl /end AXIS_DESCR
/end CHARACTERISTIC
/begin CHARACTERISTIC Ctp_law_xurb_5_4 "Table of gear shifting form 2 to 1 for the extra urban law" CURVE 0xa0037500 _REC_A1CUR_20_u2_u2 655.35 _CNV_R_R_VA_F_0v01__500_CM 0. 655.35 FORMAT "%9.2"
 /begin AXIS_DESCR COM_AXIS Vxx_free_shf_pdl _CNV_R_R_VA_F_0v125_492_CM 11 0. 100. FORMAT "%9.2" AXIS_PTS_REF Ctb_down_shf_pdl /end AXIS_DESCR
/end CHARACTERISTIC
/begin CHARACTERISTIC Ctp_law_xurb_5_6 "Table of gear shifting form 1 to 2 for the extra urban law" CURVE 0xa0037518 _REC_A1CUR_20_u2_u2 655.35 _CNV_R_R_VA_F_0v01__500_CM 0. 655.35 FORMAT "%9.2"
 /begin AXIS_DESCR COM_AXIS Vxx_free_shf_pdl _CNV_R_R_VA_F_0v125_492_CM 11 0. 100. FORMAT "%9.2" AXIS_PTS_REF Ctb_up_shf_pdl /end AXIS_DESCR
/end CHARACTERISTIC
/begin CHARACTERISTIC Ctp_law_xurb_6_5 "Table of gear shifting form 2 to 1 for the extra urban law" CURVE 0xa0037530 _REC_A1CUR_20_u2_u2 655.35 _CNV_R_R_VA_F_0v01__500_CM 0. 655.35 FORMAT "%9.2"
 /begin AXIS_DESCR COM_AXIS Vxx_free_shf_pdl _CNV_R_R_VA_F_0v125_492_CM 11 0. 100. FORMAT "%9.2" AXIS_PTS_REF Ctb_down_shf_pdl /end AXIS_DESCR
/end CHARACTERISTIC
/begin CHARACTERISTIC Ctp_min_vs_decl "Minimum value of vehicle speed offset for brake assistance" CURVE 0xa00375a8 _REC_A1CUR_20_s2_u1 510. _CNV_R_R_VA_F_0v01__500_CM -255. 255. FORMAT "%9.2"
 /begin AXIS_DESCR COM_AXIS NO_INPUT_QUANTITY _CNV_R_R_VA_F_1_p1__494_CM 6 1. 6. FORMAT "%9.2" AXIS_PTS_REF Ctb_gear_fs /end AXIS_DESCR
/end CHARACTERISTIC
/begin CHARACTERISTIC Ctp_n_lim_apmp_down_shf "Table of engine speed beyond a downshift can't be forced" CURVE 0xa00370b0 _REC_A1CUR_20_u2_u1 16383.75 _CNV_R_R_VA_F_0v25__491_CM 0. 16383.75 FORMAT "%9.2"
 /begin AXIS_DESCR COM_AXIS NO_INPUT_QUANTITY _CNV_R_R_VA_F_1_p1__494_CM 6 1. 6. FORMAT "%9.2" AXIS_PTS_REF Ctb_gear_fs /end AXIS_DESCR
/end CHARACTERISTIC
/begin CHARACTERISTIC Ctp_pdl_cru_max_lim "Table of maximum pedale values in cruise control" CURVE 0xa00375b4 _REC_A1CUR_20_u2_u1 100. _CNV_R_R_VA_F_0v125_492_CM 0. 100. FORMAT "%9.2"
 /begin AXIS_DESCR COM_AXIS NO_INPUT_QUANTITY _CNV_R_R_VA_F_1_p1__494_CM 6 1. 6. FORMAT "%9.2" AXIS_PTS_REF Ctb_gear_fs /end AXIS_DESCR
/end CHARACTERISTIC
/begin CHARACTERISTIC Ctp_sta_dspl_arw_up_dly "Start time of an up shift display for curent gear ratio" CURVE 0xa0022228 _REC_A1CUR_20_u1_u1 5.1 _CNV_R_R_VA_F_0v02__497_CM 0. 5.1 FORMAT "%9.2"
 /begin AXIS_DESCR COM_AXIS NO_INPUT_QUANTITY _CNV_R_R_VA_F_1_p1__494_CM 6 1. 6. FORMAT "%9.2" AXIS_PTS_REF Ctb_gear_fs /end AXIS_DESCR
/end CHARACTERISTIC
/begin CHARACTERISTIC Ctp_v1000 "a_pc_drc_opo_fslawxx_xxx_xx_x_a/Calibration vector of gear ratio targets : 1st_gear,..., 6th_gear" CURVE 0xa0037548 _REC_A1CUR_20_u2_u1 200. _CNV_R_R_VA_F_0v01__501_CM 0. 200. FORMAT "%9.2"
 /begin AXIS_DESCR COM_AXIS NO_INPUT_QUANTITY _CNV_R_R_VA_F_1_p1__494_CM 6 1. 6. FORMAT "%9.2" AXIS_PTS_REF Ctb_gear_fs /end AXIS_DESCR
/end CHARACTERISTIC
/begin MEASUREMENT Vbx_apmp_down_shf "Down shift command" UBYTE _CNV_S_2_VA_Bool_ON_502_CM 1 0. 0. 1. ECU_ADDRESS 0xd000740b BIT_MASK 0x1 /end MEASUREMENT
/begin MEASUREMENT Vbx_apmp_up_shf "Up shift command" UBYTE _CNV_S_2_VA_Bool_ON_502_CM 1 0. 0. 1. ECU_ADDRESS 0xd000740c BIT_MASK 0x1 /end MEASUREMENT
/begin MEASUREMENT Vbx_arw_down "Command for down shift display" UBYTE _CNV_S_2_VA_Bool_ON_502_CM 1 0. 0. 1. ECU_ADDRESS 0xd0007d47 BIT_MASK 0x1 /end MEASUREMENT
/begin MEASUREMENT Vbx_arw_down_raw "Raw command for down shift display" UBYTE _CNV_S_2_VA_Bool_ON_502_CM 1 0. 0. 1. ECU_ADDRESS 0xd0007d48 BIT_MASK 0x1 /end MEASUREMENT
/begin MEASUREMENT Vbx_arw_up "Command for up shift display" UBYTE _CNV_S_2_VA_Bool_ON_502_CM 1 0. 0. 1. ECU_ADDRESS 0xd0007d4a BIT_MASK 0x1 /end MEASUREMENT
/begin MEASUREMENT Vbx_arw_up_raw "Raw command for up shift display" UBYTE _CNV_S_2_VA_Bool_ON_502_CM 1 0. 0. 1. ECU_ADDRESS 0xd0007d4b BIT_MASK 0x1 /end MEASUREMENT
/begin MEASUREMENT Vbx_dly_ini "Init command for the delay management" UBYTE _CNV_S_2_VA_Bool_ON_502_CM 1 0. 0. 1. ECU_ADDRESS 0xd0007423 BIT_MASK 0x1 /end MEASUREMENT
/begin MEASUREMENT Vbx_forc_gear_1 "Detection of the 1st gear shifting" UBYTE _CNV_S_2_VA_Bool_ON_502_CM 1 0. 0. 1. ECU_ADDRESS 0xd0007431 BIT_MASK 0x1 /end MEASUREMENT
/begin MEASUREMENT Vbx_free_shf_dft "Flag used to detect when free shit can't be calculated" UBYTE _CNV_S_2_VA_Bool_ON_502_CM 1 0. 0. 1. ECU_ADDRESS 0xd000742e BIT_MASK 0x1 /end MEASUREMENT
/begin MEASUREMENT Vbx_free_shf_dsb "Free shift disable variable" UBYTE _CNV_S_2_VA_Bool_ON_502_CM 1 0. 0. 1. ECU_ADDRESS 0xd0007440 BIT_MASK 0x1 /end MEASUREMENT
/begin MEASUREMENT Vbx_fs_hv_cfm "Heavy vehicle configuration" UBYTE _CNV_S_2_VA_Bool_ON_502_CM 1 0. 0. 1. ECU_ADDRESS 0xd0007441 BIT_MASK 0x1 /end MEASUREMENT
/begin MEASUREMENT Vbx_out_tco "Test result on tco" UBYTE _CNV_S_2_VA_Bool_ON_502_CM 1 0. 0. 1. ECU_ADDRESS 0xd0007d5c BIT_MASK 0x1 /end MEASUREMENT
/begin MEASUREMENT Vbx_sta_tco_ena "Bit to start the test of cata law" UBYTE _CNV_S_2_VA_Bool_ON_502_CM 1 0. 0. 1. ECU_ADDRESS 0xd0007d5d BIT_MASK 0x1 /end MEASUREMENT
/begin MEASUREMENT Vbx_up_shf_blk_cur "Flag of blocking of upshifts in bend" UBYTE _CNV_S_2_VA_Bool_ON_502_CM 1 0. 0. 1. ECU_ADDRESS 0xd0007414 BIT_MASK 0x1 /end MEASUREMENT
/begin MEASUREMENT Vbx_wup_cata_dsb "Bit to disable the selection of cata law" UBYTE _CNV_S_2_VA_Bool_ON_502_CM 1 0. 0. 1. ECU_ADDRESS 0xd0007d5e BIT_MASK 0x1 /end MEASUREMENT
/begin MEASUREMENT Vbx_wup_cata_ena "Bit to enable the selection of cata law" UBYTE _CNV_S_2_VA_Bool_ON_502_CM 1 0. 0. 1. ECU_ADDRESS 0xd000743b BIT_MASK 0x1 /end MEASUREMENT
/begin MEASUREMENT Vsx_apmp_free_shf_mod "Free shift mod value from the anti pump function" UBYTE _CNV_R_R_VA_I_16_503_CM 1 0. 0. 255. ECU_ADDRESS 0xd0007411 FORMAT "%9.2" /end MEASUREMENT
/begin MEASUREMENT Vsx_fast_off_free_shf_mod "Free shift mod value from the fast off function" UBYTE _CNV_R_R_VA_I_16_503_CM 1 0. 0. 255. ECU_ADDRESS 0xd0007425 FORMAT "%9.2" /end MEASUREMENT
/begin MEASUREMENT Vsx_fast_on_free_shf_mod "Free shift mod value from the fast on function" UBYTE _CNV_R_R_VA_I_16_503_CM 1 0. 0. 255. ECU_ADDRESS 0xd0007427 FORMAT "%9.2" /end MEASUREMENT
/begin MEASUREMENT Vsx_free_shf_dspl "Final free shift display" UBYTE _CNV_S_3_VA_Vsx_fre_504_CM 1 0. 0. 2. ECU_ADDRESS 0xd0007419 /end MEASUREMENT
/begin MEASUREMENT Vsx_frz_free_shf_mod "Free shift mod value from the gear shift inhibition function" UBYTE _CNV_R_R_VA_I_16_503_CM 1 0. 0. 255. ECU_ADDRESS 0xd000742d FORMAT "%9.2" /end MEASUREMENT
/begin MEASUREMENT Vsx_law_free_shf_mod "Free shift mod value from the law management function" UBYTE _CNV_R_R_VA_I_16_503_CM 1 0. 0. 255. ECU_ADDRESS 0xd0007432 FORMAT "%9.2" /end MEASUREMENT
/begin MEASUREMENT Vsx_law_sel "selected law value (cata, eco, uphil, ...)" UBYTE _CNV_S_6_VA_Vsx_law_505_CM 1 0. 1. 14. ECU_ADDRESS 0xd000743c /end MEASUREMENT
/begin MEASUREMENT Vsx_law_sel_lim "selected law value without Nsx_mod_uhil_2 value" UBYTE _CNV_S_5_VA_Vsx_law_506_CM 1 0. 1. 5. ECU_ADDRESS 0xd0007d52 /end MEASUREMENT
/begin MEASUREMENT Vsx_load_lvl "Load type" UBYTE _CNV_S_4_VA_Vsx_loa_507_CM 1 0. 0. 3. ECU_ADDRESS 0xd000743d /end MEASUREMENT
/begin MEASUREMENT Vsx_no_seq_free_shf_mod "Free shift mod value from the delay management function" UBYTE _CNV_R_R_VA_I_16_503_CM 1 0. 0. 255. ECU_ADDRESS 0xd000741d FORMAT "%9.2" /end MEASUREMENT
/begin MEASUREMENT Vsx_road_typ "Road type" UBYTE _CNV_S_2_VA_Vsx_roa_508_CM 1 0. 1. 2. ECU_ADDRESS 0xd000743e /end MEASUREMENT
/begin MEASUREMENT Vsx_stt_dhil "Downhill managment state" UBYTE _CNV_R_R_VA_I_16_503_CM 1 0. 0. 255. ECU_ADDRESS 0xd0007436 FORMAT "%9.2" /end MEASUREMENT
/begin MEASUREMENT Vsx_stt_dly "Delay management state" UBYTE _CNV_R_R_VA_I_16_503_CM 1 0. 0. 255. ECU_ADDRESS 0xd000741a FORMAT "%9.2" /end MEASUREMENT
/begin MEASUREMENT Vsx_stt_fast_off "Fast off managment state" UBYTE _CNV_R_R_VA_I_16_503_CM 1 0. 0. 255. ECU_ADDRESS 0xd0007d53 FORMAT "%9.2" /end MEASUREMENT
/begin MEASUREMENT Vsx_stt_fast_on "Fast on management state" UBYTE _CNV_R_R_VA_I_16_503_CM 1 0. 0. 255. ECU_ADDRESS 0xd0007428 FORMAT "%9.2" /end MEASUREMENT
/begin MEASUREMENT Vxx_ant_vs "Anticipated vehicle speed" UWORD _CNV_R_R_VA_F_0v01__500_CM 1 0. 0. 655.35 ECU_ADDRESS 0xd0004c1c FORMAT "%9.2" /end MEASUREMENT
/begin MEASUREMENT Vxx_apmp_gear "Gear value given by the anti pump gear function" UBYTE _CNV_R_R_VA_F_1_p2__509_CM 1 0. 2. 257. ECU_ADDRESS 0xd000740e FORMAT "%9.2" /end MEASUREMENT
/begin MEASUREMENT Vxx_apmp_gear_sel "Gear value recommended by the anti pump function" UBYTE _CNV_R_R_VA_F_1_p1__494_CM 1 0. 1. 256. ECU_ADDRESS 0xd0007412 FORMAT "%9.2" /end MEASUREMENT
/begin MEASUREMENT Vxx_ctr_dspl_up "Counter for display cycles" UBYTE _CNV_R_R_VA_I_16_503_CM 1 0. 0. 255. ECU_ADDRESS 0xd0007d40 FORMAT "%9.2" /end MEASUREMENT
/begin MEASUREMENT Vxx_cur_dly "Temporization of wait allowing to determine the end of a bend" UBYTE _CNV_R_R_VA_F_0v02__497_CM 1 0. 0. 5.1 ECU_ADDRESS 0xd0007416 FORMAT "%9.2" /end MEASUREMENT
/begin MEASUREMENT Vxx_cur_tra_acel_thd "Threshold of transverse acceleration allowing to detect a bend" UWORD _CNV_R_R_VA_F_0v000_496_CM 1 0. 0. 26.214 ECU_ADDRESS 0xd0004bfa FORMAT "%9.4" /end MEASUREMENT
/begin MEASUREMENT Vxx_dhil_gear_sel "Recommended gear value from the downhill managment" UBYTE _CNV_R_R_VA_F_1_p1__494_CM 1 0. 1. 256. ECU_ADDRESS 0xd0007437 FORMAT "%9.2" /end MEASUREMENT
/begin MEASUREMENT Vxx_dhil_n_up_shf_in_thd "Engine speed threshold to enter in upshift state" UWORD _CNV_R_R_VA_F_0v25__495_CM 1 0. 0. 16383.75 ECU_ADDRESS 0xd0004c1e FORMAT "%9.2" /end MEASUREMENT
/begin MEASUREMENT Vxx_dhil_n_up_shf_out_thd "Engine speed threshold to exit the upshift state" UWORD _CNV_R_R_VA_F_0v25__495_CM 1 0. 0. 16383.75 ECU_ADDRESS 0xd0004c20 FORMAT "%9.2" /end MEASUREMENT
/begin MEASUREMENT Vxx_dhil_vs_down_shf_thd "vehicle speed threshold for down shift recommendation" UWORD _CNV_R_R_VA_F_0v01__500_CM 1 0. 0. 655.35 ECU_ADDRESS 0xd0004c22 FORMAT "%9.2" /end MEASUREMENT
/begin MEASUREMENT Vxx_dly_driv_pwt_sp_100 "Powertrain setpoint in % from 0 to 100 with 300 ms delayed" UWORD _CNV_R_R_VA_F_0v125_510_CM 1 0. 0. 8191.875 ECU_ADDRESS 0xd0004c8c FORMAT "%9.2" /end MEASUREMENT
/begin MEASUREMENT Vxx_dly_frz_gear_sel "Gear value recommended by the gear shift inhibition function delayed" UBYTE _CNV_R_R_VA_F_1_m1__511_CM 1 0. -1. 254. ECU_ADDRESS 0xd0007d54 FORMAT "%9.2" /end MEASUREMENT
/begin MEASUREMENT Vxx_dly_gear_sel "Gear value from law management function delayed" UBYTE _CNV_R_R_VA_F_1_p1__494_CM 1 0. 1. 256. ECU_ADDRESS 0xd0007429 FORMAT "%9.2" /end MEASUREMENT
/begin MEASUREMENT Vxx_driv_pwt_sp_100 "Powertrain setpoint in % from 0 to 100" UWORD _CNV_R_R_VA_F_0v125_510_CM 1 0. 0. 8191.875 ECU_ADDRESS 0xd0004c90 FORMAT "%9.2" /end MEASUREMENT
/begin MEASUREMENT Vxx_fast_off_dly "Temporization value for the fast off function" UBYTE _CNV_R_R_VA_F_0v02__497_CM 1 0. 0. 5.1 ECU_ADDRESS 0xd0007d55 FORMAT "%9.2" /end MEASUREMENT
/begin MEASUREMENT Vxx_fast_off_gear_sel "Gear value recommended by the fast off function" UBYTE _CNV_R_R_VA_F_1_m1__511_CM 1 0. -1. 254. ECU_ADDRESS 0xd0007426 FORMAT "%9.2" /end MEASUREMENT
/begin MEASUREMENT Vxx_fast_off_gear_sel_bk "Gear value recommended by the fast off function delayed" UBYTE _CNV_R_R_VA_F_1_m1__511_CM 1 0. -1. 254. ECU_ADDRESS 0xd000741b FORMAT "%9.2" /end MEASUREMENT
/begin MEASUREMENT Vxx_fast_off_kd_n_thd "Engine speed values for kick" UWORD _CNV_R_R_VA_F_0v25__495_CM 1 0. 0. 16383.75 ECU_ADDRESS 0xd000614e FORMAT "%9.2" /end MEASUREMENT
/begin MEASUREMENT Vxx_fast_off_max_dly "Maximum temporization value for the fast off function" UBYTE _CNV_R_R_VA_F_0v02__497_CM 1 0. 0. 5.1 ECU_ADDRESS 0xd0007d56 FORMAT "%9.2" /end MEASUREMENT
/begin MEASUREMENT Vxx_fast_off_no_pdl_dly "Temporization value for foot up" UBYTE _CNV_R_R_VA_F_0v02__497_CM 1 0. 0. 5.1 ECU_ADDRESS 0xd0007d57 FORMAT "%9.2" /end MEASUREMENT
/begin MEASUREMENT Vxx_fast_on_gear_sel "Gear value recommended by the fast on function" UBYTE _CNV_R_R_VA_F_1_p1__494_CM 1 0. 1. 256. ECU_ADDRESS 0xd000742a FORMAT "%9.2" /end MEASUREMENT
/begin MEASUREMENT Vxx_free_shf_pdl "Final powertrain setpoint in % from 0 to 100 after delay and freezing" UWORD _CNV_R_R_VA_F_0v125_510_CM 1 0. 0. 8191.875 ECU_ADDRESS 0xd0004ca0 FORMAT "%9.2" /end MEASUREMENT
/begin MEASUREMENT Vxx_frz_gear_sel "Gear value recommended by the gear shift inhibition function" UBYTE _CNV_R_R_VA_F_1_m1__511_CM 1 0. -1. 254. ECU_ADDRESS 0xd000742c FORMAT "%9.2" /end MEASUREMENT
/begin MEASUREMENT Vxx_gear_bk "Gear engaged delayed ( [-1 0 1 2 3 4 5 6] )" UBYTE _CNV_R_R_VA_F_1_m1__511_CM 1 0. -1. 254. ECU_ADDRESS 0xd000741c FORMAT "%9.2" /end MEASUREMENT
/begin MEASUREMENT Vxx_gear_lim "Gear engaged limited from 1 to 6" UBYTE _CNV_R_R_VA_F_1_p1__494_CM 1 0. 1. 256. ECU_ADDRESS 0xd000740f FORMAT "%9.2" /end MEASUREMENT
/begin MEASUREMENT Vxx_gear_lim_inc "Gear engaged + 1 limited by gear max" UBYTE _CNV_R_R_VA_F_1_p1__494_CM 1 0. 1. 256. ECU_ADDRESS 0xd0007410 FORMAT "%9.2" /end MEASUREMENT
/begin MEASUREMENT Vxx_gear_sel "Gear value from law management function" UBYTE _CNV_R_R_VA_F_1_p1__494_CM 1 0. 1. 256. ECU_ADDRESS 0xd0007433 FORMAT "%9.2" /end MEASUREMENT
/begin MEASUREMENT Vxx_law_gear_sel "Recommended gear from eco, extra urban or uphill laws" UBYTE _CNV_R_R_VA_F_1_p1__494_CM 1 0. 1. 256. ECU_ADDRESS 0xd0007439 FORMAT "%9.2" /end MEASUREMENT
/begin MEASUREMENT Vxx_max_avl_pow "Maximum effective engine power at current engine speed" SWORD _CNV_R_R_VA_F_10_p0_512_CM 1 0. -327680. 327670. ECU_ADDRESS 0xd0004bee FORMAT "%9.2" /end MEASUREMENT
/begin MEASUREMENT Vxx_max_avl_pow_inc "Estimation of maximum effective engine power at gear + 1 engine speed" SWORD _CNV_R_R_VA_F_10_p0_512_CM 1 0. -327680. 327670. ECU_ADDRESS 0xd0004bf0 FORMAT "%9.2" /end MEASUREMENT
/begin MEASUREMENT Vxx_max_avl_pow_rat "Ratio between theoretical and real maximum engine power at curent engine speed" SBYTE _CNV_R_R_VA_F_0v01__513_CM 1 0. -1.28 1.27 ECU_ADDRESS 0xd000740d FORMAT "%9.2" /end MEASUREMENT
/begin MEASUREMENT Vxx_min_dspl_arw_up_dly "Minimum time of an up shift display" UBYTE _CNV_R_R_VA_F_0v02__497_CM 1 0. 0. 5.1 ECU_ADDRESS 0xd0007d41 FORMAT "%9.2" /end MEASUREMENT
/begin MEASUREMENT Vxx_n_dhil "Estimated engine speed from vehicle speed" UWORD _CNV_R_R_VA_F_0v25__495_CM 1 0. 0. 16383.75 ECU_ADDRESS 0xd0004c24 FORMAT "%9.2" /end MEASUREMENT
/begin MEASUREMENT Vxx_n_gear "Engine speed calculated with the vehicle speed and the gear engaged ratio" UWORD _CNV_R_R_VA_F_0v25__495_CM 1 0. 0. 16383.75 ECU_ADDRESS 0xd0004bf6 FORMAT "%9.2" /end MEASUREMENT
/begin MEASUREMENT Vxx_n_gear_inc "Engine speed calculated with the vehicle speed and the engaged gear + 1" UWORD _CNV_R_R_VA_F_0v25__495_CM 1 0. 0. 16383.75 ECU_ADDRESS 0xd0004bf8 FORMAT "%9.2" /end MEASUREMENT
/begin MEASUREMENT Vxx_no_seq_gear_sel "Gear value recommended by the delay management function" UBYTE _CNV_R_R_VA_F_1_m1__511_CM 1 0. -1. 254. ECU_ADDRESS 0xd000741e FORMAT "%9.2" /end MEASUREMENT
/begin MEASUREMENT Vxx_pdl_grd "Free shift pedal gradient" SWORD _CNV_R_R_VA_F_0v125_514_CM 1 0. -4096. 4095.875 ECU_ADDRESS 0xd0004c00 FORMAT "%9.2" /end MEASUREMENT
/begin MEASUREMENT Vxx_pow_r_req_down "Resistive efforts power with the power margine for the down shift test" SWORD _CNV_R_R_VA_F_10_p0_512_CM 1 0. -327680. 327670. ECU_ADDRESS 0xd0004bf2 FORMAT "%9.2" /end MEASUREMENT
/begin MEASUREMENT Vxx_pow_r_req_up "Resistive efforts power with the power margine for the up shift test" SWORD _CNV_R_R_VA_F_10_p0_512_CM 1 0. -327680. 327670. ECU_ADDRESS 0xd0004bf4 FORMAT "%9.2" /end MEASUREMENT
/begin MEASUREMENT Vxx_sta_dspl_arw_up_dly "Start time of an up shift display" UBYTE _CNV_R_R_VA_F_0v02__497_CM 1 0. 0. 5.1 ECU_ADDRESS 0xd0007d42 FORMAT "%9.2" /end MEASUREMENT
/begin MEASUREMENT Vxx_t_ant "Timer used for the driver anticipation" UBYTE _CNV_R_R_VA_F_0v02__497_CM 1 0. 0. 5.1 ECU_ADDRESS 0xd000741f FORMAT "%9.2" /end MEASUREMENT
/begin MEASUREMENT Vxx_t_cur "Timer allowing to determine the end of a bend" UBYTE _CNV_R_R_VA_F_0v02__497_CM 1 0. 0. 5.1 ECU_ADDRESS 0xd0007417 FORMAT "%9.2" /end MEASUREMENT
/begin MEASUREMENT Vxx_t_fast_off "Timer used for the fast off temporization" UBYTE _CNV_R_R_VA_F_0v02__497_CM 1 0. 0. 5.1 ECU_ADDRESS 0xd0007d58 FORMAT "%9.2" /end MEASUREMENT
/begin MEASUREMENT Vxx_t_max_arw_down "Timer used for maximum time of a down shift display" UWORD _CNV_R_R_VA_F_0v02__497_CM 1 0. 0. 1310.7 ECU_ADDRESS 0xd0006146 FORMAT "%9.2" /end MEASUREMENT
/begin MEASUREMENT Vxx_t_max_arw_up "Timer used for maximum time of an up shift display" UWORD _CNV_R_R_VA_F_0v02__497_CM 1 0. 0. 1310.7 ECU_ADDRESS 0xd0006148 FORMAT "%9.2" /end MEASUREMENT
/begin MEASUREMENT Vxx_t_max_cur "Maximum value of Vxx_tmr_curve" UBYTE _CNV_R_R_VA_F_0v02__497_CM 1 0. 0. 5.1 ECU_ADDRESS 0xd0007418 FORMAT "%9.2" /end MEASUREMENT
/begin MEASUREMENT Vxx_t_min_arw_down "Timer used for minimum time of a down shift display" UBYTE _CNV_R_R_VA_F_0v02__497_CM 1 0. 0. 5.1 ECU_ADDRESS 0xd0007d43 FORMAT "%9.2" /end MEASUREMENT
/begin MEASUREMENT Vxx_t_min_arw_up "Timer used for minimum time of an up shift display" UBYTE _CNV_R_R_VA_F_0v02__497_CM 1 0. 0. 5.1 ECU_ADDRESS 0xd0007d44 FORMAT "%9.2" /end MEASUREMENT
/begin MEASUREMENT Vxx_t_no_pdl "Timer used for the foot up temporization" UBYTE _CNV_R_R_VA_F_0v02__497_CM 1 0. 0. 5.1 ECU_ADDRESS 0xd0007d59 FORMAT "%9.2" /end MEASUREMENT
/begin MEASUREMENT Vxx_t_no_seq_down_shf "Timer used for the down shift sequence control" UBYTE _CNV_R_R_VA_F_0v02__497_CM 1 0. 0. 5.1 ECU_ADDRESS 0xd0007420 FORMAT "%9.2" /end MEASUREMENT
/begin MEASUREMENT Vxx_t_no_seq_up_shf "Timer used for the up shift sequence control" UBYTE _CNV_R_R_VA_F_0v02__497_CM 1 0. 0. 5.1 ECU_ADDRESS 0xd0007421 FORMAT "%9.2" /end MEASUREMENT
/begin MEASUREMENT Vxx_t_rest_arw_down "Timer used for the restart time of a down shift display" UWORD _CNV_R_R_VA_F_0v02__497_CM 1 0. 0. 1310.7 ECU_ADDRESS 0xd000614a FORMAT "%9.2" /end MEASUREMENT
/begin MEASUREMENT Vxx_t_rest_arw_up "Timer used for the restart time of an up shift display" UWORD _CNV_R_R_VA_F_0v02__497_CM 1 0. 0. 1310.7 ECU_ADDRESS 0xd000614c FORMAT "%9.2" /end MEASUREMENT
/begin MEASUREMENT Vxx_t_sta_arw_down "Timer used for the start time of a down shift display" UBYTE _CNV_R_R_VA_F_0v02__497_CM 1 0. 0. 5.1 ECU_ADDRESS 0xd0007d45 FORMAT "%9.2" /end MEASUREMENT
/begin MEASUREMENT Vxx_t_sta_arw_up "Timer used for the start time of an up shift display" UBYTE _CNV_R_R_VA_F_0v02__497_CM 1 0. 0. 5.1 ECU_ADDRESS 0xd0007d46 FORMAT "%9.2" /end MEASUREMENT
/begin MEASUREMENT Vxx_t_up_shf_dly "Timer used for the up shift temporization" UBYTE _CNV_R_R_VA_F_0v02__497_CM 1 0. 0. 5.1 ECU_ADDRESS 0xd0007d5a FORMAT "%9.2" /end MEASUREMENT
/begin MEASUREMENT Vxx_tco_ctr "Counter for the tco watching init" UBYTE _CNV_R_R_VA_I_16_503_CM 1 0. 0. 255. ECU_ADDRESS 0xd0007d60 FORMAT "%9.2" /end MEASUREMENT
/begin MEASUREMENT Vxx_tra_acel_abs "Absolut value of the transverse acceleration" UWORD _CNV_R_R_VA_F_0v000_496_CM 1 0. 0. 26.214 ECU_ADDRESS 0xd0004bfc FORMAT "%9.4" /end MEASUREMENT
/begin MEASUREMENT Vxx_tra_acel_abs_vld "Absolut value of the transverse acceleration when the calculation is valid (else = 0)" UWORD _CNV_R_R_VA_F_0v000_496_CM 1 0. 0. 26.214 ECU_ADDRESS 0xd0004bfe FORMAT "%9.4" /end MEASUREMENT
/begin MEASUREMENT Vxx_up_shf_no_seq_dly "Temporization value for the up shift sequence control" UBYTE _CNV_R_R_VA_F_0v02__497_CM 1 0. 0. 5.1 ECU_ADDRESS 0xd0007422 FORMAT "%9.2" /end MEASUREMENT
/begin MEASUREMENT Vxx_vs_mv "Average vehicle speed" UWORD _CNV_R_R_VA_F_0v01__500_CM 1 0. 0. 655.35 ECU_ADDRESS 0xd0004c8a FORMAT "%9.2" /end MEASUREMENT
/begin MEASUREMENT Vxx_vs_thd_1_2 "Vehicle speed threshold for gear shifting form 1 to 2" UWORD _CNV_R_R_VA_F_0v01__500_CM 1 0. 0. 655.35 ECU_ADDRESS 0xd0004c26 FORMAT "%9.2" /end MEASUREMENT
/begin MEASUREMENT Vxx_vs_thd_2_1 "Vehicle speed threshold for gear shifting form 2 to 1" UWORD _CNV_R_R_VA_F_0v01__500_CM 1 0. 0. 655.35 ECU_ADDRESS 0xd0004c28 FORMAT "%9.2" /end MEASUREMENT
/begin MEASUREMENT Vxx_vs_thd_2_3 "Vehicle speed threshold for gear shifting form 2 to 3" UWORD _CNV_R_R_VA_F_0v01__500_CM 1 0. 0. 655.35 ECU_ADDRESS 0xd0004c2a FORMAT "%9.2" /end MEASUREMENT
/begin MEASUREMENT Vxx_vs_thd_2_uhil_1_2 "Vehicle speed threshold for gear shifting form 1 to 2 for the uphill 2 law" UWORD _CNV_R_R_VA_F_0v01__500_CM 1 0. 0. 655.35 ECU_ADDRESS 0xd0004c08 FORMAT "%9.2" /end MEASUREMENT
/begin MEASUREMENT Vxx_vs_thd_2_uhil_2_1 "Vehicle speed threshold for gear shifting form 2 to 1 for the uphill 2 law" UWORD _CNV_R_R_VA_F_0v01__500_CM 1 0. 0. 655.35 ECU_ADDRESS 0xd0004c12 FORMAT "%9.2" /end MEASUREMENT
/begin MEASUREMENT Vxx_vs_thd_2_uhil_2_3 "Vehicle speed threshold for gear shifting form 2 to 3 for the uphill 2 law" UWORD _CNV_R_R_VA_F_0v01__500_CM 1 0. 0. 655.35 ECU_ADDRESS 0xd0004c0a FORMAT "%9.2" /end MEASUREMENT
/begin MEASUREMENT Vxx_vs_thd_2_uhil_3_2 "Vehicle speed threshold for gear shifting form 3 to 2 for the uphill 2 law" UWORD _CNV_R_R_VA_F_0v01__500_CM 1 0. 0. 655.35 ECU_ADDRESS 0xd0004c14 FORMAT "%9.2" /end MEASUREMENT
/begin MEASUREMENT Vxx_vs_thd_2_uhil_3_4 "Vehicle speed threshold for gear shifting form 3 to 4 for the uphill 2 law" UWORD _CNV_R_R_VA_F_0v01__500_CM 1 0. 0. 655.35 ECU_ADDRESS 0xd0004c0c FORMAT "%9.2" /end MEASUREMENT
/begin MEASUREMENT Vxx_vs_thd_2_uhil_4_3 "Vehicle speed threshold for gear shifting form 4 to 3 for the uphill 2 law" UWORD _CNV_R_R_VA_F_0v01__500_CM 1 0. 0. 655.35 ECU_ADDRESS 0xd0004c16 FORMAT "%9.2" /end MEASUREMENT
/begin MEASUREMENT Vxx_vs_thd_2_uhil_4_5 "Vehicle speed threshold for gear shifting form 4 to 5 for the uphill 2 law" UWORD _CNV_R_R_VA_F_0v01__500_CM 1 0. 0. 655.35 ECU_ADDRESS 0xd0004c0e FORMAT "%9.2" /end MEASUREMENT
/begin MEASUREMENT Vxx_vs_thd_2_uhil_5_4 "Vehicle speed threshold for gear shifting form 5 to 4 for the uphill 2 law" UWORD _CNV_R_R_VA_F_0v01__500_CM 1 0. 0. 655.35 ECU_ADDRESS 0xd0004c18 FORMAT "%9.2" /end MEASUREMENT
/begin MEASUREMENT Vxx_vs_thd_2_uhil_5_6 "Vehicle speed threshold for gear shifting form 5 to 6 for the uphill 2 law" UWORD _CNV_R_R_VA_F_0v01__500_CM 1 0. 0. 655.35 ECU_ADDRESS 0xd0004c10 FORMAT "%9.2" /end MEASUREMENT
/begin MEASUREMENT Vxx_vs_thd_2_uhil_6_5 "Vehicle speed threshold for gear shifting form 6 to 5 for the uphill 2 law" UWORD _CNV_R_R_VA_F_0v01__500_CM 1 0. 0. 655.35 ECU_ADDRESS 0xd0004c1a FORMAT "%9.2" /end MEASUREMENT
/begin MEASUREMENT Vxx_vs_thd_3_2 "Vehicle speed threshold for gear shifting form 3 to 2" UWORD _CNV_R_R_VA_F_0v01__500_CM 1 0. 0. 655.35 ECU_ADDRESS 0xd0004c2c FORMAT "%9.2" /end MEASUREMENT
/begin MEASUREMENT Vxx_vs_thd_3_4 "Vehicle speed threshold for gear shifting form 3 to 4" UWORD _CNV_R_R_VA_F_0v01__500_CM 1 0. 0. 655.35 ECU_ADDRESS 0xd0004c2e FORMAT "%9.2" /end MEASUREMENT
/begin MEASUREMENT Vxx_vs_thd_4_3 "Vehicle speed threshold for gear shifting form 4 to 3" UWORD _CNV_R_R_VA_F_0v01__500_CM 1 0. 0. 655.35 ECU_ADDRESS 0xd0004c30 FORMAT "%9.2" /end MEASUREMENT
/begin MEASUREMENT Vxx_vs_thd_4_5 "Vehicle speed threshold for gear shifting form 4 to 5" UWORD _CNV_R_R_VA_F_0v01__500_CM 1 0. 0. 655.35 ECU_ADDRESS 0xd0004c32 FORMAT "%9.2" /end MEASUREMENT
/begin MEASUREMENT Vxx_vs_thd_5_4 "Vehicle speed threshold for gear shifting form 5 to 4" UWORD _CNV_R_R_VA_F_0v01__500_CM 1 0. 0. 655.35 ECU_ADDRESS 0xd0004c34 FORMAT "%9.2" /end MEASUREMENT
/begin MEASUREMENT Vxx_vs_thd_5_6 "Vehicle speed threshold for gear shifting form 5 to 6" UWORD _CNV_R_R_VA_F_0v01__500_CM 1 0. 0. 655.35 ECU_ADDRESS 0xd0004c36 FORMAT "%9.2" /end MEASUREMENT
/begin MEASUREMENT Vxx_vs_thd_6_5 "Vehicle speed threshold for gear shifting form 6 to 5" UWORD _CNV_R_R_VA_F_0v01__500_CM 1 0. 0. 655.35 ECU_ADDRESS 0xd0004c38 FORMAT "%9.2" /end MEASUREMENT
/begin MEASUREMENT Vxx_vs_thd_eco_1_2 "Vehicle speed threshold for gear shifting form 1 to 2 for the eco law" UWORD _CNV_R_R_VA_F_0v01__500_CM 1 0. 0. 655.35 ECU_ADDRESS 0xd0004c4e FORMAT "%9.2" /end MEASUREMENT
/begin MEASUREMENT Vxx_vs_thd_eco_2_1 "Vehicle speed threshold for gear shifting form 2 to 1 for the eco law" UWORD _CNV_R_R_VA_F_0v01__500_CM 1 0. 0. 655.35 ECU_ADDRESS 0xd0004c58 FORMAT "%9.2" /end MEASUREMENT
/begin MEASUREMENT Vxx_vs_thd_eco_2_3 "Vehicle speed threshold for gear shifting form 2 to 3 for the eco law" UWORD _CNV_R_R_VA_F_0v01__500_CM 1 0. 0. 655.35 ECU_ADDRESS 0xd0004c50 FORMAT "%9.2" /end MEASUREMENT
/begin MEASUREMENT Vxx_vs_thd_eco_3_2 "Vehicle speed threshold for gear shifting form 3 to 2 for the eco law" UWORD _CNV_R_R_VA_F_0v01__500_CM 1 0. 0. 655.35 ECU_ADDRESS 0xd0004c5a FORMAT "%9.2" /end MEASUREMENT
/begin MEASUREMENT Vxx_vs_thd_eco_3_4 "Vehicle speed threshold for gear shifting form 3 to 4 for the eco law" UWORD _CNV_R_R_VA_F_0v01__500_CM 1 0. 0. 655.35 ECU_ADDRESS 0xd0004c52 FORMAT "%9.2" /end MEASUREMENT
/begin MEASUREMENT Vxx_vs_thd_eco_4_3 "Vehicle speed threshold for gear shifting form 4 to 3 for the eco law" UWORD _CNV_R_R_VA_F_0v01__500_CM 1 0. 0. 655.35 ECU_ADDRESS 0xd0004c5c FORMAT "%9.2" /end MEASUREMENT
/begin MEASUREMENT Vxx_vs_thd_eco_4_5 "Vehicle speed threshold for gear shifting form 4 to 5 for the eco law" UWORD _CNV_R_R_VA_F_0v01__500_CM 1 0. 0. 655.35 ECU_ADDRESS 0xd0004c54 FORMAT "%9.2" /end MEASUREMENT
/begin MEASUREMENT Vxx_vs_thd_eco_5_4 "Vehicle speed threshold for gear shifting form 5 to 4 for the eco law" UWORD _CNV_R_R_VA_F_0v01__500_CM 1 0. 0. 655.35 ECU_ADDRESS 0xd0004c5e FORMAT "%9.2" /end MEASUREMENT
/begin MEASUREMENT Vxx_vs_thd_eco_5_6 "Vehicle speed threshold for gear shifting form 5 to 6 for the eco law" UWORD _CNV_R_R_VA_F_0v01__500_CM 1 0. 0. 655.35 ECU_ADDRESS 0xd0004c56 FORMAT "%9.2" /end MEASUREMENT
/begin MEASUREMENT Vxx_vs_thd_eco_6_5 "Vehicle speed threshold for gear shifting form 6 to 5 for the eco law" UWORD _CNV_R_R_VA_F_0v01__500_CM 1 0. 0. 655.35 ECU_ADDRESS 0xd0004c60 FORMAT "%9.2" /end MEASUREMENT
/begin MEASUREMENT Vxx_vs_thd_uhil_1_2 "Vehicle speed threshold for gear shifting form 1 to 2 for the uphill law" UWORD _CNV_R_R_VA_F_0v01__500_CM 1 0. 0. 655.35 ECU_ADDRESS 0xd0004c3a FORMAT "%9.2" /end MEASUREMENT
/begin MEASUREMENT Vxx_vs_thd_uhil_2_1 "Vehicle speed threshold for gear shifting form 2 to 1 for the uphill law" UWORD _CNV_R_R_VA_F_0v01__500_CM 1 0. 0. 655.35 ECU_ADDRESS 0xd0004c44 FORMAT "%9.2" /end MEASUREMENT
/begin MEASUREMENT Vxx_vs_thd_uhil_2_3 "Vehicle speed threshold for gear shifting form 2 to 3 for the uphill law" UWORD _CNV_R_R_VA_F_0v01__500_CM 1 0. 0. 655.35 ECU_ADDRESS 0xd0004c3c FORMAT "%9.2" /end MEASUREMENT
/begin MEASUREMENT Vxx_vs_thd_uhil_3_2 "Vehicle speed threshold for gear shifting form 3 to 2 for the uphill law" UWORD _CNV_R_R_VA_F_0v01__500_CM 1 0. 0. 655.35 ECU_ADDRESS 0xd0004c46 FORMAT "%9.2" /end MEASUREMENT
/begin MEASUREMENT Vxx_vs_thd_uhil_3_4 "Vehicle speed threshold for gear shifting form 3 to 4 for the uphill law" UWORD _CNV_R_R_VA_F_0v01__500_CM 1 0. 0. 655.35 ECU_ADDRESS 0xd0004c3e FORMAT "%9.2" /end MEASUREMENT
/begin MEASUREMENT Vxx_vs_thd_uhil_4_3 "Vehicle speed threshold for gear shifting form 4 to 3 for the uphill law" UWORD _CNV_R_R_VA_F_0v01__500_CM 1 0. 0. 655.35 ECU_ADDRESS 0xd0004c48 FORMAT "%9.2" /end MEASUREMENT
/begin MEASUREMENT Vxx_vs_thd_uhil_4_5 "Vehicle speed threshold for gear shifting form 4 to 5 for the uphill law" UWORD _CNV_R_R_VA_F_0v01__500_CM 1 0. 0. 655.35 ECU_ADDRESS 0xd0004c40 FORMAT "%9.2" /end MEASUREMENT
/begin MEASUREMENT Vxx_vs_thd_uhil_5_4 "Vehicle speed threshold for gear shifting form 5 to 4 for the uphill law" UWORD _CNV_R_R_VA_F_0v01__500_CM 1 0. 0. 655.35 ECU_ADDRESS 0xd0004c4a FORMAT "%9.2" /end MEASUREMENT
/begin MEASUREMENT Vxx_vs_thd_uhil_5_6 "Vehicle speed threshold for gear shifting form 5 to 6 for the uphill law" UWORD _CNV_R_R_VA_F_0v01__500_CM 1 0. 0. 655.35 ECU_ADDRESS 0xd0004c42 FORMAT "%9.2" /end MEASUREMENT
/begin MEASUREMENT Vxx_vs_thd_uhil_6_5 "Vehicle speed threshold for gear shifting form 6 to 5 for the uphill law" UWORD _CNV_R_R_VA_F_0v01__500_CM 1 0. 0. 655.35 ECU_ADDRESS 0xd0004c4c FORMAT "%9.2" /end MEASUREMENT
/begin MEASUREMENT Vxx_vs_thd_wup_cata_1_2 "Vehicle speed threshold for gear shifting form 1 to 2 for the cata law" UWORD _CNV_R_R_VA_F_0v01__500_CM 1 0. 0. 655.35 ECU_ADDRESS 0xd0004c76 FORMAT "%9.2" /end MEASUREMENT
/begin MEASUREMENT Vxx_vs_thd_wup_cata_2_1 "Vehicle speed threshold for gear shifting form 2 to 1 for the cata law" UWORD _CNV_R_R_VA_F_0v01__500_CM 1 0. 0. 655.35 ECU_ADDRESS 0xd0004c80 FORMAT "%9.2" /end MEASUREMENT
/begin MEASUREMENT Vxx_vs_thd_wup_cata_2_3 "Vehicle speed threshold for gear shifting form 2 to 3 for the cata law" UWORD _CNV_R_R_VA_F_0v01__500_CM 1 0. 0. 655.35 ECU_ADDRESS 0xd0004c78 FORMAT "%9.2" /end MEASUREMENT
/begin MEASUREMENT Vxx_vs_thd_wup_cata_3_2 "Vehicle speed threshold for gear shifting form 3 to 2 for the cata law" UWORD _CNV_R_R_VA_F_0v01__500_CM 1 0. 0. 655.35 ECU_ADDRESS 0xd0004c82 FORMAT "%9.2" /end MEASUREMENT
/begin MEASUREMENT Vxx_vs_thd_wup_cata_3_4 "Vehicle speed threshold for gear shifting form 3 to 4 for the cata law" UWORD _CNV_R_R_VA_F_0v01__500_CM 1 0. 0. 655.35 ECU_ADDRESS 0xd0004c7a FORMAT "%9.2" /end MEASUREMENT
/begin MEASUREMENT Vxx_vs_thd_wup_cata_4_3 "Vehicle speed threshold for gear shifting form 4 to 3 for the cata law" UWORD _CNV_R_R_VA_F_0v01__500_CM 1 0. 0. 655.35 ECU_ADDRESS 0xd0004c84 FORMAT "%9.2" /end MEASUREMENT
/begin MEASUREMENT Vxx_vs_thd_wup_cata_4_5 "Vehicle speed threshold for gear shifting form 4 to 5 for the cata law" UWORD _CNV_R_R_VA_F_0v01__500_CM 1 0. 0. 655.35 ECU_ADDRESS 0xd0004c7c FORMAT "%9.2" /end MEASUREMENT
/begin MEASUREMENT Vxx_vs_thd_wup_cata_5_4 "Vehicle speed threshold for gear shifting form 5 to 4 for the cata law" UWORD _CNV_R_R_VA_F_0v01__500_CM 1 0. 0. 655.35 ECU_ADDRESS 0xd0004c86 FORMAT "%9.2" /end MEASUREMENT
/begin MEASUREMENT Vxx_vs_thd_wup_cata_5_6 "Vehicle speed threshold for gear shifting form 5 to 6 for the cata law" UWORD _CNV_R_R_VA_F_0v01__500_CM 1 0. 0. 655.35 ECU_ADDRESS 0xd0004c7e FORMAT "%9.2" /end MEASUREMENT
/begin MEASUREMENT Vxx_vs_thd_wup_cata_6_5 "Vehicle speed threshold for gear shifting form 6 to 5 for the cata law" UWORD _CNV_R_R_VA_F_0v01__500_CM 1 0. 0. 655.35 ECU_ADDRESS 0xd0004c88 FORMAT "%9.2" /end MEASUREMENT
/begin MEASUREMENT Vxx_vs_thd_xurb_1_2 "Vehicle speed threshold for gear shifting form 1 to 2 for the extra urban law" UWORD _CNV_R_R_VA_F_0v01__500_CM 1 0. 0. 655.35 ECU_ADDRESS 0xd0004c62 FORMAT "%9.2" /end MEASUREMENT
/begin MEASUREMENT Vxx_vs_thd_xurb_2_1 "Vehicle speed threshold for gear shifting form 2 to 1 for the extra urban law" UWORD _CNV_R_R_VA_F_0v01__500_CM 1 0. 0. 655.35 ECU_ADDRESS 0xd0004c6c FORMAT "%9.2" /end MEASUREMENT
/begin MEASUREMENT Vxx_vs_thd_xurb_2_3 "Vehicle speed threshold for gear shifting form 2 to 3 for the extra urban law" UWORD _CNV_R_R_VA_F_0v01__500_CM 1 0. 0. 655.35 ECU_ADDRESS 0xd0004c64 FORMAT "%9.2" /end MEASUREMENT
/begin MEASUREMENT Vxx_vs_thd_xurb_3_2 "Vehicle speed threshold for gear shifting form 3 to 2 for the extra urban law" UWORD _CNV_R_R_VA_F_0v01__500_CM 1 0. 0. 655.35 ECU_ADDRESS 0xd0004c6e FORMAT "%9.2" /end MEASUREMENT
/begin MEASUREMENT Vxx_vs_thd_xurb_3_4 "Vehicle speed threshold for gear shifting form 3 to 4 for the extra urban law" UWORD _CNV_R_R_VA_F_0v01__500_CM 1 0. 0. 655.35 ECU_ADDRESS 0xd0004c66 FORMAT "%9.2" /end MEASUREMENT
/begin MEASUREMENT Vxx_vs_thd_xurb_4_3 "Vehicle speed threshold for gear shifting form 4 to 3 for the extra urban law" UWORD _CNV_R_R_VA_F_0v01__500_CM 1 0. 0. 655.35 ECU_ADDRESS 0xd0004c70 FORMAT "%9.2" /end MEASUREMENT
/begin MEASUREMENT Vxx_vs_thd_xurb_4_5 "Vehicle speed threshold for gear shifting form 4 to 5 for the extra urban law" UWORD _CNV_R_R_VA_F_0v01__500_CM 1 0. 0. 655.35 ECU_ADDRESS 0xd0004c68 FORMAT "%9.2" /end MEASUREMENT
/begin MEASUREMENT Vxx_vs_thd_xurb_5_4 "Vehicle speed threshold for gear shifting form 5 to 4 for the extra urban law" UWORD _CNV_R_R_VA_F_0v01__500_CM 1 0. 0. 655.35 ECU_ADDRESS 0xd0004c72 FORMAT "%9.2" /end MEASUREMENT
/begin MEASUREMENT Vxx_vs_thd_xurb_5_6 "Vehicle speed threshold for gear shifting form 5 to 6 for the extra urban law" UWORD _CNV_R_R_VA_F_0v01__500_CM 1 0. 0. 655.35 ECU_ADDRESS 0xd0004c6a FORMAT "%9.2" /end MEASUREMENT
/begin MEASUREMENT Vxx_vs_thd_xurb_6_5 "Vehicle speed threshold for gear shifting form 6 to 5 for the extra urban law" UWORD _CNV_R_R_VA_F_0v01__500_CM 1 0. 0. 655.35 ECU_ADDRESS 0xd0004c74 FORMAT "%9.2" /end MEASUREMENT
/begin CHARACTERISTIC Cbx_apmp_ena_cfm "Anti pump enable bit" VALUE 0xa0022214 _REC_S1VAL_Normal_u1 1. _CNV_S_2_VA_Bool_ON_502_CM 0. 1. BIT_MASK 0x1 /end CHARACTERISTIC
/begin CHARACTERISTIC Cbx_brk_ass_ena_cfm "Enable bit for the brake assistance function" VALUE 0xa002227c _REC_S1VAL_Normal_u1 1. _CNV_S_2_VA_Bool_ON_502_CM 0. 1. BIT_MASK 0x1 /end CHARACTERISTIC
/begin CHARACTERISTIC Cbx_cru_blk_cfm "Enable bit for cruise control detection" VALUE 0xa0022262 _REC_S1VAL_Normal_u1 1. _CNV_S_2_VA_Bool_ON_502_CM 0. 1. BIT_MASK 0x1 /end CHARACTERISTIC
/begin CHARACTERISTIC Cbx_cur_ena_cfm "Enable bit for gear inhibition by curve detection" VALUE 0xa0022263 _REC_S1VAL_Normal_u1 1. _CNV_S_2_VA_Bool_ON_502_CM 0. 1. BIT_MASK 0x1 /end CHARACTERISTIC
/begin CHARACTERISTIC Cbx_dly_ena_cfm "Enable bit for delay management function" VALUE 0xa002223a _REC_S1VAL_Normal_u1 1. _CNV_S_2_VA_Bool_ON_502_CM 0. 1. BIT_MASK 0x1 /end CHARACTERISTIC
/begin CHARACTERISTIC Cbx_down_shf_blk_cur_cfm "Enable bit for down shift inhibition by curve detection" VALUE 0xa0022264 _REC_S1VAL_Normal_u1 1. _CNV_S_2_VA_Bool_ON_502_CM 0. 1. BIT_MASK 0x1 /end CHARACTERISTIC
/begin CHARACTERISTIC Cbx_fast_off_ena_cfm "Enable bit for fast off function" VALUE 0xa0022253 _REC_S1VAL_Normal_u1 1. _CNV_S_2_VA_Bool_ON_502_CM 0. 1. BIT_MASK 0x1 /end CHARACTERISTIC
/begin CHARACTERISTIC Cbx_fast_off_kd_ena_cfm "Enable bit for the kick function" VALUE 0xa0022254 _REC_S1VAL_Normal_u1 1. _CNV_S_2_VA_Bool_ON_502_CM 0. 1. BIT_MASK 0x1 /end CHARACTERISTIC
/begin CHARACTERISTIC Cbx_fast_on_ena_cfm "Enable bit for fast on function" VALUE 0xa002225d _REC_S1VAL_Normal_u1 1. _CNV_S_2_VA_Bool_ON_502_CM 0. 1. BIT_MASK 0x1 /end CHARACTERISTIC
/begin CHARACTERISTIC Cbx_free_shf_dsb_cfm "Calibration to inhibit free shift display" VALUE 0xa002229a _REC_S1VAL_Normal_u1 1. _CNV_S_2_VA_Bool_ON_502_CM 0. 1. BIT_MASK 0x1 /end CHARACTERISTIC
/begin CHARACTERISTIC Cbx_gear_blk_cfm "Enable bit for gear shift inhibitions" VALUE 0xa0022265 _REC_S1VAL_Normal_u1 1. _CNV_S_2_VA_Bool_ON_502_CM 0. 1. BIT_MASK 0x1 /end CHARACTERISTIC
/begin CHARACTERISTIC Cbx_wal_1_req_fs_cfm "Enable bit for gear shift inhibitions on global warning lamp 1 activation request" VALUE 0xa0022266 _REC_S1VAL_Normal_u1 1. _CNV_S_2_VA_Bool_ON_502_CM 0. 1. BIT_MASK 0x1 /end CHARACTERISTIC
/begin CHARACTERISTIC Cxx_acel_in_brk_ass_thd "Vehicle acceleration in threshold" VALUE 0xa0022268 _REC_S1VAL_Normal_s4 25.5 _CNV_R_R_VA_F_0v000_496_CM -12. 13.5 FORMAT "%9.4" /end CHARACTERISTIC
/begin CHARACTERISTIC Cxx_acel_out_brk_ass_thd "Vehicle acceleration out threshold" VALUE 0xa002226c _REC_S1VAL_Normal_s4 25.5 _CNV_R_R_VA_F_0v000_496_CM -12. 13.5 FORMAT "%9.4" /end CHARACTERISTIC
/begin CHARACTERISTIC Cxx_cur_tra_acel_hys "Hysteresis of transverse acceleration for the bend detection" VALUE 0xa002221c _REC_S1VAL_Normal_u2 13.5 _CNV_R_R_VA_F_0v000_496_CM 0. 13.5 FORMAT "%9.4" /end CHARACTERISTIC
/begin CHARACTERISTIC Cxx_dhil_flat_thd "Torque threshold to pass from downhill mod to flat mod" VALUE 0xa002227e _REC_S1VAL_Normal_s2 65535. _CNV_R_R_VA_F_1_p0__515_CM -32768. 32767. FORMAT "%9.2" /end CHARACTERISTIC
/begin CHARACTERISTIC Cxx_down_shf_no_seq_dly "Temporization value for the down shift sequence control" VALUE 0xa0022238 _REC_S1VAL_Normal_u1 5.1 _CNV_R_R_VA_F_0v02__497_CM 0. 5.1 FORMAT "%9.2" /end CHARACTERISTIC
/begin CHARACTERISTIC Cxx_down_shf_pow_rat "Power margine for down shift calcul" VALUE 0xa002220c _REC_S1VAL_Normal_u2 100. _CNV_R_R_VA_F_0v125_510_CM 0. 100. FORMAT "%9.2" /end CHARACTERISTIC
/begin CHARACTERISTIC Cxx_down_up_shf_no_seq_dly "Temporization value for the down shift to up shift sequence control" VALUE 0xa002223c _REC_S1VAL_Normal_u1 5.1 _CNV_R_R_VA_F_0v02__497_CM 0. 5.1 FORMAT "%9.2" /end CHARACTERISTIC
/begin CHARACTERISTIC Cxx_driv_ant_dly "Temporization value for the driver anticipation" VALUE 0xa0022239 _REC_S1VAL_Normal_u1 5.1 _CNV_R_R_VA_F_0v02__497_CM 0. 5.1 FORMAT "%9.2" /end CHARACTERISTIC
/begin CHARACTERISTIC Cxx_fast_off_kd_pdl_thd "Kick down value" VALUE 0xa002223e _REC_S1VAL_Normal_u2 100. _CNV_R_R_VA_F_0v125_492_CM 0. 100. FORMAT "%9.2" /end CHARACTERISTIC
/begin CHARACTERISTIC Cxx_flat_dhil_thd "Torque threshold to pass from flat mod to downhill mod" VALUE 0xa0022280 _REC_S1VAL_Normal_s2 65535. _CNV_R_R_VA_F_1_p0__515_CM -32768. 32767. FORMAT "%9.2" /end CHARACTERISTIC
/begin CHARACTERISTIC Cxx_flat_uhil_thd "Torque threshold to pass from flat mod to uphill mod" VALUE 0xa0022282 _REC_S1VAL_Normal_s2 65535. _CNV_R_R_VA_F_1_p0__515_CM -32768. 32767. FORMAT "%9.2" /end CHARACTERISTIC
/begin CHARACTERISTIC Cxx_free_shf_no_pdl "Foot up value" VALUE 0xa0022270 _REC_S1VAL_Normal_u2 100. _CNV_R_R_VA_F_0v125_492_CM 0. 100. FORMAT "%9.2" /end CHARACTERISTIC
/begin CHARACTERISTIC Cxx_free_shf_no_pdl_brk_ass "Foot up value for brake assistance" VALUE 0xa0022272 _REC_S1VAL_Normal_u2 100. _CNV_R_R_VA_F_0v125_492_CM 0. 100. FORMAT "%9.2" /end CHARACTERISTIC
/begin CHARACTERISTIC Cxx_free_shf_no_pdl_fast_off "Foot up value" VALUE 0xa0022240 _REC_S1VAL_Normal_u2 100. _CNV_R_R_VA_F_0v125_492_CM 0. 100. FORMAT "%9.2" /end CHARACTERISTIC
/begin CHARACTERISTIC Cxx_free_shf_no_pdl_fast_on "Foot up value" VALUE 0xa0022258 _REC_S1VAL_Normal_u2 100. _CNV_R_R_VA_F_0v125_492_CM 0. 100. FORMAT "%9.2" /end CHARACTERISTIC
/begin CHARACTERISTIC Cxx_gear_max "a_pc_drc_opo_fslawxx_xxx_xx_x_a/Max gear" VALUE 0xa002227a _REC_S1VAL_Normal_u1 5. _CNV_R_R_VA_F_1_p1__494_CM 1. 6. FORMAT "%9.2" /end CHARACTERISTIC
/begin CHARACTERISTIC Cxx_law_sel_cfm "Law value forcing" VALUE 0xa0022294 _REC_S1VAL_Normal_u1 14. _CNV_R_R_VA_I_16_503_CM 0. 14. FORMAT "%9.2" /end CHARACTERISTIC
/begin CHARACTERISTIC Cxx_lg_acel_law_fil "First order fiter constant time for the acceleration" VALUE 0xa002227b _REC_S1VAL_Normal_u1 5.1 _CNV_R_R_VA_F_0v02__497_CM 0. 5.1 FORMAT "%9.2" /end CHARACTERISTIC
/begin CHARACTERISTIC Cxx_max_decl "Deceleration threshold of emergency baking detectection" VALUE 0xa002225e _REC_S1VAL_Normal_s4 25.5 _CNV_R_R_VA_F_0v000_516_CM -12. 13.5 FORMAT "%9.4" /end CHARACTERISTIC
/begin CHARACTERISTIC Cxx_max_dspl_arw_cyc_nr "Number of display cycles" VALUE 0xa0022230 _REC_S1VAL_Normal_u1 32. _CNV_R_R_VA_I_16_503_CM 0. 32. FORMAT "%9.2" /end CHARACTERISTIC
/begin CHARACTERISTIC Cxx_max_dspl_arw_down_dly "Maximum time of a down shift display" VALUE 0xa0022220 _REC_S1VAL_Normal_u2 1310.7 _CNV_R_R_VA_F_0v02__497_CM 0. 1310.7 FORMAT "%9.2" /end CHARACTERISTIC
/begin CHARACTERISTIC Cxx_max_dspl_arw_up_dly "Maximum time of an up shift display" VALUE 0xa0022222 _REC_S1VAL_Normal_u2 1310.7 _CNV_R_R_VA_F_0v02__497_CM 0. 1310.7 FORMAT "%9.2" /end CHARACTERISTIC
/begin CHARACTERISTIC Cxx_max_pow_fs "Max value of Ctp_apmp_max_pow" VALUE 0xa0022210 _REC_S1VAL_Normal_u2 655350. _CNV_R_R_VA_F_10_p0_512_CM 0. 655350. FORMAT "%9.2" /end CHARACTERISTIC
/begin CHARACTERISTIC Cxx_min_dspl_arw_down_dly "Minimum time of a down shift display" VALUE 0xa002222e _REC_S1VAL_Normal_u1 5.1 _CNV_R_R_VA_F_0v02__497_CM 0. 5.1 FORMAT "%9.2" /end CHARACTERISTIC
/begin CHARACTERISTIC Cxx_min_dspl_arw_up_dly "Minimum time of an up shift display" VALUE 0xa0022231 _REC_S1VAL_Normal_u1 5.1 _CNV_R_R_VA_F_0v02__497_CM 0. 5.1 FORMAT "%9.2" /end CHARACTERISTIC
/begin CHARACTERISTIC Cxx_mv_vs_dec_fil "First order filter time for the vehicle speed mean value (if the vehicle speed gradient is negative)" VALUE 0xa0022295 _REC_S1VAL_Normal_u1 255. _CNV_R_R_VA_F_1_p0__517_CM 0. 255. FORMAT "%9.2" /end CHARACTERISTIC
/begin CHARACTERISTIC Cxx_mv_vs_inc_fil "First order filter time for the vehicle speed mean value (if the vehicle speed gradient is positve)" VALUE 0xa0022296 _REC_S1VAL_Normal_u1 255. _CNV_R_R_VA_F_1_p0__517_CM 0. 255. FORMAT "%9.2" /end CHARACTERISTIC
/begin CHARACTERISTIC Cxx_n_lim_apmp_down_shf_hys "Engine speed hysteresis" VALUE 0xa0022212 _REC_S1VAL_Normal_u2 16383.75 _CNV_R_R_VA_F_0v25__491_CM 0. 16383.75 FORMAT "%9.2" /end CHARACTERISTIC
/begin CHARACTERISTIC Cxx_n_run_thd "Engine speed threshold (start engine)" VALUE 0xa002228a _REC_S1VAL_Normal_u2 16383.75 _CNV_R_R_VA_F_0v25__495_CM 0. 16383.75 FORMAT "%9.2" /end CHARACTERISTIC
/begin CHARACTERISTIC Cxx_pdl_cru_min_lim "Minimum pedale value in cruise control" VALUE 0xa0022298 _REC_S1VAL_Normal_u2 100. _CNV_R_R_VA_F_0v125_492_CM 0. 100. FORMAT "%9.2" /end CHARACTERISTIC
/begin CHARACTERISTIC Cxx_pdl_fast_on_kd_thd "Kick down threshold value for the fast on function" VALUE 0xa002225a _REC_S1VAL_Normal_u2 100. _CNV_R_R_VA_F_0v125_492_CM 0. 100. FORMAT "%9.2" /end CHARACTERISTIC
/begin CHARACTERISTIC Cxx_pdl_grd_fast_on_thd "Pedal gradient threshold for fast on function" VALUE 0xa0022256 _REC_S1VAL_Normal_s2 4000. _CNV_R_R_VA_F_0v125_514_CM -2000. 2000. FORMAT "%9.2" /end CHARACTERISTIC
/begin CHARACTERISTIC Cxx_pdl_grd_fil "Pedal gradient filter constant time" VALUE 0xa002225c _REC_S1VAL_Normal_u1 5.1 _CNV_R_R_VA_F_0v02__497_CM 0. 5.1 FORMAT "%9.2" /end CHARACTERISTIC
/begin CHARACTERISTIC Cxx_pdl_grd_in_neg_thd "Negative pedal gradient threshold to enter in Fast off" VALUE 0xa0022242 _REC_S1VAL_Normal_s2 4000. _CNV_R_R_VA_F_0v125_514_CM -2000. 2000. FORMAT "%9.2" /end CHARACTERISTIC
/begin CHARACTERISTIC Cxx_pdl_grd_out_neg_thd "Negative pedal gradient threshold to exit Fast off" VALUE 0xa0022244 _REC_S1VAL_Normal_s2 4000. _CNV_R_R_VA_F_0v125_514_CM -2000. 2000. FORMAT "%9.2" /end CHARACTERISTIC
/begin CHARACTERISTIC Cxx_pow_apmp_hys "Hysteresis power value for the anti pump tests" VALUE 0xa002220a _REC_S1VAL_Normal_s2 655350. _CNV_R_R_VA_F_10_p0_512_CM -327680. 327670. FORMAT "%9.2" /end CHARACTERISTIC
/begin CHARACTERISTIC Cxx_rest_dspl_arw_down_dly "Restart time of a down shift display" VALUE 0xa0022224 _REC_S1VAL_Normal_u2 1310.7 _CNV_R_R_VA_F_0v02__497_CM 0. 1310.7 FORMAT "%9.2" /end CHARACTERISTIC
/begin CHARACTERISTIC Cxx_rest_dspl_arw_up_dly "Restart time of an up shift display" VALUE 0xa0022226 _REC_S1VAL_Normal_u2 1310.7 _CNV_R_R_VA_F_0v02__497_CM 0. 1310.7 FORMAT "%9.2" /end CHARACTERISTIC
/begin CHARACTERISTIC Cxx_sta_dspl_arw_down_dly "Start time of a down shift display" VALUE 0xa002222f _REC_S1VAL_Normal_u1 5.1 _CNV_R_R_VA_F_0v02__497_CM 0. 5.1 FORMAT "%9.2" /end CHARACTERISTIC
/begin CHARACTERISTIC Cxx_tco_thd "Engine coolant temperature threshold for the cata test" VALUE 0xa002228c _REC_S1VAL_Normal_u2 240. _CNV_R_R_VA_F_0v1_m_518_CM -40. 200. FORMAT "%9.2" /end CHARACTERISTIC
/begin CHARACTERISTIC Cxx_tra_acel_cur_fil "Time constant of the first order filter of the transverse acceleration" VALUE 0xa002221e _REC_S1VAL_Normal_u1 5.1 _CNV_R_R_VA_F_0v02__497_CM 0. 5.1 FORMAT "%9.2" /end CHARACTERISTIC
/begin CHARACTERISTIC Cxx_uhil_flat_thd "Torque threshold to pass from uphill mod to flat mod" VALUE 0xa0022286 _REC_S1VAL_Normal_s2 65535. _CNV_R_R_VA_F_1_p0__515_CM -32768. 32767. FORMAT "%9.2" /end CHARACTERISTIC
/begin CHARACTERISTIC Cxx_up_down_shf_no_seq_dly "Temporization value for the up shift to down shift sequence control" VALUE 0xa002223b _REC_S1VAL_Normal_u1 5.1 _CNV_R_R_VA_F_0v02__497_CM 0. 5.1 FORMAT "%9.2" /end CHARACTERISTIC
/begin CHARACTERISTIC Cxx_up_shf_dly "Temporization value used for the up shift delay" VALUE 0xa0022252 _REC_S1VAL_Normal_u1 5.1 _CNV_R_R_VA_F_0v02__497_CM 0. 5.1 FORMAT "%9.2" /end CHARACTERISTIC
/begin CHARACTERISTIC Cxx_up_shf_pow_rat "Power margine for up shift calcul" VALUE 0xa002220e _REC_S1VAL_Normal_u2 100. _CNV_R_R_VA_F_0v125_510_CM 0. 100. FORMAT "%9.2" /end CHARACTERISTIC
/begin CHARACTERISTIC Cxx_vs_eco_xurb_thd "Average vehicle speed threshold value to pass from eco law to ext urban law" VALUE 0xa002228e _REC_S1VAL_Normal_u2 655.35 _CNV_R_R_VA_F_0v01__500_CM 0. 655.35 FORMAT "%9.2" /end CHARACTERISTIC
/begin CHARACTERISTIC Cxx_vs_xurb_eco_thd "Average vehicle speed threshold value to pass from ext urban law to eco law" VALUE 0xa0022290 _REC_S1VAL_Normal_u2 655.35 _CNV_R_R_VA_F_0v01__500_CM 0. 655.35 FORMAT "%9.2" /end CHARACTERISTIC
/begin CHARACTERISTIC Cxx_wup_cata_dly "Timer calibration for the cata law" VALUE 0xa0022292 _REC_S1VAL_Normal_u2 65535. _CNV_R_R_VA_F_1_p0__517_CM 0. 65535. FORMAT "%9.2" /end CHARACTERISTIC
/begin AXIS_PTS Ctb_gear_fs "Ctb_gear_fs" 0xa002229c NO_INPUT_QUANTITY _REC_A2AXS_20_u1 5. _CNV_R_R_VA_F_1_p1__494_CM 6 1. 6. FORMAT "%9.2" /end AXIS_PTS
/begin COMPU_METHOD _CNV_A_R_ECME_LINEA_0_CM "" RAT_FUNC "%6.3" "-" COEFFS 0 1. 0. 0 0 1 /end COMPU_METHOD
/begin COMPU_METHOD _CNV_S_2_RANGE______3_CM "" TAB_VERB "%6.3" "-" COMPU_TAB_REF _CNV_S_2_RANGE______3 /end COMPU_METHOD
/begin COMPU_VTAB _CNV_S_2_RANGE______3 "" TAB_VERB 2 0 "0" 1 "1" /end COMPU_VTAB
/begin COMPU_METHOD _CNV_A_R_ENSD_LINEA_22_CM "" RAT_FUNC "%6.3" "rpm" COEFFS 0 4. 0. 0 0 1 /end COMPU_METHOD
/begin COMPU_METHOD _CNV_A_R_LINEAR_____29_CM "" RAT_FUNC "%6.3" "-" COEFFS 0 256. 0. 0 0 1 /end COMPU_METHOD
/begin COMPU_METHOD _CNV_A_R_LINEAR_____32_CM "" RAT_FUNC "%6.3" "s" COEFFS 0 100. 0. 0 0 1 /end COMPU_METHOD
/begin COMPU_METHOD _CNV_A_R_LINEAR_____42_CM "" RAT_FUNC "%6.3" "-" COEFFS 0 128. 0. 0 0 1 /end COMPU_METHOD
/begin COMPU_METHOD _CNV_A_R_LINEAR_____53_CM "" RAT_FUNC "%6.3" "-" COEFFS 0 16384. 0. 0 0 1 /end COMPU_METHOD
/begin COMPU_METHOD _CNV_A_R_LINEAR_____58_CM "" RAT_FUNC "%6.3" "s" COEFFS 0 10. 0. 0 0 1 /end COMPU_METHOD
/begin COMPU_METHOD _CNV_A_R_LINEAR_____71_CM "" RAT_FUNC "%6.3" "km/h" COEFFS 0 1. 0. 0 0 1 /end COMPU_METHOD
/begin COMPU_METHOD _CNV_A_R_LINEAR_____100_CM "" RAT_FUNC "%6.3" "-" COEFFS 0 98303.99999999926 -65535.99344639951 0 0 1 /end COMPU_METHOD
/begin COMPU_METHOD _CNV_A_R_LINEAR_____101_CM "" RAT_FUNC "%6.3" "TDC" COEFFS 0 1. 0. 0 0 1 /end COMPU_METHOD
/begin COMPU_METHOD _CNV_A_R_LINEAR_____102_CM "" RAT_FUNC "%6.3" "µs" COEFFS 0 0.25 0. 0 0 1 /end COMPU_METHOD
/begin COMPU_METHOD _CNV_A_R_LINEAR_____103_CM "" RAT_FUNC "%6.3" "[-]" COEFFS 0 384. -256.0000128 0 0 1 /end COMPU_METHOD
/begin COMPU_METHOD _CNV_A_R_LINEAR_____110_CM "" RAT_FUNC "%6.3" "°C" COEFFS 0 10. 400. 0 0 1 /end COMPU_METHOD
/begin COMPU_METHOD _CNV_A_R_LINEAR_____115_CM "" RAT_FUNC "%6.3" "hPa" COEFFS 0 1. 0. 0 0 1 /end COMPU_METHOD
/begin COMPU_METHOD _CNV_A_R_LINEAR_____123_CM "" RAT_FUNC "%6.3" "-" COEFFS 0 100. 0. 0 0 1 /end COMPU_METHOD
/begin COMPU_METHOD _CNV_A_R_LINEAR_____125_CM "" RAT_FUNC "%6.3" "km/h" COEFFS 0 100. 0. 0 0 1 /end COMPU_METHOD
/begin COMPU_METHOD _CNV_A_R_LINEAR_____145_CM "" RAT_FUNC "%6.3" "-" COEFFS 0 1. 1. 0 0 1 /end COMPU_METHOD
/begin COMPU_METHOD _CNV_A_R_LINEAR_____161_CM "" RAT_FUNC "%6.3" "-" COEFFS 0 1000. 0. 0 0 1 /end COMPU_METHOD
/begin COMPU_METHOD _CNV_A_R_LINEAR_____162_CM "" RAT_FUNC "%6.3" "-" COEFFS 0 255. 0. 0 0 1 /end COMPU_METHOD
/begin COMPU_METHOD _CNV_A_R_LINEAR_____164_CM "" RAT_FUNC "%6.3" "1/s" COEFFS 0 1000. 0. 0 0 1 /end COMPU_METHOD
/begin COMPU_METHOD _CNV_A_R_LINEAR_____172_CM "" RAT_FUNC "%6.3" "kg/h" COEFFS 0 20. 0. 0 0 1 /end COMPU_METHOD
/begin COMPU_METHOD _CNV_S_3_STATUS_OK__179_CM "" TAB_VERB "%6.3" "-" COMPU_TAB_REF _CNV_S_3_STATUS_OK__179 /end COMPU_METHOD
/begin COMPU_VTAB _CNV_S_3_STATUS_OK__179 "" TAB_VERB 3 0 "Nsx_vld_nok_0" 1 "Nsx_vld_ok_1" 2 "Nsx_vld_fail_2" /end COMPU_VTAB
/begin COMPU_METHOD _CNV_S_3_STATUS_OK__213_CM "" TAB_VERB "%6.3" "" COMPU_TAB_REF _CNV_S_3_STATUS_OK__213 /end COMPU_METHOD
/begin COMPU_VTAB _CNV_S_3_STATUS_OK__213 "" TAB_VERB 3 0 "Nsx_vld_nok_0" 1 "Nsx_vld_ok_1" 2 "Nsx_vld_fail_2" /end COMPU_VTAB
/begin COMPU_METHOD _CNV_A_R_LINEAR_____216_CM "" RAT_FUNC "%6.3" "Nm" COEFFS 0 32. 12800. 0 0 1 /end COMPU_METHOD
/begin COMPU_METHOD _CNV_S_8_STATUS_OK__234_CM "" TAB_VERB "%6.3" "-" COMPU_TAB_REF _CNV_S_8_STATUS_OK__234 /end COMPU_METHOD
/begin COMPU_VTAB _CNV_S_8_STATUS_OK__234 "" TAB_VERB 8 0 "Nsx_vld_nok_0" 1 "Nsx_vld_ok_1" 2 "Nsx_vld_fail_2" 3 "Nsx_vld_fail_3" 4 "Nsx_vld_fail_4" 5 "Nsx_vld_fail_5" 6 "Nsx_vld_fail_6" 7 "Nsx_vld_fail_7" /end COMPU_VTAB
/begin COMPU_METHOD _CNV_A_R_LINEAR_____267_CM "" RAT_FUNC "%6.3" "%" COEFFS 0 800. 0. 0 0 1 /end COMPU_METHOD
/begin COMPU_METHOD _CNV_A_R_LINEAR_____294_CM "" RAT_FUNC "%6.3" "-" COEFFS 0 25.6 0. 0 0 1 /end COMPU_METHOD
/begin COMPU_METHOD _CNV_A_R_LINEAR_____361_CM "" RAT_FUNC "%6.3" "N" COEFFS 0 0.5 0. 0 0 1 /end COMPU_METHOD
/begin COMPU_METHOD _CNV_A_R_LINEAR_____369_CM "" RAT_FUNC "%6.3" "Nm" COEFFS 0 10. 0. 0 0 1 /end COMPU_METHOD
/begin COMPU_METHOD _CNV_A_R_LINEAR_____396_CM "" RAT_FUNC "%6.3" "(km/h)/K*rpm" COEFFS 0 100. 0. 0 0 1 /end COMPU_METHOD
/begin COMPU_METHOD _CNV_A_R_LINEAR_____408_CM "" RAT_FUNC "%6.3" "s" COEFFS 0 2. 0. 0 0 1 /end COMPU_METHOD
/begin COMPU_METHOD _CNV_A_R_LINEAR_____442_CM "" RAT_FUNC "%6.3" "°C" COEFFS 0 0.25 10. 0 0 1 /end COMPU_METHOD
/begin COMPU_METHOD _CNV_A_R_LINEAR_____466_CM "" RAT_FUNC "%6.3" "N" COEFFS 0 4.e-002 0. 0 0 1 /end COMPU_METHOD
/begin COMPU_METHOD _CNV_A_R_LINEAR_____467_CM "" RAT_FUNC "%6.3" "km/h/s" COEFFS 0 524.2879999999999 -7.275957614183426e-012 0 0 1 /end COMPU_METHOD
/begin COMPU_METHOD _CNV_A_R_LINEAR_____468_CM "" RAT_FUNC "%6.3" "N" COEFFS 0 1. 0. 0 0 1 /end COMPU_METHOD
/begin COMPU_METHOD _CNV_A_R_LINEAR_____469_CM "" RAT_FUNC "%6.3" "1/s²" COEFFS 0 33.55443200078277 0. 0 0 1 /end COMPU_METHOD
/begin COMPU_METHOD _CNV_A_R_LINEAR_____470_CM "" RAT_FUNC "%6.3" "1/s" COEFFS 0 524.2880000000008 0. 0 0 1 /end COMPU_METHOD
/begin COMPU_METHOD _CNV_A_R_LINEAR_____471_CM "" RAT_FUNC "%6.3" "km/h/s" COEFFS 0 34359738.36799999 -4.76837158203125e-007 0 0 1 /end COMPU_METHOD
/begin COMPU_METHOD _CNV_A_R_LINEAR_____472_CM "" RAT_FUNC "%6.3" "km/h/s" COEFFS 0 100. 0. 0 0 1 /end COMPU_METHOD
/begin COMPU_METHOD _CNV_A_R_LINEAR_____473_CM "" RAT_FUNC "%6.3" "N/s" COEFFS 0 0.5 0. 0 0 1 /end COMPU_METHOD
/begin COMPU_METHOD _CNV_A_R_LINEAR_____474_CM "" RAT_FUNC "%6.3" "km/h/s" COEFFS 0 40. 0. 0 0 1 /end COMPU_METHOD
/begin COMPU_METHOD _CNV_A_R_LINEAR_____475_CM "" RAT_FUNC "%6.3" "kg" COEFFS 0 0.1 0. 0 0 1 /end COMPU_METHOD
/begin COMPU_METHOD _CNV_A_R_LINEAR_____476_CM "" RAT_FUNC "%6.3" "°C" COEFFS 0 0.25 0. 0 0 1 /end COMPU_METHOD
/begin COMPU_METHOD _CNV_A_R_LINEAR_____477_CM "" RAT_FUNC "%6.3" "%" COEFFS 0 255. 0. 0 0 1 /end COMPU_METHOD
/begin COMPU_METHOD _CNV_A_R_LINEAR_____478_CM "" RAT_FUNC "%6.3" "-" COEFFS 0 43.69066666666667 7.275957614183426e-012 0 0 1 /end COMPU_METHOD
/begin COMPU_METHOD _CNV_A_R_LINEAR_____479_CM "" RAT_FUNC "%6.3" "-" COEFFS 0 99999.99999999996 -1.117587089538574e-008 0 0 1 /end COMPU_METHOD
/begin COMPU_METHOD _CNV_A_R_LINEAR_____480_CM "" RAT_FUNC "%6.3" "s" COEFFS 0 25.6 0. 0 0 1 /end COMPU_METHOD
/begin COMPU_METHOD _CNV_S_4_CTL_MON_DI_481_CM "" TAB_VERB "%6.3" "-" COMPU_TAB_REF _CNV_S_4_CTL_MON_DI_481 /end COMPU_METHOD
/begin COMPU_VTAB _CNV_S_4_CTL_MON_DI_481 "" TAB_VERB 4 10 "Nsx_ctl_mon_ini" 20 "Nsx_ctl_mon_wait" 30 "Nsx_ctl_mon_diag" 40 "Nsx_ctl_mon_end" /end COMPU_VTAB
/begin COMPU_METHOD _CNV_A_R_LINEAR_____482_CM "" RAT_FUNC "%6.3" "m" COEFFS 0 3.6 0. 0 0 1 /end COMPU_METHOD
/begin COMPU_METHOD _CNV_S_3_RANGE_STAT_483_CM "" TAB_VERB "%6.3" "-" COMPU_TAB_REF _CNV_S_3_RANGE_STAT_483 /end COMPU_METHOD
/begin COMPU_VTAB _CNV_S_3_RANGE_STAT_483 "" TAB_VERB 3 1 "Nsx_tlz_aplci_wat_ap_stt" 2 "Nsx_tlz_aplci_fast_ap_stt" 3 "Nsx_tlz_aplci_slow_ap_stt" /end COMPU_VTAB
/begin COMPU_METHOD _CNV_S_2_RANGE_STAT_484_CM "" TAB_VERB "%6.3" "-" COMPU_TAB_REF _CNV_S_2_RANGE_STAT_484 /end COMPU_METHOD
/begin COMPU_VTAB _CNV_S_2_RANGE_STAT_484 "" TAB_VERB 2 0 "Nsx_tlz_clc_ini_wat_stt" 1 "Nsx_tlz_clc_clc_stt" /end COMPU_VTAB
/begin COMPU_METHOD _CNV_A_R_LINEAR_____485_CM "" RAT_FUNC "%6.3" "Nm" COEFFS 0 1. 0. 0 0 1 /end COMPU_METHOD
/begin COMPU_METHOD _CNV_A_R_LINEAR_____486_CM "" RAT_FUNC "%6.3" "Nm" COEFFS 0 10. 32768. 0 0 1 /end COMPU_METHOD
/begin COMPU_METHOD _CNV_R_R_VA_F_0v25__491_CM "" RAT_FUNC "%6.3" "RPM" COEFFS 0. 1. 0. 0. 0. 0.25 /end COMPU_METHOD
/begin COMPU_METHOD _CNV_R_R_VA_F_0v125_492_CM "" RAT_FUNC "%6.3" "ratio" COEFFS 0. 1. 0. 0. 0. 0.125 /end COMPU_METHOD
/begin COMPU_METHOD _CNV_R_R_VA_F_0v125_493_CM "" RAT_FUNC "%6.3" "ratio/s" COEFFS 0. 1. 2000. 0. 0. 0.125 /end COMPU_METHOD
/begin COMPU_METHOD _CNV_R_R_VA_F_1_p1__494_CM "" RAT_FUNC "%6.3" "-" COEFFS 0. 1. -1. 0. 0. 1. /end COMPU_METHOD
/begin COMPU_METHOD _CNV_R_R_VA_F_0v25__495_CM "" RAT_FUNC "%6.3" "rpm" COEFFS 0. 1. 0. 0. 0. 0.25 /end COMPU_METHOD
/begin COMPU_METHOD _CNV_R_R_VA_F_0v000_496_CM "" RAT_FUNC "%6.3" "m/s2" COEFFS 0. 1. 0. 0. 0. 4.e-004 /end COMPU_METHOD
/begin COMPU_METHOD _CNV_R_R_VA_F_0v02__497_CM "" RAT_FUNC "%6.3" "s" COEFFS 0. 1. 0. 0. 0. 2.e-002 /end COMPU_METHOD
/begin COMPU_METHOD _CNV_R_R_VA_F_10_m3_498_CM "" RAT_FUNC "%6.3" "W" COEFFS 0. 1. 327680. 0. 0. 10. /end COMPU_METHOD
/begin COMPU_METHOD _CNV_R_R_VA_F_0v1_p_499_CM "" RAT_FUNC "%6.3" "s" COEFFS 0. 1. 0. 0. 0. 0.1 /end COMPU_METHOD
/begin COMPU_METHOD _CNV_R_R_VA_F_0v01__500_CM "" RAT_FUNC "%6.3" "km/h" COEFFS 0. 1. 0. 0. 0. 1.e-002 /end COMPU_METHOD
/begin COMPU_METHOD _CNV_R_R_VA_F_0v01__501_CM "" RAT_FUNC "%6.3" "(km/h)/krpm" COEFFS 0. 1. 0. 0. 0. 1.e-002 /end COMPU_METHOD
/begin COMPU_METHOD _CNV_S_2_VA_Bool_ON_502_CM "" TAB_VERB "%6.3" "." COMPU_TAB_REF _CNV_S_2_VA_Bool_ON_502 /end COMPU_METHOD
/begin COMPU_VTAB _CNV_S_2_VA_Bool_ON_502 "" TAB_VERB 2 0 "OFF" 1 "ON" /end COMPU_VTAB
/begin COMPU_METHOD _CNV_R_R_VA_I_16_503_CM "" RAT_FUNC "%6.3" "-" COEFFS 0. 1. 0. 0. 0. 1. /end COMPU_METHOD
/begin COMPU_METHOD _CNV_S_3_VA_Vsx_fre_504_CM "" TAB_VERB "%6.3" "-" COMPU_TAB_REF _CNV_S_3_VA_Vsx_fre_504 /end COMPU_METHOD
/begin COMPU_VTAB _CNV_S_3_VA_Vsx_fre_504 "" TAB_VERB 3 0 "Nsx_arw_neut" 1 "Nsx_arw_up" 2 "Nsx_arw_down" /end COMPU_VTAB
/begin COMPU_METHOD _CNV_S_6_VA_Vsx_law_505_CM "" TAB_VERB "%6.3" "-" COMPU_TAB_REF _CNV_S_6_VA_Vsx_law_505 /end COMPU_METHOD
/begin COMPU_VTAB _CNV_S_6_VA_Vsx_law_505 "" TAB_VERB 6 1 "Nsx_mod_eco" 2 "Nsx_mod_xurb" 3 "Nsx_mod_dhil" 4 "Nsx_mod_uhil" 5 "Nsx_mod_wup_cata" 14 "Nsx_mod_uhil_2" /end COMPU_VTAB
/begin COMPU_METHOD _CNV_S_5_VA_Vsx_law_506_CM "" TAB_VERB "%6.3" "-" COMPU_TAB_REF _CNV_S_5_VA_Vsx_law_506 /end COMPU_METHOD
/begin COMPU_VTAB _CNV_S_5_VA_Vsx_law_506 "" TAB_VERB 5 1 "Nsx_mod_eco" 2 "Nsx_mod_xurb" 3 "Nsx_mod_dhil" 4 "Nsx_mod_uhil" 5 "Nsx_mod_wup_cata" /end COMPU_VTAB
/begin COMPU_METHOD _CNV_S_4_VA_Vsx_loa_507_CM "" TAB_VERB "%6.3" "-" COMPU_TAB_REF _CNV_S_4_VA_Vsx_loa_507 /end COMPU_METHOD
/begin COMPU_VTAB _CNV_S_4_VA_Vsx_loa_507 "" TAB_VERB 4 0 "Nsx_load_flat" 1 "Nsx_load_uhil" 2 "Nsx_load_dhil" 3 "Nsx_load_uhil_2" /end COMPU_VTAB
/begin COMPU_METHOD _CNV_S_2_VA_Vsx_roa_508_CM "" TAB_VERB "%6.3" "-" COMPU_TAB_REF _CNV_S_2_VA_Vsx_roa_508 /end COMPU_METHOD
/begin COMPU_VTAB _CNV_S_2_VA_Vsx_roa_508 "" TAB_VERB 2 1 "Nsx_road_eco" 2 "Nsx_road_xurb" /end COMPU_VTAB
/begin COMPU_METHOD _CNV_R_R_VA_F_1_p2__509_CM "" RAT_FUNC "%6.3" "-" COEFFS 0. 1. -2. 0. 0. 1. /end COMPU_METHOD
/begin COMPU_METHOD _CNV_R_R_VA_F_0v125_510_CM "" RAT_FUNC "%6.3" "%" COEFFS 0. 1. 0. 0. 0. 0.125 /end COMPU_METHOD
/begin COMPU_METHOD _CNV_R_R_VA_F_1_m1__511_CM "" RAT_FUNC "%6.3" "-" COEFFS 0. 1. 1. 0. 0. 1. /end COMPU_METHOD
/begin COMPU_METHOD _CNV_R_R_VA_F_10_p0_512_CM "" RAT_FUNC "%6.3" "W" COEFFS 0. 1. 0. 0. 0. 10. /end COMPU_METHOD
/begin COMPU_METHOD _CNV_R_R_VA_F_0v01__513_CM "" RAT_FUNC "%6.3" "ratio" COEFFS 0. 1. 0. 0. 0. 1.e-002 /end COMPU_METHOD
/begin COMPU_METHOD _CNV_R_R_VA_F_0v125_514_CM "" RAT_FUNC "%6.3" "ratio/s" COEFFS 0. 1. 0. 0. 0. 0.125 /end COMPU_METHOD
/begin COMPU_METHOD _CNV_R_R_VA_F_1_p0__515_CM "" RAT_FUNC "%6.3" "N.m" COEFFS 0. 1. 0. 0. 0. 1. /end COMPU_METHOD
/begin COMPU_METHOD _CNV_R_R_VA_F_0v000_516_CM "" RAT_FUNC "%6.3" "m/s²" COEFFS 0. 1. 0. 0. 0. 4.e-004 /end COMPU_METHOD
/begin COMPU_METHOD _CNV_R_R_VA_F_1_p0__517_CM "" RAT_FUNC "%6.3" "s" COEFFS 0. 1. 0. 0. 0. 1. /end COMPU_METHOD
/begin COMPU_METHOD _CNV_R_R_VA_F_0v1_m_518_CM "" RAT_FUNC "%6.3" "°C" COEFFS 0. 1. 40. 0. 0. 0.1 /end COMPU_METHOD
/begin RECORD_LAYOUT _REC_S1VAL_20_u4 FNC_VALUES 1 ULONG COLUMN_DIR DIRECT /end RECORD_LAYOUT
/begin RECORD_LAYOUT _REC_S1VAL_20_u1 FNC_VALUES 1 UBYTE COLUMN_DIR DIRECT /end RECORD_LAYOUT
/begin RECORD_LAYOUT _REC_A2AXS_20_u1 NO_AXIS_PTS_X 1 UBYTE AXIS_PTS_X 2 UBYTE INDEX_INCR DIRECT /end RECORD_LAYOUT
/begin RECORD_LAYOUT _REC_S1VAL_20_u2 FNC_VALUES 1 UWORD COLUMN_DIR DIRECT /end RECORD_LAYOUT
/begin RECORD_LAYOUT _REC_S1VAL_20_s2 FNC_VALUES 1 SWORD COLUMN_DIR DIRECT /end RECORD_LAYOUT
/begin RECORD_LAYOUT _REC_A2AXS_20_u2 NO_AXIS_PTS_X 1 UWORD AXIS_PTS_X 2 UWORD INDEX_INCR DIRECT /end RECORD_LAYOUT
/begin RECORD_LAYOUT _REC_A1CUR_20_u1_u2 FNC_VALUES 1 UBYTE COLUMN_DIR DIRECT /end RECORD_LAYOUT
/begin RECORD_LAYOUT _REC_A1CUR_20_u1_u1 FNC_VALUES 1 UBYTE COLUMN_DIR DIRECT /end RECORD_LAYOUT
/begin RECORD_LAYOUT _REC_A1CUR_20_u2_u1 FNC_VALUES 1 UWORD COLUMN_DIR DIRECT /end RECORD_LAYOUT
/begin RECORD_LAYOUT _REC_A1MAP_20_u2_u2_u2 FNC_VALUES 1 UWORD COLUMN_DIR DIRECT /end RECORD_LAYOUT
/begin RECORD_LAYOUT _REC_A1CUR_20_u2_u2 FNC_VALUES 1 UWORD COLUMN_DIR DIRECT /end RECORD_LAYOUT
/begin RECORD_LAYOUT _REC_A1MAP_20_u2_u2_u1 FNC_VALUES 1 UWORD COLUMN_DIR DIRECT /end RECORD_LAYOUT
/begin RECORD_LAYOUT _REC_A1MAP_20_u1_u1_u2 FNC_VALUES 1 UBYTE COLUMN_DIR DIRECT /end RECORD_LAYOUT
/begin RECORD_LAYOUT _REC_S1VAL_20_s1 FNC_VALUES 1 SBYTE COLUMN_DIR DIRECT /end RECORD_LAYOUT
/begin RECORD_LAYOUT _REC_A1MAP_20_u1_u2_u2 FNC_VALUES 1 UBYTE COLUMN_DIR DIRECT /end RECORD_LAYOUT
/begin RECORD_LAYOUT _REC_A1MAP_20_u2_u1_u2 FNC_VALUES 1 UWORD COLUMN_DIR DIRECT /end RECORD_LAYOUT
/begin RECORD_LAYOUT _REC_A1CUR_20_s2_u1 FNC_VALUES 1 SWORD COLUMN_DIR DIRECT /end RECORD_LAYOUT
/begin RECORD_LAYOUT _REC_S1VAL_20_s4 FNC_VALUES 1 SLONG COLUMN_DIR DIRECT /end RECORD_LAYOUT
/begin RECORD_LAYOUT _REC_S1VAL_Normal_u1 FNC_VALUES 1 UBYTE COLUMN_DIR DIRECT /end RECORD_LAYOUT
/begin RECORD_LAYOUT _REC_S1VAL_Normal_s4 FNC_VALUES 1 SLONG COLUMN_DIR DIRECT /end RECORD_LAYOUT
/begin RECORD_LAYOUT _REC_S1VAL_Normal_u2 FNC_VALUES 1 UWORD COLUMN_DIR DIRECT /end RECORD_LAYOUT
/begin RECORD_LAYOUT _REC_S1VAL_Normal_s2 FNC_VALUES 1 SWORD COLUMN_DIR DIRECT /end RECORD_LAYOUT
/begin FUNCTION PcCruCtl_Servoxx ""
 /begin DEF_CHARACTERISTIC Ctb_cru_sl_vs Ctp_dyn_forc Cbx_sl_max_i_cor Cxx_cru_cmf_cut_forc_dec Cxx_cru_min_forc Cxx_cru_ref_vs_acel_grd Cxx_cru_ref_vs_acel_ofs Cxx_cru_ref_vs_decl_grd Cxx_cru_ref_vs_decl_ofs Cxx_cru_sp_acel_grd Cxx_cru_sp_decl_grd Cxx_cru_sp_max_forc_inc Cxx_cru_svkl_ig Cxx_cru_svkl_max_i_cor Cxx_cru_svkl_min_i_cor Cxx_cru_svkl_pg Cxx_cru_svkl_vs_thd Cxx_sl_cmf_cut_forc_inc Cxx_sl_max_forc Cxx_sl_sp_max_forc_dec Cxx_sl_svkl_ig Cxx_sl_svkl_max_i_cor Cxx_sl_svkl_min_i_cor Cxx_sl_svkl_pg Cxx_sl_svkl_vs_thd Cxx_vh_wht /end DEF_CHARACTERISTIC
 /begin OUT_MEASUREMENT Vbx_cru_act Vbx_cru_mstr Vbx_cru_mstr_prev Vbx_cru_sl_svkl_act Vbx_csl_mstr Vxx_cru_fil_vs_ref Vxx_cru_fil_vs_ref_init Vxx_cru_fil_vs_ref_prev Vxx_cru_forc_sp_nom Vxx_cru_sl_dyn_forc_ini Vxx_cru_sl_fil_vs_ref Vxx_cru_sl_forc_ref Vxx_cru_sl_svkl_acel_ref Vxx_cru_sl_svkl_forc Vxx_cru_sl_svkl_forc_ref Vxx_cru_sl_svkl_ig Vxx_cru_sl_svkl_max_i_cor Vxx_cru_sl_svkl_min_i_cor Vxx_cru_sl_svkl_p_cor Vxx_cru_sl_svkl_pg Vxx_cru_sl_svkl_vs_i_cor Vxx_cru_sl_svkl_vs_i_cor_init Vxx_cru_sl_svkl_vs_i_cor_prev Vxx_cru_vs_ref_ofs Vxx_csl_forc_sp_nom Vxx_dyn_forc /end OUT_MEASUREMENT
/end FUNCTION
/begin FUNCTION PcCruCtl_Slarbxx "" /begin OUT_MEASUREMENT Vbx_sl_mstr Vxx_sl_forc_sp /end OUT_MEASUREMENT /end FUNCTION
/begin FUNCTION PcCruCtl_Fslsvxx "" /begin OUT_MEASUREMENT Vbx_fsl_mstr Vxx_fsl_forc_sp /end OUT_MEASUREMENT /end FUNCTION
/begin FUNCTION InAtiTbo "" /begin SUB_FUNCTION InAtiTbo_Gaztemp_xxxxxg /end SUB_FUNCTION /end FUNCTION
/begin FUNCTION InAtiTbo_Gaztemp_xxxxxg ""
 /begin DEF_CHARACTERISTIC Ntb_ex_gaz_temp Ntb_ex_gaz_temp_ofs_vs Ntb_map_cata_mdl_temp Ntb_n_cata_mdl_temp Cmp_ex_gaz_map_n_temp Ctp_ex_gaz_temp_ofs_maf Ctp_ex_gaz_temp_ofs_maf_l Ctp_ex_gaz_temp_ofs_vs Cxx_ex_gaz_fil_fac_inj /end DEF_CHARACTERISTIC
 /begin OUT_MEASUREMENT Vbx_cata_temp_rise Vsx_ex_gaz_temp_fil_val_vld Vxx_ex_gaz_fil_fac Vxx_ex_gaz_fil_fac_fall Vxx_ex_gaz_fil_fac_inj_cut Vxx_ex_gaz_fil_fac_rise Vxx_ex_gaz_map_n_temp Vxx_ex_gaz_temp_fil_val Vxx_ex_gaz_temp_fil_val_aut Vxx_ex_gaz_temp_fil_val_hold Vxx_ex_gaz_temp_fil_val_not_aut Vxx_ex_gaz_temp_ofs_vs Vxx_ex_gaz_temp_val Vxx_ex_gaz_temp_val_aut Vxx_ex_gaz_temp_val_not_aut /end OUT_MEASUREMENT
/end FUNCTION
/begin FUNCTION PcDrcOvt "" /begin SUB_FUNCTION PcDrcOvt_Drovtxx PcDrcOvt_Tkorixx /end SUB_FUNCTION /end FUNCTION
/begin FUNCTION PcDrcOvt_Drovtxx ""
 /begin DEF_CHARACTERISTIC Ctb_ovt_acel_pdl_dif_thd Ctp_ovt_acel_pdl_dif_thd Cbx_driv_ovt_req_100_rat_cfm Cbx_driv_ovt_req_dsb_cfm Cbx_driv_ovt_req_kd_cfm Cxx_ovt_acel_pdl_dif_t /end DEF_CHARACTERISTIC
 /begin OUT_MEASUREMENT Vbx_driv_ovt_req /end OUT_MEASUREMENT
/end FUNCTION
/begin FUNCTION PcDrcOvt_Tkorixx ""
 /begin DEF_CHARACTERISTIC Cxx_tkof_fl_mat_thd Cxx_tkof_map_hys Cxx_tkof_map_thd Cxx_tkof_n_h_thd Cxx_tkof_n_hys Cxx_tkof_n_l_thd /end DEF_CHARACTERISTIC
 /begin OUT_MEASUREMENT Vbx_tkof_fl_ena Vbx_tkof_fl_map_cdn Vbx_tkof_fl_mat_cdn Vbx_tkof_fl_n_cdn /end OUT_MEASUREMENT
/end FUNCTION
/begin FUNCTION InPciMgb "" /begin SUB_FUNCTION InPciMgb_Gecgexx InPciMgb_Schxxxx InPciMgb_Tqetgtx /end SUB_FUNCTION /end FUNCTION
/begin FUNCTION InPciMgb_Gecgexx ""
 /begin DEF_CHARACTERISTIC Cxx_gear_cge_dec_dly Cxx_gear_cge_sp_lim_dly Cxx_gear_cge_tqe_tgt_dly /end DEF_CHARACTERISTIC
 /begin OUT_MEASUREMENT Vbx_gear_cge_spv_on Vbx_gear_cge_tqe_sp_lim Vbx_gear_cge_tqe_tgt Vxx_gear_cge_fmt /end OUT_MEASUREMENT
/end FUNCTION
/begin FUNCTION InPciMgb_Schxxxx "" /begin DEF_CHARACTERISTIC Cbx_mgb_shf_ant_tq_cfm /end DEF_CHARACTERISTIC /begin OUT_MEASUREMENT Vbx_mgb_shf_ant_tq_cfm /end OUT_MEASUREMENT /end FUNCTION
/begin FUNCTION InPciMgb_Tqetgtx "" /begin DEF_CHARACTERISTIC Ctb_gear_cge_n_mv Cmp_gear_cge_tgt_tqe Cxx_mgb_max_tqe_tgt /end DEF_CHARACTERISTIC
 /begin OUT_MEASUREMENT Vbx_mgb_tqe_tgt_calc_on Vxx_mgb_max_tqe_tgt Vxx_mgb_min_tqe_tgt /end OUT_MEASUREMENT
/end FUNCTION
/begin FUNCTION CbRicDgn ""
 /begin OUT_MEASUREMENT Vxx_fsys_cpt_max Vxx_fsys_cpt_min Vxx_fsys_cpt_val Sxx_fsys_cor_ti_fac Sxx_fsys_cor_ti_fac_max Sxx_fsys_cor_ti_fac_min Vxx_cl_rich_chr_max Vxx_cl_rich_chr_val /end OUT_MEASUREMENT
 /begin SUB_FUNCTION CbRicDgn_Fuelxxx CbRicDgn_Ctlmonx CbRicDgn_Schxxxx /end SUB_FUNCTION
/end FUNCTION
/begin FUNCTION CbRicDgn_Fuelxxx ""
 /begin DEF_CHARACTERISTIC Ctb_fsys_n_5 Ctp_fsys_eal_min Cbx_conf_schd_diag_fsys Cbx_fsys_diag_conf Cxx_dfdec_fsys_cpt Cxx_dfinc_fsys_cpt Cxx_fsys_alco_dly_1 Cxx_fsys_alco_dly_2 Cxx_fsys_cor_fac_alco_max_1 Cxx_fsys_cor_fac_alco_max_2 Cxx_fsys_cor_fac_alco_min_1 Cxx_fsys_cor_fac_alco_min_2 Cxx_fsys_cor_fac_max_1 Cxx_fsys_cor_fac_max_2 Cxx_fsys_cor_fac_min_1 Cxx_fsys_cor_fac_min_2 Cxx_fsys_crit_alco_bal_1 Cxx_fsys_crit_alco_bal_2 Cxx_fsys_crit_alco_bal_3 Cxx_fsys_crit_bal_1 Cxx_fsys_crit_bal_2 Cxx_fsys_crit_bal_3 Cxx_fsys_crit_diag_alco_max_1 Cxx_fsys_crit_diag_alco_max_2 Cxx_fsys_crit_diag_alco_min_1 Cxx_fsys_crit_diag_alco_min_2 Cxx_fsys_crit_diag_max_1 Cxx_fsys_crit_diag_max_2 Cxx_fsys_crit_diag_min_1 Cxx_fsys_crit_diag_min_2 Cxx_fsys_dly_1 Cxx_fsys_dly_2 Cxx_fsys_eal_max_thd Cxx_fsys_fuel_typ_rat_max_1 Cxx_fsys_fuel_typ_rat_max_2 Cxx_fsys_fuel_typ_rat_min_1 Cxx_fsys_fuel_typ_rat_min_2 Cxx_fsys_n_max_thd Cxx_fsys_n_min_thd Cxx_fsys_tco_min_thd Cxx_fsys_thd_ad_fac_max Cxx_fsys_thd_ad_fac_min Cxx_fsys_thd_ad_ofs_max Cxx_fsys_thd_ad_ofs_min Cxx_fsys_win_nr_fail Cxx_fsys_win_nr_fail_alco Cxx_min_diag_fsys_dly /end DEF_CHARACTERISTIC
 /begin OUT_MEASUREMENT Vbx_df_fsys_cpt Vbx_diag_ena_fsys_cpt Vbx_dsb_diag_fsys_cpt Vbx_fsys_cond Vbx_fsys_req Vbx_trans_clf_fsys_cpt Vsx_fsys_stt Vsx_fsys_vld Vxx_diag_fsys_dsb_dly Vxx_fsys_cor_fac_max_1 Vxx_fsys_cor_fac_max_2 Vxx_fsys_cor_fac_min_1 Vxx_fsys_cor_fac_min_2 Vxx_fsys_cor_ti_fac Vxx_fsys_cor_ti_fac_clr Vxx_fsys_cor_ti_fac_ini Vxx_fsys_cor_ti_fac_max Vxx_fsys_cor_ti_fac_max_clr Vxx_fsys_cor_ti_fac_max_ini Vxx_fsys_cor_ti_fac_min Vxx_fsys_cor_ti_fac_min_clr Vxx_fsys_cor_ti_fac_min_ini Vxx_fsys_crit_bal_1 Vxx_fsys_crit_bal_2 Vxx_fsys_crit_bal_3 Vxx_fsys_crit_diag Vxx_fsys_crit_diag_clr Vxx_fsys_crit_diag_ini Vxx_fsys_crit_diag_max Vxx_fsys_crit_diag_max_1 Vxx_fsys_crit_diag_max_2 Vxx_fsys_crit_diag_max_clr Vxx_fsys_crit_diag_max_ini Vxx_fsys_crit_diag_med Vxx_fsys_crit_diag_med_1 Vxx_fsys_crit_diag_med_2 Vxx_fsys_crit_diag_med_3 Vxx_fsys_crit_diag_min Vxx_fsys_crit_diag_min_1 Vxx_fsys_crit_diag_min_2 Vxx_fsys_crit_diag_min_clr Vxx_fsys_crit_diag_min_ini Vxx_fsys_crit_diag_win Vxx_fsys_dft_dly Vxx_fsys_dly Vxx_fsys_dly_1 Vxx_fsys_dly_2 Vxx_fsys_no_dft_dly Vxx_fsys_win_ctr Vxx_fsys_win_nr_fail /end OUT_MEASUREMENT
/end FUNCTION
/begin FUNCTION CbRicDgn_Ctlmonx ""
 /begin DEF_CHARACTERISTIC Ctb_ctl_mon_tco Ctp_ctl_mon_t_max Cbx_conf_schd_diag_ctl_mon Cxx_dfdec_cl_rich_chr Cxx_dfinc_cl_rich_chr /end DEF_CHARACTERISTIC
 /begin OUT_MEASUREMENT Vbx_cl_mon_end Vbx_cl_mon_req Vbx_df_cl_rich_chr Vbx_diag_ena_cl_rich_chr Vsx_ctl_mon_stt Vxx_cl_rich_chr_max_clr Vxx_cl_rich_chr_max_ini Vxx_cl_rich_chr_val_clr Vxx_cl_rich_chr_val_ini Vxx_ctl_mon_t Vxx_ctl_mon_t_max Vxx_ctl_mon_thd_max /end OUT_MEASUREMENT
/end FUNCTION
/begin FUNCTION CbRicDgn_Schxxxx "" /begin DEF_CHARACTERISTIC Cbx_rich_clos_loop_mon_cfm /end DEF_CHARACTERISTIC /begin OUT_MEASUREMENT Vbx_rich_clos_loop_mon_cfm /end OUT_MEASUREMENT /end FUNCTION
/begin FUNCTION InTqiTlz ""
 /begin OUT_MEASUREMENT Vbx_tlz_ad_cor_ok Vbx_tlz_ad_b_done Vbx_tlz_ad_b_clc Vxx_tlz_ad_b_ok Vxx_tlz_ad_bkp_last Vxx_tlz_ad_b1_ctr_tdc Vxx_tlz_ad_b2_ctr_tdc Vxx_mis_n_max_thd_1_2 Vxx_tlz_ad_cor_ctr_tdc Vxx_tlz_ad_cor_fil Vxx_tlz_ad_cor_val Vxx_mis_km_dly Vxx_tlz_ad_b2_fil_1 Vxx_tlz_ad_b1_fil_2 Vxx_tlz_ad_b2_fil_2 Vxx_tlz_ad_b1_fil_1 Vxx_tlz_ad_b2_fil_3 Vxx_tlz_ad_b1_fil_3 Vxx_tlz_ad_b2_fil_4 Vxx_tlz_ad_b1_fil_4 Vxx_tlz_ad_b2_fil_5 Vxx_tlz_ad_b1_fil_5 Vxx_tlz_ad_b1_fil_6 Vxx_tlz_ad_b2_fil_6 Vxx_tlz_ad_b1_fil Vxx_tlz_ad_b2_fil /end OUT_MEASUREMENT
 /begin SUB_FUNCTION InTqiTlz_Aplcixx InTqiTlz_Aplcorx InTqiTlz_Betaxxx InTqiTlz_Ctlzxxx InTqiTlz_Obtlzco InTqiTlz_Tlzmfxx InTqiTlz_Alcoxxx /end SUB_FUNCTION
/end FUNCTION
/begin FUNCTION InTqiTlz_Aplcixx ""
 /begin DEF_CHARACTERISTIC Ctb_n_tlz_ad_b Ntb_7 Ctd_mis_n_max_thd_1_2 Ctd_tlz_ad_b_ena Ctp_tlz_ad_b_grd_prs Cbx_ad_ini_req Cbx_tq_ini_req Cxx_dfdec_tlz_ad_b_cpt Cxx_dfinc_tlz_ad_b_cpt Cxx_tlz_ad_b_fil_fac Cxx_tlz_ad_b_max Cxx_tlz_ad_b_max_1 Cxx_tlz_ad_b_max_2 Cxx_tlz_ad_b_max_3 Cxx_tlz_ad_b_max_4 Cxx_tlz_ad_b_max_5 Cxx_tlz_ad_b_max_6 Cxx_tlz_ad_b_min Cxx_tlz_ad_b_min_1 Cxx_tlz_ad_b_min_2 Cxx_tlz_ad_b_min_3 Cxx_tlz_ad_b_min_4 Cxx_tlz_ad_b_min_5 Cxx_tlz_ad_b_min_6 Cxx_tlz_ad_b_n_max Cxx_tlz_ad_b_n_max_1 Cxx_tlz_ad_b_n_max_2 Cxx_tlz_ad_b_n_max_3 Cxx_tlz_ad_b_n_max_4 Cxx_tlz_ad_b_n_max_5 Cxx_tlz_ad_b_n_max_6 Cxx_tlz_ad_b_n_min Cxx_tlz_ad_b_n_min_1 Cxx_tlz_ad_b_n_min_2 Cxx_tlz_ad_b_n_min_3 Cxx_tlz_ad_b_n_min_4 Cxx_tlz_ad_b_n_min_5 Cxx_tlz_ad_b_n_min_6 Cxx_tlz_ad_b_nr_tdc Cxx_tlz_ad_b_slow_nr_tdc Cxx_tlz_b_ini Cxx_vs_n_rat_dif_max Cxx_vs_n_rat_dif_max_dly /end DEF_CHARACTERISTIC
 /begin OUT_MEASUREMENT Vbx_df_tlz_ad_b_cpt Vbx_tlz_ad_b_ena Vbx_tlz_ad_b_fast_stt_ena Vbx_tlz_ad_b_slow_stt_ena Vbx_tlz_ad_b_wat_stt_ena Vbx_tlz_fast_ad_b_ena Vbx_tlz_slow_ad_b_dsb Vbx_tlz_slow_ad_b_ena Vsx_tlz_ad_b_stt Vsx_tlz_ad_b_vld Vxx_tlz_ad_b1_dif Vxx_tlz_ad_b1_fil_prev Vxx_tlz_ad_b2_dif Vxx_tlz_ad_b2_fil_prev Vxx_tlz_ad_b_ctr_tdc Vxx_tlz_ad_b_dif Vxx_tlz_ad_b_fil Vxx_tlz_ad_b_slow_ctr_tdc Vxx_tlz_ad_bkp /end OUT_MEASUREMENT
/end FUNCTION
/begin FUNCTION InTqiTlz_Aplcorx ""
 /begin DEF_CHARACTERISTIC Cbx_tlz_ad_cor_conf Cxx_tlz_ad_cor_fil_fac Cxx_tlz_ad_cor_n_max Cxx_tlz_ad_cor_n_min Cxx_tlz_ad_cor_nr_tdc Cxx_tlz_max_rat_n_ena Cxx_tlz_min_rat_n_ena /end DEF_CHARACTERISTIC
 /begin OUT_MEASUREMENT Vbx_tlz_ad_cor_ena Vbx_tlz_ad_cor_ok_1 Vbx_tlz_stt_0_tmp Vbx_tlz_stt_1_tmp Vbx_tlz_stt_2_tmp Vsx_tlz_ad_cor_stt Vxx_tlz_ad_cor_dif /end OUT_MEASUREMENT
/end FUNCTION
/begin FUNCTION InTqiTlz_Betaxxx "" /begin DEF_CHARACTERISTIC Cxx_tlz_n_max Cxx_tlz_n_min /end DEF_CHARACTERISTIC
 /begin OUT_MEASUREMENT Vbx_tlz_b_clc_ena Vtx_tlz_ad_b_val[0] Vtx_tlz_ad_b_val[1] Vtx_tlz_ad_b_val[2] Vtx_tlz_ad_b_val[3] Vtx_tlz_ad_b_val[4] Vtx_tlz_ad_b_val[5] Vxx_tlz_b1_val Vxx_tlz_b2_val Vxx_tlz_b_val /end OUT_MEASUREMENT
/end FUNCTION
/begin FUNCTION InTqiTlz_Ctlzxxx "" /begin DEF_CHARACTERISTIC Cxx_tlz_a Cxx_tlz_cor_n_max /end DEF_CHARACTERISTIC
 /begin OUT_MEASUREMENT Vbx_tlz_clc Vbx_tlz_err Vbx_tlz_l_n_clc_ena Vbx_tlz_off_stt Vbx_tlz_raw_clc Vbx_tlz_raw_err Vsx_tlz_clc_stt Vxx_tlz_b_cor Vxx_tlz_cor_tmp Vxx_tlz_raw_val Vxx_tlz_val Vxx_tlz_val_tmp /end OUT_MEASUREMENT
/end FUNCTION
/begin FUNCTION InTqiTlz_Obtlzco ""
 /begin DEF_CHARACTERISTIC Ctb_mis_tlz_cor_eal Ctb_mis_tlz_cor_n Cmp_mis_tlz_cor_cyl_0 Cmp_mis_tlz_cor_cyl_1 Cmp_mis_tlz_cor_cyl_2 Cxx_mis_km_dly /end DEF_CHARACTERISTIC
 /begin OUT_MEASUREMENT Vbx_mis_km_ena Vbx_mis_tlz_cor_ena Vxx_mis_tlz_cor Vxx_mis_tlz_val_cor /end OUT_MEASUREMENT
/end FUNCTION
/begin FUNCTION InTqiTlz_Tlzmfxx ""
 /begin DEF_CHARACTERISTIC Ctb_dft_comb_eal Ctb_mis_n_17 Cmp_det_thd_tlz_dif Cmp_det_thd_tlz_dif_agb Cmp_det_thd_tlz_dif_lpg Ctp_tlz_fil_fac Ctp_tlz_fil_fac_lpg Ctp_tlz_fil_rst_eal_dif Cxx_tlz_fil_rat Cxx_tlz_fil_rat_lpg Cxx_tlz_fil_rst_n_dif_thd /end DEF_CHARACTERISTIC
 /begin OUT_MEASUREMENT Vbx_mis_fil_rst_eal_dif Vbx_mis_fil_rst_eal_dif2 Vbx_mis_fil_rst_n_dif Vbx_mis_fil_rst_n_dif2 Vbx_mis_stat_fil Vbx_mis_stat_fil4 Vbx_mis_tlz_fil_rst Vsx_mis_tlz_vld Vxx_mis_tlz_dif Vxx_mis_tlz_fil_mes Vxx_mis_tlz_fil_mes1 Vxx_mis_tlz_fil_mes2 Vxx_mis_tlz_fil_mes3 Vxx_mis_tlz_fil_mes4 /end OUT_MEASUREMENT
/end FUNCTION
/begin FUNCTION InTqiTlz_Alcoxxx "" /begin DEF_CHARACTERISTIC Cmp_det_thd_tlz_dif_agb_alco Cmp_det_thd_tlz_dif_alco /end DEF_CHARACTERISTIC /begin OUT_MEASUREMENT Vxx_det_thd_tlz_dif_agb_alco Vxx_det_thd_tlz_dif_alco /end OUT_MEASUREMENT /end FUNCTION
/begin FUNCTION TqLimPmx "" /begin SUB_FUNCTION TqLimPmx_Fstqprj_xxxxxx /end SUB_FUNCTION /end FUNCTION
/begin FUNCTION TqLimPmx_Fstqprj_xxxxxx ""
 /begin OUT_MEASUREMENT Vbx_tq_rams_lim_spc_act_1 Vbx_tq_rams_lim_spc_act_2 Vbx_tq_rams_lim_spc_act_3 /end OUT_MEASUREMENT
/end FUNCTION
/begin FUNCTION PcDrcOpo ""
 /begin SUB_FUNCTION PcDrcOpo_Fsapgxx_xxxxxx PcDrcOpo_Fsfofxx_xxxxxx PcDrcOpo_Fsapmxx_xxxxxx PcDrcOpo_Fscurxx_xxxxxx PcDrcOpo_Fsdisxx_xxxxxx PcDrcOpo_Fsdlyxx_xxxxxx PcDrcOpo_Fsfonxx_xxxxxx PcDrcOpo_Fsgihxx_xxxxxx PcDrcOpo_Fslawhv_xxxxxx PcDrcOpo_Fslawxx_xxxxxx PcDrcOpo_Fslslxx_xxxxxx PcDrcOpo_Fspfzxx_xxxxxx PcDrcOpo_Schxxxx_xxxxxx /end SUB_FUNCTION
/end FUNCTION
/begin FUNCTION PcDrcOpo_Fsapgxx_xxxxxx ""
 /begin DEF_CHARACTERISTIC Ctb_n_apmp Ctp_apmp_max_pow Ctp_n_lim_apmp_down_shf Cxx_down_shf_pow_rat Cxx_max_pow_fs Cxx_n_lim_apmp_down_shf_hys Cxx_pow_apmp_hys Cxx_up_shf_pow_rat /end DEF_CHARACTERISTIC
 /begin OUT_MEASUREMENT Vbx_apmp_down_shf Vbx_apmp_up_shf Vxx_apmp_gear Vxx_gear_lim Vxx_gear_lim_inc Vxx_max_avl_pow Vxx_max_avl_pow_inc Vxx_max_avl_pow_rat Vxx_n_gear Vxx_n_gear_inc Vxx_pow_r_req_down Vxx_pow_r_req_up /end OUT_MEASUREMENT
/end FUNCTION
/begin FUNCTION PcDrcOpo_Fsfofxx_xxxxxx ""
 /begin DEF_CHARACTERISTIC Ctb_fast_off_pdl_grd Ctb_law Cmp_fast_off_law_pdl_grd_dly Ctp_fast_off_kd_n_thd Ctp_fast_off_no_pdl_dly Cbx_fast_off_ena_cfm Cbx_fast_off_kd_ena_cfm Cxx_fast_off_kd_pdl_thd Cxx_free_shf_no_pdl_fast_off Cxx_pdl_grd_in_neg_thd Cxx_pdl_grd_out_neg_thd Cxx_up_shf_dly /end DEF_CHARACTERISTIC
 /begin OUT_MEASUREMENT Vsx_fast_off_free_shf_mod Vsx_law_sel_lim Vsx_stt_fast_off Vxx_dly_frz_gear_sel Vxx_fast_off_dly Vxx_fast_off_gear_sel Vxx_fast_off_kd_n_thd Vxx_fast_off_max_dly Vxx_fast_off_no_pdl_dly Vxx_t_fast_off Vxx_t_no_pdl Vxx_t_up_shf_dly /end OUT_MEASUREMENT
/end FUNCTION
/begin FUNCTION PcDrcOpo_Fsapmxx_xxxxxx "" /begin DEF_CHARACTERISTIC Cbx_apmp_ena_cfm /end DEF_CHARACTERISTIC /begin OUT_MEASUREMENT Vsx_apmp_free_shf_mod Vxx_apmp_gear_sel /end OUT_MEASUREMENT /end FUNCTION
/begin FUNCTION PcDrcOpo_Fscurxx_xxxxxx ""
 /begin DEF_CHARACTERISTIC Ctb_cur_spd Cmp_cur_tra_acel_thd Ctp_cur_dly Cxx_cur_tra_acel_hys Cxx_tra_acel_cur_fil /end DEF_CHARACTERISTIC
 /begin OUT_MEASUREMENT Vbx_up_shf_blk_cur Vxx_cur_dly Vxx_cur_tra_acel_thd Vxx_t_cur Vxx_t_max_cur Vxx_tra_acel_abs Vxx_tra_acel_abs_vld /end OUT_MEASUREMENT
/end FUNCTION
/begin FUNCTION PcDrcOpo_Fsdisxx_xxxxxx ""
 /begin DEF_CHARACTERISTIC Ctp_sta_dspl_arw_up_dly Cxx_max_dspl_arw_cyc_nr Cxx_max_dspl_arw_down_dly Cxx_max_dspl_arw_up_dly Cxx_min_dspl_arw_down_dly Cxx_min_dspl_arw_up_dly Cxx_rest_dspl_arw_down_dly Cxx_rest_dspl_arw_up_dly Cxx_sta_dspl_arw_down_dly /end DEF_CHARACTERISTIC
 /begin OUT_MEASUREMENT Vbx_arw_down Vbx_arw_down_raw Vbx_arw_up Vbx_arw_up_raw Vsx_free_shf_dspl Vxx_ctr_dspl_up Vxx_min_dspl_arw_up_dly Vxx_sta_dspl_arw_up_dly Vxx_t_max_arw_down Vxx_t_max_arw_up Vxx_t_min_arw_down Vxx_t_min_arw_up Vxx_t_rest_arw_down Vxx_t_rest_arw_up Vxx_t_sta_arw_down Vxx_t_sta_arw_up /end OUT_MEASUREMENT
/end FUNCTION
/begin FUNCTION PcDrcOpo_Fsdlyxx_xxxxxx ""
 /begin DEF_CHARACTERISTIC Ctp_gear_pdl_no_seq_dly Cbx_dly_ena_cfm Cxx_down_shf_no_seq_dly Cxx_down_up_shf_no_seq_dly Cxx_driv_ant_dly Cxx_up_down_shf_no_seq_dly /end DEF_CHARACTERISTIC
 /begin OUT_MEASUREMENT Vbx_dly_ini Vsx_no_seq_free_shf_mod Vsx_stt_dly Vxx_fast_off_gear_sel_bk Vxx_gear_bk Vxx_no_seq_gear_sel Vxx_t_ant Vxx_t_no_seq_down_shf Vxx_t_no_seq_up_shf Vxx_up_shf_no_seq_dly /end OUT_MEASUREMENT
/end FUNCTION
/begin FUNCTION PcDrcOpo_Fsfonxx_xxxxxx ""
 /begin DEF_CHARACTERISTIC Cbx_fast_on_ena_cfm Cxx_free_shf_no_pdl_fast_on Cxx_pdl_fast_on_kd_thd Cxx_pdl_grd_fast_on_thd Cxx_pdl_grd_fil /end DEF_CHARACTERISTIC
 /begin OUT_MEASUREMENT Vsx_fast_on_free_shf_mod Vsx_stt_fast_on Vxx_dly_gear_sel Vxx_fast_on_gear_sel Vxx_pdl_grd /end OUT_MEASUREMENT
/end FUNCTION
/begin FUNCTION PcDrcOpo_Fsgihxx_xxxxxx ""
 /begin DEF_CHARACTERISTIC Cbx_cru_blk_cfm Cbx_cur_ena_cfm Cbx_down_shf_blk_cur_cfm Cbx_gear_blk_cfm Cbx_wal_1_req_fs_cfm Cxx_max_decl /end DEF_CHARACTERISTIC
 /begin OUT_MEASUREMENT Vbx_free_shf_dft Vsx_frz_free_shf_mod Vxx_frz_gear_sel /end OUT_MEASUREMENT
/end FUNCTION
/begin FUNCTION PcDrcOpo_Fslawhv_xxxxxx ""
 /begin OUT_MEASUREMENT Vxx_vs_thd_2_uhil_1_2 Vxx_vs_thd_2_uhil_2_1 Vxx_vs_thd_2_uhil_2_3 Vxx_vs_thd_2_uhil_3_2 Vxx_vs_thd_2_uhil_3_4 Vxx_vs_thd_2_uhil_4_3 Vxx_vs_thd_2_uhil_4_5 Vxx_vs_thd_2_uhil_5_4 Vxx_vs_thd_2_uhil_5_6 Vxx_vs_thd_2_uhil_6_5 /end OUT_MEASUREMENT
/end FUNCTION
/begin FUNCTION PcDrcOpo_Fslawxx_xxxxxx ""
 /begin DEF_CHARACTERISTIC Ctb_down_shf_pdl Ctb_up_shf_pdl Ctp_brk_ass_fac Ctp_dhil_n_up_shf_in_thd Ctp_dhil_n_up_shf_out_thd Ctp_dhil_vs_down_shf_thd Ctp_law_eco_1_2 Ctp_law_eco_2_1 Ctp_law_eco_2_3 Ctp_law_eco_3_2 Ctp_law_eco_3_4 Ctp_law_eco_4_3 Ctp_law_eco_4_5 Ctp_law_eco_5_4 Ctp_law_eco_5_6 Ctp_law_eco_6_5 Ctp_law_uhil_1_2 Ctp_law_uhil_2_1 Ctp_law_uhil_2_3 Ctp_law_uhil_3_2 Ctp_law_uhil_3_4 Ctp_law_uhil_4_3 Ctp_law_uhil_4_5 Ctp_law_uhil_5_4 Ctp_law_uhil_5_6 Ctp_law_uhil_6_5 Ctp_law_wup_cata_1_2 Ctp_law_wup_cata_2_1 Ctp_law_wup_cata_2_3 Ctp_law_wup_cata_3_2 Ctp_law_wup_cata_3_4 Ctp_law_wup_cata_4_3 Ctp_law_wup_cata_4_5 Ctp_law_wup_cata_5_4 Ctp_law_wup_cata_5_6 Ctp_law_wup_cata_6_5 Ctp_law_xurb_1_2 Ctp_law_xurb_2_1 Ctp_law_xurb_2_3 Ctp_law_xurb_3_2 Ctp_law_xurb_3_4 Ctp_law_xurb_4_3 Ctp_law_xurb_4_5 Ctp_law_xurb_5_4 Ctp_law_xurb_5_6 Ctp_law_xurb_6_5 Ctp_min_vs_decl Ctp_v1000 Cbx_brk_ass_ena_cfm Cxx_acel_in_brk_ass_thd Cxx_acel_out_brk_ass_thd Cxx_free_shf_no_pdl Cxx_free_shf_no_pdl_brk_ass Cxx_gear_max Cxx_lg_acel_law_fil /end DEF_CHARACTERISTIC
 /begin OUT_MEASUREMENT Vbx_forc_gear_1 Vsx_law_free_shf_mod Vsx_stt_dhil Vxx_ant_vs Vxx_dhil_gear_sel Vxx_dhil_n_up_shf_in_thd Vxx_dhil_n_up_shf_out_thd Vxx_dhil_vs_down_shf_thd Vxx_gear_sel Vxx_law_gear_sel Vxx_n_dhil Vxx_vs_thd_1_2 Vxx_vs_thd_2_1 Vxx_vs_thd_2_3 Vxx_vs_thd_3_2 Vxx_vs_thd_3_4 Vxx_vs_thd_4_3 Vxx_vs_thd_4_5 Vxx_vs_thd_5_4 Vxx_vs_thd_5_6 Vxx_vs_thd_6_5 Vxx_vs_thd_eco_1_2 Vxx_vs_thd_eco_2_1 Vxx_vs_thd_eco_2_3 Vxx_vs_thd_eco_3_2 Vxx_vs_thd_eco_3_4 Vxx_vs_thd_eco_4_3 Vxx_vs_thd_eco_4_5 Vxx_vs_thd_eco_5_4 Vxx_vs_thd_eco_5_6 Vxx_vs_thd_eco_6_5 Vxx_vs_thd_uhil_1_2 Vxx_vs_thd_uhil_2_1 Vxx_vs_thd_uhil_2_3 Vxx_vs_thd_uhil_3_2 Vxx_vs_thd_uhil_3_4 Vxx_vs_thd_uhil_4_3 Vxx_vs_thd_uhil_4_5 Vxx_vs_thd_uhil_5_4 Vxx_vs_thd_uhil_5_6 Vxx_vs_thd_uhil_6_5 Vxx_vs_thd_wup_cata_1_2 Vxx_vs_thd_wup_cata_2_1 Vxx_vs_thd_wup_cata_2_3 Vxx_vs_thd_wup_cata_3_2 Vxx_vs_thd_wup_cata_3_4 Vxx_vs_thd_wup_cata_4_3 Vxx_vs_thd_wup_cata_4_5 Vxx_vs_thd_wup_cata_5_4 Vxx_vs_thd_wup_cata_5_6 Vxx_vs_thd_wup_cata_6_5 Vxx_vs_thd_xurb_1_2 Vxx_vs_thd_xurb_2_1 Vxx_vs_thd_xurb_2_3 Vxx_vs_thd_xurb_3_2 Vxx_vs_thd_xurb_3_4 Vxx_vs_thd_xurb_4_3 Vxx_vs_thd_xurb_4_5 Vxx_vs_thd_xurb_5_4 Vxx_vs_thd_xurb_5_6 Vxx_vs_thd_xurb_6_5 /end OUT_MEASUREMENT
/end FUNCTION
/begin FUNCTION PcDrcOpo_Fslslxx_xxxxxx ""
 /begin DEF_CHARACTERISTIC Cxx_dhil_flat_thd Cxx_flat_dhil_thd Cxx_flat_uhil_thd Cxx_law_sel_cfm Cxx_mv_vs_dec_fil Cxx_mv_vs_inc_fil Cxx_n_run_thd Cxx_tco_thd Cxx_uhil_flat_thd Cxx_vs_eco_xurb_thd Cxx_vs_xurb_eco_thd Cxx_wup_cata_dly /end DEF_CHARACTERISTIC
 /begin OUT_MEASUREMENT Vbx_out_tco Vbx_sta_tco_ena Vbx_wup_cata_dsb Vbx_wup_cata_ena Vsx_law_sel Vsx_load_lvl Vsx_road_typ Vxx_tco_ctr Vxx_vs_mv /end OUT_MEASUREMENT
/end FUNCTION
/begin FUNCTION PcDrcOpo_Fspfzxx_xxxxxx "" /begin DEF_CHARACTERISTIC Ctp_pdl_cru_max_lim Cxx_pdl_cru_min_lim /end DEF_CHARACTERISTIC
 /begin OUT_MEASUREMENT Vxx_dly_driv_pwt_sp_100 Vxx_driv_pwt_sp_100 Vxx_free_shf_pdl /end OUT_MEASUREMENT
/end FUNCTION
/begin FUNCTION PcDrcOpo_Schxxxx_xxxxxx "" /begin DEF_CHARACTERISTIC Cbx_free_shf_dsb_cfm /end DEF_CHARACTERISTIC /begin OUT_MEASUREMENT Vbx_free_shf_dsb Vbx_fs_hv_cfm /end OUT_MEASUREMENT /end FUNCTION
/begin FUNCTION PcDrCRds "" /begin SUB_FUNCTION PcDrCRds_Fstqdxx_xxxxxx /end SUB_FUNCTION /end FUNCTION
/end MODULE
/end PROJECT
