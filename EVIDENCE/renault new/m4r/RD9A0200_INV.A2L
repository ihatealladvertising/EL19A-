ASAP2_VERSION 1 41
/begin PROJECT RD8 "_default_ProjectLongIdentifier"
/begin HEADER "_default_HeaderComment" PROJECT_NO RD9 /end HEADER
/begin MODULE _default_ModuleName "_default_ModuleLongIdentifier"
/begin MOD_COMMON "_default_ModCommonComment" DEPOSIT ABSOLUTE BYTE_ORDER MSB_LAST ALIGNMENT_BYTE 1 ALIGNMENT_WORD 2 ALIGNMENT_LONG 2 ALIGNMENT_FLOAT32_IEEE 2 ALIGNMENT_FLOAT64_IEEE 4 /end MOD_COMMON
/begin MEASUREMENT AlternatorMaximumPower "Transmitted CAN parameter" UBYTE _CNV_A_R_ECME_LINEA_0_CM 1 0. 0. 255. ECU_ADDRESS 0xd00069b2 FORMAT "%3.0" /end MEASUREMENT
/begin MEASUREMENT MinimumInstantTorque "Transmitted CAN parameter" UWORD _CNV_A_R_ECME_LINEA_0_CM 1 0. 0. 4095. ECU_ADDRESS 0xd0004128 FORMAT "%4.0" /end MEASUREMENT
/begin MEASUREMENT EngineRPM "Transmitted CAN parameter" UWORD _CNV_A_R_ECME_LINEA_0_CM 1 0. 0. 65535. ECU_ADDRESS 0xd000411e FORMAT "%5.0" /end MEASUREMENT
/begin MEASUREMENT ACHighPressureSensor "Transmitted CAN parameter" UWORD _CNV_A_R_ECME_LINEA_0_CM 1 0. 0. 511. ECU_ADDRESS 0xd000412c FORMAT "%3.0" /end MEASUREMENT
/begin MEASUREMENT CCSpeedReachedDisplayReq "Transmitted CAN parameter" UBYTE _CNV_A_R_ECME_LINEA_0_CM 1 0. 0. 1. ECU_ADDRESS 0xd0007922 FORMAT "%1.0" /end MEASUREMENT
/begin MEASUREMENT CrankingAuthorization_ECM "Transmitted CAN parameter" UBYTE _CNV_A_R_ECME_LINEA_0_CM 1 0. 0. 3. ECU_ADDRESS 0xd00069db FORMAT "%1.0" /end MEASUREMENT
/begin MEASUREMENT CruiseControlStatusDisplay "Transmitted CAN parameter" UBYTE _CNV_A_R_ECME_LINEA_0_CM 1 0. 0. 7. ECU_ADDRESS 0xd000791f FORMAT "%1.0" /end MEASUREMENT
/begin MEASUREMENT CruiseControlStatus_forTM "Transmitted CAN parameter" UBYTE _CNV_A_R_ECME_LINEA_0_CM 1 0. 0. 3. ECU_ADDRESS 0xd00069dc FORMAT "%1.0" /end MEASUREMENT
/begin MEASUREMENT EngineFanSpeedRequest "Transmitted CAN parameter" UBYTE _CNV_A_R_ECME_LINEA_0_CM 1 0. 0. 3. ECU_ADDRESS 0xd00069dd FORMAT "%1.0" /end MEASUREMENT
/begin MEASUREMENT EngineStopRequestOrigine "Transmitted CAN parameter" UBYTE _CNV_A_R_ECME_LINEA_0_CM 1 0. 0. 15. ECU_ADDRESS 0xd00069de FORMAT "%2.0" /end MEASUREMENT
/begin MEASUREMENT OverspeedIndicationDisplayReq "Transmitted CAN parameter" UBYTE _CNV_A_R_ECME_LINEA_0_CM 1 0. 0. 1. ECU_ADDRESS 0xd0007920 FORMAT "%1.0" /end MEASUREMENT
/begin MEASUREMENT RequestedSpeedDisplayRequest "Transmitted CAN parameter" UBYTE _CNV_A_R_ECME_LINEA_0_CM 1 0. 0. 255. ECU_ADDRESS 0xd0007921 FORMAT "%3.0" /end MEASUREMENT
/begin MEASUREMENT EngineStatus_R "Transmitted CAN parameter" UBYTE _CNV_A_R_ECME_LINEA_0_CM 1 0. 0. 3. ECU_ADDRESS 0xd00069a7 FORMAT "%1.0" /end MEASUREMENT
/begin MEASUREMENT MaxEngineSpeedRequest "Transmitted CAN parameter" UBYTE _CNV_A_R_ECME_LINEA_0_CM 1 0. 0. 255. ECU_ADDRESS 0xd00078ee FORMAT "%3.0" /end MEASUREMENT
/begin MEASUREMENT MinEngineSpeedRequest "Transmitted CAN parameter" UBYTE _CNV_A_R_ECME_LINEA_0_CM 1 0. 0. 255. ECU_ADDRESS 0xd00078ef FORMAT "%3.0" /end MEASUREMENT
/begin MEASUREMENT MaximumInstantTorque "Transmitted CAN parameter" UWORD _CNV_A_R_ECME_LINEA_0_CM 1 0. 0. 4095. ECU_ADDRESS 0xd0004126 /end MEASUREMENT
/begin MEASUREMENT MaxElectricalPowerAllowed "Transmitted CAN parameter" UBYTE _CNV_A_R_ECME_LINEA_0_CM 1 0. 0. 31. ECU_ADDRESS 0xd00069b6 FORMAT "%2.0" /end MEASUREMENT
/begin MEASUREMENT ECM_TorqueRequestStatus "Transmitted CAN parameter" UBYTE _CNV_A_R_ECME_LINEA_0_CM 1 0. 0. 3. ECU_ADDRESS 0xd00069b9 FORMAT "%1.0" /end MEASUREMENT
/begin MEASUREMENT FrictionTorque "Transmitted CAN parameter" UWORD _CNV_A_R_ECME_LINEA_0_CM 1 0. 0. 4095. ECU_ADDRESS 0xd0004124 /end MEASUREMENT
/begin MEASUREMENT IdleSpeedControlInternalRequest "Transmitted CAN parameter" UBYTE _CNV_A_R_ECME_LINEA_0_CM 1 0. 0. 255. ECU_ADDRESS 0xd00078f1 FORMAT "%3.0" /end MEASUREMENT
/begin MEASUREMENT AllowedPowerGradient "Transmitted CAN parameter" UBYTE _CNV_A_R_ECME_LINEA_0_CM 1 0. 0. 255. ECU_ADDRESS 0xd00069b3 FORMAT "%3.0" /end MEASUREMENT
/begin MEASUREMENT AllowedPowerGradientNeg "Transmitted CAN parameter" UBYTE _CNV_A_R_ECME_LINEA_0_CM 1 0. 0. 255. ECU_ADDRESS 0xd00069b4 FORMAT "%3.0" /end MEASUREMENT
/begin MEASUREMENT Vbx_mux_agb_is_acel_req "AT Idle speed setpoint acceleration request from CAN" UBYTE _CNV_S_2_RANGE______3_CM 1 0. 0. 1. ECU_ADDRESS 0xd00078ec BIT_MASK 0x1 /end MEASUREMENT
/begin MEASUREMENT Vsx_mux_agb_is_acel_req_vld "CAN message validity : Idle speed setpoint acceleration request by AT" UBYTE _CNV_A_R_ECME_LINEA_0_CM 1 0. 0. 2. ECU_ADDRESS 0xd00078ed FORMAT "%1.0" /end MEASUREMENT
/begin MEASUREMENT Vbx_mux_agb_is_acel_sp_navl "indicates that AT minimum idle speed is unavailable" UBYTE _CNV_S_2_RANGE______3_CM 1 0. 0. 1. ECU_ADDRESS 0xd00069a5 BIT_MASK 0x1 /end MEASUREMENT
/begin MEASUREMENT Vsx_mux_agb_is_acel_sp_vld "Automated Gearbox idle speed setpoint CAN validity status" UBYTE _CNV_S_3_STATUS_OK__179_CM 1 0. 0. 2. ECU_ADDRESS 0xd00069a6 /end MEASUREMENT
/begin MEASUREMENT Vxx_mux_agb_is_acel_sp "Automatic Transmission idle speed setpoint acceleration required received on CAN" UWORD _CNV_A_R_ENSD_LINEA_22_CM 1 0. 0. 16383.75 ECU_ADDRESS 0xd000411a FORMAT "%8.2" /end MEASUREMENT
/begin MEASUREMENT ElectricalPowerCutFreeze "Transmitted CAN parameter" UBYTE _CNV_A_R_ECME_LINEA_0_CM 1 0. 0. 3. ECU_ADDRESS 0xd00069b5 FORMAT "%1.0" /end MEASUREMENT
/begin MEASUREMENT MeanEffectiveTorque "Transmitted CAN parameter" UWORD _CNV_A_R_ECME_LINEA_0_CM 1 0. 0. 4095. ECU_ADDRESS 0xd0004122 FORMAT "%4.0" /end MEASUREMENT
/begin MEASUREMENT Vbx_mux_alt_pwm_navl "indicates that alternator load is unavailable" UBYTE _CNV_S_2_RANGE______3_CM 1 0. 0. 1. ECU_ADDRESS 0xd00069e3 BIT_MASK 0x1 /end MEASUREMENT
/begin MEASUREMENT Vsx_mux_alt_pwm_vld "Multiplexed alternator load validity status" UBYTE _CNV_S_3_STATUS_OK__179_CM 1 0. 0. 2. ECU_ADDRESS 0xd00069e4 /end MEASUREMENT
/begin MEASUREMENT Vxx_mux_alt_pwm "Multiplexed alternator load" UBYTE _CNV_A_R_LINEAR_____165_CM 1 0. 0. 100. ECU_ADDRESS 0xd00069e5 FORMAT "%12.8" /end MEASUREMENT
/begin MEASUREMENT Vbx_mux_ptc_is_acel_req "PTC idle speed request from CAN" UBYTE _CNV_S_2_RANGE______3_CM 1 0. 0. 1. ECU_ADDRESS 0xd00078f0 BIT_MASK 0x1 /end MEASUREMENT
/begin MEASUREMENT Vsx_mux_ptc_is_acel_vld "" UBYTE _CNV_A_R_ECME_LINEA_0_CM 1 0. 0. 1. ECU_ADDRESS 0xd00069ac FORMAT "%1.0" /end MEASUREMENT
/begin MEASUREMENT Vbx_mux_alt_pow_navl "Alternator power from CAN is not available" UBYTE _CNV_S_2_RANGE______3_CM 1 0. 0. 1. ECU_ADDRESS 0xd00069b7 BIT_MASK 0x1 /end MEASUREMENT
/begin MEASUREMENT Vsx_mux_alt_pow_vld "Alternator power from CAN validity status" UBYTE _CNV_S_3_STATUS_OK__179_CM 1 0. 0. 2. ECU_ADDRESS 0xd00069b8 /end MEASUREMENT
/begin MEASUREMENT Vxx_mux_alt_pow "Alternator power from CAN" UWORD _CNV_A_R_LINEAR_____186_CM 1 0. 0. 655350. ECU_ADDRESS 0xd000412a FORMAT "%6.0" /end MEASUREMENT
/begin MEASUREMENT ECM_CANHS_RNr_01[0] "Transmitted CAN frame" UBYTE _CNV_A_R_ECME_LINEA_0_CM 1 0. 0. 255. ECU_ADDRESS 0xd00069bc FORMAT "%3.0" /end MEASUREMENT
/begin MEASUREMENT ECM_CANHS_RNr_01[1] "Transmitted CAN frame" UBYTE _CNV_A_R_ECME_LINEA_0_CM 1 0. 0. 255. ECU_ADDRESS 0xd00069bd FORMAT "%3.0" /end MEASUREMENT
/begin MEASUREMENT ECM_CANHS_RNr_01[2] "Transmitted CAN frame" UBYTE _CNV_A_R_ECME_LINEA_0_CM 1 0. 0. 255. ECU_ADDRESS 0xd00069be FORMAT "%3.0" /end MEASUREMENT
/begin MEASUREMENT ECM_CANHS_RNr_01[3] "Transmitted CAN frame" UBYTE _CNV_A_R_ECME_LINEA_0_CM 1 0. 0. 255. ECU_ADDRESS 0xd00069bf FORMAT "%3.0" /end MEASUREMENT
/begin MEASUREMENT ECM_CANHS_RNr_01[4] "Transmitted CAN frame" UBYTE _CNV_A_R_ECME_LINEA_0_CM 1 0. 0. 255. ECU_ADDRESS 0xd00069c0 FORMAT "%3.0" /end MEASUREMENT
/begin MEASUREMENT ECM_CANHS_RNr_01[5] "Transmitted CAN frame" UBYTE _CNV_A_R_ECME_LINEA_0_CM 1 0. 0. 255. ECU_ADDRESS 0xd00069c1 FORMAT "%3.0" /end MEASUREMENT
/begin MEASUREMENT ECM_CANHS_RNr_01[6] "Transmitted CAN frame" UBYTE _CNV_A_R_ECME_LINEA_0_CM 1 0. 0. 255. ECU_ADDRESS 0xd00069c2 FORMAT "%3.0" /end MEASUREMENT
/begin MEASUREMENT ECM_CANHS_RNr_01[7] "Transmitted CAN frame" UBYTE _CNV_A_R_ECME_LINEA_0_CM 1 0. 0. 255. ECU_ADDRESS 0xd00069c3 FORMAT "%3.0" /end MEASUREMENT
/begin MEASUREMENT ECM_CANHS_RNr_02[0] "Transmitted CAN frame" UBYTE _CNV_A_R_ECME_LINEA_0_CM 1 0. 0. 255. ECU_ADDRESS 0xd0007908 FORMAT "%3.0" /end MEASUREMENT
/begin MEASUREMENT ECM_CANHS_RNr_02[1] "Transmitted CAN frame" UBYTE _CNV_A_R_ECME_LINEA_0_CM 1 0. 0. 255. ECU_ADDRESS 0xd0007909 FORMAT "%3.0" /end MEASUREMENT
/begin MEASUREMENT ECM_CANHS_RNr_02[2] "Transmitted CAN frame" UBYTE _CNV_A_R_ECME_LINEA_0_CM 1 0. 0. 255. ECU_ADDRESS 0xd000790a FORMAT "%3.0" /end MEASUREMENT
/begin MEASUREMENT ECM_CANHS_RNr_02[3] "Transmitted CAN frame" UBYTE _CNV_A_R_ECME_LINEA_0_CM 1 0. 0. 255. ECU_ADDRESS 0xd000790b FORMAT "%3.0" /end MEASUREMENT
/begin MEASUREMENT ECM_CANHS_RNr_02[4] "Transmitted CAN frame" UBYTE _CNV_A_R_ECME_LINEA_0_CM 1 0. 0. 255. ECU_ADDRESS 0xd000790c FORMAT "%3.0" /end MEASUREMENT
/begin MEASUREMENT ECM_CANHS_RNr_02[5] "Transmitted CAN frame" UBYTE _CNV_A_R_ECME_LINEA_0_CM 1 0. 0. 255. ECU_ADDRESS 0xd000790d FORMAT "%3.0" /end MEASUREMENT
/begin MEASUREMENT ECM_CANHS_RNr_02[6] "Transmitted CAN frame" UBYTE _CNV_A_R_ECME_LINEA_0_CM 1 0. 0. 255. ECU_ADDRESS 0xd000790e FORMAT "%3.0" /end MEASUREMENT
/begin MEASUREMENT ECM_CANHS_R_03[0] "Transmitted CAN frame" UBYTE _CNV_A_R_ECME_LINEA_0_CM 1 0. 0. 255. ECU_ADDRESS 0xd00069c4 FORMAT "%3.0" /end MEASUREMENT
/begin MEASUREMENT ECM_CANHS_R_03[1] "Transmitted CAN frame" UBYTE _CNV_A_R_ECME_LINEA_0_CM 1 0. 0. 255. ECU_ADDRESS 0xd00069c5 FORMAT "%3.0" /end MEASUREMENT
/begin MEASUREMENT ECM_CANHS_R_03[2] "Transmitted CAN frame" UBYTE _CNV_A_R_ECME_LINEA_0_CM 1 0. 0. 255. ECU_ADDRESS 0xd00069c6 FORMAT "%3.0" /end MEASUREMENT
/begin MEASUREMENT ECM_VERLOG[0] "Transmitted CAN frame" UBYTE _CNV_A_R_ECME_LINEA_0_CM 1 0. 0. 255. ECU_ADDRESS 0xd0007910 FORMAT "%3.0" /end MEASUREMENT
/begin MEASUREMENT ECM_VERLOG[1] "Transmitted CAN frame" UBYTE _CNV_A_R_ECME_LINEA_0_CM 1 0. 0. 255. ECU_ADDRESS 0xd0007911 FORMAT "%3.0" /end MEASUREMENT
/begin MEASUREMENT ECM_VERLOG[2] "Transmitted CAN frame" UBYTE _CNV_A_R_ECME_LINEA_0_CM 1 0. 0. 255. ECU_ADDRESS 0xd0007912 FORMAT "%3.0" /end MEASUREMENT
/begin MEASUREMENT ECM_VERLOG[3] "Transmitted CAN frame" UBYTE _CNV_A_R_ECME_LINEA_0_CM 1 0. 0. 255. ECU_ADDRESS 0xd0007913 FORMAT "%3.0" /end MEASUREMENT
/begin MEASUREMENT ECM_VERLOG[4] "Transmitted CAN frame" UBYTE _CNV_A_R_ECME_LINEA_0_CM 1 0. 0. 255. ECU_ADDRESS 0xd0007914 FORMAT "%3.0" /end MEASUREMENT
/begin MEASUREMENT ECM_VERLOG[5] "Transmitted CAN frame" UBYTE _CNV_A_R_ECME_LINEA_0_CM 1 0. 0. 255. ECU_ADDRESS 0xd0007915 FORMAT "%3.0" /end MEASUREMENT
/begin MEASUREMENT ECM_VERLOG[6] "Transmitted CAN frame" UBYTE _CNV_A_R_ECME_LINEA_0_CM 1 0. 0. 255. ECU_ADDRESS 0xd0007916 FORMAT "%3.0" /end MEASUREMENT
/begin MEASUREMENT FORCE_ECM_CANHS_R_01[0] "Transmitted CAN frame" UBYTE _CNV_A_R_ECME_LINEA_0_CM 1 0. 0. 255. ECU_ADDRESS 0xd00078f8 FORMAT "%3.0" /end MEASUREMENT
/begin MEASUREMENT FORCE_ECM_CANHS_R_01[1] "Transmitted CAN frame" UBYTE _CNV_A_R_ECME_LINEA_0_CM 1 0. 0. 255. ECU_ADDRESS 0xd00078f9 FORMAT "%3.0" /end MEASUREMENT
/begin MEASUREMENT FORCE_ECM_CANHS_R_01[2] "Transmitted CAN frame" UBYTE _CNV_A_R_ECME_LINEA_0_CM 1 0. 0. 255. ECU_ADDRESS 0xd00078fa FORMAT "%3.0" /end MEASUREMENT
/begin MEASUREMENT FORCE_ECM_CANHS_R_01[3] "Transmitted CAN frame" UBYTE _CNV_A_R_ECME_LINEA_0_CM 1 0. 0. 255. ECU_ADDRESS 0xd00078fb FORMAT "%3.0" /end MEASUREMENT
/begin MEASUREMENT FORCE_ECM_CANHS_R_01[4] "Transmitted CAN frame" UBYTE _CNV_A_R_ECME_LINEA_0_CM 1 0. 0. 255. ECU_ADDRESS 0xd00078fc FORMAT "%3.0" /end MEASUREMENT
/begin MEASUREMENT FORCE_ECM_CANHS_R_01[5] "Transmitted CAN frame" UBYTE _CNV_A_R_ECME_LINEA_0_CM 1 0. 0. 255. ECU_ADDRESS 0xd00078fd FORMAT "%3.0" /end MEASUREMENT
/begin MEASUREMENT FORCE_ECM_CANHS_R_01[6] "Transmitted CAN frame" UBYTE _CNV_A_R_ECME_LINEA_0_CM 1 0. 0. 255. ECU_ADDRESS 0xd00078fe FORMAT "%3.0" /end MEASUREMENT
/begin MEASUREMENT FORCE_ECM_CANHS_R_01[7] "Transmitted CAN frame" UBYTE _CNV_A_R_ECME_LINEA_0_CM 1 0. 0. 255. ECU_ADDRESS 0xd00078ff FORMAT "%3.0" /end MEASUREMENT
/begin MEASUREMENT MMI_ECM_CANHS_RNr_01[0] "Transmitted CAN frame" UBYTE _CNV_A_R_ECME_LINEA_0_CM 1 0. 0. 255. ECU_ADDRESS 0xd0007918 FORMAT "%3.0" /end MEASUREMENT
/begin MEASUREMENT MMI_ECM_CANHS_RNr_01[1] "Transmitted CAN frame" UBYTE _CNV_A_R_ECME_LINEA_0_CM 1 0. 0. 255. ECU_ADDRESS 0xd0007919 FORMAT "%3.0" /end MEASUREMENT
/begin MEASUREMENT MMI_ECM_CANHS_RNr_01[2] "Transmitted CAN frame" UBYTE _CNV_A_R_ECME_LINEA_0_CM 1 0. 0. 255. ECU_ADDRESS 0xd000791a FORMAT "%3.0" /end MEASUREMENT
/begin MEASUREMENT MMI_ECM_CANHS_RNr_01[3] "Transmitted CAN frame" UBYTE _CNV_A_R_ECME_LINEA_0_CM 1 0. 0. 255. ECU_ADDRESS 0xd000791b FORMAT "%3.0" /end MEASUREMENT
/begin MEASUREMENT MMI_ECM_CANHS_RNr_01[4] "Transmitted CAN frame" UBYTE _CNV_A_R_ECME_LINEA_0_CM 1 0. 0. 255. ECU_ADDRESS 0xd000791c FORMAT "%3.0" /end MEASUREMENT
/begin MEASUREMENT MMI_ECM_CANHS_RNr_01[5] "Transmitted CAN frame" UBYTE _CNV_A_R_ECME_LINEA_0_CM 1 0. 0. 255. ECU_ADDRESS 0xd000791d FORMAT "%3.0" /end MEASUREMENT
/begin MEASUREMENT MMI_ECM_CANHS_RNr_01[6] "Transmitted CAN frame" UBYTE _CNV_A_R_ECME_LINEA_0_CM 1 0. 0. 255. ECU_ADDRESS 0xd000791e FORMAT "%3.0" /end MEASUREMENT
/begin MEASUREMENT MMI_ECM_CANHS_Rst_01[0] "Transmitted CAN frame" UBYTE _CNV_A_R_ECME_LINEA_0_CM 1 0. 0. 255. ECU_ADDRESS 0xd0007900 FORMAT "%3.0" /end MEASUREMENT
/begin MEASUREMENT MMI_ECM_CANHS_Rst_01[1] "Transmitted CAN frame" UBYTE _CNV_A_R_ECME_LINEA_0_CM 1 0. 0. 255. ECU_ADDRESS 0xd0007901 FORMAT "%3.0" /end MEASUREMENT
/begin MEASUREMENT MMI_ECM_CANHS_Rst_01[2] "Transmitted CAN frame" UBYTE _CNV_A_R_ECME_LINEA_0_CM 1 0. 0. 255. ECU_ADDRESS 0xd0007902 FORMAT "%3.0" /end MEASUREMENT
/begin MEASUREMENT MMI_ECM_CANHS_Rst_01[3] "Transmitted CAN frame" UBYTE _CNV_A_R_ECME_LINEA_0_CM 1 0. 0. 255. ECU_ADDRESS 0xd0007903 FORMAT "%3.0" /end MEASUREMENT
/begin MEASUREMENT MMI_ECM_CANHS_Rst_01[4] "Transmitted CAN frame" UBYTE _CNV_A_R_ECME_LINEA_0_CM 1 0. 0. 255. ECU_ADDRESS 0xd0007904 FORMAT "%3.0" /end MEASUREMENT
/begin MEASUREMENT MMI_ECM_CANHS_Rst_01[5] "Transmitted CAN frame" UBYTE _CNV_A_R_ECME_LINEA_0_CM 1 0. 0. 255. ECU_ADDRESS 0xd0007905 FORMAT "%3.0" /end MEASUREMENT
/begin MEASUREMENT MMI_ECM_CANHS_Rst_01[6] "Transmitted CAN frame" UBYTE _CNV_A_R_ECME_LINEA_0_CM 1 0. 0. 255. ECU_ADDRESS 0xd0007906 FORMAT "%3.0" /end MEASUREMENT
/begin MEASUREMENT MMI_ECM_CANHS_Rst_01[7] "Transmitted CAN frame" UBYTE _CNV_A_R_ECME_LINEA_0_CM 1 0. 0. 255. ECU_ADDRESS 0xd0007907 FORMAT "%3.0" /end MEASUREMENT
/begin MEASUREMENT TORQUE_ECM_CANHS_RNr_01[0] "Transmitted CAN frame" UBYTE _CNV_A_R_ECME_LINEA_0_CM 1 0. 0. 255. ECU_ADDRESS 0xd00069c8 FORMAT "%3.0" /end MEASUREMENT
/begin MEASUREMENT TORQUE_ECM_CANHS_RNr_01[1] "Transmitted CAN frame" UBYTE _CNV_A_R_ECME_LINEA_0_CM 1 0. 0. 255. ECU_ADDRESS 0xd00069c9 FORMAT "%3.0" /end MEASUREMENT
/begin MEASUREMENT TORQUE_ECM_CANHS_RNr_01[2] "Transmitted CAN frame" UBYTE _CNV_A_R_ECME_LINEA_0_CM 1 0. 0. 255. ECU_ADDRESS 0xd00069ca FORMAT "%3.0" /end MEASUREMENT
/begin MEASUREMENT TORQUE_ECM_CANHS_RNr_01[3] "Transmitted CAN frame" UBYTE _CNV_A_R_ECME_LINEA_0_CM 1 0. 0. 255. ECU_ADDRESS 0xd00069cb FORMAT "%3.0" /end MEASUREMENT
/begin MEASUREMENT TORQUE_ECM_CANHS_RNr_01[4] "Transmitted CAN frame" UBYTE _CNV_A_R_ECME_LINEA_0_CM 1 0. 0. 255. ECU_ADDRESS 0xd00069cc FORMAT "%3.0" /end MEASUREMENT
/begin MEASUREMENT TORQUE_ECM_CANHS_RNr_01[5] "Transmitted CAN frame" UBYTE _CNV_A_R_ECME_LINEA_0_CM 1 0. 0. 255. ECU_ADDRESS 0xd00069cd FORMAT "%3.0" /end MEASUREMENT
/begin MEASUREMENT TORQUE_ECM_CANHS_RNr_01[6] "Transmitted CAN frame" UBYTE _CNV_A_R_ECME_LINEA_0_CM 1 0. 0. 255. ECU_ADDRESS 0xd00069ce FORMAT "%3.0" /end MEASUREMENT
/begin MEASUREMENT TORQUE_ECM_CANHS_RNr_02[0] "Transmitted CAN frame" UBYTE _CNV_A_R_ECME_LINEA_0_CM 1 0. 0. 255. ECU_ADDRESS 0xd00069d0 FORMAT "%3.0" /end MEASUREMENT
/begin MEASUREMENT TORQUE_ECM_CANHS_RNr_02[1] "Transmitted CAN frame" UBYTE _CNV_A_R_ECME_LINEA_0_CM 1 0. 0. 255. ECU_ADDRESS 0xd00069d1 FORMAT "%3.0" /end MEASUREMENT
/begin MEASUREMENT TORQUE_ECM_CANHS_RNr_02[2] "Transmitted CAN frame" UBYTE _CNV_A_R_ECME_LINEA_0_CM 1 0. 0. 255. ECU_ADDRESS 0xd00069d2 FORMAT "%3.0" /end MEASUREMENT
/begin MEASUREMENT TORQUE_ECM_CANHS_RNr_02[3] "Transmitted CAN frame" UBYTE _CNV_A_R_ECME_LINEA_0_CM 1 0. 0. 255. ECU_ADDRESS 0xd00069d3 FORMAT "%3.0" /end MEASUREMENT
/begin MEASUREMENT TORQUE_ECM_CANHS_RNr_02[4] "Transmitted CAN frame" UBYTE _CNV_A_R_ECME_LINEA_0_CM 1 0. 0. 255. ECU_ADDRESS 0xd00069d4 FORMAT "%3.0" /end MEASUREMENT
/begin MEASUREMENT TORQUE_ECM_CANHS_RNr_02[5] "Transmitted CAN frame" UBYTE _CNV_A_R_ECME_LINEA_0_CM 1 0. 0. 255. ECU_ADDRESS 0xd00069d5 FORMAT "%3.0" /end MEASUREMENT
/begin MEASUREMENT TORQUE_ECM_CANHS_R_01[0] "Transmitted CAN frame" UBYTE _CNV_A_R_ECME_LINEA_0_CM 1 0. 0. 255. ECU_ADDRESS 0xd00069d6 FORMAT "%3.0" /end MEASUREMENT
/begin MEASUREMENT TORQUE_ECM_CANHS_R_01[1] "Transmitted CAN frame" UBYTE _CNV_A_R_ECME_LINEA_0_CM 1 0. 0. 255. ECU_ADDRESS 0xd00069d7 FORMAT "%3.0" /end MEASUREMENT
/begin MEASUREMENT TORQUE_ECM_CANHS_R_01[2] "Transmitted CAN frame" UBYTE _CNV_A_R_ECME_LINEA_0_CM 1 0. 0. 255. ECU_ADDRESS 0xd00069d8 FORMAT "%3.0" /end MEASUREMENT
/begin MEASUREMENT TORQUE_ECM_CANHS_R_01[3] "Transmitted CAN frame" UBYTE _CNV_A_R_ECME_LINEA_0_CM 1 0. 0. 255. ECU_ADDRESS 0xd00069d9 FORMAT "%3.0" /end MEASUREMENT
/begin MEASUREMENT TORQUE_ECM_CANHS_R_01[4] "Transmitted CAN frame" UBYTE _CNV_A_R_ECME_LINEA_0_CM 1 0. 0. 255. ECU_ADDRESS 0xd00069da FORMAT "%3.0" /end MEASUREMENT
/begin MEASUREMENT ACCompMaximumPower "Transmitted CAN parameter" UBYTE _CNV_A_R_ECME_LINEA_0_CM 1 0. 0. 255. ECU_ADDRESS 0xd00069b1 FORMAT "%3.0" /end MEASUREMENT
/begin MEASUREMENT Vbx_mux_ac_pow_navl "air conditionning power unavailability" UBYTE _CNV_S_2_RANGE______3_CM 1 0. 0. 1. ECU_ADDRESS 0xd00069af BIT_MASK 0x1 /end MEASUREMENT
/begin MEASUREMENT Vsx_mux_ac_pow_vld "air conditionning power received from CAN validity status" UBYTE _CNV_S_3_STATUS_OK__179_CM 1 0. 0. 2. ECU_ADDRESS 0xd00069b0 /end MEASUREMENT
/begin MEASUREMENT Vxx_mux_ac_pow "air conditionning power received from CAN" UWORD _CNV_A_R_LINEAR_____186_CM 1 0. 0. 655350. ECU_ADDRESS 0xd0004120 FORMAT "%6.0" /end MEASUREMENT
/begin MEASUREMENT Vbx_mux_el_bk_wind "Electric backlite request from CAN" UBYTE _CNV_S_2_RANGE______3_CM 1 0. 0. 1. ECU_ADDRESS 0xd00069ad BIT_MASK 0x1 /end MEASUREMENT
/begin MEASUREMENT Vbx_mux_el_wind_is_acel "Electric windshield idle speed setpoint acceleration request from CAN" UBYTE _CNV_S_2_RANGE______3_CM 1 0. 0. 1. ECU_ADDRESS 0xd00069ae BIT_MASK 0x1 /end MEASUREMENT
/begin MEASUREMENT ACCompAuthorized "Transmitted CAN parameter" UBYTE _CNV_A_R_ECME_LINEA_0_CM 1 0. 0. 1. ECU_ADDRESS 0xd00069e1 FORMAT "%1.0" /end MEASUREMENT
/begin MEASUREMENT ACCompClutchActivation "Transmitted CAN parameter" UBYTE _CNV_A_R_ECME_LINEA_0_CM 1 0. 0. 1. ECU_ADDRESS 0xd00069e2 FORMAT "%1.0" /end MEASUREMENT
/begin MEASUREMENT Vbx_mux_ac_clu_req "air conditionning compressor request sent from AC ECU to USM (M3 architecture) received from CAN" UBYTE _CNV_S_2_RANGE______3_CM 1 0. 0. 1. ECU_ADDRESS 0xd00069df BIT_MASK 0x1 /end MEASUREMENT
/begin MEASUREMENT Vsx_mux_ac_clu_req_vld "air conditionning compressor request sent from AC ECU to USM (M3 architecture) validity status" UBYTE _CNV_S_3_STATUS_OK__179_CM 1 0. 0. 2. ECU_ADDRESS 0xd00069e0 /end MEASUREMENT
/begin MEASUREMENT Vbx_mux_egb_n_lim_navl "indicates that FuelCutRequestedEngineSpeed is unavailable" UBYTE _CNV_S_2_RANGE______3_CM 1 0. 0. 1. ECU_ADDRESS 0xd00069aa BIT_MASK 0x1 /end MEASUREMENT
/begin MEASUREMENT Vsx_mux_egb_n_lim_vld "engine speed limitation validity status" UBYTE _CNV_S_3_STATUS_OK__179_CM 1 0. 0. 2. ECU_ADDRESS 0xd00069ab /end MEASUREMENT
/begin MEASUREMENT Vxx_mux_egb_n_lim "Engine speed limitation requested by electronic gear box (CVT,...)" UWORD _CNV_A_R_ENSD_LINEA_22_CM 1 0. 0. 16383.75 ECU_ADDRESS 0xd000411c FORMAT "%8.2" /end MEASUREMENT
/begin MEASUREMENT Vbx_can_diag "Mux diagnostic activation indicator for network (CAN bus) failure detection" UBYTE _CNV_S_2_RANGE______3_CM 1 0. 0. 1. ECU_ADDRESS 0xd00078cc BIT_MASK 0x1 /end MEASUREMENT
/begin MEASUREMENT Vbx_can_diag_raw "Raw Mux diagnostic activation indicator" UBYTE _CNV_S_2_RANGE______3_CM 1 0. 0. 1. ECU_ADDRESS 0xd0006989 BIT_MASK 0x1 /end MEASUREMENT
/begin MEASUREMENT Vbx_mux_ac_acel_is_sp_navl "Accelerated engine idle speed setpoint request for air conditionning from CAN not available" UBYTE _CNV_S_2_RANGE______3_CM 1 0. 0. 1. ECU_ADDRESS 0xd000698a BIT_MASK 0x1 /end MEASUREMENT
/begin MEASUREMENT Vbx_mux_ac_mdf1_req "Fan 1 activation request from air conditioning ECU received on the CAN network" UBYTE _CNV_S_2_RANGE______3_CM 1 0. 0. 1. ECU_ADDRESS 0xd000698b BIT_MASK 0x1 /end MEASUREMENT
/begin MEASUREMENT Vbx_mux_ac_mdf2_req "Fan 2 activation request from air conditioning ECU received on the CAN network" UBYTE _CNV_S_2_RANGE______3_CM 1 0. 0. 1. ECU_ADDRESS 0xd000698c BIT_MASK 0x1 /end MEASUREMENT
/begin MEASUREMENT Vbx_mux_ac_req "Climate cooling request from CAN network" UBYTE _CNV_S_2_RANGE______3_CM 1 0. 0. 1. ECU_ADDRESS 0xd000698d BIT_MASK 0x1 /end MEASUREMENT
/begin MEASUREMENT Vbx_mux_ac_req_ext "Climate cooling request from AC ECU (cold loop outside ECM)" UBYTE _CNV_S_2_RANGE______3_CM 1 0. 0. 1. ECU_ADDRESS 0xd000698e BIT_MASK 0x1 /end MEASUREMENT
/begin MEASUREMENT Vbx_mux_ac_req_int "Climate cooling request from CAN ECU when cold loop is in ECM" UBYTE _CNV_S_2_RANGE______3_CM 1 0. 0. 1. ECU_ADDRESS 0xd000698f BIT_MASK 0x1 /end MEASUREMENT
/begin MEASUREMENT Vbx_mux_agb_mdf1_req "Fan 1 activation request from AGB received on the CAN network" UBYTE _CNV_S_2_RANGE______3_CM 1 0. 0. 1. ECU_ADDRESS 0xd0006990 BIT_MASK 0x1 /end MEASUREMENT
/begin MEASUREMENT Vbx_mux_agb_mdf2_req "Fan 2 activation request from AGB received on the CAN network" UBYTE _CNV_S_2_RANGE______3_CM 1 0. 0. 1. ECU_ADDRESS 0xd0006991 BIT_MASK 0x1 /end MEASUREMENT
/begin MEASUREMENT Vbx_mux_can_diag "Counting and storage of CAN mute/absent failure authorization" UBYTE _CNV_S_2_RANGE______3_CM 1 0. 0. 1. ECU_ADDRESS 0xd0006992 BIT_MASK 0x1 /end MEASUREMENT
/begin MEASUREMENT Vbx_mux_dspl_vs_in_mph "The vehicule speed used for CC/SL is in mph" UBYTE _CNV_S_2_RANGE______3_CM 1 0. 0. 1. ECU_ADDRESS 0xd00078cd BIT_MASK 0x1 /end MEASUREMENT
/begin MEASUREMENT Vbx_mux_dspl_vs_navl "Displayed vehicle speed received on the CAN network not available" UBYTE _CNV_S_2_RANGE______3_CM 1 0. 0. 1. ECU_ADDRESS 0xd00078ce BIT_MASK 0x1 /end MEASUREMENT
/begin MEASUREMENT Vbx_mux_vh_key "CAN input data indicating if the key vehicle is present (1=vehicle with key)" UBYTE _CNV_S_2_RANGE______3_CM 1 0. 0. 1. ECU_ADDRESS 0xd00078cf BIT_MASK 0x1 /end MEASUREMENT
/begin MEASUREMENT Vbx_mux_vs_navl "Vehicle speed received on the CAN network not available" UBYTE _CNV_S_2_RANGE______3_CM 1 0. 0. 1. ECU_ADDRESS 0xd0006993 BIT_MASK 0x1 /end MEASUREMENT
/begin MEASUREMENT Vsx_mux_ac_acel_is_sp_vld "Accelerated engine idle speed setpoint request for air conditionning from CAN validity status" UBYTE _CNV_S_3_STATUS_OK__179_CM 1 0. 0. 2. ECU_ADDRESS 0xd0006994 /end MEASUREMENT
/begin MEASUREMENT Vsx_mux_ac_mdf_req_vld "Fans activation request from air conditioning ECU received on the CAN network validity status" UBYTE _CNV_S_4_STATUS_OK__180_CM 1 0. 0. 3. ECU_ADDRESS 0xd0006995 /end MEASUREMENT
/begin MEASUREMENT Vsx_mux_ac_req_ext_vld "Climate cooling request from AC ECU validity status" UBYTE _CNV_S_4_STATUS_OK__338_CM 1 0. 0. 3. ECU_ADDRESS 0xd0006996 /end MEASUREMENT
/begin MEASUREMENT Vsx_mux_ac_req_int_vld "Climate cooling request from CAN ECU (when cold loop is in ECM) validity status" UBYTE _CNV_S_4_STATUS_OK__338_CM 1 0. 0. 3. ECU_ADDRESS 0xd0006997 /end MEASUREMENT
/begin MEASUREMENT Vsx_mux_ac_req_vld "Climate cooling request from CAN network validity status" UBYTE _CNV_S_4_STATUS_OK__180_CM 1 0. 0. 3. ECU_ADDRESS 0xd0006998 /end MEASUREMENT
/begin MEASUREMENT Vsx_mux_agb_mdf_req_vld "Fans activation request from AGB received on the CAN network validity status" UBYTE _CNV_S_4_STATUS_OK__180_CM 1 0. 0. 3. ECU_ADDRESS 0xd0006999 /end MEASUREMENT
/begin MEASUREMENT Vsx_mux_dspl_vs_vld "Displayed vehicle speed received on the CAN network validity status " UBYTE _CNV_S_4_STATUS_OK__180_CM 1 0. 0. 3. ECU_ADDRESS 0xd00078d0 /end MEASUREMENT
/begin MEASUREMENT Vsx_mux_ena_sta_agb "AT Starter authorization or stop received on the CAN network" UBYTE _CNV_A_R_ECME_LINEA_0_CM 1 0. 0. 3. ECU_ADDRESS 0xd000699a FORMAT "%1.0" /end MEASUREMENT
/begin MEASUREMENT Vsx_mux_ena_sta_agb_vld "AT Starter authorization or stop received on the CAN network validity status" UBYTE _CNV_S_4_STATUS_OK__180_CM 1 0. 0. 3. ECU_ADDRESS 0xd000699b /end MEASUREMENT
/begin MEASUREMENT Vsx_mux_sta_stt_vld "Starter status received on the CAN network validity status" UBYTE _CNV_S_4_STATUS_OK__180_CM 1 0. 0. 3. ECU_ADDRESS 0xd000699c /end MEASUREMENT
/begin MEASUREMENT Vsx_mux_vs_vld "Vehicle speed received on the CAN network validity status " UBYTE _CNV_S_4_STATUS_OK__180_CM 1 0. 0. 3. ECU_ADDRESS 0xd000699d /end MEASUREMENT
/begin MEASUREMENT Vxx_mux_ac_acel_is_sp "Accelerated engine idle speed setpoint request for air conditionning from CAN" UWORD _CNV_A_R_ENSD_LINEA_22_CM 1 0. 0. 16383.75 ECU_ADDRESS 0xd0004116 FORMAT "%8.2" /end MEASUREMENT
/begin MEASUREMENT Vxx_mux_airb1 "Byte n°1 of the AIRBAGCrash frame recieved on the CAN network" UBYTE _CNV_A_R_ECME_LINEA_0_CM 1 0. 0. 255. ECU_ADDRESS 0xd00078d1 FORMAT "%3.0" /end MEASUREMENT
/begin MEASUREMENT Vxx_mux_airb2 "Byte n°2 of the AIRBAGCrash frame recieved on the CAN network" UBYTE _CNV_A_R_ECME_LINEA_0_CM 1 0. 0. 255. ECU_ADDRESS 0xd00078d2 FORMAT "%3.0" /end MEASUREMENT
/begin MEASUREMENT Vxx_mux_dspl_vs "Displayed vehicle speed received on the CAN network" UWORD _CNV_A_R_LINEAR_____125_CM 1 0. 0. 655.35 ECU_ADDRESS 0xd00051b6 FORMAT "%6.2" /end MEASUREMENT
/begin MEASUREMENT Vxx_mux_eng_stop_req_ccu "Emergency engine stop request received on the CAN network" UBYTE _CNV_A_R_ECME_LINEA_0_CM 1 0. 0. 255. ECU_ADDRESS 0xd000699e FORMAT "%3.0" /end MEASUREMENT
/begin MEASUREMENT Vxx_mux_eng_stop_req_rgb "Engine stop requested by robotized gearbox received on the CAN network" UBYTE _CNV_A_R_ECME_LINEA_0_CM 1 0. 0. 255. ECU_ADDRESS 0xd000699f FORMAT "%3.0" /end MEASUREMENT
/begin MEASUREMENT Vxx_mux_sta_stt "Starter status received on the CAN network" UBYTE _CNV_A_R_ECME_LINEA_0_CM 1 0. 0. 3. ECU_ADDRESS 0xd00069a0 FORMAT "%1.0" /end MEASUREMENT
/begin MEASUREMENT Vxx_mux_sta_swi_act_ctr "Starter status received on the CAN network" UBYTE _CNV_A_R_ECME_LINEA_0_CM 1 0. 0. 7. ECU_ADDRESS 0xd00078d3 FORMAT "%1.0" /end MEASUREMENT
/begin MEASUREMENT Vxx_mux_vs "Vehicle speed received on the CAN network" UWORD _CNV_A_R_LINEAR_____125_CM 1 0. 0. 655.35 ECU_ADDRESS 0xd0004118 FORMAT "%6.2" /end MEASUREMENT
/begin CHARACTERISTIC Cbx_vh_key_navl_val "Boolean to choose the default value when the KeyVehicle is received to an unavailable value (1 = key vehicle; 0 = without key vehicle)" VALUE 0xa0021156 _REC_S1VAL_20_u1 1. _CNV_S_2_RANGE______3_CM 0. 1. BIT_MASK 0x1 /end CHARACTERISTIC
/begin CHARACTERISTIC Cxx_eng_aut_can_diag_dly "Delay between the moment when the engine is autonomous and the authorization to set Vbx_can_diag to 1" VALUE 0xa0021154 _REC_S1VAL_20_u2 655.35 _CNV_A_R_LINEAR_____32_CM 0. 655.35 FORMAT "%6.2" /end CHARACTERISTIC
/begin MEASUREMENT Vsx_mux_rgb_pump_vld "Robotized gearbox pump activation received on the CAN validity status" UBYTE _CNV_S_3_STATUS_OK__179_CM 1 0. 0. 2. ECU_ADDRESS 0xd00078f3 /end MEASUREMENT
/begin MEASUREMENT Vxx_mux_rgb_pump "Robotized gearbox pump activation received on the CAN" UBYTE _CNV_A_R_ECME_LINEA_0_CM 1 0. 0. 3. ECU_ADDRESS 0xd00078f4 FORMAT "%1.0" /end MEASUREMENT
/begin MEASUREMENT FloatingInhibition "Transmitted CAN parameter" UBYTE _CNV_A_R_ECME_LINEA_0_CM 1 0. 0. 3. ECU_ADDRESS 0xd0007923 FORMAT "%1.0" /end MEASUREMENT
/begin MEASUREMENT Vbx_esm_cfm "Energy Smart Management configuration boolean (1 = ESM present)" UBYTE _CNV_S_2_RANGE______3_CM 1 0. 0. 1. ECU_ADDRESS 0xd00078d4 BIT_MASK 0x1 /end MEASUREMENT
/begin MEASUREMENT Vbx_mux_airb_cfm "MUX airbag crash presence configuration boolean (1 = MUX present)" UBYTE _CNV_S_2_RANGE______3_CM 1 0. 0. 1. ECU_ADDRESS 0xd00078d5 BIT_MASK 0x1 /end MEASUREMENT
/begin MEASUREMENT Vbx_mux_bpk_cfm "MUX brake parking presence configuration boolean (1 = MUX present)" UBYTE _CNV_S_2_RANGE______3_CM 1 0. 0. 1. ECU_ADDRESS 0xd00078d6 BIT_MASK 0x1 /end MEASUREMENT
/begin MEASUREMENT Vbx_mux_dspl_vs_cfm "MUX displayed vehicle speed presence configuration boolean (1 = MUX present)" UBYTE _CNV_S_2_RANGE______3_CM 1 0. 0. 1. ECU_ADDRESS 0xd00078d7 BIT_MASK 0x1 /end MEASUREMENT
/begin MEASUREMENT Vbx_mux_end_str_clu_cnt_cfm "MUX end stroke clutch contactor presence configuration boolean (1 = MUX present)" UBYTE _CNV_S_2_RANGE______3_CM 1 0. 0. 1. ECU_ADDRESS 0xd00078d8 BIT_MASK 0x1 /end MEASUREMENT
/begin MEASUREMENT Vbx_mux_eng_stop_req_ccu_cfm "MUX BCM engine stop request presence configuration boolean (1 = MUX present)" UBYTE _CNV_S_2_RANGE______3_CM 1 0. 0. 1. ECU_ADDRESS 0xd00078d9 BIT_MASK 0x1 /end MEASUREMENT
/begin MEASUREMENT Vbx_mux_fwhs_cfm "MUX front wheel speed presence configuration boolean (1 = MUX present)" UBYTE _CNV_S_2_RANGE______3_CM 1 0. 0. 1. ECU_ADDRESS 0xd00078da BIT_MASK 0x1 /end MEASUREMENT
/begin MEASUREMENT Vbx_mux_neut_cnt_cfm "MUX neutral contactor presence configuration boolean (1 = MUX present)" UBYTE _CNV_S_2_RANGE______3_CM 1 0. 0. 1. ECU_ADDRESS 0xd00078db BIT_MASK 0x1 /end MEASUREMENT
/begin MEASUREMENT Vbx_mux_rvr_cnt_cfm "MUX reverse contactor presence configuration boolean (1 = MUX present)" UBYTE _CNV_S_2_RANGE______3_CM 1 0. 0. 1. ECU_ADDRESS 0xd00078dc BIT_MASK 0x1 /end MEASUREMENT
/begin MEASUREMENT Vbx_mux_rwhs_cfm "MUX rear wheel speed presence configuration boolean (1 = MUX present)" UBYTE _CNV_S_2_RANGE______3_CM 1 0. 0. 1. ECU_ADDRESS 0xd00078dd BIT_MASK 0x1 /end MEASUREMENT
/begin MEASUREMENT Vbx_mux_sta_stt_cfm "MUX starter status presence configuration boolean (1 = MUX present)" UBYTE _CNV_S_2_RANGE______3_CM 1 0. 0. 1. ECU_ADDRESS 0xd00078de BIT_MASK 0x1 /end MEASUREMENT
/begin MEASUREMENT Vbx_mux_tra_acel_cfm "MUX transversal acceleration presence configuration boolean (1 = MUX present)" UBYTE _CNV_S_2_RANGE______3_CM 1 0. 0. 1. ECU_ADDRESS 0xd00078df BIT_MASK 0x1 /end MEASUREMENT
/begin MEASUREMENT Vbx_mux_vh_dist_cfm "MUX vehicle distance presence configuration boolean (1 = MUX present)" UBYTE _CNV_S_2_RANGE______3_CM 1 0. 0. 1. ECU_ADDRESS 0xd00078e0 BIT_MASK 0x1 /end MEASUREMENT
/begin MEASUREMENT Vbx_mux_vh_key_cfm "MUX key vehicle presence configuration boolean (1 = MUX present)" UBYTE _CNV_S_2_RANGE______3_CM 1 0. 0. 1. ECU_ADDRESS 0xd00078e1 BIT_MASK 0x1 /end MEASUREMENT
/begin MEASUREMENT Vbx_rs_gear_shf_cfm "Renault sport gear shift display configuration boolean (1 = RS Activation)" UBYTE _CNV_S_2_RANGE______3_CM 1 0. 0. 1. ECU_ADDRESS 0xd00078e2 BIT_MASK 0x1 /end MEASUREMENT
/begin MEASUREMENT Vbx_sens_brk_pdl_clos_cfm "Closed brake pedal sensor presence configuration boolean (1 = wire sensor present)" UBYTE _CNV_S_2_RANGE______3_CM 1 0. 0. 1. ECU_ADDRESS 0xd00078e3 BIT_MASK 0x1 /end MEASUREMENT
/begin MEASUREMENT Vbx_wf_ac_req_cfm "Wire frame air conditionning request presence configuration boolean (1 = wire frame present)" UBYTE _CNV_S_2_RANGE______3_CM 1 0. 0. 1. ECU_ADDRESS 0xd00078e4 BIT_MASK 0x1 /end MEASUREMENT
/begin MEASUREMENT Vbx_wf_acs_acel_is_req_cfm "Wire frame accessories accelerated idle speed request presence configuration boolean (1 = wire frame present)" UBYTE _CNV_S_2_RANGE______3_CM 1 0. 0. 1. ECU_ADDRESS 0xd00078e5 BIT_MASK 0x1 /end MEASUREMENT
/begin MEASUREMENT Vbx_wf_alt_cfm "Wire frame alternator presence configuration boolean (1 = wire frame present)" UBYTE _CNV_S_2_RANGE______3_CM 1 0. 0. 1. ECU_ADDRESS 0xd00078e6 BIT_MASK 0x1 /end MEASUREMENT
/begin MEASUREMENT Vbx_wf_comp_cfa_cfm "Wire frame passenger compartment cooling fan presence configuration boolean (1 = wire frame present)" UBYTE _CNV_S_2_RANGE______3_CM 1 0. 0. 1. ECU_ADDRESS 0xd00078e7 BIT_MASK 0x1 /end MEASUREMENT
/begin MEASUREMENT Vbx_wf_fuel_lvl_cfm "Wire frame fuel level presence configuration boolean (1 = wire frame present)" UBYTE _CNV_S_2_RANGE______3_CM 1 0. 0. 1. ECU_ADDRESS 0xd00078e8 BIT_MASK 0x1 /end MEASUREMENT
/begin MEASUREMENT Vbx_wf_vs_cfm "Wire frame vehicle speed presence configuration boolean (1 = wire frame present)" UBYTE _CNV_S_2_RANGE______3_CM 1 0. 0. 1. ECU_ADDRESS 0xd00078e9 BIT_MASK 0x1 /end MEASUREMENT
/begin MEASUREMENT Vxx_pwst_prs_auto_conf_cfm "Power steering pressure type configuration. 0:absent, 1:wire field, 2:software information" UBYTE _CNV_A_R_ECME_LINEA_0_CM 1 0. 0. 2. ECU_ADDRESS 0xd00078ea FORMAT "%3.0" /end MEASUREMENT
/begin MEASUREMENT Vxx_sas_cfm "Stop and Start configuration" UBYTE _CNV_A_R_ECME_LINEA_0_CM 1 0. 0. 2. ECU_ADDRESS 0xd00078eb FORMAT "%3.0" /end MEASUREMENT
/begin CHARACTERISTIC Cbx_esm_cfm "ESM type configuration embedded choice." VALUE 0xa0021158 _REC_S1VAL_20_u1 1. _CNV_A_R_ECME_LINEA_0_CM 0. 1. FORMAT "%1.0" BIT_MASK 0x1 /end CHARACTERISTIC
/begin CHARACTERISTIC Cbx_rs_gear_shf_cfm "Renault Sport application: disable rs gear shift when equal to 0" VALUE 0xa0021159 _REC_S1VAL_20_u1 1. _CNV_A_R_ECME_LINEA_0_CM 0. 1. FORMAT "%1.0" BIT_MASK 0x1 /end CHARACTERISTIC
/begin CHARACTERISTIC Cxx_pwst_prs_auto_conf_cfm "Power steering pressure type configuration embedded choice." VALUE 0xa002115a _REC_S1VAL_20_u1 2. _CNV_A_R_ECME_LINEA_0_CM 0. 2. FORMAT "%3.0" /end CHARACTERISTIC
/begin CHARACTERISTIC Cxx_sas_cfm "Stop and Start type configuration embedded choice." VALUE 0xa0021157 _REC_S1VAL_20_u1 2. _CNV_A_R_ECME_LINEA_0_CM 0. 2. FORMAT "%3.0" /end CHARACTERISTIC
/begin MEASUREMENT RST_GearShift "Transmitted CAN parameter" UBYTE _CNV_A_R_ECME_LINEA_0_CM 1 0. 0. 1. ECU_ADDRESS 0xd00069a8 FORMAT "%3.0" /end MEASUREMENT
/begin MEASUREMENT Vbx_mux_ptc_pow_navl "PTC power from CAN is not available" UBYTE _CNV_S_2_RANGE______3_CM 1 0. 0. 1. ECU_ADDRESS 0xd00069e6 BIT_MASK 0x1 /end MEASUREMENT
/begin MEASUREMENT Vsx_mux_ptc_pow_vld "PTC power (from CAN) validity status" UBYTE _CNV_S_3_STATUS_OK__179_CM 1 0. 0. 2. ECU_ADDRESS 0xd00069e7 /end MEASUREMENT
/begin MEASUREMENT Vxx_mux_ptc_pow "PTC power consumed received from CAN" UWORD _CNV_A_R_LINEAR_____186_CM 1 0. 0. 655350. ECU_ADDRESS 0xd00051ba FORMAT "%6.0" /end MEASUREMENT
/begin MEASUREMENT Vbx_mux_lft_rwhs_navl "Indicates that the left right wheel speed received on the CAN is unavailable" UBYTE _CNV_S_2_RANGE______3_CM 1 0. 0. 1. ECU_ADDRESS 0xd00069e8 BIT_MASK 0x1 /end MEASUREMENT
/begin MEASUREMENT Vbx_mux_rgt_rwhs_navl "Indicates that the rear right wheel speed received on the CAN is unavailable" UBYTE _CNV_S_2_RANGE______3_CM 1 0. 0. 1. ECU_ADDRESS 0xd00069e9 BIT_MASK 0x1 /end MEASUREMENT
/begin MEASUREMENT Vsx_mux_lft_rwhs_vld "Rear left wheel speed received on the CAN validity status" UBYTE _CNV_S_3_STATUS_OK__179_CM 1 0. 0. 2. ECU_ADDRESS 0xd00069ea /end MEASUREMENT
/begin MEASUREMENT Vsx_mux_rgt_rwhs_vld "Rear right wheel speed received on the CAN validity status" UBYTE _CNV_S_3_STATUS_OK__179_CM 1 0. 0. 2. ECU_ADDRESS 0xd00069eb /end MEASUREMENT
/begin MEASUREMENT Vxx_mux_lft_rwhs "Rear left wheel speed received on the CAN" UWORD _CNV_A_R_LINEAR_____125_CM 1 0. 0. 655.34 ECU_ADDRESS 0xd000412e FORMAT "%6.2" /end MEASUREMENT
/begin MEASUREMENT Vxx_mux_rgt_rwhs "Rear right wheel speed received on the CAN" UWORD _CNV_A_R_LINEAR_____125_CM 1 0. 0. 655.34 ECU_ADDRESS 0xd0004130 FORMAT "%6.2" /end MEASUREMENT
/begin MEASUREMENT Vxx_mux_rs_dspl_pdl_spt_fac "Pedal progressivity maps chosen by the Renault Sport Display received on the CAN." UBYTE _CNV_A_R_ECME_LINEA_0_CM 1 0. 0. 15. ECU_ADDRESS 0xd00078a5 FORMAT "%3.0" /end MEASUREMENT
/begin MEASUREMENT Vxx_mux_rs_dspl_pdl_spt_fac_raw "Raw pedal progressivity maps chosen by the Renault Sport Display (CAN parameter no treated)" UBYTE _CNV_A_R_ECME_LINEA_0_CM 1 0. 0. 15. ECU_ADDRESS 0xd0006930 FORMAT "%3.0" /end MEASUREMENT
/begin MEASUREMENT Vbx_mux_raw_dyn_mod_req "Sport mode request received on the CAN." UBYTE _CNV_S_2_RANGE______3_CM 1 0. 0. 1. ECU_ADDRESS 0xd00078a6 BIT_MASK 0x1 /end MEASUREMENT
/begin MEASUREMENT Vxx_mux_raw_dyn_mod_req_raw "Raw sport mode request (CAN parameter no treated)." UBYTE _CNV_A_R_ECME_LINEA_0_CM 1 0. 0. 7. ECU_ADDRESS 0xd0006931 FORMAT "%3.0" /end MEASUREMENT
/begin MEASUREMENT Vxx_mux_gear_cge_max_ofs "Gearshift offset chosen by the Renault Sport display received on the CAN." UWORD _CNV_A_R_ENSD_LINEA_22_CM 1 0. 0. 16383.75 ECU_ADDRESS 0xd00051b8 FORMAT "%8.2" /end MEASUREMENT
/begin MEASUREMENT RST_BoostPressure "Transmitted CAN parameter" UBYTE _CNV_A_R_ECME_LINEA_0_CM 1 0. 0. 63. ECU_ADDRESS 0xd00078a9 FORMAT "%3.0" /end MEASUREMENT
/begin MEASUREMENT RST_CurrentGear "Transmitted CAN parameter" UBYTE _CNV_A_R_ECME_LINEA_0_CM 1 0. 0. 7. ECU_ADDRESS 0xd00078aa FORMAT "%3.0" /end MEASUREMENT
/begin MEASUREMENT RST_EngineCoolantTemp "Transmitted CAN parameter." UBYTE _CNV_A_R_ECME_LINEA_0_CM 1 0. 0. 255. ECU_ADDRESS 0xd00078ab FORMAT "%3.0" /end MEASUREMENT
/begin MEASUREMENT RST_EngineStatus "Transmitted CAN parameter." UBYTE _CNV_A_R_ECME_LINEA_0_CM 1 0. 0. 3. ECU_ADDRESS 0xd00078ac FORMAT "%3.0" /end MEASUREMENT
/begin MEASUREMENT RST_FuelConsumption "Transmitted CAN parameter." UBYTE _CNV_A_R_ECME_LINEA_0_CM 1 0. 0. 255. ECU_ADDRESS 0xd00078ad FORMAT "%3.0" /end MEASUREMENT
/begin MEASUREMENT RST_IntakeAirTemperature "Transmitted CAN parameter." UBYTE _CNV_A_R_ECME_LINEA_0_CM 1 0. 0. 255. ECU_ADDRESS 0xd00078ae FORMAT "%3.0" /end MEASUREMENT
/begin MEASUREMENT RST_KickDownActivated "Transmitted CAN parameter." UBYTE _CNV_A_R_ECME_LINEA_0_CM 1 0. 0. 1. ECU_ADDRESS 0xd00078af FORMAT "%3.0" /end MEASUREMENT
/begin MEASUREMENT RST_OilTemperature "Transmitted CAN parameter." UBYTE _CNV_A_R_ECME_LINEA_0_CM 1 0. 0. 255. ECU_ADDRESS 0xd00078b0 FORMAT "%3.0" /end MEASUREMENT
/begin MEASUREMENT RST_OvertorqueState "Transmitted CAN parameter." UBYTE _CNV_A_R_ECME_LINEA_0_CM 1 0. 0. 3. ECU_ADDRESS 0xd00078b1 FORMAT "%3.0" /end MEASUREMENT
/begin MEASUREMENT RST_PowerTrainSetPoint "Transmitted CAN parameter." UWORD _CNV_A_R_ECME_LINEA_0_CM 1 0. 0. 1023. ECU_ADDRESS 0xd00051ae FORMAT "%5.0" /end MEASUREMENT
/begin MEASUREMENT Vbx_mux_prim_sha_spd_navl "indicates that primary shaft speed received on the CAN is unavailable" UBYTE _CNV_S_2_RANGE______3_CM 1 0. 0. 1. ECU_ADDRESS 0xd000693a BIT_MASK 0x1 /end MEASUREMENT
/begin MEASUREMENT Vsx_mux_prim_sha_spd_vld "Primary shaft speed received on the CAN validity status" UBYTE _CNV_S_8_STATUS_OK__234_CM 1 0. 0. 7. ECU_ADDRESS 0xd000693b /end MEASUREMENT
/begin MEASUREMENT Vxx_mux_prim_sha_spd "Primary shaft speed received on the CAN" UWORD _CNV_A_R_ENSD_LINEA_22_CM 1 0. 0. 16383.75 ECU_ADDRESS 0xd00040f0 FORMAT "%8.2" /end MEASUREMENT
/begin AXIS_PTS Ctb_ajs_cor_driv_tq_fac "Breakpoint calibration of normalized driver torque factor in AJCOR function" 0xa0033520 Vxx_ajs_spv_driv_tq_fac _REC_A2AXS_20_u1 1. _CNV_A_R_LINEAR_____123_CM 11 0. 1. FORMAT "%4.2" /end AXIS_PTS
/begin AXIS_PTS Ctb_ajs_cor_n "Breakpoint calibration of engine speed in AJCOR function" 0xa003352c Vxx_n _REC_A2AXS_20_u2 16383.75 _CNV_A_R_ENSD_LINEA_22_CM 10 0. 16383.75 FORMAT "%8.2" /end AXIS_PTS
/begin AXIS_PTS Ctb_ajs_cor_n_diff "Breakpoint calibration of difference between engine speed and idle speed setpoint in AJCOR function" 0xa0033544 Vxx_ajs_cor_n_diff _REC_A2AXS_20_u2 16383.75 _CNV_A_R_ENSD_LINEA_22_CM 8 0. 16383.75 FORMAT "%8.2" /end AXIS_PTS
/begin AXIS_PTS Ctb_ajs_cor_tco "Breakpoint calibration of engine coolant temperature in AJCOR function" 0xa0033558 Vxx_tco _REC_A2AXS_20_u2 240. _CNV_A_R_LINEAR_____110_CM 6 -40. 200. FORMAT "%5.1" /end AXIS_PTS
/begin AXIS_PTS Ctb_ajs_dt_tq_rat "a_sm_caj_ctl_ajcorxx_xxx_xx_x_a/Breakpoint calibration of driveline torque ratio" 0xa0033568 Vxx_ajs_dt_tq_rat _REC_A2AXS_20_u2 210. _CNV_A_R_LINEAR_____313_CM 12 -10. 200. FORMAT "%6.2" /end AXIS_PTS
/begin CHARACTERISTIC Cmp_ajs_cor_fast_cor_dly "AJCOR cartography for the maximum time to delay the fast anti-jerk correction." MAP 0xa0033584 _REC_A1MAP_20_u2_u2_u1 655.35 _CNV_A_R_LINEAR_____32_CM 0. 655.35 FORMAT "%6.2"
 /begin AXIS_DESCR COM_AXIS Vxx_n _CNV_A_R_ENSD_LINEA_22_CM 10 0. 16383.75 FORMAT "%8.2" AXIS_PTS_REF Ctb_ajs_cor_n /end AXIS_DESCR
 /begin AXIS_DESCR COM_AXIS Vxx_ajs_spv_driv_tq_fac _CNV_A_R_LINEAR_____123_CM 11 0. 1. FORMAT "%4.2" AXIS_PTS_REF Ctb_ajs_cor_driv_tq_fac /end AXIS_DESCR
/end CHARACTERISTIC
/begin CHARACTERISTIC Cmp_ajs_cor_t1_acel_dt_clos "AJCOR time constant cartography for vehicle acceleration when driveline is closed" MAP 0xa0033660 _REC_A1MAP_20_u2_u2_u2 65.535 _CNV_A_R_LINEAR_____116_CM 0. 65.535
 /begin AXIS_DESCR COM_AXIS Vxx_n _CNV_A_R_ENSD_LINEA_22_CM 10 0. 16383.75 FORMAT "%8.2" AXIS_PTS_REF Ctb_ajs_cor_n /end AXIS_DESCR
 /begin AXIS_DESCR COM_AXIS Vxx_ajs_dt_tq_rat _CNV_A_R_LINEAR_____313_CM 12 -10. 200. FORMAT "%6.2" AXIS_PTS_REF Ctb_ajs_dt_tq_rat /end AXIS_DESCR
/end CHARACTERISTIC
/begin CHARACTERISTIC Cmp_ajs_cor_t1_decl_dt_clos "AJCOR time constant cartography for vehicle deceleration when driveline is closed" MAP 0xa0033750 _REC_A1MAP_20_u2_u2_u2 65.535 _CNV_A_R_LINEAR_____116_CM 0. 65.535
 /begin AXIS_DESCR COM_AXIS Vxx_n _CNV_A_R_ENSD_LINEA_22_CM 10 0. 16383.75 FORMAT "%8.2" AXIS_PTS_REF Ctb_ajs_cor_n /end AXIS_DESCR
 /begin AXIS_DESCR COM_AXIS Vxx_ajs_dt_tq_rat _CNV_A_R_LINEAR_____313_CM 12 -10. 200. FORMAT "%6.2" AXIS_PTS_REF Ctb_ajs_dt_tq_rat /end AXIS_DESCR
/end CHARACTERISTIC
/begin CHARACTERISTIC Cmp_ajs_cor_t1_fast_cor "AJCOR time constant cartography used during the boost of the curative anti-jerk function." MAP 0xa0033840 _REC_A1MAP_20_u2_u2_u1 65.535 _CNV_A_R_LINEAR_____116_CM 0. 65.535
 /begin AXIS_DESCR COM_AXIS Vxx_n _CNV_A_R_ENSD_LINEA_22_CM 10 0. 16383.75 FORMAT "%8.2" AXIS_PTS_REF Ctb_ajs_cor_n /end AXIS_DESCR
 /begin AXIS_DESCR COM_AXIS Vxx_ajs_spv_driv_tq_fac _CNV_A_R_LINEAR_____123_CM 11 0. 1. FORMAT "%4.2" AXIS_PTS_REF Ctb_ajs_cor_driv_tq_fac /end AXIS_DESCR
/end CHARACTERISTIC
/begin CHARACTERISTIC Cmp_ajs_cor_td_acel_dt_clos "AJCOR gain cartography for vehicle acceleration when driveline is closed (unit=(N.m/rpm)^(1/2))" MAP 0xa003391c _REC_A1MAP_20_u2_u2_u2 1. _CNV_A_R_LINEAR_____459_CM 0. 1. FORMAT "%5.3"
 /begin AXIS_DESCR COM_AXIS Vxx_n _CNV_A_R_ENSD_LINEA_22_CM 10 0. 16383.75 FORMAT "%8.2" AXIS_PTS_REF Ctb_ajs_cor_n /end AXIS_DESCR
 /begin AXIS_DESCR COM_AXIS Vxx_ajs_dt_tq_rat _CNV_A_R_LINEAR_____313_CM 12 -10. 200. FORMAT "%6.2" AXIS_PTS_REF Ctb_ajs_dt_tq_rat /end AXIS_DESCR
/end CHARACTERISTIC
/begin CHARACTERISTIC Cmp_ajs_cor_td_acel_n_fac "AJCOR Cartography of td modulation factors, for vehicle acceleration" MAP 0xa0033a0c _REC_A1MAP_20_u2_u2_u2 100. _CNV_A_R_LINEAR_____123_CM 0. 100.
 /begin AXIS_DESCR COM_AXIS Vxx_ajs_cor_n_diff _CNV_A_R_ENSD_LINEA_22_CM 8 0. 16383.75 FORMAT "%8.2" AXIS_PTS_REF Ctb_ajs_cor_n_diff /end AXIS_DESCR
 /begin AXIS_DESCR COM_AXIS Vxx_tco _CNV_A_R_LINEAR_____110_CM 6 -40. 200. FORMAT "%5.1" AXIS_PTS_REF Ctb_ajs_cor_tco /end AXIS_DESCR
/end CHARACTERISTIC
/begin CHARACTERISTIC Cmp_ajs_cor_td_decl_dt_clos "AJCOR gain cartography for vehicle deceleration when driveline is closed (unit=(N.m/rpm)^(1/2))" MAP 0xa0033a6c _REC_A1MAP_20_u2_u2_u2 1. _CNV_A_R_LINEAR_____459_CM 0. 1. FORMAT "%5.3"
 /begin AXIS_DESCR COM_AXIS Vxx_n _CNV_A_R_ENSD_LINEA_22_CM 10 0. 16383.75 FORMAT "%8.2" AXIS_PTS_REF Ctb_ajs_cor_n /end AXIS_DESCR
 /begin AXIS_DESCR COM_AXIS Vxx_ajs_dt_tq_rat _CNV_A_R_LINEAR_____313_CM 12 -10. 200. FORMAT "%6.2" AXIS_PTS_REF Ctb_ajs_dt_tq_rat /end AXIS_DESCR
/end CHARACTERISTIC
/begin CHARACTERISTIC Cmp_ajs_cor_td_decl_n_fac "AJCOR Cartography of td modulation factors, for vehicle deceleration" MAP 0xa0033b5c _REC_A1MAP_20_u2_u2_u2 100. _CNV_A_R_LINEAR_____123_CM 0. 100.
 /begin AXIS_DESCR COM_AXIS Vxx_ajs_cor_n_diff _CNV_A_R_ENSD_LINEA_22_CM 8 0. 16383.75 FORMAT "%8.2" AXIS_PTS_REF Ctb_ajs_cor_n_diff /end AXIS_DESCR
 /begin AXIS_DESCR COM_AXIS Vxx_tco _CNV_A_R_LINEAR_____110_CM 6 -40. 200. FORMAT "%5.1" AXIS_PTS_REF Ctb_ajs_cor_tco /end AXIS_DESCR
/end CHARACTERISTIC
/begin CHARACTERISTIC Cmp_ajs_cor_td_fast_cor "AJCOR gain cartography used during the boost of the curative anti-jerk function (unit=(N.m/rpm)^(1/2))" MAP 0xa0033bbc _REC_A1MAP_20_u2_u2_u1 1. _CNV_A_R_LINEAR_____459_CM 0. 1. FORMAT "%5.3"
 /begin AXIS_DESCR COM_AXIS Vxx_n _CNV_A_R_ENSD_LINEA_22_CM 10 0. 16383.75 FORMAT "%8.2" AXIS_PTS_REF Ctb_ajs_cor_n /end AXIS_DESCR
 /begin AXIS_DESCR COM_AXIS Vxx_ajs_spv_driv_tq_fac _CNV_A_R_LINEAR_____123_CM 11 0. 1. FORMAT "%4.2" AXIS_PTS_REF Ctb_ajs_cor_driv_tq_fac /end AXIS_DESCR
/end CHARACTERISTIC
/begin CHARACTERISTIC Cmp_ajs_cor_td_tq_acel_fac "AJCOR cartography for modulation factors of the filter gain when driveline is closed, for vehicle acceleration" MAP 0xa0033c98 _REC_A1MAP_20_u2_u1_u2 100. _CNV_A_R_LINEAR_____123_CM 0. 100.
 /begin AXIS_DESCR COM_AXIS Vxx_ajs_spv_driv_tq_fac _CNV_A_R_LINEAR_____123_CM 11 0. 1. FORMAT "%4.2" AXIS_PTS_REF Ctb_ajs_cor_driv_tq_fac /end AXIS_DESCR
 /begin AXIS_DESCR COM_AXIS Vxx_ajs_dt_tq_rat _CNV_A_R_LINEAR_____313_CM 12 -10. 200. FORMAT "%6.2" AXIS_PTS_REF Ctb_ajs_dt_tq_rat /end AXIS_DESCR
/end CHARACTERISTIC
/begin CHARACTERISTIC Cmp_ajs_cor_td_tq_decl_fac "AJCOR cartography for modulation factors of the filter gain when driveline is closed, for vehicle deceleration" MAP 0xa0033da0 _REC_A1MAP_20_u2_u1_u2 100. _CNV_A_R_LINEAR_____123_CM 0. 100.
 /begin AXIS_DESCR COM_AXIS Vxx_ajs_spv_driv_tq_fac _CNV_A_R_LINEAR_____123_CM 11 0. 1. FORMAT "%4.2" AXIS_PTS_REF Ctb_ajs_cor_driv_tq_fac /end AXIS_DESCR
 /begin AXIS_DESCR COM_AXIS Vxx_ajs_dt_tq_rat _CNV_A_R_LINEAR_____313_CM 12 -10. 200. FORMAT "%6.2" AXIS_PTS_REF Ctb_ajs_dt_tq_rat /end AXIS_DESCR
/end CHARACTERISTIC
/begin CHARACTERISTIC Ctp_ajs_cor_dz_tqe "AJCOR table for torque thresholds of the dead zone" CURVE 0xa0033ea8 _REC_A1CUR_20_u2_u2 2047.96875 _CNV_A_R_LINEAR_____181_CM 0. 2047.96875 FORMAT "%10.5"
 /begin AXIS_DESCR COM_AXIS Vxx_n _CNV_A_R_ENSD_LINEA_22_CM 10 0. 16383.75 FORMAT "%8.2" AXIS_PTS_REF Ctb_ajs_cor_n /end AXIS_DESCR
/end CHARACTERISTIC
/begin CHARACTERISTIC Ctp_ajs_cor_fast_cor_dly_fac "AJCOR table for the modulation of the maximum time to delay the boosted anti-jerk correction." CURVE 0xa0033ebc _REC_A1CUR_20_u2_u2 100. _CNV_A_R_LINEAR_____123_CM 0. 100.
 /begin AXIS_DESCR COM_AXIS Vxx_ajs_dt_tq_rat _CNV_A_R_LINEAR_____313_CM 12 -10. 200. FORMAT "%6.2" AXIS_PTS_REF Ctb_ajs_dt_tq_rat /end AXIS_DESCR
/end CHARACTERISTIC
/begin CHARACTERISTIC Ctp_ajs_cor_max_cor_dyn_tqe "AJCOR table for the selection of the maximum dynamique torque correction" CURVE 0xa0033ed4 _REC_A1CUR_20_u2_u2 2047.96875 _CNV_A_R_LINEAR_____185_CM -1024. 1023.96875 FORMAT "%11.5"
 /begin AXIS_DESCR COM_AXIS Vxx_tco _CNV_A_R_LINEAR_____110_CM 6 -40. 200. FORMAT "%5.1" AXIS_PTS_REF Ctb_ajs_cor_tco /end AXIS_DESCR
/end CHARACTERISTIC
/begin CHARACTERISTIC Ctp_ajs_cor_min_cor_dyn_tqe "AJCOR table for the selection of the minimum dynamique torque correction" CURVE 0xa0033ee0 _REC_A1CUR_20_u2_u2 2047.96875 _CNV_A_R_LINEAR_____185_CM -1024. 1023.96875 FORMAT "%11.5"
 /begin AXIS_DESCR COM_AXIS Vxx_tco _CNV_A_R_LINEAR_____110_CM 6 -40. 200. FORMAT "%5.1" AXIS_PTS_REF Ctb_ajs_cor_tco /end AXIS_DESCR
/end CHARACTERISTIC
/begin CHARACTERISTIC Ctp_ajs_cor_t1_fast_cor_fac "AJCOR table for the modulation of the time constant used during the boost of the curative anti-jerk function." CURVE 0xa0033eec _REC_A1CUR_20_u2_u2 100. _CNV_A_R_LINEAR_____123_CM 0. 100.
 /begin AXIS_DESCR COM_AXIS Vxx_ajs_dt_tq_rat _CNV_A_R_LINEAR_____313_CM 12 -10. 200. FORMAT "%6.2" AXIS_PTS_REF Ctb_ajs_dt_tq_rat /end AXIS_DESCR
/end CHARACTERISTIC
/begin CHARACTERISTIC Ctp_ajs_cor_td_fast_cor_fac "AJCOR table for the modulation of the gain used during the boost of the curative anti-jerk function." CURVE 0xa0033f04 _REC_A1CUR_20_u2_u2 100. _CNV_A_R_LINEAR_____123_CM 0. 100.
 /begin AXIS_DESCR COM_AXIS Vxx_ajs_dt_tq_rat _CNV_A_R_LINEAR_____313_CM 12 -10. 200. FORMAT "%6.2" AXIS_PTS_REF Ctb_ajs_dt_tq_rat /end AXIS_DESCR
/end CHARACTERISTIC
/begin MEASUREMENT Vbx_ajs_cor_fast_cor_off "The fast anti-jerk correction is not active." UBYTE _CNV_S_2_RANGE______3_CM 1 0. 0. 1. ECU_ADDRESS 0xd0007090 BIT_MASK 0x1 /end MEASUREMENT
/begin MEASUREMENT Vbx_ajs_cor_fast_cor_on "The fast anti-jerk correction is active." UBYTE _CNV_S_2_RANGE______3_CM 1 0. 0. 1. ECU_ADDRESS 0xd0007091 BIT_MASK 0x1 /end MEASUREMENT
/begin MEASUREMENT Vbx_ajs_cor_stt_cut "Boolean variable deactivating (1) the AJCOR function" UBYTE _CNV_S_2_RANGE______3_CM 1 0. 0. 1. ECU_ADDRESS 0xd0007092 BIT_MASK 0x1 /end MEASUREMENT
/begin MEASUREMENT Vsx_ajs_cor_stt_para "State variable to select AJCOR parameters" UBYTE _CNV_A_R_A_105_CM 1 0. 1. 5. ECU_ADDRESS 0xd0007093 /end MEASUREMENT
/begin MEASUREMENT Vxx_ajs_cor_dyn_tqe "Torque correction calculated by AJCOR function" SWORD _CNV_A_R_LINEAR_____181_CM 1 0. -1024. 1023.96875 ECU_ADDRESS 0xd0004834 FORMAT "%11.5" /end MEASUREMENT
/begin MEASUREMENT Vxx_ajs_cor_dz_tqe "torque value threshold of AJCOR dead zone" UWORD _CNV_A_R_LINEAR_____181_CM 1 0. 0. 2047.96875 ECU_ADDRESS 0xd0004836 FORMAT "%10.5" /end MEASUREMENT
/begin MEASUREMENT Vxx_ajs_cor_fast_cor_dly "Maximum time to inhibate the anti-jerk correction during the boost of the curative anti-jerk function." UWORD _CNV_A_R_LINEAR_____32_CM 1 0. 0. 655.35 ECU_ADDRESS 0xd0004838 FORMAT "%6.2" /end MEASUREMENT
/begin MEASUREMENT Vxx_ajs_cor_lim_dyn_tqe "Limited torque correction calculated by AJCOR function" UWORD _CNV_A_R_LINEAR_____216_CM 1 0. -400. 1647.96875 ECU_ADDRESS 0xd000483a FORMAT "%11.5" /end MEASUREMENT
/begin MEASUREMENT Vxx_ajs_cor_lim_dz_dyn_tqe "Limited torque correction calculated by AJCOR function. This torque calculation included dead zone" UWORD _CNV_A_R_LINEAR_____216_CM 1 0. -400. 1647.96875 ECU_ADDRESS 0xd000483c FORMAT "%11.5" /end MEASUREMENT
/begin MEASUREMENT Vxx_ajs_cor_max_cor_dyn "Maximum dynamic torque correction autorized for AJCOR when driveline is closed" UWORD _CNV_A_R_LINEAR_____181_CM 1 0. 0. 2047.96875 ECU_ADDRESS 0xd000483e FORMAT "%10.5" /end MEASUREMENT
/begin MEASUREMENT Vxx_ajs_cor_min_cor_dyn "Minimum dynamic torque correction autorized for AJCOR when driveline is closed" UWORD _CNV_A_R_LINEAR_____185_CM 1 0. -1024. 1023.96875 ECU_ADDRESS 0xd0004840 FORMAT "%11.5" /end MEASUREMENT
/begin MEASUREMENT Vxx_ajs_cor_n_diff "Difference between engine speed and idle speed setpoint in AJCOR function" UWORD _CNV_A_R_ENSD_LINEA_22_CM 1 0. 0. 16383.75 ECU_ADDRESS 0xd0004842 FORMAT "%8.2" /end MEASUREMENT
/begin MEASUREMENT Vxx_ajs_cor_t1 "AJCOR final time constant value" UWORD _CNV_A_R_LINEAR_____116_CM 1 0. 0. 65.535 ECU_ADDRESS 0xd0004844 /end MEASUREMENT
/begin MEASUREMENT Vxx_ajs_cor_t1_acel "AJCOR time constant value calculated for vehicle acceleration" UWORD _CNV_A_R_LINEAR_____116_CM 1 0. 0. 65.535 ECU_ADDRESS 0xd0004846 /end MEASUREMENT
/begin MEASUREMENT Vxx_ajs_cor_t1_decl "AJCOR time constant value calculated for vehicle deceleration" UWORD _CNV_A_R_LINEAR_____116_CM 1 0. 0. 65.535 ECU_ADDRESS 0xd0004848 /end MEASUREMENT
/begin MEASUREMENT Vxx_ajs_cor_t1_fast_cor "AJCOR time constant value used during the boost of the curative anti-jerk function" UWORD _CNV_A_R_LINEAR_____116_CM 1 0. 0. 65.535 ECU_ADDRESS 0xd000484a /end MEASUREMENT
/begin MEASUREMENT Vxx_ajs_cor_td "AJCOR final gain value (NB:unit=(N.m/rpm)^(1/2))" UWORD _CNV_A_R_LINEAR_____459_CM 1 0. 0. 1. ECU_ADDRESS 0xd000484c FORMAT "%5.3" /end MEASUREMENT
/begin MEASUREMENT Vxx_ajs_cor_td_acel "AJCOR gain value calculated for vehicle acceleration (unit=(N.m/rpm)^(1/2))" UWORD _CNV_A_R_LINEAR_____459_CM 1 0. 0. 1. ECU_ADDRESS 0xd000484e FORMAT "%5.3" /end MEASUREMENT
/begin MEASUREMENT Vxx_ajs_cor_td_decl "AJCOR gain value calculated for vehicle deceleration (unit=(N.m/rpm)^(1/2))" UWORD _CNV_A_R_LINEAR_____459_CM 1 0. 0. 1. ECU_ADDRESS 0xd0004850 FORMAT "%5.3" /end MEASUREMENT
/begin MEASUREMENT Vxx_ajs_cor_td_fast_cor "AJCOR gain value used during the boost of the curative anti-jerk function (NB:unit=(N.m/rpm)^(1/2))" UWORD _CNV_A_R_LINEAR_____459_CM 1 0. 0. 1. ECU_ADDRESS 0xd0004852 FORMAT "%5.3" /end MEASUREMENT
/begin MEASUREMENT Vxx_ajs_cor_td_tq_fac "AjCOR modulation factor for the filter gain" UWORD _CNV_A_R_LINEAR_____123_CM 1 0. 0. 100. ECU_ADDRESS 0xd0004854 /end MEASUREMENT
/begin MEASUREMENT Vxx_ajs_cor_tqe "Torque correction calculated by AJCOR function but not limited" UWORD _CNV_A_R_LINEAR_____216_CM 1 0. -400. 1647.96875 ECU_ADDRESS 0xd0004856 FORMAT "%11.5" /end MEASUREMENT
/begin MEASUREMENT Vxx_ajs_cor_tqe_tmp "Intermediate calculation of the torque correction in the AJCOR filter" UWORD _CNV_A_R_LINEAR_____460_CM 1 0. -400. 1647.96875 ECU_ADDRESS 0xd0004858 FORMAT "%10.5" /end MEASUREMENT
/begin CHARACTERISTIC Cbx_ajs_cor_brk_cut_cfm "Boolean calibration to enable (=1) AJCOR deactivation when brake pedal is pressed" VALUE 0xa0021ccc _REC_S1VAL_20_u1 1. _CNV_A_R_ECME_LINEA_0_CM 0. 1. FORMAT "%1.0" BIT_MASK 0x1 /end CHARACTERISTIC
/begin CHARACTERISTIC Cbx_ajs_cor_driv_cut_cfm "Boolean calibration to cut AJCOR if an injection cut is requested" VALUE 0xa0021ccd _REC_S1VAL_20_u1 1. _CNV_A_R_ECME_LINEA_0_CM 0. 1. FORMAT "%1.0" BIT_MASK 0x1 /end CHARACTERISTIC
/begin CHARACTERISTIC Cbx_ajs_cor_dz_cfm "Boolean calibration to active AJCOR dead zone" VALUE 0xa0021cce _REC_S1VAL_20_u1 1. _CNV_A_R_ECME_LINEA_0_CM 0. 1. FORMAT "%1.0" BIT_MASK 0x1 /end CHARACTERISTIC
/begin CHARACTERISTIC Cbx_ajs_cor_is_cfm "Boolean calibration to enable (=1) AJCOR function when idle speed regulation is active" VALUE 0xa0021ccf _REC_S1VAL_20_u1 1. _CNV_A_R_ECME_LINEA_0_CM 0. 1. FORMAT "%1.0" BIT_MASK 0x1 /end CHARACTERISTIC
/begin CHARACTERISTIC Cbx_ajs_cor_stt_cfm "Boolean calibration to deactivate AJCOR function (0) manually" VALUE 0xa0021cd0 _REC_S1VAL_20_u1 1. _CNV_A_R_ECME_LINEA_0_CM 0. 1. FORMAT "%1.0" BIT_MASK 0x1 /end CHARACTERISTIC
/begin CHARACTERISTIC Cxx_ajs_cor_dz_dly "Time delay of AJCOR dead zone" VALUE 0xa0021cd1 _REC_S1VAL_20_u1 25.5 _CNV_A_R_LINEAR_____58_CM 0. 25.5 FORMAT "%4.1" /end CHARACTERISTIC
/begin CHARACTERISTIC Cxx_ajs_cor_max_cor_dyn_dt_open "Maximum dynamic torque correction autorized for AJCOR when driveline is open" VALUE 0xa0021cae _REC_S1VAL_20_u2 2047.96875 _CNV_A_R_LINEAR_____185_CM -1024. 1023.96875 FORMAT "%10.5" /end CHARACTERISTIC
/begin CHARACTERISTIC Cxx_ajs_cor_max_fast_cor "Maximum dynamic torque correction autorized for AJCOR when the boost of curative anti-jerk is active." VALUE 0xa0021cb0 _REC_S1VAL_20_s2 2047.96875 _CNV_A_R_LINEAR_____181_CM -1024. 1023.96875 FORMAT "%10.5" /end CHARACTERISTIC
/begin CHARACTERISTIC Cxx_ajs_cor_min_cor_dyn_dt_open "Minimum dynamic torque correction autorized for AJCOR when driveline is opened" VALUE 0xa0021cb2 _REC_S1VAL_20_u2 2047.96875 _CNV_A_R_LINEAR_____185_CM -1024. 1023.96875 FORMAT "%10.5" /end CHARACTERISTIC
/begin CHARACTERISTIC Cxx_ajs_cor_min_fast_cor "Minimum dynamic torque correction autorized for AJCOR when the boost of curative anti-jerk is active." VALUE 0xa0021cb4 _REC_S1VAL_20_u2 2047.96875 _CNV_A_R_LINEAR_____185_CM -1024. 1023.96875 FORMAT "%11.5" /end CHARACTERISTIC
/begin CHARACTERISTIC Cxx_ajs_cor_t1_acel_dt_modu "AJCOR time constant value when driveline is in modulation mode for vehicle acceleration" VALUE 0xa0021cb6 _REC_S1VAL_20_u2 65.535 _CNV_A_R_LINEAR_____116_CM 0. 65.535 /end CHARACTERISTIC
/begin CHARACTERISTIC Cxx_ajs_cor_t1_acel_dt_open "AJCOR time constant value when driveline is open for vehicle acceleration" VALUE 0xa0021cb8 _REC_S1VAL_20_u2 65.535 _CNV_A_R_LINEAR_____116_CM 0. 65.535 /end CHARACTERISTIC
/begin CHARACTERISTIC Cxx_ajs_cor_t1_decl_dt_modu "AJCOR time constant value when driveline is in modulation mode for vehicle deceleration" VALUE 0xa0021cba _REC_S1VAL_20_u2 65.535 _CNV_A_R_LINEAR_____116_CM 0. 65.535 /end CHARACTERISTIC
/begin CHARACTERISTIC Cxx_ajs_cor_t1_decl_dt_open "AJCOR time constant value when driveline is open for vehicle deceleration" VALUE 0xa0021cbc _REC_S1VAL_20_u2 65.535 _CNV_A_R_LINEAR_____116_CM 0. 65.535 /end CHARACTERISTIC
/begin CHARACTERISTIC Cxx_ajs_cor_t1_dt_ini "AJCOR time constant value during initialisation" VALUE 0xa0021cbe _REC_S1VAL_20_u2 65.535 _CNV_A_R_LINEAR_____116_CM 0. 65.535 /end CHARACTERISTIC
/begin CHARACTERISTIC Cxx_ajs_cor_td_acel_dt_modu "AJCOR gain value when driveline is in modulation mode for vehicle acceleration (unit=(N.m/rpm)^(1/2)" VALUE 0xa0021cc0 _REC_S1VAL_20_u2 1. _CNV_A_R_LINEAR_____459_CM 0. 1. FORMAT "%5.3" /end CHARACTERISTIC
/begin CHARACTERISTIC Cxx_ajs_cor_td_acel_dt_open "AJCOR gain value when driveline is open for vehicle acceleration (unit=(N.m/rpm)^(1/2))" VALUE 0xa0021cc2 _REC_S1VAL_20_u2 1. _CNV_A_R_LINEAR_____459_CM 0. 1. FORMAT "%5.3" /end CHARACTERISTIC
/begin CHARACTERISTIC Cxx_ajs_cor_td_decl_dt_modu "AJCOR gain value when driveline is in modulation for vehicle deceleration (unit=(N.m/rpm)^(1/2))" VALUE 0xa0021cc4 _REC_S1VAL_20_u2 1. _CNV_A_R_LINEAR_____459_CM 0. 1. FORMAT "%5.3" /end CHARACTERISTIC
/begin CHARACTERISTIC Cxx_ajs_cor_td_decl_dt_open "AJCOR gain value when driveline is open for vehicle deceleration (unit=(N.m/rpm)^(1/2))" VALUE 0xa0021cc6 _REC_S1VAL_20_u2 1. _CNV_A_R_LINEAR_____459_CM 0. 1. FORMAT "%5.3" /end CHARACTERISTIC
/begin CHARACTERISTIC Cxx_ajs_cor_td_dt_ini "AJCOR gain value during initialisation (unit=(N.m/rpm)^(1/2))" VALUE 0xa0021cc8 _REC_S1VAL_20_u2 1. _CNV_A_R_LINEAR_____459_CM 0. 1. FORMAT "%5.3" /end CHARACTERISTIC
/begin CHARACTERISTIC Cxx_ajs_cor_tkof_vs_thd "Threshold of vehicle speed to activate the anti-jerk correction during take off" VALUE 0xa0021cca _REC_S1VAL_20_u2 655.35 _CNV_A_R_LINEAR_____125_CM 0. 655.35 FORMAT "%6.2" /end CHARACTERISTIC
/begin MEASUREMENT Vbx_ajs_cor_act "Boolean variable to deactivate curative calculation above an engine speed threshold" UBYTE _CNV_S_2_RANGE______3_CM 1 0. 0. 1. ECU_ADDRESS 0xd0007094 BIT_MASK 0x1 /end MEASUREMENT
/begin CHARACTERISTIC Cxx_ajs_cor_act_n_hys "Engine speed hysteresis to deactivate curative calculation" VALUE 0xa0021cd2 _REC_S1VAL_20_s2 16383.75 _CNV_A_R_ENSD_LINEA_22_CM -8192. 8191.75 FORMAT "%8.2" /end CHARACTERISTIC
/begin CHARACTERISTIC Cxx_ajs_cor_act_n_thd "Engine speed threshold to deactivate curative calculation" VALUE 0xa0021cd4 _REC_S1VAL_20_u2 16383.75 _CNV_A_R_ENSD_LINEA_22_CM 0. 16383.75 FORMAT "%8.2" /end CHARACTERISTIC
/begin CHARACTERISTIC Cmp_ajs_cor_t1_acel_clos_spc "Specific AJCOR time constant cartography for vehicle acceleration when driveline is closed" MAP 0xa0033f1c _REC_A1MAP_20_u2_u2_u2 65.535 _CNV_A_R_LINEAR_____116_CM 0. 65.535
 /begin AXIS_DESCR COM_AXIS Vxx_n _CNV_A_R_ENSD_LINEA_22_CM 10 0. 16383.75 FORMAT "%8.2" AXIS_PTS_REF Ctb_ajs_cor_n /end AXIS_DESCR
 /begin AXIS_DESCR COM_AXIS Vxx_ajs_dt_tq_rat _CNV_A_R_LINEAR_____313_CM 12 -10. 200. FORMAT "%6.2" AXIS_PTS_REF Ctb_ajs_dt_tq_rat /end AXIS_DESCR
/end CHARACTERISTIC
/begin CHARACTERISTIC Cmp_ajs_cor_t1_decl_clos_spc "Specific AJCOR time constant cartography for vehicle deceleration when driveline is closed" MAP 0xa003400c _REC_A1MAP_20_u2_u2_u2 65.535 _CNV_A_R_LINEAR_____116_CM 0. 65.535
 /begin AXIS_DESCR COM_AXIS Vxx_n _CNV_A_R_ENSD_LINEA_22_CM 10 0. 16383.75 FORMAT "%8.2" AXIS_PTS_REF Ctb_ajs_cor_n /end AXIS_DESCR
 /begin AXIS_DESCR COM_AXIS Vxx_ajs_dt_tq_rat _CNV_A_R_LINEAR_____313_CM 12 -10. 200. FORMAT "%6.2" AXIS_PTS_REF Ctb_ajs_dt_tq_rat /end AXIS_DESCR
/end CHARACTERISTIC
/begin CHARACTERISTIC Cmp_ajs_cor_td_acel_clos_spc "Specific AJCOR gain cartography for vehicle acceleration when driveline is closed (unit=(N.m/rpm)^(1/2))" MAP 0xa00340fc _REC_A1MAP_20_u2_u2_u2 1. _CNV_A_R_LINEAR_____459_CM 0. 1. FORMAT "%5.3"
 /begin AXIS_DESCR COM_AXIS Vxx_n _CNV_A_R_ENSD_LINEA_22_CM 10 0. 16383.75 FORMAT "%8.2" AXIS_PTS_REF Ctb_ajs_cor_n /end AXIS_DESCR
 /begin AXIS_DESCR COM_AXIS Vxx_ajs_dt_tq_rat _CNV_A_R_LINEAR_____313_CM 12 -10. 200. FORMAT "%6.2" AXIS_PTS_REF Ctb_ajs_dt_tq_rat /end AXIS_DESCR
/end CHARACTERISTIC
/begin CHARACTERISTIC Cmp_ajs_cor_td_acel_fac_spc "Specific AJCOR cartography for modulation factors of the filter gain when driveline is closed, for vehicle acceleration" MAP 0xa00341ec _REC_A1MAP_20_u2_u1_u2 100. _CNV_A_R_LINEAR_____123_CM 0. 100.
 /begin AXIS_DESCR COM_AXIS Vxx_ajs_spv_driv_tq_fac _CNV_A_R_LINEAR_____123_CM 11 0. 1. FORMAT "%4.2" AXIS_PTS_REF Ctb_ajs_cor_driv_tq_fac /end AXIS_DESCR
 /begin AXIS_DESCR COM_AXIS Vxx_ajs_dt_tq_rat _CNV_A_R_LINEAR_____313_CM 12 -10. 200. FORMAT "%6.2" AXIS_PTS_REF Ctb_ajs_dt_tq_rat /end AXIS_DESCR
/end CHARACTERISTIC
/begin CHARACTERISTIC Cmp_ajs_cor_td_decl_clos_spc "Specific AJCOR gain cartography for vehicle deceleration when driveline is closed (unit=(N.m/rpm)^(1/2))" MAP 0xa00342f4 _REC_A1MAP_20_u2_u2_u2 1. _CNV_A_R_LINEAR_____459_CM 0. 1. FORMAT "%5.3"
 /begin AXIS_DESCR COM_AXIS Vxx_n _CNV_A_R_ENSD_LINEA_22_CM 10 0. 16383.75 FORMAT "%8.2" AXIS_PTS_REF Ctb_ajs_cor_n /end AXIS_DESCR
 /begin AXIS_DESCR COM_AXIS Vxx_ajs_dt_tq_rat _CNV_A_R_LINEAR_____313_CM 12 -10. 200. FORMAT "%6.2" AXIS_PTS_REF Ctb_ajs_dt_tq_rat /end AXIS_DESCR
/end CHARACTERISTIC
/begin CHARACTERISTIC Cmp_ajs_cor_td_decl_fac_spc "Specific AJCOR cartography for modulation factors of the filter gain when driveline is closed, for vehicle deceleration" MAP 0xa00343e4 _REC_A1MAP_20_u2_u1_u2 100. _CNV_A_R_LINEAR_____123_CM 0. 100.
 /begin AXIS_DESCR COM_AXIS Vxx_ajs_spv_driv_tq_fac _CNV_A_R_LINEAR_____123_CM 11 0. 1. FORMAT "%4.2" AXIS_PTS_REF Ctb_ajs_cor_driv_tq_fac /end AXIS_DESCR
 /begin AXIS_DESCR COM_AXIS Vxx_ajs_dt_tq_rat _CNV_A_R_LINEAR_____313_CM 12 -10. 200. FORMAT "%6.2" AXIS_PTS_REF Ctb_ajs_dt_tq_rat /end AXIS_DESCR
/end CHARACTERISTIC
/begin CHARACTERISTIC Ctp_ajs_cor_dz_tqe_spc "Specific AJCOR table for torque thresholds of the dead zone" CURVE 0xa00344ec _REC_A1CUR_20_u2_u2 2047.96875 _CNV_A_R_LINEAR_____181_CM 0. 2047.96875 FORMAT "%10.5"
 /begin AXIS_DESCR COM_AXIS Vxx_n _CNV_A_R_ENSD_LINEA_22_CM 10 0. 16383.75 FORMAT "%8.2" AXIS_PTS_REF Ctb_ajs_cor_n /end AXIS_DESCR
/end CHARACTERISTIC
/begin CHARACTERISTIC Ctp_ajs_cor_max_dyn_tqe_spc "Specific AJCOR table for the selection of the maximum dynamique torque correction" CURVE 0xa0034500 _REC_A1CUR_20_u2_u2 2047.96875 _CNV_A_R_LINEAR_____185_CM -1024. 1023.96875 FORMAT "%11.5"
 /begin AXIS_DESCR COM_AXIS Vxx_tco _CNV_A_R_LINEAR_____110_CM 6 -40. 200. FORMAT "%5.1" AXIS_PTS_REF Ctb_ajs_cor_tco /end AXIS_DESCR
/end CHARACTERISTIC
/begin CHARACTERISTIC Ctp_ajs_cor_min_dyn_tqe_spc "Specific AJCOR table for the selection of the minimum dynamique torque correction" CURVE 0xa003450c _REC_A1CUR_20_u2_u2 2047.96875 _CNV_A_R_LINEAR_____185_CM -1024. 1023.96875 FORMAT "%11.5"
 /begin AXIS_DESCR COM_AXIS Vxx_tco _CNV_A_R_LINEAR_____110_CM 6 -40. 200. FORMAT "%5.1" AXIS_PTS_REF Ctb_ajs_cor_tco /end AXIS_DESCR
/end CHARACTERISTIC
/begin MEASUREMENT Vxx_ajs_cor_dz_dly_spc "Specific time delay of AJCOR dead zone" UBYTE _CNV_A_R_LINEAR_____58_CM 1 0. 0. 25.5 ECU_ADDRESS 0xd0007095 FORMAT "%4.1" /end MEASUREMENT
/begin MEASUREMENT Vxx_ajs_cor_dz_tqe_spc "Specific torque threshold of the AJCOR dead zone" UWORD _CNV_A_R_LINEAR_____181_CM 1 0. 0. 2047.96875 ECU_ADDRESS 0xd000485a FORMAT "%10.5" /end MEASUREMENT
/begin MEASUREMENT Vxx_ajs_cor_max_cor_dyn_spc "Specific maximum dynamic torque correction autorized for AJCOR" UWORD _CNV_A_R_LINEAR_____181_CM 1 0. 0. 2047.96875 ECU_ADDRESS 0xd000485c FORMAT "%10.5" /end MEASUREMENT
/begin MEASUREMENT Vxx_ajs_cor_min_cor_dyn_spc "Specific minimum dynamic torque correction autorized for AJCOR" UWORD _CNV_A_R_LINEAR_____185_CM 1 0. -1024. 1023.96875 ECU_ADDRESS 0xd000485e FORMAT "%11.5" /end MEASUREMENT
/begin MEASUREMENT Vxx_ajs_cor_spc_rat "Specific ratio for AJCOR parameters interpolation" UWORD _CNV_A_R_LINEAR_____161_CM 1 0. 0. 1. ECU_ADDRESS 0xd0004860 FORMAT "%5.3" /end MEASUREMENT
/begin MEASUREMENT Vxx_ajs_cor_t1_acel_dt_clos_spc "Specific AJCOR time constant value calculated for vehicle acceleration when driveline is closed" UWORD _CNV_A_R_LINEAR_____116_CM 1 0. 0. 65.535 ECU_ADDRESS 0xd0004862 /end MEASUREMENT
/begin MEASUREMENT Vxx_ajs_cor_t1_decl_dt_clos_spc "Specific AJCOR time constant value calculated for vehicle deceleration when driveline is closed" UWORD _CNV_A_R_LINEAR_____116_CM 1 0. 0. 65.535 ECU_ADDRESS 0xd0004864 /end MEASUREMENT
/begin MEASUREMENT Vxx_ajs_cor_td_acel_dt_clos_spc "Specific AJCOR gain value calculated for vehicle acceleration when driveline is closed" UWORD _CNV_A_R_LINEAR_____459_CM 1 0. 0. 1. ECU_ADDRESS 0xd0004866 FORMAT "%5.3" /end MEASUREMENT
/begin MEASUREMENT Vxx_ajs_cor_td_decl_dt_clos_spc "Specific AJCOR gain value calculated for vehicle deceleration when driveline is closed" UWORD _CNV_A_R_LINEAR_____459_CM 1 0. 0. 1. ECU_ADDRESS 0xd0004868 FORMAT "%5.3" /end MEASUREMENT
/begin MEASUREMENT Vxx_ajs_cor_td_tq_fac_spc "Specific modulation factor of the AJCOR filter gain when driveline is closed" UWORD _CNV_A_R_LINEAR_____123_CM 1 0. 0. 100. ECU_ADDRESS 0xd000486a /end MEASUREMENT
/begin CHARACTERISTIC Cxx_ajs_cor_dz_dly_spc "Specific time delay of AJCOR dead zone" VALUE 0xa0021cda _REC_S1VAL_20_u1 25.5 _CNV_A_R_LINEAR_____58_CM 0. 25.5 FORMAT "%4.1" /end CHARACTERISTIC
/begin CHARACTERISTIC Cxx_ajs_cor_max_dyn_open_spc "Specific maximum dynamic torque correction autorized for AJCOR when driveline is open" VALUE 0xa0021cd6 _REC_S1VAL_20_s2 2047.96875 _CNV_A_R_LINEAR_____181_CM -1024. 1023.96875 FORMAT "%11.5" /end CHARACTERISTIC
/begin CHARACTERISTIC Cxx_ajs_cor_min_dyn_open_spc "Specific minimum dynamic torque correction autorized for AJCOR when driveline is open" VALUE 0xa0021cd8 _REC_S1VAL_20_s2 2047.96875 _CNV_A_R_LINEAR_____181_CM -1024. 1023.96875 FORMAT "%11.5" /end CHARACTERISTIC
/begin MEASUREMENT Vbx_cru_on_off_in "Input of the cruise control main switch" UBYTE _CNV_S_2_RANGE______3_CM 1 0. 0. 1. ECU_ADDRESS 0xd0006501 BIT_MASK 0x1 /end MEASUREMENT
/begin MEASUREMENT Vbx_eprm_rdy "The EEPROM is ready to be written" UBYTE _CNV_S_2_RANGE______3_CM 1 0. 0. 1. ECU_ADDRESS 0xd0006503 BIT_MASK 0x1 /end MEASUREMENT
/begin MEASUREMENT Vbx_sl_on_off_in "Input of the speed limiter main switch" UBYTE _CNV_S_2_RANGE______3_CM 1 0. 0. 1. ECU_ADDRESS 0xd0006502 BIT_MASK 0x1 /end MEASUREMENT
/begin MEASUREMENT Vxx_cru_sl_whl_cmd_in "Input of the cruise control and speed limiter steering wheel push buttons" UWORD _CNV_A_R_LINEAR_____107_CM 1 0. 0. 25000. ECU_ADDRESS 0xd0003ef2 FORMAT "%5.0" /end MEASUREMENT
/begin MEASUREMENT lv_cru_swi_on_off "Cruise control main switch (inverted or not)" UBYTE _CNV_S_2_RANGE______3_CM 1 0. 0. 1. ECU_ADDRESS 0xd00064fd /end MEASUREMENT
/begin MEASUREMENT lv_pin_cru_swi_on_off "Cruise control main switch" UBYTE _CNV_S_2_RANGE______3_CM 1 0. 0. 1. ECU_ADDRESS 0xd00064ff /end MEASUREMENT
/begin MEASUREMENT lv_pin_vvsl_swi_on_off "Speed limiter main switch" UBYTE _CNV_S_2_RANGE______3_CM 1 0. 0. 1. ECU_ADDRESS 0xd0006500 /end MEASUREMENT
/begin MEASUREMENT lv_vvsl_swi_on_off "Speed limiter main switch (inverted or not)" UBYTE _CNV_S_2_RANGE______3_CM 1 0. 0. 1. ECU_ADDRESS 0xd00064fe /end MEASUREMENT
/begin MEASUREMENT v_cru "Cruise control analog input" UWORD _CNV_A_R_LINEAR_____14_CM 1 0. 0. 4.99984741210938 ECU_ADDRESS 0xd0003ef0 FORMAT "%6.4" /end MEASUREMENT
/begin CHARACTERISTIC c_ctr_fil_asw "Filter Time for Cruise Control and Speed Limiter Logical Inputs" VALUE 0xa0020b34 _REC_S1VAL_20_u1 255. _CNV_A_R_LINEAR_____201_CM 0. 255. FORMAT "%3.0" /end CHARACTERISTIC
/begin CHARACTERISTIC lc_linp_conv_cru_swi "Switch if logical cruise controle main switch signal input should be inverted" VALUE 0xa0020b4d _REC_S1VAL_20_u1 1. _CNV_S_2_RANGE______3_CM 0. 1. /end CHARACTERISTIC
/begin CHARACTERISTIC lc_linp_conv_vvsl_swi "Switch if logical speed limiter main switch signal input should be inverted" VALUE 0xa0020b4e _REC_S1VAL_20_u1 1. _CNV_S_2_RANGE______3_CM 0. 1. /end CHARACTERISTIC
/begin MEASUREMENT Vtx_vin_crc_data[0] "Value of VIN and CRC data" UBYTE _CNV_A_R_A_105_CM 1 0. 0. 255. DISPLAY_IDENTIFIER DgDgtSer_0_NVM.Vtx_vin_crc_data_NVM[0] ECU_ADDRESS 0xd0007a30 /end MEASUREMENT
/begin MEASUREMENT Vtx_vin_crc_data[1] "Value of VIN and CRC data" UBYTE _CNV_A_R_A_105_CM 1 0. 0. 255. DISPLAY_IDENTIFIER DgDgtSer_0_NVM.Vtx_vin_crc_data_NVM[1] ECU_ADDRESS 0xd0007a31 /end MEASUREMENT
/begin MEASUREMENT Vtx_vin_crc_data[2] "Value of VIN and CRC data" UBYTE _CNV_A_R_A_105_CM 1 0. 0. 255. DISPLAY_IDENTIFIER DgDgtSer_0_NVM.Vtx_vin_crc_data_NVM[2] ECU_ADDRESS 0xd0007a32 /end MEASUREMENT
/begin MEASUREMENT Vtx_vin_crc_data[3] "Value of VIN and CRC data" UBYTE _CNV_A_R_A_105_CM 1 0. 0. 255. DISPLAY_IDENTIFIER DgDgtSer_0_NVM.Vtx_vin_crc_data_NVM[3] ECU_ADDRESS 0xd0007a33 /end MEASUREMENT
/begin MEASUREMENT Vtx_vin_crc_data[4] "Value of VIN and CRC data" UBYTE _CNV_A_R_A_105_CM 1 0. 0. 255. DISPLAY_IDENTIFIER DgDgtSer_0_NVM.Vtx_vin_crc_data_NVM[4] ECU_ADDRESS 0xd0007a34 /end MEASUREMENT
/begin MEASUREMENT Vtx_vin_crc_data[5] "Value of VIN and CRC data" UBYTE _CNV_A_R_A_105_CM 1 0. 0. 255. DISPLAY_IDENTIFIER DgDgtSer_0_NVM.Vtx_vin_crc_data_NVM[5] ECU_ADDRESS 0xd0007a35 /end MEASUREMENT
/begin MEASUREMENT Vtx_vin_crc_data[6] "Value of VIN and CRC data" UBYTE _CNV_A_R_A_105_CM 1 0. 0. 255. DISPLAY_IDENTIFIER DgDgtSer_0_NVM.Vtx_vin_crc_data_NVM[6] ECU_ADDRESS 0xd0007a36 /end MEASUREMENT
/begin MEASUREMENT Vtx_vin_crc_data[7] "Value of VIN and CRC data" UBYTE _CNV_A_R_A_105_CM 1 0. 0. 255. DISPLAY_IDENTIFIER DgDgtSer_0_NVM.Vtx_vin_crc_data_NVM[7] ECU_ADDRESS 0xd0007a37 /end MEASUREMENT
/begin MEASUREMENT Vtx_vin_crc_data[8] "Value of VIN and CRC data" UBYTE _CNV_A_R_A_105_CM 1 0. 0. 255. DISPLAY_IDENTIFIER DgDgtSer_0_NVM.Vtx_vin_crc_data_NVM[8] ECU_ADDRESS 0xd0007a38 /end MEASUREMENT
/begin MEASUREMENT Vtx_vin_crc_data[9] "Value of VIN and CRC data" UBYTE _CNV_A_R_A_105_CM 1 0. 0. 255. DISPLAY_IDENTIFIER DgDgtSer_0_NVM.Vtx_vin_crc_data_NVM[9] ECU_ADDRESS 0xd0007a39 /end MEASUREMENT
/begin MEASUREMENT Vtx_vin_crc_data[10] "Value of VIN and CRC data" UBYTE _CNV_A_R_A_105_CM 1 0. 0. 255. DISPLAY_IDENTIFIER DgDgtSer_0_NVM.Vtx_vin_crc_data_NVM[10] ECU_ADDRESS 0xd0007a3a /end MEASUREMENT
/begin MEASUREMENT Vtx_vin_crc_data[11] "Value of VIN and CRC data" UBYTE _CNV_A_R_A_105_CM 1 0. 0. 255. DISPLAY_IDENTIFIER DgDgtSer_0_NVM.Vtx_vin_crc_data_NVM[11] ECU_ADDRESS 0xd0007a3b /end MEASUREMENT
/begin MEASUREMENT Vtx_vin_crc_data[12] "Value of VIN and CRC data" UBYTE _CNV_A_R_A_105_CM 1 0. 0. 255. DISPLAY_IDENTIFIER DgDgtSer_0_NVM.Vtx_vin_crc_data_NVM[12] ECU_ADDRESS 0xd0007a3c /end MEASUREMENT
/begin MEASUREMENT Vtx_vin_crc_data[13] "Value of VIN and CRC data" UBYTE _CNV_A_R_A_105_CM 1 0. 0. 255. DISPLAY_IDENTIFIER DgDgtSer_0_NVM.Vtx_vin_crc_data_NVM[13] ECU_ADDRESS 0xd0007a3d /end MEASUREMENT
/begin MEASUREMENT Vtx_vin_crc_data[14] "Value of VIN and CRC data" UBYTE _CNV_A_R_A_105_CM 1 0. 0. 255. DISPLAY_IDENTIFIER DgDgtSer_0_NVM.Vtx_vin_crc_data_NVM[14] ECU_ADDRESS 0xd0007a3e /end MEASUREMENT
/begin MEASUREMENT Vtx_vin_crc_data[15] "Value of VIN and CRC data" UBYTE _CNV_A_R_A_105_CM 1 0. 0. 255. DISPLAY_IDENTIFIER DgDgtSer_0_NVM.Vtx_vin_crc_data_NVM[15] ECU_ADDRESS 0xd0007a3f /end MEASUREMENT
/begin MEASUREMENT Vtx_vin_crc_data[16] "Value of VIN and CRC data" UBYTE _CNV_A_R_A_105_CM 1 0. 0. 255. DISPLAY_IDENTIFIER DgDgtSer_0_NVM.Vtx_vin_crc_data_NVM[16] ECU_ADDRESS 0xd0007a40 /end MEASUREMENT
/begin MEASUREMENT Vtx_vin_crc_data[17] "Value of VIN and CRC data" UBYTE _CNV_A_R_A_105_CM 1 0. 0. 255. DISPLAY_IDENTIFIER DgDgtSer_0_NVM.Vtx_vin_crc_data_NVM[17] ECU_ADDRESS 0xd0007a41 /end MEASUREMENT
/begin MEASUREMENT Vtx_vin_crc_data[18] "Value of VIN and CRC data" UBYTE _CNV_A_R_A_105_CM 1 0. 0. 255. DISPLAY_IDENTIFIER DgDgtSer_0_NVM.Vtx_vin_crc_data_NVM[18] ECU_ADDRESS 0xd0007a42 /end MEASUREMENT
/begin MEASUREMENT Vsx_diag_sess "Diagnostic session table" UBYTE _CNV_A_R_ECME_LINEA_0_CM 1 0. 0. 255. ECU_ADDRESS 0xd000239d FORMAT "%3.0" /end MEASUREMENT
/begin CHARACTERISTIC Cbx_fail_dft_ini_req "Clear diagnostics information request" VALUE 0xa00211ea _REC_S1VAL_20_u1 1. _CNV_S_2_RANGE______3_CM 0. 1. /end CHARACTERISTIC
/begin CHARACTERISTIC Ctx_vin_crc_ini_data[0] "Calibration value of VIN and CRC data" VALUE 0xa002b78c _REC_S1VAL_20_u1 255. _CNV_A_R_ECME_LINEA_0_CM 0. 255. FORMAT "%1.0" /end CHARACTERISTIC
/begin CHARACTERISTIC Ctx_vin_crc_ini_data[1] "Calibration value of VIN and CRC data" VALUE 0xa002b78d _REC_S1VAL_20_u1 255. _CNV_A_R_ECME_LINEA_0_CM 0. 255. FORMAT "%1.0" /end CHARACTERISTIC
/begin CHARACTERISTIC Ctx_vin_crc_ini_data[2] "Calibration value of VIN and CRC data" VALUE 0xa002b78e _REC_S1VAL_20_u1 255. _CNV_A_R_ECME_LINEA_0_CM 0. 255. FORMAT "%1.0" /end CHARACTERISTIC
/begin CHARACTERISTIC Ctx_vin_crc_ini_data[3] "Calibration value of VIN and CRC data" VALUE 0xa002b78f _REC_S1VAL_20_u1 255. _CNV_A_R_ECME_LINEA_0_CM 0. 255. FORMAT "%1.0" /end CHARACTERISTIC
/begin CHARACTERISTIC Ctx_vin_crc_ini_data[4] "Calibration value of VIN and CRC data" VALUE 0xa002b790 _REC_S1VAL_20_u1 255. _CNV_A_R_ECME_LINEA_0_CM 0. 255. FORMAT "%1.0" /end CHARACTERISTIC
/begin CHARACTERISTIC Ctx_vin_crc_ini_data[5] "Calibration value of VIN and CRC data" VALUE 0xa002b791 _REC_S1VAL_20_u1 255. _CNV_A_R_ECME_LINEA_0_CM 0. 255. FORMAT "%1.0" /end CHARACTERISTIC
/begin CHARACTERISTIC Ctx_vin_crc_ini_data[6] "Calibration value of VIN and CRC data" VALUE 0xa002b792 _REC_S1VAL_20_u1 255. _CNV_A_R_ECME_LINEA_0_CM 0. 255. FORMAT "%1.0" /end CHARACTERISTIC
/begin CHARACTERISTIC Ctx_vin_crc_ini_data[7] "Calibration value of VIN and CRC data" VALUE 0xa002b793 _REC_S1VAL_20_u1 255. _CNV_A_R_ECME_LINEA_0_CM 0. 255. FORMAT "%1.0" /end CHARACTERISTIC
/begin CHARACTERISTIC Ctx_vin_crc_ini_data[8] "Calibration value of VIN and CRC data" VALUE 0xa002b794 _REC_S1VAL_20_u1 255. _CNV_A_R_ECME_LINEA_0_CM 0. 255. FORMAT "%1.0" /end CHARACTERISTIC
/begin CHARACTERISTIC Ctx_vin_crc_ini_data[9] "Calibration value of VIN and CRC data" VALUE 0xa002b795 _REC_S1VAL_20_u1 255. _CNV_A_R_ECME_LINEA_0_CM 0. 255. FORMAT "%1.0" /end CHARACTERISTIC
/begin CHARACTERISTIC Ctx_vin_crc_ini_data[10] "Calibration value of VIN and CRC data" VALUE 0xa002b796 _REC_S1VAL_20_u1 255. _CNV_A_R_ECME_LINEA_0_CM 0. 255. FORMAT "%1.0" /end CHARACTERISTIC
/begin CHARACTERISTIC Ctx_vin_crc_ini_data[11] "Calibration value of VIN and CRC data" VALUE 0xa002b797 _REC_S1VAL_20_u1 255. _CNV_A_R_ECME_LINEA_0_CM 0. 255. FORMAT "%1.0" /end CHARACTERISTIC
/begin CHARACTERISTIC Ctx_vin_crc_ini_data[12] "Calibration value of VIN and CRC data" VALUE 0xa002b798 _REC_S1VAL_20_u1 255. _CNV_A_R_ECME_LINEA_0_CM 0. 255. FORMAT "%1.0" /end CHARACTERISTIC
/begin CHARACTERISTIC Ctx_vin_crc_ini_data[13] "Calibration value of VIN and CRC data" VALUE 0xa002b799 _REC_S1VAL_20_u1 255. _CNV_A_R_ECME_LINEA_0_CM 0. 255. FORMAT "%1.0" /end CHARACTERISTIC
/begin CHARACTERISTIC Ctx_vin_crc_ini_data[14] "Calibration value of VIN and CRC data" VALUE 0xa002b79a _REC_S1VAL_20_u1 255. _CNV_A_R_ECME_LINEA_0_CM 0. 255. FORMAT "%1.0" /end CHARACTERISTIC
/begin CHARACTERISTIC Ctx_vin_crc_ini_data[15] "Calibration value of VIN and CRC data" VALUE 0xa002b79b _REC_S1VAL_20_u1 255. _CNV_A_R_ECME_LINEA_0_CM 0. 255. FORMAT "%1.0" /end CHARACTERISTIC
/begin CHARACTERISTIC Ctx_vin_crc_ini_data[16] "Calibration value of VIN and CRC data" VALUE 0xa002b79c _REC_S1VAL_20_u1 255. _CNV_A_R_ECME_LINEA_0_CM 0. 255. FORMAT "%1.0" /end CHARACTERISTIC
/begin CHARACTERISTIC Ctx_vin_crc_ini_data[17] "Calibration value of VIN and CRC data" VALUE 0xa002b79d _REC_S1VAL_20_u1 255. _CNV_A_R_ECME_LINEA_0_CM 0. 255. FORMAT "%1.0" /end CHARACTERISTIC
/begin CHARACTERISTIC Ctx_vin_crc_ini_data[18] "Calibration value of VIN and CRC data" VALUE 0xa002b79e _REC_S1VAL_20_u1 255. _CNV_A_R_ECME_LINEA_0_CM 0. 255. FORMAT "%1.0" /end CHARACTERISTIC
/begin CHARACTERISTIC Cxx_c_nr1 "Calibration number (byte 0)" VALUE 0xa00211eb _REC_S1VAL_20_u1 255. _CNV_A_R_ECME_LINEA_0_CM 0. 255. FORMAT "%3.0" /end CHARACTERISTIC
/begin CHARACTERISTIC Cxx_c_nr2 "Calibration number (byte 1)" VALUE 0xa00211ec _REC_S1VAL_20_u1 255. _CNV_A_R_ECME_LINEA_0_CM 0. 255. FORMAT "%3.0" /end CHARACTERISTIC
/begin CHARACTERISTIC Cxx_cert_id "Approval Number basic part list" VALUE 0xa00211ed _REC_S1VAL_20_u1 255. _CNV_A_R_ECME_LINEA_0_CM 0. 255. FORMAT "%3.0" /end CHARACTERISTIC
/begin CHARACTERISTIC Cxx_diag_nr "Diagnostic identification code" VALUE 0xa00211ee _REC_S1VAL_20_u1 255. _CNV_A_R_ECME_LINEA_0_CM 0. 255. FORMAT "%3.0" /end CHARACTERISTIC
/begin CHARACTERISTIC Cxx_ecu_nr1 "PartNumber.LowerPart (byte 0)" VALUE 0xa00211ef _REC_S1VAL_20_u1 255. _CNV_A_R_ECME_LINEA_0_CM 0. 255. FORMAT "%3.0" /end CHARACTERISTIC
/begin CHARACTERISTIC Cxx_ecu_nr2 "PartNumber.LowerPart (byte 1)" VALUE 0xa00211f0 _REC_S1VAL_20_u1 255. _CNV_A_R_ECME_LINEA_0_CM 0. 255. FORMAT "%3.0" /end CHARACTERISTIC
/begin CHARACTERISTIC Cxx_ecu_nr3 "PartNumber.LowerPart (byte 2)" VALUE 0xa00211f1 _REC_S1VAL_20_u1 255. _CNV_A_R_ECME_LINEA_0_CM 0. 255. FORMAT "%3.0" /end CHARACTERISTIC
/begin CHARACTERISTIC Cxx_ecu_nr4 "PartNumber.LowerPart (byte 3)" VALUE 0xa00211f2 _REC_S1VAL_20_u1 255. _CNV_A_R_ECME_LINEA_0_CM 0. 255. FORMAT "%3.0" /end CHARACTERISTIC
/begin CHARACTERISTIC Cxx_ecu_nr5 "PartNumber.LowerPart (byte 4)" VALUE 0xa00211f3 _REC_S1VAL_20_u1 255. _CNV_A_R_ECME_LINEA_0_CM 0. 255. FORMAT "%3.0" /end CHARACTERISTIC
/begin CHARACTERISTIC Cxx_etun_nr "Other system features" VALUE 0xa00211f4 _REC_S1VAL_20_u1 255. _CNV_A_R_ECME_LINEA_0_CM 0. 255. FORMAT "%3.0" /end CHARACTERISTIC
/begin CHARACTERISTIC Cxx_oem_id "Car manufacturer identification code" VALUE 0xa00211f5 _REC_S1VAL_20_u1 255. _CNV_A_R_ECME_LINEA_0_CM 0. 255. FORMAT "%3.0" /end CHARACTERISTIC
/begin CHARACTERISTIC Cxx_prog_nr1 "Software number (byte 0)" VALUE 0xa00211f6 _REC_S1VAL_20_u1 255. _CNV_A_R_ECME_LINEA_0_CM 0. 255. FORMAT "%3.0" /end CHARACTERISTIC
/begin CHARACTERISTIC Cxx_prog_nr2 "Software number (byte 1)" VALUE 0xa00211f7 _REC_S1VAL_20_u1 255. _CNV_A_R_ECME_LINEA_0_CM 0. 255. FORMAT "%3.0" /end CHARACTERISTIC
/begin CHARACTERISTIC Cxx_rsa_did_lim_val_cfm "Limit identifier of RSA DID part" VALUE 0xa00211e8 _REC_S1VAL_20_u2 65535. _CNV_A_R_ECME_LINEA_0_CM 0. 65535. FORMAT "%5.0" /end CHARACTERISTIC
/begin CHARACTERISTIC Cxx_supl_nr1 "Supplier number (byte 0)" VALUE 0xa00211f8 _REC_S1VAL_20_u1 255. _CNV_A_R_ECME_LINEA_0_CM 0. 255. FORMAT "%3.0" /end CHARACTERISTIC
/begin CHARACTERISTIC Cxx_supl_nr2 "Supplier number (byte 1)" VALUE 0xa00211f9 _REC_S1VAL_20_u1 255. _CNV_A_R_ECME_LINEA_0_CM 0. 255. FORMAT "%3.0" /end CHARACTERISTIC
/begin CHARACTERISTIC Cxx_supl_nr3 "Supplier number (byte 2)" VALUE 0xa00211fa _REC_S1VAL_20_u1 255. _CNV_A_R_ECME_LINEA_0_CM 0. 255. FORMAT "%3.0" /end CHARACTERISTIC
/begin CHARACTERISTIC Cxx_sys_c_nr "Other system features" VALUE 0xa00211fb _REC_S1VAL_20_u1 255. _CNV_A_R_ECME_LINEA_0_CM 0. 255. FORMAT "%3.0" /end CHARACTERISTIC
/begin CHARACTERISTIC Cxx_vers_nr1 "Edition number (byte 0)" VALUE 0xa00211fc _REC_S1VAL_20_u1 255. _CNV_A_R_ECME_LINEA_0_CM 0. 255. FORMAT "%3.0" /end CHARACTERISTIC
/begin CHARACTERISTIC Cxx_vers_nr2 "Edition number (byte 1)" VALUE 0xa00211fd _REC_S1VAL_20_u1 255. _CNV_A_R_ECME_LINEA_0_CM 0. 255. FORMAT "%3.0" /end CHARACTERISTIC
/begin CHARACTERISTIC Cbx_obd_fail_dft_ini_req "Initialisation request of OBD data." VALUE 0xa00211fe _REC_S1VAL_20_u1 1. _CNV_S_2_RANGE______3_CM 0. 1. /end CHARACTERISTIC
/begin MEASUREMENT Vxx_fsl_km_NVM "Mileage recording" ULONG _CNV_A_R_LINEAR_____461_CM 1 0. 0. 16000000. DISPLAY_IDENTIFIER PcCruSpt_NVM.Vxx_fsl_km_NVM ECU_ADDRESS 0xd00029a4 FORMAT "%10.1" /end MEASUREMENT
/begin MEASUREMENT Sxx_cru_dgn_eprm_imd_writ_ctr "Indicates the number of write-on-the-flight in EEPROM" ULONG _CNV_A_R_ECME_LINEA_0_CM 1 0. 0. 16777215. DISPLAY_IDENTIFIER PcCruSpt_NVM.Sxx_cru_dgn_eprm_imd_writ_ctr_NVM ECU_ADDRESS 0xd00029a8 FORMAT "%8.0" /end MEASUREMENT
/begin MEASUREMENT Vxx_max_vs_NVM "Dynamic requested speed for FSL as read in EEPROM(default value $FFFE)." UWORD _CNV_A_R_LINEAR_____125_CM 1 0. 0. 655.35 DISPLAY_IDENTIFIER PcCruSpt_NVM.Vxx_max_vs_NVM ECU_ADDRESS 0xd00029ac FORMAT "%6.2" /end MEASUREMENT
/begin MEASUREMENT Vxx_cru_fail_NVM "Carrier of all the failures which cause CC failure" UBYTE _CNV_A_R_ECME_LINEA_0_CM 1 0. 0. 255. DISPLAY_IDENTIFIER PcCruSpt_NVM.Vxx_cru_fail_NVM ECU_ADDRESS 0xd00029ae FORMAT "%3.0" /end MEASUREMENT
/begin MEASUREMENT Vxx_cru_sl_fail_NVM "Carrier of all the failures which cause CC/SL failure" UBYTE _CNV_A_R_ECME_LINEA_0_CM 1 0. 0. 255. DISPLAY_IDENTIFIER PcCruSpt_NVM.Vxx_cru_sl_fail_NVM ECU_ADDRESS 0xd00029af FORMAT "%3.0" /end MEASUREMENT
/begin MEASUREMENT Vxx_cru_sl_dacn_sys_NVM "Compilation of all the cru/sl normal deactivations due to system causes. Saved in E²PROM." UBYTE _CNV_A_R_ECME_LINEA_0_CM 1 0. 0. 255. DISPLAY_IDENTIFIER PcCruSpt_NVM.Vxx_cru_sl_dacn_sys_NVM ECU_ADDRESS 0xd00029b0 FORMAT "%3.0" /end MEASUREMENT
/begin MEASUREMENT Vbx_sli_buf_sf_NVM "1 = The 4 buffers (Sxx_sli_brk_buf, Sxx_sli_clu_buf, Sxx_sli_cru_stt_buf and Sxx_sli_vs_buf) correspond to the last shut off / 0 = the" UBYTE _CNV_S_2_RANGE______3_CM 1 0. 0. 1. DISPLAY_IDENTIFIER PcCruSpt_NVM.Vbx_sli_buf_sf_NVM ECU_ADDRESS 0xd00029b1 BIT_MASK 0x1 /end MEASUREMENT
/begin MEASUREMENT Sxx_sli_brk_buf_NVM "Buffer of the 16 last seconds of the brake status stored in EEPROM" UWORD _CNV_A_R_ECME_LINEA_0_CM 1 0. 0. 65535. DISPLAY_IDENTIFIER PcCruSpt_RVLV2_NVM.Sxx_sli_brk_buf_NVM ECU_ADDRESS 0xd00029b4 FORMAT "%5.0" /end MEASUREMENT
/begin MEASUREMENT Sxx_sli_clu_buf_NVM "Buffer of the 16 last seconds of the clutch status stored in EEPROM" UWORD _CNV_A_R_ECME_LINEA_0_CM 1 0. 0. 65535. DISPLAY_IDENTIFIER PcCruSpt_RVLV2_NVM.Sxx_sli_clu_buf_NVM ECU_ADDRESS 0xd00029b6 FORMAT "%5.0" /end MEASUREMENT
/begin MEASUREMENT Sxx_sli_cru_stt_buf_NVM "Buffer of the 16 last seconds of the cruise control status stored in EEPROM" UWORD _CNV_A_R_ECME_LINEA_0_CM 1 0. 0. 65535. DISPLAY_IDENTIFIER PcCruSpt_RVLV2_NVM.Sxx_sli_cru_stt_buf_NVM ECU_ADDRESS 0xd00029b8 FORMAT "%5.0" /end MEASUREMENT
/begin MEASUREMENT Sxx_sli_vs_buf[0] "Buffer of the 16 last seconds of the vehicle speed stored in EEPROM" UBYTE _CNV_A_R_ECME_LINEA_0_CM 1 0. 0. 255. DISPLAY_IDENTIFIER PcCruSpt_RVLV2_NVM.Sxx_sli_vs_buf_NVM[0] ECU_ADDRESS 0xd00029bc FORMAT "%3.0" /end MEASUREMENT
/begin MEASUREMENT Sxx_sli_vs_buf[1] "Buffer of the 16 last seconds of the vehicle speed stored in EEPROM" UBYTE _CNV_A_R_ECME_LINEA_0_CM 1 0. 0. 255. DISPLAY_IDENTIFIER PcCruSpt_RVLV2_NVM.Sxx_sli_vs_buf_NVM[1] ECU_ADDRESS 0xd00029bd FORMAT "%3.0" /end MEASUREMENT
/begin MEASUREMENT Sxx_sli_vs_buf[2] "Buffer of the 16 last seconds of the vehicle speed stored in EEPROM" UBYTE _CNV_A_R_ECME_LINEA_0_CM 1 0. 0. 255. DISPLAY_IDENTIFIER PcCruSpt_RVLV2_NVM.Sxx_sli_vs_buf_NVM[2] ECU_ADDRESS 0xd00029be FORMAT "%3.0" /end MEASUREMENT
/begin MEASUREMENT Sxx_sli_vs_buf[3] "Buffer of the 16 last seconds of the vehicle speed stored in EEPROM" UBYTE _CNV_A_R_ECME_LINEA_0_CM 1 0. 0. 255. DISPLAY_IDENTIFIER PcCruSpt_RVLV2_NVM.Sxx_sli_vs_buf_NVM[3] ECU_ADDRESS 0xd00029bf FORMAT "%3.0" /end MEASUREMENT
/begin MEASUREMENT Sxx_sli_vs_buf[4] "Buffer of the 16 last seconds of the vehicle speed stored in EEPROM" UBYTE _CNV_A_R_ECME_LINEA_0_CM 1 0. 0. 255. DISPLAY_IDENTIFIER PcCruSpt_RVLV2_NVM.Sxx_sli_vs_buf_NVM[4] ECU_ADDRESS 0xd00029c0 FORMAT "%3.0" /end MEASUREMENT
/begin MEASUREMENT Sxx_sli_vs_buf[5] "Buffer of the 16 last seconds of the vehicle speed stored in EEPROM" UBYTE _CNV_A_R_ECME_LINEA_0_CM 1 0. 0. 255. DISPLAY_IDENTIFIER PcCruSpt_RVLV2_NVM.Sxx_sli_vs_buf_NVM[5] ECU_ADDRESS 0xd00029c1 FORMAT "%3.0" /end MEASUREMENT
/begin MEASUREMENT Sxx_sli_vs_buf[6] "Buffer of the 16 last seconds of the vehicle speed stored in EEPROM" UBYTE _CNV_A_R_ECME_LINEA_0_CM 1 0. 0. 255. DISPLAY_IDENTIFIER PcCruSpt_RVLV2_NVM.Sxx_sli_vs_buf_NVM[6] ECU_ADDRESS 0xd00029c2 FORMAT "%3.0" /end MEASUREMENT
/begin MEASUREMENT Sxx_sli_vs_buf[7] "Buffer of the 16 last seconds of the vehicle speed stored in EEPROM" UBYTE _CNV_A_R_ECME_LINEA_0_CM 1 0. 0. 255. DISPLAY_IDENTIFIER PcCruSpt_RVLV2_NVM.Sxx_sli_vs_buf_NVM[7] ECU_ADDRESS 0xd00029c3 FORMAT "%3.0" /end MEASUREMENT
/begin MEASUREMENT Sxx_sli_vs_buf[8] "Buffer of the 16 last seconds of the vehicle speed stored in EEPROM" UBYTE _CNV_A_R_ECME_LINEA_0_CM 1 0. 0. 255. DISPLAY_IDENTIFIER PcCruSpt_RVLV2_NVM.Sxx_sli_vs_buf_NVM[8] ECU_ADDRESS 0xd00029c4 FORMAT "%3.0" /end MEASUREMENT
/begin MEASUREMENT Sxx_sli_vs_buf[9] "Buffer of the 16 last seconds of the vehicle speed stored in EEPROM" UBYTE _CNV_A_R_ECME_LINEA_0_CM 1 0. 0. 255. DISPLAY_IDENTIFIER PcCruSpt_RVLV2_NVM.Sxx_sli_vs_buf_NVM[9] ECU_ADDRESS 0xd00029c5 FORMAT "%3.0" /end MEASUREMENT
/begin MEASUREMENT Sxx_sli_vs_buf[10] "Buffer of the 16 last seconds of the vehicle speed stored in EEPROM" UBYTE _CNV_A_R_ECME_LINEA_0_CM 1 0. 0. 255. DISPLAY_IDENTIFIER PcCruSpt_RVLV2_NVM.Sxx_sli_vs_buf_NVM[10] ECU_ADDRESS 0xd00029c6 FORMAT "%3.0" /end MEASUREMENT
/begin MEASUREMENT Sxx_sli_vs_buf[11] "Buffer of the 16 last seconds of the vehicle speed stored in EEPROM" UBYTE _CNV_A_R_ECME_LINEA_0_CM 1 0. 0. 255. DISPLAY_IDENTIFIER PcCruSpt_RVLV2_NVM.Sxx_sli_vs_buf_NVM[11] ECU_ADDRESS 0xd00029c7 FORMAT "%3.0" /end MEASUREMENT
/begin MEASUREMENT Sxx_sli_vs_buf[12] "Buffer of the 16 last seconds of the vehicle speed stored in EEPROM" UBYTE _CNV_A_R_ECME_LINEA_0_CM 1 0. 0. 255. DISPLAY_IDENTIFIER PcCruSpt_RVLV2_NVM.Sxx_sli_vs_buf_NVM[12] ECU_ADDRESS 0xd00029c8 FORMAT "%3.0" /end MEASUREMENT
/begin MEASUREMENT Sxx_sli_vs_buf[13] "Buffer of the 16 last seconds of the vehicle speed stored in EEPROM" UBYTE _CNV_A_R_ECME_LINEA_0_CM 1 0. 0. 255. DISPLAY_IDENTIFIER PcCruSpt_RVLV2_NVM.Sxx_sli_vs_buf_NVM[13] ECU_ADDRESS 0xd00029c9 FORMAT "%3.0" /end MEASUREMENT
/begin MEASUREMENT Sxx_sli_vs_buf[14] "Buffer of the 16 last seconds of the vehicle speed stored in EEPROM" UBYTE _CNV_A_R_ECME_LINEA_0_CM 1 0. 0. 255. DISPLAY_IDENTIFIER PcCruSpt_RVLV2_NVM.Sxx_sli_vs_buf_NVM[14] ECU_ADDRESS 0xd00029ca FORMAT "%3.0" /end MEASUREMENT
/begin MEASUREMENT Sxx_sli_vs_buf[15] "Buffer of the 16 last seconds of the vehicle speed stored in EEPROM" UBYTE _CNV_A_R_ECME_LINEA_0_CM 1 0. 0. 255. DISPLAY_IDENTIFIER PcCruSpt_RVLV2_NVM.Sxx_sli_vs_buf_NVM[15] ECU_ADDRESS 0xd00029cb FORMAT "%3.0" /end MEASUREMENT
/begin MEASUREMENT Vxx_crsh_dly_ctr_NVM "Last shut off / activation -- crash duration counter" UBYTE _CNV_A_R_LINEAR_____68_CM 1 0. 0. 255. DISPLAY_IDENTIFIER PcCruSpt_RVLV2_NVM.Vxx_crsh_dly_ctr_NVM ECU_ADDRESS 0xd00029cc FORMAT "%3.0" /end MEASUREMENT
/begin MEASUREMENT Vxx_cru_dgn_diag_NVM "Carrier of information about the diag add on" UBYTE _CNV_A_R_ECME_LINEA_0_CM 1 0. 0. 255. DISPLAY_IDENTIFIER PcCruSpt_RVLV2_NVM.Vxx_cru_dgn_diag_NVM ECU_ADDRESS 0xd00029cd FORMAT "%3.0" /end MEASUREMENT
/begin MEASUREMENT Vbx_crsh_end_rec_eprm_NVM "A crash occured and the diagnostic add-on strategy is frozen" UBYTE _CNV_S_2_RANGE______3_CM 1 0. 0. 1. DISPLAY_IDENTIFIER PcCruSpt_RVLV2_NVM.Vbx_crsh_end_rec_eprm_NVM ECU_ADDRESS 0xd00029ce BIT_MASK 0x1 /end MEASUREMENT
/begin MEASUREMENT Sxx_cru_dist_buf[0] "Buffer of the 20 last mileages associated to an activation or shut off" ULONG _CNV_A_R_LINEAR_____274_CM 1 0. 0. 16777215. DISPLAY_IDENTIFIER PcCruSpt_RVLV_NVM.Sxx_cru_dist_buf_NVM[0] ECU_ADDRESS 0xd00029d0 FORMAT "%8.0" /end MEASUREMENT
/begin MEASUREMENT Sxx_cru_dist_buf[1] "Buffer of the 20 last mileages associated to an activation or shut off" ULONG _CNV_A_R_LINEAR_____274_CM 1 0. 0. 16777215. DISPLAY_IDENTIFIER PcCruSpt_RVLV_NVM.Sxx_cru_dist_buf_NVM[1] ECU_ADDRESS 0xd00029d4 FORMAT "%8.0" /end MEASUREMENT
/begin MEASUREMENT Sxx_cru_dist_buf[2] "Buffer of the 20 last mileages associated to an activation or shut off" ULONG _CNV_A_R_LINEAR_____274_CM 1 0. 0. 16777215. DISPLAY_IDENTIFIER PcCruSpt_RVLV_NVM.Sxx_cru_dist_buf_NVM[2] ECU_ADDRESS 0xd00029d8 FORMAT "%8.0" /end MEASUREMENT
/begin MEASUREMENT Sxx_cru_dist_buf[3] "Buffer of the 20 last mileages associated to an activation or shut off" ULONG _CNV_A_R_LINEAR_____274_CM 1 0. 0. 16777215. DISPLAY_IDENTIFIER PcCruSpt_RVLV_NVM.Sxx_cru_dist_buf_NVM[3] ECU_ADDRESS 0xd00029dc FORMAT "%8.0" /end MEASUREMENT
/begin MEASUREMENT Sxx_cru_dist_buf[4] "Buffer of the 20 last mileages associated to an activation or shut off" ULONG _CNV_A_R_LINEAR_____274_CM 1 0. 0. 16777215. DISPLAY_IDENTIFIER PcCruSpt_RVLV_NVM.Sxx_cru_dist_buf_NVM[4] ECU_ADDRESS 0xd00029e0 FORMAT "%8.0" /end MEASUREMENT
/begin MEASUREMENT Sxx_cru_dist_buf[5] "Buffer of the 20 last mileages associated to an activation or shut off" ULONG _CNV_A_R_LINEAR_____274_CM 1 0. 0. 16777215. DISPLAY_IDENTIFIER PcCruSpt_RVLV_NVM.Sxx_cru_dist_buf_NVM[5] ECU_ADDRESS 0xd00029e4 FORMAT "%8.0" /end MEASUREMENT
/begin MEASUREMENT Sxx_cru_dist_buf[6] "Buffer of the 20 last mileages associated to an activation or shut off" ULONG _CNV_A_R_LINEAR_____274_CM 1 0. 0. 16777215. DISPLAY_IDENTIFIER PcCruSpt_RVLV_NVM.Sxx_cru_dist_buf_NVM[6] ECU_ADDRESS 0xd00029e8 FORMAT "%8.0" /end MEASUREMENT
/begin MEASUREMENT Sxx_cru_dist_buf[7] "Buffer of the 20 last mileages associated to an activation or shut off" ULONG _CNV_A_R_LINEAR_____274_CM 1 0. 0. 16777215. DISPLAY_IDENTIFIER PcCruSpt_RVLV_NVM.Sxx_cru_dist_buf_NVM[7] ECU_ADDRESS 0xd00029ec FORMAT "%8.0" /end MEASUREMENT
/begin MEASUREMENT Sxx_cru_dist_buf[8] "Buffer of the 20 last mileages associated to an activation or shut off" ULONG _CNV_A_R_LINEAR_____274_CM 1 0. 0. 16777215. DISPLAY_IDENTIFIER PcCruSpt_RVLV_NVM.Sxx_cru_dist_buf_NVM[8] ECU_ADDRESS 0xd00029f0 FORMAT "%8.0" /end MEASUREMENT
/begin MEASUREMENT Sxx_cru_dist_buf[9] "Buffer of the 20 last mileages associated to an activation or shut off" ULONG _CNV_A_R_LINEAR_____274_CM 1 0. 0. 16777215. DISPLAY_IDENTIFIER PcCruSpt_RVLV_NVM.Sxx_cru_dist_buf_NVM[9] ECU_ADDRESS 0xd00029f4 FORMAT "%8.0" /end MEASUREMENT
/begin MEASUREMENT Sxx_cru_dist_buf[10] "Buffer of the 20 last mileages associated to an activation or shut off" ULONG _CNV_A_R_LINEAR_____274_CM 1 0. 0. 16777215. DISPLAY_IDENTIFIER PcCruSpt_RVLV_NVM.Sxx_cru_dist_buf_NVM[10] ECU_ADDRESS 0xd00029f8 FORMAT "%8.0" /end MEASUREMENT
/begin MEASUREMENT Sxx_cru_dist_buf[11] "Buffer of the 20 last mileages associated to an activation or shut off" ULONG _CNV_A_R_LINEAR_____274_CM 1 0. 0. 16777215. DISPLAY_IDENTIFIER PcCruSpt_RVLV_NVM.Sxx_cru_dist_buf_NVM[11] ECU_ADDRESS 0xd00029fc FORMAT "%8.0" /end MEASUREMENT
/begin MEASUREMENT Sxx_cru_dist_buf[12] "Buffer of the 20 last mileages associated to an activation or shut off" ULONG _CNV_A_R_LINEAR_____274_CM 1 0. 0. 16777215. DISPLAY_IDENTIFIER PcCruSpt_RVLV_NVM.Sxx_cru_dist_buf_NVM[12] ECU_ADDRESS 0xd0002a00 FORMAT "%8.0" /end MEASUREMENT
/begin MEASUREMENT Sxx_cru_dist_buf[13] "Buffer of the 20 last mileages associated to an activation or shut off" ULONG _CNV_A_R_LINEAR_____274_CM 1 0. 0. 16777215. DISPLAY_IDENTIFIER PcCruSpt_RVLV_NVM.Sxx_cru_dist_buf_NVM[13] ECU_ADDRESS 0xd0002a04 FORMAT "%8.0" /end MEASUREMENT
/begin MEASUREMENT Sxx_cru_dist_buf[14] "Buffer of the 20 last mileages associated to an activation or shut off" ULONG _CNV_A_R_LINEAR_____274_CM 1 0. 0. 16777215. DISPLAY_IDENTIFIER PcCruSpt_RVLV_NVM.Sxx_cru_dist_buf_NVM[14] ECU_ADDRESS 0xd0002a08 FORMAT "%8.0" /end MEASUREMENT
/begin MEASUREMENT Sxx_cru_dist_buf[15] "Buffer of the 20 last mileages associated to an activation or shut off" ULONG _CNV_A_R_LINEAR_____274_CM 1 0. 0. 16777215. DISPLAY_IDENTIFIER PcCruSpt_RVLV_NVM.Sxx_cru_dist_buf_NVM[15] ECU_ADDRESS 0xd0002a0c FORMAT "%8.0" /end MEASUREMENT
/begin MEASUREMENT Sxx_cru_dist_buf[16] "Buffer of the 20 last mileages associated to an activation or shut off" ULONG _CNV_A_R_LINEAR_____274_CM 1 0. 0. 16777215. DISPLAY_IDENTIFIER PcCruSpt_RVLV_NVM.Sxx_cru_dist_buf_NVM[16] ECU_ADDRESS 0xd0002a10 FORMAT "%8.0" /end MEASUREMENT
/begin MEASUREMENT Sxx_cru_dist_buf[17] "Buffer of the 20 last mileages associated to an activation or shut off" ULONG _CNV_A_R_LINEAR_____274_CM 1 0. 0. 16777215. DISPLAY_IDENTIFIER PcCruSpt_RVLV_NVM.Sxx_cru_dist_buf_NVM[17] ECU_ADDRESS 0xd0002a14 FORMAT "%8.0" /end MEASUREMENT
/begin MEASUREMENT Sxx_cru_dist_buf[18] "Buffer of the 20 last mileages associated to an activation or shut off" ULONG _CNV_A_R_LINEAR_____274_CM 1 0. 0. 16777215. DISPLAY_IDENTIFIER PcCruSpt_RVLV_NVM.Sxx_cru_dist_buf_NVM[18] ECU_ADDRESS 0xd0002a18 FORMAT "%8.0" /end MEASUREMENT
/begin MEASUREMENT Sxx_cru_dist_buf[19] "Buffer of the 20 last mileages associated to an activation or shut off" ULONG _CNV_A_R_LINEAR_____274_CM 1 0. 0. 16777215. DISPLAY_IDENTIFIER PcCruSpt_RVLV_NVM.Sxx_cru_dist_buf_NVM[19] ECU_ADDRESS 0xd0002a1c FORMAT "%8.0" /end MEASUREMENT
/begin MEASUREMENT Sxx_cru_dsb_buf[0] "Buffer of the 20 last CC activations or deactivations root cause" UBYTE _CNV_A_R_ECME_LINEA_0_CM 1 0. 0. 255. DISPLAY_IDENTIFIER PcCruSpt_RVLV_NVM.Sxx_cru_dsb_buf_NVM[0] ECU_ADDRESS 0xd0002a20 FORMAT "%3.0" /end MEASUREMENT
/begin MEASUREMENT Sxx_cru_dsb_buf[1] "Buffer of the 20 last CC activations or deactivations root cause" UBYTE _CNV_A_R_ECME_LINEA_0_CM 1 0. 0. 255. DISPLAY_IDENTIFIER PcCruSpt_RVLV_NVM.Sxx_cru_dsb_buf_NVM[1] ECU_ADDRESS 0xd0002a21 FORMAT "%3.0" /end MEASUREMENT
/begin MEASUREMENT Sxx_cru_dsb_buf[2] "Buffer of the 20 last CC activations or deactivations root cause" UBYTE _CNV_A_R_ECME_LINEA_0_CM 1 0. 0. 255. DISPLAY_IDENTIFIER PcCruSpt_RVLV_NVM.Sxx_cru_dsb_buf_NVM[2] ECU_ADDRESS 0xd0002a22 FORMAT "%3.0" /end MEASUREMENT
/begin MEASUREMENT Sxx_cru_dsb_buf[3] "Buffer of the 20 last CC activations or deactivations root cause" UBYTE _CNV_A_R_ECME_LINEA_0_CM 1 0. 0. 255. DISPLAY_IDENTIFIER PcCruSpt_RVLV_NVM.Sxx_cru_dsb_buf_NVM[3] ECU_ADDRESS 0xd0002a23 FORMAT "%3.0" /end MEASUREMENT
/begin MEASUREMENT Sxx_cru_dsb_buf[4] "Buffer of the 20 last CC activations or deactivations root cause" UBYTE _CNV_A_R_ECME_LINEA_0_CM 1 0. 0. 255. DISPLAY_IDENTIFIER PcCruSpt_RVLV_NVM.Sxx_cru_dsb_buf_NVM[4] ECU_ADDRESS 0xd0002a24 FORMAT "%3.0" /end MEASUREMENT
/begin MEASUREMENT Sxx_cru_dsb_buf[5] "Buffer of the 20 last CC activations or deactivations root cause" UBYTE _CNV_A_R_ECME_LINEA_0_CM 1 0. 0. 255. DISPLAY_IDENTIFIER PcCruSpt_RVLV_NVM.Sxx_cru_dsb_buf_NVM[5] ECU_ADDRESS 0xd0002a25 FORMAT "%3.0" /end MEASUREMENT
/begin MEASUREMENT Sxx_cru_dsb_buf[6] "Buffer of the 20 last CC activations or deactivations root cause" UBYTE _CNV_A_R_ECME_LINEA_0_CM 1 0. 0. 255. DISPLAY_IDENTIFIER PcCruSpt_RVLV_NVM.Sxx_cru_dsb_buf_NVM[6] ECU_ADDRESS 0xd0002a26 FORMAT "%3.0" /end MEASUREMENT
/begin MEASUREMENT Sxx_cru_dsb_buf[7] "Buffer of the 20 last CC activations or deactivations root cause" UBYTE _CNV_A_R_ECME_LINEA_0_CM 1 0. 0. 255. DISPLAY_IDENTIFIER PcCruSpt_RVLV_NVM.Sxx_cru_dsb_buf_NVM[7] ECU_ADDRESS 0xd0002a27 FORMAT "%3.0" /end MEASUREMENT
/begin MEASUREMENT Sxx_cru_dsb_buf[8] "Buffer of the 20 last CC activations or deactivations root cause" UBYTE _CNV_A_R_ECME_LINEA_0_CM 1 0. 0. 255. DISPLAY_IDENTIFIER PcCruSpt_RVLV_NVM.Sxx_cru_dsb_buf_NVM[8] ECU_ADDRESS 0xd0002a28 FORMAT "%3.0" /end MEASUREMENT
/begin MEASUREMENT Sxx_cru_dsb_buf[9] "Buffer of the 20 last CC activations or deactivations root cause" UBYTE _CNV_A_R_ECME_LINEA_0_CM 1 0. 0. 255. DISPLAY_IDENTIFIER PcCruSpt_RVLV_NVM.Sxx_cru_dsb_buf_NVM[9] ECU_ADDRESS 0xd0002a29 FORMAT "%3.0" /end MEASUREMENT
/begin MEASUREMENT Sxx_cru_dsb_buf[10] "Buffer of the 20 last CC activations or deactivations root cause" UBYTE _CNV_A_R_ECME_LINEA_0_CM 1 0. 0. 255. DISPLAY_IDENTIFIER PcCruSpt_RVLV_NVM.Sxx_cru_dsb_buf_NVM[10] ECU_ADDRESS 0xd0002a2a FORMAT "%3.0" /end MEASUREMENT
/begin MEASUREMENT Sxx_cru_dsb_buf[11] "Buffer of the 20 last CC activations or deactivations root cause" UBYTE _CNV_A_R_ECME_LINEA_0_CM 1 0. 0. 255. DISPLAY_IDENTIFIER PcCruSpt_RVLV_NVM.Sxx_cru_dsb_buf_NVM[11] ECU_ADDRESS 0xd0002a2b FORMAT "%3.0" /end MEASUREMENT
/begin MEASUREMENT Sxx_cru_dsb_buf[12] "Buffer of the 20 last CC activations or deactivations root cause" UBYTE _CNV_A_R_ECME_LINEA_0_CM 1 0. 0. 255. DISPLAY_IDENTIFIER PcCruSpt_RVLV_NVM.Sxx_cru_dsb_buf_NVM[12] ECU_ADDRESS 0xd0002a2c FORMAT "%3.0" /end MEASUREMENT
/begin MEASUREMENT Sxx_cru_dsb_buf[13] "Buffer of the 20 last CC activations or deactivations root cause" UBYTE _CNV_A_R_ECME_LINEA_0_CM 1 0. 0. 255. DISPLAY_IDENTIFIER PcCruSpt_RVLV_NVM.Sxx_cru_dsb_buf_NVM[13] ECU_ADDRESS 0xd0002a2d FORMAT "%3.0" /end MEASUREMENT
/begin MEASUREMENT Sxx_cru_dsb_buf[14] "Buffer of the 20 last CC activations or deactivations root cause" UBYTE _CNV_A_R_ECME_LINEA_0_CM 1 0. 0. 255. DISPLAY_IDENTIFIER PcCruSpt_RVLV_NVM.Sxx_cru_dsb_buf_NVM[14] ECU_ADDRESS 0xd0002a2e FORMAT "%3.0" /end MEASUREMENT
/begin MEASUREMENT Sxx_cru_dsb_buf[15] "Buffer of the 20 last CC activations or deactivations root cause" UBYTE _CNV_A_R_ECME_LINEA_0_CM 1 0. 0. 255. DISPLAY_IDENTIFIER PcCruSpt_RVLV_NVM.Sxx_cru_dsb_buf_NVM[15] ECU_ADDRESS 0xd0002a2f FORMAT "%3.0" /end MEASUREMENT
/begin MEASUREMENT Sxx_cru_dsb_buf[16] "Buffer of the 20 last CC activations or deactivations root cause" UBYTE _CNV_A_R_ECME_LINEA_0_CM 1 0. 0. 255. DISPLAY_IDENTIFIER PcCruSpt_RVLV_NVM.Sxx_cru_dsb_buf_NVM[16] ECU_ADDRESS 0xd0002a30 FORMAT "%3.0" /end MEASUREMENT
/begin MEASUREMENT Sxx_cru_dsb_buf[17] "Buffer of the 20 last CC activations or deactivations root cause" UBYTE _CNV_A_R_ECME_LINEA_0_CM 1 0. 0. 255. DISPLAY_IDENTIFIER PcCruSpt_RVLV_NVM.Sxx_cru_dsb_buf_NVM[17] ECU_ADDRESS 0xd0002a31 FORMAT "%3.0" /end MEASUREMENT
/begin MEASUREMENT Sxx_cru_dsb_buf[18] "Buffer of the 20 last CC activations or deactivations root cause" UBYTE _CNV_A_R_ECME_LINEA_0_CM 1 0. 0. 255. DISPLAY_IDENTIFIER PcCruSpt_RVLV_NVM.Sxx_cru_dsb_buf_NVM[18] ECU_ADDRESS 0xd0002a32 FORMAT "%3.0" /end MEASUREMENT
/begin MEASUREMENT Sxx_cru_dsb_buf[19] "Buffer of the 20 last CC activations or deactivations root cause" UBYTE _CNV_A_R_ECME_LINEA_0_CM 1 0. 0. 255. DISPLAY_IDENTIFIER PcCruSpt_RVLV_NVM.Sxx_cru_dsb_buf_NVM[19] ECU_ADDRESS 0xd0002a33 FORMAT "%3.0" /end MEASUREMENT
/begin MEASUREMENT Vbx_brk_pdl_vld_fail "Brake pedal states validity indicator is in the \"limp home data\" status" UBYTE _CNV_S_2_RANGE______3_CM 1 0. 0. 1. ECU_ADDRESS 0xd0006f57 BIT_MASK 0x1 /end MEASUREMENT
/begin MEASUREMENT Vbx_brk_pdl_vld_nok "Brake pedal states validity indicator is in the \"invalid data\" status" UBYTE _CNV_S_2_RANGE______3_CM 1 0. 0. 1. ECU_ADDRESS 0xd0006f58 BIT_MASK 0x1 /end MEASUREMENT
/begin MEASUREMENT Vbx_cru_brk_det "Braking detected for cruise control" UBYTE _CNV_S_2_RANGE______3_CM 1 0. 0. 1. ECU_ADDRESS 0xd0006f59 BIT_MASK 0x1 /end MEASUREMENT
/begin MEASUREMENT Vbx_cru_brk_det_sudn "Sudden braking detected for cruise control" UBYTE _CNV_S_2_RANGE______3_CM 1 0. 0. 1. ECU_ADDRESS 0xd0006f5a BIT_MASK 0x1 /end MEASUREMENT
/begin MEASUREMENT Vbx_cru_clu_abst_fil "Filtered clutch pedal status information absence" UBYTE _CNV_S_2_RANGE______3_CM 1 0. 0. 1. ECU_ADDRESS 0xd0006f5b BIT_MASK 0x1 /end MEASUREMENT
/begin MEASUREMENT Vbx_cru_clu_navl_fil "Filtered unavailable clutch pedal status information" UBYTE _CNV_S_2_RANGE______3_CM 1 0. 0. 1. ECU_ADDRESS 0xd0006f5c BIT_MASK 0x1 /end MEASUREMENT
/begin MEASUREMENT Vbx_diag_ena_cru "Diag Authorization for Cruise Control" UBYTE _CNV_S_2_RANGE______3_CM 1 0. 0. 1. ECU_ADDRESS 0xd0006f5d BIT_MASK 0x1 /end MEASUREMENT
/begin MEASUREMENT Vbx_diag_ena_cru_sl "Diag Authorization for Cruise Control and Speed limiter" UBYTE _CNV_S_2_RANGE______3_CM 1 0. 0. 1. ECU_ADDRESS 0xd0006f5e BIT_MASK 0x1 /end MEASUREMENT
/begin MEASUREMENT Vbx_diag_ena_cru_sl_dtc "Diag Authorization for Cruise Control and Speed limiter DTC" UBYTE _CNV_S_2_RANGE______3_CM 1 0. 0. 1. ECU_ADDRESS 0xd0006f5f BIT_MASK 0x1 /end MEASUREMENT
/begin MEASUREMENT Vbx_gear_vld_nok_fail "Gear engaged validity indicator is in the invalidity status \"invalid data\" or \"limp home data\"" UBYTE _CNV_S_2_RANGE______3_CM 1 0. 0. 1. ECU_ADDRESS 0xd0006f60 BIT_MASK 0x1 /end MEASUREMENT
/begin MEASUREMENT Vsx_cru_vld "Cruise control validity status" UBYTE _CNV_S_3_STATUS_OK__179_CM 1 0. 0. 2. ECU_ADDRESS 0xd0006f61 /end MEASUREMENT
/begin MEASUREMENT Vsx_sl_vld "Speed limiter validity status" UBYTE _CNV_S_3_STATUS_OK__179_CM 1 0. 0. 2. ECU_ADDRESS 0xd0006f62 /end MEASUREMENT
/begin CHARACTERISTIC Cxx_brk_det_dly "Minimum time to detect à brake pedal press" VALUE 0xa0021b5e _REC_S1VAL_20_u2 655.35 _CNV_A_R_LINEAR_____32_CM 0. 655.35 FORMAT "%6.2" /end CHARACTERISTIC
/begin CHARACTERISTIC Cxx_brk_min_decl_thd "Minimum deceleration value to detect braking" VALUE 0xa0021b60 _REC_S1VAL_20_s2 25.5 _CNV_A_R_LINEAR_____462_CM -12. 13.5 FORMAT "%5.1" /end CHARACTERISTIC
/begin CHARACTERISTIC Cxx_cru_brk_fail_dly "Minimum time to detect a brake information absence." VALUE 0xa0021b62 _REC_S1VAL_20_u2 655.35 _CNV_A_R_LINEAR_____32_CM 0. 655.35 FORMAT "%6.2" /end CHARACTERISTIC
/begin CHARACTERISTIC Cxx_cru_brk_nok_dly "Minimum time to detect a non available brake information." VALUE 0xa0021b64 _REC_S1VAL_20_u2 655.35 _CNV_A_R_LINEAR_____32_CM 0. 655.35 FORMAT "%6.2" /end CHARACTERISTIC
/begin CHARACTERISTIC Cxx_cru_clu_navl_dly "Minimum time to detect a clutch information absence" VALUE 0xa0021b66 _REC_S1VAL_20_u2 655.35 _CNV_A_R_LINEAR_____32_CM 0. 655.35 FORMAT "%6.2" /end CHARACTERISTIC
/begin CHARACTERISTIC Cxx_cru_clu_nok_dly "Minimum time to detect a non available clutch information" VALUE 0xa0021b68 _REC_S1VAL_20_u2 655.35 _CNV_A_R_LINEAR_____32_CM 0. 655.35 FORMAT "%6.2" /end CHARACTERISTIC
/begin CHARACTERISTIC Cxx_dfdec_cru_sl_tot "Cruise control and speed limiter common failures Detected Failure Counter Decrement" VALUE 0xa0021b6a _REC_S1VAL_20_u2 65535. _CNV_A_R_ECME_LINEA_0_CM 0. 65535. FORMAT "%5.0" /end CHARACTERISTIC
/begin CHARACTERISTIC Cxx_dfinc_cru_sl_tot "Cruise control and speed limiter common failures Detected Failure Counter Increment" VALUE 0xa0021b6c _REC_S1VAL_20_u2 65535. _CNV_A_R_ECME_LINEA_0_CM 0. 65535. FORMAT "%5.0" /end CHARACTERISTIC
/begin CHARACTERISTIC Cxx_lih_dly "Sufficient time to confirm limphome mode in automatic gearbox" VALUE 0xa0021b74 _REC_S1VAL_20_u1 2.55 _CNV_A_R_LINEAR_____32_CM 0. 2.55 FORMAT "%4.2" /end CHARACTERISTIC
/begin CHARACTERISTIC Cxx_sp_vs_dif_brk_det "Difference between requested speed and vehicle speed to detect braking" VALUE 0xa0021b6e _REC_S1VAL_20_u2 655.35 _CNV_A_R_LINEAR_____125_CM 0. 655.35 FORMAT "%6.2" /end CHARACTERISTIC
/begin CHARACTERISTIC Cxx_sudn_brk_det_dly "Minimum time to detect a sudden braking" VALUE 0xa0021b70 _REC_S1VAL_20_u2 655.35 _CNV_A_R_LINEAR_____32_CM 0. 655.35 FORMAT "%6.2" /end CHARACTERISTIC
/begin CHARACTERISTIC Cxx_sudn_brk_min_decl_thd "Minimum deceleration value to detect sudden braking" VALUE 0xa0021b72 _REC_S1VAL_20_s2 25.5 _CNV_A_R_LINEAR_____462_CM -12. 13.5 FORMAT "%5.1" /end CHARACTERISTIC
/begin MEASUREMENT Vbx_crsh_det "A crash has been detected" UBYTE _CNV_S_2_RANGE______3_CM 1 0. 0. 1. ECU_ADDRESS 0xd0006f94 BIT_MASK 0x1 /end MEASUREMENT
/begin MEASUREMENT Vbx_cru_dgn_eprm_writ_off "Boolean that indicates the write-on-the-flight storage in EEPROM on cruise control activation or deactivation is inhibited" UBYTE _CNV_S_2_RANGE______3_CM 1 0. 0. 1. ECU_ADDRESS 0xd0006f95 BIT_MASK 0x1 /end MEASUREMENT
/begin MEASUREMENT Vbx_cru_dgn_eprm_writ_on "Boolean that indicates the write-on-the-flight storage in EEPROM on cruise control activation or deactivation is enable" UBYTE _CNV_S_2_RANGE______3_CM 1 0. 0. 1. ECU_ADDRESS 0xd0006f96 BIT_MASK 0x1 /end MEASUREMENT
/begin MEASUREMENT Vbx_cru_diag_ena "1 : Means the diag is enable (Cbx_cru_diag_add_on == 1 and Vbx_crsh_end_rec_eprm == 0)  / 0 : means it is disable" UBYTE _CNV_S_2_RANGE______3_CM 1 0. 0. 1. ECU_ADDRESS 0xd0006f97 BIT_MASK 0x1 /end MEASUREMENT
/begin MEASUREMENT Vbx_cru_sl_dacn_bit0 "bit 0 of Vxx_cru_sl_dacn" UBYTE _CNV_S_2_RANGE______3_CM 1 0. 0. 1. ECU_ADDRESS 0xd0006f98 BIT_MASK 0x1 /end MEASUREMENT
/begin MEASUREMENT Vbx_cru_sl_dacn_bit1 "bit 1 of Vxx_cru_sl_dacn" UBYTE _CNV_S_2_RANGE______3_CM 1 0. 0. 1. ECU_ADDRESS 0xd0006f99 BIT_MASK 0x1 /end MEASUREMENT
/begin MEASUREMENT Vbx_ram_full "A root cause and milleage are stored in the second buffer in RAM so no other deactivation or activation can be stored until the EEPROM is ready" UBYTE _CNV_S_2_RANGE______3_CM 1 0. 0. 1. ECU_ADDRESS 0xd0006f9a BIT_MASK 0x1 /end MEASUREMENT
/begin MEASUREMENT Vbx_ram_full_prev "Previous compilation of Vbx_ram_full" UBYTE _CNV_S_2_RANGE______3_CM 1 0. 0. 1. ECU_ADDRESS 0xd0006f9b BIT_MASK 0x1 /end MEASUREMENT
/begin MEASUREMENT Vbx_set_id_bit6 "Set the bit 6 of the RC marker" UBYTE _CNV_S_2_RANGE______3_CM 1 0. 0. 1. ECU_ADDRESS 0xd0006f9c BIT_MASK 0x1 /end MEASUREMENT
/begin MEASUREMENT Vbx_set_id_bit7 "Set the bit 7 of the RC marker" UBYTE _CNV_S_2_RANGE______3_CM 1 0. 0. 1. ECU_ADDRESS 0xd0006f9d BIT_MASK 0x1 /end MEASUREMENT
/begin MEASUREMENT Vxx_act_deact_id_buf_2 "Root cause of the deactivation or activation stored in RAM in the second buffer" UBYTE _CNV_A_R_ECME_LINEA_0_CM 1 0. 0. 255. ECU_ADDRESS 0xd0006f9e FORMAT "%3.0" /end MEASUREMENT
/begin MEASUREMENT Vxx_cru_act_deact_id "Root cause of the deactivation or activation stored in RAM in the first buffer" UBYTE _CNV_A_R_ECME_LINEA_0_CM 1 0. 0. 255. ECU_ADDRESS 0xd0006f9f FORMAT "%3.0" /end MEASUREMENT
/begin MEASUREMENT Vxx_cru_act_deact_id_to_saved "Root cause of the deactivation or activation to be stored from the buffer 1 or 2" UBYTE _CNV_A_R_ECME_LINEA_0_CM 1 0. 0. 255. ECU_ADDRESS 0xd0006fa0 FORMAT "%3.0" /end MEASUREMENT
/begin MEASUREMENT Vxx_cru_dist_buf[0] "Mileage associated to the activation or shut off n° 1" ULONG _CNV_A_R_LINEAR_____274_CM 1 0. 0. 16777215. ECU_ADDRESS 0xd0002a34 FORMAT "%8.0" /end MEASUREMENT
/begin MEASUREMENT Vxx_cru_dist_buf[1] "Mileage associated to the activation or shut off n° 1" ULONG _CNV_A_R_LINEAR_____274_CM 1 0. 0. 16777215. ECU_ADDRESS 0xd0002a38 FORMAT "%8.0" /end MEASUREMENT
/begin MEASUREMENT Vxx_cru_dist_buf[2] "Mileage associated to the activation or shut off n° 1" ULONG _CNV_A_R_LINEAR_____274_CM 1 0. 0. 16777215. ECU_ADDRESS 0xd0002a3c FORMAT "%8.0" /end MEASUREMENT
/begin MEASUREMENT Vxx_cru_dist_buf[3] "Mileage associated to the activation or shut off n° 1" ULONG _CNV_A_R_LINEAR_____274_CM 1 0. 0. 16777215. ECU_ADDRESS 0xd0002a40 FORMAT "%8.0" /end MEASUREMENT
/begin MEASUREMENT Vxx_cru_dist_buf[4] "Mileage associated to the activation or shut off n° 1" ULONG _CNV_A_R_LINEAR_____274_CM 1 0. 0. 16777215. ECU_ADDRESS 0xd0002a44 FORMAT "%8.0" /end MEASUREMENT
/begin MEASUREMENT Vxx_cru_dist_buf[5] "Mileage associated to the activation or shut off n° 1" ULONG _CNV_A_R_LINEAR_____274_CM 1 0. 0. 16777215. ECU_ADDRESS 0xd0002a48 FORMAT "%8.0" /end MEASUREMENT
/begin MEASUREMENT Vxx_cru_dist_buf[6] "Mileage associated to the activation or shut off n° 1" ULONG _CNV_A_R_LINEAR_____274_CM 1 0. 0. 16777215. ECU_ADDRESS 0xd0002a4c FORMAT "%8.0" /end MEASUREMENT
/begin MEASUREMENT Vxx_cru_dist_buf[7] "Mileage associated to the activation or shut off n° 1" ULONG _CNV_A_R_LINEAR_____274_CM 1 0. 0. 16777215. ECU_ADDRESS 0xd0002a50 FORMAT "%8.0" /end MEASUREMENT
/begin MEASUREMENT Vxx_cru_dist_buf[8] "Mileage associated to the activation or shut off n° 1" ULONG _CNV_A_R_LINEAR_____274_CM 1 0. 0. 16777215. ECU_ADDRESS 0xd0002a54 FORMAT "%8.0" /end MEASUREMENT
/begin MEASUREMENT Vxx_cru_dist_buf[9] "Mileage associated to the activation or shut off n° 1" ULONG _CNV_A_R_LINEAR_____274_CM 1 0. 0. 16777215. ECU_ADDRESS 0xd0002a58 FORMAT "%8.0" /end MEASUREMENT
/begin MEASUREMENT Vxx_cru_dist_buf[10] "Mileage associated to the activation or shut off n° 1" ULONG _CNV_A_R_LINEAR_____274_CM 1 0. 0. 16777215. ECU_ADDRESS 0xd0002a5c FORMAT "%8.0" /end MEASUREMENT
/begin MEASUREMENT Vxx_cru_dist_buf[11] "Mileage associated to the activation or shut off n° 1" ULONG _CNV_A_R_LINEAR_____274_CM 1 0. 0. 16777215. ECU_ADDRESS 0xd0002a60 FORMAT "%8.0" /end MEASUREMENT
/begin MEASUREMENT Vxx_cru_dist_buf[12] "Mileage associated to the activation or shut off n° 1" ULONG _CNV_A_R_LINEAR_____274_CM 1 0. 0. 16777215. ECU_ADDRESS 0xd0002a64 FORMAT "%8.0" /end MEASUREMENT
/begin MEASUREMENT Vxx_cru_dist_buf[13] "Mileage associated to the activation or shut off n° 1" ULONG _CNV_A_R_LINEAR_____274_CM 1 0. 0. 16777215. ECU_ADDRESS 0xd0002a68 FORMAT "%8.0" /end MEASUREMENT
/begin MEASUREMENT Vxx_cru_dist_buf[14] "Mileage associated to the activation or shut off n° 1" ULONG _CNV_A_R_LINEAR_____274_CM 1 0. 0. 16777215. ECU_ADDRESS 0xd0002a6c FORMAT "%8.0" /end MEASUREMENT
/begin MEASUREMENT Vxx_cru_dist_buf[15] "Mileage associated to the activation or shut off n° 1" ULONG _CNV_A_R_LINEAR_____274_CM 1 0. 0. 16777215. ECU_ADDRESS 0xd0002a70 FORMAT "%8.0" /end MEASUREMENT
/begin MEASUREMENT Vxx_cru_dist_buf[16] "Mileage associated to the activation or shut off n° 1" ULONG _CNV_A_R_LINEAR_____274_CM 1 0. 0. 16777215. ECU_ADDRESS 0xd0002a74 FORMAT "%8.0" /end MEASUREMENT
/begin MEASUREMENT Vxx_cru_dist_buf[17] "Mileage associated to the activation or shut off n° 1" ULONG _CNV_A_R_LINEAR_____274_CM 1 0. 0. 16777215. ECU_ADDRESS 0xd0002a78 FORMAT "%8.0" /end MEASUREMENT
/begin MEASUREMENT Vxx_cru_dist_buf[18] "Mileage associated to the activation or shut off n° 1" ULONG _CNV_A_R_LINEAR_____274_CM 1 0. 0. 16777215. ECU_ADDRESS 0xd0002a7c FORMAT "%8.0" /end MEASUREMENT
/begin MEASUREMENT Vxx_cru_dist_buf[19] "Mileage associated to the activation or shut off n° 1" ULONG _CNV_A_R_LINEAR_____274_CM 1 0. 0. 16777215. ECU_ADDRESS 0xd0002a80 FORMAT "%8.0" /end MEASUREMENT
/begin MEASUREMENT Vxx_cru_dsb_buf[0] "Root cause of the activation or shut off n°1" UBYTE _CNV_A_R_ECME_LINEA_0_CM 1 0. 0. 255. ECU_ADDRESS 0xd0006f80 FORMAT "%3.0" /end MEASUREMENT
/begin MEASUREMENT Vxx_cru_dsb_buf[1] "Root cause of the activation or shut off n°1" UBYTE _CNV_A_R_ECME_LINEA_0_CM 1 0. 0. 255. ECU_ADDRESS 0xd0006f81 FORMAT "%3.0" /end MEASUREMENT
/begin MEASUREMENT Vxx_cru_dsb_buf[2] "Root cause of the activation or shut off n°1" UBYTE _CNV_A_R_ECME_LINEA_0_CM 1 0. 0. 255. ECU_ADDRESS 0xd0006f82 FORMAT "%3.0" /end MEASUREMENT
/begin MEASUREMENT Vxx_cru_dsb_buf[3] "Root cause of the activation or shut off n°1" UBYTE _CNV_A_R_ECME_LINEA_0_CM 1 0. 0. 255. ECU_ADDRESS 0xd0006f83 FORMAT "%3.0" /end MEASUREMENT
/begin MEASUREMENT Vxx_cru_dsb_buf[4] "Root cause of the activation or shut off n°1" UBYTE _CNV_A_R_ECME_LINEA_0_CM 1 0. 0. 255. ECU_ADDRESS 0xd0006f84 FORMAT "%3.0" /end MEASUREMENT
/begin MEASUREMENT Vxx_cru_dsb_buf[5] "Root cause of the activation or shut off n°1" UBYTE _CNV_A_R_ECME_LINEA_0_CM 1 0. 0. 255. ECU_ADDRESS 0xd0006f85 FORMAT "%3.0" /end MEASUREMENT
/begin MEASUREMENT Vxx_cru_dsb_buf[6] "Root cause of the activation or shut off n°1" UBYTE _CNV_A_R_ECME_LINEA_0_CM 1 0. 0. 255. ECU_ADDRESS 0xd0006f86 FORMAT "%3.0" /end MEASUREMENT
/begin MEASUREMENT Vxx_cru_dsb_buf[7] "Root cause of the activation or shut off n°1" UBYTE _CNV_A_R_ECME_LINEA_0_CM 1 0. 0. 255. ECU_ADDRESS 0xd0006f87 FORMAT "%3.0" /end MEASUREMENT
/begin MEASUREMENT Vxx_cru_dsb_buf[8] "Root cause of the activation or shut off n°1" UBYTE _CNV_A_R_ECME_LINEA_0_CM 1 0. 0. 255. ECU_ADDRESS 0xd0006f88 FORMAT "%3.0" /end MEASUREMENT
/begin MEASUREMENT Vxx_cru_dsb_buf[9] "Root cause of the activation or shut off n°1" UBYTE _CNV_A_R_ECME_LINEA_0_CM 1 0. 0. 255. ECU_ADDRESS 0xd0006f89 FORMAT "%3.0" /end MEASUREMENT
/begin MEASUREMENT Vxx_cru_dsb_buf[10] "Root cause of the activation or shut off n°1" UBYTE _CNV_A_R_ECME_LINEA_0_CM 1 0. 0. 255. ECU_ADDRESS 0xd0006f8a FORMAT "%3.0" /end MEASUREMENT
/begin MEASUREMENT Vxx_cru_dsb_buf[11] "Root cause of the activation or shut off n°1" UBYTE _CNV_A_R_ECME_LINEA_0_CM 1 0. 0. 255. ECU_ADDRESS 0xd0006f8b FORMAT "%3.0" /end MEASUREMENT
/begin MEASUREMENT Vxx_cru_dsb_buf[12] "Root cause of the activation or shut off n°1" UBYTE _CNV_A_R_ECME_LINEA_0_CM 1 0. 0. 255. ECU_ADDRESS 0xd0006f8c FORMAT "%3.0" /end MEASUREMENT
/begin MEASUREMENT Vxx_cru_dsb_buf[13] "Root cause of the activation or shut off n°1" UBYTE _CNV_A_R_ECME_LINEA_0_CM 1 0. 0. 255. ECU_ADDRESS 0xd0006f8d FORMAT "%3.0" /end MEASUREMENT
/begin MEASUREMENT Vxx_cru_dsb_buf[14] "Root cause of the activation or shut off n°1" UBYTE _CNV_A_R_ECME_LINEA_0_CM 1 0. 0. 255. ECU_ADDRESS 0xd0006f8e FORMAT "%3.0" /end MEASUREMENT
/begin MEASUREMENT Vxx_cru_dsb_buf[15] "Root cause of the activation or shut off n°1" UBYTE _CNV_A_R_ECME_LINEA_0_CM 1 0. 0. 255. ECU_ADDRESS 0xd0006f8f FORMAT "%3.0" /end MEASUREMENT
/begin MEASUREMENT Vxx_cru_dsb_buf[16] "Root cause of the activation or shut off n°1" UBYTE _CNV_A_R_ECME_LINEA_0_CM 1 0. 0. 255. ECU_ADDRESS 0xd0006f90 FORMAT "%3.0" /end MEASUREMENT
/begin MEASUREMENT Vxx_cru_dsb_buf[17] "Root cause of the activation or shut off n°1" UBYTE _CNV_A_R_ECME_LINEA_0_CM 1 0. 0. 255. ECU_ADDRESS 0xd0006f91 FORMAT "%3.0" /end MEASUREMENT
/begin MEASUREMENT Vxx_cru_dsb_buf[18] "Root cause of the activation or shut off n°1" UBYTE _CNV_A_R_ECME_LINEA_0_CM 1 0. 0. 255. ECU_ADDRESS 0xd0006f92 FORMAT "%3.0" /end MEASUREMENT
/begin MEASUREMENT Vxx_cru_dsb_buf[19] "Root cause of the activation or shut off n°1" UBYTE _CNV_A_R_ECME_LINEA_0_CM 1 0. 0. 255. ECU_ADDRESS 0xd0006f93 FORMAT "%3.0" /end MEASUREMENT
/begin MEASUREMENT Vxx_sli_brk_buf "Buffer of the 16 last seconds of the brake status" UWORD _CNV_A_R_ECME_LINEA_0_CM 1 0. 0. 65535. ECU_ADDRESS 0xd0005fc4 FORMAT "%5.0" /end MEASUREMENT
/begin MEASUREMENT Vxx_sli_clu_buf "Buffer of the 16 last seconds of the clutch status" UWORD _CNV_A_R_ECME_LINEA_0_CM 1 0. 0. 65535. ECU_ADDRESS 0xd0005fc6 FORMAT "%5.0" /end MEASUREMENT
/begin MEASUREMENT Vxx_sli_cru_stt_buf "Buffer of the 16 last seconds of the cruise control status" UWORD _CNV_A_R_ECME_LINEA_0_CM 1 0. 0. 65535. ECU_ADDRESS 0xd0005fc8 FORMAT "%5.0" /end MEASUREMENT
/begin MEASUREMENT Vxx_sli_vs_buf[0] "Buffer of the 16 last seconds of the vehicle speed" UBYTE _CNV_A_R_ECME_LINEA_0_CM 1 0. 0. 255. ECU_ADDRESS 0xd0007c78 FORMAT "%3.0" /end MEASUREMENT
/begin MEASUREMENT Vxx_sli_vs_buf[1] "Buffer of the 16 last seconds of the vehicle speed" UBYTE _CNV_A_R_ECME_LINEA_0_CM 1 0. 0. 255. ECU_ADDRESS 0xd0007c79 FORMAT "%3.0" /end MEASUREMENT
/begin MEASUREMENT Vxx_sli_vs_buf[2] "Buffer of the 16 last seconds of the vehicle speed" UBYTE _CNV_A_R_ECME_LINEA_0_CM 1 0. 0. 255. ECU_ADDRESS 0xd0007c7a FORMAT "%3.0" /end MEASUREMENT
/begin MEASUREMENT Vxx_sli_vs_buf[3] "Buffer of the 16 last seconds of the vehicle speed" UBYTE _CNV_A_R_ECME_LINEA_0_CM 1 0. 0. 255. ECU_ADDRESS 0xd0007c7b FORMAT "%3.0" /end MEASUREMENT
/begin MEASUREMENT Vxx_sli_vs_buf[4] "Buffer of the 16 last seconds of the vehicle speed" UBYTE _CNV_A_R_ECME_LINEA_0_CM 1 0. 0. 255. ECU_ADDRESS 0xd0007c7c FORMAT "%3.0" /end MEASUREMENT
/begin MEASUREMENT Vxx_sli_vs_buf[5] "Buffer of the 16 last seconds of the vehicle speed" UBYTE _CNV_A_R_ECME_LINEA_0_CM 1 0. 0. 255. ECU_ADDRESS 0xd0007c7d FORMAT "%3.0" /end MEASUREMENT
/begin MEASUREMENT Vxx_sli_vs_buf[6] "Buffer of the 16 last seconds of the vehicle speed" UBYTE _CNV_A_R_ECME_LINEA_0_CM 1 0. 0. 255. ECU_ADDRESS 0xd0007c7e FORMAT "%3.0" /end MEASUREMENT
/begin MEASUREMENT Vxx_sli_vs_buf[7] "Buffer of the 16 last seconds of the vehicle speed" UBYTE _CNV_A_R_ECME_LINEA_0_CM 1 0. 0. 255. ECU_ADDRESS 0xd0007c7f FORMAT "%3.0" /end MEASUREMENT
/begin MEASUREMENT Vxx_sli_vs_buf[8] "Buffer of the 16 last seconds of the vehicle speed" UBYTE _CNV_A_R_ECME_LINEA_0_CM 1 0. 0. 255. ECU_ADDRESS 0xd0007c80 FORMAT "%3.0" /end MEASUREMENT
/begin MEASUREMENT Vxx_sli_vs_buf[9] "Buffer of the 16 last seconds of the vehicle speed" UBYTE _CNV_A_R_ECME_LINEA_0_CM 1 0. 0. 255. ECU_ADDRESS 0xd0007c81 FORMAT "%3.0" /end MEASUREMENT
/begin MEASUREMENT Vxx_sli_vs_buf[10] "Buffer of the 16 last seconds of the vehicle speed" UBYTE _CNV_A_R_ECME_LINEA_0_CM 1 0. 0. 255. ECU_ADDRESS 0xd0007c82 FORMAT "%3.0" /end MEASUREMENT
/begin MEASUREMENT Vxx_sli_vs_buf[11] "Buffer of the 16 last seconds of the vehicle speed" UBYTE _CNV_A_R_ECME_LINEA_0_CM 1 0. 0. 255. ECU_ADDRESS 0xd0007c83 FORMAT "%3.0" /end MEASUREMENT
/begin MEASUREMENT Vxx_sli_vs_buf[12] "Buffer of the 16 last seconds of the vehicle speed" UBYTE _CNV_A_R_ECME_LINEA_0_CM 1 0. 0. 255. ECU_ADDRESS 0xd0007c84 FORMAT "%3.0" /end MEASUREMENT
/begin MEASUREMENT Vxx_sli_vs_buf[13] "Buffer of the 16 last seconds of the vehicle speed" UBYTE _CNV_A_R_ECME_LINEA_0_CM 1 0. 0. 255. ECU_ADDRESS 0xd0007c85 FORMAT "%3.0" /end MEASUREMENT
/begin MEASUREMENT Vxx_sli_vs_buf[14] "Buffer of the 16 last seconds of the vehicle speed" UBYTE _CNV_A_R_ECME_LINEA_0_CM 1 0. 0. 255. ECU_ADDRESS 0xd0007c86 FORMAT "%3.0" /end MEASUREMENT
/begin MEASUREMENT Vxx_sli_vs_buf[15] "Buffer of the 16 last seconds of the vehicle speed" UBYTE _CNV_A_R_ECME_LINEA_0_CM 1 0. 0. 255. ECU_ADDRESS 0xd0007c87 FORMAT "%3.0" /end MEASUREMENT
/begin MEASUREMENT Vxx_togl_ctr "Counter to detect toggling effect" UBYTE _CNV_A_R_ECME_LINEA_0_CM 1 0. 0. 255. ECU_ADDRESS 0xd0006fa1 FORMAT "%3.0" /end MEASUREMENT
/begin MEASUREMENT Vxx_togl_tmr "Timer to detect toggling effect" UBYTE _CNV_A_R_LINEAR_____123_CM 1 0. 0. 2.55 ECU_ADDRESS 0xd0006fa2 FORMAT "%4.2" /end MEASUREMENT
/begin MEASUREMENT Vxx_vh_dist_buf_2 "milleage of the deactivation or activation stored in RAM in the second buffer" ULONG _CNV_A_R_ECME_LINEA_0_CM 1 0. 0. 16777215. ECU_ADDRESS 0xd0002a84 FORMAT "%8.0" /end MEASUREMENT
/begin CHARACTERISTIC Cbx_cru_diag_add_on "Activate the cruise control diagnostic add-on (1= activated)" VALUE 0xa0021b7a _REC_S1VAL_20_u1 1. _CNV_S_2_RANGE______3_CM 0. 1. BIT_MASK 0x1 /end CHARACTERISTIC
/begin CHARACTERISTIC Cxx_cru_dgn_eprm_imd_writ_thr "Threshold to stop root cause and mileage EEPROM write-on-the-flight" VALUE 0xa0021b76 _REC_S1VAL_20_u4 16777215. _CNV_A_R_ECME_LINEA_0_CM 0. 16777215. FORMAT "%8.0" /end CHARACTERISTIC
/begin CHARACTERISTIC Cxx_togl_dly "Delay to consider toggling phenomena" VALUE 0xa0021b7b _REC_S1VAL_20_u1 2.55 _CNV_A_R_LINEAR_____32_CM 0. 2.55 FORMAT "%4.2" /end CHARACTERISTIC
/begin CHARACTERISTIC Cxx_togl_thr "Maximum number of activation/deactivation before a calibrated delay to consider toggling" VALUE 0xa0021b7c _REC_S1VAL_20_u1 255. _CNV_A_R_ECME_LINEA_0_CM 0. 255. FORMAT "%3.0" /end CHARACTERISTIC
/begin MEASUREMENT Vbx_cru_eng_dsb "Engine control request for cruise control abnormal deactivation " UBYTE _CNV_S_2_RANGE______3_CM 1 0. 0. 1. ECU_ADDRESS 0xd0006fa5 BIT_MASK 0x1 /end MEASUREMENT
/begin MEASUREMENT Vbx_cru_eng_dsb_sys "Engine control request for cruise control system deactivation" UBYTE _CNV_S_2_RANGE______3_CM 1 0. 0. 1. ECU_ADDRESS 0xd0006fa6 BIT_MASK 0x1 /end MEASUREMENT
/begin MEASUREMENT Vbx_sl_eng_dsb "Engine control request for speed limiter abnormal deactivation " UBYTE _CNV_S_2_RANGE______3_CM 1 0. 0. 1. ECU_ADDRESS 0xd0006fa7 BIT_MASK 0x1 /end MEASUREMENT
/begin MEASUREMENT Vbx_sl_eng_dsb_sys "Engine control request for speed limiter system deactivation" UBYTE _CNV_S_2_RANGE______3_CM 1 0. 0. 1. ECU_ADDRESS 0xd0006fa8 BIT_MASK 0x1 /end MEASUREMENT
/begin CHARACTERISTIC Cbx_cru_eng_dsb_wal_1_req_cfm "Configuration bit for cruise control deactivation by engine control on warning lamp level 1 request." VALUE 0xa0021b7d _REC_S1VAL_20_u1 1. _CNV_A_R_ECME_LINEA_0_CM 0. 1. FORMAT "%1.0" BIT_MASK 0x1 /end CHARACTERISTIC
/begin CHARACTERISTIC Cbx_cru_sl_eng_dsb_vld_cfm "Configuration bit for cruise control and speed limiter deactivation by engine control on IVLD" VALUE 0xa0021b7e _REC_S1VAL_20_u1 1. _CNV_A_R_ECME_LINEA_0_CM 0. 1. FORMAT "%1.0" BIT_MASK 0x1 /end CHARACTERISTIC
/begin CHARACTERISTIC Cbx_sl_eng_dsb_wal_1_req_cfm "Configuration bit for speed limiter deactivation by engine control on warning lamp level 1 request." VALUE 0xa0021b7f _REC_S1VAL_20_u1 1. _CNV_A_R_ECME_LINEA_0_CM 0. 1. FORMAT "%1.0" BIT_MASK 0x1 /end CHARACTERISTIC
/begin MEASUREMENT Vbx_cru_sl_warn "Cruise control and speed limiter warning (overspeed)" UBYTE _CNV_S_2_RANGE______3_CM 1 0. 0. 1. ECU_ADDRESS 0xd0006fb4 BIT_MASK 0x1 /end MEASUREMENT
/begin MEASUREMENT Vbx_cru_sl_warn_prev "Previous value of the cruise control and speed limiter warning (overspeed)" UBYTE _CNV_S_2_RANGE______3_CM 1 0. 0. 1. ECU_ADDRESS 0xd0006fb5 BIT_MASK 0x1 /end MEASUREMENT
/begin MEASUREMENT Vbx_cru_sl_warn_raw "Stateflow output: Cruise control and speed limiter warning (overspeed)" UBYTE _CNV_S_2_RANGE______3_CM 1 0. 0. 1. ECU_ADDRESS 0xd0006fb6 BIT_MASK 0x1 /end MEASUREMENT
/begin MEASUREMENT Vbx_vs_clos_spt_lamp "Cruise control and speed limiter : the speed is reaching the setpoint (sent on the CAN network)" UBYTE _CNV_S_2_RANGE______3_CM 1 0. 0. 1. ECU_ADDRESS 0xd0006fb7 BIT_MASK 0x1 /end MEASUREMENT
/begin MEASUREMENT Vxx_cru_sl_driv_vs_sp "Requested speed selected by the driver (Cruise Control or Speed Limiter)" UBYTE _CNV_A_R_ECME_LINEA_0_CM 1 0. 0. 255. ECU_ADDRESS 0xd0006fb8 FORMAT "%3.0" /end MEASUREMENT
/begin MEASUREMENT Vxx_cru_sl_driv_vs_sp_kmh "Requested speed selected by the driver (Cruise Control or Speed Limiter) in km/h" UBYTE _CNV_A_R_LINEAR_____71_CM 1 0. 0. 255. ECU_ADDRESS 0xd0006fb9 FORMAT "%3.0" /end MEASUREMENT
/begin MEASUREMENT Vxx_cru_sl_sp_inc_dec_dly_cnt "Timer for long switch press" UBYTE _CNV_A_R_LINEAR_____32_CM 1 0. 0. 2.55 ECU_ADDRESS 0xd0006fba FORMAT "%4.2" /end MEASUREMENT
/begin MEASUREMENT Vxx_cru_sl_stt_ip_nom "Cruise control and speed limiter status : parameter sent to the cluster by CAN for display" UBYTE _CNV_A_R_ECME_LINEA_0_CM 1 0. 0. 7. ECU_ADDRESS 0xd0006fbb FORMAT "%1.0" /end MEASUREMENT
/begin MEASUREMENT Vxx_cru_sl_vs_sp_nom "Cruise control or speed limiter requested speed sent to the cluster by CAN for display" UBYTE _CNV_A_R_ECME_LINEA_0_CM 1 0. 0. 255. ECU_ADDRESS 0xd0006fbc FORMAT "%3.0" /end MEASUREMENT
/begin CHARACTERISTIC Cbx_ena_reg_decl_resu_on "This calibration authorise or not the entry in regulation by pressing resume or set/+ ( 1 : enable / 0 : disable)" VALUE 0xa0021b81 _REC_S1VAL_20_u1 1. _CNV_S_2_RANGE______3_CM 0. 1. BIT_MASK 0x1 /end CHARACTERISTIC
/begin CHARACTERISTIC Cxx_cru_ovs_warn_thd "Speed theshold to activate the warning in case of volontary cruise control overspeed" VALUE 0xa0021b82 _REC_S1VAL_20_u1 25.5 _CNV_A_R_LINEAR_____463_CM 0. 25.5 FORMAT "%4.1" /end CHARACTERISTIC
/begin CHARACTERISTIC Cxx_cru_ovs_warn_thd_mph "Speed theshold in mph to activate the warning in case of volontary cruise control overspeed" VALUE 0xa0021b83 _REC_S1VAL_20_u1 25.5 _CNV_A_R_LINEAR_____464_CM 0. 25.5 FORMAT "%4.1" /end CHARACTERISTIC
/begin CHARACTERISTIC Cxx_cru_sl_long_sp_dec_t "pc_cru_spt_setptxx/Minimum duration of a push button press for continuous decrease of requested speed" VALUE 0xa0021b84 _REC_S1VAL_20_u1 2.55 _CNV_A_R_LINEAR_____32_CM 0. 2.55 FORMAT "%4.2" /end CHARACTERISTIC
/begin CHARACTERISTIC Cxx_cru_sl_long_sp_inc_t "pc_cru_spt_setptxx/Minimum duration of a push button press for continuous increase of requested speed" VALUE 0xa0021b85 _REC_S1VAL_20_u1 2.55 _CNV_A_R_LINEAR_____32_CM 0. 2.55 FORMAT "%4.2" /end CHARACTERISTIC
/begin CHARACTERISTIC Cxx_cru_sl_sp_inc_t "Time between two requested speed increments or decrements when button is pressed continuously" VALUE 0xa0021b86 _REC_S1VAL_20_u1 25.5 _CNV_A_R_LINEAR_____58_CM 0. 25.5 FORMAT "%4.1" /end CHARACTERISTIC
/begin CHARACTERISTIC Cxx_cru_sl_warn_dly "Filtering delay before transmission of a CRU/SL warning" VALUE 0xa0021b87 _REC_S1VAL_20_u1 25.5 _CNV_A_R_LINEAR_____58_CM 0. 25.5 FORMAT "%4.1" /end CHARACTERISTIC
/begin CHARACTERISTIC Cxx_sl_ovs_warn_thd "Speed theshold to activate the warning in case of volontary speed limiter overspeed" VALUE 0xa0021b88 _REC_S1VAL_20_s1 25.5 _CNV_A_R_LINEAR_____463_CM -12.8 12.7 FORMAT "%6.2" /end CHARACTERISTIC
/begin CHARACTERISTIC Cxx_sl_ovs_warn_thd_mph "Speed theshold in mph to activate the warning in case of volontary speed limiter overspeed" VALUE 0xa0021b89 _REC_S1VAL_20_s1 25.5 _CNV_A_R_LINEAR_____464_CM -12.8 12.7 FORMAT "%6.2" /end CHARACTERISTIC
/begin MEASUREMENT Vbx_cru_cmf_cut "Comfortable stop of the speed regulation" UBYTE _CNV_S_2_RANGE______3_CM 1 0. 0. 1. ECU_ADDRESS 0xd0006fc6 BIT_MASK 0x1 /end MEASUREMENT
/begin MEASUREMENT Vbx_sta_swi_act "The START button has been pressed" UBYTE _CNV_S_2_RANGE______3_CM 1 0. 0. 1. ECU_ADDRESS 0xd0006fc7 BIT_MASK 0x1 /end MEASUREMENT
/begin MEASUREMENT Vsx_cru_stt "Cruise control state" UBYTE _CNV_A_R_ECME_LINEA_0_CM 1 0. 0. 255. ECU_ADDRESS 0xd0006fc8 FORMAT "%3.0" /end MEASUREMENT
/begin MEASUREMENT Vsx_sl_stt "Speed limiter state" UBYTE _CNV_A_R_ECME_LINEA_0_CM 1 0. 0. 4. ECU_ADDRESS 0xd0006fc9 FORMAT "%1.0" /end MEASUREMENT
/begin MEASUREMENT Vxx_cru_sl_dacn "Compilation of all the cru/sl normal causes of deactivation." UBYTE _CNV_A_R_ECME_LINEA_0_CM 1 0. 0. 255. ECU_ADDRESS 0xd0006fca FORMAT "%3.0" /end MEASUREMENT
/begin MEASUREMENT Vxx_cru_sl_dacn_prev "Previous compilation of all the cru/sl normal causes of deactivation" UBYTE _CNV_A_R_ECME_LINEA_0_CM 1 0. 0. 255. ECU_ADDRESS 0xd0006fcb FORMAT "%3.0" /end MEASUREMENT
/begin MEASUREMENT Vxx_cru_sl_dacn_sys_prev "Previous compilation of all the cru/sl normal deactivations due to system causes." UBYTE _CNV_A_R_ECME_LINEA_0_CM 1 0. 0. 255. ECU_ADDRESS 0xd0006fcc FORMAT "%3.0" /end MEASUREMENT
/begin MEASUREMENT Vxx_cru_sl_stt_nom "Cruise control and speed limiter status : parameter sent to the gearbox on the CAN network" UBYTE _CNV_A_R_ECME_LINEA_0_CM 1 0. 0. 3. ECU_ADDRESS 0xd0006fcd FORMAT "%1.0" /end MEASUREMENT
/begin MEASUREMENT Vbx_cru_sl_kmh_mph_cge "The displayed speed unit has changed during CC/SL activation" UBYTE _CNV_S_2_RANGE______3_CM 1 0. 0. 1. ECU_ADDRESS 0xd0006feb BIT_MASK 0x1 /end MEASUREMENT
/begin MEASUREMENT Vbx_cru_sl_oor_vs "Vehicle speed outside the speed acceptance domain of CC/SL" UBYTE _CNV_S_2_RANGE______3_CM 1 0. 0. 1. ECU_ADDRESS 0xd0006fec BIT_MASK 0x1 /end MEASUREMENT
/begin MEASUREMENT Vbx_cru_smal_vs_sp_rat "Vehicle speed is too small in comparison on the requested speed to enter in speed regulation" UBYTE _CNV_S_2_RANGE______3_CM 1 0. 0. 1. ECU_ADDRESS 0xd0006fed BIT_MASK 0x1 /end MEASUREMENT
/begin MEASUREMENT Vbx_df_cru_vs_cmp "CCSL mux vehicle speed Coherence detected failure" UBYTE _CNV_S_2_RANGE______3_CM 1 0. 0. 1. ECU_ADDRESS 0xd0006fee BIT_MASK 0x1 /end MEASUREMENT
/begin MEASUREMENT Vbx_dspl_vs_abst_fil "Displayed vehicle speed received on the CAN network not present after a filtering time" UBYTE _CNV_S_2_RANGE______3_CM 1 0. 0. 1. ECU_ADDRESS 0xd0006fef BIT_MASK 0x1 /end MEASUREMENT
/begin MEASUREMENT Vbx_dspl_vs_navl_fil "Displayed vehicle speed received on the CAN network not available after a filtering time" UBYTE _CNV_S_2_RANGE______3_CM 1 0. 0. 1. ECU_ADDRESS 0xd0006ff0 BIT_MASK 0x1 /end MEASUREMENT
/begin MEASUREMENT Vbx_vs_abst_fil "Vehicle speed received on the CAN network not present after a filtering time" UBYTE _CNV_S_2_RANGE______3_CM 1 0. 0. 1. ECU_ADDRESS 0xd0006ff1 BIT_MASK 0x1 /end MEASUREMENT
/begin MEASUREMENT Vbx_vs_navl_fil "Vehicle speed received on the CAN network not available after a filtering time" UBYTE _CNV_S_2_RANGE______3_CM 1 0. 0. 1. ECU_ADDRESS 0xd0006ff2 BIT_MASK 0x1 /end MEASUREMENT
/begin MEASUREMENT Vbx_vs_nok "Invalid or absent vehicle speed" UBYTE _CNV_S_2_RANGE______3_CM 1 0. 0. 1. ECU_ADDRESS 0xd0006ff3 BIT_MASK 0x1 /end MEASUREMENT
/begin MEASUREMENT Vxx_cru_sl_acel "Filtered vehicle acceleration for cruise control  and speed limiter" SWORD _CNV_A_R_LINEAR_____462_CM 1 0. -12. 13.5 ECU_ADDRESS 0xd00046fe FORMAT "%5.1" /end MEASUREMENT
/begin MEASUREMENT Vxx_cru_sl_long_step "Value of requested speed step when accel or decel switch pressed continuously" UBYTE _CNV_A_R_ECME_LINEA_0_CM 1 0. 0. 255. ECU_ADDRESS 0xd0006ff4 FORMAT "%3.0" /end MEASUREMENT
/begin MEASUREMENT Vxx_cru_sl_max_vs "CC/SL maximal speed setpoint" UBYTE _CNV_A_R_ECME_LINEA_0_CM 1 0. 0. 255. ECU_ADDRESS 0xd0006ff5 FORMAT "%3.0" /end MEASUREMENT
/begin MEASUREMENT Vxx_cru_sl_min_vs "CC/SL minimal speed setpoint" UBYTE _CNV_A_R_ECME_LINEA_0_CM 1 0. 0. 255. ECU_ADDRESS 0xd0006ff6 FORMAT "%3.0" /end MEASUREMENT
/begin MEASUREMENT Vxx_cru_sl_no_efv_vs_thd "Difference between vehicle speed and requested speed to declare CC/SL ineffective" UBYTE _CNV_A_R_LINEAR_____297_CM 1 0. 0. 25.5 ECU_ADDRESS 0xd0006ff7 FORMAT "%4.1" /end MEASUREMENT
/begin MEASUREMENT Vxx_cru_sl_raw_vs "Raw vehicle speed for cruise control and speed limiter strategy" UWORD _CNV_A_R_LINEAR_____123_CM 1 0. 0. 655.35 ECU_ADDRESS 0xd0004700 FORMAT "%4.2" /end MEASUREMENT
/begin MEASUREMENT Vxx_cru_sl_smal_step "Value of requested speed step when accel or decel switch pressed during a short time" UBYTE _CNV_A_R_ECME_LINEA_0_CM 1 0. 0. 255. ECU_ADDRESS 0xd0006ff8 FORMAT "%3.0" /end MEASUREMENT
/begin MEASUREMENT Vxx_cru_sl_vs "Vehicle speed filtered by the cruise control/speed limiter strategy" UWORD _CNV_A_R_LINEAR_____123_CM 1 0. 0. 655.35 ECU_ADDRESS 0xd0004702 FORMAT "%4.2" /end MEASUREMENT
/begin MEASUREMENT Vxx_cru_sl_vs_kmh "Vehicle speed filtered by the cruise control/speed limiter strategy in km/h" UWORD _CNV_A_R_LINEAR_____125_CM 1 0. 0. 655.35 ECU_ADDRESS 0xd0004704 FORMAT "%6.2" /end MEASUREMENT
/begin MEASUREMENT Vxx_vs_clos_spt_lamp_off_thd "Difference between vehicle speed and requested speed to turn OFF the lamp indicating that vehicle speed is reaching the setpoint." UBYTE _CNV_A_R_LINEAR_____297_CM 1 0. 0. 25.5 ECU_ADDRESS 0xd0006ff9 FORMAT "%4.1" /end MEASUREMENT
/begin MEASUREMENT Vxx_vs_clos_spt_lamp_on_thd "Difference between vehicle speed and requested speed to turn ON the lamp indicating that vehicle speed is reaching the setpoint." UBYTE _CNV_A_R_LINEAR_____297_CM 1 0. 0. 25.5 ECU_ADDRESS 0xd0006ffa FORMAT "%4.1" /end MEASUREMENT
/begin CHARACTERISTIC Cbx_cru_sl_vs_cmp_prmt "The CC/SL failure due to vehicle speed incoherence is irreversible (1 = irreversible)" VALUE 0xa0021b95 _REC_S1VAL_20_u1 1. _CNV_S_2_RANGE______3_CM 0. 1. BIT_MASK 0x1 /end CHARACTERISTIC
/begin CHARACTERISTIC Cbx_fsl_ena_cfm "" VALUE 0xa0021b94 _REC_S1VAL_20_u1 1. _CNV_S_2_RANGE______3_CM 0. 1. BIT_MASK 0x1 /end CHARACTERISTIC
/begin CHARACTERISTIC Cxx_cru_abst_dspl_vs_dly "Frame absence duration to declare unavailable displayed vehicle speed" VALUE 0xa0021b96 _REC_S1VAL_20_u1 2.55 _CNV_A_R_LINEAR_____32_CM 0. 2.55 FORMAT "%4.2" /end CHARACTERISTIC
/begin CHARACTERISTIC Cxx_cru_abst_vs_dly "Frame absence duration to declare unavailable vehicle speed" VALUE 0xa0021b97 _REC_S1VAL_20_u1 2.55 _CNV_A_R_LINEAR_____32_CM 0. 2.55 FORMAT "%4.2" /end CHARACTERISTIC
/begin CHARACTERISTIC Cxx_cru_long_step "Value of requested speed step in cruise control mode when accel or decel switch pressed continuously" VALUE 0xa0021b98 _REC_S1VAL_20_u1 255. _CNV_A_R_LINEAR_____71_CM 0. 255. FORMAT "%3.0" /end CHARACTERISTIC
/begin CHARACTERISTIC Cxx_cru_long_step_mph "Value of requested speed step in Cruise control mode when accel or decel switch pressed continuously in mph" VALUE 0xa0021b99 _REC_S1VAL_20_u1 255. _CNV_A_R_LINEAR_____465_CM 0. 255. FORMAT "%1.0" /end CHARACTERISTIC
/begin CHARACTERISTIC Cxx_cru_nok_vs_dly "Invalid value duration to  declare invalid vehicle speed" VALUE 0xa0021b9a _REC_S1VAL_20_u1 2.55 _CNV_A_R_LINEAR_____32_CM 0. 2.55 FORMAT "%4.2" /end CHARACTERISTIC
/begin CHARACTERISTIC Cxx_cru_sl_fil_acel_fac "Acceleration digital filtering parameter" VALUE 0xa0021b9b _REC_S1VAL_20_u1 0.99609375 _CNV_A_R_LINEAR_____29_CM 0. 0.99609375 FORMAT "%5.3" /end CHARACTERISTIC
/begin CHARACTERISTIC Cxx_cru_sl_fil_vs_fac "Speed digital filtering parameter" VALUE 0xa0021b9c _REC_S1VAL_20_u1 0.99609375 _CNV_A_R_LINEAR_____29_CM 0. 0.99609375 FORMAT "%5.3" /end CHARACTERISTIC
/begin CHARACTERISTIC Cxx_cru_sl_max_vs "CC/SL maximal speed setpoint" VALUE 0xa0021b9d _REC_S1VAL_20_u1 255. _CNV_A_R_LINEAR_____71_CM 0. 255. FORMAT "%3.0" /end CHARACTERISTIC
/begin CHARACTERISTIC Cxx_cru_sl_max_vs_mph "CC/SL maximal speed setpoint in mph" VALUE 0xa0021b9e _REC_S1VAL_20_u1 255. _CNV_A_R_LINEAR_____465_CM 0. 255. FORMAT "%1.0" /end CHARACTERISTIC
/begin CHARACTERISTIC Cxx_cru_sl_min_vs "CC/SL minimal speed setpoint" VALUE 0xa0021b9f _REC_S1VAL_20_u1 255. _CNV_A_R_LINEAR_____71_CM 0. 255. FORMAT "%3.0" /end CHARACTERISTIC
/begin CHARACTERISTIC Cxx_cru_sl_min_vs_mph "CC/SL minimal speed setpoint in mph" VALUE 0xa0021ba0 _REC_S1VAL_20_u1 255. _CNV_A_R_LINEAR_____465_CM 0. 255. FORMAT "%1.0" /end CHARACTERISTIC
/begin CHARACTERISTIC Cxx_cru_sl_no_efv_vs_thd "Difference between vehicle speed and requested speed to declare CC/SL ineffective" VALUE 0xa0021ba1 _REC_S1VAL_20_u1 25.5 _CNV_A_R_LINEAR_____463_CM 0. 25.5 FORMAT "%4.1" /end CHARACTERISTIC
/begin CHARACTERISTIC Cxx_cru_sl_no_efv_vs_thd_mph "Difference between vehicle speed and requested speed to declare CC/SL ineffective in mph" VALUE 0xa0021ba2 _REC_S1VAL_20_u1 25.5 _CNV_A_R_LINEAR_____464_CM 0. 25.5 FORMAT "%4.1" /end CHARACTERISTIC
/begin CHARACTERISTIC Cxx_cru_sl_smal_step "Value of requested speed step when accel or decel switch pressed during a short time" VALUE 0xa0021ba3 _REC_S1VAL_20_u1 255. _CNV_A_R_LINEAR_____71_CM 0. 255. FORMAT "%3.0" /end CHARACTERISTIC
/begin CHARACTERISTIC Cxx_cru_sl_smal_step_mph "Value of requested speed step when accel or decel switch pressed during a short time in mph" VALUE 0xa0021ba4 _REC_S1VAL_20_u1 255. _CNV_A_R_LINEAR_____465_CM 0. 255. FORMAT "%1.0" /end CHARACTERISTIC
/begin CHARACTERISTIC Cxx_cru_vs_secu_min "Minimum speed to test the speed coherence" VALUE 0xa0021ba5 _REC_S1VAL_20_u1 255. _CNV_A_R_LINEAR_____71_CM 0. 255. FORMAT "%3.0" /end CHARACTERISTIC
/begin CHARACTERISTIC Cxx_cru_vs_sp_rat "Minimum vehicle speed/requested speed ratio to disconnect cruise control" VALUE 0xa0021b8a _REC_S1VAL_20_u2 200. _CNV_A_R_LINEAR_____146_CM 0. 200. FORMAT "%6.2" /end CHARACTERISTIC
/begin CHARACTERISTIC Cxx_dfdec_cru_vs_cmp "CC/SL mux vehicle speed coherence Detected Failure Counter Decrement" VALUE 0xa0021b8c _REC_S1VAL_20_u2 65535. _CNV_A_R_ECME_LINEA_0_CM 0. 65535. FORMAT "%5.0" /end CHARACTERISTIC
/begin CHARACTERISTIC Cxx_dfinc_cru_vs_cmp "CC/SL mux vehicle speed coherence Detected Failure Counter Increment" VALUE 0xa0021b8e _REC_S1VAL_20_u2 65535. _CNV_A_R_ECME_LINEA_0_CM 0. 65535. FORMAT "%5.0" /end CHARACTERISTIC
/begin CHARACTERISTIC Cxx_dspl_vs_secu_fac "Factor to detect bad received displayed vehicle speed" VALUE 0xa0021ba6 _REC_S1VAL_20_u1 0.255 _CNV_A_R_LINEAR_____161_CM 0. 0.255 FORMAT "%5.3" /end CHARACTERISTIC
/begin CHARACTERISTIC Cxx_dspl_vs_secu_ofs "Offset to detect bad received displayed vehicle speed" VALUE 0xa0021b90 _REC_S1VAL_20_u2 655.35 _CNV_A_R_LINEAR_____125_CM 0. 655.35 FORMAT "%6.2" /end CHARACTERISTIC
/begin CHARACTERISTIC Cxx_dspl_vs_secu_thd "Threshold to detect bad received displayed vehicle speed" VALUE 0xa0021b92 _REC_S1VAL_20_u2 655.35 _CNV_A_R_LINEAR_____125_CM 0. 655.35 FORMAT "%6.2" /end CHARACTERISTIC
/begin CHARACTERISTIC Cxx_sl_long_step "Value of requested speed step in speed limiter mode when accel or decel switch pressed continuously" VALUE 0xa0021ba7 _REC_S1VAL_20_u1 255. _CNV_A_R_LINEAR_____71_CM 0. 255. FORMAT "%3.0" /end CHARACTERISTIC
/begin CHARACTERISTIC Cxx_sl_long_step_mph "Value of requested speed step in Speed limiter mode when accel or decel switch pressed continuously in mph" VALUE 0xa0021ba8 _REC_S1VAL_20_u1 255. _CNV_A_R_LINEAR_____465_CM 0. 255. FORMAT "%1.0" /end CHARACTERISTIC
/begin CHARACTERISTIC Cxx_vs_clos_spt_lamp_off_thd "Difference between vehicle speed and requested speed to turn OFF the lamp indicating that vehicle speed is reaching the setpoint." VALUE 0xa0021ba9 _REC_S1VAL_20_u1 25.5 _CNV_A_R_LINEAR_____464_CM 0. 25.5 FORMAT "%3.1" /end CHARACTERISTIC
/begin CHARACTERISTIC Cxx_vs_clos_spt_lamp_off_thd_mph "Difference between vehicle speed and requested speed to turn OFF the lamp indicating that vehicle speed is reaching the setpoint  in mph." VALUE 0xa0021baa _REC_S1VAL_20_u1 25.5 _CNV_A_R_LINEAR_____464_CM 0. 25.5 FORMAT "%3.1" /end CHARACTERISTIC
/begin CHARACTERISTIC Cxx_vs_clos_spt_lamp_on_thd "Difference between vehicle speed and requested speed to turn ON the lamp indicating that vehicle speed is reaching the setpoint." VALUE 0xa0021bab _REC_S1VAL_20_u1 25.5 _CNV_A_R_LINEAR_____464_CM 0. 25.5 FORMAT "%3.1" /end CHARACTERISTIC
/begin CHARACTERISTIC Cxx_vs_clos_spt_lamp_on_thd_mph "Difference between vehicle speed and requested speed to turn ON the lamp indicating that vehicle speed is reaching the setpoint  in mph." VALUE 0xa0021bac _REC_S1VAL_20_u1 25.5 _CNV_A_R_LINEAR_____464_CM 0. 25.5 FORMAT "%3.1" /end CHARACTERISTIC
/begin MEASUREMENT Vxx_fsl_max_vs_sp_kmh "Requested speed for fixed speed limiter or statutory limiter" UWORD _CNV_A_R_LINEAR_____125_CM 1 0. 0. 655.35 ECU_ADDRESS 0xd00046ea FORMAT "%6.2" /end MEASUREMENT
/begin MEASUREMENT Vbx_fsl_cfm "Fixed Speed Limiter activated." UBYTE _CNV_S_2_RANGE______3_CM 1 0. 0. 1. ECU_ADDRESS 0xd0006fa9 BIT_MASK 0x1 /end MEASUREMENT
/begin CHARACTERISTIC Cbx_fsl_cfm "(=1) Fixed Speed Limiter activated" VALUE 0xa0021b80 _REC_S1VAL_20_u1 1. _CNV_S_2_RANGE______3_CM 0. 1. BIT_MASK 0x1 /end CHARACTERISTIC
/begin MEASUREMENT Vbx_whl_lk_stt_NVM "Steering wheel switches connection detection. Stored in E²PROM." UBYTE _CNV_S_2_RANGE______3_CM 1 0. 0. 1. DISPLAY_IDENTIFIER InPciCci_NVM.Vbx_whl_lk_stt_NVM ECU_ADDRESS 0xd0006be4 BIT_MASK 0x1 /end MEASUREMENT
/begin MEASUREMENT Vxx_cru_sl_resu_blk_dly_max_NVM "Maximum duration of RESUME button press" UBYTE _CNV_A_R_LINEAR_____68_CM 1 0. 0. 255. DISPLAY_IDENTIFIER InPciCci_NVM.Vxx_cru_sl_resu_blk_dly_max_NVM ECU_ADDRESS 0xd0006be5 FORMAT "%3.0" /end MEASUREMENT
/begin MEASUREMENT Vxx_cru_sl_acel_blk_dly_max_NVM "Maximum duration of SET+ button press" UBYTE _CNV_A_R_LINEAR_____68_CM 1 0. 0. 255. DISPLAY_IDENTIFIER InPciCci_NVM.Vxx_cru_sl_acel_blk_dly_max_NVM ECU_ADDRESS 0xd0006be6 FORMAT "%3.0" /end MEASUREMENT
/begin MEASUREMENT Vxx_cru_sl_decl_blk_dly_max_NVM "Maximum duration of SET- button press" UBYTE _CNV_A_R_LINEAR_____68_CM 1 0. 0. 255. DISPLAY_IDENTIFIER InPciCci_NVM.Vxx_cru_sl_decl_blk_dly_max_NVM ECU_ADDRESS 0xd0006be7 FORMAT "%3.0" /end MEASUREMENT
/begin MEASUREMENT Vxx_cru_sl_susp_blk_dly_max "Maximum duration of SUSPEND button press" UBYTE _CNV_A_R_LINEAR_____68_CM 1 0. 0. 255. DISPLAY_IDENTIFIER InPciCci_NVM.Vxx_cru_sl_susp_blk_dly_max_NVM ECU_ADDRESS 0xd0006be8 FORMAT "%3.0" /end MEASUREMENT
/begin MEASUREMENT Vxx_cru_sl_whl_cmd_blk_ctr_max_NVM "Maximum value of counter for detection of blocked button. Saved in EEPROM" UBYTE _CNV_A_R_ECME_LINEA_0_CM 1 0. 0. 255. DISPLAY_IDENTIFIER InPciCci_NVM.Vxx_cru_sl_whl_cmd_blk_ctr_max_NVM ECU_ADDRESS 0xd0006be9 FORMAT "%3.0" /end MEASUREMENT
/begin MEASUREMENT Vbx_cru_swi_lk_stt_NVM "Detect the cruise control switch connection. Stored in E²PROM." UBYTE _CNV_S_2_RANGE______3_CM 1 0. 0. 1. DISPLAY_IDENTIFIER InPciCci_NVM.Vbx_cru_swi_lk_stt_NVM ECU_ADDRESS 0xd0006bea BIT_MASK 0x1 /end MEASUREMENT
/begin MEASUREMENT Vbx_cru_lk_stt_NVM "Detect cruise control option with security on configuration detection. Stored in E²PROM." UBYTE _CNV_S_2_RANGE______3_CM 1 0. 0. 1. DISPLAY_IDENTIFIER InPciCci_NVM.Vbx_cru_lk_stt_NVM ECU_ADDRESS 0xd0006beb BIT_MASK 0x1 /end MEASUREMENT
/begin MEASUREMENT Vbx_sl_swi_lk_stt_NVM "Detect the speed limiter switch connection. Stored in E²PROM." UBYTE _CNV_S_2_RANGE______3_CM 1 0. 0. 1. DISPLAY_IDENTIFIER InPciCci_NVM.Vbx_sl_swi_lk_stt_NVM ECU_ADDRESS 0xd0006bec BIT_MASK 0x1 /end MEASUREMENT
/begin MEASUREMENT Vbx_sl_lk_stt_NVM "speed limiter option detection with security on configuration detection. Stored in E²PROM." UBYTE _CNV_S_2_RANGE______3_CM 1 0. 0. 1. DISPLAY_IDENTIFIER InPciCci_NVM.Vbx_sl_lk_stt_NVM ECU_ADDRESS 0xd0006bed BIT_MASK 0x1 /end MEASUREMENT
/begin MEASUREMENT Vbx_cru_sl_acel_blk "The SET+ button is blocked" UBYTE _CNV_S_2_RANGE______3_CM 1 0. 0. 1. ECU_ADDRESS 0xd0006c1e BIT_MASK 0x1 /end MEASUREMENT
/begin MEASUREMENT Vbx_cru_sl_decl_blk "The SET- button is blocked" UBYTE _CNV_S_2_RANGE______3_CM 1 0. 0. 1. ECU_ADDRESS 0xd0006c1f BIT_MASK 0x1 /end MEASUREMENT
/begin MEASUREMENT Vbx_cru_sl_lk_ena "Enable cruise control and speed limiter option detection" UBYTE _CNV_S_2_RANGE______3_CM 1 0. 0. 1. ECU_ADDRESS 0xd0006c20 BIT_MASK 0x1 /end MEASUREMENT
/begin MEASUREMENT Vbx_cru_sl_new_lk_ena "Authorization to connect cruise control and speed limiter options (=1 enable)" UBYTE _CNV_S_2_RANGE______3_CM 1 0. 0. 1. ECU_ADDRESS 0xd0007be2 BIT_MASK 0x1 /end MEASUREMENT
/begin MEASUREMENT Vbx_cru_sl_resu_blk "The RESUME button is blocked" UBYTE _CNV_S_2_RANGE______3_CM 1 0. 0. 1. ECU_ADDRESS 0xd0006c21 BIT_MASK 0x1 /end MEASUREMENT
/begin MEASUREMENT Vbx_cru_sl_susp_blk "The SUSPEND button is blocked" UBYTE _CNV_S_2_RANGE______3_CM 1 0. 0. 1. ECU_ADDRESS 0xd0006c22 BIT_MASK 0x1 /end MEASUREMENT
/begin MEASUREMENT Vbx_cru_sl_whl_cmd_blk "One of the CC/SL steering wheel switches is inferred blocked" UBYTE _CNV_S_2_RANGE______3_CM 1 0. 0. 1. ECU_ADDRESS 0xd0006c23 BIT_MASK 0x1 /end MEASUREMENT
/begin MEASUREMENT Vbx_df_cru_sl_swi_chr "CCSL Main Switch Coherence detected failure" UBYTE _CNV_S_2_RANGE______3_CM 1 0. 0. 1. ECU_ADDRESS 0xd0007be3 BIT_MASK 0x1 /end MEASUREMENT
/begin MEASUREMENT Vbx_df_cru_whl_cmd_nok "CCSL steering wheel switched blocked button detected failure" UBYTE _CNV_S_2_RANGE______3_CM 1 0. 0. 1. ECU_ADDRESS 0xd0007be4 BIT_MASK 0x1 /end MEASUREMENT
/begin MEASUREMENT Vbx_df_cru_whl_cmd_oc_scw "CCSL steering switches open circuit detected failure" UBYTE _CNV_S_2_RANGE______3_CM 1 0. 0. 1. ECU_ADDRESS 0xd0007be5 BIT_MASK 0x1 /end MEASUREMENT
/begin MEASUREMENT Vbx_df_cru_whl_cmd_oor "CCSL Steering Wheel Command Switch invalid value detected failure" UBYTE _CNV_S_2_RANGE______3_CM 1 0. 0. 1. ECU_ADDRESS 0xd0007be6 BIT_MASK 0x1 /end MEASUREMENT
/begin MEASUREMENT Vsx_cru_sl_on_off "CC or SL strategy requested by the driver" UBYTE _CNV_A_R_ECME_LINEA_0_CM 1 0. 0. 2. ECU_ADDRESS 0xd0006c1a FORMAT "%1.0" /end MEASUREMENT
/begin MEASUREMENT Vsx_cru_sl_on_off_raw "State of the on off main switch before filtering" UBYTE _CNV_A_R_ECME_LINEA_0_CM 1 0. 0. 3. ECU_ADDRESS 0xd0007be7 FORMAT "%1.0" /end MEASUREMENT
/begin MEASUREMENT Vsx_cru_sl_swi_vld "CCSL switches function validity status: Vsx_cru_sl_swi_vld != Nsx_vld_ok_1 significates that the switches function is out of order" UBYTE _CNV_A_R_ECME_LINEA_0_CM 1 0. 0. 1. ECU_ADDRESS 0xd0007be8 FORMAT "%1.0" /end MEASUREMENT
/begin MEASUREMENT Vxx_acc_cmd_stt "ACC steering wheel commands transmitted to ACC ECU" UBYTE _CNV_A_R_ECME_LINEA_0_CM 1 0. 0. 31. ECU_ADDRESS 0xd0006c1b FORMAT "%2.0" /end MEASUREMENT
/begin MEASUREMENT Vxx_acc_swi "ACC/speed limiter main switch position transmitted to ACC ECU" UBYTE _CNV_A_R_ECME_LINEA_0_CM 1 0. 0. 3. ECU_ADDRESS 0xd0007be9 FORMAT "%1.0" /end MEASUREMENT
/begin MEASUREMENT Vxx_cru_sl_whl_cmd_raw "State of the steering wheel buttons : not filtered" UBYTE _CNV_A_R_ECME_LINEA_0_CM 1 0. 0. 6. ECU_ADDRESS 0xd0007bea FORMAT "%1.0" /end MEASUREMENT
/begin MEASUREMENT Vxx_cru_sl_whl_cmd_stt "State of the steering wheel push buttons" UBYTE _CNV_A_R_ECME_LINEA_0_CM 1 0. 0. 6. ECU_ADDRESS 0xd0006c1c FORMAT "%1.0" /end MEASUREMENT
/begin MEASUREMENT Vxx_sta_swi_act_ctr "Counter : increment at each START button push" UBYTE _CNV_A_R_ECME_LINEA_0_CM 1 0. 0. 7. ECU_ADDRESS 0xd0006c1d FORMAT "%1.0" /end MEASUREMENT
/begin CHARACTERISTIC Cbx_cru_sl_lk_rls_ena "Connection detection with the release position authorized (1 = authorized)" VALUE 0xa00215a0 _REC_S1VAL_20_u1 1. _CNV_A_R_ECME_LINEA_0_CM 0. 1. FORMAT "%1.0" BIT_MASK 0x1 /end CHARACTERISTIC
/begin CHARACTERISTIC Cbx_cru_sl_swi_chr_prmt "The CC/SL failure due to main switch incoherence is irreversible" VALUE 0xa00215a1 _REC_S1VAL_20_u1 1. _CNV_A_R_ECME_LINEA_0_CM 0. 1. FORMAT "%1.0" BIT_MASK 0x1 /end CHARACTERISTIC
/begin CHARACTERISTIC Cxx_cru_sl_acel_blk_dly "Maxixmum duration of the SET+ press before blocked switch detection" VALUE 0xa0021576 _REC_S1VAL_20_u2 6553.5 _CNV_A_R_LINEAR_____58_CM 0. 6553.5 FORMAT "%6.1" /end CHARACTERISTIC
/begin CHARACTERISTIC Cxx_cru_sl_acel_max_thd "Maximum dec threshold to detect an accel switch press" VALUE 0xa0021578 _REC_S1VAL_20_u2 25000. _CNV_A_R_LINEAR_____107_CM 0. 25000. FORMAT "%5.0" /end CHARACTERISTIC
/begin CHARACTERISTIC Cxx_cru_sl_acel_min_thd "Minimum dec threshold to detect an accel switch press" VALUE 0xa002157a _REC_S1VAL_20_u2 25000. _CNV_A_R_LINEAR_____107_CM 0. 25000. FORMAT "%5.0" /end CHARACTERISTIC
/begin CHARACTERISTIC Cxx_cru_sl_decl_blk_dly "Maxixmum duration of the SET- press before blocked switch detection" VALUE 0xa002157c _REC_S1VAL_20_u2 6553.5 _CNV_A_R_LINEAR_____58_CM 0. 6553.5 FORMAT "%6.1" /end CHARACTERISTIC
/begin CHARACTERISTIC Cxx_cru_sl_decl_max_thd "Maximum dec threshold to detect a decel switch press" VALUE 0xa002157e _REC_S1VAL_20_u2 25000. _CNV_A_R_LINEAR_____107_CM 0. 25000. FORMAT "%5.0" /end CHARACTERISTIC
/begin CHARACTERISTIC Cxx_cru_sl_decl_min_thd "Minimum dec threshold to detect a decel switch press" VALUE 0xa0021580 _REC_S1VAL_20_u2 25000. _CNV_A_R_LINEAR_____107_CM 0. 25000. FORMAT "%5.0" /end CHARACTERISTIC
/begin CHARACTERISTIC Cxx_cru_sl_lk_ena_dly "Filter time to enable the cruise control and speed limiter option detection" VALUE 0xa00215a2 _REC_S1VAL_20_u1 2.55 _CNV_A_R_LINEAR_____32_CM 0. 2.55 FORMAT "%4.2" /end CHARACTERISTIC
/begin CHARACTERISTIC Cxx_cru_sl_lk_vb_thd "Minimum battery voltage to enable the cruise control and speed limiter option detection" VALUE 0xa0021582 _REC_S1VAL_20_u2 25000. _CNV_A_R_LINEAR_____107_CM 0. 25000. FORMAT "%5.0" /end CHARACTERISTIC
/begin CHARACTERISTIC Cxx_cru_sl_open_min_thd "Minimum dec threshold to detect not-connected steering wheel switch" VALUE 0xa0021584 _REC_S1VAL_20_u2 25000. _CNV_A_R_LINEAR_____107_CM 0. 25000. FORMAT "%5.0" /end CHARACTERISTIC
/begin CHARACTERISTIC Cxx_cru_sl_resu_blk_dly "Maxixmum duration of the RESUME press before blocked switch detection" VALUE 0xa0021586 _REC_S1VAL_20_u2 6553.5 _CNV_A_R_LINEAR_____58_CM 0. 6553.5 FORMAT "%6.1" /end CHARACTERISTIC
/begin CHARACTERISTIC Cxx_cru_sl_resu_max_thd "Maximum dec threshold to detect a resume switch press" VALUE 0xa0021588 _REC_S1VAL_20_u2 25000. _CNV_A_R_LINEAR_____107_CM 0. 25000. FORMAT "%5.0" /end CHARACTERISTIC
/begin CHARACTERISTIC Cxx_cru_sl_resu_min_thd "Minimum dec threshold to detect a resume switch press" VALUE 0xa002158a _REC_S1VAL_20_u2 25000. _CNV_A_R_LINEAR_____107_CM 0. 25000. FORMAT "%5.0" /end CHARACTERISTIC
/begin CHARACTERISTIC Cxx_cru_sl_rls_max_thd "Maximum dec threshold to detect non-pressed steering wheel switch" VALUE 0xa002158c _REC_S1VAL_20_u2 25000. _CNV_A_R_LINEAR_____107_CM 0. 25000. FORMAT "%5.0" /end CHARACTERISTIC
/begin CHARACTERISTIC Cxx_cru_sl_rls_min_thd "Minimum dec threshold to detect non-pressed steering wheel switch" VALUE 0xa002158e _REC_S1VAL_20_u2 25000. _CNV_A_R_LINEAR_____107_CM 0. 25000. FORMAT "%5.0" /end CHARACTERISTIC
/begin CHARACTERISTIC Cxx_cru_sl_susp_blk_dly "Maxixmum duration of the SUSPEND press before blocked switch detection" VALUE 0xa0021590 _REC_S1VAL_20_u2 6553.5 _CNV_A_R_LINEAR_____58_CM 0. 6553.5 FORMAT "%6.1" /end CHARACTERISTIC
/begin CHARACTERISTIC Cxx_cru_sl_susp_max_thd "Maximum dec threshold to detect a suspend switch press" VALUE 0xa0021592 _REC_S1VAL_20_u2 25000. _CNV_A_R_LINEAR_____107_CM 0. 25000. FORMAT "%5.0" /end CHARACTERISTIC
/begin CHARACTERISTIC Cxx_cru_sl_swi_dly "Main switch press validation time" VALUE 0xa00215a3 _REC_S1VAL_20_u1 25.5 _CNV_A_R_LINEAR_____58_CM 0. 25.5 FORMAT "%4.1" /end CHARACTERISTIC
/begin CHARACTERISTIC Cxx_cru_sl_swi_igk_dly "Delay to take into account a APC line cut-off" VALUE 0xa00215a4 _REC_S1VAL_20_u1 25.5 _CNV_A_R_LINEAR_____58_CM 0. 25.5 FORMAT "%4.1" /end CHARACTERISTIC
/begin CHARACTERISTIC Cxx_cru_sl_whl_cmd_blk_ctr_max "CC/SL: maximum number of unexpected switch changes before blocked switch detection" VALUE 0xa00215a5 _REC_S1VAL_20_u1 255. _CNV_A_R_ECME_LINEA_0_CM 0. 255. FORMAT "%3.0" /end CHARACTERISTIC
/begin CHARACTERISTIC Cxx_cru_sl_whl_swi_dly "Steering wheel switch press validation time" VALUE 0xa00215a6 _REC_S1VAL_20_u1 2.55 _CNV_A_R_LINEAR_____32_CM 0. 2.55 FORMAT "%4.2" /end CHARACTERISTIC
/begin CHARACTERISTIC Cxx_dfdec_cru_sl_swi_chr "Cruise Control Main Switch Coherence detected failure counter decrement" VALUE 0xa0021594 _REC_S1VAL_20_u2 65535. _CNV_A_R_ECME_LINEA_0_CM 0. 65535. FORMAT "%5.0" /end CHARACTERISTIC
/begin CHARACTERISTIC Cxx_dfdec_cru_whl_cmd "Cruise Control Steering Wheel Command Switch Detected Failure Counter Decrement" VALUE 0xa0021596 _REC_S1VAL_20_u2 65535. _CNV_A_R_ECME_LINEA_0_CM 0. 65535. FORMAT "%5.0" /end CHARACTERISTIC
/begin CHARACTERISTIC Cxx_dfdec_cru_whl_cmd_nok "CCSL steering wheel switches blocked button detected failure counter decrement" VALUE 0xa0021598 _REC_S1VAL_20_u2 65535. _CNV_A_R_ECME_LINEA_0_CM 0. 65535. FORMAT "%5.0" /end CHARACTERISTIC
/begin CHARACTERISTIC Cxx_dfinc_cru_sl_swi_chr "Cruise Control Main Switch Coherence detected failure counter increment" VALUE 0xa002159a _REC_S1VAL_20_u2 65535. _CNV_A_R_ECME_LINEA_0_CM 0. 65535. FORMAT "%5.0" /end CHARACTERISTIC
/begin CHARACTERISTIC Cxx_dfinc_cru_whl_cmd "Cruise Control Steering Wheel Command Switch Detected Failure Counter Increment" VALUE 0xa002159c _REC_S1VAL_20_u2 65535. _CNV_A_R_ECME_LINEA_0_CM 0. 65535. FORMAT "%5.0" /end CHARACTERISTIC
/begin CHARACTERISTIC Cxx_dfinc_cru_whl_cmd_nok "CCSL steering wheel switches blocked button detected failure counter increment" VALUE 0xa002159e _REC_S1VAL_20_u2 65535. _CNV_A_R_ECME_LINEA_0_CM 0. 65535. FORMAT "%5.0" /end CHARACTERISTIC
/begin MEASUREMENT Vbx_cru_swi "" UBYTE _CNV_S_2_RANGE______3_CM 1 0. 0. 1. DISPLAY_IDENTIFIER PcCruCtl_NVM.Vbx_cru_swi_NVM ECU_ADDRESS 0xd0006f1e BIT_MASK 0x1 /end MEASUREMENT
/begin MEASUREMENT Vxx_cru_cmp_diag "" UBYTE _CNV_A_R_ECME_LINEA_0_CM 1 0. 0. 255. DISPLAY_IDENTIFIER PcCruCtl_NVM.Vxx_cru_cmp_diag_NVM ECU_ADDRESS 0xd0006f1f FORMAT "%3.0" /end MEASUREMENT
/begin MEASUREMENT Vbx_cru_cmp_bgin_clu "CC safety failure due to wired clutch information" UBYTE _CNV_S_2_RANGE______3_CM 1 0. 0. 1. ECU_ADDRESS 0xd0006f2a BIT_MASK 0x1 /end MEASUREMENT
/begin MEASUREMENT Vbx_cru_cmp_forc_pres "CC safety failure due to force setpoint presence" UBYTE _CNV_S_2_RANGE______3_CM 1 0. 0. 1. ECU_ADDRESS 0xd0006f2b BIT_MASK 0x1 /end MEASUREMENT
/begin MEASUREMENT Vbx_cru_cmp_open_brk "CC safety failure due to brake clutch information" UBYTE _CNV_S_2_RANGE______3_CM 1 0. 0. 1. ECU_ADDRESS 0xd0006f2c BIT_MASK 0x1 /end MEASUREMENT
/begin MEASUREMENT Vxx_cru_cmp_diag_new "carrier for safety failure diagnosis" UBYTE _CNV_A_R_ECME_LINEA_0_CM 1 0. 0. 255. ECU_ADDRESS 0xd0006f2d FORMAT "%3.0" /end MEASUREMENT
/begin MEASUREMENT Vxx_cru_cmp_diag_prev "Previous carrier for safety failure diagnosis" UBYTE _CNV_A_R_ECME_LINEA_0_CM 1 0. 0. 255. ECU_ADDRESS 0xd0006f2e FORMAT "%3.0" /end MEASUREMENT
/begin MEASUREMENT Vxx_cru_forc_sp "Driving force requested by Cruise Control" SLONG _CNV_A_R_LINEAR_____361_CM 1 0. -20000. 111068. ECU_ADDRESS 0xd0002980 FORMAT "%6.0" /end MEASUREMENT
/begin MEASUREMENT Vxx_cru_sl_stt "Cruise control and speed limiter status : parameter sent to the gearbox on the can network" UBYTE _CNV_A_R_ECME_LINEA_0_CM 1 0. 0. 3. ECU_ADDRESS 0xd0006f2f FORMAT "%1.0" /end MEASUREMENT
/begin MEASUREMENT Vxx_cru_sl_stt_ip "Cruise control and speed limiter status : parameter sent to the cluster on the can network" UBYTE _CNV_A_R_ECME_LINEA_0_CM 1 0. 0. 7. ECU_ADDRESS 0xd0006f30 FORMAT "%1.0" /end MEASUREMENT
/begin MEASUREMENT Vxx_cru_sl_vs_sp "Cruise control and speed limiter requested speed sent to the cluster on the can network" UBYTE _CNV_A_R_ECME_LINEA_0_CM 1 0. 0. 255. ECU_ADDRESS 0xd0006f31 FORMAT "%3.0" /end MEASUREMENT
/begin MEASUREMENT Vxx_csl_forc_sp "Driving force requested by Costumer Speed Limiter" SLONG _CNV_A_R_LINEAR_____361_CM 1 0. -20000. 111068. ECU_ADDRESS 0xd0002984 FORMAT "%6.0" /end MEASUREMENT
/begin CHARACTERISTIC Cbx_bgin_clu_fail_ccp_ena "Enabling boolean for ccp clutch coherence" VALUE 0xa0021b28 _REC_S1VAL_20_u1 1. _CNV_S_2_RANGE______3_CM 0. 1. BIT_MASK 0x1 /end CHARACTERISTIC
/begin CHARACTERISTIC Cbx_bgin_clu_fail_co_ena "Enabling boolean for co clutch coherence" VALUE 0xa0021b29 _REC_S1VAL_20_u1 1. _CNV_S_2_RANGE______3_CM 0. 1. BIT_MASK 0x1 /end CHARACTERISTIC
/begin CHARACTERISTIC Cbx_brk_fail_ccp_ena "Enabling boolean for ccp brake coherence" VALUE 0xa0021b2a _REC_S1VAL_20_u1 1. _CNV_S_2_RANGE______3_CM 0. 1. BIT_MASK 0x1 /end CHARACTERISTIC
/begin CHARACTERISTIC Cbx_brk_fail_co_ena "Enabling boolean for co brake coherence" VALUE 0xa0021b2b _REC_S1VAL_20_u1 1. _CNV_S_2_RANGE______3_CM 0. 1. BIT_MASK 0x1 /end CHARACTERISTIC
/begin CHARACTERISTIC Cbx_ena_brk_cru_swi_cfm "Enabling boolean for safety strategy on brake  switch" VALUE 0xa0021b2c _REC_S1VAL_20_u1 1. _CNV_A_R_ECME_LINEA_0_CM 0. 1. FORMAT "%1.0" BIT_MASK 0x1 /end CHARACTERISTIC
/begin CHARACTERISTIC Cbx_ena_clu_cru_swi_cfm "Enabling boolean for safety strategy on clutch  switch" VALUE 0xa0021b2d _REC_S1VAL_20_u1 1. _CNV_A_R_ECME_LINEA_0_CM 0. 1. FORMAT "%1.0" BIT_MASK 0x1 /end CHARACTERISTIC
/begin CHARACTERISTIC Cxx_bgin_clu_fail_ccp_dly "Admissible delay of incoherence between clutch information due to CAN communication" VALUE 0xa0021b0a _REC_S1VAL_20_u2 655.35 _CNV_A_R_LINEAR_____32_CM 0. 655.35 FORMAT "%6.2" /end CHARACTERISTIC
/begin CHARACTERISTIC Cxx_bgin_clu_fail_co_dly "Admissible delay of incoherence between clutch information due to CAN communication" VALUE 0xa0021b0c _REC_S1VAL_20_u2 655.35 _CNV_A_R_LINEAR_____32_CM 0. 655.35 FORMAT "%6.2" /end CHARACTERISTIC
/begin CHARACTERISTIC Cxx_brk_fail_ccp_dly "Admissible delay of incoherence between brake information due to CAN communication" VALUE 0xa0021b0e _REC_S1VAL_20_u2 655.35 _CNV_A_R_LINEAR_____32_CM 0. 655.35 FORMAT "%6.2" /end CHARACTERISTIC
/begin CHARACTERISTIC Cxx_brk_fail_co_dly "Admissible delay of incoherence between brake information due to CAN communication" VALUE 0xa0021b10 _REC_S1VAL_20_u2 655.35 _CNV_A_R_LINEAR_____32_CM 0. 655.35 FORMAT "%6.2" /end CHARACTERISTIC
/begin CHARACTERISTIC Cxx_cru_forc_sp_dly "Delay for cruise control comfortable deactivation before safety failure detection" VALUE 0xa0021b12 _REC_S1VAL_20_u2 655.35 _CNV_A_R_LINEAR_____32_CM 0. 655.35 FORMAT "%6.2" /end CHARACTERISTIC
/begin CHARACTERISTIC Cxx_cru_forc_sp_thd "Threshold for the maximum force request out of cruise control conditions" VALUE 0xa0021b14 _REC_S1VAL_20_s4 131068. _CNV_A_R_LINEAR_____361_CM -20000. 111068. FORMAT "%6.0" /end CHARACTERISTIC
/begin CHARACTERISTIC Cxx_dfdec_bgin_clu_cmp "Incoherence between clutch information detected failure counter decrement." VALUE 0xa0021b18 _REC_S1VAL_20_u2 65535. _CNV_A_R_ECME_LINEA_0_CM 0. 65535. FORMAT "%5.0" /end CHARACTERISTIC
/begin CHARACTERISTIC Cxx_dfdec_brk_pdl_cmp "Incoherence between brake information detected failure counter decrement." VALUE 0xa0021b1a _REC_S1VAL_20_u2 65535. _CNV_A_R_ECME_LINEA_0_CM 0. 65535. FORMAT "%5.0" /end CHARACTERISTIC
/begin CHARACTERISTIC Cxx_dfdec_cru_cmp "Cruise control safety detected failure counter decrement." VALUE 0xa0021b1c _REC_S1VAL_20_u2 65535. _CNV_A_R_ECME_LINEA_0_CM 0. 65535. FORMAT "%5.0" /end CHARACTERISTIC
/begin CHARACTERISTIC Cxx_dfinc_bgin_clu_cmp "Incoherence between clutch information detected failure counter increment." VALUE 0xa0021b1e _REC_S1VAL_20_u2 65535. _CNV_A_R_ECME_LINEA_0_CM 0. 65535. FORMAT "%5.0" /end CHARACTERISTIC
/begin CHARACTERISTIC Cxx_dfinc_brk_pdl_cmp "Incoherence between brake information detected failure counter increment." VALUE 0xa0021b20 _REC_S1VAL_20_u2 65535. _CNV_A_R_ECME_LINEA_0_CM 0. 65535. FORMAT "%5.0" /end CHARACTERISTIC
/begin CHARACTERISTIC Cxx_dfinc_cru_cmp "Cruise control safety detected failure counter increment." VALUE 0xa0021b22 _REC_S1VAL_20_u2 65535. _CNV_A_R_ECME_LINEA_0_CM 0. 65535. FORMAT "%5.0" /end CHARACTERISTIC
/begin CHARACTERISTIC Cxx_wf_bgin_clu_rams_dly "Delay to confirm activated clutch for safety needs" VALUE 0xa0021b24 _REC_S1VAL_20_u2 655.35 _CNV_A_R_LINEAR_____32_CM 0. 655.35 FORMAT "%6.2" /end CHARACTERISTIC
/begin CHARACTERISTIC Cxx_wf_brk_rams_dly "Delay to confirm activated brake for safety needs" VALUE 0xa0021b26 _REC_S1VAL_20_u2 655.35 _CNV_A_R_LINEAR_____32_CM 0. 655.35 FORMAT "%6.2" /end CHARACTERISTIC
/begin MEASUREMENT Vsx_mux_vh_stt "Vehicle state received on the CAN" UBYTE _CNV_S_5_STATUS_VH__575_CM 1 0. 0. 4. ECU_ADDRESS 0xd00069ee /end MEASUREMENT
/begin MEASUREMENT Vsx_mux_vh_stt_vld "Vehicle state received on the CAN validity status" UBYTE _CNV_S_3_STATUS_OK__179_CM 1 0. 0. 2. ECU_ADDRESS 0xd00069ef /end MEASUREMENT
/begin MEASUREMENT Vbx_mux_eng_auto_stop_req_navl "Engine stop request from Stop and Start supervisor received on the CAN not available" UBYTE _CNV_S_2_RANGE______3_CM 1 0. 0. 1. ECU_ADDRESS 0xd0007926 BIT_MASK 0x1 /end MEASUREMENT
/begin MEASUREMENT Vsx_mux_eng_auto_stop_req_vld "Engine stop request from Stop and Start supervisor received on the CAN validity status" UBYTE _CNV_S_3_STATUS_OK__179_CM 1 0. 0. 2. ECU_ADDRESS 0xd00069ec /end MEASUREMENT
/begin MEASUREMENT Vxx_mux_eng_auto_stop_req "Engine stop request from Stop and Start supervisor received on the CAN" UBYTE _CNV_A_R_ECME_LINEA_0_CM 1 0. 0. 255. ECU_ADDRESS 0xd0007927 FORMAT "%3.0" /end MEASUREMENT
/begin MEASUREMENT SlipControlRequest "Transmitted CAN parameter" UBYTE _CNV_A_R_ECME_LINEA_0_CM 1 0. 0. 3. ECU_ADDRESS 0xd0006938 FORMAT "%3.0" /end MEASUREMENT
/begin MEASUREMENT AdditionalTankFuelLowLevel "Transmitted CAN parameter" UBYTE _CNV_A_R_ECME_LINEA_0_CM 1 0. 0. 1. ECU_ADDRESS 0xd0007858 FORMAT "%3.0" /end MEASUREMENT
/begin MEASUREMENT Vsx_mux_tra_acel_vld "Transverse acceleration sensor received on the CAN validity status" UBYTE _CNV_S_3_STATUS_OK__179_CM 1 0. 0. 2. ECU_ADDRESS 0xd00069ed /end MEASUREMENT
/begin MEASUREMENT Vxx_mux_tra_acel "Transverse acceleration sensor received on the CAN" SLONG _CNV_A_R_LINEAR_____385_CM 1 0. -12. 13.5 ECU_ADDRESS 0xd000254c FORMAT "%8.4" /end MEASUREMENT
/begin COMPU_METHOD _CNV_A_R_ECME_LINEA_0_CM "" RAT_FUNC "%6.3" "-" COEFFS 0 1. 0. 0 0 1 /end COMPU_METHOD
/begin COMPU_METHOD _CNV_S_2_RANGE______3_CM "" TAB_VERB "%6.3" "-" COMPU_TAB_REF _CNV_S_2_RANGE______3 /end COMPU_METHOD
/begin COMPU_VTAB _CNV_S_2_RANGE______3 "" TAB_VERB 2 0 "0" 1 "1" /end COMPU_VTAB
/begin COMPU_METHOD _CNV_A_R_LINEAR_____14_CM "" RAT_FUNC "%6.3" "V" COEFFS 0 6553.599999999993 0. 0 0 1 /end COMPU_METHOD
/begin COMPU_METHOD _CNV_A_R_ENSD_LINEA_22_CM "" RAT_FUNC "%6.3" "rpm" COEFFS 0 4. 0. 0 0 1 /end COMPU_METHOD
/begin COMPU_METHOD _CNV_A_R_LINEAR_____29_CM "" RAT_FUNC "%6.3" "-" COEFFS 0 256. 0. 0 0 1 /end COMPU_METHOD
/begin COMPU_METHOD _CNV_A_R_LINEAR_____32_CM "" RAT_FUNC "%6.3" "s" COEFFS 0 100. 0. 0 0 1 /end COMPU_METHOD
/begin COMPU_METHOD _CNV_A_R_LINEAR_____58_CM "" RAT_FUNC "%6.3" "s" COEFFS 0 10. 0. 0 0 1 /end COMPU_METHOD
/begin COMPU_METHOD _CNV_A_R_LINEAR_____68_CM "" RAT_FUNC "%6.3" "s" COEFFS 0 1. 0. 0 0 1 /end COMPU_METHOD
/begin COMPU_METHOD _CNV_A_R_LINEAR_____71_CM "" RAT_FUNC "%6.3" "km/h" COEFFS 0 1. 0. 0 0 1 /end COMPU_METHOD
/begin COMPU_METHOD _CNV_A_R_A_105_CM "" RAT_FUNC "%6.3" "" COEFFS 0 1. 0. 0 0 1 /end COMPU_METHOD
/begin COMPU_METHOD _CNV_A_R_LINEAR_____107_CM "" RAT_FUNC "%6.3" "mV" COEFFS 0 1. 0. 0 0 1 /end COMPU_METHOD
/begin COMPU_METHOD _CNV_A_R_LINEAR_____110_CM "" RAT_FUNC "%6.3" "°C" COEFFS 0 10. 400. 0 0 1 /end COMPU_METHOD
/begin COMPU_METHOD _CNV_A_R_LINEAR_____116_CM "" RAT_FUNC "%6.3" "s" COEFFS 0 1000. 0. 0 0 1 /end COMPU_METHOD
/begin COMPU_METHOD _CNV_A_R_LINEAR_____123_CM "" RAT_FUNC "%6.3" "-" COEFFS 0 100. 0. 0 0 1 /end COMPU_METHOD
/begin COMPU_METHOD _CNV_A_R_LINEAR_____125_CM "" RAT_FUNC "%6.3" "km/h" COEFFS 0 100. 0. 0 0 1 /end COMPU_METHOD
/begin COMPU_METHOD _CNV_A_R_LINEAR_____146_CM "" RAT_FUNC "%6.3" "%" COEFFS 0 100. 0. 0 0 1 /end COMPU_METHOD
/begin COMPU_METHOD _CNV_A_R_LINEAR_____161_CM "" RAT_FUNC "%6.3" "-" COEFFS 0 1000. 0. 0 0 1 /end COMPU_METHOD
/begin COMPU_METHOD _CNV_A_R_LINEAR_____165_CM "" RAT_FUNC "%6.3" "%" COEFFS 0 2.55 0. 0 0 1 /end COMPU_METHOD
/begin COMPU_METHOD _CNV_S_3_STATUS_OK__179_CM "" TAB_VERB "%6.3" "-" COMPU_TAB_REF _CNV_S_3_STATUS_OK__179 /end COMPU_METHOD
/begin COMPU_VTAB _CNV_S_3_STATUS_OK__179 "" TAB_VERB 3 0 "Nsx_vld_nok_0" 1 "Nsx_vld_ok_1" 2 "Nsx_vld_fail_2" /end COMPU_VTAB
/begin COMPU_METHOD _CNV_S_4_STATUS_OK__180_CM "" TAB_VERB "%6.3" "-" COMPU_TAB_REF _CNV_S_4_STATUS_OK__180 /end COMPU_METHOD
/begin COMPU_VTAB _CNV_S_4_STATUS_OK__180 "" TAB_VERB 4 0 "Nsx_vld_nok_0" 1 "Nsx_vld_ok_1" 2 "Nsx_vld_fail_2" 3 "Nsx_vld_fail_3" /end COMPU_VTAB
/begin COMPU_METHOD _CNV_A_R_LINEAR_____181_CM "" RAT_FUNC "%6.3" "Nm" COEFFS 0 32. 0. 0 0 1 /end COMPU_METHOD
/begin COMPU_METHOD _CNV_A_R_LINEAR_____185_CM "" RAT_FUNC "%6.3" "Nm" COEFFS 0 32. 32768. 0 0 1 /end COMPU_METHOD
/begin COMPU_METHOD _CNV_A_R_LINEAR_____186_CM "" RAT_FUNC "%6.3" "W" COEFFS 0 0.1 0. 0 0 1 /end COMPU_METHOD
/begin COMPU_METHOD _CNV_A_R_LINEAR_____201_CM "" RAT_FUNC "%6.3" "ms" COEFFS 0 1. 0. 0 0 1 /end COMPU_METHOD
/begin COMPU_METHOD _CNV_A_R_LINEAR_____216_CM "" RAT_FUNC "%6.3" "Nm" COEFFS 0 32. 12800. 0 0 1 /end COMPU_METHOD
/begin COMPU_METHOD _CNV_S_8_STATUS_OK__234_CM "" TAB_VERB "%6.3" "-" COMPU_TAB_REF _CNV_S_8_STATUS_OK__234 /end COMPU_METHOD
/begin COMPU_VTAB _CNV_S_8_STATUS_OK__234 "" TAB_VERB 8 0 "Nsx_vld_nok_0" 1 "Nsx_vld_ok_1" 2 "Nsx_vld_fail_2" 3 "Nsx_vld_fail_3" 4 "Nsx_vld_fail_4" 5 "Nsx_vld_fail_5" 6 "Nsx_vld_fail_6" 7 "Nsx_vld_fail_7" /end COMPU_VTAB
/begin COMPU_METHOD _CNV_A_R_LINEAR_____274_CM "" RAT_FUNC "%6.3" "km" COEFFS 0 1. 0. 0 0 1 /end COMPU_METHOD
/begin COMPU_METHOD _CNV_A_R_LINEAR_____297_CM "" RAT_FUNC "%6.3" "-" COEFFS 0 10. 0. 0 0 1 /end COMPU_METHOD
/begin COMPU_METHOD _CNV_A_R_LINEAR_____313_CM "" RAT_FUNC "%6.3" "-" COEFFS 0 100. 1000. 0 0 1 /end COMPU_METHOD
/begin COMPU_METHOD _CNV_S_4_STATUS_OK__338_CM "" TAB_VERB "%6.3" "" COMPU_TAB_REF _CNV_S_4_STATUS_OK__338 /end COMPU_METHOD
/begin COMPU_VTAB _CNV_S_4_STATUS_OK__338 "" TAB_VERB 4 0 "Nsx_vld_nok_0" 1 "Nsx_vld_ok_1" 2 "Nsx_vld_fail_2" 3 "Nsx_vld_fail_3" /end COMPU_VTAB
/begin COMPU_METHOD _CNV_A_R_LINEAR_____361_CM "" RAT_FUNC "%6.3" "N" COEFFS 0 0.5 0. 0 0 1 /end COMPU_METHOD
/begin COMPU_METHOD _CNV_A_R_LINEAR_____385_CM "" RAT_FUNC "%6.3" "m/s²" COEFFS 0 2500. 0. 0 0 1 /end COMPU_METHOD
/begin COMPU_METHOD _CNV_A_R_LINEAR_____459_CM "" RAT_FUNC "%6.3" "(Nm/rpm)^(1/2)" COEFFS 0 1000. 0. 0 0 1 /end COMPU_METHOD
/begin COMPU_METHOD _CNV_A_R_LINEAR_____460_CM "" RAT_FUNC "%6.3" "(Nm/rpm)^(1/2)" COEFFS 0 32. 12800. 0 0 1 /end COMPU_METHOD
/begin COMPU_METHOD _CNV_A_R_LINEAR_____461_CM "" RAT_FUNC "%6.3" "km" COEFFS 0 10. 0. 0 0 1 /end COMPU_METHOD
/begin COMPU_METHOD _CNV_A_R_LINEAR_____462_CM "" RAT_FUNC "%6.3" "m/s²" COEFFS 0 10. 0. 0 0 1 /end COMPU_METHOD
/begin COMPU_METHOD _CNV_A_R_LINEAR_____463_CM "" RAT_FUNC "%6.3" "km/h" COEFFS 0 10. 0. 0 0 1 /end COMPU_METHOD
/begin COMPU_METHOD _CNV_A_R_LINEAR_____464_CM "" RAT_FUNC "%6.3" "mph" COEFFS 0 10. 0. 0 0 1 /end COMPU_METHOD
/begin COMPU_METHOD _CNV_A_R_LINEAR_____465_CM "" RAT_FUNC "%6.3" "mph" COEFFS 0 1. 0. 0 0 1 /end COMPU_METHOD
/begin COMPU_METHOD _CNV_S_5_STATUS_VH__575_CM "" TAB_VERB "%6.3" "-" COMPU_TAB_REF _CNV_S_5_STATUS_VH__575 /end COMPU_METHOD
/begin COMPU_VTAB _CNV_S_5_STATUS_VH__575 "" TAB_VERB 5 0 "Nsx_vh_stt_off" 1 "Nsx_vh_stt_on" 2 "Nsx_vh_stt_on_igk" 3 "Nsx_vh_stt_on_eng_sta" 4 "Nsx_vh_stt_on_eng_run" /end COMPU_VTAB
/begin RECORD_LAYOUT _REC_S1VAL_20_u4 FNC_VALUES 1 ULONG COLUMN_DIR DIRECT /end RECORD_LAYOUT
/begin RECORD_LAYOUT _REC_S1VAL_20_u1 FNC_VALUES 1 UBYTE COLUMN_DIR DIRECT /end RECORD_LAYOUT
/begin RECORD_LAYOUT _REC_A2AXS_20_u1 NO_AXIS_PTS_X 1 UBYTE AXIS_PTS_X 2 UBYTE INDEX_INCR DIRECT /end RECORD_LAYOUT
/begin RECORD_LAYOUT _REC_S1VAL_20_u2 FNC_VALUES 1 UWORD COLUMN_DIR DIRECT /end RECORD_LAYOUT
/begin RECORD_LAYOUT _REC_S1VAL_20_s2 FNC_VALUES 1 SWORD COLUMN_DIR DIRECT /end RECORD_LAYOUT
/begin RECORD_LAYOUT _REC_A2AXS_20_u2 NO_AXIS_PTS_X 1 UWORD AXIS_PTS_X 2 UWORD INDEX_INCR DIRECT /end RECORD_LAYOUT
/begin RECORD_LAYOUT _REC_A1MAP_20_u2_u2_u2 FNC_VALUES 1 UWORD COLUMN_DIR DIRECT /end RECORD_LAYOUT
/begin RECORD_LAYOUT _REC_A1CUR_20_u2_u2 FNC_VALUES 1 UWORD COLUMN_DIR DIRECT /end RECORD_LAYOUT
/begin RECORD_LAYOUT _REC_A1MAP_20_u2_u2_u1 FNC_VALUES 1 UWORD COLUMN_DIR DIRECT /end RECORD_LAYOUT
/begin RECORD_LAYOUT _REC_S1VAL_20_s1 FNC_VALUES 1 SBYTE COLUMN_DIR DIRECT /end RECORD_LAYOUT
/begin RECORD_LAYOUT _REC_A1MAP_20_u2_u1_u2 FNC_VALUES 1 UWORD COLUMN_DIR DIRECT /end RECORD_LAYOUT
/begin RECORD_LAYOUT _REC_S1VAL_20_s4 FNC_VALUES 1 SLONG COLUMN_DIR DIRECT /end RECORD_LAYOUT
/begin FUNCTION CmMuxSer_Rxp50in "" /begin DEF_CHARACTERISTIC Cbx_vh_key_navl_val Cxx_eng_aut_can_diag_dly /end DEF_CHARACTERISTIC
 /begin OUT_MEASUREMENT Vbx_can_diag Vbx_can_diag_raw Vbx_mux_ac_acel_is_sp_navl Vbx_mux_ac_mdf1_req Vbx_mux_ac_mdf2_req Vbx_mux_ac_req Vbx_mux_ac_req_ext Vbx_mux_ac_req_int Vbx_mux_agb_mdf1_req Vbx_mux_agb_mdf2_req Vbx_mux_can_diag Vbx_mux_dspl_vs_in_mph Vbx_mux_dspl_vs_navl Vbx_mux_vh_key Vbx_mux_vs_navl Vsx_mux_ac_acel_is_sp_vld Vsx_mux_ac_mdf_req_vld Vsx_mux_ac_req_ext_vld Vsx_mux_ac_req_int_vld Vsx_mux_ac_req_vld Vsx_mux_agb_mdf_req_vld Vsx_mux_dspl_vs_vld Vsx_mux_ena_sta_agb Vsx_mux_ena_sta_agb_vld Vsx_mux_sta_stt_vld Vsx_mux_vs_vld Vxx_mux_ac_acel_is_sp Vxx_mux_airb1 Vxx_mux_airb2 Vxx_mux_dspl_vs Vxx_mux_eng_stop_req_ccu Vxx_mux_eng_stop_req_rgb Vxx_mux_sta_stt Vxx_mux_sta_swi_act_ctr Vxx_mux_vs /end OUT_MEASUREMENT
/end FUNCTION
/begin FUNCTION CmMuxSer_Schxxxx ""
 /begin DEF_CHARACTERISTIC Cbx_esm_cfm Cbx_rs_gear_shf_cfm Cxx_pwst_prs_auto_conf_cfm Cxx_sas_cfm /end DEF_CHARACTERISTIC
 /begin OUT_MEASUREMENT Vbx_esm_cfm Vbx_mux_airb_cfm Vbx_mux_bpk_cfm Vbx_mux_dspl_vs_cfm Vbx_mux_end_str_clu_cnt_cfm Vbx_mux_eng_stop_req_ccu_cfm Vbx_mux_fwhs_cfm Vbx_mux_neut_cnt_cfm Vbx_mux_rvr_cnt_cfm Vbx_mux_rwhs_cfm Vbx_mux_sta_stt_cfm Vbx_mux_tra_acel_cfm Vbx_mux_vh_dist_cfm Vbx_mux_vh_key_cfm Vbx_rs_gear_shf_cfm Vbx_sens_brk_pdl_clos_cfm Vbx_wf_ac_req_cfm Vbx_wf_acs_acel_is_req_cfm Vbx_wf_alt_cfm Vbx_wf_comp_cfa_cfm Vbx_wf_fuel_lvl_cfm Vbx_wf_vs_cfm Vxx_pwst_prs_auto_conf_cfm Vxx_sas_cfm /end OUT_MEASUREMENT
/end FUNCTION
/begin FUNCTION CmMuxSer_Smat1in "" /begin OUT_MEASUREMENT Vbx_mux_agb_is_acel_req Vsx_mux_agb_is_acel_req_vld /end OUT_MEASUREMENT /end FUNCTION
/begin FUNCTION CmMuxSer_Smat2in ""
 /begin OUT_MEASUREMENT Vbx_mux_agb_is_acel_sp_navl Vsx_mux_agb_is_acel_sp_vld Vxx_mux_agb_is_acel_sp /end OUT_MEASUREMENT
/end FUNCTION
/begin FUNCTION CmMuxSer_Smengou "" /begin OUT_MEASUREMENT EngineStatus_R /end OUT_MEASUREMENT /end FUNCTION
/begin FUNCTION CmMuxSer_Smlimin ""
 /begin OUT_MEASUREMENT Vbx_mux_egb_n_lim_navl Vsx_mux_egb_n_lim_vld Vxx_mux_egb_n_lim /end OUT_MEASUREMENT
/end FUNCTION
/begin FUNCTION CmMuxSer_Smovnou "" /begin OUT_MEASUREMENT MaxEngineSpeedRequest MinEngineSpeedRequest /end OUT_MEASUREMENT /end FUNCTION
/begin FUNCTION CmMuxSer_Smptcin "" /begin OUT_MEASUREMENT Vbx_mux_ptc_is_acel_req Vsx_mux_ptc_is_acel_vld /end OUT_MEASUREMENT /end FUNCTION
/begin FUNCTION CmMuxSer_Smspdou "" /begin OUT_MEASUREMENT EngineRPM /end OUT_MEASUREMENT /end FUNCTION
/begin FUNCTION CmMuxSer_Smsptou "" /begin OUT_MEASUREMENT IdleSpeedControlInternalRequest /end OUT_MEASUREMENT /end FUNCTION
/begin FUNCTION CmMuxSer_Tqampou "" /begin OUT_MEASUREMENT AlternatorMaximumPower /end OUT_MEASUREMENT /end FUNCTION
/begin FUNCTION CmMuxSer_Tqapgou "" /begin OUT_MEASUREMENT AllowedPowerGradient AllowedPowerGradientNeg /end OUT_MEASUREMENT /end FUNCTION
/begin FUNCTION CmMuxSer_Tqecfou "" /begin OUT_MEASUREMENT ElectricalPowerCutFreeze /end OUT_MEASUREMENT /end FUNCTION
/begin FUNCTION CmMuxSer_Tqestou "" /begin OUT_MEASUREMENT MeanEffectiveTorque /end OUT_MEASUREMENT /end FUNCTION
/begin FUNCTION CmMuxSer_Tqlosou "" /begin OUT_MEASUREMENT FrictionTorque /end OUT_MEASUREMENT /end FUNCTION
/begin FUNCTION CmMuxSer_Tqmaxou "" /begin OUT_MEASUREMENT MaximumInstantTorque /end OUT_MEASUREMENT /end FUNCTION
/begin FUNCTION CmMuxSer_Tqminou "" /begin OUT_MEASUREMENT MinimumInstantTorque /end OUT_MEASUREMENT /end FUNCTION
/begin FUNCTION CmMuxSer_Tqmpaou "" /begin OUT_MEASUREMENT MaxElectricalPowerAllowed /end OUT_MEASUREMENT /end FUNCTION
/begin FUNCTION CmMuxSer_Tqpalin "" /begin OUT_MEASUREMENT Vbx_mux_alt_pow_navl Vsx_mux_alt_pow_vld Vxx_mux_alt_pow /end OUT_MEASUREMENT /end FUNCTION
/begin FUNCTION CmMuxSer_Tqreqou "" /begin OUT_MEASUREMENT ECM_TorqueRequestStatus /end OUT_MEASUREMENT /end FUNCTION
/begin FUNCTION CmMuxSer_Tqprgin "" /begin OUT_MEASUREMENT Vsx_mux_rgb_pump_vld Vxx_mux_rgb_pump /end OUT_MEASUREMENT /end FUNCTION
/begin FUNCTION CmMuxSer_Txfrmxx ""
 /begin OUT_MEASUREMENT ECM_CANHS_RNr_01[0] ECM_CANHS_RNr_01[1] ECM_CANHS_RNr_01[2] ECM_CANHS_RNr_01[3] ECM_CANHS_RNr_01[4] ECM_CANHS_RNr_01[5] ECM_CANHS_RNr_01[6] ECM_CANHS_RNr_01[7] ECM_CANHS_RNr_02[0] ECM_CANHS_RNr_02[1] ECM_CANHS_RNr_02[2] ECM_CANHS_RNr_02[3] ECM_CANHS_RNr_02[4] ECM_CANHS_RNr_02[5] ECM_CANHS_RNr_02[6] ECM_CANHS_R_03[0] ECM_CANHS_R_03[1] ECM_CANHS_R_03[2] ECM_VERLOG[0] ECM_VERLOG[1] ECM_VERLOG[2] ECM_VERLOG[3] ECM_VERLOG[4] ECM_VERLOG[5] ECM_VERLOG[6] FORCE_ECM_CANHS_R_01[0] FORCE_ECM_CANHS_R_01[1] FORCE_ECM_CANHS_R_01[2] FORCE_ECM_CANHS_R_01[3] FORCE_ECM_CANHS_R_01[4] FORCE_ECM_CANHS_R_01[5] FORCE_ECM_CANHS_R_01[6] FORCE_ECM_CANHS_R_01[7] MMI_ECM_CANHS_RNr_01[0] MMI_ECM_CANHS_RNr_01[1] MMI_ECM_CANHS_RNr_01[2] MMI_ECM_CANHS_RNr_01[3] MMI_ECM_CANHS_RNr_01[4] MMI_ECM_CANHS_RNr_01[5] MMI_ECM_CANHS_RNr_01[6] MMI_ECM_CANHS_Rst_01[0] MMI_ECM_CANHS_Rst_01[1] MMI_ECM_CANHS_Rst_01[2] MMI_ECM_CANHS_Rst_01[3] MMI_ECM_CANHS_Rst_01[4] MMI_ECM_CANHS_Rst_01[5] MMI_ECM_CANHS_Rst_01[6] MMI_ECM_CANHS_Rst_01[7] TORQUE_ECM_CANHS_RNr_01[0] TORQUE_ECM_CANHS_RNr_01[1] TORQUE_ECM_CANHS_RNr_01[2] TORQUE_ECM_CANHS_RNr_01[3] TORQUE_ECM_CANHS_RNr_01[4] TORQUE_ECM_CANHS_RNr_01[5] TORQUE_ECM_CANHS_RNr_01[6] TORQUE_ECM_CANHS_RNr_02[0] TORQUE_ECM_CANHS_RNr_02[1] TORQUE_ECM_CANHS_RNr_02[2] TORQUE_ECM_CANHS_RNr_02[3] TORQUE_ECM_CANHS_RNr_02[4] TORQUE_ECM_CANHS_RNr_02[5] TORQUE_ECM_CANHS_R_01[0] TORQUE_ECM_CANHS_R_01[1] TORQUE_ECM_CANHS_R_01[2] TORQUE_ECM_CANHS_R_01[3] TORQUE_ECM_CANHS_R_01[4] /end OUT_MEASUREMENT
/end FUNCTION
/begin FUNCTION CmMuxSer_Txp50ou ""
 /begin OUT_MEASUREMENT ACHighPressureSensor CCSpeedReachedDisplayReq CrankingAuthorization_ECM CruiseControlStatusDisplay CruiseControlStatus_forTM EngineFanSpeedRequest EngineStopRequestOrigine OverspeedIndicationDisplayReq RequestedSpeedDisplayRequest /end OUT_MEASUREMENT
/end FUNCTION
/begin FUNCTION CmMuxSer_Smwixin "" /begin OUT_MEASUREMENT Vbx_mux_el_bk_wind Vbx_mux_el_wind_is_acel /end OUT_MEASUREMENT /end FUNCTION
/begin FUNCTION CmMuxSer_Tqacxin "" /begin OUT_MEASUREMENT Vbx_mux_ac_pow_navl Vsx_mux_ac_pow_vld Vxx_mux_ac_pow /end OUT_MEASUREMENT /end FUNCTION
/begin FUNCTION CmMuxSer_Tqacxou "" /begin OUT_MEASUREMENT ACCompMaximumPower /end OUT_MEASUREMENT /end FUNCTION
/begin FUNCTION CmMuxSer_Vfacxin "" /begin OUT_MEASUREMENT Vbx_mux_ac_clu_req Vsx_mux_ac_clu_req_vld /end OUT_MEASUREMENT /end FUNCTION
/begin FUNCTION CmMuxSer_Vfacxou "" /begin OUT_MEASUREMENT ACCompAuthorized ACCompClutchActivation /end OUT_MEASUREMENT /end FUNCTION
/begin FUNCTION CmMuxSer_Vfadfin "" /begin OUT_MEASUREMENT Vbx_mux_alt_pwm_navl Vsx_mux_alt_pwm_vld Vxx_mux_alt_pwm /end OUT_MEASUREMENT /end FUNCTION
/begin FUNCTION CmMuxSer_Vffltou "" /begin OUT_MEASUREMENT FloatingInhibition /end OUT_MEASUREMENT /end FUNCTION
/begin FUNCTION CmMuxSer_Vfptcin "" /begin OUT_MEASUREMENT Vbx_mux_ptc_pow_navl Vsx_mux_ptc_pow_vld Vxx_mux_ptc_pow /end OUT_MEASUREMENT /end FUNCTION
/begin FUNCTION CmMuxSer_Vfrwsin ""
 /begin OUT_MEASUREMENT Vbx_mux_lft_rwhs_navl Vbx_mux_rgt_rwhs_navl Vsx_mux_lft_rwhs_vld Vsx_mux_rgt_rwhs_vld Vxx_mux_lft_rwhs Vxx_mux_rgt_rwhs /end OUT_MEASUREMENT
/end FUNCTION
/begin FUNCTION CmMuxSer_Vftacin "" /begin OUT_MEASUREMENT Vsx_mux_tra_acel_vld Vxx_mux_tra_acel /end OUT_MEASUREMENT /end FUNCTION
/begin FUNCTION CmMuxSer_Pctbnin ""
 /begin OUT_MEASUREMENT Vbx_mux_prim_sha_spd_navl Vsx_mux_prim_sha_spd_vld Vxx_mux_prim_sha_spd /end OUT_MEASUREMENT
/end FUNCTION
/begin FUNCTION CmMuxSer_Smgshou "" /begin OUT_MEASUREMENT RST_GearShift /end OUT_MEASUREMENT /end FUNCTION
/begin FUNCTION CmMuxSer_Rsdspou ""
 /begin OUT_MEASUREMENT RST_BoostPressure RST_CurrentGear RST_EngineCoolantTemp RST_EngineStatus RST_FuelConsumption RST_IntakeAirTemperature RST_KickDownActivated RST_OilTemperature RST_OvertorqueState RST_PowerTrainSetPoint /end OUT_MEASUREMENT
/end FUNCTION
/begin FUNCTION CmMuxSer_Pcrspin ""
 /begin OUT_MEASUREMENT Vxx_mux_rs_dspl_pdl_spt_fac Vxx_mux_rs_dspl_pdl_spt_fac_raw /end OUT_MEASUREMENT
/end FUNCTION
/begin FUNCTION CmMuxSer_Smrsgin "" /begin OUT_MEASUREMENT Vxx_mux_gear_cge_max_ofs /end OUT_MEASUREMENT /end FUNCTION
/begin FUNCTION CmMuxSer_Pcrssin "" /begin OUT_MEASUREMENT Vbx_mux_raw_dyn_mod_req Vxx_mux_raw_dyn_mod_req_raw /end OUT_MEASUREMENT /end FUNCTION
/begin FUNCTION CmMuxSer_Vfvhsin "" /begin OUT_MEASUREMENT Vsx_mux_vh_stt Vsx_mux_vh_stt_vld /end OUT_MEASUREMENT /end FUNCTION
/begin FUNCTION CmMuxSer_Vfssxin ""
 /begin OUT_MEASUREMENT Vbx_mux_eng_auto_stop_req_navl Vsx_mux_eng_auto_stop_req_vld Vxx_mux_eng_auto_stop_req /end OUT_MEASUREMENT
/end FUNCTION
/begin FUNCTION CmMuxSer_Pcsliou "" /begin OUT_MEASUREMENT SlipControlRequest /end OUT_MEASUREMENT /end FUNCTION
/begin FUNCTION CmMuxSer_Cbfatou "" /begin OUT_MEASUREMENT AdditionalTankFuelLowLevel /end OUT_MEASUREMENT /end FUNCTION
/begin FUNCTION SmCajCtl "" /begin SUB_FUNCTION SmCajCtl_Ajcorxx SmCajCtl_Spcpaxx SmCajCtl_Coracxx /end SUB_FUNCTION /end FUNCTION
/begin FUNCTION SmCajCtl_Ajcorxx ""
 /begin DEF_CHARACTERISTIC Ctb_ajs_cor_driv_tq_fac Ctb_ajs_cor_n Ctb_ajs_cor_n_diff Ctb_ajs_cor_tco Ctb_ajs_dt_tq_rat Cmp_ajs_cor_fast_cor_dly Cmp_ajs_cor_t1_acel_dt_clos Cmp_ajs_cor_t1_decl_dt_clos Cmp_ajs_cor_t1_fast_cor Cmp_ajs_cor_td_acel_dt_clos Cmp_ajs_cor_td_acel_n_fac Cmp_ajs_cor_td_decl_dt_clos Cmp_ajs_cor_td_decl_n_fac Cmp_ajs_cor_td_fast_cor Cmp_ajs_cor_td_tq_acel_fac Cmp_ajs_cor_td_tq_decl_fac Ctp_ajs_cor_dz_tqe Ctp_ajs_cor_fast_cor_dly_fac Ctp_ajs_cor_max_cor_dyn_tqe Ctp_ajs_cor_min_cor_dyn_tqe Ctp_ajs_cor_t1_fast_cor_fac Ctp_ajs_cor_td_fast_cor_fac Cbx_ajs_cor_brk_cut_cfm Cbx_ajs_cor_driv_cut_cfm Cbx_ajs_cor_dz_cfm Cbx_ajs_cor_is_cfm Cbx_ajs_cor_stt_cfm Cxx_ajs_cor_dz_dly Cxx_ajs_cor_max_cor_dyn_dt_open Cxx_ajs_cor_max_fast_cor Cxx_ajs_cor_min_cor_dyn_dt_open Cxx_ajs_cor_min_fast_cor Cxx_ajs_cor_t1_acel_dt_modu Cxx_ajs_cor_t1_acel_dt_open Cxx_ajs_cor_t1_decl_dt_modu Cxx_ajs_cor_t1_decl_dt_open Cxx_ajs_cor_t1_dt_ini Cxx_ajs_cor_td_acel_dt_modu Cxx_ajs_cor_td_acel_dt_open Cxx_ajs_cor_td_decl_dt_modu Cxx_ajs_cor_td_decl_dt_open Cxx_ajs_cor_td_dt_ini Cxx_ajs_cor_tkof_vs_thd /end DEF_CHARACTERISTIC
 /begin OUT_MEASUREMENT Vbx_ajs_cor_fast_cor_off Vbx_ajs_cor_fast_cor_on Vbx_ajs_cor_stt_cut Vsx_ajs_cor_stt_para Vxx_ajs_cor_dyn_tqe Vxx_ajs_cor_dz_tqe Vxx_ajs_cor_fast_cor_dly Vxx_ajs_cor_lim_dyn_tqe Vxx_ajs_cor_lim_dz_dyn_tqe Vxx_ajs_cor_max_cor_dyn Vxx_ajs_cor_min_cor_dyn Vxx_ajs_cor_n_diff Vxx_ajs_cor_t1 Vxx_ajs_cor_t1_acel Vxx_ajs_cor_t1_decl Vxx_ajs_cor_t1_fast_cor Vxx_ajs_cor_td Vxx_ajs_cor_td_acel Vxx_ajs_cor_td_decl Vxx_ajs_cor_td_fast_cor Vxx_ajs_cor_td_tq_fac Vxx_ajs_cor_tqe Vxx_ajs_cor_tqe_tmp /end OUT_MEASUREMENT
/end FUNCTION
/begin FUNCTION SmCajCtl_Spcpaxx ""
 /begin DEF_CHARACTERISTIC Cmp_ajs_cor_t1_acel_clos_spc Cmp_ajs_cor_t1_decl_clos_spc Cmp_ajs_cor_td_acel_clos_spc Cmp_ajs_cor_td_acel_fac_spc Cmp_ajs_cor_td_decl_clos_spc Cmp_ajs_cor_td_decl_fac_spc Ctp_ajs_cor_dz_tqe_spc Ctp_ajs_cor_max_dyn_tqe_spc Ctp_ajs_cor_min_dyn_tqe_spc Cxx_ajs_cor_dz_dly_spc Cxx_ajs_cor_max_dyn_open_spc Cxx_ajs_cor_min_dyn_open_spc /end DEF_CHARACTERISTIC
 /begin OUT_MEASUREMENT Vxx_ajs_cor_dz_dly_spc Vxx_ajs_cor_dz_tqe_spc Vxx_ajs_cor_max_cor_dyn_spc Vxx_ajs_cor_min_cor_dyn_spc Vxx_ajs_cor_spc_rat Vxx_ajs_cor_t1_acel_dt_clos_spc Vxx_ajs_cor_t1_decl_dt_clos_spc Vxx_ajs_cor_td_acel_dt_clos_spc Vxx_ajs_cor_td_decl_dt_clos_spc Vxx_ajs_cor_td_tq_fac_spc /end OUT_MEASUREMENT
/end FUNCTION
/begin FUNCTION SmCajCtl_Coracxx "" /begin DEF_CHARACTERISTIC Cxx_ajs_cor_act_n_hys Cxx_ajs_cor_act_n_thd /end DEF_CHARACTERISTIC /begin OUT_MEASUREMENT Vbx_ajs_cor_act /end OUT_MEASUREMENT /end FUNCTION
/begin FUNCTION BiPciCci "" /begin DEF_CHARACTERISTIC c_ctr_fil_asw lc_linp_conv_cru_swi lc_linp_conv_vvsl_swi /end DEF_CHARACTERISTIC
 /begin OUT_MEASUREMENT Vbx_cru_on_off_in Vbx_eprm_rdy Vbx_sl_on_off_in Vxx_cru_sl_whl_cmd_in lv_cru_swi_on_off lv_pin_cru_swi_on_off lv_pin_vvsl_swi_on_off lv_vvsl_swi_on_off v_cru /end OUT_MEASUREMENT
/end FUNCTION
/begin FUNCTION DgDgtSer "" /begin SUB_FUNCTION DgDgtSer_docserx_xxxxxx DgDgtSer_obdserx_xxxxxx /end SUB_FUNCTION /end FUNCTION
/begin FUNCTION DgDgtSer_docserx_xxxxxx ""
 /begin DEF_CHARACTERISTIC Cbx_fail_dft_ini_req Ctx_vin_crc_ini_data[0] Ctx_vin_crc_ini_data[1] Ctx_vin_crc_ini_data[2] Ctx_vin_crc_ini_data[3] Ctx_vin_crc_ini_data[4] Ctx_vin_crc_ini_data[5] Ctx_vin_crc_ini_data[6] Ctx_vin_crc_ini_data[7] Ctx_vin_crc_ini_data[8] Ctx_vin_crc_ini_data[9] Ctx_vin_crc_ini_data[10] Ctx_vin_crc_ini_data[11] Ctx_vin_crc_ini_data[12] Ctx_vin_crc_ini_data[13] Ctx_vin_crc_ini_data[14] Ctx_vin_crc_ini_data[15] Ctx_vin_crc_ini_data[16] Ctx_vin_crc_ini_data[17] Ctx_vin_crc_ini_data[18] Cxx_c_nr1 Cxx_c_nr2 Cxx_cert_id Cxx_diag_nr Cxx_ecu_nr1 Cxx_ecu_nr2 Cxx_ecu_nr3 Cxx_ecu_nr4 Cxx_ecu_nr5 Cxx_etun_nr Cxx_oem_id Cxx_prog_nr1 Cxx_prog_nr2 Cxx_rsa_did_lim_val_cfm Cxx_supl_nr1 Cxx_supl_nr2 Cxx_supl_nr3 Cxx_sys_c_nr Cxx_vers_nr1 Cxx_vers_nr2 /end DEF_CHARACTERISTIC
 /begin OUT_MEASUREMENT Vtx_vin_crc_data[0] Vtx_vin_crc_data[1] Vtx_vin_crc_data[2] Vtx_vin_crc_data[3] Vtx_vin_crc_data[4] Vtx_vin_crc_data[5] Vtx_vin_crc_data[6] Vtx_vin_crc_data[7] Vtx_vin_crc_data[8] Vtx_vin_crc_data[9] Vtx_vin_crc_data[10] Vtx_vin_crc_data[11] Vtx_vin_crc_data[12] Vtx_vin_crc_data[13] Vtx_vin_crc_data[14] Vtx_vin_crc_data[15] Vtx_vin_crc_data[16] Vtx_vin_crc_data[17] Vtx_vin_crc_data[18] Vsx_diag_sess /end OUT_MEASUREMENT
/end FUNCTION
/begin FUNCTION DgDgtSer_obdserx_xxxxxx "" /begin DEF_CHARACTERISTIC Cbx_obd_fail_dft_ini_req /end DEF_CHARACTERISTIC /end FUNCTION
/begin FUNCTION PcCruSpt ""
 /begin OUT_MEASUREMENT Vxx_fsl_km_NVM Sxx_cru_dgn_eprm_imd_writ_ctr Vxx_max_vs_NVM Vxx_cru_fail_NVM Vxx_cru_sl_fail_NVM Vxx_cru_sl_dacn_sys_NVM Vbx_sli_buf_sf_NVM Sxx_sli_brk_buf_NVM Sxx_sli_clu_buf_NVM Sxx_sli_cru_stt_buf_NVM Sxx_sli_vs_buf[0] Sxx_sli_vs_buf[1] Sxx_sli_vs_buf[2] Sxx_sli_vs_buf[3] Sxx_sli_vs_buf[4] Sxx_sli_vs_buf[5] Sxx_sli_vs_buf[6] Sxx_sli_vs_buf[7] Sxx_sli_vs_buf[8] Sxx_sli_vs_buf[9] Sxx_sli_vs_buf[10] Sxx_sli_vs_buf[11] Sxx_sli_vs_buf[12] Sxx_sli_vs_buf[13] Sxx_sli_vs_buf[14] Sxx_sli_vs_buf[15] Vxx_crsh_dly_ctr_NVM Vxx_cru_dgn_diag_NVM Vbx_crsh_end_rec_eprm_NVM Sxx_cru_dist_buf[0] Sxx_cru_dist_buf[1] Sxx_cru_dist_buf[2] Sxx_cru_dist_buf[3] Sxx_cru_dist_buf[4] Sxx_cru_dist_buf[5] Sxx_cru_dist_buf[6] Sxx_cru_dist_buf[7] Sxx_cru_dist_buf[8] Sxx_cru_dist_buf[9] Sxx_cru_dist_buf[10] Sxx_cru_dist_buf[11] Sxx_cru_dist_buf[12] Sxx_cru_dist_buf[13] Sxx_cru_dist_buf[14] Sxx_cru_dist_buf[15] Sxx_cru_dist_buf[16] Sxx_cru_dist_buf[17] Sxx_cru_dist_buf[18] Sxx_cru_dist_buf[19] Sxx_cru_dsb_buf[0] Sxx_cru_dsb_buf[1] Sxx_cru_dsb_buf[2] Sxx_cru_dsb_buf[3] Sxx_cru_dsb_buf[4] Sxx_cru_dsb_buf[5] Sxx_cru_dsb_buf[6] Sxx_cru_dsb_buf[7] Sxx_cru_dsb_buf[8] Sxx_cru_dsb_buf[9] Sxx_cru_dsb_buf[10] Sxx_cru_dsb_buf[11] Sxx_cru_dsb_buf[12] Sxx_cru_dsb_buf[13] Sxx_cru_dsb_buf[14] Sxx_cru_dsb_buf[15] Sxx_cru_dsb_buf[16] Sxx_cru_dsb_buf[17] Sxx_cru_dsb_buf[18] Sxx_cru_dsb_buf[19] /end OUT_MEASUREMENT
 /begin SUB_FUNCTION PcCruSpt_Dacaxxx PcCruSpt_Dgaddon PcCruSpt_Dsbccxx PcCruSpt_Schxxxx PcCruSpt_Setptxx PcCruSpt_Stflwxx PcCruSpt_Vsintxx PcCruSpt_Fslinxx /end SUB_FUNCTION
/end FUNCTION
/begin FUNCTION PcCruSpt_Dacaxxx ""
 /begin DEF_CHARACTERISTIC Cxx_brk_det_dly Cxx_brk_min_decl_thd Cxx_cru_brk_fail_dly Cxx_cru_brk_nok_dly Cxx_cru_clu_navl_dly Cxx_cru_clu_nok_dly Cxx_dfdec_cru_sl_tot Cxx_dfinc_cru_sl_tot Cxx_lih_dly Cxx_sp_vs_dif_brk_det Cxx_sudn_brk_det_dly Cxx_sudn_brk_min_decl_thd /end DEF_CHARACTERISTIC
 /begin OUT_MEASUREMENT Vbx_brk_pdl_vld_fail Vbx_brk_pdl_vld_nok Vbx_cru_brk_det Vbx_cru_brk_det_sudn Vbx_cru_clu_abst_fil Vbx_cru_clu_navl_fil Vbx_diag_ena_cru Vbx_diag_ena_cru_sl Vbx_diag_ena_cru_sl_dtc Vbx_gear_vld_nok_fail Vsx_cru_vld Vsx_sl_vld /end OUT_MEASUREMENT
/end FUNCTION
/begin FUNCTION PcCruSpt_Dgaddon ""
 /begin DEF_CHARACTERISTIC Cbx_cru_diag_add_on Cxx_cru_dgn_eprm_imd_writ_thr Cxx_togl_dly Cxx_togl_thr /end DEF_CHARACTERISTIC
 /begin OUT_MEASUREMENT Vbx_crsh_det Vbx_cru_dgn_eprm_writ_off Vbx_cru_dgn_eprm_writ_on Vbx_cru_diag_ena Vbx_cru_sl_dacn_bit0 Vbx_cru_sl_dacn_bit1 Vbx_ram_full Vbx_ram_full_prev Vbx_set_id_bit6 Vbx_set_id_bit7 Vxx_act_deact_id_buf_2 Vxx_cru_act_deact_id Vxx_cru_act_deact_id_to_saved Vxx_cru_dist_buf[0] Vxx_cru_dist_buf[1] Vxx_cru_dist_buf[2] Vxx_cru_dist_buf[3] Vxx_cru_dist_buf[4] Vxx_cru_dist_buf[5] Vxx_cru_dist_buf[6] Vxx_cru_dist_buf[7] Vxx_cru_dist_buf[8] Vxx_cru_dist_buf[9] Vxx_cru_dist_buf[10] Vxx_cru_dist_buf[11] Vxx_cru_dist_buf[12] Vxx_cru_dist_buf[13] Vxx_cru_dist_buf[14] Vxx_cru_dist_buf[15] Vxx_cru_dist_buf[16] Vxx_cru_dist_buf[17] Vxx_cru_dist_buf[18] Vxx_cru_dist_buf[19] Vxx_cru_dsb_buf[0] Vxx_cru_dsb_buf[1] Vxx_cru_dsb_buf[2] Vxx_cru_dsb_buf[3] Vxx_cru_dsb_buf[4] Vxx_cru_dsb_buf[5] Vxx_cru_dsb_buf[6] Vxx_cru_dsb_buf[7] Vxx_cru_dsb_buf[8] Vxx_cru_dsb_buf[9] Vxx_cru_dsb_buf[10] Vxx_cru_dsb_buf[11] Vxx_cru_dsb_buf[12] Vxx_cru_dsb_buf[13] Vxx_cru_dsb_buf[14] Vxx_cru_dsb_buf[15] Vxx_cru_dsb_buf[16] Vxx_cru_dsb_buf[17] Vxx_cru_dsb_buf[18] Vxx_cru_dsb_buf[19] Vxx_sli_brk_buf Vxx_sli_clu_buf Vxx_sli_cru_stt_buf Vxx_sli_vs_buf[0] Vxx_sli_vs_buf[1] Vxx_sli_vs_buf[2] Vxx_sli_vs_buf[3] Vxx_sli_vs_buf[4] Vxx_sli_vs_buf[5] Vxx_sli_vs_buf[6] Vxx_sli_vs_buf[7] Vxx_sli_vs_buf[8] Vxx_sli_vs_buf[9] Vxx_sli_vs_buf[10] Vxx_sli_vs_buf[11] Vxx_sli_vs_buf[12] Vxx_sli_vs_buf[13] Vxx_sli_vs_buf[14] Vxx_sli_vs_buf[15] Vxx_togl_ctr Vxx_togl_tmr Vxx_vh_dist_buf_2 /end OUT_MEASUREMENT
/end FUNCTION
/begin FUNCTION PcCruSpt_Dsbccxx ""
 /begin DEF_CHARACTERISTIC Cbx_cru_eng_dsb_wal_1_req_cfm Cbx_cru_sl_eng_dsb_vld_cfm Cbx_sl_eng_dsb_wal_1_req_cfm /end DEF_CHARACTERISTIC
 /begin OUT_MEASUREMENT Vbx_cru_eng_dsb Vbx_cru_eng_dsb_sys Vbx_sl_eng_dsb Vbx_sl_eng_dsb_sys /end OUT_MEASUREMENT
/end FUNCTION
/begin FUNCTION PcCruSpt_Schxxxx "" /begin DEF_CHARACTERISTIC Cbx_fsl_cfm /end DEF_CHARACTERISTIC /begin OUT_MEASUREMENT Vbx_fsl_cfm /end OUT_MEASUREMENT /end FUNCTION
/begin FUNCTION PcCruSpt_Setptxx ""
 /begin DEF_CHARACTERISTIC Cbx_ena_reg_decl_resu_on Cxx_cru_ovs_warn_thd Cxx_cru_ovs_warn_thd_mph Cxx_cru_sl_long_sp_dec_t Cxx_cru_sl_long_sp_inc_t Cxx_cru_sl_sp_inc_t Cxx_cru_sl_warn_dly Cxx_sl_ovs_warn_thd Cxx_sl_ovs_warn_thd_mph /end DEF_CHARACTERISTIC
 /begin OUT_MEASUREMENT Vbx_cru_sl_warn Vbx_cru_sl_warn_prev Vbx_cru_sl_warn_raw Vbx_vs_clos_spt_lamp Vxx_cru_sl_driv_vs_sp Vxx_cru_sl_driv_vs_sp_kmh Vxx_cru_sl_sp_inc_dec_dly_cnt Vxx_cru_sl_stt_ip_nom Vxx_cru_sl_vs_sp_nom /end OUT_MEASUREMENT
/end FUNCTION
/begin FUNCTION PcCruSpt_Stflwxx ""
 /begin OUT_MEASUREMENT Vbx_cru_cmf_cut Vbx_sta_swi_act Vsx_cru_stt Vsx_sl_stt Vxx_cru_sl_dacn Vxx_cru_sl_dacn_prev Vxx_cru_sl_dacn_sys_prev Vxx_cru_sl_stt_nom /end OUT_MEASUREMENT
/end FUNCTION
/begin FUNCTION PcCruSpt_Vsintxx ""
 /begin DEF_CHARACTERISTIC Cbx_cru_sl_vs_cmp_prmt Cbx_fsl_ena_cfm Cxx_cru_abst_dspl_vs_dly Cxx_cru_abst_vs_dly Cxx_cru_long_step Cxx_cru_long_step_mph Cxx_cru_nok_vs_dly Cxx_cru_sl_fil_acel_fac Cxx_cru_sl_fil_vs_fac Cxx_cru_sl_max_vs Cxx_cru_sl_max_vs_mph Cxx_cru_sl_min_vs Cxx_cru_sl_min_vs_mph Cxx_cru_sl_no_efv_vs_thd Cxx_cru_sl_no_efv_vs_thd_mph Cxx_cru_sl_smal_step Cxx_cru_sl_smal_step_mph Cxx_cru_vs_secu_min Cxx_cru_vs_sp_rat Cxx_dfdec_cru_vs_cmp Cxx_dfinc_cru_vs_cmp Cxx_dspl_vs_secu_fac Cxx_dspl_vs_secu_ofs Cxx_dspl_vs_secu_thd Cxx_sl_long_step Cxx_sl_long_step_mph Cxx_vs_clos_spt_lamp_off_thd Cxx_vs_clos_spt_lamp_off_thd_mph Cxx_vs_clos_spt_lamp_on_thd Cxx_vs_clos_spt_lamp_on_thd_mph /end DEF_CHARACTERISTIC
 /begin OUT_MEASUREMENT Vbx_cru_sl_kmh_mph_cge Vbx_cru_sl_oor_vs Vbx_cru_smal_vs_sp_rat Vbx_df_cru_vs_cmp Vbx_dspl_vs_abst_fil Vbx_dspl_vs_navl_fil Vbx_vs_abst_fil Vbx_vs_navl_fil Vbx_vs_nok Vxx_cru_sl_acel Vxx_cru_sl_long_step Vxx_cru_sl_max_vs Vxx_cru_sl_min_vs Vxx_cru_sl_no_efv_vs_thd Vxx_cru_sl_raw_vs Vxx_cru_sl_smal_step Vxx_cru_sl_vs Vxx_cru_sl_vs_kmh Vxx_vs_clos_spt_lamp_off_thd Vxx_vs_clos_spt_lamp_on_thd /end OUT_MEASUREMENT
/end FUNCTION
/begin FUNCTION PcCruSpt_Fslinxx "" /begin OUT_MEASUREMENT Vxx_fsl_max_vs_sp_kmh /end OUT_MEASUREMENT /end FUNCTION
/begin FUNCTION InPciCci ""
 /begin OUT_MEASUREMENT Vbx_whl_lk_stt_NVM Vxx_cru_sl_resu_blk_dly_max_NVM Vxx_cru_sl_acel_blk_dly_max_NVM Vxx_cru_sl_decl_blk_dly_max_NVM Vxx_cru_sl_susp_blk_dly_max Vxx_cru_sl_whl_cmd_blk_ctr_max_NVM Vbx_cru_swi_lk_stt_NVM Vbx_cru_lk_stt_NVM Vbx_sl_swi_lk_stt_NVM Vbx_sl_lk_stt_NVM /end OUT_MEASUREMENT
 /begin SUB_FUNCTION InPciCci_Swtchsr /end SUB_FUNCTION
/end FUNCTION
/begin FUNCTION InPciCci_Swtchsr ""
 /begin DEF_CHARACTERISTIC Cbx_cru_sl_lk_rls_ena Cbx_cru_sl_swi_chr_prmt Cxx_cru_sl_acel_blk_dly Cxx_cru_sl_acel_max_thd Cxx_cru_sl_acel_min_thd Cxx_cru_sl_decl_blk_dly Cxx_cru_sl_decl_max_thd Cxx_cru_sl_decl_min_thd Cxx_cru_sl_lk_ena_dly Cxx_cru_sl_lk_vb_thd Cxx_cru_sl_open_min_thd Cxx_cru_sl_resu_blk_dly Cxx_cru_sl_resu_max_thd Cxx_cru_sl_resu_min_thd Cxx_cru_sl_rls_max_thd Cxx_cru_sl_rls_min_thd Cxx_cru_sl_susp_blk_dly Cxx_cru_sl_susp_max_thd Cxx_cru_sl_swi_dly Cxx_cru_sl_swi_igk_dly Cxx_cru_sl_whl_cmd_blk_ctr_max Cxx_cru_sl_whl_swi_dly Cxx_dfdec_cru_sl_swi_chr Cxx_dfdec_cru_whl_cmd Cxx_dfdec_cru_whl_cmd_nok Cxx_dfinc_cru_sl_swi_chr Cxx_dfinc_cru_whl_cmd Cxx_dfinc_cru_whl_cmd_nok /end DEF_CHARACTERISTIC
 /begin OUT_MEASUREMENT Vbx_cru_sl_acel_blk Vbx_cru_sl_decl_blk Vbx_cru_sl_lk_ena Vbx_cru_sl_new_lk_ena Vbx_cru_sl_resu_blk Vbx_cru_sl_susp_blk Vbx_cru_sl_whl_cmd_blk Vbx_df_cru_sl_swi_chr Vbx_df_cru_whl_cmd_nok Vbx_df_cru_whl_cmd_oc_scw Vbx_df_cru_whl_cmd_oor Vsx_cru_sl_on_off Vsx_cru_sl_on_off_raw Vsx_cru_sl_swi_vld Vxx_acc_cmd_stt Vxx_acc_swi Vxx_cru_sl_whl_cmd_raw Vxx_cru_sl_whl_cmd_stt Vxx_sta_swi_act_ctr /end OUT_MEASUREMENT
/end FUNCTION
/begin FUNCTION PcCruCtl "" /begin OUT_MEASUREMENT Vbx_cru_swi Vxx_cru_cmp_diag /end OUT_MEASUREMENT
 /begin SUB_FUNCTION PcCruCtl_Safetyx PcCruCtl_Servoxx PcCruCtl_Slarbxx PcCruCtl_Fslsvxx /end SUB_FUNCTION
/end FUNCTION
/begin FUNCTION PcCruCtl_Safetyx ""
 /begin DEF_CHARACTERISTIC Cbx_bgin_clu_fail_ccp_ena Cbx_bgin_clu_fail_co_ena Cbx_brk_fail_ccp_ena Cbx_brk_fail_co_ena Cbx_ena_brk_cru_swi_cfm Cbx_ena_clu_cru_swi_cfm Cxx_bgin_clu_fail_ccp_dly Cxx_bgin_clu_fail_co_dly Cxx_brk_fail_ccp_dly Cxx_brk_fail_co_dly Cxx_cru_forc_sp_dly Cxx_cru_forc_sp_thd Cxx_dfdec_bgin_clu_cmp Cxx_dfdec_brk_pdl_cmp Cxx_dfdec_cru_cmp Cxx_dfinc_bgin_clu_cmp Cxx_dfinc_brk_pdl_cmp Cxx_dfinc_cru_cmp Cxx_wf_bgin_clu_rams_dly Cxx_wf_brk_rams_dly /end DEF_CHARACTERISTIC
 /begin OUT_MEASUREMENT Vbx_cru_cmp_bgin_clu Vbx_cru_cmp_forc_pres Vbx_cru_cmp_open_brk Vxx_cru_cmp_diag_new Vxx_cru_cmp_diag_prev Vxx_cru_forc_sp Vxx_cru_sl_stt Vxx_cru_sl_stt_ip Vxx_cru_sl_vs_sp Vxx_csl_forc_sp /end OUT_MEASUREMENT
/end FUNCTION
/end MODULE
/end PROJECT
