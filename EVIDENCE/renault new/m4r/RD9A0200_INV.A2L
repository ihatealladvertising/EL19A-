ASAP2_VERSION 1 41
/begin PROJECT RD8 "_default_ProjectLongIdentifier"
/begin HEADER "_default_HeaderComment" PROJECT_NO RD9 /end HEADER
/begin MODULE _default_ModuleName "_default_ModuleLongIdentifier"
/begin MOD_COMMON "_default_ModCommonComment" DEPOSIT ABSOLUTE BYTE_ORDER MSB_LAST ALIGNMENT_BYTE 1 ALIGNMENT_WORD 2 ALIGNMENT_LONG 2 ALIGNMENT_FLOAT32_IEEE 2 ALIGNMENT_FLOAT64_IEEE 4 /end MOD_COMMON
/begin MEASUREMENT Vbx_asr_cdn "ASR conditions" UBYTE _CNV_S_2_RANGE______3_CM 1 0. 0. 1. ECU_ADDRESS 0xd0007bf2 BIT_MASK 0x1 /end MEASUREMENT
/begin MEASUREMENT Vbx_asr_msr_ack "ESP frame acknowledgement bit. this value is set to 1 if there is no request" UBYTE _CNV_S_2_RANGE______3_CM 1 0. 0. 1. ECU_ADDRESS 0xd0006caa BIT_MASK 0x1 /end MEASUREMENT
/begin MEASUREMENT Vbx_asr_msr_cdn "ASR MSR authorization" UBYTE _CNV_S_2_RANGE______3_CM 1 0. 0. 1. ECU_ADDRESS 0xd0007bf3 BIT_MASK 0x1 /end MEASUREMENT
/begin MEASUREMENT Vbx_asr_msr_frm_abst_tmp "Absence of ESP frame reception" UBYTE _CNV_S_2_RANGE______3_CM 1 0. 0. 1. ECU_ADDRESS 0xd0006cab BIT_MASK 0x1 /end MEASUREMENT
/begin MEASUREMENT Vbx_asr_msr_lk "This boolean is memorized when the first esp frame occurs" UBYTE _CNV_S_2_RANGE______3_CM 1 0. 0. 1. ECU_ADDRESS 0xd0007bf4 BIT_MASK 0x1 /end MEASUREMENT
/begin MEASUREMENT Vbx_asr_prot_dft "Protocol error (complement and clock) in ASR regulation (slew rate activation)" UBYTE _CNV_S_2_RANGE______3_CM 1 0. 0. 1. ECU_ADDRESS 0xd0007bf5 BIT_MASK 0x1 /end MEASUREMENT
/begin MEASUREMENT Vbx_asr_tqe_req_ok "Authorized ASR torque request" UBYTE _CNV_S_2_RANGE______3_CM 1 0. 0. 1. ECU_ADDRESS 0xd0007bf6 BIT_MASK 0x1 /end MEASUREMENT
/begin MEASUREMENT Vbx_df_esp_data_chr "ESP torque request coherency detected failure" UBYTE _CNV_S_2_RANGE______3_CM 1 0. 0. 1. ECU_ADDRESS 0xd0007bf7 BIT_MASK 0x1 /end MEASUREMENT
/begin MEASUREMENT Vbx_df_esp_data_seq_ctr "ESP frame sequence counter detected failure" UBYTE _CNV_S_2_RANGE______3_CM 1 0. 0. 1. ECU_ADDRESS 0xd0007bf8 BIT_MASK 0x1 /end MEASUREMENT
/begin MEASUREMENT Vbx_df_esp_no_frm "The engine control has lost communication with ESP" UBYTE _CNV_S_2_RANGE______3_CM 1 0. 0. 1. ECU_ADDRESS 0xd0007bf9 BIT_MASK 0x1 /end MEASUREMENT
/begin MEASUREMENT Vbx_msr_cdn "MSR conditions" UBYTE _CNV_S_2_RANGE______3_CM 1 0. 0. 1. ECU_ADDRESS 0xd0007bfa BIT_MASK 0x1 /end MEASUREMENT
/begin MEASUREMENT Vbx_msr_tqe_req_ok "Authorized MSR torque request" UBYTE _CNV_S_2_RANGE______3_CM 1 0. 0. 1. ECU_ADDRESS 0xd0007bfb BIT_MASK 0x1 /end MEASUREMENT
/begin MEASUREMENT Vbx_tmp_df_esp_data_chr "Single ESP torque request coherency failure" UBYTE _CNV_S_2_RANGE______3_CM 1 0. 0. 1. ECU_ADDRESS 0xd0006cac BIT_MASK 0x1 /end MEASUREMENT
/begin MEASUREMENT Vbx_tmp_df_esp_data_seq_ctr "Single ESP frame sequence counter failure" UBYTE _CNV_S_2_RANGE______3_CM 1 0. 0. 1. ECU_ADDRESS 0xd0006cad BIT_MASK 0x1 /end MEASUREMENT
/begin MEASUREMENT Vxx_asr_msr_20ms_t "Reccurence time of the block" UBYTE _CNV_A_R_LINEAR_____116_CM 1 0. 0. 0.255 ECU_ADDRESS 0xd0006cae FORMAT "%5.3" /end MEASUREMENT
/begin MEASUREMENT Vxx_asr_tqe_sp "ASR setpoint torque sent to torque arbitration" UWORD _CNV_A_R_LINEAR_____216_CM 1 0. -400. 1647.96875 ECU_ADDRESS 0xd00043d8 FORMAT "%10.5" /end MEASUREMENT
/begin MEASUREMENT Vxx_asr_tqe_tgt "ASR target torque sent to torque arbitration" UWORD _CNV_A_R_LINEAR_____216_CM 1 0. -400. 1647.96875 ECU_ADDRESS 0xd00043da FORMAT "%10.5" /end MEASUREMENT
/begin MEASUREMENT Vxx_msr_tqe_sp "MSR torque setting sent to torque arbitration" UWORD _CNV_A_R_LINEAR_____216_CM 1 0. -400. 1647.96875 ECU_ADDRESS 0xd00043dc FORMAT "%10.5" /end MEASUREMENT
/begin CHARACTERISTIC Cxx_asr_msr_abst_dly "Calibration time to detect a lost frame" VALUE 0xa0021606 _REC_S1VAL_20_u2 65.535 _CNV_A_R_LINEAR_____116_CM 0. 65.535 FORMAT "%5.3" /end CHARACTERISTIC
/begin CHARACTERISTIC Cxx_asr_msr_ctr_thd "This is a failure counter threshold. It authorize N successive failure before downgraded mode" VALUE 0xa0021622 _REC_S1VAL_20_u1 255. _CNV_A_R_ECME_LINEA_0_CM 0. 255. FORMAT "%3.0" /end CHARACTERISTIC
/begin CHARACTERISTIC Cxx_asr_msr_max_tqe "Maximum allowable ASR/MSR torque request" VALUE 0xa0021608 _REC_S1VAL_20_u2 2047.96875 _CNV_A_R_LINEAR_____216_CM -400. 1647.96875 FORMAT "%10.5" /end CHARACTERISTIC
/begin CHARACTERISTIC Cxx_asr_msr_raw_sum "Sum of raw ASR target and raw MSR setpoint" VALUE 0xa002160a _REC_S1VAL_20_u2 65535. _CNV_A_R_ECME_LINEA_0_CM 0. 65535. FORMAT "%5.0" /end CHARACTERISTIC
/begin CHARACTERISTIC Cxx_asr_slwr_neg "ASR slew rate negative curve in case of protocol error" VALUE 0xa002160c _REC_S1VAL_20_u2 10235. _CNV_A_R_LINEAR_____217_CM -10235. 0. FORMAT "%6.0" /end CHARACTERISTIC
/begin CHARACTERISTIC Cxx_asr_slwr_pos "ASR slew rate positive curve in case of protocol error" VALUE 0xa002160e _REC_S1VAL_20_u2 10235. _CNV_A_R_LINEAR_____218_CM 0. 10235. FORMAT "%5.0" /end CHARACTERISTIC
/begin CHARACTERISTIC Cxx_asr_tqe_sp_msr_raw "Unscaled (raw) value of ASR torque setpoint sent during MSR requests" VALUE 0xa0021610 _REC_S1VAL_20_u2 65535. _CNV_A_R_ECME_LINEA_0_CM 0. 65535. FORMAT "%5.0" /end CHARACTERISTIC
/begin CHARACTERISTIC Cxx_dfdec_esp_data_chr "ESP data torque request coherency detected failure counter decrement" VALUE 0xa0021612 _REC_S1VAL_20_u2 65535. _CNV_A_R_ECME_LINEA_0_CM 0. 65535. FORMAT "%5.0" /end CHARACTERISTIC
/begin CHARACTERISTIC Cxx_dfdec_esp_data_seq_ctr "ESP data frame sequence counter detected failure counter decrement" VALUE 0xa0021614 _REC_S1VAL_20_u2 65535. _CNV_A_R_ECME_LINEA_0_CM 0. 65535. FORMAT "%5.0" /end CHARACTERISTIC
/begin CHARACTERISTIC Cxx_dfdec_esp_no_frm "ESP Missing Message detected failure counter decrement" VALUE 0xa0021616 _REC_S1VAL_20_u2 65535. _CNV_A_R_ECME_LINEA_0_CM 0. 65535. FORMAT "%5.0" /end CHARACTERISTIC
/begin CHARACTERISTIC Cxx_dfinc_esp_data_chr "ESP data torque request coherency detected failure counter increment" VALUE 0xa0021618 _REC_S1VAL_20_u2 65535. _CNV_A_R_ECME_LINEA_0_CM 0. 65535. FORMAT "%5.0" /end CHARACTERISTIC
/begin CHARACTERISTIC Cxx_dfinc_esp_data_seq_ctr "ESP data frame sequence counter detected failure counter increment" VALUE 0xa002161a _REC_S1VAL_20_u2 65535. _CNV_A_R_ECME_LINEA_0_CM 0. 65535. FORMAT "%5.0" /end CHARACTERISTIC
/begin CHARACTERISTIC Cxx_dfinc_esp_no_frm "ESP Missing Message detected failure counter increment " VALUE 0xa002161c _REC_S1VAL_20_u2 65535. _CNV_A_R_ECME_LINEA_0_CM 0. 65535. FORMAT "%5.0" /end CHARACTERISTIC
/begin CHARACTERISTIC Cxx_min_tqe_dsb "a_in_pci_esp_absctxx / Torque value to be sent to torque arbitration when there isn't any request for a minimum torque" VALUE 0xa002161e _REC_S1VAL_20_u2 2047.96875 _CNV_A_R_LINEAR_____216_CM -400. 1647.96875 FORMAT "%10.5" /end CHARACTERISTIC
/begin CHARACTERISTIC Cxx_mux_asr_msr_tqe_nok_raw "Unscaled (raw) invalid value of ASR and MSR torque requests" VALUE 0xa0021620 _REC_S1VAL_20_u2 4095. _CNV_A_R_ECME_LINEA_0_CM 0. 4095. FORMAT "%4.0" /end CHARACTERISTIC
/begin MEASUREMENT Vbx_asr_reg "ASR in regulation" UBYTE _CNV_S_2_RANGE______3_CM 1 0. 0. 1. ECU_ADDRESS 0xd0007bfc BIT_MASK 0x1 /end MEASUREMENT
/begin MEASUREMENT Vbx_ayc_reg "AYC in regulation" UBYTE _CNV_S_2_RANGE______3_CM 1 0. 0. 1. ECU_ADDRESS 0xd0007bfd BIT_MASK 0x1 /end MEASUREMENT
/begin MEASUREMENT Vsx_asr_msr_typ "Torque control type" UBYTE _CNV_S_4_STATUS_TQ__219_CM 1 0. 0. 6. ECU_ADDRESS 0xd0007bfe /end MEASUREMENT
/begin AXIS_PTS Ctb_eal "16 breakpoint table for Engine air load" 0xa002b7f4 Vxx_eal _REC_A2AXS_20_u2 3.99993896484375 _CNV_A_R_LINEAR_____53_CM 16 0. 3.99993896484375 FORMAT "%10.8" /end AXIS_PTS
/begin MEASUREMENT Vxb_eal.factor "" UWORD _CNV_A_R_A_105_CM 1 0. 0. 65535. ECU_ADDRESS 0xd0006abe /end MEASUREMENT
/begin MEASUREMENT Vxb_eal.index "" UBYTE _CNV_A_R_A_105_CM 1 0. 0. 255. ECU_ADDRESS 0xd0006ac0 /end MEASUREMENT
/begin MEASUREMENT Vxb_eal.num_dp "" UBYTE _CNV_A_R_A_105_CM 1 0. 0. 255. ECU_ADDRESS 0xd0006ac1 /end MEASUREMENT
/begin MEASUREMENT Vxb_pred_eal.factor "" UWORD _CNV_A_R_A_105_CM 1 0. 0. 65535. ECU_ADDRESS 0xd0006ac2 /end MEASUREMENT
/begin MEASUREMENT Vxb_pred_eal.index "" UBYTE _CNV_A_R_A_105_CM 1 0. 0. 255. ECU_ADDRESS 0xd0006ac4 /end MEASUREMENT
/begin MEASUREMENT Vxb_pred_eal.num_dp "" UBYTE _CNV_A_R_A_105_CM 1 0. 0. 255. ECU_ADDRESS 0xd0006ac5 /end MEASUREMENT
/begin MEASUREMENT Vsx_eal_vld "Validity indicator for engine air load" UBYTE _CNV_A_R_ECME_LINEA_0_CM 1 0. 0. 255. ECU_ADDRESS 0xd0006ac6 FORMAT "%3.0" /end MEASUREMENT
/begin MEASUREMENT Vxx_eal "Engine air load" UWORD _CNV_A_R_LINEAR_____53_CM 1 0. 0. 3.99993896484375 ECU_ADDRESS 0xd000418c FORMAT "%7.5" /end MEASUREMENT
/begin MEASUREMENT Vxx_eal_tdc_2 "Engine air load 2 tdc earlier" UWORD _CNV_A_R_LINEAR_____53_CM 1 0. 0. 3.99993896484375 ECU_ADDRESS 0xd000418e FORMAT "%7.5" /end MEASUREMENT
/begin MEASUREMENT Vxx_eal_tdc_4 "Engine air load 4 tdc earlier" UWORD _CNV_A_R_LINEAR_____53_CM 1 0. 0. 3.99993896484375 ECU_ADDRESS 0xd0004190 FORMAT "%7.5" /end MEASUREMENT
/begin MEASUREMENT Vxx_pred_air_wht_frh "Mass of air trapped in the cylinder for next ignition" UWORD _CNV_A_R_LINEAR_____220_CM 1 0. 0. 6553.5 ECU_ADDRESS 0xd0004192 FORMAT "%6.1" /end MEASUREMENT
/begin MEASUREMENT Vxx_pred_eal "Engine air load using predicted pressure" UWORD _CNV_A_R_LINEAR_____53_CM 1 0. 0. 3.99993896484375 ECU_ADDRESS 0xd0004194 FORMAT "%7.5" /end MEASUREMENT
/begin MEASUREMENT Vxx_pump_maf "Amount of air pumped into culinder" UWORD _CNV_A_R_LINEAR_____172_CM 1 0. 0. 3000. ECU_ADDRESS 0xd0004196 FORMAT "%4.3" /end MEASUREMENT
/begin MEASUREMENT Vxx_pump_maf_fil "Filtered amount of air pumped into cylinder." UWORD _CNV_A_R_LINEAR_____172_CM 1 0. 0. 3000. ECU_ADDRESS 0xd0004198 FORMAT "%4.3" /end MEASUREMENT
/begin CHARACTERISTIC Cxx_cyl_vol "Engine capacity displacement" VALUE 0xa002123c _REC_S1VAL_20_u2 4.e-003 _CNV_A_R_LINEAR_____221_CM 0. 4.e-003 FORMAT "%8.6" /end CHARACTERISTIC
/begin CHARACTERISTIC Cxx_eng_air_wht_ref "Mass of air in the cylinder in standard condition" VALUE 0xa002123e _REC_S1VAL_20_u2 6553.5 _CNV_A_R_LINEAR_____114_CM 0. 6553.5 /end CHARACTERISTIC
/begin CHARACTERISTIC Cxx_pump_maf_fil_ftc "Filter time constant for mass air flow pumped into cylinder." VALUE 0xa0021240 _REC_S1VAL_20_u2 655.35 _CNV_A_R_LINEAR_____32_CM 0. 655.35 FORMAT "%6.2" /end CHARACTERISTIC
/begin AXIS_PTS Ctb_fill_efy_cor_dyn_amp "Atmorspheric pressure breakpoint" 0xa002bb30 NO_INPUT_QUANTITY _REC_A2AXS_20_u2 20000. _CNV_A_R_LINEAR_____115_CM 9 0. 20000. FORMAT "%5.0" /end AXIS_PTS
/begin AXIS_PTS Ctb_n_fill_efy_cor_dyn "Engine speed breakpoints for time constant" 0xa002bb44 Vxx_n _REC_A2AXS_20_u2 16383.75 _CNV_A_R_ENSD_LINEA_22_CM 6 0. 16383.75 FORMAT "%8.2" /end AXIS_PTS
/begin CHARACTERISTIC Cmp_n_map_cor_dyn_amp "Map of thermic efficiency for power estimate, for a low atmorspheric pressure" MAP 0xa002bb54 _REC_A1MAP_20_u2_u2_u2 1.99996948242188 _CNV_A_R_LINEAR_____48_CM 0. 1.99996948242188 FORMAT "%7.5"
 /begin AXIS_DESCR COM_AXIS Vxx_n _CNV_A_R_ENSD_LINEA_22_CM 20 0. 16383.75 FORMAT "%8.2" AXIS_PTS_REF Ctb_n /end AXIS_DESCR
 /begin AXIS_DESCR COM_AXIS Vxx_map _CNV_A_R_LINEAR_____115_CM 17 0. 20000. FORMAT "%5.0" AXIS_PTS_REF Ctb_prs /end AXIS_DESCR
/end CHARACTERISTIC
/begin CHARACTERISTIC Cmp_n_map_cor_dyn_th "Map of thermic efficiency for power estimate" MAP 0xa002bdfc _REC_A1MAP_20_u2_u2_u2 1.99996948242188 _CNV_A_R_LINEAR_____48_CM 0. 1.99996948242188 FORMAT "%7.5"
 /begin AXIS_DESCR COM_AXIS Vxx_n _CNV_A_R_ENSD_LINEA_22_CM 20 0. 16383.75 FORMAT "%8.2" AXIS_PTS_REF Ctb_n /end AXIS_DESCR
 /begin AXIS_DESCR COM_AXIS Vxx_map _CNV_A_R_LINEAR_____115_CM 17 0. 20000. FORMAT "%5.0" AXIS_PTS_REF Ctb_prs /end AXIS_DESCR
/end CHARACTERISTIC
/begin CHARACTERISTIC Cmp_n_map_fill_efv "Map giving the corrective term of mass efficiency for MAIRPRD computing" MAP 0xa002c0a4 _REC_A1MAP_20_u2_u2_u2 1.99996948242188 _CNV_A_R_LINEAR_____48_CM 0. 1.99996948242188 FORMAT "%7.5"
 /begin AXIS_DESCR COM_AXIS Vxx_n _CNV_A_R_ENSD_LINEA_22_CM 20 0. 16383.75 FORMAT "%8.2" AXIS_PTS_REF Ctb_n /end AXIS_DESCR
 /begin AXIS_DESCR COM_AXIS Vxx_map _CNV_A_R_LINEAR_____115_CM 17 0. 20000. FORMAT "%5.0" AXIS_PTS_REF Ctb_prs /end AXIS_DESCR
/end CHARACTERISTIC
/begin CHARACTERISTIC Cmp_vvt_fill_efv_cor_fac1 "Map of first coefficient of the parabolic correction of fill up efficiency for continuous intake VVT" MAP 0xa002c34c _REC_A1MAP_20_u2_u2_u2 1.99996948242187e-003 _CNV_A_R_LINEAR_____222_CM 0. 1.99996948242187e-003 FORMAT "%9.8"
 /begin AXIS_DESCR COM_AXIS Vxx_n _CNV_A_R_ENSD_LINEA_22_CM 20 0. 16383.75 FORMAT "%8.2" AXIS_PTS_REF Ctb_n /end AXIS_DESCR
 /begin AXIS_DESCR COM_AXIS Vxx_map _CNV_A_R_LINEAR_____115_CM 17 0. 20000. FORMAT "%5.0" AXIS_PTS_REF Ctb_prs /end AXIS_DESCR
/end CHARACTERISTIC
/begin CHARACTERISTIC Cmp_vvt_fill_efv_cor_fac2 "Map of second coefficient of the parabolic correction of fill up efficiency for continuous in VVT" MAP 0xa002c5f4 _REC_A1MAP_20_u2_u2_u2 7.812380790710449e-002 _CNV_A_R_LINEAR_____223_CM -3.90625e-002 3.90613079071045e-002 FORMAT "%10.7"
 /begin AXIS_DESCR COM_AXIS Vxx_n _CNV_A_R_ENSD_LINEA_22_CM 20 0. 16383.75 FORMAT "%8.2" AXIS_PTS_REF Ctb_n /end AXIS_DESCR
 /begin AXIS_DESCR COM_AXIS Vxx_map _CNV_A_R_LINEAR_____115_CM 17 0. 20000. FORMAT "%5.0" AXIS_PTS_REF Ctb_prs /end AXIS_DESCR
/end CHARACTERISTIC
/begin CHARACTERISTIC Ctp_fill_efy_cor_dyn_amp_rat "Ratio depending of the atmospheric pressure, for the interpolation of dynamic correction" CURVE 0xa002c89c _REC_A1CUR_20_u2_u2 1. _CNV_A_R_LINEAR_____224_CM 0. 1. FORMAT "%7.5"
 /begin AXIS_DESCR COM_AXIS NO_INPUT_QUANTITY _CNV_A_R_LINEAR_____115_CM 9 0. 20000. FORMAT "%5.0" AXIS_PTS_REF Ctb_fill_efy_cor_dyn_amp /end AXIS_DESCR
/end CHARACTERISTIC
/begin CHARACTERISTIC Ctp_fill_efy_dyn_off_dly "Inhibition timer after start" CURVE 0xa002c8b0 _REC_A1CUR_20_u2_u2 655.35 _CNV_A_R_LINEAR_____32_CM 0. 655.35 FORMAT "%6.2"
 /begin AXIS_DESCR COM_AXIS Vxx_tco _CNV_A_R_LINEAR_____110_CM 9 -40. 200. FORMAT "%5.1" AXIS_PTS_REF Ctb_tco2 /end AXIS_DESCR
/end CHARACTERISTIC
/begin CHARACTERISTIC Ctp_fill_efy_dyn_tco_cor "Engine coolant temperature correction" CURVE 0xa002c8c4 _REC_A1CUR_20_u2_u2 1. _CNV_A_R_LINEAR_____88_CM 0. 1. FORMAT "%6.4"
 /begin AXIS_DESCR COM_AXIS Vxx_tco _CNV_A_R_LINEAR_____110_CM 9 -40. 200. FORMAT "%5.1" AXIS_PTS_REF Ctb_tco2 /end AXIS_DESCR
/end CHARACTERISTIC
/begin CHARACTERISTIC Ctp_map_n_ftc "Thermic time constant" CURVE 0xa002c8d8 _REC_A1CUR_20_u2_u2 655.35 _CNV_A_R_LINEAR_____32_CM 0. 655.35 FORMAT "%6.2"
 /begin AXIS_DESCR COM_AXIS Vxx_n _CNV_A_R_ENSD_LINEA_22_CM 6 0. 16383.75 FORMAT "%8.2" AXIS_PTS_REF Ctb_n_fill_efy_cor_dyn /end AXIS_DESCR
/end CHARACTERISTIC
/begin CHARACTERISTIC Ctp_vlv_air_temp_cor "Table of correction of cylinder fill up efficiency relative correction" CURVE 0xa002c8e4 _REC_A1CUR_20_u2_u2 1.999969482 _CNV_A_R_LINEAR_____147_CM 0. 1.999969482 FORMAT "%10.8"
 /begin AXIS_DESCR COM_AXIS NO_INPUT_QUANTITY _CNV_A_R_LINEAR_____110_CM 9 -40. 200. FORMAT "%5.1" AXIS_PTS_REF Ctb_mat2 /end AXIS_DESCR
/end CHARACTERISTIC
/begin MEASUREMENT Vsx_eng_vol_fill_efy_vld "Cylinder fill-up efficiency validity status" UBYTE _CNV_A_R_ECME_LINEA_0_CM 1 0. 0. 2. ECU_ADDRESS 0xd0006aca FORMAT "%1.0" /end MEASUREMENT
/begin MEASUREMENT Vxx_air_temp_inj_cor "Correction of cylinder fill up efficiency with valve gaz temperature" UWORD _CNV_A_R_LINEAR_____147_CM 1 0. 0. 1.999969482 ECU_ADDRESS 0xd00041b2 FORMAT "%10.8" /end MEASUREMENT
/begin MEASUREMENT Vxx_eng_vol_fill_efy "Cylinder fill up efficiency" UWORD _CNV_A_R_LINEAR_____147_CM 1 0. 0. 1.999969482 ECU_ADDRESS 0xd00041b4 FORMAT "%10.8" /end MEASUREMENT
/begin MEASUREMENT Vxx_eng_vol_fill_efy_fil "Cylinder fill up efficiency (filtered for throttle command)" UWORD _CNV_A_R_LINEAR_____147_CM 1 0. 0. 1.999969482 ECU_ADDRESS 0xd00041b6 FORMAT "%10.8" /end MEASUREMENT
/begin MEASUREMENT Vxx_fill_efv_cor_rat "Cylinder fill up efficiency without temperature effect" UWORD _CNV_A_R_LINEAR_____147_CM 1 0. 0. 1.999969482 ECU_ADDRESS 0xd00041b8 FORMAT "%10.8" /end MEASUREMENT
/begin MEASUREMENT Vxx_fill_efy_cor_dyn "Thermic correction on fill-up efficiency" SWORD _CNV_A_R_LINEAR_____225_CM 1 0. -1. 0.999969482421875 ECU_ADDRESS 0xd00041ba FORMAT "%8.5" /end MEASUREMENT
/begin MEASUREMENT Vxx_fill_efy_cor_dyn_raw "Thermic correction on fill-up efficiency before coolant factor" SWORD _CNV_A_R_LINEAR_____225_CM 1 0. -1. 0.999969482421875 ECU_ADDRESS 0xd00041bc FORMAT "%8.5" /end MEASUREMENT
/begin MEASUREMENT Vxx_vvt_fill_efv_cor "Fill up efficiency correction for continous intake VVT " SWORD _CNV_A_R_LINEAR_____225_CM 1 0. -1. 0.999969482421875 ECU_ADDRESS 0xd00041be FORMAT "%8.5" /end MEASUREMENT
/begin MEASUREMENT Vxx_vvt_fill_efv_cor_fac1 "First coefficient of the parabolic correction of fill up efficiency for continuous intake VVT" UWORD _CNV_A_R_LINEAR_____222_CM 1 0. 0. 1.99996948242187e-003 ECU_ADDRESS 0xd00041c0 FORMAT "%9.8" /end MEASUREMENT
/begin MEASUREMENT Vxx_vvt_fill_efv_cor_fac2 "Second coefficient of the parabolic correction of fill up efficiency for continuous intake VVT" SWORD _CNV_A_R_LINEAR_____226_CM 1 0. -3.90625e-002 3.90613079071045e-002 ECU_ADDRESS 0xd00041c2 FORMAT "%10.7" /end MEASUREMENT
/begin CHARACTERISTIC Cbx_vvtc_in_ang_ofs "Correction relative to intake vvt angle setpoint (1) or offset (0)" VALUE 0xa0021252 _REC_S1VAL_20_u1 1. _CNV_A_R_ECME_LINEA_0_CM 0. 1. FORMAT "%1.0" BIT_MASK 0x1 /end CHARACTERISTIC
/begin CHARACTERISTIC Cxx_eng_vol_fill_efy_drv_max "Maximum slope for fill up efficiency." VALUE 0xa0021248 _REC_S1VAL_20_u2 99.99847412109381 _CNV_A_R_LINEAR_____227_CM -50. 49.9984741210938 FORMAT "%9.6" /end CHARACTERISTIC
/begin CHARACTERISTIC Cxx_eng_vol_fill_efy_dz "Fill up efficiency deadzone" VALUE 0xa002124a _REC_S1VAL_20_s2 1.999969482421875 _CNV_A_R_LINEAR_____225_CM -1. 0.999969482421875 FORMAT "%9.6" /end CHARACTERISTIC
/begin CHARACTERISTIC Cxx_fill_efy_cor_dyn_max "Maximum thermic correction on fill-up efficiency" VALUE 0xa002124c _REC_S1VAL_20_s2 1.999969482421875 _CNV_A_R_LINEAR_____225_CM -1. 0.999969482421875 FORMAT "%8.5" /end CHARACTERISTIC
/begin CHARACTERISTIC Cxx_fill_efy_cor_dyn_min "Minimum thermic correction on fill-up efficiency" VALUE 0xa002124e _REC_S1VAL_20_s2 1.999969482421875 _CNV_A_R_LINEAR_____225_CM -1. 0.999969482421875 FORMAT "%8.5" /end CHARACTERISTIC
/begin CHARACTERISTIC Cxx_vvt_fill_efv_cam_ofs "Offset angle for calculation of VVT fill up efficiency relative correction" VALUE 0xa0021250 _REC_S1VAL_20_s2 719.98 _CNV_A_R_LINEAR_____228_CM -360. 359.98 FORMAT "%7.2" /end CHARACTERISTIC
/begin MEASUREMENT Vxx_mfld_dly "Manifold time constant" UWORD _CNV_A_R_LINEAR_____116_CM 1 0. 0. 65.535 ECU_ADDRESS 0xd00041c6 FORMAT "%5.3" /end MEASUREMENT
/begin CHARACTERISTIC Cxx_mfld_vol "Volume between the inlet throttle and the inlet ports" VALUE 0xa0021254 _REC_S1VAL_20_u2 4.e-002 _CNV_A_R_LINEAR_____229_CM 0. 4.e-002 FORMAT "%7.5" /end CHARACTERISTIC
/begin CHARACTERISTIC Cmp_prs_n_alti_min_map_cor "Factor applied on altimetric pressure to obtain variation of Pzero" MAP 0xa002c91c _REC_A1MAP_20_u1_u2_u2 0.99609375 _CNV_A_R_LINEAR_____29_CM 0. 0.99609375 FORMAT "%10.8"
 /begin AXIS_DESCR COM_AXIS Vxx_map _CNV_A_R_LINEAR_____115_CM 9 0. 20000. FORMAT "%5.0" AXIS_PTS_REF Ctb_prs2 /end AXIS_DESCR
 /begin AXIS_DESCR COM_AXIS Vxx_n _CNV_A_R_ENSD_LINEA_22_CM 9 0. 16383.75 FORMAT "%8.2" AXIS_PTS_REF Ctb_n2 /end AXIS_DESCR
/end CHARACTERISTIC
/begin CHARACTERISTIC Ctp_min_map "Minimum manifold pressure to get engine mass air flow (depending on engine speed)" CURVE 0xa002c970 _REC_A1CUR_20_u2_u2 20000. _CNV_A_R_LINEAR_____115_CM 0. 20000. FORMAT "%5.0"
 /begin AXIS_DESCR COM_AXIS Vxx_n _CNV_A_R_ENSD_LINEA_22_CM 20 0. 16383.75 FORMAT "%8.2" AXIS_PTS_REF Ctb_n /end AXIS_DESCR
/end CHARACTERISTIC
/begin MEASUREMENT Vsx_min_map_maf_vld "Validity indicator for minimum pressure for mass air flow" UBYTE _CNV_S_3_STATUS_OK__179_CM 1 0. 0. 2. ECU_ADDRESS 0xd0006acb /end MEASUREMENT
/begin MEASUREMENT Vxx_min_map_maf "Minimum pressure under which there is no air flow into cylinder (including altimetry)" UWORD _CNV_A_R_LINEAR_____115_CM 1 0. 0. 20000. ECU_ADDRESS 0xd00041c8 FORMAT "%5.0" /end MEASUREMENT
/begin AXIS_PTS Ctp_it_ar_psn "Throttle position setpoint depending on effective area." 0xa002c8f8 Vxx_mv_it_rel_psn _REC_A2AXS_20_u2 100. _CNV_A_R_LINEAR_____150_CM 17 0. 100. FORMAT "%6.2" /end AXIS_PTS
/begin MEASUREMENT Vxx_pred_map_efv_it_ar "Effective intake throttle area" UWORD _CNV_A_R_LINEAR_____144_CM 1 0. 0. 3.90619e-003 ECU_ADDRESS 0xd00041c4 FORMAT "%11.9" /end MEASUREMENT
/begin AXIS_PTS Ntb_100_9 "Table of breakpoints" 0xa002bad4 Vxx_cp_pwm_appl _REC_A2AXS_20_u2 100. _CNV_A_R_LINEAR_____159_CM 9 0. 100. READ_ONLY FORMAT "%12.8" /end AXIS_PTS
/begin AXIS_PTS Ntb_1_9 "Table of breakpoints" 0xa002bae8 Vxx_cp_rich_cor _REC_A2AXS_20_u2 0.666656494140625 _CNV_A_R_LINEAR_____50_CM 9 0. 0.666656494140625 READ_ONLY FORMAT "%8.7" /end AXIS_PTS
/begin CHARACTERISTIC Ctp_cp_load_fac_cor "Cartographie de correction du Cfe_value en fonction du taux d'essence dans le débit de purge" CURVE 0xa002bafc _REC_A1CUR_20_u1_u2 3.984375 _CNV_A_R_LINEAR_____83_CM 0. 3.984375 FORMAT "%8.6"
 /begin AXIS_DESCR COM_AXIS Vxx_cp_rich_cor _CNV_A_R_LINEAR_____50_CM 9 0. 0.666656494140625 READ_ONLY FORMAT "%8.7" AXIS_PTS_REF Ntb_1_9 /end AXIS_DESCR
/end CHARACTERISTIC
/begin CHARACTERISTIC Ctp_pwm_cp_efv_ar1 "Effective area of the canister purge at high frequency command" CURVE 0xa002bb08 _REC_A1CUR_20_u2_u2 2.44136274662394e-004 _CNV_A_R_LINEAR_____230_CM 0. 2.44136274662394e-004 FORMAT "%11.9"
 /begin AXIS_DESCR COM_AXIS Vxx_cp_pwm_appl _CNV_A_R_LINEAR_____159_CM 9 0. 100. READ_ONLY FORMAT "%12.8" AXIS_PTS_REF Ntb_100_9 /end AXIS_DESCR
/end CHARACTERISTIC
/begin CHARACTERISTIC Ctp_pwm_cp_efv_ar2 "Effective area of the canister purge at low frequency command" CURVE 0xa002bb1c _REC_A1CUR_20_u2_u2 2.44136274662394e-004 _CNV_A_R_LINEAR_____230_CM 0. 2.44136274662394e-004 FORMAT "%11.9"
 /begin AXIS_DESCR COM_AXIS Vxx_cp_pwm_appl _CNV_A_R_LINEAR_____159_CM 9 0. 100. READ_ONLY FORMAT "%12.8" AXIS_PTS_REF Ntb_100_9 /end AXIS_DESCR
/end CHARACTERISTIC
/begin MEASUREMENT Vxx_clc_ar_cp_air_gas_maf "Theoretical mass air flow per unit of the effective surface valve of the canister purge" UWORD _CNV_A_R_LINEAR_____231_CM 1 0. 0. 510. ECU_ADDRESS 0xd000419e FORMAT "%11.7" /end MEASUREMENT
/begin MEASUREMENT Vxx_clc_ar_cp_air_gas_maf_cor "Corrected theoretical mass air flow per unit of the effective surface valve of the canister" UWORD _CNV_A_R_LINEAR_____231_CM 1 0. 0. 510. ECU_ADDRESS 0xd00041a0 FORMAT "%11.7" /end MEASUREMENT
/begin MEASUREMENT Vxx_cp_efv_ar "Effective area of the canister purge valve." UWORD _CNV_A_R_LINEAR_____49_CM 1 0. 0. 2.4414e-004 ECU_ADDRESS 0xd00041a2 FORMAT "%14.12" /end MEASUREMENT
/begin MEASUREMENT Vxx_cp_maf "Canister purge mass air flow" UWORD _CNV_A_R_LINEAR_____172_CM 1 0. 0. 3000. ECU_ADDRESS 0xd00041a4 FORMAT "%4.3" /end MEASUREMENT
/begin MEASUREMENT Vxx_raw_cp_maf "Canister purge mass air flow for EVAP calculation" UWORD _CNV_A_R_LINEAR_____172_CM 1 0. 0. 3000. ECU_ADDRESS 0xd00041a6 FORMAT "%7.2" /end MEASUREMENT
/begin CHARACTERISTIC Cbx_as_cpmaf_on_mod "Airpath flow correction by canister flow activation authorisation" VALUE 0xa0021246 _REC_S1VAL_20_u1 1. _CNV_A_R_ECME_LINEA_0_CM 0. 1. FORMAT "%1.0" BIT_MASK 0x1 /end CHARACTERISTIC
/begin CHARACTERISTIC Cxx_dft_cp_load "Default canister charge" VALUE 0xa0021242 _REC_S1VAL_20_u2 0.666666733327059 _CNV_A_R_LINEAR_____232_CM 0. 0.666666733327059 FORMAT "%8.7" /end CHARACTERISTIC
/begin CHARACTERISTIC Cxx_flr_clc_dsb_prs_thd "Manifold pressure beyond which we inhibit the calculation of the mass air flow from the canister" VALUE 0xa0021244 _REC_S1VAL_20_u2 20000. _CNV_A_R_LINEAR_____115_CM 0. 20000. FORMAT "%5.0" /end CHARACTERISTIC
/begin CHARACTERISTIC Cmp_n_map_fill_efv_ofs_alco "Map giving the corrective offset applied on gazonline fill up efficiency for alcool" MAP 0xa002b818 _REC_A1MAP_20_u2_u2_u2 1.999969482421875 _CNV_A_R_LINEAR_____233_CM -1. 0.999969482421875 FORMAT "%10.8"
 /begin AXIS_DESCR COM_AXIS Vxx_n _CNV_A_R_ENSD_LINEA_22_CM 20 0. 16383.75 FORMAT "%8.2" AXIS_PTS_REF Ctb_n /end AXIS_DESCR
 /begin AXIS_DESCR COM_AXIS Vxx_map _CNV_A_R_LINEAR_____115_CM 17 0. 20000. FORMAT "%5.0" AXIS_PTS_REF Ctb_prs /end AXIS_DESCR
/end CHARACTERISTIC
/begin CHARACTERISTIC Ctp_vlv_air_temp_cor_alco "Table of correction of cylinder fill-up efficiency with valve gaz temperature for alcool" CURVE 0xa002bac0 _REC_A1CUR_20_u2_u2 1.999969482 _CNV_A_R_LINEAR_____147_CM 0. 1.999969482 FORMAT "%10.8"
 /begin AXIS_DESCR COM_AXIS NO_INPUT_QUANTITY _CNV_A_R_LINEAR_____110_CM 9 -40. 200. FORMAT "%5.1" AXIS_PTS_REF Ctb_mat2 /end AXIS_DESCR
/end CHARACTERISTIC
/begin MEASUREMENT Vxx_fill_efv_ofs_alco "corrective term of fill up efficiency applied on gazoline settings" UWORD _CNV_A_R_LINEAR_____233_CM 1 0. -1. 0.999969482421875 ECU_ADDRESS 0xd000419a FORMAT "%10.8" /end MEASUREMENT
/begin MEASUREMENT Vxx_vlv_air_temp_cor_alco "Table of correction of cylinder fill-up efficiency with valve gaz temperature for alcool" UWORD _CNV_A_R_LINEAR_____147_CM 1 0. 0. 1.999969482 ECU_ADDRESS 0xd000419c FORMAT "%10.8" /end MEASUREMENT
/begin AXIS_PTS Ctb_sens_it_cor_1 "Breakpoint table used with the cartography Ctp_sens_it_cor_1." 0xa002cbd0 Vxx_sens_it_tmp_1 _REC_A2AXS_20_u2 100. _CNV_A_R_LINEAR_____150_CM 4 0. 100. FORMAT "%6.2" /end AXIS_PTS
/begin AXIS_PTS Ctb_sens_it_cor_2 "Breakpoint table used with the cartography Ctp_sens_it_cor_2." 0xa002cbdc Vxx_sens_it_tmp_2 _REC_A2AXS_20_u2 100. _CNV_A_R_LINEAR_____150_CM 4 0. 100. FORMAT "%6.2" /end AXIS_PTS
/begin CHARACTERISTIC Ctp_sens_it_cor_1 "Cartography to convert the sensor 1 read position in V of a normalized position." CURVE 0xa00212e0 _REC_A1CUR_20_u2_u2 100. _CNV_A_R_LINEAR_____150_CM 0. 100. FORMAT "%6.2"
 /begin AXIS_DESCR COM_AXIS Vxx_sens_it_tmp_1 _CNV_A_R_LINEAR_____150_CM 4 0. 100. FORMAT "%6.2" AXIS_PTS_REF Ctb_sens_it_cor_1 /end AXIS_DESCR
/end CHARACTERISTIC
/begin CHARACTERISTIC Ctp_sens_it_cor_2 "Cartography to convert the sensor 2 read position in V of a normalized position." CURVE 0xa00212e8 _REC_A1CUR_20_u2_u2 100. _CNV_A_R_LINEAR_____150_CM 0. 100. FORMAT "%6.2"
 /begin AXIS_DESCR COM_AXIS Vxx_sens_it_tmp_2 _CNV_A_R_LINEAR_____150_CM 4 0. 100. FORMAT "%6.2" AXIS_PTS_REF Ctb_sens_it_cor_2 /end AXIS_DESCR
/end CHARACTERISTIC
/begin MEASUREMENT Vbx_df_sens_it_1_nok "IT Sensor 1 Plausibility detected failure" UBYTE _CNV_S_2_RANGE______3_CM 1 0. 0. 1. ECU_ADDRESS 0xd0006b03 BIT_MASK 0x1 /end MEASUREMENT
/begin MEASUREMENT Vbx_df_sens_it_2_nok "IT Sensor 2 Plausibility detected failure" UBYTE _CNV_S_2_RANGE______3_CM 1 0. 0. 1. ECU_ADDRESS 0xd0006b04 BIT_MASK 0x1 /end MEASUREMENT
/begin MEASUREMENT Vbx_df_sens_it_chr "IT Sensors 1 and 2 Coherence detected failure" UBYTE _CNV_S_2_RANGE______3_CM 1 0. 0. 1. ECU_ADDRESS 0xd0006b05 BIT_MASK 0x1 /end MEASUREMENT
/begin MEASUREMENT Vbx_df_sens_it_sig_mcut "IT Sensors microcut detected failure" UBYTE _CNV_S_2_RANGE______3_CM 1 0. 0. 1. ECU_ADDRESS 0xd0006b06 BIT_MASK 0x1 /end MEASUREMENT
/begin MEASUREMENT Vbx_diag_ena_sens_it_chr "IT Sensors 1 and 2 Coherence diagnosis authorization" UBYTE _CNV_S_2_RANGE______3_CM 1 0. 0. 1. ECU_ADDRESS 0xd0006b07 BIT_MASK 0x1 /end MEASUREMENT
/begin MEASUREMENT Vbx_it_psn_stab_1 "Indicates the stability of the sensor 1 position, during offset reading" UBYTE _CNV_S_2_RANGE______3_CM 1 0. 0. 1. ECU_ADDRESS 0xd0006b08 BIT_MASK 0x1 /end MEASUREMENT
/begin MEASUREMENT Vbx_it_psn_stab_2 "Indicates the stability of the sensor 2 position, during offset reading" UBYTE _CNV_S_2_RANGE______3_CM 1 0. 0. 1. ECU_ADDRESS 0xd0006b09 BIT_MASK 0x1 /end MEASUREMENT
/begin MEASUREMENT Vbx_it_psn_stab_det_1 "Indicates if a new sensor 1 position has to be taken in order to check the stability." UBYTE _CNV_S_2_RANGE______3_CM 1 0. 0. 1. ECU_ADDRESS 0xd0006b0a BIT_MASK 0x1 /end MEASUREMENT
/begin MEASUREMENT Vbx_it_psn_stab_det_2 "Indicates if a new sensor 2 position has to be taken in order to check the stability." UBYTE _CNV_S_2_RANGE______3_CM 1 0. 0. 1. ECU_ADDRESS 0xd0006b0b BIT_MASK 0x1 /end MEASUREMENT
/begin MEASUREMENT Vbx_sens_it_spd_chr_no_norm "Indicates that the speed of sensor 1 and 2 are not coherent." UBYTE _CNV_S_2_RANGE______3_CM 1 0. 0. 1. ECU_ADDRESS 0xd0006b0c BIT_MASK 0x1 /end MEASUREMENT
/begin MEASUREMENT Vsx_it_sens_vld "Inlet throttle sensor validity status." UBYTE _CNV_S_8_STATUS_OK__234_CM 1 0. 0. 7. ECU_ADDRESS 0xd0006b0d /end MEASUREMENT
/begin MEASUREMENT Vsx_it_sens_vld_prev "Inlet throttle sensor validity status, previous sample time." UBYTE _CNV_S_8_STATUS_OK__234_CM 1 0. 0. 7. ECU_ADDRESS 0xd0006b0e /end MEASUREMENT
/begin MEASUREMENT Vsx_it_sens_vld_tmp "Inlet throttle sensor validity status, temporary value." UBYTE _CNV_S_8_STATUS_OK__234_CM 1 0. 0. 7. ECU_ADDRESS 0xd0006b0f /end MEASUREMENT
/begin MEASUREMENT Vxx_it_psn "Throttle position in percent of the sensor supply voltage" UWORD _CNV_A_R_LINEAR_____150_CM 1 0. 0. 100. ECU_ADDRESS 0xd000426e FORMAT "%6.2" /end MEASUREMENT
/begin MEASUREMENT Vxx_it_psn_mv_1 "Sliding mean value, 1st sensor" UWORD _CNV_A_R_LINEAR_____150_CM 1 0. 0. 100. ECU_ADDRESS 0xd0004270 FORMAT "%6.2" /end MEASUREMENT
/begin MEASUREMENT Vxx_it_psn_mv_2 "Sliding mean value, 2 nd sensor" UWORD _CNV_A_R_LINEAR_____150_CM 1 0. 0. 100. ECU_ADDRESS 0xd0004272 FORMAT "%6.2" /end MEASUREMENT
/begin MEASUREMENT Vxx_it_psn_stab_1 "Value of the position used as a reference for the check of the stability, sensor 1." UWORD _CNV_A_R_LINEAR_____150_CM 1 0. 0. 100. ECU_ADDRESS 0xd0004274 FORMAT "%6.2" /end MEASUREMENT
/begin MEASUREMENT Vxx_it_psn_stab_2 "Value of the position used as a reference for the check of the stability, sensor 2." UWORD _CNV_A_R_LINEAR_____150_CM 1 0. 0. 100. ECU_ADDRESS 0xd0004276 FORMAT "%6.2" /end MEASUREMENT
/begin MEASUREMENT Vxx_sens_it_1 "Inlet throttle sensor 1 position." UWORD _CNV_A_R_LINEAR_____150_CM 1 0. 0. 100. ECU_ADDRESS 0xd0004278 FORMAT "%6.2" /end MEASUREMENT
/begin MEASUREMENT Vxx_sens_it_2 "Inlet throttle sensor 2 position." UWORD _CNV_A_R_LINEAR_____150_CM 1 0. 0. 100. ECU_ADDRESS 0xd000427a FORMAT "%6.2" /end MEASUREMENT
/begin MEASUREMENT Vxx_sens_it_tmp_1 "Absolute position from the sensor 1, in percent of the sensor supply voltage. Before lin. carto." UWORD _CNV_A_R_LINEAR_____150_CM 1 0. 0. 100. ECU_ADDRESS 0xd000427c FORMAT "%6.2" /end MEASUREMENT
/begin MEASUREMENT Vxx_sens_it_tmp_2 "Absolute position from the sensor 2, in percent of the sensor supply voltage. Before lin. carto." UWORD _CNV_A_R_LINEAR_____150_CM 1 0. 0. 100. ECU_ADDRESS 0xd000427e FORMAT "%6.2" /end MEASUREMENT
/begin CHARACTERISTIC Cbx_sens_it_chr_fil_cho "Activation of filter for sensor incoherence detection." VALUE 0xa0021318 _REC_S1VAL_20_u1 1. _CNV_S_2_RANGE______3_CM 0. 1. /end CHARACTERISTIC
/begin CHARACTERISTIC Cbx_sens_it_mcut_cho "Microcut diag. configuration." VALUE 0xa0021319 _REC_S1VAL_20_u1 1. _CNV_S_2_RANGE______3_CM 0. 1. /end CHARACTERISTIC
/begin CHARACTERISTIC Cbx_sens_it_mcut_cho_2 "Mcut configuration for regulation on one sensor. On-> rise mcut diagnosis on src_df." VALUE 0xa002131a _REC_S1VAL_20_u1 1. _CNV_S_2_RANGE______3_CM 0. 1. /end CHARACTERISTIC
/begin CHARACTERISTIC Cbx_sens_it_typ_1 "Indicates if the sensor 1 technology obliges to adapt the signal with the sensor supply voltage." VALUE 0xa002131b _REC_S1VAL_20_u1 1. _CNV_S_2_RANGE______3_CM 0. 1. /end CHARACTERISTIC
/begin CHARACTERISTIC Cbx_sens_it_typ_2 "Indicates if the sensor 2 technology obliges to adapt the signal with the sensor supply voltage." VALUE 0xa002131c _REC_S1VAL_20_u1 1. _CNV_S_2_RANGE______3_CM 0. 1. /end CHARACTERISTIC
/begin CHARACTERISTIC Cbx_sens_it_vld_cho_1 "a_in_asi_iti_itposxx/Position value on failure 2. Off -> limp home, On -> remaining sensor." VALUE 0xa002131d _REC_S1VAL_20_u1 1. _CNV_S_2_RANGE______3_CM 0. 1. /end CHARACTERISTIC
/begin CHARACTERISTIC Cbx_sens_it_vld_cho_2 "a_in_asi_iti_itposxx/Position value on failure 3. Off -> limp home, On -> remaining sensor." VALUE 0xa002131e _REC_S1VAL_20_u1 1. _CNV_S_2_RANGE______3_CM 0. 1. /end CHARACTERISTIC
/begin CHARACTERISTIC Cbx_sens_it_vld_cho_3 "Position value on Vsx_it_clt_vld ==0. Off -> limp home, On -> sensor." VALUE 0xa002131f _REC_S1VAL_20_u1 1. _CNV_S_2_RANGE______3_CM 0. 1. /end CHARACTERISTIC
/begin CHARACTERISTIC Cxx_dfdec_sens_it_1_nok "a_in_asi_iti_itposxx/IT Sensor 1 Plausibility detected failure counter decrement" VALUE 0xa00212f0 _REC_S1VAL_20_u2 65535. _CNV_A_R_ECME_LINEA_0_CM 0. 65535. FORMAT "%5.0" /end CHARACTERISTIC
/begin CHARACTERISTIC Cxx_dfdec_sens_it_2_nok "a_in_asi_iti_itposxx/IT Sensor 2 Plausibility detected failure counter decrement" VALUE 0xa00212f2 _REC_S1VAL_20_u2 65535. _CNV_A_R_ECME_LINEA_0_CM 0. 65535. FORMAT "%5.0" /end CHARACTERISTIC
/begin CHARACTERISTIC Cxx_dfdec_sens_it_chr "a_in_asi_iti_itposxx/ IT Sensor 1 and 2 Coherence detected failure counter decrement" VALUE 0xa00212f4 _REC_S1VAL_20_u2 65535. _CNV_A_R_ECME_LINEA_0_CM 0. 65535. FORMAT "%5.0" /end CHARACTERISTIC
/begin CHARACTERISTIC Cxx_dfdec_sens_it_sig_mcut "IT Sensor microcut detected failure counter decrement" VALUE 0xa00212f6 _REC_S1VAL_20_u2 65535. _CNV_A_R_ECME_LINEA_0_CM 0. 65535. FORMAT "%5.0" /end CHARACTERISTIC
/begin CHARACTERISTIC Cxx_dfinc_sens_it_1_nok "a_in_asi_iti_itposxx/ IT Sensor 1 Plausibility detected failure counter increment" VALUE 0xa00212f8 _REC_S1VAL_20_u2 65535. _CNV_A_R_ECME_LINEA_0_CM 0. 65535. FORMAT "%5.0" /end CHARACTERISTIC
/begin CHARACTERISTIC Cxx_dfinc_sens_it_2_nok "a_in_asi_iti_itposxx/ IT Sensor 2 Plausibility detected failure counter increment" VALUE 0xa00212fa _REC_S1VAL_20_u2 65535. _CNV_A_R_ECME_LINEA_0_CM 0. 65535. FORMAT "%5.0" /end CHARACTERISTIC
/begin CHARACTERISTIC Cxx_dfinc_sens_it_chr "a_in_asi_iti_itposxx/ IT Sensor 1 and 2 Coherence detected failure counter increment" VALUE 0xa00212fc _REC_S1VAL_20_u2 65535. _CNV_A_R_ECME_LINEA_0_CM 0. 65535. FORMAT "%5.0" /end CHARACTERISTIC
/begin CHARACTERISTIC Cxx_dfinc_sens_it_sig_mcut "IT Sensor microcut detected failure counter increment" VALUE 0xa00212fe _REC_S1VAL_20_u2 65535. _CNV_A_R_ECME_LINEA_0_CM 0. 65535. FORMAT "%5.0" /end CHARACTERISTIC
/begin CHARACTERISTIC Cxx_it_psn_stab_dly_1 "Time period to declare the sensor 1 position \"stable\" (used during learning and check)." VALUE 0xa0021300 _REC_S1VAL_20_u2 65.535 _CNV_A_R_LINEAR_____116_CM 0. 65.535 /end CHARACTERISTIC
/begin CHARACTERISTIC Cxx_it_psn_stab_dly_2 "Time period to declare the sensor 2 position \"stable\" (used during learning and check)." VALUE 0xa0021302 _REC_S1VAL_20_u2 65.535 _CNV_A_R_LINEAR_____116_CM 0. 65.535 /end CHARACTERISTIC
/begin CHARACTERISTIC Cxx_it_psn_stab_thd_1 "Threshold value to consider the stability of sensor 1 position during the learning or reading cycle." VALUE 0xa0021304 _REC_S1VAL_20_u2 100. _CNV_A_R_LINEAR_____150_CM 0. 100. FORMAT "%6.2" /end CHARACTERISTIC
/begin CHARACTERISTIC Cxx_it_psn_stab_thd_2 "Threshold value to consider the stability of sensor 2 position during the learning or reading cycle." VALUE 0xa0021306 _REC_S1VAL_20_u2 100. _CNV_A_R_LINEAR_____150_CM 0. 100. FORMAT "%6.2" /end CHARACTERISTIC
/begin CHARACTERISTIC Cxx_sens_it_1_src_max "Maximum plausible value, sensor 1." VALUE 0xa0021308 _REC_S1VAL_20_u2 100. _CNV_A_R_LINEAR_____150_CM 0. 100. FORMAT "%6.2" /end CHARACTERISTIC
/begin CHARACTERISTIC Cxx_sens_it_1_src_min "Minimum plausible value, sensor 1." VALUE 0xa002130a _REC_S1VAL_20_u2 100. _CNV_A_R_LINEAR_____150_CM 0. 100. FORMAT "%6.2" /end CHARACTERISTIC
/begin CHARACTERISTIC Cxx_sens_it_2_src_max "Maximum plausible value, sensor 2." VALUE 0xa002130c _REC_S1VAL_20_u2 100. _CNV_A_R_LINEAR_____150_CM 0. 100. FORMAT "%6.2" /end CHARACTERISTIC
/begin CHARACTERISTIC Cxx_sens_it_2_src_min "Minimum plausible value, sensor 2." VALUE 0xa002130e _REC_S1VAL_20_u2 100. _CNV_A_R_LINEAR_____150_CM 0. 100. FORMAT "%6.2" /end CHARACTERISTIC
/begin CHARACTERISTIC Cxx_sens_it_chr_fil "Time constant of the coherence diagnosis first order filter." VALUE 0xa0021310 _REC_S1VAL_20_u2 65.535 _CNV_A_R_LINEAR_____116_CM 0. 65.535 /end CHARACTERISTIC
/begin CHARACTERISTIC Cxx_sens_it_max_chr_dif "Max. abs(sensor1-sensor2), for coherence diagnosis." VALUE 0xa0021312 _REC_S1VAL_20_u2 100. _CNV_A_R_LINEAR_____150_CM 0. 100. FORMAT "%6.2" /end CHARACTERISTIC
/begin CHARACTERISTIC Cxx_sens_it_mcut_det_dly "Microcut diagnosis detection delay." VALUE 0xa0021314 _REC_S1VAL_20_u2 65.535 _CNV_A_R_LINEAR_____116_CM 0. 65.535 /end CHARACTERISTIC
/begin CHARACTERISTIC Cxx_sens_it_spd_chr_thd "Microcut diagnosis speed cohenrence thresh." VALUE 0xa0021316 _REC_S1VAL_20_u2 100. _CNV_A_R_LINEAR_____150_CM 0. 100. FORMAT "%6.2" /end CHARACTERISTIC
/begin MEASUREMENT Vbx_it_pwl_ad_req "Request to learn on next power latch phase." UBYTE _CNV_S_2_RANGE______3_CM 1 0. 0. 1. DISPLAY_IDENTIFIER OuAsoIto_NVM.Vbx_it_pwl_ad_req_NVM ECU_ADDRESS 0xd00045b8 BIT_MASK 0x1 /end MEASUREMENT
/begin MEASUREMENT Vbx_it_frst_ad_ok "First learning successfully completed." UBYTE _CNV_S_2_RANGE______3_CM 1 0. 0. 1. DISPLAY_IDENTIFIER OuAsoIto_NVM.Vbx_it_frst_ad_ok_NVM ECU_ADDRESS 0xd00045b9 BIT_MASK 0x1 /end MEASUREMENT
/begin MEASUREMENT Vbx_it_frst_ad_stop "End of the first learning phase, after first key on." UBYTE _CNV_S_2_RANGE______3_CM 1 0. 0. 1. DISPLAY_IDENTIFIER OuAsoIto_NVM.Vbx_it_frst_ad_stop_NVM ECU_ADDRESS 0xd00045ba BIT_MASK 0x1 /end MEASUREMENT
/begin MEASUREMENT Vxx_it_clos_psn_1 "Closed position learnt on the first sensor." UWORD _CNV_A_R_LINEAR_____150_CM 1 0. 0. 100. DISPLAY_IDENTIFIER OuAsoIto_NVM.Vxx_it_clos_psn_1_NVM ECU_ADDRESS 0xd00045bc FORMAT "%6.2" /end MEASUREMENT
/begin MEASUREMENT Vxx_it_lih_psn_1 "Limp home position learnt on the first sensor." UWORD _CNV_A_R_LINEAR_____150_CM 1 0. 0. 100. DISPLAY_IDENTIFIER OuAsoIto_NVM.Vxx_it_lih_psn_1_NVM ECU_ADDRESS 0xd00045be FORMAT "%6.2" /end MEASUREMENT
/begin MEASUREMENT Vxx_it_open_psn_1 "Open position learnt on the first sensor." UWORD _CNV_A_R_LINEAR_____150_CM 1 0. 0. 100. DISPLAY_IDENTIFIER OuAsoIto_NVM.Vxx_it_open_psn_1_NVM ECU_ADDRESS 0xd00045c0 FORMAT "%6.2" /end MEASUREMENT
/begin MEASUREMENT Vxx_it_clos_psn_2 "Closed position learnt on the second sensor." UWORD _CNV_A_R_LINEAR_____150_CM 1 0. 0. 100. DISPLAY_IDENTIFIER OuAsoIto_NVM.Vxx_it_clos_psn_2_NVM ECU_ADDRESS 0xd00045c2 FORMAT "%6.2" /end MEASUREMENT
/begin MEASUREMENT Vxx_it_lih_psn_2 "Limp home position learnt on the second sensor." UWORD _CNV_A_R_LINEAR_____150_CM 1 0. 0. 100. DISPLAY_IDENTIFIER OuAsoIto_NVM.Vxx_it_lih_psn_2_NVM ECU_ADDRESS 0xd00045c4 FORMAT "%6.2" /end MEASUREMENT
/begin MEASUREMENT Vxx_it_open_psn_2 "Open position learnt on the second sensor." UWORD _CNV_A_R_LINEAR_____150_CM 1 0. 0. 100. DISPLAY_IDENTIFIER OuAsoIto_NVM.Vxx_it_open_psn_2_NVM ECU_ADDRESS 0xd00045c6 FORMAT "%6.2" /end MEASUREMENT
/begin MEASUREMENT Vxx_it_ofs_secu_nok_ctr "Springs check detected failure local counter" UWORD _CNV_A_R_ECME_LINEA_0_CM 1 0. 0. 65535. DISPLAY_IDENTIFIER OuAsoIto_NVM.Vxx_it_ofs_secu_nok_ctr_NVM ECU_ADDRESS 0xd00045c8 FORMAT "%5.0" /end MEASUREMENT
/begin MEASUREMENT Vxx_it_ofs_meca_ctr "Offset Deviation detected failure local counter" UWORD _CNV_A_R_ECME_LINEA_0_CM 1 0. 0. 65535. DISPLAY_IDENTIFIER OuAsoIto_NVM.Vxx_it_ofs_meca_ctr_NVM ECU_ADDRESS 0xd00045ca FORMAT "%5.0" /end MEASUREMENT
/begin MEASUREMENT Vxx_it_ofs_no_norm_ctr "First Offset detected failure local counter" UWORD _CNV_A_R_ECME_LINEA_0_CM 1 0. 0. 65535. DISPLAY_IDENTIFIER OuAsoIto_NVM.Vxx_it_ofs_no_norm_ctr_NVM ECU_ADDRESS 0xd00045cc FORMAT "%5.0" /end MEASUREMENT
/begin MEASUREMENT Vbx_df_it_ofs_meca "IT Offset Deviation detected failure" UBYTE _CNV_S_2_RANGE______3_CM 1 0. 0. 1. ECU_ADDRESS 0xd0006e03 BIT_MASK 0x1 /end MEASUREMENT
/begin MEASUREMENT Vbx_df_it_ofs_meca_tmp "IT Offset Deviation detected failure, temporary value" UBYTE _CNV_S_2_RANGE______3_CM 1 0. 0. 1. ECU_ADDRESS 0xd0006e04 BIT_MASK 0x1 /end MEASUREMENT
/begin MEASUREMENT Vbx_df_it_ofs_no_norm "IT First Offset Learning detected failure" UBYTE _CNV_S_2_RANGE______3_CM 1 0. 0. 1. ECU_ADDRESS 0xd0006e05 BIT_MASK 0x1 /end MEASUREMENT
/begin MEASUREMENT Vbx_df_it_ofs_no_norm_tmp "IT First Offset Learning detected failure, temporary value" UBYTE _CNV_S_2_RANGE______3_CM 1 0. 0. 1. ECU_ADDRESS 0xd0006e06 BIT_MASK 0x1 /end MEASUREMENT
/begin MEASUREMENT Vbx_df_it_ofs_secu_nok "IT springs check detected failure" UBYTE _CNV_S_2_RANGE______3_CM 1 0. 0. 1. ECU_ADDRESS 0xd0006e07 BIT_MASK 0x1 /end MEASUREMENT
/begin MEASUREMENT Vbx_df_it_ofs_secu_nok_tmp "IT springs check detected failure, tempory value" UBYTE _CNV_S_2_RANGE______3_CM 1 0. 0. 1. ECU_ADDRESS 0xd0006e08 BIT_MASK 0x1 /end MEASUREMENT
/begin MEASUREMENT Vbx_df_it_reg_blk "Blocked IT during regulation detected failure" UBYTE _CNV_S_2_RANGE______3_CM 1 0. 0. 1. ECU_ADDRESS 0xd0006e09 BIT_MASK 0x1 /end MEASUREMENT
/begin MEASUREMENT Vbx_diag_ena_it_ofs_1 "Offset reading diagnosis authorization 1" UBYTE _CNV_S_2_RANGE______3_CM 1 0. 0. 1. ECU_ADDRESS 0xd0006e0a BIT_MASK 0x1 /end MEASUREMENT
/begin MEASUREMENT Vbx_diag_ena_it_ofs_meca "IT Offset Deviation diagnosis authorization." UBYTE _CNV_S_2_RANGE______3_CM 1 0. 0. 1. ECU_ADDRESS 0xd0006e0b BIT_MASK 0x1 /end MEASUREMENT
/begin MEASUREMENT Vbx_diag_ena_it_ofs_no_norm "IT First Offset Learning diagnosis authorization" UBYTE _CNV_S_2_RANGE______3_CM 1 0. 0. 1. ECU_ADDRESS 0xd0006e0c BIT_MASK 0x1 /end MEASUREMENT
/begin MEASUREMENT Vbx_diag_ena_it_ofs_secu_nok "IT springs check diagnosis authorization" UBYTE _CNV_S_2_RANGE______3_CM 1 0. 0. 1. ECU_ADDRESS 0xd0006e0d BIT_MASK 0x1 /end MEASUREMENT
/begin MEASUREMENT Vbx_it_diag_ad_1 "Result of the offset reading (adaptative) diagnosis , 1st sensor." UBYTE _CNV_S_2_RANGE______3_CM 1 0. 0. 1. ECU_ADDRESS 0xd0006e0e BIT_MASK 0x1 /end MEASUREMENT
/begin MEASUREMENT Vbx_it_diag_ad_2 "Result of the offset reading (adaptative) diagnosis , 2nd sensor." UBYTE _CNV_S_2_RANGE______3_CM 1 0. 0. 1. ECU_ADDRESS 0xd0006e0f BIT_MASK 0x1 /end MEASUREMENT
/begin MEASUREMENT Vbx_it_diag_ad_end_1 "Indicates the end of the adaptative (offset reading) diagnosis, 1st sensor." UBYTE _CNV_S_2_RANGE______3_CM 1 0. 0. 1. ECU_ADDRESS 0xd0006e10 BIT_MASK 0x1 /end MEASUREMENT
/begin MEASUREMENT Vbx_it_diag_ad_end_2 "Indicates the end of the adaptative (offset reading) diagnosis, 2nd sensor." UBYTE _CNV_S_2_RANGE______3_CM 1 0. 0. 1. ECU_ADDRESS 0xd0006e11 BIT_MASK 0x1 /end MEASUREMENT
/begin MEASUREMENT Vbx_it_diag_ad_fail "Indicates an adaptative request failure." UBYTE _CNV_S_2_RANGE______3_CM 1 0. 0. 1. ECU_ADDRESS 0xd0006e12 BIT_MASK 0x1 /end MEASUREMENT
/begin MEASUREMENT Vbx_it_diag_ini "Flag indicating diagnosis counters initialization request." UBYTE _CNV_S_2_RANGE______3_CM 1 0. 0. 1. ECU_ADDRESS 0xd0006e13 BIT_MASK 0x1 /end MEASUREMENT
/begin MEASUREMENT Vbx_it_diag_psn_stab "Abnormal stable position during regulation." UBYTE _CNV_S_2_RANGE______3_CM 1 0. 0. 1. ECU_ADDRESS 0xd0006e14 BIT_MASK 0x1 /end MEASUREMENT
/begin MEASUREMENT Vbx_it_diag_psn_stab_det_1 "Indicates if a new sensor 1 position has to be taken in order to check the stability." UBYTE _CNV_S_2_RANGE______3_CM 1 0. 0. 1. ECU_ADDRESS 0xd0006e15 BIT_MASK 0x1 /end MEASUREMENT
/begin MEASUREMENT Vbx_it_diag_stab_ena "Triggers stabilization check." UBYTE _CNV_S_2_RANGE______3_CM 1 0. 0. 1. ECU_ADDRESS 0xd0006e16 BIT_MASK 0x1 /end MEASUREMENT
/begin MEASUREMENT Vbx_it_reset_reg_blk "Flag that resets the regulation failure detection temporization." UBYTE _CNV_S_2_RANGE______3_CM 1 0. 0. 1. ECU_ADDRESS 0xd0006e17 BIT_MASK 0x1 /end MEASUREMENT
/begin MEASUREMENT Vxx_it_diag_psn_stab "Reference value for stabilization check." UWORD _CNV_A_R_LINEAR_____150_CM 1 0. 0. 100. ECU_ADDRESS 0xd0004594 FORMAT "%6.2" /end MEASUREMENT
/begin MEASUREMENT Vxx_it_ofs_meca_ctr_tmp "Offset Deviation detected failure local counter. Temp. value" UWORD _CNV_A_R_ECME_LINEA_0_CM 1 0. 0. 65535. ECU_ADDRESS 0xd0004596 FORMAT "%5.0" /end MEASUREMENT
/begin MEASUREMENT Vxx_it_ofs_no_norm_ctr_tmp "First Offset detected failure local counter. Temp. value" UWORD _CNV_A_R_ECME_LINEA_0_CM 1 0. 0. 65535. ECU_ADDRESS 0xd0004598 FORMAT "%5.0" /end MEASUREMENT
/begin MEASUREMENT Vxx_it_ofs_secu_nok_ctr_tmp "Springs check detected failure local counter. Temp. value" UWORD _CNV_A_R_ECME_LINEA_0_CM 1 0. 0. 65535. ECU_ADDRESS 0xd000459a FORMAT "%5.0" /end MEASUREMENT
/begin MEASUREMENT Vxx_it_tempo_reg_blk "Temporization for regulation failure detection." UWORD _CNV_A_R_LINEAR_____116_CM 1 0. 0. 65.535 ECU_ADDRESS 0xd000459c FORMAT "%5.3" /end MEASUREMENT
/begin CHARACTERISTIC Cxx_dfdec_it_cmd_el "a_ou_aso_ito_itdiagx/Inlet Throttle HBridge detected failure counter decrement" VALUE 0xa00218aa _REC_S1VAL_20_u2 65535. _CNV_A_R_ECME_LINEA_0_CM 0. 65535. FORMAT "%5.0" /end CHARACTERISTIC
/begin CHARACTERISTIC Cxx_dfdec_it_ofs_meca "a_ou_aso_ito_itdiagx/IT Offset Deviation detected failure counter decrement" VALUE 0xa00218ac _REC_S1VAL_20_u2 65535. _CNV_A_R_ECME_LINEA_0_CM 0. 65535. FORMAT "%5.0" /end CHARACTERISTIC
/begin CHARACTERISTIC Cxx_dfdec_it_ofs_no_norm "a_ou_aso_ito_itdiagx/IT First Offset detected failure counter decrement" VALUE 0xa00218ae _REC_S1VAL_20_u2 65535. _CNV_A_R_ECME_LINEA_0_CM 0. 65535. FORMAT "%5.0" /end CHARACTERISTIC
/begin CHARACTERISTIC Cxx_dfdec_it_ofs_secu_nok "a_ou_aso_ito_itdiagx/IT springs check detected failure counter decrement" VALUE 0xa00218b0 _REC_S1VAL_20_u2 65535. _CNV_A_R_ECME_LINEA_0_CM 0. 65535. FORMAT "%5.0" /end CHARACTERISTIC
/begin CHARACTERISTIC Cxx_dfdec_it_reg_blk "a_ou_aso_ito_itdiagx/Blocked IT during regulation detected failure counter decrement" VALUE 0xa00218b2 _REC_S1VAL_20_u2 65535. _CNV_A_R_ECME_LINEA_0_CM 0. 65535. FORMAT "%5.0" /end CHARACTERISTIC
/begin CHARACTERISTIC Cxx_dfinc_it_cmd_el "a_ou_aso_ito_itdiagx/Inlet Throttle HBridge detected failure counter increment" VALUE 0xa00218b4 _REC_S1VAL_20_u2 65535. _CNV_A_R_ECME_LINEA_0_CM 0. 65535. FORMAT "%5.0" /end CHARACTERISTIC
/begin CHARACTERISTIC Cxx_dfinc_it_ofs_meca "a_ou_aso_ito_itdiagx/IT Offset Deviation detected failure counter increment" VALUE 0xa00218b6 _REC_S1VAL_20_u2 65535. _CNV_A_R_ECME_LINEA_0_CM 0. 65535. FORMAT "%5.0" /end CHARACTERISTIC
/begin CHARACTERISTIC Cxx_dfinc_it_ofs_no_norm "a_ou_aso_ito_itdiagx/IT First Offset detected failure counter increment" VALUE 0xa00218b8 _REC_S1VAL_20_u2 65535. _CNV_A_R_ECME_LINEA_0_CM 0. 65535. FORMAT "%5.0" /end CHARACTERISTIC
/begin CHARACTERISTIC Cxx_dfinc_it_ofs_secu_nok "a_ou_aso_ito_itdiagx/IT springs check detected failure counter increment" VALUE 0xa00218ba _REC_S1VAL_20_u2 65535. _CNV_A_R_ECME_LINEA_0_CM 0. 65535. FORMAT "%5.0" /end CHARACTERISTIC
/begin CHARACTERISTIC Cxx_dfinc_it_reg_blk "a_ou_aso_ito_itdiagx/Blocked IT during regulation detected failure counter increment" VALUE 0xa00218bc _REC_S1VAL_20_u2 65535. _CNV_A_R_ECME_LINEA_0_CM 0. 65535. FORMAT "%5.0" /end CHARACTERISTIC
/begin CHARACTERISTIC Cxx_it_diag_psn_stab_dly "Delay to detect a position stuck and stable." VALUE 0xa00218be _REC_S1VAL_20_u2 65.535 _CNV_A_R_LINEAR_____116_CM 0. 65.535 FORMAT "%5.3" /end CHARACTERISTIC
/begin CHARACTERISTIC Cxx_it_diag_psn_stab_thd "Position error thresh to detect a position stuck and stable." VALUE 0xa00218c0 _REC_S1VAL_20_u2 100. _CNV_A_R_LINEAR_____150_CM 0. 100. FORMAT "%6.2" /end CHARACTERISTIC
/begin CHARACTERISTIC Cxx_it_max_clos_psn "Maximum coherent closed position." VALUE 0xa00218c2 _REC_S1VAL_20_u2 100. _CNV_A_R_LINEAR_____150_CM 0. 100. FORMAT "%6.2" /end CHARACTERISTIC
/begin CHARACTERISTIC Cxx_it_max_clos_psn_dev "Maximum admissible closed position deviation during power latch check." VALUE 0xa00218c4 _REC_S1VAL_20_u2 100. _CNV_A_R_LINEAR_____150_CM 0. 100. FORMAT "%6.2" /end CHARACTERISTIC
/begin CHARACTERISTIC Cxx_it_max_lih_psn "Maximum coherent limp home position." VALUE 0xa00218c6 _REC_S1VAL_20_u2 100. _CNV_A_R_LINEAR_____150_CM 0. 100. FORMAT "%6.2" /end CHARACTERISTIC
/begin CHARACTERISTIC Cxx_it_max_lih_psn_dev "Maximum admissible limp home position deviation during power latch check." VALUE 0xa00218c8 _REC_S1VAL_20_u2 100. _CNV_A_R_LINEAR_____150_CM 0. 100. FORMAT "%6.2" /end CHARACTERISTIC
/begin CHARACTERISTIC Cxx_it_max_open_psn "Maximum coherent open position." VALUE 0xa00218ca _REC_S1VAL_20_u2 100. _CNV_A_R_LINEAR_____150_CM 0. 100. FORMAT "%6.2" /end CHARACTERISTIC
/begin CHARACTERISTIC Cxx_it_max_open_psn_dev "Maximum admissible open position deviation during power latch check." VALUE 0xa00218cc _REC_S1VAL_20_u2 100. _CNV_A_R_LINEAR_____150_CM 0. 100. FORMAT "%6.2" /end CHARACTERISTIC
/begin CHARACTERISTIC Cxx_it_min_clos_psn "Minimum coherent closed position." VALUE 0xa00218ce _REC_S1VAL_20_u2 100. _CNV_A_R_LINEAR_____150_CM 0. 100. FORMAT "%6.2" /end CHARACTERISTIC
/begin CHARACTERISTIC Cxx_it_min_lih_psn "Minimum coherent limp home position." VALUE 0xa00218d0 _REC_S1VAL_20_u2 100. _CNV_A_R_LINEAR_____150_CM 0. 100. FORMAT "%6.2" /end CHARACTERISTIC
/begin CHARACTERISTIC Cxx_it_min_open_psn "Minimum coherent open position." VALUE 0xa00218d2 _REC_S1VAL_20_u2 100. _CNV_A_R_LINEAR_____150_CM 0. 100. FORMAT "%6.2" /end CHARACTERISTIC
/begin CHARACTERISTIC Cxx_it_ofs_meca_decr "Offset Deviation detected failure local counter decrement" VALUE 0xa00218d4 _REC_S1VAL_20_u2 65535. _CNV_A_R_ECME_LINEA_0_CM 0. 65535. FORMAT "%5.0" /end CHARACTERISTIC
/begin CHARACTERISTIC Cxx_it_ofs_meca_incr "Offset Deviation detected failure local counter increment" VALUE 0xa00218d6 _REC_S1VAL_20_u2 65535. _CNV_A_R_ECME_LINEA_0_CM 0. 65535. FORMAT "%5.0" /end CHARACTERISTIC
/begin CHARACTERISTIC Cxx_it_ofs_no_norm_decr "First Offset detected failure local counter decrement" VALUE 0xa00218d8 _REC_S1VAL_20_u2 65535. _CNV_A_R_ECME_LINEA_0_CM 0. 65535. FORMAT "%5.0" /end CHARACTERISTIC
/begin CHARACTERISTIC Cxx_it_ofs_no_norm_incr "First Offset detected failure local counter increment" VALUE 0xa00218da _REC_S1VAL_20_u2 65535. _CNV_A_R_ECME_LINEA_0_CM 0. 65535. FORMAT "%5.0" /end CHARACTERISTIC
/begin CHARACTERISTIC Cxx_it_ofs_secu_nok_decr "Springs check detected failure local counter decrement" VALUE 0xa00218dc _REC_S1VAL_20_u2 65535. _CNV_A_R_ECME_LINEA_0_CM 0. 65535. FORMAT "%5.0" /end CHARACTERISTIC
/begin CHARACTERISTIC Cxx_it_ofs_secu_nok_incr "Springs check detected failure local counter increment" VALUE 0xa00218de _REC_S1VAL_20_u2 65535. _CNV_A_R_ECME_LINEA_0_CM 0. 65535. FORMAT "%5.0" /end CHARACTERISTIC
/begin CHARACTERISTIC Cxx_it_reg_blk_det_dly "Delay to detect a regulation failure." VALUE 0xa00218e0 _REC_S1VAL_20_u2 65.535 _CNV_A_R_LINEAR_____116_CM 0. 65.535 FORMAT "%5.3" /end CHARACTERISTIC
/begin CHARACTERISTIC Cxx_it_reg_blk_max_err "Position error thresh to detect regulation failure." VALUE 0xa00218e2 _REC_S1VAL_20_u2 100. _CNV_A_R_LINEAR_____150_CM 0. 100. FORMAT "%6.2" /end CHARACTERISTIC
/begin CHARACTERISTIC Cxx_it_reg_blk_max_err_2 "Position error thresh to detect a blocked and stable position." VALUE 0xa00218e4 _REC_S1VAL_20_u2 100. _CNV_A_R_LINEAR_____150_CM 0. 100. FORMAT "%6.2" /end CHARACTERISTIC
/begin CHARACTERISTIC Cxx_it_reg_blk_v_max_thd "Voltage upper saturation thresh to detect regulation failure." VALUE 0xa00218e6 _REC_S1VAL_20_u2 25000. _CNV_A_R_LINEAR_____107_CM 0. 25000. FORMAT "%5.0" /end CHARACTERISTIC
/begin CHARACTERISTIC Cxx_it_reg_blk_v_min_thd "Voltage lower saturation thresh to detect regulation failure." VALUE 0xa00218e8 _REC_S1VAL_20_s2 25000. _CNV_A_R_LINEAR_____107_CM -25000. 0. FORMAT "%6.0" /end CHARACTERISTIC
/begin AXIS_PTS Ctb_it_frst_ad_t "Breakpoint table for the first learning cycle. Used for position setpoint." 0xa002ec64 Vxx_it_cyc_remaining_t _REC_A2AXS_20_u2 65.535 _CNV_A_R_LINEAR_____116_CM 32 0. 65.535 FORMAT "%5.3" /end AXIS_PTS
/begin AXIS_PTS Ctb_it_frst_ad_t_2 "Breakpoint table for the first learning cycle. Used for cycle request." 0xa002eca8 Vxx_it_cyc_remaining_t _REC_A2AXS_20_u2 65.535 _CNV_A_R_LINEAR_____116_CM 32 0. 65.535 FORMAT "%5.3" /end AXIS_PTS
/begin AXIS_PTS Ctb_it_ol_v_psn "Breakpoint table for open loop control." 0xa002ecec Vxx_fil1_it_psn_sp _REC_A2AXS_20_u2 200. _CNV_A_R_LINEAR_____146_CM 16 0. 200. FORMAT "%4.2" /end AXIS_PTS
/begin AXIS_PTS Ctb_it_pwl_ad_t "Breakpoint table for the power latch cycle. Used for position setpoint." 0xa002ed10 Vxx_it_cyc_remaining_t _REC_A2AXS_20_u2 65.535 _CNV_A_R_LINEAR_____116_CM 32 0. 65.535 FORMAT "%5.3" /end AXIS_PTS
/begin AXIS_PTS Ctb_it_pwl_ad_t_2 "Breakpoint table for the power latch cycle. Used for cycle request." 0xa002ed54 Vxx_it_cyc_remaining_t _REC_A2AXS_20_u2 65.535 _CNV_A_R_LINEAR_____116_CM 32 0. 65.535 FORMAT "%5.3" /end AXIS_PTS
/begin CHARACTERISTIC Ctd_it_frst_ad_deci "Indexed Table. Decision on reading failure, during first learning cycle." CURVE 0xa002ed98 _REC_A1CUR_20_u1_u2 5. _CNV_A_R_ECME_LINEA_0_CM 1. 6. FORMAT "%1.0"
 /begin AXIS_DESCR COM_AXIS Vxx_it_cyc_remaining_t _CNV_A_R_LINEAR_____116_CM 32 0. 65.535 FORMAT "%5.3" AXIS_PTS_REF Ctb_it_frst_ad_t_2 /end AXIS_DESCR
/end CHARACTERISTIC
/begin CHARACTERISTIC Ctd_it_frst_ad_req "Indexed table. Type of request profile during first learning." CURVE 0xa002edb8 _REC_A1CUR_20_u1_u2 12. _CNV_A_R_ECME_LINEA_0_CM 1. 13. FORMAT "%3.0"
 /begin AXIS_DESCR COM_AXIS Vxx_it_cyc_remaining_t _CNV_A_R_LINEAR_____116_CM 32 0. 65.535 FORMAT "%5.3" AXIS_PTS_REF Ctb_it_frst_ad_t_2 /end AXIS_DESCR
/end CHARACTERISTIC
/begin CHARACTERISTIC Ctd_it_frst_ad_v_cut "Indexed Table. H-Bridge shutdown requests for the first learning cycle." CURVE 0xa002edd8 _REC_A1CUR_20_u1_u2 1. _CNV_S_2_RANGE______3_CM 0. 1.
 /begin AXIS_DESCR COM_AXIS Vxx_it_cyc_remaining_t _CNV_A_R_LINEAR_____116_CM 32 0. 65.535 FORMAT "%5.3" AXIS_PTS_REF Ctb_it_frst_ad_t /end AXIS_DESCR
/end CHARACTERISTIC
/begin CHARACTERISTIC Ctd_it_pwl_ad_deci "Indexed Table. Decision on reading failure during power latch cycle." CURVE 0xa002edf8 _REC_A1CUR_20_u1_u2 5. _CNV_A_R_ECME_LINEA_0_CM 1. 6. FORMAT "%1.0"
 /begin AXIS_DESCR COM_AXIS Vxx_it_cyc_remaining_t _CNV_A_R_LINEAR_____116_CM 32 0. 65.535 FORMAT "%5.3" AXIS_PTS_REF Ctb_it_pwl_ad_t_2 /end AXIS_DESCR
/end CHARACTERISTIC
/begin CHARACTERISTIC Ctd_it_pwl_ad_req "Indexed Table. Type of request profile during  power latch check cycle." CURVE 0xa002ee18 _REC_A1CUR_20_u1_u2 12. _CNV_A_R_ECME_LINEA_0_CM 1. 13. FORMAT "%3.0"
 /begin AXIS_DESCR COM_AXIS Vxx_it_cyc_remaining_t _CNV_A_R_LINEAR_____116_CM 32 0. 65.535 FORMAT "%5.3" AXIS_PTS_REF Ctb_it_pwl_ad_t_2 /end AXIS_DESCR
/end CHARACTERISTIC
/begin CHARACTERISTIC Ctd_it_pwl_ad_v_cut "Indexed Table. H-Bridge shutdown requests for the power latch check cycle." CURVE 0xa002ee38 _REC_A1CUR_20_u1_u2 1. _CNV_S_2_RANGE______3_CM 0. 1.
 /begin AXIS_DESCR COM_AXIS Vxx_it_cyc_remaining_t _CNV_A_R_LINEAR_____116_CM 32 0. 65.535 FORMAT "%5.3" AXIS_PTS_REF Ctb_it_pwl_ad_t /end AXIS_DESCR
/end CHARACTERISTIC
/begin CHARACTERISTIC Ctp_it_frst_ad_sp "Cartography of the position setpoint for the first learning cycle." CURVE 0xa002ee58 _REC_A1CUR_20_u2_u2 100. _CNV_A_R_LINEAR_____150_CM 0. 100. FORMAT "%6.2"
 /begin AXIS_DESCR COM_AXIS Vxx_it_cyc_remaining_t _CNV_A_R_LINEAR_____116_CM 32 0. 65.535 FORMAT "%5.3" AXIS_PTS_REF Ctb_it_frst_ad_t /end AXIS_DESCR
/end CHARACTERISTIC
/begin CHARACTERISTIC Ctp_it_ol_v "Cartography of Voltage for open loop control." CURVE 0xa002ee98 _REC_A1CUR_20_u2_u2 50000. _CNV_A_R_LINEAR_____235_CM -25000. 25000. FORMAT "%6.0"
 /begin AXIS_DESCR COM_AXIS Vxx_fil1_it_psn_sp _CNV_A_R_LINEAR_____146_CM 16 0. 200. FORMAT "%4.2" AXIS_PTS_REF Ctb_it_ol_v_psn /end AXIS_DESCR
/end CHARACTERISTIC
/begin CHARACTERISTIC Ctp_it_pwl_ad_sp "Cartography of the position setpoint for the first power latch cycle." CURVE 0xa002eeb8 _REC_A1CUR_20_u2_u2 100. _CNV_A_R_LINEAR_____150_CM 0. 100. FORMAT "%6.2"
 /begin AXIS_DESCR COM_AXIS Vxx_it_cyc_remaining_t _CNV_A_R_LINEAR_____116_CM 32 0. 65.535 FORMAT "%5.3" AXIS_PTS_REF Ctb_it_pwl_ad_t /end AXIS_DESCR
/end CHARACTERISTIC
/begin MEASUREMENT Vbx_diag_ena_it_ofs "Offset reading diagnosis authorization." UBYTE _CNV_S_2_RANGE______3_CM 1 0. 0. 1. ECU_ADDRESS 0xd0006e3b BIT_MASK 0x1 /end MEASUREMENT
/begin MEASUREMENT Vbx_diag_ena_it_reg_blk "Blocked IT during regulation diagnosis authorization" UBYTE _CNV_S_2_RANGE______3_CM 1 0. 0. 1. ECU_ADDRESS 0xd0006e3c BIT_MASK 0x1 /end MEASUREMENT
/begin MEASUREMENT Vbx_it_ad_cyc_end "Indicates the end of the learning or check cycle." UBYTE _CNV_S_2_RANGE______3_CM 1 0. 0. 1. ECU_ADDRESS 0xd0006e3d BIT_MASK 0x1 /end MEASUREMENT
/begin MEASUREMENT Vbx_it_ad_cyc_end_mem "Indicates the end of the learning or check cycle. Local variable of learning stateflow." UBYTE _CNV_S_2_RANGE______3_CM 1 0. 0. 1. ECU_ADDRESS 0xd0006e3e BIT_MASK 0x1 /end MEASUREMENT
/begin MEASUREMENT Vbx_it_ad_cyc_v_cut "Request from the Cycle Generation to cut the H-Bridge, during learning or check." UBYTE _CNV_S_2_RANGE______3_CM 1 0. 0. 1. ECU_ADDRESS 0xd0006e3f BIT_MASK 0x1 /end MEASUREMENT
/begin MEASUREMENT Vbx_it_ad_ena "Enables adaptative request." UBYTE _CNV_S_2_RANGE______3_CM 1 0. 0. 1. ECU_ADDRESS 0xd0006e40 BIT_MASK 0x1 /end MEASUREMENT
/begin MEASUREMENT Vbx_it_ad_v_lim_stop "Flag indicating the end of voltage limitation during thrust learning" UBYTE _CNV_S_2_RANGE______3_CM 1 0. 0. 1. ECU_ADDRESS 0xd0006e41 BIT_MASK 0x1 /end MEASUREMENT
/begin MEASUREMENT Vbx_it_cyc_cho "Type of cycle that is executed (1: power latch check, 0 : complete learning)" UBYTE _CNV_S_2_RANGE______3_CM 1 0. 0. 1. ECU_ADDRESS 0xd0006e42 BIT_MASK 0x1 /end MEASUREMENT
/begin MEASUREMENT Vbx_it_cyc_inter "Indicates that a check or relearning cycle was interrupted." UBYTE _CNV_S_2_RANGE______3_CM 1 0. 0. 1. ECU_ADDRESS 0xd0006e43 BIT_MASK 0x1 /end MEASUREMENT
/begin MEASUREMENT Vbx_it_hbrg_inh "H-Bridge inhibition request." UBYTE _CNV_S_2_RANGE______3_CM 1 0. 0. 1. ECU_ADDRESS 0xd0006e44 BIT_MASK 0x1 /end MEASUREMENT
/begin MEASUREMENT Vbx_it_igk_on "Indicates a key on interrupting a power latch phase." UBYTE _CNV_S_2_RANGE______3_CM 1 0. 0. 1. ECU_ADDRESS 0xd0006e45 BIT_MASK 0x1 /end MEASUREMENT
/begin MEASUREMENT Vbx_it_imd_ad_req "Request to relearn immediately, during power latch phase." UBYTE _CNV_S_2_RANGE______3_CM 1 0. 0. 1. ECU_ADDRESS 0xd0006e46 BIT_MASK 0x1 /end MEASUREMENT
/begin MEASUREMENT Vbx_it_imd_ad_req_tmp "Request to relearn immediately, during power latch phase. Temp.value" UBYTE _CNV_S_2_RANGE______3_CM 1 0. 0. 1. ECU_ADDRESS 0xd0006e47 BIT_MASK 0x1 /end MEASUREMENT
/begin MEASUREMENT Vbx_it_mon_mv_ena_1 "Enables mean value calculation, 1st sensor." UBYTE _CNV_S_2_RANGE______3_CM 1 0. 0. 1. ECU_ADDRESS 0xd0006e48 BIT_MASK 0x1 /end MEASUREMENT
/begin MEASUREMENT Vbx_it_mon_mv_ena_2 "Enables mean value calculation, 2nd sensor." UBYTE _CNV_S_2_RANGE______3_CM 1 0. 0. 1. ECU_ADDRESS 0xd0006e49 BIT_MASK 0x1 /end MEASUREMENT
/begin MEASUREMENT Vbx_it_mon_read_ena "Enables reading and stability check." UBYTE _CNV_S_2_RANGE______3_CM 1 0. 0. 1. ECU_ADDRESS 0xd0006e4a BIT_MASK 0x1 /end MEASUREMENT
/begin MEASUREMENT Vbx_it_ofs_diag_ena_1 "Enables offset reading diagnosis, 1st sensor." UBYTE _CNV_S_2_RANGE______3_CM 1 0. 0. 1. ECU_ADDRESS 0xd0006e4b BIT_MASK 0x1 /end MEASUREMENT
/begin MEASUREMENT Vbx_it_ofs_diag_ena_2 "Enables offset reading diagnosis, 2nd sensor." UBYTE _CNV_S_2_RANGE______3_CM 1 0. 0. 1. ECU_ADDRESS 0xd0006e4c BIT_MASK 0x1 /end MEASUREMENT
/begin MEASUREMENT Vbx_it_pwl_bgin "Indicates the beginning of the power latch phase." UBYTE _CNV_S_2_RANGE______3_CM 1 0. 0. 1. ECU_ADDRESS 0xd0006e4d BIT_MASK 0x1 /end MEASUREMENT
/begin MEASUREMENT Vbx_it_pwl_end "End of powerlatch phase. IT available for basis software tests." UBYTE _CNV_S_2_RANGE______3_CM 1 0. 0. 1. ECU_ADDRESS 0xd0006e4e BIT_MASK 0x1 /end MEASUREMENT
/begin MEASUREMENT Vbx_it_pws_req "Request to maintain the power latch." UBYTE _CNV_S_2_RANGE______3_CM 1 0. 0. 1. ECU_ADDRESS 0xd0006e4f BIT_MASK 0x1 /end MEASUREMENT
/begin MEASUREMENT Vbx_it_read_ok_1 "Reading on 1st sensor was successfully completed." UBYTE _CNV_S_2_RANGE______3_CM 1 0. 0. 1. ECU_ADDRESS 0xd0006e50 BIT_MASK 0x1 /end MEASUREMENT
/begin MEASUREMENT Vbx_it_read_ok_2 "Reading on 2nd sensor was successfully completed." UBYTE _CNV_S_2_RANGE______3_CM 1 0. 0. 1. ECU_ADDRESS 0xd0006e51 BIT_MASK 0x1 /end MEASUREMENT
/begin MEASUREMENT Vbx_it_req_fail_1 "Indicates a request failure, first sensor." UBYTE _CNV_S_2_RANGE______3_CM 1 0. 0. 1. ECU_ADDRESS 0xd0006e52 BIT_MASK 0x1 /end MEASUREMENT
/begin MEASUREMENT Vbx_it_req_fail_2 "Indicates a request failure, second sensor." UBYTE _CNV_S_2_RANGE______3_CM 1 0. 0. 1. ECU_ADDRESS 0xd0006e53 BIT_MASK 0x1 /end MEASUREMENT
/begin MEASUREMENT Vbx_it_sta_dsb "Throttle not available for engine start (search phase)" UBYTE _CNV_S_2_RANGE______3_CM 1 0. 0. 1. ECU_ADDRESS 0xd0006e54 BIT_MASK 0x1 /end MEASUREMENT
/begin MEASUREMENT Vbx_it_temp_no_ok "Indicates that the temperature is too high or too low to learn thrusts and limp home." UBYTE _CNV_S_2_RANGE______3_CM 1 0. 0. 1. ECU_ADDRESS 0xd0006e55 BIT_MASK 0x1 /end MEASUREMENT
/begin MEASUREMENT Vbx_it_trigger_1 "Trigger. Local variable" UBYTE _CNV_S_2_RANGE______3_CM 1 0. 0. 1. ECU_ADDRESS 0xd0006e56 BIT_MASK 0x1 /end MEASUREMENT
/begin MEASUREMENT Vbx_it_trigger_2 "Trigger. Local variable" UBYTE _CNV_S_2_RANGE______3_CM 1 0. 0. 1. ECU_ADDRESS 0xd0006e57 BIT_MASK 0x1 /end MEASUREMENT
/begin MEASUREMENT Vbx_it_trigger_3 "Trigger. Local variable" UBYTE _CNV_S_2_RANGE______3_CM 1 0. 0. 1. ECU_ADDRESS 0xd0006e58 BIT_MASK 0x1 /end MEASUREMENT
/begin MEASUREMENT Vbx_it_trigger_4 "Trigger. Local variable" UBYTE _CNV_S_2_RANGE______3_CM 1 0. 0. 1. ECU_ADDRESS 0xd0006e59 BIT_MASK 0x1 /end MEASUREMENT
/begin MEASUREMENT Vbx_it_trigger_5 "Trigger. Local variable" UBYTE _CNV_S_2_RANGE______3_CM 1 0. 0. 1. ECU_ADDRESS 0xd0006e5a BIT_MASK 0x1 /end MEASUREMENT
/begin MEASUREMENT Vbx_it_trigger_ofs_1 "Trigger. Local variable" UBYTE _CNV_S_2_RANGE______3_CM 1 0. 0. 1. ECU_ADDRESS 0xd0006e5b BIT_MASK 0x1 /end MEASUREMENT
/begin MEASUREMENT Vbx_it_trigger_ofs_2 "Trigger. Local variable" UBYTE _CNV_S_2_RANGE______3_CM 1 0. 0. 1. ECU_ADDRESS 0xd0006e5c BIT_MASK 0x1 /end MEASUREMENT
/begin MEASUREMENT Vbx_it_trigger_ofs_3 "Trigger. Local variable" UBYTE _CNV_S_2_RANGE______3_CM 1 0. 0. 1. ECU_ADDRESS 0xd0006e5d BIT_MASK 0x1 /end MEASUREMENT
/begin MEASUREMENT Vbx_it_trigger_ofs_4 "Trigger. Local variable" UBYTE _CNV_S_2_RANGE______3_CM 1 0. 0. 1. ECU_ADDRESS 0xd0006e5e BIT_MASK 0x1 /end MEASUREMENT
/begin MEASUREMENT Vbx_it_trigger_ofs_5 "Trigger. Local variable" UBYTE _CNV_S_2_RANGE______3_CM 1 0. 0. 1. ECU_ADDRESS 0xd0006e5f BIT_MASK 0x1 /end MEASUREMENT
/begin MEASUREMENT Vbx_it_trigger_ofs_6 "Trigger. Local variable" UBYTE _CNV_S_2_RANGE______3_CM 1 0. 0. 1. ECU_ADDRESS 0xd0006e60 BIT_MASK 0x1 /end MEASUREMENT
/begin MEASUREMENT Vbx_it_v_sp_cho "Voltage setpoint choice (if one, regulation mode, if 0, open loop)." UBYTE _CNV_S_2_RANGE______3_CM 1 0. 0. 1. ECU_ADDRESS 0xd0006e61 BIT_MASK 0x1 /end MEASUREMENT
/begin MEASUREMENT Vbx_it_write_ena "Enables offset writing" UBYTE _CNV_S_2_RANGE______3_CM 1 0. 0. 1. ECU_ADDRESS 0xd0006e62 BIT_MASK 0x1 /end MEASUREMENT
/begin MEASUREMENT Vsx_it_ctl_vld "Inlet throttle control system validity status." UBYTE _CNV_A_R_ECME_LINEA_0_CM 1 0. 0. 255. ECU_ADDRESS 0xd0006e63 FORMAT "%3.0" /end MEASUREMENT
/begin MEASUREMENT Vsx_it_vld "Inlet throttle validity status" UBYTE _CNV_A_R_ECME_LINEA_0_CM 1 0. 0. 255. ECU_ADDRESS 0xd0006e64 FORMAT "%3.0" /end MEASUREMENT
/begin MEASUREMENT Vxx_fil1_it_abs_psn_sp "IT absolute position reference from the Air System." UWORD _CNV_A_R_LINEAR_____146_CM 1 0. 0. 200. ECU_ADDRESS 0xd00045d0 FORMAT "%6.2" /end MEASUREMENT
/begin MEASUREMENT Vxx_it_ad_cyc_req "Current learning or reading type of request. From the Cycle Generation." UBYTE _CNV_A_R_ECME_LINEA_0_CM 1 0. 1. 13. ECU_ADDRESS 0xd0006e65 FORMAT "%3.0" /end MEASUREMENT
/begin MEASUREMENT Vxx_it_ad_cyc_sp "Position reference from the Cycle Generation (used during learning or check cycles)." UWORD _CNV_A_R_LINEAR_____150_CM 1 0. 0. 100. ECU_ADDRESS 0xd00045d2 FORMAT "%6.2" /end MEASUREMENT
/begin MEASUREMENT Vxx_it_ad_deci "Decision to execute in case of learning or check failure. After Dynamic Configuration." UBYTE _CNV_A_R_ECME_LINEA_0_CM 1 0. 1. 6. ECU_ADDRESS 0xd0006e66 FORMAT "%1.0" /end MEASUREMENT
/begin MEASUREMENT Vxx_it_ad_fail_deci "Decision to execute in case of learning or check failure. From the Cycle Generation." UBYTE _CNV_A_R_ECME_LINEA_0_CM 1 0. 1. 6. ECU_ADDRESS 0xd0006e67 FORMAT "%1.0" /end MEASUREMENT
/begin MEASUREMENT Vxx_it_ad_fail_deci_mem "Decision to execute in case of learning or check failure. Memorized value.  From Learning stateflow" UBYTE _CNV_A_R_ECME_LINEA_0_CM 1 0. 1. 6. ECU_ADDRESS 0xd0006e68 FORMAT "%1.0" /end MEASUREMENT
/begin MEASUREMENT Vxx_it_ad_pb "A problem occured during reading request." UBYTE _CNV_A_R_ECME_LINEA_0_CM 1 0. 1. 6. ECU_ADDRESS 0xd0006e69 FORMAT "%1.0" /end MEASUREMENT
/begin MEASUREMENT Vxx_it_ad_req "Current reading or learning type of request." UBYTE _CNV_A_R_ECME_LINEA_0_CM 1 0. 1. 13. ECU_ADDRESS 0xd0006e6a FORMAT "%2.0" /end MEASUREMENT
/begin MEASUREMENT Vxx_it_ad_req_mem "Learning or reading type of request. Memorized value. From the Learn or Check state flow." UBYTE _CNV_A_R_ECME_LINEA_0_CM 1 0. 1. 13. ECU_ADDRESS 0xd0006e6b FORMAT "%3.0" /end MEASUREMENT
/begin MEASUREMENT Vxx_it_ad_stt "State of the Learn or Check (adaptative) stateflow" UBYTE _CNV_A_R_ECME_LINEA_0_CM 1 0. 1. 5. ECU_ADDRESS 0xd0006e6c FORMAT "%3.0" /end MEASUREMENT
/begin MEASUREMENT Vxx_it_ad_typ "Type of cycle that is processing. 1 : first learning, 2 : pwl check, 3 : pwl relearning" UBYTE _CNV_A_R_ECME_LINEA_0_CM 1 0. 1. 4. ECU_ADDRESS 0xd0006e6d FORMAT "%3.0" /end MEASUREMENT
/begin MEASUREMENT Vxx_it_clos_psn "Closed position of the inlet throttle." UWORD _CNV_A_R_LINEAR_____150_CM 1 0. 0. 100. ECU_ADDRESS 0xd00045d4 FORMAT "%6.2" /end MEASUREMENT
/begin MEASUREMENT Vxx_it_cyc_nr "Number of learning or check cycles that occured." UBYTE _CNV_A_R_ECME_LINEA_0_CM 1 0. 0. 8. ECU_ADDRESS 0xd0006e6e FORMAT "%3.0" /end MEASUREMENT
/begin MEASUREMENT Vxx_it_cyc_remaining_t "Remaining time before end of learning or check cycle." UWORD _CNV_A_R_LINEAR_____116_CM 1 0. 0. 65.535 ECU_ADDRESS 0xd00045d6 FORMAT "%5.3" /end MEASUREMENT
/begin MEASUREMENT Vxx_it_diag_fail_mode "Failure mode requested." UBYTE _CNV_A_R_ECME_LINEA_0_CM 1 0. 0. 2. ECU_ADDRESS 0xd0006e6f FORMAT "%1.0" /end MEASUREMENT
/begin MEASUREMENT Vxx_it_lih_psn "Limp home position of the inlet throttle." UWORD _CNV_A_R_LINEAR_____150_CM 1 0. 0. 100. ECU_ADDRESS 0xd00045d8 FORMAT "%6.2" /end MEASUREMENT
/begin MEASUREMENT Vxx_it_mon_psn_sp "Position setpoint sent by the monitoring system." UWORD _CNV_A_R_LINEAR_____150_CM 1 0. 0. 100. ECU_ADDRESS 0xd00045da FORMAT "%6.2" /end MEASUREMENT
/begin MEASUREMENT Vxx_it_mon_v_sp "Voltage setpoint for open loop control. Value sent to the H bridge." SWORD _CNV_A_R_LINEAR_____107_CM 1 0. -25000. 25000. ECU_ADDRESS 0xd00045dc FORMAT "%6.0" /end MEASUREMENT
/begin MEASUREMENT Vxx_it_ofs_1 "Current value read by the Reading stateflow, 1st sensor." UWORD _CNV_A_R_LINEAR_____150_CM 1 0. 0. 100. ECU_ADDRESS 0xd00045de FORMAT "%6.2" /end MEASUREMENT
/begin MEASUREMENT Vxx_it_ofs_2 "Current value read by the Reading stateflow, 2nd sensor." UWORD _CNV_A_R_LINEAR_____150_CM 1 0. 0. 100. ECU_ADDRESS 0xd00045e0 FORMAT "%6.2" /end MEASUREMENT
/begin MEASUREMENT Vxx_it_ofs_ctr_1 "Internal counter, offset reading stateflow 1." UWORD _CNV_A_R_ECME_LINEA_0_CM 1 0. 1. 512. ECU_ADDRESS 0xd00045e2 FORMAT "%3.0" /end MEASUREMENT
/begin MEASUREMENT Vxx_it_ofs_ctr_2 "Internal counter, offset reading stateflow 2." UWORD _CNV_A_R_ECME_LINEA_0_CM 1 0. 1. 512. ECU_ADDRESS 0xd00045e4 FORMAT "%3.0" /end MEASUREMENT
/begin MEASUREMENT Vxx_it_ofs_down "Minimum value of the position setpoint." UWORD _CNV_A_R_LINEAR_____150_CM 1 0. 0. 100. ECU_ADDRESS 0xd00045e6 FORMAT "%6.2" /end MEASUREMENT
/begin MEASUREMENT Vxx_it_ofs_up "Maximum value of the position setpoint." UWORD _CNV_A_R_LINEAR_____150_CM 1 0. 0. 100. ECU_ADDRESS 0xd00045e8 FORMAT "%6.2" /end MEASUREMENT
/begin MEASUREMENT Vxx_it_ol_ctr "Counter for the open loop control request." UBYTE _CNV_A_R_ECME_LINEA_0_CM 1 0. 0. 3. ECU_ADDRESS 0xd0006e70 FORMAT "%1.0" /end MEASUREMENT
/begin MEASUREMENT Vxx_it_open_psn "Open position  of the inlet throttle" UWORD _CNV_A_R_LINEAR_____150_CM 1 0. 0. 100. ECU_ADDRESS 0xd00045ea FORMAT "%6.2" /end MEASUREMENT
/begin MEASUREMENT Vxx_it_read_stt_1 "State of the Reading stateflow, 1st sensor." UBYTE _CNV_A_R_ECME_LINEA_0_CM 1 0. 1. 5. ECU_ADDRESS 0xd0006e71 FORMAT "%3.0" /end MEASUREMENT
/begin MEASUREMENT Vxx_it_read_stt_2 "State of the Reading stateflow, 2nd sensor." UBYTE _CNV_A_R_ECME_LINEA_0_CM 1 0. 1. 5. ECU_ADDRESS 0xd0006e72 FORMAT "%3.0" /end MEASUREMENT
/begin MEASUREMENT Vxx_it_rel_psn "Relative throttle position in percent of the sensor supply voltage." UWORD _CNV_A_R_LINEAR_____150_CM 1 0. 0. 100. ECU_ADDRESS 0xd00045ec FORMAT "%6.2" /end MEASUREMENT
/begin MEASUREMENT Vxx_it_rge_down "Range near the low voltage thrust where the thrust approach strategy is activated." UWORD _CNV_A_R_LINEAR_____150_CM 1 0. 0. 100. ECU_ADDRESS 0xd00045ee FORMAT "%6.2" /end MEASUREMENT
/begin MEASUREMENT Vxx_it_rge_up "Range near the high voltage thrust where the thrust approach strategy is activated." UWORD _CNV_A_R_LINEAR_____150_CM 1 0. 0. 100. ECU_ADDRESS 0xd00045f0 FORMAT "%6.2" /end MEASUREMENT
/begin MEASUREMENT Vxx_it_stt "State of the main state flow." UBYTE _CNV_A_R_ECME_LINEA_0_CM 1 0. 1. 11. ECU_ADDRESS 0xd0006e73 FORMAT "%3.0" /end MEASUREMENT
/begin MEASUREMENT Vxx_it_stt_ctr "Internal counter, main stateflow." UWORD _CNV_A_R_ECME_LINEA_0_CM 1 0. 0. 65535. ECU_ADDRESS 0xd00045f2 FORMAT "%5.0" /end MEASUREMENT
/begin MEASUREMENT Vxx_it_v_lim_down "Minimum value of the it command voltage." SWORD _CNV_A_R_LINEAR_____107_CM 1 0. -25000. 0. ECU_ADDRESS 0xd00045f4 FORMAT "%6.0" /end MEASUREMENT
/begin MEASUREMENT Vxx_it_v_lim_up "Maximum value of the it command voltage." UWORD _CNV_A_R_LINEAR_____107_CM 1 0. 0. 25000. ECU_ADDRESS 0xd00045f6 FORMAT "%5.0" /end MEASUREMENT
/begin MEASUREMENT Vxx_mv_it_rel_psn "Filtered relative throttle position in percent of the sensor supply voltage." UWORD _CNV_A_R_LINEAR_____150_CM 1 0. 0. 100. ECU_ADDRESS 0xd00045f8 FORMAT "%6.2" /end MEASUREMENT
/begin CHARACTERISTIC Cbx_it_ad_req "Forces complete learning cycle." VALUE 0xa0021916 _REC_S1VAL_20_u1 1. _CNV_A_R_ECME_LINEA_0_CM 0. 1. FORMAT "%1.0" BIT_MASK 0x1 /end CHARACTERISTIC
/begin CHARACTERISTIC Cbx_it_ad_sat_v_lim "Enables to saturate the command immediately during a learning request" VALUE 0xa0021917 _REC_S1VAL_20_u1 1. _CNV_A_R_ECME_LINEA_0_CM 0. 1. FORMAT "%1.0" BIT_MASK 0x1 /end CHARACTERISTIC
/begin CHARACTERISTIC Cbx_it_bch_mod_ena "Triggers the bench mode" VALUE 0xa0021918 _REC_S1VAL_20_u1 1. _CNV_A_R_ECME_LINEA_0_CM 0. 1. FORMAT "%1.0" BIT_MASK 0x1 /end CHARACTERISTIC
/begin CHARACTERISTIC Cbx_it_igk_on_ad_ena "Enables relearning during key on." VALUE 0xa0021919 _REC_S1VAL_20_u1 1. _CNV_A_R_ECME_LINEA_0_CM 0. 1. FORMAT "%1.0" BIT_MASK 0x1 /end CHARACTERISTIC
/begin CHARACTERISTIC Cbx_it_mon_1_sens_ad "Enables adaptative cycle while only one sensor is OK." VALUE 0xa002191a _REC_S1VAL_20_u1 1. _CNV_A_R_ECME_LINEA_0_CM 0. 1. FORMAT "%1.0" BIT_MASK 0x1 /end CHARACTERISTIC
/begin CHARACTERISTIC Cbx_it_sens_vld_2_fail_cho "Global validity configuration on sensor Ivld==2." VALUE 0xa002191b _REC_S1VAL_20_u1 1. _CNV_A_R_ECME_LINEA_0_CM 0. 1. FORMAT "%1.0" BIT_MASK 0x1 /end CHARACTERISTIC
/begin CHARACTERISTIC Cbx_it_sens_vld_3_fail_cho "Global validity configuration on sensor Ivld==3." VALUE 0xa002191c _REC_S1VAL_20_u1 1. _CNV_A_R_ECME_LINEA_0_CM 0. 1. FORMAT "%1.0" BIT_MASK 0x1 /end CHARACTERISTIC
/begin CHARACTERISTIC Cxx_it_ad_rge_down "Range for the closed position approach, during learning or check." VALUE 0xa00218ea _REC_S1VAL_20_u2 100. _CNV_A_R_LINEAR_____150_CM 0. 100. FORMAT "%6.2" /end CHARACTERISTIC
/begin CHARACTERISTIC Cxx_it_ad_rge_up "Range for the open position approach, during learning or check." VALUE 0xa00218ec _REC_S1VAL_20_u2 100. _CNV_A_R_LINEAR_____150_CM 0. 100. FORMAT "%6.2" /end CHARACTERISTIC
/begin CHARACTERISTIC Cxx_it_ad_v_lim_down "Voltage lower saturation during learning or check cycle after first servo controller saturation.." VALUE 0xa00218ee _REC_S1VAL_20_s2 25000. _CNV_A_R_LINEAR_____107_CM -25000. 0. FORMAT "%6.0" /end CHARACTERISTIC
/begin CHARACTERISTIC Cxx_it_ad_v_lim_up "Voltage upper saturation during learning or check cycle after first servo controller saturation.." VALUE 0xa00218f0 _REC_S1VAL_20_u2 25000. _CNV_A_R_LINEAR_____107_CM 0. 25000. FORMAT "%5.0" /end CHARACTERISTIC
/begin CHARACTERISTIC Cxx_it_clos_psn_ini "Closed position of the inlet throttle, default value." VALUE 0xa00218f2 _REC_S1VAL_20_u2 100. _CNV_A_R_LINEAR_____150_CM 0. 100. FORMAT "%6.2" /end CHARACTERISTIC
/begin CHARACTERISTIC Cxx_it_frst_ad_t "First learning cycle duration." VALUE 0xa00218f4 _REC_S1VAL_20_u2 65.535 _CNV_A_R_LINEAR_____116_CM 0. 65.535 FORMAT "%5.3" /end CHARACTERISTIC
/begin CHARACTERISTIC Cxx_it_learn_max_temp "Maximum temperature to allow learning." VALUE 0xa00218f6 _REC_S1VAL_20_u2 240. _CNV_A_R_LINEAR_____110_CM -40. 200. FORMAT "%5.1" /end CHARACTERISTIC
/begin CHARACTERISTIC Cxx_it_learn_min_temp "Minimum temperature to allow learning." VALUE 0xa00218f8 _REC_S1VAL_20_u2 240. _CNV_A_R_LINEAR_____110_CM -40. 200. FORMAT "%5.1" /end CHARACTERISTIC
/begin CHARACTERISTIC Cxx_it_lih_psn_ini "Limp home position of the inlet throttle, default value." VALUE 0xa00218fa _REC_S1VAL_20_u2 100. _CNV_A_R_LINEAR_____150_CM 0. 100. FORMAT "%6.2" /end CHARACTERISTIC
/begin CHARACTERISTIC Cxx_it_ofs_ctr_max_1 "Number of samples for the mean value calculation, sensor 1." VALUE 0xa00218fc _REC_S1VAL_20_u2 511. _CNV_A_R_ECME_LINEA_0_CM 1. 512. FORMAT "%3.0" /end CHARACTERISTIC
/begin CHARACTERISTIC Cxx_it_ofs_ctr_max_2 "Number of samples for the mean value calculation, sensor 2." VALUE 0xa00218fe _REC_S1VAL_20_u2 511. _CNV_A_R_ECME_LINEA_0_CM 1. 512. FORMAT "%3.0" /end CHARACTERISTIC
/begin CHARACTERISTIC Cxx_it_open_psn_ini "Open position of the inlet throttle, default value." VALUE 0xa0021900 _REC_S1VAL_20_u2 100. _CNV_A_R_LINEAR_____150_CM 0. 100. FORMAT "%6.2" /end CHARACTERISTIC
/begin CHARACTERISTIC Cxx_it_psn_ftc "Throttle position filtering factor" VALUE 0xa0021902 _REC_S1VAL_20_u2 65.535 _CNV_A_R_LINEAR_____116_CM 0. 65.535 FORMAT "%5.3" /end CHARACTERISTIC
/begin CHARACTERISTIC Cxx_it_pwl_ad_t "Power latch check cycle duration." VALUE 0xa0021904 _REC_S1VAL_20_u2 65.535 _CNV_A_R_LINEAR_____116_CM 0. 65.535 FORMAT "%5.3" /end CHARACTERISTIC
/begin CHARACTERISTIC Cxx_it_rge_down "Range for the closed position approach, during regulation." VALUE 0xa0021906 _REC_S1VAL_20_u2 100. _CNV_A_R_LINEAR_____150_CM 0. 100. FORMAT "%6.2" /end CHARACTERISTIC
/begin CHARACTERISTIC Cxx_it_rge_up "Range for the open position approach, during regulation." VALUE 0xa0021908 _REC_S1VAL_20_u2 100. _CNV_A_R_LINEAR_____150_CM 0. 100. FORMAT "%6.2" /end CHARACTERISTIC
/begin CHARACTERISTIC Cxx_it_stt_frst_ctr "Waiting time (number of samples) before first learning." VALUE 0xa002190a _REC_S1VAL_20_u2 65535. _CNV_A_R_ECME_LINEA_0_CM 0. 65535. FORMAT "%5.0" /end CHARACTERISTIC
/begin CHARACTERISTIC Cxx_it_stt_pwl_check_ctr "Waiting time (number of samples) before power latch check." VALUE 0xa002190c _REC_S1VAL_20_u2 65535. _CNV_A_R_ECME_LINEA_0_CM 0. 65535. FORMAT "%5.0" /end CHARACTERISTIC
/begin CHARACTERISTIC Cxx_it_stt_pwl_end_ctr "Waiting time (number of steps) after the end of the pwl cycle before shutdown." VALUE 0xa002190e _REC_S1VAL_20_u2 65535. _CNV_A_R_ECME_LINEA_0_CM 0. 65535. FORMAT "%5.0" /end CHARACTERISTIC
/begin CHARACTERISTIC Cxx_it_stt_pwl_learn_ctr "Waiting time (number of samples) before power latch relearning." VALUE 0xa0021910 _REC_S1VAL_20_u2 65535. _CNV_A_R_ECME_LINEA_0_CM 0. 65535. FORMAT "%5.0" /end CHARACTERISTIC
/begin CHARACTERISTIC Cxx_it_v_lim_down "Minimum value of the it command voltage during regulation." VALUE 0xa0021912 _REC_S1VAL_20_s2 25000. _CNV_A_R_LINEAR_____107_CM -25000. 0. FORMAT "%6.0" /end CHARACTERISTIC
/begin CHARACTERISTIC Cxx_it_v_lim_up "Maximum value of the it command voltage during regulation." VALUE 0xa0021914 _REC_S1VAL_20_u2 25000. _CNV_A_R_LINEAR_____107_CM 0. 25000. FORMAT "%5.0" /end CHARACTERISTIC
/begin MEASUREMENT Vbx_it_psn_sp_slop_ena "Boolean to start the slope generation for the position setpoint, during thrust approach" UBYTE _CNV_S_2_RANGE______3_CM 1 0. 0. 1. ECU_ADDRESS 0xd0006e7b BIT_MASK 0x1 /end MEASUREMENT
/begin MEASUREMENT Vbx_it_v_lim_down "Indicates that the maximum negative command voltage was reached." UBYTE _CNV_S_2_RANGE______3_CM 1 0. 0. 1. ECU_ADDRESS 0xd0006e7c BIT_MASK 0x1 /end MEASUREMENT
/begin MEASUREMENT Vbx_it_v_lim_up "Indicates that the maximum positive command voltage was reached." UBYTE _CNV_S_2_RANGE______3_CM 1 0. 0. 1. ECU_ADDRESS 0xd0006e7d BIT_MASK 0x1 /end MEASUREMENT
/begin MEASUREMENT Vxx_it_cmd_val "Output of the S controller." SLONG _CNV_A_R_LINEAR_____236_CM 1 0. -25. 24.9999990234375 ECU_ADDRESS 0xd0002914 FORMAT "%16.12" /end MEASUREMENT
/begin MEASUREMENT Vxx_it_cmd_val_1 "Output of the S1 component of the S controller." SLONG _CNV_A_R_LINEAR_____236_CM 1 0. -25. 24.9999990234375 ECU_ADDRESS 0xd0002918 FORMAT "%16.12" /end MEASUREMENT
/begin MEASUREMENT Vxx_it_cmd_val_2 "Output of the S2 component of the S controller." SLONG _CNV_A_R_LINEAR_____236_CM 1 0. -25. 24.9999990234375 ECU_ADDRESS 0xd000291c FORMAT "%16.12" /end MEASUREMENT
/begin MEASUREMENT Vxx_it_cmd_val_3 "Output of the S3 component of the S controller." SLONG _CNV_A_R_LINEAR_____236_CM 1 0. -25. 24.9999990234375 ECU_ADDRESS 0xd0002920 FORMAT "%16.12" /end MEASUREMENT
/begin MEASUREMENT Vxx_it_cmd_val_lim "Voltage setpoint given by the RST Controller." SWORD _CNV_A_R_LINEAR_____161_CM 1 0. -25. 25. ECU_ADDRESS 0xd0004610 FORMAT "%7.3" /end MEASUREMENT
/begin MEASUREMENT Vxx_it_cmd_val_lim_1 "Voltage setpoint given by the RST Controller in mV." SWORD _CNV_A_R_LINEAR_____107_CM 1 0. -25000. 25000. ECU_ADDRESS 0xd0004612 FORMAT "%6.0" /end MEASUREMENT
/begin MEASUREMENT Vxx_it_ctl_err "Difference between the outputs of the T and R controller. Similar to a position error." SLONG _CNV_A_R_LINEAR_____237_CM 1 0. -8192. 8191.875 ECU_ADDRESS 0xd0002924 FORMAT "%13.7" /end MEASUREMENT
/begin MEASUREMENT Vxx_it_ctl_err_lim "Saturated value of Vxx_it_ctl_err. Input of the S controller." SWORD _CNV_A_R_LINEAR_____161_CM 1 0. -25. 25. ECU_ADDRESS 0xd0004614 FORMAT "%7.3" /end MEASUREMENT
/begin MEASUREMENT Vxx_it_frn_cps_v "Friction Compensation Voltage added to Vxx_it_cmd_val_lim." SWORD _CNV_A_R_LINEAR_____107_CM 1 0. -25000. 25000. ECU_ADDRESS 0xd0004616 FORMAT "%6.0" /end MEASUREMENT
/begin MEASUREMENT Vxx_it_lim_down_thd "Position threshold to activate the approach strategy near the closed thrust." UWORD _CNV_A_R_LINEAR_____150_CM 1 0. 0. 100. ECU_ADDRESS 0xd0004618 FORMAT "%6.2" /end MEASUREMENT
/begin MEASUREMENT Vxx_it_lim_up_thd "Position threshold to activate the approach strategy near the open thrust." UWORD _CNV_A_R_LINEAR_____150_CM 1 0. 0. 100. ECU_ADDRESS 0xd000461a FORMAT "%6.2" /end MEASUREMENT
/begin MEASUREMENT Vxx_it_psn_ctl "Output of the Controller R." SLONG _CNV_A_R_LINEAR_____237_CM 1 0. -8192. 8191.875 ECU_ADDRESS 0xd0002928 FORMAT "%13.7" /end MEASUREMENT
/begin MEASUREMENT Vxx_it_psn_ctl_0 "Ouput of the coefficient R0 of the RST Controller." ULONG _CNV_A_R_LINEAR_____237_CM 1 0. 0. 8191.875 ECU_ADDRESS 0xd000292c FORMAT "%12.7" /end MEASUREMENT
/begin MEASUREMENT Vxx_it_psn_ctl_1 "Ouput of the coefficient R1 of the RST Controller." ULONG _CNV_A_R_LINEAR_____237_CM 1 0. 0. 8191.875 ECU_ADDRESS 0xd0002930 FORMAT "%12.7" /end MEASUREMENT
/begin MEASUREMENT Vxx_it_psn_ctl_2 "Ouput of the coefficient R2 of the RST Controller." ULONG _CNV_A_R_LINEAR_____237_CM 1 0. 0. 8191.875 ECU_ADDRESS 0xd0002934 FORMAT "%12.7" /end MEASUREMENT
/begin MEASUREMENT Vxx_it_psn_ctl_3 "Ouput of the coefficient R3 of the RST Controller." ULONG _CNV_A_R_LINEAR_____237_CM 1 0. 0. 8191.875 ECU_ADDRESS 0xd0002938 FORMAT "%12.7" /end MEASUREMENT
/begin MEASUREMENT Vxx_it_psn_reg_1 "IT position used by the controller." UWORD _CNV_A_R_LINEAR_____150_CM 1 0. 0. 100. ECU_ADDRESS 0xd000461c FORMAT "%6.2" /end MEASUREMENT
/begin MEASUREMENT Vxx_it_psn_reg_3 "Output of the dead zone filter." UWORD _CNV_A_R_LINEAR_____150_CM 1 0. 0. 100. ECU_ADDRESS 0xd000461e FORMAT "%6.2" /end MEASUREMENT
/begin MEASUREMENT Vxx_it_psn_sp_cor_1 "Input of the position setpoint slope. Used during the thrust approach." UWORD _CNV_A_R_LINEAR_____150_CM 1 0. 0. 100. ECU_ADDRESS 0xd0004620 FORMAT "%6.2" /end MEASUREMENT
/begin MEASUREMENT Vxx_it_psn_sp_ctl "Output of the T controller." SLONG _CNV_A_R_LINEAR_____237_CM 1 0. -8192. 8191.875 ECU_ADDRESS 0xd000293c FORMAT "%13.7" /end MEASUREMENT
/begin MEASUREMENT Vxx_it_psn_sp_ctl_0 "Output of the first component of the T controller." ULONG _CNV_A_R_LINEAR_____237_CM 1 0. 0. 8191.875 ECU_ADDRESS 0xd0002940 FORMAT "%12.7" /end MEASUREMENT
/begin MEASUREMENT Vxx_it_psn_sp_ctl_1 "Output of the second component of the T controller." ULONG _CNV_A_R_LINEAR_____237_CM 1 0. 0. 8191.875 ECU_ADDRESS 0xd0002944 FORMAT "%12.7" /end MEASUREMENT
/begin MEASUREMENT Vxx_it_psn_sp_ctl_2 "Output of the third component of the T controller." ULONG _CNV_A_R_LINEAR_____237_CM 1 0. 0. 8191.875 ECU_ADDRESS 0xd0002948 FORMAT "%12.7" /end MEASUREMENT
/begin MEASUREMENT Vxx_it_psn_sp_mod "Used to indicate if the position setpoint has to be modified by the thrust approach strategy." UBYTE _CNV_A_R_ECME_LINEA_0_CM 1 0. 0. 16. ECU_ADDRESS 0xd0006e7e FORMAT "%3.0" /end MEASUREMENT
/begin MEASUREMENT Vxx_it_psn_sp_reg "Absolute position setpoint really given to the RST controller." UWORD _CNV_A_R_LINEAR_____150_CM 1 0. 0. 100. ECU_ADDRESS 0xd0004622 FORMAT "%6.2" /end MEASUREMENT
/begin MEASUREMENT Vxx_it_psn_sp_slop "Position setpoint given by a slope system, when position and setpoint are near a thrust." UWORD _CNV_A_R_LINEAR_____150_CM 1 0. 0. 100. ECU_ADDRESS 0xd0004624 FORMAT "%6.2" /end MEASUREMENT
/begin MEASUREMENT Vxx_it_v_sp "Voltage setpoint given by the RST regulator and sent to the component." SWORD _CNV_A_R_LINEAR_____107_CM 1 0. -25000. 25000. ECU_ADDRESS 0xd0004626 FORMAT "%6.0" /end MEASUREMENT
/begin MEASUREMENT Vxx_it_v_sp_cor_lim "Voltage setpoint given to the H bridge." SWORD _CNV_A_R_LINEAR_____107_CM 1 0. -25000. 25000. ECU_ADDRESS 0xd0004628 FORMAT "%6.0" /end MEASUREMENT
/begin CHARACTERISTIC Cbx_it_psn_ctl_sgn "Allow to invert the sign of Vxx_it_psn_ctl." VALUE 0xa0021946 _REC_S1VAL_20_u1 1. _CNV_A_R_ECME_LINEA_0_CM 0. 1. FORMAT "%1.0" BIT_MASK 0x1 /end CHARACTERISTIC
/begin CHARACTERISTIC Cbx_it_psn_fil_cho_1 "Choice between the filtered position and the raw position. If 1, filtered." VALUE 0xa0021947 _REC_S1VAL_20_u1 1. _CNV_A_R_ECME_LINEA_0_CM 0. 1. FORMAT "%1.0" BIT_MASK 0x1 /end CHARACTERISTIC
/begin CHARACTERISTIC Cbx_it_psn_sp_ctl_sgn "Allow to invert the sign of  Vxx_it_psn_sp_ctl." VALUE 0xa0021948 _REC_S1VAL_20_u1 1. _CNV_A_R_ECME_LINEA_0_CM 0. 1. FORMAT "%1.0" BIT_MASK 0x1 /end CHARACTERISTIC
/begin CHARACTERISTIC Cxx_it_cmd_val_1 "Parameter corresponding to the S1 coefficient of the RST Controller." VALUE 0xa002191e _REC_S1VAL_20_s2 1.999969482421875 _CNV_A_R_LINEAR_____225_CM -1. 0.999969482421875 FORMAT "%9.6" /end CHARACTERISTIC
/begin CHARACTERISTIC Cxx_it_cmd_val_2 "Parameter corresponding to the S2 coefficient of the RST Controller." VALUE 0xa0021920 _REC_S1VAL_20_s2 1.999969482421875 _CNV_A_R_LINEAR_____225_CM -1. 0.999969482421875 FORMAT "%9.6" /end CHARACTERISTIC
/begin CHARACTERISTIC Cxx_it_cmd_val_3 "Parameter corresponding to the S3 coefficient of the RST Controller." VALUE 0xa0021922 _REC_S1VAL_20_s2 1.999969482421875 _CNV_A_R_LINEAR_____225_CM -1. 0.999969482421875 FORMAT "%9.6" /end CHARACTERISTIC
/begin CHARACTERISTIC Cxx_it_cps_v "Constant Compensation Voltage (if needed)." VALUE 0xa0021924 _REC_S1VAL_20_s2 50000. _CNV_A_R_LINEAR_____107_CM -25000. 25000. FORMAT "%6.0" /end CHARACTERISTIC
/begin CHARACTERISTIC Cxx_it_ctl_lim "Limitation used in the RST controller to take into account the max. battery voltage." VALUE 0xa0021926 _REC_S1VAL_20_s2 50. _CNV_A_R_LINEAR_____161_CM -25. 25. FORMAT "%7.3" /end CHARACTERISTIC
/begin CHARACTERISTIC Cxx_it_ctl_psn_sp_stab_thd "Range of setpoint variation under which the setpoint can be considered as stable." VALUE 0xa0021928 _REC_S1VAL_20_u2 100. _CNV_A_R_LINEAR_____150_CM 0. 100. FORMAT "%6.2" /end CHARACTERISTIC
/begin CHARACTERISTIC Cxx_it_ctl_psn_stab_thd "Threshold value to consider the stability of position in the dead zone filter." VALUE 0xa002192a _REC_S1VAL_20_u2 100. _CNV_A_R_LINEAR_____150_CM 0. 100. FORMAT "%6.2" /end CHARACTERISTIC
/begin CHARACTERISTIC Cxx_it_ctl_psn_thd "Second position threshold to keep the dead zone filter active." VALUE 0xa002192c _REC_S1VAL_20_u2 100. _CNV_A_R_LINEAR_____150_CM 0. 100. FORMAT "%6.2" /end CHARACTERISTIC
/begin CHARACTERISTIC Cxx_it_ctl_stab_dly "Time period of the first position stability control before activating the Dead Zone Filter." VALUE 0xa002192e _REC_S1VAL_20_u2 65.535 _CNV_A_R_LINEAR_____116_CM 0. 65.535 FORMAT "%5.3" /end CHARACTERISTIC
/begin CHARACTERISTIC Cxx_it_frn_cps_v "Absolute value of the Friction Compensation Voltage." VALUE 0xa0021930 _REC_S1VAL_20_s2 50000. _CNV_A_R_LINEAR_____107_CM -25000. 25000. FORMAT "%6.0" /end CHARACTERISTIC
/begin CHARACTERISTIC Cxx_it_psn_ctl_0 "Coefficient R0 of the RST Controller." VALUE 0xa0021932 _REC_S1VAL_20_u2 81.91875 _CNV_A_R_LINEAR_____238_CM 0. 81.91875 FORMAT "%8.5" /end CHARACTERISTIC
/begin CHARACTERISTIC Cxx_it_psn_ctl_1 "Coefficient R1 of the RST Controller." VALUE 0xa0021934 _REC_S1VAL_20_u2 81.91875 _CNV_A_R_LINEAR_____238_CM 0. 81.91875 FORMAT "%8.5" /end CHARACTERISTIC
/begin CHARACTERISTIC Cxx_it_psn_ctl_2 "Coefficient R2 of the RST Controller." VALUE 0xa0021936 _REC_S1VAL_20_u2 81.91875 _CNV_A_R_LINEAR_____238_CM 0. 81.91875 FORMAT "%8.5" /end CHARACTERISTIC
/begin CHARACTERISTIC Cxx_it_psn_ctl_3 "Coefficient R3 of the RST Controller." VALUE 0xa0021938 _REC_S1VAL_20_u2 81.91875 _CNV_A_R_LINEAR_____238_CM 0. 81.91875 FORMAT "%8.5" /end CHARACTERISTIC
/begin CHARACTERISTIC Cxx_it_psn_frn_cps_thd "Interval between the setpoint and the position where the friction compensation is disabled." VALUE 0xa002193a _REC_S1VAL_20_u2 100. _CNV_A_R_LINEAR_____150_CM 0. 100. FORMAT "%6.2" /end CHARACTERISTIC
/begin CHARACTERISTIC Cxx_it_psn_slop_lim_down "Slope corresponding to the maximum negative approach speed of the closed thrust." VALUE 0xa002193c _REC_S1VAL_20_u2 100. _CNV_A_R_LINEAR_____239_CM -100. 0. FORMAT "%6.2" /end CHARACTERISTIC
/begin CHARACTERISTIC Cxx_it_psn_slop_lim_up "Slope corresponding to the maximum approach speed of the open thrust." VALUE 0xa002193e _REC_S1VAL_20_u2 100. _CNV_A_R_LINEAR_____150_CM 0. 100. FORMAT "%6.2" /end CHARACTERISTIC
/begin CHARACTERISTIC Cxx_it_psn_sp_ctl_0 "Coefficient T0 of the RST Controller." VALUE 0xa0021940 _REC_S1VAL_20_u2 81.91875 _CNV_A_R_LINEAR_____238_CM 0. 81.91875 FORMAT "%8.5" /end CHARACTERISTIC
/begin CHARACTERISTIC Cxx_it_psn_sp_ctl_1 "Coefficient T1 of the RST Controller." VALUE 0xa0021942 _REC_S1VAL_20_u2 81.91875 _CNV_A_R_LINEAR_____238_CM 0. 81.91875 FORMAT "%8.5" /end CHARACTERISTIC
/begin CHARACTERISTIC Cxx_it_psn_sp_ctl_2 "Coefficient T2 of the RST Controller." VALUE 0xa0021944 _REC_S1VAL_20_u2 81.91875 _CNV_A_R_LINEAR_____238_CM 0. 81.91875 FORMAT "%8.5" /end CHARACTERISTIC
/begin MEASUREMENT Vsx_wgc_vld "Wastegate validity status" UBYTE _CNV_S_3_STATUS_OK__179_CM 1 0. 0. 2. ECU_ADDRESS 0xd0006e7f /end MEASUREMENT
/begin CHARACTERISTIC Cxx_dfdec_wgc_oc "Open circuit of wastegate detected failure counter decrement" VALUE 0xa002194a _REC_S1VAL_20_u2 65535. _CNV_A_R_ECME_LINEA_0_CM 0. 65535. FORMAT "%5.0" /end CHARACTERISTIC
/begin CHARACTERISTIC Cxx_dfdec_wgc_scg "Short circuit to ground of wastegate detected failure counter decrement" VALUE 0xa002194c _REC_S1VAL_20_u2 65535. _CNV_A_R_ECME_LINEA_0_CM 0. 65535. FORMAT "%5.0" /end CHARACTERISTIC
/begin CHARACTERISTIC Cxx_dfdec_wgc_scw "Short circuit to battery of wastegate detected failure counter decrement" VALUE 0xa002194e _REC_S1VAL_20_u2 65535. _CNV_A_R_ECME_LINEA_0_CM 0. 65535. FORMAT "%5.0" /end CHARACTERISTIC
/begin CHARACTERISTIC Cxx_dfinc_wgc_oc "Short circuit of wastegate detected failure counter increment" VALUE 0xa0021950 _REC_S1VAL_20_u2 65535. _CNV_A_R_ECME_LINEA_0_CM 0. 65535. FORMAT "%5.0" /end CHARACTERISTIC
/begin CHARACTERISTIC Cxx_dfinc_wgc_scg "Short circuit to ground of wastegate detected failure counter increment" VALUE 0xa0021952 _REC_S1VAL_20_u2 65535. _CNV_A_R_ECME_LINEA_0_CM 0. 65535. FORMAT "%5.0" /end CHARACTERISTIC
/begin CHARACTERISTIC Cxx_dfinc_wgc_scw "Short circuit to battery of wastegate detected failure counter increment" VALUE 0xa0021954 _REC_S1VAL_20_u2 65535. _CNV_A_R_ECME_LINEA_0_CM 0. 65535. FORMAT "%5.0" /end CHARACTERISTIC
/begin CHARACTERISTIC Cmp_n_prs_mat_ftc "Map of the filter time constant of the simulated valve gaz temperature." MAP 0xa002cb54 _REC_A1MAP_20_u1_u2_u2 25.5 _CNV_A_R_LINEAR_____58_CM 0. 25.5 FORMAT "%4.1"
 /begin AXIS_DESCR COM_AXIS Vxx_n _CNV_A_R_ENSD_LINEA_22_CM 9 0. 16383.75 FORMAT "%8.2" AXIS_PTS_REF Ctb_n2 /end AXIS_DESCR
 /begin AXIS_DESCR COM_AXIS Vxx_map _CNV_A_R_LINEAR_____115_CM 9 0. 20000. FORMAT "%5.0" AXIS_PTS_REF Ctb_prs2 /end AXIS_DESCR
/end CHARACTERISTIC
/begin CHARACTERISTIC Ctp_n_mat_fac "Coefficient table n°1 depending on engine speed" CURVE 0xa002cba8 _REC_A1CUR_20_u1_u2 0.99609375 _CNV_A_R_LINEAR_____29_CM 0. 0.99609375 FORMAT "%10.8"
 /begin AXIS_DESCR COM_AXIS Vxx_n _CNV_A_R_ENSD_LINEA_22_CM 20 0. 16383.75 FORMAT "%8.2" AXIS_PTS_REF Ctb_n /end AXIS_DESCR
/end CHARACTERISTIC
/begin CHARACTERISTIC Ctp_prs_mat_fac "Coefficient table n°2 depending on the pressure" CURVE 0xa002cbbc _REC_A1CUR_20_u1_u2 1.9921875 _CNV_A_R_LINEAR_____240_CM -1. 0.9921875 FORMAT "%9.6"
 /begin AXIS_DESCR COM_AXIS Vxx_map _CNV_A_R_LINEAR_____115_CM 17 0. 20000. FORMAT "%5.0" AXIS_PTS_REF Ctb_prs /end AXIS_DESCR
/end CHARACTERISTIC
/begin MEASUREMENT Vsx_vlv_air_temp_vld "Validity indicator of valve air temperature" UBYTE _CNV_S_3_STATUS_OK__179_CM 1 0. 0. 2. ECU_ADDRESS 0xd0007b32 /end MEASUREMENT
/begin MEASUREMENT Vxx_mat_fac "Coefficient between mat and tco to creat vlv_air_temp" UBYTE _CNV_A_R_LINEAR_____29_CM 1 0. 0. 0.99609375 ECU_ADDRESS 0xd0006b00 FORMAT "%5.3" /end MEASUREMENT
/begin MEASUREMENT Vxx_vlv_air_temp "Simulated valve gaz temperature" UWORD _CNV_A_R_LINEAR_____110_CM 1 0. -40. 200. ECU_ADDRESS 0xd000425a FORMAT "%5.1" /end MEASUREMENT
/begin MEASUREMENT Vxx_vlv_air_temp_ftc "Filter time constant of the simulated valve gaz temperature" UBYTE _CNV_A_R_LINEAR_____58_CM 1 0. 0. 25.5 ECU_ADDRESS 0xd0007b33 FORMAT "%4.1" /end MEASUREMENT
/begin CHARACTERISTIC Cxx_mat_fac "Coefficient n°3" VALUE 0xa00212df _REC_S1VAL_20_u1 0.99609375 _CNV_A_R_LINEAR_____29_CM 0. 0.99609375 FORMAT "%5.3" /end CHARACTERISTIC
/begin MEASUREMENT Vsx_mdl_mat_vld "Manifold air temperature model validity status" UBYTE _CNV_S_2_STATUS_OK__241_CM 1 0. 0. 1. ECU_ADDRESS 0xd0007b2d /end MEASUREMENT
/begin MEASUREMENT Vxx_mdl_mat "Manifold air temperature (model)" UWORD _CNV_A_R_LINEAR_____110_CM 1 0. -40. 200. ECU_ADDRESS 0xd0005ea4 FORMAT "%5.1" /end MEASUREMENT
/begin CHARACTERISTIC Cxx_mem_mat_fail_max_mat "Maximum MAT when the sensor failure is memorized" VALUE 0xa00212d8 _REC_S1VAL_20_u2 240. _CNV_A_R_LINEAR_____110_CM -40. 200. FORMAT "%5.1" /end CHARACTERISTIC
/begin AXIS_PTS Ctb_mat2 "Table of 9 programmable breakpoints of air temperature" 0xa002cb40 NO_INPUT_QUANTITY _REC_A2AXS_20_u2 240. _CNV_A_R_LINEAR_____110_CM 9 -40. 200. FORMAT "%5.1" /end AXIS_PTS
/begin MEASUREMENT Vsx_mat_vld "Manifold air temperature validity status" UBYTE _CNV_S_3_STATUS_OK__213_CM 1 0. 0. 2. ECU_ADDRESS 0xd0007b2b /end MEASUREMENT
/begin MEASUREMENT Vxx_mat "Manifold air temperature" UWORD _CNV_A_R_LINEAR_____110_CM 1 0. -40. 200. ECU_ADDRESS 0xd0005ea2 FORMAT "%5.1" /end MEASUREMENT
/begin MEASUREMENT Vxx_sqrt_mat "Square root of the manifold temperature" UBYTE _CNV_A_R_LINEAR_____242_CM 1 0. 15. 21.97265625 ECU_ADDRESS 0xd0007b2c FORMAT "%10.8" /end MEASUREMENT
/begin CHARACTERISTIC Cxx_mat_fail_val "Mainfold air temperature default value" VALUE 0xa00212d6 _REC_S1VAL_20_u2 240. _CNV_A_R_LINEAR_____110_CM -40. 200. FORMAT "%5.1" /end CHARACTERISTIC
/begin MEASUREMENT Vsx_sens_mat_vld "Manifold air temperature sensor validity status" UBYTE _CNV_S_3_STATUS_OK__213_CM 1 0. 0. 2. ECU_ADDRESS 0xd0007b2e /end MEASUREMENT
/begin MEASUREMENT Vxx_raw_sens_mat_fil "Filtered raw manifold air temperature sensor" UWORD _CNV_A_R_LINEAR_____110_CM 1 0. -40. 200. ECU_ADDRESS 0xd0004256 FORMAT "%6.1" /end MEASUREMENT
/begin MEASUREMENT Vxx_raw_sens_mat_rtn "Retained raw manifold air temperature sensor" UWORD _CNV_A_R_LINEAR_____110_CM 1 0. -40. 200. ECU_ADDRESS 0xd0004258 FORMAT "%6.1" /end MEASUREMENT
/begin MEASUREMENT Vxx_sens_mat "Manifold air temperature (sensor)" UWORD _CNV_A_R_LINEAR_____110_CM 1 0. -40. 200. ECU_ADDRESS 0xd0005ea6 FORMAT "%5.1" /end MEASUREMENT
/begin CHARACTERISTIC Cbx_sens_mat_fil_cfm "Calibration for activate the filtering of manifold air temperature" VALUE 0xa00212de _REC_S1VAL_20_u1 1. _CNV_A_R_ECME_LINEA_0_CM 0. 1. FORMAT "%3.0" BIT_MASK 0x1 /end CHARACTERISTIC
/begin CHARACTERISTIC Cxx_dfdec_sens_mat "Manifold air temperature sensor detected failure counter decrement" VALUE 0xa00212da _REC_S1VAL_20_u2 65535. _CNV_A_R_ECME_LINEA_0_CM 0. 65535. FORMAT "%5.0" /end CHARACTERISTIC
/begin CHARACTERISTIC Cxx_dfinc_sens_mat "Manifold air temperature sensor detected failure counter increment" VALUE 0xa00212dc _REC_S1VAL_20_u2 65535. _CNV_A_R_ECME_LINEA_0_CM 0. 65535. FORMAT "%5.0" /end CHARACTERISTIC
/begin MEASUREMENT Vsx_up_it_temp_vld "Upstream throttle temperature validity status" UBYTE _CNV_S_3_STATUS_OK__179_CM 1 0. 0. 2. ECU_ADDRESS 0xd0007b30 /end MEASUREMENT
/begin MEASUREMENT Vxx_sqrt_up_it_temp "Square root of the inlet throttle upstream temperature in K^1/2" UBYTE _CNV_A_R_LINEAR_____242_CM 1 0. 15. 21.97265625 ECU_ADDRESS 0xd0007b31 FORMAT "%10.8" /end MEASUREMENT
/begin MEASUREMENT Vxx_up_it_temp "Intake throttle upstream air temperature" UWORD _CNV_A_R_LINEAR_____110_CM 1 0. -40. 200. ECU_ADDRESS 0xd0005eaa FORMAT "%5.1" /end MEASUREMENT
/begin CHARACTERISTIC Ctp_n_mat_fac_alco "Coefficient table n°1 depending on engine speed in alcool" CURVE 0xa002cb18 _REC_A1CUR_20_u1_u2 0.99609375 _CNV_A_R_LINEAR_____29_CM 0. 0.99609375 FORMAT "%10.8"
 /begin AXIS_DESCR COM_AXIS Vxx_n _CNV_A_R_ENSD_LINEA_22_CM 20 0. 16383.75 FORMAT "%8.2" AXIS_PTS_REF Ctb_n /end AXIS_DESCR
/end CHARACTERISTIC
/begin CHARACTERISTIC Ctp_prs_mat_fac_alco "Coefficient table n°2 depending on the pressure in alcool" CURVE 0xa002cb2c _REC_A1CUR_20_u1_u2 1.9921875 _CNV_A_R_LINEAR_____240_CM -1. 0.9921875 FORMAT "%9.6"
 /begin AXIS_DESCR COM_AXIS Vxx_map _CNV_A_R_LINEAR_____115_CM 17 0. 20000. FORMAT "%5.0" AXIS_PTS_REF Ctb_prs /end AXIS_DESCR
/end CHARACTERISTIC
/begin MEASUREMENT Vxx_mat_fac_alco "Coefficient between mat and tco to create vlv_air_temp in alcool" UBYTE _CNV_A_R_LINEAR_____29_CM 1 0. 0. 0.99609375 ECU_ADDRESS 0xd0007b2a FORMAT "%10.8" /end MEASUREMENT
/begin CHARACTERISTIC Cxx_mat_fac_alco "Coefficient n°3" VALUE 0xa00212d4 _REC_S1VAL_20_u1 0.99609375 _CNV_A_R_LINEAR_____29_CM 0. 0.99609375 FORMAT "%10.8" /end CHARACTERISTIC
/begin MEASUREMENT Vsx_tenv_vld "External temperature validity status" UBYTE _CNV_S_3_STATUS_OK__179_CM 1 0. 0. 2. ECU_ADDRESS 0xd0007b2f /end MEASUREMENT
/begin MEASUREMENT Vxx_tenv "Environmental temperature" UWORD _CNV_A_R_LINEAR_____110_CM 1 0. -40. 200. ECU_ADDRESS 0xd0005ea8 FORMAT "%5.1" /end MEASUREMENT
/begin AXIS_PTS Ctb_sta_tco "Coolant temperature breakpoints for starting set point tables" 0xa002d498 Vxx_tco _REC_A2AXS_20_u2 240. _CNV_A_R_LINEAR_____110_CM 8 -40. 200. FORMAT "%5.1" /end AXIS_PTS
/begin AXIS_PTS Ctb_tco "16 engine coolant temperature breakpoints" 0xa002d4ac Vxx_tco _REC_A2AXS_20_u2 240. _CNV_A_R_LINEAR_____110_CM 16 -40. 200. FORMAT "%5.1" /end AXIS_PTS
/begin AXIS_PTS Ctb_tco2 "Engine coolant temperature breakpoints" 0xa002d4d0 Vxx_tco _REC_A2AXS_20_u2 240. _CNV_A_R_LINEAR_____110_CM 9 -40. 200. FORMAT "%5.1" /end AXIS_PTS
/begin MEASUREMENT Vxb_sta_tco.factor "" UWORD _CNV_A_R_A_105_CM 1 0. 0. 65535. ECU_ADDRESS 0xd0007ba6 /end MEASUREMENT
/begin MEASUREMENT Vxb_sta_tco.index "" UBYTE _CNV_A_R_A_105_CM 1 0. 0. 255. ECU_ADDRESS 0xd0007ba8 /end MEASUREMENT
/begin MEASUREMENT Vxb_sta_tco.num_dp "" UBYTE _CNV_A_R_A_105_CM 1 0. 0. 255. ECU_ADDRESS 0xd0007ba9 /end MEASUREMENT
/begin MEASUREMENT Vxb_tco.factor "" UWORD _CNV_A_R_A_105_CM 1 0. 0. 65535. ECU_ADDRESS 0xd0007baa /end MEASUREMENT
/begin MEASUREMENT Vxb_tco.index "" UBYTE _CNV_A_R_A_105_CM 1 0. 0. 255. ECU_ADDRESS 0xd0007bac /end MEASUREMENT
/begin MEASUREMENT Vxb_tco.num_dp "" UBYTE _CNV_A_R_A_105_CM 1 0. 0. 255. ECU_ADDRESS 0xd0007bad /end MEASUREMENT
/begin MEASUREMENT Vxb_tco2.factor "" UWORD _CNV_A_R_A_105_CM 1 0. 0. 65535. ECU_ADDRESS 0xd0007bae /end MEASUREMENT
/begin MEASUREMENT Vxb_tco2.index "" UBYTE _CNV_A_R_A_105_CM 1 0. 0. 255. ECU_ADDRESS 0xd0007bb0 /end MEASUREMENT
/begin MEASUREMENT Vxb_tco2.num_dp "" UBYTE _CNV_A_R_A_105_CM 1 0. 0. 255. ECU_ADDRESS 0xd0007bb1 /end MEASUREMENT
/begin MEASUREMENT Vsx_sta_tco_vld "Engine coolant temperature during engine starting validity status" UBYTE _CNV_S_3_STATUS_OK__179_CM 1 0. 0. 2. ECU_ADDRESS 0xd0007bb2 /end MEASUREMENT
/begin MEASUREMENT Vsx_tco_vld "engine coolant temperature validity status" UBYTE _CNV_S_3_STATUS_OK__179_CM 1 0. 0. 2. ECU_ADDRESS 0xd0007bb3 /end MEASUREMENT
/begin MEASUREMENT Vxx_sta_tco "Starting coolant temperature" UWORD _CNV_A_R_LINEAR_____110_CM 1 0. -40. 200. ECU_ADDRESS 0xd0005ee8 FORMAT "%5.1" /end MEASUREMENT
/begin MEASUREMENT Vxx_tco "Engine coolant temperature" UWORD _CNV_A_R_LINEAR_____110_CM 1 0. -40. 200. ECU_ADDRESS 0xd0004308 FORMAT "%5.1" /end MEASUREMENT
/begin CHARACTERISTIC Cxx_tco_inc "Max gradient of tco" VALUE 0xa0021488 _REC_S1VAL_20_u2 30. _CNV_A_R_LINEAR_____243_CM 0. 30. FORMAT "%4.1" /end CHARACTERISTIC
/begin MEASUREMENT Vbx_df_sens_tco "engine cooling temperature sensor detected failure" UBYTE _CNV_S_2_RANGE______3_CM 1 0. 0. 1. ECU_ADDRESS 0xd0007bb6 BIT_MASK 0x1 /end MEASUREMENT
/begin MEASUREMENT Vsx_sens_tco_vld "engine coolant temperature sensor validity status" UBYTE _CNV_S_3_STATUS_OK__179_CM 1 0. 0. 2. ECU_ADDRESS 0xd0007bb7 /end MEASUREMENT
/begin MEASUREMENT Vxx_sens_tco "Engine coolant temperature (sensor)" UWORD _CNV_A_R_LINEAR_____110_CM 1 0. -40. 200. ECU_ADDRESS 0xd0005eea FORMAT "%5.1" /end MEASUREMENT
/begin MEASUREMENT Vxx_sens_tco_frz "Frozen engine coolant temperature in case of detected failure (sensor)" UWORD _CNV_A_R_LINEAR_____110_CM 1 0. -40. 200. ECU_ADDRESS 0xd0005eec FORMAT "%5.1" /end MEASUREMENT
/begin CHARACTERISTIC Cxx_dfdec_sens_tco "engine cooling temperature sensor detected failure counter decrement" VALUE 0xa0021492 _REC_S1VAL_20_u2 65535. _CNV_A_R_ECME_LINEA_0_CM 0. 65535. FORMAT "%5.0" /end CHARACTERISTIC
/begin CHARACTERISTIC Cxx_dfinc_sens_tco "engine cooling temperature sensor detected failure counter increment" VALUE 0xa0021494 _REC_S1VAL_20_u2 65535. _CNV_A_R_ECME_LINEA_0_CM 0. 65535. FORMAT "%5.0" /end CHARACTERISTIC
/begin CHARACTERISTIC Cxx_raw_sens_tco_ini "Raw engine coolant temperature on init" VALUE 0xa0021496 _REC_S1VAL_20_u2 240. _CNV_A_R_LINEAR_____110_CM -40. 200. FORMAT "%5.1" /end CHARACTERISTIC
/begin MEASUREMENT Vbx_tco_mdl_cnt "Top Dead Center counter" UBYTE _CNV_S_2_RANGE______3_CM 1 0. 0. 1. ECU_ADDRESS 0xd0006b86 BIT_MASK 0x1 /end MEASUREMENT
/begin MEASUREMENT Vsx_mdl_tco "State of Tco model" UBYTE _CNV_S_5_STATUS_TCO_244_CM 1 0. 0. 30. ECU_ADDRESS 0xd0006b87 /end MEASUREMENT
/begin MEASUREMENT Vsx_mdl_tco_vld "Engine coolant temperature model validity status" UBYTE _CNV_S_3_STATUS_OK__179_CM 1 0. 0. 2. ECU_ADDRESS 0xd0006b88 /end MEASUREMENT
/begin MEASUREMENT Vsx_mdl_tco_vld_2 "Engine coolant temperature model validity status 2" UBYTE _CNV_S_3_STATUS_OK__179_CM 1 0. 0. 2. ECU_ADDRESS 0xd0006b89 /end MEASUREMENT
/begin MEASUREMENT Vxx_mdl_tco "Engine coolant temperature (model)" UWORD _CNV_A_R_LINEAR_____110_CM 1 0. -40. 200. ECU_ADDRESS 0xd000430a FORMAT "%5.1" /end MEASUREMENT
/begin CHARACTERISTIC Cxx_mdl_tco_inc "Engine coolant temperature model increment" VALUE 0xa002148a _REC_S1VAL_20_u2 240. _CNV_A_R_LINEAR_____110_CM -40. 200. FORMAT "%5.1" /end CHARACTERISTIC
/begin CHARACTERISTIC Cxx_mdl_tco_max "Max engine coolant temperature model" VALUE 0xa002148c _REC_S1VAL_20_u2 240. _CNV_A_R_LINEAR_____110_CM -40. 200. FORMAT "%5.1" /end CHARACTERISTIC
/begin CHARACTERISTIC Cxx_tdc_mdl_fail_tdc_cnt "Top Dead Center counter when Vsx_mdl_tco_vld == Nok." VALUE 0xa002148e _REC_S1VAL_20_u2 65535. _CNV_A_R_LINEAR_____101_CM 0. 65535. FORMAT "%5.0" /end CHARACTERISTIC
/begin CHARACTERISTIC Cxx_tdc_mdl_tdc_cnt "Top Dead Center counter." VALUE 0xa0021490 _REC_S1VAL_20_u2 65535. _CNV_A_R_LINEAR_____101_CM 0. 65535. FORMAT "%5.0" /end CHARACTERISTIC
/begin MEASUREMENT Vbx_df_sens_tco_sig_mcut "Engine cooling temperature sensor signal momentarily implausible or discontinuous detected failure" UBYTE _CNV_S_2_RANGE______3_CM 1 0. 0. 1. ECU_ADDRESS 0xd0007b84 BIT_MASK 0x1 /end MEASUREMENT
/begin CHARACTERISTIC Cxx_dfdec_sens_tco_sig_mcut "Engine cooling temperature sensor momentarily implausible or discontinuous diagnostic detected failure counter decrement" VALUE 0xa002142e _REC_S1VAL_20_u2 65535. _CNV_A_R_ECME_LINEA_0_CM 0. 65535. FORMAT "%5.0" /end CHARACTERISTIC
/begin CHARACTERISTIC Cxx_dfinc_sens_tco_sig_mcut "Engine cooling temperature sensor momentarily implausible or discontinuous diagnostic detected failure counter increment" VALUE 0xa0021430 _REC_S1VAL_20_u2 65535. _CNV_A_R_ECME_LINEA_0_CM 0. 65535. FORMAT "%5.0" /end CHARACTERISTIC
/begin CHARACTERISTIC Cxx_tco_sig_mcut_max_slop "Slop of engine cooling temperature for micro cut detection" VALUE 0xa0021432 _REC_S1VAL_20_u2 240. _CNV_A_R_LINEAR_____110_CM -40. 200. FORMAT "%5.1" /end CHARACTERISTIC
/begin MEASUREMENT Vbx_moni_tco_cfm "Coolant Temperature Monitoring Strategy Configuration" UBYTE _CNV_S_2_RANGE______3_CM 1 0. 0. 1. ECU_ADDRESS 0xd0007b82 BIT_MASK 0x1 /end MEASUREMENT
/begin CHARACTERISTIC Cbx_moni_tco_cho "Coolant Temperature Monitoring Strategy Configuration" VALUE 0xa002142d _REC_S1VAL_20_u1 1. _CNV_A_R_ECME_LINEA_0_CM 0. 1. FORMAT "%1.0" BIT_MASK 0x1 /end CHARACTERISTIC
/begin AXIS_PTS Ctb_tco_mon_sta_tco_diag_thd "Starting coolant temperature threshold for diagnostic" 0xa0021434 Vxx_sta_tco _REC_A2AXS_20_u2 240. _CNV_A_R_LINEAR_____110_CM 3 -40. 200. FORMAT "%5.1" /end AXIS_PTS
/begin CHARACTERISTIC Ctd_tco_mon_sta_tco_diag_thd "delay choice for diagnostic enabling" CURVE 0xa002143c _REC_A1CUR_20_u1_u2 2. _CNV_A_R_ECME_LINEA_0_CM 1. 3. FORMAT "%1.0"
 /begin AXIS_DESCR COM_AXIS Vxx_sta_tco _CNV_A_R_LINEAR_____110_CM 3 -40. 200. FORMAT "%5.1" AXIS_PTS_REF Ctb_tco_mon_sta_tco_diag_thd /end AXIS_DESCR
/end CHARACTERISTIC
/begin MEASUREMENT Vbx_df_tco_cl_no_norm "engine cooling temperature detected failure" UBYTE _CNV_S_2_RANGE______3_CM 1 0. 0. 1. ECU_ADDRESS 0xd0007b94 BIT_MASK 0x1 /end MEASUREMENT
/begin MEASUREMENT Vbx_df_tsta_reg_no_norm "engine thermostat detected failure" UBYTE _CNV_S_2_RANGE______3_CM 1 0. 0. 1. ECU_ADDRESS 0xd0007b95 BIT_MASK 0x1 /end MEASUREMENT
/begin MEASUREMENT Vbx_diag_ena_tco_cl_no_norm "engine cooling temperature diagnostic information available" UBYTE _CNV_S_2_RANGE______3_CM 1 0. 0. 1. ECU_ADDRESS 0xd0007b96 BIT_MASK 0x1 /end MEASUREMENT
/begin MEASUREMENT Vbx_diag_ena_tsta_reg_no_norm "engine thermostat diagnostic information available" UBYTE _CNV_S_2_RANGE______3_CM 1 0. 0. 1. ECU_ADDRESS 0xd0007b97 BIT_MASK 0x1 /end MEASUREMENT
/begin MEASUREMENT Vbx_tco_mon_cl_diag "Flag of engine cooling temperature diagnosis" UBYTE _CNV_S_2_RANGE______3_CM 1 0. 0. 1. ECU_ADDRESS 0xd0007b98 BIT_MASK 0x1 /end MEASUREMENT
/begin MEASUREMENT Vbx_tco_mon_drv_inf "Derivative engine coolant temperature inf flag" UBYTE _CNV_S_2_RANGE______3_CM 1 0. 0. 1. ECU_ADDRESS 0xd0007b99 BIT_MASK 0x1 /end MEASUREMENT
/begin MEASUREMENT Vbx_tco_mon_drv_sup "Derivative engine coolant temperature sup flag" UBYTE _CNV_S_2_RANGE______3_CM 1 0. 0. 1. ECU_ADDRESS 0xd0007b9a BIT_MASK 0x1 /end MEASUREMENT
/begin MEASUREMENT Vbx_tco_mon_ena "Tco monitoring enabling with Ivld inputs" UBYTE _CNV_S_2_RANGE______3_CM 1 0. 0. 1. ECU_ADDRESS 0xd0007b9b BIT_MASK 0x1 /end MEASUREMENT
/begin MEASUREMENT Vbx_tco_mon_hot "Enable thresholds of tco monitoring if sta tco is hot" UBYTE _CNV_S_2_RANGE______3_CM 1 0. 0. 1. ECU_ADDRESS 0xd0007b9c BIT_MASK 0x1 /end MEASUREMENT
/begin MEASUREMENT Vbx_tco_mon_t "Enable to calculate averages" UBYTE _CNV_S_2_RANGE______3_CM 1 0. 0. 1. ECU_ADDRESS 0xd0007b9d BIT_MASK 0x1 /end MEASUREMENT
/begin MEASUREMENT Vbx_tco_mon_t_ena "Begining of tco monitoring" UBYTE _CNV_S_2_RANGE______3_CM 1 0. 0. 1. ECU_ADDRESS 0xd0007b9e BIT_MASK 0x1 /end MEASUREMENT
/begin MEASUREMENT Vbx_tco_mon_t_min_diag "Flag of engine cooling temperature diagnosis" UBYTE _CNV_S_2_RANGE______3_CM 1 0. 0. 1. ECU_ADDRESS 0xd0007b9f BIT_MASK 0x1 /end MEASUREMENT
/begin MEASUREMENT Vbx_tco_mon_t_min_diag_ena "Minimum time for engine thermostat diagnostic information available" UBYTE _CNV_S_2_RANGE______3_CM 1 0. 0. 1. ECU_ADDRESS 0xd0007ba0 BIT_MASK 0x1 /end MEASUREMENT
/begin MEASUREMENT Vbx_tco_mon_t_win "Window of tco monitoring" UBYTE _CNV_S_2_RANGE______3_CM 1 0. 0. 1. ECU_ADDRESS 0xd0007ba1 BIT_MASK 0x1 /end MEASUREMENT
/begin MEASUREMENT Vbx_tco_mon_tout "Time-out of tco monitoring" UBYTE _CNV_S_2_RANGE______3_CM 1 0. 0. 1. ECU_ADDRESS 0xd0007ba2 BIT_MASK 0x1 /end MEASUREMENT
/begin MEASUREMENT Vbx_tco_mon_tsta_diag "Flag of thermostat diagnosis" UBYTE _CNV_S_2_RANGE______3_CM 1 0. 0. 1. ECU_ADDRESS 0xd0007ba3 BIT_MASK 0x1 /end MEASUREMENT
/begin MEASUREMENT Vxd_tco_mon_sta_tco_diag_thd "Index of delay choice for diagnostic enabling" UBYTE _CNV_A_R_ECME_LINEA_0_CM 1 0. 1. 3. ECU_ADDRESS 0xd0007ba4 FORMAT "%1.0" /end MEASUREMENT
/begin MEASUREMENT Vxx_tco_mon_adac_fim_avg "Injected fuel mass for ADAC (fuel consumption) average" ULONG _CNV_A_R_LINEAR_____133_CM 1 0. 0. 4800. ECU_ADDRESS 0xd0003574 FORMAT "%12.3" /end MEASUREMENT
/begin MEASUREMENT Vxx_tco_mon_alt_pwm_avg "Filtered alternator load average" UWORD _CNV_A_R_LINEAR_____245_CM 1 0. 0. 819187.5 ECU_ADDRESS 0xd0005ed0 FORMAT "%8.1" /end MEASUREMENT
/begin MEASUREMENT Vxx_tco_mon_avg "Used to calculate averages" UWORD _CNV_A_R_ECME_LINEA_0_CM 1 0. 0. 65535. ECU_ADDRESS 0xd0005ed2 FORMAT "%5.0" /end MEASUREMENT
/begin MEASUREMENT Vxx_tco_mon_drg "Time of tco monitoring (Cxx_mon_t_sup-inf)" UWORD _CNV_A_R_LINEAR_____58_CM 1 0. 0. 6553.5 ECU_ADDRESS 0xd0005ed4 FORMAT "%6.1" /end MEASUREMENT
/begin MEASUREMENT Vxx_tco_mon_drv "Derivative engine coolant temperature" UWORD _CNV_A_R_LINEAR_____110_CM 1 0. -40. 200. ECU_ADDRESS 0xd0005ed6 FORMAT "%5.1" /end MEASUREMENT
/begin MEASUREMENT Vxx_tco_mon_mat_min "Minimum intake air temperature during driving" UWORD _CNV_A_R_LINEAR_____110_CM 1 0. -40. 200. ECU_ADDRESS 0xd0005ed8 FORMAT "%5.1" /end MEASUREMENT
/begin MEASUREMENT Vxx_tco_mon_n_avg "Engine speed average" UWORD _CNV_A_R_ENSD_LINEA_22_CM 1 0. 0. 16383.75 ECU_ADDRESS 0xd0005eda FORMAT "%8.2" /end MEASUREMENT
/begin MEASUREMENT Vxx_tco_mon_t "Time" UWORD _CNV_A_R_LINEAR_____58_CM 1 0. 0. 6553.5 ECU_ADDRESS 0xd0005edc FORMAT "%6.1" /end MEASUREMENT
/begin MEASUREMENT Vxx_tco_mon_tco_avg "Engine coolant temperature average" UWORD _CNV_A_R_LINEAR_____110_CM 1 0. -40. 200. ECU_ADDRESS 0xd0005ede FORMAT "%5.1" /end MEASUREMENT
/begin MEASUREMENT Vxx_tco_mon_tqi_avg "Final indicated target torque ratio average" UWORD _CNV_A_R_LINEAR_____183_CM 1 0. 0. 1. ECU_ADDRESS 0xd0005ee0 FORMAT "%11.9" /end MEASUREMENT
/begin MEASUREMENT Vxx_tco_mon_tqi_win_avg "Final indicated target torque ratio average" UWORD _CNV_A_R_LINEAR_____246_CM 1 0. 0. 16383.75 ECU_ADDRESS 0xd0005ee2 FORMAT "%8.2" /end MEASUREMENT
/begin MEASUREMENT Vxx_tco_mon_vs_avg "Vehicle speed average" UWORD _CNV_A_R_LINEAR_____125_CM 1 0. 0. 655.35 ECU_ADDRESS 0xd0005ee4 FORMAT "%6.2" /end MEASUREMENT
/begin CHARACTERISTIC Cbx_tco_mon_dft_lght_ena "Water temperature alert lamp tco monitoring enabling." VALUE 0xa0021482 _REC_S1VAL_20_u1 1. _CNV_A_R_ECME_LINEA_0_CM 0. 1. FORMAT "%1.0" BIT_MASK 0x1 /end CHARACTERISTIC
/begin CHARACTERISTIC Cbx_tco_mon_dft_lght_tco_ena "Water temperature alert lamp tco cl failure enabling." VALUE 0xa0021483 _REC_S1VAL_20_u1 1. _CNV_A_R_ECME_LINEA_0_CM 0. 1. FORMAT "%1.0" BIT_MASK 0x1 /end CHARACTERISTIC
/begin CHARACTERISTIC Cbx_tco_mon_dft_lght_tsta_ena "Water temperature alert lamp thermostat reg failure enabling." VALUE 0xa0021484 _REC_S1VAL_20_u1 1. _CNV_A_R_ECME_LINEA_0_CM 0. 1. FORMAT "%1.0" BIT_MASK 0x1 /end CHARACTERISTIC
/begin CHARACTERISTIC Cbx_tco_mon_tco_cl_diag_ena "Engine cooling temperature tco monitoring enabling" VALUE 0xa0021485 _REC_S1VAL_20_u1 1. _CNV_A_R_ECME_LINEA_0_CM 0. 1. FORMAT "%1.0" BIT_MASK 0x1 /end CHARACTERISTIC
/begin CHARACTERISTIC Cbx_tco_mon_tco_t_min_diag_ena "Engine thermostat delay tco monitoring enabling" VALUE 0xa0021486 _REC_S1VAL_20_u1 1. _CNV_A_R_ECME_LINEA_0_CM 0. 1. FORMAT "%1.0" BIT_MASK 0x1 /end CHARACTERISTIC
/begin CHARACTERISTIC Cbx_tco_mon_tsta_diag_ena "Engine thermostat tco monitoring enabling" VALUE 0xa0021487 _REC_S1VAL_20_u1 1. _CNV_A_R_ECME_LINEA_0_CM 0. 1. FORMAT "%1.0" BIT_MASK 0x1 /end CHARACTERISTIC
/begin CHARACTERISTIC Cxx_dfdec_tco_cl "engine temperature detected failure counter decrement" VALUE 0xa0021440 _REC_S1VAL_20_u2 65535. _CNV_A_R_ECME_LINEA_0_CM 0. 65535. FORMAT "%5.0" /end CHARACTERISTIC
/begin CHARACTERISTIC Cxx_dfdec_tsta_reg "engine thermostat detected failure counter decrement" VALUE 0xa0021442 _REC_S1VAL_20_u2 65535. _CNV_A_R_ECME_LINEA_0_CM 0. 65535. FORMAT "%5.0" /end CHARACTERISTIC
/begin CHARACTERISTIC Cxx_dfinc_tco_cl "engine temperature detected failure counter increment" VALUE 0xa0021444 _REC_S1VAL_20_u2 65535. _CNV_A_R_ECME_LINEA_0_CM 0. 65535. FORMAT "%5.0" /end CHARACTERISTIC
/begin CHARACTERISTIC Cxx_dfinc_tsta_reg "engine thermostat detected failure counter increment" VALUE 0xa0021446 _REC_S1VAL_20_u2 65535. _CNV_A_R_ECME_LINEA_0_CM 0. 65535. FORMAT "%5.0" /end CHARACTERISTIC
/begin CHARACTERISTIC Cxx_tco_mon_Te1 "Duration of sampling" VALUE 0xa0021448 _REC_S1VAL_20_u2 6553.5 _CNV_A_R_LINEAR_____58_CM 0. 6553.5 FORMAT "%6.1" /end CHARACTERISTIC
/begin CHARACTERISTIC Cxx_tco_mon_Te2 "Duration of the average" VALUE 0xa002144a _REC_S1VAL_20_u2 6553.5 _CNV_A_R_LINEAR_____58_CM 0. 6553.5 FORMAT "%6.1" /end CHARACTERISTIC
/begin CHARACTERISTIC Cxx_tco_mon_adac_fim_avg_inf "Injected fuel mass for ADAC (fuel consumption) average inf window" VALUE 0xa002144c _REC_S1VAL_20_u4 4800. _CNV_A_R_LINEAR_____133_CM 0. 4800. FORMAT "%12.3" /end CHARACTERISTIC
/begin CHARACTERISTIC Cxx_tco_mon_adac_fim_avg_sup "Injected fuel mass for ADAC (fuel consumption) average sup window" VALUE 0xa0021450 _REC_S1VAL_20_u4 4800. _CNV_A_R_LINEAR_____133_CM 0. 4800. FORMAT "%12.3" /end CHARACTERISTIC
/begin CHARACTERISTIC Cxx_tco_mon_alt_pwm_sup "Filtered alternator load average max value" VALUE 0xa0021454 _REC_S1VAL_20_u2 819187.5 _CNV_A_R_LINEAR_____245_CM 0. 819187.5 FORMAT "%8.1" /end CHARACTERISTIC
/begin CHARACTERISTIC Cxx_tco_mon_alt_pwm_sup_2 "Filtered alternator load average max value number 2" VALUE 0xa0021456 _REC_S1VAL_20_u2 819187.5 _CNV_A_R_LINEAR_____245_CM 0. 819187.5 FORMAT "%8.1" /end CHARACTERISTIC
/begin CHARACTERISTIC Cxx_tco_mon_drv_inf "Derivative engine coolant temperature inf threshold" VALUE 0xa0021458 _REC_S1VAL_20_u2 240. _CNV_A_R_LINEAR_____110_CM -40. 200. FORMAT "%5.1" /end CHARACTERISTIC
/begin CHARACTERISTIC Cxx_tco_mon_drv_sup "Derivative engine coolant temperature sup threshold" VALUE 0xa002145a _REC_S1VAL_20_u2 240. _CNV_A_R_LINEAR_____110_CM -40. 200. FORMAT "%5.1" /end CHARACTERISTIC
/begin CHARACTERISTIC Cxx_tco_mon_ini_inf "Engine coolant temperature initial inf value" VALUE 0xa002145c _REC_S1VAL_20_u2 240. _CNV_A_R_LINEAR_____110_CM -40. 200. FORMAT "%5.1" /end CHARACTERISTIC
/begin CHARACTERISTIC Cxx_tco_mon_n_avg_inf "Engine speed average inf value" VALUE 0xa002145e _REC_S1VAL_20_u2 16383.75 _CNV_A_R_ENSD_LINEA_22_CM 0. 16383.75 FORMAT "%8.2" /end CHARACTERISTIC
/begin CHARACTERISTIC Cxx_tco_mon_rich_cl_thd_t1 "Delay to check if the cooling temperature is not reached (depends of sta_tco)" VALUE 0xa0021460 _REC_S1VAL_20_u2 6553.5 _CNV_A_R_LINEAR_____58_CM 0. 6553.5 FORMAT "%6.1" /end CHARACTERISTIC
/begin CHARACTERISTIC Cxx_tco_mon_rich_cl_thd_t2 "Delay to check if the cooling temperature is not reached (depends of sta_tco)" VALUE 0xa0021462 _REC_S1VAL_20_u2 6553.5 _CNV_A_R_LINEAR_____58_CM 0. 6553.5 FORMAT "%6.1" /end CHARACTERISTIC
/begin CHARACTERISTIC Cxx_tco_mon_t_inf "Time to delay the begining of tco monitoring" VALUE 0xa0021464 _REC_S1VAL_20_u2 6553.5 _CNV_A_R_LINEAR_____58_CM 0. 6553.5 FORMAT "%6.1" /end CHARACTERISTIC
/begin CHARACTERISTIC Cxx_tco_mon_t_sup "Time to delay the begining of tco monitoring" VALUE 0xa0021466 _REC_S1VAL_20_u2 6553.5 _CNV_A_R_LINEAR_____58_CM 0. 6553.5 FORMAT "%6.1" /end CHARACTERISTIC
/begin CHARACTERISTIC Cxx_tco_mon_t_thd_t0 "Delay to check if the cooling temperature is not reached" VALUE 0xa0021468 _REC_S1VAL_20_u2 6553.5 _CNV_A_R_LINEAR_____58_CM 0. 6553.5 FORMAT "%6.1" /end CHARACTERISTIC
/begin CHARACTERISTIC Cxx_tco_mon_tair_min_inf "Minimum intake air temperature during driving inf window" VALUE 0xa002146a _REC_S1VAL_20_u2 240. _CNV_A_R_LINEAR_____110_CM -40. 200. FORMAT "%5.1" /end CHARACTERISTIC
/begin CHARACTERISTIC Cxx_tco_mon_tair_min_sup "Minimum intake air temperature during driving sup window" VALUE 0xa002146c _REC_S1VAL_20_u2 240. _CNV_A_R_LINEAR_____110_CM -40. 200. FORMAT "%5.1" /end CHARACTERISTIC
/begin CHARACTERISTIC Cxx_tco_mon_tco_avg_inf "Engine coolant temperature average inf window" VALUE 0xa002146e _REC_S1VAL_20_u2 240. _CNV_A_R_LINEAR_____110_CM -40. 200. FORMAT "%5.1" /end CHARACTERISTIC
/begin CHARACTERISTIC Cxx_tco_mon_tco_avg_sup "Engine coolant temperature average sup window" VALUE 0xa0021470 _REC_S1VAL_20_u2 240. _CNV_A_R_LINEAR_____110_CM -40. 200. FORMAT "%5.1" /end CHARACTERISTIC
/begin CHARACTERISTIC Cxx_tco_mon_tco_thd "Delay to check if the cooling temperature is not reached" VALUE 0xa0021472 _REC_S1VAL_20_u2 240. _CNV_A_R_LINEAR_____110_CM -40. 200. FORMAT "%5.1" /end CHARACTERISTIC
/begin CHARACTERISTIC Cxx_tco_mon_tqi_avg_inf "Final indicated target torque ratio average inv window" VALUE 0xa0021474 _REC_S1VAL_20_u2 1. _CNV_A_R_LINEAR_____183_CM 0. 1. FORMAT "%11.9" /end CHARACTERISTIC
/begin CHARACTERISTIC Cxx_tco_mon_tqi_avg_sup "Final indicated target torque ratio average sup window" VALUE 0xa0021476 _REC_S1VAL_20_u2 1. _CNV_A_R_LINEAR_____183_CM 0. 1. FORMAT "%11.9" /end CHARACTERISTIC
/begin CHARACTERISTIC Cxx_tco_mon_tqi_cold_avg_inf "Final indicated target torque ratio average inf window (cold case)" VALUE 0xa0021478 _REC_S1VAL_20_u2 16383.75 _CNV_A_R_LINEAR_____246_CM 0. 16383.75 FORMAT "%8.2" /end CHARACTERISTIC
/begin CHARACTERISTIC Cxx_tco_mon_tqi_cold_avg_sup "Final indicated target torque ratio average sup window (cold case)" VALUE 0xa002147a _REC_S1VAL_20_u2 16383.75 _CNV_A_R_LINEAR_____246_CM 0. 16383.75 FORMAT "%8.2" /end CHARACTERISTIC
/begin CHARACTERISTIC Cxx_tco_mon_tqi_hot_avg_inf "Final indicated target torque ratio average inf window (hot case)" VALUE 0xa002147c _REC_S1VAL_20_u2 16383.75 _CNV_A_R_LINEAR_____246_CM 0. 16383.75 FORMAT "%8.2" /end CHARACTERISTIC
/begin CHARACTERISTIC Cxx_tco_mon_tqi_hot_avg_sup "Final indicated target torque ratio average sup window (hot case)" VALUE 0xa002147e _REC_S1VAL_20_u2 16383.75 _CNV_A_R_LINEAR_____246_CM 0. 16383.75 FORMAT "%8.2" /end CHARACTERISTIC
/begin CHARACTERISTIC Cxx_tco_mon_vs_avg_inf "Vehicle speed average inf value" VALUE 0xa0021480 _REC_S1VAL_20_u2 655.35 _CNV_A_R_LINEAR_____125_CM 0. 655.35 FORMAT "%6.2" /end CHARACTERISTIC
/begin MEASUREMENT Vxx_pft_oil_csm "" UWORD _CNV_A_R_LINEAR_____247_CM 1 0. 0. 6.5535 DISPLAY_IDENTIFIER InCliLui_NVM.Vxx_pft_oil_csm_NVM ECU_ADDRESS 0xd0005eee FORMAT "%6.4" /end MEASUREMENT
/begin MEASUREMENT Vxx_amp "" UWORD _CNV_A_R_LINEAR_____115_CM 1 0. 0. 20000. DISPLAY_IDENTIFIER InAsiIap_NVM.Vxx_amp_nvm ECU_ADDRESS 0xd00041e0 FORMAT "%5.0" /end MEASUREMENT
/begin MEASUREMENT Vxx_map_spg_dif "" SWORD _CNV_A_R_LINEAR_____115_CM 1 0. -10000. 10000. DISPLAY_IDENTIFIER InAsiIap_NVM.Vxx_map_spg_dif_nvm ECU_ADDRESS 0xd00041e2 FORMAT "%6.0" /end MEASUREMENT
/begin MEASUREMENT Vsx_sens_spg_vld "Boost pressure sensor value validity status" UBYTE _CNV_S_3_STATUS_OK__179_CM 1 0. 0. 2. ECU_ADDRESS 0xd0006afe /end MEASUREMENT
/begin MEASUREMENT Vxx_sens_spg "Boost pressure measurement value from sensor" UWORD _CNV_A_R_LINEAR_____115_CM 1 0. 0. 20000. ECU_ADDRESS 0xd000424e FORMAT "%5.0" /end MEASUREMENT
/begin CHARACTERISTIC Cxx_dfdec_sens_spg_h "Boost pressure sensor high signal detected failure counter decrement" VALUE 0xa00212cc _REC_S1VAL_20_u2 65535. _CNV_A_R_ECME_LINEA_0_CM 0. 65535. FORMAT "%5.0" /end CHARACTERISTIC
/begin CHARACTERISTIC Cxx_dfdec_sens_spg_l "Boost pressure low signal circuit to ground detected failure counter decrement" VALUE 0xa00212ce _REC_S1VAL_20_u2 65535. _CNV_A_R_ECME_LINEA_0_CM 0. 65535. FORMAT "%5.0" /end CHARACTERISTIC
/begin CHARACTERISTIC Cxx_dfinc_sens_spg_h "Boost pressure sensor high signal detected failure counter increment" VALUE 0xa00212d0 _REC_S1VAL_20_u2 65535. _CNV_A_R_ECME_LINEA_0_CM 0. 65535. FORMAT "%5.0" /end CHARACTERISTIC
/begin CHARACTERISTIC Cxx_dfinc_sens_spg_l "Boost pressure low signal circuit to ground detected failure counter increment" VALUE 0xa00212d2 _REC_S1VAL_20_u2 65535. _CNV_A_R_ECME_LINEA_0_CM 0. 65535. FORMAT "%5.0" /end CHARACTERISTIC
/begin AXIS_PTS Ctb_n_spg_dft_mdl "Breakpoint of Engine speed for Ctp_n_spg_dft_mod" 0xa002cadc Vxx_n _REC_A2AXS_20_u2 16383.75 _CNV_A_R_ENSD_LINEA_22_CM 9 0. 16383.75 FORMAT "%8.2" /end AXIS_PTS
/begin CHARACTERISTIC Ctp_n_amp_spg_dif_cut "Diff between Vxx_spg-Vxx_map during slowdown cut off due to the flow of the turbine and the throttle" CURVE 0xa002caf0 _REC_A1CUR_20_u2_u2 20000. _CNV_A_R_LINEAR_____115_CM 0. 20000. FORMAT "%5.0"
 /begin AXIS_DESCR COM_AXIS Vxx_n _CNV_A_R_ENSD_LINEA_22_CM 9 0. 16383.75 FORMAT "%8.2" AXIS_PTS_REF Ctb_n2 /end AXIS_DESCR
/end CHARACTERISTIC
/begin CHARACTERISTIC Ctp_n_spg_dft_mdl "Default value of Vxx_mdl_sgp" CURVE 0xa002cb04 _REC_A1CUR_20_u2_u2 20000. _CNV_A_R_LINEAR_____115_CM 0. 20000. FORMAT "%5.0"
 /begin AXIS_DESCR COM_AXIS Vxx_n _CNV_A_R_ENSD_LINEA_22_CM 9 0. 16383.75 FORMAT "%8.2" AXIS_PTS_REF Ctb_n_spg_dft_mdl /end AXIS_DESCR
/end CHARACTERISTIC
/begin MEASUREMENT Vbx_amp_spg_dif_upd "Pressure difference between Vxx_amp and Vxx_spg during engine slowdown update" UBYTE _CNV_S_2_RANGE______3_CM 1 0. 0. 1. ECU_ADDRESS 0xd0006af6 BIT_MASK 0x1 /end MEASUREMENT
/begin MEASUREMENT Vbx_df_spg_oor "Turbocharger Pressure Sensor Abnormal Voltage detected failure" UBYTE _CNV_S_2_RANGE______3_CM 1 0. 0. 1. ECU_ADDRESS 0xd0006af7 BIT_MASK 0x1 /end MEASUREMENT
/begin MEASUREMENT Vbx_diag_ena_spg_oor "Turbocharger Pressure Sensor Out Of Range diagnostic information available" UBYTE _CNV_S_2_RANGE______3_CM 1 0. 0. 1. ECU_ADDRESS 0xd0006af8 BIT_MASK 0x1 /end MEASUREMENT
/begin MEASUREMENT Vbx_inj_cut_cdn "Injection cut detection" UBYTE _CNV_S_2_RANGE______3_CM 1 0. 0. 1. ECU_ADDRESS 0xd0006af9 BIT_MASK 0x1 /end MEASUREMENT
/begin MEASUREMENT Vbx_low_eng_load "Low engine load detection" UBYTE _CNV_S_2_RANGE______3_CM 1 0. 0. 1. ECU_ADDRESS 0xd0006afa BIT_MASK 0x1 /end MEASUREMENT
/begin MEASUREMENT Vbx_spg_gbx_stt "Gearbox state for SPG diagnosis purpose" UBYTE _CNV_S_2_RANGE______3_CM 1 0. 0. 1. ECU_ADDRESS 0xd0006afb BIT_MASK 0x1 /end MEASUREMENT
/begin MEASUREMENT Vbx_spg_ini "Boolean indicating the initialisation state of spg" UBYTE _CNV_S_2_RANGE______3_CM 1 0. 0. 1. ECU_ADDRESS 0xd0006afc BIT_MASK 0x1 /end MEASUREMENT
/begin MEASUREMENT Vsx_spg_vld "Boost pressure validity status" UBYTE _CNV_A_R_ECME_LINEA_0_CM 1 0. 0. 2. ECU_ADDRESS 0xd0006afd FORMAT "%1.0" /end MEASUREMENT
/begin MEASUREMENT Vxx_act_is_dly "Idle speed recognation delay" UWORD _CNV_A_R_LINEAR_____32_CM 1 0. 0. 655.35 ECU_ADDRESS 0xd0004240 FORMAT "%6.2" /end MEASUREMENT
/begin MEASUREMENT Vxx_amp_inj_cut_dly "Delay variable for the detection of an injection cut" UWORD _CNV_A_R_LINEAR_____116_CM 1 0. 0. 65.535 ECU_ADDRESS 0xd0004242 FORMAT "%5.3" /end MEASUREMENT
/begin MEASUREMENT Vxx_amp_spg_dif "Pressure difference between Vxx_amp and Vxx_spg during engfine slowdown" UWORD _CNV_A_R_LINEAR_____115_CM 1 0. 0. 20000. ECU_ADDRESS 0xd0004244 FORMAT "%5.0" /end MEASUREMENT
/begin MEASUREMENT Vxx_it_psn_dif_fil "filtered absolute variation of Vxx_it_rel_psn" UWORD _CNV_A_R_LINEAR_____146_CM 1 0. 0. 100. ECU_ADDRESS 0xd0004246 FORMAT "%6.2" /end MEASUREMENT
/begin MEASUREMENT Vxx_mdl_spg "modelled turbocharger pressure" UWORD _CNV_A_R_LINEAR_____115_CM 1 0. 0. 20000. ECU_ADDRESS 0xd0004248 FORMAT "%5.0" /end MEASUREMENT
/begin MEASUREMENT Vxx_spg "Boost pressure measurement value" UWORD _CNV_A_R_LINEAR_____115_CM 1 0. 0. 20000. ECU_ADDRESS 0xd000424a FORMAT "%5.0" /end MEASUREMENT
/begin CHARACTERISTIC Cbx_spg_sens_cfm "Boolean indicating if the engine is equipped with an boost pressure sensor" VALUE 0xa00212ca _REC_S1VAL_20_u1 1. _CNV_A_R_ECME_LINEA_0_CM 0. 1. FORMAT "%1.0" BIT_MASK 0x1 /end CHARACTERISTIC
/begin CHARACTERISTIC Cxx_act_is_dly "Time after the recognition of the idle speed for the diagnosis of Vxx_spg and the updating Vxx_amp" VALUE 0xa00212aa _REC_S1VAL_20_u2 655.35 _CNV_A_R_LINEAR_____32_CM 0. 655.35 FORMAT "%6.2" /end CHARACTERISTIC
/begin CHARACTERISTIC Cxx_amp_cge_n_thd "Threshold of Vxx_n above of which we forbid the updating of Vxx_amp and the diagnosis of Vxx_spg" VALUE 0xa00212ac _REC_S1VAL_20_u2 16383.75 _CNV_A_R_ENSD_LINEA_22_CM 0. 16383.75 FORMAT "%8.2" /end CHARACTERISTIC
/begin CHARACTERISTIC Cxx_amp_inj_cut_dly "Time after the recognition of the cut of inj for the diagnosis of Vxx_spg and the updating Vxx_amp" VALUE 0xa00212ae _REC_S1VAL_20_u2 65.535 _CNV_A_R_LINEAR_____116_CM 0. 65.535 FORMAT "%5.3" /end CHARACTERISTIC
/begin CHARACTERISTIC Cxx_amp_spg_dif_fac "Coefficient of loss of load between the throttle and the atmospheric pressure" VALUE 0xa00212b0 _REC_S1VAL_20_u2 3.999938e-002 _CNV_A_R_LINEAR_____248_CM 0. 3.999938e-002 FORMAT "%9.7" /end CHARACTERISTIC
/begin CHARACTERISTIC Cxx_dfdec_spg_oor "" VALUE 0xa00212b2 _REC_S1VAL_20_u2 65535. _CNV_A_R_ECME_LINEA_0_CM 0. 65535. FORMAT "%5.0" /end CHARACTERISTIC
/begin CHARACTERISTIC Cxx_dfinc_spg_oor "" VALUE 0xa00212b4 _REC_S1VAL_20_u2 65535. _CNV_A_R_ECME_LINEA_0_CM 0. 65535. FORMAT "%5.0" /end CHARACTERISTIC
/begin CHARACTERISTIC Cxx_fil_it_psn_dif_thd "Thd of Vxx_fil_it_psn_dif above which we forbid learning of Vxx_amp and the diagnosis of Vxx_spg" VALUE 0xa00212b6 _REC_S1VAL_20_u2 100. _CNV_A_R_LINEAR_____146_CM 0. 100. FORMAT "%6.2" /end CHARACTERISTIC
/begin CHARACTERISTIC Cxx_it_psn_cge_fil_ftc "Factor of filtering of Vxx_it_rel_psn" VALUE 0xa00212b8 _REC_S1VAL_20_u2 65.535 _CNV_A_R_LINEAR_____116_CM 0. 65.535 FORMAT "%5.3" /end CHARACTERISTIC
/begin CHARACTERISTIC Cxx_it_psn_dif_thd "Thd of Vxx_it_rel_psn above which we forbid learning of Vxx_amp and the diagnosis of Vxx_spg" VALUE 0xa00212ba _REC_S1VAL_20_u2 100. _CNV_A_R_LINEAR_____146_CM 0. 100. FORMAT "%6.2" /end CHARACTERISTIC
/begin CHARACTERISTIC Cxx_max_amp "maximum threshold of Atmospheric pressure" VALUE 0xa00212bc _REC_S1VAL_20_u2 20000. _CNV_A_R_LINEAR_____115_CM 0. 20000. FORMAT "%5.0" /end CHARACTERISTIC
/begin CHARACTERISTIC Cxx_min_amp "minimum threshold of Atmospheric pressure" VALUE 0xa00212be _REC_S1VAL_20_u2 20000. _CNV_A_R_LINEAR_____115_CM 0. 20000. FORMAT "%5.0" /end CHARACTERISTIC
/begin CHARACTERISTIC Cxx_spg_fail_l_thd "Value of Vxx_spg below which we declare a breakdown pressure sensor, stopped engine." VALUE 0xa00212c0 _REC_S1VAL_20_u2 20000. _CNV_A_R_LINEAR_____115_CM 0. 20000. FORMAT "%5.0" /end CHARACTERISTIC
/begin CHARACTERISTIC Cxx_spg_fail_up_thd "Value of Vxx_spg upper which we declare a breakdown pressure sensor, stopped engine." VALUE 0xa00212c2 _REC_S1VAL_20_u2 20000. _CNV_A_R_LINEAR_____115_CM 0. 20000. FORMAT "%5.0" /end CHARACTERISTIC
/begin CHARACTERISTIC Cxx_spg_fail_val "Defaut value for boost pressure" VALUE 0xa00212c4 _REC_S1VAL_20_u2 20000. _CNV_A_R_LINEAR_____115_CM 0. 20000. FORMAT "%5.0" /end CHARACTERISTIC
/begin CHARACTERISTIC Cxx_spg_min "Value of Vxx_spg below which we declare a breakdown sensor." VALUE 0xa00212c6 _REC_S1VAL_20_u2 20000. _CNV_A_R_LINEAR_____115_CM 0. 20000. FORMAT "%5.0" /end CHARACTERISTIC
/begin CHARACTERISTIC Cxx_stab_spg_dif_thd "Absolved max value  between 2 acquisitions of pressure stopped engine for the diagnosis" VALUE 0xa00212c8 _REC_S1VAL_20_u2 20000. _CNV_A_R_LINEAR_____115_CM 0. 20000. FORMAT "%5.0" /end CHARACTERISTIC
/begin MEASUREMENT Vsx_sens_map_vld "Manifold pressure from sensor validity status" UBYTE _CNV_A_R_ECME_LINEA_0_CM 1 0. 0. 2. ECU_ADDRESS 0xd0006aef FORMAT "%1.0" /end MEASUREMENT
/begin MEASUREMENT Vxx_sens_map "Manifold pressure from sensor" UWORD _CNV_A_R_LINEAR_____115_CM 1 0. 0. 20000. ECU_ADDRESS 0xd000422c FORMAT "%5.0" /end MEASUREMENT
/begin CHARACTERISTIC Cxx_dfdec_sens_map_h "Manifold pressure sensor high signal detected failure counter decrement" VALUE 0xa0021296 _REC_S1VAL_20_u2 65535. _CNV_A_R_ECME_LINEA_0_CM 0. 65535. FORMAT "%5.0" /end CHARACTERISTIC
/begin CHARACTERISTIC Cxx_dfdec_sens_map_l "Manifold pressure sensor low signal to ground detected failure counter decrement" VALUE 0xa0021298 _REC_S1VAL_20_u2 65535. _CNV_A_R_ECME_LINEA_0_CM 0. 65535. FORMAT "%5.0" /end CHARACTERISTIC
/begin CHARACTERISTIC Cxx_dfinc_sens_map_h "Manifold pressure sensor high signal detected failure counter increment" VALUE 0xa002129a _REC_S1VAL_20_u2 65535. _CNV_A_R_ECME_LINEA_0_CM 0. 65535. FORMAT "%5.0" /end CHARACTERISTIC
/begin CHARACTERISTIC Cxx_dfinc_sens_map_l "Manifold pressure sensor low signal to ground detected failure counter increment" VALUE 0xa002129c _REC_S1VAL_20_u2 65535. _CNV_A_R_ECME_LINEA_0_CM 0. 65535. FORMAT "%5.0" /end CHARACTERISTIC
/begin MEASUREMENT Vxx_lim_pred_map "Predicted manifold pressure for next intake (limited)" UWORD _CNV_A_R_LINEAR_____115_CM 1 0. 0. 20000. ECU_ADDRESS 0xd0004230 FORMAT "%5.0" /end MEASUREMENT
/begin MEASUREMENT Vxx_lim_pred_map_dif "Predicted manifold pressure difference for next intake (limited)" SWORD _CNV_A_R_LINEAR_____115_CM 1 0. -10000. 10000. ECU_ADDRESS 0xd0004232 FORMAT "%6.0" /end MEASUREMENT
/begin MEASUREMENT Vxx_pred_map "Predicted manifold pressure for next intake" UWORD _CNV_A_R_LINEAR_____115_CM 1 0. 0. 20000. ECU_ADDRESS 0xd0004234 FORMAT "%5.0" /end MEASUREMENT
/begin MEASUREMENT Vxx_pred_map_dif "Predicted manifold pressure difference for next intake." SWORD _CNV_A_R_LINEAR_____115_CM 1 0. -10000. 10000. ECU_ADDRESS 0xd0004236 FORMAT "%6.0" /end MEASUREMENT
/begin CHARACTERISTIC Cxx_pred_map_dif_dz "Dead zone in Vxx_pred_map_dif application" VALUE 0xa002129e _REC_S1VAL_20_u2 20000. _CNV_A_R_LINEAR_____115_CM 0. 20000. FORMAT "%5.0" /end CHARACTERISTIC
/begin CHARACTERISTIC Cxx_pred_map_dif_max_fac "Factor applied on upstream pressure to saturate predicted manifold pressure difference" VALUE 0xa00212a6 _REC_S1VAL_20_u1 1.9921875 _CNV_A_R_LINEAR_____42_CM 0. 1.9921875 FORMAT "%8.6" /end CHARACTERISTIC
/begin CHARACTERISTIC Cxx_pred_map_dif_neg_fac "Predicted manifold pressure difference factor when negative" VALUE 0xa00212a7 _REC_S1VAL_20_u1 1.9921875 _CNV_A_R_LINEAR_____42_CM 0. 1.9921875 FORMAT "%8.6" /end CHARACTERISTIC
/begin CHARACTERISTIC Cxx_pred_map_dif_pos_fac "Predicted manifold pressure difference factor when positive" VALUE 0xa00212a8 _REC_S1VAL_20_u1 1.9921875 _CNV_A_R_LINEAR_____42_CM 0. 1.9921875 FORMAT "%8.6" /end CHARACTERISTIC
/begin CHARACTERISTIC Cxx_t_pred_dly_ref "Time term of the reference prediction delay" VALUE 0xa00212a0 _REC_S1VAL_20_u2 0.1 _CNV_A_R_LINEAR_____249_CM 0. 0.1 FORMAT "%5.4" /end CHARACTERISTIC
/begin CHARACTERISTIC Cxx_tdc_nr_pred_dly_ref "TDC term of the reference prediction delay" VALUE 0xa00212a2 _REC_S1VAL_20_u2 5. _CNV_A_R_LINEAR_____250_CM 0. 5. FORMAT "%8.7" /end CHARACTERISTIC
/begin CHARACTERISTIC Cxx_vvtc_angl_tdc_fac "Convertion factor between relative VVT angle ant TDC number." VALUE 0xa00212a4 _REC_S1VAL_20_s2 9.9998474e-002 _CNV_A_R_LINEAR_____251_CM -5.e-002 4.9998474e-002 FORMAT "%10.8" /end CHARACTERISTIC
/begin AXIS_PTS Ntb_n_amp_map_dif "9 equidistant points [800; 1312; 1824; 2336; 2848; 3360; 3872; 4384; 4896]" 0xa002c998 Vxx_n _REC_A2AXS_20_u2 16383.75 _CNV_A_R_ENSD_LINEA_22_CM 9 0. 16383.75 READ_ONLY FORMAT "%8.2" /end AXIS_PTS
/begin AXIS_PTS Ntb_n_kd_it_psn_thd "9 equidistant points [1280; 1536; 1792; 2048; 2304; 2560; 2816; 3072; 3328]" 0xa002c9ac Vxx_n _REC_A2AXS_20_u2 16383.75 _CNV_A_R_ENSD_LINEA_22_CM 9 0. 16383.75 READ_ONLY FORMAT "%8.2" /end AXIS_PTS
/begin CHARACTERISTIC Ctp_n_amp_map_dif "Difference between the atmospheric pressure and the manifold pressure in full load" CURVE 0xa002c9c0 _REC_A1CUR_20_u2_u2 20000. _CNV_A_R_LINEAR_____115_CM 0. 20000. FORMAT "%5.0"
 /begin AXIS_DESCR COM_AXIS Vxx_n _CNV_A_R_ENSD_LINEA_22_CM 9 0. 16383.75 READ_ONLY FORMAT "%8.2" AXIS_PTS_REF Ntb_n_amp_map_dif /end AXIS_DESCR
/end CHARACTERISTIC
/begin CHARACTERISTIC Ctp_n_kd_it_psn_thd "threshold of the throttle for atmospheric pressure recognition" CURVE 0xa002c9d4 _REC_A1CUR_20_u2_u2 100. _CNV_A_R_LINEAR_____150_CM 0. 100. FORMAT "%6.2"
 /begin AXIS_DESCR COM_AXIS Vxx_n _CNV_A_R_ENSD_LINEA_22_CM 9 0. 16383.75 READ_ONLY FORMAT "%8.2" AXIS_PTS_REF Ntb_n_kd_it_psn_thd /end AXIS_DESCR
/end CHARACTERISTIC
/begin MEASUREMENT Vbx_amp_ad_kd_it "Full opening throttle recognized for the updating of the atmospheric pressure" UBYTE _CNV_S_2_RANGE______3_CM 1 0. 0. 1. ECU_ADDRESS 0xd0006ad2 BIT_MASK 0x1 /end MEASUREMENT
/begin MEASUREMENT Vbx_amp_eng_run "Atmospheric learning strategy for running engine is activated" UBYTE _CNV_S_2_RANGE______3_CM 1 0. 0. 1. ECU_ADDRESS 0xd0006ad3 BIT_MASK 0x1 /end MEASUREMENT
/begin MEASUREMENT Vbx_amp_eng_stop "Atmospheric learning strategy for the stopped engine is activated" UBYTE _CNV_S_2_RANGE______3_CM 1 0. 0. 1. ECU_ADDRESS 0xd0006ad4 BIT_MASK 0x1 /end MEASUREMENT
/begin MEASUREMENT Vbx_amp_map_fil_ena "Manifold pressure filter is activated for atmospheric pressure learning" UBYTE _CNV_S_2_RANGE______3_CM 1 0. 0. 1. ECU_ADDRESS 0xd0006ad5 BIT_MASK 0x1 /end MEASUREMENT
/begin MEASUREMENT Vbx_amp_mem_run_eng "Engine has already run since last wake-up or reset." UBYTE _CNV_S_2_RANGE______3_CM 1 0. 0. 1. ECU_ADDRESS 0xd0006ad6 BIT_MASK 0x1 /end MEASUREMENT
/begin MEASUREMENT Vbx_amp_upd "Atmospheric pressure updating condition" UBYTE _CNV_S_2_RANGE______3_CM 1 0. 0. 1. ECU_ADDRESS 0xd0006ad7 BIT_MASK 0x1 /end MEASUREMENT
/begin MEASUREMENT Vsx_amp_vld "Atmospheric pressure validity status" UBYTE _CNV_A_R_ECME_LINEA_0_CM 1 0. 0. 3. ECU_ADDRESS 0xd0006ad8 FORMAT "%1.0" /end MEASUREMENT
/begin MEASUREMENT Vxx_amp_map "Filtered manifold pressure for atmospheric pressure learning" UWORD _CNV_A_R_LINEAR_____252_CM 1 0. 0. 2047.96875 ECU_ADDRESS 0xd00041e4 FORMAT "%10.5" /end MEASUREMENT
/begin MEASUREMENT Vxx_fil_amp "Filtered atmospheric pressure" UWORD _CNV_A_R_LINEAR_____252_CM 1 0. 0. 2047.96875 ECU_ADDRESS 0xd00041e6 FORMAT "%10.5" /end MEASUREMENT
/begin MEASUREMENT Vxx_fil_map_spg_dif1 "Internal filtered value of difference between supercharger pressure and manifold pressure" SWORD _CNV_A_R_LINEAR_____253_CM 1 0. -128. 127.99609375 ECU_ADDRESS 0xd00041e8 FORMAT "%11.6" /end MEASUREMENT
/begin MEASUREMENT Vxx_raw_amp "Raw atmospheric pressure" UWORD _CNV_A_R_LINEAR_____115_CM 1 0. 0. 20000. ECU_ADDRESS 0xd00041ea FORMAT "%5.0" /end MEASUREMENT
/begin MEASUREMENT Vxx_stal_dly "Temporising using to filter engine stalling." UWORD _CNV_A_R_LINEAR_____32_CM 1 0. 0. 655.35 ECU_ADDRESS 0xd00041ec FORMAT "%6.2" /end MEASUREMENT
/begin CHARACTERISTIC Cxx_amp_dft_val "Value by default of the atmospheric pressure in case of breakdown of the pressure sensor" VALUE 0xa0021256 _REC_S1VAL_20_u2 20000. _CNV_A_R_LINEAR_____115_CM 0. 20000. FORMAT "%5.0" /end CHARACTERISTIC
/begin CHARACTERISTIC Cxx_amp_eprm_h_thd "Upper threshold for testing the eeprom readed Amp value" VALUE 0xa0021258 _REC_S1VAL_20_u2 20000. _CNV_A_R_LINEAR_____115_CM 0. 20000. FORMAT "%5.0" /end CHARACTERISTIC
/begin CHARACTERISTIC Cxx_amp_eprm_l_thd "Lower threshold for testing the eeprom readed Amp value" VALUE 0xa002125a _REC_S1VAL_20_u2 20000. _CNV_A_R_LINEAR_____115_CM 0. 20000. FORMAT "%5.0" /end CHARACTERISTIC
/begin CHARACTERISTIC Cxx_amp_kd_dly "Tuning time between the kick down and the atmospheric pressure computation" VALUE 0xa002125c _REC_S1VAL_20_u2 65.535 _CNV_A_R_LINEAR_____116_CM 0. 65.535 FORMAT "%5.3" /end CHARACTERISTIC
/begin CHARACTERISTIC Cxx_amp_map_cge_n_thd "Threshold of Vxx_n above which we forbid the update of the atmospheric pressure" VALUE 0xa002125e _REC_S1VAL_20_u2 16383.75 _CNV_A_R_ENSD_LINEA_22_CM 0. 16383.75 FORMAT "%8.2" /end CHARACTERISTIC
/begin CHARACTERISTIC Cxx_amp_map_fil_fac "Filter factor for manifold pressure in atmospheric learning strategy" VALUE 0xa002126a _REC_S1VAL_20_u1 0.99609375 _CNV_A_R_LINEAR_____29_CM 0. 0.99609375 FORMAT "%10.8" /end CHARACTERISTIC
/begin CHARACTERISTIC Cxx_amp_spg_fil_fac "Filter factor for supercharger sensor in atmospheric learning strategy" VALUE 0xa002126b _REC_S1VAL_20_u1 0.99609375 _CNV_A_R_LINEAR_____29_CM 0. 0.99609375 FORMAT "%10.8" /end CHARACTERISTIC
/begin CHARACTERISTIC Cxx_max_map_spg_dif "Maximal value between Vxx_map and Vxx_spg (in absolute value)." VALUE 0xa0021260 _REC_S1VAL_20_u2 20000. _CNV_A_R_LINEAR_____115_CM 0. 20000. FORMAT "%5.0" /end CHARACTERISTIC
/begin CHARACTERISTIC Cxx_n_kd_it_psn_hys "hysteresis of the threshold of the throttle for atmospheric pressure recognition" VALUE 0xa0021262 _REC_S1VAL_20_u2 100. _CNV_A_R_LINEAR_____150_CM 0. 100. FORMAT "%6.2" /end CHARACTERISTIC
/begin CHARACTERISTIC Cxx_sens_dif_amp_map_thd "Stability threshold on manifold pressure to learn atmospheric pressure while engine stopped." VALUE 0xa0021264 _REC_S1VAL_20_u2 20000. _CNV_A_R_LINEAR_____115_CM 0. 20000. FORMAT "%5.0" /end CHARACTERISTIC
/begin CHARACTERISTIC Cxx_sens_dif_amp_spg_thd "Stability threshold for the interdiction of the learning of the difference between pressure sensors while engine stopped (atmospheric" VALUE 0xa0021266 _REC_S1VAL_20_u2 20000. _CNV_A_R_LINEAR_____115_CM 0. 20000. FORMAT "%5.0" /end CHARACTERISTIC
/begin CHARACTERISTIC Cxx_stal_dly "Temporising using to filter engine stalling." VALUE 0xa0021268 _REC_S1VAL_20_u2 655.35 _CNV_A_R_LINEAR_____32_CM 0. 655.35 FORMAT "%6.2" /end CHARACTERISTIC
/begin AXIS_PTS Ctb_prs "" 0xa002c9e8 Vxx_map _REC_A2AXS_20_u2 20000. _CNV_A_R_LINEAR_____115_CM 17 0. 20000. FORMAT "%5.0" /end AXIS_PTS
/begin AXIS_PTS Ctb_prs2 "9 programmable pressure breakpoint table" 0xa002ca0c Vxx_map _REC_A2AXS_20_u2 20000. _CNV_A_R_LINEAR_____115_CM 9 0. 20000. FORMAT "%5.0" /end AXIS_PTS
/begin MEASUREMENT Vxb_map.factor "" UWORD _CNV_A_R_A_105_CM 1 0. 0. 65535. ECU_ADDRESS 0xd0006ada /end MEASUREMENT
/begin MEASUREMENT Vxb_map.index "" UBYTE _CNV_A_R_A_105_CM 1 0. 0. 255. ECU_ADDRESS 0xd0006adc /end MEASUREMENT
/begin MEASUREMENT Vxb_map.num_dp "" UBYTE _CNV_A_R_A_105_CM 1 0. 0. 255. ECU_ADDRESS 0xd0006add /end MEASUREMENT
/begin MEASUREMENT Vxb_map2.factor "" UWORD _CNV_A_R_A_105_CM 1 0. 0. 65535. ECU_ADDRESS 0xd0006ade /end MEASUREMENT
/begin MEASUREMENT Vxb_map2.index "" UBYTE _CNV_A_R_A_105_CM 1 0. 0. 255. ECU_ADDRESS 0xd0006ae0 /end MEASUREMENT
/begin MEASUREMENT Vxb_map2.num_dp "" UBYTE _CNV_A_R_A_105_CM 1 0. 0. 255. ECU_ADDRESS 0xd0006ae1 /end MEASUREMENT
/begin MEASUREMENT Vbx_df_map_chr "Manifold Absolute Pressure Incoherency, not plausible detected failure" UBYTE _CNV_S_2_RANGE______3_CM 1 0. 0. 1. ECU_ADDRESS 0xd0006ae4 BIT_MASK 0x1 /end MEASUREMENT
/begin MEASUREMENT Vbx_df_map_oor "Manifold Absolute Pressure Abnormal Voltage detected failure" UBYTE _CNV_S_2_RANGE______3_CM 1 0. 0. 1. ECU_ADDRESS 0xd0006ae5 BIT_MASK 0x1 /end MEASUREMENT
/begin MEASUREMENT Vbx_diag_ena_map_chr "Manifold Absolute Pressure Incoherency diagnostic information available" UBYTE _CNV_S_2_RANGE______3_CM 1 0. 0. 1. ECU_ADDRESS 0xd0006ae6 BIT_MASK 0x1 /end MEASUREMENT
/begin MEASUREMENT Vbx_diag_ena_map_oor "Manifold Absolute Pressure Abnormal Voltage diagnostic information available" UBYTE _CNV_S_2_RANGE______3_CM 1 0. 0. 1. ECU_ADDRESS 0xd0006ae7 BIT_MASK 0x1 /end MEASUREMENT
/begin MEASUREMENT Vbx_map_chr_diag_run_dly_rst "Reset of the internal TDC counter for running coherency check on MAP" UBYTE _CNV_S_2_RANGE______3_CM 1 0. 0. 1. ECU_ADDRESS 0xd0006ae8 BIT_MASK 0x1 /end MEASUREMENT
/begin MEASUREMENT Vbx_map_chr_diag_run_ena "Running coherency considered as present since a specific number of TDC. Present coherency failure" UBYTE _CNV_S_2_RANGE______3_CM 1 0. 0. 1. ECU_ADDRESS 0xd0006ae9 BIT_MASK 0x1 /end MEASUREMENT
/begin MEASUREMENT Vbx_map_diag_oor "raw running coherency default, not yet considered as present" UBYTE _CNV_S_2_RANGE______3_CM 1 0. 0. 1. ECU_ADDRESS 0xd0006aea BIT_MASK 0x1 /end MEASUREMENT
/begin MEASUREMENT Vsx_map_vld "Manifold pressure validity status" UBYTE _CNV_A_R_ECME_LINEA_0_CM 1 0. 0. 2. ECU_ADDRESS 0xd0006ae2 FORMAT "%1.0" /end MEASUREMENT
/begin MEASUREMENT Vxx_map "Manifold pressure value " UWORD _CNV_A_R_LINEAR_____115_CM 1 0. 0. 20000. ECU_ADDRESS 0xd00041f0 FORMAT "%5.0" /end MEASUREMENT
/begin MEASUREMENT Vxx_map_chr_diag_run_dly "Internal TDC counter for coherency check on map" UBYTE _CNV_A_R_LINEAR_____101_CM 1 0. 0. 255. ECU_ADDRESS 0xd0006ae3 FORMAT "%3.0" /end MEASUREMENT
/begin MEASUREMENT Vxx_map_fil "Intake manifold filtered pressure " UWORD _CNV_A_R_LINEAR_____115_CM 1 0. 0. 20000. ECU_ADDRESS 0xd00041f2 FORMAT "%5.0" /end MEASUREMENT
/begin CHARACTERISTIC Cxx_dfdec_map_chr "Manifold Absolute Pressure Incoherency detected failure counter decrement" VALUE 0xa002126c _REC_S1VAL_20_u2 65535. _CNV_A_R_ECME_LINEA_0_CM 0. 65535. FORMAT "%5.0" /end CHARACTERISTIC
/begin CHARACTERISTIC Cxx_dfdec_map_oor "Manifold Absolute Pressure Abnormal Voltage detected failure counter decrement" VALUE 0xa002126e _REC_S1VAL_20_u2 65535. _CNV_A_R_ECME_LINEA_0_CM 0. 65535. FORMAT "%5.0" /end CHARACTERISTIC
/begin CHARACTERISTIC Cxx_dfdec_map_oor_run "Manifold Air Pressure out of range detected failure counter decrement engine running" VALUE 0xa0021270 _REC_S1VAL_20_u2 65535. _CNV_A_R_ECME_LINEA_0_CM 0. 65535. FORMAT "%5.0" /end CHARACTERISTIC
/begin CHARACTERISTIC Cxx_dfinc_map_chr "Manifold Absolute Pressure Incoherency detected failure counter increment" VALUE 0xa0021272 _REC_S1VAL_20_u2 65535. _CNV_A_R_ECME_LINEA_0_CM 0. 65535. FORMAT "%5.0" /end CHARACTERISTIC
/begin CHARACTERISTIC Cxx_dfinc_map_oor "Manifold Absolute Pressure Abnormal Voltage detected failure counter increment" VALUE 0xa0021274 _REC_S1VAL_20_u2 65535. _CNV_A_R_ECME_LINEA_0_CM 0. 65535. FORMAT "%5.0" /end CHARACTERISTIC
/begin CHARACTERISTIC Cxx_dfinc_map_oor_run "Manifold Air Pressure out of range detected failure counter increment engine running" VALUE 0xa0021276 _REC_S1VAL_20_u2 65535. _CNV_A_R_ECME_LINEA_0_CM 0. 65535. FORMAT "%5.0" /end CHARACTERISTIC
/begin CHARACTERISTIC Cxx_dif_sens_esti_map_err "Difference between Vxx_sens_map and Vxx_mdl_map  for declare a failure" VALUE 0xa0021278 _REC_S1VAL_20_u2 20000. _CNV_A_R_LINEAR_____115_CM 0. 20000. FORMAT "%5.0" /end CHARACTERISTIC
/begin CHARACTERISTIC Cxx_map_fil_ftc "Filtering time constant for Vxx_map_fil" VALUE 0xa002127a _REC_S1VAL_20_u2 65.535 _CNV_A_R_LINEAR_____116_CM 0. 65.535 /end CHARACTERISTIC
/begin CHARACTERISTIC Cxx_min_n_test_acq "regime en dessous duquel on ne teste pas la coherence des acquisitions." VALUE 0xa002127c _REC_S1VAL_20_u2 16383.75 _CNV_A_R_ENSD_LINEA_22_CM 0. 16383.75 FORMAT "%8.2" /end CHARACTERISTIC
/begin CHARACTERISTIC Cxx_nr_tdc_dif_prs_fail "Number of TDC to confirm consider the coherency default on map as present" VALUE 0xa002128a _REC_S1VAL_20_u1 255. _CNV_A_R_LINEAR_____101_CM 0. 255. FORMAT "%3.0" /end CHARACTERISTIC
/begin CHARACTERISTIC Cxx_rel_it_prs_thd_h_err "Threshold on throttle position to consider an out of range positive default" VALUE 0xa002127e _REC_S1VAL_20_u2 100. _CNV_A_R_LINEAR_____150_CM 0. 100. FORMAT "%6.2" /end CHARACTERISTIC
/begin CHARACTERISTIC Cxx_sens_map_max_dif_val "Maximum pressure difference between two consecutive acquisition to enable stopped engine oor test" VALUE 0xa0021280 _REC_S1VAL_20_u2 20000. _CNV_A_R_LINEAR_____115_CM 0. 20000. FORMAT "%5.0" /end CHARACTERISTIC
/begin CHARACTERISTIC Cxx_sens_map_run_eng_h_thd "Maximum threshold for out of range manifold air pressure testing" VALUE 0xa0021282 _REC_S1VAL_20_u2 20000. _CNV_A_R_LINEAR_____115_CM 0. 20000. FORMAT "%5.0" /end CHARACTERISTIC
/begin CHARACTERISTIC Cxx_sens_map_run_eng_l_thd "Minimum threshold for out of range manifold air pressure testing" VALUE 0xa0021284 _REC_S1VAL_20_u2 20000. _CNV_A_R_LINEAR_____115_CM 0. 20000. FORMAT "%5.0" /end CHARACTERISTIC
/begin CHARACTERISTIC Cxx_sens_map_stop_eng_h_thd "Maximum manifold pressure value for stopped engine oor test" VALUE 0xa0021286 _REC_S1VAL_20_u2 20000. _CNV_A_R_LINEAR_____115_CM 0. 20000. FORMAT "%5.0" /end CHARACTERISTIC
/begin CHARACTERISTIC Cxx_sens_map_stop_eng_l_thd "Minimum manifold pressure value for stopped engine oor test" VALUE 0xa0021288 _REC_S1VAL_20_u2 20000. _CNV_A_R_LINEAR_____115_CM 0. 20000. FORMAT "%5.0" /end CHARACTERISTIC
/begin AXIS_PTS Ctb_pred_map_prs_rat "Breakpoints on Pcol/Pamont variable to get Barré St Venant definition" 0xa002ca20 Vxx_raw_mdl_map_spg_rat _REC_A2AXS_20_u2 1.99996948242188 _CNV_A_R_LINEAR_____48_CM 10 0. 1.99996948242188 FORMAT "%7.5" /end AXIS_PTS
/begin AXIS_PTS Ctb_psi_fac_cor "breakpoints on (x/fbsv(x))-1 function" 0xa002ca38 Vxx_temp2[0] _REC_A2AXS_20_u2 16383.75 _CNV_A_R_LINEAR_____254_CM 17 0. 16383.75 FORMAT "%8.2" /end AXIS_PTS
/begin CHARACTERISTIC Ctd_ofs_psi_fac "zero ordinate of the segment of Barré St Venant function (function of Pcol/Pamont)" CURVE 0xa002ca5c _REC_A1CUR_20_u2_u2 0.99998474 _CNV_A_R_LINEAR_____255_CM 0. 0.99998474 FORMAT "%10.8"
 /begin AXIS_DESCR COM_AXIS Vxx_raw_mdl_map_spg_rat _CNV_A_R_LINEAR_____48_CM 10 0. 1.99996948242188 FORMAT "%7.5" AXIS_PTS_REF Ctb_pred_map_prs_rat /end AXIS_DESCR
/end CHARACTERISTIC
/begin CHARACTERISTIC Ctd_slop_psi_fac "slope of the segment of Barré St Venant function (function de Pcol/Pamont)" CURVE 0xa002ca70 _REC_A1CUR_20_u2_u2 0.9999847412109381 _CNV_A_R_LINEAR_____256_CM -0.9999847412109381 0. FORMAT "%10.8"
 /begin AXIS_DESCR COM_AXIS Vxx_raw_mdl_map_spg_rat _CNV_A_R_LINEAR_____48_CM 10 0. 1.99996948242188 FORMAT "%7.5" AXIS_PTS_REF Ctb_pred_map_prs_rat /end AXIS_DESCR
/end CHARACTERISTIC
/begin CHARACTERISTIC Ctp_cp_load_map_fac_cor "Correction of Cfe_value according to the gas charge in the canister purge for manifold pressure" CURVE 0xa002ca84 _REC_A1CUR_20_u1_u2 3.984375 _CNV_A_R_LINEAR_____83_CM 0. 3.984375 FORMAT "%8.6"
 /begin AXIS_DESCR COM_AXIS Vxx_cp_rich_cor _CNV_A_R_LINEAR_____50_CM 9 0. 0.666656494140625 READ_ONLY FORMAT "%8.7" AXIS_PTS_REF Ntb_1_9 /end AXIS_DESCR
/end CHARACTERISTIC
/begin CHARACTERISTIC Ctp_ftc_mdl_map "Table of filter time constant for the modelled manifold pressure" CURVE 0xa002ca90 _REC_A1CUR_20_u2_u2 65.535 _CNV_A_R_LINEAR_____116_CM 0. 65.535 FORMAT "%5.3"
 /begin AXIS_DESCR COM_AXIS Vxx_n _CNV_A_R_ENSD_LINEA_22_CM 20 0. 16383.75 FORMAT "%8.2" AXIS_PTS_REF Ctb_n /end AXIS_DESCR
/end CHARACTERISTIC
/begin CHARACTERISTIC Ctp_pred_map_prs_rat "x value of (x/fbsv(x))-1 function" CURVE 0xa002cab8 _REC_A1CUR_20_u2_u2 0.99998474 _CNV_A_R_LINEAR_____257_CM 0. 0.99998474 FORMAT "%10.8"
 /begin AXIS_DESCR COM_AXIS Vxx_temp2[0] _CNV_A_R_LINEAR_____254_CM 17 0. 16383.75 FORMAT "%8.2" AXIS_PTS_REF Ctb_psi_fac_cor /end AXIS_DESCR
/end CHARACTERISTIC
/begin MEASUREMENT Vbx_pred_map_psi_fac_cor "activation boolean for correction of Barré St Venant function" UBYTE _CNV_S_2_RANGE______3_CM 1 0. 0. 1. ECU_ADDRESS 0xd0006aed BIT_MASK 0x1 /end MEASUREMENT
/begin MEASUREMENT Vsx_mdl_map_vld "Manifold pressure from model validity status" UBYTE _CNV_S_3_STATUS_OK__179_CM 1 0. 0. 2. ECU_ADDRESS 0xd0006aee /end MEASUREMENT
/begin MEASUREMENT Vxx_fil_pred_map_efv_it_ar "effective throttle area filtered" UWORD _CNV_A_R_LINEAR_____144_CM 1 0. 0. 3.90619e-003 ECU_ADDRESS 0xd00041f6 FORMAT "%11.9" /end MEASUREMENT
/begin MEASUREMENT Vxx_fill_efy_n_mpl "product (volumetric efficiency X engine speed)" UWORD _CNV_A_R_ENSD_LINEA_22_CM 1 0. 0. 16383.75 ECU_ADDRESS 0xd00041f8 FORMAT "%8.2" /end MEASUREMENT
/begin MEASUREMENT Vxx_mdl_map "Manifold pressure value from model" UWORD _CNV_A_R_LINEAR_____115_CM 1 0. 0. 20000. ECU_ADDRESS 0xd00041fa FORMAT "%5.0" /end MEASUREMENT
/begin MEASUREMENT Vxx_mdl_map_fac_1 "Internal constant factor 1 for modelled manifold pressure" UWORD _CNV_A_R_LINEAR_____258_CM 1 0. 5000000. 44999389.648438 ECU_ADDRESS 0xd0005e9c FORMAT "%15.5" /end MEASUREMENT
/begin MEASUREMENT Vxx_mdl_map_fac_2 "Internal constant factor 2 for modelled manifold pressure" UWORD _CNV_A_R_LINEAR_____259_CM 1 0. 0. 599990.8447 ECU_ADDRESS 0xd0005e9e FORMAT "%11.5" /end MEASUREMENT
/begin MEASUREMENT Vxx_mdl_map_fil "Manifold pressure value from model filtered value" UWORD _CNV_A_R_LINEAR_____115_CM 1 0. 0. 20000. ECU_ADDRESS 0xd00041fc FORMAT "%5.0" /end MEASUREMENT
/begin MEASUREMENT Vxx_mdl_map_spg_rat "ratio (modelled manifold pressure / up stream pressure)" UWORD _CNV_A_R_LINEAR_____257_CM 1 0. 0. 0.99998474 ECU_ADDRESS 0xd00041fe FORMAT "%10.8" /end MEASUREMENT
/begin MEASUREMENT Vxx_mfld_fil_fac "filter constant of manifold model" UWORD _CNV_A_R_LINEAR_____260_CM 1 0. 0. 511.99 ECU_ADDRESS 0xd0004200 FORMAT "%11.7" /end MEASUREMENT
/begin MEASUREMENT Vxx_min_map_spg_rat "ratio (minimum manifold pressure / up stream pressure)" UWORD _CNV_A_R_LINEAR_____261_CM 1 0. 0. 0.49999237 ECU_ADDRESS 0xd0004202 FORMAT "%10.8" /end MEASUREMENT
/begin MEASUREMENT Vxx_pred_map_cp_maf_fac "canister scaling factor between engine and throttle mass air flow for manifold model" UWORD _CNV_A_R_LINEAR_____262_CM 1 0. 0. 4095.9375 ECU_ADDRESS 0xd0004204 FORMAT "%9.4" /end MEASUREMENT
/begin MEASUREMENT Vxx_pred_map_cp_psi_fac "Canister Barré St Venant factor (used in throttle mass air flow calculation)" UWORD _CNV_A_R_LINEAR_____263_CM 1 0. 0. 6.24990463256836e-002 ECU_ADDRESS 0xd0004206 FORMAT "%10.8" /end MEASUREMENT
/begin MEASUREMENT Vxx_pred_map_cp_psi_fac_ofs "canister purge zero ordinate of the segment of Barré St Venant function (function of Pcol/Pamont)" UWORD _CNV_A_R_LINEAR_____255_CM 1 0. 0. 0.99998474 ECU_ADDRESS 0xd0004208 FORMAT "%10.8" /end MEASUREMENT
/begin MEASUREMENT Vxx_pred_map_cp_psi_fac_slop "canister purge slope of the segment of Barré St Venant function (function of Pcol/Pamont)" UWORD _CNV_A_R_LINEAR_____256_CM 1 0. -0.9999847412109381 0. ECU_ADDRESS 0xd000420a FORMAT "%10.8" /end MEASUREMENT
/begin MEASUREMENT Vxx_pred_map_it_maf_fac "Scaling factor between engine and throttle mass air flow for manifold model" UWORD _CNV_A_R_LINEAR_____262_CM 1 0. 0. 4095.9375 ECU_ADDRESS 0xd000420c FORMAT "%9.4" /end MEASUREMENT
/begin MEASUREMENT Vxx_pred_map_mdl_eng_maf "Modelled engine air mass flow" UWORD _CNV_A_R_LINEAR_____172_CM 1 0. 0. 3000. ECU_ADDRESS 0xd000420e FORMAT "%4.3" /end MEASUREMENT
/begin MEASUREMENT Vxx_pred_map_mdl_it_maf "Modelled throttle air mass flow" UWORD _CNV_A_R_LINEAR_____172_CM 1 0. 0. 3000. ECU_ADDRESS 0xd0004210 FORMAT "%4.3" /end MEASUREMENT
/begin MEASUREMENT Vxx_pred_map_psi_fac "Throttle Barré St Venant factor (used in throttle mass air flow calculation)" UWORD _CNV_A_R_LINEAR_____263_CM 1 0. 0. 6.24990463256836e-002 ECU_ADDRESS 0xd0004212 FORMAT "%10.8" /end MEASUREMENT
/begin MEASUREMENT Vxx_pred_map_psi_fac_ofs "zero ordinate of the segment of Barré St Venant function (function of Pcol/Pamont)" UWORD _CNV_A_R_LINEAR_____255_CM 1 0. 0. 0.99998474 ECU_ADDRESS 0xd0004214 FORMAT "%10.8" /end MEASUREMENT
/begin MEASUREMENT Vxx_pred_map_psi_fac_slop "slope of the segment of Barré St Venant function (function of Pcol/Pamont)" UWORD _CNV_A_R_LINEAR_____256_CM 1 0. -0.9999847412109381 0. ECU_ADDRESS 0xd0004216 FORMAT "%10.8" /end MEASUREMENT
/begin MEASUREMENT Vxx_raw_mdl_map "Raw modelled manifold pressure" UWORD _CNV_A_R_LINEAR_____115_CM 1 0. 0. 20000. ECU_ADDRESS 0xd0004218 FORMAT "%5.0" /end MEASUREMENT
/begin MEASUREMENT Vxx_raw_mdl_map_spg_rat "rough value of modelled ratio (manifold pressure / up stream pressure) (before correction)" UWORD _CNV_A_R_LINEAR_____48_CM 1 0. 0. 1.99996948242188 ECU_ADDRESS 0xd000421a FORMAT "%7.5" /end MEASUREMENT
/begin MEASUREMENT Vxx_spg_amp_rat "Ratio between pressure before throttle and atmospheric pressure" UWORD _CNV_A_R_LINEAR_____264_CM 1 0. 0. 6.5535 ECU_ADDRESS 0xd000421c FORMAT "%6.4" /end MEASUREMENT
/begin MEASUREMENT Vxx_temp0[0] "Input vector 1" UWORD _CNV_A_R_LINEAR_____48_CM 1 0. 0. 1.99996948242188 ECU_ADDRESS 0xd000421e FORMAT "%7.5" /end MEASUREMENT
/begin MEASUREMENT Vxx_temp0[1] "Input vector 1" UWORD _CNV_A_R_LINEAR_____48_CM 1 0. 0. 1.99996948242188 ECU_ADDRESS 0xd0004220 FORMAT "%7.5" /end MEASUREMENT
/begin MEASUREMENT Vxx_temp1[0] "Input vector 2" UWORD _CNV_A_R_LINEAR_____48_CM 1 0. 0. 1.99996948242188 ECU_ADDRESS 0xd0004222 FORMAT "%7.5" /end MEASUREMENT
/begin MEASUREMENT Vxx_temp1[1] "Input vector 2" UWORD _CNV_A_R_LINEAR_____48_CM 1 0. 0. 1.99996948242188 ECU_ADDRESS 0xd0004224 FORMAT "%7.5" /end MEASUREMENT
/begin MEASUREMENT Vxx_temp2[0] "Input vector 3" UWORD _CNV_A_R_LINEAR_____254_CM 1 0. 0. 16383.75 ECU_ADDRESS 0xd0004226 FORMAT "%8.2" /end MEASUREMENT
/begin MEASUREMENT Vxx_temp2[1] "Input vector 3" UWORD _CNV_A_R_LINEAR_____254_CM 1 0. 0. 16383.75 ECU_ADDRESS 0xd0004228 FORMAT "%8.2" /end MEASUREMENT
/begin CHARACTERISTIC Cxx_it_ar_max_slop "maximum slew rate of throttle effective area" VALUE 0xa002128c _REC_S1VAL_20_u2 3.90619e-003 _CNV_A_R_LINEAR_____144_CM 0. 3.90619e-003 FORMAT "%11.9" /end CHARACTERISTIC
/begin CHARACTERISTIC Cxx_last_bkp_prs_rat "before last breakpoint of Barré St Venant definition : abscisse of the begining of correction" VALUE 0xa002128e _REC_S1VAL_20_u2 1.99996948242188 _CNV_A_R_LINEAR_____48_CM 0. 1.99996948242188 FORMAT "%7.5" /end CHARACTERISTIC
/begin CHARACTERISTIC Cxx_map_mv_ftc "Filtering time constant for the modelled manifold pressure" VALUE 0xa0021290 _REC_S1VAL_20_u2 65.535 _CNV_A_R_LINEAR_____116_CM 0. 65.535 FORMAT "%5.3" /end CHARACTERISTIC
/begin CHARACTERISTIC Cxx_pred_map_max_prs_rat "maximmum of Pcol/Pamont ratio for getting in Barré St Venant table" VALUE 0xa0021292 _REC_S1VAL_20_u2 1.99996948242188 _CNV_A_R_LINEAR_____48_CM 0. 1.99996948242188 FORMAT "%7.5" /end CHARACTERISTIC
/begin CHARACTERISTIC Cxx_tdc_per_fac "Nbr_of_cylinder / Rev_per_cycle / 60" VALUE 0xa0021294 _REC_S1VAL_20_u1 4.17e-002 _CNV_A_R_LINEAR_____265_CM 8.3e-003 5.e-002 FORMAT "%6.4" /end CHARACTERISTIC
/begin MEASUREMENT Vbx_acel_pdl_fil_sens_v1 "Accelerator pedal sensor track 1 evolution condition" UBYTE _CNV_S_2_RANGE______3_CM 1 0. 0. 1. ECU_ADDRESS 0xd0006bc8 BIT_MASK 0x1 /end MEASUREMENT
/begin MEASUREMENT Vbx_acel_pdl_fil_sens_v2 "Accelerator pedal sensor track 1 evolution condition" UBYTE _CNV_S_2_RANGE______3_CM 1 0. 0. 1. ECU_ADDRESS 0xd0006bc9 BIT_MASK 0x1 /end MEASUREMENT
/begin MEASUREMENT Vxx_acel_pdl_fil_sens_v1 "filtered accelerator pedal sensor output voltage: track 1" UWORD _CNV_A_R_LINEAR_____266_CM 1 0. 0. 1. ECU_ADDRESS 0xd000437c FORMAT "%9.7" /end MEASUREMENT
/begin MEASUREMENT Vxx_acel_pdl_fil_sens_v2 "filtered accelerator pedal sensor output voltage: track 2" UWORD _CNV_A_R_LINEAR_____266_CM 1 0. 0. 1. ECU_ADDRESS 0xd000437e FORMAT "%9.7" /end MEASUREMENT
/begin MEASUREMENT Vxx_acel_pdl_sens_rat1 "Accelerator pedal sensor output voltage ratio : track 1" UWORD _CNV_A_R_LINEAR_____266_CM 1 0. 0. 1. ECU_ADDRESS 0xd0004380 FORMAT "%9.7" /end MEASUREMENT
/begin MEASUREMENT Vxx_acel_pdl_sens_rat2 "Accelerator pedal sensor output voltage ratio : track 2" UWORD _CNV_A_R_LINEAR_____266_CM 1 0. 0. 1. ECU_ADDRESS 0xd0004382 FORMAT "%9.7" /end MEASUREMENT
/begin CHARACTERISTIC Cxx_acel_pdl_sens_pws "Accelerator pedal sensor power supply" VALUE 0xa002153c _REC_S1VAL_20_u2 25000. _CNV_A_R_LINEAR_____107_CM 0. 25000. FORMAT "%5.0" /end CHARACTERISTIC
/begin CHARACTERISTIC Cxx_acel_pdl_stab_thd "Accelerator pedal signal stabilization threshold" VALUE 0xa002153e _REC_S1VAL_20_u2 1. _CNV_A_R_LINEAR_____266_CM 0. 1. FORMAT "%9.7" /end CHARACTERISTIC
/begin AXIS_PTS Ctb_n "20 programmable engine speed breakpoints map" 0xa002db74 Vxx_n _REC_A2AXS_20_u2 16383.75 _CNV_A_R_ENSD_LINEA_22_CM 20 0. 16383.75 FORMAT "%8.2" /end AXIS_PTS
/begin AXIS_PTS Ctb_n2 "9 programmable engine speed breakpoints table" 0xa002dba0 Vxx_n _REC_A2AXS_20_u2 16383.75 _CNV_A_R_ENSD_LINEA_22_CM 9 0. 16383.75 FORMAT "%8.2" /end AXIS_PTS
/begin AXIS_PTS Ctb_toil "engine oil temperature breakpoints" 0xa002d4e4 Vxx_toil _REC_A2AXS_20_u2 240. _CNV_A_R_LINEAR_____110_CM 16 -40. 200. FORMAT "%5.1" /end AXIS_PTS
/begin MEASUREMENT Vsx_toil_vld "Oil temperature validity status" UBYTE _CNV_S_3_STATUS_OK__179_CM 1 0. 0. 2. ECU_ADDRESS 0xd0007bc5 /end MEASUREMENT
/begin MEASUREMENT Vxx_toil "Oil temperature" UWORD _CNV_A_R_LINEAR_____110_CM 1 0. -40. 200. ECU_ADDRESS 0xd0005ef6 FORMAT "%5.1" /end MEASUREMENT
/begin CHARACTERISTIC Cxx_mdl_toil_fail "Default value in case of mtl toil failure" VALUE 0xa00214a2 _REC_S1VAL_20_u2 240. _CNV_A_R_LINEAR_____110_CM -40. 200. FORMAT "%5.1" /end CHARACTERISTIC
/begin AXIS_PTS Ctb_n4 "Engine speed  breakpoints for oil temperature computing" 0xa002d508 Vxx_n _REC_A2AXS_20_u2 16383.75 _CNV_A_R_ENSD_LINEA_22_CM 6 0. 16383.75 FORMAT "%8.2" /end AXIS_PTS
/begin AXIS_PTS Ctb_tco_dif "Table of Delta between water temp. and  reference  water temp. in running conditions (near 92 °c)" 0xa002d518 Vxx_tco_dif _REC_A2AXS_20_u2 240. _CNV_A_R_LINEAR_____110_CM 17 -40. 200. FORMAT "%5.1" /end AXIS_PTS
/begin AXIS_PTS Ctb_tqi_rat "Indicated torque ratio breakpoints table" 0xa002d53c Vxx_tqi_rat_tgt _REC_A2AXS_20_u2 1. _CNV_A_R_LINEAR_____183_CM 6 0. 1. FORMAT "%11.9" /end AXIS_PTS
/begin CHARACTERISTIC Cmp_n_toil "Map of oil temperature in stabilised and standard conditions [90-92'C]" MAP 0xa002d54c _REC_A1MAP_20_u2_u2_u2 240. _CNV_A_R_LINEAR_____110_CM -40. 200. FORMAT "%5.1"
 /begin AXIS_DESCR COM_AXIS Vxx_tqi_rat_tgt _CNV_A_R_LINEAR_____183_CM 6 0. 1. FORMAT "%11.9" AXIS_PTS_REF Ctb_tqi_rat /end AXIS_DESCR
 /begin AXIS_DESCR COM_AXIS Vxx_n _CNV_A_R_ENSD_LINEA_22_CM 6 0. 16383.75 FORMAT "%8.2" AXIS_PTS_REF Ctb_n4 /end AXIS_DESCR
/end CHARACTERISTIC
/begin CHARACTERISTIC Ctp_tco_toil_ofs "Table of corrective terms for basic oil temerature computing" CURVE 0xa002d594 _REC_A1CUR_20_u2_u2 2400. _CNV_A_R_LINEAR_____307_CM -1200. 1200. FORMAT "%7.1"
 /begin AXIS_DESCR COM_AXIS Vxx_tco_dif _CNV_A_R_LINEAR_____110_CM 17 -40. 200. FORMAT "%5.1" AXIS_PTS_REF Ctb_tco_dif /end AXIS_DESCR
/end CHARACTERISTIC
/begin CHARACTERISTIC Ctp_toil_fil "Map of filtering coefficients for dynamic oil temperature computing  in engine running conditions" CURVE 0xa002d5b8 _REC_A1CUR_20_u2_u2 100. _CNV_A_R_LINEAR_____159_CM 0. 100. FORMAT "%12.8"
 /begin AXIS_DESCR COM_AXIS Vxx_n _CNV_A_R_ENSD_LINEA_22_CM 6 0. 16383.75 FORMAT "%8.2" AXIS_PTS_REF Ctb_n4 /end AXIS_DESCR
/end CHARACTERISTIC
/begin MEASUREMENT Vbx_toil_pws "Boolean used to ask ECU electrical supply for oil temperature computing" UBYTE _CNV_S_2_RANGE______3_CM 1 0. 0. 1. ECU_ADDRESS 0xd0007bc8 BIT_MASK 0x1 /end MEASUREMENT
/begin MEASUREMENT Vsx_mdl_toil_vld "Modelised oil temperature validity status" UBYTE _CNV_S_3_STATUS_OK__179_CM 1 0. 0. 2. ECU_ADDRESS 0xd0007bc9 /end MEASUREMENT
/begin MEASUREMENT Vxx_mdl_toil "Modelised oil temperature" UWORD _CNV_A_R_LINEAR_____110_CM 1 0. -40. 200. ECU_ADDRESS 0xd0005efa FORMAT "%5.1" /end MEASUREMENT
/begin MEASUREMENT Vxx_stab_toil "Oil temperature in stabilised conditions" UWORD _CNV_A_R_LINEAR_____110_CM 1 0. -40. 200. ECU_ADDRESS 0xd0005efc FORMAT "%5.1" /end MEASUREMENT
/begin MEASUREMENT Vxx_tco_dif "Delta between water temperature and reference water temperature in running conditions." UWORD _CNV_A_R_LINEAR_____110_CM 1 0. -40. 200. ECU_ADDRESS 0xd0005efe FORMAT "%5.1" /end MEASUREMENT
/begin MEASUREMENT Vxx_tco_fil "Filtered coolant temperature for oil temperature computing" UWORD _CNV_A_R_LINEAR_____110_CM 1 0. -40. 200. ECU_ADDRESS 0xd0005f00 FORMAT "%5.1" /end MEASUREMENT
/begin MEASUREMENT Vxx_toil_pws_max_dly "Remaining duration after engine stall of maintain of the calculation of the oil temperature." UWORD _CNV_A_R_LINEAR_____58_CM 1 0. 0. 6553.5 ECU_ADDRESS 0xd0005f02 FORMAT "%6.1" /end MEASUREMENT
/begin CHARACTERISTIC Cxx_stop_toil_fil "Filtering coefficient for oil temperature computing in engine stop running conditions" VALUE 0xa00214a4 _REC_S1VAL_20_u2 100. _CNV_A_R_LINEAR_____159_CM 0. 100. FORMAT "%12.8" /end CHARACTERISTIC
/begin CHARACTERISTIC Cxx_tco_toil_fil "Filtering coefficient for water temperature." VALUE 0xa00214a6 _REC_S1VAL_20_u2 100. _CNV_A_R_LINEAR_____159_CM 0. 100. FORMAT "%12.8" /end CHARACTERISTIC
/begin CHARACTERISTIC Cxx_tco_toil_thd "Reference water temperature in usual running conditions for oil temperature computing" VALUE 0xa00214a8 _REC_S1VAL_20_u2 240. _CNV_A_R_LINEAR_____110_CM -40. 200. FORMAT "%5.1" /end CHARACTERISTIC
/begin CHARACTERISTIC Cxx_toil_pws_max_dly "Maximum duration after engine stall of maintain of the calculation of the oil temperature." VALUE 0xa00214aa _REC_S1VAL_20_u2 6553.5 _CNV_A_R_LINEAR_____58_CM 0. 6553.5 FORMAT "%6.1" /end CHARACTERISTIC
/begin CHARACTERISTIC Cxx_toil_tco_cnt "Water temp minus Oil temperature value for 'power-latch' maintenance" VALUE 0xa00214ac _REC_S1VAL_20_u2 240. _CNV_A_R_LINEAR_____110_CM -40. 200. FORMAT "%5.1" /end CHARACTERISTIC
/begin CHARACTERISTIC Cxx_tqi_rat_cut_thd "Threshold of indicated torque ratio used for the filtering of the oil temperature model" VALUE 0xa00214ae _REC_S1VAL_20_u2 1. _CNV_A_R_LINEAR_____183_CM 0. 1. FORMAT "%11.9" /end CHARACTERISTIC
/begin MEASUREMENT Vsx_sens_toil_vld "Oil temperature analog sensor validity status" UBYTE _CNV_S_3_STATUS_OK__179_CM 1 0. 0. 2. ECU_ADDRESS 0xd0007bc4 /end MEASUREMENT
/begin MEASUREMENT Vxx_sens_toil "Oil temperature from sensor" UWORD _CNV_A_R_LINEAR_____110_CM 1 0. -40. 200. ECU_ADDRESS 0xd0005ef4 FORMAT "%5.1" /end MEASUREMENT
/begin MEASUREMENT Vbx_owe_ini_req_ok "Initialisation request (manual or after sale department) accepted" UBYTE _CNV_S_2_RANGE______3_CM 1 0. 0. 1. ECU_ADDRESS 0xd0007bc1 BIT_MASK 0x1 /end MEASUREMENT
/begin MEASUREMENT Vbx_owe_mnl_ini_req_ok "Manual initialisation request accepted" UBYTE _CNV_S_2_RANGE______3_CM 1 0. 0. 1. ECU_ADDRESS 0xd0007bc2 BIT_MASK 0x1 /end MEASUREMENT
/begin CHARACTERISTIC Cbx_owe_mnl_ini_req_ena "Calibration to forbid the use of manual init by pedals (to use the can information)" VALUE 0xa00214a0 _REC_S1VAL_20_u1 1. _CNV_S_2_RANGE______3_CM 0. 1. BIT_MASK 0x1 /end CHARACTERISTIC
/begin MEASUREMENT Sxx_owe_st3 "State of the third scheduler" UBYTE _CNV_A_R_ECME_LINEA_0_CM 1 0. 0. 20. ECU_ADDRESS 0xd0007bbc FORMAT "%2.0" /end MEASUREMENT
/begin MEASUREMENT Sxx_owe_st4 "State of the fourth scheduler" UBYTE _CNV_A_R_ECME_LINEA_0_CM 1 0. 0. 20. ECU_ADDRESS 0xd0007bbd FORMAT "%2.0" /end MEASUREMENT
/begin MEASUREMENT Vbx_brk "State of the break switch ( 1 if pushed)" UBYTE _CNV_S_2_RANGE______3_CM 1 0. 0. 1. ECU_ADDRESS 0xd0007bbe BIT_MASK 0x1 /end MEASUREMENT
/begin MEASUREMENT Vbx_owe_igk_on_igk_off "Rising edge of the ignition key" UBYTE _CNV_S_2_RANGE______3_CM 1 0. 0. 1. ECU_ADDRESS 0xd0007bbf BIT_MASK 0x1 /end MEASUREMENT
/begin MEASUREMENT Vbx_owe_mnl_ini_req "Manual initialisation request" UBYTE _CNV_S_2_RANGE______3_CM 1 0. 0. 1. ECU_ADDRESS 0xd0007bc0 BIT_MASK 0x1 /end MEASUREMENT
/begin MEASUREMENT Vxx_owe_ctr4 "Value of the fourth counter" UWORD _CNV_A_R_ECME_LINEA_0_CM 1 0. 0. 65535. ECU_ADDRESS 0xd0005ef0 FORMAT "%5.0" /end MEASUREMENT
/begin MEASUREMENT Vxx_owe_ctr5 "Value of the fifth counter" UWORD _CNV_A_R_ECME_LINEA_0_CM 1 0. 0. 65535. ECU_ADDRESS 0xd0005ef2 FORMAT "%5.0" /end MEASUREMENT
/begin CHARACTERISTIC Cxx_owe_ctr4 "Counter 4 threshold calibration" VALUE 0xa0021498 _REC_S1VAL_20_u2 65535. _CNV_A_R_ECME_LINEA_0_CM 0. 65535. FORMAT "%5.0" /end CHARACTERISTIC
/begin CHARACTERISTIC Cxx_owe_ctr5 "Counter 5 threshold calibration" VALUE 0xa002149a _REC_S1VAL_20_u2 65535. _CNV_A_R_ECME_LINEA_0_CM 0. 65535. FORMAT "%5.0" /end CHARACTERISTIC
/begin CHARACTERISTIC Cxx_owe_n "Engine speed threshold to go out of the manual reset strategy condition" VALUE 0xa002149c _REC_S1VAL_20_u2 6000. _CNV_A_R_LINEAR_____19_CM 0. 6000. FORMAT "%4.0" /end CHARACTERISTIC
/begin CHARACTERISTIC Cxx_owe_pdl_thd "Accelerator pedal threshold for the manual reset strategy" VALUE 0xa002149e _REC_S1VAL_20_u2 1.25 _CNV_A_R_LINEAR_____267_CM 0. 1.25 FORMAT "%7.5" /end CHARACTERISTIC
/begin MEASUREMENT Vbx_owe_cfm "OCS inhibition variable" UBYTE _CNV_S_2_RANGE______3_CM 1 0. 0. 1. ECU_ADDRESS 0xd0007bc3 BIT_MASK 0x1 /end MEASUREMENT
/begin CHARACTERISTIC Cbx_owe_cfm "OCS inhibition parameter" VALUE 0xa00214a1 _REC_S1VAL_20_u1 1. _CNV_S_2_RANGE______3_CM 0. 1. BIT_MASK 0x1 /end CHARACTERISTIC
/begin COMPU_METHOD _CNV_A_R_ECME_LINEA_0_CM "" RAT_FUNC "%6.3" "-" COEFFS 0 1. 0. 0 0 1 /end COMPU_METHOD
/begin COMPU_METHOD _CNV_S_2_RANGE______3_CM "" TAB_VERB "%6.3" "-" COMPU_TAB_REF _CNV_S_2_RANGE______3 /end COMPU_METHOD
/begin COMPU_VTAB _CNV_S_2_RANGE______3 "" TAB_VERB 2 0 "0" 1 "1" /end COMPU_VTAB
/begin COMPU_METHOD _CNV_A_R_LINEAR_____19_CM "" RAT_FUNC "%6.3" "rpm" COEFFS 0 1. 0. 0 0 1 /end COMPU_METHOD
/begin COMPU_METHOD _CNV_A_R_ENSD_LINEA_22_CM "" RAT_FUNC "%6.3" "rpm" COEFFS 0 4. 0. 0 0 1 /end COMPU_METHOD
/begin COMPU_METHOD _CNV_A_R_LINEAR_____29_CM "" RAT_FUNC "%6.3" "-" COEFFS 0 256. 0. 0 0 1 /end COMPU_METHOD
/begin COMPU_METHOD _CNV_A_R_LINEAR_____32_CM "" RAT_FUNC "%6.3" "s" COEFFS 0 100. 0. 0 0 1 /end COMPU_METHOD
/begin COMPU_METHOD _CNV_A_R_LINEAR_____42_CM "" RAT_FUNC "%6.3" "-" COEFFS 0 128. 0. 0 0 1 /end COMPU_METHOD
/begin COMPU_METHOD _CNV_A_R_LINEAR_____48_CM "" RAT_FUNC "%6.3" "-" COEFFS 0 32767.99999999992 0. 0 0 1 /end COMPU_METHOD
/begin COMPU_METHOD _CNV_A_R_LINEAR_____49_CM "" RAT_FUNC "%6.3" "m²" COEFFS 0 268432047.1860408 0. 0 0 1 /end COMPU_METHOD
/begin COMPU_METHOD _CNV_A_R_LINEAR_____50_CM "" RAT_FUNC "%6.3" "-" COEFFS 0 98304. 0. 0 0 1 /end COMPU_METHOD
/begin COMPU_METHOD _CNV_A_R_LINEAR_____53_CM "" RAT_FUNC "%6.3" "-" COEFFS 0 16384. 0. 0 0 1 /end COMPU_METHOD
/begin COMPU_METHOD _CNV_A_R_LINEAR_____58_CM "" RAT_FUNC "%6.3" "s" COEFFS 0 10. 0. 0 0 1 /end COMPU_METHOD
/begin COMPU_METHOD _CNV_A_R_LINEAR_____83_CM "" RAT_FUNC "%6.3" "-" COEFFS 0 64. 0. 0 0 1 /end COMPU_METHOD
/begin COMPU_METHOD _CNV_A_R_LINEAR_____88_CM "" RAT_FUNC "%6.3" "-" COEFFS 0 8192. 0. 0 0 1 /end COMPU_METHOD
/begin COMPU_METHOD _CNV_A_R_LINEAR_____101_CM "" RAT_FUNC "%6.3" "TDC" COEFFS 0 1. 0. 0 0 1 /end COMPU_METHOD
/begin COMPU_METHOD _CNV_A_R_A_105_CM "" RAT_FUNC "%6.3" "" COEFFS 0 1. 0. 0 0 1 /end COMPU_METHOD
/begin COMPU_METHOD _CNV_A_R_LINEAR_____107_CM "" RAT_FUNC "%6.3" "mV" COEFFS 0 1. 0. 0 0 1 /end COMPU_METHOD
/begin COMPU_METHOD _CNV_A_R_LINEAR_____110_CM "" RAT_FUNC "%6.3" "°C" COEFFS 0 10. 400. 0 0 1 /end COMPU_METHOD
/begin COMPU_METHOD _CNV_A_R_LINEAR_____114_CM "" RAT_FUNC "%6.3" "mg" COEFFS 0 10. 0. 0 0 1 /end COMPU_METHOD
/begin COMPU_METHOD _CNV_A_R_LINEAR_____115_CM "" RAT_FUNC "%6.3" "hPa" COEFFS 0 1. 0. 0 0 1 /end COMPU_METHOD
/begin COMPU_METHOD _CNV_A_R_LINEAR_____116_CM "" RAT_FUNC "%6.3" "s" COEFFS 0 1000. 0. 0 0 1 /end COMPU_METHOD
/begin COMPU_METHOD _CNV_A_R_LINEAR_____125_CM "" RAT_FUNC "%6.3" "km/h" COEFFS 0 100. 0. 0 0 1 /end COMPU_METHOD
/begin COMPU_METHOD _CNV_A_R_LINEAR_____133_CM "" RAT_FUNC "%6.3" "mg/stk" COEFFS 0 390.625 0. 0 0 1 /end COMPU_METHOD
/begin COMPU_METHOD _CNV_A_R_LINEAR_____144_CM "" RAT_FUNC "%6.3" "m²" COEFFS 0 16777217.69806384 0. 0 0 1 /end COMPU_METHOD
/begin COMPU_METHOD _CNV_A_R_LINEAR_____146_CM "" RAT_FUNC "%6.3" "%" COEFFS 0 100. 0. 0 0 1 /end COMPU_METHOD
/begin COMPU_METHOD _CNV_A_R_LINEAR_____147_CM "" RAT_FUNC "%6.3" "-" COEFFS 0 32768.0000069121 0. 0 0 1 /end COMPU_METHOD
/begin COMPU_METHOD _CNV_A_R_LINEAR_____150_CM "" RAT_FUNC "%6.3" "%" COEFFS 0 20. 0. 0 0 1 /end COMPU_METHOD
/begin COMPU_METHOD _CNV_A_R_LINEAR_____159_CM "" RAT_FUNC "%6.3" "%" COEFFS 0 655.35 0. 0 0 1 /end COMPU_METHOD
/begin COMPU_METHOD _CNV_A_R_LINEAR_____161_CM "" RAT_FUNC "%6.3" "-" COEFFS 0 1000. 0. 0 0 1 /end COMPU_METHOD
/begin COMPU_METHOD _CNV_A_R_LINEAR_____172_CM "" RAT_FUNC "%6.3" "kg/h" COEFFS 0 20. 0. 0 0 1 /end COMPU_METHOD
/begin COMPU_METHOD _CNV_S_3_STATUS_OK__179_CM "" TAB_VERB "%6.3" "-" COMPU_TAB_REF _CNV_S_3_STATUS_OK__179 /end COMPU_METHOD
/begin COMPU_VTAB _CNV_S_3_STATUS_OK__179 "" TAB_VERB 3 0 "Nsx_vld_nok_0" 1 "Nsx_vld_ok_1" 2 "Nsx_vld_fail_2" /end COMPU_VTAB
/begin COMPU_METHOD _CNV_A_R_LINEAR_____183_CM "" RAT_FUNC "%6.3" "-" COEFFS 0 1024. 0. 0 0 1 /end COMPU_METHOD
/begin COMPU_METHOD _CNV_S_3_STATUS_OK__213_CM "" TAB_VERB "%6.3" "" COMPU_TAB_REF _CNV_S_3_STATUS_OK__213 /end COMPU_METHOD
/begin COMPU_VTAB _CNV_S_3_STATUS_OK__213 "" TAB_VERB 3 0 "Nsx_vld_nok_0" 1 "Nsx_vld_ok_1" 2 "Nsx_vld_fail_2" /end COMPU_VTAB
/begin COMPU_METHOD _CNV_A_R_LINEAR_____216_CM "" RAT_FUNC "%6.3" "Nm" COEFFS 0 32. 12800. 0 0 1 /end COMPU_METHOD
/begin COMPU_METHOD _CNV_A_R_LINEAR_____217_CM "" RAT_FUNC "%6.3" "Nm/s" COEFFS 0 -0.2 0. 0 0 1 /end COMPU_METHOD
/begin COMPU_METHOD _CNV_A_R_LINEAR_____218_CM "" RAT_FUNC "%6.3" "Nm/s" COEFFS 0 0.2 0. 0 0 1 /end COMPU_METHOD
/begin COMPU_METHOD _CNV_S_4_STATUS_TQ__219_CM "" TAB_VERB "%6.3" "-" COMPU_TAB_REF _CNV_S_4_STATUS_TQ__219 /end COMPU_METHOD
/begin COMPU_VTAB _CNV_S_4_STATUS_TQ__219 "" TAB_VERB 4 0 "Nsx_no_tq_req" 1 "Nsx_asr_msr_tq_req_nok" 5 "Nsx_asr_tq_req" 6 "Nsx_msr_tq_req" /end COMPU_VTAB
/begin COMPU_METHOD _CNV_A_R_LINEAR_____220_CM "" RAT_FUNC "%6.3" "mg/stk" COEFFS 0 10. 0. 0 0 1 /end COMPU_METHOD
/begin COMPU_METHOD _CNV_A_R_LINEAR_____221_CM "" RAT_FUNC "%6.3" "m3" COEFFS 0 1000000. 0. 0 0 1 /end COMPU_METHOD
/begin COMPU_METHOD _CNV_A_R_LINEAR_____222_CM "" RAT_FUNC "%6.3" "-" COEFFS 0 32768000.00000008 0. 0 0 1 /end COMPU_METHOD
/begin COMPU_METHOD _CNV_A_R_LINEAR_____223_CM "" RAT_FUNC "%6.3" "-" COEFFS 0 838860.8000000001 32768. 0 0 1 /end COMPU_METHOD
/begin COMPU_METHOD _CNV_A_R_LINEAR_____224_CM "" RAT_FUNC "%6.3" "-" COEFFS 0 32767.99999999991 0. 0 0 1 /end COMPU_METHOD
/begin COMPU_METHOD _CNV_A_R_LINEAR_____225_CM "" RAT_FUNC "%6.3" "-" COEFFS 0 32768. 0. 0 0 1 /end COMPU_METHOD
/begin COMPU_METHOD _CNV_A_R_LINEAR_____226_CM "" RAT_FUNC "%6.3" "-" COEFFS 0 838860.8000000001 0. 0 0 1 /end COMPU_METHOD
/begin COMPU_METHOD _CNV_A_R_LINEAR_____227_CM "" RAT_FUNC "%6.3" "1/s" COEFFS 0 655.3599999999997 32767.99999999999 0 0 1 /end COMPU_METHOD
/begin COMPU_METHOD _CNV_A_R_LINEAR_____228_CM "" RAT_FUNC "%6.3" "°CRK" COEFFS 0 49.99999999999999 -3.637978807091713e-012 0 0 1 /end COMPU_METHOD
/begin COMPU_METHOD _CNV_A_R_LINEAR_____229_CM "" RAT_FUNC "%6.3" "m3" COEFFS 0 100000. 0. 0 0 1 /end COMPU_METHOD
/begin COMPU_METHOD _CNV_A_R_LINEAR_____230_CM "" RAT_FUNC "%6.3" "m²" COEFFS 0 268435455.9999995 0. 0 0 1 /end COMPU_METHOD
/begin COMPU_METHOD _CNV_A_R_LINEAR_____231_CM "" RAT_FUNC "%6.3" "kg/(s*m²)" COEFFS 0 128. 0. 0 0 1 /end COMPU_METHOD
/begin COMPU_METHOD _CNV_A_R_LINEAR_____232_CM "" RAT_FUNC "%6.3" "-" COEFFS 0 98302.49017067616 0. 0 0 1 /end COMPU_METHOD
/begin COMPU_METHOD _CNV_A_R_LINEAR_____233_CM "" RAT_FUNC "%6.3" "-" COEFFS 0 32768. 32768. 0 0 1 /end COMPU_METHOD
/begin COMPU_METHOD _CNV_S_8_STATUS_OK__234_CM "" TAB_VERB "%6.3" "-" COMPU_TAB_REF _CNV_S_8_STATUS_OK__234 /end COMPU_METHOD
/begin COMPU_VTAB _CNV_S_8_STATUS_OK__234 "" TAB_VERB 8 0 "Nsx_vld_nok_0" 1 "Nsx_vld_ok_1" 2 "Nsx_vld_fail_2" 3 "Nsx_vld_fail_3" 4 "Nsx_vld_fail_4" 5 "Nsx_vld_fail_5" 6 "Nsx_vld_fail_6" 7 "Nsx_vld_fail_7" /end COMPU_VTAB
/begin COMPU_METHOD _CNV_A_R_LINEAR_____235_CM "" RAT_FUNC "%6.3" "mV" COEFFS 0 1. 25000. 0 0 1 /end COMPU_METHOD
/begin COMPU_METHOD _CNV_A_R_LINEAR_____236_CM "" RAT_FUNC "%6.3" "-" COEFFS 0 32768000. 1.192092895507813e-007 0 0 1 /end COMPU_METHOD
/begin COMPU_METHOD _CNV_A_R_LINEAR_____237_CM "" RAT_FUNC "%6.3" "-" COEFFS 0 16000. 0. 0 0 1 /end COMPU_METHOD
/begin COMPU_METHOD _CNV_A_R_LINEAR_____238_CM "" RAT_FUNC "%6.3" "-" COEFFS 0 800. 0. 0 0 1 /end COMPU_METHOD
/begin COMPU_METHOD _CNV_A_R_LINEAR_____239_CM "" RAT_FUNC "%6.3" "%" COEFFS 0 -20. 0. 0 0 1 /end COMPU_METHOD
/begin COMPU_METHOD _CNV_A_R_LINEAR_____240_CM "" RAT_FUNC "%6.3" "-" COEFFS 0 128. 128. 0 0 1 /end COMPU_METHOD
/begin COMPU_METHOD _CNV_S_2_STATUS_OK__241_CM "" TAB_VERB "%6.3" "" COMPU_TAB_REF _CNV_S_2_STATUS_OK__241 /end COMPU_METHOD
/begin COMPU_VTAB _CNV_S_2_STATUS_OK__241 "" TAB_VERB 2 0 "Nsx_vld_nok_0" 1 "Nsx_vld_ok_1" /end COMPU_VTAB
/begin COMPU_METHOD _CNV_A_R_LINEAR_____242_CM "" RAT_FUNC "%6.3" "K^1/2" COEFFS 0 36.57142857142857 -548.5714285714286 0 0 1 /end COMPU_METHOD
/begin COMPU_METHOD _CNV_A_R_LINEAR_____243_CM "" RAT_FUNC "%6.3" "°C/s" COEFFS 0 10. 0. 0 0 1 /end COMPU_METHOD
/begin COMPU_METHOD _CNV_S_5_STATUS_TCO_244_CM "" TAB_VERB "%6.3" "-" COMPU_TAB_REF _CNV_S_5_STATUS_TCO_244 /end COMPU_METHOD
/begin COMPU_VTAB _CNV_S_5_STATUS_TCO_244 "" TAB_VERB 5 0 "Nsx_init_tco_fail" 1 "Nsx_wait_tco_fail" 10 "Nsx_inc_mdl" 20 "Nsx_no_inc_mdl" 30 "Nsx_no_inc_max_mdl" /end COMPU_VTAB
/begin COMPU_METHOD _CNV_A_R_LINEAR_____245_CM "" RAT_FUNC "%6.3" "-" COEFFS 0 8.e-002 0. 0 0 1 /end COMPU_METHOD
/begin COMPU_METHOD _CNV_A_R_LINEAR_____246_CM "" RAT_FUNC "%6.3" "-" COEFFS 0 4. 0. 0 0 1 /end COMPU_METHOD
/begin COMPU_METHOD _CNV_A_R_LINEAR_____247_CM "" RAT_FUNC "%6.3" "kg" COEFFS 0 10000. 0. 0 0 1 /end COMPU_METHOD
/begin COMPU_METHOD _CNV_A_R_LINEAR_____248_CM "" RAT_FUNC "%6.3" "hpa/(kg/h)²" COEFFS 0 1638400.395206126 0. 0 0 1 /end COMPU_METHOD
/begin COMPU_METHOD _CNV_A_R_LINEAR_____249_CM "" RAT_FUNC "%6.3" "s" COEFFS 0 10000. 0. 0 0 1 /end COMPU_METHOD
/begin COMPU_METHOD _CNV_A_R_LINEAR_____250_CM "" RAT_FUNC "%6.3" "TDC" COEFFS 0 128. 0. 0 0 1 /end COMPU_METHOD
/begin COMPU_METHOD _CNV_A_R_LINEAR_____251_CM "" RAT_FUNC "%6.3" "TDC/°" COEFFS 0 655360.0007936121 3.96806062781252e-005 0 0 1 /end COMPU_METHOD
/begin COMPU_METHOD _CNV_A_R_LINEAR_____252_CM "" RAT_FUNC "%6.3" "hPa" COEFFS 0 32. 0. 0 0 1 /end COMPU_METHOD
/begin COMPU_METHOD _CNV_A_R_LINEAR_____253_CM "" RAT_FUNC "%6.3" "hPa" COEFFS 0 256. 0. 0 0 1 /end COMPU_METHOD
/begin COMPU_METHOD _CNV_A_R_LINEAR_____254_CM "" RAT_FUNC "%6.3" "m/(s^2*K^1/2)" COEFFS 0 4. 0. 0 0 1 /end COMPU_METHOD
/begin COMPU_METHOD _CNV_A_R_LINEAR_____255_CM "" RAT_FUNC "%6.3" "(s^2*K^1/2)/m" COEFFS 0 65536.00007936121 0. 0 0 1 /end COMPU_METHOD
/begin COMPU_METHOD _CNV_A_R_LINEAR_____256_CM "" RAT_FUNC "%6.3" "(s^2*K^1/2)/m" COEFFS 0 65535.99999999996 65535. 0 0 1 /end COMPU_METHOD
/begin COMPU_METHOD _CNV_A_R_LINEAR_____257_CM "" RAT_FUNC "%6.3" "-" COEFFS 0 65536.00007936121 0. 0 0 1 /end COMPU_METHOD
/begin COMPU_METHOD _CNV_A_R_LINEAR_____258_CM "" RAT_FUNC "%6.3" "tr/(min*m*K*s^2)" COEFFS 0 1.63839999999998e-003 -8191.999999999898 0 0 1 /end COMPU_METHOD
/begin COMPU_METHOD _CNV_A_R_LINEAR_____259_CM "" RAT_FUNC "%6.3" "1/rpm" COEFFS 0 0.1092266666715023 0. 0 0 1 /end COMPU_METHOD
/begin COMPU_METHOD _CNV_A_R_LINEAR_____260_CM "" RAT_FUNC "%6.3" "Nm" COEFFS 0 128.0005468856814 0. 0 0 1 /end COMPU_METHOD
/begin COMPU_METHOD _CNV_A_R_LINEAR_____261_CM "" RAT_FUNC "%6.3" "-" COEFFS 0 131072.0001587224 0. 0 0 1 /end COMPU_METHOD
/begin COMPU_METHOD _CNV_A_R_LINEAR_____262_CM "" RAT_FUNC "%6.3" "m/(s^2*K^1/2)" COEFFS 0 16. 0. 0 0 1 /end COMPU_METHOD
/begin COMPU_METHOD _CNV_A_R_LINEAR_____263_CM "" RAT_FUNC "%6.3" "(s^2*K^1/2)/m" COEFFS 0 1048576. 0. 0 0 1 /end COMPU_METHOD
/begin COMPU_METHOD _CNV_A_R_LINEAR_____264_CM "" RAT_FUNC "%6.3" "-" COEFFS 0 10000. 0. 0 0 1 /end COMPU_METHOD
/begin COMPU_METHOD _CNV_A_R_LINEAR_____265_CM "" RAT_FUNC "%6.3" "-" COEFFS 0 120. 0. 0 0 1 /end COMPU_METHOD
/begin COMPU_METHOD _CNV_A_R_LINEAR_____266_CM "" RAT_FUNC "%6.3" "-" COEFFS 0 1023. 0. 0 0 1 /end COMPU_METHOD
/begin COMPU_METHOD _CNV_A_R_LINEAR_____267_CM "" RAT_FUNC "%6.3" "%" COEFFS 0 800. 0. 0 0 1 /end COMPU_METHOD
/begin COMPU_METHOD _CNV_A_R_LINEAR_____307_CM "" RAT_FUNC "%6.3" "°C" COEFFS 0 10. 12000. 0 0 1 /end COMPU_METHOD
/begin RECORD_LAYOUT _REC_S1VAL_20_u4 FNC_VALUES 1 ULONG COLUMN_DIR DIRECT /end RECORD_LAYOUT
/begin RECORD_LAYOUT _REC_S1VAL_20_u1 FNC_VALUES 1 UBYTE COLUMN_DIR DIRECT /end RECORD_LAYOUT
/begin RECORD_LAYOUT _REC_S1VAL_20_u2 FNC_VALUES 1 UWORD COLUMN_DIR DIRECT /end RECORD_LAYOUT
/begin RECORD_LAYOUT _REC_S1VAL_20_s2 FNC_VALUES 1 SWORD COLUMN_DIR DIRECT /end RECORD_LAYOUT
/begin RECORD_LAYOUT _REC_A2AXS_20_u2 NO_AXIS_PTS_X 1 UWORD AXIS_PTS_X 2 UWORD INDEX_INCR DIRECT /end RECORD_LAYOUT
/begin RECORD_LAYOUT _REC_A1CUR_20_u1_u2 FNC_VALUES 1 UBYTE COLUMN_DIR DIRECT /end RECORD_LAYOUT
/begin RECORD_LAYOUT _REC_A1MAP_20_u2_u2_u2 FNC_VALUES 1 UWORD COLUMN_DIR DIRECT /end RECORD_LAYOUT
/begin RECORD_LAYOUT _REC_A1CUR_20_u2_u2 FNC_VALUES 1 UWORD COLUMN_DIR DIRECT /end RECORD_LAYOUT
/begin RECORD_LAYOUT _REC_A1MAP_20_u1_u2_u2 FNC_VALUES 1 UBYTE COLUMN_DIR DIRECT /end RECORD_LAYOUT
/begin FUNCTION InPciEsp_Absctxx_xxxxxx ""
 /begin DEF_CHARACTERISTIC Cxx_asr_msr_abst_dly Cxx_asr_msr_ctr_thd Cxx_asr_msr_max_tqe Cxx_asr_msr_raw_sum Cxx_asr_slwr_neg Cxx_asr_slwr_pos Cxx_asr_tqe_sp_msr_raw Cxx_dfdec_esp_data_chr Cxx_dfdec_esp_data_seq_ctr Cxx_dfdec_esp_no_frm Cxx_dfinc_esp_data_chr Cxx_dfinc_esp_data_seq_ctr Cxx_dfinc_esp_no_frm Cxx_min_tqe_dsb Cxx_mux_asr_msr_tqe_nok_raw /end DEF_CHARACTERISTIC
 /begin OUT_MEASUREMENT Vbx_asr_cdn Vbx_asr_msr_ack Vbx_asr_msr_cdn Vbx_asr_msr_frm_abst_tmp Vbx_asr_msr_lk Vbx_asr_prot_dft Vbx_asr_tqe_req_ok Vbx_df_esp_data_chr Vbx_df_esp_data_seq_ctr Vbx_df_esp_no_frm Vbx_msr_cdn Vbx_msr_tqe_req_ok Vbx_tmp_df_esp_data_chr Vbx_tmp_df_esp_data_seq_ctr Vxx_asr_msr_20ms_t Vxx_asr_tqe_sp Vxx_asr_tqe_tgt Vxx_msr_tqe_sp /end OUT_MEASUREMENT
/end FUNCTION
/begin FUNCTION InPciEsp_Espxxcs_xxxxxx "" /begin OUT_MEASUREMENT Vbx_asr_reg Vbx_ayc_reg Vsx_asr_msr_typ /end OUT_MEASUREMENT /end FUNCTION
/begin FUNCTION InAsiIaf ""
 /begin SUB_FUNCTION InAsiIaf_Airwhxx InAsiIaf_Cpmafxx InAsiIaf_Filupxx InAsiIaf_Macstxx InAsiIaf_Pzeroxx InAsiIaf_Itarexx InAsiIaf_Alcoxxx /end SUB_FUNCTION
/end FUNCTION
/begin FUNCTION InAsiIaf_Airwhxx ""
 /begin DEF_CHARACTERISTIC Ctb_eal Cxx_cyl_vol Cxx_eng_air_wht_ref Cxx_pump_maf_fil_ftc /end DEF_CHARACTERISTIC
 /begin OUT_MEASUREMENT Vxb_eal.factor Vxb_eal.index Vxb_eal.num_dp Vxb_pred_eal.factor Vxb_pred_eal.index Vxb_pred_eal.num_dp Vsx_eal_vld Vxx_eal Vxx_eal_tdc_2 Vxx_eal_tdc_4 Vxx_pred_air_wht_frh Vxx_pred_eal Vxx_pump_maf Vxx_pump_maf_fil /end OUT_MEASUREMENT
/end FUNCTION
/begin FUNCTION InAsiIaf_Cpmafxx ""
 /begin DEF_CHARACTERISTIC Ntb_100_9 Ntb_1_9 Ctp_cp_load_fac_cor Ctp_pwm_cp_efv_ar1 Ctp_pwm_cp_efv_ar2 Cbx_as_cpmaf_on_mod Cxx_dft_cp_load Cxx_flr_clc_dsb_prs_thd /end DEF_CHARACTERISTIC
 /begin OUT_MEASUREMENT Vxx_clc_ar_cp_air_gas_maf Vxx_clc_ar_cp_air_gas_maf_cor Vxx_cp_efv_ar Vxx_cp_maf Vxx_raw_cp_maf /end OUT_MEASUREMENT
/end FUNCTION
/begin FUNCTION InAsiIaf_Filupxx ""
 /begin DEF_CHARACTERISTIC Ctb_fill_efy_cor_dyn_amp Ctb_n_fill_efy_cor_dyn Cmp_n_map_cor_dyn_amp Cmp_n_map_cor_dyn_th Cmp_n_map_fill_efv Cmp_vvt_fill_efv_cor_fac1 Cmp_vvt_fill_efv_cor_fac2 Ctp_fill_efy_cor_dyn_amp_rat Ctp_fill_efy_dyn_off_dly Ctp_fill_efy_dyn_tco_cor Ctp_map_n_ftc Ctp_vlv_air_temp_cor Cbx_vvtc_in_ang_ofs Cxx_eng_vol_fill_efy_drv_max Cxx_eng_vol_fill_efy_dz Cxx_fill_efy_cor_dyn_max Cxx_fill_efy_cor_dyn_min Cxx_vvt_fill_efv_cam_ofs /end DEF_CHARACTERISTIC
 /begin OUT_MEASUREMENT Vsx_eng_vol_fill_efy_vld Vxx_air_temp_inj_cor Vxx_eng_vol_fill_efy Vxx_eng_vol_fill_efy_fil Vxx_fill_efv_cor_rat Vxx_fill_efy_cor_dyn Vxx_fill_efy_cor_dyn_raw Vxx_vvt_fill_efv_cor Vxx_vvt_fill_efv_cor_fac1 Vxx_vvt_fill_efv_cor_fac2 /end OUT_MEASUREMENT
/end FUNCTION
/begin FUNCTION InAsiIaf_Macstxx "" /begin DEF_CHARACTERISTIC Cxx_mfld_vol /end DEF_CHARACTERISTIC /begin OUT_MEASUREMENT Vxx_mfld_dly /end OUT_MEASUREMENT /end FUNCTION
/begin FUNCTION InAsiIaf_Pzeroxx "" /begin DEF_CHARACTERISTIC Cmp_prs_n_alti_min_map_cor Ctp_min_map /end DEF_CHARACTERISTIC /begin OUT_MEASUREMENT Vsx_min_map_maf_vld Vxx_min_map_maf /end OUT_MEASUREMENT /end FUNCTION
/begin FUNCTION InAsiIaf_Itarexx "" /begin DEF_CHARACTERISTIC Ctp_it_ar_psn /end DEF_CHARACTERISTIC /begin OUT_MEASUREMENT Vxx_pred_map_efv_it_ar /end OUT_MEASUREMENT /end FUNCTION
/begin FUNCTION InAsiIaf_Alcoxxx "" /begin DEF_CHARACTERISTIC Cmp_n_map_fill_efv_ofs_alco Ctp_vlv_air_temp_cor_alco /end DEF_CHARACTERISTIC /begin OUT_MEASUREMENT Vxx_fill_efv_ofs_alco Vxx_vlv_air_temp_cor_alco /end OUT_MEASUREMENT /end FUNCTION
/begin FUNCTION InAsiIti "" /begin SUB_FUNCTION InAsiIti_Itposxx_xxxxxg /end SUB_FUNCTION /end FUNCTION
/begin FUNCTION InAsiIti_Itposxx_xxxxxg ""
 /begin DEF_CHARACTERISTIC Ctb_sens_it_cor_1 Ctb_sens_it_cor_2 Ctp_sens_it_cor_1 Ctp_sens_it_cor_2 Cbx_sens_it_chr_fil_cho Cbx_sens_it_mcut_cho Cbx_sens_it_mcut_cho_2 Cbx_sens_it_typ_1 Cbx_sens_it_typ_2 Cbx_sens_it_vld_cho_1 Cbx_sens_it_vld_cho_2 Cbx_sens_it_vld_cho_3 Cxx_dfdec_sens_it_1_nok Cxx_dfdec_sens_it_2_nok Cxx_dfdec_sens_it_chr Cxx_dfdec_sens_it_sig_mcut Cxx_dfinc_sens_it_1_nok Cxx_dfinc_sens_it_2_nok Cxx_dfinc_sens_it_chr Cxx_dfinc_sens_it_sig_mcut Cxx_it_psn_stab_dly_1 Cxx_it_psn_stab_dly_2 Cxx_it_psn_stab_thd_1 Cxx_it_psn_stab_thd_2 Cxx_sens_it_1_src_max Cxx_sens_it_1_src_min Cxx_sens_it_2_src_max Cxx_sens_it_2_src_min Cxx_sens_it_chr_fil Cxx_sens_it_max_chr_dif Cxx_sens_it_mcut_det_dly Cxx_sens_it_spd_chr_thd /end DEF_CHARACTERISTIC
 /begin OUT_MEASUREMENT Vbx_df_sens_it_1_nok Vbx_df_sens_it_2_nok Vbx_df_sens_it_chr Vbx_df_sens_it_sig_mcut Vbx_diag_ena_sens_it_chr Vbx_it_psn_stab_1 Vbx_it_psn_stab_2 Vbx_it_psn_stab_det_1 Vbx_it_psn_stab_det_2 Vbx_sens_it_spd_chr_no_norm Vsx_it_sens_vld Vsx_it_sens_vld_prev Vsx_it_sens_vld_tmp Vxx_it_psn Vxx_it_psn_mv_1 Vxx_it_psn_mv_2 Vxx_it_psn_stab_1 Vxx_it_psn_stab_2 Vxx_sens_it_1 Vxx_sens_it_2 Vxx_sens_it_tmp_1 Vxx_sens_it_tmp_2 /end OUT_MEASUREMENT
/end FUNCTION
/begin FUNCTION OuAsoIto "" /begin SUB_FUNCTION OuAsoIto_Itdiagx OuAsoIto_Itmonxx OuAsoIto_Itregul /end SUB_FUNCTION /end FUNCTION
/begin FUNCTION OuAsoIto_Itdiagx ""
 /begin DEF_CHARACTERISTIC Cxx_dfdec_it_cmd_el Cxx_dfdec_it_ofs_meca Cxx_dfdec_it_ofs_no_norm Cxx_dfdec_it_ofs_secu_nok Cxx_dfdec_it_reg_blk Cxx_dfinc_it_cmd_el Cxx_dfinc_it_ofs_meca Cxx_dfinc_it_ofs_no_norm Cxx_dfinc_it_ofs_secu_nok Cxx_dfinc_it_reg_blk Cxx_it_diag_psn_stab_dly Cxx_it_diag_psn_stab_thd Cxx_it_max_clos_psn Cxx_it_max_clos_psn_dev Cxx_it_max_lih_psn Cxx_it_max_lih_psn_dev Cxx_it_max_open_psn Cxx_it_max_open_psn_dev Cxx_it_min_clos_psn Cxx_it_min_lih_psn Cxx_it_min_open_psn Cxx_it_ofs_meca_decr Cxx_it_ofs_meca_incr Cxx_it_ofs_no_norm_decr Cxx_it_ofs_no_norm_incr Cxx_it_ofs_secu_nok_decr Cxx_it_ofs_secu_nok_incr Cxx_it_reg_blk_det_dly Cxx_it_reg_blk_max_err Cxx_it_reg_blk_max_err_2 Cxx_it_reg_blk_v_max_thd Cxx_it_reg_blk_v_min_thd /end DEF_CHARACTERISTIC
 /begin OUT_MEASUREMENT Vxx_it_open_psn_1 Vxx_it_open_psn_2 Vxx_it_ofs_secu_nok_ctr Vxx_it_ofs_meca_ctr Vxx_it_ofs_no_norm_ctr Vbx_df_it_ofs_meca Vbx_df_it_ofs_meca_tmp Vbx_df_it_ofs_no_norm Vbx_df_it_ofs_no_norm_tmp Vbx_df_it_ofs_secu_nok Vbx_df_it_ofs_secu_nok_tmp Vbx_df_it_reg_blk Vbx_diag_ena_it_ofs_1 Vbx_diag_ena_it_ofs_meca Vbx_diag_ena_it_ofs_no_norm Vbx_diag_ena_it_ofs_secu_nok Vbx_it_diag_ad_1 Vbx_it_diag_ad_2 Vbx_it_diag_ad_end_1 Vbx_it_diag_ad_end_2 Vbx_it_diag_ad_fail Vbx_it_diag_ini Vbx_it_diag_psn_stab Vbx_it_diag_psn_stab_det_1 Vbx_it_diag_stab_ena Vbx_it_reset_reg_blk Vxx_it_diag_psn_stab Vxx_it_ofs_meca_ctr_tmp Vxx_it_ofs_no_norm_ctr_tmp Vxx_it_ofs_secu_nok_ctr_tmp Vxx_it_tempo_reg_blk /end OUT_MEASUREMENT
/end FUNCTION
/begin FUNCTION OuAsoIto_Itmonxx ""
 /begin DEF_CHARACTERISTIC Ctb_it_frst_ad_t Ctb_it_frst_ad_t_2 Ctb_it_ol_v_psn Ctb_it_pwl_ad_t Ctb_it_pwl_ad_t_2 Ctd_it_frst_ad_deci Ctd_it_frst_ad_req Ctd_it_frst_ad_v_cut Ctd_it_pwl_ad_deci Ctd_it_pwl_ad_req Ctd_it_pwl_ad_v_cut Ctp_it_frst_ad_sp Ctp_it_ol_v Ctp_it_pwl_ad_sp Cbx_it_ad_req Cbx_it_ad_sat_v_lim Cbx_it_bch_mod_ena Cbx_it_igk_on_ad_ena Cbx_it_mon_1_sens_ad Cbx_it_sens_vld_2_fail_cho Cbx_it_sens_vld_3_fail_cho Cxx_it_ad_rge_down Cxx_it_ad_rge_up Cxx_it_ad_v_lim_down Cxx_it_ad_v_lim_up Cxx_it_clos_psn_ini Cxx_it_frst_ad_t Cxx_it_learn_max_temp Cxx_it_learn_min_temp Cxx_it_lih_psn_ini Cxx_it_ofs_ctr_max_1 Cxx_it_ofs_ctr_max_2 Cxx_it_open_psn_ini Cxx_it_psn_ftc Cxx_it_pwl_ad_t Cxx_it_rge_down Cxx_it_rge_up Cxx_it_stt_frst_ctr Cxx_it_stt_pwl_check_ctr Cxx_it_stt_pwl_end_ctr Cxx_it_stt_pwl_learn_ctr Cxx_it_v_lim_down Cxx_it_v_lim_up /end DEF_CHARACTERISTIC
 /begin OUT_MEASUREMENT Vbx_it_pwl_ad_req Vbx_it_frst_ad_ok Vbx_it_frst_ad_stop Vxx_it_clos_psn_1 Vxx_it_lih_psn_1 Vxx_it_clos_psn_2 Vxx_it_lih_psn_2 Vbx_diag_ena_it_ofs Vbx_diag_ena_it_reg_blk Vbx_it_ad_cyc_end Vbx_it_ad_cyc_end_mem Vbx_it_ad_cyc_v_cut Vbx_it_ad_ena Vbx_it_ad_v_lim_stop Vbx_it_cyc_cho Vbx_it_cyc_inter Vbx_it_hbrg_inh Vbx_it_igk_on Vbx_it_imd_ad_req Vbx_it_imd_ad_req_tmp Vbx_it_mon_mv_ena_1 Vbx_it_mon_mv_ena_2 Vbx_it_mon_read_ena Vbx_it_ofs_diag_ena_1 Vbx_it_ofs_diag_ena_2 Vbx_it_pwl_bgin Vbx_it_pwl_end Vbx_it_pws_req Vbx_it_read_ok_1 Vbx_it_read_ok_2 Vbx_it_req_fail_1 Vbx_it_req_fail_2 Vbx_it_sta_dsb Vbx_it_temp_no_ok Vbx_it_trigger_1 Vbx_it_trigger_2 Vbx_it_trigger_3 Vbx_it_trigger_4 Vbx_it_trigger_5 Vbx_it_trigger_ofs_1 Vbx_it_trigger_ofs_2 Vbx_it_trigger_ofs_3 Vbx_it_trigger_ofs_4 Vbx_it_trigger_ofs_5 Vbx_it_trigger_ofs_6 Vbx_it_v_sp_cho Vbx_it_write_ena Vsx_it_ctl_vld Vsx_it_vld Vxx_fil1_it_abs_psn_sp Vxx_it_ad_cyc_req Vxx_it_ad_cyc_sp Vxx_it_ad_deci Vxx_it_ad_fail_deci Vxx_it_ad_fail_deci_mem Vxx_it_ad_pb Vxx_it_ad_req Vxx_it_ad_req_mem Vxx_it_ad_stt Vxx_it_ad_typ Vxx_it_clos_psn Vxx_it_cyc_nr Vxx_it_cyc_remaining_t Vxx_it_diag_fail_mode Vxx_it_lih_psn Vxx_it_mon_psn_sp Vxx_it_mon_v_sp Vxx_it_ofs_1 Vxx_it_ofs_2 Vxx_it_ofs_ctr_1 Vxx_it_ofs_ctr_2 Vxx_it_ofs_down Vxx_it_ofs_up Vxx_it_ol_ctr Vxx_it_open_psn Vxx_it_read_stt_1 Vxx_it_read_stt_2 Vxx_it_rel_psn Vxx_it_rge_down Vxx_it_rge_up Vxx_it_stt Vxx_it_stt_ctr Vxx_it_v_lim_down Vxx_it_v_lim_up Vxx_mv_it_rel_psn /end OUT_MEASUREMENT
/end FUNCTION
/begin FUNCTION OuAsoIto_Itregul ""
 /begin DEF_CHARACTERISTIC Cbx_it_psn_ctl_sgn Cbx_it_psn_fil_cho_1 Cbx_it_psn_sp_ctl_sgn Cxx_it_cmd_val_1 Cxx_it_cmd_val_2 Cxx_it_cmd_val_3 Cxx_it_cps_v Cxx_it_ctl_lim Cxx_it_ctl_psn_sp_stab_thd Cxx_it_ctl_psn_stab_thd Cxx_it_ctl_psn_thd Cxx_it_ctl_stab_dly Cxx_it_frn_cps_v Cxx_it_psn_ctl_0 Cxx_it_psn_ctl_1 Cxx_it_psn_ctl_2 Cxx_it_psn_ctl_3 Cxx_it_psn_frn_cps_thd Cxx_it_psn_slop_lim_down Cxx_it_psn_slop_lim_up Cxx_it_psn_sp_ctl_0 Cxx_it_psn_sp_ctl_1 Cxx_it_psn_sp_ctl_2 /end DEF_CHARACTERISTIC
 /begin OUT_MEASUREMENT Vbx_it_psn_sp_slop_ena Vbx_it_v_lim_down Vbx_it_v_lim_up Vxx_it_cmd_val Vxx_it_cmd_val_1 Vxx_it_cmd_val_2 Vxx_it_cmd_val_3 Vxx_it_cmd_val_lim Vxx_it_cmd_val_lim_1 Vxx_it_ctl_err Vxx_it_ctl_err_lim Vxx_it_frn_cps_v Vxx_it_lim_down_thd Vxx_it_lim_up_thd Vxx_it_psn_ctl Vxx_it_psn_ctl_0 Vxx_it_psn_ctl_1 Vxx_it_psn_ctl_2 Vxx_it_psn_ctl_3 Vxx_it_psn_reg_1 Vxx_it_psn_reg_3 Vxx_it_psn_sp_cor_1 Vxx_it_psn_sp_ctl Vxx_it_psn_sp_ctl_0 Vxx_it_psn_sp_ctl_1 Vxx_it_psn_sp_ctl_2 Vxx_it_psn_sp_mod Vxx_it_psn_sp_reg Vxx_it_psn_sp_slop Vxx_it_v_sp Vxx_it_v_sp_cor_lim /end OUT_MEASUREMENT
/end FUNCTION
/begin FUNCTION OuAsoTco "" /begin SUB_FUNCTION OuAsoTco_Wgcdiag /end SUB_FUNCTION /end FUNCTION
/begin FUNCTION OuAsoTco_Wgcdiag ""
 /begin DEF_CHARACTERISTIC Cxx_dfdec_wgc_oc Cxx_dfdec_wgc_scg Cxx_dfdec_wgc_scw Cxx_dfinc_wgc_oc Cxx_dfinc_wgc_scg Cxx_dfinc_wgc_scw /end DEF_CHARACTERISTIC
 /begin OUT_MEASUREMENT Vsx_wgc_vld /end OUT_MEASUREMENT
/end FUNCTION
/begin FUNCTION InAsiIat ""
 /begin SUB_FUNCTION InAsiIat_Matxxmd InAsiIat_Matxxcs InAsiIat_Matxxsr InAsiIat_Upittxx InAsiIat_Vlvtpxx InAsiIat_Alcoxxx InAsiIat_Tenvxcs /end SUB_FUNCTION
/end FUNCTION
/begin FUNCTION InAsiIat_Matxxmd "" /begin DEF_CHARACTERISTIC Cxx_mem_mat_fail_max_mat /end DEF_CHARACTERISTIC /begin OUT_MEASUREMENT Vsx_mdl_mat_vld Vxx_mdl_mat /end OUT_MEASUREMENT /end FUNCTION
/begin FUNCTION InAsiIat_Matxxcs "" /begin DEF_CHARACTERISTIC Ctb_mat2 Cxx_mat_fail_val /end DEF_CHARACTERISTIC /begin OUT_MEASUREMENT Vsx_mat_vld Vxx_mat Vxx_sqrt_mat /end OUT_MEASUREMENT /end FUNCTION
/begin FUNCTION InAsiIat_Matxxsr "" /begin DEF_CHARACTERISTIC Cbx_sens_mat_fil_cfm Cxx_dfdec_sens_mat Cxx_dfinc_sens_mat /end DEF_CHARACTERISTIC
 /begin OUT_MEASUREMENT Vsx_sens_mat_vld Vxx_raw_sens_mat_fil Vxx_raw_sens_mat_rtn Vxx_sens_mat /end OUT_MEASUREMENT
/end FUNCTION
/begin FUNCTION InAsiIat_Upittxx "" /begin OUT_MEASUREMENT Vsx_up_it_temp_vld Vxx_sqrt_up_it_temp Vxx_up_it_temp /end OUT_MEASUREMENT /end FUNCTION
/begin FUNCTION InAsiIat_Vlvtpxx ""
 /begin DEF_CHARACTERISTIC Cmp_n_prs_mat_ftc Ctp_n_mat_fac Ctp_prs_mat_fac Cxx_mat_fac /end DEF_CHARACTERISTIC
 /begin OUT_MEASUREMENT Vsx_vlv_air_temp_vld Vxx_mat_fac Vxx_vlv_air_temp Vxx_vlv_air_temp_ftc /end OUT_MEASUREMENT
/end FUNCTION
/begin FUNCTION InAsiIat_Alcoxxx "" /begin DEF_CHARACTERISTIC Ctp_n_mat_fac_alco Ctp_prs_mat_fac_alco Cxx_mat_fac_alco /end DEF_CHARACTERISTIC /begin OUT_MEASUREMENT Vxx_mat_fac_alco /end OUT_MEASUREMENT /end FUNCTION
/begin FUNCTION InAsiIat_Tenvxcs "" /begin OUT_MEASUREMENT Vsx_tenv_vld Vxx_tenv /end OUT_MEASUREMENT /end FUNCTION
/begin FUNCTION InCliCoi ""
 /begin SUB_FUNCTION InCliCoi_Tcoxxcs InCliCoi_Tcoxxsr InCliCoi_Tcoxxmd InCliCoi_Tcomcsr InCliCoi_Schxxxx InCliCoi_Tcomoni /end SUB_FUNCTION
/end FUNCTION
/begin FUNCTION InCliCoi_Tcoxxcs "" /begin DEF_CHARACTERISTIC Ctb_sta_tco Ctb_tco Ctb_tco2 Cxx_tco_inc /end DEF_CHARACTERISTIC
 /begin OUT_MEASUREMENT Vxb_sta_tco.factor Vxb_sta_tco.index Vxb_sta_tco.num_dp Vxb_tco.factor Vxb_tco.index Vxb_tco.num_dp Vxb_tco2.factor Vxb_tco2.index Vxb_tco2.num_dp Vsx_sta_tco_vld Vsx_tco_vld Vxx_sta_tco Vxx_tco /end OUT_MEASUREMENT
/end FUNCTION
/begin FUNCTION InCliCoi_Tcoxxsr "" /begin DEF_CHARACTERISTIC Cxx_dfdec_sens_tco Cxx_dfinc_sens_tco Cxx_raw_sens_tco_ini /end DEF_CHARACTERISTIC
 /begin OUT_MEASUREMENT Vbx_df_sens_tco Vsx_sens_tco_vld Vxx_sens_tco Vxx_sens_tco_frz /end OUT_MEASUREMENT
/end FUNCTION
/begin FUNCTION InCliCoi_Tcoxxmd ""
 /begin DEF_CHARACTERISTIC Cxx_mdl_tco_inc Cxx_mdl_tco_max Cxx_tdc_mdl_fail_tdc_cnt Cxx_tdc_mdl_tdc_cnt /end DEF_CHARACTERISTIC
 /begin OUT_MEASUREMENT Vbx_tco_mdl_cnt Vsx_mdl_tco Vsx_mdl_tco_vld Vsx_mdl_tco_vld_2 Vxx_mdl_tco /end OUT_MEASUREMENT
/end FUNCTION
/begin FUNCTION InCliCoi_Tcomcsr ""
 /begin DEF_CHARACTERISTIC Cxx_dfdec_sens_tco_sig_mcut Cxx_dfinc_sens_tco_sig_mcut Cxx_tco_sig_mcut_max_slop /end DEF_CHARACTERISTIC
 /begin OUT_MEASUREMENT Vbx_df_sens_tco_sig_mcut /end OUT_MEASUREMENT
/end FUNCTION
/begin FUNCTION InCliCoi_Schxxxx "" /begin DEF_CHARACTERISTIC Cbx_moni_tco_cho /end DEF_CHARACTERISTIC /begin OUT_MEASUREMENT Vbx_moni_tco_cfm /end OUT_MEASUREMENT /end FUNCTION
/begin FUNCTION InCliCoi_Tcomoni ""
 /begin DEF_CHARACTERISTIC Ctb_tco_mon_sta_tco_diag_thd Ctd_tco_mon_sta_tco_diag_thd Cbx_tco_mon_dft_lght_ena Cbx_tco_mon_dft_lght_tco_ena Cbx_tco_mon_dft_lght_tsta_ena Cbx_tco_mon_tco_cl_diag_ena Cbx_tco_mon_tco_t_min_diag_ena Cbx_tco_mon_tsta_diag_ena Cxx_dfdec_tco_cl Cxx_dfdec_tsta_reg Cxx_dfinc_tco_cl Cxx_dfinc_tsta_reg Cxx_tco_mon_Te1 Cxx_tco_mon_Te2 Cxx_tco_mon_adac_fim_avg_inf Cxx_tco_mon_adac_fim_avg_sup Cxx_tco_mon_alt_pwm_sup Cxx_tco_mon_alt_pwm_sup_2 Cxx_tco_mon_drv_inf Cxx_tco_mon_drv_sup Cxx_tco_mon_ini_inf Cxx_tco_mon_n_avg_inf Cxx_tco_mon_rich_cl_thd_t1 Cxx_tco_mon_rich_cl_thd_t2 Cxx_tco_mon_t_inf Cxx_tco_mon_t_sup Cxx_tco_mon_t_thd_t0 Cxx_tco_mon_tair_min_inf Cxx_tco_mon_tair_min_sup Cxx_tco_mon_tco_avg_inf Cxx_tco_mon_tco_avg_sup Cxx_tco_mon_tco_thd Cxx_tco_mon_tqi_avg_inf Cxx_tco_mon_tqi_avg_sup Cxx_tco_mon_tqi_cold_avg_inf Cxx_tco_mon_tqi_cold_avg_sup Cxx_tco_mon_tqi_hot_avg_inf Cxx_tco_mon_tqi_hot_avg_sup Cxx_tco_mon_vs_avg_inf /end DEF_CHARACTERISTIC
 /begin OUT_MEASUREMENT Vbx_df_tco_cl_no_norm Vbx_df_tsta_reg_no_norm Vbx_diag_ena_tco_cl_no_norm Vbx_diag_ena_tsta_reg_no_norm Vbx_tco_mon_cl_diag Vbx_tco_mon_drv_inf Vbx_tco_mon_drv_sup Vbx_tco_mon_ena Vbx_tco_mon_hot Vbx_tco_mon_t Vbx_tco_mon_t_ena Vbx_tco_mon_t_min_diag Vbx_tco_mon_t_min_diag_ena Vbx_tco_mon_t_win Vbx_tco_mon_tout Vbx_tco_mon_tsta_diag Vxd_tco_mon_sta_tco_diag_thd Vxx_tco_mon_adac_fim_avg Vxx_tco_mon_alt_pwm_avg Vxx_tco_mon_avg Vxx_tco_mon_drg Vxx_tco_mon_drv Vxx_tco_mon_mat_min Vxx_tco_mon_n_avg Vxx_tco_mon_t Vxx_tco_mon_tco_avg Vxx_tco_mon_tqi_avg Vxx_tco_mon_tqi_win_avg Vxx_tco_mon_vs_avg /end OUT_MEASUREMENT
/end FUNCTION
/begin FUNCTION InCliLui "" /begin OUT_MEASUREMENT Vxx_pft_oil_csm /end OUT_MEASUREMENT
 /begin SUB_FUNCTION InCliLui_Toilxcs InCliLui_Toilxmd InCliLui_Toilubc InCliLui_Owpdlrx InCliLui_Owrstcs InCliLui_Schxxxx /end SUB_FUNCTION
/end FUNCTION
/begin FUNCTION InCliLui_Toilxcs "" /begin DEF_CHARACTERISTIC Ctb_toil Cxx_mdl_toil_fail /end DEF_CHARACTERISTIC /begin OUT_MEASUREMENT Vsx_toil_vld Vxx_toil /end OUT_MEASUREMENT /end FUNCTION
/begin FUNCTION InCliLui_Toilxmd ""
 /begin DEF_CHARACTERISTIC Ctb_n4 Ctb_tco_dif Ctb_tqi_rat Cmp_n_toil Ctp_tco_toil_ofs Ctp_toil_fil Cxx_stop_toil_fil Cxx_tco_toil_fil Cxx_tco_toil_thd Cxx_toil_pws_max_dly Cxx_toil_tco_cnt Cxx_tqi_rat_cut_thd /end DEF_CHARACTERISTIC
 /begin OUT_MEASUREMENT Vbx_toil_pws Vsx_mdl_toil_vld Vxx_mdl_toil Vxx_stab_toil Vxx_tco_dif Vxx_tco_fil Vxx_toil_pws_max_dly /end OUT_MEASUREMENT
/end FUNCTION
/begin FUNCTION InCliLui_Toilubc "" /begin OUT_MEASUREMENT Vsx_sens_toil_vld Vxx_sens_toil /end OUT_MEASUREMENT /end FUNCTION
/begin FUNCTION InCliLui_Owpdlrx "" /begin DEF_CHARACTERISTIC Cxx_owe_ctr4 Cxx_owe_ctr5 Cxx_owe_n Cxx_owe_pdl_thd /end DEF_CHARACTERISTIC
 /begin OUT_MEASUREMENT Sxx_owe_st3 Sxx_owe_st4 Vbx_brk Vbx_owe_igk_on_igk_off Vbx_owe_mnl_ini_req Vxx_owe_ctr4 Vxx_owe_ctr5 /end OUT_MEASUREMENT
/end FUNCTION
/begin FUNCTION InCliLui_Owrstcs "" /begin DEF_CHARACTERISTIC Cbx_owe_mnl_ini_req_ena /end DEF_CHARACTERISTIC /begin OUT_MEASUREMENT Vbx_owe_ini_req_ok Vbx_owe_mnl_ini_req_ok /end OUT_MEASUREMENT /end FUNCTION
/begin FUNCTION InCliLui_Schxxxx "" /begin DEF_CHARACTERISTIC Cbx_owe_cfm /end DEF_CHARACTERISTIC /begin OUT_MEASUREMENT Vbx_owe_cfm /end OUT_MEASUREMENT /end FUNCTION
/begin FUNCTION InAsiIap "" /begin OUT_MEASUREMENT Vxx_amp Vxx_map_spg_dif /end OUT_MEASUREMENT
 /begin SUB_FUNCTION InAsiIap_Spgxxsr InAsiIap_Ppredxx InAsiIap_Spgxxcs InAsiIap_Mapxxsr InAsiIap_Mapxxcs InAsiIap_Atmoxxx InAsiIap_Mapxxmd /end SUB_FUNCTION
/end FUNCTION
/begin FUNCTION InAsiIap_Spgxxsr ""
 /begin DEF_CHARACTERISTIC Cxx_dfdec_sens_spg_h Cxx_dfdec_sens_spg_l Cxx_dfinc_sens_spg_h Cxx_dfinc_sens_spg_l /end DEF_CHARACTERISTIC
 /begin OUT_MEASUREMENT Vsx_sens_spg_vld Vxx_sens_spg /end OUT_MEASUREMENT
/end FUNCTION
/begin FUNCTION InAsiIap_Ppredxx ""
 /begin DEF_CHARACTERISTIC Cxx_pred_map_dif_dz Cxx_pred_map_dif_max_fac Cxx_pred_map_dif_neg_fac Cxx_pred_map_dif_pos_fac Cxx_t_pred_dly_ref Cxx_tdc_nr_pred_dly_ref Cxx_vvtc_angl_tdc_fac /end DEF_CHARACTERISTIC
 /begin OUT_MEASUREMENT Vxx_lim_pred_map Vxx_lim_pred_map_dif Vxx_pred_map Vxx_pred_map_dif /end OUT_MEASUREMENT
/end FUNCTION
/begin FUNCTION InAsiIap_Spgxxcs ""
 /begin DEF_CHARACTERISTIC Ctb_n_spg_dft_mdl Ctp_n_amp_spg_dif_cut Ctp_n_spg_dft_mdl Cbx_spg_sens_cfm Cxx_act_is_dly Cxx_amp_cge_n_thd Cxx_amp_inj_cut_dly Cxx_amp_spg_dif_fac Cxx_dfdec_spg_oor Cxx_dfinc_spg_oor Cxx_fil_it_psn_dif_thd Cxx_it_psn_cge_fil_ftc Cxx_it_psn_dif_thd Cxx_max_amp Cxx_min_amp Cxx_spg_fail_l_thd Cxx_spg_fail_up_thd Cxx_spg_fail_val Cxx_spg_min Cxx_stab_spg_dif_thd /end DEF_CHARACTERISTIC
 /begin OUT_MEASUREMENT Vbx_amp_spg_dif_upd Vbx_df_spg_oor Vbx_diag_ena_spg_oor Vbx_inj_cut_cdn Vbx_low_eng_load Vbx_spg_gbx_stt Vbx_spg_ini Vsx_spg_vld Vxx_act_is_dly Vxx_amp_inj_cut_dly Vxx_amp_spg_dif Vxx_it_psn_dif_fil Vxx_mdl_spg Vxx_spg /end OUT_MEASUREMENT
/end FUNCTION
/begin FUNCTION InAsiIap_Mapxxsr ""
 /begin DEF_CHARACTERISTIC Cxx_dfdec_sens_map_h Cxx_dfdec_sens_map_l Cxx_dfinc_sens_map_h Cxx_dfinc_sens_map_l /end DEF_CHARACTERISTIC
 /begin OUT_MEASUREMENT Vsx_sens_map_vld Vxx_sens_map /end OUT_MEASUREMENT
/end FUNCTION
/begin FUNCTION InAsiIap_Mapxxcs ""
 /begin DEF_CHARACTERISTIC Ctb_prs Ctb_prs2 Cxx_dfdec_map_chr Cxx_dfdec_map_oor Cxx_dfdec_map_oor_run Cxx_dfinc_map_chr Cxx_dfinc_map_oor Cxx_dfinc_map_oor_run Cxx_dif_sens_esti_map_err Cxx_map_fil_ftc Cxx_min_n_test_acq Cxx_nr_tdc_dif_prs_fail Cxx_rel_it_prs_thd_h_err Cxx_sens_map_max_dif_val Cxx_sens_map_run_eng_h_thd Cxx_sens_map_run_eng_l_thd Cxx_sens_map_stop_eng_h_thd Cxx_sens_map_stop_eng_l_thd /end DEF_CHARACTERISTIC
 /begin OUT_MEASUREMENT Vxb_map.factor Vxb_map.index Vxb_map.num_dp Vxb_map2.factor Vxb_map2.index Vxb_map2.num_dp Vbx_df_map_chr Vbx_df_map_oor Vbx_diag_ena_map_chr Vbx_diag_ena_map_oor Vbx_map_chr_diag_run_dly_rst Vbx_map_chr_diag_run_ena Vbx_map_diag_oor Vsx_map_vld Vxx_map Vxx_map_chr_diag_run_dly Vxx_map_fil /end OUT_MEASUREMENT
/end FUNCTION
/begin FUNCTION InAsiIap_Atmoxxx ""
 /begin DEF_CHARACTERISTIC Ntb_n_amp_map_dif Ntb_n_kd_it_psn_thd Ctp_n_amp_map_dif Ctp_n_kd_it_psn_thd Cxx_amp_dft_val Cxx_amp_eprm_h_thd Cxx_amp_eprm_l_thd Cxx_amp_kd_dly Cxx_amp_map_cge_n_thd Cxx_amp_map_fil_fac Cxx_amp_spg_fil_fac Cxx_max_map_spg_dif Cxx_n_kd_it_psn_hys Cxx_sens_dif_amp_map_thd Cxx_sens_dif_amp_spg_thd Cxx_stal_dly /end DEF_CHARACTERISTIC
 /begin OUT_MEASUREMENT Vbx_amp_ad_kd_it Vbx_amp_eng_run Vbx_amp_eng_stop Vbx_amp_map_fil_ena Vbx_amp_mem_run_eng Vbx_amp_upd Vsx_amp_vld Vxx_amp_map Vxx_fil_amp Vxx_fil_map_spg_dif1 Vxx_raw_amp Vxx_stal_dly /end OUT_MEASUREMENT
/end FUNCTION
/begin FUNCTION InAsiIap_Mapxxmd ""
 /begin DEF_CHARACTERISTIC Ctb_pred_map_prs_rat Ctb_psi_fac_cor Ctd_ofs_psi_fac Ctd_slop_psi_fac Ctp_cp_load_map_fac_cor Ctp_ftc_mdl_map Ctp_pred_map_prs_rat Cxx_it_ar_max_slop Cxx_last_bkp_prs_rat Cxx_map_mv_ftc Cxx_pred_map_max_prs_rat Cxx_tdc_per_fac /end DEF_CHARACTERISTIC
 /begin OUT_MEASUREMENT Vbx_pred_map_psi_fac_cor Vsx_mdl_map_vld Vxx_fil_pred_map_efv_it_ar Vxx_fill_efy_n_mpl Vxx_mdl_map Vxx_mdl_map_fac_1 Vxx_mdl_map_fac_2 Vxx_mdl_map_fil Vxx_mdl_map_spg_rat Vxx_mfld_fil_fac Vxx_min_map_spg_rat Vxx_pred_map_cp_maf_fac Vxx_pred_map_cp_psi_fac Vxx_pred_map_cp_psi_fac_ofs Vxx_pred_map_cp_psi_fac_slop Vxx_pred_map_it_maf_fac Vxx_pred_map_mdl_eng_maf Vxx_pred_map_mdl_it_maf Vxx_pred_map_psi_fac Vxx_pred_map_psi_fac_ofs Vxx_pred_map_psi_fac_slop Vxx_raw_mdl_map Vxx_raw_mdl_map_spg_rat Vxx_spg_amp_rat Vxx_temp0[0] Vxx_temp0[1] Vxx_temp1[0] Vxx_temp1[1] Vxx_temp2[0] Vxx_temp2[1] /end OUT_MEASUREMENT
/end FUNCTION
/begin FUNCTION InPciApi ""
 /begin SUB_FUNCTION InPciApi_Pedxxsr InPciApi_Pedinxx InPciApi_Sftpdxx InPciApi_Pedxxxx /end SUB_FUNCTION
/end FUNCTION
/begin FUNCTION InPciApi_Pedxxsr "" /begin DEF_CHARACTERISTIC Cxx_acel_pdl_sens_pws Cxx_acel_pdl_stab_thd /end DEF_CHARACTERISTIC
 /begin OUT_MEASUREMENT Vbx_acel_pdl_fil_sens_v1 Vbx_acel_pdl_fil_sens_v2 Vxx_acel_pdl_fil_sens_v1 Vxx_acel_pdl_fil_sens_v2 Vxx_acel_pdl_sens_rat1 Vxx_acel_pdl_sens_rat2 /end OUT_MEASUREMENT
/end FUNCTION
/end MODULE
/end PROJECT
