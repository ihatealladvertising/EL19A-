ASAP2_VERSION 1 41
/begin PROJECT RD8 "_default_ProjectLongIdentifier"
/begin HEADER "_default_HeaderComment" PROJECT_NO RD9 /end HEADER
/begin MODULE _default_ModuleName "_default_ModuleLongIdentifier"
/begin MOD_COMMON "_default_ModCommonComment" DEPOSIT ABSOLUTE BYTE_ORDER MSB_LAST ALIGNMENT_BYTE 1 ALIGNMENT_WORD 2 ALIGNMENT_LONG 2 ALIGNMENT_FLOAT32_IEEE 2 ALIGNMENT_FLOAT64_IEEE 4 /end MOD_COMMON
/begin CHARACTERISTIC Cxx_dtc_obd_igc_2_scg "" VALUE 0xa002b662 _REC_S1VAL_20_u2 65535. _CNV_A_R_A_105_CM 0. 65535. DISPLAY_IDENTIFIER fm_cal_igc_2_scg.Cxx_dtc_obd_xxx /end CHARACTERISTIC
/begin CHARACTERISTIC Cxx_conf_wal_igc_2_scg "" VALUE 0xa002b664 _REC_S1VAL_20_u1 3. _CNV_A_R_A_105_CM 0. 3. DISPLAY_IDENTIFIER fm_cal_igc_2_scg.fm_static_bitfield.Cxx_conf_wal_xxx BIT_MASK 0x3 /end CHARACTERISTIC
/begin CHARACTERISTIC Cbx_obd_igc_2_scg "" VALUE 0xa002b664 _REC_S1VAL_20_u1 255. _CNV_A_R_A_105_CM 0. 255. DISPLAY_IDENTIFIER fm_cal_igc_2_scg.fm_static_bitfield.Cbx_obd_xxx BIT_MASK 0x4 /end CHARACTERISTIC
/begin CHARACTERISTIC Cbx_obd_mena_igc_2_scg "" VALUE 0xa002b664 _REC_S1VAL_20_u1 255. _CNV_A_R_A_105_CM 0. 255. DISPLAY_IDENTIFIER fm_cal_igc_2_scg.fm_static_bitfield.Cbx_obd_mena_xxx BIT_MASK 0x8 /end CHARACTERISTIC
/begin CHARACTERISTIC Cxx_dtc_lb_igc_2_scg "" VALUE 0xa002b665 _REC_S1VAL_20_u1 255. _CNV_A_R_A_105_CM 0. 255. DISPLAY_IDENTIFIER fm_cal_igc_2_scg.Cxx_dtc_lb_xxx /end CHARACTERISTIC
/begin CHARACTERISTIC Cxx_obd_dc_igc_2_scg "" VALUE 0xa002b666 _REC_S1VAL_20_u1 9. _CNV_A_R_A_105_CM 1. 10. DISPLAY_IDENTIFIER fm_cal_igc_2_scg.Cxx_obd_dc_xxx /end CHARACTERISTIC
/begin CHARACTERISTIC Cxx_obd_us_typ_igc_2_scg "" VALUE 0xa002b667 _REC_S1VAL_20_u1 255. _CNV_A_R_A_105_CM 0. 255. DISPLAY_IDENTIFIER fm_cal_igc_2_scg.Cxx_obd_us_typ_xxx /end CHARACTERISTIC
/begin CHARACTERISTIC Cxx_dtc_obd_igc_2_scw "" VALUE 0xa002b66e _REC_S1VAL_20_u2 65535. _CNV_A_R_A_105_CM 0. 65535. DISPLAY_IDENTIFIER fm_cal_igc_2_scw.Cxx_dtc_obd_xxx /end CHARACTERISTIC
/begin CHARACTERISTIC Cxx_conf_wal_igc_2_scw "" VALUE 0xa002b670 _REC_S1VAL_20_u1 3. _CNV_A_R_A_105_CM 0. 3. DISPLAY_IDENTIFIER fm_cal_igc_2_scw.fm_static_bitfield.Cxx_conf_wal_xxx BIT_MASK 0x3 /end CHARACTERISTIC
/begin CHARACTERISTIC Cbx_obd_igc_2_scw "" VALUE 0xa002b670 _REC_S1VAL_20_u1 255. _CNV_A_R_A_105_CM 0. 255. DISPLAY_IDENTIFIER fm_cal_igc_2_scw.fm_static_bitfield.Cbx_obd_xxx BIT_MASK 0x4 /end CHARACTERISTIC
/begin CHARACTERISTIC Cbx_obd_mena_igc_2_scw "" VALUE 0xa002b670 _REC_S1VAL_20_u1 255. _CNV_A_R_A_105_CM 0. 255. DISPLAY_IDENTIFIER fm_cal_igc_2_scw.fm_static_bitfield.Cbx_obd_mena_xxx BIT_MASK 0x8 /end CHARACTERISTIC
/begin CHARACTERISTIC Cxx_dtc_lb_igc_2_scw "" VALUE 0xa002b671 _REC_S1VAL_20_u1 255. _CNV_A_R_A_105_CM 0. 255. DISPLAY_IDENTIFIER fm_cal_igc_2_scw.Cxx_dtc_lb_xxx /end CHARACTERISTIC
/begin CHARACTERISTIC Cxx_obd_dc_igc_2_scw "" VALUE 0xa002b672 _REC_S1VAL_20_u1 9. _CNV_A_R_A_105_CM 1. 10. DISPLAY_IDENTIFIER fm_cal_igc_2_scw.Cxx_obd_dc_xxx /end CHARACTERISTIC
/begin CHARACTERISTIC Cxx_obd_us_typ_igc_2_scw "" VALUE 0xa002b673 _REC_S1VAL_20_u1 255. _CNV_A_R_A_105_CM 0. 255. DISPLAY_IDENTIFIER fm_cal_igc_2_scw.Cxx_obd_us_typ_xxx /end CHARACTERISTIC
/begin CHARACTERISTIC Cxx_dtc_obd_igc_3_oc "" VALUE 0xa002b67a _REC_S1VAL_20_u2 65535. _CNV_A_R_A_105_CM 0. 65535. DISPLAY_IDENTIFIER fm_cal_igc_3_oc.Cxx_dtc_obd_xxx /end CHARACTERISTIC
/begin CHARACTERISTIC Cxx_conf_wal_igc_3_oc "" VALUE 0xa002b67c _REC_S1VAL_20_u1 3. _CNV_A_R_A_105_CM 0. 3. DISPLAY_IDENTIFIER fm_cal_igc_3_oc.fm_static_bitfield.Cxx_conf_wal_xxx BIT_MASK 0x3 /end CHARACTERISTIC
/begin CHARACTERISTIC Cbx_obd_igc_3_oc "" VALUE 0xa002b67c _REC_S1VAL_20_u1 255. _CNV_A_R_A_105_CM 0. 255. DISPLAY_IDENTIFIER fm_cal_igc_3_oc.fm_static_bitfield.Cbx_obd_xxx BIT_MASK 0x4 /end CHARACTERISTIC
/begin CHARACTERISTIC Cbx_obd_mena_igc_3_oc "" VALUE 0xa002b67c _REC_S1VAL_20_u1 255. _CNV_A_R_A_105_CM 0. 255. DISPLAY_IDENTIFIER fm_cal_igc_3_oc.fm_static_bitfield.Cbx_obd_mena_xxx BIT_MASK 0x8 /end CHARACTERISTIC
/begin CHARACTERISTIC Cxx_dtc_lb_igc_3_oc "" VALUE 0xa002b67d _REC_S1VAL_20_u1 255. _CNV_A_R_A_105_CM 0. 255. DISPLAY_IDENTIFIER fm_cal_igc_3_oc.Cxx_dtc_lb_xxx /end CHARACTERISTIC
/begin CHARACTERISTIC Cxx_obd_dc_igc_3_oc "" VALUE 0xa002b67e _REC_S1VAL_20_u1 9. _CNV_A_R_A_105_CM 1. 10. DISPLAY_IDENTIFIER fm_cal_igc_3_oc.Cxx_obd_dc_xxx /end CHARACTERISTIC
/begin CHARACTERISTIC Cxx_obd_us_typ_igc_3_oc "" VALUE 0xa002b67f _REC_S1VAL_20_u1 255. _CNV_A_R_A_105_CM 0. 255. DISPLAY_IDENTIFIER fm_cal_igc_3_oc.Cxx_obd_us_typ_xxx /end CHARACTERISTIC
/begin CHARACTERISTIC Cxx_dtc_obd_igc_3_scg "" VALUE 0xa002b686 _REC_S1VAL_20_u2 65535. _CNV_A_R_A_105_CM 0. 65535. DISPLAY_IDENTIFIER fm_cal_igc_3_scg.Cxx_dtc_obd_xxx /end CHARACTERISTIC
/begin CHARACTERISTIC Cxx_conf_wal_igc_3_scg "" VALUE 0xa002b688 _REC_S1VAL_20_u1 3. _CNV_A_R_A_105_CM 0. 3. DISPLAY_IDENTIFIER fm_cal_igc_3_scg.fm_static_bitfield.Cxx_conf_wal_xxx BIT_MASK 0x3 /end CHARACTERISTIC
/begin CHARACTERISTIC Cbx_obd_igc_3_scg "" VALUE 0xa002b688 _REC_S1VAL_20_u1 255. _CNV_A_R_A_105_CM 0. 255. DISPLAY_IDENTIFIER fm_cal_igc_3_scg.fm_static_bitfield.Cbx_obd_xxx BIT_MASK 0x4 /end CHARACTERISTIC
/begin CHARACTERISTIC Cbx_obd_mena_igc_3_scg "" VALUE 0xa002b688 _REC_S1VAL_20_u1 255. _CNV_A_R_A_105_CM 0. 255. DISPLAY_IDENTIFIER fm_cal_igc_3_scg.fm_static_bitfield.Cbx_obd_mena_xxx BIT_MASK 0x8 /end CHARACTERISTIC
/begin CHARACTERISTIC Cxx_dtc_lb_igc_3_scg "" VALUE 0xa002b689 _REC_S1VAL_20_u1 255. _CNV_A_R_A_105_CM 0. 255. DISPLAY_IDENTIFIER fm_cal_igc_3_scg.Cxx_dtc_lb_xxx /end CHARACTERISTIC
/begin CHARACTERISTIC Cxx_obd_dc_igc_3_scg "" VALUE 0xa002b68a _REC_S1VAL_20_u1 9. _CNV_A_R_A_105_CM 1. 10. DISPLAY_IDENTIFIER fm_cal_igc_3_scg.Cxx_obd_dc_xxx /end CHARACTERISTIC
/begin CHARACTERISTIC Cxx_obd_us_typ_igc_3_scg "" VALUE 0xa002b68b _REC_S1VAL_20_u1 255. _CNV_A_R_A_105_CM 0. 255. DISPLAY_IDENTIFIER fm_cal_igc_3_scg.Cxx_obd_us_typ_xxx /end CHARACTERISTIC
/begin CHARACTERISTIC Cxx_dtc_obd_igc_3_scw "" VALUE 0xa002b692 _REC_S1VAL_20_u2 65535. _CNV_A_R_A_105_CM 0. 65535. DISPLAY_IDENTIFIER fm_cal_igc_3_scw.Cxx_dtc_obd_xxx /end CHARACTERISTIC
/begin CHARACTERISTIC Cxx_conf_wal_igc_3_scw "" VALUE 0xa002b694 _REC_S1VAL_20_u1 3. _CNV_A_R_A_105_CM 0. 3. DISPLAY_IDENTIFIER fm_cal_igc_3_scw.fm_static_bitfield.Cxx_conf_wal_xxx BIT_MASK 0x3 /end CHARACTERISTIC
/begin CHARACTERISTIC Cbx_obd_igc_3_scw "" VALUE 0xa002b694 _REC_S1VAL_20_u1 255. _CNV_A_R_A_105_CM 0. 255. DISPLAY_IDENTIFIER fm_cal_igc_3_scw.fm_static_bitfield.Cbx_obd_xxx BIT_MASK 0x4 /end CHARACTERISTIC
/begin CHARACTERISTIC Cbx_obd_mena_igc_3_scw "" VALUE 0xa002b694 _REC_S1VAL_20_u1 255. _CNV_A_R_A_105_CM 0. 255. DISPLAY_IDENTIFIER fm_cal_igc_3_scw.fm_static_bitfield.Cbx_obd_mena_xxx BIT_MASK 0x8 /end CHARACTERISTIC
/begin CHARACTERISTIC Cxx_dtc_lb_igc_3_scw "" VALUE 0xa002b695 _REC_S1VAL_20_u1 255. _CNV_A_R_A_105_CM 0. 255. DISPLAY_IDENTIFIER fm_cal_igc_3_scw.Cxx_dtc_lb_xxx /end CHARACTERISTIC
/begin CHARACTERISTIC Cxx_obd_dc_igc_3_scw "" VALUE 0xa002b696 _REC_S1VAL_20_u1 9. _CNV_A_R_A_105_CM 1. 10. DISPLAY_IDENTIFIER fm_cal_igc_3_scw.Cxx_obd_dc_xxx /end CHARACTERISTIC
/begin CHARACTERISTIC Cxx_obd_us_typ_igc_3_scw "" VALUE 0xa002b697 _REC_S1VAL_20_u1 255. _CNV_A_R_A_105_CM 0. 255. DISPLAY_IDENTIFIER fm_cal_igc_3_scw.Cxx_obd_us_typ_xxx /end CHARACTERISTIC
/begin CHARACTERISTIC Cxx_dtc_obd_igc_4_oc "" VALUE 0xa002b69e _REC_S1VAL_20_u2 65535. _CNV_A_R_A_105_CM 0. 65535. DISPLAY_IDENTIFIER fm_cal_igc_4_oc.Cxx_dtc_obd_xxx /end CHARACTERISTIC
/begin CHARACTERISTIC Cxx_conf_wal_igc_4_oc "" VALUE 0xa002b6a0 _REC_S1VAL_20_u1 3. _CNV_A_R_A_105_CM 0. 3. DISPLAY_IDENTIFIER fm_cal_igc_4_oc.fm_static_bitfield.Cxx_conf_wal_xxx BIT_MASK 0x3 /end CHARACTERISTIC
/begin CHARACTERISTIC Cbx_obd_igc_4_oc "" VALUE 0xa002b6a0 _REC_S1VAL_20_u1 255. _CNV_A_R_A_105_CM 0. 255. DISPLAY_IDENTIFIER fm_cal_igc_4_oc.fm_static_bitfield.Cbx_obd_xxx BIT_MASK 0x4 /end CHARACTERISTIC
/begin CHARACTERISTIC Cbx_obd_mena_igc_4_oc "" VALUE 0xa002b6a0 _REC_S1VAL_20_u1 255. _CNV_A_R_A_105_CM 0. 255. DISPLAY_IDENTIFIER fm_cal_igc_4_oc.fm_static_bitfield.Cbx_obd_mena_xxx BIT_MASK 0x8 /end CHARACTERISTIC
/begin CHARACTERISTIC Cxx_dtc_lb_igc_4_oc "" VALUE 0xa002b6a1 _REC_S1VAL_20_u1 255. _CNV_A_R_A_105_CM 0. 255. DISPLAY_IDENTIFIER fm_cal_igc_4_oc.Cxx_dtc_lb_xxx /end CHARACTERISTIC
/begin CHARACTERISTIC Cxx_obd_dc_igc_4_oc "" VALUE 0xa002b6a2 _REC_S1VAL_20_u1 9. _CNV_A_R_A_105_CM 1. 10. DISPLAY_IDENTIFIER fm_cal_igc_4_oc.Cxx_obd_dc_xxx /end CHARACTERISTIC
/begin CHARACTERISTIC Cxx_obd_us_typ_igc_4_oc "" VALUE 0xa002b6a3 _REC_S1VAL_20_u1 255. _CNV_A_R_A_105_CM 0. 255. DISPLAY_IDENTIFIER fm_cal_igc_4_oc.Cxx_obd_us_typ_xxx /end CHARACTERISTIC
/begin CHARACTERISTIC Cxx_dtc_obd_igc_4_scg "" VALUE 0xa002b6aa _REC_S1VAL_20_u2 65535. _CNV_A_R_A_105_CM 0. 65535. DISPLAY_IDENTIFIER fm_cal_igc_4_scg.Cxx_dtc_obd_xxx /end CHARACTERISTIC
/begin CHARACTERISTIC Cxx_conf_wal_igc_4_scg "" VALUE 0xa002b6ac _REC_S1VAL_20_u1 3. _CNV_A_R_A_105_CM 0. 3. DISPLAY_IDENTIFIER fm_cal_igc_4_scg.fm_static_bitfield.Cxx_conf_wal_xxx BIT_MASK 0x3 /end CHARACTERISTIC
/begin CHARACTERISTIC Cbx_obd_igc_4_scg "" VALUE 0xa002b6ac _REC_S1VAL_20_u1 255. _CNV_A_R_A_105_CM 0. 255. DISPLAY_IDENTIFIER fm_cal_igc_4_scg.fm_static_bitfield.Cbx_obd_xxx BIT_MASK 0x4 /end CHARACTERISTIC
/begin CHARACTERISTIC Cbx_obd_mena_igc_4_scg "" VALUE 0xa002b6ac _REC_S1VAL_20_u1 255. _CNV_A_R_A_105_CM 0. 255. DISPLAY_IDENTIFIER fm_cal_igc_4_scg.fm_static_bitfield.Cbx_obd_mena_xxx BIT_MASK 0x8 /end CHARACTERISTIC
/begin CHARACTERISTIC Cxx_dtc_lb_igc_4_scg "" VALUE 0xa002b6ad _REC_S1VAL_20_u1 255. _CNV_A_R_A_105_CM 0. 255. DISPLAY_IDENTIFIER fm_cal_igc_4_scg.Cxx_dtc_lb_xxx /end CHARACTERISTIC
/begin CHARACTERISTIC Cxx_obd_dc_igc_4_scg "" VALUE 0xa002b6ae _REC_S1VAL_20_u1 9. _CNV_A_R_A_105_CM 1. 10. DISPLAY_IDENTIFIER fm_cal_igc_4_scg.Cxx_obd_dc_xxx /end CHARACTERISTIC
/begin CHARACTERISTIC Cxx_obd_us_typ_igc_4_scg "" VALUE 0xa002b6af _REC_S1VAL_20_u1 255. _CNV_A_R_A_105_CM 0. 255. DISPLAY_IDENTIFIER fm_cal_igc_4_scg.Cxx_obd_us_typ_xxx /end CHARACTERISTIC
/begin CHARACTERISTIC Cxx_dtc_obd_igc_4_scw "" VALUE 0xa002b6b6 _REC_S1VAL_20_u2 65535. _CNV_A_R_A_105_CM 0. 65535. DISPLAY_IDENTIFIER fm_cal_igc_4_scw.Cxx_dtc_obd_xxx /end CHARACTERISTIC
/begin CHARACTERISTIC Cxx_conf_wal_igc_4_scw "" VALUE 0xa002b6b8 _REC_S1VAL_20_u1 3. _CNV_A_R_A_105_CM 0. 3. DISPLAY_IDENTIFIER fm_cal_igc_4_scw.fm_static_bitfield.Cxx_conf_wal_xxx BIT_MASK 0x3 /end CHARACTERISTIC
/begin CHARACTERISTIC Cbx_obd_igc_4_scw "" VALUE 0xa002b6b8 _REC_S1VAL_20_u1 255. _CNV_A_R_A_105_CM 0. 255. DISPLAY_IDENTIFIER fm_cal_igc_4_scw.fm_static_bitfield.Cbx_obd_xxx BIT_MASK 0x4 /end CHARACTERISTIC
/begin CHARACTERISTIC Cbx_obd_mena_igc_4_scw "" VALUE 0xa002b6b8 _REC_S1VAL_20_u1 255. _CNV_A_R_A_105_CM 0. 255. DISPLAY_IDENTIFIER fm_cal_igc_4_scw.fm_static_bitfield.Cbx_obd_mena_xxx BIT_MASK 0x8 /end CHARACTERISTIC
/begin CHARACTERISTIC Cxx_dtc_lb_igc_4_scw "" VALUE 0xa002b6b9 _REC_S1VAL_20_u1 255. _CNV_A_R_A_105_CM 0. 255. DISPLAY_IDENTIFIER fm_cal_igc_4_scw.Cxx_dtc_lb_xxx /end CHARACTERISTIC
/begin CHARACTERISTIC Cxx_obd_dc_igc_4_scw "" VALUE 0xa002b6ba _REC_S1VAL_20_u1 9. _CNV_A_R_A_105_CM 1. 10. DISPLAY_IDENTIFIER fm_cal_igc_4_scw.Cxx_obd_dc_xxx /end CHARACTERISTIC
/begin CHARACTERISTIC Cxx_obd_us_typ_igc_4_scw "" VALUE 0xa002b6bb _REC_S1VAL_20_u1 255. _CNV_A_R_A_105_CM 0. 255. DISPLAY_IDENTIFIER fm_cal_igc_4_scw.Cxx_obd_us_typ_xxx /end CHARACTERISTIC
/begin CHARACTERISTIC Cxx_dtc_obd_in_cam_chr "" VALUE 0xa002b43a _REC_S1VAL_20_u2 65535. _CNV_A_R_A_105_CM 0. 65535. DISPLAY_IDENTIFIER fm_cal_in_cam_chr.Cxx_dtc_obd_xxx /end CHARACTERISTIC
/begin CHARACTERISTIC Cxx_conf_wal_in_cam_chr "" VALUE 0xa002b43c _REC_S1VAL_20_u1 3. _CNV_A_R_A_105_CM 0. 3. DISPLAY_IDENTIFIER fm_cal_in_cam_chr.fm_static_bitfield.Cxx_conf_wal_xxx BIT_MASK 0x3 /end CHARACTERISTIC
/begin CHARACTERISTIC Cbx_obd_in_cam_chr "" VALUE 0xa002b43c _REC_S1VAL_20_u1 255. _CNV_A_R_A_105_CM 0. 255. DISPLAY_IDENTIFIER fm_cal_in_cam_chr.fm_static_bitfield.Cbx_obd_xxx BIT_MASK 0x4 /end CHARACTERISTIC
/begin CHARACTERISTIC Cbx_obd_mena_in_cam_chr "" VALUE 0xa002b43c _REC_S1VAL_20_u1 255. _CNV_A_R_A_105_CM 0. 255. DISPLAY_IDENTIFIER fm_cal_in_cam_chr.fm_static_bitfield.Cbx_obd_mena_xxx BIT_MASK 0x8 /end CHARACTERISTIC
/begin CHARACTERISTIC Cxx_dtc_lb_in_cam_chr "" VALUE 0xa002b43d _REC_S1VAL_20_u1 255. _CNV_A_R_A_105_CM 0. 255. DISPLAY_IDENTIFIER fm_cal_in_cam_chr.Cxx_dtc_lb_xxx /end CHARACTERISTIC
/begin CHARACTERISTIC Cxx_obd_dc_in_cam_chr "" VALUE 0xa002b43e _REC_S1VAL_20_u1 9. _CNV_A_R_A_105_CM 1. 10. DISPLAY_IDENTIFIER fm_cal_in_cam_chr.Cxx_obd_dc_xxx /end CHARACTERISTIC
/begin CHARACTERISTIC Cxx_obd_us_typ_in_cam_chr "" VALUE 0xa002b43f _REC_S1VAL_20_u1 255. _CNV_A_R_A_105_CM 0. 255. DISPLAY_IDENTIFIER fm_cal_in_cam_chr.Cxx_obd_us_typ_xxx /end CHARACTERISTIC
/begin CHARACTERISTIC Cxx_dtc_obd_in_cam_crk_cmp "" VALUE 0xa002b446 _REC_S1VAL_20_u2 65535. _CNV_A_R_A_105_CM 0. 65535. DISPLAY_IDENTIFIER fm_cal_in_cam_crk_cmp.Cxx_dtc_obd_xxx /end CHARACTERISTIC
/begin CHARACTERISTIC Cxx_conf_wal_in_cam_crk_cmp "" VALUE 0xa002b448 _REC_S1VAL_20_u1 3. _CNV_A_R_A_105_CM 0. 3. DISPLAY_IDENTIFIER fm_cal_in_cam_crk_cmp.fm_static_bitfield.Cxx_conf_wal_xxx BIT_MASK 0x3 /end CHARACTERISTIC
/begin CHARACTERISTIC Cbx_obd_in_cam_crk_cmp "" VALUE 0xa002b448 _REC_S1VAL_20_u1 255. _CNV_A_R_A_105_CM 0. 255. DISPLAY_IDENTIFIER fm_cal_in_cam_crk_cmp.fm_static_bitfield.Cbx_obd_xxx BIT_MASK 0x4 /end CHARACTERISTIC
/begin CHARACTERISTIC Cbx_obd_mena_in_cam_crk_cmp "" VALUE 0xa002b448 _REC_S1VAL_20_u1 255. _CNV_A_R_A_105_CM 0. 255. DISPLAY_IDENTIFIER fm_cal_in_cam_crk_cmp.fm_static_bitfield.Cbx_obd_mena_xxx BIT_MASK 0x8 /end CHARACTERISTIC
/begin CHARACTERISTIC Cxx_dtc_lb_in_cam_crk_cmp "" VALUE 0xa002b449 _REC_S1VAL_20_u1 255. _CNV_A_R_A_105_CM 0. 255. DISPLAY_IDENTIFIER fm_cal_in_cam_crk_cmp.Cxx_dtc_lb_xxx /end CHARACTERISTIC
/begin CHARACTERISTIC Cxx_obd_dc_in_cam_crk_cmp "" VALUE 0xa002b44a _REC_S1VAL_20_u1 9. _CNV_A_R_A_105_CM 1. 10. DISPLAY_IDENTIFIER fm_cal_in_cam_crk_cmp.Cxx_obd_dc_xxx /end CHARACTERISTIC
/begin CHARACTERISTIC Cxx_obd_us_typ_in_cam_crk_cmp "" VALUE 0xa002b44b _REC_S1VAL_20_u1 255. _CNV_A_R_A_105_CM 0. 255. DISPLAY_IDENTIFIER fm_cal_in_cam_crk_cmp.Cxx_obd_us_typ_xxx /end CHARACTERISTIC
/begin CHARACTERISTIC Cxx_dtc_obd_in_cam_cyc "" VALUE 0xa002b506 _REC_S1VAL_20_u2 65535. _CNV_A_R_A_105_CM 0. 65535. DISPLAY_IDENTIFIER fm_cal_in_cam_cyc.Cxx_dtc_obd_xxx /end CHARACTERISTIC
/begin CHARACTERISTIC Cxx_conf_wal_in_cam_cyc "" VALUE 0xa002b508 _REC_S1VAL_20_u1 3. _CNV_A_R_A_105_CM 0. 3. DISPLAY_IDENTIFIER fm_cal_in_cam_cyc.fm_static_bitfield.Cxx_conf_wal_xxx BIT_MASK 0x3 /end CHARACTERISTIC
/begin CHARACTERISTIC Cbx_obd_in_cam_cyc "" VALUE 0xa002b508 _REC_S1VAL_20_u1 255. _CNV_A_R_A_105_CM 0. 255. DISPLAY_IDENTIFIER fm_cal_in_cam_cyc.fm_static_bitfield.Cbx_obd_xxx BIT_MASK 0x4 /end CHARACTERISTIC
/begin CHARACTERISTIC Cbx_obd_mena_in_cam_cyc "" VALUE 0xa002b508 _REC_S1VAL_20_u1 255. _CNV_A_R_A_105_CM 0. 255. DISPLAY_IDENTIFIER fm_cal_in_cam_cyc.fm_static_bitfield.Cbx_obd_mena_xxx BIT_MASK 0x8 /end CHARACTERISTIC
/begin CHARACTERISTIC Cxx_dtc_lb_in_cam_cyc "" VALUE 0xa002b509 _REC_S1VAL_20_u1 255. _CNV_A_R_A_105_CM 0. 255. DISPLAY_IDENTIFIER fm_cal_in_cam_cyc.Cxx_dtc_lb_xxx /end CHARACTERISTIC
/begin CHARACTERISTIC Cxx_obd_dc_in_cam_cyc "" VALUE 0xa002b50a _REC_S1VAL_20_u1 9. _CNV_A_R_A_105_CM 1. 10. DISPLAY_IDENTIFIER fm_cal_in_cam_cyc.Cxx_obd_dc_xxx /end CHARACTERISTIC
/begin CHARACTERISTIC Cxx_obd_us_typ_in_cam_cyc "" VALUE 0xa002b50b _REC_S1VAL_20_u1 255. _CNV_A_R_A_105_CM 0. 255. DISPLAY_IDENTIFIER fm_cal_in_cam_cyc.Cxx_obd_us_typ_xxx /end CHARACTERISTIC
/begin CHARACTERISTIC Cxx_dtc_obd_in_cam_no_sig "" VALUE 0xa002b452 _REC_S1VAL_20_u2 65535. _CNV_A_R_A_105_CM 0. 65535. DISPLAY_IDENTIFIER fm_cal_in_cam_no_sig.Cxx_dtc_obd_xxx /end CHARACTERISTIC
/begin CHARACTERISTIC Cxx_conf_wal_in_cam_no_sig "" VALUE 0xa002b454 _REC_S1VAL_20_u1 3. _CNV_A_R_A_105_CM 0. 3. DISPLAY_IDENTIFIER fm_cal_in_cam_no_sig.fm_static_bitfield.Cxx_conf_wal_xxx BIT_MASK 0x3 /end CHARACTERISTIC
/begin CHARACTERISTIC Cbx_obd_in_cam_no_sig "" VALUE 0xa002b454 _REC_S1VAL_20_u1 255. _CNV_A_R_A_105_CM 0. 255. DISPLAY_IDENTIFIER fm_cal_in_cam_no_sig.fm_static_bitfield.Cbx_obd_xxx BIT_MASK 0x4 /end CHARACTERISTIC
/begin CHARACTERISTIC Cbx_obd_mena_in_cam_no_sig "" VALUE 0xa002b454 _REC_S1VAL_20_u1 255. _CNV_A_R_A_105_CM 0. 255. DISPLAY_IDENTIFIER fm_cal_in_cam_no_sig.fm_static_bitfield.Cbx_obd_mena_xxx BIT_MASK 0x8 /end CHARACTERISTIC
/begin CHARACTERISTIC Cxx_dtc_lb_in_cam_no_sig "" VALUE 0xa002b455 _REC_S1VAL_20_u1 255. _CNV_A_R_A_105_CM 0. 255. DISPLAY_IDENTIFIER fm_cal_in_cam_no_sig.Cxx_dtc_lb_xxx /end CHARACTERISTIC
/begin CHARACTERISTIC Cxx_obd_dc_in_cam_no_sig "" VALUE 0xa002b456 _REC_S1VAL_20_u1 9. _CNV_A_R_A_105_CM 1. 10. DISPLAY_IDENTIFIER fm_cal_in_cam_no_sig.Cxx_obd_dc_xxx /end CHARACTERISTIC
/begin CHARACTERISTIC Cxx_obd_us_typ_in_cam_no_sig "" VALUE 0xa002b457 _REC_S1VAL_20_u1 255. _CNV_A_R_A_105_CM 0. 255. DISPLAY_IDENTIFIER fm_cal_in_cam_no_sig.Cxx_obd_us_typ_xxx /end CHARACTERISTIC
/begin CHARACTERISTIC Cxx_dtc_obd_in_cam_nok "" VALUE 0xa002b4fa _REC_S1VAL_20_u2 65535. _CNV_A_R_A_105_CM 0. 65535. DISPLAY_IDENTIFIER fm_cal_in_cam_nok.Cxx_dtc_obd_xxx /end CHARACTERISTIC
/begin CHARACTERISTIC Cxx_conf_wal_in_cam_nok "" VALUE 0xa002b4fc _REC_S1VAL_20_u1 3. _CNV_A_R_A_105_CM 0. 3. DISPLAY_IDENTIFIER fm_cal_in_cam_nok.fm_static_bitfield.Cxx_conf_wal_xxx BIT_MASK 0x3 /end CHARACTERISTIC
/begin CHARACTERISTIC Cbx_obd_in_cam_nok "" VALUE 0xa002b4fc _REC_S1VAL_20_u1 255. _CNV_A_R_A_105_CM 0. 255. DISPLAY_IDENTIFIER fm_cal_in_cam_nok.fm_static_bitfield.Cbx_obd_xxx BIT_MASK 0x4 /end CHARACTERISTIC
/begin CHARACTERISTIC Cbx_obd_mena_in_cam_nok "" VALUE 0xa002b4fc _REC_S1VAL_20_u1 255. _CNV_A_R_A_105_CM 0. 255. DISPLAY_IDENTIFIER fm_cal_in_cam_nok.fm_static_bitfield.Cbx_obd_mena_xxx BIT_MASK 0x8 /end CHARACTERISTIC
/begin CHARACTERISTIC Cxx_dtc_lb_in_cam_nok "" VALUE 0xa002b4fd _REC_S1VAL_20_u1 255. _CNV_A_R_A_105_CM 0. 255. DISPLAY_IDENTIFIER fm_cal_in_cam_nok.Cxx_dtc_lb_xxx /end CHARACTERISTIC
/begin CHARACTERISTIC Cxx_obd_dc_in_cam_nok "" VALUE 0xa002b4fe _REC_S1VAL_20_u1 9. _CNV_A_R_A_105_CM 1. 10. DISPLAY_IDENTIFIER fm_cal_in_cam_nok.Cxx_obd_dc_xxx /end CHARACTERISTIC
/begin CHARACTERISTIC Cxx_obd_us_typ_in_cam_nok "" VALUE 0xa002b4ff _REC_S1VAL_20_u1 255. _CNV_A_R_A_105_CM 0. 255. DISPLAY_IDENTIFIER fm_cal_in_cam_nok.Cxx_obd_us_typ_xxx /end CHARACTERISTIC
/begin CHARACTERISTIC Cxx_dtc_obd_in_vvtc_ad "" VALUE 0xa002b45e _REC_S1VAL_20_u2 65535. _CNV_A_R_A_105_CM 0. 65535. DISPLAY_IDENTIFIER fm_cal_in_vvtc_ad.Cxx_dtc_obd_xxx /end CHARACTERISTIC
/begin CHARACTERISTIC Cxx_conf_wal_in_vvtc_ad "" VALUE 0xa002b460 _REC_S1VAL_20_u1 3. _CNV_A_R_A_105_CM 0. 3. DISPLAY_IDENTIFIER fm_cal_in_vvtc_ad.fm_static_bitfield.Cxx_conf_wal_xxx BIT_MASK 0x3 /end CHARACTERISTIC
/begin CHARACTERISTIC Cbx_obd_in_vvtc_ad "" VALUE 0xa002b460 _REC_S1VAL_20_u1 255. _CNV_A_R_A_105_CM 0. 255. DISPLAY_IDENTIFIER fm_cal_in_vvtc_ad.fm_static_bitfield.Cbx_obd_xxx BIT_MASK 0x4 /end CHARACTERISTIC
/begin CHARACTERISTIC Cbx_obd_mena_in_vvtc_ad "" VALUE 0xa002b460 _REC_S1VAL_20_u1 255. _CNV_A_R_A_105_CM 0. 255. DISPLAY_IDENTIFIER fm_cal_in_vvtc_ad.fm_static_bitfield.Cbx_obd_mena_xxx BIT_MASK 0x8 /end CHARACTERISTIC
/begin CHARACTERISTIC Cxx_dtc_lb_in_vvtc_ad "" VALUE 0xa002b461 _REC_S1VAL_20_u1 255. _CNV_A_R_A_105_CM 0. 255. DISPLAY_IDENTIFIER fm_cal_in_vvtc_ad.Cxx_dtc_lb_xxx /end CHARACTERISTIC
/begin CHARACTERISTIC Cxx_obd_dc_in_vvtc_ad "" VALUE 0xa002b462 _REC_S1VAL_20_u1 9. _CNV_A_R_A_105_CM 1. 10. DISPLAY_IDENTIFIER fm_cal_in_vvtc_ad.Cxx_obd_dc_xxx /end CHARACTERISTIC
/begin CHARACTERISTIC Cxx_obd_us_typ_in_vvtc_ad "" VALUE 0xa002b463 _REC_S1VAL_20_u1 255. _CNV_A_R_A_105_CM 0. 255. DISPLAY_IDENTIFIER fm_cal_in_vvtc_ad.Cxx_obd_us_typ_xxx /end CHARACTERISTIC
/begin CHARACTERISTIC Cxx_dtc_obd_in_vvtc_blk "" VALUE 0xa002aed6 _REC_S1VAL_20_u2 65535. _CNV_A_R_A_105_CM 0. 65535. DISPLAY_IDENTIFIER fm_cal_in_vvtc_blk.Cxx_dtc_obd_xxx /end CHARACTERISTIC
/begin CHARACTERISTIC Cxx_conf_wal_in_vvtc_blk "" VALUE 0xa002aed8 _REC_S1VAL_20_u1 3. _CNV_A_R_A_105_CM 0. 3. DISPLAY_IDENTIFIER fm_cal_in_vvtc_blk.fm_static_bitfield.Cxx_conf_wal_xxx BIT_MASK 0x3 /end CHARACTERISTIC
/begin CHARACTERISTIC Cbx_obd_in_vvtc_blk "" VALUE 0xa002aed8 _REC_S1VAL_20_u1 255. _CNV_A_R_A_105_CM 0. 255. DISPLAY_IDENTIFIER fm_cal_in_vvtc_blk.fm_static_bitfield.Cbx_obd_xxx BIT_MASK 0x4 /end CHARACTERISTIC
/begin CHARACTERISTIC Cbx_obd_mena_in_vvtc_blk "" VALUE 0xa002aed8 _REC_S1VAL_20_u1 255. _CNV_A_R_A_105_CM 0. 255. DISPLAY_IDENTIFIER fm_cal_in_vvtc_blk.fm_static_bitfield.Cbx_obd_mena_xxx BIT_MASK 0x8 /end CHARACTERISTIC
/begin CHARACTERISTIC Cxx_dtc_lb_in_vvtc_blk "" VALUE 0xa002aed9 _REC_S1VAL_20_u1 255. _CNV_A_R_A_105_CM 0. 255. DISPLAY_IDENTIFIER fm_cal_in_vvtc_blk.Cxx_dtc_lb_xxx /end CHARACTERISTIC
/begin CHARACTERISTIC Cxx_obd_dc_in_vvtc_blk "" VALUE 0xa002aeda _REC_S1VAL_20_u1 9. _CNV_A_R_A_105_CM 1. 10. DISPLAY_IDENTIFIER fm_cal_in_vvtc_blk.Cxx_obd_dc_xxx /end CHARACTERISTIC
/begin CHARACTERISTIC Cxx_obd_us_typ_in_vvtc_blk "" VALUE 0xa002aedb _REC_S1VAL_20_u1 255. _CNV_A_R_A_105_CM 0. 255. DISPLAY_IDENTIFIER fm_cal_in_vvtc_blk.Cxx_obd_us_typ_xxx /end CHARACTERISTIC
/begin CHARACTERISTIC Cxx_dtc_obd_in_vvtc_dirt_lkg "" VALUE 0xa002aee2 _REC_S1VAL_20_u2 65535. _CNV_A_R_A_105_CM 0. 65535. DISPLAY_IDENTIFIER fm_cal_in_vvtc_dirt_lkg.Cxx_dtc_obd_xxx /end CHARACTERISTIC
/begin CHARACTERISTIC Cxx_conf_wal_in_vvtc_dirt_lkg "" VALUE 0xa002aee4 _REC_S1VAL_20_u1 3. _CNV_A_R_A_105_CM 0. 3. DISPLAY_IDENTIFIER fm_cal_in_vvtc_dirt_lkg.fm_static_bitfield.Cxx_conf_wal_xxx BIT_MASK 0x3 /end CHARACTERISTIC
/begin CHARACTERISTIC Cbx_obd_in_vvtc_dirt_lkg "" VALUE 0xa002aee4 _REC_S1VAL_20_u1 255. _CNV_A_R_A_105_CM 0. 255. DISPLAY_IDENTIFIER fm_cal_in_vvtc_dirt_lkg.fm_static_bitfield.Cbx_obd_xxx BIT_MASK 0x4 /end CHARACTERISTIC
/begin CHARACTERISTIC Cbx_obd_mena_in_vvtc_dirt_lkg "" VALUE 0xa002aee4 _REC_S1VAL_20_u1 255. _CNV_A_R_A_105_CM 0. 255. DISPLAY_IDENTIFIER fm_cal_in_vvtc_dirt_lkg.fm_static_bitfield.Cbx_obd_mena_xxx BIT_MASK 0x8 /end CHARACTERISTIC
/begin CHARACTERISTIC Cxx_dtc_lb_in_vvtc_dirt_lkg "" VALUE 0xa002aee5 _REC_S1VAL_20_u1 255. _CNV_A_R_A_105_CM 0. 255. DISPLAY_IDENTIFIER fm_cal_in_vvtc_dirt_lkg.Cxx_dtc_lb_xxx /end CHARACTERISTIC
/begin CHARACTERISTIC Cxx_obd_dc_in_vvtc_dirt_lkg "" VALUE 0xa002aee6 _REC_S1VAL_20_u1 9. _CNV_A_R_A_105_CM 1. 10. DISPLAY_IDENTIFIER fm_cal_in_vvtc_dirt_lkg.Cxx_obd_dc_xxx /end CHARACTERISTIC
/begin CHARACTERISTIC Cxx_obd_us_typ_in_vvtc_dirt_lkg "" VALUE 0xa002aee7 _REC_S1VAL_20_u1 255. _CNV_A_R_A_105_CM 0. 255. DISPLAY_IDENTIFIER fm_cal_in_vvtc_dirt_lkg.Cxx_obd_us_typ_xxx /end CHARACTERISTIC
/begin CHARACTERISTIC Cxx_dtc_obd_in_vvtc_sldv_oc "" VALUE 0xa002aeee _REC_S1VAL_20_u2 65535. _CNV_A_R_A_105_CM 0. 65535. DISPLAY_IDENTIFIER fm_cal_in_vvtc_sldv_oc.Cxx_dtc_obd_xxx /end CHARACTERISTIC
/begin CHARACTERISTIC Cxx_conf_wal_in_vvtc_sldv_oc "" VALUE 0xa002aef0 _REC_S1VAL_20_u1 3. _CNV_A_R_A_105_CM 0. 3. DISPLAY_IDENTIFIER fm_cal_in_vvtc_sldv_oc.fm_static_bitfield.Cxx_conf_wal_xxx BIT_MASK 0x3 /end CHARACTERISTIC
/begin CHARACTERISTIC Cbx_obd_in_vvtc_sldv_oc "" VALUE 0xa002aef0 _REC_S1VAL_20_u1 255. _CNV_A_R_A_105_CM 0. 255. DISPLAY_IDENTIFIER fm_cal_in_vvtc_sldv_oc.fm_static_bitfield.Cbx_obd_xxx BIT_MASK 0x4 /end CHARACTERISTIC
/begin CHARACTERISTIC Cbx_obd_mena_in_vvtc_sldv_oc "" VALUE 0xa002aef0 _REC_S1VAL_20_u1 255. _CNV_A_R_A_105_CM 0. 255. DISPLAY_IDENTIFIER fm_cal_in_vvtc_sldv_oc.fm_static_bitfield.Cbx_obd_mena_xxx BIT_MASK 0x8 /end CHARACTERISTIC
/begin CHARACTERISTIC Cxx_dtc_lb_in_vvtc_sldv_oc "" VALUE 0xa002aef1 _REC_S1VAL_20_u1 255. _CNV_A_R_A_105_CM 0. 255. DISPLAY_IDENTIFIER fm_cal_in_vvtc_sldv_oc.Cxx_dtc_lb_xxx /end CHARACTERISTIC
/begin CHARACTERISTIC Cxx_obd_dc_in_vvtc_sldv_oc "" VALUE 0xa002aef2 _REC_S1VAL_20_u1 9. _CNV_A_R_A_105_CM 1. 10. DISPLAY_IDENTIFIER fm_cal_in_vvtc_sldv_oc.Cxx_obd_dc_xxx /end CHARACTERISTIC
/begin CHARACTERISTIC Cxx_obd_us_typ_in_vvtc_sldv_oc "" VALUE 0xa002aef3 _REC_S1VAL_20_u1 255. _CNV_A_R_A_105_CM 0. 255. DISPLAY_IDENTIFIER fm_cal_in_vvtc_sldv_oc.Cxx_obd_us_typ_xxx /end CHARACTERISTIC
/begin CHARACTERISTIC Cxx_dtc_obd_in_vvtc_sldv_scg "" VALUE 0xa002aefa _REC_S1VAL_20_u2 65535. _CNV_A_R_A_105_CM 0. 65535. DISPLAY_IDENTIFIER fm_cal_in_vvtc_sldv_scg.Cxx_dtc_obd_xxx /end CHARACTERISTIC
/begin CHARACTERISTIC Cxx_conf_wal_in_vvtc_sldv_scg "" VALUE 0xa002aefc _REC_S1VAL_20_u1 3. _CNV_A_R_A_105_CM 0. 3. DISPLAY_IDENTIFIER fm_cal_in_vvtc_sldv_scg.fm_static_bitfield.Cxx_conf_wal_xxx BIT_MASK 0x3 /end CHARACTERISTIC
/begin CHARACTERISTIC Cbx_obd_in_vvtc_sldv_scg "" VALUE 0xa002aefc _REC_S1VAL_20_u1 255. _CNV_A_R_A_105_CM 0. 255. DISPLAY_IDENTIFIER fm_cal_in_vvtc_sldv_scg.fm_static_bitfield.Cbx_obd_xxx BIT_MASK 0x4 /end CHARACTERISTIC
/begin CHARACTERISTIC Cbx_obd_mena_in_vvtc_sldv_scg "" VALUE 0xa002aefc _REC_S1VAL_20_u1 255. _CNV_A_R_A_105_CM 0. 255. DISPLAY_IDENTIFIER fm_cal_in_vvtc_sldv_scg.fm_static_bitfield.Cbx_obd_mena_xxx BIT_MASK 0x8 /end CHARACTERISTIC
/begin CHARACTERISTIC Cxx_dtc_lb_in_vvtc_sldv_scg "" VALUE 0xa002aefd _REC_S1VAL_20_u1 255. _CNV_A_R_A_105_CM 0. 255. DISPLAY_IDENTIFIER fm_cal_in_vvtc_sldv_scg.Cxx_dtc_lb_xxx /end CHARACTERISTIC
/begin CHARACTERISTIC Cxx_obd_dc_in_vvtc_sldv_scg "" VALUE 0xa002aefe _REC_S1VAL_20_u1 9. _CNV_A_R_A_105_CM 1. 10. DISPLAY_IDENTIFIER fm_cal_in_vvtc_sldv_scg.Cxx_obd_dc_xxx /end CHARACTERISTIC
/begin CHARACTERISTIC Cxx_obd_us_typ_in_vvtc_sldv_scg "" VALUE 0xa002aeff _REC_S1VAL_20_u1 255. _CNV_A_R_A_105_CM 0. 255. DISPLAY_IDENTIFIER fm_cal_in_vvtc_sldv_scg.Cxx_obd_us_typ_xxx /end CHARACTERISTIC
/begin CHARACTERISTIC Cxx_dtc_obd_in_vvtc_sldv_scw "" VALUE 0xa002af06 _REC_S1VAL_20_u2 65535. _CNV_A_R_A_105_CM 0. 65535. DISPLAY_IDENTIFIER fm_cal_in_vvtc_sldv_scw.Cxx_dtc_obd_xxx /end CHARACTERISTIC
/begin CHARACTERISTIC Cxx_conf_wal_in_vvtc_sldv_scw "" VALUE 0xa002af08 _REC_S1VAL_20_u1 3. _CNV_A_R_A_105_CM 0. 3. DISPLAY_IDENTIFIER fm_cal_in_vvtc_sldv_scw.fm_static_bitfield.Cxx_conf_wal_xxx BIT_MASK 0x3 /end CHARACTERISTIC
/begin CHARACTERISTIC Cbx_obd_in_vvtc_sldv_scw "" VALUE 0xa002af08 _REC_S1VAL_20_u1 255. _CNV_A_R_A_105_CM 0. 255. DISPLAY_IDENTIFIER fm_cal_in_vvtc_sldv_scw.fm_static_bitfield.Cbx_obd_xxx BIT_MASK 0x4 /end CHARACTERISTIC
/begin CHARACTERISTIC Cbx_obd_mena_in_vvtc_sldv_scw "" VALUE 0xa002af08 _REC_S1VAL_20_u1 255. _CNV_A_R_A_105_CM 0. 255. DISPLAY_IDENTIFIER fm_cal_in_vvtc_sldv_scw.fm_static_bitfield.Cbx_obd_mena_xxx BIT_MASK 0x8 /end CHARACTERISTIC
/begin CHARACTERISTIC Cxx_dtc_lb_in_vvtc_sldv_scw "" VALUE 0xa002af09 _REC_S1VAL_20_u1 255. _CNV_A_R_A_105_CM 0. 255. DISPLAY_IDENTIFIER fm_cal_in_vvtc_sldv_scw.Cxx_dtc_lb_xxx /end CHARACTERISTIC
/begin CHARACTERISTIC Cxx_obd_dc_in_vvtc_sldv_scw "" VALUE 0xa002af0a _REC_S1VAL_20_u1 9. _CNV_A_R_A_105_CM 1. 10. DISPLAY_IDENTIFIER fm_cal_in_vvtc_sldv_scw.Cxx_obd_dc_xxx /end CHARACTERISTIC
/begin CHARACTERISTIC Cxx_obd_us_typ_in_vvtc_sldv_scw "" VALUE 0xa002af0b _REC_S1VAL_20_u1 255. _CNV_A_R_A_105_CM 0. 255. DISPLAY_IDENTIFIER fm_cal_in_vvtc_sldv_scw.Cxx_obd_us_typ_xxx /end CHARACTERISTIC
/begin CHARACTERISTIC Cxx_dtc_obd_inj1_oc "" VALUE 0xa002af2a _REC_S1VAL_20_u2 65535. _CNV_A_R_A_105_CM 0. 65535. DISPLAY_IDENTIFIER fm_cal_inj1_oc.Cxx_dtc_obd_xxx /end CHARACTERISTIC
/begin CHARACTERISTIC Cxx_conf_wal_inj1_oc "" VALUE 0xa002af2c _REC_S1VAL_20_u1 3. _CNV_A_R_A_105_CM 0. 3. DISPLAY_IDENTIFIER fm_cal_inj1_oc.fm_static_bitfield.Cxx_conf_wal_xxx BIT_MASK 0x3 /end CHARACTERISTIC
/begin CHARACTERISTIC Cbx_obd_inj1_oc "" VALUE 0xa002af2c _REC_S1VAL_20_u1 255. _CNV_A_R_A_105_CM 0. 255. DISPLAY_IDENTIFIER fm_cal_inj1_oc.fm_static_bitfield.Cbx_obd_xxx BIT_MASK 0x4 /end CHARACTERISTIC
/begin CHARACTERISTIC Cbx_obd_mena_inj1_oc "" VALUE 0xa002af2c _REC_S1VAL_20_u1 255. _CNV_A_R_A_105_CM 0. 255. DISPLAY_IDENTIFIER fm_cal_inj1_oc.fm_static_bitfield.Cbx_obd_mena_xxx BIT_MASK 0x8 /end CHARACTERISTIC
/begin CHARACTERISTIC Cxx_dtc_lb_inj1_oc "" VALUE 0xa002af2d _REC_S1VAL_20_u1 255. _CNV_A_R_A_105_CM 0. 255. DISPLAY_IDENTIFIER fm_cal_inj1_oc.Cxx_dtc_lb_xxx /end CHARACTERISTIC
/begin CHARACTERISTIC Cxx_obd_dc_inj1_oc "" VALUE 0xa002af2e _REC_S1VAL_20_u1 9. _CNV_A_R_A_105_CM 1. 10. DISPLAY_IDENTIFIER fm_cal_inj1_oc.Cxx_obd_dc_xxx /end CHARACTERISTIC
/begin CHARACTERISTIC Cxx_obd_us_typ_inj1_oc "" VALUE 0xa002af2f _REC_S1VAL_20_u1 255. _CNV_A_R_A_105_CM 0. 255. DISPLAY_IDENTIFIER fm_cal_inj1_oc.Cxx_obd_us_typ_xxx /end CHARACTERISTIC
/begin CHARACTERISTIC Cxx_dtc_obd_inj1_scg "" VALUE 0xa002af36 _REC_S1VAL_20_u2 65535. _CNV_A_R_A_105_CM 0. 65535. DISPLAY_IDENTIFIER fm_cal_inj1_scg.Cxx_dtc_obd_xxx /end CHARACTERISTIC
/begin CHARACTERISTIC Cxx_conf_wal_inj1_scg "" VALUE 0xa002af38 _REC_S1VAL_20_u1 3. _CNV_A_R_A_105_CM 0. 3. DISPLAY_IDENTIFIER fm_cal_inj1_scg.fm_static_bitfield.Cxx_conf_wal_xxx BIT_MASK 0x3 /end CHARACTERISTIC
/begin CHARACTERISTIC Cbx_obd_inj1_scg "" VALUE 0xa002af38 _REC_S1VAL_20_u1 255. _CNV_A_R_A_105_CM 0. 255. DISPLAY_IDENTIFIER fm_cal_inj1_scg.fm_static_bitfield.Cbx_obd_xxx BIT_MASK 0x4 /end CHARACTERISTIC
/begin CHARACTERISTIC Cbx_obd_mena_inj1_scg "" VALUE 0xa002af38 _REC_S1VAL_20_u1 255. _CNV_A_R_A_105_CM 0. 255. DISPLAY_IDENTIFIER fm_cal_inj1_scg.fm_static_bitfield.Cbx_obd_mena_xxx BIT_MASK 0x8 /end CHARACTERISTIC
/begin CHARACTERISTIC Cxx_dtc_lb_inj1_scg "" VALUE 0xa002af39 _REC_S1VAL_20_u1 255. _CNV_A_R_A_105_CM 0. 255. DISPLAY_IDENTIFIER fm_cal_inj1_scg.Cxx_dtc_lb_xxx /end CHARACTERISTIC
/begin CHARACTERISTIC Cxx_obd_dc_inj1_scg "" VALUE 0xa002af3a _REC_S1VAL_20_u1 9. _CNV_A_R_A_105_CM 1. 10. DISPLAY_IDENTIFIER fm_cal_inj1_scg.Cxx_obd_dc_xxx /end CHARACTERISTIC
/begin CHARACTERISTIC Cxx_obd_us_typ_inj1_scg "" VALUE 0xa002af3b _REC_S1VAL_20_u1 255. _CNV_A_R_A_105_CM 0. 255. DISPLAY_IDENTIFIER fm_cal_inj1_scg.Cxx_obd_us_typ_xxx /end CHARACTERISTIC
/begin CHARACTERISTIC Cxx_dtc_obd_inj1_scw "" VALUE 0xa002af42 _REC_S1VAL_20_u2 65535. _CNV_A_R_A_105_CM 0. 65535. DISPLAY_IDENTIFIER fm_cal_inj1_scw.Cxx_dtc_obd_xxx /end CHARACTERISTIC
/begin CHARACTERISTIC Cxx_conf_wal_inj1_scw "" VALUE 0xa002af44 _REC_S1VAL_20_u1 3. _CNV_A_R_A_105_CM 0. 3. DISPLAY_IDENTIFIER fm_cal_inj1_scw.fm_static_bitfield.Cxx_conf_wal_xxx BIT_MASK 0x3 /end CHARACTERISTIC
/begin CHARACTERISTIC Cbx_obd_inj1_scw "" VALUE 0xa002af44 _REC_S1VAL_20_u1 255. _CNV_A_R_A_105_CM 0. 255. DISPLAY_IDENTIFIER fm_cal_inj1_scw.fm_static_bitfield.Cbx_obd_xxx BIT_MASK 0x4 /end CHARACTERISTIC
/begin CHARACTERISTIC Cbx_obd_mena_inj1_scw "" VALUE 0xa002af44 _REC_S1VAL_20_u1 255. _CNV_A_R_A_105_CM 0. 255. DISPLAY_IDENTIFIER fm_cal_inj1_scw.fm_static_bitfield.Cbx_obd_mena_xxx BIT_MASK 0x8 /end CHARACTERISTIC
/begin CHARACTERISTIC Cxx_dtc_lb_inj1_scw "" VALUE 0xa002af45 _REC_S1VAL_20_u1 255. _CNV_A_R_A_105_CM 0. 255. DISPLAY_IDENTIFIER fm_cal_inj1_scw.Cxx_dtc_lb_xxx /end CHARACTERISTIC
/begin CHARACTERISTIC Cxx_obd_dc_inj1_scw "" VALUE 0xa002af46 _REC_S1VAL_20_u1 9. _CNV_A_R_A_105_CM 1. 10. DISPLAY_IDENTIFIER fm_cal_inj1_scw.Cxx_obd_dc_xxx /end CHARACTERISTIC
/begin CHARACTERISTIC Cxx_obd_us_typ_inj1_scw "" VALUE 0xa002af47 _REC_S1VAL_20_u1 255. _CNV_A_R_A_105_CM 0. 255. DISPLAY_IDENTIFIER fm_cal_inj1_scw.Cxx_obd_us_typ_xxx /end CHARACTERISTIC
/begin CHARACTERISTIC Cxx_dtc_obd_inj2_oc "" VALUE 0xa002af4e _REC_S1VAL_20_u2 65535. _CNV_A_R_A_105_CM 0. 65535. DISPLAY_IDENTIFIER fm_cal_inj2_oc.Cxx_dtc_obd_xxx /end CHARACTERISTIC
/begin CHARACTERISTIC Cxx_conf_wal_inj2_oc "" VALUE 0xa002af50 _REC_S1VAL_20_u1 3. _CNV_A_R_A_105_CM 0. 3. DISPLAY_IDENTIFIER fm_cal_inj2_oc.fm_static_bitfield.Cxx_conf_wal_xxx BIT_MASK 0x3 /end CHARACTERISTIC
/begin CHARACTERISTIC Cbx_obd_inj2_oc "" VALUE 0xa002af50 _REC_S1VAL_20_u1 255. _CNV_A_R_A_105_CM 0. 255. DISPLAY_IDENTIFIER fm_cal_inj2_oc.fm_static_bitfield.Cbx_obd_xxx BIT_MASK 0x4 /end CHARACTERISTIC
/begin CHARACTERISTIC Cbx_obd_mena_inj2_oc "" VALUE 0xa002af50 _REC_S1VAL_20_u1 255. _CNV_A_R_A_105_CM 0. 255. DISPLAY_IDENTIFIER fm_cal_inj2_oc.fm_static_bitfield.Cbx_obd_mena_xxx BIT_MASK 0x8 /end CHARACTERISTIC
/begin CHARACTERISTIC Cxx_dtc_lb_inj2_oc "" VALUE 0xa002af51 _REC_S1VAL_20_u1 255. _CNV_A_R_A_105_CM 0. 255. DISPLAY_IDENTIFIER fm_cal_inj2_oc.Cxx_dtc_lb_xxx /end CHARACTERISTIC
/begin CHARACTERISTIC Cxx_obd_dc_inj2_oc "" VALUE 0xa002af52 _REC_S1VAL_20_u1 9. _CNV_A_R_A_105_CM 1. 10. DISPLAY_IDENTIFIER fm_cal_inj2_oc.Cxx_obd_dc_xxx /end CHARACTERISTIC
/begin CHARACTERISTIC Cxx_obd_us_typ_inj2_oc "" VALUE 0xa002af53 _REC_S1VAL_20_u1 255. _CNV_A_R_A_105_CM 0. 255. DISPLAY_IDENTIFIER fm_cal_inj2_oc.Cxx_obd_us_typ_xxx /end CHARACTERISTIC
/begin CHARACTERISTIC Cxx_dtc_obd_inj2_scg "" VALUE 0xa002af5a _REC_S1VAL_20_u2 65535. _CNV_A_R_A_105_CM 0. 65535. DISPLAY_IDENTIFIER fm_cal_inj2_scg.Cxx_dtc_obd_xxx /end CHARACTERISTIC
/begin CHARACTERISTIC Cxx_conf_wal_inj2_scg "" VALUE 0xa002af5c _REC_S1VAL_20_u1 3. _CNV_A_R_A_105_CM 0. 3. DISPLAY_IDENTIFIER fm_cal_inj2_scg.fm_static_bitfield.Cxx_conf_wal_xxx BIT_MASK 0x3 /end CHARACTERISTIC
/begin CHARACTERISTIC Cbx_obd_inj2_scg "" VALUE 0xa002af5c _REC_S1VAL_20_u1 255. _CNV_A_R_A_105_CM 0. 255. DISPLAY_IDENTIFIER fm_cal_inj2_scg.fm_static_bitfield.Cbx_obd_xxx BIT_MASK 0x4 /end CHARACTERISTIC
/begin CHARACTERISTIC Cbx_obd_mena_inj2_scg "" VALUE 0xa002af5c _REC_S1VAL_20_u1 255. _CNV_A_R_A_105_CM 0. 255. DISPLAY_IDENTIFIER fm_cal_inj2_scg.fm_static_bitfield.Cbx_obd_mena_xxx BIT_MASK 0x8 /end CHARACTERISTIC
/begin CHARACTERISTIC Cxx_dtc_lb_inj2_scg "" VALUE 0xa002af5d _REC_S1VAL_20_u1 255. _CNV_A_R_A_105_CM 0. 255. DISPLAY_IDENTIFIER fm_cal_inj2_scg.Cxx_dtc_lb_xxx /end CHARACTERISTIC
/begin CHARACTERISTIC Cxx_obd_dc_inj2_scg "" VALUE 0xa002af5e _REC_S1VAL_20_u1 9. _CNV_A_R_A_105_CM 1. 10. DISPLAY_IDENTIFIER fm_cal_inj2_scg.Cxx_obd_dc_xxx /end CHARACTERISTIC
/begin CHARACTERISTIC Cxx_obd_us_typ_inj2_scg "" VALUE 0xa002af5f _REC_S1VAL_20_u1 255. _CNV_A_R_A_105_CM 0. 255. DISPLAY_IDENTIFIER fm_cal_inj2_scg.Cxx_obd_us_typ_xxx /end CHARACTERISTIC
/begin CHARACTERISTIC Cxx_dtc_obd_inj2_scw "" VALUE 0xa002af66 _REC_S1VAL_20_u2 65535. _CNV_A_R_A_105_CM 0. 65535. DISPLAY_IDENTIFIER fm_cal_inj2_scw.Cxx_dtc_obd_xxx /end CHARACTERISTIC
/begin CHARACTERISTIC Cxx_conf_wal_inj2_scw "" VALUE 0xa002af68 _REC_S1VAL_20_u1 3. _CNV_A_R_A_105_CM 0. 3. DISPLAY_IDENTIFIER fm_cal_inj2_scw.fm_static_bitfield.Cxx_conf_wal_xxx BIT_MASK 0x3 /end CHARACTERISTIC
/begin CHARACTERISTIC Cbx_obd_inj2_scw "" VALUE 0xa002af68 _REC_S1VAL_20_u1 255. _CNV_A_R_A_105_CM 0. 255. DISPLAY_IDENTIFIER fm_cal_inj2_scw.fm_static_bitfield.Cbx_obd_xxx BIT_MASK 0x4 /end CHARACTERISTIC
/begin CHARACTERISTIC Cbx_obd_mena_inj2_scw "" VALUE 0xa002af68 _REC_S1VAL_20_u1 255. _CNV_A_R_A_105_CM 0. 255. DISPLAY_IDENTIFIER fm_cal_inj2_scw.fm_static_bitfield.Cbx_obd_mena_xxx BIT_MASK 0x8 /end CHARACTERISTIC
/begin CHARACTERISTIC Cxx_dtc_lb_inj2_scw "" VALUE 0xa002af69 _REC_S1VAL_20_u1 255. _CNV_A_R_A_105_CM 0. 255. DISPLAY_IDENTIFIER fm_cal_inj2_scw.Cxx_dtc_lb_xxx /end CHARACTERISTIC
/begin CHARACTERISTIC Cxx_obd_dc_inj2_scw "" VALUE 0xa002af6a _REC_S1VAL_20_u1 9. _CNV_A_R_A_105_CM 1. 10. DISPLAY_IDENTIFIER fm_cal_inj2_scw.Cxx_obd_dc_xxx /end CHARACTERISTIC
/begin CHARACTERISTIC Cxx_obd_us_typ_inj2_scw "" VALUE 0xa002af6b _REC_S1VAL_20_u1 255. _CNV_A_R_A_105_CM 0. 255. DISPLAY_IDENTIFIER fm_cal_inj2_scw.Cxx_obd_us_typ_xxx /end CHARACTERISTIC
/begin CHARACTERISTIC Cxx_dtc_obd_inj3_oc "" VALUE 0xa002af72 _REC_S1VAL_20_u2 65535. _CNV_A_R_A_105_CM 0. 65535. DISPLAY_IDENTIFIER fm_cal_inj3_oc.Cxx_dtc_obd_xxx /end CHARACTERISTIC
/begin CHARACTERISTIC Cxx_conf_wal_inj3_oc "" VALUE 0xa002af74 _REC_S1VAL_20_u1 3. _CNV_A_R_A_105_CM 0. 3. DISPLAY_IDENTIFIER fm_cal_inj3_oc.fm_static_bitfield.Cxx_conf_wal_xxx BIT_MASK 0x3 /end CHARACTERISTIC
/begin CHARACTERISTIC Cbx_obd_inj3_oc "" VALUE 0xa002af74 _REC_S1VAL_20_u1 255. _CNV_A_R_A_105_CM 0. 255. DISPLAY_IDENTIFIER fm_cal_inj3_oc.fm_static_bitfield.Cbx_obd_xxx BIT_MASK 0x4 /end CHARACTERISTIC
/begin CHARACTERISTIC Cbx_obd_mena_inj3_oc "" VALUE 0xa002af74 _REC_S1VAL_20_u1 255. _CNV_A_R_A_105_CM 0. 255. DISPLAY_IDENTIFIER fm_cal_inj3_oc.fm_static_bitfield.Cbx_obd_mena_xxx BIT_MASK 0x8 /end CHARACTERISTIC
/begin CHARACTERISTIC Cxx_dtc_lb_inj3_oc "" VALUE 0xa002af75 _REC_S1VAL_20_u1 255. _CNV_A_R_A_105_CM 0. 255. DISPLAY_IDENTIFIER fm_cal_inj3_oc.Cxx_dtc_lb_xxx /end CHARACTERISTIC
/begin CHARACTERISTIC Cxx_obd_dc_inj3_oc "" VALUE 0xa002af76 _REC_S1VAL_20_u1 9. _CNV_A_R_A_105_CM 1. 10. DISPLAY_IDENTIFIER fm_cal_inj3_oc.Cxx_obd_dc_xxx /end CHARACTERISTIC
/begin CHARACTERISTIC Cxx_obd_us_typ_inj3_oc "" VALUE 0xa002af77 _REC_S1VAL_20_u1 255. _CNV_A_R_A_105_CM 0. 255. DISPLAY_IDENTIFIER fm_cal_inj3_oc.Cxx_obd_us_typ_xxx /end CHARACTERISTIC
/begin CHARACTERISTIC Cxx_dtc_obd_inj3_scg "" VALUE 0xa002af7e _REC_S1VAL_20_u2 65535. _CNV_A_R_A_105_CM 0. 65535. DISPLAY_IDENTIFIER fm_cal_inj3_scg.Cxx_dtc_obd_xxx /end CHARACTERISTIC
/begin CHARACTERISTIC Cxx_conf_wal_inj3_scg "" VALUE 0xa002af80 _REC_S1VAL_20_u1 3. _CNV_A_R_A_105_CM 0. 3. DISPLAY_IDENTIFIER fm_cal_inj3_scg.fm_static_bitfield.Cxx_conf_wal_xxx BIT_MASK 0x3 /end CHARACTERISTIC
/begin CHARACTERISTIC Cbx_obd_inj3_scg "" VALUE 0xa002af80 _REC_S1VAL_20_u1 255. _CNV_A_R_A_105_CM 0. 255. DISPLAY_IDENTIFIER fm_cal_inj3_scg.fm_static_bitfield.Cbx_obd_xxx BIT_MASK 0x4 /end CHARACTERISTIC
/begin CHARACTERISTIC Cbx_obd_mena_inj3_scg "" VALUE 0xa002af80 _REC_S1VAL_20_u1 255. _CNV_A_R_A_105_CM 0. 255. DISPLAY_IDENTIFIER fm_cal_inj3_scg.fm_static_bitfield.Cbx_obd_mena_xxx BIT_MASK 0x8 /end CHARACTERISTIC
/begin CHARACTERISTIC Cxx_dtc_lb_inj3_scg "" VALUE 0xa002af81 _REC_S1VAL_20_u1 255. _CNV_A_R_A_105_CM 0. 255. DISPLAY_IDENTIFIER fm_cal_inj3_scg.Cxx_dtc_lb_xxx /end CHARACTERISTIC
/begin CHARACTERISTIC Cxx_obd_dc_inj3_scg "" VALUE 0xa002af82 _REC_S1VAL_20_u1 9. _CNV_A_R_A_105_CM 1. 10. DISPLAY_IDENTIFIER fm_cal_inj3_scg.Cxx_obd_dc_xxx /end CHARACTERISTIC
/begin CHARACTERISTIC Cxx_obd_us_typ_inj3_scg "" VALUE 0xa002af83 _REC_S1VAL_20_u1 255. _CNV_A_R_A_105_CM 0. 255. DISPLAY_IDENTIFIER fm_cal_inj3_scg.Cxx_obd_us_typ_xxx /end CHARACTERISTIC
/begin CHARACTERISTIC Cxx_dtc_obd_inj3_scw "" VALUE 0xa002af8a _REC_S1VAL_20_u2 65535. _CNV_A_R_A_105_CM 0. 65535. DISPLAY_IDENTIFIER fm_cal_inj3_scw.Cxx_dtc_obd_xxx /end CHARACTERISTIC
/begin CHARACTERISTIC Cxx_conf_wal_inj3_scw "" VALUE 0xa002af8c _REC_S1VAL_20_u1 3. _CNV_A_R_A_105_CM 0. 3. DISPLAY_IDENTIFIER fm_cal_inj3_scw.fm_static_bitfield.Cxx_conf_wal_xxx BIT_MASK 0x3 /end CHARACTERISTIC
/begin CHARACTERISTIC Cbx_obd_inj3_scw "" VALUE 0xa002af8c _REC_S1VAL_20_u1 255. _CNV_A_R_A_105_CM 0. 255. DISPLAY_IDENTIFIER fm_cal_inj3_scw.fm_static_bitfield.Cbx_obd_xxx BIT_MASK 0x4 /end CHARACTERISTIC
/begin CHARACTERISTIC Cbx_obd_mena_inj3_scw "" VALUE 0xa002af8c _REC_S1VAL_20_u1 255. _CNV_A_R_A_105_CM 0. 255. DISPLAY_IDENTIFIER fm_cal_inj3_scw.fm_static_bitfield.Cbx_obd_mena_xxx BIT_MASK 0x8 /end CHARACTERISTIC
/begin CHARACTERISTIC Cxx_dtc_lb_inj3_scw "" VALUE 0xa002af8d _REC_S1VAL_20_u1 255. _CNV_A_R_A_105_CM 0. 255. DISPLAY_IDENTIFIER fm_cal_inj3_scw.Cxx_dtc_lb_xxx /end CHARACTERISTIC
/begin CHARACTERISTIC Cxx_obd_dc_inj3_scw "" VALUE 0xa002af8e _REC_S1VAL_20_u1 9. _CNV_A_R_A_105_CM 1. 10. DISPLAY_IDENTIFIER fm_cal_inj3_scw.Cxx_obd_dc_xxx /end CHARACTERISTIC
/begin CHARACTERISTIC Cxx_obd_us_typ_inj3_scw "" VALUE 0xa002af8f _REC_S1VAL_20_u1 255. _CNV_A_R_A_105_CM 0. 255. DISPLAY_IDENTIFIER fm_cal_inj3_scw.Cxx_obd_us_typ_xxx /end CHARACTERISTIC
/begin CHARACTERISTIC Cxx_dtc_obd_inj4_oc "" VALUE 0xa002af96 _REC_S1VAL_20_u2 65535. _CNV_A_R_A_105_CM 0. 65535. DISPLAY_IDENTIFIER fm_cal_inj4_oc.Cxx_dtc_obd_xxx /end CHARACTERISTIC
/begin CHARACTERISTIC Cxx_conf_wal_inj4_oc "" VALUE 0xa002af98 _REC_S1VAL_20_u1 3. _CNV_A_R_A_105_CM 0. 3. DISPLAY_IDENTIFIER fm_cal_inj4_oc.fm_static_bitfield.Cxx_conf_wal_xxx BIT_MASK 0x3 /end CHARACTERISTIC
/begin CHARACTERISTIC Cbx_obd_inj4_oc "" VALUE 0xa002af98 _REC_S1VAL_20_u1 255. _CNV_A_R_A_105_CM 0. 255. DISPLAY_IDENTIFIER fm_cal_inj4_oc.fm_static_bitfield.Cbx_obd_xxx BIT_MASK 0x4 /end CHARACTERISTIC
/begin CHARACTERISTIC Cbx_obd_mena_inj4_oc "" VALUE 0xa002af98 _REC_S1VAL_20_u1 255. _CNV_A_R_A_105_CM 0. 255. DISPLAY_IDENTIFIER fm_cal_inj4_oc.fm_static_bitfield.Cbx_obd_mena_xxx BIT_MASK 0x8 /end CHARACTERISTIC
/begin CHARACTERISTIC Cxx_dtc_lb_inj4_oc "" VALUE 0xa002af99 _REC_S1VAL_20_u1 255. _CNV_A_R_A_105_CM 0. 255. DISPLAY_IDENTIFIER fm_cal_inj4_oc.Cxx_dtc_lb_xxx /end CHARACTERISTIC
/begin CHARACTERISTIC Cxx_obd_dc_inj4_oc "" VALUE 0xa002af9a _REC_S1VAL_20_u1 9. _CNV_A_R_A_105_CM 1. 10. DISPLAY_IDENTIFIER fm_cal_inj4_oc.Cxx_obd_dc_xxx /end CHARACTERISTIC
/begin CHARACTERISTIC Cxx_obd_us_typ_inj4_oc "" VALUE 0xa002af9b _REC_S1VAL_20_u1 255. _CNV_A_R_A_105_CM 0. 255. DISPLAY_IDENTIFIER fm_cal_inj4_oc.Cxx_obd_us_typ_xxx /end CHARACTERISTIC
/begin CHARACTERISTIC Cxx_dtc_obd_inj4_scg "" VALUE 0xa002afa2 _REC_S1VAL_20_u2 65535. _CNV_A_R_A_105_CM 0. 65535. DISPLAY_IDENTIFIER fm_cal_inj4_scg.Cxx_dtc_obd_xxx /end CHARACTERISTIC
/begin CHARACTERISTIC Cxx_conf_wal_inj4_scg "" VALUE 0xa002afa4 _REC_S1VAL_20_u1 3. _CNV_A_R_A_105_CM 0. 3. DISPLAY_IDENTIFIER fm_cal_inj4_scg.fm_static_bitfield.Cxx_conf_wal_xxx BIT_MASK 0x3 /end CHARACTERISTIC
/begin CHARACTERISTIC Cbx_obd_inj4_scg "" VALUE 0xa002afa4 _REC_S1VAL_20_u1 255. _CNV_A_R_A_105_CM 0. 255. DISPLAY_IDENTIFIER fm_cal_inj4_scg.fm_static_bitfield.Cbx_obd_xxx BIT_MASK 0x4 /end CHARACTERISTIC
/begin CHARACTERISTIC Cbx_obd_mena_inj4_scg "" VALUE 0xa002afa4 _REC_S1VAL_20_u1 255. _CNV_A_R_A_105_CM 0. 255. DISPLAY_IDENTIFIER fm_cal_inj4_scg.fm_static_bitfield.Cbx_obd_mena_xxx BIT_MASK 0x8 /end CHARACTERISTIC
/begin CHARACTERISTIC Cxx_dtc_lb_inj4_scg "" VALUE 0xa002afa5 _REC_S1VAL_20_u1 255. _CNV_A_R_A_105_CM 0. 255. DISPLAY_IDENTIFIER fm_cal_inj4_scg.Cxx_dtc_lb_xxx /end CHARACTERISTIC
/begin CHARACTERISTIC Cxx_obd_dc_inj4_scg "" VALUE 0xa002afa6 _REC_S1VAL_20_u1 9. _CNV_A_R_A_105_CM 1. 10. DISPLAY_IDENTIFIER fm_cal_inj4_scg.Cxx_obd_dc_xxx /end CHARACTERISTIC
/begin CHARACTERISTIC Cxx_obd_us_typ_inj4_scg "" VALUE 0xa002afa7 _REC_S1VAL_20_u1 255. _CNV_A_R_A_105_CM 0. 255. DISPLAY_IDENTIFIER fm_cal_inj4_scg.Cxx_obd_us_typ_xxx /end CHARACTERISTIC
/begin CHARACTERISTIC Cxx_dtc_obd_inj4_scw "" VALUE 0xa002afae _REC_S1VAL_20_u2 65535. _CNV_A_R_A_105_CM 0. 65535. DISPLAY_IDENTIFIER fm_cal_inj4_scw.Cxx_dtc_obd_xxx /end CHARACTERISTIC
/begin CHARACTERISTIC Cxx_conf_wal_inj4_scw "" VALUE 0xa002afb0 _REC_S1VAL_20_u1 3. _CNV_A_R_A_105_CM 0. 3. DISPLAY_IDENTIFIER fm_cal_inj4_scw.fm_static_bitfield.Cxx_conf_wal_xxx BIT_MASK 0x3 /end CHARACTERISTIC
/begin CHARACTERISTIC Cbx_obd_inj4_scw "" VALUE 0xa002afb0 _REC_S1VAL_20_u1 255. _CNV_A_R_A_105_CM 0. 255. DISPLAY_IDENTIFIER fm_cal_inj4_scw.fm_static_bitfield.Cbx_obd_xxx BIT_MASK 0x4 /end CHARACTERISTIC
/begin CHARACTERISTIC Cbx_obd_mena_inj4_scw "" VALUE 0xa002afb0 _REC_S1VAL_20_u1 255. _CNV_A_R_A_105_CM 0. 255. DISPLAY_IDENTIFIER fm_cal_inj4_scw.fm_static_bitfield.Cbx_obd_mena_xxx BIT_MASK 0x8 /end CHARACTERISTIC
/begin CHARACTERISTIC Cxx_dtc_lb_inj4_scw "" VALUE 0xa002afb1 _REC_S1VAL_20_u1 255. _CNV_A_R_A_105_CM 0. 255. DISPLAY_IDENTIFIER fm_cal_inj4_scw.Cxx_dtc_lb_xxx /end CHARACTERISTIC
/begin CHARACTERISTIC Cxx_obd_dc_inj4_scw "" VALUE 0xa002afb2 _REC_S1VAL_20_u1 9. _CNV_A_R_A_105_CM 1. 10. DISPLAY_IDENTIFIER fm_cal_inj4_scw.Cxx_obd_dc_xxx /end CHARACTERISTIC
/begin CHARACTERISTIC Cxx_obd_us_typ_inj4_scw "" VALUE 0xa002afb3 _REC_S1VAL_20_u1 255. _CNV_A_R_A_105_CM 0. 255. DISPLAY_IDENTIFIER fm_cal_inj4_scw.Cxx_obd_us_typ_xxx /end CHARACTERISTIC
/begin CHARACTERISTIC Cxx_dtc_obd_inj_ecu_itl "" VALUE 0xa002b4be _REC_S1VAL_20_u2 65535. _CNV_A_R_A_105_CM 0. 65535. DISPLAY_IDENTIFIER fm_cal_inj_ecu_itl.Cxx_dtc_obd_xxx /end CHARACTERISTIC
/begin CHARACTERISTIC Cxx_conf_wal_inj_ecu_itl "" VALUE 0xa002b4c0 _REC_S1VAL_20_u1 3. _CNV_A_R_A_105_CM 0. 3. DISPLAY_IDENTIFIER fm_cal_inj_ecu_itl.fm_static_bitfield.Cxx_conf_wal_xxx BIT_MASK 0x3 /end CHARACTERISTIC
/begin CHARACTERISTIC Cbx_obd_inj_ecu_itl "" VALUE 0xa002b4c0 _REC_S1VAL_20_u1 255. _CNV_A_R_A_105_CM 0. 255. DISPLAY_IDENTIFIER fm_cal_inj_ecu_itl.fm_static_bitfield.Cbx_obd_xxx BIT_MASK 0x4 /end CHARACTERISTIC
/begin CHARACTERISTIC Cbx_obd_mena_inj_ecu_itl "" VALUE 0xa002b4c0 _REC_S1VAL_20_u1 255. _CNV_A_R_A_105_CM 0. 255. DISPLAY_IDENTIFIER fm_cal_inj_ecu_itl.fm_static_bitfield.Cbx_obd_mena_xxx BIT_MASK 0x8 /end CHARACTERISTIC
/begin CHARACTERISTIC Cxx_dtc_lb_inj_ecu_itl "" VALUE 0xa002b4c1 _REC_S1VAL_20_u1 255. _CNV_A_R_A_105_CM 0. 255. DISPLAY_IDENTIFIER fm_cal_inj_ecu_itl.Cxx_dtc_lb_xxx /end CHARACTERISTIC
/begin CHARACTERISTIC Cxx_obd_dc_inj_ecu_itl "" VALUE 0xa002b4c2 _REC_S1VAL_20_u1 9. _CNV_A_R_A_105_CM 1. 10. DISPLAY_IDENTIFIER fm_cal_inj_ecu_itl.Cxx_obd_dc_xxx /end CHARACTERISTIC
/begin CHARACTERISTIC Cxx_obd_us_typ_inj_ecu_itl "" VALUE 0xa002b4c3 _REC_S1VAL_20_u1 255. _CNV_A_R_A_105_CM 0. 255. DISPLAY_IDENTIFIER fm_cal_inj_ecu_itl.Cxx_obd_us_typ_xxx /end CHARACTERISTIC
/begin CHARACTERISTIC Cxx_dtc_obd_inj_ecu_lbdw_icp "" VALUE 0xa002af12 _REC_S1VAL_20_u2 65535. _CNV_A_R_A_105_CM 0. 65535. DISPLAY_IDENTIFIER fm_cal_inj_ecu_lbdw_icp.Cxx_dtc_obd_xxx /end CHARACTERISTIC
/begin CHARACTERISTIC Cxx_conf_wal_inj_ecu_lbdw_icp "" VALUE 0xa002af14 _REC_S1VAL_20_u1 3. _CNV_A_R_A_105_CM 0. 3. DISPLAY_IDENTIFIER fm_cal_inj_ecu_lbdw_icp.fm_static_bitfield.Cxx_conf_wal_xxx BIT_MASK 0x3 /end CHARACTERISTIC
/begin CHARACTERISTIC Cbx_obd_inj_ecu_lbdw_icp "" VALUE 0xa002af14 _REC_S1VAL_20_u1 255. _CNV_A_R_A_105_CM 0. 255. DISPLAY_IDENTIFIER fm_cal_inj_ecu_lbdw_icp.fm_static_bitfield.Cbx_obd_xxx BIT_MASK 0x4 /end CHARACTERISTIC
/begin CHARACTERISTIC Cbx_obd_mena_inj_ecu_lbdw_icp "" VALUE 0xa002af14 _REC_S1VAL_20_u1 255. _CNV_A_R_A_105_CM 0. 255. DISPLAY_IDENTIFIER fm_cal_inj_ecu_lbdw_icp.fm_static_bitfield.Cbx_obd_mena_xxx BIT_MASK 0x8 /end CHARACTERISTIC
/begin CHARACTERISTIC Cxx_dtc_lb_inj_ecu_lbdw_icp "" VALUE 0xa002af15 _REC_S1VAL_20_u1 255. _CNV_A_R_A_105_CM 0. 255. DISPLAY_IDENTIFIER fm_cal_inj_ecu_lbdw_icp.Cxx_dtc_lb_xxx /end CHARACTERISTIC
/begin CHARACTERISTIC Cxx_obd_dc_inj_ecu_lbdw_icp "" VALUE 0xa002af16 _REC_S1VAL_20_u1 9. _CNV_A_R_A_105_CM 1. 10. DISPLAY_IDENTIFIER fm_cal_inj_ecu_lbdw_icp.Cxx_obd_dc_xxx /end CHARACTERISTIC
/begin CHARACTERISTIC Cxx_obd_us_typ_inj_ecu_lbdw_icp "" VALUE 0xa002af17 _REC_S1VAL_20_u1 255. _CNV_A_R_A_105_CM 0. 255. DISPLAY_IDENTIFIER fm_cal_inj_ecu_lbdw_icp.Cxx_obd_us_typ_xxx /end CHARACTERISTIC
/begin CHARACTERISTIC Cxx_dtc_obd_inj_ecu_lbup_icp "" VALUE 0xa002af1e _REC_S1VAL_20_u2 65535. _CNV_A_R_A_105_CM 0. 65535. DISPLAY_IDENTIFIER fm_cal_inj_ecu_lbup_icp.Cxx_dtc_obd_xxx /end CHARACTERISTIC
/begin CHARACTERISTIC Cxx_conf_wal_inj_ecu_lbup_icp "" VALUE 0xa002af20 _REC_S1VAL_20_u1 3. _CNV_A_R_A_105_CM 0. 3. DISPLAY_IDENTIFIER fm_cal_inj_ecu_lbup_icp.fm_static_bitfield.Cxx_conf_wal_xxx BIT_MASK 0x3 /end CHARACTERISTIC
/begin CHARACTERISTIC Cbx_obd_inj_ecu_lbup_icp "" VALUE 0xa002af20 _REC_S1VAL_20_u1 255. _CNV_A_R_A_105_CM 0. 255. DISPLAY_IDENTIFIER fm_cal_inj_ecu_lbup_icp.fm_static_bitfield.Cbx_obd_xxx BIT_MASK 0x4 /end CHARACTERISTIC
/begin CHARACTERISTIC Cbx_obd_mena_inj_ecu_lbup_icp "" VALUE 0xa002af20 _REC_S1VAL_20_u1 255. _CNV_A_R_A_105_CM 0. 255. DISPLAY_IDENTIFIER fm_cal_inj_ecu_lbup_icp.fm_static_bitfield.Cbx_obd_mena_xxx BIT_MASK 0x8 /end CHARACTERISTIC
/begin CHARACTERISTIC Cxx_dtc_lb_inj_ecu_lbup_icp "" VALUE 0xa002af21 _REC_S1VAL_20_u1 255. _CNV_A_R_A_105_CM 0. 255. DISPLAY_IDENTIFIER fm_cal_inj_ecu_lbup_icp.Cxx_dtc_lb_xxx /end CHARACTERISTIC
/begin CHARACTERISTIC Cxx_obd_dc_inj_ecu_lbup_icp "" VALUE 0xa002af22 _REC_S1VAL_20_u1 9. _CNV_A_R_A_105_CM 1. 10. DISPLAY_IDENTIFIER fm_cal_inj_ecu_lbup_icp.Cxx_obd_dc_xxx /end CHARACTERISTIC
/begin CHARACTERISTIC Cxx_obd_us_typ_inj_ecu_lbup_icp "" VALUE 0xa002af23 _REC_S1VAL_20_u1 255. _CNV_A_R_A_105_CM 0. 255. DISPLAY_IDENTIFIER fm_cal_inj_ecu_lbup_icp.Cxx_obd_us_typ_xxx /end CHARACTERISTIC
/begin CHARACTERISTIC Cxx_conf_wal_ip_lght_tco_ovh "" VALUE 0xa002b4cc _REC_S1VAL_20_u1 3. _CNV_A_R_A_105_CM 0. 3. DISPLAY_IDENTIFIER fm_cal_ip_lght_tco_ovh.fm_static_bitfield.Cxx_conf_wal_xxx BIT_MASK 0x3 /end CHARACTERISTIC
/begin CHARACTERISTIC Cxx_dtc_lb_ip_lght_tco_ovh "" VALUE 0xa002b4cd _REC_S1VAL_20_u1 255. _CNV_A_R_A_105_CM 0. 255. DISPLAY_IDENTIFIER fm_cal_ip_lght_tco_ovh.Cxx_dtc_lb_xxx /end CHARACTERISTIC
/begin CHARACTERISTIC Cxx_obd_us_typ_ip_lght_tco_ovh "" VALUE 0xa002b4cf _REC_S1VAL_20_u1 255. _CNV_A_R_A_105_CM 0. 255. DISPLAY_IDENTIFIER fm_cal_ip_lght_tco_ovh.Cxx_obd_us_typ_xxx /end CHARACTERISTIC
/begin CHARACTERISTIC Cxx_dtc_obd_isr_h_lvl "" VALUE 0xa002b6c2 _REC_S1VAL_20_u2 65535. _CNV_A_R_A_105_CM 0. 65535. DISPLAY_IDENTIFIER fm_cal_isr_h_lvl.Cxx_dtc_obd_xxx /end CHARACTERISTIC
/begin CHARACTERISTIC Cxx_conf_wal_isr_h_lvl "" VALUE 0xa002b6c4 _REC_S1VAL_20_u1 3. _CNV_A_R_A_105_CM 0. 3. DISPLAY_IDENTIFIER fm_cal_isr_h_lvl.fm_static_bitfield.Cxx_conf_wal_xxx BIT_MASK 0x3 /end CHARACTERISTIC
/begin CHARACTERISTIC Cbx_obd_isr_h_lvl "" VALUE 0xa002b6c4 _REC_S1VAL_20_u1 255. _CNV_A_R_A_105_CM 0. 255. DISPLAY_IDENTIFIER fm_cal_isr_h_lvl.fm_static_bitfield.Cbx_obd_xxx BIT_MASK 0x4 /end CHARACTERISTIC
/begin CHARACTERISTIC Cbx_obd_mena_isr_h_lvl "" VALUE 0xa002b6c4 _REC_S1VAL_20_u1 255. _CNV_A_R_A_105_CM 0. 255. DISPLAY_IDENTIFIER fm_cal_isr_h_lvl.fm_static_bitfield.Cbx_obd_mena_xxx BIT_MASK 0x8 /end CHARACTERISTIC
/begin CHARACTERISTIC Cxx_dtc_lb_isr_h_lvl "" VALUE 0xa002b6c5 _REC_S1VAL_20_u1 255. _CNV_A_R_A_105_CM 0. 255. DISPLAY_IDENTIFIER fm_cal_isr_h_lvl.Cxx_dtc_lb_xxx /end CHARACTERISTIC
/begin CHARACTERISTIC Cxx_obd_dc_isr_h_lvl "" VALUE 0xa002b6c6 _REC_S1VAL_20_u1 9. _CNV_A_R_A_105_CM 1. 10. DISPLAY_IDENTIFIER fm_cal_isr_h_lvl.Cxx_obd_dc_xxx /end CHARACTERISTIC
/begin CHARACTERISTIC Cxx_obd_us_typ_isr_h_lvl "" VALUE 0xa002b6c7 _REC_S1VAL_20_u1 255. _CNV_A_R_A_105_CM 0. 255. DISPLAY_IDENTIFIER fm_cal_isr_h_lvl.Cxx_obd_us_typ_xxx /end CHARACTERISTIC
/begin CHARACTERISTIC Cxx_dtc_obd_isr_l_lvl "" VALUE 0xa002b6ce _REC_S1VAL_20_u2 65535. _CNV_A_R_A_105_CM 0. 65535. DISPLAY_IDENTIFIER fm_cal_isr_l_lvl.Cxx_dtc_obd_xxx /end CHARACTERISTIC
/begin CHARACTERISTIC Cxx_conf_wal_isr_l_lvl "" VALUE 0xa002b6d0 _REC_S1VAL_20_u1 3. _CNV_A_R_A_105_CM 0. 3. DISPLAY_IDENTIFIER fm_cal_isr_l_lvl.fm_static_bitfield.Cxx_conf_wal_xxx BIT_MASK 0x3 /end CHARACTERISTIC
/begin CHARACTERISTIC Cbx_obd_isr_l_lvl "" VALUE 0xa002b6d0 _REC_S1VAL_20_u1 255. _CNV_A_R_A_105_CM 0. 255. DISPLAY_IDENTIFIER fm_cal_isr_l_lvl.fm_static_bitfield.Cbx_obd_xxx BIT_MASK 0x4 /end CHARACTERISTIC
/begin CHARACTERISTIC Cbx_obd_mena_isr_l_lvl "" VALUE 0xa002b6d0 _REC_S1VAL_20_u1 255. _CNV_A_R_A_105_CM 0. 255. DISPLAY_IDENTIFIER fm_cal_isr_l_lvl.fm_static_bitfield.Cbx_obd_mena_xxx BIT_MASK 0x8 /end CHARACTERISTIC
/begin CHARACTERISTIC Cxx_dtc_lb_isr_l_lvl "" VALUE 0xa002b6d1 _REC_S1VAL_20_u1 255. _CNV_A_R_A_105_CM 0. 255. DISPLAY_IDENTIFIER fm_cal_isr_l_lvl.Cxx_dtc_lb_xxx /end CHARACTERISTIC
/begin CHARACTERISTIC Cxx_obd_dc_isr_l_lvl "" VALUE 0xa002b6d2 _REC_S1VAL_20_u1 9. _CNV_A_R_A_105_CM 1. 10. DISPLAY_IDENTIFIER fm_cal_isr_l_lvl.Cxx_obd_dc_xxx /end CHARACTERISTIC
/begin CHARACTERISTIC Cxx_obd_us_typ_isr_l_lvl "" VALUE 0xa002b6d3 _REC_S1VAL_20_u1 255. _CNV_A_R_A_105_CM 0. 255. DISPLAY_IDENTIFIER fm_cal_isr_l_lvl.Cxx_obd_us_typ_xxx /end CHARACTERISTIC
/begin CHARACTERISTIC Cxx_dtc_obd_it_cmd_el "" VALUE 0xa002afba _REC_S1VAL_20_u2 65535. _CNV_A_R_A_105_CM 0. 65535. DISPLAY_IDENTIFIER fm_cal_it_cmd_el.Cxx_dtc_obd_xxx /end CHARACTERISTIC
/begin CHARACTERISTIC Cxx_conf_wal_it_cmd_el "" VALUE 0xa002afbc _REC_S1VAL_20_u1 3. _CNV_A_R_A_105_CM 0. 3. DISPLAY_IDENTIFIER fm_cal_it_cmd_el.fm_static_bitfield.Cxx_conf_wal_xxx BIT_MASK 0x3 /end CHARACTERISTIC
/begin CHARACTERISTIC Cbx_obd_it_cmd_el "" VALUE 0xa002afbc _REC_S1VAL_20_u1 255. _CNV_A_R_A_105_CM 0. 255. DISPLAY_IDENTIFIER fm_cal_it_cmd_el.fm_static_bitfield.Cbx_obd_xxx BIT_MASK 0x4 /end CHARACTERISTIC
/begin CHARACTERISTIC Cbx_obd_mena_it_cmd_el "" VALUE 0xa002afbc _REC_S1VAL_20_u1 255. _CNV_A_R_A_105_CM 0. 255. DISPLAY_IDENTIFIER fm_cal_it_cmd_el.fm_static_bitfield.Cbx_obd_mena_xxx BIT_MASK 0x8 /end CHARACTERISTIC
/begin CHARACTERISTIC Cxx_dtc_lb_it_cmd_el "" VALUE 0xa002afbd _REC_S1VAL_20_u1 255. _CNV_A_R_A_105_CM 0. 255. DISPLAY_IDENTIFIER fm_cal_it_cmd_el.Cxx_dtc_lb_xxx /end CHARACTERISTIC
/begin CHARACTERISTIC Cxx_obd_dc_it_cmd_el "" VALUE 0xa002afbe _REC_S1VAL_20_u1 9. _CNV_A_R_A_105_CM 1. 10. DISPLAY_IDENTIFIER fm_cal_it_cmd_el.Cxx_obd_dc_xxx /end CHARACTERISTIC
/begin CHARACTERISTIC Cxx_obd_us_typ_it_cmd_el "" VALUE 0xa002afbf _REC_S1VAL_20_u1 255. _CNV_A_R_A_105_CM 0. 255. DISPLAY_IDENTIFIER fm_cal_it_cmd_el.Cxx_obd_us_typ_xxx /end CHARACTERISTIC
/begin CHARACTERISTIC Cxx_dtc_obd_it_ofs_meca "" VALUE 0xa002afc6 _REC_S1VAL_20_u2 65535. _CNV_A_R_A_105_CM 0. 65535. DISPLAY_IDENTIFIER fm_cal_it_ofs_meca.Cxx_dtc_obd_xxx /end CHARACTERISTIC
/begin CHARACTERISTIC Cxx_conf_wal_it_ofs_meca "" VALUE 0xa002afc8 _REC_S1VAL_20_u1 3. _CNV_A_R_A_105_CM 0. 3. DISPLAY_IDENTIFIER fm_cal_it_ofs_meca.fm_static_bitfield.Cxx_conf_wal_xxx BIT_MASK 0x3 /end CHARACTERISTIC
/begin CHARACTERISTIC Cbx_obd_it_ofs_meca "" VALUE 0xa002afc8 _REC_S1VAL_20_u1 255. _CNV_A_R_A_105_CM 0. 255. DISPLAY_IDENTIFIER fm_cal_it_ofs_meca.fm_static_bitfield.Cbx_obd_xxx BIT_MASK 0x4 /end CHARACTERISTIC
/begin CHARACTERISTIC Cbx_obd_mena_it_ofs_meca "" VALUE 0xa002afc8 _REC_S1VAL_20_u1 255. _CNV_A_R_A_105_CM 0. 255. DISPLAY_IDENTIFIER fm_cal_it_ofs_meca.fm_static_bitfield.Cbx_obd_mena_xxx BIT_MASK 0x8 /end CHARACTERISTIC
/begin CHARACTERISTIC Cxx_dtc_lb_it_ofs_meca "" VALUE 0xa002afc9 _REC_S1VAL_20_u1 255. _CNV_A_R_A_105_CM 0. 255. DISPLAY_IDENTIFIER fm_cal_it_ofs_meca.Cxx_dtc_lb_xxx /end CHARACTERISTIC
/begin CHARACTERISTIC Cxx_obd_dc_it_ofs_meca "" VALUE 0xa002afca _REC_S1VAL_20_u1 9. _CNV_A_R_A_105_CM 1. 10. DISPLAY_IDENTIFIER fm_cal_it_ofs_meca.Cxx_obd_dc_xxx /end CHARACTERISTIC
/begin CHARACTERISTIC Cxx_obd_us_typ_it_ofs_meca "" VALUE 0xa002afcb _REC_S1VAL_20_u1 255. _CNV_A_R_A_105_CM 0. 255. DISPLAY_IDENTIFIER fm_cal_it_ofs_meca.Cxx_obd_us_typ_xxx /end CHARACTERISTIC
/begin CHARACTERISTIC Cxx_dtc_obd_it_ofs_no_norm "" VALUE 0xa002afd2 _REC_S1VAL_20_u2 65535. _CNV_A_R_A_105_CM 0. 65535. DISPLAY_IDENTIFIER fm_cal_it_ofs_no_norm.Cxx_dtc_obd_xxx /end CHARACTERISTIC
/begin CHARACTERISTIC Cxx_conf_wal_it_ofs_no_norm "" VALUE 0xa002afd4 _REC_S1VAL_20_u1 3. _CNV_A_R_A_105_CM 0. 3. DISPLAY_IDENTIFIER fm_cal_it_ofs_no_norm.fm_static_bitfield.Cxx_conf_wal_xxx BIT_MASK 0x3 /end CHARACTERISTIC
/begin CHARACTERISTIC Cbx_obd_it_ofs_no_norm "" VALUE 0xa002afd4 _REC_S1VAL_20_u1 255. _CNV_A_R_A_105_CM 0. 255. DISPLAY_IDENTIFIER fm_cal_it_ofs_no_norm.fm_static_bitfield.Cbx_obd_xxx BIT_MASK 0x4 /end CHARACTERISTIC
/begin CHARACTERISTIC Cbx_obd_mena_it_ofs_no_norm "" VALUE 0xa002afd4 _REC_S1VAL_20_u1 255. _CNV_A_R_A_105_CM 0. 255. DISPLAY_IDENTIFIER fm_cal_it_ofs_no_norm.fm_static_bitfield.Cbx_obd_mena_xxx BIT_MASK 0x8 /end CHARACTERISTIC
/begin CHARACTERISTIC Cxx_dtc_lb_it_ofs_no_norm "" VALUE 0xa002afd5 _REC_S1VAL_20_u1 255. _CNV_A_R_A_105_CM 0. 255. DISPLAY_IDENTIFIER fm_cal_it_ofs_no_norm.Cxx_dtc_lb_xxx /end CHARACTERISTIC
/begin CHARACTERISTIC Cxx_obd_dc_it_ofs_no_norm "" VALUE 0xa002afd6 _REC_S1VAL_20_u1 9. _CNV_A_R_A_105_CM 1. 10. DISPLAY_IDENTIFIER fm_cal_it_ofs_no_norm.Cxx_obd_dc_xxx /end CHARACTERISTIC
/begin CHARACTERISTIC Cxx_obd_us_typ_it_ofs_no_norm "" VALUE 0xa002afd7 _REC_S1VAL_20_u1 255. _CNV_A_R_A_105_CM 0. 255. DISPLAY_IDENTIFIER fm_cal_it_ofs_no_norm.Cxx_obd_us_typ_xxx /end CHARACTERISTIC
/begin CHARACTERISTIC Cxx_dtc_obd_it_ofs_secu_nok "" VALUE 0xa002afde _REC_S1VAL_20_u2 65535. _CNV_A_R_A_105_CM 0. 65535. DISPLAY_IDENTIFIER fm_cal_it_ofs_secu_nok.Cxx_dtc_obd_xxx /end CHARACTERISTIC
/begin CHARACTERISTIC Cxx_conf_wal_it_ofs_secu_nok "" VALUE 0xa002afe0 _REC_S1VAL_20_u1 3. _CNV_A_R_A_105_CM 0. 3. DISPLAY_IDENTIFIER fm_cal_it_ofs_secu_nok.fm_static_bitfield.Cxx_conf_wal_xxx BIT_MASK 0x3 /end CHARACTERISTIC
/begin CHARACTERISTIC Cbx_obd_it_ofs_secu_nok "" VALUE 0xa002afe0 _REC_S1VAL_20_u1 255. _CNV_A_R_A_105_CM 0. 255. DISPLAY_IDENTIFIER fm_cal_it_ofs_secu_nok.fm_static_bitfield.Cbx_obd_xxx BIT_MASK 0x4 /end CHARACTERISTIC
/begin CHARACTERISTIC Cbx_obd_mena_it_ofs_secu_nok "" VALUE 0xa002afe0 _REC_S1VAL_20_u1 255. _CNV_A_R_A_105_CM 0. 255. DISPLAY_IDENTIFIER fm_cal_it_ofs_secu_nok.fm_static_bitfield.Cbx_obd_mena_xxx BIT_MASK 0x8 /end CHARACTERISTIC
/begin CHARACTERISTIC Cxx_dtc_lb_it_ofs_secu_nok "" VALUE 0xa002afe1 _REC_S1VAL_20_u1 255. _CNV_A_R_A_105_CM 0. 255. DISPLAY_IDENTIFIER fm_cal_it_ofs_secu_nok.Cxx_dtc_lb_xxx /end CHARACTERISTIC
/begin CHARACTERISTIC Cxx_obd_dc_it_ofs_secu_nok "" VALUE 0xa002afe2 _REC_S1VAL_20_u1 9. _CNV_A_R_A_105_CM 1. 10. DISPLAY_IDENTIFIER fm_cal_it_ofs_secu_nok.Cxx_obd_dc_xxx /end CHARACTERISTIC
/begin CHARACTERISTIC Cxx_obd_us_typ_it_ofs_secu_nok "" VALUE 0xa002afe3 _REC_S1VAL_20_u1 255. _CNV_A_R_A_105_CM 0. 255. DISPLAY_IDENTIFIER fm_cal_it_ofs_secu_nok.Cxx_obd_us_typ_xxx /end CHARACTERISTIC
/begin CHARACTERISTIC Cxx_dtc_obd_it_reg_blk "" VALUE 0xa002afea _REC_S1VAL_20_u2 65535. _CNV_A_R_A_105_CM 0. 65535. DISPLAY_IDENTIFIER fm_cal_it_reg_blk.Cxx_dtc_obd_xxx /end CHARACTERISTIC
/begin CHARACTERISTIC Cxx_conf_wal_it_reg_blk "" VALUE 0xa002afec _REC_S1VAL_20_u1 3. _CNV_A_R_A_105_CM 0. 3. DISPLAY_IDENTIFIER fm_cal_it_reg_blk.fm_static_bitfield.Cxx_conf_wal_xxx BIT_MASK 0x3 /end CHARACTERISTIC
/begin CHARACTERISTIC Cbx_obd_it_reg_blk "" VALUE 0xa002afec _REC_S1VAL_20_u1 255. _CNV_A_R_A_105_CM 0. 255. DISPLAY_IDENTIFIER fm_cal_it_reg_blk.fm_static_bitfield.Cbx_obd_xxx BIT_MASK 0x4 /end CHARACTERISTIC
/begin CHARACTERISTIC Cbx_obd_mena_it_reg_blk "" VALUE 0xa002afec _REC_S1VAL_20_u1 255. _CNV_A_R_A_105_CM 0. 255. DISPLAY_IDENTIFIER fm_cal_it_reg_blk.fm_static_bitfield.Cbx_obd_mena_xxx BIT_MASK 0x8 /end CHARACTERISTIC
/begin CHARACTERISTIC Cxx_dtc_lb_it_reg_blk "" VALUE 0xa002afed _REC_S1VAL_20_u1 255. _CNV_A_R_A_105_CM 0. 255. DISPLAY_IDENTIFIER fm_cal_it_reg_blk.Cxx_dtc_lb_xxx /end CHARACTERISTIC
/begin CHARACTERISTIC Cxx_obd_dc_it_reg_blk "" VALUE 0xa002afee _REC_S1VAL_20_u1 9. _CNV_A_R_A_105_CM 1. 10. DISPLAY_IDENTIFIER fm_cal_it_reg_blk.Cxx_obd_dc_xxx /end CHARACTERISTIC
/begin CHARACTERISTIC Cxx_obd_us_typ_it_reg_blk "" VALUE 0xa002afef _REC_S1VAL_20_u1 255. _CNV_A_R_A_105_CM 0. 255. DISPLAY_IDENTIFIER fm_cal_it_reg_blk.Cxx_obd_us_typ_xxx /end CHARACTERISTIC
/begin CHARACTERISTIC Cxx_dtc_obd_knk_oor "" VALUE 0xa002aff6 _REC_S1VAL_20_u2 65535. _CNV_A_R_A_105_CM 0. 65535. DISPLAY_IDENTIFIER fm_cal_knk_oor.Cxx_dtc_obd_xxx /end CHARACTERISTIC
/begin CHARACTERISTIC Cxx_conf_wal_knk_oor "" VALUE 0xa002aff8 _REC_S1VAL_20_u1 3. _CNV_A_R_A_105_CM 0. 3. DISPLAY_IDENTIFIER fm_cal_knk_oor.fm_static_bitfield.Cxx_conf_wal_xxx BIT_MASK 0x3 /end CHARACTERISTIC
/begin CHARACTERISTIC Cbx_obd_knk_oor "" VALUE 0xa002aff8 _REC_S1VAL_20_u1 255. _CNV_A_R_A_105_CM 0. 255. DISPLAY_IDENTIFIER fm_cal_knk_oor.fm_static_bitfield.Cbx_obd_xxx BIT_MASK 0x4 /end CHARACTERISTIC
/begin CHARACTERISTIC Cbx_obd_mena_knk_oor "" VALUE 0xa002aff8 _REC_S1VAL_20_u1 255. _CNV_A_R_A_105_CM 0. 255. DISPLAY_IDENTIFIER fm_cal_knk_oor.fm_static_bitfield.Cbx_obd_mena_xxx BIT_MASK 0x8 /end CHARACTERISTIC
/begin CHARACTERISTIC Cxx_dtc_lb_knk_oor "" VALUE 0xa002aff9 _REC_S1VAL_20_u1 255. _CNV_A_R_A_105_CM 0. 255. DISPLAY_IDENTIFIER fm_cal_knk_oor.Cxx_dtc_lb_xxx /end CHARACTERISTIC
/begin CHARACTERISTIC Cxx_obd_dc_knk_oor "" VALUE 0xa002affa _REC_S1VAL_20_u1 9. _CNV_A_R_A_105_CM 1. 10. DISPLAY_IDENTIFIER fm_cal_knk_oor.Cxx_obd_dc_xxx /end CHARACTERISTIC
/begin CHARACTERISTIC Cxx_obd_us_typ_knk_oor "" VALUE 0xa002affb _REC_S1VAL_20_u1 255. _CNV_A_R_A_105_CM 0. 255. DISPLAY_IDENTIFIER fm_cal_knk_oor.Cxx_obd_us_typ_xxx /end CHARACTERISTIC
/begin CHARACTERISTIC Cxx_dtc_obd_knk_shp "" VALUE 0xa002b002 _REC_S1VAL_20_u2 65535. _CNV_A_R_A_105_CM 0. 65535. DISPLAY_IDENTIFIER fm_cal_knk_shp.Cxx_dtc_obd_xxx /end CHARACTERISTIC
/begin CHARACTERISTIC Cxx_conf_wal_knk_shp "" VALUE 0xa002b004 _REC_S1VAL_20_u1 3. _CNV_A_R_A_105_CM 0. 3. DISPLAY_IDENTIFIER fm_cal_knk_shp.fm_static_bitfield.Cxx_conf_wal_xxx BIT_MASK 0x3 /end CHARACTERISTIC
/begin CHARACTERISTIC Cbx_obd_knk_shp "" VALUE 0xa002b004 _REC_S1VAL_20_u1 255. _CNV_A_R_A_105_CM 0. 255. DISPLAY_IDENTIFIER fm_cal_knk_shp.fm_static_bitfield.Cbx_obd_xxx BIT_MASK 0x4 /end CHARACTERISTIC
/begin CHARACTERISTIC Cbx_obd_mena_knk_shp "" VALUE 0xa002b004 _REC_S1VAL_20_u1 255. _CNV_A_R_A_105_CM 0. 255. DISPLAY_IDENTIFIER fm_cal_knk_shp.fm_static_bitfield.Cbx_obd_mena_xxx BIT_MASK 0x8 /end CHARACTERISTIC
/begin CHARACTERISTIC Cxx_dtc_lb_knk_shp "" VALUE 0xa002b005 _REC_S1VAL_20_u1 255. _CNV_A_R_A_105_CM 0. 255. DISPLAY_IDENTIFIER fm_cal_knk_shp.Cxx_dtc_lb_xxx /end CHARACTERISTIC
/begin CHARACTERISTIC Cxx_obd_dc_knk_shp "" VALUE 0xa002b006 _REC_S1VAL_20_u1 9. _CNV_A_R_A_105_CM 1. 10. DISPLAY_IDENTIFIER fm_cal_knk_shp.Cxx_obd_dc_xxx /end CHARACTERISTIC
/begin CHARACTERISTIC Cxx_obd_us_typ_knk_shp "" VALUE 0xa002b007 _REC_S1VAL_20_u1 255. _CNV_A_R_A_105_CM 0. 255. DISPLAY_IDENTIFIER fm_cal_knk_shp.Cxx_obd_us_typ_xxx /end CHARACTERISTIC
/begin CHARACTERISTIC Cxx_dtc_obd_lbdw_hot_dirt_lkg "" VALUE 0xa002b6e6 _REC_S1VAL_20_u2 65535. _CNV_A_R_A_105_CM 0. 65535. DISPLAY_IDENTIFIER fm_cal_lbdw_hot_dirt_lkg.Cxx_dtc_obd_xxx /end CHARACTERISTIC
/begin CHARACTERISTIC Cxx_conf_wal_lbdw_hot_dirt_lkg "" VALUE 0xa002b6e8 _REC_S1VAL_20_u1 3. _CNV_A_R_A_105_CM 0. 3. DISPLAY_IDENTIFIER fm_cal_lbdw_hot_dirt_lkg.fm_static_bitfield.Cxx_conf_wal_xxx BIT_MASK 0x3 /end CHARACTERISTIC
/begin CHARACTERISTIC Cbx_obd_lbdw_hot_dirt_lkg "" VALUE 0xa002b6e8 _REC_S1VAL_20_u1 255. _CNV_A_R_A_105_CM 0. 255. DISPLAY_IDENTIFIER fm_cal_lbdw_hot_dirt_lkg.fm_static_bitfield.Cbx_obd_xxx BIT_MASK 0x4 /end CHARACTERISTIC
/begin CHARACTERISTIC Cbx_obd_mena_lbdw_hot_dirt_lkg "" VALUE 0xa002b6e8 _REC_S1VAL_20_u1 255. _CNV_A_R_A_105_CM 0. 255. DISPLAY_IDENTIFIER fm_cal_lbdw_hot_dirt_lkg.fm_static_bitfield.Cbx_obd_mena_xxx BIT_MASK 0x8 /end CHARACTERISTIC
/begin CHARACTERISTIC Cxx_dtc_lb_lbdw_hot_dirt_lkg "" VALUE 0xa002b6e9 _REC_S1VAL_20_u1 255. _CNV_A_R_A_105_CM 0. 255. DISPLAY_IDENTIFIER fm_cal_lbdw_hot_dirt_lkg.Cxx_dtc_lb_xxx /end CHARACTERISTIC
/begin CHARACTERISTIC Cxx_obd_dc_lbdw_hot_dirt_lkg "" VALUE 0xa002b6ea _REC_S1VAL_20_u1 9. _CNV_A_R_A_105_CM 1. 10. DISPLAY_IDENTIFIER fm_cal_lbdw_hot_dirt_lkg.Cxx_obd_dc_xxx /end CHARACTERISTIC
/begin CHARACTERISTIC Cxx_obd_us_typ_lbdw_hot_dirt_lkg "" VALUE 0xa002b6eb _REC_S1VAL_20_u1 255. _CNV_A_R_A_105_CM 0. 255. DISPLAY_IDENTIFIER fm_cal_lbdw_hot_dirt_lkg.Cxx_obd_us_typ_xxx /end CHARACTERISTIC
/begin CHARACTERISTIC Cxx_dtc_obd_lbdw_hot_oc "" VALUE 0xa002b22a _REC_S1VAL_20_u2 65535. _CNV_A_R_A_105_CM 0. 65535. DISPLAY_IDENTIFIER fm_cal_lbdw_hot_oc.Cxx_dtc_obd_xxx /end CHARACTERISTIC
/begin CHARACTERISTIC Cxx_conf_wal_lbdw_hot_oc "" VALUE 0xa002b22c _REC_S1VAL_20_u1 3. _CNV_A_R_A_105_CM 0. 3. DISPLAY_IDENTIFIER fm_cal_lbdw_hot_oc.fm_static_bitfield.Cxx_conf_wal_xxx BIT_MASK 0x3 /end CHARACTERISTIC
/begin CHARACTERISTIC Cbx_obd_lbdw_hot_oc "" VALUE 0xa002b22c _REC_S1VAL_20_u1 255. _CNV_A_R_A_105_CM 0. 255. DISPLAY_IDENTIFIER fm_cal_lbdw_hot_oc.fm_static_bitfield.Cbx_obd_xxx BIT_MASK 0x4 /end CHARACTERISTIC
/begin CHARACTERISTIC Cbx_obd_mena_lbdw_hot_oc "" VALUE 0xa002b22c _REC_S1VAL_20_u1 255. _CNV_A_R_A_105_CM 0. 255. DISPLAY_IDENTIFIER fm_cal_lbdw_hot_oc.fm_static_bitfield.Cbx_obd_mena_xxx BIT_MASK 0x8 /end CHARACTERISTIC
/begin CHARACTERISTIC Cxx_dtc_lb_lbdw_hot_oc "" VALUE 0xa002b22d _REC_S1VAL_20_u1 255. _CNV_A_R_A_105_CM 0. 255. DISPLAY_IDENTIFIER fm_cal_lbdw_hot_oc.Cxx_dtc_lb_xxx /end CHARACTERISTIC
/begin CHARACTERISTIC Cxx_obd_dc_lbdw_hot_oc "" VALUE 0xa002b22e _REC_S1VAL_20_u1 9. _CNV_A_R_A_105_CM 1. 10. DISPLAY_IDENTIFIER fm_cal_lbdw_hot_oc.Cxx_obd_dc_xxx /end CHARACTERISTIC
/begin CHARACTERISTIC Cxx_obd_us_typ_lbdw_hot_oc "" VALUE 0xa002b22f _REC_S1VAL_20_u1 255. _CNV_A_R_A_105_CM 0. 255. DISPLAY_IDENTIFIER fm_cal_lbdw_hot_oc.Cxx_obd_us_typ_xxx /end CHARACTERISTIC
/begin CHARACTERISTIC Cxx_dtc_obd_lbdw_hot_scg "" VALUE 0xa002b236 _REC_S1VAL_20_u2 65535. _CNV_A_R_A_105_CM 0. 65535. DISPLAY_IDENTIFIER fm_cal_lbdw_hot_scg.Cxx_dtc_obd_xxx /end CHARACTERISTIC
/begin CHARACTERISTIC Cxx_conf_wal_lbdw_hot_scg "" VALUE 0xa002b238 _REC_S1VAL_20_u1 3. _CNV_A_R_A_105_CM 0. 3. DISPLAY_IDENTIFIER fm_cal_lbdw_hot_scg.fm_static_bitfield.Cxx_conf_wal_xxx BIT_MASK 0x3 /end CHARACTERISTIC
/begin CHARACTERISTIC Cbx_obd_lbdw_hot_scg "" VALUE 0xa002b238 _REC_S1VAL_20_u1 255. _CNV_A_R_A_105_CM 0. 255. DISPLAY_IDENTIFIER fm_cal_lbdw_hot_scg.fm_static_bitfield.Cbx_obd_xxx BIT_MASK 0x4 /end CHARACTERISTIC
/begin CHARACTERISTIC Cbx_obd_mena_lbdw_hot_scg "" VALUE 0xa002b238 _REC_S1VAL_20_u1 255. _CNV_A_R_A_105_CM 0. 255. DISPLAY_IDENTIFIER fm_cal_lbdw_hot_scg.fm_static_bitfield.Cbx_obd_mena_xxx BIT_MASK 0x8 /end CHARACTERISTIC
/begin CHARACTERISTIC Cxx_dtc_lb_lbdw_hot_scg "" VALUE 0xa002b239 _REC_S1VAL_20_u1 255. _CNV_A_R_A_105_CM 0. 255. DISPLAY_IDENTIFIER fm_cal_lbdw_hot_scg.Cxx_dtc_lb_xxx /end CHARACTERISTIC
/begin CHARACTERISTIC Cxx_obd_dc_lbdw_hot_scg "" VALUE 0xa002b23a _REC_S1VAL_20_u1 9. _CNV_A_R_A_105_CM 1. 10. DISPLAY_IDENTIFIER fm_cal_lbdw_hot_scg.Cxx_obd_dc_xxx /end CHARACTERISTIC
/begin CHARACTERISTIC Cxx_obd_us_typ_lbdw_hot_scg "" VALUE 0xa002b23b _REC_S1VAL_20_u1 255. _CNV_A_R_A_105_CM 0. 255. DISPLAY_IDENTIFIER fm_cal_lbdw_hot_scg.Cxx_obd_us_typ_xxx /end CHARACTERISTIC
/begin CHARACTERISTIC Cxx_dtc_obd_lbdw_hot_scw "" VALUE 0xa002b242 _REC_S1VAL_20_u2 65535. _CNV_A_R_A_105_CM 0. 65535. DISPLAY_IDENTIFIER fm_cal_lbdw_hot_scw.Cxx_dtc_obd_xxx /end CHARACTERISTIC
/begin CHARACTERISTIC Cxx_conf_wal_lbdw_hot_scw "" VALUE 0xa002b244 _REC_S1VAL_20_u1 3. _CNV_A_R_A_105_CM 0. 3. DISPLAY_IDENTIFIER fm_cal_lbdw_hot_scw.fm_static_bitfield.Cxx_conf_wal_xxx BIT_MASK 0x3 /end CHARACTERISTIC
/begin CHARACTERISTIC Cbx_obd_lbdw_hot_scw "" VALUE 0xa002b244 _REC_S1VAL_20_u1 255. _CNV_A_R_A_105_CM 0. 255. DISPLAY_IDENTIFIER fm_cal_lbdw_hot_scw.fm_static_bitfield.Cbx_obd_xxx BIT_MASK 0x4 /end CHARACTERISTIC
/begin CHARACTERISTIC Cbx_obd_mena_lbdw_hot_scw "" VALUE 0xa002b244 _REC_S1VAL_20_u1 255. _CNV_A_R_A_105_CM 0. 255. DISPLAY_IDENTIFIER fm_cal_lbdw_hot_scw.fm_static_bitfield.Cbx_obd_mena_xxx BIT_MASK 0x8 /end CHARACTERISTIC
/begin CHARACTERISTIC Cxx_dtc_lb_lbdw_hot_scw "" VALUE 0xa002b245 _REC_S1VAL_20_u1 255. _CNV_A_R_A_105_CM 0. 255. DISPLAY_IDENTIFIER fm_cal_lbdw_hot_scw.Cxx_dtc_lb_xxx /end CHARACTERISTIC
/begin CHARACTERISTIC Cxx_obd_dc_lbdw_hot_scw "" VALUE 0xa002b246 _REC_S1VAL_20_u1 9. _CNV_A_R_A_105_CM 1. 10. DISPLAY_IDENTIFIER fm_cal_lbdw_hot_scw.Cxx_obd_dc_xxx /end CHARACTERISTIC
/begin CHARACTERISTIC Cxx_obd_us_typ_lbdw_hot_scw "" VALUE 0xa002b247 _REC_S1VAL_20_u1 255. _CNV_A_R_A_105_CM 0. 255. DISPLAY_IDENTIFIER fm_cal_lbdw_hot_scw.Cxx_obd_us_typ_xxx /end CHARACTERISTIC
/begin CHARACTERISTIC Cxx_dtc_obd_lbdw_oc "" VALUE 0xa002b00e _REC_S1VAL_20_u2 65535. _CNV_A_R_A_105_CM 0. 65535. DISPLAY_IDENTIFIER fm_cal_lbdw_oc.Cxx_dtc_obd_xxx /end CHARACTERISTIC
/begin CHARACTERISTIC Cxx_conf_wal_lbdw_oc "" VALUE 0xa002b010 _REC_S1VAL_20_u1 3. _CNV_A_R_A_105_CM 0. 3. DISPLAY_IDENTIFIER fm_cal_lbdw_oc.fm_static_bitfield.Cxx_conf_wal_xxx BIT_MASK 0x3 /end CHARACTERISTIC
/begin CHARACTERISTIC Cbx_obd_lbdw_oc "" VALUE 0xa002b010 _REC_S1VAL_20_u1 255. _CNV_A_R_A_105_CM 0. 255. DISPLAY_IDENTIFIER fm_cal_lbdw_oc.fm_static_bitfield.Cbx_obd_xxx BIT_MASK 0x4 /end CHARACTERISTIC
/begin CHARACTERISTIC Cbx_obd_mena_lbdw_oc "" VALUE 0xa002b010 _REC_S1VAL_20_u1 255. _CNV_A_R_A_105_CM 0. 255. DISPLAY_IDENTIFIER fm_cal_lbdw_oc.fm_static_bitfield.Cbx_obd_mena_xxx BIT_MASK 0x8 /end CHARACTERISTIC
/begin CHARACTERISTIC Cxx_dtc_lb_lbdw_oc "" VALUE 0xa002b011 _REC_S1VAL_20_u1 255. _CNV_A_R_A_105_CM 0. 255. DISPLAY_IDENTIFIER fm_cal_lbdw_oc.Cxx_dtc_lb_xxx /end CHARACTERISTIC
/begin CHARACTERISTIC Cxx_obd_dc_lbdw_oc "" VALUE 0xa002b012 _REC_S1VAL_20_u1 9. _CNV_A_R_A_105_CM 1. 10. DISPLAY_IDENTIFIER fm_cal_lbdw_oc.Cxx_obd_dc_xxx /end CHARACTERISTIC
/begin CHARACTERISTIC Cxx_obd_us_typ_lbdw_oc "" VALUE 0xa002b013 _REC_S1VAL_20_u1 255. _CNV_A_R_A_105_CM 0. 255. DISPLAY_IDENTIFIER fm_cal_lbdw_oc.Cxx_obd_us_typ_xxx /end CHARACTERISTIC
/begin CHARACTERISTIC Cxx_dtc_obd_lbdw_scg "" VALUE 0xa002b01a _REC_S1VAL_20_u2 65535. _CNV_A_R_A_105_CM 0. 65535. DISPLAY_IDENTIFIER fm_cal_lbdw_scg.Cxx_dtc_obd_xxx /end CHARACTERISTIC
/begin CHARACTERISTIC Cxx_conf_wal_lbdw_scg "" VALUE 0xa002b01c _REC_S1VAL_20_u1 3. _CNV_A_R_A_105_CM 0. 3. DISPLAY_IDENTIFIER fm_cal_lbdw_scg.fm_static_bitfield.Cxx_conf_wal_xxx BIT_MASK 0x3 /end CHARACTERISTIC
/begin CHARACTERISTIC Cbx_obd_lbdw_scg "" VALUE 0xa002b01c _REC_S1VAL_20_u1 255. _CNV_A_R_A_105_CM 0. 255. DISPLAY_IDENTIFIER fm_cal_lbdw_scg.fm_static_bitfield.Cbx_obd_xxx BIT_MASK 0x4 /end CHARACTERISTIC
/begin CHARACTERISTIC Cbx_obd_mena_lbdw_scg "" VALUE 0xa002b01c _REC_S1VAL_20_u1 255. _CNV_A_R_A_105_CM 0. 255. DISPLAY_IDENTIFIER fm_cal_lbdw_scg.fm_static_bitfield.Cbx_obd_mena_xxx BIT_MASK 0x8 /end CHARACTERISTIC
/begin CHARACTERISTIC Cxx_dtc_lb_lbdw_scg "" VALUE 0xa002b01d _REC_S1VAL_20_u1 255. _CNV_A_R_A_105_CM 0. 255. DISPLAY_IDENTIFIER fm_cal_lbdw_scg.Cxx_dtc_lb_xxx /end CHARACTERISTIC
/begin CHARACTERISTIC Cxx_obd_dc_lbdw_scg "" VALUE 0xa002b01e _REC_S1VAL_20_u1 9. _CNV_A_R_A_105_CM 1. 10. DISPLAY_IDENTIFIER fm_cal_lbdw_scg.Cxx_obd_dc_xxx /end CHARACTERISTIC
/begin CHARACTERISTIC Cxx_obd_us_typ_lbdw_scg "" VALUE 0xa002b01f _REC_S1VAL_20_u1 255. _CNV_A_R_A_105_CM 0. 255. DISPLAY_IDENTIFIER fm_cal_lbdw_scg.Cxx_obd_us_typ_xxx /end CHARACTERISTIC
/begin CHARACTERISTIC Cxx_dtc_obd_lbdw_scw "" VALUE 0xa002b026 _REC_S1VAL_20_u2 65535. _CNV_A_R_A_105_CM 0. 65535. DISPLAY_IDENTIFIER fm_cal_lbdw_scw.Cxx_dtc_obd_xxx /end CHARACTERISTIC
/begin CHARACTERISTIC Cxx_conf_wal_lbdw_scw "" VALUE 0xa002b028 _REC_S1VAL_20_u1 3. _CNV_A_R_A_105_CM 0. 3. DISPLAY_IDENTIFIER fm_cal_lbdw_scw.fm_static_bitfield.Cxx_conf_wal_xxx BIT_MASK 0x3 /end CHARACTERISTIC
/begin CHARACTERISTIC Cbx_obd_lbdw_scw "" VALUE 0xa002b028 _REC_S1VAL_20_u1 255. _CNV_A_R_A_105_CM 0. 255. DISPLAY_IDENTIFIER fm_cal_lbdw_scw.fm_static_bitfield.Cbx_obd_xxx BIT_MASK 0x4 /end CHARACTERISTIC
/begin CHARACTERISTIC Cbx_obd_mena_lbdw_scw "" VALUE 0xa002b028 _REC_S1VAL_20_u1 255. _CNV_A_R_A_105_CM 0. 255. DISPLAY_IDENTIFIER fm_cal_lbdw_scw.fm_static_bitfield.Cbx_obd_mena_xxx BIT_MASK 0x8 /end CHARACTERISTIC
/begin CHARACTERISTIC Cxx_dtc_lb_lbdw_scw "" VALUE 0xa002b029 _REC_S1VAL_20_u1 255. _CNV_A_R_A_105_CM 0. 255. DISPLAY_IDENTIFIER fm_cal_lbdw_scw.Cxx_dtc_lb_xxx /end CHARACTERISTIC
/begin CHARACTERISTIC Cxx_obd_dc_lbdw_scw "" VALUE 0xa002b02a _REC_S1VAL_20_u1 9. _CNV_A_R_A_105_CM 1. 10. DISPLAY_IDENTIFIER fm_cal_lbdw_scw.Cxx_obd_dc_xxx /end CHARACTERISTIC
/begin CHARACTERISTIC Cxx_obd_us_typ_lbdw_scw "" VALUE 0xa002b02b _REC_S1VAL_20_u1 255. _CNV_A_R_A_105_CM 0. 255. DISPLAY_IDENTIFIER fm_cal_lbdw_scw.Cxx_obd_us_typ_xxx /end CHARACTERISTIC
/begin CHARACTERISTIC Cxx_dtc_obd_lbup_cpt "" VALUE 0xa002b46a _REC_S1VAL_20_u2 65535. _CNV_A_R_A_105_CM 0. 65535. DISPLAY_IDENTIFIER fm_cal_lbup_cpt.Cxx_dtc_obd_xxx /end CHARACTERISTIC
/begin CHARACTERISTIC Cxx_conf_wal_lbup_cpt "" VALUE 0xa002b46c _REC_S1VAL_20_u1 3. _CNV_A_R_A_105_CM 0. 3. DISPLAY_IDENTIFIER fm_cal_lbup_cpt.fm_static_bitfield.Cxx_conf_wal_xxx BIT_MASK 0x3 /end CHARACTERISTIC
/begin CHARACTERISTIC Cbx_obd_lbup_cpt "" VALUE 0xa002b46c _REC_S1VAL_20_u1 255. _CNV_A_R_A_105_CM 0. 255. DISPLAY_IDENTIFIER fm_cal_lbup_cpt.fm_static_bitfield.Cbx_obd_xxx BIT_MASK 0x4 /end CHARACTERISTIC
/begin CHARACTERISTIC Cbx_obd_mena_lbup_cpt "" VALUE 0xa002b46c _REC_S1VAL_20_u1 255. _CNV_A_R_A_105_CM 0. 255. DISPLAY_IDENTIFIER fm_cal_lbup_cpt.fm_static_bitfield.Cbx_obd_mena_xxx BIT_MASK 0x8 /end CHARACTERISTIC
/begin CHARACTERISTIC Cxx_dtc_lb_lbup_cpt "" VALUE 0xa002b46d _REC_S1VAL_20_u1 255. _CNV_A_R_A_105_CM 0. 255. DISPLAY_IDENTIFIER fm_cal_lbup_cpt.Cxx_dtc_lb_xxx /end CHARACTERISTIC
/begin CHARACTERISTIC Cxx_obd_dc_lbup_cpt "" VALUE 0xa002b46e _REC_S1VAL_20_u1 9. _CNV_A_R_A_105_CM 1. 10. DISPLAY_IDENTIFIER fm_cal_lbup_cpt.Cxx_obd_dc_xxx /end CHARACTERISTIC
/begin CHARACTERISTIC Cxx_obd_us_typ_lbup_cpt "" VALUE 0xa002b46f _REC_S1VAL_20_u1 255. _CNV_A_R_A_105_CM 0. 255. DISPLAY_IDENTIFIER fm_cal_lbup_cpt.Cxx_obd_us_typ_xxx /end CHARACTERISTIC
/begin CHARACTERISTIC Cxx_dtc_obd_lbup_hot_apl_down "" VALUE 0xa002b656 _REC_S1VAL_20_u2 65535. _CNV_A_R_A_105_CM 0. 65535. DISPLAY_IDENTIFIER fm_cal_lbup_hot_apl_down.Cxx_dtc_obd_xxx /end CHARACTERISTIC
/begin CHARACTERISTIC Cxx_conf_wal_lbup_hot_apl_down "" VALUE 0xa002b658 _REC_S1VAL_20_u1 3. _CNV_A_R_A_105_CM 0. 3. DISPLAY_IDENTIFIER fm_cal_lbup_hot_apl_down.fm_static_bitfield.Cxx_conf_wal_xxx BIT_MASK 0x3 /end CHARACTERISTIC
/begin CHARACTERISTIC Cbx_obd_lbup_hot_apl_down "" VALUE 0xa002b658 _REC_S1VAL_20_u1 255. _CNV_A_R_A_105_CM 0. 255. DISPLAY_IDENTIFIER fm_cal_lbup_hot_apl_down.fm_static_bitfield.Cbx_obd_xxx BIT_MASK 0x4 /end CHARACTERISTIC
/begin CHARACTERISTIC Cbx_obd_mena_lbup_hot_apl_down "" VALUE 0xa002b658 _REC_S1VAL_20_u1 255. _CNV_A_R_A_105_CM 0. 255. DISPLAY_IDENTIFIER fm_cal_lbup_hot_apl_down.fm_static_bitfield.Cbx_obd_mena_xxx BIT_MASK 0x8 /end CHARACTERISTIC
/begin CHARACTERISTIC Cxx_dtc_lb_lbup_hot_apl_down "" VALUE 0xa002b659 _REC_S1VAL_20_u1 255. _CNV_A_R_A_105_CM 0. 255. DISPLAY_IDENTIFIER fm_cal_lbup_hot_apl_down.Cxx_dtc_lb_xxx /end CHARACTERISTIC
/begin CHARACTERISTIC Cxx_obd_dc_lbup_hot_apl_down "" VALUE 0xa002b65a _REC_S1VAL_20_u1 9. _CNV_A_R_A_105_CM 1. 10. DISPLAY_IDENTIFIER fm_cal_lbup_hot_apl_down.Cxx_obd_dc_xxx /end CHARACTERISTIC
/begin CHARACTERISTIC Cxx_obd_us_typ_lbup_hot_apl_down "" VALUE 0xa002b65b _REC_S1VAL_20_u1 255. _CNV_A_R_A_105_CM 0. 255. DISPLAY_IDENTIFIER fm_cal_lbup_hot_apl_down.Cxx_obd_us_typ_xxx /end CHARACTERISTIC
/begin CHARACTERISTIC Cxx_dtc_obd_lbup_hot_dirt_lkg "" VALUE 0xa002b6f2 _REC_S1VAL_20_u2 65535. _CNV_A_R_A_105_CM 0. 65535. DISPLAY_IDENTIFIER fm_cal_lbup_hot_dirt_lkg.Cxx_dtc_obd_xxx /end CHARACTERISTIC
/begin CHARACTERISTIC Cxx_conf_wal_lbup_hot_dirt_lkg "" VALUE 0xa002b6f4 _REC_S1VAL_20_u1 3. _CNV_A_R_A_105_CM 0. 3. DISPLAY_IDENTIFIER fm_cal_lbup_hot_dirt_lkg.fm_static_bitfield.Cxx_conf_wal_xxx BIT_MASK 0x3 /end CHARACTERISTIC
/begin CHARACTERISTIC Cbx_obd_lbup_hot_dirt_lkg "" VALUE 0xa002b6f4 _REC_S1VAL_20_u1 255. _CNV_A_R_A_105_CM 0. 255. DISPLAY_IDENTIFIER fm_cal_lbup_hot_dirt_lkg.fm_static_bitfield.Cbx_obd_xxx BIT_MASK 0x4 /end CHARACTERISTIC
/begin CHARACTERISTIC Cbx_obd_mena_lbup_hot_dirt_lkg "" VALUE 0xa002b6f4 _REC_S1VAL_20_u1 255. _CNV_A_R_A_105_CM 0. 255. DISPLAY_IDENTIFIER fm_cal_lbup_hot_dirt_lkg.fm_static_bitfield.Cbx_obd_mena_xxx BIT_MASK 0x8 /end CHARACTERISTIC
/begin CHARACTERISTIC Cxx_dtc_lb_lbup_hot_dirt_lkg "" VALUE 0xa002b6f5 _REC_S1VAL_20_u1 255. _CNV_A_R_A_105_CM 0. 255. DISPLAY_IDENTIFIER fm_cal_lbup_hot_dirt_lkg.Cxx_dtc_lb_xxx /end CHARACTERISTIC
/begin CHARACTERISTIC Cxx_obd_dc_lbup_hot_dirt_lkg "" VALUE 0xa002b6f6 _REC_S1VAL_20_u1 9. _CNV_A_R_A_105_CM 1. 10. DISPLAY_IDENTIFIER fm_cal_lbup_hot_dirt_lkg.Cxx_obd_dc_xxx /end CHARACTERISTIC
/begin CHARACTERISTIC Cxx_obd_us_typ_lbup_hot_dirt_lkg "" VALUE 0xa002b6f7 _REC_S1VAL_20_u1 255. _CNV_A_R_A_105_CM 0. 255. DISPLAY_IDENTIFIER fm_cal_lbup_hot_dirt_lkg.Cxx_obd_us_typ_xxx /end CHARACTERISTIC
/begin CHARACTERISTIC Cxx_dtc_obd_lbup_hot_oc "" VALUE 0xa002b24e _REC_S1VAL_20_u2 65535. _CNV_A_R_A_105_CM 0. 65535. DISPLAY_IDENTIFIER fm_cal_lbup_hot_oc.Cxx_dtc_obd_xxx /end CHARACTERISTIC
/begin CHARACTERISTIC Cxx_conf_wal_lbup_hot_oc "" VALUE 0xa002b250 _REC_S1VAL_20_u1 3. _CNV_A_R_A_105_CM 0. 3. DISPLAY_IDENTIFIER fm_cal_lbup_hot_oc.fm_static_bitfield.Cxx_conf_wal_xxx BIT_MASK 0x3 /end CHARACTERISTIC
/begin CHARACTERISTIC Cbx_obd_lbup_hot_oc "" VALUE 0xa002b250 _REC_S1VAL_20_u1 255. _CNV_A_R_A_105_CM 0. 255. DISPLAY_IDENTIFIER fm_cal_lbup_hot_oc.fm_static_bitfield.Cbx_obd_xxx BIT_MASK 0x4 /end CHARACTERISTIC
/begin CHARACTERISTIC Cbx_obd_mena_lbup_hot_oc "" VALUE 0xa002b250 _REC_S1VAL_20_u1 255. _CNV_A_R_A_105_CM 0. 255. DISPLAY_IDENTIFIER fm_cal_lbup_hot_oc.fm_static_bitfield.Cbx_obd_mena_xxx BIT_MASK 0x8 /end CHARACTERISTIC
/begin CHARACTERISTIC Cxx_dtc_lb_lbup_hot_oc "" VALUE 0xa002b251 _REC_S1VAL_20_u1 255. _CNV_A_R_A_105_CM 0. 255. DISPLAY_IDENTIFIER fm_cal_lbup_hot_oc.Cxx_dtc_lb_xxx /end CHARACTERISTIC
/begin CHARACTERISTIC Cxx_obd_dc_lbup_hot_oc "" VALUE 0xa002b252 _REC_S1VAL_20_u1 9. _CNV_A_R_A_105_CM 1. 10. DISPLAY_IDENTIFIER fm_cal_lbup_hot_oc.Cxx_obd_dc_xxx /end CHARACTERISTIC
/begin CHARACTERISTIC Cxx_obd_us_typ_lbup_hot_oc "" VALUE 0xa002b253 _REC_S1VAL_20_u1 255. _CNV_A_R_A_105_CM 0. 255. DISPLAY_IDENTIFIER fm_cal_lbup_hot_oc.Cxx_obd_us_typ_xxx /end CHARACTERISTIC
/begin CHARACTERISTIC Cxx_dtc_obd_lbup_hot_scg "" VALUE 0xa002b25a _REC_S1VAL_20_u2 65535. _CNV_A_R_A_105_CM 0. 65535. DISPLAY_IDENTIFIER fm_cal_lbup_hot_scg.Cxx_dtc_obd_xxx /end CHARACTERISTIC
/begin CHARACTERISTIC Cxx_conf_wal_lbup_hot_scg "" VALUE 0xa002b25c _REC_S1VAL_20_u1 3. _CNV_A_R_A_105_CM 0. 3. DISPLAY_IDENTIFIER fm_cal_lbup_hot_scg.fm_static_bitfield.Cxx_conf_wal_xxx BIT_MASK 0x3 /end CHARACTERISTIC
/begin CHARACTERISTIC Cbx_obd_lbup_hot_scg "" VALUE 0xa002b25c _REC_S1VAL_20_u1 255. _CNV_A_R_A_105_CM 0. 255. DISPLAY_IDENTIFIER fm_cal_lbup_hot_scg.fm_static_bitfield.Cbx_obd_xxx BIT_MASK 0x4 /end CHARACTERISTIC
/begin CHARACTERISTIC Cbx_obd_mena_lbup_hot_scg "" VALUE 0xa002b25c _REC_S1VAL_20_u1 255. _CNV_A_R_A_105_CM 0. 255. DISPLAY_IDENTIFIER fm_cal_lbup_hot_scg.fm_static_bitfield.Cbx_obd_mena_xxx BIT_MASK 0x8 /end CHARACTERISTIC
/begin CHARACTERISTIC Cxx_dtc_lb_lbup_hot_scg "" VALUE 0xa002b25d _REC_S1VAL_20_u1 255. _CNV_A_R_A_105_CM 0. 255. DISPLAY_IDENTIFIER fm_cal_lbup_hot_scg.Cxx_dtc_lb_xxx /end CHARACTERISTIC
/begin CHARACTERISTIC Cxx_obd_dc_lbup_hot_scg "" VALUE 0xa002b25e _REC_S1VAL_20_u1 9. _CNV_A_R_A_105_CM 1. 10. DISPLAY_IDENTIFIER fm_cal_lbup_hot_scg.Cxx_obd_dc_xxx /end CHARACTERISTIC
/begin CHARACTERISTIC Cxx_obd_us_typ_lbup_hot_scg "" VALUE 0xa002b25f _REC_S1VAL_20_u1 255. _CNV_A_R_A_105_CM 0. 255. DISPLAY_IDENTIFIER fm_cal_lbup_hot_scg.Cxx_obd_us_typ_xxx /end CHARACTERISTIC
/begin CHARACTERISTIC Cxx_dtc_obd_lbup_hot_scw "" VALUE 0xa002b266 _REC_S1VAL_20_u2 65535. _CNV_A_R_A_105_CM 0. 65535. DISPLAY_IDENTIFIER fm_cal_lbup_hot_scw.Cxx_dtc_obd_xxx /end CHARACTERISTIC
/begin CHARACTERISTIC Cxx_conf_wal_lbup_hot_scw "" VALUE 0xa002b268 _REC_S1VAL_20_u1 3. _CNV_A_R_A_105_CM 0. 3. DISPLAY_IDENTIFIER fm_cal_lbup_hot_scw.fm_static_bitfield.Cxx_conf_wal_xxx BIT_MASK 0x3 /end CHARACTERISTIC
/begin CHARACTERISTIC Cbx_obd_lbup_hot_scw "" VALUE 0xa002b268 _REC_S1VAL_20_u1 255. _CNV_A_R_A_105_CM 0. 255. DISPLAY_IDENTIFIER fm_cal_lbup_hot_scw.fm_static_bitfield.Cbx_obd_xxx BIT_MASK 0x4 /end CHARACTERISTIC
/begin CHARACTERISTIC Cbx_obd_mena_lbup_hot_scw "" VALUE 0xa002b268 _REC_S1VAL_20_u1 255. _CNV_A_R_A_105_CM 0. 255. DISPLAY_IDENTIFIER fm_cal_lbup_hot_scw.fm_static_bitfield.Cbx_obd_mena_xxx BIT_MASK 0x8 /end CHARACTERISTIC
/begin CHARACTERISTIC Cxx_dtc_lb_lbup_hot_scw "" VALUE 0xa002b269 _REC_S1VAL_20_u1 255. _CNV_A_R_A_105_CM 0. 255. DISPLAY_IDENTIFIER fm_cal_lbup_hot_scw.Cxx_dtc_lb_xxx /end CHARACTERISTIC
/begin CHARACTERISTIC Cxx_obd_dc_lbup_hot_scw "" VALUE 0xa002b26a _REC_S1VAL_20_u1 9. _CNV_A_R_A_105_CM 1. 10. DISPLAY_IDENTIFIER fm_cal_lbup_hot_scw.Cxx_obd_dc_xxx /end CHARACTERISTIC
/begin CHARACTERISTIC Cxx_obd_us_typ_lbup_hot_scw "" VALUE 0xa002b26b _REC_S1VAL_20_u1 255. _CNV_A_R_A_105_CM 0. 255. DISPLAY_IDENTIFIER fm_cal_lbup_hot_scw.Cxx_obd_us_typ_xxx /end CHARACTERISTIC
/begin CHARACTERISTIC Cxx_dtc_obd_lbup_nok "" VALUE 0xa002b64a _REC_S1VAL_20_u2 65535. _CNV_A_R_A_105_CM 0. 65535. DISPLAY_IDENTIFIER fm_cal_lbup_nok.Cxx_dtc_obd_xxx /end CHARACTERISTIC
/begin CHARACTERISTIC Cxx_conf_wal_lbup_nok "" VALUE 0xa002b64c _REC_S1VAL_20_u1 3. _CNV_A_R_A_105_CM 0. 3. DISPLAY_IDENTIFIER fm_cal_lbup_nok.fm_static_bitfield.Cxx_conf_wal_xxx BIT_MASK 0x3 /end CHARACTERISTIC
/begin CHARACTERISTIC Cbx_obd_lbup_nok "" VALUE 0xa002b64c _REC_S1VAL_20_u1 255. _CNV_A_R_A_105_CM 0. 255. DISPLAY_IDENTIFIER fm_cal_lbup_nok.fm_static_bitfield.Cbx_obd_xxx BIT_MASK 0x4 /end CHARACTERISTIC
/begin CHARACTERISTIC Cbx_obd_mena_lbup_nok "" VALUE 0xa002b64c _REC_S1VAL_20_u1 255. _CNV_A_R_A_105_CM 0. 255. DISPLAY_IDENTIFIER fm_cal_lbup_nok.fm_static_bitfield.Cbx_obd_mena_xxx BIT_MASK 0x8 /end CHARACTERISTIC
/begin CHARACTERISTIC Cxx_dtc_lb_lbup_nok "" VALUE 0xa002b64d _REC_S1VAL_20_u1 255. _CNV_A_R_A_105_CM 0. 255. DISPLAY_IDENTIFIER fm_cal_lbup_nok.Cxx_dtc_lb_xxx /end CHARACTERISTIC
/begin CHARACTERISTIC Cxx_obd_dc_lbup_nok "" VALUE 0xa002b64e _REC_S1VAL_20_u1 9. _CNV_A_R_A_105_CM 1. 10. DISPLAY_IDENTIFIER fm_cal_lbup_nok.Cxx_obd_dc_xxx /end CHARACTERISTIC
/begin CHARACTERISTIC Cxx_obd_us_typ_lbup_nok "" VALUE 0xa002b64f _REC_S1VAL_20_u1 255. _CNV_A_R_A_105_CM 0. 255. DISPLAY_IDENTIFIER fm_cal_lbup_nok.Cxx_obd_us_typ_xxx /end CHARACTERISTIC
/begin CHARACTERISTIC Cxx_dtc_obd_lbup_oc "" VALUE 0xa002b032 _REC_S1VAL_20_u2 65535. _CNV_A_R_A_105_CM 0. 65535. DISPLAY_IDENTIFIER fm_cal_lbup_oc.Cxx_dtc_obd_xxx /end CHARACTERISTIC
/begin CHARACTERISTIC Cxx_conf_wal_lbup_oc "" VALUE 0xa002b034 _REC_S1VAL_20_u1 3. _CNV_A_R_A_105_CM 0. 3. DISPLAY_IDENTIFIER fm_cal_lbup_oc.fm_static_bitfield.Cxx_conf_wal_xxx BIT_MASK 0x3 /end CHARACTERISTIC
/begin CHARACTERISTIC Cbx_obd_lbup_oc "" VALUE 0xa002b034 _REC_S1VAL_20_u1 255. _CNV_A_R_A_105_CM 0. 255. DISPLAY_IDENTIFIER fm_cal_lbup_oc.fm_static_bitfield.Cbx_obd_xxx BIT_MASK 0x4 /end CHARACTERISTIC
/begin CHARACTERISTIC Cbx_obd_mena_lbup_oc "" VALUE 0xa002b034 _REC_S1VAL_20_u1 255. _CNV_A_R_A_105_CM 0. 255. DISPLAY_IDENTIFIER fm_cal_lbup_oc.fm_static_bitfield.Cbx_obd_mena_xxx BIT_MASK 0x8 /end CHARACTERISTIC
/begin CHARACTERISTIC Cxx_dtc_lb_lbup_oc "" VALUE 0xa002b035 _REC_S1VAL_20_u1 255. _CNV_A_R_A_105_CM 0. 255. DISPLAY_IDENTIFIER fm_cal_lbup_oc.Cxx_dtc_lb_xxx /end CHARACTERISTIC
/begin CHARACTERISTIC Cxx_obd_dc_lbup_oc "" VALUE 0xa002b036 _REC_S1VAL_20_u1 9. _CNV_A_R_A_105_CM 1. 10. DISPLAY_IDENTIFIER fm_cal_lbup_oc.Cxx_obd_dc_xxx /end CHARACTERISTIC
/begin CHARACTERISTIC Cxx_obd_us_typ_lbup_oc "" VALUE 0xa002b037 _REC_S1VAL_20_u1 255. _CNV_A_R_A_105_CM 0. 255. DISPLAY_IDENTIFIER fm_cal_lbup_oc.Cxx_obd_us_typ_xxx /end CHARACTERISTIC
/begin CHARACTERISTIC Cxx_dtc_obd_lbup_scg "" VALUE 0xa002b03e _REC_S1VAL_20_u2 65535. _CNV_A_R_A_105_CM 0. 65535. DISPLAY_IDENTIFIER fm_cal_lbup_scg.Cxx_dtc_obd_xxx /end CHARACTERISTIC
/begin CHARACTERISTIC Cxx_conf_wal_lbup_scg "" VALUE 0xa002b040 _REC_S1VAL_20_u1 3. _CNV_A_R_A_105_CM 0. 3. DISPLAY_IDENTIFIER fm_cal_lbup_scg.fm_static_bitfield.Cxx_conf_wal_xxx BIT_MASK 0x3 /end CHARACTERISTIC
/begin CHARACTERISTIC Cbx_obd_lbup_scg "" VALUE 0xa002b040 _REC_S1VAL_20_u1 255. _CNV_A_R_A_105_CM 0. 255. DISPLAY_IDENTIFIER fm_cal_lbup_scg.fm_static_bitfield.Cbx_obd_xxx BIT_MASK 0x4 /end CHARACTERISTIC
/begin CHARACTERISTIC Cbx_obd_mena_lbup_scg "" VALUE 0xa002b040 _REC_S1VAL_20_u1 255. _CNV_A_R_A_105_CM 0. 255. DISPLAY_IDENTIFIER fm_cal_lbup_scg.fm_static_bitfield.Cbx_obd_mena_xxx BIT_MASK 0x8 /end CHARACTERISTIC
/begin CHARACTERISTIC Cxx_dtc_lb_lbup_scg "" VALUE 0xa002b041 _REC_S1VAL_20_u1 255. _CNV_A_R_A_105_CM 0. 255. DISPLAY_IDENTIFIER fm_cal_lbup_scg.Cxx_dtc_lb_xxx /end CHARACTERISTIC
/begin CHARACTERISTIC Cxx_obd_dc_lbup_scg "" VALUE 0xa002b042 _REC_S1VAL_20_u1 9. _CNV_A_R_A_105_CM 1. 10. DISPLAY_IDENTIFIER fm_cal_lbup_scg.Cxx_obd_dc_xxx /end CHARACTERISTIC
/begin CHARACTERISTIC Cxx_obd_us_typ_lbup_scg "" VALUE 0xa002b043 _REC_S1VAL_20_u1 255. _CNV_A_R_A_105_CM 0. 255. DISPLAY_IDENTIFIER fm_cal_lbup_scg.Cxx_obd_us_typ_xxx /end CHARACTERISTIC
/begin CHARACTERISTIC Cxx_dtc_obd_lbup_scw "" VALUE 0xa002b04a _REC_S1VAL_20_u2 65535. _CNV_A_R_A_105_CM 0. 65535. DISPLAY_IDENTIFIER fm_cal_lbup_scw.Cxx_dtc_obd_xxx /end CHARACTERISTIC
/begin CHARACTERISTIC Cxx_conf_wal_lbup_scw "" VALUE 0xa002b04c _REC_S1VAL_20_u1 3. _CNV_A_R_A_105_CM 0. 3. DISPLAY_IDENTIFIER fm_cal_lbup_scw.fm_static_bitfield.Cxx_conf_wal_xxx BIT_MASK 0x3 /end CHARACTERISTIC
/begin CHARACTERISTIC Cbx_obd_lbup_scw "" VALUE 0xa002b04c _REC_S1VAL_20_u1 255. _CNV_A_R_A_105_CM 0. 255. DISPLAY_IDENTIFIER fm_cal_lbup_scw.fm_static_bitfield.Cbx_obd_xxx BIT_MASK 0x4 /end CHARACTERISTIC
/begin CHARACTERISTIC Cbx_obd_mena_lbup_scw "" VALUE 0xa002b04c _REC_S1VAL_20_u1 255. _CNV_A_R_A_105_CM 0. 255. DISPLAY_IDENTIFIER fm_cal_lbup_scw.fm_static_bitfield.Cbx_obd_mena_xxx BIT_MASK 0x8 /end CHARACTERISTIC
/begin CHARACTERISTIC Cxx_dtc_lb_lbup_scw "" VALUE 0xa002b04d _REC_S1VAL_20_u1 255. _CNV_A_R_A_105_CM 0. 255. DISPLAY_IDENTIFIER fm_cal_lbup_scw.Cxx_dtc_lb_xxx /end CHARACTERISTIC
/begin CHARACTERISTIC Cxx_obd_dc_lbup_scw "" VALUE 0xa002b04e _REC_S1VAL_20_u1 9. _CNV_A_R_A_105_CM 1. 10. DISPLAY_IDENTIFIER fm_cal_lbup_scw.Cxx_obd_dc_xxx /end CHARACTERISTIC
/begin CHARACTERISTIC Cxx_obd_us_typ_lbup_scw "" VALUE 0xa002b04f _REC_S1VAL_20_u1 255. _CNV_A_R_A_105_CM 0. 255. DISPLAY_IDENTIFIER fm_cal_lbup_scw.Cxx_obd_us_typ_xxx /end CHARACTERISTIC
/begin CHARACTERISTIC Cxx_dtc_obd_lbup_shf_h "" VALUE 0xa002b75e _REC_S1VAL_20_u2 65535. _CNV_A_R_A_105_CM 0. 65535. DISPLAY_IDENTIFIER fm_cal_lbup_shf_h.Cxx_dtc_obd_xxx /end CHARACTERISTIC
/begin CHARACTERISTIC Cxx_conf_wal_lbup_shf_h "" VALUE 0xa002b760 _REC_S1VAL_20_u1 3. _CNV_A_R_A_105_CM 0. 3. DISPLAY_IDENTIFIER fm_cal_lbup_shf_h.fm_static_bitfield.Cxx_conf_wal_xxx BIT_MASK 0x3 /end CHARACTERISTIC
/begin CHARACTERISTIC Cbx_obd_lbup_shf_h "" VALUE 0xa002b760 _REC_S1VAL_20_u1 255. _CNV_A_R_A_105_CM 0. 255. DISPLAY_IDENTIFIER fm_cal_lbup_shf_h.fm_static_bitfield.Cbx_obd_xxx BIT_MASK 0x4 /end CHARACTERISTIC
/begin CHARACTERISTIC Cbx_obd_mena_lbup_shf_h "" VALUE 0xa002b760 _REC_S1VAL_20_u1 255. _CNV_A_R_A_105_CM 0. 255. DISPLAY_IDENTIFIER fm_cal_lbup_shf_h.fm_static_bitfield.Cbx_obd_mena_xxx BIT_MASK 0x8 /end CHARACTERISTIC
/begin CHARACTERISTIC Cxx_dtc_lb_lbup_shf_h "" VALUE 0xa002b761 _REC_S1VAL_20_u1 255. _CNV_A_R_A_105_CM 0. 255. DISPLAY_IDENTIFIER fm_cal_lbup_shf_h.Cxx_dtc_lb_xxx /end CHARACTERISTIC
/begin CHARACTERISTIC Cxx_obd_dc_lbup_shf_h "" VALUE 0xa002b762 _REC_S1VAL_20_u1 9. _CNV_A_R_A_105_CM 1. 10. DISPLAY_IDENTIFIER fm_cal_lbup_shf_h.Cxx_obd_dc_xxx /end CHARACTERISTIC
/begin CHARACTERISTIC Cxx_obd_us_typ_lbup_shf_h "" VALUE 0xa002b763 _REC_S1VAL_20_u1 255. _CNV_A_R_A_105_CM 0. 255. DISPLAY_IDENTIFIER fm_cal_lbup_shf_h.Cxx_obd_us_typ_xxx /end CHARACTERISTIC
/begin CHARACTERISTIC Cxx_dtc_obd_lbup_shf_l "" VALUE 0xa002b76a _REC_S1VAL_20_u2 65535. _CNV_A_R_A_105_CM 0. 65535. DISPLAY_IDENTIFIER fm_cal_lbup_shf_l.Cxx_dtc_obd_xxx /end CHARACTERISTIC
/begin CHARACTERISTIC Cxx_conf_wal_lbup_shf_l "" VALUE 0xa002b76c _REC_S1VAL_20_u1 3. _CNV_A_R_A_105_CM 0. 3. DISPLAY_IDENTIFIER fm_cal_lbup_shf_l.fm_static_bitfield.Cxx_conf_wal_xxx BIT_MASK 0x3 /end CHARACTERISTIC
/begin CHARACTERISTIC Cbx_obd_lbup_shf_l "" VALUE 0xa002b76c _REC_S1VAL_20_u1 255. _CNV_A_R_A_105_CM 0. 255. DISPLAY_IDENTIFIER fm_cal_lbup_shf_l.fm_static_bitfield.Cbx_obd_xxx BIT_MASK 0x4 /end CHARACTERISTIC
/begin CHARACTERISTIC Cbx_obd_mena_lbup_shf_l "" VALUE 0xa002b76c _REC_S1VAL_20_u1 255. _CNV_A_R_A_105_CM 0. 255. DISPLAY_IDENTIFIER fm_cal_lbup_shf_l.fm_static_bitfield.Cbx_obd_mena_xxx BIT_MASK 0x8 /end CHARACTERISTIC
/begin CHARACTERISTIC Cxx_dtc_lb_lbup_shf_l "" VALUE 0xa002b76d _REC_S1VAL_20_u1 255. _CNV_A_R_A_105_CM 0. 255. DISPLAY_IDENTIFIER fm_cal_lbup_shf_l.Cxx_dtc_lb_xxx /end CHARACTERISTIC
/begin CHARACTERISTIC Cxx_obd_dc_lbup_shf_l "" VALUE 0xa002b76e _REC_S1VAL_20_u1 9. _CNV_A_R_A_105_CM 1. 10. DISPLAY_IDENTIFIER fm_cal_lbup_shf_l.Cxx_obd_dc_xxx /end CHARACTERISTIC
/begin CHARACTERISTIC Cxx_obd_us_typ_lbup_shf_l "" VALUE 0xa002b76f _REC_S1VAL_20_u1 255. _CNV_A_R_A_105_CM 0. 255. DISPLAY_IDENTIFIER fm_cal_lbup_shf_l.Cxx_obd_us_typ_xxx /end CHARACTERISTIC
/begin CHARACTERISTIC Cxx_dtc_obd_map_chr "" VALUE 0xa002b272 _REC_S1VAL_20_u2 65535. _CNV_A_R_A_105_CM 0. 65535. DISPLAY_IDENTIFIER fm_cal_map_chr.Cxx_dtc_obd_xxx /end CHARACTERISTIC
/begin CHARACTERISTIC Cxx_conf_wal_map_chr "" VALUE 0xa002b274 _REC_S1VAL_20_u1 3. _CNV_A_R_A_105_CM 0. 3. DISPLAY_IDENTIFIER fm_cal_map_chr.fm_static_bitfield.Cxx_conf_wal_xxx BIT_MASK 0x3 /end CHARACTERISTIC
/begin CHARACTERISTIC Cbx_obd_map_chr "" VALUE 0xa002b274 _REC_S1VAL_20_u1 255. _CNV_A_R_A_105_CM 0. 255. DISPLAY_IDENTIFIER fm_cal_map_chr.fm_static_bitfield.Cbx_obd_xxx BIT_MASK 0x4 /end CHARACTERISTIC
/begin CHARACTERISTIC Cbx_obd_mena_map_chr "" VALUE 0xa002b274 _REC_S1VAL_20_u1 255. _CNV_A_R_A_105_CM 0. 255. DISPLAY_IDENTIFIER fm_cal_map_chr.fm_static_bitfield.Cbx_obd_mena_xxx BIT_MASK 0x8 /end CHARACTERISTIC
/begin CHARACTERISTIC Cxx_dtc_lb_map_chr "" VALUE 0xa002b275 _REC_S1VAL_20_u1 255. _CNV_A_R_A_105_CM 0. 255. DISPLAY_IDENTIFIER fm_cal_map_chr.Cxx_dtc_lb_xxx /end CHARACTERISTIC
/begin CHARACTERISTIC Cxx_obd_dc_map_chr "" VALUE 0xa002b276 _REC_S1VAL_20_u1 9. _CNV_A_R_A_105_CM 1. 10. DISPLAY_IDENTIFIER fm_cal_map_chr.Cxx_obd_dc_xxx /end CHARACTERISTIC
/begin CHARACTERISTIC Cxx_obd_us_typ_map_chr "" VALUE 0xa002b277 _REC_S1VAL_20_u1 255. _CNV_A_R_A_105_CM 0. 255. DISPLAY_IDENTIFIER fm_cal_map_chr.Cxx_obd_us_typ_xxx /end CHARACTERISTIC
/begin CHARACTERISTIC Cxx_dtc_obd_map_oor "" VALUE 0xa002b27e _REC_S1VAL_20_u2 65535. _CNV_A_R_A_105_CM 0. 65535. DISPLAY_IDENTIFIER fm_cal_map_oor.Cxx_dtc_obd_xxx /end CHARACTERISTIC
/begin CHARACTERISTIC Cxx_conf_wal_map_oor "" VALUE 0xa002b280 _REC_S1VAL_20_u1 3. _CNV_A_R_A_105_CM 0. 3. DISPLAY_IDENTIFIER fm_cal_map_oor.fm_static_bitfield.Cxx_conf_wal_xxx BIT_MASK 0x3 /end CHARACTERISTIC
/begin CHARACTERISTIC Cbx_obd_map_oor "" VALUE 0xa002b280 _REC_S1VAL_20_u1 255. _CNV_A_R_A_105_CM 0. 255. DISPLAY_IDENTIFIER fm_cal_map_oor.fm_static_bitfield.Cbx_obd_xxx BIT_MASK 0x4 /end CHARACTERISTIC
/begin CHARACTERISTIC Cbx_obd_mena_map_oor "" VALUE 0xa002b280 _REC_S1VAL_20_u1 255. _CNV_A_R_A_105_CM 0. 255. DISPLAY_IDENTIFIER fm_cal_map_oor.fm_static_bitfield.Cbx_obd_mena_xxx BIT_MASK 0x8 /end CHARACTERISTIC
/begin CHARACTERISTIC Cxx_dtc_lb_map_oor "" VALUE 0xa002b281 _REC_S1VAL_20_u1 255. _CNV_A_R_A_105_CM 0. 255. DISPLAY_IDENTIFIER fm_cal_map_oor.Cxx_dtc_lb_xxx /end CHARACTERISTIC
/begin CHARACTERISTIC Cxx_obd_dc_map_oor "" VALUE 0xa002b282 _REC_S1VAL_20_u1 9. _CNV_A_R_A_105_CM 1. 10. DISPLAY_IDENTIFIER fm_cal_map_oor.Cxx_obd_dc_xxx /end CHARACTERISTIC
/begin CHARACTERISTIC Cxx_obd_us_typ_map_oor "" VALUE 0xa002b283 _REC_S1VAL_20_u1 255. _CNV_A_R_A_105_CM 0. 255. DISPLAY_IDENTIFIER fm_cal_map_oor.Cxx_obd_us_typ_xxx /end CHARACTERISTIC
/begin CHARACTERISTIC Cxx_dtc_obd_mis_1_cata "" VALUE 0xa002b28a _REC_S1VAL_20_u2 65535. _CNV_A_R_A_105_CM 0. 65535. DISPLAY_IDENTIFIER fm_cal_mis_1_cata.Cxx_dtc_obd_xxx /end CHARACTERISTIC
/begin CHARACTERISTIC Cxx_conf_wal_mis_1_cata "" VALUE 0xa002b28c _REC_S1VAL_20_u1 3. _CNV_A_R_A_105_CM 0. 3. DISPLAY_IDENTIFIER fm_cal_mis_1_cata.fm_static_bitfield.Cxx_conf_wal_xxx BIT_MASK 0x3 /end CHARACTERISTIC
/begin CHARACTERISTIC Cbx_obd_mis_1_cata "" VALUE 0xa002b28c _REC_S1VAL_20_u1 255. _CNV_A_R_A_105_CM 0. 255. DISPLAY_IDENTIFIER fm_cal_mis_1_cata.fm_static_bitfield.Cbx_obd_xxx BIT_MASK 0x4 /end CHARACTERISTIC
/begin CHARACTERISTIC Cbx_obd_mena_mis_1_cata "" VALUE 0xa002b28c _REC_S1VAL_20_u1 255. _CNV_A_R_A_105_CM 0. 255. DISPLAY_IDENTIFIER fm_cal_mis_1_cata.fm_static_bitfield.Cbx_obd_mena_xxx BIT_MASK 0x8 /end CHARACTERISTIC
/begin CHARACTERISTIC Cxx_dtc_lb_mis_1_cata "" VALUE 0xa002b28d _REC_S1VAL_20_u1 255. _CNV_A_R_A_105_CM 0. 255. DISPLAY_IDENTIFIER fm_cal_mis_1_cata.Cxx_dtc_lb_xxx /end CHARACTERISTIC
/begin CHARACTERISTIC Cxx_obd_dc_mis_1_cata "" VALUE 0xa002b28e _REC_S1VAL_20_u1 9. _CNV_A_R_A_105_CM 1. 10. DISPLAY_IDENTIFIER fm_cal_mis_1_cata.Cxx_obd_dc_xxx /end CHARACTERISTIC
/begin CHARACTERISTIC Cxx_obd_us_typ_mis_1_cata "" VALUE 0xa002b28f _REC_S1VAL_20_u1 255. _CNV_A_R_A_105_CM 0. 255. DISPLAY_IDENTIFIER fm_cal_mis_1_cata.Cxx_obd_us_typ_xxx /end CHARACTERISTIC
/begin CHARACTERISTIC Cxx_dtc_obd_mis_1_lpg_cata "" VALUE 0xa002b296 _REC_S1VAL_20_u2 65535. _CNV_A_R_A_105_CM 0. 65535. DISPLAY_IDENTIFIER fm_cal_mis_1_lpg_cata.Cxx_dtc_obd_xxx /end CHARACTERISTIC
/begin CHARACTERISTIC Cxx_conf_wal_mis_1_lpg_cata "" VALUE 0xa002b298 _REC_S1VAL_20_u1 3. _CNV_A_R_A_105_CM 0. 3. DISPLAY_IDENTIFIER fm_cal_mis_1_lpg_cata.fm_static_bitfield.Cxx_conf_wal_xxx BIT_MASK 0x3 /end CHARACTERISTIC
/begin CHARACTERISTIC Cbx_obd_mis_1_lpg_cata "" VALUE 0xa002b298 _REC_S1VAL_20_u1 255. _CNV_A_R_A_105_CM 0. 255. DISPLAY_IDENTIFIER fm_cal_mis_1_lpg_cata.fm_static_bitfield.Cbx_obd_xxx BIT_MASK 0x4 /end CHARACTERISTIC
/begin CHARACTERISTIC Cbx_obd_mena_mis_1_lpg_cata "" VALUE 0xa002b298 _REC_S1VAL_20_u1 255. _CNV_A_R_A_105_CM 0. 255. DISPLAY_IDENTIFIER fm_cal_mis_1_lpg_cata.fm_static_bitfield.Cbx_obd_mena_xxx BIT_MASK 0x8 /end CHARACTERISTIC
/begin CHARACTERISTIC Cxx_dtc_lb_mis_1_lpg_cata "" VALUE 0xa002b299 _REC_S1VAL_20_u1 255. _CNV_A_R_A_105_CM 0. 255. DISPLAY_IDENTIFIER fm_cal_mis_1_lpg_cata.Cxx_dtc_lb_xxx /end CHARACTERISTIC
/begin CHARACTERISTIC Cxx_obd_dc_mis_1_lpg_cata "" VALUE 0xa002b29a _REC_S1VAL_20_u1 9. _CNV_A_R_A_105_CM 1. 10. DISPLAY_IDENTIFIER fm_cal_mis_1_lpg_cata.Cxx_obd_dc_xxx /end CHARACTERISTIC
/begin CHARACTERISTIC Cxx_obd_us_typ_mis_1_lpg_cata "" VALUE 0xa002b29b _REC_S1VAL_20_u1 255. _CNV_A_R_A_105_CM 0. 255. DISPLAY_IDENTIFIER fm_cal_mis_1_lpg_cata.Cxx_obd_us_typ_xxx /end CHARACTERISTIC
/begin CHARACTERISTIC Cxx_dtc_obd_mis_1_lpg_trs_h "" VALUE 0xa002b2a2 _REC_S1VAL_20_u2 65535. _CNV_A_R_A_105_CM 0. 65535. DISPLAY_IDENTIFIER fm_cal_mis_1_lpg_trs_h.Cxx_dtc_obd_xxx /end CHARACTERISTIC
/begin CHARACTERISTIC Cxx_conf_wal_mis_1_lpg_trs_h "" VALUE 0xa002b2a4 _REC_S1VAL_20_u1 3. _CNV_A_R_A_105_CM 0. 3. DISPLAY_IDENTIFIER fm_cal_mis_1_lpg_trs_h.fm_static_bitfield.Cxx_conf_wal_xxx BIT_MASK 0x3 /end CHARACTERISTIC
/begin CHARACTERISTIC Cbx_obd_mis_1_lpg_trs_h "" VALUE 0xa002b2a4 _REC_S1VAL_20_u1 255. _CNV_A_R_A_105_CM 0. 255. DISPLAY_IDENTIFIER fm_cal_mis_1_lpg_trs_h.fm_static_bitfield.Cbx_obd_xxx BIT_MASK 0x4 /end CHARACTERISTIC
/begin CHARACTERISTIC Cbx_obd_mena_mis_1_lpg_trs_h "" VALUE 0xa002b2a4 _REC_S1VAL_20_u1 255. _CNV_A_R_A_105_CM 0. 255. DISPLAY_IDENTIFIER fm_cal_mis_1_lpg_trs_h.fm_static_bitfield.Cbx_obd_mena_xxx BIT_MASK 0x8 /end CHARACTERISTIC
/begin CHARACTERISTIC Cxx_dtc_lb_mis_1_lpg_trs_h "" VALUE 0xa002b2a5 _REC_S1VAL_20_u1 255. _CNV_A_R_A_105_CM 0. 255. DISPLAY_IDENTIFIER fm_cal_mis_1_lpg_trs_h.Cxx_dtc_lb_xxx /end CHARACTERISTIC
/begin CHARACTERISTIC Cxx_obd_dc_mis_1_lpg_trs_h "" VALUE 0xa002b2a6 _REC_S1VAL_20_u1 9. _CNV_A_R_A_105_CM 1. 10. DISPLAY_IDENTIFIER fm_cal_mis_1_lpg_trs_h.Cxx_obd_dc_xxx /end CHARACTERISTIC
/begin CHARACTERISTIC Cxx_obd_us_typ_mis_1_lpg_trs_h "" VALUE 0xa002b2a7 _REC_S1VAL_20_u1 255. _CNV_A_R_A_105_CM 0. 255. DISPLAY_IDENTIFIER fm_cal_mis_1_lpg_trs_h.Cxx_obd_us_typ_xxx /end CHARACTERISTIC
/begin CHARACTERISTIC Cxx_dtc_obd_mis_1_trs_h "" VALUE 0xa002b2ae _REC_S1VAL_20_u2 65535. _CNV_A_R_A_105_CM 0. 65535. DISPLAY_IDENTIFIER fm_cal_mis_1_trs_h.Cxx_dtc_obd_xxx /end CHARACTERISTIC
/begin CHARACTERISTIC Cxx_conf_wal_mis_1_trs_h "" VALUE 0xa002b2b0 _REC_S1VAL_20_u1 3. _CNV_A_R_A_105_CM 0. 3. DISPLAY_IDENTIFIER fm_cal_mis_1_trs_h.fm_static_bitfield.Cxx_conf_wal_xxx BIT_MASK 0x3 /end CHARACTERISTIC
/begin CHARACTERISTIC Cbx_obd_mis_1_trs_h "" VALUE 0xa002b2b0 _REC_S1VAL_20_u1 255. _CNV_A_R_A_105_CM 0. 255. DISPLAY_IDENTIFIER fm_cal_mis_1_trs_h.fm_static_bitfield.Cbx_obd_xxx BIT_MASK 0x4 /end CHARACTERISTIC
/begin CHARACTERISTIC Cbx_obd_mena_mis_1_trs_h "" VALUE 0xa002b2b0 _REC_S1VAL_20_u1 255. _CNV_A_R_A_105_CM 0. 255. DISPLAY_IDENTIFIER fm_cal_mis_1_trs_h.fm_static_bitfield.Cbx_obd_mena_xxx BIT_MASK 0x8 /end CHARACTERISTIC
/begin CHARACTERISTIC Cxx_dtc_lb_mis_1_trs_h "" VALUE 0xa002b2b1 _REC_S1VAL_20_u1 255. _CNV_A_R_A_105_CM 0. 255. DISPLAY_IDENTIFIER fm_cal_mis_1_trs_h.Cxx_dtc_lb_xxx /end CHARACTERISTIC
/begin CHARACTERISTIC Cxx_obd_dc_mis_1_trs_h "" VALUE 0xa002b2b2 _REC_S1VAL_20_u1 9. _CNV_A_R_A_105_CM 1. 10. DISPLAY_IDENTIFIER fm_cal_mis_1_trs_h.Cxx_obd_dc_xxx /end CHARACTERISTIC
/begin CHARACTERISTIC Cxx_obd_us_typ_mis_1_trs_h "" VALUE 0xa002b2b3 _REC_S1VAL_20_u1 255. _CNV_A_R_A_105_CM 0. 255. DISPLAY_IDENTIFIER fm_cal_mis_1_trs_h.Cxx_obd_us_typ_xxx /end CHARACTERISTIC
/begin CHARACTERISTIC Cxx_dtc_obd_mis_2_cata "" VALUE 0xa002b2ba _REC_S1VAL_20_u2 65535. _CNV_A_R_A_105_CM 0. 65535. DISPLAY_IDENTIFIER fm_cal_mis_2_cata.Cxx_dtc_obd_xxx /end CHARACTERISTIC
/begin CHARACTERISTIC Cxx_conf_wal_mis_2_cata "" VALUE 0xa002b2bc _REC_S1VAL_20_u1 3. _CNV_A_R_A_105_CM 0. 3. DISPLAY_IDENTIFIER fm_cal_mis_2_cata.fm_static_bitfield.Cxx_conf_wal_xxx BIT_MASK 0x3 /end CHARACTERISTIC
/begin CHARACTERISTIC Cbx_obd_mis_2_cata "" VALUE 0xa002b2bc _REC_S1VAL_20_u1 255. _CNV_A_R_A_105_CM 0. 255. DISPLAY_IDENTIFIER fm_cal_mis_2_cata.fm_static_bitfield.Cbx_obd_xxx BIT_MASK 0x4 /end CHARACTERISTIC
/begin CHARACTERISTIC Cbx_obd_mena_mis_2_cata "" VALUE 0xa002b2bc _REC_S1VAL_20_u1 255. _CNV_A_R_A_105_CM 0. 255. DISPLAY_IDENTIFIER fm_cal_mis_2_cata.fm_static_bitfield.Cbx_obd_mena_xxx BIT_MASK 0x8 /end CHARACTERISTIC
/begin CHARACTERISTIC Cxx_dtc_lb_mis_2_cata "" VALUE 0xa002b2bd _REC_S1VAL_20_u1 255. _CNV_A_R_A_105_CM 0. 255. DISPLAY_IDENTIFIER fm_cal_mis_2_cata.Cxx_dtc_lb_xxx /end CHARACTERISTIC
/begin CHARACTERISTIC Cxx_obd_dc_mis_2_cata "" VALUE 0xa002b2be _REC_S1VAL_20_u1 9. _CNV_A_R_A_105_CM 1. 10. DISPLAY_IDENTIFIER fm_cal_mis_2_cata.Cxx_obd_dc_xxx /end CHARACTERISTIC
/begin CHARACTERISTIC Cxx_obd_us_typ_mis_2_cata "" VALUE 0xa002b2bf _REC_S1VAL_20_u1 255. _CNV_A_R_A_105_CM 0. 255. DISPLAY_IDENTIFIER fm_cal_mis_2_cata.Cxx_obd_us_typ_xxx /end CHARACTERISTIC
/begin CHARACTERISTIC Cxx_dtc_obd_mis_2_lpg_cata "" VALUE 0xa002b2c6 _REC_S1VAL_20_u2 65535. _CNV_A_R_A_105_CM 0. 65535. DISPLAY_IDENTIFIER fm_cal_mis_2_lpg_cata.Cxx_dtc_obd_xxx /end CHARACTERISTIC
/begin CHARACTERISTIC Cxx_conf_wal_mis_2_lpg_cata "" VALUE 0xa002b2c8 _REC_S1VAL_20_u1 3. _CNV_A_R_A_105_CM 0. 3. DISPLAY_IDENTIFIER fm_cal_mis_2_lpg_cata.fm_static_bitfield.Cxx_conf_wal_xxx BIT_MASK 0x3 /end CHARACTERISTIC
/begin CHARACTERISTIC Cbx_obd_mis_2_lpg_cata "" VALUE 0xa002b2c8 _REC_S1VAL_20_u1 255. _CNV_A_R_A_105_CM 0. 255. DISPLAY_IDENTIFIER fm_cal_mis_2_lpg_cata.fm_static_bitfield.Cbx_obd_xxx BIT_MASK 0x4 /end CHARACTERISTIC
/begin CHARACTERISTIC Cbx_obd_mena_mis_2_lpg_cata "" VALUE 0xa002b2c8 _REC_S1VAL_20_u1 255. _CNV_A_R_A_105_CM 0. 255. DISPLAY_IDENTIFIER fm_cal_mis_2_lpg_cata.fm_static_bitfield.Cbx_obd_mena_xxx BIT_MASK 0x8 /end CHARACTERISTIC
/begin CHARACTERISTIC Cxx_dtc_lb_mis_2_lpg_cata "" VALUE 0xa002b2c9 _REC_S1VAL_20_u1 255. _CNV_A_R_A_105_CM 0. 255. DISPLAY_IDENTIFIER fm_cal_mis_2_lpg_cata.Cxx_dtc_lb_xxx /end CHARACTERISTIC
/begin CHARACTERISTIC Cxx_obd_dc_mis_2_lpg_cata "" VALUE 0xa002b2ca _REC_S1VAL_20_u1 9. _CNV_A_R_A_105_CM 1. 10. DISPLAY_IDENTIFIER fm_cal_mis_2_lpg_cata.Cxx_obd_dc_xxx /end CHARACTERISTIC
/begin CHARACTERISTIC Cxx_obd_us_typ_mis_2_lpg_cata "" VALUE 0xa002b2cb _REC_S1VAL_20_u1 255. _CNV_A_R_A_105_CM 0. 255. DISPLAY_IDENTIFIER fm_cal_mis_2_lpg_cata.Cxx_obd_us_typ_xxx /end CHARACTERISTIC
/begin CHARACTERISTIC Cxx_dtc_obd_mis_2_lpg_trs_h "" VALUE 0xa002b2d2 _REC_S1VAL_20_u2 65535. _CNV_A_R_A_105_CM 0. 65535. DISPLAY_IDENTIFIER fm_cal_mis_2_lpg_trs_h.Cxx_dtc_obd_xxx /end CHARACTERISTIC
/begin CHARACTERISTIC Cxx_conf_wal_mis_2_lpg_trs_h "" VALUE 0xa002b2d4 _REC_S1VAL_20_u1 3. _CNV_A_R_A_105_CM 0. 3. DISPLAY_IDENTIFIER fm_cal_mis_2_lpg_trs_h.fm_static_bitfield.Cxx_conf_wal_xxx BIT_MASK 0x3 /end CHARACTERISTIC
/begin CHARACTERISTIC Cbx_obd_mis_2_lpg_trs_h "" VALUE 0xa002b2d4 _REC_S1VAL_20_u1 255. _CNV_A_R_A_105_CM 0. 255. DISPLAY_IDENTIFIER fm_cal_mis_2_lpg_trs_h.fm_static_bitfield.Cbx_obd_xxx BIT_MASK 0x4 /end CHARACTERISTIC
/begin CHARACTERISTIC Cbx_obd_mena_mis_2_lpg_trs_h "" VALUE 0xa002b2d4 _REC_S1VAL_20_u1 255. _CNV_A_R_A_105_CM 0. 255. DISPLAY_IDENTIFIER fm_cal_mis_2_lpg_trs_h.fm_static_bitfield.Cbx_obd_mena_xxx BIT_MASK 0x8 /end CHARACTERISTIC
/begin CHARACTERISTIC Cxx_dtc_lb_mis_2_lpg_trs_h "" VALUE 0xa002b2d5 _REC_S1VAL_20_u1 255. _CNV_A_R_A_105_CM 0. 255. DISPLAY_IDENTIFIER fm_cal_mis_2_lpg_trs_h.Cxx_dtc_lb_xxx /end CHARACTERISTIC
/begin CHARACTERISTIC Cxx_obd_dc_mis_2_lpg_trs_h "" VALUE 0xa002b2d6 _REC_S1VAL_20_u1 9. _CNV_A_R_A_105_CM 1. 10. DISPLAY_IDENTIFIER fm_cal_mis_2_lpg_trs_h.Cxx_obd_dc_xxx /end CHARACTERISTIC
/begin CHARACTERISTIC Cxx_obd_us_typ_mis_2_lpg_trs_h "" VALUE 0xa002b2d7 _REC_S1VAL_20_u1 255. _CNV_A_R_A_105_CM 0. 255. DISPLAY_IDENTIFIER fm_cal_mis_2_lpg_trs_h.Cxx_obd_us_typ_xxx /end CHARACTERISTIC
/begin CHARACTERISTIC Cxx_dtc_obd_mis_2_trs_h "" VALUE 0xa002b2de _REC_S1VAL_20_u2 65535. _CNV_A_R_A_105_CM 0. 65535. DISPLAY_IDENTIFIER fm_cal_mis_2_trs_h.Cxx_dtc_obd_xxx /end CHARACTERISTIC
/begin CHARACTERISTIC Cxx_conf_wal_mis_2_trs_h "" VALUE 0xa002b2e0 _REC_S1VAL_20_u1 3. _CNV_A_R_A_105_CM 0. 3. DISPLAY_IDENTIFIER fm_cal_mis_2_trs_h.fm_static_bitfield.Cxx_conf_wal_xxx BIT_MASK 0x3 /end CHARACTERISTIC
/begin CHARACTERISTIC Cbx_obd_mis_2_trs_h "" VALUE 0xa002b2e0 _REC_S1VAL_20_u1 255. _CNV_A_R_A_105_CM 0. 255. DISPLAY_IDENTIFIER fm_cal_mis_2_trs_h.fm_static_bitfield.Cbx_obd_xxx BIT_MASK 0x4 /end CHARACTERISTIC
/begin CHARACTERISTIC Cbx_obd_mena_mis_2_trs_h "" VALUE 0xa002b2e0 _REC_S1VAL_20_u1 255. _CNV_A_R_A_105_CM 0. 255. DISPLAY_IDENTIFIER fm_cal_mis_2_trs_h.fm_static_bitfield.Cbx_obd_mena_xxx BIT_MASK 0x8 /end CHARACTERISTIC
/begin CHARACTERISTIC Cxx_dtc_lb_mis_2_trs_h "" VALUE 0xa002b2e1 _REC_S1VAL_20_u1 255. _CNV_A_R_A_105_CM 0. 255. DISPLAY_IDENTIFIER fm_cal_mis_2_trs_h.Cxx_dtc_lb_xxx /end CHARACTERISTIC
/begin CHARACTERISTIC Cxx_obd_dc_mis_2_trs_h "" VALUE 0xa002b2e2 _REC_S1VAL_20_u1 9. _CNV_A_R_A_105_CM 1. 10. DISPLAY_IDENTIFIER fm_cal_mis_2_trs_h.Cxx_obd_dc_xxx /end CHARACTERISTIC
/begin CHARACTERISTIC Cxx_obd_us_typ_mis_2_trs_h "" VALUE 0xa002b2e3 _REC_S1VAL_20_u1 255. _CNV_A_R_A_105_CM 0. 255. DISPLAY_IDENTIFIER fm_cal_mis_2_trs_h.Cxx_obd_us_typ_xxx /end CHARACTERISTIC
/begin CHARACTERISTIC Cxx_dtc_obd_mis_3_cata "" VALUE 0xa002b2ea _REC_S1VAL_20_u2 65535. _CNV_A_R_A_105_CM 0. 65535. DISPLAY_IDENTIFIER fm_cal_mis_3_cata.Cxx_dtc_obd_xxx /end CHARACTERISTIC
/begin CHARACTERISTIC Cxx_conf_wal_mis_3_cata "" VALUE 0xa002b2ec _REC_S1VAL_20_u1 3. _CNV_A_R_A_105_CM 0. 3. DISPLAY_IDENTIFIER fm_cal_mis_3_cata.fm_static_bitfield.Cxx_conf_wal_xxx BIT_MASK 0x3 /end CHARACTERISTIC
/begin CHARACTERISTIC Cbx_obd_mis_3_cata "" VALUE 0xa002b2ec _REC_S1VAL_20_u1 255. _CNV_A_R_A_105_CM 0. 255. DISPLAY_IDENTIFIER fm_cal_mis_3_cata.fm_static_bitfield.Cbx_obd_xxx BIT_MASK 0x4 /end CHARACTERISTIC
/begin CHARACTERISTIC Cbx_obd_mena_mis_3_cata "" VALUE 0xa002b2ec _REC_S1VAL_20_u1 255. _CNV_A_R_A_105_CM 0. 255. DISPLAY_IDENTIFIER fm_cal_mis_3_cata.fm_static_bitfield.Cbx_obd_mena_xxx BIT_MASK 0x8 /end CHARACTERISTIC
/begin CHARACTERISTIC Cxx_dtc_lb_mis_3_cata "" VALUE 0xa002b2ed _REC_S1VAL_20_u1 255. _CNV_A_R_A_105_CM 0. 255. DISPLAY_IDENTIFIER fm_cal_mis_3_cata.Cxx_dtc_lb_xxx /end CHARACTERISTIC
/begin CHARACTERISTIC Cxx_obd_dc_mis_3_cata "" VALUE 0xa002b2ee _REC_S1VAL_20_u1 9. _CNV_A_R_A_105_CM 1. 10. DISPLAY_IDENTIFIER fm_cal_mis_3_cata.Cxx_obd_dc_xxx /end CHARACTERISTIC
/begin CHARACTERISTIC Cxx_obd_us_typ_mis_3_cata "" VALUE 0xa002b2ef _REC_S1VAL_20_u1 255. _CNV_A_R_A_105_CM 0. 255. DISPLAY_IDENTIFIER fm_cal_mis_3_cata.Cxx_obd_us_typ_xxx /end CHARACTERISTIC
/begin CHARACTERISTIC Cxx_dtc_obd_mis_3_lpg_cata "" VALUE 0xa002b2f6 _REC_S1VAL_20_u2 65535. _CNV_A_R_A_105_CM 0. 65535. DISPLAY_IDENTIFIER fm_cal_mis_3_lpg_cata.Cxx_dtc_obd_xxx /end CHARACTERISTIC
/begin CHARACTERISTIC Cxx_conf_wal_mis_3_lpg_cata "" VALUE 0xa002b2f8 _REC_S1VAL_20_u1 3. _CNV_A_R_A_105_CM 0. 3. DISPLAY_IDENTIFIER fm_cal_mis_3_lpg_cata.fm_static_bitfield.Cxx_conf_wal_xxx BIT_MASK 0x3 /end CHARACTERISTIC
/begin CHARACTERISTIC Cbx_obd_mis_3_lpg_cata "" VALUE 0xa002b2f8 _REC_S1VAL_20_u1 255. _CNV_A_R_A_105_CM 0. 255. DISPLAY_IDENTIFIER fm_cal_mis_3_lpg_cata.fm_static_bitfield.Cbx_obd_xxx BIT_MASK 0x4 /end CHARACTERISTIC
/begin CHARACTERISTIC Cbx_obd_mena_mis_3_lpg_cata "" VALUE 0xa002b2f8 _REC_S1VAL_20_u1 255. _CNV_A_R_A_105_CM 0. 255. DISPLAY_IDENTIFIER fm_cal_mis_3_lpg_cata.fm_static_bitfield.Cbx_obd_mena_xxx BIT_MASK 0x8 /end CHARACTERISTIC
/begin CHARACTERISTIC Cxx_dtc_lb_mis_3_lpg_cata "" VALUE 0xa002b2f9 _REC_S1VAL_20_u1 255. _CNV_A_R_A_105_CM 0. 255. DISPLAY_IDENTIFIER fm_cal_mis_3_lpg_cata.Cxx_dtc_lb_xxx /end CHARACTERISTIC
/begin CHARACTERISTIC Cxx_obd_dc_mis_3_lpg_cata "" VALUE 0xa002b2fa _REC_S1VAL_20_u1 9. _CNV_A_R_A_105_CM 1. 10. DISPLAY_IDENTIFIER fm_cal_mis_3_lpg_cata.Cxx_obd_dc_xxx /end CHARACTERISTIC
/begin CHARACTERISTIC Cxx_obd_us_typ_mis_3_lpg_cata "" VALUE 0xa002b2fb _REC_S1VAL_20_u1 255. _CNV_A_R_A_105_CM 0. 255. DISPLAY_IDENTIFIER fm_cal_mis_3_lpg_cata.Cxx_obd_us_typ_xxx /end CHARACTERISTIC
/begin CHARACTERISTIC Cxx_dtc_obd_mis_3_lpg_trs_h "" VALUE 0xa002b302 _REC_S1VAL_20_u2 65535. _CNV_A_R_A_105_CM 0. 65535. DISPLAY_IDENTIFIER fm_cal_mis_3_lpg_trs_h.Cxx_dtc_obd_xxx /end CHARACTERISTIC
/begin CHARACTERISTIC Cxx_conf_wal_mis_3_lpg_trs_h "" VALUE 0xa002b304 _REC_S1VAL_20_u1 3. _CNV_A_R_A_105_CM 0. 3. DISPLAY_IDENTIFIER fm_cal_mis_3_lpg_trs_h.fm_static_bitfield.Cxx_conf_wal_xxx BIT_MASK 0x3 /end CHARACTERISTIC
/begin CHARACTERISTIC Cbx_obd_mis_3_lpg_trs_h "" VALUE 0xa002b304 _REC_S1VAL_20_u1 255. _CNV_A_R_A_105_CM 0. 255. DISPLAY_IDENTIFIER fm_cal_mis_3_lpg_trs_h.fm_static_bitfield.Cbx_obd_xxx BIT_MASK 0x4 /end CHARACTERISTIC
/begin CHARACTERISTIC Cbx_obd_mena_mis_3_lpg_trs_h "" VALUE 0xa002b304 _REC_S1VAL_20_u1 255. _CNV_A_R_A_105_CM 0. 255. DISPLAY_IDENTIFIER fm_cal_mis_3_lpg_trs_h.fm_static_bitfield.Cbx_obd_mena_xxx BIT_MASK 0x8 /end CHARACTERISTIC
/begin CHARACTERISTIC Cxx_dtc_lb_mis_3_lpg_trs_h "" VALUE 0xa002b305 _REC_S1VAL_20_u1 255. _CNV_A_R_A_105_CM 0. 255. DISPLAY_IDENTIFIER fm_cal_mis_3_lpg_trs_h.Cxx_dtc_lb_xxx /end CHARACTERISTIC
/begin CHARACTERISTIC Cxx_obd_dc_mis_3_lpg_trs_h "" VALUE 0xa002b306 _REC_S1VAL_20_u1 9. _CNV_A_R_A_105_CM 1. 10. DISPLAY_IDENTIFIER fm_cal_mis_3_lpg_trs_h.Cxx_obd_dc_xxx /end CHARACTERISTIC
/begin CHARACTERISTIC Cxx_obd_us_typ_mis_3_lpg_trs_h "" VALUE 0xa002b307 _REC_S1VAL_20_u1 255. _CNV_A_R_A_105_CM 0. 255. DISPLAY_IDENTIFIER fm_cal_mis_3_lpg_trs_h.Cxx_obd_us_typ_xxx /end CHARACTERISTIC
/begin CHARACTERISTIC Cxx_dtc_obd_mis_3_trs_h "" VALUE 0xa002b30e _REC_S1VAL_20_u2 65535. _CNV_A_R_A_105_CM 0. 65535. DISPLAY_IDENTIFIER fm_cal_mis_3_trs_h.Cxx_dtc_obd_xxx /end CHARACTERISTIC
/begin CHARACTERISTIC Cxx_conf_wal_mis_3_trs_h "" VALUE 0xa002b310 _REC_S1VAL_20_u1 3. _CNV_A_R_A_105_CM 0. 3. DISPLAY_IDENTIFIER fm_cal_mis_3_trs_h.fm_static_bitfield.Cxx_conf_wal_xxx BIT_MASK 0x3 /end CHARACTERISTIC
/begin CHARACTERISTIC Cbx_obd_mis_3_trs_h "" VALUE 0xa002b310 _REC_S1VAL_20_u1 255. _CNV_A_R_A_105_CM 0. 255. DISPLAY_IDENTIFIER fm_cal_mis_3_trs_h.fm_static_bitfield.Cbx_obd_xxx BIT_MASK 0x4 /end CHARACTERISTIC
/begin CHARACTERISTIC Cbx_obd_mena_mis_3_trs_h "" VALUE 0xa002b310 _REC_S1VAL_20_u1 255. _CNV_A_R_A_105_CM 0. 255. DISPLAY_IDENTIFIER fm_cal_mis_3_trs_h.fm_static_bitfield.Cbx_obd_mena_xxx BIT_MASK 0x8 /end CHARACTERISTIC
/begin CHARACTERISTIC Cxx_dtc_lb_mis_3_trs_h "" VALUE 0xa002b311 _REC_S1VAL_20_u1 255. _CNV_A_R_A_105_CM 0. 255. DISPLAY_IDENTIFIER fm_cal_mis_3_trs_h.Cxx_dtc_lb_xxx /end CHARACTERISTIC
/begin CHARACTERISTIC Cxx_obd_dc_mis_3_trs_h "" VALUE 0xa002b312 _REC_S1VAL_20_u1 9. _CNV_A_R_A_105_CM 1. 10. DISPLAY_IDENTIFIER fm_cal_mis_3_trs_h.Cxx_obd_dc_xxx /end CHARACTERISTIC
/begin CHARACTERISTIC Cxx_obd_us_typ_mis_3_trs_h "" VALUE 0xa002b313 _REC_S1VAL_20_u1 255. _CNV_A_R_A_105_CM 0. 255. DISPLAY_IDENTIFIER fm_cal_mis_3_trs_h.Cxx_obd_us_typ_xxx /end CHARACTERISTIC
/begin CHARACTERISTIC Cxx_dtc_obd_mis_4_cata "" VALUE 0xa002b31a _REC_S1VAL_20_u2 65535. _CNV_A_R_A_105_CM 0. 65535. DISPLAY_IDENTIFIER fm_cal_mis_4_cata.Cxx_dtc_obd_xxx /end CHARACTERISTIC
/begin CHARACTERISTIC Cxx_conf_wal_mis_4_cata "" VALUE 0xa002b31c _REC_S1VAL_20_u1 3. _CNV_A_R_A_105_CM 0. 3. DISPLAY_IDENTIFIER fm_cal_mis_4_cata.fm_static_bitfield.Cxx_conf_wal_xxx BIT_MASK 0x3 /end CHARACTERISTIC
/begin CHARACTERISTIC Cbx_obd_mis_4_cata "" VALUE 0xa002b31c _REC_S1VAL_20_u1 255. _CNV_A_R_A_105_CM 0. 255. DISPLAY_IDENTIFIER fm_cal_mis_4_cata.fm_static_bitfield.Cbx_obd_xxx BIT_MASK 0x4 /end CHARACTERISTIC
/begin CHARACTERISTIC Cbx_obd_mena_mis_4_cata "" VALUE 0xa002b31c _REC_S1VAL_20_u1 255. _CNV_A_R_A_105_CM 0. 255. DISPLAY_IDENTIFIER fm_cal_mis_4_cata.fm_static_bitfield.Cbx_obd_mena_xxx BIT_MASK 0x8 /end CHARACTERISTIC
/begin CHARACTERISTIC Cxx_dtc_lb_mis_4_cata "" VALUE 0xa002b31d _REC_S1VAL_20_u1 255. _CNV_A_R_A_105_CM 0. 255. DISPLAY_IDENTIFIER fm_cal_mis_4_cata.Cxx_dtc_lb_xxx /end CHARACTERISTIC
/begin CHARACTERISTIC Cxx_obd_dc_mis_4_cata "" VALUE 0xa002b31e _REC_S1VAL_20_u1 9. _CNV_A_R_A_105_CM 1. 10. DISPLAY_IDENTIFIER fm_cal_mis_4_cata.Cxx_obd_dc_xxx /end CHARACTERISTIC
/begin CHARACTERISTIC Cxx_obd_us_typ_mis_4_cata "" VALUE 0xa002b31f _REC_S1VAL_20_u1 255. _CNV_A_R_A_105_CM 0. 255. DISPLAY_IDENTIFIER fm_cal_mis_4_cata.Cxx_obd_us_typ_xxx /end CHARACTERISTIC
/begin CHARACTERISTIC Cxx_dtc_obd_mis_4_lpg_cata "" VALUE 0xa002b326 _REC_S1VAL_20_u2 65535. _CNV_A_R_A_105_CM 0. 65535. DISPLAY_IDENTIFIER fm_cal_mis_4_lpg_cata.Cxx_dtc_obd_xxx /end CHARACTERISTIC
/begin CHARACTERISTIC Cxx_conf_wal_mis_4_lpg_cata "" VALUE 0xa002b328 _REC_S1VAL_20_u1 3. _CNV_A_R_A_105_CM 0. 3. DISPLAY_IDENTIFIER fm_cal_mis_4_lpg_cata.fm_static_bitfield.Cxx_conf_wal_xxx BIT_MASK 0x3 /end CHARACTERISTIC
/begin CHARACTERISTIC Cbx_obd_mis_4_lpg_cata "" VALUE 0xa002b328 _REC_S1VAL_20_u1 255. _CNV_A_R_A_105_CM 0. 255. DISPLAY_IDENTIFIER fm_cal_mis_4_lpg_cata.fm_static_bitfield.Cbx_obd_xxx BIT_MASK 0x4 /end CHARACTERISTIC
/begin CHARACTERISTIC Cbx_obd_mena_mis_4_lpg_cata "" VALUE 0xa002b328 _REC_S1VAL_20_u1 255. _CNV_A_R_A_105_CM 0. 255. DISPLAY_IDENTIFIER fm_cal_mis_4_lpg_cata.fm_static_bitfield.Cbx_obd_mena_xxx BIT_MASK 0x8 /end CHARACTERISTIC
/begin CHARACTERISTIC Cxx_dtc_lb_mis_4_lpg_cata "" VALUE 0xa002b329 _REC_S1VAL_20_u1 255. _CNV_A_R_A_105_CM 0. 255. DISPLAY_IDENTIFIER fm_cal_mis_4_lpg_cata.Cxx_dtc_lb_xxx /end CHARACTERISTIC
/begin CHARACTERISTIC Cxx_obd_dc_mis_4_lpg_cata "" VALUE 0xa002b32a _REC_S1VAL_20_u1 9. _CNV_A_R_A_105_CM 1. 10. DISPLAY_IDENTIFIER fm_cal_mis_4_lpg_cata.Cxx_obd_dc_xxx /end CHARACTERISTIC
/begin CHARACTERISTIC Cxx_obd_us_typ_mis_4_lpg_cata "" VALUE 0xa002b32b _REC_S1VAL_20_u1 255. _CNV_A_R_A_105_CM 0. 255. DISPLAY_IDENTIFIER fm_cal_mis_4_lpg_cata.Cxx_obd_us_typ_xxx /end CHARACTERISTIC
/begin CHARACTERISTIC Cxx_dtc_obd_mis_4_lpg_trs_h "" VALUE 0xa002b332 _REC_S1VAL_20_u2 65535. _CNV_A_R_A_105_CM 0. 65535. DISPLAY_IDENTIFIER fm_cal_mis_4_lpg_trs_h.Cxx_dtc_obd_xxx /end CHARACTERISTIC
/begin CHARACTERISTIC Cxx_conf_wal_mis_4_lpg_trs_h "" VALUE 0xa002b334 _REC_S1VAL_20_u1 3. _CNV_A_R_A_105_CM 0. 3. DISPLAY_IDENTIFIER fm_cal_mis_4_lpg_trs_h.fm_static_bitfield.Cxx_conf_wal_xxx BIT_MASK 0x3 /end CHARACTERISTIC
/begin CHARACTERISTIC Cbx_obd_mis_4_lpg_trs_h "" VALUE 0xa002b334 _REC_S1VAL_20_u1 255. _CNV_A_R_A_105_CM 0. 255. DISPLAY_IDENTIFIER fm_cal_mis_4_lpg_trs_h.fm_static_bitfield.Cbx_obd_xxx BIT_MASK 0x4 /end CHARACTERISTIC
/begin CHARACTERISTIC Cbx_obd_mena_mis_4_lpg_trs_h "" VALUE 0xa002b334 _REC_S1VAL_20_u1 255. _CNV_A_R_A_105_CM 0. 255. DISPLAY_IDENTIFIER fm_cal_mis_4_lpg_trs_h.fm_static_bitfield.Cbx_obd_mena_xxx BIT_MASK 0x8 /end CHARACTERISTIC
/begin CHARACTERISTIC Cxx_dtc_lb_mis_4_lpg_trs_h "" VALUE 0xa002b335 _REC_S1VAL_20_u1 255. _CNV_A_R_A_105_CM 0. 255. DISPLAY_IDENTIFIER fm_cal_mis_4_lpg_trs_h.Cxx_dtc_lb_xxx /end CHARACTERISTIC
/begin CHARACTERISTIC Cxx_obd_dc_mis_4_lpg_trs_h "" VALUE 0xa002b336 _REC_S1VAL_20_u1 9. _CNV_A_R_A_105_CM 1. 10. DISPLAY_IDENTIFIER fm_cal_mis_4_lpg_trs_h.Cxx_obd_dc_xxx /end CHARACTERISTIC
/begin CHARACTERISTIC Cxx_obd_us_typ_mis_4_lpg_trs_h "" VALUE 0xa002b337 _REC_S1VAL_20_u1 255. _CNV_A_R_A_105_CM 0. 255. DISPLAY_IDENTIFIER fm_cal_mis_4_lpg_trs_h.Cxx_obd_us_typ_xxx /end CHARACTERISTIC
/begin CHARACTERISTIC Cxx_dtc_obd_mis_4_trs_h "" VALUE 0xa002b33e _REC_S1VAL_20_u2 65535. _CNV_A_R_A_105_CM 0. 65535. DISPLAY_IDENTIFIER fm_cal_mis_4_trs_h.Cxx_dtc_obd_xxx /end CHARACTERISTIC
/begin CHARACTERISTIC Cxx_conf_wal_mis_4_trs_h "" VALUE 0xa002b340 _REC_S1VAL_20_u1 3. _CNV_A_R_A_105_CM 0. 3. DISPLAY_IDENTIFIER fm_cal_mis_4_trs_h.fm_static_bitfield.Cxx_conf_wal_xxx BIT_MASK 0x3 /end CHARACTERISTIC
/begin CHARACTERISTIC Cbx_obd_mis_4_trs_h "" VALUE 0xa002b340 _REC_S1VAL_20_u1 255. _CNV_A_R_A_105_CM 0. 255. DISPLAY_IDENTIFIER fm_cal_mis_4_trs_h.fm_static_bitfield.Cbx_obd_xxx BIT_MASK 0x4 /end CHARACTERISTIC
/begin CHARACTERISTIC Cbx_obd_mena_mis_4_trs_h "" VALUE 0xa002b340 _REC_S1VAL_20_u1 255. _CNV_A_R_A_105_CM 0. 255. DISPLAY_IDENTIFIER fm_cal_mis_4_trs_h.fm_static_bitfield.Cbx_obd_mena_xxx BIT_MASK 0x8 /end CHARACTERISTIC
/begin CHARACTERISTIC Cxx_dtc_lb_mis_4_trs_h "" VALUE 0xa002b341 _REC_S1VAL_20_u1 255. _CNV_A_R_A_105_CM 0. 255. DISPLAY_IDENTIFIER fm_cal_mis_4_trs_h.Cxx_dtc_lb_xxx /end CHARACTERISTIC
/begin CHARACTERISTIC Cxx_obd_dc_mis_4_trs_h "" VALUE 0xa002b342 _REC_S1VAL_20_u1 9. _CNV_A_R_A_105_CM 1. 10. DISPLAY_IDENTIFIER fm_cal_mis_4_trs_h.Cxx_obd_dc_xxx /end CHARACTERISTIC
/begin CHARACTERISTIC Cxx_obd_us_typ_mis_4_trs_h "" VALUE 0xa002b343 _REC_S1VAL_20_u1 255. _CNV_A_R_A_105_CM 0. 255. DISPLAY_IDENTIFIER fm_cal_mis_4_trs_h.Cxx_obd_us_typ_xxx /end CHARACTERISTIC
/begin CHARACTERISTIC Cxx_dtc_obd_mis_cata "" VALUE 0xa002b34a _REC_S1VAL_20_u2 65535. _CNV_A_R_A_105_CM 0. 65535. DISPLAY_IDENTIFIER fm_cal_mis_cata.Cxx_dtc_obd_xxx /end CHARACTERISTIC
/begin CHARACTERISTIC Cxx_conf_wal_mis_cata "" VALUE 0xa002b34c _REC_S1VAL_20_u1 3. _CNV_A_R_A_105_CM 0. 3. DISPLAY_IDENTIFIER fm_cal_mis_cata.fm_static_bitfield.Cxx_conf_wal_xxx BIT_MASK 0x3 /end CHARACTERISTIC
/begin CHARACTERISTIC Cbx_obd_mis_cata "" VALUE 0xa002b34c _REC_S1VAL_20_u1 255. _CNV_A_R_A_105_CM 0. 255. DISPLAY_IDENTIFIER fm_cal_mis_cata.fm_static_bitfield.Cbx_obd_xxx BIT_MASK 0x4 /end CHARACTERISTIC
/begin CHARACTERISTIC Cbx_obd_mena_mis_cata "" VALUE 0xa002b34c _REC_S1VAL_20_u1 255. _CNV_A_R_A_105_CM 0. 255. DISPLAY_IDENTIFIER fm_cal_mis_cata.fm_static_bitfield.Cbx_obd_mena_xxx BIT_MASK 0x8 /end CHARACTERISTIC
/begin CHARACTERISTIC Cxx_dtc_lb_mis_cata "" VALUE 0xa002b34d _REC_S1VAL_20_u1 255. _CNV_A_R_A_105_CM 0. 255. DISPLAY_IDENTIFIER fm_cal_mis_cata.Cxx_dtc_lb_xxx /end CHARACTERISTIC
/begin CHARACTERISTIC Cxx_obd_dc_mis_cata "" VALUE 0xa002b34e _REC_S1VAL_20_u1 9. _CNV_A_R_A_105_CM 1. 10. DISPLAY_IDENTIFIER fm_cal_mis_cata.Cxx_obd_dc_xxx /end CHARACTERISTIC
/begin CHARACTERISTIC Cxx_obd_us_typ_mis_cata "" VALUE 0xa002b34f _REC_S1VAL_20_u1 255. _CNV_A_R_A_105_CM 0. 255. DISPLAY_IDENTIFIER fm_cal_mis_cata.Cxx_obd_us_typ_xxx /end CHARACTERISTIC
/begin CHARACTERISTIC Cxx_dtc_obd_mis_lpg_cata "" VALUE 0xa002b356 _REC_S1VAL_20_u2 65535. _CNV_A_R_A_105_CM 0. 65535. DISPLAY_IDENTIFIER fm_cal_mis_lpg_cata.Cxx_dtc_obd_xxx /end CHARACTERISTIC
/begin CHARACTERISTIC Cxx_conf_wal_mis_lpg_cata "" VALUE 0xa002b358 _REC_S1VAL_20_u1 3. _CNV_A_R_A_105_CM 0. 3. DISPLAY_IDENTIFIER fm_cal_mis_lpg_cata.fm_static_bitfield.Cxx_conf_wal_xxx BIT_MASK 0x3 /end CHARACTERISTIC
/begin CHARACTERISTIC Cbx_obd_mis_lpg_cata "" VALUE 0xa002b358 _REC_S1VAL_20_u1 255. _CNV_A_R_A_105_CM 0. 255. DISPLAY_IDENTIFIER fm_cal_mis_lpg_cata.fm_static_bitfield.Cbx_obd_xxx BIT_MASK 0x4 /end CHARACTERISTIC
/begin CHARACTERISTIC Cbx_obd_mena_mis_lpg_cata "" VALUE 0xa002b358 _REC_S1VAL_20_u1 255. _CNV_A_R_A_105_CM 0. 255. DISPLAY_IDENTIFIER fm_cal_mis_lpg_cata.fm_static_bitfield.Cbx_obd_mena_xxx BIT_MASK 0x8 /end CHARACTERISTIC
/begin CHARACTERISTIC Cxx_dtc_lb_mis_lpg_cata "" VALUE 0xa002b359 _REC_S1VAL_20_u1 255. _CNV_A_R_A_105_CM 0. 255. DISPLAY_IDENTIFIER fm_cal_mis_lpg_cata.Cxx_dtc_lb_xxx /end CHARACTERISTIC
/begin CHARACTERISTIC Cxx_obd_dc_mis_lpg_cata "" VALUE 0xa002b35a _REC_S1VAL_20_u1 9. _CNV_A_R_A_105_CM 1. 10. DISPLAY_IDENTIFIER fm_cal_mis_lpg_cata.Cxx_obd_dc_xxx /end CHARACTERISTIC
/begin CHARACTERISTIC Cxx_obd_us_typ_mis_lpg_cata "" VALUE 0xa002b35b _REC_S1VAL_20_u1 255. _CNV_A_R_A_105_CM 0. 255. DISPLAY_IDENTIFIER fm_cal_mis_lpg_cata.Cxx_obd_us_typ_xxx /end CHARACTERISTIC
/begin CHARACTERISTIC Cxx_dtc_obd_mis_lpg_trs_h "" VALUE 0xa002b362 _REC_S1VAL_20_u2 65535. _CNV_A_R_A_105_CM 0. 65535. DISPLAY_IDENTIFIER fm_cal_mis_lpg_trs_h.Cxx_dtc_obd_xxx /end CHARACTERISTIC
/begin CHARACTERISTIC Cxx_conf_wal_mis_lpg_trs_h "" VALUE 0xa002b364 _REC_S1VAL_20_u1 3. _CNV_A_R_A_105_CM 0. 3. DISPLAY_IDENTIFIER fm_cal_mis_lpg_trs_h.fm_static_bitfield.Cxx_conf_wal_xxx BIT_MASK 0x3 /end CHARACTERISTIC
/begin CHARACTERISTIC Cbx_obd_mis_lpg_trs_h "" VALUE 0xa002b364 _REC_S1VAL_20_u1 255. _CNV_A_R_A_105_CM 0. 255. DISPLAY_IDENTIFIER fm_cal_mis_lpg_trs_h.fm_static_bitfield.Cbx_obd_xxx BIT_MASK 0x4 /end CHARACTERISTIC
/begin CHARACTERISTIC Cbx_obd_mena_mis_lpg_trs_h "" VALUE 0xa002b364 _REC_S1VAL_20_u1 255. _CNV_A_R_A_105_CM 0. 255. DISPLAY_IDENTIFIER fm_cal_mis_lpg_trs_h.fm_static_bitfield.Cbx_obd_mena_xxx BIT_MASK 0x8 /end CHARACTERISTIC
/begin CHARACTERISTIC Cxx_dtc_lb_mis_lpg_trs_h "" VALUE 0xa002b365 _REC_S1VAL_20_u1 255. _CNV_A_R_A_105_CM 0. 255. DISPLAY_IDENTIFIER fm_cal_mis_lpg_trs_h.Cxx_dtc_lb_xxx /end CHARACTERISTIC
/begin CHARACTERISTIC Cxx_obd_dc_mis_lpg_trs_h "" VALUE 0xa002b366 _REC_S1VAL_20_u1 9. _CNV_A_R_A_105_CM 1. 10. DISPLAY_IDENTIFIER fm_cal_mis_lpg_trs_h.Cxx_obd_dc_xxx /end CHARACTERISTIC
/begin CHARACTERISTIC Cxx_obd_us_typ_mis_lpg_trs_h "" VALUE 0xa002b367 _REC_S1VAL_20_u1 255. _CNV_A_R_A_105_CM 0. 255. DISPLAY_IDENTIFIER fm_cal_mis_lpg_trs_h.Cxx_obd_us_typ_xxx /end CHARACTERISTIC
/begin CHARACTERISTIC Cxx_dtc_obd_mis_min_fuel_cata "" VALUE 0xa002b36e _REC_S1VAL_20_u2 65535. _CNV_A_R_A_105_CM 0. 65535. DISPLAY_IDENTIFIER fm_cal_mis_min_fuel_cata.Cxx_dtc_obd_xxx /end CHARACTERISTIC
/begin CHARACTERISTIC Cxx_conf_wal_mis_min_fuel_cata "" VALUE 0xa002b370 _REC_S1VAL_20_u1 3. _CNV_A_R_A_105_CM 0. 3. DISPLAY_IDENTIFIER fm_cal_mis_min_fuel_cata.fm_static_bitfield.Cxx_conf_wal_xxx BIT_MASK 0x3 /end CHARACTERISTIC
/begin CHARACTERISTIC Cbx_obd_mis_min_fuel_cata "" VALUE 0xa002b370 _REC_S1VAL_20_u1 255. _CNV_A_R_A_105_CM 0. 255. DISPLAY_IDENTIFIER fm_cal_mis_min_fuel_cata.fm_static_bitfield.Cbx_obd_xxx BIT_MASK 0x4 /end CHARACTERISTIC
/begin CHARACTERISTIC Cbx_obd_mena_mis_min_fuel_cata "" VALUE 0xa002b370 _REC_S1VAL_20_u1 255. _CNV_A_R_A_105_CM 0. 255. DISPLAY_IDENTIFIER fm_cal_mis_min_fuel_cata.fm_static_bitfield.Cbx_obd_mena_xxx BIT_MASK 0x8 /end CHARACTERISTIC
/begin CHARACTERISTIC Cxx_dtc_lb_mis_min_fuel_cata "" VALUE 0xa002b371 _REC_S1VAL_20_u1 255. _CNV_A_R_A_105_CM 0. 255. DISPLAY_IDENTIFIER fm_cal_mis_min_fuel_cata.Cxx_dtc_lb_xxx /end CHARACTERISTIC
/begin CHARACTERISTIC Cxx_obd_dc_mis_min_fuel_cata "" VALUE 0xa002b372 _REC_S1VAL_20_u1 9. _CNV_A_R_A_105_CM 1. 10. DISPLAY_IDENTIFIER fm_cal_mis_min_fuel_cata.Cxx_obd_dc_xxx /end CHARACTERISTIC
/begin CHARACTERISTIC Cxx_obd_us_typ_mis_min_fuel_cata "" VALUE 0xa002b373 _REC_S1VAL_20_u1 255. _CNV_A_R_A_105_CM 0. 255. DISPLAY_IDENTIFIER fm_cal_mis_min_fuel_cata.Cxx_obd_us_typ_xxx /end CHARACTERISTIC
/begin CHARACTERISTIC Cxx_dtc_obd_mis_min_fuel_trs_h "" VALUE 0xa002b37a _REC_S1VAL_20_u2 65535. _CNV_A_R_A_105_CM 0. 65535. DISPLAY_IDENTIFIER fm_cal_mis_min_fuel_trs_h.Cxx_dtc_obd_xxx /end CHARACTERISTIC
/begin CHARACTERISTIC Cxx_conf_wal_mis_min_fuel_trs_h "" VALUE 0xa002b37c _REC_S1VAL_20_u1 3. _CNV_A_R_A_105_CM 0. 3. DISPLAY_IDENTIFIER fm_cal_mis_min_fuel_trs_h.fm_static_bitfield.Cxx_conf_wal_xxx BIT_MASK 0x3 /end CHARACTERISTIC
/begin CHARACTERISTIC Cbx_obd_mis_min_fuel_trs_h "" VALUE 0xa002b37c _REC_S1VAL_20_u1 255. _CNV_A_R_A_105_CM 0. 255. DISPLAY_IDENTIFIER fm_cal_mis_min_fuel_trs_h.fm_static_bitfield.Cbx_obd_xxx BIT_MASK 0x4 /end CHARACTERISTIC
/begin CHARACTERISTIC Cbx_obd_mena_mis_min_fuel_trs_h "" VALUE 0xa002b37c _REC_S1VAL_20_u1 255. _CNV_A_R_A_105_CM 0. 255. DISPLAY_IDENTIFIER fm_cal_mis_min_fuel_trs_h.fm_static_bitfield.Cbx_obd_mena_xxx BIT_MASK 0x8 /end CHARACTERISTIC
/begin CHARACTERISTIC Cxx_dtc_lb_mis_min_fuel_trs_h "" VALUE 0xa002b37d _REC_S1VAL_20_u1 255. _CNV_A_R_A_105_CM 0. 255. DISPLAY_IDENTIFIER fm_cal_mis_min_fuel_trs_h.Cxx_dtc_lb_xxx /end CHARACTERISTIC
/begin CHARACTERISTIC Cxx_obd_dc_mis_min_fuel_trs_h "" VALUE 0xa002b37e _REC_S1VAL_20_u1 9. _CNV_A_R_A_105_CM 1. 10. DISPLAY_IDENTIFIER fm_cal_mis_min_fuel_trs_h.Cxx_obd_dc_xxx /end CHARACTERISTIC
/begin CHARACTERISTIC Cxx_obd_us_typ_mis_min_fuel_trs_h "" VALUE 0xa002b37f _REC_S1VAL_20_u1 255. _CNV_A_R_A_105_CM 0. 255. DISPLAY_IDENTIFIER fm_cal_mis_min_fuel_trs_h.Cxx_obd_us_typ_xxx /end CHARACTERISTIC
/begin CHARACTERISTIC Cxx_dtc_obd_mis_trs_h "" VALUE 0xa002b386 _REC_S1VAL_20_u2 65535. _CNV_A_R_A_105_CM 0. 65535. DISPLAY_IDENTIFIER fm_cal_mis_trs_h.Cxx_dtc_obd_xxx /end CHARACTERISTIC
/begin CHARACTERISTIC Cxx_conf_wal_mis_trs_h "" VALUE 0xa002b388 _REC_S1VAL_20_u1 3. _CNV_A_R_A_105_CM 0. 3. DISPLAY_IDENTIFIER fm_cal_mis_trs_h.fm_static_bitfield.Cxx_conf_wal_xxx BIT_MASK 0x3 /end CHARACTERISTIC
/begin CHARACTERISTIC Cbx_obd_mis_trs_h "" VALUE 0xa002b388 _REC_S1VAL_20_u1 255. _CNV_A_R_A_105_CM 0. 255. DISPLAY_IDENTIFIER fm_cal_mis_trs_h.fm_static_bitfield.Cbx_obd_xxx BIT_MASK 0x4 /end CHARACTERISTIC
/begin CHARACTERISTIC Cbx_obd_mena_mis_trs_h "" VALUE 0xa002b388 _REC_S1VAL_20_u1 255. _CNV_A_R_A_105_CM 0. 255. DISPLAY_IDENTIFIER fm_cal_mis_trs_h.fm_static_bitfield.Cbx_obd_mena_xxx BIT_MASK 0x8 /end CHARACTERISTIC
/begin CHARACTERISTIC Cxx_dtc_lb_mis_trs_h "" VALUE 0xa002b389 _REC_S1VAL_20_u1 255. _CNV_A_R_A_105_CM 0. 255. DISPLAY_IDENTIFIER fm_cal_mis_trs_h.Cxx_dtc_lb_xxx /end CHARACTERISTIC
/begin CHARACTERISTIC Cxx_obd_dc_mis_trs_h "" VALUE 0xa002b38a _REC_S1VAL_20_u1 9. _CNV_A_R_A_105_CM 1. 10. DISPLAY_IDENTIFIER fm_cal_mis_trs_h.Cxx_obd_dc_xxx /end CHARACTERISTIC
/begin CHARACTERISTIC Cxx_obd_us_typ_mis_trs_h "" VALUE 0xa002b38b _REC_S1VAL_20_u1 255. _CNV_A_R_A_105_CM 0. 255. DISPLAY_IDENTIFIER fm_cal_mis_trs_h.Cxx_obd_us_typ_xxx /end CHARACTERISTIC
/begin CHARACTERISTIC Cxx_dtc_obd_mis_unk_cata "" VALUE 0xa002b392 _REC_S1VAL_20_u2 65535. _CNV_A_R_A_105_CM 0. 65535. DISPLAY_IDENTIFIER fm_cal_mis_unk_cata.Cxx_dtc_obd_xxx /end CHARACTERISTIC
/begin CHARACTERISTIC Cxx_conf_wal_mis_unk_cata "" VALUE 0xa002b394 _REC_S1VAL_20_u1 3. _CNV_A_R_A_105_CM 0. 3. DISPLAY_IDENTIFIER fm_cal_mis_unk_cata.fm_static_bitfield.Cxx_conf_wal_xxx BIT_MASK 0x3 /end CHARACTERISTIC
/begin CHARACTERISTIC Cbx_obd_mis_unk_cata "" VALUE 0xa002b394 _REC_S1VAL_20_u1 255. _CNV_A_R_A_105_CM 0. 255. DISPLAY_IDENTIFIER fm_cal_mis_unk_cata.fm_static_bitfield.Cbx_obd_xxx BIT_MASK 0x4 /end CHARACTERISTIC
/begin CHARACTERISTIC Cbx_obd_mena_mis_unk_cata "" VALUE 0xa002b394 _REC_S1VAL_20_u1 255. _CNV_A_R_A_105_CM 0. 255. DISPLAY_IDENTIFIER fm_cal_mis_unk_cata.fm_static_bitfield.Cbx_obd_mena_xxx BIT_MASK 0x8 /end CHARACTERISTIC
/begin CHARACTERISTIC Cxx_dtc_lb_mis_unk_cata "" VALUE 0xa002b395 _REC_S1VAL_20_u1 255. _CNV_A_R_A_105_CM 0. 255. DISPLAY_IDENTIFIER fm_cal_mis_unk_cata.Cxx_dtc_lb_xxx /end CHARACTERISTIC
/begin CHARACTERISTIC Cxx_obd_dc_mis_unk_cata "" VALUE 0xa002b396 _REC_S1VAL_20_u1 9. _CNV_A_R_A_105_CM 1. 10. DISPLAY_IDENTIFIER fm_cal_mis_unk_cata.Cxx_obd_dc_xxx /end CHARACTERISTIC
/begin CHARACTERISTIC Cxx_obd_us_typ_mis_unk_cata "" VALUE 0xa002b397 _REC_S1VAL_20_u1 255. _CNV_A_R_A_105_CM 0. 255. DISPLAY_IDENTIFIER fm_cal_mis_unk_cata.Cxx_obd_us_typ_xxx /end CHARACTERISTIC
/begin CHARACTERISTIC Cxx_dtc_obd_mis_unk_lpg_cata "" VALUE 0xa002b39e _REC_S1VAL_20_u2 65535. _CNV_A_R_A_105_CM 0. 65535. DISPLAY_IDENTIFIER fm_cal_mis_unk_lpg_cata.Cxx_dtc_obd_xxx /end CHARACTERISTIC
/begin CHARACTERISTIC Cxx_conf_wal_mis_unk_lpg_cata "" VALUE 0xa002b3a0 _REC_S1VAL_20_u1 3. _CNV_A_R_A_105_CM 0. 3. DISPLAY_IDENTIFIER fm_cal_mis_unk_lpg_cata.fm_static_bitfield.Cxx_conf_wal_xxx BIT_MASK 0x3 /end CHARACTERISTIC
/begin CHARACTERISTIC Cbx_obd_mis_unk_lpg_cata "" VALUE 0xa002b3a0 _REC_S1VAL_20_u1 255. _CNV_A_R_A_105_CM 0. 255. DISPLAY_IDENTIFIER fm_cal_mis_unk_lpg_cata.fm_static_bitfield.Cbx_obd_xxx BIT_MASK 0x4 /end CHARACTERISTIC
/begin CHARACTERISTIC Cbx_obd_mena_mis_unk_lpg_cata "" VALUE 0xa002b3a0 _REC_S1VAL_20_u1 255. _CNV_A_R_A_105_CM 0. 255. DISPLAY_IDENTIFIER fm_cal_mis_unk_lpg_cata.fm_static_bitfield.Cbx_obd_mena_xxx BIT_MASK 0x8 /end CHARACTERISTIC
/begin CHARACTERISTIC Cxx_dtc_lb_mis_unk_lpg_cata "" VALUE 0xa002b3a1 _REC_S1VAL_20_u1 255. _CNV_A_R_A_105_CM 0. 255. DISPLAY_IDENTIFIER fm_cal_mis_unk_lpg_cata.Cxx_dtc_lb_xxx /end CHARACTERISTIC
/begin CHARACTERISTIC Cxx_obd_dc_mis_unk_lpg_cata "" VALUE 0xa002b3a2 _REC_S1VAL_20_u1 9. _CNV_A_R_A_105_CM 1. 10. DISPLAY_IDENTIFIER fm_cal_mis_unk_lpg_cata.Cxx_obd_dc_xxx /end CHARACTERISTIC
/begin CHARACTERISTIC Cxx_obd_us_typ_mis_unk_lpg_cata "" VALUE 0xa002b3a3 _REC_S1VAL_20_u1 255. _CNV_A_R_A_105_CM 0. 255. DISPLAY_IDENTIFIER fm_cal_mis_unk_lpg_cata.Cxx_obd_us_typ_xxx /end CHARACTERISTIC
/begin CHARACTERISTIC Cxx_dtc_obd_mis_unk_lpg_trs_h "" VALUE 0xa002b3aa _REC_S1VAL_20_u2 65535. _CNV_A_R_A_105_CM 0. 65535. DISPLAY_IDENTIFIER fm_cal_mis_unk_lpg_trs_h.Cxx_dtc_obd_xxx /end CHARACTERISTIC
/begin CHARACTERISTIC Cxx_conf_wal_mis_unk_lpg_trs_h "" VALUE 0xa002b3ac _REC_S1VAL_20_u1 3. _CNV_A_R_A_105_CM 0. 3. DISPLAY_IDENTIFIER fm_cal_mis_unk_lpg_trs_h.fm_static_bitfield.Cxx_conf_wal_xxx BIT_MASK 0x3 /end CHARACTERISTIC
/begin CHARACTERISTIC Cbx_obd_mis_unk_lpg_trs_h "" VALUE 0xa002b3ac _REC_S1VAL_20_u1 255. _CNV_A_R_A_105_CM 0. 255. DISPLAY_IDENTIFIER fm_cal_mis_unk_lpg_trs_h.fm_static_bitfield.Cbx_obd_xxx BIT_MASK 0x4 /end CHARACTERISTIC
/begin CHARACTERISTIC Cbx_obd_mena_mis_unk_lpg_trs_h "" VALUE 0xa002b3ac _REC_S1VAL_20_u1 255. _CNV_A_R_A_105_CM 0. 255. DISPLAY_IDENTIFIER fm_cal_mis_unk_lpg_trs_h.fm_static_bitfield.Cbx_obd_mena_xxx BIT_MASK 0x8 /end CHARACTERISTIC
/begin CHARACTERISTIC Cxx_dtc_lb_mis_unk_lpg_trs_h "" VALUE 0xa002b3ad _REC_S1VAL_20_u1 255. _CNV_A_R_A_105_CM 0. 255. DISPLAY_IDENTIFIER fm_cal_mis_unk_lpg_trs_h.Cxx_dtc_lb_xxx /end CHARACTERISTIC
/begin CHARACTERISTIC Cxx_obd_dc_mis_unk_lpg_trs_h "" VALUE 0xa002b3ae _REC_S1VAL_20_u1 9. _CNV_A_R_A_105_CM 1. 10. DISPLAY_IDENTIFIER fm_cal_mis_unk_lpg_trs_h.Cxx_obd_dc_xxx /end CHARACTERISTIC
/begin CHARACTERISTIC Cxx_obd_us_typ_mis_unk_lpg_trs_h "" VALUE 0xa002b3af _REC_S1VAL_20_u1 255. _CNV_A_R_A_105_CM 0. 255. DISPLAY_IDENTIFIER fm_cal_mis_unk_lpg_trs_h.Cxx_obd_us_typ_xxx /end CHARACTERISTIC
/begin CHARACTERISTIC Cxx_dtc_obd_mis_unk_trs_h "" VALUE 0xa002b3b6 _REC_S1VAL_20_u2 65535. _CNV_A_R_A_105_CM 0. 65535. DISPLAY_IDENTIFIER fm_cal_mis_unk_trs_h.Cxx_dtc_obd_xxx /end CHARACTERISTIC
/begin CHARACTERISTIC Cxx_conf_wal_mis_unk_trs_h "" VALUE 0xa002b3b8 _REC_S1VAL_20_u1 3. _CNV_A_R_A_105_CM 0. 3. DISPLAY_IDENTIFIER fm_cal_mis_unk_trs_h.fm_static_bitfield.Cxx_conf_wal_xxx BIT_MASK 0x3 /end CHARACTERISTIC
/begin CHARACTERISTIC Cbx_obd_mis_unk_trs_h "" VALUE 0xa002b3b8 _REC_S1VAL_20_u1 255. _CNV_A_R_A_105_CM 0. 255. DISPLAY_IDENTIFIER fm_cal_mis_unk_trs_h.fm_static_bitfield.Cbx_obd_xxx BIT_MASK 0x4 /end CHARACTERISTIC
/begin CHARACTERISTIC Cbx_obd_mena_mis_unk_trs_h "" VALUE 0xa002b3b8 _REC_S1VAL_20_u1 255. _CNV_A_R_A_105_CM 0. 255. DISPLAY_IDENTIFIER fm_cal_mis_unk_trs_h.fm_static_bitfield.Cbx_obd_mena_xxx BIT_MASK 0x8 /end CHARACTERISTIC
/begin CHARACTERISTIC Cxx_dtc_lb_mis_unk_trs_h "" VALUE 0xa002b3b9 _REC_S1VAL_20_u1 255. _CNV_A_R_A_105_CM 0. 255. DISPLAY_IDENTIFIER fm_cal_mis_unk_trs_h.Cxx_dtc_lb_xxx /end CHARACTERISTIC
/begin CHARACTERISTIC Cxx_obd_dc_mis_unk_trs_h "" VALUE 0xa002b3ba _REC_S1VAL_20_u1 9. _CNV_A_R_A_105_CM 1. 10. DISPLAY_IDENTIFIER fm_cal_mis_unk_trs_h.Cxx_obd_dc_xxx /end CHARACTERISTIC
/begin CHARACTERISTIC Cxx_obd_us_typ_mis_unk_trs_h "" VALUE 0xa002b3bb _REC_S1VAL_20_u1 255. _CNV_A_R_A_105_CM 0. 255. DISPLAY_IDENTIFIER fm_cal_mis_unk_trs_h.Cxx_obd_us_typ_xxx /end CHARACTERISTIC
/begin CHARACTERISTIC Cxx_conf_wal_ptc_rov_oc "" VALUE 0xa002b4d8 _REC_S1VAL_20_u1 3. _CNV_A_R_A_105_CM 0. 3. DISPLAY_IDENTIFIER fm_cal_ptc_rov_oc.fm_static_bitfield.Cxx_conf_wal_xxx BIT_MASK 0x3 /end CHARACTERISTIC
/begin CHARACTERISTIC Cxx_dtc_lb_ptc_rov_oc "" VALUE 0xa002b4d9 _REC_S1VAL_20_u1 255. _CNV_A_R_A_105_CM 0. 255. DISPLAY_IDENTIFIER fm_cal_ptc_rov_oc.Cxx_dtc_lb_xxx /end CHARACTERISTIC
/begin CHARACTERISTIC Cxx_obd_us_typ_ptc_rov_oc "" VALUE 0xa002b4db _REC_S1VAL_20_u1 255. _CNV_A_R_A_105_CM 0. 255. DISPLAY_IDENTIFIER fm_cal_ptc_rov_oc.Cxx_obd_us_typ_xxx /end CHARACTERISTIC
/begin CHARACTERISTIC Cxx_conf_wal_ptc_rov_scg "" VALUE 0xa002b4e4 _REC_S1VAL_20_u1 3. _CNV_A_R_A_105_CM 0. 3. DISPLAY_IDENTIFIER fm_cal_ptc_rov_scg.fm_static_bitfield.Cxx_conf_wal_xxx BIT_MASK 0x3 /end CHARACTERISTIC
/begin CHARACTERISTIC Cxx_dtc_lb_ptc_rov_scg "" VALUE 0xa002b4e5 _REC_S1VAL_20_u1 255. _CNV_A_R_A_105_CM 0. 255. DISPLAY_IDENTIFIER fm_cal_ptc_rov_scg.Cxx_dtc_lb_xxx /end CHARACTERISTIC
/begin CHARACTERISTIC Cxx_obd_us_typ_ptc_rov_scg "" VALUE 0xa002b4e7 _REC_S1VAL_20_u1 255. _CNV_A_R_A_105_CM 0. 255. DISPLAY_IDENTIFIER fm_cal_ptc_rov_scg.Cxx_obd_us_typ_xxx /end CHARACTERISTIC
/begin CHARACTERISTIC Cxx_conf_wal_ptc_rov_scw "" VALUE 0xa002b4f0 _REC_S1VAL_20_u1 3. _CNV_A_R_A_105_CM 0. 3. DISPLAY_IDENTIFIER fm_cal_ptc_rov_scw.fm_static_bitfield.Cxx_conf_wal_xxx BIT_MASK 0x3 /end CHARACTERISTIC
/begin CHARACTERISTIC Cxx_dtc_lb_ptc_rov_scw "" VALUE 0xa002b4f1 _REC_S1VAL_20_u1 255. _CNV_A_R_A_105_CM 0. 255. DISPLAY_IDENTIFIER fm_cal_ptc_rov_scw.Cxx_dtc_lb_xxx /end CHARACTERISTIC
/begin CHARACTERISTIC Cxx_obd_us_typ_ptc_rov_scw "" VALUE 0xa002b4f3 _REC_S1VAL_20_u1 255. _CNV_A_R_A_105_CM 0. 255. DISPLAY_IDENTIFIER fm_cal_ptc_rov_scw.Cxx_obd_us_typ_xxx /end CHARACTERISTIC
/begin CHARACTERISTIC Cxx_dtc_obd_pws_1_h "" VALUE 0xa002b056 _REC_S1VAL_20_u2 65535. _CNV_A_R_A_105_CM 0. 65535. DISPLAY_IDENTIFIER fm_cal_pws_1_h.Cxx_dtc_obd_xxx /end CHARACTERISTIC
/begin CHARACTERISTIC Cxx_conf_wal_pws_1_h "" VALUE 0xa002b058 _REC_S1VAL_20_u1 3. _CNV_A_R_A_105_CM 0. 3. DISPLAY_IDENTIFIER fm_cal_pws_1_h.fm_static_bitfield.Cxx_conf_wal_xxx BIT_MASK 0x3 /end CHARACTERISTIC
/begin CHARACTERISTIC Cbx_obd_pws_1_h "" VALUE 0xa002b058 _REC_S1VAL_20_u1 255. _CNV_A_R_A_105_CM 0. 255. DISPLAY_IDENTIFIER fm_cal_pws_1_h.fm_static_bitfield.Cbx_obd_xxx BIT_MASK 0x4 /end CHARACTERISTIC
/begin CHARACTERISTIC Cbx_obd_mena_pws_1_h "" VALUE 0xa002b058 _REC_S1VAL_20_u1 255. _CNV_A_R_A_105_CM 0. 255. DISPLAY_IDENTIFIER fm_cal_pws_1_h.fm_static_bitfield.Cbx_obd_mena_xxx BIT_MASK 0x8 /end CHARACTERISTIC
/begin CHARACTERISTIC Cxx_dtc_lb_pws_1_h "" VALUE 0xa002b059 _REC_S1VAL_20_u1 255. _CNV_A_R_A_105_CM 0. 255. DISPLAY_IDENTIFIER fm_cal_pws_1_h.Cxx_dtc_lb_xxx /end CHARACTERISTIC
/begin CHARACTERISTIC Cxx_obd_dc_pws_1_h "" VALUE 0xa002b05a _REC_S1VAL_20_u1 9. _CNV_A_R_A_105_CM 1. 10. DISPLAY_IDENTIFIER fm_cal_pws_1_h.Cxx_obd_dc_xxx /end CHARACTERISTIC
/begin CHARACTERISTIC Cxx_obd_us_typ_pws_1_h "" VALUE 0xa002b05b _REC_S1VAL_20_u1 255. _CNV_A_R_A_105_CM 0. 255. DISPLAY_IDENTIFIER fm_cal_pws_1_h.Cxx_obd_us_typ_xxx /end CHARACTERISTIC
/begin CHARACTERISTIC Cxx_dtc_obd_pws_1_l "" VALUE 0xa002b062 _REC_S1VAL_20_u2 65535. _CNV_A_R_A_105_CM 0. 65535. DISPLAY_IDENTIFIER fm_cal_pws_1_l.Cxx_dtc_obd_xxx /end CHARACTERISTIC
/begin CHARACTERISTIC Cxx_conf_wal_pws_1_l "" VALUE 0xa002b064 _REC_S1VAL_20_u1 3. _CNV_A_R_A_105_CM 0. 3. DISPLAY_IDENTIFIER fm_cal_pws_1_l.fm_static_bitfield.Cxx_conf_wal_xxx BIT_MASK 0x3 /end CHARACTERISTIC
/begin CHARACTERISTIC Cbx_obd_pws_1_l "" VALUE 0xa002b064 _REC_S1VAL_20_u1 255. _CNV_A_R_A_105_CM 0. 255. DISPLAY_IDENTIFIER fm_cal_pws_1_l.fm_static_bitfield.Cbx_obd_xxx BIT_MASK 0x4 /end CHARACTERISTIC
/begin CHARACTERISTIC Cbx_obd_mena_pws_1_l "" VALUE 0xa002b064 _REC_S1VAL_20_u1 255. _CNV_A_R_A_105_CM 0. 255. DISPLAY_IDENTIFIER fm_cal_pws_1_l.fm_static_bitfield.Cbx_obd_mena_xxx BIT_MASK 0x8 /end CHARACTERISTIC
/begin CHARACTERISTIC Cxx_dtc_lb_pws_1_l "" VALUE 0xa002b065 _REC_S1VAL_20_u1 255. _CNV_A_R_A_105_CM 0. 255. DISPLAY_IDENTIFIER fm_cal_pws_1_l.Cxx_dtc_lb_xxx /end CHARACTERISTIC
/begin CHARACTERISTIC Cxx_obd_dc_pws_1_l "" VALUE 0xa002b066 _REC_S1VAL_20_u1 9. _CNV_A_R_A_105_CM 1. 10. DISPLAY_IDENTIFIER fm_cal_pws_1_l.Cxx_obd_dc_xxx /end CHARACTERISTIC
/begin CHARACTERISTIC Cxx_obd_us_typ_pws_1_l "" VALUE 0xa002b067 _REC_S1VAL_20_u1 255. _CNV_A_R_A_105_CM 0. 255. DISPLAY_IDENTIFIER fm_cal_pws_1_l.Cxx_obd_us_typ_xxx /end CHARACTERISTIC
/begin CHARACTERISTIC Cxx_dtc_obd_pws_2_h "" VALUE 0xa002b06e _REC_S1VAL_20_u2 65535. _CNV_A_R_A_105_CM 0. 65535. DISPLAY_IDENTIFIER fm_cal_pws_2_h.Cxx_dtc_obd_xxx /end CHARACTERISTIC
/begin CHARACTERISTIC Cxx_conf_wal_pws_2_h "" VALUE 0xa002b070 _REC_S1VAL_20_u1 3. _CNV_A_R_A_105_CM 0. 3. DISPLAY_IDENTIFIER fm_cal_pws_2_h.fm_static_bitfield.Cxx_conf_wal_xxx BIT_MASK 0x3 /end CHARACTERISTIC
/begin CHARACTERISTIC Cbx_obd_pws_2_h "" VALUE 0xa002b070 _REC_S1VAL_20_u1 255. _CNV_A_R_A_105_CM 0. 255. DISPLAY_IDENTIFIER fm_cal_pws_2_h.fm_static_bitfield.Cbx_obd_xxx BIT_MASK 0x4 /end CHARACTERISTIC
/begin CHARACTERISTIC Cbx_obd_mena_pws_2_h "" VALUE 0xa002b070 _REC_S1VAL_20_u1 255. _CNV_A_R_A_105_CM 0. 255. DISPLAY_IDENTIFIER fm_cal_pws_2_h.fm_static_bitfield.Cbx_obd_mena_xxx BIT_MASK 0x8 /end CHARACTERISTIC
/begin CHARACTERISTIC Cxx_dtc_lb_pws_2_h "" VALUE 0xa002b071 _REC_S1VAL_20_u1 255. _CNV_A_R_A_105_CM 0. 255. DISPLAY_IDENTIFIER fm_cal_pws_2_h.Cxx_dtc_lb_xxx /end CHARACTERISTIC
/begin CHARACTERISTIC Cxx_obd_dc_pws_2_h "" VALUE 0xa002b072 _REC_S1VAL_20_u1 9. _CNV_A_R_A_105_CM 1. 10. DISPLAY_IDENTIFIER fm_cal_pws_2_h.Cxx_obd_dc_xxx /end CHARACTERISTIC
/begin CHARACTERISTIC Cxx_obd_us_typ_pws_2_h "" VALUE 0xa002b073 _REC_S1VAL_20_u1 255. _CNV_A_R_A_105_CM 0. 255. DISPLAY_IDENTIFIER fm_cal_pws_2_h.Cxx_obd_us_typ_xxx /end CHARACTERISTIC
/begin CHARACTERISTIC Cxx_dtc_obd_pws_2_l "" VALUE 0xa002b07a _REC_S1VAL_20_u2 65535. _CNV_A_R_A_105_CM 0. 65535. DISPLAY_IDENTIFIER fm_cal_pws_2_l.Cxx_dtc_obd_xxx /end CHARACTERISTIC
/begin CHARACTERISTIC Cxx_conf_wal_pws_2_l "" VALUE 0xa002b07c _REC_S1VAL_20_u1 3. _CNV_A_R_A_105_CM 0. 3. DISPLAY_IDENTIFIER fm_cal_pws_2_l.fm_static_bitfield.Cxx_conf_wal_xxx BIT_MASK 0x3 /end CHARACTERISTIC
/begin CHARACTERISTIC Cbx_obd_pws_2_l "" VALUE 0xa002b07c _REC_S1VAL_20_u1 255. _CNV_A_R_A_105_CM 0. 255. DISPLAY_IDENTIFIER fm_cal_pws_2_l.fm_static_bitfield.Cbx_obd_xxx BIT_MASK 0x4 /end CHARACTERISTIC
/begin CHARACTERISTIC Cbx_obd_mena_pws_2_l "" VALUE 0xa002b07c _REC_S1VAL_20_u1 255. _CNV_A_R_A_105_CM 0. 255. DISPLAY_IDENTIFIER fm_cal_pws_2_l.fm_static_bitfield.Cbx_obd_mena_xxx BIT_MASK 0x8 /end CHARACTERISTIC
/begin CHARACTERISTIC Cxx_dtc_lb_pws_2_l "" VALUE 0xa002b07d _REC_S1VAL_20_u1 255. _CNV_A_R_A_105_CM 0. 255. DISPLAY_IDENTIFIER fm_cal_pws_2_l.Cxx_dtc_lb_xxx /end CHARACTERISTIC
/begin CHARACTERISTIC Cxx_obd_dc_pws_2_l "" VALUE 0xa002b07e _REC_S1VAL_20_u1 9. _CNV_A_R_A_105_CM 1. 10. DISPLAY_IDENTIFIER fm_cal_pws_2_l.Cxx_obd_dc_xxx /end CHARACTERISTIC
/begin CHARACTERISTIC Cxx_obd_us_typ_pws_2_l "" VALUE 0xa002b07f _REC_S1VAL_20_u1 255. _CNV_A_R_A_105_CM 0. 255. DISPLAY_IDENTIFIER fm_cal_pws_2_l.Cxx_obd_us_typ_xxx /end CHARACTERISTIC
/begin CHARACTERISTIC Cxx_dtc_obd_pws_3_h "" VALUE 0xa002b086 _REC_S1VAL_20_u2 65535. _CNV_A_R_A_105_CM 0. 65535. DISPLAY_IDENTIFIER fm_cal_pws_3_h.Cxx_dtc_obd_xxx /end CHARACTERISTIC
/begin CHARACTERISTIC Cxx_conf_wal_pws_3_h "" VALUE 0xa002b088 _REC_S1VAL_20_u1 3. _CNV_A_R_A_105_CM 0. 3. DISPLAY_IDENTIFIER fm_cal_pws_3_h.fm_static_bitfield.Cxx_conf_wal_xxx BIT_MASK 0x3 /end CHARACTERISTIC
/begin CHARACTERISTIC Cbx_obd_pws_3_h "" VALUE 0xa002b088 _REC_S1VAL_20_u1 255. _CNV_A_R_A_105_CM 0. 255. DISPLAY_IDENTIFIER fm_cal_pws_3_h.fm_static_bitfield.Cbx_obd_xxx BIT_MASK 0x4 /end CHARACTERISTIC
/begin CHARACTERISTIC Cbx_obd_mena_pws_3_h "" VALUE 0xa002b088 _REC_S1VAL_20_u1 255. _CNV_A_R_A_105_CM 0. 255. DISPLAY_IDENTIFIER fm_cal_pws_3_h.fm_static_bitfield.Cbx_obd_mena_xxx BIT_MASK 0x8 /end CHARACTERISTIC
/begin CHARACTERISTIC Cxx_dtc_lb_pws_3_h "" VALUE 0xa002b089 _REC_S1VAL_20_u1 255. _CNV_A_R_A_105_CM 0. 255. DISPLAY_IDENTIFIER fm_cal_pws_3_h.Cxx_dtc_lb_xxx /end CHARACTERISTIC
/begin CHARACTERISTIC Cxx_obd_dc_pws_3_h "" VALUE 0xa002b08a _REC_S1VAL_20_u1 9. _CNV_A_R_A_105_CM 1. 10. DISPLAY_IDENTIFIER fm_cal_pws_3_h.Cxx_obd_dc_xxx /end CHARACTERISTIC
/begin CHARACTERISTIC Cxx_obd_us_typ_pws_3_h "" VALUE 0xa002b08b _REC_S1VAL_20_u1 255. _CNV_A_R_A_105_CM 0. 255. DISPLAY_IDENTIFIER fm_cal_pws_3_h.Cxx_obd_us_typ_xxx /end CHARACTERISTIC
/begin CHARACTERISTIC Cxx_dtc_obd_pws_3_l "" VALUE 0xa002b092 _REC_S1VAL_20_u2 65535. _CNV_A_R_A_105_CM 0. 65535. DISPLAY_IDENTIFIER fm_cal_pws_3_l.Cxx_dtc_obd_xxx /end CHARACTERISTIC
/begin CHARACTERISTIC Cxx_conf_wal_pws_3_l "" VALUE 0xa002b094 _REC_S1VAL_20_u1 3. _CNV_A_R_A_105_CM 0. 3. DISPLAY_IDENTIFIER fm_cal_pws_3_l.fm_static_bitfield.Cxx_conf_wal_xxx BIT_MASK 0x3 /end CHARACTERISTIC
/begin CHARACTERISTIC Cbx_obd_pws_3_l "" VALUE 0xa002b094 _REC_S1VAL_20_u1 255. _CNV_A_R_A_105_CM 0. 255. DISPLAY_IDENTIFIER fm_cal_pws_3_l.fm_static_bitfield.Cbx_obd_xxx BIT_MASK 0x4 /end CHARACTERISTIC
/begin CHARACTERISTIC Cbx_obd_mena_pws_3_l "" VALUE 0xa002b094 _REC_S1VAL_20_u1 255. _CNV_A_R_A_105_CM 0. 255. DISPLAY_IDENTIFIER fm_cal_pws_3_l.fm_static_bitfield.Cbx_obd_mena_xxx BIT_MASK 0x8 /end CHARACTERISTIC
/begin CHARACTERISTIC Cxx_dtc_lb_pws_3_l "" VALUE 0xa002b095 _REC_S1VAL_20_u1 255. _CNV_A_R_A_105_CM 0. 255. DISPLAY_IDENTIFIER fm_cal_pws_3_l.Cxx_dtc_lb_xxx /end CHARACTERISTIC
/begin CHARACTERISTIC Cxx_obd_dc_pws_3_l "" VALUE 0xa002b096 _REC_S1VAL_20_u1 9. _CNV_A_R_A_105_CM 1. 10. DISPLAY_IDENTIFIER fm_cal_pws_3_l.Cxx_obd_dc_xxx /end CHARACTERISTIC
/begin CHARACTERISTIC Cxx_obd_us_typ_pws_3_l "" VALUE 0xa002b097 _REC_S1VAL_20_u1 255. _CNV_A_R_A_105_CM 0. 255. DISPLAY_IDENTIFIER fm_cal_pws_3_l.Cxx_obd_us_typ_xxx /end CHARACTERISTIC
/begin CHARACTERISTIC Cxx_dtc_obd_sens_it_1_nok "" VALUE 0xa002b09e _REC_S1VAL_20_u2 65535. _CNV_A_R_A_105_CM 0. 65535. DISPLAY_IDENTIFIER fm_cal_sens_it_1_nok.Cxx_dtc_obd_xxx /end CHARACTERISTIC
/begin CHARACTERISTIC Cxx_conf_wal_sens_it_1_nok "" VALUE 0xa002b0a0 _REC_S1VAL_20_u1 3. _CNV_A_R_A_105_CM 0. 3. DISPLAY_IDENTIFIER fm_cal_sens_it_1_nok.fm_static_bitfield.Cxx_conf_wal_xxx BIT_MASK 0x3 /end CHARACTERISTIC
/begin CHARACTERISTIC Cbx_obd_sens_it_1_nok "" VALUE 0xa002b0a0 _REC_S1VAL_20_u1 255. _CNV_A_R_A_105_CM 0. 255. DISPLAY_IDENTIFIER fm_cal_sens_it_1_nok.fm_static_bitfield.Cbx_obd_xxx BIT_MASK 0x4 /end CHARACTERISTIC
/begin CHARACTERISTIC Cbx_obd_mena_sens_it_1_nok "" VALUE 0xa002b0a0 _REC_S1VAL_20_u1 255. _CNV_A_R_A_105_CM 0. 255. DISPLAY_IDENTIFIER fm_cal_sens_it_1_nok.fm_static_bitfield.Cbx_obd_mena_xxx BIT_MASK 0x8 /end CHARACTERISTIC
/begin CHARACTERISTIC Cxx_dtc_lb_sens_it_1_nok "" VALUE 0xa002b0a1 _REC_S1VAL_20_u1 255. _CNV_A_R_A_105_CM 0. 255. DISPLAY_IDENTIFIER fm_cal_sens_it_1_nok.Cxx_dtc_lb_xxx /end CHARACTERISTIC
/begin CHARACTERISTIC Cxx_obd_dc_sens_it_1_nok "" VALUE 0xa002b0a2 _REC_S1VAL_20_u1 9. _CNV_A_R_A_105_CM 1. 10. DISPLAY_IDENTIFIER fm_cal_sens_it_1_nok.Cxx_obd_dc_xxx /end CHARACTERISTIC
/begin CHARACTERISTIC Cxx_obd_us_typ_sens_it_1_nok "" VALUE 0xa002b0a3 _REC_S1VAL_20_u1 255. _CNV_A_R_A_105_CM 0. 255. DISPLAY_IDENTIFIER fm_cal_sens_it_1_nok.Cxx_obd_us_typ_xxx /end CHARACTERISTIC
/begin CHARACTERISTIC Cxx_dtc_obd_sens_it_2_nok "" VALUE 0xa002b0aa _REC_S1VAL_20_u2 65535. _CNV_A_R_A_105_CM 0. 65535. DISPLAY_IDENTIFIER fm_cal_sens_it_2_nok.Cxx_dtc_obd_xxx /end CHARACTERISTIC
/begin CHARACTERISTIC Cxx_conf_wal_sens_it_2_nok "" VALUE 0xa002b0ac _REC_S1VAL_20_u1 3. _CNV_A_R_A_105_CM 0. 3. DISPLAY_IDENTIFIER fm_cal_sens_it_2_nok.fm_static_bitfield.Cxx_conf_wal_xxx BIT_MASK 0x3 /end CHARACTERISTIC
/begin CHARACTERISTIC Cbx_obd_sens_it_2_nok "" VALUE 0xa002b0ac _REC_S1VAL_20_u1 255. _CNV_A_R_A_105_CM 0. 255. DISPLAY_IDENTIFIER fm_cal_sens_it_2_nok.fm_static_bitfield.Cbx_obd_xxx BIT_MASK 0x4 /end CHARACTERISTIC
/begin CHARACTERISTIC Cbx_obd_mena_sens_it_2_nok "" VALUE 0xa002b0ac _REC_S1VAL_20_u1 255. _CNV_A_R_A_105_CM 0. 255. DISPLAY_IDENTIFIER fm_cal_sens_it_2_nok.fm_static_bitfield.Cbx_obd_mena_xxx BIT_MASK 0x8 /end CHARACTERISTIC
/begin CHARACTERISTIC Cxx_dtc_lb_sens_it_2_nok "" VALUE 0xa002b0ad _REC_S1VAL_20_u1 255. _CNV_A_R_A_105_CM 0. 255. DISPLAY_IDENTIFIER fm_cal_sens_it_2_nok.Cxx_dtc_lb_xxx /end CHARACTERISTIC
/begin CHARACTERISTIC Cxx_obd_dc_sens_it_2_nok "" VALUE 0xa002b0ae _REC_S1VAL_20_u1 9. _CNV_A_R_A_105_CM 1. 10. DISPLAY_IDENTIFIER fm_cal_sens_it_2_nok.Cxx_obd_dc_xxx /end CHARACTERISTIC
/begin CHARACTERISTIC Cxx_obd_us_typ_sens_it_2_nok "" VALUE 0xa002b0af _REC_S1VAL_20_u1 255. _CNV_A_R_A_105_CM 0. 255. DISPLAY_IDENTIFIER fm_cal_sens_it_2_nok.Cxx_obd_us_typ_xxx /end CHARACTERISTIC
/begin CHARACTERISTIC Cxx_dtc_obd_sens_it_chr "" VALUE 0xa002b0b6 _REC_S1VAL_20_u2 65535. _CNV_A_R_A_105_CM 0. 65535. DISPLAY_IDENTIFIER fm_cal_sens_it_chr.Cxx_dtc_obd_xxx /end CHARACTERISTIC
/begin CHARACTERISTIC Cxx_conf_wal_sens_it_chr "" VALUE 0xa002b0b8 _REC_S1VAL_20_u1 3. _CNV_A_R_A_105_CM 0. 3. DISPLAY_IDENTIFIER fm_cal_sens_it_chr.fm_static_bitfield.Cxx_conf_wal_xxx BIT_MASK 0x3 /end CHARACTERISTIC
/begin CHARACTERISTIC Cbx_obd_sens_it_chr "" VALUE 0xa002b0b8 _REC_S1VAL_20_u1 255. _CNV_A_R_A_105_CM 0. 255. DISPLAY_IDENTIFIER fm_cal_sens_it_chr.fm_static_bitfield.Cbx_obd_xxx BIT_MASK 0x4 /end CHARACTERISTIC
/begin CHARACTERISTIC Cbx_obd_mena_sens_it_chr "" VALUE 0xa002b0b8 _REC_S1VAL_20_u1 255. _CNV_A_R_A_105_CM 0. 255. DISPLAY_IDENTIFIER fm_cal_sens_it_chr.fm_static_bitfield.Cbx_obd_mena_xxx BIT_MASK 0x8 /end CHARACTERISTIC
/begin CHARACTERISTIC Cxx_dtc_lb_sens_it_chr "" VALUE 0xa002b0b9 _REC_S1VAL_20_u1 255. _CNV_A_R_A_105_CM 0. 255. DISPLAY_IDENTIFIER fm_cal_sens_it_chr.Cxx_dtc_lb_xxx /end CHARACTERISTIC
/begin CHARACTERISTIC Cxx_obd_dc_sens_it_chr "" VALUE 0xa002b0ba _REC_S1VAL_20_u1 9. _CNV_A_R_A_105_CM 1. 10. DISPLAY_IDENTIFIER fm_cal_sens_it_chr.Cxx_obd_dc_xxx /end CHARACTERISTIC
/begin CHARACTERISTIC Cxx_obd_us_typ_sens_it_chr "" VALUE 0xa002b0bb _REC_S1VAL_20_u1 255. _CNV_A_R_A_105_CM 0. 255. DISPLAY_IDENTIFIER fm_cal_sens_it_chr.Cxx_obd_us_typ_xxx /end CHARACTERISTIC
/begin CHARACTERISTIC Cxx_dtc_obd_sens_it_sig_mcut "" VALUE 0xa002b0c2 _REC_S1VAL_20_u2 65535. _CNV_A_R_A_105_CM 0. 65535. DISPLAY_IDENTIFIER fm_cal_sens_it_sig_mcut.Cxx_dtc_obd_xxx /end CHARACTERISTIC
/begin CHARACTERISTIC Cxx_conf_wal_sens_it_sig_mcut "" VALUE 0xa002b0c4 _REC_S1VAL_20_u1 3. _CNV_A_R_A_105_CM 0. 3. DISPLAY_IDENTIFIER fm_cal_sens_it_sig_mcut.fm_static_bitfield.Cxx_conf_wal_xxx BIT_MASK 0x3 /end CHARACTERISTIC
/begin CHARACTERISTIC Cbx_obd_sens_it_sig_mcut "" VALUE 0xa002b0c4 _REC_S1VAL_20_u1 255. _CNV_A_R_A_105_CM 0. 255. DISPLAY_IDENTIFIER fm_cal_sens_it_sig_mcut.fm_static_bitfield.Cbx_obd_xxx BIT_MASK 0x4 /end CHARACTERISTIC
/begin CHARACTERISTIC Cbx_obd_mena_sens_it_sig_mcut "" VALUE 0xa002b0c4 _REC_S1VAL_20_u1 255. _CNV_A_R_A_105_CM 0. 255. DISPLAY_IDENTIFIER fm_cal_sens_it_sig_mcut.fm_static_bitfield.Cbx_obd_mena_xxx BIT_MASK 0x8 /end CHARACTERISTIC
/begin CHARACTERISTIC Cxx_dtc_lb_sens_it_sig_mcut "" VALUE 0xa002b0c5 _REC_S1VAL_20_u1 255. _CNV_A_R_A_105_CM 0. 255. DISPLAY_IDENTIFIER fm_cal_sens_it_sig_mcut.Cxx_dtc_lb_xxx /end CHARACTERISTIC
/begin CHARACTERISTIC Cxx_obd_dc_sens_it_sig_mcut "" VALUE 0xa002b0c6 _REC_S1VAL_20_u1 9. _CNV_A_R_A_105_CM 1. 10. DISPLAY_IDENTIFIER fm_cal_sens_it_sig_mcut.Cxx_obd_dc_xxx /end CHARACTERISTIC
/begin CHARACTERISTIC Cxx_obd_us_typ_sens_it_sig_mcut "" VALUE 0xa002b0c7 _REC_S1VAL_20_u1 255. _CNV_A_R_A_105_CM 0. 255. DISPLAY_IDENTIFIER fm_cal_sens_it_sig_mcut.Cxx_obd_us_typ_xxx /end CHARACTERISTIC
/begin CHARACTERISTIC Cxx_dtc_obd_sens_map_h "" VALUE 0xa002b0ce _REC_S1VAL_20_u2 65535. _CNV_A_R_A_105_CM 0. 65535. DISPLAY_IDENTIFIER fm_cal_sens_map_h.Cxx_dtc_obd_xxx /end CHARACTERISTIC
/begin CHARACTERISTIC Cxx_conf_wal_sens_map_h "" VALUE 0xa002b0d0 _REC_S1VAL_20_u1 3. _CNV_A_R_A_105_CM 0. 3. DISPLAY_IDENTIFIER fm_cal_sens_map_h.fm_static_bitfield.Cxx_conf_wal_xxx BIT_MASK 0x3 /end CHARACTERISTIC
/begin CHARACTERISTIC Cbx_obd_sens_map_h "" VALUE 0xa002b0d0 _REC_S1VAL_20_u1 255. _CNV_A_R_A_105_CM 0. 255. DISPLAY_IDENTIFIER fm_cal_sens_map_h.fm_static_bitfield.Cbx_obd_xxx BIT_MASK 0x4 /end CHARACTERISTIC
/begin CHARACTERISTIC Cbx_obd_mena_sens_map_h "" VALUE 0xa002b0d0 _REC_S1VAL_20_u1 255. _CNV_A_R_A_105_CM 0. 255. DISPLAY_IDENTIFIER fm_cal_sens_map_h.fm_static_bitfield.Cbx_obd_mena_xxx BIT_MASK 0x8 /end CHARACTERISTIC
/begin CHARACTERISTIC Cxx_dtc_lb_sens_map_h "" VALUE 0xa002b0d1 _REC_S1VAL_20_u1 255. _CNV_A_R_A_105_CM 0. 255. DISPLAY_IDENTIFIER fm_cal_sens_map_h.Cxx_dtc_lb_xxx /end CHARACTERISTIC
/begin CHARACTERISTIC Cxx_obd_dc_sens_map_h "" VALUE 0xa002b0d2 _REC_S1VAL_20_u1 9. _CNV_A_R_A_105_CM 1. 10. DISPLAY_IDENTIFIER fm_cal_sens_map_h.Cxx_obd_dc_xxx /end CHARACTERISTIC
/begin CHARACTERISTIC Cxx_obd_us_typ_sens_map_h "" VALUE 0xa002b0d3 _REC_S1VAL_20_u1 255. _CNV_A_R_A_105_CM 0. 255. DISPLAY_IDENTIFIER fm_cal_sens_map_h.Cxx_obd_us_typ_xxx /end CHARACTERISTIC
/begin CHARACTERISTIC Cxx_dtc_obd_sens_map_l "" VALUE 0xa002b0da _REC_S1VAL_20_u2 65535. _CNV_A_R_A_105_CM 0. 65535. DISPLAY_IDENTIFIER fm_cal_sens_map_l.Cxx_dtc_obd_xxx /end CHARACTERISTIC
/begin CHARACTERISTIC Cxx_conf_wal_sens_map_l "" VALUE 0xa002b0dc _REC_S1VAL_20_u1 3. _CNV_A_R_A_105_CM 0. 3. DISPLAY_IDENTIFIER fm_cal_sens_map_l.fm_static_bitfield.Cxx_conf_wal_xxx BIT_MASK 0x3 /end CHARACTERISTIC
/begin CHARACTERISTIC Cbx_obd_sens_map_l "" VALUE 0xa002b0dc _REC_S1VAL_20_u1 255. _CNV_A_R_A_105_CM 0. 255. DISPLAY_IDENTIFIER fm_cal_sens_map_l.fm_static_bitfield.Cbx_obd_xxx BIT_MASK 0x4 /end CHARACTERISTIC
/begin CHARACTERISTIC Cbx_obd_mena_sens_map_l "" VALUE 0xa002b0dc _REC_S1VAL_20_u1 255. _CNV_A_R_A_105_CM 0. 255. DISPLAY_IDENTIFIER fm_cal_sens_map_l.fm_static_bitfield.Cbx_obd_mena_xxx BIT_MASK 0x8 /end CHARACTERISTIC
/begin CHARACTERISTIC Cxx_dtc_lb_sens_map_l "" VALUE 0xa002b0dd _REC_S1VAL_20_u1 255. _CNV_A_R_A_105_CM 0. 255. DISPLAY_IDENTIFIER fm_cal_sens_map_l.Cxx_dtc_lb_xxx /end CHARACTERISTIC
/begin CHARACTERISTIC Cxx_obd_dc_sens_map_l "" VALUE 0xa002b0de _REC_S1VAL_20_u1 9. _CNV_A_R_A_105_CM 1. 10. DISPLAY_IDENTIFIER fm_cal_sens_map_l.Cxx_obd_dc_xxx /end CHARACTERISTIC
/begin CHARACTERISTIC Cxx_obd_us_typ_sens_map_l "" VALUE 0xa002b0df _REC_S1VAL_20_u1 255. _CNV_A_R_A_105_CM 0. 255. DISPLAY_IDENTIFIER fm_cal_sens_map_l.Cxx_obd_us_typ_xxx /end CHARACTERISTIC
/begin CHARACTERISTIC Cxx_dtc_obd_sens_mat_h "" VALUE 0xa002b182 _REC_S1VAL_20_u2 65535. _CNV_A_R_A_105_CM 0. 65535. DISPLAY_IDENTIFIER fm_cal_sens_mat_h.Cxx_dtc_obd_xxx /end CHARACTERISTIC
/begin CHARACTERISTIC Cxx_conf_wal_sens_mat_h "" VALUE 0xa002b184 _REC_S1VAL_20_u1 3. _CNV_A_R_A_105_CM 0. 3. DISPLAY_IDENTIFIER fm_cal_sens_mat_h.fm_static_bitfield.Cxx_conf_wal_xxx BIT_MASK 0x3 /end CHARACTERISTIC
/begin CHARACTERISTIC Cbx_obd_sens_mat_h "" VALUE 0xa002b184 _REC_S1VAL_20_u1 255. _CNV_A_R_A_105_CM 0. 255. DISPLAY_IDENTIFIER fm_cal_sens_mat_h.fm_static_bitfield.Cbx_obd_xxx BIT_MASK 0x4 /end CHARACTERISTIC
/begin CHARACTERISTIC Cbx_obd_mena_sens_mat_h "" VALUE 0xa002b184 _REC_S1VAL_20_u1 255. _CNV_A_R_A_105_CM 0. 255. DISPLAY_IDENTIFIER fm_cal_sens_mat_h.fm_static_bitfield.Cbx_obd_mena_xxx BIT_MASK 0x8 /end CHARACTERISTIC
/begin CHARACTERISTIC Cxx_dtc_lb_sens_mat_h "" VALUE 0xa002b185 _REC_S1VAL_20_u1 255. _CNV_A_R_A_105_CM 0. 255. DISPLAY_IDENTIFIER fm_cal_sens_mat_h.Cxx_dtc_lb_xxx /end CHARACTERISTIC
/begin CHARACTERISTIC Cxx_obd_dc_sens_mat_h "" VALUE 0xa002b186 _REC_S1VAL_20_u1 9. _CNV_A_R_A_105_CM 1. 10. DISPLAY_IDENTIFIER fm_cal_sens_mat_h.Cxx_obd_dc_xxx /end CHARACTERISTIC
/begin CHARACTERISTIC Cxx_obd_us_typ_sens_mat_h "" VALUE 0xa002b187 _REC_S1VAL_20_u1 255. _CNV_A_R_A_105_CM 0. 255. DISPLAY_IDENTIFIER fm_cal_sens_mat_h.Cxx_obd_us_typ_xxx /end CHARACTERISTIC
/begin CHARACTERISTIC Cxx_dtc_obd_sens_mat_l "" VALUE 0xa002b18e _REC_S1VAL_20_u2 65535. _CNV_A_R_A_105_CM 0. 65535. DISPLAY_IDENTIFIER fm_cal_sens_mat_l.Cxx_dtc_obd_xxx /end CHARACTERISTIC
/begin CHARACTERISTIC Cxx_conf_wal_sens_mat_l "" VALUE 0xa002b190 _REC_S1VAL_20_u1 3. _CNV_A_R_A_105_CM 0. 3. DISPLAY_IDENTIFIER fm_cal_sens_mat_l.fm_static_bitfield.Cxx_conf_wal_xxx BIT_MASK 0x3 /end CHARACTERISTIC
/begin CHARACTERISTIC Cbx_obd_sens_mat_l "" VALUE 0xa002b190 _REC_S1VAL_20_u1 255. _CNV_A_R_A_105_CM 0. 255. DISPLAY_IDENTIFIER fm_cal_sens_mat_l.fm_static_bitfield.Cbx_obd_xxx BIT_MASK 0x4 /end CHARACTERISTIC
/begin CHARACTERISTIC Cbx_obd_mena_sens_mat_l "" VALUE 0xa002b190 _REC_S1VAL_20_u1 255. _CNV_A_R_A_105_CM 0. 255. DISPLAY_IDENTIFIER fm_cal_sens_mat_l.fm_static_bitfield.Cbx_obd_mena_xxx BIT_MASK 0x8 /end CHARACTERISTIC
/begin CHARACTERISTIC Cxx_dtc_lb_sens_mat_l "" VALUE 0xa002b191 _REC_S1VAL_20_u1 255. _CNV_A_R_A_105_CM 0. 255. DISPLAY_IDENTIFIER fm_cal_sens_mat_l.Cxx_dtc_lb_xxx /end CHARACTERISTIC
/begin CHARACTERISTIC Cxx_obd_dc_sens_mat_l "" VALUE 0xa002b192 _REC_S1VAL_20_u1 9. _CNV_A_R_A_105_CM 1. 10. DISPLAY_IDENTIFIER fm_cal_sens_mat_l.Cxx_obd_dc_xxx /end CHARACTERISTIC
/begin CHARACTERISTIC Cxx_obd_us_typ_sens_mat_l "" VALUE 0xa002b193 _REC_S1VAL_20_u1 255. _CNV_A_R_A_105_CM 0. 255. DISPLAY_IDENTIFIER fm_cal_sens_mat_l.Cxx_obd_us_typ_xxx /end CHARACTERISTIC
/begin CHARACTERISTIC Cxx_dtc_obd_sens_rvc_h "" VALUE 0xa002b61a _REC_S1VAL_20_u2 65535. _CNV_A_R_A_105_CM 0. 65535. DISPLAY_IDENTIFIER fm_cal_sens_rvc_h.Cxx_dtc_obd_xxx /end CHARACTERISTIC
/begin CHARACTERISTIC Cxx_conf_wal_sens_rvc_h "" VALUE 0xa002b61c _REC_S1VAL_20_u1 3. _CNV_A_R_A_105_CM 0. 3. DISPLAY_IDENTIFIER fm_cal_sens_rvc_h.fm_static_bitfield.Cxx_conf_wal_xxx BIT_MASK 0x3 /end CHARACTERISTIC
/begin CHARACTERISTIC Cbx_obd_sens_rvc_h "" VALUE 0xa002b61c _REC_S1VAL_20_u1 255. _CNV_A_R_A_105_CM 0. 255. DISPLAY_IDENTIFIER fm_cal_sens_rvc_h.fm_static_bitfield.Cbx_obd_xxx BIT_MASK 0x4 /end CHARACTERISTIC
/begin CHARACTERISTIC Cbx_obd_mena_sens_rvc_h "" VALUE 0xa002b61c _REC_S1VAL_20_u1 255. _CNV_A_R_A_105_CM 0. 255. DISPLAY_IDENTIFIER fm_cal_sens_rvc_h.fm_static_bitfield.Cbx_obd_mena_xxx BIT_MASK 0x8 /end CHARACTERISTIC
/begin CHARACTERISTIC Cxx_dtc_lb_sens_rvc_h "" VALUE 0xa002b61d _REC_S1VAL_20_u1 255. _CNV_A_R_A_105_CM 0. 255. DISPLAY_IDENTIFIER fm_cal_sens_rvc_h.Cxx_dtc_lb_xxx /end CHARACTERISTIC
/begin CHARACTERISTIC Cxx_obd_dc_sens_rvc_h "" VALUE 0xa002b61e _REC_S1VAL_20_u1 9. _CNV_A_R_A_105_CM 1. 10. DISPLAY_IDENTIFIER fm_cal_sens_rvc_h.Cxx_obd_dc_xxx /end CHARACTERISTIC
/begin CHARACTERISTIC Cxx_obd_us_typ_sens_rvc_h "" VALUE 0xa002b61f _REC_S1VAL_20_u1 255. _CNV_A_R_A_105_CM 0. 255. DISPLAY_IDENTIFIER fm_cal_sens_rvc_h.Cxx_obd_us_typ_xxx /end CHARACTERISTIC
/begin CHARACTERISTIC Cxx_dtc_obd_sens_rvc_l "" VALUE 0xa002b626 _REC_S1VAL_20_u2 65535. _CNV_A_R_A_105_CM 0. 65535. DISPLAY_IDENTIFIER fm_cal_sens_rvc_l.Cxx_dtc_obd_xxx /end CHARACTERISTIC
/begin CHARACTERISTIC Cxx_conf_wal_sens_rvc_l "" VALUE 0xa002b628 _REC_S1VAL_20_u1 3. _CNV_A_R_A_105_CM 0. 3. DISPLAY_IDENTIFIER fm_cal_sens_rvc_l.fm_static_bitfield.Cxx_conf_wal_xxx BIT_MASK 0x3 /end CHARACTERISTIC
/begin CHARACTERISTIC Cbx_obd_sens_rvc_l "" VALUE 0xa002b628 _REC_S1VAL_20_u1 255. _CNV_A_R_A_105_CM 0. 255. DISPLAY_IDENTIFIER fm_cal_sens_rvc_l.fm_static_bitfield.Cbx_obd_xxx BIT_MASK 0x4 /end CHARACTERISTIC
/begin CHARACTERISTIC Cbx_obd_mena_sens_rvc_l "" VALUE 0xa002b628 _REC_S1VAL_20_u1 255. _CNV_A_R_A_105_CM 0. 255. DISPLAY_IDENTIFIER fm_cal_sens_rvc_l.fm_static_bitfield.Cbx_obd_mena_xxx BIT_MASK 0x8 /end CHARACTERISTIC
/begin CHARACTERISTIC Cxx_dtc_lb_sens_rvc_l "" VALUE 0xa002b629 _REC_S1VAL_20_u1 255. _CNV_A_R_A_105_CM 0. 255. DISPLAY_IDENTIFIER fm_cal_sens_rvc_l.Cxx_dtc_lb_xxx /end CHARACTERISTIC
/begin CHARACTERISTIC Cxx_obd_dc_sens_rvc_l "" VALUE 0xa002b62a _REC_S1VAL_20_u1 9. _CNV_A_R_A_105_CM 1. 10. DISPLAY_IDENTIFIER fm_cal_sens_rvc_l.Cxx_obd_dc_xxx /end CHARACTERISTIC
/begin CHARACTERISTIC Cxx_obd_us_typ_sens_rvc_l "" VALUE 0xa002b62b _REC_S1VAL_20_u1 255. _CNV_A_R_A_105_CM 0. 255. DISPLAY_IDENTIFIER fm_cal_sens_rvc_l.Cxx_obd_us_typ_xxx /end CHARACTERISTIC
/begin CHARACTERISTIC Cxx_dtc_obd_sens_rvc_nok "" VALUE 0xa002b632 _REC_S1VAL_20_u2 65535. _CNV_A_R_A_105_CM 0. 65535. DISPLAY_IDENTIFIER fm_cal_sens_rvc_nok.Cxx_dtc_obd_xxx /end CHARACTERISTIC
/begin CHARACTERISTIC Cxx_conf_wal_sens_rvc_nok "" VALUE 0xa002b634 _REC_S1VAL_20_u1 3. _CNV_A_R_A_105_CM 0. 3. DISPLAY_IDENTIFIER fm_cal_sens_rvc_nok.fm_static_bitfield.Cxx_conf_wal_xxx BIT_MASK 0x3 /end CHARACTERISTIC
/begin CHARACTERISTIC Cbx_obd_sens_rvc_nok "" VALUE 0xa002b634 _REC_S1VAL_20_u1 255. _CNV_A_R_A_105_CM 0. 255. DISPLAY_IDENTIFIER fm_cal_sens_rvc_nok.fm_static_bitfield.Cbx_obd_xxx BIT_MASK 0x4 /end CHARACTERISTIC
/begin CHARACTERISTIC Cbx_obd_mena_sens_rvc_nok "" VALUE 0xa002b634 _REC_S1VAL_20_u1 255. _CNV_A_R_A_105_CM 0. 255. DISPLAY_IDENTIFIER fm_cal_sens_rvc_nok.fm_static_bitfield.Cbx_obd_mena_xxx BIT_MASK 0x8 /end CHARACTERISTIC
/begin CHARACTERISTIC Cxx_dtc_lb_sens_rvc_nok "" VALUE 0xa002b635 _REC_S1VAL_20_u1 255. _CNV_A_R_A_105_CM 0. 255. DISPLAY_IDENTIFIER fm_cal_sens_rvc_nok.Cxx_dtc_lb_xxx /end CHARACTERISTIC
/begin CHARACTERISTIC Cxx_obd_dc_sens_rvc_nok "" VALUE 0xa002b636 _REC_S1VAL_20_u1 9. _CNV_A_R_A_105_CM 1. 10. DISPLAY_IDENTIFIER fm_cal_sens_rvc_nok.Cxx_obd_dc_xxx /end CHARACTERISTIC
/begin CHARACTERISTIC Cxx_obd_us_typ_sens_rvc_nok "" VALUE 0xa002b637 _REC_S1VAL_20_u1 255. _CNV_A_R_A_105_CM 0. 255. DISPLAY_IDENTIFIER fm_cal_sens_rvc_nok.Cxx_obd_us_typ_xxx /end CHARACTERISTIC
/begin CHARACTERISTIC Cxx_dtc_obd_sens_rvc_sig_mcut "" VALUE 0xa002b63e _REC_S1VAL_20_u2 65535. _CNV_A_R_A_105_CM 0. 65535. DISPLAY_IDENTIFIER fm_cal_sens_rvc_sig_mcut.Cxx_dtc_obd_xxx /end CHARACTERISTIC
/begin CHARACTERISTIC Cxx_conf_wal_sens_rvc_sig_mcut "" VALUE 0xa002b640 _REC_S1VAL_20_u1 3. _CNV_A_R_A_105_CM 0. 3. DISPLAY_IDENTIFIER fm_cal_sens_rvc_sig_mcut.fm_static_bitfield.Cxx_conf_wal_xxx BIT_MASK 0x3 /end CHARACTERISTIC
/begin CHARACTERISTIC Cbx_obd_sens_rvc_sig_mcut "" VALUE 0xa002b640 _REC_S1VAL_20_u1 255. _CNV_A_R_A_105_CM 0. 255. DISPLAY_IDENTIFIER fm_cal_sens_rvc_sig_mcut.fm_static_bitfield.Cbx_obd_xxx BIT_MASK 0x4 /end CHARACTERISTIC
/begin CHARACTERISTIC Cbx_obd_mena_sens_rvc_sig_mcut "" VALUE 0xa002b640 _REC_S1VAL_20_u1 255. _CNV_A_R_A_105_CM 0. 255. DISPLAY_IDENTIFIER fm_cal_sens_rvc_sig_mcut.fm_static_bitfield.Cbx_obd_mena_xxx BIT_MASK 0x8 /end CHARACTERISTIC
/begin CHARACTERISTIC Cxx_dtc_lb_sens_rvc_sig_mcut "" VALUE 0xa002b641 _REC_S1VAL_20_u1 255. _CNV_A_R_A_105_CM 0. 255. DISPLAY_IDENTIFIER fm_cal_sens_rvc_sig_mcut.Cxx_dtc_lb_xxx /end CHARACTERISTIC
/begin CHARACTERISTIC Cxx_obd_dc_sens_rvc_sig_mcut "" VALUE 0xa002b642 _REC_S1VAL_20_u1 9. _CNV_A_R_A_105_CM 1. 10. DISPLAY_IDENTIFIER fm_cal_sens_rvc_sig_mcut.Cxx_obd_dc_xxx /end CHARACTERISTIC
/begin CHARACTERISTIC Cxx_obd_us_typ_sens_rvc_sig_mcut "" VALUE 0xa002b643 _REC_S1VAL_20_u1 255. _CNV_A_R_A_105_CM 0. 255. DISPLAY_IDENTIFIER fm_cal_sens_rvc_sig_mcut.Cxx_obd_us_typ_xxx /end CHARACTERISTIC
/begin CHARACTERISTIC Cxx_dtc_obd_sens_spg_h "" VALUE 0xa002b0e6 _REC_S1VAL_20_u2 65535. _CNV_A_R_A_105_CM 0. 65535. DISPLAY_IDENTIFIER fm_cal_sens_spg_h.Cxx_dtc_obd_xxx /end CHARACTERISTIC
/begin CHARACTERISTIC Cxx_conf_wal_sens_spg_h "" VALUE 0xa002b0e8 _REC_S1VAL_20_u1 3. _CNV_A_R_A_105_CM 0. 3. DISPLAY_IDENTIFIER fm_cal_sens_spg_h.fm_static_bitfield.Cxx_conf_wal_xxx BIT_MASK 0x3 /end CHARACTERISTIC
/begin CHARACTERISTIC Cbx_obd_sens_spg_h "" VALUE 0xa002b0e8 _REC_S1VAL_20_u1 255. _CNV_A_R_A_105_CM 0. 255. DISPLAY_IDENTIFIER fm_cal_sens_spg_h.fm_static_bitfield.Cbx_obd_xxx BIT_MASK 0x4 /end CHARACTERISTIC
/begin CHARACTERISTIC Cbx_obd_mena_sens_spg_h "" VALUE 0xa002b0e8 _REC_S1VAL_20_u1 255. _CNV_A_R_A_105_CM 0. 255. DISPLAY_IDENTIFIER fm_cal_sens_spg_h.fm_static_bitfield.Cbx_obd_mena_xxx BIT_MASK 0x8 /end CHARACTERISTIC
/begin CHARACTERISTIC Cxx_dtc_lb_sens_spg_h "" VALUE 0xa002b0e9 _REC_S1VAL_20_u1 255. _CNV_A_R_A_105_CM 0. 255. DISPLAY_IDENTIFIER fm_cal_sens_spg_h.Cxx_dtc_lb_xxx /end CHARACTERISTIC
/begin CHARACTERISTIC Cxx_obd_dc_sens_spg_h "" VALUE 0xa002b0ea _REC_S1VAL_20_u1 9. _CNV_A_R_A_105_CM 1. 10. DISPLAY_IDENTIFIER fm_cal_sens_spg_h.Cxx_obd_dc_xxx /end CHARACTERISTIC
/begin CHARACTERISTIC Cxx_obd_us_typ_sens_spg_h "" VALUE 0xa002b0eb _REC_S1VAL_20_u1 255. _CNV_A_R_A_105_CM 0. 255. DISPLAY_IDENTIFIER fm_cal_sens_spg_h.Cxx_obd_us_typ_xxx /end CHARACTERISTIC
/begin CHARACTERISTIC Cxx_dtc_obd_sens_spg_l "" VALUE 0xa002b0f2 _REC_S1VAL_20_u2 65535. _CNV_A_R_A_105_CM 0. 65535. DISPLAY_IDENTIFIER fm_cal_sens_spg_l.Cxx_dtc_obd_xxx /end CHARACTERISTIC
/begin CHARACTERISTIC Cxx_conf_wal_sens_spg_l "" VALUE 0xa002b0f4 _REC_S1VAL_20_u1 3. _CNV_A_R_A_105_CM 0. 3. DISPLAY_IDENTIFIER fm_cal_sens_spg_l.fm_static_bitfield.Cxx_conf_wal_xxx BIT_MASK 0x3 /end CHARACTERISTIC
/begin CHARACTERISTIC Cbx_obd_sens_spg_l "" VALUE 0xa002b0f4 _REC_S1VAL_20_u1 255. _CNV_A_R_A_105_CM 0. 255. DISPLAY_IDENTIFIER fm_cal_sens_spg_l.fm_static_bitfield.Cbx_obd_xxx BIT_MASK 0x4 /end CHARACTERISTIC
/begin CHARACTERISTIC Cbx_obd_mena_sens_spg_l "" VALUE 0xa002b0f4 _REC_S1VAL_20_u1 255. _CNV_A_R_A_105_CM 0. 255. DISPLAY_IDENTIFIER fm_cal_sens_spg_l.fm_static_bitfield.Cbx_obd_mena_xxx BIT_MASK 0x8 /end CHARACTERISTIC
/begin CHARACTERISTIC Cxx_dtc_lb_sens_spg_l "" VALUE 0xa002b0f5 _REC_S1VAL_20_u1 255. _CNV_A_R_A_105_CM 0. 255. DISPLAY_IDENTIFIER fm_cal_sens_spg_l.Cxx_dtc_lb_xxx /end CHARACTERISTIC
/begin CHARACTERISTIC Cxx_obd_dc_sens_spg_l "" VALUE 0xa002b0f6 _REC_S1VAL_20_u1 9. _CNV_A_R_A_105_CM 1. 10. DISPLAY_IDENTIFIER fm_cal_sens_spg_l.Cxx_obd_dc_xxx /end CHARACTERISTIC
/begin CHARACTERISTIC Cxx_obd_us_typ_sens_spg_l "" VALUE 0xa002b0f7 _REC_S1VAL_20_u1 255. _CNV_A_R_A_105_CM 0. 255. DISPLAY_IDENTIFIER fm_cal_sens_spg_l.Cxx_obd_us_typ_xxx /end CHARACTERISTIC
/begin CHARACTERISTIC Cxx_dtc_obd_sens_tco_h "" VALUE 0xa002b0fe _REC_S1VAL_20_u2 65535. _CNV_A_R_A_105_CM 0. 65535. DISPLAY_IDENTIFIER fm_cal_sens_tco_h.Cxx_dtc_obd_xxx /end CHARACTERISTIC
/begin CHARACTERISTIC Cxx_conf_wal_sens_tco_h "" VALUE 0xa002b100 _REC_S1VAL_20_u1 3. _CNV_A_R_A_105_CM 0. 3. DISPLAY_IDENTIFIER fm_cal_sens_tco_h.fm_static_bitfield.Cxx_conf_wal_xxx BIT_MASK 0x3 /end CHARACTERISTIC
/begin CHARACTERISTIC Cbx_obd_sens_tco_h "" VALUE 0xa002b100 _REC_S1VAL_20_u1 255. _CNV_A_R_A_105_CM 0. 255. DISPLAY_IDENTIFIER fm_cal_sens_tco_h.fm_static_bitfield.Cbx_obd_xxx BIT_MASK 0x4 /end CHARACTERISTIC
/begin CHARACTERISTIC Cbx_obd_mena_sens_tco_h "" VALUE 0xa002b100 _REC_S1VAL_20_u1 255. _CNV_A_R_A_105_CM 0. 255. DISPLAY_IDENTIFIER fm_cal_sens_tco_h.fm_static_bitfield.Cbx_obd_mena_xxx BIT_MASK 0x8 /end CHARACTERISTIC
/begin CHARACTERISTIC Cxx_dtc_lb_sens_tco_h "" VALUE 0xa002b101 _REC_S1VAL_20_u1 255. _CNV_A_R_A_105_CM 0. 255. DISPLAY_IDENTIFIER fm_cal_sens_tco_h.Cxx_dtc_lb_xxx /end CHARACTERISTIC
/begin CHARACTERISTIC Cxx_obd_dc_sens_tco_h "" VALUE 0xa002b102 _REC_S1VAL_20_u1 9. _CNV_A_R_A_105_CM 1. 10. DISPLAY_IDENTIFIER fm_cal_sens_tco_h.Cxx_obd_dc_xxx /end CHARACTERISTIC
/begin CHARACTERISTIC Cxx_obd_us_typ_sens_tco_h "" VALUE 0xa002b103 _REC_S1VAL_20_u1 255. _CNV_A_R_A_105_CM 0. 255. DISPLAY_IDENTIFIER fm_cal_sens_tco_h.Cxx_obd_us_typ_xxx /end CHARACTERISTIC
/begin CHARACTERISTIC Cxx_dtc_obd_sens_tco_l "" VALUE 0xa002b10a _REC_S1VAL_20_u2 65535. _CNV_A_R_A_105_CM 0. 65535. DISPLAY_IDENTIFIER fm_cal_sens_tco_l.Cxx_dtc_obd_xxx /end CHARACTERISTIC
/begin CHARACTERISTIC Cxx_conf_wal_sens_tco_l "" VALUE 0xa002b10c _REC_S1VAL_20_u1 3. _CNV_A_R_A_105_CM 0. 3. DISPLAY_IDENTIFIER fm_cal_sens_tco_l.fm_static_bitfield.Cxx_conf_wal_xxx BIT_MASK 0x3 /end CHARACTERISTIC
/begin CHARACTERISTIC Cbx_obd_sens_tco_l "" VALUE 0xa002b10c _REC_S1VAL_20_u1 255. _CNV_A_R_A_105_CM 0. 255. DISPLAY_IDENTIFIER fm_cal_sens_tco_l.fm_static_bitfield.Cbx_obd_xxx BIT_MASK 0x4 /end CHARACTERISTIC
/begin CHARACTERISTIC Cbx_obd_mena_sens_tco_l "" VALUE 0xa002b10c _REC_S1VAL_20_u1 255. _CNV_A_R_A_105_CM 0. 255. DISPLAY_IDENTIFIER fm_cal_sens_tco_l.fm_static_bitfield.Cbx_obd_mena_xxx BIT_MASK 0x8 /end CHARACTERISTIC
/begin CHARACTERISTIC Cxx_dtc_lb_sens_tco_l "" VALUE 0xa002b10d _REC_S1VAL_20_u1 255. _CNV_A_R_A_105_CM 0. 255. DISPLAY_IDENTIFIER fm_cal_sens_tco_l.Cxx_dtc_lb_xxx /end CHARACTERISTIC
/begin CHARACTERISTIC Cxx_obd_dc_sens_tco_l "" VALUE 0xa002b10e _REC_S1VAL_20_u1 9. _CNV_A_R_A_105_CM 1. 10. DISPLAY_IDENTIFIER fm_cal_sens_tco_l.Cxx_obd_dc_xxx /end CHARACTERISTIC
/begin CHARACTERISTIC Cxx_obd_us_typ_sens_tco_l "" VALUE 0xa002b10f _REC_S1VAL_20_u1 255. _CNV_A_R_A_105_CM 0. 255. DISPLAY_IDENTIFIER fm_cal_sens_tco_l.Cxx_obd_us_typ_xxx /end CHARACTERISTIC
/begin CHARACTERISTIC Cxx_dtc_obd_sens_tco_sig_mcut "" VALUE 0xa002b566 _REC_S1VAL_20_u2 65535. _CNV_A_R_A_105_CM 0. 65535. DISPLAY_IDENTIFIER fm_cal_sens_tco_sig_mcut.Cxx_dtc_obd_xxx /end CHARACTERISTIC
/begin CHARACTERISTIC Cxx_conf_wal_sens_tco_sig_mcut "" VALUE 0xa002b568 _REC_S1VAL_20_u1 3. _CNV_A_R_A_105_CM 0. 3. DISPLAY_IDENTIFIER fm_cal_sens_tco_sig_mcut.fm_static_bitfield.Cxx_conf_wal_xxx BIT_MASK 0x3 /end CHARACTERISTIC
/begin CHARACTERISTIC Cbx_obd_sens_tco_sig_mcut "" VALUE 0xa002b568 _REC_S1VAL_20_u1 255. _CNV_A_R_A_105_CM 0. 255. DISPLAY_IDENTIFIER fm_cal_sens_tco_sig_mcut.fm_static_bitfield.Cbx_obd_xxx BIT_MASK 0x4 /end CHARACTERISTIC
/begin CHARACTERISTIC Cbx_obd_mena_sens_tco_sig_mcut "" VALUE 0xa002b568 _REC_S1VAL_20_u1 255. _CNV_A_R_A_105_CM 0. 255. DISPLAY_IDENTIFIER fm_cal_sens_tco_sig_mcut.fm_static_bitfield.Cbx_obd_mena_xxx BIT_MASK 0x8 /end CHARACTERISTIC
/begin CHARACTERISTIC Cxx_dtc_lb_sens_tco_sig_mcut "" VALUE 0xa002b569 _REC_S1VAL_20_u1 255. _CNV_A_R_A_105_CM 0. 255. DISPLAY_IDENTIFIER fm_cal_sens_tco_sig_mcut.Cxx_dtc_lb_xxx /end CHARACTERISTIC
/begin CHARACTERISTIC Cxx_obd_dc_sens_tco_sig_mcut "" VALUE 0xa002b56a _REC_S1VAL_20_u1 9. _CNV_A_R_A_105_CM 1. 10. DISPLAY_IDENTIFIER fm_cal_sens_tco_sig_mcut.Cxx_obd_dc_xxx /end CHARACTERISTIC
/begin CHARACTERISTIC Cxx_obd_us_typ_sens_tco_sig_mcut "" VALUE 0xa002b56b _REC_S1VAL_20_u1 255. _CNV_A_R_A_105_CM 0. 255. DISPLAY_IDENTIFIER fm_cal_sens_tco_sig_mcut.Cxx_obd_us_typ_xxx /end CHARACTERISTIC
/begin CHARACTERISTIC Cxx_dtc_obd_sfty_tq_chr "" VALUE 0xa002b476 _REC_S1VAL_20_u2 65535. _CNV_A_R_A_105_CM 0. 65535. DISPLAY_IDENTIFIER fm_cal_sfty_tq_chr.Cxx_dtc_obd_xxx /end CHARACTERISTIC
/begin CHARACTERISTIC Cxx_conf_wal_sfty_tq_chr "" VALUE 0xa002b478 _REC_S1VAL_20_u1 3. _CNV_A_R_A_105_CM 0. 3. DISPLAY_IDENTIFIER fm_cal_sfty_tq_chr.fm_static_bitfield.Cxx_conf_wal_xxx BIT_MASK 0x3 /end CHARACTERISTIC
/begin CHARACTERISTIC Cbx_obd_sfty_tq_chr "" VALUE 0xa002b478 _REC_S1VAL_20_u1 255. _CNV_A_R_A_105_CM 0. 255. DISPLAY_IDENTIFIER fm_cal_sfty_tq_chr.fm_static_bitfield.Cbx_obd_xxx BIT_MASK 0x4 /end CHARACTERISTIC
/begin CHARACTERISTIC Cbx_obd_mena_sfty_tq_chr "" VALUE 0xa002b478 _REC_S1VAL_20_u1 255. _CNV_A_R_A_105_CM 0. 255. DISPLAY_IDENTIFIER fm_cal_sfty_tq_chr.fm_static_bitfield.Cbx_obd_mena_xxx BIT_MASK 0x8 /end CHARACTERISTIC
/begin CHARACTERISTIC Cxx_dtc_lb_sfty_tq_chr "" VALUE 0xa002b479 _REC_S1VAL_20_u1 255. _CNV_A_R_A_105_CM 0. 255. DISPLAY_IDENTIFIER fm_cal_sfty_tq_chr.Cxx_dtc_lb_xxx /end CHARACTERISTIC
/begin CHARACTERISTIC Cxx_obd_dc_sfty_tq_chr "" VALUE 0xa002b47a _REC_S1VAL_20_u1 9. _CNV_A_R_A_105_CM 1. 10. DISPLAY_IDENTIFIER fm_cal_sfty_tq_chr.Cxx_obd_dc_xxx /end CHARACTERISTIC
/begin CHARACTERISTIC Cxx_obd_us_typ_sfty_tq_chr "" VALUE 0xa002b47b _REC_S1VAL_20_u1 255. _CNV_A_R_A_105_CM 0. 255. DISPLAY_IDENTIFIER fm_cal_sfty_tq_chr.Cxx_obd_us_typ_xxx /end CHARACTERISTIC
/begin CHARACTERISTIC Cxx_dtc_obd_sfty_tq_clc_chr "" VALUE 0xa002b482 _REC_S1VAL_20_u2 65535. _CNV_A_R_A_105_CM 0. 65535. DISPLAY_IDENTIFIER fm_cal_sfty_tq_clc_chr.Cxx_dtc_obd_xxx /end CHARACTERISTIC
/begin CHARACTERISTIC Cxx_conf_wal_sfty_tq_clc_chr "" VALUE 0xa002b484 _REC_S1VAL_20_u1 3. _CNV_A_R_A_105_CM 0. 3. DISPLAY_IDENTIFIER fm_cal_sfty_tq_clc_chr.fm_static_bitfield.Cxx_conf_wal_xxx BIT_MASK 0x3 /end CHARACTERISTIC
/begin CHARACTERISTIC Cbx_obd_sfty_tq_clc_chr "" VALUE 0xa002b484 _REC_S1VAL_20_u1 255. _CNV_A_R_A_105_CM 0. 255. DISPLAY_IDENTIFIER fm_cal_sfty_tq_clc_chr.fm_static_bitfield.Cbx_obd_xxx BIT_MASK 0x4 /end CHARACTERISTIC
/begin CHARACTERISTIC Cbx_obd_mena_sfty_tq_clc_chr "" VALUE 0xa002b484 _REC_S1VAL_20_u1 255. _CNV_A_R_A_105_CM 0. 255. DISPLAY_IDENTIFIER fm_cal_sfty_tq_clc_chr.fm_static_bitfield.Cbx_obd_mena_xxx BIT_MASK 0x8 /end CHARACTERISTIC
/begin CHARACTERISTIC Cxx_dtc_lb_sfty_tq_clc_chr "" VALUE 0xa002b485 _REC_S1VAL_20_u1 255. _CNV_A_R_A_105_CM 0. 255. DISPLAY_IDENTIFIER fm_cal_sfty_tq_clc_chr.Cxx_dtc_lb_xxx /end CHARACTERISTIC
/begin CHARACTERISTIC Cxx_obd_dc_sfty_tq_clc_chr "" VALUE 0xa002b486 _REC_S1VAL_20_u1 9. _CNV_A_R_A_105_CM 1. 10. DISPLAY_IDENTIFIER fm_cal_sfty_tq_clc_chr.Cxx_obd_dc_xxx /end CHARACTERISTIC
/begin CHARACTERISTIC Cxx_obd_us_typ_sfty_tq_clc_chr "" VALUE 0xa002b487 _REC_S1VAL_20_u1 255. _CNV_A_R_A_105_CM 0. 255. DISPLAY_IDENTIFIER fm_cal_sfty_tq_clc_chr.Cxx_obd_us_typ_xxx /end CHARACTERISTIC
/begin CHARACTERISTIC Cxx_conf_wal_sfty_tq_lih_chr "" VALUE 0xa002b490 _REC_S1VAL_20_u1 3. _CNV_A_R_A_105_CM 0. 3. DISPLAY_IDENTIFIER fm_cal_sfty_tq_lih_chr.fm_static_bitfield.Cxx_conf_wal_xxx BIT_MASK 0x3 /end CHARACTERISTIC
/begin CHARACTERISTIC Cxx_dtc_lb_sfty_tq_lih_chr "" VALUE 0xa002b491 _REC_S1VAL_20_u1 255. _CNV_A_R_A_105_CM 0. 255. DISPLAY_IDENTIFIER fm_cal_sfty_tq_lih_chr.Cxx_dtc_lb_xxx /end CHARACTERISTIC
/begin CHARACTERISTIC Cxx_obd_us_typ_sfty_tq_lih_chr "" VALUE 0xa002b493 _REC_S1VAL_20_u1 255. _CNV_A_R_A_105_CM 0. 255. DISPLAY_IDENTIFIER fm_cal_sfty_tq_lih_chr.Cxx_obd_us_typ_xxx /end CHARACTERISTIC
/begin CHARACTERISTIC Cxx_dtc_obd_spg_oor "" VALUE 0xa002b3c2 _REC_S1VAL_20_u2 65535. _CNV_A_R_A_105_CM 0. 65535. DISPLAY_IDENTIFIER fm_cal_spg_oor.Cxx_dtc_obd_xxx /end CHARACTERISTIC
/begin CHARACTERISTIC Cxx_conf_wal_spg_oor "" VALUE 0xa002b3c4 _REC_S1VAL_20_u1 3. _CNV_A_R_A_105_CM 0. 3. DISPLAY_IDENTIFIER fm_cal_spg_oor.fm_static_bitfield.Cxx_conf_wal_xxx BIT_MASK 0x3 /end CHARACTERISTIC
/begin CHARACTERISTIC Cbx_obd_spg_oor "" VALUE 0xa002b3c4 _REC_S1VAL_20_u1 255. _CNV_A_R_A_105_CM 0. 255. DISPLAY_IDENTIFIER fm_cal_spg_oor.fm_static_bitfield.Cbx_obd_xxx BIT_MASK 0x4 /end CHARACTERISTIC
/begin CHARACTERISTIC Cbx_obd_mena_spg_oor "" VALUE 0xa002b3c4 _REC_S1VAL_20_u1 255. _CNV_A_R_A_105_CM 0. 255. DISPLAY_IDENTIFIER fm_cal_spg_oor.fm_static_bitfield.Cbx_obd_mena_xxx BIT_MASK 0x8 /end CHARACTERISTIC
/begin CHARACTERISTIC Cxx_dtc_lb_spg_oor "" VALUE 0xa002b3c5 _REC_S1VAL_20_u1 255. _CNV_A_R_A_105_CM 0. 255. DISPLAY_IDENTIFIER fm_cal_spg_oor.Cxx_dtc_lb_xxx /end CHARACTERISTIC
/begin CHARACTERISTIC Cxx_obd_dc_spg_oor "" VALUE 0xa002b3c6 _REC_S1VAL_20_u1 9. _CNV_A_R_A_105_CM 1. 10. DISPLAY_IDENTIFIER fm_cal_spg_oor.Cxx_obd_dc_xxx /end CHARACTERISTIC
/begin CHARACTERISTIC Cxx_obd_us_typ_spg_oor "" VALUE 0xa002b3c7 _REC_S1VAL_20_u1 255. _CNV_A_R_A_105_CM 0. 255. DISPLAY_IDENTIFIER fm_cal_spg_oor.Cxx_obd_us_typ_xxx /end CHARACTERISTIC
/begin CHARACTERISTIC Cxx_dtc_obd_spg_reg_apl_down "" VALUE 0xa002b116 _REC_S1VAL_20_u2 65535. _CNV_A_R_A_105_CM 0. 65535. DISPLAY_IDENTIFIER fm_cal_spg_reg_apl_down.Cxx_dtc_obd_xxx /end CHARACTERISTIC
/begin CHARACTERISTIC Cxx_conf_wal_spg_reg_apl_down "" VALUE 0xa002b118 _REC_S1VAL_20_u1 3. _CNV_A_R_A_105_CM 0. 3. DISPLAY_IDENTIFIER fm_cal_spg_reg_apl_down.fm_static_bitfield.Cxx_conf_wal_xxx BIT_MASK 0x3 /end CHARACTERISTIC
/begin CHARACTERISTIC Cbx_obd_spg_reg_apl_down "" VALUE 0xa002b118 _REC_S1VAL_20_u1 255. _CNV_A_R_A_105_CM 0. 255. DISPLAY_IDENTIFIER fm_cal_spg_reg_apl_down.fm_static_bitfield.Cbx_obd_xxx BIT_MASK 0x4 /end CHARACTERISTIC
/begin CHARACTERISTIC Cbx_obd_mena_spg_reg_apl_down "" VALUE 0xa002b118 _REC_S1VAL_20_u1 255. _CNV_A_R_A_105_CM 0. 255. DISPLAY_IDENTIFIER fm_cal_spg_reg_apl_down.fm_static_bitfield.Cbx_obd_mena_xxx BIT_MASK 0x8 /end CHARACTERISTIC
/begin CHARACTERISTIC Cxx_dtc_lb_spg_reg_apl_down "" VALUE 0xa002b119 _REC_S1VAL_20_u1 255. _CNV_A_R_A_105_CM 0. 255. DISPLAY_IDENTIFIER fm_cal_spg_reg_apl_down.Cxx_dtc_lb_xxx /end CHARACTERISTIC
/begin CHARACTERISTIC Cxx_obd_dc_spg_reg_apl_down "" VALUE 0xa002b11a _REC_S1VAL_20_u1 9. _CNV_A_R_A_105_CM 1. 10. DISPLAY_IDENTIFIER fm_cal_spg_reg_apl_down.Cxx_obd_dc_xxx /end CHARACTERISTIC
/begin CHARACTERISTIC Cxx_obd_us_typ_spg_reg_apl_down "" VALUE 0xa002b11b _REC_S1VAL_20_u1 255. _CNV_A_R_A_105_CM 0. 255. DISPLAY_IDENTIFIER fm_cal_spg_reg_apl_down.Cxx_obd_us_typ_xxx /end CHARACTERISTIC
/begin CHARACTERISTIC Cxx_dtc_obd_spg_reg_apl_up "" VALUE 0xa002b122 _REC_S1VAL_20_u2 65535. _CNV_A_R_A_105_CM 0. 65535. DISPLAY_IDENTIFIER fm_cal_spg_reg_apl_up.Cxx_dtc_obd_xxx /end CHARACTERISTIC
/begin CHARACTERISTIC Cxx_conf_wal_spg_reg_apl_up "" VALUE 0xa002b124 _REC_S1VAL_20_u1 3. _CNV_A_R_A_105_CM 0. 3. DISPLAY_IDENTIFIER fm_cal_spg_reg_apl_up.fm_static_bitfield.Cxx_conf_wal_xxx BIT_MASK 0x3 /end CHARACTERISTIC
/begin CHARACTERISTIC Cbx_obd_spg_reg_apl_up "" VALUE 0xa002b124 _REC_S1VAL_20_u1 255. _CNV_A_R_A_105_CM 0. 255. DISPLAY_IDENTIFIER fm_cal_spg_reg_apl_up.fm_static_bitfield.Cbx_obd_xxx BIT_MASK 0x4 /end CHARACTERISTIC
/begin CHARACTERISTIC Cbx_obd_mena_spg_reg_apl_up "" VALUE 0xa002b124 _REC_S1VAL_20_u1 255. _CNV_A_R_A_105_CM 0. 255. DISPLAY_IDENTIFIER fm_cal_spg_reg_apl_up.fm_static_bitfield.Cbx_obd_mena_xxx BIT_MASK 0x8 /end CHARACTERISTIC
/begin CHARACTERISTIC Cxx_dtc_lb_spg_reg_apl_up "" VALUE 0xa002b125 _REC_S1VAL_20_u1 255. _CNV_A_R_A_105_CM 0. 255. DISPLAY_IDENTIFIER fm_cal_spg_reg_apl_up.Cxx_dtc_lb_xxx /end CHARACTERISTIC
/begin CHARACTERISTIC Cxx_obd_dc_spg_reg_apl_up "" VALUE 0xa002b126 _REC_S1VAL_20_u1 9. _CNV_A_R_A_105_CM 1. 10. DISPLAY_IDENTIFIER fm_cal_spg_reg_apl_up.Cxx_obd_dc_xxx /end CHARACTERISTIC
/begin CHARACTERISTIC Cxx_obd_us_typ_spg_reg_apl_up "" VALUE 0xa002b127 _REC_S1VAL_20_u1 255. _CNV_A_R_A_105_CM 0. 255. DISPLAY_IDENTIFIER fm_cal_spg_reg_apl_up.Cxx_obd_us_typ_xxx /end CHARACTERISTIC
/begin CHARACTERISTIC Cxx_dtc_obd_tco_cl_no_norm "" VALUE 0xa002b6fe _REC_S1VAL_20_u2 65535. _CNV_A_R_A_105_CM 0. 65535. DISPLAY_IDENTIFIER fm_cal_tco_cl_no_norm.Cxx_dtc_obd_xxx /end CHARACTERISTIC
/begin CHARACTERISTIC Cxx_conf_wal_tco_cl_no_norm "" VALUE 0xa002b700 _REC_S1VAL_20_u1 3. _CNV_A_R_A_105_CM 0. 3. DISPLAY_IDENTIFIER fm_cal_tco_cl_no_norm.fm_static_bitfield.Cxx_conf_wal_xxx BIT_MASK 0x3 /end CHARACTERISTIC
/begin CHARACTERISTIC Cbx_obd_tco_cl_no_norm "" VALUE 0xa002b700 _REC_S1VAL_20_u1 255. _CNV_A_R_A_105_CM 0. 255. DISPLAY_IDENTIFIER fm_cal_tco_cl_no_norm.fm_static_bitfield.Cbx_obd_xxx BIT_MASK 0x4 /end CHARACTERISTIC
/begin CHARACTERISTIC Cbx_obd_mena_tco_cl_no_norm "" VALUE 0xa002b700 _REC_S1VAL_20_u1 255. _CNV_A_R_A_105_CM 0. 255. DISPLAY_IDENTIFIER fm_cal_tco_cl_no_norm.fm_static_bitfield.Cbx_obd_mena_xxx BIT_MASK 0x8 /end CHARACTERISTIC
/begin CHARACTERISTIC Cxx_dtc_lb_tco_cl_no_norm "" VALUE 0xa002b701 _REC_S1VAL_20_u1 255. _CNV_A_R_A_105_CM 0. 255. DISPLAY_IDENTIFIER fm_cal_tco_cl_no_norm.Cxx_dtc_lb_xxx /end CHARACTERISTIC
/begin CHARACTERISTIC Cxx_obd_dc_tco_cl_no_norm "" VALUE 0xa002b702 _REC_S1VAL_20_u1 9. _CNV_A_R_A_105_CM 1. 10. DISPLAY_IDENTIFIER fm_cal_tco_cl_no_norm.Cxx_obd_dc_xxx /end CHARACTERISTIC
/begin CHARACTERISTIC Cxx_obd_us_typ_tco_cl_no_norm "" VALUE 0xa002b703 _REC_S1VAL_20_u1 255. _CNV_A_R_A_105_CM 0. 255. DISPLAY_IDENTIFIER fm_cal_tco_cl_no_norm.Cxx_obd_us_typ_xxx /end CHARACTERISTIC
/begin CHARACTERISTIC Cxx_dtc_obd_tlz_ad_b_cpt "" VALUE 0xa002b3ce _REC_S1VAL_20_u2 65535. _CNV_A_R_A_105_CM 0. 65535. DISPLAY_IDENTIFIER fm_cal_tlz_ad_b_cpt.Cxx_dtc_obd_xxx /end CHARACTERISTIC
/begin CHARACTERISTIC Cxx_conf_wal_tlz_ad_b_cpt "" VALUE 0xa002b3d0 _REC_S1VAL_20_u1 3. _CNV_A_R_A_105_CM 0. 3. DISPLAY_IDENTIFIER fm_cal_tlz_ad_b_cpt.fm_static_bitfield.Cxx_conf_wal_xxx BIT_MASK 0x3 /end CHARACTERISTIC
/begin CHARACTERISTIC Cbx_obd_tlz_ad_b_cpt "" VALUE 0xa002b3d0 _REC_S1VAL_20_u1 255. _CNV_A_R_A_105_CM 0. 255. DISPLAY_IDENTIFIER fm_cal_tlz_ad_b_cpt.fm_static_bitfield.Cbx_obd_xxx BIT_MASK 0x4 /end CHARACTERISTIC
/begin CHARACTERISTIC Cbx_obd_mena_tlz_ad_b_cpt "" VALUE 0xa002b3d0 _REC_S1VAL_20_u1 255. _CNV_A_R_A_105_CM 0. 255. DISPLAY_IDENTIFIER fm_cal_tlz_ad_b_cpt.fm_static_bitfield.Cbx_obd_mena_xxx BIT_MASK 0x8 /end CHARACTERISTIC
/begin CHARACTERISTIC Cxx_dtc_lb_tlz_ad_b_cpt "" VALUE 0xa002b3d1 _REC_S1VAL_20_u1 255. _CNV_A_R_A_105_CM 0. 255. DISPLAY_IDENTIFIER fm_cal_tlz_ad_b_cpt.Cxx_dtc_lb_xxx /end CHARACTERISTIC
/begin CHARACTERISTIC Cxx_obd_dc_tlz_ad_b_cpt "" VALUE 0xa002b3d2 _REC_S1VAL_20_u1 9. _CNV_A_R_A_105_CM 1. 10. DISPLAY_IDENTIFIER fm_cal_tlz_ad_b_cpt.Cxx_obd_dc_xxx /end CHARACTERISTIC
/begin CHARACTERISTIC Cxx_obd_us_typ_tlz_ad_b_cpt "" VALUE 0xa002b3d3 _REC_S1VAL_20_u1 255. _CNV_A_R_A_105_CM 0. 255. DISPLAY_IDENTIFIER fm_cal_tlz_ad_b_cpt.Cxx_obd_us_typ_xxx /end CHARACTERISTIC
/begin CHARACTERISTIC Cxx_dtc_obd_tsta_reg_no_norm "" VALUE 0xa002b70a _REC_S1VAL_20_u2 65535. _CNV_A_R_A_105_CM 0. 65535. DISPLAY_IDENTIFIER fm_cal_tsta_reg_no_norm.Cxx_dtc_obd_xxx /end CHARACTERISTIC
/begin CHARACTERISTIC Cxx_conf_wal_tsta_reg_no_norm "" VALUE 0xa002b70c _REC_S1VAL_20_u1 3. _CNV_A_R_A_105_CM 0. 3. DISPLAY_IDENTIFIER fm_cal_tsta_reg_no_norm.fm_static_bitfield.Cxx_conf_wal_xxx BIT_MASK 0x3 /end CHARACTERISTIC
/begin CHARACTERISTIC Cbx_obd_tsta_reg_no_norm "" VALUE 0xa002b70c _REC_S1VAL_20_u1 255. _CNV_A_R_A_105_CM 0. 255. DISPLAY_IDENTIFIER fm_cal_tsta_reg_no_norm.fm_static_bitfield.Cbx_obd_xxx BIT_MASK 0x4 /end CHARACTERISTIC
/begin CHARACTERISTIC Cbx_obd_mena_tsta_reg_no_norm "" VALUE 0xa002b70c _REC_S1VAL_20_u1 255. _CNV_A_R_A_105_CM 0. 255. DISPLAY_IDENTIFIER fm_cal_tsta_reg_no_norm.fm_static_bitfield.Cbx_obd_mena_xxx BIT_MASK 0x8 /end CHARACTERISTIC
/begin CHARACTERISTIC Cxx_dtc_lb_tsta_reg_no_norm "" VALUE 0xa002b70d _REC_S1VAL_20_u1 255. _CNV_A_R_A_105_CM 0. 255. DISPLAY_IDENTIFIER fm_cal_tsta_reg_no_norm.Cxx_dtc_lb_xxx /end CHARACTERISTIC
/begin CHARACTERISTIC Cxx_obd_dc_tsta_reg_no_norm "" VALUE 0xa002b70e _REC_S1VAL_20_u1 9. _CNV_A_R_A_105_CM 1. 10. DISPLAY_IDENTIFIER fm_cal_tsta_reg_no_norm.Cxx_obd_dc_xxx /end CHARACTERISTIC
/begin CHARACTERISTIC Cxx_obd_us_typ_tsta_reg_no_norm "" VALUE 0xa002b70f _REC_S1VAL_20_u1 255. _CNV_A_R_A_105_CM 0. 255. DISPLAY_IDENTIFIER fm_cal_tsta_reg_no_norm.Cxx_obd_us_typ_xxx /end CHARACTERISTIC
/begin CHARACTERISTIC Cxx_dtc_obd_vb_clc_chr "" VALUE 0xa002b6da _REC_S1VAL_20_u2 65535. _CNV_A_R_A_105_CM 0. 65535. DISPLAY_IDENTIFIER fm_cal_vb_clc_chr.Cxx_dtc_obd_xxx /end CHARACTERISTIC
/begin CHARACTERISTIC Cxx_conf_wal_vb_clc_chr "" VALUE 0xa002b6dc _REC_S1VAL_20_u1 3. _CNV_A_R_A_105_CM 0. 3. DISPLAY_IDENTIFIER fm_cal_vb_clc_chr.fm_static_bitfield.Cxx_conf_wal_xxx BIT_MASK 0x3 /end CHARACTERISTIC
/begin CHARACTERISTIC Cbx_obd_vb_clc_chr "" VALUE 0xa002b6dc _REC_S1VAL_20_u1 255. _CNV_A_R_A_105_CM 0. 255. DISPLAY_IDENTIFIER fm_cal_vb_clc_chr.fm_static_bitfield.Cbx_obd_xxx BIT_MASK 0x4 /end CHARACTERISTIC
/begin CHARACTERISTIC Cbx_obd_mena_vb_clc_chr "" VALUE 0xa002b6dc _REC_S1VAL_20_u1 255. _CNV_A_R_A_105_CM 0. 255. DISPLAY_IDENTIFIER fm_cal_vb_clc_chr.fm_static_bitfield.Cbx_obd_mena_xxx BIT_MASK 0x8 /end CHARACTERISTIC
/begin CHARACTERISTIC Cxx_dtc_lb_vb_clc_chr "" VALUE 0xa002b6dd _REC_S1VAL_20_u1 255. _CNV_A_R_A_105_CM 0. 255. DISPLAY_IDENTIFIER fm_cal_vb_clc_chr.Cxx_dtc_lb_xxx /end CHARACTERISTIC
/begin CHARACTERISTIC Cxx_obd_dc_vb_clc_chr "" VALUE 0xa002b6de _REC_S1VAL_20_u1 9. _CNV_A_R_A_105_CM 1. 10. DISPLAY_IDENTIFIER fm_cal_vb_clc_chr.Cxx_obd_dc_xxx /end CHARACTERISTIC
/begin CHARACTERISTIC Cxx_obd_us_typ_vb_clc_chr "" VALUE 0xa002b6df _REC_S1VAL_20_u1 255. _CNV_A_R_A_105_CM 0. 255. DISPLAY_IDENTIFIER fm_cal_vb_clc_chr.Cxx_obd_us_typ_xxx /end CHARACTERISTIC
/begin CHARACTERISTIC Cxx_dtc_obd_vb_h "" VALUE 0xa002b12e _REC_S1VAL_20_u2 65535. _CNV_A_R_A_105_CM 0. 65535. DISPLAY_IDENTIFIER fm_cal_vb_h.Cxx_dtc_obd_xxx /end CHARACTERISTIC
/begin CHARACTERISTIC Cxx_conf_wal_vb_h "" VALUE 0xa002b130 _REC_S1VAL_20_u1 3. _CNV_A_R_A_105_CM 0. 3. DISPLAY_IDENTIFIER fm_cal_vb_h.fm_static_bitfield.Cxx_conf_wal_xxx BIT_MASK 0x3 /end CHARACTERISTIC
/begin CHARACTERISTIC Cbx_obd_vb_h "" VALUE 0xa002b130 _REC_S1VAL_20_u1 255. _CNV_A_R_A_105_CM 0. 255. DISPLAY_IDENTIFIER fm_cal_vb_h.fm_static_bitfield.Cbx_obd_xxx BIT_MASK 0x4 /end CHARACTERISTIC
/begin CHARACTERISTIC Cbx_obd_mena_vb_h "" VALUE 0xa002b130 _REC_S1VAL_20_u1 255. _CNV_A_R_A_105_CM 0. 255. DISPLAY_IDENTIFIER fm_cal_vb_h.fm_static_bitfield.Cbx_obd_mena_xxx BIT_MASK 0x8 /end CHARACTERISTIC
/begin CHARACTERISTIC Cxx_dtc_lb_vb_h "" VALUE 0xa002b131 _REC_S1VAL_20_u1 255. _CNV_A_R_A_105_CM 0. 255. DISPLAY_IDENTIFIER fm_cal_vb_h.Cxx_dtc_lb_xxx /end CHARACTERISTIC
/begin CHARACTERISTIC Cxx_obd_dc_vb_h "" VALUE 0xa002b132 _REC_S1VAL_20_u1 9. _CNV_A_R_A_105_CM 1. 10. DISPLAY_IDENTIFIER fm_cal_vb_h.Cxx_obd_dc_xxx /end CHARACTERISTIC
/begin CHARACTERISTIC Cxx_obd_us_typ_vb_h "" VALUE 0xa002b133 _REC_S1VAL_20_u1 255. _CNV_A_R_A_105_CM 0. 255. DISPLAY_IDENTIFIER fm_cal_vb_h.Cxx_obd_us_typ_xxx /end CHARACTERISTIC
/begin CHARACTERISTIC Cxx_dtc_obd_vb_l "" VALUE 0xa002b13a _REC_S1VAL_20_u2 65535. _CNV_A_R_A_105_CM 0. 65535. DISPLAY_IDENTIFIER fm_cal_vb_l.Cxx_dtc_obd_xxx /end CHARACTERISTIC
/begin CHARACTERISTIC Cxx_conf_wal_vb_l "" VALUE 0xa002b13c _REC_S1VAL_20_u1 3. _CNV_A_R_A_105_CM 0. 3. DISPLAY_IDENTIFIER fm_cal_vb_l.fm_static_bitfield.Cxx_conf_wal_xxx BIT_MASK 0x3 /end CHARACTERISTIC
/begin CHARACTERISTIC Cbx_obd_vb_l "" VALUE 0xa002b13c _REC_S1VAL_20_u1 255. _CNV_A_R_A_105_CM 0. 255. DISPLAY_IDENTIFIER fm_cal_vb_l.fm_static_bitfield.Cbx_obd_xxx BIT_MASK 0x4 /end CHARACTERISTIC
/begin CHARACTERISTIC Cbx_obd_mena_vb_l "" VALUE 0xa002b13c _REC_S1VAL_20_u1 255. _CNV_A_R_A_105_CM 0. 255. DISPLAY_IDENTIFIER fm_cal_vb_l.fm_static_bitfield.Cbx_obd_mena_xxx BIT_MASK 0x8 /end CHARACTERISTIC
/begin CHARACTERISTIC Cxx_dtc_lb_vb_l "" VALUE 0xa002b13d _REC_S1VAL_20_u1 255. _CNV_A_R_A_105_CM 0. 255. DISPLAY_IDENTIFIER fm_cal_vb_l.Cxx_dtc_lb_xxx /end CHARACTERISTIC
/begin CHARACTERISTIC Cxx_obd_dc_vb_l "" VALUE 0xa002b13e _REC_S1VAL_20_u1 9. _CNV_A_R_A_105_CM 1. 10. DISPLAY_IDENTIFIER fm_cal_vb_l.Cxx_obd_dc_xxx /end CHARACTERISTIC
/begin CHARACTERISTIC Cxx_obd_us_typ_vb_l "" VALUE 0xa002b13f _REC_S1VAL_20_u1 255. _CNV_A_R_A_105_CM 0. 255. DISPLAY_IDENTIFIER fm_cal_vb_l.Cxx_obd_us_typ_xxx /end CHARACTERISTIC
/begin COMPU_METHOD _CNV_A_R_A_105_CM "" RAT_FUNC "%6.3" "" COEFFS 0 1. 0. 0 0 1 /end COMPU_METHOD
/begin RECORD_LAYOUT _REC_S1VAL_20_u1 FNC_VALUES 1 UBYTE COLUMN_DIR DIRECT /end RECORD_LAYOUT
/begin RECORD_LAYOUT _REC_S1VAL_20_u2 FNC_VALUES 1 UWORD COLUMN_DIR DIRECT /end RECORD_LAYOUT
/begin FUNCTION DgDftCfg ""
 /begin DEF_CHARACTERISTIC Cxx_dtc_obd_igc_2_scg Cxx_conf_wal_igc_2_scg Cbx_obd_igc_2_scg Cbx_obd_mena_igc_2_scg Cxx_dtc_lb_igc_2_scg Cxx_obd_dc_igc_2_scg Cxx_obd_us_typ_igc_2_scg Cxx_dtc_obd_igc_2_scw Cxx_conf_wal_igc_2_scw Cbx_obd_igc_2_scw Cbx_obd_mena_igc_2_scw Cxx_dtc_lb_igc_2_scw Cxx_obd_dc_igc_2_scw Cxx_obd_us_typ_igc_2_scw Cxx_dtc_obd_igc_3_oc Cxx_conf_wal_igc_3_oc Cbx_obd_igc_3_oc Cbx_obd_mena_igc_3_oc Cxx_dtc_lb_igc_3_oc Cxx_obd_dc_igc_3_oc Cxx_obd_us_typ_igc_3_oc Cxx_dtc_obd_igc_3_scg Cxx_conf_wal_igc_3_scg Cbx_obd_igc_3_scg Cbx_obd_mena_igc_3_scg Cxx_dtc_lb_igc_3_scg Cxx_obd_dc_igc_3_scg Cxx_obd_us_typ_igc_3_scg Cxx_dtc_obd_igc_3_scw Cxx_conf_wal_igc_3_scw Cbx_obd_igc_3_scw Cbx_obd_mena_igc_3_scw Cxx_dtc_lb_igc_3_scw Cxx_obd_dc_igc_3_scw Cxx_obd_us_typ_igc_3_scw Cxx_dtc_obd_igc_4_oc Cxx_conf_wal_igc_4_oc Cbx_obd_igc_4_oc Cbx_obd_mena_igc_4_oc Cxx_dtc_lb_igc_4_oc Cxx_obd_dc_igc_4_oc Cxx_obd_us_typ_igc_4_oc Cxx_dtc_obd_igc_4_scg Cxx_conf_wal_igc_4_scg Cbx_obd_igc_4_scg Cbx_obd_mena_igc_4_scg Cxx_dtc_lb_igc_4_scg Cxx_obd_dc_igc_4_scg Cxx_obd_us_typ_igc_4_scg Cxx_dtc_obd_igc_4_scw Cxx_conf_wal_igc_4_scw Cbx_obd_igc_4_scw Cbx_obd_mena_igc_4_scw Cxx_dtc_lb_igc_4_scw Cxx_obd_dc_igc_4_scw Cxx_obd_us_typ_igc_4_scw Cxx_dtc_obd_in_cam_chr Cxx_conf_wal_in_cam_chr Cbx_obd_in_cam_chr Cbx_obd_mena_in_cam_chr Cxx_dtc_lb_in_cam_chr Cxx_obd_dc_in_cam_chr Cxx_obd_us_typ_in_cam_chr Cxx_dtc_obd_in_cam_crk_cmp Cxx_conf_wal_in_cam_crk_cmp Cbx_obd_in_cam_crk_cmp Cbx_obd_mena_in_cam_crk_cmp Cxx_dtc_lb_in_cam_crk_cmp Cxx_obd_dc_in_cam_crk_cmp Cxx_obd_us_typ_in_cam_crk_cmp Cxx_dtc_obd_in_cam_cyc Cxx_conf_wal_in_cam_cyc Cbx_obd_in_cam_cyc Cbx_obd_mena_in_cam_cyc Cxx_dtc_lb_in_cam_cyc Cxx_obd_dc_in_cam_cyc Cxx_obd_us_typ_in_cam_cyc Cxx_dtc_obd_in_cam_no_sig Cxx_conf_wal_in_cam_no_sig Cbx_obd_in_cam_no_sig Cbx_obd_mena_in_cam_no_sig Cxx_dtc_lb_in_cam_no_sig Cxx_obd_dc_in_cam_no_sig Cxx_obd_us_typ_in_cam_no_sig Cxx_dtc_obd_in_cam_nok Cxx_conf_wal_in_cam_nok Cbx_obd_in_cam_nok Cbx_obd_mena_in_cam_nok Cxx_dtc_lb_in_cam_nok Cxx_obd_dc_in_cam_nok Cxx_obd_us_typ_in_cam_nok Cxx_dtc_obd_in_vvtc_ad Cxx_conf_wal_in_vvtc_ad Cbx_obd_in_vvtc_ad Cbx_obd_mena_in_vvtc_ad Cxx_dtc_lb_in_vvtc_ad Cxx_obd_dc_in_vvtc_ad Cxx_obd_us_typ_in_vvtc_ad Cxx_dtc_obd_in_vvtc_blk Cxx_conf_wal_in_vvtc_blk Cbx_obd_in_vvtc_blk Cbx_obd_mena_in_vvtc_blk Cxx_dtc_lb_in_vvtc_blk Cxx_obd_dc_in_vvtc_blk Cxx_obd_us_typ_in_vvtc_blk Cxx_dtc_obd_in_vvtc_dirt_lkg Cxx_conf_wal_in_vvtc_dirt_lkg Cbx_obd_in_vvtc_dirt_lkg Cbx_obd_mena_in_vvtc_dirt_lkg Cxx_dtc_lb_in_vvtc_dirt_lkg Cxx_obd_dc_in_vvtc_dirt_lkg Cxx_obd_us_typ_in_vvtc_dirt_lkg Cxx_dtc_obd_in_vvtc_sldv_oc Cxx_conf_wal_in_vvtc_sldv_oc Cbx_obd_in_vvtc_sldv_oc Cbx_obd_mena_in_vvtc_sldv_oc Cxx_dtc_lb_in_vvtc_sldv_oc Cxx_obd_dc_in_vvtc_sldv_oc Cxx_obd_us_typ_in_vvtc_sldv_oc Cxx_dtc_obd_in_vvtc_sldv_scg Cxx_conf_wal_in_vvtc_sldv_scg Cbx_obd_in_vvtc_sldv_scg Cbx_obd_mena_in_vvtc_sldv_scg Cxx_dtc_lb_in_vvtc_sldv_scg Cxx_obd_dc_in_vvtc_sldv_scg Cxx_obd_us_typ_in_vvtc_sldv_scg Cxx_dtc_obd_in_vvtc_sldv_scw Cxx_conf_wal_in_vvtc_sldv_scw Cbx_obd_in_vvtc_sldv_scw Cbx_obd_mena_in_vvtc_sldv_scw Cxx_dtc_lb_in_vvtc_sldv_scw Cxx_obd_dc_in_vvtc_sldv_scw Cxx_obd_us_typ_in_vvtc_sldv_scw Cxx_dtc_obd_inj1_oc Cxx_conf_wal_inj1_oc Cbx_obd_inj1_oc Cbx_obd_mena_inj1_oc Cxx_dtc_lb_inj1_oc Cxx_obd_dc_inj1_oc Cxx_obd_us_typ_inj1_oc Cxx_dtc_obd_inj1_scg Cxx_conf_wal_inj1_scg Cbx_obd_inj1_scg Cbx_obd_mena_inj1_scg Cxx_dtc_lb_inj1_scg Cxx_obd_dc_inj1_scg Cxx_obd_us_typ_inj1_scg Cxx_dtc_obd_inj1_scw Cxx_conf_wal_inj1_scw Cbx_obd_inj1_scw Cbx_obd_mena_inj1_scw Cxx_dtc_lb_inj1_scw Cxx_obd_dc_inj1_scw Cxx_obd_us_typ_inj1_scw Cxx_dtc_obd_inj2_oc Cxx_conf_wal_inj2_oc Cbx_obd_inj2_oc Cbx_obd_mena_inj2_oc Cxx_dtc_lb_inj2_oc Cxx_obd_dc_inj2_oc Cxx_obd_us_typ_inj2_oc Cxx_dtc_obd_inj2_scg Cxx_conf_wal_inj2_scg Cbx_obd_inj2_scg Cbx_obd_mena_inj2_scg Cxx_dtc_lb_inj2_scg Cxx_obd_dc_inj2_scg Cxx_obd_us_typ_inj2_scg Cxx_dtc_obd_inj2_scw Cxx_conf_wal_inj2_scw Cbx_obd_inj2_scw Cbx_obd_mena_inj2_scw Cxx_dtc_lb_inj2_scw Cxx_obd_dc_inj2_scw Cxx_obd_us_typ_inj2_scw Cxx_dtc_obd_inj3_oc Cxx_conf_wal_inj3_oc Cbx_obd_inj3_oc Cbx_obd_mena_inj3_oc Cxx_dtc_lb_inj3_oc Cxx_obd_dc_inj3_oc Cxx_obd_us_typ_inj3_oc Cxx_dtc_obd_inj3_scg Cxx_conf_wal_inj3_scg Cbx_obd_inj3_scg Cbx_obd_mena_inj3_scg Cxx_dtc_lb_inj3_scg Cxx_obd_dc_inj3_scg Cxx_obd_us_typ_inj3_scg Cxx_dtc_obd_inj3_scw Cxx_conf_wal_inj3_scw Cbx_obd_inj3_scw Cbx_obd_mena_inj3_scw Cxx_dtc_lb_inj3_scw Cxx_obd_dc_inj3_scw Cxx_obd_us_typ_inj3_scw Cxx_dtc_obd_inj4_oc Cxx_conf_wal_inj4_oc Cbx_obd_inj4_oc Cbx_obd_mena_inj4_oc Cxx_dtc_lb_inj4_oc Cxx_obd_dc_inj4_oc Cxx_obd_us_typ_inj4_oc Cxx_dtc_obd_inj4_scg Cxx_conf_wal_inj4_scg Cbx_obd_inj4_scg Cbx_obd_mena_inj4_scg Cxx_dtc_lb_inj4_scg Cxx_obd_dc_inj4_scg Cxx_obd_us_typ_inj4_scg Cxx_dtc_obd_inj4_scw Cxx_conf_wal_inj4_scw Cbx_obd_inj4_scw Cbx_obd_mena_inj4_scw Cxx_dtc_lb_inj4_scw Cxx_obd_dc_inj4_scw Cxx_obd_us_typ_inj4_scw Cxx_dtc_obd_inj_ecu_itl Cxx_conf_wal_inj_ecu_itl Cbx_obd_inj_ecu_itl Cbx_obd_mena_inj_ecu_itl Cxx_dtc_lb_inj_ecu_itl Cxx_obd_dc_inj_ecu_itl Cxx_obd_us_typ_inj_ecu_itl Cxx_dtc_obd_inj_ecu_lbdw_icp Cxx_conf_wal_inj_ecu_lbdw_icp Cbx_obd_inj_ecu_lbdw_icp Cbx_obd_mena_inj_ecu_lbdw_icp Cxx_dtc_lb_inj_ecu_lbdw_icp Cxx_obd_dc_inj_ecu_lbdw_icp Cxx_obd_us_typ_inj_ecu_lbdw_icp Cxx_dtc_obd_inj_ecu_lbup_icp Cxx_conf_wal_inj_ecu_lbup_icp Cbx_obd_inj_ecu_lbup_icp Cbx_obd_mena_inj_ecu_lbup_icp Cxx_dtc_lb_inj_ecu_lbup_icp Cxx_obd_dc_inj_ecu_lbup_icp Cxx_obd_us_typ_inj_ecu_lbup_icp Cxx_conf_wal_ip_lght_tco_ovh Cxx_dtc_lb_ip_lght_tco_ovh Cxx_obd_us_typ_ip_lght_tco_ovh Cxx_dtc_obd_isr_h_lvl Cxx_conf_wal_isr_h_lvl Cbx_obd_isr_h_lvl Cbx_obd_mena_isr_h_lvl Cxx_dtc_lb_isr_h_lvl Cxx_obd_dc_isr_h_lvl Cxx_obd_us_typ_isr_h_lvl Cxx_dtc_obd_isr_l_lvl Cxx_conf_wal_isr_l_lvl Cbx_obd_isr_l_lvl Cbx_obd_mena_isr_l_lvl Cxx_dtc_lb_isr_l_lvl Cxx_obd_dc_isr_l_lvl Cxx_obd_us_typ_isr_l_lvl Cxx_dtc_obd_it_cmd_el Cxx_conf_wal_it_cmd_el Cbx_obd_it_cmd_el Cbx_obd_mena_it_cmd_el Cxx_dtc_lb_it_cmd_el Cxx_obd_dc_it_cmd_el Cxx_obd_us_typ_it_cmd_el Cxx_dtc_obd_it_ofs_meca Cxx_conf_wal_it_ofs_meca Cbx_obd_it_ofs_meca Cbx_obd_mena_it_ofs_meca Cxx_dtc_lb_it_ofs_meca Cxx_obd_dc_it_ofs_meca Cxx_obd_us_typ_it_ofs_meca Cxx_dtc_obd_it_ofs_no_norm Cxx_conf_wal_it_ofs_no_norm Cbx_obd_it_ofs_no_norm Cbx_obd_mena_it_ofs_no_norm Cxx_dtc_lb_it_ofs_no_norm Cxx_obd_dc_it_ofs_no_norm Cxx_obd_us_typ_it_ofs_no_norm Cxx_dtc_obd_it_ofs_secu_nok Cxx_conf_wal_it_ofs_secu_nok Cbx_obd_it_ofs_secu_nok Cbx_obd_mena_it_ofs_secu_nok Cxx_dtc_lb_it_ofs_secu_nok Cxx_obd_dc_it_ofs_secu_nok Cxx_obd_us_typ_it_ofs_secu_nok Cxx_dtc_obd_it_reg_blk Cxx_conf_wal_it_reg_blk Cbx_obd_it_reg_blk Cbx_obd_mena_it_reg_blk Cxx_dtc_lb_it_reg_blk Cxx_obd_dc_it_reg_blk Cxx_obd_us_typ_it_reg_blk Cxx_dtc_obd_knk_oor Cxx_conf_wal_knk_oor Cbx_obd_knk_oor Cbx_obd_mena_knk_oor Cxx_dtc_lb_knk_oor Cxx_obd_dc_knk_oor Cxx_obd_us_typ_knk_oor Cxx_dtc_obd_knk_shp Cxx_conf_wal_knk_shp Cbx_obd_knk_shp Cbx_obd_mena_knk_shp Cxx_dtc_lb_knk_shp Cxx_obd_dc_knk_shp Cxx_obd_us_typ_knk_shp Cxx_dtc_obd_lbdw_hot_dirt_lkg Cxx_conf_wal_lbdw_hot_dirt_lkg Cbx_obd_lbdw_hot_dirt_lkg Cbx_obd_mena_lbdw_hot_dirt_lkg Cxx_dtc_lb_lbdw_hot_dirt_lkg Cxx_obd_dc_lbdw_hot_dirt_lkg Cxx_obd_us_typ_lbdw_hot_dirt_lkg Cxx_dtc_obd_lbdw_hot_oc Cxx_conf_wal_lbdw_hot_oc Cbx_obd_lbdw_hot_oc Cbx_obd_mena_lbdw_hot_oc Cxx_dtc_lb_lbdw_hot_oc Cxx_obd_dc_lbdw_hot_oc Cxx_obd_us_typ_lbdw_hot_oc Cxx_dtc_obd_lbdw_hot_scg Cxx_conf_wal_lbdw_hot_scg Cbx_obd_lbdw_hot_scg Cbx_obd_mena_lbdw_hot_scg Cxx_dtc_lb_lbdw_hot_scg Cxx_obd_dc_lbdw_hot_scg Cxx_obd_us_typ_lbdw_hot_scg Cxx_dtc_obd_lbdw_hot_scw Cxx_conf_wal_lbdw_hot_scw Cbx_obd_lbdw_hot_scw Cbx_obd_mena_lbdw_hot_scw Cxx_dtc_lb_lbdw_hot_scw Cxx_obd_dc_lbdw_hot_scw Cxx_obd_us_typ_lbdw_hot_scw Cxx_dtc_obd_lbdw_oc Cxx_conf_wal_lbdw_oc Cbx_obd_lbdw_oc Cbx_obd_mena_lbdw_oc Cxx_dtc_lb_lbdw_oc Cxx_obd_dc_lbdw_oc Cxx_obd_us_typ_lbdw_oc Cxx_dtc_obd_lbdw_scg Cxx_conf_wal_lbdw_scg Cbx_obd_lbdw_scg Cbx_obd_mena_lbdw_scg Cxx_dtc_lb_lbdw_scg Cxx_obd_dc_lbdw_scg Cxx_obd_us_typ_lbdw_scg Cxx_dtc_obd_lbdw_scw Cxx_conf_wal_lbdw_scw Cbx_obd_lbdw_scw Cbx_obd_mena_lbdw_scw Cxx_dtc_lb_lbdw_scw Cxx_obd_dc_lbdw_scw Cxx_obd_us_typ_lbdw_scw Cxx_dtc_obd_lbup_cpt Cxx_conf_wal_lbup_cpt Cbx_obd_lbup_cpt Cbx_obd_mena_lbup_cpt Cxx_dtc_lb_lbup_cpt Cxx_obd_dc_lbup_cpt Cxx_obd_us_typ_lbup_cpt Cxx_dtc_obd_lbup_hot_apl_down Cxx_conf_wal_lbup_hot_apl_down Cbx_obd_lbup_hot_apl_down Cbx_obd_mena_lbup_hot_apl_down Cxx_dtc_lb_lbup_hot_apl_down Cxx_obd_dc_lbup_hot_apl_down Cxx_obd_us_typ_lbup_hot_apl_down Cxx_dtc_obd_lbup_hot_dirt_lkg Cxx_conf_wal_lbup_hot_dirt_lkg Cbx_obd_lbup_hot_dirt_lkg Cbx_obd_mena_lbup_hot_dirt_lkg Cxx_dtc_lb_lbup_hot_dirt_lkg Cxx_obd_dc_lbup_hot_dirt_lkg Cxx_obd_us_typ_lbup_hot_dirt_lkg Cxx_dtc_obd_lbup_hot_oc Cxx_conf_wal_lbup_hot_oc Cbx_obd_lbup_hot_oc Cbx_obd_mena_lbup_hot_oc Cxx_dtc_lb_lbup_hot_oc Cxx_obd_dc_lbup_hot_oc Cxx_obd_us_typ_lbup_hot_oc Cxx_dtc_obd_lbup_hot_scg Cxx_conf_wal_lbup_hot_scg Cbx_obd_lbup_hot_scg Cbx_obd_mena_lbup_hot_scg Cxx_dtc_lb_lbup_hot_scg Cxx_obd_dc_lbup_hot_scg Cxx_obd_us_typ_lbup_hot_scg Cxx_dtc_obd_lbup_hot_scw Cxx_conf_wal_lbup_hot_scw Cbx_obd_lbup_hot_scw Cbx_obd_mena_lbup_hot_scw Cxx_dtc_lb_lbup_hot_scw Cxx_obd_dc_lbup_hot_scw Cxx_obd_us_typ_lbup_hot_scw Cxx_dtc_obd_lbup_nok Cxx_conf_wal_lbup_nok Cbx_obd_lbup_nok Cbx_obd_mena_lbup_nok Cxx_dtc_lb_lbup_nok Cxx_obd_dc_lbup_nok Cxx_obd_us_typ_lbup_nok Cxx_dtc_obd_lbup_oc Cxx_conf_wal_lbup_oc Cbx_obd_lbup_oc Cbx_obd_mena_lbup_oc Cxx_dtc_lb_lbup_oc Cxx_obd_dc_lbup_oc Cxx_obd_us_typ_lbup_oc Cxx_dtc_obd_lbup_scg Cxx_conf_wal_lbup_scg Cbx_obd_lbup_scg Cbx_obd_mena_lbup_scg Cxx_dtc_lb_lbup_scg Cxx_obd_dc_lbup_scg Cxx_obd_us_typ_lbup_scg Cxx_dtc_obd_lbup_scw Cxx_conf_wal_lbup_scw Cbx_obd_lbup_scw Cbx_obd_mena_lbup_scw Cxx_dtc_lb_lbup_scw Cxx_obd_dc_lbup_scw Cxx_obd_us_typ_lbup_scw Cxx_dtc_obd_lbup_shf_h Cxx_conf_wal_lbup_shf_h Cbx_obd_lbup_shf_h Cbx_obd_mena_lbup_shf_h Cxx_dtc_lb_lbup_shf_h Cxx_obd_dc_lbup_shf_h Cxx_obd_us_typ_lbup_shf_h Cxx_dtc_obd_lbup_shf_l Cxx_conf_wal_lbup_shf_l Cbx_obd_lbup_shf_l Cbx_obd_mena_lbup_shf_l Cxx_dtc_lb_lbup_shf_l Cxx_obd_dc_lbup_shf_l Cxx_obd_us_typ_lbup_shf_l Cxx_dtc_obd_map_chr Cxx_conf_wal_map_chr Cbx_obd_map_chr Cbx_obd_mena_map_chr Cxx_dtc_lb_map_chr Cxx_obd_dc_map_chr Cxx_obd_us_typ_map_chr Cxx_dtc_obd_map_oor Cxx_conf_wal_map_oor Cbx_obd_map_oor Cbx_obd_mena_map_oor Cxx_dtc_lb_map_oor Cxx_obd_dc_map_oor Cxx_obd_us_typ_map_oor Cxx_dtc_obd_mis_1_cata Cxx_conf_wal_mis_1_cata Cbx_obd_mis_1_cata Cbx_obd_mena_mis_1_cata Cxx_dtc_lb_mis_1_cata Cxx_obd_dc_mis_1_cata Cxx_obd_us_typ_mis_1_cata Cxx_dtc_obd_mis_1_lpg_cata Cxx_conf_wal_mis_1_lpg_cata Cbx_obd_mis_1_lpg_cata Cbx_obd_mena_mis_1_lpg_cata Cxx_dtc_lb_mis_1_lpg_cata Cxx_obd_dc_mis_1_lpg_cata Cxx_obd_us_typ_mis_1_lpg_cata Cxx_dtc_obd_mis_1_lpg_trs_h Cxx_conf_wal_mis_1_lpg_trs_h Cbx_obd_mis_1_lpg_trs_h Cbx_obd_mena_mis_1_lpg_trs_h Cxx_dtc_lb_mis_1_lpg_trs_h Cxx_obd_dc_mis_1_lpg_trs_h Cxx_obd_us_typ_mis_1_lpg_trs_h Cxx_dtc_obd_mis_1_trs_h Cxx_conf_wal_mis_1_trs_h Cbx_obd_mis_1_trs_h Cbx_obd_mena_mis_1_trs_h Cxx_dtc_lb_mis_1_trs_h Cxx_obd_dc_mis_1_trs_h Cxx_obd_us_typ_mis_1_trs_h Cxx_dtc_obd_mis_2_cata Cxx_conf_wal_mis_2_cata Cbx_obd_mis_2_cata Cbx_obd_mena_mis_2_cata Cxx_dtc_lb_mis_2_cata Cxx_obd_dc_mis_2_cata Cxx_obd_us_typ_mis_2_cata Cxx_dtc_obd_mis_2_lpg_cata Cxx_conf_wal_mis_2_lpg_cata Cbx_obd_mis_2_lpg_cata Cbx_obd_mena_mis_2_lpg_cata Cxx_dtc_lb_mis_2_lpg_cata Cxx_obd_dc_mis_2_lpg_cata Cxx_obd_us_typ_mis_2_lpg_cata Cxx_dtc_obd_mis_2_lpg_trs_h Cxx_conf_wal_mis_2_lpg_trs_h Cbx_obd_mis_2_lpg_trs_h Cbx_obd_mena_mis_2_lpg_trs_h Cxx_dtc_lb_mis_2_lpg_trs_h Cxx_obd_dc_mis_2_lpg_trs_h Cxx_obd_us_typ_mis_2_lpg_trs_h Cxx_dtc_obd_mis_2_trs_h Cxx_conf_wal_mis_2_trs_h Cbx_obd_mis_2_trs_h Cbx_obd_mena_mis_2_trs_h Cxx_dtc_lb_mis_2_trs_h Cxx_obd_dc_mis_2_trs_h Cxx_obd_us_typ_mis_2_trs_h Cxx_dtc_obd_mis_3_cata Cxx_conf_wal_mis_3_cata Cbx_obd_mis_3_cata Cbx_obd_mena_mis_3_cata Cxx_dtc_lb_mis_3_cata Cxx_obd_dc_mis_3_cata Cxx_obd_us_typ_mis_3_cata Cxx_dtc_obd_mis_3_lpg_cata Cxx_conf_wal_mis_3_lpg_cata Cbx_obd_mis_3_lpg_cata Cbx_obd_mena_mis_3_lpg_cata Cxx_dtc_lb_mis_3_lpg_cata Cxx_obd_dc_mis_3_lpg_cata Cxx_obd_us_typ_mis_3_lpg_cata Cxx_dtc_obd_mis_3_lpg_trs_h Cxx_conf_wal_mis_3_lpg_trs_h Cbx_obd_mis_3_lpg_trs_h Cbx_obd_mena_mis_3_lpg_trs_h Cxx_dtc_lb_mis_3_lpg_trs_h Cxx_obd_dc_mis_3_lpg_trs_h Cxx_obd_us_typ_mis_3_lpg_trs_h Cxx_dtc_obd_mis_3_trs_h Cxx_conf_wal_mis_3_trs_h Cbx_obd_mis_3_trs_h Cbx_obd_mena_mis_3_trs_h Cxx_dtc_lb_mis_3_trs_h Cxx_obd_dc_mis_3_trs_h Cxx_obd_us_typ_mis_3_trs_h Cxx_dtc_obd_mis_4_cata Cxx_conf_wal_mis_4_cata Cbx_obd_mis_4_cata Cbx_obd_mena_mis_4_cata Cxx_dtc_lb_mis_4_cata Cxx_obd_dc_mis_4_cata Cxx_obd_us_typ_mis_4_cata Cxx_dtc_obd_mis_4_lpg_cata Cxx_conf_wal_mis_4_lpg_cata Cbx_obd_mis_4_lpg_cata Cbx_obd_mena_mis_4_lpg_cata Cxx_dtc_lb_mis_4_lpg_cata Cxx_obd_dc_mis_4_lpg_cata Cxx_obd_us_typ_mis_4_lpg_cata Cxx_dtc_obd_mis_4_lpg_trs_h Cxx_conf_wal_mis_4_lpg_trs_h Cbx_obd_mis_4_lpg_trs_h Cbx_obd_mena_mis_4_lpg_trs_h Cxx_dtc_lb_mis_4_lpg_trs_h Cxx_obd_dc_mis_4_lpg_trs_h Cxx_obd_us_typ_mis_4_lpg_trs_h Cxx_dtc_obd_mis_4_trs_h Cxx_conf_wal_mis_4_trs_h Cbx_obd_mis_4_trs_h Cbx_obd_mena_mis_4_trs_h Cxx_dtc_lb_mis_4_trs_h Cxx_obd_dc_mis_4_trs_h Cxx_obd_us_typ_mis_4_trs_h Cxx_dtc_obd_mis_cata Cxx_conf_wal_mis_cata Cbx_obd_mis_cata Cbx_obd_mena_mis_cata Cxx_dtc_lb_mis_cata Cxx_obd_dc_mis_cata Cxx_obd_us_typ_mis_cata Cxx_dtc_obd_mis_lpg_cata Cxx_conf_wal_mis_lpg_cata Cbx_obd_mis_lpg_cata Cbx_obd_mena_mis_lpg_cata Cxx_dtc_lb_mis_lpg_cata Cxx_obd_dc_mis_lpg_cata Cxx_obd_us_typ_mis_lpg_cata Cxx_dtc_obd_mis_lpg_trs_h Cxx_conf_wal_mis_lpg_trs_h Cbx_obd_mis_lpg_trs_h Cbx_obd_mena_mis_lpg_trs_h Cxx_dtc_lb_mis_lpg_trs_h Cxx_obd_dc_mis_lpg_trs_h Cxx_obd_us_typ_mis_lpg_trs_h Cxx_dtc_obd_mis_min_fuel_cata Cxx_conf_wal_mis_min_fuel_cata Cbx_obd_mis_min_fuel_cata Cbx_obd_mena_mis_min_fuel_cata Cxx_dtc_lb_mis_min_fuel_cata Cxx_obd_dc_mis_min_fuel_cata Cxx_obd_us_typ_mis_min_fuel_cata Cxx_dtc_obd_mis_min_fuel_trs_h Cxx_conf_wal_mis_min_fuel_trs_h Cbx_obd_mis_min_fuel_trs_h Cbx_obd_mena_mis_min_fuel_trs_h Cxx_dtc_lb_mis_min_fuel_trs_h Cxx_obd_dc_mis_min_fuel_trs_h Cxx_obd_us_typ_mis_min_fuel_trs_h Cxx_dtc_obd_mis_trs_h Cxx_conf_wal_mis_trs_h Cbx_obd_mis_trs_h Cbx_obd_mena_mis_trs_h Cxx_dtc_lb_mis_trs_h Cxx_obd_dc_mis_trs_h Cxx_obd_us_typ_mis_trs_h Cxx_dtc_obd_mis_unk_cata Cxx_conf_wal_mis_unk_cata Cbx_obd_mis_unk_cata Cbx_obd_mena_mis_unk_cata Cxx_dtc_lb_mis_unk_cata Cxx_obd_dc_mis_unk_cata Cxx_obd_us_typ_mis_unk_cata Cxx_dtc_obd_mis_unk_lpg_cata Cxx_conf_wal_mis_unk_lpg_cata Cbx_obd_mis_unk_lpg_cata Cbx_obd_mena_mis_unk_lpg_cata Cxx_dtc_lb_mis_unk_lpg_cata Cxx_obd_dc_mis_unk_lpg_cata Cxx_obd_us_typ_mis_unk_lpg_cata Cxx_dtc_obd_mis_unk_lpg_trs_h Cxx_conf_wal_mis_unk_lpg_trs_h Cbx_obd_mis_unk_lpg_trs_h Cbx_obd_mena_mis_unk_lpg_trs_h Cxx_dtc_lb_mis_unk_lpg_trs_h Cxx_obd_dc_mis_unk_lpg_trs_h Cxx_obd_us_typ_mis_unk_lpg_trs_h Cxx_dtc_obd_mis_unk_trs_h Cxx_conf_wal_mis_unk_trs_h Cbx_obd_mis_unk_trs_h Cbx_obd_mena_mis_unk_trs_h Cxx_dtc_lb_mis_unk_trs_h Cxx_obd_dc_mis_unk_trs_h Cxx_obd_us_typ_mis_unk_trs_h Cxx_conf_wal_ptc_rov_oc Cxx_dtc_lb_ptc_rov_oc Cxx_obd_us_typ_ptc_rov_oc Cxx_conf_wal_ptc_rov_scg Cxx_dtc_lb_ptc_rov_scg Cxx_obd_us_typ_ptc_rov_scg Cxx_conf_wal_ptc_rov_scw Cxx_dtc_lb_ptc_rov_scw Cxx_obd_us_typ_ptc_rov_scw Cxx_dtc_obd_pws_1_h Cxx_conf_wal_pws_1_h Cbx_obd_pws_1_h Cbx_obd_mena_pws_1_h Cxx_dtc_lb_pws_1_h Cxx_obd_dc_pws_1_h Cxx_obd_us_typ_pws_1_h Cxx_dtc_obd_pws_1_l Cxx_conf_wal_pws_1_l Cbx_obd_pws_1_l Cbx_obd_mena_pws_1_l Cxx_dtc_lb_pws_1_l Cxx_obd_dc_pws_1_l Cxx_obd_us_typ_pws_1_l Cxx_dtc_obd_pws_2_h Cxx_conf_wal_pws_2_h Cbx_obd_pws_2_h Cbx_obd_mena_pws_2_h Cxx_dtc_lb_pws_2_h Cxx_obd_dc_pws_2_h Cxx_obd_us_typ_pws_2_h Cxx_dtc_obd_pws_2_l Cxx_conf_wal_pws_2_l Cbx_obd_pws_2_l Cbx_obd_mena_pws_2_l Cxx_dtc_lb_pws_2_l Cxx_obd_dc_pws_2_l Cxx_obd_us_typ_pws_2_l Cxx_dtc_obd_pws_3_h Cxx_conf_wal_pws_3_h Cbx_obd_pws_3_h Cbx_obd_mena_pws_3_h Cxx_dtc_lb_pws_3_h Cxx_obd_dc_pws_3_h Cxx_obd_us_typ_pws_3_h Cxx_dtc_obd_pws_3_l Cxx_conf_wal_pws_3_l Cbx_obd_pws_3_l Cbx_obd_mena_pws_3_l Cxx_dtc_lb_pws_3_l Cxx_obd_dc_pws_3_l Cxx_obd_us_typ_pws_3_l Cxx_dtc_obd_sens_it_1_nok Cxx_conf_wal_sens_it_1_nok Cbx_obd_sens_it_1_nok Cbx_obd_mena_sens_it_1_nok Cxx_dtc_lb_sens_it_1_nok Cxx_obd_dc_sens_it_1_nok Cxx_obd_us_typ_sens_it_1_nok Cxx_dtc_obd_sens_it_2_nok Cxx_conf_wal_sens_it_2_nok Cbx_obd_sens_it_2_nok Cbx_obd_mena_sens_it_2_nok Cxx_dtc_lb_sens_it_2_nok Cxx_obd_dc_sens_it_2_nok Cxx_obd_us_typ_sens_it_2_nok Cxx_dtc_obd_sens_it_chr Cxx_conf_wal_sens_it_chr Cbx_obd_sens_it_chr Cbx_obd_mena_sens_it_chr Cxx_dtc_lb_sens_it_chr Cxx_obd_dc_sens_it_chr Cxx_obd_us_typ_sens_it_chr Cxx_dtc_obd_sens_it_sig_mcut Cxx_conf_wal_sens_it_sig_mcut Cbx_obd_sens_it_sig_mcut Cbx_obd_mena_sens_it_sig_mcut Cxx_dtc_lb_sens_it_sig_mcut Cxx_obd_dc_sens_it_sig_mcut Cxx_obd_us_typ_sens_it_sig_mcut Cxx_dtc_obd_sens_map_h Cxx_conf_wal_sens_map_h Cbx_obd_sens_map_h Cbx_obd_mena_sens_map_h Cxx_dtc_lb_sens_map_h Cxx_obd_dc_sens_map_h Cxx_obd_us_typ_sens_map_h Cxx_dtc_obd_sens_map_l Cxx_conf_wal_sens_map_l Cbx_obd_sens_map_l Cbx_obd_mena_sens_map_l Cxx_dtc_lb_sens_map_l Cxx_obd_dc_sens_map_l Cxx_obd_us_typ_sens_map_l Cxx_dtc_obd_sens_mat_h Cxx_conf_wal_sens_mat_h Cbx_obd_sens_mat_h Cbx_obd_mena_sens_mat_h Cxx_dtc_lb_sens_mat_h Cxx_obd_dc_sens_mat_h Cxx_obd_us_typ_sens_mat_h Cxx_dtc_obd_sens_mat_l Cxx_conf_wal_sens_mat_l Cbx_obd_sens_mat_l Cbx_obd_mena_sens_mat_l Cxx_dtc_lb_sens_mat_l Cxx_obd_dc_sens_mat_l Cxx_obd_us_typ_sens_mat_l Cxx_dtc_obd_sens_rvc_h Cxx_conf_wal_sens_rvc_h Cbx_obd_sens_rvc_h Cbx_obd_mena_sens_rvc_h Cxx_dtc_lb_sens_rvc_h Cxx_obd_dc_sens_rvc_h Cxx_obd_us_typ_sens_rvc_h Cxx_dtc_obd_sens_rvc_l Cxx_conf_wal_sens_rvc_l Cbx_obd_sens_rvc_l Cbx_obd_mena_sens_rvc_l Cxx_dtc_lb_sens_rvc_l Cxx_obd_dc_sens_rvc_l Cxx_obd_us_typ_sens_rvc_l Cxx_dtc_obd_sens_rvc_nok Cxx_conf_wal_sens_rvc_nok Cbx_obd_sens_rvc_nok Cbx_obd_mena_sens_rvc_nok Cxx_dtc_lb_sens_rvc_nok Cxx_obd_dc_sens_rvc_nok Cxx_obd_us_typ_sens_rvc_nok Cxx_dtc_obd_sens_rvc_sig_mcut Cxx_conf_wal_sens_rvc_sig_mcut Cbx_obd_sens_rvc_sig_mcut Cbx_obd_mena_sens_rvc_sig_mcut Cxx_dtc_lb_sens_rvc_sig_mcut Cxx_obd_dc_sens_rvc_sig_mcut Cxx_obd_us_typ_sens_rvc_sig_mcut Cxx_dtc_obd_sens_spg_h Cxx_conf_wal_sens_spg_h Cbx_obd_sens_spg_h Cbx_obd_mena_sens_spg_h Cxx_dtc_lb_sens_spg_h Cxx_obd_dc_sens_spg_h Cxx_obd_us_typ_sens_spg_h Cxx_dtc_obd_sens_spg_l Cxx_conf_wal_sens_spg_l Cbx_obd_sens_spg_l Cbx_obd_mena_sens_spg_l Cxx_dtc_lb_sens_spg_l Cxx_obd_dc_sens_spg_l Cxx_obd_us_typ_sens_spg_l Cxx_dtc_obd_sens_tco_h Cxx_conf_wal_sens_tco_h Cbx_obd_sens_tco_h Cbx_obd_mena_sens_tco_h Cxx_dtc_lb_sens_tco_h Cxx_obd_dc_sens_tco_h Cxx_obd_us_typ_sens_tco_h Cxx_dtc_obd_sens_tco_l Cxx_conf_wal_sens_tco_l Cbx_obd_sens_tco_l Cbx_obd_mena_sens_tco_l Cxx_dtc_lb_sens_tco_l Cxx_obd_dc_sens_tco_l Cxx_obd_us_typ_sens_tco_l Cxx_dtc_obd_sens_tco_sig_mcut Cxx_conf_wal_sens_tco_sig_mcut Cbx_obd_sens_tco_sig_mcut Cbx_obd_mena_sens_tco_sig_mcut Cxx_dtc_lb_sens_tco_sig_mcut Cxx_obd_dc_sens_tco_sig_mcut Cxx_obd_us_typ_sens_tco_sig_mcut Cxx_dtc_obd_sfty_tq_chr Cxx_conf_wal_sfty_tq_chr Cbx_obd_sfty_tq_chr Cbx_obd_mena_sfty_tq_chr Cxx_dtc_lb_sfty_tq_chr Cxx_obd_dc_sfty_tq_chr Cxx_obd_us_typ_sfty_tq_chr Cxx_dtc_obd_sfty_tq_clc_chr Cxx_conf_wal_sfty_tq_clc_chr Cbx_obd_sfty_tq_clc_chr Cbx_obd_mena_sfty_tq_clc_chr Cxx_dtc_lb_sfty_tq_clc_chr Cxx_obd_dc_sfty_tq_clc_chr Cxx_obd_us_typ_sfty_tq_clc_chr Cxx_conf_wal_sfty_tq_lih_chr Cxx_dtc_lb_sfty_tq_lih_chr Cxx_obd_us_typ_sfty_tq_lih_chr Cxx_dtc_obd_spg_oor Cxx_conf_wal_spg_oor Cbx_obd_spg_oor Cbx_obd_mena_spg_oor Cxx_dtc_lb_spg_oor Cxx_obd_dc_spg_oor Cxx_obd_us_typ_spg_oor Cxx_dtc_obd_spg_reg_apl_down Cxx_conf_wal_spg_reg_apl_down Cbx_obd_spg_reg_apl_down Cbx_obd_mena_spg_reg_apl_down Cxx_dtc_lb_spg_reg_apl_down Cxx_obd_dc_spg_reg_apl_down Cxx_obd_us_typ_spg_reg_apl_down Cxx_dtc_obd_spg_reg_apl_up Cxx_conf_wal_spg_reg_apl_up Cbx_obd_spg_reg_apl_up Cbx_obd_mena_spg_reg_apl_up Cxx_dtc_lb_spg_reg_apl_up Cxx_obd_dc_spg_reg_apl_up Cxx_obd_us_typ_spg_reg_apl_up Cxx_dtc_obd_tco_cl_no_norm Cxx_conf_wal_tco_cl_no_norm Cbx_obd_tco_cl_no_norm Cbx_obd_mena_tco_cl_no_norm Cxx_dtc_lb_tco_cl_no_norm Cxx_obd_dc_tco_cl_no_norm Cxx_obd_us_typ_tco_cl_no_norm Cxx_dtc_obd_tlz_ad_b_cpt Cxx_conf_wal_tlz_ad_b_cpt Cbx_obd_tlz_ad_b_cpt Cbx_obd_mena_tlz_ad_b_cpt Cxx_dtc_lb_tlz_ad_b_cpt Cxx_obd_dc_tlz_ad_b_cpt Cxx_obd_us_typ_tlz_ad_b_cpt Cxx_dtc_obd_tsta_reg_no_norm Cxx_conf_wal_tsta_reg_no_norm Cbx_obd_tsta_reg_no_norm Cbx_obd_mena_tsta_reg_no_norm Cxx_dtc_lb_tsta_reg_no_norm Cxx_obd_dc_tsta_reg_no_norm Cxx_obd_us_typ_tsta_reg_no_norm Cxx_dtc_obd_vb_clc_chr Cxx_conf_wal_vb_clc_chr Cbx_obd_vb_clc_chr Cbx_obd_mena_vb_clc_chr Cxx_dtc_lb_vb_clc_chr Cxx_obd_dc_vb_clc_chr Cxx_obd_us_typ_vb_clc_chr Cxx_dtc_obd_vb_h Cxx_conf_wal_vb_h Cbx_obd_vb_h Cbx_obd_mena_vb_h Cxx_dtc_lb_vb_h Cxx_obd_dc_vb_h Cxx_obd_us_typ_vb_h Cxx_dtc_obd_vb_l Cxx_conf_wal_vb_l Cbx_obd_vb_l Cbx_obd_mena_vb_l Cxx_dtc_lb_vb_l Cxx_obd_dc_vb_l Cxx_obd_us_typ_vb_l /end DEF_CHARACTERISTIC
/end FUNCTION
/end MODULE
/end PROJECT
