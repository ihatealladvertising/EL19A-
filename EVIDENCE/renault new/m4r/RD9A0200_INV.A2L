ASAP2_VERSION 1 41
/begin PROJECT RD8 "_default_ProjectLongIdentifier"
/begin HEADER "_default_HeaderComment" PROJECT_NO RD9 /end HEADER
/begin MODULE _default_ModuleName "_default_ModuleLongIdentifier"
/begin MOD_COMMON "_default_ModCommonComment" DEPOSIT ABSOLUTE BYTE_ORDER MSB_LAST ALIGNMENT_BYTE 1 ALIGNMENT_WORD 2 ALIGNMENT_LONG 2 ALIGNMENT_FLOAT32_IEEE 2 ALIGNMENT_FLOAT64_IEEE 4 /end MOD_COMMON
/begin CHARACTERISTIC Ctx_ffm_did_crk[4] "" VALUE 0xa002ac8c _REC_S1VAL_20_u2 65535. _CNV_A_R_A_105_CM 0. 65535. DISPLAY_IDENTIFIER Pxx_dgdftmng_dtc_crk.Ctx_ffm_did_xxx[4] /end CHARACTERISTIC
/begin CHARACTERISTIC Cxx_dtc_hmb_crk "" VALUE 0xa002ac8e _REC_S1VAL_20_u2 65535. _CNV_A_R_A_105_CM 0. 65535. DISPLAY_IDENTIFIER Pxx_dgdftmng_dtc_crk.Cxx_dtc_hmb_xxx /end CHARACTERISTIC
/begin CHARACTERISTIC Ctx_ffm_did_cru[0] "" VALUE 0xa002ab58 _REC_S1VAL_20_u2 65535. _CNV_A_R_A_105_CM 0. 65535. DISPLAY_IDENTIFIER Pxx_dgdftmng_dtc_cru.Ctx_ffm_did_xxx[0] /end CHARACTERISTIC
/begin CHARACTERISTIC Ctx_ffm_did_cru[1] "" VALUE 0xa002ab5a _REC_S1VAL_20_u2 65535. _CNV_A_R_A_105_CM 0. 65535. DISPLAY_IDENTIFIER Pxx_dgdftmng_dtc_cru.Ctx_ffm_did_xxx[1] /end CHARACTERISTIC
/begin CHARACTERISTIC Ctx_ffm_did_cru[2] "" VALUE 0xa002ab5c _REC_S1VAL_20_u2 65535. _CNV_A_R_A_105_CM 0. 65535. DISPLAY_IDENTIFIER Pxx_dgdftmng_dtc_cru.Ctx_ffm_did_xxx[2] /end CHARACTERISTIC
/begin CHARACTERISTIC Ctx_ffm_did_cru[3] "" VALUE 0xa002ab5e _REC_S1VAL_20_u2 65535. _CNV_A_R_A_105_CM 0. 65535. DISPLAY_IDENTIFIER Pxx_dgdftmng_dtc_cru.Ctx_ffm_did_xxx[3] /end CHARACTERISTIC
/begin CHARACTERISTIC Ctx_ffm_did_cru[4] "" VALUE 0xa002ab60 _REC_S1VAL_20_u2 65535. _CNV_A_R_A_105_CM 0. 65535. DISPLAY_IDENTIFIER Pxx_dgdftmng_dtc_cru.Ctx_ffm_did_xxx[4] /end CHARACTERISTIC
/begin CHARACTERISTIC Cxx_dtc_hmb_cru "" VALUE 0xa002ab62 _REC_S1VAL_20_u2 65535. _CNV_A_R_A_105_CM 0. 65535. DISPLAY_IDENTIFIER Pxx_dgdftmng_dtc_cru.Cxx_dtc_hmb_xxx /end CHARACTERISTIC
/begin CHARACTERISTIC Ctx_ffm_did_cru_sl[0] "" VALUE 0xa002ab70 _REC_S1VAL_20_u2 65535. _CNV_A_R_A_105_CM 0. 65535. DISPLAY_IDENTIFIER Pxx_dgdftmng_dtc_cru_sl.Ctx_ffm_did_xxx[0] /end CHARACTERISTIC
/begin CHARACTERISTIC Ctx_ffm_did_cru_sl[1] "" VALUE 0xa002ab72 _REC_S1VAL_20_u2 65535. _CNV_A_R_A_105_CM 0. 65535. DISPLAY_IDENTIFIER Pxx_dgdftmng_dtc_cru_sl.Ctx_ffm_did_xxx[1] /end CHARACTERISTIC
/begin CHARACTERISTIC Ctx_ffm_did_cru_sl[2] "" VALUE 0xa002ab74 _REC_S1VAL_20_u2 65535. _CNV_A_R_A_105_CM 0. 65535. DISPLAY_IDENTIFIER Pxx_dgdftmng_dtc_cru_sl.Ctx_ffm_did_xxx[2] /end CHARACTERISTIC
/begin CHARACTERISTIC Ctx_ffm_did_cru_sl[3] "" VALUE 0xa002ab76 _REC_S1VAL_20_u2 65535. _CNV_A_R_A_105_CM 0. 65535. DISPLAY_IDENTIFIER Pxx_dgdftmng_dtc_cru_sl.Ctx_ffm_did_xxx[3] /end CHARACTERISTIC
/begin CHARACTERISTIC Ctx_ffm_did_cru_sl[4] "" VALUE 0xa002ab78 _REC_S1VAL_20_u2 65535. _CNV_A_R_A_105_CM 0. 65535. DISPLAY_IDENTIFIER Pxx_dgdftmng_dtc_cru_sl.Ctx_ffm_did_xxx[4] /end CHARACTERISTIC
/begin CHARACTERISTIC Cxx_dtc_hmb_cru_sl "" VALUE 0xa002ab7a _REC_S1VAL_20_u2 65535. _CNV_A_R_A_105_CM 0. 65535. DISPLAY_IDENTIFIER Pxx_dgdftmng_dtc_cru_sl.Cxx_dtc_hmb_xxx /end CHARACTERISTIC
/begin CHARACTERISTIC Ctx_ffm_did_cru_sl_swi[0] "" VALUE 0xa002ab64 _REC_S1VAL_20_u2 65535. _CNV_A_R_A_105_CM 0. 65535. DISPLAY_IDENTIFIER Pxx_dgdftmng_dtc_cru_sl_swi.Ctx_ffm_did_xxx[0] /end CHARACTERISTIC
/begin CHARACTERISTIC Ctx_ffm_did_cru_sl_swi[1] "" VALUE 0xa002ab66 _REC_S1VAL_20_u2 65535. _CNV_A_R_A_105_CM 0. 65535. DISPLAY_IDENTIFIER Pxx_dgdftmng_dtc_cru_sl_swi.Ctx_ffm_did_xxx[1] /end CHARACTERISTIC
/begin CHARACTERISTIC Ctx_ffm_did_cru_sl_swi[2] "" VALUE 0xa002ab68 _REC_S1VAL_20_u2 65535. _CNV_A_R_A_105_CM 0. 65535. DISPLAY_IDENTIFIER Pxx_dgdftmng_dtc_cru_sl_swi.Ctx_ffm_did_xxx[2] /end CHARACTERISTIC
/begin CHARACTERISTIC Ctx_ffm_did_cru_sl_swi[3] "" VALUE 0xa002ab6a _REC_S1VAL_20_u2 65535. _CNV_A_R_A_105_CM 0. 65535. DISPLAY_IDENTIFIER Pxx_dgdftmng_dtc_cru_sl_swi.Ctx_ffm_did_xxx[3] /end CHARACTERISTIC
/begin CHARACTERISTIC Ctx_ffm_did_cru_sl_swi[4] "" VALUE 0xa002ab6c _REC_S1VAL_20_u2 65535. _CNV_A_R_A_105_CM 0. 65535. DISPLAY_IDENTIFIER Pxx_dgdftmng_dtc_cru_sl_swi.Ctx_ffm_did_xxx[4] /end CHARACTERISTIC
/begin CHARACTERISTIC Cxx_dtc_hmb_cru_sl_swi "" VALUE 0xa002ab6e _REC_S1VAL_20_u2 65535. _CNV_A_R_A_105_CM 0. 65535. DISPLAY_IDENTIFIER Pxx_dgdftmng_dtc_cru_sl_swi.Cxx_dtc_hmb_xxx /end CHARACTERISTIC
/begin CHARACTERISTIC Ctx_ffm_did_cru_vs[0] "" VALUE 0xa002ab7c _REC_S1VAL_20_u2 65535. _CNV_A_R_A_105_CM 0. 65535. DISPLAY_IDENTIFIER Pxx_dgdftmng_dtc_cru_vs.Ctx_ffm_did_xxx[0] /end CHARACTERISTIC
/begin CHARACTERISTIC Ctx_ffm_did_cru_vs[1] "" VALUE 0xa002ab7e _REC_S1VAL_20_u2 65535. _CNV_A_R_A_105_CM 0. 65535. DISPLAY_IDENTIFIER Pxx_dgdftmng_dtc_cru_vs.Ctx_ffm_did_xxx[1] /end CHARACTERISTIC
/begin CHARACTERISTIC Ctx_ffm_did_cru_vs[2] "" VALUE 0xa002ab80 _REC_S1VAL_20_u2 65535. _CNV_A_R_A_105_CM 0. 65535. DISPLAY_IDENTIFIER Pxx_dgdftmng_dtc_cru_vs.Ctx_ffm_did_xxx[2] /end CHARACTERISTIC
/begin CHARACTERISTIC Ctx_ffm_did_cru_vs[3] "" VALUE 0xa002ab82 _REC_S1VAL_20_u2 65535. _CNV_A_R_A_105_CM 0. 65535. DISPLAY_IDENTIFIER Pxx_dgdftmng_dtc_cru_vs.Ctx_ffm_did_xxx[3] /end CHARACTERISTIC
/begin CHARACTERISTIC Ctx_ffm_did_cru_vs[4] "" VALUE 0xa002ab84 _REC_S1VAL_20_u2 65535. _CNV_A_R_A_105_CM 0. 65535. DISPLAY_IDENTIFIER Pxx_dgdftmng_dtc_cru_vs.Ctx_ffm_did_xxx[4] /end CHARACTERISTIC
/begin CHARACTERISTIC Cxx_dtc_hmb_cru_vs "" VALUE 0xa002ab86 _REC_S1VAL_20_u2 65535. _CNV_A_R_A_105_CM 0. 65535. DISPLAY_IDENTIFIER Pxx_dgdftmng_dtc_cru_vs.Cxx_dtc_hmb_xxx /end CHARACTERISTIC
/begin CHARACTERISTIC Ctx_ffm_did_cru_whl_cmd[0] "" VALUE 0xa002ab88 _REC_S1VAL_20_u2 65535. _CNV_A_R_A_105_CM 0. 65535. DISPLAY_IDENTIFIER Pxx_dgdftmng_dtc_cru_whl_cmd.Ctx_ffm_did_xxx[0] /end CHARACTERISTIC
/begin CHARACTERISTIC Ctx_ffm_did_cru_whl_cmd[1] "" VALUE 0xa002ab8a _REC_S1VAL_20_u2 65535. _CNV_A_R_A_105_CM 0. 65535. DISPLAY_IDENTIFIER Pxx_dgdftmng_dtc_cru_whl_cmd.Ctx_ffm_did_xxx[1] /end CHARACTERISTIC
/begin CHARACTERISTIC Ctx_ffm_did_cru_whl_cmd[2] "" VALUE 0xa002ab8c _REC_S1VAL_20_u2 65535. _CNV_A_R_A_105_CM 0. 65535. DISPLAY_IDENTIFIER Pxx_dgdftmng_dtc_cru_whl_cmd.Ctx_ffm_did_xxx[2] /end CHARACTERISTIC
/begin CHARACTERISTIC Ctx_ffm_did_cru_whl_cmd[3] "" VALUE 0xa002ab8e _REC_S1VAL_20_u2 65535. _CNV_A_R_A_105_CM 0. 65535. DISPLAY_IDENTIFIER Pxx_dgdftmng_dtc_cru_whl_cmd.Ctx_ffm_did_xxx[3] /end CHARACTERISTIC
/begin CHARACTERISTIC Ctx_ffm_did_cru_whl_cmd[4] "" VALUE 0xa002ab90 _REC_S1VAL_20_u2 65535. _CNV_A_R_A_105_CM 0. 65535. DISPLAY_IDENTIFIER Pxx_dgdftmng_dtc_cru_whl_cmd.Ctx_ffm_did_xxx[4] /end CHARACTERISTIC
/begin CHARACTERISTIC Cxx_dtc_hmb_cru_whl_cmd "" VALUE 0xa002ab92 _REC_S1VAL_20_u2 65535. _CNV_A_R_A_105_CM 0. 65535. DISPLAY_IDENTIFIER Pxx_dgdftmng_dtc_cru_whl_cmd.Cxx_dtc_hmb_xxx /end CHARACTERISTIC
/begin CHARACTERISTIC Ctx_ffm_did_ecm_adc[0] "" VALUE 0xa002acd8 _REC_S1VAL_20_u2 65535. _CNV_A_R_A_105_CM 0. 65535. DISPLAY_IDENTIFIER Pxx_dgdftmng_dtc_ecm_adc.Ctx_ffm_did_xxx[0] /end CHARACTERISTIC
/begin CHARACTERISTIC Ctx_ffm_did_ecm_adc[1] "" VALUE 0xa002acda _REC_S1VAL_20_u2 65535. _CNV_A_R_A_105_CM 0. 65535. DISPLAY_IDENTIFIER Pxx_dgdftmng_dtc_ecm_adc.Ctx_ffm_did_xxx[1] /end CHARACTERISTIC
/begin CHARACTERISTIC Ctx_ffm_did_ecm_adc[2] "" VALUE 0xa002acdc _REC_S1VAL_20_u2 65535. _CNV_A_R_A_105_CM 0. 65535. DISPLAY_IDENTIFIER Pxx_dgdftmng_dtc_ecm_adc.Ctx_ffm_did_xxx[2] /end CHARACTERISTIC
/begin CHARACTERISTIC Ctx_ffm_did_ecm_adc[3] "" VALUE 0xa002acde _REC_S1VAL_20_u2 65535. _CNV_A_R_A_105_CM 0. 65535. DISPLAY_IDENTIFIER Pxx_dgdftmng_dtc_ecm_adc.Ctx_ffm_did_xxx[3] /end CHARACTERISTIC
/begin CHARACTERISTIC Ctx_ffm_did_ecm_adc[4] "" VALUE 0xa002ace0 _REC_S1VAL_20_u2 65535. _CNV_A_R_A_105_CM 0. 65535. DISPLAY_IDENTIFIER Pxx_dgdftmng_dtc_ecm_adc.Ctx_ffm_did_xxx[4] /end CHARACTERISTIC
/begin CHARACTERISTIC Cxx_dtc_hmb_ecm_adc "" VALUE 0xa002ace2 _REC_S1VAL_20_u2 65535. _CNV_A_R_A_105_CM 0. 65535. DISPLAY_IDENTIFIER Pxx_dgdftmng_dtc_ecm_adc.Cxx_dtc_hmb_xxx /end CHARACTERISTIC
/begin CHARACTERISTIC Ctx_ffm_did_ecm_err[0] "" VALUE 0xa002aca8 _REC_S1VAL_20_u2 65535. _CNV_A_R_A_105_CM 0. 65535. DISPLAY_IDENTIFIER Pxx_dgdftmng_dtc_ecm_err.Ctx_ffm_did_xxx[0] /end CHARACTERISTIC
/begin CHARACTERISTIC Ctx_ffm_did_ecm_err[1] "" VALUE 0xa002acaa _REC_S1VAL_20_u2 65535. _CNV_A_R_A_105_CM 0. 65535. DISPLAY_IDENTIFIER Pxx_dgdftmng_dtc_ecm_err.Ctx_ffm_did_xxx[1] /end CHARACTERISTIC
/begin CHARACTERISTIC Ctx_ffm_did_ecm_err[2] "" VALUE 0xa002acac _REC_S1VAL_20_u2 65535. _CNV_A_R_A_105_CM 0. 65535. DISPLAY_IDENTIFIER Pxx_dgdftmng_dtc_ecm_err.Ctx_ffm_did_xxx[2] /end CHARACTERISTIC
/begin CHARACTERISTIC Ctx_ffm_did_ecm_err[3] "" VALUE 0xa002acae _REC_S1VAL_20_u2 65535. _CNV_A_R_A_105_CM 0. 65535. DISPLAY_IDENTIFIER Pxx_dgdftmng_dtc_ecm_err.Ctx_ffm_did_xxx[3] /end CHARACTERISTIC
/begin CHARACTERISTIC Ctx_ffm_did_ecm_err[4] "" VALUE 0xa002acb0 _REC_S1VAL_20_u2 65535. _CNV_A_R_A_105_CM 0. 65535. DISPLAY_IDENTIFIER Pxx_dgdftmng_dtc_ecm_err.Ctx_ffm_did_xxx[4] /end CHARACTERISTIC
/begin CHARACTERISTIC Cxx_dtc_hmb_ecm_err "" VALUE 0xa002acb2 _REC_S1VAL_20_u2 65535. _CNV_A_R_A_105_CM 0. 65535. DISPLAY_IDENTIFIER Pxx_dgdftmng_dtc_ecm_err.Cxx_dtc_hmb_xxx /end CHARACTERISTIC
/begin CHARACTERISTIC Ctx_ffm_did_ecm_mon[0] "" VALUE 0xa002acb4 _REC_S1VAL_20_u2 65535. _CNV_A_R_A_105_CM 0. 65535. DISPLAY_IDENTIFIER Pxx_dgdftmng_dtc_ecm_mon.Ctx_ffm_did_xxx[0] /end CHARACTERISTIC
/begin CHARACTERISTIC Ctx_ffm_did_ecm_mon[1] "" VALUE 0xa002acb6 _REC_S1VAL_20_u2 65535. _CNV_A_R_A_105_CM 0. 65535. DISPLAY_IDENTIFIER Pxx_dgdftmng_dtc_ecm_mon.Ctx_ffm_did_xxx[1] /end CHARACTERISTIC
/begin CHARACTERISTIC Ctx_ffm_did_ecm_mon[2] "" VALUE 0xa002acb8 _REC_S1VAL_20_u2 65535. _CNV_A_R_A_105_CM 0. 65535. DISPLAY_IDENTIFIER Pxx_dgdftmng_dtc_ecm_mon.Ctx_ffm_did_xxx[2] /end CHARACTERISTIC
/begin CHARACTERISTIC Ctx_ffm_did_ecm_mon[3] "" VALUE 0xa002acba _REC_S1VAL_20_u2 65535. _CNV_A_R_A_105_CM 0. 65535. DISPLAY_IDENTIFIER Pxx_dgdftmng_dtc_ecm_mon.Ctx_ffm_did_xxx[3] /end CHARACTERISTIC
/begin CHARACTERISTIC Ctx_ffm_did_ecm_mon[4] "" VALUE 0xa002acbc _REC_S1VAL_20_u2 65535. _CNV_A_R_A_105_CM 0. 65535. DISPLAY_IDENTIFIER Pxx_dgdftmng_dtc_ecm_mon.Ctx_ffm_did_xxx[4] /end CHARACTERISTIC
/begin CHARACTERISTIC Cxx_dtc_hmb_ecm_mon "" VALUE 0xa002acbe _REC_S1VAL_20_u2 65535. _CNV_A_R_A_105_CM 0. 65535. DISPLAY_IDENTIFIER Pxx_dgdftmng_dtc_ecm_mon.Cxx_dtc_hmb_xxx /end CHARACTERISTIC
/begin CHARACTERISTIC Ctx_ffm_did_efi_sldv_2[0] "" VALUE 0xa002ad8c _REC_S1VAL_20_u2 65535. _CNV_A_R_A_105_CM 0. 65535. DISPLAY_IDENTIFIER Pxx_dgdftmng_dtc_efi_sldv_2.Ctx_ffm_did_xxx[0] /end CHARACTERISTIC
/begin CHARACTERISTIC Ctx_ffm_did_efi_sldv_2[1] "" VALUE 0xa002ad8e _REC_S1VAL_20_u2 65535. _CNV_A_R_A_105_CM 0. 65535. DISPLAY_IDENTIFIER Pxx_dgdftmng_dtc_efi_sldv_2.Ctx_ffm_did_xxx[1] /end CHARACTERISTIC
/begin CHARACTERISTIC Ctx_ffm_did_efi_sldv_2[2] "" VALUE 0xa002ad90 _REC_S1VAL_20_u2 65535. _CNV_A_R_A_105_CM 0. 65535. DISPLAY_IDENTIFIER Pxx_dgdftmng_dtc_efi_sldv_2.Ctx_ffm_did_xxx[2] /end CHARACTERISTIC
/begin CHARACTERISTIC Ctx_ffm_did_efi_sldv_2[3] "" VALUE 0xa002ad92 _REC_S1VAL_20_u2 65535. _CNV_A_R_A_105_CM 0. 65535. DISPLAY_IDENTIFIER Pxx_dgdftmng_dtc_efi_sldv_2.Ctx_ffm_did_xxx[3] /end CHARACTERISTIC
/begin CHARACTERISTIC Ctx_ffm_did_efi_sldv_2[4] "" VALUE 0xa002ad94 _REC_S1VAL_20_u2 65535. _CNV_A_R_A_105_CM 0. 65535. DISPLAY_IDENTIFIER Pxx_dgdftmng_dtc_efi_sldv_2.Ctx_ffm_did_xxx[4] /end CHARACTERISTIC
/begin CHARACTERISTIC Cxx_dtc_hmb_efi_sldv_2 "" VALUE 0xa002ad96 _REC_S1VAL_20_u2 65535. _CNV_A_R_A_105_CM 0. 65535. DISPLAY_IDENTIFIER Pxx_dgdftmng_dtc_efi_sldv_2.Cxx_dtc_hmb_xxx /end CHARACTERISTIC
/begin CHARACTERISTIC Ctx_ffm_did_esp[0] "" VALUE 0xa002a9e4 _REC_S1VAL_20_u2 65535. _CNV_A_R_A_105_CM 0. 65535. DISPLAY_IDENTIFIER Pxx_dgdftmng_dtc_esp.Ctx_ffm_did_xxx[0] /end CHARACTERISTIC
/begin CHARACTERISTIC Ctx_ffm_did_esp[1] "" VALUE 0xa002a9e6 _REC_S1VAL_20_u2 65535. _CNV_A_R_A_105_CM 0. 65535. DISPLAY_IDENTIFIER Pxx_dgdftmng_dtc_esp.Ctx_ffm_did_xxx[1] /end CHARACTERISTIC
/begin CHARACTERISTIC Ctx_ffm_did_esp[2] "" VALUE 0xa002a9e8 _REC_S1VAL_20_u2 65535. _CNV_A_R_A_105_CM 0. 65535. DISPLAY_IDENTIFIER Pxx_dgdftmng_dtc_esp.Ctx_ffm_did_xxx[2] /end CHARACTERISTIC
/begin CHARACTERISTIC Ctx_ffm_did_esp[3] "" VALUE 0xa002a9ea _REC_S1VAL_20_u2 65535. _CNV_A_R_A_105_CM 0. 65535. DISPLAY_IDENTIFIER Pxx_dgdftmng_dtc_esp.Ctx_ffm_did_xxx[3] /end CHARACTERISTIC
/begin CHARACTERISTIC Ctx_ffm_did_esp[4] "" VALUE 0xa002a9ec _REC_S1VAL_20_u2 65535. _CNV_A_R_A_105_CM 0. 65535. DISPLAY_IDENTIFIER Pxx_dgdftmng_dtc_esp.Ctx_ffm_did_xxx[4] /end CHARACTERISTIC
/begin CHARACTERISTIC Cxx_dtc_hmb_esp "" VALUE 0xa002a9ee _REC_S1VAL_20_u2 65535. _CNV_A_R_A_105_CM 0. 65535. DISPLAY_IDENTIFIER Pxx_dgdftmng_dtc_esp.Cxx_dtc_hmb_xxx /end CHARACTERISTIC
/begin CHARACTERISTIC Ctx_ffm_did_esp_data[0] "" VALUE 0xa002a9d8 _REC_S1VAL_20_u2 65535. _CNV_A_R_A_105_CM 0. 65535. DISPLAY_IDENTIFIER Pxx_dgdftmng_dtc_esp_data.Ctx_ffm_did_xxx[0] /end CHARACTERISTIC
/begin CHARACTERISTIC Ctx_ffm_did_esp_data[1] "" VALUE 0xa002a9da _REC_S1VAL_20_u2 65535. _CNV_A_R_A_105_CM 0. 65535. DISPLAY_IDENTIFIER Pxx_dgdftmng_dtc_esp_data.Ctx_ffm_did_xxx[1] /end CHARACTERISTIC
/begin CHARACTERISTIC Ctx_ffm_did_esp_data[2] "" VALUE 0xa002a9dc _REC_S1VAL_20_u2 65535. _CNV_A_R_A_105_CM 0. 65535. DISPLAY_IDENTIFIER Pxx_dgdftmng_dtc_esp_data.Ctx_ffm_did_xxx[2] /end CHARACTERISTIC
/begin CHARACTERISTIC Ctx_ffm_did_esp_data[3] "" VALUE 0xa002a9de _REC_S1VAL_20_u2 65535. _CNV_A_R_A_105_CM 0. 65535. DISPLAY_IDENTIFIER Pxx_dgdftmng_dtc_esp_data.Ctx_ffm_did_xxx[3] /end CHARACTERISTIC
/begin CHARACTERISTIC Ctx_ffm_did_esp_data[4] "" VALUE 0xa002a9e0 _REC_S1VAL_20_u2 65535. _CNV_A_R_A_105_CM 0. 65535. DISPLAY_IDENTIFIER Pxx_dgdftmng_dtc_esp_data.Ctx_ffm_did_xxx[4] /end CHARACTERISTIC
/begin CHARACTERISTIC Cxx_dtc_hmb_esp_data "" VALUE 0xa002a9e2 _REC_S1VAL_20_u2 65535. _CNV_A_R_A_105_CM 0. 65535. DISPLAY_IDENTIFIER Pxx_dgdftmng_dtc_esp_data.Cxx_dtc_hmb_xxx /end CHARACTERISTIC
/begin CHARACTERISTIC Ctx_ffm_did_eva_fcap[0] "" VALUE 0xa002acf0 _REC_S1VAL_20_u2 65535. _CNV_A_R_A_105_CM 0. 65535. DISPLAY_IDENTIFIER Pxx_dgdftmng_dtc_eva_fcap.Ctx_ffm_did_xxx[0] /end CHARACTERISTIC
/begin CHARACTERISTIC Ctx_ffm_did_eva_fcap[1] "" VALUE 0xa002acf2 _REC_S1VAL_20_u2 65535. _CNV_A_R_A_105_CM 0. 65535. DISPLAY_IDENTIFIER Pxx_dgdftmng_dtc_eva_fcap.Ctx_ffm_did_xxx[1] /end CHARACTERISTIC
/begin CHARACTERISTIC Ctx_ffm_did_eva_fcap[2] "" VALUE 0xa002acf4 _REC_S1VAL_20_u2 65535. _CNV_A_R_A_105_CM 0. 65535. DISPLAY_IDENTIFIER Pxx_dgdftmng_dtc_eva_fcap.Ctx_ffm_did_xxx[2] /end CHARACTERISTIC
/begin CHARACTERISTIC Ctx_ffm_did_eva_fcap[3] "" VALUE 0xa002acf6 _REC_S1VAL_20_u2 65535. _CNV_A_R_A_105_CM 0. 65535. DISPLAY_IDENTIFIER Pxx_dgdftmng_dtc_eva_fcap.Ctx_ffm_did_xxx[3] /end CHARACTERISTIC
/begin CHARACTERISTIC Ctx_ffm_did_eva_fcap[4] "" VALUE 0xa002acf8 _REC_S1VAL_20_u2 65535. _CNV_A_R_A_105_CM 0. 65535. DISPLAY_IDENTIFIER Pxx_dgdftmng_dtc_eva_fcap.Ctx_ffm_did_xxx[4] /end CHARACTERISTIC
/begin CHARACTERISTIC Cxx_dtc_hmb_eva_fcap "" VALUE 0xa002acfa _REC_S1VAL_20_u2 65535. _CNV_A_R_A_105_CM 0. 65535. DISPLAY_IDENTIFIER Pxx_dgdftmng_dtc_eva_fcap.Cxx_dtc_hmb_xxx /end CHARACTERISTIC
/begin CHARACTERISTIC Ctx_ffm_did_eva_sldv[0] "" VALUE 0xa002acfc _REC_S1VAL_20_u2 65535. _CNV_A_R_A_105_CM 0. 65535. DISPLAY_IDENTIFIER Pxx_dgdftmng_dtc_eva_sldv.Ctx_ffm_did_xxx[0] /end CHARACTERISTIC
/begin CHARACTERISTIC Ctx_ffm_did_eva_sldv[1] "" VALUE 0xa002acfe _REC_S1VAL_20_u2 65535. _CNV_A_R_A_105_CM 0. 65535. DISPLAY_IDENTIFIER Pxx_dgdftmng_dtc_eva_sldv.Ctx_ffm_did_xxx[1] /end CHARACTERISTIC
/begin CHARACTERISTIC Ctx_ffm_did_eva_sldv[2] "" VALUE 0xa002ad00 _REC_S1VAL_20_u2 65535. _CNV_A_R_A_105_CM 0. 65535. DISPLAY_IDENTIFIER Pxx_dgdftmng_dtc_eva_sldv.Ctx_ffm_did_xxx[2] /end CHARACTERISTIC
/begin CHARACTERISTIC Ctx_ffm_did_eva_sldv[3] "" VALUE 0xa002ad02 _REC_S1VAL_20_u2 65535. _CNV_A_R_A_105_CM 0. 65535. DISPLAY_IDENTIFIER Pxx_dgdftmng_dtc_eva_sldv.Ctx_ffm_did_xxx[3] /end CHARACTERISTIC
/begin CHARACTERISTIC Ctx_ffm_did_eva_sldv[4] "" VALUE 0xa002ad04 _REC_S1VAL_20_u2 65535. _CNV_A_R_A_105_CM 0. 65535. DISPLAY_IDENTIFIER Pxx_dgdftmng_dtc_eva_sldv.Ctx_ffm_did_xxx[4] /end CHARACTERISTIC
/begin CHARACTERISTIC Cxx_dtc_hmb_eva_sldv "" VALUE 0xa002ad06 _REC_S1VAL_20_u2 65535. _CNV_A_R_A_105_CM 0. 65535. DISPLAY_IDENTIFIER Pxx_dgdftmng_dtc_eva_sldv.Cxx_dtc_hmb_xxx /end CHARACTERISTIC
/begin CHARACTERISTIC Ctx_ffm_did_evap[0] "" VALUE 0xa002ace4 _REC_S1VAL_20_u2 65535. _CNV_A_R_A_105_CM 0. 65535. DISPLAY_IDENTIFIER Pxx_dgdftmng_dtc_evap.Ctx_ffm_did_xxx[0] /end CHARACTERISTIC
/begin CHARACTERISTIC Ctx_ffm_did_evap[1] "" VALUE 0xa002ace6 _REC_S1VAL_20_u2 65535. _CNV_A_R_A_105_CM 0. 65535. DISPLAY_IDENTIFIER Pxx_dgdftmng_dtc_evap.Ctx_ffm_did_xxx[1] /end CHARACTERISTIC
/begin CHARACTERISTIC Ctx_ffm_did_evap[2] "" VALUE 0xa002ace8 _REC_S1VAL_20_u2 65535. _CNV_A_R_A_105_CM 0. 65535. DISPLAY_IDENTIFIER Pxx_dgdftmng_dtc_evap.Ctx_ffm_did_xxx[2] /end CHARACTERISTIC
/begin CHARACTERISTIC Ctx_ffm_did_evap[3] "" VALUE 0xa002acea _REC_S1VAL_20_u2 65535. _CNV_A_R_A_105_CM 0. 65535. DISPLAY_IDENTIFIER Pxx_dgdftmng_dtc_evap.Ctx_ffm_did_xxx[3] /end CHARACTERISTIC
/begin CHARACTERISTIC Ctx_ffm_did_evap[4] "" VALUE 0xa002acec _REC_S1VAL_20_u2 65535. _CNV_A_R_A_105_CM 0. 65535. DISPLAY_IDENTIFIER Pxx_dgdftmng_dtc_evap.Ctx_ffm_did_xxx[4] /end CHARACTERISTIC
/begin CHARACTERISTIC Cxx_dtc_hmb_evap "" VALUE 0xa002acee _REC_S1VAL_20_u2 65535. _CNV_A_R_A_105_CM 0. 65535. DISPLAY_IDENTIFIER Pxx_dgdftmng_dtc_evap.Cxx_dtc_hmb_xxx /end CHARACTERISTIC
/begin CHARACTERISTIC Ctx_ffm_did_fsys[0] "" VALUE 0xa002ab94 _REC_S1VAL_20_u2 65535. _CNV_A_R_A_105_CM 0. 65535. DISPLAY_IDENTIFIER Pxx_dgdftmng_dtc_fsys.Ctx_ffm_did_xxx[0] /end CHARACTERISTIC
/begin CHARACTERISTIC Ctx_ffm_did_fsys[1] "" VALUE 0xa002ab96 _REC_S1VAL_20_u2 65535. _CNV_A_R_A_105_CM 0. 65535. DISPLAY_IDENTIFIER Pxx_dgdftmng_dtc_fsys.Ctx_ffm_did_xxx[1] /end CHARACTERISTIC
/begin CHARACTERISTIC Ctx_ffm_did_fsys[2] "" VALUE 0xa002ab98 _REC_S1VAL_20_u2 65535. _CNV_A_R_A_105_CM 0. 65535. DISPLAY_IDENTIFIER Pxx_dgdftmng_dtc_fsys.Ctx_ffm_did_xxx[2] /end CHARACTERISTIC
/begin CHARACTERISTIC Ctx_ffm_did_fsys[3] "" VALUE 0xa002ab9a _REC_S1VAL_20_u2 65535. _CNV_A_R_A_105_CM 0. 65535. DISPLAY_IDENTIFIER Pxx_dgdftmng_dtc_fsys.Ctx_ffm_did_xxx[3] /end CHARACTERISTIC
/begin CHARACTERISTIC Ctx_ffm_did_fsys[4] "" VALUE 0xa002ab9c _REC_S1VAL_20_u2 65535. _CNV_A_R_A_105_CM 0. 65535. DISPLAY_IDENTIFIER Pxx_dgdftmng_dtc_fsys.Ctx_ffm_did_xxx[4] /end CHARACTERISTIC
/begin CHARACTERISTIC Cxx_dtc_hmb_fsys "" VALUE 0xa002ab9e _REC_S1VAL_20_u2 65535. _CNV_A_R_A_105_CM 0. 65535. DISPLAY_IDENTIFIER Pxx_dgdftmng_dtc_fsys.Cxx_dtc_hmb_xxx /end CHARACTERISTIC
/begin CHARACTERISTIC Ctx_ffm_did_gas_pump[0] "" VALUE 0xa002a9f0 _REC_S1VAL_20_u2 65535. _CNV_A_R_A_105_CM 0. 65535. DISPLAY_IDENTIFIER Pxx_dgdftmng_dtc_gas_pump.Ctx_ffm_did_xxx[0] /end CHARACTERISTIC
/begin CHARACTERISTIC Ctx_ffm_did_gas_pump[1] "" VALUE 0xa002a9f2 _REC_S1VAL_20_u2 65535. _CNV_A_R_A_105_CM 0. 65535. DISPLAY_IDENTIFIER Pxx_dgdftmng_dtc_gas_pump.Ctx_ffm_did_xxx[1] /end CHARACTERISTIC
/begin CHARACTERISTIC Ctx_ffm_did_gas_pump[2] "" VALUE 0xa002a9f4 _REC_S1VAL_20_u2 65535. _CNV_A_R_A_105_CM 0. 65535. DISPLAY_IDENTIFIER Pxx_dgdftmng_dtc_gas_pump.Ctx_ffm_did_xxx[2] /end CHARACTERISTIC
/begin CHARACTERISTIC Ctx_ffm_did_gas_pump[3] "" VALUE 0xa002a9f6 _REC_S1VAL_20_u2 65535. _CNV_A_R_A_105_CM 0. 65535. DISPLAY_IDENTIFIER Pxx_dgdftmng_dtc_gas_pump.Ctx_ffm_did_xxx[3] /end CHARACTERISTIC
/begin CHARACTERISTIC Ctx_ffm_did_gas_pump[4] "" VALUE 0xa002a9f8 _REC_S1VAL_20_u2 65535. _CNV_A_R_A_105_CM 0. 65535. DISPLAY_IDENTIFIER Pxx_dgdftmng_dtc_gas_pump.Ctx_ffm_did_xxx[4] /end CHARACTERISTIC
/begin CHARACTERISTIC Cxx_dtc_hmb_gas_pump "" VALUE 0xa002a9fa _REC_S1VAL_20_u2 65535. _CNV_A_R_A_105_CM 0. 65535. DISPLAY_IDENTIFIER Pxx_dgdftmng_dtc_gas_pump.Cxx_dtc_hmb_xxx /end CHARACTERISTIC
/begin CHARACTERISTIC Ctx_ffm_did_gas_pump_2[0] "" VALUE 0xa002ad98 _REC_S1VAL_20_u2 65535. _CNV_A_R_A_105_CM 0. 65535. DISPLAY_IDENTIFIER Pxx_dgdftmng_dtc_gas_pump_2.Ctx_ffm_did_xxx[0] /end CHARACTERISTIC
/begin CHARACTERISTIC Ctx_ffm_did_gas_pump_2[1] "" VALUE 0xa002ad9a _REC_S1VAL_20_u2 65535. _CNV_A_R_A_105_CM 0. 65535. DISPLAY_IDENTIFIER Pxx_dgdftmng_dtc_gas_pump_2.Ctx_ffm_did_xxx[1] /end CHARACTERISTIC
/begin CHARACTERISTIC Ctx_ffm_did_gas_pump_2[2] "" VALUE 0xa002ad9c _REC_S1VAL_20_u2 65535. _CNV_A_R_A_105_CM 0. 65535. DISPLAY_IDENTIFIER Pxx_dgdftmng_dtc_gas_pump_2.Ctx_ffm_did_xxx[2] /end CHARACTERISTIC
/begin CHARACTERISTIC Ctx_ffm_did_gas_pump_2[3] "" VALUE 0xa002ad9e _REC_S1VAL_20_u2 65535. _CNV_A_R_A_105_CM 0. 65535. DISPLAY_IDENTIFIER Pxx_dgdftmng_dtc_gas_pump_2.Ctx_ffm_did_xxx[3] /end CHARACTERISTIC
/begin CHARACTERISTIC Ctx_ffm_did_gas_pump_2[4] "" VALUE 0xa002ada0 _REC_S1VAL_20_u2 65535. _CNV_A_R_A_105_CM 0. 65535. DISPLAY_IDENTIFIER Pxx_dgdftmng_dtc_gas_pump_2.Ctx_ffm_did_xxx[4] /end CHARACTERISTIC
/begin CHARACTERISTIC Cxx_dtc_hmb_gas_pump_2 "" VALUE 0xa002ada2 _REC_S1VAL_20_u2 65535. _CNV_A_R_A_105_CM 0. 65535. DISPLAY_IDENTIFIER Pxx_dgdftmng_dtc_gas_pump_2.Cxx_dtc_hmb_xxx /end CHARACTERISTIC
/begin CHARACTERISTIC Ctx_ffm_did_igc_1[0] "" VALUE 0xa002ad14 _REC_S1VAL_20_u2 65535. _CNV_A_R_A_105_CM 0. 65535. DISPLAY_IDENTIFIER Pxx_dgdftmng_dtc_igc_1.Ctx_ffm_did_xxx[0] /end CHARACTERISTIC
/begin CHARACTERISTIC Ctx_ffm_did_igc_1[1] "" VALUE 0xa002ad16 _REC_S1VAL_20_u2 65535. _CNV_A_R_A_105_CM 0. 65535. DISPLAY_IDENTIFIER Pxx_dgdftmng_dtc_igc_1.Ctx_ffm_did_xxx[1] /end CHARACTERISTIC
/begin CHARACTERISTIC Ctx_ffm_did_igc_1[2] "" VALUE 0xa002ad18 _REC_S1VAL_20_u2 65535. _CNV_A_R_A_105_CM 0. 65535. DISPLAY_IDENTIFIER Pxx_dgdftmng_dtc_igc_1.Ctx_ffm_did_xxx[2] /end CHARACTERISTIC
/begin CHARACTERISTIC Ctx_ffm_did_igc_1[3] "" VALUE 0xa002ad1a _REC_S1VAL_20_u2 65535. _CNV_A_R_A_105_CM 0. 65535. DISPLAY_IDENTIFIER Pxx_dgdftmng_dtc_igc_1.Ctx_ffm_did_xxx[3] /end CHARACTERISTIC
/begin CHARACTERISTIC Ctx_ffm_did_igc_1[4] "" VALUE 0xa002ad1c _REC_S1VAL_20_u2 65535. _CNV_A_R_A_105_CM 0. 65535. DISPLAY_IDENTIFIER Pxx_dgdftmng_dtc_igc_1.Ctx_ffm_did_xxx[4] /end CHARACTERISTIC
/begin CHARACTERISTIC Cxx_dtc_hmb_igc_1 "" VALUE 0xa002ad1e _REC_S1VAL_20_u2 65535. _CNV_A_R_A_105_CM 0. 65535. DISPLAY_IDENTIFIER Pxx_dgdftmng_dtc_igc_1.Cxx_dtc_hmb_xxx /end CHARACTERISTIC
/begin CHARACTERISTIC Ctx_ffm_did_igc_2[0] "" VALUE 0xa002ad20 _REC_S1VAL_20_u2 65535. _CNV_A_R_A_105_CM 0. 65535. DISPLAY_IDENTIFIER Pxx_dgdftmng_dtc_igc_2.Ctx_ffm_did_xxx[0] /end CHARACTERISTIC
/begin CHARACTERISTIC Ctx_ffm_did_igc_2[1] "" VALUE 0xa002ad22 _REC_S1VAL_20_u2 65535. _CNV_A_R_A_105_CM 0. 65535. DISPLAY_IDENTIFIER Pxx_dgdftmng_dtc_igc_2.Ctx_ffm_did_xxx[1] /end CHARACTERISTIC
/begin CHARACTERISTIC Ctx_ffm_did_igc_2[2] "" VALUE 0xa002ad24 _REC_S1VAL_20_u2 65535. _CNV_A_R_A_105_CM 0. 65535. DISPLAY_IDENTIFIER Pxx_dgdftmng_dtc_igc_2.Ctx_ffm_did_xxx[2] /end CHARACTERISTIC
/begin CHARACTERISTIC Ctx_ffm_did_igc_2[3] "" VALUE 0xa002ad26 _REC_S1VAL_20_u2 65535. _CNV_A_R_A_105_CM 0. 65535. DISPLAY_IDENTIFIER Pxx_dgdftmng_dtc_igc_2.Ctx_ffm_did_xxx[3] /end CHARACTERISTIC
/begin CHARACTERISTIC Ctx_ffm_did_igc_2[4] "" VALUE 0xa002ad28 _REC_S1VAL_20_u2 65535. _CNV_A_R_A_105_CM 0. 65535. DISPLAY_IDENTIFIER Pxx_dgdftmng_dtc_igc_2.Ctx_ffm_did_xxx[4] /end CHARACTERISTIC
/begin CHARACTERISTIC Cxx_dtc_hmb_igc_2 "" VALUE 0xa002ad2a _REC_S1VAL_20_u2 65535. _CNV_A_R_A_105_CM 0. 65535. DISPLAY_IDENTIFIER Pxx_dgdftmng_dtc_igc_2.Cxx_dtc_hmb_xxx /end CHARACTERISTIC
/begin CHARACTERISTIC Ctx_ffm_did_igc_3[0] "" VALUE 0xa002ad2c _REC_S1VAL_20_u2 65535. _CNV_A_R_A_105_CM 0. 65535. DISPLAY_IDENTIFIER Pxx_dgdftmng_dtc_igc_3.Ctx_ffm_did_xxx[0] /end CHARACTERISTIC
/begin CHARACTERISTIC Ctx_ffm_did_igc_3[1] "" VALUE 0xa002ad2e _REC_S1VAL_20_u2 65535. _CNV_A_R_A_105_CM 0. 65535. DISPLAY_IDENTIFIER Pxx_dgdftmng_dtc_igc_3.Ctx_ffm_did_xxx[1] /end CHARACTERISTIC
/begin CHARACTERISTIC Ctx_ffm_did_igc_3[2] "" VALUE 0xa002ad30 _REC_S1VAL_20_u2 65535. _CNV_A_R_A_105_CM 0. 65535. DISPLAY_IDENTIFIER Pxx_dgdftmng_dtc_igc_3.Ctx_ffm_did_xxx[2] /end CHARACTERISTIC
/begin CHARACTERISTIC Ctx_ffm_did_igc_3[3] "" VALUE 0xa002ad32 _REC_S1VAL_20_u2 65535. _CNV_A_R_A_105_CM 0. 65535. DISPLAY_IDENTIFIER Pxx_dgdftmng_dtc_igc_3.Ctx_ffm_did_xxx[3] /end CHARACTERISTIC
/begin CHARACTERISTIC Ctx_ffm_did_igc_3[4] "" VALUE 0xa002ad34 _REC_S1VAL_20_u2 65535. _CNV_A_R_A_105_CM 0. 65535. DISPLAY_IDENTIFIER Pxx_dgdftmng_dtc_igc_3.Ctx_ffm_did_xxx[4] /end CHARACTERISTIC
/begin CHARACTERISTIC Cxx_dtc_hmb_igc_3 "" VALUE 0xa002ad36 _REC_S1VAL_20_u2 65535. _CNV_A_R_A_105_CM 0. 65535. DISPLAY_IDENTIFIER Pxx_dgdftmng_dtc_igc_3.Cxx_dtc_hmb_xxx /end CHARACTERISTIC
/begin CHARACTERISTIC Ctx_ffm_did_igc_4[0] "" VALUE 0xa002ad38 _REC_S1VAL_20_u2 65535. _CNV_A_R_A_105_CM 0. 65535. DISPLAY_IDENTIFIER Pxx_dgdftmng_dtc_igc_4.Ctx_ffm_did_xxx[0] /end CHARACTERISTIC
/begin CHARACTERISTIC Ctx_ffm_did_igc_4[1] "" VALUE 0xa002ad3a _REC_S1VAL_20_u2 65535. _CNV_A_R_A_105_CM 0. 65535. DISPLAY_IDENTIFIER Pxx_dgdftmng_dtc_igc_4.Ctx_ffm_did_xxx[1] /end CHARACTERISTIC
/begin CHARACTERISTIC Ctx_ffm_did_igc_4[2] "" VALUE 0xa002ad3c _REC_S1VAL_20_u2 65535. _CNV_A_R_A_105_CM 0. 65535. DISPLAY_IDENTIFIER Pxx_dgdftmng_dtc_igc_4.Ctx_ffm_did_xxx[2] /end CHARACTERISTIC
/begin CHARACTERISTIC Ctx_ffm_did_igc_4[3] "" VALUE 0xa002ad3e _REC_S1VAL_20_u2 65535. _CNV_A_R_A_105_CM 0. 65535. DISPLAY_IDENTIFIER Pxx_dgdftmng_dtc_igc_4.Ctx_ffm_did_xxx[3] /end CHARACTERISTIC
/begin CHARACTERISTIC Ctx_ffm_did_igc_4[4] "" VALUE 0xa002ad40 _REC_S1VAL_20_u2 65535. _CNV_A_R_A_105_CM 0. 65535. DISPLAY_IDENTIFIER Pxx_dgdftmng_dtc_igc_4.Ctx_ffm_did_xxx[4] /end CHARACTERISTIC
/begin CHARACTERISTIC Cxx_dtc_hmb_igc_4 "" VALUE 0xa002ad42 _REC_S1VAL_20_u2 65535. _CNV_A_R_A_105_CM 0. 65535. DISPLAY_IDENTIFIER Pxx_dgdftmng_dtc_igc_4.Cxx_dtc_hmb_xxx /end CHARACTERISTIC
/begin CHARACTERISTIC Ctx_ffm_did_in_cam[0] "" VALUE 0xa002ac90 _REC_S1VAL_20_u2 65535. _CNV_A_R_A_105_CM 0. 65535. DISPLAY_IDENTIFIER Pxx_dgdftmng_dtc_in_cam.Ctx_ffm_did_xxx[0] /end CHARACTERISTIC
/begin CHARACTERISTIC Ctx_ffm_did_in_cam[1] "" VALUE 0xa002ac92 _REC_S1VAL_20_u2 65535. _CNV_A_R_A_105_CM 0. 65535. DISPLAY_IDENTIFIER Pxx_dgdftmng_dtc_in_cam.Ctx_ffm_did_xxx[1] /end CHARACTERISTIC
/begin CHARACTERISTIC Ctx_ffm_did_in_cam[2] "" VALUE 0xa002ac94 _REC_S1VAL_20_u2 65535. _CNV_A_R_A_105_CM 0. 65535. DISPLAY_IDENTIFIER Pxx_dgdftmng_dtc_in_cam.Ctx_ffm_did_xxx[2] /end CHARACTERISTIC
/begin CHARACTERISTIC Ctx_ffm_did_in_cam[3] "" VALUE 0xa002ac96 _REC_S1VAL_20_u2 65535. _CNV_A_R_A_105_CM 0. 65535. DISPLAY_IDENTIFIER Pxx_dgdftmng_dtc_in_cam.Ctx_ffm_did_xxx[3] /end CHARACTERISTIC
/begin CHARACTERISTIC Ctx_ffm_did_in_cam[4] "" VALUE 0xa002ac98 _REC_S1VAL_20_u2 65535. _CNV_A_R_A_105_CM 0. 65535. DISPLAY_IDENTIFIER Pxx_dgdftmng_dtc_in_cam.Ctx_ffm_did_xxx[4] /end CHARACTERISTIC
/begin CHARACTERISTIC Cxx_dtc_hmb_in_cam "" VALUE 0xa002ac9a _REC_S1VAL_20_u2 65535. _CNV_A_R_A_105_CM 0. 65535. DISPLAY_IDENTIFIER Pxx_dgdftmng_dtc_in_cam.Cxx_dtc_hmb_xxx /end CHARACTERISTIC
/begin CHARACTERISTIC Ctx_ffm_did_in_cam_crk[0] "" VALUE 0xa002ad5c _REC_S1VAL_20_u2 65535. _CNV_A_R_A_105_CM 0. 65535. DISPLAY_IDENTIFIER Pxx_dgdftmng_dtc_in_cam_crk.Ctx_ffm_did_xxx[0] /end CHARACTERISTIC
/begin CHARACTERISTIC Ctx_ffm_did_in_cam_crk[1] "" VALUE 0xa002ad5e _REC_S1VAL_20_u2 65535. _CNV_A_R_A_105_CM 0. 65535. DISPLAY_IDENTIFIER Pxx_dgdftmng_dtc_in_cam_crk.Ctx_ffm_did_xxx[1] /end CHARACTERISTIC
/begin CHARACTERISTIC Ctx_ffm_did_in_cam_crk[2] "" VALUE 0xa002ad60 _REC_S1VAL_20_u2 65535. _CNV_A_R_A_105_CM 0. 65535. DISPLAY_IDENTIFIER Pxx_dgdftmng_dtc_in_cam_crk.Ctx_ffm_did_xxx[2] /end CHARACTERISTIC
/begin CHARACTERISTIC Ctx_ffm_did_in_cam_crk[3] "" VALUE 0xa002ad62 _REC_S1VAL_20_u2 65535. _CNV_A_R_A_105_CM 0. 65535. DISPLAY_IDENTIFIER Pxx_dgdftmng_dtc_in_cam_crk.Ctx_ffm_did_xxx[3] /end CHARACTERISTIC
/begin CHARACTERISTIC Ctx_ffm_did_in_cam_crk[4] "" VALUE 0xa002ad64 _REC_S1VAL_20_u2 65535. _CNV_A_R_A_105_CM 0. 65535. DISPLAY_IDENTIFIER Pxx_dgdftmng_dtc_in_cam_crk.Ctx_ffm_did_xxx[4] /end CHARACTERISTIC
/begin CHARACTERISTIC Cxx_dtc_hmb_in_cam_crk "" VALUE 0xa002ad66 _REC_S1VAL_20_u2 65535. _CNV_A_R_A_105_CM 0. 65535. DISPLAY_IDENTIFIER Pxx_dgdftmng_dtc_in_cam_crk.Cxx_dtc_hmb_xxx /end CHARACTERISTIC
/begin CHARACTERISTIC Ctx_ffm_did_in_vvtc[0] "" VALUE 0xa002a9fc _REC_S1VAL_20_u2 65535. _CNV_A_R_A_105_CM 0. 65535. DISPLAY_IDENTIFIER Pxx_dgdftmng_dtc_in_vvtc.Ctx_ffm_did_xxx[0] /end CHARACTERISTIC
/begin CHARACTERISTIC Ctx_ffm_did_in_vvtc[1] "" VALUE 0xa002a9fe _REC_S1VAL_20_u2 65535. _CNV_A_R_A_105_CM 0. 65535. DISPLAY_IDENTIFIER Pxx_dgdftmng_dtc_in_vvtc.Ctx_ffm_did_xxx[1] /end CHARACTERISTIC
/begin CHARACTERISTIC Ctx_ffm_did_in_vvtc[2] "" VALUE 0xa002aa00 _REC_S1VAL_20_u2 65535. _CNV_A_R_A_105_CM 0. 65535. DISPLAY_IDENTIFIER Pxx_dgdftmng_dtc_in_vvtc.Ctx_ffm_did_xxx[2] /end CHARACTERISTIC
/begin CHARACTERISTIC Ctx_ffm_did_in_vvtc[3] "" VALUE 0xa002aa02 _REC_S1VAL_20_u2 65535. _CNV_A_R_A_105_CM 0. 65535. DISPLAY_IDENTIFIER Pxx_dgdftmng_dtc_in_vvtc.Ctx_ffm_did_xxx[3] /end CHARACTERISTIC
/begin CHARACTERISTIC Ctx_ffm_did_in_vvtc[4] "" VALUE 0xa002aa04 _REC_S1VAL_20_u2 65535. _CNV_A_R_A_105_CM 0. 65535. DISPLAY_IDENTIFIER Pxx_dgdftmng_dtc_in_vvtc.Ctx_ffm_did_xxx[4] /end CHARACTERISTIC
/begin CHARACTERISTIC Cxx_dtc_hmb_in_vvtc "" VALUE 0xa002aa06 _REC_S1VAL_20_u2 65535. _CNV_A_R_A_105_CM 0. 65535. DISPLAY_IDENTIFIER Pxx_dgdftmng_dtc_in_vvtc.Cxx_dtc_hmb_xxx /end CHARACTERISTIC
/begin CHARACTERISTIC Ctx_ffm_did_in_vvtc_sldv[0] "" VALUE 0xa002aa08 _REC_S1VAL_20_u2 65535. _CNV_A_R_A_105_CM 0. 65535. DISPLAY_IDENTIFIER Pxx_dgdftmng_dtc_in_vvtc_sldv.Ctx_ffm_did_xxx[0] /end CHARACTERISTIC
/begin CHARACTERISTIC Ctx_ffm_did_in_vvtc_sldv[1] "" VALUE 0xa002aa0a _REC_S1VAL_20_u2 65535. _CNV_A_R_A_105_CM 0. 65535. DISPLAY_IDENTIFIER Pxx_dgdftmng_dtc_in_vvtc_sldv.Ctx_ffm_did_xxx[1] /end CHARACTERISTIC
/begin CHARACTERISTIC Ctx_ffm_did_in_vvtc_sldv[2] "" VALUE 0xa002aa0c _REC_S1VAL_20_u2 65535. _CNV_A_R_A_105_CM 0. 65535. DISPLAY_IDENTIFIER Pxx_dgdftmng_dtc_in_vvtc_sldv.Ctx_ffm_did_xxx[2] /end CHARACTERISTIC
/begin CHARACTERISTIC Ctx_ffm_did_in_vvtc_sldv[3] "" VALUE 0xa002aa0e _REC_S1VAL_20_u2 65535. _CNV_A_R_A_105_CM 0. 65535. DISPLAY_IDENTIFIER Pxx_dgdftmng_dtc_in_vvtc_sldv.Ctx_ffm_did_xxx[3] /end CHARACTERISTIC
/begin CHARACTERISTIC Ctx_ffm_did_in_vvtc_sldv[4] "" VALUE 0xa002aa10 _REC_S1VAL_20_u2 65535. _CNV_A_R_A_105_CM 0. 65535. DISPLAY_IDENTIFIER Pxx_dgdftmng_dtc_in_vvtc_sldv.Ctx_ffm_did_xxx[4] /end CHARACTERISTIC
/begin CHARACTERISTIC Cxx_dtc_hmb_in_vvtc_sldv "" VALUE 0xa002aa12 _REC_S1VAL_20_u2 65535. _CNV_A_R_A_105_CM 0. 65535. DISPLAY_IDENTIFIER Pxx_dgdftmng_dtc_in_vvtc_sldv.Cxx_dtc_hmb_xxx /end CHARACTERISTIC
/begin CHARACTERISTIC Ctx_ffm_did_inj1[0] "" VALUE 0xa002aa20 _REC_S1VAL_20_u2 65535. _CNV_A_R_A_105_CM 0. 65535. DISPLAY_IDENTIFIER Pxx_dgdftmng_dtc_inj1.Ctx_ffm_did_xxx[0] /end CHARACTERISTIC
/begin CHARACTERISTIC Ctx_ffm_did_inj1[1] "" VALUE 0xa002aa22 _REC_S1VAL_20_u2 65535. _CNV_A_R_A_105_CM 0. 65535. DISPLAY_IDENTIFIER Pxx_dgdftmng_dtc_inj1.Ctx_ffm_did_xxx[1] /end CHARACTERISTIC
/begin CHARACTERISTIC Ctx_ffm_did_inj1[2] "" VALUE 0xa002aa24 _REC_S1VAL_20_u2 65535. _CNV_A_R_A_105_CM 0. 65535. DISPLAY_IDENTIFIER Pxx_dgdftmng_dtc_inj1.Ctx_ffm_did_xxx[2] /end CHARACTERISTIC
/begin CHARACTERISTIC Ctx_ffm_did_inj1[3] "" VALUE 0xa002aa26 _REC_S1VAL_20_u2 65535. _CNV_A_R_A_105_CM 0. 65535. DISPLAY_IDENTIFIER Pxx_dgdftmng_dtc_inj1.Ctx_ffm_did_xxx[3] /end CHARACTERISTIC
/begin CHARACTERISTIC Ctx_ffm_did_inj1[4] "" VALUE 0xa002aa28 _REC_S1VAL_20_u2 65535. _CNV_A_R_A_105_CM 0. 65535. DISPLAY_IDENTIFIER Pxx_dgdftmng_dtc_inj1.Ctx_ffm_did_xxx[4] /end CHARACTERISTIC
/begin CHARACTERISTIC Cxx_dtc_hmb_inj1 "" VALUE 0xa002aa2a _REC_S1VAL_20_u2 65535. _CNV_A_R_A_105_CM 0. 65535. DISPLAY_IDENTIFIER Pxx_dgdftmng_dtc_inj1.Cxx_dtc_hmb_xxx /end CHARACTERISTIC
/begin CHARACTERISTIC Ctx_ffm_did_inj2[0] "" VALUE 0xa002aa2c _REC_S1VAL_20_u2 65535. _CNV_A_R_A_105_CM 0. 65535. DISPLAY_IDENTIFIER Pxx_dgdftmng_dtc_inj2.Ctx_ffm_did_xxx[0] /end CHARACTERISTIC
/begin CHARACTERISTIC Ctx_ffm_did_inj2[1] "" VALUE 0xa002aa2e _REC_S1VAL_20_u2 65535. _CNV_A_R_A_105_CM 0. 65535. DISPLAY_IDENTIFIER Pxx_dgdftmng_dtc_inj2.Ctx_ffm_did_xxx[1] /end CHARACTERISTIC
/begin CHARACTERISTIC Ctx_ffm_did_inj2[2] "" VALUE 0xa002aa30 _REC_S1VAL_20_u2 65535. _CNV_A_R_A_105_CM 0. 65535. DISPLAY_IDENTIFIER Pxx_dgdftmng_dtc_inj2.Ctx_ffm_did_xxx[2] /end CHARACTERISTIC
/begin CHARACTERISTIC Ctx_ffm_did_inj2[3] "" VALUE 0xa002aa32 _REC_S1VAL_20_u2 65535. _CNV_A_R_A_105_CM 0. 65535. DISPLAY_IDENTIFIER Pxx_dgdftmng_dtc_inj2.Ctx_ffm_did_xxx[3] /end CHARACTERISTIC
/begin CHARACTERISTIC Ctx_ffm_did_inj2[4] "" VALUE 0xa002aa34 _REC_S1VAL_20_u2 65535. _CNV_A_R_A_105_CM 0. 65535. DISPLAY_IDENTIFIER Pxx_dgdftmng_dtc_inj2.Ctx_ffm_did_xxx[4] /end CHARACTERISTIC
/begin CHARACTERISTIC Cxx_dtc_hmb_inj2 "" VALUE 0xa002aa36 _REC_S1VAL_20_u2 65535. _CNV_A_R_A_105_CM 0. 65535. DISPLAY_IDENTIFIER Pxx_dgdftmng_dtc_inj2.Cxx_dtc_hmb_xxx /end CHARACTERISTIC
/begin CHARACTERISTIC Ctx_ffm_did_inj3[0] "" VALUE 0xa002aa38 _REC_S1VAL_20_u2 65535. _CNV_A_R_A_105_CM 0. 65535. DISPLAY_IDENTIFIER Pxx_dgdftmng_dtc_inj3.Ctx_ffm_did_xxx[0] /end CHARACTERISTIC
/begin CHARACTERISTIC Ctx_ffm_did_inj3[1] "" VALUE 0xa002aa3a _REC_S1VAL_20_u2 65535. _CNV_A_R_A_105_CM 0. 65535. DISPLAY_IDENTIFIER Pxx_dgdftmng_dtc_inj3.Ctx_ffm_did_xxx[1] /end CHARACTERISTIC
/begin CHARACTERISTIC Ctx_ffm_did_inj3[2] "" VALUE 0xa002aa3c _REC_S1VAL_20_u2 65535. _CNV_A_R_A_105_CM 0. 65535. DISPLAY_IDENTIFIER Pxx_dgdftmng_dtc_inj3.Ctx_ffm_did_xxx[2] /end CHARACTERISTIC
/begin CHARACTERISTIC Ctx_ffm_did_inj3[3] "" VALUE 0xa002aa3e _REC_S1VAL_20_u2 65535. _CNV_A_R_A_105_CM 0. 65535. DISPLAY_IDENTIFIER Pxx_dgdftmng_dtc_inj3.Ctx_ffm_did_xxx[3] /end CHARACTERISTIC
/begin CHARACTERISTIC Ctx_ffm_did_inj3[4] "" VALUE 0xa002aa40 _REC_S1VAL_20_u2 65535. _CNV_A_R_A_105_CM 0. 65535. DISPLAY_IDENTIFIER Pxx_dgdftmng_dtc_inj3.Ctx_ffm_did_xxx[4] /end CHARACTERISTIC
/begin CHARACTERISTIC Cxx_dtc_hmb_inj3 "" VALUE 0xa002aa42 _REC_S1VAL_20_u2 65535. _CNV_A_R_A_105_CM 0. 65535. DISPLAY_IDENTIFIER Pxx_dgdftmng_dtc_inj3.Cxx_dtc_hmb_xxx /end CHARACTERISTIC
/begin CHARACTERISTIC Ctx_ffm_did_inj4[0] "" VALUE 0xa002aa44 _REC_S1VAL_20_u2 65535. _CNV_A_R_A_105_CM 0. 65535. DISPLAY_IDENTIFIER Pxx_dgdftmng_dtc_inj4.Ctx_ffm_did_xxx[0] /end CHARACTERISTIC
/begin CHARACTERISTIC Ctx_ffm_did_inj4[1] "" VALUE 0xa002aa46 _REC_S1VAL_20_u2 65535. _CNV_A_R_A_105_CM 0. 65535. DISPLAY_IDENTIFIER Pxx_dgdftmng_dtc_inj4.Ctx_ffm_did_xxx[1] /end CHARACTERISTIC
/begin CHARACTERISTIC Ctx_ffm_did_inj4[2] "" VALUE 0xa002aa48 _REC_S1VAL_20_u2 65535. _CNV_A_R_A_105_CM 0. 65535. DISPLAY_IDENTIFIER Pxx_dgdftmng_dtc_inj4.Ctx_ffm_did_xxx[2] /end CHARACTERISTIC
/begin CHARACTERISTIC Ctx_ffm_did_inj4[3] "" VALUE 0xa002aa4a _REC_S1VAL_20_u2 65535. _CNV_A_R_A_105_CM 0. 65535. DISPLAY_IDENTIFIER Pxx_dgdftmng_dtc_inj4.Ctx_ffm_did_xxx[3] /end CHARACTERISTIC
/begin CHARACTERISTIC Ctx_ffm_did_inj4[4] "" VALUE 0xa002aa4c _REC_S1VAL_20_u2 65535. _CNV_A_R_A_105_CM 0. 65535. DISPLAY_IDENTIFIER Pxx_dgdftmng_dtc_inj4.Ctx_ffm_did_xxx[4] /end CHARACTERISTIC
/begin CHARACTERISTIC Cxx_dtc_hmb_inj4 "" VALUE 0xa002aa4e _REC_S1VAL_20_u2 65535. _CNV_A_R_A_105_CM 0. 65535. DISPLAY_IDENTIFIER Pxx_dgdftmng_dtc_inj4.Cxx_dtc_hmb_xxx /end CHARACTERISTIC
/begin CHARACTERISTIC Ctx_ffm_did_inj_ecu[0] "" VALUE 0xa002aa14 _REC_S1VAL_20_u2 65535. _CNV_A_R_A_105_CM 0. 65535. DISPLAY_IDENTIFIER Pxx_dgdftmng_dtc_inj_ecu.Ctx_ffm_did_xxx[0] /end CHARACTERISTIC
/begin CHARACTERISTIC Ctx_ffm_did_inj_ecu[1] "" VALUE 0xa002aa16 _REC_S1VAL_20_u2 65535. _CNV_A_R_A_105_CM 0. 65535. DISPLAY_IDENTIFIER Pxx_dgdftmng_dtc_inj_ecu.Ctx_ffm_did_xxx[1] /end CHARACTERISTIC
/begin CHARACTERISTIC Ctx_ffm_did_inj_ecu[2] "" VALUE 0xa002aa18 _REC_S1VAL_20_u2 65535. _CNV_A_R_A_105_CM 0. 65535. DISPLAY_IDENTIFIER Pxx_dgdftmng_dtc_inj_ecu.Ctx_ffm_did_xxx[2] /end CHARACTERISTIC
/begin CHARACTERISTIC Ctx_ffm_did_inj_ecu[3] "" VALUE 0xa002aa1a _REC_S1VAL_20_u2 65535. _CNV_A_R_A_105_CM 0. 65535. DISPLAY_IDENTIFIER Pxx_dgdftmng_dtc_inj_ecu.Ctx_ffm_did_xxx[3] /end CHARACTERISTIC
/begin CHARACTERISTIC Ctx_ffm_did_inj_ecu[4] "" VALUE 0xa002aa1c _REC_S1VAL_20_u2 65535. _CNV_A_R_A_105_CM 0. 65535. DISPLAY_IDENTIFIER Pxx_dgdftmng_dtc_inj_ecu.Ctx_ffm_did_xxx[4] /end CHARACTERISTIC
/begin CHARACTERISTIC Cxx_dtc_hmb_inj_ecu "" VALUE 0xa002aa1e _REC_S1VAL_20_u2 65535. _CNV_A_R_A_105_CM 0. 65535. DISPLAY_IDENTIFIER Pxx_dgdftmng_dtc_inj_ecu.Cxx_dtc_hmb_xxx /end CHARACTERISTIC
/begin CHARACTERISTIC Ctx_ffm_did_ip_lght_tco[0] "" VALUE 0xa002acc0 _REC_S1VAL_20_u2 65535. _CNV_A_R_A_105_CM 0. 65535. DISPLAY_IDENTIFIER Pxx_dgdftmng_dtc_ip_lght_tco.Ctx_ffm_did_xxx[0] /end CHARACTERISTIC
/begin CHARACTERISTIC Ctx_ffm_did_ip_lght_tco[1] "" VALUE 0xa002acc2 _REC_S1VAL_20_u2 65535. _CNV_A_R_A_105_CM 0. 65535. DISPLAY_IDENTIFIER Pxx_dgdftmng_dtc_ip_lght_tco.Ctx_ffm_did_xxx[1] /end CHARACTERISTIC
/begin CHARACTERISTIC Ctx_ffm_did_ip_lght_tco[2] "" VALUE 0xa002acc4 _REC_S1VAL_20_u2 65535. _CNV_A_R_A_105_CM 0. 65535. DISPLAY_IDENTIFIER Pxx_dgdftmng_dtc_ip_lght_tco.Ctx_ffm_did_xxx[2] /end CHARACTERISTIC
/begin CHARACTERISTIC Ctx_ffm_did_ip_lght_tco[3] "" VALUE 0xa002acc6 _REC_S1VAL_20_u2 65535. _CNV_A_R_A_105_CM 0. 65535. DISPLAY_IDENTIFIER Pxx_dgdftmng_dtc_ip_lght_tco.Ctx_ffm_did_xxx[3] /end CHARACTERISTIC
/begin CHARACTERISTIC Ctx_ffm_did_ip_lght_tco[4] "" VALUE 0xa002acc8 _REC_S1VAL_20_u2 65535. _CNV_A_R_A_105_CM 0. 65535. DISPLAY_IDENTIFIER Pxx_dgdftmng_dtc_ip_lght_tco.Ctx_ffm_did_xxx[4] /end CHARACTERISTIC
/begin CHARACTERISTIC Cxx_dtc_hmb_ip_lght_tco "" VALUE 0xa002acca _REC_S1VAL_20_u2 65535. _CNV_A_R_A_105_CM 0. 65535. DISPLAY_IDENTIFIER Pxx_dgdftmng_dtc_ip_lght_tco.Cxx_dtc_hmb_xxx /end CHARACTERISTIC
/begin CHARACTERISTIC Ctx_ffm_did_isr[0] "" VALUE 0xa002ad44 _REC_S1VAL_20_u2 65535. _CNV_A_R_A_105_CM 0. 65535. DISPLAY_IDENTIFIER Pxx_dgdftmng_dtc_isr.Ctx_ffm_did_xxx[0] /end CHARACTERISTIC
/begin CHARACTERISTIC Ctx_ffm_did_isr[1] "" VALUE 0xa002ad46 _REC_S1VAL_20_u2 65535. _CNV_A_R_A_105_CM 0. 65535. DISPLAY_IDENTIFIER Pxx_dgdftmng_dtc_isr.Ctx_ffm_did_xxx[1] /end CHARACTERISTIC
/begin CHARACTERISTIC Ctx_ffm_did_isr[2] "" VALUE 0xa002ad48 _REC_S1VAL_20_u2 65535. _CNV_A_R_A_105_CM 0. 65535. DISPLAY_IDENTIFIER Pxx_dgdftmng_dtc_isr.Ctx_ffm_did_xxx[2] /end CHARACTERISTIC
/begin CHARACTERISTIC Ctx_ffm_did_isr[3] "" VALUE 0xa002ad4a _REC_S1VAL_20_u2 65535. _CNV_A_R_A_105_CM 0. 65535. DISPLAY_IDENTIFIER Pxx_dgdftmng_dtc_isr.Ctx_ffm_did_xxx[3] /end CHARACTERISTIC
/begin CHARACTERISTIC Ctx_ffm_did_isr[4] "" VALUE 0xa002ad4c _REC_S1VAL_20_u2 65535. _CNV_A_R_A_105_CM 0. 65535. DISPLAY_IDENTIFIER Pxx_dgdftmng_dtc_isr.Ctx_ffm_did_xxx[4] /end CHARACTERISTIC
/begin CHARACTERISTIC Cxx_dtc_hmb_isr "" VALUE 0xa002ad4e _REC_S1VAL_20_u2 65535. _CNV_A_R_A_105_CM 0. 65535. DISPLAY_IDENTIFIER Pxx_dgdftmng_dtc_isr.Cxx_dtc_hmb_xxx /end CHARACTERISTIC
/begin CHARACTERISTIC Ctx_ffm_did_it_cmd[0] "" VALUE 0xa002aa50 _REC_S1VAL_20_u2 65535. _CNV_A_R_A_105_CM 0. 65535. DISPLAY_IDENTIFIER Pxx_dgdftmng_dtc_it_cmd.Ctx_ffm_did_xxx[0] /end CHARACTERISTIC
/begin CHARACTERISTIC Ctx_ffm_did_it_cmd[1] "" VALUE 0xa002aa52 _REC_S1VAL_20_u2 65535. _CNV_A_R_A_105_CM 0. 65535. DISPLAY_IDENTIFIER Pxx_dgdftmng_dtc_it_cmd.Ctx_ffm_did_xxx[1] /end CHARACTERISTIC
/begin CHARACTERISTIC Ctx_ffm_did_it_cmd[2] "" VALUE 0xa002aa54 _REC_S1VAL_20_u2 65535. _CNV_A_R_A_105_CM 0. 65535. DISPLAY_IDENTIFIER Pxx_dgdftmng_dtc_it_cmd.Ctx_ffm_did_xxx[2] /end CHARACTERISTIC
/begin CHARACTERISTIC Ctx_ffm_did_it_cmd[3] "" VALUE 0xa002aa56 _REC_S1VAL_20_u2 65535. _CNV_A_R_A_105_CM 0. 65535. DISPLAY_IDENTIFIER Pxx_dgdftmng_dtc_it_cmd.Ctx_ffm_did_xxx[3] /end CHARACTERISTIC
/begin CHARACTERISTIC Ctx_ffm_did_it_cmd[4] "" VALUE 0xa002aa58 _REC_S1VAL_20_u2 65535. _CNV_A_R_A_105_CM 0. 65535. DISPLAY_IDENTIFIER Pxx_dgdftmng_dtc_it_cmd.Ctx_ffm_did_xxx[4] /end CHARACTERISTIC
/begin CHARACTERISTIC Cxx_dtc_hmb_it_cmd "" VALUE 0xa002aa5a _REC_S1VAL_20_u2 65535. _CNV_A_R_A_105_CM 0. 65535. DISPLAY_IDENTIFIER Pxx_dgdftmng_dtc_it_cmd.Cxx_dtc_hmb_xxx /end CHARACTERISTIC
/begin CHARACTERISTIC Ctx_ffm_did_it_ofs[0] "" VALUE 0xa002aa5c _REC_S1VAL_20_u2 65535. _CNV_A_R_A_105_CM 0. 65535. DISPLAY_IDENTIFIER Pxx_dgdftmng_dtc_it_ofs.Ctx_ffm_did_xxx[0] /end CHARACTERISTIC
/begin CHARACTERISTIC Ctx_ffm_did_it_ofs[1] "" VALUE 0xa002aa5e _REC_S1VAL_20_u2 65535. _CNV_A_R_A_105_CM 0. 65535. DISPLAY_IDENTIFIER Pxx_dgdftmng_dtc_it_ofs.Ctx_ffm_did_xxx[1] /end CHARACTERISTIC
/begin CHARACTERISTIC Ctx_ffm_did_it_ofs[2] "" VALUE 0xa002aa60 _REC_S1VAL_20_u2 65535. _CNV_A_R_A_105_CM 0. 65535. DISPLAY_IDENTIFIER Pxx_dgdftmng_dtc_it_ofs.Ctx_ffm_did_xxx[2] /end CHARACTERISTIC
/begin CHARACTERISTIC Ctx_ffm_did_it_ofs[3] "" VALUE 0xa002aa62 _REC_S1VAL_20_u2 65535. _CNV_A_R_A_105_CM 0. 65535. DISPLAY_IDENTIFIER Pxx_dgdftmng_dtc_it_ofs.Ctx_ffm_did_xxx[3] /end CHARACTERISTIC
/begin CHARACTERISTIC Ctx_ffm_did_it_ofs[4] "" VALUE 0xa002aa64 _REC_S1VAL_20_u2 65535. _CNV_A_R_A_105_CM 0. 65535. DISPLAY_IDENTIFIER Pxx_dgdftmng_dtc_it_ofs.Ctx_ffm_did_xxx[4] /end CHARACTERISTIC
/begin CHARACTERISTIC Cxx_dtc_hmb_it_ofs "" VALUE 0xa002aa66 _REC_S1VAL_20_u2 65535. _CNV_A_R_A_105_CM 0. 65535. DISPLAY_IDENTIFIER Pxx_dgdftmng_dtc_it_ofs.Cxx_dtc_hmb_xxx /end CHARACTERISTIC
/begin CHARACTERISTIC Ctx_ffm_did_it_reg[0] "" VALUE 0xa002aa68 _REC_S1VAL_20_u2 65535. _CNV_A_R_A_105_CM 0. 65535. DISPLAY_IDENTIFIER Pxx_dgdftmng_dtc_it_reg.Ctx_ffm_did_xxx[0] /end CHARACTERISTIC
/begin CHARACTERISTIC Ctx_ffm_did_it_reg[1] "" VALUE 0xa002aa6a _REC_S1VAL_20_u2 65535. _CNV_A_R_A_105_CM 0. 65535. DISPLAY_IDENTIFIER Pxx_dgdftmng_dtc_it_reg.Ctx_ffm_did_xxx[1] /end CHARACTERISTIC
/begin CHARACTERISTIC Ctx_ffm_did_it_reg[2] "" VALUE 0xa002aa6c _REC_S1VAL_20_u2 65535. _CNV_A_R_A_105_CM 0. 65535. DISPLAY_IDENTIFIER Pxx_dgdftmng_dtc_it_reg.Ctx_ffm_did_xxx[2] /end CHARACTERISTIC
/begin CHARACTERISTIC Ctx_ffm_did_it_reg[3] "" VALUE 0xa002aa6e _REC_S1VAL_20_u2 65535. _CNV_A_R_A_105_CM 0. 65535. DISPLAY_IDENTIFIER Pxx_dgdftmng_dtc_it_reg.Ctx_ffm_did_xxx[3] /end CHARACTERISTIC
/begin CHARACTERISTIC Ctx_ffm_did_it_reg[4] "" VALUE 0xa002aa70 _REC_S1VAL_20_u2 65535. _CNV_A_R_A_105_CM 0. 65535. DISPLAY_IDENTIFIER Pxx_dgdftmng_dtc_it_reg.Ctx_ffm_did_xxx[4] /end CHARACTERISTIC
/begin CHARACTERISTIC Cxx_dtc_hmb_it_reg "" VALUE 0xa002aa72 _REC_S1VAL_20_u2 65535. _CNV_A_R_A_105_CM 0. 65535. DISPLAY_IDENTIFIER Pxx_dgdftmng_dtc_it_reg.Cxx_dtc_hmb_xxx /end CHARACTERISTIC
/begin CHARACTERISTIC Ctx_ffm_did_knk[0] "" VALUE 0xa002aa74 _REC_S1VAL_20_u2 65535. _CNV_A_R_A_105_CM 0. 65535. DISPLAY_IDENTIFIER Pxx_dgdftmng_dtc_knk.Ctx_ffm_did_xxx[0] /end CHARACTERISTIC
/begin CHARACTERISTIC Ctx_ffm_did_knk[1] "" VALUE 0xa002aa76 _REC_S1VAL_20_u2 65535. _CNV_A_R_A_105_CM 0. 65535. DISPLAY_IDENTIFIER Pxx_dgdftmng_dtc_knk.Ctx_ffm_did_xxx[1] /end CHARACTERISTIC
/begin CHARACTERISTIC Ctx_ffm_did_knk[2] "" VALUE 0xa002aa78 _REC_S1VAL_20_u2 65535. _CNV_A_R_A_105_CM 0. 65535. DISPLAY_IDENTIFIER Pxx_dgdftmng_dtc_knk.Ctx_ffm_did_xxx[2] /end CHARACTERISTIC
/begin CHARACTERISTIC Ctx_ffm_did_knk[3] "" VALUE 0xa002aa7a _REC_S1VAL_20_u2 65535. _CNV_A_R_A_105_CM 0. 65535. DISPLAY_IDENTIFIER Pxx_dgdftmng_dtc_knk.Ctx_ffm_did_xxx[3] /end CHARACTERISTIC
/begin CHARACTERISTIC Ctx_ffm_did_knk[4] "" VALUE 0xa002aa7c _REC_S1VAL_20_u2 65535. _CNV_A_R_A_105_CM 0. 65535. DISPLAY_IDENTIFIER Pxx_dgdftmng_dtc_knk.Ctx_ffm_did_xxx[4] /end CHARACTERISTIC
/begin CHARACTERISTIC Cxx_dtc_hmb_knk "" VALUE 0xa002aa7e _REC_S1VAL_20_u2 65535. _CNV_A_R_A_105_CM 0. 65535. DISPLAY_IDENTIFIER Pxx_dgdftmng_dtc_knk.Cxx_dtc_hmb_xxx /end CHARACTERISTIC
/begin CHARACTERISTIC Ctx_ffm_did_lbdw[0] "" VALUE 0xa002ad50 _REC_S1VAL_20_u2 65535. _CNV_A_R_A_105_CM 0. 65535. DISPLAY_IDENTIFIER Pxx_dgdftmng_dtc_lbdw.Ctx_ffm_did_xxx[0] /end CHARACTERISTIC
/begin CHARACTERISTIC Ctx_ffm_did_lbdw[1] "" VALUE 0xa002ad52 _REC_S1VAL_20_u2 65535. _CNV_A_R_A_105_CM 0. 65535. DISPLAY_IDENTIFIER Pxx_dgdftmng_dtc_lbdw.Ctx_ffm_did_xxx[1] /end CHARACTERISTIC
/begin CHARACTERISTIC Ctx_ffm_did_lbdw[2] "" VALUE 0xa002ad54 _REC_S1VAL_20_u2 65535. _CNV_A_R_A_105_CM 0. 65535. DISPLAY_IDENTIFIER Pxx_dgdftmng_dtc_lbdw.Ctx_ffm_did_xxx[2] /end CHARACTERISTIC
/begin CHARACTERISTIC Ctx_ffm_did_lbdw[3] "" VALUE 0xa002ad56 _REC_S1VAL_20_u2 65535. _CNV_A_R_A_105_CM 0. 65535. DISPLAY_IDENTIFIER Pxx_dgdftmng_dtc_lbdw.Ctx_ffm_did_xxx[3] /end CHARACTERISTIC
/begin CHARACTERISTIC Ctx_ffm_did_lbdw[4] "" VALUE 0xa002ad58 _REC_S1VAL_20_u2 65535. _CNV_A_R_A_105_CM 0. 65535. DISPLAY_IDENTIFIER Pxx_dgdftmng_dtc_lbdw.Ctx_ffm_did_xxx[4] /end CHARACTERISTIC
/begin CHARACTERISTIC Cxx_dtc_hmb_lbdw "" VALUE 0xa002ad5a _REC_S1VAL_20_u2 65535. _CNV_A_R_A_105_CM 0. 65535. DISPLAY_IDENTIFIER Pxx_dgdftmng_dtc_lbdw.Cxx_dtc_hmb_xxx /end CHARACTERISTIC
/begin CHARACTERISTIC Ctx_ffm_did_lbdw_hot[0] "" VALUE 0xa002aa80 _REC_S1VAL_20_u2 65535. _CNV_A_R_A_105_CM 0. 65535. DISPLAY_IDENTIFIER Pxx_dgdftmng_dtc_lbdw_hot.Ctx_ffm_did_xxx[0] /end CHARACTERISTIC
/begin CHARACTERISTIC Ctx_ffm_did_lbdw_hot[1] "" VALUE 0xa002aa82 _REC_S1VAL_20_u2 65535. _CNV_A_R_A_105_CM 0. 65535. DISPLAY_IDENTIFIER Pxx_dgdftmng_dtc_lbdw_hot.Ctx_ffm_did_xxx[1] /end CHARACTERISTIC
/begin CHARACTERISTIC Ctx_ffm_did_lbdw_hot[2] "" VALUE 0xa002aa84 _REC_S1VAL_20_u2 65535. _CNV_A_R_A_105_CM 0. 65535. DISPLAY_IDENTIFIER Pxx_dgdftmng_dtc_lbdw_hot.Ctx_ffm_did_xxx[2] /end CHARACTERISTIC
/begin CHARACTERISTIC Ctx_ffm_did_lbdw_hot[3] "" VALUE 0xa002aa86 _REC_S1VAL_20_u2 65535. _CNV_A_R_A_105_CM 0. 65535. DISPLAY_IDENTIFIER Pxx_dgdftmng_dtc_lbdw_hot.Ctx_ffm_did_xxx[3] /end CHARACTERISTIC
/begin CHARACTERISTIC Ctx_ffm_did_lbdw_hot[4] "" VALUE 0xa002aa88 _REC_S1VAL_20_u2 65535. _CNV_A_R_A_105_CM 0. 65535. DISPLAY_IDENTIFIER Pxx_dgdftmng_dtc_lbdw_hot.Ctx_ffm_did_xxx[4] /end CHARACTERISTIC
/begin CHARACTERISTIC Cxx_dtc_hmb_lbdw_hot "" VALUE 0xa002aa8a _REC_S1VAL_20_u2 65535. _CNV_A_R_A_105_CM 0. 65535. DISPLAY_IDENTIFIER Pxx_dgdftmng_dtc_lbdw_hot.Cxx_dtc_hmb_xxx /end CHARACTERISTIC
/begin CHARACTERISTIC Ctx_ffm_did_lbup[0] "" VALUE 0xa002aa8c _REC_S1VAL_20_u2 65535. _CNV_A_R_A_105_CM 0. 65535. DISPLAY_IDENTIFIER Pxx_dgdftmng_dtc_lbup.Ctx_ffm_did_xxx[0] /end CHARACTERISTIC
/begin CHARACTERISTIC Ctx_ffm_did_lbup[1] "" VALUE 0xa002aa8e _REC_S1VAL_20_u2 65535. _CNV_A_R_A_105_CM 0. 65535. DISPLAY_IDENTIFIER Pxx_dgdftmng_dtc_lbup.Ctx_ffm_did_xxx[1] /end CHARACTERISTIC
/begin CHARACTERISTIC Ctx_ffm_did_lbup[2] "" VALUE 0xa002aa90 _REC_S1VAL_20_u2 65535. _CNV_A_R_A_105_CM 0. 65535. DISPLAY_IDENTIFIER Pxx_dgdftmng_dtc_lbup.Ctx_ffm_did_xxx[2] /end CHARACTERISTIC
/begin CHARACTERISTIC Ctx_ffm_did_lbup[3] "" VALUE 0xa002aa92 _REC_S1VAL_20_u2 65535. _CNV_A_R_A_105_CM 0. 65535. DISPLAY_IDENTIFIER Pxx_dgdftmng_dtc_lbup.Ctx_ffm_did_xxx[3] /end CHARACTERISTIC
/begin CHARACTERISTIC Ctx_ffm_did_lbup[4] "" VALUE 0xa002aa94 _REC_S1VAL_20_u2 65535. _CNV_A_R_A_105_CM 0. 65535. DISPLAY_IDENTIFIER Pxx_dgdftmng_dtc_lbup.Ctx_ffm_did_xxx[4] /end CHARACTERISTIC
/begin CHARACTERISTIC Cxx_dtc_hmb_lbup "" VALUE 0xa002aa96 _REC_S1VAL_20_u2 65535. _CNV_A_R_A_105_CM 0. 65535. DISPLAY_IDENTIFIER Pxx_dgdftmng_dtc_lbup.Cxx_dtc_hmb_xxx /end CHARACTERISTIC
/begin CHARACTERISTIC Ctx_ffm_did_lbup_hot[0] "" VALUE 0xa002aba0 _REC_S1VAL_20_u2 65535. _CNV_A_R_A_105_CM 0. 65535. DISPLAY_IDENTIFIER Pxx_dgdftmng_dtc_lbup_hot.Ctx_ffm_did_xxx[0] /end CHARACTERISTIC
/begin CHARACTERISTIC Ctx_ffm_did_lbup_hot[1] "" VALUE 0xa002aba2 _REC_S1VAL_20_u2 65535. _CNV_A_R_A_105_CM 0. 65535. DISPLAY_IDENTIFIER Pxx_dgdftmng_dtc_lbup_hot.Ctx_ffm_did_xxx[1] /end CHARACTERISTIC
/begin CHARACTERISTIC Ctx_ffm_did_lbup_hot[2] "" VALUE 0xa002aba4 _REC_S1VAL_20_u2 65535. _CNV_A_R_A_105_CM 0. 65535. DISPLAY_IDENTIFIER Pxx_dgdftmng_dtc_lbup_hot.Ctx_ffm_did_xxx[2] /end CHARACTERISTIC
/begin CHARACTERISTIC Ctx_ffm_did_lbup_hot[3] "" VALUE 0xa002aba6 _REC_S1VAL_20_u2 65535. _CNV_A_R_A_105_CM 0. 65535. DISPLAY_IDENTIFIER Pxx_dgdftmng_dtc_lbup_hot.Ctx_ffm_did_xxx[3] /end CHARACTERISTIC
/begin CHARACTERISTIC Ctx_ffm_did_lbup_hot[4] "" VALUE 0xa002aba8 _REC_S1VAL_20_u2 65535. _CNV_A_R_A_105_CM 0. 65535. DISPLAY_IDENTIFIER Pxx_dgdftmng_dtc_lbup_hot.Ctx_ffm_did_xxx[4] /end CHARACTERISTIC
/begin CHARACTERISTIC Cxx_dtc_hmb_lbup_hot "" VALUE 0xa002abaa _REC_S1VAL_20_u2 65535. _CNV_A_R_A_105_CM 0. 65535. DISPLAY_IDENTIFIER Pxx_dgdftmng_dtc_lbup_hot.Cxx_dtc_hmb_xxx /end CHARACTERISTIC
/begin CHARACTERISTIC Ctx_ffm_did_lbup_shf[0] "" VALUE 0xa002ada4 _REC_S1VAL_20_u2 65535. _CNV_A_R_A_105_CM 0. 65535. DISPLAY_IDENTIFIER Pxx_dgdftmng_dtc_lbup_shf.Ctx_ffm_did_xxx[0] /end CHARACTERISTIC
/begin CHARACTERISTIC Ctx_ffm_did_lbup_shf[1] "" VALUE 0xa002ada6 _REC_S1VAL_20_u2 65535. _CNV_A_R_A_105_CM 0. 65535. DISPLAY_IDENTIFIER Pxx_dgdftmng_dtc_lbup_shf.Ctx_ffm_did_xxx[1] /end CHARACTERISTIC
/begin CHARACTERISTIC Ctx_ffm_did_lbup_shf[2] "" VALUE 0xa002ada8 _REC_S1VAL_20_u2 65535. _CNV_A_R_A_105_CM 0. 65535. DISPLAY_IDENTIFIER Pxx_dgdftmng_dtc_lbup_shf.Ctx_ffm_did_xxx[2] /end CHARACTERISTIC
/begin CHARACTERISTIC Ctx_ffm_did_lbup_shf[3] "" VALUE 0xa002adaa _REC_S1VAL_20_u2 65535. _CNV_A_R_A_105_CM 0. 65535. DISPLAY_IDENTIFIER Pxx_dgdftmng_dtc_lbup_shf.Ctx_ffm_did_xxx[3] /end CHARACTERISTIC
/begin CHARACTERISTIC Ctx_ffm_did_lbup_shf[4] "" VALUE 0xa002adac _REC_S1VAL_20_u2 65535. _CNV_A_R_A_105_CM 0. 65535. DISPLAY_IDENTIFIER Pxx_dgdftmng_dtc_lbup_shf.Ctx_ffm_did_xxx[4] /end CHARACTERISTIC
/begin CHARACTERISTIC Cxx_dtc_hmb_lbup_shf "" VALUE 0xa002adae _REC_S1VAL_20_u2 65535. _CNV_A_R_A_105_CM 0. 65535. DISPLAY_IDENTIFIER Pxx_dgdftmng_dtc_lbup_shf.Cxx_dtc_hmb_xxx /end CHARACTERISTIC
/begin CHARACTERISTIC Ctx_ffm_did_map[0] "" VALUE 0xa002abac _REC_S1VAL_20_u2 65535. _CNV_A_R_A_105_CM 0. 65535. DISPLAY_IDENTIFIER Pxx_dgdftmng_dtc_map.Ctx_ffm_did_xxx[0] /end CHARACTERISTIC
/begin CHARACTERISTIC Ctx_ffm_did_map[1] "" VALUE 0xa002abae _REC_S1VAL_20_u2 65535. _CNV_A_R_A_105_CM 0. 65535. DISPLAY_IDENTIFIER Pxx_dgdftmng_dtc_map.Ctx_ffm_did_xxx[1] /end CHARACTERISTIC
/begin CHARACTERISTIC Ctx_ffm_did_map[2] "" VALUE 0xa002abb0 _REC_S1VAL_20_u2 65535. _CNV_A_R_A_105_CM 0. 65535. DISPLAY_IDENTIFIER Pxx_dgdftmng_dtc_map.Ctx_ffm_did_xxx[2] /end CHARACTERISTIC
/begin CHARACTERISTIC Ctx_ffm_did_map[3] "" VALUE 0xa002abb2 _REC_S1VAL_20_u2 65535. _CNV_A_R_A_105_CM 0. 65535. DISPLAY_IDENTIFIER Pxx_dgdftmng_dtc_map.Ctx_ffm_did_xxx[3] /end CHARACTERISTIC
/begin CHARACTERISTIC Ctx_ffm_did_map[4] "" VALUE 0xa002abb4 _REC_S1VAL_20_u2 65535. _CNV_A_R_A_105_CM 0. 65535. DISPLAY_IDENTIFIER Pxx_dgdftmng_dtc_map.Ctx_ffm_did_xxx[4] /end CHARACTERISTIC
/begin CHARACTERISTIC Cxx_dtc_hmb_map "" VALUE 0xa002abb6 _REC_S1VAL_20_u2 65535. _CNV_A_R_A_105_CM 0. 65535. DISPLAY_IDENTIFIER Pxx_dgdftmng_dtc_map.Cxx_dtc_hmb_xxx /end CHARACTERISTIC
/begin CHARACTERISTIC Ctx_ffm_did_mis[0] "" VALUE 0xa002ac18 _REC_S1VAL_20_u2 65535. _CNV_A_R_A_105_CM 0. 65535. DISPLAY_IDENTIFIER Pxx_dgdftmng_dtc_mis.Ctx_ffm_did_xxx[0] /end CHARACTERISTIC
/begin CHARACTERISTIC Ctx_ffm_did_mis[1] "" VALUE 0xa002ac1a _REC_S1VAL_20_u2 65535. _CNV_A_R_A_105_CM 0. 65535. DISPLAY_IDENTIFIER Pxx_dgdftmng_dtc_mis.Ctx_ffm_did_xxx[1] /end CHARACTERISTIC
/begin CHARACTERISTIC Ctx_ffm_did_mis[2] "" VALUE 0xa002ac1c _REC_S1VAL_20_u2 65535. _CNV_A_R_A_105_CM 0. 65535. DISPLAY_IDENTIFIER Pxx_dgdftmng_dtc_mis.Ctx_ffm_did_xxx[2] /end CHARACTERISTIC
/begin CHARACTERISTIC Ctx_ffm_did_mis[3] "" VALUE 0xa002ac1e _REC_S1VAL_20_u2 65535. _CNV_A_R_A_105_CM 0. 65535. DISPLAY_IDENTIFIER Pxx_dgdftmng_dtc_mis.Ctx_ffm_did_xxx[3] /end CHARACTERISTIC
/begin CHARACTERISTIC Ctx_ffm_did_mis[4] "" VALUE 0xa002ac20 _REC_S1VAL_20_u2 65535. _CNV_A_R_A_105_CM 0. 65535. DISPLAY_IDENTIFIER Pxx_dgdftmng_dtc_mis.Ctx_ffm_did_xxx[4] /end CHARACTERISTIC
/begin CHARACTERISTIC Cxx_dtc_hmb_mis "" VALUE 0xa002ac22 _REC_S1VAL_20_u2 65535. _CNV_A_R_A_105_CM 0. 65535. DISPLAY_IDENTIFIER Pxx_dgdftmng_dtc_mis.Cxx_dtc_hmb_xxx /end CHARACTERISTIC
/begin CHARACTERISTIC Ctx_ffm_did_mis_1[0] "" VALUE 0xa002abb8 _REC_S1VAL_20_u2 65535. _CNV_A_R_A_105_CM 0. 65535. DISPLAY_IDENTIFIER Pxx_dgdftmng_dtc_mis_1.Ctx_ffm_did_xxx[0] /end CHARACTERISTIC
/begin CHARACTERISTIC Ctx_ffm_did_mis_1[1] "" VALUE 0xa002abba _REC_S1VAL_20_u2 65535. _CNV_A_R_A_105_CM 0. 65535. DISPLAY_IDENTIFIER Pxx_dgdftmng_dtc_mis_1.Ctx_ffm_did_xxx[1] /end CHARACTERISTIC
/begin CHARACTERISTIC Ctx_ffm_did_mis_1[2] "" VALUE 0xa002abbc _REC_S1VAL_20_u2 65535. _CNV_A_R_A_105_CM 0. 65535. DISPLAY_IDENTIFIER Pxx_dgdftmng_dtc_mis_1.Ctx_ffm_did_xxx[2] /end CHARACTERISTIC
/begin CHARACTERISTIC Ctx_ffm_did_mis_1[3] "" VALUE 0xa002abbe _REC_S1VAL_20_u2 65535. _CNV_A_R_A_105_CM 0. 65535. DISPLAY_IDENTIFIER Pxx_dgdftmng_dtc_mis_1.Ctx_ffm_did_xxx[3] /end CHARACTERISTIC
/begin CHARACTERISTIC Ctx_ffm_did_mis_1[4] "" VALUE 0xa002abc0 _REC_S1VAL_20_u2 65535. _CNV_A_R_A_105_CM 0. 65535. DISPLAY_IDENTIFIER Pxx_dgdftmng_dtc_mis_1.Ctx_ffm_did_xxx[4] /end CHARACTERISTIC
/begin CHARACTERISTIC Cxx_dtc_hmb_mis_1 "" VALUE 0xa002abc2 _REC_S1VAL_20_u2 65535. _CNV_A_R_A_105_CM 0. 65535. DISPLAY_IDENTIFIER Pxx_dgdftmng_dtc_mis_1.Cxx_dtc_hmb_xxx /end CHARACTERISTIC
/begin CHARACTERISTIC Ctx_ffm_did_mis_1_lpg[0] "" VALUE 0xa002abc4 _REC_S1VAL_20_u2 65535. _CNV_A_R_A_105_CM 0. 65535. DISPLAY_IDENTIFIER Pxx_dgdftmng_dtc_mis_1_lpg.Ctx_ffm_did_xxx[0] /end CHARACTERISTIC
/begin CHARACTERISTIC Ctx_ffm_did_mis_1_lpg[1] "" VALUE 0xa002abc6 _REC_S1VAL_20_u2 65535. _CNV_A_R_A_105_CM 0. 65535. DISPLAY_IDENTIFIER Pxx_dgdftmng_dtc_mis_1_lpg.Ctx_ffm_did_xxx[1] /end CHARACTERISTIC
/begin CHARACTERISTIC Ctx_ffm_did_mis_1_lpg[2] "" VALUE 0xa002abc8 _REC_S1VAL_20_u2 65535. _CNV_A_R_A_105_CM 0. 65535. DISPLAY_IDENTIFIER Pxx_dgdftmng_dtc_mis_1_lpg.Ctx_ffm_did_xxx[2] /end CHARACTERISTIC
/begin CHARACTERISTIC Ctx_ffm_did_mis_1_lpg[3] "" VALUE 0xa002abca _REC_S1VAL_20_u2 65535. _CNV_A_R_A_105_CM 0. 65535. DISPLAY_IDENTIFIER Pxx_dgdftmng_dtc_mis_1_lpg.Ctx_ffm_did_xxx[3] /end CHARACTERISTIC
/begin CHARACTERISTIC Ctx_ffm_did_mis_1_lpg[4] "" VALUE 0xa002abcc _REC_S1VAL_20_u2 65535. _CNV_A_R_A_105_CM 0. 65535. DISPLAY_IDENTIFIER Pxx_dgdftmng_dtc_mis_1_lpg.Ctx_ffm_did_xxx[4] /end CHARACTERISTIC
/begin CHARACTERISTIC Cxx_dtc_hmb_mis_1_lpg "" VALUE 0xa002abce _REC_S1VAL_20_u2 65535. _CNV_A_R_A_105_CM 0. 65535. DISPLAY_IDENTIFIER Pxx_dgdftmng_dtc_mis_1_lpg.Cxx_dtc_hmb_xxx /end CHARACTERISTIC
/begin CHARACTERISTIC Ctx_ffm_did_mis_2[0] "" VALUE 0xa002abd0 _REC_S1VAL_20_u2 65535. _CNV_A_R_A_105_CM 0. 65535. DISPLAY_IDENTIFIER Pxx_dgdftmng_dtc_mis_2.Ctx_ffm_did_xxx[0] /end CHARACTERISTIC
/begin CHARACTERISTIC Ctx_ffm_did_mis_2[1] "" VALUE 0xa002abd2 _REC_S1VAL_20_u2 65535. _CNV_A_R_A_105_CM 0. 65535. DISPLAY_IDENTIFIER Pxx_dgdftmng_dtc_mis_2.Ctx_ffm_did_xxx[1] /end CHARACTERISTIC
/begin CHARACTERISTIC Ctx_ffm_did_mis_2[2] "" VALUE 0xa002abd4 _REC_S1VAL_20_u2 65535. _CNV_A_R_A_105_CM 0. 65535. DISPLAY_IDENTIFIER Pxx_dgdftmng_dtc_mis_2.Ctx_ffm_did_xxx[2] /end CHARACTERISTIC
/begin CHARACTERISTIC Ctx_ffm_did_mis_2[3] "" VALUE 0xa002abd6 _REC_S1VAL_20_u2 65535. _CNV_A_R_A_105_CM 0. 65535. DISPLAY_IDENTIFIER Pxx_dgdftmng_dtc_mis_2.Ctx_ffm_did_xxx[3] /end CHARACTERISTIC
/begin CHARACTERISTIC Ctx_ffm_did_mis_2[4] "" VALUE 0xa002abd8 _REC_S1VAL_20_u2 65535. _CNV_A_R_A_105_CM 0. 65535. DISPLAY_IDENTIFIER Pxx_dgdftmng_dtc_mis_2.Ctx_ffm_did_xxx[4] /end CHARACTERISTIC
/begin CHARACTERISTIC Cxx_dtc_hmb_mis_2 "" VALUE 0xa002abda _REC_S1VAL_20_u2 65535. _CNV_A_R_A_105_CM 0. 65535. DISPLAY_IDENTIFIER Pxx_dgdftmng_dtc_mis_2.Cxx_dtc_hmb_xxx /end CHARACTERISTIC
/begin CHARACTERISTIC Ctx_ffm_did_mis_2_lpg[0] "" VALUE 0xa002abdc _REC_S1VAL_20_u2 65535. _CNV_A_R_A_105_CM 0. 65535. DISPLAY_IDENTIFIER Pxx_dgdftmng_dtc_mis_2_lpg.Ctx_ffm_did_xxx[0] /end CHARACTERISTIC
/begin CHARACTERISTIC Ctx_ffm_did_mis_2_lpg[1] "" VALUE 0xa002abde _REC_S1VAL_20_u2 65535. _CNV_A_R_A_105_CM 0. 65535. DISPLAY_IDENTIFIER Pxx_dgdftmng_dtc_mis_2_lpg.Ctx_ffm_did_xxx[1] /end CHARACTERISTIC
/begin CHARACTERISTIC Ctx_ffm_did_mis_2_lpg[2] "" VALUE 0xa002abe0 _REC_S1VAL_20_u2 65535. _CNV_A_R_A_105_CM 0. 65535. DISPLAY_IDENTIFIER Pxx_dgdftmng_dtc_mis_2_lpg.Ctx_ffm_did_xxx[2] /end CHARACTERISTIC
/begin CHARACTERISTIC Ctx_ffm_did_mis_2_lpg[3] "" VALUE 0xa002abe2 _REC_S1VAL_20_u2 65535. _CNV_A_R_A_105_CM 0. 65535. DISPLAY_IDENTIFIER Pxx_dgdftmng_dtc_mis_2_lpg.Ctx_ffm_did_xxx[3] /end CHARACTERISTIC
/begin CHARACTERISTIC Ctx_ffm_did_mis_2_lpg[4] "" VALUE 0xa002abe4 _REC_S1VAL_20_u2 65535. _CNV_A_R_A_105_CM 0. 65535. DISPLAY_IDENTIFIER Pxx_dgdftmng_dtc_mis_2_lpg.Ctx_ffm_did_xxx[4] /end CHARACTERISTIC
/begin CHARACTERISTIC Cxx_dtc_hmb_mis_2_lpg "" VALUE 0xa002abe6 _REC_S1VAL_20_u2 65535. _CNV_A_R_A_105_CM 0. 65535. DISPLAY_IDENTIFIER Pxx_dgdftmng_dtc_mis_2_lpg.Cxx_dtc_hmb_xxx /end CHARACTERISTIC
/begin CHARACTERISTIC Ctx_ffm_did_mis_3[0] "" VALUE 0xa002abe8 _REC_S1VAL_20_u2 65535. _CNV_A_R_A_105_CM 0. 65535. DISPLAY_IDENTIFIER Pxx_dgdftmng_dtc_mis_3.Ctx_ffm_did_xxx[0] /end CHARACTERISTIC
/begin CHARACTERISTIC Ctx_ffm_did_mis_3[1] "" VALUE 0xa002abea _REC_S1VAL_20_u2 65535. _CNV_A_R_A_105_CM 0. 65535. DISPLAY_IDENTIFIER Pxx_dgdftmng_dtc_mis_3.Ctx_ffm_did_xxx[1] /end CHARACTERISTIC
/begin CHARACTERISTIC Ctx_ffm_did_mis_3[2] "" VALUE 0xa002abec _REC_S1VAL_20_u2 65535. _CNV_A_R_A_105_CM 0. 65535. DISPLAY_IDENTIFIER Pxx_dgdftmng_dtc_mis_3.Ctx_ffm_did_xxx[2] /end CHARACTERISTIC
/begin CHARACTERISTIC Ctx_ffm_did_mis_3[3] "" VALUE 0xa002abee _REC_S1VAL_20_u2 65535. _CNV_A_R_A_105_CM 0. 65535. DISPLAY_IDENTIFIER Pxx_dgdftmng_dtc_mis_3.Ctx_ffm_did_xxx[3] /end CHARACTERISTIC
/begin CHARACTERISTIC Ctx_ffm_did_mis_3[4] "" VALUE 0xa002abf0 _REC_S1VAL_20_u2 65535. _CNV_A_R_A_105_CM 0. 65535. DISPLAY_IDENTIFIER Pxx_dgdftmng_dtc_mis_3.Ctx_ffm_did_xxx[4] /end CHARACTERISTIC
/begin CHARACTERISTIC Cxx_dtc_hmb_mis_3 "" VALUE 0xa002abf2 _REC_S1VAL_20_u2 65535. _CNV_A_R_A_105_CM 0. 65535. DISPLAY_IDENTIFIER Pxx_dgdftmng_dtc_mis_3.Cxx_dtc_hmb_xxx /end CHARACTERISTIC
/begin CHARACTERISTIC Ctx_ffm_did_mis_3_lpg[0] "" VALUE 0xa002abf4 _REC_S1VAL_20_u2 65535. _CNV_A_R_A_105_CM 0. 65535. DISPLAY_IDENTIFIER Pxx_dgdftmng_dtc_mis_3_lpg.Ctx_ffm_did_xxx[0] /end CHARACTERISTIC
/begin CHARACTERISTIC Ctx_ffm_did_mis_3_lpg[1] "" VALUE 0xa002abf6 _REC_S1VAL_20_u2 65535. _CNV_A_R_A_105_CM 0. 65535. DISPLAY_IDENTIFIER Pxx_dgdftmng_dtc_mis_3_lpg.Ctx_ffm_did_xxx[1] /end CHARACTERISTIC
/begin CHARACTERISTIC Ctx_ffm_did_mis_3_lpg[2] "" VALUE 0xa002abf8 _REC_S1VAL_20_u2 65535. _CNV_A_R_A_105_CM 0. 65535. DISPLAY_IDENTIFIER Pxx_dgdftmng_dtc_mis_3_lpg.Ctx_ffm_did_xxx[2] /end CHARACTERISTIC
/begin CHARACTERISTIC Ctx_ffm_did_mis_3_lpg[3] "" VALUE 0xa002abfa _REC_S1VAL_20_u2 65535. _CNV_A_R_A_105_CM 0. 65535. DISPLAY_IDENTIFIER Pxx_dgdftmng_dtc_mis_3_lpg.Ctx_ffm_did_xxx[3] /end CHARACTERISTIC
/begin CHARACTERISTIC Ctx_ffm_did_mis_3_lpg[4] "" VALUE 0xa002abfc _REC_S1VAL_20_u2 65535. _CNV_A_R_A_105_CM 0. 65535. DISPLAY_IDENTIFIER Pxx_dgdftmng_dtc_mis_3_lpg.Ctx_ffm_did_xxx[4] /end CHARACTERISTIC
/begin CHARACTERISTIC Cxx_dtc_hmb_mis_3_lpg "" VALUE 0xa002abfe _REC_S1VAL_20_u2 65535. _CNV_A_R_A_105_CM 0. 65535. DISPLAY_IDENTIFIER Pxx_dgdftmng_dtc_mis_3_lpg.Cxx_dtc_hmb_xxx /end CHARACTERISTIC
/begin CHARACTERISTIC Ctx_ffm_did_mis_4[0] "" VALUE 0xa002ac00 _REC_S1VAL_20_u2 65535. _CNV_A_R_A_105_CM 0. 65535. DISPLAY_IDENTIFIER Pxx_dgdftmng_dtc_mis_4.Ctx_ffm_did_xxx[0] /end CHARACTERISTIC
/begin CHARACTERISTIC Ctx_ffm_did_mis_4[1] "" VALUE 0xa002ac02 _REC_S1VAL_20_u2 65535. _CNV_A_R_A_105_CM 0. 65535. DISPLAY_IDENTIFIER Pxx_dgdftmng_dtc_mis_4.Ctx_ffm_did_xxx[1] /end CHARACTERISTIC
/begin CHARACTERISTIC Ctx_ffm_did_mis_4[2] "" VALUE 0xa002ac04 _REC_S1VAL_20_u2 65535. _CNV_A_R_A_105_CM 0. 65535. DISPLAY_IDENTIFIER Pxx_dgdftmng_dtc_mis_4.Ctx_ffm_did_xxx[2] /end CHARACTERISTIC
/begin CHARACTERISTIC Ctx_ffm_did_mis_4[3] "" VALUE 0xa002ac06 _REC_S1VAL_20_u2 65535. _CNV_A_R_A_105_CM 0. 65535. DISPLAY_IDENTIFIER Pxx_dgdftmng_dtc_mis_4.Ctx_ffm_did_xxx[3] /end CHARACTERISTIC
/begin CHARACTERISTIC Ctx_ffm_did_mis_4[4] "" VALUE 0xa002ac08 _REC_S1VAL_20_u2 65535. _CNV_A_R_A_105_CM 0. 65535. DISPLAY_IDENTIFIER Pxx_dgdftmng_dtc_mis_4.Ctx_ffm_did_xxx[4] /end CHARACTERISTIC
/begin CHARACTERISTIC Cxx_dtc_hmb_mis_4 "" VALUE 0xa002ac0a _REC_S1VAL_20_u2 65535. _CNV_A_R_A_105_CM 0. 65535. DISPLAY_IDENTIFIER Pxx_dgdftmng_dtc_mis_4.Cxx_dtc_hmb_xxx /end CHARACTERISTIC
/begin CHARACTERISTIC Ctx_ffm_did_mis_4_lpg[0] "" VALUE 0xa002ac0c _REC_S1VAL_20_u2 65535. _CNV_A_R_A_105_CM 0. 65535. DISPLAY_IDENTIFIER Pxx_dgdftmng_dtc_mis_4_lpg.Ctx_ffm_did_xxx[0] /end CHARACTERISTIC
/begin CHARACTERISTIC Ctx_ffm_did_mis_4_lpg[1] "" VALUE 0xa002ac0e _REC_S1VAL_20_u2 65535. _CNV_A_R_A_105_CM 0. 65535. DISPLAY_IDENTIFIER Pxx_dgdftmng_dtc_mis_4_lpg.Ctx_ffm_did_xxx[1] /end CHARACTERISTIC
/begin CHARACTERISTIC Ctx_ffm_did_mis_4_lpg[2] "" VALUE 0xa002ac10 _REC_S1VAL_20_u2 65535. _CNV_A_R_A_105_CM 0. 65535. DISPLAY_IDENTIFIER Pxx_dgdftmng_dtc_mis_4_lpg.Ctx_ffm_did_xxx[2] /end CHARACTERISTIC
/begin CHARACTERISTIC Ctx_ffm_did_mis_4_lpg[3] "" VALUE 0xa002ac12 _REC_S1VAL_20_u2 65535. _CNV_A_R_A_105_CM 0. 65535. DISPLAY_IDENTIFIER Pxx_dgdftmng_dtc_mis_4_lpg.Ctx_ffm_did_xxx[3] /end CHARACTERISTIC
/begin CHARACTERISTIC Ctx_ffm_did_mis_4_lpg[4] "" VALUE 0xa002ac14 _REC_S1VAL_20_u2 65535. _CNV_A_R_A_105_CM 0. 65535. DISPLAY_IDENTIFIER Pxx_dgdftmng_dtc_mis_4_lpg.Ctx_ffm_did_xxx[4] /end CHARACTERISTIC
/begin CHARACTERISTIC Cxx_dtc_hmb_mis_4_lpg "" VALUE 0xa002ac16 _REC_S1VAL_20_u2 65535. _CNV_A_R_A_105_CM 0. 65535. DISPLAY_IDENTIFIER Pxx_dgdftmng_dtc_mis_4_lpg.Cxx_dtc_hmb_xxx /end CHARACTERISTIC
/begin CHARACTERISTIC Ctx_ffm_did_mis_lpg[0] "" VALUE 0xa002ac24 _REC_S1VAL_20_u2 65535. _CNV_A_R_A_105_CM 0. 65535. DISPLAY_IDENTIFIER Pxx_dgdftmng_dtc_mis_lpg.Ctx_ffm_did_xxx[0] /end CHARACTERISTIC
/begin CHARACTERISTIC Ctx_ffm_did_mis_lpg[1] "" VALUE 0xa002ac26 _REC_S1VAL_20_u2 65535. _CNV_A_R_A_105_CM 0. 65535. DISPLAY_IDENTIFIER Pxx_dgdftmng_dtc_mis_lpg.Ctx_ffm_did_xxx[1] /end CHARACTERISTIC
/begin CHARACTERISTIC Ctx_ffm_did_mis_lpg[2] "" VALUE 0xa002ac28 _REC_S1VAL_20_u2 65535. _CNV_A_R_A_105_CM 0. 65535. DISPLAY_IDENTIFIER Pxx_dgdftmng_dtc_mis_lpg.Ctx_ffm_did_xxx[2] /end CHARACTERISTIC
/begin CHARACTERISTIC Ctx_ffm_did_mis_lpg[3] "" VALUE 0xa002ac2a _REC_S1VAL_20_u2 65535. _CNV_A_R_A_105_CM 0. 65535. DISPLAY_IDENTIFIER Pxx_dgdftmng_dtc_mis_lpg.Ctx_ffm_did_xxx[3] /end CHARACTERISTIC
/begin CHARACTERISTIC Ctx_ffm_did_mis_lpg[4] "" VALUE 0xa002ac2c _REC_S1VAL_20_u2 65535. _CNV_A_R_A_105_CM 0. 65535. DISPLAY_IDENTIFIER Pxx_dgdftmng_dtc_mis_lpg.Ctx_ffm_did_xxx[4] /end CHARACTERISTIC
/begin CHARACTERISTIC Cxx_dtc_hmb_mis_lpg "" VALUE 0xa002ac2e _REC_S1VAL_20_u2 65535. _CNV_A_R_A_105_CM 0. 65535. DISPLAY_IDENTIFIER Pxx_dgdftmng_dtc_mis_lpg.Cxx_dtc_hmb_xxx /end CHARACTERISTIC
/begin CHARACTERISTIC Ctx_ffm_did_mis_min_fuel[0] "" VALUE 0xa002ac30 _REC_S1VAL_20_u2 65535. _CNV_A_R_A_105_CM 0. 65535. DISPLAY_IDENTIFIER Pxx_dgdftmng_dtc_mis_min_fuel.Ctx_ffm_did_xxx[0] /end CHARACTERISTIC
/begin CHARACTERISTIC Ctx_ffm_did_mis_min_fuel[1] "" VALUE 0xa002ac32 _REC_S1VAL_20_u2 65535. _CNV_A_R_A_105_CM 0. 65535. DISPLAY_IDENTIFIER Pxx_dgdftmng_dtc_mis_min_fuel.Ctx_ffm_did_xxx[1] /end CHARACTERISTIC
/begin CHARACTERISTIC Ctx_ffm_did_mis_min_fuel[2] "" VALUE 0xa002ac34 _REC_S1VAL_20_u2 65535. _CNV_A_R_A_105_CM 0. 65535. DISPLAY_IDENTIFIER Pxx_dgdftmng_dtc_mis_min_fuel.Ctx_ffm_did_xxx[2] /end CHARACTERISTIC
/begin CHARACTERISTIC Ctx_ffm_did_mis_min_fuel[3] "" VALUE 0xa002ac36 _REC_S1VAL_20_u2 65535. _CNV_A_R_A_105_CM 0. 65535. DISPLAY_IDENTIFIER Pxx_dgdftmng_dtc_mis_min_fuel.Ctx_ffm_did_xxx[3] /end CHARACTERISTIC
/begin CHARACTERISTIC Ctx_ffm_did_mis_min_fuel[4] "" VALUE 0xa002ac38 _REC_S1VAL_20_u2 65535. _CNV_A_R_A_105_CM 0. 65535. DISPLAY_IDENTIFIER Pxx_dgdftmng_dtc_mis_min_fuel.Ctx_ffm_did_xxx[4] /end CHARACTERISTIC
/begin CHARACTERISTIC Cxx_dtc_hmb_mis_min_fuel "" VALUE 0xa002ac3a _REC_S1VAL_20_u2 65535. _CNV_A_R_A_105_CM 0. 65535. DISPLAY_IDENTIFIER Pxx_dgdftmng_dtc_mis_min_fuel.Cxx_dtc_hmb_xxx /end CHARACTERISTIC
/begin CHARACTERISTIC Ctx_ffm_did_mis_unk[0] "" VALUE 0xa002ac3c _REC_S1VAL_20_u2 65535. _CNV_A_R_A_105_CM 0. 65535. DISPLAY_IDENTIFIER Pxx_dgdftmng_dtc_mis_unk.Ctx_ffm_did_xxx[0] /end CHARACTERISTIC
/begin CHARACTERISTIC Ctx_ffm_did_mis_unk[1] "" VALUE 0xa002ac3e _REC_S1VAL_20_u2 65535. _CNV_A_R_A_105_CM 0. 65535. DISPLAY_IDENTIFIER Pxx_dgdftmng_dtc_mis_unk.Ctx_ffm_did_xxx[1] /end CHARACTERISTIC
/begin CHARACTERISTIC Ctx_ffm_did_mis_unk[2] "" VALUE 0xa002ac40 _REC_S1VAL_20_u2 65535. _CNV_A_R_A_105_CM 0. 65535. DISPLAY_IDENTIFIER Pxx_dgdftmng_dtc_mis_unk.Ctx_ffm_did_xxx[2] /end CHARACTERISTIC
/begin CHARACTERISTIC Ctx_ffm_did_mis_unk[3] "" VALUE 0xa002ac42 _REC_S1VAL_20_u2 65535. _CNV_A_R_A_105_CM 0. 65535. DISPLAY_IDENTIFIER Pxx_dgdftmng_dtc_mis_unk.Ctx_ffm_did_xxx[3] /end CHARACTERISTIC
/begin CHARACTERISTIC Ctx_ffm_did_mis_unk[4] "" VALUE 0xa002ac44 _REC_S1VAL_20_u2 65535. _CNV_A_R_A_105_CM 0. 65535. DISPLAY_IDENTIFIER Pxx_dgdftmng_dtc_mis_unk.Ctx_ffm_did_xxx[4] /end CHARACTERISTIC
/begin CHARACTERISTIC Cxx_dtc_hmb_mis_unk "" VALUE 0xa002ac46 _REC_S1VAL_20_u2 65535. _CNV_A_R_A_105_CM 0. 65535. DISPLAY_IDENTIFIER Pxx_dgdftmng_dtc_mis_unk.Cxx_dtc_hmb_xxx /end CHARACTERISTIC
/begin CHARACTERISTIC Ctx_ffm_did_mis_unk_lpg[0] "" VALUE 0xa002ac48 _REC_S1VAL_20_u2 65535. _CNV_A_R_A_105_CM 0. 65535. DISPLAY_IDENTIFIER Pxx_dgdftmng_dtc_mis_unk_lpg.Ctx_ffm_did_xxx[0] /end CHARACTERISTIC
/begin CHARACTERISTIC Ctx_ffm_did_mis_unk_lpg[1] "" VALUE 0xa002ac4a _REC_S1VAL_20_u2 65535. _CNV_A_R_A_105_CM 0. 65535. DISPLAY_IDENTIFIER Pxx_dgdftmng_dtc_mis_unk_lpg.Ctx_ffm_did_xxx[1] /end CHARACTERISTIC
/begin CHARACTERISTIC Ctx_ffm_did_mis_unk_lpg[2] "" VALUE 0xa002ac4c _REC_S1VAL_20_u2 65535. _CNV_A_R_A_105_CM 0. 65535. DISPLAY_IDENTIFIER Pxx_dgdftmng_dtc_mis_unk_lpg.Ctx_ffm_did_xxx[2] /end CHARACTERISTIC
/begin CHARACTERISTIC Ctx_ffm_did_mis_unk_lpg[3] "" VALUE 0xa002ac4e _REC_S1VAL_20_u2 65535. _CNV_A_R_A_105_CM 0. 65535. DISPLAY_IDENTIFIER Pxx_dgdftmng_dtc_mis_unk_lpg.Ctx_ffm_did_xxx[3] /end CHARACTERISTIC
/begin CHARACTERISTIC Ctx_ffm_did_mis_unk_lpg[4] "" VALUE 0xa002ac50 _REC_S1VAL_20_u2 65535. _CNV_A_R_A_105_CM 0. 65535. DISPLAY_IDENTIFIER Pxx_dgdftmng_dtc_mis_unk_lpg.Ctx_ffm_did_xxx[4] /end CHARACTERISTIC
/begin CHARACTERISTIC Cxx_dtc_hmb_mis_unk_lpg "" VALUE 0xa002ac52 _REC_S1VAL_20_u2 65535. _CNV_A_R_A_105_CM 0. 65535. DISPLAY_IDENTIFIER Pxx_dgdftmng_dtc_mis_unk_lpg.Cxx_dtc_hmb_xxx /end CHARACTERISTIC
/begin CHARACTERISTIC Ctx_ffm_did_ptc_rov[0] "" VALUE 0xa002accc _REC_S1VAL_20_u2 65535. _CNV_A_R_A_105_CM 0. 65535. DISPLAY_IDENTIFIER Pxx_dgdftmng_dtc_ptc_rov.Ctx_ffm_did_xxx[0] /end CHARACTERISTIC
/begin CHARACTERISTIC Ctx_ffm_did_ptc_rov[1] "" VALUE 0xa002acce _REC_S1VAL_20_u2 65535. _CNV_A_R_A_105_CM 0. 65535. DISPLAY_IDENTIFIER Pxx_dgdftmng_dtc_ptc_rov.Ctx_ffm_did_xxx[1] /end CHARACTERISTIC
/begin CHARACTERISTIC Ctx_ffm_did_ptc_rov[2] "" VALUE 0xa002acd0 _REC_S1VAL_20_u2 65535. _CNV_A_R_A_105_CM 0. 65535. DISPLAY_IDENTIFIER Pxx_dgdftmng_dtc_ptc_rov.Ctx_ffm_did_xxx[2] /end CHARACTERISTIC
/begin CHARACTERISTIC Ctx_ffm_did_ptc_rov[3] "" VALUE 0xa002acd2 _REC_S1VAL_20_u2 65535. _CNV_A_R_A_105_CM 0. 65535. DISPLAY_IDENTIFIER Pxx_dgdftmng_dtc_ptc_rov.Ctx_ffm_did_xxx[3] /end CHARACTERISTIC
/begin CHARACTERISTIC Ctx_ffm_did_ptc_rov[4] "" VALUE 0xa002acd4 _REC_S1VAL_20_u2 65535. _CNV_A_R_A_105_CM 0. 65535. DISPLAY_IDENTIFIER Pxx_dgdftmng_dtc_ptc_rov.Ctx_ffm_did_xxx[4] /end CHARACTERISTIC
/begin CHARACTERISTIC Cxx_dtc_hmb_ptc_rov "" VALUE 0xa002acd6 _REC_S1VAL_20_u2 65535. _CNV_A_R_A_105_CM 0. 65535. DISPLAY_IDENTIFIER Pxx_dgdftmng_dtc_ptc_rov.Cxx_dtc_hmb_xxx /end CHARACTERISTIC
/begin CHARACTERISTIC Ctx_ffm_did_pws_1[0] "" VALUE 0xa002aa98 _REC_S1VAL_20_u2 65535. _CNV_A_R_A_105_CM 0. 65535. DISPLAY_IDENTIFIER Pxx_dgdftmng_dtc_pws_1.Ctx_ffm_did_xxx[0] /end CHARACTERISTIC
/begin CHARACTERISTIC Ctx_ffm_did_pws_1[1] "" VALUE 0xa002aa9a _REC_S1VAL_20_u2 65535. _CNV_A_R_A_105_CM 0. 65535. DISPLAY_IDENTIFIER Pxx_dgdftmng_dtc_pws_1.Ctx_ffm_did_xxx[1] /end CHARACTERISTIC
/begin CHARACTERISTIC Ctx_ffm_did_pws_1[2] "" VALUE 0xa002aa9c _REC_S1VAL_20_u2 65535. _CNV_A_R_A_105_CM 0. 65535. DISPLAY_IDENTIFIER Pxx_dgdftmng_dtc_pws_1.Ctx_ffm_did_xxx[2] /end CHARACTERISTIC
/begin CHARACTERISTIC Ctx_ffm_did_pws_1[3] "" VALUE 0xa002aa9e _REC_S1VAL_20_u2 65535. _CNV_A_R_A_105_CM 0. 65535. DISPLAY_IDENTIFIER Pxx_dgdftmng_dtc_pws_1.Ctx_ffm_did_xxx[3] /end CHARACTERISTIC
/begin CHARACTERISTIC Ctx_ffm_did_pws_1[4] "" VALUE 0xa002aaa0 _REC_S1VAL_20_u2 65535. _CNV_A_R_A_105_CM 0. 65535. DISPLAY_IDENTIFIER Pxx_dgdftmng_dtc_pws_1.Ctx_ffm_did_xxx[4] /end CHARACTERISTIC
/begin CHARACTERISTIC Cxx_dtc_hmb_pws_1 "" VALUE 0xa002aaa2 _REC_S1VAL_20_u2 65535. _CNV_A_R_A_105_CM 0. 65535. DISPLAY_IDENTIFIER Pxx_dgdftmng_dtc_pws_1.Cxx_dtc_hmb_xxx /end CHARACTERISTIC
/begin CHARACTERISTIC Ctx_ffm_did_pws_2[0] "" VALUE 0xa002aaa4 _REC_S1VAL_20_u2 65535. _CNV_A_R_A_105_CM 0. 65535. DISPLAY_IDENTIFIER Pxx_dgdftmng_dtc_pws_2.Ctx_ffm_did_xxx[0] /end CHARACTERISTIC
/begin CHARACTERISTIC Ctx_ffm_did_pws_2[1] "" VALUE 0xa002aaa6 _REC_S1VAL_20_u2 65535. _CNV_A_R_A_105_CM 0. 65535. DISPLAY_IDENTIFIER Pxx_dgdftmng_dtc_pws_2.Ctx_ffm_did_xxx[1] /end CHARACTERISTIC
/begin CHARACTERISTIC Ctx_ffm_did_pws_2[2] "" VALUE 0xa002aaa8 _REC_S1VAL_20_u2 65535. _CNV_A_R_A_105_CM 0. 65535. DISPLAY_IDENTIFIER Pxx_dgdftmng_dtc_pws_2.Ctx_ffm_did_xxx[2] /end CHARACTERISTIC
/begin CHARACTERISTIC Ctx_ffm_did_pws_2[3] "" VALUE 0xa002aaaa _REC_S1VAL_20_u2 65535. _CNV_A_R_A_105_CM 0. 65535. DISPLAY_IDENTIFIER Pxx_dgdftmng_dtc_pws_2.Ctx_ffm_did_xxx[3] /end CHARACTERISTIC
/begin CHARACTERISTIC Ctx_ffm_did_pws_2[4] "" VALUE 0xa002aaac _REC_S1VAL_20_u2 65535. _CNV_A_R_A_105_CM 0. 65535. DISPLAY_IDENTIFIER Pxx_dgdftmng_dtc_pws_2.Ctx_ffm_did_xxx[4] /end CHARACTERISTIC
/begin CHARACTERISTIC Cxx_dtc_hmb_pws_2 "" VALUE 0xa002aaae _REC_S1VAL_20_u2 65535. _CNV_A_R_A_105_CM 0. 65535. DISPLAY_IDENTIFIER Pxx_dgdftmng_dtc_pws_2.Cxx_dtc_hmb_xxx /end CHARACTERISTIC
/begin CHARACTERISTIC Ctx_ffm_did_pws_3[0] "" VALUE 0xa002aab0 _REC_S1VAL_20_u2 65535. _CNV_A_R_A_105_CM 0. 65535. DISPLAY_IDENTIFIER Pxx_dgdftmng_dtc_pws_3.Ctx_ffm_did_xxx[0] /end CHARACTERISTIC
/begin CHARACTERISTIC Ctx_ffm_did_pws_3[1] "" VALUE 0xa002aab2 _REC_S1VAL_20_u2 65535. _CNV_A_R_A_105_CM 0. 65535. DISPLAY_IDENTIFIER Pxx_dgdftmng_dtc_pws_3.Ctx_ffm_did_xxx[1] /end CHARACTERISTIC
/begin CHARACTERISTIC Ctx_ffm_did_pws_3[2] "" VALUE 0xa002aab4 _REC_S1VAL_20_u2 65535. _CNV_A_R_A_105_CM 0. 65535. DISPLAY_IDENTIFIER Pxx_dgdftmng_dtc_pws_3.Ctx_ffm_did_xxx[2] /end CHARACTERISTIC
/begin CHARACTERISTIC Ctx_ffm_did_pws_3[3] "" VALUE 0xa002aab6 _REC_S1VAL_20_u2 65535. _CNV_A_R_A_105_CM 0. 65535. DISPLAY_IDENTIFIER Pxx_dgdftmng_dtc_pws_3.Ctx_ffm_did_xxx[3] /end CHARACTERISTIC
/begin CHARACTERISTIC Ctx_ffm_did_pws_3[4] "" VALUE 0xa002aab8 _REC_S1VAL_20_u2 65535. _CNV_A_R_A_105_CM 0. 65535. DISPLAY_IDENTIFIER Pxx_dgdftmng_dtc_pws_3.Ctx_ffm_did_xxx[4] /end CHARACTERISTIC
/begin CHARACTERISTIC Cxx_dtc_hmb_pws_3 "" VALUE 0xa002aaba _REC_S1VAL_20_u2 65535. _CNV_A_R_A_105_CM 0. 65535. DISPLAY_IDENTIFIER Pxx_dgdftmng_dtc_pws_3.Cxx_dtc_hmb_xxx /end CHARACTERISTIC
/begin CHARACTERISTIC Ctx_ffm_did_sens_it[0] "" VALUE 0xa002aad4 _REC_S1VAL_20_u2 65535. _CNV_A_R_A_105_CM 0. 65535. DISPLAY_IDENTIFIER Pxx_dgdftmng_dtc_sens_it.Ctx_ffm_did_xxx[0] /end CHARACTERISTIC
/begin CHARACTERISTIC Ctx_ffm_did_sens_it[1] "" VALUE 0xa002aad6 _REC_S1VAL_20_u2 65535. _CNV_A_R_A_105_CM 0. 65535. DISPLAY_IDENTIFIER Pxx_dgdftmng_dtc_sens_it.Ctx_ffm_did_xxx[1] /end CHARACTERISTIC
/begin CHARACTERISTIC Ctx_ffm_did_sens_it[2] "" VALUE 0xa002aad8 _REC_S1VAL_20_u2 65535. _CNV_A_R_A_105_CM 0. 65535. DISPLAY_IDENTIFIER Pxx_dgdftmng_dtc_sens_it.Ctx_ffm_did_xxx[2] /end CHARACTERISTIC
/begin CHARACTERISTIC Ctx_ffm_did_sens_it[3] "" VALUE 0xa002aada _REC_S1VAL_20_u2 65535. _CNV_A_R_A_105_CM 0. 65535. DISPLAY_IDENTIFIER Pxx_dgdftmng_dtc_sens_it.Ctx_ffm_did_xxx[3] /end CHARACTERISTIC
/begin CHARACTERISTIC Ctx_ffm_did_sens_it[4] "" VALUE 0xa002aadc _REC_S1VAL_20_u2 65535. _CNV_A_R_A_105_CM 0. 65535. DISPLAY_IDENTIFIER Pxx_dgdftmng_dtc_sens_it.Ctx_ffm_did_xxx[4] /end CHARACTERISTIC
/begin CHARACTERISTIC Cxx_dtc_hmb_sens_it "" VALUE 0xa002aade _REC_S1VAL_20_u2 65535. _CNV_A_R_A_105_CM 0. 65535. DISPLAY_IDENTIFIER Pxx_dgdftmng_dtc_sens_it.Cxx_dtc_hmb_xxx /end CHARACTERISTIC
/begin CHARACTERISTIC Ctx_ffm_did_sens_it_1[0] "" VALUE 0xa002aabc _REC_S1VAL_20_u2 65535. _CNV_A_R_A_105_CM 0. 65535. DISPLAY_IDENTIFIER Pxx_dgdftmng_dtc_sens_it_1.Ctx_ffm_did_xxx[0] /end CHARACTERISTIC
/begin CHARACTERISTIC Ctx_ffm_did_sens_it_1[1] "" VALUE 0xa002aabe _REC_S1VAL_20_u2 65535. _CNV_A_R_A_105_CM 0. 65535. DISPLAY_IDENTIFIER Pxx_dgdftmng_dtc_sens_it_1.Ctx_ffm_did_xxx[1] /end CHARACTERISTIC
/begin CHARACTERISTIC Ctx_ffm_did_sens_it_1[2] "" VALUE 0xa002aac0 _REC_S1VAL_20_u2 65535. _CNV_A_R_A_105_CM 0. 65535. DISPLAY_IDENTIFIER Pxx_dgdftmng_dtc_sens_it_1.Ctx_ffm_did_xxx[2] /end CHARACTERISTIC
/begin CHARACTERISTIC Ctx_ffm_did_sens_it_1[3] "" VALUE 0xa002aac2 _REC_S1VAL_20_u2 65535. _CNV_A_R_A_105_CM 0. 65535. DISPLAY_IDENTIFIER Pxx_dgdftmng_dtc_sens_it_1.Ctx_ffm_did_xxx[3] /end CHARACTERISTIC
/begin CHARACTERISTIC Ctx_ffm_did_sens_it_1[4] "" VALUE 0xa002aac4 _REC_S1VAL_20_u2 65535. _CNV_A_R_A_105_CM 0. 65535. DISPLAY_IDENTIFIER Pxx_dgdftmng_dtc_sens_it_1.Ctx_ffm_did_xxx[4] /end CHARACTERISTIC
/begin CHARACTERISTIC Cxx_dtc_hmb_sens_it_1 "" VALUE 0xa002aac6 _REC_S1VAL_20_u2 65535. _CNV_A_R_A_105_CM 0. 65535. DISPLAY_IDENTIFIER Pxx_dgdftmng_dtc_sens_it_1.Cxx_dtc_hmb_xxx /end CHARACTERISTIC
/begin CHARACTERISTIC Ctx_ffm_did_sens_it_2[0] "" VALUE 0xa002aac8 _REC_S1VAL_20_u2 65535. _CNV_A_R_A_105_CM 0. 65535. DISPLAY_IDENTIFIER Pxx_dgdftmng_dtc_sens_it_2.Ctx_ffm_did_xxx[0] /end CHARACTERISTIC
/begin CHARACTERISTIC Ctx_ffm_did_sens_it_2[1] "" VALUE 0xa002aaca _REC_S1VAL_20_u2 65535. _CNV_A_R_A_105_CM 0. 65535. DISPLAY_IDENTIFIER Pxx_dgdftmng_dtc_sens_it_2.Ctx_ffm_did_xxx[1] /end CHARACTERISTIC
/begin CHARACTERISTIC Ctx_ffm_did_sens_it_2[2] "" VALUE 0xa002aacc _REC_S1VAL_20_u2 65535. _CNV_A_R_A_105_CM 0. 65535. DISPLAY_IDENTIFIER Pxx_dgdftmng_dtc_sens_it_2.Ctx_ffm_did_xxx[2] /end CHARACTERISTIC
/begin CHARACTERISTIC Ctx_ffm_did_sens_it_2[3] "" VALUE 0xa002aace _REC_S1VAL_20_u2 65535. _CNV_A_R_A_105_CM 0. 65535. DISPLAY_IDENTIFIER Pxx_dgdftmng_dtc_sens_it_2.Ctx_ffm_did_xxx[3] /end CHARACTERISTIC
/begin CHARACTERISTIC Ctx_ffm_did_sens_it_2[4] "" VALUE 0xa002aad0 _REC_S1VAL_20_u2 65535. _CNV_A_R_A_105_CM 0. 65535. DISPLAY_IDENTIFIER Pxx_dgdftmng_dtc_sens_it_2.Ctx_ffm_did_xxx[4] /end CHARACTERISTIC
/begin CHARACTERISTIC Cxx_dtc_hmb_sens_it_2 "" VALUE 0xa002aad2 _REC_S1VAL_20_u2 65535. _CNV_A_R_A_105_CM 0. 65535. DISPLAY_IDENTIFIER Pxx_dgdftmng_dtc_sens_it_2.Cxx_dtc_hmb_xxx /end CHARACTERISTIC
/begin CHARACTERISTIC Ctx_ffm_did_sens_map[0] "" VALUE 0xa002aae0 _REC_S1VAL_20_u2 65535. _CNV_A_R_A_105_CM 0. 65535. DISPLAY_IDENTIFIER Pxx_dgdftmng_dtc_sens_map.Ctx_ffm_did_xxx[0] /end CHARACTERISTIC
/begin CHARACTERISTIC Ctx_ffm_did_sens_map[1] "" VALUE 0xa002aae2 _REC_S1VAL_20_u2 65535. _CNV_A_R_A_105_CM 0. 65535. DISPLAY_IDENTIFIER Pxx_dgdftmng_dtc_sens_map.Ctx_ffm_did_xxx[1] /end CHARACTERISTIC
/begin CHARACTERISTIC Ctx_ffm_did_sens_map[2] "" VALUE 0xa002aae4 _REC_S1VAL_20_u2 65535. _CNV_A_R_A_105_CM 0. 65535. DISPLAY_IDENTIFIER Pxx_dgdftmng_dtc_sens_map.Ctx_ffm_did_xxx[2] /end CHARACTERISTIC
/begin CHARACTERISTIC Ctx_ffm_did_sens_map[3] "" VALUE 0xa002aae6 _REC_S1VAL_20_u2 65535. _CNV_A_R_A_105_CM 0. 65535. DISPLAY_IDENTIFIER Pxx_dgdftmng_dtc_sens_map.Ctx_ffm_did_xxx[3] /end CHARACTERISTIC
/begin CHARACTERISTIC Ctx_ffm_did_sens_map[4] "" VALUE 0xa002aae8 _REC_S1VAL_20_u2 65535. _CNV_A_R_A_105_CM 0. 65535. DISPLAY_IDENTIFIER Pxx_dgdftmng_dtc_sens_map.Ctx_ffm_did_xxx[4] /end CHARACTERISTIC
/begin CHARACTERISTIC Cxx_dtc_hmb_sens_map "" VALUE 0xa002aaea _REC_S1VAL_20_u2 65535. _CNV_A_R_A_105_CM 0. 65535. DISPLAY_IDENTIFIER Pxx_dgdftmng_dtc_sens_map.Cxx_dtc_hmb_xxx /end CHARACTERISTIC
/begin CHARACTERISTIC Ctx_ffm_did_sens_mat[0] "" VALUE 0xa002ab34 _REC_S1VAL_20_u2 65535. _CNV_A_R_A_105_CM 0. 65535. DISPLAY_IDENTIFIER Pxx_dgdftmng_dtc_sens_mat.Ctx_ffm_did_xxx[0] /end CHARACTERISTIC
/begin CHARACTERISTIC Ctx_ffm_did_sens_mat[1] "" VALUE 0xa002ab36 _REC_S1VAL_20_u2 65535. _CNV_A_R_A_105_CM 0. 65535. DISPLAY_IDENTIFIER Pxx_dgdftmng_dtc_sens_mat.Ctx_ffm_did_xxx[1] /end CHARACTERISTIC
/begin CHARACTERISTIC Ctx_ffm_did_sens_mat[2] "" VALUE 0xa002ab38 _REC_S1VAL_20_u2 65535. _CNV_A_R_A_105_CM 0. 65535. DISPLAY_IDENTIFIER Pxx_dgdftmng_dtc_sens_mat.Ctx_ffm_did_xxx[2] /end CHARACTERISTIC
/begin CHARACTERISTIC Ctx_ffm_did_sens_mat[3] "" VALUE 0xa002ab3a _REC_S1VAL_20_u2 65535. _CNV_A_R_A_105_CM 0. 65535. DISPLAY_IDENTIFIER Pxx_dgdftmng_dtc_sens_mat.Ctx_ffm_did_xxx[3] /end CHARACTERISTIC
/begin CHARACTERISTIC Ctx_ffm_did_sens_mat[4] "" VALUE 0xa002ab3c _REC_S1VAL_20_u2 65535. _CNV_A_R_A_105_CM 0. 65535. DISPLAY_IDENTIFIER Pxx_dgdftmng_dtc_sens_mat.Ctx_ffm_did_xxx[4] /end CHARACTERISTIC
/begin CHARACTERISTIC Cxx_dtc_hmb_sens_mat "" VALUE 0xa002ab3e _REC_S1VAL_20_u2 65535. _CNV_A_R_A_105_CM 0. 65535. DISPLAY_IDENTIFIER Pxx_dgdftmng_dtc_sens_mat.Cxx_dtc_hmb_xxx /end CHARACTERISTIC
/begin CHARACTERISTIC Ctx_ffm_did_sens_rvc[0] "" VALUE 0xa002ad08 _REC_S1VAL_20_u2 65535. _CNV_A_R_A_105_CM 0. 65535. DISPLAY_IDENTIFIER Pxx_dgdftmng_dtc_sens_rvc.Ctx_ffm_did_xxx[0] /end CHARACTERISTIC
/begin CHARACTERISTIC Ctx_ffm_did_sens_rvc[1] "" VALUE 0xa002ad0a _REC_S1VAL_20_u2 65535. _CNV_A_R_A_105_CM 0. 65535. DISPLAY_IDENTIFIER Pxx_dgdftmng_dtc_sens_rvc.Ctx_ffm_did_xxx[1] /end CHARACTERISTIC
/begin CHARACTERISTIC Ctx_ffm_did_sens_rvc[2] "" VALUE 0xa002ad0c _REC_S1VAL_20_u2 65535. _CNV_A_R_A_105_CM 0. 65535. DISPLAY_IDENTIFIER Pxx_dgdftmng_dtc_sens_rvc.Ctx_ffm_did_xxx[2] /end CHARACTERISTIC
/begin CHARACTERISTIC Ctx_ffm_did_sens_rvc[3] "" VALUE 0xa002ad0e _REC_S1VAL_20_u2 65535. _CNV_A_R_A_105_CM 0. 65535. DISPLAY_IDENTIFIER Pxx_dgdftmng_dtc_sens_rvc.Ctx_ffm_did_xxx[3] /end CHARACTERISTIC
/begin CHARACTERISTIC Ctx_ffm_did_sens_rvc[4] "" VALUE 0xa002ad10 _REC_S1VAL_20_u2 65535. _CNV_A_R_A_105_CM 0. 65535. DISPLAY_IDENTIFIER Pxx_dgdftmng_dtc_sens_rvc.Ctx_ffm_did_xxx[4] /end CHARACTERISTIC
/begin CHARACTERISTIC Cxx_dtc_hmb_sens_rvc "" VALUE 0xa002ad12 _REC_S1VAL_20_u2 65535. _CNV_A_R_A_105_CM 0. 65535. DISPLAY_IDENTIFIER Pxx_dgdftmng_dtc_sens_rvc.Cxx_dtc_hmb_xxx /end CHARACTERISTIC
/begin CHARACTERISTIC Ctx_ffm_did_sens_spg[0] "" VALUE 0xa002aaec _REC_S1VAL_20_u2 65535. _CNV_A_R_A_105_CM 0. 65535. DISPLAY_IDENTIFIER Pxx_dgdftmng_dtc_sens_spg.Ctx_ffm_did_xxx[0] /end CHARACTERISTIC
/begin CHARACTERISTIC Ctx_ffm_did_sens_spg[1] "" VALUE 0xa002aaee _REC_S1VAL_20_u2 65535. _CNV_A_R_A_105_CM 0. 65535. DISPLAY_IDENTIFIER Pxx_dgdftmng_dtc_sens_spg.Ctx_ffm_did_xxx[1] /end CHARACTERISTIC
/begin CHARACTERISTIC Ctx_ffm_did_sens_spg[2] "" VALUE 0xa002aaf0 _REC_S1VAL_20_u2 65535. _CNV_A_R_A_105_CM 0. 65535. DISPLAY_IDENTIFIER Pxx_dgdftmng_dtc_sens_spg.Ctx_ffm_did_xxx[2] /end CHARACTERISTIC
/begin CHARACTERISTIC Ctx_ffm_did_sens_spg[3] "" VALUE 0xa002aaf2 _REC_S1VAL_20_u2 65535. _CNV_A_R_A_105_CM 0. 65535. DISPLAY_IDENTIFIER Pxx_dgdftmng_dtc_sens_spg.Ctx_ffm_did_xxx[3] /end CHARACTERISTIC
/begin CHARACTERISTIC Ctx_ffm_did_sens_spg[4] "" VALUE 0xa002aaf4 _REC_S1VAL_20_u2 65535. _CNV_A_R_A_105_CM 0. 65535. DISPLAY_IDENTIFIER Pxx_dgdftmng_dtc_sens_spg.Ctx_ffm_did_xxx[4] /end CHARACTERISTIC
/begin CHARACTERISTIC Cxx_dtc_hmb_sens_spg "" VALUE 0xa002aaf6 _REC_S1VAL_20_u2 65535. _CNV_A_R_A_105_CM 0. 65535. DISPLAY_IDENTIFIER Pxx_dgdftmng_dtc_sens_spg.Cxx_dtc_hmb_xxx /end CHARACTERISTIC
/begin CHARACTERISTIC Ctx_ffm_did_sens_tco[0] "" VALUE 0xa002aaf8 _REC_S1VAL_20_u2 65535. _CNV_A_R_A_105_CM 0. 65535. DISPLAY_IDENTIFIER Pxx_dgdftmng_dtc_sens_tco.Ctx_ffm_did_xxx[0] /end CHARACTERISTIC
/begin CHARACTERISTIC Ctx_ffm_did_sens_tco[1] "" VALUE 0xa002aafa _REC_S1VAL_20_u2 65535. _CNV_A_R_A_105_CM 0. 65535. DISPLAY_IDENTIFIER Pxx_dgdftmng_dtc_sens_tco.Ctx_ffm_did_xxx[1] /end CHARACTERISTIC
/begin CHARACTERISTIC Ctx_ffm_did_sens_tco[2] "" VALUE 0xa002aafc _REC_S1VAL_20_u2 65535. _CNV_A_R_A_105_CM 0. 65535. DISPLAY_IDENTIFIER Pxx_dgdftmng_dtc_sens_tco.Ctx_ffm_did_xxx[2] /end CHARACTERISTIC
/begin CHARACTERISTIC Ctx_ffm_did_sens_tco[3] "" VALUE 0xa002aafe _REC_S1VAL_20_u2 65535. _CNV_A_R_A_105_CM 0. 65535. DISPLAY_IDENTIFIER Pxx_dgdftmng_dtc_sens_tco.Ctx_ffm_did_xxx[3] /end CHARACTERISTIC
/begin CHARACTERISTIC Ctx_ffm_did_sens_tco[4] "" VALUE 0xa002ab00 _REC_S1VAL_20_u2 65535. _CNV_A_R_A_105_CM 0. 65535. DISPLAY_IDENTIFIER Pxx_dgdftmng_dtc_sens_tco.Ctx_ffm_did_xxx[4] /end CHARACTERISTIC
/begin CHARACTERISTIC Cxx_dtc_hmb_sens_tco "" VALUE 0xa002ab02 _REC_S1VAL_20_u2 65535. _CNV_A_R_A_105_CM 0. 65535. DISPLAY_IDENTIFIER Pxx_dgdftmng_dtc_sens_tco.Cxx_dtc_hmb_xxx /end CHARACTERISTIC
/begin CHARACTERISTIC Ctx_ffm_did_sfty_tq[0] "" VALUE 0xa002ac9c _REC_S1VAL_20_u2 65535. _CNV_A_R_A_105_CM 0. 65535. DISPLAY_IDENTIFIER Pxx_dgdftmng_dtc_sfty_tq.Ctx_ffm_did_xxx[0] /end CHARACTERISTIC
/begin CHARACTERISTIC Ctx_ffm_did_sfty_tq[1] "" VALUE 0xa002ac9e _REC_S1VAL_20_u2 65535. _CNV_A_R_A_105_CM 0. 65535. DISPLAY_IDENTIFIER Pxx_dgdftmng_dtc_sfty_tq.Ctx_ffm_did_xxx[1] /end CHARACTERISTIC
/begin CHARACTERISTIC Ctx_ffm_did_sfty_tq[2] "" VALUE 0xa002aca0 _REC_S1VAL_20_u2 65535. _CNV_A_R_A_105_CM 0. 65535. DISPLAY_IDENTIFIER Pxx_dgdftmng_dtc_sfty_tq.Ctx_ffm_did_xxx[2] /end CHARACTERISTIC
/begin CHARACTERISTIC Ctx_ffm_did_sfty_tq[3] "" VALUE 0xa002aca2 _REC_S1VAL_20_u2 65535. _CNV_A_R_A_105_CM 0. 65535. DISPLAY_IDENTIFIER Pxx_dgdftmng_dtc_sfty_tq.Ctx_ffm_did_xxx[3] /end CHARACTERISTIC
/begin CHARACTERISTIC Ctx_ffm_did_sfty_tq[4] "" VALUE 0xa002aca4 _REC_S1VAL_20_u2 65535. _CNV_A_R_A_105_CM 0. 65535. DISPLAY_IDENTIFIER Pxx_dgdftmng_dtc_sfty_tq.Ctx_ffm_did_xxx[4] /end CHARACTERISTIC
/begin CHARACTERISTIC Cxx_dtc_hmb_sfty_tq "" VALUE 0xa002aca6 _REC_S1VAL_20_u2 65535. _CNV_A_R_A_105_CM 0. 65535. DISPLAY_IDENTIFIER Pxx_dgdftmng_dtc_sfty_tq.Cxx_dtc_hmb_xxx /end CHARACTERISTIC
/begin CHARACTERISTIC Ctx_ffm_did_spg[0] "" VALUE 0xa002ac54 _REC_S1VAL_20_u2 65535. _CNV_A_R_A_105_CM 0. 65535. DISPLAY_IDENTIFIER Pxx_dgdftmng_dtc_spg.Ctx_ffm_did_xxx[0] /end CHARACTERISTIC
/begin CHARACTERISTIC Ctx_ffm_did_spg[1] "" VALUE 0xa002ac56 _REC_S1VAL_20_u2 65535. _CNV_A_R_A_105_CM 0. 65535. DISPLAY_IDENTIFIER Pxx_dgdftmng_dtc_spg.Ctx_ffm_did_xxx[1] /end CHARACTERISTIC
/begin CHARACTERISTIC Ctx_ffm_did_spg[2] "" VALUE 0xa002ac58 _REC_S1VAL_20_u2 65535. _CNV_A_R_A_105_CM 0. 65535. DISPLAY_IDENTIFIER Pxx_dgdftmng_dtc_spg.Ctx_ffm_did_xxx[2] /end CHARACTERISTIC
/begin CHARACTERISTIC Ctx_ffm_did_spg[3] "" VALUE 0xa002ac5a _REC_S1VAL_20_u2 65535. _CNV_A_R_A_105_CM 0. 65535. DISPLAY_IDENTIFIER Pxx_dgdftmng_dtc_spg.Ctx_ffm_did_xxx[3] /end CHARACTERISTIC
/begin CHARACTERISTIC Ctx_ffm_did_spg[4] "" VALUE 0xa002ac5c _REC_S1VAL_20_u2 65535. _CNV_A_R_A_105_CM 0. 65535. DISPLAY_IDENTIFIER Pxx_dgdftmng_dtc_spg.Ctx_ffm_did_xxx[4] /end CHARACTERISTIC
/begin CHARACTERISTIC Cxx_dtc_hmb_spg "" VALUE 0xa002ac5e _REC_S1VAL_20_u2 65535. _CNV_A_R_A_105_CM 0. 65535. DISPLAY_IDENTIFIER Pxx_dgdftmng_dtc_spg.Cxx_dtc_hmb_xxx /end CHARACTERISTIC
/begin CHARACTERISTIC Ctx_ffm_did_spg_reg[0] "" VALUE 0xa002ab04 _REC_S1VAL_20_u2 65535. _CNV_A_R_A_105_CM 0. 65535. DISPLAY_IDENTIFIER Pxx_dgdftmng_dtc_spg_reg.Ctx_ffm_did_xxx[0] /end CHARACTERISTIC
/begin CHARACTERISTIC Ctx_ffm_did_spg_reg[1] "" VALUE 0xa002ab06 _REC_S1VAL_20_u2 65535. _CNV_A_R_A_105_CM 0. 65535. DISPLAY_IDENTIFIER Pxx_dgdftmng_dtc_spg_reg.Ctx_ffm_did_xxx[1] /end CHARACTERISTIC
/begin CHARACTERISTIC Ctx_ffm_did_spg_reg[2] "" VALUE 0xa002ab08 _REC_S1VAL_20_u2 65535. _CNV_A_R_A_105_CM 0. 65535. DISPLAY_IDENTIFIER Pxx_dgdftmng_dtc_spg_reg.Ctx_ffm_did_xxx[2] /end CHARACTERISTIC
/begin CHARACTERISTIC Ctx_ffm_did_spg_reg[3] "" VALUE 0xa002ab0a _REC_S1VAL_20_u2 65535. _CNV_A_R_A_105_CM 0. 65535. DISPLAY_IDENTIFIER Pxx_dgdftmng_dtc_spg_reg.Ctx_ffm_did_xxx[3] /end CHARACTERISTIC
/begin CHARACTERISTIC Ctx_ffm_did_spg_reg[4] "" VALUE 0xa002ab0c _REC_S1VAL_20_u2 65535. _CNV_A_R_A_105_CM 0. 65535. DISPLAY_IDENTIFIER Pxx_dgdftmng_dtc_spg_reg.Ctx_ffm_did_xxx[4] /end CHARACTERISTIC
/begin CHARACTERISTIC Cxx_dtc_hmb_spg_reg "" VALUE 0xa002ab0e _REC_S1VAL_20_u2 65535. _CNV_A_R_A_105_CM 0. 65535. DISPLAY_IDENTIFIER Pxx_dgdftmng_dtc_spg_reg.Cxx_dtc_hmb_xxx /end CHARACTERISTIC
/begin CHARACTERISTIC Ctx_ffm_did_tco_cl[0] "" VALUE 0xa002ad68 _REC_S1VAL_20_u2 65535. _CNV_A_R_A_105_CM 0. 65535. DISPLAY_IDENTIFIER Pxx_dgdftmng_dtc_tco_cl.Ctx_ffm_did_xxx[0] /end CHARACTERISTIC
/begin CHARACTERISTIC Ctx_ffm_did_tco_cl[1] "" VALUE 0xa002ad6a _REC_S1VAL_20_u2 65535. _CNV_A_R_A_105_CM 0. 65535. DISPLAY_IDENTIFIER Pxx_dgdftmng_dtc_tco_cl.Ctx_ffm_did_xxx[1] /end CHARACTERISTIC
/begin CHARACTERISTIC Ctx_ffm_did_tco_cl[2] "" VALUE 0xa002ad6c _REC_S1VAL_20_u2 65535. _CNV_A_R_A_105_CM 0. 65535. DISPLAY_IDENTIFIER Pxx_dgdftmng_dtc_tco_cl.Ctx_ffm_did_xxx[2] /end CHARACTERISTIC
/begin CHARACTERISTIC Ctx_ffm_did_tco_cl[3] "" VALUE 0xa002ad6e _REC_S1VAL_20_u2 65535. _CNV_A_R_A_105_CM 0. 65535. DISPLAY_IDENTIFIER Pxx_dgdftmng_dtc_tco_cl.Ctx_ffm_did_xxx[3] /end CHARACTERISTIC
/begin CHARACTERISTIC Ctx_ffm_did_tco_cl[4] "" VALUE 0xa002ad70 _REC_S1VAL_20_u2 65535. _CNV_A_R_A_105_CM 0. 65535. DISPLAY_IDENTIFIER Pxx_dgdftmng_dtc_tco_cl.Ctx_ffm_did_xxx[4] /end CHARACTERISTIC
/begin CHARACTERISTIC Cxx_dtc_hmb_tco_cl "" VALUE 0xa002ad72 _REC_S1VAL_20_u2 65535. _CNV_A_R_A_105_CM 0. 65535. DISPLAY_IDENTIFIER Pxx_dgdftmng_dtc_tco_cl.Cxx_dtc_hmb_xxx /end CHARACTERISTIC
/begin CHARACTERISTIC Ctx_ffm_did_tlz_ad_b[0] "" VALUE 0xa002ac60 _REC_S1VAL_20_u2 65535. _CNV_A_R_A_105_CM 0. 65535. DISPLAY_IDENTIFIER Pxx_dgdftmng_dtc_tlz_ad_b.Ctx_ffm_did_xxx[0] /end CHARACTERISTIC
/begin CHARACTERISTIC Ctx_ffm_did_tlz_ad_b[1] "" VALUE 0xa002ac62 _REC_S1VAL_20_u2 65535. _CNV_A_R_A_105_CM 0. 65535. DISPLAY_IDENTIFIER Pxx_dgdftmng_dtc_tlz_ad_b.Ctx_ffm_did_xxx[1] /end CHARACTERISTIC
/begin CHARACTERISTIC Ctx_ffm_did_tlz_ad_b[2] "" VALUE 0xa002ac64 _REC_S1VAL_20_u2 65535. _CNV_A_R_A_105_CM 0. 65535. DISPLAY_IDENTIFIER Pxx_dgdftmng_dtc_tlz_ad_b.Ctx_ffm_did_xxx[2] /end CHARACTERISTIC
/begin CHARACTERISTIC Ctx_ffm_did_tlz_ad_b[3] "" VALUE 0xa002ac66 _REC_S1VAL_20_u2 65535. _CNV_A_R_A_105_CM 0. 65535. DISPLAY_IDENTIFIER Pxx_dgdftmng_dtc_tlz_ad_b.Ctx_ffm_did_xxx[3] /end CHARACTERISTIC
/begin CHARACTERISTIC Ctx_ffm_did_tlz_ad_b[4] "" VALUE 0xa002ac68 _REC_S1VAL_20_u2 65535. _CNV_A_R_A_105_CM 0. 65535. DISPLAY_IDENTIFIER Pxx_dgdftmng_dtc_tlz_ad_b.Ctx_ffm_did_xxx[4] /end CHARACTERISTIC
/begin CHARACTERISTIC Cxx_dtc_hmb_tlz_ad_b "" VALUE 0xa002ac6a _REC_S1VAL_20_u2 65535. _CNV_A_R_A_105_CM 0. 65535. DISPLAY_IDENTIFIER Pxx_dgdftmng_dtc_tlz_ad_b.Cxx_dtc_hmb_xxx /end CHARACTERISTIC
/begin CHARACTERISTIC Ctx_ffm_did_tsta_reg[0] "" VALUE 0xa002ad74 _REC_S1VAL_20_u2 65535. _CNV_A_R_A_105_CM 0. 65535. DISPLAY_IDENTIFIER Pxx_dgdftmng_dtc_tsta_reg.Ctx_ffm_did_xxx[0] /end CHARACTERISTIC
/begin CHARACTERISTIC Ctx_ffm_did_tsta_reg[1] "" VALUE 0xa002ad76 _REC_S1VAL_20_u2 65535. _CNV_A_R_A_105_CM 0. 65535. DISPLAY_IDENTIFIER Pxx_dgdftmng_dtc_tsta_reg.Ctx_ffm_did_xxx[1] /end CHARACTERISTIC
/begin CHARACTERISTIC Ctx_ffm_did_tsta_reg[2] "" VALUE 0xa002ad78 _REC_S1VAL_20_u2 65535. _CNV_A_R_A_105_CM 0. 65535. DISPLAY_IDENTIFIER Pxx_dgdftmng_dtc_tsta_reg.Ctx_ffm_did_xxx[2] /end CHARACTERISTIC
/begin CHARACTERISTIC Ctx_ffm_did_tsta_reg[3] "" VALUE 0xa002ad7a _REC_S1VAL_20_u2 65535. _CNV_A_R_A_105_CM 0. 65535. DISPLAY_IDENTIFIER Pxx_dgdftmng_dtc_tsta_reg.Ctx_ffm_did_xxx[3] /end CHARACTERISTIC
/begin CHARACTERISTIC Ctx_ffm_did_tsta_reg[4] "" VALUE 0xa002ad7c _REC_S1VAL_20_u2 65535. _CNV_A_R_A_105_CM 0. 65535. DISPLAY_IDENTIFIER Pxx_dgdftmng_dtc_tsta_reg.Ctx_ffm_did_xxx[4] /end CHARACTERISTIC
/begin CHARACTERISTIC Cxx_dtc_hmb_tsta_reg "" VALUE 0xa002ad7e _REC_S1VAL_20_u2 65535. _CNV_A_R_A_105_CM 0. 65535. DISPLAY_IDENTIFIER Pxx_dgdftmng_dtc_tsta_reg.Cxx_dtc_hmb_xxx /end CHARACTERISTIC
/begin CHARACTERISTIC Ctx_ffm_did_vb[0] "" VALUE 0xa002ab10 _REC_S1VAL_20_u2 65535. _CNV_A_R_A_105_CM 0. 65535. DISPLAY_IDENTIFIER Pxx_dgdftmng_dtc_vb.Ctx_ffm_did_xxx[0] /end CHARACTERISTIC
/begin CHARACTERISTIC Ctx_ffm_did_vb[1] "" VALUE 0xa002ab12 _REC_S1VAL_20_u2 65535. _CNV_A_R_A_105_CM 0. 65535. DISPLAY_IDENTIFIER Pxx_dgdftmng_dtc_vb.Ctx_ffm_did_xxx[1] /end CHARACTERISTIC
/begin CHARACTERISTIC Ctx_ffm_did_vb[2] "" VALUE 0xa002ab14 _REC_S1VAL_20_u2 65535. _CNV_A_R_A_105_CM 0. 65535. DISPLAY_IDENTIFIER Pxx_dgdftmng_dtc_vb.Ctx_ffm_did_xxx[2] /end CHARACTERISTIC
/begin CHARACTERISTIC Ctx_ffm_did_vb[3] "" VALUE 0xa002ab16 _REC_S1VAL_20_u2 65535. _CNV_A_R_A_105_CM 0. 65535. DISPLAY_IDENTIFIER Pxx_dgdftmng_dtc_vb.Ctx_ffm_did_xxx[3] /end CHARACTERISTIC
/begin CHARACTERISTIC Ctx_ffm_did_vb[4] "" VALUE 0xa002ab18 _REC_S1VAL_20_u2 65535. _CNV_A_R_A_105_CM 0. 65535. DISPLAY_IDENTIFIER Pxx_dgdftmng_dtc_vb.Ctx_ffm_did_xxx[4] /end CHARACTERISTIC
/begin CHARACTERISTIC Cxx_dtc_hmb_vb "" VALUE 0xa002ab1a _REC_S1VAL_20_u2 65535. _CNV_A_R_A_105_CM 0. 65535. DISPLAY_IDENTIFIER Pxx_dgdftmng_dtc_vb.Cxx_dtc_hmb_xxx /end CHARACTERISTIC
/begin CHARACTERISTIC Ctx_ffm_did_vb_rly[0] "" VALUE 0xa002ab1c _REC_S1VAL_20_u2 65535. _CNV_A_R_A_105_CM 0. 65535. DISPLAY_IDENTIFIER Pxx_dgdftmng_dtc_vb_rly.Ctx_ffm_did_xxx[0] /end CHARACTERISTIC
/begin CHARACTERISTIC Ctx_ffm_did_vb_rly[1] "" VALUE 0xa002ab1e _REC_S1VAL_20_u2 65535. _CNV_A_R_A_105_CM 0. 65535. DISPLAY_IDENTIFIER Pxx_dgdftmng_dtc_vb_rly.Ctx_ffm_did_xxx[1] /end CHARACTERISTIC
/begin CHARACTERISTIC Ctx_ffm_did_vb_rly[2] "" VALUE 0xa002ab20 _REC_S1VAL_20_u2 65535. _CNV_A_R_A_105_CM 0. 65535. DISPLAY_IDENTIFIER Pxx_dgdftmng_dtc_vb_rly.Ctx_ffm_did_xxx[2] /end CHARACTERISTIC
/begin CHARACTERISTIC Ctx_ffm_did_vb_rly[3] "" VALUE 0xa002ab22 _REC_S1VAL_20_u2 65535. _CNV_A_R_A_105_CM 0. 65535. DISPLAY_IDENTIFIER Pxx_dgdftmng_dtc_vb_rly.Ctx_ffm_did_xxx[3] /end CHARACTERISTIC
/begin CHARACTERISTIC Ctx_ffm_did_vb_rly[4] "" VALUE 0xa002ab24 _REC_S1VAL_20_u2 65535. _CNV_A_R_A_105_CM 0. 65535. DISPLAY_IDENTIFIER Pxx_dgdftmng_dtc_vb_rly.Ctx_ffm_did_xxx[4] /end CHARACTERISTIC
/begin CHARACTERISTIC Cxx_dtc_hmb_vb_rly "" VALUE 0xa002ab26 _REC_S1VAL_20_u2 65535. _CNV_A_R_A_105_CM 0. 65535. DISPLAY_IDENTIFIER Pxx_dgdftmng_dtc_vb_rly.Cxx_dtc_hmb_xxx /end CHARACTERISTIC
/begin CHARACTERISTIC Ctx_ffm_did_wgc[0] "" VALUE 0xa002ac6c _REC_S1VAL_20_u2 65535. _CNV_A_R_A_105_CM 0. 65535. DISPLAY_IDENTIFIER Pxx_dgdftmng_dtc_wgc.Ctx_ffm_did_xxx[0] /end CHARACTERISTIC
/begin CHARACTERISTIC Ctx_ffm_did_wgc[1] "" VALUE 0xa002ac6e _REC_S1VAL_20_u2 65535. _CNV_A_R_A_105_CM 0. 65535. DISPLAY_IDENTIFIER Pxx_dgdftmng_dtc_wgc.Ctx_ffm_did_xxx[1] /end CHARACTERISTIC
/begin CHARACTERISTIC Ctx_ffm_did_wgc[2] "" VALUE 0xa002ac70 _REC_S1VAL_20_u2 65535. _CNV_A_R_A_105_CM 0. 65535. DISPLAY_IDENTIFIER Pxx_dgdftmng_dtc_wgc.Ctx_ffm_did_xxx[2] /end CHARACTERISTIC
/begin CHARACTERISTIC Ctx_ffm_did_wgc[3] "" VALUE 0xa002ac72 _REC_S1VAL_20_u2 65535. _CNV_A_R_A_105_CM 0. 65535. DISPLAY_IDENTIFIER Pxx_dgdftmng_dtc_wgc.Ctx_ffm_did_xxx[3] /end CHARACTERISTIC
/begin CHARACTERISTIC Ctx_ffm_did_wgc[4] "" VALUE 0xa002ac74 _REC_S1VAL_20_u2 65535. _CNV_A_R_A_105_CM 0. 65535. DISPLAY_IDENTIFIER Pxx_dgdftmng_dtc_wgc.Ctx_ffm_did_xxx[4] /end CHARACTERISTIC
/begin CHARACTERISTIC Cxx_dtc_hmb_wgc "" VALUE 0xa002ac76 _REC_S1VAL_20_u2 65535. _CNV_A_R_A_105_CM 0. 65535. DISPLAY_IDENTIFIER Pxx_dgdftmng_dtc_wgc.Cxx_dtc_hmb_xxx /end CHARACTERISTIC
/begin CHARACTERISTIC Ctx_ffm_did_wpmp_tcr[0] "" VALUE 0xa002ac78 _REC_S1VAL_20_u2 65535. _CNV_A_R_A_105_CM 0. 65535. DISPLAY_IDENTIFIER Pxx_dgdftmng_dtc_wpmp_tcr.Ctx_ffm_did_xxx[0] /end CHARACTERISTIC
/begin CHARACTERISTIC Ctx_ffm_did_wpmp_tcr[1] "" VALUE 0xa002ac7a _REC_S1VAL_20_u2 65535. _CNV_A_R_A_105_CM 0. 65535. DISPLAY_IDENTIFIER Pxx_dgdftmng_dtc_wpmp_tcr.Ctx_ffm_did_xxx[1] /end CHARACTERISTIC
/begin CHARACTERISTIC Ctx_ffm_did_wpmp_tcr[2] "" VALUE 0xa002ac7c _REC_S1VAL_20_u2 65535. _CNV_A_R_A_105_CM 0. 65535. DISPLAY_IDENTIFIER Pxx_dgdftmng_dtc_wpmp_tcr.Ctx_ffm_did_xxx[2] /end CHARACTERISTIC
/begin CHARACTERISTIC Ctx_ffm_did_wpmp_tcr[3] "" VALUE 0xa002ac7e _REC_S1VAL_20_u2 65535. _CNV_A_R_A_105_CM 0. 65535. DISPLAY_IDENTIFIER Pxx_dgdftmng_dtc_wpmp_tcr.Ctx_ffm_did_xxx[3] /end CHARACTERISTIC
/begin CHARACTERISTIC Ctx_ffm_did_wpmp_tcr[4] "" VALUE 0xa002ac80 _REC_S1VAL_20_u2 65535. _CNV_A_R_A_105_CM 0. 65535. DISPLAY_IDENTIFIER Pxx_dgdftmng_dtc_wpmp_tcr.Ctx_ffm_did_xxx[4] /end CHARACTERISTIC
/begin CHARACTERISTIC Cxx_dtc_hmb_wpmp_tcr "" VALUE 0xa002ac82 _REC_S1VAL_20_u2 65535. _CNV_A_R_A_105_CM 0. 65535. DISPLAY_IDENTIFIER Pxx_dgdftmng_dtc_wpmp_tcr.Cxx_dtc_hmb_xxx /end CHARACTERISTIC
/begin CHARACTERISTIC Cxx_conf_wal_ac_prs_h "" VALUE 0xa002adb8 _REC_S1VAL_20_u1 3. _CNV_A_R_A_105_CM 0. 3. DISPLAY_IDENTIFIER fm_cal_ac_prs_h.fm_static_bitfield.Cxx_conf_wal_xxx BIT_MASK 0x3 /end CHARACTERISTIC
/begin CHARACTERISTIC Cxx_dtc_lb_ac_prs_h "" VALUE 0xa002adb9 _REC_S1VAL_20_u1 255. _CNV_A_R_A_105_CM 0. 255. DISPLAY_IDENTIFIER fm_cal_ac_prs_h.Cxx_dtc_lb_xxx /end CHARACTERISTIC
/begin CHARACTERISTIC Cxx_obd_us_typ_ac_prs_h "" VALUE 0xa002adbb _REC_S1VAL_20_u1 255. _CNV_A_R_A_105_CM 0. 255. DISPLAY_IDENTIFIER fm_cal_ac_prs_h.Cxx_obd_us_typ_xxx /end CHARACTERISTIC
/begin CHARACTERISTIC Cxx_conf_wal_ac_prs_l "" VALUE 0xa002adc4 _REC_S1VAL_20_u1 3. _CNV_A_R_A_105_CM 0. 3. DISPLAY_IDENTIFIER fm_cal_ac_prs_l.fm_static_bitfield.Cxx_conf_wal_xxx BIT_MASK 0x3 /end CHARACTERISTIC
/begin CHARACTERISTIC Cxx_dtc_lb_ac_prs_l "" VALUE 0xa002adc5 _REC_S1VAL_20_u1 255. _CNV_A_R_A_105_CM 0. 255. DISPLAY_IDENTIFIER fm_cal_ac_prs_l.Cxx_dtc_lb_xxx /end CHARACTERISTIC
/begin CHARACTERISTIC Cxx_obd_us_typ_ac_prs_l "" VALUE 0xa002adc7 _REC_S1VAL_20_u1 255. _CNV_A_R_A_105_CM 0. 255. DISPLAY_IDENTIFIER fm_cal_ac_prs_l.Cxx_obd_us_typ_xxx /end CHARACTERISTIC
/begin CHARACTERISTIC Cxx_dtc_obd_acel_pdl_chr "" VALUE 0xa002adce _REC_S1VAL_20_u2 65535. _CNV_A_R_A_105_CM 0. 65535. DISPLAY_IDENTIFIER fm_cal_acel_pdl_chr.Cxx_dtc_obd_xxx /end CHARACTERISTIC
/begin CHARACTERISTIC Cxx_conf_wal_acel_pdl_chr "" VALUE 0xa002add0 _REC_S1VAL_20_u1 3. _CNV_A_R_A_105_CM 0. 3. DISPLAY_IDENTIFIER fm_cal_acel_pdl_chr.fm_static_bitfield.Cxx_conf_wal_xxx BIT_MASK 0x3 /end CHARACTERISTIC
/begin CHARACTERISTIC Cbx_obd_acel_pdl_chr "" VALUE 0xa002add0 _REC_S1VAL_20_u1 255. _CNV_A_R_A_105_CM 0. 255. DISPLAY_IDENTIFIER fm_cal_acel_pdl_chr.fm_static_bitfield.Cbx_obd_xxx BIT_MASK 0x4 /end CHARACTERISTIC
/begin CHARACTERISTIC Cbx_obd_mena_acel_pdl_chr "" VALUE 0xa002add0 _REC_S1VAL_20_u1 255. _CNV_A_R_A_105_CM 0. 255. DISPLAY_IDENTIFIER fm_cal_acel_pdl_chr.fm_static_bitfield.Cbx_obd_mena_xxx BIT_MASK 0x8 /end CHARACTERISTIC
/begin CHARACTERISTIC Cxx_dtc_lb_acel_pdl_chr "" VALUE 0xa002add1 _REC_S1VAL_20_u1 255. _CNV_A_R_A_105_CM 0. 255. DISPLAY_IDENTIFIER fm_cal_acel_pdl_chr.Cxx_dtc_lb_xxx /end CHARACTERISTIC
/begin CHARACTERISTIC Cxx_obd_dc_acel_pdl_chr "" VALUE 0xa002add2 _REC_S1VAL_20_u1 9. _CNV_A_R_A_105_CM 1. 10. DISPLAY_IDENTIFIER fm_cal_acel_pdl_chr.Cxx_obd_dc_xxx /end CHARACTERISTIC
/begin CHARACTERISTIC Cxx_obd_us_typ_acel_pdl_chr "" VALUE 0xa002add3 _REC_S1VAL_20_u1 255. _CNV_A_R_A_105_CM 0. 255. DISPLAY_IDENTIFIER fm_cal_acel_pdl_chr.Cxx_obd_us_typ_xxx /end CHARACTERISTIC
/begin CHARACTERISTIC Cxx_dtc_obd_acel_pdl_secu_1 "" VALUE 0xa002adda _REC_S1VAL_20_u2 65535. _CNV_A_R_A_105_CM 0. 65535. DISPLAY_IDENTIFIER fm_cal_acel_pdl_secu_1.Cxx_dtc_obd_xxx /end CHARACTERISTIC
/begin CHARACTERISTIC Cxx_conf_wal_acel_pdl_secu_1 "" VALUE 0xa002addc _REC_S1VAL_20_u1 3. _CNV_A_R_A_105_CM 0. 3. DISPLAY_IDENTIFIER fm_cal_acel_pdl_secu_1.fm_static_bitfield.Cxx_conf_wal_xxx BIT_MASK 0x3 /end CHARACTERISTIC
/begin CHARACTERISTIC Cbx_obd_acel_pdl_secu_1 "" VALUE 0xa002addc _REC_S1VAL_20_u1 255. _CNV_A_R_A_105_CM 0. 255. DISPLAY_IDENTIFIER fm_cal_acel_pdl_secu_1.fm_static_bitfield.Cbx_obd_xxx BIT_MASK 0x4 /end CHARACTERISTIC
/begin CHARACTERISTIC Cbx_obd_mena_acel_pdl_secu_1 "" VALUE 0xa002addc _REC_S1VAL_20_u1 255. _CNV_A_R_A_105_CM 0. 255. DISPLAY_IDENTIFIER fm_cal_acel_pdl_secu_1.fm_static_bitfield.Cbx_obd_mena_xxx BIT_MASK 0x8 /end CHARACTERISTIC
/begin CHARACTERISTIC Cxx_dtc_lb_acel_pdl_secu_1 "" VALUE 0xa002addd _REC_S1VAL_20_u1 255. _CNV_A_R_A_105_CM 0. 255. DISPLAY_IDENTIFIER fm_cal_acel_pdl_secu_1.Cxx_dtc_lb_xxx /end CHARACTERISTIC
/begin CHARACTERISTIC Cxx_obd_dc_acel_pdl_secu_1 "" VALUE 0xa002adde _REC_S1VAL_20_u1 9. _CNV_A_R_A_105_CM 1. 10. DISPLAY_IDENTIFIER fm_cal_acel_pdl_secu_1.Cxx_obd_dc_xxx /end CHARACTERISTIC
/begin CHARACTERISTIC Cxx_obd_us_typ_acel_pdl_secu_1 "" VALUE 0xa002addf _REC_S1VAL_20_u1 255. _CNV_A_R_A_105_CM 0. 255. DISPLAY_IDENTIFIER fm_cal_acel_pdl_secu_1.Cxx_obd_us_typ_xxx /end CHARACTERISTIC
/begin CHARACTERISTIC Cxx_dtc_obd_acel_pdl_secu_2 "" VALUE 0xa002ade6 _REC_S1VAL_20_u2 65535. _CNV_A_R_A_105_CM 0. 65535. DISPLAY_IDENTIFIER fm_cal_acel_pdl_secu_2.Cxx_dtc_obd_xxx /end CHARACTERISTIC
/begin CHARACTERISTIC Cxx_conf_wal_acel_pdl_secu_2 "" VALUE 0xa002ade8 _REC_S1VAL_20_u1 3. _CNV_A_R_A_105_CM 0. 3. DISPLAY_IDENTIFIER fm_cal_acel_pdl_secu_2.fm_static_bitfield.Cxx_conf_wal_xxx BIT_MASK 0x3 /end CHARACTERISTIC
/begin CHARACTERISTIC Cbx_obd_acel_pdl_secu_2 "" VALUE 0xa002ade8 _REC_S1VAL_20_u1 255. _CNV_A_R_A_105_CM 0. 255. DISPLAY_IDENTIFIER fm_cal_acel_pdl_secu_2.fm_static_bitfield.Cbx_obd_xxx BIT_MASK 0x4 /end CHARACTERISTIC
/begin CHARACTERISTIC Cbx_obd_mena_acel_pdl_secu_2 "" VALUE 0xa002ade8 _REC_S1VAL_20_u1 255. _CNV_A_R_A_105_CM 0. 255. DISPLAY_IDENTIFIER fm_cal_acel_pdl_secu_2.fm_static_bitfield.Cbx_obd_mena_xxx BIT_MASK 0x8 /end CHARACTERISTIC
/begin CHARACTERISTIC Cxx_dtc_lb_acel_pdl_secu_2 "" VALUE 0xa002ade9 _REC_S1VAL_20_u1 255. _CNV_A_R_A_105_CM 0. 255. DISPLAY_IDENTIFIER fm_cal_acel_pdl_secu_2.Cxx_dtc_lb_xxx /end CHARACTERISTIC
/begin CHARACTERISTIC Cxx_obd_dc_acel_pdl_secu_2 "" VALUE 0xa002adea _REC_S1VAL_20_u1 9. _CNV_A_R_A_105_CM 1. 10. DISPLAY_IDENTIFIER fm_cal_acel_pdl_secu_2.Cxx_obd_dc_xxx /end CHARACTERISTIC
/begin CHARACTERISTIC Cxx_obd_us_typ_acel_pdl_secu_2 "" VALUE 0xa002adeb _REC_S1VAL_20_u1 255. _CNV_A_R_A_105_CM 0. 255. DISPLAY_IDENTIFIER fm_cal_acel_pdl_secu_2.Cxx_obd_us_typ_xxx /end CHARACTERISTIC
/begin CHARACTERISTIC Cxx_dtc_obd_acel_pdl_tot "" VALUE 0xa002adf2 _REC_S1VAL_20_u2 65535. _CNV_A_R_A_105_CM 0. 65535. DISPLAY_IDENTIFIER fm_cal_acel_pdl_tot.Cxx_dtc_obd_xxx /end CHARACTERISTIC
/begin CHARACTERISTIC Cxx_conf_wal_acel_pdl_tot "" VALUE 0xa002adf4 _REC_S1VAL_20_u1 3. _CNV_A_R_A_105_CM 0. 3. DISPLAY_IDENTIFIER fm_cal_acel_pdl_tot.fm_static_bitfield.Cxx_conf_wal_xxx BIT_MASK 0x3 /end CHARACTERISTIC
/begin CHARACTERISTIC Cbx_obd_acel_pdl_tot "" VALUE 0xa002adf4 _REC_S1VAL_20_u1 255. _CNV_A_R_A_105_CM 0. 255. DISPLAY_IDENTIFIER fm_cal_acel_pdl_tot.fm_static_bitfield.Cbx_obd_xxx BIT_MASK 0x4 /end CHARACTERISTIC
/begin CHARACTERISTIC Cbx_obd_mena_acel_pdl_tot "" VALUE 0xa002adf4 _REC_S1VAL_20_u1 255. _CNV_A_R_A_105_CM 0. 255. DISPLAY_IDENTIFIER fm_cal_acel_pdl_tot.fm_static_bitfield.Cbx_obd_mena_xxx BIT_MASK 0x8 /end CHARACTERISTIC
/begin CHARACTERISTIC Cxx_dtc_lb_acel_pdl_tot "" VALUE 0xa002adf5 _REC_S1VAL_20_u1 255. _CNV_A_R_A_105_CM 0. 255. DISPLAY_IDENTIFIER fm_cal_acel_pdl_tot.Cxx_dtc_lb_xxx /end CHARACTERISTIC
/begin CHARACTERISTIC Cxx_obd_dc_acel_pdl_tot "" VALUE 0xa002adf6 _REC_S1VAL_20_u1 9. _CNV_A_R_A_105_CM 1. 10. DISPLAY_IDENTIFIER fm_cal_acel_pdl_tot.Cxx_obd_dc_xxx /end CHARACTERISTIC
/begin CHARACTERISTIC Cxx_obd_us_typ_acel_pdl_tot "" VALUE 0xa002adf7 _REC_S1VAL_20_u1 255. _CNV_A_R_A_105_CM 0. 255. DISPLAY_IDENTIFIER fm_cal_acel_pdl_tot.Cxx_obd_us_typ_xxx /end CHARACTERISTIC
/begin CHARACTERISTIC Cxx_dtc_obd_acel_pdl_v1_h "" VALUE 0xa002adfe _REC_S1VAL_20_u2 65535. _CNV_A_R_A_105_CM 0. 65535. DISPLAY_IDENTIFIER fm_cal_acel_pdl_v1_h.Cxx_dtc_obd_xxx /end CHARACTERISTIC
/begin CHARACTERISTIC Cxx_conf_wal_acel_pdl_v1_h "" VALUE 0xa002ae00 _REC_S1VAL_20_u1 3. _CNV_A_R_A_105_CM 0. 3. DISPLAY_IDENTIFIER fm_cal_acel_pdl_v1_h.fm_static_bitfield.Cxx_conf_wal_xxx BIT_MASK 0x3 /end CHARACTERISTIC
/begin CHARACTERISTIC Cbx_obd_acel_pdl_v1_h "" VALUE 0xa002ae00 _REC_S1VAL_20_u1 255. _CNV_A_R_A_105_CM 0. 255. DISPLAY_IDENTIFIER fm_cal_acel_pdl_v1_h.fm_static_bitfield.Cbx_obd_xxx BIT_MASK 0x4 /end CHARACTERISTIC
/begin CHARACTERISTIC Cbx_obd_mena_acel_pdl_v1_h "" VALUE 0xa002ae00 _REC_S1VAL_20_u1 255. _CNV_A_R_A_105_CM 0. 255. DISPLAY_IDENTIFIER fm_cal_acel_pdl_v1_h.fm_static_bitfield.Cbx_obd_mena_xxx BIT_MASK 0x8 /end CHARACTERISTIC
/begin CHARACTERISTIC Cxx_dtc_lb_acel_pdl_v1_h "" VALUE 0xa002ae01 _REC_S1VAL_20_u1 255. _CNV_A_R_A_105_CM 0. 255. DISPLAY_IDENTIFIER fm_cal_acel_pdl_v1_h.Cxx_dtc_lb_xxx /end CHARACTERISTIC
/begin CHARACTERISTIC Cxx_obd_dc_acel_pdl_v1_h "" VALUE 0xa002ae02 _REC_S1VAL_20_u1 9. _CNV_A_R_A_105_CM 1. 10. DISPLAY_IDENTIFIER fm_cal_acel_pdl_v1_h.Cxx_obd_dc_xxx /end CHARACTERISTIC
/begin CHARACTERISTIC Cxx_obd_us_typ_acel_pdl_v1_h "" VALUE 0xa002ae03 _REC_S1VAL_20_u1 255. _CNV_A_R_A_105_CM 0. 255. DISPLAY_IDENTIFIER fm_cal_acel_pdl_v1_h.Cxx_obd_us_typ_xxx /end CHARACTERISTIC
/begin CHARACTERISTIC Cxx_dtc_obd_acel_pdl_v1_l "" VALUE 0xa002ae0a _REC_S1VAL_20_u2 65535. _CNV_A_R_A_105_CM 0. 65535. DISPLAY_IDENTIFIER fm_cal_acel_pdl_v1_l.Cxx_dtc_obd_xxx /end CHARACTERISTIC
/begin CHARACTERISTIC Cxx_conf_wal_acel_pdl_v1_l "" VALUE 0xa002ae0c _REC_S1VAL_20_u1 3. _CNV_A_R_A_105_CM 0. 3. DISPLAY_IDENTIFIER fm_cal_acel_pdl_v1_l.fm_static_bitfield.Cxx_conf_wal_xxx BIT_MASK 0x3 /end CHARACTERISTIC
/begin CHARACTERISTIC Cbx_obd_acel_pdl_v1_l "" VALUE 0xa002ae0c _REC_S1VAL_20_u1 255. _CNV_A_R_A_105_CM 0. 255. DISPLAY_IDENTIFIER fm_cal_acel_pdl_v1_l.fm_static_bitfield.Cbx_obd_xxx BIT_MASK 0x4 /end CHARACTERISTIC
/begin CHARACTERISTIC Cbx_obd_mena_acel_pdl_v1_l "" VALUE 0xa002ae0c _REC_S1VAL_20_u1 255. _CNV_A_R_A_105_CM 0. 255. DISPLAY_IDENTIFIER fm_cal_acel_pdl_v1_l.fm_static_bitfield.Cbx_obd_mena_xxx BIT_MASK 0x8 /end CHARACTERISTIC
/begin CHARACTERISTIC Cxx_dtc_lb_acel_pdl_v1_l "" VALUE 0xa002ae0d _REC_S1VAL_20_u1 255. _CNV_A_R_A_105_CM 0. 255. DISPLAY_IDENTIFIER fm_cal_acel_pdl_v1_l.Cxx_dtc_lb_xxx /end CHARACTERISTIC
/begin CHARACTERISTIC Cxx_obd_dc_acel_pdl_v1_l "" VALUE 0xa002ae0e _REC_S1VAL_20_u1 9. _CNV_A_R_A_105_CM 1. 10. DISPLAY_IDENTIFIER fm_cal_acel_pdl_v1_l.Cxx_obd_dc_xxx /end CHARACTERISTIC
/begin CHARACTERISTIC Cxx_obd_us_typ_acel_pdl_v1_l "" VALUE 0xa002ae0f _REC_S1VAL_20_u1 255. _CNV_A_R_A_105_CM 0. 255. DISPLAY_IDENTIFIER fm_cal_acel_pdl_v1_l.Cxx_obd_us_typ_xxx /end CHARACTERISTIC
/begin CHARACTERISTIC Cxx_dtc_obd_acel_pdl_v2_h "" VALUE 0xa002ae16 _REC_S1VAL_20_u2 65535. _CNV_A_R_A_105_CM 0. 65535. DISPLAY_IDENTIFIER fm_cal_acel_pdl_v2_h.Cxx_dtc_obd_xxx /end CHARACTERISTIC
/begin CHARACTERISTIC Cxx_conf_wal_acel_pdl_v2_h "" VALUE 0xa002ae18 _REC_S1VAL_20_u1 3. _CNV_A_R_A_105_CM 0. 3. DISPLAY_IDENTIFIER fm_cal_acel_pdl_v2_h.fm_static_bitfield.Cxx_conf_wal_xxx BIT_MASK 0x3 /end CHARACTERISTIC
/begin CHARACTERISTIC Cbx_obd_acel_pdl_v2_h "" VALUE 0xa002ae18 _REC_S1VAL_20_u1 255. _CNV_A_R_A_105_CM 0. 255. DISPLAY_IDENTIFIER fm_cal_acel_pdl_v2_h.fm_static_bitfield.Cbx_obd_xxx BIT_MASK 0x4 /end CHARACTERISTIC
/begin CHARACTERISTIC Cbx_obd_mena_acel_pdl_v2_h "" VALUE 0xa002ae18 _REC_S1VAL_20_u1 255. _CNV_A_R_A_105_CM 0. 255. DISPLAY_IDENTIFIER fm_cal_acel_pdl_v2_h.fm_static_bitfield.Cbx_obd_mena_xxx BIT_MASK 0x8 /end CHARACTERISTIC
/begin CHARACTERISTIC Cxx_dtc_lb_acel_pdl_v2_h "" VALUE 0xa002ae19 _REC_S1VAL_20_u1 255. _CNV_A_R_A_105_CM 0. 255. DISPLAY_IDENTIFIER fm_cal_acel_pdl_v2_h.Cxx_dtc_lb_xxx /end CHARACTERISTIC
/begin CHARACTERISTIC Cxx_obd_dc_acel_pdl_v2_h "" VALUE 0xa002ae1a _REC_S1VAL_20_u1 9. _CNV_A_R_A_105_CM 1. 10. DISPLAY_IDENTIFIER fm_cal_acel_pdl_v2_h.Cxx_obd_dc_xxx /end CHARACTERISTIC
/begin CHARACTERISTIC Cxx_obd_us_typ_acel_pdl_v2_h "" VALUE 0xa002ae1b _REC_S1VAL_20_u1 255. _CNV_A_R_A_105_CM 0. 255. DISPLAY_IDENTIFIER fm_cal_acel_pdl_v2_h.Cxx_obd_us_typ_xxx /end CHARACTERISTIC
/begin CHARACTERISTIC Cxx_dtc_obd_acel_pdl_v2_l "" VALUE 0xa002ae22 _REC_S1VAL_20_u2 65535. _CNV_A_R_A_105_CM 0. 65535. DISPLAY_IDENTIFIER fm_cal_acel_pdl_v2_l.Cxx_dtc_obd_xxx /end CHARACTERISTIC
/begin CHARACTERISTIC Cxx_conf_wal_acel_pdl_v2_l "" VALUE 0xa002ae24 _REC_S1VAL_20_u1 3. _CNV_A_R_A_105_CM 0. 3. DISPLAY_IDENTIFIER fm_cal_acel_pdl_v2_l.fm_static_bitfield.Cxx_conf_wal_xxx BIT_MASK 0x3 /end CHARACTERISTIC
/begin CHARACTERISTIC Cbx_obd_acel_pdl_v2_l "" VALUE 0xa002ae24 _REC_S1VAL_20_u1 255. _CNV_A_R_A_105_CM 0. 255. DISPLAY_IDENTIFIER fm_cal_acel_pdl_v2_l.fm_static_bitfield.Cbx_obd_xxx BIT_MASK 0x4 /end CHARACTERISTIC
/begin CHARACTERISTIC Cbx_obd_mena_acel_pdl_v2_l "" VALUE 0xa002ae24 _REC_S1VAL_20_u1 255. _CNV_A_R_A_105_CM 0. 255. DISPLAY_IDENTIFIER fm_cal_acel_pdl_v2_l.fm_static_bitfield.Cbx_obd_mena_xxx BIT_MASK 0x8 /end CHARACTERISTIC
/begin CHARACTERISTIC Cxx_dtc_lb_acel_pdl_v2_l "" VALUE 0xa002ae25 _REC_S1VAL_20_u1 255. _CNV_A_R_A_105_CM 0. 255. DISPLAY_IDENTIFIER fm_cal_acel_pdl_v2_l.Cxx_dtc_lb_xxx /end CHARACTERISTIC
/begin CHARACTERISTIC Cxx_obd_dc_acel_pdl_v2_l "" VALUE 0xa002ae26 _REC_S1VAL_20_u1 9. _CNV_A_R_A_105_CM 1. 10. DISPLAY_IDENTIFIER fm_cal_acel_pdl_v2_l.Cxx_obd_dc_xxx /end CHARACTERISTIC
/begin CHARACTERISTIC Cxx_obd_us_typ_acel_pdl_v2_l "" VALUE 0xa002ae27 _REC_S1VAL_20_u1 255. _CNV_A_R_A_105_CM 0. 255. DISPLAY_IDENTIFIER fm_cal_acel_pdl_v2_l.Cxx_obd_us_typ_xxx /end CHARACTERISTIC
/begin CHARACTERISTIC Cxx_dtc_obd_actr_rly_oc "" VALUE 0xa002ae2e _REC_S1VAL_20_u2 65535. _CNV_A_R_A_105_CM 0. 65535. DISPLAY_IDENTIFIER fm_cal_actr_rly_oc.Cxx_dtc_obd_xxx /end CHARACTERISTIC
/begin CHARACTERISTIC Cxx_conf_wal_actr_rly_oc "" VALUE 0xa002ae30 _REC_S1VAL_20_u1 3. _CNV_A_R_A_105_CM 0. 3. DISPLAY_IDENTIFIER fm_cal_actr_rly_oc.fm_static_bitfield.Cxx_conf_wal_xxx BIT_MASK 0x3 /end CHARACTERISTIC
/begin CHARACTERISTIC Cbx_obd_actr_rly_oc "" VALUE 0xa002ae30 _REC_S1VAL_20_u1 255. _CNV_A_R_A_105_CM 0. 255. DISPLAY_IDENTIFIER fm_cal_actr_rly_oc.fm_static_bitfield.Cbx_obd_xxx BIT_MASK 0x4 /end CHARACTERISTIC
/begin CHARACTERISTIC Cbx_obd_mena_actr_rly_oc "" VALUE 0xa002ae30 _REC_S1VAL_20_u1 255. _CNV_A_R_A_105_CM 0. 255. DISPLAY_IDENTIFIER fm_cal_actr_rly_oc.fm_static_bitfield.Cbx_obd_mena_xxx BIT_MASK 0x8 /end CHARACTERISTIC
/begin CHARACTERISTIC Cxx_dtc_lb_actr_rly_oc "" VALUE 0xa002ae31 _REC_S1VAL_20_u1 255. _CNV_A_R_A_105_CM 0. 255. DISPLAY_IDENTIFIER fm_cal_actr_rly_oc.Cxx_dtc_lb_xxx /end CHARACTERISTIC
/begin CHARACTERISTIC Cxx_obd_dc_actr_rly_oc "" VALUE 0xa002ae32 _REC_S1VAL_20_u1 9. _CNV_A_R_A_105_CM 1. 10. DISPLAY_IDENTIFIER fm_cal_actr_rly_oc.Cxx_obd_dc_xxx /end CHARACTERISTIC
/begin CHARACTERISTIC Cxx_obd_us_typ_actr_rly_oc "" VALUE 0xa002ae33 _REC_S1VAL_20_u1 255. _CNV_A_R_A_105_CM 0. 255. DISPLAY_IDENTIFIER fm_cal_actr_rly_oc.Cxx_obd_us_typ_xxx /end CHARACTERISTIC
/begin CHARACTERISTIC Cxx_dtc_obd_actr_rly_scg "" VALUE 0xa002ae3a _REC_S1VAL_20_u2 65535. _CNV_A_R_A_105_CM 0. 65535. DISPLAY_IDENTIFIER fm_cal_actr_rly_scg.Cxx_dtc_obd_xxx /end CHARACTERISTIC
/begin CHARACTERISTIC Cxx_conf_wal_actr_rly_scg "" VALUE 0xa002ae3c _REC_S1VAL_20_u1 3. _CNV_A_R_A_105_CM 0. 3. DISPLAY_IDENTIFIER fm_cal_actr_rly_scg.fm_static_bitfield.Cxx_conf_wal_xxx BIT_MASK 0x3 /end CHARACTERISTIC
/begin CHARACTERISTIC Cbx_obd_actr_rly_scg "" VALUE 0xa002ae3c _REC_S1VAL_20_u1 255. _CNV_A_R_A_105_CM 0. 255. DISPLAY_IDENTIFIER fm_cal_actr_rly_scg.fm_static_bitfield.Cbx_obd_xxx BIT_MASK 0x4 /end CHARACTERISTIC
/begin CHARACTERISTIC Cbx_obd_mena_actr_rly_scg "" VALUE 0xa002ae3c _REC_S1VAL_20_u1 255. _CNV_A_R_A_105_CM 0. 255. DISPLAY_IDENTIFIER fm_cal_actr_rly_scg.fm_static_bitfield.Cbx_obd_mena_xxx BIT_MASK 0x8 /end CHARACTERISTIC
/begin CHARACTERISTIC Cxx_dtc_lb_actr_rly_scg "" VALUE 0xa002ae3d _REC_S1VAL_20_u1 255. _CNV_A_R_A_105_CM 0. 255. DISPLAY_IDENTIFIER fm_cal_actr_rly_scg.Cxx_dtc_lb_xxx /end CHARACTERISTIC
/begin CHARACTERISTIC Cxx_obd_dc_actr_rly_scg "" VALUE 0xa002ae3e _REC_S1VAL_20_u1 9. _CNV_A_R_A_105_CM 1. 10. DISPLAY_IDENTIFIER fm_cal_actr_rly_scg.Cxx_obd_dc_xxx /end CHARACTERISTIC
/begin CHARACTERISTIC Cxx_obd_us_typ_actr_rly_scg "" VALUE 0xa002ae3f _REC_S1VAL_20_u1 255. _CNV_A_R_A_105_CM 0. 255. DISPLAY_IDENTIFIER fm_cal_actr_rly_scg.Cxx_obd_us_typ_xxx /end CHARACTERISTIC
/begin CHARACTERISTIC Cxx_dtc_obd_actr_rly_scw "" VALUE 0xa002ae46 _REC_S1VAL_20_u2 65535. _CNV_A_R_A_105_CM 0. 65535. DISPLAY_IDENTIFIER fm_cal_actr_rly_scw.Cxx_dtc_obd_xxx /end CHARACTERISTIC
/begin CHARACTERISTIC Cxx_conf_wal_actr_rly_scw "" VALUE 0xa002ae48 _REC_S1VAL_20_u1 3. _CNV_A_R_A_105_CM 0. 3. DISPLAY_IDENTIFIER fm_cal_actr_rly_scw.fm_static_bitfield.Cxx_conf_wal_xxx BIT_MASK 0x3 /end CHARACTERISTIC
/begin CHARACTERISTIC Cbx_obd_actr_rly_scw "" VALUE 0xa002ae48 _REC_S1VAL_20_u1 255. _CNV_A_R_A_105_CM 0. 255. DISPLAY_IDENTIFIER fm_cal_actr_rly_scw.fm_static_bitfield.Cbx_obd_xxx BIT_MASK 0x4 /end CHARACTERISTIC
/begin CHARACTERISTIC Cbx_obd_mena_actr_rly_scw "" VALUE 0xa002ae48 _REC_S1VAL_20_u1 255. _CNV_A_R_A_105_CM 0. 255. DISPLAY_IDENTIFIER fm_cal_actr_rly_scw.fm_static_bitfield.Cbx_obd_mena_xxx BIT_MASK 0x8 /end CHARACTERISTIC
/begin CHARACTERISTIC Cxx_dtc_lb_actr_rly_scw "" VALUE 0xa002ae49 _REC_S1VAL_20_u1 255. _CNV_A_R_A_105_CM 0. 255. DISPLAY_IDENTIFIER fm_cal_actr_rly_scw.Cxx_dtc_lb_xxx /end CHARACTERISTIC
/begin CHARACTERISTIC Cxx_obd_dc_actr_rly_scw "" VALUE 0xa002ae4a _REC_S1VAL_20_u1 9. _CNV_A_R_A_105_CM 1. 10. DISPLAY_IDENTIFIER fm_cal_actr_rly_scw.Cxx_obd_dc_xxx /end CHARACTERISTIC
/begin CHARACTERISTIC Cxx_obd_us_typ_actr_rly_scw "" VALUE 0xa002ae4b _REC_S1VAL_20_u1 255. _CNV_A_R_A_105_CM 0. 255. DISPLAY_IDENTIFIER fm_cal_actr_rly_scw.Cxx_obd_us_typ_xxx /end CHARACTERISTIC
/begin CHARACTERISTIC Cxx_dtc_obd_agb_data_chr "" VALUE 0xa002ae52 _REC_S1VAL_20_u2 65535. _CNV_A_R_A_105_CM 0. 65535. DISPLAY_IDENTIFIER fm_cal_agb_data_chr.Cxx_dtc_obd_xxx /end CHARACTERISTIC
/begin CHARACTERISTIC Cxx_conf_wal_agb_data_chr "" VALUE 0xa002ae54 _REC_S1VAL_20_u1 3. _CNV_A_R_A_105_CM 0. 3. DISPLAY_IDENTIFIER fm_cal_agb_data_chr.fm_static_bitfield.Cxx_conf_wal_xxx BIT_MASK 0x3 /end CHARACTERISTIC
/begin CHARACTERISTIC Cbx_obd_agb_data_chr "" VALUE 0xa002ae54 _REC_S1VAL_20_u1 255. _CNV_A_R_A_105_CM 0. 255. DISPLAY_IDENTIFIER fm_cal_agb_data_chr.fm_static_bitfield.Cbx_obd_xxx BIT_MASK 0x4 /end CHARACTERISTIC
/begin CHARACTERISTIC Cbx_obd_mena_agb_data_chr "" VALUE 0xa002ae54 _REC_S1VAL_20_u1 255. _CNV_A_R_A_105_CM 0. 255. DISPLAY_IDENTIFIER fm_cal_agb_data_chr.fm_static_bitfield.Cbx_obd_mena_xxx BIT_MASK 0x8 /end CHARACTERISTIC
/begin CHARACTERISTIC Cxx_dtc_lb_agb_data_chr "" VALUE 0xa002ae55 _REC_S1VAL_20_u1 255. _CNV_A_R_A_105_CM 0. 255. DISPLAY_IDENTIFIER fm_cal_agb_data_chr.Cxx_dtc_lb_xxx /end CHARACTERISTIC
/begin CHARACTERISTIC Cxx_obd_dc_agb_data_chr "" VALUE 0xa002ae56 _REC_S1VAL_20_u1 9. _CNV_A_R_A_105_CM 1. 10. DISPLAY_IDENTIFIER fm_cal_agb_data_chr.Cxx_obd_dc_xxx /end CHARACTERISTIC
/begin CHARACTERISTIC Cxx_obd_us_typ_agb_data_chr "" VALUE 0xa002ae57 _REC_S1VAL_20_u1 255. _CNV_A_R_A_105_CM 0. 255. DISPLAY_IDENTIFIER fm_cal_agb_data_chr.Cxx_obd_us_typ_xxx /end CHARACTERISTIC
/begin CHARACTERISTIC Cxx_dtc_obd_agb_data_seq_ctr "" VALUE 0xa002ae5e _REC_S1VAL_20_u2 65535. _CNV_A_R_A_105_CM 0. 65535. DISPLAY_IDENTIFIER fm_cal_agb_data_seq_ctr.Cxx_dtc_obd_xxx /end CHARACTERISTIC
/begin CHARACTERISTIC Cxx_conf_wal_agb_data_seq_ctr "" VALUE 0xa002ae60 _REC_S1VAL_20_u1 3. _CNV_A_R_A_105_CM 0. 3. DISPLAY_IDENTIFIER fm_cal_agb_data_seq_ctr.fm_static_bitfield.Cxx_conf_wal_xxx BIT_MASK 0x3 /end CHARACTERISTIC
/begin CHARACTERISTIC Cbx_obd_agb_data_seq_ctr "" VALUE 0xa002ae60 _REC_S1VAL_20_u1 255. _CNV_A_R_A_105_CM 0. 255. DISPLAY_IDENTIFIER fm_cal_agb_data_seq_ctr.fm_static_bitfield.Cbx_obd_xxx BIT_MASK 0x4 /end CHARACTERISTIC
/begin CHARACTERISTIC Cbx_obd_mena_agb_data_seq_ctr "" VALUE 0xa002ae60 _REC_S1VAL_20_u1 255. _CNV_A_R_A_105_CM 0. 255. DISPLAY_IDENTIFIER fm_cal_agb_data_seq_ctr.fm_static_bitfield.Cbx_obd_mena_xxx BIT_MASK 0x8 /end CHARACTERISTIC
/begin CHARACTERISTIC Cxx_dtc_lb_agb_data_seq_ctr "" VALUE 0xa002ae61 _REC_S1VAL_20_u1 255. _CNV_A_R_A_105_CM 0. 255. DISPLAY_IDENTIFIER fm_cal_agb_data_seq_ctr.Cxx_dtc_lb_xxx /end CHARACTERISTIC
/begin CHARACTERISTIC Cxx_obd_dc_agb_data_seq_ctr "" VALUE 0xa002ae62 _REC_S1VAL_20_u1 9. _CNV_A_R_A_105_CM 1. 10. DISPLAY_IDENTIFIER fm_cal_agb_data_seq_ctr.Cxx_obd_dc_xxx /end CHARACTERISTIC
/begin CHARACTERISTIC Cxx_obd_us_typ_agb_data_seq_ctr "" VALUE 0xa002ae63 _REC_S1VAL_20_u1 255. _CNV_A_R_A_105_CM 0. 255. DISPLAY_IDENTIFIER fm_cal_agb_data_seq_ctr.Cxx_obd_us_typ_xxx /end CHARACTERISTIC
/begin CHARACTERISTIC Cxx_dtc_obd_agb_data_tout "" VALUE 0xa002ae6a _REC_S1VAL_20_u2 65535. _CNV_A_R_A_105_CM 0. 65535. DISPLAY_IDENTIFIER fm_cal_agb_data_tout.Cxx_dtc_obd_xxx /end CHARACTERISTIC
/begin CHARACTERISTIC Cxx_conf_wal_agb_data_tout "" VALUE 0xa002ae6c _REC_S1VAL_20_u1 3. _CNV_A_R_A_105_CM 0. 3. DISPLAY_IDENTIFIER fm_cal_agb_data_tout.fm_static_bitfield.Cxx_conf_wal_xxx BIT_MASK 0x3 /end CHARACTERISTIC
/begin CHARACTERISTIC Cbx_obd_agb_data_tout "" VALUE 0xa002ae6c _REC_S1VAL_20_u1 255. _CNV_A_R_A_105_CM 0. 255. DISPLAY_IDENTIFIER fm_cal_agb_data_tout.fm_static_bitfield.Cbx_obd_xxx BIT_MASK 0x4 /end CHARACTERISTIC
/begin CHARACTERISTIC Cbx_obd_mena_agb_data_tout "" VALUE 0xa002ae6c _REC_S1VAL_20_u1 255. _CNV_A_R_A_105_CM 0. 255. DISPLAY_IDENTIFIER fm_cal_agb_data_tout.fm_static_bitfield.Cbx_obd_mena_xxx BIT_MASK 0x8 /end CHARACTERISTIC
/begin CHARACTERISTIC Cxx_dtc_lb_agb_data_tout "" VALUE 0xa002ae6d _REC_S1VAL_20_u1 255. _CNV_A_R_A_105_CM 0. 255. DISPLAY_IDENTIFIER fm_cal_agb_data_tout.Cxx_dtc_lb_xxx /end CHARACTERISTIC
/begin CHARACTERISTIC Cxx_obd_dc_agb_data_tout "" VALUE 0xa002ae6e _REC_S1VAL_20_u1 9. _CNV_A_R_A_105_CM 1. 10. DISPLAY_IDENTIFIER fm_cal_agb_data_tout.Cxx_obd_dc_xxx /end CHARACTERISTIC
/begin CHARACTERISTIC Cxx_obd_us_typ_agb_data_tout "" VALUE 0xa002ae6f _REC_S1VAL_20_u1 255. _CNV_A_R_A_105_CM 0. 255. DISPLAY_IDENTIFIER fm_cal_agb_data_tout.Cxx_obd_us_typ_xxx /end CHARACTERISTIC
/begin CHARACTERISTIC Cxx_dtc_obd_agb_no_frm "" VALUE 0xa002ae76 _REC_S1VAL_20_u2 65535. _CNV_A_R_A_105_CM 0. 65535. DISPLAY_IDENTIFIER fm_cal_agb_no_frm.Cxx_dtc_obd_xxx /end CHARACTERISTIC
/begin CHARACTERISTIC Cxx_conf_wal_agb_no_frm "" VALUE 0xa002ae78 _REC_S1VAL_20_u1 3. _CNV_A_R_A_105_CM 0. 3. DISPLAY_IDENTIFIER fm_cal_agb_no_frm.fm_static_bitfield.Cxx_conf_wal_xxx BIT_MASK 0x3 /end CHARACTERISTIC
/begin CHARACTERISTIC Cbx_obd_agb_no_frm "" VALUE 0xa002ae78 _REC_S1VAL_20_u1 255. _CNV_A_R_A_105_CM 0. 255. DISPLAY_IDENTIFIER fm_cal_agb_no_frm.fm_static_bitfield.Cbx_obd_xxx BIT_MASK 0x4 /end CHARACTERISTIC
/begin CHARACTERISTIC Cbx_obd_mena_agb_no_frm "" VALUE 0xa002ae78 _REC_S1VAL_20_u1 255. _CNV_A_R_A_105_CM 0. 255. DISPLAY_IDENTIFIER fm_cal_agb_no_frm.fm_static_bitfield.Cbx_obd_mena_xxx BIT_MASK 0x8 /end CHARACTERISTIC
/begin CHARACTERISTIC Cxx_dtc_lb_agb_no_frm "" VALUE 0xa002ae79 _REC_S1VAL_20_u1 255. _CNV_A_R_A_105_CM 0. 255. DISPLAY_IDENTIFIER fm_cal_agb_no_frm.Cxx_dtc_lb_xxx /end CHARACTERISTIC
/begin CHARACTERISTIC Cxx_obd_dc_agb_no_frm "" VALUE 0xa002ae7a _REC_S1VAL_20_u1 9. _CNV_A_R_A_105_CM 1. 10. DISPLAY_IDENTIFIER fm_cal_agb_no_frm.Cxx_obd_dc_xxx /end CHARACTERISTIC
/begin CHARACTERISTIC Cxx_obd_us_typ_agb_no_frm "" VALUE 0xa002ae7b _REC_S1VAL_20_u1 255. _CNV_A_R_A_105_CM 0. 255. DISPLAY_IDENTIFIER fm_cal_agb_no_frm.Cxx_obd_us_typ_xxx /end CHARACTERISTIC
/begin CHARACTERISTIC Cxx_conf_wal_bgin_clu_cmp "" VALUE 0xa002b19c _REC_S1VAL_20_u1 3. _CNV_A_R_A_105_CM 0. 3. DISPLAY_IDENTIFIER fm_cal_bgin_clu_cmp.fm_static_bitfield.Cxx_conf_wal_xxx BIT_MASK 0x3 /end CHARACTERISTIC
/begin CHARACTERISTIC Cxx_dtc_lb_bgin_clu_cmp "" VALUE 0xa002b19d _REC_S1VAL_20_u1 255. _CNV_A_R_A_105_CM 0. 255. DISPLAY_IDENTIFIER fm_cal_bgin_clu_cmp.Cxx_dtc_lb_xxx /end CHARACTERISTIC
/begin CHARACTERISTIC Cxx_obd_us_typ_bgin_clu_cmp "" VALUE 0xa002b19f _REC_S1VAL_20_u1 255. _CNV_A_R_A_105_CM 0. 255. DISPLAY_IDENTIFIER fm_cal_bgin_clu_cmp.Cxx_obd_us_typ_xxx /end CHARACTERISTIC
/begin CHARACTERISTIC Cxx_conf_wal_bgin_clu_nok "" VALUE 0xa002b1a8 _REC_S1VAL_20_u1 3. _CNV_A_R_A_105_CM 0. 3. DISPLAY_IDENTIFIER fm_cal_bgin_clu_nok.fm_static_bitfield.Cxx_conf_wal_xxx BIT_MASK 0x3 /end CHARACTERISTIC
/begin CHARACTERISTIC Cxx_dtc_lb_bgin_clu_nok "" VALUE 0xa002b1a9 _REC_S1VAL_20_u1 255. _CNV_A_R_A_105_CM 0. 255. DISPLAY_IDENTIFIER fm_cal_bgin_clu_nok.Cxx_dtc_lb_xxx /end CHARACTERISTIC
/begin CHARACTERISTIC Cxx_obd_us_typ_bgin_clu_nok "" VALUE 0xa002b1ab _REC_S1VAL_20_u1 255. _CNV_A_R_A_105_CM 0. 255. DISPLAY_IDENTIFIER fm_cal_bgin_clu_nok.Cxx_obd_us_typ_xxx /end CHARACTERISTIC
/begin CHARACTERISTIC Cxx_conf_wal_brk_pdl_cmp "" VALUE 0xa002b1b4 _REC_S1VAL_20_u1 3. _CNV_A_R_A_105_CM 0. 3. DISPLAY_IDENTIFIER fm_cal_brk_pdl_cmp.fm_static_bitfield.Cxx_conf_wal_xxx BIT_MASK 0x3 /end CHARACTERISTIC
/begin CHARACTERISTIC Cxx_dtc_lb_brk_pdl_cmp "" VALUE 0xa002b1b5 _REC_S1VAL_20_u1 255. _CNV_A_R_A_105_CM 0. 255. DISPLAY_IDENTIFIER fm_cal_brk_pdl_cmp.Cxx_dtc_lb_xxx /end CHARACTERISTIC
/begin CHARACTERISTIC Cxx_obd_us_typ_brk_pdl_cmp "" VALUE 0xa002b1b7 _REC_S1VAL_20_u1 255. _CNV_A_R_A_105_CM 0. 255. DISPLAY_IDENTIFIER fm_cal_brk_pdl_cmp.Cxx_obd_us_typ_xxx /end CHARACTERISTIC
/begin CHARACTERISTIC Cxx_dtc_obd_cata_cpt "" VALUE 0xa002b1be _REC_S1VAL_20_u2 65535. _CNV_A_R_A_105_CM 0. 65535. DISPLAY_IDENTIFIER fm_cal_cata_cpt.Cxx_dtc_obd_xxx /end CHARACTERISTIC
/begin CHARACTERISTIC Cxx_conf_wal_cata_cpt "" VALUE 0xa002b1c0 _REC_S1VAL_20_u1 3. _CNV_A_R_A_105_CM 0. 3. DISPLAY_IDENTIFIER fm_cal_cata_cpt.fm_static_bitfield.Cxx_conf_wal_xxx BIT_MASK 0x3 /end CHARACTERISTIC
/begin CHARACTERISTIC Cbx_obd_cata_cpt "" VALUE 0xa002b1c0 _REC_S1VAL_20_u1 255. _CNV_A_R_A_105_CM 0. 255. DISPLAY_IDENTIFIER fm_cal_cata_cpt.fm_static_bitfield.Cbx_obd_xxx BIT_MASK 0x4 /end CHARACTERISTIC
/begin CHARACTERISTIC Cbx_obd_mena_cata_cpt "" VALUE 0xa002b1c0 _REC_S1VAL_20_u1 255. _CNV_A_R_A_105_CM 0. 255. DISPLAY_IDENTIFIER fm_cal_cata_cpt.fm_static_bitfield.Cbx_obd_mena_xxx BIT_MASK 0x8 /end CHARACTERISTIC
/begin CHARACTERISTIC Cxx_dtc_lb_cata_cpt "" VALUE 0xa002b1c1 _REC_S1VAL_20_u1 255. _CNV_A_R_A_105_CM 0. 255. DISPLAY_IDENTIFIER fm_cal_cata_cpt.Cxx_dtc_lb_xxx /end CHARACTERISTIC
/begin CHARACTERISTIC Cxx_obd_dc_cata_cpt "" VALUE 0xa002b1c2 _REC_S1VAL_20_u1 9. _CNV_A_R_A_105_CM 1. 10. DISPLAY_IDENTIFIER fm_cal_cata_cpt.Cxx_obd_dc_xxx /end CHARACTERISTIC
/begin CHARACTERISTIC Cxx_obd_us_typ_cata_cpt "" VALUE 0xa002b1c3 _REC_S1VAL_20_u1 255. _CNV_A_R_A_105_CM 0. 255. DISPLAY_IDENTIFIER fm_cal_cata_cpt.Cxx_obd_us_typ_xxx /end CHARACTERISTIC
/begin CHARACTERISTIC Cxx_dtc_obd_cl_rich_chr "" VALUE 0xa002b536 _REC_S1VAL_20_u2 65535. _CNV_A_R_A_105_CM 0. 65535. DISPLAY_IDENTIFIER fm_cal_cl_rich_chr.Cxx_dtc_obd_xxx /end CHARACTERISTIC
/begin CHARACTERISTIC Cxx_conf_wal_cl_rich_chr "" VALUE 0xa002b538 _REC_S1VAL_20_u1 3. _CNV_A_R_A_105_CM 0. 3. DISPLAY_IDENTIFIER fm_cal_cl_rich_chr.fm_static_bitfield.Cxx_conf_wal_xxx BIT_MASK 0x3 /end CHARACTERISTIC
/begin CHARACTERISTIC Cbx_obd_cl_rich_chr "" VALUE 0xa002b538 _REC_S1VAL_20_u1 255. _CNV_A_R_A_105_CM 0. 255. DISPLAY_IDENTIFIER fm_cal_cl_rich_chr.fm_static_bitfield.Cbx_obd_xxx BIT_MASK 0x4 /end CHARACTERISTIC
/begin CHARACTERISTIC Cbx_obd_mena_cl_rich_chr "" VALUE 0xa002b538 _REC_S1VAL_20_u1 255. _CNV_A_R_A_105_CM 0. 255. DISPLAY_IDENTIFIER fm_cal_cl_rich_chr.fm_static_bitfield.Cbx_obd_mena_xxx BIT_MASK 0x8 /end CHARACTERISTIC
/begin CHARACTERISTIC Cxx_dtc_lb_cl_rich_chr "" VALUE 0xa002b539 _REC_S1VAL_20_u1 255. _CNV_A_R_A_105_CM 0. 255. DISPLAY_IDENTIFIER fm_cal_cl_rich_chr.Cxx_dtc_lb_xxx /end CHARACTERISTIC
/begin CHARACTERISTIC Cxx_obd_dc_cl_rich_chr "" VALUE 0xa002b53a _REC_S1VAL_20_u1 9. _CNV_A_R_A_105_CM 1. 10. DISPLAY_IDENTIFIER fm_cal_cl_rich_chr.Cxx_obd_dc_xxx /end CHARACTERISTIC
/begin CHARACTERISTIC Cxx_obd_us_typ_cl_rich_chr "" VALUE 0xa002b53b _REC_S1VAL_20_u1 255. _CNV_A_R_A_105_CM 0. 255. DISPLAY_IDENTIFIER fm_cal_cl_rich_chr.Cxx_obd_us_typ_xxx /end CHARACTERISTIC
/begin CHARACTERISTIC Cxx_conf_wal_clu_cnt_nok "" VALUE 0xa002ae84 _REC_S1VAL_20_u1 3. _CNV_A_R_A_105_CM 0. 3. DISPLAY_IDENTIFIER fm_cal_clu_cnt_nok.fm_static_bitfield.Cxx_conf_wal_xxx BIT_MASK 0x3 /end CHARACTERISTIC
/begin CHARACTERISTIC Cxx_dtc_lb_clu_cnt_nok "" VALUE 0xa002ae85 _REC_S1VAL_20_u1 255. _CNV_A_R_A_105_CM 0. 255. DISPLAY_IDENTIFIER fm_cal_clu_cnt_nok.Cxx_dtc_lb_xxx /end CHARACTERISTIC
/begin CHARACTERISTIC Cxx_obd_us_typ_clu_cnt_nok "" VALUE 0xa002ae87 _REC_S1VAL_20_u1 255. _CNV_A_R_A_105_CM 0. 255. DISPLAY_IDENTIFIER fm_cal_clu_cnt_nok.Cxx_obd_us_typ_xxx /end CHARACTERISTIC
/begin CHARACTERISTIC Cxx_dtc_obd_cp_blk_open "" VALUE 0xa002b5ae _REC_S1VAL_20_u2 65535. _CNV_A_R_A_105_CM 0. 65535. DISPLAY_IDENTIFIER fm_cal_cp_blk_open.Cxx_dtc_obd_xxx /end CHARACTERISTIC
/begin CHARACTERISTIC Cxx_conf_wal_cp_blk_open "" VALUE 0xa002b5b0 _REC_S1VAL_20_u1 3. _CNV_A_R_A_105_CM 0. 3. DISPLAY_IDENTIFIER fm_cal_cp_blk_open.fm_static_bitfield.Cxx_conf_wal_xxx BIT_MASK 0x3 /end CHARACTERISTIC
/begin CHARACTERISTIC Cbx_obd_cp_blk_open "" VALUE 0xa002b5b0 _REC_S1VAL_20_u1 255. _CNV_A_R_A_105_CM 0. 255. DISPLAY_IDENTIFIER fm_cal_cp_blk_open.fm_static_bitfield.Cbx_obd_xxx BIT_MASK 0x4 /end CHARACTERISTIC
/begin CHARACTERISTIC Cbx_obd_mena_cp_blk_open "" VALUE 0xa002b5b0 _REC_S1VAL_20_u1 255. _CNV_A_R_A_105_CM 0. 255. DISPLAY_IDENTIFIER fm_cal_cp_blk_open.fm_static_bitfield.Cbx_obd_mena_xxx BIT_MASK 0x8 /end CHARACTERISTIC
/begin CHARACTERISTIC Cxx_dtc_lb_cp_blk_open "" VALUE 0xa002b5b1 _REC_S1VAL_20_u1 255. _CNV_A_R_A_105_CM 0. 255. DISPLAY_IDENTIFIER fm_cal_cp_blk_open.Cxx_dtc_lb_xxx /end CHARACTERISTIC
/begin CHARACTERISTIC Cxx_obd_dc_cp_blk_open "" VALUE 0xa002b5b2 _REC_S1VAL_20_u1 9. _CNV_A_R_A_105_CM 1. 10. DISPLAY_IDENTIFIER fm_cal_cp_blk_open.Cxx_obd_dc_xxx /end CHARACTERISTIC
/begin CHARACTERISTIC Cxx_obd_us_typ_cp_blk_open "" VALUE 0xa002b5b3 _REC_S1VAL_20_u1 255. _CNV_A_R_A_105_CM 0. 255. DISPLAY_IDENTIFIER fm_cal_cp_blk_open.Cxx_obd_us_typ_xxx /end CHARACTERISTIC
/begin CHARACTERISTIC Cxx_dtc_obd_cp_oc "" VALUE 0xa002b15e _REC_S1VAL_20_u2 65535. _CNV_A_R_A_105_CM 0. 65535. DISPLAY_IDENTIFIER fm_cal_cp_oc.Cxx_dtc_obd_xxx /end CHARACTERISTIC
/begin CHARACTERISTIC Cxx_conf_wal_cp_oc "" VALUE 0xa002b160 _REC_S1VAL_20_u1 3. _CNV_A_R_A_105_CM 0. 3. DISPLAY_IDENTIFIER fm_cal_cp_oc.fm_static_bitfield.Cxx_conf_wal_xxx BIT_MASK 0x3 /end CHARACTERISTIC
/begin CHARACTERISTIC Cbx_obd_cp_oc "" VALUE 0xa002b160 _REC_S1VAL_20_u1 255. _CNV_A_R_A_105_CM 0. 255. DISPLAY_IDENTIFIER fm_cal_cp_oc.fm_static_bitfield.Cbx_obd_xxx BIT_MASK 0x4 /end CHARACTERISTIC
/begin CHARACTERISTIC Cbx_obd_mena_cp_oc "" VALUE 0xa002b160 _REC_S1VAL_20_u1 255. _CNV_A_R_A_105_CM 0. 255. DISPLAY_IDENTIFIER fm_cal_cp_oc.fm_static_bitfield.Cbx_obd_mena_xxx BIT_MASK 0x8 /end CHARACTERISTIC
/begin CHARACTERISTIC Cxx_dtc_lb_cp_oc "" VALUE 0xa002b161 _REC_S1VAL_20_u1 255. _CNV_A_R_A_105_CM 0. 255. DISPLAY_IDENTIFIER fm_cal_cp_oc.Cxx_dtc_lb_xxx /end CHARACTERISTIC
/begin CHARACTERISTIC Cxx_obd_dc_cp_oc "" VALUE 0xa002b162 _REC_S1VAL_20_u1 9. _CNV_A_R_A_105_CM 1. 10. DISPLAY_IDENTIFIER fm_cal_cp_oc.Cxx_obd_dc_xxx /end CHARACTERISTIC
/begin CHARACTERISTIC Cxx_obd_us_typ_cp_oc "" VALUE 0xa002b163 _REC_S1VAL_20_u1 255. _CNV_A_R_A_105_CM 0. 255. DISPLAY_IDENTIFIER fm_cal_cp_oc.Cxx_obd_us_typ_xxx /end CHARACTERISTIC
/begin CHARACTERISTIC Cxx_dtc_obd_cp_scg "" VALUE 0xa002b16a _REC_S1VAL_20_u2 65535. _CNV_A_R_A_105_CM 0. 65535. DISPLAY_IDENTIFIER fm_cal_cp_scg.Cxx_dtc_obd_xxx /end CHARACTERISTIC
/begin CHARACTERISTIC Cxx_conf_wal_cp_scg "" VALUE 0xa002b16c _REC_S1VAL_20_u1 3. _CNV_A_R_A_105_CM 0. 3. DISPLAY_IDENTIFIER fm_cal_cp_scg.fm_static_bitfield.Cxx_conf_wal_xxx BIT_MASK 0x3 /end CHARACTERISTIC
/begin CHARACTERISTIC Cbx_obd_cp_scg "" VALUE 0xa002b16c _REC_S1VAL_20_u1 255. _CNV_A_R_A_105_CM 0. 255. DISPLAY_IDENTIFIER fm_cal_cp_scg.fm_static_bitfield.Cbx_obd_xxx BIT_MASK 0x4 /end CHARACTERISTIC
/begin CHARACTERISTIC Cbx_obd_mena_cp_scg "" VALUE 0xa002b16c _REC_S1VAL_20_u1 255. _CNV_A_R_A_105_CM 0. 255. DISPLAY_IDENTIFIER fm_cal_cp_scg.fm_static_bitfield.Cbx_obd_mena_xxx BIT_MASK 0x8 /end CHARACTERISTIC
/begin CHARACTERISTIC Cxx_dtc_lb_cp_scg "" VALUE 0xa002b16d _REC_S1VAL_20_u1 255. _CNV_A_R_A_105_CM 0. 255. DISPLAY_IDENTIFIER fm_cal_cp_scg.Cxx_dtc_lb_xxx /end CHARACTERISTIC
/begin CHARACTERISTIC Cxx_obd_dc_cp_scg "" VALUE 0xa002b16e _REC_S1VAL_20_u1 9. _CNV_A_R_A_105_CM 1. 10. DISPLAY_IDENTIFIER fm_cal_cp_scg.Cxx_obd_dc_xxx /end CHARACTERISTIC
/begin CHARACTERISTIC Cxx_obd_us_typ_cp_scg "" VALUE 0xa002b16f _REC_S1VAL_20_u1 255. _CNV_A_R_A_105_CM 0. 255. DISPLAY_IDENTIFIER fm_cal_cp_scg.Cxx_obd_us_typ_xxx /end CHARACTERISTIC
/begin CHARACTERISTIC Cxx_dtc_obd_cp_scw "" VALUE 0xa002b176 _REC_S1VAL_20_u2 65535. _CNV_A_R_A_105_CM 0. 65535. DISPLAY_IDENTIFIER fm_cal_cp_scw.Cxx_dtc_obd_xxx /end CHARACTERISTIC
/begin CHARACTERISTIC Cxx_conf_wal_cp_scw "" VALUE 0xa002b178 _REC_S1VAL_20_u1 3. _CNV_A_R_A_105_CM 0. 3. DISPLAY_IDENTIFIER fm_cal_cp_scw.fm_static_bitfield.Cxx_conf_wal_xxx BIT_MASK 0x3 /end CHARACTERISTIC
/begin CHARACTERISTIC Cbx_obd_cp_scw "" VALUE 0xa002b178 _REC_S1VAL_20_u1 255. _CNV_A_R_A_105_CM 0. 255. DISPLAY_IDENTIFIER fm_cal_cp_scw.fm_static_bitfield.Cbx_obd_xxx BIT_MASK 0x4 /end CHARACTERISTIC
/begin CHARACTERISTIC Cbx_obd_mena_cp_scw "" VALUE 0xa002b178 _REC_S1VAL_20_u1 255. _CNV_A_R_A_105_CM 0. 255. DISPLAY_IDENTIFIER fm_cal_cp_scw.fm_static_bitfield.Cbx_obd_mena_xxx BIT_MASK 0x8 /end CHARACTERISTIC
/begin CHARACTERISTIC Cxx_dtc_lb_cp_scw "" VALUE 0xa002b179 _REC_S1VAL_20_u1 255. _CNV_A_R_A_105_CM 0. 255. DISPLAY_IDENTIFIER fm_cal_cp_scw.Cxx_dtc_lb_xxx /end CHARACTERISTIC
/begin CHARACTERISTIC Cxx_obd_dc_cp_scw "" VALUE 0xa002b17a _REC_S1VAL_20_u1 9. _CNV_A_R_A_105_CM 1. 10. DISPLAY_IDENTIFIER fm_cal_cp_scw.Cxx_obd_dc_xxx /end CHARACTERISTIC
/begin CHARACTERISTIC Cxx_obd_us_typ_cp_scw "" VALUE 0xa002b17b _REC_S1VAL_20_u1 255. _CNV_A_R_A_105_CM 0. 255. DISPLAY_IDENTIFIER fm_cal_cp_scw.Cxx_obd_us_typ_xxx /end CHARACTERISTIC
/begin CHARACTERISTIC Cxx_dtc_obd_crk_chr "" VALUE 0xa002b422 _REC_S1VAL_20_u2 65535. _CNV_A_R_A_105_CM 0. 65535. DISPLAY_IDENTIFIER fm_cal_crk_chr.Cxx_dtc_obd_xxx /end CHARACTERISTIC
/begin CHARACTERISTIC Cxx_conf_wal_crk_chr "" VALUE 0xa002b424 _REC_S1VAL_20_u1 3. _CNV_A_R_A_105_CM 0. 3. DISPLAY_IDENTIFIER fm_cal_crk_chr.fm_static_bitfield.Cxx_conf_wal_xxx BIT_MASK 0x3 /end CHARACTERISTIC
/begin CHARACTERISTIC Cbx_obd_crk_chr "" VALUE 0xa002b424 _REC_S1VAL_20_u1 255. _CNV_A_R_A_105_CM 0. 255. DISPLAY_IDENTIFIER fm_cal_crk_chr.fm_static_bitfield.Cbx_obd_xxx BIT_MASK 0x4 /end CHARACTERISTIC
/begin CHARACTERISTIC Cbx_obd_mena_crk_chr "" VALUE 0xa002b424 _REC_S1VAL_20_u1 255. _CNV_A_R_A_105_CM 0. 255. DISPLAY_IDENTIFIER fm_cal_crk_chr.fm_static_bitfield.Cbx_obd_mena_xxx BIT_MASK 0x8 /end CHARACTERISTIC
/begin CHARACTERISTIC Cxx_dtc_lb_crk_chr "" VALUE 0xa002b425 _REC_S1VAL_20_u1 255. _CNV_A_R_A_105_CM 0. 255. DISPLAY_IDENTIFIER fm_cal_crk_chr.Cxx_dtc_lb_xxx /end CHARACTERISTIC
/begin CHARACTERISTIC Cxx_obd_dc_crk_chr "" VALUE 0xa002b426 _REC_S1VAL_20_u1 9. _CNV_A_R_A_105_CM 1. 10. DISPLAY_IDENTIFIER fm_cal_crk_chr.Cxx_obd_dc_xxx /end CHARACTERISTIC
/begin CHARACTERISTIC Cxx_obd_us_typ_crk_chr "" VALUE 0xa002b427 _REC_S1VAL_20_u1 255. _CNV_A_R_A_105_CM 0. 255. DISPLAY_IDENTIFIER fm_cal_crk_chr.Cxx_obd_us_typ_xxx /end CHARACTERISTIC
/begin CHARACTERISTIC Cxx_dtc_obd_crk_cmp "" VALUE 0xa002b512 _REC_S1VAL_20_u2 65535. _CNV_A_R_A_105_CM 0. 65535. DISPLAY_IDENTIFIER fm_cal_crk_cmp.Cxx_dtc_obd_xxx /end CHARACTERISTIC
/begin CHARACTERISTIC Cxx_conf_wal_crk_cmp "" VALUE 0xa002b514 _REC_S1VAL_20_u1 3. _CNV_A_R_A_105_CM 0. 3. DISPLAY_IDENTIFIER fm_cal_crk_cmp.fm_static_bitfield.Cxx_conf_wal_xxx BIT_MASK 0x3 /end CHARACTERISTIC
/begin CHARACTERISTIC Cbx_obd_crk_cmp "" VALUE 0xa002b514 _REC_S1VAL_20_u1 255. _CNV_A_R_A_105_CM 0. 255. DISPLAY_IDENTIFIER fm_cal_crk_cmp.fm_static_bitfield.Cbx_obd_xxx BIT_MASK 0x4 /end CHARACTERISTIC
/begin CHARACTERISTIC Cbx_obd_mena_crk_cmp "" VALUE 0xa002b514 _REC_S1VAL_20_u1 255. _CNV_A_R_A_105_CM 0. 255. DISPLAY_IDENTIFIER fm_cal_crk_cmp.fm_static_bitfield.Cbx_obd_mena_xxx BIT_MASK 0x8 /end CHARACTERISTIC
/begin CHARACTERISTIC Cxx_dtc_lb_crk_cmp "" VALUE 0xa002b515 _REC_S1VAL_20_u1 255. _CNV_A_R_A_105_CM 0. 255. DISPLAY_IDENTIFIER fm_cal_crk_cmp.Cxx_dtc_lb_xxx /end CHARACTERISTIC
/begin CHARACTERISTIC Cxx_obd_dc_crk_cmp "" VALUE 0xa002b516 _REC_S1VAL_20_u1 9. _CNV_A_R_A_105_CM 1. 10. DISPLAY_IDENTIFIER fm_cal_crk_cmp.Cxx_obd_dc_xxx /end CHARACTERISTIC
/begin CHARACTERISTIC Cxx_obd_us_typ_crk_cmp "" VALUE 0xa002b517 _REC_S1VAL_20_u1 255. _CNV_A_R_A_105_CM 0. 255. DISPLAY_IDENTIFIER fm_cal_crk_cmp.Cxx_obd_us_typ_xxx /end CHARACTERISTIC
/begin CHARACTERISTIC Cxx_dtc_obd_crk_cyc "" VALUE 0xa002b42e _REC_S1VAL_20_u2 65535. _CNV_A_R_A_105_CM 0. 65535. DISPLAY_IDENTIFIER fm_cal_crk_cyc.Cxx_dtc_obd_xxx /end CHARACTERISTIC
/begin CHARACTERISTIC Cxx_conf_wal_crk_cyc "" VALUE 0xa002b430 _REC_S1VAL_20_u1 3. _CNV_A_R_A_105_CM 0. 3. DISPLAY_IDENTIFIER fm_cal_crk_cyc.fm_static_bitfield.Cxx_conf_wal_xxx BIT_MASK 0x3 /end CHARACTERISTIC
/begin CHARACTERISTIC Cbx_obd_crk_cyc "" VALUE 0xa002b430 _REC_S1VAL_20_u1 255. _CNV_A_R_A_105_CM 0. 255. DISPLAY_IDENTIFIER fm_cal_crk_cyc.fm_static_bitfield.Cbx_obd_xxx BIT_MASK 0x4 /end CHARACTERISTIC
/begin CHARACTERISTIC Cbx_obd_mena_crk_cyc "" VALUE 0xa002b430 _REC_S1VAL_20_u1 255. _CNV_A_R_A_105_CM 0. 255. DISPLAY_IDENTIFIER fm_cal_crk_cyc.fm_static_bitfield.Cbx_obd_mena_xxx BIT_MASK 0x8 /end CHARACTERISTIC
/begin CHARACTERISTIC Cxx_dtc_lb_crk_cyc "" VALUE 0xa002b431 _REC_S1VAL_20_u1 255. _CNV_A_R_A_105_CM 0. 255. DISPLAY_IDENTIFIER fm_cal_crk_cyc.Cxx_dtc_lb_xxx /end CHARACTERISTIC
/begin CHARACTERISTIC Cxx_obd_dc_crk_cyc "" VALUE 0xa002b432 _REC_S1VAL_20_u1 9. _CNV_A_R_A_105_CM 1. 10. DISPLAY_IDENTIFIER fm_cal_crk_cyc.Cxx_obd_dc_xxx /end CHARACTERISTIC
/begin CHARACTERISTIC Cxx_obd_us_typ_crk_cyc "" VALUE 0xa002b433 _REC_S1VAL_20_u1 255. _CNV_A_R_A_105_CM 0. 255. DISPLAY_IDENTIFIER fm_cal_crk_cyc.Cxx_obd_us_typ_xxx /end CHARACTERISTIC
/begin CHARACTERISTIC Cxx_dtc_obd_crk_no_sig "" VALUE 0xa002b49a _REC_S1VAL_20_u2 65535. _CNV_A_R_A_105_CM 0. 65535. DISPLAY_IDENTIFIER fm_cal_crk_no_sig.Cxx_dtc_obd_xxx /end CHARACTERISTIC
/begin CHARACTERISTIC Cxx_conf_wal_crk_no_sig "" VALUE 0xa002b49c _REC_S1VAL_20_u1 3. _CNV_A_R_A_105_CM 0. 3. DISPLAY_IDENTIFIER fm_cal_crk_no_sig.fm_static_bitfield.Cxx_conf_wal_xxx BIT_MASK 0x3 /end CHARACTERISTIC
/begin CHARACTERISTIC Cbx_obd_crk_no_sig "" VALUE 0xa002b49c _REC_S1VAL_20_u1 255. _CNV_A_R_A_105_CM 0. 255. DISPLAY_IDENTIFIER fm_cal_crk_no_sig.fm_static_bitfield.Cbx_obd_xxx BIT_MASK 0x4 /end CHARACTERISTIC
/begin CHARACTERISTIC Cbx_obd_mena_crk_no_sig "" VALUE 0xa002b49c _REC_S1VAL_20_u1 255. _CNV_A_R_A_105_CM 0. 255. DISPLAY_IDENTIFIER fm_cal_crk_no_sig.fm_static_bitfield.Cbx_obd_mena_xxx BIT_MASK 0x8 /end CHARACTERISTIC
/begin CHARACTERISTIC Cxx_dtc_lb_crk_no_sig "" VALUE 0xa002b49d _REC_S1VAL_20_u1 255. _CNV_A_R_A_105_CM 0. 255. DISPLAY_IDENTIFIER fm_cal_crk_no_sig.Cxx_dtc_lb_xxx /end CHARACTERISTIC
/begin CHARACTERISTIC Cxx_obd_dc_crk_no_sig "" VALUE 0xa002b49e _REC_S1VAL_20_u1 9. _CNV_A_R_A_105_CM 1. 10. DISPLAY_IDENTIFIER fm_cal_crk_no_sig.Cxx_obd_dc_xxx /end CHARACTERISTIC
/begin CHARACTERISTIC Cxx_obd_us_typ_crk_no_sig "" VALUE 0xa002b49f _REC_S1VAL_20_u1 255. _CNV_A_R_A_105_CM 0. 255. DISPLAY_IDENTIFIER fm_cal_crk_no_sig.Cxx_obd_us_typ_xxx /end CHARACTERISTIC
/begin CHARACTERISTIC Cxx_dtc_obd_crk_oc "" VALUE 0xa002b52a _REC_S1VAL_20_u2 65535. _CNV_A_R_A_105_CM 0. 65535. DISPLAY_IDENTIFIER fm_cal_crk_oc.Cxx_dtc_obd_xxx /end CHARACTERISTIC
/begin CHARACTERISTIC Cxx_conf_wal_crk_oc "" VALUE 0xa002b52c _REC_S1VAL_20_u1 3. _CNV_A_R_A_105_CM 0. 3. DISPLAY_IDENTIFIER fm_cal_crk_oc.fm_static_bitfield.Cxx_conf_wal_xxx BIT_MASK 0x3 /end CHARACTERISTIC
/begin CHARACTERISTIC Cbx_obd_crk_oc "" VALUE 0xa002b52c _REC_S1VAL_20_u1 255. _CNV_A_R_A_105_CM 0. 255. DISPLAY_IDENTIFIER fm_cal_crk_oc.fm_static_bitfield.Cbx_obd_xxx BIT_MASK 0x4 /end CHARACTERISTIC
/begin CHARACTERISTIC Cbx_obd_mena_crk_oc "" VALUE 0xa002b52c _REC_S1VAL_20_u1 255. _CNV_A_R_A_105_CM 0. 255. DISPLAY_IDENTIFIER fm_cal_crk_oc.fm_static_bitfield.Cbx_obd_mena_xxx BIT_MASK 0x8 /end CHARACTERISTIC
/begin CHARACTERISTIC Cxx_dtc_lb_crk_oc "" VALUE 0xa002b52d _REC_S1VAL_20_u1 255. _CNV_A_R_A_105_CM 0. 255. DISPLAY_IDENTIFIER fm_cal_crk_oc.Cxx_dtc_lb_xxx /end CHARACTERISTIC
/begin CHARACTERISTIC Cxx_obd_dc_crk_oc "" VALUE 0xa002b52e _REC_S1VAL_20_u1 9. _CNV_A_R_A_105_CM 1. 10. DISPLAY_IDENTIFIER fm_cal_crk_oc.Cxx_obd_dc_xxx /end CHARACTERISTIC
/begin CHARACTERISTIC Cxx_obd_us_typ_crk_oc "" VALUE 0xa002b52f _REC_S1VAL_20_u1 255. _CNV_A_R_A_105_CM 0. 255. DISPLAY_IDENTIFIER fm_cal_crk_oc.Cxx_obd_us_typ_xxx /end CHARACTERISTIC
/begin CHARACTERISTIC Cxx_dtc_obd_crk_shp "" VALUE 0xa002b51e _REC_S1VAL_20_u2 65535. _CNV_A_R_A_105_CM 0. 65535. DISPLAY_IDENTIFIER fm_cal_crk_shp.Cxx_dtc_obd_xxx /end CHARACTERISTIC
/begin CHARACTERISTIC Cxx_conf_wal_crk_shp "" VALUE 0xa002b520 _REC_S1VAL_20_u1 3. _CNV_A_R_A_105_CM 0. 3. DISPLAY_IDENTIFIER fm_cal_crk_shp.fm_static_bitfield.Cxx_conf_wal_xxx BIT_MASK 0x3 /end CHARACTERISTIC
/begin CHARACTERISTIC Cbx_obd_crk_shp "" VALUE 0xa002b520 _REC_S1VAL_20_u1 255. _CNV_A_R_A_105_CM 0. 255. DISPLAY_IDENTIFIER fm_cal_crk_shp.fm_static_bitfield.Cbx_obd_xxx BIT_MASK 0x4 /end CHARACTERISTIC
/begin CHARACTERISTIC Cbx_obd_mena_crk_shp "" VALUE 0xa002b520 _REC_S1VAL_20_u1 255. _CNV_A_R_A_105_CM 0. 255. DISPLAY_IDENTIFIER fm_cal_crk_shp.fm_static_bitfield.Cbx_obd_mena_xxx BIT_MASK 0x8 /end CHARACTERISTIC
/begin CHARACTERISTIC Cxx_dtc_lb_crk_shp "" VALUE 0xa002b521 _REC_S1VAL_20_u1 255. _CNV_A_R_A_105_CM 0. 255. DISPLAY_IDENTIFIER fm_cal_crk_shp.Cxx_dtc_lb_xxx /end CHARACTERISTIC
/begin CHARACTERISTIC Cxx_obd_dc_crk_shp "" VALUE 0xa002b522 _REC_S1VAL_20_u1 9. _CNV_A_R_A_105_CM 1. 10. DISPLAY_IDENTIFIER fm_cal_crk_shp.Cxx_obd_dc_xxx /end CHARACTERISTIC
/begin CHARACTERISTIC Cxx_obd_us_typ_crk_shp "" VALUE 0xa002b523 _REC_S1VAL_20_u1 255. _CNV_A_R_A_105_CM 0. 255. DISPLAY_IDENTIFIER fm_cal_crk_shp.Cxx_obd_us_typ_xxx /end CHARACTERISTIC
/begin CHARACTERISTIC Cxx_conf_wal_cru_cmp "" VALUE 0xa002b1cc _REC_S1VAL_20_u1 3. _CNV_A_R_A_105_CM 0. 3. DISPLAY_IDENTIFIER fm_cal_cru_cmp.fm_static_bitfield.Cxx_conf_wal_xxx BIT_MASK 0x3 /end CHARACTERISTIC
/begin CHARACTERISTIC Cxx_dtc_lb_cru_cmp "" VALUE 0xa002b1cd _REC_S1VAL_20_u1 255. _CNV_A_R_A_105_CM 0. 255. DISPLAY_IDENTIFIER fm_cal_cru_cmp.Cxx_dtc_lb_xxx /end CHARACTERISTIC
/begin CHARACTERISTIC Cxx_obd_us_typ_cru_cmp "" VALUE 0xa002b1cf _REC_S1VAL_20_u1 255. _CNV_A_R_A_105_CM 0. 255. DISPLAY_IDENTIFIER fm_cal_cru_cmp.Cxx_obd_us_typ_xxx /end CHARACTERISTIC
/begin CHARACTERISTIC Cxx_conf_wal_cru_sl_swi_chr "" VALUE 0xa002b1d8 _REC_S1VAL_20_u1 3. _CNV_A_R_A_105_CM 0. 3. DISPLAY_IDENTIFIER fm_cal_cru_sl_swi_chr.fm_static_bitfield.Cxx_conf_wal_xxx BIT_MASK 0x3 /end CHARACTERISTIC
/begin CHARACTERISTIC Cxx_dtc_lb_cru_sl_swi_chr "" VALUE 0xa002b1d9 _REC_S1VAL_20_u1 255. _CNV_A_R_A_105_CM 0. 255. DISPLAY_IDENTIFIER fm_cal_cru_sl_swi_chr.Cxx_dtc_lb_xxx /end CHARACTERISTIC
/begin CHARACTERISTIC Cxx_obd_us_typ_cru_sl_swi_chr "" VALUE 0xa002b1db _REC_S1VAL_20_u1 255. _CNV_A_R_A_105_CM 0. 255. DISPLAY_IDENTIFIER fm_cal_cru_sl_swi_chr.Cxx_obd_us_typ_xxx /end CHARACTERISTIC
/begin CHARACTERISTIC Cxx_conf_wal_cru_sl_tot "" VALUE 0xa002b1e4 _REC_S1VAL_20_u1 3. _CNV_A_R_A_105_CM 0. 3. DISPLAY_IDENTIFIER fm_cal_cru_sl_tot.fm_static_bitfield.Cxx_conf_wal_xxx BIT_MASK 0x3 /end CHARACTERISTIC
/begin CHARACTERISTIC Cxx_dtc_lb_cru_sl_tot "" VALUE 0xa002b1e5 _REC_S1VAL_20_u1 255. _CNV_A_R_A_105_CM 0. 255. DISPLAY_IDENTIFIER fm_cal_cru_sl_tot.Cxx_dtc_lb_xxx /end CHARACTERISTIC
/begin CHARACTERISTIC Cxx_obd_us_typ_cru_sl_tot "" VALUE 0xa002b1e7 _REC_S1VAL_20_u1 255. _CNV_A_R_A_105_CM 0. 255. DISPLAY_IDENTIFIER fm_cal_cru_sl_tot.Cxx_obd_us_typ_xxx /end CHARACTERISTIC
/begin CHARACTERISTIC Cxx_conf_wal_cru_vs_cmp "" VALUE 0xa002b1f0 _REC_S1VAL_20_u1 3. _CNV_A_R_A_105_CM 0. 3. DISPLAY_IDENTIFIER fm_cal_cru_vs_cmp.fm_static_bitfield.Cxx_conf_wal_xxx BIT_MASK 0x3 /end CHARACTERISTIC
/begin CHARACTERISTIC Cxx_dtc_lb_cru_vs_cmp "" VALUE 0xa002b1f1 _REC_S1VAL_20_u1 255. _CNV_A_R_A_105_CM 0. 255. DISPLAY_IDENTIFIER fm_cal_cru_vs_cmp.Cxx_dtc_lb_xxx /end CHARACTERISTIC
/begin CHARACTERISTIC Cxx_obd_us_typ_cru_vs_cmp "" VALUE 0xa002b1f3 _REC_S1VAL_20_u1 255. _CNV_A_R_A_105_CM 0. 255. DISPLAY_IDENTIFIER fm_cal_cru_vs_cmp.Cxx_obd_us_typ_xxx /end CHARACTERISTIC
/begin CHARACTERISTIC Cxx_conf_wal_cru_whl_cmd_nok "" VALUE 0xa002b1fc _REC_S1VAL_20_u1 3. _CNV_A_R_A_105_CM 0. 3. DISPLAY_IDENTIFIER fm_cal_cru_whl_cmd_nok.fm_static_bitfield.Cxx_conf_wal_xxx BIT_MASK 0x3 /end CHARACTERISTIC
/begin CHARACTERISTIC Cxx_dtc_lb_cru_whl_cmd_nok "" VALUE 0xa002b1fd _REC_S1VAL_20_u1 255. _CNV_A_R_A_105_CM 0. 255. DISPLAY_IDENTIFIER fm_cal_cru_whl_cmd_nok.Cxx_dtc_lb_xxx /end CHARACTERISTIC
/begin CHARACTERISTIC Cxx_obd_us_typ_cru_whl_cmd_nok "" VALUE 0xa002b1ff _REC_S1VAL_20_u1 255. _CNV_A_R_A_105_CM 0. 255. DISPLAY_IDENTIFIER fm_cal_cru_whl_cmd_nok.Cxx_obd_us_typ_xxx /end CHARACTERISTIC
/begin CHARACTERISTIC Cxx_conf_wal_cru_whl_cmd_oc_scw "" VALUE 0xa002b208 _REC_S1VAL_20_u1 3. _CNV_A_R_A_105_CM 0. 3. DISPLAY_IDENTIFIER fm_cal_cru_whl_cmd_oc_scw.fm_static_bitfield.Cxx_conf_wal_xxx BIT_MASK 0x3 /end CHARACTERISTIC
/begin CHARACTERISTIC Cxx_dtc_lb_cru_whl_cmd_oc_scw "" VALUE 0xa002b209 _REC_S1VAL_20_u1 255. _CNV_A_R_A_105_CM 0. 255. DISPLAY_IDENTIFIER fm_cal_cru_whl_cmd_oc_scw.Cxx_dtc_lb_xxx /end CHARACTERISTIC
/begin CHARACTERISTIC Cxx_obd_us_typ_cru_whl_cmd_oc_scw "" VALUE 0xa002b20b _REC_S1VAL_20_u1 255. _CNV_A_R_A_105_CM 0. 255. DISPLAY_IDENTIFIER fm_cal_cru_whl_cmd_oc_scw.Cxx_obd_us_typ_xxx /end CHARACTERISTIC
/begin CHARACTERISTIC Cxx_conf_wal_cru_whl_cmd_oor "" VALUE 0xa002b214 _REC_S1VAL_20_u1 3. _CNV_A_R_A_105_CM 0. 3. DISPLAY_IDENTIFIER fm_cal_cru_whl_cmd_oor.fm_static_bitfield.Cxx_conf_wal_xxx BIT_MASK 0x3 /end CHARACTERISTIC
/begin CHARACTERISTIC Cxx_dtc_lb_cru_whl_cmd_oor "" VALUE 0xa002b215 _REC_S1VAL_20_u1 255. _CNV_A_R_A_105_CM 0. 255. DISPLAY_IDENTIFIER fm_cal_cru_whl_cmd_oor.Cxx_dtc_lb_xxx /end CHARACTERISTIC
/begin CHARACTERISTIC Cxx_obd_us_typ_cru_whl_cmd_oor "" VALUE 0xa002b217 _REC_S1VAL_20_u1 255. _CNV_A_R_A_105_CM 0. 255. DISPLAY_IDENTIFIER fm_cal_cru_whl_cmd_oor.Cxx_obd_us_typ_xxx /end CHARACTERISTIC
/begin CHARACTERISTIC Cxx_dtc_obd_ecm_adc_tron "" VALUE 0xa002b55a _REC_S1VAL_20_u2 65535. _CNV_A_R_A_105_CM 0. 65535. DISPLAY_IDENTIFIER fm_cal_ecm_adc_tron.Cxx_dtc_obd_xxx /end CHARACTERISTIC
/begin CHARACTERISTIC Cxx_conf_wal_ecm_adc_tron "" VALUE 0xa002b55c _REC_S1VAL_20_u1 3. _CNV_A_R_A_105_CM 0. 3. DISPLAY_IDENTIFIER fm_cal_ecm_adc_tron.fm_static_bitfield.Cxx_conf_wal_xxx BIT_MASK 0x3 /end CHARACTERISTIC
/begin CHARACTERISTIC Cbx_obd_ecm_adc_tron "" VALUE 0xa002b55c _REC_S1VAL_20_u1 255. _CNV_A_R_A_105_CM 0. 255. DISPLAY_IDENTIFIER fm_cal_ecm_adc_tron.fm_static_bitfield.Cbx_obd_xxx BIT_MASK 0x4 /end CHARACTERISTIC
/begin CHARACTERISTIC Cbx_obd_mena_ecm_adc_tron "" VALUE 0xa002b55c _REC_S1VAL_20_u1 255. _CNV_A_R_A_105_CM 0. 255. DISPLAY_IDENTIFIER fm_cal_ecm_adc_tron.fm_static_bitfield.Cbx_obd_mena_xxx BIT_MASK 0x8 /end CHARACTERISTIC
/begin CHARACTERISTIC Cxx_dtc_lb_ecm_adc_tron "" VALUE 0xa002b55d _REC_S1VAL_20_u1 255. _CNV_A_R_A_105_CM 0. 255. DISPLAY_IDENTIFIER fm_cal_ecm_adc_tron.Cxx_dtc_lb_xxx /end CHARACTERISTIC
/begin CHARACTERISTIC Cxx_obd_dc_ecm_adc_tron "" VALUE 0xa002b55e _REC_S1VAL_20_u1 9. _CNV_A_R_A_105_CM 1. 10. DISPLAY_IDENTIFIER fm_cal_ecm_adc_tron.Cxx_obd_dc_xxx /end CHARACTERISTIC
/begin CHARACTERISTIC Cxx_obd_us_typ_ecm_adc_tron "" VALUE 0xa002b55f _REC_S1VAL_20_u1 255. _CNV_A_R_A_105_CM 0. 255. DISPLAY_IDENTIFIER fm_cal_ecm_adc_tron.Cxx_obd_us_typ_xxx /end CHARACTERISTIC
/begin CHARACTERISTIC Cxx_dtc_obd_ecm_err_itl "" VALUE 0xa002b4a6 _REC_S1VAL_20_u2 65535. _CNV_A_R_A_105_CM 0. 65535. DISPLAY_IDENTIFIER fm_cal_ecm_err_itl.Cxx_dtc_obd_xxx /end CHARACTERISTIC
/begin CHARACTERISTIC Cxx_conf_wal_ecm_err_itl "" VALUE 0xa002b4a8 _REC_S1VAL_20_u1 3. _CNV_A_R_A_105_CM 0. 3. DISPLAY_IDENTIFIER fm_cal_ecm_err_itl.fm_static_bitfield.Cxx_conf_wal_xxx BIT_MASK 0x3 /end CHARACTERISTIC
/begin CHARACTERISTIC Cbx_obd_ecm_err_itl "" VALUE 0xa002b4a8 _REC_S1VAL_20_u1 255. _CNV_A_R_A_105_CM 0. 255. DISPLAY_IDENTIFIER fm_cal_ecm_err_itl.fm_static_bitfield.Cbx_obd_xxx BIT_MASK 0x4 /end CHARACTERISTIC
/begin CHARACTERISTIC Cbx_obd_mena_ecm_err_itl "" VALUE 0xa002b4a8 _REC_S1VAL_20_u1 255. _CNV_A_R_A_105_CM 0. 255. DISPLAY_IDENTIFIER fm_cal_ecm_err_itl.fm_static_bitfield.Cbx_obd_mena_xxx BIT_MASK 0x8 /end CHARACTERISTIC
/begin CHARACTERISTIC Cxx_dtc_lb_ecm_err_itl "" VALUE 0xa002b4a9 _REC_S1VAL_20_u1 255. _CNV_A_R_A_105_CM 0. 255. DISPLAY_IDENTIFIER fm_cal_ecm_err_itl.Cxx_dtc_lb_xxx /end CHARACTERISTIC
/begin CHARACTERISTIC Cxx_obd_dc_ecm_err_itl "" VALUE 0xa002b4aa _REC_S1VAL_20_u1 9. _CNV_A_R_A_105_CM 1. 10. DISPLAY_IDENTIFIER fm_cal_ecm_err_itl.Cxx_obd_dc_xxx /end CHARACTERISTIC
/begin CHARACTERISTIC Cxx_obd_us_typ_ecm_err_itl "" VALUE 0xa002b4ab _REC_S1VAL_20_u1 255. _CNV_A_R_A_105_CM 0. 255. DISPLAY_IDENTIFIER fm_cal_ecm_err_itl.Cxx_obd_us_typ_xxx /end CHARACTERISTIC
/begin CHARACTERISTIC Cxx_dtc_obd_ecm_mon_secu_1 "" VALUE 0xa002b542 _REC_S1VAL_20_u2 65535. _CNV_A_R_A_105_CM 0. 65535. DISPLAY_IDENTIFIER fm_cal_ecm_mon_secu_1.Cxx_dtc_obd_xxx /end CHARACTERISTIC
/begin CHARACTERISTIC Cxx_conf_wal_ecm_mon_secu_1 "" VALUE 0xa002b544 _REC_S1VAL_20_u1 3. _CNV_A_R_A_105_CM 0. 3. DISPLAY_IDENTIFIER fm_cal_ecm_mon_secu_1.fm_static_bitfield.Cxx_conf_wal_xxx BIT_MASK 0x3 /end CHARACTERISTIC
/begin CHARACTERISTIC Cbx_obd_ecm_mon_secu_1 "" VALUE 0xa002b544 _REC_S1VAL_20_u1 255. _CNV_A_R_A_105_CM 0. 255. DISPLAY_IDENTIFIER fm_cal_ecm_mon_secu_1.fm_static_bitfield.Cbx_obd_xxx BIT_MASK 0x4 /end CHARACTERISTIC
/begin CHARACTERISTIC Cbx_obd_mena_ecm_mon_secu_1 "" VALUE 0xa002b544 _REC_S1VAL_20_u1 255. _CNV_A_R_A_105_CM 0. 255. DISPLAY_IDENTIFIER fm_cal_ecm_mon_secu_1.fm_static_bitfield.Cbx_obd_mena_xxx BIT_MASK 0x8 /end CHARACTERISTIC
/begin CHARACTERISTIC Cxx_dtc_lb_ecm_mon_secu_1 "" VALUE 0xa002b545 _REC_S1VAL_20_u1 255. _CNV_A_R_A_105_CM 0. 255. DISPLAY_IDENTIFIER fm_cal_ecm_mon_secu_1.Cxx_dtc_lb_xxx /end CHARACTERISTIC
/begin CHARACTERISTIC Cxx_obd_dc_ecm_mon_secu_1 "" VALUE 0xa002b546 _REC_S1VAL_20_u1 9. _CNV_A_R_A_105_CM 1. 10. DISPLAY_IDENTIFIER fm_cal_ecm_mon_secu_1.Cxx_obd_dc_xxx /end CHARACTERISTIC
/begin CHARACTERISTIC Cxx_obd_us_typ_ecm_mon_secu_1 "" VALUE 0xa002b547 _REC_S1VAL_20_u1 255. _CNV_A_R_A_105_CM 0. 255. DISPLAY_IDENTIFIER fm_cal_ecm_mon_secu_1.Cxx_obd_us_typ_xxx /end CHARACTERISTIC
/begin CHARACTERISTIC Cxx_dtc_obd_ecm_mon_secu_2 "" VALUE 0xa002b54e _REC_S1VAL_20_u2 65535. _CNV_A_R_A_105_CM 0. 65535. DISPLAY_IDENTIFIER fm_cal_ecm_mon_secu_2.Cxx_dtc_obd_xxx /end CHARACTERISTIC
/begin CHARACTERISTIC Cxx_conf_wal_ecm_mon_secu_2 "" VALUE 0xa002b550 _REC_S1VAL_20_u1 3. _CNV_A_R_A_105_CM 0. 3. DISPLAY_IDENTIFIER fm_cal_ecm_mon_secu_2.fm_static_bitfield.Cxx_conf_wal_xxx BIT_MASK 0x3 /end CHARACTERISTIC
/begin CHARACTERISTIC Cbx_obd_ecm_mon_secu_2 "" VALUE 0xa002b550 _REC_S1VAL_20_u1 255. _CNV_A_R_A_105_CM 0. 255. DISPLAY_IDENTIFIER fm_cal_ecm_mon_secu_2.fm_static_bitfield.Cbx_obd_xxx BIT_MASK 0x4 /end CHARACTERISTIC
/begin CHARACTERISTIC Cbx_obd_mena_ecm_mon_secu_2 "" VALUE 0xa002b550 _REC_S1VAL_20_u1 255. _CNV_A_R_A_105_CM 0. 255. DISPLAY_IDENTIFIER fm_cal_ecm_mon_secu_2.fm_static_bitfield.Cbx_obd_mena_xxx BIT_MASK 0x8 /end CHARACTERISTIC
/begin CHARACTERISTIC Cxx_dtc_lb_ecm_mon_secu_2 "" VALUE 0xa002b551 _REC_S1VAL_20_u1 255. _CNV_A_R_A_105_CM 0. 255. DISPLAY_IDENTIFIER fm_cal_ecm_mon_secu_2.Cxx_dtc_lb_xxx /end CHARACTERISTIC
/begin CHARACTERISTIC Cxx_obd_dc_ecm_mon_secu_2 "" VALUE 0xa002b552 _REC_S1VAL_20_u1 9. _CNV_A_R_A_105_CM 1. 10. DISPLAY_IDENTIFIER fm_cal_ecm_mon_secu_2.Cxx_obd_dc_xxx /end CHARACTERISTIC
/begin CHARACTERISTIC Cxx_obd_us_typ_ecm_mon_secu_2 "" VALUE 0xa002b553 _REC_S1VAL_20_u1 255. _CNV_A_R_A_105_CM 0. 255. DISPLAY_IDENTIFIER fm_cal_ecm_mon_secu_2.Cxx_obd_us_typ_xxx /end CHARACTERISTIC
/begin CHARACTERISTIC Cxx_dtc_obd_ecm_mon_tron "" VALUE 0xa002b4b2 _REC_S1VAL_20_u2 65535. _CNV_A_R_A_105_CM 0. 65535. DISPLAY_IDENTIFIER fm_cal_ecm_mon_tron.Cxx_dtc_obd_xxx /end CHARACTERISTIC
/begin CHARACTERISTIC Cxx_conf_wal_ecm_mon_tron "" VALUE 0xa002b4b4 _REC_S1VAL_20_u1 3. _CNV_A_R_A_105_CM 0. 3. DISPLAY_IDENTIFIER fm_cal_ecm_mon_tron.fm_static_bitfield.Cxx_conf_wal_xxx BIT_MASK 0x3 /end CHARACTERISTIC
/begin CHARACTERISTIC Cbx_obd_ecm_mon_tron "" VALUE 0xa002b4b4 _REC_S1VAL_20_u1 255. _CNV_A_R_A_105_CM 0. 255. DISPLAY_IDENTIFIER fm_cal_ecm_mon_tron.fm_static_bitfield.Cbx_obd_xxx BIT_MASK 0x4 /end CHARACTERISTIC
/begin CHARACTERISTIC Cbx_obd_mena_ecm_mon_tron "" VALUE 0xa002b4b4 _REC_S1VAL_20_u1 255. _CNV_A_R_A_105_CM 0. 255. DISPLAY_IDENTIFIER fm_cal_ecm_mon_tron.fm_static_bitfield.Cbx_obd_mena_xxx BIT_MASK 0x8 /end CHARACTERISTIC
/begin CHARACTERISTIC Cxx_dtc_lb_ecm_mon_tron "" VALUE 0xa002b4b5 _REC_S1VAL_20_u1 255. _CNV_A_R_A_105_CM 0. 255. DISPLAY_IDENTIFIER fm_cal_ecm_mon_tron.Cxx_dtc_lb_xxx /end CHARACTERISTIC
/begin CHARACTERISTIC Cxx_obd_dc_ecm_mon_tron "" VALUE 0xa002b4b6 _REC_S1VAL_20_u1 9. _CNV_A_R_A_105_CM 1. 10. DISPLAY_IDENTIFIER fm_cal_ecm_mon_tron.Cxx_obd_dc_xxx /end CHARACTERISTIC
/begin CHARACTERISTIC Cxx_obd_us_typ_ecm_mon_tron "" VALUE 0xa002b4b7 _REC_S1VAL_20_u1 255. _CNV_A_R_A_105_CM 0. 255. DISPLAY_IDENTIFIER fm_cal_ecm_mon_tron.Cxx_obd_us_typ_xxx /end CHARACTERISTIC
/begin CHARACTERISTIC Cxx_dtc_obd_efi_sldv_2_oc "" VALUE 0xa002b716 _REC_S1VAL_20_u2 65535. _CNV_A_R_A_105_CM 0. 65535. DISPLAY_IDENTIFIER fm_cal_efi_sldv_2_oc.Cxx_dtc_obd_xxx /end CHARACTERISTIC
/begin CHARACTERISTIC Cxx_conf_wal_efi_sldv_2_oc "" VALUE 0xa002b718 _REC_S1VAL_20_u1 3. _CNV_A_R_A_105_CM 0. 3. DISPLAY_IDENTIFIER fm_cal_efi_sldv_2_oc.fm_static_bitfield.Cxx_conf_wal_xxx BIT_MASK 0x3 /end CHARACTERISTIC
/begin CHARACTERISTIC Cbx_obd_efi_sldv_2_oc "" VALUE 0xa002b718 _REC_S1VAL_20_u1 255. _CNV_A_R_A_105_CM 0. 255. DISPLAY_IDENTIFIER fm_cal_efi_sldv_2_oc.fm_static_bitfield.Cbx_obd_xxx BIT_MASK 0x4 /end CHARACTERISTIC
/begin CHARACTERISTIC Cbx_obd_mena_efi_sldv_2_oc "" VALUE 0xa002b718 _REC_S1VAL_20_u1 255. _CNV_A_R_A_105_CM 0. 255. DISPLAY_IDENTIFIER fm_cal_efi_sldv_2_oc.fm_static_bitfield.Cbx_obd_mena_xxx BIT_MASK 0x8 /end CHARACTERISTIC
/begin CHARACTERISTIC Cxx_dtc_lb_efi_sldv_2_oc "" VALUE 0xa002b719 _REC_S1VAL_20_u1 255. _CNV_A_R_A_105_CM 0. 255. DISPLAY_IDENTIFIER fm_cal_efi_sldv_2_oc.Cxx_dtc_lb_xxx /end CHARACTERISTIC
/begin CHARACTERISTIC Cxx_obd_dc_efi_sldv_2_oc "" VALUE 0xa002b71a _REC_S1VAL_20_u1 9. _CNV_A_R_A_105_CM 1. 10. DISPLAY_IDENTIFIER fm_cal_efi_sldv_2_oc.Cxx_obd_dc_xxx /end CHARACTERISTIC
/begin CHARACTERISTIC Cxx_obd_us_typ_efi_sldv_2_oc "" VALUE 0xa002b71b _REC_S1VAL_20_u1 255. _CNV_A_R_A_105_CM 0. 255. DISPLAY_IDENTIFIER fm_cal_efi_sldv_2_oc.Cxx_obd_us_typ_xxx /end CHARACTERISTIC
/begin CHARACTERISTIC Cxx_dtc_obd_efi_sldv_2_scg "" VALUE 0xa002b722 _REC_S1VAL_20_u2 65535. _CNV_A_R_A_105_CM 0. 65535. DISPLAY_IDENTIFIER fm_cal_efi_sldv_2_scg.Cxx_dtc_obd_xxx /end CHARACTERISTIC
/begin CHARACTERISTIC Cxx_conf_wal_efi_sldv_2_scg "" VALUE 0xa002b724 _REC_S1VAL_20_u1 3. _CNV_A_R_A_105_CM 0. 3. DISPLAY_IDENTIFIER fm_cal_efi_sldv_2_scg.fm_static_bitfield.Cxx_conf_wal_xxx BIT_MASK 0x3 /end CHARACTERISTIC
/begin CHARACTERISTIC Cbx_obd_efi_sldv_2_scg "" VALUE 0xa002b724 _REC_S1VAL_20_u1 255. _CNV_A_R_A_105_CM 0. 255. DISPLAY_IDENTIFIER fm_cal_efi_sldv_2_scg.fm_static_bitfield.Cbx_obd_xxx BIT_MASK 0x4 /end CHARACTERISTIC
/begin CHARACTERISTIC Cbx_obd_mena_efi_sldv_2_scg "" VALUE 0xa002b724 _REC_S1VAL_20_u1 255. _CNV_A_R_A_105_CM 0. 255. DISPLAY_IDENTIFIER fm_cal_efi_sldv_2_scg.fm_static_bitfield.Cbx_obd_mena_xxx BIT_MASK 0x8 /end CHARACTERISTIC
/begin CHARACTERISTIC Cxx_dtc_lb_efi_sldv_2_scg "" VALUE 0xa002b725 _REC_S1VAL_20_u1 255. _CNV_A_R_A_105_CM 0. 255. DISPLAY_IDENTIFIER fm_cal_efi_sldv_2_scg.Cxx_dtc_lb_xxx /end CHARACTERISTIC
/begin CHARACTERISTIC Cxx_obd_dc_efi_sldv_2_scg "" VALUE 0xa002b726 _REC_S1VAL_20_u1 9. _CNV_A_R_A_105_CM 1. 10. DISPLAY_IDENTIFIER fm_cal_efi_sldv_2_scg.Cxx_obd_dc_xxx /end CHARACTERISTIC
/begin CHARACTERISTIC Cxx_obd_us_typ_efi_sldv_2_scg "" VALUE 0xa002b727 _REC_S1VAL_20_u1 255. _CNV_A_R_A_105_CM 0. 255. DISPLAY_IDENTIFIER fm_cal_efi_sldv_2_scg.Cxx_obd_us_typ_xxx /end CHARACTERISTIC
/begin CHARACTERISTIC Cxx_dtc_obd_efi_sldv_2_scw "" VALUE 0xa002b72e _REC_S1VAL_20_u2 65535. _CNV_A_R_A_105_CM 0. 65535. DISPLAY_IDENTIFIER fm_cal_efi_sldv_2_scw.Cxx_dtc_obd_xxx /end CHARACTERISTIC
/begin CHARACTERISTIC Cxx_conf_wal_efi_sldv_2_scw "" VALUE 0xa002b730 _REC_S1VAL_20_u1 3. _CNV_A_R_A_105_CM 0. 3. DISPLAY_IDENTIFIER fm_cal_efi_sldv_2_scw.fm_static_bitfield.Cxx_conf_wal_xxx BIT_MASK 0x3 /end CHARACTERISTIC
/begin CHARACTERISTIC Cbx_obd_efi_sldv_2_scw "" VALUE 0xa002b730 _REC_S1VAL_20_u1 255. _CNV_A_R_A_105_CM 0. 255. DISPLAY_IDENTIFIER fm_cal_efi_sldv_2_scw.fm_static_bitfield.Cbx_obd_xxx BIT_MASK 0x4 /end CHARACTERISTIC
/begin CHARACTERISTIC Cbx_obd_mena_efi_sldv_2_scw "" VALUE 0xa002b730 _REC_S1VAL_20_u1 255. _CNV_A_R_A_105_CM 0. 255. DISPLAY_IDENTIFIER fm_cal_efi_sldv_2_scw.fm_static_bitfield.Cbx_obd_mena_xxx BIT_MASK 0x8 /end CHARACTERISTIC
/begin CHARACTERISTIC Cxx_dtc_lb_efi_sldv_2_scw "" VALUE 0xa002b731 _REC_S1VAL_20_u1 255. _CNV_A_R_A_105_CM 0. 255. DISPLAY_IDENTIFIER fm_cal_efi_sldv_2_scw.Cxx_dtc_lb_xxx /end CHARACTERISTIC
/begin CHARACTERISTIC Cxx_obd_dc_efi_sldv_2_scw "" VALUE 0xa002b732 _REC_S1VAL_20_u1 9. _CNV_A_R_A_105_CM 1. 10. DISPLAY_IDENTIFIER fm_cal_efi_sldv_2_scw.Cxx_obd_dc_xxx /end CHARACTERISTIC
/begin CHARACTERISTIC Cxx_obd_us_typ_efi_sldv_2_scw "" VALUE 0xa002b733 _REC_S1VAL_20_u1 255. _CNV_A_R_A_105_CM 0. 255. DISPLAY_IDENTIFIER fm_cal_efi_sldv_2_scw.Cxx_obd_us_typ_xxx /end CHARACTERISTIC
/begin CHARACTERISTIC Cxx_conf_wal_esp_data_chr "" VALUE 0xa002ae90 _REC_S1VAL_20_u1 3. _CNV_A_R_A_105_CM 0. 3. DISPLAY_IDENTIFIER fm_cal_esp_data_chr.fm_static_bitfield.Cxx_conf_wal_xxx BIT_MASK 0x3 /end CHARACTERISTIC
/begin CHARACTERISTIC Cxx_dtc_lb_esp_data_chr "" VALUE 0xa002ae91 _REC_S1VAL_20_u1 255. _CNV_A_R_A_105_CM 0. 255. DISPLAY_IDENTIFIER fm_cal_esp_data_chr.Cxx_dtc_lb_xxx /end CHARACTERISTIC
/begin CHARACTERISTIC Cxx_obd_us_typ_esp_data_chr "" VALUE 0xa002ae93 _REC_S1VAL_20_u1 255. _CNV_A_R_A_105_CM 0. 255. DISPLAY_IDENTIFIER fm_cal_esp_data_chr.Cxx_obd_us_typ_xxx /end CHARACTERISTIC
/begin CHARACTERISTIC Cxx_conf_wal_esp_data_seq_ctr "" VALUE 0xa002ae9c _REC_S1VAL_20_u1 3. _CNV_A_R_A_105_CM 0. 3. DISPLAY_IDENTIFIER fm_cal_esp_data_seq_ctr.fm_static_bitfield.Cxx_conf_wal_xxx BIT_MASK 0x3 /end CHARACTERISTIC
/begin CHARACTERISTIC Cxx_dtc_lb_esp_data_seq_ctr "" VALUE 0xa002ae9d _REC_S1VAL_20_u1 255. _CNV_A_R_A_105_CM 0. 255. DISPLAY_IDENTIFIER fm_cal_esp_data_seq_ctr.Cxx_dtc_lb_xxx /end CHARACTERISTIC
/begin CHARACTERISTIC Cxx_obd_us_typ_esp_data_seq_ctr "" VALUE 0xa002ae9f _REC_S1VAL_20_u1 255. _CNV_A_R_A_105_CM 0. 255. DISPLAY_IDENTIFIER fm_cal_esp_data_seq_ctr.Cxx_obd_us_typ_xxx /end CHARACTERISTIC
/begin CHARACTERISTIC Cxx_conf_wal_esp_no_frm "" VALUE 0xa002aea8 _REC_S1VAL_20_u1 3. _CNV_A_R_A_105_CM 0. 3. DISPLAY_IDENTIFIER fm_cal_esp_no_frm.fm_static_bitfield.Cxx_conf_wal_xxx BIT_MASK 0x3 /end CHARACTERISTIC
/begin CHARACTERISTIC Cxx_dtc_lb_esp_no_frm "" VALUE 0xa002aea9 _REC_S1VAL_20_u1 255. _CNV_A_R_A_105_CM 0. 255. DISPLAY_IDENTIFIER fm_cal_esp_no_frm.Cxx_dtc_lb_xxx /end CHARACTERISTIC
/begin CHARACTERISTIC Cxx_obd_us_typ_esp_no_frm "" VALUE 0xa002aeab _REC_S1VAL_20_u1 255. _CNV_A_R_A_105_CM 0. 255. DISPLAY_IDENTIFIER fm_cal_esp_no_frm.Cxx_obd_us_typ_xxx /end CHARACTERISTIC
/begin CHARACTERISTIC Cxx_dtc_obd_eva_fcap_abn_cple "" VALUE 0xa002b5c6 _REC_S1VAL_20_u2 65535. _CNV_A_R_A_105_CM 0. 65535. DISPLAY_IDENTIFIER fm_cal_eva_fcap_abn_cple.Cxx_dtc_obd_xxx /end CHARACTERISTIC
/begin CHARACTERISTIC Cxx_conf_wal_eva_fcap_abn_cple "" VALUE 0xa002b5c8 _REC_S1VAL_20_u1 3. _CNV_A_R_A_105_CM 0. 3. DISPLAY_IDENTIFIER fm_cal_eva_fcap_abn_cple.fm_static_bitfield.Cxx_conf_wal_xxx BIT_MASK 0x3 /end CHARACTERISTIC
/begin CHARACTERISTIC Cbx_obd_eva_fcap_abn_cple "" VALUE 0xa002b5c8 _REC_S1VAL_20_u1 255. _CNV_A_R_A_105_CM 0. 255. DISPLAY_IDENTIFIER fm_cal_eva_fcap_abn_cple.fm_static_bitfield.Cbx_obd_xxx BIT_MASK 0x4 /end CHARACTERISTIC
/begin CHARACTERISTIC Cbx_obd_mena_eva_fcap_abn_cple "" VALUE 0xa002b5c8 _REC_S1VAL_20_u1 255. _CNV_A_R_A_105_CM 0. 255. DISPLAY_IDENTIFIER fm_cal_eva_fcap_abn_cple.fm_static_bitfield.Cbx_obd_mena_xxx BIT_MASK 0x8 /end CHARACTERISTIC
/begin CHARACTERISTIC Cxx_dtc_lb_eva_fcap_abn_cple "" VALUE 0xa002b5c9 _REC_S1VAL_20_u1 255. _CNV_A_R_A_105_CM 0. 255. DISPLAY_IDENTIFIER fm_cal_eva_fcap_abn_cple.Cxx_dtc_lb_xxx /end CHARACTERISTIC
/begin CHARACTERISTIC Cxx_obd_dc_eva_fcap_abn_cple "" VALUE 0xa002b5ca _REC_S1VAL_20_u1 9. _CNV_A_R_A_105_CM 1. 10. DISPLAY_IDENTIFIER fm_cal_eva_fcap_abn_cple.Cxx_obd_dc_xxx /end CHARACTERISTIC
/begin CHARACTERISTIC Cxx_obd_us_typ_eva_fcap_abn_cple "" VALUE 0xa002b5cb _REC_S1VAL_20_u1 255. _CNV_A_R_A_105_CM 0. 255. DISPLAY_IDENTIFIER fm_cal_eva_fcap_abn_cple.Cxx_obd_us_typ_xxx /end CHARACTERISTIC
/begin CHARACTERISTIC Cxx_dtc_obd_eva_fcap_no_lk "" VALUE 0xa002b5d2 _REC_S1VAL_20_u2 65535. _CNV_A_R_A_105_CM 0. 65535. DISPLAY_IDENTIFIER fm_cal_eva_fcap_no_lk.Cxx_dtc_obd_xxx /end CHARACTERISTIC
/begin CHARACTERISTIC Cxx_conf_wal_eva_fcap_no_lk "" VALUE 0xa002b5d4 _REC_S1VAL_20_u1 3. _CNV_A_R_A_105_CM 0. 3. DISPLAY_IDENTIFIER fm_cal_eva_fcap_no_lk.fm_static_bitfield.Cxx_conf_wal_xxx BIT_MASK 0x3 /end CHARACTERISTIC
/begin CHARACTERISTIC Cbx_obd_eva_fcap_no_lk "" VALUE 0xa002b5d4 _REC_S1VAL_20_u1 255. _CNV_A_R_A_105_CM 0. 255. DISPLAY_IDENTIFIER fm_cal_eva_fcap_no_lk.fm_static_bitfield.Cbx_obd_xxx BIT_MASK 0x4 /end CHARACTERISTIC
/begin CHARACTERISTIC Cbx_obd_mena_eva_fcap_no_lk "" VALUE 0xa002b5d4 _REC_S1VAL_20_u1 255. _CNV_A_R_A_105_CM 0. 255. DISPLAY_IDENTIFIER fm_cal_eva_fcap_no_lk.fm_static_bitfield.Cbx_obd_mena_xxx BIT_MASK 0x8 /end CHARACTERISTIC
/begin CHARACTERISTIC Cxx_dtc_lb_eva_fcap_no_lk "" VALUE 0xa002b5d5 _REC_S1VAL_20_u1 255. _CNV_A_R_A_105_CM 0. 255. DISPLAY_IDENTIFIER fm_cal_eva_fcap_no_lk.Cxx_dtc_lb_xxx /end CHARACTERISTIC
/begin CHARACTERISTIC Cxx_obd_dc_eva_fcap_no_lk "" VALUE 0xa002b5d6 _REC_S1VAL_20_u1 9. _CNV_A_R_A_105_CM 1. 10. DISPLAY_IDENTIFIER fm_cal_eva_fcap_no_lk.Cxx_obd_dc_xxx /end CHARACTERISTIC
/begin CHARACTERISTIC Cxx_obd_us_typ_eva_fcap_no_lk "" VALUE 0xa002b5d7 _REC_S1VAL_20_u1 255. _CNV_A_R_A_105_CM 0. 255. DISPLAY_IDENTIFIER fm_cal_eva_fcap_no_lk.Cxx_obd_us_typ_xxx /end CHARACTERISTIC
/begin CHARACTERISTIC Cxx_dtc_obd_eva_sldv_blk_clos "" VALUE 0xa002b5ea _REC_S1VAL_20_u2 65535. _CNV_A_R_A_105_CM 0. 65535. DISPLAY_IDENTIFIER fm_cal_eva_sldv_blk_clos.Cxx_dtc_obd_xxx /end CHARACTERISTIC
/begin CHARACTERISTIC Cxx_conf_wal_eva_sldv_blk_clos "" VALUE 0xa002b5ec _REC_S1VAL_20_u1 3. _CNV_A_R_A_105_CM 0. 3. DISPLAY_IDENTIFIER fm_cal_eva_sldv_blk_clos.fm_static_bitfield.Cxx_conf_wal_xxx BIT_MASK 0x3 /end CHARACTERISTIC
/begin CHARACTERISTIC Cbx_obd_eva_sldv_blk_clos "" VALUE 0xa002b5ec _REC_S1VAL_20_u1 255. _CNV_A_R_A_105_CM 0. 255. DISPLAY_IDENTIFIER fm_cal_eva_sldv_blk_clos.fm_static_bitfield.Cbx_obd_xxx BIT_MASK 0x4 /end CHARACTERISTIC
/begin CHARACTERISTIC Cbx_obd_mena_eva_sldv_blk_clos "" VALUE 0xa002b5ec _REC_S1VAL_20_u1 255. _CNV_A_R_A_105_CM 0. 255. DISPLAY_IDENTIFIER fm_cal_eva_sldv_blk_clos.fm_static_bitfield.Cbx_obd_mena_xxx BIT_MASK 0x8 /end CHARACTERISTIC
/begin CHARACTERISTIC Cxx_dtc_lb_eva_sldv_blk_clos "" VALUE 0xa002b5ed _REC_S1VAL_20_u1 255. _CNV_A_R_A_105_CM 0. 255. DISPLAY_IDENTIFIER fm_cal_eva_sldv_blk_clos.Cxx_dtc_lb_xxx /end CHARACTERISTIC
/begin CHARACTERISTIC Cxx_obd_dc_eva_sldv_blk_clos "" VALUE 0xa002b5ee _REC_S1VAL_20_u1 9. _CNV_A_R_A_105_CM 1. 10. DISPLAY_IDENTIFIER fm_cal_eva_sldv_blk_clos.Cxx_obd_dc_xxx /end CHARACTERISTIC
/begin CHARACTERISTIC Cxx_obd_us_typ_eva_sldv_blk_clos "" VALUE 0xa002b5ef _REC_S1VAL_20_u1 255. _CNV_A_R_A_105_CM 0. 255. DISPLAY_IDENTIFIER fm_cal_eva_sldv_blk_clos.Cxx_obd_us_typ_xxx /end CHARACTERISTIC
/begin CHARACTERISTIC Cxx_dtc_obd_eva_sldv_oc "" VALUE 0xa002b5f6 _REC_S1VAL_20_u2 65535. _CNV_A_R_A_105_CM 0. 65535. DISPLAY_IDENTIFIER fm_cal_eva_sldv_oc.Cxx_dtc_obd_xxx /end CHARACTERISTIC
/begin CHARACTERISTIC Cxx_conf_wal_eva_sldv_oc "" VALUE 0xa002b5f8 _REC_S1VAL_20_u1 3. _CNV_A_R_A_105_CM 0. 3. DISPLAY_IDENTIFIER fm_cal_eva_sldv_oc.fm_static_bitfield.Cxx_conf_wal_xxx BIT_MASK 0x3 /end CHARACTERISTIC
/begin CHARACTERISTIC Cbx_obd_eva_sldv_oc "" VALUE 0xa002b5f8 _REC_S1VAL_20_u1 255. _CNV_A_R_A_105_CM 0. 255. DISPLAY_IDENTIFIER fm_cal_eva_sldv_oc.fm_static_bitfield.Cbx_obd_xxx BIT_MASK 0x4 /end CHARACTERISTIC
/begin CHARACTERISTIC Cbx_obd_mena_eva_sldv_oc "" VALUE 0xa002b5f8 _REC_S1VAL_20_u1 255. _CNV_A_R_A_105_CM 0. 255. DISPLAY_IDENTIFIER fm_cal_eva_sldv_oc.fm_static_bitfield.Cbx_obd_mena_xxx BIT_MASK 0x8 /end CHARACTERISTIC
/begin CHARACTERISTIC Cxx_dtc_lb_eva_sldv_oc "" VALUE 0xa002b5f9 _REC_S1VAL_20_u1 255. _CNV_A_R_A_105_CM 0. 255. DISPLAY_IDENTIFIER fm_cal_eva_sldv_oc.Cxx_dtc_lb_xxx /end CHARACTERISTIC
/begin CHARACTERISTIC Cxx_obd_dc_eva_sldv_oc "" VALUE 0xa002b5fa _REC_S1VAL_20_u1 9. _CNV_A_R_A_105_CM 1. 10. DISPLAY_IDENTIFIER fm_cal_eva_sldv_oc.Cxx_obd_dc_xxx /end CHARACTERISTIC
/begin CHARACTERISTIC Cxx_obd_us_typ_eva_sldv_oc "" VALUE 0xa002b5fb _REC_S1VAL_20_u1 255. _CNV_A_R_A_105_CM 0. 255. DISPLAY_IDENTIFIER fm_cal_eva_sldv_oc.Cxx_obd_us_typ_xxx /end CHARACTERISTIC
/begin CHARACTERISTIC Cxx_dtc_obd_eva_sldv_scg "" VALUE 0xa002b602 _REC_S1VAL_20_u2 65535. _CNV_A_R_A_105_CM 0. 65535. DISPLAY_IDENTIFIER fm_cal_eva_sldv_scg.Cxx_dtc_obd_xxx /end CHARACTERISTIC
/begin CHARACTERISTIC Cxx_conf_wal_eva_sldv_scg "" VALUE 0xa002b604 _REC_S1VAL_20_u1 3. _CNV_A_R_A_105_CM 0. 3. DISPLAY_IDENTIFIER fm_cal_eva_sldv_scg.fm_static_bitfield.Cxx_conf_wal_xxx BIT_MASK 0x3 /end CHARACTERISTIC
/begin CHARACTERISTIC Cbx_obd_eva_sldv_scg "" VALUE 0xa002b604 _REC_S1VAL_20_u1 255. _CNV_A_R_A_105_CM 0. 255. DISPLAY_IDENTIFIER fm_cal_eva_sldv_scg.fm_static_bitfield.Cbx_obd_xxx BIT_MASK 0x4 /end CHARACTERISTIC
/begin CHARACTERISTIC Cbx_obd_mena_eva_sldv_scg "" VALUE 0xa002b604 _REC_S1VAL_20_u1 255. _CNV_A_R_A_105_CM 0. 255. DISPLAY_IDENTIFIER fm_cal_eva_sldv_scg.fm_static_bitfield.Cbx_obd_mena_xxx BIT_MASK 0x8 /end CHARACTERISTIC
/begin CHARACTERISTIC Cxx_dtc_lb_eva_sldv_scg "" VALUE 0xa002b605 _REC_S1VAL_20_u1 255. _CNV_A_R_A_105_CM 0. 255. DISPLAY_IDENTIFIER fm_cal_eva_sldv_scg.Cxx_dtc_lb_xxx /end CHARACTERISTIC
/begin CHARACTERISTIC Cxx_obd_dc_eva_sldv_scg "" VALUE 0xa002b606 _REC_S1VAL_20_u1 9. _CNV_A_R_A_105_CM 1. 10. DISPLAY_IDENTIFIER fm_cal_eva_sldv_scg.Cxx_obd_dc_xxx /end CHARACTERISTIC
/begin CHARACTERISTIC Cxx_obd_us_typ_eva_sldv_scg "" VALUE 0xa002b607 _REC_S1VAL_20_u1 255. _CNV_A_R_A_105_CM 0. 255. DISPLAY_IDENTIFIER fm_cal_eva_sldv_scg.Cxx_obd_us_typ_xxx /end CHARACTERISTIC
/begin CHARACTERISTIC Cxx_dtc_obd_eva_sldv_scw "" VALUE 0xa002b60e _REC_S1VAL_20_u2 65535. _CNV_A_R_A_105_CM 0. 65535. DISPLAY_IDENTIFIER fm_cal_eva_sldv_scw.Cxx_dtc_obd_xxx /end CHARACTERISTIC
/begin CHARACTERISTIC Cxx_conf_wal_eva_sldv_scw "" VALUE 0xa002b610 _REC_S1VAL_20_u1 3. _CNV_A_R_A_105_CM 0. 3. DISPLAY_IDENTIFIER fm_cal_eva_sldv_scw.fm_static_bitfield.Cxx_conf_wal_xxx BIT_MASK 0x3 /end CHARACTERISTIC
/begin CHARACTERISTIC Cbx_obd_eva_sldv_scw "" VALUE 0xa002b610 _REC_S1VAL_20_u1 255. _CNV_A_R_A_105_CM 0. 255. DISPLAY_IDENTIFIER fm_cal_eva_sldv_scw.fm_static_bitfield.Cbx_obd_xxx BIT_MASK 0x4 /end CHARACTERISTIC
/begin CHARACTERISTIC Cbx_obd_mena_eva_sldv_scw "" VALUE 0xa002b610 _REC_S1VAL_20_u1 255. _CNV_A_R_A_105_CM 0. 255. DISPLAY_IDENTIFIER fm_cal_eva_sldv_scw.fm_static_bitfield.Cbx_obd_mena_xxx BIT_MASK 0x8 /end CHARACTERISTIC
/begin CHARACTERISTIC Cxx_dtc_lb_eva_sldv_scw "" VALUE 0xa002b611 _REC_S1VAL_20_u1 255. _CNV_A_R_A_105_CM 0. 255. DISPLAY_IDENTIFIER fm_cal_eva_sldv_scw.Cxx_dtc_lb_xxx /end CHARACTERISTIC
/begin CHARACTERISTIC Cxx_obd_dc_eva_sldv_scw "" VALUE 0xa002b612 _REC_S1VAL_20_u1 9. _CNV_A_R_A_105_CM 1. 10. DISPLAY_IDENTIFIER fm_cal_eva_sldv_scw.Cxx_obd_dc_xxx /end CHARACTERISTIC
/begin CHARACTERISTIC Cxx_obd_us_typ_eva_sldv_scw "" VALUE 0xa002b613 _REC_S1VAL_20_u1 255. _CNV_A_R_A_105_CM 0. 255. DISPLAY_IDENTIFIER fm_cal_eva_sldv_scw.Cxx_obd_us_typ_xxx /end CHARACTERISTIC
/begin CHARACTERISTIC Cxx_dtc_obd_evap_chr "" VALUE 0xa002b5ba _REC_S1VAL_20_u2 65535. _CNV_A_R_A_105_CM 0. 65535. DISPLAY_IDENTIFIER fm_cal_evap_chr.Cxx_dtc_obd_xxx /end CHARACTERISTIC
/begin CHARACTERISTIC Cxx_conf_wal_evap_chr "" VALUE 0xa002b5bc _REC_S1VAL_20_u1 3. _CNV_A_R_A_105_CM 0. 3. DISPLAY_IDENTIFIER fm_cal_evap_chr.fm_static_bitfield.Cxx_conf_wal_xxx BIT_MASK 0x3 /end CHARACTERISTIC
/begin CHARACTERISTIC Cbx_obd_evap_chr "" VALUE 0xa002b5bc _REC_S1VAL_20_u1 255. _CNV_A_R_A_105_CM 0. 255. DISPLAY_IDENTIFIER fm_cal_evap_chr.fm_static_bitfield.Cbx_obd_xxx BIT_MASK 0x4 /end CHARACTERISTIC
/begin CHARACTERISTIC Cbx_obd_mena_evap_chr "" VALUE 0xa002b5bc _REC_S1VAL_20_u1 255. _CNV_A_R_A_105_CM 0. 255. DISPLAY_IDENTIFIER fm_cal_evap_chr.fm_static_bitfield.Cbx_obd_mena_xxx BIT_MASK 0x8 /end CHARACTERISTIC
/begin CHARACTERISTIC Cxx_dtc_lb_evap_chr "" VALUE 0xa002b5bd _REC_S1VAL_20_u1 255. _CNV_A_R_A_105_CM 0. 255. DISPLAY_IDENTIFIER fm_cal_evap_chr.Cxx_dtc_lb_xxx /end CHARACTERISTIC
/begin CHARACTERISTIC Cxx_obd_dc_evap_chr "" VALUE 0xa002b5be _REC_S1VAL_20_u1 9. _CNV_A_R_A_105_CM 1. 10. DISPLAY_IDENTIFIER fm_cal_evap_chr.Cxx_obd_dc_xxx /end CHARACTERISTIC
/begin CHARACTERISTIC Cxx_obd_us_typ_evap_chr "" VALUE 0xa002b5bf _REC_S1VAL_20_u1 255. _CNV_A_R_A_105_CM 0. 255. DISPLAY_IDENTIFIER fm_cal_evap_chr.Cxx_obd_us_typ_xxx /end CHARACTERISTIC
/begin CHARACTERISTIC Cxx_dtc_obd_evap_lkg "" VALUE 0xa002b5de _REC_S1VAL_20_u2 65535. _CNV_A_R_A_105_CM 0. 65535. DISPLAY_IDENTIFIER fm_cal_evap_lkg.Cxx_dtc_obd_xxx /end CHARACTERISTIC
/begin CHARACTERISTIC Cxx_conf_wal_evap_lkg "" VALUE 0xa002b5e0 _REC_S1VAL_20_u1 3. _CNV_A_R_A_105_CM 0. 3. DISPLAY_IDENTIFIER fm_cal_evap_lkg.fm_static_bitfield.Cxx_conf_wal_xxx BIT_MASK 0x3 /end CHARACTERISTIC
/begin CHARACTERISTIC Cbx_obd_evap_lkg "" VALUE 0xa002b5e0 _REC_S1VAL_20_u1 255. _CNV_A_R_A_105_CM 0. 255. DISPLAY_IDENTIFIER fm_cal_evap_lkg.fm_static_bitfield.Cbx_obd_xxx BIT_MASK 0x4 /end CHARACTERISTIC
/begin CHARACTERISTIC Cbx_obd_mena_evap_lkg "" VALUE 0xa002b5e0 _REC_S1VAL_20_u1 255. _CNV_A_R_A_105_CM 0. 255. DISPLAY_IDENTIFIER fm_cal_evap_lkg.fm_static_bitfield.Cbx_obd_mena_xxx BIT_MASK 0x8 /end CHARACTERISTIC
/begin CHARACTERISTIC Cxx_dtc_lb_evap_lkg "" VALUE 0xa002b5e1 _REC_S1VAL_20_u1 255. _CNV_A_R_A_105_CM 0. 255. DISPLAY_IDENTIFIER fm_cal_evap_lkg.Cxx_dtc_lb_xxx /end CHARACTERISTIC
/begin CHARACTERISTIC Cxx_obd_dc_evap_lkg "" VALUE 0xa002b5e2 _REC_S1VAL_20_u1 9. _CNV_A_R_A_105_CM 1. 10. DISPLAY_IDENTIFIER fm_cal_evap_lkg.Cxx_obd_dc_xxx /end CHARACTERISTIC
/begin CHARACTERISTIC Cxx_obd_us_typ_evap_lkg "" VALUE 0xa002b5e3 _REC_S1VAL_20_u1 255. _CNV_A_R_A_105_CM 0. 255. DISPLAY_IDENTIFIER fm_cal_evap_lkg.Cxx_obd_us_typ_xxx /end CHARACTERISTIC
/begin CHARACTERISTIC Cxx_dtc_obd_fsys_cpt "" VALUE 0xa002b21e _REC_S1VAL_20_u2 65535. _CNV_A_R_A_105_CM 0. 65535. DISPLAY_IDENTIFIER fm_cal_fsys_cpt.Cxx_dtc_obd_xxx /end CHARACTERISTIC
/begin CHARACTERISTIC Cxx_conf_wal_fsys_cpt "" VALUE 0xa002b220 _REC_S1VAL_20_u1 3. _CNV_A_R_A_105_CM 0. 3. DISPLAY_IDENTIFIER fm_cal_fsys_cpt.fm_static_bitfield.Cxx_conf_wal_xxx BIT_MASK 0x3 /end CHARACTERISTIC
/begin CHARACTERISTIC Cbx_obd_fsys_cpt "" VALUE 0xa002b220 _REC_S1VAL_20_u1 255. _CNV_A_R_A_105_CM 0. 255. DISPLAY_IDENTIFIER fm_cal_fsys_cpt.fm_static_bitfield.Cbx_obd_xxx BIT_MASK 0x4 /end CHARACTERISTIC
/begin CHARACTERISTIC Cbx_obd_mena_fsys_cpt "" VALUE 0xa002b220 _REC_S1VAL_20_u1 255. _CNV_A_R_A_105_CM 0. 255. DISPLAY_IDENTIFIER fm_cal_fsys_cpt.fm_static_bitfield.Cbx_obd_mena_xxx BIT_MASK 0x8 /end CHARACTERISTIC
/begin CHARACTERISTIC Cxx_dtc_lb_fsys_cpt "" VALUE 0xa002b221 _REC_S1VAL_20_u1 255. _CNV_A_R_A_105_CM 0. 255. DISPLAY_IDENTIFIER fm_cal_fsys_cpt.Cxx_dtc_lb_xxx /end CHARACTERISTIC
/begin CHARACTERISTIC Cxx_obd_dc_fsys_cpt "" VALUE 0xa002b222 _REC_S1VAL_20_u1 9. _CNV_A_R_A_105_CM 1. 10. DISPLAY_IDENTIFIER fm_cal_fsys_cpt.Cxx_obd_dc_xxx /end CHARACTERISTIC
/begin CHARACTERISTIC Cxx_obd_us_typ_fsys_cpt "" VALUE 0xa002b223 _REC_S1VAL_20_u1 255. _CNV_A_R_A_105_CM 0. 255. DISPLAY_IDENTIFIER fm_cal_fsys_cpt.Cxx_obd_us_typ_xxx /end CHARACTERISTIC
/begin CHARACTERISTIC Cxx_dtc_obd_gas_pump_2_oc "" VALUE 0xa002b73a _REC_S1VAL_20_u2 65535. _CNV_A_R_A_105_CM 0. 65535. DISPLAY_IDENTIFIER fm_cal_gas_pump_2_oc.Cxx_dtc_obd_xxx /end CHARACTERISTIC
/begin CHARACTERISTIC Cxx_conf_wal_gas_pump_2_oc "" VALUE 0xa002b73c _REC_S1VAL_20_u1 3. _CNV_A_R_A_105_CM 0. 3. DISPLAY_IDENTIFIER fm_cal_gas_pump_2_oc.fm_static_bitfield.Cxx_conf_wal_xxx BIT_MASK 0x3 /end CHARACTERISTIC
/begin CHARACTERISTIC Cbx_obd_gas_pump_2_oc "" VALUE 0xa002b73c _REC_S1VAL_20_u1 255. _CNV_A_R_A_105_CM 0. 255. DISPLAY_IDENTIFIER fm_cal_gas_pump_2_oc.fm_static_bitfield.Cbx_obd_xxx BIT_MASK 0x4 /end CHARACTERISTIC
/begin CHARACTERISTIC Cbx_obd_mena_gas_pump_2_oc "" VALUE 0xa002b73c _REC_S1VAL_20_u1 255. _CNV_A_R_A_105_CM 0. 255. DISPLAY_IDENTIFIER fm_cal_gas_pump_2_oc.fm_static_bitfield.Cbx_obd_mena_xxx BIT_MASK 0x8 /end CHARACTERISTIC
/begin CHARACTERISTIC Cxx_dtc_lb_gas_pump_2_oc "" VALUE 0xa002b73d _REC_S1VAL_20_u1 255. _CNV_A_R_A_105_CM 0. 255. DISPLAY_IDENTIFIER fm_cal_gas_pump_2_oc.Cxx_dtc_lb_xxx /end CHARACTERISTIC
/begin CHARACTERISTIC Cxx_obd_dc_gas_pump_2_oc "" VALUE 0xa002b73e _REC_S1VAL_20_u1 9. _CNV_A_R_A_105_CM 1. 10. DISPLAY_IDENTIFIER fm_cal_gas_pump_2_oc.Cxx_obd_dc_xxx /end CHARACTERISTIC
/begin CHARACTERISTIC Cxx_obd_us_typ_gas_pump_2_oc "" VALUE 0xa002b73f _REC_S1VAL_20_u1 255. _CNV_A_R_A_105_CM 0. 255. DISPLAY_IDENTIFIER fm_cal_gas_pump_2_oc.Cxx_obd_us_typ_xxx /end CHARACTERISTIC
/begin CHARACTERISTIC Cxx_dtc_obd_gas_pump_2_scg "" VALUE 0xa002b746 _REC_S1VAL_20_u2 65535. _CNV_A_R_A_105_CM 0. 65535. DISPLAY_IDENTIFIER fm_cal_gas_pump_2_scg.Cxx_dtc_obd_xxx /end CHARACTERISTIC
/begin CHARACTERISTIC Cxx_conf_wal_gas_pump_2_scg "" VALUE 0xa002b748 _REC_S1VAL_20_u1 3. _CNV_A_R_A_105_CM 0. 3. DISPLAY_IDENTIFIER fm_cal_gas_pump_2_scg.fm_static_bitfield.Cxx_conf_wal_xxx BIT_MASK 0x3 /end CHARACTERISTIC
/begin CHARACTERISTIC Cbx_obd_gas_pump_2_scg "" VALUE 0xa002b748 _REC_S1VAL_20_u1 255. _CNV_A_R_A_105_CM 0. 255. DISPLAY_IDENTIFIER fm_cal_gas_pump_2_scg.fm_static_bitfield.Cbx_obd_xxx BIT_MASK 0x4 /end CHARACTERISTIC
/begin CHARACTERISTIC Cbx_obd_mena_gas_pump_2_scg "" VALUE 0xa002b748 _REC_S1VAL_20_u1 255. _CNV_A_R_A_105_CM 0. 255. DISPLAY_IDENTIFIER fm_cal_gas_pump_2_scg.fm_static_bitfield.Cbx_obd_mena_xxx BIT_MASK 0x8 /end CHARACTERISTIC
/begin CHARACTERISTIC Cxx_dtc_lb_gas_pump_2_scg "" VALUE 0xa002b749 _REC_S1VAL_20_u1 255. _CNV_A_R_A_105_CM 0. 255. DISPLAY_IDENTIFIER fm_cal_gas_pump_2_scg.Cxx_dtc_lb_xxx /end CHARACTERISTIC
/begin CHARACTERISTIC Cxx_obd_dc_gas_pump_2_scg "" VALUE 0xa002b74a _REC_S1VAL_20_u1 9. _CNV_A_R_A_105_CM 1. 10. DISPLAY_IDENTIFIER fm_cal_gas_pump_2_scg.Cxx_obd_dc_xxx /end CHARACTERISTIC
/begin CHARACTERISTIC Cxx_obd_us_typ_gas_pump_2_scg "" VALUE 0xa002b74b _REC_S1VAL_20_u1 255. _CNV_A_R_A_105_CM 0. 255. DISPLAY_IDENTIFIER fm_cal_gas_pump_2_scg.Cxx_obd_us_typ_xxx /end CHARACTERISTIC
/begin CHARACTERISTIC Cxx_dtc_obd_gas_pump_2_scw "" VALUE 0xa002b752 _REC_S1VAL_20_u2 65535. _CNV_A_R_A_105_CM 0. 65535. DISPLAY_IDENTIFIER fm_cal_gas_pump_2_scw.Cxx_dtc_obd_xxx /end CHARACTERISTIC
/begin CHARACTERISTIC Cxx_conf_wal_gas_pump_2_scw "" VALUE 0xa002b754 _REC_S1VAL_20_u1 3. _CNV_A_R_A_105_CM 0. 3. DISPLAY_IDENTIFIER fm_cal_gas_pump_2_scw.fm_static_bitfield.Cxx_conf_wal_xxx BIT_MASK 0x3 /end CHARACTERISTIC
/begin CHARACTERISTIC Cbx_obd_gas_pump_2_scw "" VALUE 0xa002b754 _REC_S1VAL_20_u1 255. _CNV_A_R_A_105_CM 0. 255. DISPLAY_IDENTIFIER fm_cal_gas_pump_2_scw.fm_static_bitfield.Cbx_obd_xxx BIT_MASK 0x4 /end CHARACTERISTIC
/begin CHARACTERISTIC Cbx_obd_mena_gas_pump_2_scw "" VALUE 0xa002b754 _REC_S1VAL_20_u1 255. _CNV_A_R_A_105_CM 0. 255. DISPLAY_IDENTIFIER fm_cal_gas_pump_2_scw.fm_static_bitfield.Cbx_obd_mena_xxx BIT_MASK 0x8 /end CHARACTERISTIC
/begin CHARACTERISTIC Cxx_dtc_lb_gas_pump_2_scw "" VALUE 0xa002b755 _REC_S1VAL_20_u1 255. _CNV_A_R_A_105_CM 0. 255. DISPLAY_IDENTIFIER fm_cal_gas_pump_2_scw.Cxx_dtc_lb_xxx /end CHARACTERISTIC
/begin CHARACTERISTIC Cxx_obd_dc_gas_pump_2_scw "" VALUE 0xa002b756 _REC_S1VAL_20_u1 9. _CNV_A_R_A_105_CM 1. 10. DISPLAY_IDENTIFIER fm_cal_gas_pump_2_scw.Cxx_obd_dc_xxx /end CHARACTERISTIC
/begin CHARACTERISTIC Cxx_obd_us_typ_gas_pump_2_scw "" VALUE 0xa002b757 _REC_S1VAL_20_u1 255. _CNV_A_R_A_105_CM 0. 255. DISPLAY_IDENTIFIER fm_cal_gas_pump_2_scw.Cxx_obd_us_typ_xxx /end CHARACTERISTIC
/begin CHARACTERISTIC Cxx_dtc_obd_gas_pump_oc "" VALUE 0xa002aeb2 _REC_S1VAL_20_u2 65535. _CNV_A_R_A_105_CM 0. 65535. DISPLAY_IDENTIFIER fm_cal_gas_pump_oc.Cxx_dtc_obd_xxx /end CHARACTERISTIC
/begin CHARACTERISTIC Cxx_conf_wal_gas_pump_oc "" VALUE 0xa002aeb4 _REC_S1VAL_20_u1 3. _CNV_A_R_A_105_CM 0. 3. DISPLAY_IDENTIFIER fm_cal_gas_pump_oc.fm_static_bitfield.Cxx_conf_wal_xxx BIT_MASK 0x3 /end CHARACTERISTIC
/begin CHARACTERISTIC Cbx_obd_gas_pump_oc "" VALUE 0xa002aeb4 _REC_S1VAL_20_u1 255. _CNV_A_R_A_105_CM 0. 255. DISPLAY_IDENTIFIER fm_cal_gas_pump_oc.fm_static_bitfield.Cbx_obd_xxx BIT_MASK 0x4 /end CHARACTERISTIC
/begin CHARACTERISTIC Cbx_obd_mena_gas_pump_oc "" VALUE 0xa002aeb4 _REC_S1VAL_20_u1 255. _CNV_A_R_A_105_CM 0. 255. DISPLAY_IDENTIFIER fm_cal_gas_pump_oc.fm_static_bitfield.Cbx_obd_mena_xxx BIT_MASK 0x8 /end CHARACTERISTIC
/begin CHARACTERISTIC Cxx_dtc_lb_gas_pump_oc "" VALUE 0xa002aeb5 _REC_S1VAL_20_u1 255. _CNV_A_R_A_105_CM 0. 255. DISPLAY_IDENTIFIER fm_cal_gas_pump_oc.Cxx_dtc_lb_xxx /end CHARACTERISTIC
/begin CHARACTERISTIC Cxx_obd_dc_gas_pump_oc "" VALUE 0xa002aeb6 _REC_S1VAL_20_u1 9. _CNV_A_R_A_105_CM 1. 10. DISPLAY_IDENTIFIER fm_cal_gas_pump_oc.Cxx_obd_dc_xxx /end CHARACTERISTIC
/begin CHARACTERISTIC Cxx_obd_us_typ_gas_pump_oc "" VALUE 0xa002aeb7 _REC_S1VAL_20_u1 255. _CNV_A_R_A_105_CM 0. 255. DISPLAY_IDENTIFIER fm_cal_gas_pump_oc.Cxx_obd_us_typ_xxx /end CHARACTERISTIC
/begin CHARACTERISTIC Cxx_dtc_obd_gas_pump_scg "" VALUE 0xa002aebe _REC_S1VAL_20_u2 65535. _CNV_A_R_A_105_CM 0. 65535. DISPLAY_IDENTIFIER fm_cal_gas_pump_scg.Cxx_dtc_obd_xxx /end CHARACTERISTIC
/begin CHARACTERISTIC Cxx_conf_wal_gas_pump_scg "" VALUE 0xa002aec0 _REC_S1VAL_20_u1 3. _CNV_A_R_A_105_CM 0. 3. DISPLAY_IDENTIFIER fm_cal_gas_pump_scg.fm_static_bitfield.Cxx_conf_wal_xxx BIT_MASK 0x3 /end CHARACTERISTIC
/begin CHARACTERISTIC Cbx_obd_gas_pump_scg "" VALUE 0xa002aec0 _REC_S1VAL_20_u1 255. _CNV_A_R_A_105_CM 0. 255. DISPLAY_IDENTIFIER fm_cal_gas_pump_scg.fm_static_bitfield.Cbx_obd_xxx BIT_MASK 0x4 /end CHARACTERISTIC
/begin CHARACTERISTIC Cbx_obd_mena_gas_pump_scg "" VALUE 0xa002aec0 _REC_S1VAL_20_u1 255. _CNV_A_R_A_105_CM 0. 255. DISPLAY_IDENTIFIER fm_cal_gas_pump_scg.fm_static_bitfield.Cbx_obd_mena_xxx BIT_MASK 0x8 /end CHARACTERISTIC
/begin CHARACTERISTIC Cxx_dtc_lb_gas_pump_scg "" VALUE 0xa002aec1 _REC_S1VAL_20_u1 255. _CNV_A_R_A_105_CM 0. 255. DISPLAY_IDENTIFIER fm_cal_gas_pump_scg.Cxx_dtc_lb_xxx /end CHARACTERISTIC
/begin CHARACTERISTIC Cxx_obd_dc_gas_pump_scg "" VALUE 0xa002aec2 _REC_S1VAL_20_u1 9. _CNV_A_R_A_105_CM 1. 10. DISPLAY_IDENTIFIER fm_cal_gas_pump_scg.Cxx_obd_dc_xxx /end CHARACTERISTIC
/begin CHARACTERISTIC Cxx_obd_us_typ_gas_pump_scg "" VALUE 0xa002aec3 _REC_S1VAL_20_u1 255. _CNV_A_R_A_105_CM 0. 255. DISPLAY_IDENTIFIER fm_cal_gas_pump_scg.Cxx_obd_us_typ_xxx /end CHARACTERISTIC
/begin CHARACTERISTIC Cxx_dtc_obd_gas_pump_scw "" VALUE 0xa002aeca _REC_S1VAL_20_u2 65535. _CNV_A_R_A_105_CM 0. 65535. DISPLAY_IDENTIFIER fm_cal_gas_pump_scw.Cxx_dtc_obd_xxx /end CHARACTERISTIC
/begin CHARACTERISTIC Cxx_conf_wal_gas_pump_scw "" VALUE 0xa002aecc _REC_S1VAL_20_u1 3. _CNV_A_R_A_105_CM 0. 3. DISPLAY_IDENTIFIER fm_cal_gas_pump_scw.fm_static_bitfield.Cxx_conf_wal_xxx BIT_MASK 0x3 /end CHARACTERISTIC
/begin CHARACTERISTIC Cbx_obd_gas_pump_scw "" VALUE 0xa002aecc _REC_S1VAL_20_u1 255. _CNV_A_R_A_105_CM 0. 255. DISPLAY_IDENTIFIER fm_cal_gas_pump_scw.fm_static_bitfield.Cbx_obd_xxx BIT_MASK 0x4 /end CHARACTERISTIC
/begin CHARACTERISTIC Cbx_obd_mena_gas_pump_scw "" VALUE 0xa002aecc _REC_S1VAL_20_u1 255. _CNV_A_R_A_105_CM 0. 255. DISPLAY_IDENTIFIER fm_cal_gas_pump_scw.fm_static_bitfield.Cbx_obd_mena_xxx BIT_MASK 0x8 /end CHARACTERISTIC
/begin CHARACTERISTIC Cxx_dtc_lb_gas_pump_scw "" VALUE 0xa002aecd _REC_S1VAL_20_u1 255. _CNV_A_R_A_105_CM 0. 255. DISPLAY_IDENTIFIER fm_cal_gas_pump_scw.Cxx_dtc_lb_xxx /end CHARACTERISTIC
/begin CHARACTERISTIC Cxx_obd_dc_gas_pump_scw "" VALUE 0xa002aece _REC_S1VAL_20_u1 9. _CNV_A_R_A_105_CM 1. 10. DISPLAY_IDENTIFIER fm_cal_gas_pump_scw.Cxx_obd_dc_xxx /end CHARACTERISTIC
/begin CHARACTERISTIC Cxx_obd_us_typ_gas_pump_scw "" VALUE 0xa002aecf _REC_S1VAL_20_u1 255. _CNV_A_R_A_105_CM 0. 255. DISPLAY_IDENTIFIER fm_cal_gas_pump_scw.Cxx_obd_us_typ_xxx /end CHARACTERISTIC
/begin CHARACTERISTIC Cxx_dtc_obd_igc_1_oc "" VALUE 0xa002b572 _REC_S1VAL_20_u2 65535. _CNV_A_R_A_105_CM 0. 65535. DISPLAY_IDENTIFIER fm_cal_igc_1_oc.Cxx_dtc_obd_xxx /end CHARACTERISTIC
/begin CHARACTERISTIC Cxx_conf_wal_igc_1_oc "" VALUE 0xa002b574 _REC_S1VAL_20_u1 3. _CNV_A_R_A_105_CM 0. 3. DISPLAY_IDENTIFIER fm_cal_igc_1_oc.fm_static_bitfield.Cxx_conf_wal_xxx BIT_MASK 0x3 /end CHARACTERISTIC
/begin CHARACTERISTIC Cbx_obd_igc_1_oc "" VALUE 0xa002b574 _REC_S1VAL_20_u1 255. _CNV_A_R_A_105_CM 0. 255. DISPLAY_IDENTIFIER fm_cal_igc_1_oc.fm_static_bitfield.Cbx_obd_xxx BIT_MASK 0x4 /end CHARACTERISTIC
/begin CHARACTERISTIC Cbx_obd_mena_igc_1_oc "" VALUE 0xa002b574 _REC_S1VAL_20_u1 255. _CNV_A_R_A_105_CM 0. 255. DISPLAY_IDENTIFIER fm_cal_igc_1_oc.fm_static_bitfield.Cbx_obd_mena_xxx BIT_MASK 0x8 /end CHARACTERISTIC
/begin CHARACTERISTIC Cxx_dtc_lb_igc_1_oc "" VALUE 0xa002b575 _REC_S1VAL_20_u1 255. _CNV_A_R_A_105_CM 0. 255. DISPLAY_IDENTIFIER fm_cal_igc_1_oc.Cxx_dtc_lb_xxx /end CHARACTERISTIC
/begin CHARACTERISTIC Cxx_obd_dc_igc_1_oc "" VALUE 0xa002b576 _REC_S1VAL_20_u1 9. _CNV_A_R_A_105_CM 1. 10. DISPLAY_IDENTIFIER fm_cal_igc_1_oc.Cxx_obd_dc_xxx /end CHARACTERISTIC
/begin CHARACTERISTIC Cxx_obd_us_typ_igc_1_oc "" VALUE 0xa002b577 _REC_S1VAL_20_u1 255. _CNV_A_R_A_105_CM 0. 255. DISPLAY_IDENTIFIER fm_cal_igc_1_oc.Cxx_obd_us_typ_xxx /end CHARACTERISTIC
/begin CHARACTERISTIC Cxx_dtc_obd_igc_1_scg "" VALUE 0xa002b57e _REC_S1VAL_20_u2 65535. _CNV_A_R_A_105_CM 0. 65535. DISPLAY_IDENTIFIER fm_cal_igc_1_scg.Cxx_dtc_obd_xxx /end CHARACTERISTIC
/begin CHARACTERISTIC Cxx_conf_wal_igc_1_scg "" VALUE 0xa002b580 _REC_S1VAL_20_u1 3. _CNV_A_R_A_105_CM 0. 3. DISPLAY_IDENTIFIER fm_cal_igc_1_scg.fm_static_bitfield.Cxx_conf_wal_xxx BIT_MASK 0x3 /end CHARACTERISTIC
/begin CHARACTERISTIC Cbx_obd_igc_1_scg "" VALUE 0xa002b580 _REC_S1VAL_20_u1 255. _CNV_A_R_A_105_CM 0. 255. DISPLAY_IDENTIFIER fm_cal_igc_1_scg.fm_static_bitfield.Cbx_obd_xxx BIT_MASK 0x4 /end CHARACTERISTIC
/begin CHARACTERISTIC Cbx_obd_mena_igc_1_scg "" VALUE 0xa002b580 _REC_S1VAL_20_u1 255. _CNV_A_R_A_105_CM 0. 255. DISPLAY_IDENTIFIER fm_cal_igc_1_scg.fm_static_bitfield.Cbx_obd_mena_xxx BIT_MASK 0x8 /end CHARACTERISTIC
/begin CHARACTERISTIC Cxx_dtc_lb_igc_1_scg "" VALUE 0xa002b581 _REC_S1VAL_20_u1 255. _CNV_A_R_A_105_CM 0. 255. DISPLAY_IDENTIFIER fm_cal_igc_1_scg.Cxx_dtc_lb_xxx /end CHARACTERISTIC
/begin CHARACTERISTIC Cxx_obd_dc_igc_1_scg "" VALUE 0xa002b582 _REC_S1VAL_20_u1 9. _CNV_A_R_A_105_CM 1. 10. DISPLAY_IDENTIFIER fm_cal_igc_1_scg.Cxx_obd_dc_xxx /end CHARACTERISTIC
/begin CHARACTERISTIC Cxx_obd_us_typ_igc_1_scg "" VALUE 0xa002b583 _REC_S1VAL_20_u1 255. _CNV_A_R_A_105_CM 0. 255. DISPLAY_IDENTIFIER fm_cal_igc_1_scg.Cxx_obd_us_typ_xxx /end CHARACTERISTIC
/begin CHARACTERISTIC Cxx_dtc_obd_igc_1_scw "" VALUE 0xa002b58a _REC_S1VAL_20_u2 65535. _CNV_A_R_A_105_CM 0. 65535. DISPLAY_IDENTIFIER fm_cal_igc_1_scw.Cxx_dtc_obd_xxx /end CHARACTERISTIC
/begin CHARACTERISTIC Cxx_conf_wal_igc_1_scw "" VALUE 0xa002b58c _REC_S1VAL_20_u1 3. _CNV_A_R_A_105_CM 0. 3. DISPLAY_IDENTIFIER fm_cal_igc_1_scw.fm_static_bitfield.Cxx_conf_wal_xxx BIT_MASK 0x3 /end CHARACTERISTIC
/begin CHARACTERISTIC Cbx_obd_igc_1_scw "" VALUE 0xa002b58c _REC_S1VAL_20_u1 255. _CNV_A_R_A_105_CM 0. 255. DISPLAY_IDENTIFIER fm_cal_igc_1_scw.fm_static_bitfield.Cbx_obd_xxx BIT_MASK 0x4 /end CHARACTERISTIC
/begin CHARACTERISTIC Cbx_obd_mena_igc_1_scw "" VALUE 0xa002b58c _REC_S1VAL_20_u1 255. _CNV_A_R_A_105_CM 0. 255. DISPLAY_IDENTIFIER fm_cal_igc_1_scw.fm_static_bitfield.Cbx_obd_mena_xxx BIT_MASK 0x8 /end CHARACTERISTIC
/begin CHARACTERISTIC Cxx_dtc_lb_igc_1_scw "" VALUE 0xa002b58d _REC_S1VAL_20_u1 255. _CNV_A_R_A_105_CM 0. 255. DISPLAY_IDENTIFIER fm_cal_igc_1_scw.Cxx_dtc_lb_xxx /end CHARACTERISTIC
/begin CHARACTERISTIC Cxx_obd_dc_igc_1_scw "" VALUE 0xa002b58e _REC_S1VAL_20_u1 9. _CNV_A_R_A_105_CM 1. 10. DISPLAY_IDENTIFIER fm_cal_igc_1_scw.Cxx_obd_dc_xxx /end CHARACTERISTIC
/begin CHARACTERISTIC Cxx_obd_us_typ_igc_1_scw "" VALUE 0xa002b58f _REC_S1VAL_20_u1 255. _CNV_A_R_A_105_CM 0. 255. DISPLAY_IDENTIFIER fm_cal_igc_1_scw.Cxx_obd_us_typ_xxx /end CHARACTERISTIC
/begin CHARACTERISTIC Cxx_dtc_obd_igc_2_oc "" VALUE 0xa002b596 _REC_S1VAL_20_u2 65535. _CNV_A_R_A_105_CM 0. 65535. DISPLAY_IDENTIFIER fm_cal_igc_2_oc.Cxx_dtc_obd_xxx /end CHARACTERISTIC
/begin CHARACTERISTIC Cxx_conf_wal_igc_2_oc "" VALUE 0xa002b598 _REC_S1VAL_20_u1 3. _CNV_A_R_A_105_CM 0. 3. DISPLAY_IDENTIFIER fm_cal_igc_2_oc.fm_static_bitfield.Cxx_conf_wal_xxx BIT_MASK 0x3 /end CHARACTERISTIC
/begin CHARACTERISTIC Cbx_obd_igc_2_oc "" VALUE 0xa002b598 _REC_S1VAL_20_u1 255. _CNV_A_R_A_105_CM 0. 255. DISPLAY_IDENTIFIER fm_cal_igc_2_oc.fm_static_bitfield.Cbx_obd_xxx BIT_MASK 0x4 /end CHARACTERISTIC
/begin CHARACTERISTIC Cbx_obd_mena_igc_2_oc "" VALUE 0xa002b598 _REC_S1VAL_20_u1 255. _CNV_A_R_A_105_CM 0. 255. DISPLAY_IDENTIFIER fm_cal_igc_2_oc.fm_static_bitfield.Cbx_obd_mena_xxx BIT_MASK 0x8 /end CHARACTERISTIC
/begin CHARACTERISTIC Cxx_dtc_lb_igc_2_oc "" VALUE 0xa002b599 _REC_S1VAL_20_u1 255. _CNV_A_R_A_105_CM 0. 255. DISPLAY_IDENTIFIER fm_cal_igc_2_oc.Cxx_dtc_lb_xxx /end CHARACTERISTIC
/begin CHARACTERISTIC Cxx_obd_dc_igc_2_oc "" VALUE 0xa002b59a _REC_S1VAL_20_u1 9. _CNV_A_R_A_105_CM 1. 10. DISPLAY_IDENTIFIER fm_cal_igc_2_oc.Cxx_obd_dc_xxx /end CHARACTERISTIC
/begin CHARACTERISTIC Cxx_obd_us_typ_igc_2_oc "" VALUE 0xa002b59b _REC_S1VAL_20_u1 255. _CNV_A_R_A_105_CM 0. 255. DISPLAY_IDENTIFIER fm_cal_igc_2_oc.Cxx_obd_us_typ_xxx /end CHARACTERISTIC
/begin COMPU_METHOD _CNV_A_R_A_105_CM "" RAT_FUNC "%6.3" "" COEFFS 0 1. 0. 0 0 1 /end COMPU_METHOD
/begin RECORD_LAYOUT _REC_S1VAL_20_u1 FNC_VALUES 1 UBYTE COLUMN_DIR DIRECT /end RECORD_LAYOUT
/begin RECORD_LAYOUT _REC_S1VAL_20_u2 FNC_VALUES 1 UWORD COLUMN_DIR DIRECT /end RECORD_LAYOUT
/begin FUNCTION DgDftCfg ""
 /begin DEF_CHARACTERISTIC Ctx_ffm_did_crk[4] Cxx_dtc_hmb_crk Ctx_ffm_did_cru[0] Ctx_ffm_did_cru[1] Ctx_ffm_did_cru[2] Ctx_ffm_did_cru[3] Ctx_ffm_did_cru[4] Cxx_dtc_hmb_cru Ctx_ffm_did_cru_sl[0] Ctx_ffm_did_cru_sl[1] Ctx_ffm_did_cru_sl[2] Ctx_ffm_did_cru_sl[3] Ctx_ffm_did_cru_sl[4] Cxx_dtc_hmb_cru_sl Ctx_ffm_did_cru_sl_swi[0] Ctx_ffm_did_cru_sl_swi[1] Ctx_ffm_did_cru_sl_swi[2] Ctx_ffm_did_cru_sl_swi[3] Ctx_ffm_did_cru_sl_swi[4] Cxx_dtc_hmb_cru_sl_swi Ctx_ffm_did_cru_vs[0] Ctx_ffm_did_cru_vs[1] Ctx_ffm_did_cru_vs[2] Ctx_ffm_did_cru_vs[3] Ctx_ffm_did_cru_vs[4] Cxx_dtc_hmb_cru_vs Ctx_ffm_did_cru_whl_cmd[0] Ctx_ffm_did_cru_whl_cmd[1] Ctx_ffm_did_cru_whl_cmd[2] Ctx_ffm_did_cru_whl_cmd[3] Ctx_ffm_did_cru_whl_cmd[4] Cxx_dtc_hmb_cru_whl_cmd Ctx_ffm_did_ecm_adc[0] Ctx_ffm_did_ecm_adc[1] Ctx_ffm_did_ecm_adc[2] Ctx_ffm_did_ecm_adc[3] Ctx_ffm_did_ecm_adc[4] Cxx_dtc_hmb_ecm_adc Ctx_ffm_did_ecm_err[0] Ctx_ffm_did_ecm_err[1] Ctx_ffm_did_ecm_err[2] Ctx_ffm_did_ecm_err[3] Ctx_ffm_did_ecm_err[4] Cxx_dtc_hmb_ecm_err Ctx_ffm_did_ecm_mon[0] Ctx_ffm_did_ecm_mon[1] Ctx_ffm_did_ecm_mon[2] Ctx_ffm_did_ecm_mon[3] Ctx_ffm_did_ecm_mon[4] Cxx_dtc_hmb_ecm_mon Ctx_ffm_did_efi_sldv_2[0] Ctx_ffm_did_efi_sldv_2[1] Ctx_ffm_did_efi_sldv_2[2] Ctx_ffm_did_efi_sldv_2[3] Ctx_ffm_did_efi_sldv_2[4] Cxx_dtc_hmb_efi_sldv_2 Ctx_ffm_did_esp[0] Ctx_ffm_did_esp[1] Ctx_ffm_did_esp[2] Ctx_ffm_did_esp[3] Ctx_ffm_did_esp[4] Cxx_dtc_hmb_esp Ctx_ffm_did_esp_data[0] Ctx_ffm_did_esp_data[1] Ctx_ffm_did_esp_data[2] Ctx_ffm_did_esp_data[3] Ctx_ffm_did_esp_data[4] Cxx_dtc_hmb_esp_data Ctx_ffm_did_eva_fcap[0] Ctx_ffm_did_eva_fcap[1] Ctx_ffm_did_eva_fcap[2] Ctx_ffm_did_eva_fcap[3] Ctx_ffm_did_eva_fcap[4] Cxx_dtc_hmb_eva_fcap Ctx_ffm_did_eva_sldv[0] Ctx_ffm_did_eva_sldv[1] Ctx_ffm_did_eva_sldv[2] Ctx_ffm_did_eva_sldv[3] Ctx_ffm_did_eva_sldv[4] Cxx_dtc_hmb_eva_sldv Ctx_ffm_did_evap[0] Ctx_ffm_did_evap[1] Ctx_ffm_did_evap[2] Ctx_ffm_did_evap[3] Ctx_ffm_did_evap[4] Cxx_dtc_hmb_evap Ctx_ffm_did_fsys[0] Ctx_ffm_did_fsys[1] Ctx_ffm_did_fsys[2] Ctx_ffm_did_fsys[3] Ctx_ffm_did_fsys[4] Cxx_dtc_hmb_fsys Ctx_ffm_did_gas_pump[0] Ctx_ffm_did_gas_pump[1] Ctx_ffm_did_gas_pump[2] Ctx_ffm_did_gas_pump[3] Ctx_ffm_did_gas_pump[4] Cxx_dtc_hmb_gas_pump Ctx_ffm_did_gas_pump_2[0] Ctx_ffm_did_gas_pump_2[1] Ctx_ffm_did_gas_pump_2[2] Ctx_ffm_did_gas_pump_2[3] Ctx_ffm_did_gas_pump_2[4] Cxx_dtc_hmb_gas_pump_2 Ctx_ffm_did_igc_1[0] Ctx_ffm_did_igc_1[1] Ctx_ffm_did_igc_1[2] Ctx_ffm_did_igc_1[3] Ctx_ffm_did_igc_1[4] Cxx_dtc_hmb_igc_1 Ctx_ffm_did_igc_2[0] Ctx_ffm_did_igc_2[1] Ctx_ffm_did_igc_2[2] Ctx_ffm_did_igc_2[3] Ctx_ffm_did_igc_2[4] Cxx_dtc_hmb_igc_2 Ctx_ffm_did_igc_3[0] Ctx_ffm_did_igc_3[1] Ctx_ffm_did_igc_3[2] Ctx_ffm_did_igc_3[3] Ctx_ffm_did_igc_3[4] Cxx_dtc_hmb_igc_3 Ctx_ffm_did_igc_4[0] Ctx_ffm_did_igc_4[1] Ctx_ffm_did_igc_4[2] Ctx_ffm_did_igc_4[3] Ctx_ffm_did_igc_4[4] Cxx_dtc_hmb_igc_4 Ctx_ffm_did_in_cam[0] Ctx_ffm_did_in_cam[1] Ctx_ffm_did_in_cam[2] Ctx_ffm_did_in_cam[3] Ctx_ffm_did_in_cam[4] Cxx_dtc_hmb_in_cam Ctx_ffm_did_in_cam_crk[0] Ctx_ffm_did_in_cam_crk[1] Ctx_ffm_did_in_cam_crk[2] Ctx_ffm_did_in_cam_crk[3] Ctx_ffm_did_in_cam_crk[4] Cxx_dtc_hmb_in_cam_crk Ctx_ffm_did_in_vvtc[0] Ctx_ffm_did_in_vvtc[1] Ctx_ffm_did_in_vvtc[2] Ctx_ffm_did_in_vvtc[3] Ctx_ffm_did_in_vvtc[4] Cxx_dtc_hmb_in_vvtc Ctx_ffm_did_in_vvtc_sldv[0] Ctx_ffm_did_in_vvtc_sldv[1] Ctx_ffm_did_in_vvtc_sldv[2] Ctx_ffm_did_in_vvtc_sldv[3] Ctx_ffm_did_in_vvtc_sldv[4] Cxx_dtc_hmb_in_vvtc_sldv Ctx_ffm_did_inj1[0] Ctx_ffm_did_inj1[1] Ctx_ffm_did_inj1[2] Ctx_ffm_did_inj1[3] Ctx_ffm_did_inj1[4] Cxx_dtc_hmb_inj1 Ctx_ffm_did_inj2[0] Ctx_ffm_did_inj2[1] Ctx_ffm_did_inj2[2] Ctx_ffm_did_inj2[3] Ctx_ffm_did_inj2[4] Cxx_dtc_hmb_inj2 Ctx_ffm_did_inj3[0] Ctx_ffm_did_inj3[1] Ctx_ffm_did_inj3[2] Ctx_ffm_did_inj3[3] Ctx_ffm_did_inj3[4] Cxx_dtc_hmb_inj3 Ctx_ffm_did_inj4[0] Ctx_ffm_did_inj4[1] Ctx_ffm_did_inj4[2] Ctx_ffm_did_inj4[3] Ctx_ffm_did_inj4[4] Cxx_dtc_hmb_inj4 Ctx_ffm_did_inj_ecu[0] Ctx_ffm_did_inj_ecu[1] Ctx_ffm_did_inj_ecu[2] Ctx_ffm_did_inj_ecu[3] Ctx_ffm_did_inj_ecu[4] Cxx_dtc_hmb_inj_ecu Ctx_ffm_did_ip_lght_tco[0] Ctx_ffm_did_ip_lght_tco[1] Ctx_ffm_did_ip_lght_tco[2] Ctx_ffm_did_ip_lght_tco[3] Ctx_ffm_did_ip_lght_tco[4] Cxx_dtc_hmb_ip_lght_tco Ctx_ffm_did_isr[0] Ctx_ffm_did_isr[1] Ctx_ffm_did_isr[2] Ctx_ffm_did_isr[3] Ctx_ffm_did_isr[4] Cxx_dtc_hmb_isr Ctx_ffm_did_it_cmd[0] Ctx_ffm_did_it_cmd[1] Ctx_ffm_did_it_cmd[2] Ctx_ffm_did_it_cmd[3] Ctx_ffm_did_it_cmd[4] Cxx_dtc_hmb_it_cmd Ctx_ffm_did_it_ofs[0] Ctx_ffm_did_it_ofs[1] Ctx_ffm_did_it_ofs[2] Ctx_ffm_did_it_ofs[3] Ctx_ffm_did_it_ofs[4] Cxx_dtc_hmb_it_ofs Ctx_ffm_did_it_reg[0] Ctx_ffm_did_it_reg[1] Ctx_ffm_did_it_reg[2] Ctx_ffm_did_it_reg[3] Ctx_ffm_did_it_reg[4] Cxx_dtc_hmb_it_reg Ctx_ffm_did_knk[0] Ctx_ffm_did_knk[1] Ctx_ffm_did_knk[2] Ctx_ffm_did_knk[3] Ctx_ffm_did_knk[4] Cxx_dtc_hmb_knk Ctx_ffm_did_lbdw[0] Ctx_ffm_did_lbdw[1] Ctx_ffm_did_lbdw[2] Ctx_ffm_did_lbdw[3] Ctx_ffm_did_lbdw[4] Cxx_dtc_hmb_lbdw Ctx_ffm_did_lbdw_hot[0] Ctx_ffm_did_lbdw_hot[1] Ctx_ffm_did_lbdw_hot[2] Ctx_ffm_did_lbdw_hot[3] Ctx_ffm_did_lbdw_hot[4] Cxx_dtc_hmb_lbdw_hot Ctx_ffm_did_lbup[0] Ctx_ffm_did_lbup[1] Ctx_ffm_did_lbup[2] Ctx_ffm_did_lbup[3] Ctx_ffm_did_lbup[4] Cxx_dtc_hmb_lbup Ctx_ffm_did_lbup_hot[0] Ctx_ffm_did_lbup_hot[1] Ctx_ffm_did_lbup_hot[2] Ctx_ffm_did_lbup_hot[3] Ctx_ffm_did_lbup_hot[4] Cxx_dtc_hmb_lbup_hot Ctx_ffm_did_lbup_shf[0] Ctx_ffm_did_lbup_shf[1] Ctx_ffm_did_lbup_shf[2] Ctx_ffm_did_lbup_shf[3] Ctx_ffm_did_lbup_shf[4] Cxx_dtc_hmb_lbup_shf Ctx_ffm_did_map[0] Ctx_ffm_did_map[1] Ctx_ffm_did_map[2] Ctx_ffm_did_map[3] Ctx_ffm_did_map[4] Cxx_dtc_hmb_map Ctx_ffm_did_mis[0] Ctx_ffm_did_mis[1] Ctx_ffm_did_mis[2] Ctx_ffm_did_mis[3] Ctx_ffm_did_mis[4] Cxx_dtc_hmb_mis Ctx_ffm_did_mis_1[0] Ctx_ffm_did_mis_1[1] Ctx_ffm_did_mis_1[2] Ctx_ffm_did_mis_1[3] Ctx_ffm_did_mis_1[4] Cxx_dtc_hmb_mis_1 Ctx_ffm_did_mis_1_lpg[0] Ctx_ffm_did_mis_1_lpg[1] Ctx_ffm_did_mis_1_lpg[2] Ctx_ffm_did_mis_1_lpg[3] Ctx_ffm_did_mis_1_lpg[4] Cxx_dtc_hmb_mis_1_lpg Ctx_ffm_did_mis_2[0] Ctx_ffm_did_mis_2[1] Ctx_ffm_did_mis_2[2] Ctx_ffm_did_mis_2[3] Ctx_ffm_did_mis_2[4] Cxx_dtc_hmb_mis_2 Ctx_ffm_did_mis_2_lpg[0] Ctx_ffm_did_mis_2_lpg[1] Ctx_ffm_did_mis_2_lpg[2] Ctx_ffm_did_mis_2_lpg[3] Ctx_ffm_did_mis_2_lpg[4] Cxx_dtc_hmb_mis_2_lpg Ctx_ffm_did_mis_3[0] Ctx_ffm_did_mis_3[1] Ctx_ffm_did_mis_3[2] Ctx_ffm_did_mis_3[3] Ctx_ffm_did_mis_3[4] Cxx_dtc_hmb_mis_3 Ctx_ffm_did_mis_3_lpg[0] Ctx_ffm_did_mis_3_lpg[1] Ctx_ffm_did_mis_3_lpg[2] Ctx_ffm_did_mis_3_lpg[3] Ctx_ffm_did_mis_3_lpg[4] Cxx_dtc_hmb_mis_3_lpg Ctx_ffm_did_mis_4[0] Ctx_ffm_did_mis_4[1] Ctx_ffm_did_mis_4[2] Ctx_ffm_did_mis_4[3] Ctx_ffm_did_mis_4[4] Cxx_dtc_hmb_mis_4 Ctx_ffm_did_mis_4_lpg[0] Ctx_ffm_did_mis_4_lpg[1] Ctx_ffm_did_mis_4_lpg[2] Ctx_ffm_did_mis_4_lpg[3] Ctx_ffm_did_mis_4_lpg[4] Cxx_dtc_hmb_mis_4_lpg Ctx_ffm_did_mis_lpg[0] Ctx_ffm_did_mis_lpg[1] Ctx_ffm_did_mis_lpg[2] Ctx_ffm_did_mis_lpg[3] Ctx_ffm_did_mis_lpg[4] Cxx_dtc_hmb_mis_lpg Ctx_ffm_did_mis_min_fuel[0] Ctx_ffm_did_mis_min_fuel[1] Ctx_ffm_did_mis_min_fuel[2] Ctx_ffm_did_mis_min_fuel[3] Ctx_ffm_did_mis_min_fuel[4] Cxx_dtc_hmb_mis_min_fuel Ctx_ffm_did_mis_unk[0] Ctx_ffm_did_mis_unk[1] Ctx_ffm_did_mis_unk[2] Ctx_ffm_did_mis_unk[3] Ctx_ffm_did_mis_unk[4] Cxx_dtc_hmb_mis_unk Ctx_ffm_did_mis_unk_lpg[0] Ctx_ffm_did_mis_unk_lpg[1] Ctx_ffm_did_mis_unk_lpg[2] Ctx_ffm_did_mis_unk_lpg[3] Ctx_ffm_did_mis_unk_lpg[4] Cxx_dtc_hmb_mis_unk_lpg Ctx_ffm_did_ptc_rov[0] Ctx_ffm_did_ptc_rov[1] Ctx_ffm_did_ptc_rov[2] Ctx_ffm_did_ptc_rov[3] Ctx_ffm_did_ptc_rov[4] Cxx_dtc_hmb_ptc_rov Ctx_ffm_did_pws_1[0] Ctx_ffm_did_pws_1[1] Ctx_ffm_did_pws_1[2] Ctx_ffm_did_pws_1[3] Ctx_ffm_did_pws_1[4] Cxx_dtc_hmb_pws_1 Ctx_ffm_did_pws_2[0] Ctx_ffm_did_pws_2[1] Ctx_ffm_did_pws_2[2] Ctx_ffm_did_pws_2[3] Ctx_ffm_did_pws_2[4] Cxx_dtc_hmb_pws_2 Ctx_ffm_did_pws_3[0] Ctx_ffm_did_pws_3[1] Ctx_ffm_did_pws_3[2] Ctx_ffm_did_pws_3[3] Ctx_ffm_did_pws_3[4] Cxx_dtc_hmb_pws_3 Ctx_ffm_did_sens_it[0] Ctx_ffm_did_sens_it[1] Ctx_ffm_did_sens_it[2] Ctx_ffm_did_sens_it[3] Ctx_ffm_did_sens_it[4] Cxx_dtc_hmb_sens_it Ctx_ffm_did_sens_it_1[0] Ctx_ffm_did_sens_it_1[1] Ctx_ffm_did_sens_it_1[2] Ctx_ffm_did_sens_it_1[3] Ctx_ffm_did_sens_it_1[4] Cxx_dtc_hmb_sens_it_1 Ctx_ffm_did_sens_it_2[0] Ctx_ffm_did_sens_it_2[1] Ctx_ffm_did_sens_it_2[2] Ctx_ffm_did_sens_it_2[3] Ctx_ffm_did_sens_it_2[4] Cxx_dtc_hmb_sens_it_2 Ctx_ffm_did_sens_map[0] Ctx_ffm_did_sens_map[1] Ctx_ffm_did_sens_map[2] Ctx_ffm_did_sens_map[3] Ctx_ffm_did_sens_map[4] Cxx_dtc_hmb_sens_map Ctx_ffm_did_sens_mat[0] Ctx_ffm_did_sens_mat[1] Ctx_ffm_did_sens_mat[2] Ctx_ffm_did_sens_mat[3] Ctx_ffm_did_sens_mat[4] Cxx_dtc_hmb_sens_mat Ctx_ffm_did_sens_rvc[0] Ctx_ffm_did_sens_rvc[1] Ctx_ffm_did_sens_rvc[2] Ctx_ffm_did_sens_rvc[3] Ctx_ffm_did_sens_rvc[4] Cxx_dtc_hmb_sens_rvc Ctx_ffm_did_sens_spg[0] Ctx_ffm_did_sens_spg[1] Ctx_ffm_did_sens_spg[2] Ctx_ffm_did_sens_spg[3] Ctx_ffm_did_sens_spg[4] Cxx_dtc_hmb_sens_spg Ctx_ffm_did_sens_tco[0] Ctx_ffm_did_sens_tco[1] Ctx_ffm_did_sens_tco[2] Ctx_ffm_did_sens_tco[3] Ctx_ffm_did_sens_tco[4] Cxx_dtc_hmb_sens_tco Ctx_ffm_did_sfty_tq[0] Ctx_ffm_did_sfty_tq[1] Ctx_ffm_did_sfty_tq[2] Ctx_ffm_did_sfty_tq[3] Ctx_ffm_did_sfty_tq[4] Cxx_dtc_hmb_sfty_tq Ctx_ffm_did_spg[0] Ctx_ffm_did_spg[1] Ctx_ffm_did_spg[2] Ctx_ffm_did_spg[3] Ctx_ffm_did_spg[4] Cxx_dtc_hmb_spg Ctx_ffm_did_spg_reg[0] Ctx_ffm_did_spg_reg[1] Ctx_ffm_did_spg_reg[2] Ctx_ffm_did_spg_reg[3] Ctx_ffm_did_spg_reg[4] Cxx_dtc_hmb_spg_reg Ctx_ffm_did_tco_cl[0] Ctx_ffm_did_tco_cl[1] Ctx_ffm_did_tco_cl[2] Ctx_ffm_did_tco_cl[3] Ctx_ffm_did_tco_cl[4] Cxx_dtc_hmb_tco_cl Ctx_ffm_did_tlz_ad_b[0] Ctx_ffm_did_tlz_ad_b[1] Ctx_ffm_did_tlz_ad_b[2] Ctx_ffm_did_tlz_ad_b[3] Ctx_ffm_did_tlz_ad_b[4] Cxx_dtc_hmb_tlz_ad_b Ctx_ffm_did_tsta_reg[0] Ctx_ffm_did_tsta_reg[1] Ctx_ffm_did_tsta_reg[2] Ctx_ffm_did_tsta_reg[3] Ctx_ffm_did_tsta_reg[4] Cxx_dtc_hmb_tsta_reg Ctx_ffm_did_vb[0] Ctx_ffm_did_vb[1] Ctx_ffm_did_vb[2] Ctx_ffm_did_vb[3] Ctx_ffm_did_vb[4] Cxx_dtc_hmb_vb Ctx_ffm_did_vb_rly[0] Ctx_ffm_did_vb_rly[1] Ctx_ffm_did_vb_rly[2] Ctx_ffm_did_vb_rly[3] Ctx_ffm_did_vb_rly[4] Cxx_dtc_hmb_vb_rly Ctx_ffm_did_wgc[0] Ctx_ffm_did_wgc[1] Ctx_ffm_did_wgc[2] Ctx_ffm_did_wgc[3] Ctx_ffm_did_wgc[4] Cxx_dtc_hmb_wgc Ctx_ffm_did_wpmp_tcr[0] Ctx_ffm_did_wpmp_tcr[1] Ctx_ffm_did_wpmp_tcr[2] Ctx_ffm_did_wpmp_tcr[3] Ctx_ffm_did_wpmp_tcr[4] Cxx_dtc_hmb_wpmp_tcr Cxx_conf_wal_ac_prs_h Cxx_dtc_lb_ac_prs_h Cxx_obd_us_typ_ac_prs_h Cxx_conf_wal_ac_prs_l Cxx_dtc_lb_ac_prs_l Cxx_obd_us_typ_ac_prs_l Cxx_dtc_obd_acel_pdl_chr Cxx_conf_wal_acel_pdl_chr Cbx_obd_acel_pdl_chr Cbx_obd_mena_acel_pdl_chr Cxx_dtc_lb_acel_pdl_chr Cxx_obd_dc_acel_pdl_chr Cxx_obd_us_typ_acel_pdl_chr Cxx_dtc_obd_acel_pdl_secu_1 Cxx_conf_wal_acel_pdl_secu_1 Cbx_obd_acel_pdl_secu_1 Cbx_obd_mena_acel_pdl_secu_1 Cxx_dtc_lb_acel_pdl_secu_1 Cxx_obd_dc_acel_pdl_secu_1 Cxx_obd_us_typ_acel_pdl_secu_1 Cxx_dtc_obd_acel_pdl_secu_2 Cxx_conf_wal_acel_pdl_secu_2 Cbx_obd_acel_pdl_secu_2 Cbx_obd_mena_acel_pdl_secu_2 Cxx_dtc_lb_acel_pdl_secu_2 Cxx_obd_dc_acel_pdl_secu_2 Cxx_obd_us_typ_acel_pdl_secu_2 Cxx_dtc_obd_acel_pdl_tot Cxx_conf_wal_acel_pdl_tot Cbx_obd_acel_pdl_tot Cbx_obd_mena_acel_pdl_tot Cxx_dtc_lb_acel_pdl_tot Cxx_obd_dc_acel_pdl_tot Cxx_obd_us_typ_acel_pdl_tot Cxx_dtc_obd_acel_pdl_v1_h Cxx_conf_wal_acel_pdl_v1_h Cbx_obd_acel_pdl_v1_h Cbx_obd_mena_acel_pdl_v1_h Cxx_dtc_lb_acel_pdl_v1_h Cxx_obd_dc_acel_pdl_v1_h Cxx_obd_us_typ_acel_pdl_v1_h Cxx_dtc_obd_acel_pdl_v1_l Cxx_conf_wal_acel_pdl_v1_l Cbx_obd_acel_pdl_v1_l Cbx_obd_mena_acel_pdl_v1_l Cxx_dtc_lb_acel_pdl_v1_l Cxx_obd_dc_acel_pdl_v1_l Cxx_obd_us_typ_acel_pdl_v1_l Cxx_dtc_obd_acel_pdl_v2_h Cxx_conf_wal_acel_pdl_v2_h Cbx_obd_acel_pdl_v2_h Cbx_obd_mena_acel_pdl_v2_h Cxx_dtc_lb_acel_pdl_v2_h Cxx_obd_dc_acel_pdl_v2_h Cxx_obd_us_typ_acel_pdl_v2_h Cxx_dtc_obd_acel_pdl_v2_l Cxx_conf_wal_acel_pdl_v2_l Cbx_obd_acel_pdl_v2_l Cbx_obd_mena_acel_pdl_v2_l Cxx_dtc_lb_acel_pdl_v2_l Cxx_obd_dc_acel_pdl_v2_l Cxx_obd_us_typ_acel_pdl_v2_l Cxx_dtc_obd_actr_rly_oc Cxx_conf_wal_actr_rly_oc Cbx_obd_actr_rly_oc Cbx_obd_mena_actr_rly_oc Cxx_dtc_lb_actr_rly_oc Cxx_obd_dc_actr_rly_oc Cxx_obd_us_typ_actr_rly_oc Cxx_dtc_obd_actr_rly_scg Cxx_conf_wal_actr_rly_scg Cbx_obd_actr_rly_scg Cbx_obd_mena_actr_rly_scg Cxx_dtc_lb_actr_rly_scg Cxx_obd_dc_actr_rly_scg Cxx_obd_us_typ_actr_rly_scg Cxx_dtc_obd_actr_rly_scw Cxx_conf_wal_actr_rly_scw Cbx_obd_actr_rly_scw Cbx_obd_mena_actr_rly_scw Cxx_dtc_lb_actr_rly_scw Cxx_obd_dc_actr_rly_scw Cxx_obd_us_typ_actr_rly_scw Cxx_dtc_obd_agb_data_chr Cxx_conf_wal_agb_data_chr Cbx_obd_agb_data_chr Cbx_obd_mena_agb_data_chr Cxx_dtc_lb_agb_data_chr Cxx_obd_dc_agb_data_chr Cxx_obd_us_typ_agb_data_chr Cxx_dtc_obd_agb_data_seq_ctr Cxx_conf_wal_agb_data_seq_ctr Cbx_obd_agb_data_seq_ctr Cbx_obd_mena_agb_data_seq_ctr Cxx_dtc_lb_agb_data_seq_ctr Cxx_obd_dc_agb_data_seq_ctr Cxx_obd_us_typ_agb_data_seq_ctr Cxx_dtc_obd_agb_data_tout Cxx_conf_wal_agb_data_tout Cbx_obd_agb_data_tout Cbx_obd_mena_agb_data_tout Cxx_dtc_lb_agb_data_tout Cxx_obd_dc_agb_data_tout Cxx_obd_us_typ_agb_data_tout Cxx_dtc_obd_agb_no_frm Cxx_conf_wal_agb_no_frm Cbx_obd_agb_no_frm Cbx_obd_mena_agb_no_frm Cxx_dtc_lb_agb_no_frm Cxx_obd_dc_agb_no_frm Cxx_obd_us_typ_agb_no_frm Cxx_conf_wal_bgin_clu_cmp Cxx_dtc_lb_bgin_clu_cmp Cxx_obd_us_typ_bgin_clu_cmp Cxx_conf_wal_bgin_clu_nok Cxx_dtc_lb_bgin_clu_nok Cxx_obd_us_typ_bgin_clu_nok Cxx_conf_wal_brk_pdl_cmp Cxx_dtc_lb_brk_pdl_cmp Cxx_obd_us_typ_brk_pdl_cmp Cxx_dtc_obd_cata_cpt Cxx_conf_wal_cata_cpt Cbx_obd_cata_cpt Cbx_obd_mena_cata_cpt Cxx_dtc_lb_cata_cpt Cxx_obd_dc_cata_cpt Cxx_obd_us_typ_cata_cpt Cxx_dtc_obd_cl_rich_chr Cxx_conf_wal_cl_rich_chr Cbx_obd_cl_rich_chr Cbx_obd_mena_cl_rich_chr Cxx_dtc_lb_cl_rich_chr Cxx_obd_dc_cl_rich_chr Cxx_obd_us_typ_cl_rich_chr Cxx_conf_wal_clu_cnt_nok Cxx_dtc_lb_clu_cnt_nok Cxx_obd_us_typ_clu_cnt_nok Cxx_dtc_obd_cp_blk_open Cxx_conf_wal_cp_blk_open Cbx_obd_cp_blk_open Cbx_obd_mena_cp_blk_open Cxx_dtc_lb_cp_blk_open Cxx_obd_dc_cp_blk_open Cxx_obd_us_typ_cp_blk_open Cxx_dtc_obd_cp_oc Cxx_conf_wal_cp_oc Cbx_obd_cp_oc Cbx_obd_mena_cp_oc Cxx_dtc_lb_cp_oc Cxx_obd_dc_cp_oc Cxx_obd_us_typ_cp_oc Cxx_dtc_obd_cp_scg Cxx_conf_wal_cp_scg Cbx_obd_cp_scg Cbx_obd_mena_cp_scg Cxx_dtc_lb_cp_scg Cxx_obd_dc_cp_scg Cxx_obd_us_typ_cp_scg Cxx_dtc_obd_cp_scw Cxx_conf_wal_cp_scw Cbx_obd_cp_scw Cbx_obd_mena_cp_scw Cxx_dtc_lb_cp_scw Cxx_obd_dc_cp_scw Cxx_obd_us_typ_cp_scw Cxx_dtc_obd_crk_chr Cxx_conf_wal_crk_chr Cbx_obd_crk_chr Cbx_obd_mena_crk_chr Cxx_dtc_lb_crk_chr Cxx_obd_dc_crk_chr Cxx_obd_us_typ_crk_chr Cxx_dtc_obd_crk_cmp Cxx_conf_wal_crk_cmp Cbx_obd_crk_cmp Cbx_obd_mena_crk_cmp Cxx_dtc_lb_crk_cmp Cxx_obd_dc_crk_cmp Cxx_obd_us_typ_crk_cmp Cxx_dtc_obd_crk_cyc Cxx_conf_wal_crk_cyc Cbx_obd_crk_cyc Cbx_obd_mena_crk_cyc Cxx_dtc_lb_crk_cyc Cxx_obd_dc_crk_cyc Cxx_obd_us_typ_crk_cyc Cxx_dtc_obd_crk_no_sig Cxx_conf_wal_crk_no_sig Cbx_obd_crk_no_sig Cbx_obd_mena_crk_no_sig Cxx_dtc_lb_crk_no_sig Cxx_obd_dc_crk_no_sig Cxx_obd_us_typ_crk_no_sig Cxx_dtc_obd_crk_oc Cxx_conf_wal_crk_oc Cbx_obd_crk_oc Cbx_obd_mena_crk_oc Cxx_dtc_lb_crk_oc Cxx_obd_dc_crk_oc Cxx_obd_us_typ_crk_oc Cxx_dtc_obd_crk_shp Cxx_conf_wal_crk_shp Cbx_obd_crk_shp Cbx_obd_mena_crk_shp Cxx_dtc_lb_crk_shp Cxx_obd_dc_crk_shp Cxx_obd_us_typ_crk_shp Cxx_conf_wal_cru_cmp Cxx_dtc_lb_cru_cmp Cxx_obd_us_typ_cru_cmp Cxx_conf_wal_cru_sl_swi_chr Cxx_dtc_lb_cru_sl_swi_chr Cxx_obd_us_typ_cru_sl_swi_chr Cxx_conf_wal_cru_sl_tot Cxx_dtc_lb_cru_sl_tot Cxx_obd_us_typ_cru_sl_tot Cxx_conf_wal_cru_vs_cmp Cxx_dtc_lb_cru_vs_cmp Cxx_obd_us_typ_cru_vs_cmp Cxx_conf_wal_cru_whl_cmd_nok Cxx_dtc_lb_cru_whl_cmd_nok Cxx_obd_us_typ_cru_whl_cmd_nok Cxx_conf_wal_cru_whl_cmd_oc_scw Cxx_dtc_lb_cru_whl_cmd_oc_scw Cxx_obd_us_typ_cru_whl_cmd_oc_scw Cxx_conf_wal_cru_whl_cmd_oor Cxx_dtc_lb_cru_whl_cmd_oor Cxx_obd_us_typ_cru_whl_cmd_oor Cxx_dtc_obd_ecm_adc_tron Cxx_conf_wal_ecm_adc_tron Cbx_obd_ecm_adc_tron Cbx_obd_mena_ecm_adc_tron Cxx_dtc_lb_ecm_adc_tron Cxx_obd_dc_ecm_adc_tron Cxx_obd_us_typ_ecm_adc_tron Cxx_dtc_obd_ecm_err_itl Cxx_conf_wal_ecm_err_itl Cbx_obd_ecm_err_itl Cbx_obd_mena_ecm_err_itl Cxx_dtc_lb_ecm_err_itl Cxx_obd_dc_ecm_err_itl Cxx_obd_us_typ_ecm_err_itl Cxx_dtc_obd_ecm_mon_secu_1 Cxx_conf_wal_ecm_mon_secu_1 Cbx_obd_ecm_mon_secu_1 Cbx_obd_mena_ecm_mon_secu_1 Cxx_dtc_lb_ecm_mon_secu_1 Cxx_obd_dc_ecm_mon_secu_1 Cxx_obd_us_typ_ecm_mon_secu_1 Cxx_dtc_obd_ecm_mon_secu_2 Cxx_conf_wal_ecm_mon_secu_2 Cbx_obd_ecm_mon_secu_2 Cbx_obd_mena_ecm_mon_secu_2 Cxx_dtc_lb_ecm_mon_secu_2 Cxx_obd_dc_ecm_mon_secu_2 Cxx_obd_us_typ_ecm_mon_secu_2 Cxx_dtc_obd_ecm_mon_tron Cxx_conf_wal_ecm_mon_tron Cbx_obd_ecm_mon_tron Cbx_obd_mena_ecm_mon_tron Cxx_dtc_lb_ecm_mon_tron Cxx_obd_dc_ecm_mon_tron Cxx_obd_us_typ_ecm_mon_tron Cxx_dtc_obd_efi_sldv_2_oc Cxx_conf_wal_efi_sldv_2_oc Cbx_obd_efi_sldv_2_oc Cbx_obd_mena_efi_sldv_2_oc Cxx_dtc_lb_efi_sldv_2_oc Cxx_obd_dc_efi_sldv_2_oc Cxx_obd_us_typ_efi_sldv_2_oc Cxx_dtc_obd_efi_sldv_2_scg Cxx_conf_wal_efi_sldv_2_scg Cbx_obd_efi_sldv_2_scg Cbx_obd_mena_efi_sldv_2_scg Cxx_dtc_lb_efi_sldv_2_scg Cxx_obd_dc_efi_sldv_2_scg Cxx_obd_us_typ_efi_sldv_2_scg Cxx_dtc_obd_efi_sldv_2_scw Cxx_conf_wal_efi_sldv_2_scw Cbx_obd_efi_sldv_2_scw Cbx_obd_mena_efi_sldv_2_scw Cxx_dtc_lb_efi_sldv_2_scw Cxx_obd_dc_efi_sldv_2_scw Cxx_obd_us_typ_efi_sldv_2_scw Cxx_conf_wal_esp_data_chr Cxx_dtc_lb_esp_data_chr Cxx_obd_us_typ_esp_data_chr Cxx_conf_wal_esp_data_seq_ctr Cxx_dtc_lb_esp_data_seq_ctr Cxx_obd_us_typ_esp_data_seq_ctr Cxx_conf_wal_esp_no_frm Cxx_dtc_lb_esp_no_frm Cxx_obd_us_typ_esp_no_frm Cxx_dtc_obd_eva_fcap_abn_cple Cxx_conf_wal_eva_fcap_abn_cple Cbx_obd_eva_fcap_abn_cple Cbx_obd_mena_eva_fcap_abn_cple Cxx_dtc_lb_eva_fcap_abn_cple Cxx_obd_dc_eva_fcap_abn_cple Cxx_obd_us_typ_eva_fcap_abn_cple Cxx_dtc_obd_eva_fcap_no_lk Cxx_conf_wal_eva_fcap_no_lk Cbx_obd_eva_fcap_no_lk Cbx_obd_mena_eva_fcap_no_lk Cxx_dtc_lb_eva_fcap_no_lk Cxx_obd_dc_eva_fcap_no_lk Cxx_obd_us_typ_eva_fcap_no_lk Cxx_dtc_obd_eva_sldv_blk_clos Cxx_conf_wal_eva_sldv_blk_clos Cbx_obd_eva_sldv_blk_clos Cbx_obd_mena_eva_sldv_blk_clos Cxx_dtc_lb_eva_sldv_blk_clos Cxx_obd_dc_eva_sldv_blk_clos Cxx_obd_us_typ_eva_sldv_blk_clos Cxx_dtc_obd_eva_sldv_oc Cxx_conf_wal_eva_sldv_oc Cbx_obd_eva_sldv_oc Cbx_obd_mena_eva_sldv_oc Cxx_dtc_lb_eva_sldv_oc Cxx_obd_dc_eva_sldv_oc Cxx_obd_us_typ_eva_sldv_oc Cxx_dtc_obd_eva_sldv_scg Cxx_conf_wal_eva_sldv_scg Cbx_obd_eva_sldv_scg Cbx_obd_mena_eva_sldv_scg Cxx_dtc_lb_eva_sldv_scg Cxx_obd_dc_eva_sldv_scg Cxx_obd_us_typ_eva_sldv_scg Cxx_dtc_obd_eva_sldv_scw Cxx_conf_wal_eva_sldv_scw Cbx_obd_eva_sldv_scw Cbx_obd_mena_eva_sldv_scw Cxx_dtc_lb_eva_sldv_scw Cxx_obd_dc_eva_sldv_scw Cxx_obd_us_typ_eva_sldv_scw Cxx_dtc_obd_evap_chr Cxx_conf_wal_evap_chr Cbx_obd_evap_chr Cbx_obd_mena_evap_chr Cxx_dtc_lb_evap_chr Cxx_obd_dc_evap_chr Cxx_obd_us_typ_evap_chr Cxx_dtc_obd_evap_lkg Cxx_conf_wal_evap_lkg Cbx_obd_evap_lkg Cbx_obd_mena_evap_lkg Cxx_dtc_lb_evap_lkg Cxx_obd_dc_evap_lkg Cxx_obd_us_typ_evap_lkg Cxx_dtc_obd_fsys_cpt Cxx_conf_wal_fsys_cpt Cbx_obd_fsys_cpt Cbx_obd_mena_fsys_cpt Cxx_dtc_lb_fsys_cpt Cxx_obd_dc_fsys_cpt Cxx_obd_us_typ_fsys_cpt Cxx_dtc_obd_gas_pump_2_oc Cxx_conf_wal_gas_pump_2_oc Cbx_obd_gas_pump_2_oc Cbx_obd_mena_gas_pump_2_oc Cxx_dtc_lb_gas_pump_2_oc Cxx_obd_dc_gas_pump_2_oc Cxx_obd_us_typ_gas_pump_2_oc Cxx_dtc_obd_gas_pump_2_scg Cxx_conf_wal_gas_pump_2_scg Cbx_obd_gas_pump_2_scg Cbx_obd_mena_gas_pump_2_scg Cxx_dtc_lb_gas_pump_2_scg Cxx_obd_dc_gas_pump_2_scg Cxx_obd_us_typ_gas_pump_2_scg Cxx_dtc_obd_gas_pump_2_scw Cxx_conf_wal_gas_pump_2_scw Cbx_obd_gas_pump_2_scw Cbx_obd_mena_gas_pump_2_scw Cxx_dtc_lb_gas_pump_2_scw Cxx_obd_dc_gas_pump_2_scw Cxx_obd_us_typ_gas_pump_2_scw Cxx_dtc_obd_gas_pump_oc Cxx_conf_wal_gas_pump_oc Cbx_obd_gas_pump_oc Cbx_obd_mena_gas_pump_oc Cxx_dtc_lb_gas_pump_oc Cxx_obd_dc_gas_pump_oc Cxx_obd_us_typ_gas_pump_oc Cxx_dtc_obd_gas_pump_scg Cxx_conf_wal_gas_pump_scg Cbx_obd_gas_pump_scg Cbx_obd_mena_gas_pump_scg Cxx_dtc_lb_gas_pump_scg Cxx_obd_dc_gas_pump_scg Cxx_obd_us_typ_gas_pump_scg Cxx_dtc_obd_gas_pump_scw Cxx_conf_wal_gas_pump_scw Cbx_obd_gas_pump_scw Cbx_obd_mena_gas_pump_scw Cxx_dtc_lb_gas_pump_scw Cxx_obd_dc_gas_pump_scw Cxx_obd_us_typ_gas_pump_scw Cxx_dtc_obd_igc_1_oc Cxx_conf_wal_igc_1_oc Cbx_obd_igc_1_oc Cbx_obd_mena_igc_1_oc Cxx_dtc_lb_igc_1_oc Cxx_obd_dc_igc_1_oc Cxx_obd_us_typ_igc_1_oc Cxx_dtc_obd_igc_1_scg Cxx_conf_wal_igc_1_scg Cbx_obd_igc_1_scg Cbx_obd_mena_igc_1_scg Cxx_dtc_lb_igc_1_scg Cxx_obd_dc_igc_1_scg Cxx_obd_us_typ_igc_1_scg Cxx_dtc_obd_igc_1_scw Cxx_conf_wal_igc_1_scw Cbx_obd_igc_1_scw Cbx_obd_mena_igc_1_scw Cxx_dtc_lb_igc_1_scw Cxx_obd_dc_igc_1_scw Cxx_obd_us_typ_igc_1_scw Cxx_dtc_obd_igc_2_oc Cxx_conf_wal_igc_2_oc Cbx_obd_igc_2_oc Cbx_obd_mena_igc_2_oc Cxx_dtc_lb_igc_2_oc Cxx_obd_dc_igc_2_oc Cxx_obd_us_typ_igc_2_oc /end DEF_CHARACTERISTIC
/end FUNCTION
/end MODULE
/end PROJECT
