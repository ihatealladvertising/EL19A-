ASAP2_VERSION 1 41
/begin PROJECT RD8 "_default_ProjectLongIdentifier"
/begin HEADER "_default_HeaderComment" PROJECT_NO RD9 /end HEADER
/begin MODULE _default_ModuleName "_default_ModuleLongIdentifier"
/begin MOD_COMMON "_default_ModCommonComment" DEPOSIT ABSOLUTE BYTE_ORDER MSB_LAST ALIGNMENT_BYTE 1 ALIGNMENT_WORD 2 ALIGNMENT_LONG 2 ALIGNMENT_FLOAT32_IEEE 2 ALIGNMENT_FLOAT64_IEEE 4 /end MOD_COMMON
/begin MEASUREMENT Vbx_n_rams_lim_spc_act_1 "Specific activation of safety engine speed limitation level 1" UBYTE _CNV_S_2_RANGE______3_CM 1 0. 0. 1. ECU_ADDRESS 0xd0007cb1 BIT_MASK 0x1 /end MEASUREMENT
/begin MEASUREMENT Vbx_n_rams_lim_spc_act_2 "Specific activation of safety engine speed limitation level 2" UBYTE _CNV_S_2_RANGE______3_CM 1 0. 0. 1. ECU_ADDRESS 0xd0007cb2 BIT_MASK 0x1 /end MEASUREMENT
/begin MEASUREMENT Vsx_agb_coup "Automatic gearbox coupler state" UBYTE _CNV_A_R_ECME_LINEA_0_CM 1 0. 0. 255. ECU_ADDRESS 0xd0006c24 FORMAT "%3.0" /end MEASUREMENT
/begin MEASUREMENT Vsx_agb_coup_vld "Automatic gearbox coupler state validity status" UBYTE _CNV_A_R_ECME_LINEA_0_CM 1 0. 0. 255. ECU_ADDRESS 0xd0006c25 FORMAT "%3.0" /end MEASUREMENT
/begin MEASUREMENT Vsx_rgb_coup "Robotized gearbox coupler state" UBYTE _CNV_A_R_ECME_LINEA_0_CM 1 0. 0. 255. ECU_ADDRESS 0xd0006c26 FORMAT "%3.0" /end MEASUREMENT
/begin MEASUREMENT Vsx_rgb_coup_vld "Robotized gearbox coupler state validity status" UBYTE _CNV_A_R_ECME_LINEA_0_CM 1 0. 0. 255. ECU_ADDRESS 0xd0006c27 FORMAT "%3.0" /end MEASUREMENT
/begin MEASUREMENT Vbx_drag_red_agb "Drag reduction mode" UBYTE _CNV_S_2_RANGE______3_CM 1 0. 0. 1. ECU_ADDRESS 0xd0006c28 BIT_MASK 0x1 /end MEASUREMENT
/begin MEASUREMENT Vbx_egb_neut "Electronic GearBox is in a configuration equivalent to Neutral for a manual gearbox." UBYTE _CNV_S_2_RANGE______3_CM 1 0. 0. 1. ECU_ADDRESS 0xd0006c29 BIT_MASK 0x1 /end MEASUREMENT
/begin MEASUREMENT Vsx_agb_vld "Automatic GearBox validity status" UBYTE _CNV_A_R_ECME_LINEA_0_CM 1 0. 0. 2. ECU_ADDRESS 0xd0006c2a FORMAT "%1.0" /end MEASUREMENT
/begin MEASUREMENT Vsx_drag_red_agb_vld "Drag reduction mode validity status" UBYTE _CNV_A_R_ECME_LINEA_0_CM 1 0. 0. 2. ECU_ADDRESS 0xd0006c2b FORMAT "%1.0" /end MEASUREMENT
/begin MEASUREMENT Vsx_egb_neut_vld "Electronic GearBox in a configuration equivalent to Neutral for a manual gearbox validity status" UBYTE _CNV_A_R_ECME_LINEA_0_CM 1 0. 0. 2. ECU_ADDRESS 0xd0006c2c FORMAT "%1.0" /end MEASUREMENT
/begin MEASUREMENT Vsx_raw_egb_ant_gear "Target raw gear due to electronic gearbox" UBYTE _CNV_A_R_LINEAR_____145_CM 1 0. -1. 15. ECU_ADDRESS 0xd0006c2d FORMAT "%3.0" /end MEASUREMENT
/begin MEASUREMENT Vsx_raw_egb_ant_gear_vld "Target raw gear due to electronic gearbox validity status" UBYTE _CNV_A_R_ECME_LINEA_0_CM 1 0. 0. 2. ECU_ADDRESS 0xd0006c2e FORMAT "%1.0" /end MEASUREMENT
/begin MEASUREMENT Vsx_raw_egb_gear "Current raw gear due to electronic gearbox" UBYTE _CNV_A_R_LINEAR_____145_CM 1 0. -1. 15. ECU_ADDRESS 0xd0006c2f FORMAT "%3.0" /end MEASUREMENT
/begin MEASUREMENT Vsx_raw_egb_gear_vld "Current raw gear due to electronic gearbox validity status" UBYTE _CNV_A_R_ECME_LINEA_0_CM 1 0. 0. 2. ECU_ADDRESS 0xd0006c30 FORMAT "%1.0" /end MEASUREMENT
/begin MEASUREMENT Vbx_bgin_clu_cnt_ena "Begin stroke sensor is functional" UBYTE _CNV_S_2_RANGE______3_CM 1 0. 0. 1. ECU_ADDRESS 0xd0006c6b BIT_MASK 0x1 /end MEASUREMENT
/begin MEASUREMENT Vbx_bgin_clu_cnt_on "Begin stroke sensor is activated" UBYTE _CNV_S_2_RANGE______3_CM 1 0. 0. 1. ECU_ADDRESS 0xd0006c6c BIT_MASK 0x1 /end MEASUREMENT
/begin MEASUREMENT Vbx_end_clu_cnt_on "End stroke sensor is activated" UBYTE _CNV_S_2_RANGE______3_CM 1 0. 0. 1. ECU_ADDRESS 0xd0006c6d BIT_MASK 0x1 /end MEASUREMENT
/begin CHARACTERISTIC Cxx_dfdec_clu_cnt_nok "a_in_pci_dls_seclcxx/Clutch contactors detected failure counter decrement" VALUE 0xa00215ea _REC_S1VAL_20_u2 65535. _CNV_A_R_ECME_LINEA_0_CM 0. 65535. FORMAT "%5.0" /end CHARACTERISTIC
/begin CHARACTERISTIC Cxx_dfinc_clu_cnt_nok "a_in_pci_dls_seclcxx/Clutch contactors detected failure counter increment" VALUE 0xa00215ec _REC_S1VAL_20_u2 65535. _CNV_A_R_ECME_LINEA_0_CM 0. 65535. FORMAT "%5.0" /end CHARACTERISTIC
/begin CHARACTERISTIC Cxx_dly_chr_bgin_end_clu_cnt "Delay to enable the coherency diag due to the different contactors information time refresh" VALUE 0xa00215ee _REC_S1VAL_20_u1 2.55 _CNV_A_R_LINEAR_____32_CM 0. 2.55 FORMAT "%4.2" /end CHARACTERISTIC
/begin MEASUREMENT Vsx_egb_ant_coup "Anticipated (forecast) transmission coupler state for automatic transmission" UBYTE _CNV_A_R_ECME_LINEA_0_CM 1 0. 0. 255. ECU_ADDRESS 0xd0006c7b FORMAT "%3.0" /end MEASUREMENT
/begin MEASUREMENT Vsx_egb_ant_coup_vld "Anticipated transmission coupler state for automatic transmission validity status" UBYTE _CNV_A_R_ECME_LINEA_0_CM 1 0. 0. 2. ECU_ADDRESS 0xd0006c7c FORMAT "%1.0" /end MEASUREMENT
/begin MEASUREMENT Vsx_egb_ant_gear "Target gear due to electronic gearbox" UBYTE _CNV_A_R_LINEAR_____145_CM 1 0. -1. 6. ECU_ADDRESS 0xd0006c7d FORMAT "%2.0" /end MEASUREMENT
/begin MEASUREMENT Vsx_egb_ant_gear_vld "Target gear due to electronic gearbox validity status" UBYTE _CNV_A_R_ECME_LINEA_0_CM 1 0. 0. 2. ECU_ADDRESS 0xd0006c7e FORMAT "%1.0" /end MEASUREMENT
/begin MEASUREMENT Vsx_egb_coup "Automatic Transmission coupler state" UBYTE _CNV_A_R_ECME_LINEA_0_CM 1 0. 0. 255. ECU_ADDRESS 0xd0006c7f FORMAT "%3.0" /end MEASUREMENT
/begin MEASUREMENT Vsx_egb_coup_vld "Automatic Transmission coupler state validity status" UBYTE _CNV_A_R_ECME_LINEA_0_CM 1 0. 0. 2. ECU_ADDRESS 0xd0006c80 FORMAT "%1.0" /end MEASUREMENT
/begin MEASUREMENT Vsx_egb_gear "Current gear due to electronic gearbox" UBYTE _CNV_A_R_LINEAR_____145_CM 1 0. -1. 6. ECU_ADDRESS 0xd0006c81 FORMAT "%2.0" /end MEASUREMENT
/begin MEASUREMENT Vsx_egb_gear_vld "Current gear due to electronic gearbox validity status" UBYTE _CNV_A_R_ECME_LINEA_0_CM 1 0. 0. 2. ECU_ADDRESS 0xd0006c82 FORMAT "%1.0" /end MEASUREMENT
/begin CHARACTERISTIC Csx_lih_egb_gear "Calibration value for the gear engaged when egb is in safety mode" VALUE 0xa00215ef _REC_S1VAL_20_u1 7. _CNV_A_R_LINEAR_____145_CM -1. 6. FORMAT "%2.0" /end CHARACTERISTIC
/begin CHARACTERISTIC Cxx_dly_coup_fail "Delay to detect a problem on the coupler frame on CAN" VALUE 0xa00215f0 _REC_S1VAL_20_u1 2.55 _CNV_A_R_LINEAR_____32_CM 0. 2.55 FORMAT "%4.2" /end CHARACTERISTIC
/begin CHARACTERISTIC Cxx_dly_gear_fail "Delay to detect a problem on the gear frame on CAN" VALUE 0xa00215f1 _REC_S1VAL_20_u1 2.55 _CNV_A_R_LINEAR_____32_CM 0. 2.55 FORMAT "%4.2" /end CHARACTERISTIC
/begin MEASUREMENT Vbx_bgin_clu_pdl_on "Begin stroke robustified information is 'pedal pressed'" UBYTE _CNV_S_2_RANGE______3_CM 1 0. 0. 1. ECU_ADDRESS 0xd0006c97 BIT_MASK 0x1 /end MEASUREMENT
/begin MEASUREMENT Vbx_gear_stab "Ratio is stabilised" UBYTE _CNV_S_2_RANGE______3_CM 1 0. 0. 1. ECU_ADDRESS 0xd0006c98 BIT_MASK 0x1 /end MEASUREMENT
/begin MEASUREMENT Vbx_neut_gear_act "Neutral gear detected with clutch contactors and software contactor" UBYTE _CNV_S_2_RANGE______3_CM 1 0. 0. 1. ECU_ADDRESS 0xd0006c99 BIT_MASK 0x1 /end MEASUREMENT
/begin MEASUREMENT Vbx_neut_psn "Neutral position is detected with gearbox contactor" UBYTE _CNV_S_2_RANGE______3_CM 1 0. 0. 1. ECU_ADDRESS 0xd0006c9a BIT_MASK 0x1 /end MEASUREMENT
/begin MEASUREMENT Vbx_ovn_ant_coup "" UBYTE _CNV_S_2_RANGE______3_CM 1 0. 0. 1. ECU_ADDRESS 0xd0006c9b BIT_MASK 0x1 /end MEASUREMENT
/begin MEASUREMENT Vbx_pdl_use_rtn "Inform the driver retains its foot on pedal" UBYTE _CNV_S_2_RANGE______3_CM 1 0. 0. 1. ECU_ADDRESS 0xd0006c9c BIT_MASK 0x1 /end MEASUREMENT
/begin MEASUREMENT Vsx_bgin_clu_nok_mgb_ant_coup "Anticipated coupler state calculated when begin clutch contactor is defective" UBYTE _CNV_S_3_RANGE_STAT_451_CM 1 0. 1. 8. ECU_ADDRESS 0xd0006c9d /end MEASUREMENT
/begin MEASUREMENT Vsx_bgin_clu_nok_mgb_coup "Coupler state calculated when begin clutch contactor is defective" UBYTE _CNV_S_3_RANGE_STAT_451_CM 1 0. 1. 8. ECU_ADDRESS 0xd0006c9e /end MEASUREMENT
/begin MEASUREMENT Vsx_bgin_clu_nok_mgb_coup_vld "Coupler state calculated when begin clutch contactor is defective validity status" UBYTE _CNV_S_3_STATUS_OK__213_CM 1 0. 0. 2. ECU_ADDRESS 0xd0006c9f /end MEASUREMENT
/begin MEASUREMENT Vsx_bgin_clu_ok_mgb_ant_coup "Anticipated coupler state calculated when begin clutch contactor is functional" UBYTE _CNV_S_3_RANGE_STAT_451_CM 1 0. 1. 8. ECU_ADDRESS 0xd0006ca0 /end MEASUREMENT
/begin MEASUREMENT Vsx_bgin_clu_ok_mgb_coup "Coupler state calculated when begin clutch contactor is functional" UBYTE _CNV_S_3_RANGE_STAT_451_CM 1 0. 1. 8. ECU_ADDRESS 0xd0006ca1 /end MEASUREMENT
/begin MEASUREMENT Vsx_bgin_clu_ok_mgb_coup_vld "Coupler state calculated when begin clutch contactor is functional validity status" UBYTE _CNV_S_3_STATUS_OK__213_CM 1 0. 0. 2. ECU_ADDRESS 0xd0006ca2 /end MEASUREMENT
/begin MEASUREMENT Vsx_mgb_ant_coup "Manual transmission anticipated coupler state (faster opening and closing detection / Vxx_coup)" UBYTE _CNV_A_R_ECME_LINEA_0_CM 1 0. 0. 255. ECU_ADDRESS 0xd0006ca3 FORMAT "%3.0" /end MEASUREMENT
/begin MEASUREMENT Vsx_mgb_ant_gear "Anticipated gear engaged due to manual gearbox" UBYTE _CNV_A_R_LINEAR_____145_CM 1 0. -1. 6. ECU_ADDRESS 0xd0006ca4 FORMAT "%2.0" /end MEASUREMENT
/begin MEASUREMENT Vsx_mgb_coup "Manual transmission coupler state" UBYTE _CNV_A_R_ECME_LINEA_0_CM 1 0. 0. 255. ECU_ADDRESS 0xd0006ca5 FORMAT "%3.0" /end MEASUREMENT
/begin MEASUREMENT Vsx_mgb_coup_vld "Manual transmission coupler state validity status" UBYTE _CNV_A_R_ECME_LINEA_0_CM 1 0. 0. 2. ECU_ADDRESS 0xd0006ca6 FORMAT "%1.0" /end MEASUREMENT
/begin MEASUREMENT Vsx_mgb_gear "Gear engaged due to manual gearbox" UBYTE _CNV_A_R_LINEAR_____145_CM 1 0. -1. 6. ECU_ADDRESS 0xd0006ca7 FORMAT "%2.0" /end MEASUREMENT
/begin MEASUREMENT Vsx_mgb_gear_vld "Gear engaged due to manual gearbox validity status" UBYTE _CNV_A_R_ECME_LINEA_0_CM 1 0. 0. 2. ECU_ADDRESS 0xd0006ca8 FORMAT "%1.0" /end MEASUREMENT
/begin MEASUREMENT Vsx_rat_gear_stab "Stabilized ratio Gear:gearbox gear identified with thin true range of the ratio Vspeed/Neng and the stability of the ratio." UBYTE _CNV_A_R_LINEAR_____145_CM 1 0. -1. 6. ECU_ADDRESS 0xd0006ca9 FORMAT "%2.0" /end MEASUREMENT
/begin CHARACTERISTIC Cbx_ant_coup_clos_clc_cfm "Determination of an anticipate coupler state when the coupler is closing" VALUE 0xa00215fe _REC_S1VAL_20_u1 1. _CNV_A_R_ECME_LINEA_0_CM 0. 1. FORMAT "%1.0" BIT_MASK 0x1 /end CHARACTERISTIC
/begin CHARACTERISTIC Cbx_bgin_clu_fail_cfm "Choice of degraded calculation of clutch state" VALUE 0xa00215ff _REC_S1VAL_20_u1 1. _CNV_A_R_ECME_LINEA_0_CM 0. 1. FORMAT "%1.0" BIT_MASK 0x1 /end CHARACTERISTIC
/begin CHARACTERISTIC Cbx_ovn_n_clu_det_cfm "Choice of enabling calculation strategy" VALUE 0xa0021600 _REC_S1VAL_20_u1 1. _CNV_A_R_ECME_LINEA_0_CM 0. 1. FORMAT "%1.0" BIT_MASK 0x1 /end CHARACTERISTIC
/begin CHARACTERISTIC Cxx_dly_clu_pdl_use_rtn "Delay before stating that the driver retain his foot on clutch pedal and stop declutching" VALUE 0xa0021601 _REC_S1VAL_20_u1 2.55 _CNV_A_R_LINEAR_____32_CM 0. 2.55 FORMAT "%4.2" /end CHARACTERISTIC
/begin CHARACTERISTIC Cxx_dly_neut_gear_act "Delay before stating that the driver has engeged the neutral gear and the vehicle is running" VALUE 0xa00215f2 _REC_S1VAL_20_u2 65.535 _CNV_A_R_LINEAR_____116_CM 0. 65.535 /end CHARACTERISTIC
/begin CHARACTERISTIC Cxx_dly_neut_gear_cnt "Delay before stating that neutral gear is engaged, taken from neutral gear contactor." VALUE 0xa00215f4 _REC_S1VAL_20_u2 65.535 _CNV_A_R_LINEAR_____116_CM 0. 65.535 /end CHARACTERISTIC
/begin CHARACTERISTIC Cxx_dly_pdl_rls "Delay before stating that the vehicle is declutched when the begin contactor was activated without a gear change" VALUE 0xa0021602 _REC_S1VAL_20_u1 2.55 _CNV_A_R_LINEAR_____32_CM 0. 2.55 FORMAT "%4.2" /end CHARACTERISTIC
/begin CHARACTERISTIC Cxx_ovn_n_clu_det_dly "Maximum time delay to detects the engine speed overshoot on an accelerator pedal release (driver tip-out)" VALUE 0xa00215f6 _REC_S1VAL_20_u2 655.35 _CNV_A_R_LINEAR_____32_CM 0. 655.35 FORMAT "%6.2" /end CHARACTERISTIC
/begin CHARACTERISTIC Cxx_ovn_n_clu_det_thd "Engine speed threshold autorization strategy calculation" VALUE 0xa00215f8 _REC_S1VAL_20_u2 16383.75 _CNV_A_R_ENSD_LINEA_22_CM 0. 16383.75 FORMAT "%8.2" /end CHARACTERISTIC
/begin CHARACTERISTIC Cxx_ovn_n_dif_clu_det_thd "Engine speed overshoot threshold" VALUE 0xa00215fa _REC_S1VAL_20_u2 16383.75 _CNV_A_R_ENSD_LINEA_22_CM 0. 16383.75 FORMAT "%8.2" /end CHARACTERISTIC
/begin CHARACTERISTIC Cxx_rat_gear_stab_dly "Delay to identify the ratio stability" VALUE 0xa00215fc _REC_S1VAL_20_u2 65.535 _CNV_A_R_LINEAR_____116_CM 0. 65.535 /end CHARACTERISTIC
/begin CHARACTERISTIC Cxx_vs_vh_max "Maximum vehicle speed to enable the detection of a foot on clutch pedal" VALUE 0xa0021603 _REC_S1VAL_20_u1 255. _CNV_A_R_LINEAR_____71_CM 0. 255. FORMAT "%3.0" /end CHARACTERISTIC
/begin CHARACTERISTIC Cxx_vs_vh_min "Minimum vehicle speed to enable the detection of a foot on clutch pedal" VALUE 0xa0021604 _REC_S1VAL_20_u1 255. _CNV_A_R_LINEAR_____71_CM 0. 255. FORMAT "%3.0" /end CHARACTERISTIC
/begin MEASUREMENT Emul "Bit indicating that ECU works in emulated mode" UBYTE _CNV_S_2_RANGE______3_CM 1 0. 0. 1. DISPLAY_IDENTIFIER Vbx_supl_emul_ecm ECU_ADDRESS 0xd0001377 BIT_MASK 0x1 /end MEASUREMENT
/begin MEASUREMENT Vsx_bgin_str_clu_cnt "Begin stroke clutch pedal switch" UBYTE _CNV_A_R_ECME_LINEA_0_CM 1 0. 0. 255. ECU_ADDRESS 0xd0006c31 FORMAT "%3.0" /end MEASUREMENT
/begin MEASUREMENT Vsx_bgin_str_clu_cru "Begin stroke clutch pedal switch for cruise control" UBYTE _CNV_A_R_ECME_LINEA_0_CM 1 0. 0. 255. ECU_ADDRESS 0xd0006c32 FORMAT "%3.0" /end MEASUREMENT
/begin MEASUREMENT Vsx_bgin_str_clu_cru_rams "Begin stroke clutch pedal switch for cruise control safety" UBYTE _CNV_A_R_ECME_LINEA_0_CM 1 0. 0. 255. ECU_ADDRESS 0xd0006c33 FORMAT "%3.0" /end MEASUREMENT
/begin MEASUREMENT Vsx_bgin_str_clu_cru_vld "Begin stroke clutch pedal switch for cruise control validity status" UBYTE _CNV_A_R_ECME_LINEA_0_CM 1 0. 0. 255. ECU_ADDRESS 0xd0006c34 FORMAT "%3.0" /end MEASUREMENT
/begin CHARACTERISTIC Cbx_mux_clu_cnt_cfm "Choise using CAN data of begin clutch contactor" VALUE 0xa00215a7 _REC_S1VAL_20_u1 1. _CNV_S_2_RANGE______3_CM 0. 1. BIT_MASK 0x1 /end CHARACTERISTIC
/begin MEASUREMENT Vsx_mux_bgin_clu_cnt "Begin stroke clutch pedal switch (from a CAN parameter)" UBYTE _CNV_S_3_CNT_INDICA_450_CM 1 0. 0. 2. ECU_ADDRESS 0xd0006c43 /end MEASUREMENT
/begin MEASUREMENT Vsx_mux_bgin_clu_cnt_vld "Begin stroke clutch pedal switch (from CAN parameter) validity status" UBYTE _CNV_S_4_STATUS_OK__180_CM 1 0. 0. 3. ECU_ADDRESS 0xd0006c44 /end MEASUREMENT
/begin MEASUREMENT Vsx_sens_bgin_clu_cnt "Wire begin clutch contactor state" UBYTE _CNV_A_R_ECME_LINEA_0_CM 1 0. 0. 255. ECU_ADDRESS 0xd0006c45 FORMAT "%3.0" /end MEASUREMENT
/begin MEASUREMENT Vsx_sens_bgin_clu_cnt_vld "Wire begin clutch contactor state validity status" UBYTE _CNV_S_3_STATUS_OK__179_CM 1 0. 0. 2. ECU_ADDRESS 0xd0006c46 /end MEASUREMENT
/begin CHARACTERISTIC Cxx_sens_clu_lk_vb_dly "Filter time to enable the begin clutch contactor connection detection" VALUE 0xa00215b8 _REC_S1VAL_20_u1 25.5 _CNV_A_R_LINEAR_____58_CM 0. 25.5 FORMAT "%4.1" /end CHARACTERISTIC
/begin CHARACTERISTIC Cxx_sens_clu_lk_vb_thd "Minimum battery voltage to enable the begin cluch contactor connection detection" VALUE 0xa00215b6 _REC_S1VAL_20_u2 25000. _CNV_A_R_LINEAR_____107_CM 0. 25000. FORMAT "%5.0" /end CHARACTERISTIC
/begin MEASUREMENT Vbx_ant_gear_shf "Rising shift identification" UBYTE _CNV_S_2_RANGE______3_CM 1 0. 0. 1. ECU_ADDRESS 0xd0006c3e BIT_MASK 0x1 /end MEASUREMENT
/begin MEASUREMENT Vbx_bgin_clu_off_nok "Incoherency confirmed when the begin clutch contactor is always OFF" UBYTE _CNV_S_2_RANGE______3_CM 1 0. 0. 1. ECU_ADDRESS 0xd0006c3f BIT_MASK 0x1 /end MEASUREMENT
/begin MEASUREMENT Vbx_bgin_clu_on_nok "Incoherency confirmed when the begin clutch contactor is always ON" UBYTE _CNV_S_2_RANGE______3_CM 1 0. 0. 1. ECU_ADDRESS 0xd0006c40 BIT_MASK 0x1 /end MEASUREMENT
/begin MEASUREMENT Vbx_df_bgin_clu_nok "Wire begin clutch contactor detected failure" UBYTE _CNV_S_2_RANGE______3_CM 1 0. 0. 1. ECU_ADDRESS 0xd0006c41 BIT_MASK 0x1 /end MEASUREMENT
/begin MEASUREMENT Vbx_raw_bgin_clu_off_no_chr "Incohernecy detected when the begin clutch contactor is always OFF" UBYTE _CNV_S_2_RANGE______3_CM 1 0. 0. 1. ECU_ADDRESS 0xd0006c42 BIT_MASK 0x1 /end MEASUREMENT
/begin MEASUREMENT Vxx_ant_gear_2 "Anticipated gear engaged high precision" SWORD _CNV_A_R_LINEAR_____123_CM 1 0. -1. 6. ECU_ADDRESS 0xd000439e FORMAT "%6.2" /end MEASUREMENT
/begin MEASUREMENT Vxx_ant_gear_mem "Last lower gear high precision" SWORD _CNV_A_R_LINEAR_____123_CM 1 0. -1. 6. ECU_ADDRESS 0xd00043a0 FORMAT "%6.2" /end MEASUREMENT
/begin CHARACTERISTIC Cbx_bgin_clu_off_dg_cfm "Diag contactor always off activation" VALUE 0xa00215b0 _REC_S1VAL_20_u1 1. _CNV_A_R_ECME_LINEA_0_CM 0. 1. FORMAT "%1.0" BIT_MASK 0x1 /end CHARACTERISTIC
/begin CHARACTERISTIC Cbx_bgin_clu_on_dg_cfm "Diag contactor always on activation" VALUE 0xa00215b1 _REC_S1VAL_20_u1 1. _CNV_A_R_ECME_LINEA_0_CM 0. 1. FORMAT "%1.0" BIT_MASK 0x1 /end CHARACTERISTIC
/begin CHARACTERISTIC Cxx_ant_gear_dif_thd "Threshold for the rising shift detection" VALUE 0xa00215a8 _REC_S1VAL_20_s2 14. _CNV_A_R_LINEAR_____123_CM -7. 7. FORMAT "%6.2" /end CHARACTERISTIC
/begin CHARACTERISTIC Cxx_ant_gear_fil "Time constant value for the the gear shift filter" VALUE 0xa00215b2 _REC_S1VAL_20_u1 25.5 _CNV_A_R_LINEAR_____58_CM 0. 25.5 FORMAT "%4.1" /end CHARACTERISTIC
/begin CHARACTERISTIC Cxx_bgin_clu_dg_act_vs_min "Minimal vehicle speed of the activation of the diagnosis" VALUE 0xa00215aa _REC_S1VAL_20_u2 655.35 _CNV_A_R_LINEAR_____125_CM 0. 655.35 FORMAT "%6.2" /end CHARACTERISTIC
/begin CHARACTERISTIC Cxx_bgin_clu_off_no_chr_ctr "Number of incoherencies when the begin clutch contactor is OFF before activating the failure manager" VALUE 0xa00215b3 _REC_S1VAL_20_u1 255. _CNV_A_R_ECME_LINEA_0_CM 0. 255. FORMAT "%3.0" /end CHARACTERISTIC
/begin CHARACTERISTIC Cxx_bgin_clu_on_no_chr_ctr "Number of incoherencies when the begin clutch contactor is ON before activating the failure manager" VALUE 0xa00215b4 _REC_S1VAL_20_u1 255. _CNV_A_R_ECME_LINEA_0_CM 0. 255. FORMAT "%3.0" /end CHARACTERISTIC
/begin CHARACTERISTIC Cxx_dfdec_bgin_clu_nok "Wire begin clutch contactor detected failure counter decrement" VALUE 0xa00215ac _REC_S1VAL_20_u2 65535. _CNV_A_R_ECME_LINEA_0_CM 0. 65535. FORMAT "%5.0" /end CHARACTERISTIC
/begin CHARACTERISTIC Cxx_dfinc_bgin_clu_nok "Wire begin clutch contactor detected failure counter increment" VALUE 0xa00215ae _REC_S1VAL_20_u2 65535. _CNV_A_R_ECME_LINEA_0_CM 0. 65535. FORMAT "%5.0" /end CHARACTERISTIC
/begin MEASUREMENT Vbx_df_knk_oor "Voltage Outside the Expected Range of knock detected failure" UBYTE _CNV_S_2_RANGE______3_CM 1 0. 0. 1. ECU_ADDRESS 0xd00064eb BIT_MASK 0x1 /end MEASUREMENT
/begin MEASUREMENT Vbx_df_knk_shp "Improper Signal Shape of knock detected failure" UBYTE _CNV_S_2_RANGE______3_CM 1 0. 0. 1. ECU_ADDRESS 0xd00064ec BIT_MASK 0x1 /end MEASUREMENT
/begin MEASUREMENT Vbx_diag_ena_knk_oor "Voltage Outside the Expected Range of knock diagnosis authorization" UBYTE _CNV_S_2_RANGE______3_CM 1 0. 0. 1. ECU_ADDRESS 0xd00064ed BIT_MASK 0x1 /end MEASUREMENT
/begin MEASUREMENT Vbx_diag_ena_knk_shp "Improper Signal Shape of knock diagnosis authorization" UBYTE _CNV_S_2_RANGE______3_CM 1 0. 0. 1. ECU_ADDRESS 0xd00064ee BIT_MASK 0x1 /end MEASUREMENT
/begin MEASUREMENT Vbx_knk_win_diag "Diagnosis of knock sensor in process" UBYTE _CNV_S_2_RANGE______3_CM 1 0. 0. 1. ECU_ADDRESS 0xd00064ef BIT_MASK 0x1 /end MEASUREMENT
/begin MEASUREMENT Vtd_fil_acq_knk_cyl[0] "Instantaneous knock noise for each cylinder" UBYTE _CNV_A_R_ECME_LINEA_0_CM 1 0. 0. 255. ECU_ADDRESS 0xd00064e4 FORMAT "%3.0" /end MEASUREMENT
/begin MEASUREMENT Vtd_fil_acq_knk_cyl[1] "Instantaneous knock noise for each cylinder" UBYTE _CNV_A_R_ECME_LINEA_0_CM 1 0. 0. 255. ECU_ADDRESS 0xd00064e5 FORMAT "%3.0" /end MEASUREMENT
/begin MEASUREMENT Vtd_fil_acq_knk_cyl[2] "Instantaneous knock noise for each cylinder" UBYTE _CNV_A_R_ECME_LINEA_0_CM 1 0. 0. 255. ECU_ADDRESS 0xd00064e6 FORMAT "%3.0" /end MEASUREMENT
/begin MEASUREMENT Vtd_fil_acq_knk_cyl[3] "Instantaneous knock noise for each cylinder" UBYTE _CNV_A_R_ECME_LINEA_0_CM 1 0. 0. 255. ECU_ADDRESS 0xd00064e7 FORMAT "%3.0" /end MEASUREMENT
/begin MEASUREMENT Vxx_knk_tdc_ctr "TDC counter for knock detection, indicates for which cylinder the knock value is available." UBYTE _CNV_A_R_LINEAR_____101_CM 1 0. 0. 3. ECU_ADDRESS 0xd00064e8 FORMAT "%1.0" /end MEASUREMENT
/begin AXIS_PTS ldp_n_32_ip_nl_gain_ad "" 0xa0020a1c n_32 _REC_A2AXS_20_u1 8160. _CNV_A_R_LINEAR_____2_CM 4 0. 8160. FORMAT "%4.0" /end AXIS_PTS
/begin CHARACTERISTIC id_fac_thd_knk[0] "Knock Factor Table per cylinder" MAP 0xa0023138 _REC_A1MAP_20_u1_u1_u1 7.96875 _CNV_A_R_KNCK_LINEA_452_CM 0. 7.96875 FORMAT "%5.3"
 /begin AXIS_DESCR COM_AXIS n_32 _CNV_A_R_LINEAR_____2_CM 16 0. 8160. FORMAT "%4.0" AXIS_PTS_REF ldpm_n_32_2_knck /end AXIS_DESCR
 /begin AXIS_DESCR COM_AXIS maf_hb _CNV_A_R_LINEAR_____77_CM 4 0. 1389. FORMAT "%4.0" AXIS_PTS_REF ldpm_maf_hb_1_knck /end AXIS_DESCR
/end CHARACTERISTIC
/begin CHARACTERISTIC id_fac_thd_knk[1] "Knock Factor Table per cylinder" MAP 0xa0023178 _REC_A1MAP_20_u1_u1_u1 7.96875 _CNV_A_R_KNCK_LINEA_452_CM 0. 7.96875 FORMAT "%5.3"
 /begin AXIS_DESCR COM_AXIS n_32 _CNV_A_R_LINEAR_____2_CM 16 0. 8160. FORMAT "%4.0" AXIS_PTS_REF ldpm_n_32_2_knck /end AXIS_DESCR
 /begin AXIS_DESCR COM_AXIS maf_hb _CNV_A_R_LINEAR_____77_CM 4 0. 1389. FORMAT "%4.0" AXIS_PTS_REF ldpm_maf_hb_1_knck /end AXIS_DESCR
/end CHARACTERISTIC
/begin CHARACTERISTIC id_fac_thd_knk[2] "Knock Factor Table per cylinder" MAP 0xa00231b8 _REC_A1MAP_20_u1_u1_u1 7.96875 _CNV_A_R_KNCK_LINEA_452_CM 0. 7.96875 FORMAT "%5.3"
 /begin AXIS_DESCR COM_AXIS n_32 _CNV_A_R_LINEAR_____2_CM 16 0. 8160. FORMAT "%4.0" AXIS_PTS_REF ldpm_n_32_2_knck /end AXIS_DESCR
 /begin AXIS_DESCR COM_AXIS maf_hb _CNV_A_R_LINEAR_____77_CM 4 0. 1389. FORMAT "%4.0" AXIS_PTS_REF ldpm_maf_hb_1_knck /end AXIS_DESCR
/end CHARACTERISTIC
/begin CHARACTERISTIC id_fac_thd_knk[3] "Knock Factor Table per cylinder" MAP 0xa00231f8 _REC_A1MAP_20_u1_u1_u1 7.96875 _CNV_A_R_KNCK_LINEA_452_CM 0. 7.96875 FORMAT "%5.3"
 /begin AXIS_DESCR COM_AXIS n_32 _CNV_A_R_LINEAR_____2_CM 16 0. 8160. FORMAT "%4.0" AXIS_PTS_REF ldpm_n_32_2_knck /end AXIS_DESCR
 /begin AXIS_DESCR COM_AXIS maf_hb _CNV_A_R_LINEAR_____77_CM 4 0. 1389. FORMAT "%4.0" AXIS_PTS_REF ldpm_maf_hb_1_knck /end AXIS_DESCR
/end CHARACTERISTIC
/begin CHARACTERISTIC id_knks_fil_frq[0] "Knock Filter Frequency for each cylinder" MAP 0xa0023238 _REC_A1MAP_20_u1_u1_u1 63. _CNV_A_R_ECME_LINEA_0_CM 0. 63. FORMAT "%3.0"
 /begin AXIS_DESCR COM_AXIS n_32 _CNV_A_R_LINEAR_____2_CM 8 0. 8160. FORMAT "%4.0" AXIS_PTS_REF ldpm_n_32_1_knck /end AXIS_DESCR
 /begin AXIS_DESCR COM_AXIS maf_hb _CNV_A_R_LINEAR_____77_CM 4 0. 1389. FORMAT "%4.0" AXIS_PTS_REF ldpm_maf_hb_1_knck /end AXIS_DESCR
/end CHARACTERISTIC
/begin CHARACTERISTIC id_knks_fil_frq[1] "Knock Filter Frequency for each cylinder" MAP 0xa0023258 _REC_A1MAP_20_u1_u1_u1 63. _CNV_A_R_ECME_LINEA_0_CM 0. 63. FORMAT "%3.0"
 /begin AXIS_DESCR COM_AXIS n_32 _CNV_A_R_LINEAR_____2_CM 8 0. 8160. FORMAT "%4.0" AXIS_PTS_REF ldpm_n_32_1_knck /end AXIS_DESCR
 /begin AXIS_DESCR COM_AXIS maf_hb _CNV_A_R_LINEAR_____77_CM 4 0. 1389. FORMAT "%4.0" AXIS_PTS_REF ldpm_maf_hb_1_knck /end AXIS_DESCR
/end CHARACTERISTIC
/begin CHARACTERISTIC id_knks_fil_frq[2] "Knock Filter Frequency for each cylinder" MAP 0xa0023278 _REC_A1MAP_20_u1_u1_u1 63. _CNV_A_R_ECME_LINEA_0_CM 0. 63. FORMAT "%3.0"
 /begin AXIS_DESCR COM_AXIS n_32 _CNV_A_R_LINEAR_____2_CM 8 0. 8160. FORMAT "%4.0" AXIS_PTS_REF ldpm_n_32_1_knck /end AXIS_DESCR
 /begin AXIS_DESCR COM_AXIS maf_hb _CNV_A_R_LINEAR_____77_CM 4 0. 1389. FORMAT "%4.0" AXIS_PTS_REF ldpm_maf_hb_1_knck /end AXIS_DESCR
/end CHARACTERISTIC
/begin CHARACTERISTIC id_knks_fil_frq[3] "Knock Filter Frequency for each cylinder" MAP 0xa0023298 _REC_A1MAP_20_u1_u1_u1 63. _CNV_A_R_ECME_LINEA_0_CM 0. 63. FORMAT "%3.0"
 /begin AXIS_DESCR COM_AXIS n_32 _CNV_A_R_LINEAR_____2_CM 8 0. 8160. FORMAT "%4.0" AXIS_PTS_REF ldpm_n_32_1_knck /end AXIS_DESCR
 /begin AXIS_DESCR COM_AXIS maf_hb _CNV_A_R_LINEAR_____77_CM 4 0. 1389. FORMAT "%4.0" AXIS_PTS_REF ldpm_maf_hb_1_knck /end AXIS_DESCR
/end CHARACTERISTIC
/begin CHARACTERISTIC id_knks_thd_add "Knock summand" CURVE 0xa00232b8 _REC_A1CUR_20_u1_u1 5.1 _CNV_A_R_KNCK_LINEA_453_CM -2.56 2.54 FORMAT "%8.6"
 /begin AXIS_DESCR COM_AXIS n_32 _CNV_A_R_LINEAR_____2_CM 16 0. 8160. FORMAT "%4.0" AXIS_PTS_REF ldpm_n_32_2_knck /end AXIS_DESCR
/end CHARACTERISTIC
/begin CHARACTERISTIC ip_itc_knk[0] "Integration Time Constant table defined per knock sensor" CURVE 0xa0020a0c _REC_A1CUR_20_u1_u1 31. _CNV_A_R_ECME_LINEA_0_CM 0. 31. FORMAT "%3.0"
 /begin AXIS_DESCR COM_AXIS n_32 _CNV_A_R_LINEAR_____2_CM 8 0. 8160. FORMAT "%4.0" AXIS_PTS_REF ldpm_n_32_1_knck /end AXIS_DESCR
/end CHARACTERISTIC
/begin CHARACTERISTIC ip_knks_gain[0] "Gain value for each cylinder" MAP 0xa00232e8 _REC_A1MAP_20_u1_u1_u1 63. _CNV_A_R_ECME_LINEA_0_CM 0. 63. FORMAT "%3.0"
 /begin AXIS_DESCR COM_AXIS n_32 _CNV_A_R_LINEAR_____2_CM 16 0. 8160. FORMAT "%4.0" AXIS_PTS_REF ldpm_n_32_2_knck /end AXIS_DESCR
 /begin AXIS_DESCR COM_AXIS maf_hb _CNV_A_R_LINEAR_____77_CM 12 0. 1389. FORMAT "%4.0" AXIS_PTS_REF ldpm_maf_hb_2_knck /end AXIS_DESCR
/end CHARACTERISTIC
/begin CHARACTERISTIC ip_knks_gain[1] "Gain value for each cylinder" MAP 0xa00233a8 _REC_A1MAP_20_u1_u1_u1 63. _CNV_A_R_ECME_LINEA_0_CM 0. 63. FORMAT "%3.0"
 /begin AXIS_DESCR COM_AXIS n_32 _CNV_A_R_LINEAR_____2_CM 16 0. 8160. FORMAT "%4.0" AXIS_PTS_REF ldpm_n_32_2_knck /end AXIS_DESCR
 /begin AXIS_DESCR COM_AXIS maf_hb _CNV_A_R_LINEAR_____77_CM 12 0. 1389. FORMAT "%4.0" AXIS_PTS_REF ldpm_maf_hb_2_knck /end AXIS_DESCR
/end CHARACTERISTIC
/begin CHARACTERISTIC ip_knks_gain[2] "Gain value for each cylinder" MAP 0xa0023468 _REC_A1MAP_20_u1_u1_u1 63. _CNV_A_R_ECME_LINEA_0_CM 0. 63. FORMAT "%3.0"
 /begin AXIS_DESCR COM_AXIS n_32 _CNV_A_R_LINEAR_____2_CM 16 0. 8160. FORMAT "%4.0" AXIS_PTS_REF ldpm_n_32_2_knck /end AXIS_DESCR
 /begin AXIS_DESCR COM_AXIS maf_hb _CNV_A_R_LINEAR_____77_CM 12 0. 1389. FORMAT "%4.0" AXIS_PTS_REF ldpm_maf_hb_2_knck /end AXIS_DESCR
/end CHARACTERISTIC
/begin CHARACTERISTIC ip_knks_gain[3] "Gain value for each cylinder" MAP 0xa0023528 _REC_A1MAP_20_u1_u1_u1 63. _CNV_A_R_ECME_LINEA_0_CM 0. 63. FORMAT "%3.0"
 /begin AXIS_DESCR COM_AXIS n_32 _CNV_A_R_LINEAR_____2_CM 16 0. 8160. FORMAT "%4.0" AXIS_PTS_REF ldpm_n_32_2_knck /end AXIS_DESCR
 /begin AXIS_DESCR COM_AXIS maf_hb _CNV_A_R_LINEAR_____77_CM 12 0. 1389. FORMAT "%4.0" AXIS_PTS_REF ldpm_maf_hb_2_knck /end AXIS_DESCR
/end CHARACTERISTIC
/begin CHARACTERISTIC ip_knkwb[0] "Beginning of measurement knock window for each cylinder" MAP 0xa00235e8 _REC_A1MAP_20_u1_u1_u1 70.125 _CNV_A_R_LINEAR_____23_CM 0. 70.125
 /begin AXIS_DESCR COM_AXIS n_32 _CNV_A_R_LINEAR_____2_CM 8 0. 8160. FORMAT "%4.0" AXIS_PTS_REF ldpm_n_32_1_knck /end AXIS_DESCR
 /begin AXIS_DESCR COM_AXIS maf_hb _CNV_A_R_LINEAR_____77_CM 4 0. 1389. FORMAT "%4.0" AXIS_PTS_REF ldpm_maf_hb_1_knck /end AXIS_DESCR
/end CHARACTERISTIC
/begin CHARACTERISTIC ip_knkwb[1] "Beginning of measurement knock window for each cylinder" MAP 0xa0023608 _REC_A1MAP_20_u1_u1_u1 70.125 _CNV_A_R_LINEAR_____23_CM 0. 70.125
 /begin AXIS_DESCR COM_AXIS n_32 _CNV_A_R_LINEAR_____2_CM 8 0. 8160. FORMAT "%4.0" AXIS_PTS_REF ldpm_n_32_1_knck /end AXIS_DESCR
 /begin AXIS_DESCR COM_AXIS maf_hb _CNV_A_R_LINEAR_____77_CM 4 0. 1389. FORMAT "%4.0" AXIS_PTS_REF ldpm_maf_hb_1_knck /end AXIS_DESCR
/end CHARACTERISTIC
/begin CHARACTERISTIC ip_knkwb[2] "Beginning of measurement knock window for each cylinder" MAP 0xa0023628 _REC_A1MAP_20_u1_u1_u1 70.125 _CNV_A_R_LINEAR_____23_CM 0. 70.125
 /begin AXIS_DESCR COM_AXIS n_32 _CNV_A_R_LINEAR_____2_CM 8 0. 8160. FORMAT "%4.0" AXIS_PTS_REF ldpm_n_32_1_knck /end AXIS_DESCR
 /begin AXIS_DESCR COM_AXIS maf_hb _CNV_A_R_LINEAR_____77_CM 4 0. 1389. FORMAT "%4.0" AXIS_PTS_REF ldpm_maf_hb_1_knck /end AXIS_DESCR
/end CHARACTERISTIC
/begin CHARACTERISTIC ip_knkwb[3] "Beginning of measurement knock window for each cylinder" MAP 0xa0023648 _REC_A1MAP_20_u1_u1_u1 70.125 _CNV_A_R_LINEAR_____23_CM 0. 70.125
 /begin AXIS_DESCR COM_AXIS n_32 _CNV_A_R_LINEAR_____2_CM 8 0. 8160. FORMAT "%4.0" AXIS_PTS_REF ldpm_n_32_1_knck /end AXIS_DESCR
 /begin AXIS_DESCR COM_AXIS maf_hb _CNV_A_R_LINEAR_____77_CM 4 0. 1389. FORMAT "%4.0" AXIS_PTS_REF ldpm_maf_hb_1_knck /end AXIS_DESCR
/end CHARACTERISTIC
/begin CHARACTERISTIC ip_knkwd[0] "Duration of measurement knock window for each cylinder" MAP 0xa0023668 _REC_A1MAP_20_u1_u1_u1 70.125 _CNV_A_R_LINEAR_____23_CM 0. 70.125
 /begin AXIS_DESCR COM_AXIS n_32 _CNV_A_R_LINEAR_____2_CM 8 0. 8160. FORMAT "%4.0" AXIS_PTS_REF ldpm_n_32_1_knck /end AXIS_DESCR
 /begin AXIS_DESCR COM_AXIS maf_hb _CNV_A_R_LINEAR_____77_CM 4 0. 1389. FORMAT "%4.0" AXIS_PTS_REF ldpm_maf_hb_1_knck /end AXIS_DESCR
/end CHARACTERISTIC
/begin CHARACTERISTIC ip_knkwd[1] "Duration of measurement knock window for each cylinder" MAP 0xa0023688 _REC_A1MAP_20_u1_u1_u1 70.125 _CNV_A_R_LINEAR_____23_CM 0. 70.125
 /begin AXIS_DESCR COM_AXIS n_32 _CNV_A_R_LINEAR_____2_CM 8 0. 8160. FORMAT "%4.0" AXIS_PTS_REF ldpm_n_32_1_knck /end AXIS_DESCR
 /begin AXIS_DESCR COM_AXIS maf_hb _CNV_A_R_LINEAR_____77_CM 4 0. 1389. FORMAT "%4.0" AXIS_PTS_REF ldpm_maf_hb_1_knck /end AXIS_DESCR
/end CHARACTERISTIC
/begin CHARACTERISTIC ip_knkwd[2] "Duration of measurement knock window for each cylinder" MAP 0xa00236a8 _REC_A1MAP_20_u1_u1_u1 70.125 _CNV_A_R_LINEAR_____23_CM 0. 70.125
 /begin AXIS_DESCR COM_AXIS n_32 _CNV_A_R_LINEAR_____2_CM 8 0. 8160. FORMAT "%4.0" AXIS_PTS_REF ldpm_n_32_1_knck /end AXIS_DESCR
 /begin AXIS_DESCR COM_AXIS maf_hb _CNV_A_R_LINEAR_____77_CM 4 0. 1389. FORMAT "%4.0" AXIS_PTS_REF ldpm_maf_hb_1_knck /end AXIS_DESCR
/end CHARACTERISTIC
/begin CHARACTERISTIC ip_knkwd[3] "Duration of measurement knock window for each cylinder" MAP 0xa00236c8 _REC_A1MAP_20_u1_u1_u1 70.125 _CNV_A_R_LINEAR_____23_CM 0. 70.125
 /begin AXIS_DESCR COM_AXIS n_32 _CNV_A_R_LINEAR_____2_CM 8 0. 8160. FORMAT "%4.0" AXIS_PTS_REF ldpm_n_32_1_knck /end AXIS_DESCR
 /begin AXIS_DESCR COM_AXIS maf_hb _CNV_A_R_LINEAR_____77_CM 4 0. 1389. FORMAT "%4.0" AXIS_PTS_REF ldpm_maf_hb_1_knck /end AXIS_DESCR
/end CHARACTERISTIC
/begin CHARACTERISTIC ip_nl_gain_ad "Target value of centred engine noise " CURVE 0xa0020a14 _REC_A1CUR_20_u2_u1 4.99992371 _CNV_A_R_KNCK_LINEA_454_CM 0. 4.99992371 FORMAT "%7.5"
 /begin AXIS_DESCR COM_AXIS n_32 _CNV_A_R_LINEAR_____2_CM 4 0. 8160. FORMAT "%4.0" AXIS_PTS_REF ldp_n_32_ip_nl_gain_ad /end AXIS_DESCR
/end CHARACTERISTIC
/begin MEASUREMENT egy_knk "Common variable of knock energy level " UWORD _CNV_A_R_LINEAR_____53_CM 1 0. 0. 3.99993896484375 ECU_ADDRESS 0xd0003d76 FORMAT "%7.5" /end MEASUREMENT
/begin MEASUREMENT knks_cmd_conf[0] "Configuration value for the analogue channel of knock sensor" UBYTE _CNV_A_R_ECME_LINEA_0_CM 1 0. 0. 3. ECU_ADDRESS 0xd00063d8 FORMAT "%3.0" /end MEASUREMENT
/begin MEASUREMENT knks_cmd_conf[1] "Configuration value for the analogue channel of knock sensor" UBYTE _CNV_A_R_ECME_LINEA_0_CM 1 0. 0. 3. ECU_ADDRESS 0xd00063d9 FORMAT "%3.0" /end MEASUREMENT
/begin MEASUREMENT knks_cmd_conf[2] "Configuration value for the analogue channel of knock sensor" UBYTE _CNV_A_R_ECME_LINEA_0_CM 1 0. 0. 3. ECU_ADDRESS 0xd00063da FORMAT "%3.0" /end MEASUREMENT
/begin MEASUREMENT knks_cmd_conf[3] "Configuration value for the analogue channel of knock sensor" UBYTE _CNV_A_R_ECME_LINEA_0_CM 1 0. 0. 3. ECU_ADDRESS 0xd00063db FORMAT "%3.0" /end MEASUREMENT
/begin MEASUREMENT knks_cmd_fil[0] "Knock Filter Frequency for each cylinder" UBYTE _CNV_A_R_ECME_LINEA_0_CM 1 0. 0. 63. ECU_ADDRESS 0xd00063dc FORMAT "%3.0" /end MEASUREMENT
/begin MEASUREMENT knks_cmd_fil[1] "Knock Filter Frequency for each cylinder" UBYTE _CNV_A_R_ECME_LINEA_0_CM 1 0. 0. 63. ECU_ADDRESS 0xd00063dd FORMAT "%3.0" /end MEASUREMENT
/begin MEASUREMENT knks_cmd_fil[2] "Knock Filter Frequency for each cylinder" UBYTE _CNV_A_R_ECME_LINEA_0_CM 1 0. 0. 63. ECU_ADDRESS 0xd00063de FORMAT "%3.0" /end MEASUREMENT
/begin MEASUREMENT knks_cmd_fil[3] "Knock Filter Frequency for each cylinder" UBYTE _CNV_A_R_ECME_LINEA_0_CM 1 0. 0. 63. ECU_ADDRESS 0xd00063df FORMAT "%3.0" /end MEASUREMENT
/begin MEASUREMENT knks_cmd_gain[0] "Gain value for each cylinder" UBYTE _CNV_A_R_ECME_LINEA_0_CM 1 0. 0. 63. ECU_ADDRESS 0xd00063e0 FORMAT "%3.0" /end MEASUREMENT
/begin MEASUREMENT knks_cmd_gain[1] "Gain value for each cylinder" UBYTE _CNV_A_R_ECME_LINEA_0_CM 1 0. 0. 63. ECU_ADDRESS 0xd00063e1 FORMAT "%3.0" /end MEASUREMENT
/begin MEASUREMENT knks_cmd_gain[2] "Gain value for each cylinder" UBYTE _CNV_A_R_ECME_LINEA_0_CM 1 0. 0. 63. ECU_ADDRESS 0xd00063e2 FORMAT "%3.0" /end MEASUREMENT
/begin MEASUREMENT knks_cmd_gain[3] "Gain value for each cylinder" UBYTE _CNV_A_R_ECME_LINEA_0_CM 1 0. 0. 63. ECU_ADDRESS 0xd00063e3 FORMAT "%3.0" /end MEASUREMENT
/begin MEASUREMENT knks_cmd_gain_ad[0] "Signed Offset on programming gain of knock IC device for each cylinder by adaptation of the engine noise" SBYTE _CNV_A_R_ECME_LINEA_0_CM 1 0. -31. 31. ECU_ADDRESS 0xd00076e8 FORMAT "%2.0" /end MEASUREMENT
/begin MEASUREMENT knks_cmd_gain_ad[1] "Signed Offset on programming gain of knock IC device for each cylinder by adaptation of the engine noise" SBYTE _CNV_A_R_ECME_LINEA_0_CM 1 0. -31. 31. ECU_ADDRESS 0xd00076e9 FORMAT "%2.0" /end MEASUREMENT
/begin MEASUREMENT knks_cmd_gain_ad[2] "Signed Offset on programming gain of knock IC device for each cylinder by adaptation of the engine noise" SBYTE _CNV_A_R_ECME_LINEA_0_CM 1 0. -31. 31. ECU_ADDRESS 0xd00076ea FORMAT "%2.0" /end MEASUREMENT
/begin MEASUREMENT knks_cmd_gain_ad[3] "Signed Offset on programming gain of knock IC device for each cylinder by adaptation of the engine noise" SBYTE _CNV_A_R_ECME_LINEA_0_CM 1 0. -31. 31. ECU_ADDRESS 0xd00076eb FORMAT "%2.0" /end MEASUREMENT
/begin MEASUREMENT knks_cmd_int[0] "Integration Time Constant for each cylinder" UBYTE _CNV_A_R_ECME_LINEA_0_CM 1 0. 0. 255. ECU_ADDRESS 0xd00063e4 FORMAT "%3.0" /end MEASUREMENT
/begin MEASUREMENT knks_cmd_int[1] "Integration Time Constant for each cylinder" UBYTE _CNV_A_R_ECME_LINEA_0_CM 1 0. 0. 255. ECU_ADDRESS 0xd00063e5 FORMAT "%3.0" /end MEASUREMENT
/begin MEASUREMENT knks_cmd_int[2] "Integration Time Constant for each cylinder" UBYTE _CNV_A_R_ECME_LINEA_0_CM 1 0. 0. 255. ECU_ADDRESS 0xd00063e6 FORMAT "%3.0" /end MEASUREMENT
/begin MEASUREMENT knks_cmd_int[3] "Integration Time Constant for each cylinder" UBYTE _CNV_A_R_ECME_LINEA_0_CM 1 0. 0. 255. ECU_ADDRESS 0xd00063e7 FORMAT "%3.0" /end MEASUREMENT
/begin MEASUREMENT knks_thd[0] "Knock Threshold per cylinder" UBYTE _CNV_A_R_LINEAR_____59_CM 1 0. 0. 4.98046875 ECU_ADDRESS 0xd00063e8 FORMAT "%6.4" /end MEASUREMENT
/begin MEASUREMENT knks_thd[1] "Knock Threshold per cylinder" UBYTE _CNV_A_R_LINEAR_____59_CM 1 0. 0. 4.98046875 ECU_ADDRESS 0xd00063e9 FORMAT "%6.4" /end MEASUREMENT
/begin MEASUREMENT knks_thd[2] "Knock Threshold per cylinder" UBYTE _CNV_A_R_LINEAR_____59_CM 1 0. 0. 4.98046875 ECU_ADDRESS 0xd00063ea FORMAT "%6.4" /end MEASUREMENT
/begin MEASUREMENT knks_thd[3] "Knock Threshold per cylinder" UBYTE _CNV_A_R_LINEAR_____59_CM 1 0. 0. 4.98046875 ECU_ADDRESS 0xd00063eb FORMAT "%6.4" /end MEASUREMENT
/begin MEASUREMENT knkwb[0] "Beginning of measurement knock window for each cylinder" UBYTE _CNV_A_R_LINEAR_____23_CM 1 0. 0. 95.625 ECU_ADDRESS 0xd00063ec /end MEASUREMENT
/begin MEASUREMENT knkwb[1] "Beginning of measurement knock window for each cylinder" UBYTE _CNV_A_R_LINEAR_____23_CM 1 0. 0. 95.625 ECU_ADDRESS 0xd00063ed /end MEASUREMENT
/begin MEASUREMENT knkwb[2] "Beginning of measurement knock window for each cylinder" UBYTE _CNV_A_R_LINEAR_____23_CM 1 0. 0. 95.625 ECU_ADDRESS 0xd00063ee /end MEASUREMENT
/begin MEASUREMENT knkwb[3] "Beginning of measurement knock window for each cylinder" UBYTE _CNV_A_R_LINEAR_____23_CM 1 0. 0. 95.625 ECU_ADDRESS 0xd00063ef /end MEASUREMENT
/begin MEASUREMENT knkwd[0] "Duration of measurement knock window for each cylinder" UBYTE _CNV_A_R_LINEAR_____23_CM 1 0. 0. 95.625 ECU_ADDRESS 0xd00063f0 /end MEASUREMENT
/begin MEASUREMENT knkwd[1] "Duration of measurement knock window for each cylinder" UBYTE _CNV_A_R_LINEAR_____23_CM 1 0. 0. 95.625 ECU_ADDRESS 0xd00063f1 /end MEASUREMENT
/begin MEASUREMENT knkwd[2] "Duration of measurement knock window for each cylinder" UBYTE _CNV_A_R_LINEAR_____23_CM 1 0. 0. 95.625 ECU_ADDRESS 0xd00063f2 /end MEASUREMENT
/begin MEASUREMENT knkwd[3] "Duration of measurement knock window for each cylinder" UBYTE _CNV_A_R_LINEAR_____23_CM 1 0. 0. 95.625 ECU_ADDRESS 0xd00063f3 /end MEASUREMENT
/begin MEASUREMENT lv_knk "Logical variable for recognition of knock detection" UBYTE _CNV_S_2_RANGE______3_CM 1 0. 0. 1. ECU_ADDRESS 0xd00063c9 BIT_MASK 0x1 /end MEASUREMENT
/begin MEASUREMENT nl[0] "Floating mean value of the noise signal" UWORD _CNV_A_R_KNCK_LINEA_454_CM 1 0. 0. 4.99992371 ECU_ADDRESS 0xd0003d82 FORMAT "%7.5" /end MEASUREMENT
/begin MEASUREMENT nl[1] "Floating mean value of the noise signal" UWORD _CNV_A_R_KNCK_LINEA_454_CM 1 0. 0. 4.99992371 ECU_ADDRESS 0xd0003d84 FORMAT "%7.5" /end MEASUREMENT
/begin MEASUREMENT nl[2] "Floating mean value of the noise signal" UWORD _CNV_A_R_KNCK_LINEA_454_CM 1 0. 0. 4.99992371 ECU_ADDRESS 0xd0003d86 FORMAT "%7.5" /end MEASUREMENT
/begin MEASUREMENT nl[3] "Floating mean value of the noise signal" UWORD _CNV_A_R_KNCK_LINEA_454_CM 1 0. 0. 4.99992371 ECU_ADDRESS 0xd0003d88 FORMAT "%7.5" /end MEASUREMENT
/begin MEASUREMENT nl_dif "Adaptive learning of engine noise deviation for gain adaptation" SWORD _CNV_A_R_KNCK_LINEA_455_CM 1 0. -2.5 2.49992371 ECU_ADDRESS 0xd0004e48 FORMAT "%7.4" /end MEASUREMENT
/begin CHARACTERISTIC c_cycnr_knk_det "Number of combustion cycles where the noise calculation is frozen after a knock detection " VALUE 0xa0020a50 _REC_S1VAL_20_u1 254. _CNV_A_R_ECME_LINEA_0_CM 1. 255. FORMAT "%3.0" /end CHARACTERISTIC
/begin CHARACTERISTIC c_egy_thd_knk "Threshold on EGY_KNK for knock detection" VALUE 0xa0020a38 _REC_S1VAL_20_u2 3.99993896484375 _CNV_A_R_LINEAR_____53_CM 0. 3.99993896484375 FORMAT "%7.5" /end CHARACTERISTIC
/begin CHARACTERISTIC c_fac_tra_knk "correction factor for load dynamic active" VALUE 0xa0020a52 _REC_S1VAL_20_u1 7.96875 _CNV_A_R_KNCK_LINEA_452_CM 0. 7.96875 FORMAT "%5.3" /end CHARACTERISTIC
/begin CHARACTERISTIC c_knks_cmd_gain_ad_max "maximum of adaptive command gain (typical value 15)" VALUE 0xa0020a53 _REC_S1VAL_20_s1 62. _CNV_A_R_ECME_LINEA_0_CM -31. 31. FORMAT "%2.0" /end CHARACTERISTIC
/begin CHARACTERISTIC c_knks_cmd_gain_ad_min "Minimum of adaptive command gain (typical value -15)" VALUE 0xa0020a54 _REC_S1VAL_20_s1 62. _CNV_A_R_ECME_LINEA_0_CM -31. 31. FORMAT "%2.0" /end CHARACTERISTIC
/begin CHARACTERISTIC c_knks_cyl_conf "Configuration of the knock sensors and the cylinders" VALUE 0xa0020a55 _REC_S1VAL_20_u1 1. _CNV_A_R_ECME_LINEA_0_CM 0. 1. FORMAT "%1.0" /end CHARACTERISTIC
/begin CHARACTERISTIC c_nl_ad_ctr "Recurrence of adaptation computation (typical value 64 tdc)" VALUE 0xa0020a5d _REC_S1VAL_20_u1 255. _CNV_A_R_ECME_LINEA_0_CM 0. 255. FORMAT "%3.0" /end CHARACTERISTIC
/begin CHARACTERISTIC c_nl_ad_thd "Threshold to enable the gain adaptation (typical value 0.2V)" VALUE 0xa0020a3c _REC_S1VAL_20_u2 4.99992371 _CNV_A_R_KNCK_LINEA_454_CM 0. 4.99992371 FORMAT "%7.5" /end CHARACTERISTIC
/begin CHARACTERISTIC c_nl_fil_gain "Filter gain for Noise Value Calculation" VALUE 0xa0020a5e _REC_S1VAL_20_u1 0.99609375 _CNV_A_R_LINEAR_____29_CM 0. 0.99609375 FORMAT "%5.3" /end CHARACTERISTIC
/begin CHARACTERISTIC c_nl_fil_gain_inc "Filter gain for Noise Value Calculation in case of increasing noise value " VALUE 0xa0020a60 _REC_S1VAL_20_u1 0.99609375 _CNV_A_R_LINEAR_____29_CM 0. 0.99609375 FORMAT "%5.3" /end CHARACTERISTIC
/begin CHARACTERISTIC c_nl_fil_gain_tra "Filter gain for Noise Value Calculation in case of Transient Case" VALUE 0xa0020a61 _REC_S1VAL_20_u1 0.99609375 _CNV_A_R_LINEAR_____29_CM 0. 0.99609375 FORMAT "%5.3" /end CHARACTERISTIC
/begin CHARACTERISTIC c_nl_inc "Increment on noise level in case of noise level calculation freeze" VALUE 0xa0020a3e _REC_S1VAL_20_u2 4.99992371 _CNV_A_R_KNCK_LINEA_454_CM 0. 4.99992371 FORMAT "%7.5" /end CHARACTERISTIC
/begin CHARACTERISTIC c_nl_lih "Limp Home value for noise value" VALUE 0xa0020a40 _REC_S1VAL_20_u2 4.99992371 _CNV_A_R_KNCK_LINEA_454_CM 0. 4.99992371 FORMAT "%7.5" /end CHARACTERISTIC
/begin CHARACTERISTIC c_nl_ofs "Offset on NL to decide which gain will be used" VALUE 0xa0020a42 _REC_S1VAL_20_u2 4.99992371 _CNV_A_R_KNCK_LINEA_454_CM 0. 4.99992371 FORMAT "%7.5" /end CHARACTERISTIC
/begin AXIS_PTS ldpm_maf_hb_1_knck "" 0xa0020a22 maf_hb _REC_A2AXS_20_u1 1389. _CNV_A_R_LINEAR_____77_CM 4 0. 1389. FORMAT "%4.0" /end AXIS_PTS
/begin AXIS_PTS ldpm_maf_hb_2_knck "" 0xa00230fc maf_hb _REC_A2AXS_20_u1 1389. _CNV_A_R_LINEAR_____77_CM 12 0. 1389. FORMAT "%4.0" /end AXIS_PTS
/begin AXIS_PTS ldpm_n_32_1_knck "" 0xa002310c n_32 _REC_A2AXS_20_u1 8160. _CNV_A_R_LINEAR_____2_CM 8 0. 8160. FORMAT "%4.0" /end AXIS_PTS
/begin AXIS_PTS ldpm_n_32_2_knck "" 0xa0023118 n_32 _REC_A2AXS_20_u1 8160. _CNV_A_R_LINEAR_____2_CM 16 0. 8160. FORMAT "%4.0" /end AXIS_PTS
/begin AXIS_PTS ldpm_n_32_5_knck "" 0xa0020a28 n_32 _REC_A2AXS_20_u1 8160. _CNV_A_R_LINEAR_____2_CM 4 0. 8160. FORMAT "%4.0" /end AXIS_PTS
/begin AXIS_PTS ldpm_tco_1_knck "" 0xa0020a2e tco _REC_A2AXS_20_u1 190.5 _CNV_A_R_LINEAR_____41_CM 4 -48. 142.5 FORMAT "%6.2" /end AXIS_PTS
/begin AXIS_PTS ldpm_n_32_3_knck "" 0xa002312c n_32 _REC_A2AXS_20_u1 8160. _CNV_A_R_LINEAR_____2_CM 8 0. 8160. FORMAT "%4.0" /end AXIS_PTS
/begin CHARACTERISTIC id_cycnr_fac_tra_knk "Cycle counter during which the Load Dynamic Function stays active after triggering" CURVE 0xa0020a34 _REC_A1CUR_20_u1_u1 255. _CNV_A_R_ECME_LINEA_0_CM 0. 255. FORMAT "%3.0"
 /begin AXIS_DESCR COM_AXIS n_32 _CNV_A_R_LINEAR_____2_CM 4 0. 8160. FORMAT "%4.0" AXIS_PTS_REF ldpm_n_32_5_knck /end AXIS_DESCR
/end CHARACTERISTIC
/begin CHARACTERISTIC id_maf_dif_tra_knk "MAF difference for Load Dynamic Recognition" CURVE 0xa00209f4 _REC_A1CUR_20_s2_u1 1389. _CNV_A_R_LINEAR_____456_CM -694.510597390707 694.4894026092931 FORMAT "%7.2"
 /begin AXIS_DESCR COM_AXIS n_32 _CNV_A_R_LINEAR_____2_CM 4 0. 8160. FORMAT "%4.0" AXIS_PTS_REF ldpm_n_32_5_knck /end AXIS_DESCR
/end CHARACTERISTIC
/begin CHARACTERISTIC id_maf_hb_min_knk_ad "MAF_HB-threshold for global adaptive circuit" CURVE 0xa00232c8 _REC_A1CUR_20_u1_u1 1389. _CNV_A_R_LINEAR_____77_CM 0. 1389. FORMAT "%4.0"
 /begin AXIS_DESCR COM_AXIS n_32 _CNV_A_R_LINEAR_____2_CM 16 0. 8160. FORMAT "%4.0" AXIS_PTS_REF ldpm_n_32_2_knck /end AXIS_DESCR
/end CHARACTERISTIC
/begin CHARACTERISTIC id_maf_min_ad_1_knk "Air-mass Threshold for Knock Adaptation of circuit 1" CURVE 0xa00209fc _REC_A1CUR_20_u1_u1 1389. _CNV_A_R_LINEAR_____77_CM 0. 1389. FORMAT "%4.0"
 /begin AXIS_DESCR COM_AXIS n_32 _CNV_A_R_LINEAR_____2_CM 8 0. 8160. FORMAT "%4.0" AXIS_PTS_REF ldpm_n_32_3_knck /end AXIS_DESCR
/end CHARACTERISTIC
/begin CHARACTERISTIC id_n_grd_max_knk "Speed Gradient for dynamic identification" CURVE 0xa0020a04 _REC_A1CUR_20_u1_u1 4064. _CNV_A_R_LINEAR_____2_CM 0. 4064. FORMAT "%4.0"
 /begin AXIS_DESCR COM_AXIS n_32 _CNV_A_R_LINEAR_____2_CM 8 0. 8160. FORMAT "%4.0" AXIS_PTS_REF ldpm_n_32_3_knck /end AXIS_DESCR
/end CHARACTERISTIC
/begin CHARACTERISTIC ip_maf_hb_min_knk "Air-mass Threshold to enable knock control" MAP 0xa00236e8 _REC_A1MAP_20_u1_u1_u1 1389. _CNV_A_R_LINEAR_____77_CM 0. 1389. FORMAT "%4.0"
 /begin AXIS_DESCR COM_AXIS n_32 _CNV_A_R_LINEAR_____2_CM 8 0. 8160. FORMAT "%4.0" AXIS_PTS_REF ldpm_n_32_1_knck /end AXIS_DESCR
 /begin AXIS_DESCR COM_AXIS tco _CNV_A_R_LINEAR_____41_CM 4 -48. 142.5 FORMAT "%6.2" AXIS_PTS_REF ldpm_tco_1_knck /end AXIS_DESCR
/end CHARACTERISTIC
/begin MEASUREMENT lv_fac_ad_knk_ena "Flag to enable global adaptation" UBYTE _CNV_S_2_RANGE______3_CM 1 0. 0. 1. ECU_ADDRESS 0xd00063bf BIT_MASK 0x1 /end MEASUREMENT
/begin MEASUREMENT lv_knk_ad_1_ena "Flag to enable circuit 1 adaptation" UBYTE _CNV_S_2_RANGE______3_CM 1 0. 0. 1. ECU_ADDRESS 0xd00063cb BIT_MASK 0x1 /end MEASUREMENT
/begin MEASUREMENT lv_knk_ad_ena "Flag to enable adaptive learning of engine noise for gain adaptation" UBYTE _CNV_S_2_RANGE______3_CM 1 0. 0. 1. ECU_ADDRESS 0xd00063cc BIT_MASK 0x1 /end MEASUREMENT
/begin MEASUREMENT lv_knk_ctl_act_ena "Flag to enable knock control " UBYTE _CNV_S_2_RANGE______3_CM 1 0. 0. 1. ECU_ADDRESS 0xd00063cd BIT_MASK 0x1 /end MEASUREMENT
/begin MEASUREMENT lv_knk_det_ena "Flag to enable knock detection " UBYTE _CNV_S_2_RANGE______3_CM 1 0. 0. 1. ECU_ADDRESS 0xd00063ce BIT_MASK 0x1 /end MEASUREMENT
/begin MEASUREMENT lv_knk_lih "Flag to indicate that one or more cylinder is/are in Knock Limp Home" UBYTE _CNV_S_2_RANGE______3_CM 1 0. 0. 1. ECU_ADDRESS 0xd00063cf BIT_MASK 0x1 /end MEASUREMENT
/begin MEASUREMENT lv_knk_lih_ena "Flag to enable knock limp home operation" UBYTE _CNV_S_2_RANGE______3_CM 1 0. 0. 1. ECU_ADDRESS 0xd00063d0 BIT_MASK 0x1 /end MEASUREMENT
/begin MEASUREMENT lv_maf_tra_knk "Logical variable for Load Dynamic Function active or passive" UBYTE _CNV_S_2_RANGE______3_CM 1 0. 0. 1. ECU_ADDRESS 0xd00063d2 BIT_MASK 0x1 /end MEASUREMENT
/begin MEASUREMENT lv_n_tra_knk "Logical variable for Engine Speed Dynamic Function active or passive" UBYTE _CNV_S_2_RANGE______3_CM 1 0. 0. 1. ECU_ADDRESS 0xd00063d4 BIT_MASK 0x1 /end MEASUREMENT
/begin CHARACTERISTIC c_ctr_ad_1_knk "Number of tdc before enabling AD1 adaptation" VALUE 0xa0020a4c _REC_S1VAL_20_u1 255. _CNV_A_R_ECME_LINEA_0_CM 0. 255. FORMAT "%3.0" /end CHARACTERISTIC
/begin CHARACTERISTIC c_ctr_nl_ad_knk "Number of tdc since the last knock detection before enabling the calculation of adaptation (typical value 16)" VALUE 0xa0020a4f _REC_S1VAL_20_u1 255. _CNV_A_R_ECME_LINEA_0_CM 0. 255. FORMAT "%3.0" /end CHARACTERISTIC
/begin CHARACTERISTIC c_maf_min_knk_ad "Condition on load to authorise the calculation of adaptation (typical value 300 to 500 mg/tdc)" VALUE 0xa0020a59 _REC_S1VAL_20_u1 1389. _CNV_A_R_LINEAR_____77_CM 0. 1389. FORMAT "%4.0" /end CHARACTERISTIC
/begin CHARACTERISTIC c_n_max_knk_ad "Condition on maximum engine speed to enable the calculation of adaptation (typical value 4500 rpm)" VALUE 0xa0020a5b _REC_S1VAL_20_u1 8160. _CNV_A_R_LINEAR_____2_CM 0. 8160. FORMAT "%4.0" /end CHARACTERISTIC
/begin CHARACTERISTIC c_n_min_knk_ad "Condition on minimum engine speed to enable the calculation of adaptation (typical value 1500 rpm)" VALUE 0xa0020a5c _REC_S1VAL_20_u1 8160. _CNV_A_R_LINEAR_____2_CM 0. 8160. FORMAT "%4.0" /end CHARACTERISTIC
/begin CHARACTERISTIC c_tco_ad_knk_min "Bottom limit TCO" VALUE 0xa0020a62 _REC_S1VAL_20_u1 190.5 _CNV_A_R_LINEAR_____41_CM -48. 142.5 FORMAT "%6.2" /end CHARACTERISTIC
/begin CHARACTERISTIC c_tco_knk_ad "Condition on TCO to authorise the calculation of adaptation (typical value 60°C)" VALUE 0xa0020a64 _REC_S1VAL_20_u1 190.5 _CNV_A_R_LINEAR_____41_CM -48. 142.5 FORMAT "%6.2" /end CHARACTERISTIC
/begin MEASUREMENT fac_ad_knk_app "Multiplicative factor on FAC_AD_KNK generated by application incidence (used when LV_FAC_AD_KNK_APP is active)" UBYTE _CNV_A_R_LINEAR_____42_CM 1 0. 0. 1. ECU_ADDRESS 0xd00063f6 FORMAT "%8.6" /end MEASUREMENT
/begin MEASUREMENT lv_fac_ad_knk_app "Flag to activate use of FAC_AD_KNK_APP (mult. factor on FAC_AD_KNK). Generated in application incidence" UBYTE _CNV_S_2_RANGE______3_CM 1 0. 0. 1. ECU_ADDRESS 0xd00063be BIT_MASK 0x1 /end MEASUREMENT
/begin MEASUREMENT lv_iga_tra_knk_app "Flag generated in application incidence to activate knock prevention in instationnary conditions" UBYTE _CNV_S_2_RANGE______3_CM 1 0. 0. 1. ECU_ADDRESS 0xd00063c0 BIT_MASK 0x1 /end MEASUREMENT
/begin MEASUREMENT lv_inh_fac_ad_knk "Application incidence for adaptation inhibition of global adaptation" UBYTE _CNV_S_2_RANGE______3_CM 1 0. 0. 1. ECU_ADDRESS 0xd00063c4 BIT_MASK 0x1 /end MEASUREMENT
/begin MEASUREMENT lv_inh_knk_ad_1 "Application incidence for adaptation inhibition of circuit 1 " UBYTE _CNV_S_2_RANGE______3_CM 1 0. 0. 1. ECU_ADDRESS 0xd00063c5 BIT_MASK 0x1 /end MEASUREMENT
/begin MEASUREMENT lv_inh_knk_ctl "Application incidence for inhibition of knock control" UBYTE _CNV_S_2_RANGE______3_CM 1 0. 0. 1. ECU_ADDRESS 0xd00063c6 BIT_MASK 0x1 /end MEASUREMENT
/begin MEASUREMENT lv_inh_knk_lih "Inhibition fag for knock limp home operation" UBYTE _CNV_S_2_RANGE______3_CM 1 0. 0. 1. ECU_ADDRESS 0xd00063c7 BIT_MASK 0x1 /end MEASUREMENT
/begin MEASUREMENT lv_inh_nl_ad_knk "Application incidence for knock adaptive gain" UBYTE _CNV_S_2_RANGE______3_CM 1 0. 0. 1. ECU_ADDRESS 0xd00063c8 BIT_MASK 0x1 /end MEASUREMENT
/begin MEASUREMENT lv_maf_tra_knk_act "Application incidence for activation of MAF transient for knock control" UBYTE _CNV_S_2_RANGE______3_CM 1 0. 0. 1. ECU_ADDRESS 0xd00063d3 BIT_MASK 0x1 /end MEASUREMENT
/begin MEASUREMENT lv_n_tra_knk_act "Application incidence for activation of N transient for knock control" UBYTE _CNV_S_2_RANGE______3_CM 1 0. 0. 1. ECU_ADDRESS 0xd00063d5 BIT_MASK 0x1 /end MEASUREMENT
/begin MEASUREMENT lv_nl_fil_gain_app "Flag generated by application incidence to use NL_FIL_GAIN_APP for noise calculation" UBYTE _CNV_S_2_RANGE______3_CM 1 0. 0. 1. ECU_ADDRESS 0xd00063d6 BIT_MASK 0x1 /end MEASUREMENT
/begin MEASUREMENT nl_fil_gain_app "Filter gain for noise value calculation, provided by application incidence, used when LV_NL_FIL_GAIN_APP is active" UBYTE _CNV_A_R_LINEAR_____29_CM 1 0. 0. 0.99609375 ECU_ADDRESS 0xd00063f7 FORMAT "%5.3" /end MEASUREMENT
/begin CHARACTERISTIC c_fac_ad_knk_app "Generation of FAC_AD_KNK_APP. Used for aggregate test" VALUE 0xa0020a51 _REC_S1VAL_20_u1 1. _CNV_A_R_LINEAR_____42_CM 0. 1. FORMAT "%8.6" /end CHARACTERISTIC
/begin CHARACTERISTIC c_nl_fil_gain_app "Application specific filter gain for noise calculation (test purpose)" VALUE 0xa0020a5f _REC_S1VAL_20_u1 0.99609375 _CNV_A_R_LINEAR_____29_CM 0. 0.99609375 FORMAT "%5.3" /end CHARACTERISTIC
/begin CHARACTERISTIC c_state_test_knk_app "Generation of application incidence flags for KNCK. Aggregate test use only ! Default value 0" VALUE 0xa0020a44 _REC_S1VAL_20_u2 65535. _CNV_A_R_ECME_LINEA_0_CM 0. 65535. FORMAT "%5.0" /end CHARACTERISTIC
/begin CHARACTERISTIC lc_knk_ad_clr "Logical value enabling reset of AD1, global adaptation and adaptive gain" VALUE 0xa0020a65 _REC_S1VAL_20_u1 1. _CNV_A_R_ECME_LINEA_0_CM 0. 1. FORMAT "%1.0" /end CHARACTERISTIC
/begin MEASUREMENT knk_loop_nr "Number of sw loop for knk filtering" UWORD _CNV_A_R_ECME_LINEA_0_CM 1 0. 0. 65535. ECU_ADDRESS 0xd0003d78 FORMAT "%5.0" /end MEASUREMENT
/begin MEASUREMENT knks[0] "Knock noise signal for cylinder x" UWORD _CNV_A_R_KNCK_LINEA_454_CM 1 0. 0. 4.99992371 ECU_ADDRESS 0xd0003d7a FORMAT "%7.5" /end MEASUREMENT
/begin MEASUREMENT knks[1] "Knock noise signal for cylinder x" UWORD _CNV_A_R_KNCK_LINEA_454_CM 1 0. 0. 4.99992371 ECU_ADDRESS 0xd0003d7c FORMAT "%7.5" /end MEASUREMENT
/begin MEASUREMENT knks[2] "Knock noise signal for cylinder x" UWORD _CNV_A_R_KNCK_LINEA_454_CM 1 0. 0. 4.99992371 ECU_ADDRESS 0xd0003d7e FORMAT "%7.5" /end MEASUREMENT
/begin MEASUREMENT knks[3] "Knock noise signal for cylinder x" UWORD _CNV_A_R_KNCK_LINEA_454_CM 1 0. 0. 4.99992371 ECU_ADDRESS 0xd0003d80 FORMAT "%7.5" /end MEASUREMENT
/begin MEASUREMENT lv_knk_acq_err "Boolean for acquisition error (failure) on the signal acquisition chain" UBYTE _CNV_S_2_RANGE______3_CM 1 0. 0. 1. ECU_ADDRESS 0xd00063ca BIT_MASK 0x1 /end MEASUREMENT
/begin MEASUREMENT state_knk_sw_acq_err "Shows on what cylinder there is an overlap in acquisition of Knk By Soft" UBYTE _CNV_A_R_ECME_LINEA_0_CM 1 0. 0. 255. ECU_ADDRESS 0xd00076e6 FORMAT "%3.0" /end MEASUREMENT
/begin CHARACTERISTIC ip_knks_err_rel[0] "Minimum threshold for relative knock failure detection (one threshold by sensor - typical value 0.06 volt)" CURVE 0xa00232d8 _REC_A1CUR_20_u2_u1 4.99992371 _CNV_A_R_KNCK_LINEA_454_CM 0. 4.99992371 FORMAT "%7.5"
 /begin AXIS_DESCR COM_AXIS n_32 _CNV_A_R_LINEAR_____2_CM 8 0. 8160. FORMAT "%4.0" AXIS_PTS_REF ldpm_n_32_1_knck /end AXIS_DESCR
/end CHARACTERISTIC
/begin MEASUREMENT ctr_err_sym_rel_knk[0] "Time counter for relative KNKS symptom filtering" UBYTE _CNV_A_R_LINEAR_____58_CM 1 0. 0. 25.5 ECU_ADDRESS 0xd00063f4 FORMAT "%4.1" /end MEASUREMENT
/begin MEASUREMENT knks_err_rel[0] "Absolute value of difference between KNKS[C_KNK_DIAG_CYL_IDC] and its sliding average" UWORD _CNV_A_R_KNCK_LINEA_454_CM 1 0. 0. 4.99992371 ECU_ADDRESS 0xd0004e44 FORMAT "%7.5" /end MEASUREMENT
/begin MEASUREMENT knks_mmv_diag[0] "Sliding average of KNKS[C_KNK_DIAG_CYL_NB]" UWORD _CNV_A_R_KNCK_LINEA_454_CM 1 0. 0. 4.99992371 ECU_ADDRESS 0xd0004e46 FORMAT "%7.5" /end MEASUREMENT
/begin MEASUREMENT lv_err_acq_knk "Boolean for confirmed error (failure) in acquisition chain (after de-bounce)" UBYTE _CNV_S_2_RANGE______3_CM 1 0. 0. 1. ECU_ADDRESS 0xd0007503 BIT_MASK 0x1 /end MEASUREMENT
/begin MEASUREMENT lv_err_bas_knk_0 "Error on basic knock signal after filtering" UBYTE _CNV_S_2_RANGE______3_CM 1 0. 0. 1. ECU_ADDRESS 0xd00064e9 BIT_MASK 0x1 /end MEASUREMENT
/begin MEASUREMENT lv_err_knk "Boolean for confirmed global error (failure) on the signal acquisition chain " UBYTE _CNV_S_2_RANGE______3_CM 1 0. 0. 1. ECU_ADDRESS 0xd00063bc BIT_MASK 0x1 /end MEASUREMENT
/begin MEASUREMENT lv_err_rel_knk_0 "Boolean for error on relative knock signal after filtering" UBYTE _CNV_S_2_RANGE______3_CM 1 0. 0. 1. ECU_ADDRESS 0xd00064ea BIT_MASK 0x1 /end MEASUREMENT
/begin MEASUREMENT lv_err_sym_knk "Boolean for instantaneous error (failure) on the signal acquisition chain" UBYTE _CNV_S_2_RANGE______3_CM 1 0. 0. 1. ECU_ADDRESS 0xd00063bd BIT_MASK 0x1 /end MEASUREMENT
/begin MEASUREMENT lv_thd_err_rel_knk[0] "Boolean for threshold for REL_KNK symptom reached" UBYTE _CNV_S_2_RANGE______3_CM 1 0. 0. 1. ECU_ADDRESS 0xd00076e5 BIT_MASK 0x1 /end MEASUREMENT
/begin MEASUREMENT nr_knk_sens "Knock sensor counter for sensor identification" UBYTE _CNV_A_R_ECME_LINEA_0_CM 1 0. 0. 3. ECU_ADDRESS 0xd00076ec FORMAT "%3.0" /end MEASUREMENT
/begin CHARACTERISTIC c_ctr_dec_err_sym_rel_knk "Decrement value for C_CTR_ERR_SYM_REL_KNK" VALUE 0xa0020a4d _REC_S1VAL_20_u1 25.5 _CNV_A_R_LINEAR_____58_CM 0. 25.5 FORMAT "%4.1" /end CHARACTERISTIC
/begin CHARACTERISTIC c_ctr_err_sym_rel_knk "Time value for relative KNKS symptom filtering" VALUE 0xa0020a4e _REC_S1VAL_20_u1 25.5 _CNV_A_R_LINEAR_____58_CM 0. 25.5 FORMAT "%4.1" /end CHARACTERISTIC
/begin CHARACTERISTIC c_knks_bas_diag "Minimum threshold of KNKS[C_KNK_DIAG_CYL_NB] to detect failure of the knock sensor (typical value 0.4V)" VALUE 0xa0020a3a _REC_S1VAL_20_u2 4.99992371 _CNV_A_R_KNCK_LINEA_454_CM 0. 4.99992371 FORMAT "%7.5" /end CHARACTERISTIC
/begin CHARACTERISTIC c_knks_diag_cyl_idc[0] "Studied cylinder for failing detection (typically the nearest of the sensor)" VALUE 0xa0020a56 _REC_S1VAL_20_u1 7. _CNV_A_R_ECME_LINEA_0_CM 0. 7. FORMAT "%3.0" /end CHARACTERISTIC
/begin CHARACTERISTIC c_knks_rel_err_fil "Slope of the filter KNKS_MMV_DIAG (typical value 0.25: smooth the noise for 4 cycles - do not use too small value: minimum 0.1)" VALUE 0xa0020a57 _REC_S1VAL_20_u1 0.99609375 _CNV_A_R_LINEAR_____29_CM 0. 0.99609375 FORMAT "%5.3" /end CHARACTERISTIC
/begin CHARACTERISTIC c_maf_min_diag_knk "Minimum load for knock failure detection enabled (typical value 200 mbar)" VALUE 0xa0020a58 _REC_S1VAL_20_u1 1389. _CNV_A_R_LINEAR_____77_CM 0. 1389. FORMAT "%4.0" /end CHARACTERISTIC
/begin CHARACTERISTIC c_n_32_min_diag_knk "Minimum engine speed for knock failure detection enabled (typical value 1500 rpm)" VALUE 0xa0020a5a _REC_S1VAL_20_u1 8160. _CNV_A_R_LINEAR_____2_CM 0. 8160. FORMAT "%4.0" /end CHARACTERISTIC
/begin CHARACTERISTIC c_tco_diag_knk "Minimum threshold of TCO to detect failure of the knock sensor (typical value 60 °C)" VALUE 0xa0020a63 _REC_S1VAL_20_u1 190.5 _CNV_A_R_LINEAR_____41_CM -48. 142.5 FORMAT "%6.2" /end CHARACTERISTIC
/begin MEASUREMENT lv_inh_diag_acq_knk "Inhibition flag for knock acquisition chain diagnosis" UBYTE _CNV_S_2_RANGE______3_CM 1 0. 0. 1. ECU_ADDRESS 0xd00063c1 BIT_MASK 0x1 /end MEASUREMENT
/begin MEASUREMENT lv_inh_diag_bas_knk "Inhibition flag for knock sensor basic diagnosis" UBYTE _CNV_S_2_RANGE______3_CM 1 0. 0. 1. ECU_ADDRESS 0xd00063c2 BIT_MASK 0x1 /end MEASUREMENT
/begin MEASUREMENT lv_inh_diag_rel_knk "Inhibition flag for knock sensor relative diagnosis" UBYTE _CNV_S_2_RANGE______3_CM 1 0. 0. 1. ECU_ADDRESS 0xd00063c3 BIT_MASK 0x1 /end MEASUREMENT
/begin MEASUREMENT Vbx_diag_ena_comb_bas_req "Boolean indicates a request of combustion mode for OBD analysis" UBYTE _CNV_S_2_RANGE______3_CM 1 0. 0. 1. ECU_ADDRESS 0xd000798f BIT_MASK 0x1 /end MEASUREMENT
/begin MEASUREMENT Vbx_htg_dsb "Boolean indicating heating glow plug command disable (default to 1)" UBYTE _CNV_S_2_RANGE______3_CM 1 0. 0. 1. ECU_ADDRESS 0xd0007990 BIT_MASK 0x1 /end MEASUREMENT
/begin MEASUREMENT Vbx_msk_iupr_cfm "Flag indicating that masked IUPR is active" UBYTE _CNV_S_2_RANGE______3_CM 1 0. 0. 1. ECU_ADDRESS 0xd0007991 BIT_MASK 0x1 /end MEASUREMENT
/begin MEASUREMENT Vbx_owe_tool_ini_req "Boolean sent by the diagnosis tool to initialise the strategy in case of oil drain" UBYTE _CNV_S_2_RANGE______3_CM 1 0. 0. 1. ECU_ADDRESS 0xd0007992 BIT_MASK 0x1 /end MEASUREMENT
/begin MEASUREMENT Vsx_owe_tool_zon_req "Geographical zon selection request from the diagnosis tool" UBYTE _CNV_A_R_ECME_LINEA_0_CM 1 0. 1. 5. ECU_ADDRESS 0xd0007993 FORMAT "%1.0" /end MEASUREMENT
/begin MEASUREMENT Vxx_diag_comb_bas "OBD request of active combustion mode" UBYTE _CNV_A_R_ECME_LINEA_0_CM 1 0. 1. 15. ECU_ADDRESS 0xd0007994 FORMAT "%2.0" /end MEASUREMENT
/begin CHARACTERISTIC Cbx_msk_iupr_cfm "Flag configuration indicating Masked IUPR activation" VALUE 0xa00211c0 _REC_S1VAL_20_u1 1. _CNV_A_R_ECME_LINEA_0_CM 0. 1. FORMAT "%1.0" BIT_MASK 0x1 /end CHARACTERISTIC
/begin CHARACTERISTIC Cbx_s06_fsys_cpt_old "(=1) Old fuel system diagnostic activated" VALUE 0xa00211c1 _REC_S1VAL_20_u1 1. _CNV_S_2_RANGE______3_CM 0. 1. BIT_MASK 0x1 /end CHARACTERISTIC
/begin CHARACTERISTIC Cxx_c_id1 "ASCII value of the first character of the CALID#2" VALUE 0xa00211c2 _REC_S1VAL_20_u1 255. _CNV_A_R_ECME_LINEA_0_CM 0. 255. FORMAT "%3.0" /end CHARACTERISTIC
/begin CHARACTERISTIC Cxx_c_id10 "ASCII value of the tenth character of the CALID#2" VALUE 0xa00211c3 _REC_S1VAL_20_u1 255. _CNV_A_R_ECME_LINEA_0_CM 0. 255. FORMAT "%3.0" /end CHARACTERISTIC
/begin CHARACTERISTIC Cxx_c_id11 "ASCII value of the eleventh character of the CALID#2" VALUE 0xa00211c4 _REC_S1VAL_20_u1 255. _CNV_A_R_ECME_LINEA_0_CM 0. 255. FORMAT "%3.0" /end CHARACTERISTIC
/begin CHARACTERISTIC Cxx_c_id12 "ASCII value of the twelfth character of the CALID#2" VALUE 0xa00211c5 _REC_S1VAL_20_u1 255. _CNV_A_R_ECME_LINEA_0_CM 0. 255. FORMAT "%3.0" /end CHARACTERISTIC
/begin CHARACTERISTIC Cxx_c_id13 "ASCII value of the thirteenth character of the CALID#2" VALUE 0xa00211c6 _REC_S1VAL_20_u1 255. _CNV_A_R_ECME_LINEA_0_CM 0. 255. FORMAT "%3.0" /end CHARACTERISTIC
/begin CHARACTERISTIC Cxx_c_id14 "ASCII value of the fourteenth character of the CALID#2" VALUE 0xa00211c7 _REC_S1VAL_20_u1 255. _CNV_A_R_ECME_LINEA_0_CM 0. 255. FORMAT "%3.0" /end CHARACTERISTIC
/begin CHARACTERISTIC Cxx_c_id15 "ASCII value of the fifteenth character of the CALID#2" VALUE 0xa00211c8 _REC_S1VAL_20_u1 255. _CNV_A_R_ECME_LINEA_0_CM 0. 255. FORMAT "%3.0" /end CHARACTERISTIC
/begin CHARACTERISTIC Cxx_c_id16 "ASCII value of the sixteenth character of the CALID#2" VALUE 0xa00211c9 _REC_S1VAL_20_u1 255. _CNV_A_R_ECME_LINEA_0_CM 0. 255. FORMAT "%3.0" /end CHARACTERISTIC
/begin CHARACTERISTIC Cxx_c_id2 "ASCII value of the second character of the CALID#2" VALUE 0xa00211ca _REC_S1VAL_20_u1 255. _CNV_A_R_ECME_LINEA_0_CM 0. 255. FORMAT "%3.0" /end CHARACTERISTIC
/begin CHARACTERISTIC Cxx_c_id3 "ASCII value of the third character of the CALID#2" VALUE 0xa00211cb _REC_S1VAL_20_u1 255. _CNV_A_R_ECME_LINEA_0_CM 0. 255. FORMAT "%3.0" /end CHARACTERISTIC
/begin CHARACTERISTIC Cxx_c_id4 "ASCII value of the fourth character of the CALID#2" VALUE 0xa00211cc _REC_S1VAL_20_u1 255. _CNV_A_R_ECME_LINEA_0_CM 0. 255. FORMAT "%3.0" /end CHARACTERISTIC
/begin CHARACTERISTIC Cxx_c_id5 "ASCII value of the fifth character of the CALID#2" VALUE 0xa00211cd _REC_S1VAL_20_u1 255. _CNV_A_R_ECME_LINEA_0_CM 0. 255. FORMAT "%3.0" /end CHARACTERISTIC
/begin CHARACTERISTIC Cxx_c_id6 "ASCII value of the sixth character of the CALID#2" VALUE 0xa00211ce _REC_S1VAL_20_u1 255. _CNV_A_R_ECME_LINEA_0_CM 0. 255. FORMAT "%3.0" /end CHARACTERISTIC
/begin CHARACTERISTIC Cxx_c_id7 "ASCII value of the seventh character of the CALID#2" VALUE 0xa00211cf _REC_S1VAL_20_u1 255. _CNV_A_R_ECME_LINEA_0_CM 0. 255. FORMAT "%3.0" /end CHARACTERISTIC
/begin CHARACTERISTIC Cxx_c_id8 "ASCII value of the eighth character of the CALID#2" VALUE 0xa00211d0 _REC_S1VAL_20_u1 255. _CNV_A_R_ECME_LINEA_0_CM 0. 255. FORMAT "%3.0" /end CHARACTERISTIC
/begin CHARACTERISTIC Cxx_c_id9 "ASCII value of the ninth character of the CALID#2" VALUE 0xa00211d1 _REC_S1VAL_20_u1 255. _CNV_A_R_ECME_LINEA_0_CM 0. 255. FORMAT "%3.0" /end CHARACTERISTIC
/begin CHARACTERISTIC Cxx_did_205F_writ_max "Maximum value authorized to write on DID $205F" VALUE 0xa0021188 _REC_S1VAL_20_u2 16383.75 _CNV_A_R_ENSD_LINEA_22_CM 0. 16383.75 FORMAT "%8.2" /end CHARACTERISTIC
/begin CHARACTERISTIC Cxx_did_205F_writ_min "Minimum value authorized to write on DID $205F" VALUE 0xa002118a _REC_S1VAL_20_u2 16383.75 _CNV_A_R_ENSD_LINEA_22_CM 0. 16383.75 FORMAT "%8.2" /end CHARACTERISTIC
/begin CHARACTERISTIC Cxx_did_2105_writ_max "Maximum value authorized to write on DID $2105" VALUE 0xa00211e0 _REC_S1VAL_20_u1 4. _CNV_A_R_ECME_LINEA_0_CM 1. 5. FORMAT "%3.0" /end CHARACTERISTIC
/begin CHARACTERISTIC Cxx_did_2105_writ_min "Minimum value authorized to write on DID $205F" VALUE 0xa00211e1 _REC_S1VAL_20_u1 4. _CNV_A_R_ECME_LINEA_0_CM 1. 5. FORMAT "%3.0" /end CHARACTERISTIC
/begin CHARACTERISTIC Cxx_did_210E_writ_max "Maximum value authorized to write on DID $210E" VALUE 0xa002118c _REC_S1VAL_20_u4 300000000. _CNV_A_R_LINEAR_____457_CM 0. 300000000. FORMAT "%10.0" /end CHARACTERISTIC
/begin CHARACTERISTIC Cxx_did_210E_writ_min "Minimum value authorized to write on DID $210E" VALUE 0xa0021190 _REC_S1VAL_20_u4 300000000. _CNV_A_R_LINEAR_____457_CM 0. 300000000. FORMAT "%10.0" /end CHARACTERISTIC
/begin CHARACTERISTIC Cxx_did_2113_writ_max "Maximum value authorized to write on DID $2113" VALUE 0xa0021194 _REC_S1VAL_20_u2 240. _CNV_A_R_LINEAR_____110_CM -40. 200. FORMAT "%5.1" /end CHARACTERISTIC
/begin CHARACTERISTIC Cxx_did_2113_writ_min "Minimum value authorized to write on DID $2113" VALUE 0xa0021196 _REC_S1VAL_20_u2 240. _CNV_A_R_LINEAR_____110_CM -40. 200. FORMAT "%5.1" /end CHARACTERISTIC
/begin CHARACTERISTIC Cxx_did_2141_writ_max "Maximum value authorized to write on DID $2141" VALUE 0xa0021198 _REC_S1VAL_20_u2 4096. _CNV_A_R_ECME_LINEA_0_CM 0. 4096. FORMAT "%5.0" /end CHARACTERISTIC
/begin CHARACTERISTIC Cxx_did_2141_writ_min "Minimum value authorized to write on DID $2141" VALUE 0xa002119a _REC_S1VAL_20_u2 4096. _CNV_A_R_ECME_LINEA_0_CM 0. 4096. FORMAT "%5.0" /end CHARACTERISTIC
/begin CHARACTERISTIC Cxx_did_2143_writ_max "Maximum value authorized to write on DID $2143" VALUE 0xa002119c _REC_S1VAL_20_u2 4096. _CNV_A_R_ECME_LINEA_0_CM 0. 4096. FORMAT "%5.0" /end CHARACTERISTIC
/begin CHARACTERISTIC Cxx_did_2143_writ_min "Minimum value authorized to write on DID $2143" VALUE 0xa002119e _REC_S1VAL_20_u2 4096. _CNV_A_R_ECME_LINEA_0_CM 0. 4096. FORMAT "%5.0" /end CHARACTERISTIC
/begin CHARACTERISTIC Cxx_did_2147_writ_max "Maximum value authorized to write on DID $2147" VALUE 0xa00211e2 _REC_S1VAL_20_u1 2. _CNV_A_R_ECME_LINEA_0_CM 0. 2. FORMAT "%3.0" /end CHARACTERISTIC
/begin CHARACTERISTIC Cxx_did_2147_writ_min "Minimum value authorized to write on DID $2147" VALUE 0xa00211e3 _REC_S1VAL_20_u1 2. _CNV_A_R_ECME_LINEA_0_CM 0. 2. FORMAT "%3.0" /end CHARACTERISTIC
/begin CHARACTERISTIC Cxx_did_2156_writ_max "Maximum value authorized to write on DID $2156" VALUE 0xa00211e4 _REC_S1VAL_20_u1 6. _CNV_A_R_ECME_LINEA_0_CM 0. 6. FORMAT "%3.0" /end CHARACTERISTIC
/begin CHARACTERISTIC Cxx_did_2156_writ_min "Minimum value authorized to write on DID $2156" VALUE 0xa00211e5 _REC_S1VAL_20_u1 6. _CNV_A_R_ECME_LINEA_0_CM 0. 6. FORMAT "%3.0" /end CHARACTERISTIC
/begin CHARACTERISTIC Cxx_did_219B_writ_max "Maximum value authorized to write on DID $219B" VALUE 0xa00211a0 _REC_S1VAL_20_u2 30. _CNV_A_R_LINEAR_____125_CM 0. 30. FORMAT "%5.2" /end CHARACTERISTIC
/begin CHARACTERISTIC Cxx_did_219B_writ_min "Minimum value authorized to write on DID $219B" VALUE 0xa00211a2 _REC_S1VAL_20_u2 30. _CNV_A_R_LINEAR_____125_CM 0. 30. FORMAT "%5.2" /end CHARACTERISTIC
/begin CHARACTERISTIC Cxx_did_2457_writ_max "Maximum value authorized to write on DID $2457" VALUE 0xa00211a4 _REC_S1VAL_20_u2 100. _CNV_A_R_LINEAR_____150_CM 0. 100. FORMAT "%6.2" /end CHARACTERISTIC
/begin CHARACTERISTIC Cxx_did_2457_writ_min "Minimum value authorized to write on DID $2457" VALUE 0xa00211a6 _REC_S1VAL_20_u2 100. _CNV_A_R_LINEAR_____150_CM 0. 100. FORMAT "%6.2" /end CHARACTERISTIC
/begin CHARACTERISTIC Cxx_did_2458_writ_max "Maximum value authorized to write on DID $2458" VALUE 0xa00211a8 _REC_S1VAL_20_u2 100. _CNV_A_R_LINEAR_____150_CM 0. 100. FORMAT "%6.2" /end CHARACTERISTIC
/begin CHARACTERISTIC Cxx_did_2458_writ_min "Minimum value authorized to write on DID $2458" VALUE 0xa00211aa _REC_S1VAL_20_u2 100. _CNV_A_R_LINEAR_____150_CM 0. 100. FORMAT "%6.2" /end CHARACTERISTIC
/begin CHARACTERISTIC Cxx_did_2459_writ_max "Maximum value authorized to write on DID $2459" VALUE 0xa00211ac _REC_S1VAL_20_u2 100. _CNV_A_R_LINEAR_____150_CM 0. 100. FORMAT "%6.2" /end CHARACTERISTIC
/begin CHARACTERISTIC Cxx_did_2459_writ_min "Minimum value authorized to write on DID $2459" VALUE 0xa00211ae _REC_S1VAL_20_u2 100. _CNV_A_R_LINEAR_____150_CM 0. 100. FORMAT "%6.2" /end CHARACTERISTIC
/begin CHARACTERISTIC Cxx_did_245A_writ_max "Maximum value authorized to write on DID $245A" VALUE 0xa00211b0 _REC_S1VAL_20_u2 100. _CNV_A_R_LINEAR_____150_CM 0. 100. FORMAT "%6.2" /end CHARACTERISTIC
/begin CHARACTERISTIC Cxx_did_245A_writ_min "Minimum value authorized to write on DID $245A" VALUE 0xa00211b2 _REC_S1VAL_20_u2 100. _CNV_A_R_LINEAR_____150_CM 0. 100. FORMAT "%6.2" /end CHARACTERISTIC
/begin CHARACTERISTIC Cxx_did_245B_writ_max "Maximum value authorized to write on DID $245B" VALUE 0xa00211b4 _REC_S1VAL_20_u2 100. _CNV_A_R_LINEAR_____150_CM 0. 100. FORMAT "%6.2" /end CHARACTERISTIC
/begin CHARACTERISTIC Cxx_did_245B_writ_min "Minimum value authorized to write on DID $245B" VALUE 0xa00211b6 _REC_S1VAL_20_u2 100. _CNV_A_R_LINEAR_____150_CM 0. 100. FORMAT "%6.2" /end CHARACTERISTIC
/begin CHARACTERISTIC Cxx_did_245C_writ_max "Maximum value authorized to write on DID $245C" VALUE 0xa00211b8 _REC_S1VAL_20_u2 100. _CNV_A_R_LINEAR_____150_CM 0. 100. FORMAT "%6.2" /end CHARACTERISTIC
/begin CHARACTERISTIC Cxx_did_245C_writ_min "Minimum value authorized to write on DID $245C" VALUE 0xa00211ba _REC_S1VAL_20_u2 100. _CNV_A_R_LINEAR_____150_CM 0. 100. FORMAT "%6.2" /end CHARACTERISTIC
/begin CHARACTERISTIC Cxx_did_24C9_writ_max "Maximum value authorized to write on DID $24C9" VALUE 0xa00211bc _REC_S1VAL_20_u2 100. _CNV_A_R_LINEAR_____150_CM 0. 100. FORMAT "%6.2" /end CHARACTERISTIC
/begin CHARACTERISTIC Cxx_did_24C9_writ_min "Minimum value authorized to write on DID $24C9" VALUE 0xa00211be _REC_S1VAL_20_u2 100. _CNV_A_R_LINEAR_____150_CM 0. 100. FORMAT "%6.2" /end CHARACTERISTIC
/begin CHARACTERISTIC Cxx_did_287F_writ_max "Maximum value authorized to write on DID $287F" VALUE 0xa00211e6 _REC_S1VAL_20_u1 80. _CNV_A_R_LINEAR_____65_CM 0. 80. FORMAT "%3.0" /end CHARACTERISTIC
/begin CHARACTERISTIC Cxx_did_287F_writ_min "Minimum value authorized to write on DID $287F" VALUE 0xa00211e7 _REC_S1VAL_20_u1 80. _CNV_A_R_LINEAR_____65_CM 0. 80. FORMAT "%3.0" /end CHARACTERISTIC
/begin CHARACTERISTIC Cxx_obd_cert_nr1 "Approval number 1" VALUE 0xa00211d2 _REC_S1VAL_20_u1 255. _CNV_A_R_ECME_LINEA_0_CM 0. 255. FORMAT "%3.0" /end CHARACTERISTIC
/begin CHARACTERISTIC Cxx_obd_cert_nr10 "Approval number 10" VALUE 0xa00211d3 _REC_S1VAL_20_u1 255. _CNV_A_R_ECME_LINEA_0_CM 0. 255. FORMAT "%3.0" /end CHARACTERISTIC
/begin CHARACTERISTIC Cxx_obd_cert_nr2 "Approval number 2" VALUE 0xa00211d4 _REC_S1VAL_20_u1 255. _CNV_A_R_ECME_LINEA_0_CM 0. 255. FORMAT "%3.0" /end CHARACTERISTIC
/begin CHARACTERISTIC Cxx_obd_cert_nr3 "Approval number 3" VALUE 0xa00211d5 _REC_S1VAL_20_u1 255. _CNV_A_R_ECME_LINEA_0_CM 0. 255. FORMAT "%3.0" /end CHARACTERISTIC
/begin CHARACTERISTIC Cxx_obd_cert_nr4 "Approval number 4" VALUE 0xa00211d6 _REC_S1VAL_20_u1 255. _CNV_A_R_ECME_LINEA_0_CM 0. 255. FORMAT "%3.0" /end CHARACTERISTIC
/begin CHARACTERISTIC Cxx_obd_cert_nr5 "Approval number 5" VALUE 0xa00211d7 _REC_S1VAL_20_u1 255. _CNV_A_R_ECME_LINEA_0_CM 0. 255. FORMAT "%3.0" /end CHARACTERISTIC
/begin CHARACTERISTIC Cxx_obd_cert_nr6 "Approval number 6" VALUE 0xa00211d8 _REC_S1VAL_20_u1 255. _CNV_A_R_ECME_LINEA_0_CM 0. 255. FORMAT "%3.0" /end CHARACTERISTIC
/begin CHARACTERISTIC Cxx_obd_cert_nr7 "Approval number 7" VALUE 0xa00211d9 _REC_S1VAL_20_u1 255. _CNV_A_R_ECME_LINEA_0_CM 0. 255. FORMAT "%3.0" /end CHARACTERISTIC
/begin CHARACTERISTIC Cxx_obd_cert_nr8 "Approval number 8" VALUE 0xa00211da _REC_S1VAL_20_u1 255. _CNV_A_R_ECME_LINEA_0_CM 0. 255. FORMAT "%3.0" /end CHARACTERISTIC
/begin CHARACTERISTIC Cxx_obd_cert_nr9 "Approval number 9" VALUE 0xa00211db _REC_S1VAL_20_u1 255. _CNV_A_R_ECME_LINEA_0_CM 0. 255. FORMAT "%3.0" /end CHARACTERISTIC
/begin CHARACTERISTIC Cxx_obd_conf_diag_prmt "" VALUE 0xa00211dc _REC_S1VAL_20_u1 255. _CNV_A_R_ECME_LINEA_0_CM 0. 255. FORMAT "%3.0" /end CHARACTERISTIC
/begin CHARACTERISTIC Cxx_obd_conf_diag_schd "" VALUE 0xa00211dd _REC_S1VAL_20_u1 255. _CNV_A_R_ECME_LINEA_0_CM 0. 255. FORMAT "%3.0" /end CHARACTERISTIC
/begin CHARACTERISTIC Cxx_obd_conf_lamb "" VALUE 0xa00211de _REC_S1VAL_20_u1 255. _CNV_A_R_ECME_LINEA_0_CM 0. 255. FORMAT "%3.0" /end CHARACTERISTIC
/begin CHARACTERISTIC Cxx_obd_conf_obd "OBD requirements to which the vehicle is designed" VALUE 0xa00211df _REC_S1VAL_20_u1 255. _CNV_A_R_ECME_LINEA_0_CM 0. 255. FORMAT "%3.0" /end CHARACTERISTIC
/begin MEASUREMENT Vxx_chks_c_sw_1 "Most significant byte of the CVN" UWORD _CNV_A_R_ECME_LINEA_0_CM 1 0. 0. 65535. ECU_ADDRESS 0xd0005e62 FORMAT "%5.0" /end MEASUREMENT
/begin MEASUREMENT Vxx_chks_c_sw_2 "Less significant byte of the CVN" UWORD _CNV_A_R_ECME_LINEA_0_CM 1 0. 0. 65535. ECU_ADDRESS 0xd0005e64 FORMAT "%5.0" /end MEASUREMENT
/begin MEASUREMENT Vxx_obd_eal "Calculated Load Value for the scantool" UBYTE _CNV_A_R_LINEAR_____165_CM 1 0. 0. 100. ECU_ADDRESS 0xd000798e FORMAT "%12.8" /end MEASUREMENT
/begin MEASUREMENT Vxx_bus_off_stt_ctr_mem "Bus Off Control Unit : current failures non-volatile counter" UBYTE _CNV_A_R_ECME_LINEA_0_CM 1 0. 0. 255. DISPLAY_IDENTIFIER CmMuxSer_NVM.Vxx_bus_off_stt_ctr_mem_NVM ECU_ADDRESS 0xd0006854 FORMAT "%3.0" /end MEASUREMENT
/begin MEASUREMENT Vxx_mute_stt_ctr_mem "Mute : current failures non-volatile counter" UBYTE _CNV_A_R_ECME_LINEA_0_CM 1 0. 0. 255. DISPLAY_IDENTIFIER CmMuxSer_NVM.Vxx_mute_stt_ctr_mem_NVM ECU_ADDRESS 0xd0006855 FORMAT "%3.0" /end MEASUREMENT
/begin MEASUREMENT Vxx_abs_ecu_stt_ctr_mem "Brake Control Unit : current failures non-volatile counter" UBYTE _CNV_A_R_ECME_LINEA_0_CM 1 0. 0. 255. DISPLAY_IDENTIFIER CmMuxSer_NVM.Vxx_abs_ecu_stt_ctr_mem_NVM ECU_ADDRESS 0xd0006856 FORMAT "%3.0" /end MEASUREMENT
/begin MEASUREMENT Vxx_agb_ecu_stt_ctr_mem "Automatic Gear Box Control Unit : current failures non-volatile counter" UBYTE _CNV_A_R_ECME_LINEA_0_CM 1 0. 0. 255. DISPLAY_IDENTIFIER CmMuxSer_NVM.Vxx_agb_ecu_stt_ctr_mem_NVM ECU_ADDRESS 0xd0006857 FORMAT "%3.0" /end MEASUREMENT
/begin MEASUREMENT Vxx_ccu_ecu_stt_ctr_mem "BCM Control Unit : current failures non-volatile counter" UBYTE _CNV_A_R_ECME_LINEA_0_CM 1 0. 0. 255. DISPLAY_IDENTIFIER CmMuxSer_NVM.Vxx_ccu_ecu_stt_ctr_mem_NVM ECU_ADDRESS 0xd0006858 FORMAT "%3.0" /end MEASUREMENT
/begin MEASUREMENT Vxx_ddcm_ecu_stt_ctr_mem "DDCM Control Unit : current failures non-volatile counter" UBYTE _CNV_A_R_ECME_LINEA_0_CM 1 0. 0. 255. DISPLAY_IDENTIFIER CmMuxSer_NVM.Vxx_ddcm_ecu_stt_ctr_mem_NVM ECU_ADDRESS 0xd0006859 FORMAT "%3.0" /end MEASUREMENT
/begin MEASUREMENT Vxx_ip_ecu_stt_ctr_mem "Cluster Control Unit : current failures non-volatile counter" UBYTE _CNV_A_R_ECME_LINEA_0_CM 1 0. 0. 255. DISPLAY_IDENTIFIER CmMuxSer_NVM.Vxx_ip_ecu_stt_ctr_mem_NVM ECU_ADDRESS 0xd000685a FORMAT "%3.0" /end MEASUREMENT
/begin MEASUREMENT Vxx_etc_ecu_stt_ctr_mem "ETC Control Unit : current failures non-volatile counter" UBYTE _CNV_A_R_ECME_LINEA_0_CM 1 0. 0. 255. DISPLAY_IDENTIFIER CmMuxSer_NVM.Vxx_etc_ecu_stt_ctr_mem_NVM ECU_ADDRESS 0xd000685b FORMAT "%3.0" /end MEASUREMENT
/begin MEASUREMENT Vxx_usm_ecu_stt_ctr_mem "USM Control Unit : current failures non-volatile counter" UBYTE _CNV_A_R_ECME_LINEA_0_CM 1 0. 0. 255. DISPLAY_IDENTIFIER CmMuxSer_NVM.Vxx_usm_ecu_stt_ctr_mem_NVM ECU_ADDRESS 0xd000685c FORMAT "%3.0" /end MEASUREMENT
/begin MEASUREMENT Vxx_ac_ecu_stt_ctr_mem "Climate Control Unit : current failures non-volatile counter" UBYTE _CNV_A_R_ECME_LINEA_0_CM 1 0. 0. 255. DISPLAY_IDENTIFIER CmMuxSer_NVM.Vxx_ac_ecu_stt_ctr_mem_NVM ECU_ADDRESS 0xd000685d FORMAT "%3.0" /end MEASUREMENT
/begin MEASUREMENT Vxx_acc_ecu_stt_ctr_mem "Automatic Cruise Control Unit : current failures non-volatile counter" UBYTE _CNV_A_R_ECME_LINEA_0_CM 1 0. 0. 255. DISPLAY_IDENTIFIER CmMuxSer_NVM.Vxx_acc_ecu_stt_ctr_mem_NVM ECU_ADDRESS 0xd000685e FORMAT "%3.0" /end MEASUREMENT
/begin MEASUREMENT Vxx_swa_ecu_stt_ctr_mem "Steering Wheel Angle Control Unit : current failures non-volatile counter" UBYTE _CNV_A_R_ECME_LINEA_0_CM 1 0. 0. 255. DISPLAY_IDENTIFIER CmMuxSer_NVM.Vxx_swa_ecu_stt_ctr_mem_NVM ECU_ADDRESS 0xd000685f FORMAT "%3.0" /end MEASUREMENT
/begin MEASUREMENT Vbx_abs_lk_stt "Mux Network configuration detection : Brake Control Unit status" UBYTE _CNV_S_2_RANGE______3_CM 1 0. 0. 1. DISPLAY_IDENTIFIER CmMuxSer_NVM.Vbx_abs_lk_stt_NVM ECU_ADDRESS 0xd0006860 BIT_MASK 0x1 /end MEASUREMENT
/begin MEASUREMENT Vbx_agb_lk_stt "The transmission is automatic (known as soon as an AT frame is received)" UBYTE _CNV_S_2_RANGE______3_CM 1 0. 0. 1. DISPLAY_IDENTIFIER CmMuxSer_NVM.Vbx_agb_lk_stt_NVM ECU_ADDRESS 0xd0006861 BIT_MASK 0x1 /end MEASUREMENT
/begin MEASUREMENT Vbx_ccu_lk_stt "Mux Network configuration detection : BCM Control Unit Status" UBYTE _CNV_S_2_RANGE______3_CM 1 0. 0. 1. DISPLAY_IDENTIFIER CmMuxSer_NVM.Vbx_ccu_lk_stt_NVM ECU_ADDRESS 0xd0006862 BIT_MASK 0x1 /end MEASUREMENT
/begin MEASUREMENT Vbx_ip_lk_stt "Mux Network configuration detection : Cluster Control Unit Status" UBYTE _CNV_S_2_RANGE______3_CM 1 0. 0. 1. DISPLAY_IDENTIFIER CmMuxSer_NVM.Vbx_ip_lk_stt_NVM ECU_ADDRESS 0xd0006863 BIT_MASK 0x1 /end MEASUREMENT
/begin MEASUREMENT Vbx_usm_lk_stt "Mux Network configuration detection : USM Control Unit Status" UBYTE _CNV_S_2_RANGE______3_CM 1 0. 0. 1. DISPLAY_IDENTIFIER CmMuxSer_NVM.Vbx_usm_lk_stt_NVM ECU_ADDRESS 0xd0006864 BIT_MASK 0x1 /end MEASUREMENT
/begin MEASUREMENT Vbx_acc_lk_stt "ACC frame presence detection with security on configuration detection. Stored in E²PROM" UBYTE _CNV_S_2_RANGE______3_CM 1 0. 0. 1. DISPLAY_IDENTIFIER CmMuxSer_NVM.Vbx_acc_lk_stt_NVM ECU_ADDRESS 0xd0006865 BIT_MASK 0x1 /end MEASUREMENT
/begin MEASUREMENT Vbx_ac_lk_stt "Mux Network configuration detection : Air Conditioning Control Unit Status" UBYTE _CNV_S_2_RANGE______3_CM 1 0. 0. 1. DISPLAY_IDENTIFIER CmMuxSer_NVM.Vbx_ac_lk_stt_NVM ECU_ADDRESS 0xd0006866 BIT_MASK 0x1 /end MEASUREMENT
/begin MEASUREMENT Vbx_sdl_lk_stt "Detect the Speed Distance Limiter option. Stored in E²PROM." UBYTE _CNV_S_2_RANGE______3_CM 1 0. 0. 1. DISPLAY_IDENTIFIER CmMuxSer_NVM.Vbx_sdl_lk_stt_NVM ECU_ADDRESS 0xd0006867 BIT_MASK 0x1 /end MEASUREMENT
/begin MEASUREMENT Vbx_swa_lk_stt "Mux Network configuration detection: Steering Wheel Angle Unit status" UBYTE _CNV_S_2_RANGE______3_CM 1 0. 0. 1. DISPLAY_IDENTIFIER CmMuxSer_NVM.Vbx_swa_lk_stt_NVM ECU_ADDRESS 0xd0006868 BIT_MASK 0x1 /end MEASUREMENT
/begin MEASUREMENT Vbx_ddcm_lk_stt "Mux Network configuration detection : Driver Door Control Module status" UBYTE _CNV_S_2_RANGE______3_CM 1 0. 0. 1. DISPLAY_IDENTIFIER CmMuxSer_NVM.Vbx_ddcm_lk_stt_NVM ECU_ADDRESS 0xd0006869 BIT_MASK 0x1 /end MEASUREMENT
/begin MEASUREMENT Vbx_etc_lk_stt "Mux Network configuration detection : Electronic Traction Control status" UBYTE _CNV_S_2_RANGE______3_CM 1 0. 0. 1. DISPLAY_IDENTIFIER CmMuxSer_NVM.Vbx_etc_lk_stt_NVM ECU_ADDRESS 0xd000686a BIT_MASK 0x1 /end MEASUREMENT
/begin MEASUREMENT AIRBAGCrash[0] "Received CAN frame" UBYTE _CNV_A_R_A_105_CM 1 0. 0. 255. ECU_ADDRESS 0xd0007884 /end MEASUREMENT
/begin MEASUREMENT AIRBAGCrash[1] "Received CAN frame" UBYTE _CNV_A_R_A_105_CM 1 0. 0. 255. ECU_ADDRESS 0xd0007885 /end MEASUREMENT
/begin MEASUREMENT BCM_CANHS_RNr_01[0] "Received CAN frame" UBYTE _CNV_A_R_A_105_CM 1 0. 0. 255. ECU_ADDRESS 0xd000686c /end MEASUREMENT
/begin MEASUREMENT BCM_CANHS_RNr_01[1] "Received CAN frame" UBYTE _CNV_A_R_A_105_CM 1 0. 0. 255. ECU_ADDRESS 0xd000686d /end MEASUREMENT
/begin MEASUREMENT BCM_CANHS_RNr_01[2] "Received CAN frame" UBYTE _CNV_A_R_A_105_CM 1 0. 0. 255. ECU_ADDRESS 0xd000686e /end MEASUREMENT
/begin MEASUREMENT BCM_CANHS_RNr_01[3] "Received CAN frame" UBYTE _CNV_A_R_A_105_CM 1 0. 0. 255. ECU_ADDRESS 0xd000686f /end MEASUREMENT
/begin MEASUREMENT BCM_CANHS_RNr_01[4] "Received CAN frame" UBYTE _CNV_A_R_A_105_CM 1 0. 0. 255. ECU_ADDRESS 0xd0006870 /end MEASUREMENT
/begin MEASUREMENT BCM_CANHS_RNr_01[5] "Received CAN frame" UBYTE _CNV_A_R_A_105_CM 1 0. 0. 255. ECU_ADDRESS 0xd0006871 /end MEASUREMENT
/begin MEASUREMENT BCM_CANHS_RNr_01[6] "Received CAN frame" UBYTE _CNV_A_R_A_105_CM 1 0. 0. 255. ECU_ADDRESS 0xd0006872 /end MEASUREMENT
/begin MEASUREMENT BCM_CANHS_RNr_01[7] "Received CAN frame" UBYTE _CNV_A_R_A_105_CM 1 0. 0. 255. ECU_ADDRESS 0xd0006873 /end MEASUREMENT
/begin MEASUREMENT BCM_CANHS_RNr_02[0] "Received CAN frame" UBYTE _CNV_A_R_A_105_CM 1 0. 0. 255. ECU_ADDRESS 0xd0007874 /end MEASUREMENT
/begin MEASUREMENT BCM_CANHS_RNr_02[1] "Received CAN frame" UBYTE _CNV_A_R_A_105_CM 1 0. 0. 255. ECU_ADDRESS 0xd0007875 /end MEASUREMENT
/begin MEASUREMENT BCM_CANHS_RNr_02[2] "Received CAN frame" UBYTE _CNV_A_R_A_105_CM 1 0. 0. 255. ECU_ADDRESS 0xd0007876 /end MEASUREMENT
/begin MEASUREMENT BCM_CANHS_RNr_02[3] "Received CAN frame" UBYTE _CNV_A_R_A_105_CM 1 0. 0. 255. ECU_ADDRESS 0xd0007877 /end MEASUREMENT
/begin MEASUREMENT BCM_CANHS_RNr_02[4] "Received CAN frame" UBYTE _CNV_A_R_A_105_CM 1 0. 0. 255. ECU_ADDRESS 0xd0007878 /end MEASUREMENT
/begin MEASUREMENT BCM_CANHS_RNr_02[5] "Received CAN frame" UBYTE _CNV_A_R_A_105_CM 1 0. 0. 255. ECU_ADDRESS 0xd0007879 /end MEASUREMENT
/begin MEASUREMENT BCM_CANHS_RNr_02[6] "Received CAN frame" UBYTE _CNV_A_R_A_105_CM 1 0. 0. 255. ECU_ADDRESS 0xd000787a /end MEASUREMENT
/begin MEASUREMENT BCM_CANHS_RNr_02[7] "Received CAN frame" UBYTE _CNV_A_R_A_105_CM 1 0. 0. 255. ECU_ADDRESS 0xd000787b /end MEASUREMENT
/begin MEASUREMENT BCM_VERLOG[0] "Received CAN frame" UBYTE _CNV_A_R_A_105_CM 1 0. 0. 255. ECU_ADDRESS 0xd0007886 /end MEASUREMENT
/begin MEASUREMENT BCM_VERLOG[1] "Received CAN frame" UBYTE _CNV_A_R_A_105_CM 1 0. 0. 255. ECU_ADDRESS 0xd0007887 /end MEASUREMENT
/begin MEASUREMENT BCM_VERLOG[2] "Received CAN frame" UBYTE _CNV_A_R_A_105_CM 1 0. 0. 255. ECU_ADDRESS 0xd0007888 /end MEASUREMENT
/begin MEASUREMENT BCM_VERLOG[3] "Received CAN frame" UBYTE _CNV_A_R_A_105_CM 1 0. 0. 255. ECU_ADDRESS 0xd0007889 /end MEASUREMENT
/begin MEASUREMENT BCM_VERLOG[4] "Received CAN frame" UBYTE _CNV_A_R_A_105_CM 1 0. 0. 255. ECU_ADDRESS 0xd000788a /end MEASUREMENT
/begin MEASUREMENT BRAKE_CANHS_RNr_01[0] "Received CAN frame" UBYTE _CNV_A_R_A_105_CM 1 0. 0. 255. ECU_ADDRESS 0xd0006894 /end MEASUREMENT
/begin MEASUREMENT BRAKE_CANHS_RNr_01[1] "Received CAN frame" UBYTE _CNV_A_R_A_105_CM 1 0. 0. 255. ECU_ADDRESS 0xd0006895 /end MEASUREMENT
/begin MEASUREMENT BRAKE_CANHS_RNr_01[2] "Received CAN frame" UBYTE _CNV_A_R_A_105_CM 1 0. 0. 255. ECU_ADDRESS 0xd0006896 /end MEASUREMENT
/begin MEASUREMENT BRAKE_CANHS_RNr_01[3] "Received CAN frame" UBYTE _CNV_A_R_A_105_CM 1 0. 0. 255. ECU_ADDRESS 0xd0006897 /end MEASUREMENT
/begin MEASUREMENT BRAKE_CANHS_RNr_01[4] "Received CAN frame" UBYTE _CNV_A_R_A_105_CM 1 0. 0. 255. ECU_ADDRESS 0xd0006898 /end MEASUREMENT
/begin MEASUREMENT BRAKE_CANHS_RNr_01[5] "Received CAN frame" UBYTE _CNV_A_R_A_105_CM 1 0. 0. 255. ECU_ADDRESS 0xd0006899 /end MEASUREMENT
/begin MEASUREMENT BRAKE_CANHS_RNr_01[6] "Received CAN frame" UBYTE _CNV_A_R_A_105_CM 1 0. 0. 255. ECU_ADDRESS 0xd000689a /end MEASUREMENT
/begin MEASUREMENT BRAKE_CANHS_RNr_02[0] "Received CAN frame" UBYTE _CNV_A_R_A_105_CM 1 0. 0. 255. ECU_ADDRESS 0xd000689c /end MEASUREMENT
/begin MEASUREMENT BRAKE_CANHS_RNr_02[1] "Received CAN frame" UBYTE _CNV_A_R_A_105_CM 1 0. 0. 255. ECU_ADDRESS 0xd000689d /end MEASUREMENT
/begin MEASUREMENT BRAKE_CANHS_RNr_02[2] "Received CAN frame" UBYTE _CNV_A_R_A_105_CM 1 0. 0. 255. ECU_ADDRESS 0xd000689e /end MEASUREMENT
/begin MEASUREMENT BRAKE_CANHS_RNr_02[3] "Received CAN frame" UBYTE _CNV_A_R_A_105_CM 1 0. 0. 255. ECU_ADDRESS 0xd000689f /end MEASUREMENT
/begin MEASUREMENT BRAKE_CANHS_RNr_02[4] "Received CAN frame" UBYTE _CNV_A_R_A_105_CM 1 0. 0. 255. ECU_ADDRESS 0xd00068a0 /end MEASUREMENT
/begin MEASUREMENT BRAKE_CANHS_RNr_02[5] "Received CAN frame" UBYTE _CNV_A_R_A_105_CM 1 0. 0. 255. ECU_ADDRESS 0xd00068a1 /end MEASUREMENT
/begin MEASUREMENT BRAKE_CANHS_RNr_03[0] "Received CAN frame" UBYTE _CNV_A_R_A_105_CM 1 0. 0. 255. ECU_ADDRESS 0xd00068a2 /end MEASUREMENT
/begin MEASUREMENT BRAKE_CANHS_RNr_03[1] "Received CAN frame" UBYTE _CNV_A_R_A_105_CM 1 0. 0. 255. ECU_ADDRESS 0xd00068a3 /end MEASUREMENT
/begin MEASUREMENT BRAKE_CANHS_RNr_03[2] "Received CAN frame" UBYTE _CNV_A_R_A_105_CM 1 0. 0. 255. ECU_ADDRESS 0xd00068a4 /end MEASUREMENT
/begin MEASUREMENT BRAKE_CANHS_RNr_03[3] "Received CAN frame" UBYTE _CNV_A_R_A_105_CM 1 0. 0. 255. ECU_ADDRESS 0xd00068a5 /end MEASUREMENT
/begin MEASUREMENT BRAKE_CANHS_RNr_03[4] "Received CAN frame" UBYTE _CNV_A_R_A_105_CM 1 0. 0. 255. ECU_ADDRESS 0xd00068a6 /end MEASUREMENT
/begin MEASUREMENT BRAKE_CANHS_RNr_03[5] "Received CAN frame" UBYTE _CNV_A_R_A_105_CM 1 0. 0. 255. ECU_ADDRESS 0xd00068a7 /end MEASUREMENT
/begin MEASUREMENT BRAKE_CANHS_RNr_04[0] "Received CAN frame" UBYTE _CNV_A_R_A_105_CM 1 0. 0. 255. ECU_ADDRESS 0xd0006874 /end MEASUREMENT
/begin MEASUREMENT BRAKE_CANHS_RNr_04[1] "Received CAN frame" UBYTE _CNV_A_R_A_105_CM 1 0. 0. 255. ECU_ADDRESS 0xd0006875 /end MEASUREMENT
/begin MEASUREMENT BRAKE_CANHS_RNr_04[2] "Received CAN frame" UBYTE _CNV_A_R_A_105_CM 1 0. 0. 255. ECU_ADDRESS 0xd0006876 /end MEASUREMENT
/begin MEASUREMENT BRAKE_CANHS_RNr_04[3] "Received CAN frame" UBYTE _CNV_A_R_A_105_CM 1 0. 0. 255. ECU_ADDRESS 0xd0006877 /end MEASUREMENT
/begin MEASUREMENT BRAKE_CANHS_RNr_04[4] "Received CAN frame" UBYTE _CNV_A_R_A_105_CM 1 0. 0. 255. ECU_ADDRESS 0xd0006878 /end MEASUREMENT
/begin MEASUREMENT BRAKE_CANHS_RNr_04[5] "Received CAN frame" UBYTE _CNV_A_R_A_105_CM 1 0. 0. 255. ECU_ADDRESS 0xd0006879 /end MEASUREMENT
/begin MEASUREMENT BRAKE_CANHS_RNr_04[6] "Received CAN frame" UBYTE _CNV_A_R_A_105_CM 1 0. 0. 255. ECU_ADDRESS 0xd000687a /end MEASUREMENT
/begin MEASUREMENT BRAKE_CANHS_RNr_04[7] "Received CAN frame" UBYTE _CNV_A_R_A_105_CM 1 0. 0. 255. ECU_ADDRESS 0xd000687b /end MEASUREMENT
/begin MEASUREMENT BRAKE_CANHS_R_01[0] "Received CAN frame" UBYTE _CNV_A_R_A_105_CM 1 0. 0. 255. ECU_ADDRESS 0xd000788c /end MEASUREMENT
/begin MEASUREMENT BRAKE_CANHS_R_01[1] "Received CAN frame" UBYTE _CNV_A_R_A_105_CM 1 0. 0. 255. ECU_ADDRESS 0xd000788d /end MEASUREMENT
/begin MEASUREMENT BRAKE_CANHS_R_01[2] "Received CAN frame" UBYTE _CNV_A_R_A_105_CM 1 0. 0. 255. ECU_ADDRESS 0xd000788e /end MEASUREMENT
/begin MEASUREMENT BRAKE_CANHS_R_01[3] "Received CAN frame" UBYTE _CNV_A_R_A_105_CM 1 0. 0. 255. ECU_ADDRESS 0xd000788f /end MEASUREMENT
/begin MEASUREMENT BRAKE_CANHS_R_01[4] "Received CAN frame" UBYTE _CNV_A_R_A_105_CM 1 0. 0. 255. ECU_ADDRESS 0xd0007890 /end MEASUREMENT
/begin MEASUREMENT BRAKE_CANHS_R_01[5] "Received CAN frame" UBYTE _CNV_A_R_A_105_CM 1 0. 0. 255. ECU_ADDRESS 0xd0007891 /end MEASUREMENT
/begin MEASUREMENT BRAKE_CANHS_R_01[6] "Received CAN frame" UBYTE _CNV_A_R_A_105_CM 1 0. 0. 255. ECU_ADDRESS 0xd0007892 /end MEASUREMENT
/begin MEASUREMENT CLIM_CANHS_R_01[0] "Received CAN frame" UBYTE _CNV_A_R_A_105_CM 1 0. 0. 255. ECU_ADDRESS 0xd00068a8 /end MEASUREMENT
/begin MEASUREMENT CLIM_CANHS_R_01[1] "Received CAN frame" UBYTE _CNV_A_R_A_105_CM 1 0. 0. 255. ECU_ADDRESS 0xd00068a9 /end MEASUREMENT
/begin MEASUREMENT CLIM_CANHS_R_01[2] "Received CAN frame" UBYTE _CNV_A_R_A_105_CM 1 0. 0. 255. ECU_ADDRESS 0xd00068aa /end MEASUREMENT
/begin MEASUREMENT CLIM_CANHS_R_01[3] "Received CAN frame" UBYTE _CNV_A_R_A_105_CM 1 0. 0. 255. ECU_ADDRESS 0xd00068ab /end MEASUREMENT
/begin MEASUREMENT CLIM_CANHS_R_01[4] "Received CAN frame" UBYTE _CNV_A_R_A_105_CM 1 0. 0. 255. ECU_ADDRESS 0xd00068ac /end MEASUREMENT
/begin MEASUREMENT CLIM_CANHS_R_01[5] "Received CAN frame" UBYTE _CNV_A_R_A_105_CM 1 0. 0. 255. ECU_ADDRESS 0xd00068ad /end MEASUREMENT
/begin MEASUREMENT CLUSTER_CANHS_RNr_01[0] "Received CAN frame" UBYTE _CNV_A_R_A_105_CM 1 0. 0. 255. ECU_ADDRESS 0xd0007894 /end MEASUREMENT
/begin MEASUREMENT CLUSTER_CANHS_RNr_01[1] "Received CAN frame" UBYTE _CNV_A_R_A_105_CM 1 0. 0. 255. ECU_ADDRESS 0xd0007895 /end MEASUREMENT
/begin MEASUREMENT CLUSTER_CANHS_RNr_01[2] "Received CAN frame" UBYTE _CNV_A_R_A_105_CM 1 0. 0. 255. ECU_ADDRESS 0xd0007896 /end MEASUREMENT
/begin MEASUREMENT CLUSTER_CANHS_RNr_01[3] "Received CAN frame" UBYTE _CNV_A_R_A_105_CM 1 0. 0. 255. ECU_ADDRESS 0xd0007897 /end MEASUREMENT
/begin MEASUREMENT CLUSTER_CANHS_RNr_01[4] "Received CAN frame" UBYTE _CNV_A_R_A_105_CM 1 0. 0. 255. ECU_ADDRESS 0xd0007898 /end MEASUREMENT
/begin MEASUREMENT CLUSTER_CANHS_R_01[0] "Received CAN frame" UBYTE _CNV_A_R_A_105_CM 1 0. 0. 255. ECU_ADDRESS 0xd000787c /end MEASUREMENT
/begin MEASUREMENT CLUSTER_CANHS_R_01[1] "Received CAN frame" UBYTE _CNV_A_R_A_105_CM 1 0. 0. 255. ECU_ADDRESS 0xd000787d /end MEASUREMENT
/begin MEASUREMENT CLUSTER_CANHS_R_01[2] "Received CAN frame" UBYTE _CNV_A_R_A_105_CM 1 0. 0. 255. ECU_ADDRESS 0xd000787e /end MEASUREMENT
/begin MEASUREMENT CLUSTER_CANHS_R_01[3] "Received CAN frame" UBYTE _CNV_A_R_A_105_CM 1 0. 0. 255. ECU_ADDRESS 0xd000787f /end MEASUREMENT
/begin MEASUREMENT CLUSTER_CANHS_R_01[4] "Received CAN frame" UBYTE _CNV_A_R_A_105_CM 1 0. 0. 255. ECU_ADDRESS 0xd0007880 /end MEASUREMENT
/begin MEASUREMENT CLUSTER_CANHS_R_01[5] "Received CAN frame" UBYTE _CNV_A_R_A_105_CM 1 0. 0. 255. ECU_ADDRESS 0xd0007881 /end MEASUREMENT
/begin MEASUREMENT CLUSTER_CANHS_R_01[6] "Received CAN frame" UBYTE _CNV_A_R_A_105_CM 1 0. 0. 255. ECU_ADDRESS 0xd0007882 /end MEASUREMENT
/begin MEASUREMENT CLUSTER_CANHS_R_01[7] "Received CAN frame" UBYTE _CNV_A_R_A_105_CM 1 0. 0. 255. ECU_ADDRESS 0xd0007883 /end MEASUREMENT
/begin MEASUREMENT DDCM_CANLSFT_R_01[0] "Received CAN frame" UBYTE _CNV_A_R_A_105_CM 1 0. 0. 255. ECU_ADDRESS 0xd00068ae /end MEASUREMENT
/begin MEASUREMENT DDCM_CANLSFT_R_01[1] "Received CAN frame" UBYTE _CNV_A_R_A_105_CM 1 0. 0. 255. ECU_ADDRESS 0xd00068af /end MEASUREMENT
/begin MEASUREMENT DDCM_CANLSFT_R_01[2] "Received CAN frame" UBYTE _CNV_A_R_A_105_CM 1 0. 0. 255. ECU_ADDRESS 0xd00068b0 /end MEASUREMENT
/begin MEASUREMENT DDCM_CANLSFT_R_01[3] "Received CAN frame" UBYTE _CNV_A_R_A_105_CM 1 0. 0. 255. ECU_ADDRESS 0xd00068b1 /end MEASUREMENT
/begin MEASUREMENT DDCM_CANLSFT_R_01[4] "Received CAN frame" UBYTE _CNV_A_R_A_105_CM 1 0. 0. 255. ECU_ADDRESS 0xd00068b2 /end MEASUREMENT
/begin MEASUREMENT ETC_CANHS_R_01[0] "Received CAN frame" UBYTE _CNV_A_R_A_105_CM 1 0. 0. 255. ECU_ADDRESS 0xd00068b4 /end MEASUREMENT
/begin MEASUREMENT ETC_CANHS_R_01[1] "Received CAN frame" UBYTE _CNV_A_R_A_105_CM 1 0. 0. 255. ECU_ADDRESS 0xd00068b5 /end MEASUREMENT
/begin MEASUREMENT ETC_CANHS_R_01[2] "Received CAN frame" UBYTE _CNV_A_R_A_105_CM 1 0. 0. 255. ECU_ADDRESS 0xd00068b6 /end MEASUREMENT
/begin MEASUREMENT ETC_CANHS_R_01[3] "Received CAN frame" UBYTE _CNV_A_R_A_105_CM 1 0. 0. 255. ECU_ADDRESS 0xd00068b7 /end MEASUREMENT
/begin MEASUREMENT ETC_CANHS_R_01[4] "Received CAN frame" UBYTE _CNV_A_R_A_105_CM 1 0. 0. 255. ECU_ADDRESS 0xd00068b8 /end MEASUREMENT
/begin MEASUREMENT MMI_BRAKE_CANHS_RNr_01[0] "Received CAN frame" UBYTE _CNV_A_R_ECME_LINEA_0_CM 1 0. 0. 255. ECU_ADDRESS 0xd000789a FORMAT "%3.0" /end MEASUREMENT
/begin MEASUREMENT MMI_BRAKE_CANHS_RNr_01[1] "Received CAN frame" UBYTE _CNV_A_R_ECME_LINEA_0_CM 1 0. 0. 255. ECU_ADDRESS 0xd000789b FORMAT "%3.0" /end MEASUREMENT
/begin MEASUREMENT MMI_BRAKE_CANHS_RNr_01[2] "Received CAN frame" UBYTE _CNV_A_R_ECME_LINEA_0_CM 1 0. 0. 255. ECU_ADDRESS 0xd000789c FORMAT "%3.0" /end MEASUREMENT
/begin MEASUREMENT RSD_CANHS_Rst_01[0] "Received CAN frame" UBYTE _CNV_A_R_ECME_LINEA_0_CM 1 0. 0. 255. ECU_ADDRESS 0xd000789e FORMAT "%3.0" /end MEASUREMENT
/begin MEASUREMENT RSD_CANHS_Rst_01[1] "Received CAN frame" UBYTE _CNV_A_R_ECME_LINEA_0_CM 1 0. 0. 255. ECU_ADDRESS 0xd000789f FORMAT "%3.0" /end MEASUREMENT
/begin MEASUREMENT RSD_CANHS_Rst_01[2] "Received CAN frame" UBYTE _CNV_A_R_ECME_LINEA_0_CM 1 0. 0. 255. ECU_ADDRESS 0xd00078a0 FORMAT "%3.0" /end MEASUREMENT
/begin MEASUREMENT RSD_CANHS_Rst_01[3] "Received CAN frame" UBYTE _CNV_A_R_ECME_LINEA_0_CM 1 0. 0. 255. ECU_ADDRESS 0xd00078a1 FORMAT "%3.0" /end MEASUREMENT
/begin MEASUREMENT SSCU_CANHS_R_02[0] "Received CAN frame" UBYTE _CNV_A_R_A_105_CM 1 0. 0. 255. ECU_ADDRESS 0xd00068c5 /end MEASUREMENT
/begin MEASUREMENT SWA_CANHS_RNr_01[0] "Received CAN frame" UBYTE _CNV_A_R_A_105_CM 1 0. 0. 255. ECU_ADDRESS 0xd000687c /end MEASUREMENT
/begin MEASUREMENT SWA_CANHS_RNr_01[1] "Received CAN frame" UBYTE _CNV_A_R_A_105_CM 1 0. 0. 255. ECU_ADDRESS 0xd000687d /end MEASUREMENT
/begin MEASUREMENT SWA_CANHS_RNr_01[2] "Received CAN frame" UBYTE _CNV_A_R_A_105_CM 1 0. 0. 255. ECU_ADDRESS 0xd000687e /end MEASUREMENT
/begin MEASUREMENT SWA_CANHS_RNr_01[3] "Received CAN frame" UBYTE _CNV_A_R_A_105_CM 1 0. 0. 255. ECU_ADDRESS 0xd000687f /end MEASUREMENT
/begin MEASUREMENT SWA_CANHS_RNr_01[4] "Received CAN frame" UBYTE _CNV_A_R_A_105_CM 1 0. 0. 255. ECU_ADDRESS 0xd0006880 /end MEASUREMENT
/begin MEASUREMENT SWA_CANHS_RNr_01[5] "Received CAN frame" UBYTE _CNV_A_R_A_105_CM 1 0. 0. 255. ECU_ADDRESS 0xd0006881 /end MEASUREMENT
/begin MEASUREMENT SWA_CANHS_RNr_01[6] "Received CAN frame" UBYTE _CNV_A_R_A_105_CM 1 0. 0. 255. ECU_ADDRESS 0xd0006882 /end MEASUREMENT
/begin MEASUREMENT SWA_CANHS_RNr_01[7] "Received CAN frame" UBYTE _CNV_A_R_A_105_CM 1 0. 0. 255. ECU_ADDRESS 0xd0006883 /end MEASUREMENT
/begin MEASUREMENT TORQUE_AT_CANHS_RNr_01[0] "Received CAN frame" UBYTE _CNV_A_R_A_105_CM 1 0. 0. 255. ECU_ADDRESS 0xd0006884 /end MEASUREMENT
/begin MEASUREMENT TORQUE_AT_CANHS_RNr_01[1] "Received CAN frame" UBYTE _CNV_A_R_A_105_CM 1 0. 0. 255. ECU_ADDRESS 0xd0006885 /end MEASUREMENT
/begin MEASUREMENT TORQUE_AT_CANHS_RNr_01[2] "Received CAN frame" UBYTE _CNV_A_R_A_105_CM 1 0. 0. 255. ECU_ADDRESS 0xd0006886 /end MEASUREMENT
/begin MEASUREMENT TORQUE_AT_CANHS_RNr_01[3] "Received CAN frame" UBYTE _CNV_A_R_A_105_CM 1 0. 0. 255. ECU_ADDRESS 0xd0006887 /end MEASUREMENT
/begin MEASUREMENT TORQUE_AT_CANHS_RNr_01[4] "Received CAN frame" UBYTE _CNV_A_R_A_105_CM 1 0. 0. 255. ECU_ADDRESS 0xd0006888 /end MEASUREMENT
/begin MEASUREMENT TORQUE_AT_CANHS_RNr_01[5] "Received CAN frame" UBYTE _CNV_A_R_A_105_CM 1 0. 0. 255. ECU_ADDRESS 0xd0006889 /end MEASUREMENT
/begin MEASUREMENT TORQUE_AT_CANHS_RNr_01[6] "Received CAN frame" UBYTE _CNV_A_R_A_105_CM 1 0. 0. 255. ECU_ADDRESS 0xd000688a /end MEASUREMENT
/begin MEASUREMENT TORQUE_AT_CANHS_RNr_01[7] "Received CAN frame" UBYTE _CNV_A_R_A_105_CM 1 0. 0. 255. ECU_ADDRESS 0xd000688b /end MEASUREMENT
/begin MEASUREMENT TORQUE_AT_CANHS_RNr_02[0] "Received CAN frame" UBYTE _CNV_A_R_A_105_CM 1 0. 0. 255. ECU_ADDRESS 0xd000688c /end MEASUREMENT
/begin MEASUREMENT TORQUE_AT_CANHS_RNr_02[1] "Received CAN frame" UBYTE _CNV_A_R_A_105_CM 1 0. 0. 255. ECU_ADDRESS 0xd000688d /end MEASUREMENT
/begin MEASUREMENT TORQUE_AT_CANHS_RNr_02[2] "Received CAN frame" UBYTE _CNV_A_R_A_105_CM 1 0. 0. 255. ECU_ADDRESS 0xd000688e /end MEASUREMENT
/begin MEASUREMENT TORQUE_AT_CANHS_RNr_02[3] "Received CAN frame" UBYTE _CNV_A_R_A_105_CM 1 0. 0. 255. ECU_ADDRESS 0xd000688f /end MEASUREMENT
/begin MEASUREMENT TORQUE_AT_CANHS_RNr_02[4] "Received CAN frame" UBYTE _CNV_A_R_A_105_CM 1 0. 0. 255. ECU_ADDRESS 0xd0006890 /end MEASUREMENT
/begin MEASUREMENT TORQUE_AT_CANHS_RNr_02[5] "Received CAN frame" UBYTE _CNV_A_R_A_105_CM 1 0. 0. 255. ECU_ADDRESS 0xd0006891 /end MEASUREMENT
/begin MEASUREMENT TORQUE_AT_CANHS_RNr_02[6] "Received CAN frame" UBYTE _CNV_A_R_A_105_CM 1 0. 0. 255. ECU_ADDRESS 0xd0006892 /end MEASUREMENT
/begin MEASUREMENT TORQUE_AT_CANHS_RNr_02[7] "Received CAN frame" UBYTE _CNV_A_R_A_105_CM 1 0. 0. 255. ECU_ADDRESS 0xd0006893 /end MEASUREMENT
/begin MEASUREMENT USM_CANHS_RNr_01[0] "Received CAN frame" UBYTE _CNV_A_R_A_105_CM 1 0. 0. 255. ECU_ADDRESS 0xd00068ba /end MEASUREMENT
/begin MEASUREMENT USM_CANHS_RNr_01[1] "Received CAN frame" UBYTE _CNV_A_R_A_105_CM 1 0. 0. 255. ECU_ADDRESS 0xd00068bb /end MEASUREMENT
/begin MEASUREMENT USM_CANHS_RNr_01[2] "Received CAN frame" UBYTE _CNV_A_R_A_105_CM 1 0. 0. 255. ECU_ADDRESS 0xd00068bc /end MEASUREMENT
/begin MEASUREMENT USM_CANHS_RNr_01[3] "Received CAN frame" UBYTE _CNV_A_R_A_105_CM 1 0. 0. 255. ECU_ADDRESS 0xd00068bd /end MEASUREMENT
/begin MEASUREMENT USM_CANHS_RNr_01[4] "Received CAN frame" UBYTE _CNV_A_R_A_105_CM 1 0. 0. 255. ECU_ADDRESS 0xd00068be /end MEASUREMENT
/begin MEASUREMENT USM_CANHS_RNr_02[0] "Received CAN frame" UBYTE _CNV_A_R_A_105_CM 1 0. 0. 255. ECU_ADDRESS 0xd00068c0 /end MEASUREMENT
/begin MEASUREMENT USM_CANHS_RNr_02[1] "Received CAN frame" UBYTE _CNV_A_R_A_105_CM 1 0. 0. 255. ECU_ADDRESS 0xd00068c1 /end MEASUREMENT
/begin MEASUREMENT USM_CANHS_RNr_02[2] "Received CAN frame" UBYTE _CNV_A_R_A_105_CM 1 0. 0. 255. ECU_ADDRESS 0xd00068c2 /end MEASUREMENT
/begin MEASUREMENT USM_CANHS_RNr_02[3] "Received CAN frame" UBYTE _CNV_A_R_A_105_CM 1 0. 0. 255. ECU_ADDRESS 0xd00068c3 /end MEASUREMENT
/begin MEASUREMENT USM_CANHS_RNr_02[4] "Received CAN frame" UBYTE _CNV_A_R_A_105_CM 1 0. 0. 255. ECU_ADDRESS 0xd00068c4 /end MEASUREMENT
/begin MEASUREMENT Vbx_abs_pws_typ_bc "Indicates the ABS power supply class" UBYTE _CNV_S_2_RANGE______3_CM 1 0. 0. 1. ECU_ADDRESS 0xd0006904 BIT_MASK 0x1 /end MEASUREMENT
/begin MEASUREMENT Vbx_ac_pws_typ_bc "Indicates the AC power supply class" UBYTE _CNV_S_2_RANGE______3_CM 1 0. 0. 1. ECU_ADDRESS 0xd0006905 BIT_MASK 0x1 /end MEASUREMENT
/begin MEASUREMENT Vbx_acc_pws_typ_bc "Indicates the ACC power supply class" UBYTE _CNV_S_2_RANGE______3_CM 1 0. 0. 1. ECU_ADDRESS 0xd0006906 BIT_MASK 0x1 /end MEASUREMENT
/begin MEASUREMENT Vbx_agb_pws_typ_bc "Indicates the AGB power supply class" UBYTE _CNV_S_2_RANGE______3_CM 1 0. 0. 1. ECU_ADDRESS 0xd0006907 BIT_MASK 0x1 /end MEASUREMENT
/begin MEASUREMENT Vbx_can_diag_bus_fail "Mux diagnostic activation indicator for network (CAN bus) failure detection." UBYTE _CNV_S_2_RANGE______3_CM 1 0. 0. 1. ECU_ADDRESS 0xd0006908 BIT_MASK 0x1 /end MEASUREMENT
/begin MEASUREMENT Vbx_can_diag_ecm "ECM reception diagnostic indicator" UBYTE _CNV_S_2_RANGE______3_CM 1 0. 0. 1. ECU_ADDRESS 0xd0006909 BIT_MASK 0x1 /end MEASUREMENT
/begin MEASUREMENT Vbx_ccu_pws_typ_bc "Indicates the BCM power supply class" UBYTE _CNV_S_2_RANGE______3_CM 1 0. 0. 1. ECU_ADDRESS 0xd000690a BIT_MASK 0x1 /end MEASUREMENT
/begin MEASUREMENT Vbx_ddcm_pws_typ_bc "Indicates the DDCM power supply class" UBYTE _CNV_S_2_RANGE______3_CM 1 0. 0. 1. ECU_ADDRESS 0xd000690b BIT_MASK 0x1 /end MEASUREMENT
/begin MEASUREMENT Vbx_etc_pws_typ_bc "Indicates the ETC power supply class" UBYTE _CNV_S_2_RANGE______3_CM 1 0. 0. 1. ECU_ADDRESS 0xd000690c BIT_MASK 0x1 /end MEASUREMENT
/begin MEASUREMENT Vbx_ip_pws_typ_bc "Indicates the CLUSTER power supply class" UBYTE _CNV_S_2_RANGE______3_CM 1 0. 0. 1. ECU_ADDRESS 0xd000690d BIT_MASK 0x1 /end MEASUREMENT
/begin MEASUREMENT Vbx_mute_pws_typ_bc "Mute power supply type (=1 if type BC, =0 if type AD)" UBYTE _CNV_S_2_RANGE______3_CM 1 0. 0. 1. ECU_ADDRESS 0xd000690e BIT_MASK 0x1 /end MEASUREMENT
/begin MEASUREMENT Vbx_swa_pws_typ_bc "Indicates the SWA power supply class" UBYTE _CNV_S_2_RANGE______3_CM 1 0. 0. 1. ECU_ADDRESS 0xd000690f BIT_MASK 0x1 /end MEASUREMENT
/begin MEASUREMENT Vbx_usm_pws_typ_bc "Indicates the USM power supply class" UBYTE _CNV_S_2_RANGE______3_CM 1 0. 0. 1. ECU_ADDRESS 0xd0006910 BIT_MASK 0x1 /end MEASUREMENT
/begin MEASUREMENT Vxx_abs_ecu_stt " State of Brake Control Unit for CAN failure detection." UBYTE _CNV_S_3_STATUS_CAN_458_CM 1 0. 0. 2. ECU_ADDRESS 0xd00068c6 /end MEASUREMENT
/begin MEASUREMENT Vxx_abs_ecu_stt_ctr "Brake Control Unit counter for validated CAN failure detection." UBYTE _CNV_A_R_ECME_LINEA_0_CM 1 0. 0. 255. ECU_ADDRESS 0xd00068c7 FORMAT "%3.0" /end MEASUREMENT
/begin MEASUREMENT Vxx_abs_ecu_stt_ctr_mem_dec "Brake Control Unit : current failures non-volatile counter (previous value)" UBYTE _CNV_A_R_ECME_LINEA_0_CM 1 0. 0. 255. ECU_ADDRESS 0xd00068c8 FORMAT "%3.0" /end MEASUREMENT
/begin MEASUREMENT Vxx_abs_ecu_stt_ctr_mem_prev "Brake Control Unit : current failures non-volatile counter (new value)" UBYTE _CNV_A_R_ECME_LINEA_0_CM 1 0. 0. 255. ECU_ADDRESS 0xd00068c9 FORMAT "%3.0" /end MEASUREMENT
/begin MEASUREMENT Vxx_abs_ecu_stt_diag "State of Brake Control Unit failure detection for Mux Network frame" UBYTE _CNV_A_R_ECME_LINEA_0_CM 1 0. 0. 255. ECU_ADDRESS 0xd00068ca FORMAT "%3.0" /end MEASUREMENT
/begin MEASUREMENT Vxx_ac_ecu_stt " State of Climate Control Unit for CAN failure detection." UBYTE _CNV_S_3_STATUS_CAN_458_CM 1 0. 0. 2. ECU_ADDRESS 0xd00068cb /end MEASUREMENT
/begin MEASUREMENT Vxx_ac_ecu_stt_ctr "Climate Control Unit counter for validated CAN failure detection." UBYTE _CNV_A_R_ECME_LINEA_0_CM 1 0. 0. 255. ECU_ADDRESS 0xd00068cc FORMAT "%3.0" /end MEASUREMENT
/begin MEASUREMENT Vxx_ac_ecu_stt_ctr_mem_dec "AC current failures non-volatile counter (new value)" UBYTE _CNV_A_R_ECME_LINEA_0_CM 1 0. 0. 255. ECU_ADDRESS 0xd00068cd FORMAT "%3.0" /end MEASUREMENT
/begin MEASUREMENT Vxx_ac_ecu_stt_ctr_mem_prev "AC current failures non-volatile counter (previous value)" UBYTE _CNV_A_R_ECME_LINEA_0_CM 1 0. 0. 255. ECU_ADDRESS 0xd00068ce FORMAT "%3.0" /end MEASUREMENT
/begin MEASUREMENT Vxx_ac_ecu_stt_diag "State of Climate Control Unit failure detection for Mux Network frame" UBYTE _CNV_A_R_ECME_LINEA_0_CM 1 0. 0. 255. ECU_ADDRESS 0xd00068cf FORMAT "%3.0" /end MEASUREMENT
/begin MEASUREMENT Vxx_acc_ecu_stt "State of Automatic Cruise Control Unit for CAN." UBYTE _CNV_S_3_STATUS_CAN_458_CM 1 0. 0. 2. ECU_ADDRESS 0xd00068d0 /end MEASUREMENT
/begin MEASUREMENT Vxx_acc_ecu_stt_ctr "Automatic Cruise Control Unit counter for validated CAN failure detection." UBYTE _CNV_A_R_ECME_LINEA_0_CM 1 0. 0. 255. ECU_ADDRESS 0xd00068d1 FORMAT "%3.0" /end MEASUREMENT
/begin MEASUREMENT Vxx_acc_ecu_stt_ctr_mem_dec "ACC current failures non-volatile counter (new value)" UBYTE _CNV_A_R_ECME_LINEA_0_CM 1 0. 0. 255. ECU_ADDRESS 0xd00068d2 FORMAT "%3.0" /end MEASUREMENT
/begin MEASUREMENT Vxx_acc_ecu_stt_ctr_mem_prev "ACC current failures non-volatile counter (previous value)" UBYTE _CNV_A_R_ECME_LINEA_0_CM 1 0. 0. 255. ECU_ADDRESS 0xd00068d3 FORMAT "%3.0" /end MEASUREMENT
/begin MEASUREMENT Vxx_acc_ecu_stt_diag "State of Automatic Cruise Control Unit failure detection for Mux Network frame²" UBYTE _CNV_A_R_ECME_LINEA_0_CM 1 0. 0. 255. ECU_ADDRESS 0xd00068d4 FORMAT "%3.0" /end MEASUREMENT
/begin MEASUREMENT Vxx_agb_ecu_stt "Automatic Gear Box Control Unit counter for validated CAN failure detection." UBYTE _CNV_S_3_STATUS_CAN_458_CM 1 0. 0. 2. ECU_ADDRESS 0xd00068d5 /end MEASUREMENT
/begin MEASUREMENT Vxx_agb_ecu_stt_ctr "Automatic Gear Box Control Unit : current failures non-volatile counter" UBYTE _CNV_A_R_ECME_LINEA_0_CM 1 0. 0. 255. ECU_ADDRESS 0xd00068d6 FORMAT "%3.0" /end MEASUREMENT
/begin MEASUREMENT Vxx_agb_ecu_stt_ctr_mem_dec "AGB : current failures non-volatile counter (new value)" UBYTE _CNV_A_R_ECME_LINEA_0_CM 1 0. 0. 255. ECU_ADDRESS 0xd00068d7 FORMAT "%3.0" /end MEASUREMENT
/begin MEASUREMENT Vxx_agb_ecu_stt_ctr_mem_prev "AGB : current failures non-volatile counter (previous value)" UBYTE _CNV_A_R_ECME_LINEA_0_CM 1 0. 0. 255. ECU_ADDRESS 0xd00068d8 FORMAT "%3.0" /end MEASUREMENT
/begin MEASUREMENT Vxx_agb_ecu_stt_diag "State of Automatic Gear Box Control Unit failure detection for Mux Network frame" UBYTE _CNV_A_R_ECME_LINEA_0_CM 1 0. 0. 255. ECU_ADDRESS 0xd00068d9 FORMAT "%3.0" /end MEASUREMENT
/begin MEASUREMENT Vxx_bus_off_stt " State of Bus Off for CAN failure detection." UBYTE _CNV_A_R_ECME_LINEA_0_CM 1 0. 0. 2. ECU_ADDRESS 0xd00068da FORMAT "%1.0" /end MEASUREMENT
/begin MEASUREMENT Vxx_bus_off_stt_ctr "Bus Off counter for validated CAN failure detection." UBYTE _CNV_A_R_ECME_LINEA_0_CM 1 0. 0. 255. ECU_ADDRESS 0xd00068db FORMAT "%3.0" /end MEASUREMENT
/begin MEASUREMENT Vxx_bus_off_stt_ctr_mem_dec "Bus Off Control Unit : current failures non-volatile counter (new value)" UBYTE _CNV_A_R_ECME_LINEA_0_CM 1 0. 0. 255. ECU_ADDRESS 0xd00068dc FORMAT "%3.0" /end MEASUREMENT
/begin MEASUREMENT Vxx_bus_off_stt_ctr_mem_prev "Bus Off Control Unit : current failures non-volatile counter (previous value)" UBYTE _CNV_A_R_ECME_LINEA_0_CM 1 0. 0. 255. ECU_ADDRESS 0xd00068dd FORMAT "%3.0" /end MEASUREMENT
/begin MEASUREMENT Vxx_bus_off_stt_diag "State of Bus Off Control Unit failure detection for Mux Network frame" UBYTE _CNV_A_R_ECME_LINEA_0_CM 1 0. 0. 255. ECU_ADDRESS 0xd00068de FORMAT "%3.0" /end MEASUREMENT
/begin MEASUREMENT Vxx_ccu_ecu_stt " State of BCM Control Unit for CAN failure detection." UBYTE _CNV_S_3_STATUS_CAN_458_CM 1 0. 0. 2. ECU_ADDRESS 0xd00068df /end MEASUREMENT
/begin MEASUREMENT Vxx_ccu_ecu_stt_ctr "BCM Control Unit counter for validated CAN failure detection." UBYTE _CNV_A_R_ECME_LINEA_0_CM 1 0. 0. 255. ECU_ADDRESS 0xd00068e0 FORMAT "%3.0" /end MEASUREMENT
/begin MEASUREMENT Vxx_ccu_ecu_stt_ctr_mem_dec "BCM : current failures non-volatile counter (new value)" UBYTE _CNV_A_R_ECME_LINEA_0_CM 1 0. 0. 255. ECU_ADDRESS 0xd00068e1 FORMAT "%3.0" /end MEASUREMENT
/begin MEASUREMENT Vxx_ccu_ecu_stt_ctr_mem_prev "BCM : current failures non-volatile counter (previous value)" UBYTE _CNV_A_R_ECME_LINEA_0_CM 1 0. 0. 255. ECU_ADDRESS 0xd00068e2 FORMAT "%3.0" /end MEASUREMENT
/begin MEASUREMENT Vxx_ccu_ecu_stt_diag "State of BCM Control Unit failure detection for Mux Network frame" UBYTE _CNV_A_R_ECME_LINEA_0_CM 1 0. 0. 255. ECU_ADDRESS 0xd00068e3 FORMAT "%3.0" /end MEASUREMENT
/begin MEASUREMENT Vxx_ddcm_ecu_stt "State of DDCM control unit for CAN failure detection" UBYTE _CNV_S_3_STATUS_CAN_458_CM 1 0. 0. 2. ECU_ADDRESS 0xd00068e4 /end MEASUREMENT
/begin MEASUREMENT Vxx_ddcm_ecu_stt_ctr "DDCM Control Unit counter for validated CAN failure detection." UBYTE _CNV_A_R_ECME_LINEA_0_CM 1 0. 0. 255. ECU_ADDRESS 0xd00068e5 FORMAT "%3.0" /end MEASUREMENT
/begin MEASUREMENT Vxx_ddcm_ecu_stt_ctr_mem_dec "DDCM current failures non-volatile counter (new value)" UBYTE _CNV_A_R_ECME_LINEA_0_CM 1 0. 0. 255. ECU_ADDRESS 0xd00068e6 FORMAT "%3.0" /end MEASUREMENT
/begin MEASUREMENT Vxx_ddcm_ecu_stt_ctr_mem_prev "DDCM current failures non-volatile counter (previous value)" UBYTE _CNV_A_R_ECME_LINEA_0_CM 1 0. 0. 255. ECU_ADDRESS 0xd00068e7 FORMAT "%3.0" /end MEASUREMENT
/begin MEASUREMENT Vxx_ddcm_ecu_stt_diag "State of DDCM Control Unit failure detection for Mux Network frame" UBYTE _CNV_A_R_ECME_LINEA_0_CM 1 0. 0. 255. ECU_ADDRESS 0xd00068e8 FORMAT "%3.0" /end MEASUREMENT
/begin MEASUREMENT Vxx_etc_ecu_stt "State of ETC control unit for CAN failure detection" UBYTE _CNV_S_3_STATUS_CAN_458_CM 1 0. 0. 2. ECU_ADDRESS 0xd00068e9 /end MEASUREMENT
/begin MEASUREMENT Vxx_etc_ecu_stt_ctr "ETC Control Unit counter for validated CAN failure detection." UBYTE _CNV_A_R_ECME_LINEA_0_CM 1 0. 0. 255. ECU_ADDRESS 0xd00068ea FORMAT "%3.0" /end MEASUREMENT
/begin MEASUREMENT Vxx_etc_ecu_stt_ctr_mem_dec "ETC current failures non-volatile counter (new value)" UBYTE _CNV_A_R_ECME_LINEA_0_CM 1 0. 0. 255. ECU_ADDRESS 0xd00068eb FORMAT "%3.0" /end MEASUREMENT
/begin MEASUREMENT Vxx_etc_ecu_stt_ctr_mem_prev "ETC current failures non-volatile counter (previous value)" UBYTE _CNV_A_R_ECME_LINEA_0_CM 1 0. 0. 255. ECU_ADDRESS 0xd00068ec FORMAT "%3.0" /end MEASUREMENT
/begin MEASUREMENT Vxx_etc_ecu_stt_diag "State of ETC Control Unit failure detection for Mux Network frame" UBYTE _CNV_A_R_ECME_LINEA_0_CM 1 0. 0. 255. ECU_ADDRESS 0xd00068ed FORMAT "%3.0" /end MEASUREMENT
/begin MEASUREMENT Vxx_gcu_ecu_stt_diag "State of Gaz Control Unit failure detection for Mux Network frame" UBYTE _CNV_A_R_ECME_LINEA_0_CM 1 0. 0. 255. ECU_ADDRESS 0xd00068ee FORMAT "%3.0" /end MEASUREMENT
/begin MEASUREMENT Vxx_ip_ecu_stt "cluster ECU status for CAN" UBYTE _CNV_S_3_STATUS_CAN_458_CM 1 0. 0. 2. ECU_ADDRESS 0xd00068ef /end MEASUREMENT
/begin MEASUREMENT Vxx_ip_ecu_stt_ctr "Cluster Control Unit counter for validated CAN failure detection." UBYTE _CNV_A_R_ECME_LINEA_0_CM 1 0. 0. 255. ECU_ADDRESS 0xd00068f0 FORMAT "%3.0" /end MEASUREMENT
/begin MEASUREMENT Vxx_ip_ecu_stt_ctr_mem_dec "CLUSTER : current failures non-volatile counter (new value)" UBYTE _CNV_A_R_ECME_LINEA_0_CM 1 0. 0. 255. ECU_ADDRESS 0xd00068f1 FORMAT "%3.0" /end MEASUREMENT
/begin MEASUREMENT Vxx_ip_ecu_stt_ctr_mem_prev "CLUSTER : current failures non-volatile counter (previous value)" UBYTE _CNV_A_R_ECME_LINEA_0_CM 1 0. 0. 255. ECU_ADDRESS 0xd00068f2 FORMAT "%3.0" /end MEASUREMENT
/begin MEASUREMENT Vxx_ip_ecu_stt_diag "State of Cluster Control Unit failure detection for Mux Network frame" UBYTE _CNV_A_R_ECME_LINEA_0_CM 1 0. 0. 255. ECU_ADDRESS 0xd00068f3 FORMAT "%3.0" /end MEASUREMENT
/begin MEASUREMENT Vxx_mute_stt " State of Mute for CAN failure detection." UBYTE _CNV_A_R_ECME_LINEA_0_CM 1 0. 0. 2. ECU_ADDRESS 0xd00068f4 FORMAT "%1.0" /end MEASUREMENT
/begin MEASUREMENT Vxx_mute_stt_ctr "Mute counter for validated CAN failure detection." UBYTE _CNV_A_R_ECME_LINEA_0_CM 1 0. 0. 255. ECU_ADDRESS 0xd00068f5 FORMAT "%3.0" /end MEASUREMENT
/begin MEASUREMENT Vxx_mute_stt_ctr_mem_dec "Mute : current failures non-volatile counter (new value)" UBYTE _CNV_A_R_ECME_LINEA_0_CM 1 0. 0. 255. ECU_ADDRESS 0xd00068f6 FORMAT "%3.0" /end MEASUREMENT
/begin MEASUREMENT Vxx_mute_stt_ctr_mem_prev "Mute : current failures non-volatile counter (previous value)" UBYTE _CNV_A_R_ECME_LINEA_0_CM 1 0. 0. 255. ECU_ADDRESS 0xd00068f7 FORMAT "%3.0" /end MEASUREMENT
/begin MEASUREMENT Vxx_mute_stt_diag "State of Mute failure detection for Mux Network frame" UBYTE _CNV_A_R_ECME_LINEA_0_CM 1 0. 0. 255. ECU_ADDRESS 0xd00068f8 FORMAT "%3.0" /end MEASUREMENT
/begin MEASUREMENT Vxx_mux_frm_set_ref "Mux messaging set reference" UWORD _CNV_A_R_ECME_LINEA_0_CM 1 0. 0. 65535. ECU_ADDRESS 0xd00051ac FORMAT "%5.0" /end MEASUREMENT
/begin MEASUREMENT Vxx_sdl_ecu_stt_diag "State of Speed and Distance Limiter Control Unit failure detection for Mux Network frame" UBYTE _CNV_A_R_ECME_LINEA_0_CM 1 0. 0. 255. ECU_ADDRESS 0xd00068f9 FORMAT "%3.0" /end MEASUREMENT
/begin MEASUREMENT Vxx_swa_ecu_stt " State of Steering Wheel Angle Control Unit for CAN failure detection." UBYTE _CNV_S_3_STATUS_CAN_458_CM 1 0. 0. 2. ECU_ADDRESS 0xd00068fa /end MEASUREMENT
/begin MEASUREMENT Vxx_swa_ecu_stt_ctr "Steering Wheel Angle Control Unit counter for validated CAN failure detection." UBYTE _CNV_A_R_ECME_LINEA_0_CM 1 0. 0. 255. ECU_ADDRESS 0xd00068fb FORMAT "%3.0" /end MEASUREMENT
/begin MEASUREMENT Vxx_swa_ecu_stt_ctr_mem_dec "SWA current failures non-volatile counter (new value)" UBYTE _CNV_A_R_ECME_LINEA_0_CM 1 0. 0. 255. ECU_ADDRESS 0xd00068fc FORMAT "%3.0" /end MEASUREMENT
/begin MEASUREMENT Vxx_swa_ecu_stt_ctr_mem_prev "SWA current failures non-volatile counter (previous value)" UBYTE _CNV_A_R_ECME_LINEA_0_CM 1 0. 0. 255. ECU_ADDRESS 0xd00068fd FORMAT "%3.0" /end MEASUREMENT
/begin MEASUREMENT Vxx_swa_ecu_stt_diag "State of Steering Wheel Angle Control Unit failure detection for Mux Network frame" UBYTE _CNV_A_R_ECME_LINEA_0_CM 1 0. 0. 255. ECU_ADDRESS 0xd00068fe FORMAT "%3.0" /end MEASUREMENT
/begin MEASUREMENT Vxx_usm_ecu_stt "State of USM Control Unit for CAN failure detection" UBYTE _CNV_S_3_STATUS_CAN_458_CM 1 0. 0. 2. ECU_ADDRESS 0xd00068ff /end MEASUREMENT
/begin MEASUREMENT Vxx_usm_ecu_stt_ctr "USM Control Unit counter for validated CAN failure detection." UBYTE _CNV_A_R_ECME_LINEA_0_CM 1 0. 0. 255. ECU_ADDRESS 0xd0006900 FORMAT "%3.0" /end MEASUREMENT
/begin MEASUREMENT Vxx_usm_ecu_stt_ctr_mem_dec "USM : current failures non-volatile counter (new value)" UBYTE _CNV_A_R_ECME_LINEA_0_CM 1 0. 0. 255. ECU_ADDRESS 0xd0006901 FORMAT "%3.0" /end MEASUREMENT
/begin MEASUREMENT Vxx_usm_ecu_stt_ctr_mem_prev "USM : current failures non-volatile counter (previous value)" UBYTE _CNV_A_R_ECME_LINEA_0_CM 1 0. 0. 255. ECU_ADDRESS 0xd0006902 FORMAT "%3.0" /end MEASUREMENT
/begin MEASUREMENT Vxx_usm_ecu_stt_diag "State of USM Control Unit failure detection for Mux Network frame" UBYTE _CNV_A_R_ECME_LINEA_0_CM 1 0. 0. 255. ECU_ADDRESS 0xd0006903 FORMAT "%3.0" /end MEASUREMENT
/begin CHARACTERISTIC Cxx_ACC_CANHS_R_01_id "ACC_CANHS_RNr_01 CAN frame identifier" VALUE 0xa00210da _REC_S1VAL_20_u2 2047. _CNV_A_R_ECME_LINEA_0_CM 0. 2047. FORMAT "%1.0" /end CHARACTERISTIC
/begin CHARACTERISTIC Cxx_AIRBAGCrash_id "AIRBAGCrash frame identifier" VALUE 0xa00210dc _REC_S1VAL_20_u2 2047. _CNV_A_R_ECME_LINEA_0_CM 0. 2047. FORMAT "%1.0" /end CHARACTERISTIC
/begin CHARACTERISTIC Cxx_BCM_CANHS_RNr_01_id "BCM_CANHS_RNr_01 CAN frame identifier" VALUE 0xa00210de _REC_S1VAL_20_u2 2047. _CNV_A_R_ECME_LINEA_0_CM 0. 2047. FORMAT "%1.0" /end CHARACTERISTIC
/begin CHARACTERISTIC Cxx_BCM_CANHS_RNr_02_id "BCM_CANHS_RNr_02 CAN frame identifier" VALUE 0xa00210e0 _REC_S1VAL_20_u2 2047. _CNV_A_R_ECME_LINEA_0_CM 0. 2047. FORMAT "%1.0" /end CHARACTERISTIC
/begin CHARACTERISTIC Cxx_BCM_VERLOG_id "BCM_VERLOG CAN frame identifier" VALUE 0xa00210e2 _REC_S1VAL_20_u2 2047. _CNV_A_R_ECME_LINEA_0_CM 0. 2047. FORMAT "%1.0" /end CHARACTERISTIC
/begin CHARACTERISTIC Cxx_BRAKE_CANHS_RNr_01_id "BRAKE_CANHS_RNr_01 frame identifier" VALUE 0xa00210e4 _REC_S1VAL_20_u2 2047. _CNV_A_R_ECME_LINEA_0_CM 0. 2047. FORMAT "%1.0" /end CHARACTERISTIC
/begin CHARACTERISTIC Cxx_BRAKE_CANHS_RNr_02_id "BRAKE_CANHS_RNr_02 frame identifier" VALUE 0xa00210e6 _REC_S1VAL_20_u2 2047. _CNV_A_R_ECME_LINEA_0_CM 0. 2047. FORMAT "%1.0" /end CHARACTERISTIC
/begin CHARACTERISTIC Cxx_BRAKE_CANHS_RNr_03_id "BRAKE_CANHS_RNr_03 frame identifier" VALUE 0xa00210e8 _REC_S1VAL_20_u2 2047. _CNV_A_R_ECME_LINEA_0_CM 0. 2047. FORMAT "%1.0" /end CHARACTERISTIC
/begin CHARACTERISTIC Cxx_BRAKE_CANHS_RNr_04_id "BRAKE_CANHS_RNr_04 frame identifier" VALUE 0xa00210ea _REC_S1VAL_20_u2 2047. _CNV_A_R_ECME_LINEA_0_CM 0. 2047. FORMAT "%1.0" /end CHARACTERISTIC
/begin CHARACTERISTIC Cxx_BRAKE_CANHS_R_01_id "BRAKE_CANHS_R_01 CAN frame identifier" VALUE 0xa00210ec _REC_S1VAL_20_u2 2047. _CNV_A_R_ECME_LINEA_0_CM 0. 2047. FORMAT "%1.0" /end CHARACTERISTIC
/begin CHARACTERISTIC Cxx_CLIM_CANHS_R_01_id "CLIM_CANHS_R_01 CAN frame identifier" VALUE 0xa00210ee _REC_S1VAL_20_u2 2047. _CNV_A_R_ECME_LINEA_0_CM 0. 2047. FORMAT "%1.0" /end CHARACTERISTIC
/begin CHARACTERISTIC Cxx_CLUSTER_CANHS_RNr_01_id "CLUSTER_CANHS_RNr_01 CAN frame identifier" VALUE 0xa00210f0 _REC_S1VAL_20_u2 2047. _CNV_A_R_ECME_LINEA_0_CM 0. 2047. FORMAT "%1.0" /end CHARACTERISTIC
/begin CHARACTERISTIC Cxx_CLUSTER_CANHS_R_01_id "CLUSTER_CANHS_R_01 CAN frame identifier" VALUE 0xa00210f2 _REC_S1VAL_20_u2 2047. _CNV_A_R_ECME_LINEA_0_CM 0. 2047. FORMAT "%1.0" /end CHARACTERISTIC
/begin CHARACTERISTIC Cxx_DDCM_CANLSFT_R_01_id "DDCM_CANLSFT_R_01 CAN frame identifier" VALUE 0xa00210f4 _REC_S1VAL_20_u2 2047. _CNV_A_R_ECME_LINEA_0_CM 0. 2047. FORMAT "%1.0" /end CHARACTERISTIC
/begin CHARACTERISTIC Cxx_ECM_CANHS_RNr_01_id "ECM_CANHS_RNr_01 CAN frame identifier" VALUE 0xa00210f6 _REC_S1VAL_20_u2 2047. _CNV_A_R_ECME_LINEA_0_CM 0. 2047. FORMAT "%1.0" /end CHARACTERISTIC
/begin CHARACTERISTIC Cxx_ECM_CANHS_RNr_02_id "ECM_CANHS_RNr_02 CAN frame identifier" VALUE 0xa00210f8 _REC_S1VAL_20_u2 2047. _CNV_A_R_ECME_LINEA_0_CM 0. 2047. FORMAT "%1.0" /end CHARACTERISTIC
/begin CHARACTERISTIC Cxx_ECM_CANHS_R_03_id "ECM_CANHS_R_03 CAN frame identifier" VALUE 0xa00210fa _REC_S1VAL_20_u2 2047. _CNV_A_R_ECME_LINEA_0_CM 0. 2047. FORMAT "%1.0" /end CHARACTERISTIC
/begin CHARACTERISTIC Cxx_ECM_VERLOG_id "ECM_VERLOG CAN frame identifier" VALUE 0xa00210fc _REC_S1VAL_20_u2 2047. _CNV_A_R_ECME_LINEA_0_CM 0. 2047. FORMAT "%1.0" /end CHARACTERISTIC
/begin CHARACTERISTIC Cxx_ETC_CANHS_R_01_id "ETC_CANHS_R_01 CAN frame identifier" VALUE 0xa00210fe _REC_S1VAL_20_u2 2047. _CNV_A_R_ECME_LINEA_0_CM 0. 2047. FORMAT "%1.0" /end CHARACTERISTIC
/begin CHARACTERISTIC Cxx_FORCE_ECM_CANHS_R_01_id "FORCE_ECM_CANHS_R_01 CAN frame identifier" VALUE 0xa0021100 _REC_S1VAL_20_u2 2047. _CNV_A_R_ECME_LINEA_0_CM 0. 2047. FORMAT "%1.0" /end CHARACTERISTIC
/begin CHARACTERISTIC Cxx_MMI_BRAKE_CANHS_RNr_01_id "MMI_BRAKE_CANHS_RNr_01 frame identifier" VALUE 0xa0021102 _REC_S1VAL_20_u2 2047. _CNV_A_R_ECME_LINEA_0_CM 0. 2047. FORMAT "%5.0" /end CHARACTERISTIC
/begin CHARACTERISTIC Cxx_MMI_ECM_CANHS_RNr_01_id "MMI_ECM_CANHS_RNr_01 CAN frame identifier" VALUE 0xa0021104 _REC_S1VAL_20_u2 2047. _CNV_A_R_ECME_LINEA_0_CM 0. 2047. FORMAT "%1.0" /end CHARACTERISTIC
/begin CHARACTERISTIC Cxx_MMI_ECM_CANHS_Rst_01_id "MMI_ECM_CANHS_Rst_01 CAN frame identifier" VALUE 0xa0021106 _REC_S1VAL_20_u2 2047. _CNV_A_R_ECME_LINEA_0_CM 0. 2047. FORMAT "%5.0" /end CHARACTERISTIC
/begin CHARACTERISTIC Cxx_RSD_CANHS_Rst_01_id "CLUSTER_CANHS_R_01 CAN frame identifier" VALUE 0xa0021108 _REC_S1VAL_20_u2 2047. _CNV_A_R_ECME_LINEA_0_CM 0. 2047. FORMAT "%5.0" /end CHARACTERISTIC
/begin CHARACTERISTIC Cxx_SSCU_CANHS_R_02_id "SSCU_CANHS_R_02 CAN frame identifier" VALUE 0xa002110a _REC_S1VAL_20_u2 2047. _CNV_A_R_ECME_LINEA_0_CM 0. 2047. FORMAT "%1.0" /end CHARACTERISTIC
/begin CHARACTERISTIC Cxx_SWA_CANHS_RNr_01_id "SWA_CANHS_RNr_01 CAN frame identifier" VALUE 0xa002110c _REC_S1VAL_20_u2 2047. _CNV_A_R_ECME_LINEA_0_CM 0. 2047. FORMAT "%1.0" /end CHARACTERISTIC
/begin CHARACTERISTIC Cxx_TORQUE_AT_CANHS_RNr_01_id "TORQUE_AT_CANHS_RNr_01 CAN frame identifier" VALUE 0xa002110e _REC_S1VAL_20_u2 2047. _CNV_A_R_ECME_LINEA_0_CM 0. 2047. FORMAT "%1.0" /end CHARACTERISTIC
/begin CHARACTERISTIC Cxx_TORQUE_AT_CANHS_RNr_02_id "TORQUE_AT_CANHS_RNr_02 CAN frame identifier" VALUE 0xa0021110 _REC_S1VAL_20_u2 2047. _CNV_A_R_ECME_LINEA_0_CM 0. 2047. FORMAT "%1.0" /end CHARACTERISTIC
/begin CHARACTERISTIC Cxx_TORQUE_ECM_CANHS_RNr_01_id "TORQUE_ECM_CANHS_RNr_01 CAN frame identifier" VALUE 0xa0021112 _REC_S1VAL_20_u2 2047. _CNV_A_R_ECME_LINEA_0_CM 0. 2047. FORMAT "%1.0" /end CHARACTERISTIC
/begin CHARACTERISTIC Cxx_TORQUE_ECM_CANHS_RNr_02_id "TORQUE_ECM_CANHS_RNr_02 CAN frame identifier" VALUE 0xa0021114 _REC_S1VAL_20_u2 2047. _CNV_A_R_ECME_LINEA_0_CM 0. 2047. FORMAT "%1.0" /end CHARACTERISTIC
/begin CHARACTERISTIC Cxx_TORQUE_ECM_CANHS_R_01_id "TORQUE_ECM_CANHS_R_01 CAN frame identifier" VALUE 0xa0021116 _REC_S1VAL_20_u2 2047. _CNV_A_R_ECME_LINEA_0_CM 0. 2047. FORMAT "%1.0" /end CHARACTERISTIC
/begin CHARACTERISTIC Cxx_USM_CANHS_RNr_01_id "USM_CANHS_RNr_01 CAN frame identifier" VALUE 0xa0021118 _REC_S1VAL_20_u2 2047. _CNV_A_R_ECME_LINEA_0_CM 0. 2047. FORMAT "%1.0" /end CHARACTERISTIC
/begin CHARACTERISTIC Cxx_USM_CANHS_RNr_02_id "USM_CANHS_RNr_02 CAN frame identifier" VALUE 0xa002111a _REC_S1VAL_20_u2 2047. _CNV_A_R_ECME_LINEA_0_CM 0. 2047. FORMAT "%1.0" /end CHARACTERISTIC
/begin CHARACTERISTIC Cxx_abs_abst_frm_dly "Brake Control Unit absence detection time-out" VALUE 0xa002111e _REC_S1VAL_20_u1 2.55 _CNV_A_R_LINEAR_____32_CM 0. 2.55 FORMAT "%4.2" /end CHARACTERISTIC
/begin CHARACTERISTIC Cxx_abs_ecu_conf "Brake Control Unit feature for Mux Network configuration detection (always present or optional)" VALUE 0xa002111f _REC_S1VAL_20_u1 255. _CNV_A_R_ECME_LINEA_0_CM 0. 255. FORMAT "%3.0" /end CHARACTERISTIC
/begin CHARACTERISTIC Cxx_abs_vld_abst_frm_dec "Brake Control Unit : decrementation value for validated absent CAN failure counter." VALUE 0xa0021120 _REC_S1VAL_20_u1 255. _CNV_A_R_ECME_LINEA_0_CM 0. 255. FORMAT "%3.0" /end CHARACTERISTIC
/begin CHARACTERISTIC Cxx_abs_vld_abst_frm_inc "Brake Control Unit : incrementation value for validated absent CAN failure counter." VALUE 0xa0021121 _REC_S1VAL_20_u1 255. _CNV_A_R_ECME_LINEA_0_CM 0. 255. FORMAT "%3.0" /end CHARACTERISTIC
/begin CHARACTERISTIC Cxx_ac_abst_frm_dly "Climate Control Unit absence detection time-out" VALUE 0xa0021122 _REC_S1VAL_20_u1 2.55 _CNV_A_R_LINEAR_____32_CM 0. 2.55 FORMAT "%4.2" /end CHARACTERISTIC
/begin CHARACTERISTIC Cxx_ac_ecu_conf "Climate Control Unit feature for Mux Network configuration detection (always present or optional)" VALUE 0xa0021123 _REC_S1VAL_20_u1 255. _CNV_A_R_ECME_LINEA_0_CM 0. 255. FORMAT "%3.0" /end CHARACTERISTIC
/begin CHARACTERISTIC Cxx_ac_vld_abst_frm_dec "Climate Control Unit : decrementation value for validated absent CAN failure counter." VALUE 0xa0021124 _REC_S1VAL_20_u1 255. _CNV_A_R_ECME_LINEA_0_CM 0. 255. FORMAT "%3.0" /end CHARACTERISTIC
/begin CHARACTERISTIC Cxx_ac_vld_abst_frm_inc "Climate Control Unit : incrementation value for validated absent CAN failure counter." VALUE 0xa0021125 _REC_S1VAL_20_u1 255. _CNV_A_R_ECME_LINEA_0_CM 0. 255. FORMAT "%3.0" /end CHARACTERISTIC
/begin CHARACTERISTIC Cxx_acc_abst_frm_dly "Automatic Cruise Control Unit absence detection time-out" VALUE 0xa0021126 _REC_S1VAL_20_u1 2.55 _CNV_A_R_LINEAR_____32_CM 0. 2.55 FORMAT "%4.2" /end CHARACTERISTIC
/begin CHARACTERISTIC Cxx_acc_ecu_conf "Automatic Cruise Control Unit feature for Mux Network config. detection (always present or optional)" VALUE 0xa0021127 _REC_S1VAL_20_u1 255. _CNV_A_R_ECME_LINEA_0_CM 0. 255. FORMAT "%3.0" /end CHARACTERISTIC
/begin CHARACTERISTIC Cxx_acc_vld_abst_frm_dec "Automatic Cruise Control Unit : decrementation value for validated absent CAN failure counter." VALUE 0xa0021128 _REC_S1VAL_20_u1 255. _CNV_A_R_ECME_LINEA_0_CM 0. 255. FORMAT "%3.0" /end CHARACTERISTIC
/begin CHARACTERISTIC Cxx_acc_vld_abst_frm_inc "Automatic Cruise Control Unit : incrementation value for validated absent CAN failure counter." VALUE 0xa0021129 _REC_S1VAL_20_u1 255. _CNV_A_R_ECME_LINEA_0_CM 0. 255. FORMAT "%3.0" /end CHARACTERISTIC
/begin CHARACTERISTIC Cxx_agb_abst_frm_dly "Automatic Gear Box Control Unit absence detection time-out" VALUE 0xa002112a _REC_S1VAL_20_u1 2.55 _CNV_A_R_LINEAR_____32_CM 0. 2.55 FORMAT "%4.2" /end CHARACTERISTIC
/begin CHARACTERISTIC Cxx_agb_ecu_conf "Automatic Gear Box Control Unit feature for Mux configuration detection (always present or optional)" VALUE 0xa002112b _REC_S1VAL_20_u1 255. _CNV_A_R_ECME_LINEA_0_CM 0. 255. FORMAT "%3.0" /end CHARACTERISTIC
/begin CHARACTERISTIC Cxx_agb_vld_abst_frm_dec "Automatic Gear Box Control Unit : decrementation value for validated absent CAN failure counter." VALUE 0xa002112c _REC_S1VAL_20_u1 255. _CNV_A_R_ECME_LINEA_0_CM 0. 255. FORMAT "%3.0" /end CHARACTERISTIC
/begin CHARACTERISTIC Cxx_agb_vld_abst_frm_inc "Automatic Gear Box Control Unit : incrementation value for validated absent CAN failure counter." VALUE 0xa002112d _REC_S1VAL_20_u1 255. _CNV_A_R_ECME_LINEA_0_CM 0. 255. FORMAT "%3.0" /end CHARACTERISTIC
/begin CHARACTERISTIC Cxx_ccu_abst_frm_dly "BCM Control Unit absence detection time-out" VALUE 0xa002112e _REC_S1VAL_20_u1 2.55 _CNV_A_R_LINEAR_____32_CM 0. 2.55 FORMAT "%4.2" /end CHARACTERISTIC
/begin CHARACTERISTIC Cxx_ccu_ecu_conf "BCM Control Unit feature for Mux Network configuration detection (always present or optional)" VALUE 0xa002112f _REC_S1VAL_20_u1 255. _CNV_A_R_ECME_LINEA_0_CM 0. 255. FORMAT "%3.0" /end CHARACTERISTIC
/begin CHARACTERISTIC Cxx_ccu_vld_abst_frm_dec "BCM Control Unit : decrementation value for validated absent CAN failure counter." VALUE 0xa0021130 _REC_S1VAL_20_u1 255. _CNV_A_R_ECME_LINEA_0_CM 0. 255. FORMAT "%3.0" /end CHARACTERISTIC
/begin CHARACTERISTIC Cxx_ccu_vld_abst_frm_inc "BCM Control Unit : incrementation value for validated absent CAN failure counter." VALUE 0xa0021131 _REC_S1VAL_20_u1 255. _CNV_A_R_ECME_LINEA_0_CM 0. 255. FORMAT "%3.0" /end CHARACTERISTIC
/begin CHARACTERISTIC Cxx_ddcm_abst_frm_dly "DDCM Control Unit absence detection time-out" VALUE 0xa0021132 _REC_S1VAL_20_u1 2.55 _CNV_A_R_LINEAR_____32_CM 0. 2.55 FORMAT "%4.2" /end CHARACTERISTIC
/begin CHARACTERISTIC Cxx_ddcm_ecu_conf "DDCM Control Unit feature for Mux configuration detection (always present or optional)" VALUE 0xa0021133 _REC_S1VAL_20_u1 255. _CNV_A_R_ECME_LINEA_0_CM 0. 255. FORMAT "%3.0" /end CHARACTERISTIC
/begin CHARACTERISTIC Cxx_ddcm_vld_abst_frm_dec "DDCM Control Unit : decrementation value for validated absent CAN failure counter." VALUE 0xa0021134 _REC_S1VAL_20_u1 255. _CNV_A_R_ECME_LINEA_0_CM 0. 255. FORMAT "%3.0" /end CHARACTERISTIC
/begin CHARACTERISTIC Cxx_ddcm_vld_abst_frm_inc "DDCM Control Unit : incrementation value for validated absent CAN failure counter." VALUE 0xa0021135 _REC_S1VAL_20_u1 255. _CNV_A_R_ECME_LINEA_0_CM 0. 255. FORMAT "%3.0" /end CHARACTERISTIC
/begin CHARACTERISTIC Cxx_ecu_stt_ctr_dec "Decrement step of the non-volatile counters" VALUE 0xa0021136 _REC_S1VAL_20_u1 255. _CNV_A_R_ECME_LINEA_0_CM 0. 255. FORMAT "%3.0" /end CHARACTERISTIC
/begin CHARACTERISTIC Cxx_ecu_stt_ctr_max "Maximum value of the non-volatile counters" VALUE 0xa0021137 _REC_S1VAL_20_u1 255. _CNV_A_R_ECME_LINEA_0_CM 0. 255. FORMAT "%3.0" /end CHARACTERISTIC
/begin CHARACTERISTIC Cxx_ecu_stt_ctr_thd "Decrement threshold of the non volatile counters" VALUE 0xa0021138 _REC_S1VAL_20_u1 255. _CNV_A_R_ECME_LINEA_0_CM 0. 255. FORMAT "%3.0" /end CHARACTERISTIC
/begin CHARACTERISTIC Cxx_etc_abst_frm_dly "ETC Control Unit absence detection time-out" VALUE 0xa0021139 _REC_S1VAL_20_u1 2.55 _CNV_A_R_LINEAR_____32_CM 0. 2.55 FORMAT "%4.2" /end CHARACTERISTIC
/begin CHARACTERISTIC Cxx_etc_ecu_conf "ETC Control Unit feature for Mux configuration detection (always present or optional)" VALUE 0xa002113a _REC_S1VAL_20_u1 255. _CNV_A_R_ECME_LINEA_0_CM 0. 255. FORMAT "%3.0" /end CHARACTERISTIC
/begin CHARACTERISTIC Cxx_etc_vld_abst_frm_dec "ETC Control Unit : decrementation value for validated absent CAN failure counter." VALUE 0xa002113b _REC_S1VAL_20_u1 255. _CNV_A_R_ECME_LINEA_0_CM 0. 255. FORMAT "%3.0" /end CHARACTERISTIC
/begin CHARACTERISTIC Cxx_etc_vld_abst_frm_inc "ETC Control Unit : incrementation value for validated absent CAN failure counter." VALUE 0xa002113c _REC_S1VAL_20_u1 255. _CNV_A_R_ECME_LINEA_0_CM 0. 255. FORMAT "%3.0" /end CHARACTERISTIC
/begin CHARACTERISTIC Cxx_ip_abst_frm_dly "Cluster Control Unit absence detection time-out" VALUE 0xa002113d _REC_S1VAL_20_u1 2.55 _CNV_A_R_LINEAR_____32_CM 0. 2.55 FORMAT "%4.2" /end CHARACTERISTIC
/begin CHARACTERISTIC Cxx_ip_ecu_conf "Cluster Control Unit feature for Mux Network configuration detection (always present or optional)" VALUE 0xa002113e _REC_S1VAL_20_u1 255. _CNV_A_R_ECME_LINEA_0_CM 0. 255. FORMAT "%3.0" /end CHARACTERISTIC
/begin CHARACTERISTIC Cxx_ip_vld_abst_frm_dec "Cluster Control Unit : decrementation value for validated absent CAN failure counter." VALUE 0xa002113f _REC_S1VAL_20_u1 255. _CNV_A_R_ECME_LINEA_0_CM 0. 255. FORMAT "%3.0" /end CHARACTERISTIC
/begin CHARACTERISTIC Cxx_ip_vld_abst_frm_inc "Cluster Control Unit : incrementation value for validated absent CAN failure counter." VALUE 0xa0021140 _REC_S1VAL_20_u1 255. _CNV_A_R_ECME_LINEA_0_CM 0. 255. FORMAT "%3.0" /end CHARACTERISTIC
/begin CHARACTERISTIC Cxx_mute_abst_frm_dly "Mute (transmission failure) detection time-out" VALUE 0xa0021141 _REC_S1VAL_20_u1 2.55 _CNV_A_R_LINEAR_____32_CM 0. 2.55 FORMAT "%4.2" /end CHARACTERISTIC
/begin CHARACTERISTIC Cxx_mute_ecu_conf "Mute (transmission failure detection) feature for Mux configuration detection (always present or opt" VALUE 0xa0021142 _REC_S1VAL_20_u1 255. _CNV_A_R_ECME_LINEA_0_CM 0. 255. FORMAT "%3.0" /end CHARACTERISTIC
/begin CHARACTERISTIC Cxx_mute_vld_abst_frm_dec "Mute : decrementation value for validated absent CAN failure counter." VALUE 0xa0021143 _REC_S1VAL_20_u1 255. _CNV_A_R_ECME_LINEA_0_CM 0. 255. FORMAT "%3.0" /end CHARACTERISTIC
/begin CHARACTERISTIC Cxx_mute_vld_abst_frm_inc "Mute : incrementation value for validated absent CAN failure counter." VALUE 0xa0021144 _REC_S1VAL_20_u1 255. _CNV_A_R_ECME_LINEA_0_CM 0. 255. FORMAT "%3.0" /end CHARACTERISTIC
/begin CHARACTERISTIC Cxx_mux_diag_ena_dly "delay counter for data reception during initialization phase" VALUE 0xa0021145 _REC_S1VAL_20_u1 25.5 _CNV_A_R_LINEAR_____58_CM 0. 25.5 FORMAT "%4.1" /end CHARACTERISTIC
/begin CHARACTERISTIC Cxx_mux_frm_set_ref "Mux messaging set reference" VALUE 0xa002111c _REC_S1VAL_20_u2 65535. _CNV_A_R_ECME_LINEA_0_CM 0. 65535. FORMAT "%5.0" /end CHARACTERISTIC
/begin CHARACTERISTIC Cxx_swa_abst_frm_dly "Steering Wheel Angle Control Unit absence detection time-out" VALUE 0xa0021146 _REC_S1VAL_20_u1 2.55 _CNV_A_R_LINEAR_____32_CM 0. 2.55 FORMAT "%4.2" /end CHARACTERISTIC
/begin CHARACTERISTIC Cxx_swa_ecu_conf "Steering Wheel Angle Control Unit feature for Mux configuration detection (always present or opt.)" VALUE 0xa0021147 _REC_S1VAL_20_u1 255. _CNV_A_R_ECME_LINEA_0_CM 0. 255. FORMAT "%3.0" /end CHARACTERISTIC
/begin CHARACTERISTIC Cxx_swa_vld_abst_frm_dec "Steering Wheel Angle Control Unit : decrementation value for validated absent CAN failure counter." VALUE 0xa0021148 _REC_S1VAL_20_u1 255. _CNV_A_R_ECME_LINEA_0_CM 0. 255. FORMAT "%3.0" /end CHARACTERISTIC
/begin CHARACTERISTIC Cxx_swa_vld_abst_frm_inc "Steering Wheel Angle Control Unit : incrementation value for validated absent CAN failure counter." VALUE 0xa0021149 _REC_S1VAL_20_u1 255. _CNV_A_R_ECME_LINEA_0_CM 0. 255. FORMAT "%3.0" /end CHARACTERISTIC
/begin CHARACTERISTIC Cxx_usm_abst_frm_dly "USM Control Unit absence detection time-out" VALUE 0xa002114a _REC_S1VAL_20_u1 2.55 _CNV_A_R_LINEAR_____32_CM 0. 2.55 FORMAT "%4.2" /end CHARACTERISTIC
/begin CHARACTERISTIC Cxx_usm_ecu_conf "USM Control Unit feature for Mux Network configuration detection (always present or optional)" VALUE 0xa002114b _REC_S1VAL_20_u1 255. _CNV_A_R_ECME_LINEA_0_CM 0. 255. FORMAT "%3.0" /end CHARACTERISTIC
/begin CHARACTERISTIC Cxx_usm_vld_abst_frm_dec "USM Control Unit : decrementation value for validated absent CAN failure counter." VALUE 0xa002114c _REC_S1VAL_20_u1 255. _CNV_A_R_ECME_LINEA_0_CM 0. 255. FORMAT "%3.0" /end CHARACTERISTIC
/begin CHARACTERISTIC Cxx_usm_vld_abst_frm_inc "USM Control Unit : incrementation value for validated absent CAN failure counter." VALUE 0xa002114d _REC_S1VAL_20_u1 255. _CNV_A_R_ECME_LINEA_0_CM 0. 255. FORMAT "%3.0" /end CHARACTERISTIC
/begin MEASUREMENT ABSinRegulation "Received CAN parameter" UBYTE _CNV_A_R_ECME_LINEA_0_CM 1 0. 0. 1. ECU_ADDRESS 0xd0006954 FORMAT "%1.0" /end MEASUREMENT
/begin MEASUREMENT ACCompClutchRequest "Received CAN parameter" UBYTE _CNV_A_R_ECME_LINEA_0_CM 1 0. 0. 1. ECU_ADDRESS 0xd00078b6 FORMAT "%1.0" /end MEASUREMENT
/begin MEASUREMENT ACCompClutchStatus "Received CAN parameter" UBYTE _CNV_A_R_ECME_LINEA_0_CM 1 0. 0. 1. ECU_ADDRESS 0xd0006955 FORMAT "%1.0" /end MEASUREMENT
/begin MEASUREMENT ACCompPowerUsed "Received CAN parameter" UBYTE _CNV_A_R_ECME_LINEA_0_CM 1 0. 0. 255. ECU_ADDRESS 0xd0006956 FORMAT "%3.0" /end MEASUREMENT
/begin MEASUREMENT ACCompRequest "Received CAN parameter" UBYTE _CNV_A_R_ECME_LINEA_0_CM 1 0. 0. 1. ECU_ADDRESS 0xd0006957 FORMAT "%1.0" /end MEASUREMENT
/begin MEASUREMENT ACCoolingFanSpeedRequest "Received CAN parameter" UBYTE _CNV_A_R_ECME_LINEA_0_CM 1 0. 0. 3. ECU_ADDRESS 0xd0006958 FORMAT "%1.0" /end MEASUREMENT
/begin MEASUREMENT ACMinEngineIdleSpeedRequest "Received CAN parameter" UBYTE _CNV_A_R_ECME_LINEA_0_CM 1 0. 0. 15. ECU_ADDRESS 0xd0006959 FORMAT "%2.0" /end MEASUREMENT
/begin MEASUREMENT ASRDynamicTorqueRequest "Received CAN parameter" UWORD _CNV_A_R_ECME_LINEA_0_CM 1 0. 0. 4095. ECU_ADDRESS 0xd00040f8 FORMAT "%4.0" /end MEASUREMENT
/begin MEASUREMENT ASRStaticTorqueRequest "Received CAN parameter" UWORD _CNV_A_R_ECME_LINEA_0_CM 1 0. 0. 4095. ECU_ADDRESS 0xd00040fa FORMAT "%4.0" /end MEASUREMENT
/begin MEASUREMENT ASRinRegulation "Received CAN parameter" UBYTE _CNV_A_R_ECME_LINEA_0_CM 1 0. 0. 1. ECU_ADDRESS 0xd000695a FORMAT "%1.0" /end MEASUREMENT
/begin MEASUREMENT ATCoolingFanSpeedRequest "Received CAN parameter" UBYTE _CNV_A_R_ECME_LINEA_0_CM 1 0. 0. 3. ECU_ADDRESS 0xd000695b FORMAT "%1.0" /end MEASUREMENT
/begin MEASUREMENT AT_Clock "Received CAN parameter" UBYTE _CNV_A_R_ECME_LINEA_0_CM 1 0. 0. 15. ECU_ADDRESS 0xd000695c FORMAT "%2.0" /end MEASUREMENT
/begin MEASUREMENT AT_MILRequest "Received CAN parameter" UBYTE _CNV_A_R_ECME_LINEA_0_CM 1 0. 0. 7. ECU_ADDRESS 0xd000695d FORMAT "%1.0" /end MEASUREMENT
/begin MEASUREMENT AT_Minimum_IdleSpeedRequest "Received CAN parameter" UBYTE _CNV_A_R_ECME_LINEA_0_CM 1 0. 0. 255. ECU_ADDRESS 0xd000695e FORMAT "%3.0" /end MEASUREMENT
/begin MEASUREMENT AT_TorqueControlType "Received CAN parameter" UBYTE _CNV_A_R_ECME_LINEA_0_CM 1 0. 0. 7. ECU_ADDRESS 0xd000695f FORMAT "%1.0" /end MEASUREMENT
/begin MEASUREMENT AT_TorqueLosses "Received CAN parameter" UBYTE _CNV_A_R_ECME_LINEA_0_CM 1 0. 0. 255. ECU_ADDRESS 0xd0006960 FORMAT "%3.0" /end MEASUREMENT
/begin MEASUREMENT AYCinRegulation "Received CAN parameter" UBYTE _CNV_A_R_ECME_LINEA_0_CM 1 0. 0. 1. ECU_ADDRESS 0xd00078b7 FORMAT "%1.0" /end MEASUREMENT
/begin MEASUREMENT AccurateOdometer "Received CAN parameter" UBYTE _CNV_A_R_ECME_LINEA_0_CM 1 0. 0. 31. ECU_ADDRESS 0xd00078b8 FORMAT "%2.0" /end MEASUREMENT
/begin MEASUREMENT AirbagCrashOrder "Received CAN parameter" UWORD _CNV_A_R_ECME_LINEA_0_CM 1 0. 0. 65535. ECU_ADDRESS 0xd00051b0 FORMAT "%5.0" /end MEASUREMENT
/begin MEASUREMENT AlternatorLoad "Received CAN parameter" UBYTE _CNV_A_R_ECME_LINEA_0_CM 1 0. 0. 255. ECU_ADDRESS 0xd0006961 FORMAT "%3.0" /end MEASUREMENT
/begin MEASUREMENT AnticipatedCurrentShift "Received CAN parameter" UBYTE _CNV_A_R_ECME_LINEA_0_CM 1 0. 0. 3. ECU_ADDRESS 0xd0006962 FORMAT "%3.0" /end MEASUREMENT
/begin MEASUREMENT BrakeInfoStatus "Received CAN parameter" UBYTE _CNV_A_R_ECME_LINEA_0_CM 1 0. 0. 7. ECU_ADDRESS 0xd0006963 FORMAT "%1.0" /end MEASUREMENT
/begin MEASUREMENT BrakeSwitchFailure "Received CAN parameter" UBYTE _CNV_A_R_ECME_LINEA_0_CM 1 0. 0. 3. ECU_ADDRESS 0xd0006964 FORMAT "%1.0" /end MEASUREMENT
/begin MEASUREMENT ClimateCoolingRequest "Received CAN parameter" UBYTE _CNV_A_R_ECME_LINEA_0_CM 1 0. 0. 1. ECU_ADDRESS 0xd00078b9 FORMAT "%1.0" /end MEASUREMENT
/begin MEASUREMENT ClutchSwitchMaximumTravel "Received CAN parameter" UBYTE _CNV_A_R_ECME_LINEA_0_CM 1 0. 0. 3. ECU_ADDRESS 0xd0006965 FORMAT "%1.0" /end MEASUREMENT
/begin MEASUREMENT ClutchSwitchMinimumTravel "Received CAN parameter" UBYTE _CNV_A_R_ECME_LINEA_0_CM 1 0. 0. 3. ECU_ADDRESS 0xd0006966 FORMAT "%1.0" /end MEASUREMENT
/begin MEASUREMENT CouplerState "Received CAN parameter" UBYTE _CNV_A_R_ECME_LINEA_0_CM 1 0. 0. 3. ECU_ADDRESS 0xd0006967 FORMAT "%3.0" /end MEASUREMENT
/begin MEASUREMENT DiagMuxOn_BCM "Received CAN parameter" UBYTE _CNV_A_R_ECME_LINEA_0_CM 1 0. 0. 1. ECU_ADDRESS 0xd0006968 FORMAT "%1.0" /end MEASUREMENT
/begin MEASUREMENT DiagnoseFuelLow "Received CAN parameter" UBYTE _CNV_A_R_ECME_LINEA_0_CM 1 0. 0. 3. ECU_ADDRESS 0xd00078ba FORMAT "%1.0" /end MEASUREMENT
/begin MEASUREMENT DisplayedSpeed "Received CAN parameter" UWORD _CNV_A_R_ECME_LINEA_0_CM 1 0. 0. 65535. ECU_ADDRESS 0xd00051b2 FORMAT "%5.0" /end MEASUREMENT
/begin MEASUREMENT DisplayedSpeedUnit "Received CAN parameter" UBYTE _CNV_A_R_ECME_LINEA_0_CM 1 0. 0. 1. ECU_ADDRESS 0xd00078bb FORMAT "%1.0" /end MEASUREMENT
/begin MEASUREMENT DistanceTotalizer "Received CAN parameter" ULONG _CNV_A_R_ECME_LINEA_0_CM 1 0. 0. 268435455. ECU_ADDRESS 0xd00034d4 FORMAT "%9.0" /end MEASUREMENT
/begin MEASUREMENT ESP_Clock "Received CAN parameter" UBYTE _CNV_A_R_ECME_LINEA_0_CM 1 0. 0. 15. ECU_ADDRESS 0xd0006969 FORMAT "%2.0" /end MEASUREMENT
/begin MEASUREMENT ESP_TorqueControlType "Received CAN parameter" UBYTE _CNV_A_R_ECME_LINEA_0_CM 1 0. 0. 7. ECU_ADDRESS 0xd000696a FORMAT "%1.0" /end MEASUREMENT
/begin MEASUREMENT ETC_Clock "Received CAN parameter" UBYTE _CNV_A_R_ECME_LINEA_0_CM 1 0. 0. 15. ECU_ADDRESS 0xd000696b FORMAT "%3.0" /end MEASUREMENT
/begin MEASUREMENT ElecPowerConsumedByAux "Received CAN parameter" UWORD _CNV_A_R_ECME_LINEA_0_CM 1 0. 0. 511. ECU_ADDRESS 0xd00051b4 FORMAT "%5.0" /end MEASUREMENT
/begin MEASUREMENT ElectricalPowerDrived "Received CAN parameter" UBYTE _CNV_A_R_ECME_LINEA_0_CM 1 0. 0. 31. ECU_ADDRESS 0xd00078bc FORMAT "%2.0" /end MEASUREMENT
/begin MEASUREMENT EmergencyEngineStop "Received CAN parameter" UBYTE _CNV_A_R_ECME_LINEA_0_CM 1 0. 0. 15. ECU_ADDRESS 0xd000696c FORMAT "%2.0" /end MEASUREMENT
/begin MEASUREMENT EngineTorqueReductionRequestCf "Received CAN parameter" UBYTE _CNV_A_R_ECME_LINEA_0_CM 1 0. 0. 1. ECU_ADDRESS 0xd000696d FORMAT "%3.0" /end MEASUREMENT
/begin MEASUREMENT ExternalTemp "Received CAN parameter" UBYTE _CNV_A_R_ECME_LINEA_0_CM 1 0. 0. 255. ECU_ADDRESS 0xd000696e FORMAT "%3.0" /end MEASUREMENT
/begin MEASUREMENT FastTorqueRequest "Received CAN parameter" UWORD _CNV_A_R_ECME_LINEA_0_CM 1 0. 0. 4095. ECU_ADDRESS 0xd00040fc FORMAT "%4.0" /end MEASUREMENT
/begin MEASUREMENT FrontDefrostEngaged "Received CAN parameter" UBYTE _CNV_A_R_ECME_LINEA_0_CM 1 0. 0. 1. ECU_ADDRESS 0xd000696f FORMAT "%1.0" /end MEASUREMENT
/begin MEASUREMENT FuelCutRequestedEngineSpeed "Received CAN parameter for engine speed limitation from EGB (CVT, ...)" UBYTE _CNV_A_R_ECME_LINEA_0_CM 1 0. 0. 255. ECU_ADDRESS 0xd0006970 FORMAT "%3.0" /end MEASUREMENT
/begin MEASUREMENT FuelLevelDisplayed "Received CAN parameter" UBYTE _CNV_A_R_ECME_LINEA_0_CM 1 0. 0. 127. ECU_ADDRESS 0xd00078bd FORMAT "%3.0" /end MEASUREMENT
/begin MEASUREMENT FuelLow "Received CAN parameter" UBYTE _CNV_A_R_ECME_LINEA_0_CM 1 0. 0. 1. ECU_ADDRESS 0xd00078be FORMAT "%1.0" /end MEASUREMENT
/begin MEASUREMENT GenericApplicativeDiagEnable "Received CAN parameter" UBYTE _CNV_A_R_ECME_LINEA_0_CM 1 0. 0. 3. ECU_ADDRESS 0xd0006971 FORMAT "%1.0" /end MEASUREMENT
/begin MEASUREMENT IdleSpeedInhibitionRequest "Received CAN parameter" UBYTE _CNV_A_R_ECME_LINEA_0_CM 1 0. 0. 3. ECU_ADDRESS 0xd00078bf FORMAT "%3.0" /end MEASUREMENT
/begin MEASUREMENT InputShaftRevolution "Received CAN parameter" UWORD _CNV_A_R_ECME_LINEA_0_CM 1 0. 0. 65535. ECU_ADDRESS 0xd00040fe FORMAT "%5.0" /end MEASUREMENT
/begin MEASUREMENT InstantMecanicalPowerByAlt "Received CAN parameter" UBYTE _CNV_A_R_ECME_LINEA_0_CM 1 0. 0. 255. ECU_ADDRESS 0xd0006972 FORMAT "%3.0" /end MEASUREMENT
/begin MEASUREMENT KeyVehicle "Received CAN parameter" UBYTE _CNV_A_R_ECME_LINEA_0_CM 1 0. 0. 3. ECU_ADDRESS 0xd00078c0 FORMAT "%1.0" /end MEASUREMENT
/begin MEASUREMENT Limit_SlowTorqueRequest "Received CAN parameter" UWORD _CNV_A_R_ECME_LINEA_0_CM 1 0. 0. 4095. ECU_ADDRESS 0xd0004100 FORMAT "%4.0" /end MEASUREMENT
/begin MEASUREMENT MSRTorqueRequest " Received CAN parameter" UWORD _CNV_A_R_ECME_LINEA_0_CM 1 0. 0. 4095. ECU_ADDRESS 0xd0004102 FORMAT "%4.0" /end MEASUREMENT
/begin MEASUREMENT MSRinRegulation "Received CAN parameter" UBYTE _CNV_A_R_ECME_LINEA_0_CM 1 0. 0. 1. ECU_ADDRESS 0xd0006973 FORMAT "%1.0" /end MEASUREMENT
/begin MEASUREMENT MiniConsumptionRequest "Received CAN parameter" UBYTE _CNV_A_R_ECME_LINEA_0_CM 1 0. 0. 3. ECU_ADDRESS 0xd0006974 FORMAT "%1.0" /end MEASUREMENT
/begin MEASUREMENT NeutralContact "Received CAN parameter" UBYTE _CNV_A_R_ECME_LINEA_0_CM 1 0. 0. 3. ECU_ADDRESS 0xd0006975 FORMAT "%1.0" /end MEASUREMENT
/begin MEASUREMENT OilDrainAlertResetRequest "Received CAN parameter" UBYTE _CNV_A_R_ECME_LINEA_0_CM 1 0. 0. 1. ECU_ADDRESS 0xd00078c1 FORMAT "%1.0" /end MEASUREMENT
/begin MEASUREMENT PTCEngineIdleSpeedRequest "Received CAN parameter" UBYTE _CNV_A_R_ECME_LINEA_0_CM 1 0. 0. 1. ECU_ADDRESS 0xd00078c2 FORMAT "%1.0" /end MEASUREMENT
/begin MEASUREMENT ParkingBrakeStatus "Received CAN parameter" UBYTE _CNV_A_R_ECME_LINEA_0_CM 1 0. 0. 3. ECU_ADDRESS 0xd0006976 FORMAT "%1.0" /end MEASUREMENT
/begin MEASUREMENT PumpActivationRequest "Received CAN parameter" UBYTE _CNV_A_R_ECME_LINEA_0_CM 1 0. 0. 3. ECU_ADDRESS 0xd0006977 FORMAT "%1.0" /end MEASUREMENT
/begin MEASUREMENT RST_EspAsrSportMode "Received CAN parameter" UBYTE _CNV_A_R_ECME_LINEA_0_CM 1 0. 0. 7. ECU_ADDRESS 0xd00078c3 FORMAT "%3.0" /end MEASUREMENT
/begin MEASUREMENT RST_GearShiftOffset "Received CAN parameter" UBYTE _CNV_A_R_ECME_LINEA_0_CM 1 0. 0. 255. ECU_ADDRESS 0xd00078c4 FORMAT "%3.0" /end MEASUREMENT
/begin MEASUREMENT RST_PedalMap "Received CAN parameter" UBYTE _CNV_A_R_ECME_LINEA_0_CM 1 0. 0. 15. ECU_ADDRESS 0xd00078c5 FORMAT "%3.0" /end MEASUREMENT
/begin MEASUREMENT RearDefrostEngaged "Received CAN parameter" UBYTE _CNV_A_R_ECME_LINEA_0_CM 1 0. 0. 1. ECU_ADDRESS 0xd00078c6 FORMAT "%1.0" /end MEASUREMENT
/begin MEASUREMENT RearGearEngaged "Received CAN parameter" UBYTE _CNV_A_R_ECME_LINEA_0_CM 1 0. 0. 3. ECU_ADDRESS 0xd0006978 FORMAT "%1.0" /end MEASUREMENT
/begin MEASUREMENT SLockValueControl "Received CAN parameter" UBYTE _CNV_A_R_ECME_LINEA_0_CM 1 0. 0. 31. ECU_ADDRESS 0xd00078c7 FORMAT "%2.0" /end MEASUREMENT
/begin MEASUREMENT SOCBattery14V "Received CAN parameter" UBYTE _CNV_A_R_ECME_LINEA_0_CM 1 0. 0. 63. ECU_ADDRESS 0xd00078c8 FORMAT "%3.0" /end MEASUREMENT
/begin MEASUREMENT SlipControlStatus "Received CAN parameter" UBYTE _CNV_A_R_ECME_LINEA_0_CM 1 0. 0. 3. ECU_ADDRESS 0xd0006979 FORMAT "%3.0" /end MEASUREMENT
/begin MEASUREMENT SlowEngineTorqueSetpoint "Received CAN parameter" UWORD _CNV_A_R_ECME_LINEA_0_CM 1 0. 0. 4095. ECU_ADDRESS 0xd0004104 FORMAT "%5.0" /end MEASUREMENT
/begin MEASUREMENT SoftwareLockValue[0] "Received CAN parameter" UBYTE _CNV_A_R_ECME_LINEA_0_CM 1 0. 0. 255. ECU_ADDRESS 0xd00078b2 FORMAT "%3.0" /end MEASUREMENT
/begin MEASUREMENT SoftwareLockValue[1] "Received CAN parameter" UBYTE _CNV_A_R_ECME_LINEA_0_CM 1 0. 0. 255. ECU_ADDRESS 0xd00078b3 FORMAT "%3.0" /end MEASUREMENT
/begin MEASUREMENT SoftwareLockValue[2] "Received CAN parameter" UBYTE _CNV_A_R_ECME_LINEA_0_CM 1 0. 0. 255. ECU_ADDRESS 0xd00078b4 FORMAT "%3.0" /end MEASUREMENT
/begin MEASUREMENT SoftwareLockValue[3] "Received CAN parameter" UBYTE _CNV_A_R_ECME_LINEA_0_CM 1 0. 0. 255. ECU_ADDRESS 0xd00078b5 FORMAT "%3.0" /end MEASUREMENT
/begin MEASUREMENT SportivityCriteria "Received CAN parameter" UBYTE _CNV_A_R_ECME_LINEA_0_CM 1 0. 0. 255. ECU_ADDRESS 0xd000697a FORMAT "%3.0" /end MEASUREMENT
/begin MEASUREMENT StartButtonPushed "Received CAN parameter" UBYTE _CNV_A_R_ECME_LINEA_0_CM 1 0. 0. 7. ECU_ADDRESS 0xd00078c9 FORMAT "%1.0" /end MEASUREMENT
/begin MEASUREMENT StarterStatus "Received CAN parameter" UBYTE _CNV_A_R_ECME_LINEA_0_CM 1 0. 0. 3. ECU_ADDRESS 0xd000697b FORMAT "%1.0" /end MEASUREMENT
/begin MEASUREMENT StartingMode_BCM_R "Received CAN parameter" UBYTE _CNV_A_R_ECME_LINEA_0_CM 1 0. 0. 3. ECU_ADDRESS 0xd000697c FORMAT "%1.0" /end MEASUREMENT
/begin MEASUREMENT SteeringWheelAngle "Received CAN parameter" UWORD _CNV_A_R_ECME_LINEA_0_CM 1 0. 0. 65535. ECU_ADDRESS 0xd0004106 FORMAT "%5.0" /end MEASUREMENT
/begin MEASUREMENT StopAutoRequest "Received CAN parameter" UBYTE _CNV_A_R_ECME_LINEA_0_CM 1 0. 0. 3. ECU_ADDRESS 0xd00078ca FORMAT "%3.0" /end MEASUREMENT
/begin MEASUREMENT TechnicalStartAutoRequest "Received CAN parameter" UBYTE _CNV_A_R_ECME_LINEA_0_CM 1 0. 0. 3. ECU_ADDRESS 0xd00078cb FORMAT "%3.0" /end MEASUREMENT
/begin MEASUREMENT TorqueConverterState "Received CAN parameter" UBYTE _CNV_A_R_ECME_LINEA_0_CM 1 0. 0. 3. ECU_ADDRESS 0xd000697d FORMAT "%1.0" /end MEASUREMENT
/begin MEASUREMENT TransmRangeEngaged_Current "Received CAN parameter" UBYTE _CNV_A_R_ECME_LINEA_0_CM 1 0. 0. 15. ECU_ADDRESS 0xd000697e FORMAT "%2.0" /end MEASUREMENT
/begin MEASUREMENT TransmRangeEngaged_Target "Received CAN parameter" UBYTE _CNV_A_R_ECME_LINEA_0_CM 1 0. 0. 15. ECU_ADDRESS 0xd000697f FORMAT "%2.0" /end MEASUREMENT
/begin MEASUREMENT TransversalAcceleration "Received CAN parameter" UWORD _CNV_A_R_ECME_LINEA_0_CM 1 0. 0. 65535. ECU_ADDRESS 0xd0004108 FORMAT "%5.0" /end MEASUREMENT
/begin MEASUREMENT VehicleSpeed "Received CAN parameter" UWORD _CNV_A_R_ECME_LINEA_0_CM 1 0. 0. 65535. ECU_ADDRESS 0xd000410a FORMAT "%5.0" /end MEASUREMENT
/begin MEASUREMENT VehicleState "Received CAN parameter" UBYTE _CNV_A_R_ECME_LINEA_0_CM 1 0. 0. 7. ECU_ADDRESS 0xd0006980 FORMAT "%3.0" /end MEASUREMENT
/begin MEASUREMENT VehiculeStateSSExtension "Received CAN parameter" UBYTE _CNV_A_R_ECME_LINEA_0_CM 1 0. 0. 3. ECU_ADDRESS 0xd0006981 FORMAT "%3.0" /end MEASUREMENT
/begin MEASUREMENT WheelSpeedRL "Received CAN parameter" UWORD _CNV_A_R_ECME_LINEA_0_CM 1 0. 0. 65535. ECU_ADDRESS 0xd000410c FORMAT "%5.0" /end MEASUREMENT
/begin MEASUREMENT WheelSpeedRR "Received CAN parameter" UWORD _CNV_A_R_ECME_LINEA_0_CM 1 0. 0. 65535. ECU_ADDRESS 0xd000410e FORMAT "%5.0" /end MEASUREMENT
/begin MEASUREMENT Vbx_mux_abs_reg "ABS in regulation received on the CAN" UBYTE _CNV_S_2_RANGE______3_CM 1 0. 0. 1. ECU_ADDRESS 0xd00078a2 BIT_MASK 0x1 /end MEASUREMENT
/begin MEASUREMENT Vsx_mux_abs_reg_vld "ABS in regulation received on the CAN validity status" UBYTE _CNV_A_R_ECME_LINEA_0_CM 1 0. 0. 1. ECU_ADDRESS 0xd00078a3 FORMAT "%1.0" /end MEASUREMENT
/begin MEASUREMENT ComputedOilDrainingRange "Transmitted CAN parameter" UWORD _CNV_A_R_ECME_LINEA_0_CM 1 0. 0. 65535. ECU_ADDRESS 0xd00051aa FORMAT "%5.0" /end MEASUREMENT
/begin MEASUREMENT FreeShift "Transmitted CAN parameter" UBYTE _CNV_A_R_ECME_LINEA_0_CM 1 0. 0. 3. ECU_ADDRESS 0xd00078a4 FORMAT "%1.0" /end MEASUREMENT
/begin CHARACTERISTIC Cxx_free_shf_dft_val "value send if free shit can't be calculated (0 or 3)" VALUE 0xa0021152 _REC_S1VAL_20_u1 3. _CNV_A_R_ECME_LINEA_0_CM 0. 3. FORMAT "%1.0" /end CHARACTERISTIC
/begin CHARACTERISTIC Cxx_free_shf_ini_val "Freeshift initial value sent on the CAN." VALUE 0xa0021153 _REC_S1VAL_20_u1 3. _CNV_A_R_ECME_LINEA_0_CM 0. 3. FORMAT "%3.0" /end CHARACTERISTIC
/begin MEASUREMENT ECM_MechanicalLoadRequest "Transmitted CAN parameter" UBYTE _CNV_A_R_ECME_LINEA_0_CM 1 0. 0. 1. ECU_ADDRESS 0xd000786c FORMAT "%1.0" /end MEASUREMENT
/begin MEASUREMENT ParticulateFilterFailureDisplay "Transmitted CAN parameter" UBYTE _CNV_A_R_ECME_LINEA_0_CM 1 0. 0. 1. ECU_ADDRESS 0xd00078a7 FORMAT "%1.0" /end MEASUREMENT
/begin MEASUREMENT ParticulateFilterState "Transmitted CAN parameter" UBYTE _CNV_A_R_ECME_LINEA_0_CM 1 0. 0. 1. ECU_ADDRESS 0xd00078a8 FORMAT "%1.0" /end MEASUREMENT
/begin MEASUREMENT WarningWaterTemp "Transmitted CAN parameter" UBYTE _CNV_A_R_ECME_LINEA_0_CM 1 0. 0. 1. ECU_ADDRESS 0xd0007861 FORMAT "%1.0" BIT_MASK 0x1 /end MEASUREMENT
/begin MEASUREMENT DownTransitionOfEngCoolantTemp "Transmitted CAN parameter" UBYTE _CNV_A_R_ECME_LINEA_0_CM 1 0. 0. 1. ECU_ADDRESS 0xd0007863 FORMAT "%1.0" /end MEASUREMENT
/begin MEASUREMENT EngineCoolantRegulationTemp "Transmitted CAN parameter" UBYTE _CNV_A_R_ECME_LINEA_0_CM 1 0. 0. 7. ECU_ADDRESS 0xd0007864 FORMAT "%1.0" /end MEASUREMENT
/begin MEASUREMENT EngineCoolantTemp "Transmitted CAN parameter" UBYTE _CNV_A_R_ECME_LINEA_0_CM 1 0. 0. 255. ECU_ADDRESS 0xd0007865 FORMAT "%3.0" /end MEASUREMENT
/begin MEASUREMENT MILLamp "Transmitted CAN parameter" UBYTE _CNV_A_R_ECME_LINEA_0_CM 1 0. 0. 15. ECU_ADDRESS 0xd0007869 FORMAT "%2.0" /end MEASUREMENT
/begin MEASUREMENT EngineControlFailureLevel1 "Transmitted CAN parameter" UBYTE _CNV_A_R_ECME_LINEA_0_CM 1 0. 0. 1. ECU_ADDRESS 0xd000786a FORMAT "%1.0" /end MEASUREMENT
/begin MEASUREMENT EngineControlFailureLevel2 "Transmitted CAN parameter" UBYTE _CNV_A_R_ECME_LINEA_0_CM 1 0. 0. 1. ECU_ADDRESS 0xd000786b FORMAT "%1.0" /end MEASUREMENT
/begin MEASUREMENT FuelConsumption "Transmitted CAN parameter" UBYTE _CNV_A_R_ECME_LINEA_0_CM 1 0. 0. 255. ECU_ADDRESS 0xd0007856 FORMAT "%3.0" /end MEASUREMENT
/begin MEASUREMENT NominalFuelConsumption "Transmitted CAN parameter" UBYTE _CNV_A_R_ECME_LINEA_0_CM 1 0. 0. 255. ECU_ADDRESS 0xd0007857 FORMAT "%3.0" /end MEASUREMENT
/begin MEASUREMENT KickDownActivated "Transmitted CAN parameter" UBYTE _CNV_A_R_ECME_LINEA_0_CM 1 0. 0. 1. ECU_ADDRESS 0xd0006911 FORMAT "%1.0" /end MEASUREMENT
/begin MEASUREMENT PedalError "Transmitted CAN parameter" UBYTE _CNV_A_R_ECME_LINEA_0_CM 1 0. 0. 3. ECU_ADDRESS 0xd0006912 FORMAT "%1.0" /end MEASUREMENT
/begin MEASUREMENT PowerTrainSetPoint "Transmitted CAN parameter" UWORD _CNV_A_R_ECME_LINEA_0_CM 1 0. 0. 1023. ECU_ADDRESS 0xd00040d6 FORMAT "%2.0" /end MEASUREMENT
/begin MEASUREMENT RawSensor "Transmitted CAN parameter" UWORD _CNV_A_R_ECME_LINEA_0_CM 1 0. 0. 1023. ECU_ADDRESS 0xd00040d8 FORMAT "%2.0" /end MEASUREMENT
/begin CHARACTERISTIC Cbx_acel_pdl_rat_secu_1_cfm "Configuration of the value sent on CAN during detected failure of reversible pedal safety case" VALUE 0xa0021150 _REC_S1VAL_20_u1 1. _CNV_A_R_ECME_LINEA_0_CM 0. 1. FORMAT "%1.0" BIT_MASK 0x1 /end CHARACTERISTIC
/begin CHARACTERISTIC Cbx_mux_driv_pwt_sp_fail "Configuration of invalid value of Powertrain Setpoint CAN signal." VALUE 0xa0021151 _REC_S1VAL_20_u1 1. _CNV_A_R_ECME_LINEA_0_CM 0. 1. FORMAT "%1.0" BIT_MASK 0x1 /end CHARACTERISTIC
/begin CHARACTERISTIC Cxx_acel_pdl_rat_secu_1_val "Value sent on CAN during detected failure of accelerator pedal safety case N°1 (reversible)" VALUE 0xa002114e _REC_S1VAL_20_u2 1.25 _CNV_A_R_LINEAR_____267_CM 0. 1.25 FORMAT "%7.5" /end CHARACTERISTIC
/begin MEASUREMENT Vbx_mux_vh_dist_navl "indicates that total vehicle distance is unavailable" UBYTE _CNV_S_2_RANGE______3_CM 1 0. 0. 1. ECU_ADDRESS 0xd0007866 BIT_MASK 0x1 /end MEASUREMENT
/begin MEASUREMENT Vsx_mux_vh_dist_vld "Total vehicle distance received on the CAN validity status" UBYTE _CNV_S_3_STATUS_OK__179_CM 1 0. 0. 2. ECU_ADDRESS 0xd0007867 /end MEASUREMENT
/begin MEASUREMENT Vxx_mux_vh_dist "Total vehicle distance received on the CAN" ULONG _CNV_A_R_LINEAR_____274_CM 1 0. 0. 16777215. ECU_ADDRESS 0xd00034d0 FORMAT "%8.0" /end MEASUREMENT
/begin MEASUREMENT Vbx_mil_gcu_req "MIL activation request of lpg control unit" UBYTE _CNV_S_2_RANGE______3_CM 1 0. 0. 1. ECU_ADDRESS 0xd0007868 BIT_MASK 0x1 /end MEASUREMENT
/begin MEASUREMENT Vxx_mux_agb_driv_spt_fac "Sportivity factor calculated by Automatic Transmission received on the CAN" UBYTE _CNV_A_R_LINEAR_____275_CM 1 0. 0. 1. ECU_ADDRESS 0xd0006939 FORMAT "%9.7" /end MEASUREMENT
/begin MEASUREMENT Vbx_mux_agb_coup_navl "Indicates that the automatic gearbox coupler state received on the CAN is unavailable" UBYTE _CNV_S_2_RANGE______3_CM 1 0. 0. 1. ECU_ADDRESS 0xd000693e BIT_MASK 0x1 /end MEASUREMENT
/begin MEASUREMENT Vbx_mux_ant_crt_slc_navl "Indicates that the anticipated current gear shift is unavailable" UBYTE _CNV_S_2_RANGE______3_CM 1 0. 0. 1. ECU_ADDRESS 0xd000693f BIT_MASK 0x1 /end MEASUREMENT
/begin MEASUREMENT Vsx_mux_agb_coup "Automatic gearbox coupler state received on the CAN" UBYTE _CNV_A_R_ECME_LINEA_0_CM 1 0. 0. 255. ECU_ADDRESS 0xd0006940 FORMAT "%3.0" /end MEASUREMENT
/begin MEASUREMENT Vsx_mux_agb_coup_vld "Automatic gearbox coupler state received on the CAN validity status" UBYTE _CNV_A_R_ECME_LINEA_0_CM 1 0. 0. 3. ECU_ADDRESS 0xd0006941 FORMAT "%1.0" /end MEASUREMENT
/begin MEASUREMENT Vsx_mux_ant_crt_slc "Anticipated current gear shift received on the CAN" UBYTE _CNV_S_3_STATUS_ANT_449_CM 1 0. 1. 3. ECU_ADDRESS 0xd0006942 /end MEASUREMENT
/begin MEASUREMENT Vsx_mux_ant_crt_slc_vld "Anticipated current gear shift received on the CAN validity status" UBYTE _CNV_S_8_STATUS_OK__234_CM 1 0. 0. 7. ECU_ADDRESS 0xd0006943 /end MEASUREMENT
/begin MEASUREMENT Vsx_mux_rgb_coup "Robotized gearbox coupler state received on the CAN" UBYTE _CNV_A_R_ECME_LINEA_0_CM 1 0. 0. 3. ECU_ADDRESS 0xd0006944 FORMAT "%1.0" /end MEASUREMENT
/begin MEASUREMENT Vsx_mux_rgb_coup_vld "Robotized gearbox coupler state received on the CAN validity status" UBYTE _CNV_A_R_ECME_LINEA_0_CM 1 0. 0. 2. ECU_ADDRESS 0xd0006945 FORMAT "%1.0" /end MEASUREMENT
/begin MEASUREMENT Vbx_mux_brk_pdl_navl "indicates that the brake pedals states switch is unavailable" UBYTE _CNV_S_2_RANGE______3_CM 1 0. 0. 1. ECU_ADDRESS 0xd000691d BIT_MASK 0x1 /end MEASUREMENT
/begin MEASUREMENT Vsx_mux_brk_pdl "Brake pedal states received on the CAN" UBYTE _CNV_A_R_ECME_LINEA_0_CM 1 0. 1. 7. ECU_ADDRESS 0xd000691e FORMAT "%1.0" /end MEASUREMENT
/begin MEASUREMENT Vsx_mux_brk_pdl_vld "Brake pedal states received on the CAN validity status" UBYTE _CNV_S_4_STATUS_OK__180_CM 1 0. 0. 3. ECU_ADDRESS 0xd000691f /end MEASUREMENT
/begin MEASUREMENT Vbx_mux_bgin_str_clu_cnt_navl "indicates that end stroke clutch pedal switch received on the CAN is unavailable" UBYTE _CNV_S_2_RANGE______3_CM 1 0. 0. 1. ECU_ADDRESS 0xd0006922 BIT_MASK 0x1 /end MEASUREMENT
/begin MEASUREMENT Vsx_mux_bgin_str_clu_cnt "Begin stroke clutch pedal switch received on the CAN" UBYTE _CNV_A_R_ECME_LINEA_0_CM 1 0. 0. 3. ECU_ADDRESS 0xd0006923 FORMAT "%1.0" /end MEASUREMENT
/begin MEASUREMENT Vsx_mux_bgin_str_clu_cnt_vld "Begin stroke clutch pedal switch received on the CAN validity status" UBYTE _CNV_S_4_STATUS_OK__180_CM 1 0. 0. 3. ECU_ADDRESS 0xd0006924 /end MEASUREMENT
/begin MEASUREMENT Vbx_mux_end_str_clu_cnt_navl "indicates that end stroke clutch pedal switch received on the CAN is unavailable" UBYTE _CNV_S_2_RANGE______3_CM 1 0. 0. 1. ECU_ADDRESS 0xd0006925 BIT_MASK 0x1 /end MEASUREMENT
/begin MEASUREMENT Vsx_mux_end_str_clu_cnt "End stroke clutch pedal switch received on the CAN" UBYTE _CNV_A_R_ECME_LINEA_0_CM 1 0. 0. 3. ECU_ADDRESS 0xd0006926 FORMAT "%1.0" /end MEASUREMENT
/begin MEASUREMENT Vsx_mux_end_str_clu_cnt_vld "End stroke clutch pedal switch received on the CAN validity status" UBYTE _CNV_A_R_ECME_LINEA_0_CM 1 0. 0. 2. ECU_ADDRESS 0xd0006927 FORMAT "%1.0" /end MEASUREMENT
/begin MEASUREMENT Vbx_mux_agb_csm_tq_navl "indicates that converter friction Torque received on the CAN is unavailable" UBYTE _CNV_S_2_RANGE______3_CM 1 0. 0. 1. ECU_ADDRESS 0xd0006914 BIT_MASK 0x1 /end MEASUREMENT
/begin MEASUREMENT Vbx_mux_gear_cge "Gear change in progress. Boolean transmitted by automatic transmissions." UBYTE _CNV_S_2_RANGE______3_CM 1 0. 0. 1. ECU_ADDRESS 0xd0006915 BIT_MASK 0x1 /end MEASUREMENT
/begin MEASUREMENT Vsx_mux_agb_csm_tq_vld "Converter friction torque received on the CAN validity status" UBYTE _CNV_S_3_STATUS_OK__213_CM 1 0. 0. 2. ECU_ADDRESS 0xd0006916 /end MEASUREMENT
/begin MEASUREMENT Vsx_mux_agb_tq_ctl_typ "AGB Torque control type" UBYTE _CNV_A_R_ECME_LINEA_0_CM 1 0. 0. 7. ECU_ADDRESS 0xd0006917 FORMAT "%1.0" /end MEASUREMENT
/begin MEASUREMENT Vxx_mux_agb_clck "clock value for the last frame acquired on the mux" UBYTE _CNV_A_R_ECME_LINEA_0_CM 1 0. 0. 15. ECU_ADDRESS 0xd0006918 FORMAT "%2.0" /end MEASUREMENT
/begin MEASUREMENT Vxx_mux_agb_csm_tq "Converter friction Torque acquired on MUX" UWORD _CNV_A_R_LINEAR_____216_CM 1 0. -400. 1647.96875 ECU_ADDRESS 0xd00040da FORMAT "%10.5" /end MEASUREMENT
/begin MEASUREMENT Vxx_mux_agb_tqe_sp "Automatic transmission fast-acting torque setting acquired on the CAN" UWORD _CNV_A_R_LINEAR_____216_CM 1 0. -400. 1647.96875 ECU_ADDRESS 0xd00040dc FORMAT "%10.5" /end MEASUREMENT
/begin MEASUREMENT Vxx_mux_agb_tqe_sp_raw "Automatic transmission fast-acting raw torque setting acquired on the CAN" UWORD _CNV_A_R_ECME_LINEA_0_CM 1 0. 0. 4095. ECU_ADDRESS 0xd00040de FORMAT "%4.0" /end MEASUREMENT
/begin MEASUREMENT Vxx_mux_agb_tqe_tgt_lim "Automatic transmission slow-acting torque setting acquired on the CAN" UWORD _CNV_A_R_LINEAR_____216_CM 1 0. -400. 1647.96875 ECU_ADDRESS 0xd00040e0 FORMAT "%10.5" /end MEASUREMENT
/begin MEASUREMENT Vxx_mux_agb_tqe_tgt_lim_raw "Automatic transmission slow-acting raw torque setting acquired on the CAN" UWORD _CNV_A_R_ECME_LINEA_0_CM 1 0. 0. 4095. ECU_ADDRESS 0xd00040e2 FORMAT "%4.0" /end MEASUREMENT
/begin MEASUREMENT Vbx_mux_bpk "Automatic or manual parking brake detected recieved on the CAN" UBYTE _CNV_S_2_RANGE______3_CM 1 0. 0. 1. ECU_ADDRESS 0xd0006919 BIT_MASK 0x1 /end MEASUREMENT
/begin MEASUREMENT Vbx_mux_bpk_navl "Indicates that the automatic or manual parking brake detected received on the CAN is unavailable" UBYTE _CNV_S_2_RANGE______3_CM 1 0. 0. 1. ECU_ADDRESS 0xd000691a BIT_MASK 0x1 /end MEASUREMENT
/begin MEASUREMENT Vsx_mux_bpk_vld "Automatic or manual parking brake detected received on the CAN validity status" UBYTE _CNV_S_3_STATUS_OK__213_CM 1 0. 0. 2. ECU_ADDRESS 0xd000691b /end MEASUREMENT
/begin MEASUREMENT DieselFilterWaterDetection "Transmitted CAN parameter" UBYTE _CNV_A_R_ECME_LINEA_0_CM 1 0. 0. 1. ECU_ADDRESS 0xd000785f FORMAT "%1.0" /end MEASUREMENT
/begin MEASUREMENT DieselPreHeating "Transmitted CAN parameter" UBYTE _CNV_A_R_ECME_LINEA_0_CM 1 0. 0. 1. ECU_ADDRESS 0xd0007860 FORMAT "%1.0" /end MEASUREMENT
/begin MEASUREMENT Vbx_mil_tcu_req "MIL activation request of transmission control unit" UBYTE _CNV_S_2_RANGE______3_CM 1 0. 0. 1. ECU_ADDRESS 0xd00067cc BIT_MASK 0x1 /end MEASUREMENT
/begin MEASUREMENT Vbx_mux_mil_tcu_req "MIL activation request of transmission control unit received on the CAN" UBYTE _CNV_S_2_RANGE______3_CM 1 0. 0. 1. ECU_ADDRESS 0xd00067cd BIT_MASK 0x1 /end MEASUREMENT
/begin MEASUREMENT Vbx_mux_neut_cnt_navl "Indicates Neutral engaged switch received on the CAN is unavailable" UBYTE _CNV_S_2_RANGE______3_CM 1 0. 0. 1. ECU_ADDRESS 0xd0006932 BIT_MASK 0x1 /end MEASUREMENT
/begin MEASUREMENT Vbx_mux_rvr_cnt_navl "indicates that Reverse gear engaged switch received on the CAN is unavailable" UBYTE _CNV_S_2_RANGE______3_CM 1 0. 0. 1. ECU_ADDRESS 0xd0006933 BIT_MASK 0x1 /end MEASUREMENT
/begin MEASUREMENT Vsx_mux_neut_cnt "Neutral engaged switch for manual gearbox received on the CAN" UBYTE _CNV_A_R_ECME_LINEA_0_CM 1 0. 0. 3. ECU_ADDRESS 0xd0006934 FORMAT "%1.0" /end MEASUREMENT
/begin MEASUREMENT Vsx_mux_neut_cnt_vld "Neutral engaged switch for manual gearbox received on the CAN validity status" UBYTE _CNV_S_3_STATUS_OK__179_CM 1 0. 0. 2. ECU_ADDRESS 0xd0006935 /end MEASUREMENT
/begin MEASUREMENT Vsx_mux_rvr_cnt "Reverse gear engaged switch for manual gearbox received on the CAN" UBYTE _CNV_A_R_ECME_LINEA_0_CM 1 0. 0. 3. ECU_ADDRESS 0xd0006936 FORMAT "%1.0" /end MEASUREMENT
/begin MEASUREMENT Vsx_mux_rvr_cnt_vld " Reverse gear engaged switch for manual gearbox received on the CAN validity status" UBYTE _CNV_S_3_STATUS_OK__179_CM 1 0. 0. 2. ECU_ADDRESS 0xd0006937 /end MEASUREMENT
/begin MEASUREMENT ASR_MSRAcknowledgement "Transmitted CAN parameter" UBYTE _CNV_A_R_ECME_LINEA_0_CM 1 0. 0. 1. ECU_ADDRESS 0xd0006946 FORMAT "%1.0" /end MEASUREMENT
/begin MEASUREMENT AT_TorqueAcknowledgement "Transmitted CAN parameter" UBYTE _CNV_A_R_ECME_LINEA_0_CM 1 0. 0. 1. ECU_ADDRESS 0xd0006947 FORMAT "%1.0" /end MEASUREMENT
/begin MEASUREMENT EngineTorque_WithoutTMReq "Transmitted CAN parameter" UWORD _CNV_A_R_ECME_LINEA_0_CM 1 0. 0. 4095. ECU_ADDRESS 0xd00040f2 FORMAT "%4.0" /end MEASUREMENT
/begin MEASUREMENT RawEngineTorque_WithoutTMReq "Transmitted CAN parameter" UWORD _CNV_A_R_ECME_LINEA_0_CM 1 0. 0. 4095. ECU_ADDRESS 0xd00040f4 FORMAT "%4.0" /end MEASUREMENT
/begin MEASUREMENT RequestedTorqueAfterProc "Transmitted CAN parameter" UWORD _CNV_A_R_ECME_LINEA_0_CM 1 0. 0. 4095. ECU_ADDRESS 0xd00040f6 FORMAT "%4.0" /end MEASUREMENT
/begin MEASUREMENT Vbx_mux_drag_red_agb "Drag reduction mode received on the CAN" UBYTE _CNV_S_2_RANGE______3_CM 1 0. 0. 1. ECU_ADDRESS 0xd000694a BIT_MASK 0x1 /end MEASUREMENT
/begin MEASUREMENT Vbx_mux_egb_neut "Electronic GearBox in a configuration equivalent to Neutral for a manual gearbox received on the CAN" UBYTE _CNV_S_2_RANGE______3_CM 1 0. 0. 1. ECU_ADDRESS 0xd000694b BIT_MASK 0x1 /end MEASUREMENT
/begin MEASUREMENT Vbx_mux_raw_egb_ant_gear_navl "Indicates taht target raw gear due to electronic gearbox received on the CAN is unavailable" UBYTE _CNV_S_2_RANGE______3_CM 1 0. 0. 1. ECU_ADDRESS 0xd000694c BIT_MASK 0x1 /end MEASUREMENT
/begin MEASUREMENT Vbx_mux_raw_egb_gear_navl "Indicates that current raw gear due to electronic gearbox received on the CAN is unavailable" UBYTE _CNV_S_2_RANGE______3_CM 1 0. 0. 1. ECU_ADDRESS 0xd000694d BIT_MASK 0x1 /end MEASUREMENT
/begin MEASUREMENT Vsx_mux_drag_red_agb_vld "Drag reduction mode received on the CAN validity status" UBYTE _CNV_S_3_STATUS_OK__179_CM 1 0. 0. 2. ECU_ADDRESS 0xd000694e /end MEASUREMENT
/begin MEASUREMENT Vsx_mux_egb_neut_vld "Electronic GearBox in a configuration equivalent to Neutral for a manual gearbox received on the CAN validity status" UBYTE _CNV_S_3_STATUS_OK__179_CM 1 0. 0. 2. ECU_ADDRESS 0xd000694f /end MEASUREMENT
/begin MEASUREMENT Vsx_mux_raw_egb_ant_gear "Target raw gear due to electronic gearbox received on the CAN" SBYTE _CNV_A_R_ECME_LINEA_0_CM 1 0. -128. 127. ECU_ADDRESS 0xd0006950 FORMAT "%3.0" /end MEASUREMENT
/begin MEASUREMENT Vsx_mux_raw_egb_ant_gear_vld "Target raw gear due to electronic gearbox  (7th and lih also possible) received on the CAN validity status" UBYTE _CNV_S_3_STATUS_OK__179_CM 1 0. 0. 2. ECU_ADDRESS 0xd0006951 /end MEASUREMENT
/begin MEASUREMENT Vsx_mux_raw_egb_gear "Current raw gear due to electronic gearbox received on the CAN" SBYTE _CNV_A_R_ECME_LINEA_0_CM 1 0. -128. 127. ECU_ADDRESS 0xd0006952 FORMAT "%3.0" /end MEASUREMENT
/begin MEASUREMENT Vsx_mux_raw_egb_gear_vld "Current raw gear due to electronic gearbox  (7 and lih also possible) received on the CAN validity status" UBYTE _CNV_S_3_STATUS_OK__179_CM 1 0. 0. 2. ECU_ADDRESS 0xd0006953 /end MEASUREMENT
/begin MEASUREMENT Vbx_mux_asr_reg "ASR in regulation received on the CAN" UBYTE _CNV_S_2_RANGE______3_CM 1 0. 0. 1. ECU_ADDRESS 0xd0006928 BIT_MASK 0x1 /end MEASUREMENT
/begin MEASUREMENT Vbx_mux_ayc_reg "AYC in regulation received on the CAN" UBYTE _CNV_S_2_RANGE______3_CM 1 0. 0. 1. ECU_ADDRESS 0xd0006929 BIT_MASK 0x1 /end MEASUREMENT
/begin MEASUREMENT Vsx_mux_asr_msr_typ "Torque control type received on the CAN" UBYTE _CNV_S_4_STATUS_TQ__219_CM 1 0. 0. 6. ECU_ADDRESS 0xd000692a /end MEASUREMENT
/begin MEASUREMENT Vsx_mux_asr_msr_typ_vld "Torque control type received on the CAN validity status" UBYTE _CNV_A_R_ECME_LINEA_0_CM 1 0. 0. 2. ECU_ADDRESS 0xd000692b FORMAT "%1.0" /end MEASUREMENT
/begin MEASUREMENT Vsx_mux_asr_reg_vld "ASR in regulation received on the CAN validity status" UBYTE _CNV_A_R_ECME_LINEA_0_CM 1 0. 0. 1. ECU_ADDRESS 0xd000692c FORMAT "%1.0" /end MEASUREMENT
/begin MEASUREMENT Vsx_mux_ayc_reg_vld "AYC in regulation received on the CAN validity status" UBYTE _CNV_A_R_ECME_LINEA_0_CM 1 0. 0. 1. ECU_ADDRESS 0xd000692d FORMAT "%1.0" /end MEASUREMENT
/begin MEASUREMENT Vxx_mux_asr_msr_clck "clock value for the last frame" UBYTE _CNV_A_R_ECME_LINEA_0_CM 1 0. 0. 255. ECU_ADDRESS 0xd000692e FORMAT "%3.0" /end MEASUREMENT
/begin MEASUREMENT Vxx_mux_asr_tqe_sp "ASR setpoint torque acquired on the MUX" UWORD _CNV_A_R_LINEAR_____216_CM 1 0. -400. 1647.96875 ECU_ADDRESS 0xd00040e4 FORMAT "%10.5" /end MEASUREMENT
/begin MEASUREMENT Vxx_mux_asr_tqe_sp_raw "ASR setpoint torque acquired on the MUX (unscaled)" UWORD _CNV_A_R_ECME_LINEA_0_CM 1 0. 0. 4095. ECU_ADDRESS 0xd00040e6 FORMAT "%4.0" /end MEASUREMENT
/begin MEASUREMENT Vxx_mux_asr_tqe_tgt "ASR target torque acquired on the MUX" UWORD _CNV_A_R_LINEAR_____216_CM 1 0. -400. 1647.96875 ECU_ADDRESS 0xd00040e8 FORMAT "%10.5" /end MEASUREMENT
/begin MEASUREMENT Vxx_mux_asr_tqe_tgt_raw "Raw unscaled ASR target torque" UWORD _CNV_A_R_ECME_LINEA_0_CM 1 0. 0. 4095. ECU_ADDRESS 0xd00040ea FORMAT "%4.0" /end MEASUREMENT
/begin MEASUREMENT Vxx_mux_msr_tqe_sp "MSR torque setting acquired on the MUX" UWORD _CNV_A_R_LINEAR_____216_CM 1 0. -400. 1647.96875 ECU_ADDRESS 0xd00040ec FORMAT "%10.5" /end MEASUREMENT
/begin MEASUREMENT Vxx_mux_msr_tqe_sp_raw "Raw unscaled MSR torque setting" UWORD _CNV_A_R_ECME_LINEA_0_CM 1 0. 0. 4095. ECU_ADDRESS 0xd00040ee FORMAT "%4.0" /end MEASUREMENT
/begin MEASUREMENT OpenActiveBrakeSwitch_ECM "Transmitted CAN parameter" UBYTE _CNV_A_R_ECME_LINEA_0_CM 1 0. 0. 3. ECU_ADDRESS 0xd0006920 FORMAT "%1.0" /end MEASUREMENT
/begin MEASUREMENT Vbx_frm_min_fuel "First CAN frame received" UBYTE _CNV_S_2_RANGE______3_CM 1 0. 0. 1. ECU_ADDRESS 0xd0007859 BIT_MASK 0x1 /end MEASUREMENT
/begin MEASUREMENT Vbx_min_fuel_navl "Minimum level of fuel level from DiagnoseFuelLow is not available" UBYTE _CNV_S_2_RANGE______3_CM 1 0. 0. 1. ECU_ADDRESS 0xd000785a BIT_MASK 0x1 /end MEASUREMENT
/begin MEASUREMENT Vbx_mux_min_fuel_raw "Raw low level of fuel received on the CAN" UBYTE _CNV_S_2_RANGE______3_CM 1 0. 0. 1. ECU_ADDRESS 0xd000785b BIT_MASK 0x1 /end MEASUREMENT
/begin MEASUREMENT Vsx_mux_fuel_lvl_vld "Petrol tank reserve received on the CAN validity status" UBYTE _CNV_S_8_STATUS_OK__234_CM 1 0. 0. 7. ECU_ADDRESS 0xd000785c /end MEASUREMENT
/begin MEASUREMENT Vsx_mux_min_fuel_raw_vld "Raw low level of fuel received on the CAN validity status" UBYTE _CNV_S_3_STATUS_OK__179_CM 1 0. 0. 2. ECU_ADDRESS 0xd000785d /end MEASUREMENT
/begin MEASUREMENT Vxx_mux_fuel_lvl "Petrol tank reserve received on the CAN" UBYTE _CNV_A_R_LINEAR_____65_CM 1 0. 0. 80. ECU_ADDRESS 0xd000785e FORMAT "%3.0" /end MEASUREMENT
/begin CHARACTERISTIC Cbx_diag_fuel_pres_cfm "DiagnoseFuelLow information is provided by CAN" VALUE 0xa00210d9 _REC_S1VAL_20_u1 1. _CNV_S_2_RANGE______3_CM 0. 1. BIT_MASK 0x1 /end CHARACTERISTIC
/begin MEASUREMENT Vbx_owe_mnl_ini_req_mux "Input from the can to initialise the strategy as \"customer init\"" UBYTE _CNV_S_2_RANGE______3_CM 1 0. 0. 1. ECU_ADDRESS 0xd0007862 BIT_MASK 0x1 /end MEASUREMENT
/begin MEASUREMENT ETC_TorqueAcknowledgement "Transmitted CAN parameter" UBYTE _CNV_A_R_ECME_LINEA_0_CM 1 0. 0. 1. ECU_ADDRESS 0xd000692f FORMAT "%3.0" /end MEASUREMENT
/begin MEASUREMENT AlternatorOptimumPower "Transmitted CAN parameter" UBYTE _CNV_A_R_ECME_LINEA_0_CM 1 0. 0. 255. ECU_ADDRESS 0xd00078f2 FORMAT "%3.0" /end MEASUREMENT
/begin MEASUREMENT MinimumVoltagebyECM "Transmitted CAN parameter" UBYTE _CNV_A_R_ECME_LINEA_0_CM 1 0. 0. 15. ECU_ADDRESS 0xd0007924 FORMAT "%2.0" /end MEASUREMENT
/begin MEASUREMENT ECM_StopAutoForbidden "Transmitted CAN parameter" UBYTE _CNV_A_R_ECME_LINEA_0_CM 1 0. 0. 3. ECU_ADDRESS 0xd0007925 FORMAT "%3.0" /end MEASUREMENT
/begin COMPU_METHOD _CNV_A_R_ECME_LINEA_0_CM "" RAT_FUNC "%6.3" "-" COEFFS 0 1. 0. 0 0 1 /end COMPU_METHOD
/begin COMPU_METHOD _CNV_A_R_LINEAR_____2_CM "" RAT_FUNC "%6.3" "rpm" COEFFS 0 3.125e-002 0. 0 0 1 /end COMPU_METHOD
/begin COMPU_METHOD _CNV_S_2_RANGE______3_CM "" TAB_VERB "%6.3" "-" COMPU_TAB_REF _CNV_S_2_RANGE______3 /end COMPU_METHOD
/begin COMPU_VTAB _CNV_S_2_RANGE______3 "" TAB_VERB 2 0 "0" 1 "1" /end COMPU_VTAB
/begin COMPU_METHOD _CNV_A_R_ENSD_LINEA_22_CM "" RAT_FUNC "%6.3" "rpm" COEFFS 0 4. 0. 0 0 1 /end COMPU_METHOD
/begin COMPU_METHOD _CNV_A_R_LINEAR_____23_CM "" RAT_FUNC "%6.3" "°CRK" COEFFS 0 2.666666666666667 0. 0 0 1 /end COMPU_METHOD
/begin COMPU_METHOD _CNV_A_R_LINEAR_____29_CM "" RAT_FUNC "%6.3" "-" COEFFS 0 256. 0. 0 0 1 /end COMPU_METHOD
/begin COMPU_METHOD _CNV_A_R_LINEAR_____32_CM "" RAT_FUNC "%6.3" "s" COEFFS 0 100. 0. 0 0 1 /end COMPU_METHOD
/begin COMPU_METHOD _CNV_A_R_LINEAR_____41_CM "" RAT_FUNC "%6.3" "°C" COEFFS 0 1.333333333333333 64. 0 0 1 /end COMPU_METHOD
/begin COMPU_METHOD _CNV_A_R_LINEAR_____42_CM "" RAT_FUNC "%6.3" "-" COEFFS 0 128. 0. 0 0 1 /end COMPU_METHOD
/begin COMPU_METHOD _CNV_A_R_LINEAR_____53_CM "" RAT_FUNC "%6.3" "-" COEFFS 0 16384. 0. 0 0 1 /end COMPU_METHOD
/begin COMPU_METHOD _CNV_A_R_LINEAR_____58_CM "" RAT_FUNC "%6.3" "s" COEFFS 0 10. 0. 0 0 1 /end COMPU_METHOD
/begin COMPU_METHOD _CNV_A_R_LINEAR_____59_CM "" RAT_FUNC "%6.3" "V" COEFFS 0 51.2 0. 0 0 1 /end COMPU_METHOD
/begin COMPU_METHOD _CNV_A_R_LINEAR_____65_CM "" RAT_FUNC "%6.3" "l" COEFFS 0 1. 0. 0 0 1 /end COMPU_METHOD
/begin COMPU_METHOD _CNV_A_R_LINEAR_____71_CM "" RAT_FUNC "%6.3" "km/h" COEFFS 0 1. 0. 0 0 1 /end COMPU_METHOD
/begin COMPU_METHOD _CNV_A_R_LINEAR_____77_CM "" RAT_FUNC "%6.3" "mg/stk" COEFFS 0 0.183585313174946 0. 0 0 1 /end COMPU_METHOD
/begin COMPU_METHOD _CNV_A_R_LINEAR_____101_CM "" RAT_FUNC "%6.3" "TDC" COEFFS 0 1. 0. 0 0 1 /end COMPU_METHOD
/begin COMPU_METHOD _CNV_A_R_A_105_CM "" RAT_FUNC "%6.3" "" COEFFS 0 1. 0. 0 0 1 /end COMPU_METHOD
/begin COMPU_METHOD _CNV_A_R_LINEAR_____107_CM "" RAT_FUNC "%6.3" "mV" COEFFS 0 1. 0. 0 0 1 /end COMPU_METHOD
/begin COMPU_METHOD _CNV_A_R_LINEAR_____110_CM "" RAT_FUNC "%6.3" "°C" COEFFS 0 10. 400. 0 0 1 /end COMPU_METHOD
/begin COMPU_METHOD _CNV_A_R_LINEAR_____116_CM "" RAT_FUNC "%6.3" "s" COEFFS 0 1000. 0. 0 0 1 /end COMPU_METHOD
/begin COMPU_METHOD _CNV_A_R_LINEAR_____123_CM "" RAT_FUNC "%6.3" "-" COEFFS 0 100. 0. 0 0 1 /end COMPU_METHOD
/begin COMPU_METHOD _CNV_A_R_LINEAR_____125_CM "" RAT_FUNC "%6.3" "km/h" COEFFS 0 100. 0. 0 0 1 /end COMPU_METHOD
/begin COMPU_METHOD _CNV_A_R_LINEAR_____145_CM "" RAT_FUNC "%6.3" "-" COEFFS 0 1. 1. 0 0 1 /end COMPU_METHOD
/begin COMPU_METHOD _CNV_A_R_LINEAR_____150_CM "" RAT_FUNC "%6.3" "%" COEFFS 0 20. 0. 0 0 1 /end COMPU_METHOD
/begin COMPU_METHOD _CNV_A_R_LINEAR_____165_CM "" RAT_FUNC "%6.3" "%" COEFFS 0 2.55 0. 0 0 1 /end COMPU_METHOD
/begin COMPU_METHOD _CNV_S_3_STATUS_OK__179_CM "" TAB_VERB "%6.3" "-" COMPU_TAB_REF _CNV_S_3_STATUS_OK__179 /end COMPU_METHOD
/begin COMPU_VTAB _CNV_S_3_STATUS_OK__179 "" TAB_VERB 3 0 "Nsx_vld_nok_0" 1 "Nsx_vld_ok_1" 2 "Nsx_vld_fail_2" /end COMPU_VTAB
/begin COMPU_METHOD _CNV_S_4_STATUS_OK__180_CM "" TAB_VERB "%6.3" "-" COMPU_TAB_REF _CNV_S_4_STATUS_OK__180 /end COMPU_METHOD
/begin COMPU_VTAB _CNV_S_4_STATUS_OK__180 "" TAB_VERB 4 0 "Nsx_vld_nok_0" 1 "Nsx_vld_ok_1" 2 "Nsx_vld_fail_2" 3 "Nsx_vld_fail_3" /end COMPU_VTAB
/begin COMPU_METHOD _CNV_S_3_STATUS_OK__213_CM "" TAB_VERB "%6.3" "" COMPU_TAB_REF _CNV_S_3_STATUS_OK__213 /end COMPU_METHOD
/begin COMPU_VTAB _CNV_S_3_STATUS_OK__213 "" TAB_VERB 3 0 "Nsx_vld_nok_0" 1 "Nsx_vld_ok_1" 2 "Nsx_vld_fail_2" /end COMPU_VTAB
/begin COMPU_METHOD _CNV_A_R_LINEAR_____216_CM "" RAT_FUNC "%6.3" "Nm" COEFFS 0 32. 12800. 0 0 1 /end COMPU_METHOD
/begin COMPU_METHOD _CNV_S_4_STATUS_TQ__219_CM "" TAB_VERB "%6.3" "-" COMPU_TAB_REF _CNV_S_4_STATUS_TQ__219 /end COMPU_METHOD
/begin COMPU_VTAB _CNV_S_4_STATUS_TQ__219 "" TAB_VERB 4 0 "Nsx_no_tq_req" 1 "Nsx_asr_msr_tq_req_nok" 5 "Nsx_asr_tq_req" 6 "Nsx_msr_tq_req" /end COMPU_VTAB
/begin COMPU_METHOD _CNV_S_8_STATUS_OK__234_CM "" TAB_VERB "%6.3" "-" COMPU_TAB_REF _CNV_S_8_STATUS_OK__234 /end COMPU_METHOD
/begin COMPU_VTAB _CNV_S_8_STATUS_OK__234 "" TAB_VERB 8 0 "Nsx_vld_nok_0" 1 "Nsx_vld_ok_1" 2 "Nsx_vld_fail_2" 3 "Nsx_vld_fail_3" 4 "Nsx_vld_fail_4" 5 "Nsx_vld_fail_5" 6 "Nsx_vld_fail_6" 7 "Nsx_vld_fail_7" /end COMPU_VTAB
/begin COMPU_METHOD _CNV_A_R_LINEAR_____267_CM "" RAT_FUNC "%6.3" "%" COEFFS 0 800. 0. 0 0 1 /end COMPU_METHOD
/begin COMPU_METHOD _CNV_A_R_LINEAR_____274_CM "" RAT_FUNC "%6.3" "km" COEFFS 0 1. 0. 0 0 1 /end COMPU_METHOD
/begin COMPU_METHOD _CNV_A_R_LINEAR_____275_CM "" RAT_FUNC "%6.3" "ratio" COEFFS 0 255. 0. 0 0 1 /end COMPU_METHOD
/begin COMPU_METHOD _CNV_S_3_STATUS_ANT_449_CM "" TAB_VERB "%6.3" "-" COMPU_TAB_REF _CNV_S_3_STATUS_ANT_449 /end COMPU_METHOD
/begin COMPU_VTAB _CNV_S_3_STATUS_ANT_449 "" TAB_VERB 3 1 "Nsx_ant_neut" 2 "Nsx_ant_drag_red_agb" 3 "Nsx_ant_driv" /end COMPU_VTAB
/begin COMPU_METHOD _CNV_S_3_CNT_INDICA_450_CM "" TAB_VERB "%6.3" "" COMPU_TAB_REF _CNV_S_3_CNT_INDICA_450 /end COMPU_METHOD
/begin COMPU_VTAB _CNV_S_3_CNT_INDICA_450 "" TAB_VERB 3 0 "Nsx_cnt_off" 1 "Nsx_cnt_on" 2 "Nsx_no_cnt" /end COMPU_VTAB
/begin COMPU_METHOD _CNV_S_3_RANGE_STAT_451_CM "" TAB_VERB "%6.3" "" COMPU_TAB_REF _CNV_S_3_RANGE_STAT_451 /end COMPU_METHOD
/begin COMPU_VTAB _CNV_S_3_RANGE_STAT_451 "" TAB_VERB 3 1 "Nsx_coup_clos" 2 "Nsx_coup_sli" 8 "Nsx_coup_open" /end COMPU_VTAB
/begin COMPU_METHOD _CNV_A_R_KNCK_LINEA_452_CM "" RAT_FUNC "%6.3" "" COEFFS 0 32. 0. 0 0 1 /end COMPU_METHOD
/begin COMPU_METHOD _CNV_A_R_KNCK_LINEA_453_CM "Battery voltage" RAT_FUNC "%6.3" "V" COEFFS 0 50. 128. 0 0 1 /end COMPU_METHOD
/begin COMPU_METHOD _CNV_A_R_KNCK_LINEA_454_CM "" RAT_FUNC "%6.3" "V" COEFFS 0 13107.19998965744 0. 0 0 1 /end COMPU_METHOD
/begin COMPU_METHOD _CNV_A_R_KNCK_LINEA_455_CM "" RAT_FUNC "%6.3" "V" COEFFS 0 13107.19998965744 -2.58563959505409e-005 0 0 1 /end COMPU_METHOD
/begin COMPU_METHOD _CNV_A_R_LINEAR_____456_CM "" RAT_FUNC "%6.3" "mg/stk" COEFFS 0 47.18142548596112 -1.455191522836685e-011 0 0 1 /end COMPU_METHOD
/begin COMPU_METHOD _CNV_A_R_LINEAR_____457_CM "" RAT_FUNC "%6.3" "trs" COEFFS 0 1. 0. 0 0 1 /end COMPU_METHOD
/begin COMPU_METHOD _CNV_S_3_STATUS_CAN_458_CM "" TAB_VERB "%6.3" "" COMPU_TAB_REF _CNV_S_3_STATUS_CAN_458 /end COMPU_METHOD
/begin COMPU_VTAB _CNV_S_3_STATUS_CAN_458 "" TAB_VERB 3 0 "Nsx_pres" 1 "Nsx_abst" 2 "Nsx_vld_abst" /end COMPU_VTAB
/begin RECORD_LAYOUT _REC_S1VAL_20_u4 FNC_VALUES 1 ULONG COLUMN_DIR DIRECT /end RECORD_LAYOUT
/begin RECORD_LAYOUT _REC_S1VAL_20_u1 FNC_VALUES 1 UBYTE COLUMN_DIR DIRECT /end RECORD_LAYOUT
/begin RECORD_LAYOUT _REC_A2AXS_20_u1 NO_AXIS_PTS_X 1 UBYTE AXIS_PTS_X 2 UBYTE INDEX_INCR DIRECT /end RECORD_LAYOUT
/begin RECORD_LAYOUT _REC_S1VAL_20_u2 FNC_VALUES 1 UWORD COLUMN_DIR DIRECT /end RECORD_LAYOUT
/begin RECORD_LAYOUT _REC_S1VAL_20_s2 FNC_VALUES 1 SWORD COLUMN_DIR DIRECT /end RECORD_LAYOUT
/begin RECORD_LAYOUT _REC_A1CUR_20_u1_u1 FNC_VALUES 1 UBYTE COLUMN_DIR DIRECT /end RECORD_LAYOUT
/begin RECORD_LAYOUT _REC_A1CUR_20_u2_u1 FNC_VALUES 1 UWORD COLUMN_DIR DIRECT /end RECORD_LAYOUT
/begin RECORD_LAYOUT _REC_A1MAP_20_u1_u1_u1 FNC_VALUES 1 UBYTE COLUMN_DIR DIRECT /end RECORD_LAYOUT
/begin RECORD_LAYOUT _REC_S1VAL_20_s1 FNC_VALUES 1 SBYTE COLUMN_DIR DIRECT /end RECORD_LAYOUT
/begin RECORD_LAYOUT _REC_A1CUR_20_s2_u1 FNC_VALUES 1 SWORD COLUMN_DIR DIRECT /end RECORD_LAYOUT
/begin FUNCTION InPciDls_Seclcxx_xxxxxx ""
 /begin DEF_CHARACTERISTIC Cxx_dfdec_clu_cnt_nok Cxx_dfinc_clu_cnt_nok Cxx_dly_chr_bgin_end_clu_cnt /end DEF_CHARACTERISTIC
 /begin OUT_MEASUREMENT Vbx_bgin_clu_cnt_ena Vbx_bgin_clu_cnt_on Vbx_end_clu_cnt_on /end OUT_MEASUREMENT
/end FUNCTION
/begin FUNCTION InPciDls_Tmdlsxx_xxxxxx ""
 /begin DEF_CHARACTERISTIC Cbx_ant_coup_clos_clc_cfm Cbx_bgin_clu_fail_cfm Cbx_ovn_n_clu_det_cfm Cxx_dly_clu_pdl_use_rtn Cxx_dly_neut_gear_act Cxx_dly_neut_gear_cnt Cxx_dly_pdl_rls Cxx_ovn_n_clu_det_dly Cxx_ovn_n_clu_det_thd Cxx_ovn_n_dif_clu_det_thd Cxx_rat_gear_stab_dly Cxx_vs_vh_max Cxx_vs_vh_min /end DEF_CHARACTERISTIC
 /begin OUT_MEASUREMENT Vbx_bgin_clu_pdl_on Vbx_gear_stab Vbx_neut_gear_act Vbx_neut_psn Vbx_ovn_ant_coup Vbx_pdl_use_rtn Vsx_bgin_clu_nok_mgb_ant_coup Vsx_bgin_clu_nok_mgb_coup Vsx_bgin_clu_nok_mgb_coup_vld Vsx_bgin_clu_ok_mgb_ant_coup Vsx_bgin_clu_ok_mgb_coup Vsx_bgin_clu_ok_mgb_coup_vld Vsx_mgb_ant_coup Vsx_mgb_ant_gear Vsx_mgb_coup Vsx_mgb_coup_vld Vsx_mgb_gear Vsx_mgb_gear_vld Vsx_rat_gear_stab /end OUT_MEASUREMENT
/end FUNCTION
/begin FUNCTION InPciDls_Attcscs_xxxxxx ""
 /begin OUT_MEASUREMENT Vsx_agb_coup Vsx_agb_coup_vld Vsx_rgb_coup Vsx_rgb_coup_vld /end OUT_MEASUREMENT
/end FUNCTION
/begin FUNCTION InPciDls_Attrecs_xxxxxx ""
 /begin OUT_MEASUREMENT Vbx_drag_red_agb Vbx_egb_neut Vsx_agb_vld Vsx_drag_red_agb_vld Vsx_egb_neut_vld Vsx_raw_egb_ant_gear Vsx_raw_egb_ant_gear_vld Vsx_raw_egb_gear Vsx_raw_egb_gear_vld /end OUT_MEASUREMENT
/end FUNCTION
/begin FUNCTION InPciDls_Tadlsxx_xxxxxx "" /begin DEF_CHARACTERISTIC Csx_lih_egb_gear Cxx_dly_coup_fail Cxx_dly_gear_fail /end DEF_CHARACTERISTIC
 /begin OUT_MEASUREMENT Vsx_egb_ant_coup Vsx_egb_ant_coup_vld Vsx_egb_ant_gear Vsx_egb_ant_gear_vld Vsx_egb_coup Vsx_egb_coup_vld Vsx_egb_gear Vsx_egb_gear_vld /end OUT_MEASUREMENT
/end FUNCTION
/begin FUNCTION InPciDls_Clb2xcs_xxxxxx "" /begin DEF_CHARACTERISTIC Cbx_mux_clu_cnt_cfm /end DEF_CHARACTERISTIC
 /begin OUT_MEASUREMENT Vsx_bgin_str_clu_cnt Vsx_bgin_str_clu_cru Vsx_bgin_str_clu_cru_rams Vsx_bgin_str_clu_cru_vld /end OUT_MEASUREMENT
/end FUNCTION
/begin FUNCTION InPciDls_Clbmucs_xxxxxx "" /begin OUT_MEASUREMENT Vsx_mux_bgin_clu_cnt Vsx_mux_bgin_clu_cnt_vld /end OUT_MEASUREMENT /end FUNCTION
/begin FUNCTION InPciDls_Clbsrcs_xxxxxx "" /begin OUT_MEASUREMENT Vsx_sens_bgin_clu_cnt Vsx_sens_bgin_clu_cnt_vld /end OUT_MEASUREMENT /end FUNCTION
/begin FUNCTION InPciDls_Clbxxsr_xxxxxx "" /begin DEF_CHARACTERISTIC Cxx_sens_clu_lk_vb_dly Cxx_sens_clu_lk_vb_thd /end DEF_CHARACTERISTIC /end FUNCTION
/begin FUNCTION InPciDls_Clbdgxx_xxxxxx ""
 /begin DEF_CHARACTERISTIC Cbx_bgin_clu_off_dg_cfm Cbx_bgin_clu_on_dg_cfm Cxx_ant_gear_dif_thd Cxx_ant_gear_fil Cxx_bgin_clu_dg_act_vs_min Cxx_bgin_clu_off_no_chr_ctr Cxx_bgin_clu_on_no_chr_ctr Cxx_dfdec_bgin_clu_nok Cxx_dfinc_bgin_clu_nok /end DEF_CHARACTERISTIC
 /begin OUT_MEASUREMENT Vbx_ant_gear_shf Vbx_bgin_clu_off_nok Vbx_bgin_clu_on_nok Vbx_df_bgin_clu_nok Vbx_raw_bgin_clu_off_no_chr Vxx_ant_gear_2 Vxx_ant_gear_mem /end OUT_MEASUREMENT
/end FUNCTION
/begin FUNCTION SmLimPsp "" /begin SUB_FUNCTION SmLimPsp_Fsnprjx /end SUB_FUNCTION /end FUNCTION
/begin FUNCTION SmLimPsp_Fsnprjx "" /begin OUT_MEASUREMENT Vbx_n_rams_lim_spc_act_1 Vbx_n_rams_lim_spc_act_2 /end OUT_MEASUREMENT /end FUNCTION
/begin FUNCTION BiVfiSlk "" /begin OUT_MEASUREMENT Emul /end OUT_MEASUREMENT /end FUNCTION
/begin FUNCTION BiCbiKnk ""
 /begin OUT_MEASUREMENT Vbx_df_knk_oor Vbx_df_knk_shp Vbx_diag_ena_knk_oor Vbx_diag_ena_knk_shp Vbx_knk_win_diag Vtd_fil_acq_knk_cyl[0] Vtd_fil_acq_knk_cyl[1] Vtd_fil_acq_knk_cyl[2] Vtd_fil_acq_knk_cyl[3] Vxx_knk_tdc_ctr /end OUT_MEASUREMENT
/end FUNCTION
/begin FUNCTION C_2_KNCK "" /begin SUB_FUNCTION KNCK_Acq_of_knk_noise /end SUB_FUNCTION /end FUNCTION
/begin FUNCTION KNCK_Acq_of_knk_noise ""
 /begin OUT_MEASUREMENT knk_loop_nr knks[0] knks[1] knks[2] knks[3] lv_knk_acq_err state_knk_sw_acq_err /end OUT_MEASUREMENT
/end FUNCTION
/begin FUNCTION C_6_KNCK ""
 /begin SUB_FUNCTION KNCK_Control_Adapt_AI KNCK_Activation_cond KNCK_Detection KNCK_Control /end SUB_FUNCTION
/end FUNCTION
/begin FUNCTION KNCK_Control_Adapt_AI ""
 /begin DEF_CHARACTERISTIC c_fac_ad_knk_app c_nl_fil_gain_app c_state_test_knk_app lc_knk_ad_clr /end DEF_CHARACTERISTIC
 /begin OUT_MEASUREMENT fac_ad_knk_app lv_fac_ad_knk_app lv_iga_tra_knk_app lv_inh_fac_ad_knk lv_inh_knk_ad_1 lv_inh_knk_ctl lv_inh_knk_lih lv_inh_nl_ad_knk lv_maf_tra_knk_act lv_n_tra_knk_act lv_nl_fil_gain_app nl_fil_gain_app /end OUT_MEASUREMENT
/end FUNCTION
/begin FUNCTION KNCK_Activation_cond "Activation condition"
 /begin DEF_CHARACTERISTIC ldpm_n_32_2_knck ldpm_n_32_5_knck ldpm_tco_1_knck ldpm_n_32_3_knck id_cycnr_fac_tra_knk id_maf_dif_tra_knk id_maf_hb_min_knk_ad id_maf_min_ad_1_knk id_n_grd_max_knk ip_maf_hb_min_knk c_ctr_ad_1_knk c_ctr_nl_ad_knk c_maf_min_knk_ad c_n_max_knk_ad c_n_min_knk_ad c_tco_ad_knk_min c_tco_knk_ad /end DEF_CHARACTERISTIC
 /begin REF_CHARACTERISTIC ldpm_n_32_1_knck /end REF_CHARACTERISTIC
 /begin OUT_MEASUREMENT lv_fac_ad_knk_ena lv_knk_ad_1_ena lv_knk_ad_ena lv_knk_ctl_act_ena lv_knk_det_ena lv_knk_lih lv_knk_lih_ena lv_maf_tra_knk lv_n_tra_knk /end OUT_MEASUREMENT
/end FUNCTION
/begin FUNCTION KNCK_Detection ""
 /begin DEF_CHARACTERISTIC ldp_n_32_ip_nl_gain_ad id_fac_thd_knk[0] id_fac_thd_knk[1] id_fac_thd_knk[2] id_fac_thd_knk[3] id_knks_fil_frq[0] id_knks_fil_frq[1] id_knks_fil_frq[2] id_knks_fil_frq[3] id_knks_thd_add ip_itc_knk[0] ip_knks_gain[0] ip_knks_gain[1] ip_knks_gain[2] ip_knks_gain[3] ip_knkwb[0] ip_knkwb[1] ip_knkwb[2] ip_knkwb[3] ip_knkwd[0] ip_knkwd[1] ip_knkwd[2] ip_knkwd[3] ip_nl_gain_ad c_cycnr_knk_det c_egy_thd_knk c_fac_tra_knk c_knks_cmd_gain_ad_max c_knks_cmd_gain_ad_min c_knks_cyl_conf c_nl_ad_ctr c_nl_ad_thd c_nl_fil_gain c_nl_fil_gain_inc c_nl_fil_gain_tra c_nl_inc c_nl_lih c_nl_ofs ldpm_maf_hb_1_knck ldpm_maf_hb_2_knck /end DEF_CHARACTERISTIC
 /begin REF_CHARACTERISTIC ldpm_n_32_1_knck ldpm_n_32_2_knck /end REF_CHARACTERISTIC
 /begin OUT_MEASUREMENT egy_knk knks_cmd_conf[0] knks_cmd_conf[1] knks_cmd_conf[2] knks_cmd_conf[3] knks_cmd_fil[0] knks_cmd_fil[1] knks_cmd_fil[2] knks_cmd_fil[3] knks_cmd_gain[0] knks_cmd_gain[1] knks_cmd_gain[2] knks_cmd_gain[3] knks_cmd_gain_ad[0] knks_cmd_gain_ad[1] knks_cmd_gain_ad[2] knks_cmd_gain_ad[3] knks_cmd_int[0] knks_cmd_int[1] knks_cmd_int[2] knks_cmd_int[3] knks_thd[0] knks_thd[1] knks_thd[2] knks_thd[3] knkwb[0] knkwb[1] knkwb[2] knkwb[3] knkwd[0] knkwd[1] knkwd[2] knkwd[3] lv_knk nl[0] nl[1] nl[2] nl[3] nl_dif /end OUT_MEASUREMENT
/end FUNCTION
/begin FUNCTION KNCK_Control "" /begin REF_CHARACTERISTIC ldpm_n_32_3_knck /end REF_CHARACTERISTIC /end FUNCTION
/begin FUNCTION C_A_KNCK "" /begin SUB_FUNCTION KNCK_Sensor_diag_AI KNCK_Acq_chain_diag /end SUB_FUNCTION /end FUNCTION
/begin FUNCTION KNCK_Sensor_diag_AI ""
 /begin OUT_MEASUREMENT lv_inh_diag_acq_knk lv_inh_diag_bas_knk lv_inh_diag_rel_knk /end OUT_MEASUREMENT
/end FUNCTION
/begin FUNCTION KNCK_Acq_chain_diag ""
 /begin DEF_CHARACTERISTIC ldpm_n_32_1_knck ip_knks_err_rel[0] c_ctr_dec_err_sym_rel_knk c_ctr_err_sym_rel_knk c_knks_bas_diag c_knks_diag_cyl_idc[0] c_knks_rel_err_fil c_maf_min_diag_knk c_n_32_min_diag_knk c_tco_diag_knk /end DEF_CHARACTERISTIC
 /begin OUT_MEASUREMENT ctr_err_sym_rel_knk[0] knks_err_rel[0] knks_mmv_diag[0] lv_err_acq_knk lv_err_bas_knk_0 lv_err_knk lv_err_rel_knk_0 lv_err_sym_knk lv_thd_err_rel_knk[0] nr_knk_sens /end OUT_MEASUREMENT
/end FUNCTION
/begin FUNCTION DgDgtDat ""
 /begin SUB_FUNCTION DgDgtDat_Msgdiag_xxxxxx DgDgtDat_Cchkclc_xxxxxx DgDgtDat_Loadval_xxxxxx /end SUB_FUNCTION
/end FUNCTION
/begin FUNCTION DgDgtDat_Msgdiag_xxxxxx ""
 /begin DEF_CHARACTERISTIC Cbx_msk_iupr_cfm Cbx_s06_fsys_cpt_old Cxx_c_id1 Cxx_c_id10 Cxx_c_id11 Cxx_c_id12 Cxx_c_id13 Cxx_c_id14 Cxx_c_id15 Cxx_c_id16 Cxx_c_id2 Cxx_c_id3 Cxx_c_id4 Cxx_c_id5 Cxx_c_id6 Cxx_c_id7 Cxx_c_id8 Cxx_c_id9 Cxx_did_205F_writ_max Cxx_did_205F_writ_min Cxx_did_2105_writ_max Cxx_did_2105_writ_min Cxx_did_210E_writ_max Cxx_did_210E_writ_min Cxx_did_2113_writ_max Cxx_did_2113_writ_min Cxx_did_2141_writ_max Cxx_did_2141_writ_min Cxx_did_2143_writ_max Cxx_did_2143_writ_min Cxx_did_2147_writ_max Cxx_did_2147_writ_min Cxx_did_2156_writ_max Cxx_did_2156_writ_min Cxx_did_219B_writ_max Cxx_did_219B_writ_min Cxx_did_2457_writ_max Cxx_did_2457_writ_min Cxx_did_2458_writ_max Cxx_did_2458_writ_min Cxx_did_2459_writ_max Cxx_did_2459_writ_min Cxx_did_245A_writ_max Cxx_did_245A_writ_min Cxx_did_245B_writ_max Cxx_did_245B_writ_min Cxx_did_245C_writ_max Cxx_did_245C_writ_min Cxx_did_24C9_writ_max Cxx_did_24C9_writ_min Cxx_did_287F_writ_max Cxx_did_287F_writ_min Cxx_obd_cert_nr1 Cxx_obd_cert_nr10 Cxx_obd_cert_nr2 Cxx_obd_cert_nr3 Cxx_obd_cert_nr4 Cxx_obd_cert_nr5 Cxx_obd_cert_nr6 Cxx_obd_cert_nr7 Cxx_obd_cert_nr8 Cxx_obd_cert_nr9 Cxx_obd_conf_diag_prmt Cxx_obd_conf_diag_schd Cxx_obd_conf_lamb Cxx_obd_conf_obd /end DEF_CHARACTERISTIC
 /begin OUT_MEASUREMENT Vbx_diag_ena_comb_bas_req Vbx_htg_dsb Vbx_msk_iupr_cfm Vbx_owe_tool_ini_req Vsx_owe_tool_zon_req Vxx_diag_comb_bas /end OUT_MEASUREMENT
/end FUNCTION
/begin FUNCTION DgDgtDat_Cchkclc_xxxxxx "" /begin OUT_MEASUREMENT Vxx_chks_c_sw_1 Vxx_chks_c_sw_2 /end OUT_MEASUREMENT /end FUNCTION
/begin FUNCTION DgDgtDat_Loadval_xxxxxx "" /begin OUT_MEASUREMENT Vxx_obd_eal /end OUT_MEASUREMENT /end FUNCTION
/begin FUNCTION CmMuxSer ""
 /begin OUT_MEASUREMENT Vxx_bus_off_stt_ctr_mem Vxx_mute_stt_ctr_mem Vxx_abs_ecu_stt_ctr_mem Vxx_agb_ecu_stt_ctr_mem Vxx_ccu_ecu_stt_ctr_mem Vxx_ddcm_ecu_stt_ctr_mem Vxx_ip_ecu_stt_ctr_mem Vxx_etc_ecu_stt_ctr_mem Vxx_usm_ecu_stt_ctr_mem Vxx_ac_ecu_stt_ctr_mem Vxx_acc_ecu_stt_ctr_mem Vxx_swa_ecu_stt_ctr_mem Vbx_abs_lk_stt Vbx_agb_lk_stt Vbx_ccu_lk_stt Vbx_ip_lk_stt Vbx_usm_lk_stt Vbx_acc_lk_stt Vbx_ac_lk_stt Vbx_sdl_lk_stt Vbx_swa_lk_stt Vbx_ddcm_lk_stt Vbx_etc_lk_stt /end OUT_MEASUREMENT
 /begin SUB_FUNCTION CmMuxSer_Vfmbvou CmMuxSer_Tqaopou CmMuxSer_Vfssfou CmMuxSer_Pcetcou CmMuxSer_Cbadaou CmMuxSer_Cbfulin CmMuxSer_Cbxxxou CmMuxSer_Clatoou CmMuxSer_Clkmxou CmMuxSer_Clrstin CmMuxSer_Clspoou CmMuxSer_Cltoxou CmMuxSer_Dgdtvin CmMuxSer_Dglpgin CmMuxSer_Dgmilou CmMuxSer_Dgmltin CmMuxSer_Dgwl1ou CmMuxSer_Dgwl2ou CmMuxSer_Ecmreqx CmMuxSer_Mngtxxx CmMuxSer_Pcabsin CmMuxSer_Pcaplou CmMuxSer_Pcatqin CmMuxSer_Pcbpkin CmMuxSer_Pcbrkin CmMuxSer_Pcbrkou CmMuxSer_Pcclbin CmMuxSer_Pcclein CmMuxSer_Pcespin CmMuxSer_Pcfshou CmMuxSer_Pcrvnin CmMuxSer_Pcspcin CmMuxSer_Pctcsin CmMuxSer_Pctqeou CmMuxSer_Pctrein CmMuxSer_Pftfdis CmMuxSer_Pftstat CmMuxSer_Rxfrmxx CmMuxSer_Rxp50in CmMuxSer_Schxxxx CmMuxSer_Smat1in CmMuxSer_Smat2in CmMuxSer_Smengou CmMuxSer_Smlimin CmMuxSer_Smovnou CmMuxSer_Smptcin CmMuxSer_Smspdou CmMuxSer_Smsptou CmMuxSer_Tqampou CmMuxSer_Tqapgou CmMuxSer_Tqecfou CmMuxSer_Tqestou CmMuxSer_Tqlosou CmMuxSer_Tqmaxou CmMuxSer_Tqminou CmMuxSer_Tqmpaou CmMuxSer_Tqpalin CmMuxSer_Tqreqou CmMuxSer_Tqprgin CmMuxSer_Txfrmxx CmMuxSer_Txp50ou CmMuxSer_Smwixin CmMuxSer_Tqacxin CmMuxSer_Tqacxou CmMuxSer_Vfacxin CmMuxSer_Vfacxou CmMuxSer_Vfadfin CmMuxSer_Vffltou CmMuxSer_Vfptcin CmMuxSer_Vfrwsin CmMuxSer_Vftacin CmMuxSer_Pctbnin CmMuxSer_Smgshou CmMuxSer_Rsdspou CmMuxSer_Pcrspin CmMuxSer_Smrsgin CmMuxSer_Pcrssin CmMuxSer_Vfvhsin CmMuxSer_Vfssxin CmMuxSer_Pcsliou CmMuxSer_Cbfatou /end SUB_FUNCTION
/end FUNCTION
/begin FUNCTION CmMuxSer_Vfmbvou "" /begin OUT_MEASUREMENT MinimumVoltagebyECM /end OUT_MEASUREMENT /end FUNCTION
/begin FUNCTION CmMuxSer_Tqaopou "" /begin OUT_MEASUREMENT AlternatorOptimumPower /end OUT_MEASUREMENT /end FUNCTION
/begin FUNCTION CmMuxSer_Vfssfou "" /begin OUT_MEASUREMENT ECM_StopAutoForbidden /end OUT_MEASUREMENT /end FUNCTION
/begin FUNCTION CmMuxSer_Pcetcou "" /begin OUT_MEASUREMENT ETC_TorqueAcknowledgement /end OUT_MEASUREMENT /end FUNCTION
/begin FUNCTION CmMuxSer_Cbadaou "" /begin OUT_MEASUREMENT FuelConsumption NominalFuelConsumption /end OUT_MEASUREMENT /end FUNCTION
/begin FUNCTION CmMuxSer_Cbfulin "" /begin DEF_CHARACTERISTIC Cbx_diag_fuel_pres_cfm /end DEF_CHARACTERISTIC
 /begin OUT_MEASUREMENT Vbx_frm_min_fuel Vbx_min_fuel_navl Vbx_mux_min_fuel_raw Vsx_mux_fuel_lvl_vld Vsx_mux_min_fuel_raw_vld Vxx_mux_fuel_lvl /end OUT_MEASUREMENT
/end FUNCTION
/begin FUNCTION CmMuxSer_Cbxxxou "" /begin OUT_MEASUREMENT DieselFilterWaterDetection DieselPreHeating /end OUT_MEASUREMENT /end FUNCTION
/begin FUNCTION CmMuxSer_Clatoou "" /begin OUT_MEASUREMENT WarningWaterTemp /end OUT_MEASUREMENT /end FUNCTION
/begin FUNCTION CmMuxSer_Clkmxou "" /begin OUT_MEASUREMENT ComputedOilDrainingRange /end OUT_MEASUREMENT /end FUNCTION
/begin FUNCTION CmMuxSer_Clrstin "" /begin OUT_MEASUREMENT Vbx_owe_mnl_ini_req_mux /end OUT_MEASUREMENT /end FUNCTION
/begin FUNCTION CmMuxSer_Clspoou "" /begin OUT_MEASUREMENT DownTransitionOfEngCoolantTemp EngineCoolantRegulationTemp /end OUT_MEASUREMENT /end FUNCTION
/begin FUNCTION CmMuxSer_Cltoxou "" /begin OUT_MEASUREMENT EngineCoolantTemp /end OUT_MEASUREMENT /end FUNCTION
/begin FUNCTION CmMuxSer_Dgdtvin "" /begin OUT_MEASUREMENT Vbx_mux_vh_dist_navl Vsx_mux_vh_dist_vld Vxx_mux_vh_dist /end OUT_MEASUREMENT /end FUNCTION
/begin FUNCTION CmMuxSer_Dglpgin "" /begin OUT_MEASUREMENT Vbx_mil_gcu_req /end OUT_MEASUREMENT /end FUNCTION
/begin FUNCTION CmMuxSer_Dgmilou "" /begin OUT_MEASUREMENT MILLamp /end OUT_MEASUREMENT /end FUNCTION
/begin FUNCTION CmMuxSer_Dgmltin "" /begin OUT_MEASUREMENT Vbx_mil_tcu_req Vbx_mux_mil_tcu_req /end OUT_MEASUREMENT /end FUNCTION
/begin FUNCTION CmMuxSer_Dgwl1ou "" /begin OUT_MEASUREMENT EngineControlFailureLevel1 /end OUT_MEASUREMENT /end FUNCTION
/begin FUNCTION CmMuxSer_Dgwl2ou "" /begin OUT_MEASUREMENT EngineControlFailureLevel2 /end OUT_MEASUREMENT /end FUNCTION
/begin FUNCTION CmMuxSer_Ecmreqx "" /begin OUT_MEASUREMENT ECM_MechanicalLoadRequest /end OUT_MEASUREMENT /end FUNCTION
/begin FUNCTION CmMuxSer_Mngtxxx ""
 /begin DEF_CHARACTERISTIC Cxx_ACC_CANHS_R_01_id Cxx_AIRBAGCrash_id Cxx_BCM_CANHS_RNr_01_id Cxx_BCM_CANHS_RNr_02_id Cxx_BCM_VERLOG_id Cxx_BRAKE_CANHS_RNr_01_id Cxx_BRAKE_CANHS_RNr_02_id Cxx_BRAKE_CANHS_RNr_03_id Cxx_BRAKE_CANHS_RNr_04_id Cxx_BRAKE_CANHS_R_01_id Cxx_CLIM_CANHS_R_01_id Cxx_CLUSTER_CANHS_RNr_01_id Cxx_CLUSTER_CANHS_R_01_id Cxx_DDCM_CANLSFT_R_01_id Cxx_ECM_CANHS_RNr_01_id Cxx_ECM_CANHS_RNr_02_id Cxx_ECM_CANHS_R_03_id Cxx_ECM_VERLOG_id Cxx_ETC_CANHS_R_01_id Cxx_FORCE_ECM_CANHS_R_01_id Cxx_MMI_BRAKE_CANHS_RNr_01_id Cxx_MMI_ECM_CANHS_RNr_01_id Cxx_MMI_ECM_CANHS_Rst_01_id Cxx_RSD_CANHS_Rst_01_id Cxx_SSCU_CANHS_R_02_id Cxx_SWA_CANHS_RNr_01_id Cxx_TORQUE_AT_CANHS_RNr_01_id Cxx_TORQUE_AT_CANHS_RNr_02_id Cxx_TORQUE_ECM_CANHS_RNr_01_id Cxx_TORQUE_ECM_CANHS_RNr_02_id Cxx_TORQUE_ECM_CANHS_R_01_id Cxx_USM_CANHS_RNr_01_id Cxx_USM_CANHS_RNr_02_id Cxx_abs_abst_frm_dly Cxx_abs_ecu_conf Cxx_abs_vld_abst_frm_dec Cxx_abs_vld_abst_frm_inc Cxx_ac_abst_frm_dly Cxx_ac_ecu_conf Cxx_ac_vld_abst_frm_dec Cxx_ac_vld_abst_frm_inc Cxx_acc_abst_frm_dly Cxx_acc_ecu_conf Cxx_acc_vld_abst_frm_dec Cxx_acc_vld_abst_frm_inc Cxx_agb_abst_frm_dly Cxx_agb_ecu_conf Cxx_agb_vld_abst_frm_dec Cxx_agb_vld_abst_frm_inc Cxx_ccu_abst_frm_dly Cxx_ccu_ecu_conf Cxx_ccu_vld_abst_frm_dec Cxx_ccu_vld_abst_frm_inc Cxx_ddcm_abst_frm_dly Cxx_ddcm_ecu_conf Cxx_ddcm_vld_abst_frm_dec Cxx_ddcm_vld_abst_frm_inc Cxx_ecu_stt_ctr_dec Cxx_ecu_stt_ctr_max Cxx_ecu_stt_ctr_thd Cxx_etc_abst_frm_dly Cxx_etc_ecu_conf Cxx_etc_vld_abst_frm_dec Cxx_etc_vld_abst_frm_inc Cxx_ip_abst_frm_dly Cxx_ip_ecu_conf Cxx_ip_vld_abst_frm_dec Cxx_ip_vld_abst_frm_inc Cxx_mute_abst_frm_dly Cxx_mute_ecu_conf Cxx_mute_vld_abst_frm_dec Cxx_mute_vld_abst_frm_inc Cxx_mux_diag_ena_dly Cxx_mux_frm_set_ref Cxx_swa_abst_frm_dly Cxx_swa_ecu_conf Cxx_swa_vld_abst_frm_dec Cxx_swa_vld_abst_frm_inc Cxx_usm_abst_frm_dly Cxx_usm_ecu_conf Cxx_usm_vld_abst_frm_dec Cxx_usm_vld_abst_frm_inc /end DEF_CHARACTERISTIC
 /begin OUT_MEASUREMENT AIRBAGCrash[0] AIRBAGCrash[1] BCM_CANHS_RNr_01[0] BCM_CANHS_RNr_01[1] BCM_CANHS_RNr_01[2] BCM_CANHS_RNr_01[3] BCM_CANHS_RNr_01[4] BCM_CANHS_RNr_01[5] BCM_CANHS_RNr_01[6] BCM_CANHS_RNr_01[7] BCM_CANHS_RNr_02[0] BCM_CANHS_RNr_02[1] BCM_CANHS_RNr_02[2] BCM_CANHS_RNr_02[3] BCM_CANHS_RNr_02[4] BCM_CANHS_RNr_02[5] BCM_CANHS_RNr_02[6] BCM_CANHS_RNr_02[7] BCM_VERLOG[0] BCM_VERLOG[1] BCM_VERLOG[2] BCM_VERLOG[3] BCM_VERLOG[4] BRAKE_CANHS_RNr_01[0] BRAKE_CANHS_RNr_01[1] BRAKE_CANHS_RNr_01[2] BRAKE_CANHS_RNr_01[3] BRAKE_CANHS_RNr_01[4] BRAKE_CANHS_RNr_01[5] BRAKE_CANHS_RNr_01[6] BRAKE_CANHS_RNr_02[0] BRAKE_CANHS_RNr_02[1] BRAKE_CANHS_RNr_02[2] BRAKE_CANHS_RNr_02[3] BRAKE_CANHS_RNr_02[4] BRAKE_CANHS_RNr_02[5] BRAKE_CANHS_RNr_03[0] BRAKE_CANHS_RNr_03[1] BRAKE_CANHS_RNr_03[2] BRAKE_CANHS_RNr_03[3] BRAKE_CANHS_RNr_03[4] BRAKE_CANHS_RNr_03[5] BRAKE_CANHS_RNr_04[0] BRAKE_CANHS_RNr_04[1] BRAKE_CANHS_RNr_04[2] BRAKE_CANHS_RNr_04[3] BRAKE_CANHS_RNr_04[4] BRAKE_CANHS_RNr_04[5] BRAKE_CANHS_RNr_04[6] BRAKE_CANHS_RNr_04[7] BRAKE_CANHS_R_01[0] BRAKE_CANHS_R_01[1] BRAKE_CANHS_R_01[2] BRAKE_CANHS_R_01[3] BRAKE_CANHS_R_01[4] BRAKE_CANHS_R_01[5] BRAKE_CANHS_R_01[6] CLIM_CANHS_R_01[0] CLIM_CANHS_R_01[1] CLIM_CANHS_R_01[2] CLIM_CANHS_R_01[3] CLIM_CANHS_R_01[4] CLIM_CANHS_R_01[5] CLUSTER_CANHS_RNr_01[0] CLUSTER_CANHS_RNr_01[1] CLUSTER_CANHS_RNr_01[2] CLUSTER_CANHS_RNr_01[3] CLUSTER_CANHS_RNr_01[4] CLUSTER_CANHS_R_01[0] CLUSTER_CANHS_R_01[1] CLUSTER_CANHS_R_01[2] CLUSTER_CANHS_R_01[3] CLUSTER_CANHS_R_01[4] CLUSTER_CANHS_R_01[5] CLUSTER_CANHS_R_01[6] CLUSTER_CANHS_R_01[7] DDCM_CANLSFT_R_01[0] DDCM_CANLSFT_R_01[1] DDCM_CANLSFT_R_01[2] DDCM_CANLSFT_R_01[3] DDCM_CANLSFT_R_01[4] ETC_CANHS_R_01[0] ETC_CANHS_R_01[1] ETC_CANHS_R_01[2] ETC_CANHS_R_01[3] ETC_CANHS_R_01[4] MMI_BRAKE_CANHS_RNr_01[0] MMI_BRAKE_CANHS_RNr_01[1] MMI_BRAKE_CANHS_RNr_01[2] RSD_CANHS_Rst_01[0] RSD_CANHS_Rst_01[1] RSD_CANHS_Rst_01[2] RSD_CANHS_Rst_01[3] SSCU_CANHS_R_02[0] SWA_CANHS_RNr_01[0] SWA_CANHS_RNr_01[1] SWA_CANHS_RNr_01[2] SWA_CANHS_RNr_01[3] SWA_CANHS_RNr_01[4] SWA_CANHS_RNr_01[5] SWA_CANHS_RNr_01[6] SWA_CANHS_RNr_01[7] TORQUE_AT_CANHS_RNr_01[0] TORQUE_AT_CANHS_RNr_01[1] TORQUE_AT_CANHS_RNr_01[2] TORQUE_AT_CANHS_RNr_01[3] TORQUE_AT_CANHS_RNr_01[4] TORQUE_AT_CANHS_RNr_01[5] TORQUE_AT_CANHS_RNr_01[6] TORQUE_AT_CANHS_RNr_01[7] TORQUE_AT_CANHS_RNr_02[0] TORQUE_AT_CANHS_RNr_02[1] TORQUE_AT_CANHS_RNr_02[2] TORQUE_AT_CANHS_RNr_02[3] TORQUE_AT_CANHS_RNr_02[4] TORQUE_AT_CANHS_RNr_02[5] TORQUE_AT_CANHS_RNr_02[6] TORQUE_AT_CANHS_RNr_02[7] USM_CANHS_RNr_01[0] USM_CANHS_RNr_01[1] USM_CANHS_RNr_01[2] USM_CANHS_RNr_01[3] USM_CANHS_RNr_01[4] USM_CANHS_RNr_02[0] USM_CANHS_RNr_02[1] USM_CANHS_RNr_02[2] USM_CANHS_RNr_02[3] USM_CANHS_RNr_02[4] Vbx_abs_pws_typ_bc Vbx_ac_pws_typ_bc Vbx_acc_pws_typ_bc Vbx_agb_pws_typ_bc Vbx_can_diag_bus_fail Vbx_can_diag_ecm Vbx_ccu_pws_typ_bc Vbx_ddcm_pws_typ_bc Vbx_etc_pws_typ_bc Vbx_ip_pws_typ_bc Vbx_mute_pws_typ_bc Vbx_swa_pws_typ_bc Vbx_usm_pws_typ_bc Vxx_abs_ecu_stt Vxx_abs_ecu_stt_ctr Vxx_abs_ecu_stt_ctr_mem_dec Vxx_abs_ecu_stt_ctr_mem_prev Vxx_abs_ecu_stt_diag Vxx_ac_ecu_stt Vxx_ac_ecu_stt_ctr Vxx_ac_ecu_stt_ctr_mem_dec Vxx_ac_ecu_stt_ctr_mem_prev Vxx_ac_ecu_stt_diag Vxx_acc_ecu_stt Vxx_acc_ecu_stt_ctr Vxx_acc_ecu_stt_ctr_mem_dec Vxx_acc_ecu_stt_ctr_mem_prev Vxx_acc_ecu_stt_diag Vxx_agb_ecu_stt Vxx_agb_ecu_stt_ctr Vxx_agb_ecu_stt_ctr_mem_dec Vxx_agb_ecu_stt_ctr_mem_prev Vxx_agb_ecu_stt_diag Vxx_bus_off_stt Vxx_bus_off_stt_ctr Vxx_bus_off_stt_ctr_mem_dec Vxx_bus_off_stt_ctr_mem_prev Vxx_bus_off_stt_diag Vxx_ccu_ecu_stt Vxx_ccu_ecu_stt_ctr Vxx_ccu_ecu_stt_ctr_mem_dec Vxx_ccu_ecu_stt_ctr_mem_prev Vxx_ccu_ecu_stt_diag Vxx_ddcm_ecu_stt Vxx_ddcm_ecu_stt_ctr Vxx_ddcm_ecu_stt_ctr_mem_dec Vxx_ddcm_ecu_stt_ctr_mem_prev Vxx_ddcm_ecu_stt_diag Vxx_etc_ecu_stt Vxx_etc_ecu_stt_ctr Vxx_etc_ecu_stt_ctr_mem_dec Vxx_etc_ecu_stt_ctr_mem_prev Vxx_etc_ecu_stt_diag Vxx_gcu_ecu_stt_diag Vxx_ip_ecu_stt Vxx_ip_ecu_stt_ctr Vxx_ip_ecu_stt_ctr_mem_dec Vxx_ip_ecu_stt_ctr_mem_prev Vxx_ip_ecu_stt_diag Vxx_mute_stt Vxx_mute_stt_ctr Vxx_mute_stt_ctr_mem_dec Vxx_mute_stt_ctr_mem_prev Vxx_mute_stt_diag Vxx_mux_frm_set_ref Vxx_sdl_ecu_stt_diag Vxx_swa_ecu_stt Vxx_swa_ecu_stt_ctr Vxx_swa_ecu_stt_ctr_mem_dec Vxx_swa_ecu_stt_ctr_mem_prev Vxx_swa_ecu_stt_diag Vxx_usm_ecu_stt Vxx_usm_ecu_stt_ctr Vxx_usm_ecu_stt_ctr_mem_dec Vxx_usm_ecu_stt_ctr_mem_prev Vxx_usm_ecu_stt_diag /end OUT_MEASUREMENT
/end FUNCTION
/begin FUNCTION CmMuxSer_Pcabsin "" /begin OUT_MEASUREMENT Vbx_mux_abs_reg Vsx_mux_abs_reg_vld /end OUT_MEASUREMENT /end FUNCTION
/begin FUNCTION CmMuxSer_Pcaplou ""
 /begin DEF_CHARACTERISTIC Cbx_acel_pdl_rat_secu_1_cfm Cbx_mux_driv_pwt_sp_fail Cxx_acel_pdl_rat_secu_1_val /end DEF_CHARACTERISTIC
 /begin OUT_MEASUREMENT KickDownActivated PedalError PowerTrainSetPoint RawSensor /end OUT_MEASUREMENT
/end FUNCTION
/begin FUNCTION CmMuxSer_Pcatqin ""
 /begin OUT_MEASUREMENT Vbx_mux_agb_csm_tq_navl Vbx_mux_gear_cge Vsx_mux_agb_csm_tq_vld Vsx_mux_agb_tq_ctl_typ Vxx_mux_agb_clck Vxx_mux_agb_csm_tq Vxx_mux_agb_tqe_sp Vxx_mux_agb_tqe_sp_raw Vxx_mux_agb_tqe_tgt_lim Vxx_mux_agb_tqe_tgt_lim_raw /end OUT_MEASUREMENT
/end FUNCTION
/begin FUNCTION CmMuxSer_Pcbpkin "" /begin OUT_MEASUREMENT Vbx_mux_bpk Vbx_mux_bpk_navl Vsx_mux_bpk_vld /end OUT_MEASUREMENT /end FUNCTION
/begin FUNCTION CmMuxSer_Pcbrkin "" /begin OUT_MEASUREMENT Vbx_mux_brk_pdl_navl Vsx_mux_brk_pdl Vsx_mux_brk_pdl_vld /end OUT_MEASUREMENT /end FUNCTION
/begin FUNCTION CmMuxSer_Pcbrkou "" /begin OUT_MEASUREMENT OpenActiveBrakeSwitch_ECM /end OUT_MEASUREMENT /end FUNCTION
/begin FUNCTION CmMuxSer_Pcclbin ""
 /begin OUT_MEASUREMENT Vbx_mux_bgin_str_clu_cnt_navl Vsx_mux_bgin_str_clu_cnt Vsx_mux_bgin_str_clu_cnt_vld /end OUT_MEASUREMENT
/end FUNCTION
/begin FUNCTION CmMuxSer_Pcclein ""
 /begin OUT_MEASUREMENT Vbx_mux_end_str_clu_cnt_navl Vsx_mux_end_str_clu_cnt Vsx_mux_end_str_clu_cnt_vld /end OUT_MEASUREMENT
/end FUNCTION
/begin FUNCTION CmMuxSer_Pcespin ""
 /begin OUT_MEASUREMENT Vbx_mux_asr_reg Vbx_mux_ayc_reg Vsx_mux_asr_msr_typ Vsx_mux_asr_msr_typ_vld Vsx_mux_asr_reg_vld Vsx_mux_ayc_reg_vld Vxx_mux_asr_msr_clck Vxx_mux_asr_tqe_sp Vxx_mux_asr_tqe_sp_raw Vxx_mux_asr_tqe_tgt Vxx_mux_asr_tqe_tgt_raw Vxx_mux_msr_tqe_sp Vxx_mux_msr_tqe_sp_raw /end OUT_MEASUREMENT
/end FUNCTION
/begin FUNCTION CmMuxSer_Pcfshou "" /begin DEF_CHARACTERISTIC Cxx_free_shf_dft_val Cxx_free_shf_ini_val /end DEF_CHARACTERISTIC /begin OUT_MEASUREMENT FreeShift /end OUT_MEASUREMENT /end FUNCTION
/begin FUNCTION CmMuxSer_Pcrvnin ""
 /begin OUT_MEASUREMENT Vbx_mux_neut_cnt_navl Vbx_mux_rvr_cnt_navl Vsx_mux_neut_cnt Vsx_mux_neut_cnt_vld Vsx_mux_rvr_cnt Vsx_mux_rvr_cnt_vld /end OUT_MEASUREMENT
/end FUNCTION
/begin FUNCTION CmMuxSer_Pcspcin "" /begin OUT_MEASUREMENT Vxx_mux_agb_driv_spt_fac /end OUT_MEASUREMENT /end FUNCTION
/begin FUNCTION CmMuxSer_Pctcsin ""
 /begin OUT_MEASUREMENT Vbx_mux_agb_coup_navl Vbx_mux_ant_crt_slc_navl Vsx_mux_agb_coup Vsx_mux_agb_coup_vld Vsx_mux_ant_crt_slc Vsx_mux_ant_crt_slc_vld Vsx_mux_rgb_coup Vsx_mux_rgb_coup_vld /end OUT_MEASUREMENT
/end FUNCTION
/begin FUNCTION CmMuxSer_Pctqeou ""
 /begin OUT_MEASUREMENT ASR_MSRAcknowledgement AT_TorqueAcknowledgement EngineTorque_WithoutTMReq RawEngineTorque_WithoutTMReq RequestedTorqueAfterProc /end OUT_MEASUREMENT
/end FUNCTION
/begin FUNCTION CmMuxSer_Pctrein ""
 /begin OUT_MEASUREMENT Vbx_mux_drag_red_agb Vbx_mux_egb_neut Vbx_mux_raw_egb_ant_gear_navl Vbx_mux_raw_egb_gear_navl Vsx_mux_drag_red_agb_vld Vsx_mux_egb_neut_vld Vsx_mux_raw_egb_ant_gear Vsx_mux_raw_egb_ant_gear_vld Vsx_mux_raw_egb_gear Vsx_mux_raw_egb_gear_vld /end OUT_MEASUREMENT
/end FUNCTION
/begin FUNCTION CmMuxSer_Pftfdis "" /begin OUT_MEASUREMENT ParticulateFilterFailureDisplay /end OUT_MEASUREMENT /end FUNCTION
/begin FUNCTION CmMuxSer_Pftstat "" /begin OUT_MEASUREMENT ParticulateFilterState /end OUT_MEASUREMENT /end FUNCTION
/begin FUNCTION CmMuxSer_Rxfrmxx ""
 /begin OUT_MEASUREMENT ABSinRegulation ACCompClutchRequest ACCompClutchStatus ACCompPowerUsed ACCompRequest ACCoolingFanSpeedRequest ACMinEngineIdleSpeedRequest ASRDynamicTorqueRequest ASRStaticTorqueRequest ASRinRegulation ATCoolingFanSpeedRequest AT_Clock AT_MILRequest AT_Minimum_IdleSpeedRequest AT_TorqueControlType AT_TorqueLosses AYCinRegulation AccurateOdometer AirbagCrashOrder AlternatorLoad AnticipatedCurrentShift BrakeInfoStatus BrakeSwitchFailure ClimateCoolingRequest ClutchSwitchMaximumTravel ClutchSwitchMinimumTravel CouplerState DiagMuxOn_BCM DiagnoseFuelLow DisplayedSpeed DisplayedSpeedUnit DistanceTotalizer ESP_Clock ESP_TorqueControlType ETC_Clock ElecPowerConsumedByAux ElectricalPowerDrived EmergencyEngineStop EngineTorqueReductionRequestCf ExternalTemp FastTorqueRequest FrontDefrostEngaged FuelCutRequestedEngineSpeed FuelLevelDisplayed FuelLow GenericApplicativeDiagEnable IdleSpeedInhibitionRequest InputShaftRevolution InstantMecanicalPowerByAlt KeyVehicle Limit_SlowTorqueRequest MSRTorqueRequest MSRinRegulation MiniConsumptionRequest NeutralContact OilDrainAlertResetRequest PTCEngineIdleSpeedRequest ParkingBrakeStatus PumpActivationRequest RST_EspAsrSportMode RST_GearShiftOffset RST_PedalMap RearDefrostEngaged RearGearEngaged SLockValueControl SOCBattery14V SlipControlStatus SlowEngineTorqueSetpoint SoftwareLockValue[0] SoftwareLockValue[1] SoftwareLockValue[2] SoftwareLockValue[3] SportivityCriteria StartButtonPushed StarterStatus StartingMode_BCM_R SteeringWheelAngle StopAutoRequest TechnicalStartAutoRequest TorqueConverterState TransmRangeEngaged_Current TransmRangeEngaged_Target TransversalAcceleration VehicleSpeed VehicleState VehiculeStateSSExtension WheelSpeedRL WheelSpeedRR /end OUT_MEASUREMENT
/end FUNCTION
/end MODULE
/end PROJECT
