ASAP2_VERSION 1 41
/begin PROJECT RD8 "_default_ProjectLongIdentifier"
/begin HEADER "_default_HeaderComment" PROJECT_NO RD9 /end HEADER
/begin MODULE _default_ModuleName "_default_ModuleLongIdentifier"
/begin MOD_COMMON "_default_ModCommonComment" DEPOSIT ABSOLUTE BYTE_ORDER MSB_LAST ALIGNMENT_BYTE 1 ALIGNMENT_WORD 2 ALIGNMENT_LONG 2 ALIGNMENT_FLOAT32_IEEE 2 ALIGNMENT_FLOAT64_IEEE 4 /end MOD_COMMON
/begin AXIS_PTS Ctb_sta_tco "Coolant temperature breakpoints for starting set point tables" 0xa002d498 Vxx_tco _REC_A2AXS_20_u2 240. _CNV_A_R_LINEAR_____110_CM 8 -40. 200. FORMAT "%5.1" /end AXIS_PTS
/begin AXIS_PTS Ctb_tco "16 engine coolant temperature breakpoints" 0xa002d4ac Vxx_tco _REC_A2AXS_20_u2 240. _CNV_A_R_LINEAR_____110_CM 16 -40. 200. FORMAT "%5.1" /end AXIS_PTS
/begin AXIS_PTS Ctb_tco2 "Engine coolant temperature breakpoints" 0xa002d4d0 Vxx_tco _REC_A2AXS_20_u2 240. _CNV_A_R_LINEAR_____110_CM 9 -40. 200. FORMAT "%5.1" /end AXIS_PTS
/begin AXIS_PTS Ctb_eng_amp "atmospheric pressure breakpoint of full load torque limitation." 0xa00357a8 Vxx_amp _REC_A2AXS_20_u2 20000. _CNV_A_R_LINEAR_____115_CM 6 0. 20000. FORMAT "%5.0" /end AXIS_PTS
/begin AXIS_PTS Ctb_n "20 programmable engine speed breakpoints map" 0xa002db74 Vxx_n _REC_A2AXS_20_u2 16383.75 _CNV_A_R_ENSD_LINEA_22_CM 20 0. 16383.75 FORMAT "%8.2" /end AXIS_PTS
/begin AXIS_PTS Ctb_n2 "9 programmable engine speed breakpoints table" 0xa002dba0 Vxx_n _REC_A2AXS_20_u2 16383.75 _CNV_A_R_ENSD_LINEA_22_CM 9 0. 16383.75 FORMAT "%8.2" /end AXIS_PTS
/begin MEASUREMENT Vxx_trz_ad_b1_val "" UWORD _CNV_A_R_ECME_LINEA_0_CM 1 0. 0. 4096. DISPLAY_IDENTIFIER InTqiTrz_NVM.Vxx_trz_ad_b1_val_NVM ECU_ADDRESS 0xd00044cc FORMAT "%4.0" /end MEASUREMENT
/begin MEASUREMENT Vxx_trz_ad_b2_val "" UWORD _CNV_A_R_ECME_LINEA_0_CM 1 0. 0. 4096. DISPLAY_IDENTIFIER InTqiTrz_NVM.Vxx_trz_ad_b2_val_NVM ECU_ADDRESS 0xd00044ce FORMAT "%4.0" /end MEASUREMENT
/begin MEASUREMENT Vxx_trz_ad_b1_dif "" SWORD _CNV_A_R_ECME_LINEA_0_CM 1 0. -32768. 32767. DISPLAY_IDENTIFIER InTqiTrz_NVM.Vxx_trz_ad_b1_dif_NVM ECU_ADDRESS 0xd00044d0 FORMAT "%6.0" /end MEASUREMENT
/begin MEASUREMENT Vxx_trz_ad_b2_dif "" SWORD _CNV_A_R_ECME_LINEA_0_CM 1 0. -32768. 32767. DISPLAY_IDENTIFIER InTqiTrz_NVM.Vxx_trz_ad_b2_dif_NVM ECU_ADDRESS 0xd00044d2 FORMAT "%6.0" /end MEASUREMENT
/begin MEASUREMENT Vxx_trz_ad_b1_fil "" UWORD _CNV_A_R_ECME_LINEA_0_CM 1 0. 0. 65535. DISPLAY_IDENTIFIER InTqiTrz_NVM.Vxx_trz_ad_b1_fil_NVM ECU_ADDRESS 0xd00044d4 FORMAT "%5.0" /end MEASUREMENT
/begin MEASUREMENT Vxx_trz_ad_b2_fil "" UWORD _CNV_A_R_ECME_LINEA_0_CM 1 0. 0. 65535. DISPLAY_IDENTIFIER InTqiTrz_NVM.Vxx_trz_ad_b2_fil_NVM ECU_ADDRESS 0xd00044d6 FORMAT "%5.0" /end MEASUREMENT
/begin MEASUREMENT Vxx_trz_ad_b_ctr_tdc "" UWORD _CNV_A_R_LINEAR_____101_CM 1 0. 0. 65535. DISPLAY_IDENTIFIER InTqiTrz_NVM.Vxx_trz_ad_b_ctr_tdc_NVM ECU_ADDRESS 0xd00044d8 FORMAT "%5.0" /end MEASUREMENT
/begin MEASUREMENT Vbx_trz_ad_b_ok "" UBYTE _CNV_S_2_RANGE______3_CM 1 0. 0. 1. DISPLAY_IDENTIFIER InTqiTrz_NVM.Vbx_trz_ad_b_ok_NVM ECU_ADDRESS 0xd00044da BIT_MASK 0x1 /end MEASUREMENT
/begin MEASUREMENT Vbx_stt_trz_cor_0_tmp "Internal Trig enable for trz torque correction beta coefficient computation" UBYTE _CNV_S_2_RANGE______3_CM 1 0. 0. 1. ECU_ADDRESS 0xd0007c19 BIT_MASK 0x1 /end MEASUREMENT
/begin MEASUREMENT Vbx_stt_trz_cor_1_tmp "Internal Trig Enable for TRZ calculation" UBYTE _CNV_S_2_RANGE______3_CM 1 0. 0. 1. ECU_ADDRESS 0xd0006d68 BIT_MASK 0x1 /end MEASUREMENT
/begin MEASUREMENT Vbx_stt_trz_cor_2_tmp "Internal Trig Enable for TRZ calculation" UBYTE _CNV_S_2_RANGE______3_CM 1 0. 0. 1. ECU_ADDRESS 0xd0006d69 BIT_MASK 0x1 /end MEASUREMENT
/begin MEASUREMENT Vbx_trz_ad_b1_stt_tmp "internal boolean for beta1 selection for the torque computation" UBYTE _CNV_S_2_RANGE______3_CM 1 0. 0. 1. ECU_ADDRESS 0xd0006d6a BIT_MASK 0x1 /end MEASUREMENT
/begin MEASUREMENT Vbx_trz_ad_b_ena "TLZ and TRZ calculation enabled" UBYTE _CNV_S_2_RANGE______3_CM 1 0. 0. 1. ECU_ADDRESS 0xd0006d6b BIT_MASK 0x1 /end MEASUREMENT
/begin MEASUREMENT Vbx_trz_cyl_slc "Internal value for type cylinder selection (ad_b1 or ad_b2)" UBYTE _CNV_S_2_RANGE______3_CM 1 0. 0. 1. ECU_ADDRESS 0xd0006d6c BIT_MASK 0x1 /end MEASUREMENT
/begin MEASUREMENT Vsx_trz_ad_b_stt "State number of the TRZ computation" UBYTE _CNV_A_R_ECME_LINEA_0_CM 1 0. 1. 3. ECU_ADDRESS 0xd0006d6d FORMAT "%1.0" /end MEASUREMENT
/begin CHARACTERISTIC Cxx_trz_ad_b_fil_fac "filter gain value for half turn adaptative correction" VALUE 0xa00217b6 _REC_S1VAL_20_u1 255. _CNV_A_R_ECME_LINEA_0_CM 0. 255. FORMAT "%3.0" /end CHARACTERISTIC
/begin CHARACTERISTIC Cxx_trz_ad_b_grd_prs "Correction gain of manifold pressure" VALUE 0xa00217b7 _REC_S1VAL_20_u1 255. _CNV_A_R_ECME_LINEA_0_CM 0. 255. FORMAT "%3.0" /end CHARACTERISTIC
/begin CHARACTERISTIC Cxx_trz_ad_b_n_max "Maximum Engine speed for adptative calculation of the correction TRZ Beta Coefficient" VALUE 0xa00217ae _REC_S1VAL_20_u2 16383.75 _CNV_A_R_ENSD_LINEA_22_CM 0. 16383.75 FORMAT "%8.2" /end CHARACTERISTIC
/begin CHARACTERISTIC Cxx_trz_ad_b_n_min "Minimum engine speed for adptative calculation of the correction TRZ Beta Coefficient" VALUE 0xa00217b0 _REC_S1VAL_20_u2 16383.75 _CNV_A_R_ENSD_LINEA_22_CM 0. 16383.75 FORMAT "%8.2" /end CHARACTERISTIC
/begin CHARACTERISTIC Cxx_trz_ad_b_nr_tdc "Minimum number of half turns necessary for learning cranck shaft defaults" VALUE 0xa00217b2 _REC_S1VAL_20_u2 65535. _CNV_A_R_LINEAR_____101_CM 0. 65535. FORMAT "%5.0" /end CHARACTERISTIC
/begin CHARACTERISTIC Cxx_trz_b_ini "Initial value of the beta coefficient cooresponding to 3 876 562 * B/A (A and B are the torque B4 coefficients)" VALUE 0xa00217b4 _REC_S1VAL_20_u2 65535. _CNV_A_R_ECME_LINEA_0_CM 0. 65535. FORMAT "%5.0" /end CHARACTERISTIC
/begin MEASUREMENT Vbx_trz_clc_ok "Flag for gaz torque TRZ computation finished" UBYTE _CNV_S_2_RANGE______3_CM 1 0. 0. 1. ECU_ADDRESS 0xd0006d75 BIT_MASK 0x1 /end MEASUREMENT
/begin MEASUREMENT Vbx_trz_raw_clc "Flag for raw torque TRZ computation finished." UBYTE _CNV_S_2_RANGE______3_CM 1 0. 0. 1. ECU_ADDRESS 0xd0006d76 BIT_MASK 0x1 /end MEASUREMENT
/begin MEASUREMENT Vbx_trz_raw_err "Overflow in calculation of the gaz torque TRZ" UBYTE _CNV_S_2_RANGE______3_CM 1 0. 0. 1. ECU_ADDRESS 0xd0006d77 BIT_MASK 0x1 /end MEASUREMENT
/begin MEASUREMENT Vbx_trz_val_neg "Boolean true  for negative value of Vxx_trz_val equal to torque value" UBYTE _CNV_S_2_RANGE______3_CM 1 0. 0. 1. ECU_ADDRESS 0xd0006d78 BIT_MASK 0x1 /end MEASUREMENT
/begin MEASUREMENT Vsx_trz_stt "Sate Number for determining the current state of the TRZ computation" UBYTE _CNV_A_R_ECME_LINEA_0_CM 1 0. 0. 2. ECU_ADDRESS 0xd0006d79 FORMAT "%1.0" /end MEASUREMENT
/begin MEASUREMENT Vxx_trz_ad_b_val "Intermediate Value of the coeficient beta corrected by adaptative strategy during half-turn for cyl 1 and 4 or cyl 2 and 3" UWORD _CNV_A_R_ECME_LINEA_0_CM 1 0. 0. 4096. ECU_ADDRESS 0xd00044dc FORMAT "%4.0" /end MEASUREMENT
/begin MEASUREMENT Vxx_trz_raw_val "Raw TRZ torque " SWORD _CNV_A_R_LINEAR_____369_CM 1 0. -3276.8 3276.7 ECU_ADDRESS 0xd00044de FORMAT "%6.1" /end MEASUREMENT
/begin MEASUREMENT Vxx_trz_val_tmp "Numerical Intermediary value in TRZ calculation " UWORD _CNV_A_R_ECME_LINEA_0_CM 1 0. 0. 65535. ECU_ADDRESS 0xd00044e0 FORMAT "%5.0" /end MEASUREMENT
/begin MEASUREMENT Vxx_trz_val_tmp1 "Numerical Intermediary value in TRZ calculation" UWORD _CNV_A_R_ECME_LINEA_0_CM 1 0. 0. 65535. ECU_ADDRESS 0xd00044e2 FORMAT "%5.0" /end MEASUREMENT
/begin CHARACTERISTIC Cxx_trz_a "A parameter of TRZ equal to 787.86 * physical (A)" VALUE 0xa00217b8 _REC_S1VAL_20_u2 65535. _CNV_A_R_ECME_LINEA_0_CM 0. 65535. FORMAT "%5.0" /end CHARACTERISTIC
/begin CHARACTERISTIC Cxx_trz_n_max "Max Engine speed value for TRZ computation" VALUE 0xa00217ba _REC_S1VAL_20_u2 16383.75 _CNV_A_R_ENSD_LINEA_22_CM 0. 16383.75 FORMAT "%8.2" /end CHARACTERISTIC
/begin CHARACTERISTIC Cxx_trz_n_min "Min Engine speed value for TRZ computation" VALUE 0xa00217bc _REC_S1VAL_20_u2 16383.75 _CNV_A_R_ENSD_LINEA_22_CM 0. 16383.75 FORMAT "%8.2" /end CHARACTERISTIC
/begin MEASUREMENT Vbx_ac_prs_lk_stt "Air conditioning pressure sensor detection. Stored in E²PROM." UBYTE _CNV_S_2_RANGE______3_CM 1 0. 0. 1. DISPLAY_IDENTIFIER InVfiAci_NVM.Vbx_ac_prs_lk_stt_NVM ECU_ADDRESS 0xd0006d7e BIT_MASK 0x1 /end MEASUREMENT
/begin MEASUREMENT Vbx_ac_req_lk_stt "Air conditioning request detection. Stored in E²PROM." UBYTE _CNV_S_2_RANGE______3_CM 1 0. 0. 1. DISPLAY_IDENTIFIER InVfiAci_NVM.Vbx_ac_req_lk_stt_NVM ECU_ADDRESS 0xd0006d7f BIT_MASK 0x1 /end MEASUREMENT
/begin MEASUREMENT Vbx_comp_cfa_lk_stt "Cabin fan request detection" UBYTE _CNV_S_2_RANGE______3_CM 1 0. 0. 1. DISPLAY_IDENTIFIER InVfiAci_NVM.Vbx_comp_cfa_lk_stt_NVM ECU_ADDRESS 0xd0006d80 BIT_MASK 0x1 /end MEASUREMENT
/begin MEASUREMENT Vbx_ac_clu_req "Air conditioning compressor clutching request sent from AC ECU to USM (M3 architecture)" UBYTE _CNV_S_2_RANGE______3_CM 1 0. 0. 1. ECU_ADDRESS 0xd0006d7a BIT_MASK 0x1 /end MEASUREMENT
/begin MEASUREMENT Vbx_ac_ext_pres "Air conditioning ECU detection. Equal to 0 if cold loop is present" UBYTE _CNV_S_2_RANGE______3_CM 1 0. 0. 1. ECU_ADDRESS 0xd0007c1c BIT_MASK 0x1 /end MEASUREMENT
/begin MEASUREMENT Vbx_ac_pres "Air conditioning option detection with security on configuration detection." UBYTE _CNV_S_2_RANGE______3_CM 1 0. 0. 1. ECU_ADDRESS 0xd0006d7b BIT_MASK 0x1 /end MEASUREMENT
/begin MEASUREMENT Vbx_df_ac_prs_h "Air conditioning pressure sensor open circuit detected failure" UBYTE _CNV_S_2_RANGE______3_CM 1 0. 0. 1. ECU_ADDRESS 0xd0007c1d BIT_MASK 0x1 /end MEASUREMENT
/begin MEASUREMENT Vbx_df_ac_prs_l "Air conditioning pressure sensor short circuit detected failure" UBYTE _CNV_S_2_RANGE______3_CM 1 0. 0. 1. ECU_ADDRESS 0xd0007c1e BIT_MASK 0x1 /end MEASUREMENT
/begin MEASUREMENT Vsx_ac_prs_vld "Relative air conditioning pressure validity status" UBYTE _CNV_A_R_ECME_LINEA_0_CM 1 0. 0. 255. ECU_ADDRESS 0xd0006d7c FORMAT "%3.0" /end MEASUREMENT
/begin MEASUREMENT Vxx_ac_prs "Relative air conditioning pressure" UWORD _CNV_A_R_LINEAR_____373_CM 1 0. 0. 6553.5 ECU_ADDRESS 0xd00044e4 FORMAT "%6.1" /end MEASUREMENT
/begin CHARACTERISTIC Cxx_ac_lk_stt_dly "Duration of air conditioning connection/detection filtering" VALUE 0xa00217be _REC_S1VAL_20_u2 655.35 _CNV_A_R_LINEAR_____32_CM 0. 655.35 FORMAT "%6.2" /end CHARACTERISTIC
/begin CHARACTERISTIC Cxx_ac_prs_fac "Air conditioning pressure sensor gain value" VALUE 0xa00217cc _REC_S1VAL_20_u1 0.255 _CNV_A_R_LINEAR_____374_CM 0. 0.255 FORMAT "%5.3" /end CHARACTERISTIC
/begin CHARACTERISTIC Cxx_ac_prs_lk_stt_dly "Duration of air conditioning pressure sensor connection filtering" VALUE 0xa00217c0 _REC_S1VAL_20_u2 655.35 _CNV_A_R_LINEAR_____32_CM 0. 655.35 FORMAT "%6.2" /end CHARACTERISTIC
/begin CHARACTERISTIC Cxx_ac_prs_ofs "Air conditioning pressure sensor offset value" VALUE 0xa00217c2 _REC_S1VAL_20_u2 60. _CNV_A_R_LINEAR_____205_CM 0. 60. FORMAT "%5.2" /end CHARACTERISTIC
/begin CHARACTERISTIC Cxx_ac_prs_v_max "High threshold for AC pressure sensor failure detection" VALUE 0xa00217c4 _REC_S1VAL_20_u2 60. _CNV_A_R_LINEAR_____205_CM 0. 60. FORMAT "%5.2" /end CHARACTERISTIC
/begin CHARACTERISTIC Cxx_ac_prs_v_min "Low threshold for AC pressure sensor failure detection" VALUE 0xa00217c6 _REC_S1VAL_20_u2 60. _CNV_A_R_LINEAR_____205_CM 0. 60. FORMAT "%5.2" /end CHARACTERISTIC
/begin CHARACTERISTIC Cxx_dfdec_ac_prs "Sensor Detected Failure Counter Decrement" VALUE 0xa00217c8 _REC_S1VAL_20_u2 65535. _CNV_A_R_ECME_LINEA_0_CM 0. 65535. FORMAT "%5.0" /end CHARACTERISTIC
/begin CHARACTERISTIC Cxx_dfinc_ac_prs "Sensor Detected Failure Counter Increment" VALUE 0xa00217ca _REC_S1VAL_20_u2 65535. _CNV_A_R_ECME_LINEA_0_CM 0. 65535. FORMAT "%5.0" /end CHARACTERISTIC
/begin MEASUREMENT Vbx_ac_mdf1_req_ext "Fan 1 activation request from air conditioning ECU" UBYTE _CNV_S_2_RANGE______3_CM 1 0. 0. 1. ECU_ADDRESS 0xd0006d82 BIT_MASK 0x1 /end MEASUREMENT
/begin MEASUREMENT Vbx_ac_mdf2_req_ext "Fan 2 activation request from air conditioning ECU" UBYTE _CNV_S_2_RANGE______3_CM 1 0. 0. 1. ECU_ADDRESS 0xd0006d83 BIT_MASK 0x1 /end MEASUREMENT
/begin MEASUREMENT Vbx_ac_req "Filtered air conditioning compressor activation request" UBYTE _CNV_S_2_RANGE______3_CM 1 0. 0. 1. ECU_ADDRESS 0xd0006d84 BIT_MASK 0x1 /end MEASUREMENT
/begin MEASUREMENT Vbx_agb_mdf1_req "Fan 1 activation request from AGB" UBYTE _CNV_S_2_RANGE______3_CM 1 0. 0. 1. ECU_ADDRESS 0xd0006d85 BIT_MASK 0x1 /end MEASUREMENT
/begin MEASUREMENT Vbx_agb_mdf2_req "Fan 2 activation request from AGB" UBYTE _CNV_S_2_RANGE______3_CM 1 0. 0. 1. ECU_ADDRESS 0xd0006d86 BIT_MASK 0x1 /end MEASUREMENT
/begin CHARACTERISTIC Cxx_ac_req_dly "Delay to filter an AC clutching request" VALUE 0xa00217ce _REC_S1VAL_20_u2 655.35 _CNV_A_R_LINEAR_____32_CM 0. 655.35 FORMAT "%6.2" /end CHARACTERISTIC
/begin CHARACTERISTIC Cxx_ac_req_dsb_dly "Delay to filter an AC clutching request inhibition" VALUE 0xa00217d0 _REC_S1VAL_20_u2 655.35 _CNV_A_R_LINEAR_____32_CM 0. 655.35 FORMAT "%6.2" /end CHARACTERISTIC
/begin CHARACTERISTIC Cxx_wf_ac_req_dly "Delay to filter a wire AC clutching request" VALUE 0xa00217d2 _REC_S1VAL_20_u2 655.35 _CNV_A_R_LINEAR_____32_CM 0. 655.35 FORMAT "%6.2" /end CHARACTERISTIC
/begin CHARACTERISTIC Cxx_wf_ac_req_dsb_dly "Delay to filter a wire AC clutching request inhibition" VALUE 0xa00217d4 _REC_S1VAL_20_u2 655.35 _CNV_A_R_LINEAR_____32_CM 0. 655.35 FORMAT "%6.2" /end CHARACTERISTIC
/begin MEASUREMENT Vbx_wf_ac_req "Climate cooling request from wire" UBYTE _CNV_S_2_RANGE______3_CM 1 0. 0. 1. ECU_ADDRESS 0xd0006d7d BIT_MASK 0x1 /end MEASUREMENT
/begin MEASUREMENT Vsx_acc_sdl_ctl_typ "" UBYTE _CNV_A_R_ECME_LINEA_0_CM 1 0. 0. 255. ECU_ADDRESS 0xd0007bca FORMAT "%3.0" /end MEASUREMENT
/begin MEASUREMENT Vxx_acc_forc_sp "Driving force requested by active cruise control." UWORD _CNV_A_R_LINEAR_____360_CM 1 0. -20000. 111068. ECU_ADDRESS 0xd0005f04 FORMAT "%6.0" /end MEASUREMENT
/begin MEASUREMENT Vxx_sdl_forc_sp "Driving force requested by speed and distance limiter." UWORD _CNV_A_R_LINEAR_____360_CM 1 0. -20000. 111068. ECU_ADDRESS 0xd0005f06 FORMAT "%6.0" /end MEASUREMENT
/begin MEASUREMENT Vbx_mdf2_reg "High temperature mode regulation authorisation for Mdf2." UBYTE _CNV_S_2_RANGE______3_CM 1 0. 0. 1. ECU_ADDRESS 0xd0007851 BIT_MASK 0x1 /end MEASUREMENT
/begin MEASUREMENT Vbx_tco_sp_l_mod "Low cooling temperature mode request (interdiction de rÃ©gulation haute tempÃ©rature avec thermostat pilotÃ©)" UBYTE _CNV_S_2_RANGE______3_CM 1 0. 0. 1. ECU_ADDRESS 0xd0007852 BIT_MASK 0x1 /end MEASUREMENT
/begin MEASUREMENT Vbx_tsta_ip_dft_lght_tco_h_sp "Switching to high temperature mode for the overheating alert lamp in the dashboard." UBYTE _CNV_S_2_RANGE______3_CM 1 0. 0. 1. ECU_ADDRESS 0xd0007853 BIT_MASK 0x1 /end MEASUREMENT
/begin MEASUREMENT Vxx_mdf2_reg_dly "Delay value before enabling low temperature mode regulation for mdf2." UBYTE _CNV_A_R_LINEAR_____68_CM 1 0. 0. 255. ECU_ADDRESS 0xd0007854 FORMAT "%3.0" /end MEASUREMENT
/begin MEASUREMENT Vxx_tco_sp "Water temperature set point for controlled thermostat." UWORD _CNV_A_R_LINEAR_____110_CM 1 0. -40. 200. ECU_ADDRESS 0xd00051a8 FORMAT "%5.1" /end MEASUREMENT
/begin MEASUREMENT Vsx_tsta_vld "Electronically controlled thermostat validity indicator" UBYTE _CNV_A_R_ECME_LINEA_0_CM 1 0. 0. 2. ECU_ADDRESS 0xd0007855 FORMAT "%1.0" /end MEASUREMENT
/begin MEASUREMENT Vbx_ac_mdf1_req "Fan 1 activation request from cold loop or air conditioning ECU" UBYTE _CNV_S_2_RANGE______3_CM 1 0. 0. 1. ECU_ADDRESS 0xd0006f13 BIT_MASK 0x1 /end MEASUREMENT
/begin MEASUREMENT Vbx_ac_mdf2_req "Fan 2 activation request from cold loop or air conditioning ECU" UBYTE _CNV_S_2_RANGE______3_CM 1 0. 0. 1. ECU_ADDRESS 0xd0006f14 BIT_MASK 0x1 /end MEASUREMENT
/begin MEASUREMENT Vbx_mdf1_cmd "Low speed engine fan command" UBYTE _CNV_S_2_RANGE______3_CM 1 0. 0. 1. ECU_ADDRESS 0xd0006f15 BIT_MASK 0x1 /end MEASUREMENT
/begin MEASUREMENT Vbx_mdf1_cmd_dly "Low speed engine fan delayed command" UBYTE _CNV_S_2_RANGE______3_CM 1 0. 0. 1. ECU_ADDRESS 0xd0006f16 BIT_MASK 0x1 /end MEASUREMENT
/begin MEASUREMENT Vbx_mdf2_cmd "High speed engine fan command" UBYTE _CNV_S_2_RANGE______3_CM 1 0. 0. 1. ECU_ADDRESS 0xd0006f17 BIT_MASK 0x1 /end MEASUREMENT
/begin MEASUREMENT Vbx_mdf2_cmd_dly "High speed engine fan delayed command" UBYTE _CNV_S_2_RANGE______3_CM 1 0. 0. 1. ECU_ADDRESS 0xd0006f18 BIT_MASK 0x1 /end MEASUREMENT
/begin MEASUREMENT Vxx_mdf_min_dly_cnt "counter for the minimum duration of fan1 or fan2 activation" UWORD _CNV_A_R_LINEAR_____32_CM 1 0. 0. 655.35 ECU_ADDRESS 0xd0004678 FORMAT "%6.2" /end MEASUREMENT
/begin MEASUREMENT Vxx_mdf_min_dly_dt "dt for the minimum duration of fan1 or fan2 activation" UWORD _CNV_A_R_LINEAR_____32_CM 1 0. 0. 655.35 ECU_ADDRESS 0xd000467a FORMAT "%6.2" /end MEASUREMENT
/begin CHARACTERISTIC Cxx_mdf_min_dly "Minimum duration of fan1 or fan2 activation" VALUE 0xa0021ae4 _REC_S1VAL_20_u2 655.35 _CNV_A_R_LINEAR_____32_CM 0. 655.35 FORMAT "%6.2" /end CHARACTERISTIC
/begin CHARACTERISTIC Cxx_mdf_on_dly "Turn on delay of fan1 or fan2 activation" VALUE 0xa0021ae6 _REC_S1VAL_20_u1 25.5 _CNV_A_R_LINEAR_____58_CM 0. 25.5 FORMAT "%4.1" /end CHARACTERISTIC
/begin MEASUREMENT Vbx_df_ip_lght_tco_ovh "Warning over heating lamp detected failure" UBYTE _CNV_S_2_RANGE______3_CM 1 0. 0. 1. ECU_ADDRESS 0xd0007c56 BIT_MASK 0x1 /end MEASUREMENT
/begin MEASUREMENT Vbx_ip_dft_lght_tco "Water temperature alert lamp." UBYTE _CNV_S_2_RANGE______3_CM 1 0. 0. 1. ECU_ADDRESS 0xd0007c57 BIT_MASK 0x1 /end MEASUREMENT
/begin MEASUREMENT Vbx_ip_lght_tco_ovh_igk_off_ena "ou_clo_coo_clatoxx/over heating lamp set of snapshot data identifiers" UBYTE _CNV_S_2_RANGE______3_CM 1 0. 0. 1. ECU_ADDRESS 0xd0007c58 BIT_MASK 0x1 /end MEASUREMENT
/begin CHARACTERISTIC Cbx_ip_lght_tco_ovh_igk_off_ena "State if warning over heating lamp in on when igk is off" VALUE 0xa0021ae2 _REC_S1VAL_20_u1 1. _CNV_A_R_ECME_LINEA_0_CM 0. 1. FORMAT "%1.0" BIT_MASK 0x1 /end CHARACTERISTIC
/begin CHARACTERISTIC Cxx_dfdec_ip_lght_tco_ovh "ou_clo_coo_clatoxx/Warning over heating lamp detected failure counter decrement" VALUE 0xa0021ad6 _REC_S1VAL_20_u2 65535. _CNV_A_R_ECME_LINEA_0_CM 0. 65535. FORMAT "%5.0" /end CHARACTERISTIC
/begin CHARACTERISTIC Cxx_dfinc_ip_lght_tco_ovh "ou_clo_coo_clatoxx/Warning over heating lamp detected failure counter increment" VALUE 0xa0021ad8 _REC_S1VAL_20_u2 65535. _CNV_A_R_ECME_LINEA_0_CM 0. 65535. FORMAT "%5.0" /end CHARACTERISTIC
/begin CHARACTERISTIC Cxx_dft_lght_off_tco_thd "offset for switching off the alert temperature lamp" VALUE 0xa0021ada _REC_S1VAL_20_u2 240. _CNV_A_R_LINEAR_____110_CM -40. 200. FORMAT "%5.1" /end CHARACTERISTIC
/begin CHARACTERISTIC Cxx_dft_lght_on_tco_thd "offset for switching ON the alert temperature lamp" VALUE 0xa0021adc _REC_S1VAL_20_u2 240. _CNV_A_R_LINEAR_____110_CM -40. 200. FORMAT "%5.1" /end CHARACTERISTIC
/begin CHARACTERISTIC Cxx_tsta_dft_lght_off_tco_thd "offset for switching off the alert temperature lamp, in HIGH temperature mode." VALUE 0xa0021ade _REC_S1VAL_20_u2 240. _CNV_A_R_LINEAR_____110_CM -40. 200. FORMAT "%5.1" /end CHARACTERISTIC
/begin CHARACTERISTIC Cxx_tsta_dft_lght_on_tco_thd "offset for switching ON the alert temperature lamp, in HIGH temperature mode." VALUE 0xa0021ae0 _REC_S1VAL_20_u2 240. _CNV_A_R_LINEAR_____110_CM -40. 200. FORMAT "%5.1" /end CHARACTERISTIC
/begin AXIS_PTS Ctb_tco_sp "Bkpt of Water temperature setpoint table." 0xa002f0a0 Vxx_tco_sp _REC_A2AXS_20_u2 240. _CNV_A_R_LINEAR_____110_CM 7 -40. 200. FORMAT "%5.1" /end AXIS_PTS
/begin CHARACTERISTIC Ctd_tco_7 "Water temperature set point indicator." CURVE 0xa0021b00 _REC_A1CUR_20_u1_u2 6. _CNV_A_R_ECME_LINEA_0_CM 0. 6. FORMAT "%1.0"
 /begin AXIS_DESCR COM_AXIS Vxx_tco_sp _CNV_A_R_LINEAR_____110_CM 7 -40. 200. FORMAT "%5.1" AXIS_PTS_REF Ctb_tco_sp /end AXIS_DESCR
/end CHARACTERISTIC
/begin MEASUREMENT Vbx_tsta_ip_trs_l_mux "Boolean of changing mode for Information panel (delayed when changing from High temperature to Low temperature mode)" UBYTE _CNV_S_2_RANGE______3_CM 1 0. 0. 1. ECU_ADDRESS 0xd0007c5e BIT_MASK 0x1 /end MEASUREMENT
/begin MEASUREMENT Vxx_tco_sp_mux "Water temperature set point for controlled thermostat on MUX" UBYTE _CNV_A_R_ECME_LINEA_0_CM 1 0. 0. 7. ECU_ADDRESS 0xd0007c5f FORMAT "%1.0" /end MEASUREMENT
/begin MEASUREMENT Vbx_thpl_is_acel "Thermoplunger idle speed setpoint acceleration request" UBYTE _CNV_S_2_RANGE______3_CM 1 0. 0. 1. ECU_ADDRESS 0xd0007c55 BIT_MASK 0x1 /end MEASUREMENT
/begin MEASUREMENT Vbx_wpmp_tcr "Turbo water cooling pump command before monitool" UBYTE _CNV_S_2_RANGE______3_CM 1 0. 0. 1. ECU_ADDRESS 0xd0007c59 BIT_MASK 0x1 /end MEASUREMENT
/begin MEASUREMENT Vbx_wpmp_tcr_cmd "Turbo water cooling pump command" UBYTE _CNV_S_2_RANGE______3_CM 1 0. 0. 1. ECU_ADDRESS 0xd0007c5a BIT_MASK 0x1 /end MEASUREMENT
/begin MEASUREMENT Vbx_wpmp_tcr_pws "Boolean to maintain the water pump ECU power supply" UBYTE _CNV_S_2_RANGE______3_CM 1 0. 0. 1. ECU_ADDRESS 0xd0007c5b BIT_MASK 0x1 /end MEASUREMENT
/begin MEASUREMENT Vbx_wpmp_tcr_stop "Mémorization of turbo water pump" UBYTE _CNV_S_2_RANGE______3_CM 1 0. 0. 1. ECU_ADDRESS 0xd0007c5c BIT_MASK 0x1 /end MEASUREMENT
/begin MEASUREMENT Vsx_wpmp_tcr "State variable for SF state machine" UBYTE _CNV_A_R_ECME_LINEA_0_CM 1 0. 0. 255. ECU_ADDRESS 0xd0007c5d FORMAT "%3.0" /end MEASUREMENT
/begin MEASUREMENT Vxx_wpmp_tco_tcr_dly "Water temperature monitoring to command turbo water pump" UWORD _CNV_A_R_LINEAR_____58_CM 1 0. 0. 6553.5 ECU_ADDRESS 0xd0005fc0 FORMAT "%6.1" /end MEASUREMENT
/begin MEASUREMENT Vxx_wpmp_tcr_dly "Turbo water pump delay command" UWORD _CNV_A_R_LINEAR_____58_CM 1 0. 0. 6553.5 ECU_ADDRESS 0xd0005fc2 FORMAT "%6.1" /end MEASUREMENT
/begin CHARACTERISTIC Cxx_dfdec_wpmp_tcr_blk "ou_clo_coo_paotxxx/unable to move the component to the commanded position of turbo water pump detected failure counter" VALUE 0xa0021ae8 _REC_S1VAL_20_u2 65535. _CNV_A_R_ECME_LINEA_0_CM 0. 65535. FORMAT "%5.0" /end CHARACTERISTIC
/begin CHARACTERISTIC Cxx_dfdec_wpmp_tcr_oc "ou_clo_coo_paotxxx/Circuit Open of turbo water pump detected failure counter decrement" VALUE 0xa0021aea _REC_S1VAL_20_u2 65535. _CNV_A_R_ECME_LINEA_0_CM 0. 65535. FORMAT "%5.0" /end CHARACTERISTIC
/begin CHARACTERISTIC Cxx_dfdec_wpmp_tcr_scg "ou_clo_coo_paotxxx/Circuit Short to Ground of turbo water pump detected failure counter decrement" VALUE 0xa0021aec _REC_S1VAL_20_u2 65535. _CNV_A_R_ECME_LINEA_0_CM 0. 65535. FORMAT "%5.0" /end CHARACTERISTIC
/begin CHARACTERISTIC Cxx_dfdec_wpmp_tcr_scw "ou_clo_coo_paotxxx/Circuit Short to Battery of turbo water pump detected failure counter decrement" VALUE 0xa0021aee _REC_S1VAL_20_u2 65535. _CNV_A_R_ECME_LINEA_0_CM 0. 65535. FORMAT "%5.0" /end CHARACTERISTIC
/begin CHARACTERISTIC Cxx_dfinc_wpmp_tcr_blk "ou_clo_coo_paotxxx/Unable to move the component to the commanded position of turbo water pump detected failure counter" VALUE 0xa0021af0 _REC_S1VAL_20_u2 65535. _CNV_A_R_ECME_LINEA_0_CM 0. 65535. FORMAT "%5.0" /end CHARACTERISTIC
/begin CHARACTERISTIC Cxx_dfinc_wpmp_tcr_oc "ou_clo_coo_paotxxx/Circuit Open of turbo water pump detected failure counter increment" VALUE 0xa0021af2 _REC_S1VAL_20_u2 65535. _CNV_A_R_ECME_LINEA_0_CM 0. 65535. FORMAT "%5.0" /end CHARACTERISTIC
/begin CHARACTERISTIC Cxx_dfinc_wpmp_tcr_scg "ou_clo_coo_paotxxx/Circuit Short to Ground of turbo water pump detected failure counter increment" VALUE 0xa0021af4 _REC_S1VAL_20_u2 65535. _CNV_A_R_ECME_LINEA_0_CM 0. 65535. FORMAT "%5.0" /end CHARACTERISTIC
/begin CHARACTERISTIC Cxx_dfinc_wpmp_tcr_scw "ou_clo_coo_paotxxx/Circuit Short to Battery of turbo water pump detected failure counter increment" VALUE 0xa0021af6 _REC_S1VAL_20_u2 65535. _CNV_A_R_ECME_LINEA_0_CM 0. 65535. FORMAT "%5.0" /end CHARACTERISTIC
/begin CHARACTERISTIC Cxx_wpmp_tcr_max_t "Max duration of pump command" VALUE 0xa0021af8 _REC_S1VAL_20_u2 6553.5 _CNV_A_R_LINEAR_____58_CM 0. 6553.5 FORMAT "%6.1" /end CHARACTERISTIC
/begin CHARACTERISTIC Cxx_wpmp_tcr_max_tco_t "Max duration of water cooling monitoring" VALUE 0xa0021afa _REC_S1VAL_20_u2 6553.5 _CNV_A_R_LINEAR_____58_CM 0. 6553.5 FORMAT "%6.1" /end CHARACTERISTIC
/begin CHARACTERISTIC Cxx_wpmp_tcr_tco_hys "hysteresis for water temperarute monitoring" VALUE 0xa0021afc _REC_S1VAL_20_u2 240. _CNV_A_R_LINEAR_____110_CM -40. 200. FORMAT "%5.1" /end CHARACTERISTIC
/begin CHARACTERISTIC Cxx_wpmp_tcr_tco_thd "Water temperarute threshold monitoring" VALUE 0xa0021afe _REC_S1VAL_20_u2 240. _CNV_A_R_LINEAR_____110_CM -40. 200. FORMAT "%5.1" /end CHARACTERISTIC
/begin AXIS_PTS Ctb_it_psn "9 breakpoint table for the throttle position" 0xa0024d58 Vxx_fil1_it_psn_sp _REC_A2AXS_20_u2 200. _CNV_A_R_LINEAR_____146_CM 9 0. 200. FORMAT "%12.8" /end AXIS_PTS
/begin AXIS_PTS Ctb_spg_ar_maf_fac "9 breakpoint table of surfacic mass air flow" 0xa0024d6c Vxx_spg_ar_maf_fac _REC_A2AXS_20_u2 6.24990463256836e-002 _CNV_A_R_LINEAR_____375_CM 9 0. 6.24990463256836e-002 FORMAT "%7.6" /end AXIS_PTS
/begin CHARACTERISTIC Cmp_spg_sp_it_mod "Boost pressure setpoint in \"throttle and revs\" mode" MAP 0xa0024d80 _REC_A1MAP_20_u2_u2_u2 20000. _CNV_A_R_LINEAR_____115_CM 0. 20000. FORMAT "%5.0"
 /begin AXIS_DESCR COM_AXIS Vxx_n _CNV_A_R_ENSD_LINEA_22_CM 9 0. 16383.75 FORMAT "%8.2" AXIS_PTS_REF Ctb_n2 /end AXIS_DESCR
 /begin AXIS_DESCR COM_AXIS Vxx_fil1_it_psn_sp _CNV_A_R_LINEAR_____146_CM 9 0. 200. FORMAT "%12.8" AXIS_PTS_REF Ctb_it_psn /end AXIS_DESCR
/end CHARACTERISTIC
/begin CHARACTERISTIC Ctp_inv_prs_rat "Table giving upstream/downstream pressure ratio depending on surfacic mass air flow ratio" CURVE 0xa0024e24 _REC_A1CUR_20_u1_u2 0.2490234375 _CNV_A_R_LINEAR_____376_CM 1. 1.2490234375 FORMAT "%4.2"
 /begin AXIS_DESCR COM_AXIS Vxx_spg_ar_maf_fac _CNV_A_R_LINEAR_____375_CM 9 0. 6.24990463256836e-002 FORMAT "%7.6" AXIS_PTS_REF Ctb_spg_ar_maf_fac /end AXIS_DESCR
/end CHARACTERISTIC
/begin CHARACTERISTIC Ctp_spg_max_grd "Max increasing speed for boost pressure" CURVE 0xa0024e30 _REC_A1CUR_20_u2_u2 999960.9375 _CNV_A_R_LINEAR_____377_CM 0. 999960.9375 FORMAT "%11.5"
 /begin AXIS_DESCR COM_AXIS Vxx_n _CNV_A_R_ENSD_LINEA_22_CM 9 0. 16383.75 FORMAT "%8.2" AXIS_PTS_REF Ctb_n2 /end AXIS_DESCR
/end CHARACTERISTIC
/begin MEASUREMENT Vxx_spg_ar_maf_fac "Surfacic mass air flow used for load losses of the throttle." UWORD _CNV_A_R_LINEAR_____375_CM 1 0. 0. 6.24990463256836e-002 ECU_ADDRESS 0xd0003de6 FORMAT "%7.6" /end MEASUREMENT
/begin MEASUREMENT Vxx_spg_fil_spg_prs_sp "Boost pressure setpoint" UWORD _CNV_A_R_LINEAR_____115_CM 1 0. 0. 20000. ECU_ADDRESS 0xd0003de8 FORMAT "%5.0" /end MEASUREMENT
/begin MEASUREMENT Vxx_spg_prs_sp "Raw boost pressure setpoint" UWORD _CNV_A_R_LINEAR_____115_CM 1 0. 0. 20000. ECU_ADDRESS 0xd0003dea FORMAT "%5.0" /end MEASUREMENT
/begin CHARACTERISTIC Cbx_spg_reg_cfm "Strategy choice : torque (1) or throttle & revs (0)" VALUE 0xa0020c4c _REC_S1VAL_20_u1 1. _CNV_A_R_ECME_LINEA_0_CM 0. 1. FORMAT "%1.0" BIT_MASK 0x1 /end CHARACTERISTIC
/begin CHARACTERISTIC Cxx_spg_max_prs_dif "Maximum load loss on throttle measured" VALUE 0xa0020c4a _REC_S1VAL_20_u2 20000. _CNV_A_R_LINEAR_____115_CM 0. 20000. FORMAT "%5.0" /end CHARACTERISTIC
/begin MEASUREMENT Vxx_lbdw_hot_obd_crt_mv_rtn "Backup value of the heater current diagnosis criterion" UWORD _CNV_A_R_LINEAR_____289_CM 1 0. 0. 5.5 DISPLAY_IDENTIFIER OuAtoDlo_NVM.Vxx_lbdw_hot_obd_crt_mv_rtn_NVM ECU_ADDRESS 0xd000462a FORMAT "%6.4" /end MEASUREMENT
/begin MEASUREMENT Vxx_lbdw_hot_obd_crt_thd_rtn "Backup value of the heater current failure threshold" UWORD _CNV_A_R_LINEAR_____289_CM 1 0. 0. 5.5 DISPLAY_IDENTIFIER OuAtoDlo_NVM.Vxx_lbdw_hot_obd_crt_thd_rtn_NVM ECU_ADDRESS 0xd000462c FORMAT "%6.4" /end MEASUREMENT
/begin AXIS_PTS Ctb_n_lbdw_hot_dsb "Breakpoint table depending on manifold presure to inhibit the heater" 0xa002ef0c Vxx_n _REC_A2AXS_20_u2 16383.75 _CNV_A_R_ENSD_LINEA_22_CM 9 0. 16383.75 FORMAT "%8.2" /end AXIS_PTS
/begin AXIS_PTS Ctb_t_lbdw_hot_rest "Breakpoint table for the restart strategy" 0xa0021964 Vxx_lbdw_hot_t _REC_A2AXS_20_u2 65535. _CNV_A_R_LINEAR_____68_CM 3 0. 65535. FORMAT "%5.0" /end AXIS_PTS
/begin AXIS_PTS Ctb_t_lbdw_hot_sta "Breakpoint table for the start strategy" 0xa002196c Vxx_lbdw_hot_t _REC_A2AXS_20_u2 65535. _CNV_A_R_LINEAR_____68_CM 3 0. 65535. FORMAT "%5.0" /end AXIS_PTS
/begin AXIS_PTS Ctb_tco_lbdw_hot_dly "Breakpoint for number of TDC necessary to switch the heater on" 0xa002ef20 Vxx_tco _REC_A2AXS_20_u2 240. _CNV_A_R_LINEAR_____110_CM 9 -40. 200. FORMAT "%5.1" /end AXIS_PTS
/begin CHARACTERISTIC Ctd_t_rat_lbdw_rest "Upstream PWM map values for restart strategy" CURVE 0xa0021974 _REC_A1CUR_20_u1_u2 100. _CNV_A_R_LINEAR_____165_CM 0. 100. FORMAT "%12.8"
 /begin AXIS_DESCR COM_AXIS Vxx_lbdw_hot_t _CNV_A_R_LINEAR_____68_CM 3 0. 65535. FORMAT "%5.0" AXIS_PTS_REF Ctb_t_lbdw_hot_rest /end AXIS_DESCR
/end CHARACTERISTIC
/begin CHARACTERISTIC Ctd_t_rat_lbdw_sta "Upstream PWM map values for start strategy" CURVE 0xa0021978 _REC_A1CUR_20_u1_u2 100. _CNV_A_R_LINEAR_____165_CM 0. 100. FORMAT "%12.8"
 /begin AXIS_DESCR COM_AXIS Vxx_lbdw_hot_t _CNV_A_R_LINEAR_____68_CM 3 0. 65535. FORMAT "%5.0" AXIS_PTS_REF Ctb_t_lbdw_hot_sta /end AXIS_DESCR
/end CHARACTERISTIC
/begin CHARACTERISTIC Ctp_n_lbdw_hot_dsb_map "Maximum manifold pressure to inhibit the heater power" CURVE 0xa002ef34 _REC_A1CUR_20_u2_u2 20000. _CNV_A_R_LINEAR_____115_CM 0. 20000. FORMAT "%5.0"
 /begin AXIS_DESCR COM_AXIS Vxx_n _CNV_A_R_ENSD_LINEA_22_CM 9 0. 16383.75 FORMAT "%8.2" AXIS_PTS_REF Ctb_n_lbdw_hot_dsb /end AXIS_DESCR
/end CHARACTERISTIC
/begin CHARACTERISTIC Ctp_tco_lbdw_hot_dly "Number of TDC before applying the heater power" CURVE 0xa002ef48 _REC_A1CUR_20_u2_u2 65535. _CNV_A_R_LINEAR_____101_CM 0. 65535. FORMAT "%5.0"
 /begin AXIS_DESCR COM_AXIS Vxx_tco _CNV_A_R_LINEAR_____110_CM 9 -40. 200. FORMAT "%5.1" AXIS_PTS_REF Ctb_tco_lbdw_hot_dly /end AXIS_DESCR
/end CHARACTERISTIC
/begin MEASUREMENT Vbx_aut_eng_lbdw_hot "Engine state : 1=autonomous engine, 0=other states" UBYTE _CNV_S_2_RANGE______3_CM 1 0. 0. 1. ECU_ADDRESS 0xd0006e80 BIT_MASK 0x1 /end MEASUREMENT
/begin MEASUREMENT Vbx_lbdw_hot_cmd "Heater power command" UBYTE _CNV_S_2_RANGE______3_CM 1 0. 0. 1. ECU_ADDRESS 0xd0006e81 BIT_MASK 0x1 /end MEASUREMENT
/begin MEASUREMENT Vbx_lbdw_hot_cmd_stt "State of the heater power command (temporary variable)" UBYTE _CNV_S_2_RANGE______3_CM 1 0. 0. 1. ECU_ADDRESS 0xd0006e82 BIT_MASK 0x1 /end MEASUREMENT
/begin MEASUREMENT Vbx_lbdw_hot_cmd_stt_sf "State of the heater power command (temporary variable) in state flow chart" UBYTE _CNV_S_2_RANGE______3_CM 1 0. 0. 1. ECU_ADDRESS 0xd0006e83 BIT_MASK 0x1 /end MEASUREMENT
/begin MEASUREMENT Vbx_lbdw_hot_t_rest "Reset of the hot time counter" UBYTE _CNV_S_2_RANGE______3_CM 1 0. 0. 1. ECU_ADDRESS 0xd0007c33 BIT_MASK 0x1 /end MEASUREMENT
/begin MEASUREMENT Vxx_lbdw_appl_pwm "PWM value apply to the sensor" UBYTE _CNV_A_R_LINEAR_____165_CM 1 0. 0. 100. ECU_ADDRESS 0xd0006e84 FORMAT "%12.8" /end MEASUREMENT
/begin MEASUREMENT Vxx_lbdw_clc_pwm "PWM value corrected with the battery voltage" UBYTE _CNV_A_R_LINEAR_____165_CM 1 0. 0. 100. ECU_ADDRESS 0xd0007c34 FORMAT "%12.8" /end MEASUREMENT
/begin MEASUREMENT Vxx_lbdw_dly_rest_t "Timer use to control the heater restart command under power latch" UWORD _CNV_A_R_LINEAR_____68_CM 1 0. 0. 65535. ECU_ADDRESS 0xd0005f96 FORMAT "%5.0" /end MEASUREMENT
/begin MEASUREMENT Vxx_lbdw_hot_dly_ctr "Time expected to swith on the heating of the downstream sensor" UWORD _CNV_A_R_LINEAR_____101_CM 1 0. 0. 65535. ECU_ADDRESS 0xd000462e FORMAT "%5.0" /end MEASUREMENT
/begin MEASUREMENT Vxx_lbdw_hot_rest_stt "Progress  in the heater strategy : 0=cold sensor 1=start strategy applied 2=restart" UBYTE _CNV_A_R_ECME_LINEA_0_CM 1 0. 0. 2. ECU_ADDRESS 0xd0007c35 FORMAT "%1.0" /end MEASUREMENT
/begin MEASUREMENT Vxx_lbdw_hot_t "Timer for heating period" UWORD _CNV_A_R_LINEAR_____68_CM 1 0. 0. 65535. ECU_ADDRESS 0xd0005f98 FORMAT "%5.0" /end MEASUREMENT
/begin MEASUREMENT Vxx_lbdw_hot_t_prev "Timer for the heating period (previous value)" UWORD _CNV_A_R_LINEAR_____68_CM 1 0. 0. 65535. ECU_ADDRESS 0xd0005f9a FORMAT "%5.0" /end MEASUREMENT
/begin MEASUREMENT Vxx_lbdw_pwm_ctr "Timer for PWM generation" UBYTE _CNV_A_R_ECME_LINEA_0_CM 1 0. 0. 255. ECU_ADDRESS 0xd0006e85 FORMAT "%3.0" /end MEASUREMENT
/begin MEASUREMENT Vxx_lbdw_ref_pwm "PWM heater value advised by the sensor supplier" UBYTE _CNV_A_R_LINEAR_____165_CM 1 0. 0. 100. ECU_ADDRESS 0xd0007c36 FORMAT "%12.8" /end MEASUREMENT
/begin MEASUREMENT Vxx_lbdw_ref_pwm_sf "PWM heater value advised by the sensor supplier in state flow chart" UBYTE _CNV_A_R_LINEAR_____165_CM 1 0. 0. 100. ECU_ADDRESS 0xd0007c37 FORMAT "%12.8" /end MEASUREMENT
/begin MEASUREMENT Vxx_lbdw_tco "Water temperature to use for dewpoint value" UWORD _CNV_A_R_LINEAR_____110_CM 1 0. -40. 200. ECU_ADDRESS 0xd0005f9c FORMAT "%5.1" /end MEASUREMENT
/begin MEASUREMENT Vxx_lbdw_tco_sta_mem "Water temperature memorization" UWORD _CNV_A_R_LINEAR_____110_CM 1 0. -40. 200. ECU_ADDRESS 0xd0005f9e FORMAT "%5.1" /end MEASUREMENT
/begin MEASUREMENT Vxx_n_lbdw_hot_dsb_map "Maximum manifold pressure to inhibit the heater power" UWORD _CNV_A_R_LINEAR_____115_CM 1 0. 0. 20000. ECU_ADDRESS 0xd0005fa0 FORMAT "%5.0" /end MEASUREMENT
/begin MEASUREMENT Vxx_t_lbdw_hot_sta "Variable for the breakpoint table for the start strategy" UWORD _CNV_A_R_LINEAR_____68_CM 1 0. 0. 65535. ECU_ADDRESS 0xd0005fa2 FORMAT "%5.0" /end MEASUREMENT
/begin MEASUREMENT Vxx_t_rat_lbdw_rest "Downstream PWM map values for restart strategy" UBYTE _CNV_A_R_LINEAR_____165_CM 1 0. 0. 100. ECU_ADDRESS 0xd0005fa4 FORMAT "%12.8" /end MEASUREMENT
/begin MEASUREMENT Vxx_t_rat_lbdw_sta "Downstream PWM map values for start strategy" UBYTE _CNV_A_R_LINEAR_____165_CM 1 0. 0. 100. ECU_ADDRESS 0xd0005fa5 FORMAT "%12.8" /end MEASUREMENT
/begin CHARACTERISTIC Cbx_lbdw_dwpt_per_ena "Activation of the dew point strategy for the upstream sensor" VALUE 0xa0021984 _REC_S1VAL_20_u1 1. _CNV_A_R_ECME_LINEA_0_CM 0. 1. FORMAT "%1.0" BIT_MASK 0x1 /end CHARACTERISTIC
/begin CHARACTERISTIC Cbx_lbdw_tco_sta_mem "Activation of the water temperature memorization" VALUE 0xa0021985 _REC_S1VAL_20_u1 1. _CNV_A_R_ECME_LINEA_0_CM 0. 1. FORMAT "%1.0" BIT_MASK 0x1 /end CHARACTERISTIC
/begin CHARACTERISTIC Cxx_lbdw_cold_sta_rat "PWM before dewpoint detection (cold start)" VALUE 0xa0021986 _REC_S1VAL_20_u1 100. _CNV_A_R_LINEAR_____165_CM 0. 100. FORMAT "%12.8" /end CHARACTERISTIC
/begin CHARACTERISTIC Cxx_lbdw_dft_pwm "PWM use in case of battery failure" VALUE 0xa0021987 _REC_S1VAL_20_u1 100. _CNV_A_R_LINEAR_____165_CM 0. 100. FORMAT "%12.8" /end CHARACTERISTIC
/begin CHARACTERISTIC Cxx_lbdw_dly_rest_t "Time necessary to concider the sensor warm or cold (under power latch)" VALUE 0xa002197c _REC_S1VAL_20_u2 65535. _CNV_A_R_LINEAR_____68_CM 0. 65535. FORMAT "%5.0" /end CHARACTERISTIC
/begin CHARACTERISTIC Cxx_lbdw_hot_cmd_map_hys "Maximum pressure value to switch on again the heater (hysteresis)" VALUE 0xa002197e _REC_S1VAL_20_u2 20000. _CNV_A_R_LINEAR_____115_CM 0. 20000. FORMAT "%5.0" /end CHARACTERISTIC
/begin CHARACTERISTIC Cxx_lbdw_hot_cmd_vs_hys "Maximum speed vehicule to switch on again the heater (hysteresis)" VALUE 0xa0021988 _REC_S1VAL_20_u1 255. _CNV_A_R_LINEAR_____71_CM 0. 255. FORMAT "%3.0" /end CHARACTERISTIC
/begin CHARACTERISTIC Cxx_lbdw_hot_dsb_vs "Maximum vehicule speed to heat the sensor" VALUE 0xa0021989 _REC_S1VAL_20_u1 255. _CNV_A_R_LINEAR_____71_CM 0. 255. FORMAT "%3.0" /end CHARACTERISTIC
/begin CHARACTERISTIC Cxx_lbdw_hot_sta_end "Time necessary to concider a hot sensor" VALUE 0xa0021980 _REC_S1VAL_20_u2 65535. _CNV_A_R_LINEAR_____68_CM 0. 65535. FORMAT "%5.0" /end CHARACTERISTIC
/begin CHARACTERISTIC Cxx_lbdw_rms_v "Effective voltage recommanded by the sensor supplyer" VALUE 0xa002198a _REC_S1VAL_20_u1 255. _CNV_A_R_LINEAR_____378_CM 0. 255. FORMAT "%3.0" /end CHARACTERISTIC
/begin CHARACTERISTIC Cxx_lbdw_tco_rest_thd "Tco threshold activating the hot restart strategy" VALUE 0xa0021982 _REC_S1VAL_20_u2 240. _CNV_A_R_LINEAR_____110_CM -40. 200. FORMAT "%5.1" /end CHARACTERISTIC
/begin MEASUREMENT Vsx_lbdw_hot_vld "Rear oxygen heating validity status" UBYTE _CNV_S_3_STATUS_OK__179_CM 1 0. 0. 2. ECU_ADDRESS 0xd0007c30 /end MEASUREMENT
/begin CHARACTERISTIC Cxx_dfdec_lbdw_hot_oc "Downstream lambda sensor heating Open circuit diagnostic detected failure counter decrement" VALUE 0xa0021956 _REC_S1VAL_20_u2 65535. _CNV_A_R_ECME_LINEA_0_CM 0. 65535. FORMAT "%5.0" /end CHARACTERISTIC
/begin CHARACTERISTIC Cxx_dfdec_lbdw_hot_scg "Downstream lambda sensor heating Short circuit to ground diagnostic detected failure counter decrement" VALUE 0xa0021958 _REC_S1VAL_20_u2 65535. _CNV_A_R_ECME_LINEA_0_CM 0. 65535. FORMAT "%5.0" /end CHARACTERISTIC
/begin CHARACTERISTIC Cxx_dfdec_lbdw_hot_scw "Downstream lambda sensor heating Short circuit at battery + diagnostic detected failure counter decrement" VALUE 0xa002195a _REC_S1VAL_20_u2 65535. _CNV_A_R_ECME_LINEA_0_CM 0. 65535. FORMAT "%5.0" /end CHARACTERISTIC
/begin CHARACTERISTIC Cxx_dfinc_lbdw_hot_oc "Downstream lambda sensor heating Open circuit diagnostic detected failure counter increment" VALUE 0xa002195c _REC_S1VAL_20_u2 65535. _CNV_A_R_ECME_LINEA_0_CM 0. 65535. FORMAT "%5.0" /end CHARACTERISTIC
/begin CHARACTERISTIC Cxx_dfinc_lbdw_hot_scg "Downstream lambda sensor heating Short circuit to ground diagnostic detected failure counter increment" VALUE 0xa002195e _REC_S1VAL_20_u2 65535. _CNV_A_R_ECME_LINEA_0_CM 0. 65535. FORMAT "%5.0" /end CHARACTERISTIC
/begin CHARACTERISTIC Cxx_dfinc_lbdw_hot_scw "Downstream lambda sensor heating Short circuit at battery + diagnostic detected failure counter increment" VALUE 0xa0021960 _REC_S1VAL_20_u2 65535. _CNV_A_R_ECME_LINEA_0_CM 0. 65535. FORMAT "%5.0" /end CHARACTERISTIC
/begin MEASUREMENT Vbx_df_lbdw_hot_dirt_lkg "Rear oxygen sensor heater fct performance diagnosis detected failure" UBYTE _CNV_S_2_RANGE______3_CM 1 0. 0. 1. ECU_ADDRESS 0xd0006e90 BIT_MASK 0x1 /end MEASUREMENT
/begin MEASUREMENT Vbx_diag_ena_lbdw_hot_dirt_lkg "Rear oxygen sensor heater fct performance diagnosis authorization" UBYTE _CNV_S_2_RANGE______3_CM 1 0. 0. 1. ECU_ADDRESS 0xd0006e91 BIT_MASK 0x1 /end MEASUREMENT
/begin MEASUREMENT Vbx_lbdw_hot_obd_cond_ok "Logic indicating if diagnosis conditions are satisfied" UBYTE _CNV_S_2_RANGE______3_CM 1 0. 0. 1. ECU_ADDRESS 0xd0006e92 BIT_MASK 0x1 /end MEASUREMENT
/begin MEASUREMENT Vbx_lbdw_hot_obd_diag_stop "Logic indicating if the test is complete" UBYTE _CNV_S_2_RANGE______3_CM 1 0. 0. 1. ECU_ADDRESS 0xd0006e93 BIT_MASK 0x1 /end MEASUREMENT
/begin MEASUREMENT Vbx_lbdw_hot_obd_inhi_cond "Inhibition conditions for lambda heating diagnosis" UBYTE _CNV_S_2_RANGE______3_CM 1 0. 0. 1. ECU_ADDRESS 0xd0006e94 BIT_MASK 0x1 /end MEASUREMENT
/begin MEASUREMENT Vbx_lbdw_hot_obd_mes "Logic indicating if the measure is complete" UBYTE _CNV_S_2_RANGE______3_CM 1 0. 0. 1. ECU_ADDRESS 0xd0006e95 BIT_MASK 0x1 /end MEASUREMENT
/begin MEASUREMENT Vbx_lbdw_hot_obd_phy_cond "Physical conditions for lambda heating diagnosis" UBYTE _CNV_S_2_RANGE______3_CM 1 0. 0. 1. ECU_ADDRESS 0xd0006e96 BIT_MASK 0x1 /end MEASUREMENT
/begin MEASUREMENT Vbx_lbdw_hot_obd_sw_cond "Software conditions for lambda heating diagnosis" UBYTE _CNV_S_2_RANGE______3_CM 1 0. 0. 1. ECU_ADDRESS 0xd0006e97 BIT_MASK 0x1 /end MEASUREMENT
/begin MEASUREMENT Vsx_lbdw_hot_obd_stt "Downstream Lambda Sensor heater OBD system status" UBYTE _CNV_S_5_RANGE_STAT_379_CM 1 0. 1. 5. ECU_ADDRESS 0xd0006e98 /end MEASUREMENT
/begin MEASUREMENT Vxx_lbdw_hot_obd_acq_nr "Number of acquisitions in a window" UWORD _CNV_A_R_ECME_LINEA_0_CM 1 0. 0. 65535. ECU_ADDRESS 0xd0004632 FORMAT "%5.0" /end MEASUREMENT
/begin MEASUREMENT Vxx_lbdw_hot_obd_acq_win_nr "Number of acquisition windows in the test" UBYTE _CNV_A_R_ECME_LINEA_0_CM 1 0. 0. 255. ECU_ADDRESS 0xd0006e99 FORMAT "%3.0" /end MEASUREMENT
/begin MEASUREMENT Vxx_lbdw_hot_obd_crt_mv "Mean value of heater current in a window" UWORD _CNV_A_R_LINEAR_____289_CM 1 0. 0. 5.5 ECU_ADDRESS 0xd0004634 FORMAT "%6.4" /end MEASUREMENT
/begin MEASUREMENT Vxx_lbdw_hot_obd_crt_mv_tot "Mean value of heater current in the whole test" UWORD _CNV_A_R_LINEAR_____289_CM 1 0. 0. 5.5 ECU_ADDRESS 0xd0004636 FORMAT "%6.4" /end MEASUREMENT
/begin MEASUREMENT Vxx_lbdw_hot_obd_lgl_dly "Duration before diagnosis enabled" UWORD _CNV_A_R_LINEAR_____58_CM 1 0. 0. 6553.5 ECU_ADDRESS 0xd0004638 FORMAT "%6.1" /end MEASUREMENT
/begin MEASUREMENT Vxx_lbdw_hot_obd_stab_dly "Duration the diagnosis conditions must be kept before test is enabled" UBYTE _CNV_A_R_LINEAR_____58_CM 1 0. 0. 25.5 ECU_ADDRESS 0xd0006e9a FORMAT "%4.1" /end MEASUREMENT
/begin MEASUREMENT Vxx_lbdw_hot_obd_win_dfctr "Number of acquisition windows where the mean value of heater current is faulty" UBYTE _CNV_A_R_ECME_LINEA_0_CM 1 0. 0. 255. ECU_ADDRESS 0xd0006e9b FORMAT "%3.0" /end MEASUREMENT
/begin CHARACTERISTIC Cxx_dfdec_lbdw_hot_dirt_lkg "Rear oxygen sensor heater fct performance detected failure counter decrement" VALUE 0xa002198c _REC_S1VAL_20_u2 65535. _CNV_A_R_ECME_LINEA_0_CM 0. 65535. FORMAT "%5.0" /end CHARACTERISTIC
/begin CHARACTERISTIC Cxx_dfinc_lbdw_hot_dirt_lkg "Rear oxygen sensor heater fct performance detected failure counter increment" VALUE 0xa002198e _REC_S1VAL_20_u2 65535. _CNV_A_R_ECME_LINEA_0_CM 0. 65535. FORMAT "%5.0" /end CHARACTERISTIC
/begin CHARACTERISTIC Cxx_lbdw_hot_obd_acq_nr_min "Minimum number of acquisitions in a window" VALUE 0xa0021990 _REC_S1VAL_20_u2 65535. _CNV_A_R_ECME_LINEA_0_CM 0. 65535. FORMAT "%5.0" /end CHARACTERISTIC
/begin CHARACTERISTIC Cxx_lbdw_hot_obd_acq_win_nr "Number of acquisition windows in the test" VALUE 0xa0021998 _REC_S1VAL_20_u1 255. _CNV_A_R_ECME_LINEA_0_CM 0. 255. FORMAT "%3.0" /end CHARACTERISTIC
/begin CHARACTERISTIC Cxx_lbdw_hot_obd_crt_thd "Lambda heater current failure threshold" VALUE 0xa0021992 _REC_S1VAL_20_u2 5.5 _CNV_A_R_LINEAR_____289_CM 0. 5.5 FORMAT "%6.4" /end CHARACTERISTIC
/begin CHARACTERISTIC Cxx_lbdw_hot_obd_lgl_dly "Duration before diagnosis enabled" VALUE 0xa0021994 _REC_S1VAL_20_u2 6553.5 _CNV_A_R_LINEAR_____58_CM 0. 6553.5 FORMAT "%6.1" /end CHARACTERISTIC
/begin CHARACTERISTIC Cxx_lbdw_hot_obd_stab_dly "Duration the diagnosis conditions must be kept before the test is enabled" VALUE 0xa0021999 _REC_S1VAL_20_u1 25.5 _CNV_A_R_LINEAR_____58_CM 0. 25.5 FORMAT "%4.1" /end CHARACTERISTIC
/begin CHARACTERISTIC Cxx_lbdw_hot_obd_tco_min "Minimum value of engine coolant temperature for the diagnosis to enable" VALUE 0xa0021996 _REC_S1VAL_20_u2 240. _CNV_A_R_LINEAR_____110_CM -40. 200. FORMAT "%5.1" /end CHARACTERISTIC
/begin CHARACTERISTIC Ctp_tco_lbdw_hot_dly_alco "Number of TDC before applying the heater power for alcool application" CURVE 0xa002eef8 _REC_A1CUR_20_u2_u2 65535. _CNV_A_R_LINEAR_____101_CM 0. 65535. FORMAT "%5.0"
 /begin AXIS_DESCR COM_AXIS Vxx_tco _CNV_A_R_LINEAR_____110_CM 9 -40. 200. FORMAT "%5.1" AXIS_PTS_REF Ctb_tco_lbdw_hot_dly /end AXIS_DESCR
/end CHARACTERISTIC
/begin MEASUREMENT Vbx_aut_eng_lbdw_hot_alco "Engine state for alcohol dewpoint strategy : 1=autonomous engine, 0=other states" UBYTE _CNV_S_2_RANGE______3_CM 1 0. 0. 1. ECU_ADDRESS 0xd0007c2f BIT_MASK 0x1 /end MEASUREMENT
/begin MEASUREMENT Vxx_lbdw_hot_dly_ctr_alco "TDC calibration value for dewpoint detection for alcool applications" UWORD _CNV_A_R_LINEAR_____101_CM 1 0. 0. 65535. ECU_ADDRESS 0xd0005f8e FORMAT "%5.0" /end MEASUREMENT
/begin MEASUREMENT Vxx_lbdw_tco_alco "Water temperature to select dewpoint value for alcohol application" UWORD _CNV_A_R_LINEAR_____110_CM 1 0. -40. 200. ECU_ADDRESS 0xd0005f90 FORMAT "%5.1" /end MEASUREMENT
/begin MEASUREMENT Vbx_lbdw_heat_diag_cfm "Downstream lambda sensor heating is active or not" UBYTE _CNV_S_2_RANGE______3_CM 1 0. 0. 1. ECU_ADDRESS 0xd0006e9c BIT_MASK 0x1 /end MEASUREMENT
/begin CHARACTERISTIC Cbx_lbdw_heat_diag_cfm "Downstream lambda sensor heating diagnosis is active or not" VALUE 0xa002199a _REC_S1VAL_20_u1 1. _CNV_A_R_ECME_LINEA_0_CM 0. 1. FORMAT "%1.0" BIT_MASK 0x1 /end CHARACTERISTIC
/begin MEASUREMENT Vxx_lbup_hot_obd_crt_mv_rtn "Backup value of the heater current diagnosis criterion" UWORD _CNV_A_R_LINEAR_____289_CM 1 0. 0. 6.5535 DISPLAY_IDENTIFIER OuCboUlo_NVM.Vxx_lbup_hot_obd_crt_mv_rtn_NVM ECU_ADDRESS 0xd000465e FORMAT "%6.4" /end MEASUREMENT
/begin MEASUREMENT Vxx_lbup_hot_obd_crt_thd_rtn "Backup value of the heater current failure threshold" UWORD _CNV_A_R_LINEAR_____289_CM 1 0. 0. 6.5535 DISPLAY_IDENTIFIER OuCboUlo_NVM.Vxx_lbup_hot_obd_crt_thd_rtn_NVM ECU_ADDRESS 0xd0004660 FORMAT "%6.4" /end MEASUREMENT
/begin AXIS_PTS Ctb_n_lbup_hot_dsb "Breakpoint table depending on manifold presure to inhibit the heater" 0xa002f040 Vxx_n _REC_A2AXS_20_u2 16383.75 _CNV_A_R_ENSD_LINEA_22_CM 9 0. 16383.75 FORMAT "%8.2" /end AXIS_PTS
/begin AXIS_PTS Ctb_t_lbup_hot_rest "Breakpoint table for the restart strategy" 0xa0021a98 Vxx_lbup_hot_t _REC_A2AXS_20_u2 65535. _CNV_A_R_LINEAR_____68_CM 3 0. 65535. FORMAT "%5.0" /end AXIS_PTS
/begin AXIS_PTS Ctb_t_lbup_hot_sta "Breakpoint table for the start strategy" 0xa0021aa0 Vxx_lbup_hot_t _REC_A2AXS_20_u2 65535. _CNV_A_R_LINEAR_____68_CM 3 0. 65535. FORMAT "%5.0" /end AXIS_PTS
/begin AXIS_PTS Ctb_tco_lbup_hot_dly "Breakpoint for number of TDC necessary to switch the heater on" 0xa002f054 Vxx_tco _REC_A2AXS_20_u2 240. _CNV_A_R_LINEAR_____110_CM 13 -40. 200. FORMAT "%5.1" /end AXIS_PTS
/begin CHARACTERISTIC Ctd_t_rat_lbup_rest "Upstream PWM map values for restart strategy" CURVE 0xa0021aa8 _REC_A1CUR_20_u1_u2 100. _CNV_A_R_LINEAR_____165_CM 0. 100. FORMAT "%12.8"
 /begin AXIS_DESCR COM_AXIS Vxx_lbup_hot_t _CNV_A_R_LINEAR_____68_CM 3 0. 65535. FORMAT "%5.0" AXIS_PTS_REF Ctb_t_lbup_hot_rest /end AXIS_DESCR
/end CHARACTERISTIC
/begin CHARACTERISTIC Ctd_t_rat_lbup_sta "Upstream PWM map values for start strategy" CURVE 0xa0021aac _REC_A1CUR_20_u1_u2 100. _CNV_A_R_LINEAR_____165_CM 0. 100. FORMAT "%12.8"
 /begin AXIS_DESCR COM_AXIS Vxx_lbup_hot_t _CNV_A_R_LINEAR_____68_CM 3 0. 65535. FORMAT "%5.0" AXIS_PTS_REF Ctb_t_lbup_hot_sta /end AXIS_DESCR
/end CHARACTERISTIC
/begin CHARACTERISTIC Ctp_n_lbup_hot_dsb_map "Maximum manifold pressure to inhibit the heater power" CURVE 0xa002f070 _REC_A1CUR_20_u2_u2 20000. _CNV_A_R_LINEAR_____115_CM 0. 20000. FORMAT "%5.0"
 /begin AXIS_DESCR COM_AXIS Vxx_n _CNV_A_R_ENSD_LINEA_22_CM 9 0. 16383.75 FORMAT "%8.2" AXIS_PTS_REF Ctb_n_lbup_hot_dsb /end AXIS_DESCR
/end CHARACTERISTIC
/begin CHARACTERISTIC Ctp_tco_lbup_hot_dly "Number of TDC before applying the heater power" CURVE 0xa002f084 _REC_A1CUR_20_u2_u2 65535. _CNV_A_R_LINEAR_____101_CM 0. 65535. FORMAT "%5.0"
 /begin AXIS_DESCR COM_AXIS Vxx_tco _CNV_A_R_LINEAR_____110_CM 13 -40. 200. FORMAT "%5.1" AXIS_PTS_REF Ctb_tco_lbup_hot_dly /end AXIS_DESCR
/end CHARACTERISTIC
/begin MEASUREMENT Vbx_aut_eng_lbup_hot "Engine state : 1=autonomous engine, 0=other states" UBYTE _CNV_S_2_RANGE______3_CM 1 0. 0. 1. ECU_ADDRESS 0xd0006ef3 BIT_MASK 0x1 /end MEASUREMENT
/begin MEASUREMENT Vbx_lbup_hot "Boolean indicating that upstream oxygen sensor is theoricaly hot" UBYTE _CNV_S_2_RANGE______3_CM 1 0. 0. 1. ECU_ADDRESS 0xd0007c45 BIT_MASK 0x1 /end MEASUREMENT
/begin MEASUREMENT Vbx_lbup_hot_cmd "Heater power command" UBYTE _CNV_S_2_RANGE______3_CM 1 0. 0. 1. ECU_ADDRESS 0xd0006ef4 BIT_MASK 0x1 /end MEASUREMENT
/begin MEASUREMENT Vbx_lbup_hot_cmd_stt "State of the heater power command (temporary variable)" UBYTE _CNV_S_2_RANGE______3_CM 1 0. 0. 1. ECU_ADDRESS 0xd0007c46 BIT_MASK 0x1 /end MEASUREMENT
/begin MEASUREMENT Vbx_lbup_hot_cmd_stt_sf "State of the heater power command (temporary variable) in state flow chart" UBYTE _CNV_S_2_RANGE______3_CM 1 0. 0. 1. ECU_ADDRESS 0xd0007c47 BIT_MASK 0x1 /end MEASUREMENT
/begin MEASUREMENT Vxx_lbup_appl_pwm "PWM value apply to the sensor" UBYTE _CNV_A_R_LINEAR_____165_CM 1 0. 0. 100. ECU_ADDRESS 0xd0006ef5 FORMAT "%12.8" /end MEASUREMENT
/begin MEASUREMENT Vxx_lbup_clc_pwm "PWM value corrected with the battery voltage" UBYTE _CNV_A_R_LINEAR_____165_CM 1 0. 0. 100. ECU_ADDRESS 0xd0007c48 FORMAT "%12.8" /end MEASUREMENT
/begin MEASUREMENT Vxx_lbup_dly_rest_t "Timer use to control the heater restart command under power latch" UWORD _CNV_A_R_LINEAR_____68_CM 1 0. 0. 65535. ECU_ADDRESS 0xd0005fb0 FORMAT "%5.0" /end MEASUREMENT
/begin MEASUREMENT Vxx_lbup_heat_egy "Heating energy of the upstream oxygen sensor" UWORD _CNV_A_R_LINEAR_____380_CM 1 0. 0. 2399.96337890625 ECU_ADDRESS 0xd0005fb2 FORMAT "%7.2" /end MEASUREMENT
/begin MEASUREMENT Vxx_lbup_heat_egy_inc "Heating energy increment of the upstream oxygen sensor" UWORD _CNV_A_R_LINEAR_____380_CM 1 0. 0. 2399.96337890625 ECU_ADDRESS 0xd0005fb4 FORMAT "%7.2" /end MEASUREMENT
/begin MEASUREMENT Vxx_lbup_heat_raw_pow "Raw power supplied by the heater power stage for the upstream oxygen sensor" UWORD _CNV_A_R_LINEAR_____381_CM 1 0. 0. 239.996337890625 ECU_ADDRESS 0xd0005fb6 FORMAT "%7.3" /end MEASUREMENT
/begin MEASUREMENT Vxx_lbup_hot_dly_ctr "Time expected to reach the end of the dew point period for the upstream sensor" UWORD _CNV_A_R_LINEAR_____101_CM 1 0. 0. 65535. ECU_ADDRESS 0xd0004662 FORMAT "%5.0" /end MEASUREMENT
/begin MEASUREMENT Vxx_lbup_hot_rest_stt "Progress in the heater strategy : 0=cold sensor 1=start strategy applied 2=restart" UBYTE _CNV_A_R_ECME_LINEA_0_CM 1 0. 0. 2. ECU_ADDRESS 0xd0007c49 FORMAT "%1.0" /end MEASUREMENT
/begin MEASUREMENT Vxx_lbup_hot_t "Timer for the heating period" UWORD _CNV_A_R_LINEAR_____68_CM 1 0. 0. 65535. ECU_ADDRESS 0xd0005fb8 FORMAT "%5.0" /end MEASUREMENT
/begin MEASUREMENT Vxx_lbup_pwm_ctr "Timer for PWM generation" UBYTE _CNV_A_R_ECME_LINEA_0_CM 1 0. 0. 255. ECU_ADDRESS 0xd0006ef6 FORMAT "%3.0" /end MEASUREMENT
/begin MEASUREMENT Vxx_lbup_ref_pwm "PWM heater value advised by the sensor supplier" UBYTE _CNV_A_R_LINEAR_____165_CM 1 0. 0. 100. ECU_ADDRESS 0xd0007c4a FORMAT "%12.8" /end MEASUREMENT
/begin MEASUREMENT Vxx_lbup_ref_pwm_sf "PWM heater value advised by the sensor supplier in state flow chart" UBYTE _CNV_A_R_LINEAR_____165_CM 1 0. 0. 100. ECU_ADDRESS 0xd0007c4b FORMAT "%12.8" /end MEASUREMENT
/begin MEASUREMENT Vxx_n_lbup_hot_dsb_map "Maximum manifold pressure to inhibit the heater power" UWORD _CNV_A_R_LINEAR_____115_CM 1 0. 0. 20000. ECU_ADDRESS 0xd0005fba FORMAT "%5.0" /end MEASUREMENT
/begin MEASUREMENT Vxx_t_lbup_hot_sta "Time of the breakpoint table for the start strategy" UWORD _CNV_A_R_LINEAR_____68_CM 1 0. 0. 65535. ECU_ADDRESS 0xd0005fbc FORMAT "%5.0" /end MEASUREMENT
/begin MEASUREMENT Vxx_t_rat_lbup_rest "Upstream PWM map values for restart strategy" UBYTE _CNV_A_R_LINEAR_____165_CM 1 0. 0. 100. ECU_ADDRESS 0xd0007c4c FORMAT "%12.8" /end MEASUREMENT
/begin MEASUREMENT Vxx_t_rat_lbup_sta "Upstream PWM map values for start strategy" UBYTE _CNV_A_R_LINEAR_____165_CM 1 0. 0. 100. ECU_ADDRESS 0xd0007c4d FORMAT "%12.8" /end MEASUREMENT
/begin CHARACTERISTIC Cbx_lbup_dwpt_per_ena "Activation of the dew point strategy for the upstream sensor" VALUE 0xa0021abe _REC_S1VAL_20_u1 1. _CNV_A_R_ECME_LINEA_0_CM 0. 1. FORMAT "%1.0" BIT_MASK 0x1 /end CHARACTERISTIC
/begin CHARACTERISTIC Cxx_lbup_cold_sta_rat "PWM before dewpoint detection (cold start)" VALUE 0xa0021abf _REC_S1VAL_20_u1 100. _CNV_A_R_LINEAR_____165_CM 0. 100. FORMAT "%12.8" /end CHARACTERISTIC
/begin CHARACTERISTIC Cxx_lbup_dft_pwm "PWM use in case of battery failure" VALUE 0xa0021ac0 _REC_S1VAL_20_u1 100. _CNV_A_R_LINEAR_____165_CM 0. 100. FORMAT "%12.8" /end CHARACTERISTIC
/begin CHARACTERISTIC Cxx_lbup_dly_rest_t "Time necessary to concider the sensor warm or cold (under power latch)" VALUE 0xa0021ab0 _REC_S1VAL_20_u2 65534. _CNV_A_R_LINEAR_____68_CM 1. 65535. FORMAT "%5.0" /end CHARACTERISTIC
/begin CHARACTERISTIC Cxx_lbup_heat_r "Resistence of the heating circuit of the upstream oxygen sensor" VALUE 0xa0021ac1 _REC_S1VAL_20_u1 9.9609375 _CNV_A_R_LINEAR_____382_CM 0.1 10.0609375 FORMAT "%5.2" /end CHARACTERISTIC
/begin CHARACTERISTIC Cxx_lbup_hot_cmd_map_hys "Maximum pressure value to switch on again the heater (hysteresis)" VALUE 0xa0021ab2 _REC_S1VAL_20_u2 20000. _CNV_A_R_LINEAR_____115_CM 0. 20000. FORMAT "%5.0" /end CHARACTERISTIC
/begin CHARACTERISTIC Cxx_lbup_hot_cmd_vs_hys "Maximum speed vehicule to switch on again the heater (hysteresis)" VALUE 0xa0021ac2 _REC_S1VAL_20_u1 255. _CNV_A_R_LINEAR_____71_CM 0. 255. FORMAT "%3.0" /end CHARACTERISTIC
/begin CHARACTERISTIC Cxx_lbup_hot_dsb_vs "Maximum vehicule speed to heat the sensor" VALUE 0xa0021ac3 _REC_S1VAL_20_u1 255. _CNV_A_R_LINEAR_____71_CM 0. 255. FORMAT "%3.0" /end CHARACTERISTIC
/begin CHARACTERISTIC Cxx_lbup_hot_egy "Heating energy threshold over wich upstream oxygen sensor is considered as hot" VALUE 0xa0021ab4 _REC_S1VAL_20_u2 2399.96337890625 _CNV_A_R_LINEAR_____380_CM 0. 2399.96337890625 FORMAT "%7.2" /end CHARACTERISTIC
/begin CHARACTERISTIC Cxx_lbup_hot_egy_max "Maximum heating energy threshold over which upstream oxygen sensor is considered as constant hot" VALUE 0xa0021ab6 _REC_S1VAL_20_u2 2399.96337890625 _CNV_A_R_LINEAR_____380_CM 0. 2399.96337890625 FORMAT "%7.2" /end CHARACTERISTIC
/begin CHARACTERISTIC Cxx_lbup_hot_sta_end "Time necessary to concider a hot sensor" VALUE 0xa0021ab8 _REC_S1VAL_20_u2 65535. _CNV_A_R_LINEAR_____68_CM 0. 65535. FORMAT "%5.0" /end CHARACTERISTIC
/begin CHARACTERISTIC Cxx_lbup_loss_pow "Heating power lost during cooling phase (w/o haeting the sensor)" VALUE 0xa0021aba _REC_S1VAL_20_u2 239.996337890625 _CNV_A_R_LINEAR_____381_CM 0. 239.996337890625 FORMAT "%7.3" /end CHARACTERISTIC
/begin CHARACTERISTIC Cxx_lbup_rms_v "Effective voltage recommanded by the sensor supplyer" VALUE 0xa0021ac4 _REC_S1VAL_20_u1 255. _CNV_A_R_LINEAR_____378_CM 0. 255. FORMAT "%3.0" /end CHARACTERISTIC
/begin CHARACTERISTIC Cxx_lbup_tco_rest_thd "Tco threshold activating the hot restart strategy" VALUE 0xa0021abc _REC_S1VAL_20_u2 240. _CNV_A_R_LINEAR_____110_CM -40. 200. FORMAT "%5.1" /end CHARACTERISTIC
/begin MEASUREMENT Vsx_lbup_hot_vld "Front Oxygen Heating Validity Status" UBYTE _CNV_S_3_STATUS_OK__179_CM 1 0. 0. 2. ECU_ADDRESS 0xd0007c43 /end MEASUREMENT
/begin CHARACTERISTIC Cxx_dfdec_lbup_hot_oc "Upstream lambda sensor heating Open circuit diagnostic detected failure counter decrement" VALUE 0xa0021a8c _REC_S1VAL_20_u2 65535. _CNV_A_R_ECME_LINEA_0_CM 0. 65535. FORMAT "%5.0" /end CHARACTERISTIC
/begin CHARACTERISTIC Cxx_dfdec_lbup_hot_scg "Upstream lambda sensor heating Short circuit to ground diagnostic detected failure counter decrement" VALUE 0xa0021a8e _REC_S1VAL_20_u2 65535. _CNV_A_R_ECME_LINEA_0_CM 0. 65535. FORMAT "%5.0" /end CHARACTERISTIC
/begin CHARACTERISTIC Cxx_dfdec_lbup_hot_scw "Upstream lambda sensor heating Short circuit at battery + diagnostic detected failure counter decrement" VALUE 0xa0021a90 _REC_S1VAL_20_u2 65535. _CNV_A_R_ECME_LINEA_0_CM 0. 65535. FORMAT "%5.0" /end CHARACTERISTIC
/begin CHARACTERISTIC Cxx_dfinc_lbup_hot_oc "Upstream lambda sensor heating Open circuit diagnostic detected failure counter increment" VALUE 0xa0021a92 _REC_S1VAL_20_u2 65535. _CNV_A_R_ECME_LINEA_0_CM 0. 65535. FORMAT "%5.0" /end CHARACTERISTIC
/begin CHARACTERISTIC Cxx_dfinc_lbup_hot_scg "Upstream lambda sensor heating Short circuit to ground diagnostic detected failure counter increment" VALUE 0xa0021a94 _REC_S1VAL_20_u2 65535. _CNV_A_R_ECME_LINEA_0_CM 0. 65535. FORMAT "%5.0" /end CHARACTERISTIC
/begin CHARACTERISTIC Cxx_dfinc_lbup_hot_scw "Upstream lambda sensor heating Short circuit at battery + diagnostic detected failure counter increment" VALUE 0xa0021a96 _REC_S1VAL_20_u2 65535. _CNV_A_R_ECME_LINEA_0_CM 0. 65535. FORMAT "%5.0" /end CHARACTERISTIC
/begin CHARACTERISTIC Ctp_tco_lbup_hot_dly_alco "Number of TDC before applying the heater power for alcool application" CURVE 0xa002f024 _REC_A1CUR_20_u2_u2 65535. _CNV_A_R_LINEAR_____101_CM 0. 65535. FORMAT "%5.0"
 /begin AXIS_DESCR COM_AXIS Vxx_tco _CNV_A_R_LINEAR_____110_CM 13 -40. 200. FORMAT "%5.1" AXIS_PTS_REF Ctb_tco_lbup_hot_dly /end AXIS_DESCR
/end CHARACTERISTIC
/begin MEASUREMENT Vxx_lbup_hot_dly_ctr_alco "TDC calibration value for dewpoint detection for alcool applications" UWORD _CNV_A_R_LINEAR_____101_CM 1 0. 0. 65535. ECU_ADDRESS 0xd000465c FORMAT "%5.0" /end MEASUREMENT
/begin MEASUREMENT Vbx_lbup_heat_diag_cfm "Boolean indicating wether upstream lambda sensor heating diagnosis is activated or not" UBYTE _CNV_S_2_RANGE______3_CM 1 0. 0. 1. ECU_ADDRESS 0xd0006f03 BIT_MASK 0x1 /end MEASUREMENT
/begin CHARACTERISTIC Cbx_lbup_heat_diag_cfm "Calibration indicating wether upstream lambda sensor heating diagnosis is activated or not" VALUE 0xa0021ad4 _REC_S1VAL_20_u1 1. _CNV_A_R_ECME_LINEA_0_CM 0. 1. FORMAT "%1.0" BIT_MASK 0x1 /end CHARACTERISTIC
/begin MEASUREMENT Vbx_df_lbup_hot_dirt_lkg "Front oxygen sensor heater fct performance diagnosis detected failure" UBYTE _CNV_S_2_RANGE______3_CM 1 0. 0. 1. ECU_ADDRESS 0xd0006ef7 BIT_MASK 0x1 /end MEASUREMENT
/begin MEASUREMENT Vbx_diag_ena_lbup_hot_dirt_lkg "Front oxygen sensor heater fct performance diagnosis authorization" UBYTE _CNV_S_2_RANGE______3_CM 1 0. 0. 1. ECU_ADDRESS 0xd0006ef8 BIT_MASK 0x1 /end MEASUREMENT
/begin MEASUREMENT Vbx_lbup_hot_obd_cond_ok "Logic indicating if diagnosis conditions are satisfied" UBYTE _CNV_S_2_RANGE______3_CM 1 0. 0. 1. ECU_ADDRESS 0xd0006ef9 BIT_MASK 0x1 /end MEASUREMENT
/begin MEASUREMENT Vbx_lbup_hot_obd_diag_stop "Logic indicating if the test is complete" UBYTE _CNV_S_2_RANGE______3_CM 1 0. 0. 1. ECU_ADDRESS 0xd0006efa BIT_MASK 0x1 /end MEASUREMENT
/begin MEASUREMENT Vbx_lbup_hot_obd_inhi_cond "Inhibition conditions for lambda heating diagnosis" UBYTE _CNV_S_2_RANGE______3_CM 1 0. 0. 1. ECU_ADDRESS 0xd0006efb BIT_MASK 0x1 /end MEASUREMENT
/begin MEASUREMENT Vbx_lbup_hot_obd_mes "Logic indicating if the measure is complete" UBYTE _CNV_S_2_RANGE______3_CM 1 0. 0. 1. ECU_ADDRESS 0xd0006efc BIT_MASK 0x1 /end MEASUREMENT
/begin MEASUREMENT Vbx_lbup_hot_obd_phy_cond "Physical conditions for lambda heating diagnosis" UBYTE _CNV_S_2_RANGE______3_CM 1 0. 0. 1. ECU_ADDRESS 0xd0006efd BIT_MASK 0x1 /end MEASUREMENT
/begin MEASUREMENT Vbx_lbup_hot_obd_sw_cond "Software conditions for lambda heating diagnosis" UBYTE _CNV_S_2_RANGE______3_CM 1 0. 0. 1. ECU_ADDRESS 0xd0006efe BIT_MASK 0x1 /end MEASUREMENT
/begin MEASUREMENT Vsx_lbup_hot_obd_stt "Upstream Lambda Sensor heater OBD system status" UBYTE _CNV_S_5_STATUS_LAM_383_CM 1 0. 1. 5. ECU_ADDRESS 0xd0006eff /end MEASUREMENT
/begin MEASUREMENT Vxx_lbup_hot_obd_acq_nr "Number of acquisitions in a window" UWORD _CNV_A_R_ECME_LINEA_0_CM 1 0. 0. 65535. ECU_ADDRESS 0xd0004664 FORMAT "%5.0" /end MEASUREMENT
/begin MEASUREMENT Vxx_lbup_hot_obd_acq_win_nr "Number of acquisition windows in the test" UBYTE _CNV_A_R_ECME_LINEA_0_CM 1 0. 0. 255. ECU_ADDRESS 0xd0006f00 FORMAT "%3.0" /end MEASUREMENT
/begin MEASUREMENT Vxx_lbup_hot_obd_crt_mv "Mean value of heater current in a window" UWORD _CNV_A_R_LINEAR_____289_CM 1 0. 0. 5.5 ECU_ADDRESS 0xd0004666 FORMAT "%6.4" /end MEASUREMENT
/begin MEASUREMENT Vxx_lbup_hot_obd_crt_mv_tot "Mean value of the heater current in the whole test" UWORD _CNV_A_R_LINEAR_____289_CM 1 0. 0. 5.5 ECU_ADDRESS 0xd0004668 FORMAT "%6.4" /end MEASUREMENT
/begin MEASUREMENT Vxx_lbup_hot_obd_lgl_dly "Duration before diagnosis enabled" UWORD _CNV_A_R_LINEAR_____58_CM 1 0. 0. 6553.5 ECU_ADDRESS 0xd000466a FORMAT "%6.1" /end MEASUREMENT
/begin MEASUREMENT Vxx_lbup_hot_obd_stab_dly "Duration the diagnosis conditions must be kept before test is enabled" UBYTE _CNV_A_R_LINEAR_____58_CM 1 0. 0. 25.5 ECU_ADDRESS 0xd0006f01 FORMAT "%4.1" /end MEASUREMENT
/begin MEASUREMENT Vxx_lbup_hot_obd_win_dfctr "Number of acquisition windows where the mean value of heater current is faulty" UBYTE _CNV_A_R_ECME_LINEA_0_CM 1 0. 0. 255. ECU_ADDRESS 0xd0006f02 FORMAT "%3.0" /end MEASUREMENT
/begin CHARACTERISTIC Cxx_dfdec_lbup_hot_dirt_lkg "Front oxygen sensor heater fct performance detected failure counter decrement" VALUE 0xa0021ac6 _REC_S1VAL_20_u2 65535. _CNV_A_R_ECME_LINEA_0_CM 0. 65535. FORMAT "%5.0" /end CHARACTERISTIC
/begin CHARACTERISTIC Cxx_dfinc_lbup_hot_dirt_lkg "Front oxygen sensor heater fct performance detected failure counter increment" VALUE 0xa0021ac8 _REC_S1VAL_20_u2 65535. _CNV_A_R_ECME_LINEA_0_CM 0. 65535. FORMAT "%5.0" /end CHARACTERISTIC
/begin CHARACTERISTIC Cxx_lbup_hot_obd_acq_nr_min "Minimum number of acquisitions in a window" VALUE 0xa0021aca _REC_S1VAL_20_u2 65535. _CNV_A_R_ECME_LINEA_0_CM 0. 65535. FORMAT "%5.0" /end CHARACTERISTIC
/begin CHARACTERISTIC Cxx_lbup_hot_obd_acq_win_nr "Number of acquisition windows in the test" VALUE 0xa0021ad2 _REC_S1VAL_20_u1 255. _CNV_A_R_ECME_LINEA_0_CM 0. 255. FORMAT "%3.0" /end CHARACTERISTIC
/begin CHARACTERISTIC Cxx_lbup_hot_obd_crt_thd "Lambda heater current failure threshold" VALUE 0xa0021acc _REC_S1VAL_20_u2 5.5 _CNV_A_R_LINEAR_____289_CM 0. 5.5 FORMAT "%6.4" /end CHARACTERISTIC
/begin CHARACTERISTIC Cxx_lbup_hot_obd_lgl_dly "Duration before diagnosis enabled" VALUE 0xa0021ace _REC_S1VAL_20_u2 6553.5 _CNV_A_R_LINEAR_____58_CM 0. 6553.5 FORMAT "%6.1" /end CHARACTERISTIC
/begin CHARACTERISTIC Cxx_lbup_hot_obd_stab_dly "Duration the diagnosis conditions must be kept before test is enabled" VALUE 0xa0021ad3 _REC_S1VAL_20_u1 25.5 _CNV_A_R_LINEAR_____58_CM 0. 25.5 FORMAT "%4.1" /end CHARACTERISTIC
/begin CHARACTERISTIC Cxx_lbup_hot_obd_tco_min "Minimum value of engine coolant temperature for the diagnosis to enable" VALUE 0xa0021ad0 _REC_S1VAL_20_u2 240. _CNV_A_R_LINEAR_____110_CM -40. 200. FORMAT "%5.1" /end CHARACTERISTIC
/begin AXIS_PTS Ctb_fct_tco_crkm "Equally distributed breakpoints for Ctp_fct_tco_dly" 0xa0036df4 Vxx_tco _REC_A2AXS_20_u2 240. _CNV_A_R_LINEAR_____110_CM 9 -40. 200. FORMAT "%5.1" /end AXIS_PTS
/begin CHARACTERISTIC Ctp_fct_tco_dly "Table of starter time out function of the water temperature" CURVE 0xa0036e08 _REC_A1CUR_20_u2_u2 6553.5 _CNV_A_R_LINEAR_____58_CM 0. 6553.5 FORMAT "%6.1"
 /begin AXIS_DESCR COM_AXIS Vxx_tco _CNV_A_R_LINEAR_____110_CM 9 -40. 200. FORMAT "%5.1" AXIS_PTS_REF Ctb_fct_tco_crkm /end AXIS_DESCR
/end CHARACTERISTIC
/begin MEASUREMENT Vbx_dft_sta "Flag indicating a starter activated but driven state not detected" UBYTE _CNV_S_2_RANGE______3_CM 1 0. 0. 1. ECU_ADDRESS 0xd0007211 BIT_MASK 0x1 /end MEASUREMENT
/begin MEASUREMENT Vbx_long_crk_req "Long cranking request (request = 1)" UBYTE _CNV_S_2_RANGE______3_CM 1 0. 0. 1. ECU_ADDRESS 0xd0007212 BIT_MASK 0x1 /end MEASUREMENT
/begin MEASUREMENT Vsx_ena_sta_agb_ecm "AT recopy Starter authorization or stop" UBYTE _CNV_A_R_ECME_LINEA_0_CM 1 0. 0. 3. ECU_ADDRESS 0xd0007213 FORMAT "%1.0" /end MEASUREMENT
/begin MEASUREMENT Vsx_ena_sta_ecm "Data indicating the cranking authorization ECM" UBYTE _CNV_A_R_ECME_LINEA_0_CM 1 0. 0. 4. ECU_ADDRESS 0xd0007214 FORMAT "%1.0" /end MEASUREMENT
/begin CHARACTERISTIC Cxx_ena_sta_agb_vld_dly "After this duration, the previous value of Vsx_ena_sta_agb will be copy in Vsx_ena_sta_agb_ecm" VALUE 0xa00220ae _REC_S1VAL_20_u1 2.55 _CNV_A_R_LINEAR_____32_CM 0. 2.55 FORMAT "%4.2" /end CHARACTERISTIC
/begin CHARACTERISTIC Cxx_frst_sta_dly "Specific time out before starter stop demand for the first engine cranking" VALUE 0xa00220aa _REC_S1VAL_20_u2 6553.5 _CNV_A_R_LINEAR_____58_CM 0. 6553.5 FORMAT "%6.1" /end CHARACTERISTIC
/begin CHARACTERISTIC Cxx_sta_stt_vld_dly "Duration of the starter status validity status before starter status reading" VALUE 0xa00220af _REC_S1VAL_20_u1 2.55 _CNV_A_R_LINEAR_____32_CM 0. 2.55 FORMAT "%4.2" /end CHARACTERISTIC
/begin CHARACTERISTIC Cxx_wait_sta_fail_dly "Duration in stopped engine state before making a starter stop request" VALUE 0xa00220ac _REC_S1VAL_20_u2 6553.5 _CNV_A_R_LINEAR_____58_CM 0. 6553.5 FORMAT "%6.1" /end CHARACTERISTIC
/begin MEASUREMENT Vbx_eng_crk_wait "Active during waiting for engine conditions before cranking (preheating, system initialization, ... )" UBYTE _CNV_S_2_RANGE______3_CM 1 0. 0. 1. ECU_ADDRESS 0xd00071fe BIT_MASK 0x1 /end MEASUREMENT
/begin MEASUREMENT SLockRequestControl "Transmitted CAN parameter" UBYTE _CNV_A_R_ECME_LINEA_0_CM 1 0. 0. 15. ECU_ADDRESS 0xd00013d0 FORMAT "%2.0" /end MEASUREMENT
/begin MEASUREMENT SoftwareLockRequest[0] "Transmitted CAN parameter" UBYTE _CNV_A_R_ECME_LINEA_0_CM 1 0. 0. 255. ECU_ADDRESS 0xd00013ca FORMAT "%3.0" /end MEASUREMENT
/begin MEASUREMENT SoftwareLockRequest[1] "Transmitted CAN parameter" UBYTE _CNV_A_R_ECME_LINEA_0_CM 1 0. 0. 255. ECU_ADDRESS 0xd00013cb FORMAT "%3.0" /end MEASUREMENT
/begin MEASUREMENT SoftwareLockRequest[2] "Transmitted CAN parameter" UBYTE _CNV_A_R_ECME_LINEA_0_CM 1 0. 0. 255. ECU_ADDRESS 0xd00013cc FORMAT "%3.0" /end MEASUREMENT
/begin MEASUREMENT SoftwareLockRequest[3] "Transmitted CAN parameter" UBYTE _CNV_A_R_ECME_LINEA_0_CM 1 0. 0. 255. ECU_ADDRESS 0xd00013cd FORMAT "%3.0" /end MEASUREMENT
/begin MEASUREMENT SoftwareLockRequest[4] "Transmitted CAN parameter" UBYTE _CNV_A_R_ECME_LINEA_0_CM 1 0. 0. 255. ECU_ADDRESS 0xd00013ce FORMAT "%3.0" /end MEASUREMENT
/begin MEASUREMENT SoftwareLockRequest[5] "Transmitted CAN parameter" UBYTE _CNV_A_R_ECME_LINEA_0_CM 1 0. 0. 255. ECU_ADDRESS 0xd00013cf FORMAT "%3.0" /end MEASUREMENT
/begin MEASUREMENT Vbx_supl_key_bkup_ok "NVMY erasable area of secret key available" UBYTE _CNV_S_2_RANGE______3_CM 1 0. 0. 1. ECU_ADDRESS 0xd00013d1 BIT_MASK 0x1 /end MEASUREMENT
/begin MEASUREMENT Vbx_supl_key_norm_ok "NVMY not erasable area of secret key available" UBYTE _CNV_S_2_RANGE______3_CM 1 0. 0. 1. ECU_ADDRESS 0xd00013d2 BIT_MASK 0x1 /end MEASUREMENT
/begin MEASUREMENT Vbx_swlk_4_ecm_prot_stt "protected state of the ECM" UBYTE _CNV_S_2_RANGE______3_CM 1 0. 0. 1. ECU_ADDRESS 0xd00013d3 BIT_MASK 0x1 /end MEASUREMENT
/begin MEASUREMENT Vbx_swlk_4_pwl_rtn_req "request to keep the power before going in protected state" UBYTE _CNV_S_2_RANGE______3_CM 1 0. 0. 1. ECU_ADDRESS 0xd00013d4 BIT_MASK 0x1 /end MEASUREMENT
/begin MEASUREMENT Vbx_swlk_cnt_tool_req "informs that the learning request has failed" UBYTE _CNV_S_2_RANGE______3_CM 1 0. 0. 1. ECU_ADDRESS 0xd00013d5 BIT_MASK 0x1 /end MEASUREMENT
/begin MEASUREMENT Vbx_swlk_diag_avl "Bit indicating that the Immobiliser diagnosis is available" UBYTE _CNV_S_2_RANGE______3_CM 1 0. 0. 1. ECU_ADDRESS 0xd00013d6 BIT_MASK 0x1 /end MEASUREMENT
/begin MEASUREMENT Vbx_swlk_diag_ccu "Immobiliser diagnosis bit indicating that the engine isn't running due to no BCM authorisation" UBYTE _CNV_S_2_RANGE______3_CM 1 0. 0. 1. ECU_ADDRESS 0xd00013d7 BIT_MASK 0x1 /end MEASUREMENT
/begin MEASUREMENT Vbx_swlk_diag_ecm "Immobiliser diagnosis bit indicating that the engine isn't running due to ECM" UBYTE _CNV_S_2_RANGE______3_CM 1 0. 0. 1. ECU_ADDRESS 0xd00013d8 BIT_MASK 0x1 /end MEASUREMENT
/begin MEASUREMENT Vbx_swlk_diag_mux "Immobiliser diagnosis bit indicating that the engine isn't running due to a CAN problem with BCM" UBYTE _CNV_S_2_RANGE______3_CM 1 0. 0. 1. ECU_ADDRESS 0xd00013d9 BIT_MASK 0x1 /end MEASUREMENT
/begin MEASUREMENT Vbx_swlk_diag_tool "Immobiliser diagnosis bit indicating that the engine isn't running due to BCM secure mode" UBYTE _CNV_S_2_RANGE______3_CM 1 0. 0. 1. ECU_ADDRESS 0xd00013da BIT_MASK 0x1 /end MEASUREMENT
/begin MEASUREMENT Vbx_swlk_dsb_ena "Indicates if the inhibition of immobilizer strategy is allowed" UBYTE _CNV_S_2_RANGE______3_CM 1 0. 0. 1. ECU_ADDRESS 0xd00013db BIT_MASK 0x1 /end MEASUREMENT
/begin MEASUREMENT Vsx_swlk_stt "Immobiliser automaton phase number" UBYTE _CNV_A_R_ECME_LINEA_0_CM 1 0. 0. 255. ECU_ADDRESS 0xd00013dc FORMAT "%3.0" /end MEASUREMENT
/begin MEASUREMENT Vxx_swlk_4_eng_run_ena "Engine running authorisation dependent on the anti theft strategy" UBYTE _CNV_A_R_ECME_LINEA_0_CM 1 0. 0. 255. ECU_ADDRESS 0xd00013dd FORMAT "%3.0" /end MEASUREMENT
/begin MEASUREMENT Vxx_swlk_diag_1 "Byte used to allow Immobiliser diagnosis" UBYTE _CNV_A_R_ECME_LINEA_0_CM 1 0. 0. 255. ECU_ADDRESS 0xd00013de FORMAT "%3.0" /end MEASUREMENT
/begin MEASUREMENT Vxx_swlk_diag_2 "Byte used to allow Immobiliser diagnosis" UBYTE _CNV_A_R_ECME_LINEA_0_CM 1 0. 0. 255. ECU_ADDRESS 0xd00013df FORMAT "%3.0" /end MEASUREMENT
/begin MEASUREMENT Vxx_swlk_diag_3 "Byte used to allow Immobiliser diagnosis" UBYTE _CNV_A_R_ECME_LINEA_0_CM 1 0. 0. 255. ECU_ADDRESS 0xd00013e0 FORMAT "%3.0" /end MEASUREMENT
/begin MEASUREMENT Vxx_swlk_key_mem_stt "Secret key NVMY area" UBYTE _CNV_A_R_ECME_LINEA_0_CM 1 0. 0. 3. ECU_ADDRESS 0xd00013e1 FORMAT "%1.0" /end MEASUREMENT
/begin MEASUREMENT Vxx_swlk_nok_id_ctr "False authentications counter" UBYTE _CNV_A_R_ECME_LINEA_0_CM 1 0. 0. 255. ECU_ADDRESS 0xd00013e2 FORMAT "%3.0" /end MEASUREMENT
/begin CHARACTERISTIC Cbx_swlk_dsb "completely inhibits the immobilizer strategy for development purpose (on emulated ECM only)" VALUE 0xa00220be _REC_S1VAL_20_u1 1. _CNV_S_2_RANGE______3_CM 0. 1. BIT_MASK 0x1 /end CHARACTERISTIC
/begin CHARACTERISTIC Cbx_swlk_key_spc_req "indicates a specific request to learn the secret key without security tool" VALUE 0xa00220bf _REC_S1VAL_20_u1 1. _CNV_S_2_RANGE______3_CM 0. 1. BIT_MASK 0x1 /end CHARACTERISTIC
/begin CHARACTERISTIC Cbx_swlk_req "set if immobilizer strategy is a base equipment" VALUE 0xa00220c0 _REC_S1VAL_20_u1 1. _CNV_S_2_RANGE______3_CM 0. 1. BIT_MASK 0x1 /end CHARACTERISTIC
/begin CHARACTERISTIC Cxx_swlk_chlg_dly "max delay for waiting the response to the challenge" VALUE 0xa00220c1 _REC_S1VAL_20_u1 2.55 _CNV_A_R_LINEAR_____32_CM 0. 2.55 FORMAT "%4.2" /end CHARACTERISTIC
/begin CHARACTERISTIC Cxx_swlk_diag_dly "Minimum delay for availability of Immobilizer diagnosis" VALUE 0xa00220c2 _REC_S1VAL_20_u1 2.55 _CNV_A_R_LINEAR_____32_CM 0. 2.55 FORMAT "%4.2" /end CHARACTERISTIC
/begin CHARACTERISTIC Cxx_swlk_id_forb_dly "max delay during which both engine running and exchanges with BCM are forbidden" VALUE 0xa00220c3 _REC_S1VAL_20_u1 25.5 _CNV_A_R_LINEAR_____58_CM 0. 25.5 FORMAT "%4.1" /end CHARACTERISTIC
/begin CHARACTERISTIC Cxx_swlk_id_nok_ctr_dec "max number of authentications allowed after the end of antiscanning timer" VALUE 0xa00220c4 _REC_S1VAL_20_u1 255. _CNV_A_R_ECME_LINEA_0_CM 0. 255. FORMAT "%3.0" /end CHARACTERISTIC
/begin CHARACTERISTIC Cxx_swlk_id_nr_ena "max number of false authentications allowed" VALUE 0xa00220c5 _REC_S1VAL_20_u1 255. _CNV_A_R_ECME_LINEA_0_CM 0. 255. FORMAT "%3.0" /end CHARACTERISTIC
/begin CHARACTERISTIC Cxx_swlk_key_dlt_dly "max time where clearing the secret key is allowed" VALUE 0xa00220c6 _REC_S1VAL_20_u1 2.55 _CNV_A_R_LINEAR_____32_CM 0. 2.55 FORMAT "%4.2" /end CHARACTERISTIC
/begin CHARACTERISTIC Cxx_swlk_key_dly "max waiting time for receiving secret key" VALUE 0xa00220c7 _REC_S1VAL_20_u1 2.55 _CNV_A_R_LINEAR_____32_CM 0. 2.55 FORMAT "%4.2" /end CHARACTERISTIC
/begin CHARACTERISTIC Cxx_swlk_noi_1 "Value used to calculate the first noise byte of the ECM_VERLOG frame" VALUE 0xa00220b8 _REC_S1VAL_20_u1 255. _CNV_A_R_ECME_LINEA_0_CM 0. 255. DISPLAY_IDENTIFIER Cxx_swlk_noi[0] FORMAT "%3.0" /end CHARACTERISTIC
/begin CHARACTERISTIC Cxx_swlk_noi_2 "Value used to calculate the first noise byte of the ECM_VERLOG frame" VALUE 0xa00220b9 _REC_S1VAL_20_u1 255. _CNV_A_R_ECME_LINEA_0_CM 0. 255. DISPLAY_IDENTIFIER Cxx_swlk_noi[1] FORMAT "%3.0" /end CHARACTERISTIC
/begin CHARACTERISTIC Cxx_swlk_noi_3 "Value used to calculate the first noise byte of the ECM_VERLOG frame" VALUE 0xa00220ba _REC_S1VAL_20_u1 255. _CNV_A_R_ECME_LINEA_0_CM 0. 255. DISPLAY_IDENTIFIER Cxx_swlk_noi[2] FORMAT "%3.0" /end CHARACTERISTIC
/begin CHARACTERISTIC Cxx_swlk_noi_4 "Value used to calculate the first noise byte of the ECM_VERLOG frame" VALUE 0xa00220bb _REC_S1VAL_20_u1 255. _CNV_A_R_ECME_LINEA_0_CM 0. 255. DISPLAY_IDENTIFIER Cxx_swlk_noi[3] FORMAT "%3.0" /end CHARACTERISTIC
/begin CHARACTERISTIC Cxx_swlk_noi_5 "Value used to calculate the first noise byte of the ECM_VERLOG frame" VALUE 0xa00220bc _REC_S1VAL_20_u1 255. _CNV_A_R_ECME_LINEA_0_CM 0. 255. DISPLAY_IDENTIFIER Cxx_swlk_noi[4] FORMAT "%3.0" /end CHARACTERISTIC
/begin CHARACTERISTIC Cxx_swlk_noi_6 "Value used to calculate the first noise byte of the ECM_VERLOG frame" VALUE 0xa00220bd _REC_S1VAL_20_u1 255. _CNV_A_R_ECME_LINEA_0_CM 0. 255. DISPLAY_IDENTIFIER Cxx_swlk_noi[5] FORMAT "%3.0" /end CHARACTERISTIC
/begin CHARACTERISTIC Cxx_swlk_pwl_dly "duration of the power lacth phase concerning the anti-theft strategy." VALUE 0xa00220c8 _REC_S1VAL_20_u1 25.5 _CNV_A_R_LINEAR_____58_CM 0. 25.5 FORMAT "%4.1" /end CHARACTERISTIC
/begin MEASUREMENT Vbx_swlk2_code_line_dfl "Bit indicating a problem on the coded line" UBYTE _CNV_S_2_RANGE______3_CM 1 0. 0. 1. ECU_ADDRESS 0xd00013e7 BIT_MASK 0x1 /end MEASUREMENT
/begin MEASUREMENT Vbx_swlk2_ecm_lck_stt "Bit indicating that the ECM is LOCKED" UBYTE _CNV_S_2_RANGE______3_CM 1 0. 0. 1. ECU_ADDRESS 0xd00013e8 BIT_MASK 0x1 /end MEASUREMENT
/begin MEASUREMENT Vbx_swlk2_ecm_prot_stt "Bit indicating the ECU is PROTECTED" UBYTE _CNV_S_2_RANGE______3_CM 1 0. 0. 1. ECU_ADDRESS 0xd00013e9 BIT_MASK 0x1 /end MEASUREMENT
/begin MEASUREMENT Vbx_swlk2_eprm_dfl "Bit indicating a problem on the EEPROM" UBYTE _CNV_S_2_RANGE______3_CM 1 0. 0. 1. ECU_ADDRESS 0xd00013ea BIT_MASK 0x1 /end MEASUREMENT
/begin MEASUREMENT Vbx_swlk2_key_mem_stt "Bit indicating that a CODE has been LEARNT" UBYTE _CNV_S_2_RANGE______3_CM 1 0. 0. 1. ECU_ADDRESS 0xd00013eb BIT_MASK 0x1 /end MEASUREMENT
/begin MEASUREMENT Vbx_swlk2_pwl_rtn_req "Request from SOFTWARE LOCK 2 to maintain power latch power supply" UBYTE _CNV_S_2_RANGE______3_CM 1 0. 0. 1. ECU_ADDRESS 0xd00013ec BIT_MASK 0x1 /end MEASUREMENT
/begin MEASUREMENT Vbx_swlk_ecm_prot_stt "protected state of the ECM" UBYTE _CNV_S_2_RANGE______3_CM 1 0. 0. 1. ECU_ADDRESS 0xd00013e4 BIT_MASK 0x1 /end MEASUREMENT
/begin MEASUREMENT Vbx_swlk_pwl_rtn_req "request to keep the power before going in protected state" UBYTE _CNV_S_2_RANGE______3_CM 1 0. 0. 1. ECU_ADDRESS 0xd00013e5 BIT_MASK 0x1 /end MEASUREMENT
/begin MEASUREMENT Vxx_eng_run_ena_swlk "Engine running authorisation dependent on the anti theft strategy" UBYTE _CNV_A_R_ECME_LINEA_0_CM 1 0. 0. 255. ECU_ADDRESS 0xd00013e6 FORMAT "%3.0" /end MEASUREMENT
/begin MEASUREMENT Vbx_swlk_2_4_cfm "Immobilizer 4 (=1) or 2 (=0) configuration" UBYTE _CNV_S_2_RANGE______3_CM 1 0. 0. 1. ECU_ADDRESS 0xd00013ed BIT_MASK 0x1 /end MEASUREMENT
/begin CHARACTERISTIC Cbx_swlk_2_4_cfm "Immobilizer 4 (=1) or 2 (=0) configuration" VALUE 0xa00220c9 _REC_S1VAL_20_u1 1. _CNV_A_R_ECME_LINEA_0_CM 0. 1. FORMAT "%1.0" BIT_MASK 0x1 /end CHARACTERISTIC
/begin MEASUREMENT Vxx_it_maf_sp "Throttle mass air flow correxponding to the request of the torque structure" UWORD _CNV_A_R_LINEAR_____172_CM 1 0. 0. 3000. ECU_ADDRESS 0xd0003e46 FORMAT "%7.2" /end MEASUREMENT
/begin MEASUREMENT Vxx_maf_eng_sp "Setpoint of the mass air flow pumped into cylinder" UWORD _CNV_A_R_LINEAR_____172_CM 1 0. 0. 3000. ECU_ADDRESS 0xd0003e48 FORMAT "%7.2" /end MEASUREMENT
/begin MEASUREMENT Vxx_knk_ctr_cyl_1 "" UWORD _CNV_A_R_ECME_LINEA_0_CM 1 0. 0. 65535. DISPLAY_IDENTIFIER InCbiKnk_NVM.Vxx_knk_ctr_cyl_1_NVM ECU_ADDRESS 0xd00042a0 FORMAT "%5.0" /end MEASUREMENT
/begin MEASUREMENT Vxx_knk_ctr_cyl_2 "" UWORD _CNV_A_R_ECME_LINEA_0_CM 1 0. 0. 65535. DISPLAY_IDENTIFIER InCbiKnk_NVM.Vxx_knk_ctr_cyl_2_NVM ECU_ADDRESS 0xd00042a2 FORMAT "%5.0" /end MEASUREMENT
/begin MEASUREMENT Vxx_knk_ctr_cyl_3 "" UWORD _CNV_A_R_ECME_LINEA_0_CM 1 0. 0. 65535. DISPLAY_IDENTIFIER InCbiKnk_NVM.Vxx_knk_ctr_cyl_3_NVM ECU_ADDRESS 0xd00042a4 FORMAT "%5.0" /end MEASUREMENT
/begin MEASUREMENT Vxx_knk_ctr_cyl_4 "" UWORD _CNV_A_R_ECME_LINEA_0_CM 1 0. 0. 65535. DISPLAY_IDENTIFIER InCbiKnk_NVM.Vxx_knk_ctr_cyl_4_NVM ECU_ADDRESS 0xd00042a6 FORMAT "%5.0" /end MEASUREMENT
/begin MEASUREMENT Vxx_mv_knk "Mean knock noise" UBYTE _CNV_A_R_ECME_LINEA_0_CM 1 0. 0. 255. ECU_ADDRESS 0xd0007b69 FORMAT "%3.0" /end MEASUREMENT
/begin CHARACTERISTIC Cxx_knk_fil_ftc "mean knock filtering factor for diagnosis frame " VALUE 0xa0021372 _REC_S1VAL_20_u1 2.55 _CNV_A_R_LINEAR_____32_CM 0. 2.55 FORMAT "%4.2" /end CHARACTERISTIC
/begin AXIS_PTS Ctb_n_knk "20 programmable engine speed breakpoints map" 0xa002ce84 Vxx_n _REC_A2AXS_20_u2 16383.75 _CNV_A_R_ENSD_LINEA_22_CM 20 0. 16383.75 FORMAT "%8.2" /end AXIS_PTS
/begin CHARACTERISTIC Ctp_n_knk_fac_cyl_0 "Factor on cylinder 1 knock for knock detection depending on engine speed" CURVE 0xa002ceb0 _REC_A1CUR_20_u1_u2 1. _CNV_A_R_LINEAR_____162_CM 0. 1. FORMAT "%9.7"
 /begin AXIS_DESCR COM_AXIS Vxx_n _CNV_A_R_ENSD_LINEA_22_CM 20 0. 16383.75 FORMAT "%8.2" AXIS_PTS_REF Ctb_n_knk /end AXIS_DESCR
/end CHARACTERISTIC
/begin CHARACTERISTIC Ctp_n_knk_fac_cyl_1 "Factor on cylinder 3 knock for knock detection depending on engine speed" CURVE 0xa002cec4 _REC_A1CUR_20_u1_u2 1. _CNV_A_R_LINEAR_____162_CM 0. 1. FORMAT "%9.7"
 /begin AXIS_DESCR COM_AXIS Vxx_n _CNV_A_R_ENSD_LINEA_22_CM 20 0. 16383.75 FORMAT "%8.2" AXIS_PTS_REF Ctb_n_knk /end AXIS_DESCR
/end CHARACTERISTIC
/begin CHARACTERISTIC Ctp_n_knk_fac_cyl_2 "Factor on cylinder 4 knock for knock detection depending on engine speed" CURVE 0xa002ced8 _REC_A1CUR_20_u1_u2 1. _CNV_A_R_LINEAR_____162_CM 0. 1. FORMAT "%9.7"
 /begin AXIS_DESCR COM_AXIS Vxx_n _CNV_A_R_ENSD_LINEA_22_CM 20 0. 16383.75 FORMAT "%8.2" AXIS_PTS_REF Ctb_n_knk /end AXIS_DESCR
/end CHARACTERISTIC
/begin CHARACTERISTIC Ctp_n_knk_fac_cyl_3 "Factor on cylinder 2 knock for knock detection depending on engine speed" CURVE 0xa002ceec _REC_A1CUR_20_u1_u2 1. _CNV_A_R_LINEAR_____162_CM 0. 1. FORMAT "%9.7"
 /begin AXIS_DESCR COM_AXIS Vxx_n _CNV_A_R_ENSD_LINEA_22_CM 20 0. 16383.75 FORMAT "%8.2" AXIS_PTS_REF Ctb_n_knk /end AXIS_DESCR
/end CHARACTERISTIC
/begin CHARACTERISTIC Ctp_n_knk_ofs_cyl_0 "Offset on cylinder 1 knock for knock detection depending on engine speed" CURVE 0xa002cf00 _REC_A1CUR_20_u1_u2 255. _CNV_A_R_ECME_LINEA_0_CM 0. 255. FORMAT "%3.0"
 /begin AXIS_DESCR COM_AXIS Vxx_n _CNV_A_R_ENSD_LINEA_22_CM 20 0. 16383.75 FORMAT "%8.2" AXIS_PTS_REF Ctb_n_knk /end AXIS_DESCR
/end CHARACTERISTIC
/begin CHARACTERISTIC Ctp_n_knk_ofs_cyl_1 "Offset on cylinder 3 knock for knock detection depending on engine speed" CURVE 0xa002cf14 _REC_A1CUR_20_u1_u2 255. _CNV_A_R_ECME_LINEA_0_CM 0. 255. FORMAT "%3.0"
 /begin AXIS_DESCR COM_AXIS Vxx_n _CNV_A_R_ENSD_LINEA_22_CM 20 0. 16383.75 FORMAT "%8.2" AXIS_PTS_REF Ctb_n_knk /end AXIS_DESCR
/end CHARACTERISTIC
/begin CHARACTERISTIC Ctp_n_knk_ofs_cyl_2 "Offset on cylinder 4 knock for knock detection depending on engine speed" CURVE 0xa002cf28 _REC_A1CUR_20_u1_u2 255. _CNV_A_R_ECME_LINEA_0_CM 0. 255. FORMAT "%3.0"
 /begin AXIS_DESCR COM_AXIS Vxx_n _CNV_A_R_ENSD_LINEA_22_CM 20 0. 16383.75 FORMAT "%8.2" AXIS_PTS_REF Ctb_n_knk /end AXIS_DESCR
/end CHARACTERISTIC
/begin CHARACTERISTIC Ctp_n_knk_ofs_cyl_3 "Offset on cylinder 2 knock for knock detection depending on engine speed" CURVE 0xa002cf3c _REC_A1CUR_20_u1_u2 255. _CNV_A_R_ECME_LINEA_0_CM 0. 255. FORMAT "%3.0"
 /begin AXIS_DESCR COM_AXIS Vxx_n _CNV_A_R_ENSD_LINEA_22_CM 20 0. 16383.75 FORMAT "%8.2" AXIS_PTS_REF Ctb_n_knk /end AXIS_DESCR
/end CHARACTERISTIC
/begin MEASUREMENT Vbx_fil_knk_noi_cyl_init "Filtered knock noise is initialized" UBYTE _CNV_S_2_RANGE______3_CM 1 0. 0. 1. ECU_ADDRESS 0xd0007b6a BIT_MASK 0x1 /end MEASUREMENT
/begin MEASUREMENT Vbx_knk_det_cyl_1 "Knock detection on cylinder 1" UBYTE _CNV_S_2_RANGE______3_CM 1 0. 0. 1. ECU_ADDRESS 0xd0006b32 BIT_MASK 0x1 /end MEASUREMENT
/begin MEASUREMENT Vbx_knk_det_cyl_2 "Knock detection on cylinder 2" UBYTE _CNV_S_2_RANGE______3_CM 1 0. 0. 1. ECU_ADDRESS 0xd0006b33 BIT_MASK 0x1 /end MEASUREMENT
/begin MEASUREMENT Vbx_knk_det_cyl_3 "Knock detection on cylinder 3" UBYTE _CNV_S_2_RANGE______3_CM 1 0. 0. 1. ECU_ADDRESS 0xd0006b34 BIT_MASK 0x1 /end MEASUREMENT
/begin MEASUREMENT Vbx_knk_det_cyl_4 "Knock detection on cylinder 4" UBYTE _CNV_S_2_RANGE______3_CM 1 0. 0. 1. ECU_ADDRESS 0xd0006b35 BIT_MASK 0x1 /end MEASUREMENT
/begin MEASUREMENT Vbx_knk_det_ena "Knock detection enable " UBYTE _CNV_S_2_RANGE______3_CM 1 0. 0. 1. ECU_ADDRESS 0xd0006b36 BIT_MASK 0x1 /end MEASUREMENT
/begin MEASUREMENT Vbx_knk_det_err_cyl "Wrong knock detection of current cylinder" UBYTE _CNV_S_2_RANGE______3_CM 1 0. 0. 1. ECU_ADDRESS 0xd0006b37 BIT_MASK 0x1 /end MEASUREMENT
/begin MEASUREMENT Vbx_knk_n_dsb "Inhibition of knock computations" UBYTE _CNV_S_2_RANGE______3_CM 1 0. 0. 1. ECU_ADDRESS 0xd0006b38 BIT_MASK 0x1 /end MEASUREMENT
/begin MEASUREMENT Vsx_knk_sens_vld "Breakdown of knock sensor" UBYTE _CNV_S_2_STATUS_OK__269_CM 1 0. 0. 1. ECU_ADDRESS 0xd0006b39 /end MEASUREMENT
/begin MEASUREMENT Vtd_fil_knk_noi_cyl[0] "Filtered knock noise for each cylinder" UWORD _CNV_A_R_LINEAR_____29_CM 1 0. 0. 255.99609375 ECU_ADDRESS 0xd00042a8 FORMAT "%10.6" /end MEASUREMENT
/begin MEASUREMENT Vtd_fil_knk_noi_cyl[1] "Filtered knock noise for each cylinder" UWORD _CNV_A_R_LINEAR_____29_CM 1 0. 0. 255.99609375 ECU_ADDRESS 0xd00042aa FORMAT "%10.6" /end MEASUREMENT
/begin MEASUREMENT Vtd_fil_knk_noi_cyl[2] "Filtered knock noise for each cylinder" UWORD _CNV_A_R_LINEAR_____29_CM 1 0. 0. 255.99609375 ECU_ADDRESS 0xd00042ac FORMAT "%10.6" /end MEASUREMENT
/begin MEASUREMENT Vtd_fil_knk_noi_cyl[3] "Filtered knock noise for each cylinder" UWORD _CNV_A_R_LINEAR_____29_CM 1 0. 0. 255.99609375 ECU_ADDRESS 0xd00042ae FORMAT "%10.6" /end MEASUREMENT
/begin MEASUREMENT Vtd_knk_det_cyl[0] "Knock detection for each cylinder" UBYTE _CNV_S_2_RANGE______3_CM 1 0. 0. 1. ECU_ADDRESS 0xd0006b2e BIT_MASK 0x1 /end MEASUREMENT
/begin MEASUREMENT Vtd_knk_det_cyl[1] "Knock detection for each cylinder" UBYTE _CNV_S_2_RANGE______3_CM 1 0. 0. 1. ECU_ADDRESS 0xd0006b2f BIT_MASK 0x1 /end MEASUREMENT
/begin MEASUREMENT Vtd_knk_det_cyl[2] "Knock detection for each cylinder" UBYTE _CNV_S_2_RANGE______3_CM 1 0. 0. 1. ECU_ADDRESS 0xd0006b30 BIT_MASK 0x1 /end MEASUREMENT
/begin MEASUREMENT Vtd_knk_det_cyl[3] "Knock detection for each cylinder" UBYTE _CNV_S_2_RANGE______3_CM 1 0. 0. 1. ECU_ADDRESS 0xd0006b31 BIT_MASK 0x1 /end MEASUREMENT
/begin MEASUREMENT Vxx_fil_acq_knk_cyl_1 "Instantaneous knock noise on cylinder 1" UBYTE _CNV_A_R_ECME_LINEA_0_CM 1 0. 0. 255. ECU_ADDRESS 0xd0006b3a FORMAT "%3.0" /end MEASUREMENT
/begin MEASUREMENT Vxx_fil_acq_knk_cyl_2 "Instantaneous knock noise on cylinder 2" UBYTE _CNV_A_R_ECME_LINEA_0_CM 1 0. 0. 255. ECU_ADDRESS 0xd0006b3b FORMAT "%3.0" /end MEASUREMENT
/begin MEASUREMENT Vxx_fil_acq_knk_cyl_3 "Instantaneous knock noise on cylinder 3" UBYTE _CNV_A_R_ECME_LINEA_0_CM 1 0. 0. 255. ECU_ADDRESS 0xd0006b3c FORMAT "%3.0" /end MEASUREMENT
/begin MEASUREMENT Vxx_fil_acq_knk_cyl_4 "Instantaneous knock noise on cylinder 4" UBYTE _CNV_A_R_ECME_LINEA_0_CM 1 0. 0. 255. ECU_ADDRESS 0xd0006b3d FORMAT "%3.0" /end MEASUREMENT
/begin CHARACTERISTIC Cbx_knk_ini_req "Request for initialisation of knock variables" VALUE 0xa0021384 _REC_S1VAL_20_u1 1. _CNV_A_R_ECME_LINEA_0_CM 0. 1. FORMAT "%1.0" BIT_MASK 0x1 /end CHARACTERISTIC
/begin CHARACTERISTIC Cxx_decl_knk_fil_fac "Knock filtering factor when knock increase" VALUE 0xa0021385 _REC_S1VAL_20_u1 1. _CNV_A_R_LINEAR_____162_CM 0. 1. FORMAT "%9.7" /end CHARACTERISTIC
/begin CHARACTERISTIC Cxx_dfdec_knk_oor "a_in_cbi_knk_knkdtxx/Voltage Outside the Expected Range of knock detected failure counter decrement" VALUE 0xa0021374 _REC_S1VAL_20_u2 65535. _CNV_A_R_ECME_LINEA_0_CM 0. 65535. FORMAT "%5.0" /end CHARACTERISTIC
/begin CHARACTERISTIC Cxx_dfdec_knk_shp "a_in_cbi_knk_knkdtxx/Improper Signal Shape of knock detected failure counter decrement" VALUE 0xa0021376 _REC_S1VAL_20_u2 65535. _CNV_A_R_ECME_LINEA_0_CM 0. 65535. FORMAT "%5.0" /end CHARACTERISTIC
/begin CHARACTERISTIC Cxx_dfinc_knk_oor "a_in_cbi_knk_knkdtxx/Voltage Outside the Expected Range of knock detected failure counter increment" VALUE 0xa0021378 _REC_S1VAL_20_u2 65535. _CNV_A_R_ECME_LINEA_0_CM 0. 65535. FORMAT "%5.0" /end CHARACTERISTIC
/begin CHARACTERISTIC Cxx_dfinc_knk_shp "a_in_cbi_knk_knkdtxx/Improper Signal Shape of knock detected failure counter increment" VALUE 0xa002137a _REC_S1VAL_20_u2 65535. _CNV_A_R_ECME_LINEA_0_CM 0. 65535. FORMAT "%5.0" /end CHARACTERISTIC
/begin CHARACTERISTIC Cxx_inc_knk_fil_fac "Knock filtering factor when knock decrease" VALUE 0xa0021386 _REC_S1VAL_20_u1 1. _CNV_A_R_LINEAR_____162_CM 0. 1. FORMAT "%9.7" /end CHARACTERISTIC
/begin CHARACTERISTIC Cxx_knk_det_n_thd "Engine speed threshold above which no knock detection is made" VALUE 0xa002137c _REC_S1VAL_20_u2 16383.75 _CNV_A_R_ENSD_LINEA_22_CM 0. 16383.75 FORMAT "%8.2" /end CHARACTERISTIC
/begin CHARACTERISTIC Cxx_knk_det_prs_thd "Pressure threshold below which no knock detection is made" VALUE 0xa002137e _REC_S1VAL_20_u2 20000. _CNV_A_R_LINEAR_____115_CM 0. 20000. FORMAT "%5.0" /end CHARACTERISTIC
/begin CHARACTERISTIC Cxx_knk_det_tco_thd "Water temperature threshold below which no knock detection is made" VALUE 0xa0021380 _REC_S1VAL_20_u2 240. _CNV_A_R_LINEAR_____110_CM -40. 200. FORMAT "%5.1" /end CHARACTERISTIC
/begin CHARACTERISTIC Cxx_knk_fil_inc "Increment of Vtd_fil_knk_noi_cyl if knock detection is made" VALUE 0xa0021387 _REC_S1VAL_20_u1 255. _CNV_A_R_ECME_LINEA_0_CM 0. 255. FORMAT "%3.0" /end CHARACTERISTIC
/begin CHARACTERISTIC Cxx_knk_n_dsb_thd "Engine speed threshold above which no knock calculation is made" VALUE 0xa0021382 _REC_S1VAL_20_u2 16383.75 _CNV_A_R_ENSD_LINEA_22_CM 0. 16383.75 FORMAT "%8.2" /end CHARACTERISTIC
/begin MEASUREMENT Vxx_map_ref "Command of manifold pressure calculated by the torque structure" UWORD _CNV_A_R_LINEAR_____115_CM 1 0. 0. 20000. ECU_ADDRESS 0xd0003e54 FORMAT "%5.0" /end MEASUREMENT
/begin MEASUREMENT Vxx_raw_map_ref "Command of manifold pressure calculated by the torque structure (without deadzone)" UWORD _CNV_A_R_LINEAR_____115_CM 1 0. 0. 20000. ECU_ADDRESS 0xd0003e56 FORMAT "%5.0" /end MEASUREMENT
/begin CHARACTERISTIC Cxx_map_ref_dz "Command of manifold pressure deadzone" VALUE 0xa0020c9a _REC_S1VAL_20_u2 20000. _CNV_A_R_LINEAR_____115_CM 0. 20000. FORMAT "%5.0" /end CHARACTERISTIC
/begin MEASUREMENT Vxx_airb1 "Byte n°1 of the AIRBAGCrash frame" UBYTE _CNV_A_R_ECME_LINEA_0_CM 1 0. 0. 255. ECU_ADDRESS 0xd0006d99 FORMAT "%3.0" /end MEASUREMENT
/begin MEASUREMENT Vxx_airb2 "Byte n°2 of the AIRBAGCrash frame" UBYTE _CNV_A_R_ECME_LINEA_0_CM 1 0. 0. 255. ECU_ADDRESS 0xd0006d9a FORMAT "%3.0" /end MEASUREMENT
/begin MEASUREMENT Vxx_eng_stop_req_ccu "Emergency engine stop request" UBYTE _CNV_A_R_ECME_LINEA_0_CM 1 0. 0. 255. ECU_ADDRESS 0xd0006d9b FORMAT "%3.0" /end MEASUREMENT
/begin MEASUREMENT Vxx_eng_stop_req_rgb "Engine stop requested by robotized gearbox" UBYTE _CNV_A_R_ECME_LINEA_0_CM 1 0. 0. 255. ECU_ADDRESS 0xd0006d9c FORMAT "%3.0" /end MEASUREMENT
/begin MEASUREMENT Vxx_eng_stop_req_ssg "Engine stop requested by SSG" UBYTE _CNV_A_R_ECME_LINEA_0_CM 1 0. 0. 255. ECU_ADDRESS 0xd0006d9d FORMAT "%3.0" /end MEASUREMENT
/begin MEASUREMENT Vxx_vh_dist "" ULONG _CNV_A_R_LINEAR_____274_CM 1 0. 0. 16777215. DISPLAY_IDENTIFIER INVFIVSI_NVM.Vxx_vh_dist_NVM ECU_ADDRESS 0xd0002854 FORMAT "%8.0" /end MEASUREMENT
/begin MEASUREMENT Vbx_ecu_pres "Production control unit is present" UBYTE _CNV_S_2_RANGE______3_CM 1 0. 0. 1. ECU_ADDRESS 0xd0007c27 BIT_MASK 0x1 /end MEASUREMENT
/begin MEASUREMENT Vsx_vh_dist_l_res_vld "Vehicle mileage with low resolution validity status" UBYTE _CNV_S_3_STATUS_OK__179_CM 1 0. 0. 2. ECU_ADDRESS 0xd0007c28 /end MEASUREMENT
/begin MEASUREMENT Vsx_vh_dist_vld "Vehicle mileage validity status" UBYTE _CNV_S_3_STATUS_OK__179_CM 1 0. 0. 2. ECU_ADDRESS 0xd0007c29 /end MEASUREMENT
/begin MEASUREMENT Vxx_vh_dist_l_res "Total vehicle distance with low resolution" UWORD _CNV_A_R_LINEAR_____384_CM 1 0. 0. 1048560. ECU_ADDRESS 0xd0005f8a FORMAT "%7.0" /end MEASUREMENT
/begin CHARACTERISTIC Cxx_vh_dist_max_dif "Maximum allowed differential value of vehicle distance (for incrementing model)" VALUE 0xa00217f6 _REC_S1VAL_20_u1 255. _CNV_A_R_LINEAR_____274_CM 0. 255. FORMAT "%3.0" /end CHARACTERISTIC
/begin MEASUREMENT Vbx_dspl_vs_in_mph "The vehicule speed used for CC/SL is in mph" UBYTE _CNV_S_2_RANGE______3_CM 1 0. 0. 1. ECU_ADDRESS 0xd0006d9e BIT_MASK 0x1 /end MEASUREMENT
/begin MEASUREMENT Vsx_dspl_vs_vld "Displayed vehicule speed validity status" UBYTE _CNV_S_4_STATUS_OK__180_CM 1 0. 0. 3. ECU_ADDRESS 0xd0006d9f /end MEASUREMENT
/begin MEASUREMENT Vxx_dspl_vs "Displayed vehicle speed" UWORD _CNV_A_R_LINEAR_____125_CM 1 0. 0. 655.35 ECU_ADDRESS 0xd00044ec FORMAT "%6.2" /end MEASUREMENT
/begin MEASUREMENT Vxx_lg_acel "Longitudinal vehicle acceleration" SLONG _CNV_A_R_LINEAR_____385_CM 1 0. -12. 13.5 ECU_ADDRESS 0xd0002860 FORMAT "%8.4" /end MEASUREMENT
/begin MEASUREMENT Vxx_lg_acel_raw "Longitudinal vehicle acceleration raw signal" SLONG _CNV_A_R_LINEAR_____385_CM 1 0. -12. 13.5 ECU_ADDRESS 0xd0002864 FORMAT "%8.4" /end MEASUREMENT
/begin CHARACTERISTIC Cxx_lg_acel_fil "Time constant of the aceleration calcul filter" VALUE 0xa00217fa _REC_S1VAL_20_u1 2.55 _CNV_A_R_LINEAR_____32_CM 0. 2.55 FORMAT "%4.2" /end CHARACTERISTIC
/begin CHARACTERISTIC Cxx_vs_tkof_thd "a_in_vfi_vsi_lacelmd_xxxx_xx_x_a/Take off vehicle speed value" VALUE 0xa00217f8 _REC_S1VAL_20_u2 655.35 _CNV_A_R_LINEAR_____125_CM 0. 655.35 FORMAT "%6.2" /end CHARACTERISTIC
/begin MEASUREMENT Vsx_vs_2_vld "Vehicle speed validity status" UBYTE _CNV_S_4_STATUS_OK__180_CM 1 0. 0. 3. ECU_ADDRESS 0xd0006da3 /end MEASUREMENT
/begin MEASUREMENT Vsx_vs_vld "Vehicule speed validity status" UBYTE _CNV_S_3_STATUS_OK__179_CM 1 0. 0. 2. ECU_ADDRESS 0xd0006da4 /end MEASUREMENT
/begin MEASUREMENT Vxx_vs "Vehicle speed" UWORD _CNV_A_R_LINEAR_____125_CM 1 0. 0. 655.35 ECU_ADDRESS 0xd00044f2 FORMAT "%6.2" /end MEASUREMENT
/begin CHARACTERISTIC Cbx_vs_vld_bch_mod_ena "Boolean to enable the bench mode for vehicle speed validity indicator (1 = enable, forbidden for serial vehicle)" VALUE 0xa00217fb _REC_S1VAL_20_u1 1. _CNV_S_2_RANGE______3_CM 0. 1. BIT_MASK 0x1 /end CHARACTERISTIC
/begin MEASUREMENT Vsx_lft_rwhs_vld "Rear left wheel speed validity status" UBYTE _CNV_S_3_STATUS_OK__179_CM 1 0. 0. 2. ECU_ADDRESS 0xd0006da5 /end MEASUREMENT
/begin MEASUREMENT Vsx_rgt_rwhs_vld "Rear right wheel speed validity status" UBYTE _CNV_S_3_STATUS_OK__179_CM 1 0. 0. 2. ECU_ADDRESS 0xd0006da6 /end MEASUREMENT
/begin MEASUREMENT Vxx_lft_rwhs "Rear left wheel speed" UWORD _CNV_A_R_LINEAR_____125_CM 1 0. 0. 655.34 ECU_ADDRESS 0xd00044f4 FORMAT "%6.2" /end MEASUREMENT
/begin MEASUREMENT Vxx_rgt_rwhs "Rear right wheel speed" UWORD _CNV_A_R_LINEAR_____125_CM 1 0. 0. 655.34 ECU_ADDRESS 0xd00044f6 FORMAT "%6.2" /end MEASUREMENT
/begin MEASUREMENT Vsx_tra_acel_vld "Transverse acceleration validity status" UBYTE _CNV_S_3_STATUS_OK__179_CM 1 0. 0. 2. ECU_ADDRESS 0xd0006da7 /end MEASUREMENT
/begin MEASUREMENT Vxx_tra_acel "Transverse acceleration" SLONG _CNV_A_R_LINEAR_____385_CM 1 0. -12. 13.5 ECU_ADDRESS 0xd0002868 FORMAT "%8.4" /end MEASUREMENT
/begin CHARACTERISTIC Cbx_tra_acel_cfm "Bit to switch the transversal acceleration source" VALUE 0xa00217fc _REC_S1VAL_20_u1 1. _CNV_S_2_RANGE______3_CM 0. 1. BIT_MASK 0x1 /end CHARACTERISTIC
/begin MEASUREMENT Vbx_ini_rel_err_fil "Conditions of reinitialisation of the filter on the relative error" UBYTE _CNV_S_2_RANGE______3_CM 1 0. 0. 1. ECU_ADDRESS 0xd0006dae BIT_MASK 0x1 /end MEASUREMENT
/begin MEASUREMENT Vbx_mdl_tra_acel_ok "The value of the transverse acceleration is valid" UBYTE _CNV_S_2_RANGE______3_CM 1 0. 0. 1. ECU_ADDRESS 0xd0006daf BIT_MASK 0x1 /end MEASUREMENT
/begin MEASUREMENT Vbx_rwhs_ok "Criterion of validity of the  rear wheels speeds" UBYTE _CNV_S_2_RANGE______3_CM 1 0. 0. 1. ECU_ADDRESS 0xd0006db0 BIT_MASK 0x1 /end MEASUREMENT
/begin MEASUREMENT Vbx_t_end "Flag which indicates that the temporal convergence of the filters is OK" UBYTE _CNV_S_2_RANGE______3_CM 1 0. 0. 1. ECU_ADDRESS 0xd0006db1 BIT_MASK 0x1 /end MEASUREMENT
/begin MEASUREMENT Vsx_mdl_tra_acel_vld "Transverse acceleration calculated from rear wheel speed validity status" UBYTE _CNV_S_3_STATUS_OK__179_CM 1 0. 0. 2. ECU_ADDRESS 0xd0006db2 /end MEASUREMENT
/begin MEASUREMENT Vxx_abs_tra_acel_mv "Absolut value of the temporal average of the transverse acceleration" UWORD _CNV_A_R_LINEAR_____385_CM 1 0. 0. 13.5 ECU_ADDRESS 0xd00044fe FORMAT "%7.4" /end MEASUREMENT
/begin MEASUREMENT Vxx_diff_rel_err "Difference between relative error of the speeds of rear wheels and the delayed average relative error" SWORD _CNV_A_R_LINEAR_____386_CM 1 0. -0.450002 0.450002 ECU_ADDRESS 0xd0004500 FORMAT "%9.6" /end MEASUREMENT
/begin MEASUREMENT Vxx_mdl_tra_acel "Transverse acceleration calculated from rear wheel speed" SLONG _CNV_A_R_LINEAR_____385_CM 1 0. -12. 13.5 ECU_ADDRESS 0xd0002878 FORMAT "%8.4" /end MEASUREMENT
/begin MEASUREMENT Vxx_mdl_tra_acel_clc "Transversal acceleration calculated from rear wheel speed" SLONG _CNV_A_R_LINEAR_____385_CM 1 0. -12. 13.5 ECU_ADDRESS 0xd000287c FORMAT "%8.4" /end MEASUREMENT
/begin MEASUREMENT Vxx_rel_err "Relative error of the speeds of rear wheels" SWORD _CNV_A_R_LINEAR_____386_CM 1 0. -0.450002 0.450002 ECU_ADDRESS 0xd0004502 FORMAT "%9.6" /end MEASUREMENT
/begin MEASUREMENT Vxx_rel_err_mv "Relative error of the radiuses of rear wheels" SWORD _CNV_A_R_LINEAR_____386_CM 1 0. -0.450002 0.450002 ECU_ADDRESS 0xd0004504 FORMAT "%9.6" /end MEASUREMENT
/begin MEASUREMENT Vxx_rel_err_mv_dly "Rel_error_avg value delayed from one sample time" SWORD _CNV_A_R_LINEAR_____386_CM 1 0. -0.450002 0.450002 ECU_ADDRESS 0xd0004506 FORMAT "%9.6" /end MEASUREMENT
/begin MEASUREMENT Vxx_rwhs_diff "Difference between the speeds of rear wheels" SWORD _CNV_A_R_LINEAR_____387_CM 1 0. -32.768 32.767 ECU_ADDRESS 0xd0004508 FORMAT "%7.3" /end MEASUREMENT
/begin MEASUREMENT Vxx_rwhs_sum "Sum of the speeds of rear wheels" UWORD _CNV_A_R_LINEAR_____388_CM 1 0. 0. 655.35 ECU_ADDRESS 0xd000450a FORMAT "%6.2" /end MEASUREMENT
/begin MEASUREMENT Vxx_t_wait_tra_acel_vld "Timer to wait the convergence of the filters" UBYTE _CNV_A_R_LINEAR_____131_CM 1 0. 0. 5.1 ECU_ADDRESS 0xd0006db3 FORMAT "%4.2" /end MEASUREMENT
/begin MEASUREMENT Vxx_tra_acel_mv "Temporal average of the transverse acceleration" SLONG _CNV_A_R_LINEAR_____385_CM 1 0. -12. 13.5 ECU_ADDRESS 0xd0002880 FORMAT "%8.4" /end MEASUREMENT
/begin CHARACTERISTIC Cxx_h_thd_tra_acel_ok "High threshold of Abs_gt_avg to validate the information of the transverse acceleration" VALUE 0xa00217fe _REC_S1VAL_20_u2 13.5 _CNV_A_R_LINEAR_____385_CM 0. 13.5 FORMAT "%7.4" /end CHARACTERISTIC
/begin CHARACTERISTIC Cxx_l_thd_tra_acel_ok "Low threshold of Abs_gt_avg to validate the information of the transverse acceleration" VALUE 0xa0021800 _REC_S1VAL_20_u2 13.5 _CNV_A_R_LINEAR_____385_CM 0. 13.5 FORMAT "%7.4" /end CHARACTERISTIC
/begin CHARACTERISTIC Cxx_rel_err_fil "Time constant of the first order filter on the relative error" VALUE 0xa0021804 _REC_S1VAL_20_u1 2550. _CNV_A_R_LINEAR_____389_CM 0. 2550. FORMAT "%4.0" /end CHARACTERISTIC
/begin CHARACTERISTIC Cxx_rel_err_thd_max "Maximal error of detection to avoid the errors due to the bends" VALUE 0xa0021802 _REC_S1VAL_20_u2 0.450002 _CNV_A_R_LINEAR_____390_CM 0. 0.450002 FORMAT "%8.6" /end CHARACTERISTIC
/begin CHARACTERISTIC Cxx_rwhb "Rear wheelbase" VALUE 0xa0021805 _REC_S1VAL_20_u1 2.55 _CNV_A_R_LINEAR_____391_CM 0.5 3.05 FORMAT "%4.2" /end CHARACTERISTIC
/begin CHARACTERISTIC Cxx_rwhs_fil "Time constant of the first order filter of the rear wheels speed" VALUE 0xa0021806 _REC_S1VAL_20_u1 5.1 _CNV_A_R_LINEAR_____131_CM 0. 5.1 FORMAT "%4.2" /end CHARACTERISTIC
/begin CHARACTERISTIC Cxx_rwhs_max_tra_acel "Threshold of maximum rear wheel speed to calculate the transverse acceleration" VALUE 0xa0021807 _REC_S1VAL_20_u1 255. _CNV_A_R_LINEAR_____392_CM 5. 260. FORMAT "%3.0" /end CHARACTERISTIC
/begin CHARACTERISTIC Cxx_rwhs_min_tra_acel "Threshold of minimum rear wheel speed to calculate the transverse acceleration" VALUE 0xa0021808 _REC_S1VAL_20_u1 255. _CNV_A_R_LINEAR_____392_CM 5. 260. FORMAT "%3.0" /end CHARACTERISTIC
/begin CHARACTERISTIC Cxx_tra_acel_mv_fil "Time constant of the first order filter on the average of the transverse acceleration" VALUE 0xa0021809 _REC_S1VAL_20_u1 255. _CNV_A_R_LINEAR_____68_CM 0. 255. FORMAT "%3.0" /end CHARACTERISTIC
/begin CHARACTERISTIC Cxx_wait_tra_acel_vld "Temporization before to calculate the validity of the transverse acceleration" VALUE 0xa002180a _REC_S1VAL_20_u1 25.5 _CNV_A_R_LINEAR_____58_CM 0. 25.5 FORMAT "%4.1" /end CHARACTERISTIC
/begin MEASUREMENT Vxx_crsh_det "" UBYTE _CNV_A_R_ECME_LINEA_0_CM 1 0. 0. 255. DISPLAY_IDENTIFIER VfEstMng_NVM.Vxx_crsh_det_NVM ECU_ADDRESS 0xd0007224 FORMAT "%3.0" /end MEASUREMENT
/begin MEASUREMENT Vxx_crsh_mem "" UBYTE _CNV_A_R_ECME_LINEA_0_CM 1 0. 0. 255. DISPLAY_IDENTIFIER VfEstMng_NVM.Vxx_crsh_mem_NVM ECU_ADDRESS 0xd0007225 FORMAT "%3.0" /end MEASUREMENT
/begin MEASUREMENT Vbx_crsh_lvl1_det "An airbag crash frame level 1 has been received" UBYTE _CNV_S_2_RANGE______3_CM 1 0. 0. 1. ECU_ADDRESS 0xd000722b BIT_MASK 0x1 /end MEASUREMENT
/begin MEASUREMENT Vbx_crsh_lvl2_det "An airbag crash frame level 2 has been received" UBYTE _CNV_S_2_RANGE______3_CM 1 0. 0. 1. ECU_ADDRESS 0xd000722c BIT_MASK 0x1 /end MEASUREMENT
/begin MEASUREMENT Vbx_crsh_lvl2_det_fmt "An airbag crash frame level 2 has been received" UBYTE _CNV_S_2_RANGE______3_CM 1 0. 0. 1. ECU_ADDRESS 0xd000722d BIT_MASK 0x1 /end MEASUREMENT
/begin MEASUREMENT Vbx_eng_stop_srce_dft "Engine stop origin: other cases" UBYTE _CNV_S_2_RANGE______3_CM 1 0. 0. 1. ECU_ADDRESS 0xd000722e BIT_MASK 0x1 /end MEASUREMENT
/begin MEASUREMENT Vbx_eng_stop_srce_norm_driv "Engine stop origin: normal driver request" UBYTE _CNV_S_2_RANGE______3_CM 1 0. 0. 1. ECU_ADDRESS 0xd000722f BIT_MASK 0x1 /end MEASUREMENT
/begin MEASUREMENT Vbx_eng_stop_srce_norm_sys "Engine stop origin: normal system request" UBYTE _CNV_S_2_RANGE______3_CM 1 0. 0. 1. ECU_ADDRESS 0xd0007230 BIT_MASK 0x1 /end MEASUREMENT
/begin MEASUREMENT Vbx_eng_stop_srce_secu "Engine stop origin: emergency request" UBYTE _CNV_S_2_RANGE______3_CM 1 0. 0. 1. ECU_ADDRESS 0xd0007231 BIT_MASK 0x1 /end MEASUREMENT
/begin MEASUREMENT Vxx_eng_run_ena_airb "Engine running authorisation dependent on airbag function" UBYTE _CNV_A_R_ECME_LINEA_0_CM 1 0. 0. 255. ECU_ADDRESS 0xd0007226 FORMAT "%3.0" /end MEASUREMENT
/begin MEASUREMENT Vxx_eng_run_ena_ccu "Engine running authorisation dependent on emergency engine stop request" UBYTE _CNV_A_R_ECME_LINEA_0_CM 1 0. 0. 255. ECU_ADDRESS 0xd0007227 FORMAT "%3.0" /end MEASUREMENT
/begin MEASUREMENT Vxx_eng_run_ena_rgb "Engine running authorisation dependent on robotized gearbox major failure" UBYTE _CNV_A_R_ECME_LINEA_0_CM 1 0. 0. 255. ECU_ADDRESS 0xd0007228 FORMAT "%3.0" /end MEASUREMENT
/begin MEASUREMENT Vxx_eng_run_ena_ssg "Engine running authorisation dependent on SSG function" UBYTE _CNV_A_R_ECME_LINEA_0_CM 1 0. 0. 255. ECU_ADDRESS 0xd0007229 FORMAT "%3.0" /end MEASUREMENT
/begin MEASUREMENT Vxx_run_eng_ena "synthesis of engine stop requests" UBYTE _CNV_A_R_ECME_LINEA_0_CM 1 0. 0. 255. ECU_ADDRESS 0xd000722a FORMAT "%3.0" /end MEASUREMENT
/begin CHARACTERISTIC Cbx_rest_aftr_crsh_ena "Authorization of restart after a crash" VALUE 0xa00220b2 _REC_S1VAL_20_u1 1. _CNV_S_2_RANGE______3_CM 0. 1. /end CHARACTERISTIC
/begin CHARACTERISTIC Cxx_eng_stop_req_airb2_lvl1 "Expected value of 2nd byte of received airbag crash frame for crash level 1" VALUE 0xa00220b3 _REC_S1VAL_20_u1 255. _CNV_A_R_ECME_LINEA_0_CM 0. 255. FORMAT "%3.0" /end CHARACTERISTIC
/begin CHARACTERISTIC Cxx_eng_stop_req_airb2_lvl2 "Expected value of 2nd byte of received airbag crash frame for crash level 2" VALUE 0xa00220b4 _REC_S1VAL_20_u1 255. _CNV_A_R_ECME_LINEA_0_CM 0. 255. FORMAT "%3.0" /end CHARACTERISTIC
/begin CHARACTERISTIC Cxx_eng_stop_req_ccu "Coherence checking of the emergency engine stop request" VALUE 0xa00220b5 _REC_S1VAL_20_u1 255. _CNV_A_R_ECME_LINEA_0_CM 0. 255. FORMAT "%3.0" /end CHARACTERISTIC
/begin CHARACTERISTIC Cxx_eng_stop_req_rgb "Coherence checking of the robotized gearbox engine stop request" VALUE 0xa00220b6 _REC_S1VAL_20_u1 255. _CNV_A_R_ECME_LINEA_0_CM 0. 255. FORMAT "%3.0" /end CHARACTERISTIC
/begin CHARACTERISTIC Cxx_eng_stop_req_ssg "Coherence checking of the SSG engine stop request" VALUE 0xa00220b7 _REC_S1VAL_20_u1 255. _CNV_A_R_ECME_LINEA_0_CM 0. 255. FORMAT "%3.0" /end CHARACTERISTIC
/begin CHARACTERISTIC Cxx_rest_aftr_crsh_dly "Time after crash to authorize an engine running" VALUE 0xa00220b0 _REC_S1VAL_20_u2 655.35 _CNV_A_R_LINEAR_____32_CM 0. 655.35 FORMAT "%6.2" /end CHARACTERISTIC
/begin AXIS_PTS Ctb_map "Maniflod pressure value break points" 0xa00281f4 Vxx_map _REC_A2AXS_20_u2 20000. _CNV_A_R_LINEAR_____115_CM 20 0. 20000. FORMAT "%5.0" /end AXIS_PTS
/begin CHARACTERISTIC Cmp_prs_n_pwm_cp "PWM of the constant rate purge canister" MAP 0xa0028220 _REC_A1MAP_20_u2_u2_u2 100. _CNV_A_R_LINEAR_____159_CM 0. 100. FORMAT "%12.8"
 /begin AXIS_DESCR COM_AXIS Vxx_map _CNV_A_R_LINEAR_____115_CM 20 0. 20000. FORMAT "%5.0" AXIS_PTS_REF Ctb_map /end AXIS_DESCR
 /begin AXIS_DESCR COM_AXIS Vxx_n _CNV_A_R_ENSD_LINEA_22_CM 20 0. 16383.75 FORMAT "%8.2" AXIS_PTS_REF Ctb_n /end AXIS_DESCR
/end CHARACTERISTIC
/begin MEASUREMENT Vbx_cp_clc_cdn "Condition for the calculation event" UBYTE _CNV_S_2_RANGE______3_CM 1 0. 0. 1. ECU_ADDRESS 0xd0006732 BIT_MASK 0x1 /end MEASUREMENT
/begin MEASUREMENT Vbx_cp_cmd_frq "Frequency command selection of the canister purge" UBYTE _CNV_S_2_RANGE______3_CM 1 0. 0. 1. ECU_ADDRESS 0xd00077d9 BIT_MASK 0x1 /end MEASUREMENT
/begin MEASUREMENT Vxx_cp_pwm "Theoretical PWM allowing to obtain completely a constant rate of the canister purge" UWORD _CNV_A_R_LINEAR_____159_CM 1 0. 0. 100. ECU_ADDRESS 0xd00050fe FORMAT "%12.8" /end MEASUREMENT
/begin MEASUREMENT Vxx_cp_pwm_appl "PWM for the canister purge valve mass air flow" UWORD _CNV_A_R_LINEAR_____159_CM 1 0. 0. 100. ECU_ADDRESS 0xd0005100 FORMAT "%12.8" /end MEASUREMENT
/begin MEASUREMENT Vxx_cp_pwm_cmd "PWM for the canister purge valve mass air flow (PWM size)" UWORD _CNV_A_R_LINEAR_____159_CM 1 0. 0. 100. ECU_ADDRESS 0xd0005102 FORMAT "%12.8" /end MEASUREMENT
/begin MEASUREMENT Vxx_cp_pwm_cor "PWM for the canister purge valve" UWORD _CNV_A_R_LINEAR_____159_CM 1 0. 0. 100. ECU_ADDRESS 0xd0005104 FORMAT "%12.8" /end MEASUREMENT
/begin MEASUREMENT Vxx_cp_pwm_efv_fac "Real factor of the canister purge rate" UBYTE _CNV_A_R_LINEAR_____162_CM 1 0. 0. 1. ECU_ADDRESS 0xd00077da FORMAT "%9.7" /end MEASUREMENT
/begin MEASUREMENT Vxx_cp_pwm_fac "Canister purge rate factor" UWORD _CNV_A_R_LINEAR_____143_CM 1 0. 0. 1. ECU_ADDRESS 0xd0003fce FORMAT "%10.9" /end MEASUREMENT
/begin MEASUREMENT Vxx_cp_pwm_max "Max of objective canister purge rate factor" UBYTE _CNV_A_R_LINEAR_____162_CM 1 0. 0. 1. ECU_ADDRESS 0xd0006733 FORMAT "%9.7" /end MEASUREMENT
/begin MEASUREMENT Vxx_cp_pwm_min "PWM for the canister purge valve minimum" UWORD _CNV_A_R_LINEAR_____159_CM 1 0. 0. 100. ECU_ADDRESS 0xd0005106 FORMAT "%12.8" /end MEASUREMENT
/begin MEASUREMENT Vxx_cp_pwm_sp "Objective canister purge rate factor" UBYTE _CNV_A_R_LINEAR_____162_CM 1 0. 0. 1. ECU_ADDRESS 0xd0006734 FORMAT "%9.7" /end MEASUREMENT
/begin MEASUREMENT Vxx_cp_pwm_sp_cor "Objective canister purge rate factor correction" UWORD _CNV_A_R_LINEAR_____143_CM 1 0. 0. 1. ECU_ADDRESS 0xd0005108 FORMAT "%10.9" /end MEASUREMENT
/begin MEASUREMENT Vxx_cp_pwm_step "Canister purge rate step" UWORD _CNV_A_R_LINEAR_____143_CM 1 0. 0. 1. ECU_ADDRESS 0xd000510a FORMAT "%10.9" /end MEASUREMENT
/begin MEASUREMENT Vxx_cp_pwm_step_cor "Canister purge rate step correction" UWORD _CNV_A_R_LINEAR_____159_CM 1 0. 0. 100. ECU_ADDRESS 0xd000510c FORMAT "%12.8" /end MEASUREMENT
/begin CHARACTERISTIC Cxx_cp_fac_pwm "Canister purge rate layout" VALUE 0xa0020e70 _REC_S1VAL_20_u1 0.996078431372549 _CNV_A_R_LINEAR_____162_CM 3.92156862745098e-003 1. FORMAT "%12.8" /end CHARACTERISTIC
/begin CHARACTERISTIC Cxx_cp_flr_min_1 "Nominal value of the opening of the valve minimum slow  frequency beginning " VALUE 0xa0020e58 _REC_S1VAL_20_u2 100. _CNV_A_R_LINEAR_____159_CM 0. 100. FORMAT "%12.8" /end CHARACTERISTIC
/begin CHARACTERISTIC Cxx_cp_flr_min_2 "Nominal value of the opening of the valve minimum fast  frequency beginning " VALUE 0xa0020e5a _REC_S1VAL_20_u2 100. _CNV_A_R_LINEAR_____159_CM 0. 100. FORMAT "%12.8" /end CHARACTERISTIC
/begin CHARACTERISTIC Cxx_cp_hys_n_frq "Engine hysterisis for the choice of the canister purge frequency command" VALUE 0xa0020e5c _REC_S1VAL_20_u2 16383.75 _CNV_A_R_ENSD_LINEA_22_CM 0. 16383.75 FORMAT "%8.2" /end CHARACTERISTIC
/begin CHARACTERISTIC Cxx_cp_n_frq "Engine speed threshold for the choice of the canister purge frequency" VALUE 0xa0020e5e _REC_S1VAL_20_u2 16383.75 _CNV_A_R_ENSD_LINEA_22_CM 0. 16383.75 FORMAT "%8.2" /end CHARACTERISTIC
/begin CHARACTERISTIC Cxx_cp_pwm_cor_max "Maximum value command for the closure of the purge and authorizing the diagnosis" VALUE 0xa0020e60 _REC_S1VAL_20_u2 100. _CNV_A_R_LINEAR_____159_CM 0. 100. FORMAT "%12.8" /end CHARACTERISTIC
/begin CHARACTERISTIC Cxx_cp_pwm_efv_fac_zero "Division by zero : Real factor of the canister purge rate" VALUE 0xa0020e71 _REC_S1VAL_20_u1 1. _CNV_A_R_LINEAR_____162_CM 0. 1. FORMAT "%9.7" /end CHARACTERISTIC
/begin CHARACTERISTIC Cxx_cp_pwm_max_1 "Canister purge rate limitation in phase NOMINAL PURGE" VALUE 0xa0020e72 _REC_S1VAL_20_u1 1. _CNV_A_R_LINEAR_____162_CM 0. 1. FORMAT "%9.7" /end CHARACTERISTIC
/begin CHARACTERISTIC Cxx_cp_pwm_max_2 "Canister purge rate limitation in phase ADAPTATIVE PURGE" VALUE 0xa0020e73 _REC_S1VAL_20_u1 1. _CNV_A_R_LINEAR_____162_CM 0. 1. FORMAT "%9.7" /end CHARACTERISTIC
/begin CHARACTERISTIC Cxx_cp_pwm_max_3 "Canister purge rate limitation in phase NOMINAL PURGE" VALUE 0xa0020e74 _REC_S1VAL_20_u1 1. _CNV_A_R_LINEAR_____162_CM 0. 1. FORMAT "%9.7" /end CHARACTERISTIC
/begin CHARACTERISTIC Cxx_cp_pwm_max_4 "Canister purge rate limitation in phase ADAPTATIVE PURGE" VALUE 0xa0020e75 _REC_S1VAL_20_u1 1. _CNV_A_R_LINEAR_____162_CM 0. 1. FORMAT "%9.7" /end CHARACTERISTIC
/begin CHARACTERISTIC Cxx_cp_pwm_min_1 "Minimum value command for the closure of the purge and authorizing the diagnosis" VALUE 0xa0020e62 _REC_S1VAL_20_u2 100. _CNV_A_R_LINEAR_____159_CM 0. 100. FORMAT "%12.8" /end CHARACTERISTIC
/begin CHARACTERISTIC Cxx_cp_pwm_min_2 "Minimum value command for the closure of the purge and authorizing the diagnosis" VALUE 0xa0020e64 _REC_S1VAL_20_u2 100. _CNV_A_R_LINEAR_____159_CM 0. 100. FORMAT "%12.8" /end CHARACTERISTIC
/begin CHARACTERISTIC Cxx_cp_pwm_sp1 "Canister purge unadaptation set point" VALUE 0xa0020e76 _REC_S1VAL_20_u1 1. _CNV_A_R_LINEAR_____162_CM 0. 1. FORMAT "%9.7" /end CHARACTERISTIC
/begin CHARACTERISTIC Cxx_cp_pwm_sp2 "Canister purge unadaptation set point" VALUE 0xa0020e77 _REC_S1VAL_20_u1 1. _CNV_A_R_LINEAR_____162_CM 0. 1. FORMAT "%9.7" /end CHARACTERISTIC
/begin CHARACTERISTIC Cxx_cp_pwm_sp3 "Canister purge unadaptation set point" VALUE 0xa0020e78 _REC_S1VAL_20_u1 1. _CNV_A_R_LINEAR_____162_CM 0. 1. FORMAT "%9.7" /end CHARACTERISTIC
/begin CHARACTERISTIC Cxx_cp_pwm_sp4 "Canister purge unadaptation set point" VALUE 0xa0020e79 _REC_S1VAL_20_u1 1. _CNV_A_R_LINEAR_____162_CM 0. 1. FORMAT "%9.7" /end CHARACTERISTIC
/begin CHARACTERISTIC Cxx_cp_pwm_sp_zero "Division by zero : Objective canister purge rate factor" VALUE 0xa0020e7a _REC_S1VAL_20_u1 1. _CNV_A_R_LINEAR_____162_CM 0. 1. FORMAT "%9.7" /end CHARACTERISTIC
/begin CHARACTERISTIC Cxx_cp_pwm_step_1 "Canister purge rate step in phase PURGE ADAPTATIVE" VALUE 0xa0020e66 _REC_S1VAL_20_u2 100. _CNV_A_R_LINEAR_____159_CM 0. 100. FORMAT "%12.8" /end CHARACTERISTIC
/begin CHARACTERISTIC Cxx_cp_pwm_step_2 "Canister purge rate step in phase PURGE ADAPTATIVE" VALUE 0xa0020e68 _REC_S1VAL_20_u2 100. _CNV_A_R_LINEAR_____159_CM 0. 100. FORMAT "%12.8" /end CHARACTERISTIC
/begin CHARACTERISTIC Cxx_cp_pwm_step_3 "Canister purge rate step in phase PURGE ADAPTATIVE" VALUE 0xa0020e6a _REC_S1VAL_20_u2 100. _CNV_A_R_LINEAR_____159_CM 0. 100. FORMAT "%12.8" /end CHARACTERISTIC
/begin CHARACTERISTIC Cxx_cp_pwm_step_4 "Canister purge rate step in phase PURGE ADAPTATIVE" VALUE 0xa0020e6c _REC_S1VAL_20_u2 100. _CNV_A_R_LINEAR_____159_CM 0. 100. FORMAT "%12.8" /end CHARACTERISTIC
/begin CHARACTERISTIC Cxx_cp_pwm_step_5 "Canister purge rate step in case of manager closure" VALUE 0xa0020e6e _REC_S1VAL_20_u2 100. _CNV_A_R_LINEAR_____159_CM 0. 100. FORMAT "%12.8" /end CHARACTERISTIC
/begin CHARACTERISTIC Ctp_tco_is_l_it_psn "Low throttle position in idle speed ( depending on tco)" CURVE 0xa00281e0 _REC_A1CUR_20_u2_u2 100. _CNV_A_R_LINEAR_____150_CM 0. 100. FORMAT "%6.2"
 /begin AXIS_DESCR COM_AXIS Vxx_tco _CNV_A_R_LINEAR_____110_CM 9 -40. 200. FORMAT "%5.1" AXIS_PTS_REF Ctb_tco2 /end AXIS_DESCR
/end CHARACTERISTIC
/begin MEASUREMENT Vbx_cp_eng_cdn_cl_ena "Engine condition for the close loop purge" UBYTE _CNV_S_2_RANGE______3_CM 1 0. 0. 1. ECU_ADDRESS 0xd00077d2 BIT_MASK 0x1 /end MEASUREMENT
/begin MEASUREMENT Vbx_cp_eng_cdn_is_ena "Engine condition for the idle speed canister purge" UBYTE _CNV_S_2_RANGE______3_CM 1 0. 0. 1. ECU_ADDRESS 0xd00077d3 BIT_MASK 0x1 /end MEASUREMENT
/begin MEASUREMENT Vbx_cp_eng_cdn_ol_ena "Canister purge condition for the purge set point" UBYTE _CNV_S_2_RANGE______3_CM 1 0. 0. 1. ECU_ADDRESS 0xd00077d4 BIT_MASK 0x1 /end MEASUREMENT
/begin MEASUREMENT Vbx_cp_eng_cdn_sp_ena "Engine condition for canister purge purpose" UBYTE _CNV_S_2_RANGE______3_CM 1 0. 0. 1. ECU_ADDRESS 0xd00077d5 BIT_MASK 0x1 /end MEASUREMENT
/begin MEASUREMENT Vbx_cp_fct "Nominal canister purge" UBYTE _CNV_S_2_RANGE______3_CM 1 0. 0. 1. ECU_ADDRESS 0xd000672d BIT_MASK 0x1 /end MEASUREMENT
/begin MEASUREMENT Vbx_cp_fct_ad "Adaptive canister purge" UBYTE _CNV_S_2_RANGE______3_CM 1 0. 0. 1. ECU_ADDRESS 0xd000672e BIT_MASK 0x1 /end MEASUREMENT
/begin MEASUREMENT Vbx_cp_load_ad "Canister purge load learnt" UBYTE _CNV_S_2_RANGE______3_CM 1 0. 0. 1. ECU_ADDRESS 0xd000672f BIT_MASK 0x1 /end MEASUREMENT
/begin MEASUREMENT Vbx_cp_req "Nominal canister purge request" UBYTE _CNV_S_2_RANGE______3_CM 1 0. 0. 1. ECU_ADDRESS 0xd0006730 BIT_MASK 0x1 /end MEASUREMENT
/begin MEASUREMENT Vbx_cp_req_ad "Adaptive canister purge request" UBYTE _CNV_S_2_RANGE______3_CM 1 0. 0. 1. ECU_ADDRESS 0xd0006731 BIT_MASK 0x1 /end MEASUREMENT
/begin MEASUREMENT Vbx_cp_stop_ad "Richness closed loop correction is requested to be set to 1" UBYTE _CNV_S_2_RANGE______3_CM 1 0. 0. 1. ECU_ADDRESS 0xd00077d6 BIT_MASK 0x1 /end MEASUREMENT
/begin MEASUREMENT Vbx_l_is_it_psn "Low throttle position in idle speed for PWM computation" UBYTE _CNV_S_2_RANGE______3_CM 1 0. 0. 1. ECU_ADDRESS 0xd00077d7 BIT_MASK 0x1 /end MEASUREMENT
/begin MEASUREMENT Vsx_cp "Canister purge state machine" UBYTE _CNV_S_5_CANISTER_P_393_CM 1 0. 0. 8. ECU_ADDRESS 0xd00077d8 /end MEASUREMENT
/begin MEASUREMENT Vxx_ad_cp_dly "Canister purge delay for the charge learning" UWORD _CNV_A_R_LINEAR_____32_CM 1 0. 0. 655.35 ECU_ADDRESS 0xd00050f4 FORMAT "%6.2" /end MEASUREMENT
/begin MEASUREMENT Vxx_ad_cp_fct_dly "Canister purge delay of the adaptive maximum duration " UWORD _CNV_A_R_LINEAR_____58_CM 1 0. 0. 6553.5 ECU_ADDRESS 0xd00050f6 FORMAT "%6.1" /end MEASUREMENT
/begin MEASUREMENT Vxx_cp_dly "Canister purge delay of the nominal duration " UWORD _CNV_A_R_LINEAR_____32_CM 1 0. 0. 655.35 ECU_ADDRESS 0xd00050f8 FORMAT "%6.2" /end MEASUREMENT
/begin MEASUREMENT Vxx_cp_rtn_dly "Canister purge delay of the maintain in nominal mode" UWORD _CNV_A_R_LINEAR_____32_CM 1 0. 0. 655.35 ECU_ADDRESS 0xd00050fa FORMAT "%6.2" /end MEASUREMENT
/begin MEASUREMENT Vxx_mv_cl_ti_fac_cp_dly "Canister purge delay for the out of purge mode stabilization" UWORD _CNV_A_R_LINEAR_____32_CM 1 0. 0. 655.35 ECU_ADDRESS 0xd00050fc FORMAT "%6.2" /end MEASUREMENT
/begin CHARACTERISTIC Cxx_cp_ad_tco_min_thd "Minimal water temperature to authorize the end of the surveillance of the canister charge" VALUE 0xa0020e3a _REC_S1VAL_20_u2 240. _CNV_A_R_LINEAR_____110_CM -40. 200. FORMAT "%5.1" /end CHARACTERISTIC
/begin CHARACTERISTIC Cxx_cp_ad_thd "Minimum canister charge to authorize the nominal mode" VALUE 0xa0020e3c _REC_S1VAL_20_u2 0.666656494140625 _CNV_A_R_LINEAR_____50_CM 0. 0.666656494140625 FORMAT "%8.7" /end CHARACTERISTIC
/begin CHARACTERISTIC Cxx_cp_is_tco_min_thd "Minimal water temperature to purge in idle speed (icing)" VALUE 0xa0020e3e _REC_S1VAL_20_u2 240. _CNV_A_R_LINEAR_____110_CM -40. 200. FORMAT "%5.1" /end CHARACTERISTIC
/begin CHARACTERISTIC Cxx_cp_is_tia_min_thd "Minimal air temperature to purge in idle speed (noise)" VALUE 0xa0020e40 _REC_S1VAL_20_u2 240. _CNV_A_R_LINEAR_____110_CM -40. 200. FORMAT "%5.1" /end CHARACTERISTIC
/begin CHARACTERISTIC Cxx_cp_max_ad_dly "Maximum delay in adaptive phase" VALUE 0xa0020e42 _REC_S1VAL_20_u2 6553.5 _CNV_A_R_LINEAR_____58_CM 0. 6553.5 FORMAT "%6.1" /end CHARACTERISTIC
/begin CHARACTERISTIC Cxx_cp_max_dly "Maximal delay to authorize the nominal mode" VALUE 0xa0020e44 _REC_S1VAL_20_u2 655.35 _CNV_A_R_LINEAR_____32_CM 0. 655.35 FORMAT "%6.2" /end CHARACTERISTIC
/begin CHARACTERISTIC Cxx_cp_max_prs_thd "Maximal pressure to learn the canister charge" VALUE 0xa0020e46 _REC_S1VAL_20_u2 20000. _CNV_A_R_LINEAR_____115_CM 0. 20000. FORMAT "%5.0" /end CHARACTERISTIC
/begin CHARACTERISTIC Cxx_cp_min_ad_dly "Minimal delay in adaptive phase" VALUE 0xa0020e48 _REC_S1VAL_20_u2 655.35 _CNV_A_R_LINEAR_____32_CM 0. 655.35 FORMAT "%6.2" /end CHARACTERISTIC
/begin CHARACTERISTIC Cxx_cp_min_dly "Minimal delay to authorize the nominal mode" VALUE 0xa0020e4a _REC_S1VAL_20_u2 655.35 _CNV_A_R_LINEAR_____32_CM 0. 655.35 FORMAT "%6.2" /end CHARACTERISTIC
/begin CHARACTERISTIC Cxx_cp_n_thd "Minimal speed engine to purge in case of a throttle failure" VALUE 0xa0020e4c _REC_S1VAL_20_u2 16383.75 _CNV_A_R_ENSD_LINEA_22_CM 0. 16383.75 FORMAT "%8.2" /end CHARACTERISTIC
/begin CHARACTERISTIC Cxx_cp_ol_tco_min_thd "Water temperature under wich the purge before the closed loop is authorized" VALUE 0xa0020e4e _REC_S1VAL_20_u2 240. _CNV_A_R_LINEAR_____110_CM -40. 200. FORMAT "%5.1" /end CHARACTERISTIC
/begin CHARACTERISTIC Cxx_cp_rtn_dly_dec "Delay in out of purge mode" VALUE 0xa0020e50 _REC_S1VAL_20_u2 655.35 _CNV_A_R_LINEAR_____32_CM 0. 655.35 FORMAT "%6.2" /end CHARACTERISTIC
/begin CHARACTERISTIC Cxx_cp_stab_dly "Delay for the out of purge mode" VALUE 0xa0020e52 _REC_S1VAL_20_u2 655.35 _CNV_A_R_LINEAR_____32_CM 0. 655.35 FORMAT "%6.2" /end CHARACTERISTIC
/begin CHARACTERISTIC Cxx_cp_tco_min_thd "Minimal water temperature to purge (noise)" VALUE 0xa0020e54 _REC_S1VAL_20_u2 240. _CNV_A_R_LINEAR_____110_CM -40. 200. FORMAT "%5.1" /end CHARACTERISTIC
/begin CHARACTERISTIC Cxx_cp_tia_min_thd "Minimal air temperature to purge (icing)" VALUE 0xa0020e56 _REC_S1VAL_20_u2 240. _CNV_A_R_LINEAR_____110_CM -40. 200. FORMAT "%5.1" /end CHARACTERISTIC
/begin MEASUREMENT Vbx_boost_td "Boolean indicating we enable \"to boost\" dwell" UBYTE _CNV_S_2_RANGE______3_CM 1 0. 0. 1. ECU_ADDRESS 0xd0006eb7 BIT_MASK 0x1 /end MEASUREMENT
/begin MEASUREMENT Vbx_igc_stt_ena "Start dwell boost authorization" UBYTE _CNV_S_2_RANGE______3_CM 1 0. 0. 1. ECU_ADDRESS 0xd0006eb8 BIT_MASK 0x1 /end MEASUREMENT
/begin MEASUREMENT Vbx_trs_td "Boolean indicating that transition counter is not ended" UBYTE _CNV_S_2_RANGE______3_CM 1 0. 0. 1. ECU_ADDRESS 0xd0006eb9 BIT_MASK 0x1 /end MEASUREMENT
/begin MEASUREMENT Vxx_ctr_tdc_aftr_trs "Counter after transition." UBYTE _CNV_A_R_ECME_LINEA_0_CM 1 0. 0. 255. ECU_ADDRESS 0xd0006eba FORMAT "%3.0" /end MEASUREMENT
/begin MEASUREMENT Vxx_igc_stt_td "Counter of the start dwell boost mode" UWORD _CNV_A_R_LINEAR_____123_CM 1 0. 0. 655.35 ECU_ADDRESS 0xd000464c FORMAT "%6.2" /end MEASUREMENT
/begin MEASUREMENT Vxx_td_stab_min "Counter for minimum duration not to authorize \"to boost\" dwell (after transition mode)" UWORD _CNV_A_R_LINEAR_____32_CM 1 0. 0. 655.35 ECU_ADDRESS 0xd000464e FORMAT "%6.2" /end MEASUREMENT
/begin MEASUREMENT Vxx_td_tra_max "Counter for maximum duration to authorize \"to boost\" dwell (in transition mode)" UWORD _CNV_A_R_LINEAR_____32_CM 1 0. 0. 655.35 ECU_ADDRESS 0xd0004650 FORMAT "%6.2" /end MEASUREMENT
/begin CHARACTERISTIC Cxx_igc_stt_dly "Start boost delay" VALUE 0xa0021a2a _REC_S1VAL_20_u2 655.35 _CNV_A_R_LINEAR_____32_CM 0. 655.35 FORMAT "%6.2" /end CHARACTERISTIC
/begin CHARACTERISTIC Cxx_igc_stt_tco_thd "Threshold above which start boost is inhibited" VALUE 0xa0021a2c _REC_S1VAL_20_u2 240. _CNV_A_R_LINEAR_____110_CM -40. 200. FORMAT "%5.1" /end CHARACTERISTIC
/begin CHARACTERISTIC Cxx_pap_dwl "Minimum throttle threshold to switch on map" VALUE 0xa0021a2e _REC_S1VAL_20_u2 100. _CNV_A_R_LINEAR_____150_CM 0. 100. FORMAT "%6.2" /end CHARACTERISTIC
/begin CHARACTERISTIC Cxx_td_stab_min "Minimum duration not to authorize \"to boost\" dwell (after transition mode)" VALUE 0xa0021a30 _REC_S1VAL_20_u2 655.35 _CNV_A_R_LINEAR_____32_CM 0. 655.35 FORMAT "%6.2" /end CHARACTERISTIC
/begin CHARACTERISTIC Cxx_td_tra_auth_max "Maximum duration to authorize \"to boost\" dwell (in transition mode)" VALUE 0xa0021a32 _REC_S1VAL_20_u2 655.35 _CNV_A_R_LINEAR_____32_CM 0. 655.35 FORMAT "%6.2" /end CHARACTERISTIC
/begin CHARACTERISTIC Cxx_tra_dwl "Number of TDC to apply map values in transition mode" VALUE 0xa0021a34 _REC_S1VAL_20_u1 255. _CNV_A_R_LINEAR_____101_CM 0. 255. FORMAT "%3.0" /end CHARACTERISTIC
/begin MEASUREMENT Vbx_ign_cut_cyl1 "No ignition command of cylinder 1" UBYTE _CNV_S_2_RANGE______3_CM 1 0. 0. 1. ECU_ADDRESS 0xd0006ebc BIT_MASK 0x1 /end MEASUREMENT
/begin MEASUREMENT Vbx_ign_cut_cyl2 "No ignition command of cylinder 2" UBYTE _CNV_S_2_RANGE______3_CM 1 0. 0. 1. ECU_ADDRESS 0xd0006ebd BIT_MASK 0x1 /end MEASUREMENT
/begin MEASUREMENT Vbx_ign_cut_cyl3 "No ignition command of cylinder 3" UBYTE _CNV_S_2_RANGE______3_CM 1 0. 0. 1. ECU_ADDRESS 0xd0006ebe BIT_MASK 0x1 /end MEASUREMENT
/begin MEASUREMENT Vbx_ign_cut_cyl4 "No ignition command of cylinder 4" UBYTE _CNV_S_2_RANGE______3_CM 1 0. 0. 1. ECU_ADDRESS 0xd0006ebf BIT_MASK 0x1 /end MEASUREMENT
/begin MEASUREMENT Vbx_mis_bch_cyl_0 "Current Ignition for Vxx_tdc_ctr = 0" UBYTE _CNV_S_2_RANGE______3_CM 1 0. 0. 1. ECU_ADDRESS 0xd0006ec0 BIT_MASK 0x1 /end MEASUREMENT
/begin MEASUREMENT Vbx_mis_bch_cyl_1 "Current Ignition for Vxx_tdc_ctr = 1" UBYTE _CNV_S_2_RANGE______3_CM 1 0. 0. 1. ECU_ADDRESS 0xd0006ec1 BIT_MASK 0x1 /end MEASUREMENT
/begin MEASUREMENT Vbx_mis_bch_cyl_2 "Current Ignition for Vxx_tdc_ctr = 2" UBYTE _CNV_S_2_RANGE______3_CM 1 0. 0. 1. ECU_ADDRESS 0xd0006ec2 BIT_MASK 0x1 /end MEASUREMENT
/begin MEASUREMENT Vbx_mis_bch_cyl_3 "Current Ignition for Vxx_tdc_ctr = 3" UBYTE _CNV_S_2_RANGE______3_CM 1 0. 0. 1. ECU_ADDRESS 0xd0006ec3 BIT_MASK 0x1 /end MEASUREMENT
/begin MEASUREMENT Vbx_mis_bch_igc_cut_req "No ignition request" UBYTE _CNV_S_2_RANGE______3_CM 1 0. 0. 1. ECU_ADDRESS 0xd0006ec4 BIT_MASK 0x1 /end MEASUREMENT
/begin CHARACTERISTIC Cbx_mis_bch_mod "Misfire bench mode activation boolean" VALUE 0xa0021a35 _REC_S1VAL_20_u1 1. _CNV_A_R_ECME_LINEA_0_CM 0. 1. FORMAT "%1.0" BIT_MASK 0x1 /end CHARACTERISTIC
/begin CHARACTERISTIC Cxx_mis_bch_mis_rat "Misfire bench mode : rate of misfire" VALUE 0xa0021a36 _REC_S1VAL_20_u1 255. _CNV_A_R_ECME_LINEA_0_CM 0. 255. FORMAT "%3.0" /end CHARACTERISTIC
/begin MEASUREMENT Vsx_igc1_vld "Ignition coil 1 validity status." UBYTE _CNV_A_R_ECME_LINEA_0_CM 1 0. 0. 1. ECU_ADDRESS 0xd0006eac FORMAT "%1.0" /end MEASUREMENT
/begin MEASUREMENT Vsx_igc2_vld "Ignition coil 2 validity status." UBYTE _CNV_A_R_ECME_LINEA_0_CM 1 0. 0. 1. ECU_ADDRESS 0xd0006ead FORMAT "%1.0" /end MEASUREMENT
/begin MEASUREMENT Vsx_igc3_vld "Ignition coil 3 validity status." UBYTE _CNV_A_R_ECME_LINEA_0_CM 1 0. 0. 1. ECU_ADDRESS 0xd0006eae FORMAT "%1.0" /end MEASUREMENT
/begin MEASUREMENT Vsx_igc4_vld "Ignition coil 4 validity status." UBYTE _CNV_A_R_ECME_LINEA_0_CM 1 0. 0. 1. ECU_ADDRESS 0xd0006eaf FORMAT "%1.0" /end MEASUREMENT
/begin MEASUREMENT Vsx_igc_vld "Ignition coils validity status." UBYTE _CNV_A_R_ECME_LINEA_0_CM 1 0. 0. 1. ECU_ADDRESS 0xd0006eb0 FORMAT "%1.0" /end MEASUREMENT
/begin CHARACTERISTIC Cxx_dfdec_igc_1_oc "Open Circuit of ignition coil 1 detected failure counter decrement." VALUE 0xa00219fa _REC_S1VAL_20_u2 65535. _CNV_A_R_ECME_LINEA_0_CM 0. 65535. FORMAT "%5.0" /end CHARACTERISTIC
/begin CHARACTERISTIC Cxx_dfdec_igc_1_scg "Short Circuit to Ground of ignition coil 1 detected failure counter decrement." VALUE 0xa00219fc _REC_S1VAL_20_u2 65535. _CNV_A_R_ECME_LINEA_0_CM 0. 65535. FORMAT "%5.0" /end CHARACTERISTIC
/begin CHARACTERISTIC Cxx_dfdec_igc_1_scw "Short Circuit to Battery of ignition coil 1 detected failure counter decrement." VALUE 0xa00219fe _REC_S1VAL_20_u2 65535. _CNV_A_R_ECME_LINEA_0_CM 0. 65535. FORMAT "%5.0" /end CHARACTERISTIC
/begin CHARACTERISTIC Cxx_dfdec_igc_2_oc "Open Circuit of ignition coil 2 detected failure counter decrement." VALUE 0xa0021a00 _REC_S1VAL_20_u2 65535. _CNV_A_R_ECME_LINEA_0_CM 0. 65535. FORMAT "%5.0" /end CHARACTERISTIC
/begin CHARACTERISTIC Cxx_dfdec_igc_2_scg "Short Circuit to Ground of ignition coil 2 detected failure counter decrement." VALUE 0xa0021a02 _REC_S1VAL_20_u2 65535. _CNV_A_R_ECME_LINEA_0_CM 0. 65535. FORMAT "%5.0" /end CHARACTERISTIC
/begin CHARACTERISTIC Cxx_dfdec_igc_2_scw "Short Circuit to Battery of ignition coil 2 detected failure counter decrement." VALUE 0xa0021a04 _REC_S1VAL_20_u2 65535. _CNV_A_R_ECME_LINEA_0_CM 0. 65535. FORMAT "%5.0" /end CHARACTERISTIC
/begin CHARACTERISTIC Cxx_dfdec_igc_3_oc "Open Circuit of ignition coil 3 detected failure counter decrement." VALUE 0xa0021a06 _REC_S1VAL_20_u2 65535. _CNV_A_R_ECME_LINEA_0_CM 0. 65535. FORMAT "%5.0" /end CHARACTERISTIC
/begin CHARACTERISTIC Cxx_dfdec_igc_3_scg "Short Circuit to Ground of ignition coil 3 detected failure counter decrement." VALUE 0xa0021a08 _REC_S1VAL_20_u2 65535. _CNV_A_R_ECME_LINEA_0_CM 0. 65535. FORMAT "%5.0" /end CHARACTERISTIC
/begin CHARACTERISTIC Cxx_dfdec_igc_3_scw "Short Circuit to Battery of ignition coil 3 detected failure counter decrement." VALUE 0xa0021a0a _REC_S1VAL_20_u2 65535. _CNV_A_R_ECME_LINEA_0_CM 0. 65535. FORMAT "%5.0" /end CHARACTERISTIC
/begin CHARACTERISTIC Cxx_dfdec_igc_4_oc "Open Circuit of ignition coil 4 detected failure counter decrement." VALUE 0xa0021a0c _REC_S1VAL_20_u2 65535. _CNV_A_R_ECME_LINEA_0_CM 0. 65535. FORMAT "%5.0" /end CHARACTERISTIC
/begin CHARACTERISTIC Cxx_dfdec_igc_4_scg "Short Circuit to Ground of ignition coil 4 detected failure counter decrement." VALUE 0xa0021a0e _REC_S1VAL_20_u2 65535. _CNV_A_R_ECME_LINEA_0_CM 0. 65535. FORMAT "%5.0" /end CHARACTERISTIC
/begin CHARACTERISTIC Cxx_dfdec_igc_4_scw "Short Circuit to Battery of ignition coil 4 detected failure counter decrement." VALUE 0xa0021a10 _REC_S1VAL_20_u2 65535. _CNV_A_R_ECME_LINEA_0_CM 0. 65535. FORMAT "%5.0" /end CHARACTERISTIC
/begin CHARACTERISTIC Cxx_dfinc_igc_1_oc "Open Circuit of ignition coil 1 detected failure counter increment." VALUE 0xa0021a12 _REC_S1VAL_20_u2 65535. _CNV_A_R_ECME_LINEA_0_CM 0. 65535. FORMAT "%5.0" /end CHARACTERISTIC
/begin CHARACTERISTIC Cxx_dfinc_igc_1_scg "Short Circuit to Ground of ignition coil 1 detected failure counter increment." VALUE 0xa0021a14 _REC_S1VAL_20_u2 65535. _CNV_A_R_ECME_LINEA_0_CM 0. 65535. FORMAT "%5.0" /end CHARACTERISTIC
/begin CHARACTERISTIC Cxx_dfinc_igc_1_scw "Short Circuit to Battery of ignition coil 1 detected failure counter increment." VALUE 0xa0021a16 _REC_S1VAL_20_u2 65535. _CNV_A_R_ECME_LINEA_0_CM 0. 65535. FORMAT "%5.0" /end CHARACTERISTIC
/begin CHARACTERISTIC Cxx_dfinc_igc_2_oc "Open Circuit of ignition coil 2 detected failure counter increment." VALUE 0xa0021a18 _REC_S1VAL_20_u2 65535. _CNV_A_R_ECME_LINEA_0_CM 0. 65535. FORMAT "%5.0" /end CHARACTERISTIC
/begin CHARACTERISTIC Cxx_dfinc_igc_2_scg "Short Circuit to Ground of ignition coil 2 detected failure counter increment." VALUE 0xa0021a1a _REC_S1VAL_20_u2 65535. _CNV_A_R_ECME_LINEA_0_CM 0. 65535. FORMAT "%5.0" /end CHARACTERISTIC
/begin CHARACTERISTIC Cxx_dfinc_igc_2_scw "Short Circuit to Battery of ignition coil 2 detected failure counter increment." VALUE 0xa0021a1c _REC_S1VAL_20_u2 65535. _CNV_A_R_ECME_LINEA_0_CM 0. 65535. FORMAT "%5.0" /end CHARACTERISTIC
/begin CHARACTERISTIC Cxx_dfinc_igc_3_oc "Open Circuit of ignition coil 3 detected failure counter increment." VALUE 0xa0021a1e _REC_S1VAL_20_u2 65535. _CNV_A_R_ECME_LINEA_0_CM 0. 65535. FORMAT "%5.0" /end CHARACTERISTIC
/begin CHARACTERISTIC Cxx_dfinc_igc_3_scg "Short Circuit to Ground of ignition coil 3 detected failure counter increment." VALUE 0xa0021a20 _REC_S1VAL_20_u2 65535. _CNV_A_R_ECME_LINEA_0_CM 0. 65535. FORMAT "%5.0" /end CHARACTERISTIC
/begin CHARACTERISTIC Cxx_dfinc_igc_3_scw "Short Circuit to Battery of ignition coil 3 detected failure counter increment." VALUE 0xa0021a22 _REC_S1VAL_20_u2 65535. _CNV_A_R_ECME_LINEA_0_CM 0. 65535. FORMAT "%5.0" /end CHARACTERISTIC
/begin CHARACTERISTIC Cxx_dfinc_igc_4_oc "Open Circuit of ignition coil 4 detected failure counter increment." VALUE 0xa0021a24 _REC_S1VAL_20_u2 65535. _CNV_A_R_ECME_LINEA_0_CM 0. 65535. FORMAT "%5.0" /end CHARACTERISTIC
/begin CHARACTERISTIC Cxx_dfinc_igc_4_scg "Short Circuit to Ground of ignition coil 4 detected failure counter increment." VALUE 0xa0021a26 _REC_S1VAL_20_u2 65535. _CNV_A_R_ECME_LINEA_0_CM 0. 65535. FORMAT "%5.0" /end CHARACTERISTIC
/begin CHARACTERISTIC Cxx_dfinc_igc_4_scw "Short Circuit to Battery of ignition coil 4 detected failure counter increment." VALUE 0xa0021a28 _REC_S1VAL_20_u2 65535. _CNV_A_R_ECME_LINEA_0_CM 0. 65535. FORMAT "%5.0" /end CHARACTERISTIC
/begin MEASUREMENT Vbx_ac_mdf1_req_int "Fan 1 activation request from cold loop" UBYTE _CNV_S_2_RANGE______3_CM 1 0. 0. 1. ECU_ADDRESS 0xd00071e8 BIT_MASK 0x1 /end MEASUREMENT
/begin MEASUREMENT Vbx_ac_mdf2_req_int "Fan 2 activation request from cold loop" UBYTE _CNV_S_2_RANGE______3_CM 1 0. 0. 1. ECU_ADDRESS 0xd00071e9 BIT_MASK 0x1 /end MEASUREMENT
/begin MEASUREMENT Vxx_ac_prs_lvl "Climate pressure area" UBYTE _CNV_A_R_ECME_LINEA_0_CM 1 0. 0. 255. ECU_ADDRESS 0xd00071ea FORMAT "%3.0" /end MEASUREMENT
/begin CHARACTERISTIC Cxx_ac_mdf_prs_hys "AC pressure hysteresis for fans activation" VALUE 0xa002207c _REC_S1VAL_20_u2 6553.5 _CNV_A_R_LINEAR_____373_CM 0. 6553.5 FORMAT "%6.1" /end CHARACTERISTIC
/begin CHARACTERISTIC Cxx_ac_mdf_prs_thd1 "AC pressure threshold n° 1 for fans activation" VALUE 0xa002207e _REC_S1VAL_20_u2 6553.5 _CNV_A_R_LINEAR_____373_CM 0. 6553.5 FORMAT "%6.1" /end CHARACTERISTIC
/begin CHARACTERISTIC Cxx_ac_mdf_prs_thd2 "AC pressure threshold n° 2 for fans activation" VALUE 0xa0022080 _REC_S1VAL_20_u2 6553.5 _CNV_A_R_LINEAR_____373_CM 0. 6553.5 FORMAT "%6.1" /end CHARACTERISTIC
/begin CHARACTERISTIC Cxx_ac_mdf_prs_thd3 "AC pressure threshold n° 3 for fans activation" VALUE 0xa0022082 _REC_S1VAL_20_u2 6553.5 _CNV_A_R_LINEAR_____373_CM 0. 6553.5 FORMAT "%6.1" /end CHARACTERISTIC
/begin CHARACTERISTIC Cxx_ac_mdf_secu_prs_hys "Security AC pressure hysteresis for fans activation when there is no ac presnce" VALUE 0xa0022084 _REC_S1VAL_20_u2 6553.5 _CNV_A_R_LINEAR_____373_CM 0. 6553.5 FORMAT "%6.1" /end CHARACTERISTIC
/begin CHARACTERISTIC Cxx_ac_mdf_secu_prs_thd "Security AC pressure threshold for fans activation when there is no ac request" VALUE 0xa0022086 _REC_S1VAL_20_u2 6553.5 _CNV_A_R_LINEAR_____373_CM 0. 6553.5 FORMAT "%6.1" /end CHARACTERISTIC
/begin CHARACTERISTIC Cxx_ac_mdf_vs_hys "Vehicle speed hysteresis for fans activation" VALUE 0xa0022088 _REC_S1VAL_20_u1 255. _CNV_A_R_LINEAR_____71_CM 0. 255. FORMAT "%3.0" /end CHARACTERISTIC
/begin CHARACTERISTIC Cxx_ac_mdf_vs_thd1 "Vehicle speed threshold n° 1 for fans activation" VALUE 0xa0022089 _REC_S1VAL_20_u1 255. _CNV_A_R_LINEAR_____71_CM 0. 255. FORMAT "%3.0" /end CHARACTERISTIC
/begin CHARACTERISTIC Cxx_ac_mdf_vs_thd2 "Vehicle speed threshold n° 2 for fans activation" VALUE 0xa002208a _REC_S1VAL_20_u1 255. _CNV_A_R_LINEAR_____71_CM 0. 255. FORMAT "%3.0" /end CHARACTERISTIC
/begin CHARACTERISTIC Cxx_ac_mdf_vs_thd3 "Vehicle speed threshold n° 3 for fans activation" VALUE 0xa002208b _REC_S1VAL_20_u1 255. _CNV_A_R_LINEAR_____71_CM 0. 255. FORMAT "%3.0" /end CHARACTERISTIC
/begin CHARACTERISTIC Cxx_ac_mdf_vs_thd4 "Vehicle speed threshold n° 4 for fans activation" VALUE 0xa002208c _REC_S1VAL_20_u1 255. _CNV_A_R_LINEAR_____71_CM 0. 255. FORMAT "%3.0" /end CHARACTERISTIC
/begin AXIS_PTS Ctb_ac_dclu_dly_n "9 programmable engine speed breakpoints table for declutching delay" 0xa0036dd4 Vxx_n _REC_A2AXS_20_u2 16383.75 _CNV_A_R_ENSD_LINEA_22_CM 9 0. 16383.75 FORMAT "%8.2" /end AXIS_PTS
/begin CHARACTERISTIC Ctp_ac_dclu_dly "Air conditioning compressor declutching delay function of engine speed" CURVE 0xa0036de8 _REC_A1CUR_20_u1_u2 2.55 _CNV_A_R_LINEAR_____32_CM 0. 2.55 FORMAT "%4.2"
 /begin AXIS_DESCR COM_AXIS Vxx_n _CNV_A_R_ENSD_LINEA_22_CM 9 0. 16383.75 FORMAT "%8.2" AXIS_PTS_REF Ctb_ac_dclu_dly_n /end AXIS_DESCR
/end CHARACTERISTIC
/begin MEASUREMENT Vbx_ac_clu_dsb "Air conditioning compressor clutching interdiction" UBYTE _CNV_S_2_RANGE______3_CM 1 0. 0. 1. ECU_ADDRESS 0xd00071ed BIT_MASK 0x1 /end MEASUREMENT
/begin MEASUREMENT Vbx_ac_clu_ena "AC compressor clutching order" UBYTE _CNV_S_2_RANGE______3_CM 1 0. 0. 1. ECU_ADDRESS 0xd00071ee BIT_MASK 0x1 /end MEASUREMENT
/begin MEASUREMENT Vbx_ac_dclu_dsb "Air conditioning compressor declutching interdiction" UBYTE _CNV_S_2_RANGE______3_CM 1 0. 0. 1. ECU_ADDRESS 0xd00071ef BIT_MASK 0x1 /end MEASUREMENT
/begin MEASUREMENT Vbx_ac_dsb "Immediate AC compressor inhibition" UBYTE _CNV_S_2_RANGE______3_CM 1 0. 0. 1. ECU_ADDRESS 0xd00071f0 BIT_MASK 0x1 /end MEASUREMENT
/begin MEASUREMENT Vsx_ac_cmd "Air conditioning compressor command" UBYTE _CNV_A_R_ECME_LINEA_0_CM 1 0. 0. 4. ECU_ADDRESS 0xd00071f1 FORMAT "%1.0" /end MEASUREMENT
/begin MEASUREMENT Vsx_acr_stt "AC compressor management phases" UBYTE _CNV_A_R_ECME_LINEA_0_CM 1 0. 0. 255. ECU_ADDRESS 0xd00071f2 FORMAT "%3.0" /end MEASUREMENT
/begin MEASUREMENT Vxx_ac_cmd_dly "Air conditioning compressor command timer" UBYTE _CNV_A_R_LINEAR_____32_CM 1 0. 0. 2.55 ECU_ADDRESS 0xd00071f3 FORMAT "%4.2" /end MEASUREMENT
/begin MEASUREMENT Vxx_ac_stt_dly "Air conditioning compressor state timer" UBYTE _CNV_A_R_LINEAR_____32_CM 1 0. 0. 2.55 ECU_ADDRESS 0xd00071f4 FORMAT "%4.2" /end MEASUREMENT
/begin CHARACTERISTIC Cxx_ac_bfr_clu_dly "Air conditioning compressor before clutching state delay" VALUE 0xa002208d _REC_S1VAL_20_u1 2.55 _CNV_A_R_LINEAR_____32_CM 0. 2.55 FORMAT "%4.2" /end CHARACTERISTIC
/begin CHARACTERISTIC Cxx_ac_clu_dly "Air conditioning compressor clutching delay" VALUE 0xa002208e _REC_S1VAL_20_u1 2.55 _CNV_A_R_LINEAR_____32_CM 0. 2.55 FORMAT "%4.2" /end CHARACTERISTIC
/begin CHARACTERISTIC Cxx_ac_ext_clu_dly "Air conditioning compressor external clutching delay (USM delay)" VALUE 0xa002208f _REC_S1VAL_20_u1 2.55 _CNV_A_R_LINEAR_____32_CM 0. 2.55 FORMAT "%4.2" /end CHARACTERISTIC
/begin CHARACTERISTIC Cxx_ac_ext_dclu_dly "Air conditioning compressor external declutching delay (USM delay)" VALUE 0xa0022090 _REC_S1VAL_20_u1 2.55 _CNV_A_R_LINEAR_____32_CM 0. 2.55 FORMAT "%4.2" /end CHARACTERISTIC
/begin CHARACTERISTIC Cxx_ac_rly_prot_dly "Minimum duration in clutched state for relay protection" VALUE 0xa0022091 _REC_S1VAL_20_u1 2.55 _CNV_A_R_LINEAR_____32_CM 0. 2.55 FORMAT "%4.2" /end CHARACTERISTIC
/begin MEASUREMENT Vbx_ac_secu_dsb "Combination of all the vehicle inhibitions" UBYTE _CNV_S_2_RANGE______3_CM 1 0. 0. 1. ECU_ADDRESS 0xd00071f6 BIT_MASK 0x1 /end MEASUREMENT
/begin MEASUREMENT Vbx_h_prs_ac_dsb "AC compressor inhibition due to high pressure" UBYTE _CNV_S_2_RANGE______3_CM 1 0. 0. 1. ECU_ADDRESS 0xd00071f7 BIT_MASK 0x1 /end MEASUREMENT
/begin MEASUREMENT Vbx_l_prs_ac_dsb "AC compressor inhibition due to low pressure" UBYTE _CNV_S_2_RANGE______3_CM 1 0. 0. 1. ECU_ADDRESS 0xd00071f8 BIT_MASK 0x1 /end MEASUREMENT
/begin MEASUREMENT Vbx_n_ac_dsb "AC compressor inhibition due to engine over-speed" UBYTE _CNV_S_2_RANGE______3_CM 1 0. 0. 1. ECU_ADDRESS 0xd00071f9 BIT_MASK 0x1 /end MEASUREMENT
/begin MEASUREMENT Vbx_n_vs_ac_clu_dsb "AC compressor clutching inhibition due to engine over-speed with too small vehicle speed" UBYTE _CNV_S_2_RANGE______3_CM 1 0. 0. 1. ECU_ADDRESS 0xd00071fa BIT_MASK 0x1 /end MEASUREMENT
/begin MEASUREMENT Vbx_prmt_n_ac_dsb "AC compressor inhibition due to prolonged engine over-speed" UBYTE _CNV_S_2_RANGE______3_CM 1 0. 0. 1. ECU_ADDRESS 0xd00071fb BIT_MASK 0x1 /end MEASUREMENT
/begin MEASUREMENT Vxx_ac_vs "Vehicle speed used by ac strategy" UBYTE _CNV_A_R_LINEAR_____71_CM 1 0. 0. 255. ECU_ADDRESS 0xd0007cf0 FORMAT "%3.0" /end MEASUREMENT
/begin MEASUREMENT Vxx_l_prs_ac_diag "Diagnosis information: the cooling gas load is too low" UBYTE _CNV_A_R_ECME_LINEA_0_CM 1 0. 0. 3. ECU_ADDRESS 0xd00071fc FORMAT "%1.0" /end MEASUREMENT
/begin CHARACTERISTIC Cbx_ac_cold_loop_in_ecm "Boolean to set cold loop inside or outside ECM (1= cold loop inside ECM)" VALUE 0xa00220a4 _REC_S1VAL_20_u1 1. _CNV_A_R_ECME_LINEA_0_CM 0. 1. FORMAT "%1.0" BIT_MASK 0x1 /end CHARACTERISTIC
/begin CHARACTERISTIC Cxx_ac_vs_nok_dly "Delay to filter an unavailable vehicle speed received on the CAN network" VALUE 0xa0022092 _REC_S1VAL_20_u2 655.35 _CNV_A_R_LINEAR_____32_CM 0. 655.35 FORMAT "%6.2" /end CHARACTERISTIC
/begin CHARACTERISTIC Cxx_h_prs_ac_dsb_dly "Authorized time of high AC pressure before AC compressor inhibition" VALUE 0xa0022094 _REC_S1VAL_20_u2 655.35 _CNV_A_R_LINEAR_____32_CM 0. 655.35 FORMAT "%6.2" /end CHARACTERISTIC
/begin CHARACTERISTIC Cxx_h_prs_ac_dsb_hys "High pressure hysteresis of the AC compressor inhibition threshold" VALUE 0xa0022096 _REC_S1VAL_20_u2 6553.5 _CNV_A_R_LINEAR_____373_CM 0. 6553.5 FORMAT "%6.1" /end CHARACTERISTIC
/begin CHARACTERISTIC Cxx_h_prs_ac_dsb_thd "Maximum AC pressure before compressor inhibition" VALUE 0xa0022098 _REC_S1VAL_20_u2 6553.5 _CNV_A_R_LINEAR_____373_CM 0. 6553.5 FORMAT "%6.1" /end CHARACTERISTIC
/begin CHARACTERISTIC Cxx_l_prs_ac_dsb_hys "Low pressure hysteresis of the AC compressor inhibition threshold" VALUE 0xa00220a5 _REC_S1VAL_20_u1 25.5 _CNV_A_R_LINEAR_____373_CM 0. 25.5 FORMAT "%4.1" /end CHARACTERISTIC
/begin CHARACTERISTIC Cxx_l_prs_ac_dsb_thd "Minimum AC pressure before compressor inhibition" VALUE 0xa00220a6 _REC_S1VAL_20_u1 25.5 _CNV_A_R_LINEAR_____373_CM 0. 25.5 FORMAT "%4.1" /end CHARACTERISTIC
/begin CHARACTERISTIC Cxx_n_ac_clu_dsb_thd "Engine speed limit to authorize AC compressor clutching" VALUE 0xa002209a _REC_S1VAL_20_u2 16383.75 _CNV_A_R_ENSD_LINEA_22_CM 0. 16383.75 FORMAT "%8.2" /end CHARACTERISTIC
/begin CHARACTERISTIC Cxx_n_ac_dsb_hys "Engine speed hysteresis of the AC compressor inhibition threshold" VALUE 0xa002209c _REC_S1VAL_20_u2 16383.75 _CNV_A_R_ENSD_LINEA_22_CM 0. 16383.75 FORMAT "%8.2" /end CHARACTERISTIC
/begin CHARACTERISTIC Cxx_n_ac_dsb_thd "Maximum engine speed before AC compressor inhibition" VALUE 0xa002209e _REC_S1VAL_20_u2 16383.75 _CNV_A_R_ENSD_LINEA_22_CM 0. 16383.75 FORMAT "%8.2" /end CHARACTERISTIC
/begin CHARACTERISTIC Cxx_prmt_n_ac_dsb_dly "Maximum prolonged engine speed duration before AC compressor inhibition" VALUE 0xa00220a7 _REC_S1VAL_20_u1 25.5 _CNV_A_R_LINEAR_____58_CM 0. 25.5 FORMAT "%4.1" /end CHARACTERISTIC
/begin CHARACTERISTIC Cxx_prmt_n_ac_dsb_hys "Prolonged engine speed hysteresis of the AC compressor inhibition threshold" VALUE 0xa00220a0 _REC_S1VAL_20_u2 16383.75 _CNV_A_R_ENSD_LINEA_22_CM 0. 16383.75 FORMAT "%8.2" /end CHARACTERISTIC
/begin CHARACTERISTIC Cxx_prmt_n_ac_dsb_thd "Maximum prolonged engine speed before AC compressor inhibition" VALUE 0xa00220a2 _REC_S1VAL_20_u2 16383.75 _CNV_A_R_ENSD_LINEA_22_CM 0. 16383.75 FORMAT "%8.2" /end CHARACTERISTIC
/begin CHARACTERISTIC Cxx_vs_ac_clu_dsb_thd "Minimum vehicule speed to authorize AC compressor clutching" VALUE 0xa00220a8 _REC_S1VAL_20_u1 255. _CNV_A_R_LINEAR_____71_CM 0. 255. FORMAT "%3.0" /end CHARACTERISTIC
/begin MEASUREMENT Vbx_ptc_comp_cfa "Cabin fan state after turn on/off delay" UBYTE _CNV_S_2_RANGE______3_CM 1 0. 0. 1. ECU_ADDRESS 0xd0007cf1 BIT_MASK 0x1 /end MEASUREMENT
/begin MEASUREMENT Vbx_ptc_cut_fil "PTC cut off request" UBYTE _CNV_S_2_RANGE______3_CM 1 0. 0. 1. ECU_ADDRESS 0xd0007cf2 BIT_MASK 0x1 /end MEASUREMENT
/begin MEASUREMENT Vbx_ptc_frz_fil "PTC freeze request" UBYTE _CNV_S_2_RANGE______3_CM 1 0. 0. 1. ECU_ADDRESS 0xd0007cf3 BIT_MASK 0x1 /end MEASUREMENT
/begin MEASUREMENT Vbx_ptc_heat_sp_frz_req "Comfort integral freeze request" UBYTE _CNV_S_2_RANGE______3_CM 1 0. 0. 1. ECU_ADDRESS 0xd0007cf4 BIT_MASK 0x1 /end MEASUREMENT
/begin MEASUREMENT Vxx_ptc_lvl_cmd "Final PTC level" UBYTE _CNV_A_R_ECME_LINEA_0_CM 1 0. 0. 5. ECU_ADDRESS 0xd0007cf5 FORMAT "%3.0" /end MEASUREMENT
/begin MEASUREMENT Vxx_ptc_th_efy_lvl_req "PTC level request according to air and coolant temperature" UBYTE _CNV_A_R_ECME_LINEA_0_CM 1 0. 0. 5. ECU_ADDRESS 0xd0007cf6 FORMAT "%3.0" /end MEASUREMENT
/begin MEASUREMENT Vbx_wf_ptc_cfm "PTC management present (=1) or absent (=0)" UBYTE _CNV_S_2_RANGE______3_CM 1 0. 0. 1. ECU_ADDRESS 0xd00071fd BIT_MASK 0x1 /end MEASUREMENT
/begin CHARACTERISTIC Cbx_wf_ptc_abst_pres_cfm "PTC management present (=1) or absent (=0) configuration" VALUE 0xa00220a9 _REC_S1VAL_20_u1 1. _CNV_A_R_ECME_LINEA_0_CM 0. 1. FORMAT "%1.0" BIT_MASK 0x1 /end CHARACTERISTIC
/begin MEASUREMENT Vxx_acs_acel_is "" UWORD _CNV_A_R_ENSD_LINEA_22_CM 1 0. 0. 16383.75 DISPLAY_IDENTIFIER SmIsrSpt_NVM.Vxx_acs_acel_is_NVM ECU_ADDRESS 0xd000237e FORMAT "%8.2" /end MEASUREMENT
/begin MEASUREMENT Vxx_el_csm_ctr "" UBYTE _CNV_A_R_ECME_LINEA_0_CM 1 0. 0. 255. DISPLAY_IDENTIFIER SmIsrSpt_NVM.Vxx_el_csm_ctr_NVM ECU_ADDRESS 0xd0002380 FORMAT "%3.0" /end MEASUREMENT
/begin MEASUREMENT Vbx_acs_acel_is_ena "" UBYTE _CNV_S_2_RANGE______3_CM 1 0. 0. 1. DISPLAY_IDENTIFIER SmIsrSpt_NVM.Vbx_acs_acel_is_ena_NVM ECU_ADDRESS 0xd0002381 BIT_MASK 0x1 /end MEASUREMENT
/begin MEASUREMENT Vxx_acs_acel_is_max_vs "" UWORD _CNV_A_R_LINEAR_____125_CM 1 0. 0. 655.35 DISPLAY_IDENTIFIER SmIsrSpt_NVM.Vxx_acs_acel_is_max_vs_NVM ECU_ADDRESS 0xd0002382 FORMAT "%6.2" /end MEASUREMENT
/begin AXIS_PTS Ctb_cold_is_cata_wup_ctr "Breakpoints use for catalyst warm-up sequences with cold start conditions" 0xa0034d8c Vxx_cata_wup_ctr _REC_A2AXS_20_u2 65535. _CNV_A_R_LINEAR_____101_CM 17 0. 65535. FORMAT "%5.0" /end AXIS_PTS
/begin AXIS_PTS Ctb_is_cata_wup_ctr "Breakpoints use for catalyst warm-up sequences without cold start conditions" 0xa0034db0 Vxx_cata_wup_ctr _REC_A2AXS_20_u2 65535. _CNV_A_R_LINEAR_____101_CM 17 0. 65535. FORMAT "%5.0" /end AXIS_PTS
/begin CHARACTERISTIC Ctp_agb_tco_min_is_n "Idle speed setpoint which depends of the coolant temperature in 'Drive' position" CURVE 0xa0034c38 _REC_A1CUR_20_u2_u2 16383.75 _CNV_A_R_ENSD_LINEA_22_CM 0. 16383.75 FORMAT "%8.2"
 /begin AXIS_DESCR COM_AXIS Vxx_tco _CNV_A_R_LINEAR_____110_CM 16 -40. 200. FORMAT "%5.1" AXIS_PTS_REF Ctb_tco /end AXIS_DESCR
/end CHARACTERISTIC
/begin CHARACTERISTIC Ctp_drag_tco_min_is_n "Idle speed setpoint which depends of the coolant temperature in case of drag reduction" CURVE 0xa0034c58 _REC_A1CUR_20_u2_u2 16383.75 _CNV_A_R_ENSD_LINEA_22_CM 0. 16383.75 FORMAT "%8.2"
 /begin AXIS_DESCR COM_AXIS Vxx_tco _CNV_A_R_LINEAR_____110_CM 16 -40. 200. FORMAT "%5.1" AXIS_PTS_REF Ctb_tco /end AXIS_DESCR
/end CHARACTERISTIC
/begin MEASUREMENT Vbx_agb_is_clc_ena "Activation (1) or deactivation (0) of the calculation of the AGB idle speed setpoints." UBYTE _CNV_S_2_RANGE______3_CM 1 0. 0. 1. ECU_ADDRESS 0xd00070e1 BIT_MASK 0x1 /end MEASUREMENT
/begin MEASUREMENT Vbx_is_run_vh_min_crp "Detection vehicle running/creeping to specific setpoint" UBYTE _CNV_S_2_RANGE______3_CM 1 0. 0. 1. ECU_ADDRESS 0xd00070e2 BIT_MASK 0x1 /end MEASUREMENT
/begin MEASUREMENT Vxx_agb_min_is_n "Automatic Transmission idle speed setpoint required" UWORD _CNV_A_R_ENSD_LINEA_22_CM 1 0. 0. 16383.75 ECU_ADDRESS 0xd000490a FORMAT "%8.2" /end MEASUREMENT
/begin MEASUREMENT Vxx_tco_agb_min_is_n "Nominal idle speed setpoint under drive or drag reduction mode" UWORD _CNV_A_R_ENSD_LINEA_22_CM 1 0. 0. 16383.75 ECU_ADDRESS 0xd000603a FORMAT "%8.2" /end MEASUREMENT
/begin CHARACTERISTIC Cxx_agb_min_is_n "Idle speed setpoint under request of the AT" VALUE 0xa0021e02 _REC_S1VAL_20_u2 16383.75 _CNV_A_R_ENSD_LINEA_22_CM 0. 16383.75 FORMAT "%8.2" /end CHARACTERISTIC
/begin CHARACTERISTIC Cxx_is_run_vh_min_crp "Threshold of speed vehicle to cancel the increase of idle speed setpoint in case of vehicle creeping" VALUE 0xa0021e04 _REC_S1VAL_20_u2 655.35 _CNV_A_R_LINEAR_____125_CM 0. 655.35 FORMAT "%6.2" /end CHARACTERISTIC
/begin CHARACTERISTIC Cxx_tco_agb_df_min_is_n "Nominal idle speed setpoint calibration in case of a validity status default under drive or drag reduction mode" VALUE 0xa0021e06 _REC_S1VAL_20_u2 16383.75 _CNV_A_R_ENSD_LINEA_22_CM 0. 16383.75 FORMAT "%8.2" /end CHARACTERISTIC
/begin CHARACTERISTIC Ctp_toil_is_n_ofs "Idle speed offset table for protection in case of igh oil temperature" CURVE 0xa0034c78 _REC_A1CUR_20_u2_u2 16383.75 _CNV_A_R_ENSD_LINEA_22_CM 0. 16383.75 FORMAT "%8.2"
 /begin AXIS_DESCR COM_AXIS Vxx_toil _CNV_A_R_LINEAR_____110_CM 16 -40. 200. FORMAT "%5.1" AXIS_PTS_REF Ctb_toil /end AXIS_DESCR
/end CHARACTERISTIC
/begin MEASUREMENT Vbx_diag_sta_ndec_abrt "ISR routine aborted status (for decrease)" UBYTE _CNV_S_2_RANGE______3_CM 1 0. 0. 1. ECU_ADDRESS 0xd0007ca0 BIT_MASK 0x1 /end MEASUREMENT
/begin MEASUREMENT Vbx_diag_sta_ninc_abrt "ISR routine aborted status (for increase)" UBYTE _CNV_S_2_RANGE______3_CM 1 0. 0. 1. ECU_ADDRESS 0xd0007ca1 BIT_MASK 0x1 /end MEASUREMENT
/begin MEASUREMENT Vxx_diag_vvtc_min_is_n "VVTC routine idle speed setpoint" UWORD _CNV_A_R_ENSD_LINEA_22_CM 1 0. 0. 16383.75 ECU_ADDRESS 0xd000603c FORMAT "%8.2" /end MEASUREMENT
/begin MEASUREMENT Vxx_inj_vld_min_is_n "Injector failure idle speed setpoint" UWORD _CNV_A_R_ENSD_LINEA_22_CM 1 0. 0. 16383.75 ECU_ADDRESS 0xd000603e FORMAT "%8.2" /end MEASUREMENT
/begin MEASUREMENT Vxx_moni_min_is_n "Monitool idle speed setpoint" UWORD _CNV_A_R_ENSD_LINEA_22_CM 1 0. 0. 16383.75 ECU_ADDRESS 0xd0006040 FORMAT "%8.2" /end MEASUREMENT
/begin MEASUREMENT Vxx_n_vld_min_is_n "Engine speed sensor failure idle speed setpoint" UWORD _CNV_A_R_ENSD_LINEA_22_CM 1 0. 0. 16383.75 ECU_ADDRESS 0xd0006042 FORMAT "%8.2" /end MEASUREMENT
/begin MEASUREMENT Vxx_prs_dft_min_is_n "Manifold pressure sensor failure idle speed setpoint" UWORD _CNV_A_R_ENSD_LINEA_22_CM 1 0. 0. 16383.75 ECU_ADDRESS 0xd0006044 FORMAT "%8.2" /end MEASUREMENT
/begin MEASUREMENT Vxx_toil_is_n_ofs "High oil temperature protection idle speed setpoint offset" UWORD _CNV_A_R_ENSD_LINEA_22_CM 1 0. 0. 16383.75 ECU_ADDRESS 0xd0006046 FORMAT "%8.2" /end MEASUREMENT
/begin CHARACTERISTIC Cxx_inj_vld_min_is_n "Default value if a default is detected on the engine speed sensor" VALUE 0xa0021e08 _REC_S1VAL_20_u2 16383.75 _CNV_A_R_ENSD_LINEA_22_CM 0. 16383.75 FORMAT "%8.2" /end CHARACTERISTIC
/begin CHARACTERISTIC Cxx_n_vld_min_is_n "Default value if a default is detected on the engine speed sensor" VALUE 0xa0021e0a _REC_S1VAL_20_u2 16383.75 _CNV_A_R_ENSD_LINEA_22_CM 0. 16383.75 FORMAT "%8.2" /end CHARACTERISTIC
/begin CHARACTERISTIC Cxx_prs_dft_min_is_n "Minimum after-sale idle speed setpoint" VALUE 0xa0021e0c _REC_S1VAL_20_u2 16383.75 _CNV_A_R_ENSD_LINEA_22_CM 0. 16383.75 FORMAT "%8.2" /end CHARACTERISTIC
/begin CHARACTERISTIC Cxx_toil_is_n_ofs "Minimum after-sale idle speed setpoint" VALUE 0xa0021e0e _REC_S1VAL_20_u2 16383.75 _CNV_A_R_ENSD_LINEA_22_CM 0. 16383.75 FORMAT "%8.2" /end CHARACTERISTIC
/begin CHARACTERISTIC Ctp_is_ast_ofs "Offset (depending coolant temperature) about idle speed setpoint to create after start state threshold" CURVE 0xa0034c98 _REC_A1CUR_20_u2_u2 16383.75 _CNV_A_R_LINEAR_____182_CM -8192. 8191.75 FORMAT "%7.2"
 /begin AXIS_DESCR COM_AXIS Vxx_tco _CNV_A_R_LINEAR_____110_CM 8 -40. 200. FORMAT "%5.1" AXIS_PTS_REF Ctb_sta_tco /end AXIS_DESCR
/end CHARACTERISTIC
/begin CHARACTERISTIC Ctp_max_ftc_dyn_is_sp "Maximal limitation allowing to saturate the constant of time according to the gera ratio" CURVE 0xa0034ca8 _REC_A1CUR_20_u2_u1 655.35 _CNV_A_R_LINEAR_____32_CM 0. 655.35 FORMAT "%6.2"
 /begin AXIS_DESCR COM_AXIS Vxx_gear _CNV_A_R_LINEAR_____145_CM 8 -1. 6. READ_ONLY FORMAT "%2.0" AXIS_PTS_REF Ntb_gear /end AXIS_DESCR
/end CHARACTERISTIC
/begin MEASUREMENT Vbx_dyn_is_n_sp_rst "Boolean indicating if an overshoot of engine speed in Cdn and Act states" UBYTE _CNV_S_2_RANGE______3_CM 1 0. 0. 1. ECU_ADDRESS 0xd00070e9 BIT_MASK 0x1 /end MEASUREMENT
/begin MEASUREMENT Vxx_dyn_is_n_sp "Dynamic idle speed setpoint" UWORD _CNV_A_R_ENSD_LINEA_22_CM 1 0. 0. 16383.75 ECU_ADDRESS 0xd0004914 FORMAT "%8.2" /end MEASUREMENT
/begin MEASUREMENT Vxx_ftc_dyn "Factor of filtering of the engine speed to teh dynamic setpoint" UWORD _CNV_A_R_LINEAR_____32_CM 1 0. 0. 655.35 ECU_ADDRESS 0xd0004916 FORMAT "%6.2" /end MEASUREMENT
/begin MEASUREMENT Vxx_ftc_dyn_n_drv "Filtered derivate of engine speed" SWORD _CNV_A_R_LINEAR_____21_CM 1 0. -8192. 8191. ECU_ADDRESS 0xd0004918 FORMAT "%5.0" /end MEASUREMENT
/begin CHARACTERISTIC Cxx_fac_n_drv_ftc_dyn "Factor of filtering of derivate of engine speed" VALUE 0xa0021e10 _REC_S1VAL_20_u2 655.35 _CNV_A_R_LINEAR_____32_CM 0. 655.35 FORMAT "%6.2" /end CHARACTERISTIC
/begin CHARACTERISTIC Cxx_is_out_dyn_ofs "Offset on the dynamic setpoint to reset the dynamic setpoint in Cdn and Act states about in case of an overshoot of engine speed" VALUE 0xa0021e12 _REC_S1VAL_20_u2 16383.75 _CNV_A_R_ENSD_LINEA_22_CM 0. 16383.75 FORMAT "%8.2" /end CHARACTERISTIC
/begin CHARACTERISTIC Cxx_k_ftc_dyn_is_sp "Filter factor for dynamic setpoint of ISR" VALUE 0xa0021e14 _REC_S1VAL_20_u2 655.35 _CNV_A_R_LINEAR_____123_CM 0. 655.35 FORMAT "%6.2" /end CHARACTERISTIC
/begin CHARACTERISTIC Cxx_min_ftc_dyn_is_sp "Minimal limitation allowing to saturate the constant of time" VALUE 0xa0021e16 _REC_S1VAL_20_u2 655.35 _CNV_A_R_LINEAR_____32_CM 0. 655.35 FORMAT "%6.2" /end CHARACTERISTIC
/begin AXIS_PTS Ctb_el_csm_n_sp_ofs "breackpoint table used for the calculation of the electric balance idle speed setpoint offset" 0xa0034cb8 Vxx_el_csm_ctr _REC_A2AXS_20_u1 255. _CNV_A_R_ECME_LINEA_0_CM 9 0. 255. FORMAT "%3.0" /end AXIS_PTS
/begin CHARACTERISTIC Ctp_el_csm_n_sp_ofs "interpolation table used for the calculation of the electric balance protection idle setpoint offset" CURVE 0xa0034cc4 _REC_A1CUR_20_u2_u1 16383.75 _CNV_A_R_ENSD_LINEA_22_CM 0. 16383.75 FORMAT "%8.2"
 /begin AXIS_DESCR COM_AXIS Vxx_el_csm_ctr _CNV_A_R_ECME_LINEA_0_CM 9 0. 255. FORMAT "%3.0" AXIS_PTS_REF Ctb_el_csm_n_sp_ofs /end AXIS_DESCR
/end CHARACTERISTIC
/begin MEASUREMENT Vbx_el_csm_clc_ena "electric balance protection Idle speed setpoint calculation enabled" UBYTE _CNV_S_2_RANGE______3_CM 1 0. 0. 1. ECU_ADDRESS 0xd0007ca2 BIT_MASK 0x1 /end MEASUREMENT
/begin MEASUREMENT Vxx_el_bk_wind_min_is_n "Electric backlite idle speed setpoint" UWORD _CNV_A_R_ENSD_LINEA_22_CM 1 0. 0. 16383.75 ECU_ADDRESS 0xd000604a FORMAT "%8.2" /end MEASUREMENT
/begin MEASUREMENT Vxx_el_wind_min_is_n "Electric balance counter" UWORD _CNV_A_R_ENSD_LINEA_22_CM 1 0. 0. 16383.75 ECU_ADDRESS 0xd000604c FORMAT "%8.2" /end MEASUREMENT
/begin MEASUREMENT Vxx_min_vb_is_ofs "Electric balance protection idle speed setpoint offset" UWORD _CNV_A_R_ENSD_LINEA_22_CM 1 0. 0. 16383.75 ECU_ADDRESS 0xd000604e FORMAT "%8.2" /end MEASUREMENT
/begin MEASUREMENT Vxx_ptc_min_is_n "PTC idle speed setpoint" UWORD _CNV_A_R_ENSD_LINEA_22_CM 1 0. 0. 16383.75 ECU_ADDRESS 0xd0006050 FORMAT "%8.2" /end MEASUREMENT
/begin MEASUREMENT Vxx_thpl_min_is_n "thermoplunger idle speed setpoint" UWORD _CNV_A_R_ENSD_LINEA_22_CM 1 0. 0. 16383.75 ECU_ADDRESS 0xd0006052 FORMAT "%8.2" /end MEASUREMENT
/begin CHARACTERISTIC Cxx_agb_wind_min_is_n "Electric windshield idle speed setpoint calibration under drive mode of the AT" VALUE 0xa0021e18 _REC_S1VAL_20_u2 16383.75 _CNV_A_R_ENSD_LINEA_22_CM 0. 16383.75 FORMAT "%8.2" /end CHARACTERISTIC
/begin CHARACTERISTIC Cxx_el_bk_wind_is_n "Electric backlite idle speed setpoint calibration" VALUE 0xa0021e1a _REC_S1VAL_20_u2 16383.75 _CNV_A_R_ENSD_LINEA_22_CM 0. 16383.75 FORMAT "%8.2" /end CHARACTERISTIC
/begin CHARACTERISTIC Cxx_el_csm_alt_cut_dly "Inhibition of the delay of the calculation of the idle speed setpoint offset under alternator requests" VALUE 0xa0021e24 _REC_S1VAL_20_u1 25.5 _CNV_A_R_LINEAR_____58_CM 0. 25.5 FORMAT "%4.1" /end CHARACTERISTIC
/begin CHARACTERISTIC Cxx_el_csm_clc_dly "Inhibition of the delay of the calculation of the idle speed setpoint offset after engine start" VALUE 0xa0021e25 _REC_S1VAL_20_u1 25.5 _CNV_A_R_LINEAR_____58_CM 0. 25.5 FORMAT "%4.1" /end CHARACTERISTIC
/begin CHARACTERISTIC Cxx_el_csm_clc_neg_fac "Gain used for the calculation of the electric balance protection counter" VALUE 0xa0021e26 _REC_S1VAL_20_u1 1. _CNV_A_R_LINEAR_____397_CM 0. 1. FORMAT "%5.3" /end CHARACTERISTIC
/begin CHARACTERISTIC Cxx_el_csm_clc_neut_vb "electric balance protection voltage reference" VALUE 0xa0021e1c _REC_S1VAL_20_u2 25000. _CNV_A_R_LINEAR_____107_CM 0. 25000. FORMAT "%5.0" /end CHARACTERISTIC
/begin CHARACTERISTIC Cxx_el_csm_clc_pos_fac "Gain used for the calculation of the electric balance protection counter" VALUE 0xa0021e27 _REC_S1VAL_20_u1 1. _CNV_A_R_LINEAR_____397_CM 0. 1. FORMAT "%5.3" /end CHARACTERISTIC
/begin CHARACTERISTIC Cxx_el_wind_tco "Engine coolant temperature threshold which not allowed electric windshield idle speed setpoint" VALUE 0xa0021e1e _REC_S1VAL_20_u2 240. _CNV_A_R_LINEAR_____110_CM -40. 200. FORMAT "%5.1" /end CHARACTERISTIC
/begin CHARACTERISTIC Cxx_ptc_min_is_n "PTC idle speed setpoint calibration" VALUE 0xa0021e20 _REC_S1VAL_20_u2 16383.75 _CNV_A_R_ENSD_LINEA_22_CM 0. 16383.75 FORMAT "%8.2" /end CHARACTERISTIC
/begin CHARACTERISTIC Cxx_thpl_min_is_n "Thermoplunger idle speed setpoint calibration" VALUE 0xa0021e22 _REC_S1VAL_20_u2 16383.75 _CNV_A_R_ENSD_LINEA_22_CM 0. 16383.75 FORMAT "%8.2" /end CHARACTERISTIC
/begin AXIS_PTS Ctb_ac_forb_is_n "Idle speed breakpoints used to avoid critical engine speed requested by AC" 0xa0034cd8 Vxx_ac_acel_is_sp _REC_A2AXS_20_u2 16383.75 _CNV_A_R_ENSD_LINEA_22_CM 16 0. 16383.75 FORMAT "%8.2" /end AXIS_PTS
/begin CHARACTERISTIC Ctp_ac_forb_is_n "Idle speed table used to avoid critical engine speed requested by AC" CURVE 0xa0034cfc _REC_A1CUR_20_u2_u2 16383.75 _CNV_A_R_ENSD_LINEA_22_CM 0. 16383.75 FORMAT "%8.2"
 /begin AXIS_DESCR COM_AXIS Vxx_ac_acel_is_sp _CNV_A_R_ENSD_LINEA_22_CM 16 0. 16383.75 FORMAT "%8.2" AXIS_PTS_REF Ctb_ac_forb_is_n /end AXIS_DESCR
/end CHARACTERISTIC
/begin CHARACTERISTIC Ctp_agb_ac_min_is_n "Cartography to compute a minimum idle speed for engine needs when AC is active (EGB in drive mode)" CURVE 0xa0034d1c _REC_A1CUR_20_u2_u2 16383.75 _CNV_A_R_ENSD_LINEA_22_CM 0. 16383.75 FORMAT "%8.2"
 /begin AXIS_DESCR COM_AXIS Vxx_tco _CNV_A_R_LINEAR_____110_CM 16 -40. 200. FORMAT "%5.1" AXIS_PTS_REF Ctb_tco /end AXIS_DESCR
/end CHARACTERISTIC
/begin CHARACTERISTIC Ctp_pn_ac_min_is_n "Cartography to compute a minimum idle speed for engine needs when AC is active (EGB in neutral mode or MGB)" CURVE 0xa0034d3c _REC_A1CUR_20_u2_u2 16383.75 _CNV_A_R_ENSD_LINEA_22_CM 0. 16383.75 FORMAT "%8.2"
 /begin AXIS_DESCR COM_AXIS Vxx_tco _CNV_A_R_LINEAR_____110_CM 16 -40. 200. FORMAT "%5.1" AXIS_PTS_REF Ctb_tco /end AXIS_DESCR
/end CHARACTERISTIC
/begin MEASUREMENT Vbx_acs_acel_is_acel_pdl_cdn "Accelerator pedal condition in commercial vehicle accessories idle speed strategy" UBYTE _CNV_S_2_RANGE______3_CM 1 0. 0. 1. ECU_ADDRESS 0xd0007cab BIT_MASK 0x1 /end MEASUREMENT
/begin MEASUREMENT Vbx_acs_acel_is_brk_cdn "Brake pedal condition in commercial vehicle accessories idle speed strategy" UBYTE _CNV_S_2_RANGE______3_CM 1 0. 0. 1. ECU_ADDRESS 0xd0007cac BIT_MASK 0x1 /end MEASUREMENT
/begin MEASUREMENT Vbx_acs_acel_is_fail "Detection of a failure that causes commercial vehicle accessories accelerated idle speed deactivation" UBYTE _CNV_S_2_RANGE______3_CM 1 0. 0. 1. ECU_ADDRESS 0xd0007cad BIT_MASK 0x1 /end MEASUREMENT
/begin MEASUREMENT Vbx_acs_acel_is_vs_cdn "Vehicle speed condition in commercial vehicle accessories idle speed strategy" UBYTE _CNV_S_2_RANGE______3_CM 1 0. 0. 1. ECU_ADDRESS 0xd0007cae BIT_MASK 0x1 /end MEASUREMENT
/begin MEASUREMENT Vxx_ac_min_is_n "Air conditioning idle speed setpoint" UWORD _CNV_A_R_ENSD_LINEA_22_CM 1 0. 0. 16383.75 ECU_ADDRESS 0xd0006064 FORMAT "%8.2" /end MEASUREMENT
/begin MEASUREMENT Vxx_acs_min_is_n "Accessories idle speed setpoint" UWORD _CNV_A_R_ENSD_LINEA_22_CM 1 0. 0. 16383.75 ECU_ADDRESS 0xd0006066 FORMAT "%8.2" /end MEASUREMENT
/begin MEASUREMENT Vxx_eng_ac_min_is_n "Air conditioning minimum idle speed for engine needs" UWORD _CNV_A_R_ENSD_LINEA_22_CM 1 0. 0. 16383.75 ECU_ADDRESS 0xd0006068 FORMAT "%8.2" /end MEASUREMENT
/begin MEASUREMENT Vxx_pwst_min_is_n "Power steering idle speed setpoint" UWORD _CNV_A_R_ENSD_LINEA_22_CM 1 0. 0. 16383.75 ECU_ADDRESS 0xd000606a FORMAT "%8.2" /end MEASUREMENT
/begin CHARACTERISTIC Cbx_acs_acel_is_acel_pdl_cfm "Calibration to activate accelerator pedal condition in commercial vehicle accessories idle speed strategy" VALUE 0xa0021e38 _REC_S1VAL_20_u1 1. _CNV_A_R_ECME_LINEA_0_CM 0. 1. FORMAT "%1.0" BIT_MASK 0x1 /end CHARACTERISTIC
/begin CHARACTERISTIC Cbx_acs_acel_is_brk_cfm "Calibration to activate brake pedal condition in commercial vehicle accessories idle speed strategy" VALUE 0xa0021e39 _REC_S1VAL_20_u1 1. _CNV_A_R_ECME_LINEA_0_CM 0. 1. FORMAT "%1.0" BIT_MASK 0x1 /end CHARACTERISTIC
/begin CHARACTERISTIC Cbx_acs_acel_is_coup_cfm "Calibration to activate coupler state condition in commercial vehicle accessories idle speed strategy" VALUE 0xa0021e3a _REC_S1VAL_20_u1 1. _CNV_A_R_ECME_LINEA_0_CM 0. 1. FORMAT "%1.0" BIT_MASK 0x1 /end CHARACTERISTIC
/begin CHARACTERISTIC Cxx_ac_acel_is_dly "Air conditioning accelerated idle speed prolongation duration" VALUE 0xa0021e2e _REC_S1VAL_20_u2 6553.5 _CNV_A_R_LINEAR_____58_CM 0. 6553.5 FORMAT "%6.1" /end CHARACTERISTIC
/begin CHARACTERISTIC Cxx_acs_acel_is_thd "Commercial vehicle accessories idle speed threshold" VALUE 0xa0021e30 _REC_S1VAL_20_u2 16383.75 _CNV_A_R_ENSD_LINEA_22_CM 0. 16383.75 FORMAT "%8.2" /end CHARACTERISTIC
/begin CHARACTERISTIC Cxx_agb_pwst_min_is_n "Power steering accelerated idle speed (EGB in drive mode)" VALUE 0xa0021e32 _REC_S1VAL_20_u2 16383.75 _CNV_A_R_ENSD_LINEA_22_CM 0. 16383.75 FORMAT "%8.2" /end CHARACTERISTIC
/begin CHARACTERISTIC Cxx_pn_pwst_min_is_n "Power steering accelerated idle speed (EGB in neutral mode or MGB)" VALUE 0xa0021e34 _REC_S1VAL_20_u2 16383.75 _CNV_A_R_ENSD_LINEA_22_CM 0. 16383.75 FORMAT "%8.2" /end CHARACTERISTIC
/begin CHARACTERISTIC Cxx_pwst_is_acel_rtn_dly "Power steering accelerated idle speed prolongation duration" VALUE 0xa0021e36 _REC_S1VAL_20_u2 6553.5 _CNV_A_R_LINEAR_____58_CM 0. 6553.5 FORMAT "%6.1" /end CHARACTERISTIC
/begin CHARACTERISTIC Cmp_tco_amp_min_is_n_alco "Cartography (alcohol configuration) for idle speed setpoint according to the engine coolant temperature and atmospheric pressure" MAP 0xa0034a60 _REC_A1MAP_20_u2_u2_u2 16383.75 _CNV_A_R_ENSD_LINEA_22_CM 0. 16383.75 FORMAT "%8.2"
 /begin AXIS_DESCR COM_AXIS Vxx_tco _CNV_A_R_LINEAR_____110_CM 16 -40. 200. FORMAT "%5.1" AXIS_PTS_REF Ctb_tco /end AXIS_DESCR
 /begin AXIS_DESCR COM_AXIS Vxx_amp _CNV_A_R_LINEAR_____115_CM 6 0. 20000. FORMAT "%5.0" AXIS_PTS_REF Ctb_eng_amp /end AXIS_DESCR
/end CHARACTERISTIC
/begin CHARACTERISTIC Ctp_cold_tdc_pn_is_n_ofs_alco "Idle speed setpoint offset during catalyst warm-up sequences with cold start conditions, under neutral mode of the AT (or manual" CURVE 0xa0034b20 _REC_A1CUR_20_u2_u2 16383.75 _CNV_A_R_ENSD_LINEA_22_CM 0. 16383.75 FORMAT "%8.2"
 /begin AXIS_DESCR COM_AXIS Vxx_cata_wup_ctr _CNV_A_R_LINEAR_____101_CM 17 0. 65535. FORMAT "%5.0" AXIS_PTS_REF Ctb_cold_is_cata_wup_ctr /end AXIS_DESCR
/end CHARACTERISTIC
/begin CHARACTERISTIC Ctp_tdc_pn_tco_is_n_ofs_alco "Idle speed setpoint offset during catalyst warm-up phases without cold start conditions, under neutral mode of the AT (or manual" CURVE 0xa0034b44 _REC_A1CUR_20_u2_u2 16383.75 _CNV_A_R_ENSD_LINEA_22_CM 0. 16383.75 FORMAT "%8.2"
 /begin AXIS_DESCR COM_AXIS Vxx_cata_wup_ctr _CNV_A_R_LINEAR_____101_CM 17 0. 65535. FORMAT "%5.0" AXIS_PTS_REF Ctb_is_cata_wup_ctr /end AXIS_DESCR
/end CHARACTERISTIC
/begin MEASUREMENT Vxx_cold_tdc_pn_is_n_ofs_alco "Idle speed setpoint offset during catalyst warm-up sequences with cold start conditions, under neutral mode of the AT (or manual\\r\\ngearbox)" UWORD _CNV_A_R_ENSD_LINEA_22_CM 1 0. 0. 16383.75 ECU_ADDRESS 0xd00048ee FORMAT "%8.2" /end MEASUREMENT
/begin MEASUREMENT Vxx_is_fuel_typ_rat_tra "Ratio dedicated to the idle speed regulation renamed" UWORD _CNV_A_R_LINEAR_____161_CM 1 0. 0. 1. ECU_ADDRESS 0xd00048f0 /end MEASUREMENT
/begin MEASUREMENT Vxx_tco_amp_min_is_n_alco "Idle speed setpoint according to the engine coolant temperature and atmospheric pressure in alcohol configuration" UWORD _CNV_A_R_ENSD_LINEA_22_CM 1 0. 0. 16383.75 ECU_ADDRESS 0xd00048f2 FORMAT "%8.2" /end MEASUREMENT
/begin MEASUREMENT Vxx_tdc_pn_tco_is_n_ofs_alco "Idle speed setpoint offset during catalyst warm-up phases without cold start conditions, under neutral mode of the AT (or manual" UWORD _CNV_A_R_ENSD_LINEA_22_CM 1 0. 0. 16383.75 ECU_ADDRESS 0xd00048f4 FORMAT "%8.2" /end MEASUREMENT
/begin AXIS_PTS Ntb_gear "Gearbox ratio breakpoint" 0xa002da28 Vxx_gear _REC_A2AXS_20_u1 7. _CNV_A_R_LINEAR_____145_CM 8 -1. 6. READ_ONLY FORMAT "%2.0" /end AXIS_PTS
/begin AXIS_PTS Ctb_toil "engine oil temperature breakpoints" 0xa002d4e4 Vxx_toil _REC_A2AXS_20_u2 240. _CNV_A_R_LINEAR_____110_CM 16 -40. 200. FORMAT "%5.1" /end AXIS_PTS
/begin COMPU_METHOD _CNV_A_R_ECME_LINEA_0_CM "" RAT_FUNC "%6.3" "-" COEFFS 0 1. 0. 0 0 1 /end COMPU_METHOD
/begin COMPU_METHOD _CNV_S_2_RANGE______3_CM "" TAB_VERB "%6.3" "-" COMPU_TAB_REF _CNV_S_2_RANGE______3 /end COMPU_METHOD
/begin COMPU_VTAB _CNV_S_2_RANGE______3 "" TAB_VERB 2 0 "0" 1 "1" /end COMPU_VTAB
/begin COMPU_METHOD _CNV_A_R_LINEAR_____21_CM "" RAT_FUNC "%6.3" "rpm/s" COEFFS 0 1. 0. 0 0 1 /end COMPU_METHOD
/begin COMPU_METHOD _CNV_A_R_ENSD_LINEA_22_CM "" RAT_FUNC "%6.3" "rpm" COEFFS 0 4. 0. 0 0 1 /end COMPU_METHOD
/begin COMPU_METHOD _CNV_A_R_LINEAR_____29_CM "" RAT_FUNC "%6.3" "-" COEFFS 0 256. 0. 0 0 1 /end COMPU_METHOD
/begin COMPU_METHOD _CNV_A_R_LINEAR_____32_CM "" RAT_FUNC "%6.3" "s" COEFFS 0 100. 0. 0 0 1 /end COMPU_METHOD
/begin COMPU_METHOD _CNV_A_R_LINEAR_____50_CM "" RAT_FUNC "%6.3" "-" COEFFS 0 98304. 0. 0 0 1 /end COMPU_METHOD
/begin COMPU_METHOD _CNV_A_R_LINEAR_____58_CM "" RAT_FUNC "%6.3" "s" COEFFS 0 10. 0. 0 0 1 /end COMPU_METHOD
/begin COMPU_METHOD _CNV_A_R_LINEAR_____68_CM "" RAT_FUNC "%6.3" "s" COEFFS 0 1. 0. 0 0 1 /end COMPU_METHOD
/begin COMPU_METHOD _CNV_A_R_LINEAR_____71_CM "" RAT_FUNC "%6.3" "km/h" COEFFS 0 1. 0. 0 0 1 /end COMPU_METHOD
/begin COMPU_METHOD _CNV_A_R_LINEAR_____101_CM "" RAT_FUNC "%6.3" "TDC" COEFFS 0 1. 0. 0 0 1 /end COMPU_METHOD
/begin COMPU_METHOD _CNV_A_R_LINEAR_____107_CM "" RAT_FUNC "%6.3" "mV" COEFFS 0 1. 0. 0 0 1 /end COMPU_METHOD
/begin COMPU_METHOD _CNV_A_R_LINEAR_____110_CM "" RAT_FUNC "%6.3" "°C" COEFFS 0 10. 400. 0 0 1 /end COMPU_METHOD
/begin COMPU_METHOD _CNV_A_R_LINEAR_____115_CM "" RAT_FUNC "%6.3" "hPa" COEFFS 0 1. 0. 0 0 1 /end COMPU_METHOD
/begin COMPU_METHOD _CNV_A_R_LINEAR_____123_CM "" RAT_FUNC "%6.3" "-" COEFFS 0 100. 0. 0 0 1 /end COMPU_METHOD
/begin COMPU_METHOD _CNV_A_R_LINEAR_____125_CM "" RAT_FUNC "%6.3" "km/h" COEFFS 0 100. 0. 0 0 1 /end COMPU_METHOD
/begin COMPU_METHOD _CNV_A_R_LINEAR_____131_CM "" RAT_FUNC "%6.3" "s" COEFFS 0 50. 0. 0 0 1 /end COMPU_METHOD
/begin COMPU_METHOD _CNV_A_R_LINEAR_____143_CM "" RAT_FUNC "%6.3" "-" COEFFS 0 65535. 0. 0 0 1 /end COMPU_METHOD
/begin COMPU_METHOD _CNV_A_R_LINEAR_____145_CM "" RAT_FUNC "%6.3" "-" COEFFS 0 1. 1. 0 0 1 /end COMPU_METHOD
/begin COMPU_METHOD _CNV_A_R_LINEAR_____146_CM "" RAT_FUNC "%6.3" "%" COEFFS 0 100. 0. 0 0 1 /end COMPU_METHOD
/begin COMPU_METHOD _CNV_A_R_LINEAR_____150_CM "" RAT_FUNC "%6.3" "%" COEFFS 0 20. 0. 0 0 1 /end COMPU_METHOD
/begin COMPU_METHOD _CNV_A_R_LINEAR_____159_CM "" RAT_FUNC "%6.3" "%" COEFFS 0 655.35 0. 0 0 1 /end COMPU_METHOD
/begin COMPU_METHOD _CNV_A_R_LINEAR_____161_CM "" RAT_FUNC "%6.3" "-" COEFFS 0 1000. 0. 0 0 1 /end COMPU_METHOD
/begin COMPU_METHOD _CNV_A_R_LINEAR_____162_CM "" RAT_FUNC "%6.3" "-" COEFFS 0 255. 0. 0 0 1 /end COMPU_METHOD
/begin COMPU_METHOD _CNV_A_R_LINEAR_____165_CM "" RAT_FUNC "%6.3" "%" COEFFS 0 2.55 0. 0 0 1 /end COMPU_METHOD
/begin COMPU_METHOD _CNV_A_R_LINEAR_____172_CM "" RAT_FUNC "%6.3" "kg/h" COEFFS 0 20. 0. 0 0 1 /end COMPU_METHOD
/begin COMPU_METHOD _CNV_S_3_STATUS_OK__179_CM "" TAB_VERB "%6.3" "-" COMPU_TAB_REF _CNV_S_3_STATUS_OK__179 /end COMPU_METHOD
/begin COMPU_VTAB _CNV_S_3_STATUS_OK__179 "" TAB_VERB 3 0 "Nsx_vld_nok_0" 1 "Nsx_vld_ok_1" 2 "Nsx_vld_fail_2" /end COMPU_VTAB
/begin COMPU_METHOD _CNV_S_4_STATUS_OK__180_CM "" TAB_VERB "%6.3" "-" COMPU_TAB_REF _CNV_S_4_STATUS_OK__180 /end COMPU_METHOD
/begin COMPU_VTAB _CNV_S_4_STATUS_OK__180 "" TAB_VERB 4 0 "Nsx_vld_nok_0" 1 "Nsx_vld_ok_1" 2 "Nsx_vld_fail_2" 3 "Nsx_vld_fail_3" /end COMPU_VTAB
/begin COMPU_METHOD _CNV_A_R_LINEAR_____182_CM "" RAT_FUNC "%6.3" "rpm" COEFFS 0 4. 32768. 0 0 1 /end COMPU_METHOD
/begin COMPU_METHOD _CNV_A_R_LINEAR_____205_CM "" RAT_FUNC "%6.3" "V" COEFFS 0 100. 0. 0 0 1 /end COMPU_METHOD
/begin COMPU_METHOD _CNV_S_2_STATUS_OK__269_CM "" TAB_VERB "%6.3" "-" COMPU_TAB_REF _CNV_S_2_STATUS_OK__269 /end COMPU_METHOD
/begin COMPU_VTAB _CNV_S_2_STATUS_OK__269 "" TAB_VERB 2 0 "Nsx_vld_nok_0" 1 "Nsx_vld_ok_1" /end COMPU_VTAB
/begin COMPU_METHOD _CNV_A_R_LINEAR_____274_CM "" RAT_FUNC "%6.3" "km" COEFFS 0 1. 0. 0 0 1 /end COMPU_METHOD
/begin COMPU_METHOD _CNV_A_R_LINEAR_____289_CM "" RAT_FUNC "%6.3" "A" COEFFS 0 10000. 0. 0 0 1 /end COMPU_METHOD
/begin COMPU_METHOD _CNV_A_R_LINEAR_____360_CM "" RAT_FUNC "%6.3" "N" COEFFS 0 0.5 10000. 0 0 1 /end COMPU_METHOD
/begin COMPU_METHOD _CNV_A_R_LINEAR_____369_CM "" RAT_FUNC "%6.3" "Nm" COEFFS 0 10. 0. 0 0 1 /end COMPU_METHOD
/begin COMPU_METHOD _CNV_A_R_LINEAR_____373_CM "" RAT_FUNC "%6.3" "bar" COEFFS 0 10. 0. 0 0 1 /end COMPU_METHOD
/begin COMPU_METHOD _CNV_A_R_LINEAR_____374_CM "" RAT_FUNC "%6.3" "V/Bar" COEFFS 0 1000. 0. 0 0 1 /end COMPU_METHOD
/begin COMPU_METHOD _CNV_A_R_LINEAR_____375_CM "" RAT_FUNC "%6.3" "s/m.K^0.5" COEFFS 0 1048576. 0. 0 0 1 /end COMPU_METHOD
/begin COMPU_METHOD _CNV_A_R_LINEAR_____376_CM "" RAT_FUNC "%6.3" "-" COEFFS 0 1024. -1024. 0 0 1 /end COMPU_METHOD
/begin COMPU_METHOD _CNV_A_R_LINEAR_____377_CM "" RAT_FUNC "%6.3" "hPa/s" COEFFS 0 2.56e-002 0. 0 0 1 /end COMPU_METHOD
/begin COMPU_METHOD _CNV_A_R_LINEAR_____378_CM "" RAT_FUNC "%6.3" "V²" COEFFS 0 1. 0. 0 0 1 /end COMPU_METHOD
/begin COMPU_METHOD _CNV_S_5_RANGE_STAT_379_CM "" TAB_VERB "%6.3" "-" COMPU_TAB_REF _CNV_S_5_RANGE_STAT_379 /end COMPU_METHOD
/begin COMPU_VTAB _CNV_S_5_RANGE_STAT_379 "" TAB_VERB 5 1 "Nsx_lbdw_hot_obd_wait" 2 "Nsx_lbdw_hot_obd_stab" 3 "Nsx_lbdw_hot_obd_mes" 4 "Nsx_lbdw_hot_obd_diag" 5 "Nsx_lbdw_hot_obd_diag_end" /end COMPU_VTAB
/begin COMPU_METHOD _CNV_A_R_LINEAR_____380_CM "" RAT_FUNC "%6.3" "J" COEFFS 0 27.30666666666667 0. 0 0 1 /end COMPU_METHOD
/begin COMPU_METHOD _CNV_A_R_LINEAR_____381_CM "" RAT_FUNC "%6.3" "W" COEFFS 0 273.0666666666667 0. 0 0 1 /end COMPU_METHOD
/begin COMPU_METHOD _CNV_A_R_LINEAR_____382_CM "" RAT_FUNC "%6.3" "Ohm" COEFFS 0 25.6 -2.560000000000001 0 0 1 /end COMPU_METHOD
/begin COMPU_METHOD _CNV_S_5_STATUS_LAM_383_CM "" TAB_VERB "%6.3" "-" COMPU_TAB_REF _CNV_S_5_STATUS_LAM_383 /end COMPU_METHOD
/begin COMPU_VTAB _CNV_S_5_STATUS_LAM_383 "" TAB_VERB 5 1 "Nsx_lbup_hot_obd_wait" 2 "Nsx_lbup_hot_obd_stab" 3 "Nsx_lbup_hot_obd_mes" 4 "Nsx_lbup_hot_obd_diag" 5 "Nsx_lbup_hot_obd_diag_end" /end COMPU_VTAB
/begin COMPU_METHOD _CNV_A_R_LINEAR_____384_CM "" RAT_FUNC "%6.3" "km" COEFFS 0 6.25e-002 0. 0 0 1 /end COMPU_METHOD
/begin COMPU_METHOD _CNV_A_R_LINEAR_____385_CM "" RAT_FUNC "%6.3" "m/s²" COEFFS 0 2500. 0. 0 0 1 /end COMPU_METHOD
/begin COMPU_METHOD _CNV_A_R_LINEAR_____386_CM "" RAT_FUNC "%6.3" "-" COEFFS 0 71428.57142857142 -3.637978807091713e-012 0 0 1 /end COMPU_METHOD
/begin COMPU_METHOD _CNV_A_R_LINEAR_____387_CM "" RAT_FUNC "%6.3" "m/s" COEFFS 0 1000. 0. 0 0 1 /end COMPU_METHOD
/begin COMPU_METHOD _CNV_A_R_LINEAR_____388_CM "" RAT_FUNC "%6.3" "m/s" COEFFS 0 100. 0. 0 0 1 /end COMPU_METHOD
/begin COMPU_METHOD _CNV_A_R_LINEAR_____389_CM "" RAT_FUNC "%6.3" "s" COEFFS 0 0.1 0. 0 0 1 /end COMPU_METHOD
/begin COMPU_METHOD _CNV_A_R_LINEAR_____390_CM "" RAT_FUNC "%6.3" "-" COEFFS 0 71428.57142857142 0. 0 0 1 /end COMPU_METHOD
/begin COMPU_METHOD _CNV_A_R_LINEAR_____391_CM "" RAT_FUNC "%6.3" "m" COEFFS 0 100. -50. 0 0 1 /end COMPU_METHOD
/begin COMPU_METHOD _CNV_A_R_LINEAR_____392_CM "" RAT_FUNC "%6.3" "km/h" COEFFS 0 1. -5. 0 0 1 /end COMPU_METHOD
/begin COMPU_METHOD _CNV_S_5_CANISTER_P_393_CM "" TAB_VERB "%6.3" "-" COMPU_TAB_REF _CNV_S_5_CANISTER_P_393 /end COMPU_METHOD
/begin COMPU_VTAB _CNV_S_5_CANISTER_P_393 "" TAB_VERB 5 0 "Nsx_cp_ini" 1 "Nsx_cp_out" 2 "Nsx_cp_ad" 4 "Nsx_cp_nom" 8 "Nsx_cp_ol" /end COMPU_VTAB
/begin COMPU_METHOD _CNV_A_R_LINEAR_____397_CM "" RAT_FUNC "%6.3" "1/V" COEFFS 0 255. 0. 0 0 1 /end COMPU_METHOD
/begin RECORD_LAYOUT _REC_S1VAL_20_u1 FNC_VALUES 1 UBYTE COLUMN_DIR DIRECT /end RECORD_LAYOUT
/begin RECORD_LAYOUT _REC_A2AXS_20_u1 NO_AXIS_PTS_X 1 UBYTE AXIS_PTS_X 2 UBYTE INDEX_INCR DIRECT /end RECORD_LAYOUT
/begin RECORD_LAYOUT _REC_S1VAL_20_u2 FNC_VALUES 1 UWORD COLUMN_DIR DIRECT /end RECORD_LAYOUT
/begin RECORD_LAYOUT _REC_A2AXS_20_u2 NO_AXIS_PTS_X 1 UWORD AXIS_PTS_X 2 UWORD INDEX_INCR DIRECT /end RECORD_LAYOUT
/begin RECORD_LAYOUT _REC_A1CUR_20_u1_u2 FNC_VALUES 1 UBYTE COLUMN_DIR DIRECT /end RECORD_LAYOUT
/begin RECORD_LAYOUT _REC_A1CUR_20_u2_u1 FNC_VALUES 1 UWORD COLUMN_DIR DIRECT /end RECORD_LAYOUT
/begin RECORD_LAYOUT _REC_A1MAP_20_u2_u2_u2 FNC_VALUES 1 UWORD COLUMN_DIR DIRECT /end RECORD_LAYOUT
/begin RECORD_LAYOUT _REC_A1CUR_20_u2_u2 FNC_VALUES 1 UWORD COLUMN_DIR DIRECT /end RECORD_LAYOUT
/begin FUNCTION InTqiTrz_Corxxxx ""
 /begin DEF_CHARACTERISTIC Cxx_trz_ad_b_fil_fac Cxx_trz_ad_b_grd_prs Cxx_trz_ad_b_n_max Cxx_trz_ad_b_n_min Cxx_trz_ad_b_nr_tdc Cxx_trz_b_ini /end DEF_CHARACTERISTIC
 /begin OUT_MEASUREMENT Vxx_trz_ad_b1_val Vxx_trz_ad_b2_val Vxx_trz_ad_b1_dif Vxx_trz_ad_b2_dif Vxx_trz_ad_b1_fil Vxx_trz_ad_b2_fil Vxx_trz_ad_b_ctr_tdc Vbx_trz_ad_b_ok Vbx_stt_trz_cor_0_tmp Vbx_stt_trz_cor_1_tmp Vbx_stt_trz_cor_2_tmp Vbx_trz_ad_b1_stt_tmp Vbx_trz_ad_b_ena Vbx_trz_cyl_slc Vsx_trz_ad_b_stt /end OUT_MEASUREMENT
/end FUNCTION
/begin FUNCTION InTqiTrz_Mdlxxxx "" /begin DEF_CHARACTERISTIC Cxx_trz_a Cxx_trz_n_max Cxx_trz_n_min /end DEF_CHARACTERISTIC
 /begin OUT_MEASUREMENT Vbx_trz_clc_ok Vbx_trz_raw_clc Vbx_trz_raw_err Vbx_trz_val_neg Vsx_trz_stt Vxx_trz_ad_b_val Vxx_trz_raw_val Vxx_trz_val_tmp Vxx_trz_val_tmp1 /end OUT_MEASUREMENT
/end FUNCTION
/begin FUNCTION InVfiAci "" /begin OUT_MEASUREMENT Vbx_ac_prs_lk_stt Vbx_ac_req_lk_stt Vbx_comp_cfa_lk_stt /end OUT_MEASUREMENT
 /begin SUB_FUNCTION InVfiAci_Mngtxcs InVfiAci_Acprssr InVfiAci_Acclucs InVfiAci_Acwfinx /end SUB_FUNCTION
/end FUNCTION
/begin FUNCTION InVfiAci_Mngtxcs ""
 /begin DEF_CHARACTERISTIC Cxx_ac_req_dly Cxx_ac_req_dsb_dly Cxx_wf_ac_req_dly Cxx_wf_ac_req_dsb_dly /end DEF_CHARACTERISTIC
 /begin OUT_MEASUREMENT Vbx_ac_mdf1_req_ext Vbx_ac_mdf2_req_ext Vbx_ac_req Vbx_agb_mdf1_req Vbx_agb_mdf2_req /end OUT_MEASUREMENT
/end FUNCTION
/begin FUNCTION InVfiAci_Acprssr ""
 /begin DEF_CHARACTERISTIC Cxx_ac_lk_stt_dly Cxx_ac_prs_fac Cxx_ac_prs_lk_stt_dly Cxx_ac_prs_ofs Cxx_ac_prs_v_max Cxx_ac_prs_v_min Cxx_dfdec_ac_prs Cxx_dfinc_ac_prs /end DEF_CHARACTERISTIC
 /begin OUT_MEASUREMENT Vbx_ac_ext_pres Vbx_ac_pres Vbx_df_ac_prs_h Vbx_df_ac_prs_l Vsx_ac_prs_vld Vxx_ac_prs /end OUT_MEASUREMENT
/end FUNCTION
/begin FUNCTION InVfiAci_Acclucs "" /begin OUT_MEASUREMENT Vbx_ac_clu_req /end OUT_MEASUREMENT /end FUNCTION
/begin FUNCTION InVfiAci_Acwfinx "" /begin OUT_MEASUREMENT Vbx_wf_ac_req /end OUT_MEASUREMENT /end FUNCTION
/begin FUNCTION InPciAcc "" /begin SUB_FUNCTION InPciAcc_Noaccxx /end SUB_FUNCTION /end FUNCTION
/begin FUNCTION InPciAcc_Noaccxx "" /begin OUT_MEASUREMENT Vsx_acc_sdl_ctl_typ Vxx_acc_forc_sp Vxx_sdl_forc_sp /end OUT_MEASUREMENT /end FUNCTION
/begin FUNCTION ClCooSpt "" /begin SUB_FUNCTION ClCooSpt_Cteaubc ClCooSpt_Tstaxbc /end SUB_FUNCTION /end FUNCTION
/begin FUNCTION ClCooSpt_Cteaubc ""
 /begin OUT_MEASUREMENT Vbx_mdf2_reg Vbx_tco_sp_l_mod Vbx_tsta_ip_dft_lght_tco_h_sp Vxx_mdf2_reg_dly Vxx_tco_sp /end OUT_MEASUREMENT
/end FUNCTION
/begin FUNCTION ClCooSpt_Tstaxbc "" /begin OUT_MEASUREMENT Vsx_tsta_vld /end OUT_MEASUREMENT /end FUNCTION
/begin FUNCTION OuCloCoo ""
 /begin SUB_FUNCTION OuCloCoo_Chvcmdx OuCloCoo_Mdfanxx OuCloCoo_Tceauxx OuCloCoo_Clatoxx OuCloCoo_Paotxxx /end SUB_FUNCTION
/end FUNCTION
/begin FUNCTION OuCloCoo_Chvcmdx "" /begin OUT_MEASUREMENT Vbx_thpl_is_acel /end OUT_MEASUREMENT /end FUNCTION
/begin FUNCTION OuCloCoo_Mdfanxx "" /begin DEF_CHARACTERISTIC Cxx_mdf_min_dly Cxx_mdf_on_dly /end DEF_CHARACTERISTIC
 /begin OUT_MEASUREMENT Vbx_ac_mdf1_req Vbx_ac_mdf2_req Vbx_mdf1_cmd Vbx_mdf1_cmd_dly Vbx_mdf2_cmd Vbx_mdf2_cmd_dly Vxx_mdf_min_dly_cnt Vxx_mdf_min_dly_dt /end OUT_MEASUREMENT
/end FUNCTION
/begin FUNCTION OuCloCoo_Tceauxx "" /begin DEF_CHARACTERISTIC Ctb_tco_sp Ctd_tco_7 /end DEF_CHARACTERISTIC /begin OUT_MEASUREMENT Vbx_tsta_ip_trs_l_mux Vxx_tco_sp_mux /end OUT_MEASUREMENT /end FUNCTION
/begin FUNCTION OuCloCoo_Clatoxx ""
 /begin DEF_CHARACTERISTIC Cbx_ip_lght_tco_ovh_igk_off_ena Cxx_dfdec_ip_lght_tco_ovh Cxx_dfinc_ip_lght_tco_ovh Cxx_dft_lght_off_tco_thd Cxx_dft_lght_on_tco_thd Cxx_tsta_dft_lght_off_tco_thd Cxx_tsta_dft_lght_on_tco_thd /end DEF_CHARACTERISTIC
 /begin OUT_MEASUREMENT Vbx_df_ip_lght_tco_ovh Vbx_ip_dft_lght_tco Vbx_ip_lght_tco_ovh_igk_off_ena /end OUT_MEASUREMENT
/end FUNCTION
/begin FUNCTION OuCloCoo_Paotxxx ""
 /begin DEF_CHARACTERISTIC Cxx_dfdec_wpmp_tcr_blk Cxx_dfdec_wpmp_tcr_oc Cxx_dfdec_wpmp_tcr_scg Cxx_dfdec_wpmp_tcr_scw Cxx_dfinc_wpmp_tcr_blk Cxx_dfinc_wpmp_tcr_oc Cxx_dfinc_wpmp_tcr_scg Cxx_dfinc_wpmp_tcr_scw Cxx_wpmp_tcr_max_t Cxx_wpmp_tcr_max_tco_t Cxx_wpmp_tcr_tco_hys Cxx_wpmp_tcr_tco_thd /end DEF_CHARACTERISTIC
 /begin OUT_MEASUREMENT Vbx_wpmp_tcr Vbx_wpmp_tcr_cmd Vbx_wpmp_tcr_pws Vbx_wpmp_tcr_stop Vsx_wpmp_tcr Vxx_wpmp_tco_tcr_dly Vxx_wpmp_tcr_dly /end OUT_MEASUREMENT
/end FUNCTION
/begin FUNCTION AsBstSpt "" /begin SUB_FUNCTION AsBstSpt_Spgspxx /end SUB_FUNCTION /end FUNCTION
/begin FUNCTION AsBstSpt_Spgspxx ""
 /begin DEF_CHARACTERISTIC Ctb_it_psn Ctb_spg_ar_maf_fac Cmp_spg_sp_it_mod Ctp_inv_prs_rat Ctp_spg_max_grd Cbx_spg_reg_cfm Cxx_spg_max_prs_dif /end DEF_CHARACTERISTIC
 /begin OUT_MEASUREMENT Vxx_spg_ar_maf_fac Vxx_spg_fil_spg_prs_sp Vxx_spg_prs_sp /end OUT_MEASUREMENT
/end FUNCTION
/begin FUNCTION OuAtoDlo "" /begin OUT_MEASUREMENT Vxx_lbdw_hot_obd_crt_mv_rtn Vxx_lbdw_hot_obd_crt_thd_rtn /end OUT_MEASUREMENT
 /begin SUB_FUNCTION OuAtoDlo_Heating OuAtoDlo_Heatdgn OuAtoDlo_Obdheat OuAtoDlo_Alcoxxx OuAtoDlo_Schxxxx /end SUB_FUNCTION
/end FUNCTION
/begin FUNCTION OuAtoDlo_Heating ""
 /begin DEF_CHARACTERISTIC Ctb_n_lbdw_hot_dsb Ctb_t_lbdw_hot_rest Ctb_t_lbdw_hot_sta Ctb_tco_lbdw_hot_dly Ctd_t_rat_lbdw_rest Ctd_t_rat_lbdw_sta Ctp_n_lbdw_hot_dsb_map Ctp_tco_lbdw_hot_dly Cbx_lbdw_dwpt_per_ena Cbx_lbdw_tco_sta_mem Cxx_lbdw_cold_sta_rat Cxx_lbdw_dft_pwm Cxx_lbdw_dly_rest_t Cxx_lbdw_hot_cmd_map_hys Cxx_lbdw_hot_cmd_vs_hys Cxx_lbdw_hot_dsb_vs Cxx_lbdw_hot_sta_end Cxx_lbdw_rms_v Cxx_lbdw_tco_rest_thd /end DEF_CHARACTERISTIC
 /begin OUT_MEASUREMENT Vbx_aut_eng_lbdw_hot Vbx_lbdw_hot_cmd Vbx_lbdw_hot_cmd_stt Vbx_lbdw_hot_cmd_stt_sf Vbx_lbdw_hot_t_rest Vxx_lbdw_appl_pwm Vxx_lbdw_clc_pwm Vxx_lbdw_dly_rest_t Vxx_lbdw_hot_dly_ctr Vxx_lbdw_hot_rest_stt Vxx_lbdw_hot_t Vxx_lbdw_hot_t_prev Vxx_lbdw_pwm_ctr Vxx_lbdw_ref_pwm Vxx_lbdw_ref_pwm_sf Vxx_lbdw_tco Vxx_lbdw_tco_sta_mem Vxx_n_lbdw_hot_dsb_map Vxx_t_lbdw_hot_sta Vxx_t_rat_lbdw_rest Vxx_t_rat_lbdw_sta /end OUT_MEASUREMENT
/end FUNCTION
/begin FUNCTION OuAtoDlo_Heatdgn ""
 /begin DEF_CHARACTERISTIC Cxx_dfdec_lbdw_hot_oc Cxx_dfdec_lbdw_hot_scg Cxx_dfdec_lbdw_hot_scw Cxx_dfinc_lbdw_hot_oc Cxx_dfinc_lbdw_hot_scg Cxx_dfinc_lbdw_hot_scw /end DEF_CHARACTERISTIC
 /begin OUT_MEASUREMENT Vsx_lbdw_hot_vld /end OUT_MEASUREMENT
/end FUNCTION
/begin FUNCTION OuAtoDlo_Obdheat ""
 /begin DEF_CHARACTERISTIC Cxx_dfdec_lbdw_hot_dirt_lkg Cxx_dfinc_lbdw_hot_dirt_lkg Cxx_lbdw_hot_obd_acq_nr_min Cxx_lbdw_hot_obd_acq_win_nr Cxx_lbdw_hot_obd_crt_thd Cxx_lbdw_hot_obd_lgl_dly Cxx_lbdw_hot_obd_stab_dly Cxx_lbdw_hot_obd_tco_min /end DEF_CHARACTERISTIC
 /begin OUT_MEASUREMENT Vbx_df_lbdw_hot_dirt_lkg Vbx_diag_ena_lbdw_hot_dirt_lkg Vbx_lbdw_hot_obd_cond_ok Vbx_lbdw_hot_obd_diag_stop Vbx_lbdw_hot_obd_inhi_cond Vbx_lbdw_hot_obd_mes Vbx_lbdw_hot_obd_phy_cond Vbx_lbdw_hot_obd_sw_cond Vsx_lbdw_hot_obd_stt Vxx_lbdw_hot_obd_acq_nr Vxx_lbdw_hot_obd_acq_win_nr Vxx_lbdw_hot_obd_crt_mv Vxx_lbdw_hot_obd_crt_mv_tot Vxx_lbdw_hot_obd_lgl_dly Vxx_lbdw_hot_obd_stab_dly Vxx_lbdw_hot_obd_win_dfctr /end OUT_MEASUREMENT
/end FUNCTION
/begin FUNCTION OuAtoDlo_Alcoxxx "" /begin DEF_CHARACTERISTIC Ctp_tco_lbdw_hot_dly_alco /end DEF_CHARACTERISTIC
 /begin OUT_MEASUREMENT Vbx_aut_eng_lbdw_hot_alco Vxx_lbdw_hot_dly_ctr_alco Vxx_lbdw_tco_alco /end OUT_MEASUREMENT
/end FUNCTION
/begin FUNCTION OuAtoDlo_Schxxxx "" /begin DEF_CHARACTERISTIC Cbx_lbdw_heat_diag_cfm /end DEF_CHARACTERISTIC /begin OUT_MEASUREMENT Vbx_lbdw_heat_diag_cfm /end OUT_MEASUREMENT /end FUNCTION
/begin FUNCTION OuCboUlo "" /begin OUT_MEASUREMENT Vxx_lbup_hot_obd_crt_mv_rtn Vxx_lbup_hot_obd_crt_thd_rtn /end OUT_MEASUREMENT
 /begin SUB_FUNCTION OuCboUlo_Heating OuCboUlo_Heatdgn OuCboUlo_Obdheat OuCboUlo_Alcoxxx OuCboUlo_Schxxxx /end SUB_FUNCTION
/end FUNCTION
/begin FUNCTION OuCboUlo_Heating ""
 /begin DEF_CHARACTERISTIC Ctb_n_lbup_hot_dsb Ctb_t_lbup_hot_rest Ctb_t_lbup_hot_sta Ctb_tco_lbup_hot_dly Ctd_t_rat_lbup_rest Ctd_t_rat_lbup_sta Ctp_n_lbup_hot_dsb_map Ctp_tco_lbup_hot_dly Cbx_lbup_dwpt_per_ena Cxx_lbup_cold_sta_rat Cxx_lbup_dft_pwm Cxx_lbup_dly_rest_t Cxx_lbup_heat_r Cxx_lbup_hot_cmd_map_hys Cxx_lbup_hot_cmd_vs_hys Cxx_lbup_hot_dsb_vs Cxx_lbup_hot_egy Cxx_lbup_hot_egy_max Cxx_lbup_hot_sta_end Cxx_lbup_loss_pow Cxx_lbup_rms_v Cxx_lbup_tco_rest_thd /end DEF_CHARACTERISTIC
 /begin OUT_MEASUREMENT Vbx_aut_eng_lbup_hot Vbx_lbup_hot Vbx_lbup_hot_cmd Vbx_lbup_hot_cmd_stt Vbx_lbup_hot_cmd_stt_sf Vxx_lbup_appl_pwm Vxx_lbup_clc_pwm Vxx_lbup_dly_rest_t Vxx_lbup_heat_egy Vxx_lbup_heat_egy_inc Vxx_lbup_heat_raw_pow Vxx_lbup_hot_dly_ctr Vxx_lbup_hot_rest_stt Vxx_lbup_hot_t Vxx_lbup_pwm_ctr Vxx_lbup_ref_pwm Vxx_lbup_ref_pwm_sf Vxx_n_lbup_hot_dsb_map Vxx_t_lbup_hot_sta Vxx_t_rat_lbup_rest Vxx_t_rat_lbup_sta /end OUT_MEASUREMENT
/end FUNCTION
/begin FUNCTION OuCboUlo_Heatdgn ""
 /begin DEF_CHARACTERISTIC Cxx_dfdec_lbup_hot_oc Cxx_dfdec_lbup_hot_scg Cxx_dfdec_lbup_hot_scw Cxx_dfinc_lbup_hot_oc Cxx_dfinc_lbup_hot_scg Cxx_dfinc_lbup_hot_scw /end DEF_CHARACTERISTIC
 /begin OUT_MEASUREMENT Vsx_lbup_hot_vld /end OUT_MEASUREMENT
/end FUNCTION
/begin FUNCTION OuCboUlo_Obdheat ""
 /begin DEF_CHARACTERISTIC Cxx_dfdec_lbup_hot_dirt_lkg Cxx_dfinc_lbup_hot_dirt_lkg Cxx_lbup_hot_obd_acq_nr_min Cxx_lbup_hot_obd_acq_win_nr Cxx_lbup_hot_obd_crt_thd Cxx_lbup_hot_obd_lgl_dly Cxx_lbup_hot_obd_stab_dly Cxx_lbup_hot_obd_tco_min /end DEF_CHARACTERISTIC
 /begin OUT_MEASUREMENT Vbx_df_lbup_hot_dirt_lkg Vbx_diag_ena_lbup_hot_dirt_lkg Vbx_lbup_hot_obd_cond_ok Vbx_lbup_hot_obd_diag_stop Vbx_lbup_hot_obd_inhi_cond Vbx_lbup_hot_obd_mes Vbx_lbup_hot_obd_phy_cond Vbx_lbup_hot_obd_sw_cond Vsx_lbup_hot_obd_stt Vxx_lbup_hot_obd_acq_nr Vxx_lbup_hot_obd_acq_win_nr Vxx_lbup_hot_obd_crt_mv Vxx_lbup_hot_obd_crt_mv_tot Vxx_lbup_hot_obd_lgl_dly Vxx_lbup_hot_obd_stab_dly Vxx_lbup_hot_obd_win_dfctr /end OUT_MEASUREMENT
/end FUNCTION
/begin FUNCTION OuCboUlo_Alcoxxx "" /begin DEF_CHARACTERISTIC Ctp_tco_lbup_hot_dly_alco /end DEF_CHARACTERISTIC /begin OUT_MEASUREMENT Vxx_lbup_hot_dly_ctr_alco /end OUT_MEASUREMENT /end FUNCTION
/begin FUNCTION OuCboUlo_Schxxxx "" /begin DEF_CHARACTERISTIC Cbx_lbup_heat_diag_cfm /end DEF_CHARACTERISTIC /begin OUT_MEASUREMENT Vbx_lbup_heat_diag_cfm /end OUT_MEASUREMENT /end FUNCTION
/begin FUNCTION VfCrkMng "" /begin SUB_FUNCTION VfCrkMng_Mngtxxx VfCrkMng_Engreqx /end SUB_FUNCTION /end FUNCTION
/begin FUNCTION VfCrkMng_Mngtxxx ""
 /begin DEF_CHARACTERISTIC Ctb_fct_tco_crkm Ctp_fct_tco_dly Cxx_ena_sta_agb_vld_dly Cxx_frst_sta_dly Cxx_sta_stt_vld_dly Cxx_wait_sta_fail_dly /end DEF_CHARACTERISTIC
 /begin OUT_MEASUREMENT Vbx_dft_sta Vbx_long_crk_req Vsx_ena_sta_agb_ecm Vsx_ena_sta_ecm /end OUT_MEASUREMENT
/end FUNCTION
/begin FUNCTION VfCrkMng_Engreqx "" /begin OUT_MEASUREMENT Vbx_eng_crk_wait /end OUT_MEASUREMENT /end FUNCTION
/begin FUNCTION VfSlkMng ""
 /begin SUB_FUNCTION VfSlkMng_Lockxv4 VfSlkMng_Lockxv2 VfSlkMng_Lockxcs VfSlkMng_Schxxxx /end SUB_FUNCTION
/end FUNCTION
/begin FUNCTION VfSlkMng_Lockxv4 ""
 /begin DEF_CHARACTERISTIC Cbx_swlk_dsb Cbx_swlk_key_spc_req Cbx_swlk_req Cxx_swlk_chlg_dly Cxx_swlk_diag_dly Cxx_swlk_id_forb_dly Cxx_swlk_id_nok_ctr_dec Cxx_swlk_id_nr_ena Cxx_swlk_key_dlt_dly Cxx_swlk_key_dly Cxx_swlk_noi_1 Cxx_swlk_noi_2 Cxx_swlk_noi_3 Cxx_swlk_noi_4 Cxx_swlk_noi_5 Cxx_swlk_noi_6 Cxx_swlk_pwl_dly /end DEF_CHARACTERISTIC
 /begin OUT_MEASUREMENT SLockRequestControl SoftwareLockRequest[0] SoftwareLockRequest[1] SoftwareLockRequest[2] SoftwareLockRequest[3] SoftwareLockRequest[4] SoftwareLockRequest[5] Vbx_supl_key_bkup_ok Vbx_supl_key_norm_ok Vbx_swlk_4_ecm_prot_stt Vbx_swlk_4_pwl_rtn_req Vbx_swlk_cnt_tool_req Vbx_swlk_diag_avl Vbx_swlk_diag_ccu Vbx_swlk_diag_ecm Vbx_swlk_diag_mux Vbx_swlk_diag_tool Vbx_swlk_dsb_ena Vsx_swlk_stt Vxx_swlk_4_eng_run_ena Vxx_swlk_diag_1 Vxx_swlk_diag_2 Vxx_swlk_diag_3 Vxx_swlk_key_mem_stt Vxx_swlk_nok_id_ctr /end OUT_MEASUREMENT
/end FUNCTION
/begin FUNCTION VfSlkMng_Lockxv2 ""
 /begin OUT_MEASUREMENT Vbx_swlk2_code_line_dfl Vbx_swlk2_ecm_lck_stt Vbx_swlk2_ecm_prot_stt Vbx_swlk2_eprm_dfl Vbx_swlk2_key_mem_stt Vbx_swlk2_pwl_rtn_req /end OUT_MEASUREMENT
/end FUNCTION
/begin FUNCTION VfSlkMng_Lockxcs ""
 /begin OUT_MEASUREMENT Vbx_swlk_ecm_prot_stt Vbx_swlk_pwl_rtn_req Vxx_eng_run_ena_swlk /end OUT_MEASUREMENT
/end FUNCTION
/begin FUNCTION VfSlkMng_Schxxxx "" /begin DEF_CHARACTERISTIC Cbx_swlk_2_4_cfm /end DEF_CHARACTERISTIC /begin OUT_MEASUREMENT Vbx_swlk_2_4_cfm /end OUT_MEASUREMENT /end FUNCTION
/begin FUNCTION AsMafSpt "" /begin SUB_FUNCTION AsMafSpt_Mafspxx /end SUB_FUNCTION /end FUNCTION
/begin FUNCTION AsMafSpt_Mafspxx "" /begin OUT_MEASUREMENT Vxx_it_maf_sp Vxx_maf_eng_sp /end OUT_MEASUREMENT /end FUNCTION
/begin FUNCTION InCbiKnk "" /begin SUB_FUNCTION InCbiKnk_Emnoixx InCbiKnk_Knkdtxx /end SUB_FUNCTION /end FUNCTION
/begin FUNCTION InCbiKnk_Emnoixx "" /begin DEF_CHARACTERISTIC Cxx_knk_fil_ftc /end DEF_CHARACTERISTIC /begin OUT_MEASUREMENT Vxx_mv_knk /end OUT_MEASUREMENT /end FUNCTION
/begin FUNCTION InCbiKnk_Knkdtxx ""
 /begin DEF_CHARACTERISTIC Ctb_n_knk Ctp_n_knk_fac_cyl_0 Ctp_n_knk_fac_cyl_1 Ctp_n_knk_fac_cyl_2 Ctp_n_knk_fac_cyl_3 Ctp_n_knk_ofs_cyl_0 Ctp_n_knk_ofs_cyl_1 Ctp_n_knk_ofs_cyl_2 Ctp_n_knk_ofs_cyl_3 Cbx_knk_ini_req Cxx_decl_knk_fil_fac Cxx_dfdec_knk_oor Cxx_dfdec_knk_shp Cxx_dfinc_knk_oor Cxx_dfinc_knk_shp Cxx_inc_knk_fil_fac Cxx_knk_det_n_thd Cxx_knk_det_prs_thd Cxx_knk_det_tco_thd Cxx_knk_fil_inc Cxx_knk_n_dsb_thd /end DEF_CHARACTERISTIC
 /begin OUT_MEASUREMENT Vxx_knk_ctr_cyl_1 Vxx_knk_ctr_cyl_2 Vxx_knk_ctr_cyl_3 Vxx_knk_ctr_cyl_4 Vbx_fil_knk_noi_cyl_init Vbx_knk_det_cyl_1 Vbx_knk_det_cyl_2 Vbx_knk_det_cyl_3 Vbx_knk_det_cyl_4 Vbx_knk_det_ena Vbx_knk_det_err_cyl Vbx_knk_n_dsb Vsx_knk_sens_vld Vtd_fil_knk_noi_cyl[0] Vtd_fil_knk_noi_cyl[1] Vtd_fil_knk_noi_cyl[2] Vtd_fil_knk_noi_cyl[3] Vtd_knk_det_cyl[0] Vtd_knk_det_cyl[1] Vtd_knk_det_cyl[2] Vtd_knk_det_cyl[3] Vxx_fil_acq_knk_cyl_1 Vxx_fil_acq_knk_cyl_2 Vxx_fil_acq_knk_cyl_3 Vxx_fil_acq_knk_cyl_4 /end OUT_MEASUREMENT
/end FUNCTION
/begin FUNCTION AsMapSpt "" /begin SUB_FUNCTION AsMapSpt_Maprfxx /end SUB_FUNCTION /end FUNCTION
/begin FUNCTION AsMapSpt_Maprfxx "" /begin DEF_CHARACTERISTIC Cxx_map_ref_dz /end DEF_CHARACTERISTIC /begin OUT_MEASUREMENT Vxx_map_ref Vxx_raw_map_ref /end OUT_MEASUREMENT /end FUNCTION
/begin FUNCTION InVfiEsi "" /begin SUB_FUNCTION InVfiEsi_Mngtxcs /end SUB_FUNCTION /end FUNCTION
/begin FUNCTION InVfiEsi_Mngtxcs ""
 /begin OUT_MEASUREMENT Vxx_airb1 Vxx_airb2 Vxx_eng_stop_req_ccu Vxx_eng_stop_req_rgb Vxx_eng_stop_req_ssg /end OUT_MEASUREMENT
/end FUNCTION
/begin FUNCTION InVfiVsi ""
 /begin SUB_FUNCTION InVfiVsi_Mngtxcs InVfiVsi_Dgtdvcs InVfiVsi_Tacelmd InVfiVsi_Dsplvcs InVfiVsi_Lacelmd InVfiVsi_Rwsxxcs InVfiVsi_Tacelcs /end SUB_FUNCTION
/end FUNCTION
/begin FUNCTION InVfiVsi_Mngtxcs "" /begin DEF_CHARACTERISTIC Cbx_vs_vld_bch_mod_ena /end DEF_CHARACTERISTIC /begin OUT_MEASUREMENT Vsx_vs_2_vld Vsx_vs_vld Vxx_vs /end OUT_MEASUREMENT /end FUNCTION
/begin FUNCTION InVfiVsi_Dgtdvcs "" /begin DEF_CHARACTERISTIC Cxx_vh_dist_max_dif /end DEF_CHARACTERISTIC
 /begin OUT_MEASUREMENT Vxx_vh_dist Vbx_ecu_pres Vsx_vh_dist_l_res_vld Vsx_vh_dist_vld Vxx_vh_dist_l_res /end OUT_MEASUREMENT
/end FUNCTION
/begin FUNCTION InVfiVsi_Tacelmd ""
 /begin DEF_CHARACTERISTIC Cxx_h_thd_tra_acel_ok Cxx_l_thd_tra_acel_ok Cxx_rel_err_fil Cxx_rel_err_thd_max Cxx_rwhb Cxx_rwhs_fil Cxx_rwhs_max_tra_acel Cxx_rwhs_min_tra_acel Cxx_tra_acel_mv_fil Cxx_wait_tra_acel_vld /end DEF_CHARACTERISTIC
 /begin OUT_MEASUREMENT Vbx_ini_rel_err_fil Vbx_mdl_tra_acel_ok Vbx_rwhs_ok Vbx_t_end Vsx_mdl_tra_acel_vld Vxx_abs_tra_acel_mv Vxx_diff_rel_err Vxx_mdl_tra_acel Vxx_mdl_tra_acel_clc Vxx_rel_err Vxx_rel_err_mv Vxx_rel_err_mv_dly Vxx_rwhs_diff Vxx_rwhs_sum Vxx_t_wait_tra_acel_vld Vxx_tra_acel_mv /end OUT_MEASUREMENT
/end FUNCTION
/begin FUNCTION InVfiVsi_Dsplvcs "" /begin OUT_MEASUREMENT Vbx_dspl_vs_in_mph Vsx_dspl_vs_vld Vxx_dspl_vs /end OUT_MEASUREMENT /end FUNCTION
/begin FUNCTION InVfiVsi_Lacelmd "" /begin DEF_CHARACTERISTIC Cxx_lg_acel_fil Cxx_vs_tkof_thd /end DEF_CHARACTERISTIC /begin OUT_MEASUREMENT Vxx_lg_acel Vxx_lg_acel_raw /end OUT_MEASUREMENT /end FUNCTION
/begin FUNCTION InVfiVsi_Rwsxxcs ""
 /begin OUT_MEASUREMENT Vsx_lft_rwhs_vld Vsx_rgt_rwhs_vld Vxx_lft_rwhs Vxx_rgt_rwhs /end OUT_MEASUREMENT
/end FUNCTION
/begin FUNCTION InVfiVsi_Tacelcs "" /begin DEF_CHARACTERISTIC Cbx_tra_acel_cfm /end DEF_CHARACTERISTIC /begin OUT_MEASUREMENT Vsx_tra_acel_vld Vxx_tra_acel /end OUT_MEASUREMENT /end FUNCTION
/begin FUNCTION VfEstMng "" /begin OUT_MEASUREMENT Vxx_crsh_det Vxx_crsh_mem /end OUT_MEASUREMENT /begin SUB_FUNCTION VfEstMng_Mngtxxx /end SUB_FUNCTION /end FUNCTION
/begin FUNCTION VfEstMng_Mngtxxx ""
 /begin DEF_CHARACTERISTIC Cbx_rest_aftr_crsh_ena Cxx_eng_stop_req_airb2_lvl1 Cxx_eng_stop_req_airb2_lvl2 Cxx_eng_stop_req_ccu Cxx_eng_stop_req_rgb Cxx_eng_stop_req_ssg Cxx_rest_aftr_crsh_dly /end DEF_CHARACTERISTIC
 /begin OUT_MEASUREMENT Vbx_crsh_lvl1_det Vbx_crsh_lvl2_det Vbx_crsh_lvl2_det_fmt Vbx_eng_stop_srce_dft Vbx_eng_stop_srce_norm_driv Vbx_eng_stop_srce_norm_sys Vbx_eng_stop_srce_secu Vxx_eng_run_ena_airb Vxx_eng_run_ena_ccu Vxx_eng_run_ena_rgb Vxx_eng_run_ena_ssg Vxx_run_eng_ena /end OUT_MEASUREMENT
/end FUNCTION
/begin FUNCTION CbRicCan "" /begin SUB_FUNCTION CbRicCan_Cppwmxx CbRicCan_Cpopenx /end SUB_FUNCTION /end FUNCTION
/begin FUNCTION CbRicCan_Cppwmxx ""
 /begin DEF_CHARACTERISTIC Ctb_map Cmp_prs_n_pwm_cp Cxx_cp_fac_pwm Cxx_cp_flr_min_1 Cxx_cp_flr_min_2 Cxx_cp_hys_n_frq Cxx_cp_n_frq Cxx_cp_pwm_cor_max Cxx_cp_pwm_efv_fac_zero Cxx_cp_pwm_max_1 Cxx_cp_pwm_max_2 Cxx_cp_pwm_max_3 Cxx_cp_pwm_max_4 Cxx_cp_pwm_min_1 Cxx_cp_pwm_min_2 Cxx_cp_pwm_sp1 Cxx_cp_pwm_sp2 Cxx_cp_pwm_sp3 Cxx_cp_pwm_sp4 Cxx_cp_pwm_sp_zero Cxx_cp_pwm_step_1 Cxx_cp_pwm_step_2 Cxx_cp_pwm_step_3 Cxx_cp_pwm_step_4 Cxx_cp_pwm_step_5 /end DEF_CHARACTERISTIC
 /begin OUT_MEASUREMENT Vbx_cp_clc_cdn Vbx_cp_cmd_frq Vxx_cp_pwm Vxx_cp_pwm_appl Vxx_cp_pwm_cmd Vxx_cp_pwm_cor Vxx_cp_pwm_efv_fac Vxx_cp_pwm_fac Vxx_cp_pwm_max Vxx_cp_pwm_min Vxx_cp_pwm_sp Vxx_cp_pwm_sp_cor Vxx_cp_pwm_step Vxx_cp_pwm_step_cor /end OUT_MEASUREMENT
/end FUNCTION
/begin FUNCTION CbRicCan_Cpopenx ""
 /begin DEF_CHARACTERISTIC Ctp_tco_is_l_it_psn Cxx_cp_ad_tco_min_thd Cxx_cp_ad_thd Cxx_cp_is_tco_min_thd Cxx_cp_is_tia_min_thd Cxx_cp_max_ad_dly Cxx_cp_max_dly Cxx_cp_max_prs_thd Cxx_cp_min_ad_dly Cxx_cp_min_dly Cxx_cp_n_thd Cxx_cp_ol_tco_min_thd Cxx_cp_rtn_dly_dec Cxx_cp_stab_dly Cxx_cp_tco_min_thd Cxx_cp_tia_min_thd /end DEF_CHARACTERISTIC
 /begin OUT_MEASUREMENT Vbx_cp_eng_cdn_cl_ena Vbx_cp_eng_cdn_is_ena Vbx_cp_eng_cdn_ol_ena Vbx_cp_eng_cdn_sp_ena Vbx_cp_fct Vbx_cp_fct_ad Vbx_cp_load_ad Vbx_cp_req Vbx_cp_req_ad Vbx_cp_stop_ad Vbx_l_is_it_psn Vsx_cp Vxx_ad_cp_dly Vxx_ad_cp_fct_dly Vxx_cp_dly Vxx_cp_rtn_dly Vxx_mv_cl_ti_fac_cp_dly /end OUT_MEASUREMENT
/end FUNCTION
/begin FUNCTION OuCboIgn "" /begin SUB_FUNCTION OuCboIgn_Dwellxx OuCboIgn_Igncutx OuCboIgn_Dgigcxx /end SUB_FUNCTION /end FUNCTION
/begin FUNCTION OuCboIgn_Dwellxx ""
 /begin DEF_CHARACTERISTIC Cxx_igc_stt_dly Cxx_igc_stt_tco_thd Cxx_pap_dwl Cxx_td_stab_min Cxx_td_tra_auth_max Cxx_tra_dwl /end DEF_CHARACTERISTIC
 /begin OUT_MEASUREMENT Vbx_boost_td Vbx_igc_stt_ena Vbx_trs_td Vxx_ctr_tdc_aftr_trs Vxx_igc_stt_td Vxx_td_stab_min Vxx_td_tra_max /end OUT_MEASUREMENT
/end FUNCTION
/begin FUNCTION OuCboIgn_Igncutx "" /begin DEF_CHARACTERISTIC Cbx_mis_bch_mod Cxx_mis_bch_mis_rat /end DEF_CHARACTERISTIC
 /begin OUT_MEASUREMENT Vbx_ign_cut_cyl1 Vbx_ign_cut_cyl2 Vbx_ign_cut_cyl3 Vbx_ign_cut_cyl4 Vbx_mis_bch_cyl_0 Vbx_mis_bch_cyl_1 Vbx_mis_bch_cyl_2 Vbx_mis_bch_cyl_3 Vbx_mis_bch_igc_cut_req /end OUT_MEASUREMENT
/end FUNCTION
/begin FUNCTION OuCboIgn_Dgigcxx ""
 /begin DEF_CHARACTERISTIC Cxx_dfdec_igc_1_oc Cxx_dfdec_igc_1_scg Cxx_dfdec_igc_1_scw Cxx_dfdec_igc_2_oc Cxx_dfdec_igc_2_scg Cxx_dfdec_igc_2_scw Cxx_dfdec_igc_3_oc Cxx_dfdec_igc_3_scg Cxx_dfdec_igc_3_scw Cxx_dfdec_igc_4_oc Cxx_dfdec_igc_4_scg Cxx_dfdec_igc_4_scw Cxx_dfinc_igc_1_oc Cxx_dfinc_igc_1_scg Cxx_dfinc_igc_1_scw Cxx_dfinc_igc_2_oc Cxx_dfinc_igc_2_scg Cxx_dfinc_igc_2_scw Cxx_dfinc_igc_3_oc Cxx_dfinc_igc_3_scg Cxx_dfinc_igc_3_scw Cxx_dfinc_igc_4_oc Cxx_dfinc_igc_4_scg Cxx_dfinc_igc_4_scw /end DEF_CHARACTERISTIC
 /begin OUT_MEASUREMENT Vsx_igc1_vld Vsx_igc2_vld Vsx_igc3_vld Vsx_igc4_vld Vsx_igc_vld /end OUT_MEASUREMENT
/end FUNCTION
/begin FUNCTION VfAcoMng ""
 /begin SUB_FUNCTION VfAcoMng_Acfanxx VfAcoMng_Compxxx VfAcoMng_Noacvxx VfAcoMng_Ptcxxxx VfAcoMng_Schxxxx /end SUB_FUNCTION
/end FUNCTION
/begin FUNCTION VfAcoMng_Acfanxx ""
 /begin DEF_CHARACTERISTIC Cxx_ac_mdf_prs_hys Cxx_ac_mdf_prs_thd1 Cxx_ac_mdf_prs_thd2 Cxx_ac_mdf_prs_thd3 Cxx_ac_mdf_secu_prs_hys Cxx_ac_mdf_secu_prs_thd Cxx_ac_mdf_vs_hys Cxx_ac_mdf_vs_thd1 Cxx_ac_mdf_vs_thd2 Cxx_ac_mdf_vs_thd3 Cxx_ac_mdf_vs_thd4 /end DEF_CHARACTERISTIC
 /begin OUT_MEASUREMENT Vbx_ac_mdf1_req_int Vbx_ac_mdf2_req_int Vxx_ac_prs_lvl /end OUT_MEASUREMENT
/end FUNCTION
/begin FUNCTION VfAcoMng_Compxxx ""
 /begin DEF_CHARACTERISTIC Ctb_ac_dclu_dly_n Ctp_ac_dclu_dly Cxx_ac_bfr_clu_dly Cxx_ac_clu_dly Cxx_ac_ext_clu_dly Cxx_ac_ext_dclu_dly Cxx_ac_rly_prot_dly /end DEF_CHARACTERISTIC
 /begin OUT_MEASUREMENT Vbx_ac_clu_dsb Vbx_ac_clu_ena Vbx_ac_dclu_dsb Vbx_ac_dsb Vsx_ac_cmd Vsx_acr_stt Vxx_ac_cmd_dly Vxx_ac_stt_dly /end OUT_MEASUREMENT
/end FUNCTION
/begin FUNCTION VfAcoMng_Noacvxx ""
 /begin DEF_CHARACTERISTIC Cbx_ac_cold_loop_in_ecm Cxx_ac_vs_nok_dly Cxx_h_prs_ac_dsb_dly Cxx_h_prs_ac_dsb_hys Cxx_h_prs_ac_dsb_thd Cxx_l_prs_ac_dsb_hys Cxx_l_prs_ac_dsb_thd Cxx_n_ac_clu_dsb_thd Cxx_n_ac_dsb_hys Cxx_n_ac_dsb_thd Cxx_prmt_n_ac_dsb_dly Cxx_prmt_n_ac_dsb_hys Cxx_prmt_n_ac_dsb_thd Cxx_vs_ac_clu_dsb_thd /end DEF_CHARACTERISTIC
 /begin OUT_MEASUREMENT Vbx_ac_secu_dsb Vbx_h_prs_ac_dsb Vbx_l_prs_ac_dsb Vbx_n_ac_dsb Vbx_n_vs_ac_clu_dsb Vbx_prmt_n_ac_dsb Vxx_ac_vs Vxx_l_prs_ac_diag /end OUT_MEASUREMENT
/end FUNCTION
/begin FUNCTION VfAcoMng_Ptcxxxx ""
 /begin OUT_MEASUREMENT Vbx_ptc_comp_cfa Vbx_ptc_cut_fil Vbx_ptc_frz_fil Vbx_ptc_heat_sp_frz_req Vxx_ptc_lvl_cmd Vxx_ptc_th_efy_lvl_req /end OUT_MEASUREMENT
/end FUNCTION
/begin FUNCTION VfAcoMng_Schxxxx "" /begin DEF_CHARACTERISTIC Cbx_wf_ptc_abst_pres_cfm /end DEF_CHARACTERISTIC /begin OUT_MEASUREMENT Vbx_wf_ptc_cfm /end OUT_MEASUREMENT /end FUNCTION
/begin FUNCTION SmIsrSpt ""
 /begin OUT_MEASUREMENT Vxx_acs_acel_is Vxx_el_csm_ctr Vbx_acs_acel_is_ena Vxx_acs_acel_is_max_vs /end OUT_MEASUREMENT
 /begin SUB_FUNCTION SmIsrSpt_Alcoxxx SmIsrSpt_Dgissxx SmIsrSpt_Mcissxx SmIsrSpt_Elissxx SmIsrSpt_Dynssxx SmIsrSpt_Atissxx SmIsrSpt_Ptissxx SmIsrSpt_Ntkofxx SmIsrSpt_Arissxx SmIsrSpt_Cfdgiss SmIsrSpt_Istatun /end SUB_FUNCTION
/end FUNCTION
/begin FUNCTION SmIsrSpt_Alcoxxx ""
 /begin DEF_CHARACTERISTIC Cmp_tco_amp_min_is_n_alco Ctp_cold_tdc_pn_is_n_ofs_alco Ctp_tdc_pn_tco_is_n_ofs_alco /end DEF_CHARACTERISTIC
 /begin OUT_MEASUREMENT Vxx_cold_tdc_pn_is_n_ofs_alco Vxx_is_fuel_typ_rat_tra Vxx_tco_amp_min_is_n_alco Vxx_tdc_pn_tco_is_n_ofs_alco /end OUT_MEASUREMENT
/end FUNCTION
/begin FUNCTION SmIsrSpt_Dgissxx ""
 /begin DEF_CHARACTERISTIC Ctp_toil_is_n_ofs Cxx_inj_vld_min_is_n Cxx_n_vld_min_is_n Cxx_prs_dft_min_is_n Cxx_toil_is_n_ofs /end DEF_CHARACTERISTIC
 /begin OUT_MEASUREMENT Vbx_diag_sta_ndec_abrt Vbx_diag_sta_ninc_abrt Vxx_diag_vvtc_min_is_n Vxx_inj_vld_min_is_n Vxx_moni_min_is_n Vxx_n_vld_min_is_n Vxx_prs_dft_min_is_n Vxx_toil_is_n_ofs /end OUT_MEASUREMENT
/end FUNCTION
/begin FUNCTION SmIsrSpt_Mcissxx ""
 /begin DEF_CHARACTERISTIC Ctb_ac_forb_is_n Ctp_ac_forb_is_n Ctp_agb_ac_min_is_n Ctp_pn_ac_min_is_n Cbx_acs_acel_is_acel_pdl_cfm Cbx_acs_acel_is_brk_cfm Cbx_acs_acel_is_coup_cfm Cxx_ac_acel_is_dly Cxx_acs_acel_is_thd Cxx_agb_pwst_min_is_n Cxx_pn_pwst_min_is_n Cxx_pwst_is_acel_rtn_dly /end DEF_CHARACTERISTIC
 /begin OUT_MEASUREMENT Vbx_acs_acel_is_acel_pdl_cdn Vbx_acs_acel_is_brk_cdn Vbx_acs_acel_is_fail Vbx_acs_acel_is_vs_cdn Vxx_ac_min_is_n Vxx_acs_min_is_n Vxx_eng_ac_min_is_n Vxx_pwst_min_is_n /end OUT_MEASUREMENT
/end FUNCTION
/begin FUNCTION SmIsrSpt_Elissxx ""
 /begin DEF_CHARACTERISTIC Ctb_el_csm_n_sp_ofs Ctp_el_csm_n_sp_ofs Cxx_agb_wind_min_is_n Cxx_el_bk_wind_is_n Cxx_el_csm_alt_cut_dly Cxx_el_csm_clc_dly Cxx_el_csm_clc_neg_fac Cxx_el_csm_clc_neut_vb Cxx_el_csm_clc_pos_fac Cxx_el_wind_tco Cxx_ptc_min_is_n Cxx_thpl_min_is_n /end DEF_CHARACTERISTIC
 /begin OUT_MEASUREMENT Vbx_el_csm_clc_ena Vxx_el_bk_wind_min_is_n Vxx_el_wind_min_is_n Vxx_min_vb_is_ofs Vxx_ptc_min_is_n Vxx_thpl_min_is_n /end OUT_MEASUREMENT
/end FUNCTION
/begin FUNCTION SmIsrSpt_Dynssxx ""
 /begin DEF_CHARACTERISTIC Ctp_is_ast_ofs Ctp_max_ftc_dyn_is_sp Cxx_fac_n_drv_ftc_dyn Cxx_is_out_dyn_ofs Cxx_k_ftc_dyn_is_sp Cxx_min_ftc_dyn_is_sp /end DEF_CHARACTERISTIC
 /begin OUT_MEASUREMENT Vbx_dyn_is_n_sp_rst Vxx_dyn_is_n_sp Vxx_ftc_dyn Vxx_ftc_dyn_n_drv /end OUT_MEASUREMENT
/end FUNCTION
/begin FUNCTION SmIsrSpt_Atissxx ""
 /begin DEF_CHARACTERISTIC Ctp_agb_tco_min_is_n Ctp_drag_tco_min_is_n Cxx_agb_min_is_n Cxx_is_run_vh_min_crp Cxx_tco_agb_df_min_is_n /end DEF_CHARACTERISTIC
 /begin OUT_MEASUREMENT Vbx_agb_is_clc_ena Vbx_is_run_vh_min_crp Vxx_agb_min_is_n Vxx_tco_agb_min_is_n /end OUT_MEASUREMENT
/end FUNCTION
/end MODULE
/end PROJECT
