ASAP2_VERSION 1 41
/begin PROJECT RD8 "_default_ProjectLongIdentifier"
/begin HEADER "_default_HeaderComment" PROJECT_NO RD9 /end HEADER
/begin MODULE _default_ModuleName "_default_ModuleLongIdentifier"
/begin MOD_COMMON "_default_ModCommonComment" DEPOSIT ABSOLUTE BYTE_ORDER MSB_LAST ALIGNMENT_BYTE 1 ALIGNMENT_WORD 2 ALIGNMENT_LONG 2 ALIGNMENT_FLOAT32_IEEE 2 ALIGNMENT_FLOAT64_IEEE 4 /end MOD_COMMON
/begin AXIS_PTS Ctb_eal "16 breakpoint table for Engine air load" 0xa002b7f4 Vxx_eal _REC_A2AXS_20_u2 3.99993896484375 _CNV_A_R_LINEAR_____53_CM 16 0. 3.99993896484375 FORMAT "%10.8" /end AXIS_PTS
/begin AXIS_PTS Ctb_sta_tco "Coolant temperature breakpoints for starting set point tables" 0xa002d498 Vxx_tco _REC_A2AXS_20_u2 240. _CNV_A_R_LINEAR_____110_CM 8 -40. 200. FORMAT "%5.1" /end AXIS_PTS
/begin AXIS_PTS Ctb_tco "16 engine coolant temperature breakpoints" 0xa002d4ac Vxx_tco _REC_A2AXS_20_u2 240. _CNV_A_R_LINEAR_____110_CM 16 -40. 200. FORMAT "%5.1" /end AXIS_PTS
/begin AXIS_PTS Ctb_prs "" 0xa002c9e8 Vxx_map _REC_A2AXS_20_u2 20000. _CNV_A_R_LINEAR_____115_CM 17 0. 20000. FORMAT "%5.0" /end AXIS_PTS
/begin AXIS_PTS Ctb_eng_amp "atmospheric pressure breakpoint of full load torque limitation." 0xa00357a8 Vxx_amp _REC_A2AXS_20_u2 20000. _CNV_A_R_LINEAR_____115_CM 6 0. 20000. FORMAT "%5.0" /end AXIS_PTS
/begin AXIS_PTS Ctb_n "20 programmable engine speed breakpoints map" 0xa002db74 Vxx_n _REC_A2AXS_20_u2 16383.75 _CNV_A_R_ENSD_LINEA_22_CM 20 0. 16383.75 FORMAT "%8.2" /end AXIS_PTS
/begin AXIS_PTS Ctb_cold_is_cata_wup_ctr "Breakpoints use for catalyst warm-up sequences with cold start conditions" 0xa0034d8c Vxx_cata_wup_ctr _REC_A2AXS_20_u2 65535. _CNV_A_R_LINEAR_____101_CM 17 0. 65535. FORMAT "%5.0" /end AXIS_PTS
/begin AXIS_PTS Ctb_is_cata_wup_ctr "Breakpoints use for catalyst warm-up sequences without cold start conditions" 0xa0034db0 Vxx_cata_wup_ctr _REC_A2AXS_20_u2 65535. _CNV_A_R_LINEAR_____101_CM 17 0. 65535. FORMAT "%5.0" /end AXIS_PTS
/begin CHARACTERISTIC Ctp_cold_tdc_agb_is_n_ofs "Idle speed setpoint offset during catalyst warm-up sequences with cold start conditions, under drive mode of the AT" CURVE 0xa0034dd4 _REC_A1CUR_20_u2_u2 16383.75 _CNV_A_R_ENSD_LINEA_22_CM 0. 16383.75 FORMAT "%8.2"
 /begin AXIS_DESCR COM_AXIS Vxx_cata_wup_ctr _CNV_A_R_LINEAR_____101_CM 17 0. 65535. FORMAT "%5.0" AXIS_PTS_REF Ctb_cold_is_cata_wup_ctr /end AXIS_DESCR
/end CHARACTERISTIC
/begin CHARACTERISTIC Ctp_cold_tdc_pn_is_n_ofs "Idle speed setpoint offset during catalyst warm-up sequences with cold start conditions, under neutral mode of the AT (or manual gearbox)" CURVE 0xa0034df8 _REC_A1CUR_20_u2_u2 16383.75 _CNV_A_R_ENSD_LINEA_22_CM 0. 16383.75 FORMAT "%8.2"
 /begin AXIS_DESCR COM_AXIS Vxx_cata_wup_ctr _CNV_A_R_LINEAR_____101_CM 17 0. 65535. FORMAT "%5.0" AXIS_PTS_REF Ctb_cold_is_cata_wup_ctr /end AXIS_DESCR
/end CHARACTERISTIC
/begin CHARACTERISTIC Ctp_tdc_agb_tco_is_n_ofs "Idle speed setpoint offset during catalyst warm-up phases without cold start conditions, under drive mode of the AT" CURVE 0xa0034e1c _REC_A1CUR_20_u2_u2 16383.75 _CNV_A_R_ENSD_LINEA_22_CM 0. 16383.75 FORMAT "%8.2"
 /begin AXIS_DESCR COM_AXIS Vxx_cata_wup_ctr _CNV_A_R_LINEAR_____101_CM 17 0. 65535. FORMAT "%5.0" AXIS_PTS_REF Ctb_is_cata_wup_ctr /end AXIS_DESCR
/end CHARACTERISTIC
/begin CHARACTERISTIC Ctp_tdc_pn_tco_is_n_ofs "Idle speed setpoint offset during catalyst warm-up phases without cold start conditions, under neutral mode of the AT (or manual gearbox)" CURVE 0xa0034e40 _REC_A1CUR_20_u2_u2 16383.75 _CNV_A_R_ENSD_LINEA_22_CM 0. 16383.75 FORMAT "%8.2"
 /begin AXIS_DESCR COM_AXIS Vxx_cata_wup_ctr _CNV_A_R_LINEAR_____101_CM 17 0. 65535. FORMAT "%5.0" AXIS_PTS_REF Ctb_is_cata_wup_ctr /end AXIS_DESCR
/end CHARACTERISTIC
/begin MEASUREMENT Vbx_cata_wup_cdn_ena "Conditions on MEA phases are valid" UBYTE _CNV_S_2_RANGE______3_CM 1 0. 0. 1. ECU_ADDRESS 0xd0007caf BIT_MASK 0x1 /end MEASUREMENT
/begin MEASUREMENT Vbx_cata_wup_dri "Drive state with AGB or CVT (if RGB or manual gearbox >= 0)" UBYTE _CNV_S_2_RANGE______3_CM 1 0. 0. 1. ECU_ADDRESS 0xd0007cb0 BIT_MASK 0x1 /end MEASUREMENT
/begin MEASUREMENT Vxx_cold_pn_tco_is_n_ofs "Idle speed setpoint during compartment heating phase with cold start conditions, under neutral mode of the AT (or manual gearbox)" UWORD _CNV_A_R_ENSD_LINEA_22_CM 1 0. 0. 16383.75 ECU_ADDRESS 0xd000606c FORMAT "%8.2" /end MEASUREMENT
/begin MEASUREMENT Vxx_is_n_ofs_cold "Idle speed setpoint during cold start conditions phase, under neutral mode of the AT (or manual gearbox)" UWORD _CNV_A_R_ENSD_LINEA_22_CM 1 0. 0. 16383.75 ECU_ADDRESS 0xd000606e FORMAT "%8.2" /end MEASUREMENT
/begin MEASUREMENT Vxx_pft_min_is_n "Particule filter idle speed setpoint" UWORD _CNV_A_R_ENSD_LINEA_22_CM 1 0. 0. 16383.75 ECU_ADDRESS 0xd0006070 FORMAT "%8.2" /end MEASUREMENT
/begin MEASUREMENT Vxx_pn_tco_is_n_ofs "Idle speed setpoint during compartment heating phase without cold start conditions, under neutral mode of the AT (or manual gearbox)" UWORD _CNV_A_R_ENSD_LINEA_22_CM 1 0. 0. 16383.75 ECU_ADDRESS 0xd0006072 FORMAT "%8.2" /end MEASUREMENT
/begin MEASUREMENT Vxx_tco_is_n_ofs "Engine warm-up idle speed setpoint offset" UWORD _CNV_A_R_ENSD_LINEA_22_CM 1 0. 0. 16383.75 ECU_ADDRESS 0xd0006074 FORMAT "%8.2" /end MEASUREMENT
/begin MEASUREMENT Vxx_tco_neut_raw_val "Intermediary calcul of Vxx_tco_is_n_ofs under neutral mode of the AT (or manual gearbox)" UWORD _CNV_A_R_ENSD_LINEA_22_CM 1 0. 0. 16383.75 ECU_ADDRESS 0xd0006076 FORMAT "%8.2" /end MEASUREMENT
/begin MEASUREMENT Vxx_tco_no_neut_raw_val "Intermediary calcul of Vxx_tco_is_n_ofs under drive mode of the AT" UWORD _CNV_A_R_ENSD_LINEA_22_CM 1 0. 0. 16383.75 ECU_ADDRESS 0xd0006078 FORMAT "%8.2" /end MEASUREMENT
/begin MEASUREMENT Vxx_tdc_pn_tco_is_n_ofs "Idle speed setpoint offset during catalyst warm-up phases without cold start conditions, under neutral mode of the AT (or manual gearbox))" UWORD _CNV_A_R_ENSD_LINEA_22_CM 1 0. 0. 16383.75 ECU_ADDRESS 0xd000607a FORMAT "%8.2" /end MEASUREMENT
/begin CHARACTERISTIC Cxx_agb_tco_is_n_ofs "Idle speed setpoint during compartment heating phase without cold start conditions, under drive mode of the AT" VALUE 0xa0021e4e _REC_S1VAL_20_u2 16383.75 _CNV_A_R_ENSD_LINEA_22_CM 0. 16383.75 FORMAT "%8.2" /end CHARACTERISTIC
/begin CHARACTERISTIC Cxx_cold_agb "Idle speed setpoint during cold start conditions phase, under drive mode of the AT" VALUE 0xa0021e50 _REC_S1VAL_20_u2 16383.75 _CNV_A_R_ENSD_LINEA_22_CM 0. 16383.75 FORMAT "%8.2" /end CHARACTERISTIC
/begin CHARACTERISTIC Cxx_cold_agb_tco_is_n_ofs "Idle speed setpoint during compartment heating phase with cold start conditions, under drive mode of the AT" VALUE 0xa0021e52 _REC_S1VAL_20_u2 16383.75 _CNV_A_R_ENSD_LINEA_22_CM 0. 16383.75 FORMAT "%8.2" /end CHARACTERISTIC
/begin CHARACTERISTIC Cxx_cold_pn "Idle speed setpoint during cold start conditions phase, under neutral mode of the AT (or manual gearbox) " VALUE 0xa0021e54 _REC_S1VAL_20_u2 16383.75 _CNV_A_R_ENSD_LINEA_22_CM 0. 16383.75 FORMAT "%8.2" /end CHARACTERISTIC
/begin CHARACTERISTIC Cxx_cold_pn_alco "Idle speed setpoint during cold start conditions phase, under neutral mode of the AT (or manual gearbox)" VALUE 0xa0021e56 _REC_S1VAL_20_u2 16383.75 _CNV_A_R_ENSD_LINEA_22_CM 0. 16383.75 FORMAT "%8.2" /end CHARACTERISTIC
/begin CHARACTERISTIC Cxx_cold_pn_tco_is_n_ofs "Idle speed setpoint during compartment heating phase with cold start conditions, under neutral mode of the AT (or manual gearbox)" VALUE 0xa0021e58 _REC_S1VAL_20_u2 16383.75 _CNV_A_R_ENSD_LINEA_22_CM 0. 16383.75 FORMAT "%8.2" /end CHARACTERISTIC
/begin CHARACTERISTIC Cxx_cold_pn_tco_is_n_ofs_alco "Idle speed setpoint during compartment heating phase with cold start conditions, under neutral mode of the AT (or manual gearbox)" VALUE 0xa0021e5a _REC_S1VAL_20_u2 16383.75 _CNV_A_R_ENSD_LINEA_22_CM 0. 16383.75 FORMAT "%8.2" /end CHARACTERISTIC
/begin CHARACTERISTIC Cxx_cold_sta_tco "Temperature threshold wich determines cold start conditions for catalyst warm-up phases" VALUE 0xa0021e5c _REC_S1VAL_20_u2 240. _CNV_A_R_LINEAR_____110_CM -40. 200. FORMAT "%5.1" /end CHARACTERISTIC
/begin CHARACTERISTIC Cxx_pn_tco_is_n_ofs "Idle speed setpoint during compartment heating phase without cold start conditions, under neutral mode of the AT (or manual gearbox)" VALUE 0xa0021e5e _REC_S1VAL_20_u2 16383.75 _CNV_A_R_ENSD_LINEA_22_CM 0. 16383.75 FORMAT "%8.2" /end CHARACTERISTIC
/begin CHARACTERISTIC Cxx_pn_tco_is_n_ofs_alco "Idle speed setpoint during compartment heating phase without cold start conditions, under neutral mode of the AT (or manual gearbox)" VALUE 0xa0021e60 _REC_S1VAL_20_u2 16383.75 _CNV_A_R_ENSD_LINEA_22_CM 0. 16383.75 FORMAT "%8.2" /end CHARACTERISTIC
/begin CHARACTERISTIC Cmp_tco_amp_min_is_n "Idle speed setpoint according to the engine coolant temperature and atmospheric pressure" MAP 0xa0034b68 _REC_A1MAP_20_u2_u2_u2 16383.75 _CNV_A_R_ENSD_LINEA_22_CM 0. 16383.75 FORMAT "%8.2"
 /begin AXIS_DESCR COM_AXIS Vxx_tco _CNV_A_R_LINEAR_____110_CM 16 -40. 200. FORMAT "%5.1" AXIS_PTS_REF Ctb_tco /end AXIS_DESCR
 /begin AXIS_DESCR COM_AXIS Vxx_amp _CNV_A_R_LINEAR_____115_CM 6 0. 20000. FORMAT "%5.0" AXIS_PTS_REF Ctb_eng_amp /end AXIS_DESCR
/end CHARACTERISTIC
/begin CHARACTERISTIC Ctd_gear_run_vh_min_is_n "Running vehicule index table based on the gear engaged" CURVE 0xa0034c28 _REC_A1CUR_20_u2_u1 16383.75 _CNV_A_R_ENSD_LINEA_22_CM 0. 16383.75 FORMAT "%8.2"
 /begin AXIS_DESCR COM_AXIS Vxx_gear _CNV_A_R_LINEAR_____145_CM 8 -1. 6. READ_ONLY FORMAT "%2.0" AXIS_PTS_REF Ntb_gear /end AXIS_DESCR
/end CHARACTERISTIC
/begin MEASUREMENT Vtx_dec_slop_itl_tb[0] "Decrease slope internal list which contains all the decrease slope setpoints." UWORD _CNV_A_R_LINEAR_____395_CM 1 0. -65535. 0. ECU_ADDRESS 0xd0005fdc FORMAT "%4.0" /end MEASUREMENT
/begin MEASUREMENT Vtx_dec_slop_itl_tb[1] "Decrease slope internal list which contains all the decrease slope setpoints." UWORD _CNV_A_R_LINEAR_____395_CM 1 0. -65535. 0. ECU_ADDRESS 0xd0005fde FORMAT "%4.0" /end MEASUREMENT
/begin MEASUREMENT Vtx_dec_slop_itl_tb[2] "Decrease slope internal list which contains all the decrease slope setpoints." UWORD _CNV_A_R_LINEAR_____395_CM 1 0. -65535. 0. ECU_ADDRESS 0xd0005fe0 FORMAT "%4.0" /end MEASUREMENT
/begin MEASUREMENT Vtx_dec_slop_itl_tb[3] "Decrease slope internal list which contains all the decrease slope setpoints." UWORD _CNV_A_R_LINEAR_____395_CM 1 0. -65535. 0. ECU_ADDRESS 0xd0005fe2 FORMAT "%4.0" /end MEASUREMENT
/begin MEASUREMENT Vtx_dec_slop_itl_tb[4] "Decrease slope internal list which contains all the decrease slope setpoints." UWORD _CNV_A_R_LINEAR_____395_CM 1 0. -65535. 0. ECU_ADDRESS 0xd0005fe4 FORMAT "%4.0" /end MEASUREMENT
/begin MEASUREMENT Vtx_dec_slop_itl_tb[5] "Decrease slope internal list which contains all the decrease slope setpoints." UWORD _CNV_A_R_LINEAR_____395_CM 1 0. -65535. 0. ECU_ADDRESS 0xd0005fe6 FORMAT "%4.0" /end MEASUREMENT
/begin MEASUREMENT Vtx_dec_slop_itl_tb[6] "Decrease slope internal list which contains all the decrease slope setpoints." UWORD _CNV_A_R_LINEAR_____395_CM 1 0. -65535. 0. ECU_ADDRESS 0xd0005fe8 FORMAT "%4.0" /end MEASUREMENT
/begin MEASUREMENT Vtx_dec_slop_itl_tb[7] "Decrease slope internal list which contains all the decrease slope setpoints." UWORD _CNV_A_R_LINEAR_____395_CM 1 0. -65535. 0. ECU_ADDRESS 0xd0005fea FORMAT "%4.0" /end MEASUREMENT
/begin MEASUREMENT Vtx_dec_slop_itl_tb[8] "Decrease slope internal list which contains all the decrease slope setpoints." UWORD _CNV_A_R_LINEAR_____395_CM 1 0. -65535. 0. ECU_ADDRESS 0xd0005fec FORMAT "%4.0" /end MEASUREMENT
/begin MEASUREMENT Vtx_dec_slop_itl_tb[9] "Decrease slope internal list which contains all the decrease slope setpoints." UWORD _CNV_A_R_LINEAR_____395_CM 1 0. -65535. 0. ECU_ADDRESS 0xd0005fee FORMAT "%4.0" /end MEASUREMENT
/begin MEASUREMENT Vtx_dec_slop_itl_tb[10] "Decrease slope internal list which contains all the decrease slope setpoints." UWORD _CNV_A_R_LINEAR_____395_CM 1 0. -65535. 0. ECU_ADDRESS 0xd0005ff0 FORMAT "%4.0" /end MEASUREMENT
/begin MEASUREMENT Vtx_dec_slop_itl_tb[11] "Decrease slope internal list which contains all the decrease slope setpoints." UWORD _CNV_A_R_LINEAR_____395_CM 1 0. -65535. 0. ECU_ADDRESS 0xd0005ff2 FORMAT "%4.0" /end MEASUREMENT
/begin MEASUREMENT Vtx_dec_slop_itl_tb[12] "Decrease slope internal list which contains all the decrease slope setpoints." UWORD _CNV_A_R_LINEAR_____395_CM 1 0. -65535. 0. ECU_ADDRESS 0xd0005ff4 FORMAT "%4.0" /end MEASUREMENT
/begin MEASUREMENT Vtx_dec_slop_itl_tb[13] "Decrease slope internal list which contains all the decrease slope setpoints." UWORD _CNV_A_R_LINEAR_____395_CM 1 0. -65535. 0. ECU_ADDRESS 0xd0005ff6 FORMAT "%4.0" /end MEASUREMENT
/begin MEASUREMENT Vtx_dec_slop_itl_tb[14] "Decrease slope internal list which contains all the decrease slope setpoints." UWORD _CNV_A_R_LINEAR_____395_CM 1 0. -65535. 0. ECU_ADDRESS 0xd0005ff8 FORMAT "%4.0" /end MEASUREMENT
/begin MEASUREMENT Vtx_inc_slop_itl_tb[0] "Increase slope internal list which contains all the increase slope setpoints." UWORD _CNV_A_R_LINEAR_____21_CM 1 0. 0. 65535. ECU_ADDRESS 0xd0005ffc FORMAT "%4.0" /end MEASUREMENT
/begin MEASUREMENT Vtx_inc_slop_itl_tb[1] "Increase slope internal list which contains all the increase slope setpoints." UWORD _CNV_A_R_LINEAR_____21_CM 1 0. 0. 65535. ECU_ADDRESS 0xd0005ffe FORMAT "%4.0" /end MEASUREMENT
/begin MEASUREMENT Vtx_inc_slop_itl_tb[2] "Increase slope internal list which contains all the increase slope setpoints." UWORD _CNV_A_R_LINEAR_____21_CM 1 0. 0. 65535. ECU_ADDRESS 0xd0006000 FORMAT "%4.0" /end MEASUREMENT
/begin MEASUREMENT Vtx_inc_slop_itl_tb[3] "Increase slope internal list which contains all the increase slope setpoints." UWORD _CNV_A_R_LINEAR_____21_CM 1 0. 0. 65535. ECU_ADDRESS 0xd0006002 FORMAT "%4.0" /end MEASUREMENT
/begin MEASUREMENT Vtx_inc_slop_itl_tb[4] "Increase slope internal list which contains all the increase slope setpoints." UWORD _CNV_A_R_LINEAR_____21_CM 1 0. 0. 65535. ECU_ADDRESS 0xd0006004 FORMAT "%4.0" /end MEASUREMENT
/begin MEASUREMENT Vtx_inc_slop_itl_tb[5] "Increase slope internal list which contains all the increase slope setpoints." UWORD _CNV_A_R_LINEAR_____21_CM 1 0. 0. 65535. ECU_ADDRESS 0xd0006006 FORMAT "%4.0" /end MEASUREMENT
/begin MEASUREMENT Vtx_inc_slop_itl_tb[6] "Increase slope internal list which contains all the increase slope setpoints." UWORD _CNV_A_R_LINEAR_____21_CM 1 0. 0. 65535. ECU_ADDRESS 0xd0006008 FORMAT "%4.0" /end MEASUREMENT
/begin MEASUREMENT Vtx_inc_slop_itl_tb[7] "Increase slope internal list which contains all the increase slope setpoints." UWORD _CNV_A_R_LINEAR_____21_CM 1 0. 0. 65535. ECU_ADDRESS 0xd000600a FORMAT "%4.0" /end MEASUREMENT
/begin MEASUREMENT Vtx_inc_slop_itl_tb[8] "Increase slope internal list which contains all the increase slope setpoints." UWORD _CNV_A_R_LINEAR_____21_CM 1 0. 0. 65535. ECU_ADDRESS 0xd000600c FORMAT "%4.0" /end MEASUREMENT
/begin MEASUREMENT Vtx_inc_slop_itl_tb[9] "Increase slope internal list which contains all the increase slope setpoints." UWORD _CNV_A_R_LINEAR_____21_CM 1 0. 0. 65535. ECU_ADDRESS 0xd000600e FORMAT "%4.0" /end MEASUREMENT
/begin MEASUREMENT Vtx_inc_slop_itl_tb[10] "Increase slope internal list which contains all the increase slope setpoints." UWORD _CNV_A_R_LINEAR_____21_CM 1 0. 0. 65535. ECU_ADDRESS 0xd0006010 FORMAT "%4.0" /end MEASUREMENT
/begin MEASUREMENT Vtx_inc_slop_itl_tb[11] "Increase slope internal list which contains all the increase slope setpoints." UWORD _CNV_A_R_LINEAR_____21_CM 1 0. 0. 65535. ECU_ADDRESS 0xd0006012 FORMAT "%4.0" /end MEASUREMENT
/begin MEASUREMENT Vtx_inc_slop_itl_tb[12] "Increase slope internal list which contains all the increase slope setpoints." UWORD _CNV_A_R_LINEAR_____21_CM 1 0. 0. 65535. ECU_ADDRESS 0xd0006014 FORMAT "%4.0" /end MEASUREMENT
/begin MEASUREMENT Vtx_inc_slop_itl_tb[13] "Increase slope internal list which contains all the increase slope setpoints." UWORD _CNV_A_R_LINEAR_____21_CM 1 0. 0. 65535. ECU_ADDRESS 0xd0006016 FORMAT "%4.0" /end MEASUREMENT
/begin MEASUREMENT Vtx_inc_slop_itl_tb[14] "Increase slope internal list which contains all the increase slope setpoints." UWORD _CNV_A_R_LINEAR_____21_CM 1 0. 0. 65535. ECU_ADDRESS 0xd0006018 FORMAT "%4.0" /end MEASUREMENT
/begin MEASUREMENT Vtx_is_sp_itl_tb[0] "Idle speed internal list which contains all the idle speed setpoints." UWORD _CNV_A_R_ENSD_LINEA_22_CM 1 0. 0. 16383.75 ECU_ADDRESS 0xd000601c FORMAT "%8.2" /end MEASUREMENT
/begin MEASUREMENT Vtx_is_sp_itl_tb[1] "Idle speed internal list which contains all the idle speed setpoints." UWORD _CNV_A_R_ENSD_LINEA_22_CM 1 0. 0. 16383.75 ECU_ADDRESS 0xd000601e FORMAT "%8.2" /end MEASUREMENT
/begin MEASUREMENT Vtx_is_sp_itl_tb[2] "Idle speed internal list which contains all the idle speed setpoints." UWORD _CNV_A_R_ENSD_LINEA_22_CM 1 0. 0. 16383.75 ECU_ADDRESS 0xd0006020 FORMAT "%8.2" /end MEASUREMENT
/begin MEASUREMENT Vtx_is_sp_itl_tb[3] "Idle speed internal list which contains all the idle speed setpoints." UWORD _CNV_A_R_ENSD_LINEA_22_CM 1 0. 0. 16383.75 ECU_ADDRESS 0xd0006022 FORMAT "%8.2" /end MEASUREMENT
/begin MEASUREMENT Vtx_is_sp_itl_tb[4] "Idle speed internal list which contains all the idle speed setpoints." UWORD _CNV_A_R_ENSD_LINEA_22_CM 1 0. 0. 16383.75 ECU_ADDRESS 0xd0006024 FORMAT "%8.2" /end MEASUREMENT
/begin MEASUREMENT Vtx_is_sp_itl_tb[5] "Idle speed internal list which contains all the idle speed setpoints." UWORD _CNV_A_R_ENSD_LINEA_22_CM 1 0. 0. 16383.75 ECU_ADDRESS 0xd0006026 FORMAT "%8.2" /end MEASUREMENT
/begin MEASUREMENT Vtx_is_sp_itl_tb[6] "Idle speed internal list which contains all the idle speed setpoints." UWORD _CNV_A_R_ENSD_LINEA_22_CM 1 0. 0. 16383.75 ECU_ADDRESS 0xd0006028 FORMAT "%8.2" /end MEASUREMENT
/begin MEASUREMENT Vtx_is_sp_itl_tb[7] "Idle speed internal list which contains all the idle speed setpoints." UWORD _CNV_A_R_ENSD_LINEA_22_CM 1 0. 0. 16383.75 ECU_ADDRESS 0xd000602a FORMAT "%8.2" /end MEASUREMENT
/begin MEASUREMENT Vtx_is_sp_itl_tb[8] "Idle speed internal list which contains all the idle speed setpoints." UWORD _CNV_A_R_ENSD_LINEA_22_CM 1 0. 0. 16383.75 ECU_ADDRESS 0xd000602c FORMAT "%8.2" /end MEASUREMENT
/begin MEASUREMENT Vtx_is_sp_itl_tb[9] "Idle speed internal list which contains all the idle speed setpoints." UWORD _CNV_A_R_ENSD_LINEA_22_CM 1 0. 0. 16383.75 ECU_ADDRESS 0xd000602e FORMAT "%8.2" /end MEASUREMENT
/begin MEASUREMENT Vtx_is_sp_itl_tb[10] "Idle speed internal list which contains all the idle speed setpoints." UWORD _CNV_A_R_ENSD_LINEA_22_CM 1 0. 0. 16383.75 ECU_ADDRESS 0xd0006030 FORMAT "%8.2" /end MEASUREMENT
/begin MEASUREMENT Vtx_is_sp_itl_tb[11] "Idle speed internal list which contains all the idle speed setpoints." UWORD _CNV_A_R_ENSD_LINEA_22_CM 1 0. 0. 16383.75 ECU_ADDRESS 0xd0006032 FORMAT "%8.2" /end MEASUREMENT
/begin MEASUREMENT Vtx_is_sp_itl_tb[12] "Idle speed internal list which contains all the idle speed setpoints." UWORD _CNV_A_R_ENSD_LINEA_22_CM 1 0. 0. 16383.75 ECU_ADDRESS 0xd0006034 FORMAT "%8.2" /end MEASUREMENT
/begin MEASUREMENT Vtx_is_sp_itl_tb[13] "Idle speed internal list which contains all the idle speed setpoints." UWORD _CNV_A_R_ENSD_LINEA_22_CM 1 0. 0. 16383.75 ECU_ADDRESS 0xd0006036 FORMAT "%8.2" /end MEASUREMENT
/begin MEASUREMENT Vtx_is_sp_itl_tb[14] "Idle speed internal list which contains all the idle speed setpoints." UWORD _CNV_A_R_ENSD_LINEA_22_CM 1 0. 0. 16383.75 ECU_ADDRESS 0xd0006038 FORMAT "%8.2" /end MEASUREMENT
/begin MEASUREMENT Vxx_arb_dec_slop "Arbitrated decrease slope applied to the current arbitrated idle speed" UWORD _CNV_A_R_LINEAR_____395_CM 1 0. -65535. 0. ECU_ADDRESS 0xd00048f8 FORMAT "%4.0" /end MEASUREMENT
/begin MEASUREMENT Vxx_arb_inc_slop "Arbitrated decrease slope applied to the current arbitrated idle speed" UWORD _CNV_A_R_LINEAR_____21_CM 1 0. 0. 65535. ECU_ADDRESS 0xd00048fa FORMAT "%4.0" /end MEASUREMENT
/begin MEASUREMENT Vxx_arb_lim_is "Arbitrated decrease slope applied to the current arbitrated idle speed" UWORD _CNV_A_R_ENSD_LINEA_22_CM 1 0. 0. 16383.75 ECU_ADDRESS 0xd00048fc FORMAT "%8.2" /end MEASUREMENT
/begin MEASUREMENT Vxx_arb_raw_is "Arbitrated raw idle speed setpoint (without min/max limitation)" UWORD _CNV_A_R_ENSD_LINEA_22_CM 1 0. 0. 16383.75 ECU_ADDRESS 0xd00048fe FORMAT "%8.2" /end MEASUREMENT
/begin MEASUREMENT Vxx_crt_is "Arbitrated decrease slope applied to the current arbitrated idle speed" UWORD _CNV_A_R_ENSD_LINEA_22_CM 1 0. 0. 16383.75 ECU_ADDRESS 0xd0004900 FORMAT "%8.2" /end MEASUREMENT
/begin MEASUREMENT Vxx_is_n_sp "Final idle speed setpoint" UWORD _CNV_A_R_ENSD_LINEA_22_CM 1 0. 0. 16383.75 ECU_ADDRESS 0xd0004902 FORMAT "%8.2" /end MEASUREMENT
/begin MEASUREMENT Vxx_run_vh_min_is_n "Running vehicule idle speed setpoint" UWORD _CNV_A_R_ENSD_LINEA_22_CM 1 0. 0. 16383.75 ECU_ADDRESS 0xd0004904 FORMAT "%8.2" /end MEASUREMENT
/begin MEASUREMENT Vxx_tco_min_is_n "Nominal idle speed setpoint" UWORD _CNV_A_R_ENSD_LINEA_22_CM 1 0. 0. 16383.75 ECU_ADDRESS 0xd0004906 FORMAT "%8.2" /end MEASUREMENT
/begin MEASUREMENT Vxx_tco_sp_min_is_n "Arbitrated decrease slope applied to the current arbitrated idle speed" UWORD _CNV_A_R_ENSD_LINEA_22_CM 1 0. 0. 16383.75 ECU_ADDRESS 0xd0004908 FORMAT "%8.2" /end MEASUREMENT
/begin CHARACTERISTIC Cbx_is_run_vh_min_crp_cfm "Configuration of type detection to idel speed setpoint for vehicle running" VALUE 0xa0021de2 _REC_S1VAL_20_u1 1. _CNV_A_R_ECME_LINEA_0_CM 0. 1. FORMAT "%1.0" BIT_MASK 0x1 /end CHARACTERISTIC
/begin CHARACTERISTIC Cbx_mpl_dec_slop_act "Activation of the decrease slopes arbitration strategy (0=One slope  1=multiple slopes)" VALUE 0xa0021de3 _REC_S1VAL_20_u1 1. _CNV_A_R_ECME_LINEA_0_CM 0. 1. FORMAT "%1.0" BIT_MASK 0x1 /end CHARACTERISTIC
/begin CHARACTERISTIC Cxx_dec_slop_ac_sp "Type of decrease  slope for the air conditionning idle speed setpoint (1=Low 2=Med 3=Fast)" VALUE 0xa0021de4 _REC_S1VAL_20_u1 2. _CNV_A_R_ECME_LINEA_0_CM 1. 3. FORMAT "%1.0" /end CHARACTERISTIC
/begin CHARACTERISTIC Cxx_dec_slop_acs_sp "Type of decrease slope for the accessories idle speed setpoint (1=Low 2=Med 3=Fast)" VALUE 0xa0021de5 _REC_S1VAL_20_u1 2. _CNV_A_R_ECME_LINEA_0_CM 1. 3. FORMAT "%1.0" /end CHARACTERISTIC
/begin CHARACTERISTIC Cxx_dec_slop_agb_sp "Type of decrease  slope for the AGB idle speed setpoint (1=Low 2=Med 3=Fast)" VALUE 0xa0021de6 _REC_S1VAL_20_u1 2. _CNV_A_R_ECME_LINEA_0_CM 1. 3. FORMAT "%1.0" /end CHARACTERISTIC
/begin CHARACTERISTIC Cxx_dec_slop_dgi_sp "Type of decrease slope for the diagnosis and protection idle speed setpoint (1=Low 2=Med 3=Fast)" VALUE 0xa0021de7 _REC_S1VAL_20_u1 2. _CNV_A_R_ECME_LINEA_0_CM 1. 3. FORMAT "%1.0" /end CHARACTERISTIC
/begin CHARACTERISTIC Cxx_dec_slop_diag_vvtc_sp "Type of decrease slope for the VVTC routine idle speed setpoint (1=Low 2=Med 3=Fast)" VALUE 0xa0021de8 _REC_S1VAL_20_u1 2. _CNV_A_R_ECME_LINEA_0_CM 1. 3. FORMAT "%3.0" /end CHARACTERISTIC
/begin CHARACTERISTIC Cxx_dec_slop_el_bk_sp "Type of decrease slope for the electrical backlite idle speed setpoint (1=Low 2=Med 3=Fast)" VALUE 0xa0021de9 _REC_S1VAL_20_u1 2. _CNV_A_R_ECME_LINEA_0_CM 1. 3. FORMAT "%1.0" /end CHARACTERISTIC
/begin CHARACTERISTIC Cxx_dec_slop_el_wind_sp "Type of decrease  slope for the electrical windshield idle speed setpoint (1=Low 2=Med 3=Fast)" VALUE 0xa0021dea _REC_S1VAL_20_u1 2. _CNV_A_R_ECME_LINEA_0_CM 1. 3. FORMAT "%1.0" /end CHARACTERISTIC
/begin CHARACTERISTIC Cxx_dec_slop_inj_sp "Type of decrease slope for the injector idle speed setpoint (1=Low 2=Med 3=Fast)" VALUE 0xa0021deb _REC_S1VAL_20_u1 2. _CNV_A_R_ECME_LINEA_0_CM 1. 3. FORMAT "%1.0" /end CHARACTERISTIC
/begin CHARACTERISTIC Cxx_dec_slop_moni_sp "Type of decrease  slope for the monitool idle speed setpoint (1=Low 2=Med 3=Fast)" VALUE 0xa0021dec _REC_S1VAL_20_u1 2. _CNV_A_R_ECME_LINEA_0_CM 1. 3. FORMAT "%1.0" /end CHARACTERISTIC
/begin CHARACTERISTIC Cxx_dec_slop_pft_sp "Type of decrease  slope for the particle filter idle speed setpoint (1=Low 2=Med 3=Fast)" VALUE 0xa0021ded _REC_S1VAL_20_u1 2. _CNV_A_R_ECME_LINEA_0_CM 1. 3. FORMAT "%1.0" /end CHARACTERISTIC
/begin CHARACTERISTIC Cxx_dec_slop_ptc_sp "Type of decrease  slope for the PTC idle speed setpoint (1=Low 2=Med 3=Fast)" VALUE 0xa0021dee _REC_S1VAL_20_u1 2. _CNV_A_R_ECME_LINEA_0_CM 1. 3. FORMAT "%1.0" /end CHARACTERISTIC
/begin CHARACTERISTIC Cxx_dec_slop_pwst_sp "Type of decrease  slope for the power steering idle speed setpoint (1=Low 2=Med 3=Fast)" VALUE 0xa0021def _REC_S1VAL_20_u1 2. _CNV_A_R_ECME_LINEA_0_CM 1. 3. FORMAT "%1.0" /end CHARACTERISTIC
/begin CHARACTERISTIC Cxx_dec_slop_run_vh_sp "Type of decrease  slope for the running vehicle idle speed setpoint (1=Low 2=Med 3=Fast)" VALUE 0xa0021df0 _REC_S1VAL_20_u1 2. _CNV_A_R_ECME_LINEA_0_CM 1. 3. FORMAT "%1.0" /end CHARACTERISTIC
/begin CHARACTERISTIC Cxx_dec_slop_tco_sp "Type of decrease  slope for the coolant temperature idle speed setpoint (1=Low 2=Med 3=Fast)" VALUE 0xa0021df1 _REC_S1VAL_20_u1 2. _CNV_A_R_ECME_LINEA_0_CM 1. 3. FORMAT "%1.0" /end CHARACTERISTIC
/begin CHARACTERISTIC Cxx_dec_slop_thpl_sp "Type of decrease  slope for the thermoplunger idle speed setpoint (1=Low 2=Med 3=Fast)" VALUE 0xa0021df2 _REC_S1VAL_20_u1 2. _CNV_A_R_ECME_LINEA_0_CM 1. 3. FORMAT "%1.0" /end CHARACTERISTIC
/begin CHARACTERISTIC Cxx_fast_dec_slop "Value for the fast decrease slope" VALUE 0xa0021dcc _REC_S1VAL_20_u2 65535. _CNV_A_R_LINEAR_____395_CM -65535. 0. FORMAT "%4.0" /end CHARACTERISTIC
/begin CHARACTERISTIC Cxx_fast_inc_slop "Value for the fast increase slope" VALUE 0xa0021dce _REC_S1VAL_20_u2 65535. _CNV_A_R_LINEAR_____21_CM 0. 65535. FORMAT "%4.0" /end CHARACTERISTIC
/begin CHARACTERISTIC Cxx_inc_slop_ac_sp "Type of increase  slope for the air conditionning idle speed setpoint (1=Low 2=Med 3=Fast)" VALUE 0xa0021df3 _REC_S1VAL_20_u1 2. _CNV_A_R_ECME_LINEA_0_CM 1. 3. FORMAT "%1.0" /end CHARACTERISTIC
/begin CHARACTERISTIC Cxx_inc_slop_acs_sp "Type of increase slope for the accessories idle speed setpoint (1=Low 2=Med 3=Fast)" VALUE 0xa0021df4 _REC_S1VAL_20_u1 2. _CNV_A_R_ECME_LINEA_0_CM 1. 3. FORMAT "%1.0" /end CHARACTERISTIC
/begin CHARACTERISTIC Cxx_inc_slop_agb_sp "Type of increase  slope for the AGB idle speed setpoint (1=Low 2=Med 3=Fast)" VALUE 0xa0021df5 _REC_S1VAL_20_u1 2. _CNV_A_R_ECME_LINEA_0_CM 1. 3. FORMAT "%1.0" /end CHARACTERISTIC
/begin CHARACTERISTIC Cxx_inc_slop_dgi_sp "Type of increase slope for the diagnosis and protection idle speed setpoint (1=Low 2=Med 3=Fast)" VALUE 0xa0021df6 _REC_S1VAL_20_u1 2. _CNV_A_R_ECME_LINEA_0_CM 1. 3. FORMAT "%1.0" /end CHARACTERISTIC
/begin CHARACTERISTIC Cxx_inc_slop_diag_vvtc_sp "Type of increase slope for the VVTC routine idle speed setpoint (1=Low 2=Med 3=Fast)" VALUE 0xa0021df7 _REC_S1VAL_20_u1 2. _CNV_A_R_ECME_LINEA_0_CM 1. 3. FORMAT "%3.0" /end CHARACTERISTIC
/begin CHARACTERISTIC Cxx_inc_slop_el_bk_sp "Type of increase slope for the electrical backlite idle speed setpoint (1=Low 2=Med 3=Fast)" VALUE 0xa0021df8 _REC_S1VAL_20_u1 2. _CNV_A_R_ECME_LINEA_0_CM 1. 3. FORMAT "%1.0" /end CHARACTERISTIC
/begin CHARACTERISTIC Cxx_inc_slop_el_wind_sp "Type of increase  slope for the electrical windshield idle speed setpoint (1=Low 2=Med 3=Fast)" VALUE 0xa0021df9 _REC_S1VAL_20_u1 2. _CNV_A_R_ECME_LINEA_0_CM 1. 3. FORMAT "%1.0" /end CHARACTERISTIC
/begin CHARACTERISTIC Cxx_inc_slop_inj_sp "Type of increase slope for the injector idle speed setpoint (1=Low 2=Med 3=Fast)" VALUE 0xa0021dfa _REC_S1VAL_20_u1 2. _CNV_A_R_ECME_LINEA_0_CM 1. 3. FORMAT "%1.0" /end CHARACTERISTIC
/begin CHARACTERISTIC Cxx_inc_slop_moni_sp "Type of increase  slope for the monitool idle speed setpoint (1=Low 2=Med 3=Fast)" VALUE 0xa0021dfb _REC_S1VAL_20_u1 2. _CNV_A_R_ECME_LINEA_0_CM 1. 3. FORMAT "%1.0" /end CHARACTERISTIC
/begin CHARACTERISTIC Cxx_inc_slop_pft_sp "Type of increase  slope for the particle filter idle speed setpoint (1=Low 2=Med 3=Fast)" VALUE 0xa0021dfc _REC_S1VAL_20_u1 2. _CNV_A_R_ECME_LINEA_0_CM 1. 3. FORMAT "%1.0" /end CHARACTERISTIC
/begin CHARACTERISTIC Cxx_inc_slop_ptc_sp "Type of increase  slope for the PTC idle speed setpoint (1=Low 2=Med 3=Fast)" VALUE 0xa0021dfd _REC_S1VAL_20_u1 2. _CNV_A_R_ECME_LINEA_0_CM 1. 3. FORMAT "%1.0" /end CHARACTERISTIC
/begin CHARACTERISTIC Cxx_inc_slop_pwst_sp "Type of increase  slope for the power steering idle speed setpoint (1=Low 2=Med 3=Fast)" VALUE 0xa0021dfe _REC_S1VAL_20_u1 2. _CNV_A_R_ECME_LINEA_0_CM 1. 3. FORMAT "%1.0" /end CHARACTERISTIC
/begin CHARACTERISTIC Cxx_inc_slop_run_vh_sp "Type of increase  slope for the running vehicle idle speed setpoint (1=Low 2=Med 3=Fast)" VALUE 0xa0021dff _REC_S1VAL_20_u1 2. _CNV_A_R_ECME_LINEA_0_CM 1. 3. FORMAT "%1.0" /end CHARACTERISTIC
/begin CHARACTERISTIC Cxx_inc_slop_tco_sp "Type of increase  slope for the coolant temperature idle speed setpoint (1=Low 2=Med 3=Fast)" VALUE 0xa0021e00 _REC_S1VAL_20_u1 2. _CNV_A_R_ECME_LINEA_0_CM 1. 3. FORMAT "%1.0" /end CHARACTERISTIC
/begin CHARACTERISTIC Cxx_inc_slop_thpl_sp "Type of increase  slope for the thermoplunger idle speed setpoint (1=Low 2=Med 3=Fast)" VALUE 0xa0021e01 _REC_S1VAL_20_u1 2. _CNV_A_R_ECME_LINEA_0_CM 1. 3. FORMAT "%1.0" /end CHARACTERISTIC
/begin CHARACTERISTIC Cxx_is_n_sp_max "Maximum idle speed setpoint authorized" VALUE 0xa0021dd0 _REC_S1VAL_20_u2 16383.75 _CNV_A_R_ENSD_LINEA_22_CM 0. 16383.75 FORMAT "%8.2" /end CHARACTERISTIC
/begin CHARACTERISTIC Cxx_is_n_sp_min "Minimum idle speed setpoint authorized" VALUE 0xa0021dd2 _REC_S1VAL_20_u2 16383.75 _CNV_A_R_ENSD_LINEA_22_CM 0. 16383.75 FORMAT "%8.2" /end CHARACTERISTIC
/begin CHARACTERISTIC Cxx_med_dec_slop "Value for the medium decrease slope" VALUE 0xa0021dd4 _REC_S1VAL_20_u2 65535. _CNV_A_R_LINEAR_____395_CM -65535. 0. FORMAT "%4.0" /end CHARACTERISTIC
/begin CHARACTERISTIC Cxx_med_inc_slop "Value for the medium increase slope" VALUE 0xa0021dd6 _REC_S1VAL_20_u2 65535. _CNV_A_R_LINEAR_____21_CM 0. 65535. FORMAT "%4.0" /end CHARACTERISTIC
/begin CHARACTERISTIC Cxx_moni_is_n_sp_max "Maximum idle speed setpoint authorized in case of monitool request" VALUE 0xa0021dd8 _REC_S1VAL_20_u2 16383.75 _CNV_A_R_ENSD_LINEA_22_CM 0. 16383.75 FORMAT "%8.2" /end CHARACTERISTIC
/begin CHARACTERISTIC Cxx_n_sp_dec "Idle speed setpoint decrementation" VALUE 0xa0021dda _REC_S1VAL_20_u2 65535. _CNV_A_R_LINEAR_____395_CM -65535. 0. FORMAT "%4.0" /end CHARACTERISTIC
/begin CHARACTERISTIC Cxx_run_vh_min_is_n_dsb "Threshold composed to V/Neng ratio, which desables the running vehicle idle speed setpoint" VALUE 0xa0021ddc _REC_S1VAL_20_s2 210. _CNV_A_R_LINEAR_____396_CM -10. 200. FORMAT "%6.2" /end CHARACTERISTIC
/begin CHARACTERISTIC Cxx_slow_dec_slop "Value for the slow decrease slope" VALUE 0xa0021dde _REC_S1VAL_20_u2 65535. _CNV_A_R_LINEAR_____395_CM -65535. 0. FORMAT "%4.0" /end CHARACTERISTIC
/begin CHARACTERISTIC Cxx_slow_inc_slop "Value for the slow increase slope" VALUE 0xa0021de0 _REC_S1VAL_20_u2 65535. _CNV_A_R_LINEAR_____21_CM 0. 65535. FORMAT "%4.0" /end CHARACTERISTIC
/begin AXIS_PTS Ctb_fzy_tkof_tqe_grd "Torque gradient breakpoints for take-off situation evaluation" 0xa0034d5c Vxx_driv_tqe_sp_grd _REC_A2AXS_20_u2 1300. _CNV_A_R_LINEAR_____304_CM 9 -650. 650. FORMAT "%5.2" /end AXIS_PTS
/begin AXIS_PTS Ctb_tkof_vs_n_rat "breakpoints de Ratio Vitesse/RÃ©gime" 0xa0034d70 Vxx_vs_n_rat_fil _REC_A2AXS_20_u2 210. _CNV_A_R_LINEAR_____197_CM 7 -10. 200. FORMAT "%6.2" /end AXIS_PTS
/begin CHARACTERISTIC Ctp_fzy_tkof_tqe_grd_fac "Take-off situation evaluation depending on torque gradient." CURVE 0xa0034d80 _REC_A1CUR_20_u1_u2 0.99609375 _CNV_A_R_LINEAR_____29_CM 0. 0.99609375 FORMAT "%10.8"
 /begin AXIS_DESCR COM_AXIS Vxx_driv_tqe_sp_grd _CNV_A_R_LINEAR_____304_CM 9 -650. 650. FORMAT "%5.2" AXIS_PTS_REF Ctb_fzy_tkof_tqe_grd /end AXIS_DESCR
/end CHARACTERISTIC
/begin CHARACTERISTIC Ctp_fzy_tkof_vs_n_rat_fac "Take-off situation evaluation depending on vehicle speed/engine speed ratio." CURVE 0xa0021e3c _REC_A1CUR_20_u1_u2 0.99609375 _CNV_A_R_LINEAR_____29_CM 0. 0.99609375 FORMAT "%10.8"
 /begin AXIS_DESCR COM_AXIS Vxx_vs_n_rat_fil _CNV_A_R_LINEAR_____197_CM 7 -10. 200. FORMAT "%6.2" AXIS_PTS_REF Ctb_tkof_vs_n_rat /end AXIS_DESCR
/end CHARACTERISTIC
/begin MEASUREMENT Vxx_driv_tqe_sp_grd "Raw driver torque gradient" UWORD _CNV_A_R_LINEAR_____304_CM 1 0. -650. 650. ECU_ADDRESS 0xd0004924 FORMAT "%5.2" /end MEASUREMENT
/begin MEASUREMENT Vxx_driv_tqe_sp_sat "Torque Setpoint before AJS Correction action and after saturation to maximal torque" UWORD _CNV_A_R_LINEAR_____216_CM 1 0. -400. 1647.96875 ECU_ADDRESS 0xd0004926 FORMAT "%10.5" /end MEASUREMENT
/begin MEASUREMENT Vxx_fzy_tkof "Take-off situation evaluation" UBYTE _CNV_A_R_LINEAR_____29_CM 1 0. 0. 0.99609375 ECU_ADDRESS 0xd00070fa FORMAT "%10.8" /end MEASUREMENT
/begin MEASUREMENT Vxx_mfld_dly_fil_fac "Filtering factor for the manifold model" UWORD _CNV_A_R_LINEAR_____7_CM 1 0. 0. 0.9999847412109381 ECU_ADDRESS 0xd0004928 FORMAT "%7.5" /end MEASUREMENT
/begin MEASUREMENT Vxx_n_tkof_inrt "Global inertia evaluated at the engine, for take-off engine speed setpoint calculation." UBYTE _CNV_A_R_LINEAR_____398_CM 1 0. 0. 2.55 ECU_ADDRESS 0xd00070fb FORMAT "%4.2" /end MEASUREMENT
/begin MEASUREMENT Vxx_tkof_dly_tqe_sp "Raw driver torque setpoint, filtered with manifold dynamic and engine delay." UWORD _CNV_A_R_LINEAR_____216_CM 1 0. -400. 1647.96875 ECU_ADDRESS 0xd000492a FORMAT "%10.5" /end MEASUREMENT
/begin MEASUREMENT Vxx_tkof_mdl_n_drv "modeled derivate of engine speed for take off" SWORD _CNV_A_R_LINEAR_____21_CM 1 0. -8192. 8191. ECU_ADDRESS 0xd000492c FORMAT "%5.0" /end MEASUREMENT
/begin MEASUREMENT Vxx_tkof_mdl_n_drv_1 "modeled derivate of engine speed for take off on gear 1" SWORD _CNV_A_R_LINEAR_____21_CM 1 0. -8192. 8191. ECU_ADDRESS 0xd000492e FORMAT "%5.0" /end MEASUREMENT
/begin MEASUREMENT Vxx_tkof_mfld_tqe_sp "Raw driver torque setpoint, filtered with manifold dynamic." UWORD _CNV_A_R_LINEAR_____216_CM 1 0. -400. 1647.96875 ECU_ADDRESS 0xd0004930 FORMAT "%10.5" /end MEASUREMENT
/begin MEASUREMENT Vxx_tkof_n_sp "Engine speed  setpoint for take-off" UWORD _CNV_A_R_ENSD_LINEA_22_CM 1 0. 0. 16383.75 ECU_ADDRESS 0xd0004932 FORMAT "%8.2" /end MEASUREMENT
/begin MEASUREMENT Vxx_tkof_tqe_sp "Raw driver torque setpoint, filtered with manifold dynamic and engine delay." UWORD _CNV_A_R_LINEAR_____216_CM 1 0. -400. 1647.96875 ECU_ADDRESS 0xd0004934 FORMAT "%10.5" /end MEASUREMENT
/begin MEASUREMENT Vxx_tq_air_dly_t "pure delay between the air intake and the supply of torque" UBYTE _CNV_A_R_LINEAR_____32_CM 1 0. 0. 2.55 ECU_ADDRESS 0xd00070fc FORMAT "%4.2" /end MEASUREMENT
/begin CHARACTERISTIC Cbx_tkof_tqe_sp_dec_cfm "if Cbx_tkof_tqe_sp_dec_cfm = 1, the manifold dynamics is take into account during increase or decrease of torque" VALUE 0xa0021e46 _REC_S1VAL_20_u1 1. _CNV_A_R_ECME_LINEA_0_CM 0. 1. FORMAT "%1.0" BIT_MASK 0x1 /end CHARACTERISTIC
/begin CHARACTERISTIC Cxx_air_tq_dly_tdc_fac "factor on tdc period to calculate pure delay." VALUE 0xa0021e47 _REC_S1VAL_20_u1 3.984375 _CNV_A_R_LINEAR_____83_CM 0. 3.984375 FORMAT "%7.5" /end CHARACTERISTIC
/begin CHARACTERISTIC Cxx_fzy_tkof_lim_dec_t "Characteristic time of diminution of Vxx_fzy_tkof (minimun time to go from 1 to 0)" VALUE 0xa0021e48 _REC_S1VAL_20_u1 25.5 _CNV_A_R_LINEAR_____58_CM 0. 25.5 FORMAT "%4.1" /end CHARACTERISTIC
/begin CHARACTERISTIC Cxx_mfld_tkof_dly_fac "manifold time delay factor" VALUE 0xa0021e49 _REC_S1VAL_20_u1 1.9921875 _CNV_A_R_LINEAR_____42_CM 0. 1.9921875 FORMAT "%8.6" /end CHARACTERISTIC
/begin CHARACTERISTIC Cxx_n_tkof_fil_fac "Filtering factor to insure the stability of the vacuous accelerations." VALUE 0xa0021e4a _REC_S1VAL_20_u1 0.99609375 _CNV_A_R_LINEAR_____29_CM 0. 0.99609375 FORMAT "%10.8" /end CHARACTERISTIC
/begin CHARACTERISTIC Cxx_n_tkof_inrt_0 "Engine inertia" VALUE 0xa0021e4b _REC_S1VAL_20_u1 2.55 _CNV_A_R_LINEAR_____398_CM 0. 2.55 FORMAT "%4.2" /end CHARACTERISTIC
/begin CHARACTERISTIC Cxx_n_tkof_inrt_1 "Vehicle+engine inertia when on first gear" VALUE 0xa0021e4c _REC_S1VAL_20_u1 2.55 _CNV_A_R_LINEAR_____398_CM 0. 2.55 FORMAT "%4.2" /end CHARACTERISTIC
/begin CHARACTERISTIC Cxx_tkof_n_dif_inrt_cge "Difference between current engine speed and setpoint for inertia shifting during take-off." VALUE 0xa0021e44 _REC_S1VAL_20_u2 16383.75 _CNV_A_R_ENSD_LINEA_22_CM 0. 16383.75 FORMAT "%8.2" /end CHARACTERISTIC
/begin CHARACTERISTIC Cxx_tkof_tqe_grd_t "filtering time for torque derivate" VALUE 0xa0021e4d _REC_S1VAL_20_u1 2.55 _CNV_A_R_LINEAR_____32_CM 0. 2.55 FORMAT "%4.2" /end CHARACTERISTIC
/begin MEASUREMENT Vsx_is_inj_vld "Injection validity status for Idle Speed" UBYTE _CNV_S_3_STATUS_OK__179_CM 1 0. 0. 2. ECU_ADDRESS 0xd0007c9f /end MEASUREMENT
/begin MEASUREMENT Vbx_diag_sta_ndec_ena "ISR routine activation status (for decrease)" UBYTE _CNV_S_2_RANGE______3_CM 1 0. 0. 1. ECU_ADDRESS 0xd0007ca3 BIT_MASK 0x1 /end MEASUREMENT
/begin MEASUREMENT Vbx_diag_sta_ndec_end "ISR routine activation status (for decrease)" UBYTE _CNV_S_2_RANGE______3_CM 1 0. 0. 1. ECU_ADDRESS 0xd0007ca4 BIT_MASK 0x1 /end MEASUREMENT
/begin MEASUREMENT Vbx_diag_sta_ninc_ena "ISR routine activation status (for increase)" UBYTE _CNV_S_2_RANGE______3_CM 1 0. 0. 1. ECU_ADDRESS 0xd0007ca5 BIT_MASK 0x1 /end MEASUREMENT
/begin MEASUREMENT Vbx_diag_sta_ninc_end "ISR routine activation status (for increase)" UBYTE _CNV_S_2_RANGE______3_CM 1 0. 0. 1. ECU_ADDRESS 0xd0007ca6 BIT_MASK 0x1 /end MEASUREMENT
/begin MEASUREMENT Vsx_diag_sta_ndec_stt "ndec routine status" UBYTE _CNV_S_4_RANGE_ROUT_288_CM 1 0. 0. 3. ECU_ADDRESS 0xd0007ca7 /end MEASUREMENT
/begin MEASUREMENT Vsx_diag_sta_ninc_stt "ninc routine status" UBYTE _CNV_S_4_RANGE_ROUT_288_CM 1 0. 0. 3. ECU_ADDRESS 0xd0007ca8 /end MEASUREMENT
/begin MEASUREMENT Vxx_diag_min_is_ofs "Temporary tuning idle speed setpoint offset" SWORD _CNV_A_R_ENSD_LINEA_22_CM 1 0. -8192. 8191.75 ECU_ADDRESS 0xd0006054 FORMAT "%8.2" /end MEASUREMENT
/begin CHARACTERISTIC Cxx_diag_max_is_n "Maximum tuning idle speed setpoint offset authorized" VALUE 0xa0021e28 _REC_S1VAL_20_s2 16383.75 _CNV_A_R_ENSD_LINEA_22_CM -8192. 8191.75 FORMAT "%8.2" /end CHARACTERISTIC
/begin CHARACTERISTIC Cxx_diag_min_is_n "Minimum tuning idle speed setpoint offset authorized" VALUE 0xa0021e2a _REC_S1VAL_20_s2 16383.75 _CNV_A_R_ENSD_LINEA_22_CM -8192. 8191.75 FORMAT "%8.2" /end CHARACTERISTIC
/begin CHARACTERISTIC Cxx_n_step "Maximum tuning idle speed setpoint offset authorized" VALUE 0xa0021e2c _REC_S1VAL_20_s2 16383.75 _CNV_A_R_ENSD_LINEA_22_CM -8192. 8191.75 FORMAT "%8.2" /end CHARACTERISTIC
/begin MEASUREMENT Vxx_sta_eng_dly_NVM "" UWORD _CNV_A_R_LINEAR_____32_CM 1 0. 0. 655.35 DISPLAY_IDENTIFIER OuCboInj_NVM.Vxx_sta_eng_dly_NVM ECU_ADDRESS 0xd0004652 FORMAT "%6.2" /end MEASUREMENT
/begin AXIS_PTS Ctb_mv_vb "Breakpoints for voltage battery correction table" 0xa002effc Vxx_mv_vb _REC_A2AXS_20_u2 25000. _CNV_A_R_LINEAR_____107_CM 9 0. 25000. FORMAT "%5.0" /end AXIS_PTS
/begin CHARACTERISTIC Ctp_vb_inj_dly_cor "Voltage battery correction table" CURVE 0xa002f010 _REC_A1CUR_20_u2_u2 65535. _CNV_A_R_LINEAR_____202_CM 0. 65535. FORMAT "%5.0"
 /begin AXIS_DESCR COM_AXIS Vxx_mv_vb _CNV_A_R_LINEAR_____107_CM 9 0. 25000. FORMAT "%5.0" AXIS_PTS_REF Ctb_mv_vb /end AXIS_DESCR
/end CHARACTERISTIC
/begin MEASUREMENT Vxx_inj_dly "Opening delay" UWORD _CNV_A_R_LINEAR_____102_CM 1 0. 0. 262140. ECU_ADDRESS 0xd0004656 FORMAT "%6.0" /end MEASUREMENT
/begin MEASUREMENT Vxx_inj_dly_clc "Calculated opening delay from injection fuel type ratio" UWORD _CNV_A_R_LINEAR_____102_CM 1 0. 0. 262140. ECU_ADDRESS 0xd0005fac FORMAT "%6.0" /end MEASUREMENT
/begin MEASUREMENT Vxx_vb_inj_dly_cor "Opening delay correction (depending on measured voltage battery)" UWORD _CNV_A_R_LINEAR_____202_CM 1 0. 0. 65535. ECU_ADDRESS 0xd0004658 FORMAT "%5.0" /end MEASUREMENT
/begin CHARACTERISTIC Cxx_inj_dly "Opening delay for an optimal voltage battery" VALUE 0xa0021a84 _REC_S1VAL_20_u2 262140. _CNV_A_R_LINEAR_____102_CM 0. 262140. FORMAT "%6.0" /end CHARACTERISTIC
/begin CHARACTERISTIC Cxx_inj_dly_alco "Opening delay for an optimal voltage battery for alcohol" VALUE 0xa0021a86 _REC_S1VAL_20_u2 262140. _CNV_A_R_LINEAR_____102_CM 0. 262140. FORMAT "%6.0" /end CHARACTERISTIC
/begin MEASUREMENT Vbx_diag_sta_ffig_abrt "ffig aborded status" UBYTE _CNV_S_2_RANGE______3_CM 1 0. 0. 1. ECU_ADDRESS 0xd0006ec6 BIT_MASK 0x1 /end MEASUREMENT
/begin MEASUREMENT Vbx_diag_sta_ffig_ena "ffig activation status" UBYTE _CNV_S_2_RANGE______3_CM 1 0. 0. 1. ECU_ADDRESS 0xd0006ec7 BIT_MASK 0x1 /end MEASUREMENT
/begin MEASUREMENT Vbx_diag_sta_ffig_end "ffig completed status" UBYTE _CNV_S_2_RANGE______3_CM 1 0. 0. 1. ECU_ADDRESS 0xd0006ec8 BIT_MASK 0x1 /end MEASUREMENT
/begin MEASUREMENT Vbx_min_cp_ti "Minimum injection time detection for canister purge" UBYTE _CNV_S_2_RANGE______3_CM 1 0. 0. 1. ECU_ADDRESS 0xd0006ec9 BIT_MASK 0x1 /end MEASUREMENT
/begin MEASUREMENT Vbx_min_ti "Injection time saturated by minimum injection time" UBYTE _CNV_S_2_RANGE______3_CM 1 0. 0. 1. ECU_ADDRESS 0xd0006eca BIT_MASK 0x1 /end MEASUREMENT
/begin MEASUREMENT Vbx_min_ti_cut "Injection cut by minimum injection time" UBYTE _CNV_S_2_RANGE______3_CM 1 0. 0. 1. ECU_ADDRESS 0xd0006ecb BIT_MASK 0x1 /end MEASUREMENT
/begin MEASUREMENT Vsx_diag_sta_ffig_stt "ffig status" UBYTE _CNV_A_R_ECME_LINEA_0_CM 1 0. 0. 255. ECU_ADDRESS 0xd0006ecc FORMAT "%3.0" /end MEASUREMENT
/begin MEASUREMENT Vsx_inj1_vld "First injector validity status" UBYTE _CNV_A_R_ECME_LINEA_0_CM 1 0. 0. 1. ECU_ADDRESS 0xd0006ecd FORMAT "%1.0" /end MEASUREMENT
/begin MEASUREMENT Vsx_inj2_vld "Second injector validity status" UBYTE _CNV_A_R_ECME_LINEA_0_CM 1 0. 0. 1. ECU_ADDRESS 0xd0006ece FORMAT "%1.0" /end MEASUREMENT
/begin MEASUREMENT Vsx_inj3_vld "Third injector validity status" UBYTE _CNV_A_R_ECME_LINEA_0_CM 1 0. 0. 1. ECU_ADDRESS 0xd0006ecf FORMAT "%1.0" /end MEASUREMENT
/begin MEASUREMENT Vsx_inj4_vld "Fourth injector validity status" UBYTE _CNV_A_R_ECME_LINEA_0_CM 1 0. 0. 1. ECU_ADDRESS 0xd0006ed0 FORMAT "%1.0" /end MEASUREMENT
/begin MEASUREMENT Vxx_efv_ti "Effective time injection." ULONG _CNV_A_R_LINEAR_____102_CM 1 0. 0. 500000. ECU_ADDRESS 0xd0002958 FORMAT "%6.0" /end MEASUREMENT
/begin MEASUREMENT Vxx_inj1_appl_ti1 "Applied injection time on cylinder 1, first injection." ULONG _CNV_A_R_LINEAR_____102_CM 1 0. 0. 500000. ECU_ADDRESS 0xd000295c FORMAT "%6.0" /end MEASUREMENT
/begin MEASUREMENT Vxx_inj1_appl_ti2 "Applied injection time on cylinder 1, second injection." ULONG _CNV_A_R_LINEAR_____102_CM 1 0. 0. 500000. ECU_ADDRESS 0xd0002960 FORMAT "%6.0" /end MEASUREMENT
/begin MEASUREMENT Vxx_inj2_appl_ti1 "Applied injection time on cylinder 2, first injection." ULONG _CNV_A_R_LINEAR_____102_CM 1 0. 0. 500000. ECU_ADDRESS 0xd0002964 FORMAT "%6.0" /end MEASUREMENT
/begin MEASUREMENT Vxx_inj2_appl_ti2 "Applied injection time on cylinder 2, second injection." ULONG _CNV_A_R_LINEAR_____102_CM 1 0. 0. 500000. ECU_ADDRESS 0xd0002968 FORMAT "%6.0" /end MEASUREMENT
/begin MEASUREMENT Vxx_inj3_appl_ti1 "Applied injection time on cylinder 3, first injection." ULONG _CNV_A_R_LINEAR_____102_CM 1 0. 0. 500000. ECU_ADDRESS 0xd000296c FORMAT "%6.0" /end MEASUREMENT
/begin MEASUREMENT Vxx_inj3_appl_ti2 "Applied injection time on cylinder 3, second injection." ULONG _CNV_A_R_LINEAR_____102_CM 1 0. 0. 500000. ECU_ADDRESS 0xd0002970 FORMAT "%6.0" /end MEASUREMENT
/begin MEASUREMENT Vxx_inj4_appl_ti1 "Applied injection time on cylinder 4, first injection." ULONG _CNV_A_R_LINEAR_____102_CM 1 0. 0. 500000. ECU_ADDRESS 0xd0002974 FORMAT "%6.0" /end MEASUREMENT
/begin MEASUREMENT Vxx_inj4_appl_ti2 "Applied injection time on cylinder 4, second injection." ULONG _CNV_A_R_LINEAR_____102_CM 1 0. 0. 500000. ECU_ADDRESS 0xd0002978 FORMAT "%6.0" /end MEASUREMENT
/begin MEASUREMENT Vxx_inj_wht_ti_fac "Interpolated conversion factor : FMI / injection time" UWORD _CNV_A_R_LINEAR_____399_CM 1 0. 1.52587890625e-002 1000. ECU_ADDRESS 0xd0005faa FORMAT "%6.2" /end MEASUREMENT
/begin MEASUREMENT Vxx_pinj_appl_ti "Applied preinjection time." UBYTE _CNV_A_R_LINEAR_____400_CM 1 0. 0. 1020000. ECU_ADDRESS 0xd0006ed1 FORMAT "%7.0" /end MEASUREMENT
/begin MEASUREMENT Vxx_sta_eng_dly_t "Duration of stalling value for the first start strategy" UWORD _CNV_A_R_LINEAR_____32_CM 1 0. 0. 655.35 ECU_ADDRESS 0xd0004654 FORMAT "%6.2" /end MEASUREMENT
/begin CHARACTERISTIC Cbx_inj1_num "Configuration to perform the purge of gasoline circuit in the first start mode for injector 1" VALUE 0xa0021a7c _REC_S1VAL_20_u1 1. _CNV_S_2_RANGE______3_CM 0. 1. BIT_MASK 0x1 /end CHARACTERISTIC
/begin CHARACTERISTIC Cbx_inj2_num "Configuration to perform the purge of gasoline circuit in the first start mode for injector 2" VALUE 0xa0021a7d _REC_S1VAL_20_u1 1. _CNV_S_2_RANGE______3_CM 0. 1. BIT_MASK 0x1 /end CHARACTERISTIC
/begin CHARACTERISTIC Cbx_inj3_num "Configuration to perform the purge of gasoline circuit in the first start mode for injector 3" VALUE 0xa0021a7e _REC_S1VAL_20_u1 1. _CNV_S_2_RANGE______3_CM 0. 1. BIT_MASK 0x1 /end CHARACTERISTIC
/begin CHARACTERISTIC Cbx_inj4_num "Configuration to perform the purge of gasoline circuit in the first start mode for injector 4" VALUE 0xa0021a7f _REC_S1VAL_20_u1 1. _CNV_S_2_RANGE______3_CM 0. 1. BIT_MASK 0x1 /end CHARACTERISTIC
/begin CHARACTERISTIC Cbx_min_ti "Setup to apply an minimum drive pulse" VALUE 0xa0021a80 _REC_S1VAL_20_u1 1. _CNV_S_2_RANGE______3_CM 0. 1. BIT_MASK 0x1 /end CHARACTERISTIC
/begin CHARACTERISTIC Cbx_ti_bch "Injection time in bench mode" VALUE 0xa0021a81 _REC_S1VAL_20_u1 1. _CNV_S_2_RANGE______3_CM 0. 1. BIT_MASK 0x1 /end CHARACTERISTIC
/begin CHARACTERISTIC Cxx_dfdec_inj1_oc "a_ou_cbo_inj_appitxx/Open Circuit of injector 1 detected failure counter decrement" VALUE 0xa0021a38 _REC_S1VAL_20_u2 65535. _CNV_A_R_ECME_LINEA_0_CM 0. 65535. FORMAT "%5.0" /end CHARACTERISTIC
/begin CHARACTERISTIC Cxx_dfdec_inj1_scg "a_ou_cbo_inj_appitxx/Short Circuit to ground of injector 1 detected failure counter decrement" VALUE 0xa0021a3a _REC_S1VAL_20_u2 65535. _CNV_A_R_ECME_LINEA_0_CM 0. 65535. FORMAT "%5.0" /end CHARACTERISTIC
/begin CHARACTERISTIC Cxx_dfdec_inj1_scw "a_ou_cbo_inj_appitxx/Short Circuit to battery of injector 1 detected failure counter decrement" VALUE 0xa0021a3c _REC_S1VAL_20_u2 65535. _CNV_A_R_ECME_LINEA_0_CM 0. 65535. FORMAT "%5.0" /end CHARACTERISTIC
/begin CHARACTERISTIC Cxx_dfdec_inj2_oc "a_ou_cbo_inj_appitxx/Open Circuit of injector 2 detected failure counter decrement" VALUE 0xa0021a3e _REC_S1VAL_20_u2 65535. _CNV_A_R_ECME_LINEA_0_CM 0. 65535. FORMAT "%5.0" /end CHARACTERISTIC
/begin CHARACTERISTIC Cxx_dfdec_inj2_scg "a_ou_cbo_inj_appitxx/Short Circuit to ground of injector 2 detected failure counter decrement" VALUE 0xa0021a40 _REC_S1VAL_20_u2 65535. _CNV_A_R_ECME_LINEA_0_CM 0. 65535. FORMAT "%5.0" /end CHARACTERISTIC
/begin CHARACTERISTIC Cxx_dfdec_inj2_scw "a_ou_cbo_inj_appitxx/Short Circuit to battery of injector 2 detected failure counter decrement" VALUE 0xa0021a42 _REC_S1VAL_20_u2 65535. _CNV_A_R_ECME_LINEA_0_CM 0. 65535. FORMAT "%5.0" /end CHARACTERISTIC
/begin CHARACTERISTIC Cxx_dfdec_inj3_oc "a_ou_cbo_inj_appitxx/Open Circuit of injector 3 detected failure counter decrement" VALUE 0xa0021a44 _REC_S1VAL_20_u2 65535. _CNV_A_R_ECME_LINEA_0_CM 0. 65535. FORMAT "%5.0" /end CHARACTERISTIC
/begin CHARACTERISTIC Cxx_dfdec_inj3_scg "a_ou_cbo_inj_appitxx/Short Circuit to ground of injector 3 detected failure counter decrement" VALUE 0xa0021a46 _REC_S1VAL_20_u2 65535. _CNV_A_R_ECME_LINEA_0_CM 0. 65535. FORMAT "%5.0" /end CHARACTERISTIC
/begin CHARACTERISTIC Cxx_dfdec_inj3_scw "a_ou_cbo_inj_appitxx/Short Circuit to battery of injector 3 detected failure counter decrement" VALUE 0xa0021a48 _REC_S1VAL_20_u2 65535. _CNV_A_R_ECME_LINEA_0_CM 0. 65535. FORMAT "%5.0" /end CHARACTERISTIC
/begin CHARACTERISTIC Cxx_dfdec_inj4_oc "a_ou_cbo_inj_appitxx/Open Circuit of injector 4 detected failure counter decrement" VALUE 0xa0021a4a _REC_S1VAL_20_u2 65535. _CNV_A_R_ECME_LINEA_0_CM 0. 65535. FORMAT "%5.0" /end CHARACTERISTIC
/begin CHARACTERISTIC Cxx_dfdec_inj4_scg "a_ou_cbo_inj_appitxx/Short Circuit to ground of injector 4 detected failure counter decrement" VALUE 0xa0021a4c _REC_S1VAL_20_u2 65535. _CNV_A_R_ECME_LINEA_0_CM 0. 65535. FORMAT "%5.0" /end CHARACTERISTIC
/begin CHARACTERISTIC Cxx_dfdec_inj4_scw "a_ou_cbo_inj_appitxx/Short Circuit to battery of injector 4 detected failure counter decrement" VALUE 0xa0021a4e _REC_S1VAL_20_u2 65535. _CNV_A_R_ECME_LINEA_0_CM 0. 65535. FORMAT "%5.0" /end CHARACTERISTIC
/begin CHARACTERISTIC Cxx_dfinc_inj1_oc "a_ou_cbo_inj_appitxx/Open Circuit of injector 1 detected failure counter increment" VALUE 0xa0021a50 _REC_S1VAL_20_u2 65535. _CNV_A_R_ECME_LINEA_0_CM 0. 65535. FORMAT "%5.0" /end CHARACTERISTIC
/begin CHARACTERISTIC Cxx_dfinc_inj1_scg "a_ou_cbo_inj_appitxx/Short Circuit to ground of injector 1 detected failure counter increment" VALUE 0xa0021a52 _REC_S1VAL_20_u2 65535. _CNV_A_R_ECME_LINEA_0_CM 0. 65535. FORMAT "%5.0" /end CHARACTERISTIC
/begin CHARACTERISTIC Cxx_dfinc_inj1_scw "a_ou_cbo_inj_appitxx/Short Circuit to battery of injector 1 detected failure counter increment" VALUE 0xa0021a54 _REC_S1VAL_20_u2 65535. _CNV_A_R_ECME_LINEA_0_CM 0. 65535. FORMAT "%5.0" /end CHARACTERISTIC
/begin CHARACTERISTIC Cxx_dfinc_inj2_oc "a_ou_cbo_inj_appitxx/Open Circuit of injector 2 detected failure counter increment" VALUE 0xa0021a56 _REC_S1VAL_20_u2 65535. _CNV_A_R_ECME_LINEA_0_CM 0. 65535. FORMAT "%5.0" /end CHARACTERISTIC
/begin CHARACTERISTIC Cxx_dfinc_inj2_scg "a_ou_cbo_inj_appitxx/Short Circuit to ground of injector 2 detected failure counter increment" VALUE 0xa0021a58 _REC_S1VAL_20_u2 65535. _CNV_A_R_ECME_LINEA_0_CM 0. 65535. FORMAT "%5.0" /end CHARACTERISTIC
/begin CHARACTERISTIC Cxx_dfinc_inj2_scw "a_ou_cbo_inj_appitxx/Short Circuit to battery of injector 2 detected failure counter increment" VALUE 0xa0021a5a _REC_S1VAL_20_u2 65535. _CNV_A_R_ECME_LINEA_0_CM 0. 65535. FORMAT "%5.0" /end CHARACTERISTIC
/begin CHARACTERISTIC Cxx_dfinc_inj3_oc "a_ou_cbo_inj_appitxx/Open Circuit of injector 3 detected failure counter increment" VALUE 0xa0021a5c _REC_S1VAL_20_u2 65535. _CNV_A_R_ECME_LINEA_0_CM 0. 65535. FORMAT "%5.0" /end CHARACTERISTIC
/begin CHARACTERISTIC Cxx_dfinc_inj3_scg "a_ou_cbo_inj_appitxx/Short Circuit to ground of injector 3 detected failure counter increment" VALUE 0xa0021a5e _REC_S1VAL_20_u2 65535. _CNV_A_R_ECME_LINEA_0_CM 0. 65535. FORMAT "%5.0" /end CHARACTERISTIC
/begin CHARACTERISTIC Cxx_dfinc_inj3_scw "a_ou_cbo_inj_appitxx/Short Circuit to battery of injector 3 detected failure counter increment" VALUE 0xa0021a60 _REC_S1VAL_20_u2 65535. _CNV_A_R_ECME_LINEA_0_CM 0. 65535. FORMAT "%5.0" /end CHARACTERISTIC
/begin CHARACTERISTIC Cxx_dfinc_inj4_oc "a_ou_cbo_inj_appitxx/Open Circuit of injector 4 detected failure counter increment" VALUE 0xa0021a62 _REC_S1VAL_20_u2 65535. _CNV_A_R_ECME_LINEA_0_CM 0. 65535. FORMAT "%5.0" /end CHARACTERISTIC
/begin CHARACTERISTIC Cxx_dfinc_inj4_scg "a_ou_cbo_inj_appitxx/Short Circuit to ground of injector 4 detected failure counter increment" VALUE 0xa0021a64 _REC_S1VAL_20_u2 65535. _CNV_A_R_ECME_LINEA_0_CM 0. 65535. FORMAT "%5.0" /end CHARACTERISTIC
/begin CHARACTERISTIC Cxx_dfinc_inj4_scw "a_ou_cbo_inj_appitxx/Short Circuit to battery of injector 4 detected failure counter increment" VALUE 0xa0021a66 _REC_S1VAL_20_u2 65535. _CNV_A_R_ECME_LINEA_0_CM 0. 65535. FORMAT "%5.0" /end CHARACTERISTIC
/begin CHARACTERISTIC Cxx_inj_appl_ti1 "First applied injection fime for the first start strategy" VALUE 0xa0021a68 _REC_S1VAL_20_u4 500000. _CNV_A_R_LINEAR_____102_CM 0. 500000. FORMAT "%6.0" /end CHARACTERISTIC
/begin CHARACTERISTIC Cxx_inj_appl_ti2 "Second applied injection time for the first start strategy" VALUE 0xa0021a6c _REC_S1VAL_20_u4 500000. _CNV_A_R_LINEAR_____102_CM 0. 500000. FORMAT "%6.0" /end CHARACTERISTIC
/begin CHARACTERISTIC Cxx_inj_wht_ti_fac "Conversion factor : weight gas / injection time." VALUE 0xa0021a70 _REC_S1VAL_20_u2 999.9847412109375 _CNV_A_R_LINEAR_____401_CM 1.52587890625e-002 1000. FORMAT "%11.6" /end CHARACTERISTIC
/begin CHARACTERISTIC Cxx_inj_wht_ti_fac_alco "Conversion factor : weight alcohol / injection time." VALUE 0xa0021a72 _REC_S1VAL_20_u2 999.9847412109375 _CNV_A_R_LINEAR_____399_CM 1.52587890625e-002 1000. FORMAT "%6.2" /end CHARACTERISTIC
/begin CHARACTERISTIC Cxx_min_cp_ti "Minimum injection time for the canister purge" VALUE 0xa0021a74 _REC_S1VAL_20_u2 262140. _CNV_A_R_LINEAR_____102_CM 0. 262140. FORMAT "%6.0" /end CHARACTERISTIC
/begin CHARACTERISTIC Cxx_min_ti "Minimum injection time value" VALUE 0xa0021a76 _REC_S1VAL_20_u2 262140. _CNV_A_R_LINEAR_____102_CM 0. 262140. FORMAT "%6.0" /end CHARACTERISTIC
/begin CHARACTERISTIC Cxx_n_thd "Threshold above which the first start strategy is inhibited" VALUE 0xa0021a82 _REC_S1VAL_20_u1 8160. _CNV_A_R_LINEAR_____2_CM 0. 8160. FORMAT "%4.0" /end CHARACTERISTIC
/begin CHARACTERISTIC Cxx_sta_eng_dly "Stalling for the first start strategy" VALUE 0xa0021a78 _REC_S1VAL_20_u2 655.35 _CNV_A_R_LINEAR_____32_CM 0. 655.35 FORMAT "%6.2" /end CHARACTERISTIC
/begin CHARACTERISTIC Cxx_ti_bch "Injection time for bench mode" VALUE 0xa0021a7a _REC_S1VAL_20_u2 262140. _CNV_A_R_LINEAR_____102_CM 0. 262140. FORMAT "%6.0" /end CHARACTERISTIC
/begin MEASUREMENT Vxx_inj1_open_angl1 "First opening angle set point for cylinder 1" UBYTE _CNV_A_R_LINEAR_____325_CM 1 0. 0. 765. ECU_ADDRESS 0xd0006ed5 FORMAT "%3.0" /end MEASUREMENT
/begin MEASUREMENT Vxx_inj1_open_angl2 "Second opening angle set point for cylinder 1" UBYTE _CNV_A_R_LINEAR_____325_CM 1 0. 0. 765. ECU_ADDRESS 0xd0006ed6 FORMAT "%3.0" /end MEASUREMENT
/begin MEASUREMENT Vxx_inj1_pinj_open_angl "Preinjection opening angle set point for injector 1" UBYTE _CNV_A_R_LINEAR_____325_CM 1 0. 0. 765. ECU_ADDRESS 0xd0006ed7 FORMAT "%3.0" /end MEASUREMENT
/begin MEASUREMENT Vxx_inj2_open_angl1 "First opening angle set point for cylinder 2" UBYTE _CNV_A_R_LINEAR_____325_CM 1 0. 0. 765. ECU_ADDRESS 0xd0006ed8 FORMAT "%3.0" /end MEASUREMENT
/begin MEASUREMENT Vxx_inj2_open_angl2 "Second opening angle set point for cylinder 2" UBYTE _CNV_A_R_LINEAR_____325_CM 1 0. 0. 765. ECU_ADDRESS 0xd0006ed9 FORMAT "%3.0" /end MEASUREMENT
/begin MEASUREMENT Vxx_inj2_pinj_open_angl "Preinjection opening angle set point for injector 2" UBYTE _CNV_A_R_LINEAR_____325_CM 1 0. 0. 765. ECU_ADDRESS 0xd0006eda FORMAT "%3.0" /end MEASUREMENT
/begin MEASUREMENT Vxx_inj3_open_angl1 "First opening angle set point for cylinder 3" UBYTE _CNV_A_R_LINEAR_____325_CM 1 0. 0. 765. ECU_ADDRESS 0xd0006edb FORMAT "%3.0" /end MEASUREMENT
/begin MEASUREMENT Vxx_inj3_open_angl2 "Second opening angle set point for cylinder 3" UBYTE _CNV_A_R_LINEAR_____325_CM 1 0. 0. 765. ECU_ADDRESS 0xd0006edc FORMAT "%3.0" /end MEASUREMENT
/begin MEASUREMENT Vxx_inj3_pinj_open_angl "Preinjection opening angle set point for injector 3" UBYTE _CNV_A_R_LINEAR_____325_CM 1 0. 0. 765. ECU_ADDRESS 0xd0006edd FORMAT "%3.0" /end MEASUREMENT
/begin MEASUREMENT Vxx_inj4_open_angl1 "First opening angle set point for cylinder 4" UBYTE _CNV_A_R_LINEAR_____325_CM 1 0. 0. 765. ECU_ADDRESS 0xd0006ede FORMAT "%3.0" /end MEASUREMENT
/begin MEASUREMENT Vxx_inj4_open_angl2 "Second opening angle set point for cylinder 4" UBYTE _CNV_A_R_LINEAR_____325_CM 1 0. 0. 765. ECU_ADDRESS 0xd0006edf FORMAT "%3.0" /end MEASUREMENT
/begin MEASUREMENT Vxx_inj4_pinj_open_angl "Preinjection opening angle set point for injector 4" UBYTE _CNV_A_R_LINEAR_____325_CM 1 0. 0. 765. ECU_ADDRESS 0xd0006ee0 FORMAT "%3.0" /end MEASUREMENT
/begin CHARACTERISTIC Cxx_seq_open_angl_max "Maximum value for injector opening angle in sequential mode" VALUE 0xa0021a88 _REC_S1VAL_20_u1 765. _CNV_A_R_LINEAR_____325_CM 0. 765. FORMAT "%3.0" /end CHARACTERISTIC
/begin CHARACTERISTIC Cxx_sfg_open_angl1_max "Maximum value for first injector opening angle in SFG-TRS mode" VALUE 0xa0021a89 _REC_S1VAL_20_u1 765. _CNV_A_R_LINEAR_____325_CM 0. 765. FORMAT "%3.0" /end CHARACTERISTIC
/begin CHARACTERISTIC Cxx_sfg_open_angl2_max "Maximum value for second injector opening angle in SFG-TRS mode" VALUE 0xa0021a8a _REC_S1VAL_20_u1 765. _CNV_A_R_LINEAR_____325_CM 0. 765. FORMAT "%3.0" /end CHARACTERISTIC
/begin CHARACTERISTIC Cxx_sta_inj_sta_angl "Opening angle for start injection mode" VALUE 0xa0021a8b _REC_S1VAL_20_u1 765. _CNV_A_R_LINEAR_____325_CM 0. 765. FORMAT "%3.0" /end CHARACTERISTIC
/begin MEASUREMENT Vbx_inj1_not_open "Indicates if injector 1 should be curently open if it was not disabled." UBYTE _CNV_S_2_RANGE______3_CM 1 0. 0. 1. ECU_ADDRESS 0xd0006eeb BIT_MASK 0x1 /end MEASUREMENT
/begin MEASUREMENT Vbx_inj1_open "Indicates if injector 1 is curently open." UBYTE _CNV_S_2_RANGE______3_CM 1 0. 0. 1. ECU_ADDRESS 0xd0006eec BIT_MASK 0x1 /end MEASUREMENT
/begin MEASUREMENT Vbx_inj2_not_open "Indicates if injector 2 should be curently open if it was not disabled." UBYTE _CNV_S_2_RANGE______3_CM 1 0. 0. 1. ECU_ADDRESS 0xd0006eed BIT_MASK 0x1 /end MEASUREMENT
/begin MEASUREMENT Vbx_inj2_open "Indicates if injector 2 is curently open." UBYTE _CNV_S_2_RANGE______3_CM 1 0. 0. 1. ECU_ADDRESS 0xd0006eee BIT_MASK 0x1 /end MEASUREMENT
/begin MEASUREMENT Vbx_inj3_not_open "Indicates if injector 3 should be curently open if it was not disabled." UBYTE _CNV_S_2_RANGE______3_CM 1 0. 0. 1. ECU_ADDRESS 0xd0006eef BIT_MASK 0x1 /end MEASUREMENT
/begin MEASUREMENT Vbx_inj3_open "Indicates if injector 3 is curently open." UBYTE _CNV_S_2_RANGE______3_CM 1 0. 0. 1. ECU_ADDRESS 0xd0006ef0 BIT_MASK 0x1 /end MEASUREMENT
/begin MEASUREMENT Vbx_inj4_not_open "Indicates if injector 4 should be curently open if it was not disabled." UBYTE _CNV_S_2_RANGE______3_CM 1 0. 0. 1. ECU_ADDRESS 0xd0006ef1 BIT_MASK 0x1 /end MEASUREMENT
/begin MEASUREMENT Vbx_inj4_open "Indicates if injector 4 is curently open." UBYTE _CNV_S_2_RANGE______3_CM 1 0. 0. 1. ECU_ADDRESS 0xd0006ef2 BIT_MASK 0x1 /end MEASUREMENT
/begin MEASUREMENT Vbx_cho_cam_ctr_init "Choice of the Camshaft wheel counter (Vxx_in_cam_ctr) intialisation" UBYTE _CNV_S_2_RANGE______3_CM 1 0. 0. 1. ECU_ADDRESS 0xd00061ee BIT_MASK 0x1 /end MEASUREMENT
/begin MEASUREMENT Vbx_df_crk_chr "High number of invalid crankshaft teeth detected failure" UBYTE _CNV_S_2_RANGE______3_CM 1 0. 0. 1. ECU_ADDRESS 0xd00061ef BIT_MASK 0x1 /end MEASUREMENT
/begin MEASUREMENT Vbx_df_crk_cmp "Incorrect number of crankshaft teeth detected failure" UBYTE _CNV_S_2_RANGE______3_CM 1 0. 0. 1. ECU_ADDRESS 0xd00061f0 BIT_MASK 0x1 /end MEASUREMENT
/begin MEASUREMENT Vbx_df_crk_cyc "Interference between two crankshaft teeth detected failure" UBYTE _CNV_S_2_RANGE______3_CM 1 0. 0. 1. ECU_ADDRESS 0xd00061f1 BIT_MASK 0x1 /end MEASUREMENT
/begin MEASUREMENT Vbx_df_crk_no_sig_wit_cam "Absence of crankshaft signal detected failure for engine with camshaft sensor" UBYTE _CNV_S_2_RANGE______3_CM 1 0. 0. 1. ECU_ADDRESS 0xd00061f2 BIT_MASK 0x1 /end MEASUREMENT
/begin MEASUREMENT Vbx_df_crk_oc "Open circuit of one of the leads of crankshaft sensor detected failure" UBYTE _CNV_S_2_RANGE______3_CM 1 0. 0. 1. ECU_ADDRESS 0xd00061f3 BIT_MASK 0x1 /end MEASUREMENT
/begin MEASUREMENT Vbx_df_crk_shp "No detection of crankshaft reference detected failure" UBYTE _CNV_S_2_RANGE______3_CM 1 0. 0. 1. ECU_ADDRESS 0xd00061f4 BIT_MASK 0x1 /end MEASUREMENT
/begin MEASUREMENT Vbx_df_in_cam_chr "Incoherency of intake camshaft signal detected failure" UBYTE _CNV_S_2_RANGE______3_CM 1 0. 0. 1. ECU_ADDRESS 0xd00061f5 BIT_MASK 0x1 /end MEASUREMENT
/begin MEASUREMENT Vbx_df_in_cam_crk_cmp "Correlation between camshaft and crankshaft signals detected failure" UBYTE _CNV_S_2_RANGE______3_CM 1 0. 0. 1. ECU_ADDRESS 0xd00061f6 BIT_MASK 0x1 /end MEASUREMENT
/begin MEASUREMENT Vbx_df_in_cam_cyc "Interference close to a intake camshaft edge detected failure" UBYTE _CNV_S_2_RANGE______3_CM 1 0. 0. 1. ECU_ADDRESS 0xd00061f7 BIT_MASK 0x1 /end MEASUREMENT
/begin MEASUREMENT Vbx_df_in_cam_no_sig "Absence of intake camshaft signal detected failure" UBYTE _CNV_S_2_RANGE______3_CM 1 0. 0. 1. ECU_ADDRESS 0xd00061f8 BIT_MASK 0x1 /end MEASUREMENT
/begin MEASUREMENT Vbx_df_in_cam_nok "Camshaft signal invalid for synchronization detected failure" UBYTE _CNV_S_2_RANGE______3_CM 1 0. 0. 1. ECU_ADDRESS 0xd00061f9 BIT_MASK 0x1 /end MEASUREMENT
/begin MEASUREMENT Vbx_diag_ena_crk_chr "High number of invalid crankshaft teeth diagnosis authorization" UBYTE _CNV_S_2_RANGE______3_CM 1 0. 0. 1. ECU_ADDRESS 0xd00061fa BIT_MASK 0x1 /end MEASUREMENT
/begin MEASUREMENT Vbx_diag_ena_crk_cmp "Incorrect number of crankshaft teeth diagnosis authorization" UBYTE _CNV_S_2_RANGE______3_CM 1 0. 0. 1. ECU_ADDRESS 0xd00061fb BIT_MASK 0x1 /end MEASUREMENT
/begin MEASUREMENT Vbx_diag_ena_crk_cyc "Interference between two crankshaft teeth diagnosis authorization" UBYTE _CNV_S_2_RANGE______3_CM 1 0. 0. 1. ECU_ADDRESS 0xd00061fc BIT_MASK 0x1 /end MEASUREMENT
/begin MEASUREMENT Vbx_diag_ena_crk_no_sig_wit_cam "Absence of crankshaft signal diagnosis authorization for engine with camshaft sensor" UBYTE _CNV_S_2_RANGE______3_CM 1 0. 0. 1. ECU_ADDRESS 0xd00061fd BIT_MASK 0x1 /end MEASUREMENT
/begin MEASUREMENT Vbx_diag_ena_crk_oc "Open circuit of one of the leads of crankshaft sensor diagnosis authorization" UBYTE _CNV_S_2_RANGE______3_CM 1 0. 0. 1. ECU_ADDRESS 0xd00061fe BIT_MASK 0x1 /end MEASUREMENT
/begin MEASUREMENT Vbx_diag_ena_crk_shp "No detection of crankshaft reference diagnosis authorization" UBYTE _CNV_S_2_RANGE______3_CM 1 0. 0. 1. ECU_ADDRESS 0xd00061ff BIT_MASK 0x1 /end MEASUREMENT
/begin MEASUREMENT Vbx_diag_ena_in_cam_chr "Incoherency of intake camshaft signal diagnosis authorization" UBYTE _CNV_S_2_RANGE______3_CM 1 0. 0. 1. ECU_ADDRESS 0xd0006200 BIT_MASK 0x1 /end MEASUREMENT
/begin MEASUREMENT Vbx_diag_ena_in_cam_crk_cmp "Correlation between camshaft and crankshaft signals diagnosis authorization" UBYTE _CNV_S_2_RANGE______3_CM 1 0. 0. 1. ECU_ADDRESS 0xd0006201 BIT_MASK 0x1 /end MEASUREMENT
/begin MEASUREMENT Vbx_diag_ena_in_cam_cyc "Interference close to a intake camshaft edge diagnosis authorization" UBYTE _CNV_S_2_RANGE______3_CM 1 0. 0. 1. ECU_ADDRESS 0xd0006202 BIT_MASK 0x1 /end MEASUREMENT
/begin MEASUREMENT Vbx_diag_ena_in_cam_no_sig "Absence of intake camshaft signal diagnosis authorization" UBYTE _CNV_S_2_RANGE______3_CM 1 0. 0. 1. ECU_ADDRESS 0xd0006203 BIT_MASK 0x1 /end MEASUREMENT
/begin MEASUREMENT Vbx_diag_ena_in_cam_nok "Camshaft signal invalid for synchronization diagnosis authorization" UBYTE _CNV_S_2_RANGE______3_CM 1 0. 0. 1. ECU_ADDRESS 0xd0006204 BIT_MASK 0x1 /end MEASUREMENT
/begin MEASUREMENT Vbx_n_inv "The engine rotates in the wrong direction" UBYTE _CNV_S_2_RANGE______3_CM 1 0. 0. 1. ECU_ADDRESS 0xd0006205 BIT_MASK 0x1 /end MEASUREMENT
/begin MEASUREMENT Vbx_raw_eng_syn "Raw value engine synchronization" UBYTE _CNV_S_2_RANGE______3_CM 1 0. 0. 1. ECU_ADDRESS 0xd0006206 BIT_MASK 0x1 /end MEASUREMENT
/begin MEASUREMENT Vbx_raw_in_cam_lvl "Raw value intake camshaft level" UBYTE _CNV_S_2_RANGE______3_CM 1 0. 0. 1. ECU_ADDRESS 0xd0006207 BIT_MASK 0x1 /end MEASUREMENT
/begin MEASUREMENT Vbx_raw_trz_clc_ena "TLZ/TRZ calculation enabled, data from basic software" UBYTE _CNV_S_2_RANGE______3_CM 1 0. 0. 1. ECU_ADDRESS 0xd0006208 BIT_MASK 0x1 /end MEASUREMENT
/begin MEASUREMENT Vxx_raw_eng_angl "Basic angular position of engine" UWORD _CNV_A_R_LINEAR_____129_CM 1 0. 0. 720. ECU_ADDRESS 0xd0003c78 FORMAT "%5.2" /end MEASUREMENT
/begin MEASUREMENT Vxx_raw_in_cam_toth_per "raw value of Duration between two intake camshaft events" UWORD _CNV_A_R_LINEAR_____202_CM 1 0. 0. 65535. ECU_ADDRESS 0xd0003c7a FORMAT "%5.0" /end MEASUREMENT
/begin MEASUREMENT Vxx_raw_n "Engine speed from supplier" UWORD _CNV_A_R_ENSD_LINEA_22_CM 1 0. 0. 16383.75 ECU_ADDRESS 0xd0003c7c FORMAT "%8.2" /end MEASUREMENT
/begin MEASUREMENT Vxx_raw_tdc_ctr "Raw value TDC counter" UBYTE _CNV_A_R_LINEAR_____101_CM 1 0. 0. 3. ECU_ADDRESS 0xd000620b FORMAT "%1.0" /end MEASUREMENT
/begin MEASUREMENT Vxx_raw_tdc_per "tdc period (32 bits) from supplier" ULONG _CNV_A_R_LINEAR_____370_CM 1 0. 0. 1. ECU_ADDRESS 0xd00023d8 FORMAT "%8.7" /end MEASUREMENT
/begin MEASUREMENT Vxx_raw_trz_t_toth_0 "Duration of 5 teeth package, data from basic software" ULONG _CNV_A_R_LINEAR_____372_CM 1 0. 0. 52428800. ECU_ADDRESS 0xd00023dc FORMAT "%8.0" /end MEASUREMENT
/begin MEASUREMENT Vxx_raw_trz_t_toth_0_nxt "Duration of 5 teeth package, data from basic software" ULONG _CNV_A_R_LINEAR_____372_CM 1 0. 0. 52428800. ECU_ADDRESS 0xd00023e0 FORMAT "%8.0" /end MEASUREMENT
/begin MEASUREMENT Vxx_raw_trz_t_toth_1 "Duration of 5 teeth package, data from basic software" ULONG _CNV_A_R_LINEAR_____372_CM 1 0. 0. 52428800. ECU_ADDRESS 0xd00023e4 FORMAT "%8.0" /end MEASUREMENT
/begin MEASUREMENT Vxx_raw_trz_t_toth_2 "Duration of 5 teeth package, data from basic software" ULONG _CNV_A_R_LINEAR_____372_CM 1 0. 0. 52428800. ECU_ADDRESS 0xd00023e8 FORMAT "%8.0" /end MEASUREMENT
/begin MEASUREMENT Vxx_raw_trz_t_toth_3 "Duration of 5 teeth package, data from basic software" ULONG _CNV_A_R_LINEAR_____372_CM 1 0. 0. 52428800. ECU_ADDRESS 0xd00023ec FORMAT "%8.0" /end MEASUREMENT
/begin MEASUREMENT Vxx_raw_trz_t_toth_4 "Duration of 5 teeth package, data from basic software" ULONG _CNV_A_R_LINEAR_____372_CM 1 0. 0. 52428800. ECU_ADDRESS 0xd00023f0 FORMAT "%8.0" /end MEASUREMENT
/begin MEASUREMENT Vxx_raw_trz_t_toth_5 "Duration of 5 teeth package, data from basic software" ULONG _CNV_A_R_LINEAR_____372_CM 1 0. 0. 52428800. ECU_ADDRESS 0xd00023f4 FORMAT "%8.0" /end MEASUREMENT
/begin MEASUREMENT Vxx_raw_trz_t_toth_5_prev "Duration of 5 teeth package, data from basic software" ULONG _CNV_A_R_LINEAR_____372_CM 1 0. 0. 52428800. ECU_ADDRESS 0xd00023f8 FORMAT "%8.0" /end MEASUREMENT
/begin MEASUREMENT lv_es "Engine operating state \"Engine stopped\"" UBYTE _CNV_S_2_RANGE______3_CM 1 0. 0. 1. ECU_ADDRESS 0xd0006209 BIT_MASK 0x1 /end MEASUREMENT
/begin MEASUREMENT lv_st "Engine operating state \"Start\"" UBYTE _CNV_S_2_RANGE______3_CM 1 0. 0. 1. ECU_ADDRESS 0xd000620a BIT_MASK 0x1 /end MEASUREMENT
/begin MEASUREMENT Vbx_mem_sta_gas_pump "Memorized state of the priming of the gas pump" UBYTE _CNV_S_2_RANGE______3_CM 1 0. 0. 1. DISPLAY_IDENTIFIER OuCboFuo_NVM.Vbx_mem_sta_gas_pump_NVM ECU_ADDRESS 0xd0004648 BIT_MASK 0x1 /end MEASUREMENT
/begin MEASUREMENT Vbx_cpl_sta_gas_pump "Additional state of the priming of the gas pump" UBYTE _CNV_S_2_RANGE______3_CM 1 0. 0. 1. DISPLAY_IDENTIFIER OuCboFuo_NVM.Vbx_cpl_sta_gas_pump_NVM ECU_ADDRESS 0xd0004649 BIT_MASK 0x1 /end MEASUREMENT
/begin MEASUREMENT Vxx_csm "fuel consumption" UWORD _CNV_A_R_LINEAR_____402_CM 1 0. 0. 100. ECU_ADDRESS 0xd0005fa6 FORMAT "%6.2" /end MEASUREMENT
/begin MEASUREMENT Vxx_csm_sum_mux "Total fuel consumption" UBYTE _CNV_A_R_LINEAR_____403_CM 1 0. 0. 20400. ECU_ADDRESS 0xd0007c38 FORMAT "%5.0" /end MEASUREMENT
/begin MEASUREMENT Vxx_fim_sum_mux_2 "Gas consumption for the mux" ULONG _CNV_A_R_LINEAR_____133_CM 1 0. 0. 4800. ECU_ADDRESS 0xd000294c FORMAT "%12.3" /end MEASUREMENT
/begin MEASUREMENT Vxx_fuel_wht_vol_fac "Convertion factor : volume / weight gas considering alcohol" UBYTE _CNV_A_R_LINEAR_____404_CM 1 0. 1. 1.498046875 ECU_ADDRESS 0xd0006e9d FORMAT "%5.3" /end MEASUREMENT
/begin CHARACTERISTIC Cxx_adac_fim_ofs "Offset to adjust the ADAC consumption" VALUE 0xa002199c _REC_S1VAL_20_s2 2.6 _CNV_A_R_LINEAR_____405_CM -1.3 1.3 FORMAT "%8.5" /end CHARACTERISTIC
/begin CHARACTERISTIC Cxx_fuel_wht_vol_fac "Conversion factor : volume / weight gas" VALUE 0xa002199e _REC_S1VAL_20_u1 0.498046875 _CNV_A_R_LINEAR_____404_CM 1. 1.498046875 FORMAT "%5.3" /end CHARACTERISTIC
/begin CHARACTERISTIC Cxx_fuel_wht_vol_fac_alco "Convertion factor : volume / weight gas for alcohol" VALUE 0xa002199f _REC_S1VAL_20_u1 0.498046875 _CNV_A_R_LINEAR_____404_CM 1. 1.498046875 FORMAT "%5.3" /end CHARACTERISTIC
/begin MEASUREMENT Vsx_cp_vld "Canister purge validity status" UBYTE _CNV_A_R_ECME_LINEA_0_CM 1 0. 0. 2. ECU_ADDRESS 0xd0007c39 FORMAT "%1.0" /end MEASUREMENT
/begin CHARACTERISTIC Cxx_dfdec_cp_oc "Open Circuit of Canister Purge detected failure counter decrement" VALUE 0xa00219a0 _REC_S1VAL_20_u2 65535. _CNV_A_R_ECME_LINEA_0_CM 0. 65535. FORMAT "%5.0" /end CHARACTERISTIC
/begin CHARACTERISTIC Cxx_dfdec_cp_scg "Short Circuit to ground of Canister Purge detected failure counter decrement" VALUE 0xa00219a2 _REC_S1VAL_20_u2 65535. _CNV_A_R_ECME_LINEA_0_CM 0. 65535. FORMAT "%5.0" /end CHARACTERISTIC
/begin CHARACTERISTIC Cxx_dfdec_cp_scw "Short Circuit to battery of Canister Purge detected failure counter decrement" VALUE 0xa00219a4 _REC_S1VAL_20_u2 65535. _CNV_A_R_ECME_LINEA_0_CM 0. 65535. FORMAT "%5.0" /end CHARACTERISTIC
/begin CHARACTERISTIC Cxx_dfinc_cp_oc "Open Circuit of Canister Purge detected failure counter increment" VALUE 0xa00219a6 _REC_S1VAL_20_u2 65535. _CNV_A_R_ECME_LINEA_0_CM 0. 65535. FORMAT "%5.0" /end CHARACTERISTIC
/begin CHARACTERISTIC Cxx_dfinc_cp_scg "Short Circuit to ground of Canister Purge detected failure counter increment" VALUE 0xa00219a8 _REC_S1VAL_20_u2 65535. _CNV_A_R_ECME_LINEA_0_CM 0. 65535. FORMAT "%5.0" /end CHARACTERISTIC
/begin CHARACTERISTIC Cxx_dfinc_cp_scw "Short Circuit to battery of Canister Purge detected failure counter increment" VALUE 0xa00219aa _REC_S1VAL_20_u2 65535. _CNV_A_R_ECME_LINEA_0_CM 0. 65535. FORMAT "%5.0" /end CHARACTERISTIC
/begin MEASUREMENT Vbx_gas_pump_rly_cmd "State of the gas pump relay control" UBYTE _CNV_S_2_RANGE______3_CM 1 0. 0. 1. ECU_ADDRESS 0xd0007c3d BIT_MASK 0x1 /end MEASUREMENT
/begin MEASUREMENT Vbx_sta_gas_pump "State of the priming of the gas pump" UBYTE _CNV_S_2_RANGE______3_CM 1 0. 0. 1. ECU_ADDRESS 0xd0007c3e BIT_MASK 0x1 /end MEASUREMENT
/begin MEASUREMENT Vsx_gas_pump_vld "Gas pump validity status" UBYTE _CNV_S_3_STATUS_OK__213_CM 1 0. 0. 2. ECU_ADDRESS 0xd0007c3f /end MEASUREMENT
/begin MEASUREMENT Vxx_gas_pump_dly "Temporization of gas pump relay" UWORD _CNV_A_R_LINEAR_____116_CM 1 0. 0. 65.535 ECU_ADDRESS 0xd0005fa8 /end MEASUREMENT
/begin CHARACTERISTIC Cbx_gas_pump_fast_stop "Configuration of the gas pump quick cut" VALUE 0xa00219e8 _REC_S1VAL_20_u1 1. _CNV_A_R_ECME_LINEA_0_CM 0. 1. FORMAT "%1.0" BIT_MASK 0x1 /end CHARACTERISTIC
/begin CHARACTERISTIC Cxx_dfdec_gas_pump_oc "a_ou_cbo_fuo_pmpcdxx/Open circuit of gas pump detected failure counter decrement" VALUE 0xa00219d8 _REC_S1VAL_20_u2 65535. _CNV_A_R_ECME_LINEA_0_CM 0. 65535. FORMAT "%5.0" /end CHARACTERISTIC
/begin CHARACTERISTIC Cxx_dfdec_gas_pump_scg "a_ou_cbo_fuo_pmpcdxx/Short Circuit to ground of gas pump detected failure counter decrement" VALUE 0xa00219da _REC_S1VAL_20_u2 65535. _CNV_A_R_ECME_LINEA_0_CM 0. 65535. FORMAT "%5.0" /end CHARACTERISTIC
/begin CHARACTERISTIC Cxx_dfdec_gas_pump_scw "a_ou_cbo_fuo_pmpcdxx/Short Circuit to battery of gas pump detected failure counter decrement" VALUE 0xa00219dc _REC_S1VAL_20_u2 65535. _CNV_A_R_ECME_LINEA_0_CM 0. 65535. FORMAT "%5.0" /end CHARACTERISTIC
/begin CHARACTERISTIC Cxx_dfinc_gas_pump_oc "a_ou_cbo_fuo_pmpcdxx/Open circuit of gas pump detected failure counter increment" VALUE 0xa00219de _REC_S1VAL_20_u2 65535. _CNV_A_R_ECME_LINEA_0_CM 0. 65535. FORMAT "%5.0" /end CHARACTERISTIC
/begin CHARACTERISTIC Cxx_dfinc_gas_pump_scg "a_ou_cbo_fuo_pmpcdxx/Short Circuit to ground of gas pump detected failure counter increment" VALUE 0xa00219e0 _REC_S1VAL_20_u2 65535. _CNV_A_R_ECME_LINEA_0_CM 0. 65535. FORMAT "%5.0" /end CHARACTERISTIC
/begin CHARACTERISTIC Cxx_dfinc_gas_pump_scw "a_ou_cbo_fuo_pmpcdxx/Short Circuit to battery of gas pump detected failure counter increment" VALUE 0xa00219e2 _REC_S1VAL_20_u2 65535. _CNV_A_R_ECME_LINEA_0_CM 0. 65535. FORMAT "%5.0" /end CHARACTERISTIC
/begin CHARACTERISTIC Cxx_gas_pump_sta_dly "Duration of the priming of the gas pump" VALUE 0xa00219e4 _REC_S1VAL_20_u2 65.535 _CNV_A_R_LINEAR_____116_CM 0. 65.535 /end CHARACTERISTIC
/begin CHARACTERISTIC Cxx_sta_gas_pump_n_thd "Engine speed upper limit for the deactivation of the priming of the pump " VALUE 0xa00219e6 _REC_S1VAL_20_u2 16383.75 _CNV_A_R_ENSD_LINEA_22_CM 0. 16383.75 FORMAT "%8.2" /end CHARACTERISTIC
/begin MEASUREMENT Vbx_ad_fuel_tk_cfm "Additionnal fuel tank is present or not" UBYTE _CNV_S_2_RANGE______3_CM 1 0. 0. 1. ECU_ADDRESS 0xd0006ea9 BIT_MASK 0x1 /end MEASUREMENT
/begin MEASUREMENT Vbx_eva_sldv_cfm "Evaporation Shut-Off Valve is present or not" UBYTE _CNV_S_2_RANGE______3_CM 1 0. 0. 1. ECU_ADDRESS 0xd0006eaa BIT_MASK 0x1 /end MEASUREMENT
/begin MEASUREMENT Vbx_fuel_csm_wf_cfm "ADAC Wire-frame configuration" UBYTE _CNV_S_2_RANGE______3_CM 1 0. 0. 1. ECU_ADDRESS 0xd0006eab BIT_MASK 0x1 /end MEASUREMENT
/begin CHARACTERISTIC Cbx_ad_fuel_tk_cfm "Additionnal fuel tank configuration" VALUE 0xa00219f7 _REC_S1VAL_20_u1 1. _CNV_A_R_ECME_LINEA_0_CM 0. 1. FORMAT "%1.0" BIT_MASK 0x1 /end CHARACTERISTIC
/begin CHARACTERISTIC Cbx_eva_sldv_cfm "Evaporation Shut-Off Valve is present or not" VALUE 0xa00219f8 _REC_S1VAL_20_u1 1. _CNV_A_R_ECME_LINEA_0_CM 0. 1. FORMAT "%1.0" BIT_MASK 0x1 /end CHARACTERISTIC
/begin CHARACTERISTIC Cbx_fuel_csm_wf_cfm "ADAC Wire-frame configuration" VALUE 0xa00219f9 _REC_S1VAL_20_u1 1. _CNV_A_R_ECME_LINEA_0_CM 0. 1. FORMAT "%1.0" BIT_MASK 0x1 /end CHARACTERISTIC
/begin MEASUREMENT Vsx_evap_sldv_vld "Shut-off valve validity status" UBYTE _CNV_S_3_STATUS_OK__179_CM 1 0. 0. 2. ECU_ADDRESS 0xd0007c3c /end MEASUREMENT
/begin CHARACTERISTIC Cxx_dfdec_eva_sldv_oc "Open circuit on shut-off valve command detected failure counter decrement" VALUE 0xa00219cc _REC_S1VAL_20_u2 65535. _CNV_A_R_ECME_LINEA_0_CM 0. 65535. FORMAT "%5.0" /end CHARACTERISTIC
/begin CHARACTERISTIC Cxx_dfdec_eva_sldv_scg "Short circuit to ground on shut-off valve command detected failure counter decrement" VALUE 0xa00219ce _REC_S1VAL_20_u2 65535. _CNV_A_R_ECME_LINEA_0_CM 0. 65535. FORMAT "%5.0" /end CHARACTERISTIC
/begin CHARACTERISTIC Cxx_dfdec_eva_sldv_scw "Short circuit to battery on shut-off valve command detected failure counter decrement" VALUE 0xa00219d0 _REC_S1VAL_20_u2 65535. _CNV_A_R_ECME_LINEA_0_CM 0. 65535. FORMAT "%5.0" /end CHARACTERISTIC
/begin CHARACTERISTIC Cxx_dfinc_eva_sldv_oc "Open circuit on shut-off valve command detected failure counter increment" VALUE 0xa00219d2 _REC_S1VAL_20_u2 65535. _CNV_A_R_ECME_LINEA_0_CM 0. 65535. FORMAT "%5.0" /end CHARACTERISTIC
/begin CHARACTERISTIC Cxx_dfinc_eva_sldv_scg "Short circuit to ground on shut-off valve command detected failure counter increment" VALUE 0xa00219d4 _REC_S1VAL_20_u2 65535. _CNV_A_R_ECME_LINEA_0_CM 0. 65535. FORMAT "%5.0" /end CHARACTERISTIC
/begin CHARACTERISTIC Cxx_dfinc_eva_sldv_scw "Short circuit to battery on shut-off valve command detected failure counter increment" VALUE 0xa00219d6 _REC_S1VAL_20_u2 65535. _CNV_A_R_ECME_LINEA_0_CM 0. 65535. FORMAT "%5.0" /end CHARACTERISTIC
/begin MEASUREMENT Vbx_sta_gaz_pump_cmd "Starting of the pump of additionnal fuel tank" UBYTE _CNV_S_2_RANGE______3_CM 1 0. 0. 1. ECU_ADDRESS 0xd0007c40 BIT_MASK 0x1 /end MEASUREMENT
/begin MEASUREMENT Vsx_gas_pump_2_vld "Fuel additional tank pump validity status" UBYTE _CNV_S_3_STATUS_OK__179_CM 1 0. 0. 2. ECU_ADDRESS 0xd0007c41 /end MEASUREMENT
/begin CHARACTERISTIC Cbx_sta_pump_bch_cmd "Bench mode activation for additional fuel tank pump" VALUE 0xa00219f6 _REC_S1VAL_20_u1 1. _CNV_A_R_ECME_LINEA_0_CM 0. 1. FORMAT "%1.0" BIT_MASK 0x1 /end CHARACTERISTIC
/begin CHARACTERISTIC Cxx_dfdec_gas_pump_2_oc "Pump for fuel additionnal tank open circuit detected failure counter decrement" VALUE 0xa00219ea _REC_S1VAL_20_u2 65535. _CNV_A_R_ECME_LINEA_0_CM 0. 65535. FORMAT "%5.0" /end CHARACTERISTIC
/begin CHARACTERISTIC Cxx_dfdec_gas_pump_2_scg "Pump for fuel additionnal tank short circuit to ground detected failure counter decrement" VALUE 0xa00219ec _REC_S1VAL_20_u2 65535. _CNV_A_R_ECME_LINEA_0_CM 0. 65535. FORMAT "%5.0" /end CHARACTERISTIC
/begin CHARACTERISTIC Cxx_dfdec_gas_pump_2_scw "Pump for fuel additionnal tank short circuit to power supply detected failure counter decrement" VALUE 0xa00219ee _REC_S1VAL_20_u2 65535. _CNV_A_R_ECME_LINEA_0_CM 0. 65535. FORMAT "%5.0" /end CHARACTERISTIC
/begin CHARACTERISTIC Cxx_dfinc_gas_pump_2_oc "Pump for fuel additionnal tank open circuit detected failure counter increment" VALUE 0xa00219f0 _REC_S1VAL_20_u2 65535. _CNV_A_R_ECME_LINEA_0_CM 0. 65535. FORMAT "%5.0" /end CHARACTERISTIC
/begin CHARACTERISTIC Cxx_dfinc_gas_pump_2_scg "Pump for fuel additionnal tank short circuit to ground detected failure counter increment" VALUE 0xa00219f2 _REC_S1VAL_20_u2 65535. _CNV_A_R_ECME_LINEA_0_CM 0. 65535. FORMAT "%5.0" /end CHARACTERISTIC
/begin CHARACTERISTIC Cxx_dfinc_gas_pump_2_scw "Pump for fuel additionnal tank short circuit to power supply detected failure counter increment" VALUE 0xa00219f4 _REC_S1VAL_20_u2 65535. _CNV_A_R_ECME_LINEA_0_CM 0. 65535. FORMAT "%5.0" /end CHARACTERISTIC
/begin AXIS_PTS Ctb_alco_rat "Breakpoints of alcohol rate" 0xa002ef5c Vxx_sta_fuel_typ_rat _REC_A2AXS_20_u2 1. _CNV_A_R_LINEAR_____161_CM 10 0. 1. FORMAT "%5.3" /end AXIS_PTS
/begin AXIS_PTS Ctb_tco_sta_sldv "Coolant temperature breakpoints for starting set point tables" 0xa002ef74 Vxx_tco _REC_A2AXS_20_u2 240. _CNV_A_R_LINEAR_____110_CM 8 -40. 200. FORMAT "%5.1" /end AXIS_PTS
/begin AXIS_PTS Ctb_vb "9-breakpoint table for battery voltage" 0xa002ef88 Vxx_vb _REC_A2AXS_20_u2 60. _CNV_A_R_LINEAR_____205_CM 9 0. 60. FORMAT "%5.2" /end AXIS_PTS
/begin CHARACTERISTIC Ctp_alco_rat_pwm_cor "Correction factor for PWM calulation depending on alcohol rate" CURVE 0xa002ef9c _REC_A1CUR_20_u1_u2 100. _CNV_A_R_LINEAR_____406_CM -50. 50. FORMAT "%9.5"
 /begin AXIS_DESCR COM_AXIS Vxx_sta_fuel_typ_rat _CNV_A_R_LINEAR_____161_CM 10 0. 1. FORMAT "%5.3" AXIS_PTS_REF Ctb_alco_rat /end AXIS_DESCR
/end CHARACTERISTIC
/begin CHARACTERISTIC Ctp_fill_sta_sldv_dly "Electrovalve activation delay with only one value which depends on coolant temperature" CURVE 0xa002efa8 _REC_A1CUR_20_u2_u2 10.2 _CNV_A_R_LINEAR_____208_CM 0. 10.2 FORMAT "%4.2"
 /begin AXIS_DESCR COM_AXIS Vxx_tco _CNV_A_R_LINEAR_____110_CM 8 -40. 200. FORMAT "%5.1" AXIS_PTS_REF Ctb_tco_sta_sldv /end AXIS_DESCR
/end CHARACTERISTIC
/begin CHARACTERISTIC Ctp_n_pwm_cor "Correction table for PWM calulation depending on engine speed" CURVE 0xa002efb8 _REC_A1CUR_20_u1_u2 100. _CNV_A_R_LINEAR_____406_CM -50. 50. FORMAT "%9.5"
 /begin AXIS_DESCR COM_AXIS Vxx_n _CNV_A_R_ENSD_LINEA_22_CM 20 0. 16383.75 FORMAT "%8.2" AXIS_PTS_REF Ctb_n /end AXIS_DESCR
/end CHARACTERISTIC
/begin CHARACTERISTIC Ctp_prs_pwm_cor "Correction table for PWM calulation depending on mass airflow pressure" CURVE 0xa002efcc _REC_A1CUR_20_u1_u2 100. _CNV_A_R_LINEAR_____406_CM -50. 50. FORMAT "%9.5"
 /begin AXIS_DESCR COM_AXIS Vxx_map _CNV_A_R_LINEAR_____115_CM 17 0. 20000. FORMAT "%5.0" AXIS_PTS_REF Ctb_prs /end AXIS_DESCR
/end CHARACTERISTIC
/begin CHARACTERISTIC Ctp_sta_tco_sldv_pwm "Correction table for PWM calulation depending on coolant temperature while starting" CURVE 0xa00219ac _REC_A1CUR_20_u1_u2 100. _CNV_A_R_LINEAR_____165_CM 0. 100. FORMAT "%12.8"
 /begin AXIS_DESCR COM_AXIS Vxx_tco _CNV_A_R_LINEAR_____110_CM 8 -40. 200. FORMAT "%5.1" AXIS_PTS_REF Ctb_tco_sta_sldv /end AXIS_DESCR
/end CHARACTERISTIC
/begin CHARACTERISTIC Ctp_tco_alco_rat_sp "Correction table to calculate alcohol rate setpoint depending on coolant temperature" CURVE 0xa002efe0 _REC_A1CUR_20_u2_u2 1. _CNV_A_R_LINEAR_____161_CM 0. 1. FORMAT "%5.3"
 /begin AXIS_DESCR COM_AXIS Vxx_tco _CNV_A_R_LINEAR_____110_CM 8 -40. 200. FORMAT "%5.1" AXIS_PTS_REF Ctb_tco_sta_sldv /end AXIS_DESCR
/end CHARACTERISTIC
/begin CHARACTERISTIC Ctp_vb_sldv_pwm_cor "Correction table for final electrovalve PWM calcuation depending on battery voltage" CURVE 0xa002eff0 _REC_A1CUR_20_u1_u2 100. _CNV_A_R_LINEAR_____406_CM -50. 50. FORMAT "%9.5"
 /begin AXIS_DESCR COM_AXIS Vxx_vb _CNV_A_R_LINEAR_____205_CM 9 0. 60. FORMAT "%5.2" AXIS_PTS_REF Ctb_vb /end AXIS_DESCR
/end CHARACTERISTIC
/begin MEASUREMENT Vbx_sta_gaz_pump_req "Additional tank pump activation request" UBYTE _CNV_S_2_RANGE______3_CM 1 0. 0. 1. ECU_ADDRESS 0xd0006e9e BIT_MASK 0x1 /end MEASUREMENT
/begin MEASUREMENT Vsx_efi_sldv_2_vld "Fuel additional tank electrovalve validity status" UBYTE _CNV_S_3_STATUS_OK__179_CM 1 0. 0. 2. ECU_ADDRESS 0xd0006e9f /end MEASUREMENT
/begin MEASUREMENT Vxx_alco_rat_sp "Setpoint of alcohol rate for engine start" UWORD _CNV_A_R_LINEAR_____161_CM 1 0. 0. 1. ECU_ADDRESS 0xd000463e FORMAT "%5.3" /end MEASUREMENT
/begin MEASUREMENT Vxx_sta_sldv_dly "Remaining time to enable additionnal tank electrovalve" UWORD _CNV_A_R_LINEAR_____208_CM 1 0. 0. 10.2 ECU_ADDRESS 0xd0004640 FORMAT "%4.2" /end MEASUREMENT
/begin MEASUREMENT Vxx_sta_sldv_frq "Frequency of electrovalve command" UBYTE _CNV_A_R_LINEAR_____290_CM 1 0. 0. 255. ECU_ADDRESS 0xd0006ea0 FORMAT "%3.0" /end MEASUREMENT
/begin MEASUREMENT Vxx_sta_sldv_pwm_appl "Electrovalve PWM of additional tank" UBYTE _CNV_A_R_LINEAR_____165_CM 1 0. 0. 100. ECU_ADDRESS 0xd0006ea1 FORMAT "%12.8" /end MEASUREMENT
/begin MEASUREMENT Vxx_sta_sldv_pwm_sp "PWM command setpoint of additional tank electrovalve" UBYTE _CNV_A_R_LINEAR_____165_CM 1 0. 0. 100. ECU_ADDRESS 0xd0006ea2 FORMAT "%12.8" /end MEASUREMENT
/begin MEASUREMENT Vxx_sta_sldv_pwm_sp1 "Computed value for Final PWM command set point for additional tank electrovalve" UBYTE _CNV_A_R_LINEAR_____165_CM 1 0. 0. 100. ECU_ADDRESS 0xd0007c3b FORMAT "%12.8" /end MEASUREMENT
/begin CHARACTERISTIC Cbx_sta_sldv_bch "Bench mode for additionnal tank electrovalve" VALUE 0xa00219c4 _REC_S1VAL_20_u1 1. _CNV_A_R_ECME_LINEA_0_CM 0. 1. FORMAT "%1.0" BIT_MASK 0x1 /end CHARACTERISTIC
/begin CHARACTERISTIC Cxx_dfdec_efi_sldv_2_oc "Additional fuel tank electrovalve scg detected failure counter decrement" VALUE 0xa00219b4 _REC_S1VAL_20_u2 65535. _CNV_A_R_ECME_LINEA_0_CM 0. 65535. FORMAT "%5.0" /end CHARACTERISTIC
/begin CHARACTERISTIC Cxx_dfdec_efi_sldv_2_scg "Additional fuel tank electrovalve scg detected failure counter decrement" VALUE 0xa00219b6 _REC_S1VAL_20_u2 65535. _CNV_A_R_ECME_LINEA_0_CM 0. 65535. FORMAT "%5.0" /end CHARACTERISTIC
/begin CHARACTERISTIC Cxx_dfdec_efi_sldv_2_scw "Additional fuel tank electrovalve scw detected failure counter decrement" VALUE 0xa00219b8 _REC_S1VAL_20_u2 65535. _CNV_A_R_ECME_LINEA_0_CM 0. 65535. FORMAT "%5.0" /end CHARACTERISTIC
/begin CHARACTERISTIC Cxx_dfinc_efi_sldv_2_oc "Additional fuel tank electrovalve oc detected failure counter increment" VALUE 0xa00219ba _REC_S1VAL_20_u2 65535. _CNV_A_R_ECME_LINEA_0_CM 0. 65535. FORMAT "%5.0" /end CHARACTERISTIC
/begin CHARACTERISTIC Cxx_dfinc_efi_sldv_2_scg "Additional fuel tank electrovalve scg detected failure counter increment" VALUE 0xa00219bc _REC_S1VAL_20_u2 65535. _CNV_A_R_ECME_LINEA_0_CM 0. 65535. FORMAT "%5.0" /end CHARACTERISTIC
/begin CHARACTERISTIC Cxx_dfinc_efi_sldv_2_scw "Additional fuel tank electrovalve scw detected failure counter increment" VALUE 0xa00219be _REC_S1VAL_20_u2 65535. _CNV_A_R_ECME_LINEA_0_CM 0. 65535. FORMAT "%5.0" /end CHARACTERISTIC
/begin CHARACTERISTIC Cxx_fill_sta_sldv_dly_dfl "Default value for the electrovalve activation time when TCO failure" VALUE 0xa00219c0 _REC_S1VAL_20_u2 10.2 _CNV_A_R_LINEAR_____208_CM 0. 10.2 FORMAT "%4.2" /end CHARACTERISTIC
/begin CHARACTERISTIC Cxx_fill_sta_sldv_pwm "Electrovalve PWM after key-on and during a calibrated time" VALUE 0xa00219c5 _REC_S1VAL_20_u1 100. _CNV_A_R_LINEAR_____165_CM 0. 100. FORMAT "%12.8" /end CHARACTERISTIC
/begin CHARACTERISTIC Cxx_sldv_pwm_min "Electrovalve PWM min value to enable the additional pump" VALUE 0xa00219c6 _REC_S1VAL_20_u1 100. _CNV_A_R_LINEAR_____165_CM 0. 100. FORMAT "%12.8" /end CHARACTERISTIC
/begin CHARACTERISTIC Cxx_sta_sldv_bch_pwm "Electrovalve PWM value to enable the additionnal pump in bench mode configuration" VALUE 0xa00219c7 _REC_S1VAL_20_u1 100. _CNV_A_R_LINEAR_____165_CM 0. 100. FORMAT "%12.8" /end CHARACTERISTIC
/begin CHARACTERISTIC Cxx_sta_sldv_frq "Command frequency of the additionnal tank electrovalve" VALUE 0xa00219c8 _REC_S1VAL_20_u1 255. _CNV_A_R_LINEAR_____290_CM 0. 255. FORMAT "%3.0" /end CHARACTERISTIC
/begin CHARACTERISTIC Cxx_sta_sldv_pwm_dec "Decrementation value of PWM electrovalve out of engine starting phase" VALUE 0xa00219c9 _REC_S1VAL_20_u1 100. _CNV_A_R_LINEAR_____165_CM 0. 100. FORMAT "%12.8" /end CHARACTERISTIC
/begin CHARACTERISTIC Cxx_sta_sldv_pwm_dft "Default value for PWM electrovalve correction when engine speed or TCO or injection time or maniflod pressure failure" VALUE 0xa00219ca _REC_S1VAL_20_u1 100. _CNV_A_R_LINEAR_____165_CM 0. 100. FORMAT "%12.8" /end CHARACTERISTIC
/begin CHARACTERISTIC Cxx_tco_alco_rat_sp_dft "Default value for the alcohol rate depending of water temperature" VALUE 0xa00219c2 _REC_S1VAL_20_u2 1. _CNV_A_R_LINEAR_____161_CM 0. 1. FORMAT "%5.3" /end CHARACTERISTIC
/begin CHARACTERISTIC c_nr_hard_1_asa "HardwareNumber.LowerPart (byte 0)" VALUE 0xa0020708 _REC_S1VAL_20_u1 255. _CNV_A_R_ECME_LINEA_0_CM 0. 255. FORMAT "%3.0" /end CHARACTERISTIC
/begin CHARACTERISTIC c_nr_hard_2_asa "HardwareNumber.LowerPart (byte 1)" VALUE 0xa0020709 _REC_S1VAL_20_u1 255. _CNV_A_R_ECME_LINEA_0_CM 0. 255. FORMAT "%3.0" /end CHARACTERISTIC
/begin CHARACTERISTIC c_nr_hard_3_asa "HardwareNumber.LowerPart (byte 2)" VALUE 0xa002070a _REC_S1VAL_20_u1 255. _CNV_A_R_ECME_LINEA_0_CM 0. 255. FORMAT "%3.0" /end CHARACTERISTIC
/begin CHARACTERISTIC c_nr_hard_4_asa "HardwareNumber.LowerPart (byte 3)" VALUE 0xa002070b _REC_S1VAL_20_u1 255. _CNV_A_R_ECME_LINEA_0_CM 0. 255. FORMAT "%3.0" /end CHARACTERISTIC
/begin CHARACTERISTIC c_nr_hard_5_asa "HardwareNumber.LowerPart (byte 4)" VALUE 0xa002070c _REC_S1VAL_20_u1 255. _CNV_A_R_ECME_LINEA_0_CM 0. 255. FORMAT "%3.0" /end CHARACTERISTIC
/begin CHARACTERISTIC c_nr_hw_prg_1_asa "Hardware - PartNumber.LowerPart (byte 0)" VALUE 0xa002070d _REC_S1VAL_20_u1 255. _CNV_A_R_ECME_LINEA_0_CM 0. 255. FORMAT "%3.0" /end CHARACTERISTIC
/begin CHARACTERISTIC c_nr_hw_prg_2_asa "Hardware - PartNumber.LowerPart (byte 1)" VALUE 0xa002070e _REC_S1VAL_20_u1 255. _CNV_A_R_ECME_LINEA_0_CM 0. 255. FORMAT "%3.0" /end CHARACTERISTIC
/begin CHARACTERISTIC c_nr_hw_prg_3_asa "Hardware - PartNumber.LowerPart (byte 2)" VALUE 0xa002070f _REC_S1VAL_20_u1 255. _CNV_A_R_ECME_LINEA_0_CM 0. 255. FORMAT "%3.0" /end CHARACTERISTIC
/begin CHARACTERISTIC c_nr_hw_prg_4_asa "Hardware - PartNumber.LowerPart (byte 3)" VALUE 0xa0020710 _REC_S1VAL_20_u1 255. _CNV_A_R_ECME_LINEA_0_CM 0. 255. FORMAT "%3.0" /end CHARACTERISTIC
/begin CHARACTERISTIC c_nr_hw_prg_5_asa "Hardware - PartNumber.LowerPart (byte 4)" VALUE 0xa0020711 _REC_S1VAL_20_u1 255. _CNV_A_R_ECME_LINEA_0_CM 0. 255. FORMAT "%3.0" /end CHARACTERISTIC
/begin MEASUREMENT Sxx_mis_ctr_NVM "Misfire counter" UWORD _CNV_A_R_ECME_LINEA_0_CM 1 0. 0. 65535. DISPLAY_IDENTIFIER CbMisDgn_NVM.Sxx_mis_ctr_NVM ECU_ADDRESS 0xd0003f90 FORMAT "%5.0" /end MEASUREMENT
/begin MEASUREMENT Sxx_mis_ctr_lpg_NVM "Misfire counter for LPG application" UWORD _CNV_A_R_ECME_LINEA_0_CM 1 0. 0. 65535. DISPLAY_IDENTIFIER CbMisDgn_NVM.Sxx_mis_ctr_lpg_NVM ECU_ADDRESS 0xd0003f92 FORMAT "%5.0" /end MEASUREMENT
/begin MEASUREMENT Vbx_inj1_cut_req_tmp "temporary injection cut request on cylinder 1" UBYTE _CNV_S_2_RANGE______3_CM 1 0. 0. 1. ECU_ADDRESS 0xd00066ac BIT_MASK 0x1 /end MEASUREMENT
/begin MEASUREMENT Vbx_inj2_cut_req_tmp "temporary injection cut request on cylinder 2" UBYTE _CNV_S_2_RANGE______3_CM 1 0. 0. 1. ECU_ADDRESS 0xd00066ad BIT_MASK 0x1 /end MEASUREMENT
/begin MEASUREMENT Vbx_inj3_cut_req_tmp "temporary injection cut request on cylinder 3" UBYTE _CNV_S_2_RANGE______3_CM 1 0. 0. 1. ECU_ADDRESS 0xd00066ae BIT_MASK 0x1 /end MEASUREMENT
/begin MEASUREMENT Vbx_inj4_cut_req_tmp "temporary injection cut request on cylinder 4" UBYTE _CNV_S_2_RANGE______3_CM 1 0. 0. 1. ECU_ADDRESS 0xd00066af BIT_MASK 0x1 /end MEASUREMENT
/begin MEASUREMENT Vbx_mis_cut "Default misfiring driving mode activated (injection cut-off)" UBYTE _CNV_S_2_RANGE______3_CM 1 0. 0. 1. ECU_ADDRESS 0xd00066b0 BIT_MASK 0x1 /end MEASUREMENT
/begin MEASUREMENT Vbx_mis_cut_cyl_done "Coupure d'injection sur les cylindres en misfire terminée" UBYTE _CNV_S_2_RANGE______3_CM 1 0. 0. 1. ECU_ADDRESS 0xd00066b1 BIT_MASK 0x1 /end MEASUREMENT
/begin MEASUREMENT Vbx_mis_det_1_2_inh "Misfire detection into mode 1/2 inhibited by zero torque line" UBYTE _CNV_S_2_RANGE______3_CM 1 0. 0. 1. ECU_ADDRESS 0xd00066b2 BIT_MASK 0x1 /end MEASUREMENT
/begin MEASUREMENT Vbx_mis_inj_re_phs_req "Engine rephasage request" UBYTE _CNV_S_2_RANGE______3_CM 1 0. 0. 1. ECU_ADDRESS 0xd00066b3 BIT_MASK 0x1 /end MEASUREMENT
/begin MEASUREMENT Vbx_mis_lih_cata_rst "Request for catalyst window reset from limp home driving mode" UBYTE _CNV_S_2_RANGE______3_CM 1 0. 0. 1. ECU_ADDRESS 0xd00066b4 BIT_MASK 0x1 /end MEASUREMENT
/begin MEASUREMENT Vbx_mis_lih_chk_dsb "The cylinder 1 recognition cannot be done because a couple of cylinders is misfiring" UBYTE _CNV_S_2_RANGE______3_CM 1 0. 0. 1. ECU_ADDRESS 0xd00066b5 BIT_MASK 0x1 /end MEASUREMENT
/begin MEASUREMENT Vbx_mis_lih_phs_chk "Fin de processus de controle phasage" UBYTE _CNV_S_2_RANGE______3_CM 1 0. 0. 1. ECU_ADDRESS 0xd00066b6 BIT_MASK 0x1 /end MEASUREMENT
/begin MEASUREMENT Vbx_mis_lih_phs_chk_req "Demande de controle du phasage par la strategie de mode degrade misfire" UBYTE _CNV_S_2_RANGE______3_CM 1 0. 0. 1. ECU_ADDRESS 0xd00066b7 BIT_MASK 0x1 /end MEASUREMENT
/begin MEASUREMENT Vbx_mis_lih_phs_ok "Phasage controle bon" UBYTE _CNV_S_2_RANGE______3_CM 1 0. 0. 1. ECU_ADDRESS 0xd00066b8 BIT_MASK 0x1 /end MEASUREMENT
/begin MEASUREMENT Vbx_mis_lih_rst_inh "Inhibition of misfire diagnosis exit on filter reset on torque transient" UBYTE _CNV_S_2_RANGE______3_CM 1 0. 0. 1. ECU_ADDRESS 0xd00066b9 BIT_MASK 0x1 /end MEASUREMENT
/begin MEASUREMENT Vbx_pres_mis_lih "Panne présente ratés de combustion ayant entrainé le mode dégradé" UBYTE _CNV_S_2_RANGE______3_CM 1 0. 0. 1. ECU_ADDRESS 0xd00066ba BIT_MASK 0x1 /end MEASUREMENT
/begin MEASUREMENT Vsx_cyl_cut "Current state of the diagram of injection cut off" UBYTE _CNV_A_R_ECME_LINEA_0_CM 1 0. 0. 255. ECU_ADDRESS 0xd00066bb FORMAT "%3.0" /end MEASUREMENT
/begin MEASUREMENT Vsx_mis_inj1_vld "Misfire for cylinder 1 validity status which emets an injection cut request" UBYTE _CNV_S_8_STATUS_OK__234_CM 1 0. 0. 7. ECU_ADDRESS 0xd00066bc /end MEASUREMENT
/begin MEASUREMENT Vsx_mis_inj2_vld "Misfire for cylinder 2 validity status which emets an injection cut request" UBYTE _CNV_S_8_STATUS_OK__234_CM 1 0. 0. 7. ECU_ADDRESS 0xd00066bd /end MEASUREMENT
/begin MEASUREMENT Vsx_mis_inj3_vld "Misfire for cylinder 3 validity status which emets an injection cut request" UBYTE _CNV_S_8_STATUS_OK__234_CM 1 0. 0. 7. ECU_ADDRESS 0xd00066be /end MEASUREMENT
/begin MEASUREMENT Vsx_mis_inj4_vld "Misfire for cylinder 4 validity status which emets an injection cut request" UBYTE _CNV_S_8_STATUS_OK__234_CM 1 0. 0. 7. ECU_ADDRESS 0xd00066bf /end MEASUREMENT
/begin MEASUREMENT Vsx_mis_lih_cyl_chk "Current state of the identification diagram for misfire limp home driving mode" UBYTE _CNV_A_R_ECME_LINEA_0_CM 1 0. 0. 255. ECU_ADDRESS 0xd00066c0 FORMAT "%3.0" /end MEASUREMENT
/begin MEASUREMENT Vsx_mis_lih_stt "Current state of the main diagram" UBYTE _CNV_A_R_ECME_LINEA_0_CM 1 0. 0. 255. ECU_ADDRESS 0xd00066c1 FORMAT "%3.0" /end MEASUREMENT
/begin MEASUREMENT Vxx_mis_cyl_fail_nr "Number of cylinders detected as misfiring" UBYTE _CNV_A_R_ECME_LINEA_0_CM 1 0. 0. 255. ECU_ADDRESS 0xd00066c2 FORMAT "%3.0" /end MEASUREMENT
/begin MEASUREMENT Vxx_mis_lih_mis_ctr "Compteur de misfire sur le cylindre aparié au cylindre coupé" UBYTE _CNV_A_R_ECME_LINEA_0_CM 1 0. 0. 255. ECU_ADDRESS 0xd00066c3 FORMAT "%3.0" /end MEASUREMENT
/begin MEASUREMENT Vxx_mis_lih_out_mis_ctr "Counter of exit from default mode by exit from misfiring detection strategy." UBYTE _CNV_A_R_ECME_LINEA_0_CM 1 0. 0. 255. ECU_ADDRESS 0xd00066c4 FORMAT "%3.0" /end MEASUREMENT
/begin MEASUREMENT Vxx_mis_lih_re_phs_ctr "Number of re-synchronization of the engine" UBYTE _CNV_A_R_ECME_LINEA_0_CM 1 0. 0. 255. ECU_ADDRESS 0xd00066c5 FORMAT "%3.0" /end MEASUREMENT
/begin MEASUREMENT Vxx_mis_lih_tdc_ctr "Compteur de PMH sur le cylindre" UBYTE _CNV_A_R_ECME_LINEA_0_CM 1 0. 0. 255. ECU_ADDRESS 0xd00066c6 FORMAT "%3.0" /end MEASUREMENT
/begin CHARACTERISTIC Cbx_mis_lih_conf "Bit of configuration for default mode" VALUE 0xa0020daa _REC_S1VAL_20_u1 1. _CNV_S_2_RANGE______3_CM 0. 1. BIT_MASK 0x1 /end CHARACTERISTIC
/begin CHARACTERISTIC Cxx_mis_lih_chk_dsb_conf "Calibration that enable to chose or not to force the check of the engine synchronization" VALUE 0xa0020dab _REC_S1VAL_20_u1 2. _CNV_A_R_ECME_LINEA_0_CM 0. 2. FORMAT "%1.0" /end CHARACTERISTIC
/begin CHARACTERISTIC Cxx_mis_lih_mis_nr "Nombre de misifre a detecter pour declarer le phasage mauvais" VALUE 0xa0020dac _REC_S1VAL_20_u1 255. _CNV_A_R_ECME_LINEA_0_CM 0. 255. FORMAT "%3.0" /end CHARACTERISTIC
/begin CHARACTERISTIC Cxx_mis_lih_n_min "Minimum engine speed for default mode activation" VALUE 0xa0020da6 _REC_S1VAL_20_u2 16383.75 _CNV_A_R_ENSD_LINEA_22_CM 0. 16383.75 FORMAT "%8.2" /end CHARACTERISTIC
/begin CHARACTERISTIC Cxx_mis_lih_out_mis_nr "Maximum number of exit from default mode by misfiring detection strategy." VALUE 0xa0020dad _REC_S1VAL_20_u1 255. _CNV_A_R_ECME_LINEA_0_CM 0. 255. FORMAT "%3.0" /end CHARACTERISTIC
/begin CHARACTERISTIC Cxx_mis_lih_re_phs_nr "maximum number of re-synchronization of the engine." VALUE 0xa0020dae _REC_S1VAL_20_u1 255. _CNV_A_R_ECME_LINEA_0_CM 0. 255. FORMAT "%3.0" /end CHARACTERISTIC
/begin CHARACTERISTIC Cxx_mis_lih_tdc_nr "taille de la fenetre de comptage pour verification phasage" VALUE 0xa0020daf _REC_S1VAL_20_u1 255. _CNV_A_R_ECME_LINEA_0_CM 0. 255. FORMAT "%3.0" /end CHARACTERISTIC
/begin CHARACTERISTIC Cxx_mis_n_max_thd_1_n "Maximum engine speed threshold to allow misfire 1/n detection" VALUE 0xa0020da8 _REC_S1VAL_20_u2 16383.75 _CNV_A_R_ENSD_LINEA_22_CM 0. 16383.75 FORMAT "%8.2" /end CHARACTERISTIC
/begin AXIS_PTS Ctb_dft_comb_eal2 "Table of engine air load breakpoins for misfire cartographies." 0xa0027b1c Vxx_eal_tdc_2 _REC_A2AXS_20_u2 3.99993896484375 _CNV_A_R_LINEAR_____53_CM 5 0. 3.99993896484375 FORMAT "%10.8" /end AXIS_PTS
/begin AXIS_PTS Ctb_dft_comb_eal2_lpg "Table of engine air load breakpoins for misfire cartographies with LPG." 0xa0027b28 Vxx_eal_tdc_2 _REC_A2AXS_20_u2 3.99993896484375 _CNV_A_R_LINEAR_____53_CM 5 0. 3.99993896484375 FORMAT "%10.8" /end AXIS_PTS
/begin AXIS_PTS Ctb_dft_comb_n2 "Table of engine speed breakpoins for misfire cartographies." 0xa0027b34 Vxx_n_tdc_2 _REC_A2AXS_20_u2 16383.75 _CNV_A_R_ENSD_LINEA_22_CM 5 0. 16383.75 FORMAT "%8.2" /end AXIS_PTS
/begin AXIS_PTS Ctb_dft_comb_n2_lpg "Table of engine speed breakpoins for misfire cartographies with LPG" 0xa0027b40 Vxx_n_tdc_2 _REC_A2AXS_20_u2 16383.75 _CNV_A_R_ENSD_LINEA_22_CM 5 0. 16383.75 FORMAT "%8.2" /end AXIS_PTS
/begin AXIS_PTS Ntb_tco_9 "water temperature breakpoints table (9 breakpoints) (°C)" 0xa00281cc Vxx_tco _REC_A2AXS_20_u2 240. _CNV_A_R_LINEAR_____110_CM 9 -40. 200. READ_ONLY FORMAT "%5.1" /end AXIS_PTS
/begin CHARACTERISTIC Cmp_mis_cata_degr "Cartographie (L: Régime , C: pression) de pondération misfire pour dégradation cata" MAP 0xa0027b4c _REC_A1MAP_20_u1_u2_u2 255. _CNV_A_R_ECME_LINEA_0_CM 0. 255. FORMAT "%3.0"
 /begin AXIS_DESCR COM_AXIS Vxx_eal_tdc_2 _CNV_A_R_LINEAR_____53_CM 17 0. 3.99993896484375 FORMAT "%7.5" AXIS_PTS_REF Ctb_dft_comb_eal /end AXIS_DESCR
 /begin AXIS_DESCR COM_AXIS Vxx_n_tdc_2 _CNV_A_R_ENSD_LINEA_22_CM 17 0. 16383.75 FORMAT "%8.2" AXIS_PTS_REF Ctb_mis_n_17 /end AXIS_DESCR
/end CHARACTERISTIC
/begin CHARACTERISTIC Cmp_mis_cata_degr_1 "Cartographie (L: Régime , C: pression) de pondération misfire pour dégradation cata au Gaz" MAP 0xa0027c70 _REC_A1MAP_20_u1_u2_u2 255. _CNV_A_R_ECME_LINEA_0_CM 0. 255. FORMAT "%3.0"
 /begin AXIS_DESCR COM_AXIS Vxx_eal_tdc_2 _CNV_A_R_LINEAR_____53_CM 17 0. 3.99993896484375 FORMAT "%7.5" AXIS_PTS_REF Ctb_dft_comb_eal /end AXIS_DESCR
 /begin AXIS_DESCR COM_AXIS Vxx_n_tdc_2 _CNV_A_R_ENSD_LINEA_22_CM 17 0. 16383.75 FORMAT "%8.2" AXIS_PTS_REF Ctb_mis_n_17 /end AXIS_DESCR
/end CHARACTERISTIC
/begin CHARACTERISTIC Cmp_mis_iga_efy_dif "Cartography autorized decline of the torque efficiency corresponding to applied avance" MAP 0xa0027d94 _REC_A1MAP_20_u2_u2_u2 1. _CNV_A_R_LINEAR_____183_CM 0. 1. FORMAT "%11.9"
 /begin AXIS_DESCR COM_AXIS Vxx_eal _CNV_A_R_LINEAR_____53_CM 16 0. 3.99993896484375 FORMAT "%10.8" AXIS_PTS_REF Ctb_eal /end AXIS_DESCR
 /begin AXIS_DESCR COM_AXIS Vxx_n _CNV_A_R_ENSD_LINEA_22_CM 20 0. 16383.75 FORMAT "%8.2" AXIS_PTS_REF Ctb_n /end AXIS_DESCR
/end CHARACTERISTIC
/begin CHARACTERISTIC Cmp_mis_tq_dif_1_2_dz_1 "Cartography of dead zone thresold for misfire 1/2 detection with LPG" MAP 0xa0028014 _REC_A1MAP_20_u1_u2_u2 255. _CNV_A_R_ECME_LINEA_0_CM 0. 255. FORMAT "%3.0"
 /begin AXIS_DESCR COM_AXIS Vxx_eal_tdc_2 _CNV_A_R_LINEAR_____53_CM 5 0. 3.99993896484375 FORMAT "%10.8" AXIS_PTS_REF Ctb_dft_comb_eal2_lpg /end AXIS_DESCR
 /begin AXIS_DESCR COM_AXIS Vxx_n_tdc_2 _CNV_A_R_ENSD_LINEA_22_CM 5 0. 16383.75 FORMAT "%8.2" AXIS_PTS_REF Ctb_dft_comb_n2_lpg /end AXIS_DESCR
/end CHARACTERISTIC
/begin CHARACTERISTIC Cmp_mis_tq_dif_1_4_dz_1 "Cartography of dead zone thresold for misfire 1/4 detection with LPG" MAP 0xa0028030 _REC_A1MAP_20_u1_u2_u2 255. _CNV_A_R_ECME_LINEA_0_CM 0. 255. FORMAT "%3.0"
 /begin AXIS_DESCR COM_AXIS Vxx_eal_tdc_2 _CNV_A_R_LINEAR_____53_CM 5 0. 3.99993896484375 FORMAT "%10.8" AXIS_PTS_REF Ctb_dft_comb_eal2_lpg /end AXIS_DESCR
 /begin AXIS_DESCR COM_AXIS Vxx_n_tdc_2 _CNV_A_R_ENSD_LINEA_22_CM 5 0. 16383.75 FORMAT "%8.2" AXIS_PTS_REF Ctb_dft_comb_n2_lpg /end AXIS_DESCR
/end CHARACTERISTIC
/begin CHARACTERISTIC Cmp_mis_tq_dif_fac_1_2 "Cartography of thresold for misfire 1/2 detection" MAP 0xa002804c _REC_A1MAP_20_u1_u2_u2 255. _CNV_A_R_ECME_LINEA_0_CM 0. 255. FORMAT "%3.0"
 /begin AXIS_DESCR COM_AXIS Vxx_eal_tdc_2 _CNV_A_R_LINEAR_____53_CM 5 0. 3.99993896484375 FORMAT "%10.8" AXIS_PTS_REF Ctb_dft_comb_eal2 /end AXIS_DESCR
 /begin AXIS_DESCR COM_AXIS Vxx_n_tdc_2 _CNV_A_R_ENSD_LINEA_22_CM 5 0. 16383.75 FORMAT "%8.2" AXIS_PTS_REF Ctb_dft_comb_n2 /end AXIS_DESCR
/end CHARACTERISTIC
/begin CHARACTERISTIC Cmp_mis_tq_dif_fac_1_2_1 "Cartography of thresold for misfire 1/2 detection with LPG" MAP 0xa0028068 _REC_A1MAP_20_u1_u2_u2 255. _CNV_A_R_ECME_LINEA_0_CM 0. 255. FORMAT "%3.0"
 /begin AXIS_DESCR COM_AXIS Vxx_eal_tdc_2 _CNV_A_R_LINEAR_____53_CM 5 0. 3.99993896484375 FORMAT "%10.8" AXIS_PTS_REF Ctb_dft_comb_eal2_lpg /end AXIS_DESCR
 /begin AXIS_DESCR COM_AXIS Vxx_n_tdc_2 _CNV_A_R_ENSD_LINEA_22_CM 5 0. 16383.75 FORMAT "%8.2" AXIS_PTS_REF Ctb_dft_comb_n2_lpg /end AXIS_DESCR
/end CHARACTERISTIC
/begin CHARACTERISTIC Cmp_mis_tq_dif_fac_1_2_dz "Cartography of dead zone thresold for misfire 1/2 detection" MAP 0xa0028084 _REC_A1MAP_20_u1_u2_u2 255. _CNV_A_R_ECME_LINEA_0_CM 0. 255. FORMAT "%3.0"
 /begin AXIS_DESCR COM_AXIS Vxx_eal_tdc_2 _CNV_A_R_LINEAR_____53_CM 5 0. 3.99993896484375 FORMAT "%10.8" AXIS_PTS_REF Ctb_dft_comb_eal2 /end AXIS_DESCR
 /begin AXIS_DESCR COM_AXIS Vxx_n_tdc_2 _CNV_A_R_ENSD_LINEA_22_CM 5 0. 16383.75 FORMAT "%8.2" AXIS_PTS_REF Ctb_dft_comb_n2 /end AXIS_DESCR
/end CHARACTERISTIC
/begin CHARACTERISTIC Cmp_mis_tq_dif_fac_1_4 "Cartography of thresold for misfire 1/4 detection" MAP 0xa00280a0 _REC_A1MAP_20_u1_u2_u2 255. _CNV_A_R_ECME_LINEA_0_CM 0. 255. FORMAT "%3.0"
 /begin AXIS_DESCR COM_AXIS Vxx_eal_tdc_2 _CNV_A_R_LINEAR_____53_CM 5 0. 3.99993896484375 FORMAT "%10.8" AXIS_PTS_REF Ctb_dft_comb_eal2 /end AXIS_DESCR
 /begin AXIS_DESCR COM_AXIS Vxx_n_tdc_2 _CNV_A_R_ENSD_LINEA_22_CM 5 0. 16383.75 FORMAT "%8.2" AXIS_PTS_REF Ctb_dft_comb_n2 /end AXIS_DESCR
/end CHARACTERISTIC
/begin CHARACTERISTIC Cmp_mis_tq_dif_fac_1_4_1 "Cartography of thresold for misfire 1/4 detection with LPG" MAP 0xa00280bc _REC_A1MAP_20_u1_u2_u2 255. _CNV_A_R_ECME_LINEA_0_CM 0. 255. FORMAT "%3.0"
 /begin AXIS_DESCR COM_AXIS Vxx_eal_tdc_2 _CNV_A_R_LINEAR_____53_CM 5 0. 3.99993896484375 FORMAT "%10.8" AXIS_PTS_REF Ctb_dft_comb_eal2_lpg /end AXIS_DESCR
 /begin AXIS_DESCR COM_AXIS Vxx_n_tdc_2 _CNV_A_R_ENSD_LINEA_22_CM 5 0. 16383.75 FORMAT "%8.2" AXIS_PTS_REF Ctb_dft_comb_n2_lpg /end AXIS_DESCR
/end CHARACTERISTIC
/begin CHARACTERISTIC Cmp_mis_tq_dif_fac_1_4_dz "Cartography of dead zone thresold for misfire 1/4 detection" MAP 0xa00280d8 _REC_A1MAP_20_u1_u2_u2 255. _CNV_A_R_ECME_LINEA_0_CM 0. 255. FORMAT "%3.0"
 /begin AXIS_DESCR COM_AXIS Vxx_eal_tdc_2 _CNV_A_R_LINEAR_____53_CM 5 0. 3.99993896484375 FORMAT "%10.8" AXIS_PTS_REF Ctb_dft_comb_eal2 /end AXIS_DESCR
 /begin AXIS_DESCR COM_AXIS Vxx_n_tdc_2 _CNV_A_R_ENSD_LINEA_22_CM 5 0. 16383.75 FORMAT "%8.2" AXIS_PTS_REF Ctb_dft_comb_n2 /end AXIS_DESCR
/end CHARACTERISTIC
/begin CHARACTERISTIC Cmp_mis_tq_dif_fac_intm "Cartography of thresold for misfire iso detection" MAP 0xa00280f4 _REC_A1MAP_20_u1_u2_u2 255. _CNV_A_R_ECME_LINEA_0_CM 0. 255. FORMAT "%3.0"
 /begin AXIS_DESCR COM_AXIS Vxx_eal_tdc_2 _CNV_A_R_LINEAR_____53_CM 5 0. 3.99993896484375 FORMAT "%10.8" AXIS_PTS_REF Ctb_dft_comb_eal2 /end AXIS_DESCR
 /begin AXIS_DESCR COM_AXIS Vxx_n_tdc_2 _CNV_A_R_ENSD_LINEA_22_CM 5 0. 16383.75 FORMAT "%8.2" AXIS_PTS_REF Ctb_dft_comb_n2 /end AXIS_DESCR
/end CHARACTERISTIC
/begin CHARACTERISTIC Cmp_mis_tq_dif_fac_intm_1 "Cartography of thresold for misfire iso detection with LPG" MAP 0xa0028110 _REC_A1MAP_20_u1_u2_u2 255. _CNV_A_R_ECME_LINEA_0_CM 0. 255. FORMAT "%3.0"
 /begin AXIS_DESCR COM_AXIS Vxx_eal_tdc_2 _CNV_A_R_LINEAR_____53_CM 5 0. 3.99993896484375 FORMAT "%10.8" AXIS_PTS_REF Ctb_dft_comb_eal2_lpg /end AXIS_DESCR
 /begin AXIS_DESCR COM_AXIS Vxx_n_tdc_2 _CNV_A_R_ENSD_LINEA_22_CM 5 0. 16383.75 FORMAT "%8.2" AXIS_PTS_REF Ctb_dft_comb_n2_lpg /end AXIS_DESCR
/end CHARACTERISTIC
/begin CHARACTERISTIC Cmp_mis_tq_dif_intm_dz "Cartography of dead zone thresold for misfire iso detection" MAP 0xa002812c _REC_A1MAP_20_u1_u2_u2 255. _CNV_A_R_ECME_LINEA_0_CM 0. 255. FORMAT "%3.0"
 /begin AXIS_DESCR COM_AXIS Vxx_eal_tdc_2 _CNV_A_R_LINEAR_____53_CM 5 0. 3.99993896484375 FORMAT "%10.8" AXIS_PTS_REF Ctb_dft_comb_eal2 /end AXIS_DESCR
 /begin AXIS_DESCR COM_AXIS Vxx_n_tdc_2 _CNV_A_R_ENSD_LINEA_22_CM 5 0. 16383.75 FORMAT "%8.2" AXIS_PTS_REF Ctb_dft_comb_n2 /end AXIS_DESCR
/end CHARACTERISTIC
/begin CHARACTERISTIC Cmp_mis_tq_dif_intm_dz_1 "Cartography of dead zone thresold for misfire iso detection with LPG" MAP 0xa0028148 _REC_A1MAP_20_u1_u2_u2 255. _CNV_A_R_ECME_LINEA_0_CM 0. 255. FORMAT "%3.0"
 /begin AXIS_DESCR COM_AXIS Vxx_eal_tdc_2 _CNV_A_R_LINEAR_____53_CM 5 0. 3.99993896484375 FORMAT "%10.8" AXIS_PTS_REF Ctb_dft_comb_eal2_lpg /end AXIS_DESCR
 /begin AXIS_DESCR COM_AXIS Vxx_n_tdc_2 _CNV_A_R_ENSD_LINEA_22_CM 5 0. 16383.75 FORMAT "%8.2" AXIS_PTS_REF Ctb_dft_comb_n2_lpg /end AXIS_DESCR
/end CHARACTERISTIC
/begin CHARACTERISTIC Ctp_min_eal "Table de masses d’air minimum = f(Vxx_prev2_n ) pour autorisation de diag misfire" CURVE 0xa0028164 _REC_A1CUR_20_u2_u2 3.99993896484375 _CNV_A_R_LINEAR_____53_CM 0. 3.99993896484375 FORMAT "%10.8"
 /begin AXIS_DESCR COM_AXIS Vxx_n_tdc_2 _CNV_A_R_ENSD_LINEA_22_CM 17 0. 16383.75 FORMAT "%8.2" AXIS_PTS_REF Ctb_mis_n_17 /end AXIS_DESCR
/end CHARACTERISTIC
/begin CHARACTERISTIC Ctp_min_eal_1_2 "Table de masses d’air minimum = f(Vxx_prev2_n ) pour autorisation de diag misfire en mode 1/2" CURVE 0xa0028188 _REC_A1CUR_20_u2_u2 3.99993896484375 _CNV_A_R_LINEAR_____53_CM 0. 3.99993896484375 FORMAT "%10.8"
 /begin AXIS_DESCR COM_AXIS Vxx_n_tdc_2 _CNV_A_R_ENSD_LINEA_22_CM 17 0. 16383.75 FORMAT "%8.2" AXIS_PTS_REF Ctb_mis_n_17 /end AXIS_DESCR
/end CHARACTERISTIC
/begin CHARACTERISTIC Ctp_min_eal_amp_ofs "Table d’offset de masses d’air minimum = f (pression atmo) pour autorisation de diag misfire" CURVE 0xa00281ac _REC_A1CUR_20_u2_u2 3.99993896484375 _CNV_A_R_LINEAR_____407_CM -2. 1.99993896484375 FORMAT "%8.5"
 /begin AXIS_DESCR COM_AXIS Vxx_amp _CNV_A_R_LINEAR_____115_CM 6 0. 20000. FORMAT "%5.0" AXIS_PTS_REF Ctb_eng_amp /end AXIS_DESCR
/end CHARACTERISTIC
/begin CHARACTERISTIC Ctp_min_eal_off "Table d’offset de masses d’air minimum = f (Teau) pour autorisation de diag misfire" CURVE 0xa00281b8 _REC_A1CUR_20_u2_u2 3.99993896484375 _CNV_A_R_LINEAR_____53_CM 0. 3.99993896484375 FORMAT "%10.8"
 /begin AXIS_DESCR COM_AXIS Vxx_tco _CNV_A_R_LINEAR_____110_CM 9 -40. 200. READ_ONLY FORMAT "%5.1" AXIS_PTS_REF Ntb_tco_9 /end AXIS_DESCR
/end CHARACTERISTIC
/begin MEASUREMENT Sxx_mis_ctr_clr "Reinit of Misfire counter for Service 6" UWORD _CNV_A_R_ECME_LINEA_0_CM 1 0. 0. 65535. ECU_ADDRESS 0xd0003f94 FORMAT "%5.0" /end MEASUREMENT
/begin MEASUREMENT Sxx_mis_ctr_lpg_clr "Reinit of Misfire counter for LPG application" UWORD _CNV_A_R_ECME_LINEA_0_CM 1 0. 0. 65535. ECU_ADDRESS 0xd0003f96 FORMAT "%5.0" /end MEASUREMENT
/begin MEASUREMENT Sxx_mis_ctr_lpg_read "Misfire counter init" UWORD _CNV_A_R_ECME_LINEA_0_CM 1 0. 0. 65535. ECU_ADDRESS 0xd00050e6 FORMAT "%5.0" /end MEASUREMENT
/begin MEASUREMENT Sxx_mis_ctr_read "Misfire counter init" UWORD _CNV_A_R_ECME_LINEA_0_CM 1 0. 0. 65535. ECU_ADDRESS 0xd00050e8 FORMAT "%5.0" /end MEASUREMENT
/begin MEASUREMENT Vbx_df_mis_1_cata "Cylinder 1 Misfire Detected Destructive Catalyst detected failure" UBYTE _CNV_S_2_RANGE______3_CM 1 0. 0. 1. ECU_ADDRESS 0xd00066cb BIT_MASK 0x1 /end MEASUREMENT
/begin MEASUREMENT Vbx_df_mis_1_lpg_cata "Cylinder 1 Misfire LPG Detected Destructive Catalyst detected failure" UBYTE _CNV_S_2_RANGE______3_CM 1 0. 0. 1. ECU_ADDRESS 0xd00066cc BIT_MASK 0x1 /end MEASUREMENT
/begin MEASUREMENT Vbx_df_mis_1_lpg_trs_h "Cylinder 1 Misfire LPG Detected Pollution detected failure" UBYTE _CNV_S_2_RANGE______3_CM 1 0. 0. 1. ECU_ADDRESS 0xd00066cd BIT_MASK 0x1 /end MEASUREMENT
/begin MEASUREMENT Vbx_df_mis_1_trs_h "Cylinder 1 Misfire Detected Pollution detected failure" UBYTE _CNV_S_2_RANGE______3_CM 1 0. 0. 1. ECU_ADDRESS 0xd00066ce BIT_MASK 0x1 /end MEASUREMENT
/begin MEASUREMENT Vbx_df_mis_2_cata "Cylinder 2 Misfire Detected Destructive Catalyst detected failure" UBYTE _CNV_S_2_RANGE______3_CM 1 0. 0. 1. ECU_ADDRESS 0xd00066cf BIT_MASK 0x1 /end MEASUREMENT
/begin MEASUREMENT Vbx_df_mis_2_lpg_cata "Cylinder 2 Misfire LPG Detected Destructive Catalyst detected failure" UBYTE _CNV_S_2_RANGE______3_CM 1 0. 0. 1. ECU_ADDRESS 0xd00066d0 BIT_MASK 0x1 /end MEASUREMENT
/begin MEASUREMENT Vbx_df_mis_2_lpg_trs_h "Cylinder 2 Misfire LPG Detected Pollution detected failure" UBYTE _CNV_S_2_RANGE______3_CM 1 0. 0. 1. ECU_ADDRESS 0xd00066d1 BIT_MASK 0x1 /end MEASUREMENT
/begin MEASUREMENT Vbx_df_mis_2_trs_h "Cylinder 2 Misfire Detected Pollution detected failure" UBYTE _CNV_S_2_RANGE______3_CM 1 0. 0. 1. ECU_ADDRESS 0xd00066d2 BIT_MASK 0x1 /end MEASUREMENT
/begin MEASUREMENT Vbx_df_mis_3_cata "Cylinder 3 Misfire Detected Destructive Catalyst detected failure" UBYTE _CNV_S_2_RANGE______3_CM 1 0. 0. 1. ECU_ADDRESS 0xd00066d3 BIT_MASK 0x1 /end MEASUREMENT
/begin MEASUREMENT Vbx_df_mis_3_lpg_cata "Cylinder 3 Misfire LPG Detected Destructive Catalyst detected failure" UBYTE _CNV_S_2_RANGE______3_CM 1 0. 0. 1. ECU_ADDRESS 0xd00066d4 BIT_MASK 0x1 /end MEASUREMENT
/begin MEASUREMENT Vbx_df_mis_3_lpg_trs_h "Cylinder 3 Misfire LPG Detected Pollution detected failure" UBYTE _CNV_S_2_RANGE______3_CM 1 0. 0. 1. ECU_ADDRESS 0xd00066d5 BIT_MASK 0x1 /end MEASUREMENT
/begin MEASUREMENT Vbx_df_mis_3_trs_h "Cylinder 3 Misfire Detected Pollution detected failure" UBYTE _CNV_S_2_RANGE______3_CM 1 0. 0. 1. ECU_ADDRESS 0xd00066d6 BIT_MASK 0x1 /end MEASUREMENT
/begin MEASUREMENT Vbx_df_mis_4_cata "Cylinder 4 Misfire Detected Destructive Catalyst detected failure" UBYTE _CNV_S_2_RANGE______3_CM 1 0. 0. 1. ECU_ADDRESS 0xd00066d7 BIT_MASK 0x1 /end MEASUREMENT
/begin MEASUREMENT Vbx_df_mis_4_lpg_cata "Cylinder 4 Misfire LPG Detected Destructive Catalyst detected failure" UBYTE _CNV_S_2_RANGE______3_CM 1 0. 0. 1. ECU_ADDRESS 0xd00066d8 BIT_MASK 0x1 /end MEASUREMENT
/begin MEASUREMENT Vbx_df_mis_4_lpg_trs_h "Cylinder 4 Misfire LPG Detected Pollution detected failure" UBYTE _CNV_S_2_RANGE______3_CM 1 0. 0. 1. ECU_ADDRESS 0xd00066d9 BIT_MASK 0x1 /end MEASUREMENT
/begin MEASUREMENT Vbx_df_mis_4_trs_h "Cylinder 4 Misfire Detected Pollution detected failure" UBYTE _CNV_S_2_RANGE______3_CM 1 0. 0. 1. ECU_ADDRESS 0xd00066da BIT_MASK 0x1 /end MEASUREMENT
/begin MEASUREMENT Vbx_df_mis_cata "Misfire Detected Destructive Catalyst detected failure" UBYTE _CNV_S_2_RANGE______3_CM 1 0. 0. 1. ECU_ADDRESS 0xd00066db BIT_MASK 0x1 /end MEASUREMENT
/begin MEASUREMENT Vbx_df_mis_lpg_cata "Misfire LPG Detected Destructive Catalyst detected failure" UBYTE _CNV_S_2_RANGE______3_CM 1 0. 0. 1. ECU_ADDRESS 0xd00066dc BIT_MASK 0x1 /end MEASUREMENT
/begin MEASUREMENT Vbx_df_mis_lpg_trs_h "Misfire LPG Detected Pollution detected failure" UBYTE _CNV_S_2_RANGE______3_CM 1 0. 0. 1. ECU_ADDRESS 0xd00066dd BIT_MASK 0x1 /end MEASUREMENT
/begin MEASUREMENT Vbx_df_mis_min_fuel_cata "Misfire Detected with Low Fuel Destructive Catalyst detected failure" UBYTE _CNV_S_2_RANGE______3_CM 1 0. 0. 1. ECU_ADDRESS 0xd00066de BIT_MASK 0x1 /end MEASUREMENT
/begin MEASUREMENT Vbx_df_mis_min_fuel_trs_h "Misfire Detected with Low Fuel Pollution detected failure" UBYTE _CNV_S_2_RANGE______3_CM 1 0. 0. 1. ECU_ADDRESS 0xd00066df BIT_MASK 0x1 /end MEASUREMENT
/begin MEASUREMENT Vbx_df_mis_trs_h "Misfire Detected Pollution detected failure" UBYTE _CNV_S_2_RANGE______3_CM 1 0. 0. 1. ECU_ADDRESS 0xd00066e0 BIT_MASK 0x1 /end MEASUREMENT
/begin MEASUREMENT Vbx_df_mis_unk_cata "Unknown Cylinder Misfire Detected Destructive Catalyst detected failure" UBYTE _CNV_S_2_RANGE______3_CM 1 0. 0. 1. ECU_ADDRESS 0xd00066e1 BIT_MASK 0x1 /end MEASUREMENT
/begin MEASUREMENT Vbx_df_mis_unk_lpg_cata "Unknown Cylinder Misfire LPG Detected Destructive Catalyst detected failure" UBYTE _CNV_S_2_RANGE______3_CM 1 0. 0. 1. ECU_ADDRESS 0xd00066e2 BIT_MASK 0x1 /end MEASUREMENT
/begin MEASUREMENT Vbx_df_mis_unk_lpg_trs_h "Unknown Cylinder Misfire LPG Detected Pollution detected failure" UBYTE _CNV_S_2_RANGE______3_CM 1 0. 0. 1. ECU_ADDRESS 0xd00066e3 BIT_MASK 0x1 /end MEASUREMENT
/begin MEASUREMENT Vbx_df_mis_unk_trs_h "Unknown Cylinder Misfire Detected Pollution detected failure" UBYTE _CNV_S_2_RANGE______3_CM 1 0. 0. 1. ECU_ADDRESS 0xd00066e4 BIT_MASK 0x1 /end MEASUREMENT
/begin MEASUREMENT Vbx_diag_ena_mis_1_cata "Cylinder 1 Misfire Detected Destructive Catalyst diagnostic authorization" UBYTE _CNV_S_2_RANGE______3_CM 1 0. 0. 1. ECU_ADDRESS 0xd00066e5 BIT_MASK 0x1 /end MEASUREMENT
/begin MEASUREMENT Vbx_diag_ena_mis_1_lpg_cata "Cylinder 1 Misfire LPG Detected Destructive Catalyst diagnostic authorization" UBYTE _CNV_S_2_RANGE______3_CM 1 0. 0. 1. ECU_ADDRESS 0xd00066e6 BIT_MASK 0x1 /end MEASUREMENT
/begin MEASUREMENT Vbx_diag_ena_mis_1_lpg_trs_h "Cylinder 1 Misfire LPG Detected Pollution diagnostic authorization" UBYTE _CNV_S_2_RANGE______3_CM 1 0. 0. 1. ECU_ADDRESS 0xd00066e7 BIT_MASK 0x1 /end MEASUREMENT
/begin MEASUREMENT Vbx_diag_ena_mis_1_trs_h "Cylinder 1 Misfire Detected Pollution Diagnostic authorization" UBYTE _CNV_S_2_RANGE______3_CM 1 0. 0. 1. ECU_ADDRESS 0xd00066e8 BIT_MASK 0x1 /end MEASUREMENT
/begin MEASUREMENT Vbx_diag_ena_mis_2_cata "Cylinder 2 Misfire Detected Destructive Catalyst diagnostic authorization" UBYTE _CNV_S_2_RANGE______3_CM 1 0. 0. 1. ECU_ADDRESS 0xd00066e9 BIT_MASK 0x1 /end MEASUREMENT
/begin MEASUREMENT Vbx_diag_ena_mis_2_lpg_cata "Cylinder 2 Misfire LPG Detected Destructive Catalyst diagnostic authorization" UBYTE _CNV_S_2_RANGE______3_CM 1 0. 0. 1. ECU_ADDRESS 0xd00066ea BIT_MASK 0x1 /end MEASUREMENT
/begin MEASUREMENT Vbx_diag_ena_mis_2_lpg_trs_h "Cylinder 2 Misfire LPG Detected Pollution diagnostic authorization" UBYTE _CNV_S_2_RANGE______3_CM 1 0. 0. 1. ECU_ADDRESS 0xd00066eb BIT_MASK 0x1 /end MEASUREMENT
/begin MEASUREMENT Vbx_diag_ena_mis_2_trs_h "Cylinder 2 Misfire Detected Pollution Diagnostic authorization" UBYTE _CNV_S_2_RANGE______3_CM 1 0. 0. 1. ECU_ADDRESS 0xd00066ec BIT_MASK 0x1 /end MEASUREMENT
/begin MEASUREMENT Vbx_diag_ena_mis_3_cata "Cylinder 3 Misfire Detected Destructive Catalyst diagnostic authorization" UBYTE _CNV_S_2_RANGE______3_CM 1 0. 0. 1. ECU_ADDRESS 0xd00066ed BIT_MASK 0x1 /end MEASUREMENT
/begin MEASUREMENT Vbx_diag_ena_mis_3_lpg_cata "Cylinder 3 Misfire LPG Detected Destructive Catalyst diagnostic authorization" UBYTE _CNV_S_2_RANGE______3_CM 1 0. 0. 1. ECU_ADDRESS 0xd00066ee BIT_MASK 0x1 /end MEASUREMENT
/begin MEASUREMENT Vbx_diag_ena_mis_3_lpg_trs_h "Cylinder 3 Misfire LPG Detected Pollution diagnostic authorization" UBYTE _CNV_S_2_RANGE______3_CM 1 0. 0. 1. ECU_ADDRESS 0xd00066ef BIT_MASK 0x1 /end MEASUREMENT
/begin MEASUREMENT Vbx_diag_ena_mis_3_trs_h "Cylinder 3 Misfire Detected Pollution Diagnostic authorization" UBYTE _CNV_S_2_RANGE______3_CM 1 0. 0. 1. ECU_ADDRESS 0xd00066f0 BIT_MASK 0x1 /end MEASUREMENT
/begin MEASUREMENT Vbx_diag_ena_mis_4_cata "Cylinder 4 Misfire Detected Destructive Catalyst diagnostic authorization" UBYTE _CNV_S_2_RANGE______3_CM 1 0. 0. 1. ECU_ADDRESS 0xd00066f1 BIT_MASK 0x1 /end MEASUREMENT
/begin MEASUREMENT Vbx_diag_ena_mis_4_lpg_cata "Cylinder 4 Misfire LPG Detected Destructive Catalyst diagnostic authorization" UBYTE _CNV_S_2_RANGE______3_CM 1 0. 0. 1. ECU_ADDRESS 0xd00066f2 BIT_MASK 0x1 /end MEASUREMENT
/begin MEASUREMENT Vbx_diag_ena_mis_4_lpg_trs_h "Cylinder 4 Misfire LPG Detected Pollution diagnostic authorization" UBYTE _CNV_S_2_RANGE______3_CM 1 0. 0. 1. ECU_ADDRESS 0xd00066f3 BIT_MASK 0x1 /end MEASUREMENT
/begin MEASUREMENT Vbx_diag_ena_mis_4_trs_h "Cylinder 4 Misfire Detected Pollution Diagnostic authorization" UBYTE _CNV_S_2_RANGE______3_CM 1 0. 0. 1. ECU_ADDRESS 0xd00066f4 BIT_MASK 0x1 /end MEASUREMENT
/begin MEASUREMENT Vbx_diag_ena_mis_cata "Misfire Detected Destructive Catalyst diagnostic authorization" UBYTE _CNV_S_2_RANGE______3_CM 1 0. 0. 1. ECU_ADDRESS 0xd00066f5 BIT_MASK 0x1 /end MEASUREMENT
/begin MEASUREMENT Vbx_diag_ena_mis_lpg_cata "Misfire LPG Detected Destructive Catalyst diagnostic authorization" UBYTE _CNV_S_2_RANGE______3_CM 1 0. 0. 1. ECU_ADDRESS 0xd00066f6 BIT_MASK 0x1 /end MEASUREMENT
/begin MEASUREMENT Vbx_diag_ena_mis_lpg_trs_h "Misfire LPG Detected Pollution diagnostic" UBYTE _CNV_S_2_RANGE______3_CM 1 0. 0. 1. ECU_ADDRESS 0xd00066f7 BIT_MASK 0x1 /end MEASUREMENT
/begin MEASUREMENT Vbx_diag_ena_mis_min_fuel_cata "Misfire Detected with Low Fuel Destructive Catalyst diagnostic authorization" UBYTE _CNV_S_2_RANGE______3_CM 1 0. 0. 1. ECU_ADDRESS 0xd00066f8 BIT_MASK 0x1 /end MEASUREMENT
/begin MEASUREMENT Vbx_diag_ena_mis_min_fuel_trs_h "Misfire Detected with Low Fuel Pollution diagnostic authorization" UBYTE _CNV_S_2_RANGE______3_CM 1 0. 0. 1. ECU_ADDRESS 0xd00066f9 BIT_MASK 0x1 /end MEASUREMENT
/begin MEASUREMENT Vbx_diag_ena_mis_trs_h "Misfire Detected Pollution diagnostic authorization" UBYTE _CNV_S_2_RANGE______3_CM 1 0. 0. 1. ECU_ADDRESS 0xd00066fa BIT_MASK 0x1 /end MEASUREMENT
/begin MEASUREMENT Vbx_diag_ena_mis_unk_cata "Unknown Cylinder Misfire Detected Destructive Catalyst diagnostic authorization" UBYTE _CNV_S_2_RANGE______3_CM 1 0. 0. 1. ECU_ADDRESS 0xd00066fb BIT_MASK 0x1 /end MEASUREMENT
/begin MEASUREMENT Vbx_diag_ena_mis_unk_lpg_cata "Unknown Cylinder Misfire LPG Detected Destructive Catalyst diagnostic authorization" UBYTE _CNV_S_2_RANGE______3_CM 1 0. 0. 1. ECU_ADDRESS 0xd00066fc BIT_MASK 0x1 /end MEASUREMENT
/begin MEASUREMENT Vbx_diag_ena_mis_unk_lpg_trs_h "Unknown Cylinder Misfire LPG Detected Pollution diagnostic authorization" UBYTE _CNV_S_2_RANGE______3_CM 1 0. 0. 1. ECU_ADDRESS 0xd00066fd BIT_MASK 0x1 /end MEASUREMENT
/begin MEASUREMENT Vbx_diag_ena_mis_unk_trs_h "Unknown Cylinder Misfire Detected Pollution diagnostic authorization" UBYTE _CNV_S_2_RANGE______3_CM 1 0. 0. 1. ECU_ADDRESS 0xd00066fe BIT_MASK 0x1 /end MEASUREMENT
/begin MEASUREMENT Vbx_dsb_diag_mis "Inhibition générale du diag misfire" UBYTE _CNV_S_2_RANGE______3_CM 1 0. 0. 1. ECU_ADDRESS 0xd00066ff BIT_MASK 0x1 /end MEASUREMENT
/begin MEASUREMENT Vbx_frst_inj_re "Init for the first rephasage" UBYTE _CNV_S_2_RANGE______3_CM 1 0. 0. 1. ECU_ADDRESS 0xd0006700 BIT_MASK 0x1 /end MEASUREMENT
/begin MEASUREMENT Vbx_mil_flsh_req "MIL flashing request status (0 switch off, 1 switch on)" UBYTE _CNV_S_2_RANGE______3_CM 1 0. 0. 1. ECU_ADDRESS 0xd0006701 BIT_MASK 0x1 /end MEASUREMENT
/begin MEASUREMENT Vbx_mis_cata_cf_vld "Misfire confirmed Destructive Catalyst validity status" UBYTE _CNV_S_2_RANGE______3_CM 1 0. 0. 1. ECU_ADDRESS 0xd0006702 BIT_MASK 0x1 /end MEASUREMENT
/begin MEASUREMENT Vbx_mis_cata_rst_done "Reset of catalyst window done" UBYTE _CNV_S_2_RANGE______3_CM 1 0. 0. 1. ECU_ADDRESS 0xd0006703 BIT_MASK 0x1 /end MEASUREMENT
/begin MEASUREMENT Vbx_mis_cata_win_stop "End of catalyst misifring window" UBYTE _CNV_S_2_RANGE______3_CM 1 0. 0. 1. ECU_ADDRESS 0xd0006704 BIT_MASK 0x1 /end MEASUREMENT
/begin MEASUREMENT Vbx_mis_cyl1 "Misfire détecté sur cylindre 1" UBYTE _CNV_S_2_RANGE______3_CM 1 0. 0. 1. ECU_ADDRESS 0xd0006705 BIT_MASK 0x1 /end MEASUREMENT
/begin MEASUREMENT Vbx_mis_cyl1_fail "Cylinder 1 misfiring" UBYTE _CNV_S_2_RANGE______3_CM 1 0. 0. 1. ECU_ADDRESS 0xd0006706 BIT_MASK 0x1 /end MEASUREMENT
/begin MEASUREMENT Vbx_mis_cyl2 "Misfire détecté sur cylindre 2" UBYTE _CNV_S_2_RANGE______3_CM 1 0. 0. 1. ECU_ADDRESS 0xd0006707 BIT_MASK 0x1 /end MEASUREMENT
/begin MEASUREMENT Vbx_mis_cyl2_fail "Cylinder 2 misfiring" UBYTE _CNV_S_2_RANGE______3_CM 1 0. 0. 1. ECU_ADDRESS 0xd0006708 BIT_MASK 0x1 /end MEASUREMENT
/begin MEASUREMENT Vbx_mis_cyl3 "Misfire détecté sur cylindre 3" UBYTE _CNV_S_2_RANGE______3_CM 1 0. 0. 1. ECU_ADDRESS 0xd0006709 BIT_MASK 0x1 /end MEASUREMENT
/begin MEASUREMENT Vbx_mis_cyl3_fail "Cylinder 3 misfiring" UBYTE _CNV_S_2_RANGE______3_CM 1 0. 0. 1. ECU_ADDRESS 0xd000670a BIT_MASK 0x1 /end MEASUREMENT
/begin MEASUREMENT Vbx_mis_cyl4 "Misfire détecté sur cylindre 4" UBYTE _CNV_S_2_RANGE______3_CM 1 0. 0. 1. ECU_ADDRESS 0xd000670b BIT_MASK 0x1 /end MEASUREMENT
/begin MEASUREMENT Vbx_mis_cyl4_fail "Cylinder 4 misfiring" UBYTE _CNV_S_2_RANGE______3_CM 1 0. 0. 1. ECU_ADDRESS 0xd000670c BIT_MASK 0x1 /end MEASUREMENT
/begin MEASUREMENT Vbx_mis_det "Misfire (mauvaise combustion) reconnue" UBYTE _CNV_S_2_RANGE______3_CM 1 0. 0. 1. ECU_ADDRESS 0xd000670d BIT_MASK 0x1 /end MEASUREMENT
/begin MEASUREMENT Vbx_mis_det_1_2 "Détection Misfire 1 sur 2" UBYTE _CNV_S_2_RANGE______3_CM 1 0. 0. 1. ECU_ADDRESS 0xd000670e BIT_MASK 0x1 /end MEASUREMENT
/begin MEASUREMENT Vbx_mis_det_1_4 "Détection Misfire 1 sur 4" UBYTE _CNV_S_2_RANGE______3_CM 1 0. 0. 1. ECU_ADDRESS 0xd000670f BIT_MASK 0x1 /end MEASUREMENT
/begin MEASUREMENT Vbx_mis_det_1_4_prev2 "Misfire 1/4 detected tdc i-2" UBYTE _CNV_S_2_RANGE______3_CM 1 0. 0. 1. ECU_ADDRESS 0xd0006710 BIT_MASK 0x1 /end MEASUREMENT
/begin MEASUREMENT Vbx_mis_det_intm "Détection Misfire isolé" UBYTE _CNV_S_2_RANGE______3_CM 1 0. 0. 1. ECU_ADDRESS 0xd0006711 BIT_MASK 0x1 /end MEASUREMENT
/begin MEASUREMENT Vbx_mis_det_prev16 "Misfire detected in 16 TDC previous" UBYTE _CNV_S_2_RANGE______3_CM 1 0. 0. 1. ECU_ADDRESS 0xd0006712 BIT_MASK 0x1 /end MEASUREMENT
/begin MEASUREMENT Vbx_mis_frst_diag_done "Initialisation of Sxx_mis_ctr and Sxx_mis_ctr_lpg for first step" UBYTE _CNV_S_2_RANGE______3_CM 1 0. 0. 1. ECU_ADDRESS 0xd0006713 BIT_MASK 0x1 /end MEASUREMENT
/begin MEASUREMENT Vbx_mis_obd_diag_stop "Other OBD diagnosis inhibited by misfire strategy in State \"Out of Diagnosis\"" UBYTE _CNV_S_2_RANGE______3_CM 1 0. 0. 1. ECU_ADDRESS 0xd0006714 BIT_MASK 0x1 /end MEASUREMENT
/begin MEASUREMENT Vbx_mis_req "Requête de diagnostic misfire au séquenceur" UBYTE _CNV_S_2_RANGE______3_CM 1 0. 0. 1. ECU_ADDRESS 0xd0006715 BIT_MASK 0x1 /end MEASUREMENT
/begin MEASUREMENT Vbx_mis_stop "misfiring strategy freezed on the current TDC" UBYTE _CNV_S_2_RANGE______3_CM 1 0. 0. 1. ECU_ADDRESS 0xd0006716 BIT_MASK 0x1 /end MEASUREMENT
/begin MEASUREMENT Vbx_pres_mis_fast "Panne présente misfire \"rafale\" détectée" UBYTE _CNV_S_2_RANGE______3_CM 1 0. 0. 1. ECU_ADDRESS 0xd0006717 BIT_MASK 0x1 /end MEASUREMENT
/begin MEASUREMENT Vsx_mis_cata_vld "Catalyst misfire validity status" UBYTE _CNV_S_8_STATUS_OK__234_CM 1 0. 0. 7. ECU_ADDRESS 0xd0006718 /end MEASUREMENT
/begin MEASUREMENT Vsx_mis_stt "State Misfire Diagnostic" UBYTE _CNV_A_R_ECME_LINEA_0_CM 1 0. 0. 255. ECU_ADDRESS 0xd0006719 FORMAT "%3.0" /end MEASUREMENT
/begin MEASUREMENT Vsx_mis_vld "Misfire validity status" UBYTE _CNV_S_8_STATUS_OK__234_CM 1 0. 0. 7. ECU_ADDRESS 0xd000671a /end MEASUREMENT
/begin MEASUREMENT Vxx_agb_conv_trs_dly "Inhibition Delay Misfire diagnostic" UWORD _CNV_A_R_LINEAR_____408_CM 1 0. 0. 32767.5 ECU_ADDRESS 0xd0003f98 FORMAT "%7.1" /end MEASUREMENT
/begin MEASUREMENT Vxx_eal_ofs_agb_dri "offset sur charge si bva en drive pour misfire" UWORD _CNV_A_R_LINEAR_____53_CM 1 0. 0. 3.99993896484375 ECU_ADDRESS 0xd0003f9a FORMAT "%10.8" /end MEASUREMENT
/begin MEASUREMENT Vxx_max_iga_efy_prev2 "torque efficiency corresponding to maximum ignition advance in tdc i-2" UWORD _CNV_A_R_LINEAR_____183_CM 1 0. 0. 1. ECU_ADDRESS 0xd0003f9c FORMAT "%11.8" /end MEASUREMENT
/begin MEASUREMENT Vxx_min_eal_1_2 "Output of Table de masses d’air minimum = f(Vxx_prev2_n ) pour autorisation de diag misfire en mode 1/2" UWORD _CNV_A_R_LINEAR_____53_CM 1 0. 0. 3.99993896484375 ECU_ADDRESS 0xd0003f9e FORMAT "%10.8" /end MEASUREMENT
/begin MEASUREMENT Vxx_mis_16_mis_ctr "Misfire Counter in last 16 TDC" UBYTE _CNV_A_R_ECME_LINEA_0_CM 1 0. 0. 255. ECU_ADDRESS 0xd000671b FORMAT "%3.0" /end MEASUREMENT
/begin MEASUREMENT Vxx_mis_cata_degr "Output of Cartographie (L: Régime , C: pression) de pondération misfire pour dégradation cata" UBYTE _CNV_A_R_ECME_LINEA_0_CM 1 0. 0. 255. ECU_ADDRESS 0xd000671c FORMAT "%3.0" /end MEASUREMENT
/begin MEASUREMENT Vxx_mis_cata_min_fuel_nr "Nombre de misfire cata détectés sous niveau mini de carburant" UBYTE _CNV_A_R_ECME_LINEA_0_CM 1 0. 0. 255. ECU_ADDRESS 0xd000671d FORMAT "%3.0" /end MEASUREMENT
/begin MEASUREMENT Vxx_mis_cata_mis_ctr "Compteur de misfire dans fenetre misfire cata" UWORD _CNV_A_R_ECME_LINEA_0_CM 1 0. 0. 65535. ECU_ADDRESS 0xd0003fa0 FORMAT "%5.0" /end MEASUREMENT
/begin MEASUREMENT Vxx_mis_cata_tdc_ctr "Compteur de pmh dans fenetre misfire cata" UWORD _CNV_A_R_LINEAR_____101_CM 1 0. 0. 65535. ECU_ADDRESS 0xd0003fa2 FORMAT "%5.0" /end MEASUREMENT
/begin MEASUREMENT Vxx_mis_cata_tdc_nr_tot "Total number of TDC under catalyst misfire present failure" ULONG _CNV_A_R_LINEAR_____101_CM 1 0. 0. 2147483647. ECU_ADDRESS 0xd0002510 FORMAT "%10.0" /end MEASUREMENT
/begin MEASUREMENT Vxx_mis_cata_tdc_prmt "Total number of TDC under catalyst misfire present failure (permanent)" ULONG _CNV_A_R_LINEAR_____101_CM 1 0. 0. 2147483647. ECU_ADDRESS 0xd0002514 FORMAT "%10.0" /end MEASUREMENT
/begin MEASUREMENT Vxx_mis_cata_win_mis_nr "Nombre de pmh mini pour diag misfire cata" UWORD _CNV_A_R_LINEAR_____101_CM 1 0. 0. 65535. ECU_ADDRESS 0xd0003fa4 FORMAT "%5.0" /end MEASUREMENT
/begin MEASUREMENT Vxx_mis_ctr_ini "Valeur EEPROM init du Misfire counter for Service 6" UWORD _CNV_A_R_ECME_LINEA_0_CM 1 0. 0. 65535. ECU_ADDRESS 0xd0003fa6 FORMAT "%5.0" /end MEASUREMENT
/begin MEASUREMENT Vxx_mis_ctr_lpg_ini "Valeur EEPROM init du Misfire counter LPG for Service 6" UWORD _CNV_A_R_ECME_LINEA_0_CM 1 0. 0. 65535. ECU_ADDRESS 0xd0003fa8 FORMAT "%5.0" /end MEASUREMENT
/begin MEASUREMENT Vxx_mis_cyl1_tdc_ctr "Tdc counter o cylinder 1" UWORD _CNV_A_R_LINEAR_____101_CM 1 0. 0. 65535. ECU_ADDRESS 0xd0003faa FORMAT "%5.0" /end MEASUREMENT
/begin MEASUREMENT Vxx_mis_cyl2_tdc_ctr "Tdc counter o cylinder 2" UWORD _CNV_A_R_LINEAR_____101_CM 1 0. 0. 65535. ECU_ADDRESS 0xd0003fac FORMAT "%5.0" /end MEASUREMENT
/begin MEASUREMENT Vxx_mis_cyl3_tdc_ctr "Tdc counter o cylinder 3" UWORD _CNV_A_R_LINEAR_____101_CM 1 0. 0. 65535. ECU_ADDRESS 0xd0003fae FORMAT "%5.0" /end MEASUREMENT
/begin MEASUREMENT Vxx_mis_cyl4_tdc_ctr "Tdc counter o cylinder 4" UWORD _CNV_A_R_LINEAR_____101_CM 1 0. 0. 65535. ECU_ADDRESS 0xd0003fb0 FORMAT "%5.0" /end MEASUREMENT
/begin MEASUREMENT Vxx_mis_diag_dsb_dly "Inhibition Delay Misfire diagnostic" UWORD _CNV_A_R_LINEAR_____408_CM 1 0. 0. 32767.5 ECU_ADDRESS 0xd0003fb2 FORMAT "%7.1" /end MEASUREMENT
/begin MEASUREMENT Vxx_mis_dt "Output of a RSA timer for the statemachine for the decrement of Vxx_mis_obd_diag_stop" UBYTE _CNV_A_R_LINEAR_____32_CM 1 0. 0. 2.55 ECU_ADDRESS 0xd000671e FORMAT "%4.2" /end MEASUREMENT
/begin MEASUREMENT Vxx_mis_eal_frz "Filtered engine air load for misfiring freeze frame" UBYTE _CNV_A_R_LINEAR_____165_CM 1 0. 0. 100. ECU_ADDRESS 0xd000671f FORMAT "%12.8" /end MEASUREMENT
/begin MEASUREMENT Vxx_mis_eol_mod_mis_ctr "Compteur de misfire en mode diagnostic fin de chaine" UWORD _CNV_A_R_ECME_LINEA_0_CM 1 0. 0. 65535. ECU_ADDRESS 0xd0003fb4 FORMAT "%5.0" /end MEASUREMENT
/begin MEASUREMENT Vxx_mis_eol_mod_prop "Pourcentage de misfire en mode diagnostic fin de chaine" UBYTE _CNV_A_R_LINEAR_____409_CM 1 0. 0. 100. ECU_ADDRESS 0xd0006720 FORMAT "%3.1" /end MEASUREMENT
/begin MEASUREMENT Vxx_mis_eol_mod_tdc_ctr "Compteur de pmh en mode diagnostic fin de chaine" UWORD _CNV_A_R_LINEAR_____101_CM 1 0. 0. 65535. ECU_ADDRESS 0xd0003fb6 FORMAT "%5.0" /end MEASUREMENT
/begin MEASUREMENT Vxx_mis_fast_mis_ctr "Compteur de misfire dans fenetre glissante misfire" UBYTE _CNV_A_R_ECME_LINEA_0_CM 1 0. 0. 255. ECU_ADDRESS 0xd0006721 FORMAT "%3.0" /end MEASUREMENT
/begin MEASUREMENT Vxx_mis_fast_tdc_ctr "Compteur de pmh dans fenetre glissante misfire" UBYTE _CNV_A_R_LINEAR_____101_CM 1 0. 0. 255. ECU_ADDRESS 0xd0006722 FORMAT "%3.0" /end MEASUREMENT
/begin MEASUREMENT Vxx_mis_iga_efy_dif_2 "Output of cartography torque efficiency corresponding to maximum ignition advance" UWORD _CNV_A_R_LINEAR_____183_CM 1 0. 0. 1. ECU_ADDRESS 0xd0003fb8 FORMAT "%11.9" /end MEASUREMENT
/begin MEASUREMENT Vxx_mis_l_n_tdc_ctr "Compteur de pmh à bas régime pour le diagnostic Misfire" UWORD _CNV_A_R_LINEAR_____101_CM 1 0. 0. 65535. ECU_ADDRESS 0xd0003fba FORMAT "%5.0" /end MEASUREMENT
/begin MEASUREMENT Vxx_mis_n_frz "Filtered engine speed for misfiring freeze frame" UWORD _CNV_A_R_ENSD_LINEA_22_CM 1 0. 0. 16383.75 ECU_ADDRESS 0xd0003fbc FORMAT "%8.2" /end MEASUREMENT
/begin MEASUREMENT Vxx_mis_n_max_thd_1_n "Maximum engine speed for 1/n misfiring detection" UWORD _CNV_A_R_ENSD_LINEA_22_CM 1 0. 0. 16383.75 ECU_ADDRESS 0xd0003fbe FORMAT "%8.2" /end MEASUREMENT
/begin MEASUREMENT Vxx_mis_nr_cyl1 "Nombre de misfire détectés sur le cylindre 1" UWORD _CNV_A_R_ECME_LINEA_0_CM 1 0. 0. 65535. ECU_ADDRESS 0xd0003fc0 FORMAT "%5.0" /end MEASUREMENT
/begin MEASUREMENT Vxx_mis_nr_cyl2 "Nombre de misfire détectés sur le cylindre 2" UWORD _CNV_A_R_ECME_LINEA_0_CM 1 0. 0. 65535. ECU_ADDRESS 0xd0003fc2 FORMAT "%5.0" /end MEASUREMENT
/begin MEASUREMENT Vxx_mis_nr_cyl3 "Nombre de misfire détectés sur le cylindre 3" UWORD _CNV_A_R_ECME_LINEA_0_CM 1 0. 0. 65535. ECU_ADDRESS 0xd0003fc4 FORMAT "%5.0" /end MEASUREMENT
/begin MEASUREMENT Vxx_mis_nr_cyl4 "Nombre de misfire détectés sur le cylindre 4" UWORD _CNV_A_R_ECME_LINEA_0_CM 1 0. 0. 65535. ECU_ADDRESS 0xd0003fc6 FORMAT "%5.0" /end MEASUREMENT
/begin MEASUREMENT Vxx_mis_obd_diag_stop "Temporisation d'inhibition des diags obd par le misfire" UBYTE _CNV_A_R_LINEAR_____32_CM 1 0. 0. 2.55 ECU_ADDRESS 0xd0006723 FORMAT "%4.2" /end MEASUREMENT
/begin MEASUREMENT Vxx_mis_polu_mis_ctr "Compteur de misfire dans fenetre misfire pollu" UWORD _CNV_A_R_ECME_LINEA_0_CM 1 0. 0. 65535. ECU_ADDRESS 0xd0003fc8 FORMAT "%5.0" /end MEASUREMENT
/begin MEASUREMENT Vxx_mis_polu_tdc_ctr "Compteur de pmh dans fenetre misfire pollu" UWORD _CNV_A_R_LINEAR_____101_CM 1 0. 0. 65535. ECU_ADDRESS 0xd0003fca FORMAT "%5.0" /end MEASUREMENT
/begin MEASUREMENT Vxx_mis_polu_tot_ctr "Compteur de misfire pollu total" UBYTE _CNV_A_R_ECME_LINEA_0_CM 1 0. 0. 255. ECU_ADDRESS 0xd0006724 FORMAT "%3.0" /end MEASUREMENT
/begin MEASUREMENT Vxx_mis_polu_win_ctr "Compteur de misfire pollu consécutifs" UBYTE _CNV_A_R_ECME_LINEA_0_CM 1 0. 0. 255. ECU_ADDRESS 0xd0006725 FORMAT "%3.0" /end MEASUREMENT
/begin MEASUREMENT Vxx_mis_polu_win_mis_nr "Nombre de pmh mini pour diag misfire pollu" UWORD _CNV_A_R_LINEAR_____101_CM 1 0. 0. 65535. ECU_ADDRESS 0xd0003fcc FORMAT "%5.0" /end MEASUREMENT
/begin MEASUREMENT Vxx_mis_stab_tdc_ctr "Compteur de pmh pour stabilisation avant diag misfire" UBYTE _CNV_A_R_LINEAR_____101_CM 1 0. 0. 255. ECU_ADDRESS 0xd0006726 FORMAT "%3.0" /end MEASUREMENT
/begin MEASUREMENT Vxx_mis_tq_dif_fac_1_2 "Output of Cartography of thresold for misfire 1/2 detection" UBYTE _CNV_A_R_LINEAR_____410_CM 1 0. 0. 1. ECU_ADDRESS 0xd0006727 FORMAT "%5.3" /end MEASUREMENT
/begin MEASUREMENT Vxx_mis_tq_dif_fac_1_2_dz "Output of Cartography of dead zone thresold for misfire 1/2 detection" UBYTE _CNV_A_R_LINEAR_____410_CM 1 0. 0. 1. ECU_ADDRESS 0xd0006728 FORMAT "%5.3" /end MEASUREMENT
/begin MEASUREMENT Vxx_mis_tq_dif_fac_1_4 "Output of Cartography of thresold for misfire 1/4 detection" UBYTE _CNV_A_R_LINEAR_____410_CM 1 0. 0. 1. ECU_ADDRESS 0xd0006729 FORMAT "%5.3" /end MEASUREMENT
/begin MEASUREMENT Vxx_mis_tq_dif_fac_1_4_dz "Output of Cartography of dead zone thresold for misfire 1/4 detection" UBYTE _CNV_A_R_LINEAR_____410_CM 1 0. 0. 1. ECU_ADDRESS 0xd000672a FORMAT "%5.3" /end MEASUREMENT
/begin MEASUREMENT Vxx_mis_tq_dif_fac_intm "Output of Cartography of thresold for misfire iso detection" UBYTE _CNV_A_R_LINEAR_____410_CM 1 0. 0. 1. ECU_ADDRESS 0xd000672b FORMAT "%5.3" /end MEASUREMENT
/begin MEASUREMENT Vxx_mis_tq_dif_intm_dz "Output of Cartography of dead zone thresold for misfire iso detection" UBYTE _CNV_A_R_LINEAR_____410_CM 1 0. 0. 1. ECU_ADDRESS 0xd000672c FORMAT "%5.3" /end MEASUREMENT
/begin CHARACTERISTIC Cbx_mis_conf_diag_mis "Configuration Misfire strategy" VALUE 0xa0020e32 _REC_S1VAL_20_u1 1. _CNV_S_2_RANGE______3_CM 0. 1. BIT_MASK 0x1 /end CHARACTERISTIC
/begin CHARACTERISTIC Cxx_agb_conv_trs_dly "Calibration Inhibition Delay Misfire diagnostic" VALUE 0xa0020db0 _REC_S1VAL_20_u2 32767.5 _CNV_A_R_LINEAR_____408_CM 0. 32767.5 FORMAT "%3.1" /end CHARACTERISTIC
/begin CHARACTERISTIC Cxx_dfdec_mis_1_cata "Cylinder 1 Misfire Detected Destructive Catalyst detected failure counter decrement" VALUE 0xa0020db2 _REC_S1VAL_20_u2 65535. _CNV_A_R_ECME_LINEA_0_CM 0. 65535. FORMAT "%5.0" /end CHARACTERISTIC
/begin CHARACTERISTIC Cxx_dfdec_mis_1_lpg_cata "Cylinder 1 Misfire LPG Detected Destructive Catalyst detected failure counter decrement" VALUE 0xa0020db4 _REC_S1VAL_20_u2 65535. _CNV_A_R_ECME_LINEA_0_CM 0. 65535. FORMAT "%5.0" /end CHARACTERISTIC
/begin CHARACTERISTIC Cxx_dfdec_mis_1_lpg_trs_h "Cylinder 1 Misfire LPG Detected Pollution detected failure counter decrement" VALUE 0xa0020db6 _REC_S1VAL_20_u2 65535. _CNV_A_R_ECME_LINEA_0_CM 0. 65535. FORMAT "%5.0" /end CHARACTERISTIC
/begin CHARACTERISTIC Cxx_dfdec_mis_1_trs_h "Cylinder 1 Misfire Detected Pollution detected failure counter decrement" VALUE 0xa0020db8 _REC_S1VAL_20_u2 65535. _CNV_A_R_ECME_LINEA_0_CM 0. 65535. FORMAT "%5.0" /end CHARACTERISTIC
/begin CHARACTERISTIC Cxx_dfdec_mis_2_cata "Cylinder 2 Misfire Detected Destructive Catalyst detected failure counter decrement" VALUE 0xa0020dba _REC_S1VAL_20_u2 65535. _CNV_A_R_ECME_LINEA_0_CM 0. 65535. FORMAT "%5.0" /end CHARACTERISTIC
/begin CHARACTERISTIC Cxx_dfdec_mis_2_lpg_cata "Cylinder 2 Misfire LPG Detected Destructive Catalyst detected failure counter decrement" VALUE 0xa0020dbc _REC_S1VAL_20_u2 65535. _CNV_A_R_ECME_LINEA_0_CM 0. 65535. FORMAT "%5.0" /end CHARACTERISTIC
/begin CHARACTERISTIC Cxx_dfdec_mis_2_lpg_trs_h "Cylinder 2 Misfire LPG Detected Pollution detected failure counter decrement" VALUE 0xa0020dbe _REC_S1VAL_20_u2 65535. _CNV_A_R_ECME_LINEA_0_CM 0. 65535. FORMAT "%5.0" /end CHARACTERISTIC
/begin CHARACTERISTIC Cxx_dfdec_mis_2_trs_h "Cylinder 2 Misfire Detected Pollution detected failure counter decrement" VALUE 0xa0020dc0 _REC_S1VAL_20_u2 65535. _CNV_A_R_ECME_LINEA_0_CM 0. 65535. FORMAT "%5.0" /end CHARACTERISTIC
/begin CHARACTERISTIC Cxx_dfdec_mis_3_cata "Cylinder 3 Misfire Detected Destructive Catalyst detected failure counter decrement" VALUE 0xa0020dc2 _REC_S1VAL_20_u2 65535. _CNV_A_R_ECME_LINEA_0_CM 0. 65535. FORMAT "%5.0" /end CHARACTERISTIC
/begin CHARACTERISTIC Cxx_dfdec_mis_3_lpg_cata "Cylinder 3 Misfire LPG Detected Destructive Catalyst detected failure counter decrement" VALUE 0xa0020dc4 _REC_S1VAL_20_u2 65535. _CNV_A_R_ECME_LINEA_0_CM 0. 65535. FORMAT "%5.0" /end CHARACTERISTIC
/begin CHARACTERISTIC Cxx_dfdec_mis_3_lpg_trs_h "Cylinder 3 Misfire LPG Detected Pollution detected failure counter decrement" VALUE 0xa0020dc6 _REC_S1VAL_20_u2 65535. _CNV_A_R_ECME_LINEA_0_CM 0. 65535. FORMAT "%5.0" /end CHARACTERISTIC
/begin CHARACTERISTIC Cxx_dfdec_mis_3_trs_h "Cylinder 3 Misfire Detected Pollution detected failure counter decrement" VALUE 0xa0020dc8 _REC_S1VAL_20_u2 65535. _CNV_A_R_ECME_LINEA_0_CM 0. 65535. FORMAT "%5.0" /end CHARACTERISTIC
/begin CHARACTERISTIC Cxx_dfdec_mis_4_cata "Cylinder 4 Misfire Detected Destructive Catalyst detected failure counter decrement" VALUE 0xa0020dca _REC_S1VAL_20_u2 65535. _CNV_A_R_ECME_LINEA_0_CM 0. 65535. FORMAT "%5.0" /end CHARACTERISTIC
/begin CHARACTERISTIC Cxx_dfdec_mis_4_lpg_cata "Cylinder 4 Misfire LPG Detected Destructive Catalyst detected failure counter decrement" VALUE 0xa0020dcc _REC_S1VAL_20_u2 65535. _CNV_A_R_ECME_LINEA_0_CM 0. 65535. FORMAT "%5.0" /end CHARACTERISTIC
/begin CHARACTERISTIC Cxx_dfdec_mis_4_lpg_trs_h "Cylinder 4 Misfire LPG Detected Pollution detected failure counter decrement" VALUE 0xa0020dce _REC_S1VAL_20_u2 65535. _CNV_A_R_ECME_LINEA_0_CM 0. 65535. FORMAT "%5.0" /end CHARACTERISTIC
/begin CHARACTERISTIC Cxx_dfdec_mis_4_trs_h "Cylinder 4 Misfire Detected Pollution detected failure counter decrement" VALUE 0xa0020dd0 _REC_S1VAL_20_u2 65535. _CNV_A_R_ECME_LINEA_0_CM 0. 65535. FORMAT "%5.0" /end CHARACTERISTIC
/begin CHARACTERISTIC Cxx_dfdec_mis_cata "Misfire Detected Destructive Catalyst detected failure counter decrement" VALUE 0xa0020dd2 _REC_S1VAL_20_u2 65535. _CNV_A_R_ECME_LINEA_0_CM 0. 65535. FORMAT "%5.0" /end CHARACTERISTIC
/begin CHARACTERISTIC Cxx_dfdec_mis_lpg_cata "Misfire LPG Detected Destructive Catalyst detected failure counter decrement" VALUE 0xa0020dd4 _REC_S1VAL_20_u2 65535. _CNV_A_R_ECME_LINEA_0_CM 0. 65535. FORMAT "%5.0" /end CHARACTERISTIC
/begin CHARACTERISTIC Cxx_dfdec_mis_lpg_trs_h "Misfire LPG Detected Pollution detected failure counter decrement" VALUE 0xa0020dd6 _REC_S1VAL_20_u2 65535. _CNV_A_R_ECME_LINEA_0_CM 0. 65535. FORMAT "%5.0" /end CHARACTERISTIC
/begin CHARACTERISTIC Cxx_dfdec_mis_min_fuel_cata "Misfire Detected with Low Fuel Destructive Catalyst detected failure counter decrement" VALUE 0xa0020dd8 _REC_S1VAL_20_u2 65535. _CNV_A_R_ECME_LINEA_0_CM 0. 65535. FORMAT "%5.0" /end CHARACTERISTIC
/begin CHARACTERISTIC Cxx_dfdec_mis_min_fuel_trs_h "Misfire Detected with Low Fuel Pollution detected failure counter decrement" VALUE 0xa0020dda _REC_S1VAL_20_u2 65535. _CNV_A_R_ECME_LINEA_0_CM 0. 65535. FORMAT "%5.0" /end CHARACTERISTIC
/begin CHARACTERISTIC Cxx_dfdec_mis_trs_h "Misfire Detected Pollution detected failure counter decrement" VALUE 0xa0020ddc _REC_S1VAL_20_u2 65535. _CNV_A_R_ECME_LINEA_0_CM 0. 65535. FORMAT "%5.0" /end CHARACTERISTIC
/begin CHARACTERISTIC Cxx_dfdec_mis_unk_cata "Unknown Cylinder Misfire Detected Destructive Catalyst detected failure counter decrement" VALUE 0xa0020dde _REC_S1VAL_20_u2 65535. _CNV_A_R_ECME_LINEA_0_CM 0. 65535. FORMAT "%5.0" /end CHARACTERISTIC
/begin CHARACTERISTIC Cxx_dfdec_mis_unk_lpg_cata "Unknown Cylinder Misfire LPG Detected Destructive Catalyst detected failure counter decrement" VALUE 0xa0020de0 _REC_S1VAL_20_u2 65535. _CNV_A_R_ECME_LINEA_0_CM 0. 65535. FORMAT "%5.0" /end CHARACTERISTIC
/begin CHARACTERISTIC Cxx_dfdec_mis_unk_lpg_trs_h "Unknown Cylinder Misfire LPG Detected Pollution detected failure counter decrement" VALUE 0xa0020de2 _REC_S1VAL_20_u2 65535. _CNV_A_R_ECME_LINEA_0_CM 0. 65535. FORMAT "%5.0" /end CHARACTERISTIC
/begin CHARACTERISTIC Cxx_dfdec_mis_unk_trs_h "Unknown Cylinder Misfire Detected Pollution detected failure counter decrement" VALUE 0xa0020de4 _REC_S1VAL_20_u2 65535. _CNV_A_R_ECME_LINEA_0_CM 0. 65535. FORMAT "%5.0" /end CHARACTERISTIC
/begin CHARACTERISTIC Cxx_dfinc_mis_1_cata "Cylinder 1 Misfire Detected Destructive Catalyst detected failure counter increment" VALUE 0xa0020de6 _REC_S1VAL_20_u2 65535. _CNV_A_R_ECME_LINEA_0_CM 0. 65535. FORMAT "%5.0" /end CHARACTERISTIC
/begin CHARACTERISTIC Cxx_dfinc_mis_1_lpg_cata "Cylinder 1 Misfire LPG Detected Destructive Catalyst detected failure counter increment" VALUE 0xa0020de8 _REC_S1VAL_20_u2 65535. _CNV_A_R_ECME_LINEA_0_CM 0. 65535. FORMAT "%5.0" /end CHARACTERISTIC
/begin CHARACTERISTIC Cxx_dfinc_mis_1_lpg_trs_h "Cylinder 1 Misfire LPG Detected Pollution detected failure counter increment" VALUE 0xa0020dea _REC_S1VAL_20_u2 65535. _CNV_A_R_ECME_LINEA_0_CM 0. 65535. FORMAT "%5.0" /end CHARACTERISTIC
/begin CHARACTERISTIC Cxx_dfinc_mis_1_trs_h "Cylinder 1 Misfire Detected Pollution detected failure counter increment" VALUE 0xa0020dec _REC_S1VAL_20_u2 65535. _CNV_A_R_ECME_LINEA_0_CM 0. 65535. FORMAT "%5.0" /end CHARACTERISTIC
/begin CHARACTERISTIC Cxx_dfinc_mis_2_cata "Cylinder 2 Misfire Detected Destructive Catalyst detected failure counter increment" VALUE 0xa0020dee _REC_S1VAL_20_u2 65535. _CNV_A_R_ECME_LINEA_0_CM 0. 65535. FORMAT "%5.0" /end CHARACTERISTIC
/begin CHARACTERISTIC Cxx_dfinc_mis_2_lpg_cata "Cylinder 2 Misfire LPG Detected Destructive Catalyst detected failure counter increment" VALUE 0xa0020df0 _REC_S1VAL_20_u2 65535. _CNV_A_R_ECME_LINEA_0_CM 0. 65535. FORMAT "%5.0" /end CHARACTERISTIC
/begin CHARACTERISTIC Cxx_dfinc_mis_2_lpg_trs_h "Cylinder 2 Misfire LPG Detected Pollution detected failure counter increment" VALUE 0xa0020df2 _REC_S1VAL_20_u2 65535. _CNV_A_R_ECME_LINEA_0_CM 0. 65535. FORMAT "%5.0" /end CHARACTERISTIC
/begin CHARACTERISTIC Cxx_dfinc_mis_2_trs_h "Cylinder 2 Misfire Detected Pollution detected failure counter increment" VALUE 0xa0020df4 _REC_S1VAL_20_u2 65535. _CNV_A_R_ECME_LINEA_0_CM 0. 65535. FORMAT "%5.0" /end CHARACTERISTIC
/begin CHARACTERISTIC Cxx_dfinc_mis_3_cata "Cylinder 3 Misfire Detected Destructive Catalyst detected failure counter increment" VALUE 0xa0020df6 _REC_S1VAL_20_u2 65535. _CNV_A_R_ECME_LINEA_0_CM 0. 65535. FORMAT "%5.0" /end CHARACTERISTIC
/begin CHARACTERISTIC Cxx_dfinc_mis_3_lpg_cata "Cylinder 3 Misfire LPG Detected Destructive Catalyst detected failure counter increment" VALUE 0xa0020df8 _REC_S1VAL_20_u2 65535. _CNV_A_R_ECME_LINEA_0_CM 0. 65535. FORMAT "%5.0" /end CHARACTERISTIC
/begin CHARACTERISTIC Cxx_dfinc_mis_3_lpg_trs_h "Cylinder 3 Misfire LPG Detected Pollution detected failure counter increment" VALUE 0xa0020dfa _REC_S1VAL_20_u2 65535. _CNV_A_R_ECME_LINEA_0_CM 0. 65535. FORMAT "%5.0" /end CHARACTERISTIC
/begin CHARACTERISTIC Cxx_dfinc_mis_3_trs_h "Cylinder 3 Misfire Detected Pollution detected failure counter increment" VALUE 0xa0020dfc _REC_S1VAL_20_u2 65535. _CNV_A_R_ECME_LINEA_0_CM 0. 65535. FORMAT "%5.0" /end CHARACTERISTIC
/begin CHARACTERISTIC Cxx_dfinc_mis_4_cata "Cylinder 4 Misfire Detected Destructive Catalyst detected failure counter increment" VALUE 0xa0020dfe _REC_S1VAL_20_u2 65535. _CNV_A_R_ECME_LINEA_0_CM 0. 65535. FORMAT "%5.0" /end CHARACTERISTIC
/begin CHARACTERISTIC Cxx_dfinc_mis_4_lpg_cata "Cylinder 4 Misfire LPG Detected Destructive Catalyst detected failure counter increment" VALUE 0xa0020e00 _REC_S1VAL_20_u2 65535. _CNV_A_R_ECME_LINEA_0_CM 0. 65535. FORMAT "%5.0" /end CHARACTERISTIC
/begin CHARACTERISTIC Cxx_dfinc_mis_4_lpg_trs_h "Cylinder 4 Misfire LPG Detected Pollution detected failure counter increment" VALUE 0xa0020e02 _REC_S1VAL_20_u2 65535. _CNV_A_R_ECME_LINEA_0_CM 0. 65535. FORMAT "%5.0" /end CHARACTERISTIC
/begin CHARACTERISTIC Cxx_dfinc_mis_4_trs_h "Cylinder 4 Misfire Detected Pollution detected failure counter increment" VALUE 0xa0020e04 _REC_S1VAL_20_u2 65535. _CNV_A_R_ECME_LINEA_0_CM 0. 65535. FORMAT "%5.0" /end CHARACTERISTIC
/begin CHARACTERISTIC Cxx_dfinc_mis_cata "Misfire Detected Destructive Catalyst detected failure counter increment" VALUE 0xa0020e06 _REC_S1VAL_20_u2 65535. _CNV_A_R_ECME_LINEA_0_CM 0. 65535. FORMAT "%5.0" /end CHARACTERISTIC
/begin CHARACTERISTIC Cxx_dfinc_mis_lpg_cata "Misfire LPG Detected Destructive Catalyst detected failure counter increment" VALUE 0xa0020e08 _REC_S1VAL_20_u2 65535. _CNV_A_R_ECME_LINEA_0_CM 0. 65535. FORMAT "%5.0" /end CHARACTERISTIC
/begin CHARACTERISTIC Cxx_dfinc_mis_lpg_trs_h "Misfire LPG Detected Pollution detected failure counter increment" VALUE 0xa0020e0a _REC_S1VAL_20_u2 65535. _CNV_A_R_ECME_LINEA_0_CM 0. 65535. FORMAT "%5.0" /end CHARACTERISTIC
/begin CHARACTERISTIC Cxx_dfinc_mis_min_fuel_cata "Misfire Detected with Low Fuel Destructive Catalyst detected failure counter increment" VALUE 0xa0020e0c _REC_S1VAL_20_u2 65535. _CNV_A_R_ECME_LINEA_0_CM 0. 65535. FORMAT "%5.0" /end CHARACTERISTIC
/begin CHARACTERISTIC Cxx_dfinc_mis_min_fuel_trs_h "Misfire Detected with Low Fuel Pollution detected failure counter increment" VALUE 0xa0020e0e _REC_S1VAL_20_u2 65535. _CNV_A_R_ECME_LINEA_0_CM 0. 65535. FORMAT "%5.0" /end CHARACTERISTIC
/begin CHARACTERISTIC Cxx_dfinc_mis_trs_h "Misfire Detected Pollution detected failure counter increment" VALUE 0xa0020e10 _REC_S1VAL_20_u2 65535. _CNV_A_R_ECME_LINEA_0_CM 0. 65535. FORMAT "%5.0" /end CHARACTERISTIC
/begin CHARACTERISTIC Cxx_dfinc_mis_unk_cata "Unknown Cylinder Misfire Detected Destructive Catalyst detected failure counter increment" VALUE 0xa0020e12 _REC_S1VAL_20_u2 65535. _CNV_A_R_ECME_LINEA_0_CM 0. 65535. FORMAT "%5.0" /end CHARACTERISTIC
/begin CHARACTERISTIC Cxx_dfinc_mis_unk_lpg_cata "Unknown Cylinder Misfire LPG Detected Destructive Catalyst detected failure counter increment" VALUE 0xa0020e14 _REC_S1VAL_20_u2 65535. _CNV_A_R_ECME_LINEA_0_CM 0. 65535. FORMAT "%5.0" /end CHARACTERISTIC
/begin CHARACTERISTIC Cxx_dfinc_mis_unk_lpg_trs_h "Unknown Cylinder Misfire LPG Detected Pollution detected failure counter increment" VALUE 0xa0020e16 _REC_S1VAL_20_u2 65535. _CNV_A_R_ECME_LINEA_0_CM 0. 65535. FORMAT "%5.0" /end CHARACTERISTIC
/begin CHARACTERISTIC Cxx_dfinc_mis_unk_trs_h "Unknown Cylinder Misfire Detected Pollution detected failure counter increment" VALUE 0xa0020e18 _REC_S1VAL_20_u2 65535. _CNV_A_R_ECME_LINEA_0_CM 0. 65535. FORMAT "%5.0" /end CHARACTERISTIC
/begin CHARACTERISTIC Cxx_min_diag_mis_dly "Delay Inhibition Misfire Diagnostic" VALUE 0xa0020e1a _REC_S1VAL_20_u2 32767.5 _CNV_A_R_LINEAR_____408_CM 0. 32767.5 FORMAT "%3.1" /end CHARACTERISTIC
/begin CHARACTERISTIC Cxx_mis_cata_win_mis_nr "Nombre de misfire dans fenetre misfire cata" VALUE 0xa0020e1c _REC_S1VAL_20_u2 65535. _CNV_A_R_ECME_LINEA_0_CM 0. 65535. FORMAT "%5.0" /end CHARACTERISTIC
/begin CHARACTERISTIC Cxx_mis_cata_win_mis_nr_1 "Nombre de misfire dans fenetre misfire cata au Gaz" VALUE 0xa0020e1e _REC_S1VAL_20_u2 65535. _CNV_A_R_ECME_LINEA_0_CM 0. 65535. FORMAT "%5.0" /end CHARACTERISTIC
/begin CHARACTERISTIC Cxx_mis_cata_win_tdc_nr "Nombre de pmh dans fenetre misfire cata" VALUE 0xa0020e20 _REC_S1VAL_20_u2 65535. _CNV_A_R_LINEAR_____101_CM 0. 65535. FORMAT "%5.0" /end CHARACTERISTIC
/begin CHARACTERISTIC Cxx_mis_cyl_fail_rat "Rate of misfires on one cylinder to declare cylinder faillure" VALUE 0xa0020e33 _REC_S1VAL_20_u1 0.99609375 _CNV_A_R_LINEAR_____29_CM 0. 0.99609375 FORMAT "%5.3" /end CHARACTERISTIC
/begin CHARACTERISTIC Cxx_mis_diag_obd_dsb_t "Temps maintien inhibition des diags obd par le misfire" VALUE 0xa0020e34 _REC_S1VAL_20_u1 2.55 _CNV_A_R_LINEAR_____32_CM 0. 2.55 FORMAT "%4.2" /end CHARACTERISTIC
/begin CHARACTERISTIC Cxx_mis_ena_n_max_thd "Seuil maximum de régime pour autoriser le diag misfire" VALUE 0xa0020e22 _REC_S1VAL_20_u2 16383.75 _CNV_A_R_ENSD_LINEA_22_CM 0. 16383.75 FORMAT "%8.2" /end CHARACTERISTIC
/begin CHARACTERISTIC Cxx_mis_ena_n_min_thd "Seuil minimum de régime pour autoriser le diag misfire" VALUE 0xa0020e24 _REC_S1VAL_20_u2 16383.75 _CNV_A_R_ENSD_LINEA_22_CM 0. 16383.75 FORMAT "%8.2" /end CHARACTERISTIC
/begin CHARACTERISTIC Cxx_mis_ena_tco_min_thd "Seuil minimum de température d'eau pour autoriser le diag misfire" VALUE 0xa0020e26 _REC_S1VAL_20_u2 240. _CNV_A_R_LINEAR_____110_CM -40. 200. FORMAT "%5.1" /end CHARACTERISTIC
/begin CHARACTERISTIC Cxx_mis_fast_win_mis_nr "Nombre de misfire dans fenetre glissante misfire" VALUE 0xa0020e35 _REC_S1VAL_20_u1 255. _CNV_A_R_ECME_LINEA_0_CM 0. 255. FORMAT "%3.0" /end CHARACTERISTIC
/begin CHARACTERISTIC Cxx_mis_fast_win_tdc_nr "Nombre de pmh dans fenetre glissante misfire" VALUE 0xa0020e36 _REC_S1VAL_20_u1 255. _CNV_A_R_LINEAR_____101_CM 0. 255. FORMAT "%3.0" /end CHARACTERISTIC
/begin CHARACTERISTIC Cxx_mis_n_max_agb_clos_no "Maximum engine speed to enable misfire detection on AGB not closed" VALUE 0xa0020e28 _REC_S1VAL_20_u2 16383.75 _CNV_A_R_ENSD_LINEA_22_CM 0. 16383.75 FORMAT "%8.2" /end CHARACTERISTIC
/begin CHARACTERISTIC Cxx_mis_ofs_eal_agb_ena "offet sur la charge pourautorisation diag misfire si bva en drive" VALUE 0xa0020e2a _REC_S1VAL_20_u2 1.99996948242188 _CNV_A_R_LINEAR_____48_CM 0. 1.99996948242188 FORMAT "%7.5" /end CHARACTERISTIC
/begin CHARACTERISTIC Cxx_mis_polu_win_mis_nr "Nombre de pmh mini pour diag misfire pollu" VALUE 0xa0020e2c _REC_S1VAL_20_u2 65535. _CNV_A_R_LINEAR_____101_CM 0. 65535. FORMAT "%5.0" /end CHARACTERISTIC
/begin CHARACTERISTIC Cxx_mis_polu_win_mis_nr_1 "Nombre de pmh mini pour diag misfire pollu au Gaz" VALUE 0xa0020e2e _REC_S1VAL_20_u2 65535. _CNV_A_R_LINEAR_____101_CM 0. 65535. FORMAT "%5.0" /end CHARACTERISTIC
/begin CHARACTERISTIC Cxx_mis_polu_win_nr_fail "Nombre minimum de fenêtres misfire pollu à prendre en compte pour déclaration panne" VALUE 0xa0020e37 _REC_S1VAL_20_u1 255. _CNV_A_R_ECME_LINEA_0_CM 0. 255. FORMAT "%3.0" /end CHARACTERISTIC
/begin CHARACTERISTIC Cxx_mis_polu_win_tdc_nr "Nombre de pmh dans fenetre misfire cata" VALUE 0xa0020e30 _REC_S1VAL_20_u2 65535. _CNV_A_R_LINEAR_____101_CM 0. 65535. FORMAT "%5.0" /end CHARACTERISTIC
/begin CHARACTERISTIC Cxx_mis_rat_min_cyl_ "Taux mini de misfire pour déclaration misfire sur cylindre considéré" VALUE 0xa0020e38 _REC_S1VAL_20_u1 255. _CNV_A_R_ECME_LINEA_0_CM 0. 255. FORMAT "%3.0" /end CHARACTERISTIC
/begin CHARACTERISTIC Cxx_mis_stab_tdc_nr "Nombre de pmh pour stabilisation avant diag misfire" VALUE 0xa0020e39 _REC_S1VAL_20_u1 255. _CNV_A_R_LINEAR_____101_CM 0. 255. FORMAT "%3.0" /end CHARACTERISTIC
/begin CHARACTERISTIC Ctd_n_prop_thd "offset of proportional activation" CURVE 0xa0034e64 _REC_A1CUR_20_u2_u1 16383.75 _CNV_A_R_ENSD_LINEA_22_CM 0. 16383.75 FORMAT "%8.2"
 /begin AXIS_DESCR COM_AXIS Vxx_gear _CNV_A_R_LINEAR_____145_CM 8 -1. 6. READ_ONLY FORMAT "%2.0" AXIS_PTS_REF Ntb_gear /end AXIS_DESCR
/end CHARACTERISTIC
/begin CHARACTERISTIC Ctd_ovn_tq_int_k "Gain for the Integrator" CURVE 0xa0034e74 _REC_A1CUR_20_u2_u1 255. _CNV_A_R_LINEAR_____411_CM 0. 255. FORMAT "%6.2"
 /begin AXIS_DESCR COM_AXIS Vxx_gear _CNV_A_R_LINEAR_____145_CM 8 -1. 6. READ_ONLY FORMAT "%2.0" AXIS_PTS_REF Ntb_gear /end AXIS_DESCR
/end CHARACTERISTIC
/begin CHARACTERISTIC Ctd_ovn_tq_prop_k "Gain for proportional" CURVE 0xa0034e84 _REC_A1CUR_20_u2_u1 255. _CNV_A_R_LINEAR_____411_CM 0. 255. FORMAT "%6.2"
 /begin AXIS_DESCR COM_AXIS Vxx_gear _CNV_A_R_LINEAR_____145_CM 8 -1. 6. READ_ONLY FORMAT "%2.0" AXIS_PTS_REF Ntb_gear /end AXIS_DESCR
/end CHARACTERISTIC
/begin MEASUREMENT Vxx_lim_dif_n "difference between the setpoint and the engine speed" SWORD _CNV_A_R_ENSD_LINEA_22_CM 1 0. -8192. 8191.75 ECU_ADDRESS 0xd0004938 FORMAT "%8.2" /end MEASUREMENT
/begin MEASUREMENT Vxx_lim_dif_n_prop "difference between the setpiont and the engine speed  + offset of proportional activation" SWORD _CNV_A_R_ENSD_LINEA_22_CM 1 0. -8192. 8191.75 ECU_ADDRESS 0xd000493a FORMAT "%8.2" /end MEASUREMENT
/begin MEASUREMENT Vxx_ovn_tq_cor "final torque corrective applied on maximum torque in case of overspeed." SWORD _CNV_A_R_LINEAR_____181_CM 1 0. -1024. 1023.96875 ECU_ADDRESS 0xd000493c FORMAT "%11.5" /end MEASUREMENT
/begin MEASUREMENT Vxx_ovn_tq_cor_p_i "torque corrective output of the PI" SWORD _CNV_A_R_LINEAR_____181_CM 1 0. -1024. 1023.96875 ECU_ADDRESS 0xd000493e FORMAT "%11.5" /end MEASUREMENT
/begin MEASUREMENT Vxx_ovn_tq_int "torque corrective output of the integrator" SWORD _CNV_A_R_LINEAR_____181_CM 1 0. -1024. 1023.96875 ECU_ADDRESS 0xd0004940 FORMAT "%11.5" /end MEASUREMENT
/begin MEASUREMENT Vxx_ovn_tq_prop "torque corrective output of the proportional" SWORD _CNV_A_R_LINEAR_____181_CM 1 0. -1024. 1023.96875 ECU_ADDRESS 0xd0004942 FORMAT "%11.5" /end MEASUREMENT
/begin CHARACTERISTIC Cxx_ovn_tq_prop_t_fil "Filter timer constant for engine speed in the loop proportional" VALUE 0xa0021e64 _REC_S1VAL_20_u1 2.55 _CNV_A_R_LINEAR_____32_CM 0. 2.55 FORMAT "%4.2" /end CHARACTERISTIC
/begin CHARACTERISTIC Cxx_tqe_max_ovn "torque saturation for the controller PI" VALUE 0xa0021e62 _REC_S1VAL_20_s2 2047.96875 _CNV_A_R_LINEAR_____181_CM -1024. 1023.96875 FORMAT "%11.5" /end CHARACTERISTIC
/begin MEASUREMENT Vbx_ovn_cut_sp "setpoint torque cut for over speed" UBYTE _CNV_S_2_RANGE______3_CM 1 0. 0. 1. ECU_ADDRESS 0xd00070fe BIT_MASK 0x1 /end MEASUREMENT
/begin CHARACTERISTIC Cxx_inj_stop_n_ofs "injection stop offset" VALUE 0xa0021e66 _REC_S1VAL_20_u2 16383.75 _CNV_A_R_ENSD_LINEA_22_CM 0. 16383.75 FORMAT "%8.2" /end CHARACTERISTIC
/begin MEASUREMENT Vxx_ovn_mon_km "Vehicle distance of last ovn monitoring" ULONG _CNV_A_R_LINEAR_____274_CM 1 0. 0. 16777215. DISPLAY_IDENTIFIER SmLimSpt_NVM.Vxx_ovn_mon_km_NVM ECU_ADDRESS 0xd0002c04 FORMAT "%10.0" /end MEASUREMENT
/begin MEASUREMENT Vxx_ovn_mon_n_max "Maximum engine speed of the vehicle" UWORD _CNV_A_R_ENSD_LINEA_22_CM 1 0. 0. 16383.75 DISPLAY_IDENTIFIER SmLimSpt_NVM.Vxx_ovn_mon_n_max_NVM ECU_ADDRESS 0xd0002c08 FORMAT "%8.2" /end MEASUREMENT
/begin MEASUREMENT Vxx_ovn_mon_dly_tot "total time in the overspeed monitoring" UWORD _CNV_A_R_LINEAR_____58_CM 1 0. 0. 6553.5 DISPLAY_IDENTIFIER SmLimSpt_NVM.Vxx_ovn_mon_dly_tot_NVM ECU_ADDRESS 0xd0002c0a FORMAT "%6.1" /end MEASUREMENT
/begin CHARACTERISTIC Ctd_gear_cge_max_n_ofs "Offset on nominal engine speed limitation (for gear change indicator light)" CURVE 0xa0034e94 _REC_A1CUR_20_u2_u1 16383.75 _CNV_A_R_LINEAR_____182_CM -8192. 8191.75 FORMAT "%7.2"
 /begin AXIS_DESCR COM_AXIS Vxx_gear _CNV_A_R_LINEAR_____145_CM 8 -1. 6. READ_ONLY FORMAT "%2.0" AXIS_PTS_REF Ntb_gear /end AXIS_DESCR
/end CHARACTERISTIC
/begin CHARACTERISTIC Ctp_max_n_gear "Maximum engine speed depending on gearbox ratio" CURVE 0xa0034ea4 _REC_A1CUR_20_u2_u1 16383.75 _CNV_A_R_ENSD_LINEA_22_CM 0. 16383.75 FORMAT "%8.2"
 /begin AXIS_DESCR COM_AXIS Vxx_gear _CNV_A_R_LINEAR_____145_CM 8 -1. 6. READ_ONLY FORMAT "%2.0" AXIS_PTS_REF Ntb_gear /end AXIS_DESCR
/end CHARACTERISTIC
/begin CHARACTERISTIC Ctp_max_n_nom_hys "Hysteresis threshold to define the engine speed range for injection cut phase" CURVE 0xa0034eb4 _REC_A1CUR_20_u2_u1 16383.75 _CNV_A_R_ENSD_LINEA_22_CM 0. 16383.75 FORMAT "%8.2"
 /begin AXIS_DESCR COM_AXIS Vxx_gear _CNV_A_R_LINEAR_____145_CM 8 -1. 6. READ_ONLY FORMAT "%2.0" AXIS_PTS_REF Ntb_gear /end AXIS_DESCR
/end CHARACTERISTIC
/begin CHARACTERISTIC Ctp_max_n_ovn_ofs "Offset to define engine speed regulation" CURVE 0xa0034ec4 _REC_A1CUR_20_u2_u1 16383.75 _CNV_A_R_ENSD_LINEA_22_CM 0. 16383.75 FORMAT "%8.2"
 /begin AXIS_DESCR COM_AXIS Vxx_gear _CNV_A_R_LINEAR_____145_CM 8 -1. 6. READ_ONLY FORMAT "%2.0" AXIS_PTS_REF Ntb_gear /end AXIS_DESCR
/end CHARACTERISTIC
/begin CHARACTERISTIC Ctp_max_n_tco "Maximum engine speed depending on coolant temperature" CURVE 0xa0034ed4 _REC_A1CUR_20_u2_u2 16383.75 _CNV_A_R_ENSD_LINEA_22_CM 0. 16383.75 FORMAT "%8.2"
 /begin AXIS_DESCR COM_AXIS Vxx_tco _CNV_A_R_LINEAR_____110_CM 16 -40. 200. FORMAT "%5.1" AXIS_PTS_REF Ctb_tco /end AXIS_DESCR
/end CHARACTERISTIC
/begin CHARACTERISTIC Ctp_max_n_toil "Maximum engine speed depending on oil temperature" CURVE 0xa0034ef4 _REC_A1CUR_20_u2_u2 16383.75 _CNV_A_R_ENSD_LINEA_22_CM 0. 16383.75 FORMAT "%8.2"
 /begin AXIS_DESCR COM_AXIS Vxx_toil _CNV_A_R_LINEAR_____110_CM 16 -40. 200. FORMAT "%5.1" AXIS_PTS_REF Ctb_toil /end AXIS_DESCR
/end CHARACTERISTIC
/begin CHARACTERISTIC Ctp_ovn_tq_cor_ena "Choose to enable soft engine speed limitation for each engaged gearbox ratio" CURVE 0xa0021e6c _REC_A1CUR_20_u1_u1 1. _CNV_S_2_RANGE______3_CM 0. 1.
 /begin AXIS_DESCR COM_AXIS Vxx_gear _CNV_A_R_LINEAR_____145_CM 8 -1. 6. READ_ONLY FORMAT "%2.0" AXIS_PTS_REF Ntb_gear /end AXIS_DESCR
/end CHARACTERISTIC
/begin CHARACTERISTIC Ctp_sta_tco_dly "Time value depending on starting coolant temperature" CURVE 0xa0021e74 _REC_A1CUR_20_u1_u2 25.5 _CNV_A_R_LINEAR_____58_CM 0. 25.5 FORMAT "%4.1"
 /begin AXIS_DESCR COM_AXIS Vxx_tco _CNV_A_R_LINEAR_____110_CM 8 -40. 200. FORMAT "%5.1" AXIS_PTS_REF Ctb_sta_tco /end AXIS_DESCR
/end CHARACTERISTIC
/begin MEASUREMENT Vbx_gear_cge_max_n "gear change indicator light flag" UBYTE _CNV_S_2_RANGE______3_CM 1 0. 0. 1. ECU_ADDRESS 0xd0007110 BIT_MASK 0x1 /end MEASUREMENT
/begin MEASUREMENT Vbx_max_n_fl_tkof_act "Specific limitation during the take off (idiot start)" UBYTE _CNV_S_2_RANGE______3_CM 1 0. 0. 1. ECU_ADDRESS 0xd0007111 BIT_MASK 0x1 /end MEASUREMENT
/begin MEASUREMENT Vbx_max_n_fl_tkof_cdn "Condition for the specific limitation during the take off" UBYTE _CNV_S_2_RANGE______3_CM 1 0. 0. 1. ECU_ADDRESS 0xd0007112 BIT_MASK 0x1 /end MEASUREMENT
/begin MEASUREMENT Vbx_ovn_sta_ena "specific limitation during startup" UBYTE _CNV_S_2_RANGE______3_CM 1 0. 0. 1. ECU_ADDRESS 0xd0007113 BIT_MASK 0x1 /end MEASUREMENT
/begin MEASUREMENT Vbx_ovn_tq_cor_ena "Enable soft engine speed limitation" UBYTE _CNV_S_2_RANGE______3_CM 1 0. 0. 1. ECU_ADDRESS 0xd0007114 BIT_MASK 0x1 /end MEASUREMENT
/begin MEASUREMENT Vxx_max_n_inj "Maximum engine speed for fuel management" UWORD _CNV_A_R_ENSD_LINEA_22_CM 1 0. 0. 16383.75 ECU_ADDRESS 0xd000494e FORMAT "%8.2" /end MEASUREMENT
/begin MEASUREMENT Vxx_max_n_nom "Maximum nominal engine speed" UWORD _CNV_A_R_ENSD_LINEA_22_CM 1 0. 0. 16383.75 ECU_ADDRESS 0xd0004950 FORMAT "%8.2" /end MEASUREMENT
/begin MEASUREMENT Vxx_max_n_ovn "Maximum engine speed for overspeed function" UWORD _CNV_A_R_ENSD_LINEA_22_CM 1 0. 0. 16383.75 ECU_ADDRESS 0xd0004952 FORMAT "%8.2" /end MEASUREMENT
/begin MEASUREMENT Vxx_max_n_ovn_ofs "Engine speed offset to determine regulation speed" UWORD _CNV_A_R_ENSD_LINEA_22_CM 1 0. 0. 16383.75 ECU_ADDRESS 0xd0004954 FORMAT "%8.2" /end MEASUREMENT
/begin MEASUREMENT Vxx_max_n_ovn_ofs_raw "Offset of engine speed for engine speed regulation" UWORD _CNV_A_R_ENSD_LINEA_22_CM 1 0. 0. 16383.75 ECU_ADDRESS 0xd0004956 FORMAT "%8.2" /end MEASUREMENT
/begin CHARACTERISTIC Cbx_max_n_fl_tkof_ant_coup_dsb "Disable the specific limitation during the take off on the condition open coupler" VALUE 0xa0021e90 _REC_S1VAL_20_u1 1. _CNV_S_2_RANGE______3_CM 0. 1. BIT_MASK 0x1 /end CHARACTERISTIC
/begin CHARACTERISTIC Cbx_max_n_fl_tkof_ena "Boolean to activate the take off limitation" VALUE 0xa0021e91 _REC_S1VAL_20_u1 1. _CNV_S_2_RANGE______3_CM 0. 1. BIT_MASK 0x1 /end CHARACTERISTIC
/begin CHARACTERISTIC Cbx_max_n_fl_tkof_ovn_tq_ena "Boolean to enable the torque engine speed limitation for take off limitation" VALUE 0xa0021e92 _REC_S1VAL_20_u1 1. _CNV_S_2_RANGE______3_CM 0. 1. BIT_MASK 0x1 /end CHARACTERISTIC
/begin CHARACTERISTIC Cbx_max_n_ovn_ofs_cfm "Boolean to activate RST injection cut strategy" VALUE 0xa0021e93 _REC_S1VAL_20_u1 1. _CNV_A_R_ECME_LINEA_0_CM 0. 1. FORMAT "%1.0" BIT_MASK 0x1 /end CHARACTERISTIC
/begin CHARACTERISTIC Cxx_gear_cge_max_n_hys "Hysteresis threshold for the gear change indicator light" VALUE 0xa0021e7c _REC_S1VAL_20_u2 16383.75 _CNV_A_R_ENSD_LINEA_22_CM 0. 16383.75 FORMAT "%8.2" /end CHARACTERISTIC
/begin CHARACTERISTIC Cxx_inj_cut_det_dly "Delay to consolidate the injection cut phase" VALUE 0xa0021e94 _REC_S1VAL_20_u1 25.5 _CNV_A_R_LINEAR_____58_CM 0. 25.5 FORMAT "%4.1" /end CHARACTERISTIC
/begin CHARACTERISTIC Cxx_max_n_dec_slop "Negatif slope for the engine speed limitation" VALUE 0xa0021e7e _REC_S1VAL_20_u2 65535. _CNV_A_R_LINEAR_____395_CM -65535. 0. FORMAT "%4.0" /end CHARACTERISTIC
/begin CHARACTERISTIC Cxx_max_n_fl_tkof "Engine speed limitation during the take off (idiot start)" VALUE 0xa0021e80 _REC_S1VAL_20_u2 16383.75 _CNV_A_R_ENSD_LINEA_22_CM 0. 16383.75 FORMAT "%8.2" /end CHARACTERISTIC
/begin CHARACTERISTIC Cxx_max_n_fl_tkof_ext_ctrl_dly "Delay to consolidate the external controls" VALUE 0xa0021e95 _REC_S1VAL_20_u1 2.55 _CNV_A_R_LINEAR_____32_CM 0. 2.55 FORMAT "%4.2" /end CHARACTERISTIC
/begin CHARACTERISTIC Cxx_max_n_fl_tkof_vs_thd "Vehicle speed threshold to activate the take off engine speed limitation (idiot start)" VALUE 0xa0021e82 _REC_S1VAL_20_u2 655.35 _CNV_A_R_LINEAR_____125_CM 0. 655.35 FORMAT "%6.2" /end CHARACTERISTIC
/begin CHARACTERISTIC Cxx_max_n_gear_dft "Maximum engine speed for gearbox default" VALUE 0xa0021e84 _REC_S1VAL_20_u2 16383.75 _CNV_A_R_ENSD_LINEA_22_CM 0. 16383.75 FORMAT "%8.2" /end CHARACTERISTIC
/begin CHARACTERISTIC Cxx_max_n_inc_slop "Positive slope for the engine speed limitation" VALUE 0xa0021e86 _REC_S1VAL_20_u2 65535. _CNV_A_R_LINEAR_____21_CM 0. 65535. FORMAT "%4.0" /end CHARACTERISTIC
/begin CHARACTERISTIC Cxx_max_n_ovn_ofs_neg_slop "Negative slope for engine speed offset" VALUE 0xa0021e88 _REC_S1VAL_20_u2 65535. _CNV_A_R_LINEAR_____395_CM -65535. 0. FORMAT "%4.0" /end CHARACTERISTIC
/begin CHARACTERISTIC Cxx_max_n_ovn_ofs_pos_slop "Positive slope for engine speed offset" VALUE 0xa0021e8a _REC_S1VAL_20_u2 65535. _CNV_A_R_LINEAR_____21_CM 0. 65535. FORMAT "%4.0" /end CHARACTERISTIC
/begin CHARACTERISTIC Cxx_max_n_tco_toil_dft "maximum engine speed depending on coolant temperature (default value)" VALUE 0xa0021e8c _REC_S1VAL_20_u2 16383.75 _CNV_A_R_ENSD_LINEA_22_CM 0. 16383.75 FORMAT "%8.2" /end CHARACTERISTIC
/begin CHARACTERISTIC Cxx_max_n_thd_oil_ovn "Maximum engine speed in start operation" VALUE 0xa0021e8e _REC_S1VAL_20_u2 16383.75 _CNV_A_R_ENSD_LINEA_22_CM 0. 16383.75 FORMAT "%8.2" /end CHARACTERISTIC
/begin CHARACTERISTIC Cxx_sta_tco_dly_dft "time value depending on starting coolant temperature (default value)" VALUE 0xa0021e96 _REC_S1VAL_20_u1 25.5 _CNV_A_R_LINEAR_____58_CM 0. 25.5 FORMAT "%4.1" /end CHARACTERISTIC
/begin CHARACTERISTIC Ctp_max_rams_n_dec "Engine speed decreasing for the safety engine speed  limitation function of the gear ratio" CURVE 0xa0034f14 _REC_A1CUR_20_u2_u1 16383.75 _CNV_A_R_ENSD_LINEA_22_CM 0. 16383.75 FORMAT "%8.2"
 /begin AXIS_DESCR COM_AXIS Vxx_gear _CNV_A_R_LINEAR_____145_CM 8 -1. 6. READ_ONLY FORMAT "%2.0" AXIS_PTS_REF Ntb_gear /end AXIS_DESCR
/end CHARACTERISTIC
/begin MEASUREMENT Vbx_n_rams_lim_act "Activation of safety engine speed limitation" UBYTE _CNV_S_2_RANGE______3_CM 1 0. 0. 1. ECU_ADDRESS 0xd0007115 BIT_MASK 0x1 /end MEASUREMENT
/begin MEASUREMENT Vsx_n_rams_lim_vld "Safety engine speed limitation validity status" UBYTE _CNV_A_R_ECME_LINEA_0_CM 1 0. 0. 1. ECU_ADDRESS 0xd0007116 FORMAT "%1.0" /end MEASUREMENT
/begin MEASUREMENT Vxx_max_rams_n "Maximum engine speed allowed by the safety" UWORD _CNV_A_R_ENSD_LINEA_22_CM 1 0. 0. 16383.75 ECU_ADDRESS 0xd000495a FORMAT "%8.2" /end MEASUREMENT
/begin CHARACTERISTIC Cxx_max_rams_n_1 "Failsafe maximum engine speed level 1" VALUE 0xa0021e98 _REC_S1VAL_20_u2 16383.75 _CNV_A_R_ENSD_LINEA_22_CM 0. 16383.75 FORMAT "%8.2" /end CHARACTERISTIC
/begin CHARACTERISTIC Cxx_max_rams_n_2 "Failsafe maximum engine speed level 2" VALUE 0xa0021e9a _REC_S1VAL_20_u2 16383.75 _CNV_A_R_ENSD_LINEA_22_CM 0. 16383.75 FORMAT "%8.2" /end CHARACTERISTIC
/begin MEASUREMENT Vbx_n_rams_lim_act_1 "Activation of safety engine speed limitation level 1" UBYTE _CNV_S_2_RANGE______3_CM 1 0. 0. 1. ECU_ADDRESS 0xd00070ff BIT_MASK 0x1 /end MEASUREMENT
/begin MEASUREMENT Vbx_n_rams_lim_act_2 "Activation of safety engine speed limitation level 2" UBYTE _CNV_S_2_RANGE______3_CM 1 0. 0. 1. ECU_ADDRESS 0xd0007100 BIT_MASK 0x1 /end MEASUREMENT
/begin MEASUREMENT Vbx_ovn_tq_cor_dft_dsb "Soft engine speed limitation disabled due to an engine default (e.g. limp-home)" UBYTE _CNV_S_2_RANGE______3_CM 1 0. 0. 1. ECU_ADDRESS 0xd0007101 BIT_MASK 0x1 /end MEASUREMENT
/begin CHARACTERISTIC Cxx_n_lim_crk_cfm "Activation of engine speed limitation by crankshaft back-up mode (0: no limitation, 1: limitation level 1, 2: limitation level 2)" VALUE 0xa0021e68 _REC_S1VAL_20_u1 2. _CNV_A_R_ECME_LINEA_0_CM 0. 2. FORMAT "%1.0" /end CHARACTERISTIC
/begin MEASUREMENT Vbx_ovn_mon_act "Activated ovn monitoring" UBYTE _CNV_S_2_RANGE______3_CM 1 0. 0. 1. ECU_ADDRESS 0xd0007118 BIT_MASK 0x1 /end MEASUREMENT
/begin CHARACTERISTIC Cxx_ovn_mon_n_thd "Engine speed threlhold to the activate ovn monitoring" VALUE 0xa0021e9c _REC_S1VAL_20_u2 16383.75 _CNV_A_R_ENSD_LINEA_22_CM 0. 16383.75 FORMAT "%8.2" /end CHARACTERISTIC
/begin MEASUREMENT Vbx_rs_ovn_mon_cfm "RS ovn monitoring Strategy configuration boolean." UBYTE _CNV_S_2_RANGE______3_CM 1 0. 0. 1. ECU_ADDRESS 0xd0007119 BIT_MASK 0x1 /end MEASUREMENT
/begin MEASUREMENT Vxx_ac_acel_is_sp "Accelerated engine idle speed setpoint request for air conditionning" UWORD _CNV_A_R_ENSD_LINEA_22_CM 1 0. 0. 16383.75 ECU_ADDRESS 0xd0005f38 FORMAT "%8.2" /end MEASUREMENT
/begin AXIS_PTS Ctb_ac_acel_is "Breakpoint table for engine idle speed need for AC" 0xa002dac8 Vxx_tair_ext _REC_A2AXS_20_u2 240. _CNV_A_R_LINEAR_____110_CM 9 -40. 200. FORMAT "%5.1" /end AXIS_PTS
/begin CHARACTERISTIC Ctp_ac_acel_is_swi_off "Breakpoint for switch off the idle speed for AC" CURVE 0xa002dadc _REC_A1CUR_20_u2_u2 6553.5 _CNV_A_R_LINEAR_____373_CM 0. 6553.5 FORMAT "%6.1"
 /begin AXIS_DESCR COM_AXIS Vxx_tair_ext _CNV_A_R_LINEAR_____110_CM 9 -40. 200. FORMAT "%5.1" AXIS_PTS_REF Ctb_ac_acel_is /end AXIS_DESCR
/end CHARACTERISTIC
/begin CHARACTERISTIC Ctp_ac_acel_is_swi_on "Breakpoint for switch on the idle speed for AC" CURVE 0xa002daf0 _REC_A1CUR_20_u2_u2 6553.5 _CNV_A_R_LINEAR_____373_CM 0. 6553.5 FORMAT "%6.1"
 /begin AXIS_DESCR COM_AXIS Vxx_tair_ext _CNV_A_R_LINEAR_____110_CM 9 -40. 200. FORMAT "%5.1" AXIS_PTS_REF Ctb_ac_acel_is /end AXIS_DESCR
/end CHARACTERISTIC
/begin CHARACTERISTIC Ctp_ac_acel_is_val_off "Breakpoint for engine idle speed off value for AC" CURVE 0xa002db04 _REC_A1CUR_20_u2_u2 16383.75 _CNV_A_R_ENSD_LINEA_22_CM 0. 16383.75 FORMAT "%8.2"
 /begin AXIS_DESCR COM_AXIS Vxx_tair_ext _CNV_A_R_LINEAR_____110_CM 9 -40. 200. FORMAT "%5.1" AXIS_PTS_REF Ctb_ac_acel_is /end AXIS_DESCR
/end CHARACTERISTIC
/begin CHARACTERISTIC Ctp_ac_acel_is_val_on "Breakpoint for engine idle speed on value for AC" CURVE 0xa002db18 _REC_A1CUR_20_u2_u2 16383.75 _CNV_A_R_ENSD_LINEA_22_CM 0. 16383.75 FORMAT "%8.2"
 /begin AXIS_DESCR COM_AXIS Vxx_tair_ext _CNV_A_R_LINEAR_____110_CM 9 -40. 200. FORMAT "%5.1" AXIS_PTS_REF Ctb_ac_acel_is /end AXIS_DESCR
/end CHARACTERISTIC
/begin MEASUREMENT Vsx_mdl_ac_acel_is_sp_vld "Accelerated engine idle speed setpoint request for air conditionning from model validity status" UBYTE _CNV_S_3_STATUS_OK__412_CM 1 0. 0. 2. ECU_ADDRESS 0xd0007bff /end MEASUREMENT
/begin MEASUREMENT Vxx_mdl_ac_acel_is_sp "Accelerated engine idle speed setpoint request for air conditionning from model" UWORD _CNV_A_R_ENSD_LINEA_22_CM 1 0. 0. 16383.75 ECU_ADDRESS 0xd0005f3c FORMAT "%8.2" /end MEASUREMENT
/begin CHARACTERISTIC Cxx_ac_req_off_ac_acel_is_sp "Default value of engine idle speed setpoint for AC when calculation is disabled" VALUE 0xa0021630 _REC_S1VAL_20_u2 16383.75 _CNV_A_R_ENSD_LINEA_22_CM 0. 16383.75 FORMAT "%8.2" /end CHARACTERISTIC
/begin MEASUREMENT Vbx_agb_is_acel_req "Idle speed setpoint acceleration by AT is requested" UBYTE _CNV_S_2_RANGE______3_CM 1 0. 0. 1. ECU_ADDRESS 0xd0007c02 BIT_MASK 0x1 /end MEASUREMENT
/begin MEASUREMENT Vsx_agb_is_acel_req_vld "Idle speed setpoint acceleration by AT is requested validity status" UBYTE _CNV_S_3_STATUS_OK__213_CM 1 0. 0. 2. ECU_ADDRESS 0xd0007c03 /end MEASUREMENT
/begin MEASUREMENT Vsx_agb_is_acel_sp_vld "Automatic Transmission idle speed setpoint acceleration required validity status" UBYTE _CNV_S_3_STATUS_OK__213_CM 1 0. 0. 2. ECU_ADDRESS 0xd0007c01 /end MEASUREMENT
/begin MEASUREMENT Vxx_agb_is_acel_sp "Automatic Transmission idle speed setpoint acceleration required" UWORD _CNV_A_R_ENSD_LINEA_22_CM 1 0. 0. 16383.75 ECU_ADDRESS 0xd0005f3e FORMAT "%8.2" /end MEASUREMENT
/begin MEASUREMENT Vbx_ptc_is_acel_req "PTC engine idle speed increase request from CAN" UBYTE _CNV_S_2_RANGE______3_CM 1 0. 0. 1. ECU_ADDRESS 0xd0007c04 BIT_MASK 0x1 /end MEASUREMENT
/begin MEASUREMENT Vbx_el_bk_wind "Electric backlite  idle speed setpoint acceleration request" UBYTE _CNV_S_2_RANGE______3_CM 1 0. 0. 1. ECU_ADDRESS 0xd0007c06 BIT_MASK 0x1 /end MEASUREMENT
/begin MEASUREMENT Vbx_el_wind_is_acel "Electric windshield  idle speed setpoint acceleration request" UBYTE _CNV_S_2_RANGE______3_CM 1 0. 0. 1. ECU_ADDRESS 0xd0007c07 BIT_MASK 0x1 /end MEASUREMENT
/begin MEASUREMENT Vbx_mdl_ptc_is_acel_req "Idle speed increase request from PTC strategy" UBYTE _CNV_S_2_RANGE______3_CM 1 0. 0. 1. ECU_ADDRESS 0xd0007c05 BIT_MASK 0x1 /end MEASUREMENT
/begin MEASUREMENT Vbx_acs_acel_is_req "Accelerated idle speed request for commercial vehicle accessories" UBYTE _CNV_S_2_RANGE______3_CM 1 0. 0. 1. ECU_ADDRESS 0xd0007c00 BIT_MASK 0x1 /end MEASUREMENT
/begin MEASUREMENT Vxx_tair_ext "Environmental temperature" UWORD _CNV_A_R_LINEAR_____110_CM 1 0. -40. 200. ECU_ADDRESS 0xd0005f3a FORMAT "%5.1" /end MEASUREMENT
/begin AXIS_PTS Ntb_gear "Gearbox ratio breakpoint" 0xa002da28 Vxx_gear _REC_A2AXS_20_u1 7. _CNV_A_R_LINEAR_____145_CM 8 -1. 6. READ_ONLY FORMAT "%2.0" /end AXIS_PTS
/begin AXIS_PTS Ctb_toil "engine oil temperature breakpoints" 0xa002d4e4 Vxx_toil _REC_A2AXS_20_u2 240. _CNV_A_R_LINEAR_____110_CM 16 -40. 200. FORMAT "%5.1" /end AXIS_PTS
/begin AXIS_PTS Ctb_dft_comb_eal "Table of engine air load breakpoins for misfire cartographies." 0xa002e488 Vxx_eal_tdc_2 _REC_A2AXS_20_u2 3.99993896484375 _CNV_A_R_LINEAR_____53_CM 17 0. 3.99993896484375 FORMAT "%7.5" /end AXIS_PTS
/begin AXIS_PTS Ctb_mis_n_17 "Table of 17 engine speed breakpoints for the misfire strategy" 0xa002e4ac Vxx_n_tdc_2 _REC_A2AXS_20_u2 16383.75 _CNV_A_R_ENSD_LINEA_22_CM 17 0. 16383.75 FORMAT "%8.2" /end AXIS_PTS
/begin COMPU_METHOD _CNV_A_R_ECME_LINEA_0_CM "" RAT_FUNC "%6.3" "-" COEFFS 0 1. 0. 0 0 1 /end COMPU_METHOD
/begin COMPU_METHOD _CNV_A_R_LINEAR_____2_CM "" RAT_FUNC "%6.3" "rpm" COEFFS 0 3.125e-002 0. 0 0 1 /end COMPU_METHOD
/begin COMPU_METHOD _CNV_S_2_RANGE______3_CM "" TAB_VERB "%6.3" "-" COMPU_TAB_REF _CNV_S_2_RANGE______3 /end COMPU_METHOD
/begin COMPU_VTAB _CNV_S_2_RANGE______3 "" TAB_VERB 2 0 "0" 1 "1" /end COMPU_VTAB
/begin COMPU_METHOD _CNV_A_R_LINEAR_____7_CM "" RAT_FUNC "%6.3" "-" COEFFS 0 65535.99999999996 0. 0 0 1 /end COMPU_METHOD
/begin COMPU_METHOD _CNV_A_R_LINEAR_____21_CM "" RAT_FUNC "%6.3" "rpm/s" COEFFS 0 1. 0. 0 0 1 /end COMPU_METHOD
/begin COMPU_METHOD _CNV_A_R_ENSD_LINEA_22_CM "" RAT_FUNC "%6.3" "rpm" COEFFS 0 4. 0. 0 0 1 /end COMPU_METHOD
/begin COMPU_METHOD _CNV_A_R_LINEAR_____29_CM "" RAT_FUNC "%6.3" "-" COEFFS 0 256. 0. 0 0 1 /end COMPU_METHOD
/begin COMPU_METHOD _CNV_A_R_LINEAR_____32_CM "" RAT_FUNC "%6.3" "s" COEFFS 0 100. 0. 0 0 1 /end COMPU_METHOD
/begin COMPU_METHOD _CNV_A_R_LINEAR_____42_CM "" RAT_FUNC "%6.3" "-" COEFFS 0 128. 0. 0 0 1 /end COMPU_METHOD
/begin COMPU_METHOD _CNV_A_R_LINEAR_____48_CM "" RAT_FUNC "%6.3" "-" COEFFS 0 32767.99999999992 0. 0 0 1 /end COMPU_METHOD
/begin COMPU_METHOD _CNV_A_R_LINEAR_____53_CM "" RAT_FUNC "%6.3" "-" COEFFS 0 16384. 0. 0 0 1 /end COMPU_METHOD
/begin COMPU_METHOD _CNV_A_R_LINEAR_____58_CM "" RAT_FUNC "%6.3" "s" COEFFS 0 10. 0. 0 0 1 /end COMPU_METHOD
/begin COMPU_METHOD _CNV_A_R_LINEAR_____83_CM "" RAT_FUNC "%6.3" "-" COEFFS 0 64. 0. 0 0 1 /end COMPU_METHOD
/begin COMPU_METHOD _CNV_A_R_LINEAR_____101_CM "" RAT_FUNC "%6.3" "TDC" COEFFS 0 1. 0. 0 0 1 /end COMPU_METHOD
/begin COMPU_METHOD _CNV_A_R_LINEAR_____102_CM "" RAT_FUNC "%6.3" "µs" COEFFS 0 0.25 0. 0 0 1 /end COMPU_METHOD
/begin COMPU_METHOD _CNV_A_R_LINEAR_____107_CM "" RAT_FUNC "%6.3" "mV" COEFFS 0 1. 0. 0 0 1 /end COMPU_METHOD
/begin COMPU_METHOD _CNV_A_R_LINEAR_____110_CM "" RAT_FUNC "%6.3" "°C" COEFFS 0 10. 400. 0 0 1 /end COMPU_METHOD
/begin COMPU_METHOD _CNV_A_R_LINEAR_____115_CM "" RAT_FUNC "%6.3" "hPa" COEFFS 0 1. 0. 0 0 1 /end COMPU_METHOD
/begin COMPU_METHOD _CNV_A_R_LINEAR_____116_CM "" RAT_FUNC "%6.3" "s" COEFFS 0 1000. 0. 0 0 1 /end COMPU_METHOD
/begin COMPU_METHOD _CNV_A_R_LINEAR_____125_CM "" RAT_FUNC "%6.3" "km/h" COEFFS 0 100. 0. 0 0 1 /end COMPU_METHOD
/begin COMPU_METHOD _CNV_A_R_LINEAR_____129_CM "" RAT_FUNC "%6.3" "°CRK" COEFFS 0 50. 0. 0 0 1 /end COMPU_METHOD
/begin COMPU_METHOD _CNV_A_R_LINEAR_____133_CM "" RAT_FUNC "%6.3" "mg/stk" COEFFS 0 390.625 0. 0 0 1 /end COMPU_METHOD
/begin COMPU_METHOD _CNV_A_R_LINEAR_____145_CM "" RAT_FUNC "%6.3" "-" COEFFS 0 1. 1. 0 0 1 /end COMPU_METHOD
/begin COMPU_METHOD _CNV_A_R_LINEAR_____161_CM "" RAT_FUNC "%6.3" "-" COEFFS 0 1000. 0. 0 0 1 /end COMPU_METHOD
/begin COMPU_METHOD _CNV_A_R_LINEAR_____165_CM "" RAT_FUNC "%6.3" "%" COEFFS 0 2.55 0. 0 0 1 /end COMPU_METHOD
/begin COMPU_METHOD _CNV_S_3_STATUS_OK__179_CM "" TAB_VERB "%6.3" "-" COMPU_TAB_REF _CNV_S_3_STATUS_OK__179 /end COMPU_METHOD
/begin COMPU_VTAB _CNV_S_3_STATUS_OK__179 "" TAB_VERB 3 0 "Nsx_vld_nok_0" 1 "Nsx_vld_ok_1" 2 "Nsx_vld_fail_2" /end COMPU_VTAB
/begin COMPU_METHOD _CNV_A_R_LINEAR_____181_CM "" RAT_FUNC "%6.3" "Nm" COEFFS 0 32. 0. 0 0 1 /end COMPU_METHOD
/begin COMPU_METHOD _CNV_A_R_LINEAR_____182_CM "" RAT_FUNC "%6.3" "rpm" COEFFS 0 4. 32768. 0 0 1 /end COMPU_METHOD
/begin COMPU_METHOD _CNV_A_R_LINEAR_____183_CM "" RAT_FUNC "%6.3" "-" COEFFS 0 1024. 0. 0 0 1 /end COMPU_METHOD
/begin COMPU_METHOD _CNV_A_R_LINEAR_____197_CM "" RAT_FUNC "%6.3" "(km/h)/K*rpm" COEFFS 0 100. 1000. 0 0 1 /end COMPU_METHOD
/begin COMPU_METHOD _CNV_A_R_LINEAR_____202_CM "" RAT_FUNC "%6.3" "µs" COEFFS 0 1. 0. 0 0 1 /end COMPU_METHOD
/begin COMPU_METHOD _CNV_A_R_LINEAR_____205_CM "" RAT_FUNC "%6.3" "V" COEFFS 0 100. 0. 0 0 1 /end COMPU_METHOD
/begin COMPU_METHOD _CNV_A_R_LINEAR_____208_CM "" RAT_FUNC "%6.3" "s" COEFFS 0 25. 0. 0 0 1 /end COMPU_METHOD
/begin COMPU_METHOD _CNV_S_3_STATUS_OK__213_CM "" TAB_VERB "%6.3" "" COMPU_TAB_REF _CNV_S_3_STATUS_OK__213 /end COMPU_METHOD
/begin COMPU_VTAB _CNV_S_3_STATUS_OK__213 "" TAB_VERB 3 0 "Nsx_vld_nok_0" 1 "Nsx_vld_ok_1" 2 "Nsx_vld_fail_2" /end COMPU_VTAB
/begin COMPU_METHOD _CNV_A_R_LINEAR_____216_CM "" RAT_FUNC "%6.3" "Nm" COEFFS 0 32. 12800. 0 0 1 /end COMPU_METHOD
/begin COMPU_METHOD _CNV_S_8_STATUS_OK__234_CM "" TAB_VERB "%6.3" "-" COMPU_TAB_REF _CNV_S_8_STATUS_OK__234 /end COMPU_METHOD
/begin COMPU_VTAB _CNV_S_8_STATUS_OK__234 "" TAB_VERB 8 0 "Nsx_vld_nok_0" 1 "Nsx_vld_ok_1" 2 "Nsx_vld_fail_2" 3 "Nsx_vld_fail_3" 4 "Nsx_vld_fail_4" 5 "Nsx_vld_fail_5" 6 "Nsx_vld_fail_6" 7 "Nsx_vld_fail_7" /end COMPU_VTAB
/begin COMPU_METHOD _CNV_A_R_LINEAR_____274_CM "" RAT_FUNC "%6.3" "km" COEFFS 0 1. 0. 0 0 1 /end COMPU_METHOD
/begin COMPU_METHOD _CNV_S_4_RANGE_ROUT_288_CM "" TAB_VERB "%6.3" "-" COMPU_TAB_REF _CNV_S_4_RANGE_ROUT_288 /end COMPU_METHOD
/begin COMPU_VTAB _CNV_S_4_RANGE_ROUT_288 "" TAB_VERB 4 0 "Nsx_diag_sta_disa_stt" 1 "Nsx_diag_sta_run_stt" 2 "Nsx_diag_sta_end_stt" 3 "Nsx_diag_sta_abrt_stt" /end COMPU_VTAB
/begin COMPU_METHOD _CNV_A_R_LINEAR_____290_CM "" RAT_FUNC "%6.3" "Hz" COEFFS 0 1. 0. 0 0 1 /end COMPU_METHOD
/begin COMPU_METHOD _CNV_A_R_LINEAR_____304_CM "" RAT_FUNC "%6.3" "Nm/s" COEFFS 0 50. 32500. 0 0 1 /end COMPU_METHOD
/begin COMPU_METHOD _CNV_A_R_LINEAR_____325_CM "" RAT_FUNC "%6.3" "°CRK" COEFFS 0 0.3333333333333333 0. 0 0 1 /end COMPU_METHOD
/begin COMPU_METHOD _CNV_A_R_LINEAR_____370_CM "" RAT_FUNC "%6.3" "s" COEFFS 0 312500. 0. 0 0 1 /end COMPU_METHOD
/begin COMPU_METHOD _CNV_A_R_LINEAR_____372_CM "" RAT_FUNC "%6.3" "ns" COEFFS 0 1.e-002 0. 0 0 1 /end COMPU_METHOD
/begin COMPU_METHOD _CNV_A_R_LINEAR_____373_CM "" RAT_FUNC "%6.3" "bar" COEFFS 0 10. 0. 0 0 1 /end COMPU_METHOD
/begin COMPU_METHOD _CNV_A_R_LINEAR_____395_CM "" RAT_FUNC "%6.3" "rpm/s" COEFFS 0 -1. 0. 0 0 1 /end COMPU_METHOD
/begin COMPU_METHOD _CNV_A_R_LINEAR_____396_CM "" RAT_FUNC "%6.3" "(km/h)/K*rpm" COEFFS 0 100. 0. 0 0 1 /end COMPU_METHOD
/begin COMPU_METHOD _CNV_A_R_LINEAR_____398_CM "" RAT_FUNC "%6.3" "kg*m²" COEFFS 0 100. 0. 0 0 1 /end COMPU_METHOD
/begin COMPU_METHOD _CNV_A_R_LINEAR_____399_CM "" RAT_FUNC "%6.3" "µs/mg" COEFFS 0 65.536 -1. 0 0 1 /end COMPU_METHOD
/begin COMPU_METHOD _CNV_A_R_LINEAR_____400_CM "" RAT_FUNC "%6.3" "µs" COEFFS 0 2.5e-004 0. 0 0 1 /end COMPU_METHOD
/begin COMPU_METHOD _CNV_A_R_LINEAR_____401_CM "" RAT_FUNC "%6.3" "µs/mg" COEFFS 0 65.53499998474098 1.525902189669637e-005 0 0 1 /end COMPU_METHOD
/begin COMPU_METHOD _CNV_A_R_LINEAR_____402_CM "" RAT_FUNC "%6.3" "l/h" COEFFS 0 100. 0. 0 0 1 /end COMPU_METHOD
/begin COMPU_METHOD _CNV_A_R_LINEAR_____403_CM "" RAT_FUNC "%6.3" "mm³" COEFFS 0 1.25e-002 0. 0 0 1 /end COMPU_METHOD
/begin COMPU_METHOD _CNV_A_R_LINEAR_____404_CM "" RAT_FUNC "%6.3" "dm3/kg" COEFFS 0 512. -512. 0 0 1 /end COMPU_METHOD
/begin COMPU_METHOD _CNV_A_R_LINEAR_____405_CM "" RAT_FUNC "%6.3" "mg/stk" COEFFS 0 25000. 0. 0 0 1 /end COMPU_METHOD
/begin COMPU_METHOD _CNV_A_R_LINEAR_____406_CM "" RAT_FUNC "%6.3" "%" COEFFS 0 2.55 127.5 0 0 1 /end COMPU_METHOD
/begin COMPU_METHOD _CNV_A_R_LINEAR_____407_CM "" RAT_FUNC "%6.3" "-" COEFFS 0 16384. 32768. 0 0 1 /end COMPU_METHOD
/begin COMPU_METHOD _CNV_A_R_LINEAR_____408_CM "" RAT_FUNC "%6.3" "s" COEFFS 0 2. 0. 0 0 1 /end COMPU_METHOD
/begin COMPU_METHOD _CNV_A_R_LINEAR_____409_CM "" RAT_FUNC "%6.3" "-" COEFFS 0 2.55 0. 0 0 1 /end COMPU_METHOD
/begin COMPU_METHOD _CNV_A_R_LINEAR_____410_CM "" RAT_FUNC "%6.3" "Nm" COEFFS 0 255. 0. 0 0 1 /end COMPU_METHOD
/begin COMPU_METHOD _CNV_A_R_LINEAR_____411_CM "" RAT_FUNC "%6.3" "Nm/(rpm.s)" COEFFS 0 100. 0. 0 0 1 /end COMPU_METHOD
/begin COMPU_METHOD _CNV_S_3_STATUS_OK__412_CM "" TAB_VERB "%6.3" "[-]" COMPU_TAB_REF _CNV_S_3_STATUS_OK__412 /end COMPU_METHOD
/begin COMPU_VTAB _CNV_S_3_STATUS_OK__412 "" TAB_VERB 3 0 "Nsx_vld_nok_0" 1 "Nsx_vld_ok_1" 2 "Nsx_vld_fail_2" /end COMPU_VTAB
/begin RECORD_LAYOUT _REC_S1VAL_20_u4 FNC_VALUES 1 ULONG COLUMN_DIR DIRECT /end RECORD_LAYOUT
/begin RECORD_LAYOUT _REC_S1VAL_20_u1 FNC_VALUES 1 UBYTE COLUMN_DIR DIRECT /end RECORD_LAYOUT
/begin RECORD_LAYOUT _REC_A2AXS_20_u1 NO_AXIS_PTS_X 1 UBYTE AXIS_PTS_X 2 UBYTE INDEX_INCR DIRECT /end RECORD_LAYOUT
/begin RECORD_LAYOUT _REC_S1VAL_20_u2 FNC_VALUES 1 UWORD COLUMN_DIR DIRECT /end RECORD_LAYOUT
/begin RECORD_LAYOUT _REC_S1VAL_20_s2 FNC_VALUES 1 SWORD COLUMN_DIR DIRECT /end RECORD_LAYOUT
/begin RECORD_LAYOUT _REC_A2AXS_20_u2 NO_AXIS_PTS_X 1 UWORD AXIS_PTS_X 2 UWORD INDEX_INCR DIRECT /end RECORD_LAYOUT
/begin RECORD_LAYOUT _REC_A1CUR_20_u1_u2 FNC_VALUES 1 UBYTE COLUMN_DIR DIRECT /end RECORD_LAYOUT
/begin RECORD_LAYOUT _REC_A1CUR_20_u1_u1 FNC_VALUES 1 UBYTE COLUMN_DIR DIRECT /end RECORD_LAYOUT
/begin RECORD_LAYOUT _REC_A1CUR_20_u2_u1 FNC_VALUES 1 UWORD COLUMN_DIR DIRECT /end RECORD_LAYOUT
/begin RECORD_LAYOUT _REC_A1MAP_20_u2_u2_u2 FNC_VALUES 1 UWORD COLUMN_DIR DIRECT /end RECORD_LAYOUT
/begin RECORD_LAYOUT _REC_A1CUR_20_u2_u2 FNC_VALUES 1 UWORD COLUMN_DIR DIRECT /end RECORD_LAYOUT
/begin RECORD_LAYOUT _REC_A1MAP_20_u1_u2_u2 FNC_VALUES 1 UBYTE COLUMN_DIR DIRECT /end RECORD_LAYOUT
/begin FUNCTION SmIsrSpt_Ptissxx ""
 /begin DEF_CHARACTERISTIC Ctb_cold_is_cata_wup_ctr Ctb_is_cata_wup_ctr Ctp_cold_tdc_agb_is_n_ofs Ctp_cold_tdc_pn_is_n_ofs Ctp_tdc_agb_tco_is_n_ofs Ctp_tdc_pn_tco_is_n_ofs Cxx_agb_tco_is_n_ofs Cxx_cold_agb Cxx_cold_agb_tco_is_n_ofs Cxx_cold_pn Cxx_cold_pn_alco Cxx_cold_pn_tco_is_n_ofs Cxx_cold_pn_tco_is_n_ofs_alco Cxx_cold_sta_tco Cxx_pn_tco_is_n_ofs Cxx_pn_tco_is_n_ofs_alco /end DEF_CHARACTERISTIC
 /begin OUT_MEASUREMENT Vbx_cata_wup_cdn_ena Vbx_cata_wup_dri Vxx_cold_pn_tco_is_n_ofs Vxx_is_n_ofs_cold Vxx_pft_min_is_n Vxx_pn_tco_is_n_ofs Vxx_tco_is_n_ofs Vxx_tco_neut_raw_val Vxx_tco_no_neut_raw_val Vxx_tdc_pn_tco_is_n_ofs /end OUT_MEASUREMENT
/end FUNCTION
/begin FUNCTION SmIsrSpt_Ntkofxx ""
 /begin DEF_CHARACTERISTIC Ctb_fzy_tkof_tqe_grd Ctb_tkof_vs_n_rat Ctp_fzy_tkof_tqe_grd_fac Ctp_fzy_tkof_vs_n_rat_fac Cbx_tkof_tqe_sp_dec_cfm Cxx_air_tq_dly_tdc_fac Cxx_fzy_tkof_lim_dec_t Cxx_mfld_tkof_dly_fac Cxx_n_tkof_fil_fac Cxx_n_tkof_inrt_0 Cxx_n_tkof_inrt_1 Cxx_tkof_n_dif_inrt_cge Cxx_tkof_tqe_grd_t /end DEF_CHARACTERISTIC
 /begin OUT_MEASUREMENT Vxx_driv_tqe_sp_grd Vxx_driv_tqe_sp_sat Vxx_fzy_tkof Vxx_mfld_dly_fil_fac Vxx_n_tkof_inrt Vxx_tkof_dly_tqe_sp Vxx_tkof_mdl_n_drv Vxx_tkof_mdl_n_drv_1 Vxx_tkof_mfld_tqe_sp Vxx_tkof_n_sp Vxx_tkof_tqe_sp Vxx_tq_air_dly_t /end OUT_MEASUREMENT
/end FUNCTION
/begin FUNCTION SmIsrSpt_Arissxx ""
 /begin DEF_CHARACTERISTIC Cmp_tco_amp_min_is_n Ctd_gear_run_vh_min_is_n Cbx_is_run_vh_min_crp_cfm Cbx_mpl_dec_slop_act Cxx_dec_slop_ac_sp Cxx_dec_slop_acs_sp Cxx_dec_slop_agb_sp Cxx_dec_slop_dgi_sp Cxx_dec_slop_diag_vvtc_sp Cxx_dec_slop_el_bk_sp Cxx_dec_slop_el_wind_sp Cxx_dec_slop_inj_sp Cxx_dec_slop_moni_sp Cxx_dec_slop_pft_sp Cxx_dec_slop_ptc_sp Cxx_dec_slop_pwst_sp Cxx_dec_slop_run_vh_sp Cxx_dec_slop_tco_sp Cxx_dec_slop_thpl_sp Cxx_fast_dec_slop Cxx_fast_inc_slop Cxx_inc_slop_ac_sp Cxx_inc_slop_acs_sp Cxx_inc_slop_agb_sp Cxx_inc_slop_dgi_sp Cxx_inc_slop_diag_vvtc_sp Cxx_inc_slop_el_bk_sp Cxx_inc_slop_el_wind_sp Cxx_inc_slop_inj_sp Cxx_inc_slop_moni_sp Cxx_inc_slop_pft_sp Cxx_inc_slop_ptc_sp Cxx_inc_slop_pwst_sp Cxx_inc_slop_run_vh_sp Cxx_inc_slop_tco_sp Cxx_inc_slop_thpl_sp Cxx_is_n_sp_max Cxx_is_n_sp_min Cxx_med_dec_slop Cxx_med_inc_slop Cxx_moni_is_n_sp_max Cxx_n_sp_dec Cxx_run_vh_min_is_n_dsb Cxx_slow_dec_slop Cxx_slow_inc_slop /end DEF_CHARACTERISTIC
 /begin OUT_MEASUREMENT Vtx_dec_slop_itl_tb[0] Vtx_dec_slop_itl_tb[1] Vtx_dec_slop_itl_tb[2] Vtx_dec_slop_itl_tb[3] Vtx_dec_slop_itl_tb[4] Vtx_dec_slop_itl_tb[5] Vtx_dec_slop_itl_tb[6] Vtx_dec_slop_itl_tb[7] Vtx_dec_slop_itl_tb[8] Vtx_dec_slop_itl_tb[9] Vtx_dec_slop_itl_tb[10] Vtx_dec_slop_itl_tb[11] Vtx_dec_slop_itl_tb[12] Vtx_dec_slop_itl_tb[13] Vtx_dec_slop_itl_tb[14] Vtx_inc_slop_itl_tb[0] Vtx_inc_slop_itl_tb[1] Vtx_inc_slop_itl_tb[2] Vtx_inc_slop_itl_tb[3] Vtx_inc_slop_itl_tb[4] Vtx_inc_slop_itl_tb[5] Vtx_inc_slop_itl_tb[6] Vtx_inc_slop_itl_tb[7] Vtx_inc_slop_itl_tb[8] Vtx_inc_slop_itl_tb[9] Vtx_inc_slop_itl_tb[10] Vtx_inc_slop_itl_tb[11] Vtx_inc_slop_itl_tb[12] Vtx_inc_slop_itl_tb[13] Vtx_inc_slop_itl_tb[14] Vtx_is_sp_itl_tb[0] Vtx_is_sp_itl_tb[1] Vtx_is_sp_itl_tb[2] Vtx_is_sp_itl_tb[3] Vtx_is_sp_itl_tb[4] Vtx_is_sp_itl_tb[5] Vtx_is_sp_itl_tb[6] Vtx_is_sp_itl_tb[7] Vtx_is_sp_itl_tb[8] Vtx_is_sp_itl_tb[9] Vtx_is_sp_itl_tb[10] Vtx_is_sp_itl_tb[11] Vtx_is_sp_itl_tb[12] Vtx_is_sp_itl_tb[13] Vtx_is_sp_itl_tb[14] Vxx_arb_dec_slop Vxx_arb_inc_slop Vxx_arb_lim_is Vxx_arb_raw_is Vxx_crt_is Vxx_is_n_sp Vxx_run_vh_min_is_n Vxx_tco_min_is_n Vxx_tco_sp_min_is_n /end OUT_MEASUREMENT
/end FUNCTION
/begin FUNCTION SmIsrSpt_Cfdgiss "" /begin OUT_MEASUREMENT Vsx_is_inj_vld /end OUT_MEASUREMENT /end FUNCTION
/begin FUNCTION SmIsrSpt_Istatun "" /begin DEF_CHARACTERISTIC Cxx_diag_max_is_n Cxx_diag_min_is_n Cxx_n_step /end DEF_CHARACTERISTIC
 /begin OUT_MEASUREMENT Vbx_diag_sta_ndec_ena Vbx_diag_sta_ndec_end Vbx_diag_sta_ninc_ena Vbx_diag_sta_ninc_end Vsx_diag_sta_ndec_stt Vsx_diag_sta_ninc_stt Vxx_diag_min_is_ofs /end OUT_MEASUREMENT
/end FUNCTION
/begin FUNCTION OuCboInj "" /begin OUT_MEASUREMENT Vxx_sta_eng_dly_NVM /end OUT_MEASUREMENT
 /begin SUB_FUNCTION OuCboInj_Appitxx OuCboInj_Mdplsxx OuCboInj_Opangxx OuCboInj_Opinjxx /end SUB_FUNCTION
/end FUNCTION
/begin FUNCTION OuCboInj_Appitxx ""
 /begin DEF_CHARACTERISTIC Cbx_inj1_num Cbx_inj2_num Cbx_inj3_num Cbx_inj4_num Cbx_min_ti Cbx_ti_bch Cxx_dfdec_inj1_oc Cxx_dfdec_inj1_scg Cxx_dfdec_inj1_scw Cxx_dfdec_inj2_oc Cxx_dfdec_inj2_scg Cxx_dfdec_inj2_scw Cxx_dfdec_inj3_oc Cxx_dfdec_inj3_scg Cxx_dfdec_inj3_scw Cxx_dfdec_inj4_oc Cxx_dfdec_inj4_scg Cxx_dfdec_inj4_scw Cxx_dfinc_inj1_oc Cxx_dfinc_inj1_scg Cxx_dfinc_inj1_scw Cxx_dfinc_inj2_oc Cxx_dfinc_inj2_scg Cxx_dfinc_inj2_scw Cxx_dfinc_inj3_oc Cxx_dfinc_inj3_scg Cxx_dfinc_inj3_scw Cxx_dfinc_inj4_oc Cxx_dfinc_inj4_scg Cxx_dfinc_inj4_scw Cxx_inj_appl_ti1 Cxx_inj_appl_ti2 Cxx_inj_wht_ti_fac Cxx_inj_wht_ti_fac_alco Cxx_min_cp_ti Cxx_min_ti Cxx_n_thd Cxx_sta_eng_dly Cxx_ti_bch /end DEF_CHARACTERISTIC
 /begin OUT_MEASUREMENT Vbx_diag_sta_ffig_abrt Vbx_diag_sta_ffig_ena Vbx_diag_sta_ffig_end Vbx_min_cp_ti Vbx_min_ti Vbx_min_ti_cut Vsx_diag_sta_ffig_stt Vsx_inj1_vld Vsx_inj2_vld Vsx_inj3_vld Vsx_inj4_vld Vxx_efv_ti Vxx_inj1_appl_ti1 Vxx_inj1_appl_ti2 Vxx_inj2_appl_ti1 Vxx_inj2_appl_ti2 Vxx_inj3_appl_ti1 Vxx_inj3_appl_ti2 Vxx_inj4_appl_ti1 Vxx_inj4_appl_ti2 Vxx_inj_wht_ti_fac Vxx_pinj_appl_ti Vxx_sta_eng_dly_t /end OUT_MEASUREMENT
/end FUNCTION
/begin FUNCTION OuCboInj_Mdplsxx "" /begin DEF_CHARACTERISTIC Ctb_mv_vb Ctp_vb_inj_dly_cor Cxx_inj_dly Cxx_inj_dly_alco /end DEF_CHARACTERISTIC /begin OUT_MEASUREMENT Vxx_inj_dly Vxx_inj_dly_clc Vxx_vb_inj_dly_cor /end OUT_MEASUREMENT /end FUNCTION
/begin FUNCTION OuCboInj_Opangxx ""
 /begin DEF_CHARACTERISTIC Cxx_seq_open_angl_max Cxx_sfg_open_angl1_max Cxx_sfg_open_angl2_max Cxx_sta_inj_sta_angl /end DEF_CHARACTERISTIC
 /begin OUT_MEASUREMENT Vxx_inj1_open_angl1 Vxx_inj1_open_angl2 Vxx_inj1_pinj_open_angl Vxx_inj2_open_angl1 Vxx_inj2_open_angl2 Vxx_inj2_pinj_open_angl Vxx_inj3_open_angl1 Vxx_inj3_open_angl2 Vxx_inj3_pinj_open_angl Vxx_inj4_open_angl1 Vxx_inj4_open_angl2 Vxx_inj4_pinj_open_angl /end OUT_MEASUREMENT
/end FUNCTION
/begin FUNCTION OuCboInj_Opinjxx ""
 /begin OUT_MEASUREMENT Vbx_inj1_not_open Vbx_inj1_open Vbx_inj2_not_open Vbx_inj2_open Vbx_inj3_not_open Vbx_inj3_open Vbx_inj4_not_open Vbx_inj4_open /end OUT_MEASUREMENT
/end FUNCTION
/begin FUNCTION BiSmiSyn "" /begin SUB_FUNCTION BiSmiSyn_Synchro /end SUB_FUNCTION /end FUNCTION
/begin FUNCTION BiSmiSyn_Synchro ""
 /begin OUT_MEASUREMENT Vbx_cho_cam_ctr_init Vbx_df_crk_chr Vbx_df_crk_cmp Vbx_df_crk_cyc Vbx_df_crk_no_sig_wit_cam Vbx_df_crk_oc Vbx_df_crk_shp Vbx_df_in_cam_chr Vbx_df_in_cam_crk_cmp Vbx_df_in_cam_cyc Vbx_df_in_cam_no_sig Vbx_df_in_cam_nok Vbx_diag_ena_crk_chr Vbx_diag_ena_crk_cmp Vbx_diag_ena_crk_cyc Vbx_diag_ena_crk_no_sig_wit_cam Vbx_diag_ena_crk_oc Vbx_diag_ena_crk_shp Vbx_diag_ena_in_cam_chr Vbx_diag_ena_in_cam_crk_cmp Vbx_diag_ena_in_cam_cyc Vbx_diag_ena_in_cam_no_sig Vbx_diag_ena_in_cam_nok Vbx_n_inv Vbx_raw_eng_syn Vbx_raw_in_cam_lvl Vbx_raw_trz_clc_ena Vxx_raw_eng_angl Vxx_raw_in_cam_toth_per Vxx_raw_n Vxx_raw_tdc_ctr Vxx_raw_tdc_per Vxx_raw_trz_t_toth_0 Vxx_raw_trz_t_toth_0_nxt Vxx_raw_trz_t_toth_1 Vxx_raw_trz_t_toth_2 Vxx_raw_trz_t_toth_3 Vxx_raw_trz_t_toth_4 Vxx_raw_trz_t_toth_5 Vxx_raw_trz_t_toth_5_prev lv_es lv_st /end OUT_MEASUREMENT
/end FUNCTION
/begin FUNCTION OuCboFuo "" /begin OUT_MEASUREMENT Vbx_mem_sta_gas_pump Vbx_cpl_sta_gas_pump /end OUT_MEASUREMENT
 /begin SUB_FUNCTION OuCboFuo_Pmpcdxx OuCboFuo_Adacxxx OuCboFuo_Cpxdiag OuCboFuo_Schxxxx OuCboFuo_Evasldv OuCboFuo_Pomadxx OuCboFuo_Eleadxx /end SUB_FUNCTION
/end FUNCTION
/begin FUNCTION OuCboFuo_Pmpcdxx ""
 /begin DEF_CHARACTERISTIC Cbx_gas_pump_fast_stop Cxx_dfdec_gas_pump_oc Cxx_dfdec_gas_pump_scg Cxx_dfdec_gas_pump_scw Cxx_dfinc_gas_pump_oc Cxx_dfinc_gas_pump_scg Cxx_dfinc_gas_pump_scw Cxx_gas_pump_sta_dly Cxx_sta_gas_pump_n_thd /end DEF_CHARACTERISTIC
 /begin OUT_MEASUREMENT Vbx_gas_pump_rly_cmd Vbx_sta_gas_pump Vsx_gas_pump_vld Vxx_gas_pump_dly /end OUT_MEASUREMENT
/end FUNCTION
/begin FUNCTION OuCboFuo_Adacxxx ""
 /begin DEF_CHARACTERISTIC Cxx_adac_fim_ofs Cxx_fuel_wht_vol_fac Cxx_fuel_wht_vol_fac_alco /end DEF_CHARACTERISTIC
 /begin OUT_MEASUREMENT Vxx_csm Vxx_csm_sum_mux Vxx_fim_sum_mux_2 Vxx_fuel_wht_vol_fac /end OUT_MEASUREMENT
/end FUNCTION
/begin FUNCTION OuCboFuo_Cpxdiag ""
 /begin DEF_CHARACTERISTIC Cxx_dfdec_cp_oc Cxx_dfdec_cp_scg Cxx_dfdec_cp_scw Cxx_dfinc_cp_oc Cxx_dfinc_cp_scg Cxx_dfinc_cp_scw /end DEF_CHARACTERISTIC
 /begin OUT_MEASUREMENT Vsx_cp_vld /end OUT_MEASUREMENT
/end FUNCTION
/begin FUNCTION OuCboFuo_Schxxxx "" /begin DEF_CHARACTERISTIC Cbx_ad_fuel_tk_cfm Cbx_eva_sldv_cfm Cbx_fuel_csm_wf_cfm /end DEF_CHARACTERISTIC /begin OUT_MEASUREMENT Vbx_ad_fuel_tk_cfm Vbx_eva_sldv_cfm Vbx_fuel_csm_wf_cfm /end OUT_MEASUREMENT /end FUNCTION
/begin FUNCTION OuCboFuo_Evasldv ""
 /begin DEF_CHARACTERISTIC Cxx_dfdec_eva_sldv_oc Cxx_dfdec_eva_sldv_scg Cxx_dfdec_eva_sldv_scw Cxx_dfinc_eva_sldv_oc Cxx_dfinc_eva_sldv_scg Cxx_dfinc_eva_sldv_scw /end DEF_CHARACTERISTIC
 /begin OUT_MEASUREMENT Vsx_evap_sldv_vld /end OUT_MEASUREMENT
/end FUNCTION
/begin FUNCTION OuCboFuo_Pomadxx ""
 /begin DEF_CHARACTERISTIC Cbx_sta_pump_bch_cmd Cxx_dfdec_gas_pump_2_oc Cxx_dfdec_gas_pump_2_scg Cxx_dfdec_gas_pump_2_scw Cxx_dfinc_gas_pump_2_oc Cxx_dfinc_gas_pump_2_scg Cxx_dfinc_gas_pump_2_scw /end DEF_CHARACTERISTIC
 /begin OUT_MEASUREMENT Vbx_sta_gaz_pump_cmd Vsx_gas_pump_2_vld /end OUT_MEASUREMENT
/end FUNCTION
/begin FUNCTION OuCboFuo_Eleadxx ""
 /begin DEF_CHARACTERISTIC Ctb_alco_rat Ctb_tco_sta_sldv Ctb_vb Ctp_alco_rat_pwm_cor Ctp_fill_sta_sldv_dly Ctp_n_pwm_cor Ctp_prs_pwm_cor Ctp_sta_tco_sldv_pwm Ctp_tco_alco_rat_sp Ctp_vb_sldv_pwm_cor Cbx_sta_sldv_bch Cxx_dfdec_efi_sldv_2_oc Cxx_dfdec_efi_sldv_2_scg Cxx_dfdec_efi_sldv_2_scw Cxx_dfinc_efi_sldv_2_oc Cxx_dfinc_efi_sldv_2_scg Cxx_dfinc_efi_sldv_2_scw Cxx_fill_sta_sldv_dly_dfl Cxx_fill_sta_sldv_pwm Cxx_sldv_pwm_min Cxx_sta_sldv_bch_pwm Cxx_sta_sldv_frq Cxx_sta_sldv_pwm_dec Cxx_sta_sldv_pwm_dft Cxx_tco_alco_rat_sp_dft /end DEF_CHARACTERISTIC
 /begin OUT_MEASUREMENT Vbx_sta_gaz_pump_req Vsx_efi_sldv_2_vld Vxx_alco_rat_sp Vxx_sta_sldv_dly Vxx_sta_sldv_frq Vxx_sta_sldv_pwm_appl Vxx_sta_sldv_pwm_sp Vxx_sta_sldv_pwm_sp1 /end OUT_MEASUREMENT
/end FUNCTION
/begin FUNCTION BiDgtSer ""
 /begin DEF_CHARACTERISTIC c_nr_hard_1_asa c_nr_hard_2_asa c_nr_hard_3_asa c_nr_hard_4_asa c_nr_hard_5_asa c_nr_hw_prg_1_asa c_nr_hw_prg_2_asa c_nr_hw_prg_3_asa c_nr_hw_prg_4_asa c_nr_hw_prg_5_asa /end DEF_CHARACTERISTIC
/end FUNCTION
/begin FUNCTION CbMisDgn "" /begin OUT_MEASUREMENT Sxx_mis_ctr_NVM Sxx_mis_ctr_lpg_NVM /end OUT_MEASUREMENT /begin SUB_FUNCTION CbMisDgn_Mdmsfxx CbMisDgn_Msfirxx /end SUB_FUNCTION /end FUNCTION
/begin FUNCTION CbMisDgn_Mdmsfxx ""
 /begin DEF_CHARACTERISTIC Cbx_mis_lih_conf Cxx_mis_lih_chk_dsb_conf Cxx_mis_lih_mis_nr Cxx_mis_lih_n_min Cxx_mis_lih_out_mis_nr Cxx_mis_lih_re_phs_nr Cxx_mis_lih_tdc_nr Cxx_mis_n_max_thd_1_n /end DEF_CHARACTERISTIC
 /begin OUT_MEASUREMENT Vbx_inj1_cut_req_tmp Vbx_inj2_cut_req_tmp Vbx_inj3_cut_req_tmp Vbx_inj4_cut_req_tmp Vbx_mis_cut Vbx_mis_cut_cyl_done Vbx_mis_det_1_2_inh Vbx_mis_inj_re_phs_req Vbx_mis_lih_cata_rst Vbx_mis_lih_chk_dsb Vbx_mis_lih_phs_chk Vbx_mis_lih_phs_chk_req Vbx_mis_lih_phs_ok Vbx_mis_lih_rst_inh Vbx_pres_mis_lih Vsx_cyl_cut Vsx_mis_inj1_vld Vsx_mis_inj2_vld Vsx_mis_inj3_vld Vsx_mis_inj4_vld Vsx_mis_lih_cyl_chk Vsx_mis_lih_stt Vxx_mis_cyl_fail_nr Vxx_mis_lih_mis_ctr Vxx_mis_lih_out_mis_ctr Vxx_mis_lih_re_phs_ctr Vxx_mis_lih_tdc_ctr /end OUT_MEASUREMENT
/end FUNCTION
/begin FUNCTION CbMisDgn_Msfirxx ""
 /begin DEF_CHARACTERISTIC Ctb_dft_comb_eal2 Ctb_dft_comb_eal2_lpg Ctb_dft_comb_n2 Ctb_dft_comb_n2_lpg Ntb_tco_9 Cmp_mis_cata_degr Cmp_mis_cata_degr_1 Cmp_mis_iga_efy_dif Cmp_mis_tq_dif_1_2_dz_1 Cmp_mis_tq_dif_1_4_dz_1 Cmp_mis_tq_dif_fac_1_2 Cmp_mis_tq_dif_fac_1_2_1 Cmp_mis_tq_dif_fac_1_2_dz Cmp_mis_tq_dif_fac_1_4 Cmp_mis_tq_dif_fac_1_4_1 Cmp_mis_tq_dif_fac_1_4_dz Cmp_mis_tq_dif_fac_intm Cmp_mis_tq_dif_fac_intm_1 Cmp_mis_tq_dif_intm_dz Cmp_mis_tq_dif_intm_dz_1 Ctp_min_eal Ctp_min_eal_1_2 Ctp_min_eal_amp_ofs Ctp_min_eal_off Cbx_mis_conf_diag_mis Cxx_agb_conv_trs_dly Cxx_dfdec_mis_1_cata Cxx_dfdec_mis_1_lpg_cata Cxx_dfdec_mis_1_lpg_trs_h Cxx_dfdec_mis_1_trs_h Cxx_dfdec_mis_2_cata Cxx_dfdec_mis_2_lpg_cata Cxx_dfdec_mis_2_lpg_trs_h Cxx_dfdec_mis_2_trs_h Cxx_dfdec_mis_3_cata Cxx_dfdec_mis_3_lpg_cata Cxx_dfdec_mis_3_lpg_trs_h Cxx_dfdec_mis_3_trs_h Cxx_dfdec_mis_4_cata Cxx_dfdec_mis_4_lpg_cata Cxx_dfdec_mis_4_lpg_trs_h Cxx_dfdec_mis_4_trs_h Cxx_dfdec_mis_cata Cxx_dfdec_mis_lpg_cata Cxx_dfdec_mis_lpg_trs_h Cxx_dfdec_mis_min_fuel_cata Cxx_dfdec_mis_min_fuel_trs_h Cxx_dfdec_mis_trs_h Cxx_dfdec_mis_unk_cata Cxx_dfdec_mis_unk_lpg_cata Cxx_dfdec_mis_unk_lpg_trs_h Cxx_dfdec_mis_unk_trs_h Cxx_dfinc_mis_1_cata Cxx_dfinc_mis_1_lpg_cata Cxx_dfinc_mis_1_lpg_trs_h Cxx_dfinc_mis_1_trs_h Cxx_dfinc_mis_2_cata Cxx_dfinc_mis_2_lpg_cata Cxx_dfinc_mis_2_lpg_trs_h Cxx_dfinc_mis_2_trs_h Cxx_dfinc_mis_3_cata Cxx_dfinc_mis_3_lpg_cata Cxx_dfinc_mis_3_lpg_trs_h Cxx_dfinc_mis_3_trs_h Cxx_dfinc_mis_4_cata Cxx_dfinc_mis_4_lpg_cata Cxx_dfinc_mis_4_lpg_trs_h Cxx_dfinc_mis_4_trs_h Cxx_dfinc_mis_cata Cxx_dfinc_mis_lpg_cata Cxx_dfinc_mis_lpg_trs_h Cxx_dfinc_mis_min_fuel_cata Cxx_dfinc_mis_min_fuel_trs_h Cxx_dfinc_mis_trs_h Cxx_dfinc_mis_unk_cata Cxx_dfinc_mis_unk_lpg_cata Cxx_dfinc_mis_unk_lpg_trs_h Cxx_dfinc_mis_unk_trs_h Cxx_min_diag_mis_dly Cxx_mis_cata_win_mis_nr Cxx_mis_cata_win_mis_nr_1 Cxx_mis_cata_win_tdc_nr Cxx_mis_cyl_fail_rat Cxx_mis_diag_obd_dsb_t Cxx_mis_ena_n_max_thd Cxx_mis_ena_n_min_thd Cxx_mis_ena_tco_min_thd Cxx_mis_fast_win_mis_nr Cxx_mis_fast_win_tdc_nr Cxx_mis_n_max_agb_clos_no Cxx_mis_ofs_eal_agb_ena Cxx_mis_polu_win_mis_nr Cxx_mis_polu_win_mis_nr_1 Cxx_mis_polu_win_nr_fail Cxx_mis_polu_win_tdc_nr Cxx_mis_rat_min_cyl_ Cxx_mis_stab_tdc_nr /end DEF_CHARACTERISTIC
 /begin OUT_MEASUREMENT Sxx_mis_ctr_clr Sxx_mis_ctr_lpg_clr Sxx_mis_ctr_lpg_read Sxx_mis_ctr_read Vbx_df_mis_1_cata Vbx_df_mis_1_lpg_cata Vbx_df_mis_1_lpg_trs_h Vbx_df_mis_1_trs_h Vbx_df_mis_2_cata Vbx_df_mis_2_lpg_cata Vbx_df_mis_2_lpg_trs_h Vbx_df_mis_2_trs_h Vbx_df_mis_3_cata Vbx_df_mis_3_lpg_cata Vbx_df_mis_3_lpg_trs_h Vbx_df_mis_3_trs_h Vbx_df_mis_4_cata Vbx_df_mis_4_lpg_cata Vbx_df_mis_4_lpg_trs_h Vbx_df_mis_4_trs_h Vbx_df_mis_cata Vbx_df_mis_lpg_cata Vbx_df_mis_lpg_trs_h Vbx_df_mis_min_fuel_cata Vbx_df_mis_min_fuel_trs_h Vbx_df_mis_trs_h Vbx_df_mis_unk_cata Vbx_df_mis_unk_lpg_cata Vbx_df_mis_unk_lpg_trs_h Vbx_df_mis_unk_trs_h Vbx_diag_ena_mis_1_cata Vbx_diag_ena_mis_1_lpg_cata Vbx_diag_ena_mis_1_lpg_trs_h Vbx_diag_ena_mis_1_trs_h Vbx_diag_ena_mis_2_cata Vbx_diag_ena_mis_2_lpg_cata Vbx_diag_ena_mis_2_lpg_trs_h Vbx_diag_ena_mis_2_trs_h Vbx_diag_ena_mis_3_cata Vbx_diag_ena_mis_3_lpg_cata Vbx_diag_ena_mis_3_lpg_trs_h Vbx_diag_ena_mis_3_trs_h Vbx_diag_ena_mis_4_cata Vbx_diag_ena_mis_4_lpg_cata Vbx_diag_ena_mis_4_lpg_trs_h Vbx_diag_ena_mis_4_trs_h Vbx_diag_ena_mis_cata Vbx_diag_ena_mis_lpg_cata Vbx_diag_ena_mis_lpg_trs_h Vbx_diag_ena_mis_min_fuel_cata Vbx_diag_ena_mis_min_fuel_trs_h Vbx_diag_ena_mis_trs_h Vbx_diag_ena_mis_unk_cata Vbx_diag_ena_mis_unk_lpg_cata Vbx_diag_ena_mis_unk_lpg_trs_h Vbx_diag_ena_mis_unk_trs_h Vbx_dsb_diag_mis Vbx_frst_inj_re Vbx_mil_flsh_req Vbx_mis_cata_cf_vld Vbx_mis_cata_rst_done Vbx_mis_cata_win_stop Vbx_mis_cyl1 Vbx_mis_cyl1_fail Vbx_mis_cyl2 Vbx_mis_cyl2_fail Vbx_mis_cyl3 Vbx_mis_cyl3_fail Vbx_mis_cyl4 Vbx_mis_cyl4_fail Vbx_mis_det Vbx_mis_det_1_2 Vbx_mis_det_1_4 Vbx_mis_det_1_4_prev2 Vbx_mis_det_intm Vbx_mis_det_prev16 Vbx_mis_frst_diag_done Vbx_mis_obd_diag_stop Vbx_mis_req Vbx_mis_stop Vbx_pres_mis_fast Vsx_mis_cata_vld Vsx_mis_stt Vsx_mis_vld Vxx_agb_conv_trs_dly Vxx_eal_ofs_agb_dri Vxx_max_iga_efy_prev2 Vxx_min_eal_1_2 Vxx_mis_16_mis_ctr Vxx_mis_cata_degr Vxx_mis_cata_min_fuel_nr Vxx_mis_cata_mis_ctr Vxx_mis_cata_tdc_ctr Vxx_mis_cata_tdc_nr_tot Vxx_mis_cata_tdc_prmt Vxx_mis_cata_win_mis_nr Vxx_mis_ctr_ini Vxx_mis_ctr_lpg_ini Vxx_mis_cyl1_tdc_ctr Vxx_mis_cyl2_tdc_ctr Vxx_mis_cyl3_tdc_ctr Vxx_mis_cyl4_tdc_ctr Vxx_mis_diag_dsb_dly Vxx_mis_dt Vxx_mis_eal_frz Vxx_mis_eol_mod_mis_ctr Vxx_mis_eol_mod_prop Vxx_mis_eol_mod_tdc_ctr Vxx_mis_fast_mis_ctr Vxx_mis_fast_tdc_ctr Vxx_mis_iga_efy_dif_2 Vxx_mis_l_n_tdc_ctr Vxx_mis_n_frz Vxx_mis_n_max_thd_1_n Vxx_mis_nr_cyl1 Vxx_mis_nr_cyl2 Vxx_mis_nr_cyl3 Vxx_mis_nr_cyl4 Vxx_mis_obd_diag_stop Vxx_mis_polu_mis_ctr Vxx_mis_polu_tdc_ctr Vxx_mis_polu_tot_ctr Vxx_mis_polu_win_ctr Vxx_mis_polu_win_mis_nr Vxx_mis_stab_tdc_ctr Vxx_mis_tq_dif_fac_1_2 Vxx_mis_tq_dif_fac_1_2_dz Vxx_mis_tq_dif_fac_1_4 Vxx_mis_tq_dif_fac_1_4_dz Vxx_mis_tq_dif_fac_intm Vxx_mis_tq_dif_intm_dz /end OUT_MEASUREMENT
/end FUNCTION
/begin FUNCTION SmLimCtl "" /begin SUB_FUNCTION SmLimCtl_Ntqcxxx SmLimCtl_Ntspcxx /end SUB_FUNCTION /end FUNCTION
/begin FUNCTION SmLimCtl_Ntqcxxx ""
 /begin DEF_CHARACTERISTIC Ctd_n_prop_thd Ctd_ovn_tq_int_k Ctd_ovn_tq_prop_k Cxx_ovn_tq_prop_t_fil Cxx_tqe_max_ovn /end DEF_CHARACTERISTIC
 /begin OUT_MEASUREMENT Vxx_lim_dif_n Vxx_lim_dif_n_prop Vxx_ovn_tq_cor Vxx_ovn_tq_cor_p_i Vxx_ovn_tq_int Vxx_ovn_tq_prop /end OUT_MEASUREMENT
/end FUNCTION
/begin FUNCTION SmLimCtl_Ntspcxx "" /begin DEF_CHARACTERISTIC Cxx_inj_stop_n_ofs /end DEF_CHARACTERISTIC /begin OUT_MEASUREMENT Vbx_ovn_cut_sp /end OUT_MEASUREMENT /end FUNCTION
/begin FUNCTION SmLimSpt "" /begin OUT_MEASUREMENT Vxx_ovn_mon_km Vxx_ovn_mon_n_max Vxx_ovn_mon_dly_tot /end OUT_MEASUREMENT
 /begin SUB_FUNCTION SmLimSpt_Nramsxx SmLimSpt_Nlimxxx SmLimSpt_Fsncfxx SmLimSpt_Ovnmonx SmLimSpt_Schedul /end SUB_FUNCTION
/end FUNCTION
/begin FUNCTION SmLimSpt_Nramsxx "" /begin DEF_CHARACTERISTIC Ctp_max_rams_n_dec Cxx_max_rams_n_1 Cxx_max_rams_n_2 /end DEF_CHARACTERISTIC /begin OUT_MEASUREMENT Vbx_n_rams_lim_act Vsx_n_rams_lim_vld Vxx_max_rams_n /end OUT_MEASUREMENT /end FUNCTION
/begin FUNCTION SmLimSpt_Nlimxxx ""
 /begin DEF_CHARACTERISTIC Ctd_gear_cge_max_n_ofs Ctp_max_n_gear Ctp_max_n_nom_hys Ctp_max_n_ovn_ofs Ctp_max_n_tco Ctp_max_n_toil Ctp_ovn_tq_cor_ena Ctp_sta_tco_dly Cbx_max_n_fl_tkof_ant_coup_dsb Cbx_max_n_fl_tkof_ena Cbx_max_n_fl_tkof_ovn_tq_ena Cbx_max_n_ovn_ofs_cfm Cxx_gear_cge_max_n_hys Cxx_inj_cut_det_dly Cxx_max_n_dec_slop Cxx_max_n_fl_tkof Cxx_max_n_fl_tkof_ext_ctrl_dly Cxx_max_n_fl_tkof_vs_thd Cxx_max_n_gear_dft Cxx_max_n_inc_slop Cxx_max_n_ovn_ofs_neg_slop Cxx_max_n_ovn_ofs_pos_slop Cxx_max_n_tco_toil_dft Cxx_max_n_thd_oil_ovn Cxx_sta_tco_dly_dft /end DEF_CHARACTERISTIC
 /begin OUT_MEASUREMENT Vbx_gear_cge_max_n Vbx_max_n_fl_tkof_act Vbx_max_n_fl_tkof_cdn Vbx_ovn_sta_ena Vbx_ovn_tq_cor_ena Vxx_max_n_inj Vxx_max_n_nom Vxx_max_n_ovn Vxx_max_n_ovn_ofs Vxx_max_n_ovn_ofs_raw /end OUT_MEASUREMENT
/end FUNCTION
/begin FUNCTION SmLimSpt_Fsncfxx "" /begin DEF_CHARACTERISTIC Cxx_n_lim_crk_cfm /end DEF_CHARACTERISTIC
 /begin OUT_MEASUREMENT Vbx_n_rams_lim_act_1 Vbx_n_rams_lim_act_2 Vbx_ovn_tq_cor_dft_dsb /end OUT_MEASUREMENT
/end FUNCTION
/begin FUNCTION SmLimSpt_Ovnmonx "" /begin DEF_CHARACTERISTIC Cxx_ovn_mon_n_thd /end DEF_CHARACTERISTIC /begin OUT_MEASUREMENT Vbx_ovn_mon_act /end OUT_MEASUREMENT /end FUNCTION
/begin FUNCTION SmLimSpt_Schedul "" /begin OUT_MEASUREMENT Vbx_rs_ovn_mon_cfm /end OUT_MEASUREMENT /end FUNCTION
/begin FUNCTION InSmiSsr ""
 /begin SUB_FUNCTION InSmiSsr_Accluxx InSmiSsr_Acclucs InSmiSsr_Agbspcs InSmiSsr_Agbxxcs InSmiSsr_Ptcxxcs InSmiSsr_Windxcs InSmiSsr_Acsiscs InSmiSsr_Acclumd InSmiSsr_Ptcxxmd /end SUB_FUNCTION
/end FUNCTION
/begin FUNCTION InSmiSsr_Accluxx ""
 /begin DEF_CHARACTERISTIC Ctb_ac_acel_is Ctp_ac_acel_is_swi_off Ctp_ac_acel_is_swi_on Ctp_ac_acel_is_val_off Ctp_ac_acel_is_val_on Cxx_ac_req_off_ac_acel_is_sp /end DEF_CHARACTERISTIC
 /begin OUT_MEASUREMENT Vsx_mdl_ac_acel_is_sp_vld Vxx_mdl_ac_acel_is_sp /end OUT_MEASUREMENT
/end FUNCTION
/begin FUNCTION InSmiSsr_Acclucs "" /begin OUT_MEASUREMENT Vxx_ac_acel_is_sp /end OUT_MEASUREMENT /end FUNCTION
/begin FUNCTION InSmiSsr_Agbspcs "" /begin OUT_MEASUREMENT Vsx_agb_is_acel_sp_vld Vxx_agb_is_acel_sp /end OUT_MEASUREMENT /end FUNCTION
/begin FUNCTION InSmiSsr_Agbxxcs "" /begin OUT_MEASUREMENT Vbx_agb_is_acel_req Vsx_agb_is_acel_req_vld /end OUT_MEASUREMENT /end FUNCTION
/begin FUNCTION InSmiSsr_Ptcxxcs "" /begin OUT_MEASUREMENT Vbx_ptc_is_acel_req /end OUT_MEASUREMENT /end FUNCTION
/begin FUNCTION InSmiSsr_Windxcs "" /begin OUT_MEASUREMENT Vbx_el_bk_wind Vbx_el_wind_is_acel /end OUT_MEASUREMENT /end FUNCTION
/begin FUNCTION InSmiSsr_Acsiscs "" /begin OUT_MEASUREMENT Vbx_acs_acel_is_req /end OUT_MEASUREMENT /end FUNCTION
/begin FUNCTION InSmiSsr_Acclumd "" /begin OUT_MEASUREMENT Vxx_tair_ext /end OUT_MEASUREMENT /end FUNCTION
/begin FUNCTION InSmiSsr_Ptcxxmd "" /begin OUT_MEASUREMENT Vbx_mdl_ptc_is_acel_req /end OUT_MEASUREMENT /end FUNCTION
/end MODULE
/end PROJECT
