ASAP2_VERSION 1 41
/begin PROJECT RD8 "_default_ProjectLongIdentifier"
/begin HEADER "_default_HeaderComment" PROJECT_NO RD9 /end HEADER
/begin MODULE _default_ModuleName "_default_ModuleLongIdentifier"
/begin MOD_COMMON "_default_ModCommonComment" DEPOSIT ABSOLUTE BYTE_ORDER MSB_LAST ALIGNMENT_BYTE 1 ALIGNMENT_WORD 2 ALIGNMENT_LONG 2 ALIGNMENT_FLOAT32_IEEE 2 ALIGNMENT_FLOAT64_IEEE 4 /end MOD_COMMON
/begin CHARACTERISTIC Ctx_ffm_did_agb[4] "" VALUE 0xa002ec40 _REC_S1VAL_20_u2 65535. _CNV_A_R_A_165_CM 0. 65535. DISPLAY_IDENTIFIER Pxx_dgdftmng_dtc_agb.Ctx_ffm_did_xxx[4] /end CHARACTERISTIC
/begin CHARACTERISTIC Cxx_dtc_hmb_agb "" VALUE 0xa002ec42 _REC_S1VAL_20_u2 65535. _CNV_A_R_A_165_CM 0. 65535. DISPLAY_IDENTIFIER Pxx_dgdftmng_dtc_agb.Cxx_dtc_hmb_xxx /end CHARACTERISTIC
/begin CHARACTERISTIC Ctx_ffm_did_agb_data[0] "" VALUE 0xa002ec2c _REC_S1VAL_20_u2 65535. _CNV_A_R_A_165_CM 0. 65535. DISPLAY_IDENTIFIER Pxx_dgdftmng_dtc_agb_data.Ctx_ffm_did_xxx[0] /end CHARACTERISTIC
/begin CHARACTERISTIC Ctx_ffm_did_agb_data[1] "" VALUE 0xa002ec2e _REC_S1VAL_20_u2 65535. _CNV_A_R_A_165_CM 0. 65535. DISPLAY_IDENTIFIER Pxx_dgdftmng_dtc_agb_data.Ctx_ffm_did_xxx[1] /end CHARACTERISTIC
/begin CHARACTERISTIC Ctx_ffm_did_agb_data[2] "" VALUE 0xa002ec30 _REC_S1VAL_20_u2 65535. _CNV_A_R_A_165_CM 0. 65535. DISPLAY_IDENTIFIER Pxx_dgdftmng_dtc_agb_data.Ctx_ffm_did_xxx[2] /end CHARACTERISTIC
/begin CHARACTERISTIC Ctx_ffm_did_agb_data[3] "" VALUE 0xa002ec32 _REC_S1VAL_20_u2 65535. _CNV_A_R_A_165_CM 0. 65535. DISPLAY_IDENTIFIER Pxx_dgdftmng_dtc_agb_data.Ctx_ffm_did_xxx[3] /end CHARACTERISTIC
/begin CHARACTERISTIC Ctx_ffm_did_agb_data[4] "" VALUE 0xa002ec34 _REC_S1VAL_20_u2 65535. _CNV_A_R_A_165_CM 0. 65535. DISPLAY_IDENTIFIER Pxx_dgdftmng_dtc_agb_data.Ctx_ffm_did_xxx[4] /end CHARACTERISTIC
/begin CHARACTERISTIC Cxx_dtc_hmb_agb_data "" VALUE 0xa002ec36 _REC_S1VAL_20_u2 65535. _CNV_A_R_A_165_CM 0. 65535. DISPLAY_IDENTIFIER Pxx_dgdftmng_dtc_agb_data.Cxx_dtc_hmb_xxx /end CHARACTERISTIC
/begin CHARACTERISTIC Ctx_ffm_did_bgin_clu[0] "" VALUE 0xa002edc4 _REC_S1VAL_20_u2 65535. _CNV_A_R_A_165_CM 0. 65535. DISPLAY_IDENTIFIER Pxx_dgdftmng_dtc_bgin_clu.Ctx_ffm_did_xxx[0] /end CHARACTERISTIC
/begin CHARACTERISTIC Ctx_ffm_did_bgin_clu[1] "" VALUE 0xa002edc6 _REC_S1VAL_20_u2 65535. _CNV_A_R_A_165_CM 0. 65535. DISPLAY_IDENTIFIER Pxx_dgdftmng_dtc_bgin_clu.Ctx_ffm_did_xxx[1] /end CHARACTERISTIC
/begin CHARACTERISTIC Ctx_ffm_did_bgin_clu[2] "" VALUE 0xa002edc8 _REC_S1VAL_20_u2 65535. _CNV_A_R_A_165_CM 0. 65535. DISPLAY_IDENTIFIER Pxx_dgdftmng_dtc_bgin_clu.Ctx_ffm_did_xxx[2] /end CHARACTERISTIC
/begin CHARACTERISTIC Ctx_ffm_did_bgin_clu[3] "" VALUE 0xa002edca _REC_S1VAL_20_u2 65535. _CNV_A_R_A_165_CM 0. 65535. DISPLAY_IDENTIFIER Pxx_dgdftmng_dtc_bgin_clu.Ctx_ffm_did_xxx[3] /end CHARACTERISTIC
/begin CHARACTERISTIC Ctx_ffm_did_bgin_clu[4] "" VALUE 0xa002edcc _REC_S1VAL_20_u2 65535. _CNV_A_R_A_165_CM 0. 65535. DISPLAY_IDENTIFIER Pxx_dgdftmng_dtc_bgin_clu.Ctx_ffm_did_xxx[4] /end CHARACTERISTIC
/begin CHARACTERISTIC Cxx_dtc_hmb_bgin_clu "" VALUE 0xa002edce _REC_S1VAL_20_u2 65535. _CNV_A_R_A_165_CM 0. 65535. DISPLAY_IDENTIFIER Pxx_dgdftmng_dtc_bgin_clu.Cxx_dtc_hmb_xxx /end CHARACTERISTIC
/begin CHARACTERISTIC Ctx_ffm_did_brk_pdl[0] "" VALUE 0xa002edd0 _REC_S1VAL_20_u2 65535. _CNV_A_R_A_165_CM 0. 65535. DISPLAY_IDENTIFIER Pxx_dgdftmng_dtc_brk_pdl.Ctx_ffm_did_xxx[0] /end CHARACTERISTIC
/begin CHARACTERISTIC Ctx_ffm_did_brk_pdl[1] "" VALUE 0xa002edd2 _REC_S1VAL_20_u2 65535. _CNV_A_R_A_165_CM 0. 65535. DISPLAY_IDENTIFIER Pxx_dgdftmng_dtc_brk_pdl.Ctx_ffm_did_xxx[1] /end CHARACTERISTIC
/begin CHARACTERISTIC Ctx_ffm_did_brk_pdl[2] "" VALUE 0xa002edd4 _REC_S1VAL_20_u2 65535. _CNV_A_R_A_165_CM 0. 65535. DISPLAY_IDENTIFIER Pxx_dgdftmng_dtc_brk_pdl.Ctx_ffm_did_xxx[2] /end CHARACTERISTIC
/begin CHARACTERISTIC Ctx_ffm_did_brk_pdl[3] "" VALUE 0xa002edd6 _REC_S1VAL_20_u2 65535. _CNV_A_R_A_165_CM 0. 65535. DISPLAY_IDENTIFIER Pxx_dgdftmng_dtc_brk_pdl.Ctx_ffm_did_xxx[3] /end CHARACTERISTIC
/begin CHARACTERISTIC Ctx_ffm_did_brk_pdl[4] "" VALUE 0xa002edd8 _REC_S1VAL_20_u2 65535. _CNV_A_R_A_165_CM 0. 65535. DISPLAY_IDENTIFIER Pxx_dgdftmng_dtc_brk_pdl.Ctx_ffm_did_xxx[4] /end CHARACTERISTIC
/begin CHARACTERISTIC Cxx_dtc_hmb_brk_pdl "" VALUE 0xa002edda _REC_S1VAL_20_u2 65535. _CNV_A_R_A_165_CM 0. 65535. DISPLAY_IDENTIFIER Pxx_dgdftmng_dtc_brk_pdl.Cxx_dtc_hmb_xxx /end CHARACTERISTIC
/begin CHARACTERISTIC Ctx_ffm_did_cata[0] "" VALUE 0xa002ec44 _REC_S1VAL_20_u2 65535. _CNV_A_R_A_165_CM 0. 65535. DISPLAY_IDENTIFIER Pxx_dgdftmng_dtc_cata.Ctx_ffm_did_xxx[0] /end CHARACTERISTIC
/begin CHARACTERISTIC Ctx_ffm_did_cata[1] "" VALUE 0xa002ec46 _REC_S1VAL_20_u2 65535. _CNV_A_R_A_165_CM 0. 65535. DISPLAY_IDENTIFIER Pxx_dgdftmng_dtc_cata.Ctx_ffm_did_xxx[1] /end CHARACTERISTIC
/begin CHARACTERISTIC Ctx_ffm_did_cata[2] "" VALUE 0xa002ec48 _REC_S1VAL_20_u2 65535. _CNV_A_R_A_165_CM 0. 65535. DISPLAY_IDENTIFIER Pxx_dgdftmng_dtc_cata.Ctx_ffm_did_xxx[2] /end CHARACTERISTIC
/begin CHARACTERISTIC Ctx_ffm_did_cata[3] "" VALUE 0xa002ec4a _REC_S1VAL_20_u2 65535. _CNV_A_R_A_165_CM 0. 65535. DISPLAY_IDENTIFIER Pxx_dgdftmng_dtc_cata.Ctx_ffm_did_xxx[3] /end CHARACTERISTIC
/begin CHARACTERISTIC Ctx_ffm_did_cata[4] "" VALUE 0xa002ec4c _REC_S1VAL_20_u2 65535. _CNV_A_R_A_165_CM 0. 65535. DISPLAY_IDENTIFIER Pxx_dgdftmng_dtc_cata.Ctx_ffm_did_xxx[4] /end CHARACTERISTIC
/begin CHARACTERISTIC Cxx_dtc_hmb_cata "" VALUE 0xa002ec4e _REC_S1VAL_20_u2 65535. _CNV_A_R_A_165_CM 0. 65535. DISPLAY_IDENTIFIER Pxx_dgdftmng_dtc_cata.Cxx_dtc_hmb_xxx /end CHARACTERISTIC
/begin CHARACTERISTIC Ctx_ffm_did_cl_rich[0] "" VALUE 0xa002efb0 _REC_S1VAL_20_u2 65535. _CNV_A_R_A_165_CM 0. 65535. DISPLAY_IDENTIFIER Pxx_dgdftmng_dtc_cl_rich.Ctx_ffm_did_xxx[0] /end CHARACTERISTIC
/begin CHARACTERISTIC Ctx_ffm_did_cl_rich[1] "" VALUE 0xa002efb2 _REC_S1VAL_20_u2 65535. _CNV_A_R_A_165_CM 0. 65535. DISPLAY_IDENTIFIER Pxx_dgdftmng_dtc_cl_rich.Ctx_ffm_did_xxx[1] /end CHARACTERISTIC
/begin CHARACTERISTIC Ctx_ffm_did_cl_rich[2] "" VALUE 0xa002efb4 _REC_S1VAL_20_u2 65535. _CNV_A_R_A_165_CM 0. 65535. DISPLAY_IDENTIFIER Pxx_dgdftmng_dtc_cl_rich.Ctx_ffm_did_xxx[2] /end CHARACTERISTIC
/begin CHARACTERISTIC Ctx_ffm_did_cl_rich[3] "" VALUE 0xa002efb6 _REC_S1VAL_20_u2 65535. _CNV_A_R_A_165_CM 0. 65535. DISPLAY_IDENTIFIER Pxx_dgdftmng_dtc_cl_rich.Ctx_ffm_did_xxx[3] /end CHARACTERISTIC
/begin CHARACTERISTIC Ctx_ffm_did_cl_rich[4] "" VALUE 0xa002efb8 _REC_S1VAL_20_u2 65535. _CNV_A_R_A_165_CM 0. 65535. DISPLAY_IDENTIFIER Pxx_dgdftmng_dtc_cl_rich.Ctx_ffm_did_xxx[4] /end CHARACTERISTIC
/begin CHARACTERISTIC Cxx_dtc_hmb_cl_rich "" VALUE 0xa002efba _REC_S1VAL_20_u2 65535. _CNV_A_R_A_165_CM 0. 65535. DISPLAY_IDENTIFIER Pxx_dgdftmng_dtc_cl_rich.Cxx_dtc_hmb_xxx /end CHARACTERISTIC
/begin CHARACTERISTIC Ctx_ffm_did_clu_cnt[0] "" VALUE 0xa002ec50 _REC_S1VAL_20_u2 65535. _CNV_A_R_A_165_CM 0. 65535. DISPLAY_IDENTIFIER Pxx_dgdftmng_dtc_clu_cnt.Ctx_ffm_did_xxx[0] /end CHARACTERISTIC
/begin CHARACTERISTIC Ctx_ffm_did_clu_cnt[1] "" VALUE 0xa002ec52 _REC_S1VAL_20_u2 65535. _CNV_A_R_A_165_CM 0. 65535. DISPLAY_IDENTIFIER Pxx_dgdftmng_dtc_clu_cnt.Ctx_ffm_did_xxx[1] /end CHARACTERISTIC
/begin CHARACTERISTIC Ctx_ffm_did_clu_cnt[2] "" VALUE 0xa002ec54 _REC_S1VAL_20_u2 65535. _CNV_A_R_A_165_CM 0. 65535. DISPLAY_IDENTIFIER Pxx_dgdftmng_dtc_clu_cnt.Ctx_ffm_did_xxx[2] /end CHARACTERISTIC
/begin CHARACTERISTIC Ctx_ffm_did_clu_cnt[3] "" VALUE 0xa002ec56 _REC_S1VAL_20_u2 65535. _CNV_A_R_A_165_CM 0. 65535. DISPLAY_IDENTIFIER Pxx_dgdftmng_dtc_clu_cnt.Ctx_ffm_did_xxx[3] /end CHARACTERISTIC
/begin CHARACTERISTIC Ctx_ffm_did_clu_cnt[4] "" VALUE 0xa002ec58 _REC_S1VAL_20_u2 65535. _CNV_A_R_A_165_CM 0. 65535. DISPLAY_IDENTIFIER Pxx_dgdftmng_dtc_clu_cnt.Ctx_ffm_did_xxx[4] /end CHARACTERISTIC
/begin CHARACTERISTIC Cxx_dtc_hmb_clu_cnt "" VALUE 0xa002ec5a _REC_S1VAL_20_u2 65535. _CNV_A_R_A_165_CM 0. 65535. DISPLAY_IDENTIFIER Pxx_dgdftmng_dtc_clu_cnt.Cxx_dtc_hmb_xxx /end CHARACTERISTIC
/begin CHARACTERISTIC Ctx_ffm_did_cp[0] "" VALUE 0xa002edac _REC_S1VAL_20_u2 65535. _CNV_A_R_A_165_CM 0. 65535. DISPLAY_IDENTIFIER Pxx_dgdftmng_dtc_cp.Ctx_ffm_did_xxx[0] /end CHARACTERISTIC
/begin CHARACTERISTIC Ctx_ffm_did_cp[1] "" VALUE 0xa002edae _REC_S1VAL_20_u2 65535. _CNV_A_R_A_165_CM 0. 65535. DISPLAY_IDENTIFIER Pxx_dgdftmng_dtc_cp.Ctx_ffm_did_xxx[1] /end CHARACTERISTIC
/begin CHARACTERISTIC Ctx_ffm_did_cp[2] "" VALUE 0xa002edb0 _REC_S1VAL_20_u2 65535. _CNV_A_R_A_165_CM 0. 65535. DISPLAY_IDENTIFIER Pxx_dgdftmng_dtc_cp.Ctx_ffm_did_xxx[2] /end CHARACTERISTIC
/begin CHARACTERISTIC Ctx_ffm_did_cp[3] "" VALUE 0xa002edb2 _REC_S1VAL_20_u2 65535. _CNV_A_R_A_165_CM 0. 65535. DISPLAY_IDENTIFIER Pxx_dgdftmng_dtc_cp.Ctx_ffm_did_xxx[3] /end CHARACTERISTIC
/begin CHARACTERISTIC Ctx_ffm_did_cp[4] "" VALUE 0xa002edb4 _REC_S1VAL_20_u2 65535. _CNV_A_R_A_165_CM 0. 65535. DISPLAY_IDENTIFIER Pxx_dgdftmng_dtc_cp.Ctx_ffm_did_xxx[4] /end CHARACTERISTIC
/begin CHARACTERISTIC Cxx_dtc_hmb_cp "" VALUE 0xa002edb6 _REC_S1VAL_20_u2 65535. _CNV_A_R_A_165_CM 0. 65535. DISPLAY_IDENTIFIER Pxx_dgdftmng_dtc_cp.Cxx_dtc_hmb_xxx /end CHARACTERISTIC
/begin CHARACTERISTIC Ctx_ffm_did_crk[0] "" VALUE 0xa002ef08 _REC_S1VAL_20_u2 65535. _CNV_A_R_A_165_CM 0. 65535. DISPLAY_IDENTIFIER Pxx_dgdftmng_dtc_crk.Ctx_ffm_did_xxx[0] /end CHARACTERISTIC
/begin CHARACTERISTIC Ctx_ffm_did_crk[1] "" VALUE 0xa002ef0a _REC_S1VAL_20_u2 65535. _CNV_A_R_A_165_CM 0. 65535. DISPLAY_IDENTIFIER Pxx_dgdftmng_dtc_crk.Ctx_ffm_did_xxx[1] /end CHARACTERISTIC
/begin CHARACTERISTIC Ctx_ffm_did_crk[2] "" VALUE 0xa002ef0c _REC_S1VAL_20_u2 65535. _CNV_A_R_A_165_CM 0. 65535. DISPLAY_IDENTIFIER Pxx_dgdftmng_dtc_crk.Ctx_ffm_did_xxx[2] /end CHARACTERISTIC
/begin CHARACTERISTIC Ctx_ffm_did_crk[3] "" VALUE 0xa002ef0e _REC_S1VAL_20_u2 65535. _CNV_A_R_A_165_CM 0. 65535. DISPLAY_IDENTIFIER Pxx_dgdftmng_dtc_crk.Ctx_ffm_did_xxx[3] /end CHARACTERISTIC
/begin CHARACTERISTIC Ctx_ffm_did_crk[4] "" VALUE 0xa002ef10 _REC_S1VAL_20_u2 65535. _CNV_A_R_A_165_CM 0. 65535. DISPLAY_IDENTIFIER Pxx_dgdftmng_dtc_crk.Ctx_ffm_did_xxx[4] /end CHARACTERISTIC
/begin CHARACTERISTIC Cxx_dtc_hmb_crk "" VALUE 0xa002ef12 _REC_S1VAL_20_u2 65535. _CNV_A_R_A_165_CM 0. 65535. DISPLAY_IDENTIFIER Pxx_dgdftmng_dtc_crk.Cxx_dtc_hmb_xxx /end CHARACTERISTIC
/begin CHARACTERISTIC Ctx_ffm_did_cru[0] "" VALUE 0xa002eddc _REC_S1VAL_20_u2 65535. _CNV_A_R_A_165_CM 0. 65535. DISPLAY_IDENTIFIER Pxx_dgdftmng_dtc_cru.Ctx_ffm_did_xxx[0] /end CHARACTERISTIC
/begin CHARACTERISTIC Ctx_ffm_did_cru[1] "" VALUE 0xa002edde _REC_S1VAL_20_u2 65535. _CNV_A_R_A_165_CM 0. 65535. DISPLAY_IDENTIFIER Pxx_dgdftmng_dtc_cru.Ctx_ffm_did_xxx[1] /end CHARACTERISTIC
/begin CHARACTERISTIC Ctx_ffm_did_cru[2] "" VALUE 0xa002ede0 _REC_S1VAL_20_u2 65535. _CNV_A_R_A_165_CM 0. 65535. DISPLAY_IDENTIFIER Pxx_dgdftmng_dtc_cru.Ctx_ffm_did_xxx[2] /end CHARACTERISTIC
/begin CHARACTERISTIC Ctx_ffm_did_cru[3] "" VALUE 0xa002ede2 _REC_S1VAL_20_u2 65535. _CNV_A_R_A_165_CM 0. 65535. DISPLAY_IDENTIFIER Pxx_dgdftmng_dtc_cru.Ctx_ffm_did_xxx[3] /end CHARACTERISTIC
/begin CHARACTERISTIC Ctx_ffm_did_cru[4] "" VALUE 0xa002ede4 _REC_S1VAL_20_u2 65535. _CNV_A_R_A_165_CM 0. 65535. DISPLAY_IDENTIFIER Pxx_dgdftmng_dtc_cru.Ctx_ffm_did_xxx[4] /end CHARACTERISTIC
/begin CHARACTERISTIC Cxx_dtc_hmb_cru "" VALUE 0xa002ede6 _REC_S1VAL_20_u2 65535. _CNV_A_R_A_165_CM 0. 65535. DISPLAY_IDENTIFIER Pxx_dgdftmng_dtc_cru.Cxx_dtc_hmb_xxx /end CHARACTERISTIC
/begin CHARACTERISTIC Ctx_ffm_did_cru_sl[0] "" VALUE 0xa002edf4 _REC_S1VAL_20_u2 65535. _CNV_A_R_A_165_CM 0. 65535. DISPLAY_IDENTIFIER Pxx_dgdftmng_dtc_cru_sl.Ctx_ffm_did_xxx[0] /end CHARACTERISTIC
/begin CHARACTERISTIC Ctx_ffm_did_cru_sl[1] "" VALUE 0xa002edf6 _REC_S1VAL_20_u2 65535. _CNV_A_R_A_165_CM 0. 65535. DISPLAY_IDENTIFIER Pxx_dgdftmng_dtc_cru_sl.Ctx_ffm_did_xxx[1] /end CHARACTERISTIC
/begin CHARACTERISTIC Ctx_ffm_did_cru_sl[2] "" VALUE 0xa002edf8 _REC_S1VAL_20_u2 65535. _CNV_A_R_A_165_CM 0. 65535. DISPLAY_IDENTIFIER Pxx_dgdftmng_dtc_cru_sl.Ctx_ffm_did_xxx[2] /end CHARACTERISTIC
/begin CHARACTERISTIC Ctx_ffm_did_cru_sl[3] "" VALUE 0xa002edfa _REC_S1VAL_20_u2 65535. _CNV_A_R_A_165_CM 0. 65535. DISPLAY_IDENTIFIER Pxx_dgdftmng_dtc_cru_sl.Ctx_ffm_did_xxx[3] /end CHARACTERISTIC
/begin CHARACTERISTIC Ctx_ffm_did_cru_sl[4] "" VALUE 0xa002edfc _REC_S1VAL_20_u2 65535. _CNV_A_R_A_165_CM 0. 65535. DISPLAY_IDENTIFIER Pxx_dgdftmng_dtc_cru_sl.Ctx_ffm_did_xxx[4] /end CHARACTERISTIC
/begin CHARACTERISTIC Cxx_dtc_hmb_cru_sl "" VALUE 0xa002edfe _REC_S1VAL_20_u2 65535. _CNV_A_R_A_165_CM 0. 65535. DISPLAY_IDENTIFIER Pxx_dgdftmng_dtc_cru_sl.Cxx_dtc_hmb_xxx /end CHARACTERISTIC
/begin CHARACTERISTIC Ctx_ffm_did_cru_sl_swi[0] "" VALUE 0xa002ede8 _REC_S1VAL_20_u2 65535. _CNV_A_R_A_165_CM 0. 65535. DISPLAY_IDENTIFIER Pxx_dgdftmng_dtc_cru_sl_swi.Ctx_ffm_did_xxx[0] /end CHARACTERISTIC
/begin CHARACTERISTIC Ctx_ffm_did_cru_sl_swi[1] "" VALUE 0xa002edea _REC_S1VAL_20_u2 65535. _CNV_A_R_A_165_CM 0. 65535. DISPLAY_IDENTIFIER Pxx_dgdftmng_dtc_cru_sl_swi.Ctx_ffm_did_xxx[1] /end CHARACTERISTIC
/begin CHARACTERISTIC Ctx_ffm_did_cru_sl_swi[2] "" VALUE 0xa002edec _REC_S1VAL_20_u2 65535. _CNV_A_R_A_165_CM 0. 65535. DISPLAY_IDENTIFIER Pxx_dgdftmng_dtc_cru_sl_swi.Ctx_ffm_did_xxx[2] /end CHARACTERISTIC
/begin CHARACTERISTIC Ctx_ffm_did_cru_sl_swi[3] "" VALUE 0xa002edee _REC_S1VAL_20_u2 65535. _CNV_A_R_A_165_CM 0. 65535. DISPLAY_IDENTIFIER Pxx_dgdftmng_dtc_cru_sl_swi.Ctx_ffm_did_xxx[3] /end CHARACTERISTIC
/begin CHARACTERISTIC Ctx_ffm_did_cru_sl_swi[4] "" VALUE 0xa002edf0 _REC_S1VAL_20_u2 65535. _CNV_A_R_A_165_CM 0. 65535. DISPLAY_IDENTIFIER Pxx_dgdftmng_dtc_cru_sl_swi.Ctx_ffm_did_xxx[4] /end CHARACTERISTIC
/begin CHARACTERISTIC Cxx_dtc_hmb_cru_sl_swi "" VALUE 0xa002edf2 _REC_S1VAL_20_u2 65535. _CNV_A_R_A_165_CM 0. 65535. DISPLAY_IDENTIFIER Pxx_dgdftmng_dtc_cru_sl_swi.Cxx_dtc_hmb_xxx /end CHARACTERISTIC
/begin CHARACTERISTIC Ctx_ffm_did_cru_vs[0] "" VALUE 0xa002ee00 _REC_S1VAL_20_u2 65535. _CNV_A_R_A_165_CM 0. 65535. DISPLAY_IDENTIFIER Pxx_dgdftmng_dtc_cru_vs.Ctx_ffm_did_xxx[0] /end CHARACTERISTIC
/begin CHARACTERISTIC Ctx_ffm_did_cru_vs[1] "" VALUE 0xa002ee02 _REC_S1VAL_20_u2 65535. _CNV_A_R_A_165_CM 0. 65535. DISPLAY_IDENTIFIER Pxx_dgdftmng_dtc_cru_vs.Ctx_ffm_did_xxx[1] /end CHARACTERISTIC
/begin CHARACTERISTIC Ctx_ffm_did_cru_vs[2] "" VALUE 0xa002ee04 _REC_S1VAL_20_u2 65535. _CNV_A_R_A_165_CM 0. 65535. DISPLAY_IDENTIFIER Pxx_dgdftmng_dtc_cru_vs.Ctx_ffm_did_xxx[2] /end CHARACTERISTIC
/begin CHARACTERISTIC Ctx_ffm_did_cru_vs[3] "" VALUE 0xa002ee06 _REC_S1VAL_20_u2 65535. _CNV_A_R_A_165_CM 0. 65535. DISPLAY_IDENTIFIER Pxx_dgdftmng_dtc_cru_vs.Ctx_ffm_did_xxx[3] /end CHARACTERISTIC
/begin CHARACTERISTIC Ctx_ffm_did_cru_vs[4] "" VALUE 0xa002ee08 _REC_S1VAL_20_u2 65535. _CNV_A_R_A_165_CM 0. 65535. DISPLAY_IDENTIFIER Pxx_dgdftmng_dtc_cru_vs.Ctx_ffm_did_xxx[4] /end CHARACTERISTIC
/begin CHARACTERISTIC Cxx_dtc_hmb_cru_vs "" VALUE 0xa002ee0a _REC_S1VAL_20_u2 65535. _CNV_A_R_A_165_CM 0. 65535. DISPLAY_IDENTIFIER Pxx_dgdftmng_dtc_cru_vs.Cxx_dtc_hmb_xxx /end CHARACTERISTIC
/begin CHARACTERISTIC Ctx_ffm_did_cru_whl_cmd[0] "" VALUE 0xa002ee0c _REC_S1VAL_20_u2 65535. _CNV_A_R_A_165_CM 0. 65535. DISPLAY_IDENTIFIER Pxx_dgdftmng_dtc_cru_whl_cmd.Ctx_ffm_did_xxx[0] /end CHARACTERISTIC
/begin CHARACTERISTIC Ctx_ffm_did_cru_whl_cmd[1] "" VALUE 0xa002ee0e _REC_S1VAL_20_u2 65535. _CNV_A_R_A_165_CM 0. 65535. DISPLAY_IDENTIFIER Pxx_dgdftmng_dtc_cru_whl_cmd.Ctx_ffm_did_xxx[1] /end CHARACTERISTIC
/begin CHARACTERISTIC Ctx_ffm_did_cru_whl_cmd[2] "" VALUE 0xa002ee10 _REC_S1VAL_20_u2 65535. _CNV_A_R_A_165_CM 0. 65535. DISPLAY_IDENTIFIER Pxx_dgdftmng_dtc_cru_whl_cmd.Ctx_ffm_did_xxx[2] /end CHARACTERISTIC
/begin CHARACTERISTIC Ctx_ffm_did_cru_whl_cmd[3] "" VALUE 0xa002ee12 _REC_S1VAL_20_u2 65535. _CNV_A_R_A_165_CM 0. 65535. DISPLAY_IDENTIFIER Pxx_dgdftmng_dtc_cru_whl_cmd.Ctx_ffm_did_xxx[3] /end CHARACTERISTIC
/begin CHARACTERISTIC Ctx_ffm_did_cru_whl_cmd[4] "" VALUE 0xa002ee14 _REC_S1VAL_20_u2 65535. _CNV_A_R_A_165_CM 0. 65535. DISPLAY_IDENTIFIER Pxx_dgdftmng_dtc_cru_whl_cmd.Ctx_ffm_did_xxx[4] /end CHARACTERISTIC
/begin CHARACTERISTIC Cxx_dtc_hmb_cru_whl_cmd "" VALUE 0xa002ee16 _REC_S1VAL_20_u2 65535. _CNV_A_R_A_165_CM 0. 65535. DISPLAY_IDENTIFIER Pxx_dgdftmng_dtc_cru_whl_cmd.Cxx_dtc_hmb_xxx /end CHARACTERISTIC
/begin CHARACTERISTIC Ctx_ffm_did_ecm_adc[0] "" VALUE 0xa002ef5c _REC_S1VAL_20_u2 65535. _CNV_A_R_A_165_CM 0. 65535. DISPLAY_IDENTIFIER Pxx_dgdftmng_dtc_ecm_adc.Ctx_ffm_did_xxx[0] /end CHARACTERISTIC
/begin CHARACTERISTIC Ctx_ffm_did_ecm_adc[1] "" VALUE 0xa002ef5e _REC_S1VAL_20_u2 65535. _CNV_A_R_A_165_CM 0. 65535. DISPLAY_IDENTIFIER Pxx_dgdftmng_dtc_ecm_adc.Ctx_ffm_did_xxx[1] /end CHARACTERISTIC
/begin CHARACTERISTIC Ctx_ffm_did_ecm_adc[2] "" VALUE 0xa002ef60 _REC_S1VAL_20_u2 65535. _CNV_A_R_A_165_CM 0. 65535. DISPLAY_IDENTIFIER Pxx_dgdftmng_dtc_ecm_adc.Ctx_ffm_did_xxx[2] /end CHARACTERISTIC
/begin CHARACTERISTIC Ctx_ffm_did_ecm_adc[3] "" VALUE 0xa002ef62 _REC_S1VAL_20_u2 65535. _CNV_A_R_A_165_CM 0. 65535. DISPLAY_IDENTIFIER Pxx_dgdftmng_dtc_ecm_adc.Ctx_ffm_did_xxx[3] /end CHARACTERISTIC
/begin CHARACTERISTIC Ctx_ffm_did_ecm_adc[4] "" VALUE 0xa002ef64 _REC_S1VAL_20_u2 65535. _CNV_A_R_A_165_CM 0. 65535. DISPLAY_IDENTIFIER Pxx_dgdftmng_dtc_ecm_adc.Ctx_ffm_did_xxx[4] /end CHARACTERISTIC
/begin CHARACTERISTIC Cxx_dtc_hmb_ecm_adc "" VALUE 0xa002ef66 _REC_S1VAL_20_u2 65535. _CNV_A_R_A_165_CM 0. 65535. DISPLAY_IDENTIFIER Pxx_dgdftmng_dtc_ecm_adc.Cxx_dtc_hmb_xxx /end CHARACTERISTIC
/begin CHARACTERISTIC Ctx_ffm_did_ecm_err[0] "" VALUE 0xa002ef2c _REC_S1VAL_20_u2 65535. _CNV_A_R_A_165_CM 0. 65535. DISPLAY_IDENTIFIER Pxx_dgdftmng_dtc_ecm_err.Ctx_ffm_did_xxx[0] /end CHARACTERISTIC
/begin CHARACTERISTIC Ctx_ffm_did_ecm_err[1] "" VALUE 0xa002ef2e _REC_S1VAL_20_u2 65535. _CNV_A_R_A_165_CM 0. 65535. DISPLAY_IDENTIFIER Pxx_dgdftmng_dtc_ecm_err.Ctx_ffm_did_xxx[1] /end CHARACTERISTIC
/begin CHARACTERISTIC Ctx_ffm_did_ecm_err[2] "" VALUE 0xa002ef30 _REC_S1VAL_20_u2 65535. _CNV_A_R_A_165_CM 0. 65535. DISPLAY_IDENTIFIER Pxx_dgdftmng_dtc_ecm_err.Ctx_ffm_did_xxx[2] /end CHARACTERISTIC
/begin CHARACTERISTIC Ctx_ffm_did_ecm_err[3] "" VALUE 0xa002ef32 _REC_S1VAL_20_u2 65535. _CNV_A_R_A_165_CM 0. 65535. DISPLAY_IDENTIFIER Pxx_dgdftmng_dtc_ecm_err.Ctx_ffm_did_xxx[3] /end CHARACTERISTIC
/begin CHARACTERISTIC Ctx_ffm_did_ecm_err[4] "" VALUE 0xa002ef34 _REC_S1VAL_20_u2 65535. _CNV_A_R_A_165_CM 0. 65535. DISPLAY_IDENTIFIER Pxx_dgdftmng_dtc_ecm_err.Ctx_ffm_did_xxx[4] /end CHARACTERISTIC
/begin CHARACTERISTIC Cxx_dtc_hmb_ecm_err "" VALUE 0xa002ef36 _REC_S1VAL_20_u2 65535. _CNV_A_R_A_165_CM 0. 65535. DISPLAY_IDENTIFIER Pxx_dgdftmng_dtc_ecm_err.Cxx_dtc_hmb_xxx /end CHARACTERISTIC
/begin CHARACTERISTIC Ctx_ffm_did_ecm_mon[0] "" VALUE 0xa002ef38 _REC_S1VAL_20_u2 65535. _CNV_A_R_A_165_CM 0. 65535. DISPLAY_IDENTIFIER Pxx_dgdftmng_dtc_ecm_mon.Ctx_ffm_did_xxx[0] /end CHARACTERISTIC
/begin CHARACTERISTIC Ctx_ffm_did_ecm_mon[1] "" VALUE 0xa002ef3a _REC_S1VAL_20_u2 65535. _CNV_A_R_A_165_CM 0. 65535. DISPLAY_IDENTIFIER Pxx_dgdftmng_dtc_ecm_mon.Ctx_ffm_did_xxx[1] /end CHARACTERISTIC
/begin CHARACTERISTIC Ctx_ffm_did_ecm_mon[2] "" VALUE 0xa002ef3c _REC_S1VAL_20_u2 65535. _CNV_A_R_A_165_CM 0. 65535. DISPLAY_IDENTIFIER Pxx_dgdftmng_dtc_ecm_mon.Ctx_ffm_did_xxx[2] /end CHARACTERISTIC
/begin CHARACTERISTIC Ctx_ffm_did_ecm_mon[3] "" VALUE 0xa002ef3e _REC_S1VAL_20_u2 65535. _CNV_A_R_A_165_CM 0. 65535. DISPLAY_IDENTIFIER Pxx_dgdftmng_dtc_ecm_mon.Ctx_ffm_did_xxx[3] /end CHARACTERISTIC
/begin CHARACTERISTIC Ctx_ffm_did_ecm_mon[4] "" VALUE 0xa002ef40 _REC_S1VAL_20_u2 65535. _CNV_A_R_A_165_CM 0. 65535. DISPLAY_IDENTIFIER Pxx_dgdftmng_dtc_ecm_mon.Ctx_ffm_did_xxx[4] /end CHARACTERISTIC
/begin CHARACTERISTIC Cxx_dtc_hmb_ecm_mon "" VALUE 0xa002ef42 _REC_S1VAL_20_u2 65535. _CNV_A_R_A_165_CM 0. 65535. DISPLAY_IDENTIFIER Pxx_dgdftmng_dtc_ecm_mon.Cxx_dtc_hmb_xxx /end CHARACTERISTIC
/begin CHARACTERISTIC Ctx_ffm_did_esp[0] "" VALUE 0xa002ec68 _REC_S1VAL_20_u2 65535. _CNV_A_R_A_165_CM 0. 65535. DISPLAY_IDENTIFIER Pxx_dgdftmng_dtc_esp.Ctx_ffm_did_xxx[0] /end CHARACTERISTIC
/begin CHARACTERISTIC Ctx_ffm_did_esp[1] "" VALUE 0xa002ec6a _REC_S1VAL_20_u2 65535. _CNV_A_R_A_165_CM 0. 65535. DISPLAY_IDENTIFIER Pxx_dgdftmng_dtc_esp.Ctx_ffm_did_xxx[1] /end CHARACTERISTIC
/begin CHARACTERISTIC Ctx_ffm_did_esp[2] "" VALUE 0xa002ec6c _REC_S1VAL_20_u2 65535. _CNV_A_R_A_165_CM 0. 65535. DISPLAY_IDENTIFIER Pxx_dgdftmng_dtc_esp.Ctx_ffm_did_xxx[2] /end CHARACTERISTIC
/begin CHARACTERISTIC Ctx_ffm_did_esp[3] "" VALUE 0xa002ec6e _REC_S1VAL_20_u2 65535. _CNV_A_R_A_165_CM 0. 65535. DISPLAY_IDENTIFIER Pxx_dgdftmng_dtc_esp.Ctx_ffm_did_xxx[3] /end CHARACTERISTIC
/begin CHARACTERISTIC Ctx_ffm_did_esp[4] "" VALUE 0xa002ec70 _REC_S1VAL_20_u2 65535. _CNV_A_R_A_165_CM 0. 65535. DISPLAY_IDENTIFIER Pxx_dgdftmng_dtc_esp.Ctx_ffm_did_xxx[4] /end CHARACTERISTIC
/begin CHARACTERISTIC Cxx_dtc_hmb_esp "" VALUE 0xa002ec72 _REC_S1VAL_20_u2 65535. _CNV_A_R_A_165_CM 0. 65535. DISPLAY_IDENTIFIER Pxx_dgdftmng_dtc_esp.Cxx_dtc_hmb_xxx /end CHARACTERISTIC
/begin CHARACTERISTIC Ctx_ffm_did_esp_data[0] "" VALUE 0xa002ec5c _REC_S1VAL_20_u2 65535. _CNV_A_R_A_165_CM 0. 65535. DISPLAY_IDENTIFIER Pxx_dgdftmng_dtc_esp_data.Ctx_ffm_did_xxx[0] /end CHARACTERISTIC
/begin CHARACTERISTIC Ctx_ffm_did_esp_data[1] "" VALUE 0xa002ec5e _REC_S1VAL_20_u2 65535. _CNV_A_R_A_165_CM 0. 65535. DISPLAY_IDENTIFIER Pxx_dgdftmng_dtc_esp_data.Ctx_ffm_did_xxx[1] /end CHARACTERISTIC
/begin CHARACTERISTIC Ctx_ffm_did_esp_data[2] "" VALUE 0xa002ec60 _REC_S1VAL_20_u2 65535. _CNV_A_R_A_165_CM 0. 65535. DISPLAY_IDENTIFIER Pxx_dgdftmng_dtc_esp_data.Ctx_ffm_did_xxx[2] /end CHARACTERISTIC
/begin CHARACTERISTIC Ctx_ffm_did_esp_data[3] "" VALUE 0xa002ec62 _REC_S1VAL_20_u2 65535. _CNV_A_R_A_165_CM 0. 65535. DISPLAY_IDENTIFIER Pxx_dgdftmng_dtc_esp_data.Ctx_ffm_did_xxx[3] /end CHARACTERISTIC
/begin CHARACTERISTIC Ctx_ffm_did_esp_data[4] "" VALUE 0xa002ec64 _REC_S1VAL_20_u2 65535. _CNV_A_R_A_165_CM 0. 65535. DISPLAY_IDENTIFIER Pxx_dgdftmng_dtc_esp_data.Ctx_ffm_did_xxx[4] /end CHARACTERISTIC
/begin CHARACTERISTIC Cxx_dtc_hmb_esp_data "" VALUE 0xa002ec66 _REC_S1VAL_20_u2 65535. _CNV_A_R_A_165_CM 0. 65535. DISPLAY_IDENTIFIER Pxx_dgdftmng_dtc_esp_data.Cxx_dtc_hmb_xxx /end CHARACTERISTIC
/begin CHARACTERISTIC Ctx_ffm_did_fsys[0] "" VALUE 0xa002ee18 _REC_S1VAL_20_u2 65535. _CNV_A_R_A_165_CM 0. 65535. DISPLAY_IDENTIFIER Pxx_dgdftmng_dtc_fsys.Ctx_ffm_did_xxx[0] /end CHARACTERISTIC
/begin CHARACTERISTIC Ctx_ffm_did_fsys[1] "" VALUE 0xa002ee1a _REC_S1VAL_20_u2 65535. _CNV_A_R_A_165_CM 0. 65535. DISPLAY_IDENTIFIER Pxx_dgdftmng_dtc_fsys.Ctx_ffm_did_xxx[1] /end CHARACTERISTIC
/begin CHARACTERISTIC Ctx_ffm_did_fsys[2] "" VALUE 0xa002ee1c _REC_S1VAL_20_u2 65535. _CNV_A_R_A_165_CM 0. 65535. DISPLAY_IDENTIFIER Pxx_dgdftmng_dtc_fsys.Ctx_ffm_did_xxx[2] /end CHARACTERISTIC
/begin CHARACTERISTIC Ctx_ffm_did_fsys[3] "" VALUE 0xa002ee1e _REC_S1VAL_20_u2 65535. _CNV_A_R_A_165_CM 0. 65535. DISPLAY_IDENTIFIER Pxx_dgdftmng_dtc_fsys.Ctx_ffm_did_xxx[3] /end CHARACTERISTIC
/begin CHARACTERISTIC Ctx_ffm_did_fsys[4] "" VALUE 0xa002ee20 _REC_S1VAL_20_u2 65535. _CNV_A_R_A_165_CM 0. 65535. DISPLAY_IDENTIFIER Pxx_dgdftmng_dtc_fsys.Ctx_ffm_did_xxx[4] /end CHARACTERISTIC
/begin CHARACTERISTIC Cxx_dtc_hmb_fsys "" VALUE 0xa002ee22 _REC_S1VAL_20_u2 65535. _CNV_A_R_A_165_CM 0. 65535. DISPLAY_IDENTIFIER Pxx_dgdftmng_dtc_fsys.Cxx_dtc_hmb_xxx /end CHARACTERISTIC
/begin CHARACTERISTIC Ctx_ffm_did_gas_pump[0] "" VALUE 0xa002ec74 _REC_S1VAL_20_u2 65535. _CNV_A_R_A_165_CM 0. 65535. DISPLAY_IDENTIFIER Pxx_dgdftmng_dtc_gas_pump.Ctx_ffm_did_xxx[0] /end CHARACTERISTIC
/begin CHARACTERISTIC Ctx_ffm_did_gas_pump[1] "" VALUE 0xa002ec76 _REC_S1VAL_20_u2 65535. _CNV_A_R_A_165_CM 0. 65535. DISPLAY_IDENTIFIER Pxx_dgdftmng_dtc_gas_pump.Ctx_ffm_did_xxx[1] /end CHARACTERISTIC
/begin CHARACTERISTIC Ctx_ffm_did_gas_pump[2] "" VALUE 0xa002ec78 _REC_S1VAL_20_u2 65535. _CNV_A_R_A_165_CM 0. 65535. DISPLAY_IDENTIFIER Pxx_dgdftmng_dtc_gas_pump.Ctx_ffm_did_xxx[2] /end CHARACTERISTIC
/begin CHARACTERISTIC Ctx_ffm_did_gas_pump[3] "" VALUE 0xa002ec7a _REC_S1VAL_20_u2 65535. _CNV_A_R_A_165_CM 0. 65535. DISPLAY_IDENTIFIER Pxx_dgdftmng_dtc_gas_pump.Ctx_ffm_did_xxx[3] /end CHARACTERISTIC
/begin CHARACTERISTIC Ctx_ffm_did_gas_pump[4] "" VALUE 0xa002ec7c _REC_S1VAL_20_u2 65535. _CNV_A_R_A_165_CM 0. 65535. DISPLAY_IDENTIFIER Pxx_dgdftmng_dtc_gas_pump.Ctx_ffm_did_xxx[4] /end CHARACTERISTIC
/begin CHARACTERISTIC Cxx_dtc_hmb_gas_pump "" VALUE 0xa002ec7e _REC_S1VAL_20_u2 65535. _CNV_A_R_A_165_CM 0. 65535. DISPLAY_IDENTIFIER Pxx_dgdftmng_dtc_gas_pump.Cxx_dtc_hmb_xxx /end CHARACTERISTIC
/begin CHARACTERISTIC Ctx_ffm_did_igc_1[0] "" VALUE 0xa002ef68 _REC_S1VAL_20_u2 65535. _CNV_A_R_A_165_CM 0. 65535. DISPLAY_IDENTIFIER Pxx_dgdftmng_dtc_igc_1.Ctx_ffm_did_xxx[0] /end CHARACTERISTIC
/begin CHARACTERISTIC Ctx_ffm_did_igc_1[1] "" VALUE 0xa002ef6a _REC_S1VAL_20_u2 65535. _CNV_A_R_A_165_CM 0. 65535. DISPLAY_IDENTIFIER Pxx_dgdftmng_dtc_igc_1.Ctx_ffm_did_xxx[1] /end CHARACTERISTIC
/begin CHARACTERISTIC Ctx_ffm_did_igc_1[2] "" VALUE 0xa002ef6c _REC_S1VAL_20_u2 65535. _CNV_A_R_A_165_CM 0. 65535. DISPLAY_IDENTIFIER Pxx_dgdftmng_dtc_igc_1.Ctx_ffm_did_xxx[2] /end CHARACTERISTIC
/begin CHARACTERISTIC Ctx_ffm_did_igc_1[3] "" VALUE 0xa002ef6e _REC_S1VAL_20_u2 65535. _CNV_A_R_A_165_CM 0. 65535. DISPLAY_IDENTIFIER Pxx_dgdftmng_dtc_igc_1.Ctx_ffm_did_xxx[3] /end CHARACTERISTIC
/begin CHARACTERISTIC Ctx_ffm_did_igc_1[4] "" VALUE 0xa002ef70 _REC_S1VAL_20_u2 65535. _CNV_A_R_A_165_CM 0. 65535. DISPLAY_IDENTIFIER Pxx_dgdftmng_dtc_igc_1.Ctx_ffm_did_xxx[4] /end CHARACTERISTIC
/begin CHARACTERISTIC Cxx_dtc_hmb_igc_1 "" VALUE 0xa002ef72 _REC_S1VAL_20_u2 65535. _CNV_A_R_A_165_CM 0. 65535. DISPLAY_IDENTIFIER Pxx_dgdftmng_dtc_igc_1.Cxx_dtc_hmb_xxx /end CHARACTERISTIC
/begin CHARACTERISTIC Ctx_ffm_did_igc_2[0] "" VALUE 0xa002ef74 _REC_S1VAL_20_u2 65535. _CNV_A_R_A_165_CM 0. 65535. DISPLAY_IDENTIFIER Pxx_dgdftmng_dtc_igc_2.Ctx_ffm_did_xxx[0] /end CHARACTERISTIC
/begin CHARACTERISTIC Ctx_ffm_did_igc_2[1] "" VALUE 0xa002ef76 _REC_S1VAL_20_u2 65535. _CNV_A_R_A_165_CM 0. 65535. DISPLAY_IDENTIFIER Pxx_dgdftmng_dtc_igc_2.Ctx_ffm_did_xxx[1] /end CHARACTERISTIC
/begin CHARACTERISTIC Ctx_ffm_did_igc_2[2] "" VALUE 0xa002ef78 _REC_S1VAL_20_u2 65535. _CNV_A_R_A_165_CM 0. 65535. DISPLAY_IDENTIFIER Pxx_dgdftmng_dtc_igc_2.Ctx_ffm_did_xxx[2] /end CHARACTERISTIC
/begin CHARACTERISTIC Ctx_ffm_did_igc_2[3] "" VALUE 0xa002ef7a _REC_S1VAL_20_u2 65535. _CNV_A_R_A_165_CM 0. 65535. DISPLAY_IDENTIFIER Pxx_dgdftmng_dtc_igc_2.Ctx_ffm_did_xxx[3] /end CHARACTERISTIC
/begin CHARACTERISTIC Ctx_ffm_did_igc_2[4] "" VALUE 0xa002ef7c _REC_S1VAL_20_u2 65535. _CNV_A_R_A_165_CM 0. 65535. DISPLAY_IDENTIFIER Pxx_dgdftmng_dtc_igc_2.Ctx_ffm_did_xxx[4] /end CHARACTERISTIC
/begin CHARACTERISTIC Cxx_dtc_hmb_igc_2 "" VALUE 0xa002ef7e _REC_S1VAL_20_u2 65535. _CNV_A_R_A_165_CM 0. 65535. DISPLAY_IDENTIFIER Pxx_dgdftmng_dtc_igc_2.Cxx_dtc_hmb_xxx /end CHARACTERISTIC
/begin CHARACTERISTIC Ctx_ffm_did_igc_3[0] "" VALUE 0xa002ef80 _REC_S1VAL_20_u2 65535. _CNV_A_R_A_165_CM 0. 65535. DISPLAY_IDENTIFIER Pxx_dgdftmng_dtc_igc_3.Ctx_ffm_did_xxx[0] /end CHARACTERISTIC
/begin CHARACTERISTIC Ctx_ffm_did_igc_3[1] "" VALUE 0xa002ef82 _REC_S1VAL_20_u2 65535. _CNV_A_R_A_165_CM 0. 65535. DISPLAY_IDENTIFIER Pxx_dgdftmng_dtc_igc_3.Ctx_ffm_did_xxx[1] /end CHARACTERISTIC
/begin CHARACTERISTIC Ctx_ffm_did_igc_3[2] "" VALUE 0xa002ef84 _REC_S1VAL_20_u2 65535. _CNV_A_R_A_165_CM 0. 65535. DISPLAY_IDENTIFIER Pxx_dgdftmng_dtc_igc_3.Ctx_ffm_did_xxx[2] /end CHARACTERISTIC
/begin CHARACTERISTIC Ctx_ffm_did_igc_3[3] "" VALUE 0xa002ef86 _REC_S1VAL_20_u2 65535. _CNV_A_R_A_165_CM 0. 65535. DISPLAY_IDENTIFIER Pxx_dgdftmng_dtc_igc_3.Ctx_ffm_did_xxx[3] /end CHARACTERISTIC
/begin CHARACTERISTIC Ctx_ffm_did_igc_3[4] "" VALUE 0xa002ef88 _REC_S1VAL_20_u2 65535. _CNV_A_R_A_165_CM 0. 65535. DISPLAY_IDENTIFIER Pxx_dgdftmng_dtc_igc_3.Ctx_ffm_did_xxx[4] /end CHARACTERISTIC
/begin CHARACTERISTIC Cxx_dtc_hmb_igc_3 "" VALUE 0xa002ef8a _REC_S1VAL_20_u2 65535. _CNV_A_R_A_165_CM 0. 65535. DISPLAY_IDENTIFIER Pxx_dgdftmng_dtc_igc_3.Cxx_dtc_hmb_xxx /end CHARACTERISTIC
/begin CHARACTERISTIC Ctx_ffm_did_igc_4[0] "" VALUE 0xa002ef8c _REC_S1VAL_20_u2 65535. _CNV_A_R_A_165_CM 0. 65535. DISPLAY_IDENTIFIER Pxx_dgdftmng_dtc_igc_4.Ctx_ffm_did_xxx[0] /end CHARACTERISTIC
/begin CHARACTERISTIC Ctx_ffm_did_igc_4[1] "" VALUE 0xa002ef8e _REC_S1VAL_20_u2 65535. _CNV_A_R_A_165_CM 0. 65535. DISPLAY_IDENTIFIER Pxx_dgdftmng_dtc_igc_4.Ctx_ffm_did_xxx[1] /end CHARACTERISTIC
/begin CHARACTERISTIC Ctx_ffm_did_igc_4[2] "" VALUE 0xa002ef90 _REC_S1VAL_20_u2 65535. _CNV_A_R_A_165_CM 0. 65535. DISPLAY_IDENTIFIER Pxx_dgdftmng_dtc_igc_4.Ctx_ffm_did_xxx[2] /end CHARACTERISTIC
/begin CHARACTERISTIC Ctx_ffm_did_igc_4[3] "" VALUE 0xa002ef92 _REC_S1VAL_20_u2 65535. _CNV_A_R_A_165_CM 0. 65535. DISPLAY_IDENTIFIER Pxx_dgdftmng_dtc_igc_4.Ctx_ffm_did_xxx[3] /end CHARACTERISTIC
/begin CHARACTERISTIC Ctx_ffm_did_igc_4[4] "" VALUE 0xa002ef94 _REC_S1VAL_20_u2 65535. _CNV_A_R_A_165_CM 0. 65535. DISPLAY_IDENTIFIER Pxx_dgdftmng_dtc_igc_4.Ctx_ffm_did_xxx[4] /end CHARACTERISTIC
/begin CHARACTERISTIC Cxx_dtc_hmb_igc_4 "" VALUE 0xa002ef96 _REC_S1VAL_20_u2 65535. _CNV_A_R_A_165_CM 0. 65535. DISPLAY_IDENTIFIER Pxx_dgdftmng_dtc_igc_4.Cxx_dtc_hmb_xxx /end CHARACTERISTIC
/begin CHARACTERISTIC Ctx_ffm_did_in_cam[0] "" VALUE 0xa002ef14 _REC_S1VAL_20_u2 65535. _CNV_A_R_A_165_CM 0. 65535. DISPLAY_IDENTIFIER Pxx_dgdftmng_dtc_in_cam.Ctx_ffm_did_xxx[0] /end CHARACTERISTIC
/begin CHARACTERISTIC Ctx_ffm_did_in_cam[1] "" VALUE 0xa002ef16 _REC_S1VAL_20_u2 65535. _CNV_A_R_A_165_CM 0. 65535. DISPLAY_IDENTIFIER Pxx_dgdftmng_dtc_in_cam.Ctx_ffm_did_xxx[1] /end CHARACTERISTIC
/begin CHARACTERISTIC Ctx_ffm_did_in_cam[2] "" VALUE 0xa002ef18 _REC_S1VAL_20_u2 65535. _CNV_A_R_A_165_CM 0. 65535. DISPLAY_IDENTIFIER Pxx_dgdftmng_dtc_in_cam.Ctx_ffm_did_xxx[2] /end CHARACTERISTIC
/begin CHARACTERISTIC Ctx_ffm_did_in_cam[3] "" VALUE 0xa002ef1a _REC_S1VAL_20_u2 65535. _CNV_A_R_A_165_CM 0. 65535. DISPLAY_IDENTIFIER Pxx_dgdftmng_dtc_in_cam.Ctx_ffm_did_xxx[3] /end CHARACTERISTIC
/begin CHARACTERISTIC Ctx_ffm_did_in_cam[4] "" VALUE 0xa002ef1c _REC_S1VAL_20_u2 65535. _CNV_A_R_A_165_CM 0. 65535. DISPLAY_IDENTIFIER Pxx_dgdftmng_dtc_in_cam.Ctx_ffm_did_xxx[4] /end CHARACTERISTIC
/begin CHARACTERISTIC Cxx_dtc_hmb_in_cam "" VALUE 0xa002ef1e _REC_S1VAL_20_u2 65535. _CNV_A_R_A_165_CM 0. 65535. DISPLAY_IDENTIFIER Pxx_dgdftmng_dtc_in_cam.Cxx_dtc_hmb_xxx /end CHARACTERISTIC
/begin CHARACTERISTIC Ctx_ffm_did_in_cam_crk[0] "" VALUE 0xa002efa4 _REC_S1VAL_20_u2 65535. _CNV_A_R_A_165_CM 0. 65535. DISPLAY_IDENTIFIER Pxx_dgdftmng_dtc_in_cam_crk.Ctx_ffm_did_xxx[0] /end CHARACTERISTIC
/begin CHARACTERISTIC Ctx_ffm_did_in_cam_crk[1] "" VALUE 0xa002efa6 _REC_S1VAL_20_u2 65535. _CNV_A_R_A_165_CM 0. 65535. DISPLAY_IDENTIFIER Pxx_dgdftmng_dtc_in_cam_crk.Ctx_ffm_did_xxx[1] /end CHARACTERISTIC
/begin CHARACTERISTIC Ctx_ffm_did_in_cam_crk[2] "" VALUE 0xa002efa8 _REC_S1VAL_20_u2 65535. _CNV_A_R_A_165_CM 0. 65535. DISPLAY_IDENTIFIER Pxx_dgdftmng_dtc_in_cam_crk.Ctx_ffm_did_xxx[2] /end CHARACTERISTIC
/begin CHARACTERISTIC Ctx_ffm_did_in_cam_crk[3] "" VALUE 0xa002efaa _REC_S1VAL_20_u2 65535. _CNV_A_R_A_165_CM 0. 65535. DISPLAY_IDENTIFIER Pxx_dgdftmng_dtc_in_cam_crk.Ctx_ffm_did_xxx[3] /end CHARACTERISTIC
/begin CHARACTERISTIC Ctx_ffm_did_in_cam_crk[4] "" VALUE 0xa002efac _REC_S1VAL_20_u2 65535. _CNV_A_R_A_165_CM 0. 65535. DISPLAY_IDENTIFIER Pxx_dgdftmng_dtc_in_cam_crk.Ctx_ffm_did_xxx[4] /end CHARACTERISTIC
/begin CHARACTERISTIC Cxx_dtc_hmb_in_cam_crk "" VALUE 0xa002efae _REC_S1VAL_20_u2 65535. _CNV_A_R_A_165_CM 0. 65535. DISPLAY_IDENTIFIER Pxx_dgdftmng_dtc_in_cam_crk.Cxx_dtc_hmb_xxx /end CHARACTERISTIC
/begin CHARACTERISTIC Ctx_ffm_did_in_vvtc[0] "" VALUE 0xa002ec80 _REC_S1VAL_20_u2 65535. _CNV_A_R_A_165_CM 0. 65535. DISPLAY_IDENTIFIER Pxx_dgdftmng_dtc_in_vvtc.Ctx_ffm_did_xxx[0] /end CHARACTERISTIC
/begin CHARACTERISTIC Ctx_ffm_did_in_vvtc[1] "" VALUE 0xa002ec82 _REC_S1VAL_20_u2 65535. _CNV_A_R_A_165_CM 0. 65535. DISPLAY_IDENTIFIER Pxx_dgdftmng_dtc_in_vvtc.Ctx_ffm_did_xxx[1] /end CHARACTERISTIC
/begin CHARACTERISTIC Ctx_ffm_did_in_vvtc[2] "" VALUE 0xa002ec84 _REC_S1VAL_20_u2 65535. _CNV_A_R_A_165_CM 0. 65535. DISPLAY_IDENTIFIER Pxx_dgdftmng_dtc_in_vvtc.Ctx_ffm_did_xxx[2] /end CHARACTERISTIC
/begin CHARACTERISTIC Ctx_ffm_did_in_vvtc[3] "" VALUE 0xa002ec86 _REC_S1VAL_20_u2 65535. _CNV_A_R_A_165_CM 0. 65535. DISPLAY_IDENTIFIER Pxx_dgdftmng_dtc_in_vvtc.Ctx_ffm_did_xxx[3] /end CHARACTERISTIC
/begin CHARACTERISTIC Ctx_ffm_did_in_vvtc[4] "" VALUE 0xa002ec88 _REC_S1VAL_20_u2 65535. _CNV_A_R_A_165_CM 0. 65535. DISPLAY_IDENTIFIER Pxx_dgdftmng_dtc_in_vvtc.Ctx_ffm_did_xxx[4] /end CHARACTERISTIC
/begin CHARACTERISTIC Cxx_dtc_hmb_in_vvtc "" VALUE 0xa002ec8a _REC_S1VAL_20_u2 65535. _CNV_A_R_A_165_CM 0. 65535. DISPLAY_IDENTIFIER Pxx_dgdftmng_dtc_in_vvtc.Cxx_dtc_hmb_xxx /end CHARACTERISTIC
/begin CHARACTERISTIC Ctx_ffm_did_in_vvtc_sldv[0] "" VALUE 0xa002ec8c _REC_S1VAL_20_u2 65535. _CNV_A_R_A_165_CM 0. 65535. DISPLAY_IDENTIFIER Pxx_dgdftmng_dtc_in_vvtc_sldv.Ctx_ffm_did_xxx[0] /end CHARACTERISTIC
/begin CHARACTERISTIC Ctx_ffm_did_in_vvtc_sldv[1] "" VALUE 0xa002ec8e _REC_S1VAL_20_u2 65535. _CNV_A_R_A_165_CM 0. 65535. DISPLAY_IDENTIFIER Pxx_dgdftmng_dtc_in_vvtc_sldv.Ctx_ffm_did_xxx[1] /end CHARACTERISTIC
/begin CHARACTERISTIC Ctx_ffm_did_in_vvtc_sldv[2] "" VALUE 0xa002ec90 _REC_S1VAL_20_u2 65535. _CNV_A_R_A_165_CM 0. 65535. DISPLAY_IDENTIFIER Pxx_dgdftmng_dtc_in_vvtc_sldv.Ctx_ffm_did_xxx[2] /end CHARACTERISTIC
/begin CHARACTERISTIC Ctx_ffm_did_in_vvtc_sldv[3] "" VALUE 0xa002ec92 _REC_S1VAL_20_u2 65535. _CNV_A_R_A_165_CM 0. 65535. DISPLAY_IDENTIFIER Pxx_dgdftmng_dtc_in_vvtc_sldv.Ctx_ffm_did_xxx[3] /end CHARACTERISTIC
/begin CHARACTERISTIC Ctx_ffm_did_in_vvtc_sldv[4] "" VALUE 0xa002ec94 _REC_S1VAL_20_u2 65535. _CNV_A_R_A_165_CM 0. 65535. DISPLAY_IDENTIFIER Pxx_dgdftmng_dtc_in_vvtc_sldv.Ctx_ffm_did_xxx[4] /end CHARACTERISTIC
/begin CHARACTERISTIC Cxx_dtc_hmb_in_vvtc_sldv "" VALUE 0xa002ec96 _REC_S1VAL_20_u2 65535. _CNV_A_R_A_165_CM 0. 65535. DISPLAY_IDENTIFIER Pxx_dgdftmng_dtc_in_vvtc_sldv.Cxx_dtc_hmb_xxx /end CHARACTERISTIC
/begin CHARACTERISTIC Ctx_ffm_did_inj1[0] "" VALUE 0xa002eca4 _REC_S1VAL_20_u2 65535. _CNV_A_R_A_165_CM 0. 65535. DISPLAY_IDENTIFIER Pxx_dgdftmng_dtc_inj1.Ctx_ffm_did_xxx[0] /end CHARACTERISTIC
/begin CHARACTERISTIC Ctx_ffm_did_inj1[1] "" VALUE 0xa002eca6 _REC_S1VAL_20_u2 65535. _CNV_A_R_A_165_CM 0. 65535. DISPLAY_IDENTIFIER Pxx_dgdftmng_dtc_inj1.Ctx_ffm_did_xxx[1] /end CHARACTERISTIC
/begin CHARACTERISTIC Ctx_ffm_did_inj1[2] "" VALUE 0xa002eca8 _REC_S1VAL_20_u2 65535. _CNV_A_R_A_165_CM 0. 65535. DISPLAY_IDENTIFIER Pxx_dgdftmng_dtc_inj1.Ctx_ffm_did_xxx[2] /end CHARACTERISTIC
/begin CHARACTERISTIC Ctx_ffm_did_inj1[3] "" VALUE 0xa002ecaa _REC_S1VAL_20_u2 65535. _CNV_A_R_A_165_CM 0. 65535. DISPLAY_IDENTIFIER Pxx_dgdftmng_dtc_inj1.Ctx_ffm_did_xxx[3] /end CHARACTERISTIC
/begin CHARACTERISTIC Ctx_ffm_did_inj1[4] "" VALUE 0xa002ecac _REC_S1VAL_20_u2 65535. _CNV_A_R_A_165_CM 0. 65535. DISPLAY_IDENTIFIER Pxx_dgdftmng_dtc_inj1.Ctx_ffm_did_xxx[4] /end CHARACTERISTIC
/begin CHARACTERISTIC Cxx_dtc_hmb_inj1 "" VALUE 0xa002ecae _REC_S1VAL_20_u2 65535. _CNV_A_R_A_165_CM 0. 65535. DISPLAY_IDENTIFIER Pxx_dgdftmng_dtc_inj1.Cxx_dtc_hmb_xxx /end CHARACTERISTIC
/begin CHARACTERISTIC Ctx_ffm_did_inj2[0] "" VALUE 0xa002ecb0 _REC_S1VAL_20_u2 65535. _CNV_A_R_A_165_CM 0. 65535. DISPLAY_IDENTIFIER Pxx_dgdftmng_dtc_inj2.Ctx_ffm_did_xxx[0] /end CHARACTERISTIC
/begin CHARACTERISTIC Ctx_ffm_did_inj2[1] "" VALUE 0xa002ecb2 _REC_S1VAL_20_u2 65535. _CNV_A_R_A_165_CM 0. 65535. DISPLAY_IDENTIFIER Pxx_dgdftmng_dtc_inj2.Ctx_ffm_did_xxx[1] /end CHARACTERISTIC
/begin CHARACTERISTIC Ctx_ffm_did_inj2[2] "" VALUE 0xa002ecb4 _REC_S1VAL_20_u2 65535. _CNV_A_R_A_165_CM 0. 65535. DISPLAY_IDENTIFIER Pxx_dgdftmng_dtc_inj2.Ctx_ffm_did_xxx[2] /end CHARACTERISTIC
/begin CHARACTERISTIC Ctx_ffm_did_inj2[3] "" VALUE 0xa002ecb6 _REC_S1VAL_20_u2 65535. _CNV_A_R_A_165_CM 0. 65535. DISPLAY_IDENTIFIER Pxx_dgdftmng_dtc_inj2.Ctx_ffm_did_xxx[3] /end CHARACTERISTIC
/begin CHARACTERISTIC Ctx_ffm_did_inj2[4] "" VALUE 0xa002ecb8 _REC_S1VAL_20_u2 65535. _CNV_A_R_A_165_CM 0. 65535. DISPLAY_IDENTIFIER Pxx_dgdftmng_dtc_inj2.Ctx_ffm_did_xxx[4] /end CHARACTERISTIC
/begin CHARACTERISTIC Cxx_dtc_hmb_inj2 "" VALUE 0xa002ecba _REC_S1VAL_20_u2 65535. _CNV_A_R_A_165_CM 0. 65535. DISPLAY_IDENTIFIER Pxx_dgdftmng_dtc_inj2.Cxx_dtc_hmb_xxx /end CHARACTERISTIC
/begin CHARACTERISTIC Ctx_ffm_did_inj3[0] "" VALUE 0xa002ecbc _REC_S1VAL_20_u2 65535. _CNV_A_R_A_165_CM 0. 65535. DISPLAY_IDENTIFIER Pxx_dgdftmng_dtc_inj3.Ctx_ffm_did_xxx[0] /end CHARACTERISTIC
/begin CHARACTERISTIC Ctx_ffm_did_inj3[1] "" VALUE 0xa002ecbe _REC_S1VAL_20_u2 65535. _CNV_A_R_A_165_CM 0. 65535. DISPLAY_IDENTIFIER Pxx_dgdftmng_dtc_inj3.Ctx_ffm_did_xxx[1] /end CHARACTERISTIC
/begin CHARACTERISTIC Ctx_ffm_did_inj3[2] "" VALUE 0xa002ecc0 _REC_S1VAL_20_u2 65535. _CNV_A_R_A_165_CM 0. 65535. DISPLAY_IDENTIFIER Pxx_dgdftmng_dtc_inj3.Ctx_ffm_did_xxx[2] /end CHARACTERISTIC
/begin CHARACTERISTIC Ctx_ffm_did_inj3[3] "" VALUE 0xa002ecc2 _REC_S1VAL_20_u2 65535. _CNV_A_R_A_165_CM 0. 65535. DISPLAY_IDENTIFIER Pxx_dgdftmng_dtc_inj3.Ctx_ffm_did_xxx[3] /end CHARACTERISTIC
/begin CHARACTERISTIC Ctx_ffm_did_inj3[4] "" VALUE 0xa002ecc4 _REC_S1VAL_20_u2 65535. _CNV_A_R_A_165_CM 0. 65535. DISPLAY_IDENTIFIER Pxx_dgdftmng_dtc_inj3.Ctx_ffm_did_xxx[4] /end CHARACTERISTIC
/begin CHARACTERISTIC Cxx_dtc_hmb_inj3 "" VALUE 0xa002ecc6 _REC_S1VAL_20_u2 65535. _CNV_A_R_A_165_CM 0. 65535. DISPLAY_IDENTIFIER Pxx_dgdftmng_dtc_inj3.Cxx_dtc_hmb_xxx /end CHARACTERISTIC
/begin CHARACTERISTIC Ctx_ffm_did_inj4[0] "" VALUE 0xa002ecc8 _REC_S1VAL_20_u2 65535. _CNV_A_R_A_165_CM 0. 65535. DISPLAY_IDENTIFIER Pxx_dgdftmng_dtc_inj4.Ctx_ffm_did_xxx[0] /end CHARACTERISTIC
/begin CHARACTERISTIC Ctx_ffm_did_inj4[1] "" VALUE 0xa002ecca _REC_S1VAL_20_u2 65535. _CNV_A_R_A_165_CM 0. 65535. DISPLAY_IDENTIFIER Pxx_dgdftmng_dtc_inj4.Ctx_ffm_did_xxx[1] /end CHARACTERISTIC
/begin CHARACTERISTIC Ctx_ffm_did_inj4[2] "" VALUE 0xa002eccc _REC_S1VAL_20_u2 65535. _CNV_A_R_A_165_CM 0. 65535. DISPLAY_IDENTIFIER Pxx_dgdftmng_dtc_inj4.Ctx_ffm_did_xxx[2] /end CHARACTERISTIC
/begin CHARACTERISTIC Ctx_ffm_did_inj4[3] "" VALUE 0xa002ecce _REC_S1VAL_20_u2 65535. _CNV_A_R_A_165_CM 0. 65535. DISPLAY_IDENTIFIER Pxx_dgdftmng_dtc_inj4.Ctx_ffm_did_xxx[3] /end CHARACTERISTIC
/begin CHARACTERISTIC Ctx_ffm_did_inj4[4] "" VALUE 0xa002ecd0 _REC_S1VAL_20_u2 65535. _CNV_A_R_A_165_CM 0. 65535. DISPLAY_IDENTIFIER Pxx_dgdftmng_dtc_inj4.Ctx_ffm_did_xxx[4] /end CHARACTERISTIC
/begin CHARACTERISTIC Cxx_dtc_hmb_inj4 "" VALUE 0xa002ecd2 _REC_S1VAL_20_u2 65535. _CNV_A_R_A_165_CM 0. 65535. DISPLAY_IDENTIFIER Pxx_dgdftmng_dtc_inj4.Cxx_dtc_hmb_xxx /end CHARACTERISTIC
/begin CHARACTERISTIC Ctx_ffm_did_inj_ecu[0] "" VALUE 0xa002ec98 _REC_S1VAL_20_u2 65535. _CNV_A_R_A_165_CM 0. 65535. DISPLAY_IDENTIFIER Pxx_dgdftmng_dtc_inj_ecu.Ctx_ffm_did_xxx[0] /end CHARACTERISTIC
/begin CHARACTERISTIC Ctx_ffm_did_inj_ecu[1] "" VALUE 0xa002ec9a _REC_S1VAL_20_u2 65535. _CNV_A_R_A_165_CM 0. 65535. DISPLAY_IDENTIFIER Pxx_dgdftmng_dtc_inj_ecu.Ctx_ffm_did_xxx[1] /end CHARACTERISTIC
/begin CHARACTERISTIC Ctx_ffm_did_inj_ecu[2] "" VALUE 0xa002ec9c _REC_S1VAL_20_u2 65535. _CNV_A_R_A_165_CM 0. 65535. DISPLAY_IDENTIFIER Pxx_dgdftmng_dtc_inj_ecu.Ctx_ffm_did_xxx[2] /end CHARACTERISTIC
/begin CHARACTERISTIC Ctx_ffm_did_inj_ecu[3] "" VALUE 0xa002ec9e _REC_S1VAL_20_u2 65535. _CNV_A_R_A_165_CM 0. 65535. DISPLAY_IDENTIFIER Pxx_dgdftmng_dtc_inj_ecu.Ctx_ffm_did_xxx[3] /end CHARACTERISTIC
/begin CHARACTERISTIC Ctx_ffm_did_inj_ecu[4] "" VALUE 0xa002eca0 _REC_S1VAL_20_u2 65535. _CNV_A_R_A_165_CM 0. 65535. DISPLAY_IDENTIFIER Pxx_dgdftmng_dtc_inj_ecu.Ctx_ffm_did_xxx[4] /end CHARACTERISTIC
/begin CHARACTERISTIC Cxx_dtc_hmb_inj_ecu "" VALUE 0xa002eca2 _REC_S1VAL_20_u2 65535. _CNV_A_R_A_165_CM 0. 65535. DISPLAY_IDENTIFIER Pxx_dgdftmng_dtc_inj_ecu.Cxx_dtc_hmb_xxx /end CHARACTERISTIC
/begin CHARACTERISTIC Ctx_ffm_did_ip_lght_tco[0] "" VALUE 0xa002ef44 _REC_S1VAL_20_u2 65535. _CNV_A_R_A_165_CM 0. 65535. DISPLAY_IDENTIFIER Pxx_dgdftmng_dtc_ip_lght_tco.Ctx_ffm_did_xxx[0] /end CHARACTERISTIC
/begin CHARACTERISTIC Ctx_ffm_did_ip_lght_tco[1] "" VALUE 0xa002ef46 _REC_S1VAL_20_u2 65535. _CNV_A_R_A_165_CM 0. 65535. DISPLAY_IDENTIFIER Pxx_dgdftmng_dtc_ip_lght_tco.Ctx_ffm_did_xxx[1] /end CHARACTERISTIC
/begin CHARACTERISTIC Ctx_ffm_did_ip_lght_tco[2] "" VALUE 0xa002ef48 _REC_S1VAL_20_u2 65535. _CNV_A_R_A_165_CM 0. 65535. DISPLAY_IDENTIFIER Pxx_dgdftmng_dtc_ip_lght_tco.Ctx_ffm_did_xxx[2] /end CHARACTERISTIC
/begin CHARACTERISTIC Ctx_ffm_did_ip_lght_tco[3] "" VALUE 0xa002ef4a _REC_S1VAL_20_u2 65535. _CNV_A_R_A_165_CM 0. 65535. DISPLAY_IDENTIFIER Pxx_dgdftmng_dtc_ip_lght_tco.Ctx_ffm_did_xxx[3] /end CHARACTERISTIC
/begin CHARACTERISTIC Ctx_ffm_did_ip_lght_tco[4] "" VALUE 0xa002ef4c _REC_S1VAL_20_u2 65535. _CNV_A_R_A_165_CM 0. 65535. DISPLAY_IDENTIFIER Pxx_dgdftmng_dtc_ip_lght_tco.Ctx_ffm_did_xxx[4] /end CHARACTERISTIC
/begin CHARACTERISTIC Cxx_dtc_hmb_ip_lght_tco "" VALUE 0xa002ef4e _REC_S1VAL_20_u2 65535. _CNV_A_R_A_165_CM 0. 65535. DISPLAY_IDENTIFIER Pxx_dgdftmng_dtc_ip_lght_tco.Cxx_dtc_hmb_xxx /end CHARACTERISTIC
/begin CHARACTERISTIC Ctx_ffm_did_it_cmd[0] "" VALUE 0xa002ecd4 _REC_S1VAL_20_u2 65535. _CNV_A_R_A_165_CM 0. 65535. DISPLAY_IDENTIFIER Pxx_dgdftmng_dtc_it_cmd.Ctx_ffm_did_xxx[0] /end CHARACTERISTIC
/begin CHARACTERISTIC Ctx_ffm_did_it_cmd[1] "" VALUE 0xa002ecd6 _REC_S1VAL_20_u2 65535. _CNV_A_R_A_165_CM 0. 65535. DISPLAY_IDENTIFIER Pxx_dgdftmng_dtc_it_cmd.Ctx_ffm_did_xxx[1] /end CHARACTERISTIC
/begin CHARACTERISTIC Ctx_ffm_did_it_cmd[2] "" VALUE 0xa002ecd8 _REC_S1VAL_20_u2 65535. _CNV_A_R_A_165_CM 0. 65535. DISPLAY_IDENTIFIER Pxx_dgdftmng_dtc_it_cmd.Ctx_ffm_did_xxx[2] /end CHARACTERISTIC
/begin CHARACTERISTIC Ctx_ffm_did_it_cmd[3] "" VALUE 0xa002ecda _REC_S1VAL_20_u2 65535. _CNV_A_R_A_165_CM 0. 65535. DISPLAY_IDENTIFIER Pxx_dgdftmng_dtc_it_cmd.Ctx_ffm_did_xxx[3] /end CHARACTERISTIC
/begin CHARACTERISTIC Ctx_ffm_did_it_cmd[4] "" VALUE 0xa002ecdc _REC_S1VAL_20_u2 65535. _CNV_A_R_A_165_CM 0. 65535. DISPLAY_IDENTIFIER Pxx_dgdftmng_dtc_it_cmd.Ctx_ffm_did_xxx[4] /end CHARACTERISTIC
/begin CHARACTERISTIC Cxx_dtc_hmb_it_cmd "" VALUE 0xa002ecde _REC_S1VAL_20_u2 65535. _CNV_A_R_A_165_CM 0. 65535. DISPLAY_IDENTIFIER Pxx_dgdftmng_dtc_it_cmd.Cxx_dtc_hmb_xxx /end CHARACTERISTIC
/begin CHARACTERISTIC Ctx_ffm_did_it_ofs[0] "" VALUE 0xa002ece0 _REC_S1VAL_20_u2 65535. _CNV_A_R_A_165_CM 0. 65535. DISPLAY_IDENTIFIER Pxx_dgdftmng_dtc_it_ofs.Ctx_ffm_did_xxx[0] /end CHARACTERISTIC
/begin CHARACTERISTIC Ctx_ffm_did_it_ofs[1] "" VALUE 0xa002ece2 _REC_S1VAL_20_u2 65535. _CNV_A_R_A_165_CM 0. 65535. DISPLAY_IDENTIFIER Pxx_dgdftmng_dtc_it_ofs.Ctx_ffm_did_xxx[1] /end CHARACTERISTIC
/begin CHARACTERISTIC Ctx_ffm_did_it_ofs[2] "" VALUE 0xa002ece4 _REC_S1VAL_20_u2 65535. _CNV_A_R_A_165_CM 0. 65535. DISPLAY_IDENTIFIER Pxx_dgdftmng_dtc_it_ofs.Ctx_ffm_did_xxx[2] /end CHARACTERISTIC
/begin CHARACTERISTIC Ctx_ffm_did_it_ofs[3] "" VALUE 0xa002ece6 _REC_S1VAL_20_u2 65535. _CNV_A_R_A_165_CM 0. 65535. DISPLAY_IDENTIFIER Pxx_dgdftmng_dtc_it_ofs.Ctx_ffm_did_xxx[3] /end CHARACTERISTIC
/begin CHARACTERISTIC Ctx_ffm_did_it_ofs[4] "" VALUE 0xa002ece8 _REC_S1VAL_20_u2 65535. _CNV_A_R_A_165_CM 0. 65535. DISPLAY_IDENTIFIER Pxx_dgdftmng_dtc_it_ofs.Ctx_ffm_did_xxx[4] /end CHARACTERISTIC
/begin CHARACTERISTIC Cxx_dtc_hmb_it_ofs "" VALUE 0xa002ecea _REC_S1VAL_20_u2 65535. _CNV_A_R_A_165_CM 0. 65535. DISPLAY_IDENTIFIER Pxx_dgdftmng_dtc_it_ofs.Cxx_dtc_hmb_xxx /end CHARACTERISTIC
/begin CHARACTERISTIC Ctx_ffm_did_it_reg[0] "" VALUE 0xa002ecec _REC_S1VAL_20_u2 65535. _CNV_A_R_A_165_CM 0. 65535. DISPLAY_IDENTIFIER Pxx_dgdftmng_dtc_it_reg.Ctx_ffm_did_xxx[0] /end CHARACTERISTIC
/begin CHARACTERISTIC Ctx_ffm_did_it_reg[1] "" VALUE 0xa002ecee _REC_S1VAL_20_u2 65535. _CNV_A_R_A_165_CM 0. 65535. DISPLAY_IDENTIFIER Pxx_dgdftmng_dtc_it_reg.Ctx_ffm_did_xxx[1] /end CHARACTERISTIC
/begin CHARACTERISTIC Ctx_ffm_did_it_reg[2] "" VALUE 0xa002ecf0 _REC_S1VAL_20_u2 65535. _CNV_A_R_A_165_CM 0. 65535. DISPLAY_IDENTIFIER Pxx_dgdftmng_dtc_it_reg.Ctx_ffm_did_xxx[2] /end CHARACTERISTIC
/begin CHARACTERISTIC Ctx_ffm_did_it_reg[3] "" VALUE 0xa002ecf2 _REC_S1VAL_20_u2 65535. _CNV_A_R_A_165_CM 0. 65535. DISPLAY_IDENTIFIER Pxx_dgdftmng_dtc_it_reg.Ctx_ffm_did_xxx[3] /end CHARACTERISTIC
/begin CHARACTERISTIC Ctx_ffm_did_it_reg[4] "" VALUE 0xa002ecf4 _REC_S1VAL_20_u2 65535. _CNV_A_R_A_165_CM 0. 65535. DISPLAY_IDENTIFIER Pxx_dgdftmng_dtc_it_reg.Ctx_ffm_did_xxx[4] /end CHARACTERISTIC
/begin CHARACTERISTIC Cxx_dtc_hmb_it_reg "" VALUE 0xa002ecf6 _REC_S1VAL_20_u2 65535. _CNV_A_R_A_165_CM 0. 65535. DISPLAY_IDENTIFIER Pxx_dgdftmng_dtc_it_reg.Cxx_dtc_hmb_xxx /end CHARACTERISTIC
/begin CHARACTERISTIC Ctx_ffm_did_knk[0] "" VALUE 0xa002ecf8 _REC_S1VAL_20_u2 65535. _CNV_A_R_A_165_CM 0. 65535. DISPLAY_IDENTIFIER Pxx_dgdftmng_dtc_knk.Ctx_ffm_did_xxx[0] /end CHARACTERISTIC
/begin CHARACTERISTIC Ctx_ffm_did_knk[1] "" VALUE 0xa002ecfa _REC_S1VAL_20_u2 65535. _CNV_A_R_A_165_CM 0. 65535. DISPLAY_IDENTIFIER Pxx_dgdftmng_dtc_knk.Ctx_ffm_did_xxx[1] /end CHARACTERISTIC
/begin CHARACTERISTIC Ctx_ffm_did_knk[2] "" VALUE 0xa002ecfc _REC_S1VAL_20_u2 65535. _CNV_A_R_A_165_CM 0. 65535. DISPLAY_IDENTIFIER Pxx_dgdftmng_dtc_knk.Ctx_ffm_did_xxx[2] /end CHARACTERISTIC
/begin CHARACTERISTIC Ctx_ffm_did_knk[3] "" VALUE 0xa002ecfe _REC_S1VAL_20_u2 65535. _CNV_A_R_A_165_CM 0. 65535. DISPLAY_IDENTIFIER Pxx_dgdftmng_dtc_knk.Ctx_ffm_did_xxx[3] /end CHARACTERISTIC
/begin CHARACTERISTIC Ctx_ffm_did_knk[4] "" VALUE 0xa002ed00 _REC_S1VAL_20_u2 65535. _CNV_A_R_A_165_CM 0. 65535. DISPLAY_IDENTIFIER Pxx_dgdftmng_dtc_knk.Ctx_ffm_did_xxx[4] /end CHARACTERISTIC
/begin CHARACTERISTIC Cxx_dtc_hmb_knk "" VALUE 0xa002ed02 _REC_S1VAL_20_u2 65535. _CNV_A_R_A_165_CM 0. 65535. DISPLAY_IDENTIFIER Pxx_dgdftmng_dtc_knk.Cxx_dtc_hmb_xxx /end CHARACTERISTIC
/begin CHARACTERISTIC Ctx_ffm_did_lbdw[0] "" VALUE 0xa002ef98 _REC_S1VAL_20_u2 65535. _CNV_A_R_A_165_CM 0. 65535. DISPLAY_IDENTIFIER Pxx_dgdftmng_dtc_lbdw.Ctx_ffm_did_xxx[0] /end CHARACTERISTIC
/begin CHARACTERISTIC Ctx_ffm_did_lbdw[1] "" VALUE 0xa002ef9a _REC_S1VAL_20_u2 65535. _CNV_A_R_A_165_CM 0. 65535. DISPLAY_IDENTIFIER Pxx_dgdftmng_dtc_lbdw.Ctx_ffm_did_xxx[1] /end CHARACTERISTIC
/begin CHARACTERISTIC Ctx_ffm_did_lbdw[2] "" VALUE 0xa002ef9c _REC_S1VAL_20_u2 65535. _CNV_A_R_A_165_CM 0. 65535. DISPLAY_IDENTIFIER Pxx_dgdftmng_dtc_lbdw.Ctx_ffm_did_xxx[2] /end CHARACTERISTIC
/begin CHARACTERISTIC Ctx_ffm_did_lbdw[3] "" VALUE 0xa002ef9e _REC_S1VAL_20_u2 65535. _CNV_A_R_A_165_CM 0. 65535. DISPLAY_IDENTIFIER Pxx_dgdftmng_dtc_lbdw.Ctx_ffm_did_xxx[3] /end CHARACTERISTIC
/begin CHARACTERISTIC Ctx_ffm_did_lbdw[4] "" VALUE 0xa002efa0 _REC_S1VAL_20_u2 65535. _CNV_A_R_A_165_CM 0. 65535. DISPLAY_IDENTIFIER Pxx_dgdftmng_dtc_lbdw.Ctx_ffm_did_xxx[4] /end CHARACTERISTIC
/begin CHARACTERISTIC Cxx_dtc_hmb_lbdw "" VALUE 0xa002efa2 _REC_S1VAL_20_u2 65535. _CNV_A_R_A_165_CM 0. 65535. DISPLAY_IDENTIFIER Pxx_dgdftmng_dtc_lbdw.Cxx_dtc_hmb_xxx /end CHARACTERISTIC
/begin CHARACTERISTIC Ctx_ffm_did_lbdw_hot[0] "" VALUE 0xa002ed04 _REC_S1VAL_20_u2 65535. _CNV_A_R_A_165_CM 0. 65535. DISPLAY_IDENTIFIER Pxx_dgdftmng_dtc_lbdw_hot.Ctx_ffm_did_xxx[0] /end CHARACTERISTIC
/begin CHARACTERISTIC Ctx_ffm_did_lbdw_hot[1] "" VALUE 0xa002ed06 _REC_S1VAL_20_u2 65535. _CNV_A_R_A_165_CM 0. 65535. DISPLAY_IDENTIFIER Pxx_dgdftmng_dtc_lbdw_hot.Ctx_ffm_did_xxx[1] /end CHARACTERISTIC
/begin CHARACTERISTIC Ctx_ffm_did_lbdw_hot[2] "" VALUE 0xa002ed08 _REC_S1VAL_20_u2 65535. _CNV_A_R_A_165_CM 0. 65535. DISPLAY_IDENTIFIER Pxx_dgdftmng_dtc_lbdw_hot.Ctx_ffm_did_xxx[2] /end CHARACTERISTIC
/begin CHARACTERISTIC Ctx_ffm_did_lbdw_hot[3] "" VALUE 0xa002ed0a _REC_S1VAL_20_u2 65535. _CNV_A_R_A_165_CM 0. 65535. DISPLAY_IDENTIFIER Pxx_dgdftmng_dtc_lbdw_hot.Ctx_ffm_did_xxx[3] /end CHARACTERISTIC
/begin CHARACTERISTIC Ctx_ffm_did_lbdw_hot[4] "" VALUE 0xa002ed0c _REC_S1VAL_20_u2 65535. _CNV_A_R_A_165_CM 0. 65535. DISPLAY_IDENTIFIER Pxx_dgdftmng_dtc_lbdw_hot.Ctx_ffm_did_xxx[4] /end CHARACTERISTIC
/begin CHARACTERISTIC Cxx_dtc_hmb_lbdw_hot "" VALUE 0xa002ed0e _REC_S1VAL_20_u2 65535. _CNV_A_R_A_165_CM 0. 65535. DISPLAY_IDENTIFIER Pxx_dgdftmng_dtc_lbdw_hot.Cxx_dtc_hmb_xxx /end CHARACTERISTIC
/begin CHARACTERISTIC Ctx_ffm_did_lbup[0] "" VALUE 0xa002ed10 _REC_S1VAL_20_u2 65535. _CNV_A_R_A_165_CM 0. 65535. DISPLAY_IDENTIFIER Pxx_dgdftmng_dtc_lbup.Ctx_ffm_did_xxx[0] /end CHARACTERISTIC
/begin CHARACTERISTIC Ctx_ffm_did_lbup[1] "" VALUE 0xa002ed12 _REC_S1VAL_20_u2 65535. _CNV_A_R_A_165_CM 0. 65535. DISPLAY_IDENTIFIER Pxx_dgdftmng_dtc_lbup.Ctx_ffm_did_xxx[1] /end CHARACTERISTIC
/begin CHARACTERISTIC Ctx_ffm_did_lbup[2] "" VALUE 0xa002ed14 _REC_S1VAL_20_u2 65535. _CNV_A_R_A_165_CM 0. 65535. DISPLAY_IDENTIFIER Pxx_dgdftmng_dtc_lbup.Ctx_ffm_did_xxx[2] /end CHARACTERISTIC
/begin CHARACTERISTIC Ctx_ffm_did_lbup[3] "" VALUE 0xa002ed16 _REC_S1VAL_20_u2 65535. _CNV_A_R_A_165_CM 0. 65535. DISPLAY_IDENTIFIER Pxx_dgdftmng_dtc_lbup.Ctx_ffm_did_xxx[3] /end CHARACTERISTIC
/begin CHARACTERISTIC Ctx_ffm_did_lbup[4] "" VALUE 0xa002ed18 _REC_S1VAL_20_u2 65535. _CNV_A_R_A_165_CM 0. 65535. DISPLAY_IDENTIFIER Pxx_dgdftmng_dtc_lbup.Ctx_ffm_did_xxx[4] /end CHARACTERISTIC
/begin CHARACTERISTIC Cxx_dtc_hmb_lbup "" VALUE 0xa002ed1a _REC_S1VAL_20_u2 65535. _CNV_A_R_A_165_CM 0. 65535. DISPLAY_IDENTIFIER Pxx_dgdftmng_dtc_lbup.Cxx_dtc_hmb_xxx /end CHARACTERISTIC
/begin CHARACTERISTIC Ctx_ffm_did_lbup_hot[0] "" VALUE 0xa002ee24 _REC_S1VAL_20_u2 65535. _CNV_A_R_A_165_CM 0. 65535. DISPLAY_IDENTIFIER Pxx_dgdftmng_dtc_lbup_hot.Ctx_ffm_did_xxx[0] /end CHARACTERISTIC
/begin CHARACTERISTIC Ctx_ffm_did_lbup_hot[1] "" VALUE 0xa002ee26 _REC_S1VAL_20_u2 65535. _CNV_A_R_A_165_CM 0. 65535. DISPLAY_IDENTIFIER Pxx_dgdftmng_dtc_lbup_hot.Ctx_ffm_did_xxx[1] /end CHARACTERISTIC
/begin CHARACTERISTIC Ctx_ffm_did_lbup_hot[2] "" VALUE 0xa002ee28 _REC_S1VAL_20_u2 65535. _CNV_A_R_A_165_CM 0. 65535. DISPLAY_IDENTIFIER Pxx_dgdftmng_dtc_lbup_hot.Ctx_ffm_did_xxx[2] /end CHARACTERISTIC
/begin CHARACTERISTIC Ctx_ffm_did_lbup_hot[3] "" VALUE 0xa002ee2a _REC_S1VAL_20_u2 65535. _CNV_A_R_A_165_CM 0. 65535. DISPLAY_IDENTIFIER Pxx_dgdftmng_dtc_lbup_hot.Ctx_ffm_did_xxx[3] /end CHARACTERISTIC
/begin CHARACTERISTIC Ctx_ffm_did_lbup_hot[4] "" VALUE 0xa002ee2c _REC_S1VAL_20_u2 65535. _CNV_A_R_A_165_CM 0. 65535. DISPLAY_IDENTIFIER Pxx_dgdftmng_dtc_lbup_hot.Ctx_ffm_did_xxx[4] /end CHARACTERISTIC
/begin CHARACTERISTIC Cxx_dtc_hmb_lbup_hot "" VALUE 0xa002ee2e _REC_S1VAL_20_u2 65535. _CNV_A_R_A_165_CM 0. 65535. DISPLAY_IDENTIFIER Pxx_dgdftmng_dtc_lbup_hot.Cxx_dtc_hmb_xxx /end CHARACTERISTIC
/begin CHARACTERISTIC Ctx_ffm_did_map[0] "" VALUE 0xa002ee30 _REC_S1VAL_20_u2 65535. _CNV_A_R_A_165_CM 0. 65535. DISPLAY_IDENTIFIER Pxx_dgdftmng_dtc_map.Ctx_ffm_did_xxx[0] /end CHARACTERISTIC
/begin CHARACTERISTIC Ctx_ffm_did_map[1] "" VALUE 0xa002ee32 _REC_S1VAL_20_u2 65535. _CNV_A_R_A_165_CM 0. 65535. DISPLAY_IDENTIFIER Pxx_dgdftmng_dtc_map.Ctx_ffm_did_xxx[1] /end CHARACTERISTIC
/begin CHARACTERISTIC Ctx_ffm_did_map[2] "" VALUE 0xa002ee34 _REC_S1VAL_20_u2 65535. _CNV_A_R_A_165_CM 0. 65535. DISPLAY_IDENTIFIER Pxx_dgdftmng_dtc_map.Ctx_ffm_did_xxx[2] /end CHARACTERISTIC
/begin CHARACTERISTIC Ctx_ffm_did_map[3] "" VALUE 0xa002ee36 _REC_S1VAL_20_u2 65535. _CNV_A_R_A_165_CM 0. 65535. DISPLAY_IDENTIFIER Pxx_dgdftmng_dtc_map.Ctx_ffm_did_xxx[3] /end CHARACTERISTIC
/begin CHARACTERISTIC Ctx_ffm_did_map[4] "" VALUE 0xa002ee38 _REC_S1VAL_20_u2 65535. _CNV_A_R_A_165_CM 0. 65535. DISPLAY_IDENTIFIER Pxx_dgdftmng_dtc_map.Ctx_ffm_did_xxx[4] /end CHARACTERISTIC
/begin CHARACTERISTIC Cxx_dtc_hmb_map "" VALUE 0xa002ee3a _REC_S1VAL_20_u2 65535. _CNV_A_R_A_165_CM 0. 65535. DISPLAY_IDENTIFIER Pxx_dgdftmng_dtc_map.Cxx_dtc_hmb_xxx /end CHARACTERISTIC
/begin CHARACTERISTIC Ctx_ffm_did_mis[0] "" VALUE 0xa002ee9c _REC_S1VAL_20_u2 65535. _CNV_A_R_A_165_CM 0. 65535. DISPLAY_IDENTIFIER Pxx_dgdftmng_dtc_mis.Ctx_ffm_did_xxx[0] /end CHARACTERISTIC
/begin CHARACTERISTIC Ctx_ffm_did_mis[1] "" VALUE 0xa002ee9e _REC_S1VAL_20_u2 65535. _CNV_A_R_A_165_CM 0. 65535. DISPLAY_IDENTIFIER Pxx_dgdftmng_dtc_mis.Ctx_ffm_did_xxx[1] /end CHARACTERISTIC
/begin CHARACTERISTIC Ctx_ffm_did_mis[2] "" VALUE 0xa002eea0 _REC_S1VAL_20_u2 65535. _CNV_A_R_A_165_CM 0. 65535. DISPLAY_IDENTIFIER Pxx_dgdftmng_dtc_mis.Ctx_ffm_did_xxx[2] /end CHARACTERISTIC
/begin CHARACTERISTIC Ctx_ffm_did_mis[3] "" VALUE 0xa002eea2 _REC_S1VAL_20_u2 65535. _CNV_A_R_A_165_CM 0. 65535. DISPLAY_IDENTIFIER Pxx_dgdftmng_dtc_mis.Ctx_ffm_did_xxx[3] /end CHARACTERISTIC
/begin CHARACTERISTIC Ctx_ffm_did_mis[4] "" VALUE 0xa002eea4 _REC_S1VAL_20_u2 65535. _CNV_A_R_A_165_CM 0. 65535. DISPLAY_IDENTIFIER Pxx_dgdftmng_dtc_mis.Ctx_ffm_did_xxx[4] /end CHARACTERISTIC
/begin CHARACTERISTIC Cxx_dtc_hmb_mis "" VALUE 0xa002eea6 _REC_S1VAL_20_u2 65535. _CNV_A_R_A_165_CM 0. 65535. DISPLAY_IDENTIFIER Pxx_dgdftmng_dtc_mis.Cxx_dtc_hmb_xxx /end CHARACTERISTIC
/begin CHARACTERISTIC Ctx_ffm_did_mis_1[0] "" VALUE 0xa002ee3c _REC_S1VAL_20_u2 65535. _CNV_A_R_A_165_CM 0. 65535. DISPLAY_IDENTIFIER Pxx_dgdftmng_dtc_mis_1.Ctx_ffm_did_xxx[0] /end CHARACTERISTIC
/begin CHARACTERISTIC Ctx_ffm_did_mis_1[1] "" VALUE 0xa002ee3e _REC_S1VAL_20_u2 65535. _CNV_A_R_A_165_CM 0. 65535. DISPLAY_IDENTIFIER Pxx_dgdftmng_dtc_mis_1.Ctx_ffm_did_xxx[1] /end CHARACTERISTIC
/begin CHARACTERISTIC Ctx_ffm_did_mis_1[2] "" VALUE 0xa002ee40 _REC_S1VAL_20_u2 65535. _CNV_A_R_A_165_CM 0. 65535. DISPLAY_IDENTIFIER Pxx_dgdftmng_dtc_mis_1.Ctx_ffm_did_xxx[2] /end CHARACTERISTIC
/begin CHARACTERISTIC Ctx_ffm_did_mis_1[3] "" VALUE 0xa002ee42 _REC_S1VAL_20_u2 65535. _CNV_A_R_A_165_CM 0. 65535. DISPLAY_IDENTIFIER Pxx_dgdftmng_dtc_mis_1.Ctx_ffm_did_xxx[3] /end CHARACTERISTIC
/begin CHARACTERISTIC Ctx_ffm_did_mis_1[4] "" VALUE 0xa002ee44 _REC_S1VAL_20_u2 65535. _CNV_A_R_A_165_CM 0. 65535. DISPLAY_IDENTIFIER Pxx_dgdftmng_dtc_mis_1.Ctx_ffm_did_xxx[4] /end CHARACTERISTIC
/begin CHARACTERISTIC Cxx_dtc_hmb_mis_1 "" VALUE 0xa002ee46 _REC_S1VAL_20_u2 65535. _CNV_A_R_A_165_CM 0. 65535. DISPLAY_IDENTIFIER Pxx_dgdftmng_dtc_mis_1.Cxx_dtc_hmb_xxx /end CHARACTERISTIC
/begin CHARACTERISTIC Ctx_ffm_did_mis_1_lpg[0] "" VALUE 0xa002ee48 _REC_S1VAL_20_u2 65535. _CNV_A_R_A_165_CM 0. 65535. DISPLAY_IDENTIFIER Pxx_dgdftmng_dtc_mis_1_lpg.Ctx_ffm_did_xxx[0] /end CHARACTERISTIC
/begin CHARACTERISTIC Ctx_ffm_did_mis_1_lpg[1] "" VALUE 0xa002ee4a _REC_S1VAL_20_u2 65535. _CNV_A_R_A_165_CM 0. 65535. DISPLAY_IDENTIFIER Pxx_dgdftmng_dtc_mis_1_lpg.Ctx_ffm_did_xxx[1] /end CHARACTERISTIC
/begin CHARACTERISTIC Ctx_ffm_did_mis_1_lpg[2] "" VALUE 0xa002ee4c _REC_S1VAL_20_u2 65535. _CNV_A_R_A_165_CM 0. 65535. DISPLAY_IDENTIFIER Pxx_dgdftmng_dtc_mis_1_lpg.Ctx_ffm_did_xxx[2] /end CHARACTERISTIC
/begin CHARACTERISTIC Ctx_ffm_did_mis_1_lpg[3] "" VALUE 0xa002ee4e _REC_S1VAL_20_u2 65535. _CNV_A_R_A_165_CM 0. 65535. DISPLAY_IDENTIFIER Pxx_dgdftmng_dtc_mis_1_lpg.Ctx_ffm_did_xxx[3] /end CHARACTERISTIC
/begin CHARACTERISTIC Ctx_ffm_did_mis_1_lpg[4] "" VALUE 0xa002ee50 _REC_S1VAL_20_u2 65535. _CNV_A_R_A_165_CM 0. 65535. DISPLAY_IDENTIFIER Pxx_dgdftmng_dtc_mis_1_lpg.Ctx_ffm_did_xxx[4] /end CHARACTERISTIC
/begin CHARACTERISTIC Cxx_dtc_hmb_mis_1_lpg "" VALUE 0xa002ee52 _REC_S1VAL_20_u2 65535. _CNV_A_R_A_165_CM 0. 65535. DISPLAY_IDENTIFIER Pxx_dgdftmng_dtc_mis_1_lpg.Cxx_dtc_hmb_xxx /end CHARACTERISTIC
/begin CHARACTERISTIC Ctx_ffm_did_mis_2[0] "" VALUE 0xa002ee54 _REC_S1VAL_20_u2 65535. _CNV_A_R_A_165_CM 0. 65535. DISPLAY_IDENTIFIER Pxx_dgdftmng_dtc_mis_2.Ctx_ffm_did_xxx[0] /end CHARACTERISTIC
/begin CHARACTERISTIC Ctx_ffm_did_mis_2[1] "" VALUE 0xa002ee56 _REC_S1VAL_20_u2 65535. _CNV_A_R_A_165_CM 0. 65535. DISPLAY_IDENTIFIER Pxx_dgdftmng_dtc_mis_2.Ctx_ffm_did_xxx[1] /end CHARACTERISTIC
/begin CHARACTERISTIC Ctx_ffm_did_mis_2[2] "" VALUE 0xa002ee58 _REC_S1VAL_20_u2 65535. _CNV_A_R_A_165_CM 0. 65535. DISPLAY_IDENTIFIER Pxx_dgdftmng_dtc_mis_2.Ctx_ffm_did_xxx[2] /end CHARACTERISTIC
/begin CHARACTERISTIC Ctx_ffm_did_mis_2[3] "" VALUE 0xa002ee5a _REC_S1VAL_20_u2 65535. _CNV_A_R_A_165_CM 0. 65535. DISPLAY_IDENTIFIER Pxx_dgdftmng_dtc_mis_2.Ctx_ffm_did_xxx[3] /end CHARACTERISTIC
/begin CHARACTERISTIC Ctx_ffm_did_mis_2[4] "" VALUE 0xa002ee5c _REC_S1VAL_20_u2 65535. _CNV_A_R_A_165_CM 0. 65535. DISPLAY_IDENTIFIER Pxx_dgdftmng_dtc_mis_2.Ctx_ffm_did_xxx[4] /end CHARACTERISTIC
/begin CHARACTERISTIC Cxx_dtc_hmb_mis_2 "" VALUE 0xa002ee5e _REC_S1VAL_20_u2 65535. _CNV_A_R_A_165_CM 0. 65535. DISPLAY_IDENTIFIER Pxx_dgdftmng_dtc_mis_2.Cxx_dtc_hmb_xxx /end CHARACTERISTIC
/begin CHARACTERISTIC Ctx_ffm_did_mis_2_lpg[0] "" VALUE 0xa002ee60 _REC_S1VAL_20_u2 65535. _CNV_A_R_A_165_CM 0. 65535. DISPLAY_IDENTIFIER Pxx_dgdftmng_dtc_mis_2_lpg.Ctx_ffm_did_xxx[0] /end CHARACTERISTIC
/begin CHARACTERISTIC Ctx_ffm_did_mis_2_lpg[1] "" VALUE 0xa002ee62 _REC_S1VAL_20_u2 65535. _CNV_A_R_A_165_CM 0. 65535. DISPLAY_IDENTIFIER Pxx_dgdftmng_dtc_mis_2_lpg.Ctx_ffm_did_xxx[1] /end CHARACTERISTIC
/begin CHARACTERISTIC Ctx_ffm_did_mis_2_lpg[2] "" VALUE 0xa002ee64 _REC_S1VAL_20_u2 65535. _CNV_A_R_A_165_CM 0. 65535. DISPLAY_IDENTIFIER Pxx_dgdftmng_dtc_mis_2_lpg.Ctx_ffm_did_xxx[2] /end CHARACTERISTIC
/begin CHARACTERISTIC Ctx_ffm_did_mis_2_lpg[3] "" VALUE 0xa002ee66 _REC_S1VAL_20_u2 65535. _CNV_A_R_A_165_CM 0. 65535. DISPLAY_IDENTIFIER Pxx_dgdftmng_dtc_mis_2_lpg.Ctx_ffm_did_xxx[3] /end CHARACTERISTIC
/begin CHARACTERISTIC Ctx_ffm_did_mis_2_lpg[4] "" VALUE 0xa002ee68 _REC_S1VAL_20_u2 65535. _CNV_A_R_A_165_CM 0. 65535. DISPLAY_IDENTIFIER Pxx_dgdftmng_dtc_mis_2_lpg.Ctx_ffm_did_xxx[4] /end CHARACTERISTIC
/begin CHARACTERISTIC Cxx_dtc_hmb_mis_2_lpg "" VALUE 0xa002ee6a _REC_S1VAL_20_u2 65535. _CNV_A_R_A_165_CM 0. 65535. DISPLAY_IDENTIFIER Pxx_dgdftmng_dtc_mis_2_lpg.Cxx_dtc_hmb_xxx /end CHARACTERISTIC
/begin CHARACTERISTIC Ctx_ffm_did_mis_3[0] "" VALUE 0xa002ee6c _REC_S1VAL_20_u2 65535. _CNV_A_R_A_165_CM 0. 65535. DISPLAY_IDENTIFIER Pxx_dgdftmng_dtc_mis_3.Ctx_ffm_did_xxx[0] /end CHARACTERISTIC
/begin CHARACTERISTIC Ctx_ffm_did_mis_3[1] "" VALUE 0xa002ee6e _REC_S1VAL_20_u2 65535. _CNV_A_R_A_165_CM 0. 65535. DISPLAY_IDENTIFIER Pxx_dgdftmng_dtc_mis_3.Ctx_ffm_did_xxx[1] /end CHARACTERISTIC
/begin CHARACTERISTIC Ctx_ffm_did_mis_3[2] "" VALUE 0xa002ee70 _REC_S1VAL_20_u2 65535. _CNV_A_R_A_165_CM 0. 65535. DISPLAY_IDENTIFIER Pxx_dgdftmng_dtc_mis_3.Ctx_ffm_did_xxx[2] /end CHARACTERISTIC
/begin CHARACTERISTIC Ctx_ffm_did_mis_3[3] "" VALUE 0xa002ee72 _REC_S1VAL_20_u2 65535. _CNV_A_R_A_165_CM 0. 65535. DISPLAY_IDENTIFIER Pxx_dgdftmng_dtc_mis_3.Ctx_ffm_did_xxx[3] /end CHARACTERISTIC
/begin CHARACTERISTIC Ctx_ffm_did_mis_3[4] "" VALUE 0xa002ee74 _REC_S1VAL_20_u2 65535. _CNV_A_R_A_165_CM 0. 65535. DISPLAY_IDENTIFIER Pxx_dgdftmng_dtc_mis_3.Ctx_ffm_did_xxx[4] /end CHARACTERISTIC
/begin CHARACTERISTIC Cxx_dtc_hmb_mis_3 "" VALUE 0xa002ee76 _REC_S1VAL_20_u2 65535. _CNV_A_R_A_165_CM 0. 65535. DISPLAY_IDENTIFIER Pxx_dgdftmng_dtc_mis_3.Cxx_dtc_hmb_xxx /end CHARACTERISTIC
/begin CHARACTERISTIC Ctx_ffm_did_mis_3_lpg[0] "" VALUE 0xa002ee78 _REC_S1VAL_20_u2 65535. _CNV_A_R_A_165_CM 0. 65535. DISPLAY_IDENTIFIER Pxx_dgdftmng_dtc_mis_3_lpg.Ctx_ffm_did_xxx[0] /end CHARACTERISTIC
/begin CHARACTERISTIC Ctx_ffm_did_mis_3_lpg[1] "" VALUE 0xa002ee7a _REC_S1VAL_20_u2 65535. _CNV_A_R_A_165_CM 0. 65535. DISPLAY_IDENTIFIER Pxx_dgdftmng_dtc_mis_3_lpg.Ctx_ffm_did_xxx[1] /end CHARACTERISTIC
/begin CHARACTERISTIC Ctx_ffm_did_mis_3_lpg[2] "" VALUE 0xa002ee7c _REC_S1VAL_20_u2 65535. _CNV_A_R_A_165_CM 0. 65535. DISPLAY_IDENTIFIER Pxx_dgdftmng_dtc_mis_3_lpg.Ctx_ffm_did_xxx[2] /end CHARACTERISTIC
/begin CHARACTERISTIC Ctx_ffm_did_mis_3_lpg[3] "" VALUE 0xa002ee7e _REC_S1VAL_20_u2 65535. _CNV_A_R_A_165_CM 0. 65535. DISPLAY_IDENTIFIER Pxx_dgdftmng_dtc_mis_3_lpg.Ctx_ffm_did_xxx[3] /end CHARACTERISTIC
/begin CHARACTERISTIC Ctx_ffm_did_mis_3_lpg[4] "" VALUE 0xa002ee80 _REC_S1VAL_20_u2 65535. _CNV_A_R_A_165_CM 0. 65535. DISPLAY_IDENTIFIER Pxx_dgdftmng_dtc_mis_3_lpg.Ctx_ffm_did_xxx[4] /end CHARACTERISTIC
/begin CHARACTERISTIC Cxx_dtc_hmb_mis_3_lpg "" VALUE 0xa002ee82 _REC_S1VAL_20_u2 65535. _CNV_A_R_A_165_CM 0. 65535. DISPLAY_IDENTIFIER Pxx_dgdftmng_dtc_mis_3_lpg.Cxx_dtc_hmb_xxx /end CHARACTERISTIC
/begin CHARACTERISTIC Ctx_ffm_did_mis_4[0] "" VALUE 0xa002ee84 _REC_S1VAL_20_u2 65535. _CNV_A_R_A_165_CM 0. 65535. DISPLAY_IDENTIFIER Pxx_dgdftmng_dtc_mis_4.Ctx_ffm_did_xxx[0] /end CHARACTERISTIC
/begin CHARACTERISTIC Ctx_ffm_did_mis_4[1] "" VALUE 0xa002ee86 _REC_S1VAL_20_u2 65535. _CNV_A_R_A_165_CM 0. 65535. DISPLAY_IDENTIFIER Pxx_dgdftmng_dtc_mis_4.Ctx_ffm_did_xxx[1] /end CHARACTERISTIC
/begin CHARACTERISTIC Ctx_ffm_did_mis_4[2] "" VALUE 0xa002ee88 _REC_S1VAL_20_u2 65535. _CNV_A_R_A_165_CM 0. 65535. DISPLAY_IDENTIFIER Pxx_dgdftmng_dtc_mis_4.Ctx_ffm_did_xxx[2] /end CHARACTERISTIC
/begin CHARACTERISTIC Ctx_ffm_did_mis_4[3] "" VALUE 0xa002ee8a _REC_S1VAL_20_u2 65535. _CNV_A_R_A_165_CM 0. 65535. DISPLAY_IDENTIFIER Pxx_dgdftmng_dtc_mis_4.Ctx_ffm_did_xxx[3] /end CHARACTERISTIC
/begin CHARACTERISTIC Ctx_ffm_did_mis_4[4] "" VALUE 0xa002ee8c _REC_S1VAL_20_u2 65535. _CNV_A_R_A_165_CM 0. 65535. DISPLAY_IDENTIFIER Pxx_dgdftmng_dtc_mis_4.Ctx_ffm_did_xxx[4] /end CHARACTERISTIC
/begin CHARACTERISTIC Cxx_dtc_hmb_mis_4 "" VALUE 0xa002ee8e _REC_S1VAL_20_u2 65535. _CNV_A_R_A_165_CM 0. 65535. DISPLAY_IDENTIFIER Pxx_dgdftmng_dtc_mis_4.Cxx_dtc_hmb_xxx /end CHARACTERISTIC
/begin CHARACTERISTIC Ctx_ffm_did_mis_4_lpg[0] "" VALUE 0xa002ee90 _REC_S1VAL_20_u2 65535. _CNV_A_R_A_165_CM 0. 65535. DISPLAY_IDENTIFIER Pxx_dgdftmng_dtc_mis_4_lpg.Ctx_ffm_did_xxx[0] /end CHARACTERISTIC
/begin CHARACTERISTIC Ctx_ffm_did_mis_4_lpg[1] "" VALUE 0xa002ee92 _REC_S1VAL_20_u2 65535. _CNV_A_R_A_165_CM 0. 65535. DISPLAY_IDENTIFIER Pxx_dgdftmng_dtc_mis_4_lpg.Ctx_ffm_did_xxx[1] /end CHARACTERISTIC
/begin CHARACTERISTIC Ctx_ffm_did_mis_4_lpg[2] "" VALUE 0xa002ee94 _REC_S1VAL_20_u2 65535. _CNV_A_R_A_165_CM 0. 65535. DISPLAY_IDENTIFIER Pxx_dgdftmng_dtc_mis_4_lpg.Ctx_ffm_did_xxx[2] /end CHARACTERISTIC
/begin CHARACTERISTIC Ctx_ffm_did_mis_4_lpg[3] "" VALUE 0xa002ee96 _REC_S1VAL_20_u2 65535. _CNV_A_R_A_165_CM 0. 65535. DISPLAY_IDENTIFIER Pxx_dgdftmng_dtc_mis_4_lpg.Ctx_ffm_did_xxx[3] /end CHARACTERISTIC
/begin CHARACTERISTIC Ctx_ffm_did_mis_4_lpg[4] "" VALUE 0xa002ee98 _REC_S1VAL_20_u2 65535. _CNV_A_R_A_165_CM 0. 65535. DISPLAY_IDENTIFIER Pxx_dgdftmng_dtc_mis_4_lpg.Ctx_ffm_did_xxx[4] /end CHARACTERISTIC
/begin CHARACTERISTIC Cxx_dtc_hmb_mis_4_lpg "" VALUE 0xa002ee9a _REC_S1VAL_20_u2 65535. _CNV_A_R_A_165_CM 0. 65535. DISPLAY_IDENTIFIER Pxx_dgdftmng_dtc_mis_4_lpg.Cxx_dtc_hmb_xxx /end CHARACTERISTIC
/begin CHARACTERISTIC Ctx_ffm_did_mis_lpg[0] "" VALUE 0xa002eea8 _REC_S1VAL_20_u2 65535. _CNV_A_R_A_165_CM 0. 65535. DISPLAY_IDENTIFIER Pxx_dgdftmng_dtc_mis_lpg.Ctx_ffm_did_xxx[0] /end CHARACTERISTIC
/begin CHARACTERISTIC Ctx_ffm_did_mis_lpg[1] "" VALUE 0xa002eeaa _REC_S1VAL_20_u2 65535. _CNV_A_R_A_165_CM 0. 65535. DISPLAY_IDENTIFIER Pxx_dgdftmng_dtc_mis_lpg.Ctx_ffm_did_xxx[1] /end CHARACTERISTIC
/begin CHARACTERISTIC Ctx_ffm_did_mis_lpg[2] "" VALUE 0xa002eeac _REC_S1VAL_20_u2 65535. _CNV_A_R_A_165_CM 0. 65535. DISPLAY_IDENTIFIER Pxx_dgdftmng_dtc_mis_lpg.Ctx_ffm_did_xxx[2] /end CHARACTERISTIC
/begin CHARACTERISTIC Ctx_ffm_did_mis_lpg[3] "" VALUE 0xa002eeae _REC_S1VAL_20_u2 65535. _CNV_A_R_A_165_CM 0. 65535. DISPLAY_IDENTIFIER Pxx_dgdftmng_dtc_mis_lpg.Ctx_ffm_did_xxx[3] /end CHARACTERISTIC
/begin CHARACTERISTIC Ctx_ffm_did_mis_lpg[4] "" VALUE 0xa002eeb0 _REC_S1VAL_20_u2 65535. _CNV_A_R_A_165_CM 0. 65535. DISPLAY_IDENTIFIER Pxx_dgdftmng_dtc_mis_lpg.Ctx_ffm_did_xxx[4] /end CHARACTERISTIC
/begin CHARACTERISTIC Cxx_dtc_hmb_mis_lpg "" VALUE 0xa002eeb2 _REC_S1VAL_20_u2 65535. _CNV_A_R_A_165_CM 0. 65535. DISPLAY_IDENTIFIER Pxx_dgdftmng_dtc_mis_lpg.Cxx_dtc_hmb_xxx /end CHARACTERISTIC
/begin CHARACTERISTIC Ctx_ffm_did_mis_min_fuel[0] "" VALUE 0xa002eeb4 _REC_S1VAL_20_u2 65535. _CNV_A_R_A_165_CM 0. 65535. DISPLAY_IDENTIFIER Pxx_dgdftmng_dtc_mis_min_fuel.Ctx_ffm_did_xxx[0] /end CHARACTERISTIC
/begin CHARACTERISTIC Ctx_ffm_did_mis_min_fuel[1] "" VALUE 0xa002eeb6 _REC_S1VAL_20_u2 65535. _CNV_A_R_A_165_CM 0. 65535. DISPLAY_IDENTIFIER Pxx_dgdftmng_dtc_mis_min_fuel.Ctx_ffm_did_xxx[1] /end CHARACTERISTIC
/begin CHARACTERISTIC Ctx_ffm_did_mis_min_fuel[2] "" VALUE 0xa002eeb8 _REC_S1VAL_20_u2 65535. _CNV_A_R_A_165_CM 0. 65535. DISPLAY_IDENTIFIER Pxx_dgdftmng_dtc_mis_min_fuel.Ctx_ffm_did_xxx[2] /end CHARACTERISTIC
/begin CHARACTERISTIC Ctx_ffm_did_mis_min_fuel[3] "" VALUE 0xa002eeba _REC_S1VAL_20_u2 65535. _CNV_A_R_A_165_CM 0. 65535. DISPLAY_IDENTIFIER Pxx_dgdftmng_dtc_mis_min_fuel.Ctx_ffm_did_xxx[3] /end CHARACTERISTIC
/begin CHARACTERISTIC Ctx_ffm_did_mis_min_fuel[4] "" VALUE 0xa002eebc _REC_S1VAL_20_u2 65535. _CNV_A_R_A_165_CM 0. 65535. DISPLAY_IDENTIFIER Pxx_dgdftmng_dtc_mis_min_fuel.Ctx_ffm_did_xxx[4] /end CHARACTERISTIC
/begin CHARACTERISTIC Cxx_dtc_hmb_mis_min_fuel "" VALUE 0xa002eebe _REC_S1VAL_20_u2 65535. _CNV_A_R_A_165_CM 0. 65535. DISPLAY_IDENTIFIER Pxx_dgdftmng_dtc_mis_min_fuel.Cxx_dtc_hmb_xxx /end CHARACTERISTIC
/begin CHARACTERISTIC Ctx_ffm_did_mis_unk[0] "" VALUE 0xa002eec0 _REC_S1VAL_20_u2 65535. _CNV_A_R_A_165_CM 0. 65535. DISPLAY_IDENTIFIER Pxx_dgdftmng_dtc_mis_unk.Ctx_ffm_did_xxx[0] /end CHARACTERISTIC
/begin CHARACTERISTIC Ctx_ffm_did_mis_unk[1] "" VALUE 0xa002eec2 _REC_S1VAL_20_u2 65535. _CNV_A_R_A_165_CM 0. 65535. DISPLAY_IDENTIFIER Pxx_dgdftmng_dtc_mis_unk.Ctx_ffm_did_xxx[1] /end CHARACTERISTIC
/begin CHARACTERISTIC Ctx_ffm_did_mis_unk[2] "" VALUE 0xa002eec4 _REC_S1VAL_20_u2 65535. _CNV_A_R_A_165_CM 0. 65535. DISPLAY_IDENTIFIER Pxx_dgdftmng_dtc_mis_unk.Ctx_ffm_did_xxx[2] /end CHARACTERISTIC
/begin CHARACTERISTIC Ctx_ffm_did_mis_unk[3] "" VALUE 0xa002eec6 _REC_S1VAL_20_u2 65535. _CNV_A_R_A_165_CM 0. 65535. DISPLAY_IDENTIFIER Pxx_dgdftmng_dtc_mis_unk.Ctx_ffm_did_xxx[3] /end CHARACTERISTIC
/begin CHARACTERISTIC Ctx_ffm_did_mis_unk[4] "" VALUE 0xa002eec8 _REC_S1VAL_20_u2 65535. _CNV_A_R_A_165_CM 0. 65535. DISPLAY_IDENTIFIER Pxx_dgdftmng_dtc_mis_unk.Ctx_ffm_did_xxx[4] /end CHARACTERISTIC
/begin CHARACTERISTIC Cxx_dtc_hmb_mis_unk "" VALUE 0xa002eeca _REC_S1VAL_20_u2 65535. _CNV_A_R_A_165_CM 0. 65535. DISPLAY_IDENTIFIER Pxx_dgdftmng_dtc_mis_unk.Cxx_dtc_hmb_xxx /end CHARACTERISTIC
/begin CHARACTERISTIC Ctx_ffm_did_mis_unk_lpg[0] "" VALUE 0xa002eecc _REC_S1VAL_20_u2 65535. _CNV_A_R_A_165_CM 0. 65535. DISPLAY_IDENTIFIER Pxx_dgdftmng_dtc_mis_unk_lpg.Ctx_ffm_did_xxx[0] /end CHARACTERISTIC
/begin CHARACTERISTIC Ctx_ffm_did_mis_unk_lpg[1] "" VALUE 0xa002eece _REC_S1VAL_20_u2 65535. _CNV_A_R_A_165_CM 0. 65535. DISPLAY_IDENTIFIER Pxx_dgdftmng_dtc_mis_unk_lpg.Ctx_ffm_did_xxx[1] /end CHARACTERISTIC
/begin CHARACTERISTIC Ctx_ffm_did_mis_unk_lpg[2] "" VALUE 0xa002eed0 _REC_S1VAL_20_u2 65535. _CNV_A_R_A_165_CM 0. 65535. DISPLAY_IDENTIFIER Pxx_dgdftmng_dtc_mis_unk_lpg.Ctx_ffm_did_xxx[2] /end CHARACTERISTIC
/begin CHARACTERISTIC Ctx_ffm_did_mis_unk_lpg[3] "" VALUE 0xa002eed2 _REC_S1VAL_20_u2 65535. _CNV_A_R_A_165_CM 0. 65535. DISPLAY_IDENTIFIER Pxx_dgdftmng_dtc_mis_unk_lpg.Ctx_ffm_did_xxx[3] /end CHARACTERISTIC
/begin CHARACTERISTIC Ctx_ffm_did_mis_unk_lpg[4] "" VALUE 0xa002eed4 _REC_S1VAL_20_u2 65535. _CNV_A_R_A_165_CM 0. 65535. DISPLAY_IDENTIFIER Pxx_dgdftmng_dtc_mis_unk_lpg.Ctx_ffm_did_xxx[4] /end CHARACTERISTIC
/begin CHARACTERISTIC Cxx_dtc_hmb_mis_unk_lpg "" VALUE 0xa002eed6 _REC_S1VAL_20_u2 65535. _CNV_A_R_A_165_CM 0. 65535. DISPLAY_IDENTIFIER Pxx_dgdftmng_dtc_mis_unk_lpg.Cxx_dtc_hmb_xxx /end CHARACTERISTIC
/begin CHARACTERISTIC Ctx_ffm_did_ptc_rov[0] "" VALUE 0xa002ef50 _REC_S1VAL_20_u2 65535. _CNV_A_R_A_165_CM 0. 65535. DISPLAY_IDENTIFIER Pxx_dgdftmng_dtc_ptc_rov.Ctx_ffm_did_xxx[0] /end CHARACTERISTIC
/begin CHARACTERISTIC Ctx_ffm_did_ptc_rov[1] "" VALUE 0xa002ef52 _REC_S1VAL_20_u2 65535. _CNV_A_R_A_165_CM 0. 65535. DISPLAY_IDENTIFIER Pxx_dgdftmng_dtc_ptc_rov.Ctx_ffm_did_xxx[1] /end CHARACTERISTIC
/begin CHARACTERISTIC Ctx_ffm_did_ptc_rov[2] "" VALUE 0xa002ef54 _REC_S1VAL_20_u2 65535. _CNV_A_R_A_165_CM 0. 65535. DISPLAY_IDENTIFIER Pxx_dgdftmng_dtc_ptc_rov.Ctx_ffm_did_xxx[2] /end CHARACTERISTIC
/begin CHARACTERISTIC Ctx_ffm_did_ptc_rov[3] "" VALUE 0xa002ef56 _REC_S1VAL_20_u2 65535. _CNV_A_R_A_165_CM 0. 65535. DISPLAY_IDENTIFIER Pxx_dgdftmng_dtc_ptc_rov.Ctx_ffm_did_xxx[3] /end CHARACTERISTIC
/begin CHARACTERISTIC Ctx_ffm_did_ptc_rov[4] "" VALUE 0xa002ef58 _REC_S1VAL_20_u2 65535. _CNV_A_R_A_165_CM 0. 65535. DISPLAY_IDENTIFIER Pxx_dgdftmng_dtc_ptc_rov.Ctx_ffm_did_xxx[4] /end CHARACTERISTIC
/begin CHARACTERISTIC Cxx_dtc_hmb_ptc_rov "" VALUE 0xa002ef5a _REC_S1VAL_20_u2 65535. _CNV_A_R_A_165_CM 0. 65535. DISPLAY_IDENTIFIER Pxx_dgdftmng_dtc_ptc_rov.Cxx_dtc_hmb_xxx /end CHARACTERISTIC
/begin CHARACTERISTIC Ctx_ffm_did_pws_1[0] "" VALUE 0xa002ed1c _REC_S1VAL_20_u2 65535. _CNV_A_R_A_165_CM 0. 65535. DISPLAY_IDENTIFIER Pxx_dgdftmng_dtc_pws_1.Ctx_ffm_did_xxx[0] /end CHARACTERISTIC
/begin CHARACTERISTIC Ctx_ffm_did_pws_1[1] "" VALUE 0xa002ed1e _REC_S1VAL_20_u2 65535. _CNV_A_R_A_165_CM 0. 65535. DISPLAY_IDENTIFIER Pxx_dgdftmng_dtc_pws_1.Ctx_ffm_did_xxx[1] /end CHARACTERISTIC
/begin CHARACTERISTIC Ctx_ffm_did_pws_1[2] "" VALUE 0xa002ed20 _REC_S1VAL_20_u2 65535. _CNV_A_R_A_165_CM 0. 65535. DISPLAY_IDENTIFIER Pxx_dgdftmng_dtc_pws_1.Ctx_ffm_did_xxx[2] /end CHARACTERISTIC
/begin CHARACTERISTIC Ctx_ffm_did_pws_1[3] "" VALUE 0xa002ed22 _REC_S1VAL_20_u2 65535. _CNV_A_R_A_165_CM 0. 65535. DISPLAY_IDENTIFIER Pxx_dgdftmng_dtc_pws_1.Ctx_ffm_did_xxx[3] /end CHARACTERISTIC
/begin CHARACTERISTIC Ctx_ffm_did_pws_1[4] "" VALUE 0xa002ed24 _REC_S1VAL_20_u2 65535. _CNV_A_R_A_165_CM 0. 65535. DISPLAY_IDENTIFIER Pxx_dgdftmng_dtc_pws_1.Ctx_ffm_did_xxx[4] /end CHARACTERISTIC
/begin CHARACTERISTIC Cxx_dtc_hmb_pws_1 "" VALUE 0xa002ed26 _REC_S1VAL_20_u2 65535. _CNV_A_R_A_165_CM 0. 65535. DISPLAY_IDENTIFIER Pxx_dgdftmng_dtc_pws_1.Cxx_dtc_hmb_xxx /end CHARACTERISTIC
/begin CHARACTERISTIC Ctx_ffm_did_pws_2[0] "" VALUE 0xa002ed28 _REC_S1VAL_20_u2 65535. _CNV_A_R_A_165_CM 0. 65535. DISPLAY_IDENTIFIER Pxx_dgdftmng_dtc_pws_2.Ctx_ffm_did_xxx[0] /end CHARACTERISTIC
/begin CHARACTERISTIC Ctx_ffm_did_pws_2[1] "" VALUE 0xa002ed2a _REC_S1VAL_20_u2 65535. _CNV_A_R_A_165_CM 0. 65535. DISPLAY_IDENTIFIER Pxx_dgdftmng_dtc_pws_2.Ctx_ffm_did_xxx[1] /end CHARACTERISTIC
/begin CHARACTERISTIC Ctx_ffm_did_pws_2[2] "" VALUE 0xa002ed2c _REC_S1VAL_20_u2 65535. _CNV_A_R_A_165_CM 0. 65535. DISPLAY_IDENTIFIER Pxx_dgdftmng_dtc_pws_2.Ctx_ffm_did_xxx[2] /end CHARACTERISTIC
/begin CHARACTERISTIC Ctx_ffm_did_pws_2[3] "" VALUE 0xa002ed2e _REC_S1VAL_20_u2 65535. _CNV_A_R_A_165_CM 0. 65535. DISPLAY_IDENTIFIER Pxx_dgdftmng_dtc_pws_2.Ctx_ffm_did_xxx[3] /end CHARACTERISTIC
/begin CHARACTERISTIC Ctx_ffm_did_pws_2[4] "" VALUE 0xa002ed30 _REC_S1VAL_20_u2 65535. _CNV_A_R_A_165_CM 0. 65535. DISPLAY_IDENTIFIER Pxx_dgdftmng_dtc_pws_2.Ctx_ffm_did_xxx[4] /end CHARACTERISTIC
/begin CHARACTERISTIC Cxx_dtc_hmb_pws_2 "" VALUE 0xa002ed32 _REC_S1VAL_20_u2 65535. _CNV_A_R_A_165_CM 0. 65535. DISPLAY_IDENTIFIER Pxx_dgdftmng_dtc_pws_2.Cxx_dtc_hmb_xxx /end CHARACTERISTIC
/begin CHARACTERISTIC Ctx_ffm_did_pws_3[0] "" VALUE 0xa002ed34 _REC_S1VAL_20_u2 65535. _CNV_A_R_A_165_CM 0. 65535. DISPLAY_IDENTIFIER Pxx_dgdftmng_dtc_pws_3.Ctx_ffm_did_xxx[0] /end CHARACTERISTIC
/begin CHARACTERISTIC Ctx_ffm_did_pws_3[1] "" VALUE 0xa002ed36 _REC_S1VAL_20_u2 65535. _CNV_A_R_A_165_CM 0. 65535. DISPLAY_IDENTIFIER Pxx_dgdftmng_dtc_pws_3.Ctx_ffm_did_xxx[1] /end CHARACTERISTIC
/begin CHARACTERISTIC Ctx_ffm_did_pws_3[2] "" VALUE 0xa002ed38 _REC_S1VAL_20_u2 65535. _CNV_A_R_A_165_CM 0. 65535. DISPLAY_IDENTIFIER Pxx_dgdftmng_dtc_pws_3.Ctx_ffm_did_xxx[2] /end CHARACTERISTIC
/begin CHARACTERISTIC Ctx_ffm_did_pws_3[3] "" VALUE 0xa002ed3a _REC_S1VAL_20_u2 65535. _CNV_A_R_A_165_CM 0. 65535. DISPLAY_IDENTIFIER Pxx_dgdftmng_dtc_pws_3.Ctx_ffm_did_xxx[3] /end CHARACTERISTIC
/begin CHARACTERISTIC Ctx_ffm_did_pws_3[4] "" VALUE 0xa002ed3c _REC_S1VAL_20_u2 65535. _CNV_A_R_A_165_CM 0. 65535. DISPLAY_IDENTIFIER Pxx_dgdftmng_dtc_pws_3.Ctx_ffm_did_xxx[4] /end CHARACTERISTIC
/begin CHARACTERISTIC Cxx_dtc_hmb_pws_3 "" VALUE 0xa002ed3e _REC_S1VAL_20_u2 65535. _CNV_A_R_A_165_CM 0. 65535. DISPLAY_IDENTIFIER Pxx_dgdftmng_dtc_pws_3.Cxx_dtc_hmb_xxx /end CHARACTERISTIC
/begin CHARACTERISTIC Ctx_ffm_did_sens_it[0] "" VALUE 0xa002ed58 _REC_S1VAL_20_u2 65535. _CNV_A_R_A_165_CM 0. 65535. DISPLAY_IDENTIFIER Pxx_dgdftmng_dtc_sens_it.Ctx_ffm_did_xxx[0] /end CHARACTERISTIC
/begin CHARACTERISTIC Ctx_ffm_did_sens_it[1] "" VALUE 0xa002ed5a _REC_S1VAL_20_u2 65535. _CNV_A_R_A_165_CM 0. 65535. DISPLAY_IDENTIFIER Pxx_dgdftmng_dtc_sens_it.Ctx_ffm_did_xxx[1] /end CHARACTERISTIC
/begin CHARACTERISTIC Ctx_ffm_did_sens_it[2] "" VALUE 0xa002ed5c _REC_S1VAL_20_u2 65535. _CNV_A_R_A_165_CM 0. 65535. DISPLAY_IDENTIFIER Pxx_dgdftmng_dtc_sens_it.Ctx_ffm_did_xxx[2] /end CHARACTERISTIC
/begin CHARACTERISTIC Ctx_ffm_did_sens_it[3] "" VALUE 0xa002ed5e _REC_S1VAL_20_u2 65535. _CNV_A_R_A_165_CM 0. 65535. DISPLAY_IDENTIFIER Pxx_dgdftmng_dtc_sens_it.Ctx_ffm_did_xxx[3] /end CHARACTERISTIC
/begin CHARACTERISTIC Ctx_ffm_did_sens_it[4] "" VALUE 0xa002ed60 _REC_S1VAL_20_u2 65535. _CNV_A_R_A_165_CM 0. 65535. DISPLAY_IDENTIFIER Pxx_dgdftmng_dtc_sens_it.Ctx_ffm_did_xxx[4] /end CHARACTERISTIC
/begin CHARACTERISTIC Cxx_dtc_hmb_sens_it "" VALUE 0xa002ed62 _REC_S1VAL_20_u2 65535. _CNV_A_R_A_165_CM 0. 65535. DISPLAY_IDENTIFIER Pxx_dgdftmng_dtc_sens_it.Cxx_dtc_hmb_xxx /end CHARACTERISTIC
/begin CHARACTERISTIC Ctx_ffm_did_sens_it_1[0] "" VALUE 0xa002ed40 _REC_S1VAL_20_u2 65535. _CNV_A_R_A_165_CM 0. 65535. DISPLAY_IDENTIFIER Pxx_dgdftmng_dtc_sens_it_1.Ctx_ffm_did_xxx[0] /end CHARACTERISTIC
/begin CHARACTERISTIC Ctx_ffm_did_sens_it_1[1] "" VALUE 0xa002ed42 _REC_S1VAL_20_u2 65535. _CNV_A_R_A_165_CM 0. 65535. DISPLAY_IDENTIFIER Pxx_dgdftmng_dtc_sens_it_1.Ctx_ffm_did_xxx[1] /end CHARACTERISTIC
/begin CHARACTERISTIC Ctx_ffm_did_sens_it_1[2] "" VALUE 0xa002ed44 _REC_S1VAL_20_u2 65535. _CNV_A_R_A_165_CM 0. 65535. DISPLAY_IDENTIFIER Pxx_dgdftmng_dtc_sens_it_1.Ctx_ffm_did_xxx[2] /end CHARACTERISTIC
/begin CHARACTERISTIC Ctx_ffm_did_sens_it_1[3] "" VALUE 0xa002ed46 _REC_S1VAL_20_u2 65535. _CNV_A_R_A_165_CM 0. 65535. DISPLAY_IDENTIFIER Pxx_dgdftmng_dtc_sens_it_1.Ctx_ffm_did_xxx[3] /end CHARACTERISTIC
/begin CHARACTERISTIC Ctx_ffm_did_sens_it_1[4] "" VALUE 0xa002ed48 _REC_S1VAL_20_u2 65535. _CNV_A_R_A_165_CM 0. 65535. DISPLAY_IDENTIFIER Pxx_dgdftmng_dtc_sens_it_1.Ctx_ffm_did_xxx[4] /end CHARACTERISTIC
/begin CHARACTERISTIC Cxx_dtc_hmb_sens_it_1 "" VALUE 0xa002ed4a _REC_S1VAL_20_u2 65535. _CNV_A_R_A_165_CM 0. 65535. DISPLAY_IDENTIFIER Pxx_dgdftmng_dtc_sens_it_1.Cxx_dtc_hmb_xxx /end CHARACTERISTIC
/begin CHARACTERISTIC Ctx_ffm_did_sens_it_2[0] "" VALUE 0xa002ed4c _REC_S1VAL_20_u2 65535. _CNV_A_R_A_165_CM 0. 65535. DISPLAY_IDENTIFIER Pxx_dgdftmng_dtc_sens_it_2.Ctx_ffm_did_xxx[0] /end CHARACTERISTIC
/begin CHARACTERISTIC Ctx_ffm_did_sens_it_2[1] "" VALUE 0xa002ed4e _REC_S1VAL_20_u2 65535. _CNV_A_R_A_165_CM 0. 65535. DISPLAY_IDENTIFIER Pxx_dgdftmng_dtc_sens_it_2.Ctx_ffm_did_xxx[1] /end CHARACTERISTIC
/begin CHARACTERISTIC Ctx_ffm_did_sens_it_2[2] "" VALUE 0xa002ed50 _REC_S1VAL_20_u2 65535. _CNV_A_R_A_165_CM 0. 65535. DISPLAY_IDENTIFIER Pxx_dgdftmng_dtc_sens_it_2.Ctx_ffm_did_xxx[2] /end CHARACTERISTIC
/begin CHARACTERISTIC Ctx_ffm_did_sens_it_2[3] "" VALUE 0xa002ed52 _REC_S1VAL_20_u2 65535. _CNV_A_R_A_165_CM 0. 65535. DISPLAY_IDENTIFIER Pxx_dgdftmng_dtc_sens_it_2.Ctx_ffm_did_xxx[3] /end CHARACTERISTIC
/begin CHARACTERISTIC Ctx_ffm_did_sens_it_2[4] "" VALUE 0xa002ed54 _REC_S1VAL_20_u2 65535. _CNV_A_R_A_165_CM 0. 65535. DISPLAY_IDENTIFIER Pxx_dgdftmng_dtc_sens_it_2.Ctx_ffm_did_xxx[4] /end CHARACTERISTIC
/begin CHARACTERISTIC Cxx_dtc_hmb_sens_it_2 "" VALUE 0xa002ed56 _REC_S1VAL_20_u2 65535. _CNV_A_R_A_165_CM 0. 65535. DISPLAY_IDENTIFIER Pxx_dgdftmng_dtc_sens_it_2.Cxx_dtc_hmb_xxx /end CHARACTERISTIC
/begin CHARACTERISTIC Ctx_ffm_did_sens_map[0] "" VALUE 0xa002ed64 _REC_S1VAL_20_u2 65535. _CNV_A_R_A_165_CM 0. 65535. DISPLAY_IDENTIFIER Pxx_dgdftmng_dtc_sens_map.Ctx_ffm_did_xxx[0] /end CHARACTERISTIC
/begin CHARACTERISTIC Ctx_ffm_did_sens_map[1] "" VALUE 0xa002ed66 _REC_S1VAL_20_u2 65535. _CNV_A_R_A_165_CM 0. 65535. DISPLAY_IDENTIFIER Pxx_dgdftmng_dtc_sens_map.Ctx_ffm_did_xxx[1] /end CHARACTERISTIC
/begin CHARACTERISTIC Ctx_ffm_did_sens_map[2] "" VALUE 0xa002ed68 _REC_S1VAL_20_u2 65535. _CNV_A_R_A_165_CM 0. 65535. DISPLAY_IDENTIFIER Pxx_dgdftmng_dtc_sens_map.Ctx_ffm_did_xxx[2] /end CHARACTERISTIC
/begin CHARACTERISTIC Ctx_ffm_did_sens_map[3] "" VALUE 0xa002ed6a _REC_S1VAL_20_u2 65535. _CNV_A_R_A_165_CM 0. 65535. DISPLAY_IDENTIFIER Pxx_dgdftmng_dtc_sens_map.Ctx_ffm_did_xxx[3] /end CHARACTERISTIC
/begin CHARACTERISTIC Ctx_ffm_did_sens_map[4] "" VALUE 0xa002ed6c _REC_S1VAL_20_u2 65535. _CNV_A_R_A_165_CM 0. 65535. DISPLAY_IDENTIFIER Pxx_dgdftmng_dtc_sens_map.Ctx_ffm_did_xxx[4] /end CHARACTERISTIC
/begin CHARACTERISTIC Cxx_dtc_hmb_sens_map "" VALUE 0xa002ed6e _REC_S1VAL_20_u2 65535. _CNV_A_R_A_165_CM 0. 65535. DISPLAY_IDENTIFIER Pxx_dgdftmng_dtc_sens_map.Cxx_dtc_hmb_xxx /end CHARACTERISTIC
/begin CHARACTERISTIC Ctx_ffm_did_sens_mat[0] "" VALUE 0xa002edb8 _REC_S1VAL_20_u2 65535. _CNV_A_R_A_165_CM 0. 65535. DISPLAY_IDENTIFIER Pxx_dgdftmng_dtc_sens_mat.Ctx_ffm_did_xxx[0] /end CHARACTERISTIC
/begin CHARACTERISTIC Ctx_ffm_did_sens_mat[1] "" VALUE 0xa002edba _REC_S1VAL_20_u2 65535. _CNV_A_R_A_165_CM 0. 65535. DISPLAY_IDENTIFIER Pxx_dgdftmng_dtc_sens_mat.Ctx_ffm_did_xxx[1] /end CHARACTERISTIC
/begin CHARACTERISTIC Ctx_ffm_did_sens_mat[2] "" VALUE 0xa002edbc _REC_S1VAL_20_u2 65535. _CNV_A_R_A_165_CM 0. 65535. DISPLAY_IDENTIFIER Pxx_dgdftmng_dtc_sens_mat.Ctx_ffm_did_xxx[2] /end CHARACTERISTIC
/begin CHARACTERISTIC Ctx_ffm_did_sens_mat[3] "" VALUE 0xa002edbe _REC_S1VAL_20_u2 65535. _CNV_A_R_A_165_CM 0. 65535. DISPLAY_IDENTIFIER Pxx_dgdftmng_dtc_sens_mat.Ctx_ffm_did_xxx[3] /end CHARACTERISTIC
/begin CHARACTERISTIC Ctx_ffm_did_sens_mat[4] "" VALUE 0xa002edc0 _REC_S1VAL_20_u2 65535. _CNV_A_R_A_165_CM 0. 65535. DISPLAY_IDENTIFIER Pxx_dgdftmng_dtc_sens_mat.Ctx_ffm_did_xxx[4] /end CHARACTERISTIC
/begin CHARACTERISTIC Cxx_dtc_hmb_sens_mat "" VALUE 0xa002edc2 _REC_S1VAL_20_u2 65535. _CNV_A_R_A_165_CM 0. 65535. DISPLAY_IDENTIFIER Pxx_dgdftmng_dtc_sens_mat.Cxx_dtc_hmb_xxx /end CHARACTERISTIC
/begin CHARACTERISTIC Ctx_ffm_did_sens_spg[0] "" VALUE 0xa002ed70 _REC_S1VAL_20_u2 65535. _CNV_A_R_A_165_CM 0. 65535. DISPLAY_IDENTIFIER Pxx_dgdftmng_dtc_sens_spg.Ctx_ffm_did_xxx[0] /end CHARACTERISTIC
/begin CHARACTERISTIC Ctx_ffm_did_sens_spg[1] "" VALUE 0xa002ed72 _REC_S1VAL_20_u2 65535. _CNV_A_R_A_165_CM 0. 65535. DISPLAY_IDENTIFIER Pxx_dgdftmng_dtc_sens_spg.Ctx_ffm_did_xxx[1] /end CHARACTERISTIC
/begin CHARACTERISTIC Ctx_ffm_did_sens_spg[2] "" VALUE 0xa002ed74 _REC_S1VAL_20_u2 65535. _CNV_A_R_A_165_CM 0. 65535. DISPLAY_IDENTIFIER Pxx_dgdftmng_dtc_sens_spg.Ctx_ffm_did_xxx[2] /end CHARACTERISTIC
/begin CHARACTERISTIC Ctx_ffm_did_sens_spg[3] "" VALUE 0xa002ed76 _REC_S1VAL_20_u2 65535. _CNV_A_R_A_165_CM 0. 65535. DISPLAY_IDENTIFIER Pxx_dgdftmng_dtc_sens_spg.Ctx_ffm_did_xxx[3] /end CHARACTERISTIC
/begin CHARACTERISTIC Ctx_ffm_did_sens_spg[4] "" VALUE 0xa002ed78 _REC_S1VAL_20_u2 65535. _CNV_A_R_A_165_CM 0. 65535. DISPLAY_IDENTIFIER Pxx_dgdftmng_dtc_sens_spg.Ctx_ffm_did_xxx[4] /end CHARACTERISTIC
/begin CHARACTERISTIC Cxx_dtc_hmb_sens_spg "" VALUE 0xa002ed7a _REC_S1VAL_20_u2 65535. _CNV_A_R_A_165_CM 0. 65535. DISPLAY_IDENTIFIER Pxx_dgdftmng_dtc_sens_spg.Cxx_dtc_hmb_xxx /end CHARACTERISTIC
/begin CHARACTERISTIC Ctx_ffm_did_sens_tco[0] "" VALUE 0xa002ed7c _REC_S1VAL_20_u2 65535. _CNV_A_R_A_165_CM 0. 65535. DISPLAY_IDENTIFIER Pxx_dgdftmng_dtc_sens_tco.Ctx_ffm_did_xxx[0] /end CHARACTERISTIC
/begin CHARACTERISTIC Ctx_ffm_did_sens_tco[1] "" VALUE 0xa002ed7e _REC_S1VAL_20_u2 65535. _CNV_A_R_A_165_CM 0. 65535. DISPLAY_IDENTIFIER Pxx_dgdftmng_dtc_sens_tco.Ctx_ffm_did_xxx[1] /end CHARACTERISTIC
/begin CHARACTERISTIC Ctx_ffm_did_sens_tco[2] "" VALUE 0xa002ed80 _REC_S1VAL_20_u2 65535. _CNV_A_R_A_165_CM 0. 65535. DISPLAY_IDENTIFIER Pxx_dgdftmng_dtc_sens_tco.Ctx_ffm_did_xxx[2] /end CHARACTERISTIC
/begin CHARACTERISTIC Ctx_ffm_did_sens_tco[3] "" VALUE 0xa002ed82 _REC_S1VAL_20_u2 65535. _CNV_A_R_A_165_CM 0. 65535. DISPLAY_IDENTIFIER Pxx_dgdftmng_dtc_sens_tco.Ctx_ffm_did_xxx[3] /end CHARACTERISTIC
/begin CHARACTERISTIC Ctx_ffm_did_sens_tco[4] "" VALUE 0xa002ed84 _REC_S1VAL_20_u2 65535. _CNV_A_R_A_165_CM 0. 65535. DISPLAY_IDENTIFIER Pxx_dgdftmng_dtc_sens_tco.Ctx_ffm_did_xxx[4] /end CHARACTERISTIC
/begin CHARACTERISTIC Cxx_dtc_hmb_sens_tco "" VALUE 0xa002ed86 _REC_S1VAL_20_u2 65535. _CNV_A_R_A_165_CM 0. 65535. DISPLAY_IDENTIFIER Pxx_dgdftmng_dtc_sens_tco.Cxx_dtc_hmb_xxx /end CHARACTERISTIC
/begin CHARACTERISTIC Ctx_ffm_did_sfty_tq[0] "" VALUE 0xa002ef20 _REC_S1VAL_20_u2 65535. _CNV_A_R_A_165_CM 0. 65535. DISPLAY_IDENTIFIER Pxx_dgdftmng_dtc_sfty_tq.Ctx_ffm_did_xxx[0] /end CHARACTERISTIC
/begin CHARACTERISTIC Ctx_ffm_did_sfty_tq[1] "" VALUE 0xa002ef22 _REC_S1VAL_20_u2 65535. _CNV_A_R_A_165_CM 0. 65535. DISPLAY_IDENTIFIER Pxx_dgdftmng_dtc_sfty_tq.Ctx_ffm_did_xxx[1] /end CHARACTERISTIC
/begin CHARACTERISTIC Ctx_ffm_did_sfty_tq[2] "" VALUE 0xa002ef24 _REC_S1VAL_20_u2 65535. _CNV_A_R_A_165_CM 0. 65535. DISPLAY_IDENTIFIER Pxx_dgdftmng_dtc_sfty_tq.Ctx_ffm_did_xxx[2] /end CHARACTERISTIC
/begin CHARACTERISTIC Ctx_ffm_did_sfty_tq[3] "" VALUE 0xa002ef26 _REC_S1VAL_20_u2 65535. _CNV_A_R_A_165_CM 0. 65535. DISPLAY_IDENTIFIER Pxx_dgdftmng_dtc_sfty_tq.Ctx_ffm_did_xxx[3] /end CHARACTERISTIC
/begin CHARACTERISTIC Ctx_ffm_did_sfty_tq[4] "" VALUE 0xa002ef28 _REC_S1VAL_20_u2 65535. _CNV_A_R_A_165_CM 0. 65535. DISPLAY_IDENTIFIER Pxx_dgdftmng_dtc_sfty_tq.Ctx_ffm_did_xxx[4] /end CHARACTERISTIC
/begin CHARACTERISTIC Cxx_dtc_hmb_sfty_tq "" VALUE 0xa002ef2a _REC_S1VAL_20_u2 65535. _CNV_A_R_A_165_CM 0. 65535. DISPLAY_IDENTIFIER Pxx_dgdftmng_dtc_sfty_tq.Cxx_dtc_hmb_xxx /end CHARACTERISTIC
/begin CHARACTERISTIC Ctx_ffm_did_spg[0] "" VALUE 0xa002eed8 _REC_S1VAL_20_u2 65535. _CNV_A_R_A_165_CM 0. 65535. DISPLAY_IDENTIFIER Pxx_dgdftmng_dtc_spg.Ctx_ffm_did_xxx[0] /end CHARACTERISTIC
/begin CHARACTERISTIC Ctx_ffm_did_spg[1] "" VALUE 0xa002eeda _REC_S1VAL_20_u2 65535. _CNV_A_R_A_165_CM 0. 65535. DISPLAY_IDENTIFIER Pxx_dgdftmng_dtc_spg.Ctx_ffm_did_xxx[1] /end CHARACTERISTIC
/begin CHARACTERISTIC Ctx_ffm_did_spg[2] "" VALUE 0xa002eedc _REC_S1VAL_20_u2 65535. _CNV_A_R_A_165_CM 0. 65535. DISPLAY_IDENTIFIER Pxx_dgdftmng_dtc_spg.Ctx_ffm_did_xxx[2] /end CHARACTERISTIC
/begin CHARACTERISTIC Ctx_ffm_did_spg[3] "" VALUE 0xa002eede _REC_S1VAL_20_u2 65535. _CNV_A_R_A_165_CM 0. 65535. DISPLAY_IDENTIFIER Pxx_dgdftmng_dtc_spg.Ctx_ffm_did_xxx[3] /end CHARACTERISTIC
/begin CHARACTERISTIC Ctx_ffm_did_spg[4] "" VALUE 0xa002eee0 _REC_S1VAL_20_u2 65535. _CNV_A_R_A_165_CM 0. 65535. DISPLAY_IDENTIFIER Pxx_dgdftmng_dtc_spg.Ctx_ffm_did_xxx[4] /end CHARACTERISTIC
/begin CHARACTERISTIC Cxx_dtc_hmb_spg "" VALUE 0xa002eee2 _REC_S1VAL_20_u2 65535. _CNV_A_R_A_165_CM 0. 65535. DISPLAY_IDENTIFIER Pxx_dgdftmng_dtc_spg.Cxx_dtc_hmb_xxx /end CHARACTERISTIC
/begin CHARACTERISTIC Ctx_ffm_did_spg_reg[0] "" VALUE 0xa002ed88 _REC_S1VAL_20_u2 65535. _CNV_A_R_A_165_CM 0. 65535. DISPLAY_IDENTIFIER Pxx_dgdftmng_dtc_spg_reg.Ctx_ffm_did_xxx[0] /end CHARACTERISTIC
/begin CHARACTERISTIC Ctx_ffm_did_spg_reg[1] "" VALUE 0xa002ed8a _REC_S1VAL_20_u2 65535. _CNV_A_R_A_165_CM 0. 65535. DISPLAY_IDENTIFIER Pxx_dgdftmng_dtc_spg_reg.Ctx_ffm_did_xxx[1] /end CHARACTERISTIC
/begin CHARACTERISTIC Ctx_ffm_did_spg_reg[2] "" VALUE 0xa002ed8c _REC_S1VAL_20_u2 65535. _CNV_A_R_A_165_CM 0. 65535. DISPLAY_IDENTIFIER Pxx_dgdftmng_dtc_spg_reg.Ctx_ffm_did_xxx[2] /end CHARACTERISTIC
/begin CHARACTERISTIC Ctx_ffm_did_spg_reg[3] "" VALUE 0xa002ed8e _REC_S1VAL_20_u2 65535. _CNV_A_R_A_165_CM 0. 65535. DISPLAY_IDENTIFIER Pxx_dgdftmng_dtc_spg_reg.Ctx_ffm_did_xxx[3] /end CHARACTERISTIC
/begin CHARACTERISTIC Ctx_ffm_did_spg_reg[4] "" VALUE 0xa002ed90 _REC_S1VAL_20_u2 65535. _CNV_A_R_A_165_CM 0. 65535. DISPLAY_IDENTIFIER Pxx_dgdftmng_dtc_spg_reg.Ctx_ffm_did_xxx[4] /end CHARACTERISTIC
/begin CHARACTERISTIC Cxx_dtc_hmb_spg_reg "" VALUE 0xa002ed92 _REC_S1VAL_20_u2 65535. _CNV_A_R_A_165_CM 0. 65535. DISPLAY_IDENTIFIER Pxx_dgdftmng_dtc_spg_reg.Cxx_dtc_hmb_xxx /end CHARACTERISTIC
/begin CHARACTERISTIC Ctx_ffm_did_tlz_ad_b[0] "" VALUE 0xa002eee4 _REC_S1VAL_20_u2 65535. _CNV_A_R_A_165_CM 0. 65535. DISPLAY_IDENTIFIER Pxx_dgdftmng_dtc_tlz_ad_b.Ctx_ffm_did_xxx[0] /end CHARACTERISTIC
/begin CHARACTERISTIC Ctx_ffm_did_tlz_ad_b[1] "" VALUE 0xa002eee6 _REC_S1VAL_20_u2 65535. _CNV_A_R_A_165_CM 0. 65535. DISPLAY_IDENTIFIER Pxx_dgdftmng_dtc_tlz_ad_b.Ctx_ffm_did_xxx[1] /end CHARACTERISTIC
/begin CHARACTERISTIC Ctx_ffm_did_tlz_ad_b[2] "" VALUE 0xa002eee8 _REC_S1VAL_20_u2 65535. _CNV_A_R_A_165_CM 0. 65535. DISPLAY_IDENTIFIER Pxx_dgdftmng_dtc_tlz_ad_b.Ctx_ffm_did_xxx[2] /end CHARACTERISTIC
/begin CHARACTERISTIC Ctx_ffm_did_tlz_ad_b[3] "" VALUE 0xa002eeea _REC_S1VAL_20_u2 65535. _CNV_A_R_A_165_CM 0. 65535. DISPLAY_IDENTIFIER Pxx_dgdftmng_dtc_tlz_ad_b.Ctx_ffm_did_xxx[3] /end CHARACTERISTIC
/begin CHARACTERISTIC Ctx_ffm_did_tlz_ad_b[4] "" VALUE 0xa002eeec _REC_S1VAL_20_u2 65535. _CNV_A_R_A_165_CM 0. 65535. DISPLAY_IDENTIFIER Pxx_dgdftmng_dtc_tlz_ad_b.Ctx_ffm_did_xxx[4] /end CHARACTERISTIC
/begin CHARACTERISTIC Cxx_dtc_hmb_tlz_ad_b "" VALUE 0xa002eeee _REC_S1VAL_20_u2 65535. _CNV_A_R_A_165_CM 0. 65535. DISPLAY_IDENTIFIER Pxx_dgdftmng_dtc_tlz_ad_b.Cxx_dtc_hmb_xxx /end CHARACTERISTIC
/begin CHARACTERISTIC Ctx_ffm_did_vb[0] "" VALUE 0xa002ed94 _REC_S1VAL_20_u2 65535. _CNV_A_R_A_165_CM 0. 65535. DISPLAY_IDENTIFIER Pxx_dgdftmng_dtc_vb.Ctx_ffm_did_xxx[0] /end CHARACTERISTIC
/begin CHARACTERISTIC Ctx_ffm_did_vb[1] "" VALUE 0xa002ed96 _REC_S1VAL_20_u2 65535. _CNV_A_R_A_165_CM 0. 65535. DISPLAY_IDENTIFIER Pxx_dgdftmng_dtc_vb.Ctx_ffm_did_xxx[1] /end CHARACTERISTIC
/begin CHARACTERISTIC Ctx_ffm_did_vb[2] "" VALUE 0xa002ed98 _REC_S1VAL_20_u2 65535. _CNV_A_R_A_165_CM 0. 65535. DISPLAY_IDENTIFIER Pxx_dgdftmng_dtc_vb.Ctx_ffm_did_xxx[2] /end CHARACTERISTIC
/begin CHARACTERISTIC Ctx_ffm_did_vb[3] "" VALUE 0xa002ed9a _REC_S1VAL_20_u2 65535. _CNV_A_R_A_165_CM 0. 65535. DISPLAY_IDENTIFIER Pxx_dgdftmng_dtc_vb.Ctx_ffm_did_xxx[3] /end CHARACTERISTIC
/begin CHARACTERISTIC Ctx_ffm_did_vb[4] "" VALUE 0xa002ed9c _REC_S1VAL_20_u2 65535. _CNV_A_R_A_165_CM 0. 65535. DISPLAY_IDENTIFIER Pxx_dgdftmng_dtc_vb.Ctx_ffm_did_xxx[4] /end CHARACTERISTIC
/begin CHARACTERISTIC Cxx_dtc_hmb_vb "" VALUE 0xa002ed9e _REC_S1VAL_20_u2 65535. _CNV_A_R_A_165_CM 0. 65535. DISPLAY_IDENTIFIER Pxx_dgdftmng_dtc_vb.Cxx_dtc_hmb_xxx /end CHARACTERISTIC
/begin CHARACTERISTIC Ctx_ffm_did_vb_rly[0] "" VALUE 0xa002eda0 _REC_S1VAL_20_u2 65535. _CNV_A_R_A_165_CM 0. 65535. DISPLAY_IDENTIFIER Pxx_dgdftmng_dtc_vb_rly.Ctx_ffm_did_xxx[0] /end CHARACTERISTIC
/begin CHARACTERISTIC Ctx_ffm_did_vb_rly[1] "" VALUE 0xa002eda2 _REC_S1VAL_20_u2 65535. _CNV_A_R_A_165_CM 0. 65535. DISPLAY_IDENTIFIER Pxx_dgdftmng_dtc_vb_rly.Ctx_ffm_did_xxx[1] /end CHARACTERISTIC
/begin CHARACTERISTIC Ctx_ffm_did_vb_rly[2] "" VALUE 0xa002eda4 _REC_S1VAL_20_u2 65535. _CNV_A_R_A_165_CM 0. 65535. DISPLAY_IDENTIFIER Pxx_dgdftmng_dtc_vb_rly.Ctx_ffm_did_xxx[2] /end CHARACTERISTIC
/begin CHARACTERISTIC Ctx_ffm_did_vb_rly[3] "" VALUE 0xa002eda6 _REC_S1VAL_20_u2 65535. _CNV_A_R_A_165_CM 0. 65535. DISPLAY_IDENTIFIER Pxx_dgdftmng_dtc_vb_rly.Ctx_ffm_did_xxx[3] /end CHARACTERISTIC
/begin CHARACTERISTIC Ctx_ffm_did_vb_rly[4] "" VALUE 0xa002eda8 _REC_S1VAL_20_u2 65535. _CNV_A_R_A_165_CM 0. 65535. DISPLAY_IDENTIFIER Pxx_dgdftmng_dtc_vb_rly.Ctx_ffm_did_xxx[4] /end CHARACTERISTIC
/begin CHARACTERISTIC Cxx_dtc_hmb_vb_rly "" VALUE 0xa002edaa _REC_S1VAL_20_u2 65535. _CNV_A_R_A_165_CM 0. 65535. DISPLAY_IDENTIFIER Pxx_dgdftmng_dtc_vb_rly.Cxx_dtc_hmb_xxx /end CHARACTERISTIC
/begin CHARACTERISTIC Ctx_ffm_did_wgc[0] "" VALUE 0xa002eef0 _REC_S1VAL_20_u2 65535. _CNV_A_R_A_165_CM 0. 65535. DISPLAY_IDENTIFIER Pxx_dgdftmng_dtc_wgc.Ctx_ffm_did_xxx[0] /end CHARACTERISTIC
/begin CHARACTERISTIC Ctx_ffm_did_wgc[1] "" VALUE 0xa002eef2 _REC_S1VAL_20_u2 65535. _CNV_A_R_A_165_CM 0. 65535. DISPLAY_IDENTIFIER Pxx_dgdftmng_dtc_wgc.Ctx_ffm_did_xxx[1] /end CHARACTERISTIC
/begin CHARACTERISTIC Ctx_ffm_did_wgc[2] "" VALUE 0xa002eef4 _REC_S1VAL_20_u2 65535. _CNV_A_R_A_165_CM 0. 65535. DISPLAY_IDENTIFIER Pxx_dgdftmng_dtc_wgc.Ctx_ffm_did_xxx[2] /end CHARACTERISTIC
/begin CHARACTERISTIC Ctx_ffm_did_wgc[3] "" VALUE 0xa002eef6 _REC_S1VAL_20_u2 65535. _CNV_A_R_A_165_CM 0. 65535. DISPLAY_IDENTIFIER Pxx_dgdftmng_dtc_wgc.Ctx_ffm_did_xxx[3] /end CHARACTERISTIC
/begin CHARACTERISTIC Ctx_ffm_did_wgc[4] "" VALUE 0xa002eef8 _REC_S1VAL_20_u2 65535. _CNV_A_R_A_165_CM 0. 65535. DISPLAY_IDENTIFIER Pxx_dgdftmng_dtc_wgc.Ctx_ffm_did_xxx[4] /end CHARACTERISTIC
/begin CHARACTERISTIC Cxx_dtc_hmb_wgc "" VALUE 0xa002eefa _REC_S1VAL_20_u2 65535. _CNV_A_R_A_165_CM 0. 65535. DISPLAY_IDENTIFIER Pxx_dgdftmng_dtc_wgc.Cxx_dtc_hmb_xxx /end CHARACTERISTIC
/begin CHARACTERISTIC Ctx_ffm_did_wpmp_tcr[0] "" VALUE 0xa002eefc _REC_S1VAL_20_u2 65535. _CNV_A_R_A_165_CM 0. 65535. DISPLAY_IDENTIFIER Pxx_dgdftmng_dtc_wpmp_tcr.Ctx_ffm_did_xxx[0] /end CHARACTERISTIC
/begin CHARACTERISTIC Ctx_ffm_did_wpmp_tcr[1] "" VALUE 0xa002eefe _REC_S1VAL_20_u2 65535. _CNV_A_R_A_165_CM 0. 65535. DISPLAY_IDENTIFIER Pxx_dgdftmng_dtc_wpmp_tcr.Ctx_ffm_did_xxx[1] /end CHARACTERISTIC
/begin CHARACTERISTIC Ctx_ffm_did_wpmp_tcr[2] "" VALUE 0xa002ef00 _REC_S1VAL_20_u2 65535. _CNV_A_R_A_165_CM 0. 65535. DISPLAY_IDENTIFIER Pxx_dgdftmng_dtc_wpmp_tcr.Ctx_ffm_did_xxx[2] /end CHARACTERISTIC
/begin CHARACTERISTIC Ctx_ffm_did_wpmp_tcr[3] "" VALUE 0xa002ef02 _REC_S1VAL_20_u2 65535. _CNV_A_R_A_165_CM 0. 65535. DISPLAY_IDENTIFIER Pxx_dgdftmng_dtc_wpmp_tcr.Ctx_ffm_did_xxx[3] /end CHARACTERISTIC
/begin CHARACTERISTIC Ctx_ffm_did_wpmp_tcr[4] "" VALUE 0xa002ef04 _REC_S1VAL_20_u2 65535. _CNV_A_R_A_165_CM 0. 65535. DISPLAY_IDENTIFIER Pxx_dgdftmng_dtc_wpmp_tcr.Ctx_ffm_did_xxx[4] /end CHARACTERISTIC
/begin CHARACTERISTIC Cxx_dtc_hmb_wpmp_tcr "" VALUE 0xa002ef06 _REC_S1VAL_20_u2 65535. _CNV_A_R_A_165_CM 0. 65535. DISPLAY_IDENTIFIER Pxx_dgdftmng_dtc_wpmp_tcr.Cxx_dtc_hmb_xxx /end CHARACTERISTIC
/begin CHARACTERISTIC Cxx_conf_wal_ac_prs_h "" VALUE 0xa002efc4 _REC_S1VAL_20_u1 3. _CNV_A_R_A_165_CM 0. 3. DISPLAY_IDENTIFIER fm_cal_ac_prs_h.fm_static_bitfield.Cxx_conf_wal_xxx BIT_MASK 0x3 /end CHARACTERISTIC
/begin CHARACTERISTIC Cxx_dtc_lb_ac_prs_h "" VALUE 0xa002efc5 _REC_S1VAL_20_u1 255. _CNV_A_R_A_165_CM 0. 255. DISPLAY_IDENTIFIER fm_cal_ac_prs_h.Cxx_dtc_lb_xxx /end CHARACTERISTIC
/begin CHARACTERISTIC Cxx_conf_wal_ac_prs_l "" VALUE 0xa002efd0 _REC_S1VAL_20_u1 3. _CNV_A_R_A_165_CM 0. 3. DISPLAY_IDENTIFIER fm_cal_ac_prs_l.fm_static_bitfield.Cxx_conf_wal_xxx BIT_MASK 0x3 /end CHARACTERISTIC
/begin CHARACTERISTIC Cxx_dtc_lb_ac_prs_l "" VALUE 0xa002efd1 _REC_S1VAL_20_u1 255. _CNV_A_R_A_165_CM 0. 255. DISPLAY_IDENTIFIER fm_cal_ac_prs_l.Cxx_dtc_lb_xxx /end CHARACTERISTIC
/begin CHARACTERISTIC Cxx_dtc_obd_acel_pdl_chr "" VALUE 0xa002efda _REC_S1VAL_20_u2 65535. _CNV_A_R_A_165_CM 0. 65535. DISPLAY_IDENTIFIER fm_cal_acel_pdl_chr.Cxx_dtc_obd_xxx /end CHARACTERISTIC
/begin CHARACTERISTIC Cxx_conf_wal_acel_pdl_chr "" VALUE 0xa002efdc _REC_S1VAL_20_u1 3. _CNV_A_R_A_165_CM 0. 3. DISPLAY_IDENTIFIER fm_cal_acel_pdl_chr.fm_static_bitfield.Cxx_conf_wal_xxx BIT_MASK 0x3 /end CHARACTERISTIC
/begin CHARACTERISTIC Cbx_obd_acel_pdl_chr "" VALUE 0xa002efdc _REC_S1VAL_20_u1 255. _CNV_A_R_A_165_CM 0. 255. DISPLAY_IDENTIFIER fm_cal_acel_pdl_chr.fm_static_bitfield.Cbx_obd_xxx BIT_MASK 0x4 /end CHARACTERISTIC
/begin CHARACTERISTIC Cbx_obd_mena_acel_pdl_chr "" VALUE 0xa002efdc _REC_S1VAL_20_u1 255. _CNV_A_R_A_165_CM 0. 255. DISPLAY_IDENTIFIER fm_cal_acel_pdl_chr.fm_static_bitfield.Cbx_obd_mena_xxx BIT_MASK 0x8 /end CHARACTERISTIC
/begin CHARACTERISTIC Cxx_dtc_lb_acel_pdl_chr "" VALUE 0xa002efdd _REC_S1VAL_20_u1 255. _CNV_A_R_A_165_CM 0. 255. DISPLAY_IDENTIFIER fm_cal_acel_pdl_chr.Cxx_dtc_lb_xxx /end CHARACTERISTIC
/begin CHARACTERISTIC Cxx_obd_dc_acel_pdl_chr "" VALUE 0xa002efde _REC_S1VAL_20_u1 9. _CNV_A_R_A_165_CM 1. 10. DISPLAY_IDENTIFIER fm_cal_acel_pdl_chr.Cxx_obd_dc_xxx /end CHARACTERISTIC
/begin CHARACTERISTIC Cxx_dtc_obd_acel_pdl_secu_1 "" VALUE 0xa002efe6 _REC_S1VAL_20_u2 65535. _CNV_A_R_A_165_CM 0. 65535. DISPLAY_IDENTIFIER fm_cal_acel_pdl_secu_1.Cxx_dtc_obd_xxx /end CHARACTERISTIC
/begin CHARACTERISTIC Cxx_conf_wal_acel_pdl_secu_1 "" VALUE 0xa002efe8 _REC_S1VAL_20_u1 3. _CNV_A_R_A_165_CM 0. 3. DISPLAY_IDENTIFIER fm_cal_acel_pdl_secu_1.fm_static_bitfield.Cxx_conf_wal_xxx BIT_MASK 0x3 /end CHARACTERISTIC
/begin CHARACTERISTIC Cbx_obd_acel_pdl_secu_1 "" VALUE 0xa002efe8 _REC_S1VAL_20_u1 255. _CNV_A_R_A_165_CM 0. 255. DISPLAY_IDENTIFIER fm_cal_acel_pdl_secu_1.fm_static_bitfield.Cbx_obd_xxx BIT_MASK 0x4 /end CHARACTERISTIC
/begin CHARACTERISTIC Cbx_obd_mena_acel_pdl_secu_1 "" VALUE 0xa002efe8 _REC_S1VAL_20_u1 255. _CNV_A_R_A_165_CM 0. 255. DISPLAY_IDENTIFIER fm_cal_acel_pdl_secu_1.fm_static_bitfield.Cbx_obd_mena_xxx BIT_MASK 0x8 /end CHARACTERISTIC
/begin CHARACTERISTIC Cxx_dtc_lb_acel_pdl_secu_1 "" VALUE 0xa002efe9 _REC_S1VAL_20_u1 255. _CNV_A_R_A_165_CM 0. 255. DISPLAY_IDENTIFIER fm_cal_acel_pdl_secu_1.Cxx_dtc_lb_xxx /end CHARACTERISTIC
/begin CHARACTERISTIC Cxx_obd_dc_acel_pdl_secu_1 "" VALUE 0xa002efea _REC_S1VAL_20_u1 9. _CNV_A_R_A_165_CM 1. 10. DISPLAY_IDENTIFIER fm_cal_acel_pdl_secu_1.Cxx_obd_dc_xxx /end CHARACTERISTIC
/begin CHARACTERISTIC Cxx_dtc_obd_acel_pdl_secu_2 "" VALUE 0xa002eff2 _REC_S1VAL_20_u2 65535. _CNV_A_R_A_165_CM 0. 65535. DISPLAY_IDENTIFIER fm_cal_acel_pdl_secu_2.Cxx_dtc_obd_xxx /end CHARACTERISTIC
/begin CHARACTERISTIC Cxx_conf_wal_acel_pdl_secu_2 "" VALUE 0xa002eff4 _REC_S1VAL_20_u1 3. _CNV_A_R_A_165_CM 0. 3. DISPLAY_IDENTIFIER fm_cal_acel_pdl_secu_2.fm_static_bitfield.Cxx_conf_wal_xxx BIT_MASK 0x3 /end CHARACTERISTIC
/begin CHARACTERISTIC Cbx_obd_acel_pdl_secu_2 "" VALUE 0xa002eff4 _REC_S1VAL_20_u1 255. _CNV_A_R_A_165_CM 0. 255. DISPLAY_IDENTIFIER fm_cal_acel_pdl_secu_2.fm_static_bitfield.Cbx_obd_xxx BIT_MASK 0x4 /end CHARACTERISTIC
/begin CHARACTERISTIC Cbx_obd_mena_acel_pdl_secu_2 "" VALUE 0xa002eff4 _REC_S1VAL_20_u1 255. _CNV_A_R_A_165_CM 0. 255. DISPLAY_IDENTIFIER fm_cal_acel_pdl_secu_2.fm_static_bitfield.Cbx_obd_mena_xxx BIT_MASK 0x8 /end CHARACTERISTIC
/begin CHARACTERISTIC Cxx_dtc_lb_acel_pdl_secu_2 "" VALUE 0xa002eff5 _REC_S1VAL_20_u1 255. _CNV_A_R_A_165_CM 0. 255. DISPLAY_IDENTIFIER fm_cal_acel_pdl_secu_2.Cxx_dtc_lb_xxx /end CHARACTERISTIC
/begin CHARACTERISTIC Cxx_obd_dc_acel_pdl_secu_2 "" VALUE 0xa002eff6 _REC_S1VAL_20_u1 9. _CNV_A_R_A_165_CM 1. 10. DISPLAY_IDENTIFIER fm_cal_acel_pdl_secu_2.Cxx_obd_dc_xxx /end CHARACTERISTIC
/begin CHARACTERISTIC Cxx_dtc_obd_acel_pdl_tot "" VALUE 0xa002effe _REC_S1VAL_20_u2 65535. _CNV_A_R_A_165_CM 0. 65535. DISPLAY_IDENTIFIER fm_cal_acel_pdl_tot.Cxx_dtc_obd_xxx /end CHARACTERISTIC
/begin CHARACTERISTIC Cxx_conf_wal_acel_pdl_tot "" VALUE 0xa002f000 _REC_S1VAL_20_u1 3. _CNV_A_R_A_165_CM 0. 3. DISPLAY_IDENTIFIER fm_cal_acel_pdl_tot.fm_static_bitfield.Cxx_conf_wal_xxx BIT_MASK 0x3 /end CHARACTERISTIC
/begin CHARACTERISTIC Cbx_obd_acel_pdl_tot "" VALUE 0xa002f000 _REC_S1VAL_20_u1 255. _CNV_A_R_A_165_CM 0. 255. DISPLAY_IDENTIFIER fm_cal_acel_pdl_tot.fm_static_bitfield.Cbx_obd_xxx BIT_MASK 0x4 /end CHARACTERISTIC
/begin CHARACTERISTIC Cbx_obd_mena_acel_pdl_tot "" VALUE 0xa002f000 _REC_S1VAL_20_u1 255. _CNV_A_R_A_165_CM 0. 255. DISPLAY_IDENTIFIER fm_cal_acel_pdl_tot.fm_static_bitfield.Cbx_obd_mena_xxx BIT_MASK 0x8 /end CHARACTERISTIC
/begin CHARACTERISTIC Cxx_dtc_lb_acel_pdl_tot "" VALUE 0xa002f001 _REC_S1VAL_20_u1 255. _CNV_A_R_A_165_CM 0. 255. DISPLAY_IDENTIFIER fm_cal_acel_pdl_tot.Cxx_dtc_lb_xxx /end CHARACTERISTIC
/begin CHARACTERISTIC Cxx_obd_dc_acel_pdl_tot "" VALUE 0xa002f002 _REC_S1VAL_20_u1 9. _CNV_A_R_A_165_CM 1. 10. DISPLAY_IDENTIFIER fm_cal_acel_pdl_tot.Cxx_obd_dc_xxx /end CHARACTERISTIC
/begin CHARACTERISTIC Cxx_dtc_obd_acel_pdl_v1_h "" VALUE 0xa002f00a _REC_S1VAL_20_u2 65535. _CNV_A_R_A_165_CM 0. 65535. DISPLAY_IDENTIFIER fm_cal_acel_pdl_v1_h.Cxx_dtc_obd_xxx /end CHARACTERISTIC
/begin CHARACTERISTIC Cxx_conf_wal_acel_pdl_v1_h "" VALUE 0xa002f00c _REC_S1VAL_20_u1 3. _CNV_A_R_A_165_CM 0. 3. DISPLAY_IDENTIFIER fm_cal_acel_pdl_v1_h.fm_static_bitfield.Cxx_conf_wal_xxx BIT_MASK 0x3 /end CHARACTERISTIC
/begin CHARACTERISTIC Cbx_obd_acel_pdl_v1_h "" VALUE 0xa002f00c _REC_S1VAL_20_u1 255. _CNV_A_R_A_165_CM 0. 255. DISPLAY_IDENTIFIER fm_cal_acel_pdl_v1_h.fm_static_bitfield.Cbx_obd_xxx BIT_MASK 0x4 /end CHARACTERISTIC
/begin CHARACTERISTIC Cbx_obd_mena_acel_pdl_v1_h "" VALUE 0xa002f00c _REC_S1VAL_20_u1 255. _CNV_A_R_A_165_CM 0. 255. DISPLAY_IDENTIFIER fm_cal_acel_pdl_v1_h.fm_static_bitfield.Cbx_obd_mena_xxx BIT_MASK 0x8 /end CHARACTERISTIC
/begin CHARACTERISTIC Cxx_dtc_lb_acel_pdl_v1_h "" VALUE 0xa002f00d _REC_S1VAL_20_u1 255. _CNV_A_R_A_165_CM 0. 255. DISPLAY_IDENTIFIER fm_cal_acel_pdl_v1_h.Cxx_dtc_lb_xxx /end CHARACTERISTIC
/begin CHARACTERISTIC Cxx_obd_dc_acel_pdl_v1_h "" VALUE 0xa002f00e _REC_S1VAL_20_u1 9. _CNV_A_R_A_165_CM 1. 10. DISPLAY_IDENTIFIER fm_cal_acel_pdl_v1_h.Cxx_obd_dc_xxx /end CHARACTERISTIC
/begin CHARACTERISTIC Cxx_dtc_obd_acel_pdl_v1_l "" VALUE 0xa002f016 _REC_S1VAL_20_u2 65535. _CNV_A_R_A_165_CM 0. 65535. DISPLAY_IDENTIFIER fm_cal_acel_pdl_v1_l.Cxx_dtc_obd_xxx /end CHARACTERISTIC
/begin CHARACTERISTIC Cxx_conf_wal_acel_pdl_v1_l "" VALUE 0xa002f018 _REC_S1VAL_20_u1 3. _CNV_A_R_A_165_CM 0. 3. DISPLAY_IDENTIFIER fm_cal_acel_pdl_v1_l.fm_static_bitfield.Cxx_conf_wal_xxx BIT_MASK 0x3 /end CHARACTERISTIC
/begin CHARACTERISTIC Cbx_obd_acel_pdl_v1_l "" VALUE 0xa002f018 _REC_S1VAL_20_u1 255. _CNV_A_R_A_165_CM 0. 255. DISPLAY_IDENTIFIER fm_cal_acel_pdl_v1_l.fm_static_bitfield.Cbx_obd_xxx BIT_MASK 0x4 /end CHARACTERISTIC
/begin CHARACTERISTIC Cbx_obd_mena_acel_pdl_v1_l "" VALUE 0xa002f018 _REC_S1VAL_20_u1 255. _CNV_A_R_A_165_CM 0. 255. DISPLAY_IDENTIFIER fm_cal_acel_pdl_v1_l.fm_static_bitfield.Cbx_obd_mena_xxx BIT_MASK 0x8 /end CHARACTERISTIC
/begin CHARACTERISTIC Cxx_dtc_lb_acel_pdl_v1_l "" VALUE 0xa002f019 _REC_S1VAL_20_u1 255. _CNV_A_R_A_165_CM 0. 255. DISPLAY_IDENTIFIER fm_cal_acel_pdl_v1_l.Cxx_dtc_lb_xxx /end CHARACTERISTIC
/begin CHARACTERISTIC Cxx_obd_dc_acel_pdl_v1_l "" VALUE 0xa002f01a _REC_S1VAL_20_u1 9. _CNV_A_R_A_165_CM 1. 10. DISPLAY_IDENTIFIER fm_cal_acel_pdl_v1_l.Cxx_obd_dc_xxx /end CHARACTERISTIC
/begin CHARACTERISTIC Cxx_dtc_obd_acel_pdl_v2_h "" VALUE 0xa002f022 _REC_S1VAL_20_u2 65535. _CNV_A_R_A_165_CM 0. 65535. DISPLAY_IDENTIFIER fm_cal_acel_pdl_v2_h.Cxx_dtc_obd_xxx /end CHARACTERISTIC
/begin CHARACTERISTIC Cxx_conf_wal_acel_pdl_v2_h "" VALUE 0xa002f024 _REC_S1VAL_20_u1 3. _CNV_A_R_A_165_CM 0. 3. DISPLAY_IDENTIFIER fm_cal_acel_pdl_v2_h.fm_static_bitfield.Cxx_conf_wal_xxx BIT_MASK 0x3 /end CHARACTERISTIC
/begin CHARACTERISTIC Cbx_obd_acel_pdl_v2_h "" VALUE 0xa002f024 _REC_S1VAL_20_u1 255. _CNV_A_R_A_165_CM 0. 255. DISPLAY_IDENTIFIER fm_cal_acel_pdl_v2_h.fm_static_bitfield.Cbx_obd_xxx BIT_MASK 0x4 /end CHARACTERISTIC
/begin CHARACTERISTIC Cbx_obd_mena_acel_pdl_v2_h "" VALUE 0xa002f024 _REC_S1VAL_20_u1 255. _CNV_A_R_A_165_CM 0. 255. DISPLAY_IDENTIFIER fm_cal_acel_pdl_v2_h.fm_static_bitfield.Cbx_obd_mena_xxx BIT_MASK 0x8 /end CHARACTERISTIC
/begin CHARACTERISTIC Cxx_dtc_lb_acel_pdl_v2_h "" VALUE 0xa002f025 _REC_S1VAL_20_u1 255. _CNV_A_R_A_165_CM 0. 255. DISPLAY_IDENTIFIER fm_cal_acel_pdl_v2_h.Cxx_dtc_lb_xxx /end CHARACTERISTIC
/begin CHARACTERISTIC Cxx_obd_dc_acel_pdl_v2_h "" VALUE 0xa002f026 _REC_S1VAL_20_u1 9. _CNV_A_R_A_165_CM 1. 10. DISPLAY_IDENTIFIER fm_cal_acel_pdl_v2_h.Cxx_obd_dc_xxx /end CHARACTERISTIC
/begin CHARACTERISTIC Cxx_dtc_obd_acel_pdl_v2_l "" VALUE 0xa002f02e _REC_S1VAL_20_u2 65535. _CNV_A_R_A_165_CM 0. 65535. DISPLAY_IDENTIFIER fm_cal_acel_pdl_v2_l.Cxx_dtc_obd_xxx /end CHARACTERISTIC
/begin CHARACTERISTIC Cxx_conf_wal_acel_pdl_v2_l "" VALUE 0xa002f030 _REC_S1VAL_20_u1 3. _CNV_A_R_A_165_CM 0. 3. DISPLAY_IDENTIFIER fm_cal_acel_pdl_v2_l.fm_static_bitfield.Cxx_conf_wal_xxx BIT_MASK 0x3 /end CHARACTERISTIC
/begin CHARACTERISTIC Cbx_obd_acel_pdl_v2_l "" VALUE 0xa002f030 _REC_S1VAL_20_u1 255. _CNV_A_R_A_165_CM 0. 255. DISPLAY_IDENTIFIER fm_cal_acel_pdl_v2_l.fm_static_bitfield.Cbx_obd_xxx BIT_MASK 0x4 /end CHARACTERISTIC
/begin CHARACTERISTIC Cbx_obd_mena_acel_pdl_v2_l "" VALUE 0xa002f030 _REC_S1VAL_20_u1 255. _CNV_A_R_A_165_CM 0. 255. DISPLAY_IDENTIFIER fm_cal_acel_pdl_v2_l.fm_static_bitfield.Cbx_obd_mena_xxx BIT_MASK 0x8 /end CHARACTERISTIC
/begin CHARACTERISTIC Cxx_dtc_lb_acel_pdl_v2_l "" VALUE 0xa002f031 _REC_S1VAL_20_u1 255. _CNV_A_R_A_165_CM 0. 255. DISPLAY_IDENTIFIER fm_cal_acel_pdl_v2_l.Cxx_dtc_lb_xxx /end CHARACTERISTIC
/begin CHARACTERISTIC Cxx_obd_dc_acel_pdl_v2_l "" VALUE 0xa002f032 _REC_S1VAL_20_u1 9. _CNV_A_R_A_165_CM 1. 10. DISPLAY_IDENTIFIER fm_cal_acel_pdl_v2_l.Cxx_obd_dc_xxx /end CHARACTERISTIC
/begin CHARACTERISTIC Cxx_dtc_obd_actr_rly_oc "" VALUE 0xa002f03a _REC_S1VAL_20_u2 65535. _CNV_A_R_A_165_CM 0. 65535. DISPLAY_IDENTIFIER fm_cal_actr_rly_oc.Cxx_dtc_obd_xxx /end CHARACTERISTIC
/begin CHARACTERISTIC Cxx_conf_wal_actr_rly_oc "" VALUE 0xa002f03c _REC_S1VAL_20_u1 3. _CNV_A_R_A_165_CM 0. 3. DISPLAY_IDENTIFIER fm_cal_actr_rly_oc.fm_static_bitfield.Cxx_conf_wal_xxx BIT_MASK 0x3 /end CHARACTERISTIC
/begin CHARACTERISTIC Cbx_obd_actr_rly_oc "" VALUE 0xa002f03c _REC_S1VAL_20_u1 255. _CNV_A_R_A_165_CM 0. 255. DISPLAY_IDENTIFIER fm_cal_actr_rly_oc.fm_static_bitfield.Cbx_obd_xxx BIT_MASK 0x4 /end CHARACTERISTIC
/begin CHARACTERISTIC Cbx_obd_mena_actr_rly_oc "" VALUE 0xa002f03c _REC_S1VAL_20_u1 255. _CNV_A_R_A_165_CM 0. 255. DISPLAY_IDENTIFIER fm_cal_actr_rly_oc.fm_static_bitfield.Cbx_obd_mena_xxx BIT_MASK 0x8 /end CHARACTERISTIC
/begin CHARACTERISTIC Cxx_dtc_lb_actr_rly_oc "" VALUE 0xa002f03d _REC_S1VAL_20_u1 255. _CNV_A_R_A_165_CM 0. 255. DISPLAY_IDENTIFIER fm_cal_actr_rly_oc.Cxx_dtc_lb_xxx /end CHARACTERISTIC
/begin CHARACTERISTIC Cxx_obd_dc_actr_rly_oc "" VALUE 0xa002f03e _REC_S1VAL_20_u1 9. _CNV_A_R_A_165_CM 1. 10. DISPLAY_IDENTIFIER fm_cal_actr_rly_oc.Cxx_obd_dc_xxx /end CHARACTERISTIC
/begin CHARACTERISTIC Cxx_dtc_obd_actr_rly_scg "" VALUE 0xa002f046 _REC_S1VAL_20_u2 65535. _CNV_A_R_A_165_CM 0. 65535. DISPLAY_IDENTIFIER fm_cal_actr_rly_scg.Cxx_dtc_obd_xxx /end CHARACTERISTIC
/begin CHARACTERISTIC Cxx_conf_wal_actr_rly_scg "" VALUE 0xa002f048 _REC_S1VAL_20_u1 3. _CNV_A_R_A_165_CM 0. 3. DISPLAY_IDENTIFIER fm_cal_actr_rly_scg.fm_static_bitfield.Cxx_conf_wal_xxx BIT_MASK 0x3 /end CHARACTERISTIC
/begin CHARACTERISTIC Cbx_obd_actr_rly_scg "" VALUE 0xa002f048 _REC_S1VAL_20_u1 255. _CNV_A_R_A_165_CM 0. 255. DISPLAY_IDENTIFIER fm_cal_actr_rly_scg.fm_static_bitfield.Cbx_obd_xxx BIT_MASK 0x4 /end CHARACTERISTIC
/begin CHARACTERISTIC Cbx_obd_mena_actr_rly_scg "" VALUE 0xa002f048 _REC_S1VAL_20_u1 255. _CNV_A_R_A_165_CM 0. 255. DISPLAY_IDENTIFIER fm_cal_actr_rly_scg.fm_static_bitfield.Cbx_obd_mena_xxx BIT_MASK 0x8 /end CHARACTERISTIC
/begin CHARACTERISTIC Cxx_dtc_lb_actr_rly_scg "" VALUE 0xa002f049 _REC_S1VAL_20_u1 255. _CNV_A_R_A_165_CM 0. 255. DISPLAY_IDENTIFIER fm_cal_actr_rly_scg.Cxx_dtc_lb_xxx /end CHARACTERISTIC
/begin CHARACTERISTIC Cxx_obd_dc_actr_rly_scg "" VALUE 0xa002f04a _REC_S1VAL_20_u1 9. _CNV_A_R_A_165_CM 1. 10. DISPLAY_IDENTIFIER fm_cal_actr_rly_scg.Cxx_obd_dc_xxx /end CHARACTERISTIC
/begin CHARACTERISTIC Cxx_dtc_obd_actr_rly_scw "" VALUE 0xa002f052 _REC_S1VAL_20_u2 65535. _CNV_A_R_A_165_CM 0. 65535. DISPLAY_IDENTIFIER fm_cal_actr_rly_scw.Cxx_dtc_obd_xxx /end CHARACTERISTIC
/begin CHARACTERISTIC Cxx_conf_wal_actr_rly_scw "" VALUE 0xa002f054 _REC_S1VAL_20_u1 3. _CNV_A_R_A_165_CM 0. 3. DISPLAY_IDENTIFIER fm_cal_actr_rly_scw.fm_static_bitfield.Cxx_conf_wal_xxx BIT_MASK 0x3 /end CHARACTERISTIC
/begin CHARACTERISTIC Cbx_obd_actr_rly_scw "" VALUE 0xa002f054 _REC_S1VAL_20_u1 255. _CNV_A_R_A_165_CM 0. 255. DISPLAY_IDENTIFIER fm_cal_actr_rly_scw.fm_static_bitfield.Cbx_obd_xxx BIT_MASK 0x4 /end CHARACTERISTIC
/begin CHARACTERISTIC Cbx_obd_mena_actr_rly_scw "" VALUE 0xa002f054 _REC_S1VAL_20_u1 255. _CNV_A_R_A_165_CM 0. 255. DISPLAY_IDENTIFIER fm_cal_actr_rly_scw.fm_static_bitfield.Cbx_obd_mena_xxx BIT_MASK 0x8 /end CHARACTERISTIC
/begin CHARACTERISTIC Cxx_dtc_lb_actr_rly_scw "" VALUE 0xa002f055 _REC_S1VAL_20_u1 255. _CNV_A_R_A_165_CM 0. 255. DISPLAY_IDENTIFIER fm_cal_actr_rly_scw.Cxx_dtc_lb_xxx /end CHARACTERISTIC
/begin CHARACTERISTIC Cxx_obd_dc_actr_rly_scw "" VALUE 0xa002f056 _REC_S1VAL_20_u1 9. _CNV_A_R_A_165_CM 1. 10. DISPLAY_IDENTIFIER fm_cal_actr_rly_scw.Cxx_obd_dc_xxx /end CHARACTERISTIC
/begin CHARACTERISTIC Cxx_dtc_obd_agb_data_chr "" VALUE 0xa002f05e _REC_S1VAL_20_u2 65535. _CNV_A_R_A_165_CM 0. 65535. DISPLAY_IDENTIFIER fm_cal_agb_data_chr.Cxx_dtc_obd_xxx /end CHARACTERISTIC
/begin CHARACTERISTIC Cxx_conf_wal_agb_data_chr "" VALUE 0xa002f060 _REC_S1VAL_20_u1 3. _CNV_A_R_A_165_CM 0. 3. DISPLAY_IDENTIFIER fm_cal_agb_data_chr.fm_static_bitfield.Cxx_conf_wal_xxx BIT_MASK 0x3 /end CHARACTERISTIC
/begin CHARACTERISTIC Cbx_obd_agb_data_chr "" VALUE 0xa002f060 _REC_S1VAL_20_u1 255. _CNV_A_R_A_165_CM 0. 255. DISPLAY_IDENTIFIER fm_cal_agb_data_chr.fm_static_bitfield.Cbx_obd_xxx BIT_MASK 0x4 /end CHARACTERISTIC
/begin CHARACTERISTIC Cbx_obd_mena_agb_data_chr "" VALUE 0xa002f060 _REC_S1VAL_20_u1 255. _CNV_A_R_A_165_CM 0. 255. DISPLAY_IDENTIFIER fm_cal_agb_data_chr.fm_static_bitfield.Cbx_obd_mena_xxx BIT_MASK 0x8 /end CHARACTERISTIC
/begin CHARACTERISTIC Cxx_dtc_lb_agb_data_chr "" VALUE 0xa002f061 _REC_S1VAL_20_u1 255. _CNV_A_R_A_165_CM 0. 255. DISPLAY_IDENTIFIER fm_cal_agb_data_chr.Cxx_dtc_lb_xxx /end CHARACTERISTIC
/begin CHARACTERISTIC Cxx_obd_dc_agb_data_chr "" VALUE 0xa002f062 _REC_S1VAL_20_u1 9. _CNV_A_R_A_165_CM 1. 10. DISPLAY_IDENTIFIER fm_cal_agb_data_chr.Cxx_obd_dc_xxx /end CHARACTERISTIC
/begin CHARACTERISTIC Cxx_dtc_obd_agb_data_seq_ctr "" VALUE 0xa002f06a _REC_S1VAL_20_u2 65535. _CNV_A_R_A_165_CM 0. 65535. DISPLAY_IDENTIFIER fm_cal_agb_data_seq_ctr.Cxx_dtc_obd_xxx /end CHARACTERISTIC
/begin CHARACTERISTIC Cxx_conf_wal_agb_data_seq_ctr "" VALUE 0xa002f06c _REC_S1VAL_20_u1 3. _CNV_A_R_A_165_CM 0. 3. DISPLAY_IDENTIFIER fm_cal_agb_data_seq_ctr.fm_static_bitfield.Cxx_conf_wal_xxx BIT_MASK 0x3 /end CHARACTERISTIC
/begin CHARACTERISTIC Cbx_obd_agb_data_seq_ctr "" VALUE 0xa002f06c _REC_S1VAL_20_u1 255. _CNV_A_R_A_165_CM 0. 255. DISPLAY_IDENTIFIER fm_cal_agb_data_seq_ctr.fm_static_bitfield.Cbx_obd_xxx BIT_MASK 0x4 /end CHARACTERISTIC
/begin CHARACTERISTIC Cbx_obd_mena_agb_data_seq_ctr "" VALUE 0xa002f06c _REC_S1VAL_20_u1 255. _CNV_A_R_A_165_CM 0. 255. DISPLAY_IDENTIFIER fm_cal_agb_data_seq_ctr.fm_static_bitfield.Cbx_obd_mena_xxx BIT_MASK 0x8 /end CHARACTERISTIC
/begin CHARACTERISTIC Cxx_dtc_lb_agb_data_seq_ctr "" VALUE 0xa002f06d _REC_S1VAL_20_u1 255. _CNV_A_R_A_165_CM 0. 255. DISPLAY_IDENTIFIER fm_cal_agb_data_seq_ctr.Cxx_dtc_lb_xxx /end CHARACTERISTIC
/begin CHARACTERISTIC Cxx_obd_dc_agb_data_seq_ctr "" VALUE 0xa002f06e _REC_S1VAL_20_u1 9. _CNV_A_R_A_165_CM 1. 10. DISPLAY_IDENTIFIER fm_cal_agb_data_seq_ctr.Cxx_obd_dc_xxx /end CHARACTERISTIC
/begin CHARACTERISTIC Cxx_dtc_obd_agb_data_tout "" VALUE 0xa002f076 _REC_S1VAL_20_u2 65535. _CNV_A_R_A_165_CM 0. 65535. DISPLAY_IDENTIFIER fm_cal_agb_data_tout.Cxx_dtc_obd_xxx /end CHARACTERISTIC
/begin CHARACTERISTIC Cxx_conf_wal_agb_data_tout "" VALUE 0xa002f078 _REC_S1VAL_20_u1 3. _CNV_A_R_A_165_CM 0. 3. DISPLAY_IDENTIFIER fm_cal_agb_data_tout.fm_static_bitfield.Cxx_conf_wal_xxx BIT_MASK 0x3 /end CHARACTERISTIC
/begin CHARACTERISTIC Cbx_obd_agb_data_tout "" VALUE 0xa002f078 _REC_S1VAL_20_u1 255. _CNV_A_R_A_165_CM 0. 255. DISPLAY_IDENTIFIER fm_cal_agb_data_tout.fm_static_bitfield.Cbx_obd_xxx BIT_MASK 0x4 /end CHARACTERISTIC
/begin CHARACTERISTIC Cbx_obd_mena_agb_data_tout "" VALUE 0xa002f078 _REC_S1VAL_20_u1 255. _CNV_A_R_A_165_CM 0. 255. DISPLAY_IDENTIFIER fm_cal_agb_data_tout.fm_static_bitfield.Cbx_obd_mena_xxx BIT_MASK 0x8 /end CHARACTERISTIC
/begin CHARACTERISTIC Cxx_dtc_lb_agb_data_tout "" VALUE 0xa002f079 _REC_S1VAL_20_u1 255. _CNV_A_R_A_165_CM 0. 255. DISPLAY_IDENTIFIER fm_cal_agb_data_tout.Cxx_dtc_lb_xxx /end CHARACTERISTIC
/begin CHARACTERISTIC Cxx_obd_dc_agb_data_tout "" VALUE 0xa002f07a _REC_S1VAL_20_u1 9. _CNV_A_R_A_165_CM 1. 10. DISPLAY_IDENTIFIER fm_cal_agb_data_tout.Cxx_obd_dc_xxx /end CHARACTERISTIC
/begin CHARACTERISTIC Cxx_dtc_obd_agb_no_frm "" VALUE 0xa002f082 _REC_S1VAL_20_u2 65535. _CNV_A_R_A_165_CM 0. 65535. DISPLAY_IDENTIFIER fm_cal_agb_no_frm.Cxx_dtc_obd_xxx /end CHARACTERISTIC
/begin CHARACTERISTIC Cxx_conf_wal_agb_no_frm "" VALUE 0xa002f084 _REC_S1VAL_20_u1 3. _CNV_A_R_A_165_CM 0. 3. DISPLAY_IDENTIFIER fm_cal_agb_no_frm.fm_static_bitfield.Cxx_conf_wal_xxx BIT_MASK 0x3 /end CHARACTERISTIC
/begin CHARACTERISTIC Cbx_obd_agb_no_frm "" VALUE 0xa002f084 _REC_S1VAL_20_u1 255. _CNV_A_R_A_165_CM 0. 255. DISPLAY_IDENTIFIER fm_cal_agb_no_frm.fm_static_bitfield.Cbx_obd_xxx BIT_MASK 0x4 /end CHARACTERISTIC
/begin CHARACTERISTIC Cbx_obd_mena_agb_no_frm "" VALUE 0xa002f084 _REC_S1VAL_20_u1 255. _CNV_A_R_A_165_CM 0. 255. DISPLAY_IDENTIFIER fm_cal_agb_no_frm.fm_static_bitfield.Cbx_obd_mena_xxx BIT_MASK 0x8 /end CHARACTERISTIC
/begin CHARACTERISTIC Cxx_dtc_lb_agb_no_frm "" VALUE 0xa002f085 _REC_S1VAL_20_u1 255. _CNV_A_R_A_165_CM 0. 255. DISPLAY_IDENTIFIER fm_cal_agb_no_frm.Cxx_dtc_lb_xxx /end CHARACTERISTIC
/begin CHARACTERISTIC Cxx_obd_dc_agb_no_frm "" VALUE 0xa002f086 _REC_S1VAL_20_u1 9. _CNV_A_R_A_165_CM 1. 10. DISPLAY_IDENTIFIER fm_cal_agb_no_frm.Cxx_obd_dc_xxx /end CHARACTERISTIC
/begin CHARACTERISTIC Cxx_conf_wal_bgin_clu_cmp "" VALUE 0xa002f3a8 _REC_S1VAL_20_u1 3. _CNV_A_R_A_165_CM 0. 3. DISPLAY_IDENTIFIER fm_cal_bgin_clu_cmp.fm_static_bitfield.Cxx_conf_wal_xxx BIT_MASK 0x3 /end CHARACTERISTIC
/begin CHARACTERISTIC Cxx_dtc_lb_bgin_clu_cmp "" VALUE 0xa002f3a9 _REC_S1VAL_20_u1 255. _CNV_A_R_A_165_CM 0. 255. DISPLAY_IDENTIFIER fm_cal_bgin_clu_cmp.Cxx_dtc_lb_xxx /end CHARACTERISTIC
/begin CHARACTERISTIC Cxx_conf_wal_bgin_clu_nok "" VALUE 0xa002f3b4 _REC_S1VAL_20_u1 3. _CNV_A_R_A_165_CM 0. 3. DISPLAY_IDENTIFIER fm_cal_bgin_clu_nok.fm_static_bitfield.Cxx_conf_wal_xxx BIT_MASK 0x3 /end CHARACTERISTIC
/begin CHARACTERISTIC Cxx_dtc_lb_bgin_clu_nok "" VALUE 0xa002f3b5 _REC_S1VAL_20_u1 255. _CNV_A_R_A_165_CM 0. 255. DISPLAY_IDENTIFIER fm_cal_bgin_clu_nok.Cxx_dtc_lb_xxx /end CHARACTERISTIC
/begin CHARACTERISTIC Cxx_conf_wal_brk_pdl_cmp "" VALUE 0xa002f3c0 _REC_S1VAL_20_u1 3. _CNV_A_R_A_165_CM 0. 3. DISPLAY_IDENTIFIER fm_cal_brk_pdl_cmp.fm_static_bitfield.Cxx_conf_wal_xxx BIT_MASK 0x3 /end CHARACTERISTIC
/begin CHARACTERISTIC Cxx_dtc_lb_brk_pdl_cmp "" VALUE 0xa002f3c1 _REC_S1VAL_20_u1 255. _CNV_A_R_A_165_CM 0. 255. DISPLAY_IDENTIFIER fm_cal_brk_pdl_cmp.Cxx_dtc_lb_xxx /end CHARACTERISTIC
/begin CHARACTERISTIC Cxx_dtc_obd_cata_cpt "" VALUE 0xa002f3ca _REC_S1VAL_20_u2 65535. _CNV_A_R_A_165_CM 0. 65535. DISPLAY_IDENTIFIER fm_cal_cata_cpt.Cxx_dtc_obd_xxx /end CHARACTERISTIC
/begin CHARACTERISTIC Cxx_conf_wal_cata_cpt "" VALUE 0xa002f3cc _REC_S1VAL_20_u1 3. _CNV_A_R_A_165_CM 0. 3. DISPLAY_IDENTIFIER fm_cal_cata_cpt.fm_static_bitfield.Cxx_conf_wal_xxx BIT_MASK 0x3 /end CHARACTERISTIC
/begin CHARACTERISTIC Cbx_obd_cata_cpt "" VALUE 0xa002f3cc _REC_S1VAL_20_u1 255. _CNV_A_R_A_165_CM 0. 255. DISPLAY_IDENTIFIER fm_cal_cata_cpt.fm_static_bitfield.Cbx_obd_xxx BIT_MASK 0x4 /end CHARACTERISTIC
/begin CHARACTERISTIC Cbx_obd_mena_cata_cpt "" VALUE 0xa002f3cc _REC_S1VAL_20_u1 255. _CNV_A_R_A_165_CM 0. 255. DISPLAY_IDENTIFIER fm_cal_cata_cpt.fm_static_bitfield.Cbx_obd_mena_xxx BIT_MASK 0x8 /end CHARACTERISTIC
/begin CHARACTERISTIC Cxx_dtc_lb_cata_cpt "" VALUE 0xa002f3cd _REC_S1VAL_20_u1 255. _CNV_A_R_A_165_CM 0. 255. DISPLAY_IDENTIFIER fm_cal_cata_cpt.Cxx_dtc_lb_xxx /end CHARACTERISTIC
/begin CHARACTERISTIC Cxx_obd_dc_cata_cpt "" VALUE 0xa002f3ce _REC_S1VAL_20_u1 9. _CNV_A_R_A_165_CM 1. 10. DISPLAY_IDENTIFIER fm_cal_cata_cpt.Cxx_obd_dc_xxx /end CHARACTERISTIC
/begin CHARACTERISTIC Cxx_dtc_obd_cl_rich_chr "" VALUE 0xa002f74e _REC_S1VAL_20_u2 65535. _CNV_A_R_A_165_CM 0. 65535. DISPLAY_IDENTIFIER fm_cal_cl_rich_chr.Cxx_dtc_obd_xxx /end CHARACTERISTIC
/begin CHARACTERISTIC Cxx_conf_wal_cl_rich_chr "" VALUE 0xa002f750 _REC_S1VAL_20_u1 3. _CNV_A_R_A_165_CM 0. 3. DISPLAY_IDENTIFIER fm_cal_cl_rich_chr.fm_static_bitfield.Cxx_conf_wal_xxx BIT_MASK 0x3 /end CHARACTERISTIC
/begin CHARACTERISTIC Cbx_obd_cl_rich_chr "" VALUE 0xa002f750 _REC_S1VAL_20_u1 255. _CNV_A_R_A_165_CM 0. 255. DISPLAY_IDENTIFIER fm_cal_cl_rich_chr.fm_static_bitfield.Cbx_obd_xxx BIT_MASK 0x4 /end CHARACTERISTIC
/begin CHARACTERISTIC Cbx_obd_mena_cl_rich_chr "" VALUE 0xa002f750 _REC_S1VAL_20_u1 255. _CNV_A_R_A_165_CM 0. 255. DISPLAY_IDENTIFIER fm_cal_cl_rich_chr.fm_static_bitfield.Cbx_obd_mena_xxx BIT_MASK 0x8 /end CHARACTERISTIC
/begin CHARACTERISTIC Cxx_dtc_lb_cl_rich_chr "" VALUE 0xa002f751 _REC_S1VAL_20_u1 255. _CNV_A_R_A_165_CM 0. 255. DISPLAY_IDENTIFIER fm_cal_cl_rich_chr.Cxx_dtc_lb_xxx /end CHARACTERISTIC
/begin CHARACTERISTIC Cxx_obd_dc_cl_rich_chr "" VALUE 0xa002f752 _REC_S1VAL_20_u1 9. _CNV_A_R_A_165_CM 1. 10. DISPLAY_IDENTIFIER fm_cal_cl_rich_chr.Cxx_obd_dc_xxx /end CHARACTERISTIC
/begin CHARACTERISTIC Cxx_conf_wal_clu_cnt_nok "" VALUE 0xa002f090 _REC_S1VAL_20_u1 3. _CNV_A_R_A_165_CM 0. 3. DISPLAY_IDENTIFIER fm_cal_clu_cnt_nok.fm_static_bitfield.Cxx_conf_wal_xxx BIT_MASK 0x3 /end CHARACTERISTIC
/begin CHARACTERISTIC Cxx_dtc_lb_clu_cnt_nok "" VALUE 0xa002f091 _REC_S1VAL_20_u1 255. _CNV_A_R_A_165_CM 0. 255. DISPLAY_IDENTIFIER fm_cal_clu_cnt_nok.Cxx_dtc_lb_xxx /end CHARACTERISTIC
/begin CHARACTERISTIC Cxx_dtc_obd_cp_oc "" VALUE 0xa002f36a _REC_S1VAL_20_u2 65535. _CNV_A_R_A_165_CM 0. 65535. DISPLAY_IDENTIFIER fm_cal_cp_oc.Cxx_dtc_obd_xxx /end CHARACTERISTIC
/begin CHARACTERISTIC Cxx_conf_wal_cp_oc "" VALUE 0xa002f36c _REC_S1VAL_20_u1 3. _CNV_A_R_A_165_CM 0. 3. DISPLAY_IDENTIFIER fm_cal_cp_oc.fm_static_bitfield.Cxx_conf_wal_xxx BIT_MASK 0x3 /end CHARACTERISTIC
/begin CHARACTERISTIC Cbx_obd_cp_oc "" VALUE 0xa002f36c _REC_S1VAL_20_u1 255. _CNV_A_R_A_165_CM 0. 255. DISPLAY_IDENTIFIER fm_cal_cp_oc.fm_static_bitfield.Cbx_obd_xxx BIT_MASK 0x4 /end CHARACTERISTIC
/begin CHARACTERISTIC Cbx_obd_mena_cp_oc "" VALUE 0xa002f36c _REC_S1VAL_20_u1 255. _CNV_A_R_A_165_CM 0. 255. DISPLAY_IDENTIFIER fm_cal_cp_oc.fm_static_bitfield.Cbx_obd_mena_xxx BIT_MASK 0x8 /end CHARACTERISTIC
/begin CHARACTERISTIC Cxx_dtc_lb_cp_oc "" VALUE 0xa002f36d _REC_S1VAL_20_u1 255. _CNV_A_R_A_165_CM 0. 255. DISPLAY_IDENTIFIER fm_cal_cp_oc.Cxx_dtc_lb_xxx /end CHARACTERISTIC
/begin CHARACTERISTIC Cxx_obd_dc_cp_oc "" VALUE 0xa002f36e _REC_S1VAL_20_u1 9. _CNV_A_R_A_165_CM 1. 10. DISPLAY_IDENTIFIER fm_cal_cp_oc.Cxx_obd_dc_xxx /end CHARACTERISTIC
/begin CHARACTERISTIC Cxx_dtc_obd_cp_scg "" VALUE 0xa002f376 _REC_S1VAL_20_u2 65535. _CNV_A_R_A_165_CM 0. 65535. DISPLAY_IDENTIFIER fm_cal_cp_scg.Cxx_dtc_obd_xxx /end CHARACTERISTIC
/begin CHARACTERISTIC Cxx_conf_wal_cp_scg "" VALUE 0xa002f378 _REC_S1VAL_20_u1 3. _CNV_A_R_A_165_CM 0. 3. DISPLAY_IDENTIFIER fm_cal_cp_scg.fm_static_bitfield.Cxx_conf_wal_xxx BIT_MASK 0x3 /end CHARACTERISTIC
/begin CHARACTERISTIC Cbx_obd_cp_scg "" VALUE 0xa002f378 _REC_S1VAL_20_u1 255. _CNV_A_R_A_165_CM 0. 255. DISPLAY_IDENTIFIER fm_cal_cp_scg.fm_static_bitfield.Cbx_obd_xxx BIT_MASK 0x4 /end CHARACTERISTIC
/begin CHARACTERISTIC Cbx_obd_mena_cp_scg "" VALUE 0xa002f378 _REC_S1VAL_20_u1 255. _CNV_A_R_A_165_CM 0. 255. DISPLAY_IDENTIFIER fm_cal_cp_scg.fm_static_bitfield.Cbx_obd_mena_xxx BIT_MASK 0x8 /end CHARACTERISTIC
/begin CHARACTERISTIC Cxx_dtc_lb_cp_scg "" VALUE 0xa002f379 _REC_S1VAL_20_u1 255. _CNV_A_R_A_165_CM 0. 255. DISPLAY_IDENTIFIER fm_cal_cp_scg.Cxx_dtc_lb_xxx /end CHARACTERISTIC
/begin CHARACTERISTIC Cxx_obd_dc_cp_scg "" VALUE 0xa002f37a _REC_S1VAL_20_u1 9. _CNV_A_R_A_165_CM 1. 10. DISPLAY_IDENTIFIER fm_cal_cp_scg.Cxx_obd_dc_xxx /end CHARACTERISTIC
/begin CHARACTERISTIC Cxx_dtc_obd_cp_scw "" VALUE 0xa002f382 _REC_S1VAL_20_u2 65535. _CNV_A_R_A_165_CM 0. 65535. DISPLAY_IDENTIFIER fm_cal_cp_scw.Cxx_dtc_obd_xxx /end CHARACTERISTIC
/begin CHARACTERISTIC Cxx_conf_wal_cp_scw "" VALUE 0xa002f384 _REC_S1VAL_20_u1 3. _CNV_A_R_A_165_CM 0. 3. DISPLAY_IDENTIFIER fm_cal_cp_scw.fm_static_bitfield.Cxx_conf_wal_xxx BIT_MASK 0x3 /end CHARACTERISTIC
/begin CHARACTERISTIC Cbx_obd_cp_scw "" VALUE 0xa002f384 _REC_S1VAL_20_u1 255. _CNV_A_R_A_165_CM 0. 255. DISPLAY_IDENTIFIER fm_cal_cp_scw.fm_static_bitfield.Cbx_obd_xxx BIT_MASK 0x4 /end CHARACTERISTIC
/begin CHARACTERISTIC Cbx_obd_mena_cp_scw "" VALUE 0xa002f384 _REC_S1VAL_20_u1 255. _CNV_A_R_A_165_CM 0. 255. DISPLAY_IDENTIFIER fm_cal_cp_scw.fm_static_bitfield.Cbx_obd_mena_xxx BIT_MASK 0x8 /end CHARACTERISTIC
/begin CHARACTERISTIC Cxx_dtc_lb_cp_scw "" VALUE 0xa002f385 _REC_S1VAL_20_u1 255. _CNV_A_R_A_165_CM 0. 255. DISPLAY_IDENTIFIER fm_cal_cp_scw.Cxx_dtc_lb_xxx /end CHARACTERISTIC
/begin CHARACTERISTIC Cxx_obd_dc_cp_scw "" VALUE 0xa002f386 _REC_S1VAL_20_u1 9. _CNV_A_R_A_165_CM 1. 10. DISPLAY_IDENTIFIER fm_cal_cp_scw.Cxx_obd_dc_xxx /end CHARACTERISTIC
/begin CHARACTERISTIC Cxx_dtc_obd_crk_chr "" VALUE 0xa002f63a _REC_S1VAL_20_u2 65535. _CNV_A_R_A_165_CM 0. 65535. DISPLAY_IDENTIFIER fm_cal_crk_chr.Cxx_dtc_obd_xxx /end CHARACTERISTIC
/begin CHARACTERISTIC Cxx_conf_wal_crk_chr "" VALUE 0xa002f63c _REC_S1VAL_20_u1 3. _CNV_A_R_A_165_CM 0. 3. DISPLAY_IDENTIFIER fm_cal_crk_chr.fm_static_bitfield.Cxx_conf_wal_xxx BIT_MASK 0x3 /end CHARACTERISTIC
/begin CHARACTERISTIC Cbx_obd_crk_chr "" VALUE 0xa002f63c _REC_S1VAL_20_u1 255. _CNV_A_R_A_165_CM 0. 255. DISPLAY_IDENTIFIER fm_cal_crk_chr.fm_static_bitfield.Cbx_obd_xxx BIT_MASK 0x4 /end CHARACTERISTIC
/begin CHARACTERISTIC Cbx_obd_mena_crk_chr "" VALUE 0xa002f63c _REC_S1VAL_20_u1 255. _CNV_A_R_A_165_CM 0. 255. DISPLAY_IDENTIFIER fm_cal_crk_chr.fm_static_bitfield.Cbx_obd_mena_xxx BIT_MASK 0x8 /end CHARACTERISTIC
/begin CHARACTERISTIC Cxx_dtc_lb_crk_chr "" VALUE 0xa002f63d _REC_S1VAL_20_u1 255. _CNV_A_R_A_165_CM 0. 255. DISPLAY_IDENTIFIER fm_cal_crk_chr.Cxx_dtc_lb_xxx /end CHARACTERISTIC
/begin CHARACTERISTIC Cxx_obd_dc_crk_chr "" VALUE 0xa002f63e _REC_S1VAL_20_u1 9. _CNV_A_R_A_165_CM 1. 10. DISPLAY_IDENTIFIER fm_cal_crk_chr.Cxx_obd_dc_xxx /end CHARACTERISTIC
/begin CHARACTERISTIC Cxx_dtc_obd_crk_cmp "" VALUE 0xa002f72a _REC_S1VAL_20_u2 65535. _CNV_A_R_A_165_CM 0. 65535. DISPLAY_IDENTIFIER fm_cal_crk_cmp.Cxx_dtc_obd_xxx /end CHARACTERISTIC
/begin CHARACTERISTIC Cxx_conf_wal_crk_cmp "" VALUE 0xa002f72c _REC_S1VAL_20_u1 3. _CNV_A_R_A_165_CM 0. 3. DISPLAY_IDENTIFIER fm_cal_crk_cmp.fm_static_bitfield.Cxx_conf_wal_xxx BIT_MASK 0x3 /end CHARACTERISTIC
/begin CHARACTERISTIC Cbx_obd_crk_cmp "" VALUE 0xa002f72c _REC_S1VAL_20_u1 255. _CNV_A_R_A_165_CM 0. 255. DISPLAY_IDENTIFIER fm_cal_crk_cmp.fm_static_bitfield.Cbx_obd_xxx BIT_MASK 0x4 /end CHARACTERISTIC
/begin CHARACTERISTIC Cbx_obd_mena_crk_cmp "" VALUE 0xa002f72c _REC_S1VAL_20_u1 255. _CNV_A_R_A_165_CM 0. 255. DISPLAY_IDENTIFIER fm_cal_crk_cmp.fm_static_bitfield.Cbx_obd_mena_xxx BIT_MASK 0x8 /end CHARACTERISTIC
/begin CHARACTERISTIC Cxx_dtc_lb_crk_cmp "" VALUE 0xa002f72d _REC_S1VAL_20_u1 255. _CNV_A_R_A_165_CM 0. 255. DISPLAY_IDENTIFIER fm_cal_crk_cmp.Cxx_dtc_lb_xxx /end CHARACTERISTIC
/begin CHARACTERISTIC Cxx_obd_dc_crk_cmp "" VALUE 0xa002f72e _REC_S1VAL_20_u1 9. _CNV_A_R_A_165_CM 1. 10. DISPLAY_IDENTIFIER fm_cal_crk_cmp.Cxx_obd_dc_xxx /end CHARACTERISTIC
/begin CHARACTERISTIC Cxx_dtc_obd_crk_cyc "" VALUE 0xa002f646 _REC_S1VAL_20_u2 65535. _CNV_A_R_A_165_CM 0. 65535. DISPLAY_IDENTIFIER fm_cal_crk_cyc.Cxx_dtc_obd_xxx /end CHARACTERISTIC
/begin CHARACTERISTIC Cxx_conf_wal_crk_cyc "" VALUE 0xa002f648 _REC_S1VAL_20_u1 3. _CNV_A_R_A_165_CM 0. 3. DISPLAY_IDENTIFIER fm_cal_crk_cyc.fm_static_bitfield.Cxx_conf_wal_xxx BIT_MASK 0x3 /end CHARACTERISTIC
/begin CHARACTERISTIC Cbx_obd_crk_cyc "" VALUE 0xa002f648 _REC_S1VAL_20_u1 255. _CNV_A_R_A_165_CM 0. 255. DISPLAY_IDENTIFIER fm_cal_crk_cyc.fm_static_bitfield.Cbx_obd_xxx BIT_MASK 0x4 /end CHARACTERISTIC
/begin CHARACTERISTIC Cbx_obd_mena_crk_cyc "" VALUE 0xa002f648 _REC_S1VAL_20_u1 255. _CNV_A_R_A_165_CM 0. 255. DISPLAY_IDENTIFIER fm_cal_crk_cyc.fm_static_bitfield.Cbx_obd_mena_xxx BIT_MASK 0x8 /end CHARACTERISTIC
/begin CHARACTERISTIC Cxx_dtc_lb_crk_cyc "" VALUE 0xa002f649 _REC_S1VAL_20_u1 255. _CNV_A_R_A_165_CM 0. 255. DISPLAY_IDENTIFIER fm_cal_crk_cyc.Cxx_dtc_lb_xxx /end CHARACTERISTIC
/begin CHARACTERISTIC Cxx_obd_dc_crk_cyc "" VALUE 0xa002f64a _REC_S1VAL_20_u1 9. _CNV_A_R_A_165_CM 1. 10. DISPLAY_IDENTIFIER fm_cal_crk_cyc.Cxx_obd_dc_xxx /end CHARACTERISTIC
/begin CHARACTERISTIC Cxx_dtc_obd_crk_no_sig "" VALUE 0xa002f6b2 _REC_S1VAL_20_u2 65535. _CNV_A_R_A_165_CM 0. 65535. DISPLAY_IDENTIFIER fm_cal_crk_no_sig.Cxx_dtc_obd_xxx /end CHARACTERISTIC
/begin CHARACTERISTIC Cxx_conf_wal_crk_no_sig "" VALUE 0xa002f6b4 _REC_S1VAL_20_u1 3. _CNV_A_R_A_165_CM 0. 3. DISPLAY_IDENTIFIER fm_cal_crk_no_sig.fm_static_bitfield.Cxx_conf_wal_xxx BIT_MASK 0x3 /end CHARACTERISTIC
/begin CHARACTERISTIC Cbx_obd_crk_no_sig "" VALUE 0xa002f6b4 _REC_S1VAL_20_u1 255. _CNV_A_R_A_165_CM 0. 255. DISPLAY_IDENTIFIER fm_cal_crk_no_sig.fm_static_bitfield.Cbx_obd_xxx BIT_MASK 0x4 /end CHARACTERISTIC
/begin CHARACTERISTIC Cbx_obd_mena_crk_no_sig "" VALUE 0xa002f6b4 _REC_S1VAL_20_u1 255. _CNV_A_R_A_165_CM 0. 255. DISPLAY_IDENTIFIER fm_cal_crk_no_sig.fm_static_bitfield.Cbx_obd_mena_xxx BIT_MASK 0x8 /end CHARACTERISTIC
/begin CHARACTERISTIC Cxx_dtc_lb_crk_no_sig "" VALUE 0xa002f6b5 _REC_S1VAL_20_u1 255. _CNV_A_R_A_165_CM 0. 255. DISPLAY_IDENTIFIER fm_cal_crk_no_sig.Cxx_dtc_lb_xxx /end CHARACTERISTIC
/begin CHARACTERISTIC Cxx_obd_dc_crk_no_sig "" VALUE 0xa002f6b6 _REC_S1VAL_20_u1 9. _CNV_A_R_A_165_CM 1. 10. DISPLAY_IDENTIFIER fm_cal_crk_no_sig.Cxx_obd_dc_xxx /end CHARACTERISTIC
/begin CHARACTERISTIC Cxx_dtc_obd_crk_oc "" VALUE 0xa002f742 _REC_S1VAL_20_u2 65535. _CNV_A_R_A_165_CM 0. 65535. DISPLAY_IDENTIFIER fm_cal_crk_oc.Cxx_dtc_obd_xxx /end CHARACTERISTIC
/begin CHARACTERISTIC Cxx_conf_wal_crk_oc "" VALUE 0xa002f744 _REC_S1VAL_20_u1 3. _CNV_A_R_A_165_CM 0. 3. DISPLAY_IDENTIFIER fm_cal_crk_oc.fm_static_bitfield.Cxx_conf_wal_xxx BIT_MASK 0x3 /end CHARACTERISTIC
/begin CHARACTERISTIC Cbx_obd_crk_oc "" VALUE 0xa002f744 _REC_S1VAL_20_u1 255. _CNV_A_R_A_165_CM 0. 255. DISPLAY_IDENTIFIER fm_cal_crk_oc.fm_static_bitfield.Cbx_obd_xxx BIT_MASK 0x4 /end CHARACTERISTIC
/begin CHARACTERISTIC Cbx_obd_mena_crk_oc "" VALUE 0xa002f744 _REC_S1VAL_20_u1 255. _CNV_A_R_A_165_CM 0. 255. DISPLAY_IDENTIFIER fm_cal_crk_oc.fm_static_bitfield.Cbx_obd_mena_xxx BIT_MASK 0x8 /end CHARACTERISTIC
/begin CHARACTERISTIC Cxx_dtc_lb_crk_oc "" VALUE 0xa002f745 _REC_S1VAL_20_u1 255. _CNV_A_R_A_165_CM 0. 255. DISPLAY_IDENTIFIER fm_cal_crk_oc.Cxx_dtc_lb_xxx /end CHARACTERISTIC
/begin CHARACTERISTIC Cxx_obd_dc_crk_oc "" VALUE 0xa002f746 _REC_S1VAL_20_u1 9. _CNV_A_R_A_165_CM 1. 10. DISPLAY_IDENTIFIER fm_cal_crk_oc.Cxx_obd_dc_xxx /end CHARACTERISTIC
/begin CHARACTERISTIC Cxx_dtc_obd_crk_shp "" VALUE 0xa002f736 _REC_S1VAL_20_u2 65535. _CNV_A_R_A_165_CM 0. 65535. DISPLAY_IDENTIFIER fm_cal_crk_shp.Cxx_dtc_obd_xxx /end CHARACTERISTIC
/begin CHARACTERISTIC Cxx_conf_wal_crk_shp "" VALUE 0xa002f738 _REC_S1VAL_20_u1 3. _CNV_A_R_A_165_CM 0. 3. DISPLAY_IDENTIFIER fm_cal_crk_shp.fm_static_bitfield.Cxx_conf_wal_xxx BIT_MASK 0x3 /end CHARACTERISTIC
/begin CHARACTERISTIC Cbx_obd_crk_shp "" VALUE 0xa002f738 _REC_S1VAL_20_u1 255. _CNV_A_R_A_165_CM 0. 255. DISPLAY_IDENTIFIER fm_cal_crk_shp.fm_static_bitfield.Cbx_obd_xxx BIT_MASK 0x4 /end CHARACTERISTIC
/begin CHARACTERISTIC Cbx_obd_mena_crk_shp "" VALUE 0xa002f738 _REC_S1VAL_20_u1 255. _CNV_A_R_A_165_CM 0. 255. DISPLAY_IDENTIFIER fm_cal_crk_shp.fm_static_bitfield.Cbx_obd_mena_xxx BIT_MASK 0x8 /end CHARACTERISTIC
/begin CHARACTERISTIC Cxx_dtc_lb_crk_shp "" VALUE 0xa002f739 _REC_S1VAL_20_u1 255. _CNV_A_R_A_165_CM 0. 255. DISPLAY_IDENTIFIER fm_cal_crk_shp.Cxx_dtc_lb_xxx /end CHARACTERISTIC
/begin CHARACTERISTIC Cxx_obd_dc_crk_shp "" VALUE 0xa002f73a _REC_S1VAL_20_u1 9. _CNV_A_R_A_165_CM 1. 10. DISPLAY_IDENTIFIER fm_cal_crk_shp.Cxx_obd_dc_xxx /end CHARACTERISTIC
/begin CHARACTERISTIC Cxx_conf_wal_cru_cmp "" VALUE 0xa002f3d8 _REC_S1VAL_20_u1 3. _CNV_A_R_A_165_CM 0. 3. DISPLAY_IDENTIFIER fm_cal_cru_cmp.fm_static_bitfield.Cxx_conf_wal_xxx BIT_MASK 0x3 /end CHARACTERISTIC
/begin CHARACTERISTIC Cxx_dtc_lb_cru_cmp "" VALUE 0xa002f3d9 _REC_S1VAL_20_u1 255. _CNV_A_R_A_165_CM 0. 255. DISPLAY_IDENTIFIER fm_cal_cru_cmp.Cxx_dtc_lb_xxx /end CHARACTERISTIC
/begin CHARACTERISTIC Cxx_conf_wal_cru_sl_swi_chr "" VALUE 0xa002f3e4 _REC_S1VAL_20_u1 3. _CNV_A_R_A_165_CM 0. 3. DISPLAY_IDENTIFIER fm_cal_cru_sl_swi_chr.fm_static_bitfield.Cxx_conf_wal_xxx BIT_MASK 0x3 /end CHARACTERISTIC
/begin CHARACTERISTIC Cxx_dtc_lb_cru_sl_swi_chr "" VALUE 0xa002f3e5 _REC_S1VAL_20_u1 255. _CNV_A_R_A_165_CM 0. 255. DISPLAY_IDENTIFIER fm_cal_cru_sl_swi_chr.Cxx_dtc_lb_xxx /end CHARACTERISTIC
/begin CHARACTERISTIC Cxx_conf_wal_cru_sl_tot "" VALUE 0xa002f3f0 _REC_S1VAL_20_u1 3. _CNV_A_R_A_165_CM 0. 3. DISPLAY_IDENTIFIER fm_cal_cru_sl_tot.fm_static_bitfield.Cxx_conf_wal_xxx BIT_MASK 0x3 /end CHARACTERISTIC
/begin CHARACTERISTIC Cxx_dtc_lb_cru_sl_tot "" VALUE 0xa002f3f1 _REC_S1VAL_20_u1 255. _CNV_A_R_A_165_CM 0. 255. DISPLAY_IDENTIFIER fm_cal_cru_sl_tot.Cxx_dtc_lb_xxx /end CHARACTERISTIC
/begin CHARACTERISTIC Cxx_conf_wal_cru_vs_cmp "" VALUE 0xa002f3fc _REC_S1VAL_20_u1 3. _CNV_A_R_A_165_CM 0. 3. DISPLAY_IDENTIFIER fm_cal_cru_vs_cmp.fm_static_bitfield.Cxx_conf_wal_xxx BIT_MASK 0x3 /end CHARACTERISTIC
/begin CHARACTERISTIC Cxx_dtc_lb_cru_vs_cmp "" VALUE 0xa002f3fd _REC_S1VAL_20_u1 255. _CNV_A_R_A_165_CM 0. 255. DISPLAY_IDENTIFIER fm_cal_cru_vs_cmp.Cxx_dtc_lb_xxx /end CHARACTERISTIC
/begin CHARACTERISTIC Cxx_conf_wal_cru_whl_cmd_nok "" VALUE 0xa002f408 _REC_S1VAL_20_u1 3. _CNV_A_R_A_165_CM 0. 3. DISPLAY_IDENTIFIER fm_cal_cru_whl_cmd_nok.fm_static_bitfield.Cxx_conf_wal_xxx BIT_MASK 0x3 /end CHARACTERISTIC
/begin CHARACTERISTIC Cxx_dtc_lb_cru_whl_cmd_nok "" VALUE 0xa002f409 _REC_S1VAL_20_u1 255. _CNV_A_R_A_165_CM 0. 255. DISPLAY_IDENTIFIER fm_cal_cru_whl_cmd_nok.Cxx_dtc_lb_xxx /end CHARACTERISTIC
/begin CHARACTERISTIC Cxx_conf_wal_cru_whl_cmd_oc_scw "" VALUE 0xa002f414 _REC_S1VAL_20_u1 3. _CNV_A_R_A_165_CM 0. 3. DISPLAY_IDENTIFIER fm_cal_cru_whl_cmd_oc_scw.fm_static_bitfield.Cxx_conf_wal_xxx BIT_MASK 0x3 /end CHARACTERISTIC
/begin CHARACTERISTIC Cxx_dtc_lb_cru_whl_cmd_oc_scw "" VALUE 0xa002f415 _REC_S1VAL_20_u1 255. _CNV_A_R_A_165_CM 0. 255. DISPLAY_IDENTIFIER fm_cal_cru_whl_cmd_oc_scw.Cxx_dtc_lb_xxx /end CHARACTERISTIC
/begin CHARACTERISTIC Cxx_conf_wal_cru_whl_cmd_oor "" VALUE 0xa002f420 _REC_S1VAL_20_u1 3. _CNV_A_R_A_165_CM 0. 3. DISPLAY_IDENTIFIER fm_cal_cru_whl_cmd_oor.fm_static_bitfield.Cxx_conf_wal_xxx BIT_MASK 0x3 /end CHARACTERISTIC
/begin CHARACTERISTIC Cxx_dtc_lb_cru_whl_cmd_oor "" VALUE 0xa002f421 _REC_S1VAL_20_u1 255. _CNV_A_R_A_165_CM 0. 255. DISPLAY_IDENTIFIER fm_cal_cru_whl_cmd_oor.Cxx_dtc_lb_xxx /end CHARACTERISTIC
/begin CHARACTERISTIC Cxx_dtc_obd_ecm_adc_tron "" VALUE 0xa002f772 _REC_S1VAL_20_u2 65535. _CNV_A_R_A_165_CM 0. 65535. DISPLAY_IDENTIFIER fm_cal_ecm_adc_tron.Cxx_dtc_obd_xxx /end CHARACTERISTIC
/begin CHARACTERISTIC Cxx_conf_wal_ecm_adc_tron "" VALUE 0xa002f774 _REC_S1VAL_20_u1 3. _CNV_A_R_A_165_CM 0. 3. DISPLAY_IDENTIFIER fm_cal_ecm_adc_tron.fm_static_bitfield.Cxx_conf_wal_xxx BIT_MASK 0x3 /end CHARACTERISTIC
/begin CHARACTERISTIC Cbx_obd_ecm_adc_tron "" VALUE 0xa002f774 _REC_S1VAL_20_u1 255. _CNV_A_R_A_165_CM 0. 255. DISPLAY_IDENTIFIER fm_cal_ecm_adc_tron.fm_static_bitfield.Cbx_obd_xxx BIT_MASK 0x4 /end CHARACTERISTIC
/begin CHARACTERISTIC Cbx_obd_mena_ecm_adc_tron "" VALUE 0xa002f774 _REC_S1VAL_20_u1 255. _CNV_A_R_A_165_CM 0. 255. DISPLAY_IDENTIFIER fm_cal_ecm_adc_tron.fm_static_bitfield.Cbx_obd_mena_xxx BIT_MASK 0x8 /end CHARACTERISTIC
/begin CHARACTERISTIC Cxx_dtc_lb_ecm_adc_tron "" VALUE 0xa002f775 _REC_S1VAL_20_u1 255. _CNV_A_R_A_165_CM 0. 255. DISPLAY_IDENTIFIER fm_cal_ecm_adc_tron.Cxx_dtc_lb_xxx /end CHARACTERISTIC
/begin CHARACTERISTIC Cxx_obd_dc_ecm_adc_tron "" VALUE 0xa002f776 _REC_S1VAL_20_u1 9. _CNV_A_R_A_165_CM 1. 10. DISPLAY_IDENTIFIER fm_cal_ecm_adc_tron.Cxx_obd_dc_xxx /end CHARACTERISTIC
/begin CHARACTERISTIC Cxx_dtc_obd_ecm_err_itl "" VALUE 0xa002f6be _REC_S1VAL_20_u2 65535. _CNV_A_R_A_165_CM 0. 65535. DISPLAY_IDENTIFIER fm_cal_ecm_err_itl.Cxx_dtc_obd_xxx /end CHARACTERISTIC
/begin CHARACTERISTIC Cxx_conf_wal_ecm_err_itl "" VALUE 0xa002f6c0 _REC_S1VAL_20_u1 3. _CNV_A_R_A_165_CM 0. 3. DISPLAY_IDENTIFIER fm_cal_ecm_err_itl.fm_static_bitfield.Cxx_conf_wal_xxx BIT_MASK 0x3 /end CHARACTERISTIC
/begin CHARACTERISTIC Cbx_obd_ecm_err_itl "" VALUE 0xa002f6c0 _REC_S1VAL_20_u1 255. _CNV_A_R_A_165_CM 0. 255. DISPLAY_IDENTIFIER fm_cal_ecm_err_itl.fm_static_bitfield.Cbx_obd_xxx BIT_MASK 0x4 /end CHARACTERISTIC
/begin CHARACTERISTIC Cbx_obd_mena_ecm_err_itl "" VALUE 0xa002f6c0 _REC_S1VAL_20_u1 255. _CNV_A_R_A_165_CM 0. 255. DISPLAY_IDENTIFIER fm_cal_ecm_err_itl.fm_static_bitfield.Cbx_obd_mena_xxx BIT_MASK 0x8 /end CHARACTERISTIC
/begin CHARACTERISTIC Cxx_dtc_lb_ecm_err_itl "" VALUE 0xa002f6c1 _REC_S1VAL_20_u1 255. _CNV_A_R_A_165_CM 0. 255. DISPLAY_IDENTIFIER fm_cal_ecm_err_itl.Cxx_dtc_lb_xxx /end CHARACTERISTIC
/begin CHARACTERISTIC Cxx_obd_dc_ecm_err_itl "" VALUE 0xa002f6c2 _REC_S1VAL_20_u1 9. _CNV_A_R_A_165_CM 1. 10. DISPLAY_IDENTIFIER fm_cal_ecm_err_itl.Cxx_obd_dc_xxx /end CHARACTERISTIC
/begin CHARACTERISTIC Cxx_dtc_obd_ecm_mon_secu_1 "" VALUE 0xa002f75a _REC_S1VAL_20_u2 65535. _CNV_A_R_A_165_CM 0. 65535. DISPLAY_IDENTIFIER fm_cal_ecm_mon_secu_1.Cxx_dtc_obd_xxx /end CHARACTERISTIC
/begin CHARACTERISTIC Cxx_conf_wal_ecm_mon_secu_1 "" VALUE 0xa002f75c _REC_S1VAL_20_u1 3. _CNV_A_R_A_165_CM 0. 3. DISPLAY_IDENTIFIER fm_cal_ecm_mon_secu_1.fm_static_bitfield.Cxx_conf_wal_xxx BIT_MASK 0x3 /end CHARACTERISTIC
/begin CHARACTERISTIC Cbx_obd_ecm_mon_secu_1 "" VALUE 0xa002f75c _REC_S1VAL_20_u1 255. _CNV_A_R_A_165_CM 0. 255. DISPLAY_IDENTIFIER fm_cal_ecm_mon_secu_1.fm_static_bitfield.Cbx_obd_xxx BIT_MASK 0x4 /end CHARACTERISTIC
/begin CHARACTERISTIC Cbx_obd_mena_ecm_mon_secu_1 "" VALUE 0xa002f75c _REC_S1VAL_20_u1 255. _CNV_A_R_A_165_CM 0. 255. DISPLAY_IDENTIFIER fm_cal_ecm_mon_secu_1.fm_static_bitfield.Cbx_obd_mena_xxx BIT_MASK 0x8 /end CHARACTERISTIC
/begin CHARACTERISTIC Cxx_dtc_lb_ecm_mon_secu_1 "" VALUE 0xa002f75d _REC_S1VAL_20_u1 255. _CNV_A_R_A_165_CM 0. 255. DISPLAY_IDENTIFIER fm_cal_ecm_mon_secu_1.Cxx_dtc_lb_xxx /end CHARACTERISTIC
/begin CHARACTERISTIC Cxx_obd_dc_ecm_mon_secu_1 "" VALUE 0xa002f75e _REC_S1VAL_20_u1 9. _CNV_A_R_A_165_CM 1. 10. DISPLAY_IDENTIFIER fm_cal_ecm_mon_secu_1.Cxx_obd_dc_xxx /end CHARACTERISTIC
/begin CHARACTERISTIC Cxx_dtc_obd_ecm_mon_secu_2 "" VALUE 0xa002f766 _REC_S1VAL_20_u2 65535. _CNV_A_R_A_165_CM 0. 65535. DISPLAY_IDENTIFIER fm_cal_ecm_mon_secu_2.Cxx_dtc_obd_xxx /end CHARACTERISTIC
/begin CHARACTERISTIC Cxx_conf_wal_ecm_mon_secu_2 "" VALUE 0xa002f768 _REC_S1VAL_20_u1 3. _CNV_A_R_A_165_CM 0. 3. DISPLAY_IDENTIFIER fm_cal_ecm_mon_secu_2.fm_static_bitfield.Cxx_conf_wal_xxx BIT_MASK 0x3 /end CHARACTERISTIC
/begin CHARACTERISTIC Cbx_obd_ecm_mon_secu_2 "" VALUE 0xa002f768 _REC_S1VAL_20_u1 255. _CNV_A_R_A_165_CM 0. 255. DISPLAY_IDENTIFIER fm_cal_ecm_mon_secu_2.fm_static_bitfield.Cbx_obd_xxx BIT_MASK 0x4 /end CHARACTERISTIC
/begin CHARACTERISTIC Cbx_obd_mena_ecm_mon_secu_2 "" VALUE 0xa002f768 _REC_S1VAL_20_u1 255. _CNV_A_R_A_165_CM 0. 255. DISPLAY_IDENTIFIER fm_cal_ecm_mon_secu_2.fm_static_bitfield.Cbx_obd_mena_xxx BIT_MASK 0x8 /end CHARACTERISTIC
/begin CHARACTERISTIC Cxx_dtc_lb_ecm_mon_secu_2 "" VALUE 0xa002f769 _REC_S1VAL_20_u1 255. _CNV_A_R_A_165_CM 0. 255. DISPLAY_IDENTIFIER fm_cal_ecm_mon_secu_2.Cxx_dtc_lb_xxx /end CHARACTERISTIC
/begin CHARACTERISTIC Cxx_obd_dc_ecm_mon_secu_2 "" VALUE 0xa002f76a _REC_S1VAL_20_u1 9. _CNV_A_R_A_165_CM 1. 10. DISPLAY_IDENTIFIER fm_cal_ecm_mon_secu_2.Cxx_obd_dc_xxx /end CHARACTERISTIC
/begin CHARACTERISTIC Cxx_dtc_obd_ecm_mon_tron "" VALUE 0xa002f6ca _REC_S1VAL_20_u2 65535. _CNV_A_R_A_165_CM 0. 65535. DISPLAY_IDENTIFIER fm_cal_ecm_mon_tron.Cxx_dtc_obd_xxx /end CHARACTERISTIC
/begin CHARACTERISTIC Cxx_conf_wal_ecm_mon_tron "" VALUE 0xa002f6cc _REC_S1VAL_20_u1 3. _CNV_A_R_A_165_CM 0. 3. DISPLAY_IDENTIFIER fm_cal_ecm_mon_tron.fm_static_bitfield.Cxx_conf_wal_xxx BIT_MASK 0x3 /end CHARACTERISTIC
/begin CHARACTERISTIC Cbx_obd_ecm_mon_tron "" VALUE 0xa002f6cc _REC_S1VAL_20_u1 255. _CNV_A_R_A_165_CM 0. 255. DISPLAY_IDENTIFIER fm_cal_ecm_mon_tron.fm_static_bitfield.Cbx_obd_xxx BIT_MASK 0x4 /end CHARACTERISTIC
/begin CHARACTERISTIC Cbx_obd_mena_ecm_mon_tron "" VALUE 0xa002f6cc _REC_S1VAL_20_u1 255. _CNV_A_R_A_165_CM 0. 255. DISPLAY_IDENTIFIER fm_cal_ecm_mon_tron.fm_static_bitfield.Cbx_obd_mena_xxx BIT_MASK 0x8 /end CHARACTERISTIC
/begin CHARACTERISTIC Cxx_dtc_lb_ecm_mon_tron "" VALUE 0xa002f6cd _REC_S1VAL_20_u1 255. _CNV_A_R_A_165_CM 0. 255. DISPLAY_IDENTIFIER fm_cal_ecm_mon_tron.Cxx_dtc_lb_xxx /end CHARACTERISTIC
/begin CHARACTERISTIC Cxx_obd_dc_ecm_mon_tron "" VALUE 0xa002f6ce _REC_S1VAL_20_u1 9. _CNV_A_R_A_165_CM 1. 10. DISPLAY_IDENTIFIER fm_cal_ecm_mon_tron.Cxx_obd_dc_xxx /end CHARACTERISTIC
/begin CHARACTERISTIC Cxx_conf_wal_esp_data_chr "" VALUE 0xa002f09c _REC_S1VAL_20_u1 3. _CNV_A_R_A_165_CM 0. 3. DISPLAY_IDENTIFIER fm_cal_esp_data_chr.fm_static_bitfield.Cxx_conf_wal_xxx BIT_MASK 0x3 /end CHARACTERISTIC
/begin CHARACTERISTIC Cxx_dtc_lb_esp_data_chr "" VALUE 0xa002f09d _REC_S1VAL_20_u1 255. _CNV_A_R_A_165_CM 0. 255. DISPLAY_IDENTIFIER fm_cal_esp_data_chr.Cxx_dtc_lb_xxx /end CHARACTERISTIC
/begin CHARACTERISTIC Cxx_conf_wal_esp_data_seq_ctr "" VALUE 0xa002f0a8 _REC_S1VAL_20_u1 3. _CNV_A_R_A_165_CM 0. 3. DISPLAY_IDENTIFIER fm_cal_esp_data_seq_ctr.fm_static_bitfield.Cxx_conf_wal_xxx BIT_MASK 0x3 /end CHARACTERISTIC
/begin CHARACTERISTIC Cxx_dtc_lb_esp_data_seq_ctr "" VALUE 0xa002f0a9 _REC_S1VAL_20_u1 255. _CNV_A_R_A_165_CM 0. 255. DISPLAY_IDENTIFIER fm_cal_esp_data_seq_ctr.Cxx_dtc_lb_xxx /end CHARACTERISTIC
/begin CHARACTERISTIC Cxx_conf_wal_esp_no_frm "" VALUE 0xa002f0b4 _REC_S1VAL_20_u1 3. _CNV_A_R_A_165_CM 0. 3. DISPLAY_IDENTIFIER fm_cal_esp_no_frm.fm_static_bitfield.Cxx_conf_wal_xxx BIT_MASK 0x3 /end CHARACTERISTIC
/begin CHARACTERISTIC Cxx_dtc_lb_esp_no_frm "" VALUE 0xa002f0b5 _REC_S1VAL_20_u1 255. _CNV_A_R_A_165_CM 0. 255. DISPLAY_IDENTIFIER fm_cal_esp_no_frm.Cxx_dtc_lb_xxx /end CHARACTERISTIC
/begin CHARACTERISTIC Cxx_dtc_obd_fsys_cpt "" VALUE 0xa002f42a _REC_S1VAL_20_u2 65535. _CNV_A_R_A_165_CM 0. 65535. DISPLAY_IDENTIFIER fm_cal_fsys_cpt.Cxx_dtc_obd_xxx /end CHARACTERISTIC
/begin CHARACTERISTIC Cxx_conf_wal_fsys_cpt "" VALUE 0xa002f42c _REC_S1VAL_20_u1 3. _CNV_A_R_A_165_CM 0. 3. DISPLAY_IDENTIFIER fm_cal_fsys_cpt.fm_static_bitfield.Cxx_conf_wal_xxx BIT_MASK 0x3 /end CHARACTERISTIC
/begin CHARACTERISTIC Cbx_obd_fsys_cpt "" VALUE 0xa002f42c _REC_S1VAL_20_u1 255. _CNV_A_R_A_165_CM 0. 255. DISPLAY_IDENTIFIER fm_cal_fsys_cpt.fm_static_bitfield.Cbx_obd_xxx BIT_MASK 0x4 /end CHARACTERISTIC
/begin CHARACTERISTIC Cbx_obd_mena_fsys_cpt "" VALUE 0xa002f42c _REC_S1VAL_20_u1 255. _CNV_A_R_A_165_CM 0. 255. DISPLAY_IDENTIFIER fm_cal_fsys_cpt.fm_static_bitfield.Cbx_obd_mena_xxx BIT_MASK 0x8 /end CHARACTERISTIC
/begin CHARACTERISTIC Cxx_dtc_lb_fsys_cpt "" VALUE 0xa002f42d _REC_S1VAL_20_u1 255. _CNV_A_R_A_165_CM 0. 255. DISPLAY_IDENTIFIER fm_cal_fsys_cpt.Cxx_dtc_lb_xxx /end CHARACTERISTIC
/begin CHARACTERISTIC Cxx_obd_dc_fsys_cpt "" VALUE 0xa002f42e _REC_S1VAL_20_u1 9. _CNV_A_R_A_165_CM 1. 10. DISPLAY_IDENTIFIER fm_cal_fsys_cpt.Cxx_obd_dc_xxx /end CHARACTERISTIC
/begin CHARACTERISTIC Cxx_dtc_obd_gas_pump_oc "" VALUE 0xa002f0be _REC_S1VAL_20_u2 65535. _CNV_A_R_A_165_CM 0. 65535. DISPLAY_IDENTIFIER fm_cal_gas_pump_oc.Cxx_dtc_obd_xxx /end CHARACTERISTIC
/begin CHARACTERISTIC Cxx_conf_wal_gas_pump_oc "" VALUE 0xa002f0c0 _REC_S1VAL_20_u1 3. _CNV_A_R_A_165_CM 0. 3. DISPLAY_IDENTIFIER fm_cal_gas_pump_oc.fm_static_bitfield.Cxx_conf_wal_xxx BIT_MASK 0x3 /end CHARACTERISTIC
/begin CHARACTERISTIC Cbx_obd_gas_pump_oc "" VALUE 0xa002f0c0 _REC_S1VAL_20_u1 255. _CNV_A_R_A_165_CM 0. 255. DISPLAY_IDENTIFIER fm_cal_gas_pump_oc.fm_static_bitfield.Cbx_obd_xxx BIT_MASK 0x4 /end CHARACTERISTIC
/begin CHARACTERISTIC Cbx_obd_mena_gas_pump_oc "" VALUE 0xa002f0c0 _REC_S1VAL_20_u1 255. _CNV_A_R_A_165_CM 0. 255. DISPLAY_IDENTIFIER fm_cal_gas_pump_oc.fm_static_bitfield.Cbx_obd_mena_xxx BIT_MASK 0x8 /end CHARACTERISTIC
/begin CHARACTERISTIC Cxx_dtc_lb_gas_pump_oc "" VALUE 0xa002f0c1 _REC_S1VAL_20_u1 255. _CNV_A_R_A_165_CM 0. 255. DISPLAY_IDENTIFIER fm_cal_gas_pump_oc.Cxx_dtc_lb_xxx /end CHARACTERISTIC
/begin CHARACTERISTIC Cxx_obd_dc_gas_pump_oc "" VALUE 0xa002f0c2 _REC_S1VAL_20_u1 9. _CNV_A_R_A_165_CM 1. 10. DISPLAY_IDENTIFIER fm_cal_gas_pump_oc.Cxx_obd_dc_xxx /end CHARACTERISTIC
/begin CHARACTERISTIC Cxx_dtc_obd_gas_pump_scg "" VALUE 0xa002f0ca _REC_S1VAL_20_u2 65535. _CNV_A_R_A_165_CM 0. 65535. DISPLAY_IDENTIFIER fm_cal_gas_pump_scg.Cxx_dtc_obd_xxx /end CHARACTERISTIC
/begin CHARACTERISTIC Cxx_conf_wal_gas_pump_scg "" VALUE 0xa002f0cc _REC_S1VAL_20_u1 3. _CNV_A_R_A_165_CM 0. 3. DISPLAY_IDENTIFIER fm_cal_gas_pump_scg.fm_static_bitfield.Cxx_conf_wal_xxx BIT_MASK 0x3 /end CHARACTERISTIC
/begin CHARACTERISTIC Cbx_obd_gas_pump_scg "" VALUE 0xa002f0cc _REC_S1VAL_20_u1 255. _CNV_A_R_A_165_CM 0. 255. DISPLAY_IDENTIFIER fm_cal_gas_pump_scg.fm_static_bitfield.Cbx_obd_xxx BIT_MASK 0x4 /end CHARACTERISTIC
/begin CHARACTERISTIC Cbx_obd_mena_gas_pump_scg "" VALUE 0xa002f0cc _REC_S1VAL_20_u1 255. _CNV_A_R_A_165_CM 0. 255. DISPLAY_IDENTIFIER fm_cal_gas_pump_scg.fm_static_bitfield.Cbx_obd_mena_xxx BIT_MASK 0x8 /end CHARACTERISTIC
/begin CHARACTERISTIC Cxx_dtc_lb_gas_pump_scg "" VALUE 0xa002f0cd _REC_S1VAL_20_u1 255. _CNV_A_R_A_165_CM 0. 255. DISPLAY_IDENTIFIER fm_cal_gas_pump_scg.Cxx_dtc_lb_xxx /end CHARACTERISTIC
/begin CHARACTERISTIC Cxx_obd_dc_gas_pump_scg "" VALUE 0xa002f0ce _REC_S1VAL_20_u1 9. _CNV_A_R_A_165_CM 1. 10. DISPLAY_IDENTIFIER fm_cal_gas_pump_scg.Cxx_obd_dc_xxx /end CHARACTERISTIC
/begin CHARACTERISTIC Cxx_dtc_obd_gas_pump_scw "" VALUE 0xa002f0d6 _REC_S1VAL_20_u2 65535. _CNV_A_R_A_165_CM 0. 65535. DISPLAY_IDENTIFIER fm_cal_gas_pump_scw.Cxx_dtc_obd_xxx /end CHARACTERISTIC
/begin CHARACTERISTIC Cxx_conf_wal_gas_pump_scw "" VALUE 0xa002f0d8 _REC_S1VAL_20_u1 3. _CNV_A_R_A_165_CM 0. 3. DISPLAY_IDENTIFIER fm_cal_gas_pump_scw.fm_static_bitfield.Cxx_conf_wal_xxx BIT_MASK 0x3 /end CHARACTERISTIC
/begin CHARACTERISTIC Cbx_obd_gas_pump_scw "" VALUE 0xa002f0d8 _REC_S1VAL_20_u1 255. _CNV_A_R_A_165_CM 0. 255. DISPLAY_IDENTIFIER fm_cal_gas_pump_scw.fm_static_bitfield.Cbx_obd_xxx BIT_MASK 0x4 /end CHARACTERISTIC
/begin CHARACTERISTIC Cbx_obd_mena_gas_pump_scw "" VALUE 0xa002f0d8 _REC_S1VAL_20_u1 255. _CNV_A_R_A_165_CM 0. 255. DISPLAY_IDENTIFIER fm_cal_gas_pump_scw.fm_static_bitfield.Cbx_obd_mena_xxx BIT_MASK 0x8 /end CHARACTERISTIC
/begin CHARACTERISTIC Cxx_dtc_lb_gas_pump_scw "" VALUE 0xa002f0d9 _REC_S1VAL_20_u1 255. _CNV_A_R_A_165_CM 0. 255. DISPLAY_IDENTIFIER fm_cal_gas_pump_scw.Cxx_dtc_lb_xxx /end CHARACTERISTIC
/begin CHARACTERISTIC Cxx_obd_dc_gas_pump_scw "" VALUE 0xa002f0da _REC_S1VAL_20_u1 9. _CNV_A_R_A_165_CM 1. 10. DISPLAY_IDENTIFIER fm_cal_gas_pump_scw.Cxx_obd_dc_xxx /end CHARACTERISTIC
/begin CHARACTERISTIC Cxx_dtc_obd_igc_1_oc "" VALUE 0xa002f78a _REC_S1VAL_20_u2 65535. _CNV_A_R_A_165_CM 0. 65535. DISPLAY_IDENTIFIER fm_cal_igc_1_oc.Cxx_dtc_obd_xxx /end CHARACTERISTIC
/begin CHARACTERISTIC Cxx_conf_wal_igc_1_oc "" VALUE 0xa002f78c _REC_S1VAL_20_u1 3. _CNV_A_R_A_165_CM 0. 3. DISPLAY_IDENTIFIER fm_cal_igc_1_oc.fm_static_bitfield.Cxx_conf_wal_xxx BIT_MASK 0x3 /end CHARACTERISTIC
/begin CHARACTERISTIC Cbx_obd_igc_1_oc "" VALUE 0xa002f78c _REC_S1VAL_20_u1 255. _CNV_A_R_A_165_CM 0. 255. DISPLAY_IDENTIFIER fm_cal_igc_1_oc.fm_static_bitfield.Cbx_obd_xxx BIT_MASK 0x4 /end CHARACTERISTIC
/begin CHARACTERISTIC Cbx_obd_mena_igc_1_oc "" VALUE 0xa002f78c _REC_S1VAL_20_u1 255. _CNV_A_R_A_165_CM 0. 255. DISPLAY_IDENTIFIER fm_cal_igc_1_oc.fm_static_bitfield.Cbx_obd_mena_xxx BIT_MASK 0x8 /end CHARACTERISTIC
/begin CHARACTERISTIC Cxx_dtc_lb_igc_1_oc "" VALUE 0xa002f78d _REC_S1VAL_20_u1 255. _CNV_A_R_A_165_CM 0. 255. DISPLAY_IDENTIFIER fm_cal_igc_1_oc.Cxx_dtc_lb_xxx /end CHARACTERISTIC
/begin CHARACTERISTIC Cxx_obd_dc_igc_1_oc "" VALUE 0xa002f78e _REC_S1VAL_20_u1 9. _CNV_A_R_A_165_CM 1. 10. DISPLAY_IDENTIFIER fm_cal_igc_1_oc.Cxx_obd_dc_xxx /end CHARACTERISTIC
/begin CHARACTERISTIC Cxx_dtc_obd_igc_1_scg "" VALUE 0xa002f796 _REC_S1VAL_20_u2 65535. _CNV_A_R_A_165_CM 0. 65535. DISPLAY_IDENTIFIER fm_cal_igc_1_scg.Cxx_dtc_obd_xxx /end CHARACTERISTIC
/begin CHARACTERISTIC Cxx_conf_wal_igc_1_scg "" VALUE 0xa002f798 _REC_S1VAL_20_u1 3. _CNV_A_R_A_165_CM 0. 3. DISPLAY_IDENTIFIER fm_cal_igc_1_scg.fm_static_bitfield.Cxx_conf_wal_xxx BIT_MASK 0x3 /end CHARACTERISTIC
/begin CHARACTERISTIC Cbx_obd_igc_1_scg "" VALUE 0xa002f798 _REC_S1VAL_20_u1 255. _CNV_A_R_A_165_CM 0. 255. DISPLAY_IDENTIFIER fm_cal_igc_1_scg.fm_static_bitfield.Cbx_obd_xxx BIT_MASK 0x4 /end CHARACTERISTIC
/begin CHARACTERISTIC Cbx_obd_mena_igc_1_scg "" VALUE 0xa002f798 _REC_S1VAL_20_u1 255. _CNV_A_R_A_165_CM 0. 255. DISPLAY_IDENTIFIER fm_cal_igc_1_scg.fm_static_bitfield.Cbx_obd_mena_xxx BIT_MASK 0x8 /end CHARACTERISTIC
/begin CHARACTERISTIC Cxx_dtc_lb_igc_1_scg "" VALUE 0xa002f799 _REC_S1VAL_20_u1 255. _CNV_A_R_A_165_CM 0. 255. DISPLAY_IDENTIFIER fm_cal_igc_1_scg.Cxx_dtc_lb_xxx /end CHARACTERISTIC
/begin CHARACTERISTIC Cxx_obd_dc_igc_1_scg "" VALUE 0xa002f79a _REC_S1VAL_20_u1 9. _CNV_A_R_A_165_CM 1. 10. DISPLAY_IDENTIFIER fm_cal_igc_1_scg.Cxx_obd_dc_xxx /end CHARACTERISTIC
/begin CHARACTERISTIC Cxx_dtc_obd_igc_1_scw "" VALUE 0xa002f7a2 _REC_S1VAL_20_u2 65535. _CNV_A_R_A_165_CM 0. 65535. DISPLAY_IDENTIFIER fm_cal_igc_1_scw.Cxx_dtc_obd_xxx /end CHARACTERISTIC
/begin CHARACTERISTIC Cxx_conf_wal_igc_1_scw "" VALUE 0xa002f7a4 _REC_S1VAL_20_u1 3. _CNV_A_R_A_165_CM 0. 3. DISPLAY_IDENTIFIER fm_cal_igc_1_scw.fm_static_bitfield.Cxx_conf_wal_xxx BIT_MASK 0x3 /end CHARACTERISTIC
/begin CHARACTERISTIC Cbx_obd_igc_1_scw "" VALUE 0xa002f7a4 _REC_S1VAL_20_u1 255. _CNV_A_R_A_165_CM 0. 255. DISPLAY_IDENTIFIER fm_cal_igc_1_scw.fm_static_bitfield.Cbx_obd_xxx BIT_MASK 0x4 /end CHARACTERISTIC
/begin CHARACTERISTIC Cbx_obd_mena_igc_1_scw "" VALUE 0xa002f7a4 _REC_S1VAL_20_u1 255. _CNV_A_R_A_165_CM 0. 255. DISPLAY_IDENTIFIER fm_cal_igc_1_scw.fm_static_bitfield.Cbx_obd_mena_xxx BIT_MASK 0x8 /end CHARACTERISTIC
/begin CHARACTERISTIC Cxx_dtc_lb_igc_1_scw "" VALUE 0xa002f7a5 _REC_S1VAL_20_u1 255. _CNV_A_R_A_165_CM 0. 255. DISPLAY_IDENTIFIER fm_cal_igc_1_scw.Cxx_dtc_lb_xxx /end CHARACTERISTIC
/begin CHARACTERISTIC Cxx_obd_dc_igc_1_scw "" VALUE 0xa002f7a6 _REC_S1VAL_20_u1 9. _CNV_A_R_A_165_CM 1. 10. DISPLAY_IDENTIFIER fm_cal_igc_1_scw.Cxx_obd_dc_xxx /end CHARACTERISTIC
/begin CHARACTERISTIC Cxx_dtc_obd_igc_2_oc "" VALUE 0xa002f7ae _REC_S1VAL_20_u2 65535. _CNV_A_R_A_165_CM 0. 65535. DISPLAY_IDENTIFIER fm_cal_igc_2_oc.Cxx_dtc_obd_xxx /end CHARACTERISTIC
/begin CHARACTERISTIC Cxx_conf_wal_igc_2_oc "" VALUE 0xa002f7b0 _REC_S1VAL_20_u1 3. _CNV_A_R_A_165_CM 0. 3. DISPLAY_IDENTIFIER fm_cal_igc_2_oc.fm_static_bitfield.Cxx_conf_wal_xxx BIT_MASK 0x3 /end CHARACTERISTIC
/begin CHARACTERISTIC Cbx_obd_igc_2_oc "" VALUE 0xa002f7b0 _REC_S1VAL_20_u1 255. _CNV_A_R_A_165_CM 0. 255. DISPLAY_IDENTIFIER fm_cal_igc_2_oc.fm_static_bitfield.Cbx_obd_xxx BIT_MASK 0x4 /end CHARACTERISTIC
/begin CHARACTERISTIC Cbx_obd_mena_igc_2_oc "" VALUE 0xa002f7b0 _REC_S1VAL_20_u1 255. _CNV_A_R_A_165_CM 0. 255. DISPLAY_IDENTIFIER fm_cal_igc_2_oc.fm_static_bitfield.Cbx_obd_mena_xxx BIT_MASK 0x8 /end CHARACTERISTIC
/begin CHARACTERISTIC Cxx_dtc_lb_igc_2_oc "" VALUE 0xa002f7b1 _REC_S1VAL_20_u1 255. _CNV_A_R_A_165_CM 0. 255. DISPLAY_IDENTIFIER fm_cal_igc_2_oc.Cxx_dtc_lb_xxx /end CHARACTERISTIC
/begin CHARACTERISTIC Cxx_obd_dc_igc_2_oc "" VALUE 0xa002f7b2 _REC_S1VAL_20_u1 9. _CNV_A_R_A_165_CM 1. 10. DISPLAY_IDENTIFIER fm_cal_igc_2_oc.Cxx_obd_dc_xxx /end CHARACTERISTIC
/begin CHARACTERISTIC Cxx_dtc_obd_igc_2_scg "" VALUE 0xa002f7de _REC_S1VAL_20_u2 65535. _CNV_A_R_A_165_CM 0. 65535. DISPLAY_IDENTIFIER fm_cal_igc_2_scg.Cxx_dtc_obd_xxx /end CHARACTERISTIC
/begin CHARACTERISTIC Cxx_conf_wal_igc_2_scg "" VALUE 0xa002f7e0 _REC_S1VAL_20_u1 3. _CNV_A_R_A_165_CM 0. 3. DISPLAY_IDENTIFIER fm_cal_igc_2_scg.fm_static_bitfield.Cxx_conf_wal_xxx BIT_MASK 0x3 /end CHARACTERISTIC
/begin CHARACTERISTIC Cbx_obd_igc_2_scg "" VALUE 0xa002f7e0 _REC_S1VAL_20_u1 255. _CNV_A_R_A_165_CM 0. 255. DISPLAY_IDENTIFIER fm_cal_igc_2_scg.fm_static_bitfield.Cbx_obd_xxx BIT_MASK 0x4 /end CHARACTERISTIC
/begin CHARACTERISTIC Cbx_obd_mena_igc_2_scg "" VALUE 0xa002f7e0 _REC_S1VAL_20_u1 255. _CNV_A_R_A_165_CM 0. 255. DISPLAY_IDENTIFIER fm_cal_igc_2_scg.fm_static_bitfield.Cbx_obd_mena_xxx BIT_MASK 0x8 /end CHARACTERISTIC
/begin CHARACTERISTIC Cxx_dtc_lb_igc_2_scg "" VALUE 0xa002f7e1 _REC_S1VAL_20_u1 255. _CNV_A_R_A_165_CM 0. 255. DISPLAY_IDENTIFIER fm_cal_igc_2_scg.Cxx_dtc_lb_xxx /end CHARACTERISTIC
/begin CHARACTERISTIC Cxx_obd_dc_igc_2_scg "" VALUE 0xa002f7e2 _REC_S1VAL_20_u1 9. _CNV_A_R_A_165_CM 1. 10. DISPLAY_IDENTIFIER fm_cal_igc_2_scg.Cxx_obd_dc_xxx /end CHARACTERISTIC
/begin CHARACTERISTIC Cxx_dtc_obd_igc_2_scw "" VALUE 0xa002f7ea _REC_S1VAL_20_u2 65535. _CNV_A_R_A_165_CM 0. 65535. DISPLAY_IDENTIFIER fm_cal_igc_2_scw.Cxx_dtc_obd_xxx /end CHARACTERISTIC
/begin CHARACTERISTIC Cxx_conf_wal_igc_2_scw "" VALUE 0xa002f7ec _REC_S1VAL_20_u1 3. _CNV_A_R_A_165_CM 0. 3. DISPLAY_IDENTIFIER fm_cal_igc_2_scw.fm_static_bitfield.Cxx_conf_wal_xxx BIT_MASK 0x3 /end CHARACTERISTIC
/begin CHARACTERISTIC Cbx_obd_igc_2_scw "" VALUE 0xa002f7ec _REC_S1VAL_20_u1 255. _CNV_A_R_A_165_CM 0. 255. DISPLAY_IDENTIFIER fm_cal_igc_2_scw.fm_static_bitfield.Cbx_obd_xxx BIT_MASK 0x4 /end CHARACTERISTIC
/begin CHARACTERISTIC Cbx_obd_mena_igc_2_scw "" VALUE 0xa002f7ec _REC_S1VAL_20_u1 255. _CNV_A_R_A_165_CM 0. 255. DISPLAY_IDENTIFIER fm_cal_igc_2_scw.fm_static_bitfield.Cbx_obd_mena_xxx BIT_MASK 0x8 /end CHARACTERISTIC
/begin CHARACTERISTIC Cxx_dtc_lb_igc_2_scw "" VALUE 0xa002f7ed _REC_S1VAL_20_u1 255. _CNV_A_R_A_165_CM 0. 255. DISPLAY_IDENTIFIER fm_cal_igc_2_scw.Cxx_dtc_lb_xxx /end CHARACTERISTIC
/begin CHARACTERISTIC Cxx_obd_dc_igc_2_scw "" VALUE 0xa002f7ee _REC_S1VAL_20_u1 9. _CNV_A_R_A_165_CM 1. 10. DISPLAY_IDENTIFIER fm_cal_igc_2_scw.Cxx_obd_dc_xxx /end CHARACTERISTIC
/begin CHARACTERISTIC Cxx_dtc_obd_igc_3_oc "" VALUE 0xa002f7f6 _REC_S1VAL_20_u2 65535. _CNV_A_R_A_165_CM 0. 65535. DISPLAY_IDENTIFIER fm_cal_igc_3_oc.Cxx_dtc_obd_xxx /end CHARACTERISTIC
/begin CHARACTERISTIC Cxx_conf_wal_igc_3_oc "" VALUE 0xa002f7f8 _REC_S1VAL_20_u1 3. _CNV_A_R_A_165_CM 0. 3. DISPLAY_IDENTIFIER fm_cal_igc_3_oc.fm_static_bitfield.Cxx_conf_wal_xxx BIT_MASK 0x3 /end CHARACTERISTIC
/begin CHARACTERISTIC Cbx_obd_igc_3_oc "" VALUE 0xa002f7f8 _REC_S1VAL_20_u1 255. _CNV_A_R_A_165_CM 0. 255. DISPLAY_IDENTIFIER fm_cal_igc_3_oc.fm_static_bitfield.Cbx_obd_xxx BIT_MASK 0x4 /end CHARACTERISTIC
/begin CHARACTERISTIC Cbx_obd_mena_igc_3_oc "" VALUE 0xa002f7f8 _REC_S1VAL_20_u1 255. _CNV_A_R_A_165_CM 0. 255. DISPLAY_IDENTIFIER fm_cal_igc_3_oc.fm_static_bitfield.Cbx_obd_mena_xxx BIT_MASK 0x8 /end CHARACTERISTIC
/begin CHARACTERISTIC Cxx_dtc_lb_igc_3_oc "" VALUE 0xa002f7f9 _REC_S1VAL_20_u1 255. _CNV_A_R_A_165_CM 0. 255. DISPLAY_IDENTIFIER fm_cal_igc_3_oc.Cxx_dtc_lb_xxx /end CHARACTERISTIC
/begin CHARACTERISTIC Cxx_obd_dc_igc_3_oc "" VALUE 0xa002f7fa _REC_S1VAL_20_u1 9. _CNV_A_R_A_165_CM 1. 10. DISPLAY_IDENTIFIER fm_cal_igc_3_oc.Cxx_obd_dc_xxx /end CHARACTERISTIC
/begin CHARACTERISTIC Cxx_dtc_obd_igc_3_scg "" VALUE 0xa002f802 _REC_S1VAL_20_u2 65535. _CNV_A_R_A_165_CM 0. 65535. DISPLAY_IDENTIFIER fm_cal_igc_3_scg.Cxx_dtc_obd_xxx /end CHARACTERISTIC
/begin CHARACTERISTIC Cxx_conf_wal_igc_3_scg "" VALUE 0xa002f804 _REC_S1VAL_20_u1 3. _CNV_A_R_A_165_CM 0. 3. DISPLAY_IDENTIFIER fm_cal_igc_3_scg.fm_static_bitfield.Cxx_conf_wal_xxx BIT_MASK 0x3 /end CHARACTERISTIC
/begin CHARACTERISTIC Cbx_obd_igc_3_scg "" VALUE 0xa002f804 _REC_S1VAL_20_u1 255. _CNV_A_R_A_165_CM 0. 255. DISPLAY_IDENTIFIER fm_cal_igc_3_scg.fm_static_bitfield.Cbx_obd_xxx BIT_MASK 0x4 /end CHARACTERISTIC
/begin CHARACTERISTIC Cbx_obd_mena_igc_3_scg "" VALUE 0xa002f804 _REC_S1VAL_20_u1 255. _CNV_A_R_A_165_CM 0. 255. DISPLAY_IDENTIFIER fm_cal_igc_3_scg.fm_static_bitfield.Cbx_obd_mena_xxx BIT_MASK 0x8 /end CHARACTERISTIC
/begin CHARACTERISTIC Cxx_dtc_lb_igc_3_scg "" VALUE 0xa002f805 _REC_S1VAL_20_u1 255. _CNV_A_R_A_165_CM 0. 255. DISPLAY_IDENTIFIER fm_cal_igc_3_scg.Cxx_dtc_lb_xxx /end CHARACTERISTIC
/begin CHARACTERISTIC Cxx_obd_dc_igc_3_scg "" VALUE 0xa002f806 _REC_S1VAL_20_u1 9. _CNV_A_R_A_165_CM 1. 10. DISPLAY_IDENTIFIER fm_cal_igc_3_scg.Cxx_obd_dc_xxx /end CHARACTERISTIC
/begin CHARACTERISTIC Cxx_dtc_obd_igc_3_scw "" VALUE 0xa002f80e _REC_S1VAL_20_u2 65535. _CNV_A_R_A_165_CM 0. 65535. DISPLAY_IDENTIFIER fm_cal_igc_3_scw.Cxx_dtc_obd_xxx /end CHARACTERISTIC
/begin CHARACTERISTIC Cxx_conf_wal_igc_3_scw "" VALUE 0xa002f810 _REC_S1VAL_20_u1 3. _CNV_A_R_A_165_CM 0. 3. DISPLAY_IDENTIFIER fm_cal_igc_3_scw.fm_static_bitfield.Cxx_conf_wal_xxx BIT_MASK 0x3 /end CHARACTERISTIC
/begin CHARACTERISTIC Cbx_obd_igc_3_scw "" VALUE 0xa002f810 _REC_S1VAL_20_u1 255. _CNV_A_R_A_165_CM 0. 255. DISPLAY_IDENTIFIER fm_cal_igc_3_scw.fm_static_bitfield.Cbx_obd_xxx BIT_MASK 0x4 /end CHARACTERISTIC
/begin CHARACTERISTIC Cbx_obd_mena_igc_3_scw "" VALUE 0xa002f810 _REC_S1VAL_20_u1 255. _CNV_A_R_A_165_CM 0. 255. DISPLAY_IDENTIFIER fm_cal_igc_3_scw.fm_static_bitfield.Cbx_obd_mena_xxx BIT_MASK 0x8 /end CHARACTERISTIC
/begin CHARACTERISTIC Cxx_dtc_lb_igc_3_scw "" VALUE 0xa002f811 _REC_S1VAL_20_u1 255. _CNV_A_R_A_165_CM 0. 255. DISPLAY_IDENTIFIER fm_cal_igc_3_scw.Cxx_dtc_lb_xxx /end CHARACTERISTIC
/begin CHARACTERISTIC Cxx_obd_dc_igc_3_scw "" VALUE 0xa002f812 _REC_S1VAL_20_u1 9. _CNV_A_R_A_165_CM 1. 10. DISPLAY_IDENTIFIER fm_cal_igc_3_scw.Cxx_obd_dc_xxx /end CHARACTERISTIC
/begin CHARACTERISTIC Cxx_dtc_obd_igc_4_oc "" VALUE 0xa002f81a _REC_S1VAL_20_u2 65535. _CNV_A_R_A_165_CM 0. 65535. DISPLAY_IDENTIFIER fm_cal_igc_4_oc.Cxx_dtc_obd_xxx /end CHARACTERISTIC
/begin CHARACTERISTIC Cxx_conf_wal_igc_4_oc "" VALUE 0xa002f81c _REC_S1VAL_20_u1 3. _CNV_A_R_A_165_CM 0. 3. DISPLAY_IDENTIFIER fm_cal_igc_4_oc.fm_static_bitfield.Cxx_conf_wal_xxx BIT_MASK 0x3 /end CHARACTERISTIC
/begin CHARACTERISTIC Cbx_obd_igc_4_oc "" VALUE 0xa002f81c _REC_S1VAL_20_u1 255. _CNV_A_R_A_165_CM 0. 255. DISPLAY_IDENTIFIER fm_cal_igc_4_oc.fm_static_bitfield.Cbx_obd_xxx BIT_MASK 0x4 /end CHARACTERISTIC
/begin CHARACTERISTIC Cbx_obd_mena_igc_4_oc "" VALUE 0xa002f81c _REC_S1VAL_20_u1 255. _CNV_A_R_A_165_CM 0. 255. DISPLAY_IDENTIFIER fm_cal_igc_4_oc.fm_static_bitfield.Cbx_obd_mena_xxx BIT_MASK 0x8 /end CHARACTERISTIC
/begin CHARACTERISTIC Cxx_dtc_lb_igc_4_oc "" VALUE 0xa002f81d _REC_S1VAL_20_u1 255. _CNV_A_R_A_165_CM 0. 255. DISPLAY_IDENTIFIER fm_cal_igc_4_oc.Cxx_dtc_lb_xxx /end CHARACTERISTIC
/begin CHARACTERISTIC Cxx_obd_dc_igc_4_oc "" VALUE 0xa002f81e _REC_S1VAL_20_u1 9. _CNV_A_R_A_165_CM 1. 10. DISPLAY_IDENTIFIER fm_cal_igc_4_oc.Cxx_obd_dc_xxx /end CHARACTERISTIC
/begin CHARACTERISTIC Cxx_dtc_obd_igc_4_scg "" VALUE 0xa002f826 _REC_S1VAL_20_u2 65535. _CNV_A_R_A_165_CM 0. 65535. DISPLAY_IDENTIFIER fm_cal_igc_4_scg.Cxx_dtc_obd_xxx /end CHARACTERISTIC
/begin CHARACTERISTIC Cxx_conf_wal_igc_4_scg "" VALUE 0xa002f828 _REC_S1VAL_20_u1 3. _CNV_A_R_A_165_CM 0. 3. DISPLAY_IDENTIFIER fm_cal_igc_4_scg.fm_static_bitfield.Cxx_conf_wal_xxx BIT_MASK 0x3 /end CHARACTERISTIC
/begin CHARACTERISTIC Cbx_obd_igc_4_scg "" VALUE 0xa002f828 _REC_S1VAL_20_u1 255. _CNV_A_R_A_165_CM 0. 255. DISPLAY_IDENTIFIER fm_cal_igc_4_scg.fm_static_bitfield.Cbx_obd_xxx BIT_MASK 0x4 /end CHARACTERISTIC
/begin CHARACTERISTIC Cbx_obd_mena_igc_4_scg "" VALUE 0xa002f828 _REC_S1VAL_20_u1 255. _CNV_A_R_A_165_CM 0. 255. DISPLAY_IDENTIFIER fm_cal_igc_4_scg.fm_static_bitfield.Cbx_obd_mena_xxx BIT_MASK 0x8 /end CHARACTERISTIC
/begin CHARACTERISTIC Cxx_dtc_lb_igc_4_scg "" VALUE 0xa002f829 _REC_S1VAL_20_u1 255. _CNV_A_R_A_165_CM 0. 255. DISPLAY_IDENTIFIER fm_cal_igc_4_scg.Cxx_dtc_lb_xxx /end CHARACTERISTIC
/begin CHARACTERISTIC Cxx_obd_dc_igc_4_scg "" VALUE 0xa002f82a _REC_S1VAL_20_u1 9. _CNV_A_R_A_165_CM 1. 10. DISPLAY_IDENTIFIER fm_cal_igc_4_scg.Cxx_obd_dc_xxx /end CHARACTERISTIC
/begin CHARACTERISTIC Cxx_dtc_obd_igc_4_scw "" VALUE 0xa002f832 _REC_S1VAL_20_u2 65535. _CNV_A_R_A_165_CM 0. 65535. DISPLAY_IDENTIFIER fm_cal_igc_4_scw.Cxx_dtc_obd_xxx /end CHARACTERISTIC
/begin CHARACTERISTIC Cxx_conf_wal_igc_4_scw "" VALUE 0xa002f834 _REC_S1VAL_20_u1 3. _CNV_A_R_A_165_CM 0. 3. DISPLAY_IDENTIFIER fm_cal_igc_4_scw.fm_static_bitfield.Cxx_conf_wal_xxx BIT_MASK 0x3 /end CHARACTERISTIC
/begin CHARACTERISTIC Cbx_obd_igc_4_scw "" VALUE 0xa002f834 _REC_S1VAL_20_u1 255. _CNV_A_R_A_165_CM 0. 255. DISPLAY_IDENTIFIER fm_cal_igc_4_scw.fm_static_bitfield.Cbx_obd_xxx BIT_MASK 0x4 /end CHARACTERISTIC
/begin CHARACTERISTIC Cbx_obd_mena_igc_4_scw "" VALUE 0xa002f834 _REC_S1VAL_20_u1 255. _CNV_A_R_A_165_CM 0. 255. DISPLAY_IDENTIFIER fm_cal_igc_4_scw.fm_static_bitfield.Cbx_obd_mena_xxx BIT_MASK 0x8 /end CHARACTERISTIC
/begin CHARACTERISTIC Cxx_dtc_lb_igc_4_scw "" VALUE 0xa002f835 _REC_S1VAL_20_u1 255. _CNV_A_R_A_165_CM 0. 255. DISPLAY_IDENTIFIER fm_cal_igc_4_scw.Cxx_dtc_lb_xxx /end CHARACTERISTIC
/begin CHARACTERISTIC Cxx_obd_dc_igc_4_scw "" VALUE 0xa002f836 _REC_S1VAL_20_u1 9. _CNV_A_R_A_165_CM 1. 10. DISPLAY_IDENTIFIER fm_cal_igc_4_scw.Cxx_obd_dc_xxx /end CHARACTERISTIC
/begin CHARACTERISTIC Cxx_dtc_obd_in_cam_chr "" VALUE 0xa002f652 _REC_S1VAL_20_u2 65535. _CNV_A_R_A_165_CM 0. 65535. DISPLAY_IDENTIFIER fm_cal_in_cam_chr.Cxx_dtc_obd_xxx /end CHARACTERISTIC
/begin CHARACTERISTIC Cxx_conf_wal_in_cam_chr "" VALUE 0xa002f654 _REC_S1VAL_20_u1 3. _CNV_A_R_A_165_CM 0. 3. DISPLAY_IDENTIFIER fm_cal_in_cam_chr.fm_static_bitfield.Cxx_conf_wal_xxx BIT_MASK 0x3 /end CHARACTERISTIC
/begin CHARACTERISTIC Cbx_obd_in_cam_chr "" VALUE 0xa002f654 _REC_S1VAL_20_u1 255. _CNV_A_R_A_165_CM 0. 255. DISPLAY_IDENTIFIER fm_cal_in_cam_chr.fm_static_bitfield.Cbx_obd_xxx BIT_MASK 0x4 /end CHARACTERISTIC
/begin CHARACTERISTIC Cbx_obd_mena_in_cam_chr "" VALUE 0xa002f654 _REC_S1VAL_20_u1 255. _CNV_A_R_A_165_CM 0. 255. DISPLAY_IDENTIFIER fm_cal_in_cam_chr.fm_static_bitfield.Cbx_obd_mena_xxx BIT_MASK 0x8 /end CHARACTERISTIC
/begin CHARACTERISTIC Cxx_dtc_lb_in_cam_chr "" VALUE 0xa002f655 _REC_S1VAL_20_u1 255. _CNV_A_R_A_165_CM 0. 255. DISPLAY_IDENTIFIER fm_cal_in_cam_chr.Cxx_dtc_lb_xxx /end CHARACTERISTIC
/begin CHARACTERISTIC Cxx_obd_dc_in_cam_chr "" VALUE 0xa002f656 _REC_S1VAL_20_u1 9. _CNV_A_R_A_165_CM 1. 10. DISPLAY_IDENTIFIER fm_cal_in_cam_chr.Cxx_obd_dc_xxx /end CHARACTERISTIC
/begin CHARACTERISTIC Cxx_dtc_obd_in_cam_crk_cmp "" VALUE 0xa002f65e _REC_S1VAL_20_u2 65535. _CNV_A_R_A_165_CM 0. 65535. DISPLAY_IDENTIFIER fm_cal_in_cam_crk_cmp.Cxx_dtc_obd_xxx /end CHARACTERISTIC
/begin CHARACTERISTIC Cxx_conf_wal_in_cam_crk_cmp "" VALUE 0xa002f660 _REC_S1VAL_20_u1 3. _CNV_A_R_A_165_CM 0. 3. DISPLAY_IDENTIFIER fm_cal_in_cam_crk_cmp.fm_static_bitfield.Cxx_conf_wal_xxx BIT_MASK 0x3 /end CHARACTERISTIC
/begin CHARACTERISTIC Cbx_obd_in_cam_crk_cmp "" VALUE 0xa002f660 _REC_S1VAL_20_u1 255. _CNV_A_R_A_165_CM 0. 255. DISPLAY_IDENTIFIER fm_cal_in_cam_crk_cmp.fm_static_bitfield.Cbx_obd_xxx BIT_MASK 0x4 /end CHARACTERISTIC
/begin CHARACTERISTIC Cbx_obd_mena_in_cam_crk_cmp "" VALUE 0xa002f660 _REC_S1VAL_20_u1 255. _CNV_A_R_A_165_CM 0. 255. DISPLAY_IDENTIFIER fm_cal_in_cam_crk_cmp.fm_static_bitfield.Cbx_obd_mena_xxx BIT_MASK 0x8 /end CHARACTERISTIC
/begin CHARACTERISTIC Cxx_dtc_lb_in_cam_crk_cmp "" VALUE 0xa002f661 _REC_S1VAL_20_u1 255. _CNV_A_R_A_165_CM 0. 255. DISPLAY_IDENTIFIER fm_cal_in_cam_crk_cmp.Cxx_dtc_lb_xxx /end CHARACTERISTIC
/begin CHARACTERISTIC Cxx_obd_dc_in_cam_crk_cmp "" VALUE 0xa002f662 _REC_S1VAL_20_u1 9. _CNV_A_R_A_165_CM 1. 10. DISPLAY_IDENTIFIER fm_cal_in_cam_crk_cmp.Cxx_obd_dc_xxx /end CHARACTERISTIC
/begin CHARACTERISTIC Cxx_dtc_obd_in_cam_cyc "" VALUE 0xa002f71e _REC_S1VAL_20_u2 65535. _CNV_A_R_A_165_CM 0. 65535. DISPLAY_IDENTIFIER fm_cal_in_cam_cyc.Cxx_dtc_obd_xxx /end CHARACTERISTIC
/begin CHARACTERISTIC Cxx_conf_wal_in_cam_cyc "" VALUE 0xa002f720 _REC_S1VAL_20_u1 3. _CNV_A_R_A_165_CM 0. 3. DISPLAY_IDENTIFIER fm_cal_in_cam_cyc.fm_static_bitfield.Cxx_conf_wal_xxx BIT_MASK 0x3 /end CHARACTERISTIC
/begin CHARACTERISTIC Cbx_obd_in_cam_cyc "" VALUE 0xa002f720 _REC_S1VAL_20_u1 255. _CNV_A_R_A_165_CM 0. 255. DISPLAY_IDENTIFIER fm_cal_in_cam_cyc.fm_static_bitfield.Cbx_obd_xxx BIT_MASK 0x4 /end CHARACTERISTIC
/begin CHARACTERISTIC Cbx_obd_mena_in_cam_cyc "" VALUE 0xa002f720 _REC_S1VAL_20_u1 255. _CNV_A_R_A_165_CM 0. 255. DISPLAY_IDENTIFIER fm_cal_in_cam_cyc.fm_static_bitfield.Cbx_obd_mena_xxx BIT_MASK 0x8 /end CHARACTERISTIC
/begin CHARACTERISTIC Cxx_dtc_lb_in_cam_cyc "" VALUE 0xa002f721 _REC_S1VAL_20_u1 255. _CNV_A_R_A_165_CM 0. 255. DISPLAY_IDENTIFIER fm_cal_in_cam_cyc.Cxx_dtc_lb_xxx /end CHARACTERISTIC
/begin CHARACTERISTIC Cxx_obd_dc_in_cam_cyc "" VALUE 0xa002f722 _REC_S1VAL_20_u1 9. _CNV_A_R_A_165_CM 1. 10. DISPLAY_IDENTIFIER fm_cal_in_cam_cyc.Cxx_obd_dc_xxx /end CHARACTERISTIC
/begin CHARACTERISTIC Cxx_dtc_obd_in_cam_no_sig "" VALUE 0xa002f66a _REC_S1VAL_20_u2 65535. _CNV_A_R_A_165_CM 0. 65535. DISPLAY_IDENTIFIER fm_cal_in_cam_no_sig.Cxx_dtc_obd_xxx /end CHARACTERISTIC
/begin CHARACTERISTIC Cxx_conf_wal_in_cam_no_sig "" VALUE 0xa002f66c _REC_S1VAL_20_u1 3. _CNV_A_R_A_165_CM 0. 3. DISPLAY_IDENTIFIER fm_cal_in_cam_no_sig.fm_static_bitfield.Cxx_conf_wal_xxx BIT_MASK 0x3 /end CHARACTERISTIC
/begin CHARACTERISTIC Cbx_obd_in_cam_no_sig "" VALUE 0xa002f66c _REC_S1VAL_20_u1 255. _CNV_A_R_A_165_CM 0. 255. DISPLAY_IDENTIFIER fm_cal_in_cam_no_sig.fm_static_bitfield.Cbx_obd_xxx BIT_MASK 0x4 /end CHARACTERISTIC
/begin CHARACTERISTIC Cbx_obd_mena_in_cam_no_sig "" VALUE 0xa002f66c _REC_S1VAL_20_u1 255. _CNV_A_R_A_165_CM 0. 255. DISPLAY_IDENTIFIER fm_cal_in_cam_no_sig.fm_static_bitfield.Cbx_obd_mena_xxx BIT_MASK 0x8 /end CHARACTERISTIC
/begin CHARACTERISTIC Cxx_dtc_lb_in_cam_no_sig "" VALUE 0xa002f66d _REC_S1VAL_20_u1 255. _CNV_A_R_A_165_CM 0. 255. DISPLAY_IDENTIFIER fm_cal_in_cam_no_sig.Cxx_dtc_lb_xxx /end CHARACTERISTIC
/begin CHARACTERISTIC Cxx_obd_dc_in_cam_no_sig "" VALUE 0xa002f66e _REC_S1VAL_20_u1 9. _CNV_A_R_A_165_CM 1. 10. DISPLAY_IDENTIFIER fm_cal_in_cam_no_sig.Cxx_obd_dc_xxx /end CHARACTERISTIC
/begin CHARACTERISTIC Cxx_dtc_obd_in_cam_nok "" VALUE 0xa002f712 _REC_S1VAL_20_u2 65535. _CNV_A_R_A_165_CM 0. 65535. DISPLAY_IDENTIFIER fm_cal_in_cam_nok.Cxx_dtc_obd_xxx /end CHARACTERISTIC
/begin CHARACTERISTIC Cxx_conf_wal_in_cam_nok "" VALUE 0xa002f714 _REC_S1VAL_20_u1 3. _CNV_A_R_A_165_CM 0. 3. DISPLAY_IDENTIFIER fm_cal_in_cam_nok.fm_static_bitfield.Cxx_conf_wal_xxx BIT_MASK 0x3 /end CHARACTERISTIC
/begin CHARACTERISTIC Cbx_obd_in_cam_nok "" VALUE 0xa002f714 _REC_S1VAL_20_u1 255. _CNV_A_R_A_165_CM 0. 255. DISPLAY_IDENTIFIER fm_cal_in_cam_nok.fm_static_bitfield.Cbx_obd_xxx BIT_MASK 0x4 /end CHARACTERISTIC
/begin CHARACTERISTIC Cbx_obd_mena_in_cam_nok "" VALUE 0xa002f714 _REC_S1VAL_20_u1 255. _CNV_A_R_A_165_CM 0. 255. DISPLAY_IDENTIFIER fm_cal_in_cam_nok.fm_static_bitfield.Cbx_obd_mena_xxx BIT_MASK 0x8 /end CHARACTERISTIC
/begin CHARACTERISTIC Cxx_dtc_lb_in_cam_nok "" VALUE 0xa002f715 _REC_S1VAL_20_u1 255. _CNV_A_R_A_165_CM 0. 255. DISPLAY_IDENTIFIER fm_cal_in_cam_nok.Cxx_dtc_lb_xxx /end CHARACTERISTIC
/begin CHARACTERISTIC Cxx_obd_dc_in_cam_nok "" VALUE 0xa002f716 _REC_S1VAL_20_u1 9. _CNV_A_R_A_165_CM 1. 10. DISPLAY_IDENTIFIER fm_cal_in_cam_nok.Cxx_obd_dc_xxx /end CHARACTERISTIC
/begin CHARACTERISTIC Cxx_dtc_obd_in_vvtc_ad "" VALUE 0xa002f676 _REC_S1VAL_20_u2 65535. _CNV_A_R_A_165_CM 0. 65535. DISPLAY_IDENTIFIER fm_cal_in_vvtc_ad.Cxx_dtc_obd_xxx /end CHARACTERISTIC
/begin CHARACTERISTIC Cxx_conf_wal_in_vvtc_ad "" VALUE 0xa002f678 _REC_S1VAL_20_u1 3. _CNV_A_R_A_165_CM 0. 3. DISPLAY_IDENTIFIER fm_cal_in_vvtc_ad.fm_static_bitfield.Cxx_conf_wal_xxx BIT_MASK 0x3 /end CHARACTERISTIC
/begin CHARACTERISTIC Cbx_obd_in_vvtc_ad "" VALUE 0xa002f678 _REC_S1VAL_20_u1 255. _CNV_A_R_A_165_CM 0. 255. DISPLAY_IDENTIFIER fm_cal_in_vvtc_ad.fm_static_bitfield.Cbx_obd_xxx BIT_MASK 0x4 /end CHARACTERISTIC
/begin CHARACTERISTIC Cbx_obd_mena_in_vvtc_ad "" VALUE 0xa002f678 _REC_S1VAL_20_u1 255. _CNV_A_R_A_165_CM 0. 255. DISPLAY_IDENTIFIER fm_cal_in_vvtc_ad.fm_static_bitfield.Cbx_obd_mena_xxx BIT_MASK 0x8 /end CHARACTERISTIC
/begin CHARACTERISTIC Cxx_dtc_lb_in_vvtc_ad "" VALUE 0xa002f679 _REC_S1VAL_20_u1 255. _CNV_A_R_A_165_CM 0. 255. DISPLAY_IDENTIFIER fm_cal_in_vvtc_ad.Cxx_dtc_lb_xxx /end CHARACTERISTIC
/begin CHARACTERISTIC Cxx_obd_dc_in_vvtc_ad "" VALUE 0xa002f67a _REC_S1VAL_20_u1 9. _CNV_A_R_A_165_CM 1. 10. DISPLAY_IDENTIFIER fm_cal_in_vvtc_ad.Cxx_obd_dc_xxx /end CHARACTERISTIC
/begin CHARACTERISTIC Cxx_dtc_obd_in_vvtc_blk "" VALUE 0xa002f0e2 _REC_S1VAL_20_u2 65535. _CNV_A_R_A_165_CM 0. 65535. DISPLAY_IDENTIFIER fm_cal_in_vvtc_blk.Cxx_dtc_obd_xxx /end CHARACTERISTIC
/begin CHARACTERISTIC Cxx_conf_wal_in_vvtc_blk "" VALUE 0xa002f0e4 _REC_S1VAL_20_u1 3. _CNV_A_R_A_165_CM 0. 3. DISPLAY_IDENTIFIER fm_cal_in_vvtc_blk.fm_static_bitfield.Cxx_conf_wal_xxx BIT_MASK 0x3 /end CHARACTERISTIC
/begin CHARACTERISTIC Cbx_obd_in_vvtc_blk "" VALUE 0xa002f0e4 _REC_S1VAL_20_u1 255. _CNV_A_R_A_165_CM 0. 255. DISPLAY_IDENTIFIER fm_cal_in_vvtc_blk.fm_static_bitfield.Cbx_obd_xxx BIT_MASK 0x4 /end CHARACTERISTIC
/begin CHARACTERISTIC Cbx_obd_mena_in_vvtc_blk "" VALUE 0xa002f0e4 _REC_S1VAL_20_u1 255. _CNV_A_R_A_165_CM 0. 255. DISPLAY_IDENTIFIER fm_cal_in_vvtc_blk.fm_static_bitfield.Cbx_obd_mena_xxx BIT_MASK 0x8 /end CHARACTERISTIC
/begin CHARACTERISTIC Cxx_dtc_lb_in_vvtc_blk "" VALUE 0xa002f0e5 _REC_S1VAL_20_u1 255. _CNV_A_R_A_165_CM 0. 255. DISPLAY_IDENTIFIER fm_cal_in_vvtc_blk.Cxx_dtc_lb_xxx /end CHARACTERISTIC
/begin CHARACTERISTIC Cxx_obd_dc_in_vvtc_blk "" VALUE 0xa002f0e6 _REC_S1VAL_20_u1 9. _CNV_A_R_A_165_CM 1. 10. DISPLAY_IDENTIFIER fm_cal_in_vvtc_blk.Cxx_obd_dc_xxx /end CHARACTERISTIC
/begin CHARACTERISTIC Cxx_dtc_obd_in_vvtc_dirt_lkg "" VALUE 0xa002f0ee _REC_S1VAL_20_u2 65535. _CNV_A_R_A_165_CM 0. 65535. DISPLAY_IDENTIFIER fm_cal_in_vvtc_dirt_lkg.Cxx_dtc_obd_xxx /end CHARACTERISTIC
/begin CHARACTERISTIC Cxx_conf_wal_in_vvtc_dirt_lkg "" VALUE 0xa002f0f0 _REC_S1VAL_20_u1 3. _CNV_A_R_A_165_CM 0. 3. DISPLAY_IDENTIFIER fm_cal_in_vvtc_dirt_lkg.fm_static_bitfield.Cxx_conf_wal_xxx BIT_MASK 0x3 /end CHARACTERISTIC
/begin CHARACTERISTIC Cbx_obd_in_vvtc_dirt_lkg "" VALUE 0xa002f0f0 _REC_S1VAL_20_u1 255. _CNV_A_R_A_165_CM 0. 255. DISPLAY_IDENTIFIER fm_cal_in_vvtc_dirt_lkg.fm_static_bitfield.Cbx_obd_xxx BIT_MASK 0x4 /end CHARACTERISTIC
/begin CHARACTERISTIC Cbx_obd_mena_in_vvtc_dirt_lkg "" VALUE 0xa002f0f0 _REC_S1VAL_20_u1 255. _CNV_A_R_A_165_CM 0. 255. DISPLAY_IDENTIFIER fm_cal_in_vvtc_dirt_lkg.fm_static_bitfield.Cbx_obd_mena_xxx BIT_MASK 0x8 /end CHARACTERISTIC
/begin CHARACTERISTIC Cxx_dtc_lb_in_vvtc_dirt_lkg "" VALUE 0xa002f0f1 _REC_S1VAL_20_u1 255. _CNV_A_R_A_165_CM 0. 255. DISPLAY_IDENTIFIER fm_cal_in_vvtc_dirt_lkg.Cxx_dtc_lb_xxx /end CHARACTERISTIC
/begin CHARACTERISTIC Cxx_obd_dc_in_vvtc_dirt_lkg "" VALUE 0xa002f0f2 _REC_S1VAL_20_u1 9. _CNV_A_R_A_165_CM 1. 10. DISPLAY_IDENTIFIER fm_cal_in_vvtc_dirt_lkg.Cxx_obd_dc_xxx /end CHARACTERISTIC
/begin CHARACTERISTIC Cxx_dtc_obd_in_vvtc_sldv_oc "" VALUE 0xa002f0fa _REC_S1VAL_20_u2 65535. _CNV_A_R_A_165_CM 0. 65535. DISPLAY_IDENTIFIER fm_cal_in_vvtc_sldv_oc.Cxx_dtc_obd_xxx /end CHARACTERISTIC
/begin CHARACTERISTIC Cxx_conf_wal_in_vvtc_sldv_oc "" VALUE 0xa002f0fc _REC_S1VAL_20_u1 3. _CNV_A_R_A_165_CM 0. 3. DISPLAY_IDENTIFIER fm_cal_in_vvtc_sldv_oc.fm_static_bitfield.Cxx_conf_wal_xxx BIT_MASK 0x3 /end CHARACTERISTIC
/begin CHARACTERISTIC Cbx_obd_in_vvtc_sldv_oc "" VALUE 0xa002f0fc _REC_S1VAL_20_u1 255. _CNV_A_R_A_165_CM 0. 255. DISPLAY_IDENTIFIER fm_cal_in_vvtc_sldv_oc.fm_static_bitfield.Cbx_obd_xxx BIT_MASK 0x4 /end CHARACTERISTIC
/begin CHARACTERISTIC Cbx_obd_mena_in_vvtc_sldv_oc "" VALUE 0xa002f0fc _REC_S1VAL_20_u1 255. _CNV_A_R_A_165_CM 0. 255. DISPLAY_IDENTIFIER fm_cal_in_vvtc_sldv_oc.fm_static_bitfield.Cbx_obd_mena_xxx BIT_MASK 0x8 /end CHARACTERISTIC
/begin CHARACTERISTIC Cxx_dtc_lb_in_vvtc_sldv_oc "" VALUE 0xa002f0fd _REC_S1VAL_20_u1 255. _CNV_A_R_A_165_CM 0. 255. DISPLAY_IDENTIFIER fm_cal_in_vvtc_sldv_oc.Cxx_dtc_lb_xxx /end CHARACTERISTIC
/begin CHARACTERISTIC Cxx_obd_dc_in_vvtc_sldv_oc "" VALUE 0xa002f0fe _REC_S1VAL_20_u1 9. _CNV_A_R_A_165_CM 1. 10. DISPLAY_IDENTIFIER fm_cal_in_vvtc_sldv_oc.Cxx_obd_dc_xxx /end CHARACTERISTIC
/begin CHARACTERISTIC Cxx_dtc_obd_in_vvtc_sldv_scg "" VALUE 0xa002f106 _REC_S1VAL_20_u2 65535. _CNV_A_R_A_165_CM 0. 65535. DISPLAY_IDENTIFIER fm_cal_in_vvtc_sldv_scg.Cxx_dtc_obd_xxx /end CHARACTERISTIC
/begin CHARACTERISTIC Cxx_conf_wal_in_vvtc_sldv_scg "" VALUE 0xa002f108 _REC_S1VAL_20_u1 3. _CNV_A_R_A_165_CM 0. 3. DISPLAY_IDENTIFIER fm_cal_in_vvtc_sldv_scg.fm_static_bitfield.Cxx_conf_wal_xxx BIT_MASK 0x3 /end CHARACTERISTIC
/begin CHARACTERISTIC Cbx_obd_in_vvtc_sldv_scg "" VALUE 0xa002f108 _REC_S1VAL_20_u1 255. _CNV_A_R_A_165_CM 0. 255. DISPLAY_IDENTIFIER fm_cal_in_vvtc_sldv_scg.fm_static_bitfield.Cbx_obd_xxx BIT_MASK 0x4 /end CHARACTERISTIC
/begin CHARACTERISTIC Cbx_obd_mena_in_vvtc_sldv_scg "" VALUE 0xa002f108 _REC_S1VAL_20_u1 255. _CNV_A_R_A_165_CM 0. 255. DISPLAY_IDENTIFIER fm_cal_in_vvtc_sldv_scg.fm_static_bitfield.Cbx_obd_mena_xxx BIT_MASK 0x8 /end CHARACTERISTIC
/begin CHARACTERISTIC Cxx_dtc_lb_in_vvtc_sldv_scg "" VALUE 0xa002f109 _REC_S1VAL_20_u1 255. _CNV_A_R_A_165_CM 0. 255. DISPLAY_IDENTIFIER fm_cal_in_vvtc_sldv_scg.Cxx_dtc_lb_xxx /end CHARACTERISTIC
/begin CHARACTERISTIC Cxx_obd_dc_in_vvtc_sldv_scg "" VALUE 0xa002f10a _REC_S1VAL_20_u1 9. _CNV_A_R_A_165_CM 1. 10. DISPLAY_IDENTIFIER fm_cal_in_vvtc_sldv_scg.Cxx_obd_dc_xxx /end CHARACTERISTIC
/begin CHARACTERISTIC Cxx_dtc_obd_in_vvtc_sldv_scw "" VALUE 0xa002f112 _REC_S1VAL_20_u2 65535. _CNV_A_R_A_165_CM 0. 65535. DISPLAY_IDENTIFIER fm_cal_in_vvtc_sldv_scw.Cxx_dtc_obd_xxx /end CHARACTERISTIC
/begin CHARACTERISTIC Cxx_conf_wal_in_vvtc_sldv_scw "" VALUE 0xa002f114 _REC_S1VAL_20_u1 3. _CNV_A_R_A_165_CM 0. 3. DISPLAY_IDENTIFIER fm_cal_in_vvtc_sldv_scw.fm_static_bitfield.Cxx_conf_wal_xxx BIT_MASK 0x3 /end CHARACTERISTIC
/begin CHARACTERISTIC Cbx_obd_in_vvtc_sldv_scw "" VALUE 0xa002f114 _REC_S1VAL_20_u1 255. _CNV_A_R_A_165_CM 0. 255. DISPLAY_IDENTIFIER fm_cal_in_vvtc_sldv_scw.fm_static_bitfield.Cbx_obd_xxx BIT_MASK 0x4 /end CHARACTERISTIC
/begin CHARACTERISTIC Cbx_obd_mena_in_vvtc_sldv_scw "" VALUE 0xa002f114 _REC_S1VAL_20_u1 255. _CNV_A_R_A_165_CM 0. 255. DISPLAY_IDENTIFIER fm_cal_in_vvtc_sldv_scw.fm_static_bitfield.Cbx_obd_mena_xxx BIT_MASK 0x8 /end CHARACTERISTIC
/begin CHARACTERISTIC Cxx_dtc_lb_in_vvtc_sldv_scw "" VALUE 0xa002f115 _REC_S1VAL_20_u1 255. _CNV_A_R_A_165_CM 0. 255. DISPLAY_IDENTIFIER fm_cal_in_vvtc_sldv_scw.Cxx_dtc_lb_xxx /end CHARACTERISTIC
/begin CHARACTERISTIC Cxx_obd_dc_in_vvtc_sldv_scw "" VALUE 0xa002f116 _REC_S1VAL_20_u1 9. _CNV_A_R_A_165_CM 1. 10. DISPLAY_IDENTIFIER fm_cal_in_vvtc_sldv_scw.Cxx_obd_dc_xxx /end CHARACTERISTIC
/begin CHARACTERISTIC Cxx_dtc_obd_inj1_oc "" VALUE 0xa002f136 _REC_S1VAL_20_u2 65535. _CNV_A_R_A_165_CM 0. 65535. DISPLAY_IDENTIFIER fm_cal_inj1_oc.Cxx_dtc_obd_xxx /end CHARACTERISTIC
/begin CHARACTERISTIC Cxx_conf_wal_inj1_oc "" VALUE 0xa002f138 _REC_S1VAL_20_u1 3. _CNV_A_R_A_165_CM 0. 3. DISPLAY_IDENTIFIER fm_cal_inj1_oc.fm_static_bitfield.Cxx_conf_wal_xxx BIT_MASK 0x3 /end CHARACTERISTIC
/begin CHARACTERISTIC Cbx_obd_inj1_oc "" VALUE 0xa002f138 _REC_S1VAL_20_u1 255. _CNV_A_R_A_165_CM 0. 255. DISPLAY_IDENTIFIER fm_cal_inj1_oc.fm_static_bitfield.Cbx_obd_xxx BIT_MASK 0x4 /end CHARACTERISTIC
/begin CHARACTERISTIC Cbx_obd_mena_inj1_oc "" VALUE 0xa002f138 _REC_S1VAL_20_u1 255. _CNV_A_R_A_165_CM 0. 255. DISPLAY_IDENTIFIER fm_cal_inj1_oc.fm_static_bitfield.Cbx_obd_mena_xxx BIT_MASK 0x8 /end CHARACTERISTIC
/begin CHARACTERISTIC Cxx_dtc_lb_inj1_oc "" VALUE 0xa002f139 _REC_S1VAL_20_u1 255. _CNV_A_R_A_165_CM 0. 255. DISPLAY_IDENTIFIER fm_cal_inj1_oc.Cxx_dtc_lb_xxx /end CHARACTERISTIC
/begin CHARACTERISTIC Cxx_obd_dc_inj1_oc "" VALUE 0xa002f13a _REC_S1VAL_20_u1 9. _CNV_A_R_A_165_CM 1. 10. DISPLAY_IDENTIFIER fm_cal_inj1_oc.Cxx_obd_dc_xxx /end CHARACTERISTIC
/begin CHARACTERISTIC Cxx_dtc_obd_inj1_scg "" VALUE 0xa002f142 _REC_S1VAL_20_u2 65535. _CNV_A_R_A_165_CM 0. 65535. DISPLAY_IDENTIFIER fm_cal_inj1_scg.Cxx_dtc_obd_xxx /end CHARACTERISTIC
/begin CHARACTERISTIC Cxx_conf_wal_inj1_scg "" VALUE 0xa002f144 _REC_S1VAL_20_u1 3. _CNV_A_R_A_165_CM 0. 3. DISPLAY_IDENTIFIER fm_cal_inj1_scg.fm_static_bitfield.Cxx_conf_wal_xxx BIT_MASK 0x3 /end CHARACTERISTIC
/begin CHARACTERISTIC Cbx_obd_inj1_scg "" VALUE 0xa002f144 _REC_S1VAL_20_u1 255. _CNV_A_R_A_165_CM 0. 255. DISPLAY_IDENTIFIER fm_cal_inj1_scg.fm_static_bitfield.Cbx_obd_xxx BIT_MASK 0x4 /end CHARACTERISTIC
/begin CHARACTERISTIC Cbx_obd_mena_inj1_scg "" VALUE 0xa002f144 _REC_S1VAL_20_u1 255. _CNV_A_R_A_165_CM 0. 255. DISPLAY_IDENTIFIER fm_cal_inj1_scg.fm_static_bitfield.Cbx_obd_mena_xxx BIT_MASK 0x8 /end CHARACTERISTIC
/begin CHARACTERISTIC Cxx_dtc_lb_inj1_scg "" VALUE 0xa002f145 _REC_S1VAL_20_u1 255. _CNV_A_R_A_165_CM 0. 255. DISPLAY_IDENTIFIER fm_cal_inj1_scg.Cxx_dtc_lb_xxx /end CHARACTERISTIC
/begin CHARACTERISTIC Cxx_obd_dc_inj1_scg "" VALUE 0xa002f146 _REC_S1VAL_20_u1 9. _CNV_A_R_A_165_CM 1. 10. DISPLAY_IDENTIFIER fm_cal_inj1_scg.Cxx_obd_dc_xxx /end CHARACTERISTIC
/begin CHARACTERISTIC Cxx_dtc_obd_inj1_scw "" VALUE 0xa002f14e _REC_S1VAL_20_u2 65535. _CNV_A_R_A_165_CM 0. 65535. DISPLAY_IDENTIFIER fm_cal_inj1_scw.Cxx_dtc_obd_xxx /end CHARACTERISTIC
/begin CHARACTERISTIC Cxx_conf_wal_inj1_scw "" VALUE 0xa002f150 _REC_S1VAL_20_u1 3. _CNV_A_R_A_165_CM 0. 3. DISPLAY_IDENTIFIER fm_cal_inj1_scw.fm_static_bitfield.Cxx_conf_wal_xxx BIT_MASK 0x3 /end CHARACTERISTIC
/begin CHARACTERISTIC Cbx_obd_inj1_scw "" VALUE 0xa002f150 _REC_S1VAL_20_u1 255. _CNV_A_R_A_165_CM 0. 255. DISPLAY_IDENTIFIER fm_cal_inj1_scw.fm_static_bitfield.Cbx_obd_xxx BIT_MASK 0x4 /end CHARACTERISTIC
/begin COMPU_METHOD _CNV_A_R_A_165_CM "" RAT_FUNC "%6.3" "" COEFFS 0 1. 0. 0 0 1 /end COMPU_METHOD
/begin RECORD_LAYOUT _REC_S1VAL_20_u1 FNC_VALUES 1 UBYTE COLUMN_DIR DIRECT /end RECORD_LAYOUT
/begin RECORD_LAYOUT _REC_S1VAL_20_u2 FNC_VALUES 1 UWORD COLUMN_DIR DIRECT /end RECORD_LAYOUT
/begin FUNCTION DgDftMng ""
 /begin DEF_CHARACTERISTIC Ctx_ffm_did_agb[4] Cxx_dtc_hmb_agb Ctx_ffm_did_agb_data[0] Ctx_ffm_did_agb_data[1] Ctx_ffm_did_agb_data[2] Ctx_ffm_did_agb_data[3] Ctx_ffm_did_agb_data[4] Cxx_dtc_hmb_agb_data Ctx_ffm_did_bgin_clu[0] Ctx_ffm_did_bgin_clu[1] Ctx_ffm_did_bgin_clu[2] Ctx_ffm_did_bgin_clu[3] Ctx_ffm_did_bgin_clu[4] Cxx_dtc_hmb_bgin_clu Ctx_ffm_did_brk_pdl[0] Ctx_ffm_did_brk_pdl[1] Ctx_ffm_did_brk_pdl[2] Ctx_ffm_did_brk_pdl[3] Ctx_ffm_did_brk_pdl[4] Cxx_dtc_hmb_brk_pdl Ctx_ffm_did_cata[0] Ctx_ffm_did_cata[1] Ctx_ffm_did_cata[2] Ctx_ffm_did_cata[3] Ctx_ffm_did_cata[4] Cxx_dtc_hmb_cata Ctx_ffm_did_cl_rich[0] Ctx_ffm_did_cl_rich[1] Ctx_ffm_did_cl_rich[2] Ctx_ffm_did_cl_rich[3] Ctx_ffm_did_cl_rich[4] Cxx_dtc_hmb_cl_rich Ctx_ffm_did_clu_cnt[0] Ctx_ffm_did_clu_cnt[1] Ctx_ffm_did_clu_cnt[2] Ctx_ffm_did_clu_cnt[3] Ctx_ffm_did_clu_cnt[4] Cxx_dtc_hmb_clu_cnt Ctx_ffm_did_cp[0] Ctx_ffm_did_cp[1] Ctx_ffm_did_cp[2] Ctx_ffm_did_cp[3] Ctx_ffm_did_cp[4] Cxx_dtc_hmb_cp Ctx_ffm_did_crk[0] Ctx_ffm_did_crk[1] Ctx_ffm_did_crk[2] Ctx_ffm_did_crk[3] Ctx_ffm_did_crk[4] Cxx_dtc_hmb_crk Ctx_ffm_did_cru[0] Ctx_ffm_did_cru[1] Ctx_ffm_did_cru[2] Ctx_ffm_did_cru[3] Ctx_ffm_did_cru[4] Cxx_dtc_hmb_cru Ctx_ffm_did_cru_sl[0] Ctx_ffm_did_cru_sl[1] Ctx_ffm_did_cru_sl[2] Ctx_ffm_did_cru_sl[3] Ctx_ffm_did_cru_sl[4] Cxx_dtc_hmb_cru_sl Ctx_ffm_did_cru_sl_swi[0] Ctx_ffm_did_cru_sl_swi[1] Ctx_ffm_did_cru_sl_swi[2] Ctx_ffm_did_cru_sl_swi[3] Ctx_ffm_did_cru_sl_swi[4] Cxx_dtc_hmb_cru_sl_swi Ctx_ffm_did_cru_vs[0] Ctx_ffm_did_cru_vs[1] Ctx_ffm_did_cru_vs[2] Ctx_ffm_did_cru_vs[3] Ctx_ffm_did_cru_vs[4] Cxx_dtc_hmb_cru_vs Ctx_ffm_did_cru_whl_cmd[0] Ctx_ffm_did_cru_whl_cmd[1] Ctx_ffm_did_cru_whl_cmd[2] Ctx_ffm_did_cru_whl_cmd[3] Ctx_ffm_did_cru_whl_cmd[4] Cxx_dtc_hmb_cru_whl_cmd Ctx_ffm_did_ecm_adc[0] Ctx_ffm_did_ecm_adc[1] Ctx_ffm_did_ecm_adc[2] Ctx_ffm_did_ecm_adc[3] Ctx_ffm_did_ecm_adc[4] Cxx_dtc_hmb_ecm_adc Ctx_ffm_did_ecm_err[0] Ctx_ffm_did_ecm_err[1] Ctx_ffm_did_ecm_err[2] Ctx_ffm_did_ecm_err[3] Ctx_ffm_did_ecm_err[4] Cxx_dtc_hmb_ecm_err Ctx_ffm_did_ecm_mon[0] Ctx_ffm_did_ecm_mon[1] Ctx_ffm_did_ecm_mon[2] Ctx_ffm_did_ecm_mon[3] Ctx_ffm_did_ecm_mon[4] Cxx_dtc_hmb_ecm_mon Ctx_ffm_did_esp[0] Ctx_ffm_did_esp[1] Ctx_ffm_did_esp[2] Ctx_ffm_did_esp[3] Ctx_ffm_did_esp[4] Cxx_dtc_hmb_esp Ctx_ffm_did_esp_data[0] Ctx_ffm_did_esp_data[1] Ctx_ffm_did_esp_data[2] Ctx_ffm_did_esp_data[3] Ctx_ffm_did_esp_data[4] Cxx_dtc_hmb_esp_data Ctx_ffm_did_fsys[0] Ctx_ffm_did_fsys[1] Ctx_ffm_did_fsys[2] Ctx_ffm_did_fsys[3] Ctx_ffm_did_fsys[4] Cxx_dtc_hmb_fsys Ctx_ffm_did_gas_pump[0] Ctx_ffm_did_gas_pump[1] Ctx_ffm_did_gas_pump[2] Ctx_ffm_did_gas_pump[3] Ctx_ffm_did_gas_pump[4] Cxx_dtc_hmb_gas_pump Ctx_ffm_did_igc_1[0] Ctx_ffm_did_igc_1[1] Ctx_ffm_did_igc_1[2] Ctx_ffm_did_igc_1[3] Ctx_ffm_did_igc_1[4] Cxx_dtc_hmb_igc_1 Ctx_ffm_did_igc_2[0] Ctx_ffm_did_igc_2[1] Ctx_ffm_did_igc_2[2] Ctx_ffm_did_igc_2[3] Ctx_ffm_did_igc_2[4] Cxx_dtc_hmb_igc_2 Ctx_ffm_did_igc_3[0] Ctx_ffm_did_igc_3[1] Ctx_ffm_did_igc_3[2] Ctx_ffm_did_igc_3[3] Ctx_ffm_did_igc_3[4] Cxx_dtc_hmb_igc_3 Ctx_ffm_did_igc_4[0] Ctx_ffm_did_igc_4[1] Ctx_ffm_did_igc_4[2] Ctx_ffm_did_igc_4[3] Ctx_ffm_did_igc_4[4] Cxx_dtc_hmb_igc_4 Ctx_ffm_did_in_cam[0] Ctx_ffm_did_in_cam[1] Ctx_ffm_did_in_cam[2] Ctx_ffm_did_in_cam[3] Ctx_ffm_did_in_cam[4] Cxx_dtc_hmb_in_cam Ctx_ffm_did_in_cam_crk[0] Ctx_ffm_did_in_cam_crk[1] Ctx_ffm_did_in_cam_crk[2] Ctx_ffm_did_in_cam_crk[3] Ctx_ffm_did_in_cam_crk[4] Cxx_dtc_hmb_in_cam_crk Ctx_ffm_did_in_vvtc[0] Ctx_ffm_did_in_vvtc[1] Ctx_ffm_did_in_vvtc[2] Ctx_ffm_did_in_vvtc[3] Ctx_ffm_did_in_vvtc[4] Cxx_dtc_hmb_in_vvtc Ctx_ffm_did_in_vvtc_sldv[0] Ctx_ffm_did_in_vvtc_sldv[1] Ctx_ffm_did_in_vvtc_sldv[2] Ctx_ffm_did_in_vvtc_sldv[3] Ctx_ffm_did_in_vvtc_sldv[4] Cxx_dtc_hmb_in_vvtc_sldv Ctx_ffm_did_inj1[0] Ctx_ffm_did_inj1[1] Ctx_ffm_did_inj1[2] Ctx_ffm_did_inj1[3] Ctx_ffm_did_inj1[4] Cxx_dtc_hmb_inj1 Ctx_ffm_did_inj2[0] Ctx_ffm_did_inj2[1] Ctx_ffm_did_inj2[2] Ctx_ffm_did_inj2[3] Ctx_ffm_did_inj2[4] Cxx_dtc_hmb_inj2 Ctx_ffm_did_inj3[0] Ctx_ffm_did_inj3[1] Ctx_ffm_did_inj3[2] Ctx_ffm_did_inj3[3] Ctx_ffm_did_inj3[4] Cxx_dtc_hmb_inj3 Ctx_ffm_did_inj4[0] Ctx_ffm_did_inj4[1] Ctx_ffm_did_inj4[2] Ctx_ffm_did_inj4[3] Ctx_ffm_did_inj4[4] Cxx_dtc_hmb_inj4 Ctx_ffm_did_inj_ecu[0] Ctx_ffm_did_inj_ecu[1] Ctx_ffm_did_inj_ecu[2] Ctx_ffm_did_inj_ecu[3] Ctx_ffm_did_inj_ecu[4] Cxx_dtc_hmb_inj_ecu Ctx_ffm_did_ip_lght_tco[0] Ctx_ffm_did_ip_lght_tco[1] Ctx_ffm_did_ip_lght_tco[2] Ctx_ffm_did_ip_lght_tco[3] Ctx_ffm_did_ip_lght_tco[4] Cxx_dtc_hmb_ip_lght_tco Ctx_ffm_did_it_cmd[0] Ctx_ffm_did_it_cmd[1] Ctx_ffm_did_it_cmd[2] Ctx_ffm_did_it_cmd[3] Ctx_ffm_did_it_cmd[4] Cxx_dtc_hmb_it_cmd Ctx_ffm_did_it_ofs[0] Ctx_ffm_did_it_ofs[1] Ctx_ffm_did_it_ofs[2] Ctx_ffm_did_it_ofs[3] Ctx_ffm_did_it_ofs[4] Cxx_dtc_hmb_it_ofs Ctx_ffm_did_it_reg[0] Ctx_ffm_did_it_reg[1] Ctx_ffm_did_it_reg[2] Ctx_ffm_did_it_reg[3] Ctx_ffm_did_it_reg[4] Cxx_dtc_hmb_it_reg Ctx_ffm_did_knk[0] Ctx_ffm_did_knk[1] Ctx_ffm_did_knk[2] Ctx_ffm_did_knk[3] Ctx_ffm_did_knk[4] Cxx_dtc_hmb_knk Ctx_ffm_did_lbdw[0] Ctx_ffm_did_lbdw[1] Ctx_ffm_did_lbdw[2] Ctx_ffm_did_lbdw[3] Ctx_ffm_did_lbdw[4] Cxx_dtc_hmb_lbdw Ctx_ffm_did_lbdw_hot[0] Ctx_ffm_did_lbdw_hot[1] Ctx_ffm_did_lbdw_hot[2] Ctx_ffm_did_lbdw_hot[3] Ctx_ffm_did_lbdw_hot[4] Cxx_dtc_hmb_lbdw_hot Ctx_ffm_did_lbup[0] Ctx_ffm_did_lbup[1] Ctx_ffm_did_lbup[2] Ctx_ffm_did_lbup[3] Ctx_ffm_did_lbup[4] Cxx_dtc_hmb_lbup Ctx_ffm_did_lbup_hot[0] Ctx_ffm_did_lbup_hot[1] Ctx_ffm_did_lbup_hot[2] Ctx_ffm_did_lbup_hot[3] Ctx_ffm_did_lbup_hot[4] Cxx_dtc_hmb_lbup_hot Ctx_ffm_did_map[0] Ctx_ffm_did_map[1] Ctx_ffm_did_map[2] Ctx_ffm_did_map[3] Ctx_ffm_did_map[4] Cxx_dtc_hmb_map Ctx_ffm_did_mis[0] Ctx_ffm_did_mis[1] Ctx_ffm_did_mis[2] Ctx_ffm_did_mis[3] Ctx_ffm_did_mis[4] Cxx_dtc_hmb_mis Ctx_ffm_did_mis_1[0] Ctx_ffm_did_mis_1[1] Ctx_ffm_did_mis_1[2] Ctx_ffm_did_mis_1[3] Ctx_ffm_did_mis_1[4] Cxx_dtc_hmb_mis_1 Ctx_ffm_did_mis_1_lpg[0] Ctx_ffm_did_mis_1_lpg[1] Ctx_ffm_did_mis_1_lpg[2] Ctx_ffm_did_mis_1_lpg[3] Ctx_ffm_did_mis_1_lpg[4] Cxx_dtc_hmb_mis_1_lpg Ctx_ffm_did_mis_2[0] Ctx_ffm_did_mis_2[1] Ctx_ffm_did_mis_2[2] Ctx_ffm_did_mis_2[3] Ctx_ffm_did_mis_2[4] Cxx_dtc_hmb_mis_2 Ctx_ffm_did_mis_2_lpg[0] Ctx_ffm_did_mis_2_lpg[1] Ctx_ffm_did_mis_2_lpg[2] Ctx_ffm_did_mis_2_lpg[3] Ctx_ffm_did_mis_2_lpg[4] Cxx_dtc_hmb_mis_2_lpg Ctx_ffm_did_mis_3[0] Ctx_ffm_did_mis_3[1] Ctx_ffm_did_mis_3[2] Ctx_ffm_did_mis_3[3] Ctx_ffm_did_mis_3[4] Cxx_dtc_hmb_mis_3 Ctx_ffm_did_mis_3_lpg[0] Ctx_ffm_did_mis_3_lpg[1] Ctx_ffm_did_mis_3_lpg[2] Ctx_ffm_did_mis_3_lpg[3] Ctx_ffm_did_mis_3_lpg[4] Cxx_dtc_hmb_mis_3_lpg Ctx_ffm_did_mis_4[0] Ctx_ffm_did_mis_4[1] Ctx_ffm_did_mis_4[2] Ctx_ffm_did_mis_4[3] Ctx_ffm_did_mis_4[4] Cxx_dtc_hmb_mis_4 Ctx_ffm_did_mis_4_lpg[0] Ctx_ffm_did_mis_4_lpg[1] Ctx_ffm_did_mis_4_lpg[2] Ctx_ffm_did_mis_4_lpg[3] Ctx_ffm_did_mis_4_lpg[4] Cxx_dtc_hmb_mis_4_lpg Ctx_ffm_did_mis_lpg[0] Ctx_ffm_did_mis_lpg[1] Ctx_ffm_did_mis_lpg[2] Ctx_ffm_did_mis_lpg[3] Ctx_ffm_did_mis_lpg[4] Cxx_dtc_hmb_mis_lpg Ctx_ffm_did_mis_min_fuel[0] Ctx_ffm_did_mis_min_fuel[1] Ctx_ffm_did_mis_min_fuel[2] Ctx_ffm_did_mis_min_fuel[3] Ctx_ffm_did_mis_min_fuel[4] Cxx_dtc_hmb_mis_min_fuel Ctx_ffm_did_mis_unk[0] Ctx_ffm_did_mis_unk[1] Ctx_ffm_did_mis_unk[2] Ctx_ffm_did_mis_unk[3] Ctx_ffm_did_mis_unk[4] Cxx_dtc_hmb_mis_unk Ctx_ffm_did_mis_unk_lpg[0] Ctx_ffm_did_mis_unk_lpg[1] Ctx_ffm_did_mis_unk_lpg[2] Ctx_ffm_did_mis_unk_lpg[3] Ctx_ffm_did_mis_unk_lpg[4] Cxx_dtc_hmb_mis_unk_lpg Ctx_ffm_did_ptc_rov[0] Ctx_ffm_did_ptc_rov[1] Ctx_ffm_did_ptc_rov[2] Ctx_ffm_did_ptc_rov[3] Ctx_ffm_did_ptc_rov[4] Cxx_dtc_hmb_ptc_rov Ctx_ffm_did_pws_1[0] Ctx_ffm_did_pws_1[1] Ctx_ffm_did_pws_1[2] Ctx_ffm_did_pws_1[3] Ctx_ffm_did_pws_1[4] Cxx_dtc_hmb_pws_1 Ctx_ffm_did_pws_2[0] Ctx_ffm_did_pws_2[1] Ctx_ffm_did_pws_2[2] Ctx_ffm_did_pws_2[3] Ctx_ffm_did_pws_2[4] Cxx_dtc_hmb_pws_2 Ctx_ffm_did_pws_3[0] Ctx_ffm_did_pws_3[1] Ctx_ffm_did_pws_3[2] Ctx_ffm_did_pws_3[3] Ctx_ffm_did_pws_3[4] Cxx_dtc_hmb_pws_3 Ctx_ffm_did_sens_it[0] Ctx_ffm_did_sens_it[1] Ctx_ffm_did_sens_it[2] Ctx_ffm_did_sens_it[3] Ctx_ffm_did_sens_it[4] Cxx_dtc_hmb_sens_it Ctx_ffm_did_sens_it_1[0] Ctx_ffm_did_sens_it_1[1] Ctx_ffm_did_sens_it_1[2] Ctx_ffm_did_sens_it_1[3] Ctx_ffm_did_sens_it_1[4] Cxx_dtc_hmb_sens_it_1 Ctx_ffm_did_sens_it_2[0] Ctx_ffm_did_sens_it_2[1] Ctx_ffm_did_sens_it_2[2] Ctx_ffm_did_sens_it_2[3] Ctx_ffm_did_sens_it_2[4] Cxx_dtc_hmb_sens_it_2 Ctx_ffm_did_sens_map[0] Ctx_ffm_did_sens_map[1] Ctx_ffm_did_sens_map[2] Ctx_ffm_did_sens_map[3] Ctx_ffm_did_sens_map[4] Cxx_dtc_hmb_sens_map Ctx_ffm_did_sens_mat[0] Ctx_ffm_did_sens_mat[1] Ctx_ffm_did_sens_mat[2] Ctx_ffm_did_sens_mat[3] Ctx_ffm_did_sens_mat[4] Cxx_dtc_hmb_sens_mat Ctx_ffm_did_sens_spg[0] Ctx_ffm_did_sens_spg[1] Ctx_ffm_did_sens_spg[2] Ctx_ffm_did_sens_spg[3] Ctx_ffm_did_sens_spg[4] Cxx_dtc_hmb_sens_spg Ctx_ffm_did_sens_tco[0] Ctx_ffm_did_sens_tco[1] Ctx_ffm_did_sens_tco[2] Ctx_ffm_did_sens_tco[3] Ctx_ffm_did_sens_tco[4] Cxx_dtc_hmb_sens_tco Ctx_ffm_did_sfty_tq[0] Ctx_ffm_did_sfty_tq[1] Ctx_ffm_did_sfty_tq[2] Ctx_ffm_did_sfty_tq[3] Ctx_ffm_did_sfty_tq[4] Cxx_dtc_hmb_sfty_tq Ctx_ffm_did_spg[0] Ctx_ffm_did_spg[1] Ctx_ffm_did_spg[2] Ctx_ffm_did_spg[3] Ctx_ffm_did_spg[4] Cxx_dtc_hmb_spg Ctx_ffm_did_spg_reg[0] Ctx_ffm_did_spg_reg[1] Ctx_ffm_did_spg_reg[2] Ctx_ffm_did_spg_reg[3] Ctx_ffm_did_spg_reg[4] Cxx_dtc_hmb_spg_reg Ctx_ffm_did_tlz_ad_b[0] Ctx_ffm_did_tlz_ad_b[1] Ctx_ffm_did_tlz_ad_b[2] Ctx_ffm_did_tlz_ad_b[3] Ctx_ffm_did_tlz_ad_b[4] Cxx_dtc_hmb_tlz_ad_b Ctx_ffm_did_vb[0] Ctx_ffm_did_vb[1] Ctx_ffm_did_vb[2] Ctx_ffm_did_vb[3] Ctx_ffm_did_vb[4] Cxx_dtc_hmb_vb Ctx_ffm_did_vb_rly[0] Ctx_ffm_did_vb_rly[1] Ctx_ffm_did_vb_rly[2] Ctx_ffm_did_vb_rly[3] Ctx_ffm_did_vb_rly[4] Cxx_dtc_hmb_vb_rly Ctx_ffm_did_wgc[0] Ctx_ffm_did_wgc[1] Ctx_ffm_did_wgc[2] Ctx_ffm_did_wgc[3] Ctx_ffm_did_wgc[4] Cxx_dtc_hmb_wgc Ctx_ffm_did_wpmp_tcr[0] Ctx_ffm_did_wpmp_tcr[1] Ctx_ffm_did_wpmp_tcr[2] Ctx_ffm_did_wpmp_tcr[3] Ctx_ffm_did_wpmp_tcr[4] Cxx_dtc_hmb_wpmp_tcr Cxx_conf_wal_ac_prs_h Cxx_dtc_lb_ac_prs_h Cxx_conf_wal_ac_prs_l Cxx_dtc_lb_ac_prs_l Cxx_dtc_obd_acel_pdl_chr Cxx_conf_wal_acel_pdl_chr Cbx_obd_acel_pdl_chr Cbx_obd_mena_acel_pdl_chr Cxx_dtc_lb_acel_pdl_chr Cxx_obd_dc_acel_pdl_chr Cxx_dtc_obd_acel_pdl_secu_1 Cxx_conf_wal_acel_pdl_secu_1 Cbx_obd_acel_pdl_secu_1 Cbx_obd_mena_acel_pdl_secu_1 Cxx_dtc_lb_acel_pdl_secu_1 Cxx_obd_dc_acel_pdl_secu_1 Cxx_dtc_obd_acel_pdl_secu_2 Cxx_conf_wal_acel_pdl_secu_2 Cbx_obd_acel_pdl_secu_2 Cbx_obd_mena_acel_pdl_secu_2 Cxx_dtc_lb_acel_pdl_secu_2 Cxx_obd_dc_acel_pdl_secu_2 Cxx_dtc_obd_acel_pdl_tot Cxx_conf_wal_acel_pdl_tot Cbx_obd_acel_pdl_tot Cbx_obd_mena_acel_pdl_tot Cxx_dtc_lb_acel_pdl_tot Cxx_obd_dc_acel_pdl_tot Cxx_dtc_obd_acel_pdl_v1_h Cxx_conf_wal_acel_pdl_v1_h Cbx_obd_acel_pdl_v1_h Cbx_obd_mena_acel_pdl_v1_h Cxx_dtc_lb_acel_pdl_v1_h Cxx_obd_dc_acel_pdl_v1_h Cxx_dtc_obd_acel_pdl_v1_l Cxx_conf_wal_acel_pdl_v1_l Cbx_obd_acel_pdl_v1_l Cbx_obd_mena_acel_pdl_v1_l Cxx_dtc_lb_acel_pdl_v1_l Cxx_obd_dc_acel_pdl_v1_l Cxx_dtc_obd_acel_pdl_v2_h Cxx_conf_wal_acel_pdl_v2_h Cbx_obd_acel_pdl_v2_h Cbx_obd_mena_acel_pdl_v2_h Cxx_dtc_lb_acel_pdl_v2_h Cxx_obd_dc_acel_pdl_v2_h Cxx_dtc_obd_acel_pdl_v2_l Cxx_conf_wal_acel_pdl_v2_l Cbx_obd_acel_pdl_v2_l Cbx_obd_mena_acel_pdl_v2_l Cxx_dtc_lb_acel_pdl_v2_l Cxx_obd_dc_acel_pdl_v2_l Cxx_dtc_obd_actr_rly_oc Cxx_conf_wal_actr_rly_oc Cbx_obd_actr_rly_oc Cbx_obd_mena_actr_rly_oc Cxx_dtc_lb_actr_rly_oc Cxx_obd_dc_actr_rly_oc Cxx_dtc_obd_actr_rly_scg Cxx_conf_wal_actr_rly_scg Cbx_obd_actr_rly_scg Cbx_obd_mena_actr_rly_scg Cxx_dtc_lb_actr_rly_scg Cxx_obd_dc_actr_rly_scg Cxx_dtc_obd_actr_rly_scw Cxx_conf_wal_actr_rly_scw Cbx_obd_actr_rly_scw Cbx_obd_mena_actr_rly_scw Cxx_dtc_lb_actr_rly_scw Cxx_obd_dc_actr_rly_scw Cxx_dtc_obd_agb_data_chr Cxx_conf_wal_agb_data_chr Cbx_obd_agb_data_chr Cbx_obd_mena_agb_data_chr Cxx_dtc_lb_agb_data_chr Cxx_obd_dc_agb_data_chr Cxx_dtc_obd_agb_data_seq_ctr Cxx_conf_wal_agb_data_seq_ctr Cbx_obd_agb_data_seq_ctr Cbx_obd_mena_agb_data_seq_ctr Cxx_dtc_lb_agb_data_seq_ctr Cxx_obd_dc_agb_data_seq_ctr Cxx_dtc_obd_agb_data_tout Cxx_conf_wal_agb_data_tout Cbx_obd_agb_data_tout Cbx_obd_mena_agb_data_tout Cxx_dtc_lb_agb_data_tout Cxx_obd_dc_agb_data_tout Cxx_dtc_obd_agb_no_frm Cxx_conf_wal_agb_no_frm Cbx_obd_agb_no_frm Cbx_obd_mena_agb_no_frm Cxx_dtc_lb_agb_no_frm Cxx_obd_dc_agb_no_frm Cxx_conf_wal_bgin_clu_cmp Cxx_dtc_lb_bgin_clu_cmp Cxx_conf_wal_bgin_clu_nok Cxx_dtc_lb_bgin_clu_nok Cxx_conf_wal_brk_pdl_cmp Cxx_dtc_lb_brk_pdl_cmp Cxx_dtc_obd_cata_cpt Cxx_conf_wal_cata_cpt Cbx_obd_cata_cpt Cbx_obd_mena_cata_cpt Cxx_dtc_lb_cata_cpt Cxx_obd_dc_cata_cpt Cxx_dtc_obd_cl_rich_chr Cxx_conf_wal_cl_rich_chr Cbx_obd_cl_rich_chr Cbx_obd_mena_cl_rich_chr Cxx_dtc_lb_cl_rich_chr Cxx_obd_dc_cl_rich_chr Cxx_conf_wal_clu_cnt_nok Cxx_dtc_lb_clu_cnt_nok Cxx_dtc_obd_cp_oc Cxx_conf_wal_cp_oc Cbx_obd_cp_oc Cbx_obd_mena_cp_oc Cxx_dtc_lb_cp_oc Cxx_obd_dc_cp_oc Cxx_dtc_obd_cp_scg Cxx_conf_wal_cp_scg Cbx_obd_cp_scg Cbx_obd_mena_cp_scg Cxx_dtc_lb_cp_scg Cxx_obd_dc_cp_scg Cxx_dtc_obd_cp_scw Cxx_conf_wal_cp_scw Cbx_obd_cp_scw Cbx_obd_mena_cp_scw Cxx_dtc_lb_cp_scw Cxx_obd_dc_cp_scw Cxx_dtc_obd_crk_chr Cxx_conf_wal_crk_chr Cbx_obd_crk_chr Cbx_obd_mena_crk_chr Cxx_dtc_lb_crk_chr Cxx_obd_dc_crk_chr Cxx_dtc_obd_crk_cmp Cxx_conf_wal_crk_cmp Cbx_obd_crk_cmp Cbx_obd_mena_crk_cmp Cxx_dtc_lb_crk_cmp Cxx_obd_dc_crk_cmp Cxx_dtc_obd_crk_cyc Cxx_conf_wal_crk_cyc Cbx_obd_crk_cyc Cbx_obd_mena_crk_cyc Cxx_dtc_lb_crk_cyc Cxx_obd_dc_crk_cyc Cxx_dtc_obd_crk_no_sig Cxx_conf_wal_crk_no_sig Cbx_obd_crk_no_sig Cbx_obd_mena_crk_no_sig Cxx_dtc_lb_crk_no_sig Cxx_obd_dc_crk_no_sig Cxx_dtc_obd_crk_oc Cxx_conf_wal_crk_oc Cbx_obd_crk_oc Cbx_obd_mena_crk_oc Cxx_dtc_lb_crk_oc Cxx_obd_dc_crk_oc Cxx_dtc_obd_crk_shp Cxx_conf_wal_crk_shp Cbx_obd_crk_shp Cbx_obd_mena_crk_shp Cxx_dtc_lb_crk_shp Cxx_obd_dc_crk_shp Cxx_conf_wal_cru_cmp Cxx_dtc_lb_cru_cmp Cxx_conf_wal_cru_sl_swi_chr Cxx_dtc_lb_cru_sl_swi_chr Cxx_conf_wal_cru_sl_tot Cxx_dtc_lb_cru_sl_tot Cxx_conf_wal_cru_vs_cmp Cxx_dtc_lb_cru_vs_cmp Cxx_conf_wal_cru_whl_cmd_nok Cxx_dtc_lb_cru_whl_cmd_nok Cxx_conf_wal_cru_whl_cmd_oc_scw Cxx_dtc_lb_cru_whl_cmd_oc_scw Cxx_conf_wal_cru_whl_cmd_oor Cxx_dtc_lb_cru_whl_cmd_oor Cxx_dtc_obd_ecm_adc_tron Cxx_conf_wal_ecm_adc_tron Cbx_obd_ecm_adc_tron Cbx_obd_mena_ecm_adc_tron Cxx_dtc_lb_ecm_adc_tron Cxx_obd_dc_ecm_adc_tron Cxx_dtc_obd_ecm_err_itl Cxx_conf_wal_ecm_err_itl Cbx_obd_ecm_err_itl Cbx_obd_mena_ecm_err_itl Cxx_dtc_lb_ecm_err_itl Cxx_obd_dc_ecm_err_itl Cxx_dtc_obd_ecm_mon_secu_1 Cxx_conf_wal_ecm_mon_secu_1 Cbx_obd_ecm_mon_secu_1 Cbx_obd_mena_ecm_mon_secu_1 Cxx_dtc_lb_ecm_mon_secu_1 Cxx_obd_dc_ecm_mon_secu_1 Cxx_dtc_obd_ecm_mon_secu_2 Cxx_conf_wal_ecm_mon_secu_2 Cbx_obd_ecm_mon_secu_2 Cbx_obd_mena_ecm_mon_secu_2 Cxx_dtc_lb_ecm_mon_secu_2 Cxx_obd_dc_ecm_mon_secu_2 Cxx_dtc_obd_ecm_mon_tron Cxx_conf_wal_ecm_mon_tron Cbx_obd_ecm_mon_tron Cbx_obd_mena_ecm_mon_tron Cxx_dtc_lb_ecm_mon_tron Cxx_obd_dc_ecm_mon_tron Cxx_conf_wal_esp_data_chr Cxx_dtc_lb_esp_data_chr Cxx_conf_wal_esp_data_seq_ctr Cxx_dtc_lb_esp_data_seq_ctr Cxx_conf_wal_esp_no_frm Cxx_dtc_lb_esp_no_frm Cxx_dtc_obd_fsys_cpt Cxx_conf_wal_fsys_cpt Cbx_obd_fsys_cpt Cbx_obd_mena_fsys_cpt Cxx_dtc_lb_fsys_cpt Cxx_obd_dc_fsys_cpt Cxx_dtc_obd_gas_pump_oc Cxx_conf_wal_gas_pump_oc Cbx_obd_gas_pump_oc Cbx_obd_mena_gas_pump_oc Cxx_dtc_lb_gas_pump_oc Cxx_obd_dc_gas_pump_oc Cxx_dtc_obd_gas_pump_scg Cxx_conf_wal_gas_pump_scg Cbx_obd_gas_pump_scg Cbx_obd_mena_gas_pump_scg Cxx_dtc_lb_gas_pump_scg Cxx_obd_dc_gas_pump_scg Cxx_dtc_obd_gas_pump_scw Cxx_conf_wal_gas_pump_scw Cbx_obd_gas_pump_scw Cbx_obd_mena_gas_pump_scw Cxx_dtc_lb_gas_pump_scw Cxx_obd_dc_gas_pump_scw Cxx_dtc_obd_igc_1_oc Cxx_conf_wal_igc_1_oc Cbx_obd_igc_1_oc Cbx_obd_mena_igc_1_oc Cxx_dtc_lb_igc_1_oc Cxx_obd_dc_igc_1_oc Cxx_dtc_obd_igc_1_scg Cxx_conf_wal_igc_1_scg Cbx_obd_igc_1_scg Cbx_obd_mena_igc_1_scg Cxx_dtc_lb_igc_1_scg Cxx_obd_dc_igc_1_scg Cxx_dtc_obd_igc_1_scw Cxx_conf_wal_igc_1_scw Cbx_obd_igc_1_scw Cbx_obd_mena_igc_1_scw Cxx_dtc_lb_igc_1_scw Cxx_obd_dc_igc_1_scw Cxx_dtc_obd_igc_2_oc Cxx_conf_wal_igc_2_oc Cbx_obd_igc_2_oc Cbx_obd_mena_igc_2_oc Cxx_dtc_lb_igc_2_oc Cxx_obd_dc_igc_2_oc Cxx_dtc_obd_igc_2_scg Cxx_conf_wal_igc_2_scg Cbx_obd_igc_2_scg Cbx_obd_mena_igc_2_scg Cxx_dtc_lb_igc_2_scg Cxx_obd_dc_igc_2_scg Cxx_dtc_obd_igc_2_scw Cxx_conf_wal_igc_2_scw Cbx_obd_igc_2_scw Cbx_obd_mena_igc_2_scw Cxx_dtc_lb_igc_2_scw Cxx_obd_dc_igc_2_scw Cxx_dtc_obd_igc_3_oc Cxx_conf_wal_igc_3_oc Cbx_obd_igc_3_oc Cbx_obd_mena_igc_3_oc Cxx_dtc_lb_igc_3_oc Cxx_obd_dc_igc_3_oc Cxx_dtc_obd_igc_3_scg Cxx_conf_wal_igc_3_scg Cbx_obd_igc_3_scg Cbx_obd_mena_igc_3_scg Cxx_dtc_lb_igc_3_scg Cxx_obd_dc_igc_3_scg Cxx_dtc_obd_igc_3_scw Cxx_conf_wal_igc_3_scw Cbx_obd_igc_3_scw Cbx_obd_mena_igc_3_scw Cxx_dtc_lb_igc_3_scw Cxx_obd_dc_igc_3_scw Cxx_dtc_obd_igc_4_oc Cxx_conf_wal_igc_4_oc Cbx_obd_igc_4_oc Cbx_obd_mena_igc_4_oc Cxx_dtc_lb_igc_4_oc Cxx_obd_dc_igc_4_oc Cxx_dtc_obd_igc_4_scg Cxx_conf_wal_igc_4_scg Cbx_obd_igc_4_scg Cbx_obd_mena_igc_4_scg Cxx_dtc_lb_igc_4_scg Cxx_obd_dc_igc_4_scg Cxx_dtc_obd_igc_4_scw Cxx_conf_wal_igc_4_scw Cbx_obd_igc_4_scw Cbx_obd_mena_igc_4_scw Cxx_dtc_lb_igc_4_scw Cxx_obd_dc_igc_4_scw Cxx_dtc_obd_in_cam_chr Cxx_conf_wal_in_cam_chr Cbx_obd_in_cam_chr Cbx_obd_mena_in_cam_chr Cxx_dtc_lb_in_cam_chr Cxx_obd_dc_in_cam_chr Cxx_dtc_obd_in_cam_crk_cmp Cxx_conf_wal_in_cam_crk_cmp Cbx_obd_in_cam_crk_cmp Cbx_obd_mena_in_cam_crk_cmp Cxx_dtc_lb_in_cam_crk_cmp Cxx_obd_dc_in_cam_crk_cmp Cxx_dtc_obd_in_cam_cyc Cxx_conf_wal_in_cam_cyc Cbx_obd_in_cam_cyc Cbx_obd_mena_in_cam_cyc Cxx_dtc_lb_in_cam_cyc Cxx_obd_dc_in_cam_cyc Cxx_dtc_obd_in_cam_no_sig Cxx_conf_wal_in_cam_no_sig Cbx_obd_in_cam_no_sig Cbx_obd_mena_in_cam_no_sig Cxx_dtc_lb_in_cam_no_sig Cxx_obd_dc_in_cam_no_sig Cxx_dtc_obd_in_cam_nok Cxx_conf_wal_in_cam_nok Cbx_obd_in_cam_nok Cbx_obd_mena_in_cam_nok Cxx_dtc_lb_in_cam_nok Cxx_obd_dc_in_cam_nok Cxx_dtc_obd_in_vvtc_ad Cxx_conf_wal_in_vvtc_ad Cbx_obd_in_vvtc_ad Cbx_obd_mena_in_vvtc_ad Cxx_dtc_lb_in_vvtc_ad Cxx_obd_dc_in_vvtc_ad Cxx_dtc_obd_in_vvtc_blk Cxx_conf_wal_in_vvtc_blk Cbx_obd_in_vvtc_blk Cbx_obd_mena_in_vvtc_blk Cxx_dtc_lb_in_vvtc_blk Cxx_obd_dc_in_vvtc_blk Cxx_dtc_obd_in_vvtc_dirt_lkg Cxx_conf_wal_in_vvtc_dirt_lkg Cbx_obd_in_vvtc_dirt_lkg Cbx_obd_mena_in_vvtc_dirt_lkg Cxx_dtc_lb_in_vvtc_dirt_lkg Cxx_obd_dc_in_vvtc_dirt_lkg Cxx_dtc_obd_in_vvtc_sldv_oc Cxx_conf_wal_in_vvtc_sldv_oc Cbx_obd_in_vvtc_sldv_oc Cbx_obd_mena_in_vvtc_sldv_oc Cxx_dtc_lb_in_vvtc_sldv_oc Cxx_obd_dc_in_vvtc_sldv_oc Cxx_dtc_obd_in_vvtc_sldv_scg Cxx_conf_wal_in_vvtc_sldv_scg Cbx_obd_in_vvtc_sldv_scg Cbx_obd_mena_in_vvtc_sldv_scg Cxx_dtc_lb_in_vvtc_sldv_scg Cxx_obd_dc_in_vvtc_sldv_scg Cxx_dtc_obd_in_vvtc_sldv_scw Cxx_conf_wal_in_vvtc_sldv_scw Cbx_obd_in_vvtc_sldv_scw Cbx_obd_mena_in_vvtc_sldv_scw Cxx_dtc_lb_in_vvtc_sldv_scw Cxx_obd_dc_in_vvtc_sldv_scw Cxx_dtc_obd_inj1_oc Cxx_conf_wal_inj1_oc Cbx_obd_inj1_oc Cbx_obd_mena_inj1_oc Cxx_dtc_lb_inj1_oc Cxx_obd_dc_inj1_oc Cxx_dtc_obd_inj1_scg Cxx_conf_wal_inj1_scg Cbx_obd_inj1_scg Cbx_obd_mena_inj1_scg Cxx_dtc_lb_inj1_scg Cxx_obd_dc_inj1_scg Cxx_dtc_obd_inj1_scw Cxx_conf_wal_inj1_scw Cbx_obd_inj1_scw /end DEF_CHARACTERISTIC
/end FUNCTION
/end MODULE
/end PROJECT
