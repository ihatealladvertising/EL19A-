/* -------------------------------------------------------------------------
Visu-IT!
Data Declaration System (DDS)
- ASAP2 export -
DDS-Version 5.3.0
Component-Version Build<000033.28> 2008/01/07 15:56:09
CreationDate 18 May 2009, 17:31:51
Project RD8
Number RD9
Structure 6C0
Serial Nr. 0
Option Project (DataBase) D:\P\RD9\6C0\RD96C0U1_t01\tmp\dds
Option Verbose false
Option ASAP2File D:\P\RD9\6C0\RD96C0U1_t01\out\cal\RD96C03b.a2l
Option IgnoreAddressCheck false
Option ASAP2Version 1.41
Option PartialExportViaFunction
Option PartialExportViaFunctionMode <0>
Option CompuMethodName <0>
Option IfDataTemplateList 'CCP ASAP1B v2.4 (using ccp-definition)'
'EDIC_ISO_15765 (CAN)'
Option A2MLMode <0>
Option CalibrationMethodList
Option MemoryRegionAutoAssignment <1>
Option AddressOffset <0>
Option ExportHiddenData false
Option ExportInvisibleData false
Option ExportSoftwareGrouping false
Option ExportComponentGrouping false
Option SuppressFunctionGrouping false
Option SuppressAxisFunctionGrouping false
Option ExportDisplayIdentifier <2>
Option ExportLongIdentifier <0>
Option ExportAnnotation false
Option ExportReference2MemorySegment false
Option SuppressEcuAddress false
Option SuppressFloat false
Option SuppressVariantCoding false
Option VariantCodingMode <0>
Option OnlineOnly false
Option Map2PointLinearConv2RatFunc true
Option NonLinearConvMode <0>
Option MapVTabRange2VTab false
Option MaxCompuTabValuePairs <800>
Option DefaultFormat4VerbalConvers...
Option WriteEscapeCharacters false
Option SASList
Option SAS4All false
Option ApplyOldIdentSyntax4NonInstr.. false
Option IgnorePartialIdentLengthCheck false
Option AllowEmptyContainer false
Option CreateAddressOffsetFile false
Option SupportEdicMobileV3 false
Option SuppressBitfieldCarrier true
Option DefaultLanguage en
Option SkipInputDefinitions false
Option Force1DValBlks false
Option ExportMaxRefresh <0>
Option DetectSizeOfEnum false
------------------------------------------------------------------------- */
ASAP2_VERSION 1 41
/begin PROJECT RD8 "_default_ProjectLongIdentifier"
/begin HEADER "_default_HeaderComment" PROJECT_NO RD9 /end HEADER
/begin MODULE _default_ModuleName "_default_ModuleLongIdentifier"
/begin MOD_PAR "_default_ModParComment" ADDR_EPK 0xa0020008 EPK "RD96C0"
 /begin MEMORY_SEGMENT _ROM "CAL" DATA FLASH INTERN 0xa0020000 0x1e400 -1 -1 -1 -1 -1 /end MEMORY_SEGMENT
 /begin MEMORY_SEGMENT _RAM_CAL "WP" DATA RAM EXTERN 0xaff20000 0x1e400 -1 -1 -1 -1 -1 /end MEMORY_SEGMENT
 /begin MEMORY_SEGMENT _INT_RAM "DRAM" VARIABLES RAM INTERN 0xd0000000 0x8000 -1 -1 -1 -1 -1 /end MEMORY_SEGMENT
 /begin MEMORY_SEGMENT _OVRAM "OVRAM" VARIABLES RAM INTERN 0xc0000000 0x1000 -1 -1 -1 -1 -1 /end MEMORY_SEGMENT
 /begin MEMORY_SEGMENT _REVIVAL_RAM "" VARIABLES RAM INTERN 0xd0001a00 0x5bff -1 -1 -1 -1 -1 /end MEMORY_SEGMENT
/end MOD_PAR
/begin MOD_COMMON "_default_ModCommonComment" DEPOSIT ABSOLUTE BYTE_ORDER MSB_LAST ALIGNMENT_BYTE 1 ALIGNMENT_WORD 2 ALIGNMENT_LONG 2 ALIGNMENT_FLOAT32_IEEE 2 ALIGNMENT_FLOAT64_IEEE 4 /end MOD_COMMON
/begin IF_DATA ASAP1B_CCP
 /begin SOURCE "Crankshaft Synchronous Cyl. 1" 0 0 DISPLAY_IDENTIFIER "DAQ1" /begin QP_BLOB 1 LENGTH 7 CAN_ID_FIXED 0x7a2 RASTER 1 FIRST_PID 0 /end QP_BLOB /end SOURCE
 /begin SOURCE "Crankshaft Synchronous Cyl. 2" 0 0 DISPLAY_IDENTIFIER "DAQ2" /begin QP_BLOB 2 LENGTH 7 CAN_ID_FIXED 0x7a2 RASTER 2 FIRST_PID 16 /end QP_BLOB /end SOURCE
 /begin SOURCE "Crankshaft Synchronous Cyl. 3" 0 0 DISPLAY_IDENTIFIER "DAQ3" /begin QP_BLOB 3 LENGTH 7 CAN_ID_FIXED 0x7a2 RASTER 3 FIRST_PID 32 /end QP_BLOB /end SOURCE
 /begin SOURCE "Crankshaft Synchronous Cyl. 4" 0 0 DISPLAY_IDENTIFIER "DAQ4" /begin QP_BLOB 4 LENGTH 7 CAN_ID_FIXED 0x7a2 RASTER 4 FIRST_PID 48 /end QP_BLOB /end SOURCE
 /begin SOURCE "Time Synchronous 4ms" 0 0 DISPLAY_IDENTIFIER "4ms" /begin QP_BLOB 30 LENGTH 7 CAN_ID_FIXED 0x7a3 RASTER 30 FIRST_PID 128 /end QP_BLOB /end SOURCE
 /begin SOURCE "Display 100ms" 0 0 DISPLAY_IDENTIFIER "Disp" /begin QP_BLOB 33 LENGTH 15 CAN_ID_FIXED 0x7a6 RASTER 33 FIRST_PID 176 /end QP_BLOB /end SOURCE
 /begin SOURCE "Time Synchronous 5ms" 0 0 DISPLAY_IDENTIFIER "5ms" /begin QP_BLOB 31 LENGTH 7 CAN_ID_FIXED 0x7a4 RASTER 31 FIRST_PID 144 /end QP_BLOB /end SOURCE
 /begin SOURCE "Time Synchronous 10ms" 0 0 DISPLAY_IDENTIFIER "10ms" /begin QP_BLOB 32 LENGTH 15 CAN_ID_FIXED 0x7a5 RASTER 32 FIRST_PID 160 /end QP_BLOB /end SOURCE
 /begin RASTER "Crankshaft Synchronous Cyl. 1" "CYL1" 1 103 1 /end RASTER
 /begin RASTER "Crankshaft Synchronous Cyl. 2" "CYL2" 2 103 1 /end RASTER
 /begin RASTER "Crankshaft Synchronous Cyl. 3" "CYL3" 3 103 1 /end RASTER
 /begin RASTER "Crankshaft Synchronous Cyl. 4" "CYL4" 4 103 1 /end RASTER
 /begin RASTER "Time Synchronous 4ms" "4ms" 30 3 4 /end RASTER
 /begin RASTER "Display 100ms" "DISP" 33 3 100 /end RASTER
 /begin RASTER "Time Synchronous 5ms" "5ms" 31 3 5 /end RASTER
 /begin RASTER "Time Synchronous 10ms" "10ms" 32 3 10 /end RASTER
 /begin EVENT_GROUP "Crankshaft Synchronous Cyl 1-4" "CRANK" RASTER 1 RASTER 2 RASTER 3 RASTER 4 /end EVENT_GROUP
 /begin SEED_KEY "internal.dll" "internal.dll" "internal.dll" /end SEED_KEY
 /begin CHECKSUM "CRC16.dll" /end CHECKSUM
 /begin TP_BLOB 0x0201 0x0204 0x7a0 0x7a1 0x1 2 BAUDRATE 1000000 SAMPLE_POINT 75 SAMPLE_RATE 1 BTL_CYCLES 16 SJW 2 SYNC_EDGE DUAL RESUME_SUPPORTED STORE_SUPPORTED /begin CHECKSUM_PARAM 0x9001 0x200 CHECKSUM_CALCULATION ACTIVE_PAGE /end CHECKSUM_PARAM
  /begin DEFINED_PAGES 1 "Working Page" 0 0xaff20000 0x1e400 RAM RAM_INIT_BY_ECU FLASH_BACK /end DEFINED_PAGES
  /begin DEFINED_PAGES 1 "ROM" 0 0xa0020000 0x1e400 FLASH /end DEFINED_PAGES
  OPTIONAL_CMD 0x5 OPTIONAL_CMD 0x8 OPTIONAL_CMD 0x9 OPTIONAL_CMD 0xc OPTIONAL_CMD 0xd OPTIONAL_CMD 0xe OPTIONAL_CMD 0x11 OPTIONAL_CMD 0x12 OPTIONAL_CMD 0x13 OPTIONAL_CMD 0x19 OPTIONAL_CMD 0x23 /end TP_BLOB
/end IF_DATA
/begin IF_DATA EDIC_ISO_15765 "V1.0" CANID_STANDARD 0x7E0 0x7E8 ADR_NORMAL 0x00 HIGHSPEED 500000 1 2000 10 0 1 1 SERVICE_FORMAT ISO14230 4 2 1 SUPP_SERVICE RMBA SUPP_SERVICE STDS TELDATA 0x10 0xC0 /end IF_DATA
/begin CHARACTERISTIC c_req_ini_nvm_grp "" VALUE 0xa00217c0 _REC_S1VAL_20_u4 4294967295. _CNV_A_R_ECME_LINEA_0_CM 0. 4294967295. FORMAT "%10.0" /end CHARACTERISTIC
/begin CHARACTERISTIC lc_req_ini_nvm "Used to initialize E2prom data contents." VALUE 0xa00217c4 _REC_S1VAL_20_u1 1. _CNV_S_2_ECME_RANGE_1_CM 0. 1. /end CHARACTERISTIC
/begin AXIS_PTS ldpm_n_32_1_ensd "" 0xa002f9a4 n_32 _REC_A2AXS_20_u1 8160. _CNV_A_R_LINEAR_____2_CM 16 0. 8160. FORMAT "%4.0" /end AXIS_PTS
/begin AXIS_PTS ldpm_n_32_2_ensd "" 0xa0021604 n_32 _REC_A2AXS_20_u1 8160. _CNV_A_R_LINEAR_____2_CM 6 0. 8160. FORMAT "%4.0" /end AXIS_PTS
/begin MEASUREMENT cpu_load "CPU load above measurement level." UWORD _CNV_A_R_CPULOAD__0_7_CM 1 0. 0. 100. ECU_ADDRESS 0xd0003124 FORMAT "%5.1" /end MEASUREMENT
/begin MEASUREMENT cpu_load_fil "Filtered CPU load above measurement level." UWORD _CNV_A_R_CPULOAD__0_7_CM 1 0. 0. 100. ECU_ADDRESS 0xd0003128 FORMAT "%5.1" /end MEASUREMENT
/begin MEASUREMENT cpu_load_fil_max "Maximum detected filtered CPU load above measurement level." UWORD _CNV_A_R_CPULOAD__0_7_CM 1 0. 0. 100. ECU_ADDRESS 0xd000312a FORMAT "%5.1" /end MEASUREMENT
/begin MEASUREMENT cpu_load_max "Maximum detected CPU load above measurement level." UWORD _CNV_A_R_CPULOAD__0_7_CM 1 0. 0. 100. ECU_ADDRESS 0xd0003126 FORMAT "%5.1" /end MEASUREMENT
/begin MEASUREMENT cpu_load_ses_ctr "Session counter." SWORD _CNV_A_R_ECME_LINEA_0_CM 1 0. -32768. 32767. ECU_ADDRESS 0xd000312c FORMAT "%6.0" /end MEASUREMENT
/begin MEASUREMENT cpu_load_tsk_per_ctr "Counter of TASK_BG_MES instances." ULONG _CNV_A_R_ECME_LINEA_0_CM 1 0. 0. 4294967295. ECU_ADDRESS 0xd0001950 FORMAT "%10.0" /end MEASUREMENT
/begin MEASUREMENT cpu_load_tsk_per_min "Minimum time between 2 instances of TASK_BG_MES." ULONG _CNV_A_R_LINEAR_____8_CM 1 0. 0. 4294967295. ECU_ADDRESS 0xd000194c FORMAT "%10.0" /end MEASUREMENT
/begin CHARACTERISTIC c_cpu_load_ftc "Time between two measurement session" VALUE 0xa0021dfc _REC_S1VAL_20_u2 0.9999847412109381 _CNV_A_R_LINEAR_____9_CM 0. 0.9999847412109381 FORMAT "%7.5" /end CHARACTERISTIC
/begin CHARACTERISTIC c_cpu_load_per "Time between two measurement session" VALUE 0xa0021dfe _REC_S1VAL_20_s2 32766. _CNV_A_R_ECME_LINEA_0_CM 1. 32767. FORMAT "%6.0" /end CHARACTERISTIC
/begin CHARACTERISTIC c_cpu_load_ses_ctr_ini "End of measurement session" VALUE 0xa0021e00 _REC_S1VAL_20_s2 32768. _CNV_A_R_ECME_LINEA_0_CM -32768. 0. FORMAT "%6.0" /end CHARACTERISTIC
/begin CHARACTERISTIC c_cpu_load_ses_t_end "End of measurement session" VALUE 0xa0021e02 _REC_S1VAL_20_s2 499. _CNV_A_R_ECME_LINEA_0_CM 1. 500. FORMAT "%6.0" /end CHARACTERISTIC
/begin CHARACTERISTIC c_cpu_load_tsk_mes_dly "Calibration for acting on measurement task period" VALUE 0xa0021e04 _REC_S1VAL_20_u2 65535. _CNV_A_R_ECME_LINEA_0_CM 0. 65535. FORMAT "%5.0" /end CHARACTERISTIC
/begin CHARACTERISTIC c_cpu_load_tsk_per_min "Calibration for acting on measurement task period" VALUE 0xa0021e06 _REC_S1VAL_20_u2 65535. _CNV_A_R_LINEAR_____8_CM 0. 65535. FORMAT "%5.0" /end CHARACTERISTIC
/begin MEASUREMENT cpu_load_err "Error bit:" UBYTE _CNV_A_R_ECME_LINEA_0_CM 1 0. 0. 255. ECU_ADDRESS 0xd00051c4 FORMAT "%3.0" /end MEASUREMENT
/begin CHARACTERISTIC c_cpu_load_1_div_res_min "" VALUE 0xa0021bd4 _REC_S1VAL_20_u2 1004. _CNV_A_R_ECME_LINEA_0_CM 20. 1024. FORMAT "%5.0" /end CHARACTERISTIC
/begin CHARACTERISTIC lc_cpu_load_max_rst "Flag for reset of variable cpu_load_max and cpu_load_fil_max." VALUE 0xa0021bd6 _REC_S1VAL_20_u1 1. _CNV_A_R_ECME_LINEA_0_CM 0. 1. FORMAT "%1.0" /end CHARACTERISTIC
/begin CHARACTERISTIC lc_cpu_load_tsk_per_min_rst "Flag for reset variable cpu_load_tsk_per_min" VALUE 0xa0021bd7 _REC_S1VAL_20_u1 1. _CNV_A_R_ECME_LINEA_0_CM 0. 1. FORMAT "%1.0" /end CHARACTERISTIC
/begin MEASUREMENT abc_lid_mc_fct_spc_ist "Local variable: value of MU anti-bounce counter for FS-IST (obtained from ABC_RCV_MC_FCT_SPC_IST)" UBYTE _CNV_A_R_ECME_LINEA_0_CM 1 0. 0. 255. ECU_ADDRESS 0xd0005705 FORMAT "%3.0" /end MEASUREMENT
/begin MEASUREMENT ctr_com_cyc_mc_dr_di_tmp "Communication cycle counter used for temporary disabling of power stages by Processor Monitoring" UBYTE _CNV_A_R_ECME_LINEA_0_CM 1 0. 0. 255. ECU_ADDRESS 0xd00054ff FORMAT "%3.0" /end MEASUREMENT
/begin MEASUREMENT ctr_rst_mc "Reset counter on MC" UBYTE _CNV_A_R_ECME_LINEA_0_CM 1 0. 0. 255. ECU_ADDRESS 0xd0007e1c FORMAT "%3.0" /end MEASUREMENT
/begin MEASUREMENT ctr_rst_mu "Value of reset counter of MU" UBYTE _CNV_A_R_ECME_LINEA_0_CM 1 0. 0. 255. ECU_ADDRESS 0xd0004466 FORMAT "%3.0" /end MEASUREMENT
/begin MEASUREMENT CTR_RST_ERR_MEM_ACT "Local variable: current value of reset counter for error memory management, plus potentially additional information" UBYTE _CNV_A_R_ECME_LINEA_0_CM 1 0. 0. 255. DISPLAY_IDENTIFIER ecm3_lf_ctr_rst_err_mem_act ECU_ADDRESS 0xd0007e04 FORMAT "%3.0" /end MEASUREMENT
/begin MEASUREMENT CTR_RST_ERR_MEM_OLD "Local variable: old value of reset counter for error memory management, plus potentially additional information" UBYTE _CNV_A_R_ECME_LINEA_0_CM 1 0. 0. 255. DISPLAY_IDENTIFIER ecm3_lf_ctr_rst_err_mem_old ECU_ADDRESS 0xd0007e06 FORMAT "%3.0" /end MEASUREMENT
/begin MEASUREMENT ecm3_lf_err_cod_err_mem_act "" UBYTE _CNV_A_R_ECME_LINEA_0_CM 1 0. 0. 255. ECU_ADDRESS 0xd0007e08 FORMAT "%3.0" /end MEASUREMENT
/begin MEASUREMENT ERR_COD_ERR_MEM_ACT "Local variable: current value of error code for error memory management" UBYTE _CNV_S_31_ECM3_ERR_C_10_CM 1 0. 0. 30. DISPLAY_IDENTIFIER ecm3_lf_err_cod_err_mem_act.err_cod_err_mem_act ECU_ADDRESS 0xd0007e08 BIT_MASK 0x1F /end MEASUREMENT
/begin MEASUREMENT STATE_ERR_IDC_ERR_MEM_ACT "Local variable: current error indication for error memory management" UBYTE _CNV_S_4_ECM3_STATE_11_CM 1 0. 0. 3. DISPLAY_IDENTIFIER ecm3_lf_err_cod_err_mem_act.state_err_idc_err_mem_act ECU_ADDRESS 0xd0007e08 BIT_MASK 0x60 /end MEASUREMENT
/begin MEASUREMENT LV_MC_CPT_ERR_MEM_ACT "Local variable: flag indicating whether the current error code for error memory management belongs to MC (=1)" UBYTE _CNV_S_2_ECM3_LV_MC_12_CM 1 0. 0. 1. DISPLAY_IDENTIFIER ecm3_lf_err_cod_err_mem_act.lv_mc_cpt_err_mem_act ECU_ADDRESS 0xd0007e08 BIT_MASK 0x80 /end MEASUREMENT
/begin MEASUREMENT ecm3_lf_err_cod_err_mem_old "" UBYTE _CNV_A_R_ECME_LINEA_0_CM 1 0. 0. 255. ECU_ADDRESS 0xd0007e0a FORMAT "%3.0" /end MEASUREMENT
/begin MEASUREMENT ERR_COD_ERR_MEM_OLD "Local variable: old value of error code for error memory management" UBYTE _CNV_S_31_ECM3_ERR_C_10_CM 1 0. 0. 30. DISPLAY_IDENTIFIER ecm3_lf_err_cod_err_mem_old.err_cod_err_mem_old ECU_ADDRESS 0xd0007e0a BIT_MASK 0x1F /end MEASUREMENT
/begin MEASUREMENT STATE_ERR_IDC_ERR_MEM_OLD "Local variable: old error indication for error memory management" UBYTE _CNV_S_4_ECM3_STATE_11_CM 1 0. 0. 3. DISPLAY_IDENTIFIER ecm3_lf_err_cod_err_mem_old.state_err_idc_err_mem_old ECU_ADDRESS 0xd0007e0a BIT_MASK 0x60 /end MEASUREMENT
/begin MEASUREMENT LV_MC_CPT_ERR_MEM_OLD "Local variable: flag indicating whether the old error code for error memory management belongs to MC (=1) or MU(=0)" UBYTE _CNV_S_2_ECM3_LV_MC_12_CM 1 0. 0. 1. DISPLAY_IDENTIFIER ecm3_lf_err_cod_err_mem_old.lv_mc_cpt_err_mem_old ECU_ADDRESS 0xd0007e0a BIT_MASK 0x80 /end MEASUREMENT
/begin MEASUREMENT ecm3_lf_err_cod_mc "" UBYTE _CNV_A_R_ECME_LINEA_0_CM 1 0. 0. 255. ECU_ADDRESS 0xd0007e1e FORMAT "%3.0" /end MEASUREMENT
/begin MEASUREMENT ERR_COD_MC "Error code of the MC" UBYTE _CNV_S_30_ECM3_ERR_C_13_CM 1 0. 0. 30. DISPLAY_IDENTIFIER ecm3_lf_err_cod_mc.err_cod_mc ECU_ADDRESS 0xd0007e1e BIT_MASK 0x1F /end MEASUREMENT
/begin MEASUREMENT STATE_ERR_IDC_MC "Error indication on MC" UBYTE _CNV_S_4_ECM3_STATE_11_CM 1 0. 0. 3. DISPLAY_IDENTIFIER ecm3_lf_err_cod_mc.state_err_idc_mc ECU_ADDRESS 0xd0007e1e BIT_MASK 0x60 /end MEASUREMENT
/begin MEASUREMENT ecm3_lf_err_cod_mu "" UBYTE _CNV_A_R_ECME_LINEA_0_CM 1 0. 0. 255. ECU_ADDRESS 0xd0004467 FORMAT "%3.0" /end MEASUREMENT
/begin MEASUREMENT ERR_COD_MU "Error code of the MU" UBYTE _CNV_S_24_ECM3_ERR_C_14_CM 1 0. 0. 23. DISPLAY_IDENTIFIER ecm3_lf_err_cod_mu.err_cod_mu ECU_ADDRESS 0xd0004467 BIT_MASK 0x1F /end MEASUREMENT
/begin MEASUREMENT STATE_ERR_IDC_MU "Error indication of MU" UBYTE _CNV_S_4_ECM3_STATE_11_CM 1 0. 0. 3. DISPLAY_IDENTIFIER ecm3_lf_err_cod_mu.state_err_idc_mu ECU_ADDRESS 0xd0004467 BIT_MASK 0x60 /end MEASUREMENT
/begin MEASUREMENT idx_nr_err_mc_fct_spc_ist "Local variable: \"marker\" of index for which second calculation of copy of process monitoring failed" UBYTE _CNV_A_R_ECME_LINEA_0_CM 1 0. 0. 255. ECU_ADDRESS 0xd0005709 FORMAT "%3.0" /end MEASUREMENT
/begin MEASUREMENT idx_state_sopc "Index into lookup table to determine the final result of the SOPC (stored in reset-safe manner)" UBYTE _CNV_A_R_ECME_LINEA_0_CM 1 0. 0. 255. ECU_ADDRESS 0xd0007e42 FORMAT "%3.0" /end MEASUREMENT
/begin MEASUREMENT lf_mc_pfm_syn_byte_mon "Local variable: PFM synchronisation byte which is updated synchronously to communications and used for monitoring the PFM data sent by the MU (timely updates, wrong response test)" UBYTE _CNV_A_R_ECME_LINEA_0_CM 1 0. 0. 255. ECU_ADDRESS 0xd00052b2 FORMAT "%3.0" /end MEASUREMENT
/begin MEASUREMENT lf_mc_pfm_syn_byte_tog "Local variable: PFM synchronisation byte which is updated synchronously with monitored functionality (modified by PFM service actions)" UBYTE _CNV_A_R_ECME_LINEA_0_CM 1 0. 0. 255. ECU_ADDRESS 0xd0004c67 FORMAT "%3.0" /end MEASUREMENT
/begin MEASUREMENT lf_mu_conf_byte "Local variable: configuration data sent by MU (in PREDRIVE and NORMAL communications)" UBYTE _CNV_A_R_ECME_LINEA_0_CM 1 0. 0. 255. ECU_ADDRESS 0xd0004178 FORMAT "%3.0" /end MEASUREMENT
/begin MEASUREMENT lv_abc_mc_err_com "Flag indicating that an anti-bounce counter for communication monitoring is greater than 0 after reset" UBYTE _CNV_S_2_RANGE______3_CM 1 0. 0. 1. ECU_ADDRESS 0xd000446e /end MEASUREMENT
/begin MEASUREMENT lv_abc_mc_err_fct_spc_ist "Flag indicating that an anti-bounce counter for FS-IST is greater than 0 after reset" UBYTE _CNV_S_2_RANGE______3_CM 1 0. 0. 1. ECU_ADDRESS 0xd0004471 /end MEASUREMENT
/begin MEASUREMENT lv_abc_mc_err_pfm "Flag indicating that an anti-bounce counter for PFM tasks 0...5 (not for task 6!) is greater than 0 after reset" UBYTE _CNV_S_2_RANGE______3_CM 1 0. 0. 1. ECU_ADDRESS 0xd000446f /end MEASUREMENT
/begin MEASUREMENT lv_abc_mc_err_pfm_6 "Flag indicating that an anti-bounce counter for PFM task 6 is greater than 0 after reset" UBYTE _CNV_S_2_RANGE______3_CM 1 0. 0. 1. ECU_ADDRESS 0xd0004470 /end MEASUREMENT
/begin MEASUREMENT lv_err_mu_mc "Error flag requesting and indicating permanent disabling of power stages by Processor Monitoring (MU and MC)" UBYTE _CNV_S_2_RANGE______3_CM 1 0. 0. 1. ECU_ADDRESS 0xd0005d8c /end MEASUREMENT
/begin MEASUREMENT lv_err_tmp_mu_mc "Error flag requesting and indicating temporary disabling of power stages by Processor Monitoring (MU and MC)" UBYTE _CNV_S_2_RANGE______3_CM 1 0. 0. 1. ECU_ADDRESS 0xd0005d8d /end MEASUREMENT
/begin MEASUREMENT lv_inj_off_tmr_inj_ena "Indicates enabling of injection by injection off timer of MU" UBYTE _CNV_S_2_RANGE______3_CM 1 0. 0. 1. ECU_ADDRESS 0xd0003f62 /end MEASUREMENT
/begin MEASUREMENT lv_inj_off_tmr_inj_ena_tmp "Temporary flag indicating enabling of injection by the injection off timer of MU" UBYTE _CNV_S_2_RANGE______3_CM 1 0. 0. 1. ECU_ADDRESS 0xd0004472 /end MEASUREMENT
/begin MEASUREMENT lv_mc_com_err "Error flag indicating any communication error (checksum, header, or parity)" UBYTE _CNV_S_2_RANGE______3_CM 1 0. 0. 1. ECU_ADDRESS 0xd0005c62 /end MEASUREMENT
/begin MEASUREMENT lv_mc_dr_off "Flag indicating whether the redundant switch-off path was triggered" UBYTE _CNV_S_2_RANGE______3_CM 1 0. 0. 1. ECU_ADDRESS 0xd0005d8b /end MEASUREMENT
/begin MEASUREMENT lv_mc_fct_spc_ist_wrg_resp_act "Local variable: flag indicating whether sending of wrong FS-IST answers is active or not" UBYTE _CNV_S_2_RANGE______3_CM 1 0. 0. 1. ECU_ADDRESS 0xd000570a /end MEASUREMENT
/begin MEASUREMENT lv_mc_ign_key "Ignition key information to be sent from MC to MU" UBYTE _CNV_S_2_RANGE______3_CM 1 0. 0. 1. ECU_ADDRESS 0xd0003f61 /end MEASUREMENT
/begin MEASUREMENT lv_mc_inh_sopc "Flag indicating that the MC-part of the SOPC has to be delayed since the MU is still disabling" UBYTE _CNV_S_2_RANGE______3_CM 1 0. 0. 1. ECU_ADDRESS 0xd000446d /end MEASUREMENT
/begin MEASUREMENT lv_mc_pfm_wrg_resp_act_6 "Flag indicating that the wrong response test for PFM task 6 has been performed at least once (needed for healing of reset counter and error information on the MC)" UBYTE _CNV_S_2_RANGE______3_CM 1 0. 0. 1. ECU_ADDRESS 0xd0004c69 /end MEASUREMENT
/begin MEASUREMENT lv_mc_rom_chk_ready "Flag indicating whether the level 1 ROM check is ready" UBYTE _CNV_S_2_RANGE______3_CM 1 0. 0. 1. ECU_ADDRESS 0xd0007e18 /end MEASUREMENT
/begin MEASUREMENT lv_mc_sopc_act "Flag indicating whether MC SOPC is still active (=1, i.e., not finished) or not (=0)" UBYTE _CNV_S_2_RANGE______3_CM 1 0. 0. 1. ECU_ADDRESS 0xd0004be0 /end MEASUREMENT
/begin MEASUREMENT lv_mc_sopc_inh_di "Flag indicating to other functions not to disable the power stages via HW disable lines because the MU-part of the SOPC is active" UBYTE _CNV_S_2_RANGE______3_CM 1 0. 0. 1. ECU_ADDRESS 0xd0005ba9 /end MEASUREMENT
/begin MEASUREMENT lv_mc_st_lih_sopc "Request to start in limp-home mode based on result of the switch-off path check" UBYTE _CNV_S_2_RANGE______3_CM 1 0. 0. 1. ECU_ADDRESS 0xd0005c84 /end MEASUREMENT
/begin MEASUREMENT lv_mu_di_out_0 "Flag indicating (in inverse logic!) whether the MU disables power stage 0 or not" UBYTE _CNV_S_2_RANGE______3_CM 1 0. 0. 1. ECU_ADDRESS 0xd0004469 /end MEASUREMENT
/begin MEASUREMENT lv_mu_di_out_1 "Flag indicating (in inverse logic!) whether the MU disables power stage 1 or not" UBYTE _CNV_S_2_RANGE______3_CM 1 0. 0. 1. ECU_ADDRESS 0xd000446a /end MEASUREMENT
/begin MEASUREMENT lv_mu_ign_key "Ignition key signal redundantly acquired on MU (only useful in HW acquisition mode)" UBYTE _CNV_S_2_RANGE______3_CM 1 0. 0. 1. ECU_ADDRESS 0xd000417b /end MEASUREMENT
/begin MEASUREMENT lv_mu_ready "Flag indicating whether MU is ready (=1) or not (=0)" UBYTE _CNV_S_2_RANGE______3_CM 1 0. 0. 1. ECU_ADDRESS 0xd000439c /end MEASUREMENT
/begin MEASUREMENT lv_v_h_det_mu "Flag indicating that over-voltage was detected by the MU" UBYTE _CNV_S_2_RANGE______3_CM 1 0. 0. 1. ECU_ADDRESS 0xd000446c /end MEASUREMENT
/begin MEASUREMENT lv_v_l_det_mu "Flag indicating that under-voltage was detected by the MU" UBYTE _CNV_S_2_RANGE______3_CM 1 0. 0. 1. ECU_ADDRESS 0xd000446b /end MEASUREMENT
/begin MEASUREMENT mu_di_state "State of MU Disable request" UBYTE _CNV_S_4_ECM3_MU_DI_15_CM 1 0. 0. 3. ECU_ADDRESS 0xd0004468 /end MEASUREMENT
/begin MEASUREMENT nr_mu_comp "Compatibility number sent by MU" UBYTE _CNV_A_R_ECME_LINEA_0_CM 1 0. 0. 255. ECU_ADDRESS 0xd0004179 FORMAT "%3.0" /end MEASUREMENT
/begin MEASUREMENT nr_mu_hw_vers "Hardware version sent by MU" UBYTE _CNV_A_R_ECME_LINEA_0_CM 1 0. 0. 255. ECU_ADDRESS 0xd000417a FORMAT "%3.0" /end MEASUREMENT
/begin MEASUREMENT state_err_idc_mu_ready "Error indication of MU fetched during readiness" UBYTE _CNV_A_R_ECME_LINEA_0_CM 1 0. 0. 255. ECU_ADDRESS 0xd000439b FORMAT "%3.0" /end MEASUREMENT
/begin MEASUREMENT state_mc "Internal state of the MC (also used as header byte in communications)" UBYTE _CNV_A_R_ECME_LINEA_0_CM 1 0. 0. 255. ECU_ADDRESS 0xd0004177 FORMAT "%3.0" /end MEASUREMENT
/begin MEASUREMENT state_mc_resp_sopc "Local variable: final result of the SOPC" UBYTE _CNV_A_R_ECME_LINEA_0_CM 1 0. 0. 255. ECU_ADDRESS 0xd0004be1 FORMAT "%3.0" /end MEASUREMENT
/begin MEASUREMENT state_mu_tmp "Header byte of MU as sent to MC (stored in reset-safe manner)" UBYTE _CNV_A_R_ECME_LINEA_0_CM 1 0. 0. 255. ECU_ADDRESS 0xd0007e1a FORMAT "%3.0" /end MEASUREMENT
/begin MEASUREMENT test_rec_idx_mon2 "Question number (\"test index\") exported to the copy of process monitoring" UBYTE _CNV_A_R_ECME_LINEA_0_CM 1 0. 0. 255. ECU_ADDRESS 0xd0004ff1 FORMAT "%3.0" /end MEASUREMENT
/begin MEASUREMENT vp_mc_an_dig_mon "Result of A/D conversion on the MC (exported to process monitoring)" UWORD _CNV_A_R_LINEAR_____16_CM 1 0. 0. 4.99984741210938 ECU_ADDRESS 0xd0005c8a FORMAT "%6.4" /end MEASUREMENT
/begin MEASUREMENT vp_mu_an_dig_mon "Result of A/D conversion on the MU (exported to process monitoring)" UWORD _CNV_A_R_LINEAR_____16_CM 1 0. 0. 4.99984741210938 ECU_ADDRESS 0xd0005c8c FORMAT "%6.4" /end MEASUREMENT
/begin CHARACTERISTIC c_err_swi_mc_level_2_cal "Switch to disregard ROM errors in the level 2 calibration data (when set to NC_ERR_SWI_MC_LEVEL_2_CAL)" VALUE 0xa002187e _REC_S1VAL_20_u2 65535. _CNV_A_R_ECME_LINEA_0_CM 0. 65535. FORMAT "%5.0" /end CHARACTERISTIC
/begin CHARACTERISTIC c_err_swi_mc_level_2_cod "Switch to disregard ROM errors in the level 2 code (when set to NC_ERR_SWI_MC_LEVEL_2_COD)" VALUE 0xa0021880 _REC_S1VAL_20_u2 65535. _CNV_A_R_ECME_LINEA_0_CM 0. 65535. FORMAT "%5.0" /end CHARACTERISTIC
/begin MEASUREMENT envd_0_mon_3 "Environmental data 0 for general processor monitoring error" UBYTE _CNV_A_R_ECME_LINEA_0_CM 1 0. 0. 255. ECU_ADDRESS 0xd0003f5c FORMAT "%3.0" /end MEASUREMENT
/begin MEASUREMENT envd_1_mon_3 "Environmental data 1 for general processor monitoring error" UBYTE _CNV_A_R_ECME_LINEA_0_CM 1 0. 0. 255. ECU_ADDRESS 0xd0003f5d FORMAT "%3.0" /end MEASUREMENT
/begin MEASUREMENT envd_2_mon_3 "Environmental data 2 for general processor monitoring error" UBYTE _CNV_A_R_ECME_LINEA_0_CM 1 0. 0. 255. ECU_ADDRESS 0xd0003f5e FORMAT "%3.0" /end MEASUREMENT
/begin MEASUREMENT envd_3_mon_3 "Environmental data 3 for general processor monitoring error" UBYTE _CNV_A_R_ECME_LINEA_0_CM 1 0. 0. 255. ECU_ADDRESS 0xd0003f5f FORMAT "%3.0" /end MEASUREMENT
/begin MEASUREMENT err_sym_mon_3 "Error symptom extracted from ERR_COD_MC and ERR_COD_MU" UBYTE _CNV_S_5_ECM3_ERR_S_17_CM 1 0. 0. 8. ECU_ADDRESS 0xd0005700 /end MEASUREMENT
/begin MEASUREMENT lv_cdn_diag_mon_3 "Diagnosis condition for processor monitoring error" UBYTE _CNV_S_2_RANGE______3_CM 1 0. 0. 1. ECU_ADDRESS 0xd00056fe /end MEASUREMENT
/begin MEASUREMENT lv_end_diag_mon_3 "Indicates that diagnosis has been finished" UBYTE _CNV_S_2_RANGE______3_CM 1 0. 0. 1. ECU_ADDRESS 0xd00056ff /end MEASUREMENT
/begin MEASUREMENT lv_err_cus_mon_3 "Safety L3 error flag set to one after 7 resets" UBYTE _CNV_S_2_RANGE______3_CM 1 0. 0. 1. ECU_ADDRESS 0xd0003f66 /end MEASUREMENT
/begin MEASUREMENT lv_err_cus_mon_3_ext "Predrive failure due to an external problem coming from the RSA safety L2" UBYTE _CNV_S_2_RANGE______3_CM 1 0. 0. 1. ECU_ADDRESS 0xd0003f68 /end MEASUREMENT
/begin MEASUREMENT lv_err_cus_mon_3_vb "Predrive failure due to a pb battery" UBYTE _CNV_S_2_RANGE______3_CM 1 0. 0. 1. ECU_ADDRESS 0xd0003f67 /end MEASUREMENT
/begin MEASUREMENT lv_err_mon_3 "Error detected by processor monitoring" UBYTE _CNV_S_2_RANGE______3_CM 1 0. 0. 1. ECU_ADDRESS 0xd0003f64 /end MEASUREMENT
/begin MEASUREMENT lv_err_tmp_cus_mon_3 "Safety L3 error flag set to one after 2 resets" UBYTE _CNV_S_2_RANGE______3_CM 1 0. 0. 1. ECU_ADDRESS 0xd0003f65 /end MEASUREMENT
/begin MEASUREMENT lv_mu_ign_key_old "Flag used for storing value of ignition key signal on MU from last recurrence (needed for IOT handling)" UBYTE _CNV_S_2_RANGE______3_CM 1 0. 0. 1. ECU_ADDRESS 0xd00056fd /end MEASUREMENT
/begin MEASUREMENT lv_pwl_lock_cdn_rom_chk "power-latch lock condition for standard ROM test execution" UBYTE _CNV_S_2_RANGE______3_CM 1 0. 0. 1. ECU_ADDRESS 0xd0003f63 /end MEASUREMENT
/begin MEASUREMENT rom_cks_cal_clc_h "Actual value of CAL data ROM test of process monitoring (upper 32 bit)" ULONG _CNV_A_R_ECME_LINEA_0_CM 1 0. 0. 4294967295. ECU_ADDRESS 0xd000298c FORMAT "%10.0" /end MEASUREMENT
/begin MEASUREMENT rom_cks_cal_clc_l "Actual value of CAL data ROM test of process monitoring (lower 32 bit)" ULONG _CNV_A_R_ECME_LINEA_0_CM 1 0. 0. 4294967295. ECU_ADDRESS 0xd0002988 FORMAT "%10.0" /end MEASUREMENT
/begin MEASUREMENT state_prdr "steps of predrive test" UBYTE _CNV_S_4_ECM3_STATE_18_CM 1 0. 0. 3. ECU_ADDRESS 0xd0003f60 /end MEASUREMENT
/begin CHARACTERISTIC c_vb_prdr "minimal battery voltage for H bridge" VALUE 0xa0021170 _REC_S1VAL_20_u2 40.99937 _CNV_A_R_LINEAR_____19_CM 0. 40.99937 FORMAT "%7.4" /end CHARACTERISTIC
/begin CHARACTERISTIC C_ROM_CKS_CAL_H "setpoint upper 32 bit of checksum of process monitoring CAL data" VALUE 0xa0020400 _REC_S1VAL_20_u4 4294967295. _CNV_A_R_ECME_LINEA_0_CM 0. 4294967295. DISPLAY_IDENTIFIER ecm3_id_rom_cks_cal[0] FORMAT "%10.0" /end CHARACTERISTIC
/begin CHARACTERISTIC C_ROM_CKS_CAL_L "setpoint lower 32 bit of checksum of process monitoring CAL data" VALUE 0xa0020404 _REC_S1VAL_20_u4 4294967295. _CNV_A_R_ECME_LINEA_0_CM 0. 4294967295. DISPLAY_IDENTIFIER ecm3_id_rom_cks_cal[1] FORMAT "%10.0" /end CHARACTERISTIC
/begin MEASUREMENT ecm3_pow_up_act "" UBYTE _CNV_S_2_ECM3_POW_U_20_CM 1 0. 90. 165. ECU_ADDRESS 0xd0007e34 /end MEASUREMENT
/begin MEASUREMENT ecm3_rcv_buf_mc[0] "" UBYTE _CNV_A_R_ECME_LINEA_0_CM 1 0. 0. 255. ECU_ADDRESS 0xd0003f74 FORMAT "%3.0" /end MEASUREMENT
/begin MEASUREMENT ecm3_rcv_buf_mc[1] "" UBYTE _CNV_A_R_ECME_LINEA_0_CM 1 0. 0. 255. ECU_ADDRESS 0xd0003f75 FORMAT "%3.0" /end MEASUREMENT
/begin MEASUREMENT ecm3_rcv_buf_mc[2] "" UBYTE _CNV_A_R_ECME_LINEA_0_CM 1 0. 0. 255. ECU_ADDRESS 0xd0003f76 FORMAT "%3.0" /end MEASUREMENT
/begin MEASUREMENT ecm3_rcv_buf_mc[3] "" UBYTE _CNV_A_R_ECME_LINEA_0_CM 1 0. 0. 255. ECU_ADDRESS 0xd0003f77 FORMAT "%3.0" /end MEASUREMENT
/begin MEASUREMENT ecm3_rcv_buf_mc[4] "" UBYTE _CNV_A_R_ECME_LINEA_0_CM 1 0. 0. 255. ECU_ADDRESS 0xd0003f78 FORMAT "%3.0" /end MEASUREMENT
/begin MEASUREMENT ecm3_rcv_buf_mc[5] "" UBYTE _CNV_A_R_ECME_LINEA_0_CM 1 0. 0. 255. ECU_ADDRESS 0xd0003f79 FORMAT "%3.0" /end MEASUREMENT
/begin MEASUREMENT ecm3_trm_buf_mc[0] "" UBYTE _CNV_A_R_ECME_LINEA_0_CM 1 0. 0. 255. ECU_ADDRESS 0xd0003f6f FORMAT "%3.0" /end MEASUREMENT
/begin MEASUREMENT ecm3_trm_buf_mc[1] "" UBYTE _CNV_A_R_ECME_LINEA_0_CM 1 0. 0. 255. ECU_ADDRESS 0xd0003f70 FORMAT "%3.0" /end MEASUREMENT
/begin MEASUREMENT ecm3_trm_buf_mc[2] "" UBYTE _CNV_A_R_ECME_LINEA_0_CM 1 0. 0. 255. ECU_ADDRESS 0xd0003f71 FORMAT "%3.0" /end MEASUREMENT
/begin MEASUREMENT ecm3_trm_buf_mc[3] "" UBYTE _CNV_A_R_ECME_LINEA_0_CM 1 0. 0. 255. ECU_ADDRESS 0xd0003f72 FORMAT "%3.0" /end MEASUREMENT
/begin MEASUREMENT ecm3_trm_buf_mc[4] "" UBYTE _CNV_A_R_ECME_LINEA_0_CM 1 0. 0. 255. ECU_ADDRESS 0xd0003f73 FORMAT "%3.0" /end MEASUREMENT
/begin MEASUREMENT lv_stop_cus_mon "Stop request coming from RSA monitoring" UBYTE _CNV_S_2_RANGE______3_CM 1 0. 0. 1. ECU_ADDRESS 0xd0005c61 BIT_MASK 0x1 /end MEASUREMENT
/begin MEASUREMENT id_seg_nr_0 "Segment number array" UBYTE _CNV_A_R_ECME_LINEA_0_CM 1 0. 0. 255. DISPLAY_IDENTIFIER id_seg_nr[0] ECU_ADDRESS 0xd000400c FORMAT "%3.0" /end MEASUREMENT
/begin MEASUREMENT id_seg_nr_1 "Segment number array" UBYTE _CNV_A_R_ECME_LINEA_0_CM 1 0. 0. 255. DISPLAY_IDENTIFIER id_seg_nr[1] ECU_ADDRESS 0xd000400d FORMAT "%3.0" /end MEASUREMENT
/begin MEASUREMENT id_seg_nr_2 "Segment number array" UBYTE _CNV_A_R_ECME_LINEA_0_CM 1 0. 0. 255. DISPLAY_IDENTIFIER id_seg_nr[2] ECU_ADDRESS 0xd000400e FORMAT "%3.0" /end MEASUREMENT
/begin MEASUREMENT id_seg_nr_3 "Segment number array" UBYTE _CNV_A_R_ECME_LINEA_0_CM 1 0. 0. 255. DISPLAY_IDENTIFIER id_seg_nr[3] ECU_ADDRESS 0xd000400f FORMAT "%3.0" /end MEASUREMENT
/begin MEASUREMENT n "Engine speed- resolution 1rpm" UWORD _CNV_A_R_LINEAR_____21_CM 1 0. 0. 8160. ECU_ADDRESS 0xd0002f90 FORMAT "%4.0" /end MEASUREMENT
/begin MEASUREMENT n_32 "Engine speed- resolution 32rpm" UBYTE _CNV_A_R_LINEAR_____2_CM 1 0. 0. 8160. ECU_ADDRESS 0xd0004016 FORMAT "%4.0" /end MEASUREMENT
/begin MEASUREMENT n_fast "Fast engine speed- resolution 1rpm" UWORD _CNV_A_R_LINEAR_____21_CM 1 0. 0. 8160. ECU_ADDRESS 0xd0002f92 FORMAT "%4.0" /end MEASUREMENT
/begin MEASUREMENT n_grd "Engine speed gradient" SBYTE _CNV_A_R_LINEAR_____22_CM 1 0. -4096. 4064. ECU_ADDRESS 0xd0004017 FORMAT "%5.0" /end MEASUREMENT
/begin MEASUREMENT n_grd_h_res "High resolution engine speed gradient" SWORD _CNV_A_R_LINEAR_____23_CM 1 0. -4096. 4095. ECU_ADDRESS 0xd0002f94 FORMAT "%6.0" /end MEASUREMENT
/begin MEASUREMENT n_grd_h_res_rng "High resolution and range engine speed gradient" SWORD _CNV_A_R_LINEAR_____23_CM 1 0. -32768. 32767. ECU_ADDRESS 0xd0002f96 FORMAT "%6.0" /end MEASUREMENT
/begin MEASUREMENT n_h_rng "High range engine speed" UWORD _CNV_A_R_LINEAR_____21_CM 1 0. 0. 65535. ECU_ADDRESS 0xd0002f98 FORMAT "%5.0" /end MEASUREMENT
/begin MEASUREMENT n_mmv "Engine speed- moving mean value" UWORD _CNV_A_R_LINEAR_____21_CM 1 0. 0. 8160. ECU_ADDRESS 0xd0002f9a FORMAT "%4.0" /end MEASUREMENT
/begin MEASUREMENT n_sae "PID0C Engine speed in revolutions per minute (RPM)" UWORD _CNV_A_R_ENSD_LINEA_24_CM 1 0. 0. 16383.75 ECU_ADDRESS 0xd0002f9c FORMAT "%8.2" /end MEASUREMENT
/begin MEASUREMENT n_tooth "Engine speed calculated on last crankshaft tooth period (update rate 10ms)" UWORD _CNV_A_R_LINEAR_____21_CM 1 0. 0. 8160. ECU_ADDRESS 0xd0002f9e FORMAT "%4.0" /end MEASUREMENT
/begin MEASUREMENT psn_eng_syn_max "Maximum engine position during crankshaft synchronization phase" UWORD _CNV_A_R_LINEAR_____25_CM 1 0. 0. 719.625 ECU_ADDRESS 0xd0002fa6 FORMAT "%8.3" /end MEASUREMENT
/begin MEASUREMENT psn_eng_syn_min "Minimum engine position during crankshaft synchronization phase" UWORD _CNV_A_R_LINEAR_____25_CM 1 0. 0. 719.625 ECU_ADDRESS 0xd0002fa8 FORMAT "%8.3" /end MEASUREMENT
/begin MEASUREMENT seg_ctr "Continuous segment counter (saturated at maximum value)" UWORD _CNV_A_R_ECME_LINEA_0_CM 1 0. 0. 65535. ECU_ADDRESS 0xd0002faa FORMAT "%5.0" /end MEASUREMENT
/begin MEASUREMENT seg_nr "Actual segment number (from 0 to NC_CYL_NR-1)" UBYTE _CNV_A_R_ECME_LINEA_0_CM 1 0. 0. 7. ECU_ADDRESS 0xd000401b FORMAT "%3.0" /end MEASUREMENT
/begin MEASUREMENT t_seg_av "Exported segment period" UWORD _CNV_A_R_LINEAR_____26_CM 1 0. 0. 0.26214 ECU_ADDRESS 0xd0002fac FORMAT "%8.6" /end MEASUREMENT
/begin MEASUREMENT t_seg_half_av "Half-segment period" UWORD _CNV_A_R_LINEAR_____26_CM 1 0. 0. 0.26214 ECU_ADDRESS 0xd0002fae FORMAT "%8.6" /end MEASUREMENT
/begin CHARACTERISTIC c_n_fast_swi "Switch case choice for N_FAST calculation mode" VALUE 0xa002165a _REC_S1VAL_20_u1 4. _CNV_A_R_ECME_LINEA_0_CM 0. 4. FORMAT "%3.0" /end CHARACTERISTIC
/begin CHARACTERISTIC c_n_tooth_end "Engine speed threshold for N_TOOTH calculation (engine start)" VALUE 0xa002165c _REC_S1VAL_20_u1 8160. _CNV_A_R_LINEAR_____2_CM 0. 8160. FORMAT "%4.0" /end CHARACTERISTIC
/begin MEASUREMENT lv_cam_lih_ext_ena "" UBYTE _CNV_S_2_RANGE______3_CM 1 0. 0. 1. ECU_ADDRESS 0xd0004022 BIT_MASK 0x1 /end MEASUREMENT
/begin MEASUREMENT lv_seg_nr_upd_req "" UBYTE _CNV_S_2_RANGE______3_CM 1 0. 0. 1. ECU_ADDRESS 0xd000403f BIT_MASK 0x1 /end MEASUREMENT
/begin MEASUREMENT lv_syn_vld_cam_lih "" UBYTE _CNV_S_2_RANGE______3_CM 1 0. 0. 1. ECU_ADDRESS 0xd0004043 BIT_MASK 0x1 /end MEASUREMENT
/begin MEASUREMENT T_DIF_EDGE_CAM_IN_1 "Time between the previous and current camshaft signal edge" ULONG _CNV_A_R_LINEAR_____26_CM 1 0. 0. 17179.86918 DISPLAY_IDENTIFIER idx_cam_ad_in[0].t_dif_edge_cam ECU_ADDRESS 0xd00017e4 FORMAT "%12.6" /end MEASUREMENT
/begin MEASUREMENT PSN_DIF_EDGE_CAM_IN_1 "crankshaft angle between the previous and the current intake camshaft position determination" UWORD _CNV_A_R_LINEAR_____25_CM 1 0. 0. 1535.625 DISPLAY_IDENTIFIER idx_cam_ad_in[0].psn_dif_edge_cam ECU_ADDRESS 0xd00017e8 FORMAT "%8.3" /end MEASUREMENT
/begin MEASUREMENT psn_edge_cam_old_in_1 "" UWORD _CNV_A_R_ENSD_LINEA_27_CM 1 0. -128. 127.9375 DISPLAY_IDENTIFIER idx_cam_ad_in[0].psn_edge_cam_old ECU_ADDRESS 0xd00017ea FORMAT "%9.4" /end MEASUREMENT
/begin MEASUREMENT PSN_CAM_IN_1 "Actual intake camshaft position relative to adapted passive position" UWORD _CNV_A_R_LINEAR_____28_CM 1 0. -96. 95.625 DISPLAY_IDENTIFIER idx_cam_ad_in[0].psn_cam ECU_ADDRESS 0xd00017f4 FORMAT "%7.3" /end MEASUREMENT
/begin MEASUREMENT CAM_PSN_LST_REF_AD_IN_1 "Adapted intake camshaft i signal position after last correct reference adaptation" UWORD _CNV_A_R_ENSD_LINEA_29_CM 1 0. -32. 31.9375 DISPLAY_IDENTIFIER idx_cam_ad_in[0].cam_psn_lst_ref_ad ECU_ADDRESS 0xd00017f6 FORMAT "%8.4" /end MEASUREMENT
/begin MEASUREMENT PSN_AD_CAM_IN_1 "adapted intake camshaft position relative to designed passive position" UBYTE _CNV_A_R_LINEAR_____30_CM 1 0. -48. 47.625 DISPLAY_IDENTIFIER idx_cam_ad_in[0].psn_ad_cam ECU_ADDRESS 0xd00017f8 FORMAT "%7.3" /end MEASUREMENT
/begin MEASUREMENT CTR_REV_AD_REF_CAM_IN_1 "Intake camshaft reference position adaptation revolution counter" UBYTE _CNV_A_R_ECME_LINEA_0_CM 1 0. 0. 255. DISPLAY_IDENTIFIER idx_cam_ad_in[0].ctr_rev_ad_ref_cam ECU_ADDRESS 0xd00017f9 FORMAT "%3.0" /end MEASUREMENT
/begin MEASUREMENT LV_AD_END_CAM_IN_1 "Intake camshaft reference position adaptation successful" UBYTE _CNV_S_2_RANGE______3_CM 1 0. 0. 1. DISPLAY_IDENTIFIER idx_cam_ad_in[0].lv_ad_end_cam ECU_ADDRESS 0xd00017fa BIT_MASK 0x1 /end MEASUREMENT
/begin MEASUREMENT LV_TOOTH_OFF_DET_ENA_IN_1 "Confirmation that a reference adaptation occurred after the very first one, to allow the one_tooth_off detection (intake i)" UBYTE _CNV_S_2_RANGE______3_CM 1 0. 0. 1. DISPLAY_IDENTIFIER idx_cam_ad_in[0].lv_tooth_off_det_ena ECU_ADDRESS 0xd00017fb BIT_MASK 0x1 /end MEASUREMENT
/begin MEASUREMENT LV_CAM_AD_SAVE_IN_1 "Confirmation that adaptative values at intake i have already been store" UBYTE _CNV_S_2_RANGE______3_CM 1 0. 0. 1. DISPLAY_IDENTIFIER idx_cam_ad_in[0].lv_cam_ad_save ECU_ADDRESS 0xd00017fc BIT_MASK 0x1 /end MEASUREMENT
/begin MEASUREMENT LV_ORNG_CAM_AD_IN_1 "Camshaft adaptive values out of range for intake bank 1" UBYTE _CNV_S_2_RANGE______3_CM 1 0. 0. 1. DISPLAY_IDENTIFIER idx_cam_ad_in[0].lv_orng_cam_ad ECU_ADDRESS 0xd00017fd BIT_MASK 0x1 /end MEASUREMENT
/begin MEASUREMENT PSN_EDGE_1_AD_CAM_IN_1 "Adapted intake camshaft i signal edge z position" UWORD _CNV_A_R_ENSD_LINEA_29_CM 1 0. -32. 31.9375 DISPLAY_IDENTIFIER idx_psn_edge_ad_cam_in_1[0] ECU_ADDRESS 0xd0002f68 FORMAT "%8.4" /end MEASUREMENT
/begin MEASUREMENT PSN_EDGE_2_AD_CAM_IN_1 "Adapted intake camshaft i signal edge z position" UWORD _CNV_A_R_ENSD_LINEA_29_CM 1 0. -32. 31.9375 DISPLAY_IDENTIFIER idx_psn_edge_ad_cam_in_1[1] ECU_ADDRESS 0xd0002f6a FORMAT "%8.4" /end MEASUREMENT
/begin MEASUREMENT PSN_EDGE_3_AD_CAM_IN_1 "Adapted intake camshaft i signal edge z position" UWORD _CNV_A_R_ENSD_LINEA_29_CM 1 0. -32. 31.9375 DISPLAY_IDENTIFIER idx_psn_edge_ad_cam_in_1[2] ECU_ADDRESS 0xd0002f6c FORMAT "%8.4" /end MEASUREMENT
/begin MEASUREMENT PSN_EDGE_4_AD_CAM_IN_1 "Adapted intake camshaft i signal edge z position" UWORD _CNV_A_R_ENSD_LINEA_29_CM 1 0. -32. 31.9375 DISPLAY_IDENTIFIER idx_psn_edge_ad_cam_in_1[3] ECU_ADDRESS 0xd0002f6e FORMAT "%8.4" /end MEASUREMENT
/begin MEASUREMENT PSN_EDGE_5_AD_CAM_IN_1 "Adapted intake camshaft i signal edge z position" UWORD _CNV_A_R_ENSD_LINEA_29_CM 1 0. -32. 31.9375 DISPLAY_IDENTIFIER idx_psn_edge_ad_cam_in_1[4] ECU_ADDRESS 0xd0002f70 FORMAT "%8.4" /end MEASUREMENT
/begin MEASUREMENT PSN_EDGE_6_AD_CAM_IN_1 "Adapted intake camshaft i signal edge z position" UWORD _CNV_A_R_ENSD_LINEA_29_CM 1 0. -32. 31.9375 DISPLAY_IDENTIFIER idx_psn_edge_ad_cam_in_1[5] ECU_ADDRESS 0xd0002f72 FORMAT "%8.4" /end MEASUREMENT
/begin MEASUREMENT PSN_EDGE_7_AD_CAM_IN_1 "Adapted intake camshaft i signal edge z position" UWORD _CNV_A_R_ENSD_LINEA_29_CM 1 0. -32. 31.9375 DISPLAY_IDENTIFIER idx_psn_edge_ad_cam_in_1[6] ECU_ADDRESS 0xd0002f74 FORMAT "%8.4" /end MEASUREMENT
/begin MEASUREMENT PSN_EDGE_8_AD_CAM_IN_1 "Adapted intake camshaft i signal edge z position" UWORD _CNV_A_R_ENSD_LINEA_29_CM 1 0. -32. 31.9375 DISPLAY_IDENTIFIER idx_psn_edge_ad_cam_in_1[7] ECU_ADDRESS 0xd0002f76 FORMAT "%8.4" /end MEASUREMENT
/begin MEASUREMENT PSN_EDGE_9_AD_CAM_IN_1 "Adapted intake camshaft i signal edge z position" UWORD _CNV_A_R_ENSD_LINEA_29_CM 1 0. -32. 31.9375 DISPLAY_IDENTIFIER idx_psn_edge_ad_cam_in_1[8] ECU_ADDRESS 0xd0002f78 FORMAT "%8.4" /end MEASUREMENT
/begin MEASUREMENT PSN_EDGE_10_AD_CAM_IN_1 "Adapted intake camshaft i signal edge z position" UWORD _CNV_A_R_ENSD_LINEA_29_CM 1 0. -32. 31.9375 DISPLAY_IDENTIFIER idx_psn_edge_ad_cam_in_1[9] ECU_ADDRESS 0xd0002f7a FORMAT "%8.4" /end MEASUREMENT
/begin MEASUREMENT PSN_EDGE_1_CAM_IN_1 "Actual intake camshaft position relative to adapted passive position at signal edge index z" UWORD _CNV_A_R_ENSD_LINEA_27_CM 1 0. -128. 127.9375 DISPLAY_IDENTIFIER idx_psn_edge_cam_in_1[0] ECU_ADDRESS 0xd0002f7c FORMAT "%9.4" /end MEASUREMENT
/begin MEASUREMENT PSN_EDGE_2_CAM_IN_1 "Actual intake camshaft position relative to adapted passive position at signal edge index z" UWORD _CNV_A_R_ENSD_LINEA_27_CM 1 0. -128. 127.9375 DISPLAY_IDENTIFIER idx_psn_edge_cam_in_1[1] ECU_ADDRESS 0xd0002f7e FORMAT "%9.4" /end MEASUREMENT
/begin MEASUREMENT PSN_EDGE_3_CAM_IN_1 "Actual intake camshaft position relative to adapted passive position at signal edge index z" UWORD _CNV_A_R_ENSD_LINEA_27_CM 1 0. -128. 127.9375 DISPLAY_IDENTIFIER idx_psn_edge_cam_in_1[2] ECU_ADDRESS 0xd0002f80 FORMAT "%9.4" /end MEASUREMENT
/begin MEASUREMENT PSN_EDGE_4_CAM_IN_1 "Actual intake camshaft position relative to adapted passive position at signal edge index z" UWORD _CNV_A_R_ENSD_LINEA_27_CM 1 0. -128. 127.9375 DISPLAY_IDENTIFIER idx_psn_edge_cam_in_1[3] ECU_ADDRESS 0xd0002f82 FORMAT "%9.4" /end MEASUREMENT
/begin MEASUREMENT PSN_EDGE_5_CAM_IN_1 "Actual intake camshaft position relative to adapted passive position at signal edge index z" UWORD _CNV_A_R_ENSD_LINEA_27_CM 1 0. -128. 127.9375 DISPLAY_IDENTIFIER idx_psn_edge_cam_in_1[4] ECU_ADDRESS 0xd0002f84 FORMAT "%9.4" /end MEASUREMENT
/begin MEASUREMENT PSN_EDGE_6_CAM_IN_1 "Actual intake camshaft position relative to adapted passive position at signal edge index z" UWORD _CNV_A_R_ENSD_LINEA_27_CM 1 0. -128. 127.9375 DISPLAY_IDENTIFIER idx_psn_edge_cam_in_1[5] ECU_ADDRESS 0xd0002f86 FORMAT "%9.4" /end MEASUREMENT
/begin MEASUREMENT PSN_EDGE_7_CAM_IN_1 "Actual intake camshaft position relative to adapted passive position at signal edge index z" UWORD _CNV_A_R_ENSD_LINEA_27_CM 1 0. -128. 127.9375 DISPLAY_IDENTIFIER idx_psn_edge_cam_in_1[6] ECU_ADDRESS 0xd0002f88 FORMAT "%9.4" /end MEASUREMENT
/begin MEASUREMENT PSN_EDGE_8_CAM_IN_1 "Actual intake camshaft position relative to adapted passive position at signal edge index z" UWORD _CNV_A_R_ENSD_LINEA_27_CM 1 0. -128. 127.9375 DISPLAY_IDENTIFIER idx_psn_edge_cam_in_1[7] ECU_ADDRESS 0xd0002f8a FORMAT "%9.4" /end MEASUREMENT
/begin MEASUREMENT PSN_EDGE_9_CAM_IN_1 "Actual intake camshaft position relative to adapted passive position at signal edge index z" UWORD _CNV_A_R_ENSD_LINEA_27_CM 1 0. -128. 127.9375 DISPLAY_IDENTIFIER idx_psn_edge_cam_in_1[8] ECU_ADDRESS 0xd0002f8c FORMAT "%9.4" /end MEASUREMENT
/begin MEASUREMENT PSN_EDGE_10_CAM_IN_1 "Actual intake camshaft position relative to adapted passive position at signal edge index z" UWORD _CNV_A_R_ENSD_LINEA_27_CM 1 0. -128. 127.9375 DISPLAY_IDENTIFIER idx_psn_edge_cam_in_1[9] ECU_ADDRESS 0xd0002f8e FORMAT "%9.4" /end MEASUREMENT
/begin CHARACTERISTIC c_crlc_ad_ref_cam_in "Averaging constant for reference position adaptation" VALUE 0xa0021670 _REC_S1VAL_20_u1 0.99609375 _CNV_A_R_LINEAR_____31_CM 0. 0.99609375 FORMAT "%5.3" /end CHARACTERISTIC
/begin CHARACTERISTIC c_grd_ad_ref_max_cam_in "Max permissible drift of reference edge position for reference position adaptation" VALUE 0xa0021671 _REC_S1VAL_20_u1 15.9375 _CNV_A_R_ENSD_LINEA_32_CM 0. 15.9375 FORMAT "%7.4" /end CHARACTERISTIC
/begin CHARACTERISTIC c_n_32_max_ad_ref_cam "Maximal engine speed for reference position adaptation activation" VALUE 0xa0021655 _REC_S1VAL_20_u1 8160. _CNV_A_R_LINEAR_____2_CM 0. 8160. FORMAT "%4.0" /end CHARACTERISTIC
/begin CHARACTERISTIC c_nr_rev_ad_ref_cam_in "Number of camshaft revolutions for reference position adaptation" VALUE 0xa0021674 _REC_S1VAL_20_u1 255. _CNV_A_R_ECME_LINEA_0_CM 0. 255. FORMAT "%3.0" /end CHARACTERISTIC
/begin CHARACTERISTIC c_tol_tooth_off_cam_in "Reference position tolerance for tooth off detection for intake camshaft" VALUE 0xa0021646 _REC_S1VAL_20_u2 31.9375 _CNV_A_R_ENSD_LINEA_32_CM 0. 31.9375 FORMAT "%7.4" /end CHARACTERISTIC
/begin MEASUREMENT lv_err_ref_crk_cam_in_1 "Present intake camshaft 1 failure reference violation" UBYTE _CNV_S_2_RANGE______3_CM 1 0. 0. 1. ECU_ADDRESS 0xd0004969 BIT_MASK 0x1 /end MEASUREMENT
/begin MEASUREMENT lv_err_tooth_off_in_1 "present intake camshaft i-one-tooth failure" UBYTE _CNV_S_2_RANGE______3_CM 1 0. 0. 1. ECU_ADDRESS 0xd0004956 BIT_MASK 0x1 /end MEASUREMENT
/begin CHARACTERISTIC c_n_32_max_diag_ref_crk_cam "Maximal engine speed of camshaft position diagnoses activation" VALUE 0xa0021658 _REC_S1VAL_20_u1 8160. _CNV_A_R_LINEAR_____2_CM 0. 8160. FORMAT "%4.0" /end CHARACTERISTIC
/begin CHARACTERISTIC c_tol_ref_crk_cam_in "Reference position tolerance range for intake camshaft" VALUE 0xa0021644 _REC_S1VAL_20_u2 31.9375 _CNV_A_R_ENSD_LINEA_32_CM 0. 31.9375 FORMAT "%7.4" /end CHARACTERISTIC
/begin MEASUREMENT ctr_cyc_eng_plaus_cam_in_1 "Engine cycle counter for camshaft signal plausibility diagnosis" UBYTE _CNV_A_R_ECME_LINEA_0_CM 1 0. 0. 255. ECU_ADDRESS 0xd0004011 FORMAT "%3.0" /end MEASUREMENT
/begin MEASUREMENT ctr_edge_syn_crk_cam "camshaft edges counter for crankshaft plausibility diagnosis" UBYTE _CNV_A_R_ECME_LINEA_0_CM 1 0. 0. 255. ECU_ADDRESS 0xd0005297 FORMAT "%3.0" /end MEASUREMENT
/begin MEASUREMENT ctr_orng_cam_syn_crk "failure counter to detect camshaft error for crankshaft synchronization" UBYTE _CNV_A_R_ECME_LINEA_0_CM 1 0. 0. 255. ECU_ADDRESS 0xd0005298 FORMAT "%3.0" /end MEASUREMENT
/begin MEASUREMENT lv_err_crk_plaus "Present crankshaft failure synchronization impossible" UBYTE _CNV_S_2_RANGE______3_CM 1 0. 0. 1. ECU_ADDRESS 0xd0004960 BIT_MASK 0x1 /end MEASUREMENT
/begin MEASUREMENT lv_err_plaus_cam_in_1 "Present camshaft failure synchronization impossible" UBYTE _CNV_S_2_RANGE______3_CM 1 0. 0. 1. ECU_ADDRESS 0xd000496b BIT_MASK 0x1 /end MEASUREMENT
/begin MEASUREMENT lv_err_syn_crk_cam_in_1 "Present intake camshaft failure for crankshaft synchronization" UBYTE _CNV_S_2_RANGE______3_CM 1 0. 0. 1. ECU_ADDRESS 0xd000496d BIT_MASK 0x1 /end MEASUREMENT
/begin CHARACTERISTIC c_ctr_orng_cam_syn_crk_max "Failure count to detect camshaft error for crankshaft synchronization" VALUE 0xa0021652 _REC_S1VAL_20_u1 255. _CNV_A_R_ECME_LINEA_0_CM 0. 255. FORMAT "%3.0" /end CHARACTERISTIC
/begin CHARACTERISTIC c_nr_cyc_eng_plaus_cam_max "Number of engine cycles to detect camshaft plausibility error" VALUE 0xa002165d _REC_S1VAL_20_u1 127. _CNV_A_R_ECME_LINEA_0_CM 0. 127. FORMAT "%3.0" /end CHARACTERISTIC
/begin CHARACTERISTIC c_nr_edge_cam_in_syn_crk_max "Number of intake camshaft signal edges to detect crankshaft plausibility error before synchronization" VALUE 0xa0021672 _REC_S1VAL_20_u1 254. _CNV_A_R_ECME_LINEA_0_CM 1. 255. FORMAT "%3.0" /end CHARACTERISTIC
/begin CHARACTERISTIC lc_cam_err_ena_vvt "Switch to enable camshaft error debouncing for VVT reactivation" VALUE 0xa0021660 _REC_S1VAL_20_u1 1. _CNV_A_R_ECME_LINEA_0_CM 0. 1. FORMAT "%1.0" /end CHARACTERISTIC
/begin CHARACTERISTIC lc_ctr_dec_plaus_cam "Switch to enable camshaft plausibility debouncing" VALUE 0xa0021661 _REC_S1VAL_20_u1 1. _CNV_A_R_ECME_LINEA_0_CM 0. 1. FORMAT "%1.0" /end CHARACTERISTIC
/begin MEASUREMENT LV_ERR_CAM_IN_1 "Failure of intake camshaft sensor 1" UBYTE _CNV_S_2_RANGE______3_CM 1 0. 0. 1. DISPLAY_IDENTIFIER idx_diag_mng_in[0].lv_err_cam ECU_ADDRESS 0xd0003ffc BIT_MASK 0x1 /end MEASUREMENT
/begin MEASUREMENT LV_INH_DIAG_SYN_CAM_IN_1 "Inhibition of intake camshaft 1 synchronization diagnosis" UBYTE _CNV_S_2_RANGE______3_CM 1 0. 0. 1. DISPLAY_IDENTIFIER idx_diag_mng_in[0].lv_inh_diag_syn_cam ECU_ADDRESS 0xd0003ffd BIT_MASK 0x1 /end MEASUREMENT
/begin MEASUREMENT LV_INH_DIAG_PER_CAM_IN_1 "Inhibition of intake camshaft 1 period diagnosis" UBYTE _CNV_S_2_RANGE______3_CM 1 0. 0. 1. DISPLAY_IDENTIFIER idx_diag_mng_in[0].lv_inh_diag_per_cam ECU_ADDRESS 0xd0003ffe BIT_MASK 0x1 /end MEASUREMENT
/begin MEASUREMENT LV_INH_DIAG_PLAUS_CAM_IN_1 "Inhibition of intake camshaft 1 plausibility diagnosis" UBYTE _CNV_S_2_RANGE______3_CM 1 0. 0. 1. DISPLAY_IDENTIFIER idx_diag_mng_in[0].lv_inh_diag_plaus_cam ECU_ADDRESS 0xd0003fff BIT_MASK 0x1 /end MEASUREMENT
/begin MEASUREMENT LV_INH_DIAG_REF_CRK_CAM_IN_1 "Inhibition of intake camshaft 1 position diagnosis" UBYTE _CNV_S_2_RANGE______3_CM 1 0. 0. 1. DISPLAY_IDENTIFIER idx_diag_mng_in[0].lv_inh_diag_ref_crk_cam ECU_ADDRESS 0xd0004000 BIT_MASK 0x1 /end MEASUREMENT
/begin MEASUREMENT LV_INH_DIAG_TOOTH_OFF_IN_1 "" UBYTE _CNV_S_2_RANGE______3_CM 1 0. 0. 1. DISPLAY_IDENTIFIER idx_diag_mng_in[0].lv_inh_diag_tooth_off ECU_ADDRESS 0xd0004001 BIT_MASK 0x1 /end MEASUREMENT
/begin MEASUREMENT LV_INH_DIAG_SYN_CRK_CAM_IN_1 "Inhibition of intake camshaft sensor diagnosis for crankshaft synchronization" UBYTE _CNV_S_2_RANGE______3_CM 1 0. 0. 1. DISPLAY_IDENTIFIER idx_diag_mng_in[0].lv_inh_diag_syn_crk_cam ECU_ADDRESS 0xd0004002 BIT_MASK 0x1 /end MEASUREMENT
/begin MEASUREMENT lv_crk_off_tmr_end "Timer T_OFF_CRK_DLY is elapsed" UBYTE _CNV_S_2_RANGE______3_CM 1 0. 0. 1. ECU_ADDRESS 0xd000529e BIT_MASK 0x1 /end MEASUREMENT
/begin MEASUREMENT lv_err_cam_tot "Failure of at least one camshaft sensor on a camshaft with IVVT actuator" UBYTE _CNV_S_2_RANGE______3_CM 1 0. 0. 1. ECU_ADDRESS 0xd000402c BIT_MASK 0x1 /end MEASUREMENT
/begin MEASUREMENT lv_err_crk "Crankshaft sensor failure" UBYTE _CNV_S_2_RANGE______3_CM 1 0. 0. 1. ECU_ADDRESS 0xd000402d BIT_MASK 0x1 /end MEASUREMENT
/begin MEASUREMENT lv_ign_inj_lock_req "Request to lock ignition and/or injection due to backwards rotation detection" UBYTE _CNV_S_2_RANGE______3_CM 1 0. 0. 1. ECU_ADDRESS 0xd000402f BIT_MASK 0x1 /end MEASUREMENT
/begin MEASUREMENT lv_inh_diag_crk_oc "Inhibition of crankshaft sensor circuit diagnosis" UBYTE _CNV_S_2_RANGE______3_CM 1 0. 0. 1. ECU_ADDRESS 0xd0004030 BIT_MASK 0x1 /end MEASUREMENT
/begin MEASUREMENT lv_inh_diag_crk_plaus "Inhibition of crankshaft sensor plausibility diagnosis" UBYTE _CNV_S_2_RANGE______3_CM 1 0. 0. 1. ECU_ADDRESS 0xd0004031 BIT_MASK 0x1 /end MEASUREMENT
/begin MEASUREMENT lv_inh_diag_crk_plaus_ena "Inhibition of crankshaft sensor plausibility diagnosis for crankshaft synchronization" UBYTE _CNV_S_2_RANGE______3_CM 1 0. 0. 1. ECU_ADDRESS 0xd0004032 BIT_MASK 0x1 /end MEASUREMENT
/begin MEASUREMENT lv_inh_diag_crk_syn "Inhibition of crankshaft sensor synchronization diagnosis" UBYTE _CNV_S_2_RANGE______3_CM 1 0. 0. 1. ECU_ADDRESS 0xd0004033 BIT_MASK 0x1 /end MEASUREMENT
/begin MEASUREMENT lv_inh_diag_crk_tooth "Inhibition of crankshaft sensor tooth number diagnosis" UBYTE _CNV_S_2_RANGE______3_CM 1 0. 0. 1. ECU_ADDRESS 0xd0004034 BIT_MASK 0x1 /end MEASUREMENT
/begin MEASUREMENT lv_inh_diag_crk_tooth_per "Inhibition of crankshaft sensor tooth peirod diagnosis" UBYTE _CNV_S_2_RANGE______3_CM 1 0. 0. 1. ECU_ADDRESS 0xd0004035 BIT_MASK 0x1 /end MEASUREMENT
/begin MEASUREMENT lv_inh_diag_ensd "Inhibition of cam/crk diagnosis during fail safe delay" UBYTE _CNV_S_2_RANGE______3_CM 1 0. 0. 1. ECU_ADDRESS 0xd0004036 BIT_MASK 0x1 /end MEASUREMENT
/begin MEASUREMENT t_off_crk_dly "Timer data for crankshaft off detection" UBYTE _CNV_A_R_LINEAR_____34_CM 1 0. 0. 2.55 ECU_ADDRESS 0xd000529c FORMAT "%4.2" /end MEASUREMENT
/begin CHARACTERISTIC c_n_l_crk_plaus_inh "Engine speed threshold for crankshaft plausibility diagnosis deactivation" VALUE 0xa0021618 _REC_S1VAL_20_u2 8160. _CNV_A_R_LINEAR_____21_CM 0. 8160. FORMAT "%4.0" /end CHARACTERISTIC
/begin CHARACTERISTIC c_n_not_rest "Engine speed threshold for cam/crk diagnosis deactivation" VALUE 0xa002165b _REC_S1VAL_20_u1 8160. _CNV_A_R_LINEAR_____2_CM 0. 8160. FORMAT "%4.0" /end CHARACTERISTIC
/begin CHARACTERISTIC c_t_dly_rest_igk "Delay time for diagnosis reactivation after key-off at low engine speed" VALUE 0xa002161e _REC_S1VAL_20_u2 655.35 _CNV_A_R_LINEAR_____34_CM 0. 655.35 FORMAT "%6.2" /end CHARACTERISTIC
/begin CHARACTERISTIC c_t_dly_rest_stall "Delay time for diagnosis reactivation after engine stalling" VALUE 0xa0021620 _REC_S1VAL_20_u2 655.35 _CNV_A_R_LINEAR_____34_CM 0. 655.35 FORMAT "%6.2" /end CHARACTERISTIC
/begin CHARACTERISTIC c_t_max_inh_diag_ensd "Maximum delay before reactivating diagnosis after engine backwards rotation confirmation" VALUE 0xa0021622 _REC_S1VAL_20_u2 655.35 _CNV_A_R_LINEAR_____34_CM 0. 655.35 FORMAT "%6.2" /end CHARACTERISTIC
/begin CHARACTERISTIC c_t_min_inh_diag_ensd "Minimum delay before reactivating diagnosis in case of key off to on after engine backwards rotation confirmation" VALUE 0xa0021624 _REC_S1VAL_20_u2 655.35 _CNV_A_R_LINEAR_____34_CM 0. 655.35 FORMAT "%6.2" /end CHARACTERISTIC
/begin CHARACTERISTIC c_t_off_crk_dly "Delay after engine stall event without tooth before setting the crankshaft to off" VALUE 0xa002165f _REC_S1VAL_20_u1 2.55 _CNV_A_R_LINEAR_____34_CM 0. 2.55 FORMAT "%4.2" /end CHARACTERISTIC
/begin CHARACTERISTIC lc_eng_back_inh "Inhibition of engine backwards rotation detection" VALUE 0xa0021662 _REC_S1VAL_20_u1 1. _CNV_A_R_ECME_LINEA_0_CM 0. 1. FORMAT "%1.0" /end CHARACTERISTIC
/begin CHARACTERISTIC lc_err_crk_inh "Inhibition of LV_ERR_CRK setting" VALUE 0xa0021663 _REC_S1VAL_20_u1 1. _CNV_A_R_ECME_LINEA_0_CM 0. 1. FORMAT "%1.0" /end CHARACTERISTIC
/begin AXIS_PTS ldp_n_id_nr_vld_cam_syn_crk "" 0xa00215fe n _REC_A2AXS_20_u2 8160. _CNV_A_R_LINEAR_____21_CM 2 0. 8160. FORMAT "%4.0" /end AXIS_PTS
/begin MEASUREMENT LV_ACT_CAM_IN_1 "self synchronization activated on intake camshaft 1" UBYTE _CNV_S_2_RANGE______3_CM 1 0. 0. 1. DISPLAY_IDENTIFIER idx_n_ctl_in[0].lv_act_cam ECU_ADDRESS 0xd0004008 BIT_MASK 0x1 /end MEASUREMENT
/begin MEASUREMENT LV_ACT_LIH_CRK_CAM_IN_1 "crankshaft limp home operating mode activated on intake camshaft 1" UBYTE _CNV_S_2_RANGE______3_CM 1 0. 0. 1. DISPLAY_IDENTIFIER idx_n_ctl_in[0].lv_act_lih_crk_cam ECU_ADDRESS 0xd0004009 BIT_MASK 0x1 /end MEASUREMENT
/begin MEASUREMENT LV_ACT_SYN_CRK_CAM_IN_1 "crankshaft synchronization operating mode activated on intake camshaft 1" UBYTE _CNV_S_2_RANGE______3_CM 1 0. 0. 1. DISPLAY_IDENTIFIER idx_n_ctl_in[0].lv_act_syn_crk_cam ECU_ADDRESS 0xd000400a BIT_MASK 0x1 /end MEASUREMENT
/begin CHARACTERISTIC id_nr_vld_cam_syn_crk "Number of camshaft signal edges to validate cam/crk synchronization" CURVE 0xa0021614 _REC_A1CUR_20_u1_u2 255. _CNV_A_R_ECME_LINEA_0_CM 0. 255. FORMAT "%3.0"
 /begin AXIS_DESCR COM_AXIS n _CNV_A_R_LINEAR_____21_CM 2 0. 8160. FORMAT "%4.0" AXIS_PTS_REF ldp_n_id_nr_vld_cam_syn_crk /end AXIS_DESCR
/end CHARACTERISTIC
/begin MEASUREMENT ctr_vld_cam_syn_crk "Counter for validation of camshaft signal for crankshaft synchronization" UBYTE _CNV_A_R_ECME_LINEA_0_CM 1 0. 0. 255. ECU_ADDRESS 0xd0005299 FORMAT "%3.0" /end MEASUREMENT
/begin MEASUREMENT lv_act_crk "Crankshaft acquisition active" UBYTE _CNV_S_2_RANGE______3_CM 1 0. 0. 1. ECU_ADDRESS 0xd0004020 BIT_MASK 0x1 /end MEASUREMENT
/begin MEASUREMENT lv_act_wout_cam_eng_pha "Activation of without camshaft sensor synchronisation" UBYTE _CNV_S_2_RANGE______3_CM 1 0. 0. 1. ECU_ADDRESS 0xd0004021 BIT_MASK 0x1 /end MEASUREMENT
/begin MEASUREMENT lv_crk_miss_run_eng "Boolean information engine running after engine stop request" UBYTE _CNV_S_2_RANGE______3_CM 1 0. 0. 1. ECU_ADDRESS 0xd0004023 BIT_MASK 0x1 /end MEASUREMENT
/begin MEASUREMENT lv_crk_plaus_first "Flag to indicat the first transition from 1 to 0 of LV_CRK_SYN" UBYTE _CNV_S_2_RANGE______3_CM 1 0. 0. 1. ECU_ADDRESS 0xd0004025 BIT_MASK 0x1 /end MEASUREMENT
/begin MEASUREMENT lv_eng_back_cfm "Engine backwards rotation confirmed" UBYTE _CNV_S_2_RANGE______3_CM 1 0. 0. 1. ECU_ADDRESS 0xd0004028 BIT_MASK 0x1 /end MEASUREMENT
/begin MEASUREMENT lv_eng_back_det "Engine backwards rotation detected" UBYTE _CNV_S_2_RANGE______3_CM 1 0. 0. 1. ECU_ADDRESS 0xd0004029 BIT_MASK 0x1 /end MEASUREMENT
/begin MEASUREMENT lv_err_cam "Failure on all camshaft sensor signals in normal mode" UBYTE _CNV_S_2_RANGE______3_CM 1 0. 0. 1. ECU_ADDRESS 0xd000402b BIT_MASK 0x1 /end MEASUREMENT
/begin MEASUREMENT lv_err_lih_crk_cam "No more camshaft sensor available for crankshaft limp-home mode" UBYTE _CNV_S_2_RANGE______3_CM 1 0. 0. 1. ECU_ADDRESS 0xd000529f BIT_MASK 0x1 /end MEASUREMENT
/begin MEASUREMENT lv_first_vld_tooth "Boolean information for detection of first tooth after engine stop" UBYTE _CNV_S_2_RANGE______3_CM 1 0. 0. 1. ECU_ADDRESS 0xd000402e BIT_MASK 0x1 /end MEASUREMENT
/begin MEASUREMENT lv_lih_err_cam "Camshaft limp-home mode (failure on all camshaft sensors)" UBYTE _CNV_S_2_RANGE______3_CM 1 0. 0. 1. ECU_ADDRESS 0xd0004038 BIT_MASK 0x1 /end MEASUREMENT
/begin MEASUREMENT lv_lih_err_crk "Boolean information for limp home mode with crankshaft sensor failure" UBYTE _CNV_S_2_RANGE______3_CM 1 0. 0. 1. ECU_ADDRESS 0xd0004039 BIT_MASK 0x1 /end MEASUREMENT
/begin MEASUREMENT lv_run_eng "Boolean information for engine running detection" UBYTE _CNV_S_2_RANGE______3_CM 1 0. 0. 1. ECU_ADDRESS 0xd000403e BIT_MASK 0x1 /end MEASUREMENT
/begin MEASUREMENT lv_syn_eng "Boolean information for engine synchronization completed" UBYTE _CNV_S_2_RANGE______3_CM 1 0. 0. 1. ECU_ADDRESS 0xd0004041 BIT_MASK 0x1 /end MEASUREMENT
/begin MEASUREMENT lv_syn_vld "Boolean information for engine synchronization validated" UBYTE _CNV_S_2_RANGE______3_CM 1 0. 0. 1. ECU_ADDRESS 0xd0004042 BIT_MASK 0x1 /end MEASUREMENT
/begin MEASUREMENT lv_timeout_cam_syn_crk "Boolean information for time-out detection on the camshaft selected for the CRK/CAM synchronization" UBYTE _CNV_S_2_RANGE______3_CM 1 0. 0. 1. ECU_ADDRESS 0xd0004045 BIT_MASK 0x1 /end MEASUREMENT
/begin CHARACTERISTIC c_t_dly_stop_eng "Delay time for engine running after engine stop request" VALUE 0xa002165e _REC_S1VAL_20_u1 2.55 _CNV_A_R_LINEAR_____34_CM 0. 2.55 FORMAT "%4.2" /end CHARACTERISTIC
/begin CHARACTERISTIC lc_inh_lih_cam "Inhibition of camshaft limp-home mode" VALUE 0xa0021664 _REC_S1VAL_20_u1 1. _CNV_A_R_ECME_LINEA_0_CM 0. 1. FORMAT "%1.0" /end CHARACTERISTIC
/begin CHARACTERISTIC lc_inh_lih_crk "Inhibition of crankshaft limp-home mode" VALUE 0xa0021665 _REC_S1VAL_20_u1 1. _CNV_A_R_ECME_LINEA_0_CM 0. 1. FORMAT "%1.0" /end CHARACTERISTIC
/begin CHARACTERISTIC lc_inh_wout_cam_eng_pha "Inhibition of without camshaft sensor synchronisation mode" VALUE 0xa0021666 _REC_S1VAL_20_u1 1. _CNV_A_R_ECME_LINEA_0_CM 0. 1. FORMAT "%1.0" /end CHARACTERISTIC
/begin MEASUREMENT tco_cmn "coolant temperature ( ENSD internal )" UBYTE _CNV_A_R_ENSD_LINEA_35_CM 1 0. -50. 205. ECU_ADDRESS 0xd000401c FORMAT "%3.0" /end MEASUREMENT
/begin MEASUREMENT vb_cmn "Battery voltage ( ENSD internal )" UBYTE _CNV_A_R_ENSD_LINEA_36_CM 1 0. 0. 28.8 ECU_ADDRESS 0xd000401d FORMAT "%5.3" /end MEASUREMENT
/begin AXIS_PTS ldpm_n_32_3_ensd "" 0xa002162a n_32 _REC_A2AXS_20_u1 8160. _CNV_A_R_LINEAR_____2_CM 6 0. 8160. FORMAT "%4.0" /end AXIS_PTS
/begin MEASUREMENT IDX_EDGE_CAM_IN_1 "Index of the last camshaft signal edge" UBYTE _CNV_A_R_LINEAR_____33_CM 1 0. 1. 32. DISPLAY_IDENTIFIER idx_cam_acq_in[0].idx_edge_cam ECU_ADDRESS 0xd00017d8 FORMAT "%3.0" /end MEASUREMENT
/begin MEASUREMENT CTR_EDGE_CAM_IN_1 "Continuous camshaft signal edge counter" UBYTE _CNV_A_R_ECME_LINEA_0_CM 1 0. 0. 255. DISPLAY_IDENTIFIER idx_cam_acq_in[0].ctr_edge_cam ECU_ADDRESS 0xd00017d9 FORMAT "%3.0" /end MEASUREMENT
/begin MEASUREMENT LV_VLD_PSN_CAM_IN_1 "Intake camshaft position measurement valid" UBYTE _CNV_S_2_RANGE______3_CM 1 0. 0. 1. DISPLAY_IDENTIFIER idx_cam_acq_in[0].lv_vld_psn_cam ECU_ADDRESS 0xd00017da BIT_MASK 0x1 /end MEASUREMENT
/begin MEASUREMENT LV_SYN_CAM_IN_1 "intake camshaft synchronized" UBYTE _CNV_S_2_RANGE______3_CM 1 0. 0. 1. DISPLAY_IDENTIFIER idx_cam_acq_in[0].lv_syn_cam ECU_ADDRESS 0xd00017db BIT_MASK 0x1 /end MEASUREMENT
/begin MEASUREMENT LV_ORNG_PER_CAM_IN_1 "intake camshaft segment period out of range" UBYTE _CNV_S_2_RANGE______3_CM 1 0. 0. 1. DISPLAY_IDENTIFIER idx_cam_acq_in[0].lv_orng_per_cam ECU_ADDRESS 0xd00017dc BIT_MASK 0x1 /end MEASUREMENT
/begin MEASUREMENT LV_ORNG_RATIO_CAM_IN_1 "Intake camshaft segment ratio out of range" UBYTE _CNV_S_2_RANGE______3_CM 1 0. 0. 1. DISPLAY_IDENTIFIER idx_cam_acq_in[0].lv_orng_ratio_cam ECU_ADDRESS 0xd00017dd BIT_MASK 0x1 /end MEASUREMENT
/begin MEASUREMENT PSN_ENG_CAM_IN_1 "" UWORD _CNV_A_R_ENSD_LINEA_32_CM 1 0. 0. 719.9375 DISPLAY_IDENTIFIER idx_cam_acq_in[0].psn_eng_cam ECU_ADDRESS 0xd00017de FORMAT "%8.4" /end MEASUREMENT
/begin MEASUREMENT T_SEG_CAM_IN_1 "Camshaft segment period" ULONG _CNV_A_R_LINEAR_____37_CM 1 0. 0. 1.9965 DISPLAY_IDENTIFIER idx_cam_acq_in[0].t_seg_cam ECU_ADDRESS 0xd00017e0 FORMAT "%8.6" /end MEASUREMENT
/begin CHARACTERISTIC id_fac_cam_in "Period ratio tolerance factor for intake camshaft" CURVE 0xa0021632 _REC_A1CUR_20_u1_u1 14.9375 _CNV_A_R_ENSD_LINEA_38_CM 1. 15.9375 FORMAT "%7.4"
 /begin AXIS_DESCR COM_AXIS n_32 _CNV_A_R_LINEAR_____2_CM 6 0. 8160. FORMAT "%4.0" AXIS_PTS_REF ldpm_n_32_3_ensd /end AXIS_DESCR
/end CHARACTERISTIC
/begin MEASUREMENT lv_cam_syn_crk "Camshaft acquisition ready for crankshaft synchronization" UBYTE _CNV_S_2_RANGE______3_CM 1 0. 0. 1. ECU_ADDRESS 0xd000529d BIT_MASK 0x1 /end MEASUREMENT
/begin MEASUREMENT lv_orng_cam_syn_crk "Camshaft signal for crankshaft synchronization out of range" UBYTE _CNV_S_2_RANGE______3_CM 1 0. 0. 1. ECU_ADDRESS 0xd00052a0 BIT_MASK 0x1 /end MEASUREMENT
/begin CHARACTERISTIC c_cam_adj_vvt_syn_crk_adc_in "Extension of  tolerance window CAM_DYW_CRK_SYN_ADC_IN  when VVT is not in locked position at start" VALUE 0xa0021638 _REC_S1VAL_20_u2 127.9375 _CNV_A_R_ENSD_LINEA_32_CM 0. 127.9375 FORMAT "%8.4" /end CHARACTERISTIC
/begin CHARACTERISTIC c_cam_adj_vvt_syn_crk_rtd_in "Extension of  tolerance window CAM_DYW_CRK_SYN_RTD_IN  when VVT is not in locked position at start" VALUE 0xa002163a _REC_S1VAL_20_u2 127.9375 _CNV_A_R_ENSD_LINEA_32_CM 0. 127.9375 FORMAT "%8.4" /end CHARACTERISTIC
/begin CHARACTERISTIC c_cam_adj_vvt_syn_in "Extension of  tolerance window CAM_DYW_SYN_IN  when VVT is not in locked position at start" VALUE 0xa002163c _REC_S1VAL_20_u2 127.9375 _CNV_A_R_ENSD_LINEA_32_CM 0. 127.9375 FORMAT "%8.4" /end CHARACTERISTIC
/begin CHARACTERISTIC c_crk_ang_dly "Crankshaft angle threshold after start of cranking to reduce the possible engine position range for pre-injection" VALUE 0xa0021616 _REC_S1VAL_20_u2 719.9375 _CNV_A_R_ENSD_LINEA_32_CM 0. 719.9375 FORMAT "%8.4" /end CHARACTERISTIC
/begin CHARACTERISTIC c_crk_ang_dly_lst_cam "Crankshaft angle threshold after last cam edge to reduce the possible engine position range for pre-injection" VALUE 0xa0021648 _REC_S1VAL_20_u2 719.9375 _CNV_A_R_ENSD_LINEA_32_CM 0. 719.9375 FORMAT "%8.4" /end CHARACTERISTIC
/begin CHARACTERISTIC c_dyw_cam_crk_syn_adc_in "Tolerance window advance for intake camshaft to crankshaft reference in crankshaft synchronization mode" VALUE 0xa002163e _REC_S1VAL_20_u2 127.9375 _CNV_A_R_ENSD_LINEA_32_CM 0. 127.9375 FORMAT "%8.4" /end CHARACTERISTIC
/begin CHARACTERISTIC c_dyw_cam_crk_syn_rtd_in "Tolerance window retard for intake camshaft to crankshaft reference in crankshaft synchronization mode" VALUE 0xa0021640 _REC_S1VAL_20_u2 127.9375 _CNV_A_R_ENSD_LINEA_32_CM 0. 127.9375 FORMAT "%8.4" /end CHARACTERISTIC
/begin CHARACTERISTIC c_dyw_cam_syn_in "Tolerance window for angle between intake camshaft signal edges in crankshaft synchronization mode" VALUE 0xa0021642 _REC_S1VAL_20_u2 127.9375 _CNV_A_R_ENSD_LINEA_32_CM 0. 127.9375 FORMAT "%8.4" /end CHARACTERISTIC
/begin CHARACTERISTIC c_nr_edge_min_vld_cam_in "Number of intake camshaft signal edges for valid position output" VALUE 0xa0021673 _REC_S1VAL_20_u1 255. _CNV_A_R_ECME_LINEA_0_CM 0. 255. FORMAT "%3.0" /end CHARACTERISTIC
/begin AXIS_PTS ldp_n_32_id_fac_ac_crk_gap "" 0xa00215fa n_32 _REC_A2AXS_20_u1 8160. _CNV_A_R_LINEAR_____2_CM 2 0. 8160. FORMAT "%4.0" /end AXIS_PTS
/begin CHARACTERISTIC id_fac_ac_crk_gap "Acceleration factor for tooth simulation in gap position" CURVE 0xa002160c _REC_A1CUR_20_u1_u1 0.9375 _CNV_A_R_ENSD_LINEA_38_CM 0. 0.9375 FORMAT "%6.4"
 /begin AXIS_DESCR COM_AXIS n_32 _CNV_A_R_LINEAR_____2_CM 2 0. 8160. FORMAT "%4.0" AXIS_PTS_REF ldp_n_32_id_fac_ac_crk_gap /end AXIS_DESCR
/end CHARACTERISTIC
/begin CHARACTERISTIC id_fac_tol_crk_tooth "Factor for calculation of expected tooth period" CURVE 0xa002160e _REC_A1CUR_20_u1_u1 0.9375 _CNV_A_R_ENSD_LINEA_38_CM 0. 0.9375 FORMAT "%6.4"
 /begin AXIS_DESCR COM_AXIS n_32 _CNV_A_R_LINEAR_____2_CM 6 0. 8160. FORMAT "%4.0" AXIS_PTS_REF ldpm_n_32_2_ensd /end AXIS_DESCR
/end CHARACTERISTIC
/begin MEASUREMENT lv_crk_miss_tooth "At least one missing tooth has been simulated" UBYTE _CNV_S_2_RANGE______3_CM 1 0. 0. 1. ECU_ADDRESS 0xd0004024 BIT_MASK 0x1 /end MEASUREMENT
/begin MEASUREMENT lv_crk_syn "Flag for crankshaft acquisition synchronized" UBYTE _CNV_S_2_RANGE______3_CM 1 0. 0. 1. ECU_ADDRESS 0xd0004027 BIT_MASK 0x1 /end MEASUREMENT
/begin MEASUREMENT lv_inh_mis_crk "Inhibition of misfire detection with crankshaft tooth number error" UBYTE _CNV_S_2_RANGE______3_CM 1 0. 0. 1. ECU_ADDRESS 0xd0004037 BIT_MASK 0x1 /end MEASUREMENT
/begin MEASUREMENT lv_lost_syn_crk "Crankshaft synchronization lost" UBYTE _CNV_S_2_RANGE______3_CM 1 0. 0. 1. ECU_ADDRESS 0xd000403a BIT_MASK 0x1 /end MEASUREMENT
/begin MEASUREMENT lv_orng_nr_tooth_crk "Wrong number of teeth seen between the last consecutive reference gaps" UBYTE _CNV_S_2_RANGE______3_CM 1 0. 0. 1. ECU_ADDRESS 0xd000403b BIT_MASK 0x1 /end MEASUREMENT
/begin MEASUREMENT lv_orng_nr_tooth_gap "Wrong number of teeth simulated in the reference gap" UBYTE _CNV_S_2_RANGE______3_CM 1 0. 0. 1. ECU_ADDRESS 0xd000403c BIT_MASK 0x1 /end MEASUREMENT
/begin MEASUREMENT lv_orng_tooth_per_crk "Invalid crankshaft tooth period" UBYTE _CNV_S_2_RANGE______3_CM 1 0. 0. 1. ECU_ADDRESS 0xd000403d BIT_MASK 0x1 /end MEASUREMENT
/begin MEASUREMENT lv_t_crk_dly "Flag set during sensing delay" UBYTE _CNV_S_2_RANGE______3_CM 1 0. 0. 1. ECU_ADDRESS 0xd0004044 BIT_MASK 0x1 /end MEASUREMENT
/begin MEASUREMENT t_seg_er "Crankshaft segment period for misfire detection (ER algorithm)" ULONG _CNV_A_R_LINEAR_____37_CM 1 0. 0. 1.9965 ECU_ADDRESS 0xd0001838 FORMAT "%8.6" /end MEASUREMENT
/begin CHARACTERISTIC c_t_crk_dly "Sensing delay time after first active crankshaft signal edge" VALUE 0xa002161a _REC_S1VAL_20_u4 3.9999946e-002 _CNV_A_R_ENSD_LINEA_39_CM 0. 3.9999946e-002 FORMAT "%8.6" /end CHARACTERISTIC
/begin MEASUREMENT lv_err_per_cam_in_1 "Present failure camshaft period too short" UBYTE _CNV_S_2_RANGE______3_CM 1 0. 0. 1. ECU_ADDRESS 0xd0004965 BIT_MASK 0x1 /end MEASUREMENT
/begin MEASUREMENT lv_err_syn_cam_in_1 "Present intake camshaft sensor failure" UBYTE _CNV_S_2_RANGE______3_CM 1 0. 0. 1. ECU_ADDRESS 0xd0004967 BIT_MASK 0x1 /end MEASUREMENT
/begin CHARACTERISTIC c_n_32_max_diag_per_cam "Maximal engine speed of camshaft segment period diagnosis activation" VALUE 0xa0021657 _REC_S1VAL_20_u1 8160. _CNV_A_R_LINEAR_____2_CM 0. 8160. FORMAT "%4.0" /end CHARACTERISTIC
/begin CHARACTERISTIC c_n_32_max_diag_syn_cam "Maximal engine speed of camshaft synchronization diagnosis activation" VALUE 0xa0021659 _REC_S1VAL_20_u1 8160. _CNV_A_R_LINEAR_____2_CM 0. 8160. FORMAT "%4.0" /end CHARACTERISTIC
/begin MEASUREMENT lv_err_ext_cam_in[0] "Failure on intake camshaft sensor due to external issue" UBYTE _CNV_S_2_RANGE______3_CM 1 0. 0. 1. ECU_ADDRESS 0xd0004010 BIT_MASK 0x1 /end MEASUREMENT
/begin MEASUREMENT lv_err_crk_syn "Present crankshaft failure with loss of synchronization" UBYTE _CNV_S_2_RANGE______3_CM 1 0. 0. 1. ECU_ADDRESS 0xd000495e BIT_MASK 0x1 /end MEASUREMENT
/begin MEASUREMENT lv_err_crk_tooth "Present crankshaft failure tooth number error" UBYTE _CNV_S_2_RANGE______3_CM 1 0. 0. 1. ECU_ADDRESS 0xd000495a BIT_MASK 0x1 /end MEASUREMENT
/begin MEASUREMENT lv_err_crk_tooth_per "Present crankshaft failure tooth number error" UBYTE _CNV_S_2_RANGE______3_CM 1 0. 0. 1. ECU_ADDRESS 0xd000495c BIT_MASK 0x1 /end MEASUREMENT
/begin CHARACTERISTIC c_n_32_max_diag_crk_tooth "Maximum engine speed to enable tooth number diagnosis" VALUE 0xa0021656 _REC_S1VAL_20_u1 8160. _CNV_A_R_LINEAR_____2_CM 0. 8160. FORMAT "%4.0" /end CHARACTERISTIC
/begin AXIS_PTS ldp_n_32_id_v_mcps_thd "" 0xa002f998 n_32 _REC_A2AXS_20_u1 8160. _CNV_A_R_LINEAR_____2_CM 8 0. 8160. FORMAT "%4.0" /end AXIS_PTS
/begin CHARACTERISTIC id_v_mcps_thd "threshold for A/C amplitude voltage to detect a failure" CURVE 0xa002f9b8 _REC_A1CUR_20_u2_u1 4.99984741210938 _CNV_A_R_LINEAR_____16_CM 0. 4.99984741210938 FORMAT "%6.4"
 /begin AXIS_DESCR COM_AXIS n_32 _CNV_A_R_LINEAR_____2_CM 8 0. 8160. FORMAT "%4.0" AXIS_PTS_REF ldp_n_32_id_v_mcps_thd /end AXIS_DESCR
/end CHARACTERISTIC
/begin MEASUREMENT lv_err_crk_oc "Crankshaft sensor failure open or short circuit present" UBYTE _CNV_S_2_RANGE______3_CM 1 0. 0. 1. ECU_ADDRESS 0xd0004962 BIT_MASK 0x1 /end MEASUREMENT
/begin MEASUREMENT v_mcps_diag_dif "Difference between maximum and minimum voltage measured on bias node during one sampling period" UWORD _CNV_A_R_LINEAR_____16_CM 1 0. 0. 4.99984741210938 ECU_ADDRESS 0xd0003c00 FORMAT "%6.4" /end MEASUREMENT
/begin MEASUREMENT v_mcps_diag_dif_max "Maximum of the DC voltage stored in a non-volatile memory for threshold validation" UWORD _CNV_A_R_LINEAR_____16_CM 1 0. 0. 4.99984741210938 ECU_ADDRESS 0xd0003c02 FORMAT "%6.4" /end MEASUREMENT
/begin MEASUREMENT v_mcps_diag_max_prev "Maximum voltage measured on bias node during sampling period" UWORD _CNV_A_R_LINEAR_____16_CM 1 0. 0. 4.99984741210938 ECU_ADDRESS 0xd0003c04 FORMAT "%6.4" /end MEASUREMENT
/begin MEASUREMENT v_mcps_diag_min_prev "Minimum voltage measured on bias node during sampling period" UWORD _CNV_A_R_LINEAR_____16_CM 1 0. 0. 4.99984741210938 ECU_ADDRESS 0xd0003c06 FORMAT "%6.4" /end MEASUREMENT
/begin CHARACTERISTIC c_mcps_sample_count "Number of samples per sample period" VALUE 0xa0021654 _REC_S1VAL_20_u1 255. _CNV_A_R_ECME_LINEA_0_CM 0. 255. FORMAT "%3.0" /end CHARACTERISTIC
/begin CHARACTERISTIC c_v_mcps_thd_max "Threshold maximum bias node voltage to detect failure" VALUE 0xa0021626 _REC_S1VAL_20_u2 4.99984741210938 _CNV_A_R_LINEAR_____16_CM 0. 4.99984741210938 FORMAT "%6.4" /end CHARACTERISTIC
/begin CHARACTERISTIC c_v_mcps_thd_min "Threshold minimum  bias node voltage to detect failure" VALUE 0xa0021628 _REC_S1VAL_20_u2 4.99984741210938 _CNV_A_R_LINEAR_____16_CM 0. 4.99984741210938 FORMAT "%6.4" /end CHARACTERISTIC
/begin CHARACTERISTIC lc_rst_v_mcps_diag_dif_max "Logical calibration for reset of V_MCPS_DIAG_DIF_MAX" VALUE 0xa0021667 _REC_S1VAL_20_u1 1. _CNV_A_R_ECME_LINEA_0_CM 0. 1. FORMAT "%1.0" /end CHARACTERISTIC
/begin MEASUREMENT lv_er_ena_seg "Misfire detection enable" UBYTE _CNV_S_2_RANGE______3_CM 1 0. 0. 1. ECU_ADDRESS 0xd000402a BIT_MASK 0x1 /end MEASUREMENT
/begin MEASUREMENT crk_off_tmr "Timer data for crankshaft off event detection " UBYTE _CNV_A_R_LINEAR_____40_CM 1 0. 0. 2550. ECU_ADDRESS 0xd0005586 FORMAT "%4.0" /end MEASUREMENT
/begin MEASUREMENT ctr_err_crk_plaus_save "counter of LV_ERR_CRK_PLAUS data" UWORD _CNV_A_R_ECME_LINEA_0_CM 1 0. 0. 65535. ECU_ADDRESS 0xd0003ca2 FORMAT "%5.0" /end MEASUREMENT
/begin MEASUREMENT ctr_err_plaus_cam_in_save[0] "counter of LV_ERR_PLAUS_CAM_IN[NC_NR_CAM_CBK] data" UWORD _CNV_A_R_ECME_LINEA_0_CM 1 0. 0. 65535. ECU_ADDRESS 0xd0003c9e FORMAT "%5.0" /end MEASUREMENT
/begin MEASUREMENT ctr_lost_syn_crk_save "counter of LV_LOST_SYN_CRK data" UWORD _CNV_A_R_ECME_LINEA_0_CM 1 0. 0. 65535. ECU_ADDRESS 0xd0003ca8 FORMAT "%5.0" /end MEASUREMENT
/begin MEASUREMENT ctr_orng_cam_syn_crk_save "counter of LV_ORNG_CAM_SYN_CRK data" UWORD _CNV_A_R_ECME_LINEA_0_CM 1 0. 0. 65535. ECU_ADDRESS 0xd0003ca0 FORMAT "%5.0" /end MEASUREMENT
/begin MEASUREMENT ctr_orng_nr_tooth_crk_save "counter of LV_ORNG_NR_TOOTH_CRK data" UWORD _CNV_A_R_ECME_LINEA_0_CM 1 0. 0. 65535. ECU_ADDRESS 0xd0003ca4 FORMAT "%5.0" /end MEASUREMENT
/begin MEASUREMENT ctr_orng_per_cam_in_save[0] "counter of LV_ORNG_PER_CAM_IN[NC_NR_CAM_CBK] data" UWORD _CNV_A_R_ECME_LINEA_0_CM 1 0. 0. 65535. ECU_ADDRESS 0xd0003c9a FORMAT "%5.0" /end MEASUREMENT
/begin MEASUREMENT ctr_orng_ratio_cam_in_save[0] "counter of LV_ORNG_RATIO_CAM_IN[NC_NR_CAM_CBK] data" UWORD _CNV_A_R_ECME_LINEA_0_CM 1 0. 0. 65535. ECU_ADDRESS 0xd0003c9c FORMAT "%5.0" /end MEASUREMENT
/begin MEASUREMENT ctr_orng_tooth_per_crk_save "counter of LV_ORNG_TOOTH_PER_CRK data" UWORD _CNV_A_R_ECME_LINEA_0_CM 1 0. 0. 65535. ECU_ADDRESS 0xd0003ca6 FORMAT "%5.0" /end MEASUREMENT
/begin MEASUREMENT LV_CAM_CUS_IN_1 "Intake camshaft signal state" UBYTE _CNV_S_2_RANGE______3_CM 1 0. 0. 1. DISPLAY_IDENTIFIER lv_cam_cus_in[0] ECU_ADDRESS 0xd00049e6 BIT_MASK 0x1 /end MEASUREMENT
/begin MEASUREMENT lv_crk_off "Flag for Crankshaft off detection" UBYTE _CNV_S_2_RANGE______3_CM 1 0. 0. 1. ECU_ADDRESS 0xd000558c BIT_MASK 0x1 /end MEASUREMENT
/begin MEASUREMENT lv_crk_wheel_typ "Flag for Crankshaft target wheel type (=1 36 teeth; =0 60 teeth)" UBYTE _CNV_S_2_RANGE______3_CM 1 0. 0. 1. ECU_ADDRESS 0xd00049e8 BIT_MASK 0x1 /end MEASUREMENT
/begin MEASUREMENT lv_lost_syn_crk_cus "Crankshaft synchronization lost" UBYTE _CNV_S_2_RANGE______3_CM 1 0. 0. 1. ECU_ADDRESS 0xd00049e7 BIT_MASK 0x1 /end MEASUREMENT
/begin MEASUREMENT lv_plaus_cam_mem[0] "Present camshaft failure synchronization impossible for counter" UBYTE _CNV_S_2_RANGE______3_CM 1 0. 0. 1. ECU_ADDRESS 0xd00049ea BIT_MASK 0x1 /end MEASUREMENT
/begin MEASUREMENT lv_tooth_per_crk_mem "Invalid crankshaft tooth period" UBYTE _CNV_S_2_RANGE______3_CM 1 0. 0. 1. ECU_ADDRESS 0xd00049e9 BIT_MASK 0x1 /end MEASUREMENT
/begin MEASUREMENT n_cus_25 "Customer specific engine speed with 0.25 resolution" UWORD _CNV_A_R_ENSD_LINEA_24_CM 1 0. 0. 8160. ECU_ADDRESS 0xd00033ec FORMAT "%7.2" /end MEASUREMENT
/begin MEASUREMENT T_SEG_CAM_CUS_IN_1 "Intake Camshaft segment period between 2 falling edges" ULONG _CNV_A_R_LINEAR_____37_CM 1 0. 0. 1.9965 DISPLAY_IDENTIFIER t_seg_cam_cus_in[0] ECU_ADDRESS 0xd0001acc FORMAT "%8.6" /end MEASUREMENT
/begin CHARACTERISTIC c_first_gap_psn_tol_adc "Advance GAP position tolerance for first gap trigger" VALUE 0xa002115e _REC_S1VAL_20_u2 719.9375 _CNV_A_R_ENSD_LINEA_32_CM 0. 719.9375 FORMAT "%8.4" /end CHARACTERISTIC
/begin CHARACTERISTIC c_first_gap_psn_tol_rtd "Retard GAP position tolerance for first gap trigger" VALUE 0xa0021160 _REC_S1VAL_20_u2 719.9375 _CNV_A_R_ENSD_LINEA_32_CM 0. 719.9375 FORMAT "%8.4" /end CHARACTERISTIC
/begin CHARACTERISTIC c_gap_psn_tol_adc "Advance GAP position tolerance for gap trigger" VALUE 0xa0021164 _REC_S1VAL_20_u2 719.9375 _CNV_A_R_ENSD_LINEA_32_CM 0. 719.9375 FORMAT "%8.4" /end CHARACTERISTIC
/begin CHARACTERISTIC c_gap_psn_tol_rtd "Retard GAP position tolerance for gap trigger" VALUE 0xa0021166 _REC_S1VAL_20_u2 719.9375 _CNV_A_R_ENSD_LINEA_32_CM 0. 719.9375 FORMAT "%8.4" /end CHARACTERISTIC
/begin CHARACTERISTIC c_n_inh_lost_syn_crk "Minimum engine speed for LV_LOST_SYN_CRK inhibition in engine stalling detection" VALUE 0xa0021168 _REC_S1VAL_20_u2 8160. _CNV_A_R_ENSD_LINEA_24_CM 0. 8160. FORMAT "%7.2" /end CHARACTERISTIC
/begin CHARACTERISTIC c_n_min_lih_crk "Minimum engine speed for crankshaft limp home commutation" VALUE 0xa002116c _REC_S1VAL_20_u2 8160. _CNV_A_R_ENSD_LINEA_24_CM 0. 8160. FORMAT "%7.2" /end CHARACTERISTIC
/begin CHARACTERISTIC c_off_crk_dly "Delay after engine stall event without tooth before setting the crankshaft to off" VALUE 0xa00211d6 _REC_S1VAL_20_u1 2550. _CNV_A_R_LINEAR_____40_CM 0. 2550. FORMAT "%4.0" /end CHARACTERISTIC
/begin AXIS_PTS ldpm_n_32_1_igre "" 0xa0027270 n_32 _REC_A2AXS_20_u1 8160. _CNV_A_R_LINEAR_____2_CM 8 0. 8160. FORMAT "%4.0" /end AXIS_PTS
/begin AXIS_PTS ldpm_vb_1_igre "" 0xa002727c vb _REC_A2AXS_20_u1 25.8984375 _CNV_A_R_LINEAR_____41_CM 8 0. 25.8984375 FORMAT "%9.6" /end AXIS_PTS
/begin CHARACTERISTIC c_ign_dyn_conf "Engine configuration number for IGRE dynamic engine configuration" VALUE 0xa0020744 _REC_S1VAL_20_u1 1. _CNV_A_R_ECME_LINEA_0_CM 1. 2. FORMAT "%3.0" /end CHARACTERISTIC
/begin AXIS_PTS ldp_tco_ip_id_temp_fac "" 0xa002724c tco _REC_A2AXS_20_u1 190.5 _CNV_A_R_LINEAR_____42_CM 8 -48. 142.5 FORMAT "%6.2" /end AXIS_PTS
/begin CHARACTERISTIC ip_td_fac "Factor for dwell time boost" MAP 0xa0027378 _REC_A1MAP_20_u1_u1_u1 1.984375 _CNV_A_R_LINEAR_____43_CM 7.8125e-003 1.9921875 FORMAT "%8.6"
 /begin AXIS_DESCR COM_AXIS vb _CNV_A_R_LINEAR_____41_CM 8 0. 25.8984375 FORMAT "%9.6" AXIS_PTS_REF ldpm_vb_1_igre /end AXIS_DESCR
 /begin AXIS_DESCR COM_AXIS n_32 _CNV_A_R_LINEAR_____2_CM 8 0. 8160. FORMAT "%4.0" AXIS_PTS_REF ldpm_n_32_1_igre /end AXIS_DESCR
/end CHARACTERISTIC
/begin CHARACTERISTIC ip_td_st_fac "Factor for dwell time boost at start" MAP 0xa00273c8 _REC_A1MAP_20_u1_u1_u1 1.984375 _CNV_A_R_LINEAR_____43_CM 7.8125e-003 1.9921875 FORMAT "%8.6"
 /begin AXIS_DESCR COM_AXIS vb _CNV_A_R_LINEAR_____41_CM 8 0. 25.8984375 FORMAT "%9.6" AXIS_PTS_REF ldpm_vb_1_igre /end AXIS_DESCR
 /begin AXIS_DESCR COM_AXIS n_32 _CNV_A_R_LINEAR_____2_CM 8 0. 8160. FORMAT "%4.0" AXIS_PTS_REF ldpm_n_32_1_igre /end AXIS_DESCR
/end CHARACTERISTIC
/begin CHARACTERISTIC ip_td_temp_fac "Factor for temperature correction on dwell" MAP 0xa0027408 _REC_A1MAP_20_u1_u1_u1 1.9921875 _CNV_A_R_LINEAR_____43_CM 0. 1.9921875 FORMAT "%8.6"
 /begin AXIS_DESCR COM_AXIS vb _CNV_A_R_LINEAR_____41_CM 8 0. 25.8984375 FORMAT "%9.6" AXIS_PTS_REF ldpm_vb_1_igre /end AXIS_DESCR
 /begin AXIS_DESCR COM_AXIS tco _CNV_A_R_LINEAR_____42_CM 8 -48. 142.5 FORMAT "%6.2" AXIS_PTS_REF ldp_tco_ip_id_temp_fac /end AXIS_DESCR
/end CHARACTERISTIC
/begin MEASUREMENT td_fac "General dwell time control factor" UBYTE _CNV_A_R_LINEAR_____43_CM 1 0. 7.8125e-003 1.9921875 ECU_ADDRESS 0xd0004389 FORMAT "%8.6" /end MEASUREMENT
/begin MEASUREMENT td_st_fac "General dwell time control factor" UBYTE _CNV_A_R_LINEAR_____43_CM 1 0. 7.8125e-003 1.9921875 ECU_ADDRESS 0xd000531d FORMAT "%8.6" /end MEASUREMENT
/begin MEASUREMENT TD_TEMP_FAC "Factor to correct temperature impact on dwell time" UBYTE _CNV_A_R_LINEAR_____43_CM 1 0. 7.8125e-003 1.9921875 DISPLAY_IDENTIFIER td_temp_fac ECU_ADDRESS 0xd000438c FORMAT "%8.6" /end MEASUREMENT
/begin AXIS_PTS ldp_tco_ip_nr_mpl "" 0xa0027258 tco _REC_A2AXS_20_u1 190.5 _CNV_A_R_LINEAR_____42_CM 8 -48. 142.5 FORMAT "%6.2" /end AXIS_PTS
/begin CHARACTERISTIC ip_nr_mpl "Number of successives ignition sparks depending on engine speed and TCO" MAP 0xa00272b8 _REC_A1MAP_20_u1_u1_u1 255. _CNV_A_R_ECME_LINEA_0_CM 0. 255. FORMAT "%3.0"
 /begin AXIS_DESCR COM_AXIS n_32 _CNV_A_R_LINEAR_____2_CM 8 0. 8160. FORMAT "%4.0" AXIS_PTS_REF ldpm_n_32_1_igre /end AXIS_DESCR
 /begin AXIS_DESCR COM_AXIS tco _CNV_A_R_LINEAR_____42_CM 8 -48. 142.5 FORMAT "%6.2" AXIS_PTS_REF ldp_tco_ip_nr_mpl /end AXIS_DESCR
/end CHARACTERISTIC
/begin CHARACTERISTIC ip_nr_mpl_s "Number of successives ignition sparks depending on engine speed and TCO in stratified mode" MAP 0xa002a3b0 _REC_A1MAP_20_u1_u1_u1 255. _CNV_A_R_ECME_LINEA_0_CM 0. 255. FORMAT "%3.0"
 /begin AXIS_DESCR COM_AXIS n_32 _CNV_A_R_LINEAR_____2_CM 8 0. 8160. FORMAT "%4.0" AXIS_PTS_REF ldpm_n_32_1_igre /end AXIS_DESCR
 /begin AXIS_DESCR COM_AXIS tco _CNV_A_R_LINEAR_____42_CM 8 -48. 142.5 FORMAT "%6.2" AXIS_PTS_REF ldp_tco_ip_nr_mpl /end AXIS_DESCR
/end CHARACTERISTIC
/begin CHARACTERISTIC ip_td_mpl "dwell time for multiple spark" CURVE 0xa00273b8 _REC_A1CUR_20_u2_u1 65.532 _CNV_A_R_LINEAR_____44_CM 0. 65.532 FORMAT "%7.3"
 /begin AXIS_DESCR COM_AXIS vb _CNV_A_R_LINEAR_____41_CM 8 0. 25.8984375 FORMAT "%9.6" AXIS_PTS_REF ldpm_vb_1_igre /end AXIS_DESCR
/end CHARACTERISTIC
/begin CHARACTERISTIC ip_td_mpl_s "dwell time for multiple spark in stratified mode confirmed" CURVE 0xa002a3f0 _REC_A1CUR_20_u2_u1 262.14 _CNV_A_R_LINEAR_____44_CM 0. 262.14 FORMAT "%7.3"
 /begin AXIS_DESCR COM_AXIS vb _CNV_A_R_LINEAR_____41_CM 8 0. 25.8984375 FORMAT "%9.6" AXIS_PTS_REF ldpm_vb_1_igre /end AXIS_DESCR
/end CHARACTERISTIC
/begin MEASUREMENT ign_mpl_nr "Number of ignition sparks" UBYTE _CNV_A_R_ECME_LINEA_0_CM 1 0. 0. 255. ECU_ADDRESS 0xd0004387 FORMAT "%3.0" /end MEASUREMENT
/begin MEASUREMENT t_ctr_td_mpl "Maintenance time of multiple spark activation before out case" UWORD _CNV_A_R_LINEAR_____34_CM 1 0. 0. 655.35 ECU_ADDRESS 0xd00031a6 FORMAT "%6.2" /end MEASUREMENT
/begin MEASUREMENT td_mpl "Dwell time for multiple spark" UWORD _CNV_A_R_LINEAR_____44_CM 1 0. 0. 65.532 ECU_ADDRESS 0xd00031aa FORMAT "%7.3" /end MEASUREMENT
/begin MEASUREMENT td_mpl_dly "Dwell time interruption" UWORD _CNV_A_R_LINEAR_____45_CM 1 0. 0. 2.044 ECU_ADDRESS 0xd00031ac FORMAT "%7.3" /end MEASUREMENT
/begin CHARACTERISTIC c_n_max_mpl_is "Engine speed max for ignition with multiple spark at idle speed" VALUE 0xa0020747 _REC_S1VAL_20_u1 8160. _CNV_A_R_LINEAR_____2_CM 0. 8160. FORMAT "%4.0" /end CHARACTERISTIC
/begin CHARACTERISTIC c_n_max_mpl_pl_pu_fl "Engine speed max for ignition with multiple spark at Run" VALUE 0xa0020748 _REC_S1VAL_20_u1 8160. _CNV_A_R_LINEAR_____2_CM 0. 8160. FORMAT "%4.0" /end CHARACTERISTIC
/begin CHARACTERISTIC c_n_max_mpl_puc "Engine speed max for ignition with multiple spark at Fuel cut off" VALUE 0xa0020749 _REC_S1VAL_20_u1 8160. _CNV_A_R_LINEAR_____2_CM 0. 8160. FORMAT "%4.0" /end CHARACTERISTIC
/begin CHARACTERISTIC c_n_max_mpl_st "Engine speed max for ignition with multiple spark at start" VALUE 0xa002074a _REC_S1VAL_20_u1 8160. _CNV_A_R_LINEAR_____2_CM 0. 8160. FORMAT "%4.0" /end CHARACTERISTIC
/begin CHARACTERISTIC c_n_min_mpl_is "Engine speed min for ignition with multiple spark at idle speed" VALUE 0xa002074b _REC_S1VAL_20_u1 8160. _CNV_A_R_LINEAR_____2_CM 0. 8160. FORMAT "%4.0" /end CHARACTERISTIC
/begin CHARACTERISTIC c_n_min_mpl_pl_pu_fl "Engine speed min for ignition with multiple spark at Run" VALUE 0xa002074c _REC_S1VAL_20_u1 8160. _CNV_A_R_LINEAR_____2_CM 0. 8160. FORMAT "%4.0" /end CHARACTERISTIC
/begin CHARACTERISTIC c_n_min_mpl_puc "Engine speed min for ignition with multiple spark at Fuel cut off" VALUE 0xa002074d _REC_S1VAL_20_u1 8160. _CNV_A_R_LINEAR_____2_CM 0. 8160. FORMAT "%4.0" /end CHARACTERISTIC
/begin CHARACTERISTIC c_n_min_mpl_st "Engine speed min for ignition with multiple spark at start" VALUE 0xa002074e _REC_S1VAL_20_u1 8160. _CNV_A_R_LINEAR_____2_CM 0. 8160. FORMAT "%4.0" /end CHARACTERISTIC
/begin CHARACTERISTIC c_t_ctr_td_mpl "maintenance time of Multiple spark activation before out case" VALUE 0xa0020728 _REC_S1VAL_20_u2 655.34 _CNV_A_R_LINEAR_____34_CM 0. 655.34 FORMAT "%6.2" /end CHARACTERISTIC
/begin CHARACTERISTIC c_t_ctr_td_mpl_ast "maintenance time of Multiple spark activation before out case and for the after start phase" VALUE 0xa002072a _REC_S1VAL_20_u2 655.34 _CNV_A_R_LINEAR_____34_CM 0. 655.34 FORMAT "%6.2" /end CHARACTERISTIC
/begin CHARACTERISTIC c_tco_max_mpl_is "Max. Coolant Temp. to have multiple spark at idle speed" VALUE 0xa0020750 _REC_S1VAL_20_u1 190.5 _CNV_A_R_LINEAR_____42_CM -48. 142.5 FORMAT "%6.2" /end CHARACTERISTIC
/begin CHARACTERISTIC c_tco_max_mpl_pl_pu_fl "Max. Coolant Temp. to have multiple spark at Run" VALUE 0xa0020751 _REC_S1VAL_20_u1 190.5 _CNV_A_R_LINEAR_____42_CM -48. 142.5 FORMAT "%6.2" /end CHARACTERISTIC
/begin CHARACTERISTIC c_tco_max_mpl_puc "Max. Coolant Temp. to have multiple spark at fuel cut off" VALUE 0xa0020752 _REC_S1VAL_20_u1 190.5 _CNV_A_R_LINEAR_____42_CM -48. 142.5 FORMAT "%6.2" /end CHARACTERISTIC
/begin CHARACTERISTIC c_tco_max_mpl_st "Max. Coolant Temp. to have multiple spark at start" VALUE 0xa0020753 _REC_S1VAL_20_u1 190.5 _CNV_A_R_LINEAR_____42_CM -48. 142.5 FORMAT "%6.2" /end CHARACTERISTIC
/begin CHARACTERISTIC c_td_mpl_man "Manual activation of the MPL" VALUE 0xa0020758 _REC_S1VAL_20_u1 1. _CNV_S_2_RANGE______3_CM 0. 1. /end CHARACTERISTIC
/begin CHARACTERISTIC c_td_t_mpl "Minimum time between two ignition ( normal value 150 us )" VALUE 0xa0020732 _REC_S1VAL_20_u2 262.14 _CNV_A_R_LINEAR_____44_CM 0. 262.14 FORMAT "%7.3" /end CHARACTERISTIC
/begin CHARACTERISTIC c_vb_max_mpl_is "Max. Battery Voltage  to have multiple spark ( requested value 16 ) at idle speed" VALUE 0xa002075a _REC_S1VAL_20_u1 25.8984375 _CNV_A_R_LINEAR_____41_CM 0. 25.8984375 FORMAT "%9.6" /end CHARACTERISTIC
/begin CHARACTERISTIC c_vb_max_mpl_pl_pu_fl "Max. Battery Voltage  to have multiple spark ( requested value 16 ) at Run" VALUE 0xa002075b _REC_S1VAL_20_u1 25.8984375 _CNV_A_R_LINEAR_____41_CM 0. 25.8984375 FORMAT "%9.6" /end CHARACTERISTIC
/begin CHARACTERISTIC c_vb_max_mpl_puc "Max. Battery Voltage  to have multiple spark ( requested value 16 ) at fuel cut off" VALUE 0xa002075c _REC_S1VAL_20_u1 25.8984375 _CNV_A_R_LINEAR_____41_CM 0. 25.8984375 FORMAT "%9.6" /end CHARACTERISTIC
/begin CHARACTERISTIC c_vb_max_mpl_st "Max. Battery Voltage  to have multiple spark ( requested value 16 ) at start" VALUE 0xa002075d _REC_S1VAL_20_u1 25.8984375 _CNV_A_R_LINEAR_____41_CM 0. 25.8984375 FORMAT "%9.6" /end CHARACTERISTIC
/begin CHARACTERISTIC ip_td "Dwell time correction versus battery voltage and engine speed" MAP 0xa00272f8 _REC_A1MAP_20_u2_u1_u1 262.14 _CNV_A_R_LINEAR_____44_CM 0. 262.14 FORMAT "%7.3"
 /begin AXIS_DESCR COM_AXIS vb _CNV_A_R_LINEAR_____41_CM 8 0. 25.8984375 FORMAT "%9.6" AXIS_PTS_REF ldpm_vb_1_igre /end AXIS_DESCR
 /begin AXIS_DESCR COM_AXIS n_32 _CNV_A_R_LINEAR_____2_CM 8 0. 8160. FORMAT "%4.0" AXIS_PTS_REF ldpm_n_32_1_igre /end AXIS_DESCR
/end CHARACTERISTIC
/begin MEASUREMENT td "Dwell time" UWORD _CNV_A_R_LINEAR_____44_CM 1 0. 0. 262.14 ECU_ADDRESS 0xd00031a8 FORMAT "%7.3" /end MEASUREMENT
/begin CHARACTERISTIC c_td_as "Dwell time offset usual value : 0 ms" VALUE 0xa002072c _REC_S1VAL_20_s2 16.32 _CNV_A_R_LINEAR_____44_CM -8.192 8.128 /end CHARACTERISTIC
/begin CHARACTERISTIC c_td_ini "Initial value for dwell time control ( typ. Value 3ms for standart coils and <2ms for pencils coils) " VALUE 0xa0020730 _REC_S1VAL_20_u2 262.14 _CNV_A_R_LINEAR_____44_CM 0. 262.14 FORMAT "%7.3" /end CHARACTERISTIC
/begin MEASUREMENT ctr_iga_off_cyc_nr_hld[0] "" UBYTE _CNV_A_R_ECME_LINEA_0_CM 1 0. 0. 255. ECU_ADDRESS 0xd0005304 FORMAT "%3.0" /end MEASUREMENT
/begin MEASUREMENT ctr_iga_off_cyc_nr_hld[1] "" UBYTE _CNV_A_R_ECME_LINEA_0_CM 1 0. 0. 255. ECU_ADDRESS 0xd0005305 FORMAT "%3.0" /end MEASUREMENT
/begin MEASUREMENT ctr_iga_off_cyc_nr_hld[2] "" UBYTE _CNV_A_R_ECME_LINEA_0_CM 1 0. 0. 255. ECU_ADDRESS 0xd0005306 FORMAT "%3.0" /end MEASUREMENT
/begin MEASUREMENT ctr_iga_off_cyc_nr_hld[3] "" UBYTE _CNV_A_R_ECME_LINEA_0_CM 1 0. 0. 255. ECU_ADDRESS 0xd0005307 FORMAT "%3.0" /end MEASUREMENT
/begin MEASUREMENT ctr_iga_on_cyc_nr_hld[0] "" UBYTE _CNV_A_R_ECME_LINEA_0_CM 1 0. 0. 255. ECU_ADDRESS 0xd0005308 FORMAT "%3.0" /end MEASUREMENT
/begin MEASUREMENT ctr_iga_on_cyc_nr_hld[1] "" UBYTE _CNV_A_R_ECME_LINEA_0_CM 1 0. 0. 255. ECU_ADDRESS 0xd0005309 FORMAT "%3.0" /end MEASUREMENT
/begin MEASUREMENT ctr_iga_on_cyc_nr_hld[2] "" UBYTE _CNV_A_R_ECME_LINEA_0_CM 1 0. 0. 255. ECU_ADDRESS 0xd000530a FORMAT "%3.0" /end MEASUREMENT
/begin MEASUREMENT ctr_iga_on_cyc_nr_hld[3] "" UBYTE _CNV_A_R_ECME_LINEA_0_CM 1 0. 0. 255. ECU_ADDRESS 0xd000530b FORMAT "%3.0" /end MEASUREMENT
/begin MEASUREMENT ctr_inh_igc_scp[0] "Counter Ignition coil failure short circuit plus" UBYTE _CNV_A_R_ECME_LINEA_0_CM 1 0. 0. 255. ECU_ADDRESS 0xd000530c FORMAT "%3.0" /end MEASUREMENT
/begin MEASUREMENT ctr_inh_igc_scp[1] "Counter Ignition coil failure short circuit plus" UBYTE _CNV_A_R_ECME_LINEA_0_CM 1 0. 0. 255. ECU_ADDRESS 0xd000530d FORMAT "%3.0" /end MEASUREMENT
/begin MEASUREMENT ctr_inh_igc_scp[2] "Counter Ignition coil failure short circuit plus" UBYTE _CNV_A_R_ECME_LINEA_0_CM 1 0. 0. 255. ECU_ADDRESS 0xd000530e FORMAT "%3.0" /end MEASUREMENT
/begin MEASUREMENT ctr_inh_igc_scp[3] "Counter Ignition coil failure short circuit plus" UBYTE _CNV_A_R_ECME_LINEA_0_CM 1 0. 0. 255. ECU_ADDRESS 0xd000530f FORMAT "%3.0" /end MEASUREMENT
/begin MEASUREMENT ctr_inh_igc_scp_all[0] "Counter Ignition coil failure short circuit plus" UBYTE _CNV_A_R_ECME_LINEA_0_CM 1 0. 0. 255. ECU_ADDRESS 0xd0005310 FORMAT "%3.0" /end MEASUREMENT
/begin MEASUREMENT ctr_inh_igc_scp_all[1] "Counter Ignition coil failure short circuit plus" UBYTE _CNV_A_R_ECME_LINEA_0_CM 1 0. 0. 255. ECU_ADDRESS 0xd0005311 FORMAT "%3.0" /end MEASUREMENT
/begin MEASUREMENT ctr_inh_igc_scp_all[2] "Counter Ignition coil failure short circuit plus" UBYTE _CNV_A_R_ECME_LINEA_0_CM 1 0. 0. 255. ECU_ADDRESS 0xd0005312 FORMAT "%3.0" /end MEASUREMENT
/begin MEASUREMENT ctr_inh_igc_scp_all[3] "Counter Ignition coil failure short circuit plus" UBYTE _CNV_A_R_ECME_LINEA_0_CM 1 0. 0. 255. ECU_ADDRESS 0xd0005313 FORMAT "%3.0" /end MEASUREMENT
/begin MEASUREMENT ctr_sum_igc_scp[0] "" UBYTE _CNV_A_R_ECME_LINEA_0_CM 1 0. 0. 255. ECU_ADDRESS 0xd0005314 FORMAT "%3.0" /end MEASUREMENT
/begin MEASUREMENT ctr_sum_igc_scp[1] "" UBYTE _CNV_A_R_ECME_LINEA_0_CM 1 0. 0. 255. ECU_ADDRESS 0xd0005315 FORMAT "%3.0" /end MEASUREMENT
/begin MEASUREMENT ctr_sum_igc_scp[2] "" UBYTE _CNV_A_R_ECME_LINEA_0_CM 1 0. 0. 255. ECU_ADDRESS 0xd0005316 FORMAT "%3.0" /end MEASUREMENT
/begin MEASUREMENT ctr_sum_igc_scp[3] "" UBYTE _CNV_A_R_ECME_LINEA_0_CM 1 0. 0. 255. ECU_ADDRESS 0xd0005317 FORMAT "%3.0" /end MEASUREMENT
/begin MEASUREMENT igc_diag_mis "Non filtered error information for misfire detection" UBYTE _CNV_A_R_ECME_LINEA_0_CM 1 0. 0. 255. ECU_ADDRESS 0xd000438d FORMAT "%3.0" /end MEASUREMENT
/begin MEASUREMENT lv_err_igc "OR of every failure" UBYTE _CNV_S_2_RANGE______3_CM 1 0. 0. 1. ECU_ADDRESS 0xd0004465 BIT_MASK 0x1 /end MEASUREMENT
/begin MEASUREMENT lv_err_igc_ol[0] "ignition coil failure primary open load" UBYTE _CNV_S_2_ECME_RANGE_1_CM 1 0. 0. 1. ECU_ADDRESS 0xd000438e /end MEASUREMENT
/begin MEASUREMENT lv_err_igc_ol[1] "ignition coil failure primary open load" UBYTE _CNV_S_2_ECME_RANGE_1_CM 1 0. 0. 1. ECU_ADDRESS 0xd000438f /end MEASUREMENT
/begin MEASUREMENT lv_err_igc_ol[2] "ignition coil failure primary open load" UBYTE _CNV_S_2_ECME_RANGE_1_CM 1 0. 0. 1. ECU_ADDRESS 0xd0004390 /end MEASUREMENT
/begin MEASUREMENT lv_err_igc_ol[3] "ignition coil failure primary open load" UBYTE _CNV_S_2_ECME_RANGE_1_CM 1 0. 0. 1. ECU_ADDRESS 0xd0004391 /end MEASUREMENT
/begin MEASUREMENT lv_err_igc_scg[0] "ignition coil failure primary short circuit ground" UBYTE _CNV_S_2_ECME_RANGE_1_CM 1 0. 0. 1. ECU_ADDRESS 0xd0004392 /end MEASUREMENT
/begin MEASUREMENT lv_err_igc_scg[1] "ignition coil failure primary short circuit ground" UBYTE _CNV_S_2_ECME_RANGE_1_CM 1 0. 0. 1. ECU_ADDRESS 0xd0004393 /end MEASUREMENT
/begin MEASUREMENT lv_err_igc_scg[2] "ignition coil failure primary short circuit ground" UBYTE _CNV_S_2_ECME_RANGE_1_CM 1 0. 0. 1. ECU_ADDRESS 0xd0004394 /end MEASUREMENT
/begin MEASUREMENT lv_err_igc_scg[3] "ignition coil failure primary short circuit ground" UBYTE _CNV_S_2_ECME_RANGE_1_CM 1 0. 0. 1. ECU_ADDRESS 0xd0004395 /end MEASUREMENT
/begin MEASUREMENT lv_err_igc_scp[0] "ignition coil failure short circuit plus" UBYTE _CNV_S_2_ECME_RANGE_1_CM 1 0. 0. 1. ECU_ADDRESS 0xd0004396 /end MEASUREMENT
/begin MEASUREMENT lv_err_igc_scp[1] "ignition coil failure short circuit plus" UBYTE _CNV_S_2_ECME_RANGE_1_CM 1 0. 0. 1. ECU_ADDRESS 0xd0004397 /end MEASUREMENT
/begin MEASUREMENT lv_err_igc_scp[2] "ignition coil failure short circuit plus" UBYTE _CNV_S_2_ECME_RANGE_1_CM 1 0. 0. 1. ECU_ADDRESS 0xd0004398 /end MEASUREMENT
/begin MEASUREMENT lv_err_igc_scp[3] "ignition coil failure short circuit plus" UBYTE _CNV_S_2_ECME_RANGE_1_CM 1 0. 0. 1. ECU_ADDRESS 0xd0004399 /end MEASUREMENT
/begin MEASUREMENT lv_err_igc_scp_cfm[0] "Ignition coil failure short circuit plus" UBYTE _CNV_S_2_ECME_RANGE_1_CM 1 0. 0. 1. ECU_ADDRESS 0xd0005318 /end MEASUREMENT
/begin MEASUREMENT lv_err_igc_scp_cfm[1] "Ignition coil failure short circuit plus" UBYTE _CNV_S_2_ECME_RANGE_1_CM 1 0. 0. 1. ECU_ADDRESS 0xd0005319 /end MEASUREMENT
/begin MEASUREMENT lv_err_igc_scp_cfm[2] "Ignition coil failure short circuit plus" UBYTE _CNV_S_2_ECME_RANGE_1_CM 1 0. 0. 1. ECU_ADDRESS 0xd000531a /end MEASUREMENT
/begin MEASUREMENT lv_err_igc_scp_cfm[3] "Ignition coil failure short circuit plus" UBYTE _CNV_S_2_ECME_RANGE_1_CM 1 0. 0. 1. ECU_ADDRESS 0xd000531b /end MEASUREMENT
/begin MEASUREMENT LV_INH_IGC_0 "Inhibition for ignition system of cylinder x" UBYTE _CNV_S_2_RANGE______3_CM 1 0. 0. 1. DISPLAY_IDENTIFIER lv_inh_igc[0] ECU_ADDRESS 0xd000444a BIT_MASK 0x1 /end MEASUREMENT
/begin MEASUREMENT LV_INH_IGC_1 "Inhibition for ignition system of cylinder x" UBYTE _CNV_S_2_RANGE______3_CM 1 0. 0. 1. DISPLAY_IDENTIFIER lv_inh_igc[1] ECU_ADDRESS 0xd000444b BIT_MASK 0x1 /end MEASUREMENT
/begin MEASUREMENT LV_INH_IGC_2 "Inhibition for ignition system of cylinder x" UBYTE _CNV_S_2_RANGE______3_CM 1 0. 0. 1. DISPLAY_IDENTIFIER lv_inh_igc[2] ECU_ADDRESS 0xd000444c BIT_MASK 0x1 /end MEASUREMENT
/begin MEASUREMENT LV_INH_IGC_3 "Inhibition for ignition system of cylinder x" UBYTE _CNV_S_2_RANGE______3_CM 1 0. 0. 1. DISPLAY_IDENTIFIER lv_inh_igc[3] ECU_ADDRESS 0xd000444d BIT_MASK 0x1 /end MEASUREMENT
/begin CHARACTERISTIC c_esb_ign_cut_diag "C_ESB_IGN_CUT_DIAG = 0 will inhibit the function - - typical value for debug = 0" VALUE 0xa0020740 _REC_S1VAL_20_u1 1. _CNV_S_2_RANGE______3_CM 0. 1. /end CHARACTERISTIC
/begin CHARACTERISTIC c_iga_off_cyc_nr_hld "Duration for regeneration cycle recurrence number ; coil has been switched off - - typical value for debug = 16" VALUE 0xa0020742 _REC_S1VAL_20_u1 255. _CNV_A_R_ECME_LINEA_0_CM 0. 255. FORMAT "%3.0" /end CHARACTERISTIC
/begin CHARACTERISTIC c_iga_on_cyc_nr_hld "Duration for regeneration cycle recurrence number ; coil has been switched on - - typical value for debug = 16" VALUE 0xa0020743 _REC_S1VAL_20_u1 255. _CNV_A_R_ECME_LINEA_0_CM 0. 255. FORMAT "%3.0" /end CHARACTERISTIC
/begin CHARACTERISTIC c_n_32_min_ol_scg_igc_diag "Min engine speed for condition diagnosis OL/SCG  - Typical value for debug value = 500 rpm" VALUE 0xa0020745 _REC_S1VAL_20_u1 8160. _CNV_A_R_LINEAR_____2_CM 0. 8160. FORMAT "%4.0" /end CHARACTERISTIC
/begin CHARACTERISTIC c_n_32_min_scp_igc_diag "Minimum engine speed for condition diagnosis SCP - Typical value for debug = 500 rpm" VALUE 0xa0020746 _REC_S1VAL_20_u1 8160. _CNV_A_R_LINEAR_____2_CM 0. 8160. FORMAT "%4.0" /end CHARACTERISTIC
/begin CHARACTERISTIC c_sum_igc_scp "Number of cycles before switching off the coil until reset - - typical value for debug = 255" VALUE 0xa002074f _REC_S1VAL_20_u1 255. _CNV_A_R_ECME_LINEA_0_CM 0. 255. FORMAT "%3.0" /end CHARACTERISTIC
/begin CHARACTERISTIC c_tco_min_igc_diag "min temperature for condition diagnosis OL & SCG - - typical value for debug = 20∞C  ( emission cycle starting )" VALUE 0xa0020754 _REC_S1VAL_20_u1 190.5 _CNV_A_R_LINEAR_____42_CM -48. 142.5 FORMAT "%6.2" /end CHARACTERISTIC
/begin MEASUREMENT ctr_inh_diag_igc "Counter of diagnostic inhibition" UBYTE _CNV_A_R_ECME_LINEA_0_CM 1 0. 0. 255. ECU_ADDRESS 0xd000531e FORMAT "%3.0" /end MEASUREMENT
/begin MEASUREMENT inh_iv_igc "Injection cut off" UBYTE _CNV_A_R_ECME_LINEA_0_CM 1 0. 0. 255. ECU_ADDRESS 0xd000439a FORMAT "%3.0" /end MEASUREMENT
/begin MEASUREMENT lv_cdn_inh_diag_ol_igc "Specific OL doagnosis deactivation conditions" UBYTE _CNV_S_2_RANGE______3_CM 1 0. 0. 1. ECU_ADDRESS 0xd0004462 BIT_MASK 0x1 /end MEASUREMENT
/begin MEASUREMENT lv_cdn_inh_diag_scg_igc "Specific SCG doagnosis deactivation conditions" UBYTE _CNV_S_2_RANGE______3_CM 1 0. 0. 1. ECU_ADDRESS 0xd0004463 BIT_MASK 0x1 /end MEASUREMENT
/begin MEASUREMENT lv_cdn_inh_diag_scp_igc "Specific SCP doagnosis deactivation conditions" UBYTE _CNV_S_2_RANGE______3_CM 1 0. 0. 1. ECU_ADDRESS 0xd0004464 BIT_MASK 0x1 /end MEASUREMENT
/begin CHARACTERISTIC c_ctr_inh_diag_igc "Calibration of diagnostic inhibition" VALUE 0xa002073e _REC_S1VAL_20_u1 255. _CNV_A_R_ECME_LINEA_0_CM 0. 255. FORMAT "%3.0" /end CHARACTERISTIC
/begin MEASUREMENT ctr_seg_nr_restart "Segment counter after a restart" UBYTE _CNV_A_R_ECME_LINEA_0_CM 1 0. 0. 255. ECU_ADDRESS 0xd000531c FORMAT "%3.0" /end MEASUREMENT
/begin MEASUREMENT cur_igc_max_diag "Bench function: memorization of maximum current sample for overcurrent detection" UWORD _CNV_A_R_IGRE_LINEA_46_CM 1 0. 0. 81.9987487792969 ECU_ADDRESS 0xd0003d4c FORMAT "%9.6" /end MEASUREMENT
/begin MEASUREMENT cur_igc_min_diag "Bench function: memorization of minimum current sample for open load detection" UWORD _CNV_A_R_IGRE_LINEA_46_CM 1 0. 0. 81.9987487792969 ECU_ADDRESS 0xd0003d4e FORMAT "%9.6" /end MEASUREMENT
/begin MEASUREMENT CUR_IGC_TD_MIN_HALF_0 "Current acquisition for diagnosis" UWORD _CNV_A_R_IGRE_LINEA_46_CM 1 0. 0. 81.9987487792969 DISPLAY_IDENTIFIER cur_igc_td_min_half[0] ECU_ADDRESS 0xd000316c FORMAT "%9.6" /end MEASUREMENT
/begin MEASUREMENT CUR_IGC_TD_MIN_HALF_1 "Current acquisition for diagnosis" UWORD _CNV_A_R_IGRE_LINEA_46_CM 1 0. 0. 81.9987487792969 DISPLAY_IDENTIFIER cur_igc_td_min_half[1] ECU_ADDRESS 0xd000316e FORMAT "%9.6" /end MEASUREMENT
/begin MEASUREMENT CUR_IGC_TD_MIN_HALF_2 "Current acquisition for diagnosis" UWORD _CNV_A_R_IGRE_LINEA_46_CM 1 0. 0. 81.9987487792969 DISPLAY_IDENTIFIER cur_igc_td_min_half[2] ECU_ADDRESS 0xd0003170 FORMAT "%9.6" /end MEASUREMENT
/begin MEASUREMENT CUR_IGC_TD_MIN_HALF_3 "Current acquisition for diagnosis" UWORD _CNV_A_R_IGRE_LINEA_46_CM 1 0. 0. 81.9987487792969 DISPLAY_IDENTIFIER cur_igc_td_min_half[3] ECU_ADDRESS 0xd0003172 FORMAT "%9.6" /end MEASUREMENT
/begin MEASUREMENT LV_OL_IGC_0 "Diagnostic of primary open load ( cylinder selected )" UBYTE _CNV_S_2_RANGE______3_CM 1 0. 0. 1. DISPLAY_IDENTIFIER lv_ol_igc[0] ECU_ADDRESS 0xd000444e BIT_MASK 0x1 /end MEASUREMENT
/begin MEASUREMENT LV_OL_IGC_1 "Diagnostic of primary open load ( cylinder selected )" UBYTE _CNV_S_2_RANGE______3_CM 1 0. 0. 1. DISPLAY_IDENTIFIER lv_ol_igc[1] ECU_ADDRESS 0xd000444f BIT_MASK 0x1 /end MEASUREMENT
/begin MEASUREMENT LV_OL_IGC_2 "Diagnostic of primary open load ( cylinder selected )" UBYTE _CNV_S_2_RANGE______3_CM 1 0. 0. 1. DISPLAY_IDENTIFIER lv_ol_igc[2] ECU_ADDRESS 0xd0004450 BIT_MASK 0x1 /end MEASUREMENT
/begin MEASUREMENT LV_OL_IGC_3 "Diagnostic of primary open load ( cylinder selected )" UBYTE _CNV_S_2_RANGE______3_CM 1 0. 0. 1. DISPLAY_IDENTIFIER lv_ol_igc[3] ECU_ADDRESS 0xd0004451 BIT_MASK 0x1 /end MEASUREMENT
/begin MEASUREMENT LV_SCG_IGC_0 "Diagnostic of primary short circuit to ground ( cylinder selected )" UBYTE _CNV_S_2_RANGE______3_CM 1 0. 0. 1. DISPLAY_IDENTIFIER lv_scg_igc[0] ECU_ADDRESS 0xd0004452 BIT_MASK 0x1 /end MEASUREMENT
/begin MEASUREMENT LV_SCG_IGC_1 "Diagnostic of primary short circuit to ground ( cylinder selected )" UBYTE _CNV_S_2_RANGE______3_CM 1 0. 0. 1. DISPLAY_IDENTIFIER lv_scg_igc[1] ECU_ADDRESS 0xd0004453 BIT_MASK 0x1 /end MEASUREMENT
/begin MEASUREMENT LV_SCG_IGC_2 "Diagnostic of primary short circuit to ground ( cylinder selected )" UBYTE _CNV_S_2_RANGE______3_CM 1 0. 0. 1. DISPLAY_IDENTIFIER lv_scg_igc[2] ECU_ADDRESS 0xd0004454 BIT_MASK 0x1 /end MEASUREMENT
/begin MEASUREMENT LV_SCG_IGC_3 "Diagnostic of primary short circuit to ground ( cylinder selected )" UBYTE _CNV_S_2_RANGE______3_CM 1 0. 0. 1. DISPLAY_IDENTIFIER lv_scg_igc[3] ECU_ADDRESS 0xd0004455 BIT_MASK 0x1 /end MEASUREMENT
/begin MEASUREMENT LV_SCP_IGC_0 "Diagnostic of primary short circuit to battery ( cylinder selected )" UBYTE _CNV_S_2_RANGE______3_CM 1 0. 0. 1. DISPLAY_IDENTIFIER lv_scp_igc[0] ECU_ADDRESS 0xd0004456 BIT_MASK 0x1 /end MEASUREMENT
/begin MEASUREMENT LV_SCP_IGC_1 "Diagnostic of primary short circuit to battery ( cylinder selected )" UBYTE _CNV_S_2_RANGE______3_CM 1 0. 0. 1. DISPLAY_IDENTIFIER lv_scp_igc[1] ECU_ADDRESS 0xd0004457 BIT_MASK 0x1 /end MEASUREMENT
/begin MEASUREMENT LV_SCP_IGC_2 "Diagnostic of primary short circuit to battery ( cylinder selected )" UBYTE _CNV_S_2_RANGE______3_CM 1 0. 0. 1. DISPLAY_IDENTIFIER lv_scp_igc[2] ECU_ADDRESS 0xd0004458 BIT_MASK 0x1 /end MEASUREMENT
/begin MEASUREMENT LV_SCP_IGC_3 "Diagnostic of primary short circuit to battery ( cylinder selected )" UBYTE _CNV_S_2_RANGE______3_CM 1 0. 0. 1. DISPLAY_IDENTIFIER lv_scp_igc[3] ECU_ADDRESS 0xd0004459 BIT_MASK 0x1 /end MEASUREMENT
/begin MEASUREMENT LV_V_VLD_IGC_0 "Flag indicating if sample acquired at TD_MIN/2 is valid" UBYTE _CNV_S_2_RANGE______3_CM 1 0. 0. 1. DISPLAY_IDENTIFIER lv_v_vld_igc[0] ECU_ADDRESS 0xd00051fc BIT_MASK 0x1 /end MEASUREMENT
/begin MEASUREMENT LV_V_VLD_IGC_1 "Flag indicating if sample acquired at TD_MIN/2 is valid" UBYTE _CNV_S_2_RANGE______3_CM 1 0. 0. 1. DISPLAY_IDENTIFIER lv_v_vld_igc[1] ECU_ADDRESS 0xd00051fd BIT_MASK 0x1 /end MEASUREMENT
/begin MEASUREMENT LV_V_VLD_IGC_2 "Flag indicating if sample acquired at TD_MIN/2 is valid" UBYTE _CNV_S_2_RANGE______3_CM 1 0. 0. 1. DISPLAY_IDENTIFIER lv_v_vld_igc[2] ECU_ADDRESS 0xd00051fe BIT_MASK 0x1 /end MEASUREMENT
/begin MEASUREMENT LV_V_VLD_IGC_3 "Flag indicating if sample acquired at TD_MIN/2 is valid" UBYTE _CNV_S_2_RANGE______3_CM 1 0. 0. 1. DISPLAY_IDENTIFIER lv_v_vld_igc[3] ECU_ADDRESS 0xd00051ff BIT_MASK 0x1 /end MEASUREMENT
/begin MEASUREMENT LV_VLD_CUR_IGC_DIAG_0 "Validity flag for current acquisition" UBYTE _CNV_S_2_RANGE______3_CM 1 0. 0. 1. DISPLAY_IDENTIFIER lv_vld_cur_igc_diag[0] ECU_ADDRESS 0xd000445a BIT_MASK 0x1 /end MEASUREMENT
/begin MEASUREMENT LV_VLD_CUR_IGC_DIAG_1 "Validity flag for current acquisition" UBYTE _CNV_S_2_RANGE______3_CM 1 0. 0. 1. DISPLAY_IDENTIFIER lv_vld_cur_igc_diag[1] ECU_ADDRESS 0xd000445b BIT_MASK 0x1 /end MEASUREMENT
/begin MEASUREMENT LV_VLD_CUR_IGC_DIAG_2 "Validity flag for current acquisition" UBYTE _CNV_S_2_RANGE______3_CM 1 0. 0. 1. DISPLAY_IDENTIFIER lv_vld_cur_igc_diag[2] ECU_ADDRESS 0xd000445c BIT_MASK 0x1 /end MEASUREMENT
/begin MEASUREMENT LV_VLD_CUR_IGC_DIAG_3 "Validity flag for current acquisition" UBYTE _CNV_S_2_RANGE______3_CM 1 0. 0. 1. DISPLAY_IDENTIFIER lv_vld_cur_igc_diag[3] ECU_ADDRESS 0xd000445d BIT_MASK 0x1 /end MEASUREMENT
/begin MEASUREMENT T_ACQ_TD_MIN_HALF_0 "Diagnosis current acquisition time" UWORD _CNV_A_R_LINEAR_____44_CM 1 0. 0. 262.14 DISPLAY_IDENTIFIER t_acq_td_min_half[0] ECU_ADDRESS 0xd0003194 FORMAT "%7.3" /end MEASUREMENT
/begin MEASUREMENT T_ACQ_TD_MIN_HALF_1 "Diagnosis current acquisition time" UWORD _CNV_A_R_LINEAR_____44_CM 1 0. 0. 262.14 DISPLAY_IDENTIFIER t_acq_td_min_half[1] ECU_ADDRESS 0xd0003196 FORMAT "%7.3" /end MEASUREMENT
/begin MEASUREMENT T_ACQ_TD_MIN_HALF_2 "Diagnosis current acquisition time" UWORD _CNV_A_R_LINEAR_____44_CM 1 0. 0. 262.14 DISPLAY_IDENTIFIER t_acq_td_min_half[2] ECU_ADDRESS 0xd0003198 FORMAT "%7.3" /end MEASUREMENT
/begin MEASUREMENT T_ACQ_TD_MIN_HALF_3 "Diagnosis current acquisition time" UWORD _CNV_A_R_LINEAR_____44_CM 1 0. 0. 262.14 DISPLAY_IDENTIFIER t_acq_td_min_half[3] ECU_ADDRESS 0xd000319a FORMAT "%7.3" /end MEASUREMENT
/begin MEASUREMENT V_IGN_TD_MIN_HALF_0 "Voltage acquisition for diagnosis" UWORD _CNV_A_R_IGRE_LINEA_47_CM 1 0. 0. 4.99992370605469 DISPLAY_IDENTIFIER v_ign_td_min_half[0] ECU_ADDRESS 0xd0003d44 FORMAT "%6.4" /end MEASUREMENT
/begin MEASUREMENT V_IGN_TD_MIN_HALF_1 "Voltage acquisition for diagnosis" UWORD _CNV_A_R_IGRE_LINEA_47_CM 1 0. 0. 4.99992370605469 DISPLAY_IDENTIFIER v_ign_td_min_half[1] ECU_ADDRESS 0xd0003d46 FORMAT "%6.4" /end MEASUREMENT
/begin MEASUREMENT V_IGN_TD_MIN_HALF_2 "Voltage acquisition for diagnosis" UWORD _CNV_A_R_IGRE_LINEA_47_CM 1 0. 0. 4.99992370605469 DISPLAY_IDENTIFIER v_ign_td_min_half[2] ECU_ADDRESS 0xd0003d48 FORMAT "%6.4" /end MEASUREMENT
/begin MEASUREMENT V_IGN_TD_MIN_HALF_3 "Voltage acquisition for diagnosis" UWORD _CNV_A_R_IGRE_LINEA_47_CM 1 0. 0. 4.99992370605469 DISPLAY_IDENTIFIER v_ign_td_min_half[3] ECU_ADDRESS 0xd0003d4a FORMAT "%6.4" /end MEASUREMENT
/begin CHARACTERISTIC c_ctr_seg_nr_restart "Segment number to wait to enable the computation of validity flags" VALUE 0xa002073f _REC_S1VAL_20_u1 255. _CNV_A_R_ECME_LINEA_0_CM 0. 255. FORMAT "%3.0" /end CHARACTERISTIC
/begin CHARACTERISTIC c_cur_igc_max "Ignition current threshold for SCP detection (default value = 12 A)" VALUE 0xa0020714 _REC_S1VAL_20_u2 81.99874877929692 _CNV_A_R_IGRE_LINEA_46_CM 0. 81.9987487792969 FORMAT "%9.6" /end CHARACTERISTIC
/begin CHARACTERISTIC c_cur_igc_min "Ignition current threshold for OL / SCG detection (default value = 1.0 A)" VALUE 0xa0020716 _REC_S1VAL_20_u2 81.99874877929692 _CNV_A_R_IGRE_LINEA_46_CM 0. 81.9987487792969 FORMAT "%9.6" /end CHARACTERISTIC
/begin CHARACTERISTIC lc_igre_dev "Logical calibration for development use only" VALUE 0xa0020761 _REC_S1VAL_20_u1 1. _CNV_A_R_ECME_LINEA_0_CM 0. 1. FORMAT "%1.0" /end CHARACTERISTIC
/begin MEASUREMENT inh_igc "Inhibition of selected cylinder" UBYTE _CNV_A_R_ECME_LINEA_0_CM 1 0. 0. 255. ECU_ADDRESS 0xd0004388 FORMAT "%3.0" /end MEASUREMENT
/begin MEASUREMENT lv_ign_seq_di_ena "Flag to acknowledge that resynchronization by a disable/enable sequence has been done" UBYTE _CNV_S_2_RANGE______3_CM 1 0. 0. 1. ECU_ADDRESS 0xd000445f BIT_MASK 0x1 /end MEASUREMENT
/begin MEASUREMENT IGA_IGC_SHIFT_RNG_0 "Ignition angle of cylinder x" UBYTE _CNV_A_R_IGRE_LINEA_48_CM 1 0. -23.625 72. DISPLAY_IDENTIFIER iga_igc_shift_rng[0] ECU_ADDRESS 0xd0004382 FORMAT "%7.3" /end MEASUREMENT
/begin MEASUREMENT IGA_IGC_SHIFT_RNG_1 "Ignition angle of cylinder x" UBYTE _CNV_A_R_IGRE_LINEA_48_CM 1 0. -23.625 72. DISPLAY_IDENTIFIER iga_igc_shift_rng[1] ECU_ADDRESS 0xd0004383 FORMAT "%7.3" /end MEASUREMENT
/begin MEASUREMENT IGA_IGC_SHIFT_RNG_2 "Ignition angle of cylinder x" UBYTE _CNV_A_R_IGRE_LINEA_48_CM 1 0. -23.625 72. DISPLAY_IDENTIFIER iga_igc_shift_rng[2] ECU_ADDRESS 0xd0004384 FORMAT "%7.3" /end MEASUREMENT
/begin MEASUREMENT IGA_IGC_SHIFT_RNG_3 "Ignition angle of cylinder x" UBYTE _CNV_A_R_IGRE_LINEA_48_CM 1 0. -23.625 72. DISPLAY_IDENTIFIER iga_igc_shift_rng[3] ECU_ADDRESS 0xd0004385 FORMAT "%7.3" /end MEASUREMENT
/begin MEASUREMENT TD_IGC_0 "dwell time duration" UWORD _CNV_A_R_LINEAR_____44_CM 1 0. 0. 262.14 DISPLAY_IDENTIFIER td_igc[0] ECU_ADDRESS 0xd000319c FORMAT "%7.3" /end MEASUREMENT
/begin MEASUREMENT TD_IGC_1 "dwell time duration" UWORD _CNV_A_R_LINEAR_____44_CM 1 0. 0. 262.14 DISPLAY_IDENTIFIER td_igc[1] ECU_ADDRESS 0xd000319e FORMAT "%7.3" /end MEASUREMENT
/begin MEASUREMENT TD_IGC_2 "dwell time duration" UWORD _CNV_A_R_LINEAR_____44_CM 1 0. 0. 262.14 DISPLAY_IDENTIFIER td_igc[2] ECU_ADDRESS 0xd00031a0 FORMAT "%7.3" /end MEASUREMENT
/begin MEASUREMENT TD_IGC_3 "dwell time duration" UWORD _CNV_A_R_LINEAR_____44_CM 1 0. 0. 262.14 DISPLAY_IDENTIFIER td_igc[3] ECU_ADDRESS 0xd00031a2 FORMAT "%7.3" /end MEASUREMENT
/begin CHARACTERISTIC c_td_eol "Dwell time for End Of Line coil test" VALUE 0xa002072e _REC_S1VAL_20_u2 262.14 _CNV_A_R_LINEAR_____44_CM 0. 262.14 FORMAT "%7.3" /end CHARACTERISTIC
/begin CHARACTERISTIC ip_td_fac_max "Max Dwell time factor" CURVE 0xa0020700 _REC_A1CUR_20_u1_u1 1.984375 _CNV_A_R_LINEAR_____43_CM 7.8125e-003 1.9921875 FORMAT "%8.6"
 /begin AXIS_DESCR COM_AXIS n_32 _CNV_A_R_LINEAR_____2_CM 8 0. 8160. FORMAT "%4.0" AXIS_PTS_REF ldpm_n_32_1_igre /end AXIS_DESCR
/end CHARACTERISTIC
/begin CHARACTERISTIC ip_td_fac_min "Min Dwell time factor" CURVE 0xa0020708 _REC_A1CUR_20_u1_u1 1.984375 _CNV_A_R_LINEAR_____43_CM 7.8125e-003 1.9921875 FORMAT "%8.6"
 /begin AXIS_DESCR COM_AXIS n_32 _CNV_A_R_LINEAR_____2_CM 8 0. 8160. FORMAT "%4.0" AXIS_PTS_REF ldpm_n_32_1_igre /end AXIS_DESCR
/end CHARACTERISTIC
/begin MEASUREMENT igc_conf "Ignition coil configuration" UBYTE _CNV_A_R_ECME_LINEA_0_CM 1 0. 1. 2. ECU_ADDRESS 0xd0004386 FORMAT "%3.0" /end MEASUREMENT
/begin MEASUREMENT lv_ign_lih "Flag indicating ignition is in limp home mode" UBYTE _CNV_S_2_RANGE______3_CM 1 0. 0. 1. ECU_ADDRESS 0xd000445e BIT_MASK 0x1 /end MEASUREMENT
/begin MEASUREMENT td_fac_max "Maximum dwell time control" UBYTE _CNV_A_R_LINEAR_____43_CM 1 0. 7.8125e-003 1.9921875 ECU_ADDRESS 0xd000438a FORMAT "%8.6" /end MEASUREMENT
/begin MEASUREMENT td_fac_min "Minimum dwell time control" UBYTE _CNV_A_R_LINEAR_____43_CM 1 0. 7.8125e-003 1.9921875 ECU_ADDRESS 0xd000438b FORMAT "%8.6" /end MEASUREMENT
/begin CHARACTERISTIC c_td_fac_st_max "Factor for maximum dwell time" VALUE 0xa0020756 _REC_S1VAL_20_u1 1.984375 _CNV_A_R_LINEAR_____43_CM 7.8125e-003 1.9921875 FORMAT "%8.6" /end CHARACTERISTIC
/begin CHARACTERISTIC c_td_fac_st_min "Factor for minimum dwell time" VALUE 0xa0020757 _REC_S1VAL_20_u1 1.984375 _CNV_A_R_LINEAR_____43_CM 7.8125e-003 1.9921875 FORMAT "%8.6" /end CHARACTERISTIC
/begin CHARACTERISTIC c_td_vb_max "Maximum battery voltage to activate MPL ( typ value : 16V )" VALUE 0xa0020759 _REC_S1VAL_20_u1 25.8984375 _CNV_A_R_LINEAR_____41_CM 0. 25.8984375 FORMAT "%9.6" /end CHARACTERISTIC
/begin CHARACTERISTIC lc_igc_lih_conf "Configuration Choice for Half static Mode in case of CAM limp home: 0 = no Limp Home - 1 = Half Static" VALUE 0xa0020760 _REC_S1VAL_20_u1 1. _CNV_A_R_ECME_LINEA_0_CM 0. 1. FORMAT "%1.0" /end CHARACTERISTIC
/begin MEASUREMENT cur_igc_mv[0] "Moving mean value of the estimated current values" UWORD _CNV_A_R_IGRE_LINEA_46_CM 1 0. 0. 81.9987487792969 ECU_ADDRESS 0xd0003d0c FORMAT "%9.6" /end MEASUREMENT
/begin MEASUREMENT cur_igc_mv[1] "Moving mean value of the estimated current values" UWORD _CNV_A_R_IGRE_LINEA_46_CM 1 0. 0. 81.9987487792969 ECU_ADDRESS 0xd0003d0e FORMAT "%9.6" /end MEASUREMENT
/begin MEASUREMENT cur_igc_mv[2] "Moving mean value of the estimated current values" UWORD _CNV_A_R_IGRE_LINEA_46_CM 1 0. 0. 81.9987487792969 ECU_ADDRESS 0xd0003d10 FORMAT "%9.6" /end MEASUREMENT
/begin MEASUREMENT cur_igc_mv[3] "Moving mean value of the estimated current values" UWORD _CNV_A_R_IGRE_LINEA_46_CM 1 0. 0. 81.9987487792969 ECU_ADDRESS 0xd0003d12 FORMAT "%9.6" /end MEASUREMENT
/begin MEASUREMENT cur_igc_pred[0] "Corrrected dwell time adaptation current acquisition" UWORD _CNV_A_R_IGRE_LINEA_46_CM 1 0. 0. 81.9987487792969 ECU_ADDRESS 0xd0003d14 FORMAT "%9.6" /end MEASUREMENT
/begin MEASUREMENT cur_igc_pred[1] "Corrrected dwell time adaptation current acquisition" UWORD _CNV_A_R_IGRE_LINEA_46_CM 1 0. 0. 81.9987487792969 ECU_ADDRESS 0xd0003d16 FORMAT "%9.6" /end MEASUREMENT
/begin MEASUREMENT cur_igc_pred[2] "Corrrected dwell time adaptation current acquisition" UWORD _CNV_A_R_IGRE_LINEA_46_CM 1 0. 0. 81.9987487792969 ECU_ADDRESS 0xd0003d18 FORMAT "%9.6" /end MEASUREMENT
/begin MEASUREMENT cur_igc_pred[3] "Corrrected dwell time adaptation current acquisition" UWORD _CNV_A_R_IGRE_LINEA_46_CM 1 0. 0. 81.9987487792969 ECU_ADDRESS 0xd0003d1a FORMAT "%9.6" /end MEASUREMENT
/begin MEASUREMENT cur_igc_td_end[0] "Dwell time adaptation current acquisition at td_end with PCB resistance taken into account" UWORD _CNV_A_R_IGRE_LINEA_46_CM 1 0. 0. 81.9987487792969 ECU_ADDRESS 0xd0003d1c FORMAT "%9.6" /end MEASUREMENT
/begin MEASUREMENT cur_igc_td_end[1] "Dwell time adaptation current acquisition at td_end with PCB resistance taken into account" UWORD _CNV_A_R_IGRE_LINEA_46_CM 1 0. 0. 81.9987487792969 ECU_ADDRESS 0xd0003d1e FORMAT "%9.6" /end MEASUREMENT
/begin MEASUREMENT cur_igc_td_end[2] "Dwell time adaptation current acquisition at td_end with PCB resistance taken into account" UWORD _CNV_A_R_IGRE_LINEA_46_CM 1 0. 0. 81.9987487792969 ECU_ADDRESS 0xd0003d20 FORMAT "%9.6" /end MEASUREMENT
/begin MEASUREMENT cur_igc_td_end[3] "Dwell time adaptation current acquisition at td_end with PCB resistance taken into account" UWORD _CNV_A_R_IGRE_LINEA_46_CM 1 0. 0. 81.9987487792969 ECU_ADDRESS 0xd0003d22 FORMAT "%9.6" /end MEASUREMENT
/begin MEASUREMENT cur_igc_td_min_half_cor[0] "Dwell time adaptation current acquisition at td_min/2 with PCB resistance taken into account" UWORD _CNV_A_R_IGRE_LINEA_46_CM 1 0. 0. 81.9987487792969 ECU_ADDRESS 0xd0003d24 FORMAT "%9.6" /end MEASUREMENT
/begin MEASUREMENT cur_igc_td_min_half_cor[1] "Dwell time adaptation current acquisition at td_min/2 with PCB resistance taken into account" UWORD _CNV_A_R_IGRE_LINEA_46_CM 1 0. 0. 81.9987487792969 ECU_ADDRESS 0xd0003d26 FORMAT "%9.6" /end MEASUREMENT
/begin MEASUREMENT cur_igc_td_min_half_cor[2] "Dwell time adaptation current acquisition at td_min/2 with PCB resistance taken into account" UWORD _CNV_A_R_IGRE_LINEA_46_CM 1 0. 0. 81.9987487792969 ECU_ADDRESS 0xd0003d28 FORMAT "%9.6" /end MEASUREMENT
/begin MEASUREMENT cur_igc_td_min_half_cor[3] "Dwell time adaptation current acquisition at td_min/2 with PCB resistance taken into account" UWORD _CNV_A_R_IGRE_LINEA_46_CM 1 0. 0. 81.9987487792969 ECU_ADDRESS 0xd0003d2a FORMAT "%9.6" /end MEASUREMENT
/begin MEASUREMENT fac_td_ad[1] "Dwell time adaptative corrective factor" UWORD _CNV_A_R_LINEAR_____49_CM 1 0. 0. 1.99996948242188 DISPLAY_IDENTIFIER fac_td_ad[0] ECU_ADDRESS 0xd0003174 FORMAT "%7.5" /end MEASUREMENT
/begin MEASUREMENT fac_td_ad[2] "Dwell time adaptative corrective factor" UWORD _CNV_A_R_LINEAR_____49_CM 1 0. 0. 1.99996948242188 DISPLAY_IDENTIFIER fac_td_ad[1] ECU_ADDRESS 0xd0003176 FORMAT "%7.5" /end MEASUREMENT
/begin MEASUREMENT fac_td_ad[3] "Dwell time adaptative corrective factor" UWORD _CNV_A_R_LINEAR_____49_CM 1 0. 0. 1.99996948242188 DISPLAY_IDENTIFIER fac_td_ad[2] ECU_ADDRESS 0xd0003178 FORMAT "%7.5" /end MEASUREMENT
/begin MEASUREMENT fac_td_ad[4] "Dwell time adaptative corrective factor" UWORD _CNV_A_R_LINEAR_____49_CM 1 0. 0. 1.99996948242188 DISPLAY_IDENTIFIER fac_td_ad[3] ECU_ADDRESS 0xd000317a FORMAT "%7.5" /end MEASUREMENT
/begin MEASUREMENT fac_td_ad_max[1] "Dwell time adaptative corrective factor" UWORD _CNV_A_R_LINEAR_____49_CM 1 0. 0. 1.99996948242188 DISPLAY_IDENTIFIER fac_td_ad_max[0] ECU_ADDRESS 0xd000317c FORMAT "%7.5" /end MEASUREMENT
/begin MEASUREMENT fac_td_ad_max[2] "Dwell time adaptative corrective factor" UWORD _CNV_A_R_LINEAR_____49_CM 1 0. 0. 1.99996948242188 DISPLAY_IDENTIFIER fac_td_ad_max[1] ECU_ADDRESS 0xd000317e FORMAT "%7.5" /end MEASUREMENT
/begin MEASUREMENT fac_td_ad_max[3] "Dwell time adaptative corrective factor" UWORD _CNV_A_R_LINEAR_____49_CM 1 0. 0. 1.99996948242188 DISPLAY_IDENTIFIER fac_td_ad_max[2] ECU_ADDRESS 0xd0003180 FORMAT "%7.5" /end MEASUREMENT
/begin MEASUREMENT fac_td_ad_max[4] "Dwell time adaptative corrective factor" UWORD _CNV_A_R_LINEAR_____49_CM 1 0. 0. 1.99996948242188 DISPLAY_IDENTIFIER fac_td_ad_max[3] ECU_ADDRESS 0xd0003182 FORMAT "%7.5" /end MEASUREMENT
/begin MEASUREMENT fac_td_ad_min[1] "Dwell time adaptative corrective factor" UWORD _CNV_A_R_LINEAR_____49_CM 1 0. 0. 1.99996948242188 DISPLAY_IDENTIFIER fac_td_ad_min[0] ECU_ADDRESS 0xd0003184 FORMAT "%7.5" /end MEASUREMENT
/begin MEASUREMENT fac_td_ad_min[2] "Dwell time adaptative corrective factor" UWORD _CNV_A_R_LINEAR_____49_CM 1 0. 0. 1.99996948242188 DISPLAY_IDENTIFIER fac_td_ad_min[1] ECU_ADDRESS 0xd0003186 FORMAT "%7.5" /end MEASUREMENT
/begin MEASUREMENT fac_td_ad_min[3] "Dwell time adaptative corrective factor" UWORD _CNV_A_R_LINEAR_____49_CM 1 0. 0. 1.99996948242188 DISPLAY_IDENTIFIER fac_td_ad_min[2] ECU_ADDRESS 0xd0003188 FORMAT "%7.5" /end MEASUREMENT
/begin MEASUREMENT fac_td_ad_min[4] "Dwell time adaptative corrective factor" UWORD _CNV_A_R_LINEAR_____49_CM 1 0. 0. 1.99996948242188 DISPLAY_IDENTIFIER fac_td_ad_min[3] ECU_ADDRESS 0xd000318a FORMAT "%7.5" /end MEASUREMENT
/begin MEASUREMENT fac_td_temp[1] "Coil factor for temperature correction" UWORD _CNV_A_R_LINEAR_____49_CM 1 0. 0. 1.99996948242188 DISPLAY_IDENTIFIER fac_td_temp[0] ECU_ADDRESS 0xd000318c FORMAT "%7.5" /end MEASUREMENT
/begin MEASUREMENT fac_td_temp[2] "Coil factor for temperature correction" UWORD _CNV_A_R_LINEAR_____49_CM 1 0. 0. 1.99996948242188 DISPLAY_IDENTIFIER fac_td_temp[1] ECU_ADDRESS 0xd000318e FORMAT "%7.5" /end MEASUREMENT
/begin MEASUREMENT fac_td_temp[3] "Coil factor for temperature correction" UWORD _CNV_A_R_LINEAR_____49_CM 1 0. 0. 1.99996948242188 DISPLAY_IDENTIFIER fac_td_temp[2] ECU_ADDRESS 0xd0003190 FORMAT "%7.5" /end MEASUREMENT
/begin MEASUREMENT fac_td_temp[4] "Coil factor for temperature correction" UWORD _CNV_A_R_LINEAR_____49_CM 1 0. 0. 1.99996948242188 DISPLAY_IDENTIFIER fac_td_temp[3] ECU_ADDRESS 0xd0003192 FORMAT "%7.5" /end MEASUREMENT
/begin MEASUREMENT lv_inh_td_ad_cyl[0] "Flag indicating that dwell adaptive function is inhibited" UBYTE _CNV_S_2_RANGE______3_CM 1 0. 0. 1. ECU_ADDRESS 0xd00051f0 BIT_MASK 0x1 /end MEASUREMENT
/begin MEASUREMENT lv_inh_td_ad_cyl[1] "Flag indicating that dwell adaptive function is inhibited" UBYTE _CNV_S_2_RANGE______3_CM 1 0. 0. 1. ECU_ADDRESS 0xd00051f1 BIT_MASK 0x1 /end MEASUREMENT
/begin MEASUREMENT lv_inh_td_ad_cyl[2] "Flag indicating that dwell adaptive function is inhibited" UBYTE _CNV_S_2_RANGE______3_CM 1 0. 0. 1. ECU_ADDRESS 0xd00051f2 BIT_MASK 0x1 /end MEASUREMENT
/begin MEASUREMENT lv_inh_td_ad_cyl[3] "Flag indicating that dwell adaptive function is inhibited" UBYTE _CNV_S_2_RANGE______3_CM 1 0. 0. 1. ECU_ADDRESS 0xd00051f3 BIT_MASK 0x1 /end MEASUREMENT
/begin MEASUREMENT lv_td_ad_acq_vld[0] "flag indicating if samples acquired are valid" UBYTE _CNV_S_2_RANGE______3_CM 1 0. 0. 1. ECU_ADDRESS 0xd00051f4 BIT_MASK 0x1 /end MEASUREMENT
/begin MEASUREMENT lv_td_ad_acq_vld[1] "flag indicating if samples acquired are valid" UBYTE _CNV_S_2_RANGE______3_CM 1 0. 0. 1. ECU_ADDRESS 0xd00051f5 BIT_MASK 0x1 /end MEASUREMENT
/begin MEASUREMENT lv_td_ad_acq_vld[2] "flag indicating if samples acquired are valid" UBYTE _CNV_S_2_RANGE______3_CM 1 0. 0. 1. ECU_ADDRESS 0xd00051f6 BIT_MASK 0x1 /end MEASUREMENT
/begin MEASUREMENT lv_td_ad_acq_vld[3] "flag indicating if samples acquired are valid" UBYTE _CNV_S_2_RANGE______3_CM 1 0. 0. 1. ECU_ADDRESS 0xd00051f7 BIT_MASK 0x1 /end MEASUREMENT
/begin MEASUREMENT lv_v_td_end_vld[0] "flag indicating if samples acquired is valid" UBYTE _CNV_S_2_RANGE______3_CM 1 0. 0. 1. ECU_ADDRESS 0xd00051f8 BIT_MASK 0x1 /end MEASUREMENT
/begin MEASUREMENT lv_v_td_end_vld[1] "flag indicating if samples acquired is valid" UBYTE _CNV_S_2_RANGE______3_CM 1 0. 0. 1. ECU_ADDRESS 0xd00051f9 BIT_MASK 0x1 /end MEASUREMENT
/begin MEASUREMENT lv_v_td_end_vld[2] "flag indicating if samples acquired is valid" UBYTE _CNV_S_2_RANGE______3_CM 1 0. 0. 1. ECU_ADDRESS 0xd00051fa BIT_MASK 0x1 /end MEASUREMENT
/begin MEASUREMENT lv_v_td_end_vld[3] "flag indicating if samples acquired is valid" UBYTE _CNV_S_2_RANGE______3_CM 1 0. 0. 1. ECU_ADDRESS 0xd00051fb BIT_MASK 0x1 /end MEASUREMENT
/begin MEASUREMENT t_acq_td_end[0] "Acquisition time of current sample" UWORD _CNV_A_R_LINEAR_____44_CM 1 0. 0. 262.14 ECU_ADDRESS 0xd0003d2c FORMAT "%7.3" /end MEASUREMENT
/begin MEASUREMENT t_acq_td_end[1] "Acquisition time of current sample" UWORD _CNV_A_R_LINEAR_____44_CM 1 0. 0. 262.14 ECU_ADDRESS 0xd0003d2e FORMAT "%7.3" /end MEASUREMENT
/begin MEASUREMENT t_acq_td_end[2] "Acquisition time of current sample" UWORD _CNV_A_R_LINEAR_____44_CM 1 0. 0. 262.14 ECU_ADDRESS 0xd0003d30 FORMAT "%7.3" /end MEASUREMENT
/begin MEASUREMENT t_acq_td_end[3] "Acquisition time of current sample" UWORD _CNV_A_R_LINEAR_____44_CM 1 0. 0. 262.14 ECU_ADDRESS 0xd0003d32 FORMAT "%7.3" /end MEASUREMENT
/begin MEASUREMENT td_igc_tmp[0] "Dwell time applied memorised to be used to calculate dwell adaptation factor" UWORD _CNV_A_R_LINEAR_____44_CM 1 0. 0. 262.14 ECU_ADDRESS 0xd0003d34 FORMAT "%7.3" /end MEASUREMENT
/begin MEASUREMENT td_igc_tmp[1] "Dwell time applied memorised to be used to calculate dwell adaptation factor" UWORD _CNV_A_R_LINEAR_____44_CM 1 0. 0. 262.14 ECU_ADDRESS 0xd0003d36 FORMAT "%7.3" /end MEASUREMENT
/begin MEASUREMENT td_igc_tmp[2] "Dwell time applied memorised to be used to calculate dwell adaptation factor" UWORD _CNV_A_R_LINEAR_____44_CM 1 0. 0. 262.14 ECU_ADDRESS 0xd0003d38 FORMAT "%7.3" /end MEASUREMENT
/begin MEASUREMENT td_igc_tmp[3] "Dwell time applied memorised to be used to calculate dwell adaptation factor" UWORD _CNV_A_R_LINEAR_____44_CM 1 0. 0. 262.14 ECU_ADDRESS 0xd0003d3a FORMAT "%7.3" /end MEASUREMENT
/begin MEASUREMENT v_igc_td_end[0] "Dwell time adaptation voltage acquisition" UWORD _CNV_A_R_IGRE_LINEA_47_CM 1 0. 0. 4.99992370605469 ECU_ADDRESS 0xd0003d3c FORMAT "%6.4" /end MEASUREMENT
/begin MEASUREMENT v_igc_td_end[1] "Dwell time adaptation voltage acquisition" UWORD _CNV_A_R_IGRE_LINEA_47_CM 1 0. 0. 4.99992370605469 ECU_ADDRESS 0xd0003d3e FORMAT "%6.4" /end MEASUREMENT
/begin MEASUREMENT v_igc_td_end[2] "Dwell time adaptation voltage acquisition" UWORD _CNV_A_R_IGRE_LINEA_47_CM 1 0. 0. 4.99992370605469 ECU_ADDRESS 0xd0003d40 FORMAT "%6.4" /end MEASUREMENT
/begin MEASUREMENT v_igc_td_end[3] "Dwell time adaptation voltage acquisition" UWORD _CNV_A_R_IGRE_LINEA_47_CM 1 0. 0. 4.99992370605469 ECU_ADDRESS 0xd0003d42 FORMAT "%6.4" /end MEASUREMENT
/begin CHARACTERISTIC c_cur_ad_min "Minimum primary current for valid sample" VALUE 0xa0020710 _REC_S1VAL_20_u2 81.99874877929692 _CNV_A_R_IGRE_LINEA_46_CM 0. 81.9987487792969 FORMAT "%9.6" /end CHARACTERISTIC
/begin CHARACTERISTIC c_fac_cur_ad_bas "Factor for current sample acquisition correction" VALUE 0xa0020718 _REC_S1VAL_20_u2 1.99996948242188 _CNV_A_R_LINEAR_____49_CM 0. 1.99996948242188 FORMAT "%7.5" /end CHARACTERISTIC
/begin CHARACTERISTIC c_fac_td_ad_cor "Gain of adaptation factor filter" VALUE 0xa0020741 _REC_S1VAL_20_u1 0.99609375 _CNV_A_R_LINEAR_____31_CM 0. 0.99609375 FORMAT "%5.3" /end CHARACTERISTIC
/begin CHARACTERISTIC c_fac_td_ad_igc "Factor for current sample mean value" VALUE 0xa002071a _REC_S1VAL_20_u2 0.9999847412109381 _CNV_A_R_LINEAR_____9_CM 0. 0.9999847412109381 FORMAT "%7.5" /end CHARACTERISTIC
/begin CHARACTERISTIC c_fac_td_ad_max "Maximum dwell time adaptative corrective offset" VALUE 0xa002071c _REC_S1VAL_20_u2 1.99996948242188 _CNV_A_R_LINEAR_____49_CM 0. 1.99996948242188 FORMAT "%7.5" /end CHARACTERISTIC
/begin CHARACTERISTIC c_fac_td_ad_min "Minimum dwell time adaptative corrective factor" VALUE 0xa002071e _REC_S1VAL_20_u2 1.99996948242188 _CNV_A_R_LINEAR_____49_CM 0. 1.99996948242188 FORMAT "%7.5" /end CHARACTERISTIC
/begin CHARACTERISTIC c_td_ad_ini_conf "Configuration of the initialisation strategy" VALUE 0xa0020755 _REC_S1VAL_20_u1 1. _CNV_A_R_ECME_LINEA_0_CM 0. 1. FORMAT "%1.0" /end CHARACTERISTIC
/begin CHARACTERISTIC lc_td_ad_clr "Logical value enabling reset of variables FAC_TD_AD[x]" VALUE 0xa0020762 _REC_S1VAL_20_u1 1. _CNV_A_R_ECME_LINEA_0_CM 0. 1. FORMAT "%1.0" /end CHARACTERISTIC
/begin AXIS_PTS ldpm_n32_ip_cur_ad_sp "" 0xa0027264 n_32 _REC_A2AXS_20_u1 8160. _CNV_A_R_LINEAR_____2_CM 8 0. 8160. FORMAT "%4.0" /end AXIS_PTS
/begin CHARACTERISTIC ip_cur_ad_sp "Current target" CURVE 0xa0027288 _REC_A1CUR_20_u2_u1 81.99874877929692 _CNV_A_R_IGRE_LINEA_46_CM 0. 81.9987487792969 FORMAT "%9.6"
 /begin AXIS_DESCR COM_AXIS n_32 _CNV_A_R_LINEAR_____2_CM 8 0. 8160. FORMAT "%4.0" AXIS_PTS_REF ldpm_n32_ip_cur_ad_sp /end AXIS_DESCR
/end CHARACTERISTIC
/begin CHARACTERISTIC ip_cur_ad_sp_st "Current target during start boost phase" CURVE 0xa0027298 _REC_A1CUR_20_u2_u1 81.99874877929692 _CNV_A_R_IGRE_LINEA_46_CM 0. 81.9987487792969 FORMAT "%9.6"
 /begin AXIS_DESCR COM_AXIS n_32 _CNV_A_R_LINEAR_____2_CM 8 0. 8160. FORMAT "%4.0" AXIS_PTS_REF ldpm_n32_ip_cur_ad_sp /end AXIS_DESCR
/end CHARACTERISTIC
/begin CHARACTERISTIC ip_cur_ad_sp_tra "Current target" CURVE 0xa00272a8 _REC_A1CUR_20_u2_u1 81.99874877929692 _CNV_A_R_IGRE_LINEA_46_CM 0. 81.9987487792969 FORMAT "%9.6"
 /begin AXIS_DESCR COM_AXIS n_32 _CNV_A_R_LINEAR_____2_CM 8 0. 8160. FORMAT "%4.0" AXIS_PTS_REF ldpm_n32_ip_cur_ad_sp /end AXIS_DESCR
/end CHARACTERISTIC
/begin MEASUREMENT cur_ad_sp "Corrected current target" UWORD _CNV_A_R_IGRE_LINEA_46_CM 1 0. 0. 81.9987487792969 ECU_ADDRESS 0xd00031a4 FORMAT "%9.6" /end MEASUREMENT
/begin MEASUREMENT lv_inh_td_ad "Flag indicating that dwell time adaptive function is inhibited" UBYTE _CNV_S_2_RANGE______3_CM 1 0. 0. 1. ECU_ADDRESS 0xd0004460 BIT_MASK 0x1 /end MEASUREMENT
/begin MEASUREMENT LV_TD_AD_INI_REQ "Flag indicating that dwell time adaptive function must be intialised with 1" UBYTE _CNV_S_2_RANGE______3_CM 1 0. 0. 1. DISPLAY_IDENTIFIER lv_td_ad_ini_req ECU_ADDRESS 0xd0004461 BIT_MASK 0x1 /end MEASUREMENT
/begin CHARACTERISTIC c_cur_ad_sp_ofs "offset on the current target" VALUE 0xa0020712 _REC_S1VAL_20_u2 81.99874877929692 _CNV_A_R_IGRE_LINEA_46_CM 0. 81.9987487792969 FORMAT "%9.6" /end CHARACTERISTIC
/begin CHARACTERISTIC c_vb_td_ad_max "Maximum battery voltage for dwell time adaptation correction" VALUE 0xa002075e _REC_S1VAL_20_u1 25.8984375 _CNV_A_R_LINEAR_____41_CM 0. 25.8984375 FORMAT "%9.6" /end CHARACTERISTIC
/begin CHARACTERISTIC c_vb_td_ad_min "Minimum battery voltage for dwell time adaptation correction" VALUE 0xa002075f _REC_S1VAL_20_u1 25.8984375 _CNV_A_R_LINEAR_____41_CM 0. 25.8984375 FORMAT "%9.6" /end CHARACTERISTIC
/begin CHARACTERISTIC lc_td_ad_ini_lih "Deactivation bit of the initialisation and freeze of dwell time adaptation in case of LIH mode for ignition in case of CAM error" VALUE 0xa0020763 _REC_S1VAL_20_u1 1. _CNV_A_R_ECME_LINEA_0_CM 0. 1. FORMAT "%1.0" /end CHARACTERISTIC
/begin CHARACTERISTIC lc_td_ad_st "Deactivation bit of the adaptative dwell time strategy in start phase" VALUE 0xa0020764 _REC_S1VAL_20_u1 1. _CNV_A_R_ECME_LINEA_0_CM 0. 1. FORMAT "%1.0" /end CHARACTERISTIC
/begin CHARACTERISTIC lc_td_ad_tra "Deactivation bit of the adaptative dwell time strategy in transient phase" VALUE 0xa0020765 _REC_S1VAL_20_u1 1. _CNV_A_R_ECME_LINEA_0_CM 0. 1. FORMAT "%1.0" /end CHARACTERISTIC
/begin MEASUREMENT Vxx_mv_ad_lsm_ctr "Learning  counter to adaptative least square method" UWORD _CNV_A_R_ECME_LINEA_0_CM 1 0. 0. 65535. DISPLAY_IDENTIFIER CbRicCtl_NVM.Vxx_mv_ad_lsm_ctr_NVM ECU_ADDRESS 0xd00035ec FORMAT "%5.0" /end MEASUREMENT
/begin MEASUREMENT Vxx_mv_ti_ad_ofs "Mean adaptation offset on injection time" SBYTE _CNV_A_R_LINEAR_____50_CM 1 0. -512. 508. DISPLAY_IDENTIFIER CbRicCtl_NVM.Vxx_mv_ti_ad_ofs_NVM ECU_ADDRESS 0xd00035ee FORMAT "%1.0" /end MEASUREMENT
/begin MEASUREMENT Vxx_mv_ti_ad_fac "Mean adaptation factor on injection time" UBYTE _CNV_A_R_LINEAR_____51_CM 1 0. 0.6666667 1.3307292 DISPLAY_IDENTIFIER CbRicCtl_NVM.Vxx_mv_ti_ad_fac_NVM ECU_ADDRESS 0xd00035ef FORMAT "%5.3" /end MEASUREMENT
/begin MEASUREMENT Vtd_max_ti_b[0] "Maximum gap compared to the initial  linear" UBYTE _CNV_A_R_ECME_LINEA_0_CM 1 0. 0. 255. DISPLAY_IDENTIFIER CbRicCtl_NVM.Vtd_max_ti_b_NVM[0] ECU_ADDRESS 0xd00035f0 FORMAT "%3.0" /end MEASUREMENT
/begin MEASUREMENT Vtd_max_ti_b[1] "Maximum gap compared to the initial  linear" UBYTE _CNV_A_R_ECME_LINEA_0_CM 1 0. 0. 255. DISPLAY_IDENTIFIER CbRicCtl_NVM.Vtd_max_ti_b_NVM[1] ECU_ADDRESS 0xd00035f1 FORMAT "%3.0" /end MEASUREMENT
/begin MEASUREMENT Vtd_max_ti_b[2] "Maximum gap compared to the initial  linear" UBYTE _CNV_A_R_ECME_LINEA_0_CM 1 0. 0. 255. DISPLAY_IDENTIFIER CbRicCtl_NVM.Vtd_max_ti_b_NVM[2] ECU_ADDRESS 0xd00035f2 FORMAT "%3.0" /end MEASUREMENT
/begin MEASUREMENT Vtd_max_ti_b[3] "Maximum gap compared to the initial  linear" UBYTE _CNV_A_R_ECME_LINEA_0_CM 1 0. 0. 255. DISPLAY_IDENTIFIER CbRicCtl_NVM.Vtd_max_ti_b_NVM[3] ECU_ADDRESS 0xd00035f3 FORMAT "%3.0" /end MEASUREMENT
/begin MEASUREMENT Vtd_max_ti_b[4] "Maximum gap compared to the initial  linear" UBYTE _CNV_A_R_ECME_LINEA_0_CM 1 0. 0. 255. DISPLAY_IDENTIFIER CbRicCtl_NVM.Vtd_max_ti_b_NVM[4] ECU_ADDRESS 0xd00035f4 FORMAT "%3.0" /end MEASUREMENT
/begin MEASUREMENT Vtd_min_ti_b[0] "Minimum gap compared to the initial  linear" UBYTE _CNV_A_R_ECME_LINEA_0_CM 1 0. 0. 255. DISPLAY_IDENTIFIER CbRicCtl_NVM.Vtd_min_ti_b_NVM[0] ECU_ADDRESS 0xd00035f6 FORMAT "%3.0" /end MEASUREMENT
/begin MEASUREMENT Vtd_min_ti_b[1] "Minimum gap compared to the initial  linear" UBYTE _CNV_A_R_ECME_LINEA_0_CM 1 0. 0. 255. DISPLAY_IDENTIFIER CbRicCtl_NVM.Vtd_min_ti_b_NVM[1] ECU_ADDRESS 0xd00035f7 FORMAT "%3.0" /end MEASUREMENT
/begin MEASUREMENT Vtd_min_ti_b[2] "Minimum gap compared to the initial  linear" UBYTE _CNV_A_R_ECME_LINEA_0_CM 1 0. 0. 255. DISPLAY_IDENTIFIER CbRicCtl_NVM.Vtd_min_ti_b_NVM[2] ECU_ADDRESS 0xd00035f8 FORMAT "%3.0" /end MEASUREMENT
/begin MEASUREMENT Vtd_min_ti_b[3] "Minimum gap compared to the initial  linear" UBYTE _CNV_A_R_ECME_LINEA_0_CM 1 0. 0. 255. DISPLAY_IDENTIFIER CbRicCtl_NVM.Vtd_min_ti_b_NVM[3] ECU_ADDRESS 0xd00035f9 FORMAT "%3.0" /end MEASUREMENT
/begin MEASUREMENT Vtd_min_ti_b[4] "Minimum gap compared to the initial  linear" UBYTE _CNV_A_R_ECME_LINEA_0_CM 1 0. 0. 255. DISPLAY_IDENTIFIER CbRicCtl_NVM.Vtd_min_ti_b_NVM[4] ECU_ADDRESS 0xd00035fa FORMAT "%3.0" /end MEASUREMENT
/begin MEASUREMENT Vbx_ti_ad4_zon "4 of the 5 zones engine learned" UBYTE _CNV_S_2_RANGE______3_CM 1 0. 0. 1. DISPLAY_IDENTIFIER CbRicCtl_NVM.Vbx_ti_ad4_zon_NVM ECU_ADDRESS 0xd00035fb BIT_MASK 0x1 /end MEASUREMENT
/begin MEASUREMENT Vtd_ti_ad1_zon[0] "Boolean information \"at least one learning in the zone\"" UBYTE _CNV_S_2_RANGE______3_CM 1 0. 0. 1. DISPLAY_IDENTIFIER CbRicCtl_NVM.Vtd_ti_ad1_zon_NVM[0] ECU_ADDRESS 0xd00035fc /end MEASUREMENT
/begin MEASUREMENT Vtd_ti_ad1_zon[1] "Boolean information \"at least one learning in the zone\"" UBYTE _CNV_S_2_RANGE______3_CM 1 0. 0. 1. DISPLAY_IDENTIFIER CbRicCtl_NVM.Vtd_ti_ad1_zon_NVM[1] ECU_ADDRESS 0xd00035fd /end MEASUREMENT
/begin MEASUREMENT Vtd_ti_ad1_zon[2] "Boolean information \"at least one learning in the zone\"" UBYTE _CNV_S_2_RANGE______3_CM 1 0. 0. 1. DISPLAY_IDENTIFIER CbRicCtl_NVM.Vtd_ti_ad1_zon_NVM[2] ECU_ADDRESS 0xd00035fe /end MEASUREMENT
/begin MEASUREMENT Vtd_ti_ad1_zon[3] "Boolean information \"at least one learning in the zone\"" UBYTE _CNV_S_2_RANGE______3_CM 1 0. 0. 1. DISPLAY_IDENTIFIER CbRicCtl_NVM.Vtd_ti_ad1_zon_NVM[3] ECU_ADDRESS 0xd00035ff /end MEASUREMENT
/begin MEASUREMENT Vtd_ti_ad1_zon[4] "Boolean information \"at least one learning in the zone\"" UBYTE _CNV_S_2_RANGE______3_CM 1 0. 0. 1. DISPLAY_IDENTIFIER CbRicCtl_NVM.Vtd_ti_ad1_zon_NVM[4] ECU_ADDRESS 0xd0003600 /end MEASUREMENT
/begin MEASUREMENT ctr_eng_psn_chk_err "Counter of mismatch between engine position and segment number" UWORD _CNV_A_R_ECME_LINEA_0_CM 1 0. 0. 65535. ECU_ADDRESS 0xd0003bfa FORMAT "%5.0" /end MEASUREMENT
/begin MEASUREMENT lv_eng_psn_chk_err "Flag indicating a mismatch between engine position and segment number" UBYTE _CNV_S_2_RANGE______3_CM 1 0. 0. 1. ECU_ADDRESS 0xd000401e BIT_MASK 0x1 /end MEASUREMENT
/begin MEASUREMENT abc_conv_mon "Anti bounce counter ADC error" UBYTE _CNV_A_R_ECME_LINEA_0_CM 1 0. 0. 255. ECU_ADDRESS 0xd0005c66 FORMAT "%3.0" /end MEASUREMENT
/begin MEASUREMENT lv_err_conv_mon "Logical variable for ADC error" UBYTE _CNV_S_2_RANGE______3_CM 1 0. 0. 1. ECU_ADDRESS 0xd0005c67 BIT_MASK 0x1 /end MEASUREMENT
/begin CHARACTERISTIC c_abc_inc_conv_mon "Anti bounce counter increment (additive value in case of ADC error)" VALUE 0xa0021f4e _REC_S1VAL_20_u1 255. _CNV_A_R_ECME_LINEA_0_CM 0. 255. FORMAT "%3.0" /end CHARACTERISTIC
/begin CHARACTERISTIC c_abc_max_conv_mon "Value at which ADC error is recognized, when reached" VALUE 0xa0021f4f _REC_S1VAL_20_u1 254. _CNV_A_R_ECME_LINEA_0_CM 1. 255. FORMAT "%3.0" /end CHARACTERISTIC
/begin CHARACTERISTIC c_state_an_dig_err_act_mon "Calibratable value used for provoking an error of the A/D conversion" VALUE 0xa0021f50 _REC_S1VAL_20_u1 255. _CNV_A_R_ECME_LINEA_0_CM 0. 255. FORMAT "%3.0" /end CHARACTERISTIC
/begin CHARACTERISTIC c_vp_acq_conv_hys_mon "Maximum allowed difference between the voltage on main controller and on monitoring unit" VALUE 0xa0021f4c _REC_S1VAL_20_u2 4.99984741210938 _CNV_A_R_LINEAR_____16_CM 0. 4.99984741210938 FORMAT "%6.4" /end CHARACTERISTIC
/begin AXIS_PTS ldpm_test_rec_idx_mon2 "" 0xa002c320 test_rec_idx_mon2 _REC_A2AXS_20_u1 31. _CNV_A_R_ECME_LINEA_0_CM 15 0. 31. FORMAT "%2.0" /end AXIS_PTS
/begin CHARACTERISTIC id_Vsx_sfty2_ant_coup_vld "Assignment table for Vsx_sfty2_ant_coup_vld decoder of copy of process monitoring" CURVE 0xa002c8a8 _REC_A1CUR_20_u1_u1 2. _CNV_A_R_ECME_LINEA_0_CM 0. 2. FORMAT "%1.0"
 /begin AXIS_DESCR COM_AXIS test_rec_idx_mon2 _CNV_A_R_ECME_LINEA_0_CM 15 0. 31. FORMAT "%2.0" AXIS_PTS_REF ldpm_test_rec_idx_mon2 /end AXIS_DESCR
/end CHARACTERISTIC
/begin MEASUREMENT Vbx_sfty2_acel_pdl_fil_sens_v1 "Accelerator pedal sensor track 1 evolution condition for safety" UBYTE _CNV_S_2_RANGE______3_CM 1 0. 0. 1. ECU_ADDRESS 0xd0005d19 BIT_MASK 0x1 /end MEASUREMENT
/begin MEASUREMENT Vbx_sfty2_acel_pdl_fil_sens_v2 "Accelerator pedal sensor track 2 evolution condition for safety" UBYTE _CNV_S_2_RANGE______3_CM 1 0. 0. 1. ECU_ADDRESS 0xd0005d1a BIT_MASK 0x1 /end MEASUREMENT
/begin MEASUREMENT Vbx_sfty2_cru_tq_req_plau "A cruise control torque request is plausible" UBYTE _CNV_S_2_RANGE______3_CM 1 0. 0. 1. ECU_ADDRESS 0xd0005d18 BIT_MASK 0x1 /end MEASUREMENT
/begin MEASUREMENT Vbx_sfty2_df_sfty_tq_chr "ECM torque plausibility detected failure" UBYTE _CNV_S_2_RANGE______3_CM 1 0. 0. 1. ECU_ADDRESS 0xd0005d1e BIT_MASK 0x1 /end MEASUREMENT
/begin MEASUREMENT Vbx_sfty2_df_sfty_tq_clc_chr "ECM torque calculation plausibility detected failure" UBYTE _CNV_S_2_RANGE______3_CM 1 0. 0. 1. ECU_ADDRESS 0xd0005d2f BIT_MASK 0x1 /end MEASUREMENT
/begin MEASUREMENT Vbx_sfty2_df_sfty_tq_lih_chr "throttle limp home for safety detected failure" UBYTE _CNV_S_2_RANGE______3_CM 1 0. 0. 1. ECU_ADDRESS 0xd0005d1f BIT_MASK 0x1 /end MEASUREMENT
/begin MEASUREMENT Vbx_sfty2_ext_ctrl_ena "External controls safety authorization flag" UBYTE _CNV_S_2_RANGE______3_CM 1 0. 0. 1. ECU_ADDRESS 0xd00054e9 BIT_MASK 0x1 /end MEASUREMENT
/begin MEASUREMENT Vbx_sfty2_igk "Ignition key signal" UBYTE _CNV_S_2_RANGE______3_CM 1 0. 0. 1. ECU_ADDRESS 0xd00054ea BIT_MASK 0x1 /end MEASUREMENT
/begin MEASUREMENT Vbx_sfty2_lih_mon_ena "Throttle limp home monitoring enabled" UBYTE _CNV_S_2_RANGE______3_CM 1 0. 0. 1. ECU_ADDRESS 0xd0005d29 BIT_MASK 0x1 /end MEASUREMENT
/begin MEASUREMENT Vbx_sfty2_prev_df_sfty_tq_chr "Previous value of ECM torque plausibility detected failure" UBYTE _CNV_S_2_RANGE______3_CM 1 0. 0. 1. ECU_ADDRESS 0xd0005d20 BIT_MASK 0x1 /end MEASUREMENT
/begin MEASUREMENT Vbx_sfty2_pwst_prs_stt "Power steering manostat activation" UBYTE _CNV_S_2_RANGE______3_CM 1 0. 0. 1. ECU_ADDRESS 0xd00054e8 BIT_MASK 0x1 /end MEASUREMENT
/begin MEASUREMENT Vbx_sfty2_rst_req "ECU reset request by safety monitoring" UBYTE _CNV_S_2_RANGE______3_CM 1 0. 0. 1. ECU_ADDRESS 0xd0005d28 BIT_MASK 0x1 /end MEASUREMENT
/begin MEASUREMENT Vbx_sfty2_sfty_aftr_rst "After an ECU reset requested safety monitoring" UBYTE _CNV_S_2_RANGE______3_CM 1 0. 0. 1. ECU_ADDRESS 0xd0005d21 BIT_MASK 0x1 /end MEASUREMENT
/begin MEASUREMENT Vbx_sfty2_sfty_aftr_rst_ini "In the initial period after an ECU reset requested safety monitoring" UBYTE _CNV_S_2_RANGE______3_CM 1 0. 0. 1. ECU_ADDRESS 0xd0005d2a BIT_MASK 0x1 /end MEASUREMENT
/begin MEASUREMENT Vbx_sfty2_sfty_aftr_rst_mem "After an ECU reset requested safety monitoring (stored in hot-reset proof memory)" UBYTE _CNV_S_2_RANGE______3_CM 1 0. 0. 1. ECU_ADDRESS 0xd0005d22 BIT_MASK 0x1 /end MEASUREMENT
/begin MEASUREMENT Vbx_sfty2_sfty_agb_tq_req_plau "Torque requests by AGB are plausible" UBYTE _CNV_S_2_RANGE______3_CM 1 0. 0. 1. ECU_ADDRESS 0xd0005d1b BIT_MASK 0x1 /end MEASUREMENT
/begin MEASUREMENT Vbx_sfty2_sfty_diag_ena_tqi "boolean which indicates that the diagnosis conditions are ok" UBYTE _CNV_S_2_RANGE______3_CM 1 0. 0. 1. ECU_ADDRESS 0xd0005d31 BIT_MASK 0x1 /end MEASUREMENT
/begin MEASUREMENT Vbx_sfty2_sfty_esti_tqi_nok "boolean which indicates that torque realization is not coherent with safe torque" UBYTE _CNV_S_2_RANGE______3_CM 1 0. 0. 1. ECU_ADDRESS 0xd0005d2b BIT_MASK 0x1 /end MEASUREMENT
/begin MEASUREMENT Vbx_sfty2_sfty_esti_tqi_nok_tmp "boolean which indicates that torque realization is temporarly not coherent with safe torque" UBYTE _CNV_S_2_RANGE______3_CM 1 0. 0. 1. ECU_ADDRESS 0xd0005d23 BIT_MASK 0x1 /end MEASUREMENT
/begin MEASUREMENT Vbx_sfty2_sfty_moni_bch_ok "Monitool or bench mode are active" UBYTE _CNV_S_2_RANGE______3_CM 1 0. 0. 1. ECU_ADDRESS 0xd0005d24 BIT_MASK 0x1 /end MEASUREMENT
/begin MEASUREMENT Vbx_sfty2_sfty_msr_tq_req_plau "Torque requests by MSR are plausible" UBYTE _CNV_S_2_RANGE______3_CM 1 0. 0. 1. ECU_ADDRESS 0xd0005d1c BIT_MASK 0x1 /end MEASUREMENT
/begin MEASUREMENT Vbx_sfty2_sfty_tq_mon_nok "boolean which indicates a failure detection in the torque structure for safety" UBYTE _CNV_S_2_RANGE______3_CM 1 0. 0. 1. ECU_ADDRESS 0xd0005d25 BIT_MASK 0x1 /end MEASUREMENT
/begin MEASUREMENT Vbx_sfty2_sfty_tqi_sp_nok "Boolean which indicates that main torque request is not coherent with safe torque request" UBYTE _CNV_S_2_RANGE______3_CM 1 0. 0. 1. ECU_ADDRESS 0xd0005d26 BIT_MASK 0x1 /end MEASUREMENT
/begin MEASUREMENT Vbx_sfty2_sfty_tqi_sp_nok_tmp "Boolean which indicates that main torque request is temporarly not coherent with safe torque request" UBYTE _CNV_S_2_RANGE______3_CM 1 0. 0. 1. ECU_ADDRESS 0xd0005d27 BIT_MASK 0x1 /end MEASUREMENT
/begin MEASUREMENT Vbx_sfty2_stop_req "Engine stop request by safety monitoring" UBYTE _CNV_S_2_RANGE______3_CM 1 0. 0. 1. ECU_ADDRESS 0xd0005d30 BIT_MASK 0x1 /end MEASUREMENT
/begin MEASUREMENT Vbx_sfty2_stop_req_aftr_rst "Engine stop request by safety monitoring (sfter reset value)" UBYTE _CNV_S_2_RANGE______3_CM 1 0. 0. 1. ECU_ADDRESS 0xd0005d2c BIT_MASK 0x1 /end MEASUREMENT
/begin MEASUREMENT Vbx_sfty2_stop_req_mem "Engine stop request by safety monitoring (stored in hot-reset proof memory)" UBYTE _CNV_S_2_RANGE______3_CM 1 0. 0. 1. ECU_ADDRESS 0xd0005d2e BIT_MASK 0x1 /end MEASUREMENT
/begin MEASUREMENT Vbx_sfty2_thr_lih_mon_nok "boolean which indicates that the throttle limp home doesn't execut correctly for safety" UBYTE _CNV_S_2_RANGE______3_CM 1 0. 0. 1. ECU_ADDRESS 0xd0005d1d /end MEASUREMENT
/begin MEASUREMENT Vbx_sfty2_thr_lih_mon_nok_fil "throttle limp home doesn't execut correctly for safety (filtered)" UBYTE _CNV_S_2_RANGE______3_CM 1 0. 0. 1. ECU_ADDRESS 0xd0005d2d BIT_MASK 0x1 /end MEASUREMENT
/begin MEASUREMENT Vsx_sfty2_acel_pdl_sens_v1_vld "Accelerator pedal sensor output voltage : track 1 validity status" UBYTE _CNV_S_2_STATUS_OK__188_CM 1 0. 0. 1. ECU_ADDRESS 0xd00054ef /end MEASUREMENT
/begin MEASUREMENT Vsx_sfty2_ant_coup_vld "Anticipated (forecast) transmission coupler state validity status" UBYTE _CNV_A_R_ECME_LINEA_0_CM 1 0. 0. 2. ECU_ADDRESS 0xd00054f0 FORMAT "%1.0" /end MEASUREMENT
/begin MEASUREMENT Vsx_sfty2_brk_pdl "Brake pedal states" UBYTE _CNV_S_3_STATUS_BRK_159_CM 1 0. 1. 4. ECU_ADDRESS 0xd00054eb /end MEASUREMENT
/begin MEASUREMENT Vsx_sfty2_cata_wup_phs "State of catalist warm-up" UBYTE _CNV_A_R_ECME_LINEA_0_CM 1 0. 0. 70. ECU_ADDRESS 0xd00054f1 FORMAT "%3.0" /end MEASUREMENT
/begin MEASUREMENT Vsx_sfty2_dlin_conf "State data of driveline configuration (Transmission type)." UBYTE _CNV_A_R_ECME_LINEA_0_CM 1 0. 0. 255. ECU_ADDRESS 0xd00054f2 FORMAT "%3.0" /end MEASUREMENT
/begin MEASUREMENT Vsx_sfty2_driv_pwt_sp_vld "Powertrain setpoint (%) requested by real (pedal) and virtual (ACC/CC/SL) drivers validity status" UBYTE _CNV_A_R_ECME_LINEA_0_CM 1 0. 0. 255. ECU_ADDRESS 0xd00054ec FORMAT "%3.0" /end MEASUREMENT
/begin MEASUREMENT Vsx_sfty2_ecm_mon_vld "Internal Control Module Monitoring Processor Performance validity status" UBYTE _CNV_S_8_STATUS_OK__181_CM 1 0. 0. 7. ECU_ADDRESS 0xd00054f3 /end MEASUREMENT
/begin MEASUREMENT Vsx_sfty2_eng "Engine states" UBYTE _CNV_A_R_ECME_LINEA_0_CM 1 0. 0. 255. ECU_ADDRESS 0xd00054f4 FORMAT "%3.0" /end MEASUREMENT
/begin MEASUREMENT Vsx_sfty2_it_vld "Inlet throttle validity status" UBYTE _CNV_A_R_ECME_LINEA_0_CM 1 0. 0. 255. ECU_ADDRESS 0xd00054f5 FORMAT "%3.0" /end MEASUREMENT
/begin MEASUREMENT Vsx_sfty2_map_vld "Manifold pressure validity status" UBYTE _CNV_A_R_ECME_LINEA_0_CM 1 0. 0. 2. ECU_ADDRESS 0xd00054f6 FORMAT "%1.0" /end MEASUREMENT
/begin MEASUREMENT Vsx_sfty2_tq_mon_vld "Safety torque monitoring validity status" UBYTE _CNV_S_2_STATUS_OK__214_CM 1 0. 0. 1. ECU_ADDRESS 0xd0005d48 /end MEASUREMENT
/begin MEASUREMENT Vsx_sfty2_vs_vld "Vehicule speed validity status" UBYTE _CNV_S_3_STATUS_OK__120_CM 1 0. 0. 2. ECU_ADDRESS 0xd00054f7 /end MEASUREMENT
/begin MEASUREMENT Vxx_sfty2_ac_pow "Air conditioning absorbed power (compressor)" UWORD _CNV_A_R_LINEAR_____128_CM 1 0. 0. 655350. ECU_ADDRESS 0xd0003bc0 FORMAT "%6.0" /end MEASUREMENT
/begin MEASUREMENT Vxx_sfty2_acel_pdl_fil_sens_v1 "Filtered accelerator pedal sensor output voltage : track 1 for safety" UWORD _CNV_A_R_LINEAR_____125_CM 1 0. 0. 0.9990234375 ECU_ADDRESS 0xd0005cea FORMAT "%11.9" /end MEASUREMENT
/begin MEASUREMENT Vxx_sfty2_acel_pdl_fil_sens_v2 "Filtered accelerator pedal sensor output voltage : track 2 for safety" UWORD _CNV_A_R_LINEAR_____125_CM 1 0. 0. 0.9990234375 ECU_ADDRESS 0xd0005cec FORMAT "%11.9" /end MEASUREMENT
/begin MEASUREMENT Vxx_sfty2_acel_pdl_rat "Normalised accelerator pedal position (for safety)" UWORD _CNV_A_R_LINEAR_____257_CM 1 0. 0. 1.25 ECU_ADDRESS 0xd0005ce4 FORMAT "%7.5" /end MEASUREMENT
/begin MEASUREMENT Vxx_sfty2_acel_pdl_sens_rat1 "Accelerator pedal sensor output voltage ratio : track 1 for safety" UWORD _CNV_A_R_LINEAR_____125_CM 1 0. 0. 0.9990234375 ECU_ADDRESS 0xd0005cee FORMAT "%11.9" /end MEASUREMENT
/begin MEASUREMENT Vxx_sfty2_acel_pdl_sens_rat2 "Accelerator pedal sensor output voltage ratio : track 2 for safety" UWORD _CNV_A_R_LINEAR_____125_CM 1 0. 0. 0.9990234375 ECU_ADDRESS 0xd0005cf0 FORMAT "%11.9" /end MEASUREMENT
/begin MEASUREMENT Vxx_sfty2_acel_pdl_sens_v1 "Copy of accelerator pedal sensor output voltage : track 1 for safety monitoring" UWORD _CNV_A_R_LINEAR_____52_CM 1 0. 0. 25000. ECU_ADDRESS 0xd0003bb6 FORMAT "%5.0" /end MEASUREMENT
/begin MEASUREMENT Vxx_sfty2_acel_pdl_sens_v2 "Accelerator pedal sensor output voltage : track 2" UWORD _CNV_A_R_LINEAR_____52_CM 1 0. 0. 25000. ECU_ADDRESS 0xd0003bb4 FORMAT "%5.0" /end MEASUREMENT
/begin MEASUREMENT Vxx_sfty2_agb_csm_tq "coupler torque losses" UWORD _CNV_A_R_LINEAR_____161_CM 1 0. -400. 1647.96875 ECU_ADDRESS 0xd0003bb8 FORMAT "%11.5" /end MEASUREMENT
/begin MEASUREMENT Vxx_sfty2_agb_min_tqe_tgt "Slow request wich will be sent to torque arbitration in min bloc" UWORD _CNV_A_R_LINEAR_____161_CM 1 0. -400. 1647.96875 ECU_ADDRESS 0xd0003bba FORMAT "%10.5" /end MEASUREMENT
/begin MEASUREMENT Vxx_sfty2_ant_coup "Anticipated (forecast) transmission coupler state" UBYTE _CNV_A_R_ECME_LINEA_0_CM 1 0. 0. 255. ECU_ADDRESS 0xd00054f8 FORMAT "%3.0" /end MEASUREMENT
/begin MEASUREMENT Vxx_sfty2_cru_pwt_sp "Powertrain setpoint (%) requested by Cruise Control" UWORD _CNV_A_R_LINEAR_____185_CM 1 0. 0. 1. ECU_ADDRESS 0xd0003bae FORMAT "%7.5" /end MEASUREMENT
/begin MEASUREMENT Vxx_sfty2_driv_pwt_sp "Powertrain setpoint (%) requested by real (pedal) and virtual (ACC/CC/SL) drivers" UWORD _CNV_A_R_LINEAR_____185_CM 1 0. 0. 1. ECU_ADDRESS 0xd0003bb0 FORMAT "%7.5" /end MEASUREMENT
/begin MEASUREMENT Vxx_sfty2_driv_spt_fac "Driver sportivity factor, including 'slow' and 'fast' adaptation algorithms" UBYTE _CNV_A_R_LINEAR_____118_CM 1 0. 0. 1. ECU_ADDRESS 0xd00054ed FORMAT "%9.7" /end MEASUREMENT
/begin MEASUREMENT Vxx_sfty2_eng_tql "Engine torque losses for safety" UWORD _CNV_A_R_LINEAR_____123_CM 1 0. 0. 2047.96875 ECU_ADDRESS 0xd0005d00 FORMAT "%10.5" /end MEASUREMENT
/begin MEASUREMENT Vxx_sfty2_esti_tqi "Estimated indicated torque from manifold air pressure (for safety)" UWORD _CNV_A_R_LINEAR_____123_CM 1 0. 0. 2047.96875 ECU_ADDRESS 0xd0005ce2 FORMAT "%10.5" /end MEASUREMENT
/begin MEASUREMENT Vxx_sfty2_esti_tqi_t_fil_min "Positive error authorised between main and safe torque for safety (min-over-time filtered)" UWORD _CNV_A_R_LINEAR_____123_CM 1 0. 0. 2047.96875 ECU_ADDRESS 0xd0005d08 FORMAT "%10.5" /end MEASUREMENT
/begin MEASUREMENT Vxx_sfty2_fil_alt_pow "Filtered alternator mechanical power" UWORD _CNV_A_R_LINEAR_____128_CM 1 0. 0. 655350. ECU_ADDRESS 0xd0003bc2 FORMAT "%6.0" /end MEASUREMENT
/begin MEASUREMENT Vxx_sfty2_gear "Gear engaged ( [-1 0 1 2 3 4 5 6] )" UBYTE _CNV_A_R_LINEAR_____113_CM 1 0. -1. 6. ECU_ADDRESS 0xd00054ee FORMAT "%2.0" /end MEASUREMENT
/begin MEASUREMENT Vxx_sfty2_inj_avl_nr "Number of available cylinders. (Only failures decrease the number)" UBYTE _CNV_A_R_ECME_LINEA_0_CM 1 0. 0. 12. ECU_ADDRESS 0xd00054f9 FORMAT "%2.0" /end MEASUREMENT
/begin MEASUREMENT Vxx_sfty2_is_ad_tq "Adaptive correction" SWORD _CNV_A_R_LINEAR_____123_CM 1 0. -1024. 1023.96875 ECU_ADDRESS 0xd0003bca FORMAT "%11.5" /end MEASUREMENT
/begin MEASUREMENT Vxx_sfty2_is_i_cor "Integral torque correction of Idle Speed Regulator" SWORD _CNV_A_R_LINEAR_____123_CM 1 0. -1024. 1023.96875 ECU_ADDRESS 0xd0003bd0 FORMAT "%11.5" /end MEASUREMENT
/begin MEASUREMENT Vxx_sfty2_is_n_sp "Final idle speed setpoint" UWORD _CNV_A_R_ENSD_LINEA_24_CM 1 0. 0. 16383.75 ECU_ADDRESS 0xd0003bbc FORMAT "%8.2" /end MEASUREMENT
/begin MEASUREMENT Vxx_sfty2_is_tqe_sp "Setpoint idle speed torque" SWORD _CNV_A_R_LINEAR_____123_CM 1 0. -1024. 1023.96875 ECU_ADDRESS 0xd0003bcc FORMAT "%11.5" /end MEASUREMENT
/begin MEASUREMENT Vxx_sfty2_map "Manifold pressure value " UWORD _CNV_A_R_LINEAR_____57_CM 1 0. 0. 20000. ECU_ADDRESS 0xd0003bac FORMAT "%5.0" /end MEASUREMENT
/begin MEASUREMENT Vxx_sfty2_msr_tqe_sp "MSR torque setting sent to torque arbitration" UWORD _CNV_A_R_LINEAR_____161_CM 1 0. -400. 1647.96875 ECU_ADDRESS 0xd0003bbe FORMAT "%10.5" /end MEASUREMENT
/begin MEASUREMENT Vxx_sfty2_pump_tql "pump torque losses" UWORD _CNV_A_R_LINEAR_____123_CM 1 0. 0. 2047.96875 ECU_ADDRESS 0xd0003bc4 FORMAT "%10.5" /end MEASUREMENT
/begin MEASUREMENT Vxx_sfty2_sfty_acel_pdl_pwt_sp "Powertrain setpoint (%) requested by the driver via the accelerator pedal (for safety)" UWORD _CNV_A_R_LINEAR_____185_CM 1 0. 0. 1. ECU_ADDRESS 0xd0005ce8 FORMAT "%7.5" /end MEASUREMENT
/begin MEASUREMENT Vxx_sfty2_sfty_ajs_modu_tqe "Final Torque after AJS Modulation action for safety" UWORD _CNV_A_R_LINEAR_____161_CM 1 0. -400. 1647.96875 ECU_ADDRESS 0xd0005cf4 FORMAT "%10.5" /end MEASUREMENT
/begin MEASUREMENT Vxx_sfty2_sfty_arb_tqe "Torque before AJS Correction action for safety" UWORD _CNV_A_R_LINEAR_____161_CM 1 0. -400. 1647.96875 ECU_ADDRESS 0xd0005cf6 FORMAT "%10.5" /end MEASUREMENT
/begin MEASUREMENT Vxx_sfty2_sfty_aux_tql_sp "torque losses due to accessories (for safety)" UBYTE _CNV_A_R_LINEAR_____431_CM 1 0. 0. 255. ECU_ADDRESS 0xd0005d40 FORMAT "%3.0" /end MEASUREMENT
/begin MEASUREMENT Vxx_sfty2_sfty_driv_pwt_sp "Powertrain setpoint (%) requested by real (pedal) and virtual (ACC/CC/SL) drivers (for safety)" UWORD _CNV_A_R_LINEAR_____185_CM 1 0. 0. 1. ECU_ADDRESS 0xd0005ce6 FORMAT "%7.5" /end MEASUREMENT
/begin MEASUREMENT Vxx_sfty2_sfty_driv_tqe_sp "Effective engine torque requested by real (pedal) and virtual (ACC/CC/SL) drivers for safety" UWORD _CNV_A_R_LINEAR_____161_CM 1 0. -400. 1647.96875 ECU_ADDRESS 0xd0005cf8 FORMAT "%10.5" /end MEASUREMENT
/begin MEASUREMENT Vxx_sfty2_sfty_esti_err "Positive error authorised between main and safe torque for safety" UWORD _CNV_A_R_LINEAR_____123_CM 1 0. 0. 2047.96875 ECU_ADDRESS 0xd0005d06 FORMAT "%10.5" /end MEASUREMENT
/begin MEASUREMENT Vxx_sfty2_sfty_esti_err_max "Positive error authorised between main and safe torque for safety (max-over-time filtered)" UWORD _CNV_A_R_LINEAR_____123_CM 1 0. 0. 2047.96875 ECU_ADDRESS 0xd0005d02 FORMAT "%10.5" /end MEASUREMENT
/begin MEASUREMENT Vxx_sfty2_sfty_frn_tql "Estimated pumping torque (for safety)" UBYTE _CNV_A_R_LINEAR_____431_CM 1 0. 0. 255. ECU_ADDRESS 0xd0005d41 FORMAT "%3.0" /end MEASUREMENT
/begin MEASUREMENT Vxx_sfty2_sfty_frn_tql_temp "Temperature for engine rubbing torque losses calculation for safety monitoring" UBYTE _CNV_A_R_LINEAR_____220_CM 1 0. -40. 200. ECU_ADDRESS 0xd0005d42 FORMAT "%3.0" /end MEASUREMENT
/begin MEASUREMENT Vxx_sfty2_sfty_lim_driv_tqe "Effective engine torque requested by real (pedal) and virtual (ACC/CC/SL) drivers for safety" UWORD _CNV_A_R_LINEAR_____161_CM 1 0. -400. 1647.96875 ECU_ADDRESS 0xd0005cfa FORMAT "%10.5" /end MEASUREMENT
/begin MEASUREMENT Vxx_sfty2_sfty_min_avl_tqe "minimum available engine torque for safety" UWORD _CNV_A_R_LINEAR_____161_CM 1 0. -400. 1647.96875 ECU_ADDRESS 0xd0005cfc FORMAT "%10.5" /end MEASUREMENT
/begin MEASUREMENT Vxx_sfty2_sfty_n "engine speed for safety monitoring" UBYTE _CNV_A_R_LINEAR_____2_CM 1 0. 0. 8160. ECU_ADDRESS 0xd0005d39 FORMAT "%4.0" /end MEASUREMENT
/begin MEASUREMENT Vxx_sfty2_sfty_n_min_tqe_agb_fac "Input variable for automatic gearbox torque calculation" UBYTE _CNV_A_R_LINEAR_____2_CM 1 0. 0. 8160. ECU_ADDRESS 0xd0005cfe FORMAT "%4.0" /end MEASUREMENT
/begin MEASUREMENT Vxx_sfty2_sfty_tco "Engine coolant temperature for safety" UBYTE _CNV_A_R_LINEAR_____220_CM 1 0. -40. 200. ECU_ADDRESS 0xd0005d44 FORMAT "%3.0" /end MEASUREMENT
/begin MEASUREMENT Vxx_sfty2_sfty_toil "Oil temperature for safety" UBYTE _CNV_A_R_LINEAR_____220_CM 1 0. -40. 200. ECU_ADDRESS 0xd0005d43 FORMAT "%3.0" /end MEASUREMENT
/begin MEASUREMENT Vxx_sfty2_sfty_tq_ffm_data_sf "Torque safety monitoring status flags for snapshot data" UBYTE _CNV_A_R_ECME_LINEA_0_CM 1 0. 0. 255. ECU_ADDRESS 0xd0005d47 FORMAT "%3.0" /end MEASUREMENT
/begin MEASUREMENT Vxx_sfty2_tkof_tqe_cor "take off torque correction" SWORD _CNV_A_R_LINEAR_____123_CM 1 0. -1024. 1023.96875 ECU_ADDRESS 0xd0003bce FORMAT "%11.5" /end MEASUREMENT
/begin MEASUREMENT Vxx_sfty2_toil "Oil temperature" UWORD _CNV_A_R_LINEAR_____54_CM 1 0. -40. 200. ECU_ADDRESS 0xd0003bc6 FORMAT "%5.1" /end MEASUREMENT
/begin MEASUREMENT Vxx_sfty2_tqi_esti_sp_dif "Difference between safety estimation of realized torque and safety estimation of torque setpoint" UWORD _CNV_A_R_LINEAR_____123_CM 1 0. 0. 2047.96875 ECU_ADDRESS 0xd0005d04 FORMAT "%10.5" /end MEASUREMENT
/begin MEASUREMENT Vxx_sfty2_tqi_sp "Final indicated setpoint torque for safety" UWORD _CNV_A_R_LINEAR_____123_CM 1 0. 0. 2047.96875 ECU_ADDRESS 0xd0005cf2 FORMAT "%10.5" /end MEASUREMENT
/begin MEASUREMENT Vxx_sfty2_tqi_sp_no_ajs "Final indicated torque set point without AJCOR correction" UWORD _CNV_A_R_LINEAR_____123_CM 1 0. 0. 2047.96875 ECU_ADDRESS 0xd0003bc8 FORMAT "%10.5" /end MEASUREMENT
/begin MEASUREMENT Vxx_sfty2_tqi_sp_t_fil_max "Final indicated setpoint torque for safety (max-over-time filtered)" UWORD _CNV_A_R_LINEAR_____123_CM 1 0. 0. 2047.96875 ECU_ADDRESS 0xd0005d0a FORMAT "%10.5" /end MEASUREMENT
/begin MEASUREMENT Vxx_sfty2_vs "Vehicle speed" UWORD _CNV_A_R_LINEAR_____70_CM 1 0. 0. 655.35 ECU_ADDRESS 0xd0003bb2 FORMAT "%6.2" /end MEASUREMENT
/begin MEASUREMENT resp_mon2 "Answer of copy of process monitoring (Level 2')" UWORD _CNV_A_R_ECME_LINEA_0_CM 1 0. 0. 65535. ECU_ADDRESS 0xd0005d16 FORMAT "%5.0" /end MEASUREMENT
/begin MEASUREMENT u8_index "Index used for the decoding of u16_sfty2_old_values_fig9, u16_sfty2_old_values_fig10 and u16_sfty2_old_values_fig11 arrays" UBYTE _CNV_A_R_ECME_LINEA_0_CM 1 0. 0. 6. ECU_ADDRESS 0xd00054fa FORMAT "%2.0" /end MEASUREMENT
/begin COMPU_METHOD _CNV_A_R_ECME_LINEA_0_CM "" RAT_FUNC "%6.3" "-" COEFFS 0 1. 0. 0 0 1 /end COMPU_METHOD
/begin COMPU_METHOD _CNV_S_2_ECME_RANGE_1_CM "" TAB_VERB "%6.3" "-" COMPU_TAB_REF _CNV_S_2_ECME_RANGE_1 /end COMPU_METHOD
/begin COMPU_VTAB _CNV_S_2_ECME_RANGE_1 "" TAB_VERB 2 0 "PASSIVE" 1 "ACTIVE" /end COMPU_VTAB
/begin COMPU_METHOD _CNV_A_R_LINEAR_____2_CM "" RAT_FUNC "%6.3" "rpm" COEFFS 0 3.125e-002 0. 0 0 1 /end COMPU_METHOD
/begin COMPU_METHOD _CNV_S_2_RANGE______3_CM "" TAB_VERB "%6.3" "-" COMPU_TAB_REF _CNV_S_2_RANGE______3 /end COMPU_METHOD
/begin COMPU_VTAB _CNV_S_2_RANGE______3 "" TAB_VERB 2 0 "0" 1 "1" /end COMPU_VTAB
/begin COMPU_METHOD _CNV_A_R_CPULOAD__0_7_CM "" RAT_FUNC "%6.3" "%" COEFFS 0 10.24 0. 0 0 1 /end COMPU_METHOD
/begin COMPU_METHOD _CNV_A_R_LINEAR_____8_CM "" RAT_FUNC "%6.3" "ticks" COEFFS 0 1. 0. 0 0 1 /end COMPU_METHOD
/begin COMPU_METHOD _CNV_A_R_LINEAR_____9_CM "" RAT_FUNC "%6.3" "-" COEFFS 0 65535.99999999996 0. 0 0 1 /end COMPU_METHOD
/begin COMPU_METHOD _CNV_S_31_ECM3_ERR_C_10_CM "" TAB_VERB "%6.3" "-" COMPU_TAB_REF _CNV_S_31_ECM3_ERR_C_10 /end COMPU_METHOD
/begin COMPU_VTAB _CNV_S_31_ECM3_ERR_C_10 "" TAB_VERB 31 0 "NOT_ERR" 1 "COM_HD" 2 "COM_CKS" 3 "COM_PAR" 4 "CONF_DIF" 5 "SOPC(MC) or CONF_CPL(MU)" 6 "COMP_NR" 7 "ROM_LEVEL_1(MC) or TOUT_MAX(MU)" 8 "RAM_LEVEL_1(MC) or TOUT_MIN(MU)" 9 "ROM_LEVEL_2(MC) or IGK_MON(MU)" 10 "RAM_LEVEL_2(MC) or EOLT(MU)" 11 "WRG_IDX(MC) or FCT_SPC_IST(MU)" 12 "WRG_RESP(MC) or DR_OFF(MU)" 13 "NOT_DEC(MC) or V_L(MU)" 14 "V_H(MU)" 15 "V_L_H(MU)" 16 "PFM_0_TOG(MC) or PFM_0(MU)" 17 "PFM_1_TOG(MC) or PFM_1(MU)" 18 "PFM_2_TOG(MC) or PFM_2(MU)" 19 "PFM_3_TOG(MC) or PFM_3(MU)" 20 "PFM_4_TOG(MC) or PFM_4(MU)" 21 "PFM_5_TOG(MC) or PFM_5(MU)" 22 "PFM_6_TOG(MC) or PFM_6(MU)" 23 "NOT_VLD_TRAN" 24 "PFM_0_RESP(MC)" 25 "PFM_1_RESP(MC)" 26 "PFM_2_RESP(MC)" 27 "PFM_3_RESP(MC)" 28 "PFM_4_RESP(MC)" 29 "PFM_5_RESP(MC)" 30 "PFM_6_RESP(MC)" /end COMPU_VTAB
/begin COMPU_METHOD _CNV_S_4_ECM3_STATE_11_CM "" TAB_VERB "%6.3" "-" COMPU_TAB_REF _CNV_S_4_ECM3_STATE_11 /end COMPU_METHOD
/begin COMPU_VTAB _CNV_S_4_ECM3_STATE_11 "" TAB_VERB 4 0 "NOT_PRES" 1 "REST_REQ" 2 "DI_REQ" 3 "PREV_REST" /end COMPU_VTAB
/begin COMPU_METHOD _CNV_S_2_ECM3_LV_MC_12_CM "" TAB_VERB "%6.3" "-" COMPU_TAB_REF _CNV_S_2_ECM3_LV_MC_12 /end COMPU_METHOD
/begin COMPU_VTAB _CNV_S_2_ECM3_LV_MC_12 "" TAB_VERB 2 0 "MU" 1 "MC" /end COMPU_VTAB
/begin COMPU_METHOD _CNV_S_30_ECM3_ERR_C_13_CM "" TAB_VERB "%6.3" "-" COMPU_TAB_REF _CNV_S_30_ECM3_ERR_C_13 /end COMPU_METHOD
/begin COMPU_VTAB _CNV_S_30_ECM3_ERR_C_13 "" TAB_VERB 30 0 "NOT_ERR" 1 "COM_HD" 2 "COM_CKS" 3 "COM_PAR" 4 "CONF_DIF" 5 "SOPC" 6 "COMP_NR" 7 "ROM_LEVEL_1" 8 "RAM_LEVEL_1" 9 "ROM_LEVEL_2" 10 "RAM_LEVEL_2" 11 "WRG_IDX" 12 "WRG_RESP" 13 "NOT_DEC" 14 "MU_READY" 16 "PFM_0_TOG" 17 "PFM_1_TOG" 18 "PFM_2_TOG" 19 "PFM_3_TOG" 20 "PFM_4_TOG" 21 "PFM_5_TOG" 22 "PFM_6_TOG" 23 "NOT_VLD_TRAN" 24 "PFM_0_RESP" 25 "PFM_1_RESP" 26 "PFM_2_RESP" 27 "PFM_3_RESP" 28 "PFM_4_RESP" 29 "PFM_5_RESP" 30 "PFM_6_RESP" /end COMPU_VTAB
/begin COMPU_METHOD _CNV_S_24_ECM3_ERR_C_14_CM "" TAB_VERB "%6.3" "-" COMPU_TAB_REF _CNV_S_24_ECM3_ERR_C_14 /end COMPU_METHOD
/begin COMPU_VTAB _CNV_S_24_ECM3_ERR_C_14 "" TAB_VERB 24 0 "NOT_ERR" 1 "COM_HD" 2 "COM_CKS" 3 "COM_PAR" 4 "CONF_DIF" 5 "CONF_CPL" 6 "COMP_NR" 7 "TOUT_MAX" 8 "TOUT_MIN" 9 "IGK_MON" 10 "EOLT" 11 "FCT_SPC_IST" 12 "DR_OFF" 13 "V_L" 14 "V_H" 15 "V_L_H" 16 "PFM_0" 17 "PFM_1" 18 "PFM_2" 19 "PFM_3" 20 "PFM_4" 21 "PFM_5" 22 "PFM_6" 23 "NOT_VLD_TRAN" /end COMPU_VTAB
/begin COMPU_METHOD _CNV_S_4_ECM3_MU_DI_15_CM "" TAB_VERB "%6.3" "" COMPU_TAB_REF _CNV_S_4_ECM3_MU_DI_15 /end COMPU_METHOD
/begin COMPU_VTAB _CNV_S_4_ECM3_MU_DI_15 "" TAB_VERB 4 0 "MU_DI_NOT_REQ" 1 "MU_DI_BUSY" 2 "MU_DI_ERR" 3 "MU_DI_OK" /end COMPU_VTAB
/begin COMPU_METHOD _CNV_A_R_LINEAR_____16_CM "" RAT_FUNC "%6.3" "V" COEFFS 0 6553.599999999993 0. 0 0 1 /end COMPU_METHOD
/begin COMPU_METHOD _CNV_S_5_ECM3_ERR_S_17_CM "" TAB_VERB "%6.3" "" COMPU_TAB_REF _CNV_S_5_ECM3_ERR_S_17 /end COMPU_METHOD
/begin COMPU_VTAB _CNV_S_5_ECM3_ERR_S_17 "" TAB_VERB 5 0 "NO_SYM" 1 "SYM_0" 2 "SYM_1" 4 "SYM_2" 8 "SYM_3" /end COMPU_VTAB
/begin COMPU_METHOD _CNV_S_4_ECM3_STATE_18_CM "" TAB_VERB "%6.3" "" COMPU_TAB_REF _CNV_S_4_ECM3_STATE_18 /end COMPU_METHOD
/begin COMPU_VTAB _CNV_S_4_ECM3_STATE_18 "" TAB_VERB 4 0 "PRDR_WAIT" 1 "PRDR_READY" 2 "PRDR_VB_ERR" 3 "PRDR_ST_END" /end COMPU_VTAB
/begin COMPU_METHOD _CNV_A_R_LINEAR_____19_CM "" RAT_FUNC "%6.3" "V" COEFFS 0 1598.439195529102 0. 0 0 1 /end COMPU_METHOD
/begin COMPU_METHOD _CNV_S_2_ECM3_POW_U_20_CM "" TAB_VERB "%6.3" "" COMPU_TAB_REF _CNV_S_2_ECM3_POW_U_20 /end COMPU_METHOD
/begin COMPU_VTAB _CNV_S_2_ECM3_POW_U_20 "" TAB_VERB 2 90 "0" 165 "1" /end COMPU_VTAB
/begin COMPU_METHOD _CNV_A_R_LINEAR_____21_CM "" RAT_FUNC "%6.3" "rpm" COEFFS 0 1. 0. 0 0 1 /end COMPU_METHOD
/begin COMPU_METHOD _CNV_A_R_LINEAR_____22_CM "" RAT_FUNC "%6.3" "rpm/s" COEFFS 0 3.125e-002 0. 0 0 1 /end COMPU_METHOD
/begin COMPU_METHOD _CNV_A_R_LINEAR_____23_CM "" RAT_FUNC "%6.3" "rpm/s" COEFFS 0 1. 0. 0 0 1 /end COMPU_METHOD
/begin COMPU_METHOD _CNV_A_R_ENSD_LINEA_24_CM "" RAT_FUNC "%6.3" "rpm" COEFFS 0 4. 0. 0 0 1 /end COMPU_METHOD
/begin COMPU_METHOD _CNV_A_R_LINEAR_____25_CM "" RAT_FUNC "%6.3" "∞CRK" COEFFS 0 2.666666666666667 0. 0 0 1 /end COMPU_METHOD
/begin COMPU_METHOD _CNV_A_R_LINEAR_____26_CM "" RAT_FUNC "%6.3" "s" COEFFS 0 250000. 0. 0 0 1 /end COMPU_METHOD
/begin COMPU_METHOD _CNV_A_R_ENSD_LINEA_27_CM "" RAT_FUNC "%6.3" "∞CRK" COEFFS 0 16. 2048. 0 0 1 /end COMPU_METHOD
/begin COMPU_METHOD _CNV_A_R_LINEAR_____28_CM "" RAT_FUNC "%6.3" "∞CRK" COEFFS 0 2.666666666666667 256. 0 0 1 /end COMPU_METHOD
/begin COMPU_METHOD _CNV_A_R_ENSD_LINEA_29_CM "" RAT_FUNC "%6.3" "∞CRK" COEFFS 0 16. 512. 0 0 1 /end COMPU_METHOD
/begin COMPU_METHOD _CNV_A_R_LINEAR_____30_CM "" RAT_FUNC "%6.3" "∞CRK" COEFFS 0 2.666666666666667 128. 0 0 1 /end COMPU_METHOD
/begin COMPU_METHOD _CNV_A_R_LINEAR_____31_CM "" RAT_FUNC "%6.3" "-" COEFFS 0 256. 0. 0 0 1 /end COMPU_METHOD
/begin COMPU_METHOD _CNV_A_R_ENSD_LINEA_32_CM "" RAT_FUNC "%6.3" "∞CRK" COEFFS 0 16. 0. 0 0 1 /end COMPU_METHOD
/begin COMPU_METHOD _CNV_A_R_LINEAR_____33_CM "" RAT_FUNC "%6.3" "-" COEFFS 0 1. -1. 0 0 1 /end COMPU_METHOD
/begin COMPU_METHOD _CNV_A_R_LINEAR_____34_CM "" RAT_FUNC "%6.3" "s" COEFFS 0 100. 0. 0 0 1 /end COMPU_METHOD
/begin COMPU_METHOD _CNV_A_R_ENSD_LINEA_35_CM "" RAT_FUNC "%6.3" "∞C" COEFFS 0 1. 50. 0 0 1 /end COMPU_METHOD
/begin COMPU_METHOD _CNV_A_R_ENSD_LINEA_36_CM "" RAT_FUNC "%6.3" "V" COEFFS 0 8.854166666666666 0. 0 0 1 /end COMPU_METHOD
/begin COMPU_METHOD _CNV_A_R_LINEAR_____37_CM "" RAT_FUNC "%6.3" "s" COEFFS 0 4201656.398697721 0. 0 0 1 /end COMPU_METHOD
/begin COMPU_METHOD _CNV_A_R_ENSD_LINEA_38_CM "" RAT_FUNC "%6.3" "-" COEFFS 0 16. 0. 0 0 1 /end COMPU_METHOD
/begin COMPU_METHOD _CNV_A_R_ENSD_LINEA_39_CM "" RAT_FUNC "%6.3" "s" COEFFS 0 4201678.146825826 0. 0 0 1 /end COMPU_METHOD
/begin COMPU_METHOD _CNV_A_R_LINEAR_____40_CM "" RAT_FUNC "%6.3" "ms" COEFFS 0 0.1 0. 0 0 1 /end COMPU_METHOD
/begin COMPU_METHOD _CNV_A_R_LINEAR_____41_CM "" RAT_FUNC "%6.3" "V" COEFFS 0 9.846153846153847 0. 0 0 1 /end COMPU_METHOD
/begin COMPU_METHOD _CNV_A_R_LINEAR_____42_CM "" RAT_FUNC "%6.3" "∞C" COEFFS 0 1.333333333333333 64. 0 0 1 /end COMPU_METHOD
/begin COMPU_METHOD _CNV_A_R_LINEAR_____43_CM "" RAT_FUNC "%6.3" "-" COEFFS 0 128. 0. 0 0 1 /end COMPU_METHOD
/begin COMPU_METHOD _CNV_A_R_LINEAR_____44_CM "" RAT_FUNC "%6.3" "ms" COEFFS 0 250. 0. 0 0 1 /end COMPU_METHOD
/begin COMPU_METHOD _CNV_A_R_LINEAR_____45_CM "" RAT_FUNC "%6.3" "ms" COEFFS 0 250.0000000000001 0. 0 0 1 /end COMPU_METHOD
/begin COMPU_METHOD _CNV_A_R_IGRE_LINEA_46_CM "" RAT_FUNC "%6.3" "A" COEFFS 0 799.2195121951216 0. 0 0 1 /end COMPU_METHOD
/begin COMPU_METHOD _CNV_A_R_IGRE_LINEA_47_CM "" RAT_FUNC "%6.3" "V" COEFFS 0 13107.19999999999 0. 0 0 1 /end COMPU_METHOD
/begin COMPU_METHOD _CNV_A_R_IGRE_LINEA_48_CM "" RAT_FUNC "%6.3" "∞CRK" COEFFS 0 2.666666666666667 63. 0 0 1 /end COMPU_METHOD
/begin COMPU_METHOD _CNV_A_R_LINEAR_____49_CM "" RAT_FUNC "%6.3" "-" COEFFS 0 32767.99999999992 0. 0 0 1 /end COMPU_METHOD
/begin COMPU_METHOD _CNV_A_R_LINEAR_____50_CM "" RAT_FUNC "%6.3" "µs" COEFFS 0 0.25 0. 0 0 1 /end COMPU_METHOD
/begin COMPU_METHOD _CNV_A_R_LINEAR_____51_CM "" RAT_FUNC "%6.3" "[-]" COEFFS 0 384. -256.0000128 0 0 1 /end COMPU_METHOD
/begin COMPU_METHOD _CNV_A_R_LINEAR_____52_CM "" RAT_FUNC "%6.3" "mV" COEFFS 0 1. 0. 0 0 1 /end COMPU_METHOD
/begin COMPU_METHOD _CNV_A_R_LINEAR_____54_CM "" RAT_FUNC "%6.3" "∞C" COEFFS 0 10. 400. 0 0 1 /end COMPU_METHOD
/begin COMPU_METHOD _CNV_A_R_LINEAR_____57_CM "" RAT_FUNC "%6.3" "hPa" COEFFS 0 1. 0. 0 0 1 /end COMPU_METHOD
/begin COMPU_METHOD _CNV_A_R_LINEAR_____70_CM "" RAT_FUNC "%6.3" "km/h" COEFFS 0 100. 0. 0 0 1 /end COMPU_METHOD
/begin COMPU_METHOD _CNV_A_R_LINEAR_____113_CM "" RAT_FUNC "%6.3" "-" COEFFS 0 1. 1. 0 0 1 /end COMPU_METHOD
/begin COMPU_METHOD _CNV_A_R_LINEAR_____118_CM "" RAT_FUNC "%6.3" "-" COEFFS 0 255. 0. 0 0 1 /end COMPU_METHOD
/begin COMPU_METHOD _CNV_S_3_STATUS_OK__120_CM "" TAB_VERB "%6.3" "-" COMPU_TAB_REF _CNV_S_3_STATUS_OK__120 /end COMPU_METHOD
/begin COMPU_VTAB _CNV_S_3_STATUS_OK__120 "" TAB_VERB 3 0 "Nsx_vld_nok_0" 1 "Nsx_vld_ok_1" 2 "Nsx_vld_fail_2" /end COMPU_VTAB
/begin COMPU_METHOD _CNV_A_R_LINEAR_____123_CM "" RAT_FUNC "%6.3" "Nm" COEFFS 0 32. 0. 0 0 1 /end COMPU_METHOD
/begin COMPU_METHOD _CNV_A_R_LINEAR_____125_CM "" RAT_FUNC "%6.3" "-" COEFFS 0 1024. 0. 0 0 1 /end COMPU_METHOD
/begin COMPU_METHOD _CNV_A_R_LINEAR_____128_CM "" RAT_FUNC "%6.3" "W" COEFFS 0 0.1 0. 0 0 1 /end COMPU_METHOD
/begin COMPU_METHOD _CNV_S_3_STATUS_BRK_159_CM "" TAB_VERB "%6.3" "" COMPU_TAB_REF _CNV_S_3_STATUS_BRK_159 /end COMPU_METHOD
/begin COMPU_VTAB _CNV_S_3_STATUS_BRK_159 "" TAB_VERB 3 1 "Nsx_brk_pdl_off" 2 "Nsx_brk_pdl_on" 4 "Nsx_brk_pdl_vld_on" /end COMPU_VTAB
/begin COMPU_METHOD _CNV_A_R_LINEAR_____161_CM "" RAT_FUNC "%6.3" "Nm" COEFFS 0 32. 12800. 0 0 1 /end COMPU_METHOD
/begin COMPU_METHOD _CNV_S_8_STATUS_OK__181_CM "" TAB_VERB "%6.3" "-" COMPU_TAB_REF _CNV_S_8_STATUS_OK__181 /end COMPU_METHOD
/begin COMPU_VTAB _CNV_S_8_STATUS_OK__181 "" TAB_VERB 8 0 "Nsx_vld_nok_0" 1 "Nsx_vld_ok_1" 2 "Nsx_vld_fail_2" 3 "Nsx_vld_fail_3" 4 "Nsx_vld_fail_4" 5 "Nsx_vld_fail_5" 6 "Nsx_vld_fail_6" 7 "Nsx_vld_fail_7" /end COMPU_VTAB
/begin COMPU_METHOD _CNV_A_R_LINEAR_____185_CM "" RAT_FUNC "%6.3" "-" COEFFS 0 800. 0. 0 0 1 /end COMPU_METHOD
/begin COMPU_METHOD _CNV_S_2_STATUS_OK__188_CM "" TAB_VERB "%6.3" "" COMPU_TAB_REF _CNV_S_2_STATUS_OK__188 /end COMPU_METHOD
/begin COMPU_VTAB _CNV_S_2_STATUS_OK__188 "" TAB_VERB 2 0 "Nsx_vld_nok_0" 1 "Nsx_vld_ok_1" /end COMPU_VTAB
/begin COMPU_METHOD _CNV_S_2_STATUS_OK__214_CM "" TAB_VERB "%6.3" "-" COMPU_TAB_REF _CNV_S_2_STATUS_OK__214 /end COMPU_METHOD
/begin COMPU_VTAB _CNV_S_2_STATUS_OK__214 "" TAB_VERB 2 0 "Nsx_vld_nok_0" 1 "Nsx_vld_ok_1" /end COMPU_VTAB
/begin COMPU_METHOD _CNV_A_R_LINEAR_____220_CM "" RAT_FUNC "%6.3" "∞C" COEFFS 0 1. 40. 0 0 1 /end COMPU_METHOD
/begin COMPU_METHOD _CNV_A_R_LINEAR_____257_CM "" RAT_FUNC "%6.3" "ratio" COEFFS 0 800. 0. 0 0 1 /end COMPU_METHOD
/begin COMPU_METHOD _CNV_A_R_LINEAR_____431_CM "" RAT_FUNC "%6.3" "Nm" COEFFS 0 1. 0. 0 0 1 /end COMPU_METHOD
/begin RECORD_LAYOUT _REC_S1VAL_20_u4 FNC_VALUES 1 ULONG COLUMN_DIR DIRECT /end RECORD_LAYOUT
/begin RECORD_LAYOUT _REC_S1VAL_20_u1 FNC_VALUES 1 UBYTE COLUMN_DIR DIRECT /end RECORD_LAYOUT
/begin RECORD_LAYOUT _REC_A2AXS_20_u1 NO_AXIS_PTS_X 1 UBYTE AXIS_PTS_X 2 UBYTE INDEX_INCR DIRECT /end RECORD_LAYOUT
/begin RECORD_LAYOUT _REC_S1VAL_20_u2 FNC_VALUES 1 UWORD COLUMN_DIR DIRECT /end RECORD_LAYOUT
/begin RECORD_LAYOUT _REC_S1VAL_20_s2 FNC_VALUES 1 SWORD COLUMN_DIR DIRECT /end RECORD_LAYOUT
/begin RECORD_LAYOUT _REC_A2AXS_20_u2 NO_AXIS_PTS_X 1 UWORD AXIS_PTS_X 2 UWORD INDEX_INCR DIRECT /end RECORD_LAYOUT
/begin RECORD_LAYOUT _REC_A1CUR_20_u1_u2 FNC_VALUES 1 UBYTE COLUMN_DIR DIRECT /end RECORD_LAYOUT
/begin RECORD_LAYOUT _REC_A1CUR_20_u1_u1 FNC_VALUES 1 UBYTE COLUMN_DIR DIRECT /end RECORD_LAYOUT
/begin RECORD_LAYOUT _REC_A1CUR_20_u2_u1 FNC_VALUES 1 UWORD COLUMN_DIR DIRECT /end RECORD_LAYOUT
/begin RECORD_LAYOUT _REC_A1MAP_20_u1_u1_u1 FNC_VALUES 1 UBYTE COLUMN_DIR DIRECT /end RECORD_LAYOUT
/begin RECORD_LAYOUT _REC_A1MAP_20_u2_u1_u1 FNC_VALUES 1 UWORD COLUMN_DIR DIRECT /end RECORD_LAYOUT
/begin FUNCTION C_A_ECME "" /begin DEF_CHARACTERISTIC c_req_ini_nvm_grp lc_req_ini_nvm /end DEF_CHARACTERISTIC /end FUNCTION
/begin FUNCTION C_1_ENSD "" /begin SUB_FUNCTION ENSD_Interface_adaptation__101C /end SUB_FUNCTION /end FUNCTION
/begin FUNCTION ENSD_Interface_adaptation__101C "ENSD_Interface_adaptation__101C" /begin OUT_MEASUREMENT tco_cmn vb_cmn /end OUT_MEASUREMENT /end FUNCTION
/begin FUNCTION C_2_ENSD "C_2_ENSD"
 /begin SUB_FUNCTION Acq_of_crankshaft_signal__200H Acq_of_camshaft_signal__200J Acq_of_crank_signal_ApInc__205P /end SUB_FUNCTION
/end FUNCTION
/begin FUNCTION Acq_of_crankshaft_signal__200H "Acq_of_crankshaft_signal__200H"
 /begin DEF_CHARACTERISTIC ldp_n_32_id_fac_ac_crk_gap id_fac_ac_crk_gap id_fac_tol_crk_tooth c_t_crk_dly /end DEF_CHARACTERISTIC
 /begin OUT_MEASUREMENT lv_crk_miss_tooth lv_crk_syn lv_inh_mis_crk lv_lost_syn_crk lv_orng_nr_tooth_crk lv_orng_nr_tooth_gap lv_orng_tooth_per_crk lv_t_crk_dly t_seg_er /end OUT_MEASUREMENT
/end FUNCTION
/begin FUNCTION Acq_of_camshaft_signal__200J "Acq_of_camshaft_signal__200J"
 /begin DEF_CHARACTERISTIC ldpm_n_32_3_ensd id_fac_cam_in c_cam_adj_vvt_syn_crk_adc_in c_cam_adj_vvt_syn_crk_rtd_in c_cam_adj_vvt_syn_in c_crk_ang_dly c_crk_ang_dly_lst_cam c_dyw_cam_crk_syn_adc_in c_dyw_cam_crk_syn_rtd_in c_dyw_cam_syn_in c_nr_edge_min_vld_cam_in /end DEF_CHARACTERISTIC
 /begin OUT_MEASUREMENT IDX_EDGE_CAM_IN_1 CTR_EDGE_CAM_IN_1 LV_VLD_PSN_CAM_IN_1 LV_SYN_CAM_IN_1 LV_ORNG_PER_CAM_IN_1 LV_ORNG_RATIO_CAM_IN_1 PSN_ENG_CAM_IN_1 T_SEG_CAM_IN_1 lv_cam_syn_crk lv_orng_cam_syn_crk /end OUT_MEASUREMENT
/end FUNCTION
/begin FUNCTION Acq_of_crank_signal_ApInc__205P "Acq_of_crank_signal_ApInc__205P" /begin OUT_MEASUREMENT lv_er_ena_seg /end OUT_MEASUREMENT /end FUNCTION
/begin FUNCTION C_4_ENSD "C_4_ENSD" /begin DEF_CHARACTERISTIC ldpm_n_32_1_ensd ldpm_n_32_2_ensd /end DEF_CHARACTERISTIC
 /begin SUB_FUNCTION Engine_position_manager__403Z Engine_pos_speed_calc__4040 Cam_adapt_and_pos_output__402S Synchro_det_in_Cam_LH__4072 Engine_pos_coherency_check__40B2 /end SUB_FUNCTION
/end FUNCTION
/begin FUNCTION Engine_position_manager__403Z "Engine_position_manager__403Z"
 /begin DEF_CHARACTERISTIC ldp_n_id_nr_vld_cam_syn_crk id_nr_vld_cam_syn_crk c_t_dly_stop_eng lc_inh_lih_cam lc_inh_lih_crk lc_inh_wout_cam_eng_pha /end DEF_CHARACTERISTIC
 /begin OUT_MEASUREMENT LV_ACT_CAM_IN_1 LV_ACT_LIH_CRK_CAM_IN_1 LV_ACT_SYN_CRK_CAM_IN_1 ctr_vld_cam_syn_crk lv_act_crk lv_act_wout_cam_eng_pha lv_crk_miss_run_eng lv_crk_plaus_first lv_eng_back_cfm lv_eng_back_det lv_err_cam lv_err_lih_crk_cam lv_first_vld_tooth lv_lih_err_cam lv_lih_err_crk lv_run_eng lv_syn_eng lv_syn_vld lv_timeout_cam_syn_crk /end OUT_MEASUREMENT
/end FUNCTION
/begin FUNCTION Engine_pos_speed_calc__4040 "Engine_pos_speed_calc__4040" /begin DEF_CHARACTERISTIC c_n_fast_swi c_n_tooth_end /end DEF_CHARACTERISTIC
 /begin OUT_MEASUREMENT id_seg_nr_0 id_seg_nr_1 id_seg_nr_2 id_seg_nr_3 n n_32 n_fast n_grd n_grd_h_res n_grd_h_res_rng n_h_rng n_mmv n_sae n_tooth psn_eng_syn_max psn_eng_syn_min seg_ctr seg_nr t_seg_av t_seg_half_av /end OUT_MEASUREMENT
/end FUNCTION
/begin FUNCTION Cam_adapt_and_pos_output__402S "Cam_adapt_and_pos_output__402S"
 /begin DEF_CHARACTERISTIC c_crlc_ad_ref_cam_in c_grd_ad_ref_max_cam_in c_n_32_max_ad_ref_cam c_nr_rev_ad_ref_cam_in c_tol_tooth_off_cam_in /end DEF_CHARACTERISTIC
 /begin OUT_MEASUREMENT T_DIF_EDGE_CAM_IN_1 PSN_DIF_EDGE_CAM_IN_1 psn_edge_cam_old_in_1 PSN_CAM_IN_1 CAM_PSN_LST_REF_AD_IN_1 PSN_AD_CAM_IN_1 CTR_REV_AD_REF_CAM_IN_1 LV_AD_END_CAM_IN_1 LV_TOOTH_OFF_DET_ENA_IN_1 LV_CAM_AD_SAVE_IN_1 LV_ORNG_CAM_AD_IN_1 PSN_EDGE_1_AD_CAM_IN_1 PSN_EDGE_2_AD_CAM_IN_1 PSN_EDGE_3_AD_CAM_IN_1 PSN_EDGE_4_AD_CAM_IN_1 PSN_EDGE_5_AD_CAM_IN_1 PSN_EDGE_6_AD_CAM_IN_1 PSN_EDGE_7_AD_CAM_IN_1 PSN_EDGE_8_AD_CAM_IN_1 PSN_EDGE_9_AD_CAM_IN_1 PSN_EDGE_10_AD_CAM_IN_1 PSN_EDGE_1_CAM_IN_1 PSN_EDGE_2_CAM_IN_1 PSN_EDGE_3_CAM_IN_1 PSN_EDGE_4_CAM_IN_1 PSN_EDGE_5_CAM_IN_1 PSN_EDGE_6_CAM_IN_1 PSN_EDGE_7_CAM_IN_1 PSN_EDGE_8_CAM_IN_1 PSN_EDGE_9_CAM_IN_1 PSN_EDGE_10_CAM_IN_1 /end OUT_MEASUREMENT
/end FUNCTION
/begin FUNCTION Synchro_det_in_Cam_LH__4072 "Synchro_det_in_Cam_LH__4072" /begin OUT_MEASUREMENT lv_cam_lih_ext_ena lv_seg_nr_upd_req lv_syn_vld_cam_lih /end OUT_MEASUREMENT /end FUNCTION
/begin FUNCTION Engine_pos_coherency_check__40B2 "Engine_pos_coherency_check__40B2" /begin OUT_MEASUREMENT ctr_eng_psn_chk_err lv_eng_psn_chk_err /end OUT_MEASUREMENT /end FUNCTION
/begin FUNCTION C_A_ENSD "C_A_ENSD"
 /begin SUB_FUNCTION Eng_pos_speed_diag_manager__A0DZ Camshaft_position_diag__A0B4 Camshaft_sensor_diagnosis__A004 Crank_sensor_diagnosis__A005 Crank_sensor_plaus_diag__A0B9 Crank_sensor_circuit_diag__A0E0 Cam_sensor_diag_Appl_inc__A01Z /end SUB_FUNCTION
/end FUNCTION
/begin FUNCTION Eng_pos_speed_diag_manager__A0DZ "Eng_pos_speed_diag_manager__A0DZ"
 /begin DEF_CHARACTERISTIC c_n_l_crk_plaus_inh c_n_not_rest c_t_dly_rest_igk c_t_dly_rest_stall c_t_max_inh_diag_ensd c_t_min_inh_diag_ensd c_t_off_crk_dly lc_eng_back_inh lc_err_crk_inh /end DEF_CHARACTERISTIC
 /begin OUT_MEASUREMENT LV_ERR_CAM_IN_1 LV_INH_DIAG_SYN_CAM_IN_1 LV_INH_DIAG_PER_CAM_IN_1 LV_INH_DIAG_PLAUS_CAM_IN_1 LV_INH_DIAG_REF_CRK_CAM_IN_1 LV_INH_DIAG_TOOTH_OFF_IN_1 LV_INH_DIAG_SYN_CRK_CAM_IN_1 lv_crk_off_tmr_end lv_err_cam_tot lv_err_crk lv_ign_inj_lock_req lv_inh_diag_crk_oc lv_inh_diag_crk_plaus lv_inh_diag_crk_plaus_ena lv_inh_diag_crk_syn lv_inh_diag_crk_tooth lv_inh_diag_crk_tooth_per lv_inh_diag_ensd t_off_crk_dly /end OUT_MEASUREMENT
/end FUNCTION
/begin FUNCTION Camshaft_position_diag__A0B4 "Camshaft_position_diag__A0B4" /begin DEF_CHARACTERISTIC c_n_32_max_diag_ref_crk_cam c_tol_ref_crk_cam_in /end DEF_CHARACTERISTIC /begin OUT_MEASUREMENT lv_err_ref_crk_cam_in_1 lv_err_tooth_off_in_1 /end OUT_MEASUREMENT /end FUNCTION
/begin FUNCTION Camshaft_sensor_diagnosis__A004 "Camshaft_sensor_diagnosis__A004" /begin DEF_CHARACTERISTIC c_n_32_max_diag_per_cam c_n_32_max_diag_syn_cam /end DEF_CHARACTERISTIC /begin OUT_MEASUREMENT lv_err_per_cam_in_1 lv_err_syn_cam_in_1 /end OUT_MEASUREMENT /end FUNCTION
/begin FUNCTION Crank_sensor_diagnosis__A005 "Crank_sensor_diagnosis__A005" /begin DEF_CHARACTERISTIC c_n_32_max_diag_crk_tooth /end DEF_CHARACTERISTIC /begin OUT_MEASUREMENT lv_err_crk_syn lv_err_crk_tooth lv_err_crk_tooth_per /end OUT_MEASUREMENT /end FUNCTION
/begin FUNCTION Crank_sensor_plaus_diag__A0B9 "Crank_sensor_plaus_diag__A0B9"
 /begin DEF_CHARACTERISTIC c_ctr_orng_cam_syn_crk_max c_nr_cyc_eng_plaus_cam_max c_nr_edge_cam_in_syn_crk_max lc_cam_err_ena_vvt lc_ctr_dec_plaus_cam /end DEF_CHARACTERISTIC
 /begin OUT_MEASUREMENT ctr_cyc_eng_plaus_cam_in_1 ctr_edge_syn_crk_cam ctr_orng_cam_syn_crk lv_err_crk_plaus lv_err_plaus_cam_in_1 lv_err_syn_crk_cam_in_1 /end OUT_MEASUREMENT
/end FUNCTION
/begin FUNCTION Crank_sensor_circuit_diag__A0E0 "Crank_sensor_circuit_diag__A0E0"
 /begin DEF_CHARACTERISTIC ldp_n_32_id_v_mcps_thd id_v_mcps_thd c_mcps_sample_count c_v_mcps_thd_max c_v_mcps_thd_min lc_rst_v_mcps_diag_dif_max /end DEF_CHARACTERISTIC
 /begin OUT_MEASUREMENT lv_err_crk_oc v_mcps_diag_dif v_mcps_diag_dif_max v_mcps_diag_max_prev v_mcps_diag_min_prev /end OUT_MEASUREMENT
/end FUNCTION
/begin FUNCTION Cam_sensor_diag_Appl_inc__A01Z "Cam_sensor_diag_Appl_inc__A01Z" /begin OUT_MEASUREMENT lv_err_ext_cam_in[0] /end OUT_MEASUREMENT /end FUNCTION
/begin FUNCTION CPULOAD "" /begin DEF_CHARACTERISTIC c_cpu_load_ftc c_cpu_load_ses_ctr_ini /end DEF_CHARACTERISTIC
 /begin OUT_MEASUREMENT cpu_load cpu_load_fil cpu_load_fil_max cpu_load_max cpu_load_ses_ctr cpu_load_tsk_per_ctr cpu_load_tsk_per_min /end OUT_MEASUREMENT
/end FUNCTION
/begin FUNCTION CPULOAD_NONE_TUNEABLE ""
 /begin DEF_CHARACTERISTIC c_cpu_load_per c_cpu_load_ses_t_end c_cpu_load_tsk_mes_dly c_cpu_load_tsk_per_min /end DEF_CHARACTERISTIC
/end FUNCTION
/begin FUNCTION CPULOAD_DEV ""
 /begin DEF_CHARACTERISTIC c_cpu_load_1_div_res_min lc_cpu_load_max_rst lc_cpu_load_tsk_per_min_rst /end DEF_CHARACTERISTIC
 /begin OUT_MEASUREMENT cpu_load_err /end OUT_MEASUREMENT
/end FUNCTION
/begin FUNCTION C_E_ECM3 ""
 /begin SUB_FUNCTION ecm3_dtsyscom ecm3_dtsyserrm ecm3_dtsysfarea ecm3_dtsysfsist ecm3_dtsyspfm ecm3_dtsysprmon ecm3_dtsyssopc ecm3_dtsysapinc_gen /end SUB_FUNCTION
/end FUNCTION
/begin FUNCTION ecm3_dtsyscom "MC communication monitoring between MC and MU"
 /begin OUT_MEASUREMENT lv_mc_com_err lv_mu_ready state_err_idc_mu_ready state_mu_tmp /end OUT_MEASUREMENT
/end FUNCTION
/begin FUNCTION ecm3_dtsyserrm "Error memory management of processor monitoring"
 /begin OUT_MEASUREMENT CTR_RST_ERR_MEM_ACT CTR_RST_ERR_MEM_OLD ecm3_lf_err_cod_err_mem_act ERR_COD_ERR_MEM_ACT STATE_ERR_IDC_ERR_MEM_ACT LV_MC_CPT_ERR_MEM_ACT ecm3_lf_err_cod_err_mem_old ERR_COD_ERR_MEM_OLD STATE_ERR_IDC_ERR_MEM_OLD LV_MC_CPT_ERR_MEM_OLD /end OUT_MEASUREMENT
/end FUNCTION
/begin FUNCTION ecm3_dtsysfarea "MC Fault Reaction"
 /begin OUT_MEASUREMENT ctr_com_cyc_mc_dr_di_tmp ctr_rst_mc ctr_rst_mu ecm3_lf_err_cod_mc ERR_COD_MC STATE_ERR_IDC_MC ecm3_lf_err_cod_mu ERR_COD_MU STATE_ERR_IDC_MU lv_abc_mc_err_com lv_abc_mc_err_fct_spc_ist lv_abc_mc_err_pfm lv_abc_mc_err_pfm_6 lv_err_mu_mc lv_err_tmp_mu_mc lv_inj_off_tmr_inj_ena_tmp lv_mc_dr_off lv_mc_inh_sopc lv_mu_di_out_0 lv_mu_di_out_1 lv_v_h_det_mu lv_v_l_det_mu mu_di_state /end OUT_MEASUREMENT
/end FUNCTION
/begin FUNCTION ecm3_dtsysfsist "MC Function-specific Instruction Set Test (FS-IST)"
 /begin OUT_MEASUREMENT abc_lid_mc_fct_spc_ist idx_nr_err_mc_fct_spc_ist lv_mc_fct_spc_ist_wrg_resp_act test_rec_idx_mon2 /end OUT_MEASUREMENT
/end FUNCTION
/begin FUNCTION ecm3_dtsyspfm "MC Program Flow Monitoring"
 /begin OUT_MEASUREMENT lf_mc_pfm_syn_byte_mon lf_mc_pfm_syn_byte_tog lv_mc_pfm_wrg_resp_act_6 /end OUT_MEASUREMENT
/end FUNCTION
/begin FUNCTION ecm3_dtsysprmon "MC Processor Monitoring"
 /begin DEF_CHARACTERISTIC c_err_swi_mc_level_2_cal c_err_swi_mc_level_2_cod C_ROM_CKS_CAL_H C_ROM_CKS_CAL_L /end DEF_CHARACTERISTIC
 /begin OUT_MEASUREMENT lf_mu_conf_byte lv_mc_rom_chk_ready lv_mu_ign_key nr_mu_comp nr_mu_hw_vers state_mc vp_mc_an_dig_mon vp_mu_an_dig_mon rom_cks_cal_clc_h rom_cks_cal_clc_l /end OUT_MEASUREMENT
/end FUNCTION
/begin FUNCTION ecm3_dtsyssopc "MC Switch-Off Path Check (SOPC)"
 /begin OUT_MEASUREMENT idx_state_sopc lv_mc_sopc_act lv_mc_sopc_inh_di state_mc_resp_sopc /end OUT_MEASUREMENT
/end FUNCTION
/begin FUNCTION ecm3_dtsysapinc_gen "MC Processor Monitoring (Application Incidences)" /begin OUT_MEASUREMENT lv_inj_off_tmr_inj_ena lv_mc_ign_key lv_mc_st_lih_sopc /end OUT_MEASUREMENT /end FUNCTION
/begin FUNCTION C_E_ECM3_CNF "" /begin SUB_FUNCTION ecm3_dtsysapinc /end SUB_FUNCTION /end FUNCTION
/begin FUNCTION ecm3_dtsysapinc "MC Processor Monitoring (Application Incidences)" /begin DEF_CHARACTERISTIC c_vb_prdr /end DEF_CHARACTERISTIC
 /begin OUT_MEASUREMENT envd_0_mon_3 envd_1_mon_3 envd_2_mon_3 envd_3_mon_3 err_sym_mon_3 lv_cdn_diag_mon_3 lv_end_diag_mon_3 lv_err_cus_mon_3 lv_err_cus_mon_3_ext lv_err_cus_mon_3_vb lv_err_mon_3 lv_err_tmp_cus_mon_3 lv_mu_ign_key_old lv_pwl_lock_cdn_rom_chk state_prdr /end OUT_MEASUREMENT
/end FUNCTION
/begin FUNCTION C_2_ECM3 "" /begin SUB_FUNCTION ecm3_infr /end SUB_FUNCTION /end FUNCTION
/begin FUNCTION ecm3_infr "INFR of ECM3" /begin OUT_MEASUREMENT ecm3_pow_up_act /end OUT_MEASUREMENT /end FUNCTION
/begin FUNCTION C_2_ATIC81 "" /begin SUB_FUNCTION atic81 /end SUB_FUNCTION /end FUNCTION
/begin FUNCTION atic81 "ATIC81 communication driver"
 /begin OUT_MEASUREMENT ecm3_rcv_buf_mc[0] ecm3_rcv_buf_mc[1] ecm3_rcv_buf_mc[2] ecm3_rcv_buf_mc[3] ecm3_rcv_buf_mc[4] ecm3_rcv_buf_mc[5] ecm3_trm_buf_mc[0] ecm3_trm_buf_mc[1] ecm3_trm_buf_mc[2] ecm3_trm_buf_mc[3] ecm3_trm_buf_mc[4] /end OUT_MEASUREMENT
/end FUNCTION
/begin FUNCTION C_E_MON "" /begin SUB_FUNCTION ECM2_Mon_analog_dig_conversion MON_ACOPPRMON MON_AINTMON /end SUB_FUNCTION /end FUNCTION
/begin FUNCTION ECM2_Mon_analog_dig_conversion ""
 /begin DEF_CHARACTERISTIC c_abc_inc_conv_mon c_abc_max_conv_mon c_state_an_dig_err_act_mon c_vp_acq_conv_hys_mon /end DEF_CHARACTERISTIC
 /begin OUT_MEASUREMENT abc_conv_mon lv_err_conv_mon /end OUT_MEASUREMENT
/end FUNCTION
/begin FUNCTION MON_ACOPPRMON "Copy of process monitoring" /begin DEF_CHARACTERISTIC ldpm_test_rec_idx_mon2 id_Vsx_sfty2_ant_coup_vld /end DEF_CHARACTERISTIC
 /begin OUT_MEASUREMENT Vbx_sfty2_acel_pdl_fil_sens_v1 Vbx_sfty2_acel_pdl_fil_sens_v2 Vbx_sfty2_cru_tq_req_plau Vbx_sfty2_df_sfty_tq_chr Vbx_sfty2_df_sfty_tq_clc_chr Vbx_sfty2_df_sfty_tq_lih_chr Vbx_sfty2_ext_ctrl_ena Vbx_sfty2_igk Vbx_sfty2_lih_mon_ena Vbx_sfty2_prev_df_sfty_tq_chr Vbx_sfty2_pwst_prs_stt Vbx_sfty2_rst_req Vbx_sfty2_sfty_aftr_rst Vbx_sfty2_sfty_aftr_rst_ini Vbx_sfty2_sfty_aftr_rst_mem Vbx_sfty2_sfty_agb_tq_req_plau Vbx_sfty2_sfty_diag_ena_tqi Vbx_sfty2_sfty_esti_tqi_nok Vbx_sfty2_sfty_esti_tqi_nok_tmp Vbx_sfty2_sfty_moni_bch_ok Vbx_sfty2_sfty_msr_tq_req_plau Vbx_sfty2_sfty_tq_mon_nok Vbx_sfty2_sfty_tqi_sp_nok Vbx_sfty2_sfty_tqi_sp_nok_tmp Vbx_sfty2_stop_req Vbx_sfty2_stop_req_aftr_rst Vbx_sfty2_stop_req_mem Vbx_sfty2_thr_lih_mon_nok Vbx_sfty2_thr_lih_mon_nok_fil Vsx_sfty2_acel_pdl_sens_v1_vld Vsx_sfty2_ant_coup_vld Vsx_sfty2_brk_pdl Vsx_sfty2_cata_wup_phs Vsx_sfty2_dlin_conf Vsx_sfty2_driv_pwt_sp_vld Vsx_sfty2_ecm_mon_vld Vsx_sfty2_eng Vsx_sfty2_it_vld Vsx_sfty2_map_vld Vsx_sfty2_tq_mon_vld Vsx_sfty2_vs_vld Vxx_sfty2_ac_pow Vxx_sfty2_acel_pdl_fil_sens_v1 Vxx_sfty2_acel_pdl_fil_sens_v2 Vxx_sfty2_acel_pdl_rat Vxx_sfty2_acel_pdl_sens_rat1 Vxx_sfty2_acel_pdl_sens_rat2 Vxx_sfty2_acel_pdl_sens_v1 Vxx_sfty2_acel_pdl_sens_v2 Vxx_sfty2_agb_csm_tq Vxx_sfty2_agb_min_tqe_tgt Vxx_sfty2_ant_coup Vxx_sfty2_cru_pwt_sp Vxx_sfty2_driv_pwt_sp Vxx_sfty2_driv_spt_fac Vxx_sfty2_eng_tql Vxx_sfty2_esti_tqi Vxx_sfty2_esti_tqi_t_fil_min Vxx_sfty2_fil_alt_pow Vxx_sfty2_gear Vxx_sfty2_inj_avl_nr Vxx_sfty2_is_ad_tq Vxx_sfty2_is_i_cor Vxx_sfty2_is_n_sp Vxx_sfty2_is_tqe_sp Vxx_sfty2_map Vxx_sfty2_msr_tqe_sp Vxx_sfty2_pump_tql Vxx_sfty2_sfty_acel_pdl_pwt_sp Vxx_sfty2_sfty_ajs_modu_tqe Vxx_sfty2_sfty_arb_tqe Vxx_sfty2_sfty_aux_tql_sp Vxx_sfty2_sfty_driv_pwt_sp Vxx_sfty2_sfty_driv_tqe_sp Vxx_sfty2_sfty_esti_err Vxx_sfty2_sfty_esti_err_max Vxx_sfty2_sfty_frn_tql Vxx_sfty2_sfty_frn_tql_temp Vxx_sfty2_sfty_lim_driv_tqe Vxx_sfty2_sfty_min_avl_tqe Vxx_sfty2_sfty_n Vxx_sfty2_sfty_n_min_tqe_agb_fac Vxx_sfty2_sfty_tco Vxx_sfty2_sfty_toil Vxx_sfty2_sfty_tq_ffm_data_sf Vxx_sfty2_tkof_tqe_cor Vxx_sfty2_toil Vxx_sfty2_tqi_esti_sp_dif Vxx_sfty2_tqi_sp Vxx_sfty2_tqi_sp_no_ajs Vxx_sfty2_tqi_sp_t_fil_max Vxx_sfty2_vs resp_mon2 u8_index /end OUT_MEASUREMENT
/end FUNCTION
/begin FUNCTION MON_AINTMON "" /begin OUT_MEASUREMENT lv_stop_cus_mon /end OUT_MEASUREMENT /end FUNCTION
/begin FUNCTION C_3_ADAPT "" /begin SUB_FUNCTION ENSD_adaptation_module /end SUB_FUNCTION /end FUNCTION
/begin FUNCTION ENSD_adaptation_module ""
 /begin DEF_CHARACTERISTIC c_first_gap_psn_tol_adc c_first_gap_psn_tol_rtd c_gap_psn_tol_adc c_gap_psn_tol_rtd c_n_inh_lost_syn_crk c_n_min_lih_crk c_off_crk_dly /end DEF_CHARACTERISTIC
 /begin OUT_MEASUREMENT crk_off_tmr ctr_err_crk_plaus_save ctr_err_plaus_cam_in_save[0] ctr_lost_syn_crk_save ctr_orng_cam_syn_crk_save ctr_orng_nr_tooth_crk_save ctr_orng_per_cam_in_save[0] ctr_orng_ratio_cam_in_save[0] ctr_orng_tooth_per_crk_save LV_CAM_CUS_IN_1 lv_crk_off lv_crk_wheel_typ lv_lost_syn_crk_cus lv_plaus_cam_mem[0] lv_tooth_per_crk_mem n_cus_25 T_SEG_CAM_CUS_IN_1 /end OUT_MEASUREMENT
/end FUNCTION
/begin FUNCTION C_1_IGRE "C_1_IGRE" /begin SUB_FUNCTION IGRE_configuration_data /end SUB_FUNCTION /end FUNCTION
/begin FUNCTION IGRE_configuration_data "IGRE configuration data" /begin DEF_CHARACTERISTIC c_ign_dyn_conf /end DEF_CHARACTERISTIC /end FUNCTION
/begin FUNCTION C_2_IGRE "C_2_IGRE"
 /begin SUB_FUNCTION IGRE_Ignition_output_diagnosis IGRE_Spark_Adv_and_Dwell_Output IGRE_Dwell_time_ad_appl_inci IGRE_Dwell_time_adaptation /end SUB_FUNCTION
/end FUNCTION
/begin FUNCTION IGRE_Ignition_output_diagnosis "Ignition_output_diagnosis"
 /begin DEF_CHARACTERISTIC c_ctr_seg_nr_restart c_cur_igc_max c_cur_igc_min lc_igre_dev /end DEF_CHARACTERISTIC
 /begin OUT_MEASUREMENT ctr_seg_nr_restart cur_igc_max_diag cur_igc_min_diag CUR_IGC_TD_MIN_HALF_0 CUR_IGC_TD_MIN_HALF_1 CUR_IGC_TD_MIN_HALF_2 CUR_IGC_TD_MIN_HALF_3 LV_OL_IGC_0 LV_OL_IGC_1 LV_OL_IGC_2 LV_OL_IGC_3 LV_SCG_IGC_0 LV_SCG_IGC_1 LV_SCG_IGC_2 LV_SCG_IGC_3 LV_SCP_IGC_0 LV_SCP_IGC_1 LV_SCP_IGC_2 LV_SCP_IGC_3 LV_V_VLD_IGC_0 LV_V_VLD_IGC_1 LV_V_VLD_IGC_2 LV_V_VLD_IGC_3 LV_VLD_CUR_IGC_DIAG_0 LV_VLD_CUR_IGC_DIAG_1 LV_VLD_CUR_IGC_DIAG_2 LV_VLD_CUR_IGC_DIAG_3 T_ACQ_TD_MIN_HALF_0 T_ACQ_TD_MIN_HALF_1 T_ACQ_TD_MIN_HALF_2 T_ACQ_TD_MIN_HALF_3 V_IGN_TD_MIN_HALF_0 V_IGN_TD_MIN_HALF_1 V_IGN_TD_MIN_HALF_2 V_IGN_TD_MIN_HALF_3 /end OUT_MEASUREMENT
/end FUNCTION
/begin FUNCTION IGRE_Spark_Adv_and_Dwell_Output "Spark_Advance_and_Dwell_Output"
 /begin DEF_CHARACTERISTIC ip_td_fac_max ip_td_fac_min c_td_fac_st_max c_td_fac_st_min c_td_vb_max lc_igc_lih_conf /end DEF_CHARACTERISTIC
 /begin OUT_MEASUREMENT igc_conf lv_ign_lih td_fac_max td_fac_min /end OUT_MEASUREMENT
/end FUNCTION
/begin FUNCTION IGRE_Dwell_time_ad_appl_inci ""
 /begin DEF_CHARACTERISTIC ldpm_n32_ip_cur_ad_sp ip_cur_ad_sp ip_cur_ad_sp_st ip_cur_ad_sp_tra c_cur_ad_sp_ofs c_vb_td_ad_max c_vb_td_ad_min lc_td_ad_ini_lih lc_td_ad_st lc_td_ad_tra /end DEF_CHARACTERISTIC
 /begin OUT_MEASUREMENT cur_ad_sp lv_inh_td_ad LV_TD_AD_INI_REQ /end OUT_MEASUREMENT
/end FUNCTION
/begin FUNCTION IGRE_Dwell_time_adaptation ""
 /begin DEF_CHARACTERISTIC c_cur_ad_min c_fac_cur_ad_bas c_fac_td_ad_cor c_fac_td_ad_igc c_fac_td_ad_max c_fac_td_ad_min c_td_ad_ini_conf lc_td_ad_clr /end DEF_CHARACTERISTIC
 /begin OUT_MEASUREMENT cur_igc_mv[0] cur_igc_mv[1] cur_igc_mv[2] cur_igc_mv[3] cur_igc_pred[0] cur_igc_pred[1] cur_igc_pred[2] cur_igc_pred[3] cur_igc_td_end[0] cur_igc_td_end[1] cur_igc_td_end[2] cur_igc_td_end[3] cur_igc_td_min_half_cor[0] cur_igc_td_min_half_cor[1] cur_igc_td_min_half_cor[2] cur_igc_td_min_half_cor[3] fac_td_ad[1] fac_td_ad[2] fac_td_ad[3] fac_td_ad[4] fac_td_ad_max[1] fac_td_ad_max[2] fac_td_ad_max[3] fac_td_ad_max[4] fac_td_ad_min[1] fac_td_ad_min[2] fac_td_ad_min[3] fac_td_ad_min[4] fac_td_temp[1] fac_td_temp[2] fac_td_temp[3] fac_td_temp[4] lv_inh_td_ad_cyl[0] lv_inh_td_ad_cyl[1] lv_inh_td_ad_cyl[2] lv_inh_td_ad_cyl[3] lv_td_ad_acq_vld[0] lv_td_ad_acq_vld[1] lv_td_ad_acq_vld[2] lv_td_ad_acq_vld[3] lv_v_td_end_vld[0] lv_v_td_end_vld[1] lv_v_td_end_vld[2] lv_v_td_end_vld[3] t_acq_td_end[0] t_acq_td_end[1] t_acq_td_end[2] t_acq_td_end[3] td_igc_tmp[0] td_igc_tmp[1] td_igc_tmp[2] td_igc_tmp[3] v_igc_td_end[0] v_igc_td_end[1] v_igc_td_end[2] v_igc_td_end[3] /end OUT_MEASUREMENT
/end FUNCTION
/begin FUNCTION C_6_IGRE "C_6_IGRE" /begin DEF_CHARACTERISTIC ldpm_n_32_1_igre ldpm_vb_1_igre ldp_tco_ip_id_temp_fac /end DEF_CHARACTERISTIC
 /begin SUB_FUNCTION IGRE_Dwell_time_control IGRE_Ignition_activation_control IGRE_Ignition_multiple_spark IGRE_TD_and_IGA_switches IGRE_Dwell_time_factor_calc /end SUB_FUNCTION
/end FUNCTION
/begin FUNCTION IGRE_Dwell_time_control "Dwell_time_control" /begin DEF_CHARACTERISTIC ip_td c_td_as c_td_ini /end DEF_CHARACTERISTIC /begin OUT_MEASUREMENT td /end OUT_MEASUREMENT /end FUNCTION
/begin FUNCTION IGRE_Ignition_activation_control "Ignition_activation_control" /begin OUT_MEASUREMENT inh_igc lv_ign_seq_di_ena /end OUT_MEASUREMENT /end FUNCTION
/begin FUNCTION IGRE_Ignition_multiple_spark "Ignition_multiple_spark"
 /begin DEF_CHARACTERISTIC ldp_tco_ip_nr_mpl ip_nr_mpl ip_nr_mpl_s ip_td_mpl ip_td_mpl_s c_n_max_mpl_is c_n_max_mpl_pl_pu_fl c_n_max_mpl_puc c_n_max_mpl_st c_n_min_mpl_is c_n_min_mpl_pl_pu_fl c_n_min_mpl_puc c_n_min_mpl_st c_t_ctr_td_mpl c_t_ctr_td_mpl_ast c_tco_max_mpl_is c_tco_max_mpl_pl_pu_fl c_tco_max_mpl_puc c_tco_max_mpl_st c_td_mpl_man c_td_t_mpl c_vb_max_mpl_is c_vb_max_mpl_pl_pu_fl c_vb_max_mpl_puc c_vb_max_mpl_st /end DEF_CHARACTERISTIC
 /begin OUT_MEASUREMENT ign_mpl_nr t_ctr_td_mpl td_mpl td_mpl_dly /end OUT_MEASUREMENT
/end FUNCTION
/begin FUNCTION IGRE_TD_and_IGA_switches "TD_and_IGA_switches" /begin DEF_CHARACTERISTIC c_td_eol /end DEF_CHARACTERISTIC
 /begin OUT_MEASUREMENT IGA_IGC_SHIFT_RNG_0 IGA_IGC_SHIFT_RNG_1 IGA_IGC_SHIFT_RNG_2 IGA_IGC_SHIFT_RNG_3 TD_IGC_0 TD_IGC_1 TD_IGC_2 TD_IGC_3 /end OUT_MEASUREMENT
/end FUNCTION
/begin FUNCTION IGRE_Dwell_time_factor_calc "Dwell_time_factor_calc" /begin DEF_CHARACTERISTIC ip_td_fac ip_td_st_fac ip_td_temp_fac /end DEF_CHARACTERISTIC /begin OUT_MEASUREMENT td_fac td_st_fac TD_TEMP_FAC /end OUT_MEASUREMENT /end FUNCTION
/begin FUNCTION C_A_IGRE "C_A_IGRE" /begin SUB_FUNCTION IGRE_Ignition_diagnosis IGRE_Appli_inci_ignition_diag /end SUB_FUNCTION /end FUNCTION
/begin FUNCTION IGRE_Ignition_diagnosis "Ignition_diagnosis"
 /begin DEF_CHARACTERISTIC c_esb_ign_cut_diag c_iga_off_cyc_nr_hld c_iga_on_cyc_nr_hld c_n_32_min_ol_scg_igc_diag c_n_32_min_scp_igc_diag c_sum_igc_scp c_tco_min_igc_diag /end DEF_CHARACTERISTIC
 /begin OUT_MEASUREMENT ctr_iga_off_cyc_nr_hld[0] ctr_iga_off_cyc_nr_hld[1] ctr_iga_off_cyc_nr_hld[2] ctr_iga_off_cyc_nr_hld[3] ctr_iga_on_cyc_nr_hld[0] ctr_iga_on_cyc_nr_hld[1] ctr_iga_on_cyc_nr_hld[2] ctr_iga_on_cyc_nr_hld[3] ctr_inh_igc_scp[0] ctr_inh_igc_scp[1] ctr_inh_igc_scp[2] ctr_inh_igc_scp[3] ctr_inh_igc_scp_all[0] ctr_inh_igc_scp_all[1] ctr_inh_igc_scp_all[2] ctr_inh_igc_scp_all[3] ctr_sum_igc_scp[0] ctr_sum_igc_scp[1] ctr_sum_igc_scp[2] ctr_sum_igc_scp[3] igc_diag_mis lv_err_igc lv_err_igc_ol[0] lv_err_igc_ol[1] lv_err_igc_ol[2] lv_err_igc_ol[3] lv_err_igc_scg[0] lv_err_igc_scg[1] lv_err_igc_scg[2] lv_err_igc_scg[3] lv_err_igc_scp[0] lv_err_igc_scp[1] lv_err_igc_scp[2] lv_err_igc_scp[3] lv_err_igc_scp_cfm[0] lv_err_igc_scp_cfm[1] lv_err_igc_scp_cfm[2] lv_err_igc_scp_cfm[3] LV_INH_IGC_0 LV_INH_IGC_1 LV_INH_IGC_2 LV_INH_IGC_3 /end OUT_MEASUREMENT
/end FUNCTION
/begin FUNCTION IGRE_Appli_inci_ignition_diag "Appli_inci_ignition_diag" /begin DEF_CHARACTERISTIC c_ctr_inh_diag_igc /end DEF_CHARACTERISTIC
 /begin OUT_MEASUREMENT ctr_inh_diag_igc inh_iv_igc lv_cdn_inh_diag_ol_igc lv_cdn_inh_diag_scg_igc lv_cdn_inh_diag_scp_igc /end OUT_MEASUREMENT
/end FUNCTION
/begin FUNCTION CbRicCtl ""
 /begin OUT_MEASUREMENT Vxx_mv_ad_lsm_ctr Vxx_mv_ti_ad_ofs Vxx_mv_ti_ad_fac Vtd_max_ti_b[0] Vtd_max_ti_b[1] Vtd_max_ti_b[2] Vtd_max_ti_b[3] Vtd_max_ti_b[4] Vtd_min_ti_b[0] Vtd_min_ti_b[1] Vtd_min_ti_b[2] Vtd_min_ti_b[3] Vtd_min_ti_b[4] Vbx_ti_ad4_zon Vtd_ti_ad1_zon[0] Vtd_ti_ad1_zon[1] Vtd_ti_ad1_zon[2] Vtd_ti_ad1_zon[3] Vtd_ti_ad1_zon[4] /end OUT_MEASUREMENT
 /begin SUB_FUNCTION CbRicCtl_Wlwetxx CbRicCtl_Dbllpxx CbRicCtl_Ricclxx CbRicCtl_Ricloxx CbRicCtl_Ricadxx /end SUB_FUNCTION
/end FUNCTION
/end MODULE
/end PROJECT
/* -------------------------------------------------------------------------
Visu-IT! - Data Declaration System (DDS)
Quality FE<0> NCE<0> E<10938> W<0>
Quantity Maps <647> Parameter<4954> Axes<257> Online<8981>
------------------------------------------------------------------------- */
