ASAP2_VERSION 1 41
/begin PROJECT RD8 "_default_ProjectLongIdentifier"
/begin HEADER "_default_HeaderComment" PROJECT_NO RD9 /end HEADER
/begin MODULE _default_ModuleName "_default_ModuleLongIdentifier"
/begin MOD_COMMON "_default_ModCommonComment" DEPOSIT ABSOLUTE BYTE_ORDER MSB_LAST ALIGNMENT_BYTE 1 ALIGNMENT_WORD 2 ALIGNMENT_LONG 2 ALIGNMENT_FLOAT32_IEEE 2 ALIGNMENT_FLOAT64_IEEE 4 /end MOD_COMMON
/begin AXIS_PTS Ntb_gear "Gearbox ratio breakpoint" 0xa002ac48 Vxx_gear _REC_A2AXS_20_u1 7. _CNV_A_R_LINEAR_____113_CM 8 -1. 6. READ_ONLY FORMAT "%2.0" /end AXIS_PTS
/begin MEASUREMENT Vbx_cru_sl_acel_blk "The SET+ button is blocked" UBYTE _CNV_S_2_RANGE______3_CM 1 0. 0. 1. ECU_ADDRESS 0xd0004d90 BIT_MASK 0x1 /end MEASUREMENT
/begin MEASUREMENT Vbx_cru_sl_decl_blk "The SET- button is blocked" UBYTE _CNV_S_2_RANGE______3_CM 1 0. 0. 1. ECU_ADDRESS 0xd0004d91 BIT_MASK 0x1 /end MEASUREMENT
/begin MEASUREMENT Vbx_cru_sl_lk_ena "Enable cruise control and speed limiter option detection" UBYTE _CNV_S_2_RANGE______3_CM 1 0. 0. 1. ECU_ADDRESS 0xd0004d92 BIT_MASK 0x1 /end MEASUREMENT
/begin MEASUREMENT Vbx_cru_sl_new_lk_ena "Authorization to connect cruise control and speed limiter options (=1 enable)" UBYTE _CNV_S_2_RANGE______3_CM 1 0. 0. 1. ECU_ADDRESS 0xd00056ae BIT_MASK 0x1 /end MEASUREMENT
/begin MEASUREMENT Vbx_cru_sl_resu_blk "The RESUME button is blocked" UBYTE _CNV_S_2_RANGE______3_CM 1 0. 0. 1. ECU_ADDRESS 0xd0004d93 BIT_MASK 0x1 /end MEASUREMENT
/begin MEASUREMENT Vbx_cru_sl_susp_blk "The SUSPEND button is blocked" UBYTE _CNV_S_2_RANGE______3_CM 1 0. 0. 1. ECU_ADDRESS 0xd0004d94 BIT_MASK 0x1 /end MEASUREMENT
/begin MEASUREMENT Vbx_cru_sl_whl_cmd_blk "One of the CC/SL steering wheel switches is inferred blocked" UBYTE _CNV_S_2_RANGE______3_CM 1 0. 0. 1. ECU_ADDRESS 0xd0004d95 BIT_MASK 0x1 /end MEASUREMENT
/begin MEASUREMENT Vbx_df_cru_sl_swi_chr "CCSL Main Switch Coherence detected failure" UBYTE _CNV_S_2_RANGE______3_CM 1 0. 0. 1. ECU_ADDRESS 0xd00056af BIT_MASK 0x1 /end MEASUREMENT
/begin MEASUREMENT Vbx_df_cru_whl_cmd_nok "CCSL steering wheel switched blocked button detected failure" UBYTE _CNV_S_2_RANGE______3_CM 1 0. 0. 1. ECU_ADDRESS 0xd00056b0 BIT_MASK 0x1 /end MEASUREMENT
/begin MEASUREMENT Vbx_df_cru_whl_cmd_oc_scw "CCSL steering switches open circuit detected failure" UBYTE _CNV_S_2_RANGE______3_CM 1 0. 0. 1. ECU_ADDRESS 0xd00056b1 BIT_MASK 0x1 /end MEASUREMENT
/begin MEASUREMENT Vbx_df_cru_whl_cmd_oor "CCSL Steering Wheel Command Switch invalid value detected failure" UBYTE _CNV_S_2_RANGE______3_CM 1 0. 0. 1. ECU_ADDRESS 0xd00056b2 BIT_MASK 0x1 /end MEASUREMENT
/begin MEASUREMENT Vsx_cru_sl_on_off "CC or SL strategy requested by the driver" UBYTE _CNV_A_R_ECME_LINEA_0_CM 1 0. 0. 2. ECU_ADDRESS 0xd0004d8c FORMAT "%1.0" /end MEASUREMENT
/begin MEASUREMENT Vsx_cru_sl_on_off_raw "State of the on off main switch before filtering" UBYTE _CNV_A_R_ECME_LINEA_0_CM 1 0. 0. 3. ECU_ADDRESS 0xd00056b3 FORMAT "%1.0" /end MEASUREMENT
/begin MEASUREMENT Vsx_cru_sl_swi_vld "CCSL switches function validity status: Vsx_cru_sl_swi_vld != Nsx_vld_ok_1 significates that the switches function is out of order" UBYTE _CNV_A_R_ECME_LINEA_0_CM 1 0. 0. 1. ECU_ADDRESS 0xd00056b4 FORMAT "%1.0" /end MEASUREMENT
/begin MEASUREMENT Vxx_acc_cmd_stt "ACC steering wheel commands transmitted to ACC ECU" UBYTE _CNV_A_R_ECME_LINEA_0_CM 1 0. 0. 31. ECU_ADDRESS 0xd0004d8d FORMAT "%2.0" /end MEASUREMENT
/begin MEASUREMENT Vxx_acc_swi "ACC/speed limiter main switch position transmitted to ACC ECU" UBYTE _CNV_A_R_ECME_LINEA_0_CM 1 0. 0. 3. ECU_ADDRESS 0xd00056b5 FORMAT "%1.0" /end MEASUREMENT
/begin MEASUREMENT Vxx_cru_sl_whl_cmd_raw "State of the steering wheel buttons : not filtered" UBYTE _CNV_A_R_ECME_LINEA_0_CM 1 0. 0. 6. ECU_ADDRESS 0xd00056b6 FORMAT "%1.0" /end MEASUREMENT
/begin MEASUREMENT Vxx_cru_sl_whl_cmd_stt "State of the steering wheel push buttons" UBYTE _CNV_A_R_ECME_LINEA_0_CM 1 0. 0. 6. ECU_ADDRESS 0xd0004d8e FORMAT "%1.0" /end MEASUREMENT
/begin MEASUREMENT Vxx_sta_swi_act_ctr "Counter : increment at each START button push" UBYTE _CNV_A_R_ECME_LINEA_0_CM 1 0. 0. 7. ECU_ADDRESS 0xd0004d8f FORMAT "%1.0" /end MEASUREMENT
/begin CHARACTERISTIC Cbx_cru_sl_lk_rls_ena "Connection detection with the release position authorized (1 = authorized)" VALUE 0xa002094c _REC_S1VAL_20_u1 1. _CNV_S_2_RANGE______3_CM 0. 1. /end CHARACTERISTIC
/begin CHARACTERISTIC Cbx_cru_sl_swi_chr_prmt "The CC/SL failure due to main switch incoherence is irreversible" VALUE 0xa002094d _REC_S1VAL_20_u1 1. _CNV_S_2_RANGE______3_CM 0. 1. /end CHARACTERISTIC
/begin CHARACTERISTIC Cxx_cru_sl_acel_blk_dly "Maxixmum duration of the SET+ press before blocked switch detection" VALUE 0xa0020922 _REC_S1VAL_20_u2 6553.5 _CNV_A_R_LINEAR_____4_CM 0. 6553.5 FORMAT "%6.1" /end CHARACTERISTIC
/begin CHARACTERISTIC Cxx_cru_sl_acel_max_thd "Maximum dec threshold to detect an accel switch press" VALUE 0xa0020924 _REC_S1VAL_20_u2 25000. _CNV_A_R_LINEAR_____52_CM 0. 25000. FORMAT "%5.0" /end CHARACTERISTIC
/begin CHARACTERISTIC Cxx_cru_sl_acel_min_thd "Minimum dec threshold to detect an accel switch press" VALUE 0xa0020926 _REC_S1VAL_20_u2 25000. _CNV_A_R_LINEAR_____52_CM 0. 25000. FORMAT "%5.0" /end CHARACTERISTIC
/begin CHARACTERISTIC Cxx_cru_sl_decl_blk_dly "Maxixmum duration of the SET- press before blocked switch detection" VALUE 0xa0020928 _REC_S1VAL_20_u2 6553.5 _CNV_A_R_LINEAR_____4_CM 0. 6553.5 FORMAT "%6.1" /end CHARACTERISTIC
/begin CHARACTERISTIC Cxx_cru_sl_decl_max_thd "Maximum dec threshold to detect a decel switch press" VALUE 0xa002092a _REC_S1VAL_20_u2 25000. _CNV_A_R_LINEAR_____52_CM 0. 25000. FORMAT "%5.0" /end CHARACTERISTIC
/begin CHARACTERISTIC Cxx_cru_sl_decl_min_thd "Minimum dec threshold to detect a decel switch press" VALUE 0xa002092c _REC_S1VAL_20_u2 25000. _CNV_A_R_LINEAR_____52_CM 0. 25000. FORMAT "%5.0" /end CHARACTERISTIC
/begin CHARACTERISTIC Cxx_cru_sl_lk_ena_dly "Filter time to enable the cruise control and speed limiter option detection" VALUE 0xa002094e _REC_S1VAL_20_u1 2.55 _CNV_A_R_LINEAR_____34_CM 0. 2.55 FORMAT "%4.2" /end CHARACTERISTIC
/begin CHARACTERISTIC Cxx_cru_sl_lk_vb_thd "Minimum battery voltage to enable the cruise control and speed limiter option detection" VALUE 0xa002092e _REC_S1VAL_20_u2 25000. _CNV_A_R_LINEAR_____52_CM 0. 25000. FORMAT "%5.0" /end CHARACTERISTIC
/begin CHARACTERISTIC Cxx_cru_sl_open_min_thd "Minimum dec threshold to detect not-connected steering wheel switch" VALUE 0xa0020930 _REC_S1VAL_20_u2 25000. _CNV_A_R_LINEAR_____52_CM 0. 25000. FORMAT "%5.0" /end CHARACTERISTIC
/begin CHARACTERISTIC Cxx_cru_sl_resu_blk_dly "Maxixmum duration of the RESUME press before blocked switch detection" VALUE 0xa0020932 _REC_S1VAL_20_u2 6553.5 _CNV_A_R_LINEAR_____4_CM 0. 6553.5 FORMAT "%6.1" /end CHARACTERISTIC
/begin CHARACTERISTIC Cxx_cru_sl_resu_max_thd "Maximum dec threshold to detect a resume switch press" VALUE 0xa0020934 _REC_S1VAL_20_u2 25000. _CNV_A_R_LINEAR_____52_CM 0. 25000. FORMAT "%5.0" /end CHARACTERISTIC
/begin CHARACTERISTIC Cxx_cru_sl_resu_min_thd "Minimum dec threshold to detect a resume switch press" VALUE 0xa0020936 _REC_S1VAL_20_u2 25000. _CNV_A_R_LINEAR_____52_CM 0. 25000. FORMAT "%5.0" /end CHARACTERISTIC
/begin CHARACTERISTIC Cxx_cru_sl_rls_max_thd "Maximum dec threshold to detect non-pressed steering wheel switch" VALUE 0xa0020938 _REC_S1VAL_20_u2 25000. _CNV_A_R_LINEAR_____52_CM 0. 25000. FORMAT "%5.0" /end CHARACTERISTIC
/begin CHARACTERISTIC Cxx_cru_sl_rls_min_thd "Minimum dec threshold to detect non-pressed steering wheel switch" VALUE 0xa002093a _REC_S1VAL_20_u2 25000. _CNV_A_R_LINEAR_____52_CM 0. 25000. FORMAT "%5.0" /end CHARACTERISTIC
/begin CHARACTERISTIC Cxx_cru_sl_susp_blk_dly "Maxixmum duration of the SUSPEND press before blocked switch detection" VALUE 0xa002093c _REC_S1VAL_20_u2 6553.5 _CNV_A_R_LINEAR_____4_CM 0. 6553.5 FORMAT "%6.1" /end CHARACTERISTIC
/begin CHARACTERISTIC Cxx_cru_sl_susp_max_thd "Maximum dec threshold to detect a suspend switch press" VALUE 0xa002093e _REC_S1VAL_20_u2 25000. _CNV_A_R_LINEAR_____52_CM 0. 25000. FORMAT "%5.0" /end CHARACTERISTIC
/begin CHARACTERISTIC Cxx_cru_sl_swi_dly "Main switch press validation time" VALUE 0xa002094f _REC_S1VAL_20_u1 25.5 _CNV_A_R_LINEAR_____4_CM 0. 25.5 FORMAT "%4.1" /end CHARACTERISTIC
/begin CHARACTERISTIC Cxx_cru_sl_swi_igk_dly "Delay to take into account a APC line cut-off" VALUE 0xa0020950 _REC_S1VAL_20_u1 25.5 _CNV_A_R_LINEAR_____4_CM 0. 25.5 FORMAT "%4.1" /end CHARACTERISTIC
/begin CHARACTERISTIC Cxx_cru_sl_whl_cmd_blk_ctr_max "CC/SL: maximum number of unexpected switch changes before blocked switch detection" VALUE 0xa0020951 _REC_S1VAL_20_u1 255. _CNV_A_R_ECME_LINEA_0_CM 0. 255. FORMAT "%3.0" /end CHARACTERISTIC
/begin CHARACTERISTIC Cxx_cru_sl_whl_swi_dly "Steering wheel switch press validation time" VALUE 0xa0020952 _REC_S1VAL_20_u1 2.55 _CNV_A_R_LINEAR_____34_CM 0. 2.55 FORMAT "%4.2" /end CHARACTERISTIC
/begin CHARACTERISTIC Cxx_dfdec_cru_sl_swi_chr "Cruise Control Main Switch Coherence detected failure counter decrement" VALUE 0xa0020940 _REC_S1VAL_20_u2 65535. _CNV_A_R_ECME_LINEA_0_CM 0. 65535. FORMAT "%5.0" /end CHARACTERISTIC
/begin CHARACTERISTIC Cxx_dfdec_cru_whl_cmd "Cruise Control Steering Wheel Command Switch Detected Failure Counter Decrement" VALUE 0xa0020942 _REC_S1VAL_20_u2 65535. _CNV_A_R_ECME_LINEA_0_CM 0. 65535. FORMAT "%5.0" /end CHARACTERISTIC
/begin CHARACTERISTIC Cxx_dfdec_cru_whl_cmd_nok "CCSL steering wheel switches blocked button detected failure counter decrement" VALUE 0xa0020944 _REC_S1VAL_20_u2 65535. _CNV_A_R_ECME_LINEA_0_CM 0. 65535. FORMAT "%5.0" /end CHARACTERISTIC
/begin CHARACTERISTIC Cxx_dfinc_cru_sl_swi_chr "Cruise Control Main Switch Coherence detected failure counter increment" VALUE 0xa0020946 _REC_S1VAL_20_u2 65535. _CNV_A_R_ECME_LINEA_0_CM 0. 65535. FORMAT "%5.0" /end CHARACTERISTIC
/begin CHARACTERISTIC Cxx_dfinc_cru_whl_cmd "Cruise Control Steering Wheel Command Switch Detected Failure Counter Increment" VALUE 0xa0020948 _REC_S1VAL_20_u2 65535. _CNV_A_R_ECME_LINEA_0_CM 0. 65535. FORMAT "%5.0" /end CHARACTERISTIC
/begin CHARACTERISTIC Cxx_dfinc_cru_whl_cmd_nok "CCSL steering wheel switches blocked button detected failure counter increment" VALUE 0xa002094a _REC_S1VAL_20_u2 65535. _CNV_A_R_ECME_LINEA_0_CM 0. 65535. FORMAT "%5.0" /end CHARACTERISTIC
/begin MEASUREMENT Vbx_cru_swi "" UBYTE _CNV_S_2_RANGE______3_CM 1 0. 0. 1. DISPLAY_IDENTIFIER PcCruCtl_NVM.Vbx_cru_swi_NVM ECU_ADDRESS 0xd0004118 BIT_MASK 0x1 /end MEASUREMENT
/begin MEASUREMENT Vxx_cru_cmp_diag "" UBYTE _CNV_A_R_ECME_LINEA_0_CM 1 0. 0. 255. DISPLAY_IDENTIFIER PcCruCtl_NVM.Vxx_cru_cmp_diag_NVM ECU_ADDRESS 0xd0004119 FORMAT "%3.0" /end MEASUREMENT
/begin MEASUREMENT Vbx_cru_cmp_bgin_clu "CC safety failure due to wired clutch information" UBYTE _CNV_S_2_RANGE______3_CM 1 0. 0. 1. ECU_ADDRESS 0xd000411f BIT_MASK 0x1 /end MEASUREMENT
/begin MEASUREMENT Vbx_cru_cmp_forc_pres "CC safety failure due to force setpoint presence" UBYTE _CNV_S_2_RANGE______3_CM 1 0. 0. 1. ECU_ADDRESS 0xd0004120 BIT_MASK 0x1 /end MEASUREMENT
/begin MEASUREMENT Vbx_cru_cmp_open_brk "CC safety failure due to brake clutch information" UBYTE _CNV_S_2_RANGE______3_CM 1 0. 0. 1. ECU_ADDRESS 0xd0004121 BIT_MASK 0x1 /end MEASUREMENT
/begin MEASUREMENT Vxx_cru_cmp_diag_new "carrier for safety failure diagnosis" UBYTE _CNV_A_R_ECME_LINEA_0_CM 1 0. 0. 255. ECU_ADDRESS 0xd000411a FORMAT "%3.0" /end MEASUREMENT
/begin MEASUREMENT Vxx_cru_cmp_diag_prev "Previous carrier for safety failure diagnosis" UBYTE _CNV_A_R_ECME_LINEA_0_CM 1 0. 0. 255. ECU_ADDRESS 0xd000411b FORMAT "%3.0" /end MEASUREMENT
/begin MEASUREMENT Vxx_cru_forc_sp "Driving force requested by Cruise Control" SLONG _CNV_A_R_LINEAR_____295_CM 1 0. -20000. 111068. ECU_ADDRESS 0xd0001ac0 FORMAT "%6.0" /end MEASUREMENT
/begin MEASUREMENT Vxx_cru_sl_stt "Cruise control and speed limiter status : parameter sent to the gearbox on the can network" UBYTE _CNV_A_R_ECME_LINEA_0_CM 1 0. 0. 3. ECU_ADDRESS 0xd000411c FORMAT "%1.0" /end MEASUREMENT
/begin MEASUREMENT Vxx_cru_sl_stt_ip "Cruise control and speed limiter status : parameter sent to the cluster on the can network" UBYTE _CNV_A_R_ECME_LINEA_0_CM 1 0. 0. 7. ECU_ADDRESS 0xd000411d FORMAT "%1.0" /end MEASUREMENT
/begin MEASUREMENT Vxx_cru_sl_vs_sp "Cruise control and speed limiter requested speed sent to the cluster on the can network" UBYTE _CNV_A_R_ECME_LINEA_0_CM 1 0. 0. 255. ECU_ADDRESS 0xd000411e FORMAT "%3.0" /end MEASUREMENT
/begin MEASUREMENT Vxx_csl_forc_sp "Driving force requested by Costumer Speed Limiter" SLONG _CNV_A_R_LINEAR_____295_CM 1 0. -20000. 111068. ECU_ADDRESS 0xd0001ac4 FORMAT "%6.0" /end MEASUREMENT
/begin CHARACTERISTIC Cbx_bgin_clu_fail_ccp_ena "Enabling boolean for ccp clutch coherence" VALUE 0xa0021544 _REC_S1VAL_20_u1 1. _CNV_S_2_RANGE______3_CM 0. 1. /end CHARACTERISTIC
/begin CHARACTERISTIC Cbx_bgin_clu_fail_co_ena "Enabling boolean for co clutch coherence" VALUE 0xa0021545 _REC_S1VAL_20_u1 1. _CNV_S_2_RANGE______3_CM 0. 1. /end CHARACTERISTIC
/begin CHARACTERISTIC Cbx_brk_fail_ccp_ena "Enabling boolean for ccp brake coherence" VALUE 0xa0021546 _REC_S1VAL_20_u1 1. _CNV_S_2_RANGE______3_CM 0. 1. /end CHARACTERISTIC
/begin CHARACTERISTIC Cbx_brk_fail_co_ena "Enabling boolean for co brake coherence" VALUE 0xa0021547 _REC_S1VAL_20_u1 1. _CNV_S_2_RANGE______3_CM 0. 1. /end CHARACTERISTIC
/begin CHARACTERISTIC Cbx_ena_brk_cru_swi_cfm "Enabling boolean for safety strategy on brake  switch" VALUE 0xa0021548 _REC_S1VAL_20_u1 1. _CNV_A_R_ECME_LINEA_0_CM 0. 1. FORMAT "%1.0" BIT_MASK 0x1 /end CHARACTERISTIC
/begin CHARACTERISTIC Cbx_ena_clu_cru_swi_cfm "Enabling boolean for safety strategy on clutch  switch" VALUE 0xa0021549 _REC_S1VAL_20_u1 1. _CNV_A_R_ECME_LINEA_0_CM 0. 1. FORMAT "%1.0" BIT_MASK 0x1 /end CHARACTERISTIC
/begin CHARACTERISTIC Cxx_bgin_clu_fail_ccp_dly "Admissible delay of incoherence between clutch information due to CAN communication" VALUE 0xa0021526 _REC_S1VAL_20_u2 655.35 _CNV_A_R_LINEAR_____34_CM 0. 655.35 FORMAT "%6.2" /end CHARACTERISTIC
/begin CHARACTERISTIC Cxx_bgin_clu_fail_co_dly "Admissible delay of incoherence between clutch information due to CAN communication" VALUE 0xa0021528 _REC_S1VAL_20_u2 655.35 _CNV_A_R_LINEAR_____34_CM 0. 655.35 FORMAT "%6.2" /end CHARACTERISTIC
/begin CHARACTERISTIC Cxx_brk_fail_ccp_dly "Admissible delay of incoherence between brake information due to CAN communication" VALUE 0xa002152a _REC_S1VAL_20_u2 655.35 _CNV_A_R_LINEAR_____34_CM 0. 655.35 FORMAT "%6.2" /end CHARACTERISTIC
/begin CHARACTERISTIC Cxx_brk_fail_co_dly "Admissible delay of incoherence between brake information due to CAN communication" VALUE 0xa002152c _REC_S1VAL_20_u2 655.35 _CNV_A_R_LINEAR_____34_CM 0. 655.35 FORMAT "%6.2" /end CHARACTERISTIC
/begin CHARACTERISTIC Cxx_cru_forc_sp_dly "Delay for cruise control comfortable deactivation before safety failure detection" VALUE 0xa002152e _REC_S1VAL_20_u2 655.35 _CNV_A_R_LINEAR_____34_CM 0. 655.35 FORMAT "%6.2" /end CHARACTERISTIC
/begin CHARACTERISTIC Cxx_cru_forc_sp_thd "Threshold for the maximum force request out of cruise control conditions" VALUE 0xa0021530 _REC_S1VAL_20_s4 131068. _CNV_A_R_LINEAR_____295_CM -20000. 111068. FORMAT "%6.0" /end CHARACTERISTIC
/begin CHARACTERISTIC Cxx_dfdec_bgin_clu_cmp "Incoherence between clutch information detected failure counter decrement." VALUE 0xa0021534 _REC_S1VAL_20_u2 65535. _CNV_A_R_ECME_LINEA_0_CM 0. 65535. FORMAT "%5.0" /end CHARACTERISTIC
/begin CHARACTERISTIC Cxx_dfdec_brk_pdl_cmp "Incoherence between brake information detected failure counter decrement." VALUE 0xa0021536 _REC_S1VAL_20_u2 65535. _CNV_A_R_ECME_LINEA_0_CM 0. 65535. FORMAT "%5.0" /end CHARACTERISTIC
/begin CHARACTERISTIC Cxx_dfdec_cru_cmp "Cruise control safety detected failure counter decrement." VALUE 0xa0021538 _REC_S1VAL_20_u2 65535. _CNV_A_R_ECME_LINEA_0_CM 0. 65535. FORMAT "%5.0" /end CHARACTERISTIC
/begin CHARACTERISTIC Cxx_dfinc_bgin_clu_cmp "Incoherence between clutch information detected failure counter increment." VALUE 0xa002153a _REC_S1VAL_20_u2 65535. _CNV_A_R_ECME_LINEA_0_CM 0. 65535. FORMAT "%5.0" /end CHARACTERISTIC
/begin CHARACTERISTIC Cxx_dfinc_brk_pdl_cmp "Incoherence between brake information detected failure counter increment." VALUE 0xa002153c _REC_S1VAL_20_u2 65535. _CNV_A_R_ECME_LINEA_0_CM 0. 65535. FORMAT "%5.0" /end CHARACTERISTIC
/begin CHARACTERISTIC Cxx_dfinc_cru_cmp "Cruise control safety detected failure counter increment." VALUE 0xa002153e _REC_S1VAL_20_u2 65535. _CNV_A_R_ECME_LINEA_0_CM 0. 65535. FORMAT "%5.0" /end CHARACTERISTIC
/begin CHARACTERISTIC Cxx_wf_bgin_clu_rams_dly "Delay to confirm activated clutch for safety needs" VALUE 0xa0021540 _REC_S1VAL_20_u2 655.35 _CNV_A_R_LINEAR_____34_CM 0. 655.35 FORMAT "%6.2" /end CHARACTERISTIC
/begin CHARACTERISTIC Cxx_wf_brk_rams_dly "Delay to confirm activated brake for safety needs" VALUE 0xa0021542 _REC_S1VAL_20_u2 655.35 _CNV_A_R_LINEAR_____34_CM 0. 655.35 FORMAT "%6.2" /end CHARACTERISTIC
/begin AXIS_PTS Ctb_cru_sl_vs "Speed breakpoints " 0xa0028de4 Vxx_vs _REC_A2AXS_20_u1 255. _CNV_A_R_LINEAR_____212_CM 17 0. 255. FORMAT "%3.0" /end AXIS_PTS
/begin CHARACTERISTIC Ctp_dyn_forc "Cartography of resistive effort function of vehicle speed" CURVE 0xa0028df8 _REC_A1CUR_20_u1_u1 6375. _CNV_A_R_LINEAR_____409_CM 0. 6375. FORMAT "%4.0"
 /begin AXIS_DESCR COM_AXIS Vxx_vs _CNV_A_R_LINEAR_____212_CM 17 0. 255. FORMAT "%3.0" AXIS_PTS_REF Ctb_cru_sl_vs /end AXIS_DESCR
/end CHARACTERISTIC
/begin MEASUREMENT Vbx_cru_act "Initialize the CC servo-control speed reference" UBYTE _CNV_S_2_RANGE______3_CM 1 0. 0. 1. ECU_ADDRESS 0xd0004128 BIT_MASK 0x1 /end MEASUREMENT
/begin MEASUREMENT Vbx_cru_mstr "Arbitrated powertrain setpoint equal to Cruise Control setpoint" UBYTE _CNV_S_2_RANGE______3_CM 1 0. 0. 1. ECU_ADDRESS 0xd0004129 BIT_MASK 0x1 /end MEASUREMENT
/begin MEASUREMENT Vbx_cru_mstr_prev "Arbitrated powertrain setpoint equal to Cruise Control setpoint" UBYTE _CNV_S_2_RANGE______3_CM 1 0. 0. 1. ECU_ADDRESS 0xd000412a BIT_MASK 0x1 /end MEASUREMENT
/begin MEASUREMENT Vbx_cru_sl_svkl_act "Control loop active" UBYTE _CNV_S_2_RANGE______3_CM 1 0. 0. 1. ECU_ADDRESS 0xd000412b BIT_MASK 0x1 /end MEASUREMENT
/begin MEASUREMENT Vbx_csl_mstr "Arbitrated powertrain setpoint equal to Costumer Speed limiter setpoint" UBYTE _CNV_S_2_RANGE______3_CM 1 0. 0. 1. ECU_ADDRESS 0xd000412c BIT_MASK 0x1 /end MEASUREMENT
/begin MEASUREMENT Vxx_cru_fil_vs_ref "CC filtred speed at the corrector input" UWORD _CNV_A_R_LINEAR_____70_CM 1 0. 0. 655.35 ECU_ADDRESS 0xd0002e58 FORMAT "%6.2" /end MEASUREMENT
/begin MEASUREMENT Vxx_cru_fil_vs_ref_init "First of previous CC filtred speed at the corrector input" UWORD _CNV_A_R_LINEAR_____70_CM 1 0. 0. 655.35 ECU_ADDRESS 0xd0002e5a FORMAT "%6.2" /end MEASUREMENT
/begin MEASUREMENT Vxx_cru_fil_vs_ref_prev "Previous CC filtred speed at the corrector input" UWORD _CNV_A_R_LINEAR_____70_CM 1 0. 0. 655.35 ECU_ADDRESS 0xd0002e5c FORMAT "%6.2" /end MEASUREMENT
/begin MEASUREMENT Vxx_cru_forc_sp_nom "Driving force requested by Cruise Control" SLONG _CNV_A_R_LINEAR_____295_CM 1 0. -20000. 111068. ECU_ADDRESS 0xd0001658 FORMAT "%6.0" /end MEASUREMENT
/begin MEASUREMENT Vxx_cru_sl_dyn_forc_ini "Initial resistive force (function of the vehicle speed)" UBYTE _CNV_A_R_LINEAR_____409_CM 1 0. 0. 6375. ECU_ADDRESS 0xd000412d FORMAT "%4.0" /end MEASUREMENT
/begin MEASUREMENT Vxx_cru_sl_fil_vs_ref "Filtered speed at the corrector input" UWORD _CNV_A_R_LINEAR_____70_CM 1 0. 0. 655.35 ECU_ADDRESS 0xd0002e5e FORMAT "%6.2" /end MEASUREMENT
/begin MEASUREMENT Vxx_cru_sl_forc_ref "Force request delivred by the control loop of the cruise control and speed limiter strategy" SLONG _CNV_A_R_LINEAR_____295_CM 1 0. -20000. 111068. ECU_ADDRESS 0xd000165c FORMAT "%6.0" /end MEASUREMENT
/begin MEASUREMENT Vxx_cru_sl_svkl_acel_ref "Acceleration command delivred by the control loop" SWORD _CNV_A_R_LINEAR_____410_CM 1 0. -62.5 62.4980926513672 ECU_ADDRESS 0xd0002e60 FORMAT "%2.4" /end MEASUREMENT
/begin MEASUREMENT Vxx_cru_sl_svkl_forc "Force command delivered by the control loop" SWORD _CNV_A_R_LINEAR_____411_CM 1 0. -32768. 32767. ECU_ADDRESS 0xd0002e62 FORMAT "%10.0" /end MEASUREMENT
/begin MEASUREMENT Vxx_cru_sl_svkl_forc_ref "Total wheel force command delivered by the control loop" SWORD _CNV_A_R_LINEAR_____411_CM 1 0. -32768. 32767. ECU_ADDRESS 0xd0002e64 FORMAT "%5.0" /end MEASUREMENT
/begin MEASUREMENT Vxx_cru_sl_svkl_ig "Integral gain" UWORD _CNV_A_R_LINEAR_____412_CM 1 0. 0. 1953.09519763205 ECU_ADDRESS 0xd0002e66 FORMAT "%9.3" /end MEASUREMENT
/begin MEASUREMENT Vxx_cru_sl_svkl_max_i_cor "maximum value of the integral correction" SWORD _CNV_A_R_LINEAR_____410_CM 1 0. -62.5 62.4980926513672 ECU_ADDRESS 0xd0002e68 FORMAT "%4.1" /end MEASUREMENT
/begin MEASUREMENT Vxx_cru_sl_svkl_min_i_cor "Minimum value of the integral correction" SWORD _CNV_A_R_LINEAR_____410_CM 1 0. -62.5 62.4980926513672 ECU_ADDRESS 0xd0002e6a FORMAT "%4.1" /end MEASUREMENT
/begin MEASUREMENT Vxx_cru_sl_svkl_p_cor "Propotional correction" SWORD _CNV_A_R_LINEAR_____410_CM 1 0. -62.5 62.4980926513672 ECU_ADDRESS 0xd0002e6c FORMAT "%4.1" /end MEASUREMENT
/begin MEASUREMENT Vxx_cru_sl_svkl_pg "Proportional gain" UWORD _CNV_A_R_LINEAR_____413_CM 1 0. 0. 124.998092651367 ECU_ADDRESS 0xd0002e6e FORMAT "%9.6" /end MEASUREMENT
/begin MEASUREMENT Vxx_cru_sl_svkl_vs_i_cor "Integral correction" SLONG _CNV_A_R_LINEAR_____414_CM 1 0. -62.5 62.4999999708962 ECU_ADDRESS 0xd0001660 FORMAT "%4.1" /end MEASUREMENT
/begin MEASUREMENT Vxx_cru_sl_svkl_vs_i_cor_init "First or previous integral correction" SLONG _CNV_A_R_LINEAR_____414_CM 1 0. -62.5 62.4999999708962 ECU_ADDRESS 0xd0001664 FORMAT "%4.1" /end MEASUREMENT
/begin MEASUREMENT Vxx_cru_sl_svkl_vs_i_cor_prev "Previous integral correction" SLONG _CNV_A_R_LINEAR_____414_CM 1 0. -62.5 62.4999999708962 ECU_ADDRESS 0xd0001668 FORMAT "%4.1" /end MEASUREMENT
/begin MEASUREMENT Vxx_cru_vs_ref_ofs "Reference speed increment" UWORD _CNV_A_R_LINEAR_____415_CM 1 0. 0. 655.35 ECU_ADDRESS 0xd0002e70 FORMAT "%6.2" /end MEASUREMENT
/begin MEASUREMENT Vxx_csl_forc_sp_nom "Driving force requested by Costumer Speed Limiter" SLONG _CNV_A_R_LINEAR_____295_CM 1 0. -20000. 111068. ECU_ADDRESS 0xd00013ee FORMAT "%6.0" /end MEASUREMENT
/begin MEASUREMENT Vxx_dyn_forc "Resistive force (function of the vehicle speed)" UBYTE _CNV_A_R_LINEAR_____409_CM 1 0. 0. 6375. ECU_ADDRESS 0xd000412e FORMAT "%4.0" /end MEASUREMENT
/begin CHARACTERISTIC Cbx_sl_max_i_cor "Enable (1) or disable (0) the ECE89 strategy" VALUE 0xa0021074 _REC_S1VAL_20_u1 1. _CNV_S_2_RANGE______3_CM 0. 1. /end CHARACTERISTIC
/begin CHARACTERISTIC Cxx_cru_cmf_cut_forc_dec "Force decrement/s for comfortable cut-off of cruise control." VALUE 0xa002104e _REC_S1VAL_20_u2 131070. _CNV_A_R_LINEAR_____416_CM 0. 131070. FORMAT "%6.0" /end CHARACTERISTIC
/begin CHARACTERISTIC Cxx_cru_min_forc "Minimum saturation value of the force request (lesser than the minimum force feasible by the engine)" VALUE 0xa0021050 _REC_S1VAL_20_s4 131068. _CNV_A_R_LINEAR_____295_CM -20000. 111068. FORMAT "%6.0" /end CHARACTERISTIC
/begin CHARACTERISTIC Cxx_cru_ref_vs_acel_grd "Acceleration gradient coefficient to calculatethe speed reference" VALUE 0xa0021075 _REC_S1VAL_20_s1 0.255 _CNV_A_R_LINEAR_____417_CM -0.128 0.127 FORMAT "%5.3" /end CHARACTERISTIC
/begin CHARACTERISTIC Cxx_cru_ref_vs_acel_ofs "Acceleration gradient offset to calculate the speed reference for cruise control" VALUE 0xa0021076 _REC_S1VAL_20_u1 6.375 _CNV_A_R_LINEAR_____418_CM 0. 6.375 FORMAT "%5.3" /end CHARACTERISTIC
/begin CHARACTERISTIC Cxx_cru_ref_vs_decl_grd "Deceleration gradient coefficient to calculate the speed reference" VALUE 0xa0021077 _REC_S1VAL_20_s1 0.255 _CNV_A_R_LINEAR_____417_CM -0.128 0.127 FORMAT "%5.3" /end CHARACTERISTIC
/begin CHARACTERISTIC Cxx_cru_ref_vs_decl_ofs "Declaration gradient offset to calculate the speed reference for cruise control" VALUE 0xa0021078 _REC_S1VAL_20_u1 6.375 _CNV_A_R_LINEAR_____418_CM 0. 6.375 FORMAT "%5.3" /end CHARACTERISTIC
/begin CHARACTERISTIC Cxx_cru_sp_acel_grd "Acceleration gradient coefficient to calculate the speed reference from the objective speed." VALUE 0xa0021079 _REC_S1VAL_20_s1 0.255 _CNV_A_R_LINEAR_____417_CM -0.128 0.127 FORMAT "%5.3" /end CHARACTERISTIC
/begin CHARACTERISTIC Cxx_cru_sp_decl_grd "Deceleration gradient coefficient to calculate the speed reference from the objective speed" VALUE 0xa002107a _REC_S1VAL_20_s1 0.255 _CNV_A_R_LINEAR_____417_CM -0.128 0.127 FORMAT "%5.3" /end CHARACTERISTIC
/begin CHARACTERISTIC Cxx_cru_sp_max_forc_inc "Force gradient for comfortable cruise control activation" VALUE 0xa0021054 _REC_S1VAL_20_u4 131070. _CNV_A_R_LINEAR_____416_CM 0. 131070. FORMAT "%6.0" /end CHARACTERISTIC
/begin CHARACTERISTIC Cxx_cru_svkl_ig "Cruise control integral gain" VALUE 0xa0021058 _REC_S1VAL_20_u2 1953.09519763205 _CNV_A_R_LINEAR_____419_CM 0. 1953.09519763205 FORMAT "%6.1" /end CHARACTERISTIC
/begin CHARACTERISTIC Cxx_cru_svkl_max_i_cor "Maximum value of the integral correction for Cruise control " VALUE 0xa002105a _REC_S1VAL_20_s2 124.9980926513672 _CNV_A_R_LINEAR_____410_CM -62.5 62.4980926513672 FORMAT "%4.1" /end CHARACTERISTIC
/begin CHARACTERISTIC Cxx_cru_svkl_min_i_cor "Minimum value of the integral correction for Cruise control " VALUE 0xa002105c _REC_S1VAL_20_s2 124.9980926513672 _CNV_A_R_LINEAR_____410_CM -62.5 62.4980926513672 FORMAT "%4.1" /end CHARACTERISTIC
/begin CHARACTERISTIC Cxx_cru_svkl_pg "Cruise control proportinal gain" VALUE 0xa002105e _REC_S1VAL_20_u2 124.998092651367 _CNV_A_R_LINEAR_____413_CM 0. 124.998092651367 FORMAT "%10.6" /end CHARACTERISTIC
/begin CHARACTERISTIC Cxx_cru_svkl_vs_thd "Speed threshold to activate servo-control in case of the objective speed" VALUE 0xa002107b _REC_S1VAL_20_s1 255. _CNV_A_R_LINEAR_____212_CM -128. 127. FORMAT "%3.0" /end CHARACTERISTIC
/begin CHARACTERISTIC Cxx_sl_cmf_cut_forc_inc "Force increment/s for comfortable cut-of of speed limiter" VALUE 0xa0021060 _REC_S1VAL_20_u2 131070. _CNV_A_R_LINEAR_____416_CM 0. 131070. FORMAT "%6.0" /end CHARACTERISTIC
/begin CHARACTERISTIC Cxx_sl_max_forc "Maximum saturation value of the force request (greater than the minimum force feasible by the engine)" VALUE 0xa0021062 _REC_S1VAL_20_s4 131068. _CNV_A_R_LINEAR_____295_CM -20000. 111068. FORMAT "%6.0" /end CHARACTERISTIC
/begin CHARACTERISTIC Cxx_sl_sp_max_forc_dec "Force gradient  for comfortable speed limiter activation" VALUE 0xa0021066 _REC_S1VAL_20_u4 131070. _CNV_A_R_LINEAR_____416_CM 0. 131070. FORMAT "%6.0" /end CHARACTERISTIC
/begin CHARACTERISTIC Cxx_sl_svkl_ig "speed limiter integral gain" VALUE 0xa002106a _REC_S1VAL_20_u2 1953.09519763205 _CNV_A_R_LINEAR_____419_CM 0. 1953.09519763205 FORMAT "%6.1" /end CHARACTERISTIC
/begin CHARACTERISTIC Cxx_sl_svkl_max_i_cor "Maximum value of the integral correction for speed limiter" VALUE 0xa002106c _REC_S1VAL_20_s2 124.9980926513672 _CNV_A_R_LINEAR_____410_CM -62.5 62.4980926513672 FORMAT "%4.1" /end CHARACTERISTIC
/begin CHARACTERISTIC Cxx_sl_svkl_min_i_cor "Minimal value of the integral correction for speed limiter" VALUE 0xa002106e _REC_S1VAL_20_s2 124.9980926513672 _CNV_A_R_LINEAR_____410_CM -62.5 62.4980926513672 FORMAT "%4.1" /end CHARACTERISTIC
/begin CHARACTERISTIC Cxx_sl_svkl_pg "Speed limiter proportinal gain" VALUE 0xa0021070 _REC_S1VAL_20_u2 124.998092651367 _CNV_A_R_LINEAR_____413_CM 0. 124.998092651367 FORMAT "%10.6" /end CHARACTERISTIC
/begin CHARACTERISTIC Cxx_sl_svkl_vs_thd "Speed threshold to activate servoing in case of the speed limiter" VALUE 0xa002107c _REC_S1VAL_20_s1 255. _CNV_A_R_LINEAR_____212_CM -128. 127. FORMAT "%3.0" /end CHARACTERISTIC
/begin CHARACTERISTIC Cxx_vh_wht "Vehicle mass" VALUE 0xa0021072 _REC_S1VAL_20_u2 2550. _CNV_A_R_LINEAR_____420_CM 450. 3000. FORMAT "%4.0" /end CHARACTERISTIC
/begin MEASUREMENT Vbx_sl_mstr "Arbitrated powertrain setpoint equal to Speed limiter setpoint" UBYTE _CNV_S_2_RANGE______3_CM 1 0. 0. 1. ECU_ADDRESS 0xd0004208 BIT_MASK 0x1 /end MEASUREMENT
/begin MEASUREMENT Vxx_sl_forc_sp "Driving force requested by Speed Limiter" SLONG _CNV_A_R_LINEAR_____295_CM 1 0. -20000. 111068. ECU_ADDRESS 0xd0001ab4 FORMAT "%6.0" /end MEASUREMENT
/begin MEASUREMENT Vbx_fsl_mstr "Arbitrated powertrain setpoint equal to Fixed Speed Limiter setpoint" UBYTE _CNV_S_2_RANGE______3_CM 1 0. 0. 1. ECU_ADDRESS 0xd0005378 BIT_MASK 0x1 /end MEASUREMENT
/begin MEASUREMENT Vxx_fsl_forc_sp "Driving force requested by Fixed Speed Limiter" SLONG _CNV_A_R_LINEAR_____295_CM 1 0. -20000. 111068. ECU_ADDRESS 0xd000196c FORMAT "%6.0" /end MEASUREMENT
/begin AXIS_PTS Ntb_ex_gaz_temp "17 breakpoints for Ctp_ex_gaz_temp_ofs_maf (kg/h) and Ctp_ex_gaz_temp_ofs_maf_l (kg/h) " 0xa002a7dc Vxx_pump_maf _REC_A2AXS_20_u2 3000. _CNV_A_R_LINEAR_____109_CM 17 0. 3000. READ_ONLY FORMAT "%4.3" /end AXIS_PTS
/begin AXIS_PTS Ntb_ex_gaz_temp_ofs_vs "9 breakpoints for Ctp_ex_gaz_temp_ofs_vs (km/h)" 0xa002a800 Vxx_vs _REC_A2AXS_20_u2 655.35 _CNV_A_R_LINEAR_____70_CM 9 0. 655.35 READ_ONLY FORMAT "%6.2" /end AXIS_PTS
/begin AXIS_PTS Ntb_map_cata_mdl_temp "17 breakpoints for Cmp_ex_gaz_map_n_temp" 0xa002a814 Vxx_map _REC_A2AXS_20_u2 20000. _CNV_A_R_LINEAR_____57_CM 17 0. 20000. READ_ONLY FORMAT "%5.0" /end AXIS_PTS
/begin AXIS_PTS Ntb_n_cata_mdl_temp "17 breakpoints for Cmp_ex_gaz_map_n_temp (rpm)" 0xa002a838 Vxx_n _REC_A2AXS_20_u2 16383.75 _CNV_A_R_ENSD_LINEA_24_CM 17 0. 16383.75 READ_ONLY FORMAT "%8.2" /end AXIS_PTS
/begin CHARACTERISTIC Cmp_ex_gaz_map_n_temp "Double interpolation between Ntb-map_cata_mdl_temp and Ntb_n_cata_mdl_temp" MAP 0xa002a85c _REC_A1MAP_20_u1_u2_u2 1020. _CNV_A_R_LINEAR_____380_CM -40. 980. FORMAT "%3.0"
 /begin AXIS_DESCR COM_AXIS Vxx_map _CNV_A_R_LINEAR_____57_CM 17 0. 20000. READ_ONLY FORMAT "%5.0" AXIS_PTS_REF Ntb_map_cata_mdl_temp /end AXIS_DESCR
 /begin AXIS_DESCR COM_AXIS Vxx_n _CNV_A_R_ENSD_LINEA_24_CM 17 0. 16383.75 READ_ONLY FORMAT "%8.2" AXIS_PTS_REF Ntb_n_cata_mdl_temp /end AXIS_DESCR
/end CHARACTERISTIC
/begin CHARACTERISTIC Ctp_ex_gaz_temp_ofs_maf "Filter gain table of exhaust gaz temperature when the temperature is risen function of air flow" CURVE 0xa002a980 _REC_A1CUR_20_u1_u2 1. _CNV_A_R_LINEAR_____118_CM 0. 1. FORMAT "%9.7"
 /begin AXIS_DESCR COM_AXIS Vxx_pump_maf _CNV_A_R_LINEAR_____109_CM 17 0. 3000. READ_ONLY FORMAT "%4.3" AXIS_PTS_REF Ntb_ex_gaz_temp /end AXIS_DESCR
/end CHARACTERISTIC
/begin CHARACTERISTIC Ctp_ex_gaz_temp_ofs_maf_l "Filter gain table of exhaust gaz temperature when the temperature is fallen function of air flow" CURVE 0xa002a994 _REC_A1CUR_20_u1_u2 1. _CNV_A_R_LINEAR_____118_CM 0. 1. FORMAT "%9.7"
 /begin AXIS_DESCR COM_AXIS Vxx_pump_maf _CNV_A_R_LINEAR_____109_CM 17 0. 3000. READ_ONLY FORMAT "%4.3" AXIS_PTS_REF Ntb_ex_gaz_temp /end AXIS_DESCR
/end CHARACTERISTIC
/begin CHARACTERISTIC Ctp_ex_gaz_temp_ofs_vs "Offset table of exhaust gaz temperature in stabilized function of vehicle speed" CURVE 0xa002a9a8 _REC_A1CUR_20_u1_u2 1020. _CNV_A_R_LINEAR_____422_CM 0. 1020. FORMAT "%4.0"
 /begin AXIS_DESCR COM_AXIS Vxx_vs _CNV_A_R_LINEAR_____70_CM 9 0. 655.35 READ_ONLY FORMAT "%6.2" AXIS_PTS_REF Ntb_ex_gaz_temp_ofs_vs /end AXIS_DESCR
/end CHARACTERISTIC
/begin MEASUREMENT Vbx_cata_temp_rise "Temperature catalyst is rising" UBYTE _CNV_S_2_RANGE______3_CM 1 0. 0. 1. ECU_ADDRESS 0xd0005356 BIT_MASK 0x1 /end MEASUREMENT
/begin MEASUREMENT Vbx_eng_aut "Engine in autonomous state" UBYTE _CNV_S_2_RANGE______3_CM 1 0. 0. 1. ECU_ADDRESS 0xd0005357 BIT_MASK 0x1 /end MEASUREMENT
/begin MEASUREMENT Vsx_ex_gaz_temp_fil_val_vld "Exhaust gaz temperature filter value validity status" UBYTE _CNV_S_3_STATUS_OK__120_CM 1 0. 0. 2. ECU_ADDRESS 0xd0005358 /end MEASUREMENT
/begin MEASUREMENT Vxx_ex_gaz_fil_fac "Filter gain of exhaust gaz temperature" UBYTE _CNV_A_R_LINEAR_____118_CM 1 0. 0. 1. ECU_ADDRESS 0xd0005359 FORMAT "%9.7" /end MEASUREMENT
/begin MEASUREMENT Vxx_ex_gaz_fil_fac_fall "Filter gain of exhaust gaz temperature when the temperature is fallen" UBYTE _CNV_A_R_LINEAR_____118_CM 1 0. 0. 1. ECU_ADDRESS 0xd000535a FORMAT "%9.7" /end MEASUREMENT
/begin MEASUREMENT Vxx_ex_gaz_fil_fac_inj_cut "Filter gain of exhaust gaz temperature when injection is cut" UBYTE _CNV_A_R_LINEAR_____118_CM 1 0. 0. 1. ECU_ADDRESS 0xd000535b FORMAT "%9.7" /end MEASUREMENT
/begin MEASUREMENT Vxx_ex_gaz_fil_fac_rise "Filter gain of exhaust gaz temperature when the temperature is risen" UBYTE _CNV_A_R_LINEAR_____118_CM 1 0. 0. 1. ECU_ADDRESS 0xd000535c FORMAT "%9.7" /end MEASUREMENT
/begin MEASUREMENT Vxx_ex_gaz_map_n_temp "Exhaust gaz temperature in fonction of pressure and engine speed" UBYTE _CNV_A_R_LINEAR_____380_CM 1 0. -40. 980. ECU_ADDRESS 0xd000535d FORMAT "%3.0" /end MEASUREMENT
/begin MEASUREMENT Vxx_ex_gaz_temp_fil_val "Exhaust gaz temperature filter value" UBYTE _CNV_A_R_LINEAR_____380_CM 1 0. -40. 980. ECU_ADDRESS 0xd000535e FORMAT "%3.0" /end MEASUREMENT
/begin MEASUREMENT Vxx_ex_gaz_temp_fil_val_aut "Exhaust gaz temperature filter value in engine autonomous state" UBYTE _CNV_A_R_LINEAR_____380_CM 1 0. -40. 980. ECU_ADDRESS 0xd000535f FORMAT "%3.0" /end MEASUREMENT
/begin MEASUREMENT Vxx_ex_gaz_temp_fil_val_hold "Exhaust gaz temperature filter value i-1" UBYTE _CNV_A_R_LINEAR_____380_CM 1 0. -40. 980. ECU_ADDRESS 0xd0005360 FORMAT "%3.0" /end MEASUREMENT
/begin MEASUREMENT Vxx_ex_gaz_temp_fil_val_not_aut "Exhaust gaz temperature filter value in not engine autonomous state" UBYTE _CNV_A_R_LINEAR_____380_CM 1 0. -40. 980. ECU_ADDRESS 0xd0005361 FORMAT "%3.0" /end MEASUREMENT
/begin MEASUREMENT Vxx_ex_gaz_temp_ofs_vs "Offset of exhaust gaz temperature in stabilized function of speed vehicle" UBYTE _CNV_A_R_LINEAR_____422_CM 1 0. 0. 1020. ECU_ADDRESS 0xd0005362 FORMAT "%4.0" /end MEASUREMENT
/begin MEASUREMENT Vxx_ex_gaz_temp_val "Exhaust gaz temperature value" UBYTE _CNV_A_R_LINEAR_____380_CM 1 0. -40. 980. ECU_ADDRESS 0xd0005363 FORMAT "%3.0" /end MEASUREMENT
/begin MEASUREMENT Vxx_ex_gaz_temp_val_aut "Exhaust gaz temperature value in autonomous engine state" UBYTE _CNV_A_R_LINEAR_____380_CM 1 0. -40. 980. ECU_ADDRESS 0xd0005364 FORMAT "%3.0" /end MEASUREMENT
/begin MEASUREMENT Vxx_ex_gaz_temp_val_not_aut "Exhaust gaz temperature value in not engine autonomous state" UBYTE _CNV_A_R_LINEAR_____380_CM 1 0. -40. 980. ECU_ADDRESS 0xd0005365 FORMAT "%3.0" /end MEASUREMENT
/begin CHARACTERISTIC Cxx_ex_gaz_fil_fac_inj "Filter gain of exhaust gaz temperature in injection cut calibration" VALUE 0xa0020c81 _REC_S1VAL_20_u1 1. _CNV_A_R_LINEAR_____118_CM 0. 1. FORMAT "%9.7" /end CHARACTERISTIC
/begin AXIS_PTS Ctb_ovt_acel_pdl_dif_thd "Driver sportivy factor breakpoint table for overtorque pedal difference threshold" 0xa0021db6 Vxx_driv_spt_fac _REC_A2AXS_20_u1 1. _CNV_A_R_LINEAR_____423_CM 5 0. 1. FORMAT "%9.7" /end AXIS_PTS
/begin CHARACTERISTIC Ctp_ovt_acel_pdl_dif_thd "Accelerator pedal difference threshold for driver overtorque request" CURVE 0xa0027240 _REC_A1CUR_20_u2_u1 1.25 _CNV_A_R_LINEAR_____211_CM 0. 1.25 FORMAT "%7.5"
 /begin AXIS_DESCR COM_AXIS Vxx_driv_spt_fac _CNV_A_R_LINEAR_____423_CM 5 0. 1. FORMAT "%9.7" AXIS_PTS_REF Ctb_ovt_acel_pdl_dif_thd /end AXIS_DESCR
/end CHARACTERISTIC
/begin MEASUREMENT Vbx_driv_ovt_req "Activation of overtorque function requested by driver actions" UBYTE _CNV_S_2_RANGE______3_CM 1 0. 0. 1. ECU_ADDRESS 0xd0004b1e BIT_MASK 0x1 /end MEASUREMENT
/begin CHARACTERISTIC Cbx_driv_ovt_req_100_rat_cfm "Inhibition of systematic driver overtorque request when accel pedal depressed by 100% ratio" VALUE 0xa0021dbc _REC_S1VAL_20_u1 1. _CNV_S_2_RANGE______3_CM 0. 1. /end CHARACTERISTIC
/begin CHARACTERISTIC Cbx_driv_ovt_req_dsb_cfm "Global inhibition of driver overtorque request" VALUE 0xa0021dbd _REC_S1VAL_20_u1 1. _CNV_S_2_RANGE______3_CM 0. 1. /end CHARACTERISTIC
/begin CHARACTERISTIC Cbx_driv_ovt_req_kd_cfm "Inhibition of systematic overtorque request in KD" VALUE 0xa0021dbe _REC_S1VAL_20_u1 1. _CNV_S_2_RANGE______3_CM 0. 1. /end CHARACTERISTIC
/begin CHARACTERISTIC Cxx_ovt_acel_pdl_dif_t "Characteristic time for accelerator pedal difference calculation (for driver overtorque request cond" VALUE 0xa0021dbf _REC_S1VAL_20_u1 2.55 _CNV_A_R_LINEAR_____34_CM 0. 2.55 FORMAT "%4.2" /end CHARACTERISTIC
/begin MEASUREMENT Vbx_tkof_fl_ena "richness increase request for take off" UBYTE _CNV_S_2_RANGE______3_CM 1 0. 0. 1. ECU_ADDRESS 0xd00045a8 BIT_MASK 0x1 /end MEASUREMENT
/begin MEASUREMENT Vbx_tkof_fl_map_cdn "Condition on manifold pressure value" UBYTE _CNV_S_2_RANGE______3_CM 1 0. 0. 1. ECU_ADDRESS 0xd00045a9 BIT_MASK 0x1 /end MEASUREMENT
/begin MEASUREMENT Vbx_tkof_fl_mat_cdn "Condition on manifold temperature value" UBYTE _CNV_S_2_RANGE______3_CM 1 0. 0. 1. ECU_ADDRESS 0xd00045aa BIT_MASK 0x1 /end MEASUREMENT
/begin MEASUREMENT Vbx_tkof_fl_n_cdn "Condition on engine speed" UBYTE _CNV_S_2_RANGE______3_CM 1 0. 0. 1. ECU_ADDRESS 0xd00045ab BIT_MASK 0x1 /end MEASUREMENT
/begin CHARACTERISTIC Cxx_tkof_fl_mat_thd "Manifold air temperature threshold" VALUE 0xa002169c _REC_S1VAL_20_u2 240. _CNV_A_R_LINEAR_____54_CM -40. 200. FORMAT "%5.1" /end CHARACTERISTIC
/begin CHARACTERISTIC Cxx_tkof_map_hys "Manifold pressure value hysteresis" VALUE 0xa002169e _REC_S1VAL_20_u2 20000. _CNV_A_R_LINEAR_____57_CM 0. 20000. FORMAT "%5.0" /end CHARACTERISTIC
/begin CHARACTERISTIC Cxx_tkof_map_thd "Manifold pressure value threshold" VALUE 0xa00216a0 _REC_S1VAL_20_u2 20000. _CNV_A_R_LINEAR_____57_CM 0. 20000. FORMAT "%5.0" /end CHARACTERISTIC
/begin CHARACTERISTIC Cxx_tkof_n_h_thd "Engine speed high threshold" VALUE 0xa00216a2 _REC_S1VAL_20_u2 16383.75 _CNV_A_R_ENSD_LINEA_24_CM 0. 16383.75 FORMAT "%8.2" /end CHARACTERISTIC
/begin CHARACTERISTIC Cxx_tkof_n_hys "Engine speed hysteresis" VALUE 0xa00216a4 _REC_S1VAL_20_u2 16383.75 _CNV_A_R_ENSD_LINEA_24_CM 0. 16383.75 FORMAT "%8.2" /end CHARACTERISTIC
/begin CHARACTERISTIC Cxx_tkof_n_l_thd "Engine speed low threshold" VALUE 0xa00216a6 _REC_S1VAL_20_u2 16383.75 _CNV_A_R_ENSD_LINEA_24_CM 0. 16383.75 FORMAT "%8.2" /end CHARACTERISTIC
/begin MEASUREMENT Vbx_gear_cge_spv_on "Boolean to indicate that the target torque provision is active" UBYTE _CNV_S_2_RANGE______3_CM 1 0. 0. 1. ECU_ADDRESS 0xd0004374 BIT_MASK 0x1 /end MEASUREMENT
/begin MEASUREMENT Vbx_gear_cge_tqe_sp_lim "Indication of a restriction on setpoint torque positive authority at the begining of the gearshift" UBYTE _CNV_S_2_RANGE______3_CM 1 0. 0. 1. ECU_ADDRESS 0xd0004375 BIT_MASK 0x1 /end MEASUREMENT
/begin MEASUREMENT Vbx_gear_cge_tqe_tgt "Boolean to indicate the activation (1) of a target torque provision during a manual gearshift" UBYTE _CNV_S_2_RANGE______3_CM 1 0. 0. 1. ECU_ADDRESS 0xd0004376 BIT_MASK 0x1 /end MEASUREMENT
/begin MEASUREMENT Vxx_gear_cge_fmt "Modulation factor for the target torque provision during a manual gear shift" UBYTE _CNV_A_R_LINEAR_____136_CM 1 0. 0. 1. ECU_ADDRESS 0xd0004377 FORMAT "%4.2" /end MEASUREMENT
/begin CHARACTERISTIC Cxx_gear_cge_dec_dly "Time required to modulate the target torque provision at the end of a manual gear shift" VALUE 0xa0021520 _REC_S1VAL_20_u2 655.35 _CNV_A_R_LINEAR_____34_CM 0. 655.35 FORMAT "%6.2" /end CHARACTERISTIC
/begin CHARACTERISTIC Cxx_gear_cge_sp_lim_dly "Maximum time for the limitation of positive target torque corrections of the anti-jerk compensator during a manual gear shift" VALUE 0xa0021522 _REC_S1VAL_20_u2 655.35 _CNV_A_R_LINEAR_____34_CM 0. 655.35 FORMAT "%6.2" /end CHARACTERISTIC
/begin CHARACTERISTIC Cxx_gear_cge_tqe_tgt_dly "Maximum time for the target torque provision during a manual gear shift" VALUE 0xa0021524 _REC_S1VAL_20_u2 655.35 _CNV_A_R_LINEAR_____34_CM 0. 655.35 FORMAT "%6.2" /end CHARACTERISTIC
/begin AXIS_PTS Ctb_gear_cge_n_mv "Engine speed breakpoints for the target torque provision" 0xa002e250 Vxx_n_mv _REC_A2AXS_20_u2 16383.75 _CNV_A_R_ENSD_LINEA_24_CM 8 0. 16383.75 FORMAT "%8.2" /end AXIS_PTS
/begin CHARACTERISTIC Cmp_gear_cge_tgt_tqe "Cartography for the target torque provision during a manual gear shift" MAP 0xa002e264 _REC_A1MAP_20_u2_u2_u1 2047.96875 _CNV_A_R_LINEAR_____161_CM -400. 1647.96875 FORMAT "%10.5"
 /begin AXIS_DESCR COM_AXIS Vxx_n_mv _CNV_A_R_ENSD_LINEA_24_CM 8 0. 16383.75 FORMAT "%8.2" AXIS_PTS_REF Ctb_gear_cge_n_mv /end AXIS_DESCR
 /begin AXIS_DESCR COM_AXIS Vxx_gear _CNV_A_R_LINEAR_____113_CM 8 -1. 6. READ_ONLY FORMAT "%2.0" AXIS_PTS_REF Ntb_gear /end AXIS_DESCR
/end CHARACTERISTIC
/begin MEASUREMENT Vbx_mgb_tqe_tgt_calc_on "Boolean to indicate that the target torque provision calculation is active" UBYTE _CNV_S_2_RANGE______3_CM 1 0. 0. 1. ECU_ADDRESS 0xd00043fd BIT_MASK 0x1 /end MEASUREMENT
/begin MEASUREMENT Vxx_mgb_max_tqe_tgt "Maximum target torque value during a manual gear shift" UWORD _CNV_A_R_LINEAR_____161_CM 1 0. -400. 1647.96875 ECU_ADDRESS 0xd0003276 FORMAT "%10.5" /end MEASUREMENT
/begin MEASUREMENT Vxx_mgb_min_tqe_tgt "Minimum target torque value during a manual gear shift" UWORD _CNV_A_R_LINEAR_____161_CM 1 0. -400. 1647.96875 ECU_ADDRESS 0xd0003278 FORMAT "%10.5" /end MEASUREMENT
/begin CHARACTERISTIC Cxx_mgb_max_tqe_tgt "Maximum calibrated target torque value during a manual gear shift" VALUE 0xa00218ce _REC_S1VAL_20_u2 2047.96875 _CNV_A_R_LINEAR_____161_CM -400. 1647.96875 FORMAT "%10.5" /end CHARACTERISTIC
/begin MEASUREMENT Vbx_mgb_shf_ant_tq_cfm "Increase of anticipated torque during manual gearbox shift activated." UBYTE _CNV_S_2_RANGE______3_CM 1 0. 0. 1. ECU_ADDRESS 0xd000435f BIT_MASK 0x1 /end MEASUREMENT
/begin CHARACTERISTIC Cbx_mgb_shf_ant_tq_cfm "(=1) Increase of anticipated torque during manual gearbox shift activated." VALUE 0xa0021502 _REC_S1VAL_20_u1 1. _CNV_S_2_RANGE______3_CM 0. 1. /end CHARACTERISTIC
/begin MEASUREMENT Vxx_fsys_cpt_max "Memorized maximum threshold for mode 6." SWORD _CNV_A_R_LINEAR_____424_CM 1 0. -750. 749.977111816406 DISPLAY_IDENTIFIER CbRicDgn_NVM.Vxx_fsys_cpt_max_NVM ECU_ADDRESS 0xd00035b0 FORMAT "%7.2" /end MEASUREMENT
/begin MEASUREMENT Vxx_fsys_cpt_min "Memorized minimum threshold for mode 6." SWORD _CNV_A_R_LINEAR_____424_CM 1 0. -750. 749.977111816406 DISPLAY_IDENTIFIER CbRicDgn_NVM.Vxx_fsys_cpt_min_NVM ECU_ADDRESS 0xd00035b2 FORMAT "%7.2" /end MEASUREMENT
/begin MEASUREMENT Vxx_fsys_cpt_val "Memorized diagnosis criteria for mode 6." SWORD _CNV_A_R_LINEAR_____424_CM 1 0. -750. 749.977111816406 DISPLAY_IDENTIFIER CbRicDgn_NVM.Vxx_fsys_cpt_val_NVM ECU_ADDRESS 0xd00035b4 FORMAT "%7.2" /end MEASUREMENT
/begin MEASUREMENT Sxx_fsys_cor_ti_fac "Corrected average ALFACL for memorized fuel system diagnostic" UWORD _CNV_A_R_LINEAR_____65_CM 1 0. 0.6666666 1.33332309414063 DISPLAY_IDENTIFIER CbRicDgn_NVM.Sxx_fsys_cor_ti_fac_NVM ECU_ADDRESS 0xd00035b6 FORMAT "%8.7" /end MEASUREMENT
/begin MEASUREMENT Sxx_fsys_cor_ti_fac_max "Max threshold for corrected average ALFACL for memorized fuel system diagnostic" UWORD _CNV_A_R_LINEAR_____65_CM 1 0. 0.6666666 1.33332309414063 DISPLAY_IDENTIFIER CbRicDgn_NVM.Sxx_fsys_cor_ti_fac_max_NVM ECU_ADDRESS 0xd00035b8 FORMAT "%8.7" /end MEASUREMENT
/begin MEASUREMENT Sxx_fsys_cor_ti_fac_min "Min threshold for corrected average ALFACL for memorized fuel system diagnostic." UWORD _CNV_A_R_LINEAR_____65_CM 1 0. 0.6666666 1.33332309414063 DISPLAY_IDENTIFIER CbRicDgn_NVM.Sxx_fsys_cor_ti_fac_min_NVM ECU_ADDRESS 0xd00035ba FORMAT "%8.7" /end MEASUREMENT
/begin MEASUREMENT Vxx_cl_rich_chr_max "Threshold for the detection of the faillure saved in mode 6" UWORD _CNV_A_R_LINEAR_____4_CM 1 0. 0. 6553.5 DISPLAY_IDENTIFIER CbRicDgn_NVM.Vxx_cl_rich_chr_max_NVM ECU_ADDRESS 0xd00035bc FORMAT "%6.1" /end MEASUREMENT
/begin MEASUREMENT Vxx_cl_rich_chr_val "Diagnosis criterion for the detection of the faillure saved in mode 6" UWORD _CNV_A_R_LINEAR_____4_CM 1 0. 0. 6553.5 DISPLAY_IDENTIFIER CbRicDgn_NVM.Vxx_cl_rich_chr_val_NVM ECU_ADDRESS 0xd00035be FORMAT "%6.1" /end MEASUREMENT
/begin AXIS_PTS Ctb_fsys_n_5 "Table of engine speed breakpoins for fuel system diagnosis cartographies." 0xa002e434 Vxx_n _REC_A2AXS_20_u2 16383.75 _CNV_A_R_ENSD_LINEA_24_CM 5 0. 16383.75 FORMAT "%8.2" /end AXIS_PTS
/begin CHARACTERISTIC Ctp_fsys_eal_min "Table de masses díair minimum = f(Vxx_n01 ) pour autorisation de diag fuel system" CURVE 0xa002e440 _REC_A1CUR_20_u2_u2 3.99993896484375 _CNV_A_R_LINEAR_____53_CM 0. 3.99993896484375 FORMAT "%7.5"
 /begin AXIS_DESCR COM_AXIS Vxx_n _CNV_A_R_ENSD_LINEA_24_CM 5 0. 16383.75 FORMAT "%8.2" AXIS_PTS_REF Ctb_fsys_n_5 /end AXIS_DESCR
/end CHARACTERISTIC
/begin MEASUREMENT Vbx_df_fsys_cpt "Fuel Trim Component detected failure" UBYTE _CNV_S_2_RANGE______3_CM 1 0. 0. 1. ECU_ADDRESS 0xd0004ca5 BIT_MASK 0x1 /end MEASUREMENT
/begin MEASUREMENT Vbx_diag_ena_fsys_cpt "Fuel Trim Component diagnostic authorization" UBYTE _CNV_S_2_RANGE______3_CM 1 0. 0. 1. ECU_ADDRESS 0xd0004ca6 BIT_MASK 0x1 /end MEASUREMENT
/begin MEASUREMENT Vbx_dsb_diag_fsys_cpt "Inhibition of fuel system diagnosis function of ivld state" UBYTE _CNV_S_2_RANGE______3_CM 1 0. 0. 1. ECU_ADDRESS 0xd0004ca7 BIT_MASK 0x1 /end MEASUREMENT
/begin MEASUREMENT Vbx_fsys_cond "Software and physical conditions of autorization of the fuel system diagnosis" UBYTE _CNV_S_2_RANGE______3_CM 1 0. 0. 1. ECU_ADDRESS 0xd0004ca8 BIT_MASK 0x1 /end MEASUREMENT
/begin MEASUREMENT Vbx_fsys_req "Autorization of the fuel system diagnosis" UBYTE _CNV_S_2_RANGE______3_CM 1 0. 0. 1. ECU_ADDRESS 0xd0004ca9 BIT_MASK 0x1 /end MEASUREMENT
/begin MEASUREMENT Vbx_trans_clf_fsys_cpt "Detects when Vbx_clf_fsys_cpt turns on " UBYTE _CNV_S_2_RANGE______3_CM 1 0. 0. 1. ECU_ADDRESS 0xd0004caa BIT_MASK 0x1 /end MEASUREMENT
/begin MEASUREMENT Vsx_fsys_stt "State of the statemachine of the fuel system diagnosis " UBYTE _CNV_A_R_ECME_LINEA_0_CM 1 0. 0. 255. ECU_ADDRESS 0xd0004cab FORMAT "%3.0" /end MEASUREMENT
/begin MEASUREMENT Vsx_fsys_vld "Fuel System validity status" UBYTE _CNV_A_R_ECME_LINEA_0_CM 1 0. 0. 255. ECU_ADDRESS 0xd0004cac FORMAT "%3.0" /end MEASUREMENT
/begin MEASUREMENT Vxx_diag_fsys_dsb_dly "Delay Inhibition FuelSystem Diagnostic after start" UWORD _CNV_A_R_LINEAR_____344_CM 1 0. 0. 32767.5 ECU_ADDRESS 0xd0003494 FORMAT "%7.1" /end MEASUREMENT
/begin MEASUREMENT Vxx_fsys_cor_fac_max_1 "Maximum threshold when using alcohol to detect a failure in cold conditions" UWORD _CNV_A_R_LINEAR_____65_CM 1 0. 0.6666666 1.33332309414063 ECU_ADDRESS 0xd0003496 FORMAT "%8.7" /end MEASUREMENT
/begin MEASUREMENT Vxx_fsys_cor_fac_max_2 "Maximum threshold when using alcohol to detect a failure in hot conditions" UWORD _CNV_A_R_LINEAR_____65_CM 1 0. 0.6666666 1.33332309414063 ECU_ADDRESS 0xd0003498 FORMAT "%8.7" /end MEASUREMENT
/begin MEASUREMENT Vxx_fsys_cor_fac_min_1 "Minimum threshold when using alcohol to detect a failure in cold conditions" UWORD _CNV_A_R_LINEAR_____65_CM 1 0. 0.6666666 1.33332309414063 ECU_ADDRESS 0xd000349a FORMAT "%8.7" /end MEASUREMENT
/begin MEASUREMENT Vxx_fsys_cor_fac_min_2 "Minimum threshold when using alcohol to detect a failure in hot conditions" UWORD _CNV_A_R_LINEAR_____65_CM 1 0. 0.6666666 1.33332309414063 ECU_ADDRESS 0xd000349c FORMAT "%8.7" /end MEASUREMENT
/begin MEASUREMENT Vxx_fsys_cor_ti_fac "Corrected average ALFACL for the fuel system diagnosis" UWORD _CNV_A_R_LINEAR_____65_CM 1 0. 0.6666666 1.33332309414063 ECU_ADDRESS 0xd000349e FORMAT "%8.7" /end MEASUREMENT
/begin MEASUREMENT Vxx_fsys_cor_ti_fac_clr "Erasing of Corrected average ALFACL for memorized fuel system diagnostic" UWORD _CNV_A_R_LINEAR_____65_CM 1 0. 0.6666666 1.33332309414063 ECU_ADDRESS 0xd00034a0 FORMAT "%8.7" /end MEASUREMENT
/begin MEASUREMENT Vxx_fsys_cor_ti_fac_ini "Initializing of Corrected average ALFACL for memorized fuel system diagnostic" UWORD _CNV_A_R_LINEAR_____65_CM 1 0. 0.6666666 1.33332309414063 ECU_ADDRESS 0xd00034a2 FORMAT "%8.7" /end MEASUREMENT
/begin MEASUREMENT Vxx_fsys_cor_ti_fac_max "Max threshold for corrected average ALFACL for fuel system diagnosis " UWORD _CNV_A_R_LINEAR_____65_CM 1 0. 0.6666666 1.33332309414063 ECU_ADDRESS 0xd00034a4 FORMAT "%8.7" /end MEASUREMENT
/begin MEASUREMENT Vxx_fsys_cor_ti_fac_max_clr "Erasing of Max threshold for corrected average ALFACL for memorized fuel system diagnostic" UWORD _CNV_A_R_LINEAR_____65_CM 1 0. 0.6666666 1.33332309414063 ECU_ADDRESS 0xd00034a6 FORMAT "%8.7" /end MEASUREMENT
/begin MEASUREMENT Vxx_fsys_cor_ti_fac_max_ini "Initializing of Max threshold for corrected average ALFACL for memorized fuel system diagnostic" UWORD _CNV_A_R_LINEAR_____65_CM 1 0. 0.6666666 1.33332309414063 ECU_ADDRESS 0xd00034a8 FORMAT "%8.7" /end MEASUREMENT
/begin MEASUREMENT Vxx_fsys_cor_ti_fac_min "Min threshold for corrected average ALFACL for fuel system diagnosis" UWORD _CNV_A_R_LINEAR_____65_CM 1 0. 0.6666666 1.33332309414063 ECU_ADDRESS 0xd00034aa FORMAT "%8.7" /end MEASUREMENT
/begin MEASUREMENT Vxx_fsys_cor_ti_fac_min_clr "Erasing of Min threshold for corrected average ALFACL for memorized fuel system diagnostic" UWORD _CNV_A_R_LINEAR_____65_CM 1 0. 0.6666666 1.33332309414063 ECU_ADDRESS 0xd00034ac FORMAT "%8.7" /end MEASUREMENT
/begin MEASUREMENT Vxx_fsys_cor_ti_fac_min_ini "Initializing of Min threshold for corrected average ALFACL for memorized fuel system diagnostic" UWORD _CNV_A_R_LINEAR_____65_CM 1 0. 0.6666666 1.33332309414063 ECU_ADDRESS 0xd00034ae FORMAT "%8.7" /end MEASUREMENT
/begin MEASUREMENT Vxx_fsys_crit_bal_1 "Ponderation in the calcul of diagnosis criteria" SBYTE _CNV_A_R_LINEAR_____236_CM 1 0. -5. 4.9609375 ECU_ADDRESS 0xd0004cad FORMAT "%5.2" /end MEASUREMENT
/begin MEASUREMENT Vxx_fsys_crit_bal_2 "Ponderation in the calcul of diagnosis criteria" SBYTE _CNV_A_R_LINEAR_____236_CM 1 0. -5. 4.9609375 ECU_ADDRESS 0xd0004cae FORMAT "%5.2" /end MEASUREMENT
/begin MEASUREMENT Vxx_fsys_crit_bal_3 "Ponderation in the calcul of diagnosis criteria" SBYTE _CNV_A_R_LINEAR_____236_CM 1 0. -5. 4.9609375 ECU_ADDRESS 0xd0004caf FORMAT "%5.2" /end MEASUREMENT
/begin MEASUREMENT Vxx_fsys_crit_diag "Value of the diagnosis criteria of fuel system diagnosis when using new diagnosis." SWORD _CNV_A_R_LINEAR_____424_CM 1 0. -750. 749.977111816406 ECU_ADDRESS 0xd00034b0 FORMAT "%7.2" /end MEASUREMENT
/begin MEASUREMENT Vxx_fsys_crit_diag_clr "Value of the diagnosis criteria of fuel system diagnosis when using new diagnosis in case of erasement request." SWORD _CNV_A_R_LINEAR_____424_CM 1 0. -750. 749.977111816406 ECU_ADDRESS 0xd00034b2 FORMAT "%7.2" /end MEASUREMENT
/begin MEASUREMENT Vxx_fsys_crit_diag_ini "Initialisation of memorized new diagnosis criteria in case of initialization request." SWORD _CNV_A_R_LINEAR_____424_CM 1 0. -750. 749.977111816406 ECU_ADDRESS 0xd00034b4 FORMAT "%7.2" /end MEASUREMENT
/begin MEASUREMENT Vxx_fsys_crit_diag_max "Initialisation of memorized maximum threshold of new criteria in case of initialization request." SWORD _CNV_A_R_LINEAR_____424_CM 1 0. -750. 749.977111816406 ECU_ADDRESS 0xd00034b6 FORMAT "%7.2" /end MEASUREMENT
/begin MEASUREMENT Vxx_fsys_crit_diag_max_1 "Maximum threshold applies on the diagnosis criteria in cold condition to detect a failure when using the new diagnosis in cold" SWORD _CNV_A_R_LINEAR_____424_CM 1 0. -750. 749.977111816406 ECU_ADDRESS 0xd00034b8 FORMAT "%7.2" /end MEASUREMENT
/begin MEASUREMENT Vxx_fsys_crit_diag_max_2 "Maximum threshold applies on the diagnosis criteria in cold condition to detect a failure when using the new diagnosis in hot" SWORD _CNV_A_R_LINEAR_____424_CM 1 0. -750. 749.977111816406 ECU_ADDRESS 0xd00034ba FORMAT "%7.2" /end MEASUREMENT
/begin MEASUREMENT Vxx_fsys_crit_diag_max_clr "Value of memorized maximum threshold of fuel system diagnosis when using new diagnosis in case of erasement request." SWORD _CNV_A_R_LINEAR_____424_CM 1 0. -750. 749.977111816406 ECU_ADDRESS 0xd00034bc FORMAT "%7.2" /end MEASUREMENT
/begin MEASUREMENT Vxx_fsys_crit_diag_max_ini "Initialisation of memorized maximum threshold of new criteria in case of initialization request." SWORD _CNV_A_R_LINEAR_____424_CM 1 0. -750. 749.977111816406 ECU_ADDRESS 0xd00034be FORMAT "%7.2" /end MEASUREMENT
/begin MEASUREMENT Vxx_fsys_crit_diag_med "Temporary value of the new diagnosis criteria" SWORD _CNV_A_R_LINEAR_____424_CM 1 0. -750. 749.977111816406 ECU_ADDRESS 0xd00034c0 FORMAT "%7.2" /end MEASUREMENT
/begin MEASUREMENT Vxx_fsys_crit_diag_med_1 "First part of the new diagnosis criteria." SLONG _CNV_A_R_LINEAR_____425_CM 1 0. -250. 249.99999 ECU_ADDRESS 0xd0001c48 FORMAT "%12.5" /end MEASUREMENT
/begin MEASUREMENT Vxx_fsys_crit_diag_med_2 "Second part of the new diagnosis criteria." SLONG _CNV_A_R_LINEAR_____425_CM 1 0. -250. 249.99999 ECU_ADDRESS 0xd0001c4c FORMAT "%12.5" /end MEASUREMENT
/begin MEASUREMENT Vxx_fsys_crit_diag_med_3 "Third part of the new diagnosis criteria." SLONG _CNV_A_R_LINEAR_____425_CM 1 0. -250. 249.99999 ECU_ADDRESS 0xd0001c50 FORMAT "%12.5" /end MEASUREMENT
/begin MEASUREMENT Vxx_fsys_crit_diag_min "Initialisation of memorized minimum threshold of new criteria in case of initialization request." SWORD _CNV_A_R_LINEAR_____424_CM 1 0. -750. 749.977111816406 ECU_ADDRESS 0xd00034c2 FORMAT "%7.2" /end MEASUREMENT
/begin MEASUREMENT Vxx_fsys_crit_diag_min_1 "Minimum threshold applies on the diagnosis criteria in cold condition to detect a failure when using the new diagnosis" SWORD _CNV_A_R_LINEAR_____424_CM 1 0. -750. 749.977111816406 ECU_ADDRESS 0xd00034c4 FORMAT "%7.2" /end MEASUREMENT
/begin MEASUREMENT Vxx_fsys_crit_diag_min_2 "Minimum threshold applies on the diagnosis criteria in hot condition to detect a failure when using the new diagnosis" SWORD _CNV_A_R_LINEAR_____424_CM 1 0. -750. 749.977111816406 ECU_ADDRESS 0xd00034c6 FORMAT "%7.2" /end MEASUREMENT
/begin MEASUREMENT Vxx_fsys_crit_diag_min_clr "Value of memorized minimum threshold of fuel system diagnosis when using new diagnosis in case of erasement request." SWORD _CNV_A_R_LINEAR_____424_CM 1 0. -750. 749.977111816406 ECU_ADDRESS 0xd00034c8 FORMAT "%7.2" /end MEASUREMENT
/begin MEASUREMENT Vxx_fsys_crit_diag_min_ini "Initialisation of memorized minimum threshold of new criteria in case of initialization request." SWORD _CNV_A_R_LINEAR_____424_CM 1 0. -750. 749.977111816406 ECU_ADDRESS 0xd00034ca FORMAT "%7.2" /end MEASUREMENT
/begin MEASUREMENT Vxx_fsys_crit_diag_win "Value in the diagnosis criteria of fuel system diagnosis in each monitoring window when using new diagnosis." SWORD _CNV_A_R_LINEAR_____424_CM 1 0. -750. 749.977111816406 ECU_ADDRESS 0xd00034cc FORMAT "%7.2" /end MEASUREMENT
/begin MEASUREMENT Vxx_fsys_dft_dly "Duration of temporal filtering to detect the presence of a default of OBD type on fuel system " UWORD _CNV_A_R_LINEAR_____34_CM 1 0. 0. 655.35 ECU_ADDRESS 0xd00034ce FORMAT "%6.2" /end MEASUREMENT
/begin MEASUREMENT Vxx_fsys_dly "Duration of temporal filtering to detect the presence or the absence of a default of OBD type on fuel system" UWORD _CNV_A_R_LINEAR_____34_CM 1 0. 0. 655.35 ECU_ADDRESS 0xd00034d0 FORMAT "%6.2" /end MEASUREMENT
/begin MEASUREMENT Vxx_fsys_dly_1 "Duration of temporal filtering to detect the presence or the absence of a default of OBD type on fuel system in cold conditions" UWORD _CNV_A_R_LINEAR_____34_CM 1 0. 0. 655.35 ECU_ADDRESS 0xd00034d2 FORMAT "%6.2" /end MEASUREMENT
/begin MEASUREMENT Vxx_fsys_dly_2 "Duration of temporal filtering to detect the presence or the absence of a default of OBD type on fuel system in hot conditions" UWORD _CNV_A_R_LINEAR_____34_CM 1 0. 0. 655.35 ECU_ADDRESS 0xd00034d4 FORMAT "%6.2" /end MEASUREMENT
/begin MEASUREMENT Vxx_fsys_no_dft_dly "Duration of temporal filtering to detect the absence of a default of OBD type on fuel system" UWORD _CNV_A_R_LINEAR_____34_CM 1 0. 0. 655.35 ECU_ADDRESS 0xd00034d6 FORMAT "%6.2" /end MEASUREMENT
/begin MEASUREMENT Vxx_fsys_win_ctr "Number of windows before detecting a faillure." UBYTE _CNV_A_R_ECME_LINEA_0_CM 1 0. 0. 255. ECU_ADDRESS 0xd0004cb0 FORMAT "%3.0" /end MEASUREMENT
/begin MEASUREMENT Vxx_fsys_win_nr_fail "number of folowing windows to detect a failure" UBYTE _CNV_A_R_ECME_LINEA_0_CM 1 0. 0. 255. ECU_ADDRESS 0xd0004cb1 FORMAT "%3.0" /end MEASUREMENT
/begin CHARACTERISTIC Cbx_conf_schd_diag_fsys "Configuration Diagnostic Fuelsystem strategy" VALUE 0xa002081e _REC_S1VAL_20_u1 1. _CNV_A_R_ECME_LINEA_0_CM 0. 1. FORMAT "%1.0" BIT_MASK 0x1 /end CHARACTERISTIC
/begin CHARACTERISTIC Cbx_fsys_diag_conf "Choice of the diagnosis to be used." VALUE 0xa002081f _REC_S1VAL_20_u1 1. _CNV_A_R_ECME_LINEA_0_CM 0. 1. FORMAT "%1.0" BIT_MASK 0x1 /end CHARACTERISTIC
/begin CHARACTERISTIC Cxx_dfdec_fsys_cpt "Fuel Trim Component detected failure counter decrement" VALUE 0xa00207e0 _REC_S1VAL_20_u2 65535. _CNV_A_R_ECME_LINEA_0_CM 0. 65535. FORMAT "%5.0" /end CHARACTERISTIC
/begin CHARACTERISTIC Cxx_dfinc_fsys_cpt "Fuel Trim Component detected failure counter increment" VALUE 0xa00207e2 _REC_S1VAL_20_u2 65535. _CNV_A_R_ECME_LINEA_0_CM 0. 65535. FORMAT "%5.0" /end CHARACTERISTIC
/begin CHARACTERISTIC Cxx_fsys_alco_dly_1 "Duration of temporal filtering, in case of alcohol using, to detect the presence or the absence of a failure of OBD type on fuel system in cold condition" VALUE 0xa00207e4 _REC_S1VAL_20_u2 655.35 _CNV_A_R_LINEAR_____34_CM 0. 655.35 FORMAT "%6.2" /end CHARACTERISTIC
/begin CHARACTERISTIC Cxx_fsys_alco_dly_2 "Duration of temporal filtering, in case of alcohol using, to detect the presence or the absence of a failure of OBD type on fuel system in hot conditions" VALUE 0xa00207e6 _REC_S1VAL_20_u2 655.35 _CNV_A_R_LINEAR_____34_CM 0. 655.35 FORMAT "%6.2" /end CHARACTERISTIC
/begin CHARACTERISTIC Cxx_fsys_cor_fac_alco_max_1 "Maximum threshold, applies on the diagnosis criteria in cold conditions to detect a failure (alcohol)" VALUE 0xa00207e8 _REC_S1VAL_20_u2 0.66665649414063 _CNV_A_R_LINEAR_____65_CM 0.6666666 1.33332309414063 FORMAT "%8.7" /end CHARACTERISTIC
/begin CHARACTERISTIC Cxx_fsys_cor_fac_alco_max_2 "Maximum threshold, applies on the diagnosis criteria in hot conditions to detect a failure (alcohol)" VALUE 0xa00207ea _REC_S1VAL_20_u2 0.66665649414063 _CNV_A_R_LINEAR_____65_CM 0.6666666 1.33332309414063 FORMAT "%8.7" /end CHARACTERISTIC
/begin CHARACTERISTIC Cxx_fsys_cor_fac_alco_min_1 "Minimum threshold, applies on the diagnosis criteria in cold conditions to detect a failure (alcohol)" VALUE 0xa00207ec _REC_S1VAL_20_u2 0.66665649414063 _CNV_A_R_LINEAR_____65_CM 0.6666666 1.33332309414063 FORMAT "%8.7" /end CHARACTERISTIC
/begin CHARACTERISTIC Cxx_fsys_cor_fac_alco_min_2 "Minimum threshold, applies on the diagnosis criteria in hot conditions to detect a failure (alcohol)" VALUE 0xa00207ee _REC_S1VAL_20_u2 0.66665649414063 _CNV_A_R_LINEAR_____65_CM 0.6666666 1.33332309414063 FORMAT "%8.7" /end CHARACTERISTIC
/begin CHARACTERISTIC Cxx_fsys_cor_fac_max_1 "Maximum threshold applies on the diagnosis criteria in cold conditions to detect a failure (gazoline)" VALUE 0xa00207f0 _REC_S1VAL_20_u2 0.66665649414063 _CNV_A_R_LINEAR_____65_CM 0.6666666 1.33332309414063 FORMAT "%8.7" /end CHARACTERISTIC
/begin CHARACTERISTIC Cxx_fsys_cor_fac_max_2 "Maximum threshold applies on the diagnosis criteria in hot conditions to detect a failure (gazoline)" VALUE 0xa00207f2 _REC_S1VAL_20_u2 0.66665649414063 _CNV_A_R_LINEAR_____65_CM 0.6666666 1.33332309414063 FORMAT "%8.7" /end CHARACTERISTIC
/begin CHARACTERISTIC Cxx_fsys_cor_fac_min_1 "Minimum threshold applies on the diagnosis criteria in cold conditions to detect a failure (gazoline)" VALUE 0xa00207f4 _REC_S1VAL_20_u2 0.66665649414063 _CNV_A_R_LINEAR_____65_CM 0.6666666 1.33332309414063 FORMAT "%8.7" /end CHARACTERISTIC
/begin CHARACTERISTIC Cxx_fsys_cor_fac_min_2 "Minimum threshold applies on the diagnosis criteria in hot conditions to detect a failure (gazoline)" VALUE 0xa00207f6 _REC_S1VAL_20_u2 0.66665649414063 _CNV_A_R_LINEAR_____65_CM 0.6666666 1.33332309414063 FORMAT "%8.7" /end CHARACTERISTIC
/begin CHARACTERISTIC Cxx_fsys_crit_alco_bal_1 "Ponderation in the calcul of diagnosis criteria (alcohol)" VALUE 0xa0020820 _REC_S1VAL_20_s1 9.9609375 _CNV_A_R_LINEAR_____426_CM -5. 4.9609375 FORMAT "%5.2" /end CHARACTERISTIC
/begin CHARACTERISTIC Cxx_fsys_crit_alco_bal_2 "Ponderation in the calcul of diagnosis criteria (alcohol)" VALUE 0xa0020821 _REC_S1VAL_20_s1 9.9609375 _CNV_A_R_LINEAR_____426_CM -5. 4.9609375 FORMAT "%5.2" /end CHARACTERISTIC
/begin CHARACTERISTIC Cxx_fsys_crit_alco_bal_3 "Ponderation in the calcul of diagnosis criteria (alcohol)" VALUE 0xa0020822 _REC_S1VAL_20_s1 9.9609375 _CNV_A_R_LINEAR_____426_CM -5. 4.9609375 FORMAT "%5.2" /end CHARACTERISTIC
/begin CHARACTERISTIC Cxx_fsys_crit_bal_1 "Ponderation in the calcul of diagnosis criteria (gazoline)" VALUE 0xa0020823 _REC_S1VAL_20_s1 9.9609375 _CNV_A_R_LINEAR_____426_CM -5. 4.9609375 FORMAT "%5.2" /end CHARACTERISTIC
/begin CHARACTERISTIC Cxx_fsys_crit_bal_2 "Ponderation in the calcul of diagnosis criteria (gazoline)" VALUE 0xa0020824 _REC_S1VAL_20_s1 9.9609375 _CNV_A_R_LINEAR_____236_CM -5. 4.9609375 FORMAT "%5.2" /end CHARACTERISTIC
/begin CHARACTERISTIC Cxx_fsys_crit_bal_3 "Ponderation in the calcul of diagnosis criteria (gazoline)" VALUE 0xa0020825 _REC_S1VAL_20_s1 9.9609375 _CNV_A_R_LINEAR_____426_CM -5. 4.9609375 FORMAT "%5.2" /end CHARACTERISTIC
/begin CHARACTERISTIC Cxx_fsys_crit_diag_alco_max_1 "Maximum threshold applies on the diagnosis criteria in cold condition to detect a failure when using the new diagnosis (alcohol)" VALUE 0xa00207f8 _REC_S1VAL_20_s2 1499.977111816406 _CNV_A_R_LINEAR_____424_CM -750. 749.977111816406 FORMAT "%7.2" /end CHARACTERISTIC
/begin CHARACTERISTIC Cxx_fsys_crit_diag_alco_max_2 "Maximum threshold applies on the diagnosis criteria in hot condition to detect a failure when using the new diagnosis (alcohol)" VALUE 0xa00207fa _REC_S1VAL_20_s2 1499.977111816406 _CNV_A_R_LINEAR_____424_CM -750. 749.977111816406 FORMAT "%7.2" /end CHARACTERISTIC
/begin CHARACTERISTIC Cxx_fsys_crit_diag_alco_min_1 "Minimum threshold applies on the diagnosis criteria in cold condition to detect a failure when using the new diagnosis (alcohol)" VALUE 0xa00207fc _REC_S1VAL_20_s2 1499.977111816406 _CNV_A_R_LINEAR_____424_CM -750. 749.977111816406 FORMAT "%7.2" /end CHARACTERISTIC
/begin CHARACTERISTIC Cxx_fsys_crit_diag_alco_min_2 "Minimum threshold applies on the diagnosis criteria in hot condition to detect a failure when using the new diagnosis (alcohol)" VALUE 0xa00207fe _REC_S1VAL_20_s2 1499.977111816406 _CNV_A_R_LINEAR_____424_CM -750. 749.977111816406 FORMAT "%7.2" /end CHARACTERISTIC
/begin CHARACTERISTIC Cxx_fsys_crit_diag_max_1 "Maximum threshold applies on the diagnosis criteria in cold condition to detect a failure when using the new diagnosis (gazoline)" VALUE 0xa0020800 _REC_S1VAL_20_s2 1499.977111816406 _CNV_A_R_LINEAR_____424_CM -750. 749.977111816406 FORMAT "%7.2" /end CHARACTERISTIC
/begin CHARACTERISTIC Cxx_fsys_crit_diag_max_2 "Maximum threshold applies on the diagnosis criteria in hot condition to detect a failure when using the new diagnosis (gazoline)" VALUE 0xa0020802 _REC_S1VAL_20_s2 1499.977111816406 _CNV_A_R_LINEAR_____424_CM -750. 749.977111816406 FORMAT "%7.2" /end CHARACTERISTIC
/begin CHARACTERISTIC Cxx_fsys_crit_diag_min_1 "Minimum threshold applies on the diagnosis criteria in cold condition to detect a failure when using the new diagnosis (gazoline)" VALUE 0xa0020804 _REC_S1VAL_20_s2 1499.977111816406 _CNV_A_R_LINEAR_____424_CM -750. 749.977111816406 FORMAT "%7.2" /end CHARACTERISTIC
/begin CHARACTERISTIC Cxx_fsys_crit_diag_min_2 "Minimum threshold applies on the diagnosis criteria in hot condition to detect a failure when using the new diagnosis (gazoline)" VALUE 0xa0020806 _REC_S1VAL_20_s2 1499.977111816406 _CNV_A_R_LINEAR_____424_CM -750. 749.977111816406 FORMAT "%7.2" /end CHARACTERISTIC
/begin CHARACTERISTIC Cxx_fsys_dly_1 "Duration of temporal filtering to detect the presence or the absence of a default of OBD type on fuel system in cold conditions" VALUE 0xa0020808 _REC_S1VAL_20_u2 655.35 _CNV_A_R_LINEAR_____34_CM 0. 655.35 FORMAT "%6.2" /end CHARACTERISTIC
/begin CHARACTERISTIC Cxx_fsys_dly_2 "Duration of temporal filtering to detect the presence or the absence of a default of OBD type on fuel system in hot conditions (gazoline)" VALUE 0xa002080a _REC_S1VAL_20_u2 655.35 _CNV_A_R_LINEAR_____34_CM 0. 655.35 FORMAT "%6.2" /end CHARACTERISTIC
/begin CHARACTERISTIC Cxx_fsys_eal_max_thd "Maximum threshold on engine air load to authorize fuel system diagnosis" VALUE 0xa002080c _REC_S1VAL_20_u2 3.99993896484375 _CNV_A_R_LINEAR_____53_CM 0. 3.99993896484375 FORMAT "%7.5" /end CHARACTERISTIC
/begin CHARACTERISTIC Cxx_fsys_fuel_typ_rat_max_1 "First maximum rate of exotic fuel to authorize the diagnosis of the fuel system" VALUE 0xa002080e _REC_S1VAL_20_u2 1. _CNV_A_R_LINEAR_____108_CM 0. 1. /end CHARACTERISTIC
/begin CHARACTERISTIC Cxx_fsys_fuel_typ_rat_max_2 "Second maximum rate of exotic fuel to authorize the diagnosis of the fuel system" VALUE 0xa0020810 _REC_S1VAL_20_u2 1. _CNV_A_R_LINEAR_____108_CM 0. 1. /end CHARACTERISTIC
/begin CHARACTERISTIC Cxx_fsys_fuel_typ_rat_min_1 "First minimum rate of exotic fuel to authorize the diagnosis of the fuel system" VALUE 0xa0020812 _REC_S1VAL_20_u2 1. _CNV_A_R_LINEAR_____108_CM 0. 1. /end CHARACTERISTIC
/begin CHARACTERISTIC Cxx_fsys_fuel_typ_rat_min_2 "Second minimum rate of exotic fuel to authorize the diagnosis of the fuel system" VALUE 0xa0020814 _REC_S1VAL_20_u2 1. _CNV_A_R_LINEAR_____108_CM 0. 1. /end CHARACTERISTIC
/begin CHARACTERISTIC Cxx_fsys_n_max_thd "Maximum threshold on engine speed to authorize fuel system diagnosis" VALUE 0xa0020816 _REC_S1VAL_20_u2 16383.75 _CNV_A_R_ENSD_LINEA_24_CM 0. 16383.75 FORMAT "%8.2" /end CHARACTERISTIC
/begin CHARACTERISTIC Cxx_fsys_n_min_thd "Minimum threshold on engine speed to authorize fuel system diagnosis" VALUE 0xa0020818 _REC_S1VAL_20_u2 16383.75 _CNV_A_R_ENSD_LINEA_24_CM 0. 16383.75 FORMAT "%8.2" /end CHARACTERISTIC
/begin CHARACTERISTIC Cxx_fsys_tco_min_thd "Threshold on engine coolant temperature to determine thesholds and filtering duration used in diagnosis strategy of the fuel system" VALUE 0xa002081a _REC_S1VAL_20_u2 240. _CNV_A_R_LINEAR_____54_CM -40. 200. FORMAT "%5.1" /end CHARACTERISTIC
/begin CHARACTERISTIC Cxx_fsys_thd_ad_fac_max "Maximum threshold on instantaneous factor on injection time." VALUE 0xa0020826 _REC_S1VAL_20_u1 0.6640625 _CNV_A_R_LINEAR_____51_CM 0.6666667 1.3307292 FORMAT "%5.3" /end CHARACTERISTIC
/begin CHARACTERISTIC Cxx_fsys_thd_ad_fac_min "Minnimum threshold on instantaneous factor on injection time." VALUE 0xa0020827 _REC_S1VAL_20_u1 0.6640625 _CNV_A_R_LINEAR_____51_CM 0.6666667 1.3307292 FORMAT "%5.3" /end CHARACTERISTIC
/begin CHARACTERISTIC Cxx_fsys_thd_ad_ofs_max "Maximum threshold on instantaneous adaptation offset on injection time." VALUE 0xa0020828 _REC_S1VAL_20_s1 1020. _CNV_A_R_LINEAR_____50_CM -512. 508. FORMAT "%1.0" /end CHARACTERISTIC
/begin CHARACTERISTIC Cxx_fsys_thd_ad_ofs_min "Minimum threshold on instantaneous adaptation offset on injection time." VALUE 0xa0020829 _REC_S1VAL_20_s1 1020. _CNV_A_R_LINEAR_____50_CM -512. 508. FORMAT "%1.0" /end CHARACTERISTIC
/begin CHARACTERISTIC Cxx_fsys_win_nr_fail "Number of folowing windows to detect a failure." VALUE 0xa002082a _REC_S1VAL_20_u1 255. _CNV_A_R_ECME_LINEA_0_CM 0. 255. FORMAT "%3.0" /end CHARACTERISTIC
/begin CHARACTERISTIC Cxx_fsys_win_nr_fail_alco "Number of following windows when using alcohol to detect a failure" VALUE 0xa002082b _REC_S1VAL_20_u1 255. _CNV_A_R_ECME_LINEA_0_CM 0. 255. FORMAT "%3.0" /end CHARACTERISTIC
/begin CHARACTERISTIC Cxx_min_diag_fsys_dly "Delay Inhibition FuelSystem Diagnostic after start" VALUE 0xa002081c _REC_S1VAL_20_u2 32767.5 _CNV_A_R_LINEAR_____344_CM 0. 32767.5 FORMAT "%4.1" /end CHARACTERISTIC
/begin MEASUREMENT Vbx_rich_clos_loop_mon_cfm "Richness closed loop monitoring configuration" UBYTE _CNV_S_2_RANGE______3_CM 1 0. 0. 1. ECU_ADDRESS 0xd00052d6 BIT_MASK 0x1 /end MEASUREMENT
/begin CHARACTERISTIC Cbx_rich_clos_loop_mon_cfm "Richness closed loop monitoring activation" VALUE 0xa00207db _REC_S1VAL_20_u1 1. _CNV_A_R_ECME_LINEA_0_CM 0. 1. FORMAT "%1.0" BIT_MASK 0x1 /end CHARACTERISTIC
/begin AXIS_PTS Ctb_ctl_mon_tco "Table of engine coolant temperature breakpoints" 0xa002529c Vxx_tco _REC_A2AXS_20_u2 240. _CNV_A_R_LINEAR_____54_CM 10 -40. 200. FORMAT "%6.1" /end AXIS_PTS
/begin CHARACTERISTIC Ctp_ctl_mon_t_max "" CURVE 0xa00252b4 _REC_A1CUR_20_u2_u2 6553.5 _CNV_A_R_LINEAR_____4_CM 0. 6553.5 FORMAT "%6.1"
 /begin AXIS_DESCR COM_AXIS Vxx_tco _CNV_A_R_LINEAR_____54_CM 10 -40. 200. FORMAT "%6.1" AXIS_PTS_REF Ctb_ctl_mon_tco /end AXIS_DESCR
/end CHARACTERISTIC
/begin MEASUREMENT Vbx_cl_mon_end "End of the diagnosis if value=1" UBYTE _CNV_S_2_RANGE______3_CM 1 0. 0. 1. ECU_ADDRESS 0xd0005058 BIT_MASK 0x1 /end MEASUREMENT
/begin MEASUREMENT Vbx_cl_mon_req "Authorization of the diagnosis of the richness regulation" UBYTE _CNV_S_2_RANGE______3_CM 1 0. 0. 1. ECU_ADDRESS 0xd0005059 BIT_MASK 0x1 /end MEASUREMENT
/begin MEASUREMENT Vbx_df_cl_rich_chr "Faillure present on the richness regulation." UBYTE _CNV_S_2_RANGE______3_CM 1 0. 0. 1. ECU_ADDRESS 0xd000505a BIT_MASK 0x1 /end MEASUREMENT
/begin MEASUREMENT Vbx_diag_ena_cl_rich_chr "Authorisation of sending data to faillure manager" UBYTE _CNV_S_2_RANGE______3_CM 1 0. 0. 1. ECU_ADDRESS 0xd000505b BIT_MASK 0x1 /end MEASUREMENT
/begin MEASUREMENT Vsx_ctl_mon_stt "State of the diagnosis of the richness regulation" UBYTE _CNV_S_4_CTL_MON_DI_427_CM 1 0. 10. 40. ECU_ADDRESS 0xd000505c /end MEASUREMENT
/begin MEASUREMENT Vxx_cl_rich_chr_max_clr "Default value in case of erasement of the threshold for the detection of the faillure saved in mode 6" UWORD _CNV_A_R_LINEAR_____4_CM 1 0. 0. 6553.5 ECU_ADDRESS 0xd0005b6c FORMAT "%6.1" /end MEASUREMENT
/begin MEASUREMENT Vxx_cl_rich_chr_max_ini "Initialisation of the threshold for the diagnosis criterion of the faillure saved in mode 6" UWORD _CNV_A_R_LINEAR_____4_CM 1 0. 0. 6553.5 ECU_ADDRESS 0xd0005b6e FORMAT "%6.1" /end MEASUREMENT
/begin MEASUREMENT Vxx_cl_rich_chr_val_clr "Default value in case of erasement of the criterion diagnosis for the detection of the faillure saved in mode 6" UWORD _CNV_A_R_LINEAR_____4_CM 1 0. 0. 6553.5 ECU_ADDRESS 0xd0005b70 FORMAT "%6.1" /end MEASUREMENT
/begin MEASUREMENT Vxx_cl_rich_chr_val_ini "Initialisation of the threshold for the diagnosis criterion of the faillure saved in mode 6" UWORD _CNV_A_R_LINEAR_____4_CM 1 0. 0. 6553.5 ECU_ADDRESS 0xd0005b72 FORMAT "%6.1" /end MEASUREMENT
/begin MEASUREMENT Vxx_ctl_mon_t "Diagnosis criterion: time passed in open loop regulation since engine start" UWORD _CNV_A_R_LINEAR_____4_CM 1 0. 0. 6553.5 ECU_ADDRESS 0xd0005b74 FORMAT "%6.1" /end MEASUREMENT
/begin MEASUREMENT Vxx_ctl_mon_t_max "Maximum threshold to detect a faillure on richness regulation" UWORD _CNV_A_R_LINEAR_____4_CM 1 0. 0. 6553.5 ECU_ADDRESS 0xd0005b76 FORMAT "%6.1" /end MEASUREMENT
/begin MEASUREMENT Vxx_ctl_mon_thd_max "Maximum time to declare a faillure in richness control" UWORD _CNV_A_R_LINEAR_____4_CM 1 0. 0. 6553.5 ECU_ADDRESS 0xd0005b78 FORMAT "%6.1" /end MEASUREMENT
/begin CHARACTERISTIC Cbx_conf_schd_diag_ctl_mon "Acitvation of the feedback control monitoring strategy" VALUE 0xa0021ed0 _REC_S1VAL_20_u1 1. _CNV_A_R_ECME_LINEA_0_CM 0. 1. FORMAT "%1.0" BIT_MASK 0x1 /end CHARACTERISTIC
/begin CHARACTERISTIC Cxx_dfdec_cl_rich_chr "cb_ric_dgn_ctlmonx / Closed loop richness detected failure counter decrement" VALUE 0xa0021ecc _REC_S1VAL_20_u2 65535. _CNV_A_R_ECME_LINEA_0_CM 0. 65535. FORMAT "%5.0" /end CHARACTERISTIC
/begin CHARACTERISTIC Cxx_dfinc_cl_rich_chr "cb_ric_dgn_ctlmonx / Closed loop richness detected failure counter increment" VALUE 0xa0021ece _REC_S1VAL_20_u2 65535. _CNV_A_R_ECME_LINEA_0_CM 0. 65535. FORMAT "%5.0" /end CHARACTERISTIC
/begin MEASUREMENT Vbx_tlz_ad_cor_ok "Booleen d'apprentissage valide dÈfaut demi-tour" UBYTE _CNV_S_2_RANGE______3_CM 1 0. 0. 1. DISPLAY_IDENTIFIER InTqiTlz_NVM.Vbx_tlz_ad_cor_ok_NVM ECU_ADDRESS 0xd0001868 BIT_MASK 0x1 /end MEASUREMENT
/begin MEASUREMENT Vbx_tlz_ad_b_done "" UBYTE _CNV_S_2_RANGE______3_CM 1 0. 0. 1. DISPLAY_IDENTIFIER InTqiTlz_NVM.Vbx_tlz_ad_b_done_NVM ECU_ADDRESS 0xd0001869 BIT_MASK 0x1 /end MEASUREMENT
/begin MEASUREMENT Vbx_tlz_ad_b_clc "" UBYTE _CNV_S_2_RANGE______3_CM 1 0. 0. 1. DISPLAY_IDENTIFIER InTqiTlz_NVM.Vbx_tlz_ad_b_clc_NVM ECU_ADDRESS 0xd000186a BIT_MASK 0x1 /end MEASUREMENT
/begin MEASUREMENT Vxx_tlz_ad_b_ok "Status of target adaptive process" UBYTE _CNV_A_R_ECME_LINEA_0_CM 1 0. 0. 2. DISPLAY_IDENTIFIER InTqiTlz_NVM.Vxx_tlz_ad_b_ok_NVM ECU_ADDRESS 0xd000186b FORMAT "%1.0" /end MEASUREMENT
/begin MEASUREMENT Vxx_tlz_ad_bkp_last "Last achieved adaptive value." UBYTE _CNV_A_R_ECME_LINEA_0_CM 1 0. 0. 6. DISPLAY_IDENTIFIER InTqiTlz_NVM.Vxx_tlz_ad_bkp_last_NVM ECU_ADDRESS 0xd000186c FORMAT "%1.0" /end MEASUREMENT
/begin MEASUREMENT Vxx_tlz_ad_b1_ctr_tdc "TDC counter for slow TLZBETA1 adaptive process" UWORD _CNV_A_R_LINEAR_____55_CM 1 0. 0. 65535. DISPLAY_IDENTIFIER InTqiTlz_NVM.Vxx_tlz_ad_b1_ctr_tdc_NVM ECU_ADDRESS 0xd000186e FORMAT "%5.0" /end MEASUREMENT
/begin MEASUREMENT Vxx_tlz_ad_b2_ctr_tdc "TDC counter for TLZBETA2 fast adaptive process" UWORD _CNV_A_R_LINEAR_____55_CM 1 0. 0. 65535. DISPLAY_IDENTIFIER InTqiTlz_NVM.Vxx_tlz_ad_b2_ctr_tdc_NVM ECU_ADDRESS 0xd0001870 FORMAT "%5.0" /end MEASUREMENT
/begin MEASUREMENT Vxx_mis_n_max_thd_1_2 "Maximum engine speed for misfiringdetection strategy" UWORD _CNV_A_R_ENSD_LINEA_24_CM 1 0. 0. 16383.75 DISPLAY_IDENTIFIER InTqiTlz_NVM.Vxx_mis_n_max_thd_1_2_NVM ECU_ADDRESS 0xd0001872 FORMAT "%8.2" /end MEASUREMENT
/begin MEASUREMENT Vxx_tlz_ad_cor_ctr_tdc "Compteur d'apprentissages dÈfaut demi-tour rÈalisÈs" UWORD _CNV_A_R_LINEAR_____55_CM 1 0. 0. 65535. DISPLAY_IDENTIFIER InTqiTlz_NVM.Vxx_tlz_ad_cor_ctr_tdc_NVM ECU_ADDRESS 0xd0001874 FORMAT "%5.0" /end MEASUREMENT
/begin MEASUREMENT Vxx_tlz_ad_cor_fil "Valeur apprise filtrÈe (correspondant ‡ 8 * TLZCORAP)" SWORD _CNV_A_R_ECME_LINEA_0_CM 1 0. -32768. 32767. DISPLAY_IDENTIFIER InTqiTlz_NVM.Vxx_tlz_ad_cor_fil_NVM ECU_ADDRESS 0xd0001876 FORMAT "%6.0" /end MEASUREMENT
/begin MEASUREMENT Vxx_tlz_ad_cor_val "TLZ adaptive correction" SWORD _CNV_A_R_ECME_LINEA_0_CM 1 0. -32768. 32767. DISPLAY_IDENTIFIER InTqiTlz_NVM.Vxx_tlz_ad_cor_val_NVM ECU_ADDRESS 0xd0001878 FORMAT "%6.0" /end MEASUREMENT
/begin MEASUREMENT Vxx_mis_km_dly "Distance driven since torque meter init." ULONG _CNV_A_R_LINEAR_____428_CM 1 0. 0. 4660337.5 DISPLAY_IDENTIFIER InTqiTlz_NVM.Vxx_mis_km_dly_NVM ECU_ADDRESS 0xd000187a FORMAT "%9.1" /end MEASUREMENT
/begin MEASUREMENT Vxx_tlz_ad_b2_fil_1 "Filtered adaptive value for cyl 2 and 3 in the first speed range" SLONG _CNV_A_R_ECME_LINEA_0_CM 1 0. -2147483648. 2147483647. DISPLAY_IDENTIFIER InTqiTlz_NVM.Vxx_tlz_ad_b2_fil_1_NVM ECU_ADDRESS 0xd000187e FORMAT "%11.0" /end MEASUREMENT
/begin MEASUREMENT Vxx_tlz_ad_b1_fil_2 "Filtered adaptive value for cyl 1 and 4 in the second speed range" SLONG _CNV_A_R_ECME_LINEA_0_CM 1 0. -2147483648. 2147483647. DISPLAY_IDENTIFIER InTqiTlz_NVM.Vxx_tlz_ad_b1_fil_2_NVM ECU_ADDRESS 0xd0001882 FORMAT "%11.0" /end MEASUREMENT
/begin MEASUREMENT Vxx_tlz_ad_b2_fil_2 "Filtered adaptive value for cyl 2 and 3 in the second speed range" SLONG _CNV_A_R_ECME_LINEA_0_CM 1 0. -2147483648. 2147483647. DISPLAY_IDENTIFIER InTqiTlz_NVM.Vxx_tlz_ad_b2_fil_2_NVM ECU_ADDRESS 0xd0001886 FORMAT "%11.0" /end MEASUREMENT
/begin MEASUREMENT Vxx_tlz_ad_b1_fil_1 "Filtered adaptive value for cyl 1 and 4 in the first speed range" SLONG _CNV_A_R_ECME_LINEA_0_CM 1 0. -2147483648. 2147483647. DISPLAY_IDENTIFIER InTqiTlz_NVM.Vxx_tlz_ad_b1_fil_1_NVM ECU_ADDRESS 0xd000188a FORMAT "%11.0" /end MEASUREMENT
/begin MEASUREMENT Vxx_tlz_ad_b2_fil_3 "Filtered adaptive value for cyl 2 and 3 in the third speed range" SLONG _CNV_A_R_ECME_LINEA_0_CM 1 0. -2147483648. 2147483647. DISPLAY_IDENTIFIER InTqiTlz_NVM.Vxx_tlz_ad_b2_fil_3_NVM ECU_ADDRESS 0xd000188e FORMAT "%11.0" /end MEASUREMENT
/begin MEASUREMENT Vxx_tlz_ad_b1_fil_3 "Filtered adaptive value for cyl 1 and 4 in the third speed range" SLONG _CNV_A_R_ECME_LINEA_0_CM 1 0. -2147483648. 2147483647. DISPLAY_IDENTIFIER InTqiTlz_NVM.Vxx_tlz_ad_b1_fil_3_NVM ECU_ADDRESS 0xd0001892 FORMAT "%11.0" /end MEASUREMENT
/begin MEASUREMENT Vxx_tlz_ad_b2_fil_4 "Filtered adaptive value for cyl 2 and 3 in the 4th speed range" SLONG _CNV_A_R_ECME_LINEA_0_CM 1 0. -2147483648. 2147483647. DISPLAY_IDENTIFIER InTqiTlz_NVM.Vxx_tlz_ad_b2_fil_4_NVM ECU_ADDRESS 0xd0001896 FORMAT "%11.0" /end MEASUREMENT
/begin MEASUREMENT Vxx_tlz_ad_b1_fil_4 "Filtered adaptive value for cyl 1 and 4 in the 4th speed range" SLONG _CNV_A_R_ECME_LINEA_0_CM 1 0. -2147483648. 2147483647. DISPLAY_IDENTIFIER InTqiTlz_NVM.Vxx_tlz_ad_b1_fil_4_NVM ECU_ADDRESS 0xd000189a FORMAT "%11.0" /end MEASUREMENT
/begin MEASUREMENT Vxx_tlz_ad_b2_fil_5 "Filtered adaptive value for cyl 2 and 3 in the 5th speed range" SLONG _CNV_A_R_ECME_LINEA_0_CM 1 0. -2147483648. 2147483647. DISPLAY_IDENTIFIER InTqiTlz_NVM.Vxx_tlz_ad_b2_fil_5_NVM ECU_ADDRESS 0xd000189e FORMAT "%11.0" /end MEASUREMENT
/begin MEASUREMENT Vxx_tlz_ad_b1_fil_5 "Filtered adaptive value for cyl 1 and 4 in the 5th speed range" SLONG _CNV_A_R_ECME_LINEA_0_CM 1 0. -2147483648. 2147483647. DISPLAY_IDENTIFIER InTqiTlz_NVM.Vxx_tlz_ad_b1_fil_5_NVM ECU_ADDRESS 0xd00018a2 FORMAT "%11.0" /end MEASUREMENT
/begin MEASUREMENT Vxx_tlz_ad_b1_fil_6 "Filtered adaptive value for cyl 1 and 4 in the 6th speed range" SLONG _CNV_A_R_ECME_LINEA_0_CM 1 0. -2147483648. 2147483647. DISPLAY_IDENTIFIER InTqiTlz_NVM.Vxx_tlz_ad_b1_fil_6_NVM ECU_ADDRESS 0xd00018a6 FORMAT "%11.0" /end MEASUREMENT
/begin MEASUREMENT Vxx_tlz_ad_b2_fil_6 "Filtered adaptive value for cyl 2 and 3 in the 6th speed range" SLONG _CNV_A_R_ECME_LINEA_0_CM 1 0. -2147483648. 2147483647. DISPLAY_IDENTIFIER InTqiTlz_NVM.Vxx_tlz_ad_b2_fil_6_NVM ECU_ADDRESS 0xd00018aa FORMAT "%11.0" /end MEASUREMENT
/begin MEASUREMENT Vxx_tlz_ad_b1_fil "Filtered adaptive value for cyl 1 and 4 during slow adaptive process" SLONG _CNV_A_R_ECME_LINEA_0_CM 1 0. -2147483648. 2147483647. DISPLAY_IDENTIFIER InTqiTlz_NVM.Vxx_tlz_ad_b1_fil_NVM ECU_ADDRESS 0xd00018ae FORMAT "%11.0" /end MEASUREMENT
/begin MEASUREMENT Vxx_tlz_ad_b2_fil "Filtered adaptive value for cyl 2 and 3 during slow adaptive process" SLONG _CNV_A_R_ECME_LINEA_0_CM 1 0. -2147483648. 2147483647. DISPLAY_IDENTIFIER InTqiTlz_NVM.Vxx_tlz_ad_b2_fil_NVM ECU_ADDRESS 0xd00018b2 FORMAT "%11.0" /end MEASUREMENT
/begin AXIS_PTS Ctb_n_tlz_ad_b "Breakpoints table for Ctp_tlz_ad_beta_grd_prs" 0xa00252e8 Vxx_n _REC_A2AXS_20_u2 16383.75 _CNV_A_R_ENSD_LINEA_24_CM 6 0. 16383.75 FORMAT "%8.2" /end AXIS_PTS
/begin AXIS_PTS Ntb_7 "Table transforming the engine speed into the interval of interpolation." 0xa0020994 Vxx_tlz_ad_bkp_last _REC_A2AXS_20_u1 6. _CNV_A_R_ECME_LINEA_0_CM 7 0. 6. READ_ONLY FORMAT "%1.0" /end AXIS_PTS
/begin CHARACTERISTIC Ctd_mis_n_max_thd_1_2 "Table of maximum engine speed for misfiring detection strategy" CURVE 0xa00252f8 _REC_A1CUR_20_u2_u1 16383.75 _CNV_A_R_ENSD_LINEA_24_CM 0. 16383.75 FORMAT "%8.2"
 /begin AXIS_DESCR COM_AXIS Vxx_tlz_ad_bkp_last _CNV_A_R_ECME_LINEA_0_CM 7 0. 6. READ_ONLY FORMAT "%1.0" AXIS_PTS_REF Ntb_7 /end AXIS_DESCR
/end CHARACTERISTIC
/begin CHARACTERISTIC Ctd_tlz_ad_b_ena "Indexed table  that enables the adaptive process on different gear ratios." CURVE 0xa002098c _REC_A1CUR_20_u1_u1 1. _CNV_A_R_ECME_LINEA_0_CM 0. 1. FORMAT "%1.0"
 /begin AXIS_DESCR COM_AXIS Vxx_gear _CNV_A_R_LINEAR_____113_CM 8 -1. 6. READ_ONLY FORMAT "%2.0" AXIS_PTS_REF Ntb_gear /end AXIS_DESCR
/end CHARACTERISTIC
/begin CHARACTERISTIC Ctp_tlz_ad_b_grd_prs "Table: gradient of BETA depending on manifold presure." CURVE 0xa0025308 _REC_A1CUR_20_u2_u2 65535. _CNV_A_R_ECME_LINEA_0_CM 0. 65535. FORMAT "%5.0"
 /begin AXIS_DESCR COM_AXIS Vxx_n _CNV_A_R_ENSD_LINEA_24_CM 6 0. 16383.75 FORMAT "%8.2" AXIS_PTS_REF Ctb_n_tlz_ad_b /end AXIS_DESCR
/end CHARACTERISTIC
/begin MEASUREMENT Vbx_df_tlz_ad_b_cpt "Cranckshaft position system variation not learned  component detected failure" UBYTE _CNV_S_2_RANGE______3_CM 1 0. 0. 1. ECU_ADDRESS 0xd0004dac BIT_MASK 0x1 /end MEASUREMENT
/begin MEASUREMENT Vbx_tlz_ad_b_ena "Engine conditions enable adaptive process" UBYTE _CNV_S_2_RANGE______3_CM 1 0. 0. 1. ECU_ADDRESS 0xd0004dad BIT_MASK 0x1 /end MEASUREMENT
/begin MEASUREMENT Vbx_tlz_ad_b_fast_stt_ena "Fast BETA adaptive process enabled" UBYTE _CNV_S_2_RANGE______3_CM 1 0. 0. 1. ECU_ADDRESS 0xd0004dae BIT_MASK 0x1 /end MEASUREMENT
/begin MEASUREMENT Vbx_tlz_ad_b_slow_stt_ena "Slow BETA adaptive process enabled" UBYTE _CNV_S_2_RANGE______3_CM 1 0. 0. 1. ECU_ADDRESS 0xd0004daf BIT_MASK 0x1 /end MEASUREMENT
/begin MEASUREMENT Vbx_tlz_ad_b_wat_stt_ena "Adaptive process waiting for powertrain conditions" UBYTE _CNV_S_2_RANGE______3_CM 1 0. 0. 1. ECU_ADDRESS 0xd0004db0 BIT_MASK 0x1 /end MEASUREMENT
/begin MEASUREMENT Vbx_tlz_fast_ad_b_ena "Engine conditions enable slow adaptive process" UBYTE _CNV_S_2_RANGE______3_CM 1 0. 0. 1. ECU_ADDRESS 0xd0004db1 BIT_MASK 0x1 /end MEASUREMENT
/begin MEASUREMENT Vbx_tlz_slow_ad_b_dsb "Enagine conditions disable slow adaptive process" UBYTE _CNV_S_2_RANGE______3_CM 1 0. 0. 1. ECU_ADDRESS 0xd0004db2 BIT_MASK 0x1 /end MEASUREMENT
/begin MEASUREMENT Vbx_tlz_slow_ad_b_ena "Enagine conditions enable slow adaptive process" UBYTE _CNV_S_2_RANGE______3_CM 1 0. 0. 1. ECU_ADDRESS 0xd0004db3 BIT_MASK 0x1 /end MEASUREMENT
/begin MEASUREMENT Vsx_tlz_ad_b_stt "State of TLZBEAT adaptive process" UBYTE _CNV_S_3_RANGE_STAT_429_CM 1 0. 1. 3. ECU_ADDRESS 0xd0004db4 /end MEASUREMENT
/begin MEASUREMENT Vsx_tlz_ad_b_vld "Torquemeter TLZ adaptative correction  system validity status." UBYTE _CNV_S_3_STATUS_OK__158_CM 1 0. 0. 2. ECU_ADDRESS 0xd0004db5 /end MEASUREMENT
/begin MEASUREMENT Vxx_tlz_ad_b1_dif "Difference between previous value of Vxx_tlz_ad_beta1_fil and the best actual value" SLONG _CNV_A_R_ECME_LINEA_0_CM 1 0. -2147483648. 2147483647. ECU_ADDRESS 0xd00020b0 FORMAT "%11.0" /end MEASUREMENT
/begin MEASUREMENT Vxx_tlz_ad_b1_fil_prev "Previous value for variable Vxx_tlz_ad_b1_fil" SLONG _CNV_A_R_ECME_LINEA_0_CM 1 0. -2147483648. 2147483647. ECU_ADDRESS 0xd00020b4 FORMAT "%11.0" /end MEASUREMENT
/begin MEASUREMENT Vxx_tlz_ad_b2_dif "Difference between previous value of Vxx_tlz_ad_beta2_fil and the best actual value" SLONG _CNV_A_R_ECME_LINEA_0_CM 1 0. -2147483648. 2147483647. ECU_ADDRESS 0xd00020b8 FORMAT "%11.0" /end MEASUREMENT
/begin MEASUREMENT Vxx_tlz_ad_b2_fil_prev "Previous value fof variable Vxx_tlz_ad_b2_fil" SLONG _CNV_A_R_ECME_LINEA_0_CM 1 0. -2147483648. 2147483647. ECU_ADDRESS 0xd00020bc FORMAT "%11.0" /end MEASUREMENT
/begin MEASUREMENT Vxx_tlz_ad_b_ctr_tdc "temporary TDC counter for fast adaptive process" UWORD _CNV_A_R_LINEAR_____55_CM 1 0. 0. 65535. ECU_ADDRESS 0xd0003a3a FORMAT "%5.0" /end MEASUREMENT
/begin MEASUREMENT Vxx_tlz_ad_b_dif "Temporary difference bitween filtered value and the best actual value for the current cylindres" SLONG _CNV_A_R_ECME_LINEA_0_CM 1 0. -2147483648. 2147483647. ECU_ADDRESS 0xd00020c0 FORMAT "%11.0" /end MEASUREMENT
/begin MEASUREMENT Vxx_tlz_ad_b_fil "Temporary filtered adaptive TLZBETA value for the current cylinders" SLONG _CNV_A_R_ECME_LINEA_0_CM 1 0. -2147483648. 2147483647. ECU_ADDRESS 0xd00020c4 FORMAT "%11.0" /end MEASUREMENT
/begin MEASUREMENT Vxx_tlz_ad_b_slow_ctr_tdc "Number of TDC during  adaptive process on the current breakpoint." UBYTE _CNV_A_R_LINEAR_____55_CM 1 0. 0. 255. ECU_ADDRESS 0xd0004db6 FORMAT "%3.0" /end MEASUREMENT
/begin MEASUREMENT Vxx_tlz_ad_bkp "Current engine speed breakpoint for target adaptive process" UBYTE _CNV_A_R_ECME_LINEA_0_CM 1 0. 0. 6. ECU_ADDRESS 0xd0004db7 FORMAT "%1.0" /end MEASUREMENT
/begin CHARACTERISTIC Cbx_ad_ini_req "Reset the torque meter adapatative learning  values to specific values for tuning needs" VALUE 0xa00209fa _REC_S1VAL_20_u1 1. _CNV_S_2_RANGE______3_CM 0. 1. /end CHARACTERISTIC
/begin CHARACTERISTIC Cbx_tq_ini_req "Reset the torque meter variables" VALUE 0xa00209fb _REC_S1VAL_20_u1 1. _CNV_S_2_RANGE______3_CM 0. 1. /end CHARACTERISTIC
/begin CHARACTERISTIC Cxx_dfdec_tlz_ad_b_cpt "Crankshaft Position System Variation Not Learned Component detected failure counter decrement" VALUE 0xa002099c _REC_S1VAL_20_u2 65535. _CNV_A_R_ECME_LINEA_0_CM 0. 65535. FORMAT "%5.0" /end CHARACTERISTIC
/begin CHARACTERISTIC Cxx_dfinc_tlz_ad_b_cpt "Crankshaft Position System Variation Not Learned Component detected failure counter increment" VALUE 0xa002099e _REC_S1VAL_20_u2 65535. _CNV_A_R_ECME_LINEA_0_CM 0. 65535. FORMAT "%5.0" /end CHARACTERISTIC
/begin CHARACTERISTIC Cxx_tlz_ad_b_fil_fac "Filter gain for BETA adaptive process" VALUE 0xa00209fc _REC_S1VAL_20_u1 255. _CNV_A_R_ECME_LINEA_0_CM 0. 255. FORMAT "%3.0" /end CHARACTERISTIC
/begin CHARACTERISTIC Cxx_tlz_ad_b_max "Maximum value for calculated beta value." VALUE 0xa00209a0 _REC_S1VAL_20_s4 4294967295. _CNV_A_R_ECME_LINEA_0_CM -2147483648. 2147483647. FORMAT "%11.0" /end CHARACTERISTIC
/begin CHARACTERISTIC Cxx_tlz_ad_b_max_1 "Maximum value of calculated beta value for the first range speed" VALUE 0xa00209a4 _REC_S1VAL_20_s4 4294967295. _CNV_A_R_ECME_LINEA_0_CM -2147483648. 2147483647. FORMAT "%11.0" /end CHARACTERISTIC
/begin CHARACTERISTIC Cxx_tlz_ad_b_max_2 "Maximum value of calculated beta value for the second range speed" VALUE 0xa00209a8 _REC_S1VAL_20_s4 4294967295. _CNV_A_R_ECME_LINEA_0_CM -2147483648. 2147483647. FORMAT "%11.0" /end CHARACTERISTIC
/begin CHARACTERISTIC Cxx_tlz_ad_b_max_3 "Maximum value of calculated beta value for the third range speed" VALUE 0xa00209ac _REC_S1VAL_20_s4 4294967295. _CNV_A_R_ECME_LINEA_0_CM -2147483648. 2147483647. FORMAT "%11.0" /end CHARACTERISTIC
/begin CHARACTERISTIC Cxx_tlz_ad_b_max_4 "Maximum value of calculated beta value for the fourth range speed" VALUE 0xa00209b0 _REC_S1VAL_20_s4 4294967295. _CNV_A_R_ECME_LINEA_0_CM -2147483648. 2147483647. FORMAT "%11.0" /end CHARACTERISTIC
/begin CHARACTERISTIC Cxx_tlz_ad_b_max_5 "Maximum value of calculated beta value for the fifth range speed" VALUE 0xa00209b4 _REC_S1VAL_20_s4 4294967295. _CNV_A_R_ECME_LINEA_0_CM -2147483648. 2147483647. FORMAT "%11.0" /end CHARACTERISTIC
/begin CHARACTERISTIC Cxx_tlz_ad_b_max_6 "Maximum value of calculated beta value for the sixth range speed." VALUE 0xa00209b8 _REC_S1VAL_20_s4 4294967295. _CNV_A_R_ECME_LINEA_0_CM -2147483648. 2147483647. FORMAT "%11.0" /end CHARACTERISTIC
/begin CHARACTERISTIC Cxx_tlz_ad_b_min "Minimum value for calculated beta value." VALUE 0xa00209bc _REC_S1VAL_20_s4 4294967295. _CNV_A_R_ECME_LINEA_0_CM -2147483648. 2147483647. FORMAT "%11.0" /end CHARACTERISTIC
/begin CHARACTERISTIC Cxx_tlz_ad_b_min_1 "Minimum value of calculated beta value for the first range speed" VALUE 0xa00209c0 _REC_S1VAL_20_s4 4294967295. _CNV_A_R_ECME_LINEA_0_CM -2147483648. 2147483647. FORMAT "%11.0" /end CHARACTERISTIC
/begin CHARACTERISTIC Cxx_tlz_ad_b_min_2 "Minimum value of calculated beta value for the second range speed" VALUE 0xa00209c4 _REC_S1VAL_20_s4 4294967295. _CNV_A_R_ECME_LINEA_0_CM -2147483648. 2147483647. FORMAT "%11.0" /end CHARACTERISTIC
/begin CHARACTERISTIC Cxx_tlz_ad_b_min_3 "Minimum value of calculated beta value for the third range speed" VALUE 0xa00209c8 _REC_S1VAL_20_s4 4294967295. _CNV_A_R_ECME_LINEA_0_CM -2147483648. 2147483647. FORMAT "%11.0" /end CHARACTERISTIC
/begin CHARACTERISTIC Cxx_tlz_ad_b_min_4 "Minimum value of calculated beta value for the fourth range speed" VALUE 0xa00209cc _REC_S1VAL_20_s4 4294967295. _CNV_A_R_ECME_LINEA_0_CM -2147483648. 2147483647. FORMAT "%11.0" /end CHARACTERISTIC
/begin CHARACTERISTIC Cxx_tlz_ad_b_min_5 "Minimum value of calculated beta value for the fifth range speed" VALUE 0xa00209d0 _REC_S1VAL_20_s4 4294967295. _CNV_A_R_ECME_LINEA_0_CM -2147483648. 2147483647. FORMAT "%11.0" /end CHARACTERISTIC
/begin CHARACTERISTIC Cxx_tlz_ad_b_min_6 "Minimum value of calculated beta value for the sixth range speed." VALUE 0xa00209d4 _REC_S1VAL_20_s4 4294967295. _CNV_A_R_ECME_LINEA_0_CM -2147483648. 2147483647. FORMAT "%11.0" /end CHARACTERISTIC
/begin CHARACTERISTIC Cxx_tlz_ad_b_n_max "Max engine speed for slow adaptive process" VALUE 0xa00209d8 _REC_S1VAL_20_u2 16383.75 _CNV_A_R_ENSD_LINEA_24_CM 0. 16383.75 FORMAT "%8.2" /end CHARACTERISTIC
/begin CHARACTERISTIC Cxx_tlz_ad_b_n_max_1 "Upper threshold for first engine speed range for TLZBETA adaptive process" VALUE 0xa00209da _REC_S1VAL_20_u2 16383.75 _CNV_A_R_ENSD_LINEA_24_CM 0. 16383.75 FORMAT "%8.2" /end CHARACTERISTIC
/begin CHARACTERISTIC Cxx_tlz_ad_b_n_max_2 "Upper threshold for second engine speed range for TLZBETA adaptive process" VALUE 0xa00209dc _REC_S1VAL_20_u2 16383.75 _CNV_A_R_ENSD_LINEA_24_CM 0. 16383.75 FORMAT "%8.2" /end CHARACTERISTIC
/begin CHARACTERISTIC Cxx_tlz_ad_b_n_max_3 "Upper threshold for third engine speed range for TLZBETA adaptive process" VALUE 0xa00209de _REC_S1VAL_20_u2 16383.75 _CNV_A_R_ENSD_LINEA_24_CM 0. 16383.75 FORMAT "%8.2" /end CHARACTERISTIC
/begin CHARACTERISTIC Cxx_tlz_ad_b_n_max_4 "Upper threshold for 4th engine speed range for TLZBETA adaptive process" VALUE 0xa00209e0 _REC_S1VAL_20_u2 16383.75 _CNV_A_R_ENSD_LINEA_24_CM 0. 16383.75 FORMAT "%8.2" /end CHARACTERISTIC
/begin CHARACTERISTIC Cxx_tlz_ad_b_n_max_5 "Upper threshold for 5th engine speed range for TLZBETA adaptive process" VALUE 0xa00209e2 _REC_S1VAL_20_u2 16383.75 _CNV_A_R_ENSD_LINEA_24_CM 0. 16383.75 FORMAT "%8.2" /end CHARACTERISTIC
/begin CHARACTERISTIC Cxx_tlz_ad_b_n_max_6 "Upper threshold for 6th engine speed range for TLZBETA adaptive process" VALUE 0xa00209e4 _REC_S1VAL_20_u2 16383.75 _CNV_A_R_ENSD_LINEA_24_CM 0. 16383.75 FORMAT "%8.2" /end CHARACTERISTIC
/begin CHARACTERISTIC Cxx_tlz_ad_b_n_min "Minimum engine speed for slow TLZBETA adaptive process" VALUE 0xa00209e6 _REC_S1VAL_20_u2 16383.75 _CNV_A_R_ENSD_LINEA_24_CM 0. 16383.75 FORMAT "%8.2" /end CHARACTERISTIC
/begin CHARACTERISTIC Cxx_tlz_ad_b_n_min_1 "Lower threshold for firts engine speed range for TLZBETA adaptive process" VALUE 0xa00209e8 _REC_S1VAL_20_u2 16383.75 _CNV_A_R_ENSD_LINEA_24_CM 0. 16383.75 FORMAT "%8.2" /end CHARACTERISTIC
/begin CHARACTERISTIC Cxx_tlz_ad_b_n_min_2 "Lower threshold for second engine speed range for TLZBETA adaptive process" VALUE 0xa00209ea _REC_S1VAL_20_u2 16383.75 _CNV_A_R_ENSD_LINEA_24_CM 0. 16383.75 FORMAT "%8.2" /end CHARACTERISTIC
/begin CHARACTERISTIC Cxx_tlz_ad_b_n_min_3 "Lower threshold for third engine speed range for TLZBETA adaptive process" VALUE 0xa00209ec _REC_S1VAL_20_u2 16383.75 _CNV_A_R_ENSD_LINEA_24_CM 0. 16383.75 FORMAT "%8.2" /end CHARACTERISTIC
/begin CHARACTERISTIC Cxx_tlz_ad_b_n_min_4 "Lower threshold for  4th engine speed range for TLZBETA adaptive process" VALUE 0xa00209ee _REC_S1VAL_20_u2 16383.75 _CNV_A_R_ENSD_LINEA_24_CM 0. 16383.75 FORMAT "%8.2" /end CHARACTERISTIC
/begin CHARACTERISTIC Cxx_tlz_ad_b_n_min_5 "Lower threshold for 5th engine speed range for TLZBETA adaptive process" VALUE 0xa00209f0 _REC_S1VAL_20_u2 16383.75 _CNV_A_R_ENSD_LINEA_24_CM 0. 16383.75 FORMAT "%8.2" /end CHARACTERISTIC
/begin CHARACTERISTIC Cxx_tlz_ad_b_n_min_6 "Lower threshold for 6th engine speed range for TLZBETA adaptive process" VALUE 0xa00209f2 _REC_S1VAL_20_u2 16383.75 _CNV_A_R_ENSD_LINEA_24_CM 0. 16383.75 FORMAT "%8.2" /end CHARACTERISTIC
/begin CHARACTERISTIC Cxx_tlz_ad_b_nr_tdc "Number of TDC for fast adaptive process." VALUE 0xa00209f4 _REC_S1VAL_20_u2 65534. _CNV_A_R_LINEAR_____55_CM 1. 65535. FORMAT "%5.0" /end CHARACTERISTIC
/begin CHARACTERISTIC Cxx_tlz_ad_b_slow_nr_tdc "Minimum number of TDC for adaptive process on all breakpoints." VALUE 0xa00209fd _REC_S1VAL_20_u1 255. _CNV_A_R_LINEAR_____55_CM 0. 255. FORMAT "%3.0" /end CHARACTERISTIC
/begin CHARACTERISTIC Cxx_tlz_b_ini "Beta paramter for TLZ index" VALUE 0xa00209f6 _REC_S1VAL_20_s2 65535. _CNV_A_R_ECME_LINEA_0_CM -32768. 32767. FORMAT "%6.0" /end CHARACTERISTIC
/begin CHARACTERISTIC Cxx_vs_n_rat_dif_max "ration variation threshold (CVT) to inhibite the adaptative process" VALUE 0xa00209f8 _REC_S1VAL_20_u2 655.34 _CNV_A_R_LINEAR_____331_CM 0. 655.34 FORMAT "%6.2" /end CHARACTERISTIC
/begin CHARACTERISTIC Cxx_vs_n_rat_dif_max_dly "Delay to inhibit the adaptative process" VALUE 0xa00209fe _REC_S1VAL_20_u1 255. _CNV_A_R_LINEAR_____55_CM 0. 255. FORMAT "%3.0" /end CHARACTERISTIC
/begin MEASUREMENT Vbx_tlz_ad_cor_ena "conditions requeired for adaptive process fulfilled" UBYTE _CNV_S_2_RANGE______3_CM 1 0. 0. 1. ECU_ADDRESS 0xd0004402 BIT_MASK 0x1 /end MEASUREMENT
/begin MEASUREMENT Vbx_tlz_ad_cor_ok_1 "Booleen d'apprentissage valide dÈfaut demi-tour intermÈdiaire" UBYTE _CNV_S_2_RANGE______3_CM 1 0. 0. 1. ECU_ADDRESS 0xd0004403 BIT_MASK 0x1 /end MEASUREMENT
/begin MEASUREMENT Vbx_tlz_stt_0_tmp "Internal Trig enable for tlz torque correction beta coefficient computation" UBYTE _CNV_S_2_RANGE______3_CM 1 0. 0. 1. ECU_ADDRESS 0xd0004404 BIT_MASK 0x1 /end MEASUREMENT
/begin MEASUREMENT Vbx_tlz_stt_1_tmp "Internal Trig Enable for TLZ calculation" UBYTE _CNV_S_2_RANGE______3_CM 1 0. 0. 1. ECU_ADDRESS 0xd0004405 BIT_MASK 0x1 /end MEASUREMENT
/begin MEASUREMENT Vbx_tlz_stt_2_tmp "Internal Trig Enable for TLZ calculation" UBYTE _CNV_S_2_RANGE______3_CM 1 0. 0. 1. ECU_ADDRESS 0xd0004406 BIT_MASK 0x1 /end MEASUREMENT
/begin MEASUREMENT Vsx_tlz_ad_cor_stt "Curent state of the state machine for low frequency tlz correction" UBYTE _CNV_A_R_ECME_LINEA_0_CM 1 0. 0. 4. ECU_ADDRESS 0xd0004407 FORMAT "%1.0" /end MEASUREMENT
/begin MEASUREMENT Vxx_tlz_ad_cor_dif "DiffÈrentiel entre la valeur de TLZCORAP prÈcÈdente et sa valeur optimale actuelle" SLONG _CNV_A_R_ECME_LINEA_0_CM 1 0. -2147483648. 2147483647. ECU_ADDRESS 0xd000216c FORMAT "%11.0" /end MEASUREMENT
/begin CHARACTERISTIC Cbx_tlz_ad_cor_conf "Boolean for inhibition of the low frequency adaptive process" VALUE 0xa00215b2 _REC_S1VAL_20_u1 1. _CNV_S_2_RANGE______3_CM 0. 1. /end CHARACTERISTIC
/begin CHARACTERISTIC Cxx_tlz_ad_cor_fil_fac "Valeur de filtrage des corrections apprentissage dÈfaut demi-tour" VALUE 0xa00215b3 _REC_S1VAL_20_u1 255. _CNV_A_R_ECME_LINEA_0_CM 0. 255. FORMAT "%3.0" /end CHARACTERISTIC
/begin CHARACTERISTIC Cxx_tlz_ad_cor_n_max "Valeur max de reg au dessus : apprentissage correction  inhibÈ.  Valeur defaut 2000 tr/mn" VALUE 0xa00215ac _REC_S1VAL_20_u2 16383.75 _CNV_A_R_ENSD_LINEA_24_CM 0. 16383.75 FORMAT "%8.2" /end CHARACTERISTIC
/begin CHARACTERISTIC Cxx_tlz_ad_cor_n_min "Valeur mini de reg en sous laquelle l'apprentissage correction  est inhibÈ. Valeur dÈfaut 2400 tr/mn" VALUE 0xa00215ae _REC_S1VAL_20_u2 16383.75 _CNV_A_R_ENSD_LINEA_24_CM 0. 16383.75 FORMAT "%8.2" /end CHARACTERISTIC
/begin CHARACTERISTIC Cxx_tlz_ad_cor_nr_tdc "Nombre de PMH pour l'apprentissage rapide du dÈfaut demi-tour" VALUE 0xa00215b0 _REC_S1VAL_20_u2 65534. _CNV_A_R_LINEAR_____55_CM 1. 65535. FORMAT "%5.0" /end CHARACTERISTIC
/begin MEASUREMENT Vbx_tlz_b_clc_ena "Engine speed condition enables the calculation of beta" UBYTE _CNV_S_2_RANGE______3_CM 1 0. 0. 1. ECU_ADDRESS 0xd0004b93 BIT_MASK 0x1 /end MEASUREMENT
/begin MEASUREMENT Vtx_tlz_ad_b_val[0] "table with adaptive values on the curent half tone wheel." SWORD _CNV_A_R_ECME_LINEA_0_CM 1 0. -32768. 32767. ECU_ADDRESS 0xd0003290 FORMAT "%6.0" /end MEASUREMENT
/begin MEASUREMENT Vtx_tlz_ad_b_val[1] "table with adaptive values on the curent half tone wheel." SWORD _CNV_A_R_ECME_LINEA_0_CM 1 0. -32768. 32767. ECU_ADDRESS 0xd0003292 FORMAT "%6.0" /end MEASUREMENT
/begin MEASUREMENT Vtx_tlz_ad_b_val[2] "table with adaptive values on the curent half tone wheel." SWORD _CNV_A_R_ECME_LINEA_0_CM 1 0. -32768. 32767. ECU_ADDRESS 0xd0003294 FORMAT "%6.0" /end MEASUREMENT
/begin MEASUREMENT Vtx_tlz_ad_b_val[3] "table with adaptive values on the curent half tone wheel." SWORD _CNV_A_R_ECME_LINEA_0_CM 1 0. -32768. 32767. ECU_ADDRESS 0xd0003296 FORMAT "%6.0" /end MEASUREMENT
/begin MEASUREMENT Vtx_tlz_ad_b_val[4] "table with adaptive values on the curent half tone wheel." SWORD _CNV_A_R_ECME_LINEA_0_CM 1 0. -32768. 32767. ECU_ADDRESS 0xd0003298 FORMAT "%6.0" /end MEASUREMENT
/begin MEASUREMENT Vtx_tlz_ad_b_val[5] "table with adaptive values on the curent half tone wheel." SWORD _CNV_A_R_ECME_LINEA_0_CM 1 0. -32768. 32767. ECU_ADDRESS 0xd000329a FORMAT "%6.0" /end MEASUREMENT
/begin MEASUREMENT Vxx_tlz_b1_val "Value of the coefficient Beta calculated on the couple of cylinder 1-3" SWORD _CNV_A_R_ECME_LINEA_0_CM 1 0. -32768. 32767. ECU_ADDRESS 0xd000329c FORMAT "%6.0" /end MEASUREMENT
/begin MEASUREMENT Vxx_tlz_b2_val "Value of the coefficient Beta calculated on the couple of cylinder 2-3" SWORD _CNV_A_R_ECME_LINEA_0_CM 1 0. -32768. 32767. ECU_ADDRESS 0xd000329e FORMAT "%6.0" /end MEASUREMENT
/begin MEASUREMENT Vxx_tlz_b_val "Value of the coeficient beta calculated" SWORD _CNV_A_R_ECME_LINEA_0_CM 1 0. -32768. 32767. ECU_ADDRESS 0xd00032a0 FORMAT "%6.0" /end MEASUREMENT
/begin CHARACTERISTIC Cxx_tlz_n_max "Maximum engine speed for TLZ index calculation." VALUE 0xa0020954 _REC_S1VAL_20_u2 16383.75 _CNV_A_R_ENSD_LINEA_24_CM 0. 16383.75 FORMAT "%8.2" /end CHARACTERISTIC
/begin CHARACTERISTIC Cxx_tlz_n_min "Minimum engine speed for TLZ index calculation." VALUE 0xa0020956 _REC_S1VAL_20_u2 16383.75 _CNV_A_R_ENSD_LINEA_24_CM 0. 16383.75 FORMAT "%8.2" /end CHARACTERISTIC
/begin MEASUREMENT Vbx_tlz_clc "Flag for TLZCPL computation finished" UBYTE _CNV_S_2_RANGE______3_CM 1 0. 0. 1. ECU_ADDRESS 0xd000459e BIT_MASK 0x1 /end MEASUREMENT
/begin MEASUREMENT Vbx_tlz_err "Error while calculating TLZ value (variable overflow...)." UBYTE _CNV_S_2_RANGE______3_CM 1 0. 0. 1. ECU_ADDRESS 0xd000459f BIT_MASK 0x1 /end MEASUREMENT
/begin MEASUREMENT Vbx_tlz_l_n_clc_ena "Flag for engine speed in the range for low frequency correction." UBYTE _CNV_S_2_RANGE______3_CM 1 0. 0. 1. ECU_ADDRESS 0xd00045a0 BIT_MASK 0x1 /end MEASUREMENT
/begin MEASUREMENT Vbx_tlz_off_stt "Calculation of Tlz index not enabled" UBYTE _CNV_S_2_RANGE______3_CM 1 0. 0. 1. ECU_ADDRESS 0xd00045a1 BIT_MASK 0x1 /end MEASUREMENT
/begin MEASUREMENT Vbx_tlz_raw_clc "Flag for TLZBRUT computation finished." UBYTE _CNV_S_2_RANGE______3_CM 1 0. 0. 1. ECU_ADDRESS 0xd00045a2 BIT_MASK 0x1 /end MEASUREMENT
/begin MEASUREMENT Vbx_tlz_raw_err "overflow in calculation of TLZBRUT" UBYTE _CNV_S_2_RANGE______3_CM 1 0. 0. 1. ECU_ADDRESS 0xd00045a3 BIT_MASK 0x1 /end MEASUREMENT
/begin MEASUREMENT Vsx_tlz_clc_stt "TLZ index calculation state." UBYTE _CNV_S_2_RANGE_STAT_430_CM 1 0. 0. 1. ECU_ADDRESS 0xd00045a4 /end MEASUREMENT
/begin MEASUREMENT Vxx_tlz_b_cor "Coefficient TLZ bÈta corrigÈ" SLONG _CNV_A_R_LINEAR_____431_CM 1 0. -65535. 65535. ECU_ADDRESS 0xd0001ad4 FORMAT "%6.0" /end MEASUREMENT
/begin MEASUREMENT Vxx_tlz_cor_tmp "Intermediary value in TLZ calculation (low engine speed)" SLONG _CNV_A_R_ECME_LINEA_0_CM 1 0. -2147483648. 2147483647. ECU_ADDRESS 0xd0001ad8 FORMAT "%11.0" /end MEASUREMENT
/begin MEASUREMENT Vxx_tlz_raw_val "Raw TLZ torque index" SWORD _CNV_A_R_LINEAR_____302_CM 1 0. -3276.8 3276.7 ECU_ADDRESS 0xd00033ee FORMAT "%7.1" /end MEASUREMENT
/begin MEASUREMENT Vxx_tlz_val "TLZ torque index" SWORD _CNV_A_R_LINEAR_____302_CM 1 0. -3276.8 3276.7 ECU_ADDRESS 0xd00033f0 FORMAT "%6.1" /end MEASUREMENT
/begin MEASUREMENT Vxx_tlz_val_tmp "Intermediary value in TLZ calculation (high engine speed)" SLONG _CNV_A_R_ECME_LINEA_0_CM 1 0. -2147483648. 2147483647. ECU_ADDRESS 0xd0001adc FORMAT "%11.0" /end MEASUREMENT
/begin CHARACTERISTIC Cxx_tlz_a "TLZ alpha parameter: depending on the inertia of rotating elements of the engine." VALUE 0xa0021698 _REC_S1VAL_20_u2 65535. _CNV_A_R_ECME_LINEA_0_CM 0. 65535. FORMAT "%5.0" /end CHARACTERISTIC
/begin CHARACTERISTIC Cxx_tlz_cor_n_max "Maximum engine speed to enable  correction of TLZ index at low engine speed." VALUE 0xa002169a _REC_S1VAL_20_u2 16383.75 _CNV_A_R_ENSD_LINEA_24_CM 0. 16383.75 FORMAT "%8.2" /end CHARACTERISTIC
/begin AXIS_PTS Ctb_mis_tlz_cor_eal "Table of engine air load breakpoints for offset correction of TLZ torque index." 0xa00282d8 Vxx_eal_tdc_2 _REC_A2AXS_20_u2 3.99993896484375 _CNV_A_R_LINEAR_____53_CM 9 0. 3.99993896484375 FORMAT "%7.5" /end AXIS_PTS
/begin AXIS_PTS Ctb_mis_tlz_cor_n "Table of engine speed breakpoints for offset correction of TLZ torque index." 0xa00282ec Vxx_n _REC_A2AXS_20_u2 16383.75 _CNV_A_R_ENSD_LINEA_24_CM 9 0. 16383.75 FORMAT "%8.2" /end AXIS_PTS
/begin CHARACTERISTIC Cmp_mis_tlz_cor_cyl_0 "carto of cylinder 0/cylinder3 offset." MAP 0xa0028300 _REC_A1MAP_20_u2_u2_u2 6553.5 _CNV_A_R_LINEAR_____432_CM -3276.8 3276.7 FORMAT "%7.1"
 /begin AXIS_DESCR COM_AXIS Vxx_eal_tdc_2 _CNV_A_R_LINEAR_____53_CM 9 0. 3.99993896484375 FORMAT "%7.5" AXIS_PTS_REF Ctb_mis_tlz_cor_eal /end AXIS_DESCR
 /begin AXIS_DESCR COM_AXIS Vxx_n _CNV_A_R_ENSD_LINEA_24_CM 9 0. 16383.75 FORMAT "%8.2" AXIS_PTS_REF Ctb_mis_tlz_cor_n /end AXIS_DESCR
/end CHARACTERISTIC
/begin CHARACTERISTIC Cmp_mis_tlz_cor_cyl_1 "carto of cylinder 1/cylinder3 offset." MAP 0xa00283a4 _REC_A1MAP_20_u2_u2_u2 6553.5 _CNV_A_R_LINEAR_____432_CM -3276.8 3276.7 FORMAT "%7.1"
 /begin AXIS_DESCR COM_AXIS Vxx_eal_tdc_2 _CNV_A_R_LINEAR_____53_CM 9 0. 3.99993896484375 FORMAT "%7.5" AXIS_PTS_REF Ctb_mis_tlz_cor_eal /end AXIS_DESCR
 /begin AXIS_DESCR COM_AXIS Vxx_n _CNV_A_R_ENSD_LINEA_24_CM 9 0. 16383.75 FORMAT "%8.2" AXIS_PTS_REF Ctb_mis_tlz_cor_n /end AXIS_DESCR
/end CHARACTERISTIC
/begin CHARACTERISTIC Cmp_mis_tlz_cor_cyl_2 "carto of cylinder 2/cylinder3 offset." MAP 0xa0028448 _REC_A1MAP_20_u2_u2_u2 6553.5 _CNV_A_R_LINEAR_____432_CM -3276.8 3276.7 FORMAT "%7.1"
 /begin AXIS_DESCR COM_AXIS Vxx_eal_tdc_2 _CNV_A_R_LINEAR_____53_CM 9 0. 3.99993896484375 FORMAT "%7.5" AXIS_PTS_REF Ctb_mis_tlz_cor_eal /end AXIS_DESCR
 /begin AXIS_DESCR COM_AXIS Vxx_n _CNV_A_R_ENSD_LINEA_24_CM 9 0. 16383.75 FORMAT "%8.2" AXIS_PTS_REF Ctb_mis_tlz_cor_n /end AXIS_DESCR
/end CHARACTERISTIC
/begin MEASUREMENT Vbx_mis_km_ena " Application of torque correction enabled by driven distance" UBYTE _CNV_S_2_RANGE______3_CM 1 0. 0. 1. ECU_ADDRESS 0xd0004ecb BIT_MASK 0x1 /end MEASUREMENT
/begin MEASUREMENT Vbx_mis_tlz_cor_ena "Recognition success, and TLZ value calculated without errors" UBYTE _CNV_S_2_RANGE______3_CM 1 0. 0. 1. ECU_ADDRESS 0xd0004ecc BIT_MASK 0x1 /end MEASUREMENT
/begin MEASUREMENT Vxx_mis_tlz_cor "Value of applied offset correction." SWORD _CNV_A_R_LINEAR_____302_CM 1 0. -3276.8 3276.7 ECU_ADDRESS 0xd0002d78 FORMAT "%6.1" /end MEASUREMENT
/begin MEASUREMENT Vxx_mis_tlz_val_cor "Corrected value of TLZ index for misfire detection" SWORD _CNV_A_R_LINEAR_____302_CM 1 0. -3276.8 3276.7 ECU_ADDRESS 0xd0002d7a FORMAT "%6.1" /end MEASUREMENT
/begin CHARACTERISTIC Cxx_mis_km_dly "Minimum distance driven since torquemeter init to allow torque correction" VALUE 0xa0020a4a _REC_S1VAL_20_u4 4660337.5 _CNV_A_R_LINEAR_____428_CM 0. 4660337.5 FORMAT "%9.1" /end CHARACTERISTIC
/begin AXIS_PTS Ctb_dft_comb_eal "Table of engine air load breakpoins for misfire cartographies." 0xa0027448 Vxx_eal_tdc_2 _REC_A2AXS_20_u2 3.99993896484375 _CNV_A_R_LINEAR_____53_CM 17 0. 3.99993896484375 FORMAT "%7.5" /end AXIS_PTS
/begin AXIS_PTS Ctb_mis_n_17 "Table de 17 breakpoints de rÈgimes pour la stratÈgie misfire" 0xa002746c Vxx_n_tdc_2 _REC_A2AXS_20_u2 16383.75 _CNV_A_R_ENSD_LINEA_24_CM 17 0. 16383.75 FORMAT "%8.2" /end AXIS_PTS
/begin CHARACTERISTIC Cmp_det_thd_tlz_dif "Cartographie des delta de couple pour seuil de dÈtection misfire" MAP 0xa0027490 _REC_A1MAP_20_u2_u2_u2 6553.5 _CNV_A_R_LINEAR_____302_CM 0. 6553.5 FORMAT "%6.1"
 /begin AXIS_DESCR COM_AXIS Vxx_n_tdc_2 _CNV_A_R_ENSD_LINEA_24_CM 17 0. 16383.75 FORMAT "%8.2" AXIS_PTS_REF Ctb_mis_n_17 /end AXIS_DESCR
 /begin AXIS_DESCR COM_AXIS Vxx_eal_tdc_2 _CNV_A_R_LINEAR_____53_CM 17 0. 3.99993896484375 FORMAT "%7.5" AXIS_PTS_REF Ctb_dft_comb_eal /end AXIS_DESCR
/end CHARACTERISTIC
/begin CHARACTERISTIC Cmp_det_thd_tlz_dif_agb "Cartographie des delta de couple pour seuil de dÈtection misfire en BVA dÈpontÈ" MAP 0xa00276d4 _REC_A1MAP_20_u2_u2_u2 6553.5 _CNV_A_R_LINEAR_____302_CM 0. 6553.5 FORMAT "%6.1"
 /begin AXIS_DESCR COM_AXIS Vxx_n_tdc_2 _CNV_A_R_ENSD_LINEA_24_CM 17 0. 16383.75 FORMAT "%8.2" AXIS_PTS_REF Ctb_mis_n_17 /end AXIS_DESCR
 /begin AXIS_DESCR COM_AXIS Vxx_eal_tdc_2 _CNV_A_R_LINEAR_____53_CM 17 0. 3.99993896484375 FORMAT "%7.5" AXIS_PTS_REF Ctb_dft_comb_eal /end AXIS_DESCR
/end CHARACTERISTIC
/begin CHARACTERISTIC Cmp_det_thd_tlz_dif_lpg "Cartographie des delta de couple pour seuil de dÈtection misfire au Gaz" MAP 0xa0027918 _REC_A1MAP_20_u2_u2_u2 6553.5 _CNV_A_R_LINEAR_____302_CM 0. 6553.5 FORMAT "%6.1"
 /begin AXIS_DESCR COM_AXIS Vxx_n_tdc_2 _CNV_A_R_ENSD_LINEA_24_CM 17 0. 16383.75 FORMAT "%8.2" AXIS_PTS_REF Ctb_mis_n_17 /end AXIS_DESCR
 /begin AXIS_DESCR COM_AXIS Vxx_eal_tdc_2 _CNV_A_R_LINEAR_____53_CM 17 0. 3.99993896484375 FORMAT "%7.5" AXIS_PTS_REF Ctb_dft_comb_eal /end AXIS_DESCR
/end CHARACTERISTIC
/begin CHARACTERISTIC Ctp_tlz_fil_fac "Table des facteurs de filtrage du couple TLZ" CURVE 0xa0027b5c _REC_A1CUR_20_u1_u2 0.99609375 _CNV_A_R_LINEAR_____31_CM 0. 0.99609375 FORMAT "%10.8"
 /begin AXIS_DESCR COM_AXIS Vxx_eal_tdc_2 _CNV_A_R_LINEAR_____53_CM 17 0. 3.99993896484375 FORMAT "%7.5" AXIS_PTS_REF Ctb_dft_comb_eal /end AXIS_DESCR
/end CHARACTERISTIC
/begin CHARACTERISTIC Ctp_tlz_fil_fac_lpg "Table des facteurs de filtrage du couple TLZ  au Gaz" CURVE 0xa0027b70 _REC_A1CUR_20_u1_u2 0.99609375 _CNV_A_R_LINEAR_____31_CM 0. 0.99609375 FORMAT "%10.8"
 /begin AXIS_DESCR COM_AXIS Vxx_eal_tdc_2 _CNV_A_R_LINEAR_____53_CM 17 0. 3.99993896484375 FORMAT "%7.5" AXIS_PTS_REF Ctb_dft_comb_eal /end AXIS_DESCR
/end CHARACTERISTIC
/begin CHARACTERISTIC Ctp_tlz_fil_rst_eal_dif "Table de delta de masse d'air pour reset du filtre TLZ fonction de la pression au PMH(i-2)" CURVE 0xa0027b84 _REC_A1CUR_20_u2_u2 3.99993896484375 _CNV_A_R_LINEAR_____53_CM 0. 3.99993896484375 FORMAT "%7.5"
 /begin AXIS_DESCR COM_AXIS Vxx_eal_tdc_2 _CNV_A_R_LINEAR_____53_CM 17 0. 3.99993896484375 FORMAT "%7.5" AXIS_PTS_REF Ctb_dft_comb_eal /end AXIS_DESCR
/end CHARACTERISTIC
/begin MEASUREMENT Vbx_mis_fil_rst_eal_dif "DÈtection de delta de charge pur reset filtre TLZ (inhib diag misfire)" UBYTE _CNV_S_2_RANGE______3_CM 1 0. 0. 1. ECU_ADDRESS 0xd0004b1f BIT_MASK 0x1 /end MEASUREMENT
/begin MEASUREMENT Vbx_mis_fil_rst_eal_dif2 "DÈtection de delta de charge pur reset filtre TLZ i-2(inhib diag misfire)" UBYTE _CNV_S_2_RANGE______3_CM 1 0. 0. 1. ECU_ADDRESS 0xd0004b20 BIT_MASK 0x1 /end MEASUREMENT
/begin MEASUREMENT Vbx_mis_fil_rst_n_dif "DÈtection de delta rÈgime pour reset filtre TLZ (inhibition du diag misfire)" UBYTE _CNV_S_2_RANGE______3_CM 1 0. 0. 1. ECU_ADDRESS 0xd0004b21 BIT_MASK 0x1 /end MEASUREMENT
/begin MEASUREMENT Vbx_mis_fil_rst_n_dif2 "DÈtection de delta rÈgime pour reset filtre TLZ  i-2 (inhibition du diag misfire)" UBYTE _CNV_S_2_RANGE______3_CM 1 0. 0. 1. ECU_ADDRESS 0xd0004b22 BIT_MASK 0x1 /end MEASUREMENT
/begin MEASUREMENT Vbx_mis_stat_fil "Blocage du filtre TLZ" UBYTE _CNV_S_2_RANGE______3_CM 1 0. 0. 1. ECU_ADDRESS 0xd0004b23 BIT_MASK 0x1 /end MEASUREMENT
/begin MEASUREMENT Vbx_mis_stat_fil4 "Blocage du filtre TLZ au pmh i-4" UBYTE _CNV_S_2_RANGE______3_CM 1 0. 0. 1. ECU_ADDRESS 0xd0004b24 BIT_MASK 0x1 /end MEASUREMENT
/begin MEASUREMENT Vbx_mis_tlz_fil_rst "Reset du filtre TLZ (inhibition du diag misfire)" UBYTE _CNV_S_2_RANGE______3_CM 1 0. 0. 1. ECU_ADDRESS 0xd0004b25 BIT_MASK 0x1 /end MEASUREMENT
/begin MEASUREMENT Vsx_mis_tlz_vld "Ivld TLZ pour le misfire" UBYTE _CNV_S_2_STATUS_OK__214_CM 1 0. 0. 1. ECU_ADDRESS 0xd0004b26 /end MEASUREMENT
/begin MEASUREMENT Vxx_mis_tlz_dif "Delta de couple pour seuil de dÈtection misfire" UWORD _CNV_A_R_LINEAR_____302_CM 1 0. 0. 6553.5 ECU_ADDRESS 0xd0003a26 FORMAT "%6.1" /end MEASUREMENT
/begin MEASUREMENT Vxx_mis_tlz_fil_mes "Couple gaz filtrÈ au pmh" SWORD _CNV_A_R_LINEAR_____302_CM 1 0. -3276.8 3276.7 ECU_ADDRESS 0xd0003a28 FORMAT "%6.1" /end MEASUREMENT
/begin MEASUREMENT Vxx_mis_tlz_fil_mes1 "Couple gaz filtrÈ au pmh i-1" SWORD _CNV_A_R_LINEAR_____302_CM 1 0. -3276.8 3276.7 ECU_ADDRESS 0xd0003a2a FORMAT "%6.1" /end MEASUREMENT
/begin MEASUREMENT Vxx_mis_tlz_fil_mes2 "Couple gaz filtrÈ au pmh i-2" SWORD _CNV_A_R_LINEAR_____302_CM 1 0. -3276.8 3276.7 ECU_ADDRESS 0xd0003a2c FORMAT "%6.1" /end MEASUREMENT
/begin MEASUREMENT Vxx_mis_tlz_fil_mes3 "Couple gaz filtrÈ au pmh i-3" SWORD _CNV_A_R_LINEAR_____302_CM 1 0. -3276.8 3276.7 ECU_ADDRESS 0xd0003a2e FORMAT "%6.1" /end MEASUREMENT
/begin MEASUREMENT Vxx_mis_tlz_fil_mes4 "Couple gaz filtrÈ au pmh i-4" SWORD _CNV_A_R_LINEAR_____302_CM 1 0. -3276.8 3276.7 ECU_ADDRESS 0xd0003a30 FORMAT "%6.1" /end MEASUREMENT
/begin CHARACTERISTIC Cxx_tlz_fil_rat "Facteur de confiance pour le filtrage du couple TLZ" VALUE 0xa0021dc2 _REC_S1VAL_20_u1 0.99609375 _CNV_A_R_LINEAR_____31_CM 0. 0.99609375 FORMAT "%10.8" /end CHARACTERISTIC
/begin CHARACTERISTIC Cxx_tlz_fil_rat_lpg "Facteur de confiance pour le filtrage du couple TLZ au Gaz" VALUE 0xa0021dc3 _REC_S1VAL_20_u1 0.99609375 _CNV_A_R_LINEAR_____31_CM 0. 0.99609375 FORMAT "%10.8" /end CHARACTERISTIC
/begin CHARACTERISTIC Cxx_tlz_fil_rst_n_dif_thd "Seuil de delta de rÈgime pour reset du filtre TLZ" VALUE 0xa0021dc0 _REC_S1VAL_20_u2 16383.75 _CNV_A_R_ENSD_LINEA_24_CM 0. 16383.75 FORMAT "%8.2" /end CHARACTERISTIC
/begin MEASUREMENT Vbx_tq_rams_lim_spc_act_1 "Specific activation of safety torque limitation level 1 (low)" UBYTE _CNV_S_2_RANGE______3_CM 1 0. 0. 1. ECU_ADDRESS 0xd00050b5 BIT_MASK 0x1 /end MEASUREMENT
/begin MEASUREMENT Vbx_tq_rams_lim_spc_act_2 "Specific activation of safety torque limitation level 2 (mean)" UBYTE _CNV_S_2_RANGE______3_CM 1 0. 0. 1. ECU_ADDRESS 0xd00050b6 BIT_MASK 0x1 /end MEASUREMENT
/begin MEASUREMENT Vbx_tq_rams_lim_spc_act_3 "Specific activation of safety vehicule speed converted in torque limitation level 3 (strong)" UBYTE _CNV_S_2_RANGE______3_CM 1 0. 0. 1. ECU_ADDRESS 0xd00050b7 BIT_MASK 0x1 /end MEASUREMENT
/begin AXIS_PTS Ctb_cur_spd "Ctb_cur_spd" 0xa0025064 Vxx_n _REC_A2AXS_20_u2 16383.75 _CNV_R_R_VA_F_0v25__437_CM 8 0. 16383.75 FORMAT "%9.2" /end AXIS_PTS
/begin AXIS_PTS Ctb_down_shf_pdl "Ctb_down_shf_pdl" 0xa0024bb4 Vxx_free_shf_pdl _REC_A2AXS_20_u2 100. _CNV_R_R_VA_F_0v125_438_CM 11 0. 100. FORMAT "%9.2" /end AXIS_PTS
/begin AXIS_PTS Ctb_fast_off_pdl_grd "Ctb_fast_off_pdl_grd" 0xa002fcec Vxx_pdl_grd _REC_A2AXS_20_u2 4000. _CNV_R_R_VA_F_0v125_439_CM 5 -2000. 2000. FORMAT "%9.2" /end AXIS_PTS
/begin AXIS_PTS Ctb_law "Ctb_law" 0xa00208e6 Vsx_law_sel _REC_A2AXS_20_u1 4. _CNV_R_R_VA_F_1_p1__440_CM 5 1. 5. FORMAT "%9.2" /end AXIS_PTS
/begin AXIS_PTS Ctb_n_apmp "Ctb_n_apmp" 0xa002fd20 Vxx_n_gear _REC_A2AXS_20_u2 16383.75 _CNV_R_R_VA_F_0v25__441_CM 17 0. 16383.75 FORMAT "%9.2" /end AXIS_PTS
/begin AXIS_PTS Ctb_up_shf_pdl "Ctb_up_shf_pdl" 0xa0024bcc Vxx_free_shf_pdl _REC_A2AXS_20_u2 100. _CNV_R_R_VA_F_0v125_438_CM 11 0. 100. FORMAT "%9.2" /end AXIS_PTS
/begin CHARACTERISTIC Cmp_cur_tra_acel_thd "Cmp_cur_tra_acel_thd" MAP 0xa0025004 _REC_A1MAP_20_u2_u1_u2 13.5 _CNV_R_R_VA_F_0v000_442_CM 0. 13.5 FORMAT "%9.4"
 /begin AXIS_DESCR COM_AXIS NO_INPUT_QUANTITY _CNV_R_R_VA_F_1_p1__440_CM 6 1. 6. FORMAT "%9.2" AXIS_PTS_REF Ctb_gear_fs /end AXIS_DESCR
 /begin AXIS_DESCR COM_AXIS Vxx_n _CNV_R_R_VA_F_0v25__437_CM 8 0. 16383.75 FORMAT "%9.2" AXIS_PTS_REF Ctb_cur_spd /end AXIS_DESCR
/end CHARACTERISTIC
/begin CHARACTERISTIC Cmp_fast_off_law_pdl_grd_dly "Cmp_fast_off_law_pdl_grd_dly" MAP 0xa002fd04 _REC_A1MAP_20_u1_u1_u2 5.1 _CNV_R_R_VA_F_0v02__443_CM 0. 5.1 FORMAT "%9.2"
 /begin AXIS_DESCR COM_AXIS Vsx_law_sel _CNV_R_R_VA_F_1_p1__440_CM 5 1. 5. FORMAT "%9.2" AXIS_PTS_REF Ctb_law /end AXIS_DESCR
 /begin AXIS_DESCR COM_AXIS Vxx_pdl_grd _CNV_R_R_VA_F_0v125_439_CM 5 -2000. 2000. FORMAT "%9.2" AXIS_PTS_REF Ctb_fast_off_pdl_grd /end AXIS_DESCR
/end CHARACTERISTIC
/begin CHARACTERISTIC Ctp_apmp_max_pow "Ctp_apmp_max_pow" CURVE 0xa002fd50 _REC_A1CUR_20_u2_u2 655350. _CNV_R_R_VA_F_10_m3_444_CM -327680. 327670. FORMAT "%9.2"
 /begin AXIS_DESCR COM_AXIS Vxx_n_gear _CNV_R_R_VA_F_0v25__441_CM 17 0. 16383.75 FORMAT "%9.2" AXIS_PTS_REF Ctb_n_apmp /end AXIS_DESCR
/end CHARACTERISTIC
/begin CHARACTERISTIC Ctp_brk_ass_fac "Ctp_brk_ass_fac" CURVE 0xa0021d5a _REC_A1CUR_20_u1_u1 25.5 _CNV_R_R_VA_F_0v1_p_445_CM 0. 25.5 FORMAT "%9.2"
 /begin AXIS_DESCR COM_AXIS NO_INPUT_QUANTITY _CNV_R_R_VA_F_1_p1__440_CM 6 1. 6. FORMAT "%9.2" AXIS_PTS_REF Ctb_gear_fs /end AXIS_DESCR
/end CHARACTERISTIC
/begin CHARACTERISTIC Ctp_cur_dly "Ctp_cur_dly" CURVE 0xa0020a08 _REC_A1CUR_20_u1_u1 5.1 _CNV_R_R_VA_F_0v02__443_CM 0. 5.1 FORMAT "%9.2"
 /begin AXIS_DESCR COM_AXIS NO_INPUT_QUANTITY _CNV_R_R_VA_F_1_p1__440_CM 6 1. 6. FORMAT "%9.2" AXIS_PTS_REF Ctb_gear_fs /end AXIS_DESCR
/end CHARACTERISTIC
/begin CHARACTERISTIC Ctp_dhil_n_up_shf_in_thd "Ctp_dhil_n_up_shf_in_thd" CURVE 0xa0024be4 _REC_A1CUR_20_u2_u1 16383.75 _CNV_R_R_VA_F_0v25__441_CM 0. 16383.75 FORMAT "%9.2"
 /begin AXIS_DESCR COM_AXIS NO_INPUT_QUANTITY _CNV_R_R_VA_F_1_p1__440_CM 6 1. 6. FORMAT "%9.2" AXIS_PTS_REF Ctb_gear_fs /end AXIS_DESCR
/end CHARACTERISTIC
/begin CHARACTERISTIC Ctp_dhil_n_up_shf_out_thd "Ctp_dhil_n_up_shf_out_thd" CURVE 0xa0024bf0 _REC_A1CUR_20_u2_u1 16383.75 _CNV_R_R_VA_F_0v25__441_CM 0. 16383.75 FORMAT "%9.2"
 /begin AXIS_DESCR COM_AXIS NO_INPUT_QUANTITY _CNV_R_R_VA_F_1_p1__440_CM 6 1. 6. FORMAT "%9.2" AXIS_PTS_REF Ctb_gear_fs /end AXIS_DESCR
/end CHARACTERISTIC
/begin CHARACTERISTIC Ctp_dhil_vs_down_shf_thd "Ctp_dhil_vs_down_shf_thd" CURVE 0xa0024bfc _REC_A1CUR_20_u2_u1 655.35 _CNV_R_R_VA_F_0v01__446_CM 0. 655.35 FORMAT "%9.2"
 /begin AXIS_DESCR COM_AXIS NO_INPUT_QUANTITY _CNV_R_R_VA_F_1_p1__440_CM 6 1. 6. FORMAT "%9.2" AXIS_PTS_REF Ctb_gear_fs /end AXIS_DESCR
/end CHARACTERISTIC
/begin CHARACTERISTIC Ctp_fast_off_kd_n_thd "Ctp_fast_off_kd_n_thd" CURVE 0xa002fcf8 _REC_A1CUR_20_u2_u1 16383.75 _CNV_R_R_VA_F_0v25__441_CM 0. 16383.75 FORMAT "%9.2"
 /begin AXIS_DESCR COM_AXIS NO_INPUT_QUANTITY _CNV_R_R_VA_F_1_p1__440_CM 6 1. 6. FORMAT "%9.2" AXIS_PTS_REF Ctb_gear_fs /end AXIS_DESCR
/end CHARACTERISTIC
/begin CHARACTERISTIC Ctp_fast_off_no_pdl_dly "Ctp_fast_off_no_pdl_dly" CURVE 0xa00208ec _REC_A1CUR_20_u1_u1 5.1 _CNV_R_R_VA_F_0v02__443_CM 0. 5.1 FORMAT "%9.2"
 /begin AXIS_DESCR COM_AXIS NO_INPUT_QUANTITY _CNV_R_R_VA_F_1_p1__440_CM 6 1. 6. FORMAT "%9.2" AXIS_PTS_REF Ctb_gear_fs /end AXIS_DESCR
/end CHARACTERISTIC
/begin CHARACTERISTIC Ctp_gear_pdl_no_seq_dly "Ctp_gear_pdl_no_seq_dly" CURVE 0xa0021edc _REC_A1CUR_20_u1_u1 5.1 _CNV_R_R_VA_F_0v02__443_CM 0. 5.1 FORMAT "%9.2"
 /begin AXIS_DESCR COM_AXIS NO_INPUT_QUANTITY _CNV_R_R_VA_F_1_p1__440_CM 6 1. 6. FORMAT "%9.2" AXIS_PTS_REF Ctb_gear_fs /end AXIS_DESCR
/end CHARACTERISTIC
/begin CHARACTERISTIC Ctp_law_eco_1_2 "Ctp_law_eco_1_2" CURVE 0xa00247e8 _REC_A1CUR_20_u2_u2 655.35 _CNV_R_R_VA_F_0v01__446_CM 0. 655.35 FORMAT "%9.2"
 /begin AXIS_DESCR COM_AXIS Vxx_free_shf_pdl _CNV_R_R_VA_F_0v125_438_CM 11 0. 100. FORMAT "%9.2" AXIS_PTS_REF Ctb_up_shf_pdl /end AXIS_DESCR
/end CHARACTERISTIC
/begin CHARACTERISTIC Ctp_law_eco_2_1 "Ctp_law_eco_2_1" CURVE 0xa0024800 _REC_A1CUR_20_u2_u2 655.35 _CNV_R_R_VA_F_0v01__446_CM 0. 655.35 FORMAT "%9.2"
 /begin AXIS_DESCR COM_AXIS Vxx_free_shf_pdl _CNV_R_R_VA_F_0v125_438_CM 11 0. 100. FORMAT "%9.2" AXIS_PTS_REF Ctb_down_shf_pdl /end AXIS_DESCR
/end CHARACTERISTIC
/begin CHARACTERISTIC Ctp_law_eco_2_3 "Ctp_law_eco_2_3" CURVE 0xa0024818 _REC_A1CUR_20_u2_u2 655.35 _CNV_R_R_VA_F_0v01__446_CM 0. 655.35 FORMAT "%9.2"
 /begin AXIS_DESCR COM_AXIS Vxx_free_shf_pdl _CNV_R_R_VA_F_0v125_438_CM 11 0. 100. FORMAT "%9.2" AXIS_PTS_REF Ctb_up_shf_pdl /end AXIS_DESCR
/end CHARACTERISTIC
/begin CHARACTERISTIC Ctp_law_eco_3_2 "Ctp_law_eco_3_2" CURVE 0xa0024830 _REC_A1CUR_20_u2_u2 655.35 _CNV_R_R_VA_F_0v01__446_CM 0. 655.35 FORMAT "%9.2"
 /begin AXIS_DESCR COM_AXIS Vxx_free_shf_pdl _CNV_R_R_VA_F_0v125_438_CM 11 0. 100. FORMAT "%9.2" AXIS_PTS_REF Ctb_down_shf_pdl /end AXIS_DESCR
/end CHARACTERISTIC
/begin CHARACTERISTIC Ctp_law_eco_3_4 "Ctp_law_eco_3_4" CURVE 0xa0024848 _REC_A1CUR_20_u2_u2 655.35 _CNV_R_R_VA_F_0v01__446_CM 0. 655.35 FORMAT "%9.2"
 /begin AXIS_DESCR COM_AXIS Vxx_free_shf_pdl _CNV_R_R_VA_F_0v125_438_CM 11 0. 100. FORMAT "%9.2" AXIS_PTS_REF Ctb_up_shf_pdl /end AXIS_DESCR
/end CHARACTERISTIC
/begin CHARACTERISTIC Ctp_law_eco_4_3 "Ctp_law_eco_4_3" CURVE 0xa0024860 _REC_A1CUR_20_u2_u2 655.35 _CNV_R_R_VA_F_0v01__446_CM 0. 655.35 FORMAT "%9.2"
 /begin AXIS_DESCR COM_AXIS Vxx_free_shf_pdl _CNV_R_R_VA_F_0v125_438_CM 11 0. 100. FORMAT "%9.2" AXIS_PTS_REF Ctb_down_shf_pdl /end AXIS_DESCR
/end CHARACTERISTIC
/begin CHARACTERISTIC Ctp_law_eco_4_5 "Ctp_law_eco_4_5" CURVE 0xa0024878 _REC_A1CUR_20_u2_u2 655.35 _CNV_R_R_VA_F_0v01__446_CM 0. 655.35 FORMAT "%9.2"
 /begin AXIS_DESCR COM_AXIS Vxx_free_shf_pdl _CNV_R_R_VA_F_0v125_438_CM 11 0. 100. FORMAT "%9.2" AXIS_PTS_REF Ctb_up_shf_pdl /end AXIS_DESCR
/end CHARACTERISTIC
/begin CHARACTERISTIC Ctp_law_eco_5_4 "Ctp_law_eco_5_4" CURVE 0xa0024890 _REC_A1CUR_20_u2_u2 655.35 _CNV_R_R_VA_F_0v01__446_CM 0. 655.35 FORMAT "%9.2"
 /begin AXIS_DESCR COM_AXIS Vxx_free_shf_pdl _CNV_R_R_VA_F_0v125_438_CM 11 0. 100. FORMAT "%9.2" AXIS_PTS_REF Ctb_down_shf_pdl /end AXIS_DESCR
/end CHARACTERISTIC
/begin CHARACTERISTIC Ctp_law_eco_5_6 "Ctp_law_eco_5_6" CURVE 0xa00248a8 _REC_A1CUR_20_u2_u2 655.35 _CNV_R_R_VA_F_0v01__446_CM 0. 655.35 FORMAT "%9.2"
 /begin AXIS_DESCR COM_AXIS Vxx_free_shf_pdl _CNV_R_R_VA_F_0v125_438_CM 11 0. 100. FORMAT "%9.2" AXIS_PTS_REF Ctb_up_shf_pdl /end AXIS_DESCR
/end CHARACTERISTIC
/begin CHARACTERISTIC Ctp_law_eco_6_5 "Ctp_law_eco_6_5" CURVE 0xa00248c0 _REC_A1CUR_20_u2_u2 655.35 _CNV_R_R_VA_F_0v01__446_CM 0. 655.35 FORMAT "%9.2"
 /begin AXIS_DESCR COM_AXIS Vxx_free_shf_pdl _CNV_R_R_VA_F_0v125_438_CM 11 0. 100. FORMAT "%9.2" AXIS_PTS_REF Ctb_down_shf_pdl /end AXIS_DESCR
/end CHARACTERISTIC
/begin CHARACTERISTIC Ctp_law_uhil_1_2 "Ctp_law_uhil_1_2" CURVE 0xa00248d8 _REC_A1CUR_20_u2_u2 655.35 _CNV_R_R_VA_F_0v01__446_CM 0. 655.35 FORMAT "%9.2"
 /begin AXIS_DESCR COM_AXIS Vxx_free_shf_pdl _CNV_R_R_VA_F_0v125_438_CM 11 0. 100. FORMAT "%9.2" AXIS_PTS_REF Ctb_up_shf_pdl /end AXIS_DESCR
/end CHARACTERISTIC
/begin CHARACTERISTIC Ctp_law_uhil_2_1 "Ctp_law_uhil_2_1" CURVE 0xa00248f0 _REC_A1CUR_20_u2_u2 655.35 _CNV_R_R_VA_F_0v01__446_CM 0. 655.35 FORMAT "%9.2"
 /begin AXIS_DESCR COM_AXIS Vxx_free_shf_pdl _CNV_R_R_VA_F_0v125_438_CM 11 0. 100. FORMAT "%9.2" AXIS_PTS_REF Ctb_down_shf_pdl /end AXIS_DESCR
/end CHARACTERISTIC
/begin CHARACTERISTIC Ctp_law_uhil_2_3 "Ctp_law_uhil_2_3" CURVE 0xa0024908 _REC_A1CUR_20_u2_u2 655.35 _CNV_R_R_VA_F_0v01__446_CM 0. 655.35 FORMAT "%9.2"
 /begin AXIS_DESCR COM_AXIS Vxx_free_shf_pdl _CNV_R_R_VA_F_0v125_438_CM 11 0. 100. FORMAT "%9.2" AXIS_PTS_REF Ctb_up_shf_pdl /end AXIS_DESCR
/end CHARACTERISTIC
/begin CHARACTERISTIC Ctp_law_uhil_3_2 "Ctp_law_uhil_3_2" CURVE 0xa0024920 _REC_A1CUR_20_u2_u2 655.35 _CNV_R_R_VA_F_0v01__446_CM 0. 655.35 FORMAT "%9.2"
 /begin AXIS_DESCR COM_AXIS Vxx_free_shf_pdl _CNV_R_R_VA_F_0v125_438_CM 11 0. 100. FORMAT "%9.2" AXIS_PTS_REF Ctb_down_shf_pdl /end AXIS_DESCR
/end CHARACTERISTIC
/begin CHARACTERISTIC Ctp_law_uhil_3_4 "Ctp_law_uhil_3_4" CURVE 0xa0024938 _REC_A1CUR_20_u2_u2 655.35 _CNV_R_R_VA_F_0v01__446_CM 0. 655.35 FORMAT "%9.2"
 /begin AXIS_DESCR COM_AXIS Vxx_free_shf_pdl _CNV_R_R_VA_F_0v125_438_CM 11 0. 100. FORMAT "%9.2" AXIS_PTS_REF Ctb_up_shf_pdl /end AXIS_DESCR
/end CHARACTERISTIC
/begin CHARACTERISTIC Ctp_law_uhil_4_3 "Ctp_law_uhil_4_3" CURVE 0xa0024950 _REC_A1CUR_20_u2_u2 655.35 _CNV_R_R_VA_F_0v01__446_CM 0. 655.35 FORMAT "%9.2"
 /begin AXIS_DESCR COM_AXIS Vxx_free_shf_pdl _CNV_R_R_VA_F_0v125_438_CM 11 0. 100. FORMAT "%9.2" AXIS_PTS_REF Ctb_down_shf_pdl /end AXIS_DESCR
/end CHARACTERISTIC
/begin CHARACTERISTIC Ctp_law_uhil_4_5 "Ctp_law_uhil_4_5" CURVE 0xa0024968 _REC_A1CUR_20_u2_u2 655.35 _CNV_R_R_VA_F_0v01__446_CM 0. 655.35 FORMAT "%9.2"
 /begin AXIS_DESCR COM_AXIS Vxx_free_shf_pdl _CNV_R_R_VA_F_0v125_438_CM 11 0. 100. FORMAT "%9.2" AXIS_PTS_REF Ctb_up_shf_pdl /end AXIS_DESCR
/end CHARACTERISTIC
/begin CHARACTERISTIC Ctp_law_uhil_5_4 "Ctp_law_uhil_5_4" CURVE 0xa0024980 _REC_A1CUR_20_u2_u2 655.35 _CNV_R_R_VA_F_0v01__446_CM 0. 655.35 FORMAT "%9.2"
 /begin AXIS_DESCR COM_AXIS Vxx_free_shf_pdl _CNV_R_R_VA_F_0v125_438_CM 11 0. 100. FORMAT "%9.2" AXIS_PTS_REF Ctb_down_shf_pdl /end AXIS_DESCR
/end CHARACTERISTIC
/begin CHARACTERISTIC Ctp_law_uhil_5_6 "Ctp_law_uhil_5_6" CURVE 0xa0024998 _REC_A1CUR_20_u2_u2 655.35 _CNV_R_R_VA_F_0v01__446_CM 0. 655.35 FORMAT "%9.2"
 /begin AXIS_DESCR COM_AXIS Vxx_free_shf_pdl _CNV_R_R_VA_F_0v125_438_CM 11 0. 100. FORMAT "%9.2" AXIS_PTS_REF Ctb_up_shf_pdl /end AXIS_DESCR
/end CHARACTERISTIC
/begin CHARACTERISTIC Ctp_law_uhil_6_5 "Ctp_law_uhil_6_5" CURVE 0xa00249b0 _REC_A1CUR_20_u2_u2 655.35 _CNV_R_R_VA_F_0v01__446_CM 0. 655.35 FORMAT "%9.2"
 /begin AXIS_DESCR COM_AXIS Vxx_free_shf_pdl _CNV_R_R_VA_F_0v125_438_CM 11 0. 100. FORMAT "%9.2" AXIS_PTS_REF Ctb_down_shf_pdl /end AXIS_DESCR
/end CHARACTERISTIC
/begin CHARACTERISTIC Ctp_law_wup_cata_1_2 "Ctp_law_wup_cata_1_2" CURVE 0xa00249c8 _REC_A1CUR_20_u2_u2 655.35 _CNV_R_R_VA_F_0v01__446_CM 0. 655.35 FORMAT "%9.2"
 /begin AXIS_DESCR COM_AXIS Vxx_free_shf_pdl _CNV_R_R_VA_F_0v125_438_CM 11 0. 100. FORMAT "%9.2" AXIS_PTS_REF Ctb_up_shf_pdl /end AXIS_DESCR
/end CHARACTERISTIC
/begin CHARACTERISTIC Ctp_law_wup_cata_2_1 "Ctp_law_wup_cata_2_1" CURVE 0xa00249e0 _REC_A1CUR_20_u2_u2 655.35 _CNV_R_R_VA_F_0v01__446_CM 0. 655.35 FORMAT "%9.2"
 /begin AXIS_DESCR COM_AXIS Vxx_free_shf_pdl _CNV_R_R_VA_F_0v125_438_CM 11 0. 100. FORMAT "%9.2" AXIS_PTS_REF Ctb_down_shf_pdl /end AXIS_DESCR
/end CHARACTERISTIC
/begin CHARACTERISTIC Ctp_law_wup_cata_2_3 "Ctp_law_wup_cata_2_3" CURVE 0xa00249f8 _REC_A1CUR_20_u2_u2 655.35 _CNV_R_R_VA_F_0v01__446_CM 0. 655.35 FORMAT "%9.2"
 /begin AXIS_DESCR COM_AXIS Vxx_free_shf_pdl _CNV_R_R_VA_F_0v125_438_CM 11 0. 100. FORMAT "%9.2" AXIS_PTS_REF Ctb_up_shf_pdl /end AXIS_DESCR
/end CHARACTERISTIC
/begin CHARACTERISTIC Ctp_law_wup_cata_3_2 "Ctp_law_wup_cata_3_2" CURVE 0xa0024a10 _REC_A1CUR_20_u2_u2 655.35 _CNV_R_R_VA_F_0v01__446_CM 0. 655.35 FORMAT "%9.2"
 /begin AXIS_DESCR COM_AXIS Vxx_free_shf_pdl _CNV_R_R_VA_F_0v125_438_CM 11 0. 100. FORMAT "%9.2" AXIS_PTS_REF Ctb_down_shf_pdl /end AXIS_DESCR
/end CHARACTERISTIC
/begin CHARACTERISTIC Ctp_law_wup_cata_3_4 "Ctp_law_wup_cata_3_4" CURVE 0xa0024a28 _REC_A1CUR_20_u2_u2 655.35 _CNV_R_R_VA_F_0v01__446_CM 0. 655.35 FORMAT "%9.2"
 /begin AXIS_DESCR COM_AXIS Vxx_free_shf_pdl _CNV_R_R_VA_F_0v125_438_CM 11 0. 100. FORMAT "%9.2" AXIS_PTS_REF Ctb_up_shf_pdl /end AXIS_DESCR
/end CHARACTERISTIC
/begin CHARACTERISTIC Ctp_law_wup_cata_4_3 "Ctp_law_wup_cata_4_3" CURVE 0xa0024a40 _REC_A1CUR_20_u2_u2 655.35 _CNV_R_R_VA_F_0v01__446_CM 0. 655.35 FORMAT "%9.2"
 /begin AXIS_DESCR COM_AXIS Vxx_free_shf_pdl _CNV_R_R_VA_F_0v125_438_CM 11 0. 100. FORMAT "%9.2" AXIS_PTS_REF Ctb_down_shf_pdl /end AXIS_DESCR
/end CHARACTERISTIC
/begin CHARACTERISTIC Ctp_law_wup_cata_4_5 "Ctp_law_wup_cata_4_5" CURVE 0xa0024a58 _REC_A1CUR_20_u2_u2 655.35 _CNV_R_R_VA_F_0v01__446_CM 0. 655.35 FORMAT "%9.2"
 /begin AXIS_DESCR COM_AXIS Vxx_free_shf_pdl _CNV_R_R_VA_F_0v125_438_CM 11 0. 100. FORMAT "%9.2" AXIS_PTS_REF Ctb_up_shf_pdl /end AXIS_DESCR
/end CHARACTERISTIC
/begin CHARACTERISTIC Ctp_law_wup_cata_5_4 "Ctp_law_wup_cata_5_4" CURVE 0xa0024a70 _REC_A1CUR_20_u2_u2 655.35 _CNV_R_R_VA_F_0v01__446_CM 0. 655.35 FORMAT "%9.2"
 /begin AXIS_DESCR COM_AXIS Vxx_free_shf_pdl _CNV_R_R_VA_F_0v125_438_CM 11 0. 100. FORMAT "%9.2" AXIS_PTS_REF Ctb_down_shf_pdl /end AXIS_DESCR
/end CHARACTERISTIC
/begin CHARACTERISTIC Ctp_law_wup_cata_5_6 "Ctp_law_wup_cata_5_6" CURVE 0xa0024a88 _REC_A1CUR_20_u2_u2 655.35 _CNV_R_R_VA_F_0v01__446_CM 0. 655.35 FORMAT "%9.2"
 /begin AXIS_DESCR COM_AXIS Vxx_free_shf_pdl _CNV_R_R_VA_F_0v125_438_CM 11 0. 100. FORMAT "%9.2" AXIS_PTS_REF Ctb_up_shf_pdl /end AXIS_DESCR
/end CHARACTERISTIC
/begin CHARACTERISTIC Ctp_law_wup_cata_6_5 "Ctp_law_wup_cata_6_5" CURVE 0xa0024aa0 _REC_A1CUR_20_u2_u2 655.35 _CNV_R_R_VA_F_0v01__446_CM 0. 655.35 FORMAT "%9.2"
 /begin AXIS_DESCR COM_AXIS Vxx_free_shf_pdl _CNV_R_R_VA_F_0v125_438_CM 11 0. 100. FORMAT "%9.2" AXIS_PTS_REF Ctb_down_shf_pdl /end AXIS_DESCR
/end CHARACTERISTIC
/begin CHARACTERISTIC Ctp_law_xurb_1_2 "Ctp_law_xurb_1_2" CURVE 0xa0024ab8 _REC_A1CUR_20_u2_u2 655.35 _CNV_R_R_VA_F_0v01__446_CM 0. 655.35 FORMAT "%9.2"
 /begin AXIS_DESCR COM_AXIS Vxx_free_shf_pdl _CNV_R_R_VA_F_0v125_438_CM 11 0. 100. FORMAT "%9.2" AXIS_PTS_REF Ctb_up_shf_pdl /end AXIS_DESCR
/end CHARACTERISTIC
/begin CHARACTERISTIC Ctp_law_xurb_2_1 "Ctp_law_xurb_2_1" CURVE 0xa0024ad0 _REC_A1CUR_20_u2_u2 655.35 _CNV_R_R_VA_F_0v01__446_CM 0. 655.35 FORMAT "%9.2"
 /begin AXIS_DESCR COM_AXIS Vxx_free_shf_pdl _CNV_R_R_VA_F_0v125_438_CM 11 0. 100. FORMAT "%9.2" AXIS_PTS_REF Ctb_down_shf_pdl /end AXIS_DESCR
/end CHARACTERISTIC
/begin CHARACTERISTIC Ctp_law_xurb_2_3 "Ctp_law_xurb_2_3" CURVE 0xa0024ae8 _REC_A1CUR_20_u2_u2 655.35 _CNV_R_R_VA_F_0v01__446_CM 0. 655.35 FORMAT "%9.2"
 /begin AXIS_DESCR COM_AXIS Vxx_free_shf_pdl _CNV_R_R_VA_F_0v125_438_CM 11 0. 100. FORMAT "%9.2" AXIS_PTS_REF Ctb_up_shf_pdl /end AXIS_DESCR
/end CHARACTERISTIC
/begin CHARACTERISTIC Ctp_law_xurb_3_2 "Ctp_law_xurb_3_2" CURVE 0xa0024b00 _REC_A1CUR_20_u2_u2 655.35 _CNV_R_R_VA_F_0v01__446_CM 0. 655.35 FORMAT "%9.2"
 /begin AXIS_DESCR COM_AXIS Vxx_free_shf_pdl _CNV_R_R_VA_F_0v125_438_CM 11 0. 100. FORMAT "%9.2" AXIS_PTS_REF Ctb_down_shf_pdl /end AXIS_DESCR
/end CHARACTERISTIC
/begin CHARACTERISTIC Ctp_law_xurb_3_4 "Ctp_law_xurb_3_4" CURVE 0xa0024b18 _REC_A1CUR_20_u2_u2 655.35 _CNV_R_R_VA_F_0v01__446_CM 0. 655.35 FORMAT "%9.2"
 /begin AXIS_DESCR COM_AXIS Vxx_free_shf_pdl _CNV_R_R_VA_F_0v125_438_CM 11 0. 100. FORMAT "%9.2" AXIS_PTS_REF Ctb_up_shf_pdl /end AXIS_DESCR
/end CHARACTERISTIC
/begin CHARACTERISTIC Ctp_law_xurb_4_3 "Ctp_law_xurb_4_3" CURVE 0xa0024b30 _REC_A1CUR_20_u2_u2 655.35 _CNV_R_R_VA_F_0v01__446_CM 0. 655.35 FORMAT "%9.2"
 /begin AXIS_DESCR COM_AXIS Vxx_free_shf_pdl _CNV_R_R_VA_F_0v125_438_CM 11 0. 100. FORMAT "%9.2" AXIS_PTS_REF Ctb_down_shf_pdl /end AXIS_DESCR
/end CHARACTERISTIC
/begin CHARACTERISTIC Ctp_law_xurb_4_5 "Ctp_law_xurb_4_5" CURVE 0xa0024b48 _REC_A1CUR_20_u2_u2 655.35 _CNV_R_R_VA_F_0v01__446_CM 0. 655.35 FORMAT "%9.2"
 /begin AXIS_DESCR COM_AXIS Vxx_free_shf_pdl _CNV_R_R_VA_F_0v125_438_CM 11 0. 100. FORMAT "%9.2" AXIS_PTS_REF Ctb_up_shf_pdl /end AXIS_DESCR
/end CHARACTERISTIC
/begin CHARACTERISTIC Ctp_law_xurb_5_4 "Ctp_law_xurb_5_4" CURVE 0xa0024b60 _REC_A1CUR_20_u2_u2 655.35 _CNV_R_R_VA_F_0v01__446_CM 0. 655.35 FORMAT "%9.2"
 /begin AXIS_DESCR COM_AXIS Vxx_free_shf_pdl _CNV_R_R_VA_F_0v125_438_CM 11 0. 100. FORMAT "%9.2" AXIS_PTS_REF Ctb_down_shf_pdl /end AXIS_DESCR
/end CHARACTERISTIC
/begin CHARACTERISTIC Ctp_law_xurb_5_6 "Ctp_law_xurb_5_6" CURVE 0xa0024b78 _REC_A1CUR_20_u2_u2 655.35 _CNV_R_R_VA_F_0v01__446_CM 0. 655.35 FORMAT "%9.2"
 /begin AXIS_DESCR COM_AXIS Vxx_free_shf_pdl _CNV_R_R_VA_F_0v125_438_CM 11 0. 100. FORMAT "%9.2" AXIS_PTS_REF Ctb_up_shf_pdl /end AXIS_DESCR
/end CHARACTERISTIC
/begin CHARACTERISTIC Ctp_law_xurb_6_5 "Ctp_law_xurb_6_5" CURVE 0xa0024b90 _REC_A1CUR_20_u2_u2 655.35 _CNV_R_R_VA_F_0v01__446_CM 0. 655.35 FORMAT "%9.2"
 /begin AXIS_DESCR COM_AXIS Vxx_free_shf_pdl _CNV_R_R_VA_F_0v125_438_CM 11 0. 100. FORMAT "%9.2" AXIS_PTS_REF Ctb_down_shf_pdl /end AXIS_DESCR
/end CHARACTERISTIC
/begin CHARACTERISTIC Ctp_min_vs_decl "Ctp_min_vs_decl" CURVE 0xa0024c08 _REC_A1CUR_20_s2_u1 510. _CNV_R_R_VA_F_0v01__446_CM -255. 255. FORMAT "%9.2"
 /begin AXIS_DESCR COM_AXIS NO_INPUT_QUANTITY _CNV_R_R_VA_F_1_p1__440_CM 6 1. 6. FORMAT "%9.2" AXIS_PTS_REF Ctb_gear_fs /end AXIS_DESCR
/end CHARACTERISTIC
/begin CHARACTERISTIC Ctp_n_lim_apmp_down_shf "Table of engine speed beyond a downshift can't be forced" CURVE 0xa002fd44 _REC_A1CUR_20_u2_u1 16383.75 _CNV_R_R_VA_F_0v25__437_CM 0. 16383.75 FORMAT "%9.2"
 /begin AXIS_DESCR COM_AXIS NO_INPUT_QUANTITY _CNV_R_R_VA_F_1_p1__440_CM 6 1. 6. FORMAT "%9.2" AXIS_PTS_REF Ctb_gear_fs /end AXIS_DESCR
/end CHARACTERISTIC
/begin CHARACTERISTIC Ctp_pdl_cru_max_lim "Ctp_pdl_cru_max_lim" CURVE 0xa002b028 _REC_A1CUR_20_u2_u1 100. _CNV_R_R_VA_F_0v125_438_CM 0. 100. FORMAT "%9.2"
 /begin AXIS_DESCR COM_AXIS NO_INPUT_QUANTITY _CNV_R_R_VA_F_1_p1__440_CM 6 1. 6. FORMAT "%9.2" AXIS_PTS_REF Ctb_gear_fs /end AXIS_DESCR
/end CHARACTERISTIC
/begin CHARACTERISTIC Ctp_sta_dspl_arw_up_dly "Ctp_sta_dspl_arw_up_dly" CURVE 0xa00217aa _REC_A1CUR_20_u1_u1 5.1 _CNV_R_R_VA_F_0v02__443_CM 0. 5.1 FORMAT "%9.2"
 /begin AXIS_DESCR COM_AXIS NO_INPUT_QUANTITY _CNV_R_R_VA_F_1_p1__440_CM 6 1. 6. FORMAT "%9.2" AXIS_PTS_REF Ctb_gear_fs /end AXIS_DESCR
/end CHARACTERISTIC
/begin CHARACTERISTIC Ctp_v1000 "Ctp_v1000" CURVE 0xa0024ba8 _REC_A1CUR_20_u2_u1 200. _CNV_R_R_VA_F_0v01__447_CM 0. 200. FORMAT "%9.2"
 /begin AXIS_DESCR COM_AXIS NO_INPUT_QUANTITY _CNV_R_R_VA_F_1_p1__440_CM 6 1. 6. FORMAT "%9.2" AXIS_PTS_REF Ctb_gear_fs /end AXIS_DESCR
/end CHARACTERISTIC
/begin MEASUREMENT Vbx_apmp_down_shf "Vbx_apmp_down_shf" UBYTE _CNV_S_2_VA_Bool_ON_448_CM 1 0. 0. 1. ECU_ADDRESS 0xd0003f3c BIT_MASK 0x1 /end MEASUREMENT
/begin MEASUREMENT Vbx_apmp_up_shf "Vbx_apmp_up_shf" UBYTE _CNV_S_2_VA_Bool_ON_448_CM 1 0. 0. 1. ECU_ADDRESS 0xd0003f3d BIT_MASK 0x1 /end MEASUREMENT
/begin MEASUREMENT Vbx_arw_down "Vbx_arw_down" UBYTE _CNV_S_2_VA_Bool_ON_448_CM 1 0. 0. 1. ECU_ADDRESS 0xd0005256 BIT_MASK 0x1 /end MEASUREMENT
/begin MEASUREMENT Vbx_arw_down_raw "Vbx_arw_down_raw" UBYTE _CNV_S_2_VA_Bool_ON_448_CM 1 0. 0. 1. ECU_ADDRESS 0xd0005257 BIT_MASK 0x1 /end MEASUREMENT
/begin MEASUREMENT Vbx_arw_up "Vbx_arw_up" UBYTE _CNV_S_2_VA_Bool_ON_448_CM 1 0. 0. 1. ECU_ADDRESS 0xd0005259 BIT_MASK 0x1 /end MEASUREMENT
/begin MEASUREMENT Vbx_arw_up_raw "Vbx_arw_up_raw" UBYTE _CNV_S_2_VA_Bool_ON_448_CM 1 0. 0. 1. ECU_ADDRESS 0xd000525a BIT_MASK 0x1 /end MEASUREMENT
/begin MEASUREMENT Vbx_dly_ini "Vbx_dly_ini" UBYTE _CNV_S_2_VA_Bool_ON_448_CM 1 0. 0. 1. ECU_ADDRESS 0xd0004c10 BIT_MASK 0x1 /end MEASUREMENT
/begin MEASUREMENT Vbx_forc_gear_1 "Vbx_forc_gear_1" UBYTE _CNV_S_2_VA_Bool_ON_448_CM 1 0. 0. 1. ECU_ADDRESS 0xd0004ae7 BIT_MASK 0x1 /end MEASUREMENT
/begin MEASUREMENT Vbx_free_shf_dft "Vbx_free_shf_dft" UBYTE _CNV_S_2_VA_Bool_ON_448_CM 1 0. 0. 1. ECU_ADDRESS 0xd0004204 BIT_MASK 0x1 /end MEASUREMENT
/begin MEASUREMENT Vbx_free_shf_dsb "Vbx_free_shf_dsb" UBYTE _CNV_S_2_VA_Bool_ON_448_CM 1 0. 0. 1. ECU_ADDRESS 0xd0004dbe BIT_MASK 0x1 /end MEASUREMENT
/begin MEASUREMENT Vbx_out_tco "Vbx_out_tco" UBYTE _CNV_S_2_VA_Bool_ON_448_CM 1 0. 0. 1. ECU_ADDRESS 0xd000579a BIT_MASK 0x1 /end MEASUREMENT
/begin MEASUREMENT Vbx_sta_tco_ena "Vbx_sta_tco_ena" UBYTE _CNV_S_2_VA_Bool_ON_448_CM 1 0. 0. 1. ECU_ADDRESS 0xd000579b BIT_MASK 0x1 /end MEASUREMENT
/begin MEASUREMENT Vbx_up_shf_blk_cur "Vbx_up_shf_blk_cur" UBYTE _CNV_S_2_VA_Bool_ON_448_CM 1 0. 0. 1. ECU_ADDRESS 0xd0004dc1 BIT_MASK 0x1 /end MEASUREMENT
/begin MEASUREMENT Vbx_wup_cata_dsb "Vbx_wup_cata_dsb" UBYTE _CNV_S_2_VA_Bool_ON_448_CM 1 0. 0. 1. ECU_ADDRESS 0xd000579c BIT_MASK 0x1 /end MEASUREMENT
/begin MEASUREMENT Vbx_wup_cata_ena "Vbx_wup_cata_ena" UBYTE _CNV_S_2_VA_Bool_ON_448_CM 1 0. 0. 1. ECU_ADDRESS 0xd0004ae0 BIT_MASK 0x1 /end MEASUREMENT
/begin MEASUREMENT Vsx_apmp_free_shf_mod "Vsx_apmp_free_shf_mod" UBYTE _CNV_R_R_VA_I_16_449_CM 1 0. 0. 255. ECU_ADDRESS 0xd0004424 FORMAT "%9.2" /end MEASUREMENT
/begin MEASUREMENT Vsx_fast_off_free_shf_mod "Vsx_fast_off_free_shf_mod" UBYTE _CNV_R_R_VA_I_16_449_CM 1 0. 0. 255. ECU_ADDRESS 0xd0004d6e FORMAT "%9.2" /end MEASUREMENT
/begin MEASUREMENT Vsx_fast_on_free_shf_mod "Vsx_fast_on_free_shf_mod" UBYTE _CNV_R_R_VA_I_16_449_CM 1 0. 0. 255. ECU_ADDRESS 0xd000423e FORMAT "%9.2" /end MEASUREMENT
/begin MEASUREMENT Vsx_free_shf_dspl "Vsx_free_shf_dspl" UBYTE _CNV_R_R_VA_I_16_449_CM 1 0. 0. 255. ECU_ADDRESS 0xd000434f FORMAT "%9.2" /end MEASUREMENT
/begin MEASUREMENT Vsx_frz_free_shf_mod "Vsx_frz_free_shf_mod" UBYTE _CNV_R_R_VA_I_16_449_CM 1 0. 0. 255. ECU_ADDRESS 0xd0004203 FORMAT "%9.2" /end MEASUREMENT
/begin MEASUREMENT Vsx_law_free_shf_mod "Vsx_law_free_shf_mod" UBYTE _CNV_R_R_VA_I_16_449_CM 1 0. 0. 255. ECU_ADDRESS 0xd0004ae8 FORMAT "%9.2" /end MEASUREMENT
/begin MEASUREMENT Vsx_law_sel "Vsx_law_sel" UBYTE _CNV_R_R_VA_I_16_449_CM 1 0. 0. 255. ECU_ADDRESS 0xd0004ae1 FORMAT "%9.2" /end MEASUREMENT
/begin MEASUREMENT Vsx_load_lvl "Vsx_load_lvl" UBYTE _CNV_R_R_VA_I_16_449_CM 1 0. 0. 255. ECU_ADDRESS 0xd0004ae2 FORMAT "%9.2" /end MEASUREMENT
/begin MEASUREMENT Vsx_no_seq_free_shf_mod "Vsx_no_seq_free_shf_mod" UBYTE _CNV_R_R_VA_I_16_449_CM 1 0. 0. 255. ECU_ADDRESS 0xd0004c0a FORMAT "%9.2" /end MEASUREMENT
/begin MEASUREMENT Vsx_road_typ "Vsx_road_typ" UBYTE _CNV_R_R_VA_I_16_449_CM 1 0. 0. 255. ECU_ADDRESS 0xd0004ae3 FORMAT "%9.2" /end MEASUREMENT
/begin MEASUREMENT Vsx_stt_dhil "Vsx_stt_dhil" UBYTE _CNV_R_R_VA_I_16_449_CM 1 0. 0. 255. ECU_ADDRESS 0xd0004aec FORMAT "%9.2" /end MEASUREMENT
/begin MEASUREMENT Vsx_stt_dly "Vsx_stt_dly" UBYTE _CNV_R_R_VA_I_16_449_CM 1 0. 0. 255. ECU_ADDRESS 0xd0004c07 FORMAT "%9.2" /end MEASUREMENT
/begin MEASUREMENT Vsx_stt_fast_off "Vsx_stt_fast_off" UBYTE _CNV_R_R_VA_I_16_449_CM 1 0. 0. 255. ECU_ADDRESS 0xd00056e2 FORMAT "%9.2" /end MEASUREMENT
/begin MEASUREMENT Vsx_stt_fast_on "Vsx_stt_fast_on" UBYTE _CNV_R_R_VA_I_16_449_CM 1 0. 0. 255. ECU_ADDRESS 0xd000423f FORMAT "%9.2" /end MEASUREMENT
/begin MEASUREMENT Vxx_ant_vs "Vxx_ant_vs" UWORD _CNV_R_R_VA_F_0v01__446_CM 1 0. 0. 655.35 ECU_ADDRESS 0xd0003702 FORMAT "%9.2" /end MEASUREMENT
/begin MEASUREMENT Vxx_apmp_gear "Vxx_apmp_gear" UBYTE _CNV_R_R_VA_F_1_p2__450_CM 1 0. 2. 257. ECU_ADDRESS 0xd0003f3f FORMAT "%9.2" /end MEASUREMENT
/begin MEASUREMENT Vxx_apmp_gear_sel "Vxx_apmp_gear_sel" UBYTE _CNV_R_R_VA_F_1_p1__440_CM 1 0. 1. 256. ECU_ADDRESS 0xd0004425 FORMAT "%9.2" /end MEASUREMENT
/begin MEASUREMENT Vxx_ctr_dspl_up "Vxx_ctr_dspl_up" UBYTE _CNV_R_R_VA_I_16_449_CM 1 0. 0. 255. ECU_ADDRESS 0xd000524f FORMAT "%9.2" /end MEASUREMENT
/begin MEASUREMENT Vxx_cur_dly "Vxx_cur_dly" UBYTE _CNV_R_R_VA_F_0v02__443_CM 1 0. 0. 5.1 ECU_ADDRESS 0xd0004dc3 FORMAT "%9.2" /end MEASUREMENT
/begin MEASUREMENT Vxx_cur_tra_acel_thd "Vxx_cur_tra_acel_thd" UWORD _CNV_R_R_VA_F_0v000_442_CM 1 0. 0. 26.214 ECU_ADDRESS 0xd0003736 FORMAT "%9.4" /end MEASUREMENT
/begin MEASUREMENT Vxx_dhil_gear_sel "Vxx_dhil_gear_sel" UBYTE _CNV_R_R_VA_F_1_p1__440_CM 1 0. 1. 256. ECU_ADDRESS 0xd0004aed FORMAT "%9.2" /end MEASUREMENT
/begin MEASUREMENT Vxx_dhil_n_up_shf_in_thd "Vxx_dhil_n_up_shf_in_thd" UWORD _CNV_R_R_VA_F_0v25__441_CM 1 0. 0. 16383.75 ECU_ADDRESS 0xd0003704 FORMAT "%9.2" /end MEASUREMENT
/begin MEASUREMENT Vxx_dhil_n_up_shf_out_thd "Vxx_dhil_n_up_shf_out_thd" UWORD _CNV_R_R_VA_F_0v25__441_CM 1 0. 0. 16383.75 ECU_ADDRESS 0xd0003706 FORMAT "%9.2" /end MEASUREMENT
/begin MEASUREMENT Vxx_dhil_vs_down_shf_thd "Vxx_dhil_vs_down_shf_thd" UWORD _CNV_R_R_VA_F_0v01__446_CM 1 0. 0. 655.35 ECU_ADDRESS 0xd0003708 FORMAT "%9.2" /end MEASUREMENT
/begin MEASUREMENT Vxx_dly_driv_pwt_sp_100 "Vxx_dly_driv_pwt_sp_100" UWORD _CNV_R_R_VA_F_0v125_451_CM 1 0. 0. 8191.875 ECU_ADDRESS 0xd0003148 FORMAT "%9.2" /end MEASUREMENT
/begin MEASUREMENT Vxx_dly_frz_gear_sel "Vxx_dly_frz_gear_sel" UBYTE _CNV_R_R_VA_F_1_m1__452_CM 1 0. -1. 254. ECU_ADDRESS 0xd00056e3 FORMAT "%9.2" /end MEASUREMENT
/begin MEASUREMENT Vxx_dly_gear_sel "Vxx_dly_gear_sel" UBYTE _CNV_R_R_VA_F_1_p1__440_CM 1 0. 1. 256. ECU_ADDRESS 0xd0004240 FORMAT "%9.2" /end MEASUREMENT
/begin MEASUREMENT Vxx_driv_pwt_sp_100 "Vxx_driv_pwt_sp_100" UWORD _CNV_R_R_VA_F_0v125_451_CM 1 0. 0. 8191.875 ECU_ADDRESS 0xd000314c FORMAT "%9.2" /end MEASUREMENT
/begin MEASUREMENT Vxx_fast_off_dly "Vxx_fast_off_dly" UBYTE _CNV_R_R_VA_F_0v02__443_CM 1 0. 0. 5.1 ECU_ADDRESS 0xd00056e4 FORMAT "%9.2" /end MEASUREMENT
/begin MEASUREMENT Vxx_fast_off_gear_sel "Vxx_fast_off_gear_sel" UBYTE _CNV_R_R_VA_F_1_m1__452_CM 1 0. -1. 254. ECU_ADDRESS 0xd0004d6f FORMAT "%9.2" /end MEASUREMENT
/begin MEASUREMENT Vxx_fast_off_gear_sel_bk "Vxx_fast_off_gear_sel_bk" UBYTE _CNV_R_R_VA_F_1_m1__452_CM 1 0. -1. 254. ECU_ADDRESS 0xd0004c08 FORMAT "%9.2" /end MEASUREMENT
/begin MEASUREMENT Vxx_fast_off_kd_n_thd "Vxx_fast_off_kd_n_thd" UWORD _CNV_R_R_VA_F_0v25__441_CM 1 0. 0. 16383.75 ECU_ADDRESS 0xd0005a7e FORMAT "%9.2" /end MEASUREMENT
/begin MEASUREMENT Vxx_fast_off_max_dly "Vxx_fast_off_max_dly" UBYTE _CNV_R_R_VA_F_0v02__443_CM 1 0. 0. 5.1 ECU_ADDRESS 0xd00056e5 FORMAT "%9.2" /end MEASUREMENT
/begin MEASUREMENT Vxx_fast_off_no_pdl_dly "Vxx_fast_off_no_pdl_dly" UBYTE _CNV_R_R_VA_F_0v02__443_CM 1 0. 0. 5.1 ECU_ADDRESS 0xd00056e6 FORMAT "%9.2" /end MEASUREMENT
/begin MEASUREMENT Vxx_fast_on_gear_sel "Vxx_fast_on_gear_sel" UBYTE _CNV_R_R_VA_F_1_p1__440_CM 1 0. 1. 256. ECU_ADDRESS 0xd0004241 FORMAT "%9.2" /end MEASUREMENT
/begin MEASUREMENT Vxx_free_shf_pdl "Vxx_free_shf_pdl" UWORD _CNV_R_R_VA_F_0v125_451_CM 1 0. 0. 8191.875 ECU_ADDRESS 0xd000315c FORMAT "%9.2" /end MEASUREMENT
/begin MEASUREMENT Vxx_frz_gear_sel "Vxx_frz_gear_sel" UBYTE _CNV_R_R_VA_F_1_m1__452_CM 1 0. -1. 254. ECU_ADDRESS 0xd0004202 FORMAT "%9.2" /end MEASUREMENT
/begin MEASUREMENT Vxx_gear_bk "Vxx_gear_bk" UBYTE _CNV_R_R_VA_F_1_m1__452_CM 1 0. -1. 254. ECU_ADDRESS 0xd0004c09 FORMAT "%9.2" /end MEASUREMENT
/begin MEASUREMENT Vxx_gear_lim "Vxx_gear_lim" UBYTE _CNV_R_R_VA_F_1_p1__440_CM 1 0. 1. 256. ECU_ADDRESS 0xd0003f40 FORMAT "%9.2" /end MEASUREMENT
/begin MEASUREMENT Vxx_gear_lim_inc "Vxx_gear_lim_inc" UBYTE _CNV_R_R_VA_F_1_p1__440_CM 1 0. 1. 256. ECU_ADDRESS 0xd0003f41 FORMAT "%9.2" /end MEASUREMENT
/begin MEASUREMENT Vxx_gear_sel "Vxx_gear_sel" UBYTE _CNV_R_R_VA_F_1_p1__440_CM 1 0. 1. 256. ECU_ADDRESS 0xd0004ae9 FORMAT "%9.2" /end MEASUREMENT
/begin MEASUREMENT Vxx_law_gear_sel "Vxx_law_gear_sel" UBYTE _CNV_R_R_VA_F_1_p1__440_CM 1 0. 1. 256. ECU_ADDRESS 0xd0004aef FORMAT "%9.2" /end MEASUREMENT
/begin MEASUREMENT Vxx_max_avl_pow "Vxx_max_avl_pow" SWORD _CNV_R_R_VA_F_10_p0_453_CM 1 0. -327680. 327670. ECU_ADDRESS 0xd0003442 FORMAT "%9.2" /end MEASUREMENT
/begin MEASUREMENT Vxx_max_avl_pow_inc "Vxx_max_avl_pow_inc" SWORD _CNV_R_R_VA_F_10_p0_453_CM 1 0. -327680. 327670. ECU_ADDRESS 0xd0003444 FORMAT "%9.2" /end MEASUREMENT
/begin MEASUREMENT Vxx_max_avl_pow_rat "Vxx_max_avl_pow_rat" SBYTE _CNV_R_R_VA_F_0v01__454_CM 1 0. -1.28 1.27 ECU_ADDRESS 0xd0003f3e FORMAT "%9.2" /end MEASUREMENT
/begin MEASUREMENT Vxx_min_dspl_arw_up_dly "Vxx_min_dspl_arw_up_dly" UBYTE _CNV_R_R_VA_F_0v02__443_CM 1 0. 0. 5.1 ECU_ADDRESS 0xd0005250 FORMAT "%9.2" /end MEASUREMENT
/begin MEASUREMENT Vxx_n_dhil "Vxx_n_dhil" UWORD _CNV_R_R_VA_F_0v25__441_CM 1 0. 0. 16383.75 ECU_ADDRESS 0xd000370a FORMAT "%9.2" /end MEASUREMENT
/begin MEASUREMENT Vxx_n_gear "Vxx_n_gear" UWORD _CNV_R_R_VA_F_0v25__441_CM 1 0. 0. 16383.75 ECU_ADDRESS 0xd000344a FORMAT "%9.2" /end MEASUREMENT
/begin MEASUREMENT Vxx_n_gear_inc "Vxx_n_gear_inc" UWORD _CNV_R_R_VA_F_0v25__441_CM 1 0. 0. 16383.75 ECU_ADDRESS 0xd000344c FORMAT "%9.2" /end MEASUREMENT
/begin MEASUREMENT Vxx_no_seq_gear_sel "Vxx_no_seq_gear_sel" UBYTE _CNV_R_R_VA_F_1_m1__452_CM 1 0. -1. 254. ECU_ADDRESS 0xd0004c0b FORMAT "%9.2" /end MEASUREMENT
/begin MEASUREMENT Vxx_pdl_grd "Vxx_pdl_grd" SWORD _CNV_R_R_VA_F_0v125_455_CM 1 0. -4096. 4095.875 ECU_ADDRESS 0xd0003304 FORMAT "%9.2" /end MEASUREMENT
/begin MEASUREMENT Vxx_pow_r_req_down "Vxx_pow_r_req_down" SWORD _CNV_R_R_VA_F_10_p0_453_CM 1 0. -327680. 327670. ECU_ADDRESS 0xd0003446 FORMAT "%9.2" /end MEASUREMENT
/begin MEASUREMENT Vxx_pow_r_req_up "Vxx_pow_r_req_up" SWORD _CNV_R_R_VA_F_10_p0_453_CM 1 0. -327680. 327670. ECU_ADDRESS 0xd0003448 FORMAT "%9.2" /end MEASUREMENT
/begin MEASUREMENT Vxx_sta_dspl_arw_up_dly "Vxx_sta_dspl_arw_up_dly" UBYTE _CNV_R_R_VA_F_0v02__443_CM 1 0. 0. 5.1 ECU_ADDRESS 0xd0005251 FORMAT "%9.2" /end MEASUREMENT
/begin MEASUREMENT Vxx_t_ant "Vxx_t_ant" UBYTE _CNV_R_R_VA_F_0v02__443_CM 1 0. 0. 5.1 ECU_ADDRESS 0xd0004c0c FORMAT "%9.2" /end MEASUREMENT
/begin MEASUREMENT Vxx_t_cur "Vxx_t_cur" UBYTE _CNV_R_R_VA_F_0v02__443_CM 1 0. 0. 5.1 ECU_ADDRESS 0xd0004dc4 FORMAT "%9.2" /end MEASUREMENT
/begin MEASUREMENT Vxx_t_fast_off "Vxx_t_fast_off" UBYTE _CNV_R_R_VA_F_0v02__443_CM 1 0. 0. 5.1 ECU_ADDRESS 0xd00056e7 FORMAT "%9.2" /end MEASUREMENT
/begin MEASUREMENT Vxx_t_max_arw_down "Vxx_t_max_arw_down" UWORD _CNV_R_R_VA_F_0v02__443_CM 1 0. 0. 1310.7 ECU_ADDRESS 0xd0005ab2 FORMAT "%9.2" /end MEASUREMENT
/begin MEASUREMENT Vxx_t_max_arw_up "Vxx_t_max_arw_up" UWORD _CNV_R_R_VA_F_0v02__443_CM 1 0. 0. 1310.7 ECU_ADDRESS 0xd0005ab4 FORMAT "%9.2" /end MEASUREMENT
/begin MEASUREMENT Vxx_t_max_cur "Vxx_t_max_cur" UBYTE _CNV_R_R_VA_F_0v02__443_CM 1 0. 0. 5.1 ECU_ADDRESS 0xd0004dc5 FORMAT "%9.2" /end MEASUREMENT
/begin MEASUREMENT Vxx_t_min_arw_down "Vxx_t_min_arw_down" UBYTE _CNV_R_R_VA_F_0v02__443_CM 1 0. 0. 5.1 ECU_ADDRESS 0xd0005252 FORMAT "%9.2" /end MEASUREMENT
/begin MEASUREMENT Vxx_t_min_arw_up "Vxx_t_min_arw_up" UBYTE _CNV_R_R_VA_F_0v02__443_CM 1 0. 0. 5.1 ECU_ADDRESS 0xd0005253 FORMAT "%9.2" /end MEASUREMENT
/begin MEASUREMENT Vxx_t_no_pdl "Vxx_t_no_pdl" UBYTE _CNV_R_R_VA_F_0v02__443_CM 1 0. 0. 5.1 ECU_ADDRESS 0xd00056e8 FORMAT "%9.2" /end MEASUREMENT
/begin MEASUREMENT Vxx_t_no_seq_down_shf "Vxx_t_no_seq_down_shf" UBYTE _CNV_R_R_VA_F_0v02__443_CM 1 0. 0. 5.1 ECU_ADDRESS 0xd0004c0d FORMAT "%9.2" /end MEASUREMENT
/begin MEASUREMENT Vxx_t_no_seq_up_shf "Vxx_t_no_seq_up_shf" UBYTE _CNV_R_R_VA_F_0v02__443_CM 1 0. 0. 5.1 ECU_ADDRESS 0xd0004c0e FORMAT "%9.2" /end MEASUREMENT
/begin MEASUREMENT Vxx_t_rest_arw_down "Vxx_t_rest_arw_down" UWORD _CNV_R_R_VA_F_0v02__443_CM 1 0. 0. 1310.7 ECU_ADDRESS 0xd0005ab6 FORMAT "%9.2" /end MEASUREMENT
/begin MEASUREMENT Vxx_t_rest_arw_up "Vxx_t_rest_arw_up" UWORD _CNV_R_R_VA_F_0v02__443_CM 1 0. 0. 1310.7 ECU_ADDRESS 0xd0005ab8 FORMAT "%9.2" /end MEASUREMENT
/begin MEASUREMENT Vxx_t_sta_arw_down "Vxx_t_sta_arw_down" UBYTE _CNV_R_R_VA_F_0v02__443_CM 1 0. 0. 5.1 ECU_ADDRESS 0xd0005254 FORMAT "%9.2" /end MEASUREMENT
/begin MEASUREMENT Vxx_t_sta_arw_up "Vxx_t_sta_arw_up" UBYTE _CNV_R_R_VA_F_0v02__443_CM 1 0. 0. 5.1 ECU_ADDRESS 0xd0005255 FORMAT "%9.2" /end MEASUREMENT
/begin MEASUREMENT Vxx_t_up_shf_dly "Vxx_t_up_shf_dly" UBYTE _CNV_R_R_VA_F_0v02__443_CM 1 0. 0. 5.1 ECU_ADDRESS 0xd00056e9 FORMAT "%9.2" /end MEASUREMENT
/begin MEASUREMENT Vxx_tco_ctr "Vxx_tco_ctr" UBYTE _CNV_R_R_VA_I_16_449_CM 1 0. 0. 255. ECU_ADDRESS 0xd000579e FORMAT "%9.2" /end MEASUREMENT
/begin MEASUREMENT Vxx_tra_acel_abs "Vxx_tra_acel_abs" UWORD _CNV_R_R_VA_F_0v000_442_CM 1 0. 0. 26.214 ECU_ADDRESS 0xd0003738 FORMAT "%9.4" /end MEASUREMENT
/begin MEASUREMENT Vxx_tra_acel_abs_vld "Vxx_tra_acel_abs_vld" UWORD _CNV_R_R_VA_F_0v000_442_CM 1 0. 0. 26.214 ECU_ADDRESS 0xd000373a FORMAT "%9.4" /end MEASUREMENT
/begin MEASUREMENT Vxx_up_shf_no_seq_dly "Vxx_up_shf_no_seq_dly" UBYTE _CNV_R_R_VA_F_0v02__443_CM 1 0. 0. 5.1 ECU_ADDRESS 0xd0004c0f FORMAT "%9.2" /end MEASUREMENT
/begin MEASUREMENT Vxx_vs_mv "Vxx_vs_mv" UWORD _CNV_R_R_VA_F_0v01__446_CM 1 0. 0. 655.35 ECU_ADDRESS 0xd00038d8 FORMAT "%9.2" /end MEASUREMENT
/begin MEASUREMENT Vxx_vs_thd_1_2 "Vxx_vs_thd_1_2" UWORD _CNV_R_R_VA_F_0v01__446_CM 1 0. 0. 655.35 ECU_ADDRESS 0xd000370c FORMAT "%9.2" /end MEASUREMENT
/begin MEASUREMENT Vxx_vs_thd_2_1 "Vxx_vs_thd_2_1" UWORD _CNV_R_R_VA_F_0v01__446_CM 1 0. 0. 655.35 ECU_ADDRESS 0xd000370e FORMAT "%9.2" /end MEASUREMENT
/begin MEASUREMENT Vxx_vs_thd_2_3 "Vxx_vs_thd_2_3" UWORD _CNV_R_R_VA_F_0v01__446_CM 1 0. 0. 655.35 ECU_ADDRESS 0xd0003710 FORMAT "%9.2" /end MEASUREMENT
/begin MEASUREMENT Vxx_vs_thd_3_2 "Vxx_vs_thd_3_2" UWORD _CNV_R_R_VA_F_0v01__446_CM 1 0. 0. 655.35 ECU_ADDRESS 0xd0003712 FORMAT "%9.2" /end MEASUREMENT
/begin MEASUREMENT Vxx_vs_thd_3_4 "Vxx_vs_thd_3_4" UWORD _CNV_R_R_VA_F_0v01__446_CM 1 0. 0. 655.35 ECU_ADDRESS 0xd0003714 FORMAT "%9.2" /end MEASUREMENT
/begin MEASUREMENT Vxx_vs_thd_4_3 "Vxx_vs_thd_4_3" UWORD _CNV_R_R_VA_F_0v01__446_CM 1 0. 0. 655.35 ECU_ADDRESS 0xd0003716 FORMAT "%9.2" /end MEASUREMENT
/begin MEASUREMENT Vxx_vs_thd_4_5 "Vxx_vs_thd_4_5" UWORD _CNV_R_R_VA_F_0v01__446_CM 1 0. 0. 655.35 ECU_ADDRESS 0xd0003718 FORMAT "%9.2" /end MEASUREMENT
/begin MEASUREMENT Vxx_vs_thd_5_4 "Vxx_vs_thd_5_4" UWORD _CNV_R_R_VA_F_0v01__446_CM 1 0. 0. 655.35 ECU_ADDRESS 0xd000371a FORMAT "%9.2" /end MEASUREMENT
/begin MEASUREMENT Vxx_vs_thd_5_6 "Vxx_vs_thd_5_6" UWORD _CNV_R_R_VA_F_0v01__446_CM 1 0. 0. 655.35 ECU_ADDRESS 0xd000371c FORMAT "%9.2" /end MEASUREMENT
/begin MEASUREMENT Vxx_vs_thd_6_5 "Vxx_vs_thd_6_5" UWORD _CNV_R_R_VA_F_0v01__446_CM 1 0. 0. 655.35 ECU_ADDRESS 0xd000371e FORMAT "%9.2" /end MEASUREMENT
/begin CHARACTERISTIC Cbx_apmp_ena_cfm "Cbx_apmp_ena_cfm" VALUE 0xa00215f0 _REC_S1VAL_Normal_u1 1. _CNV_S_2_VA_Bool_ON_448_CM 0. 1. /end CHARACTERISTIC
/begin CHARACTERISTIC Cbx_brk_ass_ena_cfm "Cbx_brk_ass_ena_cfm" VALUE 0xa0021d62 _REC_S1VAL_Normal_u1 1. _CNV_S_2_VA_Bool_ON_448_CM 0. 1. /end CHARACTERISTIC
/begin CHARACTERISTIC Cbx_cru_blk_cfm "Cbx_cru_blk_cfm" VALUE 0xa0021368 _REC_S1VAL_Normal_u1 1. _CNV_S_2_VA_Bool_ON_448_CM 0. 1. /end CHARACTERISTIC
/begin CHARACTERISTIC Cbx_cur_ena_cfm "Cbx_cur_ena_cfm" VALUE 0xa0021369 _REC_S1VAL_Normal_u1 1. _CNV_S_2_VA_Bool_ON_448_CM 0. 1. /end CHARACTERISTIC
/begin CHARACTERISTIC Cbx_dly_ena_cfm "Cbx_dly_ena_cfm" VALUE 0xa0021ee4 _REC_S1VAL_Normal_u1 1. _CNV_S_2_VA_Bool_ON_448_CM 0. 1. /end CHARACTERISTIC
/begin CHARACTERISTIC Cbx_down_shf_blk_cur_cfm "Cbx_down_shf_blk_cur_cfm" VALUE 0xa002136a _REC_S1VAL_Normal_u1 1. _CNV_S_2_VA_Bool_ON_448_CM 0. 1. /end CHARACTERISTIC
/begin CHARACTERISTIC Cbx_fast_off_ena_cfm "Cbx_fast_off_ena_cfm" VALUE 0xa00208f3 _REC_S1VAL_Normal_u1 1. _CNV_S_2_VA_Bool_ON_448_CM 0. 1. /end CHARACTERISTIC
/begin CHARACTERISTIC Cbx_fast_off_kd_ena_cfm "Cbx_fast_off_kd_ena_cfm" VALUE 0xa00208f4 _REC_S1VAL_Normal_u1 1. _CNV_S_2_VA_Bool_ON_448_CM 0. 1. /end CHARACTERISTIC
/begin CHARACTERISTIC Cbx_fast_on_ena_cfm "Cbx_fast_on_ena_cfm" VALUE 0xa0021465 _REC_S1VAL_Normal_u1 1. _CNV_S_2_VA_Bool_ON_448_CM 0. 1. /end CHARACTERISTIC
/begin CHARACTERISTIC Cbx_free_shf_dsb_cfm "Cbx_free_shf_dsb_cfm" VALUE 0xa0020a07 _REC_S1VAL_Normal_u1 1. _CNV_S_2_VA_Bool_ON_448_CM 0. 1. /end CHARACTERISTIC
/begin CHARACTERISTIC Cbx_gear_blk_cfm "Cbx_gear_blk_cfm" VALUE 0xa002136b _REC_S1VAL_Normal_u1 1. _CNV_S_2_VA_Bool_ON_448_CM 0. 1. /end CHARACTERISTIC
/begin CHARACTERISTIC Cbx_wal_1_req_fs_cfm "Cbx_wal_1_req_fs_cfm" VALUE 0xa002136c _REC_S1VAL_Normal_u1 1. _CNV_S_2_VA_Bool_ON_448_CM 0. 1. /end CHARACTERISTIC
/begin CHARACTERISTIC Cxx_acel_in_brk_ass_thd "Cxx_acel_in_brk_ass_thd" VALUE 0xa0021d4e _REC_S1VAL_Normal_s4 25.5 _CNV_R_R_VA_F_0v000_442_CM -12. 13.5 FORMAT "%9.4" /end CHARACTERISTIC
/begin CHARACTERISTIC Cxx_acel_out_brk_ass_thd "Cxx_acel_out_brk_ass_thd" VALUE 0xa0021d52 _REC_S1VAL_Normal_s4 25.5 _CNV_R_R_VA_F_0v000_442_CM -12. 13.5 FORMAT "%9.4" /end CHARACTERISTIC
/begin CHARACTERISTIC Cxx_cur_tra_acel_hys "Cxx_cur_tra_acel_hys" VALUE 0xa0020a0e _REC_S1VAL_Normal_u2 13.5 _CNV_R_R_VA_F_0v000_442_CM 0. 13.5 FORMAT "%9.4" /end CHARACTERISTIC
/begin CHARACTERISTIC Cxx_dhil_flat_thd "Cxx_dhil_flat_thd" VALUE 0xa0021d38 _REC_S1VAL_Normal_s2 65535. _CNV_R_R_VA_F_1_p0__456_CM -32768. 32767. FORMAT "%9.2" /end CHARACTERISTIC
/begin CHARACTERISTIC Cxx_down_shf_no_seq_dly "Cxx_down_shf_no_seq_dly" VALUE 0xa0021ee2 _REC_S1VAL_Normal_u1 5.1 _CNV_R_R_VA_F_0v02__443_CM 0. 5.1 FORMAT "%9.2" /end CHARACTERISTIC
/begin CHARACTERISTIC Cxx_down_shf_pow_rat "Cxx_down_shf_pow_rat" VALUE 0xa0020e3e _REC_S1VAL_Normal_u2 100. _CNV_R_R_VA_F_0v125_451_CM 0. 100. FORMAT "%9.2" /end CHARACTERISTIC
/begin CHARACTERISTIC Cxx_driv_ant_dly "Cxx_driv_ant_dly" VALUE 0xa0021ee3 _REC_S1VAL_Normal_u1 5.1 _CNV_R_R_VA_F_0v02__443_CM 0. 5.1 FORMAT "%9.2" /end CHARACTERISTIC
/begin CHARACTERISTIC Cxx_fast_off_kd_pdl_thd "Cxx_fast_off_kd_pdl_thd" VALUE 0xa00208de _REC_S1VAL_Normal_u2 100. _CNV_R_R_VA_F_0v125_438_CM 0. 100. FORMAT "%9.2" /end CHARACTERISTIC
/begin CHARACTERISTIC Cxx_flat_dhil_thd "Cxx_flat_dhil_thd" VALUE 0xa0021d3a _REC_S1VAL_Normal_s2 65535. _CNV_R_R_VA_F_1_p0__456_CM -32768. 32767. FORMAT "%9.2" /end CHARACTERISTIC
/begin CHARACTERISTIC Cxx_flat_uhil_thd "Cxx_flat_uhil_thd" VALUE 0xa0021d3c _REC_S1VAL_Normal_s2 65535. _CNV_R_R_VA_F_1_p0__456_CM -32768. 32767. FORMAT "%9.2" /end CHARACTERISTIC
/begin CHARACTERISTIC Cxx_free_shf_no_pdl "Cxx_free_shf_no_pdl" VALUE 0xa0021d56 _REC_S1VAL_Normal_u2 100. _CNV_R_R_VA_F_0v125_438_CM 0. 100. FORMAT "%9.2" /end CHARACTERISTIC
/begin CHARACTERISTIC Cxx_free_shf_no_pdl_brk_ass "Cxx_free_shf_no_pdl_brk_ass" VALUE 0xa0021d58 _REC_S1VAL_Normal_u2 100. _CNV_R_R_VA_F_0v125_438_CM 0. 100. FORMAT "%9.2" /end CHARACTERISTIC
/begin CHARACTERISTIC Cxx_free_shf_no_pdl_fast_off "Cxx_free_shf_no_pdl_fast_off" VALUE 0xa00208e0 _REC_S1VAL_Normal_u2 100. _CNV_R_R_VA_F_0v125_438_CM 0. 100. FORMAT "%9.2" /end CHARACTERISTIC
/begin CHARACTERISTIC Cxx_free_shf_no_pdl_fast_on "Cxx_free_shf_no_pdl_fast_on" VALUE 0xa0021460 _REC_S1VAL_Normal_u2 100. _CNV_R_R_VA_F_0v125_438_CM 0. 100. FORMAT "%9.2" /end CHARACTERISTIC
/begin CHARACTERISTIC Cxx_gear_max "Cxx_gear_max" VALUE 0xa0021d60 _REC_S1VAL_Normal_u1 5. _CNV_R_R_VA_F_1_p1__440_CM 1. 6. FORMAT "%9.2" /end CHARACTERISTIC
/begin CHARACTERISTIC Cxx_law_sel_cfm "Cxx_law_sel_cfm" VALUE 0xa0021d4a _REC_S1VAL_Normal_u1 5. _CNV_R_R_VA_I_16_449_CM 0. 5. FORMAT "%9.2" /end CHARACTERISTIC
/begin CHARACTERISTIC Cxx_lg_acel_law_fil "Cxx_lg_acel_law_fil" VALUE 0xa0021d61 _REC_S1VAL_Normal_u1 5.1 _CNV_R_R_VA_F_0v02__443_CM 0. 5.1 FORMAT "%9.2" /end CHARACTERISTIC
/begin CHARACTERISTIC Cxx_max_decl "Cxx_max_decl" VALUE 0xa0021364 _REC_S1VAL_Normal_s4 25.5 _CNV_R_R_VA_F_0v000_457_CM -12. 13.5 FORMAT "%9.4" /end CHARACTERISTIC
/begin CHARACTERISTIC Cxx_max_dspl_arw_cyc_nr "Cxx_max_dspl_arw_cyc_nr" VALUE 0xa00217b2 _REC_S1VAL_Normal_u1 32. _CNV_R_R_VA_I_16_449_CM 0. 32. FORMAT "%9.2" /end CHARACTERISTIC
/begin CHARACTERISTIC Cxx_max_dspl_arw_down_dly "Cxx_max_dspl_arw_down_dly" VALUE 0xa00217a2 _REC_S1VAL_Normal_u2 1310.7 _CNV_R_R_VA_F_0v02__443_CM 0. 1310.7 FORMAT "%9.2" /end CHARACTERISTIC
/begin CHARACTERISTIC Cxx_max_dspl_arw_up_dly "Cxx_max_dspl_arw_up_dly" VALUE 0xa00217a4 _REC_S1VAL_Normal_u2 1310.7 _CNV_R_R_VA_F_0v02__443_CM 0. 1310.7 FORMAT "%9.2" /end CHARACTERISTIC
/begin CHARACTERISTIC Cxx_max_pow_fs "Cxx_max_pow_fs" VALUE 0xa0020e42 _REC_S1VAL_Normal_u2 655350. _CNV_R_R_VA_F_10_p0_453_CM 0. 655350. FORMAT "%9.2" /end CHARACTERISTIC
/begin CHARACTERISTIC Cxx_min_dspl_arw_down_dly "Cxx_min_dspl_arw_down_dly" VALUE 0xa00217b0 _REC_S1VAL_Normal_u1 5.1 _CNV_R_R_VA_F_0v02__443_CM 0. 5.1 FORMAT "%9.2" /end CHARACTERISTIC
/begin CHARACTERISTIC Cxx_min_dspl_arw_up_dly "Cxx_min_dspl_arw_up_dly" VALUE 0xa00217b3 _REC_S1VAL_Normal_u1 5.1 _CNV_R_R_VA_F_0v02__443_CM 0. 5.1 FORMAT "%9.2" /end CHARACTERISTIC
/begin CHARACTERISTIC Cxx_mv_vs_dec_fil "Cxx_mv_vs_dec_fil" VALUE 0xa0021d4b _REC_S1VAL_Normal_u1 255. _CNV_R_R_VA_F_1_p0__458_CM 0. 255. FORMAT "%9.2" /end CHARACTERISTIC
/begin CHARACTERISTIC Cxx_mv_vs_inc_fil "Cxx_mv_vs_inc_fil" VALUE 0xa0021d4c _REC_S1VAL_Normal_u1 255. _CNV_R_R_VA_F_1_p0__458_CM 0. 255. FORMAT "%9.2" /end CHARACTERISTIC
/begin CHARACTERISTIC Cxx_n_lim_apmp_down_shf_hys "Engine speed hysteresis" VALUE 0xa0020e44 _REC_S1VAL_Normal_u2 16383.75 _CNV_R_R_VA_F_0v25__437_CM 0. 16383.75 FORMAT "%9.2" /end CHARACTERISTIC
/begin CHARACTERISTIC Cxx_n_run_thd "Cxx_n_run_thd" VALUE 0xa0021d40 _REC_S1VAL_Normal_u2 65535. _CNV_R_R_VA_F_1_p0__459_CM 0. 65535. FORMAT "%9.2" /end CHARACTERISTIC
/begin CHARACTERISTIC Cxx_pdl_cru_min_lim "Cxx_pdl_cru_min_lim" VALUE 0xa0021720 _REC_S1VAL_Normal_u2 100. _CNV_R_R_VA_F_0v125_438_CM 0. 100. FORMAT "%9.2" /end CHARACTERISTIC
/begin CHARACTERISTIC Cxx_pdl_fast_on_kd_thd "Cxx_pdl_fast_on_kd_thd" VALUE 0xa0021462 _REC_S1VAL_Normal_u2 100. _CNV_R_R_VA_F_0v125_438_CM 0. 100. FORMAT "%9.2" /end CHARACTERISTIC
/begin CHARACTERISTIC Cxx_pdl_grd_fast_on_thd "Cxx_pdl_grd_fast_on_thd" VALUE 0xa002145e _REC_S1VAL_Normal_s2 4000. _CNV_R_R_VA_F_0v125_455_CM -2000. 2000. FORMAT "%9.2" /end CHARACTERISTIC
/begin CHARACTERISTIC Cxx_pdl_grd_fil "Cxx_pdl_grd_fil" VALUE 0xa0021464 _REC_S1VAL_Normal_u1 5.1 _CNV_R_R_VA_F_0v02__443_CM 0. 5.1 FORMAT "%9.2" /end CHARACTERISTIC
/begin CHARACTERISTIC Cxx_pdl_grd_in_neg_thd "Cxx_pdl_grd_in_neg_thd" VALUE 0xa00208e2 _REC_S1VAL_Normal_s2 4000. _CNV_R_R_VA_F_0v125_455_CM -2000. 2000. FORMAT "%9.2" /end CHARACTERISTIC
/begin CHARACTERISTIC Cxx_pdl_grd_out_neg_thd "Cxx_pdl_grd_out_neg_thd" VALUE 0xa00208e4 _REC_S1VAL_Normal_s2 4000. _CNV_R_R_VA_F_0v125_455_CM -2000. 2000. FORMAT "%9.2" /end CHARACTERISTIC
/begin CHARACTERISTIC Cxx_pow_apmp_hys "Cxx_pow_apmp_hys" VALUE 0xa0020e3c _REC_S1VAL_Normal_s2 655350. _CNV_R_R_VA_F_10_p0_453_CM -327680. 327670. FORMAT "%9.2" /end CHARACTERISTIC
/begin CHARACTERISTIC Cxx_rest_dspl_arw_down_dly "Cxx_rest_dspl_arw_down_dly" VALUE 0xa00217a6 _REC_S1VAL_Normal_u2 1310.7 _CNV_R_R_VA_F_0v02__443_CM 0. 1310.7 FORMAT "%9.2" /end CHARACTERISTIC
/begin CHARACTERISTIC Cxx_rest_dspl_arw_up_dly "Cxx_rest_dspl_arw_up_dly" VALUE 0xa00217a8 _REC_S1VAL_Normal_u2 1310.7 _CNV_R_R_VA_F_0v02__443_CM 0. 1310.7 FORMAT "%9.2" /end CHARACTERISTIC
/begin CHARACTERISTIC Cxx_sta_dspl_arw_down_dly "Cxx_sta_dspl_arw_down_dly" VALUE 0xa00217b1 _REC_S1VAL_Normal_u1 5.1 _CNV_R_R_VA_F_0v02__443_CM 0. 5.1 FORMAT "%9.2" /end CHARACTERISTIC
/begin CHARACTERISTIC Cxx_tco_thd "Cxx_tco_thd" VALUE 0xa0021d42 _REC_S1VAL_Normal_u2 240. _CNV_R_R_VA_F_0v1_m_460_CM -40. 200. FORMAT "%9.2" /end CHARACTERISTIC
/begin CHARACTERISTIC Cxx_tra_acel_cur_fil "Cxx_tra_acel_cur_fil" VALUE 0xa0020a10 _REC_S1VAL_Normal_u1 5.1 _CNV_R_R_VA_F_0v02__443_CM 0. 5.1 FORMAT "%9.2" /end CHARACTERISTIC
/begin CHARACTERISTIC Cxx_uhil_flat_thd "Cxx_uhil_flat_thd" VALUE 0xa0021d3e _REC_S1VAL_Normal_s2 65535. _CNV_R_R_VA_F_1_p0__456_CM -32768. 32767. FORMAT "%9.2" /end CHARACTERISTIC
/begin CHARACTERISTIC Cxx_up_shf_dly "Cxx_up_shf_dly" VALUE 0xa00208f2 _REC_S1VAL_Normal_u1 5.1 _CNV_R_R_VA_F_0v02__443_CM 0. 5.1 FORMAT "%9.2" /end CHARACTERISTIC
/begin CHARACTERISTIC Cxx_up_shf_pow_rat "Cxx_up_shf_pow_rat" VALUE 0xa0020e40 _REC_S1VAL_Normal_u2 100. _CNV_R_R_VA_F_0v125_451_CM 0. 100. FORMAT "%9.2" /end CHARACTERISTIC
/begin CHARACTERISTIC Cxx_vs_eco_xurb_thd "Cxx_vs_eco_xurb_thd" VALUE 0xa0021d44 _REC_S1VAL_Normal_u2 655.35 _CNV_R_R_VA_F_0v01__446_CM 0. 655.35 FORMAT "%9.2" /end CHARACTERISTIC
/begin CHARACTERISTIC Cxx_vs_xurb_eco_thd "Cxx_vs_xurb_eco_thd" VALUE 0xa0021d46 _REC_S1VAL_Normal_u2 655.35 _CNV_R_R_VA_F_0v01__446_CM 0. 655.35 FORMAT "%9.2" /end CHARACTERISTIC
/begin CHARACTERISTIC Cxx_wup_cata_dly "Cxx_wup_cata_dly" VALUE 0xa0021d48 _REC_S1VAL_Normal_u2 65535. _CNV_R_R_VA_F_1_p0__458_CM 0. 65535. FORMAT "%9.2" /end CHARACTERISTIC
/begin AXIS_PTS Ctb_gear_fs "Ctb_gear_fs" 0xa0021be6 NO_INPUT_QUANTITY _REC_A2AXS_20_u1 5. _CNV_R_R_VA_F_1_p1__440_CM 6 1. 6. FORMAT "%9.2" /end AXIS_PTS
/begin COMPU_METHOD _CNV_A_R_ECME_LINEA_0_CM "" RAT_FUNC "%6.3" "-" COEFFS 0 1. 0. 0 0 1 /end COMPU_METHOD
/begin COMPU_METHOD _CNV_S_2_RANGE______3_CM "" TAB_VERB "%6.3" "-" COMPU_TAB_REF _CNV_S_2_RANGE______3 /end COMPU_METHOD
/begin COMPU_VTAB _CNV_S_2_RANGE______3 "" TAB_VERB 2 0 "0" 1 "1" /end COMPU_VTAB
/begin COMPU_METHOD _CNV_A_R_LINEAR_____4_CM "" RAT_FUNC "%6.3" "s" COEFFS 0 10. 0. 0 0 1 /end COMPU_METHOD
/begin COMPU_METHOD _CNV_A_R_ENSD_LINEA_24_CM "" RAT_FUNC "%6.3" "rpm" COEFFS 0 4. 0. 0 0 1 /end COMPU_METHOD
/begin COMPU_METHOD _CNV_A_R_LINEAR_____31_CM "" RAT_FUNC "%6.3" "-" COEFFS 0 256. 0. 0 0 1 /end COMPU_METHOD
/begin COMPU_METHOD _CNV_A_R_LINEAR_____34_CM "" RAT_FUNC "%6.3" "s" COEFFS 0 100. 0. 0 0 1 /end COMPU_METHOD
/begin COMPU_METHOD _CNV_A_R_LINEAR_____50_CM "" RAT_FUNC "%6.3" "µs" COEFFS 0 0.25 0. 0 0 1 /end COMPU_METHOD
/begin COMPU_METHOD _CNV_A_R_LINEAR_____51_CM "" RAT_FUNC "%6.3" "[-]" COEFFS 0 384. -256.0000128 0 0 1 /end COMPU_METHOD
/begin COMPU_METHOD _CNV_A_R_LINEAR_____52_CM "" RAT_FUNC "%6.3" "mV" COEFFS 0 1. 0. 0 0 1 /end COMPU_METHOD
/begin COMPU_METHOD _CNV_A_R_LINEAR_____53_CM "" RAT_FUNC "%6.3" "-" COEFFS 0 16384. 0. 0 0 1 /end COMPU_METHOD
/begin COMPU_METHOD _CNV_A_R_LINEAR_____54_CM "" RAT_FUNC "%6.3" "∞C" COEFFS 0 10. 400. 0 0 1 /end COMPU_METHOD
/begin COMPU_METHOD _CNV_A_R_LINEAR_____55_CM "" RAT_FUNC "%6.3" "TDC" COEFFS 0 1. 0. 0 0 1 /end COMPU_METHOD
/begin COMPU_METHOD _CNV_A_R_LINEAR_____57_CM "" RAT_FUNC "%6.3" "hPa" COEFFS 0 1. 0. 0 0 1 /end COMPU_METHOD
/begin COMPU_METHOD _CNV_A_R_LINEAR_____65_CM "" RAT_FUNC "%6.3" "-" COEFFS 0 98303.99999999926 -65535.99344639951 0 0 1 /end COMPU_METHOD
/begin COMPU_METHOD _CNV_A_R_LINEAR_____70_CM "" RAT_FUNC "%6.3" "km/h" COEFFS 0 100. 0. 0 0 1 /end COMPU_METHOD
/begin COMPU_METHOD _CNV_A_R_LINEAR_____108_CM "" RAT_FUNC "%6.3" "-" COEFFS 0 1000. 0. 0 0 1 /end COMPU_METHOD
/begin COMPU_METHOD _CNV_A_R_LINEAR_____109_CM "" RAT_FUNC "%6.3" "kg/h" COEFFS 0 20. 0. 0 0 1 /end COMPU_METHOD
/begin COMPU_METHOD _CNV_A_R_LINEAR_____113_CM "" RAT_FUNC "%6.3" "-" COEFFS 0 1. 1. 0 0 1 /end COMPU_METHOD
/begin COMPU_METHOD _CNV_A_R_LINEAR_____118_CM "" RAT_FUNC "%6.3" "-" COEFFS 0 255. 0. 0 0 1 /end COMPU_METHOD
/begin COMPU_METHOD _CNV_S_3_STATUS_OK__120_CM "" TAB_VERB "%6.3" "-" COMPU_TAB_REF _CNV_S_3_STATUS_OK__120 /end COMPU_METHOD
/begin COMPU_VTAB _CNV_S_3_STATUS_OK__120 "" TAB_VERB 3 0 "Nsx_vld_nok_0" 1 "Nsx_vld_ok_1" 2 "Nsx_vld_fail_2" /end COMPU_VTAB
/begin COMPU_METHOD _CNV_A_R_LINEAR_____136_CM "" RAT_FUNC "%6.3" "-" COEFFS 0 100. 0. 0 0 1 /end COMPU_METHOD
/begin COMPU_METHOD _CNV_S_3_STATUS_OK__158_CM "" TAB_VERB "%6.3" "" COMPU_TAB_REF _CNV_S_3_STATUS_OK__158 /end COMPU_METHOD
/begin COMPU_VTAB _CNV_S_3_STATUS_OK__158 "" TAB_VERB 3 0 "Nsx_vld_nok_0" 1 "Nsx_vld_ok_1" 2 "Nsx_vld_fail_2" /end COMPU_VTAB
/begin COMPU_METHOD _CNV_A_R_LINEAR_____161_CM "" RAT_FUNC "%6.3" "Nm" COEFFS 0 32. 12800. 0 0 1 /end COMPU_METHOD
/begin COMPU_METHOD _CNV_A_R_LINEAR_____211_CM "" RAT_FUNC "%6.3" "%" COEFFS 0 800. 0. 0 0 1 /end COMPU_METHOD
/begin COMPU_METHOD _CNV_A_R_LINEAR_____212_CM "" RAT_FUNC "%6.3" "km/h" COEFFS 0 1. 0. 0 0 1 /end COMPU_METHOD
/begin COMPU_METHOD _CNV_S_2_STATUS_OK__214_CM "" TAB_VERB "%6.3" "-" COMPU_TAB_REF _CNV_S_2_STATUS_OK__214 /end COMPU_METHOD
/begin COMPU_VTAB _CNV_S_2_STATUS_OK__214 "" TAB_VERB 2 0 "Nsx_vld_nok_0" 1 "Nsx_vld_ok_1" /end COMPU_VTAB
/begin COMPU_METHOD _CNV_A_R_LINEAR_____236_CM "" RAT_FUNC "%6.3" "-" COEFFS 0 25.6 0. 0 0 1 /end COMPU_METHOD
/begin COMPU_METHOD _CNV_A_R_LINEAR_____295_CM "" RAT_FUNC "%6.3" "N" COEFFS 0 0.5 0. 0 0 1 /end COMPU_METHOD
/begin COMPU_METHOD _CNV_A_R_LINEAR_____302_CM "" RAT_FUNC "%6.3" "Nm" COEFFS 0 10. 0. 0 0 1 /end COMPU_METHOD
/begin COMPU_METHOD _CNV_A_R_LINEAR_____331_CM "" RAT_FUNC "%6.3" "(km/h)/K*rpm" COEFFS 0 100. 0. 0 0 1 /end COMPU_METHOD
/begin COMPU_METHOD _CNV_A_R_LINEAR_____344_CM "" RAT_FUNC "%6.3" "s" COEFFS 0 2. 0. 0 0 1 /end COMPU_METHOD
/begin COMPU_METHOD _CNV_A_R_LINEAR_____380_CM "" RAT_FUNC "%6.3" "∞C" COEFFS 0 0.25 10. 0 0 1 /end COMPU_METHOD
/begin COMPU_METHOD _CNV_A_R_LINEAR_____409_CM "" RAT_FUNC "%6.3" "N" COEFFS 0 4.e-002 0. 0 0 1 /end COMPU_METHOD
/begin COMPU_METHOD _CNV_A_R_LINEAR_____410_CM "" RAT_FUNC "%6.3" "km/h/s" COEFFS 0 524.2879999999999 -7.275957614183426e-012 0 0 1 /end COMPU_METHOD
/begin COMPU_METHOD _CNV_A_R_LINEAR_____411_CM "" RAT_FUNC "%6.3" "N" COEFFS 0 1. 0. 0 0 1 /end COMPU_METHOD
/begin COMPU_METHOD _CNV_A_R_LINEAR_____412_CM "" RAT_FUNC "%6.3" "1/s" COEFFS 0 33.55443200078277 0. 0 0 1 /end COMPU_METHOD
/begin COMPU_METHOD _CNV_A_R_LINEAR_____413_CM "" RAT_FUNC "%6.3" "1/s" COEFFS 0 524.2880000000008 0. 0 0 1 /end COMPU_METHOD
/begin COMPU_METHOD _CNV_A_R_LINEAR_____414_CM "" RAT_FUNC "%6.3" "km/h/s" COEFFS 0 34359738.36799999 -4.76837158203125e-007 0 0 1 /end COMPU_METHOD
/begin COMPU_METHOD _CNV_A_R_LINEAR_____415_CM "" RAT_FUNC "%6.3" "km/h/s" COEFFS 0 100. 0. 0 0 1 /end COMPU_METHOD
/begin COMPU_METHOD _CNV_A_R_LINEAR_____416_CM "" RAT_FUNC "%6.3" "N/s" COEFFS 0 0.5 0. 0 0 1 /end COMPU_METHOD
/begin COMPU_METHOD _CNV_A_R_LINEAR_____417_CM "" RAT_FUNC "%6.3" "1/s" COEFFS 0 1000. 0. 0 0 1 /end COMPU_METHOD
/begin COMPU_METHOD _CNV_A_R_LINEAR_____418_CM "" RAT_FUNC "%6.3" "km/h/s" COEFFS 0 40. 0. 0 0 1 /end COMPU_METHOD
/begin COMPU_METHOD _CNV_A_R_LINEAR_____419_CM "" RAT_FUNC "%6.3" "1/s≤" COEFFS 0 33.55443200078277 0. 0 0 1 /end COMPU_METHOD
/begin COMPU_METHOD _CNV_A_R_LINEAR_____420_CM "" RAT_FUNC "%6.3" "kg" COEFFS 0 0.1 0. 0 0 1 /end COMPU_METHOD
/begin COMPU_METHOD _CNV_A_R_LINEAR_____422_CM "" RAT_FUNC "%6.3" "∞C" COEFFS 0 0.25 0. 0 0 1 /end COMPU_METHOD
/begin COMPU_METHOD _CNV_A_R_LINEAR_____423_CM "" RAT_FUNC "%6.3" "%" COEFFS 0 255. 0. 0 0 1 /end COMPU_METHOD
/begin COMPU_METHOD _CNV_A_R_LINEAR_____424_CM "" RAT_FUNC "%6.3" "-" COEFFS 0 43.69066666666667 7.275957614183426e-012 0 0 1 /end COMPU_METHOD
/begin COMPU_METHOD _CNV_A_R_LINEAR_____425_CM "" RAT_FUNC "%6.3" "-" COEFFS 0 99999.99999999996 -1.117587089538574e-008 0 0 1 /end COMPU_METHOD
/begin COMPU_METHOD _CNV_A_R_LINEAR_____426_CM "" RAT_FUNC "%6.3" "s" COEFFS 0 25.6 0. 0 0 1 /end COMPU_METHOD
/begin COMPU_METHOD _CNV_S_4_CTL_MON_DI_427_CM "" TAB_VERB "%6.3" "-" COMPU_TAB_REF _CNV_S_4_CTL_MON_DI_427 /end COMPU_METHOD
/begin COMPU_VTAB _CNV_S_4_CTL_MON_DI_427 "" TAB_VERB 4 10 "Nsx_ctl_mon_ini" 20 "Nsx_ctl_mon_wait" 30 "Nsx_ctl_mon_diag" 40 "Nsx_ctl_mon_end" /end COMPU_VTAB
/begin COMPU_METHOD _CNV_A_R_LINEAR_____428_CM "" RAT_FUNC "%6.3" "m" COEFFS 0 3.6 0. 0 0 1 /end COMPU_METHOD
/begin COMPU_METHOD _CNV_S_3_RANGE_STAT_429_CM "" TAB_VERB "%6.3" "-" COMPU_TAB_REF _CNV_S_3_RANGE_STAT_429 /end COMPU_METHOD
/begin COMPU_VTAB _CNV_S_3_RANGE_STAT_429 "" TAB_VERB 3 1 "Nsx_tlz_aplci_wat_ap_stt" 2 "Nsx_tlz_aplci_fast_ap_stt" 3 "Nsx_tlz_aplci_slow_ap_stt" /end COMPU_VTAB
/begin COMPU_METHOD _CNV_S_2_RANGE_STAT_430_CM "" TAB_VERB "%6.3" "-" COMPU_TAB_REF _CNV_S_2_RANGE_STAT_430 /end COMPU_METHOD
/begin COMPU_VTAB _CNV_S_2_RANGE_STAT_430 "" TAB_VERB 2 0 "Nsx_tlz_clc_ini_wat_stt" 1 "Nsx_tlz_clc_clc_stt" /end COMPU_VTAB
/begin COMPU_METHOD _CNV_A_R_LINEAR_____431_CM "" RAT_FUNC "%6.3" "Nm" COEFFS 0 1. 0. 0 0 1 /end COMPU_METHOD
/begin COMPU_METHOD _CNV_A_R_LINEAR_____432_CM "" RAT_FUNC "%6.3" "Nm" COEFFS 0 10. 32768. 0 0 1 /end COMPU_METHOD
/begin COMPU_METHOD _CNV_R_R_VA_F_0v25__437_CM "" RAT_FUNC "%6.3" "RPM" COEFFS 0. 1. 0. 0. 0. 0.25 /end COMPU_METHOD
/begin COMPU_METHOD _CNV_R_R_VA_F_0v125_438_CM "" RAT_FUNC "%6.3" "ratio" COEFFS 0. 1. 0. 0. 0. 0.125 /end COMPU_METHOD
/begin COMPU_METHOD _CNV_R_R_VA_F_0v125_439_CM "" RAT_FUNC "%6.3" "ratio/s" COEFFS 0. 1. 2000. 0. 0. 0.125 /end COMPU_METHOD
/begin COMPU_METHOD _CNV_R_R_VA_F_1_p1__440_CM "" RAT_FUNC "%6.3" "-" COEFFS 0. 1. -1. 0. 0. 1. /end COMPU_METHOD
/begin COMPU_METHOD _CNV_R_R_VA_F_0v25__441_CM "" RAT_FUNC "%6.3" "rpm" COEFFS 0. 1. 0. 0. 0. 0.25 /end COMPU_METHOD
/begin COMPU_METHOD _CNV_R_R_VA_F_0v000_442_CM "" RAT_FUNC "%6.3" "m/s2" COEFFS 0. 1. 0. 0. 0. 4.e-004 /end COMPU_METHOD
/begin COMPU_METHOD _CNV_R_R_VA_F_0v02__443_CM "" RAT_FUNC "%6.3" "s" COEFFS 0. 1. 0. 0. 0. 2.e-002 /end COMPU_METHOD
/begin COMPU_METHOD _CNV_R_R_VA_F_10_m3_444_CM "" RAT_FUNC "%6.3" "W" COEFFS 0. 1. 327680. 0. 0. 10. /end COMPU_METHOD
/begin COMPU_METHOD _CNV_R_R_VA_F_0v1_p_445_CM "" RAT_FUNC "%6.3" "s" COEFFS 0. 1. 0. 0. 0. 0.1 /end COMPU_METHOD
/begin COMPU_METHOD _CNV_R_R_VA_F_0v01__446_CM "" RAT_FUNC "%6.3" "km/h" COEFFS 0. 1. 0. 0. 0. 1.e-002 /end COMPU_METHOD
/begin COMPU_METHOD _CNV_R_R_VA_F_0v01__447_CM "" RAT_FUNC "%6.3" "(km/h)/krpm" COEFFS 0. 1. 0. 0. 0. 1.e-002 /end COMPU_METHOD
/begin COMPU_METHOD _CNV_S_2_VA_Bool_ON_448_CM "" TAB_VERB "%6.3" "." COMPU_TAB_REF _CNV_S_2_VA_Bool_ON_448 /end COMPU_METHOD
/begin COMPU_VTAB _CNV_S_2_VA_Bool_ON_448 "" TAB_VERB 2 0 "OFF" 1 "ON" /end COMPU_VTAB
/begin COMPU_METHOD _CNV_R_R_VA_I_16_449_CM "" RAT_FUNC "%6.3" "-" COEFFS 0. 1. 0. 0. 0. 1. /end COMPU_METHOD
/begin COMPU_METHOD _CNV_R_R_VA_F_1_p2__450_CM "" RAT_FUNC "%6.3" "-" COEFFS 0. 1. -2. 0. 0. 1. /end COMPU_METHOD
/begin COMPU_METHOD _CNV_R_R_VA_F_0v125_451_CM "" RAT_FUNC "%6.3" "%" COEFFS 0. 1. 0. 0. 0. 0.125 /end COMPU_METHOD
/begin COMPU_METHOD _CNV_R_R_VA_F_1_m1__452_CM "" RAT_FUNC "%6.3" "-" COEFFS 0. 1. 1. 0. 0. 1. /end COMPU_METHOD
/begin COMPU_METHOD _CNV_R_R_VA_F_10_p0_453_CM "" RAT_FUNC "%6.3" "W" COEFFS 0. 1. 0. 0. 0. 10. /end COMPU_METHOD
/begin COMPU_METHOD _CNV_R_R_VA_F_0v01__454_CM "" RAT_FUNC "%6.3" "ratio" COEFFS 0. 1. 0. 0. 0. 1.e-002 /end COMPU_METHOD
/begin COMPU_METHOD _CNV_R_R_VA_F_0v125_455_CM "" RAT_FUNC "%6.3" "ratio/s" COEFFS 0. 1. 0. 0. 0. 0.125 /end COMPU_METHOD
/begin COMPU_METHOD _CNV_R_R_VA_F_1_p0__456_CM "" RAT_FUNC "%6.3" "N.m" COEFFS 0. 1. 0. 0. 0. 1. /end COMPU_METHOD
/begin COMPU_METHOD _CNV_R_R_VA_F_0v000_457_CM "" RAT_FUNC "%6.3" "m/s¬≤" COEFFS 0. 1. 0. 0. 0. 4.e-004 /end COMPU_METHOD
/begin COMPU_METHOD _CNV_R_R_VA_F_1_p0__458_CM "" RAT_FUNC "%6.3" "s" COEFFS 0. 1. 0. 0. 0. 1. /end COMPU_METHOD
/begin COMPU_METHOD _CNV_R_R_VA_F_1_p0__459_CM "" RAT_FUNC "%6.3" "rpm" COEFFS 0. 1. 0. 0. 0. 1. /end COMPU_METHOD
/begin COMPU_METHOD _CNV_R_R_VA_F_0v1_m_460_CM "" RAT_FUNC "%6.3" "¬∞C" COEFFS 0. 1. 40. 0. 0. 0.1 /end COMPU_METHOD
/begin RECORD_LAYOUT _REC_S1VAL_20_u4 FNC_VALUES 1 ULONG COLUMN_DIR DIRECT /end RECORD_LAYOUT
/begin RECORD_LAYOUT _REC_S1VAL_20_u1 FNC_VALUES 1 UBYTE COLUMN_DIR DIRECT /end RECORD_LAYOUT
/begin RECORD_LAYOUT _REC_A2AXS_20_u1 NO_AXIS_PTS_X 1 UBYTE AXIS_PTS_X 2 UBYTE INDEX_INCR DIRECT /end RECORD_LAYOUT
/begin RECORD_LAYOUT _REC_S1VAL_20_u2 FNC_VALUES 1 UWORD COLUMN_DIR DIRECT /end RECORD_LAYOUT
/begin RECORD_LAYOUT _REC_S1VAL_20_s2 FNC_VALUES 1 SWORD COLUMN_DIR DIRECT /end RECORD_LAYOUT
/begin RECORD_LAYOUT _REC_A2AXS_20_u2 NO_AXIS_PTS_X 1 UWORD AXIS_PTS_X 2 UWORD INDEX_INCR DIRECT /end RECORD_LAYOUT
/begin RECORD_LAYOUT _REC_A1CUR_20_u1_u2 FNC_VALUES 1 UBYTE COLUMN_DIR DIRECT /end RECORD_LAYOUT
/begin RECORD_LAYOUT _REC_A1CUR_20_u1_u1 FNC_VALUES 1 UBYTE COLUMN_DIR DIRECT /end RECORD_LAYOUT
/begin RECORD_LAYOUT _REC_A1CUR_20_u2_u1 FNC_VALUES 1 UWORD COLUMN_DIR DIRECT /end RECORD_LAYOUT
/begin RECORD_LAYOUT _REC_A1MAP_20_u2_u2_u2 FNC_VALUES 1 UWORD COLUMN_DIR DIRECT /end RECORD_LAYOUT
/begin RECORD_LAYOUT _REC_A1CUR_20_u2_u2 FNC_VALUES 1 UWORD COLUMN_DIR DIRECT /end RECORD_LAYOUT
/begin RECORD_LAYOUT _REC_A1MAP_20_u1_u2_u2 FNC_VALUES 1 UBYTE COLUMN_DIR DIRECT /end RECORD_LAYOUT
/begin RECORD_LAYOUT _REC_S1VAL_20_s4 FNC_VALUES 1 SLONG COLUMN_DIR DIRECT /end RECORD_LAYOUT
/begin RECORD_LAYOUT _REC_S1VAL_20_s1 FNC_VALUES 1 SBYTE COLUMN_DIR DIRECT /end RECORD_LAYOUT
/begin RECORD_LAYOUT _REC_A1MAP_20_u2_u1_u2 FNC_VALUES 1 UWORD COLUMN_DIR DIRECT /end RECORD_LAYOUT
/begin RECORD_LAYOUT _REC_A1MAP_20_u2_u2_u1 FNC_VALUES 1 UWORD COLUMN_DIR DIRECT /end RECORD_LAYOUT
/begin RECORD_LAYOUT _REC_A1MAP_20_u1_u1_u2 FNC_VALUES 1 UBYTE COLUMN_DIR DIRECT /end RECORD_LAYOUT
/begin RECORD_LAYOUT _REC_A1CUR_20_s2_u1 FNC_VALUES 1 SWORD COLUMN_DIR DIRECT /end RECORD_LAYOUT
/begin RECORD_LAYOUT _REC_S1VAL_Normal_u1 FNC_VALUES 1 UBYTE COLUMN_DIR DIRECT /end RECORD_LAYOUT
/begin RECORD_LAYOUT _REC_S1VAL_Normal_s4 FNC_VALUES 1 SLONG COLUMN_DIR DIRECT /end RECORD_LAYOUT
/begin RECORD_LAYOUT _REC_S1VAL_Normal_u2 FNC_VALUES 1 UWORD COLUMN_DIR DIRECT /end RECORD_LAYOUT
/begin RECORD_LAYOUT _REC_S1VAL_Normal_s2 FNC_VALUES 1 SWORD COLUMN_DIR DIRECT /end RECORD_LAYOUT
/begin FUNCTION InPciCci_Swtchsr ""
 /begin DEF_CHARACTERISTIC Cbx_cru_sl_lk_rls_ena Cbx_cru_sl_swi_chr_prmt Cxx_cru_sl_acel_blk_dly Cxx_cru_sl_acel_max_thd Cxx_cru_sl_acel_min_thd Cxx_cru_sl_decl_blk_dly Cxx_cru_sl_decl_max_thd Cxx_cru_sl_decl_min_thd Cxx_cru_sl_lk_ena_dly Cxx_cru_sl_lk_vb_thd Cxx_cru_sl_open_min_thd Cxx_cru_sl_resu_blk_dly Cxx_cru_sl_resu_max_thd Cxx_cru_sl_resu_min_thd Cxx_cru_sl_rls_max_thd Cxx_cru_sl_rls_min_thd Cxx_cru_sl_susp_blk_dly Cxx_cru_sl_susp_max_thd Cxx_cru_sl_swi_dly Cxx_cru_sl_swi_igk_dly Cxx_cru_sl_whl_cmd_blk_ctr_max Cxx_cru_sl_whl_swi_dly Cxx_dfdec_cru_sl_swi_chr Cxx_dfdec_cru_whl_cmd Cxx_dfdec_cru_whl_cmd_nok Cxx_dfinc_cru_sl_swi_chr Cxx_dfinc_cru_whl_cmd Cxx_dfinc_cru_whl_cmd_nok /end DEF_CHARACTERISTIC
 /begin OUT_MEASUREMENT Vbx_cru_sl_acel_blk Vbx_cru_sl_decl_blk Vbx_cru_sl_lk_ena Vbx_cru_sl_new_lk_ena Vbx_cru_sl_resu_blk Vbx_cru_sl_susp_blk Vbx_cru_sl_whl_cmd_blk Vbx_df_cru_sl_swi_chr Vbx_df_cru_whl_cmd_nok Vbx_df_cru_whl_cmd_oc_scw Vbx_df_cru_whl_cmd_oor Vsx_cru_sl_on_off Vsx_cru_sl_on_off_raw Vsx_cru_sl_swi_vld Vxx_acc_cmd_stt Vxx_acc_swi Vxx_cru_sl_whl_cmd_raw Vxx_cru_sl_whl_cmd_stt Vxx_sta_swi_act_ctr /end OUT_MEASUREMENT
/end FUNCTION
/begin FUNCTION PcCruCtl ""
 /begin SUB_FUNCTION PcCruCtl_Safetyx PcCruCtl_Servoxx PcCruCtl_Slarbxx PcCruCtl_Fslsvxx /end SUB_FUNCTION
/end FUNCTION
/begin FUNCTION PcCruCtl_Safetyx ""
 /begin DEF_CHARACTERISTIC Cbx_bgin_clu_fail_ccp_ena Cbx_bgin_clu_fail_co_ena Cbx_brk_fail_ccp_ena Cbx_brk_fail_co_ena Cbx_ena_brk_cru_swi_cfm Cbx_ena_clu_cru_swi_cfm Cxx_bgin_clu_fail_ccp_dly Cxx_bgin_clu_fail_co_dly Cxx_brk_fail_ccp_dly Cxx_brk_fail_co_dly Cxx_cru_forc_sp_dly Cxx_cru_forc_sp_thd Cxx_dfdec_bgin_clu_cmp Cxx_dfdec_brk_pdl_cmp Cxx_dfdec_cru_cmp Cxx_dfinc_bgin_clu_cmp Cxx_dfinc_brk_pdl_cmp Cxx_dfinc_cru_cmp Cxx_wf_bgin_clu_rams_dly Cxx_wf_brk_rams_dly /end DEF_CHARACTERISTIC
 /begin OUT_MEASUREMENT Vbx_cru_swi Vxx_cru_cmp_diag Vbx_cru_cmp_bgin_clu Vbx_cru_cmp_forc_pres Vbx_cru_cmp_open_brk Vxx_cru_cmp_diag_new Vxx_cru_cmp_diag_prev Vxx_cru_forc_sp Vxx_cru_sl_stt Vxx_cru_sl_stt_ip Vxx_cru_sl_vs_sp Vxx_csl_forc_sp /end OUT_MEASUREMENT
/end FUNCTION
/begin FUNCTION PcCruCtl_Servoxx ""
 /begin DEF_CHARACTERISTIC Ctb_cru_sl_vs Ctp_dyn_forc Cbx_sl_max_i_cor Cxx_cru_cmf_cut_forc_dec Cxx_cru_min_forc Cxx_cru_ref_vs_acel_grd Cxx_cru_ref_vs_acel_ofs Cxx_cru_ref_vs_decl_grd Cxx_cru_ref_vs_decl_ofs Cxx_cru_sp_acel_grd Cxx_cru_sp_decl_grd Cxx_cru_sp_max_forc_inc Cxx_cru_svkl_ig Cxx_cru_svkl_max_i_cor Cxx_cru_svkl_min_i_cor Cxx_cru_svkl_pg Cxx_cru_svkl_vs_thd Cxx_sl_cmf_cut_forc_inc Cxx_sl_max_forc Cxx_sl_sp_max_forc_dec Cxx_sl_svkl_ig Cxx_sl_svkl_max_i_cor Cxx_sl_svkl_min_i_cor Cxx_sl_svkl_pg Cxx_sl_svkl_vs_thd Cxx_vh_wht /end DEF_CHARACTERISTIC
 /begin OUT_MEASUREMENT Vbx_cru_act Vbx_cru_mstr Vbx_cru_mstr_prev Vbx_cru_sl_svkl_act Vbx_csl_mstr Vxx_cru_fil_vs_ref Vxx_cru_fil_vs_ref_init Vxx_cru_fil_vs_ref_prev Vxx_cru_forc_sp_nom Vxx_cru_sl_dyn_forc_ini Vxx_cru_sl_fil_vs_ref Vxx_cru_sl_forc_ref Vxx_cru_sl_svkl_acel_ref Vxx_cru_sl_svkl_forc Vxx_cru_sl_svkl_forc_ref Vxx_cru_sl_svkl_ig Vxx_cru_sl_svkl_max_i_cor Vxx_cru_sl_svkl_min_i_cor Vxx_cru_sl_svkl_p_cor Vxx_cru_sl_svkl_pg Vxx_cru_sl_svkl_vs_i_cor Vxx_cru_sl_svkl_vs_i_cor_init Vxx_cru_sl_svkl_vs_i_cor_prev Vxx_cru_vs_ref_ofs Vxx_csl_forc_sp_nom Vxx_dyn_forc /end OUT_MEASUREMENT
/end FUNCTION
/begin FUNCTION PcCruCtl_Slarbxx "" /begin OUT_MEASUREMENT Vbx_sl_mstr Vxx_sl_forc_sp /end OUT_MEASUREMENT /end FUNCTION
/begin FUNCTION PcCruCtl_Fslsvxx "" /begin OUT_MEASUREMENT Vbx_fsl_mstr Vxx_fsl_forc_sp /end OUT_MEASUREMENT /end FUNCTION
/begin FUNCTION InAtiTbo "" /begin SUB_FUNCTION InAtiTbo_Gaztemp_xxxxxg /end SUB_FUNCTION /end FUNCTION
/begin FUNCTION InAtiTbo_Gaztemp_xxxxxg ""
 /begin DEF_CHARACTERISTIC Ntb_ex_gaz_temp Ntb_ex_gaz_temp_ofs_vs Ntb_map_cata_mdl_temp Ntb_n_cata_mdl_temp Cmp_ex_gaz_map_n_temp Ctp_ex_gaz_temp_ofs_maf Ctp_ex_gaz_temp_ofs_maf_l Ctp_ex_gaz_temp_ofs_vs Cxx_ex_gaz_fil_fac_inj /end DEF_CHARACTERISTIC
 /begin OUT_MEASUREMENT Vbx_cata_temp_rise Vbx_eng_aut Vsx_ex_gaz_temp_fil_val_vld Vxx_ex_gaz_fil_fac Vxx_ex_gaz_fil_fac_fall Vxx_ex_gaz_fil_fac_inj_cut Vxx_ex_gaz_fil_fac_rise Vxx_ex_gaz_map_n_temp Vxx_ex_gaz_temp_fil_val Vxx_ex_gaz_temp_fil_val_aut Vxx_ex_gaz_temp_fil_val_hold Vxx_ex_gaz_temp_fil_val_not_aut Vxx_ex_gaz_temp_ofs_vs Vxx_ex_gaz_temp_val Vxx_ex_gaz_temp_val_aut Vxx_ex_gaz_temp_val_not_aut /end OUT_MEASUREMENT
/end FUNCTION
/begin FUNCTION PcDrcOvt "" /begin SUB_FUNCTION PcDrcOvt_Drovtxx PcDrcOvt_Tkorixx /end SUB_FUNCTION /end FUNCTION
/begin FUNCTION PcDrcOvt_Drovtxx ""
 /begin DEF_CHARACTERISTIC Ctb_ovt_acel_pdl_dif_thd Ctp_ovt_acel_pdl_dif_thd Cbx_driv_ovt_req_100_rat_cfm Cbx_driv_ovt_req_dsb_cfm Cbx_driv_ovt_req_kd_cfm Cxx_ovt_acel_pdl_dif_t /end DEF_CHARACTERISTIC
 /begin OUT_MEASUREMENT Vbx_driv_ovt_req /end OUT_MEASUREMENT
/end FUNCTION
/begin FUNCTION PcDrcOvt_Tkorixx ""
 /begin DEF_CHARACTERISTIC Cxx_tkof_fl_mat_thd Cxx_tkof_map_hys Cxx_tkof_map_thd Cxx_tkof_n_h_thd Cxx_tkof_n_hys Cxx_tkof_n_l_thd /end DEF_CHARACTERISTIC
 /begin OUT_MEASUREMENT Vbx_tkof_fl_ena Vbx_tkof_fl_map_cdn Vbx_tkof_fl_mat_cdn Vbx_tkof_fl_n_cdn /end OUT_MEASUREMENT
/end FUNCTION
/begin FUNCTION InPciMgb "" /begin SUB_FUNCTION InPciMgb_Gecgexx InPciMgb_Schxxxx InPciMgb_Tqetgtx /end SUB_FUNCTION /end FUNCTION
/begin FUNCTION InPciMgb_Gecgexx ""
 /begin DEF_CHARACTERISTIC Cxx_gear_cge_dec_dly Cxx_gear_cge_sp_lim_dly Cxx_gear_cge_tqe_tgt_dly /end DEF_CHARACTERISTIC
 /begin OUT_MEASUREMENT Vbx_gear_cge_spv_on Vbx_gear_cge_tqe_sp_lim Vbx_gear_cge_tqe_tgt Vxx_gear_cge_fmt /end OUT_MEASUREMENT
/end FUNCTION
/begin FUNCTION InPciMgb_Schxxxx "" /begin DEF_CHARACTERISTIC Cbx_mgb_shf_ant_tq_cfm /end DEF_CHARACTERISTIC /begin OUT_MEASUREMENT Vbx_mgb_shf_ant_tq_cfm /end OUT_MEASUREMENT /end FUNCTION
/begin FUNCTION InPciMgb_Tqetgtx "" /begin DEF_CHARACTERISTIC Ctb_gear_cge_n_mv Cmp_gear_cge_tgt_tqe Cxx_mgb_max_tqe_tgt /end DEF_CHARACTERISTIC
 /begin OUT_MEASUREMENT Vbx_mgb_tqe_tgt_calc_on Vxx_mgb_max_tqe_tgt Vxx_mgb_min_tqe_tgt /end OUT_MEASUREMENT
/end FUNCTION
/begin FUNCTION CbRicDgn ""
 /begin OUT_MEASUREMENT Vxx_fsys_cpt_max Vxx_fsys_cpt_min Vxx_fsys_cpt_val Sxx_fsys_cor_ti_fac Sxx_fsys_cor_ti_fac_max Sxx_fsys_cor_ti_fac_min Vxx_cl_rich_chr_max Vxx_cl_rich_chr_val /end OUT_MEASUREMENT
 /begin SUB_FUNCTION CbRicDgn_Fuelxxx CbRicDgn_Ctlmonx CbRicDgn_Schxxxx /end SUB_FUNCTION
/end FUNCTION
/begin FUNCTION CbRicDgn_Fuelxxx ""
 /begin DEF_CHARACTERISTIC Ctb_fsys_n_5 Ctp_fsys_eal_min Cbx_conf_schd_diag_fsys Cbx_fsys_diag_conf Cxx_dfdec_fsys_cpt Cxx_dfinc_fsys_cpt Cxx_fsys_alco_dly_1 Cxx_fsys_alco_dly_2 Cxx_fsys_cor_fac_alco_max_1 Cxx_fsys_cor_fac_alco_max_2 Cxx_fsys_cor_fac_alco_min_1 Cxx_fsys_cor_fac_alco_min_2 Cxx_fsys_cor_fac_max_1 Cxx_fsys_cor_fac_max_2 Cxx_fsys_cor_fac_min_1 Cxx_fsys_cor_fac_min_2 Cxx_fsys_crit_alco_bal_1 Cxx_fsys_crit_alco_bal_2 Cxx_fsys_crit_alco_bal_3 Cxx_fsys_crit_bal_1 Cxx_fsys_crit_bal_2 Cxx_fsys_crit_bal_3 Cxx_fsys_crit_diag_alco_max_1 Cxx_fsys_crit_diag_alco_max_2 Cxx_fsys_crit_diag_alco_min_1 Cxx_fsys_crit_diag_alco_min_2 Cxx_fsys_crit_diag_max_1 Cxx_fsys_crit_diag_max_2 Cxx_fsys_crit_diag_min_1 Cxx_fsys_crit_diag_min_2 Cxx_fsys_dly_1 Cxx_fsys_dly_2 Cxx_fsys_eal_max_thd Cxx_fsys_fuel_typ_rat_max_1 Cxx_fsys_fuel_typ_rat_max_2 Cxx_fsys_fuel_typ_rat_min_1 Cxx_fsys_fuel_typ_rat_min_2 Cxx_fsys_n_max_thd Cxx_fsys_n_min_thd Cxx_fsys_tco_min_thd Cxx_fsys_thd_ad_fac_max Cxx_fsys_thd_ad_fac_min Cxx_fsys_thd_ad_ofs_max Cxx_fsys_thd_ad_ofs_min Cxx_fsys_win_nr_fail Cxx_fsys_win_nr_fail_alco Cxx_min_diag_fsys_dly /end DEF_CHARACTERISTIC
 /begin OUT_MEASUREMENT Vbx_df_fsys_cpt Vbx_diag_ena_fsys_cpt Vbx_dsb_diag_fsys_cpt Vbx_fsys_cond Vbx_fsys_req Vbx_trans_clf_fsys_cpt Vsx_fsys_stt Vsx_fsys_vld Vxx_diag_fsys_dsb_dly Vxx_fsys_cor_fac_max_1 Vxx_fsys_cor_fac_max_2 Vxx_fsys_cor_fac_min_1 Vxx_fsys_cor_fac_min_2 Vxx_fsys_cor_ti_fac Vxx_fsys_cor_ti_fac_clr Vxx_fsys_cor_ti_fac_ini Vxx_fsys_cor_ti_fac_max Vxx_fsys_cor_ti_fac_max_clr Vxx_fsys_cor_ti_fac_max_ini Vxx_fsys_cor_ti_fac_min Vxx_fsys_cor_ti_fac_min_clr Vxx_fsys_cor_ti_fac_min_ini Vxx_fsys_crit_bal_1 Vxx_fsys_crit_bal_2 Vxx_fsys_crit_bal_3 Vxx_fsys_crit_diag Vxx_fsys_crit_diag_clr Vxx_fsys_crit_diag_ini Vxx_fsys_crit_diag_max Vxx_fsys_crit_diag_max_1 Vxx_fsys_crit_diag_max_2 Vxx_fsys_crit_diag_max_clr Vxx_fsys_crit_diag_max_ini Vxx_fsys_crit_diag_med Vxx_fsys_crit_diag_med_1 Vxx_fsys_crit_diag_med_2 Vxx_fsys_crit_diag_med_3 Vxx_fsys_crit_diag_min Vxx_fsys_crit_diag_min_1 Vxx_fsys_crit_diag_min_2 Vxx_fsys_crit_diag_min_clr Vxx_fsys_crit_diag_min_ini Vxx_fsys_crit_diag_win Vxx_fsys_dft_dly Vxx_fsys_dly Vxx_fsys_dly_1 Vxx_fsys_dly_2 Vxx_fsys_no_dft_dly Vxx_fsys_win_ctr Vxx_fsys_win_nr_fail /end OUT_MEASUREMENT
/end FUNCTION
/begin FUNCTION CbRicDgn_Ctlmonx ""
 /begin DEF_CHARACTERISTIC Ctb_ctl_mon_tco Ctp_ctl_mon_t_max Cbx_conf_schd_diag_ctl_mon Cxx_dfdec_cl_rich_chr Cxx_dfinc_cl_rich_chr /end DEF_CHARACTERISTIC
 /begin OUT_MEASUREMENT Vbx_cl_mon_end Vbx_cl_mon_req Vbx_df_cl_rich_chr Vbx_diag_ena_cl_rich_chr Vsx_ctl_mon_stt Vxx_cl_rich_chr_max_clr Vxx_cl_rich_chr_max_ini Vxx_cl_rich_chr_val_clr Vxx_cl_rich_chr_val_ini Vxx_ctl_mon_t Vxx_ctl_mon_t_max Vxx_ctl_mon_thd_max /end OUT_MEASUREMENT
/end FUNCTION
/begin FUNCTION CbRicDgn_Schxxxx "" /begin DEF_CHARACTERISTIC Cbx_rich_clos_loop_mon_cfm /end DEF_CHARACTERISTIC /begin OUT_MEASUREMENT Vbx_rich_clos_loop_mon_cfm /end OUT_MEASUREMENT /end FUNCTION
/begin FUNCTION InTqiTlz ""
 /begin OUT_MEASUREMENT Vbx_tlz_ad_cor_ok Vbx_tlz_ad_b_done Vbx_tlz_ad_b_clc Vxx_tlz_ad_b_ok Vxx_tlz_ad_bkp_last Vxx_tlz_ad_b1_ctr_tdc Vxx_tlz_ad_b2_ctr_tdc Vxx_mis_n_max_thd_1_2 Vxx_tlz_ad_cor_ctr_tdc Vxx_tlz_ad_cor_fil Vxx_tlz_ad_cor_val Vxx_mis_km_dly Vxx_tlz_ad_b2_fil_1 Vxx_tlz_ad_b1_fil_2 Vxx_tlz_ad_b2_fil_2 Vxx_tlz_ad_b1_fil_1 Vxx_tlz_ad_b2_fil_3 Vxx_tlz_ad_b1_fil_3 Vxx_tlz_ad_b2_fil_4 Vxx_tlz_ad_b1_fil_4 Vxx_tlz_ad_b2_fil_5 Vxx_tlz_ad_b1_fil_5 Vxx_tlz_ad_b1_fil_6 Vxx_tlz_ad_b2_fil_6 Vxx_tlz_ad_b1_fil Vxx_tlz_ad_b2_fil /end OUT_MEASUREMENT
 /begin SUB_FUNCTION InTqiTlz_Aplcixx InTqiTlz_Aplcorx InTqiTlz_Betaxxx InTqiTlz_Ctlzxxx InTqiTlz_Obtlzco InTqiTlz_Tlzmfxx /end SUB_FUNCTION
/end FUNCTION
/begin FUNCTION InTqiTlz_Aplcixx ""
 /begin DEF_CHARACTERISTIC Ctb_n_tlz_ad_b Ntb_7 Ctd_mis_n_max_thd_1_2 Ctd_tlz_ad_b_ena Ctp_tlz_ad_b_grd_prs Cbx_ad_ini_req Cbx_tq_ini_req Cxx_dfdec_tlz_ad_b_cpt Cxx_dfinc_tlz_ad_b_cpt Cxx_tlz_ad_b_fil_fac Cxx_tlz_ad_b_max Cxx_tlz_ad_b_max_1 Cxx_tlz_ad_b_max_2 Cxx_tlz_ad_b_max_3 Cxx_tlz_ad_b_max_4 Cxx_tlz_ad_b_max_5 Cxx_tlz_ad_b_max_6 Cxx_tlz_ad_b_min Cxx_tlz_ad_b_min_1 Cxx_tlz_ad_b_min_2 Cxx_tlz_ad_b_min_3 Cxx_tlz_ad_b_min_4 Cxx_tlz_ad_b_min_5 Cxx_tlz_ad_b_min_6 Cxx_tlz_ad_b_n_max Cxx_tlz_ad_b_n_max_1 Cxx_tlz_ad_b_n_max_2 Cxx_tlz_ad_b_n_max_3 Cxx_tlz_ad_b_n_max_4 Cxx_tlz_ad_b_n_max_5 Cxx_tlz_ad_b_n_max_6 Cxx_tlz_ad_b_n_min Cxx_tlz_ad_b_n_min_1 Cxx_tlz_ad_b_n_min_2 Cxx_tlz_ad_b_n_min_3 Cxx_tlz_ad_b_n_min_4 Cxx_tlz_ad_b_n_min_5 Cxx_tlz_ad_b_n_min_6 Cxx_tlz_ad_b_nr_tdc Cxx_tlz_ad_b_slow_nr_tdc Cxx_tlz_b_ini Cxx_vs_n_rat_dif_max Cxx_vs_n_rat_dif_max_dly /end DEF_CHARACTERISTIC
 /begin OUT_MEASUREMENT Vbx_df_tlz_ad_b_cpt Vbx_tlz_ad_b_ena Vbx_tlz_ad_b_fast_stt_ena Vbx_tlz_ad_b_slow_stt_ena Vbx_tlz_ad_b_wat_stt_ena Vbx_tlz_fast_ad_b_ena Vbx_tlz_slow_ad_b_dsb Vbx_tlz_slow_ad_b_ena Vsx_tlz_ad_b_stt Vsx_tlz_ad_b_vld Vxx_tlz_ad_b1_dif Vxx_tlz_ad_b1_fil_prev Vxx_tlz_ad_b2_dif Vxx_tlz_ad_b2_fil_prev Vxx_tlz_ad_b_ctr_tdc Vxx_tlz_ad_b_dif Vxx_tlz_ad_b_fil Vxx_tlz_ad_b_slow_ctr_tdc Vxx_tlz_ad_bkp /end OUT_MEASUREMENT
/end FUNCTION
/begin FUNCTION InTqiTlz_Aplcorx ""
 /begin DEF_CHARACTERISTIC Cbx_tlz_ad_cor_conf Cxx_tlz_ad_cor_fil_fac Cxx_tlz_ad_cor_n_max Cxx_tlz_ad_cor_n_min Cxx_tlz_ad_cor_nr_tdc /end DEF_CHARACTERISTIC
 /begin OUT_MEASUREMENT Vbx_tlz_ad_cor_ena Vbx_tlz_ad_cor_ok_1 Vbx_tlz_stt_0_tmp Vbx_tlz_stt_1_tmp Vbx_tlz_stt_2_tmp Vsx_tlz_ad_cor_stt Vxx_tlz_ad_cor_dif /end OUT_MEASUREMENT
/end FUNCTION
/begin FUNCTION InTqiTlz_Betaxxx "" /begin DEF_CHARACTERISTIC Cxx_tlz_n_max Cxx_tlz_n_min /end DEF_CHARACTERISTIC
 /begin OUT_MEASUREMENT Vbx_tlz_b_clc_ena Vtx_tlz_ad_b_val[0] Vtx_tlz_ad_b_val[1] Vtx_tlz_ad_b_val[2] Vtx_tlz_ad_b_val[3] Vtx_tlz_ad_b_val[4] Vtx_tlz_ad_b_val[5] Vxx_tlz_b1_val Vxx_tlz_b2_val Vxx_tlz_b_val /end OUT_MEASUREMENT
/end FUNCTION
/begin FUNCTION InTqiTlz_Ctlzxxx "" /begin DEF_CHARACTERISTIC Cxx_tlz_a Cxx_tlz_cor_n_max /end DEF_CHARACTERISTIC
 /begin OUT_MEASUREMENT Vbx_tlz_clc Vbx_tlz_err Vbx_tlz_l_n_clc_ena Vbx_tlz_off_stt Vbx_tlz_raw_clc Vbx_tlz_raw_err Vsx_tlz_clc_stt Vxx_tlz_b_cor Vxx_tlz_cor_tmp Vxx_tlz_raw_val Vxx_tlz_val Vxx_tlz_val_tmp /end OUT_MEASUREMENT
/end FUNCTION
/begin FUNCTION InTqiTlz_Obtlzco ""
 /begin DEF_CHARACTERISTIC Ctb_mis_tlz_cor_eal Ctb_mis_tlz_cor_n Cmp_mis_tlz_cor_cyl_0 Cmp_mis_tlz_cor_cyl_1 Cmp_mis_tlz_cor_cyl_2 Cxx_mis_km_dly /end DEF_CHARACTERISTIC
 /begin OUT_MEASUREMENT Vbx_mis_km_ena Vbx_mis_tlz_cor_ena Vxx_mis_tlz_cor Vxx_mis_tlz_val_cor /end OUT_MEASUREMENT
/end FUNCTION
/begin FUNCTION InTqiTlz_Tlzmfxx ""
 /begin DEF_CHARACTERISTIC Ctb_dft_comb_eal Ctb_mis_n_17 Cmp_det_thd_tlz_dif Cmp_det_thd_tlz_dif_agb Cmp_det_thd_tlz_dif_lpg Ctp_tlz_fil_fac Ctp_tlz_fil_fac_lpg Ctp_tlz_fil_rst_eal_dif Cxx_tlz_fil_rat Cxx_tlz_fil_rat_lpg Cxx_tlz_fil_rst_n_dif_thd /end DEF_CHARACTERISTIC
 /begin OUT_MEASUREMENT Vbx_mis_fil_rst_eal_dif Vbx_mis_fil_rst_eal_dif2 Vbx_mis_fil_rst_n_dif Vbx_mis_fil_rst_n_dif2 Vbx_mis_stat_fil Vbx_mis_stat_fil4 Vbx_mis_tlz_fil_rst Vsx_mis_tlz_vld Vxx_mis_tlz_dif Vxx_mis_tlz_fil_mes Vxx_mis_tlz_fil_mes1 Vxx_mis_tlz_fil_mes2 Vxx_mis_tlz_fil_mes3 Vxx_mis_tlz_fil_mes4 /end OUT_MEASUREMENT
/end FUNCTION
/begin FUNCTION TqLimPmx "" /begin SUB_FUNCTION TqLimPmx_Fstqprj_xxxxxx /end SUB_FUNCTION /end FUNCTION
/begin FUNCTION TqLimPmx_Fstqprj_xxxxxx ""
 /begin OUT_MEASUREMENT Vbx_tq_rams_lim_spc_act_1 Vbx_tq_rams_lim_spc_act_2 Vbx_tq_rams_lim_spc_act_3 /end OUT_MEASUREMENT
/end FUNCTION
/begin FUNCTION PcDrcOpo ""
 /begin SUB_FUNCTION PcDrcOpo_Fsapgxx_xxxxxx PcDrcOpo_Fsfofxx_xxxxxx PcDrcOpo_Fsapmxx_xxxxxx PcDrcOpo_Fscurxx_xxxxxx PcDrcOpo_Fsdisxx_xxxxxx PcDrcOpo_Fsdlyxx_xxxxxx PcDrcOpo_Fsfonxx_xxxxxx PcDrcOpo_Fsgihxx_xxxxxx PcDrcOpo_Fslawxx_xxxxxx PcDrcOpo_Fslslxx_xxxxxx PcDrcOpo_Fspfzxx_xxxxxx PcDrcOpo_Schxxxx_xxxxxx /end SUB_FUNCTION
/end FUNCTION
/begin FUNCTION PcDrcOpo_Fsapgxx_xxxxxx ""
 /begin DEF_CHARACTERISTIC Ctb_n_apmp Ctp_apmp_max_pow Ctp_n_lim_apmp_down_shf Cxx_down_shf_pow_rat Cxx_max_pow_fs Cxx_n_lim_apmp_down_shf_hys Cxx_pow_apmp_hys Cxx_up_shf_pow_rat /end DEF_CHARACTERISTIC
 /begin OUT_MEASUREMENT Vbx_apmp_down_shf Vbx_apmp_up_shf Vxx_apmp_gear Vxx_gear_lim Vxx_gear_lim_inc Vxx_max_avl_pow Vxx_max_avl_pow_inc Vxx_max_avl_pow_rat Vxx_n_gear Vxx_n_gear_inc Vxx_pow_r_req_down Vxx_pow_r_req_up /end OUT_MEASUREMENT
/end FUNCTION
/begin FUNCTION PcDrcOpo_Fsfofxx_xxxxxx ""
 /begin DEF_CHARACTERISTIC Ctb_fast_off_pdl_grd Ctb_law Cmp_fast_off_law_pdl_grd_dly Ctp_fast_off_kd_n_thd Ctp_fast_off_no_pdl_dly Cbx_fast_off_ena_cfm Cbx_fast_off_kd_ena_cfm Cxx_fast_off_kd_pdl_thd Cxx_free_shf_no_pdl_fast_off Cxx_pdl_grd_in_neg_thd Cxx_pdl_grd_out_neg_thd Cxx_up_shf_dly /end DEF_CHARACTERISTIC
 /begin OUT_MEASUREMENT Vsx_fast_off_free_shf_mod Vsx_stt_fast_off Vxx_dly_frz_gear_sel Vxx_fast_off_dly Vxx_fast_off_gear_sel Vxx_fast_off_kd_n_thd Vxx_fast_off_max_dly Vxx_fast_off_no_pdl_dly Vxx_t_fast_off Vxx_t_no_pdl Vxx_t_up_shf_dly /end OUT_MEASUREMENT
/end FUNCTION
/begin FUNCTION PcDrcOpo_Fsapmxx_xxxxxx "" /begin DEF_CHARACTERISTIC Cbx_apmp_ena_cfm /end DEF_CHARACTERISTIC /begin OUT_MEASUREMENT Vsx_apmp_free_shf_mod Vxx_apmp_gear_sel /end OUT_MEASUREMENT /end FUNCTION
/begin FUNCTION PcDrcOpo_Fscurxx_xxxxxx ""
 /begin DEF_CHARACTERISTIC Ctb_cur_spd Cmp_cur_tra_acel_thd Ctp_cur_dly Cxx_cur_tra_acel_hys Cxx_tra_acel_cur_fil /end DEF_CHARACTERISTIC
 /begin OUT_MEASUREMENT Vbx_up_shf_blk_cur Vxx_cur_dly Vxx_cur_tra_acel_thd Vxx_t_cur Vxx_t_max_cur Vxx_tra_acel_abs Vxx_tra_acel_abs_vld /end OUT_MEASUREMENT
/end FUNCTION
/begin FUNCTION PcDrcOpo_Fsdisxx_xxxxxx ""
 /begin DEF_CHARACTERISTIC Ctp_sta_dspl_arw_up_dly Cxx_max_dspl_arw_cyc_nr Cxx_max_dspl_arw_down_dly Cxx_max_dspl_arw_up_dly Cxx_min_dspl_arw_down_dly Cxx_min_dspl_arw_up_dly Cxx_rest_dspl_arw_down_dly Cxx_rest_dspl_arw_up_dly Cxx_sta_dspl_arw_down_dly /end DEF_CHARACTERISTIC
 /begin OUT_MEASUREMENT Vbx_arw_down Vbx_arw_down_raw Vbx_arw_up Vbx_arw_up_raw Vsx_free_shf_dspl Vxx_ctr_dspl_up Vxx_min_dspl_arw_up_dly Vxx_sta_dspl_arw_up_dly Vxx_t_max_arw_down Vxx_t_max_arw_up Vxx_t_min_arw_down Vxx_t_min_arw_up Vxx_t_rest_arw_down Vxx_t_rest_arw_up Vxx_t_sta_arw_down Vxx_t_sta_arw_up /end OUT_MEASUREMENT
/end FUNCTION
/begin FUNCTION PcDrcOpo_Fsdlyxx_xxxxxx ""
 /begin DEF_CHARACTERISTIC Ctp_gear_pdl_no_seq_dly Cbx_dly_ena_cfm Cxx_down_shf_no_seq_dly Cxx_driv_ant_dly /end DEF_CHARACTERISTIC
 /begin OUT_MEASUREMENT Vbx_dly_ini Vsx_no_seq_free_shf_mod Vsx_stt_dly Vxx_fast_off_gear_sel_bk Vxx_gear_bk Vxx_no_seq_gear_sel Vxx_t_ant Vxx_t_no_seq_down_shf Vxx_t_no_seq_up_shf Vxx_up_shf_no_seq_dly /end OUT_MEASUREMENT
/end FUNCTION
/begin FUNCTION PcDrcOpo_Fsfonxx_xxxxxx ""
 /begin DEF_CHARACTERISTIC Cbx_fast_on_ena_cfm Cxx_free_shf_no_pdl_fast_on Cxx_pdl_fast_on_kd_thd Cxx_pdl_grd_fast_on_thd Cxx_pdl_grd_fil /end DEF_CHARACTERISTIC
 /begin OUT_MEASUREMENT Vsx_fast_on_free_shf_mod Vsx_stt_fast_on Vxx_dly_gear_sel Vxx_fast_on_gear_sel Vxx_pdl_grd /end OUT_MEASUREMENT
/end FUNCTION
/begin FUNCTION PcDrcOpo_Fsgihxx_xxxxxx ""
 /begin DEF_CHARACTERISTIC Cbx_cru_blk_cfm Cbx_cur_ena_cfm Cbx_down_shf_blk_cur_cfm Cbx_gear_blk_cfm Cbx_wal_1_req_fs_cfm Cxx_max_decl /end DEF_CHARACTERISTIC
 /begin OUT_MEASUREMENT Vbx_free_shf_dft Vsx_frz_free_shf_mod Vxx_frz_gear_sel /end OUT_MEASUREMENT
/end FUNCTION
/begin FUNCTION PcDrcOpo_Fslawxx_xxxxxx ""
 /begin DEF_CHARACTERISTIC Ctb_down_shf_pdl Ctb_up_shf_pdl Ctp_brk_ass_fac Ctp_dhil_n_up_shf_in_thd Ctp_dhil_n_up_shf_out_thd Ctp_dhil_vs_down_shf_thd Ctp_law_eco_1_2 Ctp_law_eco_2_1 Ctp_law_eco_2_3 Ctp_law_eco_3_2 Ctp_law_eco_3_4 Ctp_law_eco_4_3 Ctp_law_eco_4_5 Ctp_law_eco_5_4 Ctp_law_eco_5_6 Ctp_law_eco_6_5 Ctp_law_uhil_1_2 Ctp_law_uhil_2_1 Ctp_law_uhil_2_3 Ctp_law_uhil_3_2 Ctp_law_uhil_3_4 Ctp_law_uhil_4_3 Ctp_law_uhil_4_5 Ctp_law_uhil_5_4 Ctp_law_uhil_5_6 Ctp_law_uhil_6_5 Ctp_law_wup_cata_1_2 Ctp_law_wup_cata_2_1 Ctp_law_wup_cata_2_3 Ctp_law_wup_cata_3_2 Ctp_law_wup_cata_3_4 Ctp_law_wup_cata_4_3 Ctp_law_wup_cata_4_5 Ctp_law_wup_cata_5_4 Ctp_law_wup_cata_5_6 Ctp_law_wup_cata_6_5 Ctp_law_xurb_1_2 Ctp_law_xurb_2_1 Ctp_law_xurb_2_3 Ctp_law_xurb_3_2 Ctp_law_xurb_3_4 Ctp_law_xurb_4_3 Ctp_law_xurb_4_5 Ctp_law_xurb_5_4 Ctp_law_xurb_5_6 Ctp_law_xurb_6_5 Ctp_min_vs_decl Ctp_v1000 Cbx_brk_ass_ena_cfm Cxx_acel_in_brk_ass_thd Cxx_acel_out_brk_ass_thd Cxx_free_shf_no_pdl Cxx_free_shf_no_pdl_brk_ass Cxx_gear_max Cxx_lg_acel_law_fil /end DEF_CHARACTERISTIC
 /begin OUT_MEASUREMENT Vbx_forc_gear_1 Vsx_law_free_shf_mod Vsx_stt_dhil Vxx_ant_vs Vxx_dhil_gear_sel Vxx_dhil_n_up_shf_in_thd Vxx_dhil_n_up_shf_out_thd Vxx_dhil_vs_down_shf_thd Vxx_gear_sel Vxx_law_gear_sel Vxx_n_dhil Vxx_vs_thd_1_2 Vxx_vs_thd_2_1 Vxx_vs_thd_2_3 Vxx_vs_thd_3_2 Vxx_vs_thd_3_4 Vxx_vs_thd_4_3 Vxx_vs_thd_4_5 Vxx_vs_thd_5_4 Vxx_vs_thd_5_6 Vxx_vs_thd_6_5 /end OUT_MEASUREMENT
/end FUNCTION
/begin FUNCTION PcDrcOpo_Fslslxx_xxxxxx ""
 /begin DEF_CHARACTERISTIC Cxx_dhil_flat_thd Cxx_flat_dhil_thd Cxx_flat_uhil_thd Cxx_law_sel_cfm Cxx_mv_vs_dec_fil Cxx_mv_vs_inc_fil Cxx_n_run_thd Cxx_tco_thd Cxx_uhil_flat_thd Cxx_vs_eco_xurb_thd Cxx_vs_xurb_eco_thd Cxx_wup_cata_dly /end DEF_CHARACTERISTIC
 /begin OUT_MEASUREMENT Vbx_out_tco Vbx_sta_tco_ena Vbx_wup_cata_dsb Vbx_wup_cata_ena Vsx_law_sel Vsx_load_lvl Vsx_road_typ Vxx_tco_ctr Vxx_vs_mv /end OUT_MEASUREMENT
/end FUNCTION
/begin FUNCTION PcDrcOpo_Fspfzxx_xxxxxx "" /begin DEF_CHARACTERISTIC Ctp_pdl_cru_max_lim Cxx_pdl_cru_min_lim /end DEF_CHARACTERISTIC
 /begin OUT_MEASUREMENT Vxx_dly_driv_pwt_sp_100 Vxx_driv_pwt_sp_100 Vxx_free_shf_pdl /end OUT_MEASUREMENT
/end FUNCTION
/begin FUNCTION PcDrcOpo_Schxxxx_xxxxxx "" /begin DEF_CHARACTERISTIC Cbx_free_shf_dsb_cfm /end DEF_CHARACTERISTIC /begin OUT_MEASUREMENT Vbx_free_shf_dsb /end OUT_MEASUREMENT /end FUNCTION
/begin FUNCTION PcDrCRds "" /begin SUB_FUNCTION PcDrCRds_Fstqdxx_xxxxxx /end SUB_FUNCTION /end FUNCTION
/end MODULE
/end PROJECT
