ASAP2_VERSION 1 41
/begin PROJECT RD8 "_default_ProjectLongIdentifier"
/begin HEADER "_default_HeaderComment" PROJECT_NO RD9 /end HEADER
/begin MODULE _default_ModuleName "_default_ModuleLongIdentifier"
/begin MOD_COMMON "_default_ModCommonComment" DEPOSIT ABSOLUTE BYTE_ORDER MSB_LAST ALIGNMENT_BYTE 1 ALIGNMENT_WORD 2 ALIGNMENT_LONG 2 ALIGNMENT_FLOAT32_IEEE 2 ALIGNMENT_FLOAT64_IEEE 4 /end MOD_COMMON
/begin CHARACTERISTIC Cmp_eal_n_lamb_v "Map of command voltage of the loop down (fonction of engine air load and engine speed)" MAP 0xa002b678 _REC_A1MAP_20_u2_u2_u2 25000. _CNV_A_R_LINEAR_____52_CM 0. 25000. FORMAT "%5.0"
 /begin AXIS_DESCR COM_AXIS Vxx_eal _CNV_A_R_LINEAR_____53_CM 16 0. 3.99993896484375 FORMAT "%10.8" AXIS_PTS_REF Ctb_eal /end AXIS_DESCR
 /begin AXIS_DESCR COM_AXIS Vxx_n _CNV_A_R_ENSD_LINEA_24_CM 9 0. 16383.75 FORMAT "%8.2" AXIS_PTS_REF Ctb_n2 /end AXIS_DESCR
/end CHARACTERISTIC
/begin CHARACTERISTIC Cmp_eal_n_lamb_v_lpg "Map of command voltage of the loop down in LPG mode (fonction of engine air load and engine speed)" MAP 0xa002b798 _REC_A1MAP_20_u2_u2_u2 25000. _CNV_A_R_LINEAR_____52_CM 0. 25000. FORMAT "%5.0"
 /begin AXIS_DESCR COM_AXIS Vxx_eal _CNV_A_R_LINEAR_____53_CM 16 0. 3.99993896484375 FORMAT "%10.8" AXIS_PTS_REF Ctb_eal /end AXIS_DESCR
 /begin AXIS_DESCR COM_AXIS Vxx_n _CNV_A_R_ENSD_LINEA_24_CM 9 0. 16383.75 FORMAT "%8.2" AXIS_PTS_REF Ctb_n2 /end AXIS_DESCR
/end CHARACTERISTIC
/begin CHARACTERISTIC Ctp_tco_cl2_ena_ctr "Table of the necessary tdc number to warm up the catalyst" CURVE 0xa002b8b8 _REC_A1CUR_20_u2_u2 65535. _CNV_A_R_ECME_LINEA_0_CM 0. 65535. FORMAT "%5.0"
 /begin AXIS_DESCR COM_AXIS Vxx_tco _CNV_A_R_LINEAR_____54_CM 9 -40. 200. FORMAT "%5.1" AXIS_PTS_REF Ctb_tco2 /end AXIS_DESCR
/end CHARACTERISTIC
/begin CHARACTERISTIC Ctp_tco_cl2_ena_ctr_lpg "Table of the necessary tdc number to warm up the catalyst in LPG mode" CURVE 0xa002b8cc _REC_A1CUR_20_u2_u2 65535. _CNV_A_R_ECME_LINEA_0_CM 0. 65535. FORMAT "%5.0"
 /begin AXIS_DESCR COM_AXIS Vxx_tco _CNV_A_R_LINEAR_____54_CM 9 -40. 200. FORMAT "%5.1" AXIS_PTS_REF Ctb_tco2 /end AXIS_DESCR
/end CHARACTERISTIC
/begin MEASUREMENT Vbx_ofs2_ena "The calculation conditions of mean offset double loop are satisfied (=1)." UBYTE _CNV_S_2_RANGE______3_CM 1 0. 0. 1. ECU_ADDRESS 0xd0005458 BIT_MASK 0x1 /end MEASUREMENT
/begin MEASUREMENT Vbx_ti_cl2_act "Double loop activated" UBYTE _CNV_S_2_RANGE______3_CM 1 0. 0. 1. ECU_ADDRESS 0xd0005459 BIT_MASK 0x1 /end MEASUREMENT
/begin MEASUREMENT Vxx_cl2_act_ctr "Activation time of the double loop." UWORD _CNV_A_R_LINEAR_____4_CM 1 0. 0. 6553.5 ECU_ADDRESS 0xd0005ac2 FORMAT "%6.1" /end MEASUREMENT
/begin MEASUREMENT Vxx_cl2_ena_ctr "TDC counter before the activation of the double loop" UWORD _CNV_A_R_LINEAR_____55_CM 1 0. 0. 65535. ECU_ADDRESS 0xd0003228 FORMAT "%5.0" /end MEASUREMENT
/begin MEASUREMENT Vxx_dbl_lbdw_v_fil "Lambda down voltage filtered for the double loop" UWORD _CNV_A_R_LINEAR_____52_CM 1 0. 0. 25000. ECU_ADDRESS 0xd0005ac4 FORMAT "%5.0" /end MEASUREMENT
/begin MEASUREMENT Vxx_lbdw_v_sp "Command voltage of the down double loop" UWORD _CNV_A_R_LINEAR_____52_CM 1 0. 0. 25000. ECU_ADDRESS 0xd0005ac6 FORMAT "%5.0" /end MEASUREMENT
/begin MEASUREMENT Vxx_mv_ti_ofs2_cor "Mean offset of the double loop." SWORD _CNV_A_R_LINEAR_____56_CM 1 0. -0.333333333238019 0.33332316071198 ECU_ADDRESS 0xd0005ac8 FORMAT "%8.5" /end MEASUREMENT
/begin MEASUREMENT Vxx_ti_i2_cor "Integral term of the double loop regulator." SWORD _CNV_A_R_LINEAR_____56_CM 1 0. -0.333333333238019 0.33332316071198 ECU_ADDRESS 0xd0005aca FORMAT "%8.5" /end MEASUREMENT
/begin MEASUREMENT Vxx_ti_ofs2_cor "Double loop offset." SWORD _CNV_A_R_LINEAR_____56_CM 1 0. -0.333333333238019 0.33332316071198 ECU_ADDRESS 0xd0005acc FORMAT "%8.5" /end MEASUREMENT
/begin MEASUREMENT Vxx_ti_p2_cor "Proportional term of the double loop regulator" SWORD _CNV_A_R_LINEAR_____56_CM 1 0. -0.333333333238019 0.33332316071198 ECU_ADDRESS 0xd0005ace FORMAT "%8.5" /end MEASUREMENT
/begin CHARACTERISTIC Cbx_ti_cl2_cfm "Soft configuration with double loop" VALUE 0xa00218ac _REC_S1VAL_20_u1 1. _CNV_A_R_ECME_LINEA_0_CM 0. 1. FORMAT "%1.0" BIT_MASK 0x1 /end CHARACTERISTIC
/begin CHARACTERISTIC Cxx_cl2_act_ctr "Conditions time of the activated double loop." VALUE 0xa0021888 _REC_S1VAL_20_u2 6553.5 _CNV_A_R_LINEAR_____4_CM 0. 6553.5 FORMAT "%6.1" /end CHARACTERISTIC
/begin CHARACTERISTIC Cxx_cl2_asd_map_thd "Minimum manifold pressure to satisfy the double loop conditions in After-Sales Department" VALUE 0xa002188a _REC_S1VAL_20_u2 20000. _CNV_A_R_LINEAR_____57_CM 0. 20000. FORMAT "%5.0" /end CHARACTERISTIC
/begin CHARACTERISTIC Cxx_cl2_ena_ctr "Number of necessary tdc to warm up the catalyser" VALUE 0xa002188c _REC_S1VAL_20_u2 65535. _CNV_A_R_LINEAR_____55_CM 0. 65535. FORMAT "%5.0" /end CHARACTERISTIC
/begin CHARACTERISTIC Cxx_cl2_map_thd "Minimum manifold pressure to start the double loop" VALUE 0xa002188e _REC_S1VAL_20_u2 20000. _CNV_A_R_LINEAR_____57_CM 0. 20000. FORMAT "%5.0" /end CHARACTERISTIC
/begin CHARACTERISTIC Cxx_cl2_n_thd "Minimum engine speed to start the double loop" VALUE 0xa00218ad _REC_S1VAL_20_u1 8160. _CNV_A_R_LINEAR_____2_CM 0. 8160. FORMAT "%4.0" /end CHARACTERISTIC
/begin CHARACTERISTIC Cxx_diag_fil_ti_ofs2_fac1 "Filter factor of the mean offset double loop during the diagnostic" VALUE 0xa00218ae _REC_S1VAL_20_u1 0.99609375 _CNV_A_R_LINEAR_____31_CM 0. 0.99609375 FORMAT "%5.3" /end CHARACTERISTIC
/begin CHARACTERISTIC Cxx_diag_fil_ti_ofs2_fac2 "Filter factor of the mean offset double loop in condition of the diagnostic" VALUE 0xa00218af _REC_S1VAL_20_u1 0.99609375 _CNV_A_R_LINEAR_____31_CM 0. 0.99609375 FORMAT "%5.3" /end CHARACTERISTIC
/begin CHARACTERISTIC Cxx_dyn_prs_fil_ofs2 "Max manifold pressure stability in order to filter the offset double loop." VALUE 0xa0021890 _REC_S1VAL_20_u2 20000. _CNV_A_R_LINEAR_____57_CM 0. 20000. FORMAT "%5.0" /end CHARACTERISTIC
/begin CHARACTERISTIC Cxx_fil_ti_ofs2_fac "Filter factor of the mean offset double loop out of the diagnostic conditions." VALUE 0xa00218b0 _REC_S1VAL_20_u1 0.99609375 _CNV_A_R_LINEAR_____31_CM 0. 0.99609375 FORMAT "%5.3" /end CHARACTERISTIC
/begin CHARACTERISTIC Cxx_lbdw_fil_fac "Calibration of time constant for the first order filter" VALUE 0xa0021892 _REC_S1VAL_20_u2 65.535 _CNV_A_R_LINEAR_____58_CM 0. 65.535 FORMAT "%5.3" /end CHARACTERISTIC
/begin CHARACTERISTIC Cxx_max_diag_ti_ofs1 "High limit of Vxx_ti_ofs2_cor (Offset Double Loop) in \"Measures\" state of the lambda diagnostic (PHDGSO2=30)" VALUE 0xa0021894 _REC_S1VAL_20_s2 0.666656493949999 _CNV_A_R_LINEAR_____56_CM -0.333333333238019 0.33332316071198 FORMAT "%8.5" /end CHARACTERISTIC
/begin CHARACTERISTIC Cxx_max_is_ti_ofs2 "High limit of Vxx_ti_ofs2_cor (Offset Double Loop) in \"Measures\" state of the lambda diagnostic (PHDGSO2=30)" VALUE 0xa0021896 _REC_S1VAL_20_s2 0.666656493949999 _CNV_A_R_LINEAR_____56_CM -0.333333333238019 0.33332316071198 FORMAT "%8.5" /end CHARACTERISTIC
/begin CHARACTERISTIC Cxx_max_n_fil_ofs2 "High limit of Vxx_ti_ofs2_cor (Offset Double Loop) in idle speed" VALUE 0xa0021898 _REC_S1VAL_20_u2 16383.75 _CNV_A_R_ENSD_LINEA_24_CM 0. 16383.75 FORMAT "%8.2" /end CHARACTERISTIC
/begin CHARACTERISTIC Cxx_max_prs_fil_ofs2 "Maximum predicted pressure for the offset double loop filter." VALUE 0xa002189a _REC_S1VAL_20_u2 20000. _CNV_A_R_LINEAR_____57_CM 0. 20000. FORMAT "%5.0" /end CHARACTERISTIC
/begin CHARACTERISTIC Cxx_max_tco_fil_ofs2 "Maximum coolant temperature for the offset double loop filter." VALUE 0xa002189c _REC_S1VAL_20_u2 240. _CNV_A_R_LINEAR_____54_CM -40. 200. FORMAT "%5.1" /end CHARACTERISTIC
/begin CHARACTERISTIC Cxx_max_ti_ofs1 "High limit of the offset double loop (Vxx_ti_ofs2_cor)" VALUE 0xa002189e _REC_S1VAL_20_s2 0.666656493949999 _CNV_A_R_LINEAR_____56_CM -0.333333333238019 0.33332316071198 FORMAT "%8.5" /end CHARACTERISTIC
/begin CHARACTERISTIC Cxx_min_diag_ti_ofs2 "Low limit of the offset double loop (Vxx_ti_ofs2_cor) in \"Measures\" state of the lambda diagnostic (PHDGSO2=30)" VALUE 0xa00218a0 _REC_S1VAL_20_s2 0.666656493949999 _CNV_A_R_LINEAR_____56_CM -0.333333333238019 0.33332316071198 FORMAT "%8.5" /end CHARACTERISTIC
/begin CHARACTERISTIC Cxx_min_is_ti_ofs2 "Low limit of the offset double loop (Vxx_ti_ofs2_cor) in \"Measures\" state of the lambda diagnostic (PHDGSO2=30)" VALUE 0xa00218a2 _REC_S1VAL_20_s2 0.666656493949999 _CNV_A_R_LINEAR_____56_CM -0.333333333238019 0.33332316071198 FORMAT "%8.5" /end CHARACTERISTIC
/begin CHARACTERISTIC Cxx_min_n_fil_ofs2 "Low limit of the offset double loop (Vxx_ti_ofs2_cor) in idle speed" VALUE 0xa00218a4 _REC_S1VAL_20_u2 16383.75 _CNV_A_R_ENSD_LINEA_24_CM 0. 16383.75 FORMAT "%8.2" /end CHARACTERISTIC
/begin CHARACTERISTIC Cxx_min_prs_fil_ofs2 "Minmum predicted pressure for the offset double loop filter." VALUE 0xa00218a6 _REC_S1VAL_20_u2 20000. _CNV_A_R_LINEAR_____57_CM 0. 20000. FORMAT "%5.0" /end CHARACTERISTIC
/begin CHARACTERISTIC Cxx_min_tco_fil_ofs2 "Minimum coolant temperature for the offset double loop filter." VALUE 0xa00218a8 _REC_S1VAL_20_u2 240. _CNV_A_R_LINEAR_____54_CM -40. 200. FORMAT "%5.1" /end CHARACTERISTIC
/begin CHARACTERISTIC Cxx_min_ti_ofs2 "Low limit of the offset double loop (Vxx_ti_ofs2_cor)" VALUE 0xa00218aa _REC_S1VAL_20_s2 0.666656493949999 _CNV_A_R_LINEAR_____56_CM -0.333333333238019 0.33332316071198 FORMAT "%8.5" /end CHARACTERISTIC
/begin CHARACTERISTIC Cxx_ti_i2_cor_fac "Gain int√©gral du correcteur double boucle" VALUE 0xa00218b1 _REC_S1VAL_20_u1 9.960937500000001e-007 _CNV_A_R_LINEAR_____59_CM 0. 9.960937500000001e-007 FORMAT "%16.14" /end CHARACTERISTIC
/begin CHARACTERISTIC Cxx_ti_p2_cor_fac "Gain proportionnel du correcteur double boucle." VALUE 0xa00218b2 _REC_S1VAL_20_u1 2.98828125e-004 _CNV_A_R_LINEAR_____60_CM 0. 2.98828125e-004 FORMAT "%14.12" /end CHARACTERISTIC
/begin AXIS_PTS Ctb_eal2 "9 breakpoint table for Engine air load" 0xa0026c14 Vxx_eal _REC_A2AXS_20_u2 3.99993896484375 _CNV_A_R_LINEAR_____53_CM 9 0. 3.99993896484375 FORMAT "%10.8" /end AXIS_PTS
/begin CHARACTERISTIC Cmp_n_eal_ti_ofs1 "Map of offset to be applied on richness closed loop. Vehicule stopped." MAP 0xa0026c28 _REC_A1MAP_20_u2_u2_u2 0.666656493949999 _CNV_A_R_LINEAR_____61_CM -0.333333333238019 0.33332316071198 FORMAT "%8.5"
 /begin AXIS_DESCR COM_AXIS Vxx_eal _CNV_A_R_LINEAR_____53_CM 16 0. 3.99993896484375 FORMAT "%10.8" AXIS_PTS_REF Ctb_eal /end AXIS_DESCR
 /begin AXIS_DESCR COM_AXIS Vxx_n _CNV_A_R_ENSD_LINEA_24_CM 9 0. 16383.75 FORMAT "%8.2" AXIS_PTS_REF Ctb_n2 /end AXIS_DESCR
/end CHARACTERISTIC
/begin CHARACTERISTIC Cmp_n_eal_ti_ofs1_lpg "Map of offset to be applied on richness closed loop. Vehicule stopped. (Exotic fuel settings)" MAP 0xa0026d48 _REC_A1MAP_20_u2_u2_u2 0.666656493949999 _CNV_A_R_LINEAR_____61_CM -0.333333333238019 0.33332316071198 FORMAT "%8.5"
 /begin AXIS_DESCR COM_AXIS Vxx_eal _CNV_A_R_LINEAR_____53_CM 16 0. 3.99993896484375 FORMAT "%10.8" AXIS_PTS_REF Ctb_eal /end AXIS_DESCR
 /begin AXIS_DESCR COM_AXIS Vxx_n _CNV_A_R_ENSD_LINEA_24_CM 9 0. 16383.75 FORMAT "%8.2" AXIS_PTS_REF Ctb_n2 /end AXIS_DESCR
/end CHARACTERISTIC
/begin CHARACTERISTIC Cmp_n_eal_ti_ofs2 "Map of offset to be applied on richness closed loop. Vehicule running." MAP 0xa0026e68 _REC_A1MAP_20_u2_u2_u2 0.666656493949999 _CNV_A_R_LINEAR_____61_CM -0.333333333238019 0.33332316071198 FORMAT "%8.5"
 /begin AXIS_DESCR COM_AXIS Vxx_eal _CNV_A_R_LINEAR_____53_CM 16 0. 3.99993896484375 FORMAT "%10.8" AXIS_PTS_REF Ctb_eal /end AXIS_DESCR
 /begin AXIS_DESCR COM_AXIS Vxx_n _CNV_A_R_ENSD_LINEA_24_CM 9 0. 16383.75 FORMAT "%8.2" AXIS_PTS_REF Ctb_n2 /end AXIS_DESCR
/end CHARACTERISTIC
/begin CHARACTERISTIC Cmp_n_eal_ti_ofs2_lpg "Map of offset to be applied on richness closed loop. Vehicule running. (Exotic fuel settings)" MAP 0xa0026f88 _REC_A1MAP_20_u2_u2_u2 0.666656493949999 _CNV_A_R_LINEAR_____61_CM -0.333333333238019 0.33332316071198 FORMAT "%8.5"
 /begin AXIS_DESCR COM_AXIS Vxx_eal _CNV_A_R_LINEAR_____53_CM 16 0. 3.99993896484375 FORMAT "%10.8" AXIS_PTS_REF Ctb_eal /end AXIS_DESCR
 /begin AXIS_DESCR COM_AXIS Vxx_n _CNV_A_R_ENSD_LINEA_24_CM 9 0. 16383.75 FORMAT "%8.2" AXIS_PTS_REF Ctb_n2 /end AXIS_DESCR
/end CHARACTERISTIC
/begin CHARACTERISTIC Cmp_n_eal_ti_p_cor "Proportional term for Vxx_cl_ti_fac _fct(n,eal)" MAP 0xa00270a8 _REC_A1MAP_20_u1_u2_u2 0.33203125 _CNV_A_R_LINEAR_____62_CM 0. 0.33203125 FORMAT "%8.6"
 /begin AXIS_DESCR COM_AXIS Vxx_n _CNV_A_R_ENSD_LINEA_24_CM 9 0. 16383.75 FORMAT "%8.2" AXIS_PTS_REF Ctb_n2 /end AXIS_DESCR
 /begin AXIS_DESCR COM_AXIS Vxx_eal _CNV_A_R_LINEAR_____53_CM 9 0. 3.99993896484375 FORMAT "%10.8" AXIS_PTS_REF Ctb_eal2 /end AXIS_DESCR
/end CHARACTERISTIC
/begin CHARACTERISTIC Cmp_n_eal_ti_p_cor_lpg "Proportional term for Vxx_cl_ti_fac _fct(n,eal) in exotic fuel mode" MAP 0xa00270fc _REC_A1MAP_20_u1_u2_u2 0.33203125 _CNV_A_R_LINEAR_____62_CM 0. 0.33203125 FORMAT "%8.6"
 /begin AXIS_DESCR COM_AXIS Vxx_n _CNV_A_R_ENSD_LINEA_24_CM 9 0. 16383.75 FORMAT "%8.2" AXIS_PTS_REF Ctb_n2 /end AXIS_DESCR
 /begin AXIS_DESCR COM_AXIS Vxx_eal _CNV_A_R_LINEAR_____53_CM 9 0. 3.99993896484375 FORMAT "%10.8" AXIS_PTS_REF Ctb_eal2 /end AXIS_DESCR
/end CHARACTERISTIC
/begin CHARACTERISTIC Ctp_acel_n_ti_p_cor "Specific slope proportional when accelerating" CURVE 0xa0027150 _REC_A1CUR_20_u1_u2 0.33203125 _CNV_A_R_LINEAR_____62_CM 0. 0.33203125 FORMAT "%8.6"
 /begin AXIS_DESCR COM_AXIS Vxx_n _CNV_A_R_ENSD_LINEA_24_CM 9 0. 16383.75 FORMAT "%8.2" AXIS_PTS_REF Ctb_n2 /end AXIS_DESCR
/end CHARACTERISTIC
/begin CHARACTERISTIC Ctp_cl_lean_sta "Table giving number of TDC to get in lean settings depending on coolant temp at start." CURVE 0xa002715c _REC_A1CUR_20_u2_u2 65535. _CNV_A_R_LINEAR_____55_CM 0. 65535. FORMAT "%5.0"
 /begin AXIS_DESCR COM_AXIS Vxx_tco _CNV_A_R_LINEAR_____54_CM 9 -40. 200. FORMAT "%5.1" AXIS_PTS_REF Ctb_tco2 /end AXIS_DESCR
/end CHARACTERISTIC
/begin CHARACTERISTIC Ctp_cl_lean_stop "Table giving number of TDC to get out of lean settings depending on coolant temp at start." CURVE 0xa0027170 _REC_A1CUR_20_u2_u2 65535. _CNV_A_R_LINEAR_____55_CM 0. 65535. FORMAT "%5.0"
 /begin AXIS_DESCR COM_AXIS Vxx_tco _CNV_A_R_LINEAR_____54_CM 9 -40. 200. FORMAT "%5.1" AXIS_PTS_REF Ctb_tco2 /end AXIS_DESCR
/end CHARACTERISTIC
/begin CHARACTERISTIC Ctp_decl_n_ti_p_cor "Specific slope proportional when decelerating" CURVE 0xa0027184 _REC_A1CUR_20_u1_u2 0.33203125 _CNV_A_R_LINEAR_____62_CM 0. 0.33203125 FORMAT "%8.6"
 /begin AXIS_DESCR COM_AXIS Vxx_n _CNV_A_R_ENSD_LINEA_24_CM 9 0. 16383.75 FORMAT "%8.2" AXIS_PTS_REF Ctb_n2 /end AXIS_DESCR
/end CHARACTERISTIC
/begin CHARACTERISTIC Ctp_eal_l_ti_i_cor "Corrective factor depending on engine air load for integral term." CURVE 0xa0027190 _REC_A1CUR_20_u1_u2 1.9921875 _CNV_A_R_LINEAR_____43_CM 0. 1.9921875 FORMAT "%8.6"
 /begin AXIS_DESCR COM_AXIS Vxx_eal _CNV_A_R_LINEAR_____53_CM 16 0. 3.99993896484375 FORMAT "%10.8" AXIS_PTS_REF Ctb_eal /end AXIS_DESCR
/end CHARACTERISTIC
/begin CHARACTERISTIC Ctp_eal_l_ti_i_cor_lean "Corrective factor depending on engine air load for integral term. in lean settings" CURVE 0xa00271a0 _REC_A1CUR_20_u1_u2 1.9921875 _CNV_A_R_LINEAR_____43_CM 0. 1.9921875 FORMAT "%8.6"
 /begin AXIS_DESCR COM_AXIS Vxx_eal _CNV_A_R_LINEAR_____53_CM 16 0. 3.99993896484375 FORMAT "%10.8" AXIS_PTS_REF Ctb_eal /end AXIS_DESCR
/end CHARACTERISTIC
/begin CHARACTERISTIC Ctp_eal_l_ti_i_cor_lean_lpg "Corrective factor depending on engine air load for integral term. in lean settings for exotic fuel" CURVE 0xa00271b0 _REC_A1CUR_20_u1_u2 1.9921875 _CNV_A_R_LINEAR_____43_CM 0. 1.9921875 FORMAT "%8.6"
 /begin AXIS_DESCR COM_AXIS Vxx_eal _CNV_A_R_LINEAR_____53_CM 16 0. 3.99993896484375 FORMAT "%10.8" AXIS_PTS_REF Ctb_eal /end AXIS_DESCR
/end CHARACTERISTIC
/begin CHARACTERISTIC Ctp_eal_l_ti_i_cor_lpg "Corrective factor depending on engine air load for integral term. For exotic fuel" CURVE 0xa00271c0 _REC_A1CUR_20_u1_u2 1.9921875 _CNV_A_R_LINEAR_____43_CM 0. 1.9921875 FORMAT "%8.6"
 /begin AXIS_DESCR COM_AXIS Vxx_eal _CNV_A_R_LINEAR_____53_CM 16 0. 3.99993896484375 FORMAT "%10.8" AXIS_PTS_REF Ctb_eal /end AXIS_DESCR
/end CHARACTERISTIC
/begin CHARACTERISTIC Ctp_n_l_ti_i "Table of Integral factor to be applied on Vxx_cl_ti_fac in normal conditions." CURVE 0xa00271d0 _REC_A1CUR_20_u1_u2 2.593994140625e-003 _CNV_A_R_LINEAR_____63_CM 0. 2.593994140625e-003 FORMAT "%10.8"
 /begin AXIS_DESCR COM_AXIS Vxx_n _CNV_A_R_ENSD_LINEA_24_CM 9 0. 16383.75 FORMAT "%8.2" AXIS_PTS_REF Ctb_n2 /end AXIS_DESCR
/end CHARACTERISTIC
/begin CHARACTERISTIC Ctp_n_l_ti_i_lean "Table of Integral factor to be applied on Vxx_cl_ti_fac in lean conditions." CURVE 0xa00271dc _REC_A1CUR_20_u1_u2 2.593994140625e-003 _CNV_A_R_LINEAR_____63_CM 0. 2.593994140625e-003 FORMAT "%10.8"
 /begin AXIS_DESCR COM_AXIS Vxx_n _CNV_A_R_ENSD_LINEA_24_CM 9 0. 16383.75 FORMAT "%8.2" AXIS_PTS_REF Ctb_n2 /end AXIS_DESCR
/end CHARACTERISTIC
/begin CHARACTERISTIC Ctp_n_l_ti_i_lean_lpg "Table of Integral factor to be applied on Vxx_cl_ti_fac in normal conditions. lean settings exotic fuel" CURVE 0xa00271e8 _REC_A1CUR_20_u1_u2 2.593994140625e-003 _CNV_A_R_LINEAR_____63_CM 0. 2.593994140625e-003 FORMAT "%10.8"
 /begin AXIS_DESCR COM_AXIS Vxx_n _CNV_A_R_ENSD_LINEA_24_CM 9 0. 16383.75 FORMAT "%8.2" AXIS_PTS_REF Ctb_n2 /end AXIS_DESCR
/end CHARACTERISTIC
/begin CHARACTERISTIC Ctp_n_l_ti_i_lpg "Table of Integral factor to be applied on Vxx_cl_ti_fac in normal conditions. for exotic fuel" CURVE 0xa00271f4 _REC_A1CUR_20_u1_u2 2.593994140625e-003 _CNV_A_R_LINEAR_____63_CM 0. 2.593994140625e-003 FORMAT "%10.8"
 /begin AXIS_DESCR COM_AXIS Vxx_n _CNV_A_R_ENSD_LINEA_24_CM 9 0. 16383.75 FORMAT "%8.2" AXIS_PTS_REF Ctb_n2 /end AXIS_DESCR
/end CHARACTERISTIC
/begin CHARACTERISTIC Ctp_n_ti_p_cor_lean1 "Proportional term depending on engine speed in lean settings towards lean." CURVE 0xa0027200 _REC_A1CUR_20_u1_u2 0.33203125 _CNV_A_R_LINEAR_____62_CM 0. 0.33203125 FORMAT "%8.6"
 /begin AXIS_DESCR COM_AXIS Vxx_n _CNV_A_R_ENSD_LINEA_24_CM 9 0. 16383.75 FORMAT "%8.2" AXIS_PTS_REF Ctb_n2 /end AXIS_DESCR
/end CHARACTERISTIC
/begin CHARACTERISTIC Ctp_n_ti_p_cor_lean2 "Proportional term depending on engine speed in lean settings toward rich." CURVE 0xa002720c _REC_A1CUR_20_u1_u2 0.33203125 _CNV_A_R_LINEAR_____62_CM 0. 0.33203125 FORMAT "%8.6"
 /begin AXIS_DESCR COM_AXIS Vxx_n _CNV_A_R_ENSD_LINEA_24_CM 9 0. 16383.75 FORMAT "%8.2" AXIS_PTS_REF Ctb_n2 /end AXIS_DESCR
/end CHARACTERISTIC
/begin CHARACTERISTIC Ctp_spc_slop_in "Table giving number of TDC to get in specific slope mode depending on coolant temp at start." CURVE 0xa0027218 _REC_A1CUR_20_u2_u2 65535. _CNV_A_R_LINEAR_____55_CM 0. 65535. FORMAT "%5.0"
 /begin AXIS_DESCR COM_AXIS Vxx_tco _CNV_A_R_LINEAR_____54_CM 9 -40. 200. FORMAT "%5.1" AXIS_PTS_REF Ctb_tco2 /end AXIS_DESCR
/end CHARACTERISTIC
/begin CHARACTERISTIC Ctp_spc_slop_out "Table giving number of TDC to get out of specific slope mode depending on coolant temp at start." CURVE 0xa002722c _REC_A1CUR_20_u2_u2 65535. _CNV_A_R_LINEAR_____55_CM 0. 65535. FORMAT "%5.0"
 /begin AXIS_DESCR COM_AXIS Vxx_tco _CNV_A_R_LINEAR_____54_CM 9 -40. 200. FORMAT "%5.1" AXIS_PTS_REF Ctb_tco2 /end AXIS_DESCR
/end CHARACTERISTIC
/begin MEASUREMENT Vbx_cl_lean_cdn "Richness closed loop lean settings conditions." UBYTE _CNV_S_2_RANGE______3_CM 1 0. 0. 1. ECU_ADDRESS 0xd0004eea BIT_MASK 0x1 /end MEASUREMENT
/begin MEASUREMENT Vbx_spc_slop "Boolean indicating that the richness fast slope is activated." UBYTE _CNV_S_2_RANGE______3_CM 1 0. 0. 1. ECU_ADDRESS 0xd0004eeb BIT_MASK 0x1 /end MEASUREMENT
/begin MEASUREMENT Vbx_ti_bar_cdn "BAR activation conditions" UBYTE _CNV_S_2_RANGE______3_CM 1 0. 0. 1. ECU_ADDRESS 0xd0004eec BIT_MASK 0x1 /end MEASUREMENT
/begin MEASUREMENT Vbx_ti_bar_end "BAR duration over." UBYTE _CNV_S_2_RANGE______3_CM 1 0. 0. 1. ECU_ADDRESS 0xd0004eed BIT_MASK 0x1 /end MEASUREMENT
/begin MEASUREMENT Vsx_rich_cl "State of the richness closed loop state machine." UWORD _CNV_S_14_RANGE_STAT_64_CM 1 0. 0. 4096. ECU_ADDRESS 0xd0002cfe /end MEASUREMENT
/begin MEASUREMENT Vxx_appl_ti_ofs_ctr "TDC counter to apply offset." UBYTE _CNV_A_R_LINEAR_____55_CM 1 0. 0. 255. ECU_ADDRESS 0xd0004eee FORMAT "%3.0" /end MEASUREMENT
/begin MEASUREMENT Vxx_cl_lean_ctr "Glitch counter" UBYTE _CNV_A_R_LINEAR_____34_CM 1 0. 0. 2.55 ECU_ADDRESS 0xd0004eef FORMAT "%4.2" /end MEASUREMENT
/begin MEASUREMENT Vxx_cl_ti_fac "Multiplicative factor from richness closed loop applied on injected fuel mass quantity." UWORD _CNV_A_R_LINEAR_____65_CM 1 0. 0.6666666 1.33332309414063 ECU_ADDRESS 0xd0002d00 FORMAT "%8.7" /end MEASUREMENT
/begin MEASUREMENT Vxx_cl_ti_fac_fast_slop_sta "Vxx_cl_ti_fac at the begining of the fast slope." UWORD _CNV_A_R_LINEAR_____65_CM 1 0. 0.6666666 1.33332309414063 ECU_ADDRESS 0xd0002d02 FORMAT "%8.7" /end MEASUREMENT
/begin MEASUREMENT Vxx_lamb_swi_ctr "Countdown of lambda switch used for filter time constant after loop closing and fats slope." UBYTE _CNV_A_R_ECME_LINEA_0_CM 1 0. 0. 255. ECU_ADDRESS 0xd0004ef0 FORMAT "%3.0" /end MEASUREMENT
/begin MEASUREMENT Vxx_last_p_cor "Last proportional term applied to Vxx_cl_ti_fac." SBYTE _CNV_A_R_LINEAR_____66_CM 1 0. -0.333333333333166 0.330729166666501 ECU_ADDRESS 0xd0004ef1 FORMAT "%8.5" /end MEASUREMENT
/begin MEASUREMENT Vxx_last_ti_p_cor "Last proportional correction without fast slope. unsigned." UBYTE _CNV_A_R_LINEAR_____67_CM 1 0. 0. 0.6640625 ECU_ADDRESS 0xd0004ef2 FORMAT "%8.6" /end MEASUREMENT
/begin MEASUREMENT Vxx_mv_cl_ti_fac "Mean value of multiplicative factor from richness closed loop." UWORD _CNV_A_R_LINEAR_____65_CM 1 0. 0.6666666 1.33332309414063 ECU_ADDRESS 0xd0002d04 FORMAT "%8.7" /end MEASUREMENT
/begin MEASUREMENT Vxx_rich_i_appl "Sum of integral terms applied to Vxx_cl_ti_fac since last lambda switch." UWORD _CNV_A_R_LINEAR_____63_CM 1 0. 0. 0.666656494140625 ECU_ADDRESS 0xd0002d06 FORMAT "%8.7" /end MEASUREMENT
/begin MEASUREMENT Vxx_rich_i_bar_apl "Integral term applied during the BAR." SWORD _CNV_A_R_LINEAR_____56_CM 1 0. -0.333333333238019 0.33332316071198 ECU_ADDRESS 0xd0002d08 FORMAT "%8.5" /end MEASUREMENT
/begin MEASUREMENT Vxx_slop_eal_dif "Difference between Engine air load and its filtered value." SWORD _CNV_A_R_LINEAR_____53_CM 1 0. -2. 1.99993896484375 ECU_ADDRESS 0xd0002d0a FORMAT "%8.5" /end MEASUREMENT
/begin MEASUREMENT Vxx_slop_eal_mmv "Engine air load filtered for richness fast slope." UWORD _CNV_A_R_LINEAR_____53_CM 1 0. 0. 3.99993896484375 ECU_ADDRESS 0xd0002d0c FORMAT "%7.5" /end MEASUREMENT
/begin MEASUREMENT Vxx_spc_slop_ctr "TDC counter used to get in or out of specific slope." UWORD _CNV_A_R_LINEAR_____55_CM 1 0. 0. 65535. ECU_ADDRESS 0xd0002d0e FORMAT "%5.0" /end MEASUREMENT
/begin MEASUREMENT Vxx_ti_i_cor "Integral factor to be applied on Vxx_cl_ti_fac in normal conditions." UBYTE _CNV_A_R_LINEAR_____63_CM 1 0. 0. 2.593994140625e-003 ECU_ADDRESS 0xd0004ef3 FORMAT "%10.8" /end MEASUREMENT
/begin MEASUREMENT Vxx_ti_i_cor_fast_slop "Integral factor to be applied on Vxx_cl_ti_fac in specific slope conditions." UBYTE _CNV_A_R_LINEAR_____63_CM 1 0. 0. 2.593994140625e-003 ECU_ADDRESS 0xd0004ef4 FORMAT "%10.8" /end MEASUREMENT
/begin MEASUREMENT Vxx_ti_i_cor_lean "Integral factor to be applied on Vxx_cl_ti_fac in lean conditions." UBYTE _CNV_A_R_LINEAR_____63_CM 1 0. 0. 2.593994140625e-003 ECU_ADDRESS 0xd0004ef5 FORMAT "%10.8" /end MEASUREMENT
/begin MEASUREMENT Vxx_ti_ofs_cor "offset applied on richness closed loop." SWORD _CNV_A_R_LINEAR_____56_CM 1 0. -0.333333333238019 0.33332316071198 ECU_ADDRESS 0xd0002d10 FORMAT "%8.5" /end MEASUREMENT
/begin MEASUREMENT Vxx_ti_p_cor "Proportional term that will be applied to Vxx_cl_ti_fac at next lambda switch." UBYTE _CNV_A_R_LINEAR_____62_CM 1 0. 0. 0.33203125 ECU_ADDRESS 0xd0004ef6 FORMAT "%8.6" /end MEASUREMENT
/begin MEASUREMENT Vxx_ti_p_cor_fast_slop "Proportional correction to compensate fast slope." UWORD _CNV_A_R_LINEAR_____63_CM 1 0. 0. 0.666656494140625 ECU_ADDRESS 0xd0002d12 FORMAT "%8.7" /end MEASUREMENT
/begin MEASUREMENT Vxx_ti_p_cor_lean1 "Proportional term that will be substracted to Vxx_cl_ti_fac at next lambda switch, in lean mode." UBYTE _CNV_A_R_LINEAR_____62_CM 1 0. 0. 0.33203125 ECU_ADDRESS 0xd0004ef7 FORMAT "%8.6" /end MEASUREMENT
/begin MEASUREMENT Vxx_ti_p_cor_lean2 "Proportional term that will be added to Vxx_cl_ti_fac at next lambda switch, in lean mode." UBYTE _CNV_A_R_LINEAR_____62_CM 1 0. 0. 0.33203125 ECU_ADDRESS 0xd0004ef8 FORMAT "%8.6" /end MEASUREMENT
/begin MEASUREMENT Vxx_trs_cl_ti_fac_bar_mem "Value of Vxx_cl_ti_fac at the entry of the BAR phase" UWORD _CNV_A_R_LINEAR_____65_CM 1 0. 0.6666666 1.33332309414063 ECU_ADDRESS 0xd0002d14 FORMAT "%8.7" /end MEASUREMENT
/begin MEASUREMENT Vxx_trs_cl_ti_fac_mem "Memory of Vxx_cl_ti_fac value at the last lambda switch." UWORD _CNV_A_R_LINEAR_____65_CM 1 0. 0.6666666 1.33332309414063 ECU_ADDRESS 0xd0002d16 FORMAT "%8.7" /end MEASUREMENT
/begin CHARACTERISTIC Cbx_ti_bar_ena "Activation of the BAR strategy (Fast downstream richness loop)" VALUE 0xa0020af0 _REC_S1VAL_20_u1 1. _CNV_A_R_ECME_LINEA_0_CM 0. 1. FORMAT "%1.0" BIT_MASK 0x1 /end CHARACTERISTIC
/begin CHARACTERISTIC Cxx_acel_spc_slop "Specific slope gain applied on standard integral parameter. When accelerating." VALUE 0xa0020af1 _REC_S1VAL_20_u1 7.96875 _CNV_A_R_LINEAR_____68_CM 1. 8.96875 FORMAT "%5.4" /end CHARACTERISTIC
/begin CHARACTERISTIC Cxx_acel_spc_slop_lean "Specific slope gain applied on standard integral parameter. When accelerating in lean settings." VALUE 0xa0020af2 _REC_S1VAL_20_u1 7.96875 _CNV_A_R_LINEAR_____68_CM 1. 8.96875 FORMAT "%5.4" /end CHARACTERISTIC
/begin CHARACTERISTIC Cxx_appl_ti_ofs_ctr "Initial value TDC counter to apply offset." VALUE 0xa0020af3 _REC_S1VAL_20_u1 255. _CNV_A_R_LINEAR_____55_CM 0. 255. FORMAT "%3.0" /end CHARACTERISTIC
/begin CHARACTERISTIC Cxx_appl_ti_ofs_ctr_lpg "Initial value TDC counter to apply offset. for exotic fuel" VALUE 0xa0020af4 _REC_S1VAL_20_u1 255. _CNV_A_R_LINEAR_____55_CM 0. 255. FORMAT "%3.0" /end CHARACTERISTIC
/begin CHARACTERISTIC Cxx_cl_lean_ctr "Anti Glitch counter initial value." VALUE 0xa0020af5 _REC_S1VAL_20_u1 2.55 _CNV_A_R_LINEAR_____34_CM 0. 2.55 FORMAT "%4.2" /end CHARACTERISTIC
/begin CHARACTERISTIC Cxx_cl_ti_fac_ftc "Filter time constant for Vxx_cl_ti_fac." VALUE 0xa0020ab8 _REC_S1VAL_20_u2 655.35 _CNV_A_R_LINEAR_____34_CM 0. 655.35 FORMAT "%6.2" /end CHARACTERISTIC
/begin CHARACTERISTIC Cxx_cl_ti_fac_ftc_lpg "Filter time constant for Vxx_cl_ti_fac. For exotic fuel" VALUE 0xa0020aba _REC_S1VAL_20_u2 655.35 _CNV_A_R_LINEAR_____34_CM 0. 655.35 FORMAT "%6.2" /end CHARACTERISTIC
/begin CHARACTERISTIC Cxx_cl_ti_fac_ol_dec "Max decrementation by step of Vxx_cl_ti_fac when returning to neutral value" VALUE 0xa0020abc _REC_S1VAL_20_u2 0.666656494140625 _CNV_A_R_LINEAR_____63_CM 0. 0.666656494140625 FORMAT "%8.7" /end CHARACTERISTIC
/begin CHARACTERISTIC Cxx_cl_ti_fac_ol_inc "Max increment by step of Vxx_cl_ti_fac when returning to neutral value" VALUE 0xa0020abe _REC_S1VAL_20_u2 0.666656494140625 _CNV_A_R_LINEAR_____63_CM 0. 0.666656494140625 FORMAT "%8.7" /end CHARACTERISTIC
/begin CHARACTERISTIC Cxx_decl_spc_slop "Specific slope gain applied on standard integral parameter. When decelerating." VALUE 0xa0020af6 _REC_S1VAL_20_u1 7.96875 _CNV_A_R_LINEAR_____68_CM 1. 8.96875 FORMAT "%5.4" /end CHARACTERISTIC
/begin CHARACTERISTIC Cxx_decl_spc_slop_lean "Specific slope gain applied on standard integral parameter. When decelerating in lean settings." VALUE 0xa0020af7 _REC_S1VAL_20_u1 7.96875 _CNV_A_R_LINEAR_____68_CM 1. 8.96875 FORMAT "%5.4" /end CHARACTERISTIC
/begin CHARACTERISTIC Cxx_dstb_ti_ofs_cor "offset correction added on richness closed loop. during richness repartition" VALUE 0xa0020ac0 _REC_S1VAL_20_s2 0.666656493949999 _CNV_A_R_LINEAR_____56_CM -0.333333333238019 0.33332316071198 FORMAT "%8.5" /end CHARACTERISTIC
/begin CHARACTERISTIC Cxx_dstb_ti_ofs_cor_lpg "offset correction added on richness closed loop. during richness repartition. for exotic fuel" VALUE 0xa0020ac2 _REC_S1VAL_20_s2 0.666656493949999 _CNV_A_R_LINEAR_____56_CM -0.333333333238019 0.33332316071198 FORMAT "%8.5" /end CHARACTERISTIC
/begin CHARACTERISTIC Cxx_dstb_ti_p_cor "Proportional term correction that will be added. during richness distribution." VALUE 0xa0020af8 _REC_S1VAL_20_u1 0.33203125 _CNV_A_R_LINEAR_____62_CM 0. 0.33203125 FORMAT "%8.6" /end CHARACTERISTIC
/begin CHARACTERISTIC Cxx_dstb_ti_p_cor_lpg "Proportional term correction that will be added. during richness distribution." VALUE 0xa0020af9 _REC_S1VAL_20_u1 0.33203125 _CNV_A_R_LINEAR_____62_CM 0. 0.33203125 FORMAT "%8.6" /end CHARACTERISTIC
/begin CHARACTERISTIC Cxx_h_ti_fast_slop_thd "Enrichment threshold that activates fast slope settings" VALUE 0xa0020afa _REC_S1VAL_20_u1 0.6640625 _CNV_A_R_LINEAR_____67_CM 0. 0.6640625 FORMAT "%8.6" /end CHARACTERISTIC
/begin CHARACTERISTIC Cxx_h_ti_fast_slop_thd_lean "Enrichment threshold that activates fast slope settings in lean configuration." VALUE 0xa0020afb _REC_S1VAL_20_u1 0.6640625 _CNV_A_R_LINEAR_____67_CM 0. 0.6640625 FORMAT "%8.6" /end CHARACTERISTIC
/begin CHARACTERISTIC Cxx_h_ti_fast_slop_thd_lpg "Enrichment threshold that activates fast slope settings for exotic fuel" VALUE 0xa0020afc _REC_S1VAL_20_u1 0.6640625 _CNV_A_R_LINEAR_____67_CM 0. 0.6640625 FORMAT "%8.6" /end CHARACTERISTIC
/begin CHARACTERISTIC Cxx_is_ti_i_cor "Integral term used during iddle speed regulation." VALUE 0xa0020afd _REC_S1VAL_20_u1 2.593994140625e-003 _CNV_A_R_LINEAR_____63_CM 0. 2.593994140625e-003 FORMAT "%10.8" /end CHARACTERISTIC
/begin CHARACTERISTIC Cxx_is_ti_i_cor_lean "Integral term used during iddle speed regulation. during lean configuration" VALUE 0xa0020afe _REC_S1VAL_20_u1 2.593994140625e-003 _CNV_A_R_LINEAR_____63_CM 0. 2.593994140625e-003 FORMAT "%10.8" /end CHARACTERISTIC
/begin CHARACTERISTIC Cxx_is_ti_i_cor_lpg "Integral term used during iddle speed regulation. for exotic fuel" VALUE 0xa0020aff _REC_S1VAL_20_u1 2.593994140625e-003 _CNV_A_R_LINEAR_____63_CM 0. 2.593994140625e-003 FORMAT "%10.8" /end CHARACTERISTIC
/begin CHARACTERISTIC Cxx_is_ti_p_cor "Proportional term applied during iddle speed regulation" VALUE 0xa0020b00 _REC_S1VAL_20_u1 0.33203125 _CNV_A_R_LINEAR_____62_CM 0. 0.33203125 FORMAT "%8.6" /end CHARACTERISTIC
/begin CHARACTERISTIC Cxx_is_ti_p_cor_lean1 "Positive proportional term applied during iddle speed regulation, lean configuration" VALUE 0xa0020b01 _REC_S1VAL_20_u1 0.33203125 _CNV_A_R_LINEAR_____62_CM 0. 0.33203125 FORMAT "%8.6" /end CHARACTERISTIC
/begin CHARACTERISTIC Cxx_is_ti_p_cor_lean2 "Negative proportional term applied during iddle speed regulation, lean configuration" VALUE 0xa0020b02 _REC_S1VAL_20_u1 0.33203125 _CNV_A_R_LINEAR_____62_CM 0. 0.33203125 FORMAT "%8.6" /end CHARACTERISTIC
/begin CHARACTERISTIC Cxx_is_ti_p_cor_lpg "Proportional term applied during iddle speed regulation for exotic fuel" VALUE 0xa0020b03 _REC_S1VAL_20_u1 0.33203125 _CNV_A_R_LINEAR_____62_CM 0. 0.33203125 FORMAT "%8.6" /end CHARACTERISTIC
/begin CHARACTERISTIC Cxx_l_ti_fast_slop_thd "Threshold of enleanment on Vxx_cl_ti_fac under which fast slope is activated." VALUE 0xa0020b04 _REC_S1VAL_20_u1 0.6640625 _CNV_A_R_LINEAR_____67_CM 0. 0.6640625 FORMAT "%8.6" /end CHARACTERISTIC
/begin CHARACTERISTIC Cxx_l_ti_fast_slop_thd_lean "Threshold of enleanment on Vxx_cl_ti_fac under which fast slope is activated. In lean configuration" VALUE 0xa0020b05 _REC_S1VAL_20_u1 0.6640625 _CNV_A_R_LINEAR_____67_CM 0. 0.6640625 FORMAT "%8.6" /end CHARACTERISTIC
/begin CHARACTERISTIC Cxx_l_ti_fast_slop_thd_lpg "Threshold of enleanment on Vxx_cl_ti_fac under which fast slope is activated. for exotic fuel" VALUE 0xa0020b06 _REC_S1VAL_20_u1 0.6640625 _CNV_A_R_LINEAR_____67_CM 0. 0.6640625 FORMAT "%8.6" /end CHARACTERISTIC
/begin CHARACTERISTIC Cxx_lamb_swi_ctr_ini "Initial value for countdown of lambda switch used for filter time constant after loop closing and fast slope." VALUE 0xa0020b07 _REC_S1VAL_20_u1 255. _CNV_A_R_ECME_LINEA_0_CM 0. 255. FORMAT "%3.0" /end CHARACTERISTIC
/begin CHARACTERISTIC Cxx_lamb_swi_ctr_ini_lpg "Initial value for countdown of lambda switch used for filter time constant after loop closing and fast slope. for exotic fuel" VALUE 0xa0020b08 _REC_S1VAL_20_u1 255. _CNV_A_R_ECME_LINEA_0_CM 0. 255. FORMAT "%3.0" /end CHARACTERISTIC
/begin CHARACTERISTIC Cxx_max_spc_slop_ctr "Value for TDC counter used to get out of specific slope." VALUE 0xa0020ac4 _REC_S1VAL_20_u2 65535. _CNV_A_R_LINEAR_____55_CM 0. 65535. FORMAT "%5.0" /end CHARACTERISTIC
/begin CHARACTERISTIC Cxx_max_ti_p_cor_fast_slop "Maximum value of compensation of fast slope." VALUE 0xa0020ac6 _REC_S1VAL_20_u2 0.666656494140625 _CNV_A_R_LINEAR_____63_CM 0. 0.666656494140625 FORMAT "%8.7" /end CHARACTERISTIC
/begin CHARACTERISTIC Cxx_max_ti_p_cor_fast_slop_lpg "Maximum value of compensation of fast slope. for exotic fuel" VALUE 0xa0020ac8 _REC_S1VAL_20_u2 0.666656494140625 _CNV_A_R_LINEAR_____63_CM 0. 0.666656494140625 FORMAT "%8.7" /end CHARACTERISTIC
/begin CHARACTERISTIC Cxx_spc_slop_eal_ftc "Filter time constant applied on EAL for the specific slope." VALUE 0xa0020aca _REC_S1VAL_20_u2 65.535 _CNV_A_R_LINEAR_____58_CM 0. 65.535 FORMAT "%5.3" /end CHARACTERISTIC
/begin CHARACTERISTIC Cxx_spc_slop_eal_h_thd "Difference between Engine air load and its filtered value over which specific slope can be activated" VALUE 0xa0020acc _REC_S1VAL_20_s2 1.99993896484375 _CNV_A_R_LINEAR_____53_CM 0. 1.99993896484375 FORMAT "%8.5" /end CHARACTERISTIC
/begin CHARACTERISTIC Cxx_spc_slop_eal_l_thd "Difference between Engine air load and its filtered value under which specific slope can be activated" VALUE 0xa0020ace _REC_S1VAL_20_s2 2. _CNV_A_R_LINEAR_____53_CM -2. 0. FORMAT "%8.5" /end CHARACTERISTIC
/begin CHARACTERISTIC Cxx_ti_bar_dly "Deactivation delay of the BAR strategy." VALUE 0xa0020ad0 _REC_S1VAL_20_u2 6553.5 _CNV_A_R_LINEAR_____4_CM 0. 6553.5 FORMAT "%6.1" /end CHARACTERISTIC
/begin CHARACTERISTIC Cxx_ti_bar_eal_max "Maximum eal for BAR activation" VALUE 0xa0020ad2 _REC_S1VAL_20_u2 3.99993896484375 _CNV_A_R_LINEAR_____53_CM 0. 3.99993896484375 FORMAT "%10.8" /end CHARACTERISTIC
/begin CHARACTERISTIC Cxx_ti_bar_eal_min "Minimum eal for BAR activation" VALUE 0xa0020ad4 _REC_S1VAL_20_u2 3.99993896484375 _CNV_A_R_LINEAR_____53_CM 0. 3.99993896484375 FORMAT "%10.8" /end CHARACTERISTIC
/begin CHARACTERISTIC Cxx_ti_bar_lbdw_lean_in "Voltage threshold to enter in lean BAR mode." VALUE 0xa0020ad6 _REC_S1VAL_20_u2 25000. _CNV_A_R_LINEAR_____52_CM 0. 25000. FORMAT "%5.0" /end CHARACTERISTIC
/begin CHARACTERISTIC Cxx_ti_bar_lbdw_lean_out "Voltage threshold to exit lean BAR mode." VALUE 0xa0020ad8 _REC_S1VAL_20_u2 25000. _CNV_A_R_LINEAR_____52_CM 0. 25000. FORMAT "%5.0" /end CHARACTERISTIC
/begin CHARACTERISTIC Cxx_ti_bar_lbdw_rich_in "Voltage threshold to enter in rich BAR mode." VALUE 0xa0020ada _REC_S1VAL_20_u2 25000. _CNV_A_R_LINEAR_____52_CM 0. 25000. FORMAT "%5.0" /end CHARACTERISTIC
/begin CHARACTERISTIC Cxx_ti_bar_lbdw_rich_out "Voltage threshold to exit rich BAR mode." VALUE 0xa0020adc _REC_S1VAL_20_u2 25000. _CNV_A_R_LINEAR_____52_CM 0. 25000. FORMAT "%5.0" /end CHARACTERISTIC
/begin CHARACTERISTIC Cxx_ti_bar_max "Maximum enrichment during BAR mode." VALUE 0xa0020ade _REC_S1VAL_20_u2 0.666656494140625 _CNV_A_R_LINEAR_____63_CM 0. 0.666656494140625 FORMAT "%8.7" /end CHARACTERISTIC
/begin CHARACTERISTIC Cxx_ti_bar_min "Maximum enleanment during BAR mode." VALUE 0xa0020ae0 _REC_S1VAL_20_s4 0.666656494140625 _CNV_A_R_LINEAR_____63_CM -0.666656494140625 0. FORMAT "%8.7" /end CHARACTERISTIC
/begin CHARACTERISTIC Cxx_ti_bar_n_max "Maximum engine speed to activate BAR." VALUE 0xa0020ae4 _REC_S1VAL_20_u2 16383.75 _CNV_A_R_ENSD_LINEA_24_CM 0. 16383.75 FORMAT "%8.2" /end CHARACTERISTIC
/begin CHARACTERISTIC Cxx_ti_bar_n_min "Minimum engine speed to activate BAR" VALUE 0xa0020ae6 _REC_S1VAL_20_u2 16383.75 _CNV_A_R_ENSD_LINEA_24_CM 0. 16383.75 FORMAT "%8.2" /end CHARACTERISTIC
/begin CHARACTERISTIC Cxx_ti_bar_tco_min "Minimum coolant temperature to activate BAR" VALUE 0xa0020ae8 _REC_S1VAL_20_u2 240. _CNV_A_R_LINEAR_____54_CM -40. 200. FORMAT "%5.1" /end CHARACTERISTIC
/begin CHARACTERISTIC Cxx_ti_i_fast_slop_fac "Factor appplied to rpm to obtain the fast slop integral value." VALUE 0xa0020b09 _REC_S1VAL_20_u1 5.06639480594806e-006 _CNV_A_R_LINEAR_____69_CM 0. 5.06639480594806e-006 FORMAT "%11.9" /end CHARACTERISTIC
/begin CHARACTERISTIC Cxx_ti_i_fast_slop_fac_lpg "Factor appplied to rpm to obtain the fast slop integral value. (exotic fuel setting)" VALUE 0xa0020b0a _REC_S1VAL_20_u1 5.06639480594806e-006 _CNV_A_R_LINEAR_____69_CM 0. 5.06639480594806e-006 FORMAT "%11.9" /end CHARACTERISTIC
/begin CHARACTERISTIC Cxx_ti_ofs_vs_thd "Vehicle speed threshold to switch between offset settings." VALUE 0xa0020aea _REC_S1VAL_20_u2 655.35 _CNV_A_R_LINEAR_____70_CM 0. 655.35 FORMAT "%6.2" /end CHARACTERISTIC
/begin CHARACTERISTIC Cxx_ti_ofs_vs_thd_lpg "Vehicle speed threshold to switch between offset settings. for exotic fuel" VALUE 0xa0020aec _REC_S1VAL_20_u2 655.35 _CNV_A_R_LINEAR_____70_CM 0. 655.35 FORMAT "%6.2" /end CHARACTERISTIC
/begin CHARACTERISTIC Cxx_ti_p_eal_thd "Engine air load threshold to have a small proportional out of Iddle State Regulation" VALUE 0xa0020aee _REC_S1VAL_20_u2 3.99993896484375 _CNV_A_R_LINEAR_____53_CM 0. 3.99993896484375 FORMAT "%7.5" /end CHARACTERISTIC
/begin AXIS_PTS Ctb_n_cl_rich_sp_bkp "engine speed breackpoints for the richness applied when low engine speed during richness closed loop" 0xa00233d0 Vxx_n _REC_A2AXS_20_u2 16383.75 _CNV_A_R_ENSD_LINEA_24_CM 4 0. 16383.75 FORMAT "%8.2" /end AXIS_PTS
/begin AXIS_PTS Ctb_tco_cl_off "13 breakpoint table for richness closed loop" 0xa00233dc Vxx_tco _REC_A2AXS_20_u2 240. _CNV_A_R_LINEAR_____54_CM 13 -40. 200. FORMAT "%5.1" /end AXIS_PTS
/begin CHARACTERISTIC Cmp_n_tco_eal_fl_thd "Map of EAL inducing full load conditions, depending on engine speed and water temp." MAP 0xa00233f8 _REC_A1MAP_20_u2_u2_u2 3.99993896484375 _CNV_A_R_LINEAR_____53_CM 0. 3.99993896484375 FORMAT "%7.5"
 /begin AXIS_DESCR COM_AXIS Vxx_tco _CNV_A_R_LINEAR_____54_CM 13 -40. 200. FORMAT "%5.1" AXIS_PTS_REF Ctb_tco_cl_off /end AXIS_DESCR
 /begin AXIS_DESCR COM_AXIS Vxx_n _CNV_A_R_ENSD_LINEA_24_CM 20 0. 16383.75 FORMAT "%8.2" AXIS_PTS_REF Ctb_n /end AXIS_DESCR
/end CHARACTERISTIC
/begin CHARACTERISTIC Cmp_n_tco_eal_fl_thd_lpg "Map of EAL inducing full load conditions, depending on engine speed and water temp. (exotic fuel)" MAP 0xa0023600 _REC_A1MAP_20_u2_u2_u2 3.99993896484375 _CNV_A_R_LINEAR_____53_CM 0. 3.99993896484375 FORMAT "%7.5"
 /begin AXIS_DESCR COM_AXIS Vxx_tco _CNV_A_R_LINEAR_____54_CM 13 -40. 200. FORMAT "%5.1" AXIS_PTS_REF Ctb_tco_cl_off /end AXIS_DESCR
 /begin AXIS_DESCR COM_AXIS Vxx_n _CNV_A_R_ENSD_LINEA_24_CM 20 0. 16383.75 FORMAT "%8.2" AXIS_PTS_REF Ctb_n /end AXIS_DESCR
/end CHARACTERISTIC
/begin CHARACTERISTIC Ctp_cl_t "Table giving the delay before closing the richness loop after start, depending on water temp." CURVE 0xa0023808 _REC_A1CUR_20_u2_u2 6553.5 _CNV_A_R_LINEAR_____4_CM 0. 6553.5 FORMAT "%6.1"
 /begin AXIS_DESCR COM_AXIS Vxx_tco _CNV_A_R_LINEAR_____54_CM 13 -40. 200. FORMAT "%5.1" AXIS_PTS_REF Ctb_tco_cl_off /end AXIS_DESCR
/end CHARACTERISTIC
/begin CHARACTERISTIC Ctp_n_cl_rich_sp "richness setpoint for low engine speeds during richness closed loop" CURVE 0xa0020e88 _REC_A1CUR_20_u2_u2 0.9947916670000001 _CNV_A_R_LINEAR_____71_CM 1. 1.994791667 FORMAT "%7.3"
 /begin AXIS_DESCR COM_AXIS Vxx_n _CNV_A_R_ENSD_LINEA_24_CM 4 0. 16383.75 FORMAT "%8.2" AXIS_PTS_REF Ctb_n_cl_rich_sp_bkp /end AXIS_DESCR
/end CHARACTERISTIC
/begin CHARACTERISTIC Ctp_n_dly_ofs_dly "Table indicating delay before full load application." CURVE 0xa0023824 _REC_A1CUR_20_u2_u2 6553.5 _CNV_A_R_LINEAR_____4_CM 0. 6553.5 FORMAT "%6.1"
 /begin AXIS_DESCR COM_AXIS Vxx_n _CNV_A_R_ENSD_LINEA_24_CM 9 0. 16383.75 FORMAT "%8.2" AXIS_PTS_REF Ctb_n2 /end AXIS_DESCR
/end CHARACTERISTIC
/begin CHARACTERISTIC Ctp_n_dly_ofs_dly_lpg "Table indicating delay before full load application. (exotic fuel)" CURVE 0xa0023838 _REC_A1CUR_20_u2_u2 6553.5 _CNV_A_R_LINEAR_____4_CM 0. 6553.5 FORMAT "%6.1"
 /begin AXIS_DESCR COM_AXIS Vxx_n _CNV_A_R_ENSD_LINEA_24_CM 9 0. 16383.75 FORMAT "%8.2" AXIS_PTS_REF Ctb_n2 /end AXIS_DESCR
/end CHARACTERISTIC
/begin CHARACTERISTIC Ctp_n_eal_fl_ocl_ofs "EAL offset added to Vxx_eal_fl_ocl to authorize full load." CURVE 0xa002384c _REC_A1CUR_20_u2_u2 3.99993896484375 _CNV_A_R_LINEAR_____53_CM 0. 3.99993896484375 FORMAT "%7.5"
 /begin AXIS_DESCR COM_AXIS Vxx_n _CNV_A_R_ENSD_LINEA_24_CM 20 0. 16383.75 FORMAT "%8.2" AXIS_PTS_REF Ctb_n /end AXIS_DESCR
/end CHARACTERISTIC
/begin CHARACTERISTIC Ctp_n_iga_eal_fl_thd "Loop opening threshold for each cranckshaft degree of ignition correction." CURVE 0xa0023874 _REC_A1CUR_20_u2_u2 3.99993896484375 _CNV_A_R_LINEAR_____72_CM 0. 3.99993896484375 FORMAT "%7.5"
 /begin AXIS_DESCR COM_AXIS Vxx_n _CNV_A_R_ENSD_LINEA_24_CM 20 0. 16383.75 FORMAT "%8.2" AXIS_PTS_REF Ctb_n /end AXIS_DESCR
/end CHARACTERISTIC
/begin MEASUREMENT Vbx_cl_cdn "Closed loop conditions." UBYTE _CNV_S_2_RANGE______3_CM 1 0. 0. 1. ECU_ADDRESS 0xd0005646 BIT_MASK 0x1 /end MEASUREMENT
/begin MEASUREMENT Vbx_cl_phs "Richness regulation condition" UBYTE _CNV_S_2_RANGE______3_CM 1 0. 0. 1. ECU_ADDRESS 0xd0003f8c BIT_MASK 0x1 /end MEASUREMENT
/begin MEASUREMENT Vbx_dly_ocl_cdn "Postponed open loop conditions." UBYTE _CNV_S_2_RANGE______3_CM 1 0. 0. 1. ECU_ADDRESS 0xd0005647 BIT_MASK 0x1 /end MEASUREMENT
/begin MEASUREMENT Vbx_fl_cdn "Full load conditions for richness" UBYTE _CNV_S_2_RANGE______3_CM 1 0. 0. 1. ECU_ADDRESS 0xd0005648 BIT_MASK 0x1 /end MEASUREMENT
/begin MEASUREMENT Vbx_fl_ena "Full load authorized" UBYTE _CNV_S_2_RANGE______3_CM 1 0. 0. 1. ECU_ADDRESS 0xd0003f8d BIT_MASK 0x1 /end MEASUREMENT
/begin MEASUREMENT Vsx_rich_stt "Phase of the richness state machine." UBYTE _CNV_S_5_RANGE_RICH_73_CM 1 0. 1. 16. ECU_ADDRESS 0xd0005649 /end MEASUREMENT
/begin MEASUREMENT Vxx_bfr_cl_ctr "Wait counter of TDC before richness loop closes when conditions are present." UBYTE _CNV_A_R_LINEAR_____55_CM 1 0. 0. 255. ECU_ADDRESS 0xd0003f8e FORMAT "%3.0" /end MEASUREMENT
/begin MEASUREMENT Vxx_cl_t "Delay before authorizing richness closed loop after start." UWORD _CNV_A_R_LINEAR_____4_CM 1 0. 0. 6553.5 ECU_ADDRESS 0xd00059e4 FORMAT "%6.1" /end MEASUREMENT
/begin MEASUREMENT Vxx_dly_ocl_dly "Delay before full load application." UWORD _CNV_A_R_LINEAR_____4_CM 1 0. 0. 6553.5 ECU_ADDRESS 0xd00059e6 FORMAT "%6.1" /end MEASUREMENT
/begin MEASUREMENT Vxx_eal_fl_ocl "EAL over which richness loop is opened." UWORD _CNV_A_R_LINEAR_____53_CM 1 0. 0. 3.99993896484375 ECU_ADDRESS 0xd00059e8 FORMAT "%7.5" /end MEASUREMENT
/begin MEASUREMENT Vxx_fl_dsb_dly "Delay before allowing richness full load phase." UWORD _CNV_A_R_LINEAR_____4_CM 1 0. 0. 6553.5 ECU_ADDRESS 0xd00059ea FORMAT "%6.1" /end MEASUREMENT
/begin MEASUREMENT Vxx_ol_ti_fac "Richness open loop factor applied to fuel mass." UBYTE _CNV_A_R_LINEAR_____74_CM 1 0. 0.6666666 1.9947916 ECU_ADDRESS 0xd000564a FORMAT "%8.6" /end MEASUREMENT
/begin CHARACTERISTIC Cbx_fl_kd_thr_conf "Disable the postponed loop opening when full throttle." VALUE 0xa0020eae _REC_S1VAL_20_u1 1. _CNV_A_R_ECME_LINEA_0_CM 0. 1. FORMAT "%1.0" BIT_MASK 0x1 /end CHARACTERISTIC
/begin CHARACTERISTIC Cbx_lbup_conf "Enables closed loop (set to OFF when no sensor)" VALUE 0xa0020eaf _REC_S1VAL_20_u1 1. _CNV_A_R_ECME_LINEA_0_CM 0. 1. FORMAT "%1.0" BIT_MASK 0x1 /end CHARACTERISTIC
/begin CHARACTERISTIC Cxx_bfr_cl_ctr "Number of TDC required before richness loop closing when conditions are present." VALUE 0xa0020eb0 _REC_S1VAL_20_u1 255. _CNV_A_R_LINEAR_____55_CM 0. 255. FORMAT "%3.0" /end CHARACTERISTIC
/begin CHARACTERISTIC Cxx_bfr_cl_ctr_lpg "Number of TDC required before richness loop closing when conditions are present.(exotic fuel)" VALUE 0xa0020eb1 _REC_S1VAL_20_u1 255. _CNV_A_R_LINEAR_____55_CM 0. 255. FORMAT "%3.0" /end CHARACTERISTIC
/begin CHARACTERISTIC Cxx_cl_off_n_thd "Engine speed threshold over which richness closed loop is disabled." VALUE 0xa0020e90 _REC_S1VAL_20_u2 16383.75 _CNV_A_R_ENSD_LINEA_24_CM 0. 16383.75 FORMAT "%8.2" /end CHARACTERISTIC
/begin CHARACTERISTIC Cxx_cl_run_eal_thd "Engine air load threshold under which open loop is set, vehicle moving." VALUE 0xa0020e92 _REC_S1VAL_20_u2 3.99993896484375 _CNV_A_R_LINEAR_____53_CM 0. 3.99993896484375 FORMAT "%7.5" /end CHARACTERISTIC
/begin CHARACTERISTIC Cxx_cl_stop_eal_thd "Engine air load threshold under which open loop is set, vehicle stopped." VALUE 0xa0020e94 _REC_S1VAL_20_u2 3.99993896484375 _CNV_A_R_LINEAR_____53_CM 0. 3.99993896484375 FORMAT "%7.5" /end CHARACTERISTIC
/begin CHARACTERISTIC Cxx_ct_pdl_tco_thd "Water temperature threshold when throttle off." VALUE 0xa0020e96 _REC_S1VAL_20_u2 240. _CNV_A_R_LINEAR_____54_CM -40. 200. FORMAT "%5.1" /end CHARACTERISTIC
/begin CHARACTERISTIC Cxx_dly_ocl_amp_thd "Atmospheric pressure under which postponed open loop is disabled." VALUE 0xa0020e98 _REC_S1VAL_20_u2 20000. _CNV_A_R_LINEAR_____57_CM 0. 20000. FORMAT "%5.0" /end CHARACTERISTIC
/begin CHARACTERISTIC Cxx_dly_ocl_l_n_thd "Engine speed under which postponed open loop is disabled. (take off)" VALUE 0xa0020e9a _REC_S1VAL_20_u2 16383.75 _CNV_A_R_ENSD_LINEA_24_CM 0. 16383.75 FORMAT "%8.2" /end CHARACTERISTIC
/begin CHARACTERISTIC Cxx_dly_ocl_up_n_thd "Engine speed over which postponed open loop is disabled. (thermic protection)" VALUE 0xa0020e9c _REC_S1VAL_20_u2 16383.75 _CNV_A_R_ENSD_LINEA_24_CM 0. 16383.75 FORMAT "%8.2" /end CHARACTERISTIC
/begin CHARACTERISTIC Cxx_fl_ena_n_thd "Engine speed under which full load enrichment is disabled." VALUE 0xa0020e9e _REC_S1VAL_20_u2 16383.75 _CNV_A_R_ENSD_LINEA_24_CM 0. 16383.75 FORMAT "%8.2" /end CHARACTERISTIC
/begin CHARACTERISTIC Cxx_fl_n_thd "Engine speed under which we exit full load conditions." VALUE 0xa0020ea0 _REC_S1VAL_20_u2 16383.75 _CNV_A_R_ENSD_LINEA_24_CM 0. 16383.75 FORMAT "%8.2" /end CHARACTERISTIC
/begin CHARACTERISTIC Cxx_fl_n_thd_hys "Hysteresis on Engine speed for full load conditions." VALUE 0xa0020ea2 _REC_S1VAL_20_u2 16383.75 _CNV_A_R_ENSD_LINEA_24_CM 0. 16383.75 FORMAT "%8.2" /end CHARACTERISTIC
/begin CHARACTERISTIC Cxx_h_dly_ocl_tco_thd "Coolant temperature over which postponed open loop is disabled." VALUE 0xa0020ea4 _REC_S1VAL_20_u2 240. _CNV_A_R_LINEAR_____54_CM -40. 200. FORMAT "%5.1" /end CHARACTERISTIC
/begin CHARACTERISTIC Cxx_l_dly_ocl_tco_thd "Engine coolant temperature under which postponed open loop is disabled." VALUE 0xa0020ea6 _REC_S1VAL_20_u2 240. _CNV_A_R_LINEAR_____54_CM -40. 200. FORMAT "%5.1" /end CHARACTERISTIC
/begin CHARACTERISTIC Cxx_ol_ti_fac_dec "Maximum decrementation of richness open loop factor during return to closed loop(per step)." VALUE 0xa0020eb2 _REC_S1VAL_20_u1 1.328125 _CNV_A_R_LINEAR_____71_CM 0. 1.328125 FORMAT "%8.6" /end CHARACTERISTIC
/begin CHARACTERISTIC Cxx_ol_ti_fac_inc "Maximum increment of richness open loop factor during exit of closed loop(per step)." VALUE 0xa0020eb3 _REC_S1VAL_20_u1 1.328125 _CNV_A_R_LINEAR_____71_CM 0. 1.328125 FORMAT "%8.6" /end CHARACTERISTIC
/begin CHARACTERISTIC Cxx_rich_cl_tco_thd "Engine coolant temperature under which Richness closed loop is forbidden." VALUE 0xa0020ea8 _REC_S1VAL_20_u2 240. _CNV_A_R_LINEAR_____54_CM -40. 200. FORMAT "%5.1" /end CHARACTERISTIC
/begin CHARACTERISTIC Cxx_rich_ol_fim_thd "Injected fuel mass under which richness closed loop is forbidden." VALUE 0xa0020eb4 _REC_S1VAL_20_u1 41.7792 _CNV_A_R_LINEAR_____75_CM 0. 41.7792 FORMAT "%8.5" /end CHARACTERISTIC
/begin CHARACTERISTIC Cxx_sta_fl_off_dly "Init value of delay before allowing richness full load phase." VALUE 0xa0020eaa _REC_S1VAL_20_u2 6553.5 _CNV_A_R_LINEAR_____4_CM 0. 6553.5 FORMAT "%6.1" /end CHARACTERISTIC
/begin CHARACTERISTIC Cxx_sta_fl_off_dly_lpg "Init value of delay before allowing richness full load phase. (Exotic fuel)" VALUE 0xa0020eac _REC_S1VAL_20_u2 6553.5 _CNV_A_R_LINEAR_____4_CM 0. 6553.5 FORMAT "%6.1" /end CHARACTERISTIC
/begin AXIS_PTS Ctb_wet_eal "9 eal breakpoints table for wall wetting" 0xa002e860 Vxx_eal _REC_A2AXS_20_u2 3.99993896484375 _CNV_A_R_LINEAR_____53_CM 9 0. 3.99993896484375 FORMAT "%7.5" /end AXIS_PTS
/begin AXIS_PTS Ctb_wet_in_vvtc_angl "5 VVTC position breackpoints table for wall wetting" 0xa002e874 Vxx_in_vvtc_angl _REC_A2AXS_20_u2 719.98 _CNV_A_R_LINEAR_____76_CM 5 0. 719.98 FORMAT "%6.2" /end AXIS_PTS
/begin AXIS_PTS Ctb_wet_n "5 RPM breakpoints table for wall wetting" 0xa002e880 Vxx_n _REC_A2AXS_20_u2 16383.75 _CNV_A_R_ENSD_LINEA_24_CM 5 0. 16383.75 FORMAT "%8.2" /end AXIS_PTS
/begin AXIS_PTS Ctb_wet_tco_17 "17 water temperature breakpoints table for wall wetting" 0xa002e88c Vxx_tco _REC_A2AXS_20_u2 240. _CNV_A_R_LINEAR_____54_CM 17 -40. 200. FORMAT "%5.1" /end AXIS_PTS
/begin AXIS_PTS Ctb_wet_tco_9 "9 water temperature breakpoints table for wall wetting" 0xa002e8b0 Vxx_tco _REC_A2AXS_20_u2 240. _CNV_A_R_LINEAR_____54_CM 9 -40. 200. FORMAT "%5.1" /end AXIS_PTS
/begin CHARACTERISTIC Cmp_wet_dep_fac_tco00 "map of fuel film factor for a 0¬∞C water temp√©rature" MAP 0xa002e8c4 _REC_A1MAP_20_u1_u2_u2 2550. _CNV_A_R_LINEAR_____77_CM 0. 2550. FORMAT "%4.0"
 /begin AXIS_DESCR COM_AXIS Vxx_eal _CNV_A_R_LINEAR_____53_CM 9 0. 3.99993896484375 FORMAT "%7.5" AXIS_PTS_REF Ctb_wet_eal /end AXIS_DESCR
 /begin AXIS_DESCR COM_AXIS Vxx_n _CNV_A_R_ENSD_LINEA_24_CM 5 0. 16383.75 FORMAT "%8.2" AXIS_PTS_REF Ctb_wet_n /end AXIS_DESCR
/end CHARACTERISTIC
/begin CHARACTERISTIC Cmp_wet_dep_fac_tco20 "map of fuel film factor for a 20¬∞C water temperature" MAP 0xa002e8f4 _REC_A1MAP_20_u1_u2_u2 2550. _CNV_A_R_LINEAR_____77_CM 0. 2550. FORMAT "%4.0"
 /begin AXIS_DESCR COM_AXIS Vxx_eal _CNV_A_R_LINEAR_____53_CM 9 0. 3.99993896484375 FORMAT "%7.5" AXIS_PTS_REF Ctb_wet_eal /end AXIS_DESCR
 /begin AXIS_DESCR COM_AXIS Vxx_n _CNV_A_R_ENSD_LINEA_24_CM 5 0. 16383.75 FORMAT "%8.2" AXIS_PTS_REF Ctb_wet_n /end AXIS_DESCR
/end CHARACTERISTIC
/begin CHARACTERISTIC Cmp_wet_dep_fac_tco40 "map of fuel film factor for a 40¬∞C water temperature" MAP 0xa002e924 _REC_A1MAP_20_u1_u2_u2 2550. _CNV_A_R_LINEAR_____77_CM 0. 2550. FORMAT "%4.0"
 /begin AXIS_DESCR COM_AXIS Vxx_eal _CNV_A_R_LINEAR_____53_CM 9 0. 3.99993896484375 FORMAT "%7.5" AXIS_PTS_REF Ctb_wet_eal /end AXIS_DESCR
 /begin AXIS_DESCR COM_AXIS Vxx_n _CNV_A_R_ENSD_LINEA_24_CM 5 0. 16383.75 FORMAT "%8.2" AXIS_PTS_REF Ctb_wet_n /end AXIS_DESCR
/end CHARACTERISTIC
/begin CHARACTERISTIC Cmp_wet_dep_fac_tco60 "map of fuel film factor for a 60¬∞C water temperature" MAP 0xa002e954 _REC_A1MAP_20_u1_u2_u2 2550. _CNV_A_R_LINEAR_____77_CM 0. 2550. FORMAT "%4.0"
 /begin AXIS_DESCR COM_AXIS Vxx_eal _CNV_A_R_LINEAR_____53_CM 9 0. 3.99993896484375 FORMAT "%7.5" AXIS_PTS_REF Ctb_wet_eal /end AXIS_DESCR
 /begin AXIS_DESCR COM_AXIS Vxx_n _CNV_A_R_ENSD_LINEA_24_CM 5 0. 16383.75 FORMAT "%8.2" AXIS_PTS_REF Ctb_wet_n /end AXIS_DESCR
/end CHARACTERISTIC
/begin CHARACTERISTIC Cmp_wet_dep_fac_tco80 "map of fuel film factor for a 80¬∞C water temperature" MAP 0xa002e984 _REC_A1MAP_20_u1_u2_u2 2550. _CNV_A_R_LINEAR_____77_CM 0. 2550. FORMAT "%4.0"
 /begin AXIS_DESCR COM_AXIS Vxx_eal _CNV_A_R_LINEAR_____53_CM 9 0. 3.99993896484375 FORMAT "%7.5" AXIS_PTS_REF Ctb_wet_eal /end AXIS_DESCR
 /begin AXIS_DESCR COM_AXIS Vxx_n _CNV_A_R_ENSD_LINEA_24_CM 5 0. 16383.75 FORMAT "%8.2" AXIS_PTS_REF Ctb_wet_n /end AXIS_DESCR
/end CHARACTERISTIC
/begin CHARACTERISTIC Cmp_wet_fil_fac_tco00 "map of dynamic filter factors in acceleration for a 0¬∞C water temperature" MAP 0xa002e9b4 _REC_A1MAP_20_u1_u2_u2 9.9609375e-002 _CNV_A_R_LINEAR_____78_CM 0. 9.9609375e-002 FORMAT "%5.4"
 /begin AXIS_DESCR COM_AXIS Vxx_eal _CNV_A_R_LINEAR_____53_CM 9 0. 3.99993896484375 FORMAT "%7.5" AXIS_PTS_REF Ctb_wet_eal /end AXIS_DESCR
 /begin AXIS_DESCR COM_AXIS Vxx_n _CNV_A_R_ENSD_LINEA_24_CM 5 0. 16383.75 FORMAT "%8.2" AXIS_PTS_REF Ctb_wet_n /end AXIS_DESCR
/end CHARACTERISTIC
/begin CHARACTERISTIC Cmp_wet_fil_fac_tco20 "map of dynamic filter factors in acceleration for a 20¬∞C water temperature" MAP 0xa002e9e4 _REC_A1MAP_20_u1_u2_u2 9.9609375e-002 _CNV_A_R_LINEAR_____78_CM 0. 9.9609375e-002 FORMAT "%5.4"
 /begin AXIS_DESCR COM_AXIS Vxx_eal _CNV_A_R_LINEAR_____53_CM 9 0. 3.99993896484375 FORMAT "%7.5" AXIS_PTS_REF Ctb_wet_eal /end AXIS_DESCR
 /begin AXIS_DESCR COM_AXIS Vxx_n _CNV_A_R_ENSD_LINEA_24_CM 5 0. 16383.75 FORMAT "%8.2" AXIS_PTS_REF Ctb_wet_n /end AXIS_DESCR
/end CHARACTERISTIC
/begin CHARACTERISTIC Cmp_wet_fil_fac_tco40 "map of dynamic filter factors in acceleration for a 40¬∞C water temperature" MAP 0xa002ea14 _REC_A1MAP_20_u1_u2_u2 9.9609375e-002 _CNV_A_R_LINEAR_____78_CM 0. 9.9609375e-002 FORMAT "%5.4"
 /begin AXIS_DESCR COM_AXIS Vxx_eal _CNV_A_R_LINEAR_____53_CM 9 0. 3.99993896484375 FORMAT "%7.5" AXIS_PTS_REF Ctb_wet_eal /end AXIS_DESCR
 /begin AXIS_DESCR COM_AXIS Vxx_n _CNV_A_R_ENSD_LINEA_24_CM 5 0. 16383.75 FORMAT "%8.2" AXIS_PTS_REF Ctb_wet_n /end AXIS_DESCR
/end CHARACTERISTIC
/begin CHARACTERISTIC Cmp_wet_fil_fac_tco60 "map of dynamic filter factors in acceleration for a 60¬∞C water temperature" MAP 0xa002ea44 _REC_A1MAP_20_u1_u2_u2 9.9609375e-002 _CNV_A_R_LINEAR_____78_CM 0. 9.9609375e-002 FORMAT "%5.4"
 /begin AXIS_DESCR COM_AXIS Vxx_eal _CNV_A_R_LINEAR_____53_CM 9 0. 3.99993896484375 FORMAT "%7.5" AXIS_PTS_REF Ctb_wet_eal /end AXIS_DESCR
 /begin AXIS_DESCR COM_AXIS Vxx_n _CNV_A_R_ENSD_LINEA_24_CM 5 0. 16383.75 FORMAT "%8.2" AXIS_PTS_REF Ctb_wet_n /end AXIS_DESCR
/end CHARACTERISTIC
/begin CHARACTERISTIC Cmp_wet_fil_fac_tco80 "map of dynamic filter factors in acceleration for a 80¬∞C water temperature" MAP 0xa002ea74 _REC_A1MAP_20_u1_u2_u2 9.9609375e-002 _CNV_A_R_LINEAR_____78_CM 0. 9.9609375e-002 FORMAT "%5.4"
 /begin AXIS_DESCR COM_AXIS Vxx_eal _CNV_A_R_LINEAR_____53_CM 9 0. 3.99993896484375 FORMAT "%7.5" AXIS_PTS_REF Ctb_wet_eal /end AXIS_DESCR
 /begin AXIS_DESCR COM_AXIS Vxx_n _CNV_A_R_ENSD_LINEA_24_CM 5 0. 16383.75 FORMAT "%8.2" AXIS_PTS_REF Ctb_wet_n /end AXIS_DESCR
/end CHARACTERISTIC
/begin CHARACTERISTIC Cmp_wet_in_vvtc_cor_fac "map of corrective gain depending on VVTC position for the calculation of the stabilized fuel film mass" MAP 0xa002eaa4 _REC_A1MAP_20_u1_u2_u2 1.9921875 _CNV_A_R_LINEAR_____43_CM 0. 1.9921875 FORMAT "%8.6"
 /begin AXIS_DESCR COM_AXIS Vxx_tco _CNV_A_R_LINEAR_____54_CM 9 -40. 200. FORMAT "%5.1" AXIS_PTS_REF Ctb_wet_tco_9 /end AXIS_DESCR
 /begin AXIS_DESCR COM_AXIS Vxx_in_vvtc_angl _CNV_A_R_LINEAR_____76_CM 5 0. 719.98 FORMAT "%6.2" AXIS_PTS_REF Ctb_wet_in_vvtc_angl /end AXIS_DESCR
/end CHARACTERISTIC
/begin CHARACTERISTIC Ctp_wet_acel_cor_fac "Table of corrective factors in acceleration" CURVE 0xa002ead4 _REC_A1CUR_20_u2_u2 65.536 _CNV_A_R_LINEAR_____79_CM 0. 65.536 FORMAT "%5.4"
 /begin AXIS_DESCR COM_AXIS Vxx_tco _CNV_A_R_LINEAR_____54_CM 17 -40. 200. FORMAT "%5.1" AXIS_PTS_REF Ctb_wet_tco_17 /end AXIS_DESCR
/end CHARACTERISTIC
/begin CHARACTERISTIC Ctp_wet_decl_cor_fac "Table of corrective factors in deceleration" CURVE 0xa002eaf8 _REC_A1CUR_20_u2_u2 65.536 _CNV_A_R_LINEAR_____79_CM 0. 65.536 FORMAT "%5.4"
 /begin AXIS_DESCR COM_AXIS Vxx_tco _CNV_A_R_LINEAR_____54_CM 17 -40. 200. FORMAT "%5.1" AXIS_PTS_REF Ctb_wet_tco_17 /end AXIS_DESCR
/end CHARACTERISTIC
/begin CHARACTERISTIC Ctp_wet_decl_fil_fac "table of dynamic filter factors in deceleration" CURVE 0xa002eb1c _REC_A1CUR_20_u1_u2 9.9609375e-002 _CNV_A_R_LINEAR_____78_CM 0. 9.9609375e-002 FORMAT "%5.4"
 /begin AXIS_DESCR COM_AXIS Vxx_tco _CNV_A_R_LINEAR_____54_CM 17 -40. 200. FORMAT "%5.1" AXIS_PTS_REF Ctb_wet_tco_17 /end AXIS_DESCR
/end CHARACTERISTIC
/begin CHARACTERISTIC Ctp_wet_ini_acel_cor_ofs "Table of specific corrective offset in case of first acceleration" CURVE 0xa002eb30 _REC_A1CUR_20_u2_u2 65.53400000000001 _CNV_A_R_LINEAR_____80_CM 0. 65.53400000000001
 /begin AXIS_DESCR COM_AXIS Vxx_tco _CNV_A_R_LINEAR_____54_CM 17 -40. 200. FORMAT "%5.1" AXIS_PTS_REF Ctb_wet_tco_17 /end AXIS_DESCR
/end CHARACTERISTIC
/begin CHARACTERISTIC Ctp_wet_vol_dif_thd_acel "Threshold to apply the wall wetting correction in acceleration" CURVE 0xa002eb54 _REC_A1CUR_20_u2_u2 1000. _CNV_A_R_LINEAR_____81_CM 0. 1000. FORMAT "%6.1"
 /begin AXIS_DESCR COM_AXIS Vxx_tco _CNV_A_R_LINEAR_____54_CM 9 -40. 200. FORMAT "%5.1" AXIS_PTS_REF Ctb_wet_tco_9 /end AXIS_DESCR
/end CHARACTERISTIC
/begin CHARACTERISTIC Ctp_wet_vol_dif_thd_decl "Threshold to apply the wall wetting correction in deceleration" CURVE 0xa002eb68 _REC_A1CUR_20_u2_u2 1000. _CNV_A_R_LINEAR_____81_CM 0. 1000. FORMAT "%6.1"
 /begin AXIS_DESCR COM_AXIS Vxx_tco _CNV_A_R_LINEAR_____54_CM 9 -40. 200. FORMAT "%5.1" AXIS_PTS_REF Ctb_wet_tco_9 /end AXIS_DESCR
/end CHARACTERISTIC
/begin CHARACTERISTIC Ctp_wet_vol_dif_thd_ini "Threshold to autorize first acceleration detection" CURVE 0xa002eb7c _REC_A1CUR_20_u2_u2 1000. _CNV_A_R_LINEAR_____81_CM 0. 1000. FORMAT "%6.1"
 /begin AXIS_DESCR COM_AXIS Vxx_tco _CNV_A_R_LINEAR_____54_CM 9 -40. 200. FORMAT "%5.1" AXIS_PTS_REF Ctb_wet_tco_9 /end AXIS_DESCR
/end CHARACTERISTIC
/begin CHARACTERISTIC Ctp_wet_vol_dif_thd_sta "Threshold to apply the wall wetting correction in a specific after start time" CURVE 0xa002eb90 _REC_A1CUR_20_u2_u2 1000. _CNV_A_R_LINEAR_____81_CM 0. 1000. FORMAT "%6.1"
 /begin AXIS_DESCR COM_AXIS Vxx_tco _CNV_A_R_LINEAR_____54_CM 9 -40. 200. FORMAT "%5.1" AXIS_PTS_REF Ctb_wet_tco_9 /end AXIS_DESCR
/end CHARACTERISTIC
/begin CHARACTERISTIC Ctp_wet_vol_dif_thd_sta_t "Table of time left after start for a specific after start threshold" CURVE 0xa002eba4 _REC_A1CUR_20_u1_u2 255. _CNV_A_R_LINEAR_____82_CM 0. 255. FORMAT "%3.0"
 /begin AXIS_DESCR COM_AXIS Vxx_tco _CNV_A_R_LINEAR_____54_CM 9 -40. 200. FORMAT "%5.1" AXIS_PTS_REF Ctb_wet_tco_9 /end AXIS_DESCR
/end CHARACTERISTIC
/begin MEASUREMENT Vbx_decl_prs_lean_ena "Autorization of lean mixture in deceleration" UBYTE _CNV_S_2_RANGE______3_CM 1 0. 0. 1. ECU_ADDRESS 0xd0003f9a BIT_MASK 0x1 /end MEASUREMENT
/begin MEASUREMENT Vbx_wet_ini_acel_cdn "Indicates that first acceleration has been detected" UBYTE _CNV_S_2_RANGE______3_CM 1 0. 0. 1. ECU_ADDRESS 0xd00056a6 BIT_MASK 0x1 /end MEASUREMENT
/begin MEASUREMENT Vbx_wet_ini_acel_rest_cdn "Indicator of restart conditions when the key ON is detected" UBYTE _CNV_S_2_RANGE______3_CM 1 0. 0. 1. ECU_ADDRESS 0xd0003f9b BIT_MASK 0x1 /end MEASUREMENT
/begin MEASUREMENT Vbx_wet_ti_clc_ena "Injection time is computed." UBYTE _CNV_S_2_RANGE______3_CM 1 0. 0. 1. ECU_ADDRESS 0xd0003f9c BIT_MASK 0x1 /end MEASUREMENT
/begin MEASUREMENT Vxx_decl_prs_lean_dsb_dly "Time after start when lean mixture in deceleration is forbidden" UBYTE _CNV_A_R_LINEAR_____82_CM 1 0. 0. 255. ECU_ADDRESS 0xd0003f9d FORMAT "%3.0" /end MEASUREMENT
/begin MEASUREMENT Vxx_fim "Average injected fuel mass disrigarding cylinder number or injection phase (1 or 2)" ULONG _CNV_A_R_LINEAR_____83_CM 1 0. 0. 4800. ECU_ADDRESS 0xd0001cc0 FORMAT "%10.6" /end MEASUREMENT
/begin MEASUREMENT Vxx_wet_acel_cor_fac "corrective factor for wall wetting correction and acceleration" UWORD _CNV_A_R_LINEAR_____79_CM 1 0. 0. 65.536 ECU_ADDRESS 0xd0003618 FORMAT "%5.4" /end MEASUREMENT
/begin MEASUREMENT Vxx_wet_acel_decl_bch_cor_fac "Final corrective factor for wall wetting correction in bench mode" UWORD _CNV_A_R_LINEAR_____79_CM 1 0. 0. 131.07 ECU_ADDRESS 0xd000361a FORMAT "%4.3" /end MEASUREMENT
/begin MEASUREMENT Vxx_wet_acel_decl_cor_fac "Final corrective factor for wall wetting correction" UWORD _CNV_A_R_LINEAR_____79_CM 1 0. 0. 131.07 ECU_ADDRESS 0xd000361c FORMAT "%4.3" /end MEASUREMENT
/begin MEASUREMENT Vxx_wet_aftr_sta_t "Time left after start for a specific after start threshold" UWORD _CNV_A_R_LINEAR_____4_CM 1 0. 0. 6553.5 ECU_ADDRESS 0xd000361e FORMAT "%6.1" /end MEASUREMENT
/begin MEASUREMENT Vxx_wet_aftr_sta_t_prev "Time left after start tor a specific after start threshold (previous time step)" UWORD _CNV_A_R_LINEAR_____4_CM 1 0. 0. 6553.5 ECU_ADDRESS 0xd0003620 FORMAT "%6.1" /end MEASUREMENT
/begin MEASUREMENT Vxx_wet_cor_ofs_itl "Specific corrective offset in case of first acceleration (internal)" UWORD _CNV_A_R_LINEAR_____80_CM 1 0. 0. 65.53400000000001 ECU_ADDRESS 0xd0003622 /end MEASUREMENT
/begin MEASUREMENT Vxx_wet_decl_cor_fac "corrective factor for wall wetting correction in deceleration" UWORD _CNV_A_R_LINEAR_____79_CM 1 0. 0. 65.536 ECU_ADDRESS 0xd0003624 FORMAT "%5.4" /end MEASUREMENT
/begin MEASUREMENT Vxx_wet_dep_fac "Gain for the calculation of the stabilized fuel film" UBYTE _CNV_A_R_LINEAR_____77_CM 1 0. 0. 2550. ECU_ADDRESS 0xd0003f9e FORMAT "%4.0" /end MEASUREMENT
/begin MEASUREMENT Vxx_wet_dyn_vol "Physical fuel film mass in the intake ports" UWORD _CNV_A_R_LINEAR_____84_CM 1 0. 0. 8999.8626709 ECU_ADDRESS 0xd0003626 FORMAT "%6.5" /end MEASUREMENT
/begin MEASUREMENT Vxx_wet_dyn_vol_fil_fac "Dynamic filter factor of the fuel film" UBYTE _CNV_A_R_LINEAR_____78_CM 1 0. 0. 9.9609375e-002 ECU_ADDRESS 0xd0003f9f FORMAT "%5.4" /end MEASUREMENT
/begin MEASUREMENT Vxx_wet_dyn_vol_prev "Physical fuel film mass in the intake ports (at the previous tdc)" UWORD _CNV_A_R_LINEAR_____84_CM 1 0. 0. 8999.8626709 ECU_ADDRESS 0xd0003628 FORMAT "%6.5" /end MEASUREMENT
/begin MEASUREMENT Vxx_wet_in_vvtc_cor_fac "Corrective gain depending on VVTC position for the calculation of the stabilized fuel film mass" UBYTE _CNV_A_R_LINEAR_____43_CM 1 0. 0. 1.9921875 ECU_ADDRESS 0xd0003fa0 FORMAT "%8.6" /end MEASUREMENT
/begin MEASUREMENT Vxx_wet_ini_acel_cor_ofs "Specific corrective offset in case of first acceleration" UWORD _CNV_A_R_LINEAR_____80_CM 1 0. 0. 65.53400000000001 ECU_ADDRESS 0xd000362a /end MEASUREMENT
/begin MEASUREMENT Vxx_wet_ini_acel_sta_t "Time left after start to detect a first acceleration" UWORD _CNV_A_R_LINEAR_____34_CM 1 0. 0. 655.35 ECU_ADDRESS 0xd000362c FORMAT "%6.2" /end MEASUREMENT
/begin MEASUREMENT Vxx_wet_stat_vol "Fuel film mass in stabilized conditions" UWORD _CNV_A_R_LINEAR_____84_CM 1 0. 0. 8999.8626709 ECU_ADDRESS 0xd000362e FORMAT "%6.5" /end MEASUREMENT
/begin MEASUREMENT Vxx_wet_ti_cut_ctr "Pulse counter" UBYTE _CNV_A_R_ECME_LINEA_0_CM 1 0. 0. 255. ECU_ADDRESS 0xd0003fa1 FORMAT "%3.0" /end MEASUREMENT
/begin MEASUREMENT Vxx_wet_ti_cut_tdc_ctr "Counter of injection time pulse TDC" UWORD _CNV_A_R_LINEAR_____55_CM 1 0. 0. 65535. ECU_ADDRESS 0xd0003630 FORMAT "%5.0" /end MEASUREMENT
/begin MEASUREMENT Vxx_wet_vol_dif_thd_acel "Threshold to apply the wall wetting correction in acceleration" UWORD _CNV_A_R_LINEAR_____81_CM 1 0. 0. 1000. ECU_ADDRESS 0xd0003632 FORMAT "%6.1" /end MEASUREMENT
/begin MEASUREMENT Vxx_wet_vol_dif_thd_decl "Threshold to apply the wall wetting correction in deceleration" UWORD _CNV_A_R_LINEAR_____81_CM 1 0. 0. 1000. ECU_ADDRESS 0xd0003634 FORMAT "%6.1" /end MEASUREMENT
/begin MEASUREMENT Vxx_wet_wht_cor "Wall wetting final correction" SLONG _CNV_A_R_LINEAR_____85_CM 1 0. -4800. 4800. ECU_ADDRESS 0xd0001cc4 FORMAT "%11.7" /end MEASUREMENT
/begin CHARACTERISTIC Cbx_wet_stat_cor_bch_mod "Bench mode stabilized fuel film calculation" VALUE 0xa0020ec4 _REC_S1VAL_20_u1 1. _CNV_A_R_ECME_LINEA_0_CM 0. 1. FORMAT "%1.0" BIT_MASK 0x1 /end CHARACTERISTIC
/begin CHARACTERISTIC Cbx_wet_vol_dif_thd_sta_ena "Boolean to enable Ctp_wet_vol_dif_thd_sta as the threshold for first acceleration detection" VALUE 0xa0020ec5 _REC_S1VAL_20_u1 1. _CNV_A_R_ECME_LINEA_0_CM 0. 1. FORMAT "%1.0" BIT_MASK 0x1 /end CHARACTERISTIC
/begin CHARACTERISTIC Cxx_decl_lean_dsb_n_ofs "Width of hysteresis for activation of lean mixture in deceleration" VALUE 0xa0020eb6 _REC_S1VAL_20_u2 16383.75 _CNV_A_R_ENSD_LINEA_24_CM 0. 16383.75 FORMAT "%8.2" /end CHARACTERISTIC
/begin CHARACTERISTIC Cxx_decl_lean_dsb_n_thd "Threshold for activation of lean mixture in deceleration" VALUE 0xa0020eb8 _REC_S1VAL_20_u2 16383.75 _CNV_A_R_ENSD_LINEA_24_CM 0. 16383.75 FORMAT "%8.2" /end CHARACTERISTIC
/begin CHARACTERISTIC Cxx_decl_prs_lean_dsb_dly "Delay after start when lean mixture in deceleration is forbidden" VALUE 0xa0020ec6 _REC_S1VAL_20_u1 255. _CNV_A_R_LINEAR_____82_CM 0. 255. FORMAT "%3.0" /end CHARACTERISTIC
/begin CHARACTERISTIC Cxx_wet_acel_bch_cor_fac "Corrective factor for wall wetting correction in acceleration in bench mode conditions" VALUE 0xa0020eba _REC_S1VAL_20_u2 131.07 _CNV_A_R_LINEAR_____79_CM 0. 131.07 FORMAT "%4.3" /end CHARACTERISTIC
/begin CHARACTERISTIC Cxx_wet_acel_bch_fil_fac "Dynamic filter factor of the fuel film in acceleration in bench mode conditions" VALUE 0xa0020ec7 _REC_S1VAL_20_u1 9.9609375e-002 _CNV_A_R_LINEAR_____78_CM 0. 9.9609375e-002 FORMAT "%5.4" /end CHARACTERISTIC
/begin CHARACTERISTIC Cxx_wet_bch_dep_fac "Gain for the calculation of the stabilized fuel film in bench mode conditions" VALUE 0xa0020ec8 _REC_S1VAL_20_u1 2550. _CNV_A_R_LINEAR_____77_CM 0. 2550. FORMAT "%4.0" /end CHARACTERISTIC
/begin CHARACTERISTIC Cxx_wet_decl_bch_cor_fac "Corrective factor for wall wetting correction in deceleration in bench mode conditions" VALUE 0xa0020ebc _REC_S1VAL_20_u2 131.07 _CNV_A_R_LINEAR_____79_CM 0. 131.07 FORMAT "%4.3" /end CHARACTERISTIC
/begin CHARACTERISTIC Cxx_wet_decl_bch_fil_fac "Dynamic filter factor of the fuel film in deceleration in bench mode conditions" VALUE 0xa0020ec9 _REC_S1VAL_20_u1 9.9609375e-002 _CNV_A_R_LINEAR_____78_CM 0. 9.9609375e-002 FORMAT "%5.4" /end CHARACTERISTIC
/begin CHARACTERISTIC Cxx_wet_ini_acel_ofs_t "Time for the offset to reach zero after initialization" VALUE 0xa0020ebe _REC_S1VAL_20_u2 655.35 _CNV_A_R_LINEAR_____34_CM 0. 655.35 FORMAT "%6.2" /end CHARACTERISTIC
/begin CHARACTERISTIC Cxx_wet_ini_acel_sta_t "Maximum time left after start to detect a fisrt acceleration" VALUE 0xa0020ec0 _REC_S1VAL_20_u2 655.35 _CNV_A_R_LINEAR_____34_CM 0. 655.35 FORMAT "%6.2" /end CHARACTERISTIC
/begin CHARACTERISTIC Cxx_wet_ti_cut_nr "Number of injection time pulse, in wall wetting bench mode" VALUE 0xa0020eca _REC_S1VAL_20_u1 255. _CNV_A_R_ECME_LINEA_0_CM 0. 255. FORMAT "%3.0" /end CHARACTERISTIC
/begin CHARACTERISTIC Cxx_wet_ti_cut_tdc_nr "Width of injection time pulse, in wall wetting bench mode" VALUE 0xa0020ec2 _REC_S1VAL_20_u2 65535. _CNV_A_R_LINEAR_____55_CM 0. 65535. FORMAT "%5.0" /end CHARACTERISTIC
/begin MEASUREMENT Vbx_ad_lsm_ena "Adaptive less square enable" UBYTE _CNV_S_2_RANGE______3_CM 1 0. 0. 1. ECU_ADDRESS 0xd0003f49 BIT_MASK 0x1 /end MEASUREMENT
/begin MEASUREMENT Vbx_ad_lsm_req "Adaptive less square request" UBYTE _CNV_S_2_RANGE______3_CM 1 0. 0. 1. ECU_ADDRESS 0xd0003f4a BIT_MASK 0x1 /end MEASUREMENT
/begin MEASUREMENT Vbx_is_hot_dly "Long time spent in idle speed regulation with hot engine" UBYTE _CNV_S_2_RANGE______3_CM 1 0. 0. 1. ECU_ADDRESS 0xd0003f4b BIT_MASK 0x1 /end MEASUREMENT
/begin MEASUREMENT Vbx_ti_ad1_zon0 "At least one successful learning in zone 0" UBYTE _CNV_S_2_RANGE______3_CM 1 0. 0. 1. ECU_ADDRESS 0xd0003f4c BIT_MASK 0x1 /end MEASUREMENT
/begin MEASUREMENT Vbx_ti_ad1_zon1 "At least one successful learning in zone 1" UBYTE _CNV_S_2_RANGE______3_CM 1 0. 0. 1. ECU_ADDRESS 0xd0003f4d BIT_MASK 0x1 /end MEASUREMENT
/begin MEASUREMENT Vbx_ti_ad1_zon2 "At least one successful learning in zone 2" UBYTE _CNV_S_2_RANGE______3_CM 1 0. 0. 1. ECU_ADDRESS 0xd0003f4e BIT_MASK 0x1 /end MEASUREMENT
/begin MEASUREMENT Vbx_ti_ad1_zon3 "At least one successful learning in zone 3" UBYTE _CNV_S_2_RANGE______3_CM 1 0. 0. 1. ECU_ADDRESS 0xd0003f4f BIT_MASK 0x1 /end MEASUREMENT
/begin MEASUREMENT Vbx_ti_ad1_zon4 "At least one successful learning in zone 4" UBYTE _CNV_S_2_RANGE______3_CM 1 0. 0. 1. ECU_ADDRESS 0xd0003f50 BIT_MASK 0x1 /end MEASUREMENT
/begin MEASUREMENT Vtd_ti_b[0] "Variation area of learning" UBYTE _CNV_A_R_ECME_LINEA_0_CM 1 0. 0. 255. ECU_ADDRESS 0xd0003f44 FORMAT "%3.0" /end MEASUREMENT
/begin MEASUREMENT Vtd_ti_b[1] "Variation area of learning" UBYTE _CNV_A_R_ECME_LINEA_0_CM 1 0. 0. 255. ECU_ADDRESS 0xd0003f45 FORMAT "%3.0" /end MEASUREMENT
/begin MEASUREMENT Vtd_ti_b[2] "Variation area of learning" UBYTE _CNV_A_R_ECME_LINEA_0_CM 1 0. 0. 255. ECU_ADDRESS 0xd0003f46 FORMAT "%3.0" /end MEASUREMENT
/begin MEASUREMENT Vtd_ti_b[3] "Variation area of learning" UBYTE _CNV_A_R_ECME_LINEA_0_CM 1 0. 0. 255. ECU_ADDRESS 0xd0003f47 FORMAT "%3.0" /end MEASUREMENT
/begin MEASUREMENT Vtd_ti_b[4] "Variation area of learning" UBYTE _CNV_A_R_ECME_LINEA_0_CM 1 0. 0. 255. ECU_ADDRESS 0xd0003f48 FORMAT "%3.0" /end MEASUREMENT
/begin MEASUREMENT Vxx_ad_lamb_swi_ctr "Switch counter above and  down lambda one" UBYTE _CNV_A_R_ECME_LINEA_0_CM 1 0. 0. 255. ECU_ADDRESS 0xd0003f51 FORMAT "%3.0" /end MEASUREMENT
/begin MEASUREMENT Vxx_imd_ti_ad_fac "Instantaneous adaptation factor on injection time" UBYTE _CNV_A_R_LINEAR_____51_CM 1 0. 0.6666667 1.3307292 ECU_ADDRESS 0xd0003f52 FORMAT "%5.3" /end MEASUREMENT
/begin MEASUREMENT Vxx_imd_ti_ad_ofs "Instantaneous adaptation offset on injection time" SBYTE _CNV_A_R_LINEAR_____50_CM 1 0. -512. 508. ECU_ADDRESS 0xd0003f53 FORMAT "%1.0" /end MEASUREMENT
/begin MEASUREMENT Vxx_imd_ti_ad_ofs_med "Instantaneous calculed adaptation offset on injection time" SBYTE _CNV_A_R_LINEAR_____50_CM 1 0. -512. 508. ECU_ADDRESS 0xd0003f54 FORMAT "%1.0" /end MEASUREMENT
/begin MEASUREMENT Vxx_is_hot_ti_cl_dly "Time spent in idle speed regulation with hot engine and with active richness regulation" UWORD _CNV_A_R_LINEAR_____4_CM 1 0. 0. 6553.5 ECU_ADDRESS 0xd0002ca4 FORMAT "%6.1" /end MEASUREMENT
/begin MEASUREMENT Vxx_mv_ti_ad_ofs_med "Mean calculted adaptation offset on injection time" SBYTE _CNV_A_R_LINEAR_____50_CM 1 0. -512. 508. ECU_ADDRESS 0xd0003f55 FORMAT "%1.0" /end MEASUREMENT
/begin MEASUREMENT Vxx_ti_ad_fac "Adaptation factor on injection time" UBYTE _CNV_A_R_LINEAR_____51_CM 1 0. 0.6666667 1.3307292 ECU_ADDRESS 0xd0003f56 FORMAT "%5.3" /end MEASUREMENT
/begin MEASUREMENT Vxx_ti_ad_fac_med "Instantaneous calculated adaptation factor on injection time" UBYTE _CNV_A_R_LINEAR_____51_CM 1 0. 0.6666667 1.3307292 ECU_ADDRESS 0xd0003f57 FORMAT "%5.3" /end MEASUREMENT
/begin MEASUREMENT Vxx_ti_ad_facm_med "Mean calculated adaptation factor on injection time" UBYTE _CNV_A_R_LINEAR_____51_CM 1 0. 0.6666667 1.3307292 ECU_ADDRESS 0xd0003f58 FORMAT "%5.3" /end MEASUREMENT
/begin MEASUREMENT Vxx_ti_ad_ofs "Adaptation offset on injection time" SBYTE _CNV_A_R_LINEAR_____50_CM 1 0. -512. 508. ECU_ADDRESS 0xd0003f59 FORMAT "%1.0" /end MEASUREMENT
/begin MEASUREMENT Vxx_ti_b_med "Pattern of the misadjustment from Vxx_mv_cl_ti_fac" UBYTE _CNV_A_R_ECME_LINEA_0_CM 1 0. 0. 255. ECU_ADDRESS 0xd0003f5a FORMAT "%3.0" /end MEASUREMENT
/begin MEASUREMENT Vxx_ti_zon_nr "Learning zone number" UBYTE _CNV_A_R_ECME_LINEA_0_CM 1 0. 0. 5. ECU_ADDRESS 0xd0003f5b FORMAT "%1.0" /end MEASUREMENT
/begin CHARACTERISTIC Ctd_max_mv_cld_ad[0] "Maximum value of learning for each zone" VALUE 0xa0020e46 _REC_S1VAL_20_u1 255. _CNV_A_R_ECME_LINEA_0_CM 0. 255. FORMAT "%3.0" /end CHARACTERISTIC
/begin CHARACTERISTIC Ctd_max_mv_cld_ad[1] "Maximum value of learning for each zone" VALUE 0xa0020e47 _REC_S1VAL_20_u1 255. _CNV_A_R_ECME_LINEA_0_CM 0. 255. FORMAT "%3.0" /end CHARACTERISTIC
/begin CHARACTERISTIC Ctd_max_mv_cld_ad[2] "Maximum value of learning for each zone" VALUE 0xa0020e48 _REC_S1VAL_20_u1 255. _CNV_A_R_ECME_LINEA_0_CM 0. 255. FORMAT "%3.0" /end CHARACTERISTIC
/begin CHARACTERISTIC Ctd_max_mv_cld_ad[3] "Maximum value of learning for each zone" VALUE 0xa0020e49 _REC_S1VAL_20_u1 255. _CNV_A_R_ECME_LINEA_0_CM 0. 255. FORMAT "%3.0" /end CHARACTERISTIC
/begin CHARACTERISTIC Ctd_max_mv_cld_ad[4] "Maximum value of learning for each zone" VALUE 0xa0020e4a _REC_S1VAL_20_u1 255. _CNV_A_R_ECME_LINEA_0_CM 0. 255. FORMAT "%3.0" /end CHARACTERISTIC
/begin CHARACTERISTIC Ctd_min_mv_cld_ad[0] "Minimum value of learning for each zone" VALUE 0xa0020e4c _REC_S1VAL_20_u1 255. _CNV_A_R_ECME_LINEA_0_CM 0. 255. FORMAT "%3.0" /end CHARACTERISTIC
/begin CHARACTERISTIC Ctd_min_mv_cld_ad[1] "Minimum value of learning for each zone" VALUE 0xa0020e4d _REC_S1VAL_20_u1 255. _CNV_A_R_ECME_LINEA_0_CM 0. 255. FORMAT "%3.0" /end CHARACTERISTIC
/begin CHARACTERISTIC Ctd_min_mv_cld_ad[2] "Minimum value of learning for each zone" VALUE 0xa0020e4e _REC_S1VAL_20_u1 255. _CNV_A_R_ECME_LINEA_0_CM 0. 255. FORMAT "%3.0" /end CHARACTERISTIC
/begin CHARACTERISTIC Ctd_min_mv_cld_ad[3] "Minimum value of learning for each zone" VALUE 0xa0020e4f _REC_S1VAL_20_u1 255. _CNV_A_R_ECME_LINEA_0_CM 0. 255. FORMAT "%3.0" /end CHARACTERISTIC
/begin CHARACTERISTIC Ctd_min_mv_cld_ad[4] "Minimum value of learning for each zone" VALUE 0xa0020e50 _REC_S1VAL_20_u1 255. _CNV_A_R_ECME_LINEA_0_CM 0. 255. FORMAT "%3.0" /end CHARACTERISTIC
/begin CHARACTERISTIC Ctd_ti_ad_fac_cor[0] "Factor used to calculate adaptation factor" VALUE 0xa0026720 _REC_S1VAL_20_s2 1.333309575 _CNV_A_R_LINEAR_____86_CM -0.66666496 0.6666446150000001 FORMAT "%7.5" /end CHARACTERISTIC
/begin CHARACTERISTIC Ctd_ti_ad_fac_cor[1] "Factor used to calculate adaptation factor" VALUE 0xa0026722 _REC_S1VAL_20_s2 1.333309575 _CNV_A_R_LINEAR_____86_CM -0.66666496 0.6666446150000001 FORMAT "%7.5" /end CHARACTERISTIC
/begin CHARACTERISTIC Ctd_ti_ad_fac_cor[2] "Factor used to calculate adaptation factor" VALUE 0xa0026724 _REC_S1VAL_20_s2 1.333309575 _CNV_A_R_LINEAR_____86_CM -0.66666496 0.6666446150000001 FORMAT "%7.5" /end CHARACTERISTIC
/begin CHARACTERISTIC Ctd_ti_ad_fac_cor[3] "Factor used to calculate adaptation factor" VALUE 0xa0026726 _REC_S1VAL_20_s2 1.333309575 _CNV_A_R_LINEAR_____86_CM -0.66666496 0.6666446150000001 FORMAT "%7.5" /end CHARACTERISTIC
/begin CHARACTERISTIC Ctd_ti_ad_fac_cor[4] "Factor used to calculate adaptation factor" VALUE 0xa0026728 _REC_S1VAL_20_s2 1.333309575 _CNV_A_R_LINEAR_____86_CM -0.66666496 0.6666446150000001 FORMAT "%7.5" /end CHARACTERISTIC
/begin CHARACTERISTIC Ctd_ti_ad_ofs_cor[0] "Maximum value of learning for each zone" VALUE 0xa002672c _REC_S1VAL_20_s2 8191.875 _CNV_A_R_LINEAR_____87_CM -4096. 4095.875 FORMAT "%3.1" /end CHARACTERISTIC
/begin CHARACTERISTIC Ctd_ti_ad_ofs_cor[1] "Maximum value of learning for each zone" VALUE 0xa002672e _REC_S1VAL_20_s2 8191.875 _CNV_A_R_LINEAR_____87_CM -4096. 4095.875 FORMAT "%3.1" /end CHARACTERISTIC
/begin CHARACTERISTIC Ctd_ti_ad_ofs_cor[2] "Maximum value of learning for each zone" VALUE 0xa0026730 _REC_S1VAL_20_s2 8191.875 _CNV_A_R_LINEAR_____87_CM -4096. 4095.875 FORMAT "%3.1" /end CHARACTERISTIC
/begin CHARACTERISTIC Ctd_ti_ad_ofs_cor[3] "Maximum value of learning for each zone" VALUE 0xa0026732 _REC_S1VAL_20_s2 8191.875 _CNV_A_R_LINEAR_____87_CM -4096. 4095.875 FORMAT "%3.1" /end CHARACTERISTIC
/begin CHARACTERISTIC Ctd_ti_ad_ofs_cor[4] "Maximum value of learning for each zone" VALUE 0xa0026734 _REC_S1VAL_20_s2 8191.875 _CNV_A_R_LINEAR_____87_CM -4096. 4095.875 FORMAT "%3.1" /end CHARACTERISTIC
/begin CHARACTERISTIC Ctd_ti_b_cor[0] "Factor used to calculate learning value" VALUE 0xa0020e52 _REC_S1VAL_20_u1 0.498046875 _CNV_A_R_LINEAR_____88_CM 0. 0.498046875 FORMAT "%5.3" /end CHARACTERISTIC
/begin CHARACTERISTIC Ctd_ti_b_cor[1] "Factor used to calculate learning value" VALUE 0xa0020e53 _REC_S1VAL_20_u1 0.498046875 _CNV_A_R_LINEAR_____88_CM 0. 0.498046875 FORMAT "%5.3" /end CHARACTERISTIC
/begin CHARACTERISTIC Ctd_ti_b_cor[2] "Factor used to calculate learning value" VALUE 0xa0020e54 _REC_S1VAL_20_u1 0.498046875 _CNV_A_R_LINEAR_____88_CM 0. 0.498046875 FORMAT "%5.3" /end CHARACTERISTIC
/begin CHARACTERISTIC Ctd_ti_b_cor[3] "Factor used to calculate learning value" VALUE 0xa0020e55 _REC_S1VAL_20_u1 0.498046875 _CNV_A_R_LINEAR_____88_CM 0. 0.498046875 FORMAT "%5.3" /end CHARACTERISTIC
/begin CHARACTERISTIC Ctd_ti_b_cor[4] "Factor used to calculate learning value" VALUE 0xa0020e56 _REC_S1VAL_20_u1 0.498046875 _CNV_A_R_LINEAR_____88_CM 0. 0.498046875 FORMAT "%5.3" /end CHARACTERISTIC
/begin CHARACTERISTIC Cxx_ad_lamb_swi_ctr "Switch counter limit before adaptation calculation" VALUE 0xa0020e6c _REC_S1VAL_20_u1 255. _CNV_A_R_ECME_LINEA_0_CM 0. 255. FORMAT "%3.0" /end CHARACTERISTIC
/begin CHARACTERISTIC Cxx_ad_off_ti_ad_fac "Adaptation factor in richness mode" VALUE 0xa0020e6d _REC_S1VAL_20_u1 0.6640625 _CNV_A_R_LINEAR_____51_CM 0.6666667 1.3307292 FORMAT "%5.3" /end CHARACTERISTIC
/begin CHARACTERISTIC Cxx_ad_off_ti_ad_ofs "Adaptation offset in richness mode" VALUE 0xa0020e6e _REC_S1VAL_20_s1 1020. _CNV_A_R_LINEAR_____50_CM -512. 508. FORMAT "%1.0" /end CHARACTERISTIC
/begin CHARACTERISTIC Cxx_cld_ad_nr "Number of learnings to refresh learning" VALUE 0xa0020e58 _REC_S1VAL_20_u2 65535. _CNV_A_R_ECME_LINEA_0_CM 0. 65535. FORMAT "%5.0" /end CHARACTERISTIC
/begin CHARACTERISTIC Cxx_is_hot_tco_thd "Temperature threshold to declare that a long time has been spent in idle speed regulation with hot engine and with active richness regulation" VALUE 0xa0020e5a _REC_S1VAL_20_u2 160. _CNV_A_R_LINEAR_____54_CM -40. 120. FORMAT "%5.1" /end CHARACTERISTIC
/begin CHARACTERISTIC Cxx_is_hot_ti_cl_dly "Time threshold to declare  that a long time has been spent in idle speed regulation with hot engine and with active richness regulation" VALUE 0xa0020e5c _REC_S1VAL_20_u2 6553.5 _CNV_A_R_LINEAR_____4_CM 0. 6553.5 FORMAT "%6.1" /end CHARACTERISTIC
/begin CHARACTERISTIC Cxx_max_cld_fac_thd "Maximum threshold not to refresh adaptation factor" VALUE 0xa0020e6f _REC_S1VAL_20_u1 0.6640625 _CNV_A_R_LINEAR_____51_CM 0.6666667 1.3307292 FORMAT "%5.3" /end CHARACTERISTIC
/begin CHARACTERISTIC Cxx_max_cld_ofs_thd "Maximum threshold not to refresh adaptation offset" VALUE 0xa0020e70 _REC_S1VAL_20_s1 1020. _CNV_A_R_LINEAR_____50_CM -512. 508. FORMAT "%1.0" /end CHARACTERISTIC
/begin CHARACTERISTIC Cxx_max_imd_ti_ad_fac "Maximum instantaneous value for the adaptation factor" VALUE 0xa0020e71 _REC_S1VAL_20_u1 0.6640625 _CNV_A_R_LINEAR_____51_CM 0.6666667 1.3307292 FORMAT "%5.3" /end CHARACTERISTIC
/begin CHARACTERISTIC Cxx_max_imd_ti_ad_ofs "Maximum instantaneous value for the adaptation offset" VALUE 0xa0020e72 _REC_S1VAL_20_s1 1020. _CNV_A_R_LINEAR_____50_CM -512. 508. FORMAT "%1.0" /end CHARACTERISTIC
/begin CHARACTERISTIC Cxx_max_mv_ti_ad_fac "Maximum mean value for the adaptation factor" VALUE 0xa0020e73 _REC_S1VAL_20_u1 0.6640625 _CNV_A_R_LINEAR_____51_CM 0.6666667 1.3307292 FORMAT "%5.3" /end CHARACTERISTIC
/begin CHARACTERISTIC Cxx_max_mv_ti_ad_ofs "Maximum mean value for the adaptation offset" VALUE 0xa0020e74 _REC_S1VAL_20_s1 1020. _CNV_A_R_LINEAR_____50_CM -512. 508. FORMAT "%1.0" /end CHARACTERISTIC
/begin CHARACTERISTIC Cxx_min_ad_fac_thd "Minimum threshold to refresh adaptation factor" VALUE 0xa0020e75 _REC_S1VAL_20_u1 0.6640625 _CNV_A_R_LINEAR_____67_CM 0. 0.6640625 FORMAT "%8.6" /end CHARACTERISTIC
/begin CHARACTERISTIC Cxx_min_ad_ofs_thd "Minimum threshold to refresh adaptation offset" VALUE 0xa0020e76 _REC_S1VAL_20_u1 1020. _CNV_A_R_LINEAR_____50_CM 0. 1020. FORMAT "%4.0" /end CHARACTERISTIC
/begin CHARACTERISTIC Cxx_min_cld_fac_thd "Minimum threshold not to refresh adaptation factor" VALUE 0xa0020e77 _REC_S1VAL_20_u1 0.6640625 _CNV_A_R_LINEAR_____51_CM 0.6666667 1.3307292 FORMAT "%5.3" /end CHARACTERISTIC
/begin CHARACTERISTIC Cxx_min_cld_ofs_thd "Minimum threshold not to refresh adaptation offset" VALUE 0xa0020e78 _REC_S1VAL_20_s1 1020. _CNV_A_R_LINEAR_____50_CM -512. 508. FORMAT "%1.0" /end CHARACTERISTIC
/begin CHARACTERISTIC Cxx_min_dif_ti_b "Minimum learning values difference to update final learning value" VALUE 0xa0020e79 _REC_S1VAL_20_u1 255. _CNV_A_R_ECME_LINEA_0_CM 0. 255. FORMAT "%3.0" /end CHARACTERISTIC
/begin CHARACTERISTIC Cxx_min_imd_ti_ad_fac "Minimum instantaneous value for the adaptation factor" VALUE 0xa0020e7a _REC_S1VAL_20_u1 0.6640625 _CNV_A_R_LINEAR_____51_CM 0.6666667 1.3307292 FORMAT "%5.3" /end CHARACTERISTIC
/begin CHARACTERISTIC Cxx_min_imd_ti_ad_ofs "Minimum instantaneous value for the adaptation offset" VALUE 0xa0020e7b _REC_S1VAL_20_s1 1020. _CNV_A_R_LINEAR_____50_CM -512. 508. FORMAT "%1.0" /end CHARACTERISTIC
/begin CHARACTERISTIC Cxx_min_mv_ti_ad_fac "Minimum mean value for the adaptation factor" VALUE 0xa0020e7c _REC_S1VAL_20_u1 0.6640625 _CNV_A_R_LINEAR_____51_CM 0.6666667 1.3307292 FORMAT "%5.3" /end CHARACTERISTIC
/begin CHARACTERISTIC Cxx_min_mv_ti_ad_ofs "Minimum mean value for the adaptation offset" VALUE 0xa0020e7d _REC_S1VAL_20_s1 1020. _CNV_A_R_LINEAR_____50_CM -512. 508. FORMAT "%1.0" /end CHARACTERISTIC
/begin CHARACTERISTIC Cxx_prs_zon "Pressure zone size (1, 2, 3)" VALUE 0xa0020e5e _REC_S1VAL_20_u2 20000. _CNV_A_R_LINEAR_____57_CM 0. 20000. FORMAT "%5.0" /end CHARACTERISTIC
/begin CHARACTERISTIC Cxx_prs_zon_st "Pressure first zone size (0)" VALUE 0xa0020e60 _REC_S1VAL_20_u2 20000. _CNV_A_R_LINEAR_____57_CM 0. 20000. FORMAT "%5.0" /end CHARACTERISTIC
/begin CHARACTERISTIC Cxx_ti_ad_max_n "Maximum engine speed threshold" VALUE 0xa0020e62 _REC_S1VAL_20_u2 16383.75 _CNV_A_R_ENSD_LINEA_24_CM 0. 16383.75 FORMAT "%8.2" /end CHARACTERISTIC
/begin CHARACTERISTIC Cxx_ti_ad_prs_l_thd "Pressure down limit for the first zone" VALUE 0xa0020e64 _REC_S1VAL_20_u2 20000. _CNV_A_R_LINEAR_____57_CM 0. 20000. FORMAT "%5.0" /end CHARACTERISTIC
/begin CHARACTERISTIC Cxx_ti_ad_prs_trs_thd "Pressure difference threshold limiting adaptation" VALUE 0xa0020e66 _REC_S1VAL_20_u2 20000. _CNV_A_R_LINEAR_____57_CM 0. 20000. FORMAT "%5.0" /end CHARACTERISTIC
/begin CHARACTERISTIC Cxx_ti_ad_prs_up_thd "Pressure upper limit for the fifth zone" VALUE 0xa0020e68 _REC_S1VAL_20_u2 20000. _CNV_A_R_LINEAR_____57_CM 0. 20000. FORMAT "%5.0" /end CHARACTERISTIC
/begin CHARACTERISTIC Cxx_ti_ad_tco_thd "Minimum water temperature to enable adaptation" VALUE 0xa0020e6a _REC_S1VAL_20_u2 240. _CNV_A_R_LINEAR_____54_CM -40. 200. FORMAT "%5.1" /end CHARACTERISTIC
/begin CHARACTERISTIC Cxx_zon_dif_min_hys "Minimum hysteresis to refresh learnings" VALUE 0xa0020e7e _REC_S1VAL_20_u1 255. _CNV_A_R_ECME_LINEA_0_CM 0. 255. FORMAT "%3.0" /end CHARACTERISTIC
/begin CHARACTERISTIC Cmp_n_eal_rich_sp_alco "Open loop basic richness setpoint map for flex-fuel." MAP 0xa0029084 _REC_A1MAP_20_u1_u2_u2 1.328125 _CNV_A_R_LINEAR_____74_CM 0.6666666 1.9947916 FORMAT "%8.6"
 /begin AXIS_DESCR COM_AXIS Vxx_n _CNV_A_R_ENSD_LINEA_24_CM 20 0. 16383.75 FORMAT "%8.2" AXIS_PTS_REF Ctb_n /end AXIS_DESCR
 /begin AXIS_DESCR COM_AXIS Vxx_eal _CNV_A_R_LINEAR_____53_CM 16 0. 3.99993896484375 FORMAT "%10.8" AXIS_PTS_REF Ctb_eal /end AXIS_DESCR
/end CHARACTERISTIC
/begin CHARACTERISTIC Ctp_n_kd_rich_fac_alco "Minimum richness setpoint applied in case of full load requested by the driver for exotic fuel." CURVE 0xa00291c4 _REC_A1CUR_20_u1_u2 1.328125 _CNV_A_R_LINEAR_____74_CM 0.6666666 1.9947916 FORMAT "%8.6"
 /begin AXIS_DESCR COM_AXIS Vxx_n _CNV_A_R_ENSD_LINEA_24_CM 20 0. 16383.75 FORMAT "%8.2" AXIS_PTS_REF Ctb_n /end AXIS_DESCR
/end CHARACTERISTIC
/begin MEASUREMENT Vxx_n_eal_rich_sp_alco "Basic richness setpoint in open loop for flex-fuel." UBYTE _CNV_A_R_LINEAR_____74_CM 1 0. 0.6666666 1.9947916 ECU_ADDRESS 0xd00041f2 FORMAT "%8.6" /end MEASUREMENT
/begin MEASUREMENT Vxx_n_kd_rich_fac_alco "Full load richness factor for flex-fuel." UBYTE _CNV_A_R_LINEAR_____74_CM 1 0. 0.6666666 1.9947916 ECU_ADDRESS 0xd00041f3 FORMAT "%8.6" /end MEASUREMENT
/begin MEASUREMENT Vtx_dstb_cylx_fim_fac[0] "4 factors applied to richness of each cylinder during richness distribution" UBYTE _CNV_A_R_LINEAR_____43_CM 1 0. 0. 1.9921875 ECU_ADDRESS 0xd00051d8 FORMAT "%8.6" /end MEASUREMENT
/begin MEASUREMENT Vtx_dstb_cylx_fim_fac[1] "4 factors applied to richness of each cylinder during richness distribution" UBYTE _CNV_A_R_LINEAR_____43_CM 1 0. 0. 1.9921875 ECU_ADDRESS 0xd00051d9 FORMAT "%8.6" /end MEASUREMENT
/begin MEASUREMENT Vtx_dstb_cylx_fim_fac[2] "4 factors applied to richness of each cylinder during richness distribution" UBYTE _CNV_A_R_LINEAR_____43_CM 1 0. 0. 1.9921875 ECU_ADDRESS 0xd00051da FORMAT "%8.6" /end MEASUREMENT
/begin MEASUREMENT Vtx_dstb_cylx_fim_fac[3] "4 factors applied to richness of each cylinder during richness distribution" UBYTE _CNV_A_R_LINEAR_____43_CM 1 0. 0. 1.9921875 ECU_ADDRESS 0xd00051db FORMAT "%8.6" /end MEASUREMENT
/begin MEASUREMENT Vtx_dstb_cylx_fim_fac_is[0] "4 factors applied to richness of each cylinder during richness distribution and iddle speed" UBYTE _CNV_A_R_LINEAR_____43_CM 1 0. 0. 1.9921875 ECU_ADDRESS 0xd00051dc FORMAT "%8.6" /end MEASUREMENT
/begin MEASUREMENT Vtx_dstb_cylx_fim_fac_is[1] "4 factors applied to richness of each cylinder during richness distribution and iddle speed" UBYTE _CNV_A_R_LINEAR_____43_CM 1 0. 0. 1.9921875 ECU_ADDRESS 0xd00051dd FORMAT "%8.6" /end MEASUREMENT
/begin MEASUREMENT Vtx_dstb_cylx_fim_fac_is[2] "4 factors applied to richness of each cylinder during richness distribution and iddle speed" UBYTE _CNV_A_R_LINEAR_____43_CM 1 0. 0. 1.9921875 ECU_ADDRESS 0xd00051de FORMAT "%8.6" /end MEASUREMENT
/begin MEASUREMENT Vtx_dstb_cylx_fim_fac_is[3] "4 factors applied to richness of each cylinder during richness distribution and iddle speed" UBYTE _CNV_A_R_LINEAR_____43_CM 1 0. 0. 1.9921875 ECU_ADDRESS 0xd00051df FORMAT "%8.6" /end MEASUREMENT
/begin MEASUREMENT Vxx_cata_rich_dstb_cyl1_fac "Factor applied to richness of cylinder 1 during richness distribution and no iddle speed" UBYTE _CNV_A_R_LINEAR_____43_CM 1 0. 0. 1.9921875 ECU_ADDRESS 0xd0004408 FORMAT "%10.8" /end MEASUREMENT
/begin MEASUREMENT Vxx_cata_rich_dstb_cyl2_fac "Factor applied to richness of cylinder 2 during richness distribution and no iddle speed" UBYTE _CNV_A_R_LINEAR_____43_CM 1 0. 0. 1.9921875 ECU_ADDRESS 0xd0004409 FORMAT "%10.8" /end MEASUREMENT
/begin MEASUREMENT Vxx_cata_rich_dstb_cyl3_fac "Factor applied to richness of cylinder 3 during richness distribution and no iddle speed" UBYTE _CNV_A_R_LINEAR_____43_CM 1 0. 0. 1.9921875 ECU_ADDRESS 0xd000440a FORMAT "%10.8" /end MEASUREMENT
/begin MEASUREMENT Vxx_cata_rich_dstb_cyl4_fac "Factor applied to richness of cylinder 4 during richness distribution and no iddle speed" UBYTE _CNV_A_R_LINEAR_____43_CM 1 0. 0. 1.9921875 ECU_ADDRESS 0xd000440b FORMAT "%10.8" /end MEASUREMENT
/begin CHARACTERISTIC Cxx_dstb_cyl1_fim_fac_is "Factor applied to richness of cylinder one during richness distribution and iddle speed" VALUE 0xa00215b4 _REC_S1VAL_20_u1 1.9921875 _CNV_A_R_LINEAR_____43_CM 0. 1.9921875 FORMAT "%10.8" /end CHARACTERISTIC
/begin CHARACTERISTIC Cxx_dstb_cyl1_fim_fac_is_alco "Factor applied to richness of cylinder one during richness distribution and iddle speed for flex-fuel" VALUE 0xa00215b5 _REC_S1VAL_20_u1 1.9921875 _CNV_A_R_LINEAR_____43_CM 0. 1.9921875 FORMAT "%8.6" /end CHARACTERISTIC
/begin CHARACTERISTIC Cxx_dstb_cyl1_h_fim_fac "High factor applied to richness of cylinder one during richness distribution and no iddle speed" VALUE 0xa00215b6 _REC_S1VAL_20_u1 1.9921875 _CNV_A_R_LINEAR_____43_CM 0. 1.9921875 FORMAT "%10.8" /end CHARACTERISTIC
/begin CHARACTERISTIC Cxx_dstb_cyl1_h_fim_fac_alco "High factor applied to richness of cylinder one during richness distribution and no iddle speed for flex-fuel" VALUE 0xa00215b7 _REC_S1VAL_20_u1 1.9921875 _CNV_A_R_LINEAR_____43_CM 0. 1.9921875 FORMAT "%8.6" /end CHARACTERISTIC
/begin CHARACTERISTIC Cxx_dstb_cyl1_l_fim_fac "Low factor applied to richness of cylinder one during richness distribution and no iddle speed" VALUE 0xa00215b8 _REC_S1VAL_20_u1 1.9921875 _CNV_A_R_LINEAR_____43_CM 0. 1.9921875 FORMAT "%10.8" /end CHARACTERISTIC
/begin CHARACTERISTIC Cxx_dstb_cyl1_l_fim_fac_alco "Low factor applied to richness of cylinder one during richness distribution and no iddle speed for flex-fuel" VALUE 0xa00215b9 _REC_S1VAL_20_u1 1.9921875 _CNV_A_R_LINEAR_____43_CM 0. 1.9921875 FORMAT "%8.6" /end CHARACTERISTIC
/begin CHARACTERISTIC Cxx_dstb_cyl2_fim_fac_is "Factor applied to richness of cylinder two during richness distribution and iddle speed" VALUE 0xa00215ba _REC_S1VAL_20_u1 1.9921875 _CNV_A_R_LINEAR_____43_CM 0. 1.9921875 FORMAT "%10.8" /end CHARACTERISTIC
/begin CHARACTERISTIC Cxx_dstb_cyl2_fim_fac_is_alco "Factor applied to richness of cylinder two during richness distribution and iddle speed for flex-fuel" VALUE 0xa00215bb _REC_S1VAL_20_u1 1.9921875 _CNV_A_R_LINEAR_____43_CM 0. 1.9921875 FORMAT "%8.6" /end CHARACTERISTIC
/begin CHARACTERISTIC Cxx_dstb_cyl2_h_fim_fac "High factor applied to richness of cylinder two during richness distribution and no iddle speed" VALUE 0xa00215bc _REC_S1VAL_20_u1 1.9921875 _CNV_A_R_LINEAR_____43_CM 0. 1.9921875 FORMAT "%10.8" /end CHARACTERISTIC
/begin CHARACTERISTIC Cxx_dstb_cyl2_h_fim_fac_alco "High factor applied to richness of cylinder two during richness distribution and no iddle speed for flex-fuel" VALUE 0xa00215bd _REC_S1VAL_20_u1 1.9921875 _CNV_A_R_LINEAR_____43_CM 0. 1.9921875 FORMAT "%8.6" /end CHARACTERISTIC
/begin CHARACTERISTIC Cxx_dstb_cyl2_l_fim_fac "Low factor applied to richness of cylinder two during richness distribution and no iddle speed" VALUE 0xa00215be _REC_S1VAL_20_u1 1.9921875 _CNV_A_R_LINEAR_____43_CM 0. 1.9921875 FORMAT "%10.8" /end CHARACTERISTIC
/begin CHARACTERISTIC Cxx_dstb_cyl2_l_fim_fac_alco "Low factor applied to richness of cylinder two during richness distribution and no iddle speed for flex-fuel" VALUE 0xa00215bf _REC_S1VAL_20_u1 1.9921875 _CNV_A_R_LINEAR_____43_CM 0. 1.9921875 FORMAT "%8.6" /end CHARACTERISTIC
/begin CHARACTERISTIC Cxx_dstb_cyl3_fim_fac_is "Factor applied to richness of cylinder three during richness distribution and iddle speed" VALUE 0xa00215c0 _REC_S1VAL_20_u1 1.9921875 _CNV_A_R_LINEAR_____43_CM 0. 1.9921875 FORMAT "%10.8" /end CHARACTERISTIC
/begin CHARACTERISTIC Cxx_dstb_cyl3_fim_fac_is_alco "Factor applied to richness of cylinder three during richness distribution and iddle speed for flex-fuel" VALUE 0xa00215c1 _REC_S1VAL_20_u1 1.9921875 _CNV_A_R_LINEAR_____43_CM 0. 1.9921875 FORMAT "%8.6" /end CHARACTERISTIC
/begin CHARACTERISTIC Cxx_dstb_cyl3_h_fim_fac "High factor applied to richness of cylinder three during richness distribution and no iddle speed" VALUE 0xa00215c2 _REC_S1VAL_20_u1 1.9921875 _CNV_A_R_LINEAR_____43_CM 0. 1.9921875 FORMAT "%10.8" /end CHARACTERISTIC
/begin CHARACTERISTIC Cxx_dstb_cyl3_h_fim_fac_alco "High factor applied to richness of cylinder three during richness distribution and no iddle speed for flex-fuel" VALUE 0xa00215c3 _REC_S1VAL_20_u1 1.9921875 _CNV_A_R_LINEAR_____43_CM 0. 1.9921875 FORMAT "%8.6" /end CHARACTERISTIC
/begin CHARACTERISTIC Cxx_dstb_cyl3_l_fim_fac "Low factor applied to richness of cylinder three during richness distribution and no iddle speed" VALUE 0xa00215c4 _REC_S1VAL_20_u1 1.9921875 _CNV_A_R_LINEAR_____43_CM 0. 1.9921875 FORMAT "%10.8" /end CHARACTERISTIC
/begin CHARACTERISTIC Cxx_dstb_cyl3_l_fim_fac_alco "Low factor applied to richness of cylinder three during richness distribution and no iddle speed for flex-fuel" VALUE 0xa00215c5 _REC_S1VAL_20_u1 1.9921875 _CNV_A_R_LINEAR_____43_CM 0. 1.9921875 FORMAT "%8.6" /end CHARACTERISTIC
/begin CHARACTERISTIC Cxx_dstb_cyl4_fim_fac_is "Factor applied to richness of cylinder four during richness distribution and iddle speed" VALUE 0xa00215c6 _REC_S1VAL_20_u1 1.9921875 _CNV_A_R_LINEAR_____43_CM 0. 1.9921875 FORMAT "%10.8" /end CHARACTERISTIC
/begin CHARACTERISTIC Cxx_dstb_cyl4_fim_fac_is_alco "Factor applied to richness of cylinder four during richness distribution and iddle speed for flex-fuel" VALUE 0xa00215c7 _REC_S1VAL_20_u1 1.9921875 _CNV_A_R_LINEAR_____43_CM 0. 1.9921875 FORMAT "%8.6" /end CHARACTERISTIC
/begin CHARACTERISTIC Cxx_dstb_cyl4_h_fim_fac "High factor applied to richness of cylinder four during richness distribution and no iddle speed" VALUE 0xa00215c8 _REC_S1VAL_20_u1 1.9921875 _CNV_A_R_LINEAR_____43_CM 0. 1.9921875 FORMAT "%10.8" /end CHARACTERISTIC
/begin CHARACTERISTIC Cxx_dstb_cyl4_h_fim_fac_alco "High factor applied to richness of cylinder four during richness distribution and no iddle speed for flex-fuel" VALUE 0xa00215c9 _REC_S1VAL_20_u1 1.9921875 _CNV_A_R_LINEAR_____43_CM 0. 1.9921875 FORMAT "%8.6" /end CHARACTERISTIC
/begin CHARACTERISTIC Cxx_dstb_cyl4_l_fim_fac "Low factor applied to richness of cylinder four during richness distribution and no iddle speed" VALUE 0xa00215ca _REC_S1VAL_20_u1 1.9921875 _CNV_A_R_LINEAR_____43_CM 0. 1.9921875 FORMAT "%10.8" /end CHARACTERISTIC
/begin CHARACTERISTIC Cxx_dstb_cyl4_l_fim_fac_alco "Low factor applied to richness of cylinder four during richness distribution and no iddle speed for flex-fuel" VALUE 0xa00215cb _REC_S1VAL_20_u1 1.9921875 _CNV_A_R_LINEAR_____43_CM 0. 1.9921875 FORMAT "%8.6" /end CHARACTERISTIC
/begin CHARACTERISTIC Cmp_n_eal_rich_sp "Open loop basic richness setpoint map" MAP 0xa002f844 _REC_A1MAP_20_u1_u2_u2 1.328125 _CNV_A_R_LINEAR_____74_CM 0.6666666 1.9947916 FORMAT "%8.6"
 /begin AXIS_DESCR COM_AXIS Vxx_n _CNV_A_R_ENSD_LINEA_24_CM 20 0. 16383.75 FORMAT "%8.2" AXIS_PTS_REF Ctb_n /end AXIS_DESCR
 /begin AXIS_DESCR COM_AXIS Vxx_eal _CNV_A_R_LINEAR_____53_CM 16 0. 3.99993896484375 FORMAT "%10.8" AXIS_PTS_REF Ctb_eal /end AXIS_DESCR
/end CHARACTERISTIC
/begin CHARACTERISTIC Ctp_n_kd_rich_fac "Minimum richness setpoint table applied in case of full load requested by the driver" CURVE 0xa002f984 _REC_A1CUR_20_u1_u2 1.328125 _CNV_A_R_LINEAR_____74_CM 0.6666666 1.9947916 FORMAT "%8.6"
 /begin AXIS_DESCR COM_AXIS Vxx_n _CNV_A_R_ENSD_LINEA_24_CM 20 0. 16383.75 FORMAT "%8.2" AXIS_PTS_REF Ctb_n /end AXIS_DESCR
/end CHARACTERISTIC
/begin MEASUREMENT Vxx_bas_rich_fac "Basic richness setpoint in open loop operation" UBYTE _CNV_A_R_LINEAR_____74_CM 1 0. 0.6666666 1.9947916 ECU_ADDRESS 0xd0004fab FORMAT "%8.6" /end MEASUREMENT
/begin MEASUREMENT Vxx_kd_rich_fac "Full load richness factor" UBYTE _CNV_A_R_LINEAR_____74_CM 1 0. 0.6666666 1.9947916 ECU_ADDRESS 0xd0004fac FORMAT "%8.6" /end MEASUREMENT
/begin MEASUREMENT Vxx_kd_rich_fac_itl "Full load richness factor internal" UBYTE _CNV_A_R_LINEAR_____74_CM 1 0. 0.6666666 1.9947916 ECU_ADDRESS 0xd0004fad FORMAT "%8.6" /end MEASUREMENT
/begin MEASUREMENT Vxx_n_kd_rich_fac "Minimum richness setpoint applied in case of full load requested by the driver" UBYTE _CNV_A_R_LINEAR_____74_CM 1 0. 0.6666666 1.9947916 ECU_ADDRESS 0xd0004fae FORMAT "%8.6" /end MEASUREMENT
/begin CHARACTERISTIC Cxx_cold_loop_kd_rich_fac "Richness factor correction depending on the ignition timing correction of the slow loop (Vxx_knk_slow_cor_max_iga)" VALUE 0xa0020f4a _REC_S1VAL_20_u1 2.98828125e-002 _CNV_A_R_LINEAR_____89_CM 0. 2.98828125e-002 FORMAT "%8.7" /end CHARACTERISTIC
/begin CHARACTERISTIC Cxx_rich_cor_ena_n_thd "RPM threshold over wich a richness correction factor is autorized for exhaust thermal protection" VALUE 0xa0020f4b _REC_S1VAL_20_u1 8160. _CNV_A_R_LINEAR_____2_CM 0. 8160. FORMAT "%4.0" /end CHARACTERISTIC
/begin CHARACTERISTIC Cxx_tia_kd_rich_cor_fac "Richness factor correction depending on the ignition timing correction for the air temperature (Vxx_tia_iga_cor)" VALUE 0xa0020f48 _REC_S1VAL_20_u2 2.98828125e-002 _CNV_A_R_LINEAR_____89_CM 0. 2.98828125e-002 FORMAT "%8.7" /end CHARACTERISTIC
/begin CHARACTERISTIC Cxx_tkof_fl_rich_fac "Richness setpoint during take-off phase" VALUE 0xa0020f4c _REC_S1VAL_20_u1 1.328125 _CNV_A_R_LINEAR_____74_CM 0.6666666 1.9947916 FORMAT "%8.6" /end CHARACTERISTIC
/begin CHARACTERISTIC Cxx_tkof_fl_rich_fac_alco "Richness setpoint during take-off phase for flex-fuel." VALUE 0xa0020f4d _REC_S1VAL_20_u1 1.328125 _CNV_A_R_LINEAR_____74_CM 0.6666666 1.9947916 FORMAT "%8.6" /end CHARACTERISTIC
/begin AXIS_PTS Ctb_prs_rat "" 0xa0023040 Vxx_it_prs_rat_fil _REC_A2AXS_20_u2 0.9999847412109381 _CNV_A_R_LINEAR_____9_CM 22 0. 0.9999847412109381 FORMAT "%7.5" /end AXIS_PTS
/begin CHARACTERISTIC Ctp_it_prs_rat_fil_ftc "Constant of time calculated from up and down throttle rate pressure value" CURVE 0xa0023070 _REC_A1CUR_20_u2_u2 20. _CNV_A_R_LINEAR_____90_CM 0. 20. FORMAT "%10.8"
 /begin AXIS_DESCR COM_AXIS Vxx_it_prs_rat_fil _CNV_A_R_LINEAR_____9_CM 22 0. 0.9999847412109381 FORMAT "%7.5" AXIS_PTS_REF Ctb_prs_rat /end AXIS_DESCR
/end CHARACTERISTIC
/begin CHARACTERISTIC Ctp_prs_tmp_flr_val "Intermediate variable for the calculation of the surfacic flow, Res = 1/(16*256^2)" CURVE 0xa002309c _REC_A1CUR_20_u2_u2 6.249904600000001e-002 _CNV_A_R_LINEAR_____91_CM 0. 6.2499046e-002 FORMAT "%7.6"
 /begin AXIS_DESCR COM_AXIS Vxx_it_prs_rat_fil _CNV_A_R_LINEAR_____9_CM 22 0. 0.9999847412109381 FORMAT "%7.5" AXIS_PTS_REF Ctb_prs_rat /end AXIS_DESCR
/end CHARACTERISTIC
/begin MEASUREMENT Vxx_ar_flr_tmp_val "Intermediate variable for the calculation of the surfacic flow, Res= 1/(16*256^2)" UWORD _CNV_A_R_LINEAR_____91_CM 1 0. 0. 6.2499046e-002 ECU_ADDRESS 0xd000375e FORMAT "%7.6" /end MEASUREMENT
/begin MEASUREMENT Vxx_it_ar_maf "Mass air flow per unity of throttle efficient area" UWORD _CNV_A_R_LINEAR_____92_CM 1 0. 0. 1836000. ECU_ADDRESS 0xd0003760 FORMAT "%10.3" /end MEASUREMENT
/begin MEASUREMENT Vxx_it_prs_rat_fil "Filtered pressure rate Pmanifold/Pup_throttle" UWORD _CNV_A_R_LINEAR_____93_CM 1 0. 0. 1. ECU_ADDRESS 0xd0003762 FORMAT "%10.9" /end MEASUREMENT
/begin MEASUREMENT Vxx_raw_prs_rat "Rate value of up and down throttle pressure Pmanifold/Pup_throttle raw" UWORD _CNV_A_R_LINEAR_____93_CM 1 0. 0. 1. ECU_ADDRESS 0xd0003764 FORMAT "%10.9" /end MEASUREMENT
/begin CHARACTERISTIC Cbx_prs_sp_dsb_cfm "Choice between the measured manifold pressure and the calculated manifold pressure." VALUE 0xa0020835 _REC_S1VAL_20_u1 1. _CNV_A_R_ECME_LINEA_0_CM 0. 1. FORMAT "%1.0" BIT_MASK 0x1 /end CHARACTERISTIC
/begin CHARACTERISTIC Ctp_cold_stop_it_psn_sp "Throttle position order during the damper phase, at cold manifold air temperature" CURVE 0xa0024744 _REC_A1CUR_20_u2_u2 200. _CNV_A_R_LINEAR_____94_CM 0. 200. FORMAT "%6.2"
 /begin AXIS_DESCR COM_AXIS Vxx_tco _CNV_A_R_LINEAR_____54_CM 9 -40. 200. FORMAT "%5.1" AXIS_PTS_REF Ctb_tco2 /end AXIS_DESCR
/end CHARACTERISTIC
/begin CHARACTERISTIC Ctp_n_min_map_it_ar "Minimum throttle opening limitation due to minimum manifold pressure (oil consumption)" CURVE 0xa0024758 _REC_A1CUR_20_u2_u2 3.90619e-003 _CNV_A_R_LINEAR_____95_CM 0. 3.90619e-003 FORMAT "%11.9"
 /begin AXIS_DESCR COM_AXIS Vxx_n _CNV_A_R_ENSD_LINEA_24_CM 20 0. 16383.75 FORMAT "%8.2" AXIS_PTS_REF Ctb_n /end AXIS_DESCR
/end CHARACTERISTIC
/begin CHARACTERISTIC Ctp_n_min_map_it_ar_fac "Minimum throttle opening lim (oil consumption constraint) correction factor" CURVE 0xa0024780 _REC_A1CUR_20_u2_u2 1.999969482 _CNV_A_R_LINEAR_____96_CM 0. 1.999969482 FORMAT "%10.8"
 /begin AXIS_DESCR COM_AXIS Vxx_tco _CNV_A_R_LINEAR_____54_CM 16 -40. 200. FORMAT "%5.1" AXIS_PTS_REF Ctb_tco /end AXIS_DESCR
/end CHARACTERISTIC
/begin CHARACTERISTIC Ctp_n_noi_max_it_ar "" CURVE 0xa00247a0 _REC_A1CUR_20_u2_u2 3.90619e-003 _CNV_A_R_LINEAR_____95_CM 0. 3.90619e-003 FORMAT "%11.9"
 /begin AXIS_DESCR COM_AXIS Vxx_n _CNV_A_R_ENSD_LINEA_24_CM 20 0. 16383.75 FORMAT "%8.2" AXIS_PTS_REF Ctb_n /end AXIS_DESCR
/end CHARACTERISTIC
/begin CHARACTERISTIC Ctp_tco_clos_it_t "Table of duration of the throttle closure temporization at the key off." CURVE 0xa00247c8 _REC_A1CUR_20_u2_u2 655.35 _CNV_A_R_LINEAR_____34_CM 0. 655.35 FORMAT "%6.2"
 /begin AXIS_DESCR COM_AXIS Vxx_tco _CNV_A_R_LINEAR_____54_CM 16 -40. 200. FORMAT "%5.1" AXIS_PTS_REF Ctb_tco /end AXIS_DESCR
/end CHARACTERISTIC
/begin MEASUREMENT Vbx_clos_it_dly_stop "Ended of temporization for the throttle closure." UBYTE _CNV_S_2_RANGE______3_CM 1 0. 0. 1. ECU_ADDRESS 0xd00046ab BIT_MASK 0x1 /end MEASUREMENT
/begin MEASUREMENT Vbx_clos_it_stop "Boolean indicating that throttle closing phase is terminated or disabled (choking)." UBYTE _CNV_S_2_RANGE______3_CM 1 0. 0. 1. ECU_ADDRESS 0xd00046ac BIT_MASK 0x1 /end MEASUREMENT
/begin MEASUREMENT Vxx_fil1_it_psn_sp "Inlet throttle position reference from the air system." UWORD _CNV_A_R_LINEAR_____94_CM 1 0. 0. 200. ECU_ADDRESS 0xd00036ec FORMAT "%5.2" /end MEASUREMENT
/begin MEASUREMENT Vxx_it_ar_sp "Command of throttle area" UWORD _CNV_A_R_LINEAR_____95_CM 1 0. 0. 3.90619e-003 ECU_ADDRESS 0xd00036ee FORMAT "%11.9" /end MEASUREMENT
/begin MEASUREMENT Vxx_it_psn_sp "Ended of temporization for the throttle closure." UWORD _CNV_A_R_LINEAR_____94_CM 1 0. 0. 200. ECU_ADDRESS 0xd00036f0 FORMAT "%5.2" /end MEASUREMENT
/begin MEASUREMENT Vxx_raw_it_psn_sp "Corrected raw command of the motorized throttle position." UWORD _CNV_A_R_LINEAR_____94_CM 1 0. 0. 200. ECU_ADDRESS 0xd00036f2 FORMAT "%5.2" /end MEASUREMENT
/begin MEASUREMENT Vxx_tq_it_ar_sp "Command of the efficiency throttle area for the torque control." UWORD _CNV_A_R_LINEAR_____97_CM 1 0. 0. 3.90619039535522e-003 ECU_ADDRESS 0xd00036f4 FORMAT "%16.12" /end MEASUREMENT
/begin CHARACTERISTIC Cbx_clos_it_dsb "Inhibition of the function damper in the driving stop." VALUE 0xa002186e _REC_S1VAL_20_u1 1. _CNV_A_R_ECME_LINEA_0_CM 0. 1. FORMAT "%1.0" BIT_MASK 0x1 /end CHARACTERISTIC
/begin CHARACTERISTIC Cbx_it_bch_cfm "Throttle bench mode." VALUE 0xa002186f _REC_S1VAL_20_u1 1. _CNV_A_R_ECME_LINEA_0_CM 0. 1. FORMAT "%1.0" BIT_MASK 0x1 /end CHARACTERISTIC
/begin CHARACTERISTIC Cbx_it_ped_bch_cfm "Throttle bench mode (calculated with pedal ratio)." VALUE 0xa0021870 _REC_S1VAL_20_u1 1. _CNV_A_R_ECME_LINEA_0_CM 0. 1. FORMAT "%1.0" BIT_MASK 0x1 /end CHARACTERISTIC
/begin CHARACTERISTIC Cxx_clos_it_mat_min "Temperature of the air over which the throttle closure (damper) is forbidden." VALUE 0xa0021858 _REC_S1VAL_20_u2 240. _CNV_A_R_LINEAR_____54_CM -40. 200. FORMAT "%5.1" /end CHARACTERISTIC
/begin CHARACTERISTIC Cxx_clos_it_n_max "Engine rpm over which the function damper is finished." VALUE 0xa002185a _REC_S1VAL_20_u2 16383.75 _CNV_A_R_ENSD_LINEA_24_CM 0. 16383.75 FORMAT "%8.2" /end CHARACTERISTIC
/begin CHARACTERISTIC Cxx_clos_it_n_min "Engine rpm below which the function damper is finished." VALUE 0xa002185c _REC_S1VAL_20_u2 16383.75 _CNV_A_R_ENSD_LINEA_24_CM 0. 16383.75 FORMAT "%8.2" /end CHARACTERISTIC
/begin CHARACTERISTIC Cxx_clos_it_vs_max "Speed over which the function damper is forbidden." VALUE 0xa002185e _REC_S1VAL_20_u2 655.35 _CNV_A_R_LINEAR_____70_CM 0. 655.35 FORMAT "%6.2" /end CHARACTERISTIC
/begin CHARACTERISTIC Cxx_eng_stop_it_psn_sp "Position throttle order during the damper phase." VALUE 0xa0021860 _REC_S1VAL_20_u2 200. _CNV_A_R_LINEAR_____94_CM 0. 200. FORMAT "%5.2" /end CHARACTERISTIC
/begin CHARACTERISTIC Cxx_ffig_it_psn_sp "Inlet throttle position reference in case of ffig." VALUE 0xa0021862 _REC_S1VAL_20_u2 200. _CNV_A_R_LINEAR_____94_CM 0. 200. FORMAT "%6.2" /end CHARACTERISTIC
/begin CHARACTERISTIC Cxx_fl_max_it_ar "Command of full load maximum throttle area." VALUE 0xa0021864 _REC_S1VAL_20_u2 3.90619e-003 _CNV_A_R_LINEAR_____95_CM 0. 3.90619e-003 FORMAT "%11.9" /end CHARACTERISTIC
/begin CHARACTERISTIC Cxx_it_pos_ped_fac_bch "factor for throttle position calculation in bench mode." VALUE 0xa0021866 _REC_S1VAL_20_u2 200. _CNV_A_R_CPULOAD__0_7_CM 0. 200. FORMAT "%13.8" /end CHARACTERISTIC
/begin CHARACTERISTIC Cxx_it_pos_sc_bch "Throttle position in bench mode." VALUE 0xa0021868 _REC_S1VAL_20_u2 200. _CNV_A_R_LINEAR_____94_CM 0. 200. FORMAT "%5.2" /end CHARACTERISTIC
/begin CHARACTERISTIC Cxx_it_pos_sc_l_thd_bch "low throttle position in bench mode." VALUE 0xa002186a _REC_S1VAL_20_u2 200. _CNV_A_R_LINEAR_____94_CM 0. 200. FORMAT "%6.2" /end CHARACTERISTIC
/begin CHARACTERISTIC Cxx_l_it_ar "Value in case of division by zero." VALUE 0xa002186c _REC_S1VAL_20_u2 3.90619e-003 _CNV_A_R_LINEAR_____95_CM 0. 3.90619e-003 FORMAT "%11.9" /end CHARACTERISTIC
/begin MEASUREMENT Vtp_it_ar[0] "Variable table for throttle area curve." UWORD _CNV_A_R_LINEAR_____95_CM 1 0. 0. 3.90619e-003 DISPLAY_IDENTIFIER AsMapCtl_NVM.Vtp_it_ar_NVM[0] ECU_ADDRESS 0xd0005868 FORMAT "%11.9" /end MEASUREMENT
/begin MEASUREMENT Vtp_it_ar[1] "Variable table for throttle area curve." UWORD _CNV_A_R_LINEAR_____95_CM 1 0. 0. 3.90619e-003 DISPLAY_IDENTIFIER AsMapCtl_NVM.Vtp_it_ar_NVM[1] ECU_ADDRESS 0xd000586a FORMAT "%11.9" /end MEASUREMENT
/begin MEASUREMENT Vtp_it_ar[2] "Variable table for throttle area curve." UWORD _CNV_A_R_LINEAR_____95_CM 1 0. 0. 3.90619e-003 DISPLAY_IDENTIFIER AsMapCtl_NVM.Vtp_it_ar_NVM[2] ECU_ADDRESS 0xd000586c FORMAT "%11.9" /end MEASUREMENT
/begin MEASUREMENT Vtp_it_ar[3] "Variable table for throttle area curve." UWORD _CNV_A_R_LINEAR_____95_CM 1 0. 0. 3.90619e-003 DISPLAY_IDENTIFIER AsMapCtl_NVM.Vtp_it_ar_NVM[3] ECU_ADDRESS 0xd000586e FORMAT "%11.9" /end MEASUREMENT
/begin MEASUREMENT Vtp_it_ar[4] "Variable table for throttle area curve." UWORD _CNV_A_R_LINEAR_____95_CM 1 0. 0. 3.90619e-003 DISPLAY_IDENTIFIER AsMapCtl_NVM.Vtp_it_ar_NVM[4] ECU_ADDRESS 0xd0005870 FORMAT "%11.9" /end MEASUREMENT
/begin MEASUREMENT Vtp_it_ar[5] "Variable table for throttle area curve." UWORD _CNV_A_R_LINEAR_____95_CM 1 0. 0. 3.90619e-003 DISPLAY_IDENTIFIER AsMapCtl_NVM.Vtp_it_ar_NVM[5] ECU_ADDRESS 0xd0005872 FORMAT "%11.9" /end MEASUREMENT
/begin MEASUREMENT Vtp_it_ar[6] "Variable table for throttle area curve." UWORD _CNV_A_R_LINEAR_____95_CM 1 0. 0. 3.90619e-003 DISPLAY_IDENTIFIER AsMapCtl_NVM.Vtp_it_ar_NVM[6] ECU_ADDRESS 0xd0005874 FORMAT "%11.9" /end MEASUREMENT
/begin MEASUREMENT Vtp_it_ar[7] "Variable table for throttle area curve." UWORD _CNV_A_R_LINEAR_____95_CM 1 0. 0. 3.90619e-003 DISPLAY_IDENTIFIER AsMapCtl_NVM.Vtp_it_ar_NVM[7] ECU_ADDRESS 0xd0005876 FORMAT "%11.9" /end MEASUREMENT
/begin MEASUREMENT Vtp_it_ar[8] "Variable table for throttle area curve." UWORD _CNV_A_R_LINEAR_____95_CM 1 0. 0. 3.90619e-003 DISPLAY_IDENTIFIER AsMapCtl_NVM.Vtp_it_ar_NVM[8] ECU_ADDRESS 0xd0005878 FORMAT "%11.9" /end MEASUREMENT
/begin MEASUREMENT Vtp_it_ar[9] "Variable table for throttle area curve." UWORD _CNV_A_R_LINEAR_____95_CM 1 0. 0. 3.90619e-003 DISPLAY_IDENTIFIER AsMapCtl_NVM.Vtp_it_ar_NVM[9] ECU_ADDRESS 0xd000587a FORMAT "%11.9" /end MEASUREMENT
/begin MEASUREMENT Vtp_it_ar[10] "Variable table for throttle area curve." UWORD _CNV_A_R_LINEAR_____95_CM 1 0. 0. 3.90619e-003 DISPLAY_IDENTIFIER AsMapCtl_NVM.Vtp_it_ar_NVM[10] ECU_ADDRESS 0xd000587c FORMAT "%11.9" /end MEASUREMENT
/begin MEASUREMENT Vtp_it_ar[11] "Variable table for throttle area curve." UWORD _CNV_A_R_LINEAR_____95_CM 1 0. 0. 3.90619e-003 DISPLAY_IDENTIFIER AsMapCtl_NVM.Vtp_it_ar_NVM[11] ECU_ADDRESS 0xd000587e FORMAT "%11.9" /end MEASUREMENT
/begin MEASUREMENT Vtp_it_ar[12] "Variable table for throttle area curve." UWORD _CNV_A_R_LINEAR_____95_CM 1 0. 0. 3.90619e-003 DISPLAY_IDENTIFIER AsMapCtl_NVM.Vtp_it_ar_NVM[12] ECU_ADDRESS 0xd0005880 FORMAT "%11.9" /end MEASUREMENT
/begin MEASUREMENT Vtp_it_ar[13] "Variable table for throttle area curve." UWORD _CNV_A_R_LINEAR_____95_CM 1 0. 0. 3.90619e-003 DISPLAY_IDENTIFIER AsMapCtl_NVM.Vtp_it_ar_NVM[13] ECU_ADDRESS 0xd0005882 FORMAT "%11.9" /end MEASUREMENT
/begin MEASUREMENT Vtp_it_ar[14] "Variable table for throttle area curve." UWORD _CNV_A_R_LINEAR_____95_CM 1 0. 0. 3.90619e-003 DISPLAY_IDENTIFIER AsMapCtl_NVM.Vtp_it_ar_NVM[14] ECU_ADDRESS 0xd0005884 FORMAT "%11.9" /end MEASUREMENT
/begin MEASUREMENT Vtp_it_ar[15] "Variable table for throttle area curve." UWORD _CNV_A_R_LINEAR_____95_CM 1 0. 0. 3.90619e-003 DISPLAY_IDENTIFIER AsMapCtl_NVM.Vtp_it_ar_NVM[15] ECU_ADDRESS 0xd0005886 FORMAT "%11.9" /end MEASUREMENT
/begin MEASUREMENT Vtp_it_ar[16] "Variable table for throttle area curve." UWORD _CNV_A_R_LINEAR_____95_CM 1 0. 0. 3.90619e-003 DISPLAY_IDENTIFIER AsMapCtl_NVM.Vtp_it_ar_NVM[16] ECU_ADDRESS 0xd0005888 FORMAT "%11.9" /end MEASUREMENT
/begin CHARACTERISTIC Ctb_no_it_psn "Table of numbers for breakpoint throttle position." CURVE 0xa002f9c8 _REC_A1CUR_20_u2_u2 31.99951171875 _CNV_A_R_LINEAR_____98_CM 0. 31.99951171875 FORMAT "%9.6"
 /begin AXIS_DESCR COM_AXIS Vxx_mv_it_rel_psn _CNV_A_R_LINEAR_____99_CM 17 0. 100. FORMAT "%6.2" AXIS_PTS_REF Ctp_it_ar_psn /end AXIS_DESCR
/end CHARACTERISTIC
/begin MEASUREMENT Vbx_act1_cor_it_adj "Boolean indicated that stabilised conditions agree to enable the \"A.C.T.A\" computing" UBYTE _CNV_S_2_RANGE______3_CM 1 0. 0. 1. ECU_ADDRESS 0xd0004848 BIT_MASK 0x1 /end MEASUREMENT
/begin MEASUREMENT Vbx_act2_cor_it_adj "Boolean indicated that limit conditions agree to enable the \"A.C.T.A\" computing" UBYTE _CNV_S_2_RANGE______3_CM 1 0. 0. 1. ECU_ADDRESS 0xd0004849 BIT_MASK 0x1 /end MEASUREMENT
/begin MEASUREMENT Vbx_act_cor_it_adj "Boolean for activation of \"A.C.T.A\" computing" UBYTE _CNV_S_2_RANGE______3_CM 1 0. 0. 1. ECU_ADDRESS 0xd000484a BIT_MASK 0x1 /end MEASUREMENT
/begin MEASUREMENT Vbx_cor_map_it_adj "Boolean of M.A.P stabilised conditions for \"A.C.T.A\" computing activation" UBYTE _CNV_S_2_RANGE______3_CM 1 0. 0. 1. ECU_ADDRESS 0xd000484b BIT_MASK 0x1 /end MEASUREMENT
/begin MEASUREMENT Vbx_cor_n_it_adj "Boolean of engine speed stabilised conditions for \"A.C.T.A\" computing activation" UBYTE _CNV_S_2_RANGE______3_CM 1 0. 0. 1. ECU_ADDRESS 0xd000484c BIT_MASK 0x1 /end MEASUREMENT
/begin MEASUREMENT Vbx_rst_cor_it_adj "Boolean to reset the modified throttle are curve towards reference one" UBYTE _CNV_S_2_RANGE______3_CM 1 0. 0. 1. ECU_ADDRESS 0xd000484d BIT_MASK 0x1 /end MEASUREMENT
/begin MEASUREMENT Vtp_cor_it_ar[0] "Final throttle area curve computed from \"A.C.T.A.\" strategy" UWORD _CNV_A_R_LINEAR_____95_CM 1 0. 0. 3.90619e-003 ECU_ADDRESS 0xd000588c FORMAT "%11.9" /end MEASUREMENT
/begin MEASUREMENT Vtp_cor_it_ar[1] "Final throttle area curve computed from \"A.C.T.A.\" strategy" UWORD _CNV_A_R_LINEAR_____95_CM 1 0. 0. 3.90619e-003 ECU_ADDRESS 0xd000588e FORMAT "%11.9" /end MEASUREMENT
/begin MEASUREMENT Vtp_cor_it_ar[2] "Final throttle area curve computed from \"A.C.T.A.\" strategy" UWORD _CNV_A_R_LINEAR_____95_CM 1 0. 0. 3.90619e-003 ECU_ADDRESS 0xd0005890 FORMAT "%11.9" /end MEASUREMENT
/begin MEASUREMENT Vtp_cor_it_ar[3] "Final throttle area curve computed from \"A.C.T.A.\" strategy" UWORD _CNV_A_R_LINEAR_____95_CM 1 0. 0. 3.90619e-003 ECU_ADDRESS 0xd0005892 FORMAT "%11.9" /end MEASUREMENT
/begin MEASUREMENT Vtp_cor_it_ar[4] "Final throttle area curve computed from \"A.C.T.A.\" strategy" UWORD _CNV_A_R_LINEAR_____95_CM 1 0. 0. 3.90619e-003 ECU_ADDRESS 0xd0005894 FORMAT "%11.9" /end MEASUREMENT
/begin MEASUREMENT Vtp_cor_it_ar[5] "Final throttle area curve computed from \"A.C.T.A.\" strategy" UWORD _CNV_A_R_LINEAR_____95_CM 1 0. 0. 3.90619e-003 ECU_ADDRESS 0xd0005896 FORMAT "%11.9" /end MEASUREMENT
/begin MEASUREMENT Vtp_cor_it_ar[6] "Final throttle area curve computed from \"A.C.T.A.\" strategy" UWORD _CNV_A_R_LINEAR_____95_CM 1 0. 0. 3.90619e-003 ECU_ADDRESS 0xd0005898 FORMAT "%11.9" /end MEASUREMENT
/begin MEASUREMENT Vtp_cor_it_ar[7] "Final throttle area curve computed from \"A.C.T.A.\" strategy" UWORD _CNV_A_R_LINEAR_____95_CM 1 0. 0. 3.90619e-003 ECU_ADDRESS 0xd000589a FORMAT "%11.9" /end MEASUREMENT
/begin MEASUREMENT Vtp_cor_it_ar[8] "Final throttle area curve computed from \"A.C.T.A.\" strategy" UWORD _CNV_A_R_LINEAR_____95_CM 1 0. 0. 3.90619e-003 ECU_ADDRESS 0xd000589c FORMAT "%11.9" /end MEASUREMENT
/begin MEASUREMENT Vtp_cor_it_ar[9] "Final throttle area curve computed from \"A.C.T.A.\" strategy" UWORD _CNV_A_R_LINEAR_____95_CM 1 0. 0. 3.90619e-003 ECU_ADDRESS 0xd000589e FORMAT "%11.9" /end MEASUREMENT
/begin MEASUREMENT Vtp_cor_it_ar[10] "Final throttle area curve computed from \"A.C.T.A.\" strategy" UWORD _CNV_A_R_LINEAR_____95_CM 1 0. 0. 3.90619e-003 ECU_ADDRESS 0xd00058a0 FORMAT "%11.9" /end MEASUREMENT
/begin MEASUREMENT Vtp_cor_it_ar[11] "Final throttle area curve computed from \"A.C.T.A.\" strategy" UWORD _CNV_A_R_LINEAR_____95_CM 1 0. 0. 3.90619e-003 ECU_ADDRESS 0xd00058a2 FORMAT "%11.9" /end MEASUREMENT
/begin MEASUREMENT Vtp_cor_it_ar[12] "Final throttle area curve computed from \"A.C.T.A.\" strategy" UWORD _CNV_A_R_LINEAR_____95_CM 1 0. 0. 3.90619e-003 ECU_ADDRESS 0xd00058a4 FORMAT "%11.9" /end MEASUREMENT
/begin MEASUREMENT Vtp_cor_it_ar[13] "Final throttle area curve computed from \"A.C.T.A.\" strategy" UWORD _CNV_A_R_LINEAR_____95_CM 1 0. 0. 3.90619e-003 ECU_ADDRESS 0xd00058a6 FORMAT "%11.9" /end MEASUREMENT
/begin MEASUREMENT Vtp_cor_it_ar[14] "Final throttle area curve computed from \"A.C.T.A.\" strategy" UWORD _CNV_A_R_LINEAR_____95_CM 1 0. 0. 3.90619e-003 ECU_ADDRESS 0xd00058a8 FORMAT "%11.9" /end MEASUREMENT
/begin MEASUREMENT Vtp_cor_it_ar[15] "Final throttle area curve computed from \"A.C.T.A.\" strategy" UWORD _CNV_A_R_LINEAR_____95_CM 1 0. 0. 3.90619e-003 ECU_ADDRESS 0xd00058aa FORMAT "%11.9" /end MEASUREMENT
/begin MEASUREMENT Vtp_cor_it_ar[16] "Final throttle area curve computed from \"A.C.T.A.\" strategy" UWORD _CNV_A_R_LINEAR_____95_CM 1 0. 0. 3.90619e-003 ECU_ADDRESS 0xd00058ac FORMAT "%11.9" /end MEASUREMENT
/begin MEASUREMENT Vtp_int_it_ar[0] "Intermediate throttle area curve computed from \"A.C.T.A\" strategy" UWORD _CNV_A_R_LINEAR_____95_CM 1 0. 0. 3.90619e-003 ECU_ADDRESS 0xd00058b0 FORMAT "%11.9" /end MEASUREMENT
/begin MEASUREMENT Vtp_int_it_ar[1] "Intermediate throttle area curve computed from \"A.C.T.A\" strategy" UWORD _CNV_A_R_LINEAR_____95_CM 1 0. 0. 3.90619e-003 ECU_ADDRESS 0xd00058b2 FORMAT "%11.9" /end MEASUREMENT
/begin MEASUREMENT Vtp_int_it_ar[2] "Intermediate throttle area curve computed from \"A.C.T.A\" strategy" UWORD _CNV_A_R_LINEAR_____95_CM 1 0. 0. 3.90619e-003 ECU_ADDRESS 0xd00058b4 FORMAT "%11.9" /end MEASUREMENT
/begin MEASUREMENT Vtp_int_it_ar[3] "Intermediate throttle area curve computed from \"A.C.T.A\" strategy" UWORD _CNV_A_R_LINEAR_____95_CM 1 0. 0. 3.90619e-003 ECU_ADDRESS 0xd00058b6 FORMAT "%11.9" /end MEASUREMENT
/begin MEASUREMENT Vtp_int_it_ar[4] "Intermediate throttle area curve computed from \"A.C.T.A\" strategy" UWORD _CNV_A_R_LINEAR_____95_CM 1 0. 0. 3.90619e-003 ECU_ADDRESS 0xd00058b8 FORMAT "%11.9" /end MEASUREMENT
/begin MEASUREMENT Vtp_int_it_ar[5] "Intermediate throttle area curve computed from \"A.C.T.A\" strategy" UWORD _CNV_A_R_LINEAR_____95_CM 1 0. 0. 3.90619e-003 ECU_ADDRESS 0xd00058ba FORMAT "%11.9" /end MEASUREMENT
/begin MEASUREMENT Vtp_int_it_ar[6] "Intermediate throttle area curve computed from \"A.C.T.A\" strategy" UWORD _CNV_A_R_LINEAR_____95_CM 1 0. 0. 3.90619e-003 ECU_ADDRESS 0xd00058bc FORMAT "%11.9" /end MEASUREMENT
/begin MEASUREMENT Vtp_int_it_ar[7] "Intermediate throttle area curve computed from \"A.C.T.A\" strategy" UWORD _CNV_A_R_LINEAR_____95_CM 1 0. 0. 3.90619e-003 ECU_ADDRESS 0xd00058be FORMAT "%11.9" /end MEASUREMENT
/begin MEASUREMENT Vtp_int_it_ar[8] "Intermediate throttle area curve computed from \"A.C.T.A\" strategy" UWORD _CNV_A_R_LINEAR_____95_CM 1 0. 0. 3.90619e-003 ECU_ADDRESS 0xd00058c0 FORMAT "%11.9" /end MEASUREMENT
/begin MEASUREMENT Vtp_int_it_ar[9] "Intermediate throttle area curve computed from \"A.C.T.A\" strategy" UWORD _CNV_A_R_LINEAR_____95_CM 1 0. 0. 3.90619e-003 ECU_ADDRESS 0xd00058c2 FORMAT "%11.9" /end MEASUREMENT
/begin MEASUREMENT Vtp_int_it_ar[10] "Intermediate throttle area curve computed from \"A.C.T.A\" strategy" UWORD _CNV_A_R_LINEAR_____95_CM 1 0. 0. 3.90619e-003 ECU_ADDRESS 0xd00058c4 FORMAT "%11.9" /end MEASUREMENT
/begin MEASUREMENT Vtp_int_it_ar[11] "Intermediate throttle area curve computed from \"A.C.T.A\" strategy" UWORD _CNV_A_R_LINEAR_____95_CM 1 0. 0. 3.90619e-003 ECU_ADDRESS 0xd00058c6 FORMAT "%11.9" /end MEASUREMENT
/begin MEASUREMENT Vtp_int_it_ar[12] "Intermediate throttle area curve computed from \"A.C.T.A\" strategy" UWORD _CNV_A_R_LINEAR_____95_CM 1 0. 0. 3.90619e-003 ECU_ADDRESS 0xd00058c8 FORMAT "%11.9" /end MEASUREMENT
/begin MEASUREMENT Vtp_int_it_ar[13] "Intermediate throttle area curve computed from \"A.C.T.A\" strategy" UWORD _CNV_A_R_LINEAR_____95_CM 1 0. 0. 3.90619e-003 ECU_ADDRESS 0xd00058ca FORMAT "%11.9" /end MEASUREMENT
/begin MEASUREMENT Vtp_int_it_ar[14] "Intermediate throttle area curve computed from \"A.C.T.A\" strategy" UWORD _CNV_A_R_LINEAR_____95_CM 1 0. 0. 3.90619e-003 ECU_ADDRESS 0xd00058cc FORMAT "%11.9" /end MEASUREMENT
/begin MEASUREMENT Vtp_int_it_ar[15] "Intermediate throttle area curve computed from \"A.C.T.A\" strategy" UWORD _CNV_A_R_LINEAR_____95_CM 1 0. 0. 3.90619e-003 ECU_ADDRESS 0xd00058ce FORMAT "%11.9" /end MEASUREMENT
/begin MEASUREMENT Vtp_int_it_ar[16] "Intermediate throttle area curve computed from \"A.C.T.A\" strategy" UWORD _CNV_A_R_LINEAR_____95_CM 1 0. 0. 3.90619e-003 ECU_ADDRESS 0xd00058d0 FORMAT "%11.9" /end MEASUREMENT
/begin MEASUREMENT Vtp_it_ar_raw[0] "Intermediate throttle area curve computed from \"A.C.T.A\" strategy" UWORD _CNV_A_R_LINEAR_____95_CM 1 0. 0. 3.90619e-003 ECU_ADDRESS 0xd00058d4 FORMAT "%11.9" /end MEASUREMENT
/begin MEASUREMENT Vtp_it_ar_raw[1] "Intermediate throttle area curve computed from \"A.C.T.A\" strategy" UWORD _CNV_A_R_LINEAR_____95_CM 1 0. 0. 3.90619e-003 ECU_ADDRESS 0xd00058d6 FORMAT "%11.9" /end MEASUREMENT
/begin MEASUREMENT Vtp_it_ar_raw[2] "Intermediate throttle area curve computed from \"A.C.T.A\" strategy" UWORD _CNV_A_R_LINEAR_____95_CM 1 0. 0. 3.90619e-003 ECU_ADDRESS 0xd00058d8 FORMAT "%11.9" /end MEASUREMENT
/begin MEASUREMENT Vtp_it_ar_raw[3] "Intermediate throttle area curve computed from \"A.C.T.A\" strategy" UWORD _CNV_A_R_LINEAR_____95_CM 1 0. 0. 3.90619e-003 ECU_ADDRESS 0xd00058da FORMAT "%11.9" /end MEASUREMENT
/begin MEASUREMENT Vtp_it_ar_raw[4] "Intermediate throttle area curve computed from \"A.C.T.A\" strategy" UWORD _CNV_A_R_LINEAR_____95_CM 1 0. 0. 3.90619e-003 ECU_ADDRESS 0xd00058dc FORMAT "%11.9" /end MEASUREMENT
/begin MEASUREMENT Vtp_it_ar_raw[5] "Intermediate throttle area curve computed from \"A.C.T.A\" strategy" UWORD _CNV_A_R_LINEAR_____95_CM 1 0. 0. 3.90619e-003 ECU_ADDRESS 0xd00058de FORMAT "%11.9" /end MEASUREMENT
/begin MEASUREMENT Vtp_it_ar_raw[6] "Intermediate throttle area curve computed from \"A.C.T.A\" strategy" UWORD _CNV_A_R_LINEAR_____95_CM 1 0. 0. 3.90619e-003 ECU_ADDRESS 0xd00058e0 FORMAT "%11.9" /end MEASUREMENT
/begin MEASUREMENT Vtp_it_ar_raw[7] "Intermediate throttle area curve computed from \"A.C.T.A\" strategy" UWORD _CNV_A_R_LINEAR_____95_CM 1 0. 0. 3.90619e-003 ECU_ADDRESS 0xd00058e2 FORMAT "%11.9" /end MEASUREMENT
/begin MEASUREMENT Vtp_it_ar_raw[8] "Intermediate throttle area curve computed from \"A.C.T.A\" strategy" UWORD _CNV_A_R_LINEAR_____95_CM 1 0. 0. 3.90619e-003 ECU_ADDRESS 0xd00058e4 FORMAT "%11.9" /end MEASUREMENT
/begin MEASUREMENT Vtp_it_ar_raw[9] "Intermediate throttle area curve computed from \"A.C.T.A\" strategy" UWORD _CNV_A_R_LINEAR_____95_CM 1 0. 0. 3.90619e-003 ECU_ADDRESS 0xd00058e6 FORMAT "%11.9" /end MEASUREMENT
/begin MEASUREMENT Vtp_it_ar_raw[10] "Intermediate throttle area curve computed from \"A.C.T.A\" strategy" UWORD _CNV_A_R_LINEAR_____95_CM 1 0. 0. 3.90619e-003 ECU_ADDRESS 0xd00058e8 FORMAT "%11.9" /end MEASUREMENT
/begin MEASUREMENT Vtp_it_ar_raw[11] "Intermediate throttle area curve computed from \"A.C.T.A\" strategy" UWORD _CNV_A_R_LINEAR_____95_CM 1 0. 0. 3.90619e-003 ECU_ADDRESS 0xd00058ea FORMAT "%11.9" /end MEASUREMENT
/begin MEASUREMENT Vtp_it_ar_raw[12] "Intermediate throttle area curve computed from \"A.C.T.A\" strategy" UWORD _CNV_A_R_LINEAR_____95_CM 1 0. 0. 3.90619e-003 ECU_ADDRESS 0xd00058ec FORMAT "%11.9" /end MEASUREMENT
/begin MEASUREMENT Vtp_it_ar_raw[13] "Intermediate throttle area curve computed from \"A.C.T.A\" strategy" UWORD _CNV_A_R_LINEAR_____95_CM 1 0. 0. 3.90619e-003 ECU_ADDRESS 0xd00058ee FORMAT "%11.9" /end MEASUREMENT
/begin MEASUREMENT Vtp_it_ar_raw[14] "Intermediate throttle area curve computed from \"A.C.T.A\" strategy" UWORD _CNV_A_R_LINEAR_____95_CM 1 0. 0. 3.90619e-003 ECU_ADDRESS 0xd00058f0 FORMAT "%11.9" /end MEASUREMENT
/begin MEASUREMENT Vtp_it_ar_raw[15] "Intermediate throttle area curve computed from \"A.C.T.A\" strategy" UWORD _CNV_A_R_LINEAR_____95_CM 1 0. 0. 3.90619e-003 ECU_ADDRESS 0xd00058f2 FORMAT "%11.9" /end MEASUREMENT
/begin MEASUREMENT Vtp_it_ar_raw[16] "Intermediate throttle area curve computed from \"A.C.T.A\" strategy" UWORD _CNV_A_R_LINEAR_____95_CM 1 0. 0. 3.90619e-003 ECU_ADDRESS 0xd00058f4 FORMAT "%11.9" /end MEASUREMENT
/begin MEASUREMENT Vtp_lim_it_ar[0] "Limited intermediate throttle area curve computed from \"A.C.T.A\" strategy" UWORD _CNV_A_R_LINEAR_____95_CM 1 0. 0. 3.90619e-003 ECU_ADDRESS 0xd00058f8 FORMAT "%11.9" /end MEASUREMENT
/begin MEASUREMENT Vtp_lim_it_ar[1] "Limited intermediate throttle area curve computed from \"A.C.T.A\" strategy" UWORD _CNV_A_R_LINEAR_____95_CM 1 0. 0. 3.90619e-003 ECU_ADDRESS 0xd00058fa FORMAT "%11.9" /end MEASUREMENT
/begin MEASUREMENT Vtp_lim_it_ar[2] "Limited intermediate throttle area curve computed from \"A.C.T.A\" strategy" UWORD _CNV_A_R_LINEAR_____95_CM 1 0. 0. 3.90619e-003 ECU_ADDRESS 0xd00058fc FORMAT "%11.9" /end MEASUREMENT
/begin MEASUREMENT Vtp_lim_it_ar[3] "Limited intermediate throttle area curve computed from \"A.C.T.A\" strategy" UWORD _CNV_A_R_LINEAR_____95_CM 1 0. 0. 3.90619e-003 ECU_ADDRESS 0xd00058fe FORMAT "%11.9" /end MEASUREMENT
/begin MEASUREMENT Vtp_lim_it_ar[4] "Limited intermediate throttle area curve computed from \"A.C.T.A\" strategy" UWORD _CNV_A_R_LINEAR_____95_CM 1 0. 0. 3.90619e-003 ECU_ADDRESS 0xd0005900 FORMAT "%11.9" /end MEASUREMENT
/begin MEASUREMENT Vtp_lim_it_ar[5] "Limited intermediate throttle area curve computed from \"A.C.T.A\" strategy" UWORD _CNV_A_R_LINEAR_____95_CM 1 0. 0. 3.90619e-003 ECU_ADDRESS 0xd0005902 FORMAT "%11.9" /end MEASUREMENT
/begin MEASUREMENT Vtp_lim_it_ar[6] "Limited intermediate throttle area curve computed from \"A.C.T.A\" strategy" UWORD _CNV_A_R_LINEAR_____95_CM 1 0. 0. 3.90619e-003 ECU_ADDRESS 0xd0005904 FORMAT "%11.9" /end MEASUREMENT
/begin MEASUREMENT Vtp_lim_it_ar[7] "Limited intermediate throttle area curve computed from \"A.C.T.A\" strategy" UWORD _CNV_A_R_LINEAR_____95_CM 1 0. 0. 3.90619e-003 ECU_ADDRESS 0xd0005906 FORMAT "%11.9" /end MEASUREMENT
/begin MEASUREMENT Vtp_lim_it_ar[8] "Limited intermediate throttle area curve computed from \"A.C.T.A\" strategy" UWORD _CNV_A_R_LINEAR_____95_CM 1 0. 0. 3.90619e-003 ECU_ADDRESS 0xd0005908 FORMAT "%11.9" /end MEASUREMENT
/begin MEASUREMENT Vtp_lim_it_ar[9] "Limited intermediate throttle area curve computed from \"A.C.T.A\" strategy" UWORD _CNV_A_R_LINEAR_____95_CM 1 0. 0. 3.90619e-003 ECU_ADDRESS 0xd000590a FORMAT "%11.9" /end MEASUREMENT
/begin MEASUREMENT Vtp_lim_it_ar[10] "Limited intermediate throttle area curve computed from \"A.C.T.A\" strategy" UWORD _CNV_A_R_LINEAR_____95_CM 1 0. 0. 3.90619e-003 ECU_ADDRESS 0xd000590c FORMAT "%11.9" /end MEASUREMENT
/begin MEASUREMENT Vtp_lim_it_ar[11] "Limited intermediate throttle area curve computed from \"A.C.T.A\" strategy" UWORD _CNV_A_R_LINEAR_____95_CM 1 0. 0. 3.90619e-003 ECU_ADDRESS 0xd000590e FORMAT "%11.9" /end MEASUREMENT
/begin MEASUREMENT Vtp_lim_it_ar[12] "Limited intermediate throttle area curve computed from \"A.C.T.A\" strategy" UWORD _CNV_A_R_LINEAR_____95_CM 1 0. 0. 3.90619e-003 ECU_ADDRESS 0xd0005910 FORMAT "%11.9" /end MEASUREMENT
/begin MEASUREMENT Vtp_lim_it_ar[13] "Limited intermediate throttle area curve computed from \"A.C.T.A\" strategy" UWORD _CNV_A_R_LINEAR_____95_CM 1 0. 0. 3.90619e-003 ECU_ADDRESS 0xd0005912 FORMAT "%11.9" /end MEASUREMENT
/begin MEASUREMENT Vtp_lim_it_ar[14] "Limited intermediate throttle area curve computed from \"A.C.T.A\" strategy" UWORD _CNV_A_R_LINEAR_____95_CM 1 0. 0. 3.90619e-003 ECU_ADDRESS 0xd0005914 FORMAT "%11.9" /end MEASUREMENT
/begin MEASUREMENT Vtp_lim_it_ar[15] "Limited intermediate throttle area curve computed from \"A.C.T.A\" strategy" UWORD _CNV_A_R_LINEAR_____95_CM 1 0. 0. 3.90619e-003 ECU_ADDRESS 0xd0005916 FORMAT "%11.9" /end MEASUREMENT
/begin MEASUREMENT Vtp_lim_it_ar[16] "Limited intermediate throttle area curve computed from \"A.C.T.A\" strategy" UWORD _CNV_A_R_LINEAR_____95_CM 1 0. 0. 3.90619e-003 ECU_ADDRESS 0xd0005918 FORMAT "%11.9" /end MEASUREMENT
/begin MEASUREMENT Vtx_fac_cor_it_adj[0] "Vector of correction values for throttle area curve" UWORD _CNV_A_R_LINEAR_____100_CM 1 0. 0.9 1.099996948 ECU_ADDRESS 0xd000591c FORMAT "%16.12" /end MEASUREMENT
/begin MEASUREMENT Vtx_fac_cor_it_adj[1] "Vector of correction values for throttle area curve" UWORD _CNV_A_R_LINEAR_____100_CM 1 0. 0.9 1.099996948 ECU_ADDRESS 0xd000591e FORMAT "%16.12" /end MEASUREMENT
/begin MEASUREMENT Vtx_fac_cor_it_adj[2] "Vector of correction values for throttle area curve" UWORD _CNV_A_R_LINEAR_____100_CM 1 0. 0.9 1.099996948 ECU_ADDRESS 0xd0005920 FORMAT "%16.12" /end MEASUREMENT
/begin MEASUREMENT Vtx_fac_cor_it_adj[3] "Vector of correction values for throttle area curve" UWORD _CNV_A_R_LINEAR_____100_CM 1 0. 0.9 1.099996948 ECU_ADDRESS 0xd0005922 FORMAT "%16.12" /end MEASUREMENT
/begin MEASUREMENT Vtx_fac_cor_it_adj[4] "Vector of correction values for throttle area curve" UWORD _CNV_A_R_LINEAR_____100_CM 1 0. 0.9 1.099996948 ECU_ADDRESS 0xd0005924 FORMAT "%16.12" /end MEASUREMENT
/begin MEASUREMENT Vtx_fac_cor_it_adj[5] "Vector of correction values for throttle area curve" UWORD _CNV_A_R_LINEAR_____100_CM 1 0. 0.9 1.099996948 ECU_ADDRESS 0xd0005926 FORMAT "%16.12" /end MEASUREMENT
/begin MEASUREMENT Vtx_fac_cor_it_adj[6] "Vector of correction values for throttle area curve" UWORD _CNV_A_R_LINEAR_____100_CM 1 0. 0.9 1.099996948 ECU_ADDRESS 0xd0005928 FORMAT "%16.12" /end MEASUREMENT
/begin MEASUREMENT Vtx_fac_cor_it_adj[7] "Vector of correction values for throttle area curve" UWORD _CNV_A_R_LINEAR_____100_CM 1 0. 0.9 1.099996948 ECU_ADDRESS 0xd000592a FORMAT "%16.12" /end MEASUREMENT
/begin MEASUREMENT Vtx_fac_cor_it_adj[8] "Vector of correction values for throttle area curve" UWORD _CNV_A_R_LINEAR_____100_CM 1 0. 0.9 1.099996948 ECU_ADDRESS 0xd000592c FORMAT "%16.12" /end MEASUREMENT
/begin MEASUREMENT Vtx_fac_cor_it_adj[9] "Vector of correction values for throttle area curve" UWORD _CNV_A_R_LINEAR_____100_CM 1 0. 0.9 1.099996948 ECU_ADDRESS 0xd000592e FORMAT "%16.12" /end MEASUREMENT
/begin MEASUREMENT Vtx_fac_cor_it_adj[10] "Vector of correction values for throttle area curve" UWORD _CNV_A_R_LINEAR_____100_CM 1 0. 0.9 1.099996948 ECU_ADDRESS 0xd0005930 FORMAT "%16.12" /end MEASUREMENT
/begin MEASUREMENT Vtx_fac_cor_it_adj[11] "Vector of correction values for throttle area curve" UWORD _CNV_A_R_LINEAR_____100_CM 1 0. 0.9 1.099996948 ECU_ADDRESS 0xd0005932 FORMAT "%16.12" /end MEASUREMENT
/begin MEASUREMENT Vtx_fac_cor_it_adj[12] "Vector of correction values for throttle area curve" UWORD _CNV_A_R_LINEAR_____100_CM 1 0. 0.9 1.099996948 ECU_ADDRESS 0xd0005934 FORMAT "%16.12" /end MEASUREMENT
/begin MEASUREMENT Vtx_fac_cor_it_adj[13] "Vector of correction values for throttle area curve" UWORD _CNV_A_R_LINEAR_____100_CM 1 0. 0.9 1.099996948 ECU_ADDRESS 0xd0005936 FORMAT "%16.12" /end MEASUREMENT
/begin MEASUREMENT Vtx_fac_cor_it_adj[14] "Vector of correction values for throttle area curve" UWORD _CNV_A_R_LINEAR_____100_CM 1 0. 0.9 1.099996948 ECU_ADDRESS 0xd0005938 FORMAT "%16.12" /end MEASUREMENT
/begin MEASUREMENT Vtx_fac_cor_it_adj[15] "Vector of correction values for throttle area curve" UWORD _CNV_A_R_LINEAR_____100_CM 1 0. 0.9 1.099996948 ECU_ADDRESS 0xd000593a FORMAT "%16.12" /end MEASUREMENT
/begin MEASUREMENT Vtx_fac_cor_it_adj[16] "Vector of correction values for throttle area curve" UWORD _CNV_A_R_LINEAR_____100_CM 1 0. 0.9 1.099996948 ECU_ADDRESS 0xd000593c FORMAT "%16.12" /end MEASUREMENT
/begin MEASUREMENT Vxx_fil_fac_cor_it_adj "Filtered corrective value computed from M.A.P error between measured and modelised values" UWORD _CNV_A_R_LINEAR_____101_CM 1 0. -0.1 9.999694824218749e-002 ECU_ADDRESS 0xd000593e FORMAT "%16.12" /end MEASUREMENT
/begin MEASUREMENT Vxx_raw_fac_cor_it_adj "Raw value computed from M.A.P error between measured and modelised values" UWORD _CNV_A_R_LINEAR_____101_CM 1 0. -0.1 9.999694824218749e-002 ECU_ADDRESS 0xd0005940 FORMAT "%16.12" /end MEASUREMENT
/begin CHARACTERISTIC Cbx_bch_cp_it_adj "Bench mode to activate the strategy independently to canister purge phase" VALUE 0xa0021d1c _REC_S1VAL_20_u1 1. _CNV_S_2_RANGE______3_CM 0. 1. /end CHARACTERISTIC
/begin CHARACTERISTIC Cbx_bch_dsb_it_adj "Bench mode to inhibit \"A.C.T.A\" strategy" VALUE 0xa0021d1d _REC_S1VAL_20_u1 1. _CNV_S_2_RANGE______3_CM 0. 1. /end CHARACTERISTIC
/begin CHARACTERISTIC Cbx_bch_dsb_it_adj_val "General bench mode value activating (On) or deactivating (Off) the strategy" VALUE 0xa0021d1e _REC_S1VAL_20_u1 1. _CNV_S_2_RANGE______3_CM 0. 1. /end CHARACTERISTIC
/begin CHARACTERISTIC Cbx_bch_rst_it_adj "Bench mode to reset the corrected throttle area computed from \"A.C.T.A\" strategy" VALUE 0xa0021d1f _REC_S1VAL_20_u1 1. _CNV_S_2_RANGE______3_CM 0. 1. /end CHARACTERISTIC
/begin CHARACTERISTIC Cbx_ena_appl_it_adj "Bench mode to enable the corrected throttle area computed from \"A.C.T.A\" strategy" VALUE 0xa0021d20 _REC_S1VAL_20_u1 1. _CNV_S_2_RANGE______3_CM 0. 1. /end CHARACTERISTIC
/begin CHARACTERISTIC Ctb_it_ar[0] "Reference throttle area curve tuned with reference throttle and engine" VALUE 0xa002f9ec _REC_S1VAL_20_u2 3.906190395355219e-003 _CNV_A_R_LINEAR_____97_CM 0. 3.90619039535522e-003 FORMAT "%16.12" /end CHARACTERISTIC
/begin CHARACTERISTIC Ctb_it_ar[1] "Reference throttle area curve tuned with reference throttle and engine" VALUE 0xa002f9ee _REC_S1VAL_20_u2 3.906190395355219e-003 _CNV_A_R_LINEAR_____97_CM 0. 3.90619039535522e-003 FORMAT "%16.12" /end CHARACTERISTIC
/begin CHARACTERISTIC Ctb_it_ar[2] "Reference throttle area curve tuned with reference throttle and engine" VALUE 0xa002f9f0 _REC_S1VAL_20_u2 3.906190395355219e-003 _CNV_A_R_LINEAR_____97_CM 0. 3.90619039535522e-003 FORMAT "%16.12" /end CHARACTERISTIC
/begin CHARACTERISTIC Ctb_it_ar[3] "Reference throttle area curve tuned with reference throttle and engine" VALUE 0xa002f9f2 _REC_S1VAL_20_u2 3.906190395355219e-003 _CNV_A_R_LINEAR_____97_CM 0. 3.90619039535522e-003 FORMAT "%16.12" /end CHARACTERISTIC
/begin CHARACTERISTIC Ctb_it_ar[4] "Reference throttle area curve tuned with reference throttle and engine" VALUE 0xa002f9f4 _REC_S1VAL_20_u2 3.906190395355219e-003 _CNV_A_R_LINEAR_____97_CM 0. 3.90619039535522e-003 FORMAT "%16.12" /end CHARACTERISTIC
/begin CHARACTERISTIC Ctb_it_ar[5] "Reference throttle area curve tuned with reference throttle and engine" VALUE 0xa002f9f6 _REC_S1VAL_20_u2 3.906190395355219e-003 _CNV_A_R_LINEAR_____97_CM 0. 3.90619039535522e-003 FORMAT "%16.12" /end CHARACTERISTIC
/begin CHARACTERISTIC Ctb_it_ar[6] "Reference throttle area curve tuned with reference throttle and engine" VALUE 0xa002f9f8 _REC_S1VAL_20_u2 3.906190395355219e-003 _CNV_A_R_LINEAR_____97_CM 0. 3.90619039535522e-003 FORMAT "%16.12" /end CHARACTERISTIC
/begin CHARACTERISTIC Ctb_it_ar[7] "Reference throttle area curve tuned with reference throttle and engine" VALUE 0xa002f9fa _REC_S1VAL_20_u2 3.906190395355219e-003 _CNV_A_R_LINEAR_____97_CM 0. 3.90619039535522e-003 FORMAT "%16.12" /end CHARACTERISTIC
/begin CHARACTERISTIC Ctb_it_ar[8] "Reference throttle area curve tuned with reference throttle and engine" VALUE 0xa002f9fc _REC_S1VAL_20_u2 3.906190395355219e-003 _CNV_A_R_LINEAR_____97_CM 0. 3.90619039535522e-003 FORMAT "%16.12" /end CHARACTERISTIC
/begin CHARACTERISTIC Ctb_it_ar[9] "Reference throttle area curve tuned with reference throttle and engine" VALUE 0xa002f9fe _REC_S1VAL_20_u2 3.906190395355219e-003 _CNV_A_R_LINEAR_____97_CM 0. 3.90619039535522e-003 FORMAT "%16.12" /end CHARACTERISTIC
/begin CHARACTERISTIC Ctb_it_ar[10] "Reference throttle area curve tuned with reference throttle and engine" VALUE 0xa002fa00 _REC_S1VAL_20_u2 3.906190395355219e-003 _CNV_A_R_LINEAR_____97_CM 0. 3.90619039535522e-003 FORMAT "%16.12" /end CHARACTERISTIC
/begin CHARACTERISTIC Ctb_it_ar[11] "Reference throttle area curve tuned with reference throttle and engine" VALUE 0xa002fa02 _REC_S1VAL_20_u2 3.906190395355219e-003 _CNV_A_R_LINEAR_____97_CM 0. 3.90619039535522e-003 FORMAT "%16.12" /end CHARACTERISTIC
/begin CHARACTERISTIC Ctb_it_ar[12] "Reference throttle area curve tuned with reference throttle and engine" VALUE 0xa002fa04 _REC_S1VAL_20_u2 3.906190395355219e-003 _CNV_A_R_LINEAR_____97_CM 0. 3.90619039535522e-003 FORMAT "%16.12" /end CHARACTERISTIC
/begin CHARACTERISTIC Ctb_it_ar[13] "Reference throttle area curve tuned with reference throttle and engine" VALUE 0xa002fa06 _REC_S1VAL_20_u2 3.906190395355219e-003 _CNV_A_R_LINEAR_____97_CM 0. 3.90619039535522e-003 FORMAT "%16.12" /end CHARACTERISTIC
/begin CHARACTERISTIC Ctb_it_ar[14] "Reference throttle area curve tuned with reference throttle and engine" VALUE 0xa002fa08 _REC_S1VAL_20_u2 3.906190395355219e-003 _CNV_A_R_LINEAR_____97_CM 0. 3.90619039535522e-003 FORMAT "%16.12" /end CHARACTERISTIC
/begin CHARACTERISTIC Ctb_it_ar[15] "Reference throttle area curve tuned with reference throttle and engine" VALUE 0xa002fa0a _REC_S1VAL_20_u2 3.906190395355219e-003 _CNV_A_R_LINEAR_____97_CM 0. 3.90619039535522e-003 FORMAT "%16.12" /end CHARACTERISTIC
/begin CHARACTERISTIC Ctb_it_ar[16] "Reference throttle area curve tuned with reference throttle and engine" VALUE 0xa002fa0c _REC_S1VAL_20_u2 3.906190395355219e-003 _CNV_A_R_LINEAR_____97_CM 0. 3.90619039535522e-003 FORMAT "%16.12" /end CHARACTERISTIC
/begin CHARACTERISTIC Ctx_fac_cor_it_ar_max[0] "Table of gain on reference throttle area curve to define minimum throttle area curve" VALUE 0xa002fa10 _REC_S1VAL_20_u2 0.99609375 _CNV_A_R_LINEAR_____102_CM 1. 1.99609375 FORMAT "%10.8" /end CHARACTERISTIC
/begin CHARACTERISTIC Ctx_fac_cor_it_ar_max[1] "Table of gain on reference throttle area curve to define minimum throttle area curve" VALUE 0xa002fa12 _REC_S1VAL_20_u2 0.99609375 _CNV_A_R_LINEAR_____102_CM 1. 1.99609375 FORMAT "%10.8" /end CHARACTERISTIC
/begin CHARACTERISTIC Ctx_fac_cor_it_ar_max[2] "Table of gain on reference throttle area curve to define minimum throttle area curve" VALUE 0xa002fa14 _REC_S1VAL_20_u2 0.99609375 _CNV_A_R_LINEAR_____102_CM 1. 1.99609375 FORMAT "%10.8" /end CHARACTERISTIC
/begin CHARACTERISTIC Ctx_fac_cor_it_ar_max[3] "Table of gain on reference throttle area curve to define minimum throttle area curve" VALUE 0xa002fa16 _REC_S1VAL_20_u2 0.99609375 _CNV_A_R_LINEAR_____102_CM 1. 1.99609375 FORMAT "%10.8" /end CHARACTERISTIC
/begin CHARACTERISTIC Ctx_fac_cor_it_ar_max[4] "Table of gain on reference throttle area curve to define minimum throttle area curve" VALUE 0xa002fa18 _REC_S1VAL_20_u2 0.99609375 _CNV_A_R_LINEAR_____102_CM 1. 1.99609375 FORMAT "%10.8" /end CHARACTERISTIC
/begin CHARACTERISTIC Ctx_fac_cor_it_ar_max[5] "Table of gain on reference throttle area curve to define minimum throttle area curve" VALUE 0xa002fa1a _REC_S1VAL_20_u2 0.99609375 _CNV_A_R_LINEAR_____102_CM 1. 1.99609375 FORMAT "%10.8" /end CHARACTERISTIC
/begin CHARACTERISTIC Ctx_fac_cor_it_ar_max[6] "Table of gain on reference throttle area curve to define minimum throttle area curve" VALUE 0xa002fa1c _REC_S1VAL_20_u2 0.99609375 _CNV_A_R_LINEAR_____102_CM 1. 1.99609375 FORMAT "%10.8" /end CHARACTERISTIC
/begin CHARACTERISTIC Ctx_fac_cor_it_ar_max[7] "Table of gain on reference throttle area curve to define minimum throttle area curve" VALUE 0xa002fa1e _REC_S1VAL_20_u2 0.99609375 _CNV_A_R_LINEAR_____102_CM 1. 1.99609375 FORMAT "%10.8" /end CHARACTERISTIC
/begin CHARACTERISTIC Ctx_fac_cor_it_ar_max[8] "Table of gain on reference throttle area curve to define minimum throttle area curve" VALUE 0xa002fa20 _REC_S1VAL_20_u2 0.99609375 _CNV_A_R_LINEAR_____102_CM 1. 1.99609375 FORMAT "%10.8" /end CHARACTERISTIC
/begin CHARACTERISTIC Ctx_fac_cor_it_ar_max[9] "Table of gain on reference throttle area curve to define minimum throttle area curve" VALUE 0xa002fa22 _REC_S1VAL_20_u2 0.99609375 _CNV_A_R_LINEAR_____102_CM 1. 1.99609375 FORMAT "%10.8" /end CHARACTERISTIC
/begin CHARACTERISTIC Ctx_fac_cor_it_ar_max[10] "Table of gain on reference throttle area curve to define minimum throttle area curve" VALUE 0xa002fa24 _REC_S1VAL_20_u2 0.99609375 _CNV_A_R_LINEAR_____102_CM 1. 1.99609375 FORMAT "%10.8" /end CHARACTERISTIC
/begin CHARACTERISTIC Ctx_fac_cor_it_ar_max[11] "Table of gain on reference throttle area curve to define minimum throttle area curve" VALUE 0xa002fa26 _REC_S1VAL_20_u2 0.99609375 _CNV_A_R_LINEAR_____102_CM 1. 1.99609375 FORMAT "%10.8" /end CHARACTERISTIC
/begin CHARACTERISTIC Ctx_fac_cor_it_ar_max[12] "Table of gain on reference throttle area curve to define minimum throttle area curve" VALUE 0xa002fa28 _REC_S1VAL_20_u2 0.99609375 _CNV_A_R_LINEAR_____102_CM 1. 1.99609375 FORMAT "%10.8" /end CHARACTERISTIC
/begin CHARACTERISTIC Ctx_fac_cor_it_ar_max[13] "Table of gain on reference throttle area curve to define minimum throttle area curve" VALUE 0xa002fa2a _REC_S1VAL_20_u2 0.99609375 _CNV_A_R_LINEAR_____102_CM 1. 1.99609375 FORMAT "%10.8" /end CHARACTERISTIC
/begin CHARACTERISTIC Ctx_fac_cor_it_ar_max[14] "Table of gain on reference throttle area curve to define minimum throttle area curve" VALUE 0xa002fa2c _REC_S1VAL_20_u2 0.99609375 _CNV_A_R_LINEAR_____102_CM 1. 1.99609375 FORMAT "%10.8" /end CHARACTERISTIC
/begin CHARACTERISTIC Ctx_fac_cor_it_ar_max[15] "Table of gain on reference throttle area curve to define minimum throttle area curve" VALUE 0xa002fa2e _REC_S1VAL_20_u2 0.99609375 _CNV_A_R_LINEAR_____102_CM 1. 1.99609375 FORMAT "%10.8" /end CHARACTERISTIC
/begin CHARACTERISTIC Ctx_fac_cor_it_ar_max[16] "Table of gain on reference throttle area curve to define minimum throttle area curve" VALUE 0xa002fa30 _REC_S1VAL_20_u2 0.99609375 _CNV_A_R_LINEAR_____102_CM 1. 1.99609375 FORMAT "%10.8" /end CHARACTERISTIC
/begin CHARACTERISTIC Ctx_fac_cor_it_ar_min[0] "Table of gain on reference throttle area curve to define minimum throttle area curve" VALUE 0xa002fa34 _REC_S1VAL_20_u2 0.99609375 _CNV_A_R_LINEAR_____31_CM 0. 0.99609375 FORMAT "%10.8" /end CHARACTERISTIC
/begin CHARACTERISTIC Ctx_fac_cor_it_ar_min[1] "Table of gain on reference throttle area curve to define minimum throttle area curve" VALUE 0xa002fa36 _REC_S1VAL_20_u2 0.99609375 _CNV_A_R_LINEAR_____31_CM 0. 0.99609375 FORMAT "%10.8" /end CHARACTERISTIC
/begin CHARACTERISTIC Ctx_fac_cor_it_ar_min[2] "Table of gain on reference throttle area curve to define minimum throttle area curve" VALUE 0xa002fa38 _REC_S1VAL_20_u2 0.99609375 _CNV_A_R_LINEAR_____31_CM 0. 0.99609375 FORMAT "%10.8" /end CHARACTERISTIC
/begin CHARACTERISTIC Ctx_fac_cor_it_ar_min[3] "Table of gain on reference throttle area curve to define minimum throttle area curve" VALUE 0xa002fa3a _REC_S1VAL_20_u2 0.99609375 _CNV_A_R_LINEAR_____31_CM 0. 0.99609375 FORMAT "%10.8" /end CHARACTERISTIC
/begin CHARACTERISTIC Ctx_fac_cor_it_ar_min[4] "Table of gain on reference throttle area curve to define minimum throttle area curve" VALUE 0xa002fa3c _REC_S1VAL_20_u2 0.99609375 _CNV_A_R_LINEAR_____31_CM 0. 0.99609375 FORMAT "%10.8" /end CHARACTERISTIC
/begin CHARACTERISTIC Ctx_fac_cor_it_ar_min[5] "Table of gain on reference throttle area curve to define minimum throttle area curve" VALUE 0xa002fa3e _REC_S1VAL_20_u2 0.99609375 _CNV_A_R_LINEAR_____31_CM 0. 0.99609375 FORMAT "%10.8" /end CHARACTERISTIC
/begin CHARACTERISTIC Ctx_fac_cor_it_ar_min[6] "Table of gain on reference throttle area curve to define minimum throttle area curve" VALUE 0xa002fa40 _REC_S1VAL_20_u2 0.99609375 _CNV_A_R_LINEAR_____31_CM 0. 0.99609375 FORMAT "%10.8" /end CHARACTERISTIC
/begin CHARACTERISTIC Ctx_fac_cor_it_ar_min[7] "Table of gain on reference throttle area curve to define minimum throttle area curve" VALUE 0xa002fa42 _REC_S1VAL_20_u2 0.99609375 _CNV_A_R_LINEAR_____31_CM 0. 0.99609375 FORMAT "%10.8" /end CHARACTERISTIC
/begin CHARACTERISTIC Ctx_fac_cor_it_ar_min[8] "Table of gain on reference throttle area curve to define minimum throttle area curve" VALUE 0xa002fa44 _REC_S1VAL_20_u2 0.99609375 _CNV_A_R_LINEAR_____31_CM 0. 0.99609375 FORMAT "%10.8" /end CHARACTERISTIC
/begin CHARACTERISTIC Ctx_fac_cor_it_ar_min[9] "Table of gain on reference throttle area curve to define minimum throttle area curve" VALUE 0xa002fa46 _REC_S1VAL_20_u2 0.99609375 _CNV_A_R_LINEAR_____31_CM 0. 0.99609375 FORMAT "%10.8" /end CHARACTERISTIC
/begin CHARACTERISTIC Ctx_fac_cor_it_ar_min[10] "Table of gain on reference throttle area curve to define minimum throttle area curve" VALUE 0xa002fa48 _REC_S1VAL_20_u2 0.99609375 _CNV_A_R_LINEAR_____31_CM 0. 0.99609375 FORMAT "%10.8" /end CHARACTERISTIC
/begin CHARACTERISTIC Ctx_fac_cor_it_ar_min[11] "Table of gain on reference throttle area curve to define minimum throttle area curve" VALUE 0xa002fa4a _REC_S1VAL_20_u2 0.99609375 _CNV_A_R_LINEAR_____31_CM 0. 0.99609375 FORMAT "%10.8" /end CHARACTERISTIC
/begin CHARACTERISTIC Ctx_fac_cor_it_ar_min[12] "Table of gain on reference throttle area curve to define minimum throttle area curve" VALUE 0xa002fa4c _REC_S1VAL_20_u2 0.99609375 _CNV_A_R_LINEAR_____31_CM 0. 0.99609375 FORMAT "%10.8" /end CHARACTERISTIC
/begin CHARACTERISTIC Ctx_fac_cor_it_ar_min[13] "Table of gain on reference throttle area curve to define minimum throttle area curve" VALUE 0xa002fa4e _REC_S1VAL_20_u2 0.99609375 _CNV_A_R_LINEAR_____31_CM 0. 0.99609375 FORMAT "%10.8" /end CHARACTERISTIC
/begin CHARACTERISTIC Ctx_fac_cor_it_ar_min[14] "Table of gain on reference throttle area curve to define minimum throttle area curve" VALUE 0xa002fa50 _REC_S1VAL_20_u2 0.99609375 _CNV_A_R_LINEAR_____31_CM 0. 0.99609375 FORMAT "%10.8" /end CHARACTERISTIC
/begin CHARACTERISTIC Ctx_fac_cor_it_ar_min[15] "Table of gain on reference throttle area curve to define minimum throttle area curve" VALUE 0xa002fa52 _REC_S1VAL_20_u2 0.99609375 _CNV_A_R_LINEAR_____31_CM 0. 0.99609375 FORMAT "%10.8" /end CHARACTERISTIC
/begin CHARACTERISTIC Ctx_fac_cor_it_ar_min[16] "Table of gain on reference throttle area curve to define minimum throttle area curve" VALUE 0xa002fa54 _REC_S1VAL_20_u2 0.99609375 _CNV_A_R_LINEAR_____31_CM 0. 0.99609375 FORMAT "%10.8" /end CHARACTERISTIC
/begin CHARACTERISTIC Cxx_adj_fac_it_adj "\"Gradual term\" to compute the corrective vector (< length of throttle table curve)" VALUE 0xa0021d21 _REC_S1VAL_20_u1 254. _CNV_A_R_ECME_LINEA_0_CM 1. 255. FORMAT "%1.0" /end CHARACTERISTIC
/begin CHARACTERISTIC Cxx_amp_upd_t_rst "Timing value after altimetric pressure reactualization to enable \"A.C.T.A\" computing" VALUE 0xa0021cf6 _REC_S1VAL_20_u2 6553.5 _CNV_A_R_LINEAR_____4_CM 0. 6553.5 FORMAT "%6.1" /end CHARACTERISTIC
/begin CHARACTERISTIC Cxx_cor_it_adj_ftc "Filtering factor for raw corrective \"ACTA\" value" VALUE 0xa0021cf8 _REC_S1VAL_20_u2 655.35 _CNV_A_R_LINEAR_____34_CM 0. 655.35 FORMAT "%6.2" /end CHARACTERISTIC
/begin CHARACTERISTIC Cxx_fac_cor_it_adj "Gain value on error between measured and modelised pressure" VALUE 0xa0021cfa _REC_S1VAL_20_u2 0.9999847412109381 _CNV_A_R_LINEAR_____9_CM 0. 0.9999847412109381 FORMAT "%16.12" /end CHARACTERISTIC
/begin CHARACTERISTIC Cxx_map_min_it_adj "Minimum M.A.P value to activate \"A.C.T.A\" computing" VALUE 0xa0021cfc _REC_S1VAL_20_u2 20000. _CNV_A_R_LINEAR_____57_CM 0. 20000. FORMAT "%1.0" /end CHARACTERISTIC
/begin CHARACTERISTIC Cxx_map_rat_max_it_adj "Maximum M.A.P ratio to activate \"A.C.T.A\" computing" VALUE 0xa0021cfe _REC_S1VAL_20_u2 0.9999847412109381 _CNV_A_R_LINEAR_____9_CM 0. 0.9999847412109381 FORMAT "%16.12" /end CHARACTERISTIC
/begin CHARACTERISTIC Cxx_mat_max_it_adj "Threshold max of air temperature for \"A.C.T.A\" computing conditions" VALUE 0xa0021d00 _REC_S1VAL_20_u2 240. _CNV_A_R_LINEAR_____54_CM -40. 200. FORMAT "%5.1" /end CHARACTERISTIC
/begin CHARACTERISTIC Cxx_mat_min_it_adj "Threshold min of air temperature for \"A.C.T.A\" computing conditions" VALUE 0xa0021d02 _REC_S1VAL_20_u2 240. _CNV_A_R_LINEAR_____54_CM -40. 200. FORMAT "%5.1" /end CHARACTERISTIC
/begin CHARACTERISTIC Cxx_min_ar_grd_it_adj "Minimum area between two modified breakpoints in the throttle area curve" VALUE 0xa0021d04 _REC_S1VAL_20_u4 3.90625e-003 _CNV_A_R_LINEAR_____103_CM 0. 3.90625e-003 FORMAT "%16.12" /end CHARACTERISTIC
/begin CHARACTERISTIC Cxx_min_it_ar "Minimum available throttle area" VALUE 0xa0021d08 _REC_S1VAL_20_u4 3.90625e-003 _CNV_A_R_LINEAR_____103_CM 0. 3.90625e-003 FORMAT "%16.12" /end CHARACTERISTIC
/begin CHARACTERISTIC Cxx_n_max_it_adj "Maximum engine speed value to activate \"A.C.T.A\" computing" VALUE 0xa0021d0c _REC_S1VAL_20_u2 16383.75 _CNV_A_R_ENSD_LINEA_24_CM 0. 16383.75 FORMAT "%8.2" /end CHARACTERISTIC
/begin CHARACTERISTIC Cxx_n_min_it_adj "Minimum engine speed value to activate \"A.C.T.A\" computing" VALUE 0xa0021d0e _REC_S1VAL_20_u2 16383.75 _CNV_A_R_ENSD_LINEA_24_CM 0. 16383.75 FORMAT "%8.2" /end CHARACTERISTIC
/begin CHARACTERISTIC Cxx_thd_map_in_it_adj "Threshold min of M.A.P error for \"A.C.T.A\" computing activation" VALUE 0xa0021d10 _REC_S1VAL_20_u2 20000. _CNV_A_R_LINEAR_____57_CM 0. 20000. FORMAT "%1.0" /end CHARACTERISTIC
/begin CHARACTERISTIC Cxx_thd_map_out_it_adj "Threshold max of M.A.P error for \"A.C.T.A\" computing activation" VALUE 0xa0021d12 _REC_S1VAL_20_u2 20000. _CNV_A_R_LINEAR_____57_CM 0. 20000. FORMAT "%1.0" /end CHARACTERISTIC
/begin CHARACTERISTIC Cxx_thd_n_in_it_adj "Threshold min of engine speed error for \"A.C.T.A\" computing activation" VALUE 0xa0021d14 _REC_S1VAL_20_u2 16383.75 _CNV_A_R_ENSD_LINEA_24_CM 0. 16383.75 FORMAT "%8.2" /end CHARACTERISTIC
/begin CHARACTERISTIC Cxx_thd_n_out_it_adj "Threshold max of engine speed error for \"A.C.T.A\" computing activation" VALUE 0xa0021d16 _REC_S1VAL_20_u2 16383.75 _CNV_A_R_ENSD_LINEA_24_CM 0. 16383.75 FORMAT "%8.2" /end CHARACTERISTIC
/begin CHARACTERISTIC Cxx_thd_pos_max_it_adj "Threshold max of throttle position for \"A.C.T.A\" computing activation" VALUE 0xa0021d18 _REC_S1VAL_20_u2 100. _CNV_A_R_LINEAR_____99_CM 0. 100. FORMAT "%4.2" /end CHARACTERISTIC
/begin CHARACTERISTIC Cxx_thd_pos_min_it_adj "Threshold min of throttle position for \"A.C.T.A\" computing activation" VALUE 0xa0021d1a _REC_S1VAL_20_u2 100. _CNV_A_R_LINEAR_____99_CM 0. 100. FORMAT "%4.2" /end CHARACTERISTIC
/begin CHARACTERISTIC Ctp_ctl_lomap_int "Gain of the integrator in function of the engine speed" CURVE 0xa002da90 _REC_A1CUR_20_u2_u2 5.96037352806888 _CNV_A_R_LINEAR_____104_CM 0. 5.96037352806888 FORMAT "%16.12"
 /begin AXIS_DESCR COM_AXIS Vxx_n _CNV_A_R_ENSD_LINEA_24_CM 9 0. 16383.75 FORMAT "%8.2" AXIS_PTS_REF Ctb_n2 /end AXIS_DESCR
/end CHARACTERISTIC
/begin MEASUREMENT Vbx_map_ctl_int_act "Flag of activation condition of the manifold pressure controler" UBYTE _CNV_S_2_RANGE______3_CM 1 0. 0. 1. ECU_ADDRESS 0xd000404e BIT_MASK 0x1 /end MEASUREMENT
/begin MEASUREMENT Vxx_map_ctl_cor_ar "throttle area correction by manifold pressure controler" SWORD _CNV_A_R_LINEAR_____105_CM 1 0. -4.883e-004 4.8822e-004 ECU_ADDRESS 0xd0003140 FORMAT "%12.9" /end MEASUREMENT
/begin MEASUREMENT Vxx_map_ctl_int_fac "Gain of the integrator multiplied by dt" UWORD _CNV_A_R_LINEAR_____106_CM 1 0. 0. 5.96037352806889e-008 ECU_ADDRESS 0xd0003142 FORMAT "%16.12" /end MEASUREMENT
/begin MEASUREMENT Vxx_map_ctl_int_raw "throttle area correction by manifold pressure integrator" SWORD _CNV_A_R_LINEAR_____105_CM 1 0. -4.883e-004 4.8822e-004 ECU_ADDRESS 0xd0003144 FORMAT "%12.9" /end MEASUREMENT
/begin MEASUREMENT Vxx_map_err "Difference between the manifold pressure and the reference manifold pressure" UWORD _CNV_A_R_LINEAR_____107_CM 1 0. -10000. 10000. ECU_ADDRESS 0xd0003146 FORMAT "%6.0" /end MEASUREMENT
/begin CHARACTERISTIC Cbx_map_ctl_int_cfm "Boolean to activate the manifold pressure controler" VALUE 0xa00214bc _REC_S1VAL_20_u1 1. _CNV_S_2_RANGE______3_CM 0. 1. /end CHARACTERISTIC
/begin CHARACTERISTIC Cbx_map_ctl_int_tkof_cfm "Boolean to activate the manifold pressure controler in the take off state" VALUE 0xa00214bd _REC_S1VAL_20_u1 1. _CNV_S_2_RANGE______3_CM 0. 1. /end CHARACTERISTIC
/begin CHARACTERISTIC Cxx_map_ctl_int_ftc_rst "filtering time constant when the controler is disabled" VALUE 0xa00214be _REC_S1VAL_20_u1 2.55 _CNV_A_R_LINEAR_____34_CM 0. 2.55 FORMAT "%4.2" /end CHARACTERISTIC
/begin CHARACTERISTIC Cxx_map_ctl_int_map_thd "Manifold pressure threshold" VALUE 0xa00214ba _REC_S1VAL_20_u2 20000. _CNV_A_R_LINEAR_____57_CM 0. 20000. FORMAT "%5.0" /end CHARACTERISTIC
/begin CHARACTERISTIC Cxx_map_ctl_int_sat_prct_min "Ratio for minimal saturation according to the section throttle applied" VALUE 0xa00214bf _REC_S1VAL_20_u1 0.99609375 _CNV_A_R_LINEAR_____31_CM 0. 0.99609375 FORMAT "%5.3" /end CHARACTERISTIC
/begin MEASUREMENT Vbx_lpg_lpg_mod "Normal LPG/CNG running mode" UBYTE _CNV_S_2_RANGE______3_CM 1 0. 0. 1. ECU_ADDRESS 0xd0004207 BIT_MASK 0x1 /end MEASUREMENT
/begin MEASUREMENT Vbx_lpg_rich_cl_cdn "Indicates that the lambda closed loop condition in LPG mode is verified." UBYTE _CNV_S_2_RANGE______3_CM 1 0. 0. 1. ECU_ADDRESS 0xd0005616 BIT_MASK 0x1 /end MEASUREMENT
/begin MEASUREMENT Vsx_wup_fuel_typ "Determinate the warm up zone" UBYTE _CNV_A_R_ECME_LINEA_0_CM 1 0. 0. 255. ECU_ADDRESS 0xd0005617 FORMAT "%3.0" /end MEASUREMENT
/begin MEASUREMENT Vxx_iga_fuel_typ_rat "Corrective factor depending on \"exotic fuel\" quantity. For ignition-linked phenomena." UWORD _CNV_A_R_LINEAR_____108_CM 1 0. 0. 1. ECU_ADDRESS 0xd0005b42 FORMAT "%5.3" /end MEASUREMENT
/begin MEASUREMENT Vxx_polu_fuel_typ_rat "Ratio dedicated to the pollution adjustment" UWORD _CNV_A_R_LINEAR_____108_CM 1 0. 0. 1. ECU_ADDRESS 0xd0005b44 /end MEASUREMENT
/begin MEASUREMENT Vxx_sta_fuel_typ_rat "Ratio dedicated to the start adjustment" UWORD _CNV_A_R_LINEAR_____108_CM 1 0. 0. 1. ECU_ADDRESS 0xd0005b46 /end MEASUREMENT
/begin MEASUREMENT Vxx_ti_fuel_typ_rat "Ratio dedicated to the time injection and stochiometry adjustment" UWORD _CNV_A_R_LINEAR_____108_CM 1 0. 0. 1. ECU_ADDRESS 0xd0003598 FORMAT "%5.3" /end MEASUREMENT
/begin MEASUREMENT Vxx_tq_fuel_typ_rat "Ratio dedicated to the torque management adjustment" UWORD _CNV_A_R_LINEAR_____108_CM 1 0. 0. 1. ECU_ADDRESS 0xd0005b48 /end MEASUREMENT
/begin MEASUREMENT Vxx_wet_fuel_typ_rat "Ratio dedicated to the welling correction adjustment" UWORD _CNV_A_R_LINEAR_____108_CM 1 0. 0. 1. ECU_ADDRESS 0xd0005b4a /end MEASUREMENT
/begin MEASUREMENT Vxx_wup_fuel_typ_rat "Ratio dedicated to the warm up adjustment according to fuel type" UWORD _CNV_A_R_LINEAR_____108_CM 1 0. 0. 1. ECU_ADDRESS 0xd0005b4c /end MEASUREMENT
/begin CHARACTERISTIC Cbx_lpg_lpg_mod "Calibrated value for \"Normal LPG/CNG running mode\"." VALUE 0xa0021384 _REC_S1VAL_20_u1 1. _CNV_S_2_RANGE______3_CM 0. 1. BIT_MASK 0x1 /end CHARACTERISTIC
/begin CHARACTERISTIC Cbx_lpg_rich_cl_cdn "Calibrated value for \"Indicates that the lambda closed loop condition in LPG mode is verified.\"." VALUE 0xa0021385 _REC_S1VAL_20_u1 1. _CNV_S_2_RANGE______3_CM 0. 1. BIT_MASK 0x1 /end CHARACTERISTIC
/begin CHARACTERISTIC Cxx_iga_fuel_typ_rat "Calibrated value for \"Corrective factor depending on \"exotic fuel\" quantity. For ignition-linked phenomena\"." VALUE 0xa0021376 _REC_S1VAL_20_u2 1. _CNV_A_R_LINEAR_____108_CM 0. 1. FORMAT "%5.3" /end CHARACTERISTIC
/begin CHARACTERISTIC Cxx_polu_fuel_typ_rat "Calibrated value for \"Corrective factor depending on \"exotic fuel\" quantity. For ignition-linked phenomena\"." VALUE 0xa0021378 _REC_S1VAL_20_u2 1. _CNV_A_R_LINEAR_____108_CM 0. 1. /end CHARACTERISTIC
/begin CHARACTERISTIC Cxx_sta_fuel_typ_rat "Calibrated dedicated to the start adjustment" VALUE 0xa002137a _REC_S1VAL_20_u2 1. _CNV_A_R_LINEAR_____108_CM 0. 1. /end CHARACTERISTIC
/begin CHARACTERISTIC Cxx_ti_fuel_typ_rat "Calibration dedicated to the time injection and stochiometry adjustment" VALUE 0xa002137c _REC_S1VAL_20_u2 1. _CNV_A_R_LINEAR_____108_CM 0. 1. FORMAT "%5.3" /end CHARACTERISTIC
/begin CHARACTERISTIC Cxx_tq_fuel_typ_rat "Calibrated dedicated to the torque mangement adjustment" VALUE 0xa002137e _REC_S1VAL_20_u2 1. _CNV_A_R_LINEAR_____108_CM 0. 1. /end CHARACTERISTIC
/begin CHARACTERISTIC Cxx_wet_fuel_typ_rat "Calibrated dedicated to the torque mangement adjustment" VALUE 0xa0021380 _REC_S1VAL_20_u2 1. _CNV_A_R_LINEAR_____108_CM 0. 1. /end CHARACTERISTIC
/begin CHARACTERISTIC Cxx_wup_fuel_typ "Calibration determinating the warm up zone" VALUE 0xa0021386 _REC_S1VAL_20_u1 255. _CNV_A_R_ECME_LINEA_0_CM 0. 255. FORMAT "%3.0" /end CHARACTERISTIC
/begin CHARACTERISTIC Cxx_wup_fuel_typ_rat "Calibrated dedicated to the warm up adjustment" VALUE 0xa0021382 _REC_S1VAL_20_u2 1. _CNV_A_R_LINEAR_____108_CM 0. 1. /end CHARACTERISTIC
/begin MEASUREMENT Sxx_spg_ad_pwm_NVM "Slow adaptive term of the wastegate control" SWORD _CNV_A_R_LINEAR_____117_CM 1 0. -50. 49.9984741210938 DISPLAY_IDENTIFIER AsBstCtl_NVM.Sxx_spg_ad_pwm_NVM ECU_ADDRESS 0xd0005942 FORMAT "%7.3" /end MEASUREMENT
/begin AXIS_PTS Ctb_eal "16 breakpoint table for Engine air load" 0xa002a6fc Vxx_eal _REC_A2AXS_20_u2 3.99993896484375 _CNV_A_R_LINEAR_____53_CM 16 0. 3.99993896484375 FORMAT "%10.8" /end AXIS_PTS
/begin AXIS_PTS Ctp_it_ar_psn "Throttle position setpoint depending on effective area." 0xa002ac7c Vxx_mv_it_rel_psn _REC_A2AXS_20_u2 100. _CNV_A_R_LINEAR_____99_CM 17 0. 100. FORMAT "%6.2" /end AXIS_PTS
/begin AXIS_PTS Ctb_tco "16 engine coolant temperature breakpoints" 0xa002dff8 Vxx_tco _REC_A2AXS_20_u2 240. _CNV_A_R_LINEAR_____54_CM 16 -40. 200. FORMAT "%5.1" /end AXIS_PTS
/begin AXIS_PTS Ctb_tco2 "Engine coolant temperature breakpoints" 0xa002e01c Vxx_tco _REC_A2AXS_20_u2 240. _CNV_A_R_LINEAR_____54_CM 9 -40. 200. FORMAT "%5.1" /end AXIS_PTS
/begin AXIS_PTS Ctb_n "20 programmable engine speed breakpoints map" 0xa00250e0 Vxx_n _REC_A2AXS_20_u2 16383.75 _CNV_A_R_ENSD_LINEA_24_CM 20 0. 16383.75 FORMAT "%8.2" /end AXIS_PTS
/begin AXIS_PTS Ctb_n2 "9 programmable engine speed breakpoints table" 0xa002510c Vxx_n _REC_A2AXS_20_u2 16383.75 _CNV_A_R_ENSD_LINEA_24_CM 9 0. 16383.75 FORMAT "%8.2" /end AXIS_PTS
/begin MEASUREMENT Vbx_cp_ad_ena "Adaptive canister purge authorized" UBYTE _CNV_S_2_RANGE______3_CM 1 0. 0. 1. ECU_ADDRESS 0xd0004f5c BIT_MASK 0x1 /end MEASUREMENT
/begin MEASUREMENT Vbx_cp_is_ena "Idle speed canister purge condition" UBYTE _CNV_S_2_RANGE______3_CM 1 0. 0. 1. ECU_ADDRESS 0xd0004f5d BIT_MASK 0x1 /end MEASUREMENT
/begin MEASUREMENT Vbx_cp_lsm_ad_ena "Adaptive less square enable" UBYTE _CNV_S_2_RANGE______3_CM 1 0. 0. 1. ECU_ADDRESS 0xd0004f5e BIT_MASK 0x1 /end MEASUREMENT
/begin MEASUREMENT Vbx_cp_rich_cge "Engine richness is perturbted by the canister purge" UBYTE _CNV_S_2_RANGE______3_CM 1 0. 0. 1. ECU_ADDRESS 0xd0004f5f BIT_MASK 0x1 /end MEASUREMENT
/begin MEASUREMENT Vbx_prev_cp "Last canister purge functioning" UBYTE _CNV_S_2_RANGE______3_CM 1 0. 0. 1. ECU_ADDRESS 0xd0004f60 BIT_MASK 0x1 /end MEASUREMENT
/begin MEASUREMENT Vxx_cp_egr_sta_dly "Delay - Canister purge" UWORD _CNV_A_R_LINEAR_____34_CM 1 0. 0. 655.35 ECU_ADDRESS 0xc0000c14 FORMAT "%6.2" /end MEASUREMENT
/begin MEASUREMENT Vxx_cp_egr_stop_dly "Delay - Canister purge" UWORD _CNV_A_R_LINEAR_____34_CM 1 0. 0. 655.35 ECU_ADDRESS 0xc0000c16 FORMAT "%6.2" /end MEASUREMENT
/begin CHARACTERISTIC Cxx_cp_lamb_fac_mv_thd_1 "Mini threshold to authorize the functioning of the canister purge" VALUE 0xa0020b9a _REC_S1VAL_20_u2 0.6666666000000001 _CNV_A_R_LINEAR_____327_CM 0.6666667 1.3333333 FORMAT "%10.8" /end CHARACTERISTIC
/begin CHARACTERISTIC Cxx_cp_lamb_fac_mv_thd_2 "Maxi threshold to authorize the functioning of the canister purge" VALUE 0xa0020b9c _REC_S1VAL_20_u2 0.6666666000000001 _CNV_A_R_LINEAR_____327_CM 0.6666667 1.3333333 FORMAT "%10.8" /end CHARACTERISTIC
/begin CHARACTERISTIC Cxx_cp_t_off "Canister purge begin functioning duration" VALUE 0xa0020b9e _REC_S1VAL_20_u2 655.35 _CNV_A_R_LINEAR_____34_CM 0. 655.35 FORMAT "%6.2" /end CHARACTERISTIC
/begin CHARACTERISTIC Cxx_cp_t_on "Canister purge end functioning duration" VALUE 0xa0020ba0 _REC_S1VAL_20_u2 655.35 _CNV_A_R_LINEAR_____34_CM 0. 655.35 FORMAT "%6.2" /end CHARACTERISTIC
/begin AXIS_PTS Ctb_n_cp "Filtering factor table for canister charge correction applied" 0xa00269f4 Vxx_n _REC_A2AXS_20_u2 16383.75 _CNV_A_R_ENSD_LINEA_24_CM 9 0. 16383.75 FORMAT "%8.2" /end AXIS_PTS
/begin CHARACTERISTIC Ctp_n_cp "Filtering factor breakpoints for canister charge correction applied" CURVE 0xa0026a08 _REC_A1CUR_20_u1_u2 1. _CNV_A_R_LINEAR_____328_CM 0. 1. FORMAT "%9.7"
 /begin AXIS_DESCR COM_AXIS Vxx_n _CNV_A_R_ENSD_LINEA_24_CM 9 0. 16383.75 FORMAT "%8.2" AXIS_PTS_REF Ctb_n_cp /end AXIS_DESCR
/end CHARACTERISTIC
/begin MEASUREMENT Vbx_cp_ad "Canister charge is currently learned" UBYTE _CNV_S_2_RANGE______3_CM 1 0. 0. 1. ECU_ADDRESS 0xd0003def BIT_MASK 0x1 /end MEASUREMENT
/begin MEASUREMENT Vbx_cp_rich_cor_lean_cond "Lean condition for the richness correction" UBYTE _CNV_S_2_RANGE______3_CM 1 0. 0. 1. ECU_ADDRESS 0xd0003df0 BIT_MASK 0x1 /end MEASUREMENT
/begin MEASUREMENT Vbx_cp_rich_cor_rich_cond "Rich condition for the richness correction" UBYTE _CNV_S_2_RANGE______3_CM 1 0. 0. 1. ECU_ADDRESS 0xd0003df1 BIT_MASK 0x1 /end MEASUREMENT
/begin MEASUREMENT Vxx_cp_fim_fac "Corrective factor depending on \"exotic fuel\" quantity. For ignition-linked phenomena." UBYTE _CNV_A_R_LINEAR_____43_CM 1 0. 0. 1.9921875 ECU_ADDRESS 0xd00057a4 FORMAT "%8.6" /end MEASUREMENT
/begin MEASUREMENT Vxx_cp_mv_cl_ti_fac "Mean value of the multiplicative factor from richness closed loop applied on injcted fuel mas quantity" UWORD _CNV_A_R_LINEAR_____65_CM 1 0. 0.6666666 1.33332309414063 ECU_ADDRESS 0xd0005b18 FORMAT "%8.7" /end MEASUREMENT
/begin MEASUREMENT Vxx_cp_rich_cor "Canister charge" UWORD _CNV_A_R_LINEAR_____63_CM 1 0. 0. 0.666656494140625 ECU_ADDRESS 0xd0005b1a FORMAT "%8.7" /end MEASUREMENT
/begin MEASUREMENT Vxx_cp_rich_cor_appl "Canister charge correction applied" UBYTE _CNV_A_R_LINEAR_____240_CM 1 0. 0.501953125 1. ECU_ADDRESS 0xd00057a5 FORMAT "%11.9" /end MEASUREMENT
/begin MEASUREMENT Vxx_cp_rich_cor_clc "Canister charge correction" UBYTE _CNV_A_R_LINEAR_____118_CM 1 0. 0. 1. ECU_ADDRESS 0xd00057a6 FORMAT "%9.7" /end MEASUREMENT
/begin MEASUREMENT Vxx_cp_rich_int_cor "Integral factor to be applied on Vxx_cl_ti_fac in canister charge learning conditions" UBYTE _CNV_A_R_LINEAR_____63_CM 1 0. 0. 2.593994140625e-003 ECU_ADDRESS 0xd0003df2 FORMAT "%10.8" /end MEASUREMENT
/begin CHARACTERISTIC Cxx_cp_fac_rel "Format factor of the canister charge" VALUE 0xa002103e _REC_S1VAL_20_u2 1. _CNV_A_R_LINEAR_____93_CM 0. 1. FORMAT "%11.9" /end CHARACTERISTIC
/begin CHARACTERISTIC Cxx_cp_fil_cl_ti_fac "Filtering coefficient for the close loop in order to learn the canister load" VALUE 0xa0021040 _REC_S1VAL_20_u2 1. _CNV_A_R_LINEAR_____93_CM 0. 1. FORMAT "%11.9" /end CHARACTERISTIC
/begin CHARACTERISTIC Cxx_cp_grd_fac "Factor for the calculation of the canister charge integration" VALUE 0xa0021042 _REC_S1VAL_20_u2 6.5535e-007 _CNV_A_R_LINEAR_____329_CM 0. 6.5535e-007 FORMAT "%13.11" /end CHARACTERISTIC
/begin CHARACTERISTIC Cxx_cp_inc_ad "Incrementation of the canister charge in case of open loop" VALUE 0xa0021044 _REC_S1VAL_20_u2 1. _CNV_A_R_LINEAR_____93_CM 0. 1. FORMAT "%11.9" /end CHARACTERISTIC
/begin CHARACTERISTIC Cxx_cp_max_ad "Maximum value of the canister charge correction" VALUE 0xa0021046 _REC_S1VAL_20_u2 1. _CNV_A_R_LINEAR_____93_CM 0. 1. FORMAT "%11.9" /end CHARACTERISTIC
/begin CHARACTERISTIC Cxx_cp_ol_rich_cor_appl "Canister charge correction applied in case of open loop phase for canister purge" VALUE 0xa002104c _REC_S1VAL_20_u1 0.498046875 _CNV_A_R_LINEAR_____240_CM 0.501953125 1. FORMAT "%11.9" /end CHARACTERISTIC
/begin CHARACTERISTIC Cxx_cp_rel_step_lamb_fac "The close loop corrective must be centred when the canister purge is closed" VALUE 0xa0021048 _REC_S1VAL_20_u2 0.666656494140625 _CNV_A_R_LINEAR_____63_CM 0. 0.666656494140625 FORMAT "%8.7" /end CHARACTERISTIC
/begin CHARACTERISTIC Cxx_cp_step_lamb_fac "The close loop corrective must be centred when the canister purge is closed" VALUE 0xa002104a _REC_S1VAL_20_s2 1.333309575 _CNV_A_R_LINEAR_____86_CM -0.66666496 0.6666446150000001 FORMAT "%7.5" /end CHARACTERISTIC
/begin MEASUREMENT Vsx_ti_alco_cor_vld "Final alcohol adaptive validity status" UBYTE _CNV_S_4_STATUS_OK__121_CM 1 0. 0. 3. ECU_ADDRESS 0xd00055ad /end MEASUREMENT
/begin MEASUREMENT Vbx_alco_typ_cfm "Flex Fuel configuration" UBYTE _CNV_S_2_RANGE______3_CM 1 0. 0. 1. ECU_ADDRESS 0xd00051c3 BIT_MASK 0x1 /end MEASUREMENT
/begin CHARACTERISTIC Cbx_alco_typ_cfm "Choice of Flex Fuel configuration" VALUE 0xa0020fe3 _REC_S1VAL_20_u1 1. _CNV_A_R_ECME_LINEA_0_CM 0. 1. FORMAT "%1.0" BIT_MASK 0x1 /end CHARACTERISTIC
/begin COMPU_METHOD _CNV_A_R_ECME_LINEA_0_CM "" RAT_FUNC "%6.3" "-" COEFFS 0 1. 0. 0 0 1 /end COMPU_METHOD
/begin COMPU_METHOD _CNV_A_R_LINEAR_____2_CM "" RAT_FUNC "%6.3" "rpm" COEFFS 0 3.125e-002 0. 0 0 1 /end COMPU_METHOD
/begin COMPU_METHOD _CNV_S_2_RANGE______3_CM "" TAB_VERB "%6.3" "-" COMPU_TAB_REF _CNV_S_2_RANGE______3 /end COMPU_METHOD
/begin COMPU_VTAB _CNV_S_2_RANGE______3 "" TAB_VERB 2 0 "0" 1 "1" /end COMPU_VTAB
/begin COMPU_METHOD _CNV_A_R_LINEAR_____4_CM "" RAT_FUNC "%6.3" "s" COEFFS 0 10. 0. 0 0 1 /end COMPU_METHOD
/begin COMPU_METHOD _CNV_A_R_CPULOAD__0_7_CM "" RAT_FUNC "%6.3" "%" COEFFS 0 10.24 0. 0 0 1 /end COMPU_METHOD
/begin COMPU_METHOD _CNV_A_R_LINEAR_____9_CM "" RAT_FUNC "%6.3" "-" COEFFS 0 65535.99999999996 0. 0 0 1 /end COMPU_METHOD
/begin COMPU_METHOD _CNV_A_R_ENSD_LINEA_24_CM "" RAT_FUNC "%6.3" "rpm" COEFFS 0 4. 0. 0 0 1 /end COMPU_METHOD
/begin COMPU_METHOD _CNV_A_R_LINEAR_____31_CM "" RAT_FUNC "%6.3" "-" COEFFS 0 256. 0. 0 0 1 /end COMPU_METHOD
/begin COMPU_METHOD _CNV_A_R_LINEAR_____34_CM "" RAT_FUNC "%6.3" "s" COEFFS 0 100. 0. 0 0 1 /end COMPU_METHOD
/begin COMPU_METHOD _CNV_A_R_LINEAR_____43_CM "" RAT_FUNC "%6.3" "-" COEFFS 0 128. 0. 0 0 1 /end COMPU_METHOD
/begin COMPU_METHOD _CNV_A_R_LINEAR_____50_CM "" RAT_FUNC "%6.3" "µs" COEFFS 0 0.25 0. 0 0 1 /end COMPU_METHOD
/begin COMPU_METHOD _CNV_A_R_LINEAR_____51_CM "" RAT_FUNC "%6.3" "[-]" COEFFS 0 384. -256.0000128 0 0 1 /end COMPU_METHOD
/begin COMPU_METHOD _CNV_A_R_LINEAR_____52_CM "" RAT_FUNC "%6.3" "mV" COEFFS 0 1. 0. 0 0 1 /end COMPU_METHOD
/begin COMPU_METHOD _CNV_A_R_LINEAR_____53_CM "" RAT_FUNC "%6.3" "-" COEFFS 0 16384. 0. 0 0 1 /end COMPU_METHOD
/begin COMPU_METHOD _CNV_A_R_LINEAR_____54_CM "" RAT_FUNC "%6.3" "∞C" COEFFS 0 10. 400. 0 0 1 /end COMPU_METHOD
/begin COMPU_METHOD _CNV_A_R_LINEAR_____55_CM "" RAT_FUNC "%6.3" "TDC" COEFFS 0 1. 0. 0 0 1 /end COMPU_METHOD
/begin COMPU_METHOD _CNV_A_R_LINEAR_____56_CM "" RAT_FUNC "%6.3" "-" COEFFS 0 98304.00002810937 7.275957614183426e-012 0 0 1 /end COMPU_METHOD
/begin COMPU_METHOD _CNV_A_R_LINEAR_____57_CM "" RAT_FUNC "%6.3" "hPa" COEFFS 0 1. 0. 0 0 1 /end COMPU_METHOD
/begin COMPU_METHOD _CNV_A_R_LINEAR_____58_CM "" RAT_FUNC "%6.3" "s" COEFFS 0 1000. 0. 0 0 1 /end COMPU_METHOD
/begin COMPU_METHOD _CNV_A_R_LINEAR_____59_CM "" RAT_FUNC "%6.3" "-" COEFFS 0 256000000. 0. 0 0 1 /end COMPU_METHOD
/begin COMPU_METHOD _CNV_A_R_LINEAR_____60_CM "" RAT_FUNC "%6.3" "-" COEFFS 0 853333.3333333334 0. 0 0 1 /end COMPU_METHOD
/begin COMPU_METHOD _CNV_A_R_LINEAR_____61_CM "" RAT_FUNC "%6.3" "-" COEFFS 0 98304.00002810937 32768.00000000001 0 0 1 /end COMPU_METHOD
/begin COMPU_METHOD _CNV_A_R_LINEAR_____62_CM "" RAT_FUNC "%6.3" "-" COEFFS 0 768. 0. 0 0 1 /end COMPU_METHOD
/begin COMPU_METHOD _CNV_A_R_LINEAR_____63_CM "" RAT_FUNC "%6.3" "-" COEFFS 0 98304. 0. 0 0 1 /end COMPU_METHOD
/begin COMPU_METHOD _CNV_S_14_RANGE_STAT_64_CM "" TAB_VERB "%6.3" "" COMPU_TAB_REF _CNV_S_14_RANGE_STAT_64 /end COMPU_METHOD
/begin COMPU_VTAB _CNV_S_14_RANGE_STAT_64 "" TAB_VERB 14 0 "CL_CATA_DIAG" 1 "CL_INI" 2 "CL_LEAN" 4 "CL_LEAN_INI" 8 "CL_LEAN_LEAN" 16 "CL_LEAN_LEAN_SLOP" 32 "CL_LEAN_RICH" 64 "CL_LEAN_RICH_SLOP" 128 "CL_LEAN_SLOP" 256 "CL_OFF" 512 "CL_RICH" 1024 "CL_RICH_SLOP" 2048 "CL_BAR_LEAN" 4096 "CL_BAR_RICH" /end COMPU_VTAB
/begin COMPU_METHOD _CNV_A_R_LINEAR_____65_CM "" RAT_FUNC "%6.3" "-" COEFFS 0 98303.99999999926 -65535.99344639951 0 0 1 /end COMPU_METHOD
/begin COMPU_METHOD _CNV_A_R_LINEAR_____66_CM "" RAT_FUNC "%6.3" "-" COEFFS 0 384.0000000001926 -5.684341886080802e-014 0 0 1 /end COMPU_METHOD
/begin COMPU_METHOD _CNV_A_R_LINEAR_____67_CM "" RAT_FUNC "%6.3" "-" COEFFS 0 384. 0. 0 0 1 /end COMPU_METHOD
/begin COMPU_METHOD _CNV_A_R_LINEAR_____68_CM "" RAT_FUNC "%6.3" "-" COEFFS 0 32. -32. 0 0 1 /end COMPU_METHOD
/begin COMPU_METHOD _CNV_A_R_LINEAR_____69_CM "" RAT_FUNC "%6.3" "min/rev" COEFFS 0 50331647.99960405 0. 0 0 1 /end COMPU_METHOD
/begin COMPU_METHOD _CNV_A_R_LINEAR_____70_CM "" RAT_FUNC "%6.3" "km/h" COEFFS 0 100. 0. 0 0 1 /end COMPU_METHOD
/begin COMPU_METHOD _CNV_A_R_LINEAR_____71_CM "" RAT_FUNC "%6.3" "-" COEFFS 0 192. 0. 0 0 1 /end COMPU_METHOD
/begin COMPU_METHOD _CNV_A_R_LINEAR_____72_CM "" RAT_FUNC "%6.3" "1/∞CRK" COEFFS 0 16384. 0. 0 0 1 /end COMPU_METHOD
/begin COMPU_METHOD _CNV_S_5_RANGE_RICH_73_CM "" TAB_VERB "%6.3" "" COMPU_TAB_REF _CNV_S_5_RANGE_RICH_73 /end COMPU_METHOD
/begin COMPU_VTAB _CNV_S_5_RANGE_RICH_73 "" TAB_VERB 5 1 "STARTING" 2 "OPEN LOOP" 4 "FULL LOAD" 8 "BEFORE CLOSED LOOP" 16 "CLOSED LOOP" /end COMPU_VTAB
/begin COMPU_METHOD _CNV_A_R_LINEAR_____74_CM "" RAT_FUNC "%6.3" "-" COEFFS 0 192. -127.9999872 0 0 1 /end COMPU_METHOD
/begin COMPU_METHOD _CNV_A_R_LINEAR_____75_CM "" RAT_FUNC "%6.3" "mg/stk" COEFFS 0 6.103515625 0. 0 0 1 /end COMPU_METHOD
/begin COMPU_METHOD _CNV_A_R_LINEAR_____76_CM "" RAT_FUNC "%6.3" "∞CRK" COEFFS 0 50. 0. 0 0 1 /end COMPU_METHOD
/begin COMPU_METHOD _CNV_A_R_LINEAR_____77_CM "" RAT_FUNC "%6.3" "%" COEFFS 0 0.1 0. 0 0 1 /end COMPU_METHOD
/begin COMPU_METHOD _CNV_A_R_LINEAR_____78_CM "" RAT_FUNC "%6.3" "-" COEFFS 0 2560. 0. 0 0 1 /end COMPU_METHOD
/begin COMPU_METHOD _CNV_A_R_LINEAR_____79_CM "" RAT_FUNC "%6.3" "-" COEFFS 0 500. 0. 0 0 1 /end COMPU_METHOD
/begin COMPU_METHOD _CNV_A_R_LINEAR_____80_CM "" RAT_FUNC "%6.3" "-" COEFFS 0 499.9999999999999 0. 0 0 1 /end COMPU_METHOD
/begin COMPU_METHOD _CNV_A_R_LINEAR_____81_CM "" RAT_FUNC "%6.3" "mg" COEFFS 0 10. 0. 0 0 1 /end COMPU_METHOD
/begin COMPU_METHOD _CNV_A_R_LINEAR_____82_CM "" RAT_FUNC "%6.3" "s" COEFFS 0 1. 0. 0 0 1 /end COMPU_METHOD
/begin COMPU_METHOD _CNV_A_R_LINEAR_____83_CM "" RAT_FUNC "%6.3" "mg/stk" COEFFS 0 390.625 0. 0 0 1 /end COMPU_METHOD
/begin COMPU_METHOD _CNV_A_R_LINEAR_____84_CM "" RAT_FUNC "%6.3" "mg" COEFFS 0 7.281777777776513 0. 0 0 1 /end COMPU_METHOD
/begin COMPU_METHOD _CNV_A_R_LINEAR_____85_CM "" RAT_FUNC "%6.3" "mg/stk" COEFFS 0 390.6250098679799 1.820735633373261e-007 0 0 1 /end COMPU_METHOD
/begin COMPU_METHOD _CNV_A_R_LINEAR_____86_CM "" RAT_FUNC "%6.3" "[-]" COEFFS 0 49152.12582944213 0. 0 0 1 /end COMPU_METHOD
/begin COMPU_METHOD _CNV_A_R_LINEAR_____87_CM "" RAT_FUNC "%6.3" "µs" COEFFS 0 8. 0. 0 0 1 /end COMPU_METHOD
/begin COMPU_METHOD _CNV_A_R_LINEAR_____88_CM "" RAT_FUNC "%6.3" "1/µs" COEFFS 0 512. 0. 0 0 1 /end COMPU_METHOD
/begin COMPU_METHOD _CNV_A_R_LINEAR_____89_CM "" RAT_FUNC "%6.3" "1/∞CRK" COEFFS 0 8533.333333333332 0. 0 0 1 /end COMPU_METHOD
/begin COMPU_METHOD _CNV_A_R_LINEAR_____90_CM "" RAT_FUNC "%6.3" "s" COEFFS 0 3276.75 0. 0 0 1 /end COMPU_METHOD
/begin COMPU_METHOD _CNV_A_R_LINEAR_____91_CM "" RAT_FUNC "%6.3" "s/m.K^0.5" COEFFS 0 1048576.005464147 0. 0 0 1 /end COMPU_METHOD
/begin COMPU_METHOD _CNV_A_R_LINEAR_____92_CM "" RAT_FUNC "%6.3" "kg/h/m≤" COEFFS 0 3.555555555555556e-002 0. 0 0 1 /end COMPU_METHOD
/begin COMPU_METHOD _CNV_A_R_LINEAR_____93_CM "" RAT_FUNC "%6.3" "-" COEFFS 0 65535. 0. 0 0 1 /end COMPU_METHOD
/begin COMPU_METHOD _CNV_A_R_LINEAR_____94_CM "" RAT_FUNC "%6.3" "%" COEFFS 0 100. 0. 0 0 1 /end COMPU_METHOD
/begin COMPU_METHOD _CNV_A_R_LINEAR_____95_CM "" RAT_FUNC "%6.3" "m≤" COEFFS 0 16777217.69806384 0. 0 0 1 /end COMPU_METHOD
/begin COMPU_METHOD _CNV_A_R_LINEAR_____96_CM "" RAT_FUNC "%6.3" "-" COEFFS 0 32768.0000069121 0. 0 0 1 /end COMPU_METHOD
/begin COMPU_METHOD _CNV_A_R_LINEAR_____97_CM "" RAT_FUNC "%6.3" "m≤" COEFFS 0 16777216.00000002 0. 0 0 1 /end COMPU_METHOD
/begin COMPU_METHOD _CNV_A_R_LINEAR_____98_CM "" RAT_FUNC "%6.3" "-" COEFFS 0 2048. 0. 0 0 1 /end COMPU_METHOD
/begin COMPU_METHOD _CNV_A_R_LINEAR_____99_CM "" RAT_FUNC "%6.3" "%" COEFFS 0 20. 0. 0 0 1 /end COMPU_METHOD
/begin COMPU_METHOD _CNV_A_R_LINEAR_____100_CM "" RAT_FUNC "%6.3" "-" COEFFS 0 327680.0003968061 -294912.0003571255 0 0 1 /end COMPU_METHOD
/begin COMPU_METHOD _CNV_A_R_LINEAR_____101_CM "" RAT_FUNC "%6.3" "-" COEFFS 0 327680. 32768. 0 0 1 /end COMPU_METHOD
/begin COMPU_METHOD _CNV_A_R_LINEAR_____102_CM "" RAT_FUNC "%6.3" "-" COEFFS 0 256. -256. 0 0 1 /end COMPU_METHOD
/begin COMPU_METHOD _CNV_A_R_LINEAR_____103_CM "" RAT_FUNC "%6.3" "m≤" COEFFS 0 16777216. 0. 0 0 1 /end COMPU_METHOD
/begin COMPU_METHOD _CNV_A_R_LINEAR_____104_CM "" RAT_FUNC "%6.3" "[mm2/hPa/s]" COEFFS 0 10995.11627776001 0. 0 0 1 /end COMPU_METHOD
/begin COMPU_METHOD _CNV_A_R_LINEAR_____105_CM "" RAT_FUNC "%6.3" "m≤" COEFFS 0 16777216.00000002 3.456079866737127e-011 0 0 1 /end COMPU_METHOD
/begin COMPU_METHOD _CNV_A_R_LINEAR_____106_CM "" RAT_FUNC "%6.3" "[m2/hPa]" COEFFS 0 1099511627775.999 0. 0 0 1 /end COMPU_METHOD
/begin COMPU_METHOD _CNV_A_R_LINEAR_____107_CM "" RAT_FUNC "%6.3" "hPa" COEFFS 0 1. 10000. 0 0 1 /end COMPU_METHOD
/begin COMPU_METHOD _CNV_A_R_LINEAR_____108_CM "" RAT_FUNC "%6.3" "-" COEFFS 0 1000. 0. 0 0 1 /end COMPU_METHOD
/begin COMPU_METHOD _CNV_A_R_LINEAR_____117_CM "" RAT_FUNC "%6.3" "%" COEFFS 0 655.3599999999997 -1.455191522836685e-011 0 0 1 /end COMPU_METHOD
/begin COMPU_METHOD _CNV_A_R_LINEAR_____118_CM "" RAT_FUNC "%6.3" "-" COEFFS 0 255. 0. 0 0 1 /end COMPU_METHOD
/begin COMPU_METHOD _CNV_S_4_STATUS_OK__121_CM "" TAB_VERB "%6.3" "-" COMPU_TAB_REF _CNV_S_4_STATUS_OK__121 /end COMPU_METHOD
/begin COMPU_VTAB _CNV_S_4_STATUS_OK__121 "" TAB_VERB 4 0 "Nsx_vld_nok_0" 1 "Nsx_vld_ok_1" 2 "Nsx_vld_fail_2" 3 "Nsx_vld_fail_3" /end COMPU_VTAB
/begin COMPU_METHOD _CNV_A_R_LINEAR_____240_CM "" RAT_FUNC "%6.3" "-" COEFFS 0 512. -257. 0 0 1 /end COMPU_METHOD
/begin COMPU_METHOD _CNV_A_R_LINEAR_____327_CM "" RAT_FUNC "%6.3" "-" COEFFS 0 98302.50983025097 -65535.00983025097 0 0 1 /end COMPU_METHOD
/begin COMPU_METHOD _CNV_A_R_LINEAR_____328_CM "" RAT_FUNC "%6.3" "s" COEFFS 0 255. 0. 0 0 1 /end COMPU_METHOD
/begin COMPU_METHOD _CNV_A_R_LINEAR_____329_CM "" RAT_FUNC "%6.3" "1/rpm" COEFFS 0 100000000000. 0. 0 0 1 /end COMPU_METHOD
/begin RECORD_LAYOUT _REC_S1VAL_20_u4 FNC_VALUES 1 ULONG COLUMN_DIR DIRECT /end RECORD_LAYOUT
/begin RECORD_LAYOUT _REC_S1VAL_20_u1 FNC_VALUES 1 UBYTE COLUMN_DIR DIRECT /end RECORD_LAYOUT
/begin RECORD_LAYOUT _REC_S1VAL_20_u2 FNC_VALUES 1 UWORD COLUMN_DIR DIRECT /end RECORD_LAYOUT
/begin RECORD_LAYOUT _REC_S1VAL_20_s2 FNC_VALUES 1 SWORD COLUMN_DIR DIRECT /end RECORD_LAYOUT
/begin RECORD_LAYOUT _REC_A2AXS_20_u2 NO_AXIS_PTS_X 1 UWORD AXIS_PTS_X 2 UWORD INDEX_INCR DIRECT /end RECORD_LAYOUT
/begin RECORD_LAYOUT _REC_A1CUR_20_u1_u2 FNC_VALUES 1 UBYTE COLUMN_DIR DIRECT /end RECORD_LAYOUT
/begin RECORD_LAYOUT _REC_A1MAP_20_u2_u2_u2 FNC_VALUES 1 UWORD COLUMN_DIR DIRECT /end RECORD_LAYOUT
/begin RECORD_LAYOUT _REC_A1CUR_20_u2_u2 FNC_VALUES 1 UWORD COLUMN_DIR DIRECT /end RECORD_LAYOUT
/begin RECORD_LAYOUT _REC_A1MAP_20_u1_u2_u2 FNC_VALUES 1 UBYTE COLUMN_DIR DIRECT /end RECORD_LAYOUT
/begin RECORD_LAYOUT _REC_S1VAL_20_s4 FNC_VALUES 1 SLONG COLUMN_DIR DIRECT /end RECORD_LAYOUT
/begin RECORD_LAYOUT _REC_S1VAL_20_s1 FNC_VALUES 1 SBYTE COLUMN_DIR DIRECT /end RECORD_LAYOUT
/begin FUNCTION CbRicCtl_Wlwetxx ""
 /begin DEF_CHARACTERISTIC Ctb_wet_eal Ctb_wet_in_vvtc_angl Ctb_wet_n Ctb_wet_tco_17 Ctb_wet_tco_9 Cmp_wet_dep_fac_tco00 Cmp_wet_dep_fac_tco20 Cmp_wet_dep_fac_tco40 Cmp_wet_dep_fac_tco60 Cmp_wet_dep_fac_tco80 Cmp_wet_fil_fac_tco00 Cmp_wet_fil_fac_tco20 Cmp_wet_fil_fac_tco40 Cmp_wet_fil_fac_tco60 Cmp_wet_fil_fac_tco80 Cmp_wet_in_vvtc_cor_fac Ctp_wet_acel_cor_fac Ctp_wet_decl_cor_fac Ctp_wet_decl_fil_fac Ctp_wet_ini_acel_cor_ofs Ctp_wet_vol_dif_thd_acel Ctp_wet_vol_dif_thd_decl Ctp_wet_vol_dif_thd_ini Ctp_wet_vol_dif_thd_sta Ctp_wet_vol_dif_thd_sta_t Cbx_wet_stat_cor_bch_mod Cbx_wet_vol_dif_thd_sta_ena Cxx_decl_lean_dsb_n_ofs Cxx_decl_lean_dsb_n_thd Cxx_decl_prs_lean_dsb_dly Cxx_wet_acel_bch_cor_fac Cxx_wet_acel_bch_fil_fac Cxx_wet_bch_dep_fac Cxx_wet_decl_bch_cor_fac Cxx_wet_decl_bch_fil_fac Cxx_wet_ini_acel_ofs_t Cxx_wet_ini_acel_sta_t Cxx_wet_ti_cut_nr Cxx_wet_ti_cut_tdc_nr /end DEF_CHARACTERISTIC
 /begin OUT_MEASUREMENT Vbx_decl_prs_lean_ena Vbx_wet_ini_acel_cdn Vbx_wet_ini_acel_rest_cdn Vbx_wet_ti_clc_ena Vxx_decl_prs_lean_dsb_dly Vxx_fim Vxx_wet_acel_cor_fac Vxx_wet_acel_decl_bch_cor_fac Vxx_wet_acel_decl_cor_fac Vxx_wet_aftr_sta_t Vxx_wet_aftr_sta_t_prev Vxx_wet_cor_ofs_itl Vxx_wet_decl_cor_fac Vxx_wet_dep_fac Vxx_wet_dyn_vol Vxx_wet_dyn_vol_fil_fac Vxx_wet_dyn_vol_prev Vxx_wet_in_vvtc_cor_fac Vxx_wet_ini_acel_cor_ofs Vxx_wet_ini_acel_sta_t Vxx_wet_stat_vol Vxx_wet_ti_cut_ctr Vxx_wet_ti_cut_tdc_ctr Vxx_wet_vol_dif_thd_acel Vxx_wet_vol_dif_thd_decl Vxx_wet_wht_cor /end OUT_MEASUREMENT
/end FUNCTION
/begin FUNCTION CbRicCtl_Dbllpxx ""
 /begin DEF_CHARACTERISTIC Cmp_eal_n_lamb_v Cmp_eal_n_lamb_v_lpg Ctp_tco_cl2_ena_ctr Ctp_tco_cl2_ena_ctr_lpg Cbx_ti_cl2_cfm Cxx_cl2_act_ctr Cxx_cl2_asd_map_thd Cxx_cl2_ena_ctr Cxx_cl2_map_thd Cxx_cl2_n_thd Cxx_diag_fil_ti_ofs2_fac1 Cxx_diag_fil_ti_ofs2_fac2 Cxx_dyn_prs_fil_ofs2 Cxx_fil_ti_ofs2_fac Cxx_lbdw_fil_fac Cxx_max_diag_ti_ofs1 Cxx_max_is_ti_ofs2 Cxx_max_n_fil_ofs2 Cxx_max_prs_fil_ofs2 Cxx_max_tco_fil_ofs2 Cxx_max_ti_ofs1 Cxx_min_diag_ti_ofs2 Cxx_min_is_ti_ofs2 Cxx_min_n_fil_ofs2 Cxx_min_prs_fil_ofs2 Cxx_min_tco_fil_ofs2 Cxx_min_ti_ofs2 Cxx_ti_i2_cor_fac Cxx_ti_p2_cor_fac /end DEF_CHARACTERISTIC
 /begin OUT_MEASUREMENT Vbx_ofs2_ena Vbx_ti_cl2_act Vxx_cl2_act_ctr Vxx_cl2_ena_ctr Vxx_dbl_lbdw_v_fil Vxx_lbdw_v_sp Vxx_mv_ti_ofs2_cor Vxx_ti_i2_cor Vxx_ti_ofs2_cor Vxx_ti_p2_cor /end OUT_MEASUREMENT
/end FUNCTION
/begin FUNCTION CbRicCtl_Ricclxx ""
 /begin DEF_CHARACTERISTIC Ctb_eal2 Cmp_n_eal_ti_ofs1 Cmp_n_eal_ti_ofs1_lpg Cmp_n_eal_ti_ofs2 Cmp_n_eal_ti_ofs2_lpg Cmp_n_eal_ti_p_cor Cmp_n_eal_ti_p_cor_lpg Ctp_acel_n_ti_p_cor Ctp_cl_lean_sta Ctp_cl_lean_stop Ctp_decl_n_ti_p_cor Ctp_eal_l_ti_i_cor Ctp_eal_l_ti_i_cor_lean Ctp_eal_l_ti_i_cor_lean_lpg Ctp_eal_l_ti_i_cor_lpg Ctp_n_l_ti_i Ctp_n_l_ti_i_lean Ctp_n_l_ti_i_lean_lpg Ctp_n_l_ti_i_lpg Ctp_n_ti_p_cor_lean1 Ctp_n_ti_p_cor_lean2 Ctp_spc_slop_in Ctp_spc_slop_out Cbx_ti_bar_ena Cxx_acel_spc_slop Cxx_acel_spc_slop_lean Cxx_appl_ti_ofs_ctr Cxx_appl_ti_ofs_ctr_lpg Cxx_cl_lean_ctr Cxx_cl_ti_fac_ftc Cxx_cl_ti_fac_ftc_lpg Cxx_cl_ti_fac_ol_dec Cxx_cl_ti_fac_ol_inc Cxx_decl_spc_slop Cxx_decl_spc_slop_lean Cxx_dstb_ti_ofs_cor Cxx_dstb_ti_ofs_cor_lpg Cxx_dstb_ti_p_cor Cxx_dstb_ti_p_cor_lpg Cxx_h_ti_fast_slop_thd Cxx_h_ti_fast_slop_thd_lean Cxx_h_ti_fast_slop_thd_lpg Cxx_is_ti_i_cor Cxx_is_ti_i_cor_lean Cxx_is_ti_i_cor_lpg Cxx_is_ti_p_cor Cxx_is_ti_p_cor_lean1 Cxx_is_ti_p_cor_lean2 Cxx_is_ti_p_cor_lpg Cxx_l_ti_fast_slop_thd Cxx_l_ti_fast_slop_thd_lean Cxx_l_ti_fast_slop_thd_lpg Cxx_lamb_swi_ctr_ini Cxx_lamb_swi_ctr_ini_lpg Cxx_max_spc_slop_ctr Cxx_max_ti_p_cor_fast_slop Cxx_max_ti_p_cor_fast_slop_lpg Cxx_spc_slop_eal_ftc Cxx_spc_slop_eal_h_thd Cxx_spc_slop_eal_l_thd Cxx_ti_bar_dly Cxx_ti_bar_eal_max Cxx_ti_bar_eal_min Cxx_ti_bar_lbdw_lean_in Cxx_ti_bar_lbdw_lean_out Cxx_ti_bar_lbdw_rich_in Cxx_ti_bar_lbdw_rich_out Cxx_ti_bar_max Cxx_ti_bar_min Cxx_ti_bar_n_max Cxx_ti_bar_n_min Cxx_ti_bar_tco_min Cxx_ti_i_fast_slop_fac Cxx_ti_i_fast_slop_fac_lpg Cxx_ti_ofs_vs_thd Cxx_ti_ofs_vs_thd_lpg Cxx_ti_p_eal_thd /end DEF_CHARACTERISTIC
 /begin OUT_MEASUREMENT Vbx_cl_lean_cdn Vbx_spc_slop Vbx_ti_bar_cdn Vbx_ti_bar_end Vsx_rich_cl Vxx_appl_ti_ofs_ctr Vxx_cl_lean_ctr Vxx_cl_ti_fac Vxx_cl_ti_fac_fast_slop_sta Vxx_lamb_swi_ctr Vxx_last_p_cor Vxx_last_ti_p_cor Vxx_mv_cl_ti_fac Vxx_rich_i_appl Vxx_rich_i_bar_apl Vxx_slop_eal_dif Vxx_slop_eal_mmv Vxx_spc_slop_ctr Vxx_ti_i_cor Vxx_ti_i_cor_fast_slop Vxx_ti_i_cor_lean Vxx_ti_ofs_cor Vxx_ti_p_cor Vxx_ti_p_cor_fast_slop Vxx_ti_p_cor_lean1 Vxx_ti_p_cor_lean2 Vxx_trs_cl_ti_fac_bar_mem Vxx_trs_cl_ti_fac_mem /end OUT_MEASUREMENT
/end FUNCTION
/begin FUNCTION CbRicCtl_Ricloxx ""
 /begin DEF_CHARACTERISTIC Ctb_n_cl_rich_sp_bkp Ctb_tco_cl_off Cmp_n_tco_eal_fl_thd Cmp_n_tco_eal_fl_thd_lpg Ctp_cl_t Ctp_n_cl_rich_sp Ctp_n_dly_ofs_dly Ctp_n_dly_ofs_dly_lpg Ctp_n_eal_fl_ocl_ofs Ctp_n_iga_eal_fl_thd Cbx_fl_kd_thr_conf Cbx_lbup_conf Cxx_bfr_cl_ctr Cxx_bfr_cl_ctr_lpg Cxx_cl_off_n_thd Cxx_cl_run_eal_thd Cxx_cl_stop_eal_thd Cxx_ct_pdl_tco_thd Cxx_dly_ocl_amp_thd Cxx_dly_ocl_l_n_thd Cxx_dly_ocl_up_n_thd Cxx_fl_ena_n_thd Cxx_fl_n_thd Cxx_fl_n_thd_hys Cxx_h_dly_ocl_tco_thd Cxx_l_dly_ocl_tco_thd Cxx_ol_ti_fac_dec Cxx_ol_ti_fac_inc Cxx_rich_cl_tco_thd Cxx_rich_ol_fim_thd Cxx_sta_fl_off_dly Cxx_sta_fl_off_dly_lpg /end DEF_CHARACTERISTIC
 /begin OUT_MEASUREMENT Vbx_cl_cdn Vbx_cl_phs Vbx_dly_ocl_cdn Vbx_fl_cdn Vbx_fl_ena Vsx_rich_stt Vxx_bfr_cl_ctr Vxx_cl_t Vxx_dly_ocl_dly Vxx_eal_fl_ocl Vxx_fl_dsb_dly Vxx_ol_ti_fac /end OUT_MEASUREMENT
/end FUNCTION
/begin FUNCTION CbRicCtl_Ricadxx ""
 /begin DEF_CHARACTERISTIC Ctd_max_mv_cld_ad[0] Ctd_max_mv_cld_ad[1] Ctd_max_mv_cld_ad[2] Ctd_max_mv_cld_ad[3] Ctd_max_mv_cld_ad[4] Ctd_min_mv_cld_ad[0] Ctd_min_mv_cld_ad[1] Ctd_min_mv_cld_ad[2] Ctd_min_mv_cld_ad[3] Ctd_min_mv_cld_ad[4] Ctd_ti_ad_fac_cor[0] Ctd_ti_ad_fac_cor[1] Ctd_ti_ad_fac_cor[2] Ctd_ti_ad_fac_cor[3] Ctd_ti_ad_fac_cor[4] Ctd_ti_ad_ofs_cor[0] Ctd_ti_ad_ofs_cor[1] Ctd_ti_ad_ofs_cor[2] Ctd_ti_ad_ofs_cor[3] Ctd_ti_ad_ofs_cor[4] Ctd_ti_b_cor[0] Ctd_ti_b_cor[1] Ctd_ti_b_cor[2] Ctd_ti_b_cor[3] Ctd_ti_b_cor[4] Cxx_ad_lamb_swi_ctr Cxx_ad_off_ti_ad_fac Cxx_ad_off_ti_ad_ofs Cxx_cld_ad_nr Cxx_is_hot_tco_thd Cxx_is_hot_ti_cl_dly Cxx_max_cld_fac_thd Cxx_max_cld_ofs_thd Cxx_max_imd_ti_ad_fac Cxx_max_imd_ti_ad_ofs Cxx_max_mv_ti_ad_fac Cxx_max_mv_ti_ad_ofs Cxx_min_ad_fac_thd Cxx_min_ad_ofs_thd Cxx_min_cld_fac_thd Cxx_min_cld_ofs_thd Cxx_min_dif_ti_b Cxx_min_imd_ti_ad_fac Cxx_min_imd_ti_ad_ofs Cxx_min_mv_ti_ad_fac Cxx_min_mv_ti_ad_ofs Cxx_prs_zon Cxx_prs_zon_st Cxx_ti_ad_max_n Cxx_ti_ad_prs_l_thd Cxx_ti_ad_prs_trs_thd Cxx_ti_ad_prs_up_thd Cxx_ti_ad_tco_thd Cxx_zon_dif_min_hys /end DEF_CHARACTERISTIC
 /begin OUT_MEASUREMENT Vbx_ad_lsm_ena Vbx_ad_lsm_req Vbx_is_hot_dly Vbx_ti_ad1_zon0 Vbx_ti_ad1_zon1 Vbx_ti_ad1_zon2 Vbx_ti_ad1_zon3 Vbx_ti_ad1_zon4 Vtd_ti_b[0] Vtd_ti_b[1] Vtd_ti_b[2] Vtd_ti_b[3] Vtd_ti_b[4] Vxx_ad_lamb_swi_ctr Vxx_imd_ti_ad_fac Vxx_imd_ti_ad_ofs Vxx_imd_ti_ad_ofs_med Vxx_is_hot_ti_cl_dly Vxx_mv_ti_ad_ofs_med Vxx_ti_ad_fac Vxx_ti_ad_fac_med Vxx_ti_ad_facm_med Vxx_ti_ad_ofs Vxx_ti_b_med Vxx_ti_zon_nr /end OUT_MEASUREMENT
/end FUNCTION
/begin FUNCTION CbRicSpt "" /begin SUB_FUNCTION CbRicSpt_Flstpxx CbRicSpt_Wupdstb CbRicSpt_Alcoxxx /end SUB_FUNCTION /end FUNCTION
/begin FUNCTION CbRicSpt_Flstpxx ""
 /begin DEF_CHARACTERISTIC Cmp_n_eal_rich_sp Ctp_n_kd_rich_fac Cxx_cold_loop_kd_rich_fac Cxx_rich_cor_ena_n_thd Cxx_tia_kd_rich_cor_fac Cxx_tkof_fl_rich_fac Cxx_tkof_fl_rich_fac_alco /end DEF_CHARACTERISTIC
 /begin OUT_MEASUREMENT Vxx_bas_rich_fac Vxx_kd_rich_fac Vxx_kd_rich_fac_itl Vxx_n_kd_rich_fac /end OUT_MEASUREMENT
/end FUNCTION
/begin FUNCTION CbRicSpt_Wupdstb ""
 /begin DEF_CHARACTERISTIC Cxx_dstb_cyl1_fim_fac_is Cxx_dstb_cyl1_fim_fac_is_alco Cxx_dstb_cyl1_h_fim_fac Cxx_dstb_cyl1_h_fim_fac_alco Cxx_dstb_cyl1_l_fim_fac Cxx_dstb_cyl1_l_fim_fac_alco Cxx_dstb_cyl2_fim_fac_is Cxx_dstb_cyl2_fim_fac_is_alco Cxx_dstb_cyl2_h_fim_fac Cxx_dstb_cyl2_h_fim_fac_alco Cxx_dstb_cyl2_l_fim_fac Cxx_dstb_cyl2_l_fim_fac_alco Cxx_dstb_cyl3_fim_fac_is Cxx_dstb_cyl3_fim_fac_is_alco Cxx_dstb_cyl3_h_fim_fac Cxx_dstb_cyl3_h_fim_fac_alco Cxx_dstb_cyl3_l_fim_fac Cxx_dstb_cyl3_l_fim_fac_alco Cxx_dstb_cyl4_fim_fac_is Cxx_dstb_cyl4_fim_fac_is_alco Cxx_dstb_cyl4_h_fim_fac Cxx_dstb_cyl4_h_fim_fac_alco Cxx_dstb_cyl4_l_fim_fac Cxx_dstb_cyl4_l_fim_fac_alco /end DEF_CHARACTERISTIC
 /begin OUT_MEASUREMENT Vtx_dstb_cylx_fim_fac[0] Vtx_dstb_cylx_fim_fac[1] Vtx_dstb_cylx_fim_fac[2] Vtx_dstb_cylx_fim_fac[3] Vtx_dstb_cylx_fim_fac_is[0] Vtx_dstb_cylx_fim_fac_is[1] Vtx_dstb_cylx_fim_fac_is[2] Vtx_dstb_cylx_fim_fac_is[3] Vxx_cata_rich_dstb_cyl1_fac Vxx_cata_rich_dstb_cyl2_fac Vxx_cata_rich_dstb_cyl3_fac Vxx_cata_rich_dstb_cyl4_fac /end OUT_MEASUREMENT
/end FUNCTION
/begin FUNCTION CbRicSpt_Alcoxxx "" /begin DEF_CHARACTERISTIC Cmp_n_eal_rich_sp_alco Ctp_n_kd_rich_fac_alco /end DEF_CHARACTERISTIC /begin OUT_MEASUREMENT Vxx_n_eal_rich_sp_alco Vxx_n_kd_rich_fac_alco /end OUT_MEASUREMENT /end FUNCTION
/begin FUNCTION AsMafCtl "" /begin SUB_FUNCTION AsMafCtl_Itsptxx AsMafCtl_Itfloxx /end SUB_FUNCTION /end FUNCTION
/begin FUNCTION AsMafCtl_Itsptxx ""
 /begin DEF_CHARACTERISTIC Ctp_cold_stop_it_psn_sp Ctp_n_min_map_it_ar Ctp_n_min_map_it_ar_fac Ctp_n_noi_max_it_ar Ctp_tco_clos_it_t Cbx_clos_it_dsb Cbx_it_bch_cfm Cbx_it_ped_bch_cfm Cxx_clos_it_mat_min Cxx_clos_it_n_max Cxx_clos_it_n_min Cxx_clos_it_vs_max Cxx_eng_stop_it_psn_sp Cxx_ffig_it_psn_sp Cxx_fl_max_it_ar Cxx_it_pos_ped_fac_bch Cxx_it_pos_sc_bch Cxx_it_pos_sc_l_thd_bch Cxx_l_it_ar /end DEF_CHARACTERISTIC
 /begin OUT_MEASUREMENT Vbx_clos_it_dly_stop Vbx_clos_it_stop Vxx_fil1_it_psn_sp Vxx_it_ar_sp Vxx_it_psn_sp Vxx_raw_it_psn_sp Vxx_tq_it_ar_sp /end OUT_MEASUREMENT
/end FUNCTION
/begin FUNCTION AsMafCtl_Itfloxx ""
 /begin DEF_CHARACTERISTIC Ctb_prs_rat Ctp_it_prs_rat_fil_ftc Ctp_prs_tmp_flr_val Cbx_prs_sp_dsb_cfm /end DEF_CHARACTERISTIC
 /begin OUT_MEASUREMENT Vxx_ar_flr_tmp_val Vxx_it_ar_maf Vxx_it_prs_rat_fil Vxx_raw_prs_rat /end OUT_MEASUREMENT
/end FUNCTION
/begin FUNCTION AsMapCtl "" /begin SUB_FUNCTION AsMapCtl_Actacxx_xxxxxg AsMapCtl_Iomapxx /end SUB_FUNCTION /end FUNCTION
/begin FUNCTION AsMapCtl_Actacxx_xxxxxg ""
 /begin DEF_CHARACTERISTIC Ctb_no_it_psn Cbx_bch_cp_it_adj Cbx_bch_dsb_it_adj Cbx_bch_dsb_it_adj_val Cbx_bch_rst_it_adj Cbx_ena_appl_it_adj Ctb_it_ar[0] Ctb_it_ar[1] Ctb_it_ar[2] Ctb_it_ar[3] Ctb_it_ar[4] Ctb_it_ar[5] Ctb_it_ar[6] Ctb_it_ar[7] Ctb_it_ar[8] Ctb_it_ar[9] Ctb_it_ar[10] Ctb_it_ar[11] Ctb_it_ar[12] Ctb_it_ar[13] Ctb_it_ar[14] Ctb_it_ar[15] Ctb_it_ar[16] Ctx_fac_cor_it_ar_max[0] Ctx_fac_cor_it_ar_max[1] Ctx_fac_cor_it_ar_max[2] Ctx_fac_cor_it_ar_max[3] Ctx_fac_cor_it_ar_max[4] Ctx_fac_cor_it_ar_max[5] Ctx_fac_cor_it_ar_max[6] Ctx_fac_cor_it_ar_max[7] Ctx_fac_cor_it_ar_max[8] Ctx_fac_cor_it_ar_max[9] Ctx_fac_cor_it_ar_max[10] Ctx_fac_cor_it_ar_max[11] Ctx_fac_cor_it_ar_max[12] Ctx_fac_cor_it_ar_max[13] Ctx_fac_cor_it_ar_max[14] Ctx_fac_cor_it_ar_max[15] Ctx_fac_cor_it_ar_max[16] Ctx_fac_cor_it_ar_min[0] Ctx_fac_cor_it_ar_min[1] Ctx_fac_cor_it_ar_min[2] Ctx_fac_cor_it_ar_min[3] Ctx_fac_cor_it_ar_min[4] Ctx_fac_cor_it_ar_min[5] Ctx_fac_cor_it_ar_min[6] Ctx_fac_cor_it_ar_min[7] Ctx_fac_cor_it_ar_min[8] Ctx_fac_cor_it_ar_min[9] Ctx_fac_cor_it_ar_min[10] Ctx_fac_cor_it_ar_min[11] Ctx_fac_cor_it_ar_min[12] Ctx_fac_cor_it_ar_min[13] Ctx_fac_cor_it_ar_min[14] Ctx_fac_cor_it_ar_min[15] Ctx_fac_cor_it_ar_min[16] Cxx_adj_fac_it_adj Cxx_amp_upd_t_rst Cxx_cor_it_adj_ftc Cxx_fac_cor_it_adj Cxx_map_min_it_adj Cxx_map_rat_max_it_adj Cxx_mat_max_it_adj Cxx_mat_min_it_adj Cxx_min_ar_grd_it_adj Cxx_min_it_ar Cxx_n_max_it_adj Cxx_n_min_it_adj Cxx_thd_map_in_it_adj Cxx_thd_map_out_it_adj Cxx_thd_n_in_it_adj Cxx_thd_n_out_it_adj Cxx_thd_pos_max_it_adj Cxx_thd_pos_min_it_adj /end DEF_CHARACTERISTIC
 /begin OUT_MEASUREMENT Vtp_it_ar[0] Vtp_it_ar[1] Vtp_it_ar[2] Vtp_it_ar[3] Vtp_it_ar[4] Vtp_it_ar[5] Vtp_it_ar[6] Vtp_it_ar[7] Vtp_it_ar[8] Vtp_it_ar[9] Vtp_it_ar[10] Vtp_it_ar[11] Vtp_it_ar[12] Vtp_it_ar[13] Vtp_it_ar[14] Vtp_it_ar[15] Vtp_it_ar[16] Vbx_act1_cor_it_adj Vbx_act2_cor_it_adj Vbx_act_cor_it_adj Vbx_cor_map_it_adj Vbx_cor_n_it_adj Vbx_rst_cor_it_adj Vtp_cor_it_ar[0] Vtp_cor_it_ar[1] Vtp_cor_it_ar[2] Vtp_cor_it_ar[3] Vtp_cor_it_ar[4] Vtp_cor_it_ar[5] Vtp_cor_it_ar[6] Vtp_cor_it_ar[7] Vtp_cor_it_ar[8] Vtp_cor_it_ar[9] Vtp_cor_it_ar[10] Vtp_cor_it_ar[11] Vtp_cor_it_ar[12] Vtp_cor_it_ar[13] Vtp_cor_it_ar[14] Vtp_cor_it_ar[15] Vtp_cor_it_ar[16] Vtp_int_it_ar[0] Vtp_int_it_ar[1] Vtp_int_it_ar[2] Vtp_int_it_ar[3] Vtp_int_it_ar[4] Vtp_int_it_ar[5] Vtp_int_it_ar[6] Vtp_int_it_ar[7] Vtp_int_it_ar[8] Vtp_int_it_ar[9] Vtp_int_it_ar[10] Vtp_int_it_ar[11] Vtp_int_it_ar[12] Vtp_int_it_ar[13] Vtp_int_it_ar[14] Vtp_int_it_ar[15] Vtp_int_it_ar[16] Vtp_it_ar_raw[0] Vtp_it_ar_raw[1] Vtp_it_ar_raw[2] Vtp_it_ar_raw[3] Vtp_it_ar_raw[4] Vtp_it_ar_raw[5] Vtp_it_ar_raw[6] Vtp_it_ar_raw[7] Vtp_it_ar_raw[8] Vtp_it_ar_raw[9] Vtp_it_ar_raw[10] Vtp_it_ar_raw[11] Vtp_it_ar_raw[12] Vtp_it_ar_raw[13] Vtp_it_ar_raw[14] Vtp_it_ar_raw[15] Vtp_it_ar_raw[16] Vtp_lim_it_ar[0] Vtp_lim_it_ar[1] Vtp_lim_it_ar[2] Vtp_lim_it_ar[3] Vtp_lim_it_ar[4] Vtp_lim_it_ar[5] Vtp_lim_it_ar[6] Vtp_lim_it_ar[7] Vtp_lim_it_ar[8] Vtp_lim_it_ar[9] Vtp_lim_it_ar[10] Vtp_lim_it_ar[11] Vtp_lim_it_ar[12] Vtp_lim_it_ar[13] Vtp_lim_it_ar[14] Vtp_lim_it_ar[15] Vtp_lim_it_ar[16] Vtx_fac_cor_it_adj[0] Vtx_fac_cor_it_adj[1] Vtx_fac_cor_it_adj[2] Vtx_fac_cor_it_adj[3] Vtx_fac_cor_it_adj[4] Vtx_fac_cor_it_adj[5] Vtx_fac_cor_it_adj[6] Vtx_fac_cor_it_adj[7] Vtx_fac_cor_it_adj[8] Vtx_fac_cor_it_adj[9] Vtx_fac_cor_it_adj[10] Vtx_fac_cor_it_adj[11] Vtx_fac_cor_it_adj[12] Vtx_fac_cor_it_adj[13] Vtx_fac_cor_it_adj[14] Vtx_fac_cor_it_adj[15] Vtx_fac_cor_it_adj[16] Vxx_fil_fac_cor_it_adj Vxx_raw_fac_cor_it_adj /end OUT_MEASUREMENT
/end FUNCTION
/begin FUNCTION AsMapCtl_Iomapxx ""
 /begin DEF_CHARACTERISTIC Ctp_ctl_lomap_int Cbx_map_ctl_int_cfm Cbx_map_ctl_int_tkof_cfm Cxx_map_ctl_int_ftc_rst Cxx_map_ctl_int_map_thd Cxx_map_ctl_int_sat_prct_min /end DEF_CHARACTERISTIC
 /begin OUT_MEASUREMENT Vbx_map_ctl_int_act Vxx_map_ctl_cor_ar Vxx_map_ctl_int_fac Vxx_map_ctl_int_raw Vxx_map_err /end OUT_MEASUREMENT
/end FUNCTION
/begin FUNCTION CbSpvCms ""
 /begin SUB_FUNCTION CbSpvCms_Fuetyxx CbSpvCms_Cpricor CbSpvCms_Cpmanxx CbSpvCms_Alcovld CbSpvCms_Schxxxx /end SUB_FUNCTION
/end FUNCTION
/begin FUNCTION CbSpvCms_Fuetyxx ""
 /begin DEF_CHARACTERISTIC Cbx_lpg_lpg_mod Cbx_lpg_rich_cl_cdn Cxx_iga_fuel_typ_rat Cxx_polu_fuel_typ_rat Cxx_sta_fuel_typ_rat Cxx_ti_fuel_typ_rat Cxx_tq_fuel_typ_rat Cxx_wet_fuel_typ_rat Cxx_wup_fuel_typ Cxx_wup_fuel_typ_rat /end DEF_CHARACTERISTIC
 /begin OUT_MEASUREMENT Vbx_lpg_lpg_mod Vbx_lpg_rich_cl_cdn Vsx_wup_fuel_typ Vxx_iga_fuel_typ_rat Vxx_polu_fuel_typ_rat Vxx_sta_fuel_typ_rat Vxx_ti_fuel_typ_rat Vxx_tq_fuel_typ_rat Vxx_wet_fuel_typ_rat Vxx_wup_fuel_typ_rat /end OUT_MEASUREMENT
/end FUNCTION
/begin FUNCTION CbSpvCms_Cpricor ""
 /begin DEF_CHARACTERISTIC Ctb_n_cp Ctp_n_cp Cxx_cp_fac_rel Cxx_cp_fil_cl_ti_fac Cxx_cp_grd_fac Cxx_cp_inc_ad Cxx_cp_max_ad Cxx_cp_ol_rich_cor_appl Cxx_cp_rel_step_lamb_fac Cxx_cp_step_lamb_fac /end DEF_CHARACTERISTIC
 /begin OUT_MEASUREMENT Vbx_cp_ad Vbx_cp_rich_cor_lean_cond Vbx_cp_rich_cor_rich_cond Vxx_cp_fim_fac Vxx_cp_mv_cl_ti_fac Vxx_cp_rich_cor Vxx_cp_rich_cor_appl Vxx_cp_rich_cor_clc Vxx_cp_rich_int_cor /end OUT_MEASUREMENT
/end FUNCTION
/begin FUNCTION CbSpvCms_Cpmanxx ""
 /begin DEF_CHARACTERISTIC Cxx_cp_lamb_fac_mv_thd_1 Cxx_cp_lamb_fac_mv_thd_2 Cxx_cp_t_off Cxx_cp_t_on /end DEF_CHARACTERISTIC
 /begin OUT_MEASUREMENT Vbx_cp_ad_ena Vbx_cp_is_ena Vbx_cp_lsm_ad_ena Vbx_cp_rich_cge Vbx_prev_cp Vxx_cp_egr_sta_dly Vxx_cp_egr_stop_dly /end OUT_MEASUREMENT
/end FUNCTION
/begin FUNCTION CbSpvCms_Alcovld "" /begin OUT_MEASUREMENT Vsx_ti_alco_cor_vld /end OUT_MEASUREMENT /end FUNCTION
/begin FUNCTION CbSpvCms_Schxxxx "" /begin DEF_CHARACTERISTIC Cbx_alco_typ_cfm /end DEF_CHARACTERISTIC /begin OUT_MEASUREMENT Vbx_alco_typ_cfm /end OUT_MEASUREMENT /end FUNCTION
/begin FUNCTION AsBstCtl "" /begin OUT_MEASUREMENT Sxx_spg_ad_pwm_NVM /end OUT_MEASUREMENT
 /begin SUB_FUNCTION AsBstCtl_Wgsptxx AsBstCtl_Limitxx AsBstCtl_Prsctxx AsBstCtl_Bpcdmxx AsBstCtl_Alcoxxx /end SUB_FUNCTION
/end FUNCTION
/end MODULE
/end PROJECT
