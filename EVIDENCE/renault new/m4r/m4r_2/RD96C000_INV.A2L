ASAP2_VERSION 1 41
/begin PROJECT RD8 "_default_ProjectLongIdentifier"
/begin HEADER "_default_HeaderComment" PROJECT_NO RD9 /end HEADER
/begin MODULE _default_ModuleName "_default_ModuleLongIdentifier"
/begin MOD_COMMON "_default_ModCommonComment" DEPOSIT ABSOLUTE BYTE_ORDER MSB_LAST ALIGNMENT_BYTE 1 ALIGNMENT_WORD 2 ALIGNMENT_LONG 2 ALIGNMENT_FLOAT32_IEEE 2 ALIGNMENT_FLOAT64_IEEE 4 /end MOD_COMMON
/begin CHARACTERISTIC Ctp_max_pump_maf "Maximum mass air flow pumped depending on engine speed to protect engine and supercharger." CURVE 0xa002a5bc _REC_A1CUR_20_u2_u2 3000. _CNV_A_R_LINEAR_____109_CM 0. 3000. FORMAT "%7.2"
 /begin AXIS_DESCR COM_AXIS Vxx_n _CNV_A_R_ENSD_LINEA_24_CM 20 0. 16383.75 FORMAT "%8.2" AXIS_PTS_REF Ctb_n /end AXIS_DESCR
/end CHARACTERISTIC
/begin CHARACTERISTIC Ctp_max_rel_map_sp "Maximum relative boost pressure depending on engine spped to protect engine and supercharger" CURVE 0xa002a5e4 _REC_A1CUR_20_u2_u2 20000. _CNV_A_R_LINEAR_____57_CM 0. 20000. FORMAT "%5.0"
 /begin AXIS_DESCR COM_AXIS Vxx_n _CNV_A_R_ENSD_LINEA_24_CM 20 0. 16383.75 FORMAT "%8.2" AXIS_PTS_REF Ctb_n /end AXIS_DESCR
/end CHARACTERISTIC
/begin MEASUREMENT Vxx_max_spg_prs "Maximum boost pressure to protect engine and supercharger" UWORD _CNV_A_R_LINEAR_____57_CM 1 0. 0. 20000. ECU_ADDRESS 0xd0002e48 FORMAT "%5.0" /end MEASUREMENT
/begin MEASUREMENT Vxx_pump_max_maf "Maximum mass air flow pumped by the engine to protect engine and supercharger" UWORD _CNV_A_R_LINEAR_____109_CM 1 0. 0. 3000. ECU_ADDRESS 0xd0002e4a FORMAT "%7.2" /end MEASUREMENT
/begin CHARACTERISTIC Ctp_max_map_inj_cut "Table giving the manifold pressure threshold for injection cut" CURVE 0xa002c070 _REC_A1CUR_20_u2_u2 20000. _CNV_A_R_LINEAR_____57_CM 0. 20000. FORMAT "%5.0"
 /begin AXIS_DESCR COM_AXIS Vxx_n _CNV_A_R_ENSD_LINEA_24_CM 9 0. 16383.75 FORMAT "%8.2" AXIS_PTS_REF Ctb_n2 /end AXIS_DESCR
/end CHARACTERISTIC
/begin MEASUREMENT Vbx_ovp_inj_cut "Full injector cut request due to manifold overpressure" UBYTE _CNV_S_2_RANGE______3_CM 1 0. 0. 1. ECU_ADDRESS 0xd0004986 BIT_MASK 0x1 /end MEASUREMENT
/begin MEASUREMENT Vxx_dly_inj_cut "TDC number since entry in manifold overpressure cut conditions" UWORD _CNV_A_R_LINEAR_____55_CM 1 0. 0. 65535. ECU_ADDRESS 0xd00032f4 FORMAT "%5.0" /end MEASUREMENT
/begin MEASUREMENT Vxx_map_drv "Derivate of manifold air pressure" SWORD _CNV_A_R_LINEAR_____110_CM 1 0. -100000. 100000. ECU_ADDRESS 0xd00032f6 FORMAT "%7.0" /end MEASUREMENT
/begin MEASUREMENT Vxx_map_thd_inj_cut "Manifold pressure threshold over which the monitoring of manifold overpressure cut condition is made" UWORD _CNV_A_R_LINEAR_____57_CM 1 0. 0. 20000. ECU_ADDRESS 0xd00032f8 FORMAT "%5.0" /end MEASUREMENT
/begin MEASUREMENT Vxx_max_map_inj_cut "Manifold pressure threshold for overpressure cut condition" UWORD _CNV_A_R_LINEAR_____57_CM 1 0. 0. 20000. ECU_ADDRESS 0xd00032fa FORMAT "%5.0" /end MEASUREMENT
/begin CHARACTERISTIC Cxx_map_drv_inj_cut "Limite of manifold pressure derivate to detect overpressure cut condition" VALUE 0xa0021a94 _REC_S1VAL_20_s2 1560000. _CNV_A_R_LINEAR_____111_CM -780000. 780000. FORMAT "%7.0" /end CHARACTERISTIC
/begin CHARACTERISTIC Cxx_nr_tdc_inj_cut "TDC delay before reactivating manifold overpressure cut" VALUE 0xa0021a96 _REC_S1VAL_20_u2 65535. _CNV_A_R_LINEAR_____55_CM 0. 65535. FORMAT "%5.0" /end CHARACTERISTIC
/begin CHARACTERISTIC Cxx_prs_thd_inj_cut "Offset de pression sur la pression maximum de coupure injection." VALUE 0xa0021a98 _REC_S1VAL_20_u2 20000. _CNV_A_R_LINEAR_____57_CM 0. 20000. FORMAT "%5.0" /end CHARACTERISTIC
/begin AXIS_PTS Ctb_spg_ol_map_sp "9 breakpoint table for the manifold pressure setpoint" 0xa002a1f4 Vxx_alti_cor_map_sp _REC_A2AXS_20_u2 20000. _CNV_A_R_LINEAR_____57_CM 9 0. 20000. FORMAT "%5.0" /end AXIS_PTS
/begin AXIS_PTS Ctb_spg_prs_err "9 breakpoint table for boost pressure error" 0xa002a208 Vxx_spg_fil_prs_err _REC_A2AXS_20_u2 20000. _CNV_A_R_LINEAR_____107_CM 9 -10000. 10000. FORMAT "%6.0" /end AXIS_PTS
/begin AXIS_PTS Ctb_spg_prs_err_drv "9 breakpoint table for the derivate of boost pressure error." 0xa002a21c Vxx_spg_raw_fil_prs_err_drv _REC_A2AXS_20_u2 20000. _CNV_A_R_LINEAR_____107_CM 9 -10000. 10000. FORMAT "%6.0" /end AXIS_PTS
/begin AXIS_PTS Ctb_thr_psn "9 breakpoint table for the throttle position" 0xa002a230 Vxx_fil1_it_psn_sp _REC_A2AXS_20_u2 200. _CNV_A_R_LINEAR_____94_CM 9 0. 200. FORMAT "%6.2" /end AXIS_PTS
/begin CHARACTERISTIC Cmp_spg_i_pwm_fac "Integral term gain for the wastegate regulation" MAP 0xa002a244 _REC_A1MAP_20_u1_u2_u1 1.31484375e-002 _CNV_A_R_LINEAR_____112_CM 0. 1.31484375e-002 FORMAT "%10.8"
 /begin AXIS_DESCR COM_AXIS Vxx_spg_fil_prs_err _CNV_A_R_LINEAR_____107_CM 9 -10000. 10000. FORMAT "%6.0" AXIS_PTS_REF Ctb_spg_prs_err /end AXIS_DESCR
 /begin AXIS_DESCR COM_AXIS Vxx_gear _CNV_A_R_LINEAR_____113_CM 8 -1. 6. READ_ONLY FORMAT "%2.0" AXIS_PTS_REF Ntb_gear /end AXIS_DESCR
/end CHARACTERISTIC
/begin CHARACTERISTIC Cmp_spg_ol_pwm "PWM setpoint for the wastegate command" MAP 0xa002a28c _REC_A1MAP_20_u1_u2_u2 100. _CNV_A_R_LINEAR_____114_CM 0. 100. FORMAT "%12.8"
 /begin AXIS_DESCR COM_AXIS Vxx_n _CNV_A_R_ENSD_LINEA_24_CM 9 0. 16383.75 FORMAT "%8.2" AXIS_PTS_REF Ctb_n2 /end AXIS_DESCR
 /begin AXIS_DESCR COM_AXIS Vxx_alti_cor_map_sp _CNV_A_R_LINEAR_____57_CM 9 0. 20000. FORMAT "%5.0" AXIS_PTS_REF Ctb_spg_ol_map_sp /end AXIS_DESCR
/end CHARACTERISTIC
/begin CHARACTERISTIC Cmp_spg_ol_pwm_thr_n "Wastegate PWM command depending on revs and throttle position setpoint" MAP 0xa002a2e0 _REC_A1MAP_20_u1_u2_u2 100. _CNV_A_R_LINEAR_____114_CM 0. 100. FORMAT "%12.8"
 /begin AXIS_DESCR COM_AXIS Vxx_n _CNV_A_R_ENSD_LINEA_24_CM 9 0. 16383.75 FORMAT "%8.2" AXIS_PTS_REF Ctb_n2 /end AXIS_DESCR
 /begin AXIS_DESCR COM_AXIS Vxx_fil1_it_psn_sp _CNV_A_R_LINEAR_____94_CM 9 0. 200. FORMAT "%6.2" AXIS_PTS_REF Ctb_thr_psn /end AXIS_DESCR
/end CHARACTERISTIC
/begin CHARACTERISTIC Cmp_spg_prop_pwm_fac "Proportional term gain for the wastegate regulation" MAP 0xa002a334 _REC_A1MAP_20_u1_u2_u1 0.420650390625 _CNV_A_R_LINEAR_____115_CM 0. 0.420650390625 FORMAT "%9.7"
 /begin AXIS_DESCR COM_AXIS Vxx_spg_fil_prs_err _CNV_A_R_LINEAR_____107_CM 9 -10000. 10000. FORMAT "%6.0" AXIS_PTS_REF Ctb_spg_prs_err /end AXIS_DESCR
 /begin AXIS_DESCR COM_AXIS Vxx_gear _CNV_A_R_LINEAR_____113_CM 8 -1. 6. READ_ONLY FORMAT "%2.0" AXIS_PTS_REF Ntb_gear /end AXIS_DESCR
/end CHARACTERISTIC
/begin CHARACTERISTIC Ctp_spg_cl_spg_prs_thd "Wastegate command start pressure." CURVE 0xa002a37c _REC_A1CUR_20_u2_u2 20000. _CNV_A_R_LINEAR_____57_CM 0. 20000. FORMAT "%5.0"
 /begin AXIS_DESCR COM_AXIS Vxx_n _CNV_A_R_ENSD_LINEA_24_CM 9 0. 16383.75 FORMAT "%8.2" AXIS_PTS_REF Ctb_n2 /end AXIS_DESCR
/end CHARACTERISTIC
/begin CHARACTERISTIC Ctp_spg_drv_pwm_fac "Derivative term gain for the wastegate regulation" CURVE 0xa002a390 _REC_A1CUR_20_u1_u2 3.984375 _CNV_A_R_LINEAR_____116_CM 0. 3.984375 FORMAT "%8.6"
 /begin AXIS_DESCR COM_AXIS Vxx_spg_raw_fil_prs_err_drv _CNV_A_R_LINEAR_____107_CM 9 -10000. 10000. FORMAT "%6.0" AXIS_PTS_REF Ctb_spg_prs_err_drv /end AXIS_DESCR
/end CHARACTERISTIC
/begin CHARACTERISTIC Ctp_spg_prs_dif_thd_trs "Pressure error threshold for transiant detection" CURVE 0xa002a39c _REC_A1CUR_20_u2_u2 20000. _CNV_A_R_LINEAR_____57_CM 0. 20000. FORMAT "%5.0"
 /begin AXIS_DESCR COM_AXIS Vxx_n _CNV_A_R_ENSD_LINEA_24_CM 9 0. 16383.75 FORMAT "%8.2" AXIS_PTS_REF Ctb_n2 /end AXIS_DESCR
/end CHARACTERISTIC
/begin MEASUREMENT Vbx_spg_ad_cdn "Boost adaptative conditions" UBYTE _CNV_S_2_RANGE______3_CM 1 0. 0. 1. ECU_ADDRESS 0xd00052a5 BIT_MASK 0x1 /end MEASUREMENT
/begin MEASUREMENT Vbx_spg_cl_cdn "Wastegate regulation conditions" UBYTE _CNV_S_2_RANGE______3_CM 1 0. 0. 1. ECU_ADDRESS 0xd00052a6 BIT_MASK 0x1 /end MEASUREMENT
/begin MEASUREMENT Vbx_spg_i_frz "Freezing of the integral term on boost control." UBYTE _CNV_S_2_RANGE______3_CM 1 0. 0. 1. ECU_ADDRESS 0xd00052a7 BIT_MASK 0x1 /end MEASUREMENT
/begin MEASUREMENT Vbx_spg_ol_cdn "Enables open loop command of the wastegate" UBYTE _CNV_S_2_RANGE______3_CM 1 0. 0. 1. ECU_ADDRESS 0xd0004bd9 BIT_MASK 0x1 /end MEASUREMENT
/begin MEASUREMENT Vbx_spg_pwm_dsb_req "Wastegate command driver disable request" UBYTE _CNV_S_2_RANGE______3_CM 1 0. 0. 1. ECU_ADDRESS 0xd0004bda BIT_MASK 0x1 /end MEASUREMENT
/begin MEASUREMENT Vbx_spg_trs "Wastegate transiant" UBYTE _CNV_S_2_RANGE______3_CM 1 0. 0. 1. ECU_ADDRESS 0xd0004bdb BIT_MASK 0x1 /end MEASUREMENT
/begin MEASUREMENT Vxx_alti_cor_map_sp "Boost pressure setpoint corrected by alto pressure." UWORD _CNV_A_R_LINEAR_____57_CM 1 0. 0. 20000. ECU_ADDRESS 0xc0000bec FORMAT "%5.0" /end MEASUREMENT
/begin MEASUREMENT Vxx_ol_spg_pwm "PWM open loop setpoint for the wastegate." UBYTE _CNV_A_R_LINEAR_____114_CM 1 0. 0. 100. ECU_ADDRESS 0xd00052a8 FORMAT "%12.8" /end MEASUREMENT
/begin MEASUREMENT Vxx_spg_ad_pwm_inc "Raw value of adaptative increment" SWORD _CNV_A_R_LINEAR_____117_CM 1 0. -50. 49.9984741210938 ECU_ADDRESS 0xc0000bee FORMAT "%7.3" /end MEASUREMENT
/begin MEASUREMENT Vxx_spg_alti_ofs "Altimetric pressure correction for the wastegate regulation" SWORD _CNV_A_R_LINEAR_____57_CM 1 0. -10000. 10000. ECU_ADDRESS 0xc0000bf0 FORMAT "%6.0" /end MEASUREMENT
/begin MEASUREMENT Vxx_spg_cl_pwm "Closed loop corretion for the wastegate regulation" SWORD _CNV_A_R_LINEAR_____117_CM 1 0. -50. 49.9984741210938 ECU_ADDRESS 0xc0000bf2 FORMAT "%7.3" /end MEASUREMENT
/begin MEASUREMENT Vxx_spg_d_pwm "Derivative term for the wastegate regulation" SWORD _CNV_A_R_LINEAR_____117_CM 1 0. -50. 49.9984741210938 ECU_ADDRESS 0xc0000bf4 FORMAT "%7.3" /end MEASUREMENT
/begin MEASUREMENT Vxx_spg_fil_prs_err "Boost pressure error" SWORD _CNV_A_R_LINEAR_____57_CM 1 0. -10000. 10000. ECU_ADDRESS 0xc0000bf6 FORMAT "%6.0" /end MEASUREMENT
/begin MEASUREMENT Vxx_spg_fil_prs_err_drv "Filtered derivate of the boost pressure error" SWORD _CNV_A_R_LINEAR_____57_CM 1 0. -10000. 10000. ECU_ADDRESS 0xc0000bf8 FORMAT "%6.0" /end MEASUREMENT
/begin MEASUREMENT Vxx_spg_i_aw_cor "Integral term anti wind up correction" SWORD _CNV_A_R_LINEAR_____117_CM 1 0. -50. 49.9984741210938 ECU_ADDRESS 0xc0000bfa FORMAT "%7.3" /end MEASUREMENT
/begin MEASUREMENT Vxx_spg_i_pwm "Integral term for the wastegate regulation" SWORD _CNV_A_R_LINEAR_____117_CM 1 0. -50. 49.9984741210938 ECU_ADDRESS 0xc0000bfc FORMAT "%7.3" /end MEASUREMENT
/begin MEASUREMENT Vxx_spg_p_pwm "Proportional term for the wastegate regulation" SWORD _CNV_A_R_LINEAR_____117_CM 1 0. -50. 49.9984741210938 ECU_ADDRESS 0xc0000bfe FORMAT "%7.3" /end MEASUREMENT
/begin MEASUREMENT Vxx_spg_prs_err "Boost pressure error for the wastegate control" SWORD _CNV_A_R_LINEAR_____57_CM 1 0. -10000. 10000. ECU_ADDRESS 0xd0002ffc FORMAT "%6.0" /end MEASUREMENT
/begin MEASUREMENT Vxx_spg_pwm_sp "RCO setpoint of the wastegate" UBYTE _CNV_A_R_LINEAR_____114_CM 1 0. 0. 100. ECU_ADDRESS 0xd0004bdc FORMAT "%12.8" /end MEASUREMENT
/begin MEASUREMENT Vxx_spg_raw_fil_prs_err_drv "Raw derivate of the boost pressure error" SWORD _CNV_A_R_LINEAR_____57_CM 1 0. -10000. 10000. ECU_ADDRESS 0xc0000c00 FORMAT "%6.0" /end MEASUREMENT
/begin CHARACTERISTIC Cbx_spg_bch_mod "Bench mode for wastegate command" VALUE 0xa0021e90 _REC_S1VAL_20_u1 1. _CNV_A_R_ECME_LINEA_0_CM 0. 1. FORMAT "%1.0" BIT_MASK 0x1 /end CHARACTERISTIC
/begin CHARACTERISTIC Cbx_spg_rams_cfm "Strategy choice : Turbocharger failure (1) or spg sensor failure (0)" VALUE 0xa0021e91 _REC_S1VAL_20_u1 1. _CNV_A_R_ECME_LINEA_0_CM 0. 1. FORMAT "%1.0" BIT_MASK 0x1 /end CHARACTERISTIC
/begin CHARACTERISTIC Cbx_spg_tq_off_mod "disables the revs - Throttle area cartography" VALUE 0xa0021e92 _REC_S1VAL_20_u1 1. _CNV_A_R_ECME_LINEA_0_CM 0. 1. FORMAT "%1.0" BIT_MASK 0x1 /end CHARACTERISTIC
/begin CHARACTERISTIC Cxx_spg_ad_alti_thd "Atmospheric pressure threshold underwhich there is no adaptation" VALUE 0xa0021e64 _REC_S1VAL_20_u2 20000. _CNV_A_R_LINEAR_____57_CM 0. 20000. FORMAT "%5.0" /end CHARACTERISTIC
/begin CHARACTERISTIC Cxx_spg_ad_down_vb_thd "Battery voltage underwich no adaptation is done" VALUE 0xa0021e66 _REC_S1VAL_20_u2 25000. _CNV_A_R_LINEAR_____52_CM 0. 25000. FORMAT "%5.0" /end CHARACTERISTIC
/begin CHARACTERISTIC Cxx_spg_ad_n_thd "Engine speed threshold overwhich no adaptation is done" VALUE 0xa0021e68 _REC_S1VAL_20_u2 16383.75 _CNV_A_R_ENSD_LINEA_24_CM 0. 16383.75 FORMAT "%8.2" /end CHARACTERISTIC
/begin CHARACTERISTIC Cxx_spg_ad_pwm_fac "Filter factor of the mean PWM when calculating the adaptation value" VALUE 0xa0021e93 _REC_S1VAL_20_u1 0.99609375 _CNV_A_R_LINEAR_____31_CM 0. 0.99609375 FORMAT "%5.3" /end CHARACTERISTIC
/begin CHARACTERISTIC Cxx_spg_ad_pwm_max_cor "Maximum adaptative term for the wastegate regulation" VALUE 0xa0021e6a _REC_S1VAL_20_s2 99.99847412109381 _CNV_A_R_LINEAR_____117_CM -50. 49.9984741210938 FORMAT "%7.3" /end CHARACTERISTIC
/begin CHARACTERISTIC Cxx_spg_ad_pwm_min_cor "Minimum adaptative term for the wastegate regulation" VALUE 0xa0021e6c _REC_S1VAL_20_s2 99.99847412109381 _CNV_A_R_LINEAR_____117_CM -50. 49.9984741210938 FORMAT "%7.3" /end CHARACTERISTIC
/begin CHARACTERISTIC Cxx_spg_ad_spg_thd "Pressure threshold underwhich no adaptation is done" VALUE 0xa0021e6e _REC_S1VAL_20_u2 20000. _CNV_A_R_LINEAR_____57_CM 0. 20000. FORMAT "%5.0" /end CHARACTERISTIC
/begin CHARACTERISTIC Cxx_spg_ad_stab_prs_thd "Stabilized pressure detection threshold" VALUE 0xa0021e70 _REC_S1VAL_20_u2 20000. _CNV_A_R_LINEAR_____57_CM 0. 20000. FORMAT "%5.0" /end CHARACTERISTIC
/begin CHARACTERISTIC Cxx_spg_ad_up_vb_thd "Battery voltage over which no adpation is done" VALUE 0xa0021e72 _REC_S1VAL_20_u2 25000. _CNV_A_R_LINEAR_____52_CM 0. 25000. FORMAT "%5.0" /end CHARACTERISTIC
/begin CHARACTERISTIC Cxx_spg_alti_ofs_fac "Correction gain on the altimetric pressure for the boost pressure regulation." VALUE 0xa0021e94 _REC_S1VAL_20_u1 1.9921875 _CNV_A_R_LINEAR_____43_CM 0. 1.9921875 FORMAT "%8.6" /end CHARACTERISTIC
/begin CHARACTERISTIC Cxx_spg_alti_ofs_ofs "Offset for the altimetric pressure correction. For the boost pressure regulation" VALUE 0xa0021e74 _REC_S1VAL_20_u2 20000. _CNV_A_R_LINEAR_____57_CM 0. 20000. FORMAT "%5.0" /end CHARACTERISTIC
/begin CHARACTERISTIC Cxx_spg_alti_ol_pwm_fac "Altmospheric pressure correction for wastegate PWM" VALUE 0xa0021e95 _REC_S1VAL_20_u1 1.9921875 _CNV_A_R_LINEAR_____43_CM 0. 1.9921875 FORMAT "%8.6" /end CHARACTERISTIC
/begin CHARACTERISTIC Cxx_spg_cl_tco_thd "Coolant temperature threshold for wastegate control" VALUE 0xa0021e76 _REC_S1VAL_20_u2 240. _CNV_A_R_LINEAR_____54_CM -40. 200. FORMAT "%5.1" /end CHARACTERISTIC
/begin CHARACTERISTIC Cxx_spg_down_ad_dz "Minimum deadzone for adaptative term of wastegate" VALUE 0xa0021e78 _REC_S1VAL_20_s2 99.99847412109381 _CNV_A_R_LINEAR_____117_CM -50. 49.9984741210938 FORMAT "%7.3" /end CHARACTERISTIC
/begin CHARACTERISTIC Cxx_spg_err_down_thd_drv "Boost pressure threshold under which cerrection is canceled" VALUE 0xa0021e7a _REC_S1VAL_20_s2 20000. _CNV_A_R_LINEAR_____57_CM -10000. 10000. FORMAT "%6.0" /end CHARACTERISTIC
/begin CHARACTERISTIC Cxx_spg_err_drv_ftc "Filter time constant for the boost pressure error" VALUE 0xa0021e7c _REC_S1VAL_20_u2 655.35 _CNV_A_R_LINEAR_____34_CM 0. 655.35 FORMAT "%6.2" /end CHARACTERISTIC
/begin CHARACTERISTIC Cxx_spg_err_up_thd_drv "Boost pressure error threshold over which derivate correction is canceled" VALUE 0xa0021e7e _REC_S1VAL_20_s2 20000. _CNV_A_R_LINEAR_____57_CM -10000. 10000. FORMAT "%6.0" /end CHARACTERISTIC
/begin CHARACTERISTIC Cxx_spg_i_aw_fac "Anti wind up Corrective gain" VALUE 0xa0021e96 _REC_S1VAL_20_u1 1. _CNV_A_R_LINEAR_____118_CM 0. 1. FORMAT "%9.7" /end CHARACTERISTIC
/begin CHARACTERISTIC Cxx_spg_i_pwm_max_cor "maximum Integral term for the wastegate regulation" VALUE 0xa0021e80 _REC_S1VAL_20_s2 99.99847412109381 _CNV_A_R_LINEAR_____117_CM -50. 49.9984741210938 FORMAT "%7.3" /end CHARACTERISTIC
/begin CHARACTERISTIC Cxx_spg_i_pwm_min_cor "minimum integral term for the wastegate regulation" VALUE 0xa0021e82 _REC_S1VAL_20_s2 99.99847412109381 _CNV_A_R_LINEAR_____117_CM -50. 49.9984741210938 FORMAT "%7.3" /end CHARACTERISTIC
/begin CHARACTERISTIC Cxx_spg_i_pwm_sp "Setpoint for the integral term of the wastegate regulation" VALUE 0xa0021e84 _REC_S1VAL_20_s2 99.99847412109381 _CNV_A_R_LINEAR_____117_CM -50. 49.9984741210938 FORMAT "%7.3" /end CHARACTERISTIC
/begin CHARACTERISTIC Cxx_spg_max_err_drv "Maximum value for boost pressure error derivate" VALUE 0xa0021e86 _REC_S1VAL_20_s2 20000. _CNV_A_R_LINEAR_____57_CM -10000. 10000. FORMAT "%6.0" /end CHARACTERISTIC
/begin CHARACTERISTIC Cxx_spg_max_pwm "Maximum threshold for the PWM saturation detection" VALUE 0xa0021e97 _REC_S1VAL_20_u1 100. _CNV_A_R_LINEAR_____114_CM 0. 100. FORMAT "%12.8" /end CHARACTERISTIC
/begin CHARACTERISTIC Cxx_spg_max_pwm_aw "Maximum threshold for the application of the anti wind up correction on integral term" VALUE 0xa0021e98 _REC_S1VAL_20_u1 100. _CNV_A_R_LINEAR_____114_CM 0. 100. FORMAT "%12.8" /end CHARACTERISTIC
/begin CHARACTERISTIC Cxx_spg_min_err_drv "Minimum value for boost pressure error derivate" VALUE 0xa0021e88 _REC_S1VAL_20_s2 20000. _CNV_A_R_LINEAR_____57_CM -10000. 10000. FORMAT "%6.0" /end CHARACTERISTIC
/begin CHARACTERISTIC Cxx_spg_min_pwm "Minimum threshold for the PWM saturation detection" VALUE 0xa0021e99 _REC_S1VAL_20_u1 100. _CNV_A_R_LINEAR_____114_CM 0. 100. FORMAT "%12.8" /end CHARACTERISTIC
/begin CHARACTERISTIC Cxx_spg_min_pwm_aw "Minimum threshold for the application of the anti wind up correction on integral term" VALUE 0xa0021e9a _REC_S1VAL_20_u1 100. _CNV_A_R_LINEAR_____114_CM 0. 100. FORMAT "%12.8" /end CHARACTERISTIC
/begin CHARACTERISTIC Cxx_spg_ol_spg_sp_thd "Pressure threshold under which open loop term is applied." VALUE 0xa0021e8a _REC_S1VAL_20_u2 20000. _CNV_A_R_LINEAR_____57_CM 0. 20000. FORMAT "%5.0" /end CHARACTERISTIC
/begin CHARACTERISTIC Cxx_spg_prop_dz "Deadzone within which proportional term is canceled." VALUE 0xa0021e8c _REC_S1VAL_20_u2 20000. _CNV_A_R_LINEAR_____57_CM 0. 20000. FORMAT "%5.0" /end CHARACTERISTIC
/begin CHARACTERISTIC Cxx_spg_pwm_bch_mod_val "Bench mode value for wastegate PWM" VALUE 0xa0021e9b _REC_S1VAL_20_u1 100. _CNV_A_R_LINEAR_____114_CM 0. 100. FORMAT "%12.8" /end CHARACTERISTIC
/begin CHARACTERISTIC Cxx_spg_pwm_dif_trt_ad "Difference between setpoint and limits under which learning is disabled." VALUE 0xa0021e9c _REC_S1VAL_20_u1 100. _CNV_A_R_LINEAR_____114_CM 0. 100. FORMAT "%12.8" /end CHARACTERISTIC
/begin CHARACTERISTIC Cxx_spg_up_ad_dz "Maximum deadzone value for the adaptative term" VALUE 0xa0021e8e _REC_S1VAL_20_s2 99.99847412109381 _CNV_A_R_LINEAR_____117_CM -50. 49.9984741210938 FORMAT "%7.3" /end CHARACTERISTIC
/begin CHARACTERISTIC Cmp_spg_ol_pwm_alco "PWM setpoint for the wastegate command" MAP 0xa0029898 _REC_A1MAP_20_u1_u2_u2 100. _CNV_A_R_LINEAR_____114_CM 0. 100. FORMAT "%12.8"
 /begin AXIS_DESCR COM_AXIS Vxx_n _CNV_A_R_ENSD_LINEA_24_CM 9 0. 16383.75 FORMAT "%8.2" AXIS_PTS_REF Ctb_n2 /end AXIS_DESCR
 /begin AXIS_DESCR COM_AXIS Vxx_alti_cor_map_sp _CNV_A_R_LINEAR_____57_CM 9 0. 20000. FORMAT "%5.0" AXIS_PTS_REF Ctb_spg_ol_map_sp /end AXIS_DESCR
/end CHARACTERISTIC
/begin MEASUREMENT Vxx_spg_ol_pwm_alco "PWM setpoint for the wastegate command (alcohol setting)" UBYTE _CNV_A_R_LINEAR_____114_CM 1 0. 0. 100. ECU_ADDRESS 0xd0004be3 FORMAT "%12.8" /end MEASUREMENT
/begin AXIS_PTS Ctb_pump_maf "9 breakpoints table for mass air flow." 0xa0028f40 Vxx_pump_maf _REC_A2AXS_20_u2 3000. _CNV_A_R_LINEAR_____109_CM 9 0. 3000. FORMAT "%7.2" /end AXIS_PTS
/begin AXIS_PTS Ctb_spg_pwm "9 breakpoints for the wastegate RCO setpoint." 0xa0028f54 Vxx_spg_pwm_sp_fil _REC_A2AXS_20_u1 100. _CNV_A_R_LINEAR_____114_CM 9 0. 100. FORMAT "%12.8" /end AXIS_PTS
/begin CHARACTERISTIC Cmp_ex_prs_dif_fac "Load losses coefficient linked to the wastegate and turbine without injection cut." MAP 0xa0028f60 _REC_A1MAP_20_u2_u1_u2 0.65535 _CNV_A_R_LINEAR_____119_CM 0. 0.65535 FORMAT "%7.5"
 /begin AXIS_DESCR COM_AXIS Vxx_spg_pwm_sp_fil _CNV_A_R_LINEAR_____114_CM 9 0. 100. FORMAT "%12.8" AXIS_PTS_REF Ctb_spg_pwm /end AXIS_DESCR
 /begin AXIS_DESCR COM_AXIS Vxx_pump_maf _CNV_A_R_LINEAR_____109_CM 9 0. 3000. FORMAT "%7.2" AXIS_PTS_REF Ctb_pump_maf /end AXIS_DESCR
/end CHARACTERISTIC
/begin MEASUREMENT Vsx_ex_prs_mdl_vld "Estimated exhaust manifold pressure validity status" UBYTE _CNV_S_3_STATUS_OK__120_CM 1 0. 0. 2. ECU_ADDRESS 0xd00051c0 /end MEASUREMENT
/begin MEASUREMENT Vsx_ex_prs_vld "Exhaust manifold pressure validity status" UBYTE _CNV_S_4_STATUS_OK__121_CM 1 0. 0. 3. ECU_ADDRESS 0xd00051c1 /end MEASUREMENT
/begin MEASUREMENT Vxx_ex_prs "Exhaust manifold pressure" UWORD _CNV_A_R_LINEAR_____57_CM 1 0. 0. 20000. ECU_ADDRESS 0xd0005ae8 FORMAT "%5.0" /end MEASUREMENT
/begin MEASUREMENT Vxx_ex_prs_mdl "Estimated exhaust manifold pressure" UWORD _CNV_A_R_LINEAR_____57_CM 1 0. 0. 20000. ECU_ADDRESS 0xd0005aea FORMAT "%5.0" /end MEASUREMENT
/begin MEASUREMENT Vxx_spg_pwm_sp_fil "RCO setpoint of the wastegate" UBYTE _CNV_A_R_LINEAR_____114_CM 1 0. 0. 100. ECU_ADDRESS 0xd00051c2 FORMAT "%12.8" /end MEASUREMENT
/begin MEASUREMENT Vxx_up_tbn_prs_dif "Exhaust counter pressure before turbine." UWORD _CNV_A_R_LINEAR_____57_CM 1 0. 0. 20000. ECU_ADDRESS 0xd0005aec FORMAT "%5.0" /end MEASUREMENT
/begin MEASUREMENT Vxx_up_tbn_prs_dif_fac "Load losses coefficient linked to the wastegate and turbine" UWORD _CNV_A_R_LINEAR_____119_CM 1 0. 0. 0.65535 ECU_ADDRESS 0xd0005aee FORMAT "%7.5" /end MEASUREMENT
/begin CHARACTERISTIC Cxx_ex_prs_fail_val "Exhaust manifold pressure default value" VALUE 0xa0021a86 _REC_S1VAL_20_u2 20000. _CNV_A_R_LINEAR_____57_CM 0. 20000. FORMAT "%5.0" /end CHARACTERISTIC
/begin CHARACTERISTIC Cxx_spg_pwm_sp_ftc "Filter time constant for wastegate PWM" VALUE 0xa0021a88 _REC_S1VAL_20_u2 65.535 _CNV_A_R_LINEAR_____58_CM 0. 65.535 /end CHARACTERISTIC
/begin CHARACTERISTIC Cxx_tbn_prs_dif_cut_fac "Wastegate and turbine load losses coefficient during injection cut" VALUE 0xa0021a8a _REC_S1VAL_20_u2 100. _CNV_A_R_LINEAR_____122_CM 0. 100. FORMAT "%12.8" /end CHARACTERISTIC
/begin MEASUREMENT Vxx_is_ad_tq "Adaptive correction" SWORD _CNV_A_R_LINEAR_____123_CM 1 0. -1024. 1023.96875 DISPLAY_IDENTIFIER SmIsrCtl_NVM.Vxx_is_ad_tq_NVM ECU_ADDRESS 0xc0000bda FORMAT "%11.5" /end MEASUREMENT
/begin AXIS_PTS Ctb_is_n_d_dif "Static error breakpoints for idle speed regulator (case derivate)" 0xa0023274 Vxx_dif_n_sp _REC_A2AXS_20_u2 16383.75 _CNV_A_R_LINEAR_____124_CM 8 -8192. 8191.75 FORMAT "%8.2" /end AXIS_PTS
/begin AXIS_PTS Ctb_is_tco "Coolant temperature breakpoints for ISR set point tables" 0xa0023288 Vxx_tco _REC_A2AXS_20_u2 240. _CNV_A_R_LINEAR_____54_CM 9 -40. 200. FORMAT "%6.1" /end AXIS_PTS
/begin CHARACTERISTIC Ctp_is_d_err_fac "Derivative correction factor table dependent on static error" CURVE 0xa002329c _REC_A1CUR_20_u2_u2 2. _CNV_A_R_LINEAR_____125_CM 0. 2. FORMAT "%10.8"
 /begin AXIS_DESCR COM_AXIS Vxx_dif_n_sp _CNV_A_R_LINEAR_____124_CM 8 -8192. 8191.75 FORMAT "%8.2" AXIS_PTS_REF Ctb_is_n_d_dif /end AXIS_DESCR
/end CHARACTERISTIC
/begin CHARACTERISTIC Ctp_is_d_gear_fac "Derivative correction factor table dependent on gear ratio" CURVE 0xa00232ac _REC_A1CUR_20_u2_u1 2. _CNV_A_R_LINEAR_____126_CM 0. 2. FORMAT "%10.8"
 /begin AXIS_DESCR COM_AXIS Vxx_gear _CNV_A_R_LINEAR_____113_CM 8 -1. 6. READ_ONLY FORMAT "%2.0" AXIS_PTS_REF Ntb_gear /end AXIS_DESCR
/end CHARACTERISTIC
/begin CHARACTERISTIC Ctp_is_d_max "Idle speed table used to determine the maximum limitation of derivative correction function Tco" CURVE 0xa00232bc _REC_A1CUR_20_u2_u2 2047.96875 _CNV_A_R_LINEAR_____127_CM -1024. 1023.96875 FORMAT "%11.5"
 /begin AXIS_DESCR COM_AXIS Vxx_tco _CNV_A_R_LINEAR_____54_CM 9 -40. 200. FORMAT "%6.1" AXIS_PTS_REF Ctb_is_tco /end AXIS_DESCR
/end CHARACTERISTIC
/begin CHARACTERISTIC Ctp_is_d_min "Idle speed table used to determine the minimum limitation of derivative correction function Tco" CURVE 0xa00232d0 _REC_A1CUR_20_u2_u2 2047.96875 _CNV_A_R_LINEAR_____127_CM -1024. 1023.96875 FORMAT "%11.5"
 /begin AXIS_DESCR COM_AXIS Vxx_tco _CNV_A_R_LINEAR_____54_CM 9 -40. 200. FORMAT "%6.1" AXIS_PTS_REF Ctb_is_tco /end AXIS_DESCR
/end CHARACTERISTIC
/begin CHARACTERISTIC Ctp_is_d_tco_fac "Derivative correction factor table dependent on coolant temperature" CURVE 0xa00232e4 _REC_A1CUR_20_u2_u2 2. _CNV_A_R_LINEAR_____125_CM 0. 2. FORMAT "%10.8"
 /begin AXIS_DESCR COM_AXIS Vxx_tco _CNV_A_R_LINEAR_____54_CM 9 -40. 200. FORMAT "%6.1" AXIS_PTS_REF Ctb_is_tco /end AXIS_DESCR
/end CHARACTERISTIC
/begin MEASUREMENT Vbx_ini_drv "Initialization conditions with switch boolean" UBYTE _CNV_S_2_RANGE______3_CM 1 0. 0. 1. ECU_ADDRESS 0xd0004be2 BIT_MASK 0x1 /end MEASUREMENT
/begin MEASUREMENT Vxx_dif_n_sp_grd "Derivative of difference between engine speed and idle speed setpoint by report to the time" SWORD _CNV_A_R_LINEAR_____23_CM 1 0. -8192. 8191. ECU_ADDRESS 0xd000357c FORMAT "%5.0" /end MEASUREMENT
/begin MEASUREMENT Vxx_is_d_cor "Derivative correction" SWORD _CNV_A_R_LINEAR_____123_CM 1 0. -1024. 1023.96875 ECU_ADDRESS 0xd000357e FORMAT "%11.5" /end MEASUREMENT
/begin MEASUREMENT Vxx_is_d_fac "Factor of derivative correction function of Tco and difference between engine and idle speed" UWORD _CNV_A_R_LINEAR_____126_CM 1 0. 0. 7.9990234375 ECU_ADDRESS 0xd0003580 FORMAT "%11.9" /end MEASUREMENT
/begin MEASUREMENT Vxx_max_is_d "Maxmimum saturation of derivative correction" SWORD _CNV_A_R_LINEAR_____123_CM 1 0. -1024. 1023.96875 ECU_ADDRESS 0xd0003582 FORMAT "%11.5" /end MEASUREMENT
/begin MEASUREMENT Vxx_min_is_d "Minimum saturation of derivative correction" SWORD _CNV_A_R_LINEAR_____123_CM 1 0. -1024. 1023.96875 ECU_ADDRESS 0xd0003584 FORMAT "%11.5" /end MEASUREMENT
/begin MEASUREMENT Vxx_mmv_n_dif_drv "Moving mean value of derivative difference between engine and idle speed setpoint" SWORD _CNV_A_R_LINEAR_____23_CM 1 0. -8192. 8191. ECU_ADDRESS 0xd0003586 FORMAT "%5.0" /end MEASUREMENT
/begin MEASUREMENT Vxx_raw_n_dif_drv "Derivative of difference between engine speed and idle speed setpoint by report to the time" SWORD _CNV_A_R_LINEAR_____23_CM 1 0. -8192. 8191. ECU_ADDRESS 0xd0003588 FORMAT "%5.0" /end MEASUREMENT
/begin CHARACTERISTIC Cxx_fac_n_d "Filter factor on moving mean value of derivative difference between engine and idle speed" VALUE 0xa0020a34 _REC_S1VAL_20_u2 65.535 _CNV_A_R_LINEAR_____58_CM 0. 65.535 /end CHARACTERISTIC
/begin CHARACTERISTIC Cxx_is_d_pft_rgn_fac "Derivate correction factor in case of particulate filter regeneration" VALUE 0xa0020a36 _REC_S1VAL_20_u2 2. _CNV_A_R_LINEAR_____125_CM 0. 2. FORMAT "%11.8" /end CHARACTERISTIC
/begin MEASUREMENT Vbx_blk_n "Engine speed hooked above of idle setpoint" UBYTE _CNV_S_2_RANGE______3_CM 1 0. 0. 1. ECU_ADDRESS 0xd00056aa BIT_MASK 0x1 /end MEASUREMENT
/begin MEASUREMENT Vbx_is_blk_n_cdn "All conditions for the detection of engine speed hook are reunited" UBYTE _CNV_S_2_RANGE______3_CM 1 0. 0. 1. ECU_ADDRESS 0xd00056ab BIT_MASK 0x1 /end MEASUREMENT
/begin MEASUREMENT Vbx_is_blk_vh "Detect if vehicle runs without engaged gear" UBYTE _CNV_S_2_RANGE______3_CM 1 0. 0. 1. ECU_ADDRESS 0xd0004379 BIT_MASK 0x1 /end MEASUREMENT
/begin MEASUREMENT Vxx_is_i_zon_out_dly "Temporization of initialization of recognition of exit of engine speed hook" UWORD _CNV_A_R_LINEAR_____34_CM 1 0. 0. 655.35 ECU_ADDRESS 0xc0000b96 FORMAT "%6.2" /end MEASUREMENT
/begin CHARACTERISTIC Cbx_is_blk_vh_run_cfm "Choice to activate the detection of engine speed hook when vehicle runs without engaged gear" VALUE 0xa0021554 _REC_S1VAL_20_u1 1. _CNV_A_R_ECME_LINEA_0_CM 0. 1. FORMAT "%1.0" BIT_MASK 0x1 /end CHARACTERISTIC
/begin CHARACTERISTIC Cbx_on_ac_cor_cfm "Inhibition boolean of the condition on the AC clutch for the detection of a engine speed hook" VALUE 0xa0021555 _REC_S1VAL_20_u1 1. _CNV_A_R_ECME_LINEA_0_CM 0. 1. FORMAT "%1.0" BIT_MASK 0x1 /end CHARACTERISTIC
/begin CHARACTERISTIC Cbx_on_alt_cor_cfm "Inhibition boolean of the condition on the alternator power for the detection of an engine speed hook" VALUE 0xa0021556 _REC_S1VAL_20_u1 1. _CNV_A_R_ECME_LINEA_0_CM 0. 1. FORMAT "%1.0" BIT_MASK 0x1 /end CHARACTERISTIC
/begin CHARACTERISTIC Cbx_on_mdf_cor_cfm "Inhibition boolean of the condition on the flans for the detection of a engine speed hook" VALUE 0xa0021557 _REC_S1VAL_20_u1 1. _CNV_A_R_ECME_LINEA_0_CM 0. 1. FORMAT "%1.0" BIT_MASK 0x1 /end CHARACTERISTIC
/begin CHARACTERISTIC Cbx_on_pwst_cor_cfm "Inhibition boolean of the condition on the power steering  manostat activation for the detection of a engine speed hook" VALUE 0xa0021558 _REC_S1VAL_20_u1 1. _CNV_A_R_ECME_LINEA_0_CM 0. 1. FORMAT "%1.0" BIT_MASK 0x1 /end CHARACTERISTIC
/begin CHARACTERISTIC Cxx_fast_ad_cdn_dly "Delay of initialization of recognition of engine speed hook" VALUE 0xa002154a _REC_S1VAL_20_u2 655.35 _CNV_A_R_LINEAR_____34_CM 0. 655.35 FORMAT "%6.2" /end CHARACTERISTIC
/begin CHARACTERISTIC Cxx_h_blk_is_alt_pow "High theshold on filtered alternator mechanical power to authorize the detection of an engine speed hook" VALUE 0xa002154c _REC_S1VAL_20_u2 655350. _CNV_A_R_LINEAR_____128_CM 0. 655350. FORMAT "%6.0" /end CHARACTERISTIC
/begin CHARACTERISTIC Cxx_is_i_zon_out_dly "Delay of initialization of recognition of exit of engine speed hook" VALUE 0xa002154e _REC_S1VAL_20_u2 655.35 _CNV_A_R_LINEAR_____34_CM 0. 655.35 FORMAT "%6.2" /end CHARACTERISTIC
/begin CHARACTERISTIC Cxx_l_blk_is_alt_pow "Low theshold on filtered alternator mechanical power to authorize the detection of an engine speed hook" VALUE 0xa0021550 _REC_S1VAL_20_u2 655350. _CNV_A_R_LINEAR_____128_CM 0. 655350. FORMAT "%6.0" /end CHARACTERISTIC
/begin CHARACTERISTIC Cxx_min_is_i_ofs "Offset about minimum torque value of idle speed regulator integral correction to detect a engine speed hook" VALUE 0xa0021552 _REC_S1VAL_20_s2 2047.96875 _CNV_A_R_LINEAR_____123_CM -1024. 1023.96875 FORMAT "%11.5" /end CHARACTERISTIC
/begin AXIS_PTS Ctb_is_in_ofs_drv "Breakpoint calibration of thresholds of entry to ISR" 0xa002fec8 Vxx_n_drv_is _REC_A2AXS_20_u2 16383. _CNV_A_R_LINEAR_____129_CM 6 -8192. 8191. FORMAT "%5.0" /end AXIS_PTS
/begin CHARACTERISTIC Ctd_is_in_ofs_drv "Breakpoint calibration of thresholds of entry to ISR" CURVE 0xa002fed8 _REC_A1CUR_20_u2_u2 16383.75 _CNV_A_R_ENSD_LINEA_24_CM 0. 16383.75 FORMAT "%8.2"
 /begin AXIS_DESCR COM_AXIS Vxx_n_drv_is _CNV_A_R_LINEAR_____129_CM 6 -8192. 8191. FORMAT "%5.0" AXIS_PTS_REF Ctb_is_in_ofs_drv /end AXIS_DESCR
/end CHARACTERISTIC
/begin CHARACTERISTIC Ctp_is_in_tco_ofs "Offset function coolant temperature to modify the threshold of entry to ISR" CURVE 0xa002fee4 _REC_A1CUR_20_u2_u2 16383.75 _CNV_A_R_LINEAR_____124_CM -8192. 8191.75 FORMAT "%8.2"
 /begin AXIS_DESCR COM_AXIS Vxx_tco _CNV_A_R_LINEAR_____54_CM 9 -40. 200. FORMAT "%6.1" AXIS_PTS_REF Ctb_is_tco /end AXIS_DESCR
/end CHARACTERISTIC
/begin CHARACTERISTIC Ctp_is_out_sta_dly "Delay to exit of start state to condition state directly (function coolant temperature)" CURVE 0xa002fef8 _REC_A1CUR_20_u2_u2 655.35 _CNV_A_R_LINEAR_____34_CM 0. 655.35 FORMAT "%6.2"
 /begin AXIS_DESCR COM_AXIS Vxx_tco _CNV_A_R_LINEAR_____54_CM 8 -40. 200. FORMAT "%5.1" AXIS_PTS_REF Ctb_sta_tco /end AXIS_DESCR
/end CHARACTERISTIC
/begin CHARACTERISTIC Ctp_sta_off_ofs "Offset (depending coolant temperature) about idle speed setpoint to create start state threshold" CURVE 0xa002ff08 _REC_A1CUR_20_u2_u2 16383.75 _CNV_A_R_LINEAR_____124_CM -8192. 8191.75 FORMAT "%8.2"
 /begin AXIS_DESCR COM_AXIS Vxx_tco _CNV_A_R_LINEAR_____54_CM 8 -40. 200. FORMAT "%5.1" AXIS_PTS_REF Ctb_sta_tco /end AXIS_DESCR
/end CHARACTERISTIC
/begin MEASUREMENT Vbx_is_act "Booleen indicating if ISR calculation is authorised" UBYTE _CNV_S_2_RANGE______3_CM 1 0. 0. 1. ECU_ADDRESS 0xd0004227 BIT_MASK 0x1 /end MEASUREMENT
/begin MEASUREMENT Vbx_old_igk_cut "Flag to detect micro-cut" UBYTE _CNV_S_2_RANGE______3_CM 1 0. 0. 1. ECU_ADDRESS 0xd0004228 BIT_MASK 0x1 /end MEASUREMENT
/begin MEASUREMENT Vbx_sta "Booleen indicating if first entry in ISR after start engine" UBYTE _CNV_S_2_RANGE______3_CM 1 0. 0. 1. ECU_ADDRESS 0xd0004229 BIT_MASK 0x1 /end MEASUREMENT
/begin MEASUREMENT Vsx_is "State variable of idle speed regulation" UBYTE _CNV_A_R_ECME_LINEA_0_CM 1 0. 0. 255. ECU_ADDRESS 0xd000422a FORMAT "%3.0" /end MEASUREMENT
/begin MEASUREMENT Vsx_is_raw "State variable of idle speed regulation without consolidation" UBYTE _CNV_S_6_RANGE_STAT_130_CM 1 0. 2. 64. ECU_ADDRESS 0xd000422b /end MEASUREMENT
/begin MEASUREMENT Vsx_mc "Micro cut detection" UBYTE _CNV_A_R_ECME_LINEA_0_CM 1 0. 0. 1. ECU_ADDRESS 0xd000422c FORMAT "%1.0" /end MEASUREMENT
/begin MEASUREMENT Vxx_is_ast_ofs "Offset (depending coolant temperature) about idle speed setpoint to create after start state threshold" SWORD _CNV_A_R_ENSD_LINEA_24_CM 1 0. -8192. 8191.75 ECU_ADDRESS 0xd000345a FORMAT "%8.2" /end MEASUREMENT
/begin MEASUREMENT Vxx_is_cdn_h_n_dly "Delay after start" UWORD _CNV_A_R_LINEAR_____34_CM 1 0. 0. 655.35 ECU_ADDRESS 0xd000345c FORMAT "%6.2" /end MEASUREMENT
/begin MEASUREMENT Vxx_is_in_deci_dly "Variable that indicates a forced activate state when engine speed is reacher" UWORD _CNV_A_R_LINEAR_____34_CM 1 0. 0. 655.35 ECU_ADDRESS 0xd000345e FORMAT "%6.2" /end MEASUREMENT
/begin MEASUREMENT Vxx_is_in_dly "Interdiction delay to entry in activate idle speed state" UWORD _CNV_A_R_LINEAR_____34_CM 1 0. 0. 655.35 ECU_ADDRESS 0xd0003460 FORMAT "%6.2" /end MEASUREMENT
/begin MEASUREMENT Vxx_is_in_n_thd "Variable of offset about idle speed setpoint to enter in condition state idle speed" UWORD _CNV_A_R_ENSD_LINEA_24_CM 1 0. 0. 16383.75 ECU_ADDRESS 0xd0003462 FORMAT "%8.2" /end MEASUREMENT
/begin MEASUREMENT Vxx_is_n_stab_fac "Anti-pumping factor" UWORD _CNV_A_R_LINEAR_____131_CM 1 0. 0. 1. ECU_ADDRESS 0xd0003464 FORMAT "%6.4" /end MEASUREMENT
/begin MEASUREMENT Vxx_is_out_ast_dly "Delay to fore input in condition idle speed state" UWORD _CNV_A_R_LINEAR_____34_CM 1 0. 0. 655.35 ECU_ADDRESS 0xd0003466 FORMAT "%6.2" /end MEASUREMENT
/begin MEASUREMENT Vxx_is_out_n_thd "Variable of offset about idle speed setpoint to exit of condition idle speed state" UWORD _CNV_A_R_ENSD_LINEA_24_CM 1 0. 0. 16383.75 ECU_ADDRESS 0xd0003468 FORMAT "%8.2" /end MEASUREMENT
/begin MEASUREMENT Vxx_is_out_sta_dly "Delay to exit of start state to condition state directly" UWORD _CNV_A_R_LINEAR_____34_CM 1 0. 0. 655.35 ECU_ADDRESS 0xd000346a FORMAT "%6.2" /end MEASUREMENT
/begin MEASUREMENT Vxx_n_drv_is "derivate of engine speed for idle speed" SWORD _CNV_A_R_LINEAR_____23_CM 1 0. -8192. 8191. ECU_ADDRESS 0xd000346c FORMAT "%5.0" /end MEASUREMENT
/begin MEASUREMENT Vxx_n_drv_sub "Filtred derivate of engine speed for start engine state" SWORD _CNV_A_R_LINEAR_____23_CM 1 0. -8192. 8191. ECU_ADDRESS 0xd000346e FORMAT "%6.0" /end MEASUREMENT
/begin MEASUREMENT Vxx_sta_off_ofs "Offset (depending coolant temperature) about idle speed setpoint to create start state threshold" SWORD _CNV_A_R_ENSD_LINEA_24_CM 1 0. -8192. 8191.75 ECU_ADDRESS 0xd0003470 FORMAT "%8.2" /end MEASUREMENT
/begin CHARACTERISTIC Cbx_tq_trs_ctl_mux_cfm "Consideration of the information intersystem torque request (=0) or no (=1)" VALUE 0xa0021402 _REC_S1VAL_20_u1 1. _CNV_A_R_ECME_LINEA_0_CM 0. 1. FORMAT "%1.0" BIT_MASK 0x1 /end CHARACTERISTIC
/begin CHARACTERISTIC Cxx_ac_is_in_cdn_ofs "Offset on the threshold determined by the derivate of engine speed when the air conditioning compressor is clutched" VALUE 0xa00213be _REC_S1VAL_20_u2 16383.75 _CNV_A_R_ENSD_LINEA_24_CM 0. 16383.75 FORMAT "%8.2" /end CHARACTERISTIC
/begin CHARACTERISTIC Cxx_ac_is_in_cdn_ofs2 "Offset on the threshold determined by the derivate of engine speed when the air conditioning compressor is clutched and when we are not entered in active ISR at the end of a temporization" VALUE 0xa00213c0 _REC_S1VAL_20_u2 16383.75 _CNV_A_R_ENSD_LINEA_24_CM 0. 16383.75 FORMAT "%8.2" /end CHARACTERISTIC
/begin CHARACTERISTIC Cxx_ac_is_in_dly "Delay to enter in activate state after condition state with air conditioning compressor clutched (coming out IS)" VALUE 0xa00213c2 _REC_S1VAL_20_u2 655.35 _CNV_A_R_LINEAR_____34_CM 0. 655.35 FORMAT "%6.2" /end CHARACTERISTIC
/begin CHARACTERISTIC Cxx_ac_is_out_n_ofs "Offset about setpoint to exit condition state when acc is clutch" VALUE 0xa00213c4 _REC_S1VAL_20_u2 16383.75 _CNV_A_R_ENSD_LINEA_24_CM 0. 16383.75 FORMAT "%8.2" /end CHARACTERISTIC
/begin CHARACTERISTIC Cxx_fac_n_drv_d "Derivate filter factor" VALUE 0xa00213c6 _REC_S1VAL_20_u2 65.535 _CNV_A_R_LINEAR_____58_CM 0. 65.535 /end CHARACTERISTIC
/begin CHARACTERISTIC Cxx_fac_n_drv_fil "Derivate filter factor for derivate of engine speed for start engine state" VALUE 0xa00213c8 _REC_S1VAL_20_u2 65.535 _CNV_A_R_LINEAR_____58_CM 0. 65.535 /end CHARACTERISTIC
/begin CHARACTERISTIC Cxx_is_act_ofs "Offset about idle speed setpoint to create activate idle speed state threshold" VALUE 0xa00213ca _REC_S1VAL_20_u2 16383.75 _CNV_A_R_ENSD_LINEA_24_CM 0. 16383.75 FORMAT "%8.2" /end CHARACTERISTIC
/begin CHARACTERISTIC Cxx_is_ast_ofs_zon "Zone of offset about idle speed setpoint to generate a setpoint in after start state" VALUE 0xa00213cc _REC_S1VAL_20_u2 16383.75 _CNV_A_R_ENSD_LINEA_24_CM 0. 16383.75 FORMAT "%8.2" /end CHARACTERISTIC
/begin CHARACTERISTIC Cxx_is_cdn_h_sta_n_dly "Delay after start during threshold to exit condition state is increased" VALUE 0xa00213ce _REC_S1VAL_20_u2 655.35 _CNV_A_R_LINEAR_____34_CM 0. 655.35 FORMAT "%6.2" /end CHARACTERISTIC
/begin CHARACTERISTIC Cxx_is_deci_in_dly "Delay to force activate state when engine speed is reacher" VALUE 0xa00213d0 _REC_S1VAL_20_u2 655.35 _CNV_A_R_LINEAR_____34_CM 0. 655.35 FORMAT "%6.2" /end CHARACTERISTIC
/begin CHARACTERISTIC Cxx_is_deci_in_n_thd "Threshold of engine speed beyond which the strategy of forced entry to ISR is inhibited" VALUE 0xa00213d2 _REC_S1VAL_20_u2 16383.75 _CNV_A_R_ENSD_LINEA_24_CM 0. 16383.75 FORMAT "%8.2" /end CHARACTERISTIC
/begin CHARACTERISTIC Cxx_is_fil_drv_n_max_ofs "Offset of (offset + zone of offset) about idle speed setpoint to generate a setpoint in after start state" VALUE 0xa00213d4 _REC_S1VAL_20_u2 16383.75 _CNV_A_R_ENSD_LINEA_24_CM 0. 16383.75 FORMAT "%8.2" /end CHARACTERISTIC
/begin CHARACTERISTIC Cxx_is_fil_drv_n_min "Threshold of hysteresis on engine speed to authorize a filtred derivate of engine speed" VALUE 0xa00213d6 _REC_S1VAL_20_u2 16383.75 _CNV_A_R_ENSD_LINEA_24_CM 0. 16383.75 FORMAT "%8.2" /end CHARACTERISTIC
/begin CHARACTERISTIC Cxx_is_in_cdn_ofs "Offset on the threshold determined by the derivate of engine speed" VALUE 0xa00213d8 _REC_S1VAL_20_u2 16383.75 _CNV_A_R_ENSD_LINEA_24_CM 0. 16383.75 FORMAT "%8.2" /end CHARACTERISTIC
/begin CHARACTERISTIC Cxx_is_in_cdn_ofs2 "Offset on the threshold determined by the derivate of engine speed when we are not entered in active ISR at the end of a temporization" VALUE 0xa00213da _REC_S1VAL_20_u2 16383.75 _CNV_A_R_ENSD_LINEA_24_CM 0. 16383.75 FORMAT "%8.2" /end CHARACTERISTIC
/begin CHARACTERISTIC Cxx_is_in_dly "Delay to enter in activate state after condition state (coming out IS)" VALUE 0xa00213dc _REC_S1VAL_20_u2 655.35 _CNV_A_R_LINEAR_____34_CM 0. 655.35 FORMAT "%6.2" /end CHARACTERISTIC
/begin CHARACTERISTIC Cxx_is_in_pump_thd "Threshold below control can enter in activate state" VALUE 0xa00213de _REC_S1VAL_20_u2 1. _CNV_A_R_LINEAR_____131_CM 0. 1. FORMAT "%6.4" /end CHARACTERISTIC
/begin CHARACTERISTIC Cxx_is_in_wit_pdl_ofs "Offset about idle speed setpoint to enter in ISR with a powertrain setpoint request" VALUE 0xa00213e0 _REC_S1VAL_20_s2 16383.75 _CNV_A_R_ENSD_LINEA_24_CM -8192. 8191.75 FORMAT "%8.2" /end CHARACTERISTIC
/begin CHARACTERISTIC Cxx_is_n_act "Engine speed threshold under ISR calculation is authorised" VALUE 0xa00213e2 _REC_S1VAL_20_u2 16383.75 _CNV_A_R_ENSD_LINEA_24_CM 0. 16383.75 FORMAT "%8.2" /end CHARACTERISTIC
/begin CHARACTERISTIC Cxx_is_n_act_hys "Engine speed hysteresis to deactivate ISR" VALUE 0xa00213e4 _REC_S1VAL_20_u2 16383.75 _CNV_A_R_ENSD_LINEA_24_CM 0. 16383.75 FORMAT "%8.2" /end CHARACTERISTIC
/begin CHARACTERISTIC Cxx_is_n_stab_clc_fac "Stability engine speed factor in idle speed" VALUE 0xa00213e6 _REC_S1VAL_20_u2 1.998046875e-003 _CNV_A_R_LINEAR_____132_CM 0. 1.998046875e-003 FORMAT "%8.6" /end CHARACTERISTIC
/begin CHARACTERISTIC Cxx_is_n_stab_clc_ini "anti-pumping factor initialisation" VALUE 0xa00213e8 _REC_S1VAL_20_u2 1. _CNV_A_R_LINEAR_____131_CM 0. 1. FORMAT "%6.4" /end CHARACTERISTIC
/begin CHARACTERISTIC Cxx_is_n_stab_drv_thd "Stability derivative engine speed threshold in idle speed" VALUE 0xa00213ea _REC_S1VAL_20_u2 8191. _CNV_A_R_LINEAR_____23_CM 0. 8191. FORMAT "%4.0" /end CHARACTERISTIC
/begin CHARACTERISTIC Cxx_is_out_ast_dly "Delay to enter in condition idle speed state after a start" VALUE 0xa00213ec _REC_S1VAL_20_u2 655.35 _CNV_A_R_LINEAR_____34_CM 0. 655.35 FORMAT "%6.2" /end CHARACTERISTIC
/begin CHARACTERISTIC Cxx_is_out_drv_thd "Threshold about derivate of engine speed to exit of ISR" VALUE 0xa00213ee _REC_S1VAL_20_s2 16383. _CNV_A_R_LINEAR_____23_CM -8192. 8191. FORMAT "%6.0" /end CHARACTERISTIC
/begin CHARACTERISTIC Cxx_is_out_n_ofs "Offset about setpoint to exit condition state" VALUE 0xa00213f0 _REC_S1VAL_20_u2 16383.75 _CNV_A_R_ENSD_LINEA_24_CM 0. 16383.75 FORMAT "%8.2" /end CHARACTERISTIC
/begin CHARACTERISTIC Cxx_is_out_n_ofs_sta "Offset about setpoint to exit activate state" VALUE 0xa00213f2 _REC_S1VAL_20_u2 16383.75 _CNV_A_R_ENSD_LINEA_24_CM 0. 16383.75 FORMAT "%8.2" /end CHARACTERISTIC
/begin CHARACTERISTIC Cxx_is_out_n_run_vh_thd "Threshold about engine speed to exit of ISR (vehicle running)" VALUE 0xa00213f4 _REC_S1VAL_20_u2 16383.75 _CNV_A_R_ENSD_LINEA_24_CM 0. 16383.75 FORMAT "%8.2" /end CHARACTERISTIC
/begin CHARACTERISTIC Cxx_is_out_n_stop_vh_thd "Threshold about engine speed to exit of ISR (vehicle stopped)" VALUE 0xa00213f6 _REC_S1VAL_20_u2 16383.75 _CNV_A_R_ENSD_LINEA_24_CM 0. 16383.75 FORMAT "%8.2" /end CHARACTERISTIC
/begin CHARACTERISTIC Cxx_is_out_pump_thd "Threshold above control can exit of activate state" VALUE 0xa00213f8 _REC_S1VAL_20_u2 1. _CNV_A_R_LINEAR_____131_CM 0. 1. FORMAT "%6.4" /end CHARACTERISTIC
/begin CHARACTERISTIC Cxx_is_out_wit_pdl_ofs "Offset about idle speed setpoint to exit of ISR with a powertrain setpoint request" VALUE 0xa00213fa _REC_S1VAL_20_s2 16383.75 _CNV_A_R_ENSD_LINEA_24_CM -8192. 8191.75 FORMAT "%8.2" /end CHARACTERISTIC
/begin CHARACTERISTIC Cxx_n_drv_ast "Calibration of comparison of the derivate of engine speed for the access Ast - > Cdn" VALUE 0xa00213fc _REC_S1VAL_20_s2 16383. _CNV_A_R_LINEAR_____23_CM -8192. 8191. FORMAT "%6.0" /end CHARACTERISTIC
/begin CHARACTERISTIC Cxx_n_drv_out "Calibration of comparison of the derivate of engine speed for the access Out or Tkof - > Cdn" VALUE 0xa00213fe _REC_S1VAL_20_s2 16383. _CNV_A_R_LINEAR_____23_CM -8192. 8191. FORMAT "%6.0" /end CHARACTERISTIC
/begin CHARACTERISTIC Cxx_sta_stt_is_in_dly "Delay to enter in activate state  after condition state (coming engine start)" VALUE 0xa0021400 _REC_S1VAL_20_u2 655.35 _CNV_A_R_LINEAR_____34_CM 0. 655.35 FORMAT "%6.2" /end CHARACTERISTIC
/begin AXIS_PTS Ctb_is_n_i_dif "Static error breakpoints for idle speed regulator" 0xa002d11c Vxx_dif_n_sp _REC_A2AXS_20_u2 16383.75 _CNV_A_R_LINEAR_____124_CM 8 -8192. 8191.75 FORMAT "%8.2" /end AXIS_PTS
/begin CHARACTERISTIC Cmp_is_i_err_tco_fac "Integral correction factor table dependant on static error and coolant temperature" MAP 0xa002d130 _REC_A1MAP_20_u2_u2_u2 2. _CNV_A_R_LINEAR_____125_CM 0. 2. FORMAT "%11.8"
 /begin AXIS_DESCR COM_AXIS Vxx_dif_n_sp _CNV_A_R_LINEAR_____124_CM 8 -8192. 8191.75 FORMAT "%8.2" AXIS_PTS_REF Ctb_is_n_i_dif /end AXIS_DESCR
 /begin AXIS_DESCR COM_AXIS Vxx_tco _CNV_A_R_LINEAR_____54_CM 9 -40. 200. FORMAT "%6.1" AXIS_PTS_REF Ctb_is_tco /end AXIS_DESCR
/end CHARACTERISTIC
/begin CHARACTERISTIC Cmp_tco_ini_i "Initial Power value of Idle Speed regulator integral correction table" MAP 0xa002d1c0 _REC_A1MAP_20_u2_u1_u2 2047.96875 _CNV_A_R_LINEAR_____127_CM -1024. 1023.96875 FORMAT "%11.5"
 /begin AXIS_DESCR COM_AXIS Vxx_gear _CNV_A_R_LINEAR_____113_CM 8 -1. 6. READ_ONLY FORMAT "%2.0" AXIS_PTS_REF Ntb_gear /end AXIS_DESCR
 /begin AXIS_DESCR COM_AXIS Vxx_tco _CNV_A_R_LINEAR_____54_CM 9 -40. 200. FORMAT "%6.1" AXIS_PTS_REF Ctb_is_tco /end AXIS_DESCR
/end CHARACTERISTIC
/begin CHARACTERISTIC Ctp_is_i_gear_fac "Integral correction factor table dependent on gear ratio" CURVE 0xa002d250 _REC_A1CUR_20_u2_u1 2. _CNV_A_R_LINEAR_____133_CM 0. 2. FORMAT "%7.4"
 /begin AXIS_DESCR COM_AXIS Vxx_gear _CNV_A_R_LINEAR_____113_CM 8 -1. 6. READ_ONLY FORMAT "%2.0" AXIS_PTS_REF Ntb_gear /end AXIS_DESCR
/end CHARACTERISTIC
/begin CHARACTERISTIC Ctp_tco_ini_i_sta "Initial power value of idle speed regulator integral correction table in start state" CURVE 0xa002d260 _REC_A1CUR_20_u2_u2 2047.96875 _CNV_A_R_LINEAR_____127_CM -1024. 1023.96875 FORMAT "%11.5"
 /begin AXIS_DESCR COM_AXIS Vxx_tco _CNV_A_R_LINEAR_____54_CM 8 -40. 200. FORMAT "%5.1" AXIS_PTS_REF Ctb_sta_tco /end AXIS_DESCR
/end CHARACTERISTIC
/begin CHARACTERISTIC Ctp_tco_tqe_max_is_i "Basic value of maximum integral torque correction table" CURVE 0xa002d270 _REC_A1CUR_20_u2_u2 2047.96875 _CNV_A_R_LINEAR_____127_CM -1024. 1023.96875 FORMAT "%11.5"
 /begin AXIS_DESCR COM_AXIS Vxx_tco _CNV_A_R_LINEAR_____54_CM 9 -40. 200. FORMAT "%6.1" AXIS_PTS_REF Ctb_is_tco /end AXIS_DESCR
/end CHARACTERISTIC
/begin MEASUREMENT Vtx_ini_i[0] "Initial torque value of Idle Speed Regulator integral correction" SWORD _CNV_A_R_LINEAR_____123_CM 1 0. -1024. 1023.96875 ECU_ADDRESS 0xd0003328 FORMAT "%11.5" /end MEASUREMENT
/begin MEASUREMENT Vtx_ini_i[1] "Initial torque value of Idle Speed Regulator integral correction" SWORD _CNV_A_R_LINEAR_____123_CM 1 0. -1024. 1023.96875 ECU_ADDRESS 0xd000332a FORMAT "%11.5" /end MEASUREMENT
/begin MEASUREMENT Vxx_is_i_cor "Integral torque correction of Idle Speed Regulator" SWORD _CNV_A_R_LINEAR_____123_CM 1 0. -1024. 1023.96875 ECU_ADDRESS 0xd000332c FORMAT "%11.5" /end MEASUREMENT
/begin MEASUREMENT Vxx_is_i_cor_ini "Initial torque value of idle speed regulator integral  correction" SLONG _CNV_A_R_LINEAR_____134_CM 1 0. -1024. 1023.999996875 ECU_ADDRESS 0xd0001a98 FORMAT "%12.6" /end MEASUREMENT
/begin MEASUREMENT Vxx_is_i_cor_ini_ad "Integral torque correction of Idle Speed Regulator after update with the adaptive torque" SLONG _CNV_A_R_LINEAR_____134_CM 1 0. -1024. 1023.999996875 ECU_ADDRESS 0xd0001a9c FORMAT "%12.6" /end MEASUREMENT
/begin MEASUREMENT Vxx_is_i_cor_prev "Integral torque correction of Idle Speed Regulator" SLONG _CNV_A_R_LINEAR_____134_CM 1 0. -1024. 1023.999996875 ECU_ADDRESS 0xd0001aa0 FORMAT "%12.6" /end MEASUREMENT
/begin MEASUREMENT Vxx_is_i_cor_wio_set "Integral torque correction of Idle Speed Regulator without ti fix integral correction under certain conditions" SLONG _CNV_A_R_LINEAR_____134_CM 1 0. -1024. 1023.999996875 ECU_ADDRESS 0xd0001aa4 FORMAT "%12.6" /end MEASUREMENT
/begin MEASUREMENT Vxx_is_i_cor_wit_set "Integral torque correction of Idle Speed Regulator with fix integral correction under certain conditions" SLONG _CNV_A_R_LINEAR_____134_CM 1 0. -1024. 1023.999996875 ECU_ADDRESS 0xd0001aa8 FORMAT "%12.6" /end MEASUREMENT
/begin MEASUREMENT Vxx_is_i_fac "Current integral correction factor for Idle Speed regulator" UWORD _CNV_A_R_LINEAR_____133_CM 1 0. 0. 55.9990234375 ECU_ADDRESS 0xd000332e FORMAT "%7.4" /end MEASUREMENT
/begin MEASUREMENT Vxx_is_i_out_fil "Decrementation integral correction when idle speed regulation is disable" SLONG _CNV_A_R_LINEAR_____134_CM 1 0. -1024. 1023.999996875 ECU_ADDRESS 0xd0001aac FORMAT "%12.6" /end MEASUREMENT
/begin MEASUREMENT Vxx_is_n_is_i "Engine speed threshold to decrease or increase integral" UWORD _CNV_A_R_ENSD_LINEA_24_CM 1 0. 0. 16383.75 ECU_ADDRESS 0xd0003330 FORMAT "%8.2" /end MEASUREMENT
/begin MEASUREMENT Vxx_is_n_is_i_grd "Torque gradient to decrease or increase the integral" UWORD _CNV_A_R_LINEAR_____135_CM 1 0. 0. 7.9998779296875 ECU_ADDRESS 0xd0003332 FORMAT "%4.2" /end MEASUREMENT
/begin MEASUREMENT Vxx_max_is_i "Maximum torque value of idle speed regulator integral  correction" SWORD _CNV_A_R_LINEAR_____123_CM 1 0. -1024. 1023.96875 ECU_ADDRESS 0xd0003334 FORMAT "%11.5" /end MEASUREMENT
/begin MEASUREMENT Vxx_min_is_i "Minimum torque value of idle speed regulator integral  correction" SWORD _CNV_A_R_LINEAR_____123_CM 1 0. -1024. 1023.96875 ECU_ADDRESS 0xc0000bdc FORMAT "%11.5" /end MEASUREMENT
/begin MEASUREMENT Vxx_min_is_i_wio_blk "Minimum torque value of idle speed regulator integral  correction without the offset in case of blocked engine speed" SWORD _CNV_A_R_LINEAR_____123_CM 1 0. -1024. 1023.96875 ECU_ADDRESS 0xc0000bde FORMAT "%11.5" /end MEASUREMENT
/begin MEASUREMENT Vxx_tqe_ini_i "Initial Value of Idle Speed regulator integral torque correction (in ast and cdn states)" SLONG _CNV_A_R_LINEAR_____134_CM 1 0. -1024. 1023.999996875 ECU_ADDRESS 0xd0001ab0 FORMAT "%12.6" /end MEASUREMENT
/begin CHARACTERISTIC Cbx_i_set_is_cfm "Switch allowing to choose between a constant integral or a calculated integral on a brake pedal" VALUE 0xa0020dfa _REC_S1VAL_20_u1 1. _CNV_A_R_ECME_LINEA_0_CM 0. 1. FORMAT "%1.0" BIT_MASK 0x1 /end CHARACTERISTIC
/begin CHARACTERISTIC Cbx_ini_i_tco_cfm "Switch allowing to choose between an initialization of integral correction function of the losses or function of (Tco, gear ratio)" VALUE 0xa0020dfb _REC_S1VAL_20_u1 1. _CNV_A_R_ECME_LINEA_0_CM 0. 1. FORMAT "%1.0" BIT_MASK 0x1 /end CHARACTERISTIC
/begin CHARACTERISTIC Cbx_is_cdn_i_act_cfm "Boolean authorizing the integral correction to regulate in the start phase and in state Cdn of ISR" VALUE 0xa0020dfc _REC_S1VAL_20_u1 1. _CNV_A_R_ECME_LINEA_0_CM 0. 1. FORMAT "%1.0" BIT_MASK 0x1 /end CHARACTERISTIC
/begin CHARACTERISTIC Cbx_is_int_ftc_n_cfm "Switch to decrease the integral according to the engine speed" VALUE 0xa0020dfd _REC_S1VAL_20_u1 1. _CNV_A_R_ECME_LINEA_0_CM 0. 1. FORMAT "%1.0" BIT_MASK 0x1 /end CHARACTERISTIC
/begin CHARACTERISTIC Cxx_blk_n_i_fac_cor "Factor on integral torque correction in case of blocked engine speed" VALUE 0xa0020dd8 _REC_S1VAL_20_u2 6.99 _CNV_A_R_LINEAR_____136_CM 0. 6.99 FORMAT "%6.2" /end CHARACTERISTIC
/begin CHARACTERISTIC Cxx_blk_n_min_is_i "Offset on minimum integral torque correction in case of blocked engine speed" VALUE 0xa0020dda _REC_S1VAL_20_u2 1. _CNV_A_R_LINEAR_____108_CM 0. 1. /end CHARACTERISTIC
/begin CHARACTERISTIC Cxx_fil_is_i_sp "Value of progressive return of the integral correction torque in Out ISR state" VALUE 0xa0020ddc _REC_S1VAL_20_s2 2047.96875 _CNV_A_R_LINEAR_____123_CM -1024. 1023.96875 FORMAT "%11.5" /end CHARACTERISTIC
/begin CHARACTERISTIC Cxx_ini_i_fac "Factor on the losses to estimate the couple of initialization of the integral torque" VALUE 0xa0020dde _REC_S1VAL_20_u2 1. _CNV_A_R_LINEAR_____108_CM 0. 1. FORMAT "%5.3" /end CHARACTERISTIC
/begin CHARACTERISTIC Cxx_is_i_out_fil_fac "Filtering factor of filtered integral correction" VALUE 0xa0020de0 _REC_S1VAL_20_u2 1. _CNV_A_R_LINEAR_____125_CM 0. 1. FORMAT "%11.9" /end CHARACTERISTIC
/begin CHARACTERISTIC Cxx_is_i_out_fil_wit_pdl_fac "Filtering factor of filtered integral correction without powertrain setpoint request" VALUE 0xa0020de2 _REC_S1VAL_20_u2 1. _CNV_A_R_LINEAR_____125_CM 0. 1. FORMAT "%11.8" /end CHARACTERISTIC
/begin CHARACTERISTIC Cxx_is_i_pft_rgn_fac "Integral correction factor in case of particulate filter regeneration" VALUE 0xa0020de4 _REC_S1VAL_20_u2 2. _CNV_A_R_LINEAR_____125_CM 0. 2. FORMAT "%11.8" /end CHARACTERISTIC
/begin CHARACTERISTIC Cxx_is_i_set_ofs "Engine speed threshold for fixed integral correction" VALUE 0xa0020de6 _REC_S1VAL_20_s2 16383.75 _CNV_A_R_ENSD_LINEA_24_CM -8192. 8191.75 FORMAT "%8.2" /end CHARACTERISTIC
/begin CHARACTERISTIC Cxx_is_i_tq_trs_ctl_mux_n_in "Engine speed threshold to fix integral correction under inter-system request" VALUE 0xa0020de8 _REC_S1VAL_20_s2 16383.75 _CNV_A_R_ENSD_LINEA_24_CM -8192. 8191.75 FORMAT "%8.2" /end CHARACTERISTIC
/begin CHARACTERISTIC Cxx_is_i_tq_trs_ctl_mux_n_out "Engine speed threshold to stop fixed integral correction under inter-system request" VALUE 0xa0020dea _REC_S1VAL_20_s2 16383.75 _CNV_A_R_ENSD_LINEA_24_CM -8192. 8191.75 FORMAT "%8.2" /end CHARACTERISTIC
/begin CHARACTERISTIC Cxx_is_n_max_is_i "Engine speed threshold to decrease the positive integral" VALUE 0xa0020dec _REC_S1VAL_20_u2 16383.75 _CNV_A_R_ENSD_LINEA_24_CM 0. 16383.75 FORMAT "%8.2" /end CHARACTERISTIC
/begin CHARACTERISTIC Cxx_is_n_max_is_i_grd "Torque gradient to decrease the integral" VALUE 0xa0020dee _REC_S1VAL_20_u2 7.9998779296875 _CNV_A_R_LINEAR_____135_CM 0. 7.9998779296875 FORMAT "%4.2" /end CHARACTERISTIC
/begin CHARACTERISTIC Cxx_is_n_min_is_i "Engine speed threshold to increase the negative integral" VALUE 0xa0020df0 _REC_S1VAL_20_u2 16383.75 _CNV_A_R_ENSD_LINEA_24_CM 0. 16383.75 FORMAT "%8.2" /end CHARACTERISTIC
/begin CHARACTERISTIC Cxx_is_n_min_is_i_grd "Torque gradient to increase the integral" VALUE 0xa0020df2 _REC_S1VAL_20_u2 7.9998779296875 _CNV_A_R_LINEAR_____135_CM 0. 7.9998779296875 FORMAT "%4.2" /end CHARACTERISTIC
/begin CHARACTERISTIC Cxx_vh_run_max_is_i_ofs "Offset on the maximum saturation if the vehicle is running" VALUE 0xa0020df4 _REC_S1VAL_20_s2 2047.96875 _CNV_A_R_LINEAR_____123_CM -1024. 1023.96875 FORMAT "%11.5" /end CHARACTERISTIC
/begin CHARACTERISTIC Cxx_vh_run_min_is_i_fac "Factor of the losses to estimate the maximum saturation if the vehicle is running" VALUE 0xa0020df6 _REC_S1VAL_20_u2 1. _CNV_A_R_LINEAR_____108_CM 0. 1. /end CHARACTERISTIC
/begin CHARACTERISTIC Cxx_vh_stop_min_is_i_fac "Factor of the losses to estimate the minimum saturation if the vehicle is stopped" VALUE 0xa0020df8 _REC_S1VAL_20_u2 1. _CNV_A_R_LINEAR_____108_CM 0. 1. /end CHARACTERISTIC
/begin AXIS_PTS Ctb_is_n_p_dif "Static error breakpoints for idle speed regulator (case proportional)" 0xa002b914 Vxx_dif_n_sp _REC_A2AXS_20_u2 16383.75 _CNV_A_R_LINEAR_____124_CM 8 -8192. 8191.75 FORMAT "%8.2" /end AXIS_PTS
/begin CHARACTERISTIC Cmp_is_p_err_tco_fac "Proportionnal correction factor table dependant on static error and coolant temperature" MAP 0xa002b928 _REC_A1MAP_20_u2_u2_u2 2. _CNV_A_R_LINEAR_____125_CM 0. 2. FORMAT "%11.8"
 /begin AXIS_DESCR COM_AXIS Vxx_dif_n_sp _CNV_A_R_LINEAR_____124_CM 8 -8192. 8191.75 FORMAT "%8.2" AXIS_PTS_REF Ctb_is_n_p_dif /end AXIS_DESCR
 /begin AXIS_DESCR COM_AXIS Vxx_tco _CNV_A_R_LINEAR_____54_CM 9 -40. 200. FORMAT "%6.1" AXIS_PTS_REF Ctb_is_tco /end AXIS_DESCR
/end CHARACTERISTIC
/begin CHARACTERISTIC Ctp_is_p_gear_fac "Proportionnal correction factor table dependant on gear ratio" CURVE 0xa002b9b8 _REC_A1CUR_20_u2_u1 2. _CNV_A_R_LINEAR_____137_CM 0. 2. FORMAT "%11.9"
 /begin AXIS_DESCR COM_AXIS Vxx_gear _CNV_A_R_LINEAR_____113_CM 8 -1. 6. READ_ONLY FORMAT "%2.0" AXIS_PTS_REF Ntb_gear /end AXIS_DESCR
/end CHARACTERISTIC
/begin CHARACTERISTIC Ctp_is_p_max "Maximum proportionnal torque correction Table dependent on coolant temperature" CURVE 0xa002b9c8 _REC_A1CUR_20_u2_u2 2047.96875 _CNV_A_R_LINEAR_____127_CM -1024. 1023.96875 FORMAT "%11.5"
 /begin AXIS_DESCR COM_AXIS Vxx_tco _CNV_A_R_LINEAR_____54_CM 9 -40. 200. FORMAT "%6.1" AXIS_PTS_REF Ctb_is_tco /end AXIS_DESCR
/end CHARACTERISTIC
/begin CHARACTERISTIC Ctp_is_p_min "Minimum proportionnal torque correction Table dependent on coolant temperature" CURVE 0xa002b9dc _REC_A1CUR_20_u2_u2 2047.96875 _CNV_A_R_LINEAR_____127_CM -1024. 1023.96875 FORMAT "%11.5"
 /begin AXIS_DESCR COM_AXIS Vxx_tco _CNV_A_R_LINEAR_____54_CM 9 -40. 200. FORMAT "%6.1" AXIS_PTS_REF Ctb_is_tco /end AXIS_DESCR
/end CHARACTERISTIC
/begin CHARACTERISTIC Ctp_is_p_sta_fac "Proportionnal Starting correction factor table dependent on Gear ratio and regulator (IS) static er" CURVE 0xa002b9f0 _REC_A1CUR_20_u2_u2 7.9990234375 _CNV_A_R_LINEAR_____137_CM 0. 7.9990234375 FORMAT "%10.7"
 /begin AXIS_DESCR COM_AXIS Vxx_tco _CNV_A_R_LINEAR_____54_CM 8 -40. 200. FORMAT "%5.1" AXIS_PTS_REF Ctb_sta_tco /end AXIS_DESCR
/end CHARACTERISTIC
/begin MEASUREMENT Vtx_is_p_fac[0] "Current proportionnal correction factor" UWORD _CNV_A_R_LINEAR_____137_CM 1 0. 0. 7.9990234375 ECU_ADDRESS 0xd000303c FORMAT "%12.9" /end MEASUREMENT
/begin MEASUREMENT Vtx_is_p_fac[1] "Current proportionnal correction factor" UWORD _CNV_A_R_LINEAR_____137_CM 1 0. 0. 7.9990234375 ECU_ADDRESS 0xd000303e FORMAT "%12.9" /end MEASUREMENT
/begin MEASUREMENT Vxx_dif_n_sp "" SWORD _CNV_A_R_ENSD_LINEA_24_CM 1 0. -8192. 8191.75 ECU_ADDRESS 0xd0003040 FORMAT "%8.2" /end MEASUREMENT
/begin MEASUREMENT Vxx_is_gear "Gear engaged" UBYTE _CNV_A_R_LINEAR_____113_CM 1 0. -1. 6. ECU_ADDRESS 0xd0004ee9 FORMAT "%2.0" /end MEASUREMENT
/begin MEASUREMENT Vxx_is_p_cor "Proportional correction" SWORD _CNV_A_R_LINEAR_____123_CM 1 0. -1024. 1023.96875 ECU_ADDRESS 0xd0003042 FORMAT "%11.5" /end MEASUREMENT
/begin MEASUREMENT Vxx_max_is_p "Maximum proportionnal torque correction" SWORD _CNV_A_R_LINEAR_____123_CM 1 0. -1024. 1023.96875 ECU_ADDRESS 0xd0003044 FORMAT "%11.5" /end MEASUREMENT
/begin MEASUREMENT Vxx_min_is_p "Minimum proportionnal torque correction" SWORD _CNV_A_R_LINEAR_____123_CM 1 0. -1024. 1023.96875 ECU_ADDRESS 0xd0003046 FORMAT "%11.5" /end MEASUREMENT
/begin CHARACTERISTIC Cbx_tq_trs_ctl_mux_p_cfm "For minimal proportional saturation, consideration of the information intersystem torque request (=1) or no (=0)" VALUE 0xa0020ab6 _REC_S1VAL_20_u1 1. _CNV_A_R_ECME_LINEA_0_CM 0. 1. FORMAT "%1.0" BIT_MASK 0x1 /end CHARACTERISTIC
/begin CHARACTERISTIC Cxx_is_ctl_mux_min_p "Minimum proportional torque correction when an intersystem torque request is in progress" VALUE 0xa0020aac _REC_S1VAL_20_s2 2047.96875 _CNV_A_R_LINEAR_____123_CM -1024. 1023.96875 FORMAT "%11.5" /end CHARACTERISTIC
/begin CHARACTERISTIC Cxx_is_p_dec_slop "Value of the decrease slop for proportional correction" VALUE 0xa0020aae _REC_S1VAL_20_u2 2047.96875 _CNV_A_R_LINEAR_____138_CM -2047.96875 0. FORMAT "%8.2" /end CHARACTERISTIC
/begin CHARACTERISTIC Cxx_is_p_inc_slop "Value of the increase slop for proportional correction" VALUE 0xa0020ab0 _REC_S1VAL_20_u2 2047.96875 _CNV_A_R_LINEAR_____139_CM 0. 2047.96875 FORMAT "%7.2" /end CHARACTERISTIC
/begin CHARACTERISTIC Cxx_is_p_pft_rgn_fac "Proportionnal correction factor in case of particulate filter regeneration" VALUE 0xa0020ab2 _REC_S1VAL_20_u2 2. _CNV_A_R_LINEAR_____125_CM 0. 2. FORMAT "%11.8" /end CHARACTERISTIC
/begin CHARACTERISTIC Cxx_is_p_sta_max "Maximum proportionnal torque correction for the Start state" VALUE 0xa0020ab4 _REC_S1VAL_20_s2 2047.96875 _CNV_A_R_LINEAR_____123_CM -1024. 1023.96875 FORMAT "%11.5" /end CHARACTERISTIC
/begin MEASUREMENT Vbx_tkof_vs_ena "Active the take off" UBYTE _CNV_S_2_RANGE______3_CM 1 0. 0. 1. ECU_ADDRESS 0xd0004a95 BIT_MASK 0x1 /end MEASUREMENT
/begin CHARACTERISTIC Cxx_tkof_ena_vs_thd "Threshold of vehicle speed to enter in take off state" VALUE 0xa0021c3a _REC_S1VAL_20_u2 655.35 _CNV_A_R_LINEAR_____70_CM 0. 655.35 FORMAT "%6.2" /end CHARACTERISTIC
/begin CHARACTERISTIC Cxx_tkof_end_vs_thd "Threshold of vehicle speed to exit of take off state" VALUE 0xa0021c3c _REC_S1VAL_20_u2 655.35 _CNV_A_R_LINEAR_____70_CM 0. 655.35 FORMAT "%6.2" /end CHARACTERISTIC
/begin CHARACTERISTIC Cxx_tkof_n_grd_end_thd "derivate of engine speed threshold for take off" VALUE 0xa0021c3e _REC_S1VAL_20_s2 16383. _CNV_A_R_LINEAR_____23_CM -8192. 8191. FORMAT "%5.0" /end CHARACTERISTIC
/begin CHARACTERISTIC Cxx_tkof_vs_n_rat_stop_thd "Threshold of vehicle and engine speed ratio to exit of take off state" VALUE 0xa0021c40 _REC_S1VAL_20_u2 210. _CNV_A_R_LINEAR_____140_CM -10. 200. FORMAT "%6.2" /end CHARACTERISTIC
/begin AXIS_PTS Ctb_is_n_dif "Static error breakpoints for idle speed regulator" 0xa00282b4 Vxx_dif_n_sp _REC_A2AXS_20_u2 16383.75 _CNV_A_R_LINEAR_____124_CM 8 -8192. 8191.75 FORMAT "%8.2" /end AXIS_PTS
/begin CHARACTERISTIC Ctp_raw_p_d_fac "Percentage of P torque and D torque considered for the calculation of the raw torque" CURVE 0xa00282c8 _REC_A1CUR_20_u2_u2 1. _CNV_A_R_LINEAR_____125_CM 0. 1. FORMAT "%11.9"
 /begin AXIS_DESCR COM_AXIS Vxx_dif_n_sp _CNV_A_R_LINEAR_____124_CM 8 -8192. 8191.75 FORMAT "%8.2" AXIS_PTS_REF Ctb_is_n_dif /end AXIS_DESCR
/end CHARACTERISTIC
/begin MEASUREMENT Vxx_is_tqe_raw "Raw idle speed torque" SWORD _CNV_A_R_LINEAR_____123_CM 1 0. -1024. 1023.96875 ECU_ADDRESS 0xd0002d5e FORMAT "%11.5" /end MEASUREMENT
/begin MEASUREMENT Vxx_is_tqe_sp "Setpoint idle speed torque" SWORD _CNV_A_R_LINEAR_____123_CM 1 0. -1024. 1023.96875 ECU_ADDRESS 0xd0002d60 FORMAT "%11.5" /end MEASUREMENT
/begin MEASUREMENT Vxx_is_tqe_tgt "Target idle speed torque" SWORD _CNV_A_R_LINEAR_____123_CM 1 0. -1024. 1023.96875 ECU_ADDRESS 0xd0002d62 FORMAT "%11.5" /end MEASUREMENT
/begin MEASUREMENT Vxx_raw_raw_is_tqe "Raw raw idle speed torque" SWORD _CNV_A_R_LINEAR_____123_CM 1 0. -1024. 1023.96875 ECU_ADDRESS 0xd0002d64 FORMAT "%11.5" /end MEASUREMENT
/begin MEASUREMENT Vxx_raw_sp_is_tqe "Raw idle speed torque" SWORD _CNV_A_R_LINEAR_____123_CM 1 0. -1024. 1023.96875 ECU_ADDRESS 0xd0002d66 FORMAT "%11.5" /end MEASUREMENT
/begin MEASUREMENT Vxx_raw_tgt_is_tqe "Raw idle speed torque" SWORD _CNV_A_R_LINEAR_____123_CM 1 0. -1024. 1023.96875 ECU_ADDRESS 0xd0002d68 FORMAT "%11.5" /end MEASUREMENT
/begin CHARACTERISTIC Cbx_cdn_is_fil_tgt_cfm "Switch allowing to initialize the filtering (to obtain the raw an couple) in Cdn state" VALUE 0xa0020a48 _REC_S1VAL_20_u1 1. _CNV_A_R_ECME_LINEA_0_CM 0. 1. FORMAT "%1.0" BIT_MASK 0x1 /end CHARACTERISTIC
/begin CHARACTERISTIC Cbx_tq_pow_is_cfm "Switch allowing to choose between torques or their equivalence in power" VALUE 0xa0020a49 _REC_S1VAL_20_u1 1. _CNV_A_R_ECME_LINEA_0_CM 0. 1. FORMAT "%1.0" BIT_MASK 0x1 /end CHARACTERISTIC
/begin CHARACTERISTIC Cxx_is_tgt_ftc "Raw torque filter factor" VALUE 0xa0020a3e _REC_S1VAL_20_u2 65.535 _CNV_A_R_LINEAR_____58_CM 0. 65.535 /end CHARACTERISTIC
/begin CHARACTERISTIC Cxx_is_tgt_ftc_dec_slop "Decrement slop to raw torque filter factor" VALUE 0xa0020a40 _REC_S1VAL_20_u2 655.35 _CNV_A_R_LINEAR_____141_CM -655.35 0. FORMAT "%7.2" /end CHARACTERISTIC
/begin CHARACTERISTIC Cxx_is_tgt_ftc_inc_slop "Increment slop to raw torque filter factor" VALUE 0xa0020a42 _REC_S1VAL_20_u2 655.35 _CNV_A_R_LINEAR_____142_CM 0. 655.35 FORMAT "%6.2" /end CHARACTERISTIC
/begin CHARACTERISTIC Cxx_mfld_dly_dec_slop "Decrement slop to manifold time constant" VALUE 0xa0020a44 _REC_S1VAL_20_u2 655.35 _CNV_A_R_LINEAR_____141_CM -655.35 0. FORMAT "%7.2" /end CHARACTERISTIC
/begin CHARACTERISTIC Cxx_mfld_dly_inc_slop "Increment slop to manifold time constant" VALUE 0xa0020a46 _REC_S1VAL_20_u2 655.35 _CNV_A_R_LINEAR_____142_CM 0. 655.35 FORMAT "%6.2" /end CHARACTERISTIC
/begin MEASUREMENT Vbx_is_ad_cdn "All the conditions for the calculation of the adaptive are reunited" UBYTE _CNV_S_2_RANGE______3_CM 1 0. 0. 1. ECU_ADDRESS 0xd00052b9 BIT_MASK 0x1 /end MEASUREMENT
/begin MEASUREMENT Vxx_fil_is_i_cor "Filtered integral torque correction" SLONG _CNV_A_R_LINEAR_____134_CM 1 0. -1024. 1023.999996875 ECU_ADDRESS 0xd00018f0 FORMAT "%12.6" /end MEASUREMENT
/begin MEASUREMENT Vxx_fil_is_i_cor_ad "Filtered integral torque correction after update with the adaptive torque" SLONG _CNV_A_R_LINEAR_____134_CM 1 0. -1024. 1023.999996875 ECU_ADDRESS 0xd00018f4 FORMAT "%12.6" /end MEASUREMENT
/begin MEASUREMENT Vxx_fil_is_i_cor_ad_last "Filtered integral torque correction after update with the adaptive torque (one step of delay)" SLONG _CNV_A_R_LINEAR_____134_CM 1 0. -1024. 1023.999996875 ECU_ADDRESS 0xd00018f8 FORMAT "%12.6" /end MEASUREMENT
/begin MEASUREMENT Vxx_is_ad_tq_ini "Initialization of adaptive correction " SLONG _CNV_A_R_LINEAR_____134_CM 1 0. -1024. 1023.999996875 ECU_ADDRESS 0xd0002abc FORMAT "%12.6" /end MEASUREMENT
/begin MEASUREMENT Vxx_is_ad_tq_last "Adaptive correction" SLONG _CNV_A_R_LINEAR_____134_CM 1 0. -1024. 1023.999996875 ECU_ADDRESS 0xd0002ac0 FORMAT "%12.6" /end MEASUREMENT
/begin MEASUREMENT Vxx_is_ad_tq_raw "Adaptive correction" SLONG _CNV_A_R_LINEAR_____134_CM 1 0. -1024. 1023.999996875 ECU_ADDRESS 0xd0002ac4 FORMAT "%12.6" /end MEASUREMENT
/begin CHARACTERISTIC Cbx_is_ad_mdf_cfm "Authorize to calculate the adaptive torque when the flans turn" VALUE 0xa0020d36 _REC_S1VAL_20_u1 1. _CNV_A_R_ECME_LINEA_0_CM 0. 1. FORMAT "%1.0" BIT_MASK 0x1 /end CHARACTERISTIC
/begin CHARACTERISTIC Cxx_ac_pow "Maximum AC power to authorize calculation of adaptive torque" VALUE 0xa0020d1e _REC_S1VAL_20_u2 655350. _CNV_A_R_LINEAR_____128_CM 0. 655350. FORMAT "%6.0" /end CHARACTERISTIC
/begin CHARACTERISTIC Cxx_ad_cor_dsb_dly "Delay of interdiction to learn adaptive torque after start" VALUE 0xa0020d20 _REC_S1VAL_20_u2 655.35 _CNV_A_R_LINEAR_____34_CM 0. 655.35 FORMAT "%6.2" /end CHARACTERISTIC
/begin CHARACTERISTIC Cxx_dri_agb_ad_is_fil "Filtering factor for the calculation of the adaptive torque if automatic transmissionis in drive" VALUE 0xa0020d22 _REC_S1VAL_20_u2 1. _CNV_A_R_LINEAR_____93_CM 0. 1. FORMAT "%10.9" /end CHARACTERISTIC
/begin CHARACTERISTIC Cxx_h_ad_is_alt_pow "High threshold on filtered alternator mechanical power to authorize the calculation of the adaptive torque" VALUE 0xa0020d24 _REC_S1VAL_20_u2 655350. _CNV_A_R_LINEAR_____128_CM 0. 655350. FORMAT "%6.0" /end CHARACTERISTIC
/begin CHARACTERISTIC Cxx_is_ad_tq_dft "First value and default calibration of adaptive correction torque about erasing authorization after a clear diag info request from the" VALUE 0xa0020fd6 _REC_S1VAL_20_s2 2047.96875 _CNV_A_R_LINEAR_____123_CM -1024. 1023.96875 FORMAT "%11.5" /end CHARACTERISTIC
/begin CHARACTERISTIC Cxx_is_i_fil_fac1 "Filtering factor of integral torque if integral torque superior to filtered integral torque correction update by adaptive torque" VALUE 0xa0020d26 _REC_S1VAL_20_u2 1. _CNV_A_R_LINEAR_____93_CM 0. 1. FORMAT "%11.9" /end CHARACTERISTIC
/begin CHARACTERISTIC Cxx_is_i_fil_fac2 "Filtering factor of integral torque if integral torque inferior to filtered integral torque correction update by adaptive torque update by adaptive torque" VALUE 0xa0020d28 _REC_S1VAL_20_u2 1. _CNV_A_R_LINEAR_____93_CM 0. 1. FORMAT "%11.9" /end CHARACTERISTIC
/begin CHARACTERISTIC Cxx_l_ad_is_alt_pow "Low threshold on filtered alternator mechanical power to authorize the calculation of the adaptive torque" VALUE 0xa0020d2a _REC_S1VAL_20_u2 655350. _CNV_A_R_LINEAR_____128_CM 0. 655350. FORMAT "%6.0" /end CHARACTERISTIC
/begin CHARACTERISTIC Cxx_max_is_ad_tq "Maximum of adaptive correction" VALUE 0xa0020d2c _REC_S1VAL_20_s2 2047.96875 _CNV_A_R_LINEAR_____123_CM -1024. 1023.96875 FORMAT "%11.5" /end CHARACTERISTIC
/begin CHARACTERISTIC Cxx_max_n_ad_sp_dif "Difference between engine speed and idle speed setpoint to authorize calculation of adaptive torque" VALUE 0xa0020d2e _REC_S1VAL_20_u2 16383.75 _CNV_A_R_LINEAR_____124_CM -8192. 8191.75 FORMAT "%8.2" /end CHARACTERISTIC
/begin CHARACTERISTIC Cxx_min_is_ad_tq "Minimum of adaptive correction" VALUE 0xa0020d30 _REC_S1VAL_20_s2 2047.96875 _CNV_A_R_LINEAR_____123_CM -1024. 1023.96875 FORMAT "%11.5" /end CHARACTERISTIC
/begin CHARACTERISTIC Cxx_min_tco_ad_cor "Minimum engine coolant temperature to authorize calculation of adaptive torque" VALUE 0xa0020d32 _REC_S1VAL_20_u2 240. _CNV_A_R_LINEAR_____54_CM -40. 200. FORMAT "%5.1" /end CHARACTERISTIC
/begin CHARACTERISTIC Cxx_neut_ad_is_fil "Filtering factor for the calculation of the adaptive torque if automatic or mechanical transmission is in neutral" VALUE 0xa0020d34 _REC_S1VAL_20_u2 1. _CNV_A_R_LINEAR_____93_CM 0. 1. FORMAT "%10.9" /end CHARACTERISTIC
/begin AXIS_PTS Ctb_n_dif_tkof "engine speed difference breakpoints table for take off" 0xa0025ab4 NO_INPUT_QUANTITY _REC_A2AXS_20_u2 16383.75 _CNV_A_R_ENSD_LINEA_24_CM 5 0. 16383.75 FORMAT "%8.2" /end AXIS_PTS
/begin AXIS_PTS Ctb_n_drv_tkof "breakpoints table of derivative of engine speed difference for take off" 0xa0025ac0 NO_INPUT_QUANTITY _REC_A2AXS_20_u2 16383. _CNV_A_R_LINEAR_____129_CM 5 -8192. 8191. FORMAT "%5.0" /end AXIS_PTS
/begin AXIS_PTS Ctb_n_tkof "engine speed breakpoints for take off" 0xa0025acc NO_INPUT_QUANTITY _REC_A2AXS_20_u2 16383.75 _CNV_A_R_ENSD_LINEA_24_CM 5 0. 16383.75 FORMAT "%8.2" /end AXIS_PTS
/begin CHARACTERISTIC Ctp_n_dif_tkof_p "gain of proportionnal controller for take off" CURVE 0xa0025ad8 _REC_A1CUR_20_u2_u2 0.2 _CNV_A_R_LINEAR_____143_CM -0.1 0.1 FORMAT "%8.5"
 /begin AXIS_DESCR COM_AXIS NO_INPUT_QUANTITY _CNV_A_R_ENSD_LINEA_24_CM 5 0. 16383.75 FORMAT "%8.2" AXIS_PTS_REF Ctb_n_dif_tkof /end AXIS_DESCR
/end CHARACTERISTIC
/begin CHARACTERISTIC Ctp_n_drv_tkof_d "gain of derivative correction for take off" CURVE 0xa0025ae4 _REC_A1CUR_20_u2_u2 0.2 _CNV_A_R_LINEAR_____143_CM -0.1 0.1 FORMAT "%8.5"
 /begin AXIS_DESCR COM_AXIS NO_INPUT_QUANTITY _CNV_A_R_LINEAR_____129_CM 5 -8192. 8191. FORMAT "%5.0" AXIS_PTS_REF Ctb_n_drv_tkof /end AXIS_DESCR
/end CHARACTERISTIC
/begin CHARACTERISTIC Ctp_n_tkof_d "factor on derivate controler for take off" CURVE 0xa002085a _REC_A1CUR_20_u1_u2 0.99609375 _CNV_A_R_LINEAR_____31_CM 0. 0.99609375 FORMAT "%10.8"
 /begin AXIS_DESCR COM_AXIS NO_INPUT_QUANTITY _CNV_A_R_ENSD_LINEA_24_CM 5 0. 16383.75 FORMAT "%8.2" AXIS_PTS_REF Ctb_n_tkof /end AXIS_DESCR
/end CHARACTERISTIC
/begin CHARACTERISTIC Ctp_n_tkof_p "factor on proportionnal controller for take off" CURVE 0xa0020860 _REC_A1CUR_20_u1_u2 0.99609375 _CNV_A_R_LINEAR_____31_CM 0. 0.99609375 FORMAT "%10.8"
 /begin AXIS_DESCR COM_AXIS NO_INPUT_QUANTITY _CNV_A_R_ENSD_LINEA_24_CM 5 0. 16383.75 FORMAT "%8.2" AXIS_PTS_REF Ctb_n_tkof /end AXIS_DESCR
/end CHARACTERISTIC
/begin MEASUREMENT Vbx_tkof_tq_cor_ena "enable take off torque correction" UBYTE _CNV_S_2_RANGE______3_CM 1 0. 0. 1. ECU_ADDRESS 0xd0004ce7 BIT_MASK 0x1 /end MEASUREMENT
/begin MEASUREMENT Vxx_tkof_d_cor "derivative take off correction" SWORD _CNV_A_R_LINEAR_____123_CM 1 0. -1024. 1023.96875 ECU_ADDRESS 0xd000386c FORMAT "%11.5" /end MEASUREMENT
/begin MEASUREMENT Vxx_tkof_p_cor "proportionnal take off correction" SWORD _CNV_A_R_LINEAR_____123_CM 1 0. -1024. 1023.96875 ECU_ADDRESS 0xd000386e FORMAT "%11.5" /end MEASUREMENT
/begin MEASUREMENT Vxx_tkof_tqe_cor "take off torque correction" SWORD _CNV_A_R_LINEAR_____123_CM 1 0. -1024. 1023.96875 ECU_ADDRESS 0xd0003870 FORMAT "%11.5" /end MEASUREMENT
/begin CHARACTERISTIC Cxx_ct_stop_tkof_ftc "filtering time constant for take off torque in exit of activation conditions." VALUE 0xa002086e _REC_S1VAL_20_u1 2.55 _CNV_A_R_LINEAR_____34_CM 0. 2.55 FORMAT "%4.2" /end CHARACTERISTIC
/begin CHARACTERISTIC Cxx_stop_tkof_ftc "filtering time constant for take off torque in exit of activation conditions." VALUE 0xa002086f _REC_S1VAL_20_u1 2.55 _CNV_A_R_LINEAR_____34_CM 0. 2.55 FORMAT "%4.2" /end CHARACTERISTIC
/begin CHARACTERISTIC Cxx_tkof_tq_d_max "maximum derivative take off correction" VALUE 0xa0020866 _REC_S1VAL_20_s2 2047.96875 _CNV_A_R_LINEAR_____123_CM -1024. 1023.96875 FORMAT "%11.5" /end CHARACTERISTIC
/begin CHARACTERISTIC Cxx_tkof_tq_d_min "minimum derivative take off correction" VALUE 0xa0020868 _REC_S1VAL_20_s2 2047.96875 _CNV_A_R_LINEAR_____123_CM -1024. 1023.96875 FORMAT "%11.5" /end CHARACTERISTIC
/begin CHARACTERISTIC Cxx_tkof_tq_p_max "maximum proportionnal take off correction" VALUE 0xa002086a _REC_S1VAL_20_s2 2047.96875 _CNV_A_R_LINEAR_____123_CM -1024. 1023.96875 FORMAT "%11.5" /end CHARACTERISTIC
/begin CHARACTERISTIC Cxx_tkof_tq_p_min "minimum proportionnal take off correction" VALUE 0xa002086c _REC_S1VAL_20_s2 2047.96875 _CNV_A_R_LINEAR_____123_CM -1024. 1023.96875 FORMAT "%11.5" /end CHARACTERISTIC
/begin MEASUREMENT Vbx_is_fac_cho "Boolean allowing to fall over on specific PID coefficients" UBYTE _CNV_S_2_RANGE______3_CM 1 0. 0. 1. ECU_ADDRESS 0xd0004401 BIT_MASK 0x1 /end MEASUREMENT
/begin MEASUREMENT Vbx_is_loop_diag_cfm "Idle Speed loop diagnosis configuration" UBYTE _CNV_S_2_RANGE______3_CM 1 0. 0. 1. ECU_ADDRESS 0xd00052b8 BIT_MASK 0x1 /end MEASUREMENT
/begin CHARACTERISTIC Cbx_is_loop_diag_cfm "Choice of Idle Speed loop diagnosis configuration" VALUE 0xa0020b8c _REC_S1VAL_20_u1 1. _CNV_A_R_ECME_LINEA_0_CM 0. 1. FORMAT "%1.0" BIT_MASK 0x1 /end CHARACTERISTIC
/begin CHARACTERISTIC Ctp_aut_eng_n_thd "Table of engine speed threshold used to declare the autonomous state" CURVE 0xa0026264 _REC_A1CUR_20_u2_u2 16383.75 _CNV_A_R_ENSD_LINEA_24_CM 0. 16383.75 FORMAT "%8.2"
 /begin AXIS_DESCR COM_AXIS Vxx_tco _CNV_A_R_LINEAR_____54_CM 9 -40. 200. FORMAT "%5.1" AXIS_PTS_REF Ctb_tco2 /end AXIS_DESCR
/end CHARACTERISTIC
/begin CHARACTERISTIC Ctp_sta_dly "Table of driven delay function of the coolant temperature" CURVE 0xa0026278 _REC_A1CUR_20_u2_u2 655.35 _CNV_A_R_LINEAR_____34_CM 0. 655.35 FORMAT "%6.2"
 /begin AXIS_DESCR COM_AXIS Vxx_tco _CNV_A_R_LINEAR_____54_CM 9 -40. 200. FORMAT "%5.1" AXIS_PTS_REF Ctb_tco2 /end AXIS_DESCR
/end CHARACTERISTIC
/begin MEASUREMENT Vbx_trs_eng_aut "Transition used to past in the autonomous state" UBYTE _CNV_S_2_RANGE______3_CM 1 0. 0. 1. ECU_ADDRESS 0xd0004b2e BIT_MASK 0x1 /end MEASUREMENT
/begin MEASUREMENT Vsx_eng "Engine states" UBYTE _CNV_A_R_ECME_LINEA_0_CM 1 0. 0. 255. ECU_ADDRESS 0xd0004b2f FORMAT "%3.0" /end MEASUREMENT
/begin MEASUREMENT Vsx_prev_eng "Previous engine states" UBYTE _CNV_A_R_ECME_LINEA_0_CM 1 0. 0. 255. ECU_ADDRESS 0xd0004b30 FORMAT "%3.0" /end MEASUREMENT
/begin CHARACTERISTIC Cxx_aut_eng_n_thd_h "Engine speed threshold used to declare the autonomous engine state" VALUE 0xa0021dee _REC_S1VAL_20_u2 16383.75 _CNV_A_R_ENSD_LINEA_24_CM 0. 16383.75 FORMAT "%8.2" /end CHARACTERISTIC
/begin CHARACTERISTIC Cxx_drvn_eng_n_thd_h "High threshold of engine speed used to initialize the timer" VALUE 0xa0021df0 _REC_S1VAL_20_u2 16383.75 _CNV_A_R_ENSD_LINEA_24_CM 0. 16383.75 FORMAT "%8.2" /end CHARACTERISTIC
/begin CHARACTERISTIC Cxx_drvn_eng_n_thd_l "Low threshold of engine speed used to initialize the timer" VALUE 0xa0021df2 _REC_S1VAL_20_u2 16383.75 _CNV_A_R_ENSD_LINEA_24_CM 0. 16383.75 FORMAT "%8.2" /end CHARACTERISTIC
/begin MEASUREMENT Vbx_frst_sta_done "" UBYTE _CNV_S_2_RANGE______3_CM 1 0. 0. 1. DISPLAY_IDENTIFIER SmStaSpv_NVM.Vbx_frst_sta_done_NVM ECU_ADDRESS 0xd0004612 BIT_MASK 0x1 /end MEASUREMENT
/begin MEASUREMENT Vbx_clu_stal "" UBYTE _CNV_S_2_RANGE______3_CM 1 0. 0. 1. DISPLAY_IDENTIFIER SmStaSpv_NVM.Vbx_clu_stal_NVM ECU_ADDRESS 0xd0004613 BIT_MASK 0x1 /end MEASUREMENT
/begin MEASUREMENT Vbx_swlk_stal "" UBYTE _CNV_S_2_RANGE______3_CM 1 0. 0. 1. DISPLAY_IDENTIFIER SmStaSpv_NVM.Vbx_swlk_stal_NVM ECU_ADDRESS 0xd0004614 BIT_MASK 0x1 /end MEASUREMENT
/begin MEASUREMENT Vbx_mem_swlk "" UBYTE _CNV_S_2_RANGE______3_CM 1 0. 0. 1. DISPLAY_IDENTIFIER SmStaSpv_NVM.Vbx_mem_swlk_NVM ECU_ADDRESS 0xd0004615 BIT_MASK 0x1 /end MEASUREMENT
/begin MEASUREMENT Vbx_df_actr_rly_oc "Open Circuit of actuators relay detected failure" UBYTE _CNV_S_2_RANGE______3_CM 1 0. 0. 1. ECU_ADDRESS 0xd0003fb3 BIT_MASK 0x1 /end MEASUREMENT
/begin MEASUREMENT Vbx_df_actr_rly_scg "Short Circuit to Ground of actuators relay detected failure" UBYTE _CNV_S_2_RANGE______3_CM 1 0. 0. 1. ECU_ADDRESS 0xd0003fb4 BIT_MASK 0x1 /end MEASUREMENT
/begin MEASUREMENT Vbx_df_actr_rly_scw "Short Circuit to battery of actuators relay detected failure" UBYTE _CNV_S_2_RANGE______3_CM 1 0. 0. 1. ECU_ADDRESS 0xd0003fb5 BIT_MASK 0x1 /end MEASUREMENT
/begin MEASUREMENT Vbx_df_pws_1_h "Power supply 1 voltage above max threshold detected failure" UBYTE _CNV_S_2_RANGE______3_CM 1 0. 0. 1. ECU_ADDRESS 0xd0003fbb BIT_MASK 0x1 /end MEASUREMENT
/begin MEASUREMENT Vbx_df_pws_1_l "Power supply 1 voltage below min threshold detected failure" UBYTE _CNV_S_2_RANGE______3_CM 1 0. 0. 1. ECU_ADDRESS 0xd0003fbc BIT_MASK 0x1 /end MEASUREMENT
/begin MEASUREMENT Vbx_df_pws_2_h "Power supply 2 voltage above max threshold detected failure" UBYTE _CNV_S_2_RANGE______3_CM 1 0. 0. 1. ECU_ADDRESS 0xd0003fbd BIT_MASK 0x1 /end MEASUREMENT
/begin MEASUREMENT Vbx_df_pws_2_l "Power supply 2 voltage below min threshold detected failure" UBYTE _CNV_S_2_RANGE______3_CM 1 0. 0. 1. ECU_ADDRESS 0xd0003fbe BIT_MASK 0x1 /end MEASUREMENT
/begin MEASUREMENT Vbx_df_pws_3_h "Power supply 3 voltage above max threshold detected failure" UBYTE _CNV_S_2_RANGE______3_CM 1 0. 0. 1. ECU_ADDRESS 0xd0003fbf BIT_MASK 0x1 /end MEASUREMENT
/begin MEASUREMENT Vbx_df_pws_3_l "Power supply 3 voltage below min threshold detected failure" UBYTE _CNV_S_2_RANGE______3_CM 1 0. 0. 1. ECU_ADDRESS 0xd0003fc0 BIT_MASK 0x1 /end MEASUREMENT
/begin MEASUREMENT Vbx_diag_ena_actr_rly_oc "Open Circuit of actuators relay diagnosis information available" UBYTE _CNV_S_2_RANGE______3_CM 1 0. 0. 1. ECU_ADDRESS 0xd0003fb6 BIT_MASK 0x1 /end MEASUREMENT
/begin MEASUREMENT Vbx_diag_ena_actr_rly_scg "Short Circuit to Ground of actuators relay diagnosis information available" UBYTE _CNV_S_2_RANGE______3_CM 1 0. 0. 1. ECU_ADDRESS 0xd0003fb7 BIT_MASK 0x1 /end MEASUREMENT
/begin MEASUREMENT Vbx_diag_ena_actr_rly_scw "Short Circuit to battery of actuators relay diagnosis information available" UBYTE _CNV_S_2_RANGE______3_CM 1 0. 0. 1. ECU_ADDRESS 0xd0003fb8 BIT_MASK 0x1 /end MEASUREMENT
/begin MEASUREMENT Vbx_diag_ena_pws_1_h "Diagnosis condition for diagnosis pws_1 high level" UBYTE _CNV_S_2_RANGE______3_CM 1 0. 0. 1. ECU_ADDRESS 0xd0003fc1 BIT_MASK 0x1 /end MEASUREMENT
/begin MEASUREMENT Vbx_diag_ena_pws_1_l "Diagnosis condition for diagnosis pws_1 low level" UBYTE _CNV_S_2_RANGE______3_CM 1 0. 0. 1. ECU_ADDRESS 0xd0003fc2 BIT_MASK 0x1 /end MEASUREMENT
/begin MEASUREMENT Vbx_diag_ena_pws_2_h "Diagnosis condition for diagnosis pws_2 high level" UBYTE _CNV_S_2_RANGE______3_CM 1 0. 0. 1. ECU_ADDRESS 0xd0003fc3 BIT_MASK 0x1 /end MEASUREMENT
/begin MEASUREMENT Vbx_diag_ena_pws_2_l "Diagnosis condition for diagnosis pws_2 low level" UBYTE _CNV_S_2_RANGE______3_CM 1 0. 0. 1. ECU_ADDRESS 0xd0003fc4 BIT_MASK 0x1 /end MEASUREMENT
/begin MEASUREMENT Vbx_diag_ena_pws_3_h "Diagnosis condition for diagnosis pws_3 high level" UBYTE _CNV_S_2_RANGE______3_CM 1 0. 0. 1. ECU_ADDRESS 0xd0003fc5 BIT_MASK 0x1 /end MEASUREMENT
/begin MEASUREMENT Vbx_diag_ena_pws_3_l "Diagnosis condition for diagnosis pws_3 low level" UBYTE _CNV_S_2_RANGE______3_CM 1 0. 0. 1. ECU_ADDRESS 0xd0003fc6 BIT_MASK 0x1 /end MEASUREMENT
/begin MEASUREMENT Vbx_ecu_rst "Flag indicating that a ECU reset has occured during the trip." UBYTE _CNV_S_2_RANGE______3_CM 1 0. 0. 1. ECU_ADDRESS 0xd0003fca BIT_MASK 0x1 /end MEASUREMENT
/begin MEASUREMENT Vbx_pws3_cfm "Boolean indicating a third power supply present at ECU ignition" UBYTE _CNV_S_2_RANGE______3_CM 1 0. 0. 1. ECU_ADDRESS 0xd0003fcb BIT_MASK 0x1 /end MEASUREMENT
/begin MEASUREMENT Vxx_raw_pws_1 "Sensors power supply 1 voltage raw acquisition" UWORD _CNV_A_R_LINEAR_____52_CM 1 0. 0. 25000. ECU_ADDRESS 0xd0003056 FORMAT "%5.0" /end MEASUREMENT
/begin MEASUREMENT Vxx_raw_pws_2 "Sensors power supply 2 voltage raw acquisition" UWORD _CNV_A_R_LINEAR_____52_CM 1 0. 0. 25000. ECU_ADDRESS 0xd0003058 FORMAT "%5.0" /end MEASUREMENT
/begin MEASUREMENT Vxx_raw_pws_3 "Sensors power supply 3 voltage raw acquisition" UWORD _CNV_A_R_LINEAR_____52_CM 1 0. 0. 25000. ECU_ADDRESS 0xd000305a FORMAT "%5.0" /end MEASUREMENT
/begin MEASUREMENT lv_err_vcc_1 "error flag for diagnosis instance Vcc_1" UBYTE _CNV_S_2_RANGE______3_CM 1 0. 0. 1. ECU_ADDRESS 0xd0003fc7 /end MEASUREMENT
/begin MEASUREMENT lv_err_vcc_2 "eroor flag for diagnosis instance Vcc_2" UBYTE _CNV_S_2_RANGE______3_CM 1 0. 0. 1. ECU_ADDRESS 0xd0003fc8 /end MEASUREMENT
/begin MEASUREMENT lv_err_vcc_3 "eroor flag for diagnosis instance Vcc_3" UBYTE _CNV_S_2_RANGE______3_CM 1 0. 0. 1. ECU_ADDRESS 0xd0003fc9 /end MEASUREMENT
/begin MEASUREMENT lv_main_rly_pwl "Flag which indicates if main Relay is stuck to 12V" UBYTE _CNV_S_2_RANGE______3_CM 1 0. 0. 1. ECU_ADDRESS 0xd0007e14 BIT_MASK 0x1 /end MEASUREMENT
/begin MEASUREMENT lv_main_rly_pwl_2 "This flag is a copy of lv_main_rly_pwl" UBYTE _CNV_S_2_RANGE______3_CM 1 0. 0. 1. ECU_ADDRESS 0xd0007e16 BIT_MASK 0x1 /end MEASUREMENT
/begin MEASUREMENT lv_mu_inh_pwl_tran_es_el "LV request to shut off MU, \"point of no return\" for ECU shut down" UBYTE _CNV_S_2_RANGE______3_CM 1 0. 0. 1. ECU_ADDRESS 0xd0003fb2 BIT_MASK 0x1 /end MEASUREMENT
/begin MEASUREMENT lv_pwl_rst_wdt_asw "Power latch phase is ended: beginning of system shutdown mechanism" UBYTE _CNV_S_2_RANGE______3_CM 1 0. 0. 1. ECU_ADDRESS 0xd0003fb9 BIT_MASK 0x1 /end MEASUREMENT
/begin MEASUREMENT lv_pwl_unlock_cdn_asw "Main relay control command state (0H=relay shall be switched off, 1H= relay shall be switched on)" UBYTE _CNV_S_2_RANGE______3_CM 1 0. 0. 1. ECU_ADDRESS 0xd0003fba BIT_MASK 0x1 /end MEASUREMENT
/begin MEASUREMENT lv_rly_main "Main relay control command state (0H=relay shall be switched off, 1H= relay shall be switched on)" UBYTE _CNV_S_2_RANGE______3_CM 1 0. 0. 1. ECU_ADDRESS 0xd0003fb1 BIT_MASK 0x1 /end MEASUREMENT
/begin MEASUREMENT t_main_rly_pwl "Time used for the main relay diagnostic" UWORD _CNV_A_R_LINEAR_____144_CM 1 0. 0. 65535. ECU_ADDRESS 0xd0003c4c FORMAT "%5.0" /end MEASUREMENT
/begin CHARACTERISTIC Cbx_pws3_cfm "3rd power supply present" VALUE 0xa00211a2 _REC_S1VAL_20_u1 1. _CNV_S_2_RANGE______3_CM 0. 1. /end CHARACTERISTIC
/begin CHARACTERISTIC lc_rly_main_pwl_on "Logical calibration to activate main relay diag" VALUE 0xa00211e7 _REC_S1VAL_20_u1 1. _CNV_A_R_ECME_LINEA_0_CM 0. 1. FORMAT "%1.0" /end CHARACTERISTIC
/begin MEASUREMENT Vxx_sens_map_v "Raw acquisition of the manifold pressure" UWORD _CNV_A_R_LINEAR_____52_CM 1 0. 0. 25000. ECU_ADDRESS 0xd0003884 FORMAT "%5.0" /end MEASUREMENT
/begin MEASUREMENT Vxx_sens_spg_v "Raw acquisition of the supercharging pressure" UWORD _CNV_A_R_LINEAR_____52_CM 1 0. 0. 25000. ECU_ADDRESS 0xd0003880 FORMAT "%5.0" /end MEASUREMENT
/begin MEASUREMENT lv_err_map "MAP sensor error detected" UBYTE _CNV_S_2_RANGE______3_CM 1 0. 0. 1. ECU_ADDRESS 0xd00046f7 BIT_MASK 0x1 /end MEASUREMENT
/begin MEASUREMENT vp_map_max "Maximum manifold air pressure per segment in voltage" UWORD _CNV_A_R_LINEAR_____16_CM 1 0. 0. 4.99984741210938 ECU_ADDRESS 0xd0003888 FORMAT "%6.4" /end MEASUREMENT
/begin MEASUREMENT vp_map_max_inter "Internal maximum manifold air pressure per segment in voltage" UWORD _CNV_A_R_LINEAR_____16_CM 1 0. 0. 4.99984741210938 ECU_ADDRESS 0xd0003d04 FORMAT "%6.4" /end MEASUREMENT
/begin MEASUREMENT vp_map_min "Minimum manifold air pressure per segment in voltage" UWORD _CNV_A_R_LINEAR_____16_CM 1 0. 0. 4.99984741210938 ECU_ADDRESS 0xd000388a FORMAT "%6.4" /end MEASUREMENT
/begin MEASUREMENT vp_map_min_inter "Internal minimum manifold air pressure per segment in voltage" UWORD _CNV_A_R_LINEAR_____16_CM 1 0. 0. 4.99984741210938 ECU_ADDRESS 0xd0003d06 FORMAT "%6.4" /end MEASUREMENT
/begin MEASUREMENT vp_map_mv "Mean value Voltage of the intake manifold pressure sensor (for diagnosis)" UWORD _CNV_A_R_LINEAR_____16_CM 1 0. 0. 4.99984741210938 ECU_ADDRESS 0xd000388c FORMAT "%6.4" /end MEASUREMENT
/begin MEASUREMENT vp_put_mv "Mean value Voltage of the pressure upstream throttle" UWORD _CNV_A_R_LINEAR_____16_CM 1 0. 0. 4.99984741210938 ECU_ADDRESS 0xd000388e FORMAT "%6.4" /end MEASUREMENT
/begin CHARACTERISTIC Cxx_hw_ftc "Hardware filter time constant" VALUE 0xa002113e _REC_S1VAL_20_u2 65535. _CNV_A_R_LINEAR_____145_CM 0. 65535. FORMAT "%5.0" /end CHARACTERISTIC
/begin CHARACTERISTIC c_vp_map_mv_max_diag "Threshold value VP_MAP_MV to detect Short circuit in signal wire to VB" VALUE 0xa0021186 _REC_S1VAL_20_u2 4.99984741210938 _CNV_A_R_LINEAR_____16_CM 0. 4.99984741210938 FORMAT "%6.4" /end CHARACTERISTIC
/begin CHARACTERISTIC c_vp_map_mv_min_diag "Threshold value VP_MAP_MV to detect Short circuit in signal wire to earth or wire break" VALUE 0xa0021188 _REC_S1VAL_20_u2 4.99984741210938 _CNV_A_R_LINEAR_____16_CM 0. 4.99984741210938 FORMAT "%6.4" /end CHARACTERISTIC
/begin CHARACTERISTIC c_vp_put_mv_max_diag "Threshold value VP_PUT_MV to detect Short circuit in signal wire to VB" VALUE 0xa002118a _REC_S1VAL_20_u2 4.99984741210938 _CNV_A_R_LINEAR_____16_CM 0. 4.99984741210938 FORMAT "%6.4" /end CHARACTERISTIC
/begin CHARACTERISTIC c_vp_put_mv_min_diag "Threshold value VP_PUT_MV to detect Short circuit in signal wire to earth or wire break" VALUE 0xa002118c _REC_S1VAL_20_u2 4.99984741210938 _CNV_A_R_LINEAR_____16_CM 0. 4.99984741210938 FORMAT "%6.4" /end CHARACTERISTIC
/begin AXIS_PTS Ntb_n_spg_fil_ftc "9 breakpoints for theinterpolated filtering factor setpoint." 0xa002ac54 Vxx_n _REC_A2AXS_20_u2 16383.75 _CNV_A_R_ENSD_LINEA_24_CM 9 0. 16383.75 READ_ONLY FORMAT "%8.2" /end AXIS_PTS
/begin CHARACTERISTIC Ctp_n_spg_fil_ftc "Interpolated filtering factor depending on the driving regime" CURVE 0xa002ac68 _REC_A1CUR_20_u2_u2 65.535 _CNV_A_R_LINEAR_____58_CM 0. 65.535 FORMAT "%5.3"
 /begin AXIS_DESCR COM_AXIS Vxx_n _CNV_A_R_ENSD_LINEA_24_CM 9 0. 16383.75 READ_ONLY FORMAT "%8.2" AXIS_PTS_REF Ntb_n_spg_fil_ftc /end AXIS_DESCR
/end CHARACTERISTIC
/begin MEASUREMENT Vbx_df_sens_spg_h "Boost pressure sensor high signal detected failure" UBYTE _CNV_S_2_RANGE______3_CM 1 0. 0. 1. ECU_ADDRESS 0xd00046f3 BIT_MASK 0x1 /end MEASUREMENT
/begin MEASUREMENT Vbx_df_sens_spg_l "Boost pressure sensor low signal detected failure" UBYTE _CNV_S_2_RANGE______3_CM 1 0. 0. 1. ECU_ADDRESS 0xd00046f4 BIT_MASK 0x1 /end MEASUREMENT
/begin MEASUREMENT Vbx_diag_ena_sens_spg_h "Boost pressure sensor high signal diagnostic information available" UBYTE _CNV_S_2_RANGE______3_CM 1 0. 0. 1. ECU_ADDRESS 0xd00046f5 BIT_MASK 0x1 /end MEASUREMENT
/begin MEASUREMENT Vbx_diag_ena_sens_spg_l "Boost pressure sensor low signal diagnostic information available" UBYTE _CNV_S_2_RANGE______3_CM 1 0. 0. 1. ECU_ADDRESS 0xd00046f6 BIT_MASK 0x1 /end MEASUREMENT
/begin MEASUREMENT Vbx_run_spg "flag indicating a running engine" UBYTE _CNV_S_2_RANGE______3_CM 1 0. 0. 1. ECU_ADDRESS 0xd00055bc BIT_MASK 0x1 /end MEASUREMENT
/begin MEASUREMENT Vbx_stop_spg "flag indicating a stopped engine" UBYTE _CNV_S_2_RANGE______3_CM 1 0. 0. 1. ECU_ADDRESS 0xd00055bd BIT_MASK 0x1 /end MEASUREMENT
/begin MEASUREMENT Vxx_raw_sens_spg "raw boost pressure from sensor" UWORD _CNV_A_R_LINEAR_____57_CM 1 0. 0. 20000. ECU_ADDRESS 0xd0005b0a FORMAT "%5.0" /end MEASUREMENT
/begin MEASUREMENT Vxx_raw_sens_spg_v_stop "acquisitions of the manifold pressure stopped engine" UWORD _CNV_A_R_LINEAR_____52_CM 1 0. 0. 25000. ECU_ADDRESS 0xd0005b0c FORMAT "%5.0" /end MEASUREMENT
/begin MEASUREMENT Vxx_raw_sens_spg_v_sum "Sum of the last three raw filtered acquisitions of the manifold pressure running engine" UWORD _CNV_A_R_LINEAR_____52_CM 1 0. 0. 65535. ECU_ADDRESS 0xd0002b7c FORMAT "%5.0" /end MEASUREMENT
/begin MEASUREMENT Vxx_spg_fil_ftc "Filtering factor for the manifold pressure acquisition" UWORD _CNV_A_R_LINEAR_____58_CM 1 0. 0. 65.535 ECU_ADDRESS 0xd0005b0e FORMAT "%5.3" /end MEASUREMENT
/begin CHARACTERISTIC Cxx_spg_fac "Earning of conversion of the measured ratio metric measure in supercharging pressure" VALUE 0xa0021dc4 _REC_S1VAL_20_u2 20000. _CNV_A_R_LINEAR_____57_CM 0. 20000. FORMAT "%5.0" /end CHARACTERISTIC
/begin CHARACTERISTIC Cxx_spg_ofs "Distance between the transfer function offset of the spg the reference of 103 hPa" VALUE 0xa0021dc6 _REC_S1VAL_20_s2 20000. _CNV_A_R_LINEAR_____57_CM -10000. 10000. FORMAT "%5.0" /end CHARACTERISTIC
/begin AXIS_PTS Ntb_n_map_fil_ftc "9 breakpoints for theinterpolated filtering factor setpoint." 0xa002e6b0 Vxx_n _REC_A2AXS_20_u2 16383.75 _CNV_A_R_ENSD_LINEA_24_CM 9 0. 16383.75 READ_ONLY FORMAT "%8.2" /end AXIS_PTS
/begin CHARACTERISTIC Ctp_n_map_fil_ftc "Interpolated filtering factor depending on the driving regime" CURVE 0xa002e6c4 _REC_A1CUR_20_u2_u2 65.535 _CNV_A_R_LINEAR_____58_CM 0. 65.535 FORMAT "%5.3"
 /begin AXIS_DESCR COM_AXIS Vxx_n _CNV_A_R_ENSD_LINEA_24_CM 9 0. 16383.75 READ_ONLY FORMAT "%8.2" AXIS_PTS_REF Ntb_n_map_fil_ftc /end AXIS_DESCR
/end CHARACTERISTIC
/begin MEASUREMENT Vbx_df_sens_map_h "Manifold pressure sensor high signal detected failure" UBYTE _CNV_S_2_RANGE______3_CM 1 0. 0. 1. ECU_ADDRESS 0xd00046ef BIT_MASK 0x1 /end MEASUREMENT
/begin MEASUREMENT Vbx_df_sens_map_l "Manifold pressure sensor low signal detected failure" UBYTE _CNV_S_2_RANGE______3_CM 1 0. 0. 1. ECU_ADDRESS 0xd00046f0 BIT_MASK 0x1 /end MEASUREMENT
/begin MEASUREMENT Vbx_diag_ena_sens_map_h "Manifold pressure sensor high signal diagnostic information available" UBYTE _CNV_S_2_RANGE______3_CM 1 0. 0. 1. ECU_ADDRESS 0xd00046f1 BIT_MASK 0x1 /end MEASUREMENT
/begin MEASUREMENT Vbx_diag_ena_sens_map_l "Manifold pressure sensor low signal diagnostic information available" UBYTE _CNV_S_2_RANGE______3_CM 1 0. 0. 1. ECU_ADDRESS 0xd00046f2 BIT_MASK 0x1 /end MEASUREMENT
/begin MEASUREMENT Vbx_run_map "flag indicating a running engine" UBYTE _CNV_S_2_RANGE______3_CM 1 0. 0. 1. ECU_ADDRESS 0xd00056f8 BIT_MASK 0x1 /end MEASUREMENT
/begin MEASUREMENT Vbx_stop_map "flag indicating a stopped engine" UBYTE _CNV_S_2_RANGE______3_CM 1 0. 0. 1. ECU_ADDRESS 0xd00056f9 BIT_MASK 0x1 /end MEASUREMENT
/begin MEASUREMENT Vxx_map_fil_ftc "Filtering factor for the manifold pressure acquisition" UWORD _CNV_A_R_LINEAR_____58_CM 1 0. 0. 65.535 ECU_ADDRESS 0xd000584c FORMAT "%5.3" /end MEASUREMENT
/begin MEASUREMENT Vxx_raw_sens_map "Raw_manifold pressure from sensor" UWORD _CNV_A_R_LINEAR_____57_CM 1 0. 0. 20000. ECU_ADDRESS 0xd000584e FORMAT "%5.0" /end MEASUREMENT
/begin MEASUREMENT Vxx_raw_sens_map_v_stop "acquisitions of the manifold pressure stopped engine" UWORD _CNV_A_R_LINEAR_____52_CM 1 0. 0. 25000. ECU_ADDRESS 0xd0005850 FORMAT "%5.0" /end MEASUREMENT
/begin MEASUREMENT Vxx_raw_sens_map_v_sum "Sum of the last three raw filtered acquisitions of the manifold pressure running engine" UWORD _CNV_A_R_LINEAR_____52_CM 1 0. 0. 65535. ECU_ADDRESS 0xd0002c54 FORMAT "%5.0" /end MEASUREMENT
/begin CHARACTERISTIC Cxx_map_fac "Conversion gain of the measured sens map information into pressure" VALUE 0xa0021584 _REC_S1VAL_20_u2 20000. _CNV_A_R_LINEAR_____57_CM 0. 20000. FORMAT "%5.0" /end CHARACTERISTIC
/begin CHARACTERISTIC Cxx_map_ofs "Distance between the offset of the transfer function of the pressure sensor and the reference of 103" VALUE 0xa0021586 _REC_S1VAL_20_s2 20000. _CNV_A_R_LINEAR_____57_CM -10000. 10000. FORMAT "%6.0" /end CHARACTERISTIC
/begin AXIS_PTS ldpm_vp_tia_1_airt "" 0xa002c33c vp_tia[0] _REC_A2AXS_20_u2 4.99984741210938 _CNV_A_R_LINEAR_____16_CM 16 0. 4.99984741210938 FORMAT "%6.4" /end AXIS_PTS
/begin CHARACTERISTIC ip_tia_mes "Intake temperature linear table" CURVE 0xa002d10c _REC_A1CUR_20_u1_u2 190.5 _CNV_A_R_LINEAR_____42_CM -48. 142.5 FORMAT "%6.2"
 /begin AXIS_DESCR COM_AXIS vp_tia[0] _CNV_A_R_LINEAR_____16_CM 16 0. 4.99984741210938 FORMAT "%6.4" AXIS_PTS_REF ldpm_vp_tia_1_airt /end AXIS_DESCR
/end CHARACTERISTIC
/begin MEASUREMENT Vbx_df_sens_mat_h "Manifold air temperature sensor high signal detected failure" UBYTE _CNV_S_2_RANGE______3_CM 1 0. 0. 1. ECU_ADDRESS 0xd000462c BIT_MASK 0x1 /end MEASUREMENT
/begin MEASUREMENT Vbx_df_sens_mat_l "Manifold air temperature sensor low signal detected failure." UBYTE _CNV_S_2_RANGE______3_CM 1 0. 0. 1. ECU_ADDRESS 0xd000462b BIT_MASK 0x1 /end MEASUREMENT
/begin MEASUREMENT Vbx_diag_ena_sens_mat_h "Manifold air temperature sensor high signal diagnosis information available." UBYTE _CNV_S_2_RANGE______3_CM 1 0. 0. 1. ECU_ADDRESS 0xd000462e BIT_MASK 0x1 /end MEASUREMENT
/begin MEASUREMENT Vbx_diag_ena_sens_mat_l "Manifold air temperature sensor low signal diagnosis information available." UBYTE _CNV_S_2_RANGE______3_CM 1 0. 0. 1. ECU_ADDRESS 0xd000462d BIT_MASK 0x1 /end MEASUREMENT
/begin MEASUREMENT Vxx_raw_sens_mat "Raw manifold air temperature sensor" UWORD _CNV_A_R_LINEAR_____54_CM 1 0. -40. 200. ECU_ADDRESS 0xd00033f4 FORMAT "%5.1" /end MEASUREMENT
/begin MEASUREMENT Vxx_sens_mat_v "Manifold air temperature (sensor) raw value" UWORD _CNV_A_R_LINEAR_____146_CM 1 0. 0. 5. ECU_ADDRESS 0xd00033f6 FORMAT "%10.8" /end MEASUREMENT
/begin MEASUREMENT err_sym_el_tia[0] "Symtom of TIA elctrical detected failure" UBYTE _CNV_S_16_RANGE_ERR__147_CM 1 0. 0. 15. ECU_ADDRESS 0xd0004628 /end MEASUREMENT
/begin MEASUREMENT lv_cdn_diag_el_tia[0] "Conditions for TIA electrical diagnosis: 1: fulfilled,: one value for each TIa sensor of AIRT" UBYTE _CNV_A_R_ECME_LINEA_0_CM 1 0. 0. 1. ECU_ADDRESS 0xd000462a FORMAT "%1.0" /end MEASUREMENT
/begin MEASUREMENT tia_mes[0] "Intake air raw measured temperature" UBYTE _CNV_A_R_LINEAR_____42_CM 1 0. -48. 142.5 ECU_ADDRESS 0xd0004629 FORMAT "%6.2" /end MEASUREMENT
/begin MEASUREMENT vp_tia[0] "Air intake temperature raw value" UWORD _CNV_A_R_LINEAR_____16_CM 1 0. 0. 4.99984741210938 ECU_ADDRESS 0xd00033f2 FORMAT "%6.4" /end MEASUREMENT
/begin MEASUREMENT vp_tia_mmv[0] "filtered value of intake air temperature" UWORD _CNV_A_R_LINEAR_____16_CM 1 0. 0. 4.99984741210938 ECU_ADDRESS 0xd00033f8 FORMAT "%6.4" /end MEASUREMENT
/begin CHARACTERISTIC c_vp_tia_max_diag_el "Vp_tia voltage threshlod value for Short Cut to Ground" VALUE 0xa0021192 _REC_S1VAL_20_u2 4.99984741210938 _CNV_A_R_LINEAR_____16_CM 0. 4.99984741210938 FORMAT "%6.4" /end CHARACTERISTIC
/begin CHARACTERISTIC c_vp_tia_min_diag_el "Vp_tia voltage threshlod value for Short Cut to Plus or Open circuit" VALUE 0xa0021194 _REC_S1VAL_20_u2 4.99984741210938 _CNV_A_R_LINEAR_____16_CM 0. 4.99984741210938 FORMAT "%6.4" /end CHARACTERISTIC
/begin MEASUREMENT maf "Air mass (predicted) for calculation of basic fuel injection" UWORD _CNV_A_R_LINEAR_____148_CM 1 0. 0. 1389. ECU_ADDRESS 0xd000352c FORMAT "%13.8" /end MEASUREMENT
/begin AXIS_PTS ldp_vp_tco_ip_tco_mes "" 0xa002c2fc vp_tco[0] _REC_A2AXS_20_u2 4.99984741210938 _CNV_A_R_LINEAR_____16_CM 16 0. 4.99984741210938 FORMAT "%6.4" /end AXIS_PTS
/begin CHARACTERISTIC ip_tco_mes "Linearization of the coolant temperature sensor voltage for temperature acquisition " CURVE 0xa002d0dc _REC_A1CUR_20_u1_u2 190.5 _CNV_A_R_LINEAR_____42_CM -48. 142.5 FORMAT "%6.2"
 /begin AXIS_DESCR COM_AXIS vp_tco[0] _CNV_A_R_LINEAR_____16_CM 16 0. 4.99984741210938 FORMAT "%6.4" AXIS_PTS_REF ldp_vp_tco_ip_tco_mes /end AXIS_DESCR
/end CHARACTERISTIC
/begin MEASUREMENT Vbx_df_sens_tco_h "Engine cooling temperature sensor high signal detected failure" UBYTE _CNV_S_2_RANGE______3_CM 1 0. 0. 1. ECU_ADDRESS 0xd0004bd5 BIT_MASK 0x1 /end MEASUREMENT
/begin MEASUREMENT Vbx_df_sens_tco_l "engine cooling temperature sensor low signal detected failure" UBYTE _CNV_S_2_RANGE______3_CM 1 0. 0. 1. ECU_ADDRESS 0xd0004bd4 BIT_MASK 0x1 /end MEASUREMENT
/begin MEASUREMENT Vbx_diag_ena_sens_tco_h "engine cooling temperature sensor high signal diagnostic information available" UBYTE _CNV_S_2_RANGE______3_CM 1 0. 0. 1. ECU_ADDRESS 0xd0004bd7 BIT_MASK 0x1 /end MEASUREMENT
/begin MEASUREMENT Vbx_diag_ena_sens_tco_l "engine cooling temperature sensor low signal diagnostic information available" UBYTE _CNV_S_2_RANGE______3_CM 1 0. 0. 1. ECU_ADDRESS 0xd0004bd6 BIT_MASK 0x1 /end MEASUREMENT
/begin MEASUREMENT Vxx_raw_sens_tco "Raw engine coolant temperature" UWORD _CNV_A_R_LINEAR_____54_CM 1 0. -40. 200. ECU_ADDRESS 0xd0002f60 FORMAT "%5.1" /end MEASUREMENT
/begin MEASUREMENT Vxx_sens_tco_v "Raw engine coolant temperature" UWORD _CNV_A_R_LINEAR_____150_CM 1 0. 0. 60. ECU_ADDRESS 0xd0002f62 FORMAT "%5.2" /end MEASUREMENT
/begin MEASUREMENT Vxx_sfty_sens_tco_v "voltage signal of the coolant sensor for safety" UWORD _CNV_A_R_LINEAR_____52_CM 1 0. 0. 25000. ECU_ADDRESS 0xd0002f64 FORMAT "%5.0" /end MEASUREMENT
/begin MEASUREMENT lv_err_tco "Global TCO error flag" UBYTE _CNV_S_2_RANGE______3_CM 1 0. 0. 1. ECU_ADDRESS 0xd0004bd8 BIT_MASK 0x1 /end MEASUREMENT
/begin CHARACTERISTIC c_vp_tco_max_diag_tco_el "Minimum raw sensor signal voltage for the coolant temperature electrical diagnosis" VALUE 0xa002118e _REC_S1VAL_20_u2 4.99984741210938 _CNV_A_R_LINEAR_____16_CM 0. 4.99984741210938 FORMAT "%6.4" /end CHARACTERISTIC
/begin CHARACTERISTIC c_vp_tco_min_diag_tco_el "Minimum raw sensor signal voltage for the coolant temperature electrical diagnosis" VALUE 0xa0021190 _REC_S1VAL_20_u2 4.99984741210938 _CNV_A_R_LINEAR_____16_CM 0. 4.99984741210938 FORMAT "%6.4" /end CHARACTERISTIC
/begin CHARACTERISTIC lc_tco_diag_ena_rst "Boolean to enable diagnosis call at reset" VALUE 0xa00211e9 _REC_S1VAL_20_u1 1. _CNV_A_R_ECME_LINEA_0_CM 0. 1. FORMAT "%1.0" /end CHARACTERISTIC
/begin MEASUREMENT Vxx_acel_pdl_sens_v1 "Accelerator pedal sensor output voltage : track 1" UWORD _CNV_A_R_LINEAR_____52_CM 1 0. 0. 25000. ECU_ADDRESS 0xd0003b38 FORMAT "%5.0" /end MEASUREMENT
/begin MEASUREMENT Vxx_acel_pdl_sens_v2 "Accelerator pedal sensor output voltage : track 2" UWORD _CNV_A_R_LINEAR_____52_CM 1 0. 0. 25000. ECU_ADDRESS 0xd0003b3a FORMAT "%5.0" /end MEASUREMENT
/begin MEASUREMENT Vxx_sfty_acel_pdl_sens_v1 "Copy of accelerator pedal sensor output voltage : track 1 for safety monitoring" UWORD _CNV_A_R_LINEAR_____52_CM 1 0. 0. 25000. ECU_ADDRESS 0xd0005d82 FORMAT "%5.0" /end MEASUREMENT
/begin MEASUREMENT vp_pvs_1 "Voltage of pedal value sensor 1" UWORD _CNV_A_R_LINEAR_____16_CM 1 0. 0. 4.99984741210938 ECU_ADDRESS 0xd0002d48 FORMAT "%6.4" /end MEASUREMENT
/begin MEASUREMENT vp_pvs_1_mon "Voltage of safety pedal value sensor 1" UWORD _CNV_A_R_LINEAR_____16_CM 1 0. 0. 4.99984741210938 ECU_ADDRESS 0xd0005b82 FORMAT "%6.4" /end MEASUREMENT
/begin MEASUREMENT vp_pvs_2 "Voltage of pedal value sensor 2" UWORD _CNV_A_R_LINEAR_____16_CM 1 0. 0. 4.99984741210938 ECU_ADDRESS 0xd0002d4a FORMAT "%6.4" /end MEASUREMENT
/begin MEASUREMENT vp_pvs_2_mon "Voltage of safety pedal value sensor 2" UWORD _CNV_A_R_LINEAR_____16_CM 1 0. 0. 4.99984741210938 ECU_ADDRESS 0xd0005b84 FORMAT "%6.4" /end MEASUREMENT
/begin MEASUREMENT Vbx_sens_igk "Ignition key signal sensor" UBYTE _CNV_S_2_RANGE______3_CM 1 0. 0. 1. ECU_ADDRESS 0xd000498d BIT_MASK 0x1 /end MEASUREMENT
/begin MEASUREMENT Vbx_df_vb_rly_oc_scg "Open circuit or short circuit to ground relay detected failure" UBYTE _CNV_S_2_RANGE______3_CM 1 0. 0. 1. ECU_ADDRESS 0xd0004a18 BIT_MASK 0x1 /end MEASUREMENT
/begin MEASUREMENT Vbx_df_vb_rly_scw "Short circuit to battery relay detected failure" UBYTE _CNV_S_2_RANGE______3_CM 1 0. 0. 1. ECU_ADDRESS 0xd0004a19 BIT_MASK 0x1 /end MEASUREMENT
/begin MEASUREMENT Vbx_diag_ena_vb_rly_oc_scg "Open circuit or short circuit to ground relay diagnostic information available" UBYTE _CNV_S_2_RANGE______3_CM 1 0. 0. 1. ECU_ADDRESS 0xd0004a1a BIT_MASK 0x1 /end MEASUREMENT
/begin MEASUREMENT Vbx_diag_ena_vb_rly_scw "Short circuit to battery relay diagnostic information available" UBYTE _CNV_S_2_RANGE______3_CM 1 0. 0. 1. ECU_ADDRESS 0xd0004a1b BIT_MASK 0x1 /end MEASUREMENT
/begin MEASUREMENT Vxx_raw_vb "Battery voltage" UWORD _CNV_A_R_LINEAR_____150_CM 1 0. 0. 60. ECU_ADDRESS 0xd00035aa FORMAT "%5.2" /end MEASUREMENT
/begin MEASUREMENT Vxx_vb_rly "After relay battery voltage" UWORD _CNV_A_R_LINEAR_____150_CM 1 0. 0. 60. ECU_ADDRESS 0xd00035a8 FORMAT "%5.2" /end MEASUREMENT
/begin CHARACTERISTIC c_cdn_vb_min_diag "Battery voltage threshold for low voltage detection for sensor diagnosis" VALUE 0xa00211c8 _REC_S1VAL_20_u1 25.8984375 _CNV_A_R_LINEAR_____41_CM 0. 25.8984375 FORMAT "%9.6" /end CHARACTERISTIC
/begin CHARACTERISTIC c_sub_vb "Battery voltage substitute value when VB acquisition is impossible while key is turned off (typical value 12,6V)" VALUE 0xa00211d9 _REC_S1VAL_20_u1 25.8984375 _CNV_A_R_LINEAR_____41_CM 0. 25.8984375 FORMAT "%9.6" /end CHARACTERISTIC
/begin CHARACTERISTIC c_t_vcc_diag_auth "Delay for diagnosis authorisation after reset" VALUE 0xa00211da _REC_S1VAL_20_u1 10.16 _CNV_A_R_LINEAR_____153_CM 4.e-002 10.2 FORMAT "%5.2" /end CHARACTERISTIC
/begin CHARACTERISTIC c_vb_max_obd1 "" VALUE 0xa00211dd _REC_S1VAL_20_u1 25.8984375 _CNV_A_R_LINEAR_____41_CM 0. 25.8984375 FORMAT "%9.6" /end CHARACTERISTIC
/begin CHARACTERISTIC c_vb_max_obd2 "VB - threshold for maximum permissible battery voltage for OBDdiagnosis" VALUE 0xa00211de _REC_S1VAL_20_u1 25.8984375 _CNV_A_R_LINEAR_____41_CM 0. 25.8984375 FORMAT "%9.6" /end CHARACTERISTIC
/begin CHARACTERISTIC c_vb_min_obd1 "" VALUE 0xa00211e0 _REC_S1VAL_20_u1 25.8984375 _CNV_A_R_LINEAR_____41_CM 0. 25.8984375 FORMAT "%9.6" /end CHARACTERISTIC
/begin CHARACTERISTIC c_vb_min_obd2 "VB - threshold for minimum permissible battery voltage for OBDdiagnosis (=6V)" VALUE 0xa00211e1 _REC_S1VAL_20_u1 25.8984375 _CNV_A_R_LINEAR_____41_CM 0. 25.8984375 FORMAT "%9.6" /end CHARACTERISTIC
/begin CHARACTERISTIC c_vb_raw_inh_diag "Raw battery voltage threshold for minimum permissible battery voltage for the diagnosis" VALUE 0xa00211e2 _REC_S1VAL_20_u1 25.8984375 _CNV_A_R_LINEAR_____41_CM 0. 25.8984375 FORMAT "%9.6" /end CHARACTERISTIC
/begin CHARACTERISTIC c_vcc_1_dif_diag "threshold for noise detection on 5V" VALUE 0xa0021172 _REC_S1VAL_20_u2 10. _CNV_A_R_LINEAR_____154_CM 0. 10. FORMAT "%7.4" /end CHARACTERISTIC
/begin CHARACTERISTIC c_vcc_1_max_diag "Max threshold on VA1 or VA2 to detect a failure" VALUE 0xa0021174 _REC_S1VAL_20_u2 10. _CNV_A_R_LINEAR_____154_CM 0. 10. FORMAT "%7.4" /end CHARACTERISTIC
/begin CHARACTERISTIC c_vcc_1_min_diag "Min threshold on VA1 or VA2 to detect a failure" VALUE 0xa0021176 _REC_S1VAL_20_u2 10. _CNV_A_R_LINEAR_____154_CM 0. 10. FORMAT "%7.4" /end CHARACTERISTIC
/begin CHARACTERISTIC c_vcc_2_dif_diag "threshold for noise detection on 5V" VALUE 0xa0021178 _REC_S1VAL_20_u2 10. _CNV_A_R_LINEAR_____154_CM 0. 10. FORMAT "%7.4" /end CHARACTERISTIC
/begin CHARACTERISTIC c_vcc_2_max_diag "Max threshold on VA1 or VA2 to detect a failure" VALUE 0xa002117a _REC_S1VAL_20_u2 10. _CNV_A_R_LINEAR_____154_CM 0. 10. FORMAT "%7.4" /end CHARACTERISTIC
/begin CHARACTERISTIC c_vcc_2_min_diag "Min threshold on VA1 or VA2 to detect a failure" VALUE 0xa002117c _REC_S1VAL_20_u2 10. _CNV_A_R_LINEAR_____154_CM 0. 10. FORMAT "%7.4" /end CHARACTERISTIC
/begin CHARACTERISTIC c_vcc_3_dif_diag "threshold for noise detection on 5V" VALUE 0xa002117e _REC_S1VAL_20_u2 10. _CNV_A_R_LINEAR_____154_CM 0. 10. FORMAT "%7.4" /end CHARACTERISTIC
/begin CHARACTERISTIC c_vcc_3_max_diag "Max threshold on VA3 to detect a failure" VALUE 0xa0021180 _REC_S1VAL_20_u2 10. _CNV_A_R_LINEAR_____154_CM 0. 10. FORMAT "%7.4" /end CHARACTERISTIC
/begin CHARACTERISTIC c_vcc_3_min_diag "Min threshold on VA3 to detect a failure" VALUE 0xa0021182 _REC_S1VAL_20_u2 10. _CNV_A_R_LINEAR_____154_CM 0. 10. FORMAT "%7.4" /end CHARACTERISTIC
/begin CHARACTERISTIC c_vcc_gain_dif "Gain of the filter for 5V diynamic evaluation" VALUE 0xa0021184 _REC_S1VAL_20_u2 1. _CNV_A_R_LINEAR_____93_CM 0. 1. FORMAT "%11.9" /end CHARACTERISTIC
/begin MEASUREMENT Vbx_df_it_cmd_el "Inlet Throttle H_bridge detected failure" UBYTE _CNV_S_2_RANGE______3_CM 1 0. 0. 1. ECU_ADDRESS 0xd0004acb BIT_MASK 0x1 /end MEASUREMENT
/begin MEASUREMENT Vbx_diag_ena_it_cmd_el "Inlet throttle HBridge detected failure." UBYTE _CNV_S_2_RANGE______3_CM 1 0. 0. 1. ECU_ADDRESS 0xd0004aca BIT_MASK 0x1 /end MEASUREMENT
/begin MEASUREMENT Vbx_it_hbrg_ok "H_bridge driver check successfully completed" UBYTE _CNV_S_2_RANGE______3_CM 1 0. 0. 1. ECU_ADDRESS 0xd0004acc BIT_MASK 0x1 /end MEASUREMENT
/begin MEASUREMENT err_sym_etc_dr "For each symptom: status of failure (set to 1 when failure symptom detected)" UBYTE _CNV_S_16_RANGE_ERR__147_CM 1 0. 0. 15. ECU_ADDRESS 0xd0004ac9 /end MEASUREMENT
/begin MEASUREMENT lv_cdn_diag_etc_dr "Diagnostic condition to start symptom detection (set to 1 when condition is fulfilled)" UBYTE _CNV_S_2_RANGE______3_CM 1 0. 0. 1. ECU_ADDRESS 0xd0004ad0 /end MEASUREMENT
/begin MEASUREMENT lv_off_mtc_asw "Disable flag of the ETC driver" UBYTE _CNV_S_2_RANGE______3_CM 1 0. 0. 1. ECU_ADDRESS 0xd0004acd /end MEASUREMENT
/begin MEASUREMENT v_mtc_sp "Voltage set point" SWORD _CNV_A_R_LINEAR_____157_CM 1 0. -28.8 28.79912109375 ECU_ADDRESS 0xd0002daa FORMAT "%9.3" /end MEASUREMENT
/begin MEASUREMENT Vbx_clu_stal_ctr "Boolean to allow increment of Vxx_clu_stal_ctr" UBYTE _CNV_S_2_RANGE______3_CM 1 0. 0. 1. DISPLAY_IDENTIFIER InSmiSyn_NVM.Vbx_clu_stal_ctr_NVM ECU_ADDRESS 0xd00030a0 BIT_MASK 0x1 /end MEASUREMENT
/begin MEASUREMENT Vxx_clu_stal_ctr "Counter of stalling of type: clutch, failed starting up, due to the software lock" UWORD _CNV_A_R_ECME_LINEA_0_CM 1 0. 0. 65535. DISPLAY_IDENTIFIER InSmiSyn_NVM.Vxx_clu_stal_ctr_NVM ECU_ADDRESS 0xd0003088 FORMAT "%5.0" /end MEASUREMENT
/begin MEASUREMENT Vxx_cylr_is_vld_ctr "Counter of success of cylinder recognition in idle speed regulation" UWORD _CNV_A_R_ECME_LINEA_0_CM 1 0. 0. 65535. DISPLAY_IDENTIFIER InSmiSyn_NVM.Vxx_cylr_is_vld_ctr_NVM ECU_ADDRESS 0xd000308a FORMAT "%5.0" /end MEASUREMENT
/begin MEASUREMENT Vxx_cylr_ok_aftr_stal_ctr "Counter of confirmation of phase in using cylinder recognition (running vehicule)" UWORD _CNV_A_R_ECME_LINEA_0_CM 1 0. 0. 65535. DISPLAY_IDENTIFIER InSmiSyn_NVM.Vxx_cylr_ok_aftr_stal_ctr_NVM ECU_ADDRESS 0xd000308c FORMAT "%5.0" /end MEASUREMENT
/begin MEASUREMENT Vxx_cylr_ok_ctr "Failure counter for cylinder recognition" UWORD _CNV_A_R_ECME_LINEA_0_CM 1 0. 0. 65535. DISPLAY_IDENTIFIER InSmiSyn_NVM.Vxx_cylr_ok_ctr_NVM ECU_ADDRESS 0xd000308e FORMAT "%5.0" /end MEASUREMENT
/begin MEASUREMENT Vxx_err_cylr_ctr "cylinder recognition counter" UWORD _CNV_A_R_ECME_LINEA_0_CM 1 0. 0. 65535. DISPLAY_IDENTIFIER InSmiSyn_NVM.Vxx_err_cylr_ctr_NVM ECU_ADDRESS 0xd0003090 FORMAT "%5.0" /end MEASUREMENT
/begin MEASUREMENT Vxx_err_cylr_is_run_ctr "cylinder recognition counter in idle speed regulation" UWORD _CNV_A_R_ECME_LINEA_0_CM 1 0. 0. 65535. DISPLAY_IDENTIFIER InSmiSyn_NVM.Vxx_err_cylr_is_run_ctr_NVM ECU_ADDRESS 0xd0003092 FORMAT "%5.0" /end MEASUREMENT
/begin MEASUREMENT Vxx_err_id_is_run_ctr "Failure counter for idle speed speed regulation (not confirmed by cylinder recognition for running vehicle)" UWORD _CNV_A_R_ECME_LINEA_0_CM 1 0. 0. 65535. DISPLAY_IDENTIFIER InSmiSyn_NVM.Vxx_err_id_is_run_ctr_NVM ECU_ADDRESS 0xd0003094 FORMAT "%5.0" /end MEASUREMENT
/begin MEASUREMENT Vxx_is_cylr_ok_ctr "Counter of success od cylinder recognition in idle speed regulation" UWORD _CNV_A_R_ECME_LINEA_0_CM 1 0. 0. 65535. DISPLAY_IDENTIFIER InSmiSyn_NVM.Vxx_is_cylr_ok_ctr_NVM ECU_ADDRESS 0xd0003096 FORMAT "%5.0" /end MEASUREMENT
/begin MEASUREMENT Vxx_no_deci_cylr_ctr "Counter of no decision of cylinder recognition" UWORD _CNV_A_R_ECME_LINEA_0_CM 1 0. 0. 65535. DISPLAY_IDENTIFIER InSmiSyn_NVM.Vxx_no_deci_cylr_ctr_NVM ECU_ADDRESS 0xd0003098 FORMAT "%5.0" /end MEASUREMENT
/begin MEASUREMENT Vxx_no_deci_id_is_ctr "Counter of no decision of cylinder recognition in RR mode" UWORD _CNV_A_R_ECME_LINEA_0_CM 1 0. 0. 65535. DISPLAY_IDENTIFIER InSmiSyn_NVM.Vxx_no_deci_id_is_ctr_NVM ECU_ADDRESS 0xd000309a FORMAT "%5.0" /end MEASUREMENT
/begin MEASUREMENT Vxx_run_re_phs_ctr "Rephasing counter after cylinder recognition in running vehicle" UWORD _CNV_A_R_ECME_LINEA_0_CM 1 0. 0. 65535. DISPLAY_IDENTIFIER InSmiSyn_NVM.Vxx_run_re_phs_ctr_NVM ECU_ADDRESS 0xd000309c FORMAT "%5.0" /end MEASUREMENT
/begin MEASUREMENT Vxx_crk_syn_loss_ctr "Counter of loss of crankshaft synchronization." UWORD _CNV_A_R_ECME_LINEA_0_CM 1 0. 0. 65535. DISPLAY_IDENTIFIER InSmiSyn_NVM.Vxx_crk_syn_loss_ctr_NVM ECU_ADDRESS 0xd000309e FORMAT "%5.0" /end MEASUREMENT
/begin AXIS_PTS Ctb_sta_tco "Coolant temperature breakpoints for starting set point tables" 0xa002dfe4 Vxx_tco _REC_A2AXS_20_u2 240. _CNV_A_R_LINEAR_____54_CM 8 -40. 200. FORMAT "%5.1" /end AXIS_PTS
/begin AXIS_PTS Ctb_tco2 "Engine coolant temperature breakpoints" 0xa002e01c Vxx_tco _REC_A2AXS_20_u2 240. _CNV_A_R_LINEAR_____54_CM 9 -40. 200. FORMAT "%5.1" /end AXIS_PTS
/begin AXIS_PTS Ctb_in_vvtc_angl_sp_ftc_n "Engine speed breakpoints used to calculate the time constant of the filter on the VVT position setpoint" 0xa002aca0 Vxx_n_mv _REC_A2AXS_20_u2 16383.75 _CNV_A_R_ENSD_LINEA_24_CM 20 0. 16383.75 FORMAT "%8.2" /end AXIS_PTS
/begin AXIS_PTS Ctb_tq_rat "9 programmable torque ratio breakpoints" 0xa002accc Vxx_tqi_rat_tgt _REC_A2AXS_20_u2 1. _CNV_A_R_LINEAR_____125_CM 9 0. 1. FORMAT "%11.9" /end AXIS_PTS
/begin CHARACTERISTIC Cmp_n_tq_cwup_vvtc_in_angl "Intake vvt relative angle setpoint map linked to catalyst warm-up" MAP 0xa002ace0 _REC_A1MAP_20_u2_u2_u2 719.98 _CNV_A_R_LINEAR_____76_CM 0. 719.98 FORMAT "%6.2"
 /begin AXIS_DESCR COM_AXIS Vxx_tq_rel _CNV_A_R_LINEAR_____228_CM 9 -2. 2. FORMAT "%7.4" AXIS_PTS_REF Ctb_wup_tq_rel /end AXIS_DESCR
 /begin AXIS_DESCR COM_AXIS Vxx_n _CNV_A_R_ENSD_LINEA_24_CM 20 0. 16383.75 FORMAT "%8.2" AXIS_PTS_REF Ctb_n /end AXIS_DESCR
/end CHARACTERISTIC
/begin CHARACTERISTIC Cmp_n_tq_vvtc_in_angl "Intake vvt relative angle setpoint map when engine is warm" MAP 0xa002ae48 _REC_A1MAP_20_u2_u2_u2 719.98 _CNV_A_R_LINEAR_____76_CM 0. 719.98 FORMAT "%6.2"
 /begin AXIS_DESCR COM_AXIS Vxx_tqi_rat_tgt _CNV_A_R_LINEAR_____125_CM 9 0. 1. FORMAT "%11.9" AXIS_PTS_REF Ctb_tq_rat /end AXIS_DESCR
 /begin AXIS_DESCR COM_AXIS Vxx_n _CNV_A_R_ENSD_LINEA_24_CM 20 0. 16383.75 FORMAT "%8.2" AXIS_PTS_REF Ctb_n /end AXIS_DESCR
/end CHARACTERISTIC
/begin CHARACTERISTIC Ctp_in_vvtc_angl_sp_ftc "Time constant for the filter on the VVT position setpoint" CURVE 0xa002afb0 _REC_A1CUR_20_u2_u2 655.35 _CNV_A_R_LINEAR_____34_CM 0. 655.35 FORMAT "%6.2"
 /begin AXIS_DESCR COM_AXIS Vxx_n_mv _CNV_A_R_ENSD_LINEA_24_CM 20 0. 16383.75 FORMAT "%8.2" AXIS_PTS_REF Ctb_in_vvtc_angl_sp_ftc_n /end AXIS_DESCR
/end CHARACTERISTIC
/begin CHARACTERISTIC Ctp_n_vvtc_trs_in_angl "Table of Intake VVT relative position setpoint in the transient of VVT" CURVE 0xa002afd8 _REC_A1CUR_20_u2_u2 719.98 _CNV_A_R_LINEAR_____76_CM 0. 719.98 FORMAT "%6.2"
 /begin AXIS_DESCR COM_AXIS Vxx_n _CNV_A_R_ENSD_LINEA_24_CM 20 0. 16383.75 FORMAT "%8.2" AXIS_PTS_REF Ctb_n /end AXIS_DESCR
/end CHARACTERISTIC
/begin CHARACTERISTIC Ctp_trs_in_vvtc_angl_sp_ftc "Time constant for the filter on the VVT position setpoint in transient" CURVE 0xa002b000 _REC_A1CUR_20_u2_u2 655.35 _CNV_A_R_LINEAR_____34_CM 0. 655.35 FORMAT "%6.2"
 /begin AXIS_DESCR COM_AXIS Vxx_n_mv _CNV_A_R_ENSD_LINEA_24_CM 20 0. 16383.75 FORMAT "%8.2" AXIS_PTS_REF Ctb_in_vvtc_angl_sp_ftc_n /end AXIS_DESCR
/end CHARACTERISTIC
/begin MEASUREMENT Vbx_vvtc_spg_trs_cdn "Boolean indicating that conditions of transition for VVT particular setpoint are activated" UBYTE _CNV_S_2_RANGE______3_CM 1 0. 0. 1. ECU_ADDRESS 0xd0004416 BIT_MASK 0x1 /end MEASUREMENT
/begin MEASUREMENT Vbx_vvtc_trs "Boolean indicating that Wastegate transition condition to the VVT is activated" UBYTE _CNV_S_2_RANGE______3_CM 1 0. 0. 1. ECU_ADDRESS 0xd0004417 BIT_MASK 0x1 /end MEASUREMENT
/begin MEASUREMENT Vxx_cata_wup_vvtc_in_angl "Nominal intake VVT relative angle setpoint linked to catalyst warm-up" UWORD _CNV_A_R_LINEAR_____76_CM 1 0. 0. 719.98 ECU_ADDRESS 0xd0002fb2 FORMAT "%6.2" /end MEASUREMENT
/begin MEASUREMENT Vxx_vvtc_in_angl_sp_nom "Intake vvt relative angle setpoint nominal" UWORD _CNV_A_R_LINEAR_____76_CM 1 0. 0. 719.98 ECU_ADDRESS 0xd0002fb4 FORMAT "%6.2" /end MEASUREMENT
/begin MEASUREMENT Vxx_vvtc_in_angl_sp_tgt "Intake vvt relative angle target setpoint" UWORD _CNV_A_R_LINEAR_____76_CM 1 0. 0. 719.98 ECU_ADDRESS 0xd0002fb6 FORMAT "%6.2" /end MEASUREMENT
/begin MEASUREMENT Vxx_vvtc_in_angl_sp_trs "Intake VVT relative angle setpoint in transient" UWORD _CNV_A_R_LINEAR_____76_CM 1 0. 0. 719.98 ECU_ADDRESS 0xd0002fb8 FORMAT "%6.2" /end MEASUREMENT
/begin MEASUREMENT Vxx_vvtc_in_angl_sp_wup "Intake vvt relative angle target" UWORD _CNV_A_R_LINEAR_____76_CM 1 0. 0. 719.98 ECU_ADDRESS 0xd0002fba FORMAT "%6.2" /end MEASUREMENT
/begin MEASUREMENT Vxx_vvtc_in_angl_sp_wup_raw "Intake vvt relative angle raw target" UWORD _CNV_A_R_LINEAR_____76_CM 1 0. 0. 719.98 ECU_ADDRESS 0xd0002fbc FORMAT "%6.2" /end MEASUREMENT
/begin CHARACTERISTIC Cxx_vvtc_angl_dec_slop "Minimum VVT angle decrease slope during change of setpoint" VALUE 0xa00215d4 _REC_S1VAL_20_u2 720. _CNV_A_R_LINEAR_____229_CM -720. 0. FORMAT "%8.2" /end CHARACTERISTIC
/begin CHARACTERISTIC Cxx_vvtc_angl_inc_slop "Maximum VVT angle increase slope during change of setpoint" VALUE 0xa00215d6 _REC_S1VAL_20_u2 720. _CNV_A_R_LINEAR_____230_CM 0. 720. FORMAT "%7.2" /end CHARACTERISTIC
/begin CHARACTERISTIC Cxx_vvtc_angl_trs_dly "Duration of the transition mode" VALUE 0xa00215d8 _REC_S1VAL_20_u2 655.35 _CNV_A_R_LINEAR_____34_CM 0. 655.35 FORMAT "%6.2" /end CHARACTERISTIC
/begin CHARACTERISTIC Cxx_vvtc_trs_amp_thd "Threshold of the atmospheric pressure for the transition mode" VALUE 0xa00215da _REC_S1VAL_20_u2 20000. _CNV_A_R_LINEAR_____57_CM 0. 20000. FORMAT "%5.0" /end CHARACTERISTIC
/begin CHARACTERISTIC Cxx_vvtc_trs_dly "Time during which the Wastegate transient is forced to off for the transient of VVT" VALUE 0xa00215e2 _REC_S1VAL_20_u1 2.55 _CNV_A_R_LINEAR_____34_CM 0. 2.55 FORMAT "%4.2" /end CHARACTERISTIC
/begin CHARACTERISTIC Cxx_vvtc_trs_n_thd "Threshold of the engine speed for the transition mode" VALUE 0xa00215dc _REC_S1VAL_20_u2 16383.75 _CNV_A_R_ENSD_LINEA_24_CM 0. 16383.75 FORMAT "%8.2" /end CHARACTERISTIC
/begin CHARACTERISTIC Cxx_vvtc_trs_tco_thd "Threshold of the engine coolant temperature for the transition mode" VALUE 0xa00215de _REC_S1VAL_20_u2 240. _CNV_A_R_LINEAR_____54_CM -40. 200. FORMAT "%5.1" /end CHARACTERISTIC
/begin CHARACTERISTIC Cxx_vvtc_trs_vs_thd "Threshold of the Vehicle speed for the transition mode" VALUE 0xa00215e0 _REC_S1VAL_20_u2 655.35 _CNV_A_R_LINEAR_____70_CM 0. 655.35 FORMAT "%6.2" /end CHARACTERISTIC
/begin AXIS_PTS Ctb_in_vvtc_act_cold_temp_n_bkp "Table of engine speed used with cartographies Ctp_in_vvtc_act_cold_temp_thd" 0xa002b034 Vxx_n _REC_A2AXS_20_u2 16383.75 _CNV_A_R_ENSD_LINEA_24_CM 9 0. 16383.75 FORMAT "%8.2" /end AXIS_PTS
/begin AXIS_PTS Ctb_in_vvtc_act_hot_temp_n_bkp "Table of engine speed used with cartographies Ctp_in_vvtc_act_hot_temp_thd_1 and Ctp_in_vvtc_act_hot_temp_thd_2" 0xa002b048 Vxx_n _REC_A2AXS_20_u2 16383.75 _CNV_A_R_ENSD_LINEA_24_CM 9 0. 16383.75 FORMAT "%8.2" /end AXIS_PTS
/begin AXIS_PTS Ctb_in_vvtc_angl_sp_cyc_t_bkp "Table of duration breakpoints used with the cartography Ctp_in_vvtc_angl_sp_cyc" 0xa002b05c Vxx_in_vvtc_angle_sp_cyc_t _REC_A2AXS_20_u2 655.35 _CNV_A_R_LINEAR_____34_CM 32 0. 655.35 FORMAT "%6.2" /end AXIS_PTS
/begin CHARACTERISTIC Ctp_in_vvtc_act_cold_temp_thd "Table of maximum (coolant or oil) temperature thresholds for the deactivation of the VVTC at cold running" CURVE 0xa002b0a0 _REC_A1CUR_20_u2_u2 240. _CNV_A_R_LINEAR_____54_CM -40. 200. FORMAT "%5.1"
 /begin AXIS_DESCR COM_AXIS Vxx_n _CNV_A_R_ENSD_LINEA_24_CM 9 0. 16383.75 FORMAT "%8.2" AXIS_PTS_REF Ctb_in_vvtc_act_cold_temp_n_bkp /end AXIS_DESCR
/end CHARACTERISTIC
/begin CHARACTERISTIC Ctp_in_vvtc_act_hot_thd_1 "Table of maximum (coolant or oil) temperature thresholds for the deactivation of the VVTC at hot running" CURVE 0xa002b0b4 _REC_A1CUR_20_u2_u2 240. _CNV_A_R_LINEAR_____54_CM -40. 200. FORMAT "%5.1"
 /begin AXIS_DESCR COM_AXIS Vxx_n _CNV_A_R_ENSD_LINEA_24_CM 9 0. 16383.75 FORMAT "%8.2" AXIS_PTS_REF Ctb_in_vvtc_act_hot_temp_n_bkp /end AXIS_DESCR
/end CHARACTERISTIC
/begin CHARACTERISTIC Ctp_in_vvtc_act_hot_thd_2 "Table of (coolant or oil) temperature thresholds to define the risk zon" CURVE 0xa002b0c8 _REC_A1CUR_20_u2_u2 240. _CNV_A_R_LINEAR_____54_CM -40. 200. FORMAT "%5.1"
 /begin AXIS_DESCR COM_AXIS Vxx_n _CNV_A_R_ENSD_LINEA_24_CM 9 0. 16383.75 FORMAT "%8.2" AXIS_PTS_REF Ctb_in_vvtc_act_hot_temp_n_bkp /end AXIS_DESCR
/end CHARACTERISTIC
/begin CHARACTERISTIC Ctp_in_vvtc_angl_sp_cyc "Cartography with specific VVTC setpoints in bench mode " CURVE 0xa002b0dc _REC_A1CUR_20_u2_u2 719.98 _CNV_A_R_LINEAR_____76_CM 0. 719.98 FORMAT "%6.2"
 /begin AXIS_DESCR COM_AXIS Vxx_in_vvtc_angle_sp_cyc_t _CNV_A_R_LINEAR_____34_CM 32 0. 655.35 FORMAT "%6.2" AXIS_PTS_REF Ctb_in_vvtc_angl_sp_cyc_t_bkp /end AXIS_DESCR
/end CHARACTERISTIC
/begin MEASUREMENT Vbx_in_vvtc_act_ena_vb "" UBYTE _CNV_S_2_RANGE______3_CM 1 0. 0. 1. ECU_ADDRESS 0xd000482e BIT_MASK 0x1 /end MEASUREMENT
/begin MEASUREMENT Vbx_in_vvtc_ena_run "The VVTC system is operating (setpoint is applied)" UBYTE _CNV_S_2_RANGE______3_CM 1 0. 0. 1. ECU_ADDRESS 0xd000482f BIT_MASK 0x1 /end MEASUREMENT
/begin MEASUREMENT Vbx_in_vvtc_ena_sldv_cln "Allow Oil Control Valve auto-cleaning mode" UBYTE _CNV_S_2_RANGE______3_CM 1 0. 0. 1. ECU_ADDRESS 0xd0004830 BIT_MASK 0x1 /end MEASUREMENT
/begin MEASUREMENT Vbx_in_vvtc_h_n_inh "The VVTC system is inhibited (setpoint is set to zero) at high engine speed" UBYTE _CNV_S_2_RANGE______3_CM 1 0. 0. 1. ECU_ADDRESS 0xd0004831 BIT_MASK 0x1 /end MEASUREMENT
/begin MEASUREMENT Vbx_in_vvtc_inh_zon "Indicate that VVTC is in the inhibition zone" UBYTE _CNV_S_2_RANGE______3_CM 1 0. 0. 1. ECU_ADDRESS 0xd0004832 BIT_MASK 0x1 /end MEASUREMENT
/begin MEASUREMENT Vbx_in_vvtc_risk_zon "Indicate that VVTC is operating in the risk zone" UBYTE _CNV_S_2_RANGE______3_CM 1 0. 0. 1. ECU_ADDRESS 0xd0004833 BIT_MASK 0x1 /end MEASUREMENT
/begin MEASUREMENT Vbx_in_vvtc_sp_fail "Failure mode on the VVTC set point" UBYTE _CNV_S_2_RANGE______3_CM 1 0. 0. 1. ECU_ADDRESS 0xd0004834 BIT_MASK 0x1 /end MEASUREMENT
/begin MEASUREMENT Vxx_in_vvtc_act_ena_fac "Coefficient to smooth variations of setpoint during activation/deactivation transitions" UWORD _CNV_A_R_LINEAR_____122_CM 1 0. 0. 100. ECU_ADDRESS 0xd0003162 FORMAT "%12.8" /end MEASUREMENT
/begin MEASUREMENT Vxx_in_vvtc_angl_sp "Angular position setpoint of the intake VVTC system" UWORD _CNV_A_R_LINEAR_____76_CM 1 0. 0. 719.98 ECU_ADDRESS 0xd0003164 FORMAT "%6.2" /end MEASUREMENT
/begin MEASUREMENT Vxx_in_vvtc_angl_sp_bch "Value of the VVTC setpoint in bench mode" UWORD _CNV_A_R_LINEAR_____76_CM 1 0. 0. 719.98 ECU_ADDRESS 0xd0003166 FORMAT "%6.2" /end MEASUREMENT
/begin MEASUREMENT Vxx_in_vvtc_angle_sp_cyc_t "VVTC setpoint cycle duration" UWORD _CNV_A_R_LINEAR_____34_CM 1 0. 0. 655.35 ECU_ADDRESS 0xd0003168 FORMAT "%6.2" /end MEASUREMENT
/begin CHARACTERISTIC Cbx_in_vvtc_angl_sp_cho "Select value of the setpoint (=0 depend on engine need / =1 from bench mode)" VALUE 0xa0021c32 _REC_S1VAL_20_u1 1. _CNV_A_R_ECME_LINEA_0_CM 0. 1. FORMAT "%1.0" BIT_MASK 0x1 /end CHARACTERISTIC
/begin CHARACTERISTIC Cbx_in_vvtc_angl_sp_cho_bch "Select value of the setpoint in bench mode (= 0 from a cartography / = 1 from a calibration)" VALUE 0xa0021c33 _REC_S1VAL_20_u1 1. _CNV_A_R_ECME_LINEA_0_CM 0. 1. FORMAT "%1.0" BIT_MASK 0x1 /end CHARACTERISTIC
/begin CHARACTERISTIC Cbx_in_vvtc_cho_angl_vld "Consider or not the Cam/Crank angle validity status in the activation conditions of the OCV auto-cleaning" VALUE 0xa0021c34 _REC_S1VAL_20_u1 1. _CNV_A_R_ECME_LINEA_0_CM 0. 1. FORMAT "%1.0" BIT_MASK 0x1 /end CHARACTERISTIC
/begin CHARACTERISTIC Cbx_in_vvtc_cho_sldv_vld "Consider or not the solenoid validity status in the activation conditions of the OCV auto-cleaning" VALUE 0xa0021c35 _REC_S1VAL_20_u1 1. _CNV_A_R_ECME_LINEA_0_CM 0. 1. FORMAT "%1.0" BIT_MASK 0x1 /end CHARACTERISTIC
/begin CHARACTERISTIC Cbx_in_vvtc_cho_tco_toil_cold "Select coolant or oil temperature to determine the activation/deactivation condition when engine is cold" VALUE 0xa0021c36 _REC_S1VAL_20_u1 1. _CNV_A_R_ECME_LINEA_0_CM 0. 1. FORMAT "%1.0" BIT_MASK 0x1 /end CHARACTERISTIC
/begin CHARACTERISTIC Cbx_in_vvtc_cho_tco_toil_hot "Select coolant or oil temperature to determine the activation/deactivation condition when engine is hot" VALUE 0xa0021c37 _REC_S1VAL_20_u1 1. _CNV_A_R_ECME_LINEA_0_CM 0. 1. FORMAT "%1.0" BIT_MASK 0x1 /end CHARACTERISTIC
/begin CHARACTERISTIC Cbx_in_vvtc_cold_act_cdn "Indicates that there is an activation condition of the system depending on cooloant or oil temperature at engine cold running" VALUE 0xa0021c38 _REC_S1VAL_20_u1 1. _CNV_A_R_ECME_LINEA_0_CM 0. 1. FORMAT "%1.0" BIT_MASK 0x1 /end CHARACTERISTIC
/begin CHARACTERISTIC Cbx_in_vvtc_hot_act_cdn "Indicates that there is an inhibition condition of the system depending on cooloant or oil temperature at engine hot running" VALUE 0xa0021c39 _REC_S1VAL_20_u1 1. _CNV_A_R_ECME_LINEA_0_CM 0. 1. FORMAT "%1.0" BIT_MASK 0x1 /end CHARACTERISTIC
/begin CHARACTERISTIC Cxx_in_vvtc_act_cold_temp_hys "Hysteresis on the minimum (coolant or oil) temperature threshold for the activation/deactivation of the VVTC" VALUE 0xa0021c08 _REC_S1VAL_20_u2 240. _CNV_A_R_LINEAR_____54_CM -40. 200. FORMAT "%5.1" /end CHARACTERISTIC
/begin CHARACTERISTIC Cxx_in_vvtc_act_ena_max_vb_thd "Maximum Battery Voltage for the activation of the VVTC" VALUE 0xa0021c0a _REC_S1VAL_20_u2 60. _CNV_A_R_LINEAR_____150_CM 0. 60. FORMAT "%5.2" /end CHARACTERISTIC
/begin CHARACTERISTIC Cxx_in_vvtc_act_ena_min_vb_thd "Minimum Battery Voltage for the activation of the VVTC" VALUE 0xa0021c0c _REC_S1VAL_20_u2 60. _CNV_A_R_LINEAR_____150_CM 0. 60. FORMAT "%5.2" /end CHARACTERISTIC
/begin CHARACTERISTIC Cxx_in_vvtc_act_ena_n_hys "Hysteresis on the engine speed hysteresis for the activation/deactivation of the VVTC" VALUE 0xa0021c0e _REC_S1VAL_20_u2 16383.75 _CNV_A_R_ENSD_LINEA_24_CM 0. 16383.75 FORMAT "%8.2" /end CHARACTERISTIC
/begin CHARACTERISTIC Cxx_in_vvtc_act_ena_n_thd "Engine speed threshold for the activation of the VVTC" VALUE 0xa0021c10 _REC_S1VAL_20_u2 16383.75 _CNV_A_R_ENSD_LINEA_24_CM 0. 16383.75 FORMAT "%8.2" /end CHARACTERISTIC
/begin CHARACTERISTIC Cxx_in_vvtc_act_ena_vb_hys "Battery Voltage Hysteresis for the activation of the VVTC" VALUE 0xa0021c12 _REC_S1VAL_20_u2 60. _CNV_A_R_LINEAR_____150_CM 0. 60. FORMAT "%5.2" /end CHARACTERISTIC
/begin CHARACTERISTIC Cxx_in_vvtc_act_hot_temp_hys_1 "Hysteresis on the maximum (coolant or oil) tempeature threshold for VVTC activation/deactivation at hot" VALUE 0xa0021c14 _REC_S1VAL_20_u2 240. _CNV_A_R_LINEAR_____54_CM -40. 200. FORMAT "%5.1" /end CHARACTERISTIC
/begin CHARACTERISTIC Cxx_in_vvtc_act_hot_temp_hys_2 "Hysteresis on (coolant or oil) temperature for the definition of the risk zone" VALUE 0xa0021c16 _REC_S1VAL_20_u2 240. _CNV_A_R_LINEAR_____54_CM -40. 200. FORMAT "%5.1" /end CHARACTERISTIC
/begin CHARACTERISTIC Cxx_in_vvtc_angl_sp_bch "Setpoint applied in bench mode" VALUE 0xa0021c18 _REC_S1VAL_20_u2 719.98 _CNV_A_R_LINEAR_____76_CM 0. 719.98 FORMAT "%6.2" /end CHARACTERISTIC
/begin CHARACTERISTIC Cxx_in_vvtc_angl_sp_cyc_t "Duration of the setpoint cycle" VALUE 0xa0021c1a _REC_S1VAL_20_u2 655.35 _CNV_A_R_LINEAR_____34_CM 0. 655.35 FORMAT "%6.2" /end CHARACTERISTIC
/begin CHARACTERISTIC Cxx_in_vvtc_angl_sp_h_lim_thd "Threshold to limit the angular displacement of the intake VVTC actuator (solenoid valve reliability considerations)" VALUE 0xa0021c1c _REC_S1VAL_20_u2 719.98 _CNV_A_R_LINEAR_____76_CM 0. 719.98 FORMAT "%6.2" /end CHARACTERISTIC
/begin CHARACTERISTIC Cxx_in_vvtc_dsb_ena_fil_inc "Value of the increment (per 10 ms) for the calculation of the smoothing coefficient" VALUE 0xa0021c1e _REC_S1VAL_20_u2 100. _CNV_A_R_LINEAR_____122_CM 0. 100. FORMAT "%12.8" /end CHARACTERISTIC
/begin CHARACTERISTIC Cxx_in_vvtc_eng_wup_t "Duration after engine start to consider that the engine is warm" VALUE 0xa0021c20 _REC_S1VAL_20_u2 6553.5 _CNV_A_R_LINEAR_____4_CM 0. 6553.5 FORMAT "%6.1" /end CHARACTERISTIC
/begin CHARACTERISTIC Cxx_in_vvtc_inh_h_n_hys "Hysteresis on the engine speed hysteresis for the VVTC inhibition at high engine speed" VALUE 0xa0021c22 _REC_S1VAL_20_u2 16383.75 _CNV_A_R_ENSD_LINEA_24_CM 0. 16383.75 FORMAT "%8.2" /end CHARACTERISTIC
/begin CHARACTERISTIC Cxx_in_vvtc_inh_h_n_thd "Engine speed threshold for the VVTC inhibition at high engine speed" VALUE 0xa0021c24 _REC_S1VAL_20_u2 16383.75 _CNV_A_R_ENSD_LINEA_24_CM 0. 16383.75 FORMAT "%8.2" /end CHARACTERISTIC
/begin CHARACTERISTIC Cxx_in_vvtc_n_thd_inh_hot "Engine speed threshold to inhibit the VVTC system if invalid coolant or oil temperature information at hot running" VALUE 0xa0021c26 _REC_S1VAL_20_u2 16383.75 _CNV_A_R_ENSD_LINEA_24_CM 0. 16383.75 FORMAT "%8.2" /end CHARACTERISTIC
/begin CHARACTERISTIC Cxx_in_vvtc_sldv_ena_n_hys "Hysteresis on the engine speed for the activation/deactivation of the auto-cleaning mode" VALUE 0xa0021c28 _REC_S1VAL_20_u2 16383.75 _CNV_A_R_ENSD_LINEA_24_CM 0. 16383.75 FORMAT "%8.2" /end CHARACTERISTIC
/begin CHARACTERISTIC Cxx_in_vvtc_sldv_ena_n_thd "Engine speed threshold for the activation of the auto-cleaning mode" VALUE 0xa0021c2a _REC_S1VAL_20_u2 16383.75 _CNV_A_R_ENSD_LINEA_24_CM 0. 16383.75 FORMAT "%8.2" /end CHARACTERISTIC
/begin CHARACTERISTIC Cxx_in_vvtc_t_ena_sldv_cyc "Duration of no VVTC movement to activate the auto-cleaning mode" VALUE 0xa0021c2c _REC_S1VAL_20_u2 6553.5 _CNV_A_R_LINEAR_____4_CM 0. 6553.5 FORMAT "%6.1" /end CHARACTERISTIC
/begin CHARACTERISTIC Cxx_in_vvtc_temp_thd_max_sldv "Condition on the maximum (coolant or oil) temperature for the activation/deactivation of the auto-cleaning mode" VALUE 0xa0021c2e _REC_S1VAL_20_u2 240. _CNV_A_R_LINEAR_____54_CM -40. 200. FORMAT "%5.1" /end CHARACTERISTIC
/begin CHARACTERISTIC Cxx_in_vvtc_temp_thd_min_sldv "Condition on the minimum (coolant or oil) temperature for the activation/deactivation of the auto-cleaning mode" VALUE 0xa0021c30 _REC_S1VAL_20_u2 240. _CNV_A_R_LINEAR_____54_CM -40. 200. FORMAT "%5.1" /end CHARACTERISTIC
/begin AXIS_PTS Ctb_wup_tq_rel "9 programmable relative torque ratio breakpoints linked to catalyst warm-up" 0xa002ba28 Vxx_tq_rel _REC_A2AXS_20_u2 4. _CNV_A_R_LINEAR_____228_CM 9 -2. 2. FORMAT "%7.4" /end AXIS_PTS
/begin MEASUREMENT Vbx_crk "Crankshaft signal" UBYTE _CNV_S_2_RANGE______3_CM 1 0. 0. 1. ECU_ADDRESS 0xd000536b BIT_MASK 0x1 /end MEASUREMENT
/begin MEASUREMENT Vbx_crk_syn "Set to ON after the first long tooth" UBYTE _CNV_S_2_RANGE______3_CM 1 0. 0. 1. ECU_ADDRESS 0xd000536c BIT_MASK 0x1 /end MEASUREMENT
/begin MEASUREMENT Vbx_deb_cdn "Flag indicating debouce test is OK" UBYTE _CNV_S_2_RANGE______3_CM 1 0. 0. 1. ECU_ADDRESS 0xd000536d BIT_MASK 0x1 /end MEASUREMENT
/begin MEASUREMENT Vbx_df_crk_no_sig "no crankshaft signal detected failure" UBYTE _CNV_S_2_RANGE______3_CM 1 0. 0. 1. ECU_ADDRESS 0xd000498e BIT_MASK 0x1 /end MEASUREMENT
/begin MEASUREMENT Vbx_df_crk_no_sig_wio_cam "no crankshaft signal detected failure for engine without camshaft sensor" UBYTE _CNV_S_2_RANGE______3_CM 1 0. 0. 1. ECU_ADDRESS 0xd000536e BIT_MASK 0x1 /end MEASUREMENT
/begin MEASUREMENT Vbx_diag_ena_crk_no_sig "no crankshaft signal diagnosis authorization" UBYTE _CNV_S_2_RANGE______3_CM 1 0. 0. 1. ECU_ADDRESS 0xd000498f BIT_MASK 0x1 /end MEASUREMENT
/begin MEASUREMENT Vbx_diag_ena_crk_no_sig_wio_cam "no crankshaft signal diagnosis authorization for engine without camshaft sensor" UBYTE _CNV_S_2_RANGE______3_CM 1 0. 0. 1. ECU_ADDRESS 0xd000536f BIT_MASK 0x1 /end MEASUREMENT
/begin MEASUREMENT Vbx_main_cdn "Flag indicating general conditions for the detection of crankshaft absence are OK" UBYTE _CNV_S_2_RANGE______3_CM 1 0. 0. 1. ECU_ADDRESS 0xd0005370 BIT_MASK 0x1 /end MEASUREMENT
/begin MEASUREMENT Vbx_map_flu_cdn "Flag indicating manifold pressure variation are in the range of running engine" UBYTE _CNV_S_2_RANGE______3_CM 1 0. 0. 1. ECU_ADDRESS 0xd0005371 BIT_MASK 0x1 /end MEASUREMENT
/begin MEASUREMENT Vbx_pres_df_crk_chr "Consolidation of no cranshaft reference detection  detected failure" UBYTE _CNV_S_2_RANGE______3_CM 1 0. 0. 1. ECU_ADDRESS 0xd0004990 BIT_MASK 0x1 /end MEASUREMENT
/begin MEASUREMENT Vbx_pres_df_crk_cmp "Consolidation of incorrect number of crankshaft teeth detected failure" UBYTE _CNV_S_2_RANGE______3_CM 1 0. 0. 1. ECU_ADDRESS 0xd0004991 BIT_MASK 0x1 /end MEASUREMENT
/begin MEASUREMENT Vbx_pres_df_crk_cyc "Consolidation of interference between two crankshaft teeth detected failure" UBYTE _CNV_S_2_RANGE______3_CM 1 0. 0. 1. ECU_ADDRESS 0xd0004992 BIT_MASK 0x1 /end MEASUREMENT
/begin MEASUREMENT Vbx_pres_df_crk_no_sig "Consolidation of no crankshaft signal detected failure" UBYTE _CNV_S_2_RANGE______3_CM 1 0. 0. 1. ECU_ADDRESS 0xd0004993 BIT_MASK 0x1 /end MEASUREMENT
/begin MEASUREMENT Vbx_pres_df_crk_oc "Consolidation of open circuit of one of the leads of crankshaft sensor detected failure" UBYTE _CNV_S_2_RANGE______3_CM 1 0. 0. 1. ECU_ADDRESS 0xd0004994 BIT_MASK 0x1 /end MEASUREMENT
/begin MEASUREMENT Vbx_pres_df_crk_shp "Consolidation of no detection of crankshaft reference detected failure" UBYTE _CNV_S_2_RANGE______3_CM 1 0. 0. 1. ECU_ADDRESS 0xd0004995 BIT_MASK 0x1 /end MEASUREMENT
/begin MEASUREMENT Vbx_run_eng_det "Boolean indicating that the engine is running" UBYTE _CNV_S_2_RANGE______3_CM 1 0. 0. 1. ECU_ADDRESS 0xd0005372 BIT_MASK 0x1 /end MEASUREMENT
/begin MEASUREMENT Vsx_sens_crk_vld "Crankshaft sensor validity status" UBYTE _CNV_S_3_STATUS_OK__120_CM 1 0. 0. 2. ECU_ADDRESS 0xd0004996 /end MEASUREMENT
/begin MEASUREMENT Vxx_crk_syn_loss_ctr_ini "Initial value of Vxx_crk_syn_loss_ctr" UWORD _CNV_A_R_ECME_LINEA_0_CM 1 0. 0. 65535. ECU_ADDRESS 0xd00057c4 FORMAT "%5.0" /end MEASUREMENT
/begin MEASUREMENT Vxx_ctr_vld_crk_fail1 "Counter of the number of confirmation of the first detected failure \"No crankshft signal\"" UBYTE _CNV_A_R_ECME_LINEA_0_CM 1 0. 0. 255. ECU_ADDRESS 0xd0005373 FORMAT "%3.0" /end MEASUREMENT
/begin CHARACTERISTIC Cxx_dfdec_crk_chr "no cranshaft reference detection detected failure counter decrement" VALUE 0xa0021aba _REC_S1VAL_20_u2 65535. _CNV_A_R_ECME_LINEA_0_CM 0. 65535. FORMAT "%5.0" /end CHARACTERISTIC
/begin CHARACTERISTIC Cxx_dfdec_crk_cmp "Incorrect number of crankshaft teeth detected failure counter decrement" VALUE 0xa0021abc _REC_S1VAL_20_u2 65535. _CNV_A_R_ECME_LINEA_0_CM 0. 65535. FORMAT "%5.0" /end CHARACTERISTIC
/begin CHARACTERISTIC Cxx_dfdec_crk_cyc "Interference between two crankshaft teeth detected failure counter decrement" VALUE 0xa0021abe _REC_S1VAL_20_u2 65535. _CNV_A_R_ECME_LINEA_0_CM 0. 65535. FORMAT "%5.0" /end CHARACTERISTIC
/begin CHARACTERISTIC Cxx_dfdec_crk_no_sig "no crankshaft signal detected failure counter decrement" VALUE 0xa0021ac0 _REC_S1VAL_20_u2 65535. _CNV_A_R_ECME_LINEA_0_CM 0. 65535. FORMAT "%5.0" /end CHARACTERISTIC
/begin CHARACTERISTIC Cxx_dfdec_crk_oc "Open circuit of one of the leads of crankshaft sensor detected failure counter decrement" VALUE 0xa0021ac2 _REC_S1VAL_20_u2 65535. _CNV_A_R_ECME_LINEA_0_CM 0. 65535. FORMAT "%5.0" /end CHARACTERISTIC
/begin CHARACTERISTIC Cxx_dfdec_crk_shp "No detection of crankshaft reference detected failure counter decrement" VALUE 0xa0021ac4 _REC_S1VAL_20_u2 65535. _CNV_A_R_ECME_LINEA_0_CM 0. 65535. FORMAT "%5.0" /end CHARACTERISTIC
/begin CHARACTERISTIC Cxx_dfinc_crk_chr "no cranshaft reference detection detected failure counter increment" VALUE 0xa0021ac6 _REC_S1VAL_20_u2 65535. _CNV_A_R_ECME_LINEA_0_CM 0. 65535. FORMAT "%5.0" /end CHARACTERISTIC
/begin CHARACTERISTIC Cxx_dfinc_crk_cmp "Incorrect number of crankshaft teeth detected failure counter increment" VALUE 0xa0021ac8 _REC_S1VAL_20_u2 65535. _CNV_A_R_ECME_LINEA_0_CM 0. 65535. FORMAT "%5.0" /end CHARACTERISTIC
/begin CHARACTERISTIC Cxx_dfinc_crk_cyc "Interference between two crankshaft teeth detected failure counter increment" VALUE 0xa0021aca _REC_S1VAL_20_u2 65535. _CNV_A_R_ECME_LINEA_0_CM 0. 65535. FORMAT "%5.0" /end CHARACTERISTIC
/begin CHARACTERISTIC Cxx_dfinc_crk_no_sig "no crankshaft signal detected failure counter increment" VALUE 0xa0021acc _REC_S1VAL_20_u2 65535. _CNV_A_R_ECME_LINEA_0_CM 0. 65535. FORMAT "%5.0" /end CHARACTERISTIC
/begin CHARACTERISTIC Cxx_dfinc_crk_oc "Open circuit of one of the leads of crankshaft sensor detected failure counter increment" VALUE 0xa0021ace _REC_S1VAL_20_u2 65535. _CNV_A_R_ECME_LINEA_0_CM 0. 65535. FORMAT "%5.0" /end CHARACTERISTIC
/begin CHARACTERISTIC Cxx_dfinc_crk_shp "No detection of crankshaft reference detected failure counter increment" VALUE 0xa0021ad0 _REC_S1VAL_20_u2 65535. _CNV_A_R_ECME_LINEA_0_CM 0. 65535. FORMAT "%5.0" /end CHARACTERISTIC
/begin CHARACTERISTIC Cxx_h_dif_prs_dsb_sp "Maximal amplitude of the oscillations of manifold pressure" VALUE 0xa0021ad2 _REC_S1VAL_20_u2 20000. _CNV_A_R_LINEAR_____57_CM 0. 20000. FORMAT "%5.0" /end CHARACTERISTIC
/begin CHARACTERISTIC Cxx_h_thd_dif_prs_dsb_sp "Variation of vacuum pressure due to the rotation of starter" VALUE 0xa0021ad4 _REC_S1VAL_20_u2 20000. _CNV_A_R_LINEAR_____57_CM 0. 20000. FORMAT "%5.0" /end CHARACTERISTIC
/begin CHARACTERISTIC Cxx_h_thd_prs_sp_fail "Minimal vacuum pressure when starter is running" VALUE 0xa0021ad6 _REC_S1VAL_20_u2 20000. _CNV_A_R_LINEAR_____57_CM 0. 20000. FORMAT "%5.0" /end CHARACTERISTIC
/begin CHARACTERISTIC Cxx_l_thd_dif_prs_dsb_sp "Minimal amplitude of the oscillations of manifold pressure" VALUE 0xa0021ad8 _REC_S1VAL_20_u2 20000. _CNV_A_R_LINEAR_____57_CM 0. 20000. FORMAT "%5.0" /end CHARACTERISTIC
/begin CHARACTERISTIC Cxx_nr_vld_crk_fail1 "Number of confirmation of the first detected failure \"No crankshft signal\"" VALUE 0xa0021ada _REC_S1VAL_20_u1 255. _CNV_A_R_ECME_LINEA_0_CM 0. 255. FORMAT "%3.0" /end CHARACTERISTIC
/begin AXIS_PTS Ctb_n "20 programmable engine speed breakpoints map" 0xa00250e0 Vxx_n _REC_A2AXS_20_u2 16383.75 _CNV_A_R_ENSD_LINEA_24_CM 20 0. 16383.75 FORMAT "%8.2" /end AXIS_PTS
/begin AXIS_PTS Ctb_n2 "9 programmable engine speed breakpoints table" 0xa002510c Vxx_n _REC_A2AXS_20_u2 16383.75 _CNV_A_R_ENSD_LINEA_24_CM 9 0. 16383.75 FORMAT "%8.2" /end AXIS_PTS
/begin MEASUREMENT Vxb_n.factor "" UWORD _CNV_A_R_A_165_CM 1 0. 0. 65535. ECU_ADDRESS 0xd000475c /end MEASUREMENT
/begin MEASUREMENT Vxb_n.index "" UBYTE _CNV_A_R_A_165_CM 1 0. 0. 255. ECU_ADDRESS 0xd000475e /end MEASUREMENT
/begin MEASUREMENT Vxb_n.num_dp "" UBYTE _CNV_A_R_A_165_CM 1 0. 0. 255. ECU_ADDRESS 0xd000475f /end MEASUREMENT
/begin MEASUREMENT Vxb_n2.factor "" UWORD _CNV_A_R_A_165_CM 1 0. 0. 65535. ECU_ADDRESS 0xd0004760 /end MEASUREMENT
/begin MEASUREMENT Vxb_n2.index "" UBYTE _CNV_A_R_A_165_CM 1 0. 0. 255. ECU_ADDRESS 0xd0004762 /end MEASUREMENT
/begin MEASUREMENT Vxb_n2.num_dp "" UBYTE _CNV_A_R_A_165_CM 1 0. 0. 255. ECU_ADDRESS 0xd0004763 /end MEASUREMENT
/begin CHARACTERISTIC Ctp_tco_n_ini "Engine speed initialization depending on coolant temperature" CURVE 0xa0025120 _REC_A1CUR_20_u2_u2 16383.75 _CNV_A_R_ENSD_LINEA_24_CM 0. 16383.75 FORMAT "%8.2"
 /begin AXIS_DESCR COM_AXIS Vxx_tco _CNV_A_R_LINEAR_____54_CM 9 -40. 200. FORMAT "%5.1" AXIS_PTS_REF Ctb_tco2 /end AXIS_DESCR
/end CHARACTERISTIC
/begin MEASUREMENT Vbx_n_ini "initialization conditions" UBYTE _CNV_S_2_RANGE______3_CM 1 0. 0. 1. ECU_ADDRESS 0xd0004765 BIT_MASK 0x1 /end MEASUREMENT
/begin MEASUREMENT Vsx_n_vld "Engine speed validity status" UBYTE _CNV_S_3_STATUS_OK__120_CM 1 0. 0. 2. ECU_ADDRESS 0xd0004764 /end MEASUREMENT
/begin MEASUREMENT Vxx_n "Engine Speed" UWORD _CNV_A_R_ENSD_LINEA_24_CM 1 0. 0. 16383.75 ECU_ADDRESS 0xd00039c8 FORMAT "%8.2" /end MEASUREMENT
/begin MEASUREMENT Vxx_tdc_per "tdc period (32bits)" ULONG _CNV_A_R_LINEAR_____303_CM 1 0. 0. 1. ECU_ADDRESS 0xd000207c FORMAT "%9.7" /end MEASUREMENT
/begin CHARACTERISTIC Cxx_tdc_rev_nr "ratio of one complete revolution on one tdc duration" VALUE 0xa00218d0 _REC_S1VAL_20_u1 4. _CNV_A_R_LINEAR_____304_CM 0. 4. FORMAT "%6.4" /end CHARACTERISTIC
/begin MEASUREMENT Vxb_n2_mv.factor "" UWORD _CNV_A_R_A_165_CM 1 0. 0. 65535. ECU_ADDRESS 0xd0004250 /end MEASUREMENT
/begin MEASUREMENT Vxb_n2_mv.index "" UBYTE _CNV_A_R_A_165_CM 1 0. 0. 255. ECU_ADDRESS 0xd0004252 /end MEASUREMENT
/begin MEASUREMENT Vxb_n2_mv.num_dp "" UBYTE _CNV_A_R_A_165_CM 1 0. 0. 255. ECU_ADDRESS 0xd0004253 /end MEASUREMENT
/begin MEASUREMENT Vxb_n_mv.factor "" UWORD _CNV_A_R_A_165_CM 1 0. 0. 65535. ECU_ADDRESS 0xd0004254 /end MEASUREMENT
/begin MEASUREMENT Vxb_n_mv.index "" UBYTE _CNV_A_R_A_165_CM 1 0. 0. 255. ECU_ADDRESS 0xd0004256 /end MEASUREMENT
/begin MEASUREMENT Vxb_n_mv.num_dp "" UBYTE _CNV_A_R_A_165_CM 1 0. 0. 255. ECU_ADDRESS 0xd0004257 /end MEASUREMENT
/begin CHARACTERISTIC Ctp_gear_n_mv_ftc "filtering time constant for engine speed" CURVE 0xa0021468 _REC_A1CUR_20_u1_u1 2.55 _CNV_A_R_LINEAR_____34_CM 0. 2.55 FORMAT "%4.2"
 /begin AXIS_DESCR COM_AXIS Vxx_gear _CNV_A_R_LINEAR_____113_CM 8 -1. 6. READ_ONLY FORMAT "%2.0" AXIS_PTS_REF Ntb_gear /end AXIS_DESCR
/end CHARACTERISTIC
/begin MEASUREMENT Vxx_n_mv "filtered engine speed" UWORD _CNV_A_R_ENSD_LINEA_24_CM 1 0. 0. 16383.75 ECU_ADDRESS 0xd000330c FORMAT "%8.2" /end MEASUREMENT
/begin MEASUREMENT Vxx_n_mv_raw "filtered engine speed" UWORD _CNV_A_R_ENSD_LINEA_24_CM 1 0. 0. 16383.75 ECU_ADDRESS 0xd000330e FORMAT "%8.2" /end MEASUREMENT
/begin MEASUREMENT Vbx_eng_syn "Engine synchronization" UBYTE _CNV_S_2_RANGE______3_CM 1 0. 0. 1. ECU_ADDRESS 0xd0004841 BIT_MASK 0x1 /end MEASUREMENT
/begin MEASUREMENT Vxx_eng_angl "Angular position of engine" UWORD _CNV_A_R_LINEAR_____76_CM 1 0. 0. 719.98 ECU_ADDRESS 0xd0003120 FORMAT "%6.2" /end MEASUREMENT
/begin MEASUREMENT Vxx_tdc_ctr "TDC counter, indicates wich cylinder is active" UBYTE _CNV_A_R_LINEAR_____55_CM 1 0. 0. 3. ECU_ADDRESS 0xd0004842 FORMAT "%1.0" /end MEASUREMENT
/begin MEASUREMENT Vxx_mv_n_drv "derivate of engine speed after moving average" SWORD _CNV_A_R_LINEAR_____23_CM 1 0. -8192. 8191. ECU_ADDRESS 0xd0003a88 FORMAT "%5.0" /end MEASUREMENT
/begin MEASUREMENT Vxx_n_drv "derivate of engine speed" SWORD _CNV_A_R_LINEAR_____23_CM 1 0. -8192. 8191. ECU_ADDRESS 0xd0003a8a FORMAT "%5.0" /end MEASUREMENT
/begin MEASUREMENT Vxx_raw_n_drv "raw derivate of engine speed" SWORD _CNV_A_R_LINEAR_____23_CM 1 0. -8192. 8191. ECU_ADDRESS 0xd0003a8c FORMAT "%5.0" /end MEASUREMENT
/begin CHARACTERISTIC Cxx_n_drv_fil_fac "first order filter factor for engine speed derivate" VALUE 0xa0020a38 _REC_S1VAL_20_u2 1. _CNV_A_R_LINEAR_____93_CM 0. 1. FORMAT "%11.9" /end CHARACTERISTIC
/begin MEASUREMENT Vbx_trz_clc_ena "TLZ/TRZ calculation enabled." UBYTE _CNV_S_2_RANGE______3_CM 1 0. 0. 1. ECU_ADDRESS 0xd0004b3f BIT_MASK 0x1 /end MEASUREMENT
/begin MEASUREMENT Vxx_trz_t_toth_0 "Duration of 30∞ Crk package" ULONG _CNV_A_R_LINEAR_____305_CM 1 0. 0. 52428800. ECU_ADDRESS 0xd000241a FORMAT "%8.0" /end MEASUREMENT
/begin MEASUREMENT Vxx_trz_t_toth_0_nxt "Duration of 30∞ Crk package ( Vxx_trz_t_toth_0_nxt (i) = Vxx_trz_t_toth_0 (i+1) )" ULONG _CNV_A_R_LINEAR_____305_CM 1 0. 0. 52428800. ECU_ADDRESS 0xd000241e FORMAT "%8.0" /end MEASUREMENT
/begin MEASUREMENT Vxx_trz_t_toth_1 "Duration of 30∞ Crk package" ULONG _CNV_A_R_LINEAR_____305_CM 1 0. 0. 52428800. ECU_ADDRESS 0xd0002422 FORMAT "%8.0" /end MEASUREMENT
/begin MEASUREMENT Vxx_trz_t_toth_2 "Duration of 30∞ Crk package" ULONG _CNV_A_R_LINEAR_____305_CM 1 0. 0. 52428800. ECU_ADDRESS 0xd0002426 FORMAT "%8.0" /end MEASUREMENT
/begin MEASUREMENT Vxx_trz_t_toth_3 "Duration of 30∞ Crk package" ULONG _CNV_A_R_LINEAR_____305_CM 1 0. 0. 52428800. ECU_ADDRESS 0xd000242a FORMAT "%8.0" /end MEASUREMENT
/begin MEASUREMENT Vxx_trz_t_toth_4 "Duration of 30∞ Crk package" ULONG _CNV_A_R_LINEAR_____305_CM 1 0. 0. 52428800. ECU_ADDRESS 0xd000242e FORMAT "%8.0" /end MEASUREMENT
/begin MEASUREMENT Vxx_trz_t_toth_5 "Duration of 30∞ Crk package" ULONG _CNV_A_R_LINEAR_____305_CM 1 0. 0. 52428800. ECU_ADDRESS 0xd0002432 FORMAT "%8.0" /end MEASUREMENT
/begin MEASUREMENT Vxx_trz_t_toth_5_prev "Duration of 30∞ Crk package ( Vxx_trz_t_toth_5_prev (i) = Vxx_trz_t_toth_5 (i-1) )" ULONG _CNV_A_R_LINEAR_____305_CM 1 0. 0. 52428800. ECU_ADDRESS 0xd0002436 FORMAT "%8.0" /end MEASUREMENT
/begin MEASUREMENT Vbx_clu_stal_ini "Boolean for clutch engine stalling detection to the initialization" UBYTE _CNV_S_2_RANGE______3_CM 1 0. 0. 1. ECU_ADDRESS 0xd000476d BIT_MASK 0x1 /end MEASUREMENT
/begin MEASUREMENT Vbx_igk_stal_eng_n_thd "Boolean for the reset of clutch engine stalling and software lock conditions" UBYTE _CNV_S_2_RANGE______3_CM 1 0. 0. 1. ECU_ADDRESS 0xd000476e BIT_MASK 0x1 /end MEASUREMENT
/begin MEASUREMENT Vbx_sta_stal "Boolean for no starting engine stalling detection" UBYTE _CNV_S_2_RANGE______3_CM 1 0. 0. 1. ECU_ADDRESS 0xd000476f BIT_MASK 0x1 /end MEASUREMENT
/begin MEASUREMENT Vbx_swlk_stal_ini "Boolean for no starting software lock engine stalling detection to the initialization" UBYTE _CNV_S_2_RANGE______3_CM 1 0. 0. 1. ECU_ADDRESS 0xd0004770 BIT_MASK 0x1 /end MEASUREMENT
/begin CHARACTERISTIC Cxx_igk_stal_eng_n_thd "Engine speed threshold for the reset of clutch engine stalling and software lock conditions" VALUE 0xa0021906 _REC_S1VAL_20_u2 16383.75 _CNV_A_R_ENSD_LINEA_24_CM 0. 16383.75 FORMAT "%8.2" /end CHARACTERISTIC
/begin CHARACTERISTIC Cxx_set_stal_dly "Initialization value of the delay used to detect the engine stalled condition" VALUE 0xa0021908 _REC_S1VAL_20_u1 2.55 _CNV_A_R_LINEAR_____34_CM 0. 2.55 FORMAT "%4.2" /end CHARACTERISTIC
/begin CHARACTERISTIC Cxx_stal_det_swlk_dly "Delay before we declare the stalled state due to the software lock" VALUE 0xa0021909 _REC_S1VAL_20_u1 2.55 _CNV_A_R_LINEAR_____34_CM 0. 2.55 FORMAT "%4.2" /end CHARACTERISTIC
/begin AXIS_PTS Ntb_gear "Gearbox ratio breakpoint" 0xa002ac48 Vxx_gear _REC_A2AXS_20_u1 7. _CNV_A_R_LINEAR_____113_CM 8 -1. 6. READ_ONLY FORMAT "%2.0" /end AXIS_PTS
/begin MEASUREMENT Vsx_vh_eng "CAN output data indicating the engine states" UBYTE _CNV_A_R_ECME_LINEA_0_CM 1 0. 0. 255. ECU_ADDRESS 0xd0004587 FORMAT "%3.0" /end MEASUREMENT
/begin CHARACTERISTIC Cxx_ini_stop_dly "Inhibition delay of the judgement of the engine stop state" VALUE 0xa0021676 _REC_S1VAL_20_u2 655.35 _CNV_A_R_LINEAR_____34_CM 0. 655.35 FORMAT "%6.2" /end CHARACTERISTIC
/begin CHARACTERISTIC Ctp_eng_diag_spg_dly "The engine speed delay to enable diagnosis" CURVE 0xa002310c _REC_A1CUR_20_u2_u2 655.35 _CNV_A_R_LINEAR_____34_CM 0. 655.35 FORMAT "%6.2"
 /begin AXIS_DESCR COM_AXIS Vxx_n _CNV_A_R_ENSD_LINEA_24_CM 9 0. 16383.75 FORMAT "%8.2" AXIS_PTS_REF Ctb_n2 /end AXIS_DESCR
/end CHARACTERISTIC
/begin MEASUREMENT Vbx_df_spg_reg_apl_down "Negative deviation of the turbocharger detected failure" UBYTE _CNV_S_2_RANGE______3_CM 1 0. 0. 1. ECU_ADDRESS 0xd0005608 BIT_MASK 0x1 /end MEASUREMENT
/begin MEASUREMENT Vbx_df_spg_reg_apl_up "Positive deviation of the turbocharger detected failure" UBYTE _CNV_S_2_RANGE______3_CM 1 0. 0. 1. ECU_ADDRESS 0xd0005609 BIT_MASK 0x1 /end MEASUREMENT
/begin MEASUREMENT Vbx_spg_dev_int_rst "Reset flag for the criteria calculation" UBYTE _CNV_S_2_RANGE______3_CM 1 0. 0. 1. ECU_ADDRESS 0xd000560a BIT_MASK 0x1 /end MEASUREMENT
/begin MEASUREMENT Vbx_spg_diag_int_cdn "Engine conditions allowing the continuous diagnosis of the turbocharger" UBYTE _CNV_S_2_RANGE______3_CM 1 0. 0. 1. ECU_ADDRESS 0xd000560b BIT_MASK 0x1 /end MEASUREMENT
/begin MEASUREMENT Vbx_spg_prs_dly "Flag for the engine speed delay" UBYTE _CNV_S_2_RANGE______3_CM 1 0. 0. 1. ECU_ADDRESS 0xd000465f BIT_MASK 0x1 /end MEASUREMENT
/begin MEASUREMENT Vbx_spg_prs_err_sgn "Governor error sign : 1=positive deviation 0=negative deviation" UBYTE _CNV_S_2_RANGE______3_CM 1 0. 0. 1. ECU_ADDRESS 0xd000560c BIT_MASK 0x1 /end MEASUREMENT
/begin MEASUREMENT Vbx_spg_prs_init "Flag for the init delay" UBYTE _CNV_S_2_RANGE______3_CM 1 0. 0. 1. ECU_ADDRESS 0xd0004660 BIT_MASK 0x1 /end MEASUREMENT
/begin MEASUREMENT Vbx_spg_prs_sp_min "Flag for minimum boost pressure set point acquiered" UBYTE _CNV_S_2_RANGE______3_CM 1 0. 0. 1. ECU_ADDRESS 0xd000560d BIT_MASK 0x1 /end MEASUREMENT
/begin MEASUREMENT Vbx_spg_reg_apl_down "Turbocharger negative deviation sample flag" UBYTE _CNV_S_2_RANGE______3_CM 1 0. 0. 1. ECU_ADDRESS 0xd000560e BIT_MASK 0x1 /end MEASUREMENT
/begin MEASUREMENT Vbx_spg_reg_apl_up "Turbocharger positive deviation sample flag" UBYTE _CNV_S_2_RANGE______3_CM 1 0. 0. 1. ECU_ADDRESS 0xd000560f BIT_MASK 0x1 /end MEASUREMENT
/begin MEASUREMENT Vsx_spg_reg_vld "Boost pressure regulation validity criteria" UBYTE _CNV_S_3_STATUS_OK__120_CM 1 0. 0. 2. ECU_ADDRESS 0xd0004661 /end MEASUREMENT
/begin MEASUREMENT Vxx_dt1_exp "" UWORD _CNV_A_R_LINEAR_____433_CM 1 0. 0. 9. ECU_ADDRESS 0xd00057c6 FORMAT "%5.4" /end MEASUREMENT
/begin MEASUREMENT Vxx_spg_dev_int "Integrated criteria raw value" ULONG _CNV_A_R_LINEAR_____434_CM 1 0. 0. 10000. ECU_ADDRESS 0xd00028e4 FORMAT "%7.1" /end MEASUREMENT
/begin MEASUREMENT Vxx_spg_int_in "Value of the integrator input" UWORD _CNV_A_R_LINEAR_____57_CM 1 0. 0. 10000. ECU_ADDRESS 0xd00057c8 FORMAT "%5.0" /end MEASUREMENT
/begin MEASUREMENT Vxx_spg_prs_dly "Engine speed delay to enable diagnosis" UWORD _CNV_A_R_LINEAR_____34_CM 1 0. 0. 655.35 ECU_ADDRESS 0xd0003530 FORMAT "%6.2" /end MEASUREMENT
/begin MEASUREMENT Vxx_spg_prs_sp_dt1 "Derivative value of the filtered pressure set point" SWORD _CNV_A_R_LINEAR_____435_CM 1 0. -10000. 10000. ECU_ADDRESS 0xd00057ca FORMAT "%6.0" /end MEASUREMENT
/begin MEASUREMENT Vxx_spg_prs_sp_fil "Filtered boost pressure set point" UWORD _CNV_A_R_LINEAR_____57_CM 1 0. 0. 20000. ECU_ADDRESS 0xd00057cc FORMAT "%5.0" /end MEASUREMENT
/begin MEASUREMENT Vxx_spg_reg_apl_down "Negative deviation diagnostic criteria" ULONG _CNV_A_R_LINEAR_____434_CM 1 0. 0. 10000. ECU_ADDRESS 0xd00028e8 FORMAT "%7.1" /end MEASUREMENT
/begin MEASUREMENT Vxx_spg_reg_apl_up "Positive deviation diagnostic criteria" ULONG _CNV_A_R_LINEAR_____434_CM 1 0. 0. 10000. ECU_ADDRESS 0xd00028ec FORMAT "%7.1" /end MEASUREMENT
/begin CHARACTERISTIC Cbx_run_eng_ena_inhi "Boolean enabling boost pressure diagnostic during engine stop requests" VALUE 0xa00217ea _REC_S1VAL_20_u1 1. _CNV_A_R_ECME_LINEA_0_CM 0. 1. FORMAT "%1.0" BIT_MASK 0x1 /end CHARACTERISTIC
/begin CHARACTERISTIC Cbx_spg_prs_sp_min "Boolean which disables minimum pressure setpoint threshold depending on altitude" VALUE 0xa00217eb _REC_S1VAL_20_u1 1. _CNV_A_R_ECME_LINEA_0_CM 0. 1. FORMAT "%1.0" BIT_MASK 0x1 /end CHARACTERISTIC
/begin CHARACTERISTIC Cbx_spg_reg_fail_cfm "Boolean to choose if the Vsx_spg_reg_vld is in nok_0 or fail_2 when Vsx_amp_vld is in nok_0" VALUE 0xa00217ec _REC_S1VAL_20_u1 1. _CNV_A_R_ECME_LINEA_0_CM 0. 1. FORMAT "%1.0" BIT_MASK 0x1 /end CHARACTERISTIC
/begin CHARACTERISTIC Cbx_up_thr_prs_sens "Boolean which indicate if the engine has a pressure sensor before the inlet throttle" VALUE 0xa00217ed _REC_S1VAL_20_u1 1. _CNV_A_R_ECME_LINEA_0_CM 0. 1. FORMAT "%1.0" BIT_MASK 0x1 /end CHARACTERISTIC
/begin CHARACTERISTIC Cxx_dfdec_spg_reg_apl_down "Turbocharger negative deviation detected failure counter decrement" VALUE 0xa00217ca _REC_S1VAL_20_u2 65535. _CNV_A_R_ECME_LINEA_0_CM 0. 65535. FORMAT "%5.0" /end CHARACTERISTIC
/begin CHARACTERISTIC Cxx_dfdec_spg_reg_apl_up "Turbocharger positive deviation detected failure counter decrement" VALUE 0xa00217cc _REC_S1VAL_20_u2 65535. _CNV_A_R_ECME_LINEA_0_CM 0. 65535. FORMAT "%5.0" /end CHARACTERISTIC
/begin CHARACTERISTIC Cxx_dfinc_spg_reg_apl_down "Turbocharger negative deviation detected failure counter increment" VALUE 0xa00217ce _REC_S1VAL_20_u2 65535. _CNV_A_R_ECME_LINEA_0_CM 0. 65535. FORMAT "%5.0" /end CHARACTERISTIC
/begin CHARACTERISTIC Cxx_dfinc_spg_reg_apl_up "Turbocharger positive deviation detected failure counter increment" VALUE 0xa00217d0 _REC_S1VAL_20_u2 65535. _CNV_A_R_ECME_LINEA_0_CM 0. 65535. FORMAT "%5.0" /end CHARACTERISTIC
/begin CHARACTERISTIC Cxx_spg_n_thd_max "Maximum engine speed to allow continuous diagnosis" VALUE 0xa00217d2 _REC_S1VAL_20_u2 16383.75 _CNV_A_R_ENSD_LINEA_24_CM 0. 16383.75 FORMAT "%8.2" /end CHARACTERISTIC
/begin CHARACTERISTIC Cxx_spg_n_thd_min "Minimum engine speed to allow continuous diagnosis" VALUE 0xa00217d4 _REC_S1VAL_20_u2 16383.75 _CNV_A_R_ENSD_LINEA_24_CM 0. 16383.75 FORMAT "%8.2" /end CHARACTERISTIC
/begin CHARACTERISTIC Cxx_spg_prs_err_min "Minimum boost air pressure governor error to take into account the diagnosis criteria" VALUE 0xa00217d6 _REC_S1VAL_20_s2 1000. _CNV_A_R_LINEAR_____57_CM -500. 500. FORMAT "%6.0" /end CHARACTERISTIC
/begin CHARACTERISTIC Cxx_spg_prs_sp_dev_max "Maximum pressure set point deviation allowed to enable the continuous diagnosis of the turbocharger" VALUE 0xa00217d8 _REC_S1VAL_20_u2 10000. _CNV_A_R_LINEAR_____110_CM 0. 10000. FORMAT "%5.0" /end CHARACTERISTIC
/begin CHARACTERISTIC Cxx_spg_prs_sp_dev_min "Minimum pressure set point deviation allowed to init the enable diagnosis delay" VALUE 0xa00217da _REC_S1VAL_20_s2 20000. _CNV_A_R_LINEAR_____435_CM -10000. 10000. FORMAT "%6.0" /end CHARACTERISTIC
/begin CHARACTERISTIC Cxx_spg_prs_sp_dt1_fac "DT1 gain for filtered boost air pressure set point" VALUE 0xa00217dc _REC_S1VAL_20_u2 50. _CNV_A_R_LINEAR_____349_CM 0. 50. FORMAT "%5.2" /end CHARACTERISTIC
/begin CHARACTERISTIC Cxx_spg_prs_sp_dt1_t "DT1 time constant for filtered boost air pressure" VALUE 0xa00217de _REC_S1VAL_20_u2 65.535 _CNV_A_R_LINEAR_____58_CM 0. 65.535 /end CHARACTERISTIC
/begin CHARACTERISTIC Cxx_spg_prs_sp_min "Minimum boost air pressure set point (Cbx_spg_prs_sp_min=1) or atmospheric pressure additive threshold (Cbx_spg_prs_sp_min=0)" VALUE 0xa00217e0 _REC_S1VAL_20_u2 4000. _CNV_A_R_LINEAR_____57_CM 0. 4000. FORMAT "%5.0" /end CHARACTERISTIC
/begin CHARACTERISTIC Cxx_spg_prs_sp_t_fil "Time constant of boost air pressure first order filter" VALUE 0xa00217e2 _REC_S1VAL_20_u2 65.535 _CNV_A_R_LINEAR_____58_CM 0. 65.535 /end CHARACTERISTIC
/begin CHARACTERISTIC Cxx_spg_reg_apl_down_thd "Threshold of negative deviation of the turbocharger" VALUE 0xa00217e4 _REC_S1VAL_20_u2 10000. _CNV_A_R_LINEAR_____436_CM 0. 10000. FORMAT "%5.0" /end CHARACTERISTIC
/begin CHARACTERISTIC Cxx_spg_reg_apl_up_thd "Threshold of positive deviation of the turbocharger" VALUE 0xa00217e6 _REC_S1VAL_20_u2 10000. _CNV_A_R_LINEAR_____436_CM 0. 10000. FORMAT "%5.0" /end CHARACTERISTIC
/begin CHARACTERISTIC Cxx_spg_sys_diag_dly "Intersystem setpoint time allowing the continuous diagnosis of the turbocharger" VALUE 0xa00217e8 _REC_S1VAL_20_u2 655.35 _CNV_A_R_LINEAR_____34_CM 0. 655.35 FORMAT "%6.2" /end CHARACTERISTIC
/begin AXIS_PTS Ctb_diag_in_vvtc_sp_cyc_t_bkp "Table of duration breakpoints used with the cartography Ctp_diag_in_vvtc_angl_sp_cyc" 0xa002a720 Vxx_diag_in_vvtc_sp_cyc_t _REC_A2AXS_20_u2 655.35 _CNV_A_R_LINEAR_____34_CM 32 0. 655.35 FORMAT "%6.2" /end AXIS_PTS
/begin CHARACTERISTIC Ctp_diag_in_vvtc_angl_sp_cyc "Cartography with specific VVTC setpoints used for aftersales routine" CURVE 0xa002a764 _REC_A1CUR_20_u2_u2 719.98 _CNV_A_R_LINEAR_____76_CM 0. 719.98 FORMAT "%6.2"
 /begin AXIS_DESCR COM_AXIS Vxx_diag_in_vvtc_sp_cyc_t _CNV_A_R_LINEAR_____34_CM 32 0. 655.35 FORMAT "%6.2" AXIS_PTS_REF Ctb_diag_in_vvtc_sp_cyc_t_bkp /end AXIS_DESCR
/end CHARACTERISTIC
/begin MEASUREMENT Vbx_diag_in_vvtc_ena_bgin_test "Beginning of VVTC actuation test (aftersales routine)" UBYTE _CNV_S_2_RANGE______3_CM 1 0. 0. 1. ECU_ADDRESS 0xd0004c27 BIT_MASK 0x1 /end MEASUREMENT
/begin MEASUREMENT Vbx_diag_in_vvtc_n_cdn_ok "Engine speed condition OK for VVTC actuation test (aftersales routine)" UBYTE _CNV_S_2_RANGE______3_CM 1 0. 0. 1. ECU_ADDRESS 0xd0004c28 BIT_MASK 0x1 /end MEASUREMENT
/begin MEASUREMENT Vbx_diag_in_vvtc_nok_n_cdn "Engine speed condition NOK during VVTC actuation test (aftersales routine)" UBYTE _CNV_S_2_RANGE______3_CM 1 0. 0. 1. ECU_ADDRESS 0xd0004c29 BIT_MASK 0x1 /end MEASUREMENT
/begin MEASUREMENT Vbx_diag_in_vvtc_test_ok "VVTC actuation finished" UBYTE _CNV_S_2_RANGE______3_CM 1 0. 0. 1. ECU_ADDRESS 0xd0004c2a BIT_MASK 0x1 /end MEASUREMENT
/begin MEASUREMENT Vbx_diag_sta_vvtc_abrt "VVTC actuation test aborted (aftersales routine)" UBYTE _CNV_S_2_RANGE______3_CM 1 0. 0. 1. ECU_ADDRESS 0xd0004c2b BIT_MASK 0x1 /end MEASUREMENT
/begin MEASUREMENT Vbx_diag_sta_vvtc_ena "Activation of the VVTC routine" UBYTE _CNV_S_2_RANGE______3_CM 1 0. 0. 1. ECU_ADDRESS 0xd0004c2c BIT_MASK 0x1 /end MEASUREMENT
/begin MEASUREMENT Vbx_diag_sta_vvtc_end "End of the VVTC actuation test (aftersales routine)" UBYTE _CNV_S_2_RANGE______3_CM 1 0. 0. 1. ECU_ADDRESS 0xd0004c2d BIT_MASK 0x1 /end MEASUREMENT
/begin MEASUREMENT Vsx_diag_sta_vvtc_stt "VVT aftersales routine status" UBYTE _CNV_S_4_RANGE_ROUT_335_CM 1 0. 0. 3. ECU_ADDRESS 0xd0004c2e /end MEASUREMENT
/begin MEASUREMENT Vxx_diag_in_vvtc_n_sub_val "Engine speed substitute value for VVT actuation test (aftersales routine)" UWORD _CNV_A_R_ENSD_LINEA_24_CM 1 0. 0. 16383.75 ECU_ADDRESS 0xd00030b0 FORMAT "%8.2" /end MEASUREMENT
/begin MEASUREMENT Vxx_diag_in_vvtc_sp_cyc_t "Variable used to display time for the cartographie Ctp_diag_in_vvtc_angl_sp_cyc" UWORD _CNV_A_R_LINEAR_____34_CM 1 0. 0. 655.35 ECU_ADDRESS 0xd00030b2 FORMAT "%6.2" /end MEASUREMENT
/begin MEASUREMENT Vxx_diag_in_vvtc_sp_sub_val "Angular setpoint subsitute value for VVTC actuation test (with aftersales routine)" UWORD _CNV_A_R_LINEAR_____76_CM 1 0. 0. 719.98 ECU_ADDRESS 0xd00030b4 FORMAT "%6.2" /end MEASUREMENT
/begin CHARACTERISTIC Cxx_diag_in_vvtc_n_ena_thd "Engine speed thershold to start VVTC actuation test" VALUE 0xa0020780 _REC_S1VAL_20_u2 16383.75 _CNV_A_R_ENSD_LINEA_24_CM 0. 16383.75 FORMAT "%8.2" /end CHARACTERISTIC
/begin CHARACTERISTIC Cxx_diag_in_vvtc_n_nok_drg_test "Duration to detect that engine speed value not coherent with VVTC actuation test (aftersales routine)" VALUE 0xa0020782 _REC_S1VAL_20_u2 655.35 _CNV_A_R_LINEAR_____34_CM 0. 655.35 FORMAT "%6.2" /end CHARACTERISTIC
/begin CHARACTERISTIC Cxx_diag_in_vvtc_n_stab_t "Duration to consider that engine speed reached the stabilization value" VALUE 0xa0020784 _REC_S1VAL_20_u2 655.35 _CNV_A_R_LINEAR_____34_CM 0. 655.35 FORMAT "%6.2" /end CHARACTERISTIC
/begin CHARACTERISTIC Cxx_diag_in_vvtc_n_sub_val "Engine speed substitute value for VVTC actuation test (aftersales routine)" VALUE 0xa0020786 _REC_S1VAL_20_u2 16383.75 _CNV_A_R_ENSD_LINEA_24_CM 0. 16383.75 FORMAT "%8.2" /end CHARACTERISTIC
/begin CHARACTERISTIC Cxx_diag_in_vvtc_sp_cyc_t "VVTC actuation duration (aftersales routine)" VALUE 0xa0020788 _REC_S1VAL_20_u2 655.35 _CNV_A_R_LINEAR_____34_CM 0. 655.35 FORMAT "%6.2" /end CHARACTERISTIC
/begin COMPU_METHOD _CNV_A_R_ECME_LINEA_0_CM "" RAT_FUNC "%6.3" "-" COEFFS 0 1. 0. 0 0 1 /end COMPU_METHOD
/begin COMPU_METHOD _CNV_S_2_RANGE______3_CM "" TAB_VERB "%6.3" "-" COMPU_TAB_REF _CNV_S_2_RANGE______3 /end COMPU_METHOD
/begin COMPU_VTAB _CNV_S_2_RANGE______3 "" TAB_VERB 2 0 "0" 1 "1" /end COMPU_VTAB
/begin COMPU_METHOD _CNV_A_R_LINEAR_____4_CM "" RAT_FUNC "%6.3" "s" COEFFS 0 10. 0. 0 0 1 /end COMPU_METHOD
/begin COMPU_METHOD _CNV_A_R_LINEAR_____16_CM "" RAT_FUNC "%6.3" "V" COEFFS 0 6553.599999999993 0. 0 0 1 /end COMPU_METHOD
/begin COMPU_METHOD _CNV_A_R_LINEAR_____23_CM "" RAT_FUNC "%6.3" "rpm/s" COEFFS 0 1. 0. 0 0 1 /end COMPU_METHOD
/begin COMPU_METHOD _CNV_A_R_ENSD_LINEA_24_CM "" RAT_FUNC "%6.3" "rpm" COEFFS 0 4. 0. 0 0 1 /end COMPU_METHOD
/begin COMPU_METHOD _CNV_A_R_LINEAR_____31_CM "" RAT_FUNC "%6.3" "-" COEFFS 0 256. 0. 0 0 1 /end COMPU_METHOD
/begin COMPU_METHOD _CNV_A_R_LINEAR_____34_CM "" RAT_FUNC "%6.3" "s" COEFFS 0 100. 0. 0 0 1 /end COMPU_METHOD
/begin COMPU_METHOD _CNV_A_R_LINEAR_____41_CM "" RAT_FUNC "%6.3" "V" COEFFS 0 9.846153846153847 0. 0 0 1 /end COMPU_METHOD
/begin COMPU_METHOD _CNV_A_R_LINEAR_____42_CM "" RAT_FUNC "%6.3" "∞C" COEFFS 0 1.333333333333333 64. 0 0 1 /end COMPU_METHOD
/begin COMPU_METHOD _CNV_A_R_LINEAR_____43_CM "" RAT_FUNC "%6.3" "-" COEFFS 0 128. 0. 0 0 1 /end COMPU_METHOD
/begin COMPU_METHOD _CNV_A_R_LINEAR_____52_CM "" RAT_FUNC "%6.3" "mV" COEFFS 0 1. 0. 0 0 1 /end COMPU_METHOD
/begin COMPU_METHOD _CNV_A_R_LINEAR_____54_CM "" RAT_FUNC "%6.3" "∞C" COEFFS 0 10. 400. 0 0 1 /end COMPU_METHOD
/begin COMPU_METHOD _CNV_A_R_LINEAR_____55_CM "" RAT_FUNC "%6.3" "TDC" COEFFS 0 1. 0. 0 0 1 /end COMPU_METHOD
/begin COMPU_METHOD _CNV_A_R_LINEAR_____57_CM "" RAT_FUNC "%6.3" "hPa" COEFFS 0 1. 0. 0 0 1 /end COMPU_METHOD
/begin COMPU_METHOD _CNV_A_R_LINEAR_____58_CM "" RAT_FUNC "%6.3" "s" COEFFS 0 1000. 0. 0 0 1 /end COMPU_METHOD
/begin COMPU_METHOD _CNV_A_R_LINEAR_____70_CM "" RAT_FUNC "%6.3" "km/h" COEFFS 0 100. 0. 0 0 1 /end COMPU_METHOD
/begin COMPU_METHOD _CNV_A_R_LINEAR_____76_CM "" RAT_FUNC "%6.3" "∞CRK" COEFFS 0 50. 0. 0 0 1 /end COMPU_METHOD
/begin COMPU_METHOD _CNV_A_R_LINEAR_____93_CM "" RAT_FUNC "%6.3" "-" COEFFS 0 65535. 0. 0 0 1 /end COMPU_METHOD
/begin COMPU_METHOD _CNV_A_R_LINEAR_____94_CM "" RAT_FUNC "%6.3" "%" COEFFS 0 100. 0. 0 0 1 /end COMPU_METHOD
/begin COMPU_METHOD _CNV_A_R_LINEAR_____107_CM "" RAT_FUNC "%6.3" "hPa" COEFFS 0 1. 10000. 0 0 1 /end COMPU_METHOD
/begin COMPU_METHOD _CNV_A_R_LINEAR_____108_CM "" RAT_FUNC "%6.3" "-" COEFFS 0 1000. 0. 0 0 1 /end COMPU_METHOD
/begin COMPU_METHOD _CNV_A_R_LINEAR_____109_CM "" RAT_FUNC "%6.3" "kg/h" COEFFS 0 20. 0. 0 0 1 /end COMPU_METHOD
/begin COMPU_METHOD _CNV_A_R_LINEAR_____110_CM "" RAT_FUNC "%6.3" "hPa/s" COEFFS 0 0.1 0. 0 0 1 /end COMPU_METHOD
/begin COMPU_METHOD _CNV_A_R_LINEAR_____111_CM "" RAT_FUNC "%6.3" "hPa/s" COEFFS 0 3.333333333333333e-002 0. 0 0 1 /end COMPU_METHOD
/begin COMPU_METHOD _CNV_A_R_LINEAR_____112_CM "" RAT_FUNC "%6.3" "%/hPa" COEFFS 0 19393.93939393939 0. 0 0 1 /end COMPU_METHOD
/begin COMPU_METHOD _CNV_A_R_LINEAR_____113_CM "" RAT_FUNC "%6.3" "-" COEFFS 0 1. 1. 0 0 1 /end COMPU_METHOD
/begin COMPU_METHOD _CNV_A_R_LINEAR_____114_CM "" RAT_FUNC "%6.3" "%" COEFFS 0 2.55 0. 0 0 1 /end COMPU_METHOD
/begin COMPU_METHOD _CNV_A_R_LINEAR_____115_CM "" RAT_FUNC "%6.3" "%/hPa" COEFFS 0 606.2041202936301 0. 0 0 1 /end COMPU_METHOD
/begin COMPU_METHOD _CNV_A_R_LINEAR_____116_CM "" RAT_FUNC "%6.3" "%/hPa" COEFFS 0 64. 0. 0 0 1 /end COMPU_METHOD
/begin COMPU_METHOD _CNV_A_R_LINEAR_____117_CM "" RAT_FUNC "%6.3" "%" COEFFS 0 655.3599999999997 -1.455191522836685e-011 0 0 1 /end COMPU_METHOD
/begin COMPU_METHOD _CNV_A_R_LINEAR_____118_CM "" RAT_FUNC "%6.3" "-" COEFFS 0 255. 0. 0 0 1 /end COMPU_METHOD
/begin COMPU_METHOD _CNV_A_R_LINEAR_____119_CM "" RAT_FUNC "%6.3" "hpa/(kg/h)≤" COEFFS 0 100000. 0. 0 0 1 /end COMPU_METHOD
/begin COMPU_METHOD _CNV_S_3_STATUS_OK__120_CM "" TAB_VERB "%6.3" "-" COMPU_TAB_REF _CNV_S_3_STATUS_OK__120 /end COMPU_METHOD
/begin COMPU_VTAB _CNV_S_3_STATUS_OK__120 "" TAB_VERB 3 0 "Nsx_vld_nok_0" 1 "Nsx_vld_ok_1" 2 "Nsx_vld_fail_2" /end COMPU_VTAB
/begin COMPU_METHOD _CNV_S_4_STATUS_OK__121_CM "" TAB_VERB "%6.3" "-" COMPU_TAB_REF _CNV_S_4_STATUS_OK__121 /end COMPU_METHOD
/begin COMPU_VTAB _CNV_S_4_STATUS_OK__121 "" TAB_VERB 4 0 "Nsx_vld_nok_0" 1 "Nsx_vld_ok_1" 2 "Nsx_vld_fail_2" 3 "Nsx_vld_fail_3" /end COMPU_VTAB
/begin COMPU_METHOD _CNV_A_R_LINEAR_____122_CM "" RAT_FUNC "%6.3" "%" COEFFS 0 655.35 0. 0 0 1 /end COMPU_METHOD
/begin COMPU_METHOD _CNV_A_R_LINEAR_____123_CM "" RAT_FUNC "%6.3" "Nm" COEFFS 0 32. 0. 0 0 1 /end COMPU_METHOD
/begin COMPU_METHOD _CNV_A_R_LINEAR_____124_CM "" RAT_FUNC "%6.3" "rpm" COEFFS 0 4. 32768. 0 0 1 /end COMPU_METHOD
/begin COMPU_METHOD _CNV_A_R_LINEAR_____125_CM "" RAT_FUNC "%6.3" "-" COEFFS 0 1024. 0. 0 0 1 /end COMPU_METHOD
/begin COMPU_METHOD _CNV_A_R_LINEAR_____126_CM "" RAT_FUNC "%6.3" "Nms/rpm" COEFFS 0 1024. 0. 0 0 1 /end COMPU_METHOD
/begin COMPU_METHOD _CNV_A_R_LINEAR_____127_CM "" RAT_FUNC "%6.3" "Nm" COEFFS 0 32. 32768. 0 0 1 /end COMPU_METHOD
/begin COMPU_METHOD _CNV_A_R_LINEAR_____128_CM "" RAT_FUNC "%6.3" "W" COEFFS 0 0.1 0. 0 0 1 /end COMPU_METHOD
/begin COMPU_METHOD _CNV_A_R_LINEAR_____129_CM "" RAT_FUNC "%6.3" "rpm/s" COEFFS 0 1. 8192. 0 0 1 /end COMPU_METHOD
/begin COMPU_METHOD _CNV_S_6_RANGE_STAT_130_CM "" TAB_VERB "%6.3" "-" COMPU_TAB_REF _CNV_S_6_RANGE_STAT_130 /end COMPU_METHOD
/begin COMPU_VTAB _CNV_S_6_RANGE_STAT_130 "" TAB_VERB 6 2 "Nsx_out_is" 4 "Nsx_tkof_is" 8 "Nsx_sta_is" 16 "Nsx_ast_is" 32 "Nsx_cdn_is" 64 "Nsx_act_is" /end COMPU_VTAB
/begin COMPU_METHOD _CNV_A_R_LINEAR_____131_CM "" RAT_FUNC "%6.3" "[-]" COEFFS 0 1024. 0. 0 0 1 /end COMPU_METHOD
/begin COMPU_METHOD _CNV_A_R_LINEAR_____132_CM "" RAT_FUNC "%6.3" "s/rpm" COEFFS 0 512000.0000000001 0. 0 0 1 /end COMPU_METHOD
/begin COMPU_METHOD _CNV_A_R_LINEAR_____133_CM "" RAT_FUNC "%6.3" "Nm/(rpm.s)" COEFFS 0 1024. 0. 0 0 1 /end COMPU_METHOD
/begin COMPU_METHOD _CNV_A_R_LINEAR_____134_CM "" RAT_FUNC "%6.3" "Nm" COEFFS 0 320000. 0. 0 0 1 /end COMPU_METHOD
/begin COMPU_METHOD _CNV_A_R_LINEAR_____135_CM "" RAT_FUNC "%6.3" "Nm/rpm" COEFFS 0 8192. 0. 0 0 1 /end COMPU_METHOD
/begin COMPU_METHOD _CNV_A_R_LINEAR_____136_CM "" RAT_FUNC "%6.3" "-" COEFFS 0 100. 0. 0 0 1 /end COMPU_METHOD
/begin COMPU_METHOD _CNV_A_R_LINEAR_____137_CM "" RAT_FUNC "%6.3" "Nm/rpm" COEFFS 0 1024. 0. 0 0 1 /end COMPU_METHOD
/begin COMPU_METHOD _CNV_A_R_LINEAR_____138_CM "" RAT_FUNC "%6.3" "Nm/s" COEFFS 0 -32. 0. 0 0 1 /end COMPU_METHOD
/begin COMPU_METHOD _CNV_A_R_LINEAR_____139_CM "" RAT_FUNC "%6.3" "Nm/s" COEFFS 0 32. 0. 0 0 1 /end COMPU_METHOD
/begin COMPU_METHOD _CNV_A_R_LINEAR_____140_CM "" RAT_FUNC "%6.3" "(km/h)/K*rpm" COEFFS 0 100. 1000. 0 0 1 /end COMPU_METHOD
/begin COMPU_METHOD _CNV_A_R_LINEAR_____141_CM "" RAT_FUNC "%6.3" "s/s" COEFFS 0 -100. 0. 0 0 1 /end COMPU_METHOD
/begin COMPU_METHOD _CNV_A_R_LINEAR_____142_CM "" RAT_FUNC "%6.3" "s/s" COEFFS 0 100. 0. 0 0 1 /end COMPU_METHOD
/begin COMPU_METHOD _CNV_A_R_LINEAR_____143_CM "" RAT_FUNC "%6.3" "Nm/rpm" COEFFS 0 5120. 512. 0 0 1 /end COMPU_METHOD
/begin COMPU_METHOD _CNV_A_R_LINEAR_____144_CM "" RAT_FUNC "%6.3" "ms" COEFFS 0 1. 0. 0 0 1 /end COMPU_METHOD
/begin COMPU_METHOD _CNV_A_R_LINEAR_____145_CM "" RAT_FUNC "%6.3" "µs" COEFFS 0 1. 0. 0 0 1 /end COMPU_METHOD
/begin COMPU_METHOD _CNV_A_R_LINEAR_____146_CM "" RAT_FUNC "%6.3" "V" COEFFS 0 204.6 0. 0 0 1 /end COMPU_METHOD
/begin COMPU_METHOD _CNV_S_16_RANGE_ERR__147_CM "" TAB_VERB "%6.3" "-" COMPU_TAB_REF _CNV_S_16_RANGE_ERR__147 /end COMPU_METHOD
/begin COMPU_VTAB _CNV_S_16_RANGE_ERR__147 "" TAB_VERB 16 0 "NO_SYM" 1 "SYM_0" 2 "SYM_1" 3 "SYM_0, SYM_1" 4 "SYM_2" 5 "SYM_0, SYM_2" 6 "SYM_1, SYM_2" 7 "SYM_0, SYM_1, SYM_2" 8 "SYM_3" 9 "SYM_0, SYM_3" 10 "SYM_1, SYM_3" 11 "SYM_0, SYM_1,SYM_3" 12 "SYM_2, SYM_3" 13 "SYM_0, SYM_2, SYM_3" 14 "SYM_1, SYM_2, SYM_3" 15 "SYM_0, SYM_1, SYM_2, SYM_3" /end COMPU_VTAB
/begin COMPU_METHOD _CNV_A_R_LINEAR_____148_CM "" RAT_FUNC "%6.3" "mg/stk" COEFFS 0 47.18142548596112 0. 0 0 1 /end COMPU_METHOD
/begin COMPU_METHOD _CNV_A_R_LINEAR_____150_CM "" RAT_FUNC "%6.3" "V" COEFFS 0 100. 0. 0 0 1 /end COMPU_METHOD
/begin COMPU_METHOD _CNV_A_R_LINEAR_____153_CM "" RAT_FUNC "%6.3" "s" COEFFS 0 25. 0. 0 0 1 /end COMPU_METHOD
/begin COMPU_METHOD _CNV_A_R_LINEAR_____154_CM "" RAT_FUNC "%6.3" "V" COEFFS 0 102.3 0. 0 0 1 /end COMPU_METHOD
/begin COMPU_METHOD _CNV_A_R_LINEAR_____157_CM "" RAT_FUNC "%6.3" "V" COEFFS 0 1137.777777777778 0. 0 0 1 /end COMPU_METHOD
/begin COMPU_METHOD _CNV_A_R_A_165_CM "" RAT_FUNC "%6.3" "" COEFFS 0 1. 0. 0 0 1 /end COMPU_METHOD
/begin COMPU_METHOD _CNV_A_R_LINEAR_____228_CM "" RAT_FUNC "%6.3" "-" COEFFS 0 1024. 32768. 0 0 1 /end COMPU_METHOD
/begin COMPU_METHOD _CNV_A_R_LINEAR_____229_CM "" RAT_FUNC "%6.3" "∞CRK/s" COEFFS 0 -50. 0. 0 0 1 /end COMPU_METHOD
/begin COMPU_METHOD _CNV_A_R_LINEAR_____230_CM "" RAT_FUNC "%6.3" "∞CRK/s" COEFFS 0 50. 0. 0 0 1 /end COMPU_METHOD
/begin COMPU_METHOD _CNV_A_R_LINEAR_____303_CM "" RAT_FUNC "%6.3" "s" COEFFS 0 312500. 0. 0 0 1 /end COMPU_METHOD
/begin COMPU_METHOD _CNV_A_R_LINEAR_____304_CM "" RAT_FUNC "%6.3" "-" COEFFS 0 6. 0. 0 0 1 /end COMPU_METHOD
/begin COMPU_METHOD _CNV_A_R_LINEAR_____305_CM "" RAT_FUNC "%6.3" "ns" COEFFS 0 1.e-002 0. 0 0 1 /end COMPU_METHOD
/begin COMPU_METHOD _CNV_S_4_RANGE_ROUT_335_CM "" TAB_VERB "%6.3" "-" COMPU_TAB_REF _CNV_S_4_RANGE_ROUT_335 /end COMPU_METHOD
/begin COMPU_VTAB _CNV_S_4_RANGE_ROUT_335 "" TAB_VERB 4 0 "Nsx_diag_sta_disa_stt" 1 "Nsx_diag_sta_run_stt" 2 "Nsx_diag_sta_end_stt" 3 "Nsx_diag_sta_abrt_stt" /end COMPU_VTAB
/begin COMPU_METHOD _CNV_A_R_LINEAR_____349_CM "" RAT_FUNC "%6.3" "1/s" COEFFS 0 100. 0. 0 0 1 /end COMPU_METHOD
/begin COMPU_METHOD _CNV_A_R_LINEAR_____433_CM "" RAT_FUNC "%6.3" "-" COEFFS 0 7281.666666666667 0. 0 0 1 /end COMPU_METHOD
/begin COMPU_METHOD _CNV_A_R_LINEAR_____434_CM "" RAT_FUNC "%6.3" "hPa*s" COEFFS 0 10. 0. 0 0 1 /end COMPU_METHOD
/begin COMPU_METHOD _CNV_A_R_LINEAR_____435_CM "" RAT_FUNC "%6.3" "[hPa/s]" COEFFS 0 0.1 0. 0 0 1 /end COMPU_METHOD
/begin COMPU_METHOD _CNV_A_R_LINEAR_____436_CM "" RAT_FUNC "%6.3" "hPa*s" COEFFS 0 1. 0. 0 0 1 /end COMPU_METHOD
/begin RECORD_LAYOUT _REC_S1VAL_20_u1 FNC_VALUES 1 UBYTE COLUMN_DIR DIRECT /end RECORD_LAYOUT
/begin RECORD_LAYOUT _REC_A2AXS_20_u1 NO_AXIS_PTS_X 1 UBYTE AXIS_PTS_X 2 UBYTE INDEX_INCR DIRECT /end RECORD_LAYOUT
/begin RECORD_LAYOUT _REC_S1VAL_20_u2 FNC_VALUES 1 UWORD COLUMN_DIR DIRECT /end RECORD_LAYOUT
/begin RECORD_LAYOUT _REC_S1VAL_20_s2 FNC_VALUES 1 SWORD COLUMN_DIR DIRECT /end RECORD_LAYOUT
/begin RECORD_LAYOUT _REC_A2AXS_20_u2 NO_AXIS_PTS_X 1 UWORD AXIS_PTS_X 2 UWORD INDEX_INCR DIRECT /end RECORD_LAYOUT
/begin RECORD_LAYOUT _REC_A1CUR_20_u1_u2 FNC_VALUES 1 UBYTE COLUMN_DIR DIRECT /end RECORD_LAYOUT
/begin RECORD_LAYOUT _REC_A1CUR_20_u1_u1 FNC_VALUES 1 UBYTE COLUMN_DIR DIRECT /end RECORD_LAYOUT
/begin RECORD_LAYOUT _REC_A1CUR_20_u2_u1 FNC_VALUES 1 UWORD COLUMN_DIR DIRECT /end RECORD_LAYOUT
/begin RECORD_LAYOUT _REC_A1MAP_20_u2_u2_u2 FNC_VALUES 1 UWORD COLUMN_DIR DIRECT /end RECORD_LAYOUT
/begin RECORD_LAYOUT _REC_A1CUR_20_u2_u2 FNC_VALUES 1 UWORD COLUMN_DIR DIRECT /end RECORD_LAYOUT
/begin RECORD_LAYOUT _REC_A1MAP_20_u1_u2_u2 FNC_VALUES 1 UBYTE COLUMN_DIR DIRECT /end RECORD_LAYOUT
/begin RECORD_LAYOUT _REC_A1MAP_20_u1_u2_u1 FNC_VALUES 1 UBYTE COLUMN_DIR DIRECT /end RECORD_LAYOUT
/begin RECORD_LAYOUT _REC_A1MAP_20_u2_u1_u2 FNC_VALUES 1 UWORD COLUMN_DIR DIRECT /end RECORD_LAYOUT
/begin FUNCTION AsBstCtl_Wgsptxx ""
 /begin DEF_CHARACTERISTIC Ctb_spg_ol_map_sp Ctb_spg_prs_err Ctb_spg_prs_err_drv Ctb_thr_psn Cmp_spg_i_pwm_fac Cmp_spg_ol_pwm Cmp_spg_ol_pwm_thr_n Cmp_spg_prop_pwm_fac Ctp_spg_cl_spg_prs_thd Ctp_spg_drv_pwm_fac Ctp_spg_prs_dif_thd_trs Cbx_spg_bch_mod Cbx_spg_rams_cfm Cbx_spg_tq_off_mod Cxx_spg_ad_alti_thd Cxx_spg_ad_down_vb_thd Cxx_spg_ad_n_thd Cxx_spg_ad_pwm_fac Cxx_spg_ad_pwm_max_cor Cxx_spg_ad_pwm_min_cor Cxx_spg_ad_spg_thd Cxx_spg_ad_stab_prs_thd Cxx_spg_ad_up_vb_thd Cxx_spg_alti_ofs_fac Cxx_spg_alti_ofs_ofs Cxx_spg_alti_ol_pwm_fac Cxx_spg_cl_tco_thd Cxx_spg_down_ad_dz Cxx_spg_err_down_thd_drv Cxx_spg_err_drv_ftc Cxx_spg_err_up_thd_drv Cxx_spg_i_aw_fac Cxx_spg_i_pwm_max_cor Cxx_spg_i_pwm_min_cor Cxx_spg_i_pwm_sp Cxx_spg_max_err_drv Cxx_spg_max_pwm Cxx_spg_max_pwm_aw Cxx_spg_min_err_drv Cxx_spg_min_pwm Cxx_spg_min_pwm_aw Cxx_spg_ol_spg_sp_thd Cxx_spg_prop_dz Cxx_spg_pwm_bch_mod_val Cxx_spg_pwm_dif_trt_ad Cxx_spg_up_ad_dz /end DEF_CHARACTERISTIC
 /begin OUT_MEASUREMENT Vbx_spg_ad_cdn Vbx_spg_cl_cdn Vbx_spg_i_frz Vbx_spg_ol_cdn Vbx_spg_pwm_dsb_req Vbx_spg_trs Vxx_alti_cor_map_sp Vxx_ol_spg_pwm Vxx_spg_ad_pwm_inc Vxx_spg_alti_ofs Vxx_spg_cl_pwm Vxx_spg_d_pwm Vxx_spg_fil_prs_err Vxx_spg_fil_prs_err_drv Vxx_spg_i_aw_cor Vxx_spg_i_pwm Vxx_spg_p_pwm Vxx_spg_prs_err Vxx_spg_pwm_sp Vxx_spg_raw_fil_prs_err_drv /end OUT_MEASUREMENT
/end FUNCTION
/begin FUNCTION AsBstCtl_Limitxx "" /begin DEF_CHARACTERISTIC Ctp_max_pump_maf Ctp_max_rel_map_sp /end DEF_CHARACTERISTIC /begin OUT_MEASUREMENT Vxx_max_spg_prs Vxx_pump_max_maf /end OUT_MEASUREMENT /end FUNCTION
/begin FUNCTION AsBstCtl_Prsctxx ""
 /begin DEF_CHARACTERISTIC Ctp_max_map_inj_cut Cxx_map_drv_inj_cut Cxx_nr_tdc_inj_cut Cxx_prs_thd_inj_cut /end DEF_CHARACTERISTIC
 /begin OUT_MEASUREMENT Vbx_ovp_inj_cut Vxx_dly_inj_cut Vxx_map_drv Vxx_map_thd_inj_cut Vxx_max_map_inj_cut /end OUT_MEASUREMENT
/end FUNCTION
/begin FUNCTION AsBstCtl_Bpcdmxx ""
 /begin DEF_CHARACTERISTIC Ctp_eng_diag_spg_dly Cbx_run_eng_ena_inhi Cbx_spg_prs_sp_min Cbx_spg_reg_fail_cfm Cbx_up_thr_prs_sens Cxx_dfdec_spg_reg_apl_down Cxx_dfdec_spg_reg_apl_up Cxx_dfinc_spg_reg_apl_down Cxx_dfinc_spg_reg_apl_up Cxx_spg_n_thd_max Cxx_spg_n_thd_min Cxx_spg_prs_err_min Cxx_spg_prs_sp_dev_max Cxx_spg_prs_sp_dev_min Cxx_spg_prs_sp_dt1_fac Cxx_spg_prs_sp_dt1_t Cxx_spg_prs_sp_min Cxx_spg_prs_sp_t_fil Cxx_spg_reg_apl_down_thd Cxx_spg_reg_apl_up_thd Cxx_spg_sys_diag_dly /end DEF_CHARACTERISTIC
 /begin OUT_MEASUREMENT Vbx_df_spg_reg_apl_down Vbx_df_spg_reg_apl_up Vbx_spg_dev_int_rst Vbx_spg_diag_int_cdn Vbx_spg_prs_dly Vbx_spg_prs_err_sgn Vbx_spg_prs_init Vbx_spg_prs_sp_min Vbx_spg_reg_apl_down Vbx_spg_reg_apl_up Vsx_spg_reg_vld Vxx_dt1_exp Vxx_spg_dev_int Vxx_spg_int_in Vxx_spg_prs_dly Vxx_spg_prs_sp_dt1 Vxx_spg_prs_sp_fil Vxx_spg_reg_apl_down Vxx_spg_reg_apl_up /end OUT_MEASUREMENT
/end FUNCTION
/begin FUNCTION AsBstCtl_Alcoxxx "" /begin DEF_CHARACTERISTIC Cmp_spg_ol_pwm_alco /end DEF_CHARACTERISTIC /begin OUT_MEASUREMENT Vxx_spg_ol_pwm_alco /end OUT_MEASUREMENT /end FUNCTION
/begin FUNCTION InAsiPbt "" /begin SUB_FUNCTION InAsiPbt_Btprsxx_xxxxxg /end SUB_FUNCTION /end FUNCTION
/begin FUNCTION InAsiPbt_Btprsxx_xxxxxg ""
 /begin DEF_CHARACTERISTIC Ctb_pump_maf Ctb_spg_pwm Cmp_ex_prs_dif_fac Cxx_ex_prs_fail_val Cxx_spg_pwm_sp_ftc Cxx_tbn_prs_dif_cut_fac /end DEF_CHARACTERISTIC
 /begin OUT_MEASUREMENT Vsx_ex_prs_mdl_vld Vsx_ex_prs_vld Vxx_ex_prs Vxx_ex_prs_mdl Vxx_spg_pwm_sp_fil Vxx_up_tbn_prs_dif Vxx_up_tbn_prs_dif_fac /end OUT_MEASUREMENT
/end FUNCTION
/begin FUNCTION AsAerVvt "VVT Command" /begin SUB_FUNCTION AsAerVvt_Inspxxx AsAerVvt_Inspclc AsAerVvt_Routmng /end SUB_FUNCTION /end FUNCTION
/begin FUNCTION AsAerVvt_Inspxxx ""
 /begin DEF_CHARACTERISTIC Ctb_in_vvtc_angl_sp_ftc_n Ctb_tq_rat Cmp_n_tq_cwup_vvtc_in_angl Cmp_n_tq_vvtc_in_angl Ctp_in_vvtc_angl_sp_ftc Ctp_n_vvtc_trs_in_angl Ctp_trs_in_vvtc_angl_sp_ftc Cxx_vvtc_angl_dec_slop Cxx_vvtc_angl_inc_slop Cxx_vvtc_angl_trs_dly Cxx_vvtc_trs_amp_thd Cxx_vvtc_trs_dly Cxx_vvtc_trs_n_thd Cxx_vvtc_trs_tco_thd Cxx_vvtc_trs_vs_thd /end DEF_CHARACTERISTIC
 /begin OUT_MEASUREMENT Vbx_vvtc_spg_trs_cdn Vbx_vvtc_trs Vxx_cata_wup_vvtc_in_angl Vxx_vvtc_in_angl_sp_nom Vxx_vvtc_in_angl_sp_tgt Vxx_vvtc_in_angl_sp_trs Vxx_vvtc_in_angl_sp_wup Vxx_vvtc_in_angl_sp_wup_raw /end OUT_MEASUREMENT
/end FUNCTION
/begin FUNCTION AsAerVvt_Inspclc ""
 /begin DEF_CHARACTERISTIC Ctb_in_vvtc_act_cold_temp_n_bkp Ctb_in_vvtc_act_hot_temp_n_bkp Ctb_in_vvtc_angl_sp_cyc_t_bkp Ctp_in_vvtc_act_cold_temp_thd Ctp_in_vvtc_act_hot_thd_1 Ctp_in_vvtc_act_hot_thd_2 Ctp_in_vvtc_angl_sp_cyc Cbx_in_vvtc_angl_sp_cho Cbx_in_vvtc_angl_sp_cho_bch Cbx_in_vvtc_cho_angl_vld Cbx_in_vvtc_cho_sldv_vld Cbx_in_vvtc_cho_tco_toil_cold Cbx_in_vvtc_cho_tco_toil_hot Cbx_in_vvtc_cold_act_cdn Cbx_in_vvtc_hot_act_cdn Cxx_in_vvtc_act_cold_temp_hys Cxx_in_vvtc_act_ena_max_vb_thd Cxx_in_vvtc_act_ena_min_vb_thd Cxx_in_vvtc_act_ena_n_hys Cxx_in_vvtc_act_ena_n_thd Cxx_in_vvtc_act_ena_vb_hys Cxx_in_vvtc_act_hot_temp_hys_1 Cxx_in_vvtc_act_hot_temp_hys_2 Cxx_in_vvtc_angl_sp_bch Cxx_in_vvtc_angl_sp_cyc_t Cxx_in_vvtc_angl_sp_h_lim_thd Cxx_in_vvtc_dsb_ena_fil_inc Cxx_in_vvtc_eng_wup_t Cxx_in_vvtc_inh_h_n_hys Cxx_in_vvtc_inh_h_n_thd Cxx_in_vvtc_n_thd_inh_hot Cxx_in_vvtc_sldv_ena_n_hys Cxx_in_vvtc_sldv_ena_n_thd Cxx_in_vvtc_t_ena_sldv_cyc Cxx_in_vvtc_temp_thd_max_sldv Cxx_in_vvtc_temp_thd_min_sldv /end DEF_CHARACTERISTIC
 /begin OUT_MEASUREMENT Vbx_in_vvtc_act_ena_vb Vbx_in_vvtc_ena_run Vbx_in_vvtc_ena_sldv_cln Vbx_in_vvtc_h_n_inh Vbx_in_vvtc_inh_zon Vbx_in_vvtc_risk_zon Vbx_in_vvtc_sp_fail Vxx_in_vvtc_act_ena_fac Vxx_in_vvtc_angl_sp Vxx_in_vvtc_angl_sp_bch Vxx_in_vvtc_angle_sp_cyc_t /end OUT_MEASUREMENT
/end FUNCTION
/begin FUNCTION AsAerVvt_Routmng ""
 /begin DEF_CHARACTERISTIC Ctb_diag_in_vvtc_sp_cyc_t_bkp Ctp_diag_in_vvtc_angl_sp_cyc Cxx_diag_in_vvtc_n_ena_thd Cxx_diag_in_vvtc_n_nok_drg_test Cxx_diag_in_vvtc_n_stab_t Cxx_diag_in_vvtc_n_sub_val Cxx_diag_in_vvtc_sp_cyc_t /end DEF_CHARACTERISTIC
 /begin OUT_MEASUREMENT Vbx_diag_in_vvtc_ena_bgin_test Vbx_diag_in_vvtc_n_cdn_ok Vbx_diag_in_vvtc_nok_n_cdn Vbx_diag_in_vvtc_test_ok Vbx_diag_sta_vvtc_abrt Vbx_diag_sta_vvtc_ena Vbx_diag_sta_vvtc_end Vsx_diag_sta_vvtc_stt Vxx_diag_in_vvtc_n_sub_val Vxx_diag_in_vvtc_sp_cyc_t Vxx_diag_in_vvtc_sp_sub_val /end OUT_MEASUREMENT
/end FUNCTION
/begin FUNCTION SmIsrCtl "" /begin OUT_MEASUREMENT Vxx_is_ad_tq /end OUT_MEASUREMENT
 /begin SUB_FUNCTION SmIsrCtl_Dervxxx SmIsrCtl_Hookxxx SmIsrCtl_Idactxx SmIsrCtl_Intxxxx SmIsrCtl_Propxxx SmIsrCtl_Tkodlxx SmIsrCtl_Idctrxx SmIsrCtl_Adaptxx SmIsrCtl_Tkocoxx SmIsrCtl_Ctlfacx SmIsrCtl_Schedul /end SUB_FUNCTION
/end FUNCTION
/begin FUNCTION SmIsrCtl_Dervxxx ""
 /begin DEF_CHARACTERISTIC Ctb_is_n_d_dif Ctb_is_tco Ctp_is_d_err_fac Ctp_is_d_gear_fac Ctp_is_d_max Ctp_is_d_min Ctp_is_d_tco_fac Cxx_fac_n_d Cxx_is_d_pft_rgn_fac /end DEF_CHARACTERISTIC
 /begin OUT_MEASUREMENT Vbx_ini_drv Vxx_dif_n_sp_grd Vxx_is_d_cor Vxx_is_d_fac Vxx_max_is_d Vxx_min_is_d Vxx_mmv_n_dif_drv Vxx_raw_n_dif_drv /end OUT_MEASUREMENT
/end FUNCTION
/begin FUNCTION SmIsrCtl_Hookxxx ""
 /begin DEF_CHARACTERISTIC Cbx_is_blk_vh_run_cfm Cbx_on_ac_cor_cfm Cbx_on_alt_cor_cfm Cbx_on_mdf_cor_cfm Cbx_on_pwst_cor_cfm Cxx_fast_ad_cdn_dly Cxx_h_blk_is_alt_pow Cxx_is_i_zon_out_dly Cxx_l_blk_is_alt_pow Cxx_min_is_i_ofs /end DEF_CHARACTERISTIC
 /begin OUT_MEASUREMENT Vbx_blk_n Vbx_is_blk_n_cdn Vbx_is_blk_vh Vxx_is_i_zon_out_dly /end OUT_MEASUREMENT
/end FUNCTION
/begin FUNCTION SmIsrCtl_Idactxx ""
 /begin DEF_CHARACTERISTIC Ctb_is_in_ofs_drv Ctd_is_in_ofs_drv Ctp_is_in_tco_ofs Ctp_is_out_sta_dly Ctp_sta_off_ofs Cbx_tq_trs_ctl_mux_cfm Cxx_ac_is_in_cdn_ofs Cxx_ac_is_in_cdn_ofs2 Cxx_ac_is_in_dly Cxx_ac_is_out_n_ofs Cxx_fac_n_drv_d Cxx_fac_n_drv_fil Cxx_is_act_ofs Cxx_is_ast_ofs_zon Cxx_is_cdn_h_sta_n_dly Cxx_is_deci_in_dly Cxx_is_deci_in_n_thd Cxx_is_fil_drv_n_max_ofs Cxx_is_fil_drv_n_min Cxx_is_in_cdn_ofs Cxx_is_in_cdn_ofs2 Cxx_is_in_dly Cxx_is_in_pump_thd Cxx_is_in_wit_pdl_ofs Cxx_is_n_act Cxx_is_n_act_hys Cxx_is_n_stab_clc_fac Cxx_is_n_stab_clc_ini Cxx_is_n_stab_drv_thd Cxx_is_out_ast_dly Cxx_is_out_drv_thd Cxx_is_out_n_ofs Cxx_is_out_n_ofs_sta Cxx_is_out_n_run_vh_thd Cxx_is_out_n_stop_vh_thd Cxx_is_out_pump_thd Cxx_is_out_wit_pdl_ofs Cxx_n_drv_ast Cxx_n_drv_out Cxx_sta_stt_is_in_dly /end DEF_CHARACTERISTIC
 /begin OUT_MEASUREMENT Vbx_is_act Vbx_old_igk_cut Vbx_sta Vsx_is Vsx_is_raw Vsx_mc Vxx_is_ast_ofs Vxx_is_cdn_h_n_dly Vxx_is_in_deci_dly Vxx_is_in_dly Vxx_is_in_n_thd Vxx_is_n_stab_fac Vxx_is_out_ast_dly Vxx_is_out_n_thd Vxx_is_out_sta_dly Vxx_n_drv_is Vxx_n_drv_sub Vxx_sta_off_ofs /end OUT_MEASUREMENT
/end FUNCTION
/begin FUNCTION SmIsrCtl_Intxxxx ""
 /begin DEF_CHARACTERISTIC Ctb_is_n_i_dif Cmp_is_i_err_tco_fac Cmp_tco_ini_i Ctp_is_i_gear_fac Ctp_tco_ini_i_sta Ctp_tco_tqe_max_is_i Cbx_i_set_is_cfm Cbx_ini_i_tco_cfm Cbx_is_cdn_i_act_cfm Cbx_is_int_ftc_n_cfm Cxx_blk_n_i_fac_cor Cxx_blk_n_min_is_i Cxx_fil_is_i_sp Cxx_ini_i_fac Cxx_is_i_out_fil_fac Cxx_is_i_out_fil_wit_pdl_fac Cxx_is_i_pft_rgn_fac Cxx_is_i_set_ofs Cxx_is_i_tq_trs_ctl_mux_n_in Cxx_is_i_tq_trs_ctl_mux_n_out Cxx_is_n_max_is_i Cxx_is_n_max_is_i_grd Cxx_is_n_min_is_i Cxx_is_n_min_is_i_grd Cxx_vh_run_max_is_i_ofs Cxx_vh_run_min_is_i_fac Cxx_vh_stop_min_is_i_fac /end DEF_CHARACTERISTIC
 /begin OUT_MEASUREMENT Vtx_ini_i[0] Vtx_ini_i[1] Vxx_is_i_cor Vxx_is_i_cor_ini Vxx_is_i_cor_ini_ad Vxx_is_i_cor_prev Vxx_is_i_cor_wio_set Vxx_is_i_cor_wit_set Vxx_is_i_fac Vxx_is_i_out_fil Vxx_is_n_is_i Vxx_is_n_is_i_grd Vxx_max_is_i Vxx_min_is_i Vxx_min_is_i_wio_blk Vxx_tqe_ini_i /end OUT_MEASUREMENT
/end FUNCTION
/begin FUNCTION SmIsrCtl_Propxxx ""
 /begin DEF_CHARACTERISTIC Ctb_is_n_p_dif Cmp_is_p_err_tco_fac Ctp_is_p_gear_fac Ctp_is_p_max Ctp_is_p_min Ctp_is_p_sta_fac Cbx_tq_trs_ctl_mux_p_cfm Cxx_is_ctl_mux_min_p Cxx_is_p_dec_slop Cxx_is_p_inc_slop Cxx_is_p_pft_rgn_fac Cxx_is_p_sta_max /end DEF_CHARACTERISTIC
 /begin OUT_MEASUREMENT Vtx_is_p_fac[0] Vtx_is_p_fac[1] Vxx_dif_n_sp Vxx_is_gear Vxx_is_p_cor Vxx_max_is_p Vxx_min_is_p /end OUT_MEASUREMENT
/end FUNCTION
/begin FUNCTION SmIsrCtl_Tkodlxx ""
 /begin DEF_CHARACTERISTIC Cxx_tkof_ena_vs_thd Cxx_tkof_end_vs_thd Cxx_tkof_n_grd_end_thd Cxx_tkof_vs_n_rat_stop_thd /end DEF_CHARACTERISTIC
 /begin OUT_MEASUREMENT Vbx_tkof_vs_ena /end OUT_MEASUREMENT
/end FUNCTION
/begin FUNCTION SmIsrCtl_Idctrxx ""
 /begin DEF_CHARACTERISTIC Ctb_is_n_dif Ctp_raw_p_d_fac Cbx_cdn_is_fil_tgt_cfm Cbx_tq_pow_is_cfm Cxx_is_tgt_ftc Cxx_is_tgt_ftc_dec_slop Cxx_is_tgt_ftc_inc_slop Cxx_mfld_dly_dec_slop Cxx_mfld_dly_inc_slop /end DEF_CHARACTERISTIC
 /begin OUT_MEASUREMENT Vxx_is_tqe_raw Vxx_is_tqe_sp Vxx_is_tqe_tgt Vxx_raw_raw_is_tqe Vxx_raw_sp_is_tqe Vxx_raw_tgt_is_tqe /end OUT_MEASUREMENT
/end FUNCTION
/begin FUNCTION SmIsrCtl_Adaptxx ""
 /begin DEF_CHARACTERISTIC Cbx_is_ad_mdf_cfm Cxx_ac_pow Cxx_ad_cor_dsb_dly Cxx_dri_agb_ad_is_fil Cxx_h_ad_is_alt_pow Cxx_is_ad_tq_dft Cxx_is_i_fil_fac1 Cxx_is_i_fil_fac2 Cxx_l_ad_is_alt_pow Cxx_max_is_ad_tq Cxx_max_n_ad_sp_dif Cxx_min_is_ad_tq Cxx_min_tco_ad_cor Cxx_neut_ad_is_fil /end DEF_CHARACTERISTIC
 /begin OUT_MEASUREMENT Vbx_is_ad_cdn Vxx_fil_is_i_cor Vxx_fil_is_i_cor_ad Vxx_fil_is_i_cor_ad_last Vxx_is_ad_tq_ini Vxx_is_ad_tq_last Vxx_is_ad_tq_raw /end OUT_MEASUREMENT
/end FUNCTION
/begin FUNCTION SmIsrCtl_Tkocoxx ""
 /begin DEF_CHARACTERISTIC Ctb_n_dif_tkof Ctb_n_drv_tkof Ctb_n_tkof Ctp_n_dif_tkof_p Ctp_n_drv_tkof_d Ctp_n_tkof_d Ctp_n_tkof_p Cxx_ct_stop_tkof_ftc Cxx_stop_tkof_ftc Cxx_tkof_tq_d_max Cxx_tkof_tq_d_min Cxx_tkof_tq_p_max Cxx_tkof_tq_p_min /end DEF_CHARACTERISTIC
 /begin OUT_MEASUREMENT Vbx_tkof_tq_cor_ena Vxx_tkof_d_cor Vxx_tkof_p_cor Vxx_tkof_tqe_cor /end OUT_MEASUREMENT
/end FUNCTION
/begin FUNCTION SmIsrCtl_Ctlfacx "" /begin OUT_MEASUREMENT Vbx_is_fac_cho /end OUT_MEASUREMENT /end FUNCTION
/begin FUNCTION SmIsrCtl_Schedul "" /begin DEF_CHARACTERISTIC Cbx_is_loop_diag_cfm /end DEF_CHARACTERISTIC /begin OUT_MEASUREMENT Vbx_is_loop_diag_cfm /end OUT_MEASUREMENT /end FUNCTION
/begin FUNCTION SmStaSpv "" /begin SUB_FUNCTION SmStaSpv_Engstxx SmStaSpv_Stalixx SmStaSpv_Entrfxx /end SUB_FUNCTION /end FUNCTION
/begin FUNCTION SmStaSpv_Engstxx ""
 /begin DEF_CHARACTERISTIC Ctp_aut_eng_n_thd Ctp_sta_dly Cxx_aut_eng_n_thd_h Cxx_drvn_eng_n_thd_h Cxx_drvn_eng_n_thd_l /end DEF_CHARACTERISTIC
 /begin OUT_MEASUREMENT Vbx_trs_eng_aut Vsx_eng Vsx_prev_eng Vbx_frst_sta_done Vbx_clu_stal Vbx_swlk_stal Vbx_mem_swlk /end OUT_MEASUREMENT
/end FUNCTION
/begin FUNCTION SmStaSpv_Stalixx ""
 /begin DEF_CHARACTERISTIC Cxx_igk_stal_eng_n_thd Cxx_set_stal_dly Cxx_stal_det_swlk_dly /end DEF_CHARACTERISTIC
 /begin OUT_MEASUREMENT Vbx_clu_stal_ini Vbx_igk_stal_eng_n_thd Vbx_sta_stal Vbx_swlk_stal_ini /end OUT_MEASUREMENT
/end FUNCTION
/begin FUNCTION SmStaSpv_Entrfxx "" /begin DEF_CHARACTERISTIC Cxx_ini_stop_dly /end DEF_CHARACTERISTIC /begin OUT_MEASUREMENT Vsx_vh_eng /end OUT_MEASUREMENT /end FUNCTION
/begin FUNCTION BoVfoSup "" /begin DEF_CHARACTERISTIC Cbx_pws3_cfm lc_rly_main_pwl_on /end DEF_CHARACTERISTIC
 /begin OUT_MEASUREMENT Vbx_df_actr_rly_oc Vbx_df_actr_rly_scg Vbx_df_actr_rly_scw Vbx_df_pws_1_h Vbx_df_pws_1_l Vbx_df_pws_2_h Vbx_df_pws_2_l Vbx_df_pws_3_h Vbx_df_pws_3_l Vbx_diag_ena_actr_rly_oc Vbx_diag_ena_actr_rly_scg Vbx_diag_ena_actr_rly_scw Vbx_diag_ena_pws_1_h Vbx_diag_ena_pws_1_l Vbx_diag_ena_pws_2_h Vbx_diag_ena_pws_2_l Vbx_diag_ena_pws_3_h Vbx_diag_ena_pws_3_l Vbx_ecu_rst Vbx_pws3_cfm Vxx_raw_pws_1 Vxx_raw_pws_2 Vxx_raw_pws_3 lv_err_vcc_1 lv_err_vcc_2 lv_err_vcc_3 lv_main_rly_pwl lv_main_rly_pwl_2 lv_mu_inh_pwl_tran_es_el lv_pwl_rst_wdt_asw lv_pwl_unlock_cdn_asw lv_rly_main t_main_rly_pwl /end OUT_MEASUREMENT
/end FUNCTION
/begin FUNCTION BiAsiIap ""
 /begin DEF_CHARACTERISTIC Cxx_hw_ftc c_vp_map_mv_max_diag c_vp_map_mv_min_diag c_vp_put_mv_max_diag c_vp_put_mv_min_diag /end DEF_CHARACTERISTIC
 /begin OUT_MEASUREMENT Vxx_sens_map_v Vxx_sens_spg_v lv_err_map vp_map_max vp_map_max_inter vp_map_min vp_map_min_inter vp_map_mv vp_put_mv /end OUT_MEASUREMENT
 /begin SUB_FUNCTION BiAsiIap_Mapxxsr BiAsiIap_Spgxxsr /end SUB_FUNCTION
/end FUNCTION
/begin FUNCTION BiAsiIap_Mapxxsr ""
 /begin DEF_CHARACTERISTIC Ntb_n_map_fil_ftc Ctp_n_map_fil_ftc Cxx_map_fac Cxx_map_ofs /end DEF_CHARACTERISTIC
 /begin OUT_MEASUREMENT Vbx_df_sens_map_h Vbx_df_sens_map_l Vbx_diag_ena_sens_map_h Vbx_diag_ena_sens_map_l Vbx_run_map Vbx_stop_map Vxx_map_fil_ftc Vxx_raw_sens_map Vxx_raw_sens_map_v_stop Vxx_raw_sens_map_v_sum /end OUT_MEASUREMENT
/end FUNCTION
/begin FUNCTION BiAsiIap_Spgxxsr ""
 /begin DEF_CHARACTERISTIC Ntb_n_spg_fil_ftc Ctp_n_spg_fil_ftc Cxx_spg_fac Cxx_spg_ofs /end DEF_CHARACTERISTIC
 /begin OUT_MEASUREMENT Vbx_df_sens_spg_h Vbx_df_sens_spg_l Vbx_diag_ena_sens_spg_h Vbx_diag_ena_sens_spg_l Vbx_run_spg Vbx_stop_spg Vxx_raw_sens_spg Vxx_raw_sens_spg_v_stop Vxx_raw_sens_spg_v_sum Vxx_spg_fil_ftc /end OUT_MEASUREMENT
/end FUNCTION
/begin FUNCTION BiAsiIat ""
 /begin DEF_CHARACTERISTIC ldpm_vp_tia_1_airt ip_tia_mes c_vp_tia_max_diag_el c_vp_tia_min_diag_el /end DEF_CHARACTERISTIC
 /begin OUT_MEASUREMENT Vbx_df_sens_mat_h Vbx_df_sens_mat_l Vbx_diag_ena_sens_mat_h Vbx_diag_ena_sens_mat_l Vxx_raw_sens_mat Vxx_sens_mat_v err_sym_el_tia[0] lv_cdn_diag_el_tia[0] tia_mes[0] vp_tia[0] vp_tia_mmv[0] /end OUT_MEASUREMENT
/end FUNCTION
/begin FUNCTION BiAsiIaf "" /begin OUT_MEASUREMENT maf /end OUT_MEASUREMENT /end FUNCTION
/begin FUNCTION BiCliCoi ""
 /begin DEF_CHARACTERISTIC ldp_vp_tco_ip_tco_mes ip_tco_mes c_vp_tco_max_diag_tco_el c_vp_tco_min_diag_tco_el lc_tco_diag_ena_rst /end DEF_CHARACTERISTIC
 /begin OUT_MEASUREMENT Vbx_df_sens_tco_h Vbx_df_sens_tco_l Vbx_diag_ena_sens_tco_h Vbx_diag_ena_sens_tco_l Vxx_raw_sens_tco Vxx_sens_tco_v Vxx_sfty_sens_tco_v lv_err_tco /end OUT_MEASUREMENT
/end FUNCTION
/begin FUNCTION BiPciApi ""
 /begin OUT_MEASUREMENT Vxx_acel_pdl_sens_v1 Vxx_acel_pdl_sens_v2 Vxx_sfty_acel_pdl_sens_v1 vp_pvs_1 vp_pvs_1_mon vp_pvs_2 vp_pvs_2_mon /end OUT_MEASUREMENT
/end FUNCTION
/begin FUNCTION BiVfiCri "" /begin OUT_MEASUREMENT Vbx_sens_igk /end OUT_MEASUREMENT /end FUNCTION
/begin FUNCTION BiVfiEmi ""
 /begin DEF_CHARACTERISTIC c_cdn_vb_min_diag c_sub_vb c_t_vcc_diag_auth c_vb_max_obd1 c_vb_max_obd2 c_vb_min_obd1 c_vb_min_obd2 c_vb_raw_inh_diag c_vcc_1_dif_diag c_vcc_1_max_diag c_vcc_1_min_diag c_vcc_2_dif_diag c_vcc_2_max_diag c_vcc_2_min_diag c_vcc_3_dif_diag c_vcc_3_max_diag c_vcc_3_min_diag c_vcc_gain_dif /end DEF_CHARACTERISTIC
 /begin OUT_MEASUREMENT Vbx_df_vb_rly_oc_scg Vbx_df_vb_rly_scw Vbx_diag_ena_vb_rly_oc_scg Vbx_diag_ena_vb_rly_scw Vxx_raw_vb Vxx_vb_rly /end OUT_MEASUREMENT
/end FUNCTION
/begin FUNCTION BoAsoIto ""
 /begin OUT_MEASUREMENT Vbx_df_it_cmd_el Vbx_diag_ena_it_cmd_el Vbx_it_hbrg_ok err_sym_etc_dr lv_cdn_diag_etc_dr lv_off_mtc_asw v_mtc_sp /end OUT_MEASUREMENT
/end FUNCTION
/begin FUNCTION InSmiSyn ""
 /begin OUT_MEASUREMENT Vbx_clu_stal_ctr Vxx_clu_stal_ctr Vxx_cylr_is_vld_ctr Vxx_cylr_ok_aftr_stal_ctr Vxx_cylr_ok_ctr Vxx_err_cylr_ctr Vxx_err_cylr_is_run_ctr Vxx_err_id_is_run_ctr Vxx_is_cylr_ok_ctr Vxx_no_deci_cylr_ctr Vxx_no_deci_id_is_ctr Vxx_run_re_phs_ctr Vxx_crk_syn_loss_ctr /end OUT_MEASUREMENT
 /begin SUB_FUNCTION InSmiSyn_Crksixx InSmiSyn_Derivxx InSmiSyn_Filspxx InSmiSyn_Speedxx InSmiSyn_Synchro InSmiSyn_Tothpac InSmiSyn_Camsixx InSmiSyn_Recocxx InSmiSyn_Spdmfxx InSmiSyn_Schedul /end SUB_FUNCTION
/end FUNCTION
/begin FUNCTION InSmiSyn_Crksixx ""
 /begin DEF_CHARACTERISTIC Cxx_dfdec_crk_chr Cxx_dfdec_crk_cmp Cxx_dfdec_crk_cyc Cxx_dfdec_crk_no_sig Cxx_dfdec_crk_oc Cxx_dfdec_crk_shp Cxx_dfinc_crk_chr Cxx_dfinc_crk_cmp Cxx_dfinc_crk_cyc Cxx_dfinc_crk_no_sig Cxx_dfinc_crk_oc Cxx_dfinc_crk_shp Cxx_h_dif_prs_dsb_sp Cxx_h_thd_dif_prs_dsb_sp Cxx_h_thd_prs_sp_fail Cxx_l_thd_dif_prs_dsb_sp Cxx_nr_vld_crk_fail1 /end DEF_CHARACTERISTIC
 /begin OUT_MEASUREMENT Vbx_crk Vbx_crk_syn Vbx_deb_cdn Vbx_df_crk_no_sig Vbx_df_crk_no_sig_wio_cam Vbx_diag_ena_crk_no_sig Vbx_diag_ena_crk_no_sig_wio_cam Vbx_main_cdn Vbx_map_flu_cdn Vbx_pres_df_crk_chr Vbx_pres_df_crk_cmp Vbx_pres_df_crk_cyc Vbx_pres_df_crk_no_sig Vbx_pres_df_crk_oc Vbx_pres_df_crk_shp Vbx_run_eng_det Vsx_sens_crk_vld Vxx_crk_syn_loss_ctr_ini Vxx_ctr_vld_crk_fail1 /end OUT_MEASUREMENT
/end FUNCTION
/begin FUNCTION InSmiSyn_Derivxx "" /begin DEF_CHARACTERISTIC Cxx_n_drv_fil_fac /end DEF_CHARACTERISTIC /begin OUT_MEASUREMENT Vxx_mv_n_drv Vxx_n_drv Vxx_raw_n_drv /end OUT_MEASUREMENT /end FUNCTION
/begin FUNCTION InSmiSyn_Filspxx "" /begin DEF_CHARACTERISTIC Ctp_gear_n_mv_ftc /end DEF_CHARACTERISTIC
 /begin OUT_MEASUREMENT Vxb_n2_mv.factor Vxb_n2_mv.index Vxb_n2_mv.num_dp Vxb_n_mv.factor Vxb_n_mv.index Vxb_n_mv.num_dp Vxx_n_mv Vxx_n_mv_raw /end OUT_MEASUREMENT
/end FUNCTION
/begin FUNCTION InSmiSyn_Speedxx "" /begin DEF_CHARACTERISTIC Ctb_n Ctb_n2 Ctp_tco_n_ini Cxx_tdc_rev_nr /end DEF_CHARACTERISTIC
 /begin OUT_MEASUREMENT Vxb_n.factor Vxb_n.index Vxb_n.num_dp Vxb_n2.factor Vxb_n2.index Vxb_n2.num_dp Vbx_n_ini Vsx_n_vld Vxx_n Vxx_tdc_per /end OUT_MEASUREMENT
/end FUNCTION
/begin FUNCTION InSmiSyn_Synchro "" /begin OUT_MEASUREMENT Vbx_eng_syn Vxx_eng_angl Vxx_tdc_ctr /end OUT_MEASUREMENT /end FUNCTION
/begin FUNCTION InSmiSyn_Tothpac ""
 /begin OUT_MEASUREMENT Vbx_trz_clc_ena Vxx_trz_t_toth_0 Vxx_trz_t_toth_0_nxt Vxx_trz_t_toth_1 Vxx_trz_t_toth_2 Vxx_trz_t_toth_3 Vxx_trz_t_toth_4 Vxx_trz_t_toth_5 Vxx_trz_t_toth_5_prev /end OUT_MEASUREMENT
/end FUNCTION
/end MODULE
/end PROJECT
