ASAP2_VERSION 1 41
/begin PROJECT RD8 "_default_ProjectLongIdentifier"
/begin HEADER "_default_HeaderComment" PROJECT_NO RD9 /end HEADER
/begin MODULE _default_ModuleName "_default_ModuleLongIdentifier"
/begin MOD_COMMON "_default_ModCommonComment" DEPOSIT ABSOLUTE BYTE_ORDER MSB_LAST ALIGNMENT_BYTE 1 ALIGNMENT_WORD 2 ALIGNMENT_LONG 2 ALIGNMENT_FLOAT32_IEEE 2 ALIGNMENT_FLOAT64_IEEE 4 /end MOD_COMMON
/begin AXIS_PTS Ctb_eal "16 breakpoint table for Engine air load" 0xa002a6fc Vxx_eal _REC_A2AXS_20_u2 3.99993896484375 _CNV_A_R_LINEAR_____53_CM 16 0. 3.99993896484375 FORMAT "%10.8" /end AXIS_PTS
/begin AXIS_PTS Ctb_mat2 "Table of 9 programmable breakpoints of air temperature" 0xa0022a0c NO_INPUT_QUANTITY _REC_A2AXS_20_u2 240. _CNV_A_R_LINEAR_____54_CM 9 -40. 200. FORMAT "%5.1" /end AXIS_PTS
/begin AXIS_PTS Ctb_sta_tco "Coolant temperature breakpoints for starting set point tables" 0xa002dfe4 Vxx_tco _REC_A2AXS_20_u2 240. _CNV_A_R_LINEAR_____54_CM 8 -40. 200. FORMAT "%5.1" /end AXIS_PTS
/begin AXIS_PTS Ctb_tco "16 engine coolant temperature breakpoints" 0xa002dff8 Vxx_tco _REC_A2AXS_20_u2 240. _CNV_A_R_LINEAR_____54_CM 16 -40. 200. FORMAT "%5.1" /end AXIS_PTS
/begin AXIS_PTS Ctb_tco2 "Engine coolant temperature breakpoints" 0xa002e01c Vxx_tco _REC_A2AXS_20_u2 240. _CNV_A_R_LINEAR_____54_CM 9 -40. 200. FORMAT "%5.1" /end AXIS_PTS
/begin AXIS_PTS Ntb_tco "water temperature breakpoints table (17 breakpoints) [-40 -30 -20 -10 0 10 20 30 40 50 60 70 80 90 100 110 120]" 0xa0023ac0 Vxx_tco _REC_A2AXS_20_u2 240. _CNV_A_R_LINEAR_____54_CM 17 -40. 200. READ_ONLY FORMAT "%5.1" /end AXIS_PTS
/begin AXIS_PTS Ctb_n_sta "Engine speed breakpoints for the fuel injection mass calculation during start" 0xa00298ec Vxx_n _REC_A2AXS_20_u2 16383.75 _CNV_A_R_ENSD_LINEA_24_CM 9 0. 16383.75 FORMAT "%8.2" /end AXIS_PTS
/begin CHARACTERISTIC Cmp_n_prs_lean_ti_ofs_alco "MAP giving the richness offset for the lean mode for flex-fuel" MAP 0xa0027efc _REC_A1MAP_20_u1_u2_u2 0.99609375 _CNV_A_R_LINEAR_____260_CM -0.5 0.49609375 FORMAT "%9.6"
 /begin AXIS_DESCR COM_AXIS Vxx_n _CNV_A_R_ENSD_LINEA_24_CM 20 0. 16383.75 FORMAT "%8.2" AXIS_PTS_REF Ctb_n /end AXIS_DESCR
 /begin AXIS_DESCR COM_AXIS Vxx_eal _CNV_A_R_LINEAR_____53_CM 16 0. 3.99993896484375 FORMAT "%10.8" AXIS_PTS_REF Ctb_eal /end AXIS_DESCR
/end CHARACTERISTIC
/begin CHARACTERISTIC Cmp_n_prs_tco_ti_fac_alco "MAP giving the correction factor for the K offset depending on RPM and EAL for flex-fuel" MAP 0xa002803c _REC_A1MAP_20_u1_u2_u2 1.9921875 _CNV_A_R_LINEAR_____187_CM -1. 0.9921875 FORMAT "%9.6"
 /begin AXIS_DESCR COM_AXIS Vxx_n _CNV_A_R_ENSD_LINEA_24_CM 20 0. 16383.75 FORMAT "%8.2" AXIS_PTS_REF Ctb_n /end AXIS_DESCR
 /begin AXIS_DESCR COM_AXIS Vxx_eal _CNV_A_R_LINEAR_____53_CM 16 0. 3.99993896484375 FORMAT "%10.8" AXIS_PTS_REF Ctb_eal /end AXIS_DESCR
/end CHARACTERISTIC
/begin CHARACTERISTIC Ctp_n_sta_fim_fac_alco "Engine speed dependant correction for fuel injection mass calculation during start for flex-fuel." CURVE 0xa002817c _REC_A1CUR_20_u1_u2 0.99609375 _CNV_A_R_LINEAR_____31_CM 0. 0.99609375 FORMAT "%10.8"
 /begin AXIS_DESCR COM_AXIS Vxx_n _CNV_A_R_ENSD_LINEA_24_CM 9 0. 16383.75 FORMAT "%8.2" AXIS_PTS_REF Ctb_n_sta /end AXIS_DESCR
/end CHARACTERISTIC
/begin CHARACTERISTIC Ctp_tco_dec_sta_fim_alco "Cooling temperature dependant decrementation value of Fuel Injection Mass just after start for flex-fuel. " CURVE 0xa0028188 _REC_A1CUR_20_u2_u2 167.7696 _CNV_A_R_LINEAR_____83_CM 0. 167.7696 FORMAT "%9.5"
 /begin AXIS_DESCR COM_AXIS Vxx_tco _CNV_A_R_LINEAR_____54_CM 16 -40. 200. FORMAT "%5.1" AXIS_PTS_REF Ctb_tco /end AXIS_DESCR
/end CHARACTERISTIC
/begin CHARACTERISTIC Ctp_tco_lean_ti_ofs_alco "additionnal offset depending on the water temperature for the lean mode for flex-fuel" CURVE 0xa00281a8 _REC_A1CUR_20_u1_u2 0.99609375 _CNV_A_R_LINEAR_____260_CM -0.5 0.49609375 FORMAT "%9.6"
 /begin AXIS_DESCR COM_AXIS Vxx_tco _CNV_A_R_LINEAR_____54_CM 17 -40. 200. READ_ONLY FORMAT "%5.1" AXIS_PTS_REF Ntb_tco /end AXIS_DESCR
/end CHARACTERISTIC
/begin CHARACTERISTIC Ctp_tco_pinj_fim_alco "Pre-injection fuel mass setpoint table, dependant on coolant temperature for flex-fuel." CURVE 0xa00281bc _REC_A1CUR_20_u2_u2 6553.5 _CNV_A_R_LINEAR_____166_CM 0. 6553.5 FORMAT "%6.1"
 /begin AXIS_DESCR COM_AXIS Vxx_tco _CNV_A_R_LINEAR_____54_CM 8 -40. 200. FORMAT "%5.1" AXIS_PTS_REF Ctb_sta_tco /end AXIS_DESCR
/end CHARACTERISTIC
/begin CHARACTERISTIC Ctp_tco_sta_fim_alco "Table of Fuel mass injection. during start depending on coolant temperature for flex-fuel." CURVE 0xa00281cc _REC_A1CUR_20_u2_u2 4799.91808 _CNV_A_R_LINEAR_____262_CM 0. 4799.91808 FORMAT "%7.2"
 /begin AXIS_DESCR COM_AXIS Vxx_tco _CNV_A_R_LINEAR_____54_CM 16 -40. 200. FORMAT "%5.1" AXIS_PTS_REF Ctb_tco /end AXIS_DESCR
/end CHARACTERISTIC
/begin CHARACTERISTIC Ctp_tco_sta_rich_dec_alco "Table giving the number of tdc between 2 decrease of the A offset (if initialized with the water temperature) for flex-fuel." CURVE 0xa00281ec _REC_A1CUR_20_u1_u2 255. _CNV_A_R_LINEAR_____55_CM 0. 255. FORMAT "%3.0"
 /begin AXIS_DESCR COM_AXIS Vxx_tco _CNV_A_R_LINEAR_____54_CM 17 -40. 200. READ_ONLY FORMAT "%5.1" AXIS_PTS_REF Ntb_tco /end AXIS_DESCR
/end CHARACTERISTIC
/begin CHARACTERISTIC Ctp_tco_sta_ti_ofs_alco "Table giving the initial A offset depending on the water temperature for flex-fuel." CURVE 0xa0028200 _REC_A1CUR_20_u1_u2 1.9921875 _CNV_A_R_LINEAR_____43_CM 0. 1.9921875 FORMAT "%8.6"
 /begin AXIS_DESCR COM_AXIS Vxx_tco _CNV_A_R_LINEAR_____54_CM 17 -40. 200. READ_ONLY FORMAT "%5.1" AXIS_PTS_REF Ntb_tco /end AXIS_DESCR
/end CHARACTERISTIC
/begin CHARACTERISTIC Ctp_tco_ti_ofs1_alco "Table giving the B offset depending on the water temperature for flex-fuel." CURVE 0xa0028214 _REC_A1CUR_20_u1_u2 1.9921875 _CNV_A_R_LINEAR_____43_CM 0. 1.9921875 FORMAT "%8.6"
 /begin AXIS_DESCR COM_AXIS Vxx_tco _CNV_A_R_LINEAR_____54_CM 17 -40. 200. READ_ONLY FORMAT "%5.1" AXIS_PTS_REF Ntb_tco /end AXIS_DESCR
/end CHARACTERISTIC
/begin CHARACTERISTIC Ctp_tco_ti_ofs2_alco "Table giving the K offset depending on the water temperature for flex-fuel." CURVE 0xa0028228 _REC_A1CUR_20_u1_u2 0.99609375 _CNV_A_R_LINEAR_____31_CM 0. 0.99609375 FORMAT "%10.8"
 /begin AXIS_DESCR COM_AXIS Vxx_tco _CNV_A_R_LINEAR_____54_CM 17 -40. 200. READ_ONLY FORMAT "%5.1" AXIS_PTS_REF Ntb_tco /end AXIS_DESCR
/end CHARACTERISTIC
/begin MEASUREMENT Vxx_n_tco_sta_fim_alco "Fuel injection Mass during start depending on engine speed and tco for flex-fuel" UWORD _CNV_A_R_LINEAR_____262_CM 1 0. 0. 4799.91808 ECU_ADDRESS 0xd0003a4a FORMAT "%7.2" /end MEASUREMENT
/begin MEASUREMENT Vxx_tco_dec_sta_fim_alco "Fuel injection Mass decrementation just after start for flex-fuel." UWORD _CNV_A_R_LINEAR_____83_CM 1 0. 0. 167.7696 ECU_ADDRESS 0xd0003a4c FORMAT "%9.5" /end MEASUREMENT
/begin MEASUREMENT Vxx_tco_lean_ti_fac_alco "Final richness factor in lean mode for flex fuel" UBYTE _CNV_A_R_LINEAR_____43_CM 1 0. 0. 1.9921875 ECU_ADDRESS 0xd0003e29 FORMAT "%8.6" /end MEASUREMENT
/begin MEASUREMENT Vxx_tco_pinj_fim_alco "Pre-injection fuel mass setpoint for flex-fuel" UWORD _CNV_A_R_LINEAR_____166_CM 1 0. 0. 6553.5 ECU_ADDRESS 0xd0003a4e FORMAT "%6.1" /end MEASUREMENT
/begin MEASUREMENT Vxx_tco_sta_rich_dec_alco "Number of tdc between 2 decrease of the A offset for flex-fuel" UBYTE _CNV_A_R_LINEAR_____55_CM 1 0. 0. 255. ECU_ADDRESS 0xd0003e2a FORMAT "%3.0" /end MEASUREMENT
/begin MEASUREMENT Vxx_tco_sta_ti_ofs_alco "Initial A offset depending on the water temperature for flex-fuel" UBYTE _CNV_A_R_LINEAR_____43_CM 1 0. 0. 1.9921875 ECU_ADDRESS 0xd0003e2b FORMAT "%8.6" /end MEASUREMENT
/begin MEASUREMENT Vxx_tco_ti_fac_alco "C factor for flex-fuel" UBYTE _CNV_A_R_LINEAR_____187_CM 1 0. -1. 0.9921875 ECU_ADDRESS 0xd0003e2c FORMAT "%9.6" /end MEASUREMENT
/begin MEASUREMENT Vxx_tco_ti_ofs1_alco "B offset for flex-fuel." UBYTE _CNV_A_R_LINEAR_____43_CM 1 0. 0. 1.9921875 ECU_ADDRESS 0xd0003e2d FORMAT "%8.6" /end MEASUREMENT
/begin MEASUREMENT Vxx_tco_ti_ofs2_alco "K offset for flex-fuel" UBYTE _CNV_A_R_LINEAR_____31_CM 1 0. 0. 0.99609375 ECU_ADDRESS 0xd0003e2e FORMAT "%5.3" /end MEASUREMENT
/begin MEASUREMENT Vxx_vld_tco_alco "Engine coolant temperature" UWORD _CNV_A_R_LINEAR_____54_CM 1 0. -40. 200. ECU_ADDRESS 0xd0003a50 FORMAT "%5.1" /end MEASUREMENT
/begin AXIS_PTS Ctb_dt_tq_rat "Breakpoint calibration of driveline torque ratio" 0xa002be6c Vxx_dt_tq_rat _REC_A2AXS_20_u2 210. _CNV_A_R_LINEAR_____251_CM 8 -10. 200. FORMAT "%6.2" /end AXIS_PTS
/begin AXIS_PTS Ctb_inj_cut_n "Breakpoint calibration of engine speed" 0xa002be80 Vxx_n_mv _REC_A2AXS_20_u2 16383.75 _CNV_A_R_ENSD_LINEA_24_CM 7 0. 16383.75 FORMAT "%8.2" /end AXIS_PTS
/begin AXIS_PTS Ctb_min_tqe_n "engine speed breakpoint for minimum torque" 0xa002be90 Vxx_n_dif_tq _REC_A2AXS_20_u2 16383.75 _CNV_A_R_ENSD_LINEA_24_CM 10 0. 16383.75 FORMAT "%8.2" /end AXIS_PTS
/begin CHARACTERISTIC Cmp_cut_fil_fac "Cartography for torque slope limitation during injection cut" MAP 0xa002bea8 _REC_A1MAP_20_u2_u2_u2 65535. _CNV_A_R_LINEAR_____234_CM -65535. 0. FORMAT "%6.0"
 /begin AXIS_DESCR COM_AXIS Vxx_n_mv _CNV_A_R_ENSD_LINEA_24_CM 7 0. 16383.75 FORMAT "%8.2" AXIS_PTS_REF Ctb_inj_cut_n /end AXIS_DESCR
 /begin AXIS_DESCR COM_AXIS Vxx_dt_tq_rat _CNV_A_R_LINEAR_____251_CM 8 -10. 200. FORMAT "%6.2" AXIS_PTS_REF Ctb_dt_tq_rat /end AXIS_DESCR
/end CHARACTERISTIC
/begin CHARACTERISTIC Cmp_driv_swi_fil_fac "Cartography for torque slope limitation during re-injection on powertrain setpoint request" MAP 0xa002bf18 _REC_A1MAP_20_u2_u2_u2 65535. _CNV_A_R_LINEAR_____235_CM 0. 65535. FORMAT "%5.0"
 /begin AXIS_DESCR COM_AXIS Vxx_n_mv _CNV_A_R_ENSD_LINEA_24_CM 7 0. 16383.75 FORMAT "%8.2" AXIS_PTS_REF Ctb_inj_cut_n /end AXIS_DESCR
 /begin AXIS_DESCR COM_AXIS Vxx_dt_tq_rat _CNV_A_R_LINEAR_____251_CM 8 -10. 200. FORMAT "%6.2" AXIS_PTS_REF Ctb_dt_tq_rat /end AXIS_DESCR
/end CHARACTERISTIC
/begin CHARACTERISTIC Cmp_n_tco_min_tq_fmt "Corrective factor on minimum driver torque." MAP 0xa002bf88 _REC_A1MAP_20_u2_u2_u2 1. _CNV_A_R_LINEAR_____98_CM 0. 1. FORMAT "%11.9"
 /begin AXIS_DESCR COM_AXIS Vxx_n_dif_tq _CNV_A_R_ENSD_LINEA_24_CM 10 0. 16383.75 FORMAT "%8.2" AXIS_PTS_REF Ctb_min_tqe_n /end AXIS_DESCR
 /begin AXIS_DESCR COM_AXIS Vxx_tco _CNV_A_R_LINEAR_____54_CM 9 -40. 200. FORMAT "%5.1" AXIS_PTS_REF Ctb_tco2 /end AXIS_DESCR
/end CHARACTERISTIC
/begin CHARACTERISTIC Ctd_coup_grip_rat "Cartography that converts transmission coupler state into coupler torque grip ratio" CURVE 0xa0021c4c _REC_A1CUR_20_u1_u1 1. _CNV_A_R_LINEAR_____252_CM 0. 1. FORMAT "%4.1"
 /begin AXIS_DESCR COM_AXIS Vxx_ant_coup _CNV_A_R_ECME_LINEA_0_CM 3 0. 255. FORMAT "%3.0" AXIS_PTS_REF Ctb_coup /end AXIS_DESCR
/end CHARACTERISTIC
/begin CHARACTERISTIC Ctd_gear_min_driv_tqe_ftc "Filtering time constant for minimum driver engine torque" CURVE 0xa0021c44 _REC_A1CUR_20_u1_u1 2.55 _CNV_A_R_LINEAR_____34_CM 0. 2.55 FORMAT "%4.2"
 /begin AXIS_DESCR COM_AXIS Vxx_gear _CNV_A_R_LINEAR_____113_CM 8 -1. 6. READ_ONLY FORMAT "%2.0" AXIS_PTS_REF Ntb_gear /end AXIS_DESCR
/end CHARACTERISTIC
/begin CHARACTERISTIC Ctd_gear_tq_rat "Cartography that converts \"vehicle_speed / rotary_engine_speed\" ratio into driveline torque ratio" CURVE 0xa002c03c _REC_A1CUR_20_u2_u1 210. _CNV_A_R_LINEAR_____251_CM -10. 200. FORMAT "%6.2"
 /begin AXIS_DESCR COM_AXIS Vxx_gear _CNV_A_R_LINEAR_____113_CM 8 -1. 6. READ_ONLY FORMAT "%2.0" AXIS_PTS_REF Ntb_gear /end AXIS_DESCR
/end CHARACTERISTIC
/begin CHARACTERISTIC Ctp_min_tq_tco_ofs "Torque offset to estimate the minimum torque in idle speed zone depending of the coolant temperature." CURVE 0xa002c04c _REC_A1CUR_20_u2_u2 2047.96875 _CNV_A_R_LINEAR_____161_CM -400. 1647.96875 FORMAT "%11.5"
 /begin AXIS_DESCR COM_AXIS Vxx_tco _CNV_A_R_LINEAR_____54_CM 9 -40. 200. FORMAT "%5.1" AXIS_PTS_REF Ctb_tco2 /end AXIS_DESCR
/end CHARACTERISTIC
/begin CHARACTERISTIC Ctp_swi_fil_fac "Table for torque slope limitation during natural re-injection" CURVE 0xa002c060 _REC_A1CUR_20_u2_u2 65535. _CNV_A_R_LINEAR_____235_CM 0. 65535. FORMAT "%5.0"
 /begin AXIS_DESCR COM_AXIS Vxx_dt_tq_rat _CNV_A_R_LINEAR_____251_CM 8 -10. 200. FORMAT "%6.2" AXIS_PTS_REF Ctb_dt_tq_rat /end AXIS_DESCR
/end CHARACTERISTIC
/begin MEASUREMENT Vbx_l_eng_tqe "The minmum torque isn't saturated by the low engine minimum torque." UBYTE _CNV_S_2_RANGE______3_CM 1 0. 0. 1. ECU_ADDRESS 0xd0005502 BIT_MASK 0x1 /end MEASUREMENT
/begin MEASUREMENT Vbx_sta_min_tq "Flag to detect the staring mode." UBYTE _CNV_S_2_RANGE______3_CM 1 0. 0. 1. ECU_ADDRESS 0xd0005503 BIT_MASK 0x1 /end MEASUREMENT
/begin MEASUREMENT Vxx_cut_fil_fac "Torque slope limitation for injection cut" UWORD _CNV_A_R_LINEAR_____234_CM 1 0. -65535. 0. ECU_ADDRESS 0xd00032be FORMAT "%6.0" /end MEASUREMENT
/begin MEASUREMENT Vxx_cut_tq_cor_fil "Correction to the minimum driver engine torque during injection cut or re-injection" UWORD _CNV_A_R_LINEAR_____161_CM 1 0. -400. 1647.96875 ECU_ADDRESS 0xd00032c0 FORMAT "%11.5" /end MEASUREMENT
/begin MEASUREMENT Vxx_dt_tq_rat "Gear rotary speed ratio : wheel_speed/engine_speed (tuned with gear state)" UWORD _CNV_A_R_LINEAR_____251_CM 1 0. -10. 200. ECU_ADDRESS 0xd00032c2 FORMAT "%6.2" /end MEASUREMENT
/begin MEASUREMENT Vxx_min_agb_tqe "coupler torque losses" UWORD _CNV_A_R_LINEAR_____161_CM 1 0. -400. 1647.96875 ECU_ADDRESS 0xd00032c4 FORMAT "%11.5" /end MEASUREMENT
/begin MEASUREMENT Vxx_min_avl_tqe "minimum available engine torque" UWORD _CNV_A_R_LINEAR_____161_CM 1 0. -400. 1647.96875 ECU_ADDRESS 0xd00032c6 FORMAT "%11.5" /end MEASUREMENT
/begin MEASUREMENT Vxx_min_avl_tqe_raw "Minimum available engine torque before saturation with minimun driver engine torque." UWORD _CNV_A_R_LINEAR_____161_CM 1 0. -400. 1647.96875 ECU_ADDRESS 0xd00032c8 FORMAT "%11.5" /end MEASUREMENT
/begin MEASUREMENT Vxx_min_bas_agb_tqe "minimum basic engine torque with AT torque losses" UWORD _CNV_A_R_LINEAR_____161_CM 1 0. -400. 1647.96875 ECU_ADDRESS 0xd00032ca FORMAT "%11.5" /end MEASUREMENT
/begin MEASUREMENT Vxx_min_bas_tqe "minimum basic engine torque" UWORD _CNV_A_R_LINEAR_____161_CM 1 0. -400. 1647.96875 ECU_ADDRESS 0xd00032cc FORMAT "%11.5" /end MEASUREMENT
/begin MEASUREMENT Vxx_min_bas_tqe_raw "minimum basic engine torque without BVA constraints" UWORD _CNV_A_R_LINEAR_____161_CM 1 0. -400. 1647.96875 ECU_ADDRESS 0xd00032ce FORMAT "%11.5" /end MEASUREMENT
/begin MEASUREMENT Vxx_min_driv_tqe "minimum driver engine torque" UWORD _CNV_A_R_LINEAR_____161_CM 1 0. -400. 1647.96875 ECU_ADDRESS 0xd00032d0 FORMAT "%11.5" /end MEASUREMENT
/begin MEASUREMENT Vxx_min_driv_tqe_raw "Raw minimum driver engine torque" UWORD _CNV_A_R_LINEAR_____161_CM 1 0. -400. 1647.96875 ECU_ADDRESS 0xd00032d2 FORMAT "%11.5" /end MEASUREMENT
/begin MEASUREMENT Vxx_min_driv_tqe_wit_inj_cut "minimum driver engine torque with injection cut" UWORD _CNV_A_R_LINEAR_____161_CM 1 0. -400. 1647.96875 ECU_ADDRESS 0xd00032d4 FORMAT "%11.5" /end MEASUREMENT
/begin MEASUREMENT Vxx_min_is_tql "minimum hyperbolic engine torque" UWORD _CNV_A_R_LINEAR_____161_CM 1 0. -400. 1647.96875 ECU_ADDRESS 0xd00032d6 FORMAT "%11.5" /end MEASUREMENT
/begin MEASUREMENT Vxx_n_dif_tq "Minimal saturation of filtered engine speed for the minimal torque calculation" UWORD _CNV_A_R_ENSD_LINEA_24_CM 1 0. 0. 16383.75 ECU_ADDRESS 0xd00032d8 FORMAT "%8.2" /end MEASUREMENT
/begin MEASUREMENT Vxx_n_mv_min_driv_tqe "Filtered engine speed used for minimum driver torque calculation" UWORD _CNV_A_R_ENSD_LINEA_24_CM 1 0. 0. 16383.75 ECU_ADDRESS 0xd00032da FORMAT "%8.2" /end MEASUREMENT
/begin MEASUREMENT Vxx_n_mv_min_driv_tqe_raw "Mean engine speed" UWORD _CNV_A_R_ENSD_LINEA_24_CM 1 0. 0. 16383.75 ECU_ADDRESS 0xd00032dc FORMAT "%8.2" /end MEASUREMENT
/begin MEASUREMENT Vxx_swi_fil_fac "Torque slope limitation for re-injection" UWORD _CNV_A_R_LINEAR_____235_CM 1 0. 0. 65535. ECU_ADDRESS 0xd00032de FORMAT "%5.0" /end MEASUREMENT
/begin CHARACTERISTIC Cbx_min_avl_tqe_raw_cfm "Boolean calibration to change the minimum available torque: equal to engine torque losses (=0)" VALUE 0xa0021c5e _REC_S1VAL_20_u1 1. _CNV_A_R_ECME_LINEA_0_CM 0. 1. FORMAT "%1.0" BIT_MASK 0x1 /end CHARACTERISTIC
/begin CHARACTERISTIC Cbx_min_driv_tqe_cfm "Boolean calibration to deactivate the use of Vxx_min_driv_tqe in AJMOD filter" VALUE 0xa0021c5f _REC_S1VAL_20_u1 1. _CNV_A_R_ECME_LINEA_0_CM 0. 1. FORMAT "%1.0" BIT_MASK 0x1 /end CHARACTERISTIC
/begin CHARACTERISTIC Cbx_min_tq_mod_cfm "Boolean to active the minimum torque in the diesel configuration." VALUE 0xa0021c60 _REC_S1VAL_20_u1 1. _CNV_S_2_RANGE______3_CM 0. 1. BIT_MASK 0x1 /end CHARACTERISTIC
/begin CHARACTERISTIC Cbx_n_mv_n_cfm "Boolean calibration to choose between a filtered raw engine speed (=1) or filtered engine speed (=0)" VALUE 0xa0021c61 _REC_S1VAL_20_u1 1. _CNV_A_R_ECME_LINEA_0_CM 0. 1. FORMAT "%1.0" BIT_MASK 0x1 /end CHARACTERISTIC
/begin CHARACTERISTIC Cxx_agb_max_tqe_cor "Value of maximum torque allowed for AT torque converter" VALUE 0xa0021c50 _REC_S1VAL_20_u2 2047.96875 _CNV_A_R_LINEAR_____123_CM 0. 2047.96875 FORMAT "%10.5" /end CHARACTERISTIC
/begin CHARACTERISTIC Cxx_agb_min_tqe_fac "Factor which allows adapting the final level of AT converter torque, according to the engine speed." VALUE 0xa0021c62 _REC_S1VAL_20_u1 3.984375 _CNV_A_R_LINEAR_____175_CM 0. 3.984375 FORMAT "%8.6" /end CHARACTERISTIC
/begin CHARACTERISTIC Cxx_fil_fac_dft "Default factor for torque slope limitation" VALUE 0xa0021c52 _REC_S1VAL_20_u2 65535. _CNV_A_R_LINEAR_____235_CM 0. 65535. FORMAT "%5.0" /end CHARACTERISTIC
/begin CHARACTERISTIC Cxx_min_is_n "engine speed threshold" VALUE 0xa0021c54 _REC_S1VAL_20_u2 16383.75 _CNV_A_R_ENSD_LINEA_24_CM 0. 16383.75 FORMAT "%8.2" /end CHARACTERISTIC
/begin CHARACTERISTIC Cxx_min_l_eng_tqe_tqe_hys "Hysteresis to detect the saturation of minimum torque by the low engine torque" VALUE 0xa0021c56 _REC_S1VAL_20_u2 2047.96875 _CNV_A_R_LINEAR_____123_CM 0. 2047.96875 FORMAT "%10.5" /end CHARACTERISTIC
/begin CHARACTERISTIC Cxx_min_n_thd_min_tq "Minimum engine speed threshold for the smoothing between the low engine minimum effective torque and the hyperbolic minimun torque" VALUE 0xa0021c58 _REC_S1VAL_20_s2 16383.75 _CNV_A_R_ENSD_LINEA_24_CM -8192. 8191.75 FORMAT "%8.2" /end CHARACTERISTIC
/begin CHARACTERISTIC Cxx_min_n_tq_grd "Torque gradient to set to the minimum torque on the engine torque losses" VALUE 0xa0021c5a _REC_S1VAL_20_u2 7.9998779296875 _CNV_A_R_LINEAR_____135_CM 0. 7.9998779296875 FORMAT "%4.2" /end CHARACTERISTIC
/begin CHARACTERISTIC Cxx_min_n_tq_grd_sta "Torque gradient to set to the minimum torque on the engine torque losses in the starting mode" VALUE 0xa0021c5c _REC_S1VAL_20_u2 7.9998779296875 _CNV_A_R_LINEAR_____135_CM 0. 7.9998779296875 FORMAT "%4.2" /end CHARACTERISTIC
/begin CHARACTERISTIC Cxx_min_tq_ast_dsb_dly "Maximum delay to disable the minimun torque after the starting mode." VALUE 0xa0021c63 _REC_S1VAL_20_u1 25.4 _CNV_A_R_LINEAR_____4_CM 0. 25.4 FORMAT "%4.1" /end CHARACTERISTIC
/begin CHARACTERISTIC Ctp_l_eng_map_n "Ratio for the minimum maniflod pressure, in function of the engine speed" CURVE 0xa002b8e0 _REC_A1CUR_20_u2_u2 1.99609375 _CNV_A_R_LINEAR_____31_CM 0. 1.99609375 FORMAT "%5.3"
 /begin AXIS_DESCR COM_AXIS Vxx_n _CNV_A_R_ENSD_LINEA_24_CM 9 0. 16383.75 FORMAT "%8.2" AXIS_PTS_REF Ctb_n2 /end AXIS_DESCR
/end CHARACTERISTIC
/begin CHARACTERISTIC Ctp_l_eng_map_tco "Minimum maniflod pressure in function of the coolant temperature" CURVE 0xa002b8f4 _REC_A1CUR_20_u2_u2 20000. _CNV_A_R_LINEAR_____57_CM 0. 20000. FORMAT "%5.0"
 /begin AXIS_DESCR COM_AXIS Vxx_tco _CNV_A_R_LINEAR_____54_CM 16 -40. 200. FORMAT "%5.1" AXIS_PTS_REF Ctb_tco /end AXIS_DESCR
/end CHARACTERISTIC
/begin MEASUREMENT Vxx_l_eng_map "Minimun manifold pressure" UWORD _CNV_A_R_LINEAR_____57_CM 1 0. 0. 20000. ECU_ADDRESS 0xd000322c FORMAT "%5.0" /end MEASUREMENT
/begin MEASUREMENT Vxx_l_eng_tq "low engine minimum torque" UWORD _CNV_A_R_LINEAR_____123_CM 1 0. 0. 2047.96875 ECU_ADDRESS 0xd000322e FORMAT "%10.5" /end MEASUREMENT
/begin MEASUREMENT Vxx_l_eng_tqe "low engine minimum effective torque" UWORD _CNV_A_R_LINEAR_____161_CM 1 0. -400. 1647.96875 ECU_ADDRESS 0xd0003230 FORMAT "%10.5" /end MEASUREMENT
/begin CHARACTERISTIC Cxx_l_eng_map_dft "Pressure offset if manifold pressure is failing" VALUE 0xa0020cbc _REC_S1VAL_20_u2 20000. _CNV_A_R_LINEAR_____57_CM 0. 20000. FORMAT "%5.0" /end CHARACTERISTIC
/begin AXIS_PTS Ctb_sta_n "Engine speed breakpoints for starting set point tables" 0xa002b17c Vxx_n _REC_A2AXS_20_u2 16383.75 _CNV_A_R_ENSD_LINEA_24_CM 8 0. 16383.75 FORMAT "%8.2" /end AXIS_PTS
/begin CHARACTERISTIC Cmp_n_tco_sta_tq "Starting Torque Table - coolant temperature and engine speed dependant" MAP 0xa002b190 _REC_A1MAP_20_u2_u2_u2 2047.96875 _CNV_A_R_LINEAR_____123_CM 0. 2047.96875 FORMAT "%10.5"
 /begin AXIS_DESCR COM_AXIS Vxx_n _CNV_A_R_ENSD_LINEA_24_CM 8 0. 16383.75 FORMAT "%8.2" AXIS_PTS_REF Ctb_sta_n /end AXIS_DESCR
 /begin AXIS_DESCR COM_AXIS Vxx_tco _CNV_A_R_LINEAR_____54_CM 8 -40. 200. FORMAT "%5.1" AXIS_PTS_REF Ctb_sta_tco /end AXIS_DESCR
/end CHARACTERISTIC
/begin CHARACTERISTIC Ctp_tco_sta_is_trs_dly "" CURVE 0xa002b210 _REC_A1CUR_20_u2_u2 655.35 _CNV_A_R_LINEAR_____34_CM 0. 655.35 FORMAT "%6.2"
 /begin AXIS_DESCR COM_AXIS Vxx_tco _CNV_A_R_LINEAR_____54_CM 8 -40. 200. FORMAT "%5.1" AXIS_PTS_REF Ctb_sta_tco /end AXIS_DESCR
/end CHARACTERISTIC
/begin MEASUREMENT Vxx_raw_sta_tq "Raw Starting Torque" UWORD _CNV_A_R_LINEAR_____123_CM 1 0. 0. 2047.96875 ECU_ADDRESS 0xd00031c0 FORMAT "%10.5" /end MEASUREMENT
/begin MEASUREMENT Vxx_sta_is_fil_fac "Variable of transition between Start Torque and Current Torque Set Point of Torque Structure" UWORD _CNV_A_R_LINEAR_____125_CM 1 0. 0. 1. ECU_ADDRESS 0xd00031c2 FORMAT "%11.9" /end MEASUREMENT
/begin MEASUREMENT Vxx_sta_tq "Start Torque Set Point" UWORD _CNV_A_R_LINEAR_____123_CM 1 0. 0. 2047.96875 ECU_ADDRESS 0xd00031c4 FORMAT "%10.5" /end MEASUREMENT
/begin CHARACTERISTIC Cxx_sta_tq_inc "Starting torque ramp value for difficult start" VALUE 0xa0021a7e _REC_S1VAL_20_u1 255. _CNV_A_R_LINEAR_____235_CM 0. 255. FORMAT "%3.0" /end CHARACTERISTIC
/begin CHARACTERISTIC Cxx_sta_tq_inc_dly "Delay before starting torque ramp activation" VALUE 0xa0021a7c _REC_S1VAL_20_u2 655.35 _CNV_A_R_LINEAR_____34_CM 0. 655.35 FORMAT "%6.2" /end CHARACTERISTIC
/begin MEASUREMENT Vbx_tq_req_stt_10 "Torque request status set to 10b" UBYTE _CNV_S_2_RANGE______3_CM 1 0. 0. 1. ECU_ADDRESS 0xd0004cbf BIT_MASK 0x1 /end MEASUREMENT
/begin MEASUREMENT Vbx_tq_req_stt_01 "Torque request status set to 01b" UBYTE _CNV_S_2_RANGE______3_CM 1 0. 0. 1. ECU_ADDRESS 0xd0004333 BIT_MASK 0x1 /end MEASUREMENT
/begin MEASUREMENT Vbx_tq_req_stt_11 "Torque request status set to 11b" UBYTE _CNV_S_2_RANGE______3_CM 1 0. 0. 1. ECU_ADDRESS 0xd0004334 BIT_MASK 0x1 /end MEASUREMENT
/begin MEASUREMENT Vsx_mux_tq_req_ans "Show to all systems how a regulation can be done (nominal, precision less or no regulation)" UBYTE _CNV_S_4_RANGE_STAT_266_CM 1 0. 0. 3. ECU_ADDRESS 0xd0004335 /end MEASUREMENT
/begin MEASUREMENT Vxx_lbup_per_mv_max_rtn "Backup value of the oxygen sensor failure threshold" UWORD _CNV_A_R_LINEAR_____34_CM 1 0. 0. 655.35 DISPLAY_IDENTIFIER InCbiUli_NVM.Vxx_lbup_per_mv_max_rtn_NVM ECU_ADDRESS 0xd00033b0 FORMAT "%6.2" /end MEASUREMENT
/begin MEASUREMENT Vxx_lbup_per_tot_mv_rtn "Backup value of the oxygen sensor diagnostic criteria" UWORD _CNV_A_R_LINEAR_____34_CM 1 0. 0. 655.35 DISPLAY_IDENTIFIER InCbiUli_NVM.Vxx_lbup_per_tot_mv_rtn_NVM ECU_ADDRESS 0xd00033b2 FORMAT "%6.2" /end MEASUREMENT
/begin MEASUREMENT Vtx_in_mem_lbup_cpt[0] "Number of times the system enters in each diagnosis conditions" UWORD _CNV_A_R_ECME_LINEA_0_CM 1 0. 0. 65535. DISPLAY_IDENTIFIER InCbiUli_NVM.Vtx_in_mem_lbup_cpt_NVM[0] ECU_ADDRESS 0xd00033b4 FORMAT "%5.0" /end MEASUREMENT
/begin MEASUREMENT Vtx_in_mem_lbup_cpt[1] "Number of times the system enters in each diagnosis conditions" UWORD _CNV_A_R_ECME_LINEA_0_CM 1 0. 0. 65535. DISPLAY_IDENTIFIER InCbiUli_NVM.Vtx_in_mem_lbup_cpt_NVM[1] ECU_ADDRESS 0xd00033b6 FORMAT "%5.0" /end MEASUREMENT
/begin MEASUREMENT Vtx_in_mem_lbup_cpt[2] "Number of times the system enters in each diagnosis conditions" UWORD _CNV_A_R_ECME_LINEA_0_CM 1 0. 0. 65535. DISPLAY_IDENTIFIER InCbiUli_NVM.Vtx_in_mem_lbup_cpt_NVM[2] ECU_ADDRESS 0xd00033b8 FORMAT "%5.0" /end MEASUREMENT
/begin MEASUREMENT Vtx_in_mem_lbup_cpt[3] "Number of times the system enters in each diagnosis conditions" UWORD _CNV_A_R_ECME_LINEA_0_CM 1 0. 0. 65535. DISPLAY_IDENTIFIER InCbiUli_NVM.Vtx_in_mem_lbup_cpt_NVM[3] ECU_ADDRESS 0xd00033ba FORMAT "%5.0" /end MEASUREMENT
/begin MEASUREMENT Vtx_in_mem_lbup_cpt[4] "Number of times the system enters in each diagnosis conditions" UWORD _CNV_A_R_ECME_LINEA_0_CM 1 0. 0. 65535. DISPLAY_IDENTIFIER InCbiUli_NVM.Vtx_in_mem_lbup_cpt_NVM[4] ECU_ADDRESS 0xd00033bc FORMAT "%5.0" /end MEASUREMENT
/begin MEASUREMENT Vtx_mem_crit_lbup_cpt[0] "Number of criteria calculated by resolution" UWORD _CNV_A_R_ECME_LINEA_0_CM 1 0. 0. 65535. DISPLAY_IDENTIFIER InCbiUli_NVM.Vtx_mem_crit_lbup_cpt_NVM[0] ECU_ADDRESS 0xd00033c0 FORMAT "%5.0" /end MEASUREMENT
/begin MEASUREMENT Vtx_mem_crit_lbup_cpt[1] "Number of criteria calculated by resolution" UWORD _CNV_A_R_ECME_LINEA_0_CM 1 0. 0. 65535. DISPLAY_IDENTIFIER InCbiUli_NVM.Vtx_mem_crit_lbup_cpt_NVM[1] ECU_ADDRESS 0xd00033c2 FORMAT "%5.0" /end MEASUREMENT
/begin MEASUREMENT Vtx_mem_crit_lbup_cpt[2] "Number of criteria calculated by resolution" UWORD _CNV_A_R_ECME_LINEA_0_CM 1 0. 0. 65535. DISPLAY_IDENTIFIER InCbiUli_NVM.Vtx_mem_crit_lbup_cpt_NVM[2] ECU_ADDRESS 0xd00033c4 FORMAT "%5.0" /end MEASUREMENT
/begin MEASUREMENT Vtx_mem_crit_lbup_cpt[3] "Number of criteria calculated by resolution" UWORD _CNV_A_R_ECME_LINEA_0_CM 1 0. 0. 65535. DISPLAY_IDENTIFIER InCbiUli_NVM.Vtx_mem_crit_lbup_cpt_NVM[3] ECU_ADDRESS 0xd00033c6 FORMAT "%5.0" /end MEASUREMENT
/begin MEASUREMENT Vtx_mem_crit_lbup_cpt[4] "Number of criteria calculated by resolution" UWORD _CNV_A_R_ECME_LINEA_0_CM 1 0. 0. 65535. DISPLAY_IDENTIFIER InCbiUli_NVM.Vtx_mem_crit_lbup_cpt_NVM[4] ECU_ADDRESS 0xd00033c8 FORMAT "%5.0" /end MEASUREMENT
/begin MEASUREMENT Vtx_mem_crit_lbup_cpt[5] "Number of criteria calculated by resolution" UWORD _CNV_A_R_ECME_LINEA_0_CM 1 0. 0. 65535. DISPLAY_IDENTIFIER InCbiUli_NVM.Vtx_mem_crit_lbup_cpt_NVM[5] ECU_ADDRESS 0xd00033ca FORMAT "%5.0" /end MEASUREMENT
/begin MEASUREMENT Vtx_mem_crit_lbup_cpt[6] "Number of criteria calculated by resolution" UWORD _CNV_A_R_ECME_LINEA_0_CM 1 0. 0. 65535. DISPLAY_IDENTIFIER InCbiUli_NVM.Vtx_mem_crit_lbup_cpt_NVM[6] ECU_ADDRESS 0xd00033cc FORMAT "%5.0" /end MEASUREMENT
/begin MEASUREMENT Vtx_out_mem_lbup_cpt[0] "Number of times the system quits each diagnosis conditions" UWORD _CNV_A_R_ECME_LINEA_0_CM 1 0. 0. 65535. DISPLAY_IDENTIFIER InCbiUli_NVM.Vtx_out_mem_lbup_cpt_NVM[0] ECU_ADDRESS 0xd00033d0 FORMAT "%5.0" /end MEASUREMENT
/begin MEASUREMENT Vtx_out_mem_lbup_cpt[1] "Number of times the system quits each diagnosis conditions" UWORD _CNV_A_R_ECME_LINEA_0_CM 1 0. 0. 65535. DISPLAY_IDENTIFIER InCbiUli_NVM.Vtx_out_mem_lbup_cpt_NVM[1] ECU_ADDRESS 0xd00033d2 FORMAT "%5.0" /end MEASUREMENT
/begin MEASUREMENT Vtx_out_mem_lbup_cpt[2] "Number of times the system quits each diagnosis conditions" UWORD _CNV_A_R_ECME_LINEA_0_CM 1 0. 0. 65535. DISPLAY_IDENTIFIER InCbiUli_NVM.Vtx_out_mem_lbup_cpt_NVM[2] ECU_ADDRESS 0xd00033d4 FORMAT "%5.0" /end MEASUREMENT
/begin MEASUREMENT Vtx_out_mem_lbup_cpt[3] "Number of times the system quits each diagnosis conditions" UWORD _CNV_A_R_ECME_LINEA_0_CM 1 0. 0. 65535. DISPLAY_IDENTIFIER InCbiUli_NVM.Vtx_out_mem_lbup_cpt_NVM[3] ECU_ADDRESS 0xd00033d6 FORMAT "%5.0" /end MEASUREMENT
/begin MEASUREMENT Vtx_out_mem_lbup_cpt[4] "Number of times the system quits each diagnosis conditions" UWORD _CNV_A_R_ECME_LINEA_0_CM 1 0. 0. 65535. DISPLAY_IDENTIFIER InCbiUli_NVM.Vtx_out_mem_lbup_cpt_NVM[4] ECU_ADDRESS 0xd00033d8 FORMAT "%5.0" /end MEASUREMENT
/begin MEASUREMENT Vxx_nr_dc_cdn_ok_lbup_cpt "Number of driving cycle with diagnosis done" UWORD _CNV_A_R_ECME_LINEA_0_CM 1 0. 0. 65535. DISPLAY_IDENTIFIER InCbiUli_NVM.Vxx_nr_dc_cdn_ok_lbup_cpt_NVM ECU_ADDRESS 0xd00033da FORMAT "%5.0" /end MEASUREMENT
/begin MEASUREMENT Vxx_t_mv_cdn_ok_lbup_cpt "Average of the maximum durations in diagnosis conditions without diagnosis done" UBYTE _CNV_A_R_LINEAR_____267_CM 1 0. 0. 63.75 DISPLAY_IDENTIFIER InCbiUli_NVM.Vxx_t_mv_cdn_ok_lbup_cpt_NVM ECU_ADDRESS 0xd00033dc FORMAT "%5.2" /end MEASUREMENT
/begin MEASUREMENT Vbx_avl_lbup "Boolean indicating that upstream lambda sensor is ready for closed loop." UBYTE _CNV_S_2_RANGE______3_CM 1 0. 0. 1. ECU_ADDRESS 0xd0004b00 BIT_MASK 0x1 /end MEASUREMENT
/begin MEASUREMENT Vbx_df_inj_ecu_lbup_icp "Main CPU Lambda Sensor (up) pumping current detected failure" UBYTE _CNV_S_2_RANGE______3_CM 1 0. 0. 1. ECU_ADDRESS 0xd0004b01 BIT_MASK 0x1 /end MEASUREMENT
/begin MEASUREMENT Vbx_df_lbup_hot_apl_down "Front Oxygen Sensor (L/R) functionnal diagnosis before closing loop detected failure." UBYTE _CNV_S_2_RANGE______3_CM 1 0. 0. 1. ECU_ADDRESS 0xd0004b02 BIT_MASK 0x1 /end MEASUREMENT
/begin MEASUREMENT Vbx_df_lbup_nok "Front Oxygen Sensor (L/R) functionnal diagnosis after closing loop detected failure." UBYTE _CNV_S_2_RANGE______3_CM 1 0. 0. 1. ECU_ADDRESS 0xd0004b03 BIT_MASK 0x1 /end MEASUREMENT
/begin MEASUREMENT Vbx_df_lbup_oc "Front Oxygen Sensor (L/R) Open circuit detected failure" UBYTE _CNV_S_2_RANGE______3_CM 1 0. 0. 1. ECU_ADDRESS 0xd0004b04 BIT_MASK 0x1 /end MEASUREMENT
/begin MEASUREMENT Vbx_df_lbup_scg "Front Oxygen Sensor (L/R) Short circuit to ground detected failure" UBYTE _CNV_S_2_RANGE______3_CM 1 0. 0. 1. ECU_ADDRESS 0xd0004b05 BIT_MASK 0x1 /end MEASUREMENT
/begin MEASUREMENT Vbx_df_lbup_scw "Front Oxygen Sensor (L/R) Short circuit at battery + detected failure" UBYTE _CNV_S_2_RANGE______3_CM 1 0. 0. 1. ECU_ADDRESS 0xd0004b06 BIT_MASK 0x1 /end MEASUREMENT
/begin MEASUREMENT Vbx_diag_ena_inj_ecu_lbup_icp "Main CPU Lambda Sensor (up) pumping current diagnostic authorisation" UBYTE _CNV_S_2_RANGE______3_CM 1 0. 0. 1. ECU_ADDRESS 0xd0004b07 BIT_MASK 0x1 /end MEASUREMENT
/begin MEASUREMENT Vbx_diag_ena_lbup_hot_apl_down "Front Oxygen Sensor (L/R) functionnal diagnosis before closing loop authorisation." UBYTE _CNV_S_2_RANGE______3_CM 1 0. 0. 1. ECU_ADDRESS 0xd0004b08 BIT_MASK 0x1 /end MEASUREMENT
/begin MEASUREMENT Vbx_diag_ena_lbup_nok "Front Oxygen Sensor (L/R) functionnal diagnosis after closing loop authorisation." UBYTE _CNV_S_2_RANGE______3_CM 1 0. 0. 1. ECU_ADDRESS 0xd0004b09 BIT_MASK 0x1 /end MEASUREMENT
/begin MEASUREMENT Vbx_diag_ena_lbup_oc "Front Oxygen Sensor (L/R) Open circuit diagnostic authorisation" UBYTE _CNV_S_2_RANGE______3_CM 1 0. 0. 1. ECU_ADDRESS 0xd0004b0a BIT_MASK 0x1 /end MEASUREMENT
/begin MEASUREMENT Vbx_diag_ena_lbup_scg "Front Oxygen Sensor (L/R) Short circuit to ground diagnostic authorisation" UBYTE _CNV_S_2_RANGE______3_CM 1 0. 0. 1. ECU_ADDRESS 0xd0004b0b BIT_MASK 0x1 /end MEASUREMENT
/begin MEASUREMENT Vbx_diag_ena_lbup_scw "Front Oxygen Sensor (L/R) Shor circuit at battery + diagnostic authorisation" UBYTE _CNV_S_2_RANGE______3_CM 1 0. 0. 1. ECU_ADDRESS 0xd0004b0c BIT_MASK 0x1 /end MEASUREMENT
/begin MEASUREMENT Vbx_ini_temp_oc "Event of reinitialisation of retaining time for the detection of the open circuit on upstream sensor" UBYTE _CNV_S_2_RANGE______3_CM 1 0. 0. 1. ECU_ADDRESS 0xd0004b0d BIT_MASK 0x1 /end MEASUREMENT
/begin MEASUREMENT Vbx_lbup_diag_ena "Meter associated to the indicator of (warm) ready probe for the diagnoses of upstream sensor" UBYTE _CNV_S_2_RANGE______3_CM 1 0. 0. 1. ECU_ADDRESS 0xd0004b0e BIT_MASK 0x1 /end MEASUREMENT
/begin MEASUREMENT Vbx_lbup_frst_thd_hot "Indicate that the sensor signal have already been out of the min-max thd with a hot sensor." UBYTE _CNV_S_2_RANGE______3_CM 1 0. 0. 1. ECU_ADDRESS 0xd0004b0f BIT_MASK 0x1 /end MEASUREMENT
/begin MEASUREMENT Vbx_lbup_in_out_thd "Indicate if the sensor signal is in the min-max range define by calibration." UBYTE _CNV_S_2_RANGE______3_CM 1 0. 0. 1. ECU_ADDRESS 0xd0004b10 BIT_MASK 0x1 /end MEASUREMENT
/begin MEASUREMENT Vsx_lbup_vld "Front Oxygen Sensor (L/R) validity status" UBYTE _CNV_A_R_ECME_LINEA_0_CM 1 0. 0. 2. ECU_ADDRESS 0xd0004b11 FORMAT "%1.0" /end MEASUREMENT
/begin MEASUREMENT Vxx_lbup_diag_ena "Meter associated to the indicator of (warm) ready probe for the diagnoses of upstream sensor" UWORD _CNV_A_R_LINEAR_____34_CM 1 0. 0. 655.35 ECU_ADDRESS 0xd0003900 FORMAT "%6.2" /end MEASUREMENT
/begin MEASUREMENT Vxx_lbup_oc_t "Retaining time used for the detection of an open circuit defect on upstream sensor" UWORD _CNV_A_R_LINEAR_____34_CM 1 0. 0. 655.35 ECU_ADDRESS 0xd0003902 FORMAT "%6.2" /end MEASUREMENT
/begin MEASUREMENT Vxx_lbup_oc_trs_ctr "Meter of the number of transitions without taking out of the strip of detection of an open circuit on upstream sensor" UBYTE _CNV_A_R_ECME_LINEA_0_CM 1 0. 0. 255. ECU_ADDRESS 0xd0004b12 FORMAT "%3.0" /end MEASUREMENT
/begin MEASUREMENT Vxx_lbup_pump_crt_t "Time after which we make the diagnosis of the upstream sensor pumping current" UWORD _CNV_A_R_LINEAR_____34_CM 1 0. 0. 655.35 ECU_ADDRESS 0xd0003904 FORMAT "%6.2" /end MEASUREMENT
/begin MEASUREMENT Vxx_sens_lbup_v_old "Tension sounds amont measured at the moment t-1 used for the diagnosis of the open circuit" UWORD _CNV_A_R_LINEAR_____52_CM 1 0. 0. 25000. ECU_ADDRESS 0xd0003906 FORMAT "%5.0" /end MEASUREMENT
/begin CHARACTERISTIC Cbx_avl_lbup_scw_rdn "Activation of the SCW diagnosis to concider an available upstream sensor" VALUE 0xa0021da2 _REC_S1VAL_20_u1 1. _CNV_S_2_RANGE______3_CM 0. 1. BIT_MASK 0x1 /end CHARACTERISTIC
/begin CHARACTERISTIC Cbx_lbup_osp_conf "Boolean of configuration to select an upstream sensor of type OSP+ (Cbx_lbup_osp_typ = one)" VALUE 0xa0021da3 _REC_S1VAL_20_u1 1. _CNV_A_R_ECME_LINEA_0_CM 0. 1. FORMAT "%1.0" BIT_MASK 0x1 /end CHARACTERISTIC
/begin CHARACTERISTIC Cxx_dfdec_inj_ecu_lbup_icp "Main CPU Lambda Sensor (up) pumping current detected failure counter decrement" VALUE 0xa0021d6c _REC_S1VAL_20_u2 65535. _CNV_A_R_ECME_LINEA_0_CM 0. 65535. FORMAT "%5.0" /end CHARACTERISTIC
/begin CHARACTERISTIC Cxx_dfdec_lbup_hot_apl_down "Front Oxygen Sensor (L/R) functionnal error detected (before closing loop) failure counter decrement." VALUE 0xa0021d6e _REC_S1VAL_20_u2 65535. _CNV_A_R_ECME_LINEA_0_CM 0. 65535. FORMAT "%5.0" /end CHARACTERISTIC
/begin CHARACTERISTIC Cxx_dfdec_lbup_nok "Front Oxygen Sensor (L/R) functionnal error detected (after closing loop) failure counter decrement." VALUE 0xa0021d70 _REC_S1VAL_20_u2 65535. _CNV_A_R_ECME_LINEA_0_CM 0. 65535. FORMAT "%5.0" /end CHARACTERISTIC
/begin CHARACTERISTIC Cxx_dfdec_lbup_oc "Front Oxygen Sensor (L/R) Open circuit detected failure counter decrement" VALUE 0xa0021d72 _REC_S1VAL_20_u2 65535. _CNV_A_R_ECME_LINEA_0_CM 0. 65535. FORMAT "%5.0" /end CHARACTERISTIC
/begin CHARACTERISTIC Cxx_dfdec_lbup_scg "Front Oxygen Sensor (L/R) Short circuit to ground detected failure counter decrement" VALUE 0xa0021d74 _REC_S1VAL_20_u2 65535. _CNV_A_R_ECME_LINEA_0_CM 0. 65535. FORMAT "%5.0" /end CHARACTERISTIC
/begin CHARACTERISTIC Cxx_dfdec_lbup_scw "Front Oxygen Sensor (L/R) Short circuit at battery + detected failure counter decrement" VALUE 0xa0021d76 _REC_S1VAL_20_u2 65535. _CNV_A_R_ECME_LINEA_0_CM 0. 65535. FORMAT "%5.0" /end CHARACTERISTIC
/begin CHARACTERISTIC Cxx_dfinc_inj_ecu_lbup_icp "Main CPU Lambda Sensor (up) pumping current detected failure counter increment" VALUE 0xa0021d78 _REC_S1VAL_20_u2 65535. _CNV_A_R_ECME_LINEA_0_CM 0. 65535. FORMAT "%5.0" /end CHARACTERISTIC
/begin CHARACTERISTIC Cxx_dfinc_lbup_hot_apl_down "Front Oxygen Sensor (L/R) functionnal error detected (before closing loop) failure counter increment." VALUE 0xa0021d7a _REC_S1VAL_20_u2 65535. _CNV_A_R_ECME_LINEA_0_CM 0. 65535. FORMAT "%5.0" /end CHARACTERISTIC
/begin CHARACTERISTIC Cxx_dfinc_lbup_nok "Front Oxygen Sensor (L/R) functionnal error detected (after closing loop) failure counter increment." VALUE 0xa0021d7c _REC_S1VAL_20_u2 65535. _CNV_A_R_ECME_LINEA_0_CM 0. 65535. FORMAT "%5.0" /end CHARACTERISTIC
/begin CHARACTERISTIC Cxx_dfinc_lbup_oc "Front Oxygen Sensor (L/R) Open circuit detected failure counter increment" VALUE 0xa0021d7e _REC_S1VAL_20_u2 65535. _CNV_A_R_ECME_LINEA_0_CM 0. 65535. FORMAT "%5.0" /end CHARACTERISTIC
/begin CHARACTERISTIC Cxx_dfinc_lbup_scg "Front Oxygen Sensor (L/R) Short circuit to ground detected failure counter increment" VALUE 0xa0021d80 _REC_S1VAL_20_u2 65535. _CNV_A_R_ECME_LINEA_0_CM 0. 65535. FORMAT "%5.0" /end CHARACTERISTIC
/begin CHARACTERISTIC Cxx_dfinc_lbup_scw "Front Oxygen Sensor (L/R) Short circuit at battery + detected failure counter increment" VALUE 0xa0021d82 _REC_S1VAL_20_u2 65535. _CNV_A_R_ECME_LINEA_0_CM 0. 65535. FORMAT "%5.0" /end CHARACTERISTIC
/begin CHARACTERISTIC Cxx_l_v_lamb_thd "Tension threshold over which lambda sensor is considered to hot and ready" VALUE 0xa0021d84 _REC_S1VAL_20_u2 25000. _CNV_A_R_LINEAR_____52_CM 0. 25000. FORMAT "%5.0" /end CHARACTERISTIC
/begin CHARACTERISTIC Cxx_lbup_hot_stt_t "Duration, after starting up, beyond which we consider the amont warm probe" VALUE 0xa0021d86 _REC_S1VAL_20_u2 655.35 _CNV_A_R_LINEAR_____34_CM 0. 655.35 FORMAT "%6.2" /end CHARACTERISTIC
/begin CHARACTERISTIC Cxx_lbup_oc_det_h_v "High threshold of frame of the tension of polarization upstream sensor for the detection open circuit" VALUE 0xa0021d88 _REC_S1VAL_20_u2 25000. _CNV_A_R_LINEAR_____52_CM 0. 25000. FORMAT "%5.0" /end CHARACTERISTIC
/begin CHARACTERISTIC Cxx_lbup_oc_det_l_v "Low threshold of frame of the tension of polarization upstream sensor for the detection open circuit" VALUE 0xa0021d8a _REC_S1VAL_20_u2 25000. _CNV_A_R_LINEAR_____52_CM 0. 25000. FORMAT "%5.0" /end CHARACTERISTIC
/begin CHARACTERISTIC Cxx_lbup_oc_t "Lasted in the strip of detection beyond which we declare a defect opened circuit" VALUE 0xa0021d8c _REC_S1VAL_20_u2 655.35 _CNV_A_R_LINEAR_____34_CM 0. 655.35 FORMAT "%6.2" /end CHARACTERISTIC
/begin CHARACTERISTIC Cxx_lbup_oc_trs_ctr "Number of transitions without taking out of the strip of detection of open circuit probe amont." VALUE 0xa0021da4 _REC_S1VAL_20_u1 255. _CNV_A_R_ECME_LINEA_0_CM 0. 255. FORMAT "%3.0" /end CHARACTERISTIC
/begin CHARACTERISTIC Cxx_lbup_osp_oc_det_h_v "High threshold of frame tension of OSP+ upstream sensor polarization for detection open circuit" VALUE 0xa0021d8e _REC_S1VAL_20_u2 25000. _CNV_A_R_LINEAR_____52_CM 0. 25000. FORMAT "%5.0" /end CHARACTERISTIC
/begin CHARACTERISTIC Cxx_lbup_osp_oc_det_l_v "Low threshold of frame tension of OSP+ upstream sensor polarization for detection open circuit" VALUE 0xa0021d90 _REC_S1VAL_20_u2 25000. _CNV_A_R_LINEAR_____52_CM 0. 25000. FORMAT "%5.0" /end CHARACTERISTIC
/begin CHARACTERISTIC Cxx_lbup_osp_scg_det_v "Low threshold of OSP+ upstream sensor tension to discover the defect short circuit in the ground (closed loop)" VALUE 0xa0021d92 _REC_S1VAL_20_u2 25000. _CNV_A_R_LINEAR_____52_CM 0. 25000. FORMAT "%5.0" /end CHARACTERISTIC
/begin CHARACTERISTIC Cxx_lbup_osp_scw_det_v "Threshold of OSP+ upsream sensor tension beyond which we discover a short circuit in + battery" VALUE 0xa0021d94 _REC_S1VAL_20_u2 25000. _CNV_A_R_LINEAR_____52_CM 0. 25000. FORMAT "%5.0" /end CHARACTERISTIC
/begin CHARACTERISTIC Cxx_lbup_pump_crt_t "Lasted in the course of which we make the diagnosis of the upstream sensor pumping current" VALUE 0xa0021d96 _REC_S1VAL_20_u2 655.35 _CNV_A_R_LINEAR_____34_CM 0. 655.35 FORMAT "%6.2" /end CHARACTERISTIC
/begin CHARACTERISTIC Cxx_lbup_pump_crt_v_thd "Threshold of tension beyond of which we discover a breakdown of the upstream sensor pumping current" VALUE 0xa0021d98 _REC_S1VAL_20_u2 25000. _CNV_A_R_LINEAR_____52_CM 0. 25000. FORMAT "%5.0" /end CHARACTERISTIC
/begin CHARACTERISTIC Cxx_lbup_scg_det_v "Threshold tension sounds amont under which we discover the defect short circuit in the ground (closed loop)" VALUE 0xa0021d9a _REC_S1VAL_20_u2 25000. _CNV_A_R_LINEAR_____52_CM 0. 25000. FORMAT "%5.0" /end CHARACTERISTIC
/begin CHARACTERISTIC Cxx_lbup_scw_det_v "Threshold of upstream sensor tension beyond which we discover a defect short circuit in + battery" VALUE 0xa0021d9c _REC_S1VAL_20_u2 25000. _CNV_A_R_LINEAR_____52_CM 0. 25000. FORMAT "%5.0" /end CHARACTERISTIC
/begin CHARACTERISTIC Cxx_lbup_v_thd "Threshold of reflation of the temporization of breakdown open circuit" VALUE 0xa0021d9e _REC_S1VAL_20_u2 25000. _CNV_A_R_LINEAR_____52_CM 0. 25000. FORMAT "%5.0" /end CHARACTERISTIC
/begin CHARACTERISTIC Cxx_up_v_lamb_thd "Tension threshold under which lambda sensor is considered hot and ready" VALUE 0xa0021da0 _REC_S1VAL_20_u2 25000. _CNV_A_R_LINEAR_____52_CM 0. 25000. FORMAT "%5.0" /end CHARACTERISTIC
/begin AXIS_PTS Ntb_lbup_maf "17 Break point for the \"Vxx_pump_maf_fil_lbup\" interpolation" 0xa0025098 Vxx_pump_maf_lbup_mv _REC_A2AXS_20_u2 3000. _CNV_A_R_LINEAR_____109_CM 17 0. 3000. READ_ONLY FORMAT "%7.2" /end AXIS_PTS
/begin CHARACTERISTIC Ctp_lbup_per_max "The oxigËne sensor failure threshold" CURVE 0xa00250bc _REC_A1CUR_20_u2_u2 655.35 _CNV_A_R_LINEAR_____34_CM 0. 655.35 FORMAT "%6.2"
 /begin AXIS_DESCR COM_AXIS Vxx_pump_maf_lbup_mv _CNV_A_R_LINEAR_____109_CM 17 0. 3000. READ_ONLY FORMAT "%7.2" AXIS_PTS_REF Ntb_lbup_maf /end AXIS_DESCR
/end CHARACTERISTIC
/begin MEASUREMENT Vbx_df_lbup_cpt "Front Oxygen Sensor (L/R) Component diagnostic detected failure" UBYTE _CNV_S_2_RANGE______3_CM 1 0. 0. 1. ECU_ADDRESS 0xd0003efb BIT_MASK 0x1 /end MEASUREMENT
/begin MEASUREMENT Vbx_diag_ena_lbup_cpt "Front Oxygen Sensor (L/R) Component diagnostic authorization" UBYTE _CNV_S_2_RANGE______3_CM 1 0. 0. 1. ECU_ADDRESS 0xd0003efc BIT_MASK 0x1 /end MEASUREMENT
/begin MEASUREMENT Vbx_diag_sta_lbup_abrt "Lambda routine aborded status" UBYTE _CNV_S_2_RANGE______3_CM 1 0. 0. 1. ECU_ADDRESS 0xd0005710 BIT_MASK 0x1 /end MEASUREMENT
/begin MEASUREMENT Vbx_diag_sta_lbup_ena "Lambda routine activation status" UBYTE _CNV_S_2_RANGE______3_CM 1 0. 0. 1. ECU_ADDRESS 0xd0003efd BIT_MASK 0x1 /end MEASUREMENT
/begin MEASUREMENT Vbx_diag_sta_lbup_end "Lambda routine completed status" UBYTE _CNV_S_2_RANGE______3_CM 1 0. 0. 1. ECU_ADDRESS 0xd0005711 BIT_MASK 0x1 /end MEASUREMENT
/begin MEASUREMENT Vbx_ena_diag_lbup "OBD Lambda diagnosis autorisation" UBYTE _CNV_S_2_RANGE______3_CM 1 0. 0. 1. ECU_ADDRESS 0xd0003efe BIT_MASK 0x1 /end MEASUREMENT
/begin MEASUREMENT Vbx_inhi_ena_diag_lbup "Inhibition condition for lambda diagnostic" UBYTE _CNV_S_2_RANGE______3_CM 1 0. 0. 1. ECU_ADDRESS 0xd0003eff BIT_MASK 0x1 /end MEASUREMENT
/begin MEASUREMENT Vbx_lbup_diag_stop "Lambda diagnostic is complete" UBYTE _CNV_S_2_RANGE______3_CM 1 0. 0. 1. ECU_ADDRESS 0xd0003f00 BIT_MASK 0x1 /end MEASUREMENT
/begin MEASUREMENT Vbx_lbup_dsb_ad_rich "Lambda diagnostic asks for the inhibition of the richness adaptative" UBYTE _CNV_S_2_RANGE______3_CM 1 0. 0. 1. ECU_ADDRESS 0xd0003f01 BIT_MASK 0x1 /end MEASUREMENT
/begin MEASUREMENT Vbx_lbup_dsb_cp "OBD lambda diagnostic request" UBYTE _CNV_S_2_RANGE______3_CM 1 0. 0. 1. ECU_ADDRESS 0xd0003f02 BIT_MASK 0x1 /end MEASUREMENT
/begin MEASUREMENT Vbx_lbup_mes "Lambda diagnostic mesure is complete" UBYTE _CNV_S_2_RANGE______3_CM 1 0. 0. 1. ECU_ADDRESS 0xd0003f03 BIT_MASK 0x1 /end MEASUREMENT
/begin MEASUREMENT Vbx_lbup_per_dly_acq_max "Maximum duration of reached acquisition" UBYTE _CNV_S_2_RANGE______3_CM 1 0. 0. 1. ECU_ADDRESS 0xd0003f04 BIT_MASK 0x1 /end MEASUREMENT
/begin MEASUREMENT Vbx_lbup_req "OBD lambda diagnostic request" UBYTE _CNV_S_2_RANGE______3_CM 1 0. 0. 1. ECU_ADDRESS 0xd0003f05 BIT_MASK 0x1 /end MEASUREMENT
/begin MEASUREMENT Vbx_phy_ena_diag_lbup "Physical condition for lambda diagnostic" UBYTE _CNV_S_2_RANGE______3_CM 1 0. 0. 1. ECU_ADDRESS 0xd0003f06 BIT_MASK 0x1 /end MEASUREMENT
/begin MEASUREMENT Vbx_sw_ena_diag_lbup "Softxare condition for lambda diagnostic" UBYTE _CNV_S_2_RANGE______3_CM 1 0. 0. 1. ECU_ADDRESS 0xd0003f07 BIT_MASK 0x1 /end MEASUREMENT
/begin MEASUREMENT Vsx_diag_sta_lbup_stt "Lambda routine status" UBYTE _CNV_A_R_ECME_LINEA_0_CM 1 0. 0. 255. ECU_ADDRESS 0xd0003ef1 FORMAT "%3.0" /end MEASUREMENT
/begin MEASUREMENT Vsx_lbup_stt "Lambda diagnostic states" UBYTE _CNV_A_R_ECME_LINEA_0_CM 1 0. 0. 60. ECU_ADDRESS 0xd0003ef2 FORMAT "%2.0" /end MEASUREMENT
/begin MEASUREMENT Vxx_edic_lbup_dly "Timer for minimal waiting between two diagnosis for edic needs" UWORD _CNV_A_R_LINEAR_____34_CM 1 0. 0. 655.35 ECU_ADDRESS 0xd0003742 FORMAT "%6.2" /end MEASUREMENT
/begin MEASUREMENT Vxx_lbup_asd_diag_ctr "Counter of diagnostic in after sale mode" UBYTE _CNV_A_R_ECME_LINEA_0_CM 1 0. 0. 255. ECU_ADDRESS 0xd0003ef3 FORMAT "%3.0" /end MEASUREMENT
/begin MEASUREMENT Vxx_lbup_asd_sf "Lambda state for after sale mode" UBYTE _CNV_A_R_ECME_LINEA_0_CM 1 0. 0. 3. ECU_ADDRESS 0xd0003ef4 FORMAT "%1.0" /end MEASUREMENT
/begin MEASUREMENT Vxx_lbup_asd_sf_ctr "Counter of diagnostic result consecutive in the same state for after sale diagnostic" UBYTE _CNV_A_R_ECME_LINEA_0_CM 1 0. 0. 255. ECU_ADDRESS 0xd0003ef5 FORMAT "%3.0" /end MEASUREMENT
/begin MEASUREMENT Vxx_lbup_asd_tout_dly "Time out for after sale diagnostic if the request can't switch to on" UWORD _CNV_A_R_LINEAR_____34_CM 1 0. 0. 655.35 ECU_ADDRESS 0xd0003744 FORMAT "%6.2" /end MEASUREMENT
/begin MEASUREMENT Vxx_lbup_in_ctr "Counter of transition Nsx_lbup_cpt_dg_dsb to Nsx_lbup_cpt_stab" UBYTE _CNV_A_R_ECME_LINEA_0_CM 1 0. 0. 255. ECU_ADDRESS 0xd0003ef6 FORMAT "%3.0" /end MEASUREMENT
/begin MEASUREMENT Vxx_lbup_jerk_nr "Number of bad transition" UBYTE _CNV_A_R_ECME_LINEA_0_CM 1 0. 0. 255. ECU_ADDRESS 0xd0003ef7 FORMAT "%3.0" /end MEASUREMENT
/begin MEASUREMENT Vxx_lbup_per_ctr "Counter of the periode duration" UWORD _CNV_A_R_LINEAR_____34_CM 1 0. 0. 655.35 ECU_ADDRESS 0xd0003746 FORMAT "%6.2" /end MEASUREMENT
/begin MEASUREMENT Vxx_lbup_per_dly_acq "Result of the elementary mesure acquisition" UWORD _CNV_A_R_LINEAR_____34_CM 1 0. 0. 655.35 ECU_ADDRESS 0xd0003748 FORMAT "%6.2" /end MEASUREMENT
/begin MEASUREMENT Vxx_lbup_per_dly_tot "Result of the total mesure acquisition" UWORD _CNV_A_R_LINEAR_____34_CM 1 0. 0. 655.35 ECU_ADDRESS 0xd000374a FORMAT "%6.2" /end MEASUREMENT
/begin MEASUREMENT Vxx_lbup_per_mv "The average pÈriode elementary" UWORD _CNV_A_R_LINEAR_____34_CM 1 0. 0. 655.35 ECU_ADDRESS 0xd000374c FORMAT "%6.2" /end MEASUREMENT
/begin MEASUREMENT Vxx_lbup_per_mv_max "The oxygen sensor failure threshold" UWORD _CNV_A_R_LINEAR_____34_CM 1 0. 0. 655.35 ECU_ADDRESS 0xd000374e FORMAT "%6.2" /end MEASUREMENT
/begin MEASUREMENT Vxx_lbup_per_nr "Number of periode during elementary acquisition" UBYTE _CNV_A_R_ECME_LINEA_0_CM 1 0. 0. 255. ECU_ADDRESS 0xd0003ef8 FORMAT "%3.0" /end MEASUREMENT
/begin MEASUREMENT Vxx_lbup_per_nr_tot "Number of total periode for the diagnostic" UBYTE _CNV_A_R_ECME_LINEA_0_CM 1 0. 0. 255. ECU_ADDRESS 0xd0003ef9 FORMAT "%3.0" /end MEASUREMENT
/begin MEASUREMENT Vxx_lbup_per_out_mes "Number of transition poor/rich before mesure" UBYTE _CNV_A_R_ECME_LINEA_0_CM 1 0. 0. 255. ECU_ADDRESS 0xd0003efa FORMAT "%3.0" /end MEASUREMENT
/begin MEASUREMENT Vxx_lbup_per_tot_mv "The average pÈriode total for the diagnostic" UWORD _CNV_A_R_LINEAR_____34_CM 1 0. 0. 655.35 ECU_ADDRESS 0xd0003750 FORMAT "%6.2" /end MEASUREMENT
/begin MEASUREMENT Vxx_lbup_stab_dly "Timer for stabilisation before mesure" UWORD _CNV_A_R_LINEAR_____34_CM 1 0. 0. 655.35 ECU_ADDRESS 0xd0003752 FORMAT "%6.2" /end MEASUREMENT
/begin MEASUREMENT Vxx_lgl_dly_diag_lbup "Timer before catalyst diagnosis" UWORD _CNV_A_R_LINEAR_____4_CM 1 0. 0. 6553.5 ECU_ADDRESS 0xd0003754 FORMAT "%6.1" /end MEASUREMENT
/begin MEASUREMENT Vxx_pump_maf_lbup_mem "Amount of air pumped into cylinder memorised for the diagnostic stability" UWORD _CNV_A_R_LINEAR_____109_CM 1 0. 0. 3000. ECU_ADDRESS 0xd0003756 FORMAT "%7.2" /end MEASUREMENT
/begin MEASUREMENT Vxx_pump_maf_lbup_mv "Amount of air pumped into cylinder for lambda diagnostic" UWORD _CNV_A_R_LINEAR_____109_CM 1 0. 0. 3000. ECU_ADDRESS 0xd0003758 FORMAT "%7.2" /end MEASUREMENT
/begin MEASUREMENT Vxx_pump_maf_lbup_prop_per "Amount of air pumped into cylinder memorised during the elementary mesure * number of elementary pÈriode" UWORD _CNV_A_R_LINEAR_____109_CM 1 0. 0. 3000. ECU_ADDRESS 0xd000375a FORMAT "%7.2" /end MEASUREMENT
/begin CHARACTERISTIC Cxx_conf_diag_lbup "Lambda Diagnostic is: 0=forbidden; 1=conventional mode; 2=bench mode" VALUE 0xa0020dca _REC_S1VAL_20_u1 3. _CNV_A_R_ECME_LINEA_0_CM 0. 3. FORMAT "%1.0" /end CHARACTERISTIC
/begin CHARACTERISTIC Cxx_dfdec_lbup_cpt "Front Oxygen Sensor (L/R) Component detected failure counter decrement" VALUE 0xa0020da2 _REC_S1VAL_20_u2 65535. _CNV_A_R_ECME_LINEA_0_CM 0. 65535. FORMAT "%5.0" /end CHARACTERISTIC
/begin CHARACTERISTIC Cxx_dfinc_lbup_cpt "Front Oxygen Sensor (L/R) Component detected failure counter increment" VALUE 0xa0020da4 _REC_S1VAL_20_u2 65535. _CNV_A_R_ECME_LINEA_0_CM 0. 65535. FORMAT "%5.0" /end CHARACTERISTIC
/begin CHARACTERISTIC Cxx_edic_lbup_dly "Minimum duration waiting between two diagnosis for edic needs" VALUE 0xa0020da6 _REC_S1VAL_20_u2 655.35 _CNV_A_R_LINEAR_____34_CM 0. 655.35 FORMAT "%6.2" /end CHARACTERISTIC
/begin CHARACTERISTIC Cxx_lbup_asd_diag_nr "Maximum number of diagnostic in after sale mode" VALUE 0xa0020dcb _REC_S1VAL_20_u1 255. _CNV_A_R_ECME_LINEA_0_CM 0. 255. FORMAT "%3.0" /end CHARACTERISTIC
/begin CHARACTERISTIC Cxx_lbup_asd_in_nr "Number of attempt for diagnosis in after sale mode" VALUE 0xa0020dcc _REC_S1VAL_20_u1 255. _CNV_A_R_ECME_LINEA_0_CM 0. 255. FORMAT "%3.0" /end CHARACTERISTIC
/begin CHARACTERISTIC Cxx_lbup_asd_sf_nr "Number of diagnostic result consecutive in the same state for after sale diagnostic" VALUE 0xa0020dcd _REC_S1VAL_20_u1 255. _CNV_A_R_ECME_LINEA_0_CM 0. 255. FORMAT "%3.0" /end CHARACTERISTIC
/begin CHARACTERISTIC Cxx_lbup_asd_tout_dly "Time out for after sale diagnostic if the request can't switch to on" VALUE 0xa0020da8 _REC_S1VAL_20_u2 655.35 _CNV_A_R_LINEAR_____34_CM 0. 655.35 FORMAT "%6.2" /end CHARACTERISTIC
/begin CHARACTERISTIC Cxx_lbup_diag_gear "Gear engaged ([-1 0 1 2 3 4 5 6]) for Lambda diagnosis authorization" VALUE 0xa0020dce _REC_S1VAL_20_u1 7. _CNV_A_R_LINEAR_____113_CM -1. 6. FORMAT "%2.0" /end CHARACTERISTIC
/begin CHARACTERISTIC Cxx_lbup_fuel_typ_rat_max_1 "First maximum rate of exotic fuel to authorize the diagnosis of the oxygen sensor" VALUE 0xa0020daa _REC_S1VAL_20_u2 1. _CNV_A_R_LINEAR_____108_CM 0. 1. FORMAT "%5.3" /end CHARACTERISTIC
/begin CHARACTERISTIC Cxx_lbup_fuel_typ_rat_max_2 "Second maximum rate of exotic fuel to authorize the diagnosis of the oxygen sensor" VALUE 0xa0020dac _REC_S1VAL_20_u2 1. _CNV_A_R_LINEAR_____108_CM 0. 1. FORMAT "%5.3" /end CHARACTERISTIC
/begin CHARACTERISTIC Cxx_lbup_fuel_typ_rat_min_1 "First minimum rate of exotic fuel to authorize the diagnosis of the oxygen sensor" VALUE 0xa0020dae _REC_S1VAL_20_u2 1. _CNV_A_R_LINEAR_____108_CM 0. 1. FORMAT "%5.3" /end CHARACTERISTIC
/begin CHARACTERISTIC Cxx_lbup_fuel_typ_rat_min_2 "Second minimum rate of exotic fuel to authorize the diagnosis of the oxygen sensor" VALUE 0xa0020db0 _REC_S1VAL_20_u2 1. _CNV_A_R_LINEAR_____108_CM 0. 1. FORMAT "%5.3" /end CHARACTERISTIC
/begin CHARACTERISTIC Cxx_lbup_hys_maf "Hysteresis on amount of air pumped into cylinder for diagnosis conditions." VALUE 0xa0020db2 _REC_S1VAL_20_u2 3000. _CNV_A_R_LINEAR_____109_CM 0. 3000. FORMAT "%7.2" /end CHARACTERISTIC
/begin CHARACTERISTIC Cxx_lbup_hys_n "Hysteresis on engine speed for diagnostic conditions" VALUE 0xa0020db4 _REC_S1VAL_20_u2 16383.75 _CNV_A_R_ENSD_LINEA_24_CM 0. 16383.75 FORMAT "%8.2" /end CHARACTERISTIC
/begin CHARACTERISTIC Cxx_lbup_in_nr "Number of attempt for diagnostis" VALUE 0xa0020dcf _REC_S1VAL_20_u1 255. _CNV_A_R_ECME_LINEA_0_CM 0. 255. FORMAT "%3.0" /end CHARACTERISTIC
/begin CHARACTERISTIC Cxx_lbup_maf_dif_max "Maximum variation of aount of air pumped into cylinder for diagnosis cnditions" VALUE 0xa0020db6 _REC_S1VAL_20_u2 3000. _CNV_A_R_LINEAR_____109_CM 0. 3000. FORMAT "%7.2" /end CHARACTERISTIC
/begin CHARACTERISTIC Cxx_lbup_maf_max "Maximum value of aount of air pumped into cylinder for diagnosis cnditions" VALUE 0xa0020db8 _REC_S1VAL_20_u2 3000. _CNV_A_R_LINEAR_____109_CM 0. 3000. FORMAT "%7.2" /end CHARACTERISTIC
/begin CHARACTERISTIC Cxx_lbup_maf_mes_max "Maximum drift of aount of air pumped into cylinder for diagnosis cnditions" VALUE 0xa0020dba _REC_S1VAL_20_u2 3000. _CNV_A_R_LINEAR_____109_CM 0. 3000. FORMAT "%7.2" /end CHARACTERISTIC
/begin CHARACTERISTIC Cxx_lbup_maf_min "Minimum value of aount of air pumped into cylinder for diagnosis cnditions" VALUE 0xa0020dbc _REC_S1VAL_20_u2 3000. _CNV_A_R_LINEAR_____109_CM 0. 3000. FORMAT "%7.2" /end CHARACTERISTIC
/begin CHARACTERISTIC Cxx_lbup_n_max "Maximum value of engine speed for diagnosis condition" VALUE 0xa0020dbe _REC_S1VAL_20_u2 16383.75 _CNV_A_R_ENSD_LINEA_24_CM 0. 16383.75 FORMAT "%8.2" /end CHARACTERISTIC
/begin CHARACTERISTIC Cxx_lbup_n_min "Minimum value of engine speed for diagnosis condition" VALUE 0xa0020dc0 _REC_S1VAL_20_u2 16383.75 _CNV_A_R_ENSD_LINEA_24_CM 0. 16383.75 FORMAT "%8.2" /end CHARACTERISTIC
/begin CHARACTERISTIC Cxx_lbup_per_dly "Maximum duration for one periode." VALUE 0xa0020dc2 _REC_S1VAL_20_u2 655.35 _CNV_A_R_LINEAR_____268_CM 2. 657.35 FORMAT "%6.2" /end CHARACTERISTIC
/begin CHARACTERISTIC Cxx_lbup_per_nr_min "Minimum number of periode for evry acquisitions." VALUE 0xa0020dd0 _REC_S1VAL_20_u1 255. _CNV_A_R_ECME_LINEA_0_CM 0. 255. FORMAT "%3.0" /end CHARACTERISTIC
/begin CHARACTERISTIC Cxx_lbup_per_nr_tot "Number of total periode for the diagnostic needs" VALUE 0xa0020dd1 _REC_S1VAL_20_u1 255. _CNV_A_R_ECME_LINEA_0_CM 0. 255. FORMAT "%3.0" /end CHARACTERISTIC
/begin CHARACTERISTIC Cxx_lbup_per_swi_nr "Number of transition poor/rich needs before mesure" VALUE 0xa0020dd2 _REC_S1VAL_20_u1 255. _CNV_A_R_ECME_LINEA_0_CM 0. 255. FORMAT "%3.0" /end CHARACTERISTIC
/begin CHARACTERISTIC Cxx_lbup_stab_dly "Duration of the stabilisation before mesure" VALUE 0xa0020dc4 _REC_S1VAL_20_u2 655.35 _CNV_A_R_LINEAR_____34_CM 0. 655.35 FORMAT "%6.2" /end CHARACTERISTIC
/begin CHARACTERISTIC Cxx_lbup_tco_min "Minimum value of engine coolant temperature for diagnosis conditions." VALUE 0xa0020dc6 _REC_S1VAL_20_u2 240. _CNV_A_R_LINEAR_____54_CM -40. 200. FORMAT "%5.1" /end CHARACTERISTIC
/begin CHARACTERISTIC Cxx_lgl_dly_diag_lbup "Duration before catalyst diagnosis" VALUE 0xa0020dc8 _REC_S1VAL_20_u2 6553.5 _CNV_A_R_LINEAR_____4_CM 0. 6553.5 FORMAT "%6.1" /end CHARACTERISTIC
/begin CHARACTERISTIC Cmp_n_eal_lbup_v_thd_alco "Map of upstream lambda tension threshold for acohol richness control. function of engine speed and engine air load" MAP 0xa0024434 _REC_A1MAP_20_u2_u2_u2 25000. _CNV_A_R_LINEAR_____52_CM 0. 25000. FORMAT "%5.0"
 /begin AXIS_DESCR COM_AXIS Vxx_n _CNV_A_R_ENSD_LINEA_24_CM 20 0. 16383.75 FORMAT "%8.2" AXIS_PTS_REF Ctb_n /end AXIS_DESCR
 /begin AXIS_DESCR COM_AXIS Vxx_eal _CNV_A_R_LINEAR_____53_CM 16 0. 3.99993896484375 FORMAT "%10.8" AXIS_PTS_REF Ctb_eal /end AXIS_DESCR
/end CHARACTERISTIC
/begin MEASUREMENT Vxx_lbup_v_thd_alco "Threshold of transition rich / poor for alcohol fuel" UWORD _CNV_A_R_LINEAR_____52_CM 1 0. 0. 25000. ECU_ADDRESS 0xd00036dc FORMAT "%5.0" /end MEASUREMENT
/begin CHARACTERISTIC Cmp_n_eal_lbup_v_thd "Map of upstream lambda tension threshold for richness control. function of engine speed and engine air load" MAP 0xa002b220 _REC_A1MAP_20_u2_u2_u2 25000. _CNV_A_R_LINEAR_____52_CM 0. 25000. FORMAT "%5.0"
 /begin AXIS_DESCR COM_AXIS Vxx_n _CNV_A_R_ENSD_LINEA_24_CM 20 0. 16383.75 FORMAT "%8.2" AXIS_PTS_REF Ctb_n /end AXIS_DESCR
 /begin AXIS_DESCR COM_AXIS Vxx_eal _CNV_A_R_LINEAR_____53_CM 16 0. 3.99993896484375 FORMAT "%10.8" AXIS_PTS_REF Ctb_eal /end AXIS_DESCR
/end CHARACTERISTIC
/begin MEASUREMENT Vbx_diag_lbup_down_stt "Low state confirmed by the upstream sensor for the diagnosis OBD of sensor" UBYTE _CNV_S_2_RANGE______3_CM 1 0. 0. 1. ECU_ADDRESS 0xd00049d9 BIT_MASK 0x1 /end MEASUREMENT
/begin MEASUREMENT Vbx_diag_lbup_up_stt "High state confirmed by the upstream sensor for the diagnosis OBD of sensor" UBYTE _CNV_S_2_RANGE______3_CM 1 0. 0. 1. ECU_ADDRESS 0xd00049da BIT_MASK 0x1 /end MEASUREMENT
/begin MEASUREMENT Vbx_lbup_down_stt "Low state confirmed by the sensor" UBYTE _CNV_S_2_RANGE______3_CM 1 0. 0. 1. ECU_ADDRESS 0xd00049db BIT_MASK 0x1 /end MEASUREMENT
/begin MEASUREMENT Vbx_lbup_efv_stt "Real state of the sensor with regard to lambda" UBYTE _CNV_S_2_RANGE______3_CM 1 0. 0. 1. ECU_ADDRESS 0xd00049dc BIT_MASK 0x1 /end MEASUREMENT
/begin MEASUREMENT Vbx_lbup_fail_trs "Glitch discovered for pc" UBYTE _CNV_S_2_RANGE______3_CM 1 0. 0. 1. ECU_ADDRESS 0xd00049dd BIT_MASK 0x1 /end MEASUREMENT
/begin MEASUREMENT Vbx_lbup_igk_off_on "Ignition off on key signal for lbup" UBYTE _CNV_S_2_RANGE______3_CM 1 0. 0. 1. ECU_ADDRESS 0xd00049de BIT_MASK 0x1 /end MEASUREMENT
/begin MEASUREMENT Vbx_lbup_lean_rich_trs "Rich / poor transition" UBYTE _CNV_S_2_RANGE______3_CM 1 0. 0. 1. ECU_ADDRESS 0xd00049df BIT_MASK 0x1 /end MEASUREMENT
/begin MEASUREMENT Vbx_lbup_stt "The current rich or poor state of the upstream sensor" UBYTE _CNV_S_2_RANGE______3_CM 1 0. 0. 1. ECU_ADDRESS 0xd00049e0 BIT_MASK 0x1 /end MEASUREMENT
/begin MEASUREMENT Vbx_lbup_sw_stt "Software state (delayed or no lead) the upstream sensor with regard to lambda" UBYTE _CNV_S_2_RANGE______3_CM 1 0. 0. 1. ECU_ADDRESS 0xd00049e1 BIT_MASK 0x1 /end MEASUREMENT
/begin MEASUREMENT Vbx_lbup_trs "Transition sensor" UBYTE _CNV_S_2_RANGE______3_CM 1 0. 0. 1. ECU_ADDRESS 0xd00049e2 BIT_MASK 0x1 /end MEASUREMENT
/begin MEASUREMENT Vbx_lbup_up_stt "High state confirmed by the probe" UBYTE _CNV_S_2_RANGE______3_CM 1 0. 0. 1. ECU_ADDRESS 0xd00049e3 BIT_MASK 0x1 /end MEASUREMENT
/begin MEASUREMENT Vbx_obd_lbup_fail_trs "Glitch discovered for OBD" UBYTE _CNV_S_2_RANGE______3_CM 1 0. 0. 1. ECU_ADDRESS 0xd00049e4 BIT_MASK 0x1 /end MEASUREMENT
/begin MEASUREMENT Vxx_lbup_trs_dly "Temporization of delay in the transition of the upstream sensor" UBYTE _CNV_A_R_LINEAR_____34_CM 1 0. 0. 2.55 ECU_ADDRESS 0xd00049e5 FORMAT "%4.2" /end MEASUREMENT
/begin CHARACTERISTIC Cbx_lbup_sw_dly_req "With or without software delay" VALUE 0xa0021b2e _REC_S1VAL_20_u1 1. _CNV_A_R_ECME_LINEA_0_CM 0. 1. FORMAT "%1.0" BIT_MASK 0x1 /end CHARACTERISTIC
/begin CHARACTERISTIC Cxx_cp_trs_h_thd "High threshold between 2 transitions poor / rich to validate a period for the bleeding to canister" VALUE 0xa0021b1e _REC_S1VAL_20_u2 25000. _CNV_A_R_LINEAR_____52_CM 0. 25000. FORMAT "%5.0" /end CHARACTERISTIC
/begin CHARACTERISTIC Cxx_cp_trs_l_thd "Low threshold between 2 transitions poor / rich to validate a period for the bleeding to canister" VALUE 0xa0021b20 _REC_S1VAL_20_u2 25000. _CNV_A_R_LINEAR_____52_CM 0. 25000. FORMAT "%5.0" /end CHARACTERISTIC
/begin CHARACTERISTIC Cxx_diag_trs_h_thd "High threshold between 2 transitions poor / rich to validate a period for the diagnosis sensor" VALUE 0xa0021b22 _REC_S1VAL_20_u2 25000. _CNV_A_R_LINEAR_____52_CM 0. 25000. FORMAT "%5.0" /end CHARACTERISTIC
/begin CHARACTERISTIC Cxx_diag_trs_l_thd "Low threshold between 2 transitions poor / rich to validate a period for the diagnosis sensor" VALUE 0xa0021b24 _REC_S1VAL_20_u2 25000. _CNV_A_R_LINEAR_____52_CM 0. 25000. FORMAT "%5.0" /end CHARACTERISTIC
/begin CHARACTERISTIC Cxx_lbup_v_eal_dft "Replacement value in case of defect of the pressure sensor" VALUE 0xa0021b26 _REC_S1VAL_20_u2 25000. _CNV_A_R_LINEAR_____52_CM 0. 25000. FORMAT "%5.0" /end CHARACTERISTIC
/begin CHARACTERISTIC Cxx_lbup_v_max_thd "Maximum tension threshold for upstream sensor overwhich richness control is not accurate." VALUE 0xa0021b28 _REC_S1VAL_20_u2 25000. _CNV_A_R_LINEAR_____52_CM 0. 25000. FORMAT "%5.0" /end CHARACTERISTIC
/begin CHARACTERISTIC Cxx_lbup_v_min_thd "Minimu tension threshold for upstream sensor underwhich richness control is not accurate." VALUE 0xa0021b2a _REC_S1VAL_20_u2 25000. _CNV_A_R_LINEAR_____52_CM 0. 25000. FORMAT "%5.0" /end CHARACTERISTIC
/begin CHARACTERISTIC Cxx_lean_rich_trs_dly "Duration of the delay in the rich / poor transition in mode bench diagnosis sensor" VALUE 0xa0021b2f _REC_S1VAL_20_u1 2.55 _CNV_A_R_LINEAR_____34_CM 0. 2.55 FORMAT "%4.2" /end CHARACTERISTIC
/begin CHARACTERISTIC Cxx_rich_lean_trs_dly "Duration of the delay in the poor / rich transition in mode bench diagnosis sensor" VALUE 0xa0021b30 _REC_S1VAL_20_u1 2.55 _CNV_A_R_LINEAR_____34_CM 0. 2.55 FORMAT "%4.2" /end CHARACTERISTIC
/begin CHARACTERISTIC Cxx_trs_thd "Threshold of transition rich / poor" VALUE 0xa0021b2c _REC_S1VAL_20_u2 25000. _CNV_A_R_LINEAR_____52_CM 0. 25000. FORMAT "%5.0" /end CHARACTERISTIC
/begin MEASUREMENT Vxx_sens_lbdw_v "" UWORD _CNV_A_R_LINEAR_____52_CM 1 0. 0. 25000. ECU_ADDRESS 0xd0002f18 FORMAT "%5.0" /end MEASUREMENT
/begin MEASUREMENT vls_down[0] "Downstream sensor voltage measured." UWORD _CNV_A_R_LINEAR_____269_CM 1 0. 0. 4.9951171875 ECU_ADDRESS 0xd0002f1a FORMAT "%5.3" /end MEASUREMENT
/begin MEASUREMENT Vxx_lim_driv_tqe_sp "Effective engine torque setpoint requested by real (pedal) and virtual (ACC/CC/SL) drivers" UWORD _CNV_A_R_LINEAR_____161_CM 1 0. -400. 1647.96875 ECU_ADDRESS 0xd0002d4c FORMAT "%10.5" /end MEASUREMENT
/begin MEASUREMENT Vxx_lim_driv_tqe_tgt "Effective engine torque target requested by real (pedal) and virtual (ACC/CC/SL) drivers" UWORD _CNV_A_R_LINEAR_____161_CM 1 0. -400. 1647.96875 ECU_ADDRESS 0xd0002d4e FORMAT "%10.5" /end MEASUREMENT
/begin MEASUREMENT Vbx_tq_trs_ctl_mux "Transient intersystem torque request in progress" UBYTE _CNV_S_2_RANGE______3_CM 1 0. 0. 1. ECU_ADDRESS 0xd0004750 BIT_MASK 0x1 /end MEASUREMENT
/begin MEASUREMENT Vxx_arb_no_agb_tqe "torque request wihout agb request" UWORD _CNV_A_R_LINEAR_____161_CM 1 0. -400. 1647.96875 ECU_ADDRESS 0xd0002ca6 FORMAT "%10.5" /end MEASUREMENT
/begin MEASUREMENT Vxx_arb_tqe_raw "Slow torque withour AT request and without anti-jerk." UWORD _CNV_A_R_LINEAR_____161_CM 1 0. -400. 1647.96875 ECU_ADDRESS 0xd0002ca8 FORMAT "%10.5" /end MEASUREMENT
/begin MEASUREMENT Vxx_arb_tqe_sp "Torque Setpoint before AJS Correction action" UWORD _CNV_A_R_LINEAR_____161_CM 1 0. -400. 1647.96875 ECU_ADDRESS 0xd0002caa FORMAT "%10.5" /end MEASUREMENT
/begin MEASUREMENT Vxx_arb_tqe_tgt "Torque Target before AJS Correction action" UWORD _CNV_A_R_LINEAR_____161_CM 1 0. -400. 1647.96875 ECU_ADDRESS 0xd0002cac FORMAT "%10.5" /end MEASUREMENT
/begin MEASUREMENT Vxx_raw_arb_no_agb_tqe "target torque request wihout agb request" UWORD _CNV_A_R_LINEAR_____161_CM 1 0. -400. 1647.96875 ECU_ADDRESS 0xd0002cae FORMAT "%10.5" /end MEASUREMENT
/begin MEASUREMENT Vxx_gbx_max_tqe_sp "Gearbox setpoint request which will be sent to torque arbitration in max bloc." UWORD _CNV_A_R_LINEAR_____161_CM 1 0. -400. 1647.96875 ECU_ADDRESS 0xd0002cb0 FORMAT "%11.5" /end MEASUREMENT
/begin MEASUREMENT Vxx_gbx_max_tqe_tgt "Gearbox slow request which will be sent to torque arbitration in max bloc." UWORD _CNV_A_R_LINEAR_____161_CM 1 0. -400. 1647.96875 ECU_ADDRESS 0xd0002cb2 FORMAT "%11.5" /end MEASUREMENT
/begin MEASUREMENT Vxx_gbx_min_tqe_sp "Gearbox setpoint request which will be sent to torque arbitration in min bloc." UWORD _CNV_A_R_LINEAR_____161_CM 1 0. -400. 1647.96875 ECU_ADDRESS 0xd0002cb4 FORMAT "%11.5" /end MEASUREMENT
/begin MEASUREMENT Vxx_gbx_min_tqe_tgt "Gearbox slow request which will be sent to torque arbitration in min bloc." UWORD _CNV_A_R_LINEAR_____161_CM 1 0. -400. 1647.96875 ECU_ADDRESS 0xd0002cb6 FORMAT "%11.5" /end MEASUREMENT
/begin AXIS_PTS Ctb_tco_cut "Engine coolant temperature breakpoints for injection cut" 0xa002e050 Vxx_tco _REC_A2AXS_20_u2 240. _CNV_A_R_LINEAR_____54_CM 9 -40. 200. FORMAT "%5.1" /end AXIS_PTS
/begin CHARACTERISTIC Ctp_tco_cut_decl_off_dly "delay table in function of coolant temperature" CURVE 0xa002e064 _REC_A1CUR_20_u2_u2 655.35 _CNV_A_R_LINEAR_____34_CM 0. 655.35 FORMAT "%6.2"
 /begin AXIS_DESCR COM_AXIS Vxx_tco _CNV_A_R_LINEAR_____54_CM 9 -40. 200. FORMAT "%5.1" AXIS_PTS_REF Ctb_tco_cut /end AXIS_DESCR
/end CHARACTERISTIC
/begin MEASUREMENT Vbx_ant_gear_coup_cut_ct_1 "First gear ratio is detected" UBYTE _CNV_S_2_RANGE______3_CM 1 0. 0. 1. ECU_ADDRESS 0xd0003db7 BIT_MASK 0x1 /end MEASUREMENT
/begin MEASUREMENT Vbx_cut_cdn "Flag of injection cut condition" UBYTE _CNV_S_2_RANGE______3_CM 1 0. 0. 1. ECU_ADDRESS 0xd0003db8 BIT_MASK 0x1 /end MEASUREMENT
/begin MEASUREMENT Vbx_swi_drv_n "Detection of the high engine derivate condition" UBYTE _CNV_S_2_RANGE______3_CM 1 0. 0. 1. ECU_ADDRESS 0xd0003db9 BIT_MASK 0x1 /end MEASUREMENT
/begin MEASUREMENT Vxx_ena_cut_n_ofs "enable cut engine offset" UWORD _CNV_A_R_ENSD_LINEA_24_CM 1 0. 0. 16383.75 ECU_ADDRESS 0xd0003204 FORMAT "%8.2" /end MEASUREMENT
/begin MEASUREMENT Vxx_swi_cut_n_ofs "switch of injection cut engine speed offset" UWORD _CNV_A_R_ENSD_LINEA_24_CM 1 0. 0. 16383.75 ECU_ADDRESS 0xd0003206 FORMAT "%8.2" /end MEASUREMENT
/begin MEASUREMENT Vxx_swi_drv_cut_n_ofs "switch of derivate injection cut offset" UWORD _CNV_A_R_ENSD_LINEA_24_CM 1 0. 0. 16383.75 ECU_ADDRESS 0xd0003208 FORMAT "%8.2" /end MEASUREMENT
/begin MEASUREMENT Vxx_tq_fuel_typ_rat_cs "Ratio dedicated to the torque management adjustment with the validity status consolidation" UWORD _CNV_A_R_LINEAR_____108_CM 1 0. 0. 1. ECU_ADDRESS 0xd000320a FORMAT "%5.3" /end MEASUREMENT
/begin MEASUREMENT Vxx_tq_fuel_typ_rat_cs_1 "1 - flex-fuel ratio dedicated to the torque management adjustment with the validity status consolidation" UWORD _CNV_A_R_LINEAR_____108_CM 1 0. 0. 1. ECU_ADDRESS 0xd000320c FORMAT "%5.3" /end MEASUREMENT
/begin CHARACTERISTIC Cbx_ant_gear_coup_cut_ct_ena "Consolidation of the gearbox ratio with the coupler state in egb configuration" VALUE 0xa0020cb8 _REC_S1VAL_20_u1 1. _CNV_A_R_ECME_LINEA_0_CM 0. 1. FORMAT "%1.0" BIT_MASK 0x1 /end CHARACTERISTIC
/begin CHARACTERISTIC Cxx_aut_swi1_is_ofs "engine offset after cut, threshold is added of idle speed set point, if the first gear ratio is detected" VALUE 0xa0020c86 _REC_S1VAL_20_u2 16383.75 _CNV_A_R_ENSD_LINEA_24_CM 0. 16383.75 FORMAT "%8.2" /end CHARACTERISTIC
/begin CHARACTERISTIC Cxx_aut_swi1_is_ofs_alco "engine offset after cut, threshold is added of idle speed set point, if the first gear ratio is detected for flex-fuel" VALUE 0xa0020c88 _REC_S1VAL_20_u2 16383.75 _CNV_A_R_ENSD_LINEA_24_CM 0. 16383.75 FORMAT "%8.2" /end CHARACTERISTIC
/begin CHARACTERISTIC Cxx_aut_swi_is_ofs "engine offset after cut, threshold is added of idle speed set point, if gear ratio is different of first ratio" VALUE 0xa0020c8a _REC_S1VAL_20_u2 16383.75 _CNV_A_R_ENSD_LINEA_24_CM 0. 16383.75 FORMAT "%8.2" /end CHARACTERISTIC
/begin CHARACTERISTIC Cxx_aut_swi_is_ofs_alco "engine offset after cut, threshold is added of idle speed set point, if gear ratio is different of first ratio for flex-fuel" VALUE 0xa0020c8c _REC_S1VAL_20_u2 16383.75 _CNV_A_R_ENSD_LINEA_24_CM 0. 16383.75 FORMAT "%8.2" /end CHARACTERISTIC
/begin CHARACTERISTIC Cxx_cut_decl_tco_thd "injection cut deceleration coolant temperature threshold" VALUE 0xa0020c8e _REC_S1VAL_20_u2 240. _CNV_A_R_LINEAR_____54_CM -40. 200. FORMAT "%5.1" /end CHARACTERISTIC
/begin CHARACTERISTIC Cxx_cut_decl_tco_thd_alco "injection cut deceleration coolant temperature threshold for flex-fuel" VALUE 0xa0020c90 _REC_S1VAL_20_u2 240. _CNV_A_R_LINEAR_____54_CM -40. 200. FORMAT "%5.1" /end CHARACTERISTIC
/begin CHARACTERISTIC Cxx_cut_decl_tqi_thd "Torque threshold during the transient intersystem torque request , comparaison with the final indicated torque set point" VALUE 0xa0020c92 _REC_S1VAL_20_u2 2047.96875 _CNV_A_R_LINEAR_____123_CM 0. 2047.96875 FORMAT "%10.5" /end CHARACTERISTIC
/begin CHARACTERISTIC Cxx_cut_n_ofs "injection cut engine offset" VALUE 0xa0020c94 _REC_S1VAL_20_u2 16383.75 _CNV_A_R_ENSD_LINEA_24_CM 0. 16383.75 FORMAT "%8.2" /end CHARACTERISTIC
/begin CHARACTERISTIC Cxx_cut_n_ofs2 "injection cut engine offset, if a powertrain torque setpoint is requested" VALUE 0xa0020c96 _REC_S1VAL_20_u2 16383.75 _CNV_A_R_ENSD_LINEA_24_CM 0. 16383.75 FORMAT "%8.2" /end CHARACTERISTIC
/begin CHARACTERISTIC Cxx_cut_n_ofs2_alco "injection cut engine offset, if a powertrain torque setpoint is requested for flex-fuel" VALUE 0xa0020c98 _REC_S1VAL_20_u2 16383.75 _CNV_A_R_ENSD_LINEA_24_CM 0. 16383.75 FORMAT "%8.2" /end CHARACTERISTIC
/begin CHARACTERISTIC Cxx_cut_n_ofs_alco "injection cut engine offset for flex-fuel" VALUE 0xa0020c9a _REC_S1VAL_20_u2 16383.75 _CNV_A_R_ENSD_LINEA_24_CM 0. 16383.75 FORMAT "%8.2" /end CHARACTERISTIC
/begin CHARACTERISTIC Cxx_decl_cut_n_ac_ofs "Deceleration injection cut engine offset if air conditioning compressor is clutched" VALUE 0xa0020c9c _REC_S1VAL_20_u2 16383.75 _CNV_A_R_ENSD_LINEA_24_CM 0. 16383.75 FORMAT "%8.2" /end CHARACTERISTIC
/begin CHARACTERISTIC Cxx_decl_cut_n_ac_ofs_alco "Deceleration injection cut engine offset if air conditioning compressor is clutched for flex-fuel." VALUE 0xa0020c9e _REC_S1VAL_20_u2 16383.75 _CNV_A_R_ENSD_LINEA_24_CM 0. 16383.75 FORMAT "%8.2" /end CHARACTERISTIC
/begin CHARACTERISTIC Cxx_decl_cut_n_ofs "deceleration injection cut engine offset" VALUE 0xa0020ca0 _REC_S1VAL_20_u2 16383.75 _CNV_A_R_ENSD_LINEA_24_CM 0. 16383.75 FORMAT "%8.2" /end CHARACTERISTIC
/begin CHARACTERISTIC Cxx_decl_cut_n_ofs_alco "deceleration injection cut engine offset for flex-fuel" VALUE 0xa0020ca2 _REC_S1VAL_20_u2 16383.75 _CNV_A_R_ENSD_LINEA_24_CM 0. 16383.75 FORMAT "%8.2" /end CHARACTERISTIC
/begin CHARACTERISTIC Cxx_kd_decl_cut_n_ac_alco "Deceleration injection cut engine offset, if a powertrain torque setpoint is requested and the AC is clutched for flex-fuel" VALUE 0xa0020ca4 _REC_S1VAL_20_u2 16383.75 _CNV_A_R_ENSD_LINEA_24_CM 0. 16383.75 FORMAT "%8.2" /end CHARACTERISTIC
/begin CHARACTERISTIC Cxx_kd_decl_cut_n_ac_ofs "Deceleration injection cut engine offset, if a powertrain torque setpoint is requested and the air conditioning compressor is clutched." VALUE 0xa0020ca6 _REC_S1VAL_20_u2 16383.75 _CNV_A_R_ENSD_LINEA_24_CM 0. 16383.75 FORMAT "%8.2" /end CHARACTERISTIC
/begin CHARACTERISTIC Cxx_kd_decl_cut_n_ofs "deceleration injection cut engine offset, if a powertrain torque setpoint is requested" VALUE 0xa0020ca8 _REC_S1VAL_20_u2 16383.75 _CNV_A_R_ENSD_LINEA_24_CM 0. 16383.75 FORMAT "%8.2" /end CHARACTERISTIC
/begin CHARACTERISTIC Cxx_kd_decl_cut_n_ofs_alco "deceleration injection cut engine offset, if a powertrain torque setpoint is requested for flex-fuel" VALUE 0xa0020caa _REC_S1VAL_20_u2 16383.75 _CNV_A_R_ENSD_LINEA_24_CM 0. 16383.75 FORMAT "%8.2" /end CHARACTERISTIC
/begin CHARACTERISTIC Cxx_swi_drv_is_ofs "engine offset after cut when engine derivate is low" VALUE 0xa0020cac _REC_S1VAL_20_u2 16383.75 _CNV_A_R_ENSD_LINEA_24_CM 0. 16383.75 FORMAT "%8.2" /end CHARACTERISTIC
/begin CHARACTERISTIC Cxx_swi_drv_is_ofs_alco "engine offset after cut when engine derivate is low for flex-fuel" VALUE 0xa0020cae _REC_S1VAL_20_u2 16383.75 _CNV_A_R_ENSD_LINEA_24_CM 0. 16383.75 FORMAT "%8.2" /end CHARACTERISTIC
/begin CHARACTERISTIC Cxx_swi_drv_n_thd "switch derivate engine threshold" VALUE 0xa0020cb0 _REC_S1VAL_20_s2 16383. _CNV_A_R_LINEAR_____23_CM -8192. 8191. FORMAT "%5.0" /end CHARACTERISTIC
/begin CHARACTERISTIC Cxx_swi_drv_n_thd_alco "switch derivate engine threshold for flex-fuel" VALUE 0xa0020cb2 _REC_S1VAL_20_s2 16383. _CNV_A_R_LINEAR_____23_CM -8192. 8191. FORMAT "%5.0" /end CHARACTERISTIC
/begin CHARACTERISTIC Cxx_tq_fuel_typ_rat_cut_dft "Flex-fuel ratio if the final alcohol adaptive is failling for engine condition" VALUE 0xa0020cb4 _REC_S1VAL_20_u2 1. _CNV_A_R_LINEAR_____108_CM 0. 1. FORMAT "%5.3" /end CHARACTERISTIC
/begin CHARACTERISTIC Cxx_wet_fuel_typ_rat_cut_dft "Flex-fuel ratio if the final alcohol adaptive is failing for coolant temperature condition" VALUE 0xa0020cb6 _REC_S1VAL_20_u2 1. _CNV_A_R_LINEAR_____108_CM 0. 1. FORMAT "%5.3" /end CHARACTERISTIC
/begin CHARACTERISTIC Ctp_cut_decl_dly "Delay table between the injection cut condition and the injection cut request in fonction of the gearbox" CURVE 0xa0023a8c _REC_A1CUR_20_u2_u1 655.35 _CNV_A_R_LINEAR_____34_CM 0. 655.35 FORMAT "%6.2"
 /begin AXIS_DESCR COM_AXIS Vxx_gear _CNV_A_R_LINEAR_____113_CM 8 -1. 6. READ_ONLY FORMAT "%2.0" AXIS_PTS_REF Ntb_gear /end AXIS_DESCR
/end CHARACTERISTIC
/begin MEASUREMENT Vbx_cut_ct "Detected if the injection cut request is coming of powertrain torque setpoint" UBYTE _CNV_S_2_RANGE______3_CM 1 0. 0. 1. ECU_ADDRESS 0xd00047da BIT_MASK 0x1 /end MEASUREMENT
/begin MEASUREMENT Vbx_cut_dly_off_trs_3 "transition 3" UBYTE _CNV_S_2_RANGE______3_CM 1 0. 0. 1. ECU_ADDRESS 0xd00047db BIT_MASK 0x1 /end MEASUREMENT
/begin MEASUREMENT Vbx_cut_dly_on_trs_2 "transition 2" UBYTE _CNV_S_2_RANGE______3_CM 1 0. 0. 1. ECU_ADDRESS 0xd00047dc BIT_MASK 0x1 /end MEASUREMENT
/begin MEASUREMENT Vbx_cut_off_dly_trs_1 "transition 1" UBYTE _CNV_S_2_RANGE______3_CM 1 0. 0. 1. ECU_ADDRESS 0xd00047dd BIT_MASK 0x1 /end MEASUREMENT
/begin MEASUREMENT Vbx_swi_drv_cut "Detection of automatic switch on the high engine derivate condition" UBYTE _CNV_S_2_RANGE______3_CM 1 0. 0. 1. ECU_ADDRESS 0xd00047de BIT_MASK 0x1 /end MEASUREMENT
/begin MEASUREMENT Vbx_swi_drv_cut_n "Detection that the engine speed is smaller that the engine speed threshold if engine derivative is high" UBYTE _CNV_S_2_RANGE______3_CM 1 0. 0. 1. ECU_ADDRESS 0xd00047df BIT_MASK 0x1 /end MEASUREMENT
/begin MEASUREMENT Vsx_driv_cut_req "injection cut requested by driver" UBYTE _CNV_A_R_ECME_LINEA_0_CM 1 0. 0. 255. ECU_ADDRESS 0xd00047e0 FORMAT "%3.0" /end MEASUREMENT
/begin CHARACTERISTIC Cxx_cut_decl_dly_tq_rat "delay before injection cut during a gear ratio change" VALUE 0xa0021946 _REC_S1VAL_20_u2 655.35 _CNV_A_R_LINEAR_____34_CM 0. 655.35 FORMAT "%6.2" /end CHARACTERISTIC
/begin AXIS_PTS Ctb_rmb_ctr "Rumble counter Breakpoint for anti-rumble strategy" 0xa002e078 Vxx_rmb_ctr _REC_A2AXS_20_u2 100. _CNV_A_R_LINEAR_____270_CM 6 0. 100. FORMAT "%8.4" /end AXIS_PTS
/begin AXIS_PTS Ctb_rmb_fil_iga_efy "Filtered final efficiency Breakpoint for anti-rumble strategy" 0xa002e088 Vxx_rmb_fil_iga_efy _REC_A2AXS_20_u2 1. _CNV_A_R_LINEAR_____125_CM 6 0. 1. FORMAT "%11.9" /end AXIS_PTS
/begin AXIS_PTS Ctb_rmb_mat "Manifold air temp. Breakpoint for anti-rumble strategy" 0xa002e098 Vxx_mat _REC_A2AXS_20_u2 240. _CNV_A_R_LINEAR_____54_CM 6 -40. 200. FORMAT "%5.1" /end AXIS_PTS
/begin AXIS_PTS Ctb_rmb_n_mv "Engine speed Breakpoint for anti-rumble strategy" 0xa002e0a8 Vxx_n_mv _REC_A2AXS_20_u2 16383.75 _CNV_A_R_ENSD_LINEA_24_CM 6 0. 16383.75 FORMAT "%8.2" /end AXIS_PTS
/begin AXIS_PTS Ctb_rmb_tco "Coolant temp. Breakpoint for anti-rumble strategy" 0xa002e0b8 Vxx_tco _REC_A2AXS_20_u2 240. _CNV_A_R_LINEAR_____54_CM 6 -40. 200. FORMAT "%5.1" /end AXIS_PTS
/begin CHARACTERISTIC Ctp_rmb_ctr_tq_cor "Rumble relative torque correction dependant on rumble counter" CURVE 0xa002e0c8 _REC_A1CUR_20_u2_u2 30. _CNV_A_R_LINEAR_____125_CM 0. 30. FORMAT "%7.4"
 /begin AXIS_DESCR COM_AXIS Vxx_rmb_ctr _CNV_A_R_LINEAR_____270_CM 6 0. 100. FORMAT "%8.4" AXIS_PTS_REF Ctb_rmb_ctr /end AXIS_DESCR
/end CHARACTERISTIC
/begin CHARACTERISTIC Ctp_rmb_iga_efy_inc_prop_fac "Ignition efficiency dependant correction for rumble strategy prop. factor" CURVE 0xa00213a6 _REC_A1CUR_20_u1_u2 1.992187 _CNV_A_R_LINEAR_____271_CM 0. 1.992187 FORMAT "%6.4"
 /begin AXIS_DESCR COM_AXIS Vxx_rmb_fil_iga_efy _CNV_A_R_LINEAR_____125_CM 6 0. 1. FORMAT "%11.9" AXIS_PTS_REF Ctb_rmb_fil_iga_efy /end AXIS_DESCR
/end CHARACTERISTIC
/begin CHARACTERISTIC Ctp_rmb_mat_inc_prop_fac "Manifold air dependant correction for rumble strategy prop. factor" CURVE 0xa00213ac _REC_A1CUR_20_u1_u2 1.992187 _CNV_A_R_LINEAR_____271_CM 0. 1.992187 FORMAT "%6.4"
 /begin AXIS_DESCR COM_AXIS Vxx_mat _CNV_A_R_LINEAR_____54_CM 6 -40. 200. FORMAT "%5.1" AXIS_PTS_REF Ctb_rmb_mat /end AXIS_DESCR
/end CHARACTERISTIC
/begin CHARACTERISTIC Ctp_rmb_n_mv_eal_lim "EAL threshold defining Rumble critical zone - dependant on filtered engine speed" CURVE 0xa002e0d4 _REC_A1CUR_20_u2_u2 3.99993896484375 _CNV_A_R_LINEAR_____53_CM 0. 3.99993896484375 FORMAT "%7.5"
 /begin AXIS_DESCR COM_AXIS Vxx_n_mv _CNV_A_R_ENSD_LINEA_24_CM 6 0. 16383.75 FORMAT "%8.2" AXIS_PTS_REF Ctb_rmb_n_mv /end AXIS_DESCR
/end CHARACTERISTIC
/begin CHARACTERISTIC Ctp_rmb_n_tq_cor_max "Maximum rumble relative torque correction dependant on engine speed" CURVE 0xa002e0e0 _REC_A1CUR_20_u2_u2 1. _CNV_A_R_LINEAR_____125_CM 0. 1. FORMAT "%11.9"
 /begin AXIS_DESCR COM_AXIS Vxx_n_mv _CNV_A_R_ENSD_LINEA_24_CM 6 0. 16383.75 FORMAT "%8.2" AXIS_PTS_REF Ctb_rmb_n_mv /end AXIS_DESCR
/end CHARACTERISTIC
/begin CHARACTERISTIC Ctp_rmb_tco_inc_prop_fac "Coolant temp. dependant correction for rumble strategy prop. factor" CURVE 0xa00213b2 _REC_A1CUR_20_u1_u2 1.992187 _CNV_A_R_LINEAR_____271_CM 0. 1.992187 FORMAT "%6.4"
 /begin AXIS_DESCR COM_AXIS Vxx_tco _CNV_A_R_LINEAR_____54_CM 6 -40. 200. FORMAT "%5.1" AXIS_PTS_REF Ctb_rmb_tco /end AXIS_DESCR
/end CHARACTERISTIC
/begin MEASUREMENT Vxx_rmb_ctr "Rumble counter defining torque correction" UWORD _CNV_A_R_LINEAR_____270_CM 1 0. 0. 100. ECU_ADDRESS 0xd000344e FORMAT "%8.4" /end MEASUREMENT
/begin MEASUREMENT Vxx_rmb_ctr_dif "Rumble counter increment (or decrement)" UWORD _CNV_A_R_LINEAR_____272_CM 1 0. -50. 50. ECU_ADDRESS 0xd0003450 FORMAT "%8.4" /end MEASUREMENT
/begin MEASUREMENT Vxx_rmb_eal_rel "Relative difference between slow torque demand and rumble zone torque threshold" UWORD _CNV_A_R_LINEAR_____273_CM 1 0. -8. 8. ECU_ADDRESS 0xd0003452 FORMAT "%8.5" /end MEASUREMENT
/begin MEASUREMENT Vxx_rmb_fil_eal "Filtered engine air load for anti-rumble strategy" UWORD _CNV_A_R_LINEAR_____53_CM 1 0. 0. 3.99993896484375 ECU_ADDRESS 0xd0003454 FORMAT "%7.5" /end MEASUREMENT
/begin MEASUREMENT Vxx_rmb_fil_iga_efy "Filtered final efficiency calculated by torque structure for anti-rumble strategy" UWORD _CNV_A_R_LINEAR_____125_CM 1 0. 0. 1. ECU_ADDRESS 0xd0003456 FORMAT "%11.9" /end MEASUREMENT
/begin MEASUREMENT Vxx_rmb_rel_tq_appl_cor "The applied relative torque correction for the load in rumble zone" UWORD _CNV_A_R_LINEAR_____125_CM 1 0. 0. 1. ECU_ADDRESS 0xd0003458 FORMAT "%11.9" /end MEASUREMENT
/begin CHARACTERISTIC Cxx_rmb_dec_prop "Proportionnal factor to decrease rumble counter" VALUE 0xa00213b8 _REC_S1VAL_20_u2 32. _CNV_A_R_LINEAR_____125_CM 0. 32. FORMAT "%8.6" /end CHARACTERISTIC
/begin CHARACTERISTIC Cxx_rmb_eal_ftc "EAL filtering factor for anti-rumble strategy" VALUE 0xa00213bc _REC_S1VAL_20_u1 25.5 _CNV_A_R_LINEAR_____4_CM 0. 25.5 FORMAT "%4.1" /end CHARACTERISTIC
/begin CHARACTERISTIC Cxx_rmb_iga_efy_ftc "Filtering factor of ignition efficiency for rumble strategy" VALUE 0xa00213bd _REC_S1VAL_20_u1 25.5 _CNV_A_R_LINEAR_____4_CM 0. 25.5 FORMAT "%4.1" /end CHARACTERISTIC
/begin CHARACTERISTIC Cxx_rmb_inc_prop "Proportionnal factor to increase rumble counter" VALUE 0xa00213ba _REC_S1VAL_20_u2 32. _CNV_A_R_LINEAR_____125_CM 0. 32. FORMAT "%8.6" /end CHARACTERISTIC
/begin MEASUREMENT Vxx_max_dyn_avl_tqi "Maximum indicated torque with dynamic limitation" UWORD _CNV_A_R_LINEAR_____123_CM 1 0. 0. 2047.96875 ECU_ADDRESS 0xd0003398 FORMAT "%10.5" /end MEASUREMENT
/begin MEASUREMENT Vxx_max_stat_avl_tqi_ovn "Maximum absolute indicated torque with soft overspeed correction" UWORD _CNV_A_R_LINEAR_____123_CM 1 0. 0. 2047.96875 ECU_ADDRESS 0xd000339a FORMAT "%10.5" /end MEASUREMENT
/begin MEASUREMENT Vxx_tqi_rat_tgt "Final indicated target torque ratio" UWORD _CNV_A_R_LINEAR_____125_CM 1 0. 0. 1. ECU_ADDRESS 0xd000339c FORMAT "%11.9" /end MEASUREMENT
/begin MEASUREMENT Vxx_tqi_raw "final indicated torque raw" UWORD _CNV_A_R_LINEAR_____123_CM 1 0. 0. 2047.96875 ECU_ADDRESS 0xd000339e FORMAT "%10.5" /end MEASUREMENT
/begin MEASUREMENT Vxx_tqi_sp "Final indicated torque set point" UWORD _CNV_A_R_LINEAR_____123_CM 1 0. 0. 2047.96875 ECU_ADDRESS 0xd00033a0 FORMAT "%10.5" /end MEASUREMENT
/begin MEASUREMENT Vxx_tqi_sp_no_ajs "Final indicated torque set point without AJCOR correction" UWORD _CNV_A_R_LINEAR_____123_CM 1 0. 0. 2047.96875 ECU_ADDRESS 0xd00033a2 FORMAT "%10.5" /end MEASUREMENT
/begin MEASUREMENT Vxx_tqi_tgt "Final indicated target torque" UWORD _CNV_A_R_LINEAR_____123_CM 1 0. 0. 2047.96875 ECU_ADDRESS 0xd00033a4 FORMAT "%10.5" /end MEASUREMENT
/begin CHARACTERISTIC Cbx_ovn_nul_tqi_sp_cfm "Anti over-speed by torque modulation configuration : annulation of tqi_sp" VALUE 0xa002187a _REC_S1VAL_20_u1 1. _CNV_A_R_ECME_LINEA_0_CM 0. 1. FORMAT "%1.0" BIT_MASK 0x1 /end CHARACTERISTIC
/begin CHARACTERISTIC Cbx_tqi_raw_bch_cfm "Raw indicated torque bench mode" VALUE 0xa002187b _REC_S1VAL_20_u1 1. _CNV_S_2_RANGE______3_CM 0. 1. BIT_MASK 0x1 /end CHARACTERISTIC
/begin CHARACTERISTIC Cbx_tqi_sp_bch_cfm "Setpoint indicated torque bench mode" VALUE 0xa002187c _REC_S1VAL_20_u1 1. _CNV_S_2_RANGE______3_CM 0. 1. BIT_MASK 0x1 /end CHARACTERISTIC
/begin CHARACTERISTIC Cbx_tqi_tgt_bch_cfm "Target indicated torque bench mode" VALUE 0xa002187d _REC_S1VAL_20_u1 1. _CNV_S_2_RANGE______3_CM 0. 1. BIT_MASK 0x1 /end CHARACTERISTIC
/begin CHARACTERISTIC Cxx_ajs_cor_lim_tq_ofs "Torque offset added to the maximum dynamic torque autorized for AJCOR" VALUE 0xa0021872 _REC_S1VAL_20_u2 2047.96875 _CNV_A_R_LINEAR_____123_CM 0. 2047.96875 FORMAT "%10.5" /end CHARACTERISTIC
/begin CHARACTERISTIC Cxx_tqi_raw_bch "Raw indicated torque bench value" VALUE 0xa0021874 _REC_S1VAL_20_u2 2047.96875 _CNV_A_R_LINEAR_____123_CM 0. 2047.96875 FORMAT "%10.5" /end CHARACTERISTIC
/begin CHARACTERISTIC Cxx_tqi_sp_bch "Setpoint indicated torque bench value" VALUE 0xa0021876 _REC_S1VAL_20_u2 2047.96875 _CNV_A_R_LINEAR_____123_CM 0. 2047.96875 FORMAT "%10.5" /end CHARACTERISTIC
/begin CHARACTERISTIC Cxx_tqi_tgt_bch "Target indicated torque bench value" VALUE 0xa0021878 _REC_S1VAL_20_u2 2047.96875 _CNV_A_R_LINEAR_____123_CM 0. 2047.96875 FORMAT "%10.5" /end CHARACTERISTIC
/begin CHARACTERISTIC Ctp_n_min_bas_cor_fac "raw torque correction factor" CURVE 0xa002988c _REC_A1CUR_20_u1_u2 0.99609375 _CNV_A_R_LINEAR_____31_CM 0. 0.99609375 FORMAT "%10.8"
 /begin AXIS_DESCR COM_AXIS Vxx_n _CNV_A_R_ENSD_LINEA_24_CM 9 0. 16383.75 FORMAT "%8.2" AXIS_PTS_REF Ctb_n2 /end AXIS_DESCR
/end CHARACTERISTIC
/begin MEASUREMENT Vxx_chk_arb_tqi_raw "Raw indicated torque after check" UWORD _CNV_A_R_LINEAR_____123_CM 1 0. 0. 2047.96875 ECU_ADDRESS 0xd0002f46 FORMAT "%10.5" /end MEASUREMENT
/begin MEASUREMENT Vxx_chk_arb_tqi_sp "Setpoint indicated torque after check" UWORD _CNV_A_R_LINEAR_____123_CM 1 0. 0. 2047.96875 ECU_ADDRESS 0xd0002f48 FORMAT "%10.5" /end MEASUREMENT
/begin MEASUREMENT Vxx_chk_arb_tqi_tgt "Target indicated torque after check" UWORD _CNV_A_R_LINEAR_____123_CM 1 0. 0. 2047.96875 ECU_ADDRESS 0xd0002f4a FORMAT "%10.5" /end MEASUREMENT
/begin MEASUREMENT Vxx_iga_arb_tqi_tgt "Target indicated torque after minimal ignition check" UWORD _CNV_A_R_LINEAR_____123_CM 1 0. 0. 2047.96875 ECU_ADDRESS 0xd0002f4c FORMAT "%10.5" /end MEASUREMENT
/begin MEASUREMENT Vxx_knk_arb_tqi_tgt "Target indicated torque after slow knock correction" UWORD _CNV_A_R_LINEAR_____123_CM 1 0. 0. 2047.96875 ECU_ADDRESS 0xd0002f4e FORMAT "%10.5" /end MEASUREMENT
/begin MEASUREMENT Vxx_min_arb_tqi[0] "Target indicated torque after idle speed correction" UWORD _CNV_A_R_LINEAR_____123_CM 1 0. 0. 2047.96875 ECU_ADDRESS 0xd0002f50 FORMAT "%10.5" /end MEASUREMENT
/begin MEASUREMENT Vxx_min_arb_tqi[1] "Target indicated torque after idle speed correction" UWORD _CNV_A_R_LINEAR_____123_CM 1 0. 0. 2047.96875 ECU_ADDRESS 0xd0002f52 FORMAT "%10.5" /end MEASUREMENT
/begin MEASUREMENT Vxx_raw_min_bas_tq_cor "Raw indicated torque correction for alternator, air conditionning, automatic gearbox, ..." SWORD _CNV_A_R_LINEAR_____123_CM 1 0. -1024. 1023.96875 ECU_ADDRESS 0xd0002f54 FORMAT "%11.5" /end MEASUREMENT
/begin MEASUREMENT Vxx_sta_tq_raw "Raw start torque setpoint" UWORD _CNV_A_R_LINEAR_____123_CM 1 0. 0. 2047.96875 ECU_ADDRESS 0xd0002f56 FORMAT "%10.5" /end MEASUREMENT
/begin MEASUREMENT Vxx_wup_arb_tqi_tgt "Target indicated torque after warm-up correction" UWORD _CNV_A_R_LINEAR_____123_CM 1 0. 0. 2047.96875 ECU_ADDRESS 0xd0002f58 FORMAT "%10.5" /end MEASUREMENT
/begin CHARACTERISTIC Ctp_n_h_thr_tq "Torque threshold above which we have to control the waste-gate" CURVE 0xa002440c _REC_A1CUR_20_u2_u2 2047.96875 _CNV_A_R_LINEAR_____123_CM 0. 2047.96875 FORMAT "%10.5"
 /begin AXIS_DESCR COM_AXIS Vxx_n _CNV_A_R_ENSD_LINEA_24_CM 20 0. 16383.75 FORMAT "%8.2" AXIS_PTS_REF Ctb_n /end AXIS_DESCR
/end CHARACTERISTIC
/begin MEASUREMENT Vbx_fl "Indicates that the full load is requested by the driver" UBYTE _CNV_S_2_RANGE______3_CM 1 0. 0. 1. ECU_ADDRESS 0xd0004630 BIT_MASK 0x1 /end MEASUREMENT
/begin MEASUREMENT Vbx_kd_fl_ena "Indicates that the full load is requested by the driver on a kick down" UBYTE _CNV_S_2_RANGE______3_CM 1 0. 0. 1. ECU_ADDRESS 0xd0004631 BIT_MASK 0x1 /end MEASUREMENT
/begin MEASUREMENT Vbx_spg_fl_ena "Indicates that the full load is requested by the driver in supercharging zone" UBYTE _CNV_S_2_RANGE______3_CM 1 0. 0. 1. ECU_ADDRESS 0xd0004632 BIT_MASK 0x1 /end MEASUREMENT
/begin MEASUREMENT Vbx_ufld_fl_ena "Indicates that the full load is requested by the driver for the unflooding, during the start engine" UBYTE _CNV_S_2_RANGE______3_CM 1 0. 0. 1. ECU_ADDRESS 0xd0004633 BIT_MASK 0x1 /end MEASUREMENT
/begin CHARACTERISTIC Cbx_spg_fl_cfm "Configuration : Full load in supercharging zone =1. Full load on driver kick down only = 0." VALUE 0xa002173e _REC_S1VAL_20_u1 1. _CNV_S_2_RANGE______3_CM 0. 1. BIT_MASK 0x1 /end CHARACTERISTIC
/begin CHARACTERISTIC Cxx_acel_pdl_ufld_it_hys "Accelerator pedal hysteresis for unflooding during the start engine" VALUE 0xa0021732 _REC_S1VAL_20_u2 1.25 _CNV_A_R_LINEAR_____257_CM 0. 1.25 FORMAT "%8.5" /end CHARACTERISTIC
/begin CHARACTERISTIC Cxx_acel_pdl_ufld_it_thd "Accelerator pedal threshold for unflooding during the start engine" VALUE 0xa0021734 _REC_S1VAL_20_u2 1.25 _CNV_A_R_LINEAR_____257_CM 0. 1.25 FORMAT "%8.5" /end CHARACTERISTIC
/begin CHARACTERISTIC Cxx_fl_tq_hys "Torque hysteresis" VALUE 0xa0021736 _REC_S1VAL_20_u2 2047.96875 _CNV_A_R_LINEAR_____123_CM 0. 2047.96875 FORMAT "%10.5" /end CHARACTERISTIC
/begin CHARACTERISTIC Cxx_fl_tq_hys2 "Torque hysteresis for full load" VALUE 0xa0021738 _REC_S1VAL_20_u2 2047.96875 _CNV_A_R_LINEAR_____123_CM 0. 2047.96875 FORMAT "%10.5" /end CHARACTERISTIC
/begin CHARACTERISTIC Cxx_fl_tq_ofs "Torque offset" VALUE 0xa002173a _REC_S1VAL_20_u2 2047.96875 _CNV_A_R_LINEAR_____123_CM 0. 2047.96875 FORMAT "%10.5" /end CHARACTERISTIC
/begin CHARACTERISTIC Cxx_fl_tq_spg_hys "Torque hysteresis for full load (supercharger only)" VALUE 0xa002173c _REC_S1VAL_20_u2 2047.96875 _CNV_A_R_LINEAR_____123_CM 0. 2047.96875 FORMAT "%10.5" /end CHARACTERISTIC
/begin AXIS_PTS Ctb_knk_iga_slow_cor_mv "Breakpoint of mean slow knock correction on four cylinder" 0xa0021388 Vxx_knk_iga_slow_cor_mv _REC_A2AXS_20_u1 95.625 _CNV_A_R_LINEAR_____25_CM 6 0. 95.625 /end AXIS_PTS
/begin CHARACTERISTIC Cmp_knk_rel_tq_cor_max "Maximum correction of the relative torque to decrease the load in knock zone." MAP 0xa002daa4 _REC_A1MAP_20_u2_u2_u1 1. _CNV_A_R_LINEAR_____125_CM 0. 1. FORMAT "%11.9"
 /begin AXIS_DESCR COM_AXIS Vxx_n _CNV_A_R_ENSD_LINEA_24_CM 9 0. 16383.75 FORMAT "%8.2" AXIS_PTS_REF Ctb_n2 /end AXIS_DESCR
 /begin AXIS_DESCR COM_AXIS Vxx_knk_iga_slow_cor_mv _CNV_A_R_LINEAR_____25_CM 6 0. 95.625 AXIS_PTS_REF Ctb_knk_iga_slow_cor_mv /end AXIS_DESCR
/end CHARACTERISTIC
/begin MEASUREMENT Vxx_knk_iga_cor_fil_mv "The filtered mean knock correction on four cylinder" UBYTE _CNV_A_R_LINEAR_____25_CM 1 0. 0. 95.625 ECU_ADDRESS 0xd000537b /end MEASUREMENT
/begin MEASUREMENT Vxx_knk_iga_cor_mv "The mean knock correction on four cylinder" UBYTE _CNV_A_R_LINEAR_____25_CM 1 0. 0. 95.625 ECU_ADDRESS 0xd000537c /end MEASUREMENT
/begin MEASUREMENT Vxx_knk_iga_slow_cor_mv "Mean slow knock correction on four cylinder" UBYTE _CNV_A_R_LINEAR_____25_CM 1 0. 0. 95.625 ECU_ADDRESS 0xd000537d /end MEASUREMENT
/begin MEASUREMENT Vxx_knk_rel_tq_appl_cor "The applied relative torque correction for the load in knock zone" UWORD _CNV_A_R_LINEAR_____125_CM 1 0. 0. 1. ECU_ADDRESS 0xd000316a FORMAT "%11.9" /end MEASUREMENT
/begin MEASUREMENT Vxx_knk_rel_tq_cor "The relative torque correction for the load in knock zone" UWORD _CNV_A_R_LINEAR_____125_CM 1 0. 0. 1. ECU_ADDRESS 0xd0005988 FORMAT "%11.9" /end MEASUREMENT
/begin MEASUREMENT Vxx_knk_rel_tq_cor_dec "decrease step for relative torque" UWORD _CNV_A_R_LINEAR_____125_CM 1 0. 0. 1. ECU_ADDRESS 0xd000598a FORMAT "%11.9" /end MEASUREMENT
/begin MEASUREMENT Vxx_knk_rel_tq_cor_inc "increase step for relative torque" UWORD _CNV_A_R_LINEAR_____125_CM 1 0. 0. 1. ECU_ADDRESS 0xd000598c FORMAT "%11.9" /end MEASUREMENT
/begin MEASUREMENT Vxx_knk_rel_tq_cor_max "Maximum relative torque correction decrease the load in the knock zone" UWORD _CNV_A_R_LINEAR_____125_CM 1 0. 0. 1. ECU_ADDRESS 0xd000598e FORMAT "%11.9" /end MEASUREMENT
/begin MEASUREMENT Vxx_knk_tq_cor_dec_dly "Current value of the timer to increase of one the step of relative torque in the knock zone" UWORD _CNV_A_R_LINEAR_____34_CM 1 0. 0. 655.35 ECU_ADDRESS 0xd0005990 FORMAT "%6.2" /end MEASUREMENT
/begin MEASUREMENT Vxx_knk_tq_cor_inc_dly "Current value of the timer to decrease of one the step of relative torque in the knock zone" UWORD _CNV_A_R_LINEAR_____34_CM 1 0. 0. 655.35 ECU_ADDRESS 0xd0005992 FORMAT "%6.2" /end MEASUREMENT
/begin CHARACTERISTIC Cbx_knk_out_tq_cor "Configuration boolean to enable the torque correction outside the knock zone" VALUE 0xa00213a0 _REC_S1VAL_20_u1 1. _CNV_S_2_RANGE______3_CM 0. 1. BIT_MASK 0x1 /end CHARACTERISTIC
/begin CHARACTERISTIC Cxx_knk_iga_cor_fil_ftc "Time constant for the ignition advance correction in knock zone" VALUE 0xa0021390 _REC_S1VAL_20_u2 655.35 _CNV_A_R_LINEAR_____34_CM 0. 655.35 FORMAT "%6.2" /end CHARACTERISTIC
/begin CHARACTERISTIC Cxx_knk_slow_fil_mv_hys "Hysteresis on the ignition correction threshold, for the output and the input of the torque correction" VALUE 0xa00213a1 _REC_S1VAL_20_u1 95.625 _CNV_A_R_LINEAR_____25_CM 0. 95.625 /end CHARACTERISTIC
/begin CHARACTERISTIC Cxx_knk_slow_fil_mv_iga "The ignition correction threshold, for the output and the input of the torque correction" VALUE 0xa00213a2 _REC_S1VAL_20_u1 95.625 _CNV_A_R_LINEAR_____25_CM 0. 95.625 /end CHARACTERISTIC
/begin CHARACTERISTIC Cxx_knk_slow_iga_efy "The ignition efficiency threshold, for the output and the input of the torque correction" VALUE 0xa0021392 _REC_S1VAL_20_u2 1. _CNV_A_R_LINEAR_____125_CM 0. 1. FORMAT "%11.9" /end CHARACTERISTIC
/begin CHARACTERISTIC Cxx_knk_slow_iga_efy_hys "Hysteresis on the ignition efficiency threshold, for the output and the input of the torque correction" VALUE 0xa00213a3 _REC_S1VAL_20_u1 95.625 _CNV_A_R_LINEAR_____25_CM 0. 95.625 /end CHARACTERISTIC
/begin CHARACTERISTIC Cxx_knk_tq_cor_dec_dly "Temporal step to decrease of one the step of relative torque in knock zone" VALUE 0xa0021394 _REC_S1VAL_20_u2 655.35 _CNV_A_R_LINEAR_____34_CM 0. 655.35 FORMAT "%6.2" /end CHARACTERISTIC
/begin CHARACTERISTIC Cxx_knk_tq_cor_dec_fac "Gain of torque decrease step in function of the slow open loop (KSC)" VALUE 0xa0021396 _REC_S1VAL_20_u2 1. _CNV_A_R_LINEAR_____274_CM 0. 1. FORMAT "%11.9" /end CHARACTERISTIC
/begin CHARACTERISTIC Cxx_knk_tq_cor_dec_ofs "The step decrease threshold of relative torque" VALUE 0xa0021398 _REC_S1VAL_20_u2 1. _CNV_A_R_LINEAR_____125_CM 0. 1. FORMAT "%11.9" /end CHARACTERISTIC
/begin CHARACTERISTIC Cxx_knk_tq_cor_inc_dly "Temporal step to increase of one the step of relative torque in knock zone" VALUE 0xa002139a _REC_S1VAL_20_u2 655.35 _CNV_A_R_LINEAR_____34_CM 0. 655.35 FORMAT "%6.2" /end CHARACTERISTIC
/begin CHARACTERISTIC Cxx_knk_tq_cor_inc_fac "Gain of torque increase step in function of the slow open loop (KSC)" VALUE 0xa002139c _REC_S1VAL_20_u2 1. _CNV_A_R_LINEAR_____274_CM 0. 1. FORMAT "%11.9" /end CHARACTERISTIC
/begin CHARACTERISTIC Cxx_knk_tq_cor_inc_ofs "The step increase threshold of relative torque" VALUE 0xa002139e _REC_S1VAL_20_u2 1. _CNV_A_R_LINEAR_____125_CM 0. 1. FORMAT "%11.9" /end CHARACTERISTIC
/begin MEASUREMENT Vbx_wg_abst_pres_cfm "Fixed nozzle turbine with wastegate present" UBYTE _CNV_S_2_RANGE______3_CM 1 0. 0. 1. ECU_ADDRESS 0xd0005338 BIT_MASK 0x1 /end MEASUREMENT
/begin CHARACTERISTIC Cbx_wg_abst_pres_cho_cfm "Fixed nozzle turbine with wastegate choice present or absent" VALUE 0xa0021e2a _REC_S1VAL_20_u1 1. _CNV_A_R_ECME_LINEA_0_CM 0. 1. FORMAT "%1.0" BIT_MASK 0x1 /end CHARACTERISTIC
/begin MEASUREMENT Vbx_igk "Ignition key signal" UBYTE _CNV_S_2_RANGE______3_CM 1 0. 0. 1. ECU_ADDRESS 0xd0004a37 BIT_MASK 0x1 /end MEASUREMENT
/begin MEASUREMENT Vbx_vh_key "Data indicating if the key vehicle is present (1=vehicle with key)" UBYTE _CNV_S_2_RANGE______3_CM 1 0. 0. 1. ECU_ADDRESS 0xd000440d BIT_MASK 0x1 /end MEASUREMENT
/begin MEASUREMENT Vsx_ena_sta_agb "AT Starter authorization or stop" UBYTE _CNV_A_R_ECME_LINEA_0_CM 1 0. 0. 255. ECU_ADDRESS 0xd000440e FORMAT "%3.0" /end MEASUREMENT
/begin MEASUREMENT Vsx_ena_sta_agb_vld "AT Starter authorization or stop validity status" UBYTE _CNV_S_4_STATUS_OK__275_CM 1 0. 0. 3. ECU_ADDRESS 0xd000440f /end MEASUREMENT
/begin MEASUREMENT Vsx_sta_stt_vld "Starter status validity status" UBYTE _CNV_S_4_STATUS_OK__275_CM 1 0. 0. 3. ECU_ADDRESS 0xd0004410 /end MEASUREMENT
/begin MEASUREMENT Vxx_sta_stt "Starter status" UBYTE _CNV_A_R_ECME_LINEA_0_CM 1 0. 0. 3. ECU_ADDRESS 0xd0004411 FORMAT "%1.0" /end MEASUREMENT
/begin AXIS_PTS Ctb_eng_amp "atmospheric pressure breakpoint of full load torque limitation." 0xa00294c4 Vxx_amp _REC_A2AXS_20_u2 20000. _CNV_A_R_LINEAR_____57_CM 6 0. 20000. FORMAT "%5.0" /end AXIS_PTS
/begin CHARACTERISTIC Cmp_amp_n_max_tqi_cor "Map of corrector coefficients (function of vacuum pressure and engine speed) working on the max IET." MAP 0xa00294d4 _REC_A1MAP_20_u1_u2_u2 0.99609375 _CNV_A_R_LINEAR_____276_CM 0.5 1.49609375 FORMAT "%10.8"
 /begin AXIS_DESCR COM_AXIS Vxx_amp _CNV_A_R_LINEAR_____57_CM 6 0. 20000. FORMAT "%5.0" AXIS_PTS_REF Ctb_eng_amp /end AXIS_DESCR
 /begin AXIS_DESCR COM_AXIS Vxx_n _CNV_A_R_ENSD_LINEA_24_CM 9 0. 16383.75 FORMAT "%8.2" AXIS_PTS_REF Ctb_n2 /end AXIS_DESCR
/end CHARACTERISTIC
/begin CHARACTERISTIC Ctp_mat_max_tqi_cor "Corrector coefficient table for Max indicated engine torque in function of air temperature" CURVE 0xa002950c _REC_A1CUR_20_u1_u2 0.99609375 _CNV_A_R_LINEAR_____276_CM 0.5 1.49609375 FORMAT "%10.8"
 /begin AXIS_DESCR COM_AXIS NO_INPUT_QUANTITY _CNV_A_R_LINEAR_____54_CM 9 -40. 200. FORMAT "%5.1" AXIS_PTS_REF Ctb_mat2 /end AXIS_DESCR
/end CHARACTERISTIC
/begin CHARACTERISTIC Ctp_n_gear_tqe_max_h "Corrector coefficient table for Max indicated engine torque in function of air temperature" CURVE 0xa0029518 _REC_A1CUR_20_u2_u2 2047.96875 _CNV_A_R_LINEAR_____161_CM -400. 1647.96875 FORMAT "%11.5"
 /begin AXIS_DESCR COM_AXIS Vxx_n _CNV_A_R_ENSD_LINEA_24_CM 20 0. 16383.75 FORMAT "%8.2" AXIS_PTS_REF Ctb_n /end AXIS_DESCR
/end CHARACTERISTIC
/begin CHARACTERISTIC Ctp_n_gear_tqe_max_l "Maximum effective torque for the low ratio" CURVE 0xa0029540 _REC_A1CUR_20_u2_u2 2047.96875 _CNV_A_R_LINEAR_____161_CM -400. 1647.96875 FORMAT "%11.5"
 /begin AXIS_DESCR COM_AXIS Vxx_n _CNV_A_R_ENSD_LINEA_24_CM 20 0. 16383.75 FORMAT "%8.2" AXIS_PTS_REF Ctb_n /end AXIS_DESCR
/end CHARACTERISTIC
/begin CHARACTERISTIC Ctp_n_max_tqi "Maximum HP Indicated mean torque in function of engine speed, under maximum supercharging pressure." CURVE 0xa0029568 _REC_A1CUR_20_u2_u2 2047.96875 _CNV_A_R_LINEAR_____123_CM 0. 2047.96875 FORMAT "%10.5"
 /begin AXIS_DESCR COM_AXIS Vxx_n _CNV_A_R_ENSD_LINEA_24_CM 20 0. 16383.75 FORMAT "%8.2" AXIS_PTS_REF Ctb_n /end AXIS_DESCR
/end CHARACTERISTIC
/begin CHARACTERISTIC Ctp_n_max_tqi_lih "Max HP Indicated mean torque in function of engine speed, with limp home position for the throttle" CURVE 0xa0029590 _REC_A1CUR_20_u2_u2 2047.96875 _CNV_A_R_LINEAR_____123_CM 0. 2047.96875 FORMAT "%10.5"
 /begin AXIS_DESCR COM_AXIS Vxx_n _CNV_A_R_ENSD_LINEA_24_CM 20 0. 16383.75 FORMAT "%8.2" AXIS_PTS_REF Ctb_n /end AXIS_DESCR
/end CHARACTERISTIC
/begin CHARACTERISTIC Ctp_n_tqi_dyn_lim "Every 20ms torque increment enable Max Indic Engine Torque to limit its temporal dynamic." CURVE 0xa00295b8 _REC_A1CUR_20_u1_u2 255. _CNV_A_R_LINEAR_____235_CM 0. 255. FORMAT "%3.0"
 /begin AXIS_DESCR COM_AXIS Vxx_n _CNV_A_R_ENSD_LINEA_24_CM 9 0. 16383.75 FORMAT "%8.2" AXIS_PTS_REF Ctb_n2 /end AXIS_DESCR
/end CHARACTERISTIC
/begin MEASUREMENT Vxx_max_avl_tqe "Maximum effective engine torque at current engine speed." UWORD _CNV_A_R_LINEAR_____161_CM 1 0. -400. 1647.96875 ECU_ADDRESS 0xd0002d28 FORMAT "%10.5" /end MEASUREMENT
/begin MEASUREMENT Vxx_max_dyn_avl_tqe "Maximum available torque with dynamic limitation" UWORD _CNV_A_R_LINEAR_____161_CM 1 0. -400. 1647.96875 ECU_ADDRESS 0xd0002d2a FORMAT "%10.5" /end MEASUREMENT
/begin MEASUREMENT Vxx_max_gear_avl_tqe "Maximal effective engine torque according to the gearbox ratio" UWORD _CNV_A_R_LINEAR_____161_CM 1 0. -400. 1647.96875 ECU_ADDRESS 0xd0002d2c FORMAT "%10.5" /end MEASUREMENT
/begin MEASUREMENT Vxx_max_tqi "Maximum (HP) Indicated engine torque available at current engine speed." UWORD _CNV_A_R_LINEAR_____123_CM 1 0. 0. 2047.96875 ECU_ADDRESS 0xd0002d2e FORMAT "%10.5" /end MEASUREMENT
/begin MEASUREMENT Vxx_max_tqi_alti_mat_cor "Maximum HP indicated engine torque corrected with altitude and air temperature functions." UWORD _CNV_A_R_LINEAR_____123_CM 1 0. 0. 2047.96875 ECU_ADDRESS 0xd0002d30 FORMAT "%10.5" /end MEASUREMENT
/begin MEASUREMENT Vxx_max_tqi_inj_cut "Maximum HP indicated engine torque corrected with the number of available cylindres." UWORD _CNV_A_R_LINEAR_____123_CM 1 0. 0. 2047.96875 ECU_ADDRESS 0xd0002d32 FORMAT "%10.5" /end MEASUREMENT
/begin MEASUREMENT Vxx_raw_max_tqi "Maximum HP indicated engine torque corrected with the number of available cylindres." UWORD _CNV_A_R_LINEAR_____123_CM 1 0. 0. 2047.96875 ECU_ADDRESS 0xd0002d34 FORMAT "%10.5" /end MEASUREMENT
/begin MEASUREMENT Vxx_tot_max_avl_tqe "Maximum effective engine torque" UWORD _CNV_A_R_LINEAR_____161_CM 1 0. -400. 1647.96875 ECU_ADDRESS 0xd0002d36 FORMAT "%10.5" /end MEASUREMENT
/begin MEASUREMENT Vxx_tqe_max_gear "Maximun effective torque in fonction of the gearbox" UWORD _CNV_A_R_LINEAR_____161_CM 1 0. -400. 1647.96875 ECU_ADDRESS 0xd0002d38 FORMAT "%10.5" /end MEASUREMENT
/begin CHARACTERISTIC Cxx_gear_max_tqe_h "Limit between the high ratio and the low ratio" VALUE 0xa0021503 _REC_S1VAL_20_u1 7. _CNV_A_R_LINEAR_____113_CM -1. 6. FORMAT "%2.0" /end CHARACTERISTIC
/begin CHARACTERISTIC Cxx_tqe_max_gear_slop_neg "Negative slope during the transmission sift" VALUE 0xa0021504 _REC_S1VAL_20_u1 255. _CNV_A_R_LINEAR_____234_CM -255. 0. FORMAT "%4.0" /end CHARACTERISTIC
/begin CHARACTERISTIC Cxx_tqe_max_gear_slop_pos "Positive slope during the transmission sift" VALUE 0xa0021505 _REC_S1VAL_20_u1 255. _CNV_A_R_LINEAR_____235_CM 0. 255. FORMAT "%3.0" /end CHARACTERISTIC
/begin CHARACTERISTIC Ctp_gear_lim_tq "gearbox torque limitation" CURVE 0xa002e6d8 _REC_A1CUR_20_u2_u1 2047.96875 _CNV_A_R_LINEAR_____161_CM -400. 1647.96875 FORMAT "%10.5"
 /begin AXIS_DESCR COM_AXIS Vxx_gear _CNV_A_R_LINEAR_____113_CM 8 -1. 6. READ_ONLY FORMAT "%2.0" AXIS_PTS_REF Ntb_gear /end AXIS_DESCR
/end CHARACTERISTIC
/begin MEASUREMENT Vxx_max_agb_tqe "Maximum automatic gearbox torque." UWORD _CNV_A_R_LINEAR_____161_CM 1 0. -400. 1647.96875 ECU_ADDRESS 0xc0000c0e FORMAT "%10.5" /end MEASUREMENT
/begin MEASUREMENT Vxx_max_gbx_tqe "Maximum torque to project gearbox from mechanical overload." UWORD _CNV_A_R_LINEAR_____161_CM 1 0. -400. 1647.96875 ECU_ADDRESS 0xc0000c10 FORMAT "%10.5" /end MEASUREMENT
/begin MEASUREMENT Vxx_max_mgb_tqe "Maximum gearbox available torque for mgb gearbox depending." UWORD _CNV_A_R_LINEAR_____161_CM 1 0. -400. 1647.96875 ECU_ADDRESS 0xc0000c12 FORMAT "%10.5" /end MEASUREMENT
/begin CHARACTERISTIC Cxx_gear_dft_lim_tq "Maximum torque to protect gearbox (default mode)" VALUE 0xa0020a00 _REC_S1VAL_20_u2 2047.96875 _CNV_A_R_LINEAR_____161_CM -400. 1647.96875 FORMAT "%10.5" /end CHARACTERISTIC
/begin AXIS_PTS Ctb_ovh_n "engine speed breakpoints map for over heating" 0xa0026a14 Vxx_n_mv _REC_A2AXS_20_u2 16383.75 _CNV_A_R_ENSD_LINEA_24_CM 5 0. 16383.75 FORMAT "%8.2" /end AXIS_PTS
/begin AXIS_PTS Ctb_ovh_tco "Coolant temperature breakpoints map for over heating" 0xa0026a20 Vxx_tco _REC_A2AXS_20_u2 240. _CNV_A_R_LINEAR_____54_CM 6 -40. 200. FORMAT "%5.1" /end AXIS_PTS
/begin AXIS_PTS Ctb_ovh_toil "Oil temperature breakpoints map for over heating" 0xa0026a30 Vxx_toil _REC_A2AXS_20_u2 240. _CNV_A_R_LINEAR_____54_CM 6 -40. 200. FORMAT "%5.1" /end AXIS_PTS
/begin AXIS_PTS Ctb_ovh_up_it_temp "Manifold air temperature breakpoints map for over heating" 0xa0026a40 Vxx_up_it_temp _REC_A2AXS_20_u2 240. _CNV_A_R_LINEAR_____54_CM 6 -40. 200. FORMAT "%5.1" /end AXIS_PTS
/begin AXIS_PTS Ctb_ovh_vs "Vehicle speed breakpoints map for over heating" 0xa00219e0 Vxx_vs _REC_A2AXS_20_u1 255. _CNV_A_R_LINEAR_____212_CM 5 0. 255. FORMAT "%3.0" /end AXIS_PTS
/begin CHARACTERISTIC Cmp_n_vs_ovh_tq_fac "overheat protection factor versus vehicle speed and engine speed" MAP 0xa0026a50 _REC_A1MAP_20_u2_u2_u1 0.99609375 _CNV_A_R_LINEAR_____31_CM 3.90625e-003 1. FORMAT "%10.8"
 /begin AXIS_DESCR COM_AXIS Vxx_n_mv _CNV_A_R_ENSD_LINEA_24_CM 5 0. 16383.75 FORMAT "%8.2" AXIS_PTS_REF Ctb_ovh_n /end AXIS_DESCR
 /begin AXIS_DESCR COM_AXIS Vxx_vs _CNV_A_R_LINEAR_____212_CM 5 0. 255. FORMAT "%3.0" AXIS_PTS_REF Ctb_ovh_vs /end AXIS_DESCR
/end CHARACTERISTIC
/begin CHARACTERISTIC Ctp_n_ovh_tq_fac "overheat protection factor versus engine speed" CURVE 0xa0026a84 _REC_A1CUR_20_u2_u2 0.99609375 _CNV_A_R_LINEAR_____277_CM 3.90625e-003 1. FORMAT "%10.8"
 /begin AXIS_DESCR COM_AXIS Vxx_n_mv _CNV_A_R_ENSD_LINEA_24_CM 5 0. 16383.75 FORMAT "%8.2" AXIS_PTS_REF Ctb_ovh_n /end AXIS_DESCR
/end CHARACTERISTIC
/begin CHARACTERISTIC Ctp_tco_ovh_tq "torque offset for overheat protection versus coolant temperature" CURVE 0xa0026a90 _REC_A1CUR_20_u2_u2 2047.96875 _CNV_A_R_LINEAR_____127_CM -1024. 1023.96875 FORMAT "%11.5"
 /begin AXIS_DESCR COM_AXIS Vxx_tco _CNV_A_R_LINEAR_____54_CM 6 -40. 200. FORMAT "%5.1" AXIS_PTS_REF Ctb_ovh_tco /end AXIS_DESCR
/end CHARACTERISTIC
/begin CHARACTERISTIC Ctp_temp_ovh_tq "torque offset for overheat protection versus air or oil temperature" CURVE 0xa0026a9c _REC_A1CUR_20_u2_u2 2047.96875 _CNV_A_R_LINEAR_____127_CM -1024. 1023.96875 FORMAT "%11.5"
 /begin AXIS_DESCR COM_AXIS Vxx_toil _CNV_A_R_LINEAR_____54_CM 6 -40. 200. FORMAT "%5.1" AXIS_PTS_REF Ctb_ovh_toil /end AXIS_DESCR
/end CHARACTERISTIC
/begin MEASUREMENT Vxx_ovh_prot_tq "Maximum indicated torque for overheat protection" SWORD _CNV_A_R_LINEAR_____123_CM 1 0. -1024. 1023.96875 ECU_ADDRESS 0xc0000b98 FORMAT "%11.5" /end MEASUREMENT
/begin CHARACTERISTIC Cbx_ovh_temp_cfm "air or oil temperature for over heating protection" VALUE 0xa00219e6 _REC_S1VAL_20_u1 1. _CNV_S_2_RANGE______3_CM 0. 1. BIT_MASK 0x1 /end CHARACTERISTIC
/begin CHARACTERISTIC Ctp_n_min_gas_lim_tq "Torque limitation value when gas tank is empty." CURVE 0xa0028e0c _REC_A1CUR_20_u2_u2 2047.96875 _CNV_A_R_LINEAR_____161_CM -400. 1647.96875 FORMAT "%10.5"
 /begin AXIS_DESCR COM_AXIS Vxx_n _CNV_A_R_ENSD_LINEA_24_CM 9 0. 16383.75 FORMAT "%8.2" AXIS_PTS_REF Ctb_n2 /end AXIS_DESCR
/end CHARACTERISTIC
/begin MEASUREMENT Vxx_max_prot_tqe "Maximum effective engine torque for engine protection." UWORD _CNV_A_R_LINEAR_____161_CM 1 0. -400. 1647.96875 ECU_ADDRESS 0xd00057ba FORMAT "%10.5" /end MEASUREMENT
/begin MEASUREMENT Vxx_min_fuel "Minimum fuel level for torque protection" UWORD _CNV_A_R_LINEAR_____125_CM 1 0. 0. 1. ECU_ADDRESS 0xd00057bc FORMAT "%11.9" /end MEASUREMENT
/begin CHARACTERISTIC Cxx_min_gas_dec "value of negative gradient in case of torque limitation when the gas tank is empty" VALUE 0xa002107e _REC_S1VAL_20_u2 7.96875 _CNV_A_R_LINEAR_____278_CM -8. -3.125e-002 FORMAT "%11.5" /end CHARACTERISTIC
/begin CHARACTERISTIC Cxx_min_gas_inc "value of positive gradient in case of torque limitation when the gas tank is empty" VALUE 0xa0021080 _REC_S1VAL_20_u2 7.96875 _CNV_A_R_LINEAR_____279_CM 3.125e-002 8. FORMAT "%10.5" /end CHARACTERISTIC
/begin MEASUREMENT Vxx_max_pow_tqe "Limitation effective torque for power " UWORD _CNV_A_R_LINEAR_____161_CM 1 0. -400. 1647.96875 ECU_ADDRESS 0xd000305c FORMAT "%10.5" /end MEASUREMENT
/begin MEASUREMENT Vxx_max_stat_avl_tqe "Maximum absolute effective torque" UWORD _CNV_A_R_LINEAR_____161_CM 1 0. -400. 1647.96875 ECU_ADDRESS 0xd000305e FORMAT "%10.5" /end MEASUREMENT
/begin CHARACTERISTIC Cxx_max_pow_gear "maximum power for power limitation." VALUE 0xa00207de _REC_S1VAL_20_u2 655350. _CNV_A_R_LINEAR_____128_CM 0. 655350. FORMAT "%6.0" /end CHARACTERISTIC
/begin AXIS_PTS Ctb_max_rams_tqe_3 "Breakpoints for the safety vehicle speed limitation converted in torque limitation level 3 (strong)" 0xa002e5bc Vxx_vs _REC_A2AXS_20_u1 255. _CNV_A_R_LINEAR_____212_CM 12 0. 255. FORMAT "%3.0" /end AXIS_PTS
/begin AXIS_PTS Ctb_max_rams_tqi_1 "Breakpoints for the safety torque limitation level 1 (low)" 0xa002e5cc Vxx_n_mv _REC_A2AXS_20_u2 16383.75 _CNV_A_R_ENSD_LINEA_24_CM 12 0. 16383.75 FORMAT "%8.2" /end AXIS_PTS
/begin AXIS_PTS Ctb_max_rams_tqi_2 "Breakpoints for the safety torque limitation level 2 (mean)" 0xa002e5e8 Vxx_n_mv _REC_A2AXS_20_u2 16383.75 _CNV_A_R_ENSD_LINEA_24_CM 12 0. 16383.75 FORMAT "%8.2" /end AXIS_PTS
/begin CHARACTERISTIC Ctp_max_rams_tqe_3 "Level 3 (strong) maximum effective torque allowed function of the vehicle speed" CURVE 0xa002e604 _REC_A1CUR_20_u2_u1 2047.96875 _CNV_A_R_LINEAR_____161_CM -400. 1647.96875 FORMAT "%10.5"
 /begin AXIS_DESCR COM_AXIS Vxx_vs _CNV_A_R_LINEAR_____212_CM 12 0. 255. FORMAT "%3.0" AXIS_PTS_REF Ctb_max_rams_tqe_3 /end AXIS_DESCR
/end CHARACTERISTIC
/begin CHARACTERISTIC Ctp_max_rams_tqi_1 "Level 1 (low) maximum indicated torque allowed function of engine speed" CURVE 0xa002e61c _REC_A1CUR_20_u2_u2 2047.96875 _CNV_A_R_LINEAR_____123_CM 0. 2047.96875 FORMAT "%10.5"
 /begin AXIS_DESCR COM_AXIS Vxx_n_mv _CNV_A_R_ENSD_LINEA_24_CM 12 0. 16383.75 FORMAT "%8.2" AXIS_PTS_REF Ctb_max_rams_tqi_1 /end AXIS_DESCR
/end CHARACTERISTIC
/begin CHARACTERISTIC Ctp_max_rams_tqi_2 "Level 2 (mean) maximum indicated torque allowed function of engine speed" CURVE 0xa002e634 _REC_A1CUR_20_u2_u2 2047.96875 _CNV_A_R_LINEAR_____123_CM 0. 2047.96875 FORMAT "%10.5"
 /begin AXIS_DESCR COM_AXIS Vxx_n_mv _CNV_A_R_ENSD_LINEA_24_CM 12 0. 16383.75 FORMAT "%8.2" AXIS_PTS_REF Ctb_max_rams_tqi_2 /end AXIS_DESCR
/end CHARACTERISTIC
/begin MEASUREMENT Vbx_max_rams_tqe_1_on "Safety torque limitation level 1 activated" UBYTE _CNV_S_2_RANGE______3_CM 1 0. 0. 1. ECU_ADDRESS 0xd0004987 BIT_MASK 0x1 /end MEASUREMENT
/begin MEASUREMENT Vbx_max_rams_tqe_2_on "Safety torque limitation level 2 activated" UBYTE _CNV_S_2_RANGE______3_CM 1 0. 0. 1. ECU_ADDRESS 0xd0004988 BIT_MASK 0x1 /end MEASUREMENT
/begin MEASUREMENT Vbx_max_rams_tqe_3_on "Safety torque limitation level 3 activated" UBYTE _CNV_S_2_RANGE______3_CM 1 0. 0. 1. ECU_ADDRESS 0xd0004989 BIT_MASK 0x1 /end MEASUREMENT
/begin MEASUREMENT Vsx_tq_rams_lim_vld "Safety torque limitation validity status" UBYTE _CNV_S_2_STATUS_OK__188_CM 1 0. 0. 1. ECU_ADDRESS 0xd000498a /end MEASUREMENT
/begin MEASUREMENT Vxx_lim_max_rams_tqe "Maximum torque allowed by the failsafe mode." UWORD _CNV_A_R_LINEAR_____161_CM 1 0. -400. 1647.96875 ECU_ADDRESS 0xd000353e FORMAT "%10.5" /end MEASUREMENT
/begin MEASUREMENT Vxx_max_rams_tqe_1 "Safety limited torque by level 1 limitation (low)" UWORD _CNV_A_R_LINEAR_____161_CM 1 0. -400. 1647.96875 ECU_ADDRESS 0xd0003540 FORMAT "%10.5" /end MEASUREMENT
/begin MEASUREMENT Vxx_max_rams_tqe_2 "Safety limited torque by level 2 limitation (mean)" UWORD _CNV_A_R_LINEAR_____161_CM 1 0. -400. 1647.96875 ECU_ADDRESS 0xd0003542 FORMAT "%10.5" /end MEASUREMENT
/begin MEASUREMENT Vxx_max_rams_tqe_3 "Safety limited vehicle speed converted in torque by level 3 limitation (strong)" UWORD _CNV_A_R_LINEAR_____161_CM 1 0. -400. 1647.96875 ECU_ADDRESS 0xd0003544 FORMAT "%10.5" /end MEASUREMENT
/begin CHARACTERISTIC Cbx_tq_rams_lim_act_3_bch_cfm "Activation of safety vehicle speed limitation converted in torque limitation level 3 (strong) bench mode" VALUE 0xa0021aa4 _REC_S1VAL_20_u1 1. _CNV_S_2_RANGE______3_CM 0. 1. BIT_MASK 0x1 /end CHARACTERISTIC
/begin CHARACTERISTIC Cxx_max_rams_tqe_1_slop "Slope to attend the safety torque limitation level 1 (low)" VALUE 0xa0021a9a _REC_S1VAL_20_u2 102398.4375 _CNV_A_R_LINEAR_____280_CM 0. 102398.4375 FORMAT "%11.4" /end CHARACTERISTIC
/begin CHARACTERISTIC Cxx_max_rams_tqe_2_slop "Slope to attend the safety torque limitation level 2 (mean)" VALUE 0xa0021a9c _REC_S1VAL_20_u2 102398.4375 _CNV_A_R_LINEAR_____280_CM 0. 102398.4375 FORMAT "%11.4" /end CHARACTERISTIC
/begin CHARACTERISTIC Cxx_max_rams_tqe_3_slop "Slope to attend the safety torque limitation level 3 (strong)" VALUE 0xa0021a9e _REC_S1VAL_20_u2 102398.4375 _CNV_A_R_LINEAR_____280_CM 0. 102398.4375 FORMAT "%11.4" /end CHARACTERISTIC
/begin CHARACTERISTIC Cxx_max_rams_tqe_3_srs "Safety limited torque level 3 (strong) if vehicle speed not valid" VALUE 0xa0021aa0 _REC_S1VAL_20_u2 2047.96875 _CNV_A_R_LINEAR_____161_CM -400. 1647.96875 FORMAT "%10.5" /end CHARACTERISTIC
/begin CHARACTERISTIC Cxx_max_rams_tqe_sta_slop "Slope to attend the safety torque limitation level 1.2.3 during engine state isn't autonomous" VALUE 0xa0021aa2 _REC_S1VAL_20_u2 102398.4375 _CNV_A_R_LINEAR_____280_CM 0. 102398.4375 FORMAT "%11.4" /end CHARACTERISTIC
/begin MEASUREMENT Vbx_tq_rams_lim_act_1 "Activation of safety torque limitation level 1 (low)" UBYTE _CNV_S_2_RANGE______3_CM 1 0. 0. 1. ECU_ADDRESS 0xd0005778 BIT_MASK 0x1 /end MEASUREMENT
/begin MEASUREMENT Vbx_tq_rams_lim_act_2 "Activation of safety torque limitation level 2 (mean)" UBYTE _CNV_S_2_RANGE______3_CM 1 0. 0. 1. ECU_ADDRESS 0xd0005779 BIT_MASK 0x1 /end MEASUREMENT
/begin MEASUREMENT Vbx_tq_rams_lim_act_3 "Activation of safety vehicle speed limitation converted in torque limitation level 3 (strong)" UBYTE _CNV_S_2_RANGE______3_CM 1 0. 0. 1. ECU_ADDRESS 0xd000577a BIT_MASK 0x1 /end MEASUREMENT
/begin CHARACTERISTIC Cxx_tq_lim_spg_reg_cfm "Activation of engine torque limitation by boost pressure regulation (0: no limitation, 1: limitation level 1, 2: limitation level 2)" VALUE 0xa00214fc _REC_S1VAL_20_u1 2. _CNV_A_R_ECME_LINEA_0_CM 0. 2. FORMAT "%1.0" /end CHARACTERISTIC
/begin MEASUREMENT Vbx_max_prot_spg_tqe_act "Maximum effective torque limitation for supercharger protection activated" UBYTE _CNV_S_2_RANGE______3_CM 1 0. 0. 1. ECU_ADDRESS 0xd0005052 BIT_MASK 0x1 /end MEASUREMENT
/begin MEASUREMENT Vxx_max_prot_spg_tqe "Maximum effective engine torque for supercharger protection" UWORD _CNV_A_R_LINEAR_____161_CM 1 0. -400. 1647.96875 ECU_ADDRESS 0xd00059ec FORMAT "%10.5" /end MEASUREMENT
/begin MEASUREMENT Vxx_sens_lbup_v "Tension upstream sensor" UWORD _CNV_A_R_LINEAR_____52_CM 1 0. 0. 25000. ECU_ADDRESS 0xd00032a4 FORMAT "%5.0" /end MEASUREMENT
/begin MEASUREMENT vls_up_raw[0] "" UWORD _CNV_A_R_LINEAR_____269_CM 1 0. 0. 4.9951171875 ECU_ADDRESS 0xd00032a6 FORMAT "%5.3" /end MEASUREMENT
/begin MEASUREMENT Vbx_ufld_cut "unflooding strategy available" UBYTE _CNV_S_2_RANGE______3_CM 1 0. 0. 1. ECU_ADDRESS 0xd00057ab BIT_MASK 0x1 /end MEASUREMENT
/begin CHARACTERISTIC Cxx_ufld_tco_thd "coolant temperature maximum value for unflooding strategy application" VALUE 0xa0021722 _REC_S1VAL_20_u2 240. _CNV_A_R_LINEAR_____54_CM -40. 200. FORMAT "%5.1" /end CHARACTERISTIC
/begin MEASUREMENT Vbx_eng_spc_acs_dsb "Accessories deactivation request for engine specific strategies" UBYTE _CNV_S_2_RANGE______3_CM 1 0. 0. 1. ECU_ADDRESS 0xd00054e5 BIT_MASK 0x1 /end MEASUREMENT
/begin AXIS_PTS Ctb_n_alt "Engine speed breakpoints for alternator cartographies" 0xa002e764 Vxx_n _REC_A2AXS_20_u2 16383.75 _CNV_A_R_ENSD_LINEA_24_CM 8 0. 16383.75 FORMAT "%8.2" /end AXIS_PTS
/begin AXIS_PTS Ctb_rbst_el_csm_dsb_amp "Atmospheric pressure breakpoints in engine robustness strategy" 0xa002e778 Vxx_amp _REC_A2AXS_20_u2 20000. _CNV_A_R_LINEAR_____57_CM 9 0. 20000. FORMAT "%5.0" /end AXIS_PTS
/begin CHARACTERISTIC Cmp_alt_slop_req "Cartography to compute alternator power gradient authorized by ECM" MAP 0xa002e78c _REC_A1MAP_20_u1_u2_u2 10200. _CNV_A_R_LINEAR_____282_CM 0. 10200. FORMAT "%5.0"
 /begin AXIS_DESCR COM_AXIS Vxx_n _CNV_A_R_ENSD_LINEA_24_CM 8 0. 16383.75 FORMAT "%8.2" AXIS_PTS_REF Ctb_n_alt /end AXIS_DESCR
 /begin AXIS_DESCR COM_AXIS Vxx_tco _CNV_A_R_LINEAR_____54_CM 9 -40. 200. FORMAT "%5.1" AXIS_PTS_REF Ctb_tco2 /end AXIS_DESCR
/end CHARACTERISTIC
/begin CHARACTERISTIC Ctd_rbst_el_csm_dsb_gear "Cartography to select gears on which electrical consumers deactivation is requested in engine robustness strategy" CURVE 0xa0020870 _REC_A1CUR_20_u1_u1 1. _CNV_A_R_ECME_LINEA_0_CM 0. 1. FORMAT "%1.0" BIT_MASK 0x1
 /begin AXIS_DESCR COM_AXIS Vxx_gear _CNV_A_R_LINEAR_____113_CM 8 -1. 6. READ_ONLY FORMAT "%2.0" AXIS_PTS_REF Ntb_gear /end AXIS_DESCR
/end CHARACTERISTIC
/begin CHARACTERISTIC Ctp_perf_acs_dsb_max_avl_tqe "Cartography to compute the maximum value of maximum available torque to request accessories deactivation in performance restitution strategy" CURVE 0xa002e7d4 _REC_A1CUR_20_u2_u2 2047.96875 _CNV_A_R_LINEAR_____161_CM -400. 1647.96875 FORMAT "%10.5"
 /begin AXIS_DESCR COM_AXIS Vxx_n _CNV_A_R_ENSD_LINEA_24_CM 20 0. 16383.75 FORMAT "%8.2" AXIS_PTS_REF Ctb_n /end AXIS_DESCR
/end CHARACTERISTIC
/begin CHARACTERISTIC Ctp_rbst_el_csm_dsb_tco_thd "Cartography to compute engine coolant temperature threshold in engine robustness strategy" CURVE 0xa002e7fc _REC_A1CUR_20_u2_u2 240. _CNV_A_R_LINEAR_____54_CM -40. 200. FORMAT "%5.1"
 /begin AXIS_DESCR COM_AXIS Vxx_amp _CNV_A_R_LINEAR_____57_CM 9 0. 20000. FORMAT "%5.0" AXIS_PTS_REF Ctb_rbst_el_csm_dsb_amp /end AXIS_DESCR
/end CHARACTERISTIC
/begin CHARACTERISTIC Ctp_sta_ac_ptc_dsb_dly "Cartography to compute air conditioning and PTC deactivation duration at engine start" CURVE 0xa002e810 _REC_A1CUR_20_u2_u2 655.35 _CNV_A_R_LINEAR_____34_CM 0. 655.35 FORMAT "%6.2"
 /begin AXIS_DESCR COM_AXIS Vxx_tco _CNV_A_R_LINEAR_____54_CM 9 -40. 200. FORMAT "%5.1" AXIS_PTS_REF Ctb_tco2 /end AXIS_DESCR
/end CHARACTERISTIC
/begin CHARACTERISTIC Ctp_sta_alt_dsb_dly "Cartography to compute alternator deactivation duration at engine start" CURVE 0xa002e824 _REC_A1CUR_20_u2_u2 655.35 _CNV_A_R_LINEAR_____34_CM 0. 655.35 FORMAT "%6.2"
 /begin AXIS_DESCR COM_AXIS Vxx_tco _CNV_A_R_LINEAR_____54_CM 9 -40. 200. FORMAT "%5.1" AXIS_PTS_REF Ctb_tco2 /end AXIS_DESCR
/end CHARACTERISTIC
/begin CHARACTERISTIC Ctp_stal_ac_dsb_n_ofs "Cartography to compute engine speed offset to start stalling anticipation in anti-stall strategy" CURVE 0xa002e838 _REC_A1CUR_20_u2_u2 16383.75 _CNV_A_R_ENSD_LINEA_24_CM 0. 16383.75 FORMAT "%8.2"
 /begin AXIS_DESCR COM_AXIS Vxx_tco _CNV_A_R_LINEAR_____54_CM 9 -40. 200. FORMAT "%5.1" AXIS_PTS_REF Ctb_tco2 /end AXIS_DESCR
/end CHARACTERISTIC
/begin CHARACTERISTIC Ctp_stal_acs_dsb_n "Cartography to compute engine speed threshold to request accessories deactivation in anti-stall strategy" CURVE 0xa002e84c _REC_A1CUR_20_u2_u2 16383.75 _CNV_A_R_ENSD_LINEA_24_CM 0. 16383.75 FORMAT "%8.2"
 /begin AXIS_DESCR COM_AXIS Vxx_tco _CNV_A_R_LINEAR_____54_CM 9 -40. 200. FORMAT "%5.1" AXIS_PTS_REF Ctb_tco2 /end AXIS_DESCR
/end CHARACTERISTIC
/begin MEASUREMENT Vbx_ac_dsb_req "Air conditioning deactivation request before coordination" UBYTE _CNV_S_2_RANGE______3_CM 1 0. 0. 1. ECU_ADDRESS 0xd0005693 BIT_MASK 0x1 /end MEASUREMENT
/begin MEASUREMENT Vbx_ac_eng_dsb "Air conditioning compressor inhibition request for engine needs" UBYTE _CNV_S_2_RANGE______3_CM 1 0. 0. 1. ECU_ADDRESS 0xd0005694 BIT_MASK 0x1 /end MEASUREMENT
/begin MEASUREMENT Vbx_ac_eng_frz "Air conditioning compressor freezing request for engine needs" UBYTE _CNV_S_2_RANGE______3_CM 1 0. 0. 1. ECU_ADDRESS 0xd0005695 BIT_MASK 0x1 /end MEASUREMENT
/begin MEASUREMENT Vbx_acel_is_ac_dsb "Air conditioning deactivation request for minimum idle speed at compressor clutching" UBYTE _CNV_S_2_RANGE______3_CM 1 0. 0. 1. ECU_ADDRESS 0xd0005696 BIT_MASK 0x1 /end MEASUREMENT
/begin MEASUREMENT Vbx_acs_frz "Accessories freezing request before coordination" UBYTE _CNV_S_2_RANGE______3_CM 1 0. 0. 1. ECU_ADDRESS 0xd0005697 BIT_MASK 0x1 /end MEASUREMENT
/begin MEASUREMENT Vbx_alt_dsb_req "Alternator deactivation request before coordination" UBYTE _CNV_S_2_RANGE______3_CM 1 0. 0. 1. ECU_ADDRESS 0xd0005698 BIT_MASK 0x1 /end MEASUREMENT
/begin MEASUREMENT Vbx_alt_eng_dsb "Alternator deactivation request after coordination" UBYTE _CNV_S_2_RANGE______3_CM 1 0. 0. 1. ECU_ADDRESS 0xd0005699 BIT_MASK 0x1 /end MEASUREMENT
/begin MEASUREMENT Vbx_perf_ac_dsb "Consolidated air conditioning deactivation request for performance restitution" UBYTE _CNV_S_2_RANGE______3_CM 1 0. 0. 1. ECU_ADDRESS 0xd0004d4a BIT_MASK 0x1 /end MEASUREMENT
/begin MEASUREMENT Vbx_perf_acs_dsb "Accessories deactivation request for performance restitution" UBYTE _CNV_S_2_RANGE______3_CM 1 0. 0. 1. ECU_ADDRESS 0xd000569a BIT_MASK 0x1 /end MEASUREMENT
/begin MEASUREMENT Vbx_perf_el_csm_dsb "Consolidated electrical consumers deactivation request for performance restitution" UBYTE _CNV_S_2_RANGE______3_CM 1 0. 0. 1. ECU_ADDRESS 0xd0004d4b BIT_MASK 0x1 /end MEASUREMENT
/begin MEASUREMENT Vbx_ptc_cut "Cut off condition, output of shut off and limitation conditions to the CAN Inj_Base_Rapide frame" UBYTE _CNV_S_2_RANGE______3_CM 1 0. 0. 1. ECU_ADDRESS 0xd000569b BIT_MASK 0x1 /end MEASUREMENT
/begin MEASUREMENT Vbx_ptc_dsb_req "PTC deactivation request before coordination" UBYTE _CNV_S_2_RANGE______3_CM 1 0. 0. 1. ECU_ADDRESS 0xd000569c BIT_MASK 0x1 /end MEASUREMENT
/begin MEASUREMENT Vbx_ptc_frz "Output of freeze condition, to the CAN INJ_Base_Rapide frame." UBYTE _CNV_S_2_RANGE______3_CM 1 0. 0. 1. ECU_ADDRESS 0xd000569d BIT_MASK 0x1 /end MEASUREMENT
/begin MEASUREMENT Vbx_rbst_el_csm_dsb "Electrical consumers deactivation request for engine robustness" UBYTE _CNV_S_2_RANGE______3_CM 1 0. 0. 1. ECU_ADDRESS 0xd0004d4c BIT_MASK 0x1 /end MEASUREMENT
/begin MEASUREMENT Vbx_sfty_acs_dsb "Accessories deactivation request for safety" UBYTE _CNV_S_2_RANGE______3_CM 1 0. 0. 1. ECU_ADDRESS 0xd000569e BIT_MASK 0x1 /end MEASUREMENT
/begin MEASUREMENT Vbx_sta_ac_ptc_dsb "Air conditioning and PTC deactivation request for engine start" UBYTE _CNV_S_2_RANGE______3_CM 1 0. 0. 1. ECU_ADDRESS 0xd000569f BIT_MASK 0x1 /end MEASUREMENT
/begin MEASUREMENT Vbx_sta_alt_dsb "Alternator deactivation request for engine start" UBYTE _CNV_S_2_RANGE______3_CM 1 0. 0. 1. ECU_ADDRESS 0xd00056a0 BIT_MASK 0x1 /end MEASUREMENT
/begin MEASUREMENT Vbx_stal_acs_dsb "Accessories deactivation request for anti-stall" UBYTE _CNV_S_2_RANGE______3_CM 1 0. 0. 1. ECU_ADDRESS 0xd00056a1 BIT_MASK 0x1 /end MEASUREMENT
/begin MEASUREMENT Vbx_stal_alt_ac_dsb "Consolidated alternator and air conditioning deactivation request for anti-stall" UBYTE _CNV_S_2_RANGE______3_CM 1 0. 0. 1. ECU_ADDRESS 0xd0004d4d BIT_MASK 0x1 /end MEASUREMENT
/begin MEASUREMENT Vbx_stal_el_csm_dsb "Consolidated electrical consumers deactivation request for anti-stall" UBYTE _CNV_S_2_RANGE______3_CM 1 0. 0. 1. ECU_ADDRESS 0xd0004d4e BIT_MASK 0x1 /end MEASUREMENT
/begin MEASUREMENT Vbx_thpl_dsb_req "Coolant heaters deactivation request before coordination" UBYTE _CNV_S_2_RANGE______3_CM 1 0. 0. 1. ECU_ADDRESS 0xd0004d4f BIT_MASK 0x1 /end MEASUREMENT
/begin MEASUREMENT Vbx_thpl_eng_dsb "Coolant heaters deactivation request for engine needs" UBYTE _CNV_S_2_RANGE______3_CM 1 0. 0. 1. ECU_ADDRESS 0xd0004d50 BIT_MASK 0x1 /end MEASUREMENT
/begin MEASUREMENT Vbx_thpl_eng_frz "Coolant heaters freezing request for engine needs" UBYTE _CNV_S_2_RANGE______3_CM 1 0. 0. 1. ECU_ADDRESS 0xd0004d51 BIT_MASK 0x1 /end MEASUREMENT
/begin MEASUREMENT Vbx_tkof_acs_dsb "Accessories deactivation request for takeoff" UBYTE _CNV_S_2_RANGE______3_CM 1 0. 0. 1. ECU_ADDRESS 0xd00056a2 BIT_MASK 0x1 /end MEASUREMENT
/begin MEASUREMENT Vbx_tkof_alt_ac_dsb "Consolidated alternator and air conditioning deactivation request for takeoff" UBYTE _CNV_S_2_RANGE______3_CM 1 0. 0. 1. ECU_ADDRESS 0xd0004d52 BIT_MASK 0x1 /end MEASUREMENT
/begin MEASUREMENT Vbx_tkof_el_csm_dsb "Consolidated electrical consumers deactivation request for takeoff" UBYTE _CNV_S_2_RANGE______3_CM 1 0. 0. 1. ECU_ADDRESS 0xd0004d53 BIT_MASK 0x1 /end MEASUREMENT
/begin MEASUREMENT Vsx_stal_acs_dsb_stt "Stalling state in anti-stall strategy" UBYTE _CNV_S_3_RANGE_STAT_283_CM 1 0. 0. 2. ECU_ADDRESS 0xd00056a3 /end MEASUREMENT
/begin MEASUREMENT Vxx_ac_max_pow_ena "Air conditioning maximum power authorized by ECM" UWORD _CNV_A_R_LINEAR_____128_CM 1 0. 0. 655350. ECU_ADDRESS 0xd0005a94 FORMAT "%6.0" /end MEASUREMENT
/begin MEASUREMENT Vxx_acel_pdl_grd "Accelerator pedal gradient" SWORD _CNV_A_R_LINEAR_____284_CM 1 0. -64. 63.998046875 ECU_ADDRESS 0xd0005a96 FORMAT "%7.3" /end MEASUREMENT
/begin MEASUREMENT Vxx_acs_ena_dly "Accessories reactivation timer" UWORD _CNV_A_R_LINEAR_____34_CM 1 0. 0. 655.35 ECU_ADDRESS 0xd0005a98 FORMAT "%6.2" /end MEASUREMENT
/begin MEASUREMENT Vxx_alt_max_pow_ena "Alternator maximum power authorized by the ECM" UWORD _CNV_A_R_LINEAR_____128_CM 1 0. 0. 655350. ECU_ADDRESS 0xd0005a9a FORMAT "%6.0" /end MEASUREMENT
/begin MEASUREMENT Vxx_alt_slop_req "Power slope sent to the USM" UBYTE _CNV_A_R_LINEAR_____282_CM 1 0. 0. 10200. ECU_ADDRESS 0xd00056a4 FORMAT "%5.0" /end MEASUREMENT
/begin MEASUREMENT Vxx_ptc_max_pow_ena "PTC maximum power allowed" UWORD _CNV_A_R_LINEAR_____128_CM 1 0. 0. 655350. ECU_ADDRESS 0xd0005a9c FORMAT "%6.0" /end MEASUREMENT
/begin MEASUREMENT Vxx_stal_ac_ant_dsb_n "Stalling anticipation engine speed threshold" UWORD _CNV_A_R_ENSD_LINEA_24_CM 1 0. 0. 16383.75 ECU_ADDRESS 0xd0005a9e FORMAT "%8.2" /end MEASUREMENT
/begin MEASUREMENT Vxx_stal_ac_max_pow_ena "Consolidated air conditioning maximum power for anti-stall" UWORD _CNV_A_R_LINEAR_____128_CM 1 0. 0. 655350. ECU_ADDRESS 0xd0005aa0 FORMAT "%6.0" /end MEASUREMENT
/begin MEASUREMENT Vxx_stal_ac_max_pow_ena_clc "Air conditioning maximum power calculated in anti-stall strategy" UWORD _CNV_A_R_LINEAR_____128_CM 1 0. 0. 655350. ECU_ADDRESS 0xd0005aa2 FORMAT "%6.0" /end MEASUREMENT
/begin MEASUREMENT Vxx_stal_ac_max_tq "Air conditioning maximum torque calculated in anti-stall strategy" UWORD _CNV_A_R_LINEAR_____123_CM 1 0. 0. 2047.96875 ECU_ADDRESS 0xd0005aa4 FORMAT "%10.5" /end MEASUREMENT
/begin MEASUREMENT Vxx_stal_ac_max_tq_clc "Air conditioning maximum torque calculated from proportional and derivative corrections in anti-stall strategy" UWORD _CNV_A_R_LINEAR_____123_CM 1 0. 0. 2047.96875 ECU_ADDRESS 0xd0005aa6 FORMAT "%10.5" /end MEASUREMENT
/begin MEASUREMENT Vxx_stal_acs_dsb_dly "Timer to leave stalling states in anti-stall strategy" UWORD _CNV_A_R_LINEAR_____34_CM 1 0. 0. 655.35 ECU_ADDRESS 0xd0005aa8 FORMAT "%6.2" /end MEASUREMENT
/begin MEASUREMENT Vxx_stal_acs_dsb_n "Stalling engine speed threshold" UWORD _CNV_A_R_ENSD_LINEA_24_CM 1 0. 0. 16383.75 ECU_ADDRESS 0xd0005aaa FORMAT "%8.2" /end MEASUREMENT
/begin MEASUREMENT Vxx_tkof_acs_dsb_vs "Vehicle speed for takeoff strategy" UWORD _CNV_A_R_LINEAR_____70_CM 1 0. 0. 655.35 ECU_ADDRESS 0xd0005aac FORMAT "%6.2" /end MEASUREMENT
/begin CHARACTERISTIC Cbx_ac_max_pow_ena_cfm "Activation of air conditioning power limitation strategy" VALUE 0xa00208c0 _REC_S1VAL_20_u1 1. _CNV_S_2_RANGE______3_CM 0. 1. BIT_MASK 0x1 /end CHARACTERISTIC
/begin CHARACTERISTIC Cbx_acel_is_ac_dsb_cfm "Activation of air conditioning accelerated idle speed strategy" VALUE 0xa00208c1 _REC_S1VAL_20_u1 1. _CNV_S_2_RANGE______3_CM 0. 1. BIT_MASK 0x1 /end CHARACTERISTIC
/begin CHARACTERISTIC Cbx_eng_spc_ac_dsb_cfm "Activation of engine specific strategy for air conditioning" VALUE 0xa00208c2 _REC_S1VAL_20_u1 1. _CNV_S_2_RANGE______3_CM 0. 1. BIT_MASK 0x1 /end CHARACTERISTIC
/begin CHARACTERISTIC Cbx_eng_spc_alt_dsb_cfm "Activation of engine specific strategy for alternator" VALUE 0xa00208c3 _REC_S1VAL_20_u1 1. _CNV_S_2_RANGE______3_CM 0. 1. BIT_MASK 0x1 /end CHARACTERISTIC
/begin CHARACTERISTIC Cbx_eng_spc_ptc_dsb_cfm "Activation of engine specific strategy for PTC" VALUE 0xa00208c4 _REC_S1VAL_20_u1 1. _CNV_S_2_RANGE______3_CM 0. 1. BIT_MASK 0x1 /end CHARACTERISTIC
/begin CHARACTERISTIC Cbx_eng_spc_thpl_dsb_cfm "Activation of engine specific strategy for coolant heaters" VALUE 0xa00208c5 _REC_S1VAL_20_u1 1. _CNV_S_2_RANGE______3_CM 0. 1. BIT_MASK 0x1 /end CHARACTERISTIC
/begin CHARACTERISTIC Cbx_perf_ac_dsb_cfm "Activation of performance restitution strategy for air conditioning" VALUE 0xa00208c6 _REC_S1VAL_20_u1 1. _CNV_S_2_RANGE______3_CM 0. 1. BIT_MASK 0x1 /end CHARACTERISTIC
/begin CHARACTERISTIC Cbx_perf_ptc_dsb_cfm "Activation of performance restitution strategy for PTC" VALUE 0xa00208c7 _REC_S1VAL_20_u1 1. _CNV_S_2_RANGE______3_CM 0. 1. BIT_MASK 0x1 /end CHARACTERISTIC
/begin CHARACTERISTIC Cbx_perf_thpl_dsb_cfm "Activation of performance restitution strategy for coolant heaters" VALUE 0xa00208c8 _REC_S1VAL_20_u1 1. _CNV_S_2_RANGE______3_CM 0. 1. BIT_MASK 0x1 /end CHARACTERISTIC
/begin CHARACTERISTIC Cbx_rbst_ptc_dsb_cfm "Activation of engine robustness strategy for PTC" VALUE 0xa00208c9 _REC_S1VAL_20_u1 1. _CNV_S_2_RANGE______3_CM 0. 1. BIT_MASK 0x1 /end CHARACTERISTIC
/begin CHARACTERISTIC Cbx_rbst_thpl_dsb_cfm "Activation of engine robustness strategy for coolant heaters" VALUE 0xa00208ca _REC_S1VAL_20_u1 1. _CNV_S_2_RANGE______3_CM 0. 1. BIT_MASK 0x1 /end CHARACTERISTIC
/begin CHARACTERISTIC Cbx_sta_thpl_dsb_cfm "Activation of engine start strategy for coolant heaters" VALUE 0xa00208cb _REC_S1VAL_20_u1 1. _CNV_S_2_RANGE______3_CM 0. 1. BIT_MASK 0x1 /end CHARACTERISTIC
/begin CHARACTERISTIC Cbx_stal_ac_dsb_cfm "Activation of anti-stall strategy for air conditioning" VALUE 0xa00208cc _REC_S1VAL_20_u1 1. _CNV_S_2_RANGE______3_CM 0. 1. BIT_MASK 0x1 /end CHARACTERISTIC
/begin CHARACTERISTIC Cbx_stal_ac_max_tq_prop_cfm "Proportional torque limitation configuration in anti-stall strategy" VALUE 0xa00208cd _REC_S1VAL_20_u1 1. _CNV_S_2_RANGE______3_CM 0. 1. BIT_MASK 0x1 /end CHARACTERISTIC
/begin CHARACTERISTIC Cbx_stal_alt_dsb_cfm "Activation of anti-stall strategy for alternator" VALUE 0xa00208ce _REC_S1VAL_20_u1 1. _CNV_S_2_RANGE______3_CM 0. 1. BIT_MASK 0x1 /end CHARACTERISTIC
/begin CHARACTERISTIC Cbx_stal_ptc_dsb_cfm "Activation of anti-stall strategy for PTC" VALUE 0xa00208cf _REC_S1VAL_20_u1 1. _CNV_S_2_RANGE______3_CM 0. 1. BIT_MASK 0x1 /end CHARACTERISTIC
/begin CHARACTERISTIC Cbx_stal_thpl_dsb_cfm "Activation of anti-stall strategy for coolant heaters" VALUE 0xa00208d0 _REC_S1VAL_20_u1 1. _CNV_S_2_RANGE______3_CM 0. 1. BIT_MASK 0x1 /end CHARACTERISTIC
/begin CHARACTERISTIC Cbx_tkof_ac_dsb_cfm "Activation of takeoff strategy for air conditioning" VALUE 0xa00208d1 _REC_S1VAL_20_u1 1. _CNV_S_2_RANGE______3_CM 0. 1. BIT_MASK 0x1 /end CHARACTERISTIC
/begin CHARACTERISTIC Cbx_tkof_acs_dsb_rwhs_cfm "Rear wheel speed configuration in takeoff vehicle speed calculation" VALUE 0xa00208d2 _REC_S1VAL_20_u1 1. _CNV_S_2_RANGE______3_CM 0. 1. BIT_MASK 0x1 /end CHARACTERISTIC
/begin CHARACTERISTIC Cbx_tkof_alt_dsb_cfm "Activation of takeoff strategy for alternator" VALUE 0xa00208d3 _REC_S1VAL_20_u1 1. _CNV_S_2_RANGE______3_CM 0. 1. BIT_MASK 0x1 /end CHARACTERISTIC
/begin CHARACTERISTIC Cbx_tkof_ptc_dsb_cfm "Activation of takeoff strategy for PTC" VALUE 0xa00208d4 _REC_S1VAL_20_u1 1. _CNV_S_2_RANGE______3_CM 0. 1. BIT_MASK 0x1 /end CHARACTERISTIC
/begin CHARACTERISTIC Cbx_tkof_thpl_dsb_cfm "Activation of takeoff strategy for coolant heaters" VALUE 0xa00208d5 _REC_S1VAL_20_u1 1. _CNV_S_2_RANGE______3_CM 0. 1. BIT_MASK 0x1 /end CHARACTERISTIC
/begin CHARACTERISTIC Cxx_acel_is_ac_dsb_dly "Minimum duration on accelerated idle speed before authorizing air conditioning compressor clutching" VALUE 0xa0020878 _REC_S1VAL_20_u2 655.35 _CNV_A_R_LINEAR_____34_CM 0. 655.35 FORMAT "%6.2" /end CHARACTERISTIC
/begin CHARACTERISTIC Cxx_acel_is_ac_dsb_rat "Accelerated idle speed ratio to authorize air conditioning compressor clutching" VALUE 0xa00208d6 _REC_S1VAL_20_u1 1. _CNV_A_R_LINEAR_____216_CM 0. 1. FORMAT "%5.3" /end CHARACTERISTIC
/begin CHARACTERISTIC Cxx_acs_amp_dft_val "Atmospheric pressure replacement value in case of invalid atmospheric pressure" VALUE 0xa002087a _REC_S1VAL_20_u2 20000. _CNV_A_R_LINEAR_____57_CM 0. 20000. FORMAT "%5.0" /end CHARACTERISTIC
/begin CHARACTERISTIC Cxx_acs_ena_dly "Minimum duration between accessories reactivations" VALUE 0xa002087c _REC_S1VAL_20_u2 655.35 _CNV_A_R_LINEAR_____34_CM 0. 655.35 FORMAT "%6.2" /end CHARACTERISTIC
/begin CHARACTERISTIC Cxx_alt_min_pow_ena "Alternator maximum power minimum value" VALUE 0xa002087e _REC_S1VAL_20_u2 655350. _CNV_A_R_LINEAR_____128_CM 0. 655350. FORMAT "%6.0" /end CHARACTERISTIC
/begin CHARACTERISTIC Cxx_perf_ac_amp_h_thd "Atmospheric pressure threshold to inhibit performance restitution strategy for air conditioning" VALUE 0xa0020880 _REC_S1VAL_20_u2 20000. _CNV_A_R_LINEAR_____57_CM 0. 20000. FORMAT "%5.0" /end CHARACTERISTIC
/begin CHARACTERISTIC Cxx_perf_ac_amp_l_thd "Atmospheric pressure threshold to activate performance restitution strategy for air conditioning" VALUE 0xa0020882 _REC_S1VAL_20_u2 20000. _CNV_A_R_LINEAR_____57_CM 0. 20000. FORMAT "%5.0" /end CHARACTERISTIC
/begin CHARACTERISTIC Cxx_perf_acs_dsb_dly "Maximum duration of accessories deactivation in performance restitution strategy" VALUE 0xa0020884 _REC_S1VAL_20_u2 655.35 _CNV_A_R_LINEAR_____34_CM 0. 655.35 FORMAT "%6.2" /end CHARACTERISTIC
/begin CHARACTERISTIC Cxx_perf_acs_dsb_h_gear "Maximum gear to request accessories deactivation in performance restitution strategy" VALUE 0xa00208d7 _REC_S1VAL_20_u1 7. _CNV_A_R_LINEAR_____113_CM -1. 6. FORMAT "%4.0" /end CHARACTERISTIC
/begin CHARACTERISTIC Cxx_perf_acs_dsb_l_gear "Minimum gear to request accessories deactivation in performance restitution strategy" VALUE 0xa00208d8 _REC_S1VAL_20_u1 7. _CNV_A_R_LINEAR_____113_CM -1. 6. FORMAT "%4.0" /end CHARACTERISTIC
/begin CHARACTERISTIC Cxx_perf_acs_dsb_n "Maximum engine speed to request accessories deactivation in preformance restitution strategy" VALUE 0xa0020886 _REC_S1VAL_20_u2 16383.75 _CNV_A_R_ENSD_LINEA_24_CM 0. 16383.75 FORMAT "%8.2" /end CHARACTERISTIC
/begin CHARACTERISTIC Cxx_perf_acs_dsb_pdl_grd "Minimum accelerator pedal gradient to request accessories deactivation in performance restitution strategy" VALUE 0xa0020888 _REC_S1VAL_20_s2 127.998046875 _CNV_A_R_LINEAR_____284_CM -64. 63.998046875 FORMAT "%7.3" /end CHARACTERISTIC
/begin CHARACTERISTIC Cxx_perf_acs_dsb_pdl_grd_t "Time constant of accelerator pedal gradient filter" VALUE 0xa00208d9 _REC_S1VAL_20_u1 2.55 _CNV_A_R_LINEAR_____34_CM 0. 2.55 FORMAT "%4.2" /end CHARACTERISTIC
/begin CHARACTERISTIC Cxx_perf_acs_dsb_pdl_rat "Minimum accelerator pedal position to request accessories deactivation in performance restitution strategy" VALUE 0xa002088a _REC_S1VAL_20_u2 1.25 _CNV_A_R_LINEAR_____257_CM 0. 1.25 FORMAT "%8.5" /end CHARACTERISTIC
/begin CHARACTERISTIC Cxx_perf_acs_dsb_tqe_dif "Maximum available torques difference to request accessories deactivation in performance restitution strategy" VALUE 0xa002088c _REC_S1VAL_20_u2 2047.96875 _CNV_A_R_LINEAR_____161_CM -400. 1647.96875 FORMAT "%10.5" /end CHARACTERISTIC
/begin CHARACTERISTIC Cxx_perf_acs_ena_n "Minimum engine speed to request accessories reactivation in performance restitution strategy" VALUE 0xa002088e _REC_S1VAL_20_u2 16383.75 _CNV_A_R_ENSD_LINEA_24_CM 0. 16383.75 FORMAT "%8.2" /end CHARACTERISTIC
/begin CHARACTERISTIC Cxx_perf_acs_ena_pdl_rat "Maximum accelerator pedal position to request accessories reactivation in performance restitution strategy" VALUE 0xa0020890 _REC_S1VAL_20_u2 1.25 _CNV_A_R_LINEAR_____257_CM 0. 1.25 FORMAT "%8.5" /end CHARACTERISTIC
/begin CHARACTERISTIC Cxx_rbst_el_csm_dsb_gear_dly "Turnoff delay on gear condition in engine robustness strategy" VALUE 0xa0020892 _REC_S1VAL_20_u2 655.35 _CNV_A_R_LINEAR_____34_CM 0. 655.35 FORMAT "%6.2" /end CHARACTERISTIC
/begin CHARACTERISTIC Cxx_rbst_el_csm_dsb_n "Engine speed threshold to request electrical consumers deactivation in engine robustness strategy" VALUE 0xa0020894 _REC_S1VAL_20_u2 16383.75 _CNV_A_R_ENSD_LINEA_24_CM 0. 16383.75 FORMAT "%8.2" /end CHARACTERISTIC
/begin CHARACTERISTIC Cxx_rbst_el_csm_dsb_tco_hys "Engine coolant temperature hysteresis in engine robustness strategy" VALUE 0xa0020896 _REC_S1VAL_20_u2 240. _CNV_A_R_LINEAR_____54_CM -40. 200. FORMAT "%5.1" /end CHARACTERISTIC
/begin CHARACTERISTIC Cxx_rbst_el_csm_ena_n "Engine speed threshold to request electrical consumers reactivation in engine robustness strategy" VALUE 0xa0020898 _REC_S1VAL_20_u2 16383.75 _CNV_A_R_ENSD_LINEA_24_CM 0. 16383.75 FORMAT "%8.2" /end CHARACTERISTIC
/begin CHARACTERISTIC Cxx_stal_ac_max_tq_d "Air conditioning maximum torque derivative factor in anti-stall strategy" VALUE 0xa002089a _REC_S1VAL_20_u2 3.99993896484375 _CNV_A_R_LINEAR_____285_CM 0. 3.99993896484375 FORMAT "%7.5" /end CHARACTERISTIC
/begin CHARACTERISTIC Cxx_stal_ac_max_tq_dft_val "Air conditioning maximum torque default value in anti-stall strategy" VALUE 0xa002089c _REC_S1VAL_20_u2 2047.96875 _CNV_A_R_LINEAR_____123_CM 0. 2047.96875 FORMAT "%10.5" /end CHARACTERISTIC
/begin CHARACTERISTIC Cxx_stal_ac_max_tq_p "Air conditioning maximum torque proportional factor in anti-stall strategy" VALUE 0xa002089e _REC_S1VAL_20_u2 7.9998779296875 _CNV_A_R_LINEAR_____286_CM 0. 7.9998779296875 FORMAT "%6.4" /end CHARACTERISTIC
/begin CHARACTERISTIC Cxx_stal_ac_max_tq_ref "Air conditioning reference torque in anti-stall strategy" VALUE 0xa00208a0 _REC_S1VAL_20_u2 2047.96875 _CNV_A_R_LINEAR_____123_CM 0. 2047.96875 FORMAT "%10.5" /end CHARACTERISTIC
/begin CHARACTERISTIC Cxx_stal_ac_max_tq_slop "Air conditioning maximum torque slew rate in anti-stall strategy" VALUE 0xa00208da _REC_S1VAL_20_u1 127.5 _CNV_A_R_LINEAR_____287_CM 0. 127.5 FORMAT "%5.1" /end CHARACTERISTIC
/begin CHARACTERISTIC Cxx_stal_ac_max_tq_thd "Air conditioning maximum torque threshold in anti-stall strategy" VALUE 0xa00208a2 _REC_S1VAL_20_u2 2047.96875 _CNV_A_R_LINEAR_____123_CM 0. 2047.96875 FORMAT "%10.5" /end CHARACTERISTIC
/begin CHARACTERISTIC Cxx_stal_acs_dsb_dly "Minimum duration before leaving stalling states in anti-stall strategy" VALUE 0xa00208a4 _REC_S1VAL_20_u2 655.35 _CNV_A_R_LINEAR_____34_CM 0. 655.35 FORMAT "%6.2" /end CHARACTERISTIC
/begin CHARACTERISTIC Cxx_stal_alt_ac_amp_h_thd "Atmospheric pressure threshold to inhibit anti-stall strategy for alternator and air conditioning" VALUE 0xa00208a6 _REC_S1VAL_20_u2 20000. _CNV_A_R_LINEAR_____57_CM 0. 20000. FORMAT "%5.0" /end CHARACTERISTIC
/begin CHARACTERISTIC Cxx_stal_alt_ac_amp_l_thd "Atmospheric pressure threshold to activate anti-stall strategy for alternator and air conditioning" VALUE 0xa00208a8 _REC_S1VAL_20_u2 20000. _CNV_A_R_LINEAR_____57_CM 0. 20000. FORMAT "%5.0" /end CHARACTERISTIC
/begin CHARACTERISTIC Cxx_tkof_acs_dsb_coup_dly "Turnoff delay on coupler state in takeoff strategy" VALUE 0xa00208aa _REC_S1VAL_20_u2 655.35 _CNV_A_R_LINEAR_____34_CM 0. 655.35 FORMAT "%6.2" /end CHARACTERISTIC
/begin CHARACTERISTIC Cxx_tkof_acs_dsb_dly "Maximum duration of accessories deactivation in takeoff strategy" VALUE 0xa00208ac _REC_S1VAL_20_u2 655.35 _CNV_A_R_LINEAR_____34_CM 0. 655.35 FORMAT "%6.2" /end CHARACTERISTIC
/begin CHARACTERISTIC Cxx_tkof_acs_dsb_n "Minimum engine speed to request accessories deactivation in takeoff strategy" VALUE 0xa00208ae _REC_S1VAL_20_u2 16383.75 _CNV_A_R_ENSD_LINEA_24_CM 0. 16383.75 FORMAT "%8.2" /end CHARACTERISTIC
/begin CHARACTERISTIC Cxx_tkof_acs_dsb_pwt_sp "Minimum driver powertrain setpoint to request accessories deactivation in takeoff strategy" VALUE 0xa00208b0 _REC_S1VAL_20_u2 1. _CNV_A_R_LINEAR_____257_CM 0. 1. FORMAT "%8.5" /end CHARACTERISTIC
/begin CHARACTERISTIC Cxx_tkof_acs_dsb_rwhs_t "Time constant of vehicle speed filter in rear wheel speed configuration" VALUE 0xa00208db _REC_S1VAL_20_u1 2.55 _CNV_A_R_LINEAR_____34_CM 0. 2.55 FORMAT "%4.2" /end CHARACTERISTIC
/begin CHARACTERISTIC Cxx_tkof_acs_dsb_tqe_sp_rat "Minimum driver torque/maximum torque ratio to request accessories deactivation in takeoff strategy" VALUE 0xa00208b2 _REC_S1VAL_20_u2 255.99609375 _CNV_A_R_LINEAR_____31_CM 0. 255.99609375 FORMAT "%10.6" /end CHARACTERISTIC
/begin CHARACTERISTIC Cxx_tkof_acs_dsb_vs "Maximum vehicle speed to request accessories deactivation in takeoff strategy" VALUE 0xa00208b4 _REC_S1VAL_20_u2 655.35 _CNV_A_R_LINEAR_____70_CM 0. 655.35 FORMAT "%6.2" /end CHARACTERISTIC
/begin CHARACTERISTIC Cxx_tkof_acs_dsb_vs_pos_slop "Maximum vehicle acceleration on takeoff" VALUE 0xa00208dc _REC_S1VAL_20_u1 255. _CNV_A_R_LINEAR_____288_CM 0. 255. FORMAT "%3.0" /end CHARACTERISTIC
/begin CHARACTERISTIC Cxx_tkof_acs_ena_pwt_sp "Maximum driver powertrain setpoint to request accessories reactivation in takeoff strategy" VALUE 0xa00208b6 _REC_S1VAL_20_u2 1. _CNV_A_R_LINEAR_____257_CM 0. 1. FORMAT "%8.5" /end CHARACTERISTIC
/begin CHARACTERISTIC Cxx_tkof_acs_ena_vs "Minimum vehicle speed to request accessories reactivation in takeoff strategy" VALUE 0xa00208b8 _REC_S1VAL_20_u2 655.35 _CNV_A_R_LINEAR_____70_CM 0. 655.35 FORMAT "%6.2" /end CHARACTERISTIC
/begin CHARACTERISTIC Cxx_tkof_acs_ena_zero_vs "Vehicle speed (0 km/h) to prevent accessories deactivation on no-load accelerations in takeoff strategy" VALUE 0xa00208ba _REC_S1VAL_20_u2 655.35 _CNV_A_R_LINEAR_____70_CM 0. 655.35 FORMAT "%6.2" /end CHARACTERISTIC
/begin CHARACTERISTIC Cxx_tkof_alt_ac_amp_h_thd "Atmospheric pressure threshold to inhibit takeoff strategy for alternator and air conditioning" VALUE 0xa00208bc _REC_S1VAL_20_u2 20000. _CNV_A_R_LINEAR_____57_CM 0. 20000. FORMAT "%5.0" /end CHARACTERISTIC
/begin CHARACTERISTIC Cxx_tkof_alt_ac_amp_l_thd "Atmospheric pressure threshold to activate takeoff strategy for alternator and air conditioning" VALUE 0xa00208be _REC_S1VAL_20_u2 20000. _CNV_A_R_LINEAR_____57_CM 0. 20000. FORMAT "%5.0" /end CHARACTERISTIC
/begin MEASUREMENT Vbx_min_fuel "Filtered minimum fuel level detected" UBYTE _CNV_S_2_RANGE______3_CM 1 0. 0. 1. ECU_ADDRESS 0xd0004997 BIT_MASK 0x1 /end MEASUREMENT
/begin MEASUREMENT Vsx_min_fuel_vld "Minimum fuel level validity status" UBYTE _CNV_S_3_STATUS_OK__120_CM 1 0. 0. 2. ECU_ADDRESS 0xd0004998 /end MEASUREMENT
/begin MEASUREMENT Vxx_min_fuel_dly "Temporization for the validation of minimum gas tank level" UWORD _CNV_A_R_LINEAR_____34_CM 1 0. 0. 655.35 ECU_ADDRESS 0xd00059ca FORMAT "%6.2" /end MEASUREMENT
/begin CHARACTERISTIC Cxx_min_fuel_dly "Minimum duration for the validation of minimum gas tank level" VALUE 0xa0021adc _REC_S1VAL_20_u2 655.35 _CNV_A_R_LINEAR_____34_CM 0. 655.35 FORMAT "%6.2" /end CHARACTERISTIC
/begin CHARACTERISTIC Cxx_no_min_fuel_dly "Minimum duration for the devalidation of minimum gas tank level" VALUE 0xa0021ade _REC_S1VAL_20_u2 655.35 _CNV_A_R_LINEAR_____34_CM 0. 655.35 FORMAT "%6.2" /end CHARACTERISTIC
/begin MEASUREMENT Vxx_pump_tql "pump torque losses" UWORD _CNV_A_R_LINEAR_____123_CM 1 0. 0. 2047.96875 ECU_ADDRESS 0xd00059b4 FORMAT "%10.5" /end MEASUREMENT
/begin AXIS_PTS Ctb_alt_n_fil_fac "Engine speed breakpoints to filter alternator torque and power" 0xa002db10 Vxx_n_mv _REC_A2AXS_20_u2 16383.75 _CNV_A_R_ENSD_LINEA_24_CM 8 0. 16383.75 FORMAT "%8.2" /end AXIS_PTS
/begin AXIS_PTS Ctb_alt_pow "Alternator power breakpoints" 0xa002db24 Vxx_no_cor_raw_alt_pow _REC_A2AXS_20_u2 655350. _CNV_A_R_LINEAR_____128_CM 9 0. 655350. FORMAT "%6.0" /end AXIS_PTS
/begin AXIS_PTS Ctb_alt_pow_cor_n "Engine speed breakpoints for alternator power correction" 0xa002db38 Vxx_n_mv _REC_A2AXS_20_u2 16383.75 _CNV_A_R_ENSD_LINEA_24_CM 9 0. 16383.75 FORMAT "%8.2" /end AXIS_PTS
/begin CHARACTERISTIC Cmp_alt_pow_cor_val "Cartography to compute alternator power corrected value" MAP 0xa002db4c _REC_A1MAP_20_u2_u2_u2 655350. _CNV_A_R_LINEAR_____128_CM 0. 655350. FORMAT "%6.0"
 /begin AXIS_DESCR COM_AXIS Vxx_no_cor_raw_alt_pow _CNV_A_R_LINEAR_____128_CM 9 0. 655350. FORMAT "%6.0" AXIS_PTS_REF Ctb_alt_pow /end AXIS_DESCR
 /begin AXIS_DESCR COM_AXIS Vxx_n_mv _CNV_A_R_ENSD_LINEA_24_CM 9 0. 16383.75 FORMAT "%8.2" AXIS_PTS_REF Ctb_alt_pow_cor_n /end AXIS_DESCR
/end CHARACTERISTIC
/begin CHARACTERISTIC Ctp_alt_pow_fil_fac "filter factor for alternator power" CURVE 0xa002dbf0 _REC_A1CUR_20_u2_u2 1. _CNV_A_R_LINEAR_____108_CM 0. 1. FORMAT "%5.3"
 /begin AXIS_DESCR COM_AXIS Vxx_n_mv _CNV_A_R_ENSD_LINEA_24_CM 8 0. 16383.75 FORMAT "%8.2" AXIS_PTS_REF Ctb_alt_n_fil_fac /end AXIS_DESCR
/end CHARACTERISTIC
/begin MEASUREMENT Vbx_alt_pow_trs "Alternator power transitional detection" UBYTE _CNV_S_2_RANGE______3_CM 1 0. 0. 1. ECU_ADDRESS 0xd0005539 BIT_MASK 0x1 /end MEASUREMENT
/begin MEASUREMENT Vsx_alt_pow_vld "Alternator mechanical power validity status" UBYTE _CNV_S_3_STATUS_OK__120_CM 1 0. 0. 2. ECU_ADDRESS 0xd000553a /end MEASUREMENT
/begin MEASUREMENT Vsx_fil_alt_pow_vld "Filtered  Alternator torque load validity status" UBYTE _CNV_S_3_STATUS_OK__120_CM 1 0. 0. 2. ECU_ADDRESS 0xd0004843 /end MEASUREMENT
/begin MEASUREMENT Vxx_alt_pow "Alternator mechanical power" UWORD _CNV_A_R_LINEAR_____128_CM 1 0. 0. 655350. ECU_ADDRESS 0xd0005a8c FORMAT "%6.0" /end MEASUREMENT
/begin MEASUREMENT Vxx_alt_pow_fil_fac "Alternator power filtering factor" UWORD _CNV_A_R_LINEAR_____108_CM 1 0. 0. 1. ECU_ADDRESS 0xd0005a8e FORMAT "%5.3" /end MEASUREMENT
/begin MEASUREMENT Vxx_alt_pow_load "Alternator power load" UWORD _CNV_A_R_LINEAR_____128_CM 1 0. 0. 655350. ECU_ADDRESS 0xd0005a90 FORMAT "%6.0" /end MEASUREMENT
/begin MEASUREMENT Vxx_fil_alt_pow "Filtered alternator mechanical power" UWORD _CNV_A_R_LINEAR_____128_CM 1 0. 0. 655350. ECU_ADDRESS 0xd00033ac FORMAT "%6.0" /end MEASUREMENT
/begin MEASUREMENT Vxx_fil_alt_pow_load_trs "Alternator filtered power used for transitional detection" UWORD _CNV_A_R_LINEAR_____128_CM 1 0. 0. 655350. ECU_ADDRESS 0xd0005a92 FORMAT "%6.0" /end MEASUREMENT
/begin MEASUREMENT Vxx_no_cor_raw_alt_pow "Not corrected alternator power" UWORD _CNV_A_R_LINEAR_____128_CM 1 0. 0. 655350. ECU_ADDRESS 0xd00033ae FORMAT "%6.0" /end MEASUREMENT
/begin CHARACTERISTIC Cxx_alt_pow_dsb_fil_fac "Value when the 1st filter is disabled" VALUE 0xa0021ce2 _REC_S1VAL_20_u2 1. _CNV_A_R_LINEAR_____108_CM 0. 1. FORMAT "%5.3" /end CHARACTERISTIC
/begin CHARACTERISTIC Cxx_alt_pow_trs_dif_thd "Alternator power transitional detection threshold" VALUE 0xa0021ce4 _REC_S1VAL_20_u2 655350. _CNV_A_R_LINEAR_____128_CM 0. 655350. FORMAT "%6.0" /end CHARACTERISTIC
/begin CHARACTERISTIC Cxx_alt_pow_trs_fil_dec "Filtering factor used to detect a decreasing alternator power value" VALUE 0xa0021ce6 _REC_S1VAL_20_u2 1. _CNV_A_R_LINEAR_____108_CM 0. 1. FORMAT "%5.3" /end CHARACTERISTIC
/begin CHARACTERISTIC Cxx_alt_pow_trs_fil_inc "Filtering factor used to detect an increasing alternator power value" VALUE 0xa0021ce8 _REC_S1VAL_20_u2 1. _CNV_A_R_LINEAR_____108_CM 0. 1. FORMAT "%5.3" /end CHARACTERISTIC
/begin CHARACTERISTIC Cxx_alt_slop_dly "Alternator power ramp on initialisation" VALUE 0xa0021cea _REC_S1VAL_20_u2 655.35 _CNV_A_R_LINEAR_____34_CM 0. 655.35 FORMAT "%6.2" /end CHARACTERISTIC
/begin CHARACTERISTIC Cxx_sta_alt_dec "Alternator power min slew rate after start" VALUE 0xa0021cec _REC_S1VAL_20_u1 2550. _CNV_A_R_LINEAR_____289_CM -2550. 0. FORMAT "%5.0" /end CHARACTERISTIC
/begin CHARACTERISTIC Cxx_sta_alt_inc "Alternator power max slew rate after start" VALUE 0xa0021ced _REC_S1VAL_20_u1 2550. _CNV_A_R_LINEAR_____290_CM 0. 2550. FORMAT "%5.0" /end CHARACTERISTIC
/begin MEASUREMENT Vsx_mdl_alt_pow_vld "Modelised alternator power validity status" UBYTE _CNV_A_R_ECME_LINEA_0_CM 1 0. 0. 255. ECU_ADDRESS 0xd0005302 FORMAT "%3.0" /end MEASUREMENT
/begin MEASUREMENT Vxx_mdl_alt_pow "Modelised alternator power calculated through lrotor" UWORD _CNV_A_R_LINEAR_____128_CM 1 0. 0. 655350. ECU_ADDRESS 0xd0005ab0 FORMAT "%6.0" /end MEASUREMENT
/begin AXIS_PTS Ctb_ac_pow "Air conditioning power breakpoints" 0xa002bd3c Vxx_no_cor_raw_ac_pow _REC_A2AXS_20_u2 655350. _CNV_A_R_LINEAR_____128_CM 9 0. 655350. FORMAT "%6.0" /end AXIS_PTS
/begin AXIS_PTS Ctb_ac_pow_cor_n "Air conditioning power breakpoints" 0xa002bd50 Vxx_n _REC_A2AXS_20_u2 16383.75 _CNV_A_R_ENSD_LINEA_24_CM 9 0. 16383.75 FORMAT "%8.2" /end AXIS_PTS
/begin CHARACTERISTIC Cmp_ac_pow_cor_val "Cartography to compute air conditioning power corrected value" MAP 0xa002bd64 _REC_A1MAP_20_u2_u2_u2 655350. _CNV_A_R_LINEAR_____128_CM 0. 655350. FORMAT "%6.0"
 /begin AXIS_DESCR COM_AXIS Vxx_no_cor_raw_ac_pow _CNV_A_R_LINEAR_____128_CM 9 0. 655350. FORMAT "%6.0" AXIS_PTS_REF Ctb_ac_pow /end AXIS_DESCR
 /begin AXIS_DESCR COM_AXIS Vxx_n _CNV_A_R_ENSD_LINEA_24_CM 9 0. 16383.75 FORMAT "%8.2" AXIS_PTS_REF Ctb_ac_pow_cor_n /end AXIS_DESCR
/end CHARACTERISTIC
/begin CHARACTERISTIC Ctp_ac_pow_dft_val "Cartography to compute air conditioning power default value" CURVE 0xa002be08 _REC_A1CUR_20_u2_u2 655350. _CNV_A_R_LINEAR_____128_CM 0. 655350. FORMAT "%6.0"
 /begin AXIS_DESCR COM_AXIS Vxx_n _CNV_A_R_ENSD_LINEA_24_CM 9 0. 16383.75 FORMAT "%8.2" AXIS_PTS_REF Ctb_n2 /end AXIS_DESCR
/end CHARACTERISTIC
/begin MEASUREMENT Vxx_ac_pow "Air conditioning absorbed power (compressor)" UWORD _CNV_A_R_LINEAR_____128_CM 1 0. 0. 655350. ECU_ADDRESS 0xd00030b6 FORMAT "%6.0" /end MEASUREMENT
/begin MEASUREMENT Vxx_no_cor_raw_ac_pow "Not corrected air conditioning power" UWORD _CNV_A_R_LINEAR_____128_CM 1 0. 0. 655350. ECU_ADDRESS 0xd00030b8 FORMAT "%6.0" /end MEASUREMENT
/begin MEASUREMENT Vxx_raw_ac_pow "Air conditioning power not taking into account compressor state" UWORD _CNV_A_R_LINEAR_____128_CM 1 0. 0. 655350. ECU_ADDRESS 0xd00030ba FORMAT "%6.0" /end MEASUREMENT
/begin MEASUREMENT Vsx_mdl_ac_pow_vld "Air conditioning power received from model validity status" UBYTE _CNV_S_3_STATUS_OK__120_CM 1 0. 0. 2. ECU_ADDRESS 0xd000439e /end MEASUREMENT
/begin MEASUREMENT Vxx_mdl_ac_pow "Air conditioning power received from model" UWORD _CNV_A_R_LINEAR_____128_CM 1 0. 0. 655350. ECU_ADDRESS 0xd0002eb4 FORMAT "%6.0" /end MEASUREMENT
/begin CHARACTERISTIC Cxx_ac_pow_max "Maximum AC absorbed power" VALUE 0xa002156a _REC_S1VAL_20_u2 655350. _CNV_A_R_LINEAR_____128_CM 0. 655350. FORMAT "%6.0" /end CHARACTERISTIC
/begin CHARACTERISTIC Cxx_ac_pow_min "Minimum AC absorbed power" VALUE 0xa002156c _REC_S1VAL_20_u2 655350. _CNV_A_R_LINEAR_____128_CM 0. 655350. FORMAT "%6.0" /end CHARACTERISTIC
/begin CHARACTERISTIC Cxx_ac_pow_n_fac "B coefficient to calculate the AC absorbed power" VALUE 0xa002156e _REC_S1VAL_20_u2 4.99992370605469 _CNV_A_R_LINEAR_____291_CM 0. 4.99992370605469 FORMAT "%1.16" /end CHARACTERISTIC
/begin CHARACTERISTIC Cxx_ac_pow_prs_fac "A coefficient to calculate the AC absorbed power" VALUE 0xa0021570 _REC_S1VAL_20_u2 6553.5 _CNV_A_R_LINEAR_____292_CM 0. 6553.5 FORMAT "%6.1" /end CHARACTERISTIC
/begin CHARACTERISTIC Cxx_ac_pow_prs_n_fac "C coefficient to calculate the AC absorbed power" VALUE 0xa0021572 _REC_S1VAL_20_u2 4.99992370605469 _CNV_A_R_LINEAR_____293_CM 0. 4.99992370605469 FORMAT "%1.16" /end CHARACTERISTIC
/begin CHARACTERISTIC Cxx_acr_eng_fac "Compressor driving ratio (on engine)" VALUE 0xa0021574 _REC_S1VAL_20_u1 2.55 _CNV_A_R_LINEAR_____136_CM 0. 2.55 FORMAT "%4.2" /end CHARACTERISTIC
/begin MEASUREMENT Vxx_el_csm_mdl_pow "Electrical consumer modelised power" UWORD _CNV_A_R_LINEAR_____128_CM 1 0. 0. 655350. ECU_ADDRESS 0xd00032a2 FORMAT "%6.0" /end MEASUREMENT
/begin CHARACTERISTIC Cxx_alt_is_meca_pow "Alternator idle speed mechanical power" VALUE 0xa0020772 _REC_S1VAL_20_u2 655350. _CNV_A_R_LINEAR_____128_CM 0. 655350. FORMAT "%6.0" /end CHARACTERISTIC
/begin CHARACTERISTIC Cxx_el_bk_wind_meca_pow "Electric backlite mechanical power" VALUE 0xa0020774 _REC_S1VAL_20_u2 655350. _CNV_A_R_LINEAR_____128_CM 0. 655350. FORMAT "%6.0" /end CHARACTERISTIC
/begin CHARACTERISTIC Cxx_el_wind_meca_pow "Electrical windshield mechanical power" VALUE 0xa0020776 _REC_S1VAL_20_u2 655350. _CNV_A_R_LINEAR_____128_CM 0. 655350. FORMAT "%6.0" /end CHARACTERISTIC
/begin CHARACTERISTIC Cxx_eng_loss_pow_min "Minimum mechanical power due to electrical consumers" VALUE 0xa0020778 _REC_S1VAL_20_u2 655350. _CNV_A_R_LINEAR_____128_CM 0. 655350. FORMAT "%6.0" /end CHARACTERISTIC
/begin CHARACTERISTIC Cxx_mdf1_meca_pow "Power consumed by cooling fan moving in first speed" VALUE 0xa002077a _REC_S1VAL_20_u2 655350. _CNV_A_R_LINEAR_____128_CM 0. 655350. FORMAT "%6.0" /end CHARACTERISTIC
/begin CHARACTERISTIC Cxx_mdf2_meca_pow "Power consumed by cooling fan moving in second speed" VALUE 0xa002077c _REC_S1VAL_20_u2 655350. _CNV_A_R_LINEAR_____128_CM 0. 655350. FORMAT "%6.0" /end CHARACTERISTIC
/begin CHARACTERISTIC Cxx_rgb_pump_meca_pow "Robotized gearbox electro hydraulical pump mechanical power" VALUE 0xa002077e _REC_S1VAL_20_u2 655350. _CNV_A_R_LINEAR_____128_CM 0. 655350. FORMAT "%6.0" /end CHARACTERISTIC
/begin MEASUREMENT Vxx_ptc_pow "PTC power consumed" UWORD _CNV_A_R_LINEAR_____128_CM 1 0. 0. 655350. ECU_ADDRESS 0xd00059bc FORMAT "%6.0" /end MEASUREMENT
/begin AXIS_PTS Ctb_ac_pow_cor "Breakpoints to compute air conditioning power correction" 0xa0025a7c Vxx_raw_ac_pow _REC_A2AXS_20_u2 655350. _CNV_A_R_LINEAR_____128_CM 9 0. 655350. FORMAT "%6.0" /end AXIS_PTS
/begin CHARACTERISTIC Ctp_ac_pow_cor "Cartography to compute air conditioning power correction" CURVE 0xa0025a90 _REC_A1CUR_20_u2_u2 655350. _CNV_A_R_LINEAR_____128_CM 0. 655350. FORMAT "%6.0"
 /begin AXIS_DESCR COM_AXIS Vxx_raw_ac_pow _CNV_A_R_LINEAR_____128_CM 9 0. 655350. FORMAT "%6.0" AXIS_PTS_REF Ctb_ac_pow_cor /end AXIS_DESCR
/end CHARACTERISTIC
/begin MEASUREMENT Vxx_ac_pow_cor "Air conditioning power correction for idle speed regulation" UWORD _CNV_A_R_LINEAR_____128_CM 1 0. 0. 655350. ECU_ADDRESS 0xd0003a8e FORMAT "%6.0" /end MEASUREMENT
/begin CHARACTERISTIC Cxx_ac_pow_cor_dly "Air conditioning power correction slope" VALUE 0xa0020a3a _REC_S1VAL_20_u2 655.35 _CNV_A_R_LINEAR_____34_CM 0. 655.35 FORMAT "%6.2" /end CHARACTERISTIC
/begin CHARACTERISTIC Cxx_ac_pow_cor_slop "Duration of air conditioning power correction before decrementation" VALUE 0xa0020a3c _REC_S1VAL_20_u2 655350. _CNV_A_R_LINEAR_____290_CM 0. 655350. FORMAT "%6.0" /end CHARACTERISTIC
/begin AXIS_PTS Ctb_n "20 programmable engine speed breakpoints map" 0xa00250e0 Vxx_n _REC_A2AXS_20_u2 16383.75 _CNV_A_R_ENSD_LINEA_24_CM 20 0. 16383.75 FORMAT "%8.2" /end AXIS_PTS
/begin AXIS_PTS Ctb_n2 "9 programmable engine speed breakpoints table" 0xa002510c Vxx_n _REC_A2AXS_20_u2 16383.75 _CNV_A_R_ENSD_LINEA_24_CM 9 0. 16383.75 FORMAT "%8.2" /end AXIS_PTS
/begin AXIS_PTS Ctb_coup "Breakpoint calibration of transmission coupler states" 0xa0021470 Vxx_ant_coup _REC_A2AXS_20_u1 255. _CNV_A_R_ECME_LINEA_0_CM 3 0. 255. FORMAT "%3.0" /end AXIS_PTS
/begin AXIS_PTS Ntb_gear "Gearbox ratio breakpoint" 0xa002ac48 Vxx_gear _REC_A2AXS_20_u1 7. _CNV_A_R_LINEAR_____113_CM 8 -1. 6. READ_ONLY FORMAT "%2.0" /end AXIS_PTS
/begin COMPU_METHOD _CNV_A_R_ECME_LINEA_0_CM "" RAT_FUNC "%6.3" "-" COEFFS 0 1. 0. 0 0 1 /end COMPU_METHOD
/begin COMPU_METHOD _CNV_S_2_RANGE______3_CM "" TAB_VERB "%6.3" "-" COMPU_TAB_REF _CNV_S_2_RANGE______3 /end COMPU_METHOD
/begin COMPU_VTAB _CNV_S_2_RANGE______3 "" TAB_VERB 2 0 "0" 1 "1" /end COMPU_VTAB
/begin COMPU_METHOD _CNV_A_R_LINEAR_____4_CM "" RAT_FUNC "%6.3" "s" COEFFS 0 10. 0. 0 0 1 /end COMPU_METHOD
/begin COMPU_METHOD _CNV_A_R_LINEAR_____23_CM "" RAT_FUNC "%6.3" "rpm/s" COEFFS 0 1. 0. 0 0 1 /end COMPU_METHOD
/begin COMPU_METHOD _CNV_A_R_ENSD_LINEA_24_CM "" RAT_FUNC "%6.3" "rpm" COEFFS 0 4. 0. 0 0 1 /end COMPU_METHOD
/begin COMPU_METHOD _CNV_A_R_LINEAR_____25_CM "" RAT_FUNC "%6.3" "∞CRK" COEFFS 0 2.666666666666667 0. 0 0 1 /end COMPU_METHOD
/begin COMPU_METHOD _CNV_A_R_LINEAR_____31_CM "" RAT_FUNC "%6.3" "-" COEFFS 0 256. 0. 0 0 1 /end COMPU_METHOD
/begin COMPU_METHOD _CNV_A_R_LINEAR_____34_CM "" RAT_FUNC "%6.3" "s" COEFFS 0 100. 0. 0 0 1 /end COMPU_METHOD
/begin COMPU_METHOD _CNV_A_R_LINEAR_____43_CM "" RAT_FUNC "%6.3" "-" COEFFS 0 128. 0. 0 0 1 /end COMPU_METHOD
/begin COMPU_METHOD _CNV_A_R_LINEAR_____52_CM "" RAT_FUNC "%6.3" "mV" COEFFS 0 1. 0. 0 0 1 /end COMPU_METHOD
/begin COMPU_METHOD _CNV_A_R_LINEAR_____53_CM "" RAT_FUNC "%6.3" "-" COEFFS 0 16384. 0. 0 0 1 /end COMPU_METHOD
/begin COMPU_METHOD _CNV_A_R_LINEAR_____54_CM "" RAT_FUNC "%6.3" "∞C" COEFFS 0 10. 400. 0 0 1 /end COMPU_METHOD
/begin COMPU_METHOD _CNV_A_R_LINEAR_____55_CM "" RAT_FUNC "%6.3" "TDC" COEFFS 0 1. 0. 0 0 1 /end COMPU_METHOD
/begin COMPU_METHOD _CNV_A_R_LINEAR_____57_CM "" RAT_FUNC "%6.3" "hPa" COEFFS 0 1. 0. 0 0 1 /end COMPU_METHOD
/begin COMPU_METHOD _CNV_A_R_LINEAR_____70_CM "" RAT_FUNC "%6.3" "km/h" COEFFS 0 100. 0. 0 0 1 /end COMPU_METHOD
/begin COMPU_METHOD _CNV_A_R_LINEAR_____83_CM "" RAT_FUNC "%6.3" "mg/stk" COEFFS 0 390.625 0. 0 0 1 /end COMPU_METHOD
/begin COMPU_METHOD _CNV_A_R_LINEAR_____98_CM "" RAT_FUNC "%6.3" "-" COEFFS 0 2048. 0. 0 0 1 /end COMPU_METHOD
/begin COMPU_METHOD _CNV_A_R_LINEAR_____108_CM "" RAT_FUNC "%6.3" "-" COEFFS 0 1000. 0. 0 0 1 /end COMPU_METHOD
/begin COMPU_METHOD _CNV_A_R_LINEAR_____109_CM "" RAT_FUNC "%6.3" "kg/h" COEFFS 0 20. 0. 0 0 1 /end COMPU_METHOD
/begin COMPU_METHOD _CNV_A_R_LINEAR_____113_CM "" RAT_FUNC "%6.3" "-" COEFFS 0 1. 1. 0 0 1 /end COMPU_METHOD
/begin COMPU_METHOD _CNV_S_3_STATUS_OK__120_CM "" TAB_VERB "%6.3" "-" COMPU_TAB_REF _CNV_S_3_STATUS_OK__120 /end COMPU_METHOD
/begin COMPU_VTAB _CNV_S_3_STATUS_OK__120 "" TAB_VERB 3 0 "Nsx_vld_nok_0" 1 "Nsx_vld_ok_1" 2 "Nsx_vld_fail_2" /end COMPU_VTAB
/begin COMPU_METHOD _CNV_A_R_LINEAR_____123_CM "" RAT_FUNC "%6.3" "Nm" COEFFS 0 32. 0. 0 0 1 /end COMPU_METHOD
/begin COMPU_METHOD _CNV_A_R_LINEAR_____125_CM "" RAT_FUNC "%6.3" "-" COEFFS 0 1024. 0. 0 0 1 /end COMPU_METHOD
/begin COMPU_METHOD _CNV_A_R_LINEAR_____127_CM "" RAT_FUNC "%6.3" "Nm" COEFFS 0 32. 32768. 0 0 1 /end COMPU_METHOD
/begin COMPU_METHOD _CNV_A_R_LINEAR_____128_CM "" RAT_FUNC "%6.3" "W" COEFFS 0 0.1 0. 0 0 1 /end COMPU_METHOD
/begin COMPU_METHOD _CNV_A_R_LINEAR_____135_CM "" RAT_FUNC "%6.3" "Nm/rpm" COEFFS 0 8192. 0. 0 0 1 /end COMPU_METHOD
/begin COMPU_METHOD _CNV_A_R_LINEAR_____136_CM "" RAT_FUNC "%6.3" "-" COEFFS 0 100. 0. 0 0 1 /end COMPU_METHOD
/begin COMPU_METHOD _CNV_A_R_LINEAR_____161_CM "" RAT_FUNC "%6.3" "Nm" COEFFS 0 32. 12800. 0 0 1 /end COMPU_METHOD
/begin COMPU_METHOD _CNV_A_R_LINEAR_____166_CM "" RAT_FUNC "%6.3" "mg/stk" COEFFS 0 10. 0. 0 0 1 /end COMPU_METHOD
/begin COMPU_METHOD _CNV_A_R_LINEAR_____175_CM "" RAT_FUNC "%6.3" "-" COEFFS 0 64. 0. 0 0 1 /end COMPU_METHOD
/begin COMPU_METHOD _CNV_A_R_LINEAR_____187_CM "" RAT_FUNC "%6.3" "-" COEFFS 0 128. 128. 0 0 1 /end COMPU_METHOD
/begin COMPU_METHOD _CNV_S_2_STATUS_OK__188_CM "" TAB_VERB "%6.3" "" COMPU_TAB_REF _CNV_S_2_STATUS_OK__188 /end COMPU_METHOD
/begin COMPU_VTAB _CNV_S_2_STATUS_OK__188 "" TAB_VERB 2 0 "Nsx_vld_nok_0" 1 "Nsx_vld_ok_1" /end COMPU_VTAB
/begin COMPU_METHOD _CNV_A_R_LINEAR_____212_CM "" RAT_FUNC "%6.3" "km/h" COEFFS 0 1. 0. 0 0 1 /end COMPU_METHOD
/begin COMPU_METHOD _CNV_A_R_LINEAR_____216_CM "" RAT_FUNC "%6.3" "ratio" COEFFS 0 255. 0. 0 0 1 /end COMPU_METHOD
/begin COMPU_METHOD _CNV_A_R_LINEAR_____234_CM "" RAT_FUNC "%6.3" "Nm/s" COEFFS 0 -1. 0. 0 0 1 /end COMPU_METHOD
/begin COMPU_METHOD _CNV_A_R_LINEAR_____235_CM "" RAT_FUNC "%6.3" "Nm/s" COEFFS 0 1. 0. 0 0 1 /end COMPU_METHOD
/begin COMPU_METHOD _CNV_A_R_LINEAR_____251_CM "" RAT_FUNC "%6.3" "-" COEFFS 0 100. 1000. 0 0 1 /end COMPU_METHOD
/begin COMPU_METHOD _CNV_A_R_LINEAR_____252_CM "" RAT_FUNC "%6.3" "-" COEFFS 0 10. 0. 0 0 1 /end COMPU_METHOD
/begin COMPU_METHOD _CNV_A_R_LINEAR_____257_CM "" RAT_FUNC "%6.3" "ratio" COEFFS 0 800. 0. 0 0 1 /end COMPU_METHOD
/begin COMPU_METHOD _CNV_A_R_LINEAR_____260_CM "" RAT_FUNC "%6.3" "-" COEFFS 0 256. 128. 0 0 1 /end COMPU_METHOD
/begin COMPU_METHOD _CNV_A_R_LINEAR_____262_CM "" RAT_FUNC "%6.3" "mg/stk" COEFFS 0 12.20703125 0. 0 0 1 /end COMPU_METHOD
/begin COMPU_METHOD _CNV_S_4_RANGE_STAT_266_CM "" TAB_VERB "%6.3" "-" COMPU_TAB_REF _CNV_S_4_RANGE_STAT_266 /end COMPU_METHOD
/begin COMPU_VTAB _CNV_S_4_RANGE_STAT_266 "" TAB_VERB 4 0 "Nsx_eng_tq_nom" 1 "Nsx_eng_tq_bad_acry" 2 "Nsx_eng_tq_trs_mod" 3 "Nsx_eng_tq_no_ans" /end COMPU_VTAB
/begin COMPU_METHOD _CNV_A_R_LINEAR_____267_CM "" RAT_FUNC "%6.3" "s" COEFFS 0 4. 0. 0 0 1 /end COMPU_METHOD
/begin COMPU_METHOD _CNV_A_R_LINEAR_____268_CM "" RAT_FUNC "%6.3" "s" COEFFS 0 100. -200. 0 0 1 /end COMPU_METHOD
/begin COMPU_METHOD _CNV_A_R_LINEAR_____269_CM "" RAT_FUNC "%6.3" "V" COEFFS 0 204.8 0. 0 0 1 /end COMPU_METHOD
/begin COMPU_METHOD _CNV_A_R_LINEAR_____270_CM "" RAT_FUNC "%6.3" "-" COEFFS 0 327.68 0. 0 0 1 /end COMPU_METHOD
/begin COMPU_METHOD _CNV_A_R_LINEAR_____271_CM "" RAT_FUNC "%6.3" "-" COEFFS 0 128.0000321254983 0. 0 0 1 /end COMPU_METHOD
/begin COMPU_METHOD _CNV_A_R_LINEAR_____272_CM "" RAT_FUNC "%6.3" "-" COEFFS 0 327.68 16384. 0 0 1 /end COMPU_METHOD
/begin COMPU_METHOD _CNV_A_R_LINEAR_____273_CM "" RAT_FUNC "%6.3" "-" COEFFS 0 2048. 16384. 0 0 1 /end COMPU_METHOD
/begin COMPU_METHOD _CNV_A_R_LINEAR_____274_CM "" RAT_FUNC "%6.3" "1/∞CRK" COEFFS 0 1024. 0. 0 0 1 /end COMPU_METHOD
/begin COMPU_METHOD _CNV_S_4_STATUS_OK__275_CM "" TAB_VERB "%6.3" "" COMPU_TAB_REF _CNV_S_4_STATUS_OK__275 /end COMPU_METHOD
/begin COMPU_VTAB _CNV_S_4_STATUS_OK__275 "" TAB_VERB 4 0 "Nsx_vld_nok_0" 1 "Nsx_vld_ok_1" 2 "Nsx_vld_fail_2" 3 "Nsx_vld_fail_3" /end COMPU_VTAB
/begin COMPU_METHOD _CNV_A_R_LINEAR_____276_CM "" RAT_FUNC "%6.3" "-" COEFFS 0 256. -128. 0 0 1 /end COMPU_METHOD
/begin COMPU_METHOD _CNV_A_R_LINEAR_____277_CM "" RAT_FUNC "%6.3" "" COEFFS 0 256. 0. 0 0 1 /end COMPU_METHOD
/begin COMPU_METHOD _CNV_A_R_LINEAR_____278_CM "" RAT_FUNC "%6.3" "1/s" COEFFS 0 -32. 0. 0 0 1 /end COMPU_METHOD
/begin COMPU_METHOD _CNV_A_R_LINEAR_____279_CM "" RAT_FUNC "%6.3" "1/s" COEFFS 0 32. 0. 0 0 1 /end COMPU_METHOD
/begin COMPU_METHOD _CNV_A_R_LINEAR_____280_CM "" RAT_FUNC "%6.3" "Nm/s" COEFFS 0 0.64 0. 0 0 1 /end COMPU_METHOD
/begin COMPU_METHOD _CNV_A_R_LINEAR_____282_CM "" RAT_FUNC "%6.3" "W/s" COEFFS 0 2.5e-002 0. 0 0 1 /end COMPU_METHOD
/begin COMPU_METHOD _CNV_S_3_RANGE_STAT_283_CM "" TAB_VERB "%6.3" "-" COMPU_TAB_REF _CNV_S_3_RANGE_STAT_283 /end COMPU_METHOD
/begin COMPU_VTAB _CNV_S_3_RANGE_STAT_283 "" TAB_VERB 3 0 "Nsx_stal_acs_ena" 1 "Nsx_stal_ac_ant_dsb" 2 "Nsx_stal_acs_dsb" /end COMPU_VTAB
/begin COMPU_METHOD _CNV_A_R_LINEAR_____284_CM "" RAT_FUNC "%6.3" "ratio/s" COEFFS 0 512. 0. 0 0 1 /end COMPU_METHOD
/begin COMPU_METHOD _CNV_A_R_LINEAR_____285_CM "" RAT_FUNC "%6.3" "s/rpm" COEFFS 0 16384. 0. 0 0 1 /end COMPU_METHOD
/begin COMPU_METHOD _CNV_A_R_LINEAR_____286_CM "" RAT_FUNC "%6.3" "1/rpm" COEFFS 0 8192. 0. 0 0 1 /end COMPU_METHOD
/begin COMPU_METHOD _CNV_A_R_LINEAR_____287_CM "" RAT_FUNC "%6.3" "Nm/s" COEFFS 0 2. 0. 0 0 1 /end COMPU_METHOD
/begin COMPU_METHOD _CNV_A_R_LINEAR_____288_CM "" RAT_FUNC "%6.3" "km/h/s" COEFFS 0 1. 0. 0 0 1 /end COMPU_METHOD
/begin COMPU_METHOD _CNV_A_R_LINEAR_____289_CM "" RAT_FUNC "%6.3" "W/s" COEFFS 0 -0.1 0. 0 0 1 /end COMPU_METHOD
/begin COMPU_METHOD _CNV_A_R_LINEAR_____290_CM "" RAT_FUNC "%6.3" "W/s" COEFFS 0 0.1 0. 0 0 1 /end COMPU_METHOD
/begin COMPU_METHOD _CNV_A_R_LINEAR_____291_CM "" RAT_FUNC "%6.3" "W/rpm" COEFFS 0 13107.19999999999 0. 0 0 1 /end COMPU_METHOD
/begin COMPU_METHOD _CNV_A_R_LINEAR_____292_CM "" RAT_FUNC "%6.3" "W/Bar" COEFFS 0 10. 0. 0 0 1 /end COMPU_METHOD
/begin COMPU_METHOD _CNV_A_R_LINEAR_____293_CM "" RAT_FUNC "%6.3" "W/rpm/Bar" COEFFS 0 13107.19999999999 0. 0 0 1 /end COMPU_METHOD
/begin RECORD_LAYOUT _REC_S1VAL_20_u1 FNC_VALUES 1 UBYTE COLUMN_DIR DIRECT /end RECORD_LAYOUT
/begin RECORD_LAYOUT _REC_A2AXS_20_u1 NO_AXIS_PTS_X 1 UBYTE AXIS_PTS_X 2 UBYTE INDEX_INCR DIRECT /end RECORD_LAYOUT
/begin RECORD_LAYOUT _REC_S1VAL_20_u2 FNC_VALUES 1 UWORD COLUMN_DIR DIRECT /end RECORD_LAYOUT
/begin RECORD_LAYOUT _REC_S1VAL_20_s2 FNC_VALUES 1 SWORD COLUMN_DIR DIRECT /end RECORD_LAYOUT
/begin RECORD_LAYOUT _REC_A2AXS_20_u2 NO_AXIS_PTS_X 1 UWORD AXIS_PTS_X 2 UWORD INDEX_INCR DIRECT /end RECORD_LAYOUT
/begin RECORD_LAYOUT _REC_A1CUR_20_u1_u2 FNC_VALUES 1 UBYTE COLUMN_DIR DIRECT /end RECORD_LAYOUT
/begin RECORD_LAYOUT _REC_A1CUR_20_u1_u1 FNC_VALUES 1 UBYTE COLUMN_DIR DIRECT /end RECORD_LAYOUT
/begin RECORD_LAYOUT _REC_A1CUR_20_u2_u1 FNC_VALUES 1 UWORD COLUMN_DIR DIRECT /end RECORD_LAYOUT
/begin RECORD_LAYOUT _REC_A1MAP_20_u2_u2_u2 FNC_VALUES 1 UWORD COLUMN_DIR DIRECT /end RECORD_LAYOUT
/begin RECORD_LAYOUT _REC_A1CUR_20_u2_u2 FNC_VALUES 1 UWORD COLUMN_DIR DIRECT /end RECORD_LAYOUT
/begin RECORD_LAYOUT _REC_A1MAP_20_u1_u2_u2 FNC_VALUES 1 UBYTE COLUMN_DIR DIRECT /end RECORD_LAYOUT
/begin RECORD_LAYOUT _REC_A1MAP_20_u2_u2_u1 FNC_VALUES 1 UWORD COLUMN_DIR DIRECT /end RECORD_LAYOUT
/begin FUNCTION CbFfwTsp_Alcoxxx ""
 /begin DEF_CHARACTERISTIC Cmp_n_prs_lean_ti_ofs_alco Cmp_n_prs_tco_ti_fac_alco Ctp_n_sta_fim_fac_alco Ctp_tco_dec_sta_fim_alco Ctp_tco_lean_ti_ofs_alco Ctp_tco_pinj_fim_alco Ctp_tco_sta_fim_alco Ctp_tco_sta_rich_dec_alco Ctp_tco_sta_ti_ofs_alco Ctp_tco_ti_ofs1_alco Ctp_tco_ti_ofs2_alco /end DEF_CHARACTERISTIC
 /begin OUT_MEASUREMENT Vxx_n_tco_sta_fim_alco Vxx_tco_dec_sta_fim_alco Vxx_tco_lean_ti_fac_alco Vxx_tco_pinj_fim_alco Vxx_tco_sta_rich_dec_alco Vxx_tco_sta_ti_ofs_alco Vxx_tco_ti_fac_alco Vxx_tco_ti_ofs1_alco Vxx_tco_ti_ofs2_alco Vxx_vld_tco_alco /end OUT_MEASUREMENT
/end FUNCTION
/begin FUNCTION TqLimMnt "" /begin SUB_FUNCTION TqLimMnt_Mintqxx TqLimMnt_Statqxx TqLimMnt_Engtqxx /end SUB_FUNCTION /end FUNCTION
/begin FUNCTION TqLimMnt_Mintqxx ""
 /begin DEF_CHARACTERISTIC Ctb_dt_tq_rat Ctb_inj_cut_n Ctb_min_tqe_n Cmp_cut_fil_fac Cmp_driv_swi_fil_fac Cmp_n_tco_min_tq_fmt Ctd_coup_grip_rat Ctd_gear_min_driv_tqe_ftc Ctd_gear_tq_rat Ctp_min_tq_tco_ofs Ctp_swi_fil_fac Cbx_min_avl_tqe_raw_cfm Cbx_min_driv_tqe_cfm Cbx_min_tq_mod_cfm Cbx_n_mv_n_cfm Cxx_agb_max_tqe_cor Cxx_agb_min_tqe_fac Cxx_fil_fac_dft Cxx_min_is_n Cxx_min_l_eng_tqe_tqe_hys Cxx_min_n_thd_min_tq Cxx_min_n_tq_grd Cxx_min_n_tq_grd_sta Cxx_min_tq_ast_dsb_dly /end DEF_CHARACTERISTIC
 /begin OUT_MEASUREMENT Vbx_l_eng_tqe Vbx_sta_min_tq Vxx_cut_fil_fac Vxx_cut_tq_cor_fil Vxx_dt_tq_rat Vxx_min_agb_tqe Vxx_min_avl_tqe Vxx_min_avl_tqe_raw Vxx_min_bas_agb_tqe Vxx_min_bas_tqe Vxx_min_bas_tqe_raw Vxx_min_driv_tqe Vxx_min_driv_tqe_raw Vxx_min_driv_tqe_wit_inj_cut Vxx_min_is_tql Vxx_n_dif_tq Vxx_n_mv_min_driv_tqe Vxx_n_mv_min_driv_tqe_raw Vxx_swi_fil_fac /end OUT_MEASUREMENT
/end FUNCTION
/begin FUNCTION TqLimMnt_Statqxx ""
 /begin DEF_CHARACTERISTIC Ctb_sta_n Cmp_n_tco_sta_tq Ctp_tco_sta_is_trs_dly Cxx_sta_tq_inc Cxx_sta_tq_inc_dly /end DEF_CHARACTERISTIC
 /begin OUT_MEASUREMENT Vxx_raw_sta_tq Vxx_sta_is_fil_fac Vxx_sta_tq /end OUT_MEASUREMENT
/end FUNCTION
/begin FUNCTION TqLimMnt_Engtqxx "" /begin DEF_CHARACTERISTIC Ctp_l_eng_map_n Ctp_l_eng_map_tco Cxx_l_eng_map_dft /end DEF_CHARACTERISTIC /begin OUT_MEASUREMENT Vxx_l_eng_map Vxx_l_eng_tq Vxx_l_eng_tqe /end OUT_MEASUREMENT /end FUNCTION
/begin FUNCTION OuTqoTqd "" /begin SUB_FUNCTION OuTqoTqd_Tqrqstt_xxxxxx OuTqoTqd_Trnstrs_stbxxg /end SUB_FUNCTION /end FUNCTION
/begin FUNCTION OuTqoTqd_Tqrqstt_xxxxxx "" /begin OUT_MEASUREMENT Vbx_tq_req_stt_01 Vbx_tq_req_stt_11 Vsx_mux_tq_req_ans /end OUT_MEASUREMENT /end FUNCTION
/begin FUNCTION OuTqoTqd_Trnstrs_stbxxg "" /begin OUT_MEASUREMENT Vbx_tq_req_stt_10 /end OUT_MEASUREMENT /end FUNCTION
/begin FUNCTION InCbiUli ""
 /begin OUT_MEASUREMENT Vxx_lbup_per_mv_max_rtn Vxx_lbup_per_tot_mv_rtn Vtx_in_mem_lbup_cpt[0] Vtx_in_mem_lbup_cpt[1] Vtx_in_mem_lbup_cpt[2] Vtx_in_mem_lbup_cpt[3] Vtx_in_mem_lbup_cpt[4] Vtx_mem_crit_lbup_cpt[0] Vtx_mem_crit_lbup_cpt[1] Vtx_mem_crit_lbup_cpt[2] Vtx_mem_crit_lbup_cpt[3] Vtx_mem_crit_lbup_cpt[4] Vtx_mem_crit_lbup_cpt[5] Vtx_mem_crit_lbup_cpt[6] Vtx_out_mem_lbup_cpt[0] Vtx_out_mem_lbup_cpt[1] Vtx_out_mem_lbup_cpt[2] Vtx_out_mem_lbup_cpt[3] Vtx_out_mem_lbup_cpt[4] Vxx_nr_dc_cdn_ok_lbup_cpt Vxx_t_mv_cdn_ok_lbup_cpt /end OUT_MEASUREMENT
 /begin SUB_FUNCTION InCbiUli_So2upsr InCbiUli_Obdlbup InCbiUli_Alcoxxx /end SUB_FUNCTION
/end FUNCTION
/begin FUNCTION InCbiUli_So2upsr ""
 /begin DEF_CHARACTERISTIC Cbx_avl_lbup_scw_rdn Cbx_lbup_osp_conf Cxx_dfdec_inj_ecu_lbup_icp Cxx_dfdec_lbup_hot_apl_down Cxx_dfdec_lbup_nok Cxx_dfdec_lbup_oc Cxx_dfdec_lbup_scg Cxx_dfdec_lbup_scw Cxx_dfinc_inj_ecu_lbup_icp Cxx_dfinc_lbup_hot_apl_down Cxx_dfinc_lbup_nok Cxx_dfinc_lbup_oc Cxx_dfinc_lbup_scg Cxx_dfinc_lbup_scw Cxx_l_v_lamb_thd Cxx_lbup_hot_stt_t Cxx_lbup_oc_det_h_v Cxx_lbup_oc_det_l_v Cxx_lbup_oc_t Cxx_lbup_oc_trs_ctr Cxx_lbup_osp_oc_det_h_v Cxx_lbup_osp_oc_det_l_v Cxx_lbup_osp_scg_det_v Cxx_lbup_osp_scw_det_v Cxx_lbup_pump_crt_t Cxx_lbup_pump_crt_v_thd Cxx_lbup_scg_det_v Cxx_lbup_scw_det_v Cxx_lbup_v_thd Cxx_up_v_lamb_thd Cmp_n_eal_lbup_v_thd Cbx_lbup_sw_dly_req Cxx_cp_trs_h_thd Cxx_cp_trs_l_thd Cxx_diag_trs_h_thd Cxx_diag_trs_l_thd Cxx_lbup_v_eal_dft Cxx_lbup_v_max_thd Cxx_lbup_v_min_thd Cxx_lean_rich_trs_dly Cxx_rich_lean_trs_dly Cxx_trs_thd /end DEF_CHARACTERISTIC
 /begin OUT_MEASUREMENT Vbx_avl_lbup Vbx_df_inj_ecu_lbup_icp Vbx_df_lbup_hot_apl_down Vbx_df_lbup_nok Vbx_df_lbup_oc Vbx_df_lbup_scg Vbx_df_lbup_scw Vbx_diag_ena_inj_ecu_lbup_icp Vbx_diag_ena_lbup_hot_apl_down Vbx_diag_ena_lbup_nok Vbx_diag_ena_lbup_oc Vbx_diag_ena_lbup_scg Vbx_diag_ena_lbup_scw Vbx_ini_temp_oc Vbx_lbup_diag_ena Vbx_lbup_frst_thd_hot Vbx_lbup_in_out_thd Vsx_lbup_vld Vxx_lbup_diag_ena Vxx_lbup_oc_t Vxx_lbup_oc_trs_ctr Vxx_lbup_pump_crt_t Vxx_sens_lbup_v_old Vbx_diag_lbup_down_stt Vbx_diag_lbup_up_stt Vbx_lbup_down_stt Vbx_lbup_efv_stt Vbx_lbup_fail_trs Vbx_lbup_igk_off_on Vbx_lbup_lean_rich_trs Vbx_lbup_stt Vbx_lbup_sw_stt Vbx_lbup_trs Vbx_lbup_up_stt Vbx_obd_lbup_fail_trs Vxx_lbup_trs_dly /end OUT_MEASUREMENT
/end FUNCTION
/begin FUNCTION InCbiUli_Obdlbup ""
 /begin DEF_CHARACTERISTIC Ntb_lbup_maf Ctp_lbup_per_max Cxx_conf_diag_lbup Cxx_dfdec_lbup_cpt Cxx_dfinc_lbup_cpt Cxx_edic_lbup_dly Cxx_lbup_asd_diag_nr Cxx_lbup_asd_in_nr Cxx_lbup_asd_sf_nr Cxx_lbup_asd_tout_dly Cxx_lbup_diag_gear Cxx_lbup_fuel_typ_rat_max_1 Cxx_lbup_fuel_typ_rat_max_2 Cxx_lbup_fuel_typ_rat_min_1 Cxx_lbup_fuel_typ_rat_min_2 Cxx_lbup_hys_maf Cxx_lbup_hys_n Cxx_lbup_in_nr Cxx_lbup_maf_dif_max Cxx_lbup_maf_max Cxx_lbup_maf_mes_max Cxx_lbup_maf_min Cxx_lbup_n_max Cxx_lbup_n_min Cxx_lbup_per_dly Cxx_lbup_per_nr_min Cxx_lbup_per_nr_tot Cxx_lbup_per_swi_nr Cxx_lbup_stab_dly Cxx_lbup_tco_min Cxx_lgl_dly_diag_lbup /end DEF_CHARACTERISTIC
 /begin OUT_MEASUREMENT Vbx_df_lbup_cpt Vbx_diag_ena_lbup_cpt Vbx_diag_sta_lbup_abrt Vbx_diag_sta_lbup_ena Vbx_diag_sta_lbup_end Vbx_ena_diag_lbup Vbx_inhi_ena_diag_lbup Vbx_lbup_diag_stop Vbx_lbup_dsb_ad_rich Vbx_lbup_dsb_cp Vbx_lbup_mes Vbx_lbup_per_dly_acq_max Vbx_lbup_req Vbx_phy_ena_diag_lbup Vbx_sw_ena_diag_lbup Vsx_diag_sta_lbup_stt Vsx_lbup_stt Vxx_edic_lbup_dly Vxx_lbup_asd_diag_ctr Vxx_lbup_asd_sf Vxx_lbup_asd_sf_ctr Vxx_lbup_asd_tout_dly Vxx_lbup_in_ctr Vxx_lbup_jerk_nr Vxx_lbup_per_ctr Vxx_lbup_per_dly_acq Vxx_lbup_per_dly_tot Vxx_lbup_per_mv Vxx_lbup_per_mv_max Vxx_lbup_per_nr Vxx_lbup_per_nr_tot Vxx_lbup_per_out_mes Vxx_lbup_per_tot_mv Vxx_lbup_stab_dly Vxx_lgl_dly_diag_lbup Vxx_pump_maf_lbup_mem Vxx_pump_maf_lbup_mv Vxx_pump_maf_lbup_prop_per /end OUT_MEASUREMENT
/end FUNCTION
/begin FUNCTION InCbiUli_Alcoxxx "" /begin DEF_CHARACTERISTIC Cmp_n_eal_lbup_v_thd_alco /end DEF_CHARACTERISTIC /begin OUT_MEASUREMENT Vxx_lbup_v_thd_alco /end OUT_MEASUREMENT /end FUNCTION
/begin FUNCTION BiAtiDli "" /begin OUT_MEASUREMENT Vxx_sens_lbdw_v vls_down[0] /end OUT_MEASUREMENT /end FUNCTION
/begin FUNCTION PcTraArb "" /begin SUB_FUNCTION PcTraArb_Arbitxx PcTraArb_Drlimxx PcTraArb_Gbmatxx /end SUB_FUNCTION /end FUNCTION
/begin FUNCTION PcTraArb_Arbitxx ""
 /begin OUT_MEASUREMENT Vbx_tq_trs_ctl_mux Vxx_arb_no_agb_tqe Vxx_arb_tqe_raw Vxx_arb_tqe_sp Vxx_arb_tqe_tgt Vxx_raw_arb_no_agb_tqe /end OUT_MEASUREMENT
/end FUNCTION
/begin FUNCTION PcTraArb_Drlimxx "" /begin OUT_MEASUREMENT Vxx_lim_driv_tqe_sp Vxx_lim_driv_tqe_tgt /end OUT_MEASUREMENT /end FUNCTION
/begin FUNCTION PcTraArb_Gbmatxx ""
 /begin OUT_MEASUREMENT Vxx_gbx_max_tqe_sp Vxx_gbx_max_tqe_tgt Vxx_gbx_min_tqe_sp Vxx_gbx_min_tqe_tgt /end OUT_MEASUREMENT
/end FUNCTION
/begin FUNCTION TqSetFtr ""
 /begin SUB_FUNCTION TqSetFtr_Ajsisxx TqSetFtr_Drcutxx TqSetFtr_Checkxx TqSetFtr_Flcdnxx TqSetFtr_Knkscxx TqSetFtr_Schedul TqSetFtr_Drcutcd TqSetFtr_Rumblex /end SUB_FUNCTION
/end FUNCTION
/begin FUNCTION TqSetFtr_Ajsisxx ""
 /begin DEF_CHARACTERISTIC Cbx_ovn_nul_tqi_sp_cfm Cbx_tqi_raw_bch_cfm Cbx_tqi_sp_bch_cfm Cbx_tqi_tgt_bch_cfm Cxx_ajs_cor_lim_tq_ofs Cxx_tqi_raw_bch Cxx_tqi_sp_bch Cxx_tqi_tgt_bch /end DEF_CHARACTERISTIC
 /begin OUT_MEASUREMENT Vxx_max_dyn_avl_tqi Vxx_max_stat_avl_tqi_ovn Vxx_tqi_rat_tgt Vxx_tqi_raw Vxx_tqi_sp Vxx_tqi_sp_no_ajs Vxx_tqi_tgt /end OUT_MEASUREMENT
/end FUNCTION
/begin FUNCTION TqSetFtr_Drcutxx "" /begin DEF_CHARACTERISTIC Ctp_cut_decl_dly Cxx_cut_decl_dly_tq_rat /end DEF_CHARACTERISTIC
 /begin OUT_MEASUREMENT Vbx_cut_ct Vbx_cut_dly_off_trs_3 Vbx_cut_dly_on_trs_2 Vbx_cut_off_dly_trs_1 Vbx_swi_drv_cut Vbx_swi_drv_cut_n Vsx_driv_cut_req /end OUT_MEASUREMENT
/end FUNCTION
/begin FUNCTION TqSetFtr_Checkxx "" /begin DEF_CHARACTERISTIC Ctp_n_min_bas_cor_fac /end DEF_CHARACTERISTIC
 /begin OUT_MEASUREMENT Vxx_chk_arb_tqi_raw Vxx_chk_arb_tqi_sp Vxx_chk_arb_tqi_tgt Vxx_iga_arb_tqi_tgt Vxx_knk_arb_tqi_tgt Vxx_min_arb_tqi[0] Vxx_min_arb_tqi[1] Vxx_raw_min_bas_tq_cor Vxx_sta_tq_raw Vxx_wup_arb_tqi_tgt /end OUT_MEASUREMENT
/end FUNCTION
/begin FUNCTION TqSetFtr_Flcdnxx ""
 /begin DEF_CHARACTERISTIC Ctp_n_h_thr_tq Cbx_spg_fl_cfm Cxx_acel_pdl_ufld_it_hys Cxx_acel_pdl_ufld_it_thd Cxx_fl_tq_hys Cxx_fl_tq_hys2 Cxx_fl_tq_ofs Cxx_fl_tq_spg_hys /end DEF_CHARACTERISTIC
 /begin OUT_MEASUREMENT Vbx_fl Vbx_kd_fl_ena Vbx_spg_fl_ena Vbx_ufld_fl_ena /end OUT_MEASUREMENT
/end FUNCTION
/begin FUNCTION TqSetFtr_Knkscxx ""
 /begin DEF_CHARACTERISTIC Ctb_knk_iga_slow_cor_mv Cmp_knk_rel_tq_cor_max Cbx_knk_out_tq_cor Cxx_knk_iga_cor_fil_ftc Cxx_knk_slow_fil_mv_hys Cxx_knk_slow_fil_mv_iga Cxx_knk_slow_iga_efy Cxx_knk_slow_iga_efy_hys Cxx_knk_tq_cor_dec_dly Cxx_knk_tq_cor_dec_fac Cxx_knk_tq_cor_dec_ofs Cxx_knk_tq_cor_inc_dly Cxx_knk_tq_cor_inc_fac Cxx_knk_tq_cor_inc_ofs /end DEF_CHARACTERISTIC
 /begin OUT_MEASUREMENT Vxx_knk_iga_cor_fil_mv Vxx_knk_iga_cor_mv Vxx_knk_iga_slow_cor_mv Vxx_knk_rel_tq_appl_cor Vxx_knk_rel_tq_cor Vxx_knk_rel_tq_cor_dec Vxx_knk_rel_tq_cor_inc Vxx_knk_rel_tq_cor_max Vxx_knk_tq_cor_dec_dly Vxx_knk_tq_cor_inc_dly /end OUT_MEASUREMENT
/end FUNCTION
/begin FUNCTION TqSetFtr_Schedul "" /begin DEF_CHARACTERISTIC Cbx_wg_abst_pres_cho_cfm /end DEF_CHARACTERISTIC /begin OUT_MEASUREMENT Vbx_wg_abst_pres_cfm /end OUT_MEASUREMENT /end FUNCTION
/begin FUNCTION TqSetFtr_Drcutcd ""
 /begin DEF_CHARACTERISTIC Ctb_tco_cut Ctp_tco_cut_decl_off_dly Cbx_ant_gear_coup_cut_ct_ena Cxx_aut_swi1_is_ofs Cxx_aut_swi1_is_ofs_alco Cxx_aut_swi_is_ofs Cxx_aut_swi_is_ofs_alco Cxx_cut_decl_tco_thd Cxx_cut_decl_tco_thd_alco Cxx_cut_decl_tqi_thd Cxx_cut_n_ofs Cxx_cut_n_ofs2 Cxx_cut_n_ofs2_alco Cxx_cut_n_ofs_alco Cxx_decl_cut_n_ac_ofs Cxx_decl_cut_n_ac_ofs_alco Cxx_decl_cut_n_ofs Cxx_decl_cut_n_ofs_alco Cxx_kd_decl_cut_n_ac_alco Cxx_kd_decl_cut_n_ac_ofs Cxx_kd_decl_cut_n_ofs Cxx_kd_decl_cut_n_ofs_alco Cxx_swi_drv_is_ofs Cxx_swi_drv_is_ofs_alco Cxx_swi_drv_n_thd Cxx_swi_drv_n_thd_alco Cxx_tq_fuel_typ_rat_cut_dft Cxx_wet_fuel_typ_rat_cut_dft /end DEF_CHARACTERISTIC
 /begin OUT_MEASUREMENT Vbx_ant_gear_coup_cut_ct_1 Vbx_cut_cdn Vbx_swi_drv_n Vxx_ena_cut_n_ofs Vxx_swi_cut_n_ofs Vxx_swi_drv_cut_n_ofs Vxx_tq_fuel_typ_rat_cs Vxx_tq_fuel_typ_rat_cs_1 /end OUT_MEASUREMENT
/end FUNCTION
/begin FUNCTION TqSetFtr_Rumblex ""
 /begin DEF_CHARACTERISTIC Ctb_rmb_ctr Ctb_rmb_fil_iga_efy Ctb_rmb_mat Ctb_rmb_n_mv Ctb_rmb_tco Ctp_rmb_ctr_tq_cor Ctp_rmb_iga_efy_inc_prop_fac Ctp_rmb_mat_inc_prop_fac Ctp_rmb_n_mv_eal_lim Ctp_rmb_n_tq_cor_max Ctp_rmb_tco_inc_prop_fac Cxx_rmb_dec_prop Cxx_rmb_eal_ftc Cxx_rmb_iga_efy_ftc Cxx_rmb_inc_prop /end DEF_CHARACTERISTIC
 /begin OUT_MEASUREMENT Vxx_rmb_ctr Vxx_rmb_ctr_dif Vxx_rmb_eal_rel Vxx_rmb_fil_eal Vxx_rmb_fil_iga_efy Vxx_rmb_rel_tq_appl_cor /end OUT_MEASUREMENT
/end FUNCTION
/begin FUNCTION InVfiCri "" /begin SUB_FUNCTION InVfiCri_Keyxxxx InVfiCri_Mngtxcs /end SUB_FUNCTION /end FUNCTION
/begin FUNCTION InVfiCri_Keyxxxx "" /begin OUT_MEASUREMENT Vbx_igk /end OUT_MEASUREMENT /end FUNCTION
/begin FUNCTION InVfiCri_Mngtxcs ""
 /begin OUT_MEASUREMENT Vbx_vh_key Vsx_ena_sta_agb Vsx_ena_sta_agb_vld Vsx_sta_stt_vld Vxx_sta_stt /end OUT_MEASUREMENT
/end FUNCTION
/begin FUNCTION TqLimMxt ""
 /begin SUB_FUNCTION TqLimMxt_Gbxlixx TqLimMxt_Maxtqxx TqLimMxt_Ovhtqxx TqLimMxt_Protqxx TqLimMxt_Statlxx TqLimMxt_Tqramsx TqLimMxt_Fstqcfx TqLimMxt_Protcxx /end SUB_FUNCTION
/end FUNCTION
/begin FUNCTION TqLimMxt_Gbxlixx "" /begin DEF_CHARACTERISTIC Ctp_gear_lim_tq Cxx_gear_dft_lim_tq /end DEF_CHARACTERISTIC /begin OUT_MEASUREMENT Vxx_max_agb_tqe Vxx_max_gbx_tqe Vxx_max_mgb_tqe /end OUT_MEASUREMENT /end FUNCTION
/begin FUNCTION TqLimMxt_Maxtqxx ""
 /begin DEF_CHARACTERISTIC Ctb_eng_amp Cmp_amp_n_max_tqi_cor Ctp_mat_max_tqi_cor Ctp_n_gear_tqe_max_h Ctp_n_gear_tqe_max_l Ctp_n_max_tqi Ctp_n_max_tqi_lih Ctp_n_tqi_dyn_lim Cxx_gear_max_tqe_h Cxx_tqe_max_gear_slop_neg Cxx_tqe_max_gear_slop_pos /end DEF_CHARACTERISTIC
 /begin OUT_MEASUREMENT Vxx_max_avl_tqe Vxx_max_dyn_avl_tqe Vxx_max_gear_avl_tqe Vxx_max_tqi Vxx_max_tqi_alti_mat_cor Vxx_max_tqi_inj_cut Vxx_raw_max_tqi Vxx_tot_max_avl_tqe Vxx_tqe_max_gear /end OUT_MEASUREMENT
/end FUNCTION
/begin FUNCTION TqLimMxt_Ovhtqxx ""
 /begin DEF_CHARACTERISTIC Ctb_ovh_n Ctb_ovh_tco Ctb_ovh_toil Ctb_ovh_up_it_temp Ctb_ovh_vs Cmp_n_vs_ovh_tq_fac Ctp_n_ovh_tq_fac Ctp_tco_ovh_tq Ctp_temp_ovh_tq Cbx_ovh_temp_cfm /end DEF_CHARACTERISTIC
 /begin OUT_MEASUREMENT Vxx_ovh_prot_tq /end OUT_MEASUREMENT
/end FUNCTION
/begin FUNCTION TqLimMxt_Protqxx "" /begin DEF_CHARACTERISTIC Ctp_n_min_gas_lim_tq Cxx_min_gas_dec Cxx_min_gas_inc /end DEF_CHARACTERISTIC /begin OUT_MEASUREMENT Vxx_max_prot_tqe Vxx_min_fuel /end OUT_MEASUREMENT /end FUNCTION
/begin FUNCTION TqLimMxt_Statlxx "" /begin DEF_CHARACTERISTIC Cxx_max_pow_gear /end DEF_CHARACTERISTIC /begin OUT_MEASUREMENT Vxx_max_pow_tqe Vxx_max_stat_avl_tqe /end OUT_MEASUREMENT /end FUNCTION
/begin FUNCTION TqLimMxt_Tqramsx ""
 /begin DEF_CHARACTERISTIC Ctb_max_rams_tqe_3 Ctb_max_rams_tqi_1 Ctb_max_rams_tqi_2 Ctp_max_rams_tqe_3 Ctp_max_rams_tqi_1 Ctp_max_rams_tqi_2 Cbx_tq_rams_lim_act_3_bch_cfm Cxx_max_rams_tqe_1_slop Cxx_max_rams_tqe_2_slop Cxx_max_rams_tqe_3_slop Cxx_max_rams_tqe_3_srs Cxx_max_rams_tqe_sta_slop /end DEF_CHARACTERISTIC
 /begin OUT_MEASUREMENT Vbx_max_rams_tqe_1_on Vbx_max_rams_tqe_2_on Vbx_max_rams_tqe_3_on Vsx_tq_rams_lim_vld Vxx_lim_max_rams_tqe Vxx_max_rams_tqe_1 Vxx_max_rams_tqe_2 Vxx_max_rams_tqe_3 /end OUT_MEASUREMENT
/end FUNCTION
/begin FUNCTION TqLimMxt_Fstqcfx "" /begin DEF_CHARACTERISTIC Cxx_tq_lim_spg_reg_cfm /end DEF_CHARACTERISTIC
 /begin OUT_MEASUREMENT Vbx_tq_rams_lim_act_1 Vbx_tq_rams_lim_act_2 Vbx_tq_rams_lim_act_3 /end OUT_MEASUREMENT
/end FUNCTION
/begin FUNCTION TqLimMxt_Protcxx "" /begin OUT_MEASUREMENT Vbx_max_prot_spg_tqe_act Vxx_max_prot_spg_tqe /end OUT_MEASUREMENT /end FUNCTION
/begin FUNCTION BiCbiUli "" /begin OUT_MEASUREMENT Vxx_sens_lbup_v vls_up_raw[0] /end OUT_MEASUREMENT /end FUNCTION
/begin FUNCTION CbFfwSck "" /begin SUB_FUNCTION CbFfwSck_Ufldxxx /end SUB_FUNCTION /end FUNCTION
/begin FUNCTION CbFfwSck_Ufldxxx "" /begin DEF_CHARACTERISTIC Cxx_ufld_tco_thd /end DEF_CHARACTERISTIC /begin OUT_MEASUREMENT Vbx_ufld_cut /end OUT_MEASUREMENT /end FUNCTION
/begin FUNCTION TqSetAcs "" /begin SUB_FUNCTION TqSetAcs_Mngtxbc TqSetAcs_Mngtxxx /end SUB_FUNCTION /end FUNCTION
/begin FUNCTION TqSetAcs_Mngtxbc "" /begin OUT_MEASUREMENT Vbx_eng_spc_acs_dsb /end OUT_MEASUREMENT /end FUNCTION
/begin FUNCTION TqSetAcs_Mngtxxx ""
 /begin DEF_CHARACTERISTIC Ctb_n_alt Ctb_rbst_el_csm_dsb_amp Cmp_alt_slop_req Ctd_rbst_el_csm_dsb_gear Ctp_perf_acs_dsb_max_avl_tqe Ctp_rbst_el_csm_dsb_tco_thd Ctp_sta_ac_ptc_dsb_dly Ctp_sta_alt_dsb_dly Ctp_stal_ac_dsb_n_ofs Ctp_stal_acs_dsb_n Cbx_ac_max_pow_ena_cfm Cbx_acel_is_ac_dsb_cfm Cbx_eng_spc_ac_dsb_cfm Cbx_eng_spc_alt_dsb_cfm Cbx_eng_spc_ptc_dsb_cfm Cbx_eng_spc_thpl_dsb_cfm Cbx_perf_ac_dsb_cfm Cbx_perf_ptc_dsb_cfm Cbx_perf_thpl_dsb_cfm Cbx_rbst_ptc_dsb_cfm Cbx_rbst_thpl_dsb_cfm Cbx_sta_thpl_dsb_cfm Cbx_stal_ac_dsb_cfm Cbx_stal_ac_max_tq_prop_cfm Cbx_stal_alt_dsb_cfm Cbx_stal_ptc_dsb_cfm Cbx_stal_thpl_dsb_cfm Cbx_tkof_ac_dsb_cfm Cbx_tkof_acs_dsb_rwhs_cfm Cbx_tkof_alt_dsb_cfm Cbx_tkof_ptc_dsb_cfm Cbx_tkof_thpl_dsb_cfm Cxx_acel_is_ac_dsb_dly Cxx_acel_is_ac_dsb_rat Cxx_acs_amp_dft_val Cxx_acs_ena_dly Cxx_alt_min_pow_ena Cxx_perf_ac_amp_h_thd Cxx_perf_ac_amp_l_thd Cxx_perf_acs_dsb_dly Cxx_perf_acs_dsb_h_gear Cxx_perf_acs_dsb_l_gear Cxx_perf_acs_dsb_n Cxx_perf_acs_dsb_pdl_grd Cxx_perf_acs_dsb_pdl_grd_t Cxx_perf_acs_dsb_pdl_rat Cxx_perf_acs_dsb_tqe_dif Cxx_perf_acs_ena_n Cxx_perf_acs_ena_pdl_rat Cxx_rbst_el_csm_dsb_gear_dly Cxx_rbst_el_csm_dsb_n Cxx_rbst_el_csm_dsb_tco_hys Cxx_rbst_el_csm_ena_n Cxx_stal_ac_max_tq_d Cxx_stal_ac_max_tq_dft_val Cxx_stal_ac_max_tq_p Cxx_stal_ac_max_tq_ref Cxx_stal_ac_max_tq_slop Cxx_stal_ac_max_tq_thd Cxx_stal_acs_dsb_dly Cxx_stal_alt_ac_amp_h_thd Cxx_stal_alt_ac_amp_l_thd Cxx_tkof_acs_dsb_coup_dly Cxx_tkof_acs_dsb_dly Cxx_tkof_acs_dsb_n Cxx_tkof_acs_dsb_pwt_sp Cxx_tkof_acs_dsb_rwhs_t Cxx_tkof_acs_dsb_tqe_sp_rat Cxx_tkof_acs_dsb_vs Cxx_tkof_acs_dsb_vs_pos_slop Cxx_tkof_acs_ena_pwt_sp Cxx_tkof_acs_ena_vs Cxx_tkof_acs_ena_zero_vs Cxx_tkof_alt_ac_amp_h_thd Cxx_tkof_alt_ac_amp_l_thd /end DEF_CHARACTERISTIC
 /begin OUT_MEASUREMENT Vbx_ac_dsb_req Vbx_ac_eng_dsb Vbx_ac_eng_frz Vbx_acel_is_ac_dsb Vbx_acs_frz Vbx_alt_dsb_req Vbx_alt_eng_dsb Vbx_perf_ac_dsb Vbx_perf_acs_dsb Vbx_perf_el_csm_dsb Vbx_ptc_cut Vbx_ptc_dsb_req Vbx_ptc_frz Vbx_rbst_el_csm_dsb Vbx_sfty_acs_dsb Vbx_sta_ac_ptc_dsb Vbx_sta_alt_dsb Vbx_stal_acs_dsb Vbx_stal_alt_ac_dsb Vbx_stal_el_csm_dsb Vbx_thpl_dsb_req Vbx_thpl_eng_dsb Vbx_thpl_eng_frz Vbx_tkof_acs_dsb Vbx_tkof_alt_ac_dsb Vbx_tkof_el_csm_dsb Vsx_stal_acs_dsb_stt Vxx_ac_max_pow_ena Vxx_acel_pdl_grd Vxx_acs_ena_dly Vxx_alt_max_pow_ena Vxx_alt_slop_req Vxx_ptc_max_pow_ena Vxx_stal_ac_ant_dsb_n Vxx_stal_ac_max_pow_ena Vxx_stal_ac_max_pow_ena_clc Vxx_stal_ac_max_tq Vxx_stal_ac_max_tq_clc Vxx_stal_acs_dsb_dly Vxx_stal_acs_dsb_n Vxx_tkof_acs_dsb_vs /end OUT_MEASUREMENT
/end FUNCTION
/begin FUNCTION InCbiFui "" /begin SUB_FUNCTION InCbiFui_Pumtqxx InCbiFui_Minfuxx /end SUB_FUNCTION /end FUNCTION
/begin FUNCTION InCbiFui_Pumtqxx "" /begin OUT_MEASUREMENT Vxx_pump_tql /end OUT_MEASUREMENT /end FUNCTION
/begin FUNCTION InCbiFui_Minfuxx "" /begin DEF_CHARACTERISTIC Cxx_min_fuel_dly Cxx_no_min_fuel_dly /end DEF_CHARACTERISTIC /begin OUT_MEASUREMENT Vbx_min_fuel Vsx_min_fuel_vld Vxx_min_fuel_dly /end OUT_MEASUREMENT /end FUNCTION
/begin FUNCTION InTqiAcs ""
 /begin SUB_FUNCTION InTqiAcs_Paltxcs InTqiAcs_Paltxmd InTqiAcs_Clmxxcs InTqiAcs_Clmxxmd InTqiAcs_Paltxfs InTqiAcs_Ptcpocs InTqiAcs_Clmcoxx InTqiAcs_Paltcox InTqiAcs_Rgbepcs InTqiAcs_Ptcxxmd /end SUB_FUNCTION
/end FUNCTION
/begin FUNCTION InTqiAcs_Paltxcs ""
 /begin DEF_CHARACTERISTIC Ctb_alt_n_fil_fac Ctb_alt_pow Ctb_alt_pow_cor_n Cmp_alt_pow_cor_val Ctp_alt_pow_fil_fac Cxx_alt_pow_dsb_fil_fac Cxx_alt_pow_trs_dif_thd Cxx_alt_pow_trs_fil_dec Cxx_alt_pow_trs_fil_inc Cxx_alt_slop_dly Cxx_sta_alt_dec Cxx_sta_alt_inc /end DEF_CHARACTERISTIC
 /begin OUT_MEASUREMENT Vbx_alt_pow_trs Vsx_alt_pow_vld Vsx_fil_alt_pow_vld Vxx_alt_pow Vxx_alt_pow_fil_fac Vxx_alt_pow_load Vxx_fil_alt_pow Vxx_fil_alt_pow_load_trs Vxx_no_cor_raw_alt_pow /end OUT_MEASUREMENT
/end FUNCTION
/begin FUNCTION InTqiAcs_Paltxmd "" /begin OUT_MEASUREMENT Vsx_mdl_alt_pow_vld Vxx_mdl_alt_pow /end OUT_MEASUREMENT /end FUNCTION
/begin FUNCTION InTqiAcs_Clmxxcs ""
 /begin DEF_CHARACTERISTIC Ctb_ac_pow Ctb_ac_pow_cor_n Cmp_ac_pow_cor_val Ctp_ac_pow_dft_val /end DEF_CHARACTERISTIC
 /begin OUT_MEASUREMENT Vxx_ac_pow Vxx_no_cor_raw_ac_pow Vxx_raw_ac_pow /end OUT_MEASUREMENT
/end FUNCTION
/begin FUNCTION InTqiAcs_Clmxxmd ""
 /begin DEF_CHARACTERISTIC Cxx_ac_pow_max Cxx_ac_pow_min Cxx_ac_pow_n_fac Cxx_ac_pow_prs_fac Cxx_ac_pow_prs_n_fac Cxx_acr_eng_fac /end DEF_CHARACTERISTIC
 /begin OUT_MEASUREMENT Vsx_mdl_ac_pow_vld Vxx_mdl_ac_pow /end OUT_MEASUREMENT
/end FUNCTION
/begin FUNCTION InTqiAcs_Paltxfs ""
 /begin DEF_CHARACTERISTIC Cxx_alt_is_meca_pow Cxx_el_bk_wind_meca_pow Cxx_el_wind_meca_pow Cxx_eng_loss_pow_min Cxx_mdf1_meca_pow Cxx_mdf2_meca_pow Cxx_rgb_pump_meca_pow /end DEF_CHARACTERISTIC
 /begin OUT_MEASUREMENT Vxx_el_csm_mdl_pow /end OUT_MEASUREMENT
/end FUNCTION
/begin FUNCTION InTqiAcs_Ptcpocs "" /begin OUT_MEASUREMENT Vxx_ptc_pow /end OUT_MEASUREMENT /end FUNCTION
/begin FUNCTION InTqiAcs_Clmcoxx ""
 /begin DEF_CHARACTERISTIC Ctb_ac_pow_cor Ctp_ac_pow_cor Cxx_ac_pow_cor_dly Cxx_ac_pow_cor_slop /end DEF_CHARACTERISTIC
 /begin OUT_MEASUREMENT Vxx_ac_pow_cor /end OUT_MEASUREMENT
/end FUNCTION
/end MODULE
/end PROJECT
