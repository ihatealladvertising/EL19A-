ASAP2_VERSION 1 41
/begin PROJECT RD8 "_default_ProjectLongIdentifier"
/begin HEADER "_default_HeaderComment" PROJECT_NO RD9 /end HEADER
/begin MODULE _default_ModuleName "_default_ModuleLongIdentifier"
/begin MOD_COMMON "_default_ModCommonComment" DEPOSIT ABSOLUTE BYTE_ORDER MSB_LAST ALIGNMENT_BYTE 1 ALIGNMENT_WORD 2 ALIGNMENT_LONG 2 ALIGNMENT_FLOAT32_IEEE 2 ALIGNMENT_FLOAT64_IEEE 4 /end MOD_COMMON
/begin AXIS_PTS Ctb_eal "16 breakpoint table for Engine air load" 0xa002a6fc Vxx_eal _REC_A2AXS_20_u2 3.99993896484375 _CNV_A_R_LINEAR_____53_CM 16 0. 3.99993896484375 FORMAT "%10.8" /end AXIS_PTS
/begin AXIS_PTS Ctb_sta_tco "Coolant temperature breakpoints for starting set point tables" 0xa002dfe4 Vxx_tco _REC_A2AXS_20_u2 240. _CNV_A_R_LINEAR_____54_CM 8 -40. 200. FORMAT "%5.1" /end AXIS_PTS
/begin AXIS_PTS Ctb_tco "16 engine coolant temperature breakpoints" 0xa002dff8 Vxx_tco _REC_A2AXS_20_u2 240. _CNV_A_R_LINEAR_____54_CM 16 -40. 200. FORMAT "%5.1" /end AXIS_PTS
/begin AXIS_PTS Ctb_eng_amp "atmospheric pressure breakpoint of full load torque limitation." 0xa00294c4 Vxx_amp _REC_A2AXS_20_u2 20000. _CNV_A_R_LINEAR_____57_CM 6 0. 20000. FORMAT "%5.0" /end AXIS_PTS
/begin AXIS_PTS Ctb_n "20 programmable engine speed breakpoints map" 0xa00250e0 Vxx_n _REC_A2AXS_20_u2 16383.75 _CNV_A_R_ENSD_LINEA_24_CM 20 0. 16383.75 FORMAT "%8.2" /end AXIS_PTS
/begin MEASUREMENT Vbx_ac_secu_dsb "Combination of all the vehicle inhibitions" UBYTE _CNV_S_2_RANGE______3_CM 1 0. 0. 1. ECU_ADDRESS 0xd0004ad3 BIT_MASK 0x1 /end MEASUREMENT
/begin MEASUREMENT Vbx_h_prs_ac_dsb "AC compressor inhibition due to high pressure" UBYTE _CNV_S_2_RANGE______3_CM 1 0. 0. 1. ECU_ADDRESS 0xd0004ad4 BIT_MASK 0x1 /end MEASUREMENT
/begin MEASUREMENT Vbx_l_prs_ac_dsb "AC compressor inhibition due to low pressure" UBYTE _CNV_S_2_RANGE______3_CM 1 0. 0. 1. ECU_ADDRESS 0xd0004ad5 BIT_MASK 0x1 /end MEASUREMENT
/begin MEASUREMENT Vbx_n_ac_dsb "AC compressor inhibition due to engine over-speed" UBYTE _CNV_S_2_RANGE______3_CM 1 0. 0. 1. ECU_ADDRESS 0xd0004ad6 BIT_MASK 0x1 /end MEASUREMENT
/begin MEASUREMENT Vbx_n_vs_ac_clu_dsb "AC compressor clutching inhibition due to engine over-speed with too small vehicle speed" UBYTE _CNV_S_2_RANGE______3_CM 1 0. 0. 1. ECU_ADDRESS 0xd0004ad7 BIT_MASK 0x1 /end MEASUREMENT
/begin MEASUREMENT Vbx_prmt_n_ac_dsb "AC compressor inhibition due to prolonged engine over-speed" UBYTE _CNV_S_2_RANGE______3_CM 1 0. 0. 1. ECU_ADDRESS 0xd0004ad8 BIT_MASK 0x1 /end MEASUREMENT
/begin MEASUREMENT Vxx_ac_vs "Vehicle speed used by ac strategy" UBYTE _CNV_A_R_LINEAR_____212_CM 1 0. 0. 255. ECU_ADDRESS 0xd00052a2 FORMAT "%3.0" /end MEASUREMENT
/begin MEASUREMENT Vxx_l_prs_ac_diag "Diagnosis information: the cooling gas load is too low" UBYTE _CNV_A_R_ECME_LINEA_0_CM 1 0. 0. 3. ECU_ADDRESS 0xd0004ad9 FORMAT "%1.0" /end MEASUREMENT
/begin CHARACTERISTIC Cbx_ac_cold_loop_in_ecm "Boolean to set cold loop inside or outside ECM (1= cold loop inside ECM)" VALUE 0xa0020854 _REC_S1VAL_20_u1 1. _CNV_S_2_RANGE______3_CM 0. 1. /end CHARACTERISTIC
/begin CHARACTERISTIC Cxx_ac_vs_nok_dly "Delay to filter an unavailable vehicle speed received on the CAN network" VALUE 0xa0020842 _REC_S1VAL_20_u2 655.35 _CNV_A_R_LINEAR_____34_CM 0. 655.35 FORMAT "%6.2" /end CHARACTERISTIC
/begin CHARACTERISTIC Cxx_h_prs_ac_dsb_dly "Authorized time of high AC pressure before AC compressor inhibition" VALUE 0xa0020844 _REC_S1VAL_20_u2 655.35 _CNV_A_R_LINEAR_____34_CM 0. 655.35 FORMAT "%6.2" /end CHARACTERISTIC
/begin CHARACTERISTIC Cxx_h_prs_ac_dsb_hys "High pressure hysteresis of the AC compressor inhibition threshold" VALUE 0xa0020846 _REC_S1VAL_20_u2 6553.5 _CNV_A_R_LINEAR_____306_CM 0. 6553.5 FORMAT "%6.1" /end CHARACTERISTIC
/begin CHARACTERISTIC Cxx_h_prs_ac_dsb_thd "Maximum AC pressure before compressor inhibition" VALUE 0xa0020848 _REC_S1VAL_20_u2 6553.5 _CNV_A_R_LINEAR_____306_CM 0. 6553.5 FORMAT "%6.1" /end CHARACTERISTIC
/begin CHARACTERISTIC Cxx_l_prs_ac_dsb_hys "Low pressure hysteresis of the AC compressor inhibition threshold" VALUE 0xa0020855 _REC_S1VAL_20_u1 25.5 _CNV_A_R_LINEAR_____306_CM 0. 25.5 FORMAT "%4.1" /end CHARACTERISTIC
/begin CHARACTERISTIC Cxx_l_prs_ac_dsb_thd "Minimum AC pressure before compressor inhibition" VALUE 0xa0020856 _REC_S1VAL_20_u1 25.5 _CNV_A_R_LINEAR_____306_CM 0. 25.5 FORMAT "%4.1" /end CHARACTERISTIC
/begin CHARACTERISTIC Cxx_n_ac_clu_dsb_thd "Engine speed limit to authorize AC compressor clutching" VALUE 0xa002084a _REC_S1VAL_20_u2 16383.75 _CNV_A_R_ENSD_LINEA_24_CM 0. 16383.75 FORMAT "%8.2" /end CHARACTERISTIC
/begin CHARACTERISTIC Cxx_n_ac_dsb_hys "Engine speed hysteresis of the AC compressor inhibition threshold" VALUE 0xa002084c _REC_S1VAL_20_u2 16383.75 _CNV_A_R_ENSD_LINEA_24_CM 0. 16383.75 FORMAT "%8.2" /end CHARACTERISTIC
/begin CHARACTERISTIC Cxx_n_ac_dsb_thd "Maximum engine speed before AC compressor inhibition" VALUE 0xa002084e _REC_S1VAL_20_u2 16383.75 _CNV_A_R_ENSD_LINEA_24_CM 0. 16383.75 FORMAT "%8.2" /end CHARACTERISTIC
/begin CHARACTERISTIC Cxx_prmt_n_ac_dsb_dly "Maximum prolonged engine speed duration before AC compressor inhibition" VALUE 0xa0020857 _REC_S1VAL_20_u1 25.5 _CNV_A_R_LINEAR_____4_CM 0. 25.5 FORMAT "%4.1" /end CHARACTERISTIC
/begin CHARACTERISTIC Cxx_prmt_n_ac_dsb_hys "Prolonged engine speed hysteresis of the AC compressor inhibition threshold" VALUE 0xa0020850 _REC_S1VAL_20_u2 16383.75 _CNV_A_R_ENSD_LINEA_24_CM 0. 16383.75 FORMAT "%8.2" /end CHARACTERISTIC
/begin CHARACTERISTIC Cxx_prmt_n_ac_dsb_thd "Maximum prolonged engine speed before AC compressor inhibition" VALUE 0xa0020852 _REC_S1VAL_20_u2 16383.75 _CNV_A_R_ENSD_LINEA_24_CM 0. 16383.75 FORMAT "%8.2" /end CHARACTERISTIC
/begin CHARACTERISTIC Cxx_vs_ac_clu_dsb_thd "Minimum vehicule speed to authorize AC compressor clutching" VALUE 0xa0020858 _REC_S1VAL_20_u1 255. _CNV_A_R_LINEAR_____212_CM 0. 255. FORMAT "%3.0" /end CHARACTERISTIC
/begin MEASUREMENT Vxx_acs_acel_is "" UWORD _CNV_A_R_ENSD_LINEA_24_CM 1 0. 0. 16383.75 DISPLAY_IDENTIFIER SmIsrSpt_NVM.Vxx_acs_acel_is_NVM ECU_ADDRESS 0xd000140c FORMAT "%8.2" /end MEASUREMENT
/begin MEASUREMENT Vxx_el_csm_ctr "" UBYTE _CNV_A_R_ECME_LINEA_0_CM 1 0. 0. 255. DISPLAY_IDENTIFIER SmIsrSpt_NVM.Vxx_el_csm_ctr_NVM ECU_ADDRESS 0xd0001410 FORMAT "%3.0" /end MEASUREMENT
/begin MEASUREMENT Vbx_acs_acel_is_ena "" UBYTE _CNV_S_2_RANGE______3_CM 1 0. 0. 1. DISPLAY_IDENTIFIER SmIsrSpt_NVM.Vbx_acs_acel_is_ena_NVM ECU_ADDRESS 0xd0001411 BIT_MASK 0x1 /end MEASUREMENT
/begin MEASUREMENT Vxx_acs_acel_is_max_vs "" UWORD _CNV_A_R_LINEAR_____70_CM 1 0. 0. 655.35 DISPLAY_IDENTIFIER SmIsrSpt_NVM.Vxx_acs_acel_is_max_vs_NVM ECU_ADDRESS 0xd000140e FORMAT "%6.2" /end MEASUREMENT
/begin AXIS_PTS Ctb_cold_is_cata_wup_ctr "Breakpoints use for catalyst warm-up sequences with cold start conditions" 0xa00232f8 Vxx_cata_wup_ctr _REC_A2AXS_20_u2 65535. _CNV_A_R_LINEAR_____55_CM 17 0. 65535. FORMAT "%5.0" /end AXIS_PTS
/begin AXIS_PTS Ctb_is_cata_wup_ctr "Breakpoints use for catalyst warm-up sequences without cold start conditions" 0xa002331c Vxx_cata_wup_ctr _REC_A2AXS_20_u2 65535. _CNV_A_R_LINEAR_____55_CM 17 0. 65535. FORMAT "%5.0" /end AXIS_PTS
/begin CHARACTERISTIC Ctp_cold_tdc_agb_is_n_ofs "Idle speed setpoint offset during catalyst warm-up sequences with cold start conditions, under drive mode of the AT" CURVE 0xa0023340 _REC_A1CUR_20_u2_u2 16383.75 _CNV_A_R_ENSD_LINEA_24_CM 0. 16383.75 FORMAT "%8.2"
 /begin AXIS_DESCR COM_AXIS Vxx_cata_wup_ctr _CNV_A_R_LINEAR_____55_CM 17 0. 65535. FORMAT "%5.0" AXIS_PTS_REF Ctb_cold_is_cata_wup_ctr /end AXIS_DESCR
/end CHARACTERISTIC
/begin CHARACTERISTIC Ctp_cold_tdc_pn_is_n_ofs "Idle speed setpoint offset during catalyst warm-up sequences with cold start conditions, under neutral mode of the AT (or manual gearbox)" CURVE 0xa0023364 _REC_A1CUR_20_u2_u2 16383.75 _CNV_A_R_ENSD_LINEA_24_CM 0. 16383.75 FORMAT "%8.2"
 /begin AXIS_DESCR COM_AXIS Vxx_cata_wup_ctr _CNV_A_R_LINEAR_____55_CM 17 0. 65535. FORMAT "%5.0" AXIS_PTS_REF Ctb_cold_is_cata_wup_ctr /end AXIS_DESCR
/end CHARACTERISTIC
/begin CHARACTERISTIC Ctp_tdc_agb_tco_is_n_ofs "Idle speed setpoint offset during catalyst warm-up phases without cold start conditions, under drive mode of the AT" CURVE 0xa0023388 _REC_A1CUR_20_u2_u2 16383.75 _CNV_A_R_ENSD_LINEA_24_CM 0. 16383.75 FORMAT "%8.2"
 /begin AXIS_DESCR COM_AXIS Vxx_cata_wup_ctr _CNV_A_R_LINEAR_____55_CM 17 0. 65535. FORMAT "%5.0" AXIS_PTS_REF Ctb_is_cata_wup_ctr /end AXIS_DESCR
/end CHARACTERISTIC
/begin CHARACTERISTIC Ctp_tdc_pn_tco_is_n_ofs "Idle speed setpoint offset during catalyst warm-up phases without cold start conditions, under neutral mode of the AT (or manual gearbox)" CURVE 0xa00233ac _REC_A1CUR_20_u2_u2 16383.75 _CNV_A_R_ENSD_LINEA_24_CM 0. 16383.75 FORMAT "%8.2"
 /begin AXIS_DESCR COM_AXIS Vxx_cata_wup_ctr _CNV_A_R_LINEAR_____55_CM 17 0. 65535. FORMAT "%5.0" AXIS_PTS_REF Ctb_is_cata_wup_ctr /end AXIS_DESCR
/end CHARACTERISTIC
/begin MEASUREMENT Vbx_cata_wup_cdn_ena "Conditions on MEA phases are valid" UBYTE _CNV_S_2_RANGE______3_CM 1 0. 0. 1. ECU_ADDRESS 0xd0005644 BIT_MASK 0x1 /end MEASUREMENT
/begin MEASUREMENT Vbx_cata_wup_dri "Drive state with AGB or CVT (if RGB or manual gearbox >= 0)" UBYTE _CNV_S_2_RANGE______3_CM 1 0. 0. 1. ECU_ADDRESS 0xd0005645 BIT_MASK 0x1 /end MEASUREMENT
/begin MEASUREMENT Vxx_cold_pn_tco_is_n_ofs "Idle speed setpoint during compartment heating phase with cold start conditions, under neutral mode of the AT (or manual gearbox)" UWORD _CNV_A_R_ENSD_LINEA_24_CM 1 0. 0. 16383.75 ECU_ADDRESS 0xc0000b80 FORMAT "%8.2" /end MEASUREMENT
/begin MEASUREMENT Vxx_is_n_ofs_cold "Idle speed setpoint during cold start conditions phase, under neutral mode of the AT (or manual gearbox)" UWORD _CNV_A_R_ENSD_LINEA_24_CM 1 0. 0. 16383.75 ECU_ADDRESS 0xc0000b82 FORMAT "%8.2" /end MEASUREMENT
/begin MEASUREMENT Vxx_pft_min_is_n "Particule filter idle speed setpoint" UWORD _CNV_A_R_ENSD_LINEA_24_CM 1 0. 0. 16383.75 ECU_ADDRESS 0xc0000b84 FORMAT "%8.2" /end MEASUREMENT
/begin MEASUREMENT Vxx_pn_tco_is_n_ofs "Idle speed setpoint during compartment heating phase without cold start conditions, under neutral mode of the AT (or manual gearbox)" UWORD _CNV_A_R_ENSD_LINEA_24_CM 1 0. 0. 16383.75 ECU_ADDRESS 0xc0000b86 FORMAT "%8.2" /end MEASUREMENT
/begin MEASUREMENT Vxx_tco_is_n_ofs "Engine warm-up idle speed setpoint offset" UWORD _CNV_A_R_ENSD_LINEA_24_CM 1 0. 0. 16383.75 ECU_ADDRESS 0xc0000b88 FORMAT "%8.2" /end MEASUREMENT
/begin MEASUREMENT Vxx_tco_neut_raw_val "Intermediary calcul of Vxx_tco_is_n_ofs under neutral mode of the AT (or manual gearbox)" UWORD _CNV_A_R_ENSD_LINEA_24_CM 1 0. 0. 16383.75 ECU_ADDRESS 0xc0000b8a FORMAT "%8.2" /end MEASUREMENT
/begin MEASUREMENT Vxx_tco_no_neut_raw_val "Intermediary calcul of Vxx_tco_is_n_ofs under drive mode of the AT" UWORD _CNV_A_R_ENSD_LINEA_24_CM 1 0. 0. 16383.75 ECU_ADDRESS 0xc0000b8c FORMAT "%8.2" /end MEASUREMENT
/begin MEASUREMENT Vxx_tdc_pn_tco_is_n_ofs "Idle speed setpoint offset during catalyst warm-up phases without cold start conditions, under neutral mode of the AT (or manual gearbox))" UWORD _CNV_A_R_ENSD_LINEA_24_CM 1 0. 0. 16383.75 ECU_ADDRESS 0xc0000b8e FORMAT "%8.2" /end MEASUREMENT
/begin CHARACTERISTIC Cxx_agb_tco_is_n_ofs "Idle speed setpoint during compartment heating phase without cold start conditions, under drive mode of the AT" VALUE 0xa002150c _REC_S1VAL_20_u2 16383.75 _CNV_A_R_ENSD_LINEA_24_CM 0. 16383.75 FORMAT "%8.2" /end CHARACTERISTIC
/begin CHARACTERISTIC Cxx_cold_agb "Idle speed setpoint during cold start conditions phase, under drive mode of the AT" VALUE 0xa002150e _REC_S1VAL_20_u2 16383.75 _CNV_A_R_ENSD_LINEA_24_CM 0. 16383.75 FORMAT "%8.2" /end CHARACTERISTIC
/begin CHARACTERISTIC Cxx_cold_agb_tco_is_n_ofs "Idle speed setpoint during compartment heating phase with cold start conditions, under drive mode of the AT" VALUE 0xa0021510 _REC_S1VAL_20_u2 16383.75 _CNV_A_R_ENSD_LINEA_24_CM 0. 16383.75 FORMAT "%8.2" /end CHARACTERISTIC
/begin CHARACTERISTIC Cxx_cold_pn "Idle speed setpoint during cold start conditions phase, under neutral mode of the AT (or manual gearbox) " VALUE 0xa0021512 _REC_S1VAL_20_u2 16383.75 _CNV_A_R_ENSD_LINEA_24_CM 0. 16383.75 FORMAT "%8.2" /end CHARACTERISTIC
/begin CHARACTERISTIC Cxx_cold_pn_alco "Idle speed setpoint during cold start conditions phase, under neutral mode of the AT (or manual gearbox)" VALUE 0xa0021514 _REC_S1VAL_20_u2 16383.75 _CNV_A_R_ENSD_LINEA_24_CM 0. 16383.75 FORMAT "%8.2" /end CHARACTERISTIC
/begin CHARACTERISTIC Cxx_cold_pn_tco_is_n_ofs "Idle speed setpoint during compartment heating phase with cold start conditions, under neutral mode of the AT (or manual gearbox)" VALUE 0xa0021516 _REC_S1VAL_20_u2 16383.75 _CNV_A_R_ENSD_LINEA_24_CM 0. 16383.75 FORMAT "%8.2" /end CHARACTERISTIC
/begin CHARACTERISTIC Cxx_cold_pn_tco_is_n_ofs_alco "Idle speed setpoint during compartment heating phase with cold start conditions, under neutral mode of the AT (or manual gearbox)" VALUE 0xa0021518 _REC_S1VAL_20_u2 16383.75 _CNV_A_R_ENSD_LINEA_24_CM 0. 16383.75 FORMAT "%8.2" /end CHARACTERISTIC
/begin CHARACTERISTIC Cxx_cold_sta_tco "Temperature threshold wich determines cold start conditions for catalyst warm-up phases" VALUE 0xa002151a _REC_S1VAL_20_u2 240. _CNV_A_R_LINEAR_____54_CM -40. 200. FORMAT "%5.1" /end CHARACTERISTIC
/begin CHARACTERISTIC Cxx_pn_tco_is_n_ofs "Idle speed setpoint during compartment heating phase without cold start conditions, under neutral mode of the AT (or manual gearbox)" VALUE 0xa002151c _REC_S1VAL_20_u2 16383.75 _CNV_A_R_ENSD_LINEA_24_CM 0. 16383.75 FORMAT "%8.2" /end CHARACTERISTIC
/begin CHARACTERISTIC Cxx_pn_tco_is_n_ofs_alco "Idle speed setpoint during compartment heating phase without cold start conditions, under neutral mode of the AT (or manual gearbox)" VALUE 0xa002151e _REC_S1VAL_20_u2 16383.75 _CNV_A_R_ENSD_LINEA_24_CM 0. 16383.75 FORMAT "%8.2" /end CHARACTERISTIC
/begin CHARACTERISTIC Cmp_tco_amp_min_is_n "Idle speed setpoint according to the engine coolant temperature and atmospheric pressure" MAP 0xa002bc6c _REC_A1MAP_20_u2_u2_u2 16383.75 _CNV_A_R_ENSD_LINEA_24_CM 0. 16383.75 FORMAT "%8.2"
 /begin AXIS_DESCR COM_AXIS Vxx_tco _CNV_A_R_LINEAR_____54_CM 16 -40. 200. FORMAT "%5.1" AXIS_PTS_REF Ctb_tco /end AXIS_DESCR
 /begin AXIS_DESCR COM_AXIS Vxx_amp _CNV_A_R_LINEAR_____57_CM 6 0. 20000. FORMAT "%5.0" AXIS_PTS_REF Ctb_eng_amp /end AXIS_DESCR
/end CHARACTERISTIC
/begin CHARACTERISTIC Ctd_gear_run_vh_min_is_n "Running vehicule index table based on the gear engaged" CURVE 0xa002bd2c _REC_A1CUR_20_u2_u1 16383.75 _CNV_A_R_ENSD_LINEA_24_CM 0. 16383.75 FORMAT "%8.2"
 /begin AXIS_DESCR COM_AXIS Vxx_gear _CNV_A_R_LINEAR_____113_CM 8 -1. 6. READ_ONLY FORMAT "%2.0" AXIS_PTS_REF Ntb_gear /end AXIS_DESCR
/end CHARACTERISTIC
/begin MEASUREMENT Vtx_dec_slop_itl_tb[0] "Decrease slope internal list which contains all the decrease slope setpoints." UWORD _CNV_A_R_LINEAR_____330_CM 1 0. -65535. 0. ECU_ADDRESS 0xd0005a04 FORMAT "%4.0" /end MEASUREMENT
/begin MEASUREMENT Vtx_dec_slop_itl_tb[1] "Decrease slope internal list which contains all the decrease slope setpoints." UWORD _CNV_A_R_LINEAR_____330_CM 1 0. -65535. 0. ECU_ADDRESS 0xd0005a06 FORMAT "%4.0" /end MEASUREMENT
/begin MEASUREMENT Vtx_dec_slop_itl_tb[2] "Decrease slope internal list which contains all the decrease slope setpoints." UWORD _CNV_A_R_LINEAR_____330_CM 1 0. -65535. 0. ECU_ADDRESS 0xd0005a08 FORMAT "%4.0" /end MEASUREMENT
/begin MEASUREMENT Vtx_dec_slop_itl_tb[3] "Decrease slope internal list which contains all the decrease slope setpoints." UWORD _CNV_A_R_LINEAR_____330_CM 1 0. -65535. 0. ECU_ADDRESS 0xd0005a0a FORMAT "%4.0" /end MEASUREMENT
/begin MEASUREMENT Vtx_dec_slop_itl_tb[4] "Decrease slope internal list which contains all the decrease slope setpoints." UWORD _CNV_A_R_LINEAR_____330_CM 1 0. -65535. 0. ECU_ADDRESS 0xd0005a0c FORMAT "%4.0" /end MEASUREMENT
/begin MEASUREMENT Vtx_dec_slop_itl_tb[5] "Decrease slope internal list which contains all the decrease slope setpoints." UWORD _CNV_A_R_LINEAR_____330_CM 1 0. -65535. 0. ECU_ADDRESS 0xd0005a0e FORMAT "%4.0" /end MEASUREMENT
/begin MEASUREMENT Vtx_dec_slop_itl_tb[6] "Decrease slope internal list which contains all the decrease slope setpoints." UWORD _CNV_A_R_LINEAR_____330_CM 1 0. -65535. 0. ECU_ADDRESS 0xd0005a10 FORMAT "%4.0" /end MEASUREMENT
/begin MEASUREMENT Vtx_dec_slop_itl_tb[7] "Decrease slope internal list which contains all the decrease slope setpoints." UWORD _CNV_A_R_LINEAR_____330_CM 1 0. -65535. 0. ECU_ADDRESS 0xd0005a12 FORMAT "%4.0" /end MEASUREMENT
/begin MEASUREMENT Vtx_dec_slop_itl_tb[8] "Decrease slope internal list which contains all the decrease slope setpoints." UWORD _CNV_A_R_LINEAR_____330_CM 1 0. -65535. 0. ECU_ADDRESS 0xd0005a14 FORMAT "%4.0" /end MEASUREMENT
/begin MEASUREMENT Vtx_dec_slop_itl_tb[9] "Decrease slope internal list which contains all the decrease slope setpoints." UWORD _CNV_A_R_LINEAR_____330_CM 1 0. -65535. 0. ECU_ADDRESS 0xd0005a16 FORMAT "%4.0" /end MEASUREMENT
/begin MEASUREMENT Vtx_dec_slop_itl_tb[10] "Decrease slope internal list which contains all the decrease slope setpoints." UWORD _CNV_A_R_LINEAR_____330_CM 1 0. -65535. 0. ECU_ADDRESS 0xd0005a18 FORMAT "%4.0" /end MEASUREMENT
/begin MEASUREMENT Vtx_dec_slop_itl_tb[11] "Decrease slope internal list which contains all the decrease slope setpoints." UWORD _CNV_A_R_LINEAR_____330_CM 1 0. -65535. 0. ECU_ADDRESS 0xd0005a1a FORMAT "%4.0" /end MEASUREMENT
/begin MEASUREMENT Vtx_dec_slop_itl_tb[12] "Decrease slope internal list which contains all the decrease slope setpoints." UWORD _CNV_A_R_LINEAR_____330_CM 1 0. -65535. 0. ECU_ADDRESS 0xd0005a1c FORMAT "%4.0" /end MEASUREMENT
/begin MEASUREMENT Vtx_dec_slop_itl_tb[13] "Decrease slope internal list which contains all the decrease slope setpoints." UWORD _CNV_A_R_LINEAR_____330_CM 1 0. -65535. 0. ECU_ADDRESS 0xd0005a1e FORMAT "%4.0" /end MEASUREMENT
/begin MEASUREMENT Vtx_dec_slop_itl_tb[14] "Decrease slope internal list which contains all the decrease slope setpoints." UWORD _CNV_A_R_LINEAR_____330_CM 1 0. -65535. 0. ECU_ADDRESS 0xd0005a20 FORMAT "%4.0" /end MEASUREMENT
/begin MEASUREMENT Vtx_inc_slop_itl_tb[0] "Increase slope internal list which contains all the increase slope setpoints." UWORD _CNV_A_R_LINEAR_____23_CM 1 0. 0. 65535. ECU_ADDRESS 0xd0005a24 FORMAT "%4.0" /end MEASUREMENT
/begin MEASUREMENT Vtx_inc_slop_itl_tb[1] "Increase slope internal list which contains all the increase slope setpoints." UWORD _CNV_A_R_LINEAR_____23_CM 1 0. 0. 65535. ECU_ADDRESS 0xd0005a26 FORMAT "%4.0" /end MEASUREMENT
/begin MEASUREMENT Vtx_inc_slop_itl_tb[2] "Increase slope internal list which contains all the increase slope setpoints." UWORD _CNV_A_R_LINEAR_____23_CM 1 0. 0. 65535. ECU_ADDRESS 0xd0005a28 FORMAT "%4.0" /end MEASUREMENT
/begin MEASUREMENT Vtx_inc_slop_itl_tb[3] "Increase slope internal list which contains all the increase slope setpoints." UWORD _CNV_A_R_LINEAR_____23_CM 1 0. 0. 65535. ECU_ADDRESS 0xd0005a2a FORMAT "%4.0" /end MEASUREMENT
/begin MEASUREMENT Vtx_inc_slop_itl_tb[4] "Increase slope internal list which contains all the increase slope setpoints." UWORD _CNV_A_R_LINEAR_____23_CM 1 0. 0. 65535. ECU_ADDRESS 0xd0005a2c FORMAT "%4.0" /end MEASUREMENT
/begin MEASUREMENT Vtx_inc_slop_itl_tb[5] "Increase slope internal list which contains all the increase slope setpoints." UWORD _CNV_A_R_LINEAR_____23_CM 1 0. 0. 65535. ECU_ADDRESS 0xd0005a2e FORMAT "%4.0" /end MEASUREMENT
/begin MEASUREMENT Vtx_inc_slop_itl_tb[6] "Increase slope internal list which contains all the increase slope setpoints." UWORD _CNV_A_R_LINEAR_____23_CM 1 0. 0. 65535. ECU_ADDRESS 0xd0005a30 FORMAT "%4.0" /end MEASUREMENT
/begin MEASUREMENT Vtx_inc_slop_itl_tb[7] "Increase slope internal list which contains all the increase slope setpoints." UWORD _CNV_A_R_LINEAR_____23_CM 1 0. 0. 65535. ECU_ADDRESS 0xd0005a32 FORMAT "%4.0" /end MEASUREMENT
/begin MEASUREMENT Vtx_inc_slop_itl_tb[8] "Increase slope internal list which contains all the increase slope setpoints." UWORD _CNV_A_R_LINEAR_____23_CM 1 0. 0. 65535. ECU_ADDRESS 0xd0005a34 FORMAT "%4.0" /end MEASUREMENT
/begin MEASUREMENT Vtx_inc_slop_itl_tb[9] "Increase slope internal list which contains all the increase slope setpoints." UWORD _CNV_A_R_LINEAR_____23_CM 1 0. 0. 65535. ECU_ADDRESS 0xd0005a36 FORMAT "%4.0" /end MEASUREMENT
/begin MEASUREMENT Vtx_inc_slop_itl_tb[10] "Increase slope internal list which contains all the increase slope setpoints." UWORD _CNV_A_R_LINEAR_____23_CM 1 0. 0. 65535. ECU_ADDRESS 0xd0005a38 FORMAT "%4.0" /end MEASUREMENT
/begin MEASUREMENT Vtx_inc_slop_itl_tb[11] "Increase slope internal list which contains all the increase slope setpoints." UWORD _CNV_A_R_LINEAR_____23_CM 1 0. 0. 65535. ECU_ADDRESS 0xd0005a3a FORMAT "%4.0" /end MEASUREMENT
/begin MEASUREMENT Vtx_inc_slop_itl_tb[12] "Increase slope internal list which contains all the increase slope setpoints." UWORD _CNV_A_R_LINEAR_____23_CM 1 0. 0. 65535. ECU_ADDRESS 0xd0005a3c FORMAT "%4.0" /end MEASUREMENT
/begin MEASUREMENT Vtx_inc_slop_itl_tb[13] "Increase slope internal list which contains all the increase slope setpoints." UWORD _CNV_A_R_LINEAR_____23_CM 1 0. 0. 65535. ECU_ADDRESS 0xd0005a3e FORMAT "%4.0" /end MEASUREMENT
/begin MEASUREMENT Vtx_inc_slop_itl_tb[14] "Increase slope internal list which contains all the increase slope setpoints." UWORD _CNV_A_R_LINEAR_____23_CM 1 0. 0. 65535. ECU_ADDRESS 0xd0005a40 FORMAT "%4.0" /end MEASUREMENT
/begin MEASUREMENT Vtx_is_sp_itl_tb[0] "Idle speed internal list which contains all the idle speed setpoints." UWORD _CNV_A_R_ENSD_LINEA_24_CM 1 0. 0. 16383.75 ECU_ADDRESS 0xd0005a44 FORMAT "%8.2" /end MEASUREMENT
/begin MEASUREMENT Vtx_is_sp_itl_tb[1] "Idle speed internal list which contains all the idle speed setpoints." UWORD _CNV_A_R_ENSD_LINEA_24_CM 1 0. 0. 16383.75 ECU_ADDRESS 0xd0005a46 FORMAT "%8.2" /end MEASUREMENT
/begin MEASUREMENT Vtx_is_sp_itl_tb[2] "Idle speed internal list which contains all the idle speed setpoints." UWORD _CNV_A_R_ENSD_LINEA_24_CM 1 0. 0. 16383.75 ECU_ADDRESS 0xd0005a48 FORMAT "%8.2" /end MEASUREMENT
/begin MEASUREMENT Vtx_is_sp_itl_tb[3] "Idle speed internal list which contains all the idle speed setpoints." UWORD _CNV_A_R_ENSD_LINEA_24_CM 1 0. 0. 16383.75 ECU_ADDRESS 0xd0005a4a FORMAT "%8.2" /end MEASUREMENT
/begin MEASUREMENT Vtx_is_sp_itl_tb[4] "Idle speed internal list which contains all the idle speed setpoints." UWORD _CNV_A_R_ENSD_LINEA_24_CM 1 0. 0. 16383.75 ECU_ADDRESS 0xd0005a4c FORMAT "%8.2" /end MEASUREMENT
/begin MEASUREMENT Vtx_is_sp_itl_tb[5] "Idle speed internal list which contains all the idle speed setpoints." UWORD _CNV_A_R_ENSD_LINEA_24_CM 1 0. 0. 16383.75 ECU_ADDRESS 0xd0005a4e FORMAT "%8.2" /end MEASUREMENT
/begin MEASUREMENT Vtx_is_sp_itl_tb[6] "Idle speed internal list which contains all the idle speed setpoints." UWORD _CNV_A_R_ENSD_LINEA_24_CM 1 0. 0. 16383.75 ECU_ADDRESS 0xd0005a50 FORMAT "%8.2" /end MEASUREMENT
/begin MEASUREMENT Vtx_is_sp_itl_tb[7] "Idle speed internal list which contains all the idle speed setpoints." UWORD _CNV_A_R_ENSD_LINEA_24_CM 1 0. 0. 16383.75 ECU_ADDRESS 0xd0005a52 FORMAT "%8.2" /end MEASUREMENT
/begin MEASUREMENT Vtx_is_sp_itl_tb[8] "Idle speed internal list which contains all the idle speed setpoints." UWORD _CNV_A_R_ENSD_LINEA_24_CM 1 0. 0. 16383.75 ECU_ADDRESS 0xd0005a54 FORMAT "%8.2" /end MEASUREMENT
/begin MEASUREMENT Vtx_is_sp_itl_tb[9] "Idle speed internal list which contains all the idle speed setpoints." UWORD _CNV_A_R_ENSD_LINEA_24_CM 1 0. 0. 16383.75 ECU_ADDRESS 0xd0005a56 FORMAT "%8.2" /end MEASUREMENT
/begin MEASUREMENT Vtx_is_sp_itl_tb[10] "Idle speed internal list which contains all the idle speed setpoints." UWORD _CNV_A_R_ENSD_LINEA_24_CM 1 0. 0. 16383.75 ECU_ADDRESS 0xd0005a58 FORMAT "%8.2" /end MEASUREMENT
/begin MEASUREMENT Vtx_is_sp_itl_tb[11] "Idle speed internal list which contains all the idle speed setpoints." UWORD _CNV_A_R_ENSD_LINEA_24_CM 1 0. 0. 16383.75 ECU_ADDRESS 0xd0005a5a FORMAT "%8.2" /end MEASUREMENT
/begin MEASUREMENT Vtx_is_sp_itl_tb[12] "Idle speed internal list which contains all the idle speed setpoints." UWORD _CNV_A_R_ENSD_LINEA_24_CM 1 0. 0. 16383.75 ECU_ADDRESS 0xd0005a5c FORMAT "%8.2" /end MEASUREMENT
/begin MEASUREMENT Vtx_is_sp_itl_tb[13] "Idle speed internal list which contains all the idle speed setpoints." UWORD _CNV_A_R_ENSD_LINEA_24_CM 1 0. 0. 16383.75 ECU_ADDRESS 0xd0005a5e FORMAT "%8.2" /end MEASUREMENT
/begin MEASUREMENT Vtx_is_sp_itl_tb[14] "Idle speed internal list which contains all the idle speed setpoints." UWORD _CNV_A_R_ENSD_LINEA_24_CM 1 0. 0. 16383.75 ECU_ADDRESS 0xd0005a60 FORMAT "%8.2" /end MEASUREMENT
/begin MEASUREMENT Vxx_arb_dec_slop "Arbitrated decrease slope applied to the current arbitrated idle speed" UWORD _CNV_A_R_LINEAR_____330_CM 1 0. -65535. 0. ECU_ADDRESS 0xd000327a FORMAT "%4.0" /end MEASUREMENT
/begin MEASUREMENT Vxx_arb_inc_slop "Arbitrated decrease slope applied to the current arbitrated idle speed" UWORD _CNV_A_R_LINEAR_____23_CM 1 0. 0. 65535. ECU_ADDRESS 0xd000327c FORMAT "%4.0" /end MEASUREMENT
/begin MEASUREMENT Vxx_arb_lim_is "Arbitrated decrease slope applied to the current arbitrated idle speed" UWORD _CNV_A_R_ENSD_LINEA_24_CM 1 0. 0. 16383.75 ECU_ADDRESS 0xd000327e FORMAT "%8.2" /end MEASUREMENT
/begin MEASUREMENT Vxx_arb_raw_is "Arbitrated raw idle speed setpoint (without min/max limitation)" UWORD _CNV_A_R_ENSD_LINEA_24_CM 1 0. 0. 16383.75 ECU_ADDRESS 0xd0003280 FORMAT "%8.2" /end MEASUREMENT
/begin MEASUREMENT Vxx_crt_is "Arbitrated decrease slope applied to the current arbitrated idle speed" UWORD _CNV_A_R_ENSD_LINEA_24_CM 1 0. 0. 16383.75 ECU_ADDRESS 0xd0003282 FORMAT "%8.2" /end MEASUREMENT
/begin MEASUREMENT Vxx_is_n_sp "Final idle speed setpoint" UWORD _CNV_A_R_ENSD_LINEA_24_CM 1 0. 0. 16383.75 ECU_ADDRESS 0xd0003284 FORMAT "%8.2" /end MEASUREMENT
/begin MEASUREMENT Vxx_run_vh_min_is_n "Running vehicule idle speed setpoint" UWORD _CNV_A_R_ENSD_LINEA_24_CM 1 0. 0. 16383.75 ECU_ADDRESS 0xd0003286 FORMAT "%8.2" /end MEASUREMENT
/begin MEASUREMENT Vxx_tco_min_is_n "Nominal idle speed setpoint" UWORD _CNV_A_R_ENSD_LINEA_24_CM 1 0. 0. 16383.75 ECU_ADDRESS 0xd0003288 FORMAT "%8.2" /end MEASUREMENT
/begin MEASUREMENT Vxx_tco_sp_min_is_n "Arbitrated decrease slope applied to the current arbitrated idle speed" UWORD _CNV_A_R_ENSD_LINEA_24_CM 1 0. 0. 16383.75 ECU_ADDRESS 0xd000328a FORMAT "%8.2" /end MEASUREMENT
/begin CHARACTERISTIC Cbx_is_run_vh_min_crp_cfm "Configuration of type detection to idel speed setpoint for vehicle running" VALUE 0xa00216c0 _REC_S1VAL_20_u1 1. _CNV_A_R_ECME_LINEA_0_CM 0. 1. FORMAT "%1.0" BIT_MASK 0x1 /end CHARACTERISTIC
/begin CHARACTERISTIC Cbx_mpl_dec_slop_act "Activation of the decrease slopes arbitration strategy (0=One slope  1=multiple slopes)" VALUE 0xa00216c1 _REC_S1VAL_20_u1 1. _CNV_A_R_ECME_LINEA_0_CM 0. 1. FORMAT "%1.0" BIT_MASK 0x1 /end CHARACTERISTIC
/begin CHARACTERISTIC Cxx_dec_slop_ac_sp "Type of decrease  slope for the air conditionning idle speed setpoint (1=Low 2=Med 3=Fast)" VALUE 0xa00216c2 _REC_S1VAL_20_u1 2. _CNV_A_R_ECME_LINEA_0_CM 1. 3. FORMAT "%1.0" /end CHARACTERISTIC
/begin CHARACTERISTIC Cxx_dec_slop_acs_sp "Type of decrease slope for the accessories idle speed setpoint (1=Low 2=Med 3=Fast)" VALUE 0xa00216c3 _REC_S1VAL_20_u1 2. _CNV_A_R_ECME_LINEA_0_CM 1. 3. FORMAT "%1.0" /end CHARACTERISTIC
/begin CHARACTERISTIC Cxx_dec_slop_agb_sp "Type of decrease  slope for the AGB idle speed setpoint (1=Low 2=Med 3=Fast)" VALUE 0xa00216c4 _REC_S1VAL_20_u1 2. _CNV_A_R_ECME_LINEA_0_CM 1. 3. FORMAT "%1.0" /end CHARACTERISTIC
/begin CHARACTERISTIC Cxx_dec_slop_dgi_sp "Type of decrease slope for the diagnosis and protection idle speed setpoint (1=Low 2=Med 3=Fast)" VALUE 0xa00216c5 _REC_S1VAL_20_u1 2. _CNV_A_R_ECME_LINEA_0_CM 1. 3. FORMAT "%1.0" /end CHARACTERISTIC
/begin CHARACTERISTIC Cxx_dec_slop_diag_vvtc_sp "Type of decrease slope for the VVTC routine idle speed setpoint (1=Low 2=Med 3=Fast)" VALUE 0xa00216c6 _REC_S1VAL_20_u1 2. _CNV_A_R_ECME_LINEA_0_CM 1. 3. FORMAT "%3.0" /end CHARACTERISTIC
/begin CHARACTERISTIC Cxx_dec_slop_el_bk_sp "Type of decrease slope for the electrical backlite idle speed setpoint (1=Low 2=Med 3=Fast)" VALUE 0xa00216c7 _REC_S1VAL_20_u1 2. _CNV_A_R_ECME_LINEA_0_CM 1. 3. FORMAT "%1.0" /end CHARACTERISTIC
/begin CHARACTERISTIC Cxx_dec_slop_el_wind_sp "Type of decrease  slope for the electrical windshield idle speed setpoint (1=Low 2=Med 3=Fast)" VALUE 0xa00216c8 _REC_S1VAL_20_u1 2. _CNV_A_R_ECME_LINEA_0_CM 1. 3. FORMAT "%1.0" /end CHARACTERISTIC
/begin CHARACTERISTIC Cxx_dec_slop_inj_sp "Type of decrease slope for the injector idle speed setpoint (1=Low 2=Med 3=Fast)" VALUE 0xa00216c9 _REC_S1VAL_20_u1 2. _CNV_A_R_ECME_LINEA_0_CM 1. 3. FORMAT "%1.0" /end CHARACTERISTIC
/begin CHARACTERISTIC Cxx_dec_slop_moni_sp "Type of decrease  slope for the monitool idle speed setpoint (1=Low 2=Med 3=Fast)" VALUE 0xa00216ca _REC_S1VAL_20_u1 2. _CNV_A_R_ECME_LINEA_0_CM 1. 3. FORMAT "%1.0" /end CHARACTERISTIC
/begin CHARACTERISTIC Cxx_dec_slop_pft_sp "Type of decrease  slope for the particle filter idle speed setpoint (1=Low 2=Med 3=Fast)" VALUE 0xa00216cb _REC_S1VAL_20_u1 2. _CNV_A_R_ECME_LINEA_0_CM 1. 3. FORMAT "%1.0" /end CHARACTERISTIC
/begin CHARACTERISTIC Cxx_dec_slop_ptc_sp "Type of decrease  slope for the PTC idle speed setpoint (1=Low 2=Med 3=Fast)" VALUE 0xa00216cc _REC_S1VAL_20_u1 2. _CNV_A_R_ECME_LINEA_0_CM 1. 3. FORMAT "%1.0" /end CHARACTERISTIC
/begin CHARACTERISTIC Cxx_dec_slop_pwst_sp "Type of decrease  slope for the power steering idle speed setpoint (1=Low 2=Med 3=Fast)" VALUE 0xa00216cd _REC_S1VAL_20_u1 2. _CNV_A_R_ECME_LINEA_0_CM 1. 3. FORMAT "%1.0" /end CHARACTERISTIC
/begin CHARACTERISTIC Cxx_dec_slop_run_vh_sp "Type of decrease  slope for the running vehicle idle speed setpoint (1=Low 2=Med 3=Fast)" VALUE 0xa00216ce _REC_S1VAL_20_u1 2. _CNV_A_R_ECME_LINEA_0_CM 1. 3. FORMAT "%1.0" /end CHARACTERISTIC
/begin CHARACTERISTIC Cxx_dec_slop_tco_sp "Type of decrease  slope for the coolant temperature idle speed setpoint (1=Low 2=Med 3=Fast)" VALUE 0xa00216cf _REC_S1VAL_20_u1 2. _CNV_A_R_ECME_LINEA_0_CM 1. 3. FORMAT "%1.0" /end CHARACTERISTIC
/begin CHARACTERISTIC Cxx_dec_slop_thpl_sp "Type of decrease  slope for the thermoplunger idle speed setpoint (1=Low 2=Med 3=Fast)" VALUE 0xa00216d0 _REC_S1VAL_20_u1 2. _CNV_A_R_ECME_LINEA_0_CM 1. 3. FORMAT "%1.0" /end CHARACTERISTIC
/begin CHARACTERISTIC Cxx_fast_dec_slop "Value for the fast decrease slope" VALUE 0xa00216aa _REC_S1VAL_20_u2 65535. _CNV_A_R_LINEAR_____330_CM -65535. 0. FORMAT "%4.0" /end CHARACTERISTIC
/begin CHARACTERISTIC Cxx_fast_inc_slop "Value for the fast increase slope" VALUE 0xa00216ac _REC_S1VAL_20_u2 65535. _CNV_A_R_LINEAR_____23_CM 0. 65535. FORMAT "%4.0" /end CHARACTERISTIC
/begin CHARACTERISTIC Cxx_inc_slop_ac_sp "Type of increase  slope for the air conditionning idle speed setpoint (1=Low 2=Med 3=Fast)" VALUE 0xa00216d1 _REC_S1VAL_20_u1 2. _CNV_A_R_ECME_LINEA_0_CM 1. 3. FORMAT "%1.0" /end CHARACTERISTIC
/begin CHARACTERISTIC Cxx_inc_slop_acs_sp "Type of increase slope for the accessories idle speed setpoint (1=Low 2=Med 3=Fast)" VALUE 0xa00216d2 _REC_S1VAL_20_u1 2. _CNV_A_R_ECME_LINEA_0_CM 1. 3. FORMAT "%1.0" /end CHARACTERISTIC
/begin CHARACTERISTIC Cxx_inc_slop_agb_sp "Type of increase  slope for the AGB idle speed setpoint (1=Low 2=Med 3=Fast)" VALUE 0xa00216d3 _REC_S1VAL_20_u1 2. _CNV_A_R_ECME_LINEA_0_CM 1. 3. FORMAT "%1.0" /end CHARACTERISTIC
/begin CHARACTERISTIC Cxx_inc_slop_dgi_sp "Type of increase slope for the diagnosis and protection idle speed setpoint (1=Low 2=Med 3=Fast)" VALUE 0xa00216d4 _REC_S1VAL_20_u1 2. _CNV_A_R_ECME_LINEA_0_CM 1. 3. FORMAT "%1.0" /end CHARACTERISTIC
/begin CHARACTERISTIC Cxx_inc_slop_diag_vvtc_sp "Type of increase slope for the VVTC routine idle speed setpoint (1=Low 2=Med 3=Fast)" VALUE 0xa00216d5 _REC_S1VAL_20_u1 2. _CNV_A_R_ECME_LINEA_0_CM 1. 3. FORMAT "%3.0" /end CHARACTERISTIC
/begin CHARACTERISTIC Cxx_inc_slop_el_bk_sp "Type of increase slope for the electrical backlite idle speed setpoint (1=Low 2=Med 3=Fast)" VALUE 0xa00216d6 _REC_S1VAL_20_u1 2. _CNV_A_R_ECME_LINEA_0_CM 1. 3. FORMAT "%1.0" /end CHARACTERISTIC
/begin CHARACTERISTIC Cxx_inc_slop_el_wind_sp "Type of increase  slope for the electrical windshield idle speed setpoint (1=Low 2=Med 3=Fast)" VALUE 0xa00216d7 _REC_S1VAL_20_u1 2. _CNV_A_R_ECME_LINEA_0_CM 1. 3. FORMAT "%1.0" /end CHARACTERISTIC
/begin CHARACTERISTIC Cxx_inc_slop_inj_sp "Type of increase slope for the injector idle speed setpoint (1=Low 2=Med 3=Fast)" VALUE 0xa00216d8 _REC_S1VAL_20_u1 2. _CNV_A_R_ECME_LINEA_0_CM 1. 3. FORMAT "%1.0" /end CHARACTERISTIC
/begin CHARACTERISTIC Cxx_inc_slop_moni_sp "Type of increase  slope for the monitool idle speed setpoint (1=Low 2=Med 3=Fast)" VALUE 0xa00216d9 _REC_S1VAL_20_u1 2. _CNV_A_R_ECME_LINEA_0_CM 1. 3. FORMAT "%1.0" /end CHARACTERISTIC
/begin CHARACTERISTIC Cxx_inc_slop_pft_sp "Type of increase  slope for the particle filter idle speed setpoint (1=Low 2=Med 3=Fast)" VALUE 0xa00216da _REC_S1VAL_20_u1 2. _CNV_A_R_ECME_LINEA_0_CM 1. 3. FORMAT "%1.0" /end CHARACTERISTIC
/begin CHARACTERISTIC Cxx_inc_slop_ptc_sp "Type of increase  slope for the PTC idle speed setpoint (1=Low 2=Med 3=Fast)" VALUE 0xa00216db _REC_S1VAL_20_u1 2. _CNV_A_R_ECME_LINEA_0_CM 1. 3. FORMAT "%1.0" /end CHARACTERISTIC
/begin CHARACTERISTIC Cxx_inc_slop_pwst_sp "Type of increase  slope for the power steering idle speed setpoint (1=Low 2=Med 3=Fast)" VALUE 0xa00216dc _REC_S1VAL_20_u1 2. _CNV_A_R_ECME_LINEA_0_CM 1. 3. FORMAT "%1.0" /end CHARACTERISTIC
/begin CHARACTERISTIC Cxx_inc_slop_run_vh_sp "Type of increase  slope for the running vehicle idle speed setpoint (1=Low 2=Med 3=Fast)" VALUE 0xa00216dd _REC_S1VAL_20_u1 2. _CNV_A_R_ECME_LINEA_0_CM 1. 3. FORMAT "%1.0" /end CHARACTERISTIC
/begin CHARACTERISTIC Cxx_inc_slop_tco_sp "Type of increase  slope for the coolant temperature idle speed setpoint (1=Low 2=Med 3=Fast)" VALUE 0xa00216de _REC_S1VAL_20_u1 2. _CNV_A_R_ECME_LINEA_0_CM 1. 3. FORMAT "%1.0" /end CHARACTERISTIC
/begin CHARACTERISTIC Cxx_inc_slop_thpl_sp "Type of increase  slope for the thermoplunger idle speed setpoint (1=Low 2=Med 3=Fast)" VALUE 0xa00216df _REC_S1VAL_20_u1 2. _CNV_A_R_ECME_LINEA_0_CM 1. 3. FORMAT "%1.0" /end CHARACTERISTIC
/begin CHARACTERISTIC Cxx_is_n_sp_max "Maximum idle speed setpoint authorized" VALUE 0xa00216ae _REC_S1VAL_20_u2 16383.75 _CNV_A_R_ENSD_LINEA_24_CM 0. 16383.75 FORMAT "%8.2" /end CHARACTERISTIC
/begin CHARACTERISTIC Cxx_is_n_sp_min "Minimum idle speed setpoint authorized" VALUE 0xa00216b0 _REC_S1VAL_20_u2 16383.75 _CNV_A_R_ENSD_LINEA_24_CM 0. 16383.75 FORMAT "%8.2" /end CHARACTERISTIC
/begin CHARACTERISTIC Cxx_med_dec_slop "Value for the medium decrease slope" VALUE 0xa00216b2 _REC_S1VAL_20_u2 65535. _CNV_A_R_LINEAR_____330_CM -65535. 0. FORMAT "%4.0" /end CHARACTERISTIC
/begin CHARACTERISTIC Cxx_med_inc_slop "Value for the medium increase slope" VALUE 0xa00216b4 _REC_S1VAL_20_u2 65535. _CNV_A_R_LINEAR_____23_CM 0. 65535. FORMAT "%4.0" /end CHARACTERISTIC
/begin CHARACTERISTIC Cxx_moni_is_n_sp_max "Maximum idle speed setpoint authorized in case of monitool request" VALUE 0xa00216b6 _REC_S1VAL_20_u2 16383.75 _CNV_A_R_ENSD_LINEA_24_CM 0. 16383.75 FORMAT "%8.2" /end CHARACTERISTIC
/begin CHARACTERISTIC Cxx_n_sp_dec "Idle speed setpoint decrementation" VALUE 0xa00216b8 _REC_S1VAL_20_u2 65535. _CNV_A_R_LINEAR_____330_CM -65535. 0. FORMAT "%4.0" /end CHARACTERISTIC
/begin CHARACTERISTIC Cxx_run_vh_min_is_n_dsb "Threshold composed to V/Neng ratio, which desables the running vehicle idle speed setpoint" VALUE 0xa00216ba _REC_S1VAL_20_s2 210. _CNV_A_R_LINEAR_____331_CM -10. 200. FORMAT "%6.2" /end CHARACTERISTIC
/begin CHARACTERISTIC Cxx_slow_dec_slop "Value for the slow decrease slope" VALUE 0xa00216bc _REC_S1VAL_20_u2 65535. _CNV_A_R_LINEAR_____330_CM -65535. 0. FORMAT "%4.0" /end CHARACTERISTIC
/begin CHARACTERISTIC Cxx_slow_inc_slop "Value for the slow increase slope" VALUE 0xa00216be _REC_S1VAL_20_u2 65535. _CNV_A_R_LINEAR_____23_CM 0. 65535. FORMAT "%4.0" /end CHARACTERISTIC
/begin CHARACTERISTIC Ctp_agb_tco_min_is_n "Idle speed setpoint which depends of the coolant temperature in 'Drive' position" CURVE 0xa002935c _REC_A1CUR_20_u2_u2 16383.75 _CNV_A_R_ENSD_LINEA_24_CM 0. 16383.75 FORMAT "%8.2"
 /begin AXIS_DESCR COM_AXIS Vxx_tco _CNV_A_R_LINEAR_____54_CM 16 -40. 200. FORMAT "%5.1" AXIS_PTS_REF Ctb_tco /end AXIS_DESCR
/end CHARACTERISTIC
/begin CHARACTERISTIC Ctp_drag_tco_min_is_n "Idle speed setpoint which depends of the coolant temperature in case of drag reduction" CURVE 0xa002937c _REC_A1CUR_20_u2_u2 16383.75 _CNV_A_R_ENSD_LINEA_24_CM 0. 16383.75 FORMAT "%8.2"
 /begin AXIS_DESCR COM_AXIS Vxx_tco _CNV_A_R_LINEAR_____54_CM 16 -40. 200. FORMAT "%5.1" AXIS_PTS_REF Ctb_tco /end AXIS_DESCR
/end CHARACTERISTIC
/begin MEASUREMENT Vbx_agb_is_clc_ena "Activation (1) or deactivation (0) of the calculation of the AGB idle speed setpoints." UBYTE _CNV_S_2_RANGE______3_CM 1 0. 0. 1. ECU_ADDRESS 0xd0004822 BIT_MASK 0x1 /end MEASUREMENT
/begin MEASUREMENT Vbx_is_run_vh_min_crp "Detection vehicle running/creeping to specific setpoint" UBYTE _CNV_S_2_RANGE______3_CM 1 0. 0. 1. ECU_ADDRESS 0xd0004823 BIT_MASK 0x1 /end MEASUREMENT
/begin MEASUREMENT Vxx_agb_min_is_n "Automatic Transmission idle speed setpoint required" UWORD _CNV_A_R_ENSD_LINEA_24_CM 1 0. 0. 16383.75 ECU_ADDRESS 0xd0002ee2 FORMAT "%8.2" /end MEASUREMENT
/begin MEASUREMENT Vxx_tco_agb_min_is_n "Nominal idle speed setpoint under drive or drag reduction mode" UWORD _CNV_A_R_ENSD_LINEA_24_CM 1 0. 0. 16383.75 ECU_ADDRESS 0xd0005866 FORMAT "%8.2" /end MEASUREMENT
/begin CHARACTERISTIC Cxx_agb_min_is_n "Idle speed setpoint under request of the AT" VALUE 0xa00219a0 _REC_S1VAL_20_u2 16383.75 _CNV_A_R_ENSD_LINEA_24_CM 0. 16383.75 FORMAT "%8.2" /end CHARACTERISTIC
/begin CHARACTERISTIC Cxx_is_run_vh_min_crp "Threshold of speed vehicle to cancel the increase of idle speed setpoint in case of vehicle creeping" VALUE 0xa00219a2 _REC_S1VAL_20_u2 655.35 _CNV_A_R_LINEAR_____70_CM 0. 655.35 FORMAT "%6.2" /end CHARACTERISTIC
/begin CHARACTERISTIC Cxx_tco_agb_df_min_is_n "Nominal idle speed setpoint calibration in case of a validity status default under drive or drag reduction mode" VALUE 0xa00219a4 _REC_S1VAL_20_u2 16383.75 _CNV_A_R_ENSD_LINEA_24_CM 0. 16383.75 FORMAT "%8.2" /end CHARACTERISTIC
/begin CHARACTERISTIC Ctp_toil_is_n_ofs "Idle speed offset table for protection in case of igh oil temperature" CURVE 0xa00252c8 _REC_A1CUR_20_u2_u2 16383.75 _CNV_A_R_ENSD_LINEA_24_CM 0. 16383.75 FORMAT "%8.2"
 /begin AXIS_DESCR COM_AXIS Vxx_toil _CNV_A_R_LINEAR_____54_CM 16 -40. 200. FORMAT "%5.1" AXIS_PTS_REF Ctb_toil /end AXIS_DESCR
/end CHARACTERISTIC
/begin MEASUREMENT Vbx_diag_sta_ndec_abrt "ISR routine aborted status (for decrease)" UBYTE _CNV_S_2_RANGE______3_CM 1 0. 0. 1. ECU_ADDRESS 0xd000505d BIT_MASK 0x1 /end MEASUREMENT
/begin MEASUREMENT Vbx_diag_sta_ninc_abrt "ISR routine aborted status (for increase)" UBYTE _CNV_S_2_RANGE______3_CM 1 0. 0. 1. ECU_ADDRESS 0xd000505e BIT_MASK 0x1 /end MEASUREMENT
/begin MEASUREMENT Vxx_diag_vvtc_min_is_n "VVTC routine idle speed setpoint" UWORD _CNV_A_R_ENSD_LINEA_24_CM 1 0. 0. 16383.75 ECU_ADDRESS 0xd000582c FORMAT "%8.2" /end MEASUREMENT
/begin MEASUREMENT Vxx_inj_vld_min_is_n "Injector failure idle speed setpoint" UWORD _CNV_A_R_ENSD_LINEA_24_CM 1 0. 0. 16383.75 ECU_ADDRESS 0xd000582e FORMAT "%8.2" /end MEASUREMENT
/begin MEASUREMENT Vxx_moni_min_is_n "Monitool idle speed setpoint" UWORD _CNV_A_R_ENSD_LINEA_24_CM 1 0. 0. 16383.75 ECU_ADDRESS 0xd0005830 FORMAT "%8.2" /end MEASUREMENT
/begin MEASUREMENT Vxx_n_vld_min_is_n "Engine speed sensor failure idle speed setpoint" UWORD _CNV_A_R_ENSD_LINEA_24_CM 1 0. 0. 16383.75 ECU_ADDRESS 0xd0005832 FORMAT "%8.2" /end MEASUREMENT
/begin MEASUREMENT Vxx_prs_dft_min_is_n "Manifold pressure sensor failure idle speed setpoint" UWORD _CNV_A_R_ENSD_LINEA_24_CM 1 0. 0. 16383.75 ECU_ADDRESS 0xd0005834 FORMAT "%8.2" /end MEASUREMENT
/begin MEASUREMENT Vxx_toil_is_n_ofs "High oil temperature protection idle speed setpoint offset" UWORD _CNV_A_R_ENSD_LINEA_24_CM 1 0. 0. 16383.75 ECU_ADDRESS 0xd0005836 FORMAT "%8.2" /end MEASUREMENT
/begin CHARACTERISTIC Cxx_inj_vld_min_is_n "Default value if a default is detected on the engine speed sensor" VALUE 0xa0021ed2 _REC_S1VAL_20_u2 16383.75 _CNV_A_R_ENSD_LINEA_24_CM 0. 16383.75 FORMAT "%8.2" /end CHARACTERISTIC
/begin CHARACTERISTIC Cxx_n_vld_min_is_n "Default value if a default is detected on the engine speed sensor" VALUE 0xa0021ed4 _REC_S1VAL_20_u2 16383.75 _CNV_A_R_ENSD_LINEA_24_CM 0. 16383.75 FORMAT "%8.2" /end CHARACTERISTIC
/begin CHARACTERISTIC Cxx_prs_dft_min_is_n "Minimum after-sale idle speed setpoint" VALUE 0xa0021ed6 _REC_S1VAL_20_u2 16383.75 _CNV_A_R_ENSD_LINEA_24_CM 0. 16383.75 FORMAT "%8.2" /end CHARACTERISTIC
/begin CHARACTERISTIC Cxx_toil_is_n_ofs "Minimum after-sale idle speed setpoint" VALUE 0xa0021ed8 _REC_S1VAL_20_u2 16383.75 _CNV_A_R_ENSD_LINEA_24_CM 0. 16383.75 FORMAT "%8.2" /end CHARACTERISTIC
/begin CHARACTERISTIC Ctp_is_ast_ofs "Offset (depending coolant temperature) about idle speed setpoint to create after start state threshold" CURVE 0xa0025078 _REC_A1CUR_20_u2_u2 16383.75 _CNV_A_R_LINEAR_____124_CM -8192. 8191.75 FORMAT "%7.2"
 /begin AXIS_DESCR COM_AXIS Vxx_tco _CNV_A_R_LINEAR_____54_CM 8 -40. 200. FORMAT "%5.1" AXIS_PTS_REF Ctb_sta_tco /end AXIS_DESCR
/end CHARACTERISTIC
/begin CHARACTERISTIC Ctp_max_ftc_dyn_is_sp "Maximal limitation allowing to saturate the constant of time according to the gera ratio" CURVE 0xa0025088 _REC_A1CUR_20_u2_u1 655.35 _CNV_A_R_LINEAR_____34_CM 0. 655.35 FORMAT "%6.2"
 /begin AXIS_DESCR COM_AXIS Vxx_gear _CNV_A_R_LINEAR_____113_CM 8 -1. 6. READ_ONLY FORMAT "%2.0" AXIS_PTS_REF Ntb_gear /end AXIS_DESCR
/end CHARACTERISTIC
/begin MEASUREMENT Vbx_dyn_is_n_sp_rst "Boolean indicating if an overshoot of engine speed in Cdn and Act states" UBYTE _CNV_S_2_RANGE______3_CM 1 0. 0. 1. ECU_ADDRESS 0xd0003e01 BIT_MASK 0x1 /end MEASUREMENT
/begin MEASUREMENT Vxx_dyn_is_n_sp "Dynamic idle speed setpoint" UWORD _CNV_A_R_ENSD_LINEA_24_CM 1 0. 0. 16383.75 ECU_ADDRESS 0xd000373c FORMAT "%8.2" /end MEASUREMENT
/begin MEASUREMENT Vxx_ftc_dyn "Factor of filtering of the engine speed to teh dynamic setpoint" UWORD _CNV_A_R_LINEAR_____34_CM 1 0. 0. 655.35 ECU_ADDRESS 0xd000373e FORMAT "%6.2" /end MEASUREMENT
/begin MEASUREMENT Vxx_ftc_dyn_n_drv "Filtered derivate of engine speed" SWORD _CNV_A_R_LINEAR_____23_CM 1 0. -8192. 8191. ECU_ADDRESS 0xd0003740 FORMAT "%5.0" /end MEASUREMENT
/begin CHARACTERISTIC Cxx_fac_n_drv_ftc_dyn "Factor of filtering of derivate of engine speed" VALUE 0xa0020cbe _REC_S1VAL_20_u2 655.35 _CNV_A_R_LINEAR_____34_CM 0. 655.35 FORMAT "%6.2" /end CHARACTERISTIC
/begin CHARACTERISTIC Cxx_is_out_dyn_ofs "Offset on the dynamic setpoint to reset the dynamic setpoint in Cdn and Act states about in case of an overshoot of engine speed" VALUE 0xa0020cc0 _REC_S1VAL_20_u2 16383.75 _CNV_A_R_ENSD_LINEA_24_CM 0. 16383.75 FORMAT "%8.2" /end CHARACTERISTIC
/begin CHARACTERISTIC Cxx_k_ftc_dyn_is_sp "Filter factor for dynamic setpoint of ISR" VALUE 0xa0020cc2 _REC_S1VAL_20_u2 655.35 _CNV_A_R_LINEAR_____136_CM 0. 655.35 FORMAT "%6.2" /end CHARACTERISTIC
/begin CHARACTERISTIC Cxx_min_ftc_dyn_is_sp "Minimal limitation allowing to saturate the constant of time" VALUE 0xa0020cc4 _REC_S1VAL_20_u2 655.35 _CNV_A_R_LINEAR_____34_CM 0. 655.35 FORMAT "%6.2" /end CHARACTERISTIC
/begin AXIS_PTS Ctb_el_csm_n_sp_ofs "breackpoint table used for the calculation of the electric balance idle speed setpoint offset" 0xa002e030 Vxx_el_csm_ctr _REC_A2AXS_20_u1 255. _CNV_A_R_ECME_LINEA_0_CM 9 0. 255. FORMAT "%3.0" /end AXIS_PTS
/begin CHARACTERISTIC Ctp_el_csm_n_sp_ofs "interpolation table used for the calculation of the electric balance protection idle setpoint offset" CURVE 0xa002e03c _REC_A1CUR_20_u2_u1 16383.75 _CNV_A_R_ENSD_LINEA_24_CM 0. 16383.75 FORMAT "%8.2"
 /begin AXIS_DESCR COM_AXIS Vxx_el_csm_ctr _CNV_A_R_ECME_LINEA_0_CM 9 0. 255. FORMAT "%3.0" AXIS_PTS_REF Ctb_el_csm_n_sp_ofs /end AXIS_DESCR
/end CHARACTERISTIC
/begin MEASUREMENT Vbx_el_csm_clc_ena "electric balance protection Idle speed setpoint calculation enabled" UBYTE _CNV_S_2_RANGE______3_CM 1 0. 0. 1. ECU_ADDRESS 0xd0005582 BIT_MASK 0x1 /end MEASUREMENT
/begin MEASUREMENT Vxx_el_bk_wind_min_is_n "Electric backlite idle speed setpoint" UWORD _CNV_A_R_ENSD_LINEA_24_CM 1 0. 0. 16383.75 ECU_ADDRESS 0xd0005842 FORMAT "%8.2" /end MEASUREMENT
/begin MEASUREMENT Vxx_el_wind_min_is_n "Electric balance counter" UWORD _CNV_A_R_ENSD_LINEA_24_CM 1 0. 0. 16383.75 ECU_ADDRESS 0xd0005844 FORMAT "%8.2" /end MEASUREMENT
/begin MEASUREMENT Vxx_min_vb_is_ofs "Electric balance protection idle speed setpoint offset" UWORD _CNV_A_R_ENSD_LINEA_24_CM 1 0. 0. 16383.75 ECU_ADDRESS 0xd0005846 FORMAT "%8.2" /end MEASUREMENT
/begin MEASUREMENT Vxx_ptc_min_is_n "PTC idle speed setpoint" UWORD _CNV_A_R_ENSD_LINEA_24_CM 1 0. 0. 16383.75 ECU_ADDRESS 0xd0005848 FORMAT "%8.2" /end MEASUREMENT
/begin MEASUREMENT Vxx_thpl_min_is_n "thermoplunger idle speed setpoint" UWORD _CNV_A_R_ENSD_LINEA_24_CM 1 0. 0. 16383.75 ECU_ADDRESS 0xd000584a FORMAT "%8.2" /end MEASUREMENT
/begin CHARACTERISTIC Cxx_agb_wind_min_is_n "Electric windshield idle speed setpoint calibration under drive mode of the AT" VALUE 0xa0021936 _REC_S1VAL_20_u2 16383.75 _CNV_A_R_ENSD_LINEA_24_CM 0. 16383.75 FORMAT "%8.2" /end CHARACTERISTIC
/begin CHARACTERISTIC Cxx_el_bk_wind_is_n "Electric backlite idle speed setpoint calibration" VALUE 0xa0021938 _REC_S1VAL_20_u2 16383.75 _CNV_A_R_ENSD_LINEA_24_CM 0. 16383.75 FORMAT "%8.2" /end CHARACTERISTIC
/begin CHARACTERISTIC Cxx_el_csm_alt_cut_dly "Inhibition of the delay of the calculation of the idle speed setpoint offset under alternator requests" VALUE 0xa0021942 _REC_S1VAL_20_u1 25.5 _CNV_A_R_LINEAR_____4_CM 0. 25.5 FORMAT "%4.1" /end CHARACTERISTIC
/begin CHARACTERISTIC Cxx_el_csm_clc_dly "Inhibition of the delay of the calculation of the idle speed setpoint offset after engine start" VALUE 0xa0021943 _REC_S1VAL_20_u1 25.5 _CNV_A_R_LINEAR_____4_CM 0. 25.5 FORMAT "%4.1" /end CHARACTERISTIC
/begin CHARACTERISTIC Cxx_el_csm_clc_neg_fac "Gain used for the calculation of the electric balance protection counter" VALUE 0xa0021944 _REC_S1VAL_20_u1 1. _CNV_A_R_LINEAR_____332_CM 0. 1. FORMAT "%5.3" /end CHARACTERISTIC
/begin CHARACTERISTIC Cxx_el_csm_clc_neut_vb "electric balance protection voltage reference" VALUE 0xa002193a _REC_S1VAL_20_u2 25000. _CNV_A_R_LINEAR_____52_CM 0. 25000. FORMAT "%5.0" /end CHARACTERISTIC
/begin CHARACTERISTIC Cxx_el_csm_clc_pos_fac "Gain used for the calculation of the electric balance protection counter" VALUE 0xa0021945 _REC_S1VAL_20_u1 1. _CNV_A_R_LINEAR_____332_CM 0. 1. FORMAT "%5.3" /end CHARACTERISTIC
/begin CHARACTERISTIC Cxx_el_wind_tco "Engine coolant temperature threshold which not allowed electric windshield idle speed setpoint" VALUE 0xa002193c _REC_S1VAL_20_u2 240. _CNV_A_R_LINEAR_____54_CM -40. 200. FORMAT "%5.1" /end CHARACTERISTIC
/begin CHARACTERISTIC Cxx_ptc_min_is_n "PTC idle speed setpoint calibration" VALUE 0xa002193e _REC_S1VAL_20_u2 16383.75 _CNV_A_R_ENSD_LINEA_24_CM 0. 16383.75 FORMAT "%8.2" /end CHARACTERISTIC
/begin CHARACTERISTIC Cxx_thpl_min_is_n "Thermoplunger idle speed setpoint calibration" VALUE 0xa0021940 _REC_S1VAL_20_u2 16383.75 _CNV_A_R_ENSD_LINEA_24_CM 0. 16383.75 FORMAT "%8.2" /end CHARACTERISTIC
/begin AXIS_PTS Ctb_ac_forb_is_n "Idle speed breakpoints used to avoid critical engine speed requested by AC" 0xa0024eec Vxx_ac_acel_is_sp _REC_A2AXS_20_u2 16383.75 _CNV_A_R_ENSD_LINEA_24_CM 16 0. 16383.75 FORMAT "%8.2" /end AXIS_PTS
/begin CHARACTERISTIC Ctp_ac_forb_is_n "Idle speed table used to avoid critical engine speed requested by AC" CURVE 0xa0024f10 _REC_A1CUR_20_u2_u2 16383.75 _CNV_A_R_ENSD_LINEA_24_CM 0. 16383.75 FORMAT "%8.2"
 /begin AXIS_DESCR COM_AXIS Vxx_ac_acel_is_sp _CNV_A_R_ENSD_LINEA_24_CM 16 0. 16383.75 FORMAT "%8.2" AXIS_PTS_REF Ctb_ac_forb_is_n /end AXIS_DESCR
/end CHARACTERISTIC
/begin CHARACTERISTIC Ctp_agb_ac_min_is_n "Cartography to compute a minimum idle speed for engine needs when AC is active (EGB in drive mode)" CURVE 0xa0024f30 _REC_A1CUR_20_u2_u2 16383.75 _CNV_A_R_ENSD_LINEA_24_CM 0. 16383.75 FORMAT "%8.2"
 /begin AXIS_DESCR COM_AXIS Vxx_tco _CNV_A_R_LINEAR_____54_CM 16 -40. 200. FORMAT "%5.1" AXIS_PTS_REF Ctb_tco /end AXIS_DESCR
/end CHARACTERISTIC
/begin CHARACTERISTIC Ctp_pn_ac_min_is_n "Cartography to compute a minimum idle speed for engine needs when AC is active (EGB in neutral mode or MGB)" CURVE 0xa0024f50 _REC_A1CUR_20_u2_u2 16383.75 _CNV_A_R_ENSD_LINEA_24_CM 0. 16383.75 FORMAT "%8.2"
 /begin AXIS_DESCR COM_AXIS Vxx_tco _CNV_A_R_LINEAR_____54_CM 16 -40. 200. FORMAT "%5.1" AXIS_PTS_REF Ctb_tco /end AXIS_DESCR
/end CHARACTERISTIC
/begin MEASUREMENT Vbx_acs_acel_is_acel_pdl_cdn "Accelerator pedal condition in commercial vehicle accessories idle speed strategy" UBYTE _CNV_S_2_RANGE______3_CM 1 0. 0. 1. ECU_ADDRESS 0xd0005701 BIT_MASK 0x1 /end MEASUREMENT
/begin MEASUREMENT Vbx_acs_acel_is_brk_cdn "Brake pedal condition in commercial vehicle accessories idle speed strategy" UBYTE _CNV_S_2_RANGE______3_CM 1 0. 0. 1. ECU_ADDRESS 0xd0005702 BIT_MASK 0x1 /end MEASUREMENT
/begin MEASUREMENT Vbx_acs_acel_is_fail "Detection of a failure that causes commercial vehicle accessories accelerated idle speed deactivation" UBYTE _CNV_S_2_RANGE______3_CM 1 0. 0. 1. ECU_ADDRESS 0xd0005703 BIT_MASK 0x1 /end MEASUREMENT
/begin MEASUREMENT Vbx_acs_acel_is_vs_cdn "Vehicle speed condition in commercial vehicle accessories idle speed strategy" UBYTE _CNV_S_2_RANGE______3_CM 1 0. 0. 1. ECU_ADDRESS 0xd0005704 BIT_MASK 0x1 /end MEASUREMENT
/begin MEASUREMENT Vxx_ac_min_is_n "Air conditioning idle speed setpoint" UWORD _CNV_A_R_ENSD_LINEA_24_CM 1 0. 0. 16383.75 ECU_ADDRESS 0xd00059ee FORMAT "%8.2" /end MEASUREMENT
/begin MEASUREMENT Vxx_acs_min_is_n "Accessories idle speed setpoint" UWORD _CNV_A_R_ENSD_LINEA_24_CM 1 0. 0. 16383.75 ECU_ADDRESS 0xd00059f0 FORMAT "%8.2" /end MEASUREMENT
/begin MEASUREMENT Vxx_eng_ac_min_is_n "Air conditioning minimum idle speed for engine needs" UWORD _CNV_A_R_ENSD_LINEA_24_CM 1 0. 0. 16383.75 ECU_ADDRESS 0xd00059f2 FORMAT "%8.2" /end MEASUREMENT
/begin MEASUREMENT Vxx_pwst_min_is_n "Power steering idle speed setpoint" UWORD _CNV_A_R_ENSD_LINEA_24_CM 1 0. 0. 16383.75 ECU_ADDRESS 0xd00059f4 FORMAT "%8.2" /end MEASUREMENT
/begin CHARACTERISTIC Cbx_acs_acel_is_acel_pdl_cfm "Calibration to activate accelerator pedal condition in commercial vehicle accessories idle speed strategy" VALUE 0xa0021e14 _REC_S1VAL_20_u1 1. _CNV_A_R_ECME_LINEA_0_CM 0. 1. FORMAT "%1.0" BIT_MASK 0x1 /end CHARACTERISTIC
/begin CHARACTERISTIC Cbx_acs_acel_is_brk_cfm "Calibration to activate brake pedal condition in commercial vehicle accessories idle speed strategy" VALUE 0xa0021e15 _REC_S1VAL_20_u1 1. _CNV_A_R_ECME_LINEA_0_CM 0. 1. FORMAT "%1.0" BIT_MASK 0x1 /end CHARACTERISTIC
/begin CHARACTERISTIC Cbx_acs_acel_is_coup_cfm "Calibration to activate coupler state condition in commercial vehicle accessories idle speed strategy" VALUE 0xa0021e16 _REC_S1VAL_20_u1 1. _CNV_A_R_ECME_LINEA_0_CM 0. 1. FORMAT "%1.0" BIT_MASK 0x1 /end CHARACTERISTIC
/begin CHARACTERISTIC Cxx_ac_acel_is_dly "Air conditioning accelerated idle speed prolongation duration" VALUE 0xa0021e0a _REC_S1VAL_20_u2 6553.5 _CNV_A_R_LINEAR_____4_CM 0. 6553.5 FORMAT "%6.1" /end CHARACTERISTIC
/begin CHARACTERISTIC Cxx_acs_acel_is_thd "Commercial vehicle accessories idle speed threshold" VALUE 0xa0021e0c _REC_S1VAL_20_u2 16383.75 _CNV_A_R_ENSD_LINEA_24_CM 0. 16383.75 FORMAT "%8.2" /end CHARACTERISTIC
/begin CHARACTERISTIC Cxx_agb_pwst_min_is_n "Power steering accelerated idle speed (EGB in drive mode)" VALUE 0xa0021e0e _REC_S1VAL_20_u2 16383.75 _CNV_A_R_ENSD_LINEA_24_CM 0. 16383.75 FORMAT "%8.2" /end CHARACTERISTIC
/begin CHARACTERISTIC Cxx_pn_pwst_min_is_n "Power steering accelerated idle speed (EGB in neutral mode or MGB)" VALUE 0xa0021e10 _REC_S1VAL_20_u2 16383.75 _CNV_A_R_ENSD_LINEA_24_CM 0. 16383.75 FORMAT "%8.2" /end CHARACTERISTIC
/begin CHARACTERISTIC Cxx_pwst_is_acel_rtn_dly "Power steering accelerated idle speed prolongation duration" VALUE 0xa0021e12 _REC_S1VAL_20_u2 6553.5 _CNV_A_R_LINEAR_____4_CM 0. 6553.5 FORMAT "%6.1" /end CHARACTERISTIC
/begin AXIS_PTS Ctb_fzy_tkof_tqe_grd "Torque gradient breakpoints for take-off situation evaluation" 0xa002bc3c Vxx_driv_tqe_sp_grd _REC_A2AXS_20_u2 1300. _CNV_A_R_LINEAR_____333_CM 9 -650. 650. FORMAT "%5.2" /end AXIS_PTS
/begin AXIS_PTS Ctb_tkof_vs_n_rat "breakpoints de Ratio Vitesse/R√©gime" 0xa002bc50 Vxx_vs_n_rat_fil _REC_A2AXS_20_u2 210. _CNV_A_R_LINEAR_____140_CM 7 -10. 200. FORMAT "%6.2" /end AXIS_PTS
/begin CHARACTERISTIC Ctp_fzy_tkof_tqe_grd_fac "Take-off situation evaluation depending on torque gradient." CURVE 0xa002bc60 _REC_A1CUR_20_u1_u2 0.99609375 _CNV_A_R_LINEAR_____31_CM 0. 0.99609375 FORMAT "%10.8"
 /begin AXIS_DESCR COM_AXIS Vxx_driv_tqe_sp_grd _CNV_A_R_LINEAR_____333_CM 9 -650. 650. FORMAT "%5.2" AXIS_PTS_REF Ctb_fzy_tkof_tqe_grd /end AXIS_DESCR
/end CHARACTERISTIC
/begin CHARACTERISTIC Ctp_fzy_tkof_vs_n_rat_fac "Take-off situation evaluation depending on vehicle speed/engine speed ratio." CURVE 0xa0021e18 _REC_A1CUR_20_u1_u2 0.99609375 _CNV_A_R_LINEAR_____31_CM 0. 0.99609375 FORMAT "%10.8"
 /begin AXIS_DESCR COM_AXIS Vxx_vs_n_rat_fil _CNV_A_R_LINEAR_____140_CM 7 -10. 200. FORMAT "%6.2" AXIS_PTS_REF Ctb_tkof_vs_n_rat /end AXIS_DESCR
/end CHARACTERISTIC
/begin MEASUREMENT Vxx_driv_tqe_sp_grd "Raw driver torque gradient" UWORD _CNV_A_R_LINEAR_____333_CM 1 0. -650. 650. ECU_ADDRESS 0xd0003060 FORMAT "%5.2" /end MEASUREMENT
/begin MEASUREMENT Vxx_driv_tqe_sp_sat "Torque Setpoint before AJS Correction action and after saturation to maximal torque" UWORD _CNV_A_R_LINEAR_____161_CM 1 0. -400. 1647.96875 ECU_ADDRESS 0xd0003062 FORMAT "%10.5" /end MEASUREMENT
/begin MEASUREMENT Vxx_fzy_tkof "Take-off situation evaluation" UBYTE _CNV_A_R_LINEAR_____31_CM 1 0. 0. 0.99609375 ECU_ADDRESS 0xd0004b82 FORMAT "%10.8" /end MEASUREMENT
/begin MEASUREMENT Vxx_mfld_dly_fil_fac "Filtering factor for the manifold model" UWORD _CNV_A_R_LINEAR_____9_CM 1 0. 0. 0.9999847412109381 ECU_ADDRESS 0xd0003064 FORMAT "%7.5" /end MEASUREMENT
/begin MEASUREMENT Vxx_n_tkof_inrt "Global inertia evaluated at the engine, for take-off engine speed setpoint calculation." UBYTE _CNV_A_R_LINEAR_____334_CM 1 0. 0. 2.55 ECU_ADDRESS 0xd0004b83 FORMAT "%4.2" /end MEASUREMENT
/begin MEASUREMENT Vxx_tkof_dly_tqe_sp "Raw driver torque setpoint, filtered with manifold dynamic and engine delay." UWORD _CNV_A_R_LINEAR_____161_CM 1 0. -400. 1647.96875 ECU_ADDRESS 0xd0003066 FORMAT "%10.5" /end MEASUREMENT
/begin MEASUREMENT Vxx_tkof_mdl_n_drv "modeled derivate of engine speed for take off" SWORD _CNV_A_R_LINEAR_____23_CM 1 0. -8192. 8191. ECU_ADDRESS 0xd0003068 FORMAT "%5.0" /end MEASUREMENT
/begin MEASUREMENT Vxx_tkof_mdl_n_drv_1 "modeled derivate of engine speed for take off on gear 1" SWORD _CNV_A_R_LINEAR_____23_CM 1 0. -8192. 8191. ECU_ADDRESS 0xd000306a FORMAT "%5.0" /end MEASUREMENT
/begin MEASUREMENT Vxx_tkof_mfld_tqe_sp "Raw driver torque setpoint, filtered with manifold dynamic." UWORD _CNV_A_R_LINEAR_____161_CM 1 0. -400. 1647.96875 ECU_ADDRESS 0xd000306c FORMAT "%10.5" /end MEASUREMENT
/begin MEASUREMENT Vxx_tkof_n_sp "Engine speed  setpoint for take-off" UWORD _CNV_A_R_ENSD_LINEA_24_CM 1 0. 0. 16383.75 ECU_ADDRESS 0xd000306e FORMAT "%8.2" /end MEASUREMENT
/begin MEASUREMENT Vxx_tkof_tqe_sp "Raw driver torque setpoint, filtered with manifold dynamic and engine delay." UWORD _CNV_A_R_LINEAR_____161_CM 1 0. -400. 1647.96875 ECU_ADDRESS 0xd0003070 FORMAT "%10.5" /end MEASUREMENT
/begin MEASUREMENT Vxx_tq_air_dly_t "pure delay between the air intake and the supply of torque" UBYTE _CNV_A_R_LINEAR_____34_CM 1 0. 0. 2.55 ECU_ADDRESS 0xd0004b84 FORMAT "%4.2" /end MEASUREMENT
/begin CHARACTERISTIC Cbx_tkof_tqe_sp_dec_cfm "if Cbx_tkof_tqe_sp_dec_cfm = 1, the manifold dynamics is take into account during increase or decrease of torque" VALUE 0xa0021e22 _REC_S1VAL_20_u1 1. _CNV_A_R_ECME_LINEA_0_CM 0. 1. FORMAT "%1.0" BIT_MASK 0x1 /end CHARACTERISTIC
/begin CHARACTERISTIC Cxx_air_tq_dly_tdc_fac "factor on tdc period to calculate pure delay." VALUE 0xa0021e23 _REC_S1VAL_20_u1 3.984375 _CNV_A_R_LINEAR_____175_CM 0. 3.984375 FORMAT "%7.5" /end CHARACTERISTIC
/begin CHARACTERISTIC Cxx_fzy_tkof_lim_dec_t "Characteristic time of diminution of Vxx_fzy_tkof (minimun time to go from 1 to 0)" VALUE 0xa0021e24 _REC_S1VAL_20_u1 25.5 _CNV_A_R_LINEAR_____4_CM 0. 25.5 FORMAT "%4.1" /end CHARACTERISTIC
/begin CHARACTERISTIC Cxx_mfld_tkof_dly_fac "manifold time delay factor" VALUE 0xa0021e25 _REC_S1VAL_20_u1 1.9921875 _CNV_A_R_LINEAR_____43_CM 0. 1.9921875 FORMAT "%8.6" /end CHARACTERISTIC
/begin CHARACTERISTIC Cxx_n_tkof_fil_fac "Filtering factor to insure the stability of the vacuous accelerations." VALUE 0xa0021e26 _REC_S1VAL_20_u1 0.99609375 _CNV_A_R_LINEAR_____31_CM 0. 0.99609375 FORMAT "%10.8" /end CHARACTERISTIC
/begin CHARACTERISTIC Cxx_n_tkof_inrt_0 "Engine inertia" VALUE 0xa0021e27 _REC_S1VAL_20_u1 2.55 _CNV_A_R_LINEAR_____334_CM 0. 2.55 FORMAT "%4.2" /end CHARACTERISTIC
/begin CHARACTERISTIC Cxx_n_tkof_inrt_1 "Vehicle+engine inertia when on first gear" VALUE 0xa0021e28 _REC_S1VAL_20_u1 2.55 _CNV_A_R_LINEAR_____334_CM 0. 2.55 FORMAT "%4.2" /end CHARACTERISTIC
/begin CHARACTERISTIC Cxx_tkof_n_dif_inrt_cge "Difference between current engine speed and setpoint for inertia shifting during take-off." VALUE 0xa0021e20 _REC_S1VAL_20_u2 16383.75 _CNV_A_R_ENSD_LINEA_24_CM 0. 16383.75 FORMAT "%8.2" /end CHARACTERISTIC
/begin CHARACTERISTIC Cxx_tkof_tqe_grd_t "filtering time for torque derivate" VALUE 0xa0021e29 _REC_S1VAL_20_u1 2.55 _CNV_A_R_LINEAR_____34_CM 0. 2.55 FORMAT "%4.2" /end CHARACTERISTIC
/begin MEASUREMENT Vsx_is_inj_vld "Injection validity status for Idle Speed" UBYTE _CNV_S_3_STATUS_OK__120_CM 1 0. 0. 2. ECU_ADDRESS 0xd0005518 /end MEASUREMENT
/begin CHARACTERISTIC Cmp_tco_amp_min_is_n_alco "Cartography (alcohol configuration) for idle speed setpoint according to the engine coolant temperature and atmospheric pressure" MAP 0xa002a400 _REC_A1MAP_20_u2_u2_u2 16383.75 _CNV_A_R_ENSD_LINEA_24_CM 0. 16383.75 FORMAT "%8.2"
 /begin AXIS_DESCR COM_AXIS Vxx_tco _CNV_A_R_LINEAR_____54_CM 16 -40. 200. FORMAT "%5.1" AXIS_PTS_REF Ctb_tco /end AXIS_DESCR
 /begin AXIS_DESCR COM_AXIS Vxx_amp _CNV_A_R_LINEAR_____57_CM 6 0. 20000. FORMAT "%5.0" AXIS_PTS_REF Ctb_eng_amp /end AXIS_DESCR
/end CHARACTERISTIC
/begin CHARACTERISTIC Ctp_cold_tdc_pn_is_n_ofs_alco "Idle speed setpoint offset during catalyst warm-up sequences with cold start conditions, under neutral mode of the AT (or manual" CURVE 0xa002a4c0 _REC_A1CUR_20_u2_u2 16383.75 _CNV_A_R_ENSD_LINEA_24_CM 0. 16383.75 FORMAT "%8.2"
 /begin AXIS_DESCR COM_AXIS Vxx_cata_wup_ctr _CNV_A_R_LINEAR_____55_CM 17 0. 65535. FORMAT "%5.0" AXIS_PTS_REF Ctb_cold_is_cata_wup_ctr /end AXIS_DESCR
/end CHARACTERISTIC
/begin CHARACTERISTIC Ctp_tdc_pn_tco_is_n_ofs_alco "Idle speed setpoint offset during catalyst warm-up phases without cold start conditions, under neutral mode of the AT (or manual" CURVE 0xa002a4e4 _REC_A1CUR_20_u2_u2 16383.75 _CNV_A_R_ENSD_LINEA_24_CM 0. 16383.75 FORMAT "%8.2"
 /begin AXIS_DESCR COM_AXIS Vxx_cata_wup_ctr _CNV_A_R_LINEAR_____55_CM 17 0. 65535. FORMAT "%5.0" AXIS_PTS_REF Ctb_is_cata_wup_ctr /end AXIS_DESCR
/end CHARACTERISTIC
/begin MEASUREMENT Vxx_cold_tdc_pn_is_n_ofs_alco "Idle speed setpoint offset during catalyst warm-up sequences with cold start conditions, under neutral mode of the AT (or manual\\r\\ngearbox)" UWORD _CNV_A_R_ENSD_LINEA_24_CM 1 0. 0. 16383.75 ECU_ADDRESS 0xd0003016 FORMAT "%8.2" /end MEASUREMENT
/begin MEASUREMENT Vxx_is_fuel_typ_rat_tra "Ratio dedicated to the idle speed regulation renamed" UWORD _CNV_A_R_LINEAR_____108_CM 1 0. 0. 1. ECU_ADDRESS 0xd0003018 /end MEASUREMENT
/begin MEASUREMENT Vxx_tco_amp_min_is_n_alco "Idle speed setpoint according to the engine coolant temperature and atmospheric pressure in alcohol configuration" UWORD _CNV_A_R_ENSD_LINEA_24_CM 1 0. 0. 16383.75 ECU_ADDRESS 0xd000301a FORMAT "%8.2" /end MEASUREMENT
/begin MEASUREMENT Vxx_tdc_pn_tco_is_n_ofs_alco "Idle speed setpoint offset during catalyst warm-up phases without cold start conditions, under neutral mode of the AT (or manual" UWORD _CNV_A_R_ENSD_LINEA_24_CM 1 0. 0. 16383.75 ECU_ADDRESS 0xd000301c FORMAT "%8.2" /end MEASUREMENT
/begin MEASUREMENT Vbx_diag_sta_ndec_ena "ISR routine activation status (for decrease)" UBYTE _CNV_S_2_RANGE______3_CM 1 0. 0. 1. ECU_ADDRESS 0xd0005201 BIT_MASK 0x1 /end MEASUREMENT
/begin MEASUREMENT Vbx_diag_sta_ndec_end "ISR routine activation status (for decrease)" UBYTE _CNV_S_2_RANGE______3_CM 1 0. 0. 1. ECU_ADDRESS 0xd0005202 BIT_MASK 0x1 /end MEASUREMENT
/begin MEASUREMENT Vbx_diag_sta_ninc_ena "ISR routine activation status (for increase)" UBYTE _CNV_S_2_RANGE______3_CM 1 0. 0. 1. ECU_ADDRESS 0xd0005203 BIT_MASK 0x1 /end MEASUREMENT
/begin MEASUREMENT Vbx_diag_sta_ninc_end "ISR routine activation status (for increase)" UBYTE _CNV_S_2_RANGE______3_CM 1 0. 0. 1. ECU_ADDRESS 0xd0005204 BIT_MASK 0x1 /end MEASUREMENT
/begin MEASUREMENT Vsx_diag_sta_ndec_stt "ndec routine status" UBYTE _CNV_S_4_RANGE_ROUT_335_CM 1 0. 0. 3. ECU_ADDRESS 0xd0005205 /end MEASUREMENT
/begin MEASUREMENT Vsx_diag_sta_ninc_stt "ninc routine status" UBYTE _CNV_S_4_RANGE_ROUT_335_CM 1 0. 0. 3. ECU_ADDRESS 0xd0005206 /end MEASUREMENT
/begin MEASUREMENT Vxx_diag_min_is_ofs "Temporary tuning idle speed setpoint offset" SWORD _CNV_A_R_ENSD_LINEA_24_CM 1 0. -8192. 8191.75 ECU_ADDRESS 0xd0005b62 FORMAT "%8.2" /end MEASUREMENT
/begin CHARACTERISTIC Cxx_diag_max_is_n "Maximum tuning idle speed setpoint offset authorized" VALUE 0xa0020fe4 _REC_S1VAL_20_s2 16383.75 _CNV_A_R_ENSD_LINEA_24_CM -8192. 8191.75 FORMAT "%8.2" /end CHARACTERISTIC
/begin CHARACTERISTIC Cxx_diag_min_is_n "Minimum tuning idle speed setpoint offset authorized" VALUE 0xa0020fe6 _REC_S1VAL_20_s2 16383.75 _CNV_A_R_ENSD_LINEA_24_CM -8192. 8191.75 FORMAT "%8.2" /end CHARACTERISTIC
/begin CHARACTERISTIC Cxx_n_step "Maximum tuning idle speed setpoint offset authorized" VALUE 0xa0020fe8 _REC_S1VAL_20_s2 16383.75 _CNV_A_R_ENSD_LINEA_24_CM -8192. 8191.75 FORMAT "%8.2" /end CHARACTERISTIC
/begin MEASUREMENT Vxx_sta_eng_dly_NVM "" UWORD _CNV_A_R_LINEAR_____34_CM 1 0. 0. 655.35 DISPLAY_IDENTIFIER OuCboInj_NVM.Vxx_sta_eng_dly_NVM ECU_ADDRESS 0xd0003ac2 FORMAT "%6.2" /end MEASUREMENT
/begin AXIS_PTS Ctb_mv_vb "Breakpoints for voltage battery correction table" 0xa002e2e4 Vxx_mv_vb _REC_A2AXS_20_u2 25000. _CNV_A_R_LINEAR_____52_CM 9 0. 25000. FORMAT "%5.0" /end AXIS_PTS
/begin CHARACTERISTIC Ctp_vb_inj_dly_cor "Voltage battery correction table" CURVE 0xa002e2f8 _REC_A1CUR_20_u2_u2 65535. _CNV_A_R_LINEAR_____145_CM 0. 65535. FORMAT "%5.0"
 /begin AXIS_DESCR COM_AXIS Vxx_mv_vb _CNV_A_R_LINEAR_____52_CM 9 0. 25000. FORMAT "%5.0" AXIS_PTS_REF Ctb_mv_vb /end AXIS_DESCR
/end CHARACTERISTIC
/begin MEASUREMENT Vxx_inj_dly "Opening delay" UWORD _CNV_A_R_LINEAR_____50_CM 1 0. 0. 262140. ECU_ADDRESS 0xd0003486 FORMAT "%6.0" /end MEASUREMENT
/begin MEASUREMENT Vxx_inj_dly_clc "Calculated opening delay from injection fuel type ratio" UWORD _CNV_A_R_LINEAR_____50_CM 1 0. 0. 262140. ECU_ADDRESS 0xc0000ba4 FORMAT "%6.0" /end MEASUREMENT
/begin MEASUREMENT Vxx_vb_inj_dly_cor "Opening delay correction (depending on measured voltage battery)" UWORD _CNV_A_R_LINEAR_____145_CM 1 0. 0. 65535. ECU_ADDRESS 0xd0003488 FORMAT "%5.0" /end MEASUREMENT
/begin CHARACTERISTIC Cxx_inj_dly "Opening delay for an optimal voltage battery" VALUE 0xa0021346 _REC_S1VAL_20_u2 262140. _CNV_A_R_LINEAR_____50_CM 0. 262140. FORMAT "%6.0" /end CHARACTERISTIC
/begin CHARACTERISTIC Cxx_inj_dly_alco "Opening delay for an optimal voltage battery for alcohol" VALUE 0xa0021348 _REC_S1VAL_20_u2 262140. _CNV_A_R_LINEAR_____50_CM 0. 262140. FORMAT "%6.0" /end CHARACTERISTIC
/begin MEASUREMENT Vbx_diag_sta_ffig_abrt "ffig aborded status" UBYTE _CNV_S_2_RANGE______3_CM 1 0. 0. 1. ECU_ADDRESS 0xd00040f5 BIT_MASK 0x1 /end MEASUREMENT
/begin MEASUREMENT Vbx_diag_sta_ffig_ena "ffig activation status" UBYTE _CNV_S_2_RANGE______3_CM 1 0. 0. 1. ECU_ADDRESS 0xd00040f6 BIT_MASK 0x1 /end MEASUREMENT
/begin MEASUREMENT Vbx_diag_sta_ffig_end "ffig completed status" UBYTE _CNV_S_2_RANGE______3_CM 1 0. 0. 1. ECU_ADDRESS 0xd00040f7 BIT_MASK 0x1 /end MEASUREMENT
/begin MEASUREMENT Vbx_min_cp_ti "Minimum injection time detection for canister purge" UBYTE _CNV_S_2_RANGE______3_CM 1 0. 0. 1. ECU_ADDRESS 0xd00040f8 BIT_MASK 0x1 /end MEASUREMENT
/begin MEASUREMENT Vbx_min_ti "Injection time saturated by minimum injection time" UBYTE _CNV_S_2_RANGE______3_CM 1 0. 0. 1. ECU_ADDRESS 0xd00040f9 BIT_MASK 0x1 /end MEASUREMENT
/begin MEASUREMENT Vbx_min_ti_cut "Injection cut by minimum injection time" UBYTE _CNV_S_2_RANGE______3_CM 1 0. 0. 1. ECU_ADDRESS 0xd00040fa BIT_MASK 0x1 /end MEASUREMENT
/begin MEASUREMENT Vsx_diag_sta_ffig_stt "ffig status" UBYTE _CNV_A_R_ECME_LINEA_0_CM 1 0. 0. 255. ECU_ADDRESS 0xd00040fb FORMAT "%3.0" /end MEASUREMENT
/begin MEASUREMENT Vsx_inj1_vld "First injector validity status" UBYTE _CNV_A_R_ECME_LINEA_0_CM 1 0. 0. 1. ECU_ADDRESS 0xd00040fc FORMAT "%1.0" /end MEASUREMENT
/begin MEASUREMENT Vsx_inj2_vld "Second injector validity status" UBYTE _CNV_A_R_ECME_LINEA_0_CM 1 0. 0. 1. ECU_ADDRESS 0xd00040fd FORMAT "%1.0" /end MEASUREMENT
/begin MEASUREMENT Vsx_inj3_vld "Third injector validity status" UBYTE _CNV_A_R_ECME_LINEA_0_CM 1 0. 0. 1. ECU_ADDRESS 0xd00040fe FORMAT "%1.0" /end MEASUREMENT
/begin MEASUREMENT Vsx_inj4_vld "Fourth injector validity status" UBYTE _CNV_A_R_ECME_LINEA_0_CM 1 0. 0. 1. ECU_ADDRESS 0xd00040ff FORMAT "%1.0" /end MEASUREMENT
/begin MEASUREMENT Vxx_efv_ti "Effective time injection." ULONG _CNV_A_R_LINEAR_____50_CM 1 0. 0. 500000. ECU_ADDRESS 0xd00021e8 FORMAT "%6.0" /end MEASUREMENT
/begin MEASUREMENT Vxx_inj1_appl_ti1 "Applied injection time on cylinder 1, first injection." ULONG _CNV_A_R_LINEAR_____50_CM 1 0. 0. 500000. ECU_ADDRESS 0xd00021ec FORMAT "%6.0" /end MEASUREMENT
/begin MEASUREMENT Vxx_inj1_appl_ti2 "Applied injection time on cylinder 1, second injection." ULONG _CNV_A_R_LINEAR_____50_CM 1 0. 0. 500000. ECU_ADDRESS 0xd00021f0 FORMAT "%6.0" /end MEASUREMENT
/begin MEASUREMENT Vxx_inj2_appl_ti1 "Applied injection time on cylinder 2, first injection." ULONG _CNV_A_R_LINEAR_____50_CM 1 0. 0. 500000. ECU_ADDRESS 0xd00021f4 FORMAT "%6.0" /end MEASUREMENT
/begin MEASUREMENT Vxx_inj2_appl_ti2 "Applied injection time on cylinder 2, second injection." ULONG _CNV_A_R_LINEAR_____50_CM 1 0. 0. 500000. ECU_ADDRESS 0xd00021f8 FORMAT "%6.0" /end MEASUREMENT
/begin MEASUREMENT Vxx_inj3_appl_ti1 "Applied injection time on cylinder 3, first injection." ULONG _CNV_A_R_LINEAR_____50_CM 1 0. 0. 500000. ECU_ADDRESS 0xd00021fc FORMAT "%6.0" /end MEASUREMENT
/begin MEASUREMENT Vxx_inj3_appl_ti2 "Applied injection time on cylinder 3, second injection." ULONG _CNV_A_R_LINEAR_____50_CM 1 0. 0. 500000. ECU_ADDRESS 0xd0002200 FORMAT "%6.0" /end MEASUREMENT
/begin MEASUREMENT Vxx_inj4_appl_ti1 "Applied injection time on cylinder 4, first injection." ULONG _CNV_A_R_LINEAR_____50_CM 1 0. 0. 500000. ECU_ADDRESS 0xd0002204 FORMAT "%6.0" /end MEASUREMENT
/begin MEASUREMENT Vxx_inj4_appl_ti2 "Applied injection time on cylinder 4, second injection." ULONG _CNV_A_R_LINEAR_____50_CM 1 0. 0. 500000. ECU_ADDRESS 0xd0002208 FORMAT "%6.0" /end MEASUREMENT
/begin MEASUREMENT Vxx_inj_wht_ti_fac "Interpolated conversion factor : FMI / injection time" UWORD _CNV_A_R_LINEAR_____336_CM 1 0. 1.52587890625e-002 1000. ECU_ADDRESS 0xc0000b90 FORMAT "%6.2" /end MEASUREMENT
/begin MEASUREMENT Vxx_pinj_appl_ti "Applied preinjection time." UBYTE _CNV_A_R_LINEAR_____337_CM 1 0. 0. 1020000. ECU_ADDRESS 0xd0004100 FORMAT "%7.0" /end MEASUREMENT
/begin MEASUREMENT Vxx_sta_eng_dly_t "Duration of stalling value for the first start strategy" UWORD _CNV_A_R_LINEAR_____34_CM 1 0. 0. 655.35 ECU_ADDRESS 0xd0003ac4 FORMAT "%6.2" /end MEASUREMENT
/begin CHARACTERISTIC Cbx_inj1_num "Configuration to perform the purge of gasoline circuit in the first start mode for injector 1" VALUE 0xa002102e _REC_S1VAL_20_u1 1. _CNV_S_2_RANGE______3_CM 0. 1. BIT_MASK 0x1 /end CHARACTERISTIC
/begin CHARACTERISTIC Cbx_inj2_num "Configuration to perform the purge of gasoline circuit in the first start mode for injector 2" VALUE 0xa002102f _REC_S1VAL_20_u1 1. _CNV_S_2_RANGE______3_CM 0. 1. BIT_MASK 0x1 /end CHARACTERISTIC
/begin CHARACTERISTIC Cbx_inj3_num "Configuration to perform the purge of gasoline circuit in the first start mode for injector 3" VALUE 0xa0021030 _REC_S1VAL_20_u1 1. _CNV_S_2_RANGE______3_CM 0. 1. BIT_MASK 0x1 /end CHARACTERISTIC
/begin CHARACTERISTIC Cbx_inj4_num "Configuration to perform the purge of gasoline circuit in the first start mode for injector 4" VALUE 0xa0021031 _REC_S1VAL_20_u1 1. _CNV_S_2_RANGE______3_CM 0. 1. BIT_MASK 0x1 /end CHARACTERISTIC
/begin CHARACTERISTIC Cbx_min_ti "Setup to apply an minimum drive pulse" VALUE 0xa0021032 _REC_S1VAL_20_u1 1. _CNV_S_2_RANGE______3_CM 0. 1. BIT_MASK 0x1 /end CHARACTERISTIC
/begin CHARACTERISTIC Cbx_ti_bch "Injection time in bench mode" VALUE 0xa0021033 _REC_S1VAL_20_u1 1. _CNV_S_2_RANGE______3_CM 0. 1. BIT_MASK 0x1 /end CHARACTERISTIC
/begin CHARACTERISTIC Cxx_dfdec_inj1_oc "a_ou_cbo_inj_appitxx/Open Circuit of injector 1 detected failure counter decrement" VALUE 0xa0020fea _REC_S1VAL_20_u2 65535. _CNV_A_R_ECME_LINEA_0_CM 0. 65535. FORMAT "%5.0" /end CHARACTERISTIC
/begin CHARACTERISTIC Cxx_dfdec_inj1_scg "a_ou_cbo_inj_appitxx/Short Circuit to ground of injector 1 detected failure counter decrement" VALUE 0xa0020fec _REC_S1VAL_20_u2 65535. _CNV_A_R_ECME_LINEA_0_CM 0. 65535. FORMAT "%5.0" /end CHARACTERISTIC
/begin CHARACTERISTIC Cxx_dfdec_inj1_scw "a_ou_cbo_inj_appitxx/Short Circuit to battery of injector 1 detected failure counter decrement" VALUE 0xa0020fee _REC_S1VAL_20_u2 65535. _CNV_A_R_ECME_LINEA_0_CM 0. 65535. FORMAT "%5.0" /end CHARACTERISTIC
/begin CHARACTERISTIC Cxx_dfdec_inj2_oc "a_ou_cbo_inj_appitxx/Open Circuit of injector 2 detected failure counter decrement" VALUE 0xa0020ff0 _REC_S1VAL_20_u2 65535. _CNV_A_R_ECME_LINEA_0_CM 0. 65535. FORMAT "%5.0" /end CHARACTERISTIC
/begin CHARACTERISTIC Cxx_dfdec_inj2_scg "a_ou_cbo_inj_appitxx/Short Circuit to ground of injector 2 detected failure counter decrement" VALUE 0xa0020ff2 _REC_S1VAL_20_u2 65535. _CNV_A_R_ECME_LINEA_0_CM 0. 65535. FORMAT "%5.0" /end CHARACTERISTIC
/begin CHARACTERISTIC Cxx_dfdec_inj2_scw "a_ou_cbo_inj_appitxx/Short Circuit to battery of injector 2 detected failure counter decrement" VALUE 0xa0020ff4 _REC_S1VAL_20_u2 65535. _CNV_A_R_ECME_LINEA_0_CM 0. 65535. FORMAT "%5.0" /end CHARACTERISTIC
/begin CHARACTERISTIC Cxx_dfdec_inj3_oc "a_ou_cbo_inj_appitxx/Open Circuit of injector 3 detected failure counter decrement" VALUE 0xa0020ff6 _REC_S1VAL_20_u2 65535. _CNV_A_R_ECME_LINEA_0_CM 0. 65535. FORMAT "%5.0" /end CHARACTERISTIC
/begin CHARACTERISTIC Cxx_dfdec_inj3_scg "a_ou_cbo_inj_appitxx/Short Circuit to ground of injector 3 detected failure counter decrement" VALUE 0xa0020ff8 _REC_S1VAL_20_u2 65535. _CNV_A_R_ECME_LINEA_0_CM 0. 65535. FORMAT "%5.0" /end CHARACTERISTIC
/begin CHARACTERISTIC Cxx_dfdec_inj3_scw "a_ou_cbo_inj_appitxx/Short Circuit to battery of injector 3 detected failure counter decrement" VALUE 0xa0020ffa _REC_S1VAL_20_u2 65535. _CNV_A_R_ECME_LINEA_0_CM 0. 65535. FORMAT "%5.0" /end CHARACTERISTIC
/begin CHARACTERISTIC Cxx_dfdec_inj4_oc "a_ou_cbo_inj_appitxx/Open Circuit of injector 4 detected failure counter decrement" VALUE 0xa0020ffc _REC_S1VAL_20_u2 65535. _CNV_A_R_ECME_LINEA_0_CM 0. 65535. FORMAT "%5.0" /end CHARACTERISTIC
/begin CHARACTERISTIC Cxx_dfdec_inj4_scg "a_ou_cbo_inj_appitxx/Short Circuit to ground of injector 4 detected failure counter decrement" VALUE 0xa0020ffe _REC_S1VAL_20_u2 65535. _CNV_A_R_ECME_LINEA_0_CM 0. 65535. FORMAT "%5.0" /end CHARACTERISTIC
/begin CHARACTERISTIC Cxx_dfdec_inj4_scw "a_ou_cbo_inj_appitxx/Short Circuit to battery of injector 4 detected failure counter decrement" VALUE 0xa0021000 _REC_S1VAL_20_u2 65535. _CNV_A_R_ECME_LINEA_0_CM 0. 65535. FORMAT "%5.0" /end CHARACTERISTIC
/begin CHARACTERISTIC Cxx_dfinc_inj1_oc "a_ou_cbo_inj_appitxx/Open Circuit of injector 1 detected failure counter increment" VALUE 0xa0021002 _REC_S1VAL_20_u2 65535. _CNV_A_R_ECME_LINEA_0_CM 0. 65535. FORMAT "%5.0" /end CHARACTERISTIC
/begin CHARACTERISTIC Cxx_dfinc_inj1_scg "a_ou_cbo_inj_appitxx/Short Circuit to ground of injector 1 detected failure counter increment" VALUE 0xa0021004 _REC_S1VAL_20_u2 65535. _CNV_A_R_ECME_LINEA_0_CM 0. 65535. FORMAT "%5.0" /end CHARACTERISTIC
/begin CHARACTERISTIC Cxx_dfinc_inj1_scw "a_ou_cbo_inj_appitxx/Short Circuit to battery of injector 1 detected failure counter increment" VALUE 0xa0021006 _REC_S1VAL_20_u2 65535. _CNV_A_R_ECME_LINEA_0_CM 0. 65535. FORMAT "%5.0" /end CHARACTERISTIC
/begin CHARACTERISTIC Cxx_dfinc_inj2_oc "a_ou_cbo_inj_appitxx/Open Circuit of injector 2 detected failure counter increment" VALUE 0xa0021008 _REC_S1VAL_20_u2 65535. _CNV_A_R_ECME_LINEA_0_CM 0. 65535. FORMAT "%5.0" /end CHARACTERISTIC
/begin CHARACTERISTIC Cxx_dfinc_inj2_scg "a_ou_cbo_inj_appitxx/Short Circuit to ground of injector 2 detected failure counter increment" VALUE 0xa002100a _REC_S1VAL_20_u2 65535. _CNV_A_R_ECME_LINEA_0_CM 0. 65535. FORMAT "%5.0" /end CHARACTERISTIC
/begin CHARACTERISTIC Cxx_dfinc_inj2_scw "a_ou_cbo_inj_appitxx/Short Circuit to battery of injector 2 detected failure counter increment" VALUE 0xa002100c _REC_S1VAL_20_u2 65535. _CNV_A_R_ECME_LINEA_0_CM 0. 65535. FORMAT "%5.0" /end CHARACTERISTIC
/begin CHARACTERISTIC Cxx_dfinc_inj3_oc "a_ou_cbo_inj_appitxx/Open Circuit of injector 3 detected failure counter increment" VALUE 0xa002100e _REC_S1VAL_20_u2 65535. _CNV_A_R_ECME_LINEA_0_CM 0. 65535. FORMAT "%5.0" /end CHARACTERISTIC
/begin CHARACTERISTIC Cxx_dfinc_inj3_scg "a_ou_cbo_inj_appitxx/Short Circuit to ground of injector 3 detected failure counter increment" VALUE 0xa0021010 _REC_S1VAL_20_u2 65535. _CNV_A_R_ECME_LINEA_0_CM 0. 65535. FORMAT "%5.0" /end CHARACTERISTIC
/begin CHARACTERISTIC Cxx_dfinc_inj3_scw "a_ou_cbo_inj_appitxx/Short Circuit to battery of injector 3 detected failure counter increment" VALUE 0xa0021012 _REC_S1VAL_20_u2 65535. _CNV_A_R_ECME_LINEA_0_CM 0. 65535. FORMAT "%5.0" /end CHARACTERISTIC
/begin CHARACTERISTIC Cxx_dfinc_inj4_oc "a_ou_cbo_inj_appitxx/Open Circuit of injector 4 detected failure counter increment" VALUE 0xa0021014 _REC_S1VAL_20_u2 65535. _CNV_A_R_ECME_LINEA_0_CM 0. 65535. FORMAT "%5.0" /end CHARACTERISTIC
/begin CHARACTERISTIC Cxx_dfinc_inj4_scg "a_ou_cbo_inj_appitxx/Short Circuit to ground of injector 4 detected failure counter increment" VALUE 0xa0021016 _REC_S1VAL_20_u2 65535. _CNV_A_R_ECME_LINEA_0_CM 0. 65535. FORMAT "%5.0" /end CHARACTERISTIC
/begin CHARACTERISTIC Cxx_dfinc_inj4_scw "a_ou_cbo_inj_appitxx/Short Circuit to battery of injector 4 detected failure counter increment" VALUE 0xa0021018 _REC_S1VAL_20_u2 65535. _CNV_A_R_ECME_LINEA_0_CM 0. 65535. FORMAT "%5.0" /end CHARACTERISTIC
/begin CHARACTERISTIC Cxx_inj_appl_ti1 "First applied injection fime for the first start strategy" VALUE 0xa002101a _REC_S1VAL_20_u4 500000. _CNV_A_R_LINEAR_____50_CM 0. 500000. FORMAT "%6.0" /end CHARACTERISTIC
/begin CHARACTERISTIC Cxx_inj_appl_ti2 "Second applied injection time for the first start strategy" VALUE 0xa002101e _REC_S1VAL_20_u4 500000. _CNV_A_R_LINEAR_____50_CM 0. 500000. FORMAT "%6.0" /end CHARACTERISTIC
/begin CHARACTERISTIC Cxx_inj_wht_ti_fac "Conversion factor : weight gas / injection time." VALUE 0xa0021022 _REC_S1VAL_20_u2 999.9847412109375 _CNV_A_R_LINEAR_____338_CM 1.52587890625e-002 1000. FORMAT "%11.6" /end CHARACTERISTIC
/begin CHARACTERISTIC Cxx_inj_wht_ti_fac_alco "Conversion factor : weight alcohol / injection time." VALUE 0xa0021024 _REC_S1VAL_20_u2 999.9847412109375 _CNV_A_R_LINEAR_____336_CM 1.52587890625e-002 1000. FORMAT "%6.2" /end CHARACTERISTIC
/begin CHARACTERISTIC Cxx_min_cp_ti "Minimum injection time for the canister purge" VALUE 0xa0021026 _REC_S1VAL_20_u2 262140. _CNV_A_R_LINEAR_____50_CM 0. 262140. FORMAT "%6.0" /end CHARACTERISTIC
/begin CHARACTERISTIC Cxx_min_ti "Minimum injection time value" VALUE 0xa0021028 _REC_S1VAL_20_u2 262140. _CNV_A_R_LINEAR_____50_CM 0. 262140. FORMAT "%6.0" /end CHARACTERISTIC
/begin CHARACTERISTIC Cxx_n_thd "Threshold above which the first start strategy is inhibited" VALUE 0xa0021034 _REC_S1VAL_20_u1 8160. _CNV_A_R_LINEAR_____2_CM 0. 8160. FORMAT "%4.0" /end CHARACTERISTIC
/begin CHARACTERISTIC Cxx_sta_eng_dly "Stalling for the first start strategy" VALUE 0xa002102a _REC_S1VAL_20_u2 655.35 _CNV_A_R_LINEAR_____34_CM 0. 655.35 FORMAT "%6.2" /end CHARACTERISTIC
/begin CHARACTERISTIC Cxx_ti_bch "Injection time for bench mode" VALUE 0xa002102c _REC_S1VAL_20_u2 262140. _CNV_A_R_LINEAR_____50_CM 0. 262140. FORMAT "%6.0" /end CHARACTERISTIC
/begin MEASUREMENT Vxx_inj1_open_angl1 "First opening angle set point for cylinder 1" UBYTE _CNV_A_R_LINEAR_____264_CM 1 0. 0. 765. ECU_ADDRESS 0xd00047cc FORMAT "%3.0" /end MEASUREMENT
/begin MEASUREMENT Vxx_inj1_open_angl2 "Second opening angle set point for cylinder 1" UBYTE _CNV_A_R_LINEAR_____264_CM 1 0. 0. 765. ECU_ADDRESS 0xd00047cd FORMAT "%3.0" /end MEASUREMENT
/begin MEASUREMENT Vxx_inj1_pinj_open_angl "Preinjection opening angle set point for injector 1" UBYTE _CNV_A_R_LINEAR_____264_CM 1 0. 0. 765. ECU_ADDRESS 0xd00047ce FORMAT "%3.0" /end MEASUREMENT
/begin MEASUREMENT Vxx_inj2_open_angl1 "First opening angle set point for cylinder 2" UBYTE _CNV_A_R_LINEAR_____264_CM 1 0. 0. 765. ECU_ADDRESS 0xd00047cf FORMAT "%3.0" /end MEASUREMENT
/begin MEASUREMENT Vxx_inj2_open_angl2 "Second opening angle set point for cylinder 2" UBYTE _CNV_A_R_LINEAR_____264_CM 1 0. 0. 765. ECU_ADDRESS 0xd00047d0 FORMAT "%3.0" /end MEASUREMENT
/begin MEASUREMENT Vxx_inj2_pinj_open_angl "Preinjection opening angle set point for injector 2" UBYTE _CNV_A_R_LINEAR_____264_CM 1 0. 0. 765. ECU_ADDRESS 0xd00047d1 FORMAT "%3.0" /end MEASUREMENT
/begin MEASUREMENT Vxx_inj3_open_angl1 "First opening angle set point for cylinder 3" UBYTE _CNV_A_R_LINEAR_____264_CM 1 0. 0. 765. ECU_ADDRESS 0xd00047d2 FORMAT "%3.0" /end MEASUREMENT
/begin MEASUREMENT Vxx_inj3_open_angl2 "Second opening angle set point for cylinder 3" UBYTE _CNV_A_R_LINEAR_____264_CM 1 0. 0. 765. ECU_ADDRESS 0xd00047d3 FORMAT "%3.0" /end MEASUREMENT
/begin MEASUREMENT Vxx_inj3_pinj_open_angl "Preinjection opening angle set point for injector 3" UBYTE _CNV_A_R_LINEAR_____264_CM 1 0. 0. 765. ECU_ADDRESS 0xd00047d4 FORMAT "%3.0" /end MEASUREMENT
/begin MEASUREMENT Vxx_inj4_open_angl1 "First opening angle set point for cylinder 4" UBYTE _CNV_A_R_LINEAR_____264_CM 1 0. 0. 765. ECU_ADDRESS 0xd00047d5 FORMAT "%3.0" /end MEASUREMENT
/begin MEASUREMENT Vxx_inj4_open_angl2 "Second opening angle set point for cylinder 4" UBYTE _CNV_A_R_LINEAR_____264_CM 1 0. 0. 765. ECU_ADDRESS 0xd00047d6 FORMAT "%3.0" /end MEASUREMENT
/begin MEASUREMENT Vxx_inj4_pinj_open_angl "Preinjection opening angle set point for injector 4" UBYTE _CNV_A_R_LINEAR_____264_CM 1 0. 0. 765. ECU_ADDRESS 0xd00047d7 FORMAT "%3.0" /end MEASUREMENT
/begin CHARACTERISTIC Cxx_seq_open_angl_max "Maximum value for injector opening angle in sequential mode" VALUE 0xa002192a _REC_S1VAL_20_u1 765. _CNV_A_R_LINEAR_____264_CM 0. 765. FORMAT "%3.0" /end CHARACTERISTIC
/begin CHARACTERISTIC Cxx_sfg_open_angl1_max "Maximum value for first injector opening angle in SFG-TRS mode" VALUE 0xa002192b _REC_S1VAL_20_u1 765. _CNV_A_R_LINEAR_____264_CM 0. 765. FORMAT "%3.0" /end CHARACTERISTIC
/begin CHARACTERISTIC Cxx_sfg_open_angl2_max "Maximum value for second injector opening angle in SFG-TRS mode" VALUE 0xa002192c _REC_S1VAL_20_u1 765. _CNV_A_R_LINEAR_____264_CM 0. 765. FORMAT "%3.0" /end CHARACTERISTIC
/begin CHARACTERISTIC Cxx_sta_inj_sta_angl "Opening angle for start injection mode" VALUE 0xa002192d _REC_S1VAL_20_u1 765. _CNV_A_R_LINEAR_____264_CM 0. 765. FORMAT "%3.0" /end CHARACTERISTIC
/begin MEASUREMENT Vbx_inj1_not_open "Indicates if injector 1 should be curently open if it was not disabled." UBYTE _CNV_S_2_RANGE______3_CM 1 0. 0. 1. ECU_ADDRESS 0xd0005026 BIT_MASK 0x1 /end MEASUREMENT
/begin MEASUREMENT Vbx_inj1_open "Indicates if injector 1 is curently open." UBYTE _CNV_S_2_RANGE______3_CM 1 0. 0. 1. ECU_ADDRESS 0xd0005027 BIT_MASK 0x1 /end MEASUREMENT
/begin MEASUREMENT Vbx_inj2_not_open "Indicates if injector 2 should be curently open if it was not disabled." UBYTE _CNV_S_2_RANGE______3_CM 1 0. 0. 1. ECU_ADDRESS 0xd0005028 BIT_MASK 0x1 /end MEASUREMENT
/begin MEASUREMENT Vbx_inj2_open "Indicates if injector 2 is curently open." UBYTE _CNV_S_2_RANGE______3_CM 1 0. 0. 1. ECU_ADDRESS 0xd0005029 BIT_MASK 0x1 /end MEASUREMENT
/begin MEASUREMENT Vbx_inj3_not_open "Indicates if injector 3 should be curently open if it was not disabled." UBYTE _CNV_S_2_RANGE______3_CM 1 0. 0. 1. ECU_ADDRESS 0xd000502a BIT_MASK 0x1 /end MEASUREMENT
/begin MEASUREMENT Vbx_inj3_open "Indicates if injector 3 is curently open." UBYTE _CNV_S_2_RANGE______3_CM 1 0. 0. 1. ECU_ADDRESS 0xd000502b BIT_MASK 0x1 /end MEASUREMENT
/begin MEASUREMENT Vbx_inj4_not_open "Indicates if injector 4 should be curently open if it was not disabled." UBYTE _CNV_S_2_RANGE______3_CM 1 0. 0. 1. ECU_ADDRESS 0xd000502c BIT_MASK 0x1 /end MEASUREMENT
/begin MEASUREMENT Vbx_inj4_open "Indicates if injector 4 is curently open." UBYTE _CNV_S_2_RANGE______3_CM 1 0. 0. 1. ECU_ADDRESS 0xd000502d BIT_MASK 0x1 /end MEASUREMENT
/begin MEASUREMENT Vbx_cho_cam_ctr_init "Choice of the Camshaft wheel counter (Vxx_in_cam_ctr) intialisation" UBYTE _CNV_S_2_RANGE______3_CM 1 0. 0. 1. ECU_ADDRESS 0xd00043a7 BIT_MASK 0x1 /end MEASUREMENT
/begin MEASUREMENT Vbx_df_crk_chr "High number of invalid crankshaft teeth detected failure" UBYTE _CNV_S_2_RANGE______3_CM 1 0. 0. 1. ECU_ADDRESS 0xd00043a8 BIT_MASK 0x1 /end MEASUREMENT
/begin MEASUREMENT Vbx_df_crk_cmp "Incorrect number of crankshaft teeth detected failure" UBYTE _CNV_S_2_RANGE______3_CM 1 0. 0. 1. ECU_ADDRESS 0xd00043a9 BIT_MASK 0x1 /end MEASUREMENT
/begin MEASUREMENT Vbx_df_crk_cyc "Interference between two crankshaft teeth detected failure" UBYTE _CNV_S_2_RANGE______3_CM 1 0. 0. 1. ECU_ADDRESS 0xd00043aa BIT_MASK 0x1 /end MEASUREMENT
/begin MEASUREMENT Vbx_df_crk_no_sig_wit_cam "Absence of crankshaft signal detected failure for engine with camshaft sensor" UBYTE _CNV_S_2_RANGE______3_CM 1 0. 0. 1. ECU_ADDRESS 0xd00043ab BIT_MASK 0x1 /end MEASUREMENT
/begin MEASUREMENT Vbx_df_crk_oc "Open circuit of one of the leads of crankshaft sensor detected failure" UBYTE _CNV_S_2_RANGE______3_CM 1 0. 0. 1. ECU_ADDRESS 0xd00043ac BIT_MASK 0x1 /end MEASUREMENT
/begin MEASUREMENT Vbx_df_crk_shp "No detection of crankshaft reference detected failure" UBYTE _CNV_S_2_RANGE______3_CM 1 0. 0. 1. ECU_ADDRESS 0xd00043ad BIT_MASK 0x1 /end MEASUREMENT
/begin MEASUREMENT Vbx_df_in_cam_chr "Incoherency of intake camshaft signal detected failure" UBYTE _CNV_S_2_RANGE______3_CM 1 0. 0. 1. ECU_ADDRESS 0xd00043ae BIT_MASK 0x1 /end MEASUREMENT
/begin MEASUREMENT Vbx_df_in_cam_crk_cmp "Correlation between camshaft and crankshaft signals detected failure" UBYTE _CNV_S_2_RANGE______3_CM 1 0. 0. 1. ECU_ADDRESS 0xd00043af BIT_MASK 0x1 /end MEASUREMENT
/begin MEASUREMENT Vbx_df_in_cam_cyc "Interference close to a intake camshaft edge detected failure" UBYTE _CNV_S_2_RANGE______3_CM 1 0. 0. 1. ECU_ADDRESS 0xd00043b0 BIT_MASK 0x1 /end MEASUREMENT
/begin MEASUREMENT Vbx_df_in_cam_no_sig "Absence of intake camshaft signal detected failure" UBYTE _CNV_S_2_RANGE______3_CM 1 0. 0. 1. ECU_ADDRESS 0xd00043b1 BIT_MASK 0x1 /end MEASUREMENT
/begin MEASUREMENT Vbx_df_in_cam_nok "Camshaft signal invalid for synchronization detected failure" UBYTE _CNV_S_2_RANGE______3_CM 1 0. 0. 1. ECU_ADDRESS 0xd00043b2 BIT_MASK 0x1 /end MEASUREMENT
/begin MEASUREMENT Vbx_diag_ena_crk_chr "High number of invalid crankshaft teeth diagnosis authorization" UBYTE _CNV_S_2_RANGE______3_CM 1 0. 0. 1. ECU_ADDRESS 0xd00043b3 BIT_MASK 0x1 /end MEASUREMENT
/begin MEASUREMENT Vbx_diag_ena_crk_cmp "Incorrect number of crankshaft teeth diagnosis authorization" UBYTE _CNV_S_2_RANGE______3_CM 1 0. 0. 1. ECU_ADDRESS 0xd00043b4 BIT_MASK 0x1 /end MEASUREMENT
/begin MEASUREMENT Vbx_diag_ena_crk_cyc "Interference between two crankshaft teeth diagnosis authorization" UBYTE _CNV_S_2_RANGE______3_CM 1 0. 0. 1. ECU_ADDRESS 0xd00043b5 BIT_MASK 0x1 /end MEASUREMENT
/begin MEASUREMENT Vbx_diag_ena_crk_no_sig_wit_cam "Absence of crankshaft signal diagnosis authorization for engine with camshaft sensor" UBYTE _CNV_S_2_RANGE______3_CM 1 0. 0. 1. ECU_ADDRESS 0xd00043b6 BIT_MASK 0x1 /end MEASUREMENT
/begin MEASUREMENT Vbx_diag_ena_crk_oc "Open circuit of one of the leads of crankshaft sensor diagnosis authorization" UBYTE _CNV_S_2_RANGE______3_CM 1 0. 0. 1. ECU_ADDRESS 0xd00043b7 BIT_MASK 0x1 /end MEASUREMENT
/begin MEASUREMENT Vbx_diag_ena_crk_shp "No detection of crankshaft reference diagnosis authorization" UBYTE _CNV_S_2_RANGE______3_CM 1 0. 0. 1. ECU_ADDRESS 0xd00043b8 BIT_MASK 0x1 /end MEASUREMENT
/begin MEASUREMENT Vbx_diag_ena_in_cam_chr "Incoherency of intake camshaft signal diagnosis authorization" UBYTE _CNV_S_2_RANGE______3_CM 1 0. 0. 1. ECU_ADDRESS 0xd00043b9 BIT_MASK 0x1 /end MEASUREMENT
/begin MEASUREMENT Vbx_diag_ena_in_cam_crk_cmp "Correlation between camshaft and crankshaft signals diagnosis authorization" UBYTE _CNV_S_2_RANGE______3_CM 1 0. 0. 1. ECU_ADDRESS 0xd00043ba BIT_MASK 0x1 /end MEASUREMENT
/begin MEASUREMENT Vbx_diag_ena_in_cam_cyc "Interference close to a intake camshaft edge diagnosis authorization" UBYTE _CNV_S_2_RANGE______3_CM 1 0. 0. 1. ECU_ADDRESS 0xd00043bb BIT_MASK 0x1 /end MEASUREMENT
/begin MEASUREMENT Vbx_diag_ena_in_cam_no_sig "Absence of intake camshaft signal diagnosis authorization" UBYTE _CNV_S_2_RANGE______3_CM 1 0. 0. 1. ECU_ADDRESS 0xd00043bc BIT_MASK 0x1 /end MEASUREMENT
/begin MEASUREMENT Vbx_diag_ena_in_cam_nok "Camshaft signal invalid for synchronization diagnosis authorization" UBYTE _CNV_S_2_RANGE______3_CM 1 0. 0. 1. ECU_ADDRESS 0xd00043bd BIT_MASK 0x1 /end MEASUREMENT
/begin MEASUREMENT Vbx_n_inv "The engine rotates in the wrong direction" UBYTE _CNV_S_2_RANGE______3_CM 1 0. 0. 1. ECU_ADDRESS 0xd00043be BIT_MASK 0x1 /end MEASUREMENT
/begin MEASUREMENT Vbx_raw_eng_syn "Raw value engine synchronization" UBYTE _CNV_S_2_RANGE______3_CM 1 0. 0. 1. ECU_ADDRESS 0xd00043bf BIT_MASK 0x1 /end MEASUREMENT
/begin MEASUREMENT Vbx_raw_in_cam_lvl "Raw value intake camshaft level" UBYTE _CNV_S_2_RANGE______3_CM 1 0. 0. 1. ECU_ADDRESS 0xd00043c0 BIT_MASK 0x1 /end MEASUREMENT
/begin MEASUREMENT Vbx_raw_trz_clc_ena "TLZ/TRZ calculation enabled, data from basic software" UBYTE _CNV_S_2_RANGE______3_CM 1 0. 0. 1. ECU_ADDRESS 0xd00043c1 BIT_MASK 0x1 /end MEASUREMENT
/begin MEASUREMENT Vxx_raw_eng_angl "Basic angular position of engine" UWORD _CNV_A_R_LINEAR_____76_CM 1 0. 0. 720. ECU_ADDRESS 0xd00037ea FORMAT "%5.2" /end MEASUREMENT
/begin MEASUREMENT Vxx_raw_in_cam_toth_per "raw value of Duration between two intake camshaft events" UWORD _CNV_A_R_LINEAR_____145_CM 1 0. 0. 65535. ECU_ADDRESS 0xd00037ec FORMAT "%5.0" /end MEASUREMENT
/begin MEASUREMENT Vxx_raw_n "Engine speed from supplier" UWORD _CNV_A_R_ENSD_LINEA_24_CM 1 0. 0. 16383.75 ECU_ADDRESS 0xd00037ee FORMAT "%8.2" /end MEASUREMENT
/begin MEASUREMENT Vxx_raw_tdc_ctr "Raw value TDC counter" UBYTE _CNV_A_R_LINEAR_____55_CM 1 0. 0. 3. ECU_ADDRESS 0xd00043c4 FORMAT "%1.0" /end MEASUREMENT
/begin MEASUREMENT Vxx_raw_tdc_per "tdc period (32 bits) from supplier" ULONG _CNV_A_R_LINEAR_____303_CM 1 0. 0. 1. ECU_ADDRESS 0xd0001e34 FORMAT "%8.7" /end MEASUREMENT
/begin MEASUREMENT Vxx_raw_trz_t_toth_0 "Duration of 5 teeth package, data from basic software" ULONG _CNV_A_R_LINEAR_____305_CM 1 0. 0. 52428800. ECU_ADDRESS 0xd0001e38 FORMAT "%8.0" /end MEASUREMENT
/begin MEASUREMENT Vxx_raw_trz_t_toth_0_nxt "Duration of 5 teeth package, data from basic software" ULONG _CNV_A_R_LINEAR_____305_CM 1 0. 0. 52428800. ECU_ADDRESS 0xd0001e3c FORMAT "%8.0" /end MEASUREMENT
/begin MEASUREMENT Vxx_raw_trz_t_toth_1 "Duration of 5 teeth package, data from basic software" ULONG _CNV_A_R_LINEAR_____305_CM 1 0. 0. 52428800. ECU_ADDRESS 0xd0001e40 FORMAT "%8.0" /end MEASUREMENT
/begin MEASUREMENT Vxx_raw_trz_t_toth_2 "Duration of 5 teeth package, data from basic software" ULONG _CNV_A_R_LINEAR_____305_CM 1 0. 0. 52428800. ECU_ADDRESS 0xd0001e44 FORMAT "%8.0" /end MEASUREMENT
/begin MEASUREMENT Vxx_raw_trz_t_toth_3 "Duration of 5 teeth package, data from basic software" ULONG _CNV_A_R_LINEAR_____305_CM 1 0. 0. 52428800. ECU_ADDRESS 0xd0001e48 FORMAT "%8.0" /end MEASUREMENT
/begin MEASUREMENT Vxx_raw_trz_t_toth_4 "Duration of 5 teeth package, data from basic software" ULONG _CNV_A_R_LINEAR_____305_CM 1 0. 0. 52428800. ECU_ADDRESS 0xd0001e4c FORMAT "%8.0" /end MEASUREMENT
/begin MEASUREMENT Vxx_raw_trz_t_toth_5 "Duration of 5 teeth package, data from basic software" ULONG _CNV_A_R_LINEAR_____305_CM 1 0. 0. 52428800. ECU_ADDRESS 0xd0001e50 FORMAT "%8.0" /end MEASUREMENT
/begin MEASUREMENT Vxx_raw_trz_t_toth_5_prev "Duration of 5 teeth package, data from basic software" ULONG _CNV_A_R_LINEAR_____305_CM 1 0. 0. 52428800. ECU_ADDRESS 0xd0001e54 FORMAT "%8.0" /end MEASUREMENT
/begin MEASUREMENT lv_es "Engine operating state \"Engine stopped\"" UBYTE _CNV_S_2_RANGE______3_CM 1 0. 0. 1. ECU_ADDRESS 0xd00043c2 BIT_MASK 0x1 /end MEASUREMENT
/begin MEASUREMENT lv_st "Engine operating state \"Start\"" UBYTE _CNV_S_2_RANGE______3_CM 1 0. 0. 1. ECU_ADDRESS 0xd00043c3 BIT_MASK 0x1 /end MEASUREMENT
/begin MEASUREMENT Vbx_mem_sta_gas_pump "Memorized state of the priming of the gas pump" UBYTE _CNV_S_2_RANGE______3_CM 1 0. 0. 1. DISPLAY_IDENTIFIER OuCboFuo_NVM.Vbx_mem_sta_gas_pump_NVM ECU_ADDRESS 0xd0002ec6 BIT_MASK 0x1 /end MEASUREMENT
/begin MEASUREMENT Vbx_cpl_sta_gas_pump "Additional state of the priming of the gas pump" UBYTE _CNV_S_2_RANGE______3_CM 1 0. 0. 1. DISPLAY_IDENTIFIER OuCboFuo_NVM.Vbx_cpl_sta_gas_pump_NVM ECU_ADDRESS 0xd0002ec7 BIT_MASK 0x1 /end MEASUREMENT
/begin MEASUREMENT Vxx_csm "fuel consumption" UWORD _CNV_A_R_LINEAR_____339_CM 1 0. 0. 100. ECU_ADDRESS 0xc0000c24 FORMAT "%6.2" /end MEASUREMENT
/begin MEASUREMENT Vxx_csm_sum_mux "Total fuel consumption" UBYTE _CNV_A_R_LINEAR_____340_CM 1 0. 0. 20400. ECU_ADDRESS 0xd0005797 FORMAT "%5.0" /end MEASUREMENT
/begin MEASUREMENT Vxx_fim_sum_mux_2 "Gas consumption for the mux" ULONG _CNV_A_R_LINEAR_____83_CM 1 0. 0. 4800. ECU_ADDRESS 0xd0001fe8 FORMAT "%12.3" /end MEASUREMENT
/begin CHARACTERISTIC Cxx_adac_fim_ofs "Offset to adjust the ADAC consumption" VALUE 0xa0021ec8 _REC_S1VAL_20_s2 2.6 _CNV_A_R_LINEAR_____341_CM -1.3 1.3 FORMAT "%8.5" /end CHARACTERISTIC
/begin CHARACTERISTIC Cxx_fuel_wht_vol_fac "Conversion factor : volume / weight gas" VALUE 0xa0021eca _REC_S1VAL_20_u1 0.498046875 _CNV_A_R_LINEAR_____342_CM 1. 1.498046875 FORMAT "%5.3" /end CHARACTERISTIC
/begin MEASUREMENT Vsx_cp_vld "Canister purge validity status" UBYTE _CNV_A_R_ECME_LINEA_0_CM 1 0. 0. 2. ECU_ADDRESS 0xd00052aa FORMAT "%1.0" /end MEASUREMENT
/begin CHARACTERISTIC Cxx_dfdec_cp_oc "Open Circuit of Canister Purge detected failure counter decrement" VALUE 0xa002181a _REC_S1VAL_20_u2 65535. _CNV_A_R_ECME_LINEA_0_CM 0. 65535. FORMAT "%5.0" /end CHARACTERISTIC
/begin CHARACTERISTIC Cxx_dfdec_cp_scg "Short Circuit to ground of Canister Purge detected failure counter decrement" VALUE 0xa002181c _REC_S1VAL_20_u2 65535. _CNV_A_R_ECME_LINEA_0_CM 0. 65535. FORMAT "%5.0" /end CHARACTERISTIC
/begin CHARACTERISTIC Cxx_dfdec_cp_scw "Short Circuit to battery of Canister Purge detected failure counter decrement" VALUE 0xa002181e _REC_S1VAL_20_u2 65535. _CNV_A_R_ECME_LINEA_0_CM 0. 65535. FORMAT "%5.0" /end CHARACTERISTIC
/begin CHARACTERISTIC Cxx_dfinc_cp_oc "Open Circuit of Canister Purge detected failure counter increment" VALUE 0xa0021820 _REC_S1VAL_20_u2 65535. _CNV_A_R_ECME_LINEA_0_CM 0. 65535. FORMAT "%5.0" /end CHARACTERISTIC
/begin CHARACTERISTIC Cxx_dfinc_cp_scg "Short Circuit to ground of Canister Purge detected failure counter increment" VALUE 0xa0021822 _REC_S1VAL_20_u2 65535. _CNV_A_R_ECME_LINEA_0_CM 0. 65535. FORMAT "%5.0" /end CHARACTERISTIC
/begin CHARACTERISTIC Cxx_dfinc_cp_scw "Short Circuit to battery of Canister Purge detected failure counter increment" VALUE 0xa0021824 _REC_S1VAL_20_u2 65535. _CNV_A_R_ECME_LINEA_0_CM 0. 65535. FORMAT "%5.0" /end CHARACTERISTIC
/begin MEASUREMENT Vbx_gas_pump_rly_cmd "State of the gas pump relay control" UBYTE _CNV_S_2_RANGE______3_CM 1 0. 0. 1. ECU_ADDRESS 0xd0005260 BIT_MASK 0x1 /end MEASUREMENT
/begin MEASUREMENT Vbx_sta_gas_pump "State of the priming of the gas pump" UBYTE _CNV_S_2_RANGE______3_CM 1 0. 0. 1. ECU_ADDRESS 0xd0005261 BIT_MASK 0x1 /end MEASUREMENT
/begin MEASUREMENT Vsx_gas_pump_vld "Gas pump validity status" UBYTE _CNV_S_3_STATUS_OK__158_CM 1 0. 0. 2. ECU_ADDRESS 0xd0005262 /end MEASUREMENT
/begin MEASUREMENT Vxx_gas_pump_dly "Temporization of gas pump relay" UWORD _CNV_A_R_LINEAR_____58_CM 1 0. 0. 65.535 ECU_ADDRESS 0xd00059ba /end MEASUREMENT
/begin CHARACTERISTIC Cbx_gas_pump_fast_stop "Configuration of the gas pump quick cut" VALUE 0xa0021200 _REC_S1VAL_20_u1 1. _CNV_S_2_RANGE______3_CM 0. 1. BIT_MASK 0x1 /end CHARACTERISTIC
/begin CHARACTERISTIC Cxx_dfdec_gas_pump_oc "a_ou_cbo_fuo_pmpcdxx/Open circuit of gas pump detected failure counter decrement" VALUE 0xa00211f0 _REC_S1VAL_20_u2 65535. _CNV_A_R_ECME_LINEA_0_CM 0. 65535. FORMAT "%5.0" /end CHARACTERISTIC
/begin CHARACTERISTIC Cxx_dfdec_gas_pump_scg "a_ou_cbo_fuo_pmpcdxx/Short Circuit to ground of gas pump detected failure counter decrement" VALUE 0xa00211f2 _REC_S1VAL_20_u2 65535. _CNV_A_R_ECME_LINEA_0_CM 0. 65535. FORMAT "%5.0" /end CHARACTERISTIC
/begin CHARACTERISTIC Cxx_dfdec_gas_pump_scw "a_ou_cbo_fuo_pmpcdxx/Short Circuit to battery of gas pump detected failure counter decrement" VALUE 0xa00211f4 _REC_S1VAL_20_u2 65535. _CNV_A_R_ECME_LINEA_0_CM 0. 65535. FORMAT "%5.0" /end CHARACTERISTIC
/begin CHARACTERISTIC Cxx_dfinc_gas_pump_oc "a_ou_cbo_fuo_pmpcdxx/Open circuit of gas pump detected failure counter increment" VALUE 0xa00211f6 _REC_S1VAL_20_u2 65535. _CNV_A_R_ECME_LINEA_0_CM 0. 65535. FORMAT "%5.0" /end CHARACTERISTIC
/begin CHARACTERISTIC Cxx_dfinc_gas_pump_scg "a_ou_cbo_fuo_pmpcdxx/Short Circuit to ground of gas pump detected failure counter increment" VALUE 0xa00211f8 _REC_S1VAL_20_u2 65535. _CNV_A_R_ECME_LINEA_0_CM 0. 65535. FORMAT "%5.0" /end CHARACTERISTIC
/begin CHARACTERISTIC Cxx_dfinc_gas_pump_scw "a_ou_cbo_fuo_pmpcdxx/Short Circuit to battery of gas pump detected failure counter increment" VALUE 0xa00211fa _REC_S1VAL_20_u2 65535. _CNV_A_R_ECME_LINEA_0_CM 0. 65535. FORMAT "%5.0" /end CHARACTERISTIC
/begin CHARACTERISTIC Cxx_gas_pump_sta_dly "Duration of the priming of the gas pump" VALUE 0xa00211fc _REC_S1VAL_20_u2 65.535 _CNV_A_R_LINEAR_____58_CM 0. 65.535 /end CHARACTERISTIC
/begin CHARACTERISTIC Cxx_sta_gas_pump_n_thd "Engine speed upper limit for the deactivation of the priming of the pump " VALUE 0xa00211fe _REC_S1VAL_20_u2 16383.75 _CNV_A_R_ENSD_LINEA_24_CM 0. 16383.75 FORMAT "%8.2" /end CHARACTERISTIC
/begin CHARACTERISTIC c_nr_hard_1_asa "HardwareNumber.LowerPart (byte 0)" VALUE 0xa0020767 _REC_S1VAL_20_u1 255. _CNV_A_R_ECME_LINEA_0_CM 0. 255. FORMAT "%3.0" /end CHARACTERISTIC
/begin CHARACTERISTIC c_nr_hard_2_asa "HardwareNumber.LowerPart (byte 1)" VALUE 0xa0020768 _REC_S1VAL_20_u1 255. _CNV_A_R_ECME_LINEA_0_CM 0. 255. FORMAT "%3.0" /end CHARACTERISTIC
/begin CHARACTERISTIC c_nr_hard_3_asa "HardwareNumber.LowerPart (byte 2)" VALUE 0xa0020769 _REC_S1VAL_20_u1 255. _CNV_A_R_ECME_LINEA_0_CM 0. 255. FORMAT "%3.0" /end CHARACTERISTIC
/begin CHARACTERISTIC c_nr_hard_4_asa "HardwareNumber.LowerPart (byte 3)" VALUE 0xa002076a _REC_S1VAL_20_u1 255. _CNV_A_R_ECME_LINEA_0_CM 0. 255. FORMAT "%3.0" /end CHARACTERISTIC
/begin CHARACTERISTIC c_nr_hard_5_asa "HardwareNumber.LowerPart (byte 4)" VALUE 0xa002076b _REC_S1VAL_20_u1 255. _CNV_A_R_ECME_LINEA_0_CM 0. 255. FORMAT "%3.0" /end CHARACTERISTIC
/begin CHARACTERISTIC c_nr_hw_prg_1_asa "Hardware - PartNumber.LowerPart (byte 0)" VALUE 0xa002076c _REC_S1VAL_20_u1 255. _CNV_A_R_ECME_LINEA_0_CM 0. 255. FORMAT "%3.0" /end CHARACTERISTIC
/begin CHARACTERISTIC c_nr_hw_prg_2_asa "Hardware - PartNumber.LowerPart (byte 1)" VALUE 0xa002076d _REC_S1VAL_20_u1 255. _CNV_A_R_ECME_LINEA_0_CM 0. 255. FORMAT "%3.0" /end CHARACTERISTIC
/begin CHARACTERISTIC c_nr_hw_prg_3_asa "Hardware - PartNumber.LowerPart (byte 2)" VALUE 0xa002076e _REC_S1VAL_20_u1 255. _CNV_A_R_ECME_LINEA_0_CM 0. 255. FORMAT "%3.0" /end CHARACTERISTIC
/begin CHARACTERISTIC c_nr_hw_prg_4_asa "Hardware - PartNumber.LowerPart (byte 3)" VALUE 0xa002076f _REC_S1VAL_20_u1 255. _CNV_A_R_ECME_LINEA_0_CM 0. 255. FORMAT "%3.0" /end CHARACTERISTIC
/begin CHARACTERISTIC c_nr_hw_prg_5_asa "Hardware - PartNumber.LowerPart (byte 4)" VALUE 0xa0020770 _REC_S1VAL_20_u1 255. _CNV_A_R_ECME_LINEA_0_CM 0. 255. FORMAT "%3.0" /end CHARACTERISTIC
/begin MEASUREMENT Sxx_mis_ctr_NVM "Misfire counter" UWORD _CNV_A_R_ECME_LINEA_0_CM 1 0. 0. 65535. DISPLAY_IDENTIFIER CbMisDgn_NVM.Sxx_mis_ctr_NVM ECU_ADDRESS 0xd0003ac6 FORMAT "%5.0" /end MEASUREMENT
/begin MEASUREMENT Sxx_mis_ctr_lpg_NVM "Misfire counter for LPG application" UWORD _CNV_A_R_ECME_LINEA_0_CM 1 0. 0. 65535. DISPLAY_IDENTIFIER CbMisDgn_NVM.Sxx_mis_ctr_lpg_NVM ECU_ADDRESS 0xd0003ac8 FORMAT "%5.0" /end MEASUREMENT
/begin MEASUREMENT Vbx_inj1_cut_req_tmp "temporary injection cut request on cylinder 1" UBYTE _CNV_S_2_RANGE______3_CM 1 0. 0. 1. ECU_ADDRESS 0xd0004c40 BIT_MASK 0x1 /end MEASUREMENT
/begin MEASUREMENT Vbx_inj2_cut_req_tmp "temporary injection cut request on cylinder 2" UBYTE _CNV_S_2_RANGE______3_CM 1 0. 0. 1. ECU_ADDRESS 0xd0004c41 BIT_MASK 0x1 /end MEASUREMENT
/begin MEASUREMENT Vbx_inj3_cut_req_tmp "temporary injection cut request on cylinder 3" UBYTE _CNV_S_2_RANGE______3_CM 1 0. 0. 1. ECU_ADDRESS 0xd0004c42 BIT_MASK 0x1 /end MEASUREMENT
/begin MEASUREMENT Vbx_inj4_cut_req_tmp "temporary injection cut request on cylinder 4" UBYTE _CNV_S_2_RANGE______3_CM 1 0. 0. 1. ECU_ADDRESS 0xd0004c43 BIT_MASK 0x1 /end MEASUREMENT
/begin MEASUREMENT Vbx_mis_cut "Default misfiring driving mode activated (injection cut-off)" UBYTE _CNV_S_2_RANGE______3_CM 1 0. 0. 1. ECU_ADDRESS 0xd0004c44 BIT_MASK 0x1 /end MEASUREMENT
/begin MEASUREMENT Vbx_mis_cut_cyl_done "Coupure d'injection sur les cylindres en misfire terminÈe" UBYTE _CNV_S_2_RANGE______3_CM 1 0. 0. 1. ECU_ADDRESS 0xd0004c45 BIT_MASK 0x1 /end MEASUREMENT
/begin MEASUREMENT Vbx_mis_det_1_2_inh "Misfire detection into mode 1/2 inhibited by zero torque line" UBYTE _CNV_S_2_RANGE______3_CM 1 0. 0. 1. ECU_ADDRESS 0xd0004c46 BIT_MASK 0x1 /end MEASUREMENT
/begin MEASUREMENT Vbx_mis_inj_re_phs_req "Engine rephasage request" UBYTE _CNV_S_2_RANGE______3_CM 1 0. 0. 1. ECU_ADDRESS 0xd0004c47 BIT_MASK 0x1 /end MEASUREMENT
/begin MEASUREMENT Vbx_mis_lih_cata_rst "Request for catalyst window reset from limp home driving mode" UBYTE _CNV_S_2_RANGE______3_CM 1 0. 0. 1. ECU_ADDRESS 0xd0004c48 BIT_MASK 0x1 /end MEASUREMENT
/begin MEASUREMENT Vbx_mis_lih_chk_dsb "The cylinder 1 recognition cannot be done because a couple of cylinders is misfiring" UBYTE _CNV_S_2_RANGE______3_CM 1 0. 0. 1. ECU_ADDRESS 0xd0004c49 BIT_MASK 0x1 /end MEASUREMENT
/begin MEASUREMENT Vbx_mis_lih_phs_chk "Fin de processus de controle phasage" UBYTE _CNV_S_2_RANGE______3_CM 1 0. 0. 1. ECU_ADDRESS 0xd0004c4a BIT_MASK 0x1 /end MEASUREMENT
/begin MEASUREMENT Vbx_mis_lih_phs_chk_req "Demande de controle du phasage par la strategie de mode degrade misfire" UBYTE _CNV_S_2_RANGE______3_CM 1 0. 0. 1. ECU_ADDRESS 0xd0004c4b BIT_MASK 0x1 /end MEASUREMENT
/begin MEASUREMENT Vbx_mis_lih_phs_ok "Phasage controle bon" UBYTE _CNV_S_2_RANGE______3_CM 1 0. 0. 1. ECU_ADDRESS 0xd0004c4c BIT_MASK 0x1 /end MEASUREMENT
/begin MEASUREMENT Vbx_mis_lih_rst_inh "Inhibition of misfire diagnosis exit on filter reset on torque transient" UBYTE _CNV_S_2_RANGE______3_CM 1 0. 0. 1. ECU_ADDRESS 0xd0004c4d BIT_MASK 0x1 /end MEASUREMENT
/begin MEASUREMENT Vbx_pres_mis_lih "Panne prÈsente ratÈs de combustion ayant entrainÈ le mode dÈgradÈ" UBYTE _CNV_S_2_RANGE______3_CM 1 0. 0. 1. ECU_ADDRESS 0xd0004c4e BIT_MASK 0x1 /end MEASUREMENT
/begin MEASUREMENT Vsx_cyl_cut "Current state of the diagram of injection cut off" UBYTE _CNV_A_R_ECME_LINEA_0_CM 1 0. 0. 255. ECU_ADDRESS 0xd0004c4f FORMAT "%3.0" /end MEASUREMENT
/begin MEASUREMENT Vsx_mis_inj1_vld "Misfire for cylinder 1 validity status which emets an injection cut request" UBYTE _CNV_S_8_STATUS_OK__181_CM 1 0. 0. 7. ECU_ADDRESS 0xd0004c50 /end MEASUREMENT
/begin MEASUREMENT Vsx_mis_inj2_vld "Misfire for cylinder 2 validity status which emets an injection cut request" UBYTE _CNV_S_8_STATUS_OK__181_CM 1 0. 0. 7. ECU_ADDRESS 0xd0004c51 /end MEASUREMENT
/begin MEASUREMENT Vsx_mis_inj3_vld "Misfire for cylinder 3 validity status which emets an injection cut request" UBYTE _CNV_S_8_STATUS_OK__181_CM 1 0. 0. 7. ECU_ADDRESS 0xd0004c52 /end MEASUREMENT
/begin MEASUREMENT Vsx_mis_inj4_vld "Misfire for cylinder 4 validity status which emets an injection cut request" UBYTE _CNV_S_8_STATUS_OK__181_CM 1 0. 0. 7. ECU_ADDRESS 0xd0004c53 /end MEASUREMENT
/begin MEASUREMENT Vsx_mis_lih_cyl_chk "Current state of the identification diagram for misfire limp home driving mode" UBYTE _CNV_A_R_ECME_LINEA_0_CM 1 0. 0. 255. ECU_ADDRESS 0xd0004c54 FORMAT "%3.0" /end MEASUREMENT
/begin MEASUREMENT Vsx_mis_lih_stt "Current state of the main diagram" UBYTE _CNV_A_R_ECME_LINEA_0_CM 1 0. 0. 255. ECU_ADDRESS 0xd0004c55 FORMAT "%3.0" /end MEASUREMENT
/begin MEASUREMENT Vxx_mis_cyl_fail_nr "Number of cylinders detected as misfiring" UBYTE _CNV_A_R_ECME_LINEA_0_CM 1 0. 0. 255. ECU_ADDRESS 0xd0004c56 FORMAT "%3.0" /end MEASUREMENT
/begin MEASUREMENT Vxx_mis_lih_mis_ctr "Compteur de misfire sur le cylindre apariÈ au cylindre coupÈ" UBYTE _CNV_A_R_ECME_LINEA_0_CM 1 0. 0. 255. ECU_ADDRESS 0xd0004c57 FORMAT "%3.0" /end MEASUREMENT
/begin MEASUREMENT Vxx_mis_lih_out_mis_ctr "Counter of exit from default mode by exit from misfiring detection strategy." UBYTE _CNV_A_R_ECME_LINEA_0_CM 1 0. 0. 255. ECU_ADDRESS 0xd0004c58 FORMAT "%3.0" /end MEASUREMENT
/begin MEASUREMENT Vxx_mis_lih_re_phs_ctr "Number of re-synchronization of the engine" UBYTE _CNV_A_R_ECME_LINEA_0_CM 1 0. 0. 255. ECU_ADDRESS 0xd0004c59 FORMAT "%3.0" /end MEASUREMENT
/begin MEASUREMENT Vxx_mis_lih_tdc_ctr "Compteur de PMH sur le cylindre" UBYTE _CNV_A_R_ECME_LINEA_0_CM 1 0. 0. 255. ECU_ADDRESS 0xd0004c5a FORMAT "%3.0" /end MEASUREMENT
/begin CHARACTERISTIC Cbx_mis_lih_conf "Bit of configuration for default mode" VALUE 0xa00207b2 _REC_S1VAL_20_u1 1. _CNV_S_2_RANGE______3_CM 0. 1. BIT_MASK 0x1 /end CHARACTERISTIC
/begin CHARACTERISTIC Cxx_mis_lih_chk_dsb_conf "Calibration that enable to chose or not to force the check of the engine synchronization" VALUE 0xa00207b3 _REC_S1VAL_20_u1 2. _CNV_A_R_ECME_LINEA_0_CM 0. 2. FORMAT "%1.0" /end CHARACTERISTIC
/begin CHARACTERISTIC Cxx_mis_lih_mis_nr "Nombre de misifre a detecter pour declarer le phasage mauvais" VALUE 0xa00207b4 _REC_S1VAL_20_u1 255. _CNV_A_R_ECME_LINEA_0_CM 0. 255. FORMAT "%3.0" /end CHARACTERISTIC
/begin CHARACTERISTIC Cxx_mis_lih_n_min "Minimum engine speed for default mode activation" VALUE 0xa00207ae _REC_S1VAL_20_u2 16383.75 _CNV_A_R_ENSD_LINEA_24_CM 0. 16383.75 FORMAT "%8.2" /end CHARACTERISTIC
/begin CHARACTERISTIC Cxx_mis_lih_out_mis_nr "Maximum number of exit from default mode by misfiring detection strategy." VALUE 0xa00207b5 _REC_S1VAL_20_u1 255. _CNV_A_R_ECME_LINEA_0_CM 0. 255. FORMAT "%3.0" /end CHARACTERISTIC
/begin CHARACTERISTIC Cxx_mis_lih_re_phs_nr "maximum number of re-synchronization of the engine." VALUE 0xa00207b6 _REC_S1VAL_20_u1 255. _CNV_A_R_ECME_LINEA_0_CM 0. 255. FORMAT "%3.0" /end CHARACTERISTIC
/begin CHARACTERISTIC Cxx_mis_lih_tdc_nr "taille de la fenetre de comptage pour verification phasage" VALUE 0xa00207b7 _REC_S1VAL_20_u1 255. _CNV_A_R_ECME_LINEA_0_CM 0. 255. FORMAT "%3.0" /end CHARACTERISTIC
/begin CHARACTERISTIC Cxx_mis_n_max_thd_1_n "Maximum engine speed threshold to allow misfire 1/n detection" VALUE 0xa00207b0 _REC_S1VAL_20_u2 16383.75 _CNV_A_R_ENSD_LINEA_24_CM 0. 16383.75 FORMAT "%8.2" /end CHARACTERISTIC
/begin AXIS_PTS Ctb_dft_comb_eal2 "Table of engine air load breakpoins for misfire cartographies." 0xa0025af0 Vxx_eal_tdc_2 _REC_A2AXS_20_u2 3.99993896484375 _CNV_A_R_LINEAR_____53_CM 5 0. 3.99993896484375 FORMAT "%10.8" /end AXIS_PTS
/begin AXIS_PTS Ctb_dft_comb_eal2_lpg "Table of engine air load breakpoins for misfire cartographies with LPG." 0xa0025afc Vxx_eal_tdc_2 _REC_A2AXS_20_u2 3.99993896484375 _CNV_A_R_LINEAR_____53_CM 5 0. 3.99993896484375 FORMAT "%10.8" /end AXIS_PTS
/begin AXIS_PTS Ctb_dft_comb_n2 "Table of engine speed breakpoins for misfire cartographies." 0xa0025b08 Vxx_n_tdc_2 _REC_A2AXS_20_u2 16383.75 _CNV_A_R_ENSD_LINEA_24_CM 5 0. 16383.75 FORMAT "%8.2" /end AXIS_PTS
/begin AXIS_PTS Ctb_dft_comb_n2_lpg "Table of engine speed breakpoins for misfire cartographies with LPG" 0xa0025b14 Vxx_n_tdc_2 _REC_A2AXS_20_u2 16383.75 _CNV_A_R_ENSD_LINEA_24_CM 5 0. 16383.75 FORMAT "%8.2" /end AXIS_PTS
/begin AXIS_PTS Ntb_tco_9 "water temperature breakpoints table (9 breakpoints) (∞C)" 0xa00261a0 Vxx_tco _REC_A2AXS_20_u2 240. _CNV_A_R_LINEAR_____54_CM 9 -40. 200. READ_ONLY FORMAT "%5.1" /end AXIS_PTS
/begin CHARACTERISTIC Cmp_mis_cata_degr "Cartographie (L: RÈgime , C: pression) de pondÈration misfire pour dÈgradation cata" MAP 0xa0025b20 _REC_A1MAP_20_u1_u2_u2 255. _CNV_A_R_ECME_LINEA_0_CM 0. 255. FORMAT "%3.0"
 /begin AXIS_DESCR COM_AXIS Vxx_eal_tdc_2 _CNV_A_R_LINEAR_____53_CM 17 0. 3.99993896484375 FORMAT "%7.5" AXIS_PTS_REF Ctb_dft_comb_eal /end AXIS_DESCR
 /begin AXIS_DESCR COM_AXIS Vxx_n_tdc_2 _CNV_A_R_ENSD_LINEA_24_CM 17 0. 16383.75 FORMAT "%8.2" AXIS_PTS_REF Ctb_mis_n_17 /end AXIS_DESCR
/end CHARACTERISTIC
/begin CHARACTERISTIC Cmp_mis_cata_degr_1 "Cartographie (L: RÈgime , C: pression) de pondÈration misfire pour dÈgradation cata au Gaz" MAP 0xa0025c44 _REC_A1MAP_20_u1_u2_u2 255. _CNV_A_R_ECME_LINEA_0_CM 0. 255. FORMAT "%3.0"
 /begin AXIS_DESCR COM_AXIS Vxx_eal_tdc_2 _CNV_A_R_LINEAR_____53_CM 17 0. 3.99993896484375 FORMAT "%7.5" AXIS_PTS_REF Ctb_dft_comb_eal /end AXIS_DESCR
 /begin AXIS_DESCR COM_AXIS Vxx_n_tdc_2 _CNV_A_R_ENSD_LINEA_24_CM 17 0. 16383.75 FORMAT "%8.2" AXIS_PTS_REF Ctb_mis_n_17 /end AXIS_DESCR
/end CHARACTERISTIC
/begin CHARACTERISTIC Cmp_mis_iga_efy_dif "Cartography autorized decline of the torque efficiency corresponding to applied avance" MAP 0xa0025d68 _REC_A1MAP_20_u2_u2_u2 1. _CNV_A_R_LINEAR_____125_CM 0. 1. FORMAT "%11.9"
 /begin AXIS_DESCR COM_AXIS Vxx_eal _CNV_A_R_LINEAR_____53_CM 16 0. 3.99993896484375 FORMAT "%10.8" AXIS_PTS_REF Ctb_eal /end AXIS_DESCR
 /begin AXIS_DESCR COM_AXIS Vxx_n _CNV_A_R_ENSD_LINEA_24_CM 20 0. 16383.75 FORMAT "%8.2" AXIS_PTS_REF Ctb_n /end AXIS_DESCR
/end CHARACTERISTIC
/begin CHARACTERISTIC Cmp_mis_tq_dif_1_2_dz_1 "Cartography of dead zone thresold for misfire 1/2 detection with LPG" MAP 0xa0025fe8 _REC_A1MAP_20_u1_u2_u2 255. _CNV_A_R_ECME_LINEA_0_CM 0. 255. FORMAT "%3.0"
 /begin AXIS_DESCR COM_AXIS Vxx_eal_tdc_2 _CNV_A_R_LINEAR_____53_CM 5 0. 3.99993896484375 FORMAT "%10.8" AXIS_PTS_REF Ctb_dft_comb_eal2_lpg /end AXIS_DESCR
 /begin AXIS_DESCR COM_AXIS Vxx_n_tdc_2 _CNV_A_R_ENSD_LINEA_24_CM 5 0. 16383.75 FORMAT "%8.2" AXIS_PTS_REF Ctb_dft_comb_n2_lpg /end AXIS_DESCR
/end CHARACTERISTIC
/begin CHARACTERISTIC Cmp_mis_tq_dif_1_4_dz_1 "Cartography of dead zone thresold for misfire 1/4 detection with LPG" MAP 0xa0026004 _REC_A1MAP_20_u1_u2_u2 255. _CNV_A_R_ECME_LINEA_0_CM 0. 255. FORMAT "%3.0"
 /begin AXIS_DESCR COM_AXIS Vxx_eal_tdc_2 _CNV_A_R_LINEAR_____53_CM 5 0. 3.99993896484375 FORMAT "%10.8" AXIS_PTS_REF Ctb_dft_comb_eal2_lpg /end AXIS_DESCR
 /begin AXIS_DESCR COM_AXIS Vxx_n_tdc_2 _CNV_A_R_ENSD_LINEA_24_CM 5 0. 16383.75 FORMAT "%8.2" AXIS_PTS_REF Ctb_dft_comb_n2_lpg /end AXIS_DESCR
/end CHARACTERISTIC
/begin CHARACTERISTIC Cmp_mis_tq_dif_fac_1_2 "Cartography of thresold for misfire 1/2 detection" MAP 0xa0026020 _REC_A1MAP_20_u1_u2_u2 255. _CNV_A_R_ECME_LINEA_0_CM 0. 255. FORMAT "%3.0"
 /begin AXIS_DESCR COM_AXIS Vxx_eal_tdc_2 _CNV_A_R_LINEAR_____53_CM 5 0. 3.99993896484375 FORMAT "%10.8" AXIS_PTS_REF Ctb_dft_comb_eal2 /end AXIS_DESCR
 /begin AXIS_DESCR COM_AXIS Vxx_n_tdc_2 _CNV_A_R_ENSD_LINEA_24_CM 5 0. 16383.75 FORMAT "%8.2" AXIS_PTS_REF Ctb_dft_comb_n2 /end AXIS_DESCR
/end CHARACTERISTIC
/begin CHARACTERISTIC Cmp_mis_tq_dif_fac_1_2_1 "Cartography of thresold for misfire 1/2 detection with LPG" MAP 0xa002603c _REC_A1MAP_20_u1_u2_u2 255. _CNV_A_R_ECME_LINEA_0_CM 0. 255. FORMAT "%3.0"
 /begin AXIS_DESCR COM_AXIS Vxx_eal_tdc_2 _CNV_A_R_LINEAR_____53_CM 5 0. 3.99993896484375 FORMAT "%10.8" AXIS_PTS_REF Ctb_dft_comb_eal2_lpg /end AXIS_DESCR
 /begin AXIS_DESCR COM_AXIS Vxx_n_tdc_2 _CNV_A_R_ENSD_LINEA_24_CM 5 0. 16383.75 FORMAT "%8.2" AXIS_PTS_REF Ctb_dft_comb_n2_lpg /end AXIS_DESCR
/end CHARACTERISTIC
/begin CHARACTERISTIC Cmp_mis_tq_dif_fac_1_2_dz "Cartography of dead zone thresold for misfire 1/2 detection" MAP 0xa0026058 _REC_A1MAP_20_u1_u2_u2 255. _CNV_A_R_ECME_LINEA_0_CM 0. 255. FORMAT "%3.0"
 /begin AXIS_DESCR COM_AXIS Vxx_eal_tdc_2 _CNV_A_R_LINEAR_____53_CM 5 0. 3.99993896484375 FORMAT "%10.8" AXIS_PTS_REF Ctb_dft_comb_eal2 /end AXIS_DESCR
 /begin AXIS_DESCR COM_AXIS Vxx_n_tdc_2 _CNV_A_R_ENSD_LINEA_24_CM 5 0. 16383.75 FORMAT "%8.2" AXIS_PTS_REF Ctb_dft_comb_n2 /end AXIS_DESCR
/end CHARACTERISTIC
/begin CHARACTERISTIC Cmp_mis_tq_dif_fac_1_4 "Cartography of thresold for misfire 1/4 detection" MAP 0xa0026074 _REC_A1MAP_20_u1_u2_u2 255. _CNV_A_R_ECME_LINEA_0_CM 0. 255. FORMAT "%3.0"
 /begin AXIS_DESCR COM_AXIS Vxx_eal_tdc_2 _CNV_A_R_LINEAR_____53_CM 5 0. 3.99993896484375 FORMAT "%10.8" AXIS_PTS_REF Ctb_dft_comb_eal2 /end AXIS_DESCR
 /begin AXIS_DESCR COM_AXIS Vxx_n_tdc_2 _CNV_A_R_ENSD_LINEA_24_CM 5 0. 16383.75 FORMAT "%8.2" AXIS_PTS_REF Ctb_dft_comb_n2 /end AXIS_DESCR
/end CHARACTERISTIC
/begin CHARACTERISTIC Cmp_mis_tq_dif_fac_1_4_1 "Cartography of thresold for misfire 1/4 detection with LPG" MAP 0xa0026090 _REC_A1MAP_20_u1_u2_u2 255. _CNV_A_R_ECME_LINEA_0_CM 0. 255. FORMAT "%3.0"
 /begin AXIS_DESCR COM_AXIS Vxx_eal_tdc_2 _CNV_A_R_LINEAR_____53_CM 5 0. 3.99993896484375 FORMAT "%10.8" AXIS_PTS_REF Ctb_dft_comb_eal2_lpg /end AXIS_DESCR
 /begin AXIS_DESCR COM_AXIS Vxx_n_tdc_2 _CNV_A_R_ENSD_LINEA_24_CM 5 0. 16383.75 FORMAT "%8.2" AXIS_PTS_REF Ctb_dft_comb_n2_lpg /end AXIS_DESCR
/end CHARACTERISTIC
/begin CHARACTERISTIC Cmp_mis_tq_dif_fac_1_4_dz "Cartography of dead zone thresold for misfire 1/4 detection" MAP 0xa00260ac _REC_A1MAP_20_u1_u2_u2 255. _CNV_A_R_ECME_LINEA_0_CM 0. 255. FORMAT "%3.0"
 /begin AXIS_DESCR COM_AXIS Vxx_eal_tdc_2 _CNV_A_R_LINEAR_____53_CM 5 0. 3.99993896484375 FORMAT "%10.8" AXIS_PTS_REF Ctb_dft_comb_eal2 /end AXIS_DESCR
 /begin AXIS_DESCR COM_AXIS Vxx_n_tdc_2 _CNV_A_R_ENSD_LINEA_24_CM 5 0. 16383.75 FORMAT "%8.2" AXIS_PTS_REF Ctb_dft_comb_n2 /end AXIS_DESCR
/end CHARACTERISTIC
/begin CHARACTERISTIC Cmp_mis_tq_dif_fac_intm "Cartography of thresold for misfire iso detection" MAP 0xa00260c8 _REC_A1MAP_20_u1_u2_u2 255. _CNV_A_R_ECME_LINEA_0_CM 0. 255. FORMAT "%3.0"
 /begin AXIS_DESCR COM_AXIS Vxx_eal_tdc_2 _CNV_A_R_LINEAR_____53_CM 5 0. 3.99993896484375 FORMAT "%10.8" AXIS_PTS_REF Ctb_dft_comb_eal2 /end AXIS_DESCR
 /begin AXIS_DESCR COM_AXIS Vxx_n_tdc_2 _CNV_A_R_ENSD_LINEA_24_CM 5 0. 16383.75 FORMAT "%8.2" AXIS_PTS_REF Ctb_dft_comb_n2 /end AXIS_DESCR
/end CHARACTERISTIC
/begin CHARACTERISTIC Cmp_mis_tq_dif_fac_intm_1 "Cartography of thresold for misfire iso detection with LPG" MAP 0xa00260e4 _REC_A1MAP_20_u1_u2_u2 255. _CNV_A_R_ECME_LINEA_0_CM 0. 255. FORMAT "%3.0"
 /begin AXIS_DESCR COM_AXIS Vxx_eal_tdc_2 _CNV_A_R_LINEAR_____53_CM 5 0. 3.99993896484375 FORMAT "%10.8" AXIS_PTS_REF Ctb_dft_comb_eal2_lpg /end AXIS_DESCR
 /begin AXIS_DESCR COM_AXIS Vxx_n_tdc_2 _CNV_A_R_ENSD_LINEA_24_CM 5 0. 16383.75 FORMAT "%8.2" AXIS_PTS_REF Ctb_dft_comb_n2_lpg /end AXIS_DESCR
/end CHARACTERISTIC
/begin CHARACTERISTIC Cmp_mis_tq_dif_intm_dz "Cartography of dead zone thresold for misfire iso detection" MAP 0xa0026100 _REC_A1MAP_20_u1_u2_u2 255. _CNV_A_R_ECME_LINEA_0_CM 0. 255. FORMAT "%3.0"
 /begin AXIS_DESCR COM_AXIS Vxx_eal_tdc_2 _CNV_A_R_LINEAR_____53_CM 5 0. 3.99993896484375 FORMAT "%10.8" AXIS_PTS_REF Ctb_dft_comb_eal2 /end AXIS_DESCR
 /begin AXIS_DESCR COM_AXIS Vxx_n_tdc_2 _CNV_A_R_ENSD_LINEA_24_CM 5 0. 16383.75 FORMAT "%8.2" AXIS_PTS_REF Ctb_dft_comb_n2 /end AXIS_DESCR
/end CHARACTERISTIC
/begin CHARACTERISTIC Cmp_mis_tq_dif_intm_dz_1 "Cartography of dead zone thresold for misfire iso detection with LPG" MAP 0xa002611c _REC_A1MAP_20_u1_u2_u2 255. _CNV_A_R_ECME_LINEA_0_CM 0. 255. FORMAT "%3.0"
 /begin AXIS_DESCR COM_AXIS Vxx_eal_tdc_2 _CNV_A_R_LINEAR_____53_CM 5 0. 3.99993896484375 FORMAT "%10.8" AXIS_PTS_REF Ctb_dft_comb_eal2_lpg /end AXIS_DESCR
 /begin AXIS_DESCR COM_AXIS Vxx_n_tdc_2 _CNV_A_R_ENSD_LINEA_24_CM 5 0. 16383.75 FORMAT "%8.2" AXIS_PTS_REF Ctb_dft_comb_n2_lpg /end AXIS_DESCR
/end CHARACTERISTIC
/begin CHARACTERISTIC Ctp_min_eal "Table de masses díair minimum = f(Vxx_prev2_n ) pour autorisation de diag misfire" CURVE 0xa0026138 _REC_A1CUR_20_u2_u2 3.99993896484375 _CNV_A_R_LINEAR_____53_CM 0. 3.99993896484375 FORMAT "%10.8"
 /begin AXIS_DESCR COM_AXIS Vxx_n_tdc_2 _CNV_A_R_ENSD_LINEA_24_CM 17 0. 16383.75 FORMAT "%8.2" AXIS_PTS_REF Ctb_mis_n_17 /end AXIS_DESCR
/end CHARACTERISTIC
/begin CHARACTERISTIC Ctp_min_eal_1_2 "Table de masses díair minimum = f(Vxx_prev2_n ) pour autorisation de diag misfire en mode 1/2" CURVE 0xa002615c _REC_A1CUR_20_u2_u2 3.99993896484375 _CNV_A_R_LINEAR_____53_CM 0. 3.99993896484375 FORMAT "%10.8"
 /begin AXIS_DESCR COM_AXIS Vxx_n_tdc_2 _CNV_A_R_ENSD_LINEA_24_CM 17 0. 16383.75 FORMAT "%8.2" AXIS_PTS_REF Ctb_mis_n_17 /end AXIS_DESCR
/end CHARACTERISTIC
/begin CHARACTERISTIC Ctp_min_eal_amp_ofs "Table díoffset de masses díair minimum = f (pression atmo) pour autorisation de diag misfire" CURVE 0xa0026180 _REC_A1CUR_20_u2_u2 3.99993896484375 _CNV_A_R_LINEAR_____343_CM -2. 1.99993896484375 FORMAT "%8.5"
 /begin AXIS_DESCR COM_AXIS Vxx_amp _CNV_A_R_LINEAR_____57_CM 6 0. 20000. FORMAT "%5.0" AXIS_PTS_REF Ctb_eng_amp /end AXIS_DESCR
/end CHARACTERISTIC
/begin CHARACTERISTIC Ctp_min_eal_off "Table díoffset de masses díair minimum = f (Teau) pour autorisation de diag misfire" CURVE 0xa002618c _REC_A1CUR_20_u2_u2 3.99993896484375 _CNV_A_R_LINEAR_____53_CM 0. 3.99993896484375 FORMAT "%10.8"
 /begin AXIS_DESCR COM_AXIS Vxx_tco _CNV_A_R_LINEAR_____54_CM 9 -40. 200. READ_ONLY FORMAT "%5.1" AXIS_PTS_REF Ntb_tco_9 /end AXIS_DESCR
/end CHARACTERISTIC
/begin MEASUREMENT Sxx_mis_ctr_clr "Reinit of Misfire counter for Service 6" UWORD _CNV_A_R_ECME_LINEA_0_CM 1 0. 0. 65535. ECU_ADDRESS 0xd0003aca FORMAT "%5.0" /end MEASUREMENT
/begin MEASUREMENT Sxx_mis_ctr_lpg_clr "Reinit of Misfire counter for LPG application" UWORD _CNV_A_R_ECME_LINEA_0_CM 1 0. 0. 65535. ECU_ADDRESS 0xd0003acc FORMAT "%5.0" /end MEASUREMENT
/begin MEASUREMENT Sxx_mis_ctr_lpg_read "Misfire counter init" UWORD _CNV_A_R_ECME_LINEA_0_CM 1 0. 0. 65535. ECU_ADDRESS 0xc0000c20 FORMAT "%5.0" /end MEASUREMENT
/begin MEASUREMENT Sxx_mis_ctr_read "Misfire counter init" UWORD _CNV_A_R_ECME_LINEA_0_CM 1 0. 0. 65535. ECU_ADDRESS 0xc0000c22 FORMAT "%5.0" /end MEASUREMENT
/begin MEASUREMENT Vbx_df_mis_1_cata "Cylinder 1 Misfire Detected Destructive Catalyst detected failure" UBYTE _CNV_S_2_RANGE______3_CM 1 0. 0. 1. ECU_ADDRESS 0xd0004ce8 BIT_MASK 0x1 /end MEASUREMENT
/begin MEASUREMENT Vbx_df_mis_1_lpg_cata "Cylinder 1 Misfire LPG Detected Destructive Catalyst detected failure" UBYTE _CNV_S_2_RANGE______3_CM 1 0. 0. 1. ECU_ADDRESS 0xd0004ce9 BIT_MASK 0x1 /end MEASUREMENT
/begin MEASUREMENT Vbx_df_mis_1_lpg_trs_h "Cylinder 1 Misfire LPG Detected Pollution detected failure" UBYTE _CNV_S_2_RANGE______3_CM 1 0. 0. 1. ECU_ADDRESS 0xd0004cea BIT_MASK 0x1 /end MEASUREMENT
/begin MEASUREMENT Vbx_df_mis_1_trs_h "Cylinder 1 Misfire Detected Pollution detected failure" UBYTE _CNV_S_2_RANGE______3_CM 1 0. 0. 1. ECU_ADDRESS 0xd0004ceb BIT_MASK 0x1 /end MEASUREMENT
/begin MEASUREMENT Vbx_df_mis_2_cata "Cylinder 2 Misfire Detected Destructive Catalyst detected failure" UBYTE _CNV_S_2_RANGE______3_CM 1 0. 0. 1. ECU_ADDRESS 0xd0004cec BIT_MASK 0x1 /end MEASUREMENT
/begin MEASUREMENT Vbx_df_mis_2_lpg_cata "Cylinder 2 Misfire LPG Detected Destructive Catalyst detected failure" UBYTE _CNV_S_2_RANGE______3_CM 1 0. 0. 1. ECU_ADDRESS 0xd0004ced BIT_MASK 0x1 /end MEASUREMENT
/begin MEASUREMENT Vbx_df_mis_2_lpg_trs_h "Cylinder 2 Misfire LPG Detected Pollution detected failure" UBYTE _CNV_S_2_RANGE______3_CM 1 0. 0. 1. ECU_ADDRESS 0xd0004cee BIT_MASK 0x1 /end MEASUREMENT
/begin MEASUREMENT Vbx_df_mis_2_trs_h "Cylinder 2 Misfire Detected Pollution detected failure" UBYTE _CNV_S_2_RANGE______3_CM 1 0. 0. 1. ECU_ADDRESS 0xd0004cef BIT_MASK 0x1 /end MEASUREMENT
/begin MEASUREMENT Vbx_df_mis_3_cata "Cylinder 3 Misfire Detected Destructive Catalyst detected failure" UBYTE _CNV_S_2_RANGE______3_CM 1 0. 0. 1. ECU_ADDRESS 0xd0004cf0 BIT_MASK 0x1 /end MEASUREMENT
/begin MEASUREMENT Vbx_df_mis_3_lpg_cata "Cylinder 3 Misfire LPG Detected Destructive Catalyst detected failure" UBYTE _CNV_S_2_RANGE______3_CM 1 0. 0. 1. ECU_ADDRESS 0xd0004cf1 BIT_MASK 0x1 /end MEASUREMENT
/begin MEASUREMENT Vbx_df_mis_3_lpg_trs_h "Cylinder 3 Misfire LPG Detected Pollution detected failure" UBYTE _CNV_S_2_RANGE______3_CM 1 0. 0. 1. ECU_ADDRESS 0xd0004cf2 BIT_MASK 0x1 /end MEASUREMENT
/begin MEASUREMENT Vbx_df_mis_3_trs_h "Cylinder 3 Misfire Detected Pollution detected failure" UBYTE _CNV_S_2_RANGE______3_CM 1 0. 0. 1. ECU_ADDRESS 0xd0004cf3 BIT_MASK 0x1 /end MEASUREMENT
/begin MEASUREMENT Vbx_df_mis_4_cata "Cylinder 4 Misfire Detected Destructive Catalyst detected failure" UBYTE _CNV_S_2_RANGE______3_CM 1 0. 0. 1. ECU_ADDRESS 0xd0004cf4 BIT_MASK 0x1 /end MEASUREMENT
/begin MEASUREMENT Vbx_df_mis_4_lpg_cata "Cylinder 4 Misfire LPG Detected Destructive Catalyst detected failure" UBYTE _CNV_S_2_RANGE______3_CM 1 0. 0. 1. ECU_ADDRESS 0xd0004cf5 BIT_MASK 0x1 /end MEASUREMENT
/begin MEASUREMENT Vbx_df_mis_4_lpg_trs_h "Cylinder 4 Misfire LPG Detected Pollution detected failure" UBYTE _CNV_S_2_RANGE______3_CM 1 0. 0. 1. ECU_ADDRESS 0xd0004cf6 BIT_MASK 0x1 /end MEASUREMENT
/begin MEASUREMENT Vbx_df_mis_4_trs_h "Cylinder 4 Misfire Detected Pollution detected failure" UBYTE _CNV_S_2_RANGE______3_CM 1 0. 0. 1. ECU_ADDRESS 0xd0004cf7 BIT_MASK 0x1 /end MEASUREMENT
/begin MEASUREMENT Vbx_df_mis_cata "Misfire Detected Destructive Catalyst detected failure" UBYTE _CNV_S_2_RANGE______3_CM 1 0. 0. 1. ECU_ADDRESS 0xd0004cf8 BIT_MASK 0x1 /end MEASUREMENT
/begin MEASUREMENT Vbx_df_mis_lpg_cata "Misfire LPG Detected Destructive Catalyst detected failure" UBYTE _CNV_S_2_RANGE______3_CM 1 0. 0. 1. ECU_ADDRESS 0xd0004cf9 BIT_MASK 0x1 /end MEASUREMENT
/begin MEASUREMENT Vbx_df_mis_lpg_trs_h "Misfire LPG Detected Pollution detected failure" UBYTE _CNV_S_2_RANGE______3_CM 1 0. 0. 1. ECU_ADDRESS 0xd0004cfa BIT_MASK 0x1 /end MEASUREMENT
/begin MEASUREMENT Vbx_df_mis_min_fuel_cata "Misfire Detected with Low Fuel Destructive Catalyst detected failure" UBYTE _CNV_S_2_RANGE______3_CM 1 0. 0. 1. ECU_ADDRESS 0xd0004cfb BIT_MASK 0x1 /end MEASUREMENT
/begin MEASUREMENT Vbx_df_mis_min_fuel_trs_h "Misfire Detected with Low Fuel Pollution detected failure" UBYTE _CNV_S_2_RANGE______3_CM 1 0. 0. 1. ECU_ADDRESS 0xd0004cfc BIT_MASK 0x1 /end MEASUREMENT
/begin MEASUREMENT Vbx_df_mis_trs_h "Misfire Detected Pollution detected failure" UBYTE _CNV_S_2_RANGE______3_CM 1 0. 0. 1. ECU_ADDRESS 0xd0004cfd BIT_MASK 0x1 /end MEASUREMENT
/begin MEASUREMENT Vbx_df_mis_unk_cata "Unknown Cylinder Misfire Detected Destructive Catalyst detected failure" UBYTE _CNV_S_2_RANGE______3_CM 1 0. 0. 1. ECU_ADDRESS 0xd0004cfe BIT_MASK 0x1 /end MEASUREMENT
/begin MEASUREMENT Vbx_df_mis_unk_lpg_cata "Unknown Cylinder Misfire LPG Detected Destructive Catalyst detected failure" UBYTE _CNV_S_2_RANGE______3_CM 1 0. 0. 1. ECU_ADDRESS 0xd0004cff BIT_MASK 0x1 /end MEASUREMENT
/begin MEASUREMENT Vbx_df_mis_unk_lpg_trs_h "Unknown Cylinder Misfire LPG Detected Pollution detected failure" UBYTE _CNV_S_2_RANGE______3_CM 1 0. 0. 1. ECU_ADDRESS 0xd0004d00 BIT_MASK 0x1 /end MEASUREMENT
/begin MEASUREMENT Vbx_df_mis_unk_trs_h "Unknown Cylinder Misfire Detected Pollution detected failure" UBYTE _CNV_S_2_RANGE______3_CM 1 0. 0. 1. ECU_ADDRESS 0xd0004d01 BIT_MASK 0x1 /end MEASUREMENT
/begin MEASUREMENT Vbx_diag_ena_mis_1_cata "Cylinder 1 Misfire Detected Destructive Catalyst diagnostic authorization" UBYTE _CNV_S_2_RANGE______3_CM 1 0. 0. 1. ECU_ADDRESS 0xd0004d02 BIT_MASK 0x1 /end MEASUREMENT
/begin MEASUREMENT Vbx_diag_ena_mis_1_lpg_cata "Cylinder 1 Misfire LPG Detected Destructive Catalyst diagnostic authorization" UBYTE _CNV_S_2_RANGE______3_CM 1 0. 0. 1. ECU_ADDRESS 0xd0004d03 BIT_MASK 0x1 /end MEASUREMENT
/begin MEASUREMENT Vbx_diag_ena_mis_1_lpg_trs_h "Cylinder 1 Misfire LPG Detected Pollution diagnostic authorization" UBYTE _CNV_S_2_RANGE______3_CM 1 0. 0. 1. ECU_ADDRESS 0xd0004d04 BIT_MASK 0x1 /end MEASUREMENT
/begin MEASUREMENT Vbx_diag_ena_mis_1_trs_h "Cylinder 1 Misfire Detected Pollution Diagnostic authorization" UBYTE _CNV_S_2_RANGE______3_CM 1 0. 0. 1. ECU_ADDRESS 0xd0004d05 BIT_MASK 0x1 /end MEASUREMENT
/begin MEASUREMENT Vbx_diag_ena_mis_2_cata "Cylinder 2 Misfire Detected Destructive Catalyst diagnostic authorization" UBYTE _CNV_S_2_RANGE______3_CM 1 0. 0. 1. ECU_ADDRESS 0xd0004d06 BIT_MASK 0x1 /end MEASUREMENT
/begin MEASUREMENT Vbx_diag_ena_mis_2_lpg_cata "Cylinder 2 Misfire LPG Detected Destructive Catalyst diagnostic authorization" UBYTE _CNV_S_2_RANGE______3_CM 1 0. 0. 1. ECU_ADDRESS 0xd0004d07 BIT_MASK 0x1 /end MEASUREMENT
/begin MEASUREMENT Vbx_diag_ena_mis_2_lpg_trs_h "Cylinder 2 Misfire LPG Detected Pollution diagnostic authorization" UBYTE _CNV_S_2_RANGE______3_CM 1 0. 0. 1. ECU_ADDRESS 0xd0004d08 BIT_MASK 0x1 /end MEASUREMENT
/begin MEASUREMENT Vbx_diag_ena_mis_2_trs_h "Cylinder 2 Misfire Detected Pollution Diagnostic authorization" UBYTE _CNV_S_2_RANGE______3_CM 1 0. 0. 1. ECU_ADDRESS 0xd0004d09 BIT_MASK 0x1 /end MEASUREMENT
/begin MEASUREMENT Vbx_diag_ena_mis_3_cata "Cylinder 3 Misfire Detected Destructive Catalyst diagnostic authorization" UBYTE _CNV_S_2_RANGE______3_CM 1 0. 0. 1. ECU_ADDRESS 0xd0004d0a BIT_MASK 0x1 /end MEASUREMENT
/begin MEASUREMENT Vbx_diag_ena_mis_3_lpg_cata "Cylinder 3 Misfire LPG Detected Destructive Catalyst diagnostic authorization" UBYTE _CNV_S_2_RANGE______3_CM 1 0. 0. 1. ECU_ADDRESS 0xd0004d0b BIT_MASK 0x1 /end MEASUREMENT
/begin MEASUREMENT Vbx_diag_ena_mis_3_lpg_trs_h "Cylinder 3 Misfire LPG Detected Pollution diagnostic authorization" UBYTE _CNV_S_2_RANGE______3_CM 1 0. 0. 1. ECU_ADDRESS 0xd0004d0c BIT_MASK 0x1 /end MEASUREMENT
/begin MEASUREMENT Vbx_diag_ena_mis_3_trs_h "Cylinder 3 Misfire Detected Pollution Diagnostic authorization" UBYTE _CNV_S_2_RANGE______3_CM 1 0. 0. 1. ECU_ADDRESS 0xd0004d0d BIT_MASK 0x1 /end MEASUREMENT
/begin MEASUREMENT Vbx_diag_ena_mis_4_cata "Cylinder 4 Misfire Detected Destructive Catalyst diagnostic authorization" UBYTE _CNV_S_2_RANGE______3_CM 1 0. 0. 1. ECU_ADDRESS 0xd0004d0e BIT_MASK 0x1 /end MEASUREMENT
/begin MEASUREMENT Vbx_diag_ena_mis_4_lpg_cata "Cylinder 4 Misfire LPG Detected Destructive Catalyst diagnostic authorization" UBYTE _CNV_S_2_RANGE______3_CM 1 0. 0. 1. ECU_ADDRESS 0xd0004d0f BIT_MASK 0x1 /end MEASUREMENT
/begin MEASUREMENT Vbx_diag_ena_mis_4_lpg_trs_h "Cylinder 4 Misfire LPG Detected Pollution diagnostic authorization" UBYTE _CNV_S_2_RANGE______3_CM 1 0. 0. 1. ECU_ADDRESS 0xd0004d10 BIT_MASK 0x1 /end MEASUREMENT
/begin MEASUREMENT Vbx_diag_ena_mis_4_trs_h "Cylinder 4 Misfire Detected Pollution Diagnostic authorization" UBYTE _CNV_S_2_RANGE______3_CM 1 0. 0. 1. ECU_ADDRESS 0xd0004d11 BIT_MASK 0x1 /end MEASUREMENT
/begin MEASUREMENT Vbx_diag_ena_mis_cata "Misfire Detected Destructive Catalyst diagnostic authorization" UBYTE _CNV_S_2_RANGE______3_CM 1 0. 0. 1. ECU_ADDRESS 0xd0004d12 BIT_MASK 0x1 /end MEASUREMENT
/begin MEASUREMENT Vbx_diag_ena_mis_lpg_cata "Misfire LPG Detected Destructive Catalyst diagnostic authorization" UBYTE _CNV_S_2_RANGE______3_CM 1 0. 0. 1. ECU_ADDRESS 0xd0004d13 BIT_MASK 0x1 /end MEASUREMENT
/begin MEASUREMENT Vbx_diag_ena_mis_lpg_trs_h "Misfire LPG Detected Pollution diagnostic" UBYTE _CNV_S_2_RANGE______3_CM 1 0. 0. 1. ECU_ADDRESS 0xd0004d14 BIT_MASK 0x1 /end MEASUREMENT
/begin MEASUREMENT Vbx_diag_ena_mis_min_fuel_cata "Misfire Detected with Low Fuel Destructive Catalyst diagnostic authorization" UBYTE _CNV_S_2_RANGE______3_CM 1 0. 0. 1. ECU_ADDRESS 0xd0004d15 BIT_MASK 0x1 /end MEASUREMENT
/begin MEASUREMENT Vbx_diag_ena_mis_min_fuel_trs_h "Misfire Detected with Low Fuel Pollution diagnostic authorization" UBYTE _CNV_S_2_RANGE______3_CM 1 0. 0. 1. ECU_ADDRESS 0xd0004d16 BIT_MASK 0x1 /end MEASUREMENT
/begin MEASUREMENT Vbx_diag_ena_mis_trs_h "Misfire Detected Pollution diagnostic authorization" UBYTE _CNV_S_2_RANGE______3_CM 1 0. 0. 1. ECU_ADDRESS 0xd0004d17 BIT_MASK 0x1 /end MEASUREMENT
/begin MEASUREMENT Vbx_diag_ena_mis_unk_cata "Unknown Cylinder Misfire Detected Destructive Catalyst diagnostic authorization" UBYTE _CNV_S_2_RANGE______3_CM 1 0. 0. 1. ECU_ADDRESS 0xd0004d18 BIT_MASK 0x1 /end MEASUREMENT
/begin MEASUREMENT Vbx_diag_ena_mis_unk_lpg_cata "Unknown Cylinder Misfire LPG Detected Destructive Catalyst diagnostic authorization" UBYTE _CNV_S_2_RANGE______3_CM 1 0. 0. 1. ECU_ADDRESS 0xd0004d19 BIT_MASK 0x1 /end MEASUREMENT
/begin MEASUREMENT Vbx_diag_ena_mis_unk_lpg_trs_h "Unknown Cylinder Misfire LPG Detected Pollution diagnostic authorization" UBYTE _CNV_S_2_RANGE______3_CM 1 0. 0. 1. ECU_ADDRESS 0xd0004d1a BIT_MASK 0x1 /end MEASUREMENT
/begin MEASUREMENT Vbx_diag_ena_mis_unk_trs_h "Unknown Cylinder Misfire Detected Pollution diagnostic authorization" UBYTE _CNV_S_2_RANGE______3_CM 1 0. 0. 1. ECU_ADDRESS 0xd0004d1b BIT_MASK 0x1 /end MEASUREMENT
/begin MEASUREMENT Vbx_dsb_diag_mis "Inhibition gÈnÈrale du diag misfire" UBYTE _CNV_S_2_RANGE______3_CM 1 0. 0. 1. ECU_ADDRESS 0xd0004d1c BIT_MASK 0x1 /end MEASUREMENT
/begin MEASUREMENT Vbx_frst_inj_re "Init for the first rephasage" UBYTE _CNV_S_2_RANGE______3_CM 1 0. 0. 1. ECU_ADDRESS 0xd0004d1d BIT_MASK 0x1 /end MEASUREMENT
/begin MEASUREMENT Vbx_mil_flsh_req "MIL flashing request status (0 switch off, 1 switch on)" UBYTE _CNV_S_2_RANGE______3_CM 1 0. 0. 1. ECU_ADDRESS 0xd0004d1e BIT_MASK 0x1 /end MEASUREMENT
/begin MEASUREMENT Vbx_mis_cata_cf_vld "Misfire confirmed Destructive Catalyst validity status" UBYTE _CNV_S_2_RANGE______3_CM 1 0. 0. 1. ECU_ADDRESS 0xd0004d1f BIT_MASK 0x1 /end MEASUREMENT
/begin MEASUREMENT Vbx_mis_cata_rst_done "Reset of catalyst window done" UBYTE _CNV_S_2_RANGE______3_CM 1 0. 0. 1. ECU_ADDRESS 0xd0004d20 BIT_MASK 0x1 /end MEASUREMENT
/begin MEASUREMENT Vbx_mis_cata_win_stop "End of catalyst misifring window" UBYTE _CNV_S_2_RANGE______3_CM 1 0. 0. 1. ECU_ADDRESS 0xd0004d21 BIT_MASK 0x1 /end MEASUREMENT
/begin MEASUREMENT Vbx_mis_cyl1 "Misfire dÈtectÈ sur cylindre 1" UBYTE _CNV_S_2_RANGE______3_CM 1 0. 0. 1. ECU_ADDRESS 0xd0004d22 BIT_MASK 0x1 /end MEASUREMENT
/begin MEASUREMENT Vbx_mis_cyl1_fail "Cylinder 1 misfiring" UBYTE _CNV_S_2_RANGE______3_CM 1 0. 0. 1. ECU_ADDRESS 0xd0004d23 BIT_MASK 0x1 /end MEASUREMENT
/begin MEASUREMENT Vbx_mis_cyl2 "Misfire dÈtectÈ sur cylindre 2" UBYTE _CNV_S_2_RANGE______3_CM 1 0. 0. 1. ECU_ADDRESS 0xd0004d24 BIT_MASK 0x1 /end MEASUREMENT
/begin MEASUREMENT Vbx_mis_cyl2_fail "Cylinder 2 misfiring" UBYTE _CNV_S_2_RANGE______3_CM 1 0. 0. 1. ECU_ADDRESS 0xd0004d25 BIT_MASK 0x1 /end MEASUREMENT
/begin MEASUREMENT Vbx_mis_cyl3 "Misfire dÈtectÈ sur cylindre 3" UBYTE _CNV_S_2_RANGE______3_CM 1 0. 0. 1. ECU_ADDRESS 0xd0004d26 BIT_MASK 0x1 /end MEASUREMENT
/begin MEASUREMENT Vbx_mis_cyl3_fail "Cylinder 3 misfiring" UBYTE _CNV_S_2_RANGE______3_CM 1 0. 0. 1. ECU_ADDRESS 0xd0004d27 BIT_MASK 0x1 /end MEASUREMENT
/begin MEASUREMENT Vbx_mis_cyl4 "Misfire dÈtectÈ sur cylindre 4" UBYTE _CNV_S_2_RANGE______3_CM 1 0. 0. 1. ECU_ADDRESS 0xd0004d28 BIT_MASK 0x1 /end MEASUREMENT
/begin MEASUREMENT Vbx_mis_cyl4_fail "Cylinder 4 misfiring" UBYTE _CNV_S_2_RANGE______3_CM 1 0. 0. 1. ECU_ADDRESS 0xd0004d29 BIT_MASK 0x1 /end MEASUREMENT
/begin MEASUREMENT Vbx_mis_det "Misfire (mauvaise combustion) reconnue" UBYTE _CNV_S_2_RANGE______3_CM 1 0. 0. 1. ECU_ADDRESS 0xd0004d2a BIT_MASK 0x1 /end MEASUREMENT
/begin MEASUREMENT Vbx_mis_det_1_2 "DÈtection Misfire 1 sur 2" UBYTE _CNV_S_2_RANGE______3_CM 1 0. 0. 1. ECU_ADDRESS 0xd0004d2b BIT_MASK 0x1 /end MEASUREMENT
/begin MEASUREMENT Vbx_mis_det_1_4 "DÈtection Misfire 1 sur 4" UBYTE _CNV_S_2_RANGE______3_CM 1 0. 0. 1. ECU_ADDRESS 0xd0004d2c BIT_MASK 0x1 /end MEASUREMENT
/begin MEASUREMENT Vbx_mis_det_1_4_prev2 "Misfire 1/4 detected tdc i-2" UBYTE _CNV_S_2_RANGE______3_CM 1 0. 0. 1. ECU_ADDRESS 0xd0004d2d BIT_MASK 0x1 /end MEASUREMENT
/begin MEASUREMENT Vbx_mis_det_intm "DÈtection Misfire isolÈ" UBYTE _CNV_S_2_RANGE______3_CM 1 0. 0. 1. ECU_ADDRESS 0xd0004d2e BIT_MASK 0x1 /end MEASUREMENT
/begin MEASUREMENT Vbx_mis_det_prev16 "Misfire detected in 16 TDC previous" UBYTE _CNV_S_2_RANGE______3_CM 1 0. 0. 1. ECU_ADDRESS 0xd0004d2f BIT_MASK 0x1 /end MEASUREMENT
/begin MEASUREMENT Vbx_mis_frst_diag_done "Initialisation of Sxx_mis_ctr and Sxx_mis_ctr_lpg for first step" UBYTE _CNV_S_2_RANGE______3_CM 1 0. 0. 1. ECU_ADDRESS 0xd0004d30 BIT_MASK 0x1 /end MEASUREMENT
/begin MEASUREMENT Vbx_mis_obd_diag_stop "Other OBD diagnosis inhibited by misfire strategy in State \"Out of Diagnosis\"" UBYTE _CNV_S_2_RANGE______3_CM 1 0. 0. 1. ECU_ADDRESS 0xd0004d31 BIT_MASK 0x1 /end MEASUREMENT
/begin MEASUREMENT Vbx_mis_req "RequÍte de diagnostic misfire au sÈquenceur" UBYTE _CNV_S_2_RANGE______3_CM 1 0. 0. 1. ECU_ADDRESS 0xd0004d32 BIT_MASK 0x1 /end MEASUREMENT
/begin MEASUREMENT Vbx_mis_stop "misfiring strategy freezed on the current TDC" UBYTE _CNV_S_2_RANGE______3_CM 1 0. 0. 1. ECU_ADDRESS 0xd0004d33 BIT_MASK 0x1 /end MEASUREMENT
/begin MEASUREMENT Vbx_pres_mis_fast "Panne prÈsente misfire \"rafale\" dÈtectÈe" UBYTE _CNV_S_2_RANGE______3_CM 1 0. 0. 1. ECU_ADDRESS 0xd0004d34 BIT_MASK 0x1 /end MEASUREMENT
/begin MEASUREMENT Vsx_mis_cata_vld "Catalyst misfire validity status" UBYTE _CNV_S_8_STATUS_OK__181_CM 1 0. 0. 7. ECU_ADDRESS 0xd0004d35 /end MEASUREMENT
/begin MEASUREMENT Vsx_mis_stt "State Misfire Diagnostic" UBYTE _CNV_A_R_ECME_LINEA_0_CM 1 0. 0. 255. ECU_ADDRESS 0xd0004d36 FORMAT "%3.0" /end MEASUREMENT
/begin MEASUREMENT Vsx_mis_vld "Misfire validity status" UBYTE _CNV_S_8_STATUS_OK__181_CM 1 0. 0. 7. ECU_ADDRESS 0xd0004d37 /end MEASUREMENT
/begin MEASUREMENT Vxx_agb_conv_trs_dly "Inhibition Delay Misfire diagnostic" UWORD _CNV_A_R_LINEAR_____344_CM 1 0. 0. 32767.5 ECU_ADDRESS 0xd0003ace FORMAT "%7.1" /end MEASUREMENT
/begin MEASUREMENT Vxx_eal_ofs_agb_dri "offset sur charge si bva en drive pour misfire" UWORD _CNV_A_R_LINEAR_____53_CM 1 0. 0. 3.99993896484375 ECU_ADDRESS 0xd0003ad0 FORMAT "%10.8" /end MEASUREMENT
/begin MEASUREMENT Vxx_max_iga_efy_prev2 "torque efficiency corresponding to maximum ignition advance in tdc i-2" UWORD _CNV_A_R_LINEAR_____125_CM 1 0. 0. 1. ECU_ADDRESS 0xd0003ad2 FORMAT "%11.8" /end MEASUREMENT
/begin MEASUREMENT Vxx_min_eal_1_2 "Output of Table de masses díair minimum = f(Vxx_prev2_n ) pour autorisation de diag misfire en mode 1/2" UWORD _CNV_A_R_LINEAR_____53_CM 1 0. 0. 3.99993896484375 ECU_ADDRESS 0xd0003ad4 FORMAT "%10.8" /end MEASUREMENT
/begin MEASUREMENT Vxx_mis_16_mis_ctr "Misfire Counter in last 16 TDC" UBYTE _CNV_A_R_ECME_LINEA_0_CM 1 0. 0. 255. ECU_ADDRESS 0xd0004d38 FORMAT "%3.0" /end MEASUREMENT
/begin MEASUREMENT Vxx_mis_cata_degr "Output of Cartographie (L: RÈgime , C: pression) de pondÈration misfire pour dÈgradation cata" UBYTE _CNV_A_R_ECME_LINEA_0_CM 1 0. 0. 255. ECU_ADDRESS 0xd0004d39 FORMAT "%3.0" /end MEASUREMENT
/begin MEASUREMENT Vxx_mis_cata_min_fuel_nr "Nombre de misfire cata dÈtectÈs sous niveau mini de carburant" UBYTE _CNV_A_R_ECME_LINEA_0_CM 1 0. 0. 255. ECU_ADDRESS 0xd0004d3a FORMAT "%3.0" /end MEASUREMENT
/begin MEASUREMENT Vxx_mis_cata_mis_ctr "Compteur de misfire dans fenetre misfire cata" UWORD _CNV_A_R_ECME_LINEA_0_CM 1 0. 0. 65535. ECU_ADDRESS 0xd0003ad6 FORMAT "%5.0" /end MEASUREMENT
/begin MEASUREMENT Vxx_mis_cata_tdc_ctr "Compteur de pmh dans fenetre misfire cata" UWORD _CNV_A_R_LINEAR_____55_CM 1 0. 0. 65535. ECU_ADDRESS 0xd0003ad8 FORMAT "%5.0" /end MEASUREMENT
/begin MEASUREMENT Vxx_mis_cata_tdc_nr_tot "Total number of TDC under catalyst misfire present failure" ULONG _CNV_A_R_LINEAR_____55_CM 1 0. 0. 2147483647. ECU_ADDRESS 0xd0002406 FORMAT "%10.0" /end MEASUREMENT
/begin MEASUREMENT Vxx_mis_cata_tdc_prmt "Total number of TDC under catalyst misfire present failure (permanent)" ULONG _CNV_A_R_LINEAR_____55_CM 1 0. 0. 2147483647. ECU_ADDRESS 0xd000240a FORMAT "%10.0" /end MEASUREMENT
/begin MEASUREMENT Vxx_mis_cata_win_mis_nr "Nombre de pmh mini pour diag misfire cata" UWORD _CNV_A_R_LINEAR_____55_CM 1 0. 0. 65535. ECU_ADDRESS 0xd0003ada FORMAT "%5.0" /end MEASUREMENT
/begin MEASUREMENT Vxx_mis_ctr_ini "Valeur EEPROM init du Misfire counter for Service 6" UWORD _CNV_A_R_ECME_LINEA_0_CM 1 0. 0. 65535. ECU_ADDRESS 0xd0003adc FORMAT "%5.0" /end MEASUREMENT
/begin MEASUREMENT Vxx_mis_ctr_lpg_ini "Valeur EEPROM init du Misfire counter LPG for Service 6" UWORD _CNV_A_R_ECME_LINEA_0_CM 1 0. 0. 65535. ECU_ADDRESS 0xd0003ade FORMAT "%5.0" /end MEASUREMENT
/begin MEASUREMENT Vxx_mis_cyl1_tdc_ctr "Tdc counter o cylinder 1" UWORD _CNV_A_R_LINEAR_____55_CM 1 0. 0. 65535. ECU_ADDRESS 0xd0003ae0 FORMAT "%5.0" /end MEASUREMENT
/begin MEASUREMENT Vxx_mis_cyl2_tdc_ctr "Tdc counter o cylinder 2" UWORD _CNV_A_R_LINEAR_____55_CM 1 0. 0. 65535. ECU_ADDRESS 0xd0003ae2 FORMAT "%5.0" /end MEASUREMENT
/begin MEASUREMENT Vxx_mis_cyl3_tdc_ctr "Tdc counter o cylinder 3" UWORD _CNV_A_R_LINEAR_____55_CM 1 0. 0. 65535. ECU_ADDRESS 0xd0003ae4 FORMAT "%5.0" /end MEASUREMENT
/begin MEASUREMENT Vxx_mis_cyl4_tdc_ctr "Tdc counter o cylinder 4" UWORD _CNV_A_R_LINEAR_____55_CM 1 0. 0. 65535. ECU_ADDRESS 0xd0003ae6 FORMAT "%5.0" /end MEASUREMENT
/begin MEASUREMENT Vxx_mis_diag_dsb_dly "Inhibition Delay Misfire diagnostic" UWORD _CNV_A_R_LINEAR_____344_CM 1 0. 0. 32767.5 ECU_ADDRESS 0xd0003ae8 FORMAT "%7.1" /end MEASUREMENT
/begin MEASUREMENT Vxx_mis_dt "Output of a RSA timer for the statemachine for the decrement of Vxx_mis_obd_diag_stop" UBYTE _CNV_A_R_LINEAR_____34_CM 1 0. 0. 2.55 ECU_ADDRESS 0xd0004d3b FORMAT "%4.2" /end MEASUREMENT
/begin MEASUREMENT Vxx_mis_eal_frz "Filtered engine air load for misfiring freeze frame" UBYTE _CNV_A_R_LINEAR_____114_CM 1 0. 0. 100. ECU_ADDRESS 0xd0004d3c FORMAT "%12.8" /end MEASUREMENT
/begin MEASUREMENT Vxx_mis_eol_mod_mis_ctr "Compteur de misfire en mode diagnostic fin de chaine" UWORD _CNV_A_R_ECME_LINEA_0_CM 1 0. 0. 65535. ECU_ADDRESS 0xd0003aea FORMAT "%5.0" /end MEASUREMENT
/begin MEASUREMENT Vxx_mis_eol_mod_prop "Pourcentage de misfire en mode diagnostic fin de chaine" UBYTE _CNV_A_R_LINEAR_____345_CM 1 0. 0. 100. ECU_ADDRESS 0xd0004d3d FORMAT "%3.1" /end MEASUREMENT
/begin MEASUREMENT Vxx_mis_eol_mod_tdc_ctr "Compteur de pmh en mode diagnostic fin de chaine" UWORD _CNV_A_R_LINEAR_____55_CM 1 0. 0. 65535. ECU_ADDRESS 0xd0003aec FORMAT "%5.0" /end MEASUREMENT
/begin MEASUREMENT Vxx_mis_fast_mis_ctr "Compteur de misfire dans fenetre glissante misfire" UBYTE _CNV_A_R_ECME_LINEA_0_CM 1 0. 0. 255. ECU_ADDRESS 0xd0004d3e FORMAT "%3.0" /end MEASUREMENT
/begin MEASUREMENT Vxx_mis_fast_tdc_ctr "Compteur de pmh dans fenetre glissante misfire" UBYTE _CNV_A_R_LINEAR_____55_CM 1 0. 0. 255. ECU_ADDRESS 0xd0004d3f FORMAT "%3.0" /end MEASUREMENT
/begin MEASUREMENT Vxx_mis_iga_efy_dif_2 "Output of cartography torque efficiency corresponding to maximum ignition advance" UWORD _CNV_A_R_LINEAR_____125_CM 1 0. 0. 1. ECU_ADDRESS 0xd0003aee FORMAT "%11.9" /end MEASUREMENT
/begin MEASUREMENT Vxx_mis_l_n_tdc_ctr "Compteur de pmh ‡ bas rÈgime pour le diagnostic Misfire" UWORD _CNV_A_R_LINEAR_____55_CM 1 0. 0. 65535. ECU_ADDRESS 0xd0003af0 FORMAT "%5.0" /end MEASUREMENT
/begin MEASUREMENT Vxx_mis_n_frz "Filtered engine speed for misfiring freeze frame" UWORD _CNV_A_R_ENSD_LINEA_24_CM 1 0. 0. 16383.75 ECU_ADDRESS 0xd0003af2 FORMAT "%8.2" /end MEASUREMENT
/begin MEASUREMENT Vxx_mis_n_max_thd_1_n "Maximum engine speed for 1/n misfiring detection" UWORD _CNV_A_R_ENSD_LINEA_24_CM 1 0. 0. 16383.75 ECU_ADDRESS 0xd0003af4 FORMAT "%8.2" /end MEASUREMENT
/begin MEASUREMENT Vxx_mis_nr_cyl1 "Nombre de misfire dÈtectÈs sur le cylindre 1" UWORD _CNV_A_R_ECME_LINEA_0_CM 1 0. 0. 65535. ECU_ADDRESS 0xd0003af6 FORMAT "%5.0" /end MEASUREMENT
/begin MEASUREMENT Vxx_mis_nr_cyl2 "Nombre de misfire dÈtectÈs sur le cylindre 2" UWORD _CNV_A_R_ECME_LINEA_0_CM 1 0. 0. 65535. ECU_ADDRESS 0xd0003af8 FORMAT "%5.0" /end MEASUREMENT
/begin MEASUREMENT Vxx_mis_nr_cyl3 "Nombre de misfire dÈtectÈs sur le cylindre 3" UWORD _CNV_A_R_ECME_LINEA_0_CM 1 0. 0. 65535. ECU_ADDRESS 0xd0003afa FORMAT "%5.0" /end MEASUREMENT
/begin MEASUREMENT Vxx_mis_nr_cyl4 "Nombre de misfire dÈtectÈs sur le cylindre 4" UWORD _CNV_A_R_ECME_LINEA_0_CM 1 0. 0. 65535. ECU_ADDRESS 0xd0003afc FORMAT "%5.0" /end MEASUREMENT
/begin MEASUREMENT Vxx_mis_obd_diag_stop "Temporisation d'inhibition des diags obd par le misfire" UBYTE _CNV_A_R_LINEAR_____34_CM 1 0. 0. 2.55 ECU_ADDRESS 0xd0004d40 FORMAT "%4.2" /end MEASUREMENT
/begin MEASUREMENT Vxx_mis_polu_mis_ctr "Compteur de misfire dans fenetre misfire pollu" UWORD _CNV_A_R_ECME_LINEA_0_CM 1 0. 0. 65535. ECU_ADDRESS 0xd0003afe FORMAT "%5.0" /end MEASUREMENT
/begin MEASUREMENT Vxx_mis_polu_tdc_ctr "Compteur de pmh dans fenetre misfire pollu" UWORD _CNV_A_R_LINEAR_____55_CM 1 0. 0. 65535. ECU_ADDRESS 0xd0003b00 FORMAT "%5.0" /end MEASUREMENT
/begin MEASUREMENT Vxx_mis_polu_tot_ctr "Compteur de misfire pollu total" UBYTE _CNV_A_R_ECME_LINEA_0_CM 1 0. 0. 255. ECU_ADDRESS 0xd0004d41 FORMAT "%3.0" /end MEASUREMENT
/begin MEASUREMENT Vxx_mis_polu_win_ctr "Compteur de misfire pollu consÈcutifs" UBYTE _CNV_A_R_ECME_LINEA_0_CM 1 0. 0. 255. ECU_ADDRESS 0xd0004d42 FORMAT "%3.0" /end MEASUREMENT
/begin MEASUREMENT Vxx_mis_polu_win_mis_nr "Nombre de pmh mini pour diag misfire pollu" UWORD _CNV_A_R_LINEAR_____55_CM 1 0. 0. 65535. ECU_ADDRESS 0xd0003b02 FORMAT "%5.0" /end MEASUREMENT
/begin MEASUREMENT Vxx_mis_stab_tdc_ctr "Compteur de pmh pour stabilisation avant diag misfire" UBYTE _CNV_A_R_LINEAR_____55_CM 1 0. 0. 255. ECU_ADDRESS 0xd0004d43 FORMAT "%3.0" /end MEASUREMENT
/begin MEASUREMENT Vxx_mis_tq_dif_fac_1_2 "Output of Cartography of thresold for misfire 1/2 detection" UBYTE _CNV_A_R_LINEAR_____346_CM 1 0. 0. 1. ECU_ADDRESS 0xd0004d44 FORMAT "%5.3" /end MEASUREMENT
/begin MEASUREMENT Vxx_mis_tq_dif_fac_1_2_dz "Output of Cartography of dead zone thresold for misfire 1/2 detection" UBYTE _CNV_A_R_LINEAR_____346_CM 1 0. 0. 1. ECU_ADDRESS 0xd0004d45 FORMAT "%5.3" /end MEASUREMENT
/begin MEASUREMENT Vxx_mis_tq_dif_fac_1_4 "Output of Cartography of thresold for misfire 1/4 detection" UBYTE _CNV_A_R_LINEAR_____346_CM 1 0. 0. 1. ECU_ADDRESS 0xd0004d46 FORMAT "%5.3" /end MEASUREMENT
/begin MEASUREMENT Vxx_mis_tq_dif_fac_1_4_dz "Output of Cartography of dead zone thresold for misfire 1/4 detection" UBYTE _CNV_A_R_LINEAR_____346_CM 1 0. 0. 1. ECU_ADDRESS 0xd0004d47 FORMAT "%5.3" /end MEASUREMENT
/begin MEASUREMENT Vxx_mis_tq_dif_fac_intm "Output of Cartography of thresold for misfire iso detection" UBYTE _CNV_A_R_LINEAR_____346_CM 1 0. 0. 1. ECU_ADDRESS 0xd0004d48 FORMAT "%5.3" /end MEASUREMENT
/begin MEASUREMENT Vxx_mis_tq_dif_intm_dz "Output of Cartography of dead zone thresold for misfire iso detection" UBYTE _CNV_A_R_LINEAR_____346_CM 1 0. 0. 1. ECU_ADDRESS 0xd0004d49 FORMAT "%5.3" /end MEASUREMENT
/begin CHARACTERISTIC Cbx_mis_conf_diag_mis "Configuration Misfire strategy" VALUE 0xa0020c26 _REC_S1VAL_20_u1 1. _CNV_S_2_RANGE______3_CM 0. 1. BIT_MASK 0x1 /end CHARACTERISTIC
/begin CHARACTERISTIC Cxx_agb_conv_trs_dly "Calibration Inhibition Delay Misfire diagnostic" VALUE 0xa0020ba4 _REC_S1VAL_20_u2 32767.5 _CNV_A_R_LINEAR_____344_CM 0. 32767.5 FORMAT "%3.1" /end CHARACTERISTIC
/begin CHARACTERISTIC Cxx_dfdec_mis_1_cata "Cylinder 1 Misfire Detected Destructive Catalyst detected failure counter decrement" VALUE 0xa0020ba6 _REC_S1VAL_20_u2 65535. _CNV_A_R_ECME_LINEA_0_CM 0. 65535. FORMAT "%5.0" /end CHARACTERISTIC
/begin CHARACTERISTIC Cxx_dfdec_mis_1_lpg_cata "Cylinder 1 Misfire LPG Detected Destructive Catalyst detected failure counter decrement" VALUE 0xa0020ba8 _REC_S1VAL_20_u2 65535. _CNV_A_R_ECME_LINEA_0_CM 0. 65535. FORMAT "%5.0" /end CHARACTERISTIC
/begin CHARACTERISTIC Cxx_dfdec_mis_1_lpg_trs_h "Cylinder 1 Misfire LPG Detected Pollution detected failure counter decrement" VALUE 0xa0020baa _REC_S1VAL_20_u2 65535. _CNV_A_R_ECME_LINEA_0_CM 0. 65535. FORMAT "%5.0" /end CHARACTERISTIC
/begin CHARACTERISTIC Cxx_dfdec_mis_1_trs_h "Cylinder 1 Misfire Detected Pollution detected failure counter decrement" VALUE 0xa0020bac _REC_S1VAL_20_u2 65535. _CNV_A_R_ECME_LINEA_0_CM 0. 65535. FORMAT "%5.0" /end CHARACTERISTIC
/begin CHARACTERISTIC Cxx_dfdec_mis_2_cata "Cylinder 2 Misfire Detected Destructive Catalyst detected failure counter decrement" VALUE 0xa0020bae _REC_S1VAL_20_u2 65535. _CNV_A_R_ECME_LINEA_0_CM 0. 65535. FORMAT "%5.0" /end CHARACTERISTIC
/begin CHARACTERISTIC Cxx_dfdec_mis_2_lpg_cata "Cylinder 2 Misfire LPG Detected Destructive Catalyst detected failure counter decrement" VALUE 0xa0020bb0 _REC_S1VAL_20_u2 65535. _CNV_A_R_ECME_LINEA_0_CM 0. 65535. FORMAT "%5.0" /end CHARACTERISTIC
/begin CHARACTERISTIC Cxx_dfdec_mis_2_lpg_trs_h "Cylinder 2 Misfire LPG Detected Pollution detected failure counter decrement" VALUE 0xa0020bb2 _REC_S1VAL_20_u2 65535. _CNV_A_R_ECME_LINEA_0_CM 0. 65535. FORMAT "%5.0" /end CHARACTERISTIC
/begin CHARACTERISTIC Cxx_dfdec_mis_2_trs_h "Cylinder 2 Misfire Detected Pollution detected failure counter decrement" VALUE 0xa0020bb4 _REC_S1VAL_20_u2 65535. _CNV_A_R_ECME_LINEA_0_CM 0. 65535. FORMAT "%5.0" /end CHARACTERISTIC
/begin CHARACTERISTIC Cxx_dfdec_mis_3_cata "Cylinder 3 Misfire Detected Destructive Catalyst detected failure counter decrement" VALUE 0xa0020bb6 _REC_S1VAL_20_u2 65535. _CNV_A_R_ECME_LINEA_0_CM 0. 65535. FORMAT "%5.0" /end CHARACTERISTIC
/begin CHARACTERISTIC Cxx_dfdec_mis_3_lpg_cata "Cylinder 3 Misfire LPG Detected Destructive Catalyst detected failure counter decrement" VALUE 0xa0020bb8 _REC_S1VAL_20_u2 65535. _CNV_A_R_ECME_LINEA_0_CM 0. 65535. FORMAT "%5.0" /end CHARACTERISTIC
/begin CHARACTERISTIC Cxx_dfdec_mis_3_lpg_trs_h "Cylinder 3 Misfire LPG Detected Pollution detected failure counter decrement" VALUE 0xa0020bba _REC_S1VAL_20_u2 65535. _CNV_A_R_ECME_LINEA_0_CM 0. 65535. FORMAT "%5.0" /end CHARACTERISTIC
/begin CHARACTERISTIC Cxx_dfdec_mis_3_trs_h "Cylinder 3 Misfire Detected Pollution detected failure counter decrement" VALUE 0xa0020bbc _REC_S1VAL_20_u2 65535. _CNV_A_R_ECME_LINEA_0_CM 0. 65535. FORMAT "%5.0" /end CHARACTERISTIC
/begin CHARACTERISTIC Cxx_dfdec_mis_4_cata "Cylinder 4 Misfire Detected Destructive Catalyst detected failure counter decrement" VALUE 0xa0020bbe _REC_S1VAL_20_u2 65535. _CNV_A_R_ECME_LINEA_0_CM 0. 65535. FORMAT "%5.0" /end CHARACTERISTIC
/begin CHARACTERISTIC Cxx_dfdec_mis_4_lpg_cata "Cylinder 4 Misfire LPG Detected Destructive Catalyst detected failure counter decrement" VALUE 0xa0020bc0 _REC_S1VAL_20_u2 65535. _CNV_A_R_ECME_LINEA_0_CM 0. 65535. FORMAT "%5.0" /end CHARACTERISTIC
/begin CHARACTERISTIC Cxx_dfdec_mis_4_lpg_trs_h "Cylinder 4 Misfire LPG Detected Pollution detected failure counter decrement" VALUE 0xa0020bc2 _REC_S1VAL_20_u2 65535. _CNV_A_R_ECME_LINEA_0_CM 0. 65535. FORMAT "%5.0" /end CHARACTERISTIC
/begin CHARACTERISTIC Cxx_dfdec_mis_4_trs_h "Cylinder 4 Misfire Detected Pollution detected failure counter decrement" VALUE 0xa0020bc4 _REC_S1VAL_20_u2 65535. _CNV_A_R_ECME_LINEA_0_CM 0. 65535. FORMAT "%5.0" /end CHARACTERISTIC
/begin CHARACTERISTIC Cxx_dfdec_mis_cata "Misfire Detected Destructive Catalyst detected failure counter decrement" VALUE 0xa0020bc6 _REC_S1VAL_20_u2 65535. _CNV_A_R_ECME_LINEA_0_CM 0. 65535. FORMAT "%5.0" /end CHARACTERISTIC
/begin CHARACTERISTIC Cxx_dfdec_mis_lpg_cata "Misfire LPG Detected Destructive Catalyst detected failure counter decrement" VALUE 0xa0020bc8 _REC_S1VAL_20_u2 65535. _CNV_A_R_ECME_LINEA_0_CM 0. 65535. FORMAT "%5.0" /end CHARACTERISTIC
/begin CHARACTERISTIC Cxx_dfdec_mis_lpg_trs_h "Misfire LPG Detected Pollution detected failure counter decrement" VALUE 0xa0020bca _REC_S1VAL_20_u2 65535. _CNV_A_R_ECME_LINEA_0_CM 0. 65535. FORMAT "%5.0" /end CHARACTERISTIC
/begin CHARACTERISTIC Cxx_dfdec_mis_min_fuel_cata "Misfire Detected with Low Fuel Destructive Catalyst detected failure counter decrement" VALUE 0xa0020bcc _REC_S1VAL_20_u2 65535. _CNV_A_R_ECME_LINEA_0_CM 0. 65535. FORMAT "%5.0" /end CHARACTERISTIC
/begin CHARACTERISTIC Cxx_dfdec_mis_min_fuel_trs_h "Misfire Detected with Low Fuel Pollution detected failure counter decrement" VALUE 0xa0020bce _REC_S1VAL_20_u2 65535. _CNV_A_R_ECME_LINEA_0_CM 0. 65535. FORMAT "%5.0" /end CHARACTERISTIC
/begin CHARACTERISTIC Cxx_dfdec_mis_trs_h "Misfire Detected Pollution detected failure counter decrement" VALUE 0xa0020bd0 _REC_S1VAL_20_u2 65535. _CNV_A_R_ECME_LINEA_0_CM 0. 65535. FORMAT "%5.0" /end CHARACTERISTIC
/begin CHARACTERISTIC Cxx_dfdec_mis_unk_cata "Unknown Cylinder Misfire Detected Destructive Catalyst detected failure counter decrement" VALUE 0xa0020bd2 _REC_S1VAL_20_u2 65535. _CNV_A_R_ECME_LINEA_0_CM 0. 65535. FORMAT "%5.0" /end CHARACTERISTIC
/begin CHARACTERISTIC Cxx_dfdec_mis_unk_lpg_cata "Unknown Cylinder Misfire LPG Detected Destructive Catalyst detected failure counter decrement" VALUE 0xa0020bd4 _REC_S1VAL_20_u2 65535. _CNV_A_R_ECME_LINEA_0_CM 0. 65535. FORMAT "%5.0" /end CHARACTERISTIC
/begin CHARACTERISTIC Cxx_dfdec_mis_unk_lpg_trs_h "Unknown Cylinder Misfire LPG Detected Pollution detected failure counter decrement" VALUE 0xa0020bd6 _REC_S1VAL_20_u2 65535. _CNV_A_R_ECME_LINEA_0_CM 0. 65535. FORMAT "%5.0" /end CHARACTERISTIC
/begin CHARACTERISTIC Cxx_dfdec_mis_unk_trs_h "Unknown Cylinder Misfire Detected Pollution detected failure counter decrement" VALUE 0xa0020bd8 _REC_S1VAL_20_u2 65535. _CNV_A_R_ECME_LINEA_0_CM 0. 65535. FORMAT "%5.0" /end CHARACTERISTIC
/begin CHARACTERISTIC Cxx_dfinc_mis_1_cata "Cylinder 1 Misfire Detected Destructive Catalyst detected failure counter increment" VALUE 0xa0020bda _REC_S1VAL_20_u2 65535. _CNV_A_R_ECME_LINEA_0_CM 0. 65535. FORMAT "%5.0" /end CHARACTERISTIC
/begin CHARACTERISTIC Cxx_dfinc_mis_1_lpg_cata "Cylinder 1 Misfire LPG Detected Destructive Catalyst detected failure counter increment" VALUE 0xa0020bdc _REC_S1VAL_20_u2 65535. _CNV_A_R_ECME_LINEA_0_CM 0. 65535. FORMAT "%5.0" /end CHARACTERISTIC
/begin CHARACTERISTIC Cxx_dfinc_mis_1_lpg_trs_h "Cylinder 1 Misfire LPG Detected Pollution detected failure counter increment" VALUE 0xa0020bde _REC_S1VAL_20_u2 65535. _CNV_A_R_ECME_LINEA_0_CM 0. 65535. FORMAT "%5.0" /end CHARACTERISTIC
/begin CHARACTERISTIC Cxx_dfinc_mis_1_trs_h "Cylinder 1 Misfire Detected Pollution detected failure counter increment" VALUE 0xa0020be0 _REC_S1VAL_20_u2 65535. _CNV_A_R_ECME_LINEA_0_CM 0. 65535. FORMAT "%5.0" /end CHARACTERISTIC
/begin CHARACTERISTIC Cxx_dfinc_mis_2_cata "Cylinder 2 Misfire Detected Destructive Catalyst detected failure counter increment" VALUE 0xa0020be2 _REC_S1VAL_20_u2 65535. _CNV_A_R_ECME_LINEA_0_CM 0. 65535. FORMAT "%5.0" /end CHARACTERISTIC
/begin CHARACTERISTIC Cxx_dfinc_mis_2_lpg_cata "Cylinder 2 Misfire LPG Detected Destructive Catalyst detected failure counter increment" VALUE 0xa0020be4 _REC_S1VAL_20_u2 65535. _CNV_A_R_ECME_LINEA_0_CM 0. 65535. FORMAT "%5.0" /end CHARACTERISTIC
/begin CHARACTERISTIC Cxx_dfinc_mis_2_lpg_trs_h "Cylinder 2 Misfire LPG Detected Pollution detected failure counter increment" VALUE 0xa0020be6 _REC_S1VAL_20_u2 65535. _CNV_A_R_ECME_LINEA_0_CM 0. 65535. FORMAT "%5.0" /end CHARACTERISTIC
/begin CHARACTERISTIC Cxx_dfinc_mis_2_trs_h "Cylinder 2 Misfire Detected Pollution detected failure counter increment" VALUE 0xa0020be8 _REC_S1VAL_20_u2 65535. _CNV_A_R_ECME_LINEA_0_CM 0. 65535. FORMAT "%5.0" /end CHARACTERISTIC
/begin CHARACTERISTIC Cxx_dfinc_mis_3_cata "Cylinder 3 Misfire Detected Destructive Catalyst detected failure counter increment" VALUE 0xa0020bea _REC_S1VAL_20_u2 65535. _CNV_A_R_ECME_LINEA_0_CM 0. 65535. FORMAT "%5.0" /end CHARACTERISTIC
/begin CHARACTERISTIC Cxx_dfinc_mis_3_lpg_cata "Cylinder 3 Misfire LPG Detected Destructive Catalyst detected failure counter increment" VALUE 0xa0020bec _REC_S1VAL_20_u2 65535. _CNV_A_R_ECME_LINEA_0_CM 0. 65535. FORMAT "%5.0" /end CHARACTERISTIC
/begin CHARACTERISTIC Cxx_dfinc_mis_3_lpg_trs_h "Cylinder 3 Misfire LPG Detected Pollution detected failure counter increment" VALUE 0xa0020bee _REC_S1VAL_20_u2 65535. _CNV_A_R_ECME_LINEA_0_CM 0. 65535. FORMAT "%5.0" /end CHARACTERISTIC
/begin CHARACTERISTIC Cxx_dfinc_mis_3_trs_h "Cylinder 3 Misfire Detected Pollution detected failure counter increment" VALUE 0xa0020bf0 _REC_S1VAL_20_u2 65535. _CNV_A_R_ECME_LINEA_0_CM 0. 65535. FORMAT "%5.0" /end CHARACTERISTIC
/begin CHARACTERISTIC Cxx_dfinc_mis_4_cata "Cylinder 4 Misfire Detected Destructive Catalyst detected failure counter increment" VALUE 0xa0020bf2 _REC_S1VAL_20_u2 65535. _CNV_A_R_ECME_LINEA_0_CM 0. 65535. FORMAT "%5.0" /end CHARACTERISTIC
/begin CHARACTERISTIC Cxx_dfinc_mis_4_lpg_cata "Cylinder 4 Misfire LPG Detected Destructive Catalyst detected failure counter increment" VALUE 0xa0020bf4 _REC_S1VAL_20_u2 65535. _CNV_A_R_ECME_LINEA_0_CM 0. 65535. FORMAT "%5.0" /end CHARACTERISTIC
/begin CHARACTERISTIC Cxx_dfinc_mis_4_lpg_trs_h "Cylinder 4 Misfire LPG Detected Pollution detected failure counter increment" VALUE 0xa0020bf6 _REC_S1VAL_20_u2 65535. _CNV_A_R_ECME_LINEA_0_CM 0. 65535. FORMAT "%5.0" /end CHARACTERISTIC
/begin CHARACTERISTIC Cxx_dfinc_mis_4_trs_h "Cylinder 4 Misfire Detected Pollution detected failure counter increment" VALUE 0xa0020bf8 _REC_S1VAL_20_u2 65535. _CNV_A_R_ECME_LINEA_0_CM 0. 65535. FORMAT "%5.0" /end CHARACTERISTIC
/begin CHARACTERISTIC Cxx_dfinc_mis_cata "Misfire Detected Destructive Catalyst detected failure counter increment" VALUE 0xa0020bfa _REC_S1VAL_20_u2 65535. _CNV_A_R_ECME_LINEA_0_CM 0. 65535. FORMAT "%5.0" /end CHARACTERISTIC
/begin CHARACTERISTIC Cxx_dfinc_mis_lpg_cata "Misfire LPG Detected Destructive Catalyst detected failure counter increment" VALUE 0xa0020bfc _REC_S1VAL_20_u2 65535. _CNV_A_R_ECME_LINEA_0_CM 0. 65535. FORMAT "%5.0" /end CHARACTERISTIC
/begin CHARACTERISTIC Cxx_dfinc_mis_lpg_trs_h "Misfire LPG Detected Pollution detected failure counter increment" VALUE 0xa0020bfe _REC_S1VAL_20_u2 65535. _CNV_A_R_ECME_LINEA_0_CM 0. 65535. FORMAT "%5.0" /end CHARACTERISTIC
/begin CHARACTERISTIC Cxx_dfinc_mis_min_fuel_cata "Misfire Detected with Low Fuel Destructive Catalyst detected failure counter increment" VALUE 0xa0020c00 _REC_S1VAL_20_u2 65535. _CNV_A_R_ECME_LINEA_0_CM 0. 65535. FORMAT "%5.0" /end CHARACTERISTIC
/begin CHARACTERISTIC Cxx_dfinc_mis_min_fuel_trs_h "Misfire Detected with Low Fuel Pollution detected failure counter increment" VALUE 0xa0020c02 _REC_S1VAL_20_u2 65535. _CNV_A_R_ECME_LINEA_0_CM 0. 65535. FORMAT "%5.0" /end CHARACTERISTIC
/begin CHARACTERISTIC Cxx_dfinc_mis_trs_h "Misfire Detected Pollution detected failure counter increment" VALUE 0xa0020c04 _REC_S1VAL_20_u2 65535. _CNV_A_R_ECME_LINEA_0_CM 0. 65535. FORMAT "%5.0" /end CHARACTERISTIC
/begin CHARACTERISTIC Cxx_dfinc_mis_unk_cata "Unknown Cylinder Misfire Detected Destructive Catalyst detected failure counter increment" VALUE 0xa0020c06 _REC_S1VAL_20_u2 65535. _CNV_A_R_ECME_LINEA_0_CM 0. 65535. FORMAT "%5.0" /end CHARACTERISTIC
/begin CHARACTERISTIC Cxx_dfinc_mis_unk_lpg_cata "Unknown Cylinder Misfire LPG Detected Destructive Catalyst detected failure counter increment" VALUE 0xa0020c08 _REC_S1VAL_20_u2 65535. _CNV_A_R_ECME_LINEA_0_CM 0. 65535. FORMAT "%5.0" /end CHARACTERISTIC
/begin CHARACTERISTIC Cxx_dfinc_mis_unk_lpg_trs_h "Unknown Cylinder Misfire LPG Detected Pollution detected failure counter increment" VALUE 0xa0020c0a _REC_S1VAL_20_u2 65535. _CNV_A_R_ECME_LINEA_0_CM 0. 65535. FORMAT "%5.0" /end CHARACTERISTIC
/begin CHARACTERISTIC Cxx_dfinc_mis_unk_trs_h "Unknown Cylinder Misfire Detected Pollution detected failure counter increment" VALUE 0xa0020c0c _REC_S1VAL_20_u2 65535. _CNV_A_R_ECME_LINEA_0_CM 0. 65535. FORMAT "%5.0" /end CHARACTERISTIC
/begin CHARACTERISTIC Cxx_min_diag_mis_dly "Delay Inhibition Misfire Diagnostic" VALUE 0xa0020c0e _REC_S1VAL_20_u2 32767.5 _CNV_A_R_LINEAR_____344_CM 0. 32767.5 FORMAT "%3.1" /end CHARACTERISTIC
/begin CHARACTERISTIC Cxx_mis_cata_win_mis_nr "Nombre de misfire dans fenetre misfire cata" VALUE 0xa0020c10 _REC_S1VAL_20_u2 65535. _CNV_A_R_ECME_LINEA_0_CM 0. 65535. FORMAT "%5.0" /end CHARACTERISTIC
/begin CHARACTERISTIC Cxx_mis_cata_win_mis_nr_1 "Nombre de misfire dans fenetre misfire cata au Gaz" VALUE 0xa0020c12 _REC_S1VAL_20_u2 65535. _CNV_A_R_ECME_LINEA_0_CM 0. 65535. FORMAT "%5.0" /end CHARACTERISTIC
/begin CHARACTERISTIC Cxx_mis_cata_win_tdc_nr "Nombre de pmh dans fenetre misfire cata" VALUE 0xa0020c14 _REC_S1VAL_20_u2 65535. _CNV_A_R_LINEAR_____55_CM 0. 65535. FORMAT "%5.0" /end CHARACTERISTIC
/begin CHARACTERISTIC Cxx_mis_cyl_fail_rat "Rate of misfires on one cylinder to declare cylinder faillure" VALUE 0xa0020c27 _REC_S1VAL_20_u1 0.99609375 _CNV_A_R_LINEAR_____31_CM 0. 0.99609375 FORMAT "%5.3" /end CHARACTERISTIC
/begin CHARACTERISTIC Cxx_mis_diag_obd_dsb_t "Temps maintien inhibition des diags obd par le misfire" VALUE 0xa0020c28 _REC_S1VAL_20_u1 2.55 _CNV_A_R_LINEAR_____34_CM 0. 2.55 FORMAT "%4.2" /end CHARACTERISTIC
/begin CHARACTERISTIC Cxx_mis_ena_n_max_thd "Seuil maximum de rÈgime pour autoriser le diag misfire" VALUE 0xa0020c16 _REC_S1VAL_20_u2 16383.75 _CNV_A_R_ENSD_LINEA_24_CM 0. 16383.75 FORMAT "%8.2" /end CHARACTERISTIC
/begin CHARACTERISTIC Cxx_mis_ena_n_min_thd "Seuil minimum de rÈgime pour autoriser le diag misfire" VALUE 0xa0020c18 _REC_S1VAL_20_u2 16383.75 _CNV_A_R_ENSD_LINEA_24_CM 0. 16383.75 FORMAT "%8.2" /end CHARACTERISTIC
/begin CHARACTERISTIC Cxx_mis_ena_tco_min_thd "Seuil minimum de tempÈrature d'eau pour autoriser le diag misfire" VALUE 0xa0020c1a _REC_S1VAL_20_u2 240. _CNV_A_R_LINEAR_____54_CM -40. 200. FORMAT "%5.1" /end CHARACTERISTIC
/begin CHARACTERISTIC Cxx_mis_fast_win_mis_nr "Nombre de misfire dans fenetre glissante misfire" VALUE 0xa0020c29 _REC_S1VAL_20_u1 255. _CNV_A_R_ECME_LINEA_0_CM 0. 255. FORMAT "%3.0" /end CHARACTERISTIC
/begin CHARACTERISTIC Cxx_mis_fast_win_tdc_nr "Nombre de pmh dans fenetre glissante misfire" VALUE 0xa0020c2a _REC_S1VAL_20_u1 255. _CNV_A_R_LINEAR_____55_CM 0. 255. FORMAT "%3.0" /end CHARACTERISTIC
/begin CHARACTERISTIC Cxx_mis_n_max_agb_clos_no "Maximum engine speed to enable misfire detection on AGB not closed" VALUE 0xa0020c1c _REC_S1VAL_20_u2 16383.75 _CNV_A_R_ENSD_LINEA_24_CM 0. 16383.75 FORMAT "%8.2" /end CHARACTERISTIC
/begin CHARACTERISTIC Cxx_mis_ofs_eal_agb_ena "offet sur la charge pourautorisation diag misfire si bva en drive" VALUE 0xa0020c1e _REC_S1VAL_20_u2 1.99996948242188 _CNV_A_R_LINEAR_____49_CM 0. 1.99996948242188 FORMAT "%7.5" /end CHARACTERISTIC
/begin CHARACTERISTIC Cxx_mis_polu_win_mis_nr "Nombre de pmh mini pour diag misfire pollu" VALUE 0xa0020c20 _REC_S1VAL_20_u2 65535. _CNV_A_R_LINEAR_____55_CM 0. 65535. FORMAT "%5.0" /end CHARACTERISTIC
/begin CHARACTERISTIC Cxx_mis_polu_win_mis_nr_1 "Nombre de pmh mini pour diag misfire pollu au Gaz" VALUE 0xa0020c22 _REC_S1VAL_20_u2 65535. _CNV_A_R_LINEAR_____55_CM 0. 65535. FORMAT "%5.0" /end CHARACTERISTIC
/begin CHARACTERISTIC Cxx_mis_polu_win_nr_fail "Nombre minimum de fenÍtres misfire pollu ‡ prendre en compte pour dÈclaration panne" VALUE 0xa0020c2b _REC_S1VAL_20_u1 255. _CNV_A_R_ECME_LINEA_0_CM 0. 255. FORMAT "%3.0" /end CHARACTERISTIC
/begin CHARACTERISTIC Cxx_mis_polu_win_tdc_nr "Nombre de pmh dans fenetre misfire cata" VALUE 0xa0020c24 _REC_S1VAL_20_u2 65535. _CNV_A_R_LINEAR_____55_CM 0. 65535. FORMAT "%5.0" /end CHARACTERISTIC
/begin CHARACTERISTIC Cxx_mis_rat_min_cyl_ "Taux mini de misfire pour dÈclaration misfire sur cylindre considÈrÈ" VALUE 0xa0020c2c _REC_S1VAL_20_u1 255. _CNV_A_R_ECME_LINEA_0_CM 0. 255. FORMAT "%3.0" /end CHARACTERISTIC
/begin CHARACTERISTIC Cxx_mis_stab_tdc_nr "Nombre de pmh pour stabilisation avant diag misfire" VALUE 0xa0020c2d _REC_S1VAL_20_u1 255. _CNV_A_R_LINEAR_____55_CM 0. 255. FORMAT "%3.0" /end CHARACTERISTIC
/begin AXIS_PTS Ntb_gear "Gearbox ratio breakpoint" 0xa002ac48 Vxx_gear _REC_A2AXS_20_u1 7. _CNV_A_R_LINEAR_____113_CM 8 -1. 6. READ_ONLY FORMAT "%2.0" /end AXIS_PTS
/begin AXIS_PTS Ctb_toil "engine oil temperature breakpoints" 0xa002a6d8 Vxx_toil _REC_A2AXS_20_u2 240. _CNV_A_R_LINEAR_____54_CM 16 -40. 200. FORMAT "%5.1" /end AXIS_PTS
/begin AXIS_PTS Ctb_dft_comb_eal "Table of engine air load breakpoins for misfire cartographies." 0xa0027448 Vxx_eal_tdc_2 _REC_A2AXS_20_u2 3.99993896484375 _CNV_A_R_LINEAR_____53_CM 17 0. 3.99993896484375 FORMAT "%7.5" /end AXIS_PTS
/begin AXIS_PTS Ctb_mis_n_17 "Table de 17 breakpoints de rÈgimes pour la stratÈgie misfire" 0xa002746c Vxx_n_tdc_2 _REC_A2AXS_20_u2 16383.75 _CNV_A_R_ENSD_LINEA_24_CM 17 0. 16383.75 FORMAT "%8.2" /end AXIS_PTS
/begin COMPU_METHOD _CNV_A_R_ECME_LINEA_0_CM "" RAT_FUNC "%6.3" "-" COEFFS 0 1. 0. 0 0 1 /end COMPU_METHOD
/begin COMPU_METHOD _CNV_A_R_LINEAR_____2_CM "" RAT_FUNC "%6.3" "rpm" COEFFS 0 3.125e-002 0. 0 0 1 /end COMPU_METHOD
/begin COMPU_METHOD _CNV_S_2_RANGE______3_CM "" TAB_VERB "%6.3" "-" COMPU_TAB_REF _CNV_S_2_RANGE______3 /end COMPU_METHOD
/begin COMPU_VTAB _CNV_S_2_RANGE______3 "" TAB_VERB 2 0 "0" 1 "1" /end COMPU_VTAB
/begin COMPU_METHOD _CNV_A_R_LINEAR_____4_CM "" RAT_FUNC "%6.3" "s" COEFFS 0 10. 0. 0 0 1 /end COMPU_METHOD
/begin COMPU_METHOD _CNV_A_R_LINEAR_____9_CM "" RAT_FUNC "%6.3" "-" COEFFS 0 65535.99999999996 0. 0 0 1 /end COMPU_METHOD
/begin COMPU_METHOD _CNV_A_R_LINEAR_____23_CM "" RAT_FUNC "%6.3" "rpm/s" COEFFS 0 1. 0. 0 0 1 /end COMPU_METHOD
/begin COMPU_METHOD _CNV_A_R_ENSD_LINEA_24_CM "" RAT_FUNC "%6.3" "rpm" COEFFS 0 4. 0. 0 0 1 /end COMPU_METHOD
/begin COMPU_METHOD _CNV_A_R_LINEAR_____31_CM "" RAT_FUNC "%6.3" "-" COEFFS 0 256. 0. 0 0 1 /end COMPU_METHOD
/begin COMPU_METHOD _CNV_A_R_LINEAR_____34_CM "" RAT_FUNC "%6.3" "s" COEFFS 0 100. 0. 0 0 1 /end COMPU_METHOD
/begin COMPU_METHOD _CNV_A_R_LINEAR_____43_CM "" RAT_FUNC "%6.3" "-" COEFFS 0 128. 0. 0 0 1 /end COMPU_METHOD
/begin COMPU_METHOD _CNV_A_R_LINEAR_____49_CM "" RAT_FUNC "%6.3" "-" COEFFS 0 32767.99999999992 0. 0 0 1 /end COMPU_METHOD
/begin COMPU_METHOD _CNV_A_R_LINEAR_____50_CM "" RAT_FUNC "%6.3" "µs" COEFFS 0 0.25 0. 0 0 1 /end COMPU_METHOD
/begin COMPU_METHOD _CNV_A_R_LINEAR_____52_CM "" RAT_FUNC "%6.3" "mV" COEFFS 0 1. 0. 0 0 1 /end COMPU_METHOD
/begin COMPU_METHOD _CNV_A_R_LINEAR_____53_CM "" RAT_FUNC "%6.3" "-" COEFFS 0 16384. 0. 0 0 1 /end COMPU_METHOD
/begin COMPU_METHOD _CNV_A_R_LINEAR_____54_CM "" RAT_FUNC "%6.3" "∞C" COEFFS 0 10. 400. 0 0 1 /end COMPU_METHOD
/begin COMPU_METHOD _CNV_A_R_LINEAR_____55_CM "" RAT_FUNC "%6.3" "TDC" COEFFS 0 1. 0. 0 0 1 /end COMPU_METHOD
/begin COMPU_METHOD _CNV_A_R_LINEAR_____57_CM "" RAT_FUNC "%6.3" "hPa" COEFFS 0 1. 0. 0 0 1 /end COMPU_METHOD
/begin COMPU_METHOD _CNV_A_R_LINEAR_____58_CM "" RAT_FUNC "%6.3" "s" COEFFS 0 1000. 0. 0 0 1 /end COMPU_METHOD
/begin COMPU_METHOD _CNV_A_R_LINEAR_____70_CM "" RAT_FUNC "%6.3" "km/h" COEFFS 0 100. 0. 0 0 1 /end COMPU_METHOD
/begin COMPU_METHOD _CNV_A_R_LINEAR_____76_CM "" RAT_FUNC "%6.3" "∞CRK" COEFFS 0 50. 0. 0 0 1 /end COMPU_METHOD
/begin COMPU_METHOD _CNV_A_R_LINEAR_____83_CM "" RAT_FUNC "%6.3" "mg/stk" COEFFS 0 390.625 0. 0 0 1 /end COMPU_METHOD
/begin COMPU_METHOD _CNV_A_R_LINEAR_____108_CM "" RAT_FUNC "%6.3" "-" COEFFS 0 1000. 0. 0 0 1 /end COMPU_METHOD
/begin COMPU_METHOD _CNV_A_R_LINEAR_____113_CM "" RAT_FUNC "%6.3" "-" COEFFS 0 1. 1. 0 0 1 /end COMPU_METHOD
/begin COMPU_METHOD _CNV_A_R_LINEAR_____114_CM "" RAT_FUNC "%6.3" "%" COEFFS 0 2.55 0. 0 0 1 /end COMPU_METHOD
/begin COMPU_METHOD _CNV_S_3_STATUS_OK__120_CM "" TAB_VERB "%6.3" "-" COMPU_TAB_REF _CNV_S_3_STATUS_OK__120 /end COMPU_METHOD
/begin COMPU_VTAB _CNV_S_3_STATUS_OK__120 "" TAB_VERB 3 0 "Nsx_vld_nok_0" 1 "Nsx_vld_ok_1" 2 "Nsx_vld_fail_2" /end COMPU_VTAB
/begin COMPU_METHOD _CNV_A_R_LINEAR_____124_CM "" RAT_FUNC "%6.3" "rpm" COEFFS 0 4. 32768. 0 0 1 /end COMPU_METHOD
/begin COMPU_METHOD _CNV_A_R_LINEAR_____125_CM "" RAT_FUNC "%6.3" "-" COEFFS 0 1024. 0. 0 0 1 /end COMPU_METHOD
/begin COMPU_METHOD _CNV_A_R_LINEAR_____136_CM "" RAT_FUNC "%6.3" "-" COEFFS 0 100. 0. 0 0 1 /end COMPU_METHOD
/begin COMPU_METHOD _CNV_A_R_LINEAR_____140_CM "" RAT_FUNC "%6.3" "(km/h)/K*rpm" COEFFS 0 100. 1000. 0 0 1 /end COMPU_METHOD
/begin COMPU_METHOD _CNV_A_R_LINEAR_____145_CM "" RAT_FUNC "%6.3" "µs" COEFFS 0 1. 0. 0 0 1 /end COMPU_METHOD
/begin COMPU_METHOD _CNV_S_3_STATUS_OK__158_CM "" TAB_VERB "%6.3" "" COMPU_TAB_REF _CNV_S_3_STATUS_OK__158 /end COMPU_METHOD
/begin COMPU_VTAB _CNV_S_3_STATUS_OK__158 "" TAB_VERB 3 0 "Nsx_vld_nok_0" 1 "Nsx_vld_ok_1" 2 "Nsx_vld_fail_2" /end COMPU_VTAB
/begin COMPU_METHOD _CNV_A_R_LINEAR_____161_CM "" RAT_FUNC "%6.3" "Nm" COEFFS 0 32. 12800. 0 0 1 /end COMPU_METHOD
/begin COMPU_METHOD _CNV_A_R_LINEAR_____175_CM "" RAT_FUNC "%6.3" "-" COEFFS 0 64. 0. 0 0 1 /end COMPU_METHOD
/begin COMPU_METHOD _CNV_S_8_STATUS_OK__181_CM "" TAB_VERB "%6.3" "-" COMPU_TAB_REF _CNV_S_8_STATUS_OK__181 /end COMPU_METHOD
/begin COMPU_VTAB _CNV_S_8_STATUS_OK__181 "" TAB_VERB 8 0 "Nsx_vld_nok_0" 1 "Nsx_vld_ok_1" 2 "Nsx_vld_fail_2" 3 "Nsx_vld_fail_3" 4 "Nsx_vld_fail_4" 5 "Nsx_vld_fail_5" 6 "Nsx_vld_fail_6" 7 "Nsx_vld_fail_7" /end COMPU_VTAB
/begin COMPU_METHOD _CNV_A_R_LINEAR_____212_CM "" RAT_FUNC "%6.3" "km/h" COEFFS 0 1. 0. 0 0 1 /end COMPU_METHOD
/begin COMPU_METHOD _CNV_A_R_LINEAR_____264_CM "" RAT_FUNC "%6.3" "∞CRK" COEFFS 0 0.3333333333333333 0. 0 0 1 /end COMPU_METHOD
/begin COMPU_METHOD _CNV_A_R_LINEAR_____303_CM "" RAT_FUNC "%6.3" "s" COEFFS 0 312500. 0. 0 0 1 /end COMPU_METHOD
/begin COMPU_METHOD _CNV_A_R_LINEAR_____305_CM "" RAT_FUNC "%6.3" "ns" COEFFS 0 1.e-002 0. 0 0 1 /end COMPU_METHOD
/begin COMPU_METHOD _CNV_A_R_LINEAR_____306_CM "" RAT_FUNC "%6.3" "bar" COEFFS 0 10. 0. 0 0 1 /end COMPU_METHOD
/begin COMPU_METHOD _CNV_A_R_LINEAR_____330_CM "" RAT_FUNC "%6.3" "rpm/s" COEFFS 0 -1. 0. 0 0 1 /end COMPU_METHOD
/begin COMPU_METHOD _CNV_A_R_LINEAR_____331_CM "" RAT_FUNC "%6.3" "(km/h)/K*rpm" COEFFS 0 100. 0. 0 0 1 /end COMPU_METHOD
/begin COMPU_METHOD _CNV_A_R_LINEAR_____332_CM "" RAT_FUNC "%6.3" "1/V" COEFFS 0 255. 0. 0 0 1 /end COMPU_METHOD
/begin COMPU_METHOD _CNV_A_R_LINEAR_____333_CM "" RAT_FUNC "%6.3" "Nm/s" COEFFS 0 50. 32500. 0 0 1 /end COMPU_METHOD
/begin COMPU_METHOD _CNV_A_R_LINEAR_____334_CM "" RAT_FUNC "%6.3" "kg*m≤" COEFFS 0 100. 0. 0 0 1 /end COMPU_METHOD
/begin COMPU_METHOD _CNV_S_4_RANGE_ROUT_335_CM "" TAB_VERB "%6.3" "-" COMPU_TAB_REF _CNV_S_4_RANGE_ROUT_335 /end COMPU_METHOD
/begin COMPU_VTAB _CNV_S_4_RANGE_ROUT_335 "" TAB_VERB 4 0 "Nsx_diag_sta_disa_stt" 1 "Nsx_diag_sta_run_stt" 2 "Nsx_diag_sta_end_stt" 3 "Nsx_diag_sta_abrt_stt" /end COMPU_VTAB
/begin COMPU_METHOD _CNV_A_R_LINEAR_____336_CM "" RAT_FUNC "%6.3" "µs/mg" COEFFS 0 65.536 -1. 0 0 1 /end COMPU_METHOD
/begin COMPU_METHOD _CNV_A_R_LINEAR_____337_CM "" RAT_FUNC "%6.3" "µs" COEFFS 0 2.5e-004 0. 0 0 1 /end COMPU_METHOD
/begin COMPU_METHOD _CNV_A_R_LINEAR_____338_CM "" RAT_FUNC "%6.3" "µs/mg" COEFFS 0 65.53499998474098 1.525902189669637e-005 0 0 1 /end COMPU_METHOD
/begin COMPU_METHOD _CNV_A_R_LINEAR_____339_CM "" RAT_FUNC "%6.3" "l/h" COEFFS 0 100. 0. 0 0 1 /end COMPU_METHOD
/begin COMPU_METHOD _CNV_A_R_LINEAR_____340_CM "" RAT_FUNC "%6.3" "mm≥" COEFFS 0 1.25e-002 0. 0 0 1 /end COMPU_METHOD
/begin COMPU_METHOD _CNV_A_R_LINEAR_____341_CM "" RAT_FUNC "%6.3" "mg/stk" COEFFS 0 25000. 0. 0 0 1 /end COMPU_METHOD
/begin COMPU_METHOD _CNV_A_R_LINEAR_____342_CM "" RAT_FUNC "%6.3" "dm3/kg" COEFFS 0 512. -512. 0 0 1 /end COMPU_METHOD
/begin COMPU_METHOD _CNV_A_R_LINEAR_____343_CM "" RAT_FUNC "%6.3" "-" COEFFS 0 16384. 32768. 0 0 1 /end COMPU_METHOD
/begin COMPU_METHOD _CNV_A_R_LINEAR_____344_CM "" RAT_FUNC "%6.3" "s" COEFFS 0 2. 0. 0 0 1 /end COMPU_METHOD
/begin COMPU_METHOD _CNV_A_R_LINEAR_____345_CM "" RAT_FUNC "%6.3" "-" COEFFS 0 2.55 0. 0 0 1 /end COMPU_METHOD
/begin COMPU_METHOD _CNV_A_R_LINEAR_____346_CM "" RAT_FUNC "%6.3" "Nm" COEFFS 0 255. 0. 0 0 1 /end COMPU_METHOD
/begin RECORD_LAYOUT _REC_S1VAL_20_u4 FNC_VALUES 1 ULONG COLUMN_DIR DIRECT /end RECORD_LAYOUT
/begin RECORD_LAYOUT _REC_S1VAL_20_u1 FNC_VALUES 1 UBYTE COLUMN_DIR DIRECT /end RECORD_LAYOUT
/begin RECORD_LAYOUT _REC_A2AXS_20_u1 NO_AXIS_PTS_X 1 UBYTE AXIS_PTS_X 2 UBYTE INDEX_INCR DIRECT /end RECORD_LAYOUT
/begin RECORD_LAYOUT _REC_S1VAL_20_u2 FNC_VALUES 1 UWORD COLUMN_DIR DIRECT /end RECORD_LAYOUT
/begin RECORD_LAYOUT _REC_S1VAL_20_s2 FNC_VALUES 1 SWORD COLUMN_DIR DIRECT /end RECORD_LAYOUT
/begin RECORD_LAYOUT _REC_A2AXS_20_u2 NO_AXIS_PTS_X 1 UWORD AXIS_PTS_X 2 UWORD INDEX_INCR DIRECT /end RECORD_LAYOUT
/begin RECORD_LAYOUT _REC_A1CUR_20_u1_u2 FNC_VALUES 1 UBYTE COLUMN_DIR DIRECT /end RECORD_LAYOUT
/begin RECORD_LAYOUT _REC_A1CUR_20_u2_u1 FNC_VALUES 1 UWORD COLUMN_DIR DIRECT /end RECORD_LAYOUT
/begin RECORD_LAYOUT _REC_A1MAP_20_u2_u2_u2 FNC_VALUES 1 UWORD COLUMN_DIR DIRECT /end RECORD_LAYOUT
/begin RECORD_LAYOUT _REC_A1CUR_20_u2_u2 FNC_VALUES 1 UWORD COLUMN_DIR DIRECT /end RECORD_LAYOUT
/begin RECORD_LAYOUT _REC_A1MAP_20_u1_u2_u2 FNC_VALUES 1 UBYTE COLUMN_DIR DIRECT /end RECORD_LAYOUT
/begin FUNCTION VfAcoMng_Noacvxx_xxxxxx ""
 /begin DEF_CHARACTERISTIC Cbx_ac_cold_loop_in_ecm Cxx_ac_vs_nok_dly Cxx_h_prs_ac_dsb_dly Cxx_h_prs_ac_dsb_hys Cxx_h_prs_ac_dsb_thd Cxx_l_prs_ac_dsb_hys Cxx_l_prs_ac_dsb_thd Cxx_n_ac_clu_dsb_thd Cxx_n_ac_dsb_hys Cxx_n_ac_dsb_thd Cxx_prmt_n_ac_dsb_dly Cxx_prmt_n_ac_dsb_hys Cxx_prmt_n_ac_dsb_thd Cxx_vs_ac_clu_dsb_thd /end DEF_CHARACTERISTIC
 /begin OUT_MEASUREMENT Vbx_ac_secu_dsb Vbx_h_prs_ac_dsb Vbx_l_prs_ac_dsb Vbx_n_ac_dsb Vbx_n_vs_ac_clu_dsb Vbx_prmt_n_ac_dsb Vxx_ac_vs Vxx_l_prs_ac_diag /end OUT_MEASUREMENT
/end FUNCTION
/begin FUNCTION SmIsrSpt ""
 /begin OUT_MEASUREMENT Vxx_acs_acel_is Vxx_el_csm_ctr Vbx_acs_acel_is_ena Vxx_acs_acel_is_max_vs /end OUT_MEASUREMENT
 /begin SUB_FUNCTION SmIsrSpt_Alcoxxx SmIsrSpt_Dgissxx SmIsrSpt_Mcissxx SmIsrSpt_Elissxx SmIsrSpt_Dynssxx SmIsrSpt_Atissxx SmIsrSpt_Ptissxx SmIsrSpt_Ntkofxx SmIsrSpt_Arissxx SmIsrSpt_Cfdgiss SmIsrSpt_Istatun /end SUB_FUNCTION
/end FUNCTION
/begin FUNCTION SmIsrSpt_Alcoxxx ""
 /begin DEF_CHARACTERISTIC Cmp_tco_amp_min_is_n_alco Ctp_cold_tdc_pn_is_n_ofs_alco Ctp_tdc_pn_tco_is_n_ofs_alco /end DEF_CHARACTERISTIC
 /begin OUT_MEASUREMENT Vxx_cold_tdc_pn_is_n_ofs_alco Vxx_is_fuel_typ_rat_tra Vxx_tco_amp_min_is_n_alco Vxx_tdc_pn_tco_is_n_ofs_alco /end OUT_MEASUREMENT
/end FUNCTION
/begin FUNCTION SmIsrSpt_Dgissxx ""
 /begin DEF_CHARACTERISTIC Ctp_toil_is_n_ofs Cxx_inj_vld_min_is_n Cxx_n_vld_min_is_n Cxx_prs_dft_min_is_n Cxx_toil_is_n_ofs /end DEF_CHARACTERISTIC
 /begin OUT_MEASUREMENT Vbx_diag_sta_ndec_abrt Vbx_diag_sta_ninc_abrt Vxx_diag_vvtc_min_is_n Vxx_inj_vld_min_is_n Vxx_moni_min_is_n Vxx_n_vld_min_is_n Vxx_prs_dft_min_is_n Vxx_toil_is_n_ofs /end OUT_MEASUREMENT
/end FUNCTION
/begin FUNCTION SmIsrSpt_Mcissxx ""
 /begin DEF_CHARACTERISTIC Ctb_ac_forb_is_n Ctp_ac_forb_is_n Ctp_agb_ac_min_is_n Ctp_pn_ac_min_is_n Cbx_acs_acel_is_acel_pdl_cfm Cbx_acs_acel_is_brk_cfm Cbx_acs_acel_is_coup_cfm Cxx_ac_acel_is_dly Cxx_acs_acel_is_thd Cxx_agb_pwst_min_is_n Cxx_pn_pwst_min_is_n Cxx_pwst_is_acel_rtn_dly /end DEF_CHARACTERISTIC
 /begin OUT_MEASUREMENT Vbx_acs_acel_is_acel_pdl_cdn Vbx_acs_acel_is_brk_cdn Vbx_acs_acel_is_fail Vbx_acs_acel_is_vs_cdn Vxx_ac_min_is_n Vxx_acs_min_is_n Vxx_eng_ac_min_is_n Vxx_pwst_min_is_n /end OUT_MEASUREMENT
/end FUNCTION
/begin FUNCTION SmIsrSpt_Elissxx ""
 /begin DEF_CHARACTERISTIC Ctb_el_csm_n_sp_ofs Ctp_el_csm_n_sp_ofs Cxx_agb_wind_min_is_n Cxx_el_bk_wind_is_n Cxx_el_csm_alt_cut_dly Cxx_el_csm_clc_dly Cxx_el_csm_clc_neg_fac Cxx_el_csm_clc_neut_vb Cxx_el_csm_clc_pos_fac Cxx_el_wind_tco Cxx_ptc_min_is_n Cxx_thpl_min_is_n /end DEF_CHARACTERISTIC
 /begin OUT_MEASUREMENT Vbx_el_csm_clc_ena Vxx_el_bk_wind_min_is_n Vxx_el_wind_min_is_n Vxx_min_vb_is_ofs Vxx_ptc_min_is_n Vxx_thpl_min_is_n /end OUT_MEASUREMENT
/end FUNCTION
/begin FUNCTION SmIsrSpt_Dynssxx ""
 /begin DEF_CHARACTERISTIC Ctp_is_ast_ofs Ctp_max_ftc_dyn_is_sp Cxx_fac_n_drv_ftc_dyn Cxx_is_out_dyn_ofs Cxx_k_ftc_dyn_is_sp Cxx_min_ftc_dyn_is_sp /end DEF_CHARACTERISTIC
 /begin OUT_MEASUREMENT Vbx_dyn_is_n_sp_rst Vxx_dyn_is_n_sp Vxx_ftc_dyn Vxx_ftc_dyn_n_drv /end OUT_MEASUREMENT
/end FUNCTION
/begin FUNCTION SmIsrSpt_Atissxx ""
 /begin DEF_CHARACTERISTIC Ctp_agb_tco_min_is_n Ctp_drag_tco_min_is_n Cxx_agb_min_is_n Cxx_is_run_vh_min_crp Cxx_tco_agb_df_min_is_n /end DEF_CHARACTERISTIC
 /begin OUT_MEASUREMENT Vbx_agb_is_clc_ena Vbx_is_run_vh_min_crp Vxx_agb_min_is_n Vxx_tco_agb_min_is_n /end OUT_MEASUREMENT
/end FUNCTION
/begin FUNCTION SmIsrSpt_Ptissxx ""
 /begin DEF_CHARACTERISTIC Ctb_cold_is_cata_wup_ctr Ctb_is_cata_wup_ctr Ctp_cold_tdc_agb_is_n_ofs Ctp_cold_tdc_pn_is_n_ofs Ctp_tdc_agb_tco_is_n_ofs Ctp_tdc_pn_tco_is_n_ofs Cxx_agb_tco_is_n_ofs Cxx_cold_agb Cxx_cold_agb_tco_is_n_ofs Cxx_cold_pn Cxx_cold_pn_alco Cxx_cold_pn_tco_is_n_ofs Cxx_cold_pn_tco_is_n_ofs_alco Cxx_cold_sta_tco Cxx_pn_tco_is_n_ofs Cxx_pn_tco_is_n_ofs_alco /end DEF_CHARACTERISTIC
 /begin OUT_MEASUREMENT Vbx_cata_wup_cdn_ena Vbx_cata_wup_dri Vxx_cold_pn_tco_is_n_ofs Vxx_is_n_ofs_cold Vxx_pft_min_is_n Vxx_pn_tco_is_n_ofs Vxx_tco_is_n_ofs Vxx_tco_neut_raw_val Vxx_tco_no_neut_raw_val Vxx_tdc_pn_tco_is_n_ofs /end OUT_MEASUREMENT
/end FUNCTION
/begin FUNCTION SmIsrSpt_Ntkofxx ""
 /begin DEF_CHARACTERISTIC Ctb_fzy_tkof_tqe_grd Ctb_tkof_vs_n_rat Ctp_fzy_tkof_tqe_grd_fac Ctp_fzy_tkof_vs_n_rat_fac Cbx_tkof_tqe_sp_dec_cfm Cxx_air_tq_dly_tdc_fac Cxx_fzy_tkof_lim_dec_t Cxx_mfld_tkof_dly_fac Cxx_n_tkof_fil_fac Cxx_n_tkof_inrt_0 Cxx_n_tkof_inrt_1 Cxx_tkof_n_dif_inrt_cge Cxx_tkof_tqe_grd_t /end DEF_CHARACTERISTIC
 /begin OUT_MEASUREMENT Vxx_driv_tqe_sp_grd Vxx_driv_tqe_sp_sat Vxx_fzy_tkof Vxx_mfld_dly_fil_fac Vxx_n_tkof_inrt Vxx_tkof_dly_tqe_sp Vxx_tkof_mdl_n_drv Vxx_tkof_mdl_n_drv_1 Vxx_tkof_mfld_tqe_sp Vxx_tkof_n_sp Vxx_tkof_tqe_sp Vxx_tq_air_dly_t /end OUT_MEASUREMENT
/end FUNCTION
/begin FUNCTION SmIsrSpt_Arissxx ""
 /begin DEF_CHARACTERISTIC Cmp_tco_amp_min_is_n Ctd_gear_run_vh_min_is_n Cbx_is_run_vh_min_crp_cfm Cbx_mpl_dec_slop_act Cxx_dec_slop_ac_sp Cxx_dec_slop_acs_sp Cxx_dec_slop_agb_sp Cxx_dec_slop_dgi_sp Cxx_dec_slop_diag_vvtc_sp Cxx_dec_slop_el_bk_sp Cxx_dec_slop_el_wind_sp Cxx_dec_slop_inj_sp Cxx_dec_slop_moni_sp Cxx_dec_slop_pft_sp Cxx_dec_slop_ptc_sp Cxx_dec_slop_pwst_sp Cxx_dec_slop_run_vh_sp Cxx_dec_slop_tco_sp Cxx_dec_slop_thpl_sp Cxx_fast_dec_slop Cxx_fast_inc_slop Cxx_inc_slop_ac_sp Cxx_inc_slop_acs_sp Cxx_inc_slop_agb_sp Cxx_inc_slop_dgi_sp Cxx_inc_slop_diag_vvtc_sp Cxx_inc_slop_el_bk_sp Cxx_inc_slop_el_wind_sp Cxx_inc_slop_inj_sp Cxx_inc_slop_moni_sp Cxx_inc_slop_pft_sp Cxx_inc_slop_ptc_sp Cxx_inc_slop_pwst_sp Cxx_inc_slop_run_vh_sp Cxx_inc_slop_tco_sp Cxx_inc_slop_thpl_sp Cxx_is_n_sp_max Cxx_is_n_sp_min Cxx_med_dec_slop Cxx_med_inc_slop Cxx_moni_is_n_sp_max Cxx_n_sp_dec Cxx_run_vh_min_is_n_dsb Cxx_slow_dec_slop Cxx_slow_inc_slop /end DEF_CHARACTERISTIC
 /begin OUT_MEASUREMENT Vtx_dec_slop_itl_tb[0] Vtx_dec_slop_itl_tb[1] Vtx_dec_slop_itl_tb[2] Vtx_dec_slop_itl_tb[3] Vtx_dec_slop_itl_tb[4] Vtx_dec_slop_itl_tb[5] Vtx_dec_slop_itl_tb[6] Vtx_dec_slop_itl_tb[7] Vtx_dec_slop_itl_tb[8] Vtx_dec_slop_itl_tb[9] Vtx_dec_slop_itl_tb[10] Vtx_dec_slop_itl_tb[11] Vtx_dec_slop_itl_tb[12] Vtx_dec_slop_itl_tb[13] Vtx_dec_slop_itl_tb[14] Vtx_inc_slop_itl_tb[0] Vtx_inc_slop_itl_tb[1] Vtx_inc_slop_itl_tb[2] Vtx_inc_slop_itl_tb[3] Vtx_inc_slop_itl_tb[4] Vtx_inc_slop_itl_tb[5] Vtx_inc_slop_itl_tb[6] Vtx_inc_slop_itl_tb[7] Vtx_inc_slop_itl_tb[8] Vtx_inc_slop_itl_tb[9] Vtx_inc_slop_itl_tb[10] Vtx_inc_slop_itl_tb[11] Vtx_inc_slop_itl_tb[12] Vtx_inc_slop_itl_tb[13] Vtx_inc_slop_itl_tb[14] Vtx_is_sp_itl_tb[0] Vtx_is_sp_itl_tb[1] Vtx_is_sp_itl_tb[2] Vtx_is_sp_itl_tb[3] Vtx_is_sp_itl_tb[4] Vtx_is_sp_itl_tb[5] Vtx_is_sp_itl_tb[6] Vtx_is_sp_itl_tb[7] Vtx_is_sp_itl_tb[8] Vtx_is_sp_itl_tb[9] Vtx_is_sp_itl_tb[10] Vtx_is_sp_itl_tb[11] Vtx_is_sp_itl_tb[12] Vtx_is_sp_itl_tb[13] Vtx_is_sp_itl_tb[14] Vxx_arb_dec_slop Vxx_arb_inc_slop Vxx_arb_lim_is Vxx_arb_raw_is Vxx_crt_is Vxx_is_n_sp Vxx_run_vh_min_is_n Vxx_tco_min_is_n Vxx_tco_sp_min_is_n /end OUT_MEASUREMENT
/end FUNCTION
/begin FUNCTION SmIsrSpt_Cfdgiss "" /begin OUT_MEASUREMENT Vsx_is_inj_vld /end OUT_MEASUREMENT /end FUNCTION
/begin FUNCTION SmIsrSpt_Istatun "" /begin DEF_CHARACTERISTIC Cxx_diag_max_is_n Cxx_diag_min_is_n Cxx_n_step /end DEF_CHARACTERISTIC
 /begin OUT_MEASUREMENT Vbx_diag_sta_ndec_ena Vbx_diag_sta_ndec_end Vbx_diag_sta_ninc_ena Vbx_diag_sta_ninc_end Vsx_diag_sta_ndec_stt Vsx_diag_sta_ninc_stt Vxx_diag_min_is_ofs /end OUT_MEASUREMENT
/end FUNCTION
/begin FUNCTION OuCboInj "" /begin OUT_MEASUREMENT Vxx_sta_eng_dly_NVM /end OUT_MEASUREMENT
 /begin SUB_FUNCTION OuCboInj_Appitxx OuCboInj_Mdplsxx OuCboInj_Opangxx OuCboInj_Opinjxx /end SUB_FUNCTION
/end FUNCTION
/begin FUNCTION OuCboInj_Appitxx ""
 /begin DEF_CHARACTERISTIC Cbx_inj1_num Cbx_inj2_num Cbx_inj3_num Cbx_inj4_num Cbx_min_ti Cbx_ti_bch Cxx_dfdec_inj1_oc Cxx_dfdec_inj1_scg Cxx_dfdec_inj1_scw Cxx_dfdec_inj2_oc Cxx_dfdec_inj2_scg Cxx_dfdec_inj2_scw Cxx_dfdec_inj3_oc Cxx_dfdec_inj3_scg Cxx_dfdec_inj3_scw Cxx_dfdec_inj4_oc Cxx_dfdec_inj4_scg Cxx_dfdec_inj4_scw Cxx_dfinc_inj1_oc Cxx_dfinc_inj1_scg Cxx_dfinc_inj1_scw Cxx_dfinc_inj2_oc Cxx_dfinc_inj2_scg Cxx_dfinc_inj2_scw Cxx_dfinc_inj3_oc Cxx_dfinc_inj3_scg Cxx_dfinc_inj3_scw Cxx_dfinc_inj4_oc Cxx_dfinc_inj4_scg Cxx_dfinc_inj4_scw Cxx_inj_appl_ti1 Cxx_inj_appl_ti2 Cxx_inj_wht_ti_fac Cxx_inj_wht_ti_fac_alco Cxx_min_cp_ti Cxx_min_ti Cxx_n_thd Cxx_sta_eng_dly Cxx_ti_bch /end DEF_CHARACTERISTIC
 /begin OUT_MEASUREMENT Vbx_diag_sta_ffig_abrt Vbx_diag_sta_ffig_ena Vbx_diag_sta_ffig_end Vbx_min_cp_ti Vbx_min_ti Vbx_min_ti_cut Vsx_diag_sta_ffig_stt Vsx_inj1_vld Vsx_inj2_vld Vsx_inj3_vld Vsx_inj4_vld Vxx_efv_ti Vxx_inj1_appl_ti1 Vxx_inj1_appl_ti2 Vxx_inj2_appl_ti1 Vxx_inj2_appl_ti2 Vxx_inj3_appl_ti1 Vxx_inj3_appl_ti2 Vxx_inj4_appl_ti1 Vxx_inj4_appl_ti2 Vxx_inj_wht_ti_fac Vxx_pinj_appl_ti Vxx_sta_eng_dly_t /end OUT_MEASUREMENT
/end FUNCTION
/begin FUNCTION OuCboInj_Mdplsxx "" /begin DEF_CHARACTERISTIC Ctb_mv_vb Ctp_vb_inj_dly_cor Cxx_inj_dly Cxx_inj_dly_alco /end DEF_CHARACTERISTIC /begin OUT_MEASUREMENT Vxx_inj_dly Vxx_inj_dly_clc Vxx_vb_inj_dly_cor /end OUT_MEASUREMENT /end FUNCTION
/begin FUNCTION OuCboInj_Opangxx ""
 /begin DEF_CHARACTERISTIC Cxx_seq_open_angl_max Cxx_sfg_open_angl1_max Cxx_sfg_open_angl2_max Cxx_sta_inj_sta_angl /end DEF_CHARACTERISTIC
 /begin OUT_MEASUREMENT Vxx_inj1_open_angl1 Vxx_inj1_open_angl2 Vxx_inj1_pinj_open_angl Vxx_inj2_open_angl1 Vxx_inj2_open_angl2 Vxx_inj2_pinj_open_angl Vxx_inj3_open_angl1 Vxx_inj3_open_angl2 Vxx_inj3_pinj_open_angl Vxx_inj4_open_angl1 Vxx_inj4_open_angl2 Vxx_inj4_pinj_open_angl /end OUT_MEASUREMENT
/end FUNCTION
/begin FUNCTION OuCboInj_Opinjxx ""
 /begin OUT_MEASUREMENT Vbx_inj1_not_open Vbx_inj1_open Vbx_inj2_not_open Vbx_inj2_open Vbx_inj3_not_open Vbx_inj3_open Vbx_inj4_not_open Vbx_inj4_open /end OUT_MEASUREMENT
/end FUNCTION
/begin FUNCTION BiSmiSyn "" /begin SUB_FUNCTION BiSmiSyn_Synchro /end SUB_FUNCTION /end FUNCTION
/begin FUNCTION BiSmiSyn_Synchro ""
 /begin OUT_MEASUREMENT Vbx_cho_cam_ctr_init Vbx_df_crk_chr Vbx_df_crk_cmp Vbx_df_crk_cyc Vbx_df_crk_no_sig_wit_cam Vbx_df_crk_oc Vbx_df_crk_shp Vbx_df_in_cam_chr Vbx_df_in_cam_crk_cmp Vbx_df_in_cam_cyc Vbx_df_in_cam_no_sig Vbx_df_in_cam_nok Vbx_diag_ena_crk_chr Vbx_diag_ena_crk_cmp Vbx_diag_ena_crk_cyc Vbx_diag_ena_crk_no_sig_wit_cam Vbx_diag_ena_crk_oc Vbx_diag_ena_crk_shp Vbx_diag_ena_in_cam_chr Vbx_diag_ena_in_cam_crk_cmp Vbx_diag_ena_in_cam_cyc Vbx_diag_ena_in_cam_no_sig Vbx_diag_ena_in_cam_nok Vbx_n_inv Vbx_raw_eng_syn Vbx_raw_in_cam_lvl Vbx_raw_trz_clc_ena Vxx_raw_eng_angl Vxx_raw_in_cam_toth_per Vxx_raw_n Vxx_raw_tdc_ctr Vxx_raw_tdc_per Vxx_raw_trz_t_toth_0 Vxx_raw_trz_t_toth_0_nxt Vxx_raw_trz_t_toth_1 Vxx_raw_trz_t_toth_2 Vxx_raw_trz_t_toth_3 Vxx_raw_trz_t_toth_4 Vxx_raw_trz_t_toth_5 Vxx_raw_trz_t_toth_5_prev lv_es lv_st /end OUT_MEASUREMENT
/end FUNCTION
/begin FUNCTION OuCboFuo "" /begin OUT_MEASUREMENT Vbx_mem_sta_gas_pump Vbx_cpl_sta_gas_pump /end OUT_MEASUREMENT /begin SUB_FUNCTION OuCboFuo_Pmpcdxx OuCboFuo_Adacxxx OuCboFuo_Cpxdiag /end SUB_FUNCTION /end FUNCTION
/begin FUNCTION OuCboFuo_Pmpcdxx ""
 /begin DEF_CHARACTERISTIC Cbx_gas_pump_fast_stop Cxx_dfdec_gas_pump_oc Cxx_dfdec_gas_pump_scg Cxx_dfdec_gas_pump_scw Cxx_dfinc_gas_pump_oc Cxx_dfinc_gas_pump_scg Cxx_dfinc_gas_pump_scw Cxx_gas_pump_sta_dly Cxx_sta_gas_pump_n_thd /end DEF_CHARACTERISTIC
 /begin OUT_MEASUREMENT Vbx_gas_pump_rly_cmd Vbx_sta_gas_pump Vsx_gas_pump_vld Vxx_gas_pump_dly /end OUT_MEASUREMENT
/end FUNCTION
/begin FUNCTION OuCboFuo_Adacxxx "" /begin DEF_CHARACTERISTIC Cxx_adac_fim_ofs Cxx_fuel_wht_vol_fac /end DEF_CHARACTERISTIC /begin OUT_MEASUREMENT Vxx_csm Vxx_csm_sum_mux Vxx_fim_sum_mux_2 /end OUT_MEASUREMENT /end FUNCTION
/begin FUNCTION OuCboFuo_Cpxdiag ""
 /begin DEF_CHARACTERISTIC Cxx_dfdec_cp_oc Cxx_dfdec_cp_scg Cxx_dfdec_cp_scw Cxx_dfinc_cp_oc Cxx_dfinc_cp_scg Cxx_dfinc_cp_scw /end DEF_CHARACTERISTIC
 /begin OUT_MEASUREMENT Vsx_cp_vld /end OUT_MEASUREMENT
/end FUNCTION
/begin FUNCTION BiDgtSer ""
 /begin DEF_CHARACTERISTIC c_nr_hard_1_asa c_nr_hard_2_asa c_nr_hard_3_asa c_nr_hard_4_asa c_nr_hard_5_asa c_nr_hw_prg_1_asa c_nr_hw_prg_2_asa c_nr_hw_prg_3_asa c_nr_hw_prg_4_asa c_nr_hw_prg_5_asa /end DEF_CHARACTERISTIC
/end FUNCTION
/begin FUNCTION CbMisDgn "" /begin OUT_MEASUREMENT Sxx_mis_ctr_NVM Sxx_mis_ctr_lpg_NVM /end OUT_MEASUREMENT /begin SUB_FUNCTION CbMisDgn_Mdmsfxx CbMisDgn_Msfirxx /end SUB_FUNCTION /end FUNCTION
/begin FUNCTION CbMisDgn_Mdmsfxx ""
 /begin DEF_CHARACTERISTIC Cbx_mis_lih_conf Cxx_mis_lih_chk_dsb_conf Cxx_mis_lih_mis_nr Cxx_mis_lih_n_min Cxx_mis_lih_out_mis_nr Cxx_mis_lih_re_phs_nr Cxx_mis_lih_tdc_nr Cxx_mis_n_max_thd_1_n /end DEF_CHARACTERISTIC
 /begin OUT_MEASUREMENT Vbx_inj1_cut_req_tmp Vbx_inj2_cut_req_tmp Vbx_inj3_cut_req_tmp Vbx_inj4_cut_req_tmp Vbx_mis_cut Vbx_mis_cut_cyl_done Vbx_mis_det_1_2_inh Vbx_mis_inj_re_phs_req Vbx_mis_lih_cata_rst Vbx_mis_lih_chk_dsb Vbx_mis_lih_phs_chk Vbx_mis_lih_phs_chk_req Vbx_mis_lih_phs_ok Vbx_mis_lih_rst_inh Vbx_pres_mis_lih Vsx_cyl_cut Vsx_mis_inj1_vld Vsx_mis_inj2_vld Vsx_mis_inj3_vld Vsx_mis_inj4_vld Vsx_mis_lih_cyl_chk Vsx_mis_lih_stt Vxx_mis_cyl_fail_nr Vxx_mis_lih_mis_ctr Vxx_mis_lih_out_mis_ctr Vxx_mis_lih_re_phs_ctr Vxx_mis_lih_tdc_ctr /end OUT_MEASUREMENT
/end FUNCTION
/begin FUNCTION CbMisDgn_Msfirxx ""
 /begin DEF_CHARACTERISTIC Ctb_dft_comb_eal2 Ctb_dft_comb_eal2_lpg Ctb_dft_comb_n2 Ctb_dft_comb_n2_lpg Ntb_tco_9 Cmp_mis_cata_degr Cmp_mis_cata_degr_1 Cmp_mis_iga_efy_dif Cmp_mis_tq_dif_1_2_dz_1 Cmp_mis_tq_dif_1_4_dz_1 Cmp_mis_tq_dif_fac_1_2 Cmp_mis_tq_dif_fac_1_2_1 Cmp_mis_tq_dif_fac_1_2_dz Cmp_mis_tq_dif_fac_1_4 Cmp_mis_tq_dif_fac_1_4_1 Cmp_mis_tq_dif_fac_1_4_dz Cmp_mis_tq_dif_fac_intm Cmp_mis_tq_dif_fac_intm_1 Cmp_mis_tq_dif_intm_dz Cmp_mis_tq_dif_intm_dz_1 Ctp_min_eal Ctp_min_eal_1_2 Ctp_min_eal_amp_ofs Ctp_min_eal_off Cbx_mis_conf_diag_mis Cxx_agb_conv_trs_dly Cxx_dfdec_mis_1_cata Cxx_dfdec_mis_1_lpg_cata Cxx_dfdec_mis_1_lpg_trs_h Cxx_dfdec_mis_1_trs_h Cxx_dfdec_mis_2_cata Cxx_dfdec_mis_2_lpg_cata Cxx_dfdec_mis_2_lpg_trs_h Cxx_dfdec_mis_2_trs_h Cxx_dfdec_mis_3_cata Cxx_dfdec_mis_3_lpg_cata Cxx_dfdec_mis_3_lpg_trs_h Cxx_dfdec_mis_3_trs_h Cxx_dfdec_mis_4_cata Cxx_dfdec_mis_4_lpg_cata Cxx_dfdec_mis_4_lpg_trs_h Cxx_dfdec_mis_4_trs_h Cxx_dfdec_mis_cata Cxx_dfdec_mis_lpg_cata Cxx_dfdec_mis_lpg_trs_h Cxx_dfdec_mis_min_fuel_cata Cxx_dfdec_mis_min_fuel_trs_h Cxx_dfdec_mis_trs_h Cxx_dfdec_mis_unk_cata Cxx_dfdec_mis_unk_lpg_cata Cxx_dfdec_mis_unk_lpg_trs_h Cxx_dfdec_mis_unk_trs_h Cxx_dfinc_mis_1_cata Cxx_dfinc_mis_1_lpg_cata Cxx_dfinc_mis_1_lpg_trs_h Cxx_dfinc_mis_1_trs_h Cxx_dfinc_mis_2_cata Cxx_dfinc_mis_2_lpg_cata Cxx_dfinc_mis_2_lpg_trs_h Cxx_dfinc_mis_2_trs_h Cxx_dfinc_mis_3_cata Cxx_dfinc_mis_3_lpg_cata Cxx_dfinc_mis_3_lpg_trs_h Cxx_dfinc_mis_3_trs_h Cxx_dfinc_mis_4_cata Cxx_dfinc_mis_4_lpg_cata Cxx_dfinc_mis_4_lpg_trs_h Cxx_dfinc_mis_4_trs_h Cxx_dfinc_mis_cata Cxx_dfinc_mis_lpg_cata Cxx_dfinc_mis_lpg_trs_h Cxx_dfinc_mis_min_fuel_cata Cxx_dfinc_mis_min_fuel_trs_h Cxx_dfinc_mis_trs_h Cxx_dfinc_mis_unk_cata Cxx_dfinc_mis_unk_lpg_cata Cxx_dfinc_mis_unk_lpg_trs_h Cxx_dfinc_mis_unk_trs_h Cxx_min_diag_mis_dly Cxx_mis_cata_win_mis_nr Cxx_mis_cata_win_mis_nr_1 Cxx_mis_cata_win_tdc_nr Cxx_mis_cyl_fail_rat Cxx_mis_diag_obd_dsb_t Cxx_mis_ena_n_max_thd Cxx_mis_ena_n_min_thd Cxx_mis_ena_tco_min_thd Cxx_mis_fast_win_mis_nr Cxx_mis_fast_win_tdc_nr Cxx_mis_n_max_agb_clos_no Cxx_mis_ofs_eal_agb_ena Cxx_mis_polu_win_mis_nr Cxx_mis_polu_win_mis_nr_1 Cxx_mis_polu_win_nr_fail Cxx_mis_polu_win_tdc_nr Cxx_mis_rat_min_cyl_ Cxx_mis_stab_tdc_nr /end DEF_CHARACTERISTIC
 /begin OUT_MEASUREMENT Sxx_mis_ctr_clr Sxx_mis_ctr_lpg_clr Sxx_mis_ctr_lpg_read Sxx_mis_ctr_read Vbx_df_mis_1_cata Vbx_df_mis_1_lpg_cata Vbx_df_mis_1_lpg_trs_h Vbx_df_mis_1_trs_h Vbx_df_mis_2_cata Vbx_df_mis_2_lpg_cata Vbx_df_mis_2_lpg_trs_h Vbx_df_mis_2_trs_h Vbx_df_mis_3_cata Vbx_df_mis_3_lpg_cata Vbx_df_mis_3_lpg_trs_h Vbx_df_mis_3_trs_h Vbx_df_mis_4_cata Vbx_df_mis_4_lpg_cata Vbx_df_mis_4_lpg_trs_h Vbx_df_mis_4_trs_h Vbx_df_mis_cata Vbx_df_mis_lpg_cata Vbx_df_mis_lpg_trs_h Vbx_df_mis_min_fuel_cata Vbx_df_mis_min_fuel_trs_h Vbx_df_mis_trs_h Vbx_df_mis_unk_cata Vbx_df_mis_unk_lpg_cata Vbx_df_mis_unk_lpg_trs_h Vbx_df_mis_unk_trs_h Vbx_diag_ena_mis_1_cata Vbx_diag_ena_mis_1_lpg_cata Vbx_diag_ena_mis_1_lpg_trs_h Vbx_diag_ena_mis_1_trs_h Vbx_diag_ena_mis_2_cata Vbx_diag_ena_mis_2_lpg_cata Vbx_diag_ena_mis_2_lpg_trs_h Vbx_diag_ena_mis_2_trs_h Vbx_diag_ena_mis_3_cata Vbx_diag_ena_mis_3_lpg_cata Vbx_diag_ena_mis_3_lpg_trs_h Vbx_diag_ena_mis_3_trs_h Vbx_diag_ena_mis_4_cata Vbx_diag_ena_mis_4_lpg_cata Vbx_diag_ena_mis_4_lpg_trs_h Vbx_diag_ena_mis_4_trs_h Vbx_diag_ena_mis_cata Vbx_diag_ena_mis_lpg_cata Vbx_diag_ena_mis_lpg_trs_h Vbx_diag_ena_mis_min_fuel_cata Vbx_diag_ena_mis_min_fuel_trs_h Vbx_diag_ena_mis_trs_h Vbx_diag_ena_mis_unk_cata Vbx_diag_ena_mis_unk_lpg_cata Vbx_diag_ena_mis_unk_lpg_trs_h Vbx_diag_ena_mis_unk_trs_h Vbx_dsb_diag_mis Vbx_frst_inj_re Vbx_mil_flsh_req Vbx_mis_cata_cf_vld Vbx_mis_cata_rst_done Vbx_mis_cata_win_stop Vbx_mis_cyl1 Vbx_mis_cyl1_fail Vbx_mis_cyl2 Vbx_mis_cyl2_fail Vbx_mis_cyl3 Vbx_mis_cyl3_fail Vbx_mis_cyl4 Vbx_mis_cyl4_fail Vbx_mis_det Vbx_mis_det_1_2 Vbx_mis_det_1_4 Vbx_mis_det_1_4_prev2 Vbx_mis_det_intm Vbx_mis_det_prev16 Vbx_mis_frst_diag_done Vbx_mis_obd_diag_stop Vbx_mis_req Vbx_mis_stop Vbx_pres_mis_fast Vsx_mis_cata_vld Vsx_mis_stt Vsx_mis_vld Vxx_agb_conv_trs_dly Vxx_eal_ofs_agb_dri Vxx_max_iga_efy_prev2 Vxx_min_eal_1_2 Vxx_mis_16_mis_ctr Vxx_mis_cata_degr Vxx_mis_cata_min_fuel_nr Vxx_mis_cata_mis_ctr Vxx_mis_cata_tdc_ctr Vxx_mis_cata_tdc_nr_tot Vxx_mis_cata_tdc_prmt Vxx_mis_cata_win_mis_nr Vxx_mis_ctr_ini Vxx_mis_ctr_lpg_ini Vxx_mis_cyl1_tdc_ctr Vxx_mis_cyl2_tdc_ctr Vxx_mis_cyl3_tdc_ctr Vxx_mis_cyl4_tdc_ctr Vxx_mis_diag_dsb_dly Vxx_mis_dt Vxx_mis_eal_frz Vxx_mis_eol_mod_mis_ctr Vxx_mis_eol_mod_prop Vxx_mis_eol_mod_tdc_ctr Vxx_mis_fast_mis_ctr Vxx_mis_fast_tdc_ctr Vxx_mis_iga_efy_dif_2 Vxx_mis_l_n_tdc_ctr Vxx_mis_n_frz Vxx_mis_n_max_thd_1_n Vxx_mis_nr_cyl1 Vxx_mis_nr_cyl2 Vxx_mis_nr_cyl3 Vxx_mis_nr_cyl4 Vxx_mis_obd_diag_stop Vxx_mis_polu_mis_ctr Vxx_mis_polu_tdc_ctr Vxx_mis_polu_tot_ctr Vxx_mis_polu_win_ctr Vxx_mis_polu_win_mis_nr Vxx_mis_stab_tdc_ctr Vxx_mis_tq_dif_fac_1_2 Vxx_mis_tq_dif_fac_1_2_dz Vxx_mis_tq_dif_fac_1_4 Vxx_mis_tq_dif_fac_1_4_dz Vxx_mis_tq_dif_fac_intm Vxx_mis_tq_dif_intm_dz /end OUT_MEASUREMENT
/end FUNCTION
/begin FUNCTION SmLimCtl "" /begin SUB_FUNCTION SmLimCtl_Ntqcxxx SmLimCtl_Ntspcxx /end SUB_FUNCTION /end FUNCTION
/end MODULE
/end PROJECT
