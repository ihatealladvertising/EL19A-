ASAP2_VERSION 1 41
/begin PROJECT RD8 "_default_ProjectLongIdentifier"
/begin HEADER "_default_HeaderComment" PROJECT_NO RD9 /end HEADER
/begin MODULE _default_ModuleName "_default_ModuleLongIdentifier"
/begin MOD_COMMON "_default_ModCommonComment" DEPOSIT ABSOLUTE BYTE_ORDER MSB_LAST ALIGNMENT_BYTE 1 ALIGNMENT_WORD 2 ALIGNMENT_LONG 2 ALIGNMENT_FLOAT32_IEEE 2 ALIGNMENT_FLOAT64_IEEE 4 /end MOD_COMMON
/begin AXIS_PTS Ctb_amp "Breakpoints of atmospheric pressure" 0xa0024c14 Vxx_amp _REC_A2AXS_20_u2 20000. _CNV_A_R_LINEAR_____57_CM 5 0. 20000. FORMAT "%5.0" /end AXIS_PTS
/begin AXIS_PTS Ctb_esti_tqe "Breakpoints of estimated effective engine torque" 0xa0024c20 Vxx_esti_tqe _REC_A2AXS_20_u2 2047.96875 _CNV_A_R_LINEAR_____161_CM 9 -400. 1647.96875 FORMAT "%10.5" /end AXIS_PTS
/begin AXIS_PTS Ctb_n_spg_dft_mdl "Breakpoint of Engine speed for Ctp_n_spg_dft_mod" 0xa0024c34 Vxx_n _REC_A2AXS_20_u2 16383.75 _CNV_A_R_ENSD_LINEA_24_CM 9 0. 16383.75 FORMAT "%8.2" /end AXIS_PTS
/begin AXIS_PTS Ntb_spg_l_hys "17 breakpoints for Ctp_spg_l_hys" 0xa0024e90 Vxx_sens_spg _REC_A2AXS_20_u2 20000. _CNV_A_R_LINEAR_____57_CM 17 0. 20000. READ_ONLY FORMAT "%5.0" /end AXIS_PTS
/begin AXIS_PTS Ntb_spg_mat_cor "9 equidistants points between -40∞C and 120∞C for Ctp_spg_mat_cor" 0xa0024eb4 Vxx_mat _REC_A2AXS_20_u2 240. _CNV_A_R_LINEAR_____54_CM 9 -40. 200. READ_ONLY FORMAT "%5.1" /end AXIS_PTS
/begin AXIS_PTS Ntb_spg_up_hys "17 equidistants points between 103 hPa and 1050,2 hPa for Ctp_spg_up_hys" 0xa0024ec8 Vxx_sens_spg _REC_A2AXS_20_u2 20000. _CNV_A_R_LINEAR_____57_CM 17 0. 20000. READ_ONLY FORMAT "%5.0" /end AXIS_PTS
/begin CHARACTERISTIC Cmp_spg_amp_cor "Offset of correction of Cmp_tq_n_spg_fail_thd function of the height and the engine speed." MAP 0xa0024c48 _REC_A1MAP_20_u2_u2_u2 20000. _CNV_A_R_LINEAR_____57_CM 0. 20000. FORMAT "%5.0"
 /begin AXIS_DESCR COM_AXIS Vxx_amp _CNV_A_R_LINEAR_____57_CM 5 0. 20000. FORMAT "%5.0" AXIS_PTS_REF Ctb_amp /end AXIS_DESCR
 /begin AXIS_DESCR COM_AXIS Vxx_esti_tqe _CNV_A_R_LINEAR_____161_CM 9 -400. 1647.96875 FORMAT "%10.5" AXIS_PTS_REF Ctb_esti_tqe /end AXIS_DESCR
/end CHARACTERISTIC
/begin CHARACTERISTIC Cmp_tq_n_spg_fail_thd "Threshold = f (Vxx_esti_tqe, Vxx_n) map turbocharger pressures" MAP 0xa0024ca4 _REC_A1MAP_20_u2_u2_u2 20000. _CNV_A_R_LINEAR_____57_CM 0. 20000. FORMAT "%5.0"
 /begin AXIS_DESCR COM_AXIS Vxx_esti_tqe _CNV_A_R_LINEAR_____161_CM 9 -400. 1647.96875 FORMAT "%10.5" AXIS_PTS_REF Ctb_esti_tqe /end AXIS_DESCR
 /begin AXIS_DESCR COM_AXIS Vxx_n _CNV_A_R_ENSD_LINEA_24_CM 20 0. 16383.75 FORMAT "%8.2" AXIS_PTS_REF Ctb_n /end AXIS_DESCR
/end CHARACTERISTIC
/begin CHARACTERISTIC Ctp_n_amp_spg_dif_cut "Diff between Vxx_spg-Vxx_map during slowdown cut off due to the flow of the turbine and the throttle" CURVE 0xa0024e0c _REC_A1CUR_20_u2_u2 20000. _CNV_A_R_LINEAR_____57_CM 0. 20000. FORMAT "%5.0"
 /begin AXIS_DESCR COM_AXIS Vxx_n _CNV_A_R_ENSD_LINEA_24_CM 9 0. 16383.75 FORMAT "%8.2" AXIS_PTS_REF Ctb_n2 /end AXIS_DESCR
/end CHARACTERISTIC
/begin CHARACTERISTIC Ctp_n_spg_dft_mdl "Default value of Vxx_mdl_sgp" CURVE 0xa0024e20 _REC_A1CUR_20_u2_u2 20000. _CNV_A_R_LINEAR_____57_CM 0. 20000. FORMAT "%5.0"
 /begin AXIS_DESCR COM_AXIS Vxx_n _CNV_A_R_ENSD_LINEA_24_CM 9 0. 16383.75 FORMAT "%8.2" AXIS_PTS_REF Ctb_n_spg_dft_mdl /end AXIS_DESCR
/end CHARACTERISTIC
/begin CHARACTERISTIC Ctp_spg_l_hys "low Hysteresis on turbocharger pressure cartography detection of a turbocharger pressure sensor def" CURVE 0xa0024e34 _REC_A1CUR_20_u2_u2 20000. _CNV_A_R_LINEAR_____57_CM 0. 20000. FORMAT "%5.0"
 /begin AXIS_DESCR COM_AXIS Vxx_sens_spg _CNV_A_R_LINEAR_____57_CM 17 0. 20000. READ_ONLY FORMAT "%5.0" AXIS_PTS_REF Ntb_spg_l_hys /end AXIS_DESCR
/end CHARACTERISTIC
/begin CHARACTERISTIC Ctp_spg_mat_cor "Offset on boost pressure cartography detection of a turbocharger pressure sensor default" CURVE 0xa0024e58 _REC_A1CUR_20_u2_u2 20000. _CNV_A_R_LINEAR_____57_CM 0. 20000. FORMAT "%5.0"
 /begin AXIS_DESCR COM_AXIS Vxx_mat _CNV_A_R_LINEAR_____54_CM 9 -40. 200. READ_ONLY FORMAT "%5.1" AXIS_PTS_REF Ntb_spg_mat_cor /end AXIS_DESCR
/end CHARACTERISTIC
/begin CHARACTERISTIC Ctp_spg_up_hys "high Hysteresis on turbocharger pressure cartography detection of a turbocharger pressure sensor de" CURVE 0xa0024e6c _REC_A1CUR_20_u2_u2 20000. _CNV_A_R_LINEAR_____57_CM 0. 20000. FORMAT "%5.0"
 /begin AXIS_DESCR COM_AXIS Vxx_sens_spg _CNV_A_R_LINEAR_____57_CM 17 0. 20000. READ_ONLY FORMAT "%5.0" AXIS_PTS_REF Ntb_spg_up_hys /end AXIS_DESCR
/end CHARACTERISTIC
/begin MEASUREMENT Vbx_amp_spg_dif_upd "Pressure difference between Vxx_amp and Vxx_spg during engine slowdown update" UBYTE _CNV_S_2_RANGE______3_CM 1 0. 0. 1. ECU_ADDRESS 0xd0003df3 BIT_MASK 0x1 /end MEASUREMENT
/begin MEASUREMENT Vbx_df_spg_chr "Turbocharger Pressure Sensor System detected failure" UBYTE _CNV_S_2_RANGE______3_CM 1 0. 0. 1. ECU_ADDRESS 0xd0003df4 BIT_MASK 0x1 /end MEASUREMENT
/begin MEASUREMENT Vbx_df_spg_oor "Turbocharger Pressure Sensor Abnormal Voltage detected failure" UBYTE _CNV_S_2_RANGE______3_CM 1 0. 0. 1. ECU_ADDRESS 0xd0003df5 BIT_MASK 0x1 /end MEASUREMENT
/begin MEASUREMENT Vbx_diag_ena_spg_chr "Turbocharger Pressure Sensor System diagnostic information available" UBYTE _CNV_S_2_RANGE______3_CM 1 0. 0. 1. ECU_ADDRESS 0xd0003df6 BIT_MASK 0x1 /end MEASUREMENT
/begin MEASUREMENT Vbx_diag_ena_spg_chr_cdn "Boolean used to build Vbx_diag_ena_spg_chr" UBYTE _CNV_S_2_RANGE______3_CM 1 0. 0. 1. ECU_ADDRESS 0xd0003df7 BIT_MASK 0x1 /end MEASUREMENT
/begin MEASUREMENT Vbx_diag_ena_spg_oor "Turbocharger Pressure Sensor Out Of Range diagnostic information available" UBYTE _CNV_S_2_RANGE______3_CM 1 0. 0. 1. ECU_ADDRESS 0xd0003df8 BIT_MASK 0x1 /end MEASUREMENT
/begin MEASUREMENT Vbx_inj_cut_cdn "Injection cut detection" UBYTE _CNV_S_2_RANGE______3_CM 1 0. 0. 1. ECU_ADDRESS 0xd0003df9 BIT_MASK 0x1 /end MEASUREMENT
/begin MEASUREMENT Vbx_low_eng_load "Low engine load detection" UBYTE _CNV_S_2_RANGE______3_CM 1 0. 0. 1. ECU_ADDRESS 0xd0003dfa BIT_MASK 0x1 /end MEASUREMENT
/begin MEASUREMENT Vbx_spg_gbx_stt "Gearbox state for SPG diagnosis purpose" UBYTE _CNV_S_2_RANGE______3_CM 1 0. 0. 1. ECU_ADDRESS 0xd0003dfb BIT_MASK 0x1 /end MEASUREMENT
/begin MEASUREMENT Vbx_spg_ini "Boolean indicating the initialisation state of spg" UBYTE _CNV_S_2_RANGE______3_CM 1 0. 0. 1. ECU_ADDRESS 0xd0003dfc BIT_MASK 0x1 /end MEASUREMENT
/begin MEASUREMENT Vsx_spg_vld "Boost pressure validity status" UBYTE _CNV_A_R_ECME_LINEA_0_CM 1 0. 0. 2. ECU_ADDRESS 0xd0003dfd FORMAT "%1.0" /end MEASUREMENT
/begin MEASUREMENT Vxx_act_is_dly "Idle speed recognation delay" UWORD _CNV_A_R_LINEAR_____34_CM 1 0. 0. 655.35 ECU_ADDRESS 0xd00038e6 FORMAT "%6.2" /end MEASUREMENT
/begin MEASUREMENT Vxx_amp_inj_cut_dly "Delay variable for the detection of an injection cut" UWORD _CNV_A_R_LINEAR_____58_CM 1 0. 0. 65.535 ECU_ADDRESS 0xd00038e8 FORMAT "%5.3" /end MEASUREMENT
/begin MEASUREMENT Vxx_amp_spg_dif "Pressure difference between Vxx_amp and Vxx_spg during engfine slowdown" UWORD _CNV_A_R_LINEAR_____57_CM 1 0. 0. 20000. ECU_ADDRESS 0xd00038ea FORMAT "%5.0" /end MEASUREMENT
/begin MEASUREMENT Vxx_esti_tqe_fil "Timer after the recognition of the cut of inj for the diagnosis of Vxx_spg and the updating Vxx_amp" UWORD _CNV_A_R_LINEAR_____161_CM 1 0. -400. 1647.96875 ECU_ADDRESS 0xd00038ec FORMAT "%10.5" /end MEASUREMENT
/begin MEASUREMENT Vxx_it_psn_dif_fil "filtered absolute variation of Vxx_it_rel_psn" UWORD _CNV_A_R_LINEAR_____94_CM 1 0. 0. 100. ECU_ADDRESS 0xd00038ee FORMAT "%6.2" /end MEASUREMENT
/begin MEASUREMENT Vxx_mdl_spg "modelled turbocharger pressure" UWORD _CNV_A_R_LINEAR_____57_CM 1 0. 0. 20000. ECU_ADDRESS 0xd00038f0 FORMAT "%5.0" /end MEASUREMENT
/begin MEASUREMENT Vxx_spg "Boost pressure measurement value" UWORD _CNV_A_R_LINEAR_____57_CM 1 0. 0. 20000. ECU_ADDRESS 0xd00038f2 FORMAT "%5.0" /end MEASUREMENT
/begin MEASUREMENT Vxx_spg_amp_cor "offset on turbocharger pressure cartography detection of a turbocharger pressure sensor default" UWORD _CNV_A_R_LINEAR_____57_CM 1 0. 0. 20000. ECU_ADDRESS 0xd00038f4 FORMAT "%5.0" /end MEASUREMENT
/begin MEASUREMENT Vxx_spg_chr_diag_dly "Delay after an intersystem torque request to authorise the chr diag" UWORD _CNV_A_R_LINEAR_____58_CM 1 0. 0. 65.535 ECU_ADDRESS 0xd00038f6 FORMAT "%5.3" /end MEASUREMENT
/begin MEASUREMENT Vxx_spg_fail_thd "Threshold of boost pressure =f(Vxx_esti_tqe, Vxx_n) for  diagnosis driven engine" UWORD _CNV_A_R_LINEAR_____57_CM 1 0. 0. 20000. ECU_ADDRESS 0xd00038f8 FORMAT "%5.0" /end MEASUREMENT
/begin MEASUREMENT Vxx_spg_l_hys "low Hysteresis on turbocharger pressure cartography detection of a turbocharger pressure sensor def" UWORD _CNV_A_R_LINEAR_____57_CM 1 0. 0. 20000. ECU_ADDRESS 0xd00038fa FORMAT "%5.0" /end MEASUREMENT
/begin MEASUREMENT Vxx_spg_mat_cor "offset on turbocharger pressure cartography detection of a turbocharger pressure sensor default" UWORD _CNV_A_R_LINEAR_____57_CM 1 0. 0. 20000. ECU_ADDRESS 0xd00038fc FORMAT "%5.0" /end MEASUREMENT
/begin MEASUREMENT Vxx_spg_up_hys "high Hysteresis on turbocharger pressure cartography detection of a turbocharger pressure sensor de" UWORD _CNV_A_R_LINEAR_____57_CM 1 0. 0. 20000. ECU_ADDRESS 0xd00038fe FORMAT "%5.0" /end MEASUREMENT
/begin CHARACTERISTIC Cbx_spg_sens_cfm "Boolean indicating if the engine is equipped with an boost pressure sensor" VALUE 0xa00210c6 _REC_S1VAL_20_u1 1. _CNV_A_R_ECME_LINEA_0_CM 0. 1. FORMAT "%1.0" BIT_MASK 0x1 /end CHARACTERISTIC
/begin CHARACTERISTIC Cxx_act_is_dly "Time after the recognition of the idle speed for the diagnosis of Vxx_spg and the updating Vxx_amp" VALUE 0xa0021096 _REC_S1VAL_20_u2 655.35 _CNV_A_R_LINEAR_____34_CM 0. 655.35 FORMAT "%6.2" /end CHARACTERISTIC
/begin CHARACTERISTIC Cxx_amp_cge_n_thd "Threshold of Vxx_n above of which we forbid the updating of Vxx_amp and the diagnosis of Vxx_spg" VALUE 0xa0021098 _REC_S1VAL_20_u2 16383.75 _CNV_A_R_ENSD_LINEA_24_CM 0. 16383.75 FORMAT "%8.2" /end CHARACTERISTIC
/begin CHARACTERISTIC Cxx_amp_inj_cut_dly "Time after the recognition of the cut of inj for the diagnosis of Vxx_spg and the updating Vxx_amp" VALUE 0xa002109a _REC_S1VAL_20_u2 65.535 _CNV_A_R_LINEAR_____58_CM 0. 65.535 FORMAT "%5.3" /end CHARACTERISTIC
/begin CHARACTERISTIC Cxx_amp_spg_dif_fac "Coefficient of loss of load between the throttle and the atmospheric pressure" VALUE 0xa002109c _REC_S1VAL_20_u2 3.999938e-002 _CNV_A_R_LINEAR_____193_CM 0. 3.999938e-002 FORMAT "%9.7" /end CHARACTERISTIC
/begin CHARACTERISTIC Cxx_dfdec_spg_chr "Turbocharger Pressure Sensor System detected failure counter decrement" VALUE 0xa002109e _REC_S1VAL_20_u2 65535. _CNV_A_R_ECME_LINEA_0_CM 0. 65535. FORMAT "%5.0" /end CHARACTERISTIC
/begin CHARACTERISTIC Cxx_dfdec_spg_oor "Turbocharger Pressure Sensor Out Of Range detected failure counter decrement" VALUE 0xa00210a0 _REC_S1VAL_20_u2 65535. _CNV_A_R_ECME_LINEA_0_CM 0. 65535. FORMAT "%5.0" /end CHARACTERISTIC
/begin CHARACTERISTIC Cxx_dfinc_spg_chr "Turbocharger Pressure Sensor System detected failure counter increment" VALUE 0xa00210a2 _REC_S1VAL_20_u2 65535. _CNV_A_R_ECME_LINEA_0_CM 0. 65535. FORMAT "%5.0" /end CHARACTERISTIC
/begin CHARACTERISTIC Cxx_dfinc_spg_oor "Turbocharger Pressure Sensor Out Of Range detected failure counter increment" VALUE 0xa00210a4 _REC_S1VAL_20_u2 65535. _CNV_A_R_ECME_LINEA_0_CM 0. 65535. FORMAT "%5.0" /end CHARACTERISTIC
/begin CHARACTERISTIC Cxx_esti_tqe_fil_ftc "Filtering time constant estimated effective engine torque" VALUE 0xa00210c7 _REC_S1VAL_20_u1 25.5 _CNV_A_R_LINEAR_____4_CM 0. 25.5 FORMAT "%4.1" /end CHARACTERISTIC
/begin CHARACTERISTIC Cxx_fil_it_psn_dif_thd "Thd of Vxx_fil_it_psn_dif above which we forbid learning of Vxx_amp and the diagnosis of Vxx_spg" VALUE 0xa00210a6 _REC_S1VAL_20_u2 100. _CNV_A_R_LINEAR_____94_CM 0. 100. FORMAT "%6.2" /end CHARACTERISTIC
/begin CHARACTERISTIC Cxx_it_psn_cge_fil_ftc "Factor of filtering of Vxx_it_rel_psn" VALUE 0xa00210a8 _REC_S1VAL_20_u2 65.535 _CNV_A_R_LINEAR_____58_CM 0. 65.535 FORMAT "%5.3" /end CHARACTERISTIC
/begin CHARACTERISTIC Cxx_it_psn_dif_thd "Thd of Vxx_it_rel_psn above which we forbid learning of Vxx_amp and the diagnosis of Vxx_spg" VALUE 0xa00210aa _REC_S1VAL_20_u2 100. _CNV_A_R_LINEAR_____94_CM 0. 100. FORMAT "%6.2" /end CHARACTERISTIC
/begin CHARACTERISTIC Cxx_max_amp "maximum threshold of Atmospheric pressure" VALUE 0xa00210ac _REC_S1VAL_20_u2 20000. _CNV_A_R_LINEAR_____57_CM 0. 20000. FORMAT "%5.0" /end CHARACTERISTIC
/begin CHARACTERISTIC Cxx_min_amp "minimum threshold of Atmospheric pressure" VALUE 0xa00210ae _REC_S1VAL_20_u2 20000. _CNV_A_R_LINEAR_____57_CM 0. 20000. FORMAT "%5.0" /end CHARACTERISTIC
/begin CHARACTERISTIC Cxx_spg_chr_diag_dly "Time after an intersystem torque request to authorize the diagnosis of the turbocharger pressure system" VALUE 0xa00210b0 _REC_S1VAL_20_u2 65.535 _CNV_A_R_LINEAR_____58_CM 0. 65.535 FORMAT "%5.3" /end CHARACTERISTIC
/begin CHARACTERISTIC Cxx_spg_diag_dsb "Threshold of Vxx_amp to forbid the diagnosis of Vxx_spg" VALUE 0xa00210b2 _REC_S1VAL_20_u2 20000. _CNV_A_R_LINEAR_____57_CM 0. 20000. FORMAT "%5.0" /end CHARACTERISTIC
/begin CHARACTERISTIC Cxx_spg_diag_max_mat "maximum threshold of Vxx_mat to forbid the diagnosis of Vxx_spg" VALUE 0xa00210b4 _REC_S1VAL_20_u2 240. _CNV_A_R_LINEAR_____54_CM -40. 200. FORMAT "%5.1" /end CHARACTERISTIC
/begin CHARACTERISTIC Cxx_spg_diag_min_mat "minimum threshold of Vxx_mat to forbid the diagnosis of Vxx_spg" VALUE 0xa00210b6 _REC_S1VAL_20_u2 240. _CNV_A_R_LINEAR_____54_CM -40. 200. FORMAT "%5.1" /end CHARACTERISTIC
/begin CHARACTERISTIC Cxx_spg_fail_l_thd "Value of Vxx_spg below which we declare a breakdown pressure sensor, stopped engine." VALUE 0xa00210b8 _REC_S1VAL_20_u2 20000. _CNV_A_R_LINEAR_____57_CM 0. 20000. FORMAT "%5.0" /end CHARACTERISTIC
/begin CHARACTERISTIC Cxx_spg_fail_up_thd "Value of Vxx_spg upper which we declare a breakdown pressure sensor, stopped engine." VALUE 0xa00210ba _REC_S1VAL_20_u2 20000. _CNV_A_R_LINEAR_____57_CM 0. 20000. FORMAT "%5.0" /end CHARACTERISTIC
/begin CHARACTERISTIC Cxx_spg_fail_val "Defaut value for boost pressure" VALUE 0xa00210bc _REC_S1VAL_20_u2 20000. _CNV_A_R_LINEAR_____57_CM 0. 20000. FORMAT "%5.0" /end CHARACTERISTIC
/begin CHARACTERISTIC Cxx_spg_min "Value of Vxx_spg below which we declare a breakdown sensor." VALUE 0xa00210be _REC_S1VAL_20_u2 20000. _CNV_A_R_LINEAR_____57_CM 0. 20000. FORMAT "%5.0" /end CHARACTERISTIC
/begin CHARACTERISTIC Cxx_spg_n_thd "Engine speed below which we don't diagnose the coherence of the Vxx_spg" VALUE 0xa00210c0 _REC_S1VAL_20_u2 16383.75 _CNV_A_R_ENSD_LINEA_24_CM 0. 16383.75 FORMAT "%8.2" /end CHARACTERISTIC
/begin CHARACTERISTIC Cxx_stab_spg_dif_thd "Absolved max value  between 2 acquisitions of pressure stopped engine for the diagnosis" VALUE 0xa00210c2 _REC_S1VAL_20_u2 20000. _CNV_A_R_LINEAR_____57_CM 0. 20000. FORMAT "%5.0" /end CHARACTERISTIC
/begin CHARACTERISTIC Cxx_tq_stab_thd "Threshold of stability in couple for boost pressure system diagnosis, driven engine" VALUE 0xa00210c4 _REC_S1VAL_20_u2 2047.96875 _CNV_A_R_LINEAR_____123_CM 0. 2047.96875 FORMAT "%10.5" /end CHARACTERISTIC
/begin MEASUREMENT Vsx_sens_map_vld "Manifold pressure from sensor validity status" UBYTE _CNV_A_R_ECME_LINEA_0_CM 1 0. 0. 2. ECU_ADDRESS 0xd0004a6e FORMAT "%1.0" /end MEASUREMENT
/begin MEASUREMENT Vxx_sens_map "Manifold pressure from sensor" UWORD _CNV_A_R_LINEAR_____57_CM 1 0. 0. 20000. ECU_ADDRESS 0xd00032a8 FORMAT "%5.0" /end MEASUREMENT
/begin CHARACTERISTIC Cxx_dfdec_sens_map_h "Manifold pressure sensor high signal detected failure counter decrement" VALUE 0xa0021c00 _REC_S1VAL_20_u2 65535. _CNV_A_R_ECME_LINEA_0_CM 0. 65535. FORMAT "%5.0" /end CHARACTERISTIC
/begin CHARACTERISTIC Cxx_dfdec_sens_map_l "Manifold pressure sensor low signal to ground detected failure counter decrement" VALUE 0xa0021c02 _REC_S1VAL_20_u2 65535. _CNV_A_R_ECME_LINEA_0_CM 0. 65535. FORMAT "%5.0" /end CHARACTERISTIC
/begin CHARACTERISTIC Cxx_dfinc_sens_map_h "Manifold pressure sensor high signal detected failure counter increment" VALUE 0xa0021c04 _REC_S1VAL_20_u2 65535. _CNV_A_R_ECME_LINEA_0_CM 0. 65535. FORMAT "%5.0" /end CHARACTERISTIC
/begin CHARACTERISTIC Cxx_dfinc_sens_map_l "Manifold pressure sensor low signal to ground detected failure counter increment" VALUE 0xa0021c06 _REC_S1VAL_20_u2 65535. _CNV_A_R_ECME_LINEA_0_CM 0. 65535. FORMAT "%5.0" /end CHARACTERISTIC
/begin AXIS_PTS Ntb_n_amp_map_dif "9 equidistant points [800; 1312; 1824; 2336; 2848; 3360; 3872; 4384; 4896]" 0xa002be1c Vxx_n _REC_A2AXS_20_u2 16383.75 _CNV_A_R_ENSD_LINEA_24_CM 9 0. 16383.75 READ_ONLY FORMAT "%8.2" /end AXIS_PTS
/begin AXIS_PTS Ntb_n_kd_it_psn_thd "9 equidistant points [1280; 1536; 1792; 2048; 2304; 2560; 2816; 3072; 3328]" 0xa002be30 Vxx_n _REC_A2AXS_20_u2 16383.75 _CNV_A_R_ENSD_LINEA_24_CM 9 0. 16383.75 READ_ONLY FORMAT "%8.2" /end AXIS_PTS
/begin CHARACTERISTIC Ctp_n_amp_map_dif "Difference between the atmospheric pressure and the manifold pressure in full load" CURVE 0xa002be44 _REC_A1CUR_20_u2_u2 20000. _CNV_A_R_LINEAR_____57_CM 0. 20000. FORMAT "%5.0"
 /begin AXIS_DESCR COM_AXIS Vxx_n _CNV_A_R_ENSD_LINEA_24_CM 9 0. 16383.75 READ_ONLY FORMAT "%8.2" AXIS_PTS_REF Ntb_n_amp_map_dif /end AXIS_DESCR
/end CHARACTERISTIC
/begin CHARACTERISTIC Ctp_n_kd_it_psn_thd "threshold of the throttle for atmospheric pressure recognition" CURVE 0xa002be58 _REC_A1CUR_20_u2_u2 100. _CNV_A_R_LINEAR_____99_CM 0. 100. FORMAT "%6.2"
 /begin AXIS_DESCR COM_AXIS Vxx_n _CNV_A_R_ENSD_LINEA_24_CM 9 0. 16383.75 READ_ONLY FORMAT "%8.2" AXIS_PTS_REF Ntb_n_kd_it_psn_thd /end AXIS_DESCR
/end CHARACTERISTIC
/begin MEASUREMENT Vbx_amp_ad_kd_it "Full opening throttle recognized for the updating of the atmospheric pressure" UBYTE _CNV_S_2_RANGE______3_CM 1 0. 0. 1. ECU_ADDRESS 0xd0004d74 BIT_MASK 0x1 /end MEASUREMENT
/begin MEASUREMENT Vbx_amp_eng_run "Atmospheric learning strategy for running engine is activated" UBYTE _CNV_S_2_RANGE______3_CM 1 0. 0. 1. ECU_ADDRESS 0xd0004d75 BIT_MASK 0x1 /end MEASUREMENT
/begin MEASUREMENT Vbx_amp_eng_stop "Atmospheric learning strategy for the stopped engine is activated" UBYTE _CNV_S_2_RANGE______3_CM 1 0. 0. 1. ECU_ADDRESS 0xd0004d76 BIT_MASK 0x1 /end MEASUREMENT
/begin MEASUREMENT Vbx_amp_map_fil_ena "Manifold pressure filter is activated for atmospheric pressure learning" UBYTE _CNV_S_2_RANGE______3_CM 1 0. 0. 1. ECU_ADDRESS 0xd0004d77 BIT_MASK 0x1 /end MEASUREMENT
/begin MEASUREMENT Vbx_amp_mem_run_eng "Engine has already run since last wake-up or reset." UBYTE _CNV_S_2_RANGE______3_CM 1 0. 0. 1. ECU_ADDRESS 0xd0004d78 BIT_MASK 0x1 /end MEASUREMENT
/begin MEASUREMENT Vbx_amp_upd "Atmospheric pressure updating condition" UBYTE _CNV_S_2_RANGE______3_CM 1 0. 0. 1. ECU_ADDRESS 0xd0004d79 BIT_MASK 0x1 /end MEASUREMENT
/begin MEASUREMENT Vsx_amp_vld "Atmospheric pressure validity status" UBYTE _CNV_A_R_ECME_LINEA_0_CM 1 0. 0. 3. ECU_ADDRESS 0xd0004d7a FORMAT "%1.0" /end MEASUREMENT
/begin MEASUREMENT Vxx_amp_map "Filtered manifold pressure for atmospheric pressure learning" UWORD _CNV_A_R_LINEAR_____197_CM 1 0. 0. 2047.96875 ECU_ADDRESS 0xd00032b2 FORMAT "%10.5" /end MEASUREMENT
/begin MEASUREMENT Vxx_fil_amp "Filtered atmospheric pressure" UWORD _CNV_A_R_LINEAR_____197_CM 1 0. 0. 2047.96875 ECU_ADDRESS 0xd00032b4 FORMAT "%10.5" /end MEASUREMENT
/begin MEASUREMENT Vxx_fil_map_spg_dif1 "Internal filtered value of difference between supercharger pressure and manifold pressure" SWORD _CNV_A_R_LINEAR_____198_CM 1 0. -128. 127.99609375 ECU_ADDRESS 0xd00032b6 FORMAT "%11.6" /end MEASUREMENT
/begin MEASUREMENT Vxx_raw_amp "Raw atmospheric pressure" UWORD _CNV_A_R_LINEAR_____57_CM 1 0. 0. 20000. ECU_ADDRESS 0xd00032b8 FORMAT "%5.0" /end MEASUREMENT
/begin MEASUREMENT Vxx_stal_dly "Temporising using to filter engine stalling." UWORD _CNV_A_R_LINEAR_____34_CM 1 0. 0. 655.35 ECU_ADDRESS 0xd00032ba FORMAT "%6.2" /end MEASUREMENT
/begin CHARACTERISTIC Cxx_amp_dft_val "Value by default of the atmospheric pressure in case of breakdown of the pressure sensor" VALUE 0xa00208f6 _REC_S1VAL_20_u2 20000. _CNV_A_R_LINEAR_____57_CM 0. 20000. FORMAT "%5.0" /end CHARACTERISTIC
/begin CHARACTERISTIC Cxx_amp_eprm_h_thd "Upper threshold for testing the eeprom readed Amp value" VALUE 0xa00208f8 _REC_S1VAL_20_u2 20000. _CNV_A_R_LINEAR_____57_CM 0. 20000. FORMAT "%5.0" /end CHARACTERISTIC
/begin CHARACTERISTIC Cxx_amp_eprm_l_thd "Lower threshold for testing the eeprom readed Amp value" VALUE 0xa00208fa _REC_S1VAL_20_u2 20000. _CNV_A_R_LINEAR_____57_CM 0. 20000. FORMAT "%5.0" /end CHARACTERISTIC
/begin CHARACTERISTIC Cxx_amp_kd_dly "Tuning time between the kick down and the atmospheric pressure computation" VALUE 0xa00208fc _REC_S1VAL_20_u2 65.535 _CNV_A_R_LINEAR_____58_CM 0. 65.535 FORMAT "%5.3" /end CHARACTERISTIC
/begin CHARACTERISTIC Cxx_amp_map_cge_n_thd "Threshold of Vxx_n above which we forbid the update of the atmospheric pressure" VALUE 0xa00208fe _REC_S1VAL_20_u2 16383.75 _CNV_A_R_ENSD_LINEA_24_CM 0. 16383.75 FORMAT "%8.2" /end CHARACTERISTIC
/begin CHARACTERISTIC Cxx_amp_map_fil_fac "Filter factor for manifold pressure in atmospheric learning strategy" VALUE 0xa002090a _REC_S1VAL_20_u1 0.99609375 _CNV_A_R_LINEAR_____31_CM 0. 0.99609375 FORMAT "%10.8" /end CHARACTERISTIC
/begin CHARACTERISTIC Cxx_amp_spg_fil_fac "Filter factor for supercharger sensor in atmospheric learning strategy" VALUE 0xa002090b _REC_S1VAL_20_u1 0.99609375 _CNV_A_R_LINEAR_____31_CM 0. 0.99609375 FORMAT "%10.8" /end CHARACTERISTIC
/begin CHARACTERISTIC Cxx_max_map_spg_dif "Maximal value between Vxx_map and Vxx_spg (in absolute value)." VALUE 0xa0020900 _REC_S1VAL_20_u2 20000. _CNV_A_R_LINEAR_____57_CM 0. 20000. FORMAT "%5.0" /end CHARACTERISTIC
/begin CHARACTERISTIC Cxx_n_kd_it_psn_hys "hysteresis of the threshold of the throttle for atmospheric pressure recognition" VALUE 0xa0020902 _REC_S1VAL_20_u2 100. _CNV_A_R_LINEAR_____99_CM 0. 100. FORMAT "%6.2" /end CHARACTERISTIC
/begin CHARACTERISTIC Cxx_sens_dif_amp_map_thd "Stability threshold on manifold pressure to learn atmospheric pressure while engine stopped." VALUE 0xa0020904 _REC_S1VAL_20_u2 20000. _CNV_A_R_LINEAR_____57_CM 0. 20000. FORMAT "%5.0" /end CHARACTERISTIC
/begin CHARACTERISTIC Cxx_sens_dif_amp_spg_thd "Stability threshold for the interdiction of the learning of the difference between pressure sensors while engine stopped (atmospheric" VALUE 0xa0020906 _REC_S1VAL_20_u2 20000. _CNV_A_R_LINEAR_____57_CM 0. 20000. FORMAT "%5.0" /end CHARACTERISTIC
/begin CHARACTERISTIC Cxx_stal_dly "Temporising using to filter engine stalling." VALUE 0xa0020908 _REC_S1VAL_20_u2 655.35 _CNV_A_R_LINEAR_____34_CM 0. 655.35 FORMAT "%6.2" /end CHARACTERISTIC
/begin AXIS_PTS Ctb_prs "" 0xa0028dac Vxx_map _REC_A2AXS_20_u2 20000. _CNV_A_R_LINEAR_____57_CM 17 0. 20000. FORMAT "%5.0" /end AXIS_PTS
/begin AXIS_PTS Ctb_prs2 "9 programmable pressure breakpoint table" 0xa0028dd0 Vxx_map _REC_A2AXS_20_u2 20000. _CNV_A_R_LINEAR_____57_CM 9 0. 20000. FORMAT "%5.0" /end AXIS_PTS
/begin MEASUREMENT Vxb_map.factor "" UWORD _CNV_A_R_A_165_CM 1 0. 0. 65535. ECU_ADDRESS 0xd000458a /end MEASUREMENT
/begin MEASUREMENT Vxb_map.index "" UBYTE _CNV_A_R_A_165_CM 1 0. 0. 255. ECU_ADDRESS 0xd000458c /end MEASUREMENT
/begin MEASUREMENT Vxb_map.num_dp "" UBYTE _CNV_A_R_A_165_CM 1 0. 0. 255. ECU_ADDRESS 0xd000458d /end MEASUREMENT
/begin MEASUREMENT Vxb_map2.factor "" UWORD _CNV_A_R_A_165_CM 1 0. 0. 65535. ECU_ADDRESS 0xd000458e /end MEASUREMENT
/begin MEASUREMENT Vxb_map2.index "" UBYTE _CNV_A_R_A_165_CM 1 0. 0. 255. ECU_ADDRESS 0xd0004590 /end MEASUREMENT
/begin MEASUREMENT Vxb_map2.num_dp "" UBYTE _CNV_A_R_A_165_CM 1 0. 0. 255. ECU_ADDRESS 0xd0004591 /end MEASUREMENT
/begin MEASUREMENT Vbx_df_map_chr "Manifold Absolute Pressure Incoherency, not plausible detected failure" UBYTE _CNV_S_2_RANGE______3_CM 1 0. 0. 1. ECU_ADDRESS 0xd0004594 BIT_MASK 0x1 /end MEASUREMENT
/begin MEASUREMENT Vbx_df_map_oor "Manifold Absolute Pressure Abnormal Voltage detected failure" UBYTE _CNV_S_2_RANGE______3_CM 1 0. 0. 1. ECU_ADDRESS 0xd0004595 BIT_MASK 0x1 /end MEASUREMENT
/begin MEASUREMENT Vbx_diag_ena_map_chr "Manifold Absolute Pressure Incoherency diagnostic information available" UBYTE _CNV_S_2_RANGE______3_CM 1 0. 0. 1. ECU_ADDRESS 0xd0004596 BIT_MASK 0x1 /end MEASUREMENT
/begin MEASUREMENT Vbx_diag_ena_map_oor "Manifold Absolute Pressure Abnormal Voltage diagnostic information available" UBYTE _CNV_S_2_RANGE______3_CM 1 0. 0. 1. ECU_ADDRESS 0xd0004597 BIT_MASK 0x1 /end MEASUREMENT
/begin MEASUREMENT Vbx_map_chr_diag_run_dly_rst "Reset of the internal TDC counter for running coherency check on MAP" UBYTE _CNV_S_2_RANGE______3_CM 1 0. 0. 1. ECU_ADDRESS 0xd0004598 BIT_MASK 0x1 /end MEASUREMENT
/begin MEASUREMENT Vbx_map_chr_diag_run_ena "Running coherency considered as present since a specific number of TDC. Present coherency failure" UBYTE _CNV_S_2_RANGE______3_CM 1 0. 0. 1. ECU_ADDRESS 0xd0004599 BIT_MASK 0x1 /end MEASUREMENT
/begin MEASUREMENT Vbx_map_diag_oor "raw running coherency default, not yet considered as present" UBYTE _CNV_S_2_RANGE______3_CM 1 0. 0. 1. ECU_ADDRESS 0xd000459a BIT_MASK 0x1 /end MEASUREMENT
/begin MEASUREMENT Vsx_map_vld "Manifold pressure validity status" UBYTE _CNV_A_R_ECME_LINEA_0_CM 1 0. 0. 2. ECU_ADDRESS 0xd0004592 FORMAT "%1.0" /end MEASUREMENT
/begin MEASUREMENT Vxx_map "Manifold pressure value " UWORD _CNV_A_R_LINEAR_____57_CM 1 0. 0. 20000. ECU_ADDRESS 0xd0002df2 FORMAT "%5.0" /end MEASUREMENT
/begin MEASUREMENT Vxx_map_chr_diag_run_dly "Internal TDC counter for coherency check on map" UBYTE _CNV_A_R_LINEAR_____55_CM 1 0. 0. 255. ECU_ADDRESS 0xd0004593 FORMAT "%3.0" /end MEASUREMENT
/begin MEASUREMENT Vxx_map_fil "Intake manifold filtered pressure " UWORD _CNV_A_R_LINEAR_____57_CM 1 0. 0. 20000. ECU_ADDRESS 0xd0002df4 FORMAT "%5.0" /end MEASUREMENT
/begin CHARACTERISTIC Cxx_dfdec_map_chr "Manifold Absolute Pressure Incoherency detected failure counter decrement" VALUE 0xa0021678 _REC_S1VAL_20_u2 65535. _CNV_A_R_ECME_LINEA_0_CM 0. 65535. FORMAT "%5.0" /end CHARACTERISTIC
/begin CHARACTERISTIC Cxx_dfdec_map_oor "Manifold Absolute Pressure Abnormal Voltage detected failure counter decrement" VALUE 0xa002167a _REC_S1VAL_20_u2 65535. _CNV_A_R_ECME_LINEA_0_CM 0. 65535. FORMAT "%5.0" /end CHARACTERISTIC
/begin CHARACTERISTIC Cxx_dfdec_map_oor_run "Manifold Air Pressure out of range detected failure counter decrement engine running" VALUE 0xa002167c _REC_S1VAL_20_u2 65535. _CNV_A_R_ECME_LINEA_0_CM 0. 65535. FORMAT "%5.0" /end CHARACTERISTIC
/begin CHARACTERISTIC Cxx_dfinc_map_chr "Manifold Absolute Pressure Incoherency detected failure counter increment" VALUE 0xa002167e _REC_S1VAL_20_u2 65535. _CNV_A_R_ECME_LINEA_0_CM 0. 65535. FORMAT "%5.0" /end CHARACTERISTIC
/begin CHARACTERISTIC Cxx_dfinc_map_oor "Manifold Absolute Pressure Abnormal Voltage detected failure counter increment" VALUE 0xa0021680 _REC_S1VAL_20_u2 65535. _CNV_A_R_ECME_LINEA_0_CM 0. 65535. FORMAT "%5.0" /end CHARACTERISTIC
/begin CHARACTERISTIC Cxx_dfinc_map_oor_run "Manifold Air Pressure out of range detected failure counter increment engine running" VALUE 0xa0021682 _REC_S1VAL_20_u2 65535. _CNV_A_R_ECME_LINEA_0_CM 0. 65535. FORMAT "%5.0" /end CHARACTERISTIC
/begin CHARACTERISTIC Cxx_dif_sens_esti_map_err "Difference between Vxx_sens_map and Vxx_mdl_map  for declare a failure" VALUE 0xa0021684 _REC_S1VAL_20_u2 20000. _CNV_A_R_LINEAR_____57_CM 0. 20000. FORMAT "%5.0" /end CHARACTERISTIC
/begin CHARACTERISTIC Cxx_map_fil_ftc "Filtering time constant for Vxx_map_fil" VALUE 0xa0021686 _REC_S1VAL_20_u2 65.535 _CNV_A_R_LINEAR_____58_CM 0. 65.535 /end CHARACTERISTIC
/begin CHARACTERISTIC Cxx_min_n_test_acq "regime en dessous duquel on ne teste pas la coherence des acquisitions." VALUE 0xa0021688 _REC_S1VAL_20_u2 16383.75 _CNV_A_R_ENSD_LINEA_24_CM 0. 16383.75 FORMAT "%8.2" /end CHARACTERISTIC
/begin CHARACTERISTIC Cxx_nr_tdc_dif_prs_fail "Number of TDC to confirm consider the coherency default on map as present" VALUE 0xa0021696 _REC_S1VAL_20_u1 255. _CNV_A_R_LINEAR_____55_CM 0. 255. FORMAT "%3.0" /end CHARACTERISTIC
/begin CHARACTERISTIC Cxx_rel_it_prs_thd_h_err "Threshold on throttle position to consider an out of range positive default" VALUE 0xa002168a _REC_S1VAL_20_u2 100. _CNV_A_R_LINEAR_____99_CM 0. 100. FORMAT "%6.2" /end CHARACTERISTIC
/begin CHARACTERISTIC Cxx_sens_map_max_dif_val "Maximum pressure difference between two consecutive acquisition to enable stopped engine oor test" VALUE 0xa002168c _REC_S1VAL_20_u2 20000. _CNV_A_R_LINEAR_____57_CM 0. 20000. FORMAT "%5.0" /end CHARACTERISTIC
/begin CHARACTERISTIC Cxx_sens_map_run_eng_h_thd "Maximum threshold for out of range manifold air pressure testing" VALUE 0xa002168e _REC_S1VAL_20_u2 20000. _CNV_A_R_LINEAR_____57_CM 0. 20000. FORMAT "%5.0" /end CHARACTERISTIC
/begin CHARACTERISTIC Cxx_sens_map_run_eng_l_thd "Minimum threshold for out of range manifold air pressure testing" VALUE 0xa0021690 _REC_S1VAL_20_u2 20000. _CNV_A_R_LINEAR_____57_CM 0. 20000. FORMAT "%5.0" /end CHARACTERISTIC
/begin CHARACTERISTIC Cxx_sens_map_stop_eng_h_thd "Maximum manifold pressure value for stopped engine oor test" VALUE 0xa0021692 _REC_S1VAL_20_u2 20000. _CNV_A_R_LINEAR_____57_CM 0. 20000. FORMAT "%5.0" /end CHARACTERISTIC
/begin CHARACTERISTIC Cxx_sens_map_stop_eng_l_thd "Minimum manifold pressure value for stopped engine oor test" VALUE 0xa0021694 _REC_S1VAL_20_u2 20000. _CNV_A_R_LINEAR_____57_CM 0. 20000. FORMAT "%5.0" /end CHARACTERISTIC
/begin AXIS_PTS Ctb_pred_map_prs_rat "Breakpoints on Pcol/Pamont variable to get BarrÈ St Venant definition" 0xa00261b4 Vxx_raw_mdl_map_spg_rat _REC_A2AXS_20_u2 1.99996948242188 _CNV_A_R_LINEAR_____49_CM 10 0. 1.99996948242188 FORMAT "%7.5" /end AXIS_PTS
/begin AXIS_PTS Ctb_psi_fac_cor "breakpoints on (x/fbsv(x))-1 function" 0xa00261cc Vxx_temp2[0] _REC_A2AXS_20_u2 16383.75 _CNV_A_R_LINEAR_____199_CM 17 0. 16383.75 FORMAT "%8.2" /end AXIS_PTS
/begin CHARACTERISTIC Ctd_ofs_psi_fac "zero ordinate of the segment of BarrÈ St Venant function (function of Pcol/Pamont)" CURVE 0xa00261f0 _REC_A1CUR_20_u2_u2 0.99998474 _CNV_A_R_LINEAR_____200_CM 0. 0.99998474 FORMAT "%10.8"
 /begin AXIS_DESCR COM_AXIS Vxx_raw_mdl_map_spg_rat _CNV_A_R_LINEAR_____49_CM 10 0. 1.99996948242188 FORMAT "%7.5" AXIS_PTS_REF Ctb_pred_map_prs_rat /end AXIS_DESCR
/end CHARACTERISTIC
/begin CHARACTERISTIC Ctd_slop_psi_fac "slope of the segment of BarrÈ St Venant function (function de Pcol/Pamont)" CURVE 0xa0026204 _REC_A1CUR_20_u2_u2 0.9999847412109381 _CNV_A_R_LINEAR_____201_CM -0.9999847412109381 0. FORMAT "%10.8"
 /begin AXIS_DESCR COM_AXIS Vxx_raw_mdl_map_spg_rat _CNV_A_R_LINEAR_____49_CM 10 0. 1.99996948242188 FORMAT "%7.5" AXIS_PTS_REF Ctb_pred_map_prs_rat /end AXIS_DESCR
/end CHARACTERISTIC
/begin CHARACTERISTIC Ctp_ftc_mdl_map "Table of filter time constant for the modelled manifold pressure" CURVE 0xa0026218 _REC_A1CUR_20_u2_u2 65.535 _CNV_A_R_LINEAR_____58_CM 0. 65.535 FORMAT "%5.3"
 /begin AXIS_DESCR COM_AXIS Vxx_n _CNV_A_R_ENSD_LINEA_24_CM 20 0. 16383.75 FORMAT "%8.2" AXIS_PTS_REF Ctb_n /end AXIS_DESCR
/end CHARACTERISTIC
/begin CHARACTERISTIC Ctp_pred_map_prs_rat "x value of (x/fbsv(x))-1 function" CURVE 0xa0026240 _REC_A1CUR_20_u2_u2 0.99998474 _CNV_A_R_LINEAR_____202_CM 0. 0.99998474 FORMAT "%10.8"
 /begin AXIS_DESCR COM_AXIS Vxx_temp2[0] _CNV_A_R_LINEAR_____199_CM 17 0. 16383.75 FORMAT "%8.2" AXIS_PTS_REF Ctb_psi_fac_cor /end AXIS_DESCR
/end CHARACTERISTIC
/begin MEASUREMENT Vbx_pred_map_psi_fac_cor "activation boolean for correction of BarrÈ St Venant function" UBYTE _CNV_S_2_RANGE______3_CM 1 0. 0. 1. ECU_ADDRESS 0xd00047d8 BIT_MASK 0x1 /end MEASUREMENT
/begin MEASUREMENT Vsx_mdl_map_vld "Manifold pressure from model validity status" UBYTE _CNV_S_3_STATUS_OK__120_CM 1 0. 0. 2. ECU_ADDRESS 0xd00047d9 /end MEASUREMENT
/begin MEASUREMENT Vxx_fil_pred_map_efv_it_ar "effective throttle area filtered" UWORD _CNV_A_R_LINEAR_____95_CM 1 0. 0. 3.90619e-003 ECU_ADDRESS 0xd0003b04 FORMAT "%11.9" /end MEASUREMENT
/begin MEASUREMENT Vxx_fill_efy_n_mpl "product (volumetric efficiency X engine speed)" UWORD _CNV_A_R_ENSD_LINEA_24_CM 1 0. 0. 16383.75 ECU_ADDRESS 0xd0003b06 FORMAT "%8.2" /end MEASUREMENT
/begin MEASUREMENT Vxx_mdl_map "Manifold pressure value from model" UWORD _CNV_A_R_LINEAR_____57_CM 1 0. 0. 20000. ECU_ADDRESS 0xd0003b08 FORMAT "%5.0" /end MEASUREMENT
/begin MEASUREMENT Vxx_mdl_map_fac_1 "Internal constant factor 1 for modelled manifold pressure" UWORD _CNV_A_R_LINEAR_____203_CM 1 0. 5000000. 44999389.648438 ECU_ADDRESS 0xd0005b58 FORMAT "%15.5" /end MEASUREMENT
/begin MEASUREMENT Vxx_mdl_map_fac_2 "Internal constant factor 2 for modelled manifold pressure" UWORD _CNV_A_R_LINEAR_____204_CM 1 0. 0. 599990.8447 ECU_ADDRESS 0xd0005b5a FORMAT "%11.5" /end MEASUREMENT
/begin MEASUREMENT Vxx_mdl_map_fil "Manifold pressure value from model filtered value" UWORD _CNV_A_R_LINEAR_____57_CM 1 0. 0. 20000. ECU_ADDRESS 0xd0003b0a FORMAT "%5.0" /end MEASUREMENT
/begin MEASUREMENT Vxx_mdl_map_spg_rat "ratio (modelled manifold pressure / up stream pressure)" UWORD _CNV_A_R_LINEAR_____202_CM 1 0. 0. 0.99998474 ECU_ADDRESS 0xd0003b0c FORMAT "%10.8" /end MEASUREMENT
/begin MEASUREMENT Vxx_mfld_fil_fac "filter constant of manifold model" UWORD _CNV_A_R_LINEAR_____205_CM 1 0. 0. 511.99 ECU_ADDRESS 0xd0003b0e FORMAT "%11.7" /end MEASUREMENT
/begin MEASUREMENT Vxx_min_map_spg_rat "ratio (minimum manifold pressure / up stream pressure)" UWORD _CNV_A_R_LINEAR_____206_CM 1 0. 0. 0.49999237 ECU_ADDRESS 0xd0003b10 FORMAT "%10.8" /end MEASUREMENT
/begin MEASUREMENT Vxx_pred_map_cp_maf_fac "canister scaling factor between engine and throttle mass air flow for manifold model" UWORD _CNV_A_R_LINEAR_____207_CM 1 0. 0. 4095.9375 ECU_ADDRESS 0xd0003b12 FORMAT "%9.4" /end MEASUREMENT
/begin MEASUREMENT Vxx_pred_map_cp_psi_fac "Canister BarrÈ St Venant factor (used in throttle mass air flow calculation)" UWORD _CNV_A_R_LINEAR_____208_CM 1 0. 0. 6.24990463256836e-002 ECU_ADDRESS 0xd0003b14 FORMAT "%10.8" /end MEASUREMENT
/begin MEASUREMENT Vxx_pred_map_cp_psi_fac_ofs "canister purge zero ordinate of the segment of BarrÈ St Venant function (function of Pcol/Pamont)" UWORD _CNV_A_R_LINEAR_____200_CM 1 0. 0. 0.99998474 ECU_ADDRESS 0xd0003b16 FORMAT "%10.8" /end MEASUREMENT
/begin MEASUREMENT Vxx_pred_map_cp_psi_fac_slop "canister purge slope of the segment of BarrÈ St Venant function (function of Pcol/Pamont)" UWORD _CNV_A_R_LINEAR_____201_CM 1 0. -0.9999847412109381 0. ECU_ADDRESS 0xd0003b18 FORMAT "%10.8" /end MEASUREMENT
/begin MEASUREMENT Vxx_pred_map_it_maf_fac "Scaling factor between engine and throttle mass air flow for manifold model" UWORD _CNV_A_R_LINEAR_____207_CM 1 0. 0. 4095.9375 ECU_ADDRESS 0xd0003b1a FORMAT "%9.4" /end MEASUREMENT
/begin MEASUREMENT Vxx_pred_map_mdl_eng_maf "Modelled engine air mass flow" UWORD _CNV_A_R_LINEAR_____109_CM 1 0. 0. 3000. ECU_ADDRESS 0xd0003b1c FORMAT "%4.3" /end MEASUREMENT
/begin MEASUREMENT Vxx_pred_map_mdl_it_maf "Modelled throttle air mass flow" UWORD _CNV_A_R_LINEAR_____109_CM 1 0. 0. 3000. ECU_ADDRESS 0xd0003b1e FORMAT "%4.3" /end MEASUREMENT
/begin MEASUREMENT Vxx_pred_map_psi_fac "Throttle BarrÈ St Venant factor (used in throttle mass air flow calculation)" UWORD _CNV_A_R_LINEAR_____208_CM 1 0. 0. 6.24990463256836e-002 ECU_ADDRESS 0xd0003b20 FORMAT "%10.8" /end MEASUREMENT
/begin MEASUREMENT Vxx_pred_map_psi_fac_ofs "zero ordinate of the segment of BarrÈ St Venant function (function of Pcol/Pamont)" UWORD _CNV_A_R_LINEAR_____200_CM 1 0. 0. 0.99998474 ECU_ADDRESS 0xd0003b22 FORMAT "%10.8" /end MEASUREMENT
/begin MEASUREMENT Vxx_pred_map_psi_fac_slop "slope of the segment of BarrÈ St Venant function (function of Pcol/Pamont)" UWORD _CNV_A_R_LINEAR_____201_CM 1 0. -0.9999847412109381 0. ECU_ADDRESS 0xd0003b24 FORMAT "%10.8" /end MEASUREMENT
/begin MEASUREMENT Vxx_raw_mdl_map "Raw modelled manifold pressure" UWORD _CNV_A_R_LINEAR_____57_CM 1 0. 0. 20000. ECU_ADDRESS 0xd0003b26 FORMAT "%5.0" /end MEASUREMENT
/begin MEASUREMENT Vxx_raw_mdl_map_spg_rat "rough value of modelled ratio (manifold pressure / up stream pressure) (before correction)" UWORD _CNV_A_R_LINEAR_____49_CM 1 0. 0. 1.99996948242188 ECU_ADDRESS 0xd0003b28 FORMAT "%7.5" /end MEASUREMENT
/begin MEASUREMENT Vxx_spg_amp_rat "Ratio between pressure before throttle and atmospheric pressure" UWORD _CNV_A_R_LINEAR_____209_CM 1 0. 0. 6.5535 ECU_ADDRESS 0xd0003b2a FORMAT "%6.4" /end MEASUREMENT
/begin MEASUREMENT Vxx_temp0[0] "Input vector 1" UWORD _CNV_A_R_LINEAR_____49_CM 1 0. 0. 1.99996948242188 ECU_ADDRESS 0xd0003b2c FORMAT "%7.5" /end MEASUREMENT
/begin MEASUREMENT Vxx_temp0[1] "Input vector 1" UWORD _CNV_A_R_LINEAR_____49_CM 1 0. 0. 1.99996948242188 ECU_ADDRESS 0xd0003b2e FORMAT "%7.5" /end MEASUREMENT
/begin MEASUREMENT Vxx_temp1[0] "Input vector 2" UWORD _CNV_A_R_LINEAR_____49_CM 1 0. 0. 1.99996948242188 ECU_ADDRESS 0xd0003b30 FORMAT "%7.5" /end MEASUREMENT
/begin MEASUREMENT Vxx_temp1[1] "Input vector 2" UWORD _CNV_A_R_LINEAR_____49_CM 1 0. 0. 1.99996948242188 ECU_ADDRESS 0xd0003b32 FORMAT "%7.5" /end MEASUREMENT
/begin MEASUREMENT Vxx_temp2[0] "Input vector 3" UWORD _CNV_A_R_LINEAR_____199_CM 1 0. 0. 16383.75 ECU_ADDRESS 0xd0003b34 FORMAT "%8.2" /end MEASUREMENT
/begin MEASUREMENT Vxx_temp2[1] "Input vector 3" UWORD _CNV_A_R_LINEAR_____199_CM 1 0. 0. 16383.75 ECU_ADDRESS 0xd0003b36 FORMAT "%8.2" /end MEASUREMENT
/begin CHARACTERISTIC Cxx_it_ar_max_slop "maximum slew rate of throttle effective area" VALUE 0xa002192e _REC_S1VAL_20_u2 3.90619e-003 _CNV_A_R_LINEAR_____95_CM 0. 3.90619e-003 FORMAT "%11.9" /end CHARACTERISTIC
/begin CHARACTERISTIC Cxx_last_bkp_prs_rat "before last breakpoint of BarrÈ St Venant definition : abscisse of the begining of correction" VALUE 0xa0021930 _REC_S1VAL_20_u2 1.99996948242188 _CNV_A_R_LINEAR_____49_CM 0. 1.99996948242188 FORMAT "%7.5" /end CHARACTERISTIC
/begin CHARACTERISTIC Cxx_map_mv_ftc "Filtering time constant for the modelled manifold pressure" VALUE 0xa0021932 _REC_S1VAL_20_u2 65.535 _CNV_A_R_LINEAR_____58_CM 0. 65.535 FORMAT "%5.3" /end CHARACTERISTIC
/begin CHARACTERISTIC Cxx_pred_map_max_prs_rat "maximmum of Pcol/Pamont ratio for getting in BarrÈ St Venant table" VALUE 0xa0021934 _REC_S1VAL_20_u2 1.99996948242188 _CNV_A_R_LINEAR_____49_CM 0. 1.99996948242188 FORMAT "%7.5" /end CHARACTERISTIC
/begin MEASUREMENT Vxx_acel_pdl_secu_ctr "Counter of accelerator pedal safety case detected failure N∞1" UBYTE _CNV_A_R_ECME_LINEA_0_CM 1 0. 0. 255. DISPLAY_IDENTIFIER InPciApi_NVM.Vxx_acel_pdl_secu_ctr_NVM ECU_ADDRESS 0xd0005530 FORMAT "%3.0" /end MEASUREMENT
/begin MEASUREMENT Vbx_acel_pdl_100_rat "Accel pedal depressed beyond 100% ratio" UBYTE _CNV_S_2_RANGE______3_CM 1 0. 0. 1. ECU_ADDRESS 0xd0004131 BIT_MASK 0x1 /end MEASUREMENT
/begin MEASUREMENT Vbx_acel_pdl_kd "accel pedal depressed beyond mechanical hard point (if no mechanical KD, flag remains inactive)" UBYTE _CNV_S_2_RANGE______3_CM 1 0. 0. 1. ECU_ADDRESS 0xd0004132 BIT_MASK 0x1 /end MEASUREMENT
/begin MEASUREMENT Vsx_acel_pdl_rat_vld "Normalised acelerator pedal position" UBYTE _CNV_S_3_STATUS_OK__120_CM 1 0. 0. 2. ECU_ADDRESS 0xd0004133 /end MEASUREMENT
/begin MEASUREMENT Vxx_acel_pdl_0_rat_v "Uref ratio value defining 0 pedal ratio position" UWORD _CNV_A_R_LINEAR_____210_CM 1 0. 0. 1. ECU_ADDRESS 0xd0003210 FORMAT "%9.7" /end MEASUREMENT
/begin MEASUREMENT Vxx_acel_pdl_100_rat_v "Uref ratio value defining 1 pedal ratio position" UWORD _CNV_A_R_LINEAR_____210_CM 1 0. 0. 1. ECU_ADDRESS 0xd0003212 FORMAT "%9.7" /end MEASUREMENT
/begin MEASUREMENT Vxx_acel_pdl_100_rat_v_max "Uref ratio value defining the activation of 100% pedal ratio flag" UWORD _CNV_A_R_LINEAR_____210_CM 1 0. 0. 1. ECU_ADDRESS 0xd0003214 FORMAT "%9.7" /end MEASUREMENT
/begin MEASUREMENT Vxx_acel_pdl_kd_in_thd "Uref ratio entry threshold for accelerato pedal kick-down detection" UWORD _CNV_A_R_LINEAR_____210_CM 1 0. 0. 1. ECU_ADDRESS 0xd0003216 FORMAT "%9.7" /end MEASUREMENT
/begin MEASUREMENT Vxx_acel_pdl_rat "Normalised accelerator pedal position" UWORD _CNV_A_R_LINEAR_____211_CM 1 0. 0. 1.25 ECU_ADDRESS 0xd0003218 FORMAT "%7.5" /end MEASUREMENT
/begin CHARACTERISTIC Cxx_acel_pdl_0_rat_v_nok "Uref ratio value defining 0 pedal ratio position if failure on track 1 and no failure on track 2" VALUE 0xa0021082 _REC_S1VAL_20_u2 1. _CNV_A_R_LINEAR_____210_CM 0. 1. FORMAT "%9.7" /end CHARACTERISTIC
/begin CHARACTERISTIC Cxx_acel_pdl_0_rat_v_ok "Uref ratio value defining 0 pedal ratio position when pedal sensor is in nominal operation (track 1)" VALUE 0xa0021084 _REC_S1VAL_20_u2 1. _CNV_A_R_LINEAR_____210_CM 0. 1. FORMAT "%9.7" /end CHARACTERISTIC
/begin CHARACTERISTIC Cxx_acel_pdl_100_rat_v_hys "Uref ratio hysteresis linked with 100% pedal ratio flag" VALUE 0xa0021086 _REC_S1VAL_20_u2 1. _CNV_A_R_LINEAR_____210_CM 0. 1. FORMAT "%9.7" /end CHARACTERISTIC
/begin CHARACTERISTIC Cxx_acel_pdl_100_rat_v_max_nok "Uref ratio maximum value defining 100% pedal ratio flag if failure on track 1 and no failure on track 2" VALUE 0xa0021088 _REC_S1VAL_20_u2 1. _CNV_A_R_LINEAR_____210_CM 0. 1. FORMAT "%9.7" /end CHARACTERISTIC
/begin CHARACTERISTIC Cxx_acel_pdl_100_rat_v_max_ok "Uref ratio maximum value defining 100% pedal ratio flag when pedal sensor is in nominal operation (track 1)" VALUE 0xa002108a _REC_S1VAL_20_u2 1. _CNV_A_R_LINEAR_____210_CM 0. 1. FORMAT "%9.7" /end CHARACTERISTIC
/begin CHARACTERISTIC Cxx_acel_pdl_100_rat_v_nok "Uref ratio value defining 100% pedal ratio position if failure on track 1 and no failure on track 2" VALUE 0xa002108c _REC_S1VAL_20_u2 1. _CNV_A_R_LINEAR_____210_CM 0. 1. FORMAT "%9.7" /end CHARACTERISTIC
/begin CHARACTERISTIC Cxx_acel_pdl_100_rat_v_ok "Uref ratio value defining 100% pedal ratio position when pedal sensor is in nominal operation (track 1)" VALUE 0xa002108e _REC_S1VAL_20_u2 1. _CNV_A_R_LINEAR_____210_CM 0. 1. FORMAT "%9.7" /end CHARACTERISTIC
/begin CHARACTERISTIC Cxx_acel_pdl_kd_hys "Uref ratio hysteresis linked with kick-down flag" VALUE 0xa0021090 _REC_S1VAL_20_u2 1. _CNV_A_R_LINEAR_____210_CM 0. 1. FORMAT "%9.7" /end CHARACTERISTIC
/begin CHARACTERISTIC Cxx_acel_pdl_kd_in_thd_nok "Uref ratio entry threshold to activate kick-down flag if failure on track 1 and no failure on track 2" VALUE 0xa0021092 _REC_S1VAL_20_u2 1. _CNV_A_R_LINEAR_____210_CM 0. 1. FORMAT "%9.7" /end CHARACTERISTIC
/begin CHARACTERISTIC Cxx_acel_pdl_kd_in_thd_ok "Uref ratio entry threshold to activate kick-down flag when pedal sensor is in nominal operation (track 1)" VALUE 0xa0021094 _REC_S1VAL_20_u2 1. _CNV_A_R_LINEAR_____210_CM 0. 1. FORMAT "%9.7" /end CHARACTERISTIC
/begin MEASUREMENT Vbx_acel_pdl_fil_sens_v1 "Accelerator pedal sensor track 1 evolution condition" UBYTE _CNV_S_2_RANGE______3_CM 1 0. 0. 1. ECU_ADDRESS 0xd0004f3b BIT_MASK 0x1 /end MEASUREMENT
/begin MEASUREMENT Vbx_acel_pdl_fil_sens_v2 "Accelerator pedal sensor track 1 evolution condition" UBYTE _CNV_S_2_RANGE______3_CM 1 0. 0. 1. ECU_ADDRESS 0xd0004f3c BIT_MASK 0x1 /end MEASUREMENT
/begin MEASUREMENT Vxx_acel_pdl_fil_sens_v1 "filtered accelerator pedal sensor output voltage: track 1" UWORD _CNV_A_R_LINEAR_____210_CM 1 0. 0. 1. ECU_ADDRESS 0xd000302a FORMAT "%9.7" /end MEASUREMENT
/begin MEASUREMENT Vxx_acel_pdl_fil_sens_v2 "filtered accelerator pedal sensor output voltage: track 2" UWORD _CNV_A_R_LINEAR_____210_CM 1 0. 0. 1. ECU_ADDRESS 0xd000302c FORMAT "%9.7" /end MEASUREMENT
/begin MEASUREMENT Vxx_acel_pdl_sens_rat1 "Accelerator pedal sensor output voltage ratio : track 1" UWORD _CNV_A_R_LINEAR_____210_CM 1 0. 0. 1. ECU_ADDRESS 0xd000302e FORMAT "%9.7" /end MEASUREMENT
/begin MEASUREMENT Vxx_acel_pdl_sens_rat2 "Accelerator pedal sensor output voltage ratio : track 2" UWORD _CNV_A_R_LINEAR_____210_CM 1 0. 0. 1. ECU_ADDRESS 0xd0003030 FORMAT "%9.7" /end MEASUREMENT
/begin CHARACTERISTIC Cxx_acel_pdl_sens_pws "Accelerator pedal sensor power supply" VALUE 0xa0020b8e _REC_S1VAL_20_u2 25000. _CNV_A_R_LINEAR_____52_CM 0. 25000. FORMAT "%5.0" /end CHARACTERISTIC
/begin CHARACTERISTIC Cxx_acel_pdl_stab_thd "Accelerator pedal signal stabilization threshold" VALUE 0xa0020b90 _REC_S1VAL_20_u2 1. _CNV_A_R_LINEAR_____210_CM 0. 1. FORMAT "%9.7" /end CHARACTERISTIC
/begin AXIS_PTS Ctb_acel_pdl_v_max_dif "Pedal breakpoint for the consistency diagnosis" 0xa00262a8 Vxx_acel_pdl_fil_sens_v1 _REC_A2AXS_20_u2 1. _CNV_A_R_LINEAR_____210_CM 9 0. 1. FORMAT "%9.7" /end AXIS_PTS
/begin CHARACTERISTIC Ctp_acel_pdl_v_max_dif "Interpolated calibration table to detect an inconsistency on accelerator pedal tracks" CURVE 0xa00262bc _REC_A1CUR_20_u2_u2 1. _CNV_A_R_LINEAR_____210_CM 0. 1. FORMAT "%9.7"
 /begin AXIS_DESCR COM_AXIS Vxx_acel_pdl_fil_sens_v1 _CNV_A_R_LINEAR_____210_CM 9 0. 1. FORMAT "%9.7" AXIS_PTS_REF Ctb_acel_pdl_v_max_dif /end AXIS_DESCR
/end CHARACTERISTIC
/begin MEASUREMENT Vbx_acel_pdl_sens1_ok "accelerator pedal sensor track 1 without default " UBYTE _CNV_S_2_RANGE______3_CM 1 0. 0. 1. ECU_ADDRESS 0xd000468a BIT_MASK 0x1 /end MEASUREMENT
/begin MEASUREMENT Vbx_det_acel_pdl_rdcy_loss "Detected loss of redundancy on accelerator pedal sensor" UBYTE _CNV_S_2_RANGE______3_CM 1 0. 0. 1. ECU_ADDRESS 0xd0004690 BIT_MASK 0x1 /end MEASUREMENT
/begin MEASUREMENT Vbx_df_acel_pdl_chr "Accelerator pedal consistency detected failure" UBYTE _CNV_S_2_RANGE______3_CM 1 0. 0. 1. ECU_ADDRESS 0xd0004691 BIT_MASK 0x1 /end MEASUREMENT
/begin MEASUREMENT Vbx_df_acel_pdl_tot "Total loss of accelerator pedal detected failure" UBYTE _CNV_S_2_RANGE______3_CM 1 0. 0. 1. ECU_ADDRESS 0xd000468b BIT_MASK 0x1 /end MEASUREMENT
/begin MEASUREMENT Vbx_df_acel_pdl_v1_h "Accelerator pedal track 1 high signal detected failure" UBYTE _CNV_S_2_RANGE______3_CM 1 0. 0. 1. ECU_ADDRESS 0xd0004692 BIT_MASK 0x1 /end MEASUREMENT
/begin MEASUREMENT Vbx_df_acel_pdl_v1_l "Accelerator pedal track 1 low signal detected failure" UBYTE _CNV_S_2_RANGE______3_CM 1 0. 0. 1. ECU_ADDRESS 0xd0004693 BIT_MASK 0x1 /end MEASUREMENT
/begin MEASUREMENT Vbx_df_acel_pdl_v2_h "Accelerator pedal track 2 high signal detected failure" UBYTE _CNV_S_2_RANGE______3_CM 1 0. 0. 1. ECU_ADDRESS 0xd0004694 BIT_MASK 0x1 /end MEASUREMENT
/begin MEASUREMENT Vbx_df_acel_pdl_v2_l "Accelerator pedal track 2 low signal detected failure" UBYTE _CNV_S_2_RANGE______3_CM 1 0. 0. 1. ECU_ADDRESS 0xd0004695 BIT_MASK 0x1 /end MEASUREMENT
/begin MEASUREMENT Vbx_diag_ena_acel_pdl_chr "Accelerator pedal consistency diagnosis authorization" UBYTE _CNV_S_2_RANGE______3_CM 1 0. 0. 1. ECU_ADDRESS 0xd000468c BIT_MASK 0x1 /end MEASUREMENT
/begin MEASUREMENT Vbx_fail_pws_acel_pdl_v1 "Failure on power supply of accelerator pedal track 1" UBYTE _CNV_S_2_RANGE______3_CM 1 0. 0. 1. ECU_ADDRESS 0xd000468d BIT_MASK 0x1 /end MEASUREMENT
/begin MEASUREMENT Vbx_fail_pws_acel_pdl_v2 "Failure on power supply of accelerator pedal track 2" UBYTE _CNV_S_2_RANGE______3_CM 1 0. 0. 1. ECU_ADDRESS 0xd000468e BIT_MASK 0x1 /end MEASUREMENT
/begin MEASUREMENT Vbx_loss_acel_pdl_v1 "" UBYTE _CNV_S_2_RANGE______3_CM 1 0. 0. 1. ECU_ADDRESS 0xd000468f BIT_MASK 0x1 /end MEASUREMENT
/begin MEASUREMENT Vsx_acel_pdl_sens_v1_vld "Accelerator pedal sensor output voltage : track 1 validity status" UBYTE _CNV_S_2_STATUS_OK__188_CM 1 0. 0. 1. ECU_ADDRESS 0xd0004696 /end MEASUREMENT
/begin MEASUREMENT Vsx_acel_pdl_v_vld "Normalised acelerator pedal position" UBYTE _CNV_S_3_STATUS_OK__158_CM 1 0. 0. 2. ECU_ADDRESS 0xd0004697 /end MEASUREMENT
/begin MEASUREMENT Vxx_acel_pdl_sens_v "filtered accelerator pedal sensor output voltage: track 1" UWORD _CNV_A_R_LINEAR_____210_CM 1 0. 0. 1. ECU_ADDRESS 0xd00038c8 FORMAT "%9.7" /end MEASUREMENT
/begin MEASUREMENT Vxx_acel_pdl_v "Accelerator pedal sensor output voltage (Upot1 or Upot2 or safety replacement value)" UWORD _CNV_A_R_LINEAR_____210_CM 1 0. 0. 1. ECU_ADDRESS 0xd00038ca FORMAT "%9.7" /end MEASUREMENT
/begin CHARACTERISTIC Cxx_acel_pdl_lih_sub_v "Accelerator pedal voltage (safety replacement value) if accelerator pedal limp home actived" VALUE 0xa002182c _REC_S1VAL_20_u2 1. _CNV_A_R_LINEAR_____210_CM 0. 1. FORMAT "%9.7" /end CHARACTERISTIC
/begin CHARACTERISTIC Cxx_acel_pdl_v1_max_thd "Maximum threshold to detect high signal failure on accelerator pedal track 1" VALUE 0xa002182e _REC_S1VAL_20_u2 1. _CNV_A_R_LINEAR_____210_CM 0. 1. FORMAT "%9.7" /end CHARACTERISTIC
/begin CHARACTERISTIC Cxx_acel_pdl_v1_min_thd "Minimum threshold to detect high signal failure on accelerator pedal track 1" VALUE 0xa0021830 _REC_S1VAL_20_u2 1. _CNV_A_R_LINEAR_____210_CM 0. 1. FORMAT "%9.7" /end CHARACTERISTIC
/begin CHARACTERISTIC Cxx_acel_pdl_v1_v2_fac "Accelerator pedal voltage (safety replacement value) if accelerator pedal limp home actived" VALUE 0xa0021846 _REC_S1VAL_20_u1 255. _CNV_A_R_ECME_LINEA_0_CM 0. 255. FORMAT "%3.0" /end CHARACTERISTIC
/begin CHARACTERISTIC Cxx_acel_pdl_v2_max_thd "Maximum threshold to detect high signal failure on accelerator pedal track 2" VALUE 0xa0021832 _REC_S1VAL_20_u2 1. _CNV_A_R_LINEAR_____210_CM 0. 1. FORMAT "%9.7" /end CHARACTERISTIC
/begin CHARACTERISTIC Cxx_acel_pdl_v2_min_thd "Minimum threshold to detect high signal failure on accelerator pedal track 2" VALUE 0xa0021834 _REC_S1VAL_20_u2 1. _CNV_A_R_LINEAR_____210_CM 0. 1. FORMAT "%9.7" /end CHARACTERISTIC
/begin CHARACTERISTIC Cxx_dfdec_acel_pdl_chr "Accelerator pedal consistency detected failure counter decrement" VALUE 0xa0021836 _REC_S1VAL_20_u2 65535. _CNV_A_R_ECME_LINEA_0_CM 0. 65535. FORMAT "%5.0" /end CHARACTERISTIC
/begin CHARACTERISTIC Cxx_dfdec_acel_pdl_tot "Total loss of accelerator pedal detected failure counter decrement" VALUE 0xa0021838 _REC_S1VAL_20_u2 65535. _CNV_A_R_ECME_LINEA_0_CM 0. 65535. FORMAT "%5.0" /end CHARACTERISTIC
/begin CHARACTERISTIC Cxx_dfdec_acel_pdl_v1 "Accelerator pedal track 1 detected failure counter decrement" VALUE 0xa002183a _REC_S1VAL_20_u2 65535. _CNV_A_R_ECME_LINEA_0_CM 0. 65535. FORMAT "%5.0" /end CHARACTERISTIC
/begin CHARACTERISTIC Cxx_dfdec_acel_pdl_v2 "Accelerator pedal track 2 detected failure counter decrement" VALUE 0xa002183c _REC_S1VAL_20_u2 65535. _CNV_A_R_ECME_LINEA_0_CM 0. 65535. FORMAT "%5.0" /end CHARACTERISTIC
/begin CHARACTERISTIC Cxx_dfinc_acel_pdl_chr "Accelerator pedal consistency detected failure counter increment" VALUE 0xa002183e _REC_S1VAL_20_u2 65535. _CNV_A_R_ECME_LINEA_0_CM 0. 65535. FORMAT "%5.0" /end CHARACTERISTIC
/begin CHARACTERISTIC Cxx_dfinc_acel_pdl_tot "Total loss of accelerator pedal detected failure counter increment" VALUE 0xa0021840 _REC_S1VAL_20_u2 65535. _CNV_A_R_ECME_LINEA_0_CM 0. 65535. FORMAT "%5.0" /end CHARACTERISTIC
/begin CHARACTERISTIC Cxx_dfinc_acel_pdl_v1 "Accelerator pedal track 1 detected failure counter increment" VALUE 0xa0021842 _REC_S1VAL_20_u2 65535. _CNV_A_R_ECME_LINEA_0_CM 0. 65535. FORMAT "%5.0" /end CHARACTERISTIC
/begin CHARACTERISTIC Cxx_dfinc_acel_pdl_v2 "Accelerator pedal track 2 detected failure counter increment" VALUE 0xa0021844 _REC_S1VAL_20_u2 65535. _CNV_A_R_ECME_LINEA_0_CM 0. 65535. FORMAT "%5.0" /end CHARACTERISTIC
/begin MEASUREMENT Vbx_acel_pdl_secu_cdn_1 "Condition 1 for activation of pedal safety case (used for the exit of emergency mode too)" UBYTE _CNV_S_2_RANGE______3_CM 1 0. 0. 1. ECU_ADDRESS 0xd0005531 BIT_MASK 0x1 /end MEASUREMENT
/begin MEASUREMENT Vbx_acel_pdl_secu_cdn_2 "Condition 2 for activation of pedal safety case (not used for the exit of emergency mode too)" UBYTE _CNV_S_2_RANGE______3_CM 1 0. 0. 1. ECU_ADDRESS 0xd0005532 BIT_MASK 0x1 /end MEASUREMENT
/begin MEASUREMENT Vbx_acel_pdl_secu_det "Detection of the conditions accelerator pedal safety case (before breaking)" UBYTE _CNV_S_2_RANGE______3_CM 1 0. 0. 1. ECU_ADDRESS 0xd0005533 BIT_MASK 0x1 /end MEASUREMENT
/begin MEASUREMENT Vbx_df_acel_pdl_secu_1 "Detection of the conditions accelerator pedal safety case N∞1 (before breaking)" UBYTE _CNV_S_2_RANGE______3_CM 1 0. 0. 1. ECU_ADDRESS 0xd0005534 BIT_MASK 0x1 /end MEASUREMENT
/begin MEASUREMENT Vbx_df_acel_pdl_secu_2 "Detected failure of accelerator pedal safety case N∞2 (reversible or irreversible downgraded mode)" UBYTE _CNV_S_2_RANGE______3_CM 1 0. 0. 1. ECU_ADDRESS 0xd0005535 BIT_MASK 0x1 /end MEASUREMENT
/begin MEASUREMENT Vbx_diag_ena_acel_pdl_secu_2 "Accelerator pedal safety case N∞2 diagnosis authorization" UBYTE _CNV_S_2_RANGE______3_CM 1 0. 0. 1. ECU_ADDRESS 0xd0005536 BIT_MASK 0x1 /end MEASUREMENT
/begin CHARACTERISTIC Cbx_acel_pdl_secu_2_cfm "bit of configuration to set accelerator pedal safety case N∞2 irreversible" VALUE 0xa00207ca _REC_S1VAL_20_u1 1. _CNV_A_R_ECME_LINEA_0_CM 0. 1. FORMAT "%1.0" BIT_MASK 0x1 /end CHARACTERISTIC
/begin CHARACTERISTIC Cbx_acel_pdl_secu_acc_cfm "bit of configuration to disable ACC condition for accelerator pedal safety case" VALUE 0xa00207cb _REC_S1VAL_20_u1 1. _CNV_A_R_ECME_LINEA_0_CM 0. 1. FORMAT "%1.0" BIT_MASK 0x1 /end CHARACTERISTIC
/begin CHARACTERISTIC Cbx_acel_pdl_secu_esp_cfm "bit of configuration to disable ASR/MSR/AYC conditions for accelerator pedal safety case" VALUE 0xa00207cc _REC_S1VAL_20_u1 1. _CNV_A_R_ECME_LINEA_0_CM 0. 1. FORMAT "%1.0" BIT_MASK 0x1 /end CHARACTERISTIC
/begin CHARACTERISTIC Cxx_acel_pdl_secu_2_inc_1 "Accelerator pedal safety case N∞2 counter increment (when diagnosis is not confirmed)" VALUE 0xa00207ba _REC_S1VAL_20_u2 65535. _CNV_A_R_ECME_LINEA_0_CM 0. 65535. FORMAT "%5.0" /end CHARACTERISTIC
/begin CHARACTERISTIC Cxx_acel_pdl_secu_2_inc_2 "Accelerator pedal safety case N∞2 counter increment (when diagnosis is confirmed)" VALUE 0xa00207bc _REC_S1VAL_20_u2 65535. _CNV_A_R_ECME_LINEA_0_CM 0. 65535. FORMAT "%5.0" /end CHARACTERISTIC
/begin CHARACTERISTIC Cxx_acel_pdl_secu_2_thd "Pedal threshold to allow the healing of accelerator pedal safety case N∞2" VALUE 0xa00207be _REC_S1VAL_20_u2 1. _CNV_A_R_LINEAR_____210_CM 0. 1. FORMAT "%9.7" /end CHARACTERISTIC
/begin CHARACTERISTIC Cxx_acel_pdl_secu_2_vs_thd "Vehicle speed threshold to allow the healing of accelerator pedal safety case N∞2" VALUE 0xa00207cd _REC_S1VAL_20_u1 255. _CNV_A_R_LINEAR_____212_CM 0. 255. FORMAT "%3.0" /end CHARACTERISTIC
/begin CHARACTERISTIC Cxx_acel_pdl_secu_dly1 "Tempo 1 (before breaking) to validate the conditions of accelerator pedal safety case" VALUE 0xa00207c0 _REC_S1VAL_20_u2 655.35 _CNV_A_R_LINEAR_____34_CM 0. 655.35 FORMAT "%6.2" /end CHARACTERISTIC
/begin CHARACTERISTIC Cxx_acel_pdl_secu_dly2 "Tempo 2 (after breaking) to detect the failure of accelerator pedal safety case N∞1" VALUE 0xa00207c2 _REC_S1VAL_20_u2 655.35 _CNV_A_R_LINEAR_____34_CM 0. 655.35 FORMAT "%6.2" /end CHARACTERISTIC
/begin CHARACTERISTIC Cxx_acel_pdl_secu_flu_thd "Pedal variation threshold to allowthe detection of accelerator pedal safety case" VALUE 0xa00207c4 _REC_S1VAL_20_u2 1. _CNV_A_R_LINEAR_____213_CM 0. 1. FORMAT "%9.7" /end CHARACTERISTIC
/begin CHARACTERISTIC Cxx_acel_pdl_secu_n_thd "Engine speed threshold to allow the detection of accelerator pedal safety case" VALUE 0xa00207ce _REC_S1VAL_20_u1 8160. _CNV_A_R_LINEAR_____2_CM 0. 8160. FORMAT "%4.0" /end CHARACTERISTIC
/begin CHARACTERISTIC Cxx_acel_pdl_secu_thd "Pedal threshold to allow the detection of accelerator pedal safety case" VALUE 0xa00207c6 _REC_S1VAL_20_u2 1. _CNV_A_R_LINEAR_____210_CM 0. 1. FORMAT "%9.7" /end CHARACTERISTIC
/begin CHARACTERISTIC Cxx_acel_pdl_secu_vs_thd "Pedal threshold to allow the detection of accelerator pedal safety case" VALUE 0xa00207cf _REC_S1VAL_20_u1 255. _CNV_A_R_LINEAR_____212_CM 0. 255. FORMAT "%3.0" /end CHARACTERISTIC
/begin CHARACTERISTIC Cxx_dfdec_acel_pdl_secu_2 "Accelerator pedal safety case N∞2 detected failure counter decrement" VALUE 0xa00207c8 _REC_S1VAL_20_u2 65535. _CNV_A_R_ECME_LINEA_0_CM 0. 65535. FORMAT "%5.0" /end CHARACTERISTIC
/begin MEASUREMENT Vbx_df_vb_h "Battery voltage above max threshold detected failure" UBYTE _CNV_S_2_RANGE______3_CM 1 0. 0. 1. ECU_ADDRESS 0xd000466b BIT_MASK 0x1 /end MEASUREMENT
/begin MEASUREMENT Vbx_df_vb_l "Battery voltage below min threshold detected failure counter saturation" UBYTE _CNV_S_2_RANGE______3_CM 1 0. 0. 1. ECU_ADDRESS 0xd000466c BIT_MASK 0x1 /end MEASUREMENT
/begin MEASUREMENT Vbx_diag_ena_vb_h "Battery voltage above max threshold diagnosis information available" UBYTE _CNV_S_2_RANGE______3_CM 1 0. 0. 1. ECU_ADDRESS 0xd000466d BIT_MASK 0x1 /end MEASUREMENT
/begin MEASUREMENT Vbx_diag_ena_vb_l "Battery voltage below min threshold diagnosis information available" UBYTE _CNV_S_2_RANGE______3_CM 1 0. 0. 1. ECU_ADDRESS 0xd000466e BIT_MASK 0x1 /end MEASUREMENT
/begin MEASUREMENT Vsx_vb_rly_vld "Main relay validity indicator" UBYTE _CNV_A_R_ECME_LINEA_0_CM 1 0. 0. 255. ECU_ADDRESS 0xd000466f FORMAT "%3.0" /end MEASUREMENT
/begin MEASUREMENT Vsx_vb_vld "Filtered voltage battery validity status" UBYTE _CNV_A_R_ECME_LINEA_0_CM 1 0. 0. 255. ECU_ADDRESS 0xd0004670 FORMAT "%3.0" /end MEASUREMENT
/begin MEASUREMENT Vxx_mv_vb "Filtered battery voltage" UWORD _CNV_A_R_LINEAR_____52_CM 1 0. 0. 25000. ECU_ADDRESS 0xd0003830 FORMAT "%5.0" /end MEASUREMENT
/begin MEASUREMENT Vxx_vb "Battery voltage" UWORD _CNV_A_R_LINEAR_____150_CM 1 0. 0. 60. ECU_ADDRESS 0xd0003832 FORMAT "%5.2" /end MEASUREMENT
/begin CHARACTERISTIC Cxx_dfdec_vb_h "Battery voltage above max threshold detected failure counter decrement" VALUE 0xa0021800 _REC_S1VAL_20_u2 65535. _CNV_A_R_ECME_LINEA_0_CM 0. 65535. FORMAT "%5.0" /end CHARACTERISTIC
/begin CHARACTERISTIC Cxx_dfdec_vb_l "Battery voltage below min threshold detected failure counter decrement" VALUE 0xa0021802 _REC_S1VAL_20_u2 65535. _CNV_A_R_ECME_LINEA_0_CM 0. 65535. FORMAT "%5.0" /end CHARACTERISTIC
/begin CHARACTERISTIC Cxx_dfdec_vb_rly_oc_scg "Open circuit or short circuit to ground on main relay detected failure counter decrement" VALUE 0xa0021804 _REC_S1VAL_20_u2 65535. _CNV_A_R_ECME_LINEA_0_CM 0. 65535. FORMAT "%5.0" /end CHARACTERISTIC
/begin CHARACTERISTIC Cxx_dfdec_vb_rly_scw "Short circuit to battery on main relay detected failure counter decrement" VALUE 0xa0021806 _REC_S1VAL_20_u2 65535. _CNV_A_R_ECME_LINEA_0_CM 0. 65535. FORMAT "%5.0" /end CHARACTERISTIC
/begin CHARACTERISTIC Cxx_dfinc_vb_h "Battery voltage above max threshold detected failure counter increment" VALUE 0xa0021808 _REC_S1VAL_20_u2 65535. _CNV_A_R_ECME_LINEA_0_CM 0. 65535. FORMAT "%5.0" /end CHARACTERISTIC
/begin CHARACTERISTIC Cxx_dfinc_vb_l "Battery voltage below min threshold detected failure counter increment" VALUE 0xa002180a _REC_S1VAL_20_u2 65535. _CNV_A_R_ECME_LINEA_0_CM 0. 65535. FORMAT "%5.0" /end CHARACTERISTIC
/begin CHARACTERISTIC Cxx_dfinc_vb_rly_oc_scg "Open circuit or short circuit to ground on main relay detected failure counter increment" VALUE 0xa002180c _REC_S1VAL_20_u2 65535. _CNV_A_R_ECME_LINEA_0_CM 0. 65535. FORMAT "%5.0" /end CHARACTERISTIC
/begin CHARACTERISTIC Cxx_dfinc_vb_rly_scw "Short circuit to battery relay detected failure counter increment" VALUE 0xa002180e _REC_S1VAL_20_u2 65535. _CNV_A_R_ECME_LINEA_0_CM 0. 65535. FORMAT "%5.0" /end CHARACTERISTIC
/begin CHARACTERISTIC Cxx_mv_vb_fac "Filter factor applied to raw battery voltage" VALUE 0xa0021810 _REC_S1VAL_20_u2 655.35 _CNV_A_R_LINEAR_____34_CM 0. 655.35 FORMAT "%6.2" /end CHARACTERISTIC
/begin CHARACTERISTIC Cxx_thd_n_diag_vb_h "Engine speed threshold for high level battery voltage fault detection" VALUE 0xa0021812 _REC_S1VAL_20_u2 16383.75 _CNV_A_R_ENSD_LINEA_24_CM 0. 16383.75 FORMAT "%8.2" /end CHARACTERISTIC
/begin CHARACTERISTIC Cxx_thd_n_diag_vb_l "Engine speed threshold for low level battery voltage fault detection" VALUE 0xa0021814 _REC_S1VAL_20_u2 16383.75 _CNV_A_R_ENSD_LINEA_24_CM 0. 16383.75 FORMAT "%8.2" /end CHARACTERISTIC
/begin CHARACTERISTIC Cxx_thd_vb_h "Max threshold for battery voltage fault detection" VALUE 0xa0021816 _REC_S1VAL_20_u2 60. _CNV_A_R_LINEAR_____150_CM 0. 60. FORMAT "%5.2" /end CHARACTERISTIC
/begin CHARACTERISTIC Cxx_thd_vb_l "Min threshold for battery voltage fault detection" VALUE 0xa0021818 _REC_S1VAL_20_u2 60. _CNV_A_R_LINEAR_____150_CM 0. 60. FORMAT "%5.2" /end CHARACTERISTIC
/begin MEASUREMENT Vbx_bdu_ope "Boolean thet indicates BDU opening" UBYTE _CNV_S_2_RANGE______3_CM 1 0. 0. 1. ECU_ADDRESS 0xd00049f3 BIT_MASK 0x1 /end MEASUREMENT
/begin MEASUREMENT Vsx_sens_alt_fil_pwm_vld "Filtered wire frame alternator load validity status" UBYTE _CNV_S_3_STATUS_OK__120_CM 1 0. 0. 2. ECU_ADDRESS 0xd0004101 /end MEASUREMENT
/begin MEASUREMENT Vxx_sens_alt_fil_pwm "filtered wire frame alternator load" UBYTE _CNV_A_R_LINEAR_____114_CM 1 0. 0. 100. ECU_ADDRESS 0xd0004102 FORMAT "%12.8" /end MEASUREMENT
/begin MEASUREMENT Vsx_alt_pwm_vld "Alternator load validity status" UBYTE _CNV_S_2_STATUS_OK__214_CM 1 0. 0. 1. ECU_ADDRESS 0xd0004c5d /end MEASUREMENT
/begin MEASUREMENT Vxx_alt_pwm "Filtered alternator load" UBYTE _CNV_A_R_LINEAR_____114_CM 1 0. 0. 100. ECU_ADDRESS 0xd0004c5e FORMAT "%12.8" /end MEASUREMENT
/begin CHARACTERISTIC Cbx_mux_alt_pwm_cfm "Multiplexed alternator load configuration" VALUE 0xa00207d2 _REC_S1VAL_20_u1 1. _CNV_A_R_ECME_LINEA_0_CM 0. 1. FORMAT "%1.0" BIT_MASK 0x1 /end CHARACTERISTIC
/begin CHARACTERISTIC Cxx_alt_pwm_l "Alternator load setting when engine is not autonomous" VALUE 0xa00207d3 _REC_S1VAL_20_u1 100. _CNV_A_R_LINEAR_____114_CM 0. 100. FORMAT "%12.8" /end CHARACTERISTIC
/begin CHARACTERISTIC Cxx_alt_pwm_sub "Alternator load by default" VALUE 0xa00207d4 _REC_S1VAL_20_u1 100. _CNV_A_R_LINEAR_____114_CM 0. 100. FORMAT "%12.8" /end CHARACTERISTIC
/begin CHARACTERISTIC Cxx_mux_alt_pwm_fil_t "Multiplexed alternator load filter time constant" VALUE 0xa00207d0 _REC_S1VAL_20_u2 65535. _CNV_A_R_LINEAR_____144_CM 0. 65535. FORMAT "%5.0" /end CHARACTERISTIC
/begin MEASUREMENT Sbx_obd_rdn_cata_cpt "" UBYTE _CNV_S_2_RANGE______217_CM 1 0. 0. 1. DISPLAY_IDENTIFIER DgDftMng_NVM.Sbx_obd_rdn_cata_cpt_NVM ECU_ADDRESS 0xd00053cc BIT_MASK 0x1 /end MEASUREMENT
/begin MEASUREMENT Sbx_obd_rdn_lbup_cpt "" UBYTE _CNV_S_2_RANGE______217_CM 1 0. 0. 1. DISPLAY_IDENTIFIER DgDftMng_NVM.Sbx_obd_rdn_lbup_cpt_NVM ECU_ADDRESS 0xd00053cd BIT_MASK 0x1 /end MEASUREMENT
/begin MEASUREMENT Sbx_obd_rdn_egr "" UBYTE _CNV_S_2_RANGE______217_CM 1 0. 0. 1. DISPLAY_IDENTIFIER DgDftMng_NVM.Sbx_obd_rdn_egr_NVM ECU_ADDRESS 0xd00053ce BIT_MASK 0x1 /end MEASUREMENT
/begin MEASUREMENT Sbx_obd_rdn_cata "" UBYTE _CNV_S_2_RANGE______217_CM 1 0. 0. 1. DISPLAY_IDENTIFIER DgDftMng_NVM.Sbx_obd_rdn_cata_NVM ECU_ADDRESS 0xd00053cf BIT_MASK 0x1 /end MEASUREMENT
/begin MEASUREMENT Sbx_obd_rdn_heat "" UBYTE _CNV_S_2_RANGE______217_CM 1 0. 0. 1. DISPLAY_IDENTIFIER DgDftMng_NVM.Sbx_obd_rdn_heat_NVM ECU_ADDRESS 0xd00053d0 BIT_MASK 0x1 /end MEASUREMENT
/begin MEASUREMENT Sbx_obd_rdn_evap "" UBYTE _CNV_S_2_RANGE______217_CM 1 0. 0. 1. DISPLAY_IDENTIFIER DgDftMng_NVM.Sbx_obd_rdn_evap_NVM ECU_ADDRESS 0xd00053d1 BIT_MASK 0x1 /end MEASUREMENT
/begin MEASUREMENT Sbx_obd_rdn_pft "" UBYTE _CNV_S_2_RANGE______217_CM 1 0. 0. 1. DISPLAY_IDENTIFIER DgDftMng_NVM.Sbx_obd_rdn_pft_NVM ECU_ADDRESS 0xd00053d2 BIT_MASK 0x1 /end MEASUREMENT
/begin MEASUREMENT Vxx_dfctr_ac_prs_h "" UWORD _CNV_A_R_A_165_CM 1 0. 0. 65535. DISPLAY_IDENTIFIER fm_sta_ac_prs_h.Vxx_dfctr_xxx ECU_ADDRESS 0xc0000004 /end MEASUREMENT
/begin MEASUREMENT Vxx_rdn_ac_prs_h "" UWORD _CNV_A_R_A_165_CM 1 0. 0. 65535. DISPLAY_IDENTIFIER fm_sta_ac_prs_h.Vxx_rdn_xxx ECU_ADDRESS 0xc0000006 /end MEASUREMENT
/begin MEASUREMENT Vbx_cf_ac_prs_h "" UBYTE _CNV_A_R_A_165_CM 1 0. 0. 255. DISPLAY_IDENTIFIER fm_sta_ac_prs_h.fm_static_bitfield.Vbx_cf_xxx ECU_ADDRESS 0xc0000008 BIT_MASK 0x1 /end MEASUREMENT
/begin MEASUREMENT Vbx_clf_ac_prs_h "" UBYTE _CNV_A_R_A_165_CM 1 0. 0. 255. DISPLAY_IDENTIFIER fm_sta_ac_prs_h.fm_static_bitfield.Vbx_clf_xxx ECU_ADDRESS 0xc0000008 BIT_MASK 0x2 /end MEASUREMENT
/begin MEASUREMENT Vbx_df_old_ac_prs_h "" UBYTE _CNV_A_R_A_165_CM 1 0. 0. 255. DISPLAY_IDENTIFIER fm_sta_ac_prs_h.fm_static_bitfield.Vbx_df_old_xxx ECU_ADDRESS 0xc0000008 BIT_MASK 0x4 /end MEASUREMENT
/begin MEASUREMENT Vbx_dfctr_sat_ac_prs_h "" UBYTE _CNV_A_R_A_165_CM 1 0. 0. 255. DISPLAY_IDENTIFIER fm_sta_ac_prs_h.fm_static_bitfield.Vbx_dfctr_sat_xxx ECU_ADDRESS 0xc0000008 BIT_MASK 0x8 /end MEASUREMENT
/begin MEASUREMENT Vbx_rdn_ac_prs_h "" UBYTE _CNV_A_R_A_165_CM 1 0. 0. 255. DISPLAY_IDENTIFIER fm_sta_ac_prs_h.fm_static_bitfield.Vbx_rdn_xxx ECU_ADDRESS 0xc0000008 BIT_MASK 0x40 /end MEASUREMENT
/begin MEASUREMENT Vxx_dtc_stt_ac_prs_h "" UBYTE _CNV_A_R_A_165_CM 1 0. 0. 255. DISPLAY_IDENTIFIER fm_sta_ac_prs_h.Vxx_dtc_stt_xxx ECU_ADDRESS 0xc0000009 /end MEASUREMENT
/begin MEASUREMENT Vxx_dfctr_ac_prs_l "" UWORD _CNV_A_R_A_165_CM 1 0. 0. 65535. DISPLAY_IDENTIFIER fm_sta_ac_prs_l.Vxx_dfctr_xxx ECU_ADDRESS 0xc000000a /end MEASUREMENT
/begin MEASUREMENT Vxx_rdn_ac_prs_l "" UWORD _CNV_A_R_A_165_CM 1 0. 0. 65535. DISPLAY_IDENTIFIER fm_sta_ac_prs_l.Vxx_rdn_xxx ECU_ADDRESS 0xc000000c /end MEASUREMENT
/begin MEASUREMENT Vbx_cf_ac_prs_l "" UBYTE _CNV_A_R_A_165_CM 1 0. 0. 255. DISPLAY_IDENTIFIER fm_sta_ac_prs_l.fm_static_bitfield.Vbx_cf_xxx ECU_ADDRESS 0xc000000e BIT_MASK 0x1 /end MEASUREMENT
/begin MEASUREMENT Vbx_clf_ac_prs_l "" UBYTE _CNV_A_R_A_165_CM 1 0. 0. 255. DISPLAY_IDENTIFIER fm_sta_ac_prs_l.fm_static_bitfield.Vbx_clf_xxx ECU_ADDRESS 0xc000000e BIT_MASK 0x2 /end MEASUREMENT
/begin MEASUREMENT Vbx_df_old_ac_prs_l "" UBYTE _CNV_A_R_A_165_CM 1 0. 0. 255. DISPLAY_IDENTIFIER fm_sta_ac_prs_l.fm_static_bitfield.Vbx_df_old_xxx ECU_ADDRESS 0xc000000e BIT_MASK 0x4 /end MEASUREMENT
/begin MEASUREMENT Vbx_dfctr_sat_ac_prs_l "" UBYTE _CNV_A_R_A_165_CM 1 0. 0. 255. DISPLAY_IDENTIFIER fm_sta_ac_prs_l.fm_static_bitfield.Vbx_dfctr_sat_xxx ECU_ADDRESS 0xc000000e BIT_MASK 0x8 /end MEASUREMENT
/begin MEASUREMENT Vbx_rdn_ac_prs_l "" UBYTE _CNV_A_R_A_165_CM 1 0. 0. 255. DISPLAY_IDENTIFIER fm_sta_ac_prs_l.fm_static_bitfield.Vbx_rdn_xxx ECU_ADDRESS 0xc000000e BIT_MASK 0x40 /end MEASUREMENT
/begin MEASUREMENT Vxx_dtc_stt_ac_prs_l "" UBYTE _CNV_A_R_A_165_CM 1 0. 0. 255. DISPLAY_IDENTIFIER fm_sta_ac_prs_l.Vxx_dtc_stt_xxx ECU_ADDRESS 0xc000000f /end MEASUREMENT
/begin MEASUREMENT Vxx_dfctr_acel_pdl_chr "" UWORD _CNV_A_R_A_165_CM 1 0. 0. 65535. DISPLAY_IDENTIFIER fm_sta_acel_pdl_chr.Vxx_dfctr_xxx ECU_ADDRESS 0xc0000010 /end MEASUREMENT
/begin MEASUREMENT Vxx_rdn_acel_pdl_chr "" UWORD _CNV_A_R_A_165_CM 1 0. 0. 65535. DISPLAY_IDENTIFIER fm_sta_acel_pdl_chr.Vxx_rdn_xxx ECU_ADDRESS 0xc0000012 /end MEASUREMENT
/begin MEASUREMENT Vbx_cf_acel_pdl_chr "" UBYTE _CNV_A_R_A_165_CM 1 0. 0. 255. DISPLAY_IDENTIFIER fm_sta_acel_pdl_chr.fm_static_bitfield.Vbx_cf_xxx ECU_ADDRESS 0xc0000014 BIT_MASK 0x1 /end MEASUREMENT
/begin MEASUREMENT Vbx_clf_acel_pdl_chr "" UBYTE _CNV_A_R_A_165_CM 1 0. 0. 255. DISPLAY_IDENTIFIER fm_sta_acel_pdl_chr.fm_static_bitfield.Vbx_clf_xxx ECU_ADDRESS 0xc0000014 BIT_MASK 0x2 /end MEASUREMENT
/begin MEASUREMENT Vbx_df_old_acel_pdl_chr "" UBYTE _CNV_A_R_A_165_CM 1 0. 0. 255. DISPLAY_IDENTIFIER fm_sta_acel_pdl_chr.fm_static_bitfield.Vbx_df_old_xxx ECU_ADDRESS 0xc0000014 BIT_MASK 0x4 /end MEASUREMENT
/begin MEASUREMENT Vbx_dfctr_sat_acel_pdl_chr "" UBYTE _CNV_A_R_A_165_CM 1 0. 0. 255. DISPLAY_IDENTIFIER fm_sta_acel_pdl_chr.fm_static_bitfield.Vbx_dfctr_sat_xxx ECU_ADDRESS 0xc0000014 BIT_MASK 0x8 /end MEASUREMENT
/begin MEASUREMENT Vbx_rdn_acel_pdl_chr "" UBYTE _CNV_A_R_A_165_CM 1 0. 0. 255. DISPLAY_IDENTIFIER fm_sta_acel_pdl_chr.fm_static_bitfield.Vbx_rdn_xxx ECU_ADDRESS 0xc0000014 BIT_MASK 0x40 /end MEASUREMENT
/begin MEASUREMENT Vxx_dtc_stt_acel_pdl_chr "" UBYTE _CNV_A_R_A_165_CM 1 0. 0. 255. DISPLAY_IDENTIFIER fm_sta_acel_pdl_chr.Vxx_dtc_stt_xxx ECU_ADDRESS 0xc0000015 /end MEASUREMENT
/begin MEASUREMENT Vxx_dfctr_acel_pdl_secu_1 "" UWORD _CNV_A_R_A_165_CM 1 0. 0. 65535. DISPLAY_IDENTIFIER fm_sta_acel_pdl_secu_1.Vxx_dfctr_xxx ECU_ADDRESS 0xc0000016 /end MEASUREMENT
/begin MEASUREMENT Vxx_rdn_acel_pdl_secu_1 "" UWORD _CNV_A_R_A_165_CM 1 0. 0. 65535. DISPLAY_IDENTIFIER fm_sta_acel_pdl_secu_1.Vxx_rdn_xxx ECU_ADDRESS 0xc0000018 /end MEASUREMENT
/begin MEASUREMENT Vbx_cf_acel_pdl_secu_1 "" UBYTE _CNV_A_R_A_165_CM 1 0. 0. 255. DISPLAY_IDENTIFIER fm_sta_acel_pdl_secu_1.fm_static_bitfield.Vbx_cf_xxx ECU_ADDRESS 0xc000001a BIT_MASK 0x1 /end MEASUREMENT
/begin MEASUREMENT Vbx_clf_acel_pdl_secu_1 "" UBYTE _CNV_A_R_A_165_CM 1 0. 0. 255. DISPLAY_IDENTIFIER fm_sta_acel_pdl_secu_1.fm_static_bitfield.Vbx_clf_xxx ECU_ADDRESS 0xc000001a BIT_MASK 0x2 /end MEASUREMENT
/begin MEASUREMENT Vbx_df_old_acel_pdl_secu_1 "" UBYTE _CNV_A_R_A_165_CM 1 0. 0. 255. DISPLAY_IDENTIFIER fm_sta_acel_pdl_secu_1.fm_static_bitfield.Vbx_df_old_xxx ECU_ADDRESS 0xc000001a BIT_MASK 0x4 /end MEASUREMENT
/begin MEASUREMENT Vbx_dfctr_sat_acel_pdl_secu_1 "" UBYTE _CNV_A_R_A_165_CM 1 0. 0. 255. DISPLAY_IDENTIFIER fm_sta_acel_pdl_secu_1.fm_static_bitfield.Vbx_dfctr_sat_xxx ECU_ADDRESS 0xc000001a BIT_MASK 0x8 /end MEASUREMENT
/begin MEASUREMENT Vbx_rdn_acel_pdl_secu_1 "" UBYTE _CNV_A_R_A_165_CM 1 0. 0. 255. DISPLAY_IDENTIFIER fm_sta_acel_pdl_secu_1.fm_static_bitfield.Vbx_rdn_xxx ECU_ADDRESS 0xc000001a BIT_MASK 0x40 /end MEASUREMENT
/begin MEASUREMENT Vxx_dtc_stt_acel_pdl_secu_1 "" UBYTE _CNV_A_R_A_165_CM 1 0. 0. 255. DISPLAY_IDENTIFIER fm_sta_acel_pdl_secu_1.Vxx_dtc_stt_xxx ECU_ADDRESS 0xc000001b /end MEASUREMENT
/begin MEASUREMENT Vxx_dfctr_acel_pdl_secu_2 "" UWORD _CNV_A_R_A_165_CM 1 0. 0. 65535. DISPLAY_IDENTIFIER fm_sta_acel_pdl_secu_2.Vxx_dfctr_xxx ECU_ADDRESS 0xc000001c /end MEASUREMENT
/begin MEASUREMENT Vxx_rdn_acel_pdl_secu_2 "" UWORD _CNV_A_R_A_165_CM 1 0. 0. 65535. DISPLAY_IDENTIFIER fm_sta_acel_pdl_secu_2.Vxx_rdn_xxx ECU_ADDRESS 0xc000001e /end MEASUREMENT
/begin MEASUREMENT Vbx_cf_acel_pdl_secu_2 "" UBYTE _CNV_A_R_A_165_CM 1 0. 0. 255. DISPLAY_IDENTIFIER fm_sta_acel_pdl_secu_2.fm_static_bitfield.Vbx_cf_xxx ECU_ADDRESS 0xc0000020 BIT_MASK 0x1 /end MEASUREMENT
/begin MEASUREMENT Vbx_clf_acel_pdl_secu_2 "" UBYTE _CNV_A_R_A_165_CM 1 0. 0. 255. DISPLAY_IDENTIFIER fm_sta_acel_pdl_secu_2.fm_static_bitfield.Vbx_clf_xxx ECU_ADDRESS 0xc0000020 BIT_MASK 0x2 /end MEASUREMENT
/begin MEASUREMENT Vbx_df_old_acel_pdl_secu_2 "" UBYTE _CNV_A_R_A_165_CM 1 0. 0. 255. DISPLAY_IDENTIFIER fm_sta_acel_pdl_secu_2.fm_static_bitfield.Vbx_df_old_xxx ECU_ADDRESS 0xc0000020 BIT_MASK 0x4 /end MEASUREMENT
/begin MEASUREMENT Vbx_dfctr_sat_acel_pdl_secu_2 "" UBYTE _CNV_A_R_A_165_CM 1 0. 0. 255. DISPLAY_IDENTIFIER fm_sta_acel_pdl_secu_2.fm_static_bitfield.Vbx_dfctr_sat_xxx ECU_ADDRESS 0xc0000020 BIT_MASK 0x8 /end MEASUREMENT
/begin MEASUREMENT Vbx_rdn_acel_pdl_secu_2 "" UBYTE _CNV_A_R_A_165_CM 1 0. 0. 255. DISPLAY_IDENTIFIER fm_sta_acel_pdl_secu_2.fm_static_bitfield.Vbx_rdn_xxx ECU_ADDRESS 0xc0000020 BIT_MASK 0x40 /end MEASUREMENT
/begin MEASUREMENT Vxx_dtc_stt_acel_pdl_secu_2 "" UBYTE _CNV_A_R_A_165_CM 1 0. 0. 255. DISPLAY_IDENTIFIER fm_sta_acel_pdl_secu_2.Vxx_dtc_stt_xxx ECU_ADDRESS 0xc0000021 /end MEASUREMENT
/begin MEASUREMENT Vxx_dfctr_acel_pdl_tot "" UWORD _CNV_A_R_A_165_CM 1 0. 0. 65535. DISPLAY_IDENTIFIER fm_sta_acel_pdl_tot.Vxx_dfctr_xxx ECU_ADDRESS 0xc0000022 /end MEASUREMENT
/begin MEASUREMENT Vxx_rdn_acel_pdl_tot "" UWORD _CNV_A_R_A_165_CM 1 0. 0. 65535. DISPLAY_IDENTIFIER fm_sta_acel_pdl_tot.Vxx_rdn_xxx ECU_ADDRESS 0xc0000024 /end MEASUREMENT
/begin MEASUREMENT Vbx_cf_acel_pdl_tot "" UBYTE _CNV_A_R_A_165_CM 1 0. 0. 255. DISPLAY_IDENTIFIER fm_sta_acel_pdl_tot.fm_static_bitfield.Vbx_cf_xxx ECU_ADDRESS 0xc0000026 BIT_MASK 0x1 /end MEASUREMENT
/begin MEASUREMENT Vbx_clf_acel_pdl_tot "" UBYTE _CNV_A_R_A_165_CM 1 0. 0. 255. DISPLAY_IDENTIFIER fm_sta_acel_pdl_tot.fm_static_bitfield.Vbx_clf_xxx ECU_ADDRESS 0xc0000026 BIT_MASK 0x2 /end MEASUREMENT
/begin MEASUREMENT Vbx_df_old_acel_pdl_tot "" UBYTE _CNV_A_R_A_165_CM 1 0. 0. 255. DISPLAY_IDENTIFIER fm_sta_acel_pdl_tot.fm_static_bitfield.Vbx_df_old_xxx ECU_ADDRESS 0xc0000026 BIT_MASK 0x4 /end MEASUREMENT
/begin MEASUREMENT Vbx_dfctr_sat_acel_pdl_tot "" UBYTE _CNV_A_R_A_165_CM 1 0. 0. 255. DISPLAY_IDENTIFIER fm_sta_acel_pdl_tot.fm_static_bitfield.Vbx_dfctr_sat_xxx ECU_ADDRESS 0xc0000026 BIT_MASK 0x8 /end MEASUREMENT
/begin MEASUREMENT Vbx_rdn_acel_pdl_tot "" UBYTE _CNV_A_R_A_165_CM 1 0. 0. 255. DISPLAY_IDENTIFIER fm_sta_acel_pdl_tot.fm_static_bitfield.Vbx_rdn_xxx ECU_ADDRESS 0xc0000026 BIT_MASK 0x40 /end MEASUREMENT
/begin MEASUREMENT Vxx_dtc_stt_acel_pdl_tot "" UBYTE _CNV_A_R_A_165_CM 1 0. 0. 255. DISPLAY_IDENTIFIER fm_sta_acel_pdl_tot.Vxx_dtc_stt_xxx ECU_ADDRESS 0xc0000027 /end MEASUREMENT
/begin MEASUREMENT Vxx_dfctr_acel_pdl_v1_h "" UWORD _CNV_A_R_A_165_CM 1 0. 0. 65535. DISPLAY_IDENTIFIER fm_sta_acel_pdl_v1_h.Vxx_dfctr_xxx ECU_ADDRESS 0xc0000028 /end MEASUREMENT
/begin MEASUREMENT Vxx_rdn_acel_pdl_v1_h "" UWORD _CNV_A_R_A_165_CM 1 0. 0. 65535. DISPLAY_IDENTIFIER fm_sta_acel_pdl_v1_h.Vxx_rdn_xxx ECU_ADDRESS 0xc000002a /end MEASUREMENT
/begin MEASUREMENT Vbx_cf_acel_pdl_v1_h "" UBYTE _CNV_A_R_A_165_CM 1 0. 0. 255. DISPLAY_IDENTIFIER fm_sta_acel_pdl_v1_h.fm_static_bitfield.Vbx_cf_xxx ECU_ADDRESS 0xc000002c BIT_MASK 0x1 /end MEASUREMENT
/begin MEASUREMENT Vbx_clf_acel_pdl_v1_h "" UBYTE _CNV_A_R_A_165_CM 1 0. 0. 255. DISPLAY_IDENTIFIER fm_sta_acel_pdl_v1_h.fm_static_bitfield.Vbx_clf_xxx ECU_ADDRESS 0xc000002c BIT_MASK 0x2 /end MEASUREMENT
/begin MEASUREMENT Vbx_df_old_acel_pdl_v1_h "" UBYTE _CNV_A_R_A_165_CM 1 0. 0. 255. DISPLAY_IDENTIFIER fm_sta_acel_pdl_v1_h.fm_static_bitfield.Vbx_df_old_xxx ECU_ADDRESS 0xc000002c BIT_MASK 0x4 /end MEASUREMENT
/begin MEASUREMENT Vbx_dfctr_sat_acel_pdl_v1_h "" UBYTE _CNV_A_R_A_165_CM 1 0. 0. 255. DISPLAY_IDENTIFIER fm_sta_acel_pdl_v1_h.fm_static_bitfield.Vbx_dfctr_sat_xxx ECU_ADDRESS 0xc000002c BIT_MASK 0x8 /end MEASUREMENT
/begin MEASUREMENT Vbx_rdn_acel_pdl_v1_h "" UBYTE _CNV_A_R_A_165_CM 1 0. 0. 255. DISPLAY_IDENTIFIER fm_sta_acel_pdl_v1_h.fm_static_bitfield.Vbx_rdn_xxx ECU_ADDRESS 0xc000002c BIT_MASK 0x40 /end MEASUREMENT
/begin MEASUREMENT Vxx_dtc_stt_acel_pdl_v1_h "" UBYTE _CNV_A_R_A_165_CM 1 0. 0. 255. DISPLAY_IDENTIFIER fm_sta_acel_pdl_v1_h.Vxx_dtc_stt_xxx ECU_ADDRESS 0xc000002d /end MEASUREMENT
/begin MEASUREMENT Vxx_dfctr_acel_pdl_v1_l "" UWORD _CNV_A_R_A_165_CM 1 0. 0. 65535. DISPLAY_IDENTIFIER fm_sta_acel_pdl_v1_l.Vxx_dfctr_xxx ECU_ADDRESS 0xc000002e /end MEASUREMENT
/begin MEASUREMENT Vxx_rdn_acel_pdl_v1_l "" UWORD _CNV_A_R_A_165_CM 1 0. 0. 65535. DISPLAY_IDENTIFIER fm_sta_acel_pdl_v1_l.Vxx_rdn_xxx ECU_ADDRESS 0xc0000030 /end MEASUREMENT
/begin MEASUREMENT Vbx_cf_acel_pdl_v1_l "" UBYTE _CNV_A_R_A_165_CM 1 0. 0. 255. DISPLAY_IDENTIFIER fm_sta_acel_pdl_v1_l.fm_static_bitfield.Vbx_cf_xxx ECU_ADDRESS 0xc0000032 BIT_MASK 0x1 /end MEASUREMENT
/begin MEASUREMENT Vbx_clf_acel_pdl_v1_l "" UBYTE _CNV_A_R_A_165_CM 1 0. 0. 255. DISPLAY_IDENTIFIER fm_sta_acel_pdl_v1_l.fm_static_bitfield.Vbx_clf_xxx ECU_ADDRESS 0xc0000032 BIT_MASK 0x2 /end MEASUREMENT
/begin MEASUREMENT Vbx_df_old_acel_pdl_v1_l "" UBYTE _CNV_A_R_A_165_CM 1 0. 0. 255. DISPLAY_IDENTIFIER fm_sta_acel_pdl_v1_l.fm_static_bitfield.Vbx_df_old_xxx ECU_ADDRESS 0xc0000032 BIT_MASK 0x4 /end MEASUREMENT
/begin MEASUREMENT Vbx_dfctr_sat_acel_pdl_v1_l "" UBYTE _CNV_A_R_A_165_CM 1 0. 0. 255. DISPLAY_IDENTIFIER fm_sta_acel_pdl_v1_l.fm_static_bitfield.Vbx_dfctr_sat_xxx ECU_ADDRESS 0xc0000032 BIT_MASK 0x8 /end MEASUREMENT
/begin MEASUREMENT Vbx_rdn_acel_pdl_v1_l "" UBYTE _CNV_A_R_A_165_CM 1 0. 0. 255. DISPLAY_IDENTIFIER fm_sta_acel_pdl_v1_l.fm_static_bitfield.Vbx_rdn_xxx ECU_ADDRESS 0xc0000032 BIT_MASK 0x40 /end MEASUREMENT
/begin MEASUREMENT Vxx_dtc_stt_acel_pdl_v1_l "" UBYTE _CNV_A_R_A_165_CM 1 0. 0. 255. DISPLAY_IDENTIFIER fm_sta_acel_pdl_v1_l.Vxx_dtc_stt_xxx ECU_ADDRESS 0xc0000033 /end MEASUREMENT
/begin MEASUREMENT Vxx_dfctr_acel_pdl_v2_h "" UWORD _CNV_A_R_A_165_CM 1 0. 0. 65535. DISPLAY_IDENTIFIER fm_sta_acel_pdl_v2_h.Vxx_dfctr_xxx ECU_ADDRESS 0xc0000034 /end MEASUREMENT
/begin MEASUREMENT Vxx_rdn_acel_pdl_v2_h "" UWORD _CNV_A_R_A_165_CM 1 0. 0. 65535. DISPLAY_IDENTIFIER fm_sta_acel_pdl_v2_h.Vxx_rdn_xxx ECU_ADDRESS 0xc0000036 /end MEASUREMENT
/begin MEASUREMENT Vbx_cf_acel_pdl_v2_h "" UBYTE _CNV_A_R_A_165_CM 1 0. 0. 255. DISPLAY_IDENTIFIER fm_sta_acel_pdl_v2_h.fm_static_bitfield.Vbx_cf_xxx ECU_ADDRESS 0xc0000038 BIT_MASK 0x1 /end MEASUREMENT
/begin MEASUREMENT Vbx_clf_acel_pdl_v2_h "" UBYTE _CNV_A_R_A_165_CM 1 0. 0. 255. DISPLAY_IDENTIFIER fm_sta_acel_pdl_v2_h.fm_static_bitfield.Vbx_clf_xxx ECU_ADDRESS 0xc0000038 BIT_MASK 0x2 /end MEASUREMENT
/begin MEASUREMENT Vbx_df_old_acel_pdl_v2_h "" UBYTE _CNV_A_R_A_165_CM 1 0. 0. 255. DISPLAY_IDENTIFIER fm_sta_acel_pdl_v2_h.fm_static_bitfield.Vbx_df_old_xxx ECU_ADDRESS 0xc0000038 BIT_MASK 0x4 /end MEASUREMENT
/begin MEASUREMENT Vbx_dfctr_sat_acel_pdl_v2_h "" UBYTE _CNV_A_R_A_165_CM 1 0. 0. 255. DISPLAY_IDENTIFIER fm_sta_acel_pdl_v2_h.fm_static_bitfield.Vbx_dfctr_sat_xxx ECU_ADDRESS 0xc0000038 BIT_MASK 0x8 /end MEASUREMENT
/begin MEASUREMENT Vbx_rdn_acel_pdl_v2_h "" UBYTE _CNV_A_R_A_165_CM 1 0. 0. 255. DISPLAY_IDENTIFIER fm_sta_acel_pdl_v2_h.fm_static_bitfield.Vbx_rdn_xxx ECU_ADDRESS 0xc0000038 BIT_MASK 0x40 /end MEASUREMENT
/begin MEASUREMENT Vxx_dtc_stt_acel_pdl_v2_h "" UBYTE _CNV_A_R_A_165_CM 1 0. 0. 255. DISPLAY_IDENTIFIER fm_sta_acel_pdl_v2_h.Vxx_dtc_stt_xxx ECU_ADDRESS 0xc0000039 /end MEASUREMENT
/begin MEASUREMENT Vxx_dfctr_acel_pdl_v2_l "" UWORD _CNV_A_R_A_165_CM 1 0. 0. 65535. DISPLAY_IDENTIFIER fm_sta_acel_pdl_v2_l.Vxx_dfctr_xxx ECU_ADDRESS 0xc000003a /end MEASUREMENT
/begin MEASUREMENT Vxx_rdn_acel_pdl_v2_l "" UWORD _CNV_A_R_A_165_CM 1 0. 0. 65535. DISPLAY_IDENTIFIER fm_sta_acel_pdl_v2_l.Vxx_rdn_xxx ECU_ADDRESS 0xc000003c /end MEASUREMENT
/begin MEASUREMENT Vbx_cf_acel_pdl_v2_l "" UBYTE _CNV_A_R_A_165_CM 1 0. 0. 255. DISPLAY_IDENTIFIER fm_sta_acel_pdl_v2_l.fm_static_bitfield.Vbx_cf_xxx ECU_ADDRESS 0xc000003e BIT_MASK 0x1 /end MEASUREMENT
/begin MEASUREMENT Vbx_clf_acel_pdl_v2_l "" UBYTE _CNV_A_R_A_165_CM 1 0. 0. 255. DISPLAY_IDENTIFIER fm_sta_acel_pdl_v2_l.fm_static_bitfield.Vbx_clf_xxx ECU_ADDRESS 0xc000003e BIT_MASK 0x2 /end MEASUREMENT
/begin MEASUREMENT Vbx_df_old_acel_pdl_v2_l "" UBYTE _CNV_A_R_A_165_CM 1 0. 0. 255. DISPLAY_IDENTIFIER fm_sta_acel_pdl_v2_l.fm_static_bitfield.Vbx_df_old_xxx ECU_ADDRESS 0xc000003e BIT_MASK 0x4 /end MEASUREMENT
/begin MEASUREMENT Vbx_dfctr_sat_acel_pdl_v2_l "" UBYTE _CNV_A_R_A_165_CM 1 0. 0. 255. DISPLAY_IDENTIFIER fm_sta_acel_pdl_v2_l.fm_static_bitfield.Vbx_dfctr_sat_xxx ECU_ADDRESS 0xc000003e BIT_MASK 0x8 /end MEASUREMENT
/begin MEASUREMENT Vbx_rdn_acel_pdl_v2_l "" UBYTE _CNV_A_R_A_165_CM 1 0. 0. 255. DISPLAY_IDENTIFIER fm_sta_acel_pdl_v2_l.fm_static_bitfield.Vbx_rdn_xxx ECU_ADDRESS 0xc000003e BIT_MASK 0x40 /end MEASUREMENT
/begin MEASUREMENT Vxx_dtc_stt_acel_pdl_v2_l "" UBYTE _CNV_A_R_A_165_CM 1 0. 0. 255. DISPLAY_IDENTIFIER fm_sta_acel_pdl_v2_l.Vxx_dtc_stt_xxx ECU_ADDRESS 0xc000003f /end MEASUREMENT
/begin MEASUREMENT Vxx_dfctr_actr_rly_oc "" UWORD _CNV_A_R_A_165_CM 1 0. 0. 65535. DISPLAY_IDENTIFIER fm_sta_actr_rly_oc.Vxx_dfctr_xxx ECU_ADDRESS 0xc0000040 /end MEASUREMENT
/begin MEASUREMENT Vxx_rdn_actr_rly_oc "" UWORD _CNV_A_R_A_165_CM 1 0. 0. 65535. DISPLAY_IDENTIFIER fm_sta_actr_rly_oc.Vxx_rdn_xxx ECU_ADDRESS 0xc0000042 /end MEASUREMENT
/begin MEASUREMENT Vbx_cf_actr_rly_oc "" UBYTE _CNV_A_R_A_165_CM 1 0. 0. 255. DISPLAY_IDENTIFIER fm_sta_actr_rly_oc.fm_static_bitfield.Vbx_cf_xxx ECU_ADDRESS 0xc0000044 BIT_MASK 0x1 /end MEASUREMENT
/begin MEASUREMENT Vbx_clf_actr_rly_oc "" UBYTE _CNV_A_R_A_165_CM 1 0. 0. 255. DISPLAY_IDENTIFIER fm_sta_actr_rly_oc.fm_static_bitfield.Vbx_clf_xxx ECU_ADDRESS 0xc0000044 BIT_MASK 0x2 /end MEASUREMENT
/begin MEASUREMENT Vbx_df_old_actr_rly_oc "" UBYTE _CNV_A_R_A_165_CM 1 0. 0. 255. DISPLAY_IDENTIFIER fm_sta_actr_rly_oc.fm_static_bitfield.Vbx_df_old_xxx ECU_ADDRESS 0xc0000044 BIT_MASK 0x4 /end MEASUREMENT
/begin MEASUREMENT Vbx_dfctr_sat_actr_rly_oc "" UBYTE _CNV_A_R_A_165_CM 1 0. 0. 255. DISPLAY_IDENTIFIER fm_sta_actr_rly_oc.fm_static_bitfield.Vbx_dfctr_sat_xxx ECU_ADDRESS 0xc0000044 BIT_MASK 0x8 /end MEASUREMENT
/begin MEASUREMENT Vbx_rdn_actr_rly_oc "" UBYTE _CNV_A_R_A_165_CM 1 0. 0. 255. DISPLAY_IDENTIFIER fm_sta_actr_rly_oc.fm_static_bitfield.Vbx_rdn_xxx ECU_ADDRESS 0xc0000044 BIT_MASK 0x40 /end MEASUREMENT
/begin MEASUREMENT Vxx_dtc_stt_actr_rly_oc "" UBYTE _CNV_A_R_A_165_CM 1 0. 0. 255. DISPLAY_IDENTIFIER fm_sta_actr_rly_oc.Vxx_dtc_stt_xxx ECU_ADDRESS 0xc0000045 /end MEASUREMENT
/begin MEASUREMENT Vxx_dfctr_actr_rly_scg "" UWORD _CNV_A_R_A_165_CM 1 0. 0. 65535. DISPLAY_IDENTIFIER fm_sta_actr_rly_scg.Vxx_dfctr_xxx ECU_ADDRESS 0xc0000046 /end MEASUREMENT
/begin MEASUREMENT Vxx_rdn_actr_rly_scg "" UWORD _CNV_A_R_A_165_CM 1 0. 0. 65535. DISPLAY_IDENTIFIER fm_sta_actr_rly_scg.Vxx_rdn_xxx ECU_ADDRESS 0xc0000048 /end MEASUREMENT
/begin MEASUREMENT Vbx_cf_actr_rly_scg "" UBYTE _CNV_A_R_A_165_CM 1 0. 0. 255. DISPLAY_IDENTIFIER fm_sta_actr_rly_scg.fm_static_bitfield.Vbx_cf_xxx ECU_ADDRESS 0xc000004a BIT_MASK 0x1 /end MEASUREMENT
/begin MEASUREMENT Vbx_clf_actr_rly_scg "" UBYTE _CNV_A_R_A_165_CM 1 0. 0. 255. DISPLAY_IDENTIFIER fm_sta_actr_rly_scg.fm_static_bitfield.Vbx_clf_xxx ECU_ADDRESS 0xc000004a BIT_MASK 0x2 /end MEASUREMENT
/begin MEASUREMENT Vbx_df_old_actr_rly_scg "" UBYTE _CNV_A_R_A_165_CM 1 0. 0. 255. DISPLAY_IDENTIFIER fm_sta_actr_rly_scg.fm_static_bitfield.Vbx_df_old_xxx ECU_ADDRESS 0xc000004a BIT_MASK 0x4 /end MEASUREMENT
/begin MEASUREMENT Vbx_dfctr_sat_actr_rly_scg "" UBYTE _CNV_A_R_A_165_CM 1 0. 0. 255. DISPLAY_IDENTIFIER fm_sta_actr_rly_scg.fm_static_bitfield.Vbx_dfctr_sat_xxx ECU_ADDRESS 0xc000004a BIT_MASK 0x8 /end MEASUREMENT
/begin MEASUREMENT Vbx_rdn_actr_rly_scg "" UBYTE _CNV_A_R_A_165_CM 1 0. 0. 255. DISPLAY_IDENTIFIER fm_sta_actr_rly_scg.fm_static_bitfield.Vbx_rdn_xxx ECU_ADDRESS 0xc000004a BIT_MASK 0x40 /end MEASUREMENT
/begin MEASUREMENT Vxx_dtc_stt_actr_rly_scg "" UBYTE _CNV_A_R_A_165_CM 1 0. 0. 255. DISPLAY_IDENTIFIER fm_sta_actr_rly_scg.Vxx_dtc_stt_xxx ECU_ADDRESS 0xc000004b /end MEASUREMENT
/begin MEASUREMENT Vxx_dfctr_actr_rly_scw "" UWORD _CNV_A_R_A_165_CM 1 0. 0. 65535. DISPLAY_IDENTIFIER fm_sta_actr_rly_scw.Vxx_dfctr_xxx ECU_ADDRESS 0xc000004c /end MEASUREMENT
/begin MEASUREMENT Vxx_rdn_actr_rly_scw "" UWORD _CNV_A_R_A_165_CM 1 0. 0. 65535. DISPLAY_IDENTIFIER fm_sta_actr_rly_scw.Vxx_rdn_xxx ECU_ADDRESS 0xc000004e /end MEASUREMENT
/begin MEASUREMENT Vbx_cf_actr_rly_scw "" UBYTE _CNV_A_R_A_165_CM 1 0. 0. 255. DISPLAY_IDENTIFIER fm_sta_actr_rly_scw.fm_static_bitfield.Vbx_cf_xxx ECU_ADDRESS 0xc0000050 BIT_MASK 0x1 /end MEASUREMENT
/begin MEASUREMENT Vbx_clf_actr_rly_scw "" UBYTE _CNV_A_R_A_165_CM 1 0. 0. 255. DISPLAY_IDENTIFIER fm_sta_actr_rly_scw.fm_static_bitfield.Vbx_clf_xxx ECU_ADDRESS 0xc0000050 BIT_MASK 0x2 /end MEASUREMENT
/begin MEASUREMENT Vbx_df_old_actr_rly_scw "" UBYTE _CNV_A_R_A_165_CM 1 0. 0. 255. DISPLAY_IDENTIFIER fm_sta_actr_rly_scw.fm_static_bitfield.Vbx_df_old_xxx ECU_ADDRESS 0xc0000050 BIT_MASK 0x4 /end MEASUREMENT
/begin MEASUREMENT Vbx_dfctr_sat_actr_rly_scw "" UBYTE _CNV_A_R_A_165_CM 1 0. 0. 255. DISPLAY_IDENTIFIER fm_sta_actr_rly_scw.fm_static_bitfield.Vbx_dfctr_sat_xxx ECU_ADDRESS 0xc0000050 BIT_MASK 0x8 /end MEASUREMENT
/begin MEASUREMENT Vbx_rdn_actr_rly_scw "" UBYTE _CNV_A_R_A_165_CM 1 0. 0. 255. DISPLAY_IDENTIFIER fm_sta_actr_rly_scw.fm_static_bitfield.Vbx_rdn_xxx ECU_ADDRESS 0xc0000050 BIT_MASK 0x40 /end MEASUREMENT
/begin MEASUREMENT Vxx_dtc_stt_actr_rly_scw "" UBYTE _CNV_A_R_A_165_CM 1 0. 0. 255. DISPLAY_IDENTIFIER fm_sta_actr_rly_scw.Vxx_dtc_stt_xxx ECU_ADDRESS 0xc0000051 /end MEASUREMENT
/begin MEASUREMENT Vxx_dfctr_agb_data_chr "" UWORD _CNV_A_R_A_165_CM 1 0. 0. 65535. DISPLAY_IDENTIFIER fm_sta_agb_data_chr.Vxx_dfctr_xxx ECU_ADDRESS 0xc0000052 /end MEASUREMENT
/begin MEASUREMENT Vxx_rdn_agb_data_chr "" UWORD _CNV_A_R_A_165_CM 1 0. 0. 65535. DISPLAY_IDENTIFIER fm_sta_agb_data_chr.Vxx_rdn_xxx ECU_ADDRESS 0xc0000054 /end MEASUREMENT
/begin MEASUREMENT Vbx_cf_agb_data_chr "" UBYTE _CNV_A_R_A_165_CM 1 0. 0. 255. DISPLAY_IDENTIFIER fm_sta_agb_data_chr.fm_static_bitfield.Vbx_cf_xxx ECU_ADDRESS 0xc0000056 BIT_MASK 0x1 /end MEASUREMENT
/begin MEASUREMENT Vbx_clf_agb_data_chr "" UBYTE _CNV_A_R_A_165_CM 1 0. 0. 255. DISPLAY_IDENTIFIER fm_sta_agb_data_chr.fm_static_bitfield.Vbx_clf_xxx ECU_ADDRESS 0xc0000056 BIT_MASK 0x2 /end MEASUREMENT
/begin MEASUREMENT Vbx_df_old_agb_data_chr "" UBYTE _CNV_A_R_A_165_CM 1 0. 0. 255. DISPLAY_IDENTIFIER fm_sta_agb_data_chr.fm_static_bitfield.Vbx_df_old_xxx ECU_ADDRESS 0xc0000056 BIT_MASK 0x4 /end MEASUREMENT
/begin MEASUREMENT Vbx_dfctr_sat_agb_data_chr "" UBYTE _CNV_A_R_A_165_CM 1 0. 0. 255. DISPLAY_IDENTIFIER fm_sta_agb_data_chr.fm_static_bitfield.Vbx_dfctr_sat_xxx ECU_ADDRESS 0xc0000056 BIT_MASK 0x8 /end MEASUREMENT
/begin MEASUREMENT Vbx_rdn_agb_data_chr "" UBYTE _CNV_A_R_A_165_CM 1 0. 0. 255. DISPLAY_IDENTIFIER fm_sta_agb_data_chr.fm_static_bitfield.Vbx_rdn_xxx ECU_ADDRESS 0xc0000056 BIT_MASK 0x40 /end MEASUREMENT
/begin MEASUREMENT Vxx_dtc_stt_agb_data_chr "" UBYTE _CNV_A_R_A_165_CM 1 0. 0. 255. DISPLAY_IDENTIFIER fm_sta_agb_data_chr.Vxx_dtc_stt_xxx ECU_ADDRESS 0xc0000057 /end MEASUREMENT
/begin MEASUREMENT Vxx_dfctr_agb_data_seq_ctr "" UWORD _CNV_A_R_A_165_CM 1 0. 0. 65535. DISPLAY_IDENTIFIER fm_sta_agb_data_seq_ctr.Vxx_dfctr_xxx ECU_ADDRESS 0xc0000058 /end MEASUREMENT
/begin MEASUREMENT Vxx_rdn_agb_data_seq_ctr "" UWORD _CNV_A_R_A_165_CM 1 0. 0. 65535. DISPLAY_IDENTIFIER fm_sta_agb_data_seq_ctr.Vxx_rdn_xxx ECU_ADDRESS 0xc000005a /end MEASUREMENT
/begin MEASUREMENT Vbx_cf_agb_data_seq_ctr "" UBYTE _CNV_A_R_A_165_CM 1 0. 0. 255. DISPLAY_IDENTIFIER fm_sta_agb_data_seq_ctr.fm_static_bitfield.Vbx_cf_xxx ECU_ADDRESS 0xc000005c BIT_MASK 0x1 /end MEASUREMENT
/begin MEASUREMENT Vbx_clf_agb_data_seq_ctr "" UBYTE _CNV_A_R_A_165_CM 1 0. 0. 255. DISPLAY_IDENTIFIER fm_sta_agb_data_seq_ctr.fm_static_bitfield.Vbx_clf_xxx ECU_ADDRESS 0xc000005c BIT_MASK 0x2 /end MEASUREMENT
/begin MEASUREMENT Vbx_df_old_agb_data_seq_ctr "" UBYTE _CNV_A_R_A_165_CM 1 0. 0. 255. DISPLAY_IDENTIFIER fm_sta_agb_data_seq_ctr.fm_static_bitfield.Vbx_df_old_xxx ECU_ADDRESS 0xc000005c BIT_MASK 0x4 /end MEASUREMENT
/begin MEASUREMENT Vbx_dfctr_sat_agb_data_seq_ctr "" UBYTE _CNV_A_R_A_165_CM 1 0. 0. 255. DISPLAY_IDENTIFIER fm_sta_agb_data_seq_ctr.fm_static_bitfield.Vbx_dfctr_sat_xxx ECU_ADDRESS 0xc000005c BIT_MASK 0x8 /end MEASUREMENT
/begin MEASUREMENT Vbx_rdn_agb_data_seq_ctr "" UBYTE _CNV_A_R_A_165_CM 1 0. 0. 255. DISPLAY_IDENTIFIER fm_sta_agb_data_seq_ctr.fm_static_bitfield.Vbx_rdn_xxx ECU_ADDRESS 0xc000005c BIT_MASK 0x40 /end MEASUREMENT
/begin MEASUREMENT Vxx_dtc_stt_agb_data_seq_ctr "" UBYTE _CNV_A_R_A_165_CM 1 0. 0. 255. DISPLAY_IDENTIFIER fm_sta_agb_data_seq_ctr.Vxx_dtc_stt_xxx ECU_ADDRESS 0xc000005d /end MEASUREMENT
/begin MEASUREMENT Vxx_dfctr_agb_data_tout "" UWORD _CNV_A_R_A_165_CM 1 0. 0. 65535. DISPLAY_IDENTIFIER fm_sta_agb_data_tout.Vxx_dfctr_xxx ECU_ADDRESS 0xc000005e /end MEASUREMENT
/begin MEASUREMENT Vxx_rdn_agb_data_tout "" UWORD _CNV_A_R_A_165_CM 1 0. 0. 65535. DISPLAY_IDENTIFIER fm_sta_agb_data_tout.Vxx_rdn_xxx ECU_ADDRESS 0xc0000060 /end MEASUREMENT
/begin MEASUREMENT Vbx_cf_agb_data_tout "" UBYTE _CNV_A_R_A_165_CM 1 0. 0. 255. DISPLAY_IDENTIFIER fm_sta_agb_data_tout.fm_static_bitfield.Vbx_cf_xxx ECU_ADDRESS 0xc0000062 BIT_MASK 0x1 /end MEASUREMENT
/begin MEASUREMENT Vbx_clf_agb_data_tout "" UBYTE _CNV_A_R_A_165_CM 1 0. 0. 255. DISPLAY_IDENTIFIER fm_sta_agb_data_tout.fm_static_bitfield.Vbx_clf_xxx ECU_ADDRESS 0xc0000062 BIT_MASK 0x2 /end MEASUREMENT
/begin MEASUREMENT Vbx_df_old_agb_data_tout "" UBYTE _CNV_A_R_A_165_CM 1 0. 0. 255. DISPLAY_IDENTIFIER fm_sta_agb_data_tout.fm_static_bitfield.Vbx_df_old_xxx ECU_ADDRESS 0xc0000062 BIT_MASK 0x4 /end MEASUREMENT
/begin MEASUREMENT Vbx_dfctr_sat_agb_data_tout "" UBYTE _CNV_A_R_A_165_CM 1 0. 0. 255. DISPLAY_IDENTIFIER fm_sta_agb_data_tout.fm_static_bitfield.Vbx_dfctr_sat_xxx ECU_ADDRESS 0xc0000062 BIT_MASK 0x8 /end MEASUREMENT
/begin MEASUREMENT Vbx_rdn_agb_data_tout "" UBYTE _CNV_A_R_A_165_CM 1 0. 0. 255. DISPLAY_IDENTIFIER fm_sta_agb_data_tout.fm_static_bitfield.Vbx_rdn_xxx ECU_ADDRESS 0xc0000062 BIT_MASK 0x40 /end MEASUREMENT
/begin MEASUREMENT Vxx_dtc_stt_agb_data_tout "" UBYTE _CNV_A_R_A_165_CM 1 0. 0. 255. DISPLAY_IDENTIFIER fm_sta_agb_data_tout.Vxx_dtc_stt_xxx ECU_ADDRESS 0xc0000063 /end MEASUREMENT
/begin MEASUREMENT Vxx_dfctr_agb_no_frm "" UWORD _CNV_A_R_A_165_CM 1 0. 0. 65535. DISPLAY_IDENTIFIER fm_sta_agb_no_frm.Vxx_dfctr_xxx ECU_ADDRESS 0xc0000064 /end MEASUREMENT
/begin MEASUREMENT Vxx_rdn_agb_no_frm "" UWORD _CNV_A_R_A_165_CM 1 0. 0. 65535. DISPLAY_IDENTIFIER fm_sta_agb_no_frm.Vxx_rdn_xxx ECU_ADDRESS 0xc0000066 /end MEASUREMENT
/begin MEASUREMENT Vbx_cf_agb_no_frm "" UBYTE _CNV_A_R_A_165_CM 1 0. 0. 255. DISPLAY_IDENTIFIER fm_sta_agb_no_frm.fm_static_bitfield.Vbx_cf_xxx ECU_ADDRESS 0xc0000068 BIT_MASK 0x1 /end MEASUREMENT
/begin MEASUREMENT Vbx_clf_agb_no_frm "" UBYTE _CNV_A_R_A_165_CM 1 0. 0. 255. DISPLAY_IDENTIFIER fm_sta_agb_no_frm.fm_static_bitfield.Vbx_clf_xxx ECU_ADDRESS 0xc0000068 BIT_MASK 0x2 /end MEASUREMENT
/begin MEASUREMENT Vbx_df_old_agb_no_frm "" UBYTE _CNV_A_R_A_165_CM 1 0. 0. 255. DISPLAY_IDENTIFIER fm_sta_agb_no_frm.fm_static_bitfield.Vbx_df_old_xxx ECU_ADDRESS 0xc0000068 BIT_MASK 0x4 /end MEASUREMENT
/begin MEASUREMENT Vbx_dfctr_sat_agb_no_frm "" UBYTE _CNV_A_R_A_165_CM 1 0. 0. 255. DISPLAY_IDENTIFIER fm_sta_agb_no_frm.fm_static_bitfield.Vbx_dfctr_sat_xxx ECU_ADDRESS 0xc0000068 BIT_MASK 0x8 /end MEASUREMENT
/begin MEASUREMENT Vbx_rdn_agb_no_frm "" UBYTE _CNV_A_R_A_165_CM 1 0. 0. 255. DISPLAY_IDENTIFIER fm_sta_agb_no_frm.fm_static_bitfield.Vbx_rdn_xxx ECU_ADDRESS 0xc0000068 BIT_MASK 0x40 /end MEASUREMENT
/begin MEASUREMENT Vxx_dtc_stt_agb_no_frm "" UBYTE _CNV_A_R_A_165_CM 1 0. 0. 255. DISPLAY_IDENTIFIER fm_sta_agb_no_frm.Vxx_dtc_stt_xxx ECU_ADDRESS 0xc0000069 /end MEASUREMENT
/begin MEASUREMENT Vxx_dfctr_bgin_clu_cmp "" UWORD _CNV_A_R_A_165_CM 1 0. 0. 65535. DISPLAY_IDENTIFIER fm_sta_bgin_clu_cmp.Vxx_dfctr_xxx ECU_ADDRESS 0xc00001f6 /end MEASUREMENT
/begin MEASUREMENT Vxx_rdn_bgin_clu_cmp "" UWORD _CNV_A_R_A_165_CM 1 0. 0. 65535. DISPLAY_IDENTIFIER fm_sta_bgin_clu_cmp.Vxx_rdn_xxx ECU_ADDRESS 0xc00001f8 /end MEASUREMENT
/begin MEASUREMENT Vbx_cf_bgin_clu_cmp "" UBYTE _CNV_A_R_A_165_CM 1 0. 0. 255. DISPLAY_IDENTIFIER fm_sta_bgin_clu_cmp.fm_static_bitfield.Vbx_cf_xxx ECU_ADDRESS 0xc00001fa BIT_MASK 0x1 /end MEASUREMENT
/begin MEASUREMENT Vbx_clf_bgin_clu_cmp "" UBYTE _CNV_A_R_A_165_CM 1 0. 0. 255. DISPLAY_IDENTIFIER fm_sta_bgin_clu_cmp.fm_static_bitfield.Vbx_clf_xxx ECU_ADDRESS 0xc00001fa BIT_MASK 0x2 /end MEASUREMENT
/begin MEASUREMENT Vbx_df_old_bgin_clu_cmp "" UBYTE _CNV_A_R_A_165_CM 1 0. 0. 255. DISPLAY_IDENTIFIER fm_sta_bgin_clu_cmp.fm_static_bitfield.Vbx_df_old_xxx ECU_ADDRESS 0xc00001fa BIT_MASK 0x4 /end MEASUREMENT
/begin MEASUREMENT Vbx_dfctr_sat_bgin_clu_cmp "" UBYTE _CNV_A_R_A_165_CM 1 0. 0. 255. DISPLAY_IDENTIFIER fm_sta_bgin_clu_cmp.fm_static_bitfield.Vbx_dfctr_sat_xxx ECU_ADDRESS 0xc00001fa BIT_MASK 0x8 /end MEASUREMENT
/begin MEASUREMENT Vbx_rdn_bgin_clu_cmp "" UBYTE _CNV_A_R_A_165_CM 1 0. 0. 255. DISPLAY_IDENTIFIER fm_sta_bgin_clu_cmp.fm_static_bitfield.Vbx_rdn_xxx ECU_ADDRESS 0xc00001fa BIT_MASK 0x40 /end MEASUREMENT
/begin MEASUREMENT Vxx_dtc_stt_bgin_clu_cmp "" UBYTE _CNV_A_R_A_165_CM 1 0. 0. 255. DISPLAY_IDENTIFIER fm_sta_bgin_clu_cmp.Vxx_dtc_stt_xxx ECU_ADDRESS 0xc00001fb /end MEASUREMENT
/begin MEASUREMENT Vxx_dfctr_bgin_clu_nok "" UWORD _CNV_A_R_A_165_CM 1 0. 0. 65535. DISPLAY_IDENTIFIER fm_sta_bgin_clu_nok.Vxx_dfctr_xxx ECU_ADDRESS 0xc00001fc /end MEASUREMENT
/begin MEASUREMENT Vxx_rdn_bgin_clu_nok "" UWORD _CNV_A_R_A_165_CM 1 0. 0. 65535. DISPLAY_IDENTIFIER fm_sta_bgin_clu_nok.Vxx_rdn_xxx ECU_ADDRESS 0xc00001fe /end MEASUREMENT
/begin MEASUREMENT Vbx_cf_bgin_clu_nok "" UBYTE _CNV_A_R_A_165_CM 1 0. 0. 255. DISPLAY_IDENTIFIER fm_sta_bgin_clu_nok.fm_static_bitfield.Vbx_cf_xxx ECU_ADDRESS 0xc0000200 BIT_MASK 0x1 /end MEASUREMENT
/begin MEASUREMENT Vbx_clf_bgin_clu_nok "" UBYTE _CNV_A_R_A_165_CM 1 0. 0. 255. DISPLAY_IDENTIFIER fm_sta_bgin_clu_nok.fm_static_bitfield.Vbx_clf_xxx ECU_ADDRESS 0xc0000200 BIT_MASK 0x2 /end MEASUREMENT
/begin MEASUREMENT Vbx_df_old_bgin_clu_nok "" UBYTE _CNV_A_R_A_165_CM 1 0. 0. 255. DISPLAY_IDENTIFIER fm_sta_bgin_clu_nok.fm_static_bitfield.Vbx_df_old_xxx ECU_ADDRESS 0xc0000200 BIT_MASK 0x4 /end MEASUREMENT
/begin MEASUREMENT Vbx_dfctr_sat_bgin_clu_nok "" UBYTE _CNV_A_R_A_165_CM 1 0. 0. 255. DISPLAY_IDENTIFIER fm_sta_bgin_clu_nok.fm_static_bitfield.Vbx_dfctr_sat_xxx ECU_ADDRESS 0xc0000200 BIT_MASK 0x8 /end MEASUREMENT
/begin MEASUREMENT Vbx_rdn_bgin_clu_nok "" UBYTE _CNV_A_R_A_165_CM 1 0. 0. 255. DISPLAY_IDENTIFIER fm_sta_bgin_clu_nok.fm_static_bitfield.Vbx_rdn_xxx ECU_ADDRESS 0xc0000200 BIT_MASK 0x40 /end MEASUREMENT
/begin MEASUREMENT Vxx_dtc_stt_bgin_clu_nok "" UBYTE _CNV_A_R_A_165_CM 1 0. 0. 255. DISPLAY_IDENTIFIER fm_sta_bgin_clu_nok.Vxx_dtc_stt_xxx ECU_ADDRESS 0xc0000201 /end MEASUREMENT
/begin MEASUREMENT Vxx_dfctr_brk_pdl_cmp "" UWORD _CNV_A_R_A_165_CM 1 0. 0. 65535. DISPLAY_IDENTIFIER fm_sta_brk_pdl_cmp.Vxx_dfctr_xxx ECU_ADDRESS 0xc0000202 /end MEASUREMENT
/begin MEASUREMENT Vxx_rdn_brk_pdl_cmp "" UWORD _CNV_A_R_A_165_CM 1 0. 0. 65535. DISPLAY_IDENTIFIER fm_sta_brk_pdl_cmp.Vxx_rdn_xxx ECU_ADDRESS 0xc0000204 /end MEASUREMENT
/begin MEASUREMENT Vbx_cf_brk_pdl_cmp "" UBYTE _CNV_A_R_A_165_CM 1 0. 0. 255. DISPLAY_IDENTIFIER fm_sta_brk_pdl_cmp.fm_static_bitfield.Vbx_cf_xxx ECU_ADDRESS 0xc0000206 BIT_MASK 0x1 /end MEASUREMENT
/begin MEASUREMENT Vbx_clf_brk_pdl_cmp "" UBYTE _CNV_A_R_A_165_CM 1 0. 0. 255. DISPLAY_IDENTIFIER fm_sta_brk_pdl_cmp.fm_static_bitfield.Vbx_clf_xxx ECU_ADDRESS 0xc0000206 BIT_MASK 0x2 /end MEASUREMENT
/begin MEASUREMENT Vbx_df_old_brk_pdl_cmp "" UBYTE _CNV_A_R_A_165_CM 1 0. 0. 255. DISPLAY_IDENTIFIER fm_sta_brk_pdl_cmp.fm_static_bitfield.Vbx_df_old_xxx ECU_ADDRESS 0xc0000206 BIT_MASK 0x4 /end MEASUREMENT
/begin MEASUREMENT Vbx_dfctr_sat_brk_pdl_cmp "" UBYTE _CNV_A_R_A_165_CM 1 0. 0. 255. DISPLAY_IDENTIFIER fm_sta_brk_pdl_cmp.fm_static_bitfield.Vbx_dfctr_sat_xxx ECU_ADDRESS 0xc0000206 BIT_MASK 0x8 /end MEASUREMENT
/begin MEASUREMENT Vbx_rdn_brk_pdl_cmp "" UBYTE _CNV_A_R_A_165_CM 1 0. 0. 255. DISPLAY_IDENTIFIER fm_sta_brk_pdl_cmp.fm_static_bitfield.Vbx_rdn_xxx ECU_ADDRESS 0xc0000206 BIT_MASK 0x40 /end MEASUREMENT
/begin MEASUREMENT Vxx_dtc_stt_brk_pdl_cmp "" UBYTE _CNV_A_R_A_165_CM 1 0. 0. 255. DISPLAY_IDENTIFIER fm_sta_brk_pdl_cmp.Vxx_dtc_stt_xxx ECU_ADDRESS 0xc0000207 /end MEASUREMENT
/begin MEASUREMENT Vxx_dfctr_cata_cpt "" UWORD _CNV_A_R_A_165_CM 1 0. 0. 65535. DISPLAY_IDENTIFIER fm_sta_cata_cpt.Vxx_dfctr_xxx ECU_ADDRESS 0xc0000208 /end MEASUREMENT
/begin MEASUREMENT Vxx_rdn_cata_cpt "" UWORD _CNV_A_R_A_165_CM 1 0. 0. 65535. DISPLAY_IDENTIFIER fm_sta_cata_cpt.Vxx_rdn_xxx ECU_ADDRESS 0xc000020a /end MEASUREMENT
/begin MEASUREMENT Vbx_cf_cata_cpt "" UBYTE _CNV_A_R_A_165_CM 1 0. 0. 255. DISPLAY_IDENTIFIER fm_sta_cata_cpt.fm_static_bitfield.Vbx_cf_xxx ECU_ADDRESS 0xc000020c BIT_MASK 0x1 /end MEASUREMENT
/begin MEASUREMENT Vbx_clf_cata_cpt "" UBYTE _CNV_A_R_A_165_CM 1 0. 0. 255. DISPLAY_IDENTIFIER fm_sta_cata_cpt.fm_static_bitfield.Vbx_clf_xxx ECU_ADDRESS 0xc000020c BIT_MASK 0x2 /end MEASUREMENT
/begin MEASUREMENT Vbx_df_old_cata_cpt "" UBYTE _CNV_A_R_A_165_CM 1 0. 0. 255. DISPLAY_IDENTIFIER fm_sta_cata_cpt.fm_static_bitfield.Vbx_df_old_xxx ECU_ADDRESS 0xc000020c BIT_MASK 0x4 /end MEASUREMENT
/begin MEASUREMENT Vbx_dfctr_sat_cata_cpt "" UBYTE _CNV_A_R_A_165_CM 1 0. 0. 255. DISPLAY_IDENTIFIER fm_sta_cata_cpt.fm_static_bitfield.Vbx_dfctr_sat_xxx ECU_ADDRESS 0xc000020c BIT_MASK 0x8 /end MEASUREMENT
/begin MEASUREMENT Vbx_rdn_cata_cpt "" UBYTE _CNV_A_R_A_165_CM 1 0. 0. 255. DISPLAY_IDENTIFIER fm_sta_cata_cpt.fm_static_bitfield.Vbx_rdn_xxx ECU_ADDRESS 0xc000020c BIT_MASK 0x40 /end MEASUREMENT
/begin MEASUREMENT Vxx_dtc_stt_cata_cpt "" UBYTE _CNV_A_R_A_165_CM 1 0. 0. 255. DISPLAY_IDENTIFIER fm_sta_cata_cpt.Vxx_dtc_stt_xxx ECU_ADDRESS 0xc000020d /end MEASUREMENT
/begin MEASUREMENT Vxx_dfctr_cl_rich_chr "" UWORD _CNV_A_R_A_165_CM 1 0. 0. 65535. DISPLAY_IDENTIFIER fm_sta_cl_rich_chr.Vxx_dfctr_xxx ECU_ADDRESS 0xc00003ca /end MEASUREMENT
/begin MEASUREMENT Vxx_rdn_cl_rich_chr "" UWORD _CNV_A_R_A_165_CM 1 0. 0. 65535. DISPLAY_IDENTIFIER fm_sta_cl_rich_chr.Vxx_rdn_xxx ECU_ADDRESS 0xc00003cc /end MEASUREMENT
/begin MEASUREMENT Vbx_cf_cl_rich_chr "" UBYTE _CNV_A_R_A_165_CM 1 0. 0. 255. DISPLAY_IDENTIFIER fm_sta_cl_rich_chr.fm_static_bitfield.Vbx_cf_xxx ECU_ADDRESS 0xc00003ce BIT_MASK 0x1 /end MEASUREMENT
/begin MEASUREMENT Vbx_clf_cl_rich_chr "" UBYTE _CNV_A_R_A_165_CM 1 0. 0. 255. DISPLAY_IDENTIFIER fm_sta_cl_rich_chr.fm_static_bitfield.Vbx_clf_xxx ECU_ADDRESS 0xc00003ce BIT_MASK 0x2 /end MEASUREMENT
/begin MEASUREMENT Vbx_df_old_cl_rich_chr "" UBYTE _CNV_A_R_A_165_CM 1 0. 0. 255. DISPLAY_IDENTIFIER fm_sta_cl_rich_chr.fm_static_bitfield.Vbx_df_old_xxx ECU_ADDRESS 0xc00003ce BIT_MASK 0x4 /end MEASUREMENT
/begin MEASUREMENT Vbx_dfctr_sat_cl_rich_chr "" UBYTE _CNV_A_R_A_165_CM 1 0. 0. 255. DISPLAY_IDENTIFIER fm_sta_cl_rich_chr.fm_static_bitfield.Vbx_dfctr_sat_xxx ECU_ADDRESS 0xc00003ce BIT_MASK 0x8 /end MEASUREMENT
/begin MEASUREMENT Vbx_rdn_cl_rich_chr "" UBYTE _CNV_A_R_A_165_CM 1 0. 0. 255. DISPLAY_IDENTIFIER fm_sta_cl_rich_chr.fm_static_bitfield.Vbx_rdn_xxx ECU_ADDRESS 0xc00003ce BIT_MASK 0x40 /end MEASUREMENT
/begin MEASUREMENT Vxx_dtc_stt_cl_rich_chr "" UBYTE _CNV_A_R_A_165_CM 1 0. 0. 255. DISPLAY_IDENTIFIER fm_sta_cl_rich_chr.Vxx_dtc_stt_xxx ECU_ADDRESS 0xc00003cf /end MEASUREMENT
/begin MEASUREMENT Vxx_dfctr_clu_cnt_nok "" UWORD _CNV_A_R_A_165_CM 1 0. 0. 65535. DISPLAY_IDENTIFIER fm_sta_clu_cnt_nok.Vxx_dfctr_xxx ECU_ADDRESS 0xc000006a /end MEASUREMENT
/begin MEASUREMENT Vxx_rdn_clu_cnt_nok "" UWORD _CNV_A_R_A_165_CM 1 0. 0. 65535. DISPLAY_IDENTIFIER fm_sta_clu_cnt_nok.Vxx_rdn_xxx ECU_ADDRESS 0xc000006c /end MEASUREMENT
/begin MEASUREMENT Vbx_cf_clu_cnt_nok "" UBYTE _CNV_A_R_A_165_CM 1 0. 0. 255. DISPLAY_IDENTIFIER fm_sta_clu_cnt_nok.fm_static_bitfield.Vbx_cf_xxx ECU_ADDRESS 0xc000006e BIT_MASK 0x1 /end MEASUREMENT
/begin MEASUREMENT Vbx_clf_clu_cnt_nok "" UBYTE _CNV_A_R_A_165_CM 1 0. 0. 255. DISPLAY_IDENTIFIER fm_sta_clu_cnt_nok.fm_static_bitfield.Vbx_clf_xxx ECU_ADDRESS 0xc000006e BIT_MASK 0x2 /end MEASUREMENT
/begin MEASUREMENT Vbx_df_old_clu_cnt_nok "" UBYTE _CNV_A_R_A_165_CM 1 0. 0. 255. DISPLAY_IDENTIFIER fm_sta_clu_cnt_nok.fm_static_bitfield.Vbx_df_old_xxx ECU_ADDRESS 0xc000006e BIT_MASK 0x4 /end MEASUREMENT
/begin MEASUREMENT Vbx_dfctr_sat_clu_cnt_nok "" UBYTE _CNV_A_R_A_165_CM 1 0. 0. 255. DISPLAY_IDENTIFIER fm_sta_clu_cnt_nok.fm_static_bitfield.Vbx_dfctr_sat_xxx ECU_ADDRESS 0xc000006e BIT_MASK 0x8 /end MEASUREMENT
/begin MEASUREMENT Vbx_rdn_clu_cnt_nok "" UBYTE _CNV_A_R_A_165_CM 1 0. 0. 255. DISPLAY_IDENTIFIER fm_sta_clu_cnt_nok.fm_static_bitfield.Vbx_rdn_xxx ECU_ADDRESS 0xc000006e BIT_MASK 0x40 /end MEASUREMENT
/begin MEASUREMENT Vxx_dtc_stt_clu_cnt_nok "" UBYTE _CNV_A_R_A_165_CM 1 0. 0. 255. DISPLAY_IDENTIFIER fm_sta_clu_cnt_nok.Vxx_dtc_stt_xxx ECU_ADDRESS 0xc000006f /end MEASUREMENT
/begin MEASUREMENT Vxx_dfctr_cp_oc "" UWORD _CNV_A_R_A_165_CM 1 0. 0. 65535. DISPLAY_IDENTIFIER fm_sta_cp_oc.Vxx_dfctr_xxx ECU_ADDRESS 0xc00001d8 /end MEASUREMENT
/begin MEASUREMENT Vxx_rdn_cp_oc "" UWORD _CNV_A_R_A_165_CM 1 0. 0. 65535. DISPLAY_IDENTIFIER fm_sta_cp_oc.Vxx_rdn_xxx ECU_ADDRESS 0xc00001da /end MEASUREMENT
/begin MEASUREMENT Vbx_cf_cp_oc "" UBYTE _CNV_A_R_A_165_CM 1 0. 0. 255. DISPLAY_IDENTIFIER fm_sta_cp_oc.fm_static_bitfield.Vbx_cf_xxx ECU_ADDRESS 0xc00001dc BIT_MASK 0x1 /end MEASUREMENT
/begin MEASUREMENT Vbx_clf_cp_oc "" UBYTE _CNV_A_R_A_165_CM 1 0. 0. 255. DISPLAY_IDENTIFIER fm_sta_cp_oc.fm_static_bitfield.Vbx_clf_xxx ECU_ADDRESS 0xc00001dc BIT_MASK 0x2 /end MEASUREMENT
/begin MEASUREMENT Vbx_df_old_cp_oc "" UBYTE _CNV_A_R_A_165_CM 1 0. 0. 255. DISPLAY_IDENTIFIER fm_sta_cp_oc.fm_static_bitfield.Vbx_df_old_xxx ECU_ADDRESS 0xc00001dc BIT_MASK 0x4 /end MEASUREMENT
/begin MEASUREMENT Vbx_dfctr_sat_cp_oc "" UBYTE _CNV_A_R_A_165_CM 1 0. 0. 255. DISPLAY_IDENTIFIER fm_sta_cp_oc.fm_static_bitfield.Vbx_dfctr_sat_xxx ECU_ADDRESS 0xc00001dc BIT_MASK 0x8 /end MEASUREMENT
/begin MEASUREMENT Vbx_rdn_cp_oc "" UBYTE _CNV_A_R_A_165_CM 1 0. 0. 255. DISPLAY_IDENTIFIER fm_sta_cp_oc.fm_static_bitfield.Vbx_rdn_xxx ECU_ADDRESS 0xc00001dc BIT_MASK 0x40 /end MEASUREMENT
/begin MEASUREMENT Vxx_dtc_stt_cp_oc "" UBYTE _CNV_A_R_A_165_CM 1 0. 0. 255. DISPLAY_IDENTIFIER fm_sta_cp_oc.Vxx_dtc_stt_xxx ECU_ADDRESS 0xc00001dd /end MEASUREMENT
/begin MEASUREMENT Vxx_dfctr_cp_scg "" UWORD _CNV_A_R_A_165_CM 1 0. 0. 65535. DISPLAY_IDENTIFIER fm_sta_cp_scg.Vxx_dfctr_xxx ECU_ADDRESS 0xc00001de /end MEASUREMENT
/begin MEASUREMENT Vxx_rdn_cp_scg "" UWORD _CNV_A_R_A_165_CM 1 0. 0. 65535. DISPLAY_IDENTIFIER fm_sta_cp_scg.Vxx_rdn_xxx ECU_ADDRESS 0xc00001e0 /end MEASUREMENT
/begin MEASUREMENT Vbx_cf_cp_scg "" UBYTE _CNV_A_R_A_165_CM 1 0. 0. 255. DISPLAY_IDENTIFIER fm_sta_cp_scg.fm_static_bitfield.Vbx_cf_xxx ECU_ADDRESS 0xc00001e2 BIT_MASK 0x1 /end MEASUREMENT
/begin MEASUREMENT Vbx_clf_cp_scg "" UBYTE _CNV_A_R_A_165_CM 1 0. 0. 255. DISPLAY_IDENTIFIER fm_sta_cp_scg.fm_static_bitfield.Vbx_clf_xxx ECU_ADDRESS 0xc00001e2 BIT_MASK 0x2 /end MEASUREMENT
/begin MEASUREMENT Vbx_df_old_cp_scg "" UBYTE _CNV_A_R_A_165_CM 1 0. 0. 255. DISPLAY_IDENTIFIER fm_sta_cp_scg.fm_static_bitfield.Vbx_df_old_xxx ECU_ADDRESS 0xc00001e2 BIT_MASK 0x4 /end MEASUREMENT
/begin MEASUREMENT Vbx_dfctr_sat_cp_scg "" UBYTE _CNV_A_R_A_165_CM 1 0. 0. 255. DISPLAY_IDENTIFIER fm_sta_cp_scg.fm_static_bitfield.Vbx_dfctr_sat_xxx ECU_ADDRESS 0xc00001e2 BIT_MASK 0x8 /end MEASUREMENT
/begin MEASUREMENT Vbx_rdn_cp_scg "" UBYTE _CNV_A_R_A_165_CM 1 0. 0. 255. DISPLAY_IDENTIFIER fm_sta_cp_scg.fm_static_bitfield.Vbx_rdn_xxx ECU_ADDRESS 0xc00001e2 BIT_MASK 0x40 /end MEASUREMENT
/begin MEASUREMENT Vxx_dtc_stt_cp_scg "" UBYTE _CNV_A_R_A_165_CM 1 0. 0. 255. DISPLAY_IDENTIFIER fm_sta_cp_scg.Vxx_dtc_stt_xxx ECU_ADDRESS 0xc00001e3 /end MEASUREMENT
/begin MEASUREMENT Vxx_dfctr_cp_scw "" UWORD _CNV_A_R_A_165_CM 1 0. 0. 65535. DISPLAY_IDENTIFIER fm_sta_cp_scw.Vxx_dfctr_xxx ECU_ADDRESS 0xc00001e4 /end MEASUREMENT
/begin MEASUREMENT Vxx_rdn_cp_scw "" UWORD _CNV_A_R_A_165_CM 1 0. 0. 65535. DISPLAY_IDENTIFIER fm_sta_cp_scw.Vxx_rdn_xxx ECU_ADDRESS 0xc00001e6 /end MEASUREMENT
/begin MEASUREMENT Vbx_cf_cp_scw "" UBYTE _CNV_A_R_A_165_CM 1 0. 0. 255. DISPLAY_IDENTIFIER fm_sta_cp_scw.fm_static_bitfield.Vbx_cf_xxx ECU_ADDRESS 0xc00001e8 BIT_MASK 0x1 /end MEASUREMENT
/begin MEASUREMENT Vbx_clf_cp_scw "" UBYTE _CNV_A_R_A_165_CM 1 0. 0. 255. DISPLAY_IDENTIFIER fm_sta_cp_scw.fm_static_bitfield.Vbx_clf_xxx ECU_ADDRESS 0xc00001e8 BIT_MASK 0x2 /end MEASUREMENT
/begin MEASUREMENT Vbx_df_old_cp_scw "" UBYTE _CNV_A_R_A_165_CM 1 0. 0. 255. DISPLAY_IDENTIFIER fm_sta_cp_scw.fm_static_bitfield.Vbx_df_old_xxx ECU_ADDRESS 0xc00001e8 BIT_MASK 0x4 /end MEASUREMENT
/begin MEASUREMENT Vbx_dfctr_sat_cp_scw "" UBYTE _CNV_A_R_A_165_CM 1 0. 0. 255. DISPLAY_IDENTIFIER fm_sta_cp_scw.fm_static_bitfield.Vbx_dfctr_sat_xxx ECU_ADDRESS 0xc00001e8 BIT_MASK 0x8 /end MEASUREMENT
/begin MEASUREMENT Vbx_rdn_cp_scw "" UBYTE _CNV_A_R_A_165_CM 1 0. 0. 255. DISPLAY_IDENTIFIER fm_sta_cp_scw.fm_static_bitfield.Vbx_rdn_xxx ECU_ADDRESS 0xc00001e8 BIT_MASK 0x40 /end MEASUREMENT
/begin MEASUREMENT Vxx_dtc_stt_cp_scw "" UBYTE _CNV_A_R_A_165_CM 1 0. 0. 255. DISPLAY_IDENTIFIER fm_sta_cp_scw.Vxx_dtc_stt_xxx ECU_ADDRESS 0xc00001e9 /end MEASUREMENT
/begin MEASUREMENT Vxx_dfctr_crk_chr "" UWORD _CNV_A_R_A_165_CM 1 0. 0. 65535. DISPLAY_IDENTIFIER fm_sta_crk_chr.Vxx_dfctr_xxx ECU_ADDRESS 0xc0000340 /end MEASUREMENT
/begin MEASUREMENT Vxx_rdn_crk_chr "" UWORD _CNV_A_R_A_165_CM 1 0. 0. 65535. DISPLAY_IDENTIFIER fm_sta_crk_chr.Vxx_rdn_xxx ECU_ADDRESS 0xc0000342 /end MEASUREMENT
/begin MEASUREMENT Vbx_cf_crk_chr "" UBYTE _CNV_A_R_A_165_CM 1 0. 0. 255. DISPLAY_IDENTIFIER fm_sta_crk_chr.fm_static_bitfield.Vbx_cf_xxx ECU_ADDRESS 0xc0000344 BIT_MASK 0x1 /end MEASUREMENT
/begin MEASUREMENT Vbx_clf_crk_chr "" UBYTE _CNV_A_R_A_165_CM 1 0. 0. 255. DISPLAY_IDENTIFIER fm_sta_crk_chr.fm_static_bitfield.Vbx_clf_xxx ECU_ADDRESS 0xc0000344 BIT_MASK 0x2 /end MEASUREMENT
/begin MEASUREMENT Vbx_df_old_crk_chr "" UBYTE _CNV_A_R_A_165_CM 1 0. 0. 255. DISPLAY_IDENTIFIER fm_sta_crk_chr.fm_static_bitfield.Vbx_df_old_xxx ECU_ADDRESS 0xc0000344 BIT_MASK 0x4 /end MEASUREMENT
/begin MEASUREMENT Vbx_dfctr_sat_crk_chr "" UBYTE _CNV_A_R_A_165_CM 1 0. 0. 255. DISPLAY_IDENTIFIER fm_sta_crk_chr.fm_static_bitfield.Vbx_dfctr_sat_xxx ECU_ADDRESS 0xc0000344 BIT_MASK 0x8 /end MEASUREMENT
/begin MEASUREMENT Vbx_rdn_crk_chr "" UBYTE _CNV_A_R_A_165_CM 1 0. 0. 255. DISPLAY_IDENTIFIER fm_sta_crk_chr.fm_static_bitfield.Vbx_rdn_xxx ECU_ADDRESS 0xc0000344 BIT_MASK 0x40 /end MEASUREMENT
/begin MEASUREMENT Vxx_dtc_stt_crk_chr "" UBYTE _CNV_A_R_A_165_CM 1 0. 0. 255. DISPLAY_IDENTIFIER fm_sta_crk_chr.Vxx_dtc_stt_xxx ECU_ADDRESS 0xc0000345 /end MEASUREMENT
/begin MEASUREMENT Vxx_dfctr_crk_cmp "" UWORD _CNV_A_R_A_165_CM 1 0. 0. 65535. DISPLAY_IDENTIFIER fm_sta_crk_cmp.Vxx_dfctr_xxx ECU_ADDRESS 0xc00003b8 /end MEASUREMENT
/begin MEASUREMENT Vxx_rdn_crk_cmp "" UWORD _CNV_A_R_A_165_CM 1 0. 0. 65535. DISPLAY_IDENTIFIER fm_sta_crk_cmp.Vxx_rdn_xxx ECU_ADDRESS 0xc00003ba /end MEASUREMENT
/begin MEASUREMENT Vbx_cf_crk_cmp "" UBYTE _CNV_A_R_A_165_CM 1 0. 0. 255. DISPLAY_IDENTIFIER fm_sta_crk_cmp.fm_static_bitfield.Vbx_cf_xxx ECU_ADDRESS 0xc00003bc BIT_MASK 0x1 /end MEASUREMENT
/begin MEASUREMENT Vbx_clf_crk_cmp "" UBYTE _CNV_A_R_A_165_CM 1 0. 0. 255. DISPLAY_IDENTIFIER fm_sta_crk_cmp.fm_static_bitfield.Vbx_clf_xxx ECU_ADDRESS 0xc00003bc BIT_MASK 0x2 /end MEASUREMENT
/begin MEASUREMENT Vbx_df_old_crk_cmp "" UBYTE _CNV_A_R_A_165_CM 1 0. 0. 255. DISPLAY_IDENTIFIER fm_sta_crk_cmp.fm_static_bitfield.Vbx_df_old_xxx ECU_ADDRESS 0xc00003bc BIT_MASK 0x4 /end MEASUREMENT
/begin MEASUREMENT Vbx_dfctr_sat_crk_cmp "" UBYTE _CNV_A_R_A_165_CM 1 0. 0. 255. DISPLAY_IDENTIFIER fm_sta_crk_cmp.fm_static_bitfield.Vbx_dfctr_sat_xxx ECU_ADDRESS 0xc00003bc BIT_MASK 0x8 /end MEASUREMENT
/begin MEASUREMENT Vbx_rdn_crk_cmp "" UBYTE _CNV_A_R_A_165_CM 1 0. 0. 255. DISPLAY_IDENTIFIER fm_sta_crk_cmp.fm_static_bitfield.Vbx_rdn_xxx ECU_ADDRESS 0xc00003bc BIT_MASK 0x40 /end MEASUREMENT
/begin MEASUREMENT Vxx_dtc_stt_crk_cmp "" UBYTE _CNV_A_R_A_165_CM 1 0. 0. 255. DISPLAY_IDENTIFIER fm_sta_crk_cmp.Vxx_dtc_stt_xxx ECU_ADDRESS 0xc00003bd /end MEASUREMENT
/begin MEASUREMENT Vxx_dfctr_crk_cyc "" UWORD _CNV_A_R_A_165_CM 1 0. 0. 65535. DISPLAY_IDENTIFIER fm_sta_crk_cyc.Vxx_dfctr_xxx ECU_ADDRESS 0xc0000346 /end MEASUREMENT
/begin MEASUREMENT Vxx_rdn_crk_cyc "" UWORD _CNV_A_R_A_165_CM 1 0. 0. 65535. DISPLAY_IDENTIFIER fm_sta_crk_cyc.Vxx_rdn_xxx ECU_ADDRESS 0xc0000348 /end MEASUREMENT
/begin MEASUREMENT Vbx_cf_crk_cyc "" UBYTE _CNV_A_R_A_165_CM 1 0. 0. 255. DISPLAY_IDENTIFIER fm_sta_crk_cyc.fm_static_bitfield.Vbx_cf_xxx ECU_ADDRESS 0xc000034a BIT_MASK 0x1 /end MEASUREMENT
/begin MEASUREMENT Vbx_clf_crk_cyc "" UBYTE _CNV_A_R_A_165_CM 1 0. 0. 255. DISPLAY_IDENTIFIER fm_sta_crk_cyc.fm_static_bitfield.Vbx_clf_xxx ECU_ADDRESS 0xc000034a BIT_MASK 0x2 /end MEASUREMENT
/begin MEASUREMENT Vbx_df_old_crk_cyc "" UBYTE _CNV_A_R_A_165_CM 1 0. 0. 255. DISPLAY_IDENTIFIER fm_sta_crk_cyc.fm_static_bitfield.Vbx_df_old_xxx ECU_ADDRESS 0xc000034a BIT_MASK 0x4 /end MEASUREMENT
/begin MEASUREMENT Vbx_dfctr_sat_crk_cyc "" UBYTE _CNV_A_R_A_165_CM 1 0. 0. 255. DISPLAY_IDENTIFIER fm_sta_crk_cyc.fm_static_bitfield.Vbx_dfctr_sat_xxx ECU_ADDRESS 0xc000034a BIT_MASK 0x8 /end MEASUREMENT
/begin MEASUREMENT Vbx_rdn_crk_cyc "" UBYTE _CNV_A_R_A_165_CM 1 0. 0. 255. DISPLAY_IDENTIFIER fm_sta_crk_cyc.fm_static_bitfield.Vbx_rdn_xxx ECU_ADDRESS 0xc000034a BIT_MASK 0x40 /end MEASUREMENT
/begin MEASUREMENT Vxx_dtc_stt_crk_cyc "" UBYTE _CNV_A_R_A_165_CM 1 0. 0. 255. DISPLAY_IDENTIFIER fm_sta_crk_cyc.Vxx_dtc_stt_xxx ECU_ADDRESS 0xc000034b /end MEASUREMENT
/begin MEASUREMENT Vxx_dfctr_crk_no_sig "" UWORD _CNV_A_R_A_165_CM 1 0. 0. 65535. DISPLAY_IDENTIFIER fm_sta_crk_no_sig.Vxx_dfctr_xxx ECU_ADDRESS 0xc000037c /end MEASUREMENT
/begin MEASUREMENT Vxx_rdn_crk_no_sig "" UWORD _CNV_A_R_A_165_CM 1 0. 0. 65535. DISPLAY_IDENTIFIER fm_sta_crk_no_sig.Vxx_rdn_xxx ECU_ADDRESS 0xc000037e /end MEASUREMENT
/begin MEASUREMENT Vbx_cf_crk_no_sig "" UBYTE _CNV_A_R_A_165_CM 1 0. 0. 255. DISPLAY_IDENTIFIER fm_sta_crk_no_sig.fm_static_bitfield.Vbx_cf_xxx ECU_ADDRESS 0xc0000380 BIT_MASK 0x1 /end MEASUREMENT
/begin MEASUREMENT Vbx_clf_crk_no_sig "" UBYTE _CNV_A_R_A_165_CM 1 0. 0. 255. DISPLAY_IDENTIFIER fm_sta_crk_no_sig.fm_static_bitfield.Vbx_clf_xxx ECU_ADDRESS 0xc0000380 BIT_MASK 0x2 /end MEASUREMENT
/begin MEASUREMENT Vbx_df_old_crk_no_sig "" UBYTE _CNV_A_R_A_165_CM 1 0. 0. 255. DISPLAY_IDENTIFIER fm_sta_crk_no_sig.fm_static_bitfield.Vbx_df_old_xxx ECU_ADDRESS 0xc0000380 BIT_MASK 0x4 /end MEASUREMENT
/begin MEASUREMENT Vbx_dfctr_sat_crk_no_sig "" UBYTE _CNV_A_R_A_165_CM 1 0. 0. 255. DISPLAY_IDENTIFIER fm_sta_crk_no_sig.fm_static_bitfield.Vbx_dfctr_sat_xxx ECU_ADDRESS 0xc0000380 BIT_MASK 0x8 /end MEASUREMENT
/begin MEASUREMENT Vbx_rdn_crk_no_sig "" UBYTE _CNV_A_R_A_165_CM 1 0. 0. 255. DISPLAY_IDENTIFIER fm_sta_crk_no_sig.fm_static_bitfield.Vbx_rdn_xxx ECU_ADDRESS 0xc0000380 BIT_MASK 0x40 /end MEASUREMENT
/begin MEASUREMENT Vxx_dtc_stt_crk_no_sig "" UBYTE _CNV_A_R_A_165_CM 1 0. 0. 255. DISPLAY_IDENTIFIER fm_sta_crk_no_sig.Vxx_dtc_stt_xxx ECU_ADDRESS 0xc0000381 /end MEASUREMENT
/begin MEASUREMENT Vxx_dfctr_crk_oc "" UWORD _CNV_A_R_A_165_CM 1 0. 0. 65535. DISPLAY_IDENTIFIER fm_sta_crk_oc.Vxx_dfctr_xxx ECU_ADDRESS 0xc00003c4 /end MEASUREMENT
/begin MEASUREMENT Vxx_rdn_crk_oc "" UWORD _CNV_A_R_A_165_CM 1 0. 0. 65535. DISPLAY_IDENTIFIER fm_sta_crk_oc.Vxx_rdn_xxx ECU_ADDRESS 0xc00003c6 /end MEASUREMENT
/begin MEASUREMENT Vbx_cf_crk_oc "" UBYTE _CNV_A_R_A_165_CM 1 0. 0. 255. DISPLAY_IDENTIFIER fm_sta_crk_oc.fm_static_bitfield.Vbx_cf_xxx ECU_ADDRESS 0xc00003c8 BIT_MASK 0x1 /end MEASUREMENT
/begin MEASUREMENT Vbx_clf_crk_oc "" UBYTE _CNV_A_R_A_165_CM 1 0. 0. 255. DISPLAY_IDENTIFIER fm_sta_crk_oc.fm_static_bitfield.Vbx_clf_xxx ECU_ADDRESS 0xc00003c8 BIT_MASK 0x2 /end MEASUREMENT
/begin MEASUREMENT Vbx_df_old_crk_oc "" UBYTE _CNV_A_R_A_165_CM 1 0. 0. 255. DISPLAY_IDENTIFIER fm_sta_crk_oc.fm_static_bitfield.Vbx_df_old_xxx ECU_ADDRESS 0xc00003c8 BIT_MASK 0x4 /end MEASUREMENT
/begin MEASUREMENT Vbx_dfctr_sat_crk_oc "" UBYTE _CNV_A_R_A_165_CM 1 0. 0. 255. DISPLAY_IDENTIFIER fm_sta_crk_oc.fm_static_bitfield.Vbx_dfctr_sat_xxx ECU_ADDRESS 0xc00003c8 BIT_MASK 0x8 /end MEASUREMENT
/begin MEASUREMENT Vbx_rdn_crk_oc "" UBYTE _CNV_A_R_A_165_CM 1 0. 0. 255. DISPLAY_IDENTIFIER fm_sta_crk_oc.fm_static_bitfield.Vbx_rdn_xxx ECU_ADDRESS 0xc00003c8 BIT_MASK 0x40 /end MEASUREMENT
/begin MEASUREMENT Vxx_dtc_stt_crk_oc "" UBYTE _CNV_A_R_A_165_CM 1 0. 0. 255. DISPLAY_IDENTIFIER fm_sta_crk_oc.Vxx_dtc_stt_xxx ECU_ADDRESS 0xc00003c9 /end MEASUREMENT
/begin MEASUREMENT Vxx_dfctr_crk_shp "" UWORD _CNV_A_R_A_165_CM 1 0. 0. 65535. DISPLAY_IDENTIFIER fm_sta_crk_shp.Vxx_dfctr_xxx ECU_ADDRESS 0xc00003be /end MEASUREMENT
/begin MEASUREMENT Vxx_rdn_crk_shp "" UWORD _CNV_A_R_A_165_CM 1 0. 0. 65535. DISPLAY_IDENTIFIER fm_sta_crk_shp.Vxx_rdn_xxx ECU_ADDRESS 0xc00003c0 /end MEASUREMENT
/begin MEASUREMENT Vbx_cf_crk_shp "" UBYTE _CNV_A_R_A_165_CM 1 0. 0. 255. DISPLAY_IDENTIFIER fm_sta_crk_shp.fm_static_bitfield.Vbx_cf_xxx ECU_ADDRESS 0xc00003c2 BIT_MASK 0x1 /end MEASUREMENT
/begin MEASUREMENT Vbx_clf_crk_shp "" UBYTE _CNV_A_R_A_165_CM 1 0. 0. 255. DISPLAY_IDENTIFIER fm_sta_crk_shp.fm_static_bitfield.Vbx_clf_xxx ECU_ADDRESS 0xc00003c2 BIT_MASK 0x2 /end MEASUREMENT
/begin MEASUREMENT Vbx_df_old_crk_shp "" UBYTE _CNV_A_R_A_165_CM 1 0. 0. 255. DISPLAY_IDENTIFIER fm_sta_crk_shp.fm_static_bitfield.Vbx_df_old_xxx ECU_ADDRESS 0xc00003c2 BIT_MASK 0x4 /end MEASUREMENT
/begin MEASUREMENT Vbx_dfctr_sat_crk_shp "" UBYTE _CNV_A_R_A_165_CM 1 0. 0. 255. DISPLAY_IDENTIFIER fm_sta_crk_shp.fm_static_bitfield.Vbx_dfctr_sat_xxx ECU_ADDRESS 0xc00003c2 BIT_MASK 0x8 /end MEASUREMENT
/begin MEASUREMENT Vbx_rdn_crk_shp "" UBYTE _CNV_A_R_A_165_CM 1 0. 0. 255. DISPLAY_IDENTIFIER fm_sta_crk_shp.fm_static_bitfield.Vbx_rdn_xxx ECU_ADDRESS 0xc00003c2 BIT_MASK 0x40 /end MEASUREMENT
/begin MEASUREMENT Vxx_dtc_stt_crk_shp "" UBYTE _CNV_A_R_A_165_CM 1 0. 0. 255. DISPLAY_IDENTIFIER fm_sta_crk_shp.Vxx_dtc_stt_xxx ECU_ADDRESS 0xc00003c3 /end MEASUREMENT
/begin MEASUREMENT Vxx_dfctr_cru_cmp "" UWORD _CNV_A_R_A_165_CM 1 0. 0. 65535. DISPLAY_IDENTIFIER fm_sta_cru_cmp.Vxx_dfctr_xxx ECU_ADDRESS 0xc000020e /end MEASUREMENT
/begin MEASUREMENT Vxx_rdn_cru_cmp "" UWORD _CNV_A_R_A_165_CM 1 0. 0. 65535. DISPLAY_IDENTIFIER fm_sta_cru_cmp.Vxx_rdn_xxx ECU_ADDRESS 0xc0000210 /end MEASUREMENT
/begin MEASUREMENT Vbx_cf_cru_cmp "" UBYTE _CNV_A_R_A_165_CM 1 0. 0. 255. DISPLAY_IDENTIFIER fm_sta_cru_cmp.fm_static_bitfield.Vbx_cf_xxx ECU_ADDRESS 0xc0000212 BIT_MASK 0x1 /end MEASUREMENT
/begin MEASUREMENT Vbx_clf_cru_cmp "" UBYTE _CNV_A_R_A_165_CM 1 0. 0. 255. DISPLAY_IDENTIFIER fm_sta_cru_cmp.fm_static_bitfield.Vbx_clf_xxx ECU_ADDRESS 0xc0000212 BIT_MASK 0x2 /end MEASUREMENT
/begin MEASUREMENT Vbx_df_old_cru_cmp "" UBYTE _CNV_A_R_A_165_CM 1 0. 0. 255. DISPLAY_IDENTIFIER fm_sta_cru_cmp.fm_static_bitfield.Vbx_df_old_xxx ECU_ADDRESS 0xc0000212 BIT_MASK 0x4 /end MEASUREMENT
/begin MEASUREMENT Vbx_dfctr_sat_cru_cmp "" UBYTE _CNV_A_R_A_165_CM 1 0. 0. 255. DISPLAY_IDENTIFIER fm_sta_cru_cmp.fm_static_bitfield.Vbx_dfctr_sat_xxx ECU_ADDRESS 0xc0000212 BIT_MASK 0x8 /end MEASUREMENT
/begin MEASUREMENT Vbx_rdn_cru_cmp "" UBYTE _CNV_A_R_A_165_CM 1 0. 0. 255. DISPLAY_IDENTIFIER fm_sta_cru_cmp.fm_static_bitfield.Vbx_rdn_xxx ECU_ADDRESS 0xc0000212 BIT_MASK 0x40 /end MEASUREMENT
/begin MEASUREMENT Vxx_dtc_stt_cru_cmp "" UBYTE _CNV_A_R_A_165_CM 1 0. 0. 255. DISPLAY_IDENTIFIER fm_sta_cru_cmp.Vxx_dtc_stt_xxx ECU_ADDRESS 0xc0000213 /end MEASUREMENT
/begin MEASUREMENT Vxx_dfctr_cru_sl_swi_chr "" UWORD _CNV_A_R_A_165_CM 1 0. 0. 65535. DISPLAY_IDENTIFIER fm_sta_cru_sl_swi_chr.Vxx_dfctr_xxx ECU_ADDRESS 0xc0000214 /end MEASUREMENT
/begin MEASUREMENT Vxx_rdn_cru_sl_swi_chr "" UWORD _CNV_A_R_A_165_CM 1 0. 0. 65535. DISPLAY_IDENTIFIER fm_sta_cru_sl_swi_chr.Vxx_rdn_xxx ECU_ADDRESS 0xc0000216 /end MEASUREMENT
/begin MEASUREMENT Vbx_cf_cru_sl_swi_chr "" UBYTE _CNV_A_R_A_165_CM 1 0. 0. 255. DISPLAY_IDENTIFIER fm_sta_cru_sl_swi_chr.fm_static_bitfield.Vbx_cf_xxx ECU_ADDRESS 0xc0000218 BIT_MASK 0x1 /end MEASUREMENT
/begin MEASUREMENT Vbx_clf_cru_sl_swi_chr "" UBYTE _CNV_A_R_A_165_CM 1 0. 0. 255. DISPLAY_IDENTIFIER fm_sta_cru_sl_swi_chr.fm_static_bitfield.Vbx_clf_xxx ECU_ADDRESS 0xc0000218 BIT_MASK 0x2 /end MEASUREMENT
/begin MEASUREMENT Vbx_df_old_cru_sl_swi_chr "" UBYTE _CNV_A_R_A_165_CM 1 0. 0. 255. DISPLAY_IDENTIFIER fm_sta_cru_sl_swi_chr.fm_static_bitfield.Vbx_df_old_xxx ECU_ADDRESS 0xc0000218 BIT_MASK 0x4 /end MEASUREMENT
/begin MEASUREMENT Vbx_dfctr_sat_cru_sl_swi_chr "" UBYTE _CNV_A_R_A_165_CM 1 0. 0. 255. DISPLAY_IDENTIFIER fm_sta_cru_sl_swi_chr.fm_static_bitfield.Vbx_dfctr_sat_xxx ECU_ADDRESS 0xc0000218 BIT_MASK 0x8 /end MEASUREMENT
/begin MEASUREMENT Vbx_rdn_cru_sl_swi_chr "" UBYTE _CNV_A_R_A_165_CM 1 0. 0. 255. DISPLAY_IDENTIFIER fm_sta_cru_sl_swi_chr.fm_static_bitfield.Vbx_rdn_xxx ECU_ADDRESS 0xc0000218 BIT_MASK 0x40 /end MEASUREMENT
/begin MEASUREMENT Vxx_dtc_stt_cru_sl_swi_chr "" UBYTE _CNV_A_R_A_165_CM 1 0. 0. 255. DISPLAY_IDENTIFIER fm_sta_cru_sl_swi_chr.Vxx_dtc_stt_xxx ECU_ADDRESS 0xc0000219 /end MEASUREMENT
/begin MEASUREMENT Vxx_dfctr_cru_sl_tot "" UWORD _CNV_A_R_A_165_CM 1 0. 0. 65535. DISPLAY_IDENTIFIER fm_sta_cru_sl_tot.Vxx_dfctr_xxx ECU_ADDRESS 0xc000021a /end MEASUREMENT
/begin MEASUREMENT Vxx_rdn_cru_sl_tot "" UWORD _CNV_A_R_A_165_CM 1 0. 0. 65535. DISPLAY_IDENTIFIER fm_sta_cru_sl_tot.Vxx_rdn_xxx ECU_ADDRESS 0xc000021c /end MEASUREMENT
/begin MEASUREMENT Vbx_cf_cru_sl_tot "" UBYTE _CNV_A_R_A_165_CM 1 0. 0. 255. DISPLAY_IDENTIFIER fm_sta_cru_sl_tot.fm_static_bitfield.Vbx_cf_xxx ECU_ADDRESS 0xc000021e BIT_MASK 0x1 /end MEASUREMENT
/begin MEASUREMENT Vbx_clf_cru_sl_tot "" UBYTE _CNV_A_R_A_165_CM 1 0. 0. 255. DISPLAY_IDENTIFIER fm_sta_cru_sl_tot.fm_static_bitfield.Vbx_clf_xxx ECU_ADDRESS 0xc000021e BIT_MASK 0x2 /end MEASUREMENT
/begin MEASUREMENT Vbx_df_old_cru_sl_tot "" UBYTE _CNV_A_R_A_165_CM 1 0. 0. 255. DISPLAY_IDENTIFIER fm_sta_cru_sl_tot.fm_static_bitfield.Vbx_df_old_xxx ECU_ADDRESS 0xc000021e BIT_MASK 0x4 /end MEASUREMENT
/begin MEASUREMENT Vbx_dfctr_sat_cru_sl_tot "" UBYTE _CNV_A_R_A_165_CM 1 0. 0. 255. DISPLAY_IDENTIFIER fm_sta_cru_sl_tot.fm_static_bitfield.Vbx_dfctr_sat_xxx ECU_ADDRESS 0xc000021e BIT_MASK 0x8 /end MEASUREMENT
/begin MEASUREMENT Vbx_rdn_cru_sl_tot "" UBYTE _CNV_A_R_A_165_CM 1 0. 0. 255. DISPLAY_IDENTIFIER fm_sta_cru_sl_tot.fm_static_bitfield.Vbx_rdn_xxx ECU_ADDRESS 0xc000021e BIT_MASK 0x40 /end MEASUREMENT
/begin MEASUREMENT Vxx_dtc_stt_cru_sl_tot "" UBYTE _CNV_A_R_A_165_CM 1 0. 0. 255. DISPLAY_IDENTIFIER fm_sta_cru_sl_tot.Vxx_dtc_stt_xxx ECU_ADDRESS 0xc000021f /end MEASUREMENT
/begin MEASUREMENT Vxx_dfctr_cru_vs_cmp "" UWORD _CNV_A_R_A_165_CM 1 0. 0. 65535. DISPLAY_IDENTIFIER fm_sta_cru_vs_cmp.Vxx_dfctr_xxx ECU_ADDRESS 0xc0000220 /end MEASUREMENT
/begin MEASUREMENT Vxx_rdn_cru_vs_cmp "" UWORD _CNV_A_R_A_165_CM 1 0. 0. 65535. DISPLAY_IDENTIFIER fm_sta_cru_vs_cmp.Vxx_rdn_xxx ECU_ADDRESS 0xc0000222 /end MEASUREMENT
/begin MEASUREMENT Vbx_cf_cru_vs_cmp "" UBYTE _CNV_A_R_A_165_CM 1 0. 0. 255. DISPLAY_IDENTIFIER fm_sta_cru_vs_cmp.fm_static_bitfield.Vbx_cf_xxx ECU_ADDRESS 0xc0000224 BIT_MASK 0x1 /end MEASUREMENT
/begin MEASUREMENT Vbx_clf_cru_vs_cmp "" UBYTE _CNV_A_R_A_165_CM 1 0. 0. 255. DISPLAY_IDENTIFIER fm_sta_cru_vs_cmp.fm_static_bitfield.Vbx_clf_xxx ECU_ADDRESS 0xc0000224 BIT_MASK 0x2 /end MEASUREMENT
/begin MEASUREMENT Vbx_df_old_cru_vs_cmp "" UBYTE _CNV_A_R_A_165_CM 1 0. 0. 255. DISPLAY_IDENTIFIER fm_sta_cru_vs_cmp.fm_static_bitfield.Vbx_df_old_xxx ECU_ADDRESS 0xc0000224 BIT_MASK 0x4 /end MEASUREMENT
/begin MEASUREMENT Vbx_dfctr_sat_cru_vs_cmp "" UBYTE _CNV_A_R_A_165_CM 1 0. 0. 255. DISPLAY_IDENTIFIER fm_sta_cru_vs_cmp.fm_static_bitfield.Vbx_dfctr_sat_xxx ECU_ADDRESS 0xc0000224 BIT_MASK 0x8 /end MEASUREMENT
/begin MEASUREMENT Vbx_rdn_cru_vs_cmp "" UBYTE _CNV_A_R_A_165_CM 1 0. 0. 255. DISPLAY_IDENTIFIER fm_sta_cru_vs_cmp.fm_static_bitfield.Vbx_rdn_xxx ECU_ADDRESS 0xc0000224 BIT_MASK 0x40 /end MEASUREMENT
/begin MEASUREMENT Vxx_dtc_stt_cru_vs_cmp "" UBYTE _CNV_A_R_A_165_CM 1 0. 0. 255. DISPLAY_IDENTIFIER fm_sta_cru_vs_cmp.Vxx_dtc_stt_xxx ECU_ADDRESS 0xc0000225 /end MEASUREMENT
/begin MEASUREMENT Vxx_dfctr_cru_whl_cmd_nok "" UWORD _CNV_A_R_A_165_CM 1 0. 0. 65535. DISPLAY_IDENTIFIER fm_sta_cru_whl_cmd_nok.Vxx_dfctr_xxx ECU_ADDRESS 0xc0000226 /end MEASUREMENT
/begin MEASUREMENT Vxx_rdn_cru_whl_cmd_nok "" UWORD _CNV_A_R_A_165_CM 1 0. 0. 65535. DISPLAY_IDENTIFIER fm_sta_cru_whl_cmd_nok.Vxx_rdn_xxx ECU_ADDRESS 0xc0000228 /end MEASUREMENT
/begin MEASUREMENT Vbx_cf_cru_whl_cmd_nok "" UBYTE _CNV_A_R_A_165_CM 1 0. 0. 255. DISPLAY_IDENTIFIER fm_sta_cru_whl_cmd_nok.fm_static_bitfield.Vbx_cf_xxx ECU_ADDRESS 0xc000022a BIT_MASK 0x1 /end MEASUREMENT
/begin MEASUREMENT Vbx_clf_cru_whl_cmd_nok "" UBYTE _CNV_A_R_A_165_CM 1 0. 0. 255. DISPLAY_IDENTIFIER fm_sta_cru_whl_cmd_nok.fm_static_bitfield.Vbx_clf_xxx ECU_ADDRESS 0xc000022a BIT_MASK 0x2 /end MEASUREMENT
/begin MEASUREMENT Vbx_df_old_cru_whl_cmd_nok "" UBYTE _CNV_A_R_A_165_CM 1 0. 0. 255. DISPLAY_IDENTIFIER fm_sta_cru_whl_cmd_nok.fm_static_bitfield.Vbx_df_old_xxx ECU_ADDRESS 0xc000022a BIT_MASK 0x4 /end MEASUREMENT
/begin MEASUREMENT Vbx_dfctr_sat_cru_whl_cmd_nok "" UBYTE _CNV_A_R_A_165_CM 1 0. 0. 255. DISPLAY_IDENTIFIER fm_sta_cru_whl_cmd_nok.fm_static_bitfield.Vbx_dfctr_sat_xxx ECU_ADDRESS 0xc000022a BIT_MASK 0x8 /end MEASUREMENT
/begin MEASUREMENT Vbx_rdn_cru_whl_cmd_nok "" UBYTE _CNV_A_R_A_165_CM 1 0. 0. 255. DISPLAY_IDENTIFIER fm_sta_cru_whl_cmd_nok.fm_static_bitfield.Vbx_rdn_xxx ECU_ADDRESS 0xc000022a BIT_MASK 0x40 /end MEASUREMENT
/begin MEASUREMENT Vxx_dtc_stt_cru_whl_cmd_nok "" UBYTE _CNV_A_R_A_165_CM 1 0. 0. 255. DISPLAY_IDENTIFIER fm_sta_cru_whl_cmd_nok.Vxx_dtc_stt_xxx ECU_ADDRESS 0xc000022b /end MEASUREMENT
/begin MEASUREMENT Vxx_dfctr_cru_whl_cmd_oc_scw "" UWORD _CNV_A_R_A_165_CM 1 0. 0. 65535. DISPLAY_IDENTIFIER fm_sta_cru_whl_cmd_oc_scw.Vxx_dfctr_xxx ECU_ADDRESS 0xc000022c /end MEASUREMENT
/begin MEASUREMENT Vxx_rdn_cru_whl_cmd_oc_scw "" UWORD _CNV_A_R_A_165_CM 1 0. 0. 65535. DISPLAY_IDENTIFIER fm_sta_cru_whl_cmd_oc_scw.Vxx_rdn_xxx ECU_ADDRESS 0xc000022e /end MEASUREMENT
/begin MEASUREMENT Vbx_cf_cru_whl_cmd_oc_scw "" UBYTE _CNV_A_R_A_165_CM 1 0. 0. 255. DISPLAY_IDENTIFIER fm_sta_cru_whl_cmd_oc_scw.fm_static_bitfield.Vbx_cf_xxx ECU_ADDRESS 0xc0000230 BIT_MASK 0x1 /end MEASUREMENT
/begin MEASUREMENT Vbx_clf_cru_whl_cmd_oc_scw "" UBYTE _CNV_A_R_A_165_CM 1 0. 0. 255. DISPLAY_IDENTIFIER fm_sta_cru_whl_cmd_oc_scw.fm_static_bitfield.Vbx_clf_xxx ECU_ADDRESS 0xc0000230 BIT_MASK 0x2 /end MEASUREMENT
/begin MEASUREMENT Vbx_df_old_cru_whl_cmd_oc_scw "" UBYTE _CNV_A_R_A_165_CM 1 0. 0. 255. DISPLAY_IDENTIFIER fm_sta_cru_whl_cmd_oc_scw.fm_static_bitfield.Vbx_df_old_xxx ECU_ADDRESS 0xc0000230 BIT_MASK 0x4 /end MEASUREMENT
/begin MEASUREMENT Vbx_dfctr_sat_cru_whl_cmd_oc_scw "" UBYTE _CNV_A_R_A_165_CM 1 0. 0. 255. DISPLAY_IDENTIFIER fm_sta_cru_whl_cmd_oc_scw.fm_static_bitfield.Vbx_dfctr_sat_xxx ECU_ADDRESS 0xc0000230 BIT_MASK 0x8 /end MEASUREMENT
/begin MEASUREMENT Vbx_rdn_cru_whl_cmd_oc_scw "" UBYTE _CNV_A_R_A_165_CM 1 0. 0. 255. DISPLAY_IDENTIFIER fm_sta_cru_whl_cmd_oc_scw.fm_static_bitfield.Vbx_rdn_xxx ECU_ADDRESS 0xc0000230 BIT_MASK 0x40 /end MEASUREMENT
/begin MEASUREMENT Vxx_dtc_stt_cru_whl_cmd_oc_scw "" UBYTE _CNV_A_R_A_165_CM 1 0. 0. 255. DISPLAY_IDENTIFIER fm_sta_cru_whl_cmd_oc_scw.Vxx_dtc_stt_xxx ECU_ADDRESS 0xc0000231 /end MEASUREMENT
/begin MEASUREMENT Vxx_dfctr_cru_whl_cmd_oor "" UWORD _CNV_A_R_A_165_CM 1 0. 0. 65535. DISPLAY_IDENTIFIER fm_sta_cru_whl_cmd_oor.Vxx_dfctr_xxx ECU_ADDRESS 0xc0000232 /end MEASUREMENT
/begin MEASUREMENT Vxx_rdn_cru_whl_cmd_oor "" UWORD _CNV_A_R_A_165_CM 1 0. 0. 65535. DISPLAY_IDENTIFIER fm_sta_cru_whl_cmd_oor.Vxx_rdn_xxx ECU_ADDRESS 0xc0000234 /end MEASUREMENT
/begin MEASUREMENT Vbx_cf_cru_whl_cmd_oor "" UBYTE _CNV_A_R_A_165_CM 1 0. 0. 255. DISPLAY_IDENTIFIER fm_sta_cru_whl_cmd_oor.fm_static_bitfield.Vbx_cf_xxx ECU_ADDRESS 0xc0000236 BIT_MASK 0x1 /end MEASUREMENT
/begin MEASUREMENT Vbx_clf_cru_whl_cmd_oor "" UBYTE _CNV_A_R_A_165_CM 1 0. 0. 255. DISPLAY_IDENTIFIER fm_sta_cru_whl_cmd_oor.fm_static_bitfield.Vbx_clf_xxx ECU_ADDRESS 0xc0000236 BIT_MASK 0x2 /end MEASUREMENT
/begin MEASUREMENT Vbx_df_old_cru_whl_cmd_oor "" UBYTE _CNV_A_R_A_165_CM 1 0. 0. 255. DISPLAY_IDENTIFIER fm_sta_cru_whl_cmd_oor.fm_static_bitfield.Vbx_df_old_xxx ECU_ADDRESS 0xc0000236 BIT_MASK 0x4 /end MEASUREMENT
/begin MEASUREMENT Vbx_dfctr_sat_cru_whl_cmd_oor "" UBYTE _CNV_A_R_A_165_CM 1 0. 0. 255. DISPLAY_IDENTIFIER fm_sta_cru_whl_cmd_oor.fm_static_bitfield.Vbx_dfctr_sat_xxx ECU_ADDRESS 0xc0000236 BIT_MASK 0x8 /end MEASUREMENT
/begin MEASUREMENT Vbx_rdn_cru_whl_cmd_oor "" UBYTE _CNV_A_R_A_165_CM 1 0. 0. 255. DISPLAY_IDENTIFIER fm_sta_cru_whl_cmd_oor.fm_static_bitfield.Vbx_rdn_xxx ECU_ADDRESS 0xc0000236 BIT_MASK 0x40 /end MEASUREMENT
/begin MEASUREMENT Vxx_dtc_stt_cru_whl_cmd_oor "" UBYTE _CNV_A_R_A_165_CM 1 0. 0. 255. DISPLAY_IDENTIFIER fm_sta_cru_whl_cmd_oor.Vxx_dtc_stt_xxx ECU_ADDRESS 0xc0000237 /end MEASUREMENT
/begin MEASUREMENT Vxx_dfctr_ecm_adc_tron "" UWORD _CNV_A_R_A_165_CM 1 0. 0. 65535. DISPLAY_IDENTIFIER fm_sta_ecm_adc_tron.Vxx_dfctr_xxx ECU_ADDRESS 0xc00003dc /end MEASUREMENT
/begin MEASUREMENT Vxx_rdn_ecm_adc_tron "" UWORD _CNV_A_R_A_165_CM 1 0. 0. 65535. DISPLAY_IDENTIFIER fm_sta_ecm_adc_tron.Vxx_rdn_xxx ECU_ADDRESS 0xc00003de /end MEASUREMENT
/begin MEASUREMENT Vbx_cf_ecm_adc_tron "" UBYTE _CNV_A_R_A_165_CM 1 0. 0. 255. DISPLAY_IDENTIFIER fm_sta_ecm_adc_tron.fm_static_bitfield.Vbx_cf_xxx ECU_ADDRESS 0xc00003e0 BIT_MASK 0x1 /end MEASUREMENT
/begin MEASUREMENT Vbx_clf_ecm_adc_tron "" UBYTE _CNV_A_R_A_165_CM 1 0. 0. 255. DISPLAY_IDENTIFIER fm_sta_ecm_adc_tron.fm_static_bitfield.Vbx_clf_xxx ECU_ADDRESS 0xc00003e0 BIT_MASK 0x2 /end MEASUREMENT
/begin MEASUREMENT Vbx_df_old_ecm_adc_tron "" UBYTE _CNV_A_R_A_165_CM 1 0. 0. 255. DISPLAY_IDENTIFIER fm_sta_ecm_adc_tron.fm_static_bitfield.Vbx_df_old_xxx ECU_ADDRESS 0xc00003e0 BIT_MASK 0x4 /end MEASUREMENT
/begin MEASUREMENT Vbx_dfctr_sat_ecm_adc_tron "" UBYTE _CNV_A_R_A_165_CM 1 0. 0. 255. DISPLAY_IDENTIFIER fm_sta_ecm_adc_tron.fm_static_bitfield.Vbx_dfctr_sat_xxx ECU_ADDRESS 0xc00003e0 BIT_MASK 0x8 /end MEASUREMENT
/begin MEASUREMENT Vbx_rdn_ecm_adc_tron "" UBYTE _CNV_A_R_A_165_CM 1 0. 0. 255. DISPLAY_IDENTIFIER fm_sta_ecm_adc_tron.fm_static_bitfield.Vbx_rdn_xxx ECU_ADDRESS 0xc00003e0 BIT_MASK 0x40 /end MEASUREMENT
/begin MEASUREMENT Vxx_dtc_stt_ecm_adc_tron "" UBYTE _CNV_A_R_A_165_CM 1 0. 0. 255. DISPLAY_IDENTIFIER fm_sta_ecm_adc_tron.Vxx_dtc_stt_xxx ECU_ADDRESS 0xc00003e1 /end MEASUREMENT
/begin MEASUREMENT Vxx_dfctr_ecm_err_itl "" UWORD _CNV_A_R_A_165_CM 1 0. 0. 65535. DISPLAY_IDENTIFIER fm_sta_ecm_err_itl.Vxx_dfctr_xxx ECU_ADDRESS 0xc0000382 /end MEASUREMENT
/begin MEASUREMENT Vxx_rdn_ecm_err_itl "" UWORD _CNV_A_R_A_165_CM 1 0. 0. 65535. DISPLAY_IDENTIFIER fm_sta_ecm_err_itl.Vxx_rdn_xxx ECU_ADDRESS 0xc0000384 /end MEASUREMENT
/begin MEASUREMENT Vbx_cf_ecm_err_itl "" UBYTE _CNV_A_R_A_165_CM 1 0. 0. 255. DISPLAY_IDENTIFIER fm_sta_ecm_err_itl.fm_static_bitfield.Vbx_cf_xxx ECU_ADDRESS 0xc0000386 BIT_MASK 0x1 /end MEASUREMENT
/begin MEASUREMENT Vbx_clf_ecm_err_itl "" UBYTE _CNV_A_R_A_165_CM 1 0. 0. 255. DISPLAY_IDENTIFIER fm_sta_ecm_err_itl.fm_static_bitfield.Vbx_clf_xxx ECU_ADDRESS 0xc0000386 BIT_MASK 0x2 /end MEASUREMENT
/begin MEASUREMENT Vbx_df_old_ecm_err_itl "" UBYTE _CNV_A_R_A_165_CM 1 0. 0. 255. DISPLAY_IDENTIFIER fm_sta_ecm_err_itl.fm_static_bitfield.Vbx_df_old_xxx ECU_ADDRESS 0xc0000386 BIT_MASK 0x4 /end MEASUREMENT
/begin MEASUREMENT Vbx_dfctr_sat_ecm_err_itl "" UBYTE _CNV_A_R_A_165_CM 1 0. 0. 255. DISPLAY_IDENTIFIER fm_sta_ecm_err_itl.fm_static_bitfield.Vbx_dfctr_sat_xxx ECU_ADDRESS 0xc0000386 BIT_MASK 0x8 /end MEASUREMENT
/begin MEASUREMENT Vbx_rdn_ecm_err_itl "" UBYTE _CNV_A_R_A_165_CM 1 0. 0. 255. DISPLAY_IDENTIFIER fm_sta_ecm_err_itl.fm_static_bitfield.Vbx_rdn_xxx ECU_ADDRESS 0xc0000386 BIT_MASK 0x40 /end MEASUREMENT
/begin MEASUREMENT Vxx_dtc_stt_ecm_err_itl "" UBYTE _CNV_A_R_A_165_CM 1 0. 0. 255. DISPLAY_IDENTIFIER fm_sta_ecm_err_itl.Vxx_dtc_stt_xxx ECU_ADDRESS 0xc0000387 /end MEASUREMENT
/begin MEASUREMENT Vxx_dfctr_ecm_mon_secu_1 "" UWORD _CNV_A_R_A_165_CM 1 0. 0. 65535. DISPLAY_IDENTIFIER fm_sta_ecm_mon_secu_1.Vxx_dfctr_xxx ECU_ADDRESS 0xc00003d0 /end MEASUREMENT
/begin MEASUREMENT Vxx_rdn_ecm_mon_secu_1 "" UWORD _CNV_A_R_A_165_CM 1 0. 0. 65535. DISPLAY_IDENTIFIER fm_sta_ecm_mon_secu_1.Vxx_rdn_xxx ECU_ADDRESS 0xc00003d2 /end MEASUREMENT
/begin MEASUREMENT Vbx_cf_ecm_mon_secu_1 "" UBYTE _CNV_A_R_A_165_CM 1 0. 0. 255. DISPLAY_IDENTIFIER fm_sta_ecm_mon_secu_1.fm_static_bitfield.Vbx_cf_xxx ECU_ADDRESS 0xc00003d4 BIT_MASK 0x1 /end MEASUREMENT
/begin MEASUREMENT Vbx_clf_ecm_mon_secu_1 "" UBYTE _CNV_A_R_A_165_CM 1 0. 0. 255. DISPLAY_IDENTIFIER fm_sta_ecm_mon_secu_1.fm_static_bitfield.Vbx_clf_xxx ECU_ADDRESS 0xc00003d4 BIT_MASK 0x2 /end MEASUREMENT
/begin MEASUREMENT Vbx_df_old_ecm_mon_secu_1 "" UBYTE _CNV_A_R_A_165_CM 1 0. 0. 255. DISPLAY_IDENTIFIER fm_sta_ecm_mon_secu_1.fm_static_bitfield.Vbx_df_old_xxx ECU_ADDRESS 0xc00003d4 BIT_MASK 0x4 /end MEASUREMENT
/begin MEASUREMENT Vbx_dfctr_sat_ecm_mon_secu_1 "" UBYTE _CNV_A_R_A_165_CM 1 0. 0. 255. DISPLAY_IDENTIFIER fm_sta_ecm_mon_secu_1.fm_static_bitfield.Vbx_dfctr_sat_xxx ECU_ADDRESS 0xc00003d4 BIT_MASK 0x8 /end MEASUREMENT
/begin MEASUREMENT Vbx_rdn_ecm_mon_secu_1 "" UBYTE _CNV_A_R_A_165_CM 1 0. 0. 255. DISPLAY_IDENTIFIER fm_sta_ecm_mon_secu_1.fm_static_bitfield.Vbx_rdn_xxx ECU_ADDRESS 0xc00003d4 BIT_MASK 0x40 /end MEASUREMENT
/begin MEASUREMENT Vxx_dtc_stt_ecm_mon_secu_1 "" UBYTE _CNV_A_R_A_165_CM 1 0. 0. 255. DISPLAY_IDENTIFIER fm_sta_ecm_mon_secu_1.Vxx_dtc_stt_xxx ECU_ADDRESS 0xc00003d5 /end MEASUREMENT
/begin MEASUREMENT Vxx_dfctr_ecm_mon_secu_2 "" UWORD _CNV_A_R_A_165_CM 1 0. 0. 65535. DISPLAY_IDENTIFIER fm_sta_ecm_mon_secu_2.Vxx_dfctr_xxx ECU_ADDRESS 0xc00003d6 /end MEASUREMENT
/begin MEASUREMENT Vxx_rdn_ecm_mon_secu_2 "" UWORD _CNV_A_R_A_165_CM 1 0. 0. 65535. DISPLAY_IDENTIFIER fm_sta_ecm_mon_secu_2.Vxx_rdn_xxx ECU_ADDRESS 0xc00003d8 /end MEASUREMENT
/begin MEASUREMENT Vbx_cf_ecm_mon_secu_2 "" UBYTE _CNV_A_R_A_165_CM 1 0. 0. 255. DISPLAY_IDENTIFIER fm_sta_ecm_mon_secu_2.fm_static_bitfield.Vbx_cf_xxx ECU_ADDRESS 0xc00003da BIT_MASK 0x1 /end MEASUREMENT
/begin MEASUREMENT Vbx_clf_ecm_mon_secu_2 "" UBYTE _CNV_A_R_A_165_CM 1 0. 0. 255. DISPLAY_IDENTIFIER fm_sta_ecm_mon_secu_2.fm_static_bitfield.Vbx_clf_xxx ECU_ADDRESS 0xc00003da BIT_MASK 0x2 /end MEASUREMENT
/begin MEASUREMENT Vbx_df_old_ecm_mon_secu_2 "" UBYTE _CNV_A_R_A_165_CM 1 0. 0. 255. DISPLAY_IDENTIFIER fm_sta_ecm_mon_secu_2.fm_static_bitfield.Vbx_df_old_xxx ECU_ADDRESS 0xc00003da BIT_MASK 0x4 /end MEASUREMENT
/begin MEASUREMENT Vbx_dfctr_sat_ecm_mon_secu_2 "" UBYTE _CNV_A_R_A_165_CM 1 0. 0. 255. DISPLAY_IDENTIFIER fm_sta_ecm_mon_secu_2.fm_static_bitfield.Vbx_dfctr_sat_xxx ECU_ADDRESS 0xc00003da BIT_MASK 0x8 /end MEASUREMENT
/begin MEASUREMENT Vbx_rdn_ecm_mon_secu_2 "" UBYTE _CNV_A_R_A_165_CM 1 0. 0. 255. DISPLAY_IDENTIFIER fm_sta_ecm_mon_secu_2.fm_static_bitfield.Vbx_rdn_xxx ECU_ADDRESS 0xc00003da BIT_MASK 0x40 /end MEASUREMENT
/begin MEASUREMENT Vxx_dtc_stt_ecm_mon_secu_2 "" UBYTE _CNV_A_R_A_165_CM 1 0. 0. 255. DISPLAY_IDENTIFIER fm_sta_ecm_mon_secu_2.Vxx_dtc_stt_xxx ECU_ADDRESS 0xc00003db /end MEASUREMENT
/begin MEASUREMENT Vxx_dfctr_ecm_mon_tron "" UWORD _CNV_A_R_A_165_CM 1 0. 0. 65535. DISPLAY_IDENTIFIER fm_sta_ecm_mon_tron.Vxx_dfctr_xxx ECU_ADDRESS 0xc0000388 /end MEASUREMENT
/begin MEASUREMENT Vxx_rdn_ecm_mon_tron "" UWORD _CNV_A_R_A_165_CM 1 0. 0. 65535. DISPLAY_IDENTIFIER fm_sta_ecm_mon_tron.Vxx_rdn_xxx ECU_ADDRESS 0xc000038a /end MEASUREMENT
/begin MEASUREMENT Vbx_cf_ecm_mon_tron "" UBYTE _CNV_A_R_A_165_CM 1 0. 0. 255. DISPLAY_IDENTIFIER fm_sta_ecm_mon_tron.fm_static_bitfield.Vbx_cf_xxx ECU_ADDRESS 0xc000038c BIT_MASK 0x1 /end MEASUREMENT
/begin MEASUREMENT Vbx_clf_ecm_mon_tron "" UBYTE _CNV_A_R_A_165_CM 1 0. 0. 255. DISPLAY_IDENTIFIER fm_sta_ecm_mon_tron.fm_static_bitfield.Vbx_clf_xxx ECU_ADDRESS 0xc000038c BIT_MASK 0x2 /end MEASUREMENT
/begin MEASUREMENT Vbx_df_old_ecm_mon_tron "" UBYTE _CNV_A_R_A_165_CM 1 0. 0. 255. DISPLAY_IDENTIFIER fm_sta_ecm_mon_tron.fm_static_bitfield.Vbx_df_old_xxx ECU_ADDRESS 0xc000038c BIT_MASK 0x4 /end MEASUREMENT
/begin MEASUREMENT Vbx_dfctr_sat_ecm_mon_tron "" UBYTE _CNV_A_R_A_165_CM 1 0. 0. 255. DISPLAY_IDENTIFIER fm_sta_ecm_mon_tron.fm_static_bitfield.Vbx_dfctr_sat_xxx ECU_ADDRESS 0xc000038c BIT_MASK 0x8 /end MEASUREMENT
/begin MEASUREMENT Vbx_rdn_ecm_mon_tron "" UBYTE _CNV_A_R_A_165_CM 1 0. 0. 255. DISPLAY_IDENTIFIER fm_sta_ecm_mon_tron.fm_static_bitfield.Vbx_rdn_xxx ECU_ADDRESS 0xc000038c BIT_MASK 0x40 /end MEASUREMENT
/begin MEASUREMENT Vxx_dtc_stt_ecm_mon_tron "" UBYTE _CNV_A_R_A_165_CM 1 0. 0. 255. DISPLAY_IDENTIFIER fm_sta_ecm_mon_tron.Vxx_dtc_stt_xxx ECU_ADDRESS 0xc000038d /end MEASUREMENT
/begin MEASUREMENT Sbx_dyn_ac_prs_h "" UBYTE _CNV_A_R_A_165_CM 1 0. 0. 255. DISPLAY_IDENTIFIER fm_sta_eprm_ac_prs_h.fm_static_eprm_bitfield.Sbx_dyn_xxx ECU_ADDRESS 0xc0000448 BIT_MASK 0x8 /end MEASUREMENT
/begin MEASUREMENT Sbx_rdn_ac_prs_h "" UBYTE _CNV_A_R_A_165_CM 1 0. 0. 255. DISPLAY_IDENTIFIER fm_sta_eprm_ac_prs_h.fm_static_eprm_bitfield.Sbx_rdn_xxx ECU_ADDRESS 0xc0000448 BIT_MASK 0x10 /end MEASUREMENT
/begin MEASUREMENT Sbx_mf_ac_prs_h "" UBYTE _CNV_A_R_A_165_CM 1 0. 0. 255. DISPLAY_IDENTIFIER fm_sta_eprm_ac_prs_h.fm_static_eprm_bitfield.Sbx_mf_xxx ECU_ADDRESS 0xc0000448 BIT_MASK 0x20 /end MEASUREMENT
/begin MEASUREMENT Sbx_cf_ac_prs_h "" UBYTE _CNV_A_R_A_165_CM 1 0. 0. 255. DISPLAY_IDENTIFIER fm_sta_eprm_ac_prs_h.fm_static_eprm_bitfield.Sbx_cf_xxx ECU_ADDRESS 0xc0000448 BIT_MASK 0x80 /end MEASUREMENT
/begin MEASUREMENT Sbx_dyn_ac_prs_l "" UBYTE _CNV_A_R_A_165_CM 1 0. 0. 255. DISPLAY_IDENTIFIER fm_sta_eprm_ac_prs_l.fm_static_eprm_bitfield.Sbx_dyn_xxx ECU_ADDRESS 0xc000044a BIT_MASK 0x8 /end MEASUREMENT
/begin MEASUREMENT Sbx_rdn_ac_prs_l "" UBYTE _CNV_A_R_A_165_CM 1 0. 0. 255. DISPLAY_IDENTIFIER fm_sta_eprm_ac_prs_l.fm_static_eprm_bitfield.Sbx_rdn_xxx ECU_ADDRESS 0xc000044a BIT_MASK 0x10 /end MEASUREMENT
/begin MEASUREMENT Sbx_mf_ac_prs_l "" UBYTE _CNV_A_R_A_165_CM 1 0. 0. 255. DISPLAY_IDENTIFIER fm_sta_eprm_ac_prs_l.fm_static_eprm_bitfield.Sbx_mf_xxx ECU_ADDRESS 0xc000044a BIT_MASK 0x20 /end MEASUREMENT
/begin MEASUREMENT Sbx_cf_ac_prs_l "" UBYTE _CNV_A_R_A_165_CM 1 0. 0. 255. DISPLAY_IDENTIFIER fm_sta_eprm_ac_prs_l.fm_static_eprm_bitfield.Sbx_cf_xxx ECU_ADDRESS 0xc000044a BIT_MASK 0x80 /end MEASUREMENT
/begin MEASUREMENT Sbx_dyn_acel_pdl_chr "" UBYTE _CNV_A_R_A_165_CM 1 0. 0. 255. DISPLAY_IDENTIFIER fm_sta_eprm_acel_pdl_chr.fm_static_eprm_bitfield.Sbx_dyn_xxx ECU_ADDRESS 0xc000044c BIT_MASK 0x8 /end MEASUREMENT
/begin MEASUREMENT Sbx_rdn_acel_pdl_chr "" UBYTE _CNV_A_R_A_165_CM 1 0. 0. 255. DISPLAY_IDENTIFIER fm_sta_eprm_acel_pdl_chr.fm_static_eprm_bitfield.Sbx_rdn_xxx ECU_ADDRESS 0xc000044c BIT_MASK 0x10 /end MEASUREMENT
/begin MEASUREMENT Sbx_mf_acel_pdl_chr "" UBYTE _CNV_A_R_A_165_CM 1 0. 0. 255. DISPLAY_IDENTIFIER fm_sta_eprm_acel_pdl_chr.fm_static_eprm_bitfield.Sbx_mf_xxx ECU_ADDRESS 0xc000044c BIT_MASK 0x20 /end MEASUREMENT
/begin MEASUREMENT Sbx_cf_acel_pdl_chr "" UBYTE _CNV_A_R_A_165_CM 1 0. 0. 255. DISPLAY_IDENTIFIER fm_sta_eprm_acel_pdl_chr.fm_static_eprm_bitfield.Sbx_cf_xxx ECU_ADDRESS 0xc000044c BIT_MASK 0x80 /end MEASUREMENT
/begin MEASUREMENT Sbx_dyn_acel_pdl_secu_1 "" UBYTE _CNV_A_R_A_165_CM 1 0. 0. 255. DISPLAY_IDENTIFIER fm_sta_eprm_acel_pdl_secu_1.fm_static_eprm_bitfield.Sbx_dyn_xxx ECU_ADDRESS 0xc000044e BIT_MASK 0x8 /end MEASUREMENT
/begin MEASUREMENT Sbx_rdn_acel_pdl_secu_1 "" UBYTE _CNV_A_R_A_165_CM 1 0. 0. 255. DISPLAY_IDENTIFIER fm_sta_eprm_acel_pdl_secu_1.fm_static_eprm_bitfield.Sbx_rdn_xxx ECU_ADDRESS 0xc000044e BIT_MASK 0x10 /end MEASUREMENT
/begin MEASUREMENT Sbx_mf_acel_pdl_secu_1 "" UBYTE _CNV_A_R_A_165_CM 1 0. 0. 255. DISPLAY_IDENTIFIER fm_sta_eprm_acel_pdl_secu_1.fm_static_eprm_bitfield.Sbx_mf_xxx ECU_ADDRESS 0xc000044e BIT_MASK 0x20 /end MEASUREMENT
/begin MEASUREMENT Sbx_cf_acel_pdl_secu_1 "" UBYTE _CNV_A_R_A_165_CM 1 0. 0. 255. DISPLAY_IDENTIFIER fm_sta_eprm_acel_pdl_secu_1.fm_static_eprm_bitfield.Sbx_cf_xxx ECU_ADDRESS 0xc000044e BIT_MASK 0x80 /end MEASUREMENT
/begin MEASUREMENT Sbx_dyn_acel_pdl_secu_2 "" UBYTE _CNV_A_R_A_165_CM 1 0. 0. 255. DISPLAY_IDENTIFIER fm_sta_eprm_acel_pdl_secu_2.fm_static_eprm_bitfield.Sbx_dyn_xxx ECU_ADDRESS 0xc0000450 BIT_MASK 0x8 /end MEASUREMENT
/begin MEASUREMENT Sbx_rdn_acel_pdl_secu_2 "" UBYTE _CNV_A_R_A_165_CM 1 0. 0. 255. DISPLAY_IDENTIFIER fm_sta_eprm_acel_pdl_secu_2.fm_static_eprm_bitfield.Sbx_rdn_xxx ECU_ADDRESS 0xc0000450 BIT_MASK 0x10 /end MEASUREMENT
/begin MEASUREMENT Sbx_mf_acel_pdl_secu_2 "" UBYTE _CNV_A_R_A_165_CM 1 0. 0. 255. DISPLAY_IDENTIFIER fm_sta_eprm_acel_pdl_secu_2.fm_static_eprm_bitfield.Sbx_mf_xxx ECU_ADDRESS 0xc0000450 BIT_MASK 0x20 /end MEASUREMENT
/begin MEASUREMENT Sbx_cf_acel_pdl_secu_2 "" UBYTE _CNV_A_R_A_165_CM 1 0. 0. 255. DISPLAY_IDENTIFIER fm_sta_eprm_acel_pdl_secu_2.fm_static_eprm_bitfield.Sbx_cf_xxx ECU_ADDRESS 0xc0000450 BIT_MASK 0x80 /end MEASUREMENT
/begin MEASUREMENT Sbx_dyn_acel_pdl_tot "" UBYTE _CNV_A_R_A_165_CM 1 0. 0. 255. DISPLAY_IDENTIFIER fm_sta_eprm_acel_pdl_tot.fm_static_eprm_bitfield.Sbx_dyn_xxx ECU_ADDRESS 0xc0000452 BIT_MASK 0x8 /end MEASUREMENT
/begin MEASUREMENT Sbx_rdn_acel_pdl_tot "" UBYTE _CNV_A_R_A_165_CM 1 0. 0. 255. DISPLAY_IDENTIFIER fm_sta_eprm_acel_pdl_tot.fm_static_eprm_bitfield.Sbx_rdn_xxx ECU_ADDRESS 0xc0000452 BIT_MASK 0x10 /end MEASUREMENT
/begin MEASUREMENT Sbx_mf_acel_pdl_tot "" UBYTE _CNV_A_R_A_165_CM 1 0. 0. 255. DISPLAY_IDENTIFIER fm_sta_eprm_acel_pdl_tot.fm_static_eprm_bitfield.Sbx_mf_xxx ECU_ADDRESS 0xc0000452 BIT_MASK 0x20 /end MEASUREMENT
/begin MEASUREMENT Sbx_cf_acel_pdl_tot "" UBYTE _CNV_A_R_A_165_CM 1 0. 0. 255. DISPLAY_IDENTIFIER fm_sta_eprm_acel_pdl_tot.fm_static_eprm_bitfield.Sbx_cf_xxx ECU_ADDRESS 0xc0000452 BIT_MASK 0x80 /end MEASUREMENT
/begin MEASUREMENT Sbx_dyn_acel_pdl_v1_h "" UBYTE _CNV_A_R_A_165_CM 1 0. 0. 255. DISPLAY_IDENTIFIER fm_sta_eprm_acel_pdl_v1_h.fm_static_eprm_bitfield.Sbx_dyn_xxx ECU_ADDRESS 0xc0000454 BIT_MASK 0x8 /end MEASUREMENT
/begin MEASUREMENT Sbx_rdn_acel_pdl_v1_h "" UBYTE _CNV_A_R_A_165_CM 1 0. 0. 255. DISPLAY_IDENTIFIER fm_sta_eprm_acel_pdl_v1_h.fm_static_eprm_bitfield.Sbx_rdn_xxx ECU_ADDRESS 0xc0000454 BIT_MASK 0x10 /end MEASUREMENT
/begin MEASUREMENT Sbx_mf_acel_pdl_v1_h "" UBYTE _CNV_A_R_A_165_CM 1 0. 0. 255. DISPLAY_IDENTIFIER fm_sta_eprm_acel_pdl_v1_h.fm_static_eprm_bitfield.Sbx_mf_xxx ECU_ADDRESS 0xc0000454 BIT_MASK 0x20 /end MEASUREMENT
/begin MEASUREMENT Sbx_cf_acel_pdl_v1_h "" UBYTE _CNV_A_R_A_165_CM 1 0. 0. 255. DISPLAY_IDENTIFIER fm_sta_eprm_acel_pdl_v1_h.fm_static_eprm_bitfield.Sbx_cf_xxx ECU_ADDRESS 0xc0000454 BIT_MASK 0x80 /end MEASUREMENT
/begin MEASUREMENT Sbx_dyn_acel_pdl_v1_l "" UBYTE _CNV_A_R_A_165_CM 1 0. 0. 255. DISPLAY_IDENTIFIER fm_sta_eprm_acel_pdl_v1_l.fm_static_eprm_bitfield.Sbx_dyn_xxx ECU_ADDRESS 0xc0000456 BIT_MASK 0x8 /end MEASUREMENT
/begin MEASUREMENT Sbx_rdn_acel_pdl_v1_l "" UBYTE _CNV_A_R_A_165_CM 1 0. 0. 255. DISPLAY_IDENTIFIER fm_sta_eprm_acel_pdl_v1_l.fm_static_eprm_bitfield.Sbx_rdn_xxx ECU_ADDRESS 0xc0000456 BIT_MASK 0x10 /end MEASUREMENT
/begin MEASUREMENT Sbx_mf_acel_pdl_v1_l "" UBYTE _CNV_A_R_A_165_CM 1 0. 0. 255. DISPLAY_IDENTIFIER fm_sta_eprm_acel_pdl_v1_l.fm_static_eprm_bitfield.Sbx_mf_xxx ECU_ADDRESS 0xc0000456 BIT_MASK 0x20 /end MEASUREMENT
/begin MEASUREMENT Sbx_cf_acel_pdl_v1_l "" UBYTE _CNV_A_R_A_165_CM 1 0. 0. 255. DISPLAY_IDENTIFIER fm_sta_eprm_acel_pdl_v1_l.fm_static_eprm_bitfield.Sbx_cf_xxx ECU_ADDRESS 0xc0000456 BIT_MASK 0x80 /end MEASUREMENT
/begin MEASUREMENT Sbx_dyn_acel_pdl_v2_h "" UBYTE _CNV_A_R_A_165_CM 1 0. 0. 255. DISPLAY_IDENTIFIER fm_sta_eprm_acel_pdl_v2_h.fm_static_eprm_bitfield.Sbx_dyn_xxx ECU_ADDRESS 0xc0000458 BIT_MASK 0x8 /end MEASUREMENT
/begin MEASUREMENT Sbx_rdn_acel_pdl_v2_h "" UBYTE _CNV_A_R_A_165_CM 1 0. 0. 255. DISPLAY_IDENTIFIER fm_sta_eprm_acel_pdl_v2_h.fm_static_eprm_bitfield.Sbx_rdn_xxx ECU_ADDRESS 0xc0000458 BIT_MASK 0x10 /end MEASUREMENT
/begin MEASUREMENT Sbx_mf_acel_pdl_v2_h "" UBYTE _CNV_A_R_A_165_CM 1 0. 0. 255. DISPLAY_IDENTIFIER fm_sta_eprm_acel_pdl_v2_h.fm_static_eprm_bitfield.Sbx_mf_xxx ECU_ADDRESS 0xc0000458 BIT_MASK 0x20 /end MEASUREMENT
/begin MEASUREMENT Sbx_cf_acel_pdl_v2_h "" UBYTE _CNV_A_R_A_165_CM 1 0. 0. 255. DISPLAY_IDENTIFIER fm_sta_eprm_acel_pdl_v2_h.fm_static_eprm_bitfield.Sbx_cf_xxx ECU_ADDRESS 0xc0000458 BIT_MASK 0x80 /end MEASUREMENT
/begin MEASUREMENT Sbx_dyn_acel_pdl_v2_l "" UBYTE _CNV_A_R_A_165_CM 1 0. 0. 255. DISPLAY_IDENTIFIER fm_sta_eprm_acel_pdl_v2_l.fm_static_eprm_bitfield.Sbx_dyn_xxx ECU_ADDRESS 0xc000045a BIT_MASK 0x8 /end MEASUREMENT
/begin MEASUREMENT Sbx_rdn_acel_pdl_v2_l "" UBYTE _CNV_A_R_A_165_CM 1 0. 0. 255. DISPLAY_IDENTIFIER fm_sta_eprm_acel_pdl_v2_l.fm_static_eprm_bitfield.Sbx_rdn_xxx ECU_ADDRESS 0xc000045a BIT_MASK 0x10 /end MEASUREMENT
/begin MEASUREMENT Sbx_mf_acel_pdl_v2_l "" UBYTE _CNV_A_R_A_165_CM 1 0. 0. 255. DISPLAY_IDENTIFIER fm_sta_eprm_acel_pdl_v2_l.fm_static_eprm_bitfield.Sbx_mf_xxx ECU_ADDRESS 0xc000045a BIT_MASK 0x20 /end MEASUREMENT
/begin MEASUREMENT Sbx_cf_acel_pdl_v2_l "" UBYTE _CNV_A_R_A_165_CM 1 0. 0. 255. DISPLAY_IDENTIFIER fm_sta_eprm_acel_pdl_v2_l.fm_static_eprm_bitfield.Sbx_cf_xxx ECU_ADDRESS 0xc000045a BIT_MASK 0x80 /end MEASUREMENT
/begin MEASUREMENT Sbx_dyn_actr_rly_oc "" UBYTE _CNV_A_R_A_165_CM 1 0. 0. 255. DISPLAY_IDENTIFIER fm_sta_eprm_actr_rly_oc.fm_static_eprm_bitfield.Sbx_dyn_xxx ECU_ADDRESS 0xc000045c BIT_MASK 0x8 /end MEASUREMENT
/begin MEASUREMENT Sbx_rdn_actr_rly_oc "" UBYTE _CNV_A_R_A_165_CM 1 0. 0. 255. DISPLAY_IDENTIFIER fm_sta_eprm_actr_rly_oc.fm_static_eprm_bitfield.Sbx_rdn_xxx ECU_ADDRESS 0xc000045c BIT_MASK 0x10 /end MEASUREMENT
/begin MEASUREMENT Sbx_mf_actr_rly_oc "" UBYTE _CNV_A_R_A_165_CM 1 0. 0. 255. DISPLAY_IDENTIFIER fm_sta_eprm_actr_rly_oc.fm_static_eprm_bitfield.Sbx_mf_xxx ECU_ADDRESS 0xc000045c BIT_MASK 0x20 /end MEASUREMENT
/begin MEASUREMENT Sbx_cf_actr_rly_oc "" UBYTE _CNV_A_R_A_165_CM 1 0. 0. 255. DISPLAY_IDENTIFIER fm_sta_eprm_actr_rly_oc.fm_static_eprm_bitfield.Sbx_cf_xxx ECU_ADDRESS 0xc000045c BIT_MASK 0x80 /end MEASUREMENT
/begin MEASUREMENT Sbx_dyn_actr_rly_scg "" UBYTE _CNV_A_R_A_165_CM 1 0. 0. 255. DISPLAY_IDENTIFIER fm_sta_eprm_actr_rly_scg.fm_static_eprm_bitfield.Sbx_dyn_xxx ECU_ADDRESS 0xc000045e BIT_MASK 0x8 /end MEASUREMENT
/begin MEASUREMENT Sbx_rdn_actr_rly_scg "" UBYTE _CNV_A_R_A_165_CM 1 0. 0. 255. DISPLAY_IDENTIFIER fm_sta_eprm_actr_rly_scg.fm_static_eprm_bitfield.Sbx_rdn_xxx ECU_ADDRESS 0xc000045e BIT_MASK 0x10 /end MEASUREMENT
/begin MEASUREMENT Sbx_mf_actr_rly_scg "" UBYTE _CNV_A_R_A_165_CM 1 0. 0. 255. DISPLAY_IDENTIFIER fm_sta_eprm_actr_rly_scg.fm_static_eprm_bitfield.Sbx_mf_xxx ECU_ADDRESS 0xc000045e BIT_MASK 0x20 /end MEASUREMENT
/begin MEASUREMENT Sbx_cf_actr_rly_scg "" UBYTE _CNV_A_R_A_165_CM 1 0. 0. 255. DISPLAY_IDENTIFIER fm_sta_eprm_actr_rly_scg.fm_static_eprm_bitfield.Sbx_cf_xxx ECU_ADDRESS 0xc000045e BIT_MASK 0x80 /end MEASUREMENT
/begin MEASUREMENT Sbx_dyn_actr_rly_scw "" UBYTE _CNV_A_R_A_165_CM 1 0. 0. 255. DISPLAY_IDENTIFIER fm_sta_eprm_actr_rly_scw.fm_static_eprm_bitfield.Sbx_dyn_xxx ECU_ADDRESS 0xc0000460 BIT_MASK 0x8 /end MEASUREMENT
/begin MEASUREMENT Sbx_rdn_actr_rly_scw "" UBYTE _CNV_A_R_A_165_CM 1 0. 0. 255. DISPLAY_IDENTIFIER fm_sta_eprm_actr_rly_scw.fm_static_eprm_bitfield.Sbx_rdn_xxx ECU_ADDRESS 0xc0000460 BIT_MASK 0x10 /end MEASUREMENT
/begin MEASUREMENT Sbx_mf_actr_rly_scw "" UBYTE _CNV_A_R_A_165_CM 1 0. 0. 255. DISPLAY_IDENTIFIER fm_sta_eprm_actr_rly_scw.fm_static_eprm_bitfield.Sbx_mf_xxx ECU_ADDRESS 0xc0000460 BIT_MASK 0x20 /end MEASUREMENT
/begin MEASUREMENT Sbx_cf_actr_rly_scw "" UBYTE _CNV_A_R_A_165_CM 1 0. 0. 255. DISPLAY_IDENTIFIER fm_sta_eprm_actr_rly_scw.fm_static_eprm_bitfield.Sbx_cf_xxx ECU_ADDRESS 0xc0000460 BIT_MASK 0x80 /end MEASUREMENT
/begin MEASUREMENT Sbx_dyn_agb_data_chr "" UBYTE _CNV_A_R_A_165_CM 1 0. 0. 255. DISPLAY_IDENTIFIER fm_sta_eprm_agb_data_chr.fm_static_eprm_bitfield.Sbx_dyn_xxx ECU_ADDRESS 0xc0000462 BIT_MASK 0x8 /end MEASUREMENT
/begin MEASUREMENT Sbx_rdn_agb_data_chr "" UBYTE _CNV_A_R_A_165_CM 1 0. 0. 255. DISPLAY_IDENTIFIER fm_sta_eprm_agb_data_chr.fm_static_eprm_bitfield.Sbx_rdn_xxx ECU_ADDRESS 0xc0000462 BIT_MASK 0x10 /end MEASUREMENT
/begin MEASUREMENT Sbx_mf_agb_data_chr "" UBYTE _CNV_A_R_A_165_CM 1 0. 0. 255. DISPLAY_IDENTIFIER fm_sta_eprm_agb_data_chr.fm_static_eprm_bitfield.Sbx_mf_xxx ECU_ADDRESS 0xc0000462 BIT_MASK 0x20 /end MEASUREMENT
/begin MEASUREMENT Sbx_cf_agb_data_chr "" UBYTE _CNV_A_R_A_165_CM 1 0. 0. 255. DISPLAY_IDENTIFIER fm_sta_eprm_agb_data_chr.fm_static_eprm_bitfield.Sbx_cf_xxx ECU_ADDRESS 0xc0000462 BIT_MASK 0x80 /end MEASUREMENT
/begin MEASUREMENT Sbx_dyn_agb_data_seq_ctr "" UBYTE _CNV_A_R_A_165_CM 1 0. 0. 255. DISPLAY_IDENTIFIER fm_sta_eprm_agb_data_seq_ctr.fm_static_eprm_bitfield.Sbx_dyn_xxx ECU_ADDRESS 0xc0000464 BIT_MASK 0x8 /end MEASUREMENT
/begin MEASUREMENT Sbx_rdn_agb_data_seq_ctr "" UBYTE _CNV_A_R_A_165_CM 1 0. 0. 255. DISPLAY_IDENTIFIER fm_sta_eprm_agb_data_seq_ctr.fm_static_eprm_bitfield.Sbx_rdn_xxx ECU_ADDRESS 0xc0000464 BIT_MASK 0x10 /end MEASUREMENT
/begin MEASUREMENT Sbx_mf_agb_data_seq_ctr "" UBYTE _CNV_A_R_A_165_CM 1 0. 0. 255. DISPLAY_IDENTIFIER fm_sta_eprm_agb_data_seq_ctr.fm_static_eprm_bitfield.Sbx_mf_xxx ECU_ADDRESS 0xc0000464 BIT_MASK 0x20 /end MEASUREMENT
/begin MEASUREMENT Sbx_cf_agb_data_seq_ctr "" UBYTE _CNV_A_R_A_165_CM 1 0. 0. 255. DISPLAY_IDENTIFIER fm_sta_eprm_agb_data_seq_ctr.fm_static_eprm_bitfield.Sbx_cf_xxx ECU_ADDRESS 0xc0000464 BIT_MASK 0x80 /end MEASUREMENT
/begin MEASUREMENT Sbx_dyn_agb_data_tout "" UBYTE _CNV_A_R_A_165_CM 1 0. 0. 255. DISPLAY_IDENTIFIER fm_sta_eprm_agb_data_tout.fm_static_eprm_bitfield.Sbx_dyn_xxx ECU_ADDRESS 0xc0000466 BIT_MASK 0x8 /end MEASUREMENT
/begin MEASUREMENT Sbx_rdn_agb_data_tout "" UBYTE _CNV_A_R_A_165_CM 1 0. 0. 255. DISPLAY_IDENTIFIER fm_sta_eprm_agb_data_tout.fm_static_eprm_bitfield.Sbx_rdn_xxx ECU_ADDRESS 0xc0000466 BIT_MASK 0x10 /end MEASUREMENT
/begin MEASUREMENT Sbx_mf_agb_data_tout "" UBYTE _CNV_A_R_A_165_CM 1 0. 0. 255. DISPLAY_IDENTIFIER fm_sta_eprm_agb_data_tout.fm_static_eprm_bitfield.Sbx_mf_xxx ECU_ADDRESS 0xc0000466 BIT_MASK 0x20 /end MEASUREMENT
/begin MEASUREMENT Sbx_cf_agb_data_tout "" UBYTE _CNV_A_R_A_165_CM 1 0. 0. 255. DISPLAY_IDENTIFIER fm_sta_eprm_agb_data_tout.fm_static_eprm_bitfield.Sbx_cf_xxx ECU_ADDRESS 0xc0000466 BIT_MASK 0x80 /end MEASUREMENT
/begin MEASUREMENT Sbx_dyn_agb_no_frm "" UBYTE _CNV_A_R_A_165_CM 1 0. 0. 255. DISPLAY_IDENTIFIER fm_sta_eprm_agb_no_frm.fm_static_eprm_bitfield.Sbx_dyn_xxx ECU_ADDRESS 0xc0000468 BIT_MASK 0x8 /end MEASUREMENT
/begin MEASUREMENT Sbx_rdn_agb_no_frm "" UBYTE _CNV_A_R_A_165_CM 1 0. 0. 255. DISPLAY_IDENTIFIER fm_sta_eprm_agb_no_frm.fm_static_eprm_bitfield.Sbx_rdn_xxx ECU_ADDRESS 0xc0000468 BIT_MASK 0x10 /end MEASUREMENT
/begin MEASUREMENT Sbx_mf_agb_no_frm "" UBYTE _CNV_A_R_A_165_CM 1 0. 0. 255. DISPLAY_IDENTIFIER fm_sta_eprm_agb_no_frm.fm_static_eprm_bitfield.Sbx_mf_xxx ECU_ADDRESS 0xc0000468 BIT_MASK 0x20 /end MEASUREMENT
/begin MEASUREMENT Sbx_cf_agb_no_frm "" UBYTE _CNV_A_R_A_165_CM 1 0. 0. 255. DISPLAY_IDENTIFIER fm_sta_eprm_agb_no_frm.fm_static_eprm_bitfield.Sbx_cf_xxx ECU_ADDRESS 0xc0000468 BIT_MASK 0x80 /end MEASUREMENT
/begin MEASUREMENT Sbx_dyn_bgin_clu_cmp "" UBYTE _CNV_A_R_A_165_CM 1 0. 0. 255. DISPLAY_IDENTIFIER fm_sta_eprm_bgin_clu_cmp.fm_static_eprm_bitfield.Sbx_dyn_xxx ECU_ADDRESS 0xc00004ee BIT_MASK 0x8 /end MEASUREMENT
/begin MEASUREMENT Sbx_rdn_bgin_clu_cmp "" UBYTE _CNV_A_R_A_165_CM 1 0. 0. 255. DISPLAY_IDENTIFIER fm_sta_eprm_bgin_clu_cmp.fm_static_eprm_bitfield.Sbx_rdn_xxx ECU_ADDRESS 0xc00004ee BIT_MASK 0x10 /end MEASUREMENT
/begin MEASUREMENT Sbx_mf_bgin_clu_cmp "" UBYTE _CNV_A_R_A_165_CM 1 0. 0. 255. DISPLAY_IDENTIFIER fm_sta_eprm_bgin_clu_cmp.fm_static_eprm_bitfield.Sbx_mf_xxx ECU_ADDRESS 0xc00004ee BIT_MASK 0x20 /end MEASUREMENT
/begin MEASUREMENT Sbx_cf_bgin_clu_cmp "" UBYTE _CNV_A_R_A_165_CM 1 0. 0. 255. DISPLAY_IDENTIFIER fm_sta_eprm_bgin_clu_cmp.fm_static_eprm_bitfield.Sbx_cf_xxx ECU_ADDRESS 0xc00004ee BIT_MASK 0x80 /end MEASUREMENT
/begin MEASUREMENT Sbx_dyn_bgin_clu_nok "" UBYTE _CNV_A_R_A_165_CM 1 0. 0. 255. DISPLAY_IDENTIFIER fm_sta_eprm_bgin_clu_nok.fm_static_eprm_bitfield.Sbx_dyn_xxx ECU_ADDRESS 0xc00004f0 BIT_MASK 0x8 /end MEASUREMENT
/begin MEASUREMENT Sbx_rdn_bgin_clu_nok "" UBYTE _CNV_A_R_A_165_CM 1 0. 0. 255. DISPLAY_IDENTIFIER fm_sta_eprm_bgin_clu_nok.fm_static_eprm_bitfield.Sbx_rdn_xxx ECU_ADDRESS 0xc00004f0 BIT_MASK 0x10 /end MEASUREMENT
/begin MEASUREMENT Sbx_mf_bgin_clu_nok "" UBYTE _CNV_A_R_A_165_CM 1 0. 0. 255. DISPLAY_IDENTIFIER fm_sta_eprm_bgin_clu_nok.fm_static_eprm_bitfield.Sbx_mf_xxx ECU_ADDRESS 0xc00004f0 BIT_MASK 0x20 /end MEASUREMENT
/begin MEASUREMENT Sbx_cf_bgin_clu_nok "" UBYTE _CNV_A_R_A_165_CM 1 0. 0. 255. DISPLAY_IDENTIFIER fm_sta_eprm_bgin_clu_nok.fm_static_eprm_bitfield.Sbx_cf_xxx ECU_ADDRESS 0xc00004f0 BIT_MASK 0x80 /end MEASUREMENT
/begin MEASUREMENT Sbx_dyn_brk_pdl_cmp "" UBYTE _CNV_A_R_A_165_CM 1 0. 0. 255. DISPLAY_IDENTIFIER fm_sta_eprm_brk_pdl_cmp.fm_static_eprm_bitfield.Sbx_dyn_xxx ECU_ADDRESS 0xc00004f2 BIT_MASK 0x8 /end MEASUREMENT
/begin MEASUREMENT Sbx_rdn_brk_pdl_cmp "" UBYTE _CNV_A_R_A_165_CM 1 0. 0. 255. DISPLAY_IDENTIFIER fm_sta_eprm_brk_pdl_cmp.fm_static_eprm_bitfield.Sbx_rdn_xxx ECU_ADDRESS 0xc00004f2 BIT_MASK 0x10 /end MEASUREMENT
/begin MEASUREMENT Sbx_mf_brk_pdl_cmp "" UBYTE _CNV_A_R_A_165_CM 1 0. 0. 255. DISPLAY_IDENTIFIER fm_sta_eprm_brk_pdl_cmp.fm_static_eprm_bitfield.Sbx_mf_xxx ECU_ADDRESS 0xc00004f2 BIT_MASK 0x20 /end MEASUREMENT
/begin MEASUREMENT Sbx_cf_brk_pdl_cmp "" UBYTE _CNV_A_R_A_165_CM 1 0. 0. 255. DISPLAY_IDENTIFIER fm_sta_eprm_brk_pdl_cmp.fm_static_eprm_bitfield.Sbx_cf_xxx ECU_ADDRESS 0xc00004f2 BIT_MASK 0x80 /end MEASUREMENT
/begin MEASUREMENT Sbx_dyn_cata_cpt "" UBYTE _CNV_A_R_A_165_CM 1 0. 0. 255. DISPLAY_IDENTIFIER fm_sta_eprm_cata_cpt.fm_static_eprm_bitfield.Sbx_dyn_xxx ECU_ADDRESS 0xc00004f4 BIT_MASK 0x8 /end MEASUREMENT
/begin MEASUREMENT Sbx_rdn_cata_cpt "" UBYTE _CNV_A_R_A_165_CM 1 0. 0. 255. DISPLAY_IDENTIFIER fm_sta_eprm_cata_cpt.fm_static_eprm_bitfield.Sbx_rdn_xxx ECU_ADDRESS 0xc00004f4 BIT_MASK 0x10 /end MEASUREMENT
/begin MEASUREMENT Sbx_mf_cata_cpt "" UBYTE _CNV_A_R_A_165_CM 1 0. 0. 255. DISPLAY_IDENTIFIER fm_sta_eprm_cata_cpt.fm_static_eprm_bitfield.Sbx_mf_xxx ECU_ADDRESS 0xc00004f4 BIT_MASK 0x20 /end MEASUREMENT
/begin MEASUREMENT Sbx_cf_cata_cpt "" UBYTE _CNV_A_R_A_165_CM 1 0. 0. 255. DISPLAY_IDENTIFIER fm_sta_eprm_cata_cpt.fm_static_eprm_bitfield.Sbx_cf_xxx ECU_ADDRESS 0xc00004f4 BIT_MASK 0x80 /end MEASUREMENT
/begin MEASUREMENT Sbx_dyn_cl_rich_chr "" UBYTE _CNV_A_R_A_165_CM 1 0. 0. 255. DISPLAY_IDENTIFIER fm_sta_eprm_cl_rich_chr.fm_static_eprm_bitfield.Sbx_dyn_xxx ECU_ADDRESS 0xc000058a BIT_MASK 0x8 /end MEASUREMENT
/begin MEASUREMENT Sbx_rdn_cl_rich_chr "" UBYTE _CNV_A_R_A_165_CM 1 0. 0. 255. DISPLAY_IDENTIFIER fm_sta_eprm_cl_rich_chr.fm_static_eprm_bitfield.Sbx_rdn_xxx ECU_ADDRESS 0xc000058a BIT_MASK 0x10 /end MEASUREMENT
/begin MEASUREMENT Sbx_mf_cl_rich_chr "" UBYTE _CNV_A_R_A_165_CM 1 0. 0. 255. DISPLAY_IDENTIFIER fm_sta_eprm_cl_rich_chr.fm_static_eprm_bitfield.Sbx_mf_xxx ECU_ADDRESS 0xc000058a BIT_MASK 0x20 /end MEASUREMENT
/begin MEASUREMENT Sbx_cf_cl_rich_chr "" UBYTE _CNV_A_R_A_165_CM 1 0. 0. 255. DISPLAY_IDENTIFIER fm_sta_eprm_cl_rich_chr.fm_static_eprm_bitfield.Sbx_cf_xxx ECU_ADDRESS 0xc000058a BIT_MASK 0x80 /end MEASUREMENT
/begin MEASUREMENT Sbx_dyn_clu_cnt_nok "" UBYTE _CNV_A_R_A_165_CM 1 0. 0. 255. DISPLAY_IDENTIFIER fm_sta_eprm_clu_cnt_nok.fm_static_eprm_bitfield.Sbx_dyn_xxx ECU_ADDRESS 0xc000046a BIT_MASK 0x8 /end MEASUREMENT
/begin MEASUREMENT Sbx_rdn_clu_cnt_nok "" UBYTE _CNV_A_R_A_165_CM 1 0. 0. 255. DISPLAY_IDENTIFIER fm_sta_eprm_clu_cnt_nok.fm_static_eprm_bitfield.Sbx_rdn_xxx ECU_ADDRESS 0xc000046a BIT_MASK 0x10 /end MEASUREMENT
/begin MEASUREMENT Sbx_mf_clu_cnt_nok "" UBYTE _CNV_A_R_A_165_CM 1 0. 0. 255. DISPLAY_IDENTIFIER fm_sta_eprm_clu_cnt_nok.fm_static_eprm_bitfield.Sbx_mf_xxx ECU_ADDRESS 0xc000046a BIT_MASK 0x20 /end MEASUREMENT
/begin MEASUREMENT Sbx_cf_clu_cnt_nok "" UBYTE _CNV_A_R_A_165_CM 1 0. 0. 255. DISPLAY_IDENTIFIER fm_sta_eprm_clu_cnt_nok.fm_static_eprm_bitfield.Sbx_cf_xxx ECU_ADDRESS 0xc000046a BIT_MASK 0x80 /end MEASUREMENT
/begin MEASUREMENT Sbx_dyn_cp_oc "" UBYTE _CNV_A_R_A_165_CM 1 0. 0. 255. DISPLAY_IDENTIFIER fm_sta_eprm_cp_oc.fm_static_eprm_bitfield.Sbx_dyn_xxx ECU_ADDRESS 0xc00004e4 BIT_MASK 0x8 /end MEASUREMENT
/begin MEASUREMENT Sbx_rdn_cp_oc "" UBYTE _CNV_A_R_A_165_CM 1 0. 0. 255. DISPLAY_IDENTIFIER fm_sta_eprm_cp_oc.fm_static_eprm_bitfield.Sbx_rdn_xxx ECU_ADDRESS 0xc00004e4 BIT_MASK 0x10 /end MEASUREMENT
/begin MEASUREMENT Sbx_mf_cp_oc "" UBYTE _CNV_A_R_A_165_CM 1 0. 0. 255. DISPLAY_IDENTIFIER fm_sta_eprm_cp_oc.fm_static_eprm_bitfield.Sbx_mf_xxx ECU_ADDRESS 0xc00004e4 BIT_MASK 0x20 /end MEASUREMENT
/begin MEASUREMENT Sbx_cf_cp_oc "" UBYTE _CNV_A_R_A_165_CM 1 0. 0. 255. DISPLAY_IDENTIFIER fm_sta_eprm_cp_oc.fm_static_eprm_bitfield.Sbx_cf_xxx ECU_ADDRESS 0xc00004e4 BIT_MASK 0x80 /end MEASUREMENT
/begin MEASUREMENT Sbx_dyn_cp_scg "" UBYTE _CNV_A_R_A_165_CM 1 0. 0. 255. DISPLAY_IDENTIFIER fm_sta_eprm_cp_scg.fm_static_eprm_bitfield.Sbx_dyn_xxx ECU_ADDRESS 0xc00004e6 BIT_MASK 0x8 /end MEASUREMENT
/begin MEASUREMENT Sbx_rdn_cp_scg "" UBYTE _CNV_A_R_A_165_CM 1 0. 0. 255. DISPLAY_IDENTIFIER fm_sta_eprm_cp_scg.fm_static_eprm_bitfield.Sbx_rdn_xxx ECU_ADDRESS 0xc00004e6 BIT_MASK 0x10 /end MEASUREMENT
/begin MEASUREMENT Sbx_mf_cp_scg "" UBYTE _CNV_A_R_A_165_CM 1 0. 0. 255. DISPLAY_IDENTIFIER fm_sta_eprm_cp_scg.fm_static_eprm_bitfield.Sbx_mf_xxx ECU_ADDRESS 0xc00004e6 BIT_MASK 0x20 /end MEASUREMENT
/begin MEASUREMENT Sbx_cf_cp_scg "" UBYTE _CNV_A_R_A_165_CM 1 0. 0. 255. DISPLAY_IDENTIFIER fm_sta_eprm_cp_scg.fm_static_eprm_bitfield.Sbx_cf_xxx ECU_ADDRESS 0xc00004e6 BIT_MASK 0x80 /end MEASUREMENT
/begin MEASUREMENT Sbx_dyn_cp_scw "" UBYTE _CNV_A_R_A_165_CM 1 0. 0. 255. DISPLAY_IDENTIFIER fm_sta_eprm_cp_scw.fm_static_eprm_bitfield.Sbx_dyn_xxx ECU_ADDRESS 0xc00004e8 BIT_MASK 0x8 /end MEASUREMENT
/begin MEASUREMENT Sbx_rdn_cp_scw "" UBYTE _CNV_A_R_A_165_CM 1 0. 0. 255. DISPLAY_IDENTIFIER fm_sta_eprm_cp_scw.fm_static_eprm_bitfield.Sbx_rdn_xxx ECU_ADDRESS 0xc00004e8 BIT_MASK 0x10 /end MEASUREMENT
/begin MEASUREMENT Sbx_mf_cp_scw "" UBYTE _CNV_A_R_A_165_CM 1 0. 0. 255. DISPLAY_IDENTIFIER fm_sta_eprm_cp_scw.fm_static_eprm_bitfield.Sbx_mf_xxx ECU_ADDRESS 0xc00004e8 BIT_MASK 0x20 /end MEASUREMENT
/begin MEASUREMENT Sbx_cf_cp_scw "" UBYTE _CNV_A_R_A_165_CM 1 0. 0. 255. DISPLAY_IDENTIFIER fm_sta_eprm_cp_scw.fm_static_eprm_bitfield.Sbx_cf_xxx ECU_ADDRESS 0xc00004e8 BIT_MASK 0x80 /end MEASUREMENT
/begin MEASUREMENT Sbx_dyn_crk_chr "" UBYTE _CNV_A_R_A_165_CM 1 0. 0. 255. DISPLAY_IDENTIFIER fm_sta_eprm_crk_chr.fm_static_eprm_bitfield.Sbx_dyn_xxx ECU_ADDRESS 0xc000055c BIT_MASK 0x8 /end MEASUREMENT
/begin MEASUREMENT Sbx_rdn_crk_chr "" UBYTE _CNV_A_R_A_165_CM 1 0. 0. 255. DISPLAY_IDENTIFIER fm_sta_eprm_crk_chr.fm_static_eprm_bitfield.Sbx_rdn_xxx ECU_ADDRESS 0xc000055c BIT_MASK 0x10 /end MEASUREMENT
/begin MEASUREMENT Sbx_mf_crk_chr "" UBYTE _CNV_A_R_A_165_CM 1 0. 0. 255. DISPLAY_IDENTIFIER fm_sta_eprm_crk_chr.fm_static_eprm_bitfield.Sbx_mf_xxx ECU_ADDRESS 0xc000055c BIT_MASK 0x20 /end MEASUREMENT
/begin MEASUREMENT Sbx_cf_crk_chr "" UBYTE _CNV_A_R_A_165_CM 1 0. 0. 255. DISPLAY_IDENTIFIER fm_sta_eprm_crk_chr.fm_static_eprm_bitfield.Sbx_cf_xxx ECU_ADDRESS 0xc000055c BIT_MASK 0x80 /end MEASUREMENT
/begin MEASUREMENT Sbx_dyn_crk_cmp "" UBYTE _CNV_A_R_A_165_CM 1 0. 0. 255. DISPLAY_IDENTIFIER fm_sta_eprm_crk_cmp.fm_static_eprm_bitfield.Sbx_dyn_xxx ECU_ADDRESS 0xc0000584 BIT_MASK 0x8 /end MEASUREMENT
/begin MEASUREMENT Sbx_rdn_crk_cmp "" UBYTE _CNV_A_R_A_165_CM 1 0. 0. 255. DISPLAY_IDENTIFIER fm_sta_eprm_crk_cmp.fm_static_eprm_bitfield.Sbx_rdn_xxx ECU_ADDRESS 0xc0000584 BIT_MASK 0x10 /end MEASUREMENT
/begin MEASUREMENT Sbx_mf_crk_cmp "" UBYTE _CNV_A_R_A_165_CM 1 0. 0. 255. DISPLAY_IDENTIFIER fm_sta_eprm_crk_cmp.fm_static_eprm_bitfield.Sbx_mf_xxx ECU_ADDRESS 0xc0000584 BIT_MASK 0x20 /end MEASUREMENT
/begin MEASUREMENT Sbx_cf_crk_cmp "" UBYTE _CNV_A_R_A_165_CM 1 0. 0. 255. DISPLAY_IDENTIFIER fm_sta_eprm_crk_cmp.fm_static_eprm_bitfield.Sbx_cf_xxx ECU_ADDRESS 0xc0000584 BIT_MASK 0x80 /end MEASUREMENT
/begin MEASUREMENT Sbx_dyn_crk_cyc "" UBYTE _CNV_A_R_A_165_CM 1 0. 0. 255. DISPLAY_IDENTIFIER fm_sta_eprm_crk_cyc.fm_static_eprm_bitfield.Sbx_dyn_xxx ECU_ADDRESS 0xc000055e BIT_MASK 0x8 /end MEASUREMENT
/begin MEASUREMENT Sbx_rdn_crk_cyc "" UBYTE _CNV_A_R_A_165_CM 1 0. 0. 255. DISPLAY_IDENTIFIER fm_sta_eprm_crk_cyc.fm_static_eprm_bitfield.Sbx_rdn_xxx ECU_ADDRESS 0xc000055e BIT_MASK 0x10 /end MEASUREMENT
/begin MEASUREMENT Sbx_mf_crk_cyc "" UBYTE _CNV_A_R_A_165_CM 1 0. 0. 255. DISPLAY_IDENTIFIER fm_sta_eprm_crk_cyc.fm_static_eprm_bitfield.Sbx_mf_xxx ECU_ADDRESS 0xc000055e BIT_MASK 0x20 /end MEASUREMENT
/begin MEASUREMENT Sbx_cf_crk_cyc "" UBYTE _CNV_A_R_A_165_CM 1 0. 0. 255. DISPLAY_IDENTIFIER fm_sta_eprm_crk_cyc.fm_static_eprm_bitfield.Sbx_cf_xxx ECU_ADDRESS 0xc000055e BIT_MASK 0x80 /end MEASUREMENT
/begin MEASUREMENT Sbx_dyn_crk_no_sig "" UBYTE _CNV_A_R_A_165_CM 1 0. 0. 255. DISPLAY_IDENTIFIER fm_sta_eprm_crk_no_sig.fm_static_eprm_bitfield.Sbx_dyn_xxx ECU_ADDRESS 0xc0000570 BIT_MASK 0x8 /end MEASUREMENT
/begin MEASUREMENT Sbx_rdn_crk_no_sig "" UBYTE _CNV_A_R_A_165_CM 1 0. 0. 255. DISPLAY_IDENTIFIER fm_sta_eprm_crk_no_sig.fm_static_eprm_bitfield.Sbx_rdn_xxx ECU_ADDRESS 0xc0000570 BIT_MASK 0x10 /end MEASUREMENT
/begin MEASUREMENT Sbx_mf_crk_no_sig "" UBYTE _CNV_A_R_A_165_CM 1 0. 0. 255. DISPLAY_IDENTIFIER fm_sta_eprm_crk_no_sig.fm_static_eprm_bitfield.Sbx_mf_xxx ECU_ADDRESS 0xc0000570 BIT_MASK 0x20 /end MEASUREMENT
/begin MEASUREMENT Sbx_cf_crk_no_sig "" UBYTE _CNV_A_R_A_165_CM 1 0. 0. 255. DISPLAY_IDENTIFIER fm_sta_eprm_crk_no_sig.fm_static_eprm_bitfield.Sbx_cf_xxx ECU_ADDRESS 0xc0000570 BIT_MASK 0x80 /end MEASUREMENT
/begin MEASUREMENT Sbx_dyn_crk_oc "" UBYTE _CNV_A_R_A_165_CM 1 0. 0. 255. DISPLAY_IDENTIFIER fm_sta_eprm_crk_oc.fm_static_eprm_bitfield.Sbx_dyn_xxx ECU_ADDRESS 0xc0000588 BIT_MASK 0x8 /end MEASUREMENT
/begin MEASUREMENT Sbx_rdn_crk_oc "" UBYTE _CNV_A_R_A_165_CM 1 0. 0. 255. DISPLAY_IDENTIFIER fm_sta_eprm_crk_oc.fm_static_eprm_bitfield.Sbx_rdn_xxx ECU_ADDRESS 0xc0000588 BIT_MASK 0x10 /end MEASUREMENT
/begin MEASUREMENT Sbx_mf_crk_oc "" UBYTE _CNV_A_R_A_165_CM 1 0. 0. 255. DISPLAY_IDENTIFIER fm_sta_eprm_crk_oc.fm_static_eprm_bitfield.Sbx_mf_xxx ECU_ADDRESS 0xc0000588 BIT_MASK 0x20 /end MEASUREMENT
/begin MEASUREMENT Sbx_cf_crk_oc "" UBYTE _CNV_A_R_A_165_CM 1 0. 0. 255. DISPLAY_IDENTIFIER fm_sta_eprm_crk_oc.fm_static_eprm_bitfield.Sbx_cf_xxx ECU_ADDRESS 0xc0000588 BIT_MASK 0x80 /end MEASUREMENT
/begin MEASUREMENT Sbx_dyn_crk_shp "" UBYTE _CNV_A_R_A_165_CM 1 0. 0. 255. DISPLAY_IDENTIFIER fm_sta_eprm_crk_shp.fm_static_eprm_bitfield.Sbx_dyn_xxx ECU_ADDRESS 0xc0000586 BIT_MASK 0x8 /end MEASUREMENT
/begin MEASUREMENT Sbx_rdn_crk_shp "" UBYTE _CNV_A_R_A_165_CM 1 0. 0. 255. DISPLAY_IDENTIFIER fm_sta_eprm_crk_shp.fm_static_eprm_bitfield.Sbx_rdn_xxx ECU_ADDRESS 0xc0000586 BIT_MASK 0x10 /end MEASUREMENT
/begin MEASUREMENT Sbx_mf_crk_shp "" UBYTE _CNV_A_R_A_165_CM 1 0. 0. 255. DISPLAY_IDENTIFIER fm_sta_eprm_crk_shp.fm_static_eprm_bitfield.Sbx_mf_xxx ECU_ADDRESS 0xc0000586 BIT_MASK 0x20 /end MEASUREMENT
/begin MEASUREMENT Sbx_cf_crk_shp "" UBYTE _CNV_A_R_A_165_CM 1 0. 0. 255. DISPLAY_IDENTIFIER fm_sta_eprm_crk_shp.fm_static_eprm_bitfield.Sbx_cf_xxx ECU_ADDRESS 0xc0000586 BIT_MASK 0x80 /end MEASUREMENT
/begin MEASUREMENT Sbx_dyn_cru_cmp "" UBYTE _CNV_A_R_A_165_CM 1 0. 0. 255. DISPLAY_IDENTIFIER fm_sta_eprm_cru_cmp.fm_static_eprm_bitfield.Sbx_dyn_xxx ECU_ADDRESS 0xc00004f6 BIT_MASK 0x8 /end MEASUREMENT
/begin MEASUREMENT Sbx_rdn_cru_cmp "" UBYTE _CNV_A_R_A_165_CM 1 0. 0. 255. DISPLAY_IDENTIFIER fm_sta_eprm_cru_cmp.fm_static_eprm_bitfield.Sbx_rdn_xxx ECU_ADDRESS 0xc00004f6 BIT_MASK 0x10 /end MEASUREMENT
/begin MEASUREMENT Sbx_mf_cru_cmp "" UBYTE _CNV_A_R_A_165_CM 1 0. 0. 255. DISPLAY_IDENTIFIER fm_sta_eprm_cru_cmp.fm_static_eprm_bitfield.Sbx_mf_xxx ECU_ADDRESS 0xc00004f6 BIT_MASK 0x20 /end MEASUREMENT
/begin MEASUREMENT Sbx_cf_cru_cmp "" UBYTE _CNV_A_R_A_165_CM 1 0. 0. 255. DISPLAY_IDENTIFIER fm_sta_eprm_cru_cmp.fm_static_eprm_bitfield.Sbx_cf_xxx ECU_ADDRESS 0xc00004f6 BIT_MASK 0x80 /end MEASUREMENT
/begin MEASUREMENT Sbx_dyn_cru_sl_swi_chr "" UBYTE _CNV_A_R_A_165_CM 1 0. 0. 255. DISPLAY_IDENTIFIER fm_sta_eprm_cru_sl_swi_chr.fm_static_eprm_bitfield.Sbx_dyn_xxx ECU_ADDRESS 0xc00004f8 BIT_MASK 0x8 /end MEASUREMENT
/begin MEASUREMENT Sbx_rdn_cru_sl_swi_chr "" UBYTE _CNV_A_R_A_165_CM 1 0. 0. 255. DISPLAY_IDENTIFIER fm_sta_eprm_cru_sl_swi_chr.fm_static_eprm_bitfield.Sbx_rdn_xxx ECU_ADDRESS 0xc00004f8 BIT_MASK 0x10 /end MEASUREMENT
/begin MEASUREMENT Sbx_mf_cru_sl_swi_chr "" UBYTE _CNV_A_R_A_165_CM 1 0. 0. 255. DISPLAY_IDENTIFIER fm_sta_eprm_cru_sl_swi_chr.fm_static_eprm_bitfield.Sbx_mf_xxx ECU_ADDRESS 0xc00004f8 BIT_MASK 0x20 /end MEASUREMENT
/begin MEASUREMENT Sbx_cf_cru_sl_swi_chr "" UBYTE _CNV_A_R_A_165_CM 1 0. 0. 255. DISPLAY_IDENTIFIER fm_sta_eprm_cru_sl_swi_chr.fm_static_eprm_bitfield.Sbx_cf_xxx ECU_ADDRESS 0xc00004f8 BIT_MASK 0x80 /end MEASUREMENT
/begin MEASUREMENT Sbx_dyn_cru_sl_tot "" UBYTE _CNV_A_R_A_165_CM 1 0. 0. 255. DISPLAY_IDENTIFIER fm_sta_eprm_cru_sl_tot.fm_static_eprm_bitfield.Sbx_dyn_xxx ECU_ADDRESS 0xc00004fa BIT_MASK 0x8 /end MEASUREMENT
/begin MEASUREMENT Sbx_rdn_cru_sl_tot "" UBYTE _CNV_A_R_A_165_CM 1 0. 0. 255. DISPLAY_IDENTIFIER fm_sta_eprm_cru_sl_tot.fm_static_eprm_bitfield.Sbx_rdn_xxx ECU_ADDRESS 0xc00004fa BIT_MASK 0x10 /end MEASUREMENT
/begin MEASUREMENT Sbx_mf_cru_sl_tot "" UBYTE _CNV_A_R_A_165_CM 1 0. 0. 255. DISPLAY_IDENTIFIER fm_sta_eprm_cru_sl_tot.fm_static_eprm_bitfield.Sbx_mf_xxx ECU_ADDRESS 0xc00004fa BIT_MASK 0x20 /end MEASUREMENT
/begin MEASUREMENT Sbx_cf_cru_sl_tot "" UBYTE _CNV_A_R_A_165_CM 1 0. 0. 255. DISPLAY_IDENTIFIER fm_sta_eprm_cru_sl_tot.fm_static_eprm_bitfield.Sbx_cf_xxx ECU_ADDRESS 0xc00004fa BIT_MASK 0x80 /end MEASUREMENT
/begin MEASUREMENT Sbx_dyn_cru_vs_cmp "" UBYTE _CNV_A_R_A_165_CM 1 0. 0. 255. DISPLAY_IDENTIFIER fm_sta_eprm_cru_vs_cmp.fm_static_eprm_bitfield.Sbx_dyn_xxx ECU_ADDRESS 0xc00004fc BIT_MASK 0x8 /end MEASUREMENT
/begin MEASUREMENT Sbx_rdn_cru_vs_cmp "" UBYTE _CNV_A_R_A_165_CM 1 0. 0. 255. DISPLAY_IDENTIFIER fm_sta_eprm_cru_vs_cmp.fm_static_eprm_bitfield.Sbx_rdn_xxx ECU_ADDRESS 0xc00004fc BIT_MASK 0x10 /end MEASUREMENT
/begin MEASUREMENT Sbx_mf_cru_vs_cmp "" UBYTE _CNV_A_R_A_165_CM 1 0. 0. 255. DISPLAY_IDENTIFIER fm_sta_eprm_cru_vs_cmp.fm_static_eprm_bitfield.Sbx_mf_xxx ECU_ADDRESS 0xc00004fc BIT_MASK 0x20 /end MEASUREMENT
/begin MEASUREMENT Sbx_cf_cru_vs_cmp "" UBYTE _CNV_A_R_A_165_CM 1 0. 0. 255. DISPLAY_IDENTIFIER fm_sta_eprm_cru_vs_cmp.fm_static_eprm_bitfield.Sbx_cf_xxx ECU_ADDRESS 0xc00004fc BIT_MASK 0x80 /end MEASUREMENT
/begin MEASUREMENT Sbx_dyn_cru_whl_cmd_nok "" UBYTE _CNV_A_R_A_165_CM 1 0. 0. 255. DISPLAY_IDENTIFIER fm_sta_eprm_cru_whl_cmd_nok.fm_static_eprm_bitfield.Sbx_dyn_xxx ECU_ADDRESS 0xc00004fe BIT_MASK 0x8 /end MEASUREMENT
/begin MEASUREMENT Sbx_rdn_cru_whl_cmd_nok "" UBYTE _CNV_A_R_A_165_CM 1 0. 0. 255. DISPLAY_IDENTIFIER fm_sta_eprm_cru_whl_cmd_nok.fm_static_eprm_bitfield.Sbx_rdn_xxx ECU_ADDRESS 0xc00004fe BIT_MASK 0x10 /end MEASUREMENT
/begin MEASUREMENT Sbx_mf_cru_whl_cmd_nok "" UBYTE _CNV_A_R_A_165_CM 1 0. 0. 255. DISPLAY_IDENTIFIER fm_sta_eprm_cru_whl_cmd_nok.fm_static_eprm_bitfield.Sbx_mf_xxx ECU_ADDRESS 0xc00004fe BIT_MASK 0x20 /end MEASUREMENT
/begin MEASUREMENT Sbx_cf_cru_whl_cmd_nok "" UBYTE _CNV_A_R_A_165_CM 1 0. 0. 255. DISPLAY_IDENTIFIER fm_sta_eprm_cru_whl_cmd_nok.fm_static_eprm_bitfield.Sbx_cf_xxx ECU_ADDRESS 0xc00004fe BIT_MASK 0x80 /end MEASUREMENT
/begin MEASUREMENT Sbx_dyn_cru_whl_cmd_oc_scw "" UBYTE _CNV_A_R_A_165_CM 1 0. 0. 255. DISPLAY_IDENTIFIER fm_sta_eprm_cru_whl_cmd_oc_scw.fm_static_eprm_bitfield.Sbx_dyn_xxx ECU_ADDRESS 0xc0000500 BIT_MASK 0x8 /end MEASUREMENT
/begin MEASUREMENT Sbx_rdn_cru_whl_cmd_oc_scw "" UBYTE _CNV_A_R_A_165_CM 1 0. 0. 255. DISPLAY_IDENTIFIER fm_sta_eprm_cru_whl_cmd_oc_scw.fm_static_eprm_bitfield.Sbx_rdn_xxx ECU_ADDRESS 0xc0000500 BIT_MASK 0x10 /end MEASUREMENT
/begin MEASUREMENT Sbx_mf_cru_whl_cmd_oc_scw "" UBYTE _CNV_A_R_A_165_CM 1 0. 0. 255. DISPLAY_IDENTIFIER fm_sta_eprm_cru_whl_cmd_oc_scw.fm_static_eprm_bitfield.Sbx_mf_xxx ECU_ADDRESS 0xc0000500 BIT_MASK 0x20 /end MEASUREMENT
/begin AXIS_PTS Ctb_n "20 programmable engine speed breakpoints map" 0xa00250e0 Vxx_n _REC_A2AXS_20_u2 16383.75 _CNV_A_R_ENSD_LINEA_24_CM 20 0. 16383.75 FORMAT "%8.2" /end AXIS_PTS
/begin AXIS_PTS Ctb_n2 "9 programmable engine speed breakpoints table" 0xa002510c Vxx_n _REC_A2AXS_20_u2 16383.75 _CNV_A_R_ENSD_LINEA_24_CM 9 0. 16383.75 FORMAT "%8.2" /end AXIS_PTS
/begin COMPU_METHOD _CNV_A_R_ECME_LINEA_0_CM "" RAT_FUNC "%6.3" "-" COEFFS 0 1. 0. 0 0 1 /end COMPU_METHOD
/begin COMPU_METHOD _CNV_A_R_LINEAR_____2_CM "" RAT_FUNC "%6.3" "rpm" COEFFS 0 3.125e-002 0. 0 0 1 /end COMPU_METHOD
/begin COMPU_METHOD _CNV_S_2_RANGE______3_CM "" TAB_VERB "%6.3" "-" COMPU_TAB_REF _CNV_S_2_RANGE______3 /end COMPU_METHOD
/begin COMPU_VTAB _CNV_S_2_RANGE______3 "" TAB_VERB 2 0 "0" 1 "1" /end COMPU_VTAB
/begin COMPU_METHOD _CNV_A_R_LINEAR_____4_CM "" RAT_FUNC "%6.3" "s" COEFFS 0 10. 0. 0 0 1 /end COMPU_METHOD
/begin COMPU_METHOD _CNV_A_R_ENSD_LINEA_24_CM "" RAT_FUNC "%6.3" "rpm" COEFFS 0 4. 0. 0 0 1 /end COMPU_METHOD
/begin COMPU_METHOD _CNV_A_R_LINEAR_____31_CM "" RAT_FUNC "%6.3" "-" COEFFS 0 256. 0. 0 0 1 /end COMPU_METHOD
/begin COMPU_METHOD _CNV_A_R_LINEAR_____34_CM "" RAT_FUNC "%6.3" "s" COEFFS 0 100. 0. 0 0 1 /end COMPU_METHOD
/begin COMPU_METHOD _CNV_A_R_LINEAR_____49_CM "" RAT_FUNC "%6.3" "-" COEFFS 0 32767.99999999992 0. 0 0 1 /end COMPU_METHOD
/begin COMPU_METHOD _CNV_A_R_LINEAR_____52_CM "" RAT_FUNC "%6.3" "mV" COEFFS 0 1. 0. 0 0 1 /end COMPU_METHOD
/begin COMPU_METHOD _CNV_A_R_LINEAR_____54_CM "" RAT_FUNC "%6.3" "∞C" COEFFS 0 10. 400. 0 0 1 /end COMPU_METHOD
/begin COMPU_METHOD _CNV_A_R_LINEAR_____55_CM "" RAT_FUNC "%6.3" "TDC" COEFFS 0 1. 0. 0 0 1 /end COMPU_METHOD
/begin COMPU_METHOD _CNV_A_R_LINEAR_____57_CM "" RAT_FUNC "%6.3" "hPa" COEFFS 0 1. 0. 0 0 1 /end COMPU_METHOD
/begin COMPU_METHOD _CNV_A_R_LINEAR_____58_CM "" RAT_FUNC "%6.3" "s" COEFFS 0 1000. 0. 0 0 1 /end COMPU_METHOD
/begin COMPU_METHOD _CNV_A_R_LINEAR_____94_CM "" RAT_FUNC "%6.3" "%" COEFFS 0 100. 0. 0 0 1 /end COMPU_METHOD
/begin COMPU_METHOD _CNV_A_R_LINEAR_____95_CM "" RAT_FUNC "%6.3" "m≤" COEFFS 0 16777217.69806384 0. 0 0 1 /end COMPU_METHOD
/begin COMPU_METHOD _CNV_A_R_LINEAR_____99_CM "" RAT_FUNC "%6.3" "%" COEFFS 0 20. 0. 0 0 1 /end COMPU_METHOD
/begin COMPU_METHOD _CNV_A_R_LINEAR_____109_CM "" RAT_FUNC "%6.3" "kg/h" COEFFS 0 20. 0. 0 0 1 /end COMPU_METHOD
/begin COMPU_METHOD _CNV_A_R_LINEAR_____114_CM "" RAT_FUNC "%6.3" "%" COEFFS 0 2.55 0. 0 0 1 /end COMPU_METHOD
/begin COMPU_METHOD _CNV_S_3_STATUS_OK__120_CM "" TAB_VERB "%6.3" "-" COMPU_TAB_REF _CNV_S_3_STATUS_OK__120 /end COMPU_METHOD
/begin COMPU_VTAB _CNV_S_3_STATUS_OK__120 "" TAB_VERB 3 0 "Nsx_vld_nok_0" 1 "Nsx_vld_ok_1" 2 "Nsx_vld_fail_2" /end COMPU_VTAB
/begin COMPU_METHOD _CNV_A_R_LINEAR_____123_CM "" RAT_FUNC "%6.3" "Nm" COEFFS 0 32. 0. 0 0 1 /end COMPU_METHOD
/begin COMPU_METHOD _CNV_A_R_LINEAR_____144_CM "" RAT_FUNC "%6.3" "ms" COEFFS 0 1. 0. 0 0 1 /end COMPU_METHOD
/begin COMPU_METHOD _CNV_A_R_LINEAR_____150_CM "" RAT_FUNC "%6.3" "V" COEFFS 0 100. 0. 0 0 1 /end COMPU_METHOD
/begin COMPU_METHOD _CNV_S_3_STATUS_OK__158_CM "" TAB_VERB "%6.3" "" COMPU_TAB_REF _CNV_S_3_STATUS_OK__158 /end COMPU_METHOD
/begin COMPU_VTAB _CNV_S_3_STATUS_OK__158 "" TAB_VERB 3 0 "Nsx_vld_nok_0" 1 "Nsx_vld_ok_1" 2 "Nsx_vld_fail_2" /end COMPU_VTAB
/begin COMPU_METHOD _CNV_A_R_LINEAR_____161_CM "" RAT_FUNC "%6.3" "Nm" COEFFS 0 32. 12800. 0 0 1 /end COMPU_METHOD
/begin COMPU_METHOD _CNV_A_R_A_165_CM "" RAT_FUNC "%6.3" "" COEFFS 0 1. 0. 0 0 1 /end COMPU_METHOD
/begin COMPU_METHOD _CNV_S_2_STATUS_OK__188_CM "" TAB_VERB "%6.3" "" COMPU_TAB_REF _CNV_S_2_STATUS_OK__188 /end COMPU_METHOD
/begin COMPU_VTAB _CNV_S_2_STATUS_OK__188 "" TAB_VERB 2 0 "Nsx_vld_nok_0" 1 "Nsx_vld_ok_1" /end COMPU_VTAB
/begin COMPU_METHOD _CNV_A_R_LINEAR_____193_CM "" RAT_FUNC "%6.3" "hpa/(kg/h)≤" COEFFS 0 1638400.395206126 0. 0 0 1 /end COMPU_METHOD
/begin COMPU_METHOD _CNV_A_R_LINEAR_____197_CM "" RAT_FUNC "%6.3" "hPa" COEFFS 0 32. 0. 0 0 1 /end COMPU_METHOD
/begin COMPU_METHOD _CNV_A_R_LINEAR_____198_CM "" RAT_FUNC "%6.3" "hPa" COEFFS 0 256. 0. 0 0 1 /end COMPU_METHOD
/begin COMPU_METHOD _CNV_A_R_LINEAR_____199_CM "" RAT_FUNC "%6.3" "m/(s^2*K^1/2)" COEFFS 0 4. 0. 0 0 1 /end COMPU_METHOD
/begin COMPU_METHOD _CNV_A_R_LINEAR_____200_CM "" RAT_FUNC "%6.3" "(s^2*K^1/2)/m" COEFFS 0 65536.00007936121 0. 0 0 1 /end COMPU_METHOD
/begin COMPU_METHOD _CNV_A_R_LINEAR_____201_CM "" RAT_FUNC "%6.3" "(s^2*K^1/2)/m" COEFFS 0 65535.99999999996 65535. 0 0 1 /end COMPU_METHOD
/begin COMPU_METHOD _CNV_A_R_LINEAR_____202_CM "" RAT_FUNC "%6.3" "-" COEFFS 0 65536.00007936121 0. 0 0 1 /end COMPU_METHOD
/begin COMPU_METHOD _CNV_A_R_LINEAR_____203_CM "" RAT_FUNC "%6.3" "tr/(min*m*K*s^2)" COEFFS 0 1.63839999999998e-003 -8191.999999999898 0 0 1 /end COMPU_METHOD
/begin COMPU_METHOD _CNV_A_R_LINEAR_____204_CM "" RAT_FUNC "%6.3" "1/rpm" COEFFS 0 0.1092266666715023 0. 0 0 1 /end COMPU_METHOD
/begin COMPU_METHOD _CNV_A_R_LINEAR_____205_CM "" RAT_FUNC "%6.3" "Nm" COEFFS 0 128.0005468856814 0. 0 0 1 /end COMPU_METHOD
/begin COMPU_METHOD _CNV_A_R_LINEAR_____206_CM "" RAT_FUNC "%6.3" "-" COEFFS 0 131072.0001587224 0. 0 0 1 /end COMPU_METHOD
/begin COMPU_METHOD _CNV_A_R_LINEAR_____207_CM "" RAT_FUNC "%6.3" "m/(s^2*K^1/2)" COEFFS 0 16. 0. 0 0 1 /end COMPU_METHOD
/begin COMPU_METHOD _CNV_A_R_LINEAR_____208_CM "" RAT_FUNC "%6.3" "(s^2*K^1/2)/m" COEFFS 0 1048576. 0. 0 0 1 /end COMPU_METHOD
/begin COMPU_METHOD _CNV_A_R_LINEAR_____209_CM "" RAT_FUNC "%6.3" "-" COEFFS 0 10000. 0. 0 0 1 /end COMPU_METHOD
/begin COMPU_METHOD _CNV_A_R_LINEAR_____210_CM "" RAT_FUNC "%6.3" "-" COEFFS 0 1023. 0. 0 0 1 /end COMPU_METHOD
/begin COMPU_METHOD _CNV_A_R_LINEAR_____211_CM "" RAT_FUNC "%6.3" "%" COEFFS 0 800. 0. 0 0 1 /end COMPU_METHOD
/begin COMPU_METHOD _CNV_A_R_LINEAR_____212_CM "" RAT_FUNC "%6.3" "km/h" COEFFS 0 1. 0. 0 0 1 /end COMPU_METHOD
/begin COMPU_METHOD _CNV_A_R_LINEAR_____213_CM "" RAT_FUNC "%6.3" "%/s" COEFFS 0 1023. 0. 0 0 1 /end COMPU_METHOD
/begin COMPU_METHOD _CNV_S_2_STATUS_OK__214_CM "" TAB_VERB "%6.3" "-" COMPU_TAB_REF _CNV_S_2_STATUS_OK__214 /end COMPU_METHOD
/begin COMPU_VTAB _CNV_S_2_STATUS_OK__214 "" TAB_VERB 2 0 "Nsx_vld_nok_0" 1 "Nsx_vld_ok_1" /end COMPU_VTAB
/begin COMPU_METHOD _CNV_S_2_RANGE______217_CM "" TAB_VERB "%6.3" "-" COMPU_TAB_REF _CNV_S_2_RANGE______217 /end COMPU_METHOD
/begin COMPU_VTAB _CNV_S_2_RANGE______217 "" TAB_VERB 2 0 "COMPLETE" 1 "NO_COMPLETE" /end COMPU_VTAB
/begin RECORD_LAYOUT _REC_S1VAL_20_u1 FNC_VALUES 1 UBYTE COLUMN_DIR DIRECT /end RECORD_LAYOUT
/begin RECORD_LAYOUT _REC_S1VAL_20_u2 FNC_VALUES 1 UWORD COLUMN_DIR DIRECT /end RECORD_LAYOUT
/begin RECORD_LAYOUT _REC_A2AXS_20_u2 NO_AXIS_PTS_X 1 UWORD AXIS_PTS_X 2 UWORD INDEX_INCR DIRECT /end RECORD_LAYOUT
/begin RECORD_LAYOUT _REC_A1MAP_20_u2_u2_u2 FNC_VALUES 1 UWORD COLUMN_DIR DIRECT /end RECORD_LAYOUT
/begin RECORD_LAYOUT _REC_A1CUR_20_u2_u2 FNC_VALUES 1 UWORD COLUMN_DIR DIRECT /end RECORD_LAYOUT
/begin FUNCTION InAsiIap_Spgxxcs ""
 /begin DEF_CHARACTERISTIC Ctb_amp Ctb_esti_tqe Ctb_n_spg_dft_mdl Ntb_spg_l_hys Ntb_spg_mat_cor Ntb_spg_up_hys Cmp_spg_amp_cor Cmp_tq_n_spg_fail_thd Ctp_n_amp_spg_dif_cut Ctp_n_spg_dft_mdl Ctp_spg_l_hys Ctp_spg_mat_cor Ctp_spg_up_hys Cbx_spg_sens_cfm Cxx_act_is_dly Cxx_amp_cge_n_thd Cxx_amp_inj_cut_dly Cxx_amp_spg_dif_fac Cxx_dfdec_spg_chr Cxx_dfdec_spg_oor Cxx_dfinc_spg_chr Cxx_dfinc_spg_oor Cxx_esti_tqe_fil_ftc Cxx_fil_it_psn_dif_thd Cxx_it_psn_cge_fil_ftc Cxx_it_psn_dif_thd Cxx_max_amp Cxx_min_amp Cxx_spg_chr_diag_dly Cxx_spg_diag_dsb Cxx_spg_diag_max_mat Cxx_spg_diag_min_mat Cxx_spg_fail_l_thd Cxx_spg_fail_up_thd Cxx_spg_fail_val Cxx_spg_min Cxx_spg_n_thd Cxx_stab_spg_dif_thd Cxx_tq_stab_thd /end DEF_CHARACTERISTIC
 /begin OUT_MEASUREMENT Vbx_amp_spg_dif_upd Vbx_df_spg_chr Vbx_df_spg_oor Vbx_diag_ena_spg_chr Vbx_diag_ena_spg_chr_cdn Vbx_diag_ena_spg_oor Vbx_inj_cut_cdn Vbx_low_eng_load Vbx_spg_gbx_stt Vbx_spg_ini Vsx_spg_vld Vxx_act_is_dly Vxx_amp_inj_cut_dly Vxx_amp_spg_dif Vxx_esti_tqe_fil Vxx_it_psn_dif_fil Vxx_mdl_spg Vxx_spg Vxx_spg_amp_cor Vxx_spg_chr_diag_dly Vxx_spg_fail_thd Vxx_spg_l_hys Vxx_spg_mat_cor Vxx_spg_up_hys /end OUT_MEASUREMENT
/end FUNCTION
/begin FUNCTION InAsiIap_Mapxxsr ""
 /begin DEF_CHARACTERISTIC Cxx_dfdec_sens_map_h Cxx_dfdec_sens_map_l Cxx_dfinc_sens_map_h Cxx_dfinc_sens_map_l /end DEF_CHARACTERISTIC
 /begin OUT_MEASUREMENT Vsx_sens_map_vld Vxx_sens_map /end OUT_MEASUREMENT
/end FUNCTION
/begin FUNCTION InAsiIap_Mapxxcs ""
 /begin DEF_CHARACTERISTIC Ctb_prs Ctb_prs2 Cxx_dfdec_map_chr Cxx_dfdec_map_oor Cxx_dfdec_map_oor_run Cxx_dfinc_map_chr Cxx_dfinc_map_oor Cxx_dfinc_map_oor_run Cxx_dif_sens_esti_map_err Cxx_map_fil_ftc Cxx_min_n_test_acq Cxx_nr_tdc_dif_prs_fail Cxx_rel_it_prs_thd_h_err Cxx_sens_map_max_dif_val Cxx_sens_map_run_eng_h_thd Cxx_sens_map_run_eng_l_thd Cxx_sens_map_stop_eng_h_thd Cxx_sens_map_stop_eng_l_thd /end DEF_CHARACTERISTIC
 /begin OUT_MEASUREMENT Vxb_map.factor Vxb_map.index Vxb_map.num_dp Vxb_map2.factor Vxb_map2.index Vxb_map2.num_dp Vbx_df_map_chr Vbx_df_map_oor Vbx_diag_ena_map_chr Vbx_diag_ena_map_oor Vbx_map_chr_diag_run_dly_rst Vbx_map_chr_diag_run_ena Vbx_map_diag_oor Vsx_map_vld Vxx_map Vxx_map_chr_diag_run_dly Vxx_map_fil /end OUT_MEASUREMENT
/end FUNCTION
/begin FUNCTION InAsiIap_Atmoxxx ""
 /begin DEF_CHARACTERISTIC Ntb_n_amp_map_dif Ntb_n_kd_it_psn_thd Ctp_n_amp_map_dif Ctp_n_kd_it_psn_thd Cxx_amp_dft_val Cxx_amp_eprm_h_thd Cxx_amp_eprm_l_thd Cxx_amp_kd_dly Cxx_amp_map_cge_n_thd Cxx_amp_map_fil_fac Cxx_amp_spg_fil_fac Cxx_max_map_spg_dif Cxx_n_kd_it_psn_hys Cxx_sens_dif_amp_map_thd Cxx_sens_dif_amp_spg_thd Cxx_stal_dly /end DEF_CHARACTERISTIC
 /begin OUT_MEASUREMENT Vbx_amp_ad_kd_it Vbx_amp_eng_run Vbx_amp_eng_stop Vbx_amp_map_fil_ena Vbx_amp_mem_run_eng Vbx_amp_upd Vsx_amp_vld Vxx_amp_map Vxx_fil_amp Vxx_fil_map_spg_dif1 Vxx_raw_amp Vxx_stal_dly /end OUT_MEASUREMENT
/end FUNCTION
/begin FUNCTION InAsiIap_Mapxxmd ""
 /begin DEF_CHARACTERISTIC Ctb_pred_map_prs_rat Ctb_psi_fac_cor Ctd_ofs_psi_fac Ctd_slop_psi_fac Ctp_ftc_mdl_map Ctp_pred_map_prs_rat Cxx_it_ar_max_slop Cxx_last_bkp_prs_rat Cxx_map_mv_ftc Cxx_pred_map_max_prs_rat /end DEF_CHARACTERISTIC
 /begin OUT_MEASUREMENT Vbx_pred_map_psi_fac_cor Vsx_mdl_map_vld Vxx_fil_pred_map_efv_it_ar Vxx_fill_efy_n_mpl Vxx_mdl_map Vxx_mdl_map_fac_1 Vxx_mdl_map_fac_2 Vxx_mdl_map_fil Vxx_mdl_map_spg_rat Vxx_mfld_fil_fac Vxx_min_map_spg_rat Vxx_pred_map_cp_maf_fac Vxx_pred_map_cp_psi_fac Vxx_pred_map_cp_psi_fac_ofs Vxx_pred_map_cp_psi_fac_slop Vxx_pred_map_it_maf_fac Vxx_pred_map_mdl_eng_maf Vxx_pred_map_mdl_it_maf Vxx_pred_map_psi_fac Vxx_pred_map_psi_fac_ofs Vxx_pred_map_psi_fac_slop Vxx_raw_mdl_map Vxx_raw_mdl_map_spg_rat Vxx_spg_amp_rat Vxx_temp0[0] Vxx_temp0[1] Vxx_temp1[0] Vxx_temp1[1] Vxx_temp2[0] Vxx_temp2[1] /end OUT_MEASUREMENT
/end FUNCTION
/begin FUNCTION InPciApi ""
 /begin SUB_FUNCTION InPciApi_Pedxxsr InPciApi_Pedinxx InPciApi_Sftpdxx InPciApi_Pedxxxx /end SUB_FUNCTION
/end FUNCTION
/begin FUNCTION InPciApi_Pedxxsr "" /begin DEF_CHARACTERISTIC Cxx_acel_pdl_sens_pws Cxx_acel_pdl_stab_thd /end DEF_CHARACTERISTIC
 /begin OUT_MEASUREMENT Vbx_acel_pdl_fil_sens_v1 Vbx_acel_pdl_fil_sens_v2 Vxx_acel_pdl_fil_sens_v1 Vxx_acel_pdl_fil_sens_v2 Vxx_acel_pdl_sens_rat1 Vxx_acel_pdl_sens_rat2 /end OUT_MEASUREMENT
/end FUNCTION
/begin FUNCTION InPciApi_Pedinxx ""
 /begin DEF_CHARACTERISTIC Cxx_acel_pdl_0_rat_v_nok Cxx_acel_pdl_0_rat_v_ok Cxx_acel_pdl_100_rat_v_hys Cxx_acel_pdl_100_rat_v_max_nok Cxx_acel_pdl_100_rat_v_max_ok Cxx_acel_pdl_100_rat_v_nok Cxx_acel_pdl_100_rat_v_ok Cxx_acel_pdl_kd_hys Cxx_acel_pdl_kd_in_thd_nok Cxx_acel_pdl_kd_in_thd_ok /end DEF_CHARACTERISTIC
 /begin OUT_MEASUREMENT Vbx_acel_pdl_100_rat Vbx_acel_pdl_kd Vsx_acel_pdl_rat_vld Vxx_acel_pdl_0_rat_v Vxx_acel_pdl_100_rat_v Vxx_acel_pdl_100_rat_v_max Vxx_acel_pdl_kd_in_thd Vxx_acel_pdl_rat /end OUT_MEASUREMENT
/end FUNCTION
/begin FUNCTION InPciApi_Sftpdxx ""
 /begin DEF_CHARACTERISTIC Cbx_acel_pdl_secu_2_cfm Cbx_acel_pdl_secu_acc_cfm Cbx_acel_pdl_secu_esp_cfm Cxx_acel_pdl_secu_2_inc_1 Cxx_acel_pdl_secu_2_inc_2 Cxx_acel_pdl_secu_2_thd Cxx_acel_pdl_secu_2_vs_thd Cxx_acel_pdl_secu_dly1 Cxx_acel_pdl_secu_dly2 Cxx_acel_pdl_secu_flu_thd Cxx_acel_pdl_secu_n_thd Cxx_acel_pdl_secu_thd Cxx_acel_pdl_secu_vs_thd Cxx_dfdec_acel_pdl_secu_2 /end DEF_CHARACTERISTIC
 /begin OUT_MEASUREMENT Vxx_acel_pdl_secu_ctr Vbx_acel_pdl_secu_cdn_1 Vbx_acel_pdl_secu_cdn_2 Vbx_acel_pdl_secu_det Vbx_df_acel_pdl_secu_1 Vbx_df_acel_pdl_secu_2 Vbx_diag_ena_acel_pdl_secu_2 /end OUT_MEASUREMENT
/end FUNCTION
/begin FUNCTION InPciApi_Pedxxxx ""
 /begin DEF_CHARACTERISTIC Ctb_acel_pdl_v_max_dif Ctp_acel_pdl_v_max_dif Cxx_acel_pdl_lih_sub_v Cxx_acel_pdl_v1_max_thd Cxx_acel_pdl_v1_min_thd Cxx_acel_pdl_v1_v2_fac Cxx_acel_pdl_v2_max_thd Cxx_acel_pdl_v2_min_thd Cxx_dfdec_acel_pdl_chr Cxx_dfdec_acel_pdl_tot Cxx_dfdec_acel_pdl_v1 Cxx_dfdec_acel_pdl_v2 Cxx_dfinc_acel_pdl_chr Cxx_dfinc_acel_pdl_tot Cxx_dfinc_acel_pdl_v1 Cxx_dfinc_acel_pdl_v2 /end DEF_CHARACTERISTIC
 /begin OUT_MEASUREMENT Vbx_acel_pdl_sens1_ok Vbx_det_acel_pdl_rdcy_loss Vbx_df_acel_pdl_chr Vbx_df_acel_pdl_tot Vbx_df_acel_pdl_v1_h Vbx_df_acel_pdl_v1_l Vbx_df_acel_pdl_v2_h Vbx_df_acel_pdl_v2_l Vbx_diag_ena_acel_pdl_chr Vbx_fail_pws_acel_pdl_v1 Vbx_fail_pws_acel_pdl_v2 Vbx_loss_acel_pdl_v1 Vsx_acel_pdl_sens_v1_vld Vsx_acel_pdl_v_vld Vxx_acel_pdl_sens_v Vxx_acel_pdl_v /end OUT_MEASUREMENT
/end FUNCTION
/begin FUNCTION InVfiEmi ""
 /begin SUB_FUNCTION InVfiEmi_Batxxxx InVfiEmi_Altdfcs InVfiEmi_Bduxxbc InVfiEmi_Altdfsr /end SUB_FUNCTION
/end FUNCTION
/begin FUNCTION InVfiEmi_Batxxxx ""
 /begin DEF_CHARACTERISTIC Cxx_dfdec_vb_h Cxx_dfdec_vb_l Cxx_dfdec_vb_rly_oc_scg Cxx_dfdec_vb_rly_scw Cxx_dfinc_vb_h Cxx_dfinc_vb_l Cxx_dfinc_vb_rly_oc_scg Cxx_dfinc_vb_rly_scw Cxx_mv_vb_fac Cxx_thd_n_diag_vb_h Cxx_thd_n_diag_vb_l Cxx_thd_vb_h Cxx_thd_vb_l /end DEF_CHARACTERISTIC
 /begin OUT_MEASUREMENT Vbx_df_vb_h Vbx_df_vb_l Vbx_diag_ena_vb_h Vbx_diag_ena_vb_l Vsx_vb_rly_vld Vsx_vb_vld Vxx_mv_vb Vxx_vb /end OUT_MEASUREMENT
/end FUNCTION
/begin FUNCTION InVfiEmi_Altdfcs ""
 /begin DEF_CHARACTERISTIC Cbx_mux_alt_pwm_cfm Cxx_alt_pwm_l Cxx_alt_pwm_sub Cxx_mux_alt_pwm_fil_t /end DEF_CHARACTERISTIC
 /begin OUT_MEASUREMENT Vsx_alt_pwm_vld Vxx_alt_pwm /end OUT_MEASUREMENT
/end FUNCTION
/begin FUNCTION InVfiEmi_Bduxxbc "" /begin OUT_MEASUREMENT Vbx_bdu_ope /end OUT_MEASUREMENT /end FUNCTION
/begin FUNCTION InVfiEmi_Altdfsr "" /begin OUT_MEASUREMENT Vsx_sens_alt_fil_pwm_vld Vxx_sens_alt_fil_pwm /end OUT_MEASUREMENT /end FUNCTION
/begin FUNCTION DgDftMng ""
 /begin OUT_MEASUREMENT Sbx_obd_rdn_cata_cpt Sbx_obd_rdn_lbup_cpt Sbx_obd_rdn_egr Sbx_obd_rdn_cata Sbx_obd_rdn_heat Sbx_obd_rdn_evap Sbx_obd_rdn_pft Vxx_dfctr_ac_prs_h Vxx_rdn_ac_prs_h Vbx_cf_ac_prs_h Vbx_clf_ac_prs_h Vbx_df_old_ac_prs_h Vbx_dfctr_sat_ac_prs_h Vbx_rdn_ac_prs_h Vxx_dtc_stt_ac_prs_h Vxx_dfctr_ac_prs_l Vxx_rdn_ac_prs_l Vbx_cf_ac_prs_l Vbx_clf_ac_prs_l Vbx_df_old_ac_prs_l Vbx_dfctr_sat_ac_prs_l Vbx_rdn_ac_prs_l Vxx_dtc_stt_ac_prs_l Vxx_dfctr_acel_pdl_chr Vxx_rdn_acel_pdl_chr Vbx_cf_acel_pdl_chr Vbx_clf_acel_pdl_chr Vbx_df_old_acel_pdl_chr Vbx_dfctr_sat_acel_pdl_chr Vbx_rdn_acel_pdl_chr Vxx_dtc_stt_acel_pdl_chr Vxx_dfctr_acel_pdl_secu_1 Vxx_rdn_acel_pdl_secu_1 Vbx_cf_acel_pdl_secu_1 Vbx_clf_acel_pdl_secu_1 Vbx_df_old_acel_pdl_secu_1 Vbx_dfctr_sat_acel_pdl_secu_1 Vbx_rdn_acel_pdl_secu_1 Vxx_dtc_stt_acel_pdl_secu_1 Vxx_dfctr_acel_pdl_secu_2 Vxx_rdn_acel_pdl_secu_2 Vbx_cf_acel_pdl_secu_2 Vbx_clf_acel_pdl_secu_2 Vbx_df_old_acel_pdl_secu_2 Vbx_dfctr_sat_acel_pdl_secu_2 Vbx_rdn_acel_pdl_secu_2 Vxx_dtc_stt_acel_pdl_secu_2 Vxx_dfctr_acel_pdl_tot Vxx_rdn_acel_pdl_tot Vbx_cf_acel_pdl_tot Vbx_clf_acel_pdl_tot Vbx_df_old_acel_pdl_tot Vbx_dfctr_sat_acel_pdl_tot Vbx_rdn_acel_pdl_tot Vxx_dtc_stt_acel_pdl_tot Vxx_dfctr_acel_pdl_v1_h Vxx_rdn_acel_pdl_v1_h Vbx_cf_acel_pdl_v1_h Vbx_clf_acel_pdl_v1_h Vbx_df_old_acel_pdl_v1_h Vbx_dfctr_sat_acel_pdl_v1_h Vbx_rdn_acel_pdl_v1_h Vxx_dtc_stt_acel_pdl_v1_h Vxx_dfctr_acel_pdl_v1_l Vxx_rdn_acel_pdl_v1_l Vbx_cf_acel_pdl_v1_l Vbx_clf_acel_pdl_v1_l Vbx_df_old_acel_pdl_v1_l Vbx_dfctr_sat_acel_pdl_v1_l Vbx_rdn_acel_pdl_v1_l Vxx_dtc_stt_acel_pdl_v1_l Vxx_dfctr_acel_pdl_v2_h Vxx_rdn_acel_pdl_v2_h Vbx_cf_acel_pdl_v2_h Vbx_clf_acel_pdl_v2_h Vbx_df_old_acel_pdl_v2_h Vbx_dfctr_sat_acel_pdl_v2_h Vbx_rdn_acel_pdl_v2_h Vxx_dtc_stt_acel_pdl_v2_h Vxx_dfctr_acel_pdl_v2_l Vxx_rdn_acel_pdl_v2_l Vbx_cf_acel_pdl_v2_l Vbx_clf_acel_pdl_v2_l Vbx_df_old_acel_pdl_v2_l Vbx_dfctr_sat_acel_pdl_v2_l Vbx_rdn_acel_pdl_v2_l Vxx_dtc_stt_acel_pdl_v2_l Vxx_dfctr_actr_rly_oc Vxx_rdn_actr_rly_oc Vbx_cf_actr_rly_oc Vbx_clf_actr_rly_oc Vbx_df_old_actr_rly_oc Vbx_dfctr_sat_actr_rly_oc Vbx_rdn_actr_rly_oc Vxx_dtc_stt_actr_rly_oc Vxx_dfctr_actr_rly_scg Vxx_rdn_actr_rly_scg Vbx_cf_actr_rly_scg Vbx_clf_actr_rly_scg Vbx_df_old_actr_rly_scg Vbx_dfctr_sat_actr_rly_scg Vbx_rdn_actr_rly_scg Vxx_dtc_stt_actr_rly_scg Vxx_dfctr_actr_rly_scw Vxx_rdn_actr_rly_scw Vbx_cf_actr_rly_scw Vbx_clf_actr_rly_scw Vbx_df_old_actr_rly_scw Vbx_dfctr_sat_actr_rly_scw Vbx_rdn_actr_rly_scw Vxx_dtc_stt_actr_rly_scw Vxx_dfctr_agb_data_chr Vxx_rdn_agb_data_chr Vbx_cf_agb_data_chr Vbx_clf_agb_data_chr Vbx_df_old_agb_data_chr Vbx_dfctr_sat_agb_data_chr Vbx_rdn_agb_data_chr Vxx_dtc_stt_agb_data_chr Vxx_dfctr_agb_data_seq_ctr Vxx_rdn_agb_data_seq_ctr Vbx_cf_agb_data_seq_ctr Vbx_clf_agb_data_seq_ctr Vbx_df_old_agb_data_seq_ctr Vbx_dfctr_sat_agb_data_seq_ctr Vbx_rdn_agb_data_seq_ctr Vxx_dtc_stt_agb_data_seq_ctr Vxx_dfctr_agb_data_tout Vxx_rdn_agb_data_tout Vbx_cf_agb_data_tout Vbx_clf_agb_data_tout Vbx_df_old_agb_data_tout Vbx_dfctr_sat_agb_data_tout Vbx_rdn_agb_data_tout Vxx_dtc_stt_agb_data_tout Vxx_dfctr_agb_no_frm Vxx_rdn_agb_no_frm Vbx_cf_agb_no_frm Vbx_clf_agb_no_frm Vbx_df_old_agb_no_frm Vbx_dfctr_sat_agb_no_frm Vbx_rdn_agb_no_frm Vxx_dtc_stt_agb_no_frm Vxx_dfctr_bgin_clu_cmp Vxx_rdn_bgin_clu_cmp Vbx_cf_bgin_clu_cmp Vbx_clf_bgin_clu_cmp Vbx_df_old_bgin_clu_cmp Vbx_dfctr_sat_bgin_clu_cmp Vbx_rdn_bgin_clu_cmp Vxx_dtc_stt_bgin_clu_cmp Vxx_dfctr_bgin_clu_nok Vxx_rdn_bgin_clu_nok Vbx_cf_bgin_clu_nok Vbx_clf_bgin_clu_nok Vbx_df_old_bgin_clu_nok Vbx_dfctr_sat_bgin_clu_nok Vbx_rdn_bgin_clu_nok Vxx_dtc_stt_bgin_clu_nok Vxx_dfctr_brk_pdl_cmp Vxx_rdn_brk_pdl_cmp Vbx_cf_brk_pdl_cmp Vbx_clf_brk_pdl_cmp Vbx_df_old_brk_pdl_cmp Vbx_dfctr_sat_brk_pdl_cmp Vbx_rdn_brk_pdl_cmp Vxx_dtc_stt_brk_pdl_cmp Vxx_dfctr_cata_cpt Vxx_rdn_cata_cpt Vbx_cf_cata_cpt Vbx_clf_cata_cpt Vbx_df_old_cata_cpt Vbx_dfctr_sat_cata_cpt Vbx_rdn_cata_cpt Vxx_dtc_stt_cata_cpt Vxx_dfctr_cl_rich_chr Vxx_rdn_cl_rich_chr Vbx_cf_cl_rich_chr Vbx_clf_cl_rich_chr Vbx_df_old_cl_rich_chr Vbx_dfctr_sat_cl_rich_chr Vbx_rdn_cl_rich_chr Vxx_dtc_stt_cl_rich_chr Vxx_dfctr_clu_cnt_nok Vxx_rdn_clu_cnt_nok Vbx_cf_clu_cnt_nok Vbx_clf_clu_cnt_nok Vbx_df_old_clu_cnt_nok Vbx_dfctr_sat_clu_cnt_nok Vbx_rdn_clu_cnt_nok Vxx_dtc_stt_clu_cnt_nok Vxx_dfctr_cp_oc Vxx_rdn_cp_oc Vbx_cf_cp_oc Vbx_clf_cp_oc Vbx_df_old_cp_oc Vbx_dfctr_sat_cp_oc Vbx_rdn_cp_oc Vxx_dtc_stt_cp_oc Vxx_dfctr_cp_scg Vxx_rdn_cp_scg Vbx_cf_cp_scg Vbx_clf_cp_scg Vbx_df_old_cp_scg Vbx_dfctr_sat_cp_scg Vbx_rdn_cp_scg Vxx_dtc_stt_cp_scg Vxx_dfctr_cp_scw Vxx_rdn_cp_scw Vbx_cf_cp_scw Vbx_clf_cp_scw Vbx_df_old_cp_scw Vbx_dfctr_sat_cp_scw Vbx_rdn_cp_scw Vxx_dtc_stt_cp_scw Vxx_dfctr_crk_chr Vxx_rdn_crk_chr Vbx_cf_crk_chr Vbx_clf_crk_chr Vbx_df_old_crk_chr Vbx_dfctr_sat_crk_chr Vbx_rdn_crk_chr Vxx_dtc_stt_crk_chr Vxx_dfctr_crk_cmp Vxx_rdn_crk_cmp Vbx_cf_crk_cmp Vbx_clf_crk_cmp Vbx_df_old_crk_cmp Vbx_dfctr_sat_crk_cmp Vbx_rdn_crk_cmp Vxx_dtc_stt_crk_cmp Vxx_dfctr_crk_cyc Vxx_rdn_crk_cyc Vbx_cf_crk_cyc Vbx_clf_crk_cyc Vbx_df_old_crk_cyc Vbx_dfctr_sat_crk_cyc Vbx_rdn_crk_cyc Vxx_dtc_stt_crk_cyc Vxx_dfctr_crk_no_sig Vxx_rdn_crk_no_sig Vbx_cf_crk_no_sig Vbx_clf_crk_no_sig Vbx_df_old_crk_no_sig Vbx_dfctr_sat_crk_no_sig Vbx_rdn_crk_no_sig Vxx_dtc_stt_crk_no_sig Vxx_dfctr_crk_oc Vxx_rdn_crk_oc Vbx_cf_crk_oc Vbx_clf_crk_oc Vbx_df_old_crk_oc Vbx_dfctr_sat_crk_oc Vbx_rdn_crk_oc Vxx_dtc_stt_crk_oc Vxx_dfctr_crk_shp Vxx_rdn_crk_shp Vbx_cf_crk_shp Vbx_clf_crk_shp Vbx_df_old_crk_shp Vbx_dfctr_sat_crk_shp Vbx_rdn_crk_shp Vxx_dtc_stt_crk_shp Vxx_dfctr_cru_cmp Vxx_rdn_cru_cmp Vbx_cf_cru_cmp Vbx_clf_cru_cmp Vbx_df_old_cru_cmp Vbx_dfctr_sat_cru_cmp Vbx_rdn_cru_cmp Vxx_dtc_stt_cru_cmp Vxx_dfctr_cru_sl_swi_chr Vxx_rdn_cru_sl_swi_chr Vbx_cf_cru_sl_swi_chr Vbx_clf_cru_sl_swi_chr Vbx_df_old_cru_sl_swi_chr Vbx_dfctr_sat_cru_sl_swi_chr Vbx_rdn_cru_sl_swi_chr Vxx_dtc_stt_cru_sl_swi_chr Vxx_dfctr_cru_sl_tot Vxx_rdn_cru_sl_tot Vbx_cf_cru_sl_tot Vbx_clf_cru_sl_tot Vbx_df_old_cru_sl_tot Vbx_dfctr_sat_cru_sl_tot Vbx_rdn_cru_sl_tot Vxx_dtc_stt_cru_sl_tot Vxx_dfctr_cru_vs_cmp Vxx_rdn_cru_vs_cmp Vbx_cf_cru_vs_cmp Vbx_clf_cru_vs_cmp Vbx_df_old_cru_vs_cmp Vbx_dfctr_sat_cru_vs_cmp Vbx_rdn_cru_vs_cmp Vxx_dtc_stt_cru_vs_cmp Vxx_dfctr_cru_whl_cmd_nok Vxx_rdn_cru_whl_cmd_nok Vbx_cf_cru_whl_cmd_nok Vbx_clf_cru_whl_cmd_nok Vbx_df_old_cru_whl_cmd_nok Vbx_dfctr_sat_cru_whl_cmd_nok Vbx_rdn_cru_whl_cmd_nok Vxx_dtc_stt_cru_whl_cmd_nok Vxx_dfctr_cru_whl_cmd_oc_scw Vxx_rdn_cru_whl_cmd_oc_scw Vbx_cf_cru_whl_cmd_oc_scw Vbx_clf_cru_whl_cmd_oc_scw Vbx_df_old_cru_whl_cmd_oc_scw Vbx_dfctr_sat_cru_whl_cmd_oc_scw Vbx_rdn_cru_whl_cmd_oc_scw Vxx_dtc_stt_cru_whl_cmd_oc_scw Vxx_dfctr_cru_whl_cmd_oor Vxx_rdn_cru_whl_cmd_oor Vbx_cf_cru_whl_cmd_oor Vbx_clf_cru_whl_cmd_oor Vbx_df_old_cru_whl_cmd_oor Vbx_dfctr_sat_cru_whl_cmd_oor Vbx_rdn_cru_whl_cmd_oor Vxx_dtc_stt_cru_whl_cmd_oor Vxx_dfctr_ecm_adc_tron Vxx_rdn_ecm_adc_tron Vbx_cf_ecm_adc_tron Vbx_clf_ecm_adc_tron Vbx_df_old_ecm_adc_tron Vbx_dfctr_sat_ecm_adc_tron Vbx_rdn_ecm_adc_tron Vxx_dtc_stt_ecm_adc_tron Vxx_dfctr_ecm_err_itl Vxx_rdn_ecm_err_itl Vbx_cf_ecm_err_itl Vbx_clf_ecm_err_itl Vbx_df_old_ecm_err_itl Vbx_dfctr_sat_ecm_err_itl Vbx_rdn_ecm_err_itl Vxx_dtc_stt_ecm_err_itl Vxx_dfctr_ecm_mon_secu_1 Vxx_rdn_ecm_mon_secu_1 Vbx_cf_ecm_mon_secu_1 Vbx_clf_ecm_mon_secu_1 Vbx_df_old_ecm_mon_secu_1 Vbx_dfctr_sat_ecm_mon_secu_1 Vbx_rdn_ecm_mon_secu_1 Vxx_dtc_stt_ecm_mon_secu_1 Vxx_dfctr_ecm_mon_secu_2 Vxx_rdn_ecm_mon_secu_2 Vbx_cf_ecm_mon_secu_2 Vbx_clf_ecm_mon_secu_2 Vbx_df_old_ecm_mon_secu_2 Vbx_dfctr_sat_ecm_mon_secu_2 Vbx_rdn_ecm_mon_secu_2 Vxx_dtc_stt_ecm_mon_secu_2 Vxx_dfctr_ecm_mon_tron Vxx_rdn_ecm_mon_tron Vbx_cf_ecm_mon_tron Vbx_clf_ecm_mon_tron Vbx_df_old_ecm_mon_tron Vbx_dfctr_sat_ecm_mon_tron Vbx_rdn_ecm_mon_tron Vxx_dtc_stt_ecm_mon_tron Sbx_dyn_ac_prs_h Sbx_rdn_ac_prs_h Sbx_mf_ac_prs_h Sbx_cf_ac_prs_h Sbx_dyn_ac_prs_l Sbx_rdn_ac_prs_l Sbx_mf_ac_prs_l Sbx_cf_ac_prs_l Sbx_dyn_acel_pdl_chr Sbx_rdn_acel_pdl_chr Sbx_mf_acel_pdl_chr Sbx_cf_acel_pdl_chr Sbx_dyn_acel_pdl_secu_1 Sbx_rdn_acel_pdl_secu_1 Sbx_mf_acel_pdl_secu_1 Sbx_cf_acel_pdl_secu_1 Sbx_dyn_acel_pdl_secu_2 Sbx_rdn_acel_pdl_secu_2 Sbx_mf_acel_pdl_secu_2 Sbx_cf_acel_pdl_secu_2 Sbx_dyn_acel_pdl_tot Sbx_rdn_acel_pdl_tot Sbx_mf_acel_pdl_tot Sbx_cf_acel_pdl_tot Sbx_dyn_acel_pdl_v1_h Sbx_rdn_acel_pdl_v1_h Sbx_mf_acel_pdl_v1_h Sbx_cf_acel_pdl_v1_h Sbx_dyn_acel_pdl_v1_l Sbx_rdn_acel_pdl_v1_l Sbx_mf_acel_pdl_v1_l Sbx_cf_acel_pdl_v1_l Sbx_dyn_acel_pdl_v2_h Sbx_rdn_acel_pdl_v2_h Sbx_mf_acel_pdl_v2_h Sbx_cf_acel_pdl_v2_h Sbx_dyn_acel_pdl_v2_l Sbx_rdn_acel_pdl_v2_l Sbx_mf_acel_pdl_v2_l Sbx_cf_acel_pdl_v2_l Sbx_dyn_actr_rly_oc Sbx_rdn_actr_rly_oc Sbx_mf_actr_rly_oc Sbx_cf_actr_rly_oc Sbx_dyn_actr_rly_scg Sbx_rdn_actr_rly_scg Sbx_mf_actr_rly_scg Sbx_cf_actr_rly_scg Sbx_dyn_actr_rly_scw Sbx_rdn_actr_rly_scw Sbx_mf_actr_rly_scw Sbx_cf_actr_rly_scw Sbx_dyn_agb_data_chr Sbx_rdn_agb_data_chr Sbx_mf_agb_data_chr Sbx_cf_agb_data_chr Sbx_dyn_agb_data_seq_ctr Sbx_rdn_agb_data_seq_ctr Sbx_mf_agb_data_seq_ctr Sbx_cf_agb_data_seq_ctr Sbx_dyn_agb_data_tout Sbx_rdn_agb_data_tout Sbx_mf_agb_data_tout Sbx_cf_agb_data_tout Sbx_dyn_agb_no_frm Sbx_rdn_agb_no_frm Sbx_mf_agb_no_frm Sbx_cf_agb_no_frm Sbx_dyn_bgin_clu_cmp Sbx_rdn_bgin_clu_cmp Sbx_mf_bgin_clu_cmp Sbx_cf_bgin_clu_cmp Sbx_dyn_bgin_clu_nok Sbx_rdn_bgin_clu_nok Sbx_mf_bgin_clu_nok Sbx_cf_bgin_clu_nok Sbx_dyn_brk_pdl_cmp Sbx_rdn_brk_pdl_cmp Sbx_mf_brk_pdl_cmp Sbx_cf_brk_pdl_cmp Sbx_dyn_cata_cpt Sbx_rdn_cata_cpt Sbx_mf_cata_cpt Sbx_cf_cata_cpt Sbx_dyn_cl_rich_chr Sbx_rdn_cl_rich_chr Sbx_mf_cl_rich_chr Sbx_cf_cl_rich_chr Sbx_dyn_clu_cnt_nok Sbx_rdn_clu_cnt_nok Sbx_mf_clu_cnt_nok Sbx_cf_clu_cnt_nok Sbx_dyn_cp_oc Sbx_rdn_cp_oc Sbx_mf_cp_oc Sbx_cf_cp_oc Sbx_dyn_cp_scg Sbx_rdn_cp_scg Sbx_mf_cp_scg Sbx_cf_cp_scg Sbx_dyn_cp_scw Sbx_rdn_cp_scw Sbx_mf_cp_scw Sbx_cf_cp_scw Sbx_dyn_crk_chr Sbx_rdn_crk_chr Sbx_mf_crk_chr Sbx_cf_crk_chr Sbx_dyn_crk_cmp Sbx_rdn_crk_cmp Sbx_mf_crk_cmp Sbx_cf_crk_cmp Sbx_dyn_crk_cyc Sbx_rdn_crk_cyc Sbx_mf_crk_cyc Sbx_cf_crk_cyc Sbx_dyn_crk_no_sig Sbx_rdn_crk_no_sig Sbx_mf_crk_no_sig Sbx_cf_crk_no_sig Sbx_dyn_crk_oc Sbx_rdn_crk_oc Sbx_mf_crk_oc Sbx_cf_crk_oc Sbx_dyn_crk_shp Sbx_rdn_crk_shp Sbx_mf_crk_shp Sbx_cf_crk_shp Sbx_dyn_cru_cmp Sbx_rdn_cru_cmp Sbx_mf_cru_cmp Sbx_cf_cru_cmp Sbx_dyn_cru_sl_swi_chr Sbx_rdn_cru_sl_swi_chr Sbx_mf_cru_sl_swi_chr Sbx_cf_cru_sl_swi_chr Sbx_dyn_cru_sl_tot Sbx_rdn_cru_sl_tot Sbx_mf_cru_sl_tot Sbx_cf_cru_sl_tot Sbx_dyn_cru_vs_cmp Sbx_rdn_cru_vs_cmp Sbx_mf_cru_vs_cmp Sbx_cf_cru_vs_cmp Sbx_dyn_cru_whl_cmd_nok Sbx_rdn_cru_whl_cmd_nok Sbx_mf_cru_whl_cmd_nok Sbx_cf_cru_whl_cmd_nok Sbx_dyn_cru_whl_cmd_oc_scw Sbx_rdn_cru_whl_cmd_oc_scw Sbx_mf_cru_whl_cmd_oc_scw /end OUT_MEASUREMENT
 /begin SUB_FUNCTION DgDftMng_Failmgt DgDftMng_Svcecom DgDftMng_Obdfram DgDftMng_Rdnmgtx DgDftMng_Obdenvx /end SUB_FUNCTION
/end FUNCTION
/end MODULE
/end PROJECT
