ASAP2_VERSION 1 41
/begin PROJECT RD8 "_default_ProjectLongIdentifier"
/begin HEADER "_default_HeaderComment" PROJECT_NO RD9 /end HEADER
/begin MODULE _default_ModuleName "_default_ModuleLongIdentifier"
/begin MOD_COMMON "_default_ModCommonComment" DEPOSIT ABSOLUTE BYTE_ORDER MSB_LAST ALIGNMENT_BYTE 1 ALIGNMENT_WORD 2 ALIGNMENT_LONG 2 ALIGNMENT_FLOAT32_IEEE 2 ALIGNMENT_FLOAT64_IEEE 4 /end MOD_COMMON
/begin MEASUREMENT Stx_esd[0] "Extended Snapshot Data table" UBYTE _CNV_A_R_ECME_LINEA_0_CM 1 0. 0. 255. ECU_ADDRESS 0xd00055c7 FORMAT "%3.0" /end MEASUREMENT
/begin MEASUREMENT Sxx_clr_dist "Distance travelled since last clear" UWORD _CNV_A_R_LINEAR_____218_CM 1 0. 0. 65535. ECU_ADDRESS 0xd0005994 FORMAT "%5.0" /end MEASUREMENT
/begin MEASUREMENT Sxx_clr_wup "Warm-up cycles counter since last clear" UBYTE _CNV_A_R_ECME_LINEA_0_CM 1 0. 0. 255. ECU_ADDRESS 0xd00055c8 FORMAT "%3.0" /end MEASUREMENT
/begin MEASUREMENT Sxx_dyn_ctr "Failure structure index of the next diagnostic instance to be stored (number of stored failures)" UBYTE _CNV_A_R_ECME_LINEA_0_CM 1 0. 0. 10. ECU_ADDRESS 0xd00055c9 FORMAT "%2.0" /end MEASUREMENT
/begin MEASUREMENT Sxx_mil_on_km "Distance travelled while MIL is activated" UWORD _CNV_A_R_LINEAR_____218_CM 1 0. 0. 65535. ECU_ADDRESS 0xd0005996 FORMAT "%5.0" /end MEASUREMENT
/begin MEASUREMENT Sxx_tmp_dist_1 "Temporary distance used to calculate distance traveled while MIL is illuminated" ULONG _CNV_A_R_LINEAR_____218_CM 1 0. 0. 16777215. ECU_ADDRESS 0xd0002b00 FORMAT "%8.0" /end MEASUREMENT
/begin MEASUREMENT Sxx_tmp_dist_2 "Temporary distance used to calculate distance traveled since last clear" ULONG _CNV_A_R_LINEAR_____218_CM 1 0. 0. 16777215. ECU_ADDRESS 0xd0002b04 FORMAT "%8.0" /end MEASUREMENT
/begin MEASUREMENT Vbx_eng_aut_fm "Current autonomous engine detection state" UBYTE _CNV_S_2_RANGE______3_CM 1 0. 0. 1. ECU_ADDRESS 0xd00055d0 BIT_MASK 0x1 /end MEASUREMENT
/begin MEASUREMENT Vbx_eng_stop "Current stopped engine detection state" UBYTE _CNV_S_2_RANGE______3_CM 1 0. 0. 1. ECU_ADDRESS 0xd00055d1 BIT_MASK 0x1 /end MEASUREMENT
/begin MEASUREMENT Vbx_igk_on_sta_pws "Ignition key OR Power up event" UBYTE _CNV_S_2_RANGE______3_CM 1 0. 0. 1. ECU_ADDRESS 0xd00055d2 BIT_MASK 0x1 /end MEASUREMENT
/begin MEASUREMENT Vbx_mil_ecu_req "MIL activation request of engine control unit" UBYTE _CNV_S_2_RANGE______3_CM 1 0. 0. 1. ECU_ADDRESS 0xd00055d3 BIT_MASK 0x1 /end MEASUREMENT
/begin MEASUREMENT Vbx_mil_prmt_req "MIL illumination gobal request status (0 switch off, 1 switch on)" UBYTE _CNV_S_2_RANGE______3_CM 1 0. 0. 1. ECU_ADDRESS 0xd00055d4 BIT_MASK 0x1 /end MEASUREMENT
/begin MEASUREMENT Vbx_obd_dc "Driving cycle detection status" UBYTE _CNV_S_2_RANGE______3_CM 1 0. 0. 1. ECU_ADDRESS 0xd00055d5 BIT_MASK 0x1 /end MEASUREMENT
/begin MEASUREMENT Vbx_obd_wup "Warm-up cycle detection status" UBYTE _CNV_S_2_RANGE______3_CM 1 0. 0. 1. ECU_ADDRESS 0xd00055d6 BIT_MASK 0x1 /end MEASUREMENT
/begin MEASUREMENT Vbx_wal_1_req "Global warning lamp 1 activation request" UBYTE _CNV_S_2_RANGE______3_CM 1 0. 0. 1. ECU_ADDRESS 0xd00055d7 BIT_MASK 0x1 /end MEASUREMENT
/begin MEASUREMENT Vbx_wal_2_req "Global warning lamp 2 activation request" UBYTE _CNV_S_2_RANGE______3_CM 1 0. 0. 1. ECU_ADDRESS 0xd00055d8 BIT_MASK 0x1 /end MEASUREMENT
/begin MEASUREMENT Vbx_wup "Current warm-up detection state" UBYTE _CNV_S_2_RANGE______3_CM 1 0. 0. 1. ECU_ADDRESS 0xd00055d9 BIT_MASK 0x1 /end MEASUREMENT
/begin MEASUREMENT Vxx_dtc_hmb_cf_redg_edic "Diagnosis trouble code (device or function identifier) corresponding to the last confirmed failure raising edge event for EDIC" UWORD _CNV_A_R_ECME_LINEA_0_CM 1 0. 0. 65535. ECU_ADDRESS 0xd0005998 FORMAT "%5.0" /end MEASUREMENT
/begin MEASUREMENT Vxx_dtc_lb_cf_redg_edic "Diagnosis trouble code (faulttype identifier) corresponding to the last confirmed failure rising edge event for EDIC" UBYTE _CNV_A_R_ECME_LINEA_0_CM 1 0. 0. 255. ECU_ADDRESS 0xd00055ca FORMAT "%3.0" /end MEASUREMENT
/begin MEASUREMENT Vxx_esd_did_nr "RSA_API_ExtendedSnapshotData number of DID to store" UBYTE _CNV_A_R_ECME_LINEA_0_CM 1 0. 0. 255. ECU_ADDRESS 0xd00055cb FORMAT "%3.0" /end MEASUREMENT
/begin MEASUREMENT Vxx_esd_ind "RSA_API_ExtendedSnapshotData calling diagnosis identifier" UWORD _CNV_A_R_ECME_LINEA_0_CM 1 0. 0. 65535. ECU_ADDRESS 0xd000599a FORMAT "%5.0" /end MEASUREMENT
/begin MEASUREMENT Vxx_esd_ind_ini "Current initial index to save requested data" UBYTE _CNV_A_R_ECME_LINEA_0_CM 1 0. 0. 255. ECU_ADDRESS 0xd00055cc FORMAT "%3.0" /end MEASUREMENT
/begin MEASUREMENT Vxx_esd_ind_max "Initial index of free space in Extended Snapshot Data table" UBYTE _CNV_A_R_ECME_LINEA_0_CM 1 0. 0. 255. ECU_ADDRESS 0xd00055cd FORMAT "%3.0" /end MEASUREMENT
/begin MEASUREMENT Vxx_esd_siz "Requested extended snapshot size in bytes to be saved" UBYTE _CNV_A_R_ECME_LINEA_0_CM 1 0. 0. 255. ECU_ADDRESS 0xd00055ce FORMAT "%3.0" /end MEASUREMENT
/begin MEASUREMENT Vxx_ind_fail_redg "Diagnosis identifier associated to Vbx_cf_xxx rising edge event" UWORD _CNV_A_R_ECME_LINEA_0_CM 1 0. 0. 65535. ECU_ADDRESS 0xd000599c FORMAT "%5.0" /end MEASUREMENT
/begin MEASUREMENT Vxx_ind_mfo_redg "Diagnosis identifier of OBD confirmed failure rising edge" UWORD _CNV_A_R_ECME_LINEA_0_CM 1 0. 0. 65535. ECU_ADDRESS 0xd000599e FORMAT "%5.0" /end MEASUREMENT
/begin MEASUREMENT Vxx_ind_obd_clf_redg "Diagnosis identifier of OBD confirmed latched rising edge" UWORD _CNV_A_R_ECME_LINEA_0_CM 1 0. 0. 65535. ECU_ADDRESS 0xd00059a0 FORMAT "%5.0" /end MEASUREMENT
/begin MEASUREMENT Vxx_ind_obd_fedg "Diagnosis identifier of OBD pending or confirmed failure falling edge or overwriting" UWORD _CNV_A_R_ECME_LINEA_0_CM 1 0. 0. 65535. ECU_ADDRESS 0xd00059a2 FORMAT "%5.0" /end MEASUREMENT
/begin MEASUREMENT Vxx_ind_pfo_redg "Diagnosis identifier of OBD pending failure rising edge" UWORD _CNV_A_R_ECME_LINEA_0_CM 1 0. 0. 65535. ECU_ADDRESS 0xd00059a4 FORMAT "%5.0" /end MEASUREMENT
/begin MEASUREMENT Vxx_tco_ini "Initial value of engine coolant temperature" UWORD _CNV_A_R_LINEAR_____54_CM 1 0. -40. 200. ECU_ADDRESS 0xd00059a6 FORMAT "%5.1" /end MEASUREMENT
/begin MEASUREMENT Vxx_tmp_pri "Temporary failure calculated priority" UBYTE _CNV_A_R_ECME_LINEA_0_CM 1 0. 0. 4. ECU_ADDRESS 0xd00055cf FORMAT "%1.0" /end MEASUREMENT
/begin CHARACTERISTIC Cxx_dyn_thd "a_dg_dft_mng_failmgt/Dynamic storage capacity or dynamic failure structures index maximum value" VALUE 0xa0020b96 _REC_S1VAL_20_u1 9. _CNV_A_R_ECME_LINEA_0_CM 0. 9. FORMAT "%1.0" /end CHARACTERISTIC
/begin CHARACTERISTIC Cxx_obd_dc_off "Number of consecutive driving cycles without failure to switch off the MI" VALUE 0xa0020b97 _REC_S1VAL_20_u1 9. _CNV_A_R_ECME_LINEA_0_CM 1. 10. FORMAT "%2.0" /end CHARACTERISTIC
/begin CHARACTERISTIC Cxx_obd_wup_thd "Number of consecutive warm-up cycles without failure to restore an OBD memorised failure" VALUE 0xa0020b98 _REC_S1VAL_20_u1 255. _CNV_A_R_ECME_LINEA_0_CM 0. 255. FORMAT "%3.0" /end CHARACTERISTIC
/begin CHARACTERISTIC Cxx_wup_dif_thd_tco "Minimum engine coolant temperature rising required to validate a warm-up cycle" VALUE 0xa0020b92 _REC_S1VAL_20_u2 240. _CNV_A_R_LINEAR_____54_CM -40. 200. FORMAT "%5.1" /end CHARACTERISTIC
/begin CHARACTERISTIC Cxx_wup_thd_tco "Minimum engine coolant temperature required to validate a warm up cycle" VALUE 0xa0020b94 _REC_S1VAL_20_u2 240. _CNV_A_R_LINEAR_____54_CM -40. 200. FORMAT "%5.1" /end CHARACTERISTIC
/begin MEASUREMENT Vxx_capture_all_nr "Current number of DTC matching the StatusMask by RSA_API_CaptureAllDTCStatus function call" UWORD _CNV_A_R_ECME_LINEA_0_CM 1 0. 0. 65535. ECU_ADDRESS 0xc0000b9a FORMAT "%5.0" /end MEASUREMENT
/begin MEASUREMENT Vxx_capture_all_pres_iter "Current last index updated by RSA_API_CaptureAllDTCStatus function" UWORD _CNV_A_R_ECME_LINEA_0_CM 1 0. 0. 65535. ECU_ADDRESS 0xc0000b9c FORMAT "%5.0" /end MEASUREMENT
/begin MEASUREMENT Vxx_capture_obd_nr "Current number of DTC matching the StatusMask by RSA_API_CaptureAllOBDDTCStatus function call" UWORD _CNV_A_R_ECME_LINEA_0_CM 1 0. 0. 65535. ECU_ADDRESS 0xc0000b9e FORMAT "%5.0" /end MEASUREMENT
/begin MEASUREMENT Vxx_capture_obd_pres_iter "Current last index updated by RSA_API_CaptureAllOBDDTCStatus function" UWORD _CNV_A_R_ECME_LINEA_0_CM 1 0. 0. 65535. ECU_ADDRESS 0xc0000ba0 FORMAT "%5.0" /end MEASUREMENT
/begin MEASUREMENT Vxx_get_ind_pres_iter "Current last index scaned by RSA_API_GetIDXByDTC function" UWORD _CNV_A_R_ECME_LINEA_0_CM 1 0. 0. 65535. ECU_ADDRESS 0xc0000ba2 FORMAT "%5.0" /end MEASUREMENT
/begin CHARACTERISTIC Ntx_data_avl_list[0] "List of supported extended data number" VALUE 0xa0020b24 _REC_S1VAL_20_u1 7. _CNV_A_R_ECME_LINEA_0_CM 128. 135. READ_ONLY FORMAT "%3.0" /end CHARACTERISTIC
/begin CHARACTERISTIC Ntx_data_avl_list[1] "List of supported extended data number" VALUE 0xa0020b25 _REC_S1VAL_20_u1 7. _CNV_A_R_ECME_LINEA_0_CM 128. 135. READ_ONLY FORMAT "%3.0" /end CHARACTERISTIC
/begin CHARACTERISTIC Ntx_data_avl_list[2] "List of supported extended data number" VALUE 0xa0020b26 _REC_S1VAL_20_u1 7. _CNV_A_R_ECME_LINEA_0_CM 128. 135. READ_ONLY FORMAT "%3.0" /end CHARACTERISTIC
/begin CHARACTERISTIC Ntx_data_avl_list[3] "List of supported extended data number" VALUE 0xa0020b27 _REC_S1VAL_20_u1 7. _CNV_A_R_ECME_LINEA_0_CM 128. 135. READ_ONLY FORMAT "%3.0" /end CHARACTERISTIC
/begin CHARACTERISTIC Ntx_data_avl_list[4] "List of supported extended data number" VALUE 0xa0020b28 _REC_S1VAL_20_u1 7. _CNV_A_R_ECME_LINEA_0_CM 128. 135. READ_ONLY FORMAT "%3.0" /end CHARACTERISTIC
/begin CHARACTERISTIC Ntx_frm_avl_list[0] "List of supported snapshot number" VALUE 0xa0020b2a _REC_S1VAL_20_u1 3. _CNV_A_R_ECME_LINEA_0_CM 1. 4. READ_ONLY FORMAT "%3.0" /end CHARACTERISTIC
/begin CHARACTERISTIC Ntx_frm_avl_list[1] "List of supported snapshot number" VALUE 0xa0020b2b _REC_S1VAL_20_u1 3. _CNV_A_R_ECME_LINEA_0_CM 1. 4. READ_ONLY FORMAT "%3.0" /end CHARACTERISTIC
/begin CHARACTERISTIC Ntx_frm_avl_list[2] "List of supported snapshot number" VALUE 0xa0020b2c _REC_S1VAL_20_u1 3. _CNV_A_R_ECME_LINEA_0_CM 1. 4. READ_ONLY FORMAT "%3.0" /end CHARACTERISTIC
/begin CHARACTERISTIC Ntx_frm_avl_list[3] "List of supported snapshot number" VALUE 0xa0020b2d _REC_S1VAL_20_u1 3. _CNV_A_R_ECME_LINEA_0_CM 1. 4. READ_ONLY FORMAT "%3.0" /end CHARACTERISTIC
/begin MEASUREMENT Vtx_fail_dc_dyn_0 "" UBYTE _CNV_A_R_A_165_CM 1 0. 0. 255. DISPLAY_IDENTIFIER fm_dyn[0].fm_dynamic_bitfield.Vtx_fail_dc_dyn ECU_ADDRESS 0xc00007a0 BIT_MASK 0x2 /end MEASUREMENT
/begin MEASUREMENT Vtx_ind_dyn_0 "" UWORD _CNV_S_690_FM_RANGE_D_225_CM 1 0. 0. 689. DISPLAY_IDENTIFIER fm_dyn[0].Vtx_ind_dyn ECU_ADDRESS 0xc00007a2 /end MEASUREMENT
/begin MEASUREMENT Vtx_fail_dc_dyn_1 "" UBYTE _CNV_A_R_A_165_CM 1 0. 0. 255. DISPLAY_IDENTIFIER fm_dyn[1].fm_dynamic_bitfield.Vtx_fail_dc_dyn ECU_ADDRESS 0xc00007a4 BIT_MASK 0x2 /end MEASUREMENT
/begin MEASUREMENT Vtx_ind_dyn_1 "" UWORD _CNV_S_690_FM_RANGE_D_225_CM 1 0. 0. 689. DISPLAY_IDENTIFIER fm_dyn[1].Vtx_ind_dyn ECU_ADDRESS 0xc00007a6 /end MEASUREMENT
/begin MEASUREMENT Vtx_fail_dc_dyn_2 "" UBYTE _CNV_A_R_A_165_CM 1 0. 0. 255. DISPLAY_IDENTIFIER fm_dyn[2].fm_dynamic_bitfield.Vtx_fail_dc_dyn ECU_ADDRESS 0xc00007a8 BIT_MASK 0x2 /end MEASUREMENT
/begin MEASUREMENT Vtx_ind_dyn_2 "" UWORD _CNV_S_690_FM_RANGE_D_225_CM 1 0. 0. 689. DISPLAY_IDENTIFIER fm_dyn[2].Vtx_ind_dyn ECU_ADDRESS 0xc00007aa /end MEASUREMENT
/begin MEASUREMENT Vtx_fail_dc_dyn_3 "" UBYTE _CNV_A_R_A_165_CM 1 0. 0. 255. DISPLAY_IDENTIFIER fm_dyn[3].fm_dynamic_bitfield.Vtx_fail_dc_dyn ECU_ADDRESS 0xc00007ac BIT_MASK 0x2 /end MEASUREMENT
/begin MEASUREMENT Vtx_ind_dyn_3 "" UWORD _CNV_S_690_FM_RANGE_D_225_CM 1 0. 0. 689. DISPLAY_IDENTIFIER fm_dyn[3].Vtx_ind_dyn ECU_ADDRESS 0xc00007ae /end MEASUREMENT
/begin MEASUREMENT Vtx_fail_dc_dyn_4 "" UBYTE _CNV_A_R_A_165_CM 1 0. 0. 255. DISPLAY_IDENTIFIER fm_dyn[4].fm_dynamic_bitfield.Vtx_fail_dc_dyn ECU_ADDRESS 0xc00007b0 BIT_MASK 0x2 /end MEASUREMENT
/begin MEASUREMENT Vtx_ind_dyn_4 "" UWORD _CNV_S_690_FM_RANGE_D_225_CM 1 0. 0. 689. DISPLAY_IDENTIFIER fm_dyn[4].Vtx_ind_dyn ECU_ADDRESS 0xc00007b2 /end MEASUREMENT
/begin MEASUREMENT Vtx_fail_dc_dyn_5 "" UBYTE _CNV_A_R_A_165_CM 1 0. 0. 255. DISPLAY_IDENTIFIER fm_dyn[5].fm_dynamic_bitfield.Vtx_fail_dc_dyn ECU_ADDRESS 0xc00007b4 BIT_MASK 0x2 /end MEASUREMENT
/begin MEASUREMENT Vtx_ind_dyn_5 "" UWORD _CNV_S_690_FM_RANGE_D_225_CM 1 0. 0. 689. DISPLAY_IDENTIFIER fm_dyn[5].Vtx_ind_dyn ECU_ADDRESS 0xc00007b6 /end MEASUREMENT
/begin MEASUREMENT Vtx_fail_dc_dyn_6 "" UBYTE _CNV_A_R_A_165_CM 1 0. 0. 255. DISPLAY_IDENTIFIER fm_dyn[6].fm_dynamic_bitfield.Vtx_fail_dc_dyn ECU_ADDRESS 0xc00007b8 BIT_MASK 0x2 /end MEASUREMENT
/begin MEASUREMENT Vtx_ind_dyn_6 "" UWORD _CNV_S_690_FM_RANGE_D_225_CM 1 0. 0. 689. DISPLAY_IDENTIFIER fm_dyn[6].Vtx_ind_dyn ECU_ADDRESS 0xc00007ba /end MEASUREMENT
/begin MEASUREMENT Vtx_fail_dc_dyn_7 "" UBYTE _CNV_A_R_A_165_CM 1 0. 0. 255. DISPLAY_IDENTIFIER fm_dyn[7].fm_dynamic_bitfield.Vtx_fail_dc_dyn ECU_ADDRESS 0xc00007bc BIT_MASK 0x2 /end MEASUREMENT
/begin MEASUREMENT Vtx_ind_dyn_7 "" UWORD _CNV_S_690_FM_RANGE_D_225_CM 1 0. 0. 689. DISPLAY_IDENTIFIER fm_dyn[7].Vtx_ind_dyn ECU_ADDRESS 0xc00007be /end MEASUREMENT
/begin MEASUREMENT Vtx_fail_dc_dyn_8 "" UBYTE _CNV_A_R_A_165_CM 1 0. 0. 255. DISPLAY_IDENTIFIER fm_dyn[8].fm_dynamic_bitfield.Vtx_fail_dc_dyn ECU_ADDRESS 0xc00007c0 BIT_MASK 0x2 /end MEASUREMENT
/begin MEASUREMENT Vtx_ind_dyn_8 "" UWORD _CNV_S_690_FM_RANGE_D_225_CM 1 0. 0. 689. DISPLAY_IDENTIFIER fm_dyn[8].Vtx_ind_dyn ECU_ADDRESS 0xc00007c2 /end MEASUREMENT
/begin MEASUREMENT Vtx_fail_dc_dyn_9 "" UBYTE _CNV_A_R_A_165_CM 1 0. 0. 255. DISPLAY_IDENTIFIER fm_dyn[9].fm_dynamic_bitfield.Vtx_fail_dc_dyn ECU_ADDRESS 0xc00007c4 BIT_MASK 0x2 /end MEASUREMENT
/begin MEASUREMENT Vtx_ind_dyn_9 "" UWORD _CNV_S_690_FM_RANGE_D_225_CM 1 0. 0. 689. DISPLAY_IDENTIFIER fm_dyn[9].Vtx_ind_dyn ECU_ADDRESS 0xc00007c6 /end MEASUREMENT
/begin MEASUREMENT Sxx_dist_fail_dyn_0 "" ULONG _CNV_A_R_LINEAR_____218_CM 1 0. 0. 16777215. DISPLAY_IDENTIFIER fm_dyn_eprm[0].Stx_dist_fail_dyn ECU_ADDRESS 0xc00007c8 FORMAT "%10.0" /end MEASUREMENT
/begin MEASUREMENT Sxx_tmp_dist_dyn_0 "" ULONG _CNV_A_R_LINEAR_____218_CM 1 0. 0. 16777215. DISPLAY_IDENTIFIER fm_dyn_eprm[0].Stx_tmp_dist_dyn ECU_ADDRESS 0xc00007cc FORMAT "%10.0" /end MEASUREMENT
/begin MEASUREMENT Sxx_km_cf_dyn_0 "" ULONG _CNV_A_R_LINEAR_____218_CM 1 0. 0. 16777215. DISPLAY_IDENTIFIER fm_dyn_eprm[0].Stx_km_cf_dyn ECU_ADDRESS 0xc00007d0 FORMAT "%10.0" /end MEASUREMENT
/begin MEASUREMENT Sxx_km_mf_dyn_0 "" ULONG _CNV_A_R_LINEAR_____218_CM 1 0. 0. 16777215. DISPLAY_IDENTIFIER fm_dyn_eprm[0].Stx_km_mf_dyn ECU_ADDRESS 0xc00007d4 FORMAT "%10.0" /end MEASUREMENT
/begin MEASUREMENT Sxx_km_pass_dyn_0 "" ULONG _CNV_A_R_LINEAR_____218_CM 1 0. 0. 16777215. DISPLAY_IDENTIFIER fm_dyn_eprm[0].Stx_km_pass_dyn ECU_ADDRESS 0xc00007d8 FORMAT "%10.0" /end MEASUREMENT
/begin MEASUREMENT Sxx_ind_dyn_0 "" UWORD _CNV_A_R_ECME_LINEA_0_CM 1 0. 0. 65535. DISPLAY_IDENTIFIER fm_dyn_eprm[0].Stx_ind_dyn ECU_ADDRESS 0xc00007dc FORMAT "%5.0" /end MEASUREMENT
/begin MEASUREMENT Sxx_ffm_esti_tqe_dyn_0 "" UWORD _CNV_A_R_LINEAR_____161_CM 1 0. -400. 1647.96875 DISPLAY_IDENTIFIER fm_dyn_eprm[0].Stx_ffm_esti_tqe_dyn ECU_ADDRESS 0xc00007de FORMAT "%10.5" /end MEASUREMENT
/begin MEASUREMENT Sxx_ffm_esti_tqe_min_dyn_0 "" UWORD _CNV_A_R_LINEAR_____161_CM 1 0. -400. 1647.96875 DISPLAY_IDENTIFIER fm_dyn_eprm[0].Stx_ffm_esti_tqe_min_dyn ECU_ADDRESS 0xc00007e0 FORMAT "%10.5" /end MEASUREMENT
/begin MEASUREMENT Sxx_ffm_esti_tqe_max_dyn_0 "" UWORD _CNV_A_R_LINEAR_____161_CM 1 0. -400. 1647.96875 DISPLAY_IDENTIFIER fm_dyn_eprm[0].Stx_ffm_esti_tqe_max_dyn ECU_ADDRESS 0xc00007e2 FORMAT "%10.5" /end MEASUREMENT
/begin MEASUREMENT Sxx_ffm_n_dyn_0 "" UWORD _CNV_A_R_ENSD_LINEA_24_CM 1 0. 0. 16383.75 DISPLAY_IDENTIFIER fm_dyn_eprm[0].Stx_ffm_n_dyn ECU_ADDRESS 0xc00007e4 FORMAT "%8.2" /end MEASUREMENT
/begin MEASUREMENT Sxx_ffm_n_min_dyn_0 "" UWORD _CNV_A_R_ENSD_LINEA_24_CM 1 0. 0. 16383.75 DISPLAY_IDENTIFIER fm_dyn_eprm[0].Stx_ffm_n_min_dyn ECU_ADDRESS 0xc00007e6 FORMAT "%8.2" /end MEASUREMENT
/begin MEASUREMENT Sxx_ffm_n_max_dyn_0 "" UWORD _CNV_A_R_ENSD_LINEA_24_CM 1 0. 0. 16383.75 DISPLAY_IDENTIFIER fm_dyn_eprm[0].Stx_ffm_n_max_dyn ECU_ADDRESS 0xc00007e8 FORMAT "%8.2" /end MEASUREMENT
/begin MEASUREMENT Sxx_ffm_tco_dyn_0 "" UWORD _CNV_A_R_LINEAR_____226_CM 1 0. -273. 6280.5 DISPLAY_IDENTIFIER fm_dyn_eprm[0].Stx_ffm_tco_dyn ECU_ADDRESS 0xc00007ea FORMAT "%6.1" /end MEASUREMENT
/begin MEASUREMENT Sxx_ffm_tco_min_dyn_0 "" UWORD _CNV_A_R_LINEAR_____226_CM 1 0. -273. 6280.5 DISPLAY_IDENTIFIER fm_dyn_eprm[0].Stx_ffm_tco_min_dyn ECU_ADDRESS 0xc00007ec FORMAT "%6.1" /end MEASUREMENT
/begin MEASUREMENT Sxx_ffm_tco_max_dyn_0 "" UWORD _CNV_A_R_LINEAR_____226_CM 1 0. -273. 6280.5 DISPLAY_IDENTIFIER fm_dyn_eprm[0].Stx_ffm_tco_max_dyn ECU_ADDRESS 0xc00007ee FORMAT "%6.1" /end MEASUREMENT
/begin MEASUREMENT Sxx_ffm_vb_dyn_0 "" UWORD _CNV_A_R_LINEAR_____150_CM 1 0. 0. 655.35 DISPLAY_IDENTIFIER fm_dyn_eprm[0].Stx_ffm_vb_dyn ECU_ADDRESS 0xc00007f0 FORMAT "%6.2" /end MEASUREMENT
/begin MEASUREMENT Sxx_ffm_vb_min_dyn_0 "" UWORD _CNV_A_R_LINEAR_____150_CM 1 0. 0. 655.35 DISPLAY_IDENTIFIER fm_dyn_eprm[0].Stx_ffm_vb_min_dyn ECU_ADDRESS 0xc00007f2 FORMAT "%6.2" /end MEASUREMENT
/begin MEASUREMENT Sxx_ffm_vb_max_dyn_0 "" UWORD _CNV_A_R_LINEAR_____150_CM 1 0. 0. 655.35 DISPLAY_IDENTIFIER fm_dyn_eprm[0].Stx_ffm_vb_max_dyn ECU_ADDRESS 0xc00007f4 FORMAT "%6.2" /end MEASUREMENT
/begin MEASUREMENT Sxx_ffm_vs_dyn_0 "" UWORD _CNV_A_R_LINEAR_____70_CM 1 0. 0. 655.35 DISPLAY_IDENTIFIER fm_dyn_eprm[0].Stx_ffm_vs_dyn ECU_ADDRESS 0xc00007f6 FORMAT "%6.2" /end MEASUREMENT
/begin MEASUREMENT Sxx_ffm_vs_min_dyn_0 "" UWORD _CNV_A_R_LINEAR_____70_CM 1 0. 0. 655.35 DISPLAY_IDENTIFIER fm_dyn_eprm[0].Stx_ffm_vs_min_dyn ECU_ADDRESS 0xc00007f8 FORMAT "%6.2" /end MEASUREMENT
/begin MEASUREMENT Sxx_ffm_vs_max_dyn_0 "" UWORD _CNV_A_R_LINEAR_____70_CM 1 0. 0. 655.35 DISPLAY_IDENTIFIER fm_dyn_eprm[0].Stx_ffm_vs_max_dyn ECU_ADDRESS 0xc00007fa FORMAT "%6.2" /end MEASUREMENT
/begin MEASUREMENT Sxx_ffm_did_1_dyn_0 "" UWORD _CNV_A_R_ECME_LINEA_0_CM 1 0. 0. 65535. DISPLAY_IDENTIFIER fm_dyn_eprm[0].Stx_ffm_did_X_dyn[0] ECU_ADDRESS 0xc00007fc FORMAT "%5.0" /end MEASUREMENT
/begin MEASUREMENT Sxx_ffm_did_2_dyn_0 "" UWORD _CNV_A_R_ECME_LINEA_0_CM 1 0. 0. 65535. DISPLAY_IDENTIFIER fm_dyn_eprm[0].Stx_ffm_did_X_dyn[1] ECU_ADDRESS 0xc00007fe FORMAT "%5.0" /end MEASUREMENT
/begin MEASUREMENT Sxx_ffm_did_3_dyn_0 "" UWORD _CNV_A_R_ECME_LINEA_0_CM 1 0. 0. 65535. DISPLAY_IDENTIFIER fm_dyn_eprm[0].Stx_ffm_did_X_dyn[2] ECU_ADDRESS 0xc0000800 FORMAT "%5.0" /end MEASUREMENT
/begin MEASUREMENT Sxx_ffm_did_4_dyn_0 "" UWORD _CNV_A_R_ECME_LINEA_0_CM 1 0. 0. 65535. DISPLAY_IDENTIFIER fm_dyn_eprm[0].Stx_ffm_did_X_dyn[3] ECU_ADDRESS 0xc0000802 FORMAT "%5.0" /end MEASUREMENT
/begin MEASUREMENT Sxx_ffm_did_5_dyn_0 "" UWORD _CNV_A_R_ECME_LINEA_0_CM 1 0. 0. 65535. DISPLAY_IDENTIFIER fm_dyn_eprm[0].Stx_ffm_did_X_dyn[4] ECU_ADDRESS 0xc0000804 FORMAT "%5.0" /end MEASUREMENT
/begin MEASUREMENT Sxx_ffm_did_1_max_dyn_0 "" UWORD _CNV_A_R_ECME_LINEA_0_CM 1 0. 0. 65535. DISPLAY_IDENTIFIER fm_dyn_eprm[0].Stx_ffm_did_X_max_dyn[0] ECU_ADDRESS 0xc0000808 FORMAT "%5.0" /end MEASUREMENT
/begin MEASUREMENT Sxx_ffm_did_2_max_dyn_0 "" UWORD _CNV_A_R_ECME_LINEA_0_CM 1 0. 0. 65535. DISPLAY_IDENTIFIER fm_dyn_eprm[0].Stx_ffm_did_X_max_dyn[1] ECU_ADDRESS 0xc000080a FORMAT "%5.0" /end MEASUREMENT
/begin MEASUREMENT Sxx_ffm_did_3_max_dyn_0 "" UWORD _CNV_A_R_ECME_LINEA_0_CM 1 0. 0. 65535. DISPLAY_IDENTIFIER fm_dyn_eprm[0].Stx_ffm_did_X_max_dyn[2] ECU_ADDRESS 0xc000080c FORMAT "%5.0" /end MEASUREMENT
/begin MEASUREMENT Sxx_ffm_did_4_max_dyn_0 "" UWORD _CNV_A_R_ECME_LINEA_0_CM 1 0. 0. 65535. DISPLAY_IDENTIFIER fm_dyn_eprm[0].Stx_ffm_did_X_max_dyn[3] ECU_ADDRESS 0xc000080e FORMAT "%5.0" /end MEASUREMENT
/begin MEASUREMENT Sxx_ffm_did_5_max_dyn_0 "" UWORD _CNV_A_R_ECME_LINEA_0_CM 1 0. 0. 65535. DISPLAY_IDENTIFIER fm_dyn_eprm[0].Stx_ffm_did_X_max_dyn[4] ECU_ADDRESS 0xc0000810 FORMAT "%5.0" /end MEASUREMENT
/begin MEASUREMENT Sxx_ffm_did_1_min_dyn_0 "" UWORD _CNV_A_R_ECME_LINEA_0_CM 1 0. 0. 65535. DISPLAY_IDENTIFIER fm_dyn_eprm[0].Stx_ffm_did_X_min_dyn[0] ECU_ADDRESS 0xc0000814 FORMAT "%5.0" /end MEASUREMENT
/begin MEASUREMENT Sxx_ffm_did_2_min_dyn_0 "" UWORD _CNV_A_R_ECME_LINEA_0_CM 1 0. 0. 65535. DISPLAY_IDENTIFIER fm_dyn_eprm[0].Stx_ffm_did_X_min_dyn[1] ECU_ADDRESS 0xc0000816 FORMAT "%5.0" /end MEASUREMENT
/begin MEASUREMENT Sxx_ffm_did_3_min_dyn_0 "" UWORD _CNV_A_R_ECME_LINEA_0_CM 1 0. 0. 65535. DISPLAY_IDENTIFIER fm_dyn_eprm[0].Stx_ffm_did_X_min_dyn[2] ECU_ADDRESS 0xc0000818 FORMAT "%5.0" /end MEASUREMENT
/begin MEASUREMENT Sxx_ffm_did_4_min_dyn_0 "" UWORD _CNV_A_R_ECME_LINEA_0_CM 1 0. 0. 65535. DISPLAY_IDENTIFIER fm_dyn_eprm[0].Stx_ffm_did_X_min_dyn[3] ECU_ADDRESS 0xc000081a FORMAT "%5.0" /end MEASUREMENT
/begin MEASUREMENT Sxx_ffm_did_5_min_dyn_0 "" UWORD _CNV_A_R_ECME_LINEA_0_CM 1 0. 0. 65535. DISPLAY_IDENTIFIER fm_dyn_eprm[0].Stx_ffm_did_X_min_dyn[4] ECU_ADDRESS 0xc000081c FORMAT "%5.0" /end MEASUREMENT
/begin MEASUREMENT Sbx_pfo_dyn_0 "" UBYTE _CNV_A_R_A_165_CM 1 0. 0. 255. DISPLAY_IDENTIFIER fm_dyn_eprm[0].fm_dynamic_eprm_bitfield.Stx_pfo_dyn ECU_ADDRESS 0xc000081e BIT_MASK 0x2 /end MEASUREMENT
/begin MEASUREMENT Sbx_mfo_dyn_0 "" UBYTE _CNV_A_R_A_165_CM 1 0. 0. 255. DISPLAY_IDENTIFIER fm_dyn_eprm[0].fm_dynamic_eprm_bitfield.Stx_mfo_dyn ECU_ADDRESS 0xc000081e BIT_MASK 0x4 /end MEASUREMENT
/begin MEASUREMENT Sbx_obd_mreq_dyn_0 "" UBYTE _CNV_A_R_A_165_CM 1 0. 0. 255. DISPLAY_IDENTIFIER fm_dyn_eprm[0].fm_dynamic_eprm_bitfield.Stx_obd_mreq_dyn ECU_ADDRESS 0xc000081e BIT_MASK 0x8 /end MEASUREMENT
/begin MEASUREMENT Sxx_obd_wctr_dyn_0 "" UBYTE _CNV_A_R_ECME_LINEA_0_CM 1 0. 0. 255. DISPLAY_IDENTIFIER fm_dyn_eprm[0].Stx_obd_wctr_dyn ECU_ADDRESS 0xc000081f FORMAT "%3.0" /end MEASUREMENT
/begin MEASUREMENT Sxx_frq_dyn_0 "" UBYTE _CNV_A_R_ECME_LINEA_0_CM 1 0. 0. 255. DISPLAY_IDENTIFIER fm_dyn_eprm[0].Stx_frq_dyn ECU_ADDRESS 0xc0000820 FORMAT "%3.0" /end MEASUREMENT
/begin MEASUREMENT Sxx_obd_clfctr_dyn_0 "" UBYTE _CNV_A_R_ECME_LINEA_0_CM 1 0. 0. 10. DISPLAY_IDENTIFIER fm_dyn_eprm[0].Stx_obd_clfctr_dyn ECU_ADDRESS 0xc0000821 FORMAT "%3.0" /end MEASUREMENT
/begin MEASUREMENT Sxx_esd_siz_dyn_0 "" UBYTE _CNV_A_R_ECME_LINEA_0_CM 1 0. 0. 255. DISPLAY_IDENTIFIER fm_dyn_eprm[0].Stx_esd_siz_dyn ECU_ADDRESS 0xc0000822 FORMAT "%3.0" /end MEASUREMENT
/begin MEASUREMENT Sxx_pri_dyn_0 "" UBYTE _CNV_A_R_ECME_LINEA_0_CM 1 0. 0. 5. DISPLAY_IDENTIFIER fm_dyn_eprm[0].Stx_pri_dyn ECU_ADDRESS 0xc0000823 FORMAT "%3.0" /end MEASUREMENT
/begin MEASUREMENT Sxx_dist_fail_dyn_1 "" ULONG _CNV_A_R_LINEAR_____218_CM 1 0. 0. 16777215. DISPLAY_IDENTIFIER fm_dyn_eprm[1].Stx_dist_fail_dyn ECU_ADDRESS 0xc0000824 FORMAT "%10.0" /end MEASUREMENT
/begin MEASUREMENT Sxx_tmp_dist_dyn_1 "" ULONG _CNV_A_R_LINEAR_____218_CM 1 0. 0. 16777215. DISPLAY_IDENTIFIER fm_dyn_eprm[1].Stx_tmp_dist_dyn ECU_ADDRESS 0xc0000828 FORMAT "%10.0" /end MEASUREMENT
/begin MEASUREMENT Sxx_km_cf_dyn_1 "" ULONG _CNV_A_R_LINEAR_____218_CM 1 0. 0. 16777215. DISPLAY_IDENTIFIER fm_dyn_eprm[1].Stx_km_cf_dyn ECU_ADDRESS 0xc000082c FORMAT "%10.0" /end MEASUREMENT
/begin MEASUREMENT Sxx_km_mf_dyn_1 "" ULONG _CNV_A_R_LINEAR_____218_CM 1 0. 0. 16777215. DISPLAY_IDENTIFIER fm_dyn_eprm[1].Stx_km_mf_dyn ECU_ADDRESS 0xc0000830 FORMAT "%10.0" /end MEASUREMENT
/begin MEASUREMENT Sxx_km_pass_dyn_1 "" ULONG _CNV_A_R_LINEAR_____218_CM 1 0. 0. 16777215. DISPLAY_IDENTIFIER fm_dyn_eprm[1].Stx_km_pass_dyn ECU_ADDRESS 0xc0000834 FORMAT "%10.0" /end MEASUREMENT
/begin MEASUREMENT Sxx_ind_dyn_1 "" UWORD _CNV_A_R_ECME_LINEA_0_CM 1 0. 0. 65535. DISPLAY_IDENTIFIER fm_dyn_eprm[1].Stx_ind_dyn ECU_ADDRESS 0xc0000838 FORMAT "%5.0" /end MEASUREMENT
/begin MEASUREMENT Sxx_ffm_esti_tqe_dyn_1 "" UWORD _CNV_A_R_LINEAR_____161_CM 1 0. -400. 1647.96875 DISPLAY_IDENTIFIER fm_dyn_eprm[1].Stx_ffm_esti_tqe_dyn ECU_ADDRESS 0xc000083a FORMAT "%10.5" /end MEASUREMENT
/begin MEASUREMENT Sxx_ffm_esti_tqe_min_dyn_1 "" UWORD _CNV_A_R_LINEAR_____161_CM 1 0. -400. 1647.96875 DISPLAY_IDENTIFIER fm_dyn_eprm[1].Stx_ffm_esti_tqe_min_dyn ECU_ADDRESS 0xc000083c FORMAT "%10.5" /end MEASUREMENT
/begin MEASUREMENT Sxx_ffm_esti_tqe_max_dyn_1 "" UWORD _CNV_A_R_LINEAR_____161_CM 1 0. -400. 1647.96875 DISPLAY_IDENTIFIER fm_dyn_eprm[1].Stx_ffm_esti_tqe_max_dyn ECU_ADDRESS 0xc000083e FORMAT "%10.5" /end MEASUREMENT
/begin MEASUREMENT Sxx_ffm_n_dyn_1 "" UWORD _CNV_A_R_ENSD_LINEA_24_CM 1 0. 0. 16383.75 DISPLAY_IDENTIFIER fm_dyn_eprm[1].Stx_ffm_n_dyn ECU_ADDRESS 0xc0000840 FORMAT "%8.2" /end MEASUREMENT
/begin MEASUREMENT Sxx_ffm_n_min_dyn_1 "" UWORD _CNV_A_R_ENSD_LINEA_24_CM 1 0. 0. 16383.75 DISPLAY_IDENTIFIER fm_dyn_eprm[1].Stx_ffm_n_min_dyn ECU_ADDRESS 0xc0000842 FORMAT "%8.2" /end MEASUREMENT
/begin MEASUREMENT Sxx_ffm_n_max_dyn_1 "" UWORD _CNV_A_R_ENSD_LINEA_24_CM 1 0. 0. 16383.75 DISPLAY_IDENTIFIER fm_dyn_eprm[1].Stx_ffm_n_max_dyn ECU_ADDRESS 0xc0000844 FORMAT "%8.2" /end MEASUREMENT
/begin MEASUREMENT Sxx_ffm_tco_dyn_1 "" UWORD _CNV_A_R_LINEAR_____226_CM 1 0. -273. 6280.5 DISPLAY_IDENTIFIER fm_dyn_eprm[1].Stx_ffm_tco_dyn ECU_ADDRESS 0xc0000846 FORMAT "%6.1" /end MEASUREMENT
/begin MEASUREMENT Sxx_ffm_tco_min_dyn_1 "" UWORD _CNV_A_R_LINEAR_____226_CM 1 0. -273. 6280.5 DISPLAY_IDENTIFIER fm_dyn_eprm[1].Stx_ffm_tco_min_dyn ECU_ADDRESS 0xc0000848 FORMAT "%6.1" /end MEASUREMENT
/begin MEASUREMENT Sxx_ffm_tco_max_dyn_1 "" UWORD _CNV_A_R_LINEAR_____226_CM 1 0. -273. 6280.5 DISPLAY_IDENTIFIER fm_dyn_eprm[1].Stx_ffm_tco_max_dyn ECU_ADDRESS 0xc000084a FORMAT "%6.1" /end MEASUREMENT
/begin MEASUREMENT Sxx_ffm_vb_dyn_1 "" UWORD _CNV_A_R_LINEAR_____150_CM 1 0. 0. 655.35 DISPLAY_IDENTIFIER fm_dyn_eprm[1].Stx_ffm_vb_dyn ECU_ADDRESS 0xc000084c FORMAT "%6.2" /end MEASUREMENT
/begin MEASUREMENT Sxx_ffm_vb_min_dyn_1 "" UWORD _CNV_A_R_LINEAR_____150_CM 1 0. 0. 655.35 DISPLAY_IDENTIFIER fm_dyn_eprm[1].Stx_ffm_vb_min_dyn ECU_ADDRESS 0xc000084e FORMAT "%6.2" /end MEASUREMENT
/begin MEASUREMENT Sxx_ffm_vb_max_dyn_1 "" UWORD _CNV_A_R_LINEAR_____150_CM 1 0. 0. 655.35 DISPLAY_IDENTIFIER fm_dyn_eprm[1].Stx_ffm_vb_max_dyn ECU_ADDRESS 0xc0000850 FORMAT "%6.2" /end MEASUREMENT
/begin MEASUREMENT Sxx_ffm_vs_dyn_1 "" UWORD _CNV_A_R_LINEAR_____70_CM 1 0. 0. 655.35 DISPLAY_IDENTIFIER fm_dyn_eprm[1].Stx_ffm_vs_dyn ECU_ADDRESS 0xc0000852 FORMAT "%6.2" /end MEASUREMENT
/begin MEASUREMENT Sxx_ffm_vs_min_dyn_1 "" UWORD _CNV_A_R_LINEAR_____70_CM 1 0. 0. 655.35 DISPLAY_IDENTIFIER fm_dyn_eprm[1].Stx_ffm_vs_min_dyn ECU_ADDRESS 0xc0000854 FORMAT "%6.2" /end MEASUREMENT
/begin MEASUREMENT Sxx_ffm_vs_max_dyn_1 "" UWORD _CNV_A_R_LINEAR_____70_CM 1 0. 0. 655.35 DISPLAY_IDENTIFIER fm_dyn_eprm[1].Stx_ffm_vs_max_dyn ECU_ADDRESS 0xc0000856 FORMAT "%6.2" /end MEASUREMENT
/begin MEASUREMENT Sxx_ffm_did_1_dyn_1 "" UWORD _CNV_A_R_ECME_LINEA_0_CM 1 0. 0. 65535. DISPLAY_IDENTIFIER fm_dyn_eprm[1].Stx_ffm_did_X_dyn[0] ECU_ADDRESS 0xc0000858 FORMAT "%5.0" /end MEASUREMENT
/begin MEASUREMENT Sxx_ffm_did_2_dyn_1 "" UWORD _CNV_A_R_ECME_LINEA_0_CM 1 0. 0. 65535. DISPLAY_IDENTIFIER fm_dyn_eprm[1].Stx_ffm_did_X_dyn[1] ECU_ADDRESS 0xc000085a FORMAT "%5.0" /end MEASUREMENT
/begin MEASUREMENT Sxx_ffm_did_3_dyn_1 "" UWORD _CNV_A_R_ECME_LINEA_0_CM 1 0. 0. 65535. DISPLAY_IDENTIFIER fm_dyn_eprm[1].Stx_ffm_did_X_dyn[2] ECU_ADDRESS 0xc000085c FORMAT "%5.0" /end MEASUREMENT
/begin MEASUREMENT Sxx_ffm_did_4_dyn_1 "" UWORD _CNV_A_R_ECME_LINEA_0_CM 1 0. 0. 65535. DISPLAY_IDENTIFIER fm_dyn_eprm[1].Stx_ffm_did_X_dyn[3] ECU_ADDRESS 0xc000085e FORMAT "%5.0" /end MEASUREMENT
/begin MEASUREMENT Sxx_ffm_did_5_dyn_1 "" UWORD _CNV_A_R_ECME_LINEA_0_CM 1 0. 0. 65535. DISPLAY_IDENTIFIER fm_dyn_eprm[1].Stx_ffm_did_X_dyn[4] ECU_ADDRESS 0xc0000860 FORMAT "%5.0" /end MEASUREMENT
/begin MEASUREMENT Sxx_ffm_did_1_max_dyn_1 "" UWORD _CNV_A_R_ECME_LINEA_0_CM 1 0. 0. 65535. DISPLAY_IDENTIFIER fm_dyn_eprm[1].Stx_ffm_did_X_max_dyn[0] ECU_ADDRESS 0xc0000864 FORMAT "%5.0" /end MEASUREMENT
/begin MEASUREMENT Sxx_ffm_did_2_max_dyn_1 "" UWORD _CNV_A_R_ECME_LINEA_0_CM 1 0. 0. 65535. DISPLAY_IDENTIFIER fm_dyn_eprm[1].Stx_ffm_did_X_max_dyn[1] ECU_ADDRESS 0xc0000866 FORMAT "%5.0" /end MEASUREMENT
/begin MEASUREMENT Sxx_ffm_did_3_max_dyn_1 "" UWORD _CNV_A_R_ECME_LINEA_0_CM 1 0. 0. 65535. DISPLAY_IDENTIFIER fm_dyn_eprm[1].Stx_ffm_did_X_max_dyn[2] ECU_ADDRESS 0xc0000868 FORMAT "%5.0" /end MEASUREMENT
/begin MEASUREMENT Sxx_ffm_did_4_max_dyn_1 "" UWORD _CNV_A_R_ECME_LINEA_0_CM 1 0. 0. 65535. DISPLAY_IDENTIFIER fm_dyn_eprm[1].Stx_ffm_did_X_max_dyn[3] ECU_ADDRESS 0xc000086a FORMAT "%5.0" /end MEASUREMENT
/begin MEASUREMENT Sxx_ffm_did_5_max_dyn_1 "" UWORD _CNV_A_R_ECME_LINEA_0_CM 1 0. 0. 65535. DISPLAY_IDENTIFIER fm_dyn_eprm[1].Stx_ffm_did_X_max_dyn[4] ECU_ADDRESS 0xc000086c FORMAT "%5.0" /end MEASUREMENT
/begin MEASUREMENT Sxx_ffm_did_1_min_dyn_1 "" UWORD _CNV_A_R_ECME_LINEA_0_CM 1 0. 0. 65535. DISPLAY_IDENTIFIER fm_dyn_eprm[1].Stx_ffm_did_X_min_dyn[0] ECU_ADDRESS 0xc0000870 FORMAT "%5.0" /end MEASUREMENT
/begin MEASUREMENT Sxx_ffm_did_2_min_dyn_1 "" UWORD _CNV_A_R_ECME_LINEA_0_CM 1 0. 0. 65535. DISPLAY_IDENTIFIER fm_dyn_eprm[1].Stx_ffm_did_X_min_dyn[1] ECU_ADDRESS 0xc0000872 FORMAT "%5.0" /end MEASUREMENT
/begin MEASUREMENT Sxx_ffm_did_3_min_dyn_1 "" UWORD _CNV_A_R_ECME_LINEA_0_CM 1 0. 0. 65535. DISPLAY_IDENTIFIER fm_dyn_eprm[1].Stx_ffm_did_X_min_dyn[2] ECU_ADDRESS 0xc0000874 FORMAT "%5.0" /end MEASUREMENT
/begin MEASUREMENT Sxx_ffm_did_4_min_dyn_1 "" UWORD _CNV_A_R_ECME_LINEA_0_CM 1 0. 0. 65535. DISPLAY_IDENTIFIER fm_dyn_eprm[1].Stx_ffm_did_X_min_dyn[3] ECU_ADDRESS 0xc0000876 FORMAT "%5.0" /end MEASUREMENT
/begin MEASUREMENT Sxx_ffm_did_5_min_dyn_1 "" UWORD _CNV_A_R_ECME_LINEA_0_CM 1 0. 0. 65535. DISPLAY_IDENTIFIER fm_dyn_eprm[1].Stx_ffm_did_X_min_dyn[4] ECU_ADDRESS 0xc0000878 FORMAT "%5.0" /end MEASUREMENT
/begin MEASUREMENT Sbx_pfo_dyn_1 "" UBYTE _CNV_A_R_A_165_CM 1 0. 0. 255. DISPLAY_IDENTIFIER fm_dyn_eprm[1].fm_dynamic_eprm_bitfield.Stx_pfo_dyn ECU_ADDRESS 0xc000087a BIT_MASK 0x2 /end MEASUREMENT
/begin MEASUREMENT Sbx_mfo_dyn_1 "" UBYTE _CNV_A_R_A_165_CM 1 0. 0. 255. DISPLAY_IDENTIFIER fm_dyn_eprm[1].fm_dynamic_eprm_bitfield.Stx_mfo_dyn ECU_ADDRESS 0xc000087a BIT_MASK 0x4 /end MEASUREMENT
/begin MEASUREMENT Sbx_obd_mreq_dyn_1 "" UBYTE _CNV_A_R_A_165_CM 1 0. 0. 255. DISPLAY_IDENTIFIER fm_dyn_eprm[1].fm_dynamic_eprm_bitfield.Stx_obd_mreq_dyn ECU_ADDRESS 0xc000087a BIT_MASK 0x8 /end MEASUREMENT
/begin MEASUREMENT Sxx_obd_wctr_dyn_1 "" UBYTE _CNV_A_R_ECME_LINEA_0_CM 1 0. 0. 255. DISPLAY_IDENTIFIER fm_dyn_eprm[1].Stx_obd_wctr_dyn ECU_ADDRESS 0xc000087b FORMAT "%3.0" /end MEASUREMENT
/begin MEASUREMENT Sxx_frq_dyn_1 "" UBYTE _CNV_A_R_ECME_LINEA_0_CM 1 0. 0. 255. DISPLAY_IDENTIFIER fm_dyn_eprm[1].Stx_frq_dyn ECU_ADDRESS 0xc000087c FORMAT "%3.0" /end MEASUREMENT
/begin MEASUREMENT Sxx_obd_clfctr_dyn_1 "" UBYTE _CNV_A_R_ECME_LINEA_0_CM 1 0. 0. 10. DISPLAY_IDENTIFIER fm_dyn_eprm[1].Stx_obd_clfctr_dyn ECU_ADDRESS 0xc000087d FORMAT "%3.0" /end MEASUREMENT
/begin MEASUREMENT Sxx_esd_siz_dyn_1 "" UBYTE _CNV_A_R_ECME_LINEA_0_CM 1 0. 0. 255. DISPLAY_IDENTIFIER fm_dyn_eprm[1].Stx_esd_siz_dyn ECU_ADDRESS 0xc000087e FORMAT "%3.0" /end MEASUREMENT
/begin MEASUREMENT Sxx_pri_dyn_1 "" UBYTE _CNV_A_R_ECME_LINEA_0_CM 1 0. 0. 5. DISPLAY_IDENTIFIER fm_dyn_eprm[1].Stx_pri_dyn ECU_ADDRESS 0xc000087f FORMAT "%3.0" /end MEASUREMENT
/begin MEASUREMENT Sxx_dist_fail_dyn_2 "" ULONG _CNV_A_R_LINEAR_____218_CM 1 0. 0. 16777215. DISPLAY_IDENTIFIER fm_dyn_eprm[2].Stx_dist_fail_dyn ECU_ADDRESS 0xc0000880 FORMAT "%10.0" /end MEASUREMENT
/begin MEASUREMENT Sxx_tmp_dist_dyn_2 "" ULONG _CNV_A_R_LINEAR_____218_CM 1 0. 0. 16777215. DISPLAY_IDENTIFIER fm_dyn_eprm[2].Stx_tmp_dist_dyn ECU_ADDRESS 0xc0000884 FORMAT "%10.0" /end MEASUREMENT
/begin MEASUREMENT Sxx_km_cf_dyn_2 "" ULONG _CNV_A_R_LINEAR_____218_CM 1 0. 0. 16777215. DISPLAY_IDENTIFIER fm_dyn_eprm[2].Stx_km_cf_dyn ECU_ADDRESS 0xc0000888 FORMAT "%10.0" /end MEASUREMENT
/begin MEASUREMENT Sxx_km_mf_dyn_2 "" ULONG _CNV_A_R_LINEAR_____218_CM 1 0. 0. 16777215. DISPLAY_IDENTIFIER fm_dyn_eprm[2].Stx_km_mf_dyn ECU_ADDRESS 0xc000088c FORMAT "%10.0" /end MEASUREMENT
/begin MEASUREMENT Sxx_km_pass_dyn_2 "" ULONG _CNV_A_R_LINEAR_____218_CM 1 0. 0. 16777215. DISPLAY_IDENTIFIER fm_dyn_eprm[2].Stx_km_pass_dyn ECU_ADDRESS 0xc0000890 FORMAT "%10.0" /end MEASUREMENT
/begin MEASUREMENT Sxx_ind_dyn_2 "" UWORD _CNV_A_R_ECME_LINEA_0_CM 1 0. 0. 65535. DISPLAY_IDENTIFIER fm_dyn_eprm[2].Stx_ind_dyn ECU_ADDRESS 0xc0000894 FORMAT "%5.0" /end MEASUREMENT
/begin MEASUREMENT Sxx_ffm_esti_tqe_dyn_2 "" UWORD _CNV_A_R_LINEAR_____161_CM 1 0. -400. 1647.96875 DISPLAY_IDENTIFIER fm_dyn_eprm[2].Stx_ffm_esti_tqe_dyn ECU_ADDRESS 0xc0000896 FORMAT "%10.5" /end MEASUREMENT
/begin MEASUREMENT Sxx_ffm_esti_tqe_min_dyn_2 "" UWORD _CNV_A_R_LINEAR_____161_CM 1 0. -400. 1647.96875 DISPLAY_IDENTIFIER fm_dyn_eprm[2].Stx_ffm_esti_tqe_min_dyn ECU_ADDRESS 0xc0000898 FORMAT "%10.5" /end MEASUREMENT
/begin MEASUREMENT Sxx_ffm_esti_tqe_max_dyn_2 "" UWORD _CNV_A_R_LINEAR_____161_CM 1 0. -400. 1647.96875 DISPLAY_IDENTIFIER fm_dyn_eprm[2].Stx_ffm_esti_tqe_max_dyn ECU_ADDRESS 0xc000089a FORMAT "%10.5" /end MEASUREMENT
/begin MEASUREMENT Sxx_ffm_n_dyn_2 "" UWORD _CNV_A_R_ENSD_LINEA_24_CM 1 0. 0. 16383.75 DISPLAY_IDENTIFIER fm_dyn_eprm[2].Stx_ffm_n_dyn ECU_ADDRESS 0xc000089c FORMAT "%8.2" /end MEASUREMENT
/begin MEASUREMENT Sxx_ffm_n_min_dyn_2 "" UWORD _CNV_A_R_ENSD_LINEA_24_CM 1 0. 0. 16383.75 DISPLAY_IDENTIFIER fm_dyn_eprm[2].Stx_ffm_n_min_dyn ECU_ADDRESS 0xc000089e FORMAT "%8.2" /end MEASUREMENT
/begin MEASUREMENT Sxx_ffm_n_max_dyn_2 "" UWORD _CNV_A_R_ENSD_LINEA_24_CM 1 0. 0. 16383.75 DISPLAY_IDENTIFIER fm_dyn_eprm[2].Stx_ffm_n_max_dyn ECU_ADDRESS 0xc00008a0 FORMAT "%8.2" /end MEASUREMENT
/begin MEASUREMENT Sxx_ffm_tco_dyn_2 "" UWORD _CNV_A_R_LINEAR_____226_CM 1 0. -273. 6280.5 DISPLAY_IDENTIFIER fm_dyn_eprm[2].Stx_ffm_tco_dyn ECU_ADDRESS 0xc00008a2 FORMAT "%6.1" /end MEASUREMENT
/begin MEASUREMENT Sxx_ffm_tco_min_dyn_2 "" UWORD _CNV_A_R_LINEAR_____226_CM 1 0. -273. 6280.5 DISPLAY_IDENTIFIER fm_dyn_eprm[2].Stx_ffm_tco_min_dyn ECU_ADDRESS 0xc00008a4 FORMAT "%6.1" /end MEASUREMENT
/begin MEASUREMENT Sxx_ffm_tco_max_dyn_2 "" UWORD _CNV_A_R_LINEAR_____226_CM 1 0. -273. 6280.5 DISPLAY_IDENTIFIER fm_dyn_eprm[2].Stx_ffm_tco_max_dyn ECU_ADDRESS 0xc00008a6 FORMAT "%6.1" /end MEASUREMENT
/begin MEASUREMENT Sxx_ffm_vb_dyn_2 "" UWORD _CNV_A_R_LINEAR_____150_CM 1 0. 0. 655.35 DISPLAY_IDENTIFIER fm_dyn_eprm[2].Stx_ffm_vb_dyn ECU_ADDRESS 0xc00008a8 FORMAT "%6.2" /end MEASUREMENT
/begin MEASUREMENT Sxx_ffm_vb_min_dyn_2 "" UWORD _CNV_A_R_LINEAR_____150_CM 1 0. 0. 655.35 DISPLAY_IDENTIFIER fm_dyn_eprm[2].Stx_ffm_vb_min_dyn ECU_ADDRESS 0xc00008aa FORMAT "%6.2" /end MEASUREMENT
/begin MEASUREMENT Sxx_ffm_vb_max_dyn_2 "" UWORD _CNV_A_R_LINEAR_____150_CM 1 0. 0. 655.35 DISPLAY_IDENTIFIER fm_dyn_eprm[2].Stx_ffm_vb_max_dyn ECU_ADDRESS 0xc00008ac FORMAT "%6.2" /end MEASUREMENT
/begin MEASUREMENT Sxx_ffm_vs_dyn_2 "" UWORD _CNV_A_R_LINEAR_____70_CM 1 0. 0. 655.35 DISPLAY_IDENTIFIER fm_dyn_eprm[2].Stx_ffm_vs_dyn ECU_ADDRESS 0xc00008ae FORMAT "%6.2" /end MEASUREMENT
/begin MEASUREMENT Sxx_ffm_vs_min_dyn_2 "" UWORD _CNV_A_R_LINEAR_____70_CM 1 0. 0. 655.35 DISPLAY_IDENTIFIER fm_dyn_eprm[2].Stx_ffm_vs_min_dyn ECU_ADDRESS 0xc00008b0 FORMAT "%6.2" /end MEASUREMENT
/begin MEASUREMENT Sxx_ffm_vs_max_dyn_2 "" UWORD _CNV_A_R_LINEAR_____70_CM 1 0. 0. 655.35 DISPLAY_IDENTIFIER fm_dyn_eprm[2].Stx_ffm_vs_max_dyn ECU_ADDRESS 0xc00008b2 FORMAT "%6.2" /end MEASUREMENT
/begin MEASUREMENT Sxx_ffm_did_1_dyn_2 "" UWORD _CNV_A_R_ECME_LINEA_0_CM 1 0. 0. 65535. DISPLAY_IDENTIFIER fm_dyn_eprm[2].Stx_ffm_did_X_dyn[0] ECU_ADDRESS 0xc00008b4 FORMAT "%5.0" /end MEASUREMENT
/begin MEASUREMENT Sxx_ffm_did_2_dyn_2 "" UWORD _CNV_A_R_ECME_LINEA_0_CM 1 0. 0. 65535. DISPLAY_IDENTIFIER fm_dyn_eprm[2].Stx_ffm_did_X_dyn[1] ECU_ADDRESS 0xc00008b6 FORMAT "%5.0" /end MEASUREMENT
/begin MEASUREMENT Sxx_ffm_did_3_dyn_2 "" UWORD _CNV_A_R_ECME_LINEA_0_CM 1 0. 0. 65535. DISPLAY_IDENTIFIER fm_dyn_eprm[2].Stx_ffm_did_X_dyn[2] ECU_ADDRESS 0xc00008b8 FORMAT "%5.0" /end MEASUREMENT
/begin MEASUREMENT Sxx_ffm_did_4_dyn_2 "" UWORD _CNV_A_R_ECME_LINEA_0_CM 1 0. 0. 65535. DISPLAY_IDENTIFIER fm_dyn_eprm[2].Stx_ffm_did_X_dyn[3] ECU_ADDRESS 0xc00008ba FORMAT "%5.0" /end MEASUREMENT
/begin MEASUREMENT Sxx_ffm_did_5_dyn_2 "" UWORD _CNV_A_R_ECME_LINEA_0_CM 1 0. 0. 65535. DISPLAY_IDENTIFIER fm_dyn_eprm[2].Stx_ffm_did_X_dyn[4] ECU_ADDRESS 0xc00008bc FORMAT "%5.0" /end MEASUREMENT
/begin MEASUREMENT Sxx_ffm_did_1_max_dyn_2 "" UWORD _CNV_A_R_ECME_LINEA_0_CM 1 0. 0. 65535. DISPLAY_IDENTIFIER fm_dyn_eprm[2].Stx_ffm_did_X_max_dyn[0] ECU_ADDRESS 0xc00008c0 FORMAT "%5.0" /end MEASUREMENT
/begin MEASUREMENT Sxx_ffm_did_2_max_dyn_2 "" UWORD _CNV_A_R_ECME_LINEA_0_CM 1 0. 0. 65535. DISPLAY_IDENTIFIER fm_dyn_eprm[2].Stx_ffm_did_X_max_dyn[1] ECU_ADDRESS 0xc00008c2 FORMAT "%5.0" /end MEASUREMENT
/begin MEASUREMENT Sxx_ffm_did_3_max_dyn_2 "" UWORD _CNV_A_R_ECME_LINEA_0_CM 1 0. 0. 65535. DISPLAY_IDENTIFIER fm_dyn_eprm[2].Stx_ffm_did_X_max_dyn[2] ECU_ADDRESS 0xc00008c4 FORMAT "%5.0" /end MEASUREMENT
/begin MEASUREMENT Sxx_ffm_did_4_max_dyn_2 "" UWORD _CNV_A_R_ECME_LINEA_0_CM 1 0. 0. 65535. DISPLAY_IDENTIFIER fm_dyn_eprm[2].Stx_ffm_did_X_max_dyn[3] ECU_ADDRESS 0xc00008c6 FORMAT "%5.0" /end MEASUREMENT
/begin MEASUREMENT Sxx_ffm_did_5_max_dyn_2 "" UWORD _CNV_A_R_ECME_LINEA_0_CM 1 0. 0. 65535. DISPLAY_IDENTIFIER fm_dyn_eprm[2].Stx_ffm_did_X_max_dyn[4] ECU_ADDRESS 0xc00008c8 FORMAT "%5.0" /end MEASUREMENT
/begin MEASUREMENT Sxx_ffm_did_1_min_dyn_2 "" UWORD _CNV_A_R_ECME_LINEA_0_CM 1 0. 0. 65535. DISPLAY_IDENTIFIER fm_dyn_eprm[2].Stx_ffm_did_X_min_dyn[0] ECU_ADDRESS 0xc00008cc FORMAT "%5.0" /end MEASUREMENT
/begin MEASUREMENT Sxx_ffm_did_2_min_dyn_2 "" UWORD _CNV_A_R_ECME_LINEA_0_CM 1 0. 0. 65535. DISPLAY_IDENTIFIER fm_dyn_eprm[2].Stx_ffm_did_X_min_dyn[1] ECU_ADDRESS 0xc00008ce FORMAT "%5.0" /end MEASUREMENT
/begin MEASUREMENT Sxx_ffm_did_3_min_dyn_2 "" UWORD _CNV_A_R_ECME_LINEA_0_CM 1 0. 0. 65535. DISPLAY_IDENTIFIER fm_dyn_eprm[2].Stx_ffm_did_X_min_dyn[2] ECU_ADDRESS 0xc00008d0 FORMAT "%5.0" /end MEASUREMENT
/begin MEASUREMENT Sxx_ffm_did_4_min_dyn_2 "" UWORD _CNV_A_R_ECME_LINEA_0_CM 1 0. 0. 65535. DISPLAY_IDENTIFIER fm_dyn_eprm[2].Stx_ffm_did_X_min_dyn[3] ECU_ADDRESS 0xc00008d2 FORMAT "%5.0" /end MEASUREMENT
/begin MEASUREMENT Sxx_ffm_did_5_min_dyn_2 "" UWORD _CNV_A_R_ECME_LINEA_0_CM 1 0. 0. 65535. DISPLAY_IDENTIFIER fm_dyn_eprm[2].Stx_ffm_did_X_min_dyn[4] ECU_ADDRESS 0xc00008d4 FORMAT "%5.0" /end MEASUREMENT
/begin MEASUREMENT Sbx_pfo_dyn_2 "" UBYTE _CNV_A_R_A_165_CM 1 0. 0. 255. DISPLAY_IDENTIFIER fm_dyn_eprm[2].fm_dynamic_eprm_bitfield.Stx_pfo_dyn ECU_ADDRESS 0xc00008d6 BIT_MASK 0x2 /end MEASUREMENT
/begin MEASUREMENT Sbx_mfo_dyn_2 "" UBYTE _CNV_A_R_A_165_CM 1 0. 0. 255. DISPLAY_IDENTIFIER fm_dyn_eprm[2].fm_dynamic_eprm_bitfield.Stx_mfo_dyn ECU_ADDRESS 0xc00008d6 BIT_MASK 0x4 /end MEASUREMENT
/begin MEASUREMENT Sbx_obd_mreq_dyn_2 "" UBYTE _CNV_A_R_A_165_CM 1 0. 0. 255. DISPLAY_IDENTIFIER fm_dyn_eprm[2].fm_dynamic_eprm_bitfield.Stx_obd_mreq_dyn ECU_ADDRESS 0xc00008d6 BIT_MASK 0x8 /end MEASUREMENT
/begin MEASUREMENT Sxx_obd_wctr_dyn_2 "" UBYTE _CNV_A_R_ECME_LINEA_0_CM 1 0. 0. 255. DISPLAY_IDENTIFIER fm_dyn_eprm[2].Stx_obd_wctr_dyn ECU_ADDRESS 0xc00008d7 FORMAT "%3.0" /end MEASUREMENT
/begin MEASUREMENT Sxx_frq_dyn_2 "" UBYTE _CNV_A_R_ECME_LINEA_0_CM 1 0. 0. 255. DISPLAY_IDENTIFIER fm_dyn_eprm[2].Stx_frq_dyn ECU_ADDRESS 0xc00008d8 FORMAT "%3.0" /end MEASUREMENT
/begin MEASUREMENT Sxx_obd_clfctr_dyn_2 "" UBYTE _CNV_A_R_ECME_LINEA_0_CM 1 0. 0. 10. DISPLAY_IDENTIFIER fm_dyn_eprm[2].Stx_obd_clfctr_dyn ECU_ADDRESS 0xc00008d9 FORMAT "%3.0" /end MEASUREMENT
/begin MEASUREMENT Sxx_esd_siz_dyn_2 "" UBYTE _CNV_A_R_ECME_LINEA_0_CM 1 0. 0. 255. DISPLAY_IDENTIFIER fm_dyn_eprm[2].Stx_esd_siz_dyn ECU_ADDRESS 0xc00008da FORMAT "%3.0" /end MEASUREMENT
/begin MEASUREMENT Sxx_pri_dyn_2 "" UBYTE _CNV_A_R_ECME_LINEA_0_CM 1 0. 0. 5. DISPLAY_IDENTIFIER fm_dyn_eprm[2].Stx_pri_dyn ECU_ADDRESS 0xc00008db FORMAT "%3.0" /end MEASUREMENT
/begin MEASUREMENT Sxx_dist_fail_dyn_3 "" ULONG _CNV_A_R_LINEAR_____218_CM 1 0. 0. 16777215. DISPLAY_IDENTIFIER fm_dyn_eprm[3].Stx_dist_fail_dyn ECU_ADDRESS 0xc00008dc FORMAT "%10.0" /end MEASUREMENT
/begin MEASUREMENT Sxx_tmp_dist_dyn_3 "" ULONG _CNV_A_R_LINEAR_____218_CM 1 0. 0. 16777215. DISPLAY_IDENTIFIER fm_dyn_eprm[3].Stx_tmp_dist_dyn ECU_ADDRESS 0xc00008e0 FORMAT "%10.0" /end MEASUREMENT
/begin MEASUREMENT Sxx_km_cf_dyn_3 "" ULONG _CNV_A_R_LINEAR_____218_CM 1 0. 0. 16777215. DISPLAY_IDENTIFIER fm_dyn_eprm[3].Stx_km_cf_dyn ECU_ADDRESS 0xc00008e4 FORMAT "%10.0" /end MEASUREMENT
/begin MEASUREMENT Sxx_km_mf_dyn_3 "" ULONG _CNV_A_R_LINEAR_____218_CM 1 0. 0. 16777215. DISPLAY_IDENTIFIER fm_dyn_eprm[3].Stx_km_mf_dyn ECU_ADDRESS 0xc00008e8 FORMAT "%10.0" /end MEASUREMENT
/begin MEASUREMENT Sxx_km_pass_dyn_3 "" ULONG _CNV_A_R_LINEAR_____218_CM 1 0. 0. 16777215. DISPLAY_IDENTIFIER fm_dyn_eprm[3].Stx_km_pass_dyn ECU_ADDRESS 0xc00008ec FORMAT "%10.0" /end MEASUREMENT
/begin MEASUREMENT Sxx_ind_dyn_3 "" UWORD _CNV_A_R_ECME_LINEA_0_CM 1 0. 0. 65535. DISPLAY_IDENTIFIER fm_dyn_eprm[3].Stx_ind_dyn ECU_ADDRESS 0xc00008f0 FORMAT "%5.0" /end MEASUREMENT
/begin MEASUREMENT Sxx_ffm_esti_tqe_dyn_3 "" UWORD _CNV_A_R_LINEAR_____161_CM 1 0. -400. 1647.96875 DISPLAY_IDENTIFIER fm_dyn_eprm[3].Stx_ffm_esti_tqe_dyn ECU_ADDRESS 0xc00008f2 FORMAT "%10.5" /end MEASUREMENT
/begin MEASUREMENT Sxx_ffm_esti_tqe_min_dyn_3 "" UWORD _CNV_A_R_LINEAR_____161_CM 1 0. -400. 1647.96875 DISPLAY_IDENTIFIER fm_dyn_eprm[3].Stx_ffm_esti_tqe_min_dyn ECU_ADDRESS 0xc00008f4 FORMAT "%10.5" /end MEASUREMENT
/begin MEASUREMENT Sxx_ffm_esti_tqe_max_dyn_3 "" UWORD _CNV_A_R_LINEAR_____161_CM 1 0. -400. 1647.96875 DISPLAY_IDENTIFIER fm_dyn_eprm[3].Stx_ffm_esti_tqe_max_dyn ECU_ADDRESS 0xc00008f6 FORMAT "%10.5" /end MEASUREMENT
/begin MEASUREMENT Sxx_ffm_n_dyn_3 "" UWORD _CNV_A_R_ENSD_LINEA_24_CM 1 0. 0. 16383.75 DISPLAY_IDENTIFIER fm_dyn_eprm[3].Stx_ffm_n_dyn ECU_ADDRESS 0xc00008f8 FORMAT "%8.2" /end MEASUREMENT
/begin MEASUREMENT Sxx_ffm_n_min_dyn_3 "" UWORD _CNV_A_R_ENSD_LINEA_24_CM 1 0. 0. 16383.75 DISPLAY_IDENTIFIER fm_dyn_eprm[3].Stx_ffm_n_min_dyn ECU_ADDRESS 0xc00008fa FORMAT "%8.2" /end MEASUREMENT
/begin MEASUREMENT Sxx_ffm_n_max_dyn_3 "" UWORD _CNV_A_R_ENSD_LINEA_24_CM 1 0. 0. 16383.75 DISPLAY_IDENTIFIER fm_dyn_eprm[3].Stx_ffm_n_max_dyn ECU_ADDRESS 0xc00008fc FORMAT "%8.2" /end MEASUREMENT
/begin MEASUREMENT Sxx_ffm_tco_dyn_3 "" UWORD _CNV_A_R_LINEAR_____226_CM 1 0. -273. 6280.5 DISPLAY_IDENTIFIER fm_dyn_eprm[3].Stx_ffm_tco_dyn ECU_ADDRESS 0xc00008fe FORMAT "%6.1" /end MEASUREMENT
/begin MEASUREMENT Sxx_ffm_tco_min_dyn_3 "" UWORD _CNV_A_R_LINEAR_____226_CM 1 0. -273. 6280.5 DISPLAY_IDENTIFIER fm_dyn_eprm[3].Stx_ffm_tco_min_dyn ECU_ADDRESS 0xc0000900 FORMAT "%6.1" /end MEASUREMENT
/begin MEASUREMENT Sxx_ffm_tco_max_dyn_3 "" UWORD _CNV_A_R_LINEAR_____226_CM 1 0. -273. 6280.5 DISPLAY_IDENTIFIER fm_dyn_eprm[3].Stx_ffm_tco_max_dyn ECU_ADDRESS 0xc0000902 FORMAT "%6.1" /end MEASUREMENT
/begin MEASUREMENT Sxx_ffm_vb_dyn_3 "" UWORD _CNV_A_R_LINEAR_____150_CM 1 0. 0. 655.35 DISPLAY_IDENTIFIER fm_dyn_eprm[3].Stx_ffm_vb_dyn ECU_ADDRESS 0xc0000904 FORMAT "%6.2" /end MEASUREMENT
/begin MEASUREMENT Sxx_ffm_vb_min_dyn_3 "" UWORD _CNV_A_R_LINEAR_____150_CM 1 0. 0. 655.35 DISPLAY_IDENTIFIER fm_dyn_eprm[3].Stx_ffm_vb_min_dyn ECU_ADDRESS 0xc0000906 FORMAT "%6.2" /end MEASUREMENT
/begin MEASUREMENT Sxx_ffm_vb_max_dyn_3 "" UWORD _CNV_A_R_LINEAR_____150_CM 1 0. 0. 655.35 DISPLAY_IDENTIFIER fm_dyn_eprm[3].Stx_ffm_vb_max_dyn ECU_ADDRESS 0xc0000908 FORMAT "%6.2" /end MEASUREMENT
/begin MEASUREMENT Sxx_ffm_vs_dyn_3 "" UWORD _CNV_A_R_LINEAR_____70_CM 1 0. 0. 655.35 DISPLAY_IDENTIFIER fm_dyn_eprm[3].Stx_ffm_vs_dyn ECU_ADDRESS 0xc000090a FORMAT "%6.2" /end MEASUREMENT
/begin MEASUREMENT Sxx_ffm_vs_min_dyn_3 "" UWORD _CNV_A_R_LINEAR_____70_CM 1 0. 0. 655.35 DISPLAY_IDENTIFIER fm_dyn_eprm[3].Stx_ffm_vs_min_dyn ECU_ADDRESS 0xc000090c FORMAT "%6.2" /end MEASUREMENT
/begin MEASUREMENT Sxx_ffm_vs_max_dyn_3 "" UWORD _CNV_A_R_LINEAR_____70_CM 1 0. 0. 655.35 DISPLAY_IDENTIFIER fm_dyn_eprm[3].Stx_ffm_vs_max_dyn ECU_ADDRESS 0xc000090e FORMAT "%6.2" /end MEASUREMENT
/begin MEASUREMENT Sxx_ffm_did_1_dyn_3 "" UWORD _CNV_A_R_ECME_LINEA_0_CM 1 0. 0. 65535. DISPLAY_IDENTIFIER fm_dyn_eprm[3].Stx_ffm_did_X_dyn[0] ECU_ADDRESS 0xc0000910 FORMAT "%5.0" /end MEASUREMENT
/begin MEASUREMENT Sxx_ffm_did_2_dyn_3 "" UWORD _CNV_A_R_ECME_LINEA_0_CM 1 0. 0. 65535. DISPLAY_IDENTIFIER fm_dyn_eprm[3].Stx_ffm_did_X_dyn[1] ECU_ADDRESS 0xc0000912 FORMAT "%5.0" /end MEASUREMENT
/begin MEASUREMENT Sxx_ffm_did_3_dyn_3 "" UWORD _CNV_A_R_ECME_LINEA_0_CM 1 0. 0. 65535. DISPLAY_IDENTIFIER fm_dyn_eprm[3].Stx_ffm_did_X_dyn[2] ECU_ADDRESS 0xc0000914 FORMAT "%5.0" /end MEASUREMENT
/begin MEASUREMENT Sxx_ffm_did_4_dyn_3 "" UWORD _CNV_A_R_ECME_LINEA_0_CM 1 0. 0. 65535. DISPLAY_IDENTIFIER fm_dyn_eprm[3].Stx_ffm_did_X_dyn[3] ECU_ADDRESS 0xc0000916 FORMAT "%5.0" /end MEASUREMENT
/begin MEASUREMENT Sxx_ffm_did_5_dyn_3 "" UWORD _CNV_A_R_ECME_LINEA_0_CM 1 0. 0. 65535. DISPLAY_IDENTIFIER fm_dyn_eprm[3].Stx_ffm_did_X_dyn[4] ECU_ADDRESS 0xc0000918 FORMAT "%5.0" /end MEASUREMENT
/begin MEASUREMENT Sxx_ffm_did_1_max_dyn_3 "" UWORD _CNV_A_R_ECME_LINEA_0_CM 1 0. 0. 65535. DISPLAY_IDENTIFIER fm_dyn_eprm[3].Stx_ffm_did_X_max_dyn[0] ECU_ADDRESS 0xc000091c FORMAT "%5.0" /end MEASUREMENT
/begin MEASUREMENT Sxx_ffm_did_2_max_dyn_3 "" UWORD _CNV_A_R_ECME_LINEA_0_CM 1 0. 0. 65535. DISPLAY_IDENTIFIER fm_dyn_eprm[3].Stx_ffm_did_X_max_dyn[1] ECU_ADDRESS 0xc000091e FORMAT "%5.0" /end MEASUREMENT
/begin MEASUREMENT Sxx_ffm_did_3_max_dyn_3 "" UWORD _CNV_A_R_ECME_LINEA_0_CM 1 0. 0. 65535. DISPLAY_IDENTIFIER fm_dyn_eprm[3].Stx_ffm_did_X_max_dyn[2] ECU_ADDRESS 0xc0000920 FORMAT "%5.0" /end MEASUREMENT
/begin MEASUREMENT Sxx_ffm_did_4_max_dyn_3 "" UWORD _CNV_A_R_ECME_LINEA_0_CM 1 0. 0. 65535. DISPLAY_IDENTIFIER fm_dyn_eprm[3].Stx_ffm_did_X_max_dyn[3] ECU_ADDRESS 0xc0000922 FORMAT "%5.0" /end MEASUREMENT
/begin MEASUREMENT Sxx_ffm_did_5_max_dyn_3 "" UWORD _CNV_A_R_ECME_LINEA_0_CM 1 0. 0. 65535. DISPLAY_IDENTIFIER fm_dyn_eprm[3].Stx_ffm_did_X_max_dyn[4] ECU_ADDRESS 0xc0000924 FORMAT "%5.0" /end MEASUREMENT
/begin MEASUREMENT Sxx_ffm_did_1_min_dyn_3 "" UWORD _CNV_A_R_ECME_LINEA_0_CM 1 0. 0. 65535. DISPLAY_IDENTIFIER fm_dyn_eprm[3].Stx_ffm_did_X_min_dyn[0] ECU_ADDRESS 0xc0000928 FORMAT "%5.0" /end MEASUREMENT
/begin MEASUREMENT Sxx_ffm_did_2_min_dyn_3 "" UWORD _CNV_A_R_ECME_LINEA_0_CM 1 0. 0. 65535. DISPLAY_IDENTIFIER fm_dyn_eprm[3].Stx_ffm_did_X_min_dyn[1] ECU_ADDRESS 0xc000092a FORMAT "%5.0" /end MEASUREMENT
/begin MEASUREMENT Sxx_ffm_did_3_min_dyn_3 "" UWORD _CNV_A_R_ECME_LINEA_0_CM 1 0. 0. 65535. DISPLAY_IDENTIFIER fm_dyn_eprm[3].Stx_ffm_did_X_min_dyn[2] ECU_ADDRESS 0xc000092c FORMAT "%5.0" /end MEASUREMENT
/begin MEASUREMENT Sxx_ffm_did_4_min_dyn_3 "" UWORD _CNV_A_R_ECME_LINEA_0_CM 1 0. 0. 65535. DISPLAY_IDENTIFIER fm_dyn_eprm[3].Stx_ffm_did_X_min_dyn[3] ECU_ADDRESS 0xc000092e FORMAT "%5.0" /end MEASUREMENT
/begin MEASUREMENT Sxx_ffm_did_5_min_dyn_3 "" UWORD _CNV_A_R_ECME_LINEA_0_CM 1 0. 0. 65535. DISPLAY_IDENTIFIER fm_dyn_eprm[3].Stx_ffm_did_X_min_dyn[4] ECU_ADDRESS 0xc0000930 FORMAT "%5.0" /end MEASUREMENT
/begin MEASUREMENT Sbx_pfo_dyn_3 "" UBYTE _CNV_A_R_A_165_CM 1 0. 0. 255. DISPLAY_IDENTIFIER fm_dyn_eprm[3].fm_dynamic_eprm_bitfield.Stx_pfo_dyn ECU_ADDRESS 0xc0000932 BIT_MASK 0x2 /end MEASUREMENT
/begin MEASUREMENT Sbx_mfo_dyn_3 "" UBYTE _CNV_A_R_A_165_CM 1 0. 0. 255. DISPLAY_IDENTIFIER fm_dyn_eprm[3].fm_dynamic_eprm_bitfield.Stx_mfo_dyn ECU_ADDRESS 0xc0000932 BIT_MASK 0x4 /end MEASUREMENT
/begin MEASUREMENT Sbx_obd_mreq_dyn_3 "" UBYTE _CNV_A_R_A_165_CM 1 0. 0. 255. DISPLAY_IDENTIFIER fm_dyn_eprm[3].fm_dynamic_eprm_bitfield.Stx_obd_mreq_dyn ECU_ADDRESS 0xc0000932 BIT_MASK 0x8 /end MEASUREMENT
/begin MEASUREMENT Sxx_obd_wctr_dyn_3 "" UBYTE _CNV_A_R_ECME_LINEA_0_CM 1 0. 0. 255. DISPLAY_IDENTIFIER fm_dyn_eprm[3].Stx_obd_wctr_dyn ECU_ADDRESS 0xc0000933 FORMAT "%3.0" /end MEASUREMENT
/begin MEASUREMENT Sxx_frq_dyn_3 "" UBYTE _CNV_A_R_ECME_LINEA_0_CM 1 0. 0. 255. DISPLAY_IDENTIFIER fm_dyn_eprm[3].Stx_frq_dyn ECU_ADDRESS 0xc0000934 FORMAT "%3.0" /end MEASUREMENT
/begin MEASUREMENT Sxx_obd_clfctr_dyn_3 "" UBYTE _CNV_A_R_ECME_LINEA_0_CM 1 0. 0. 10. DISPLAY_IDENTIFIER fm_dyn_eprm[3].Stx_obd_clfctr_dyn ECU_ADDRESS 0xc0000935 FORMAT "%3.0" /end MEASUREMENT
/begin MEASUREMENT Sxx_esd_siz_dyn_3 "" UBYTE _CNV_A_R_ECME_LINEA_0_CM 1 0. 0. 255. DISPLAY_IDENTIFIER fm_dyn_eprm[3].Stx_esd_siz_dyn ECU_ADDRESS 0xc0000936 FORMAT "%3.0" /end MEASUREMENT
/begin MEASUREMENT Sxx_pri_dyn_3 "" UBYTE _CNV_A_R_ECME_LINEA_0_CM 1 0. 0. 5. DISPLAY_IDENTIFIER fm_dyn_eprm[3].Stx_pri_dyn ECU_ADDRESS 0xc0000937 FORMAT "%3.0" /end MEASUREMENT
/begin MEASUREMENT Sxx_dist_fail_dyn_4 "" ULONG _CNV_A_R_LINEAR_____218_CM 1 0. 0. 16777215. DISPLAY_IDENTIFIER fm_dyn_eprm[4].Stx_dist_fail_dyn ECU_ADDRESS 0xc0000938 FORMAT "%10.0" /end MEASUREMENT
/begin MEASUREMENT Sxx_tmp_dist_dyn_4 "" ULONG _CNV_A_R_LINEAR_____218_CM 1 0. 0. 16777215. DISPLAY_IDENTIFIER fm_dyn_eprm[4].Stx_tmp_dist_dyn ECU_ADDRESS 0xc000093c FORMAT "%10.0" /end MEASUREMENT
/begin MEASUREMENT Sxx_km_cf_dyn_4 "" ULONG _CNV_A_R_LINEAR_____218_CM 1 0. 0. 16777215. DISPLAY_IDENTIFIER fm_dyn_eprm[4].Stx_km_cf_dyn ECU_ADDRESS 0xc0000940 FORMAT "%10.0" /end MEASUREMENT
/begin MEASUREMENT Sxx_km_mf_dyn_4 "" ULONG _CNV_A_R_LINEAR_____218_CM 1 0. 0. 16777215. DISPLAY_IDENTIFIER fm_dyn_eprm[4].Stx_km_mf_dyn ECU_ADDRESS 0xc0000944 FORMAT "%10.0" /end MEASUREMENT
/begin MEASUREMENT Sxx_km_pass_dyn_4 "" ULONG _CNV_A_R_LINEAR_____218_CM 1 0. 0. 16777215. DISPLAY_IDENTIFIER fm_dyn_eprm[4].Stx_km_pass_dyn ECU_ADDRESS 0xc0000948 FORMAT "%10.0" /end MEASUREMENT
/begin MEASUREMENT Sxx_ind_dyn_4 "" UWORD _CNV_A_R_ECME_LINEA_0_CM 1 0. 0. 65535. DISPLAY_IDENTIFIER fm_dyn_eprm[4].Stx_ind_dyn ECU_ADDRESS 0xc000094c FORMAT "%5.0" /end MEASUREMENT
/begin MEASUREMENT Sxx_ffm_esti_tqe_dyn_4 "" UWORD _CNV_A_R_LINEAR_____161_CM 1 0. -400. 1647.96875 DISPLAY_IDENTIFIER fm_dyn_eprm[4].Stx_ffm_esti_tqe_dyn ECU_ADDRESS 0xc000094e FORMAT "%10.5" /end MEASUREMENT
/begin MEASUREMENT Sxx_ffm_esti_tqe_min_dyn_4 "" UWORD _CNV_A_R_LINEAR_____161_CM 1 0. -400. 1647.96875 DISPLAY_IDENTIFIER fm_dyn_eprm[4].Stx_ffm_esti_tqe_min_dyn ECU_ADDRESS 0xc0000950 FORMAT "%10.5" /end MEASUREMENT
/begin MEASUREMENT Sxx_ffm_esti_tqe_max_dyn_4 "" UWORD _CNV_A_R_LINEAR_____161_CM 1 0. -400. 1647.96875 DISPLAY_IDENTIFIER fm_dyn_eprm[4].Stx_ffm_esti_tqe_max_dyn ECU_ADDRESS 0xc0000952 FORMAT "%10.5" /end MEASUREMENT
/begin MEASUREMENT Sxx_ffm_n_dyn_4 "" UWORD _CNV_A_R_ENSD_LINEA_24_CM 1 0. 0. 16383.75 DISPLAY_IDENTIFIER fm_dyn_eprm[4].Stx_ffm_n_dyn ECU_ADDRESS 0xc0000954 FORMAT "%8.2" /end MEASUREMENT
/begin MEASUREMENT Sxx_ffm_n_min_dyn_4 "" UWORD _CNV_A_R_ENSD_LINEA_24_CM 1 0. 0. 16383.75 DISPLAY_IDENTIFIER fm_dyn_eprm[4].Stx_ffm_n_min_dyn ECU_ADDRESS 0xc0000956 FORMAT "%8.2" /end MEASUREMENT
/begin MEASUREMENT Sxx_ffm_n_max_dyn_4 "" UWORD _CNV_A_R_ENSD_LINEA_24_CM 1 0. 0. 16383.75 DISPLAY_IDENTIFIER fm_dyn_eprm[4].Stx_ffm_n_max_dyn ECU_ADDRESS 0xc0000958 FORMAT "%8.2" /end MEASUREMENT
/begin MEASUREMENT Sxx_ffm_tco_dyn_4 "" UWORD _CNV_A_R_LINEAR_____226_CM 1 0. -273. 6280.5 DISPLAY_IDENTIFIER fm_dyn_eprm[4].Stx_ffm_tco_dyn ECU_ADDRESS 0xc000095a FORMAT "%6.1" /end MEASUREMENT
/begin MEASUREMENT Sxx_ffm_tco_min_dyn_4 "" UWORD _CNV_A_R_LINEAR_____226_CM 1 0. -273. 6280.5 DISPLAY_IDENTIFIER fm_dyn_eprm[4].Stx_ffm_tco_min_dyn ECU_ADDRESS 0xc000095c FORMAT "%6.1" /end MEASUREMENT
/begin MEASUREMENT Sxx_ffm_tco_max_dyn_4 "" UWORD _CNV_A_R_LINEAR_____226_CM 1 0. -273. 6280.5 DISPLAY_IDENTIFIER fm_dyn_eprm[4].Stx_ffm_tco_max_dyn ECU_ADDRESS 0xc000095e FORMAT "%6.1" /end MEASUREMENT
/begin MEASUREMENT Sxx_ffm_vb_dyn_4 "" UWORD _CNV_A_R_LINEAR_____150_CM 1 0. 0. 655.35 DISPLAY_IDENTIFIER fm_dyn_eprm[4].Stx_ffm_vb_dyn ECU_ADDRESS 0xc0000960 FORMAT "%6.2" /end MEASUREMENT
/begin MEASUREMENT Sxx_ffm_vb_min_dyn_4 "" UWORD _CNV_A_R_LINEAR_____150_CM 1 0. 0. 655.35 DISPLAY_IDENTIFIER fm_dyn_eprm[4].Stx_ffm_vb_min_dyn ECU_ADDRESS 0xc0000962 FORMAT "%6.2" /end MEASUREMENT
/begin MEASUREMENT Sxx_ffm_vb_max_dyn_4 "" UWORD _CNV_A_R_LINEAR_____150_CM 1 0. 0. 655.35 DISPLAY_IDENTIFIER fm_dyn_eprm[4].Stx_ffm_vb_max_dyn ECU_ADDRESS 0xc0000964 FORMAT "%6.2" /end MEASUREMENT
/begin MEASUREMENT Sxx_ffm_vs_dyn_4 "" UWORD _CNV_A_R_LINEAR_____70_CM 1 0. 0. 655.35 DISPLAY_IDENTIFIER fm_dyn_eprm[4].Stx_ffm_vs_dyn ECU_ADDRESS 0xc0000966 FORMAT "%6.2" /end MEASUREMENT
/begin MEASUREMENT Sxx_ffm_vs_min_dyn_4 "" UWORD _CNV_A_R_LINEAR_____70_CM 1 0. 0. 655.35 DISPLAY_IDENTIFIER fm_dyn_eprm[4].Stx_ffm_vs_min_dyn ECU_ADDRESS 0xc0000968 FORMAT "%6.2" /end MEASUREMENT
/begin MEASUREMENT Sxx_ffm_vs_max_dyn_4 "" UWORD _CNV_A_R_LINEAR_____70_CM 1 0. 0. 655.35 DISPLAY_IDENTIFIER fm_dyn_eprm[4].Stx_ffm_vs_max_dyn ECU_ADDRESS 0xc000096a FORMAT "%6.2" /end MEASUREMENT
/begin MEASUREMENT Sxx_ffm_did_1_dyn_4 "" UWORD _CNV_A_R_ECME_LINEA_0_CM 1 0. 0. 65535. DISPLAY_IDENTIFIER fm_dyn_eprm[4].Stx_ffm_did_X_dyn[0] ECU_ADDRESS 0xc000096c FORMAT "%5.0" /end MEASUREMENT
/begin MEASUREMENT Sxx_ffm_did_2_dyn_4 "" UWORD _CNV_A_R_ECME_LINEA_0_CM 1 0. 0. 65535. DISPLAY_IDENTIFIER fm_dyn_eprm[4].Stx_ffm_did_X_dyn[1] ECU_ADDRESS 0xc000096e FORMAT "%5.0" /end MEASUREMENT
/begin MEASUREMENT Sxx_ffm_did_3_dyn_4 "" UWORD _CNV_A_R_ECME_LINEA_0_CM 1 0. 0. 65535. DISPLAY_IDENTIFIER fm_dyn_eprm[4].Stx_ffm_did_X_dyn[2] ECU_ADDRESS 0xc0000970 FORMAT "%5.0" /end MEASUREMENT
/begin MEASUREMENT Sxx_ffm_did_4_dyn_4 "" UWORD _CNV_A_R_ECME_LINEA_0_CM 1 0. 0. 65535. DISPLAY_IDENTIFIER fm_dyn_eprm[4].Stx_ffm_did_X_dyn[3] ECU_ADDRESS 0xc0000972 FORMAT "%5.0" /end MEASUREMENT
/begin MEASUREMENT Sxx_ffm_did_5_dyn_4 "" UWORD _CNV_A_R_ECME_LINEA_0_CM 1 0. 0. 65535. DISPLAY_IDENTIFIER fm_dyn_eprm[4].Stx_ffm_did_X_dyn[4] ECU_ADDRESS 0xc0000974 FORMAT "%5.0" /end MEASUREMENT
/begin MEASUREMENT Sxx_ffm_did_1_max_dyn_4 "" UWORD _CNV_A_R_ECME_LINEA_0_CM 1 0. 0. 65535. DISPLAY_IDENTIFIER fm_dyn_eprm[4].Stx_ffm_did_X_max_dyn[0] ECU_ADDRESS 0xc0000978 FORMAT "%5.0" /end MEASUREMENT
/begin MEASUREMENT Sxx_ffm_did_2_max_dyn_4 "" UWORD _CNV_A_R_ECME_LINEA_0_CM 1 0. 0. 65535. DISPLAY_IDENTIFIER fm_dyn_eprm[4].Stx_ffm_did_X_max_dyn[1] ECU_ADDRESS 0xc000097a FORMAT "%5.0" /end MEASUREMENT
/begin MEASUREMENT Sxx_ffm_did_3_max_dyn_4 "" UWORD _CNV_A_R_ECME_LINEA_0_CM 1 0. 0. 65535. DISPLAY_IDENTIFIER fm_dyn_eprm[4].Stx_ffm_did_X_max_dyn[2] ECU_ADDRESS 0xc000097c FORMAT "%5.0" /end MEASUREMENT
/begin MEASUREMENT Sxx_ffm_did_4_max_dyn_4 "" UWORD _CNV_A_R_ECME_LINEA_0_CM 1 0. 0. 65535. DISPLAY_IDENTIFIER fm_dyn_eprm[4].Stx_ffm_did_X_max_dyn[3] ECU_ADDRESS 0xc000097e FORMAT "%5.0" /end MEASUREMENT
/begin MEASUREMENT Sxx_ffm_did_5_max_dyn_4 "" UWORD _CNV_A_R_ECME_LINEA_0_CM 1 0. 0. 65535. DISPLAY_IDENTIFIER fm_dyn_eprm[4].Stx_ffm_did_X_max_dyn[4] ECU_ADDRESS 0xc0000980 FORMAT "%5.0" /end MEASUREMENT
/begin MEASUREMENT Sxx_ffm_did_1_min_dyn_4 "" UWORD _CNV_A_R_ECME_LINEA_0_CM 1 0. 0. 65535. DISPLAY_IDENTIFIER fm_dyn_eprm[4].Stx_ffm_did_X_min_dyn[0] ECU_ADDRESS 0xc0000984 FORMAT "%5.0" /end MEASUREMENT
/begin MEASUREMENT Sxx_ffm_did_2_min_dyn_4 "" UWORD _CNV_A_R_ECME_LINEA_0_CM 1 0. 0. 65535. DISPLAY_IDENTIFIER fm_dyn_eprm[4].Stx_ffm_did_X_min_dyn[1] ECU_ADDRESS 0xc0000986 FORMAT "%5.0" /end MEASUREMENT
/begin MEASUREMENT Sxx_ffm_did_3_min_dyn_4 "" UWORD _CNV_A_R_ECME_LINEA_0_CM 1 0. 0. 65535. DISPLAY_IDENTIFIER fm_dyn_eprm[4].Stx_ffm_did_X_min_dyn[2] ECU_ADDRESS 0xc0000988 FORMAT "%5.0" /end MEASUREMENT
/begin MEASUREMENT Sxx_ffm_did_4_min_dyn_4 "" UWORD _CNV_A_R_ECME_LINEA_0_CM 1 0. 0. 65535. DISPLAY_IDENTIFIER fm_dyn_eprm[4].Stx_ffm_did_X_min_dyn[3] ECU_ADDRESS 0xc000098a FORMAT "%5.0" /end MEASUREMENT
/begin MEASUREMENT Sxx_ffm_did_5_min_dyn_4 "" UWORD _CNV_A_R_ECME_LINEA_0_CM 1 0. 0. 65535. DISPLAY_IDENTIFIER fm_dyn_eprm[4].Stx_ffm_did_X_min_dyn[4] ECU_ADDRESS 0xc000098c FORMAT "%5.0" /end MEASUREMENT
/begin MEASUREMENT Sbx_pfo_dyn_4 "" UBYTE _CNV_A_R_A_165_CM 1 0. 0. 255. DISPLAY_IDENTIFIER fm_dyn_eprm[4].fm_dynamic_eprm_bitfield.Stx_pfo_dyn ECU_ADDRESS 0xc000098e BIT_MASK 0x2 /end MEASUREMENT
/begin MEASUREMENT Sbx_mfo_dyn_4 "" UBYTE _CNV_A_R_A_165_CM 1 0. 0. 255. DISPLAY_IDENTIFIER fm_dyn_eprm[4].fm_dynamic_eprm_bitfield.Stx_mfo_dyn ECU_ADDRESS 0xc000098e BIT_MASK 0x4 /end MEASUREMENT
/begin MEASUREMENT Sbx_obd_mreq_dyn_4 "" UBYTE _CNV_A_R_A_165_CM 1 0. 0. 255. DISPLAY_IDENTIFIER fm_dyn_eprm[4].fm_dynamic_eprm_bitfield.Stx_obd_mreq_dyn ECU_ADDRESS 0xc000098e BIT_MASK 0x8 /end MEASUREMENT
/begin MEASUREMENT Sxx_obd_wctr_dyn_4 "" UBYTE _CNV_A_R_ECME_LINEA_0_CM 1 0. 0. 255. DISPLAY_IDENTIFIER fm_dyn_eprm[4].Stx_obd_wctr_dyn ECU_ADDRESS 0xc000098f FORMAT "%3.0" /end MEASUREMENT
/begin MEASUREMENT Sxx_frq_dyn_4 "" UBYTE _CNV_A_R_ECME_LINEA_0_CM 1 0. 0. 255. DISPLAY_IDENTIFIER fm_dyn_eprm[4].Stx_frq_dyn ECU_ADDRESS 0xc0000990 FORMAT "%3.0" /end MEASUREMENT
/begin MEASUREMENT Sxx_obd_clfctr_dyn_4 "" UBYTE _CNV_A_R_ECME_LINEA_0_CM 1 0. 0. 10. DISPLAY_IDENTIFIER fm_dyn_eprm[4].Stx_obd_clfctr_dyn ECU_ADDRESS 0xc0000991 FORMAT "%3.0" /end MEASUREMENT
/begin MEASUREMENT Sxx_esd_siz_dyn_4 "" UBYTE _CNV_A_R_ECME_LINEA_0_CM 1 0. 0. 255. DISPLAY_IDENTIFIER fm_dyn_eprm[4].Stx_esd_siz_dyn ECU_ADDRESS 0xc0000992 FORMAT "%3.0" /end MEASUREMENT
/begin MEASUREMENT Sxx_pri_dyn_4 "" UBYTE _CNV_A_R_ECME_LINEA_0_CM 1 0. 0. 5. DISPLAY_IDENTIFIER fm_dyn_eprm[4].Stx_pri_dyn ECU_ADDRESS 0xc0000993 FORMAT "%3.0" /end MEASUREMENT
/begin MEASUREMENT Sxx_dist_fail_dyn_5 "" ULONG _CNV_A_R_LINEAR_____218_CM 1 0. 0. 16777215. DISPLAY_IDENTIFIER fm_dyn_eprm[5].Stx_dist_fail_dyn ECU_ADDRESS 0xc0000994 FORMAT "%10.0" /end MEASUREMENT
/begin MEASUREMENT Sxx_tmp_dist_dyn_5 "" ULONG _CNV_A_R_LINEAR_____218_CM 1 0. 0. 16777215. DISPLAY_IDENTIFIER fm_dyn_eprm[5].Stx_tmp_dist_dyn ECU_ADDRESS 0xc0000998 FORMAT "%10.0" /end MEASUREMENT
/begin MEASUREMENT Sxx_km_cf_dyn_5 "" ULONG _CNV_A_R_LINEAR_____218_CM 1 0. 0. 16777215. DISPLAY_IDENTIFIER fm_dyn_eprm[5].Stx_km_cf_dyn ECU_ADDRESS 0xc000099c FORMAT "%10.0" /end MEASUREMENT
/begin MEASUREMENT Sxx_km_mf_dyn_5 "" ULONG _CNV_A_R_LINEAR_____218_CM 1 0. 0. 16777215. DISPLAY_IDENTIFIER fm_dyn_eprm[5].Stx_km_mf_dyn ECU_ADDRESS 0xc00009a0 FORMAT "%10.0" /end MEASUREMENT
/begin MEASUREMENT Sxx_km_pass_dyn_5 "" ULONG _CNV_A_R_LINEAR_____218_CM 1 0. 0. 16777215. DISPLAY_IDENTIFIER fm_dyn_eprm[5].Stx_km_pass_dyn ECU_ADDRESS 0xc00009a4 FORMAT "%10.0" /end MEASUREMENT
/begin MEASUREMENT Sxx_ind_dyn_5 "" UWORD _CNV_A_R_ECME_LINEA_0_CM 1 0. 0. 65535. DISPLAY_IDENTIFIER fm_dyn_eprm[5].Stx_ind_dyn ECU_ADDRESS 0xc00009a8 FORMAT "%5.0" /end MEASUREMENT
/begin MEASUREMENT Sxx_ffm_esti_tqe_dyn_5 "" UWORD _CNV_A_R_LINEAR_____161_CM 1 0. -400. 1647.96875 DISPLAY_IDENTIFIER fm_dyn_eprm[5].Stx_ffm_esti_tqe_dyn ECU_ADDRESS 0xc00009aa FORMAT "%10.5" /end MEASUREMENT
/begin MEASUREMENT Sxx_ffm_esti_tqe_min_dyn_5 "" UWORD _CNV_A_R_LINEAR_____161_CM 1 0. -400. 1647.96875 DISPLAY_IDENTIFIER fm_dyn_eprm[5].Stx_ffm_esti_tqe_min_dyn ECU_ADDRESS 0xc00009ac FORMAT "%10.5" /end MEASUREMENT
/begin MEASUREMENT Sxx_ffm_esti_tqe_max_dyn_5 "" UWORD _CNV_A_R_LINEAR_____161_CM 1 0. -400. 1647.96875 DISPLAY_IDENTIFIER fm_dyn_eprm[5].Stx_ffm_esti_tqe_max_dyn ECU_ADDRESS 0xc00009ae FORMAT "%10.5" /end MEASUREMENT
/begin MEASUREMENT Sxx_ffm_n_dyn_5 "" UWORD _CNV_A_R_ENSD_LINEA_24_CM 1 0. 0. 16383.75 DISPLAY_IDENTIFIER fm_dyn_eprm[5].Stx_ffm_n_dyn ECU_ADDRESS 0xc00009b0 FORMAT "%8.2" /end MEASUREMENT
/begin MEASUREMENT Sxx_ffm_n_min_dyn_5 "" UWORD _CNV_A_R_ENSD_LINEA_24_CM 1 0. 0. 16383.75 DISPLAY_IDENTIFIER fm_dyn_eprm[5].Stx_ffm_n_min_dyn ECU_ADDRESS 0xc00009b2 FORMAT "%8.2" /end MEASUREMENT
/begin MEASUREMENT Sxx_ffm_n_max_dyn_5 "" UWORD _CNV_A_R_ENSD_LINEA_24_CM 1 0. 0. 16383.75 DISPLAY_IDENTIFIER fm_dyn_eprm[5].Stx_ffm_n_max_dyn ECU_ADDRESS 0xc00009b4 FORMAT "%8.2" /end MEASUREMENT
/begin MEASUREMENT Sxx_ffm_tco_dyn_5 "" UWORD _CNV_A_R_LINEAR_____226_CM 1 0. -273. 6280.5 DISPLAY_IDENTIFIER fm_dyn_eprm[5].Stx_ffm_tco_dyn ECU_ADDRESS 0xc00009b6 FORMAT "%6.1" /end MEASUREMENT
/begin MEASUREMENT Sxx_ffm_tco_min_dyn_5 "" UWORD _CNV_A_R_LINEAR_____226_CM 1 0. -273. 6280.5 DISPLAY_IDENTIFIER fm_dyn_eprm[5].Stx_ffm_tco_min_dyn ECU_ADDRESS 0xc00009b8 FORMAT "%6.1" /end MEASUREMENT
/begin MEASUREMENT Sxx_ffm_tco_max_dyn_5 "" UWORD _CNV_A_R_LINEAR_____226_CM 1 0. -273. 6280.5 DISPLAY_IDENTIFIER fm_dyn_eprm[5].Stx_ffm_tco_max_dyn ECU_ADDRESS 0xc00009ba FORMAT "%6.1" /end MEASUREMENT
/begin MEASUREMENT Sxx_ffm_vb_dyn_5 "" UWORD _CNV_A_R_LINEAR_____150_CM 1 0. 0. 655.35 DISPLAY_IDENTIFIER fm_dyn_eprm[5].Stx_ffm_vb_dyn ECU_ADDRESS 0xc00009bc FORMAT "%6.2" /end MEASUREMENT
/begin MEASUREMENT Sxx_ffm_vb_min_dyn_5 "" UWORD _CNV_A_R_LINEAR_____150_CM 1 0. 0. 655.35 DISPLAY_IDENTIFIER fm_dyn_eprm[5].Stx_ffm_vb_min_dyn ECU_ADDRESS 0xc00009be FORMAT "%6.2" /end MEASUREMENT
/begin MEASUREMENT Sxx_ffm_vb_max_dyn_5 "" UWORD _CNV_A_R_LINEAR_____150_CM 1 0. 0. 655.35 DISPLAY_IDENTIFIER fm_dyn_eprm[5].Stx_ffm_vb_max_dyn ECU_ADDRESS 0xc00009c0 FORMAT "%6.2" /end MEASUREMENT
/begin MEASUREMENT Sxx_ffm_vs_dyn_5 "" UWORD _CNV_A_R_LINEAR_____70_CM 1 0. 0. 655.35 DISPLAY_IDENTIFIER fm_dyn_eprm[5].Stx_ffm_vs_dyn ECU_ADDRESS 0xc00009c2 FORMAT "%6.2" /end MEASUREMENT
/begin MEASUREMENT Sxx_ffm_vs_min_dyn_5 "" UWORD _CNV_A_R_LINEAR_____70_CM 1 0. 0. 655.35 DISPLAY_IDENTIFIER fm_dyn_eprm[5].Stx_ffm_vs_min_dyn ECU_ADDRESS 0xc00009c4 FORMAT "%6.2" /end MEASUREMENT
/begin MEASUREMENT Sxx_ffm_vs_max_dyn_5 "" UWORD _CNV_A_R_LINEAR_____70_CM 1 0. 0. 655.35 DISPLAY_IDENTIFIER fm_dyn_eprm[5].Stx_ffm_vs_max_dyn ECU_ADDRESS 0xc00009c6 FORMAT "%6.2" /end MEASUREMENT
/begin MEASUREMENT Sxx_ffm_did_1_dyn_5 "" UWORD _CNV_A_R_ECME_LINEA_0_CM 1 0. 0. 65535. DISPLAY_IDENTIFIER fm_dyn_eprm[5].Stx_ffm_did_X_dyn[0] ECU_ADDRESS 0xc00009c8 FORMAT "%5.0" /end MEASUREMENT
/begin MEASUREMENT Sxx_ffm_did_2_dyn_5 "" UWORD _CNV_A_R_ECME_LINEA_0_CM 1 0. 0. 65535. DISPLAY_IDENTIFIER fm_dyn_eprm[5].Stx_ffm_did_X_dyn[1] ECU_ADDRESS 0xc00009ca FORMAT "%5.0" /end MEASUREMENT
/begin MEASUREMENT Sxx_ffm_did_3_dyn_5 "" UWORD _CNV_A_R_ECME_LINEA_0_CM 1 0. 0. 65535. DISPLAY_IDENTIFIER fm_dyn_eprm[5].Stx_ffm_did_X_dyn[2] ECU_ADDRESS 0xc00009cc FORMAT "%5.0" /end MEASUREMENT
/begin MEASUREMENT Sxx_ffm_did_4_dyn_5 "" UWORD _CNV_A_R_ECME_LINEA_0_CM 1 0. 0. 65535. DISPLAY_IDENTIFIER fm_dyn_eprm[5].Stx_ffm_did_X_dyn[3] ECU_ADDRESS 0xc00009ce FORMAT "%5.0" /end MEASUREMENT
/begin MEASUREMENT Sxx_ffm_did_5_dyn_5 "" UWORD _CNV_A_R_ECME_LINEA_0_CM 1 0. 0. 65535. DISPLAY_IDENTIFIER fm_dyn_eprm[5].Stx_ffm_did_X_dyn[4] ECU_ADDRESS 0xc00009d0 FORMAT "%5.0" /end MEASUREMENT
/begin MEASUREMENT Sxx_ffm_did_1_max_dyn_5 "" UWORD _CNV_A_R_ECME_LINEA_0_CM 1 0. 0. 65535. DISPLAY_IDENTIFIER fm_dyn_eprm[5].Stx_ffm_did_X_max_dyn[0] ECU_ADDRESS 0xc00009d4 FORMAT "%5.0" /end MEASUREMENT
/begin MEASUREMENT Sxx_ffm_did_2_max_dyn_5 "" UWORD _CNV_A_R_ECME_LINEA_0_CM 1 0. 0. 65535. DISPLAY_IDENTIFIER fm_dyn_eprm[5].Stx_ffm_did_X_max_dyn[1] ECU_ADDRESS 0xc00009d6 FORMAT "%5.0" /end MEASUREMENT
/begin MEASUREMENT Sxx_ffm_did_3_max_dyn_5 "" UWORD _CNV_A_R_ECME_LINEA_0_CM 1 0. 0. 65535. DISPLAY_IDENTIFIER fm_dyn_eprm[5].Stx_ffm_did_X_max_dyn[2] ECU_ADDRESS 0xc00009d8 FORMAT "%5.0" /end MEASUREMENT
/begin MEASUREMENT Sxx_ffm_did_4_max_dyn_5 "" UWORD _CNV_A_R_ECME_LINEA_0_CM 1 0. 0. 65535. DISPLAY_IDENTIFIER fm_dyn_eprm[5].Stx_ffm_did_X_max_dyn[3] ECU_ADDRESS 0xc00009da FORMAT "%5.0" /end MEASUREMENT
/begin MEASUREMENT Sxx_ffm_did_5_max_dyn_5 "" UWORD _CNV_A_R_ECME_LINEA_0_CM 1 0. 0. 65535. DISPLAY_IDENTIFIER fm_dyn_eprm[5].Stx_ffm_did_X_max_dyn[4] ECU_ADDRESS 0xc00009dc FORMAT "%5.0" /end MEASUREMENT
/begin MEASUREMENT Sxx_ffm_did_1_min_dyn_5 "" UWORD _CNV_A_R_ECME_LINEA_0_CM 1 0. 0. 65535. DISPLAY_IDENTIFIER fm_dyn_eprm[5].Stx_ffm_did_X_min_dyn[0] ECU_ADDRESS 0xc00009e0 FORMAT "%5.0" /end MEASUREMENT
/begin MEASUREMENT Sxx_ffm_did_2_min_dyn_5 "" UWORD _CNV_A_R_ECME_LINEA_0_CM 1 0. 0. 65535. DISPLAY_IDENTIFIER fm_dyn_eprm[5].Stx_ffm_did_X_min_dyn[1] ECU_ADDRESS 0xc00009e2 FORMAT "%5.0" /end MEASUREMENT
/begin MEASUREMENT Sxx_ffm_did_3_min_dyn_5 "" UWORD _CNV_A_R_ECME_LINEA_0_CM 1 0. 0. 65535. DISPLAY_IDENTIFIER fm_dyn_eprm[5].Stx_ffm_did_X_min_dyn[2] ECU_ADDRESS 0xc00009e4 FORMAT "%5.0" /end MEASUREMENT
/begin MEASUREMENT Sxx_ffm_did_4_min_dyn_5 "" UWORD _CNV_A_R_ECME_LINEA_0_CM 1 0. 0. 65535. DISPLAY_IDENTIFIER fm_dyn_eprm[5].Stx_ffm_did_X_min_dyn[3] ECU_ADDRESS 0xc00009e6 FORMAT "%5.0" /end MEASUREMENT
/begin MEASUREMENT Sxx_ffm_did_5_min_dyn_5 "" UWORD _CNV_A_R_ECME_LINEA_0_CM 1 0. 0. 65535. DISPLAY_IDENTIFIER fm_dyn_eprm[5].Stx_ffm_did_X_min_dyn[4] ECU_ADDRESS 0xc00009e8 FORMAT "%5.0" /end MEASUREMENT
/begin MEASUREMENT Sbx_pfo_dyn_5 "" UBYTE _CNV_A_R_A_165_CM 1 0. 0. 255. DISPLAY_IDENTIFIER fm_dyn_eprm[5].fm_dynamic_eprm_bitfield.Stx_pfo_dyn ECU_ADDRESS 0xc00009ea BIT_MASK 0x2 /end MEASUREMENT
/begin MEASUREMENT Sbx_mfo_dyn_5 "" UBYTE _CNV_A_R_A_165_CM 1 0. 0. 255. DISPLAY_IDENTIFIER fm_dyn_eprm[5].fm_dynamic_eprm_bitfield.Stx_mfo_dyn ECU_ADDRESS 0xc00009ea BIT_MASK 0x4 /end MEASUREMENT
/begin MEASUREMENT Sbx_obd_mreq_dyn_5 "" UBYTE _CNV_A_R_A_165_CM 1 0. 0. 255. DISPLAY_IDENTIFIER fm_dyn_eprm[5].fm_dynamic_eprm_bitfield.Stx_obd_mreq_dyn ECU_ADDRESS 0xc00009ea BIT_MASK 0x8 /end MEASUREMENT
/begin MEASUREMENT Sxx_obd_wctr_dyn_5 "" UBYTE _CNV_A_R_ECME_LINEA_0_CM 1 0. 0. 255. DISPLAY_IDENTIFIER fm_dyn_eprm[5].Stx_obd_wctr_dyn ECU_ADDRESS 0xc00009eb FORMAT "%3.0" /end MEASUREMENT
/begin MEASUREMENT Sxx_frq_dyn_5 "" UBYTE _CNV_A_R_ECME_LINEA_0_CM 1 0. 0. 255. DISPLAY_IDENTIFIER fm_dyn_eprm[5].Stx_frq_dyn ECU_ADDRESS 0xc00009ec FORMAT "%3.0" /end MEASUREMENT
/begin MEASUREMENT Sxx_obd_clfctr_dyn_5 "" UBYTE _CNV_A_R_ECME_LINEA_0_CM 1 0. 0. 10. DISPLAY_IDENTIFIER fm_dyn_eprm[5].Stx_obd_clfctr_dyn ECU_ADDRESS 0xc00009ed FORMAT "%3.0" /end MEASUREMENT
/begin MEASUREMENT Sxx_esd_siz_dyn_5 "" UBYTE _CNV_A_R_ECME_LINEA_0_CM 1 0. 0. 255. DISPLAY_IDENTIFIER fm_dyn_eprm[5].Stx_esd_siz_dyn ECU_ADDRESS 0xc00009ee FORMAT "%3.0" /end MEASUREMENT
/begin MEASUREMENT Sxx_pri_dyn_5 "" UBYTE _CNV_A_R_ECME_LINEA_0_CM 1 0. 0. 5. DISPLAY_IDENTIFIER fm_dyn_eprm[5].Stx_pri_dyn ECU_ADDRESS 0xc00009ef FORMAT "%3.0" /end MEASUREMENT
/begin MEASUREMENT Sxx_dist_fail_dyn_6 "" ULONG _CNV_A_R_LINEAR_____218_CM 1 0. 0. 16777215. DISPLAY_IDENTIFIER fm_dyn_eprm[6].Stx_dist_fail_dyn ECU_ADDRESS 0xc00009f0 FORMAT "%10.0" /end MEASUREMENT
/begin MEASUREMENT Sxx_tmp_dist_dyn_6 "" ULONG _CNV_A_R_LINEAR_____218_CM 1 0. 0. 16777215. DISPLAY_IDENTIFIER fm_dyn_eprm[6].Stx_tmp_dist_dyn ECU_ADDRESS 0xc00009f4 FORMAT "%10.0" /end MEASUREMENT
/begin MEASUREMENT Sxx_km_cf_dyn_6 "" ULONG _CNV_A_R_LINEAR_____218_CM 1 0. 0. 16777215. DISPLAY_IDENTIFIER fm_dyn_eprm[6].Stx_km_cf_dyn ECU_ADDRESS 0xc00009f8 FORMAT "%10.0" /end MEASUREMENT
/begin MEASUREMENT Sxx_km_mf_dyn_6 "" ULONG _CNV_A_R_LINEAR_____218_CM 1 0. 0. 16777215. DISPLAY_IDENTIFIER fm_dyn_eprm[6].Stx_km_mf_dyn ECU_ADDRESS 0xc00009fc FORMAT "%10.0" /end MEASUREMENT
/begin MEASUREMENT Sxx_km_pass_dyn_6 "" ULONG _CNV_A_R_LINEAR_____218_CM 1 0. 0. 16777215. DISPLAY_IDENTIFIER fm_dyn_eprm[6].Stx_km_pass_dyn ECU_ADDRESS 0xc0000a00 FORMAT "%10.0" /end MEASUREMENT
/begin MEASUREMENT Sxx_ind_dyn_6 "" UWORD _CNV_A_R_ECME_LINEA_0_CM 1 0. 0. 65535. DISPLAY_IDENTIFIER fm_dyn_eprm[6].Stx_ind_dyn ECU_ADDRESS 0xc0000a04 FORMAT "%5.0" /end MEASUREMENT
/begin MEASUREMENT Sxx_ffm_esti_tqe_dyn_6 "" UWORD _CNV_A_R_LINEAR_____161_CM 1 0. -400. 1647.96875 DISPLAY_IDENTIFIER fm_dyn_eprm[6].Stx_ffm_esti_tqe_dyn ECU_ADDRESS 0xc0000a06 FORMAT "%10.5" /end MEASUREMENT
/begin MEASUREMENT Sxx_ffm_esti_tqe_min_dyn_6 "" UWORD _CNV_A_R_LINEAR_____161_CM 1 0. -400. 1647.96875 DISPLAY_IDENTIFIER fm_dyn_eprm[6].Stx_ffm_esti_tqe_min_dyn ECU_ADDRESS 0xc0000a08 FORMAT "%10.5" /end MEASUREMENT
/begin MEASUREMENT Sxx_ffm_esti_tqe_max_dyn_6 "" UWORD _CNV_A_R_LINEAR_____161_CM 1 0. -400. 1647.96875 DISPLAY_IDENTIFIER fm_dyn_eprm[6].Stx_ffm_esti_tqe_max_dyn ECU_ADDRESS 0xc0000a0a FORMAT "%10.5" /end MEASUREMENT
/begin MEASUREMENT Sxx_ffm_n_dyn_6 "" UWORD _CNV_A_R_ENSD_LINEA_24_CM 1 0. 0. 16383.75 DISPLAY_IDENTIFIER fm_dyn_eprm[6].Stx_ffm_n_dyn ECU_ADDRESS 0xc0000a0c FORMAT "%8.2" /end MEASUREMENT
/begin MEASUREMENT Sxx_ffm_n_min_dyn_6 "" UWORD _CNV_A_R_ENSD_LINEA_24_CM 1 0. 0. 16383.75 DISPLAY_IDENTIFIER fm_dyn_eprm[6].Stx_ffm_n_min_dyn ECU_ADDRESS 0xc0000a0e FORMAT "%8.2" /end MEASUREMENT
/begin MEASUREMENT Sxx_ffm_n_max_dyn_6 "" UWORD _CNV_A_R_ENSD_LINEA_24_CM 1 0. 0. 16383.75 DISPLAY_IDENTIFIER fm_dyn_eprm[6].Stx_ffm_n_max_dyn ECU_ADDRESS 0xc0000a10 FORMAT "%8.2" /end MEASUREMENT
/begin MEASUREMENT Sxx_ffm_tco_dyn_6 "" UWORD _CNV_A_R_LINEAR_____226_CM 1 0. -273. 6280.5 DISPLAY_IDENTIFIER fm_dyn_eprm[6].Stx_ffm_tco_dyn ECU_ADDRESS 0xc0000a12 FORMAT "%6.1" /end MEASUREMENT
/begin MEASUREMENT Sxx_ffm_tco_min_dyn_6 "" UWORD _CNV_A_R_LINEAR_____226_CM 1 0. -273. 6280.5 DISPLAY_IDENTIFIER fm_dyn_eprm[6].Stx_ffm_tco_min_dyn ECU_ADDRESS 0xc0000a14 FORMAT "%6.1" /end MEASUREMENT
/begin MEASUREMENT Sxx_ffm_tco_max_dyn_6 "" UWORD _CNV_A_R_LINEAR_____226_CM 1 0. -273. 6280.5 DISPLAY_IDENTIFIER fm_dyn_eprm[6].Stx_ffm_tco_max_dyn ECU_ADDRESS 0xc0000a16 FORMAT "%6.1" /end MEASUREMENT
/begin MEASUREMENT Sxx_ffm_vb_dyn_6 "" UWORD _CNV_A_R_LINEAR_____150_CM 1 0. 0. 655.35 DISPLAY_IDENTIFIER fm_dyn_eprm[6].Stx_ffm_vb_dyn ECU_ADDRESS 0xc0000a18 FORMAT "%6.2" /end MEASUREMENT
/begin MEASUREMENT Sxx_ffm_vb_min_dyn_6 "" UWORD _CNV_A_R_LINEAR_____150_CM 1 0. 0. 655.35 DISPLAY_IDENTIFIER fm_dyn_eprm[6].Stx_ffm_vb_min_dyn ECU_ADDRESS 0xc0000a1a FORMAT "%6.2" /end MEASUREMENT
/begin MEASUREMENT Sxx_ffm_vb_max_dyn_6 "" UWORD _CNV_A_R_LINEAR_____150_CM 1 0. 0. 655.35 DISPLAY_IDENTIFIER fm_dyn_eprm[6].Stx_ffm_vb_max_dyn ECU_ADDRESS 0xc0000a1c FORMAT "%6.2" /end MEASUREMENT
/begin MEASUREMENT Sxx_ffm_vs_dyn_6 "" UWORD _CNV_A_R_LINEAR_____70_CM 1 0. 0. 655.35 DISPLAY_IDENTIFIER fm_dyn_eprm[6].Stx_ffm_vs_dyn ECU_ADDRESS 0xc0000a1e FORMAT "%6.2" /end MEASUREMENT
/begin MEASUREMENT Sxx_ffm_vs_min_dyn_6 "" UWORD _CNV_A_R_LINEAR_____70_CM 1 0. 0. 655.35 DISPLAY_IDENTIFIER fm_dyn_eprm[6].Stx_ffm_vs_min_dyn ECU_ADDRESS 0xc0000a20 FORMAT "%6.2" /end MEASUREMENT
/begin MEASUREMENT Sxx_ffm_vs_max_dyn_6 "" UWORD _CNV_A_R_LINEAR_____70_CM 1 0. 0. 655.35 DISPLAY_IDENTIFIER fm_dyn_eprm[6].Stx_ffm_vs_max_dyn ECU_ADDRESS 0xc0000a22 FORMAT "%6.2" /end MEASUREMENT
/begin MEASUREMENT Sxx_ffm_did_1_dyn_6 "" UWORD _CNV_A_R_ECME_LINEA_0_CM 1 0. 0. 65535. DISPLAY_IDENTIFIER fm_dyn_eprm[6].Stx_ffm_did_X_dyn[0] ECU_ADDRESS 0xc0000a24 FORMAT "%5.0" /end MEASUREMENT
/begin MEASUREMENT Sxx_ffm_did_2_dyn_6 "" UWORD _CNV_A_R_ECME_LINEA_0_CM 1 0. 0. 65535. DISPLAY_IDENTIFIER fm_dyn_eprm[6].Stx_ffm_did_X_dyn[1] ECU_ADDRESS 0xc0000a26 FORMAT "%5.0" /end MEASUREMENT
/begin MEASUREMENT Sxx_ffm_did_3_dyn_6 "" UWORD _CNV_A_R_ECME_LINEA_0_CM 1 0. 0. 65535. DISPLAY_IDENTIFIER fm_dyn_eprm[6].Stx_ffm_did_X_dyn[2] ECU_ADDRESS 0xc0000a28 FORMAT "%5.0" /end MEASUREMENT
/begin MEASUREMENT Sxx_ffm_did_4_dyn_6 "" UWORD _CNV_A_R_ECME_LINEA_0_CM 1 0. 0. 65535. DISPLAY_IDENTIFIER fm_dyn_eprm[6].Stx_ffm_did_X_dyn[3] ECU_ADDRESS 0xc0000a2a FORMAT "%5.0" /end MEASUREMENT
/begin MEASUREMENT Sxx_ffm_did_5_dyn_6 "" UWORD _CNV_A_R_ECME_LINEA_0_CM 1 0. 0. 65535. DISPLAY_IDENTIFIER fm_dyn_eprm[6].Stx_ffm_did_X_dyn[4] ECU_ADDRESS 0xc0000a2c FORMAT "%5.0" /end MEASUREMENT
/begin MEASUREMENT Sxx_ffm_did_1_max_dyn_6 "" UWORD _CNV_A_R_ECME_LINEA_0_CM 1 0. 0. 65535. DISPLAY_IDENTIFIER fm_dyn_eprm[6].Stx_ffm_did_X_max_dyn[0] ECU_ADDRESS 0xc0000a30 FORMAT "%5.0" /end MEASUREMENT
/begin MEASUREMENT Sxx_ffm_did_2_max_dyn_6 "" UWORD _CNV_A_R_ECME_LINEA_0_CM 1 0. 0. 65535. DISPLAY_IDENTIFIER fm_dyn_eprm[6].Stx_ffm_did_X_max_dyn[1] ECU_ADDRESS 0xc0000a32 FORMAT "%5.0" /end MEASUREMENT
/begin MEASUREMENT Sxx_ffm_did_3_max_dyn_6 "" UWORD _CNV_A_R_ECME_LINEA_0_CM 1 0. 0. 65535. DISPLAY_IDENTIFIER fm_dyn_eprm[6].Stx_ffm_did_X_max_dyn[2] ECU_ADDRESS 0xc0000a34 FORMAT "%5.0" /end MEASUREMENT
/begin MEASUREMENT Sxx_ffm_did_4_max_dyn_6 "" UWORD _CNV_A_R_ECME_LINEA_0_CM 1 0. 0. 65535. DISPLAY_IDENTIFIER fm_dyn_eprm[6].Stx_ffm_did_X_max_dyn[3] ECU_ADDRESS 0xc0000a36 FORMAT "%5.0" /end MEASUREMENT
/begin MEASUREMENT Sxx_ffm_did_5_max_dyn_6 "" UWORD _CNV_A_R_ECME_LINEA_0_CM 1 0. 0. 65535. DISPLAY_IDENTIFIER fm_dyn_eprm[6].Stx_ffm_did_X_max_dyn[4] ECU_ADDRESS 0xc0000a38 FORMAT "%5.0" /end MEASUREMENT
/begin MEASUREMENT Sxx_ffm_did_1_min_dyn_6 "" UWORD _CNV_A_R_ECME_LINEA_0_CM 1 0. 0. 65535. DISPLAY_IDENTIFIER fm_dyn_eprm[6].Stx_ffm_did_X_min_dyn[0] ECU_ADDRESS 0xc0000a3c FORMAT "%5.0" /end MEASUREMENT
/begin MEASUREMENT Sxx_ffm_did_2_min_dyn_6 "" UWORD _CNV_A_R_ECME_LINEA_0_CM 1 0. 0. 65535. DISPLAY_IDENTIFIER fm_dyn_eprm[6].Stx_ffm_did_X_min_dyn[1] ECU_ADDRESS 0xc0000a3e FORMAT "%5.0" /end MEASUREMENT
/begin MEASUREMENT Sxx_ffm_did_3_min_dyn_6 "" UWORD _CNV_A_R_ECME_LINEA_0_CM 1 0. 0. 65535. DISPLAY_IDENTIFIER fm_dyn_eprm[6].Stx_ffm_did_X_min_dyn[2] ECU_ADDRESS 0xc0000a40 FORMAT "%5.0" /end MEASUREMENT
/begin MEASUREMENT Sxx_ffm_did_4_min_dyn_6 "" UWORD _CNV_A_R_ECME_LINEA_0_CM 1 0. 0. 65535. DISPLAY_IDENTIFIER fm_dyn_eprm[6].Stx_ffm_did_X_min_dyn[3] ECU_ADDRESS 0xc0000a42 FORMAT "%5.0" /end MEASUREMENT
/begin MEASUREMENT Sxx_ffm_did_5_min_dyn_6 "" UWORD _CNV_A_R_ECME_LINEA_0_CM 1 0. 0. 65535. DISPLAY_IDENTIFIER fm_dyn_eprm[6].Stx_ffm_did_X_min_dyn[4] ECU_ADDRESS 0xc0000a44 FORMAT "%5.0" /end MEASUREMENT
/begin MEASUREMENT Sbx_pfo_dyn_6 "" UBYTE _CNV_A_R_A_165_CM 1 0. 0. 255. DISPLAY_IDENTIFIER fm_dyn_eprm[6].fm_dynamic_eprm_bitfield.Stx_pfo_dyn ECU_ADDRESS 0xc0000a46 BIT_MASK 0x2 /end MEASUREMENT
/begin MEASUREMENT Sbx_mfo_dyn_6 "" UBYTE _CNV_A_R_A_165_CM 1 0. 0. 255. DISPLAY_IDENTIFIER fm_dyn_eprm[6].fm_dynamic_eprm_bitfield.Stx_mfo_dyn ECU_ADDRESS 0xc0000a46 BIT_MASK 0x4 /end MEASUREMENT
/begin MEASUREMENT Sbx_obd_mreq_dyn_6 "" UBYTE _CNV_A_R_A_165_CM 1 0. 0. 255. DISPLAY_IDENTIFIER fm_dyn_eprm[6].fm_dynamic_eprm_bitfield.Stx_obd_mreq_dyn ECU_ADDRESS 0xc0000a46 BIT_MASK 0x8 /end MEASUREMENT
/begin MEASUREMENT Sxx_obd_wctr_dyn_6 "" UBYTE _CNV_A_R_ECME_LINEA_0_CM 1 0. 0. 255. DISPLAY_IDENTIFIER fm_dyn_eprm[6].Stx_obd_wctr_dyn ECU_ADDRESS 0xc0000a47 FORMAT "%3.0" /end MEASUREMENT
/begin MEASUREMENT Sxx_frq_dyn_6 "" UBYTE _CNV_A_R_ECME_LINEA_0_CM 1 0. 0. 255. DISPLAY_IDENTIFIER fm_dyn_eprm[6].Stx_frq_dyn ECU_ADDRESS 0xc0000a48 FORMAT "%3.0" /end MEASUREMENT
/begin MEASUREMENT Sxx_obd_clfctr_dyn_6 "" UBYTE _CNV_A_R_ECME_LINEA_0_CM 1 0. 0. 10. DISPLAY_IDENTIFIER fm_dyn_eprm[6].Stx_obd_clfctr_dyn ECU_ADDRESS 0xc0000a49 FORMAT "%3.0" /end MEASUREMENT
/begin MEASUREMENT Sxx_esd_siz_dyn_6 "" UBYTE _CNV_A_R_ECME_LINEA_0_CM 1 0. 0. 255. DISPLAY_IDENTIFIER fm_dyn_eprm[6].Stx_esd_siz_dyn ECU_ADDRESS 0xc0000a4a FORMAT "%3.0" /end MEASUREMENT
/begin MEASUREMENT Sxx_pri_dyn_6 "" UBYTE _CNV_A_R_ECME_LINEA_0_CM 1 0. 0. 5. DISPLAY_IDENTIFIER fm_dyn_eprm[6].Stx_pri_dyn ECU_ADDRESS 0xc0000a4b FORMAT "%3.0" /end MEASUREMENT
/begin MEASUREMENT Sxx_dist_fail_dyn_7 "" ULONG _CNV_A_R_LINEAR_____218_CM 1 0. 0. 16777215. DISPLAY_IDENTIFIER fm_dyn_eprm[7].Stx_dist_fail_dyn ECU_ADDRESS 0xc0000a4c FORMAT "%10.0" /end MEASUREMENT
/begin MEASUREMENT Sxx_tmp_dist_dyn_7 "" ULONG _CNV_A_R_LINEAR_____218_CM 1 0. 0. 16777215. DISPLAY_IDENTIFIER fm_dyn_eprm[7].Stx_tmp_dist_dyn ECU_ADDRESS 0xc0000a50 FORMAT "%10.0" /end MEASUREMENT
/begin MEASUREMENT Sxx_km_cf_dyn_7 "" ULONG _CNV_A_R_LINEAR_____218_CM 1 0. 0. 16777215. DISPLAY_IDENTIFIER fm_dyn_eprm[7].Stx_km_cf_dyn ECU_ADDRESS 0xc0000a54 FORMAT "%10.0" /end MEASUREMENT
/begin MEASUREMENT Sxx_km_mf_dyn_7 "" ULONG _CNV_A_R_LINEAR_____218_CM 1 0. 0. 16777215. DISPLAY_IDENTIFIER fm_dyn_eprm[7].Stx_km_mf_dyn ECU_ADDRESS 0xc0000a58 FORMAT "%10.0" /end MEASUREMENT
/begin MEASUREMENT Sxx_km_pass_dyn_7 "" ULONG _CNV_A_R_LINEAR_____218_CM 1 0. 0. 16777215. DISPLAY_IDENTIFIER fm_dyn_eprm[7].Stx_km_pass_dyn ECU_ADDRESS 0xc0000a5c FORMAT "%10.0" /end MEASUREMENT
/begin MEASUREMENT Sxx_ind_dyn_7 "" UWORD _CNV_A_R_ECME_LINEA_0_CM 1 0. 0. 65535. DISPLAY_IDENTIFIER fm_dyn_eprm[7].Stx_ind_dyn ECU_ADDRESS 0xc0000a60 FORMAT "%5.0" /end MEASUREMENT
/begin MEASUREMENT Sxx_ffm_esti_tqe_dyn_7 "" UWORD _CNV_A_R_LINEAR_____161_CM 1 0. -400. 1647.96875 DISPLAY_IDENTIFIER fm_dyn_eprm[7].Stx_ffm_esti_tqe_dyn ECU_ADDRESS 0xc0000a62 FORMAT "%10.5" /end MEASUREMENT
/begin MEASUREMENT Sxx_ffm_esti_tqe_min_dyn_7 "" UWORD _CNV_A_R_LINEAR_____161_CM 1 0. -400. 1647.96875 DISPLAY_IDENTIFIER fm_dyn_eprm[7].Stx_ffm_esti_tqe_min_dyn ECU_ADDRESS 0xc0000a64 FORMAT "%10.5" /end MEASUREMENT
/begin MEASUREMENT Sxx_ffm_esti_tqe_max_dyn_7 "" UWORD _CNV_A_R_LINEAR_____161_CM 1 0. -400. 1647.96875 DISPLAY_IDENTIFIER fm_dyn_eprm[7].Stx_ffm_esti_tqe_max_dyn ECU_ADDRESS 0xc0000a66 FORMAT "%10.5" /end MEASUREMENT
/begin MEASUREMENT Sxx_ffm_n_dyn_7 "" UWORD _CNV_A_R_ENSD_LINEA_24_CM 1 0. 0. 16383.75 DISPLAY_IDENTIFIER fm_dyn_eprm[7].Stx_ffm_n_dyn ECU_ADDRESS 0xc0000a68 FORMAT "%8.2" /end MEASUREMENT
/begin MEASUREMENT Sxx_ffm_n_min_dyn_7 "" UWORD _CNV_A_R_ENSD_LINEA_24_CM 1 0. 0. 16383.75 DISPLAY_IDENTIFIER fm_dyn_eprm[7].Stx_ffm_n_min_dyn ECU_ADDRESS 0xc0000a6a FORMAT "%8.2" /end MEASUREMENT
/begin MEASUREMENT Sxx_ffm_n_max_dyn_7 "" UWORD _CNV_A_R_ENSD_LINEA_24_CM 1 0. 0. 16383.75 DISPLAY_IDENTIFIER fm_dyn_eprm[7].Stx_ffm_n_max_dyn ECU_ADDRESS 0xc0000a6c FORMAT "%8.2" /end MEASUREMENT
/begin MEASUREMENT Sxx_ffm_tco_dyn_7 "" UWORD _CNV_A_R_LINEAR_____226_CM 1 0. -273. 6280.5 DISPLAY_IDENTIFIER fm_dyn_eprm[7].Stx_ffm_tco_dyn ECU_ADDRESS 0xc0000a6e FORMAT "%6.1" /end MEASUREMENT
/begin MEASUREMENT Sxx_ffm_tco_min_dyn_7 "" UWORD _CNV_A_R_LINEAR_____226_CM 1 0. -273. 6280.5 DISPLAY_IDENTIFIER fm_dyn_eprm[7].Stx_ffm_tco_min_dyn ECU_ADDRESS 0xc0000a70 FORMAT "%6.1" /end MEASUREMENT
/begin MEASUREMENT Sxx_ffm_tco_max_dyn_7 "" UWORD _CNV_A_R_LINEAR_____226_CM 1 0. -273. 6280.5 DISPLAY_IDENTIFIER fm_dyn_eprm[7].Stx_ffm_tco_max_dyn ECU_ADDRESS 0xc0000a72 FORMAT "%6.1" /end MEASUREMENT
/begin MEASUREMENT Sxx_ffm_vb_dyn_7 "" UWORD _CNV_A_R_LINEAR_____150_CM 1 0. 0. 655.35 DISPLAY_IDENTIFIER fm_dyn_eprm[7].Stx_ffm_vb_dyn ECU_ADDRESS 0xc0000a74 FORMAT "%6.2" /end MEASUREMENT
/begin MEASUREMENT Sxx_ffm_vb_min_dyn_7 "" UWORD _CNV_A_R_LINEAR_____150_CM 1 0. 0. 655.35 DISPLAY_IDENTIFIER fm_dyn_eprm[7].Stx_ffm_vb_min_dyn ECU_ADDRESS 0xc0000a76 FORMAT "%6.2" /end MEASUREMENT
/begin MEASUREMENT Sxx_ffm_vb_max_dyn_7 "" UWORD _CNV_A_R_LINEAR_____150_CM 1 0. 0. 655.35 DISPLAY_IDENTIFIER fm_dyn_eprm[7].Stx_ffm_vb_max_dyn ECU_ADDRESS 0xc0000a78 FORMAT "%6.2" /end MEASUREMENT
/begin MEASUREMENT Sxx_ffm_vs_dyn_7 "" UWORD _CNV_A_R_LINEAR_____70_CM 1 0. 0. 655.35 DISPLAY_IDENTIFIER fm_dyn_eprm[7].Stx_ffm_vs_dyn ECU_ADDRESS 0xc0000a7a FORMAT "%6.2" /end MEASUREMENT
/begin MEASUREMENT Sxx_ffm_vs_min_dyn_7 "" UWORD _CNV_A_R_LINEAR_____70_CM 1 0. 0. 655.35 DISPLAY_IDENTIFIER fm_dyn_eprm[7].Stx_ffm_vs_min_dyn ECU_ADDRESS 0xc0000a7c FORMAT "%6.2" /end MEASUREMENT
/begin MEASUREMENT Sxx_ffm_vs_max_dyn_7 "" UWORD _CNV_A_R_LINEAR_____70_CM 1 0. 0. 655.35 DISPLAY_IDENTIFIER fm_dyn_eprm[7].Stx_ffm_vs_max_dyn ECU_ADDRESS 0xc0000a7e FORMAT "%6.2" /end MEASUREMENT
/begin MEASUREMENT Sxx_ffm_did_1_dyn_7 "" UWORD _CNV_A_R_ECME_LINEA_0_CM 1 0. 0. 65535. DISPLAY_IDENTIFIER fm_dyn_eprm[7].Stx_ffm_did_X_dyn[0] ECU_ADDRESS 0xc0000a80 FORMAT "%5.0" /end MEASUREMENT
/begin MEASUREMENT Sxx_ffm_did_2_dyn_7 "" UWORD _CNV_A_R_ECME_LINEA_0_CM 1 0. 0. 65535. DISPLAY_IDENTIFIER fm_dyn_eprm[7].Stx_ffm_did_X_dyn[1] ECU_ADDRESS 0xc0000a82 FORMAT "%5.0" /end MEASUREMENT
/begin MEASUREMENT Sxx_ffm_did_3_dyn_7 "" UWORD _CNV_A_R_ECME_LINEA_0_CM 1 0. 0. 65535. DISPLAY_IDENTIFIER fm_dyn_eprm[7].Stx_ffm_did_X_dyn[2] ECU_ADDRESS 0xc0000a84 FORMAT "%5.0" /end MEASUREMENT
/begin MEASUREMENT Sxx_ffm_did_4_dyn_7 "" UWORD _CNV_A_R_ECME_LINEA_0_CM 1 0. 0. 65535. DISPLAY_IDENTIFIER fm_dyn_eprm[7].Stx_ffm_did_X_dyn[3] ECU_ADDRESS 0xc0000a86 FORMAT "%5.0" /end MEASUREMENT
/begin MEASUREMENT Sxx_ffm_did_5_dyn_7 "" UWORD _CNV_A_R_ECME_LINEA_0_CM 1 0. 0. 65535. DISPLAY_IDENTIFIER fm_dyn_eprm[7].Stx_ffm_did_X_dyn[4] ECU_ADDRESS 0xc0000a88 FORMAT "%5.0" /end MEASUREMENT
/begin MEASUREMENT Sxx_ffm_did_1_max_dyn_7 "" UWORD _CNV_A_R_ECME_LINEA_0_CM 1 0. 0. 65535. DISPLAY_IDENTIFIER fm_dyn_eprm[7].Stx_ffm_did_X_max_dyn[0] ECU_ADDRESS 0xc0000a8c FORMAT "%5.0" /end MEASUREMENT
/begin MEASUREMENT Sxx_ffm_did_2_max_dyn_7 "" UWORD _CNV_A_R_ECME_LINEA_0_CM 1 0. 0. 65535. DISPLAY_IDENTIFIER fm_dyn_eprm[7].Stx_ffm_did_X_max_dyn[1] ECU_ADDRESS 0xc0000a8e FORMAT "%5.0" /end MEASUREMENT
/begin MEASUREMENT Sxx_ffm_did_3_max_dyn_7 "" UWORD _CNV_A_R_ECME_LINEA_0_CM 1 0. 0. 65535. DISPLAY_IDENTIFIER fm_dyn_eprm[7].Stx_ffm_did_X_max_dyn[2] ECU_ADDRESS 0xc0000a90 FORMAT "%5.0" /end MEASUREMENT
/begin MEASUREMENT Sxx_ffm_did_4_max_dyn_7 "" UWORD _CNV_A_R_ECME_LINEA_0_CM 1 0. 0. 65535. DISPLAY_IDENTIFIER fm_dyn_eprm[7].Stx_ffm_did_X_max_dyn[3] ECU_ADDRESS 0xc0000a92 FORMAT "%5.0" /end MEASUREMENT
/begin MEASUREMENT Sxx_ffm_did_5_max_dyn_7 "" UWORD _CNV_A_R_ECME_LINEA_0_CM 1 0. 0. 65535. DISPLAY_IDENTIFIER fm_dyn_eprm[7].Stx_ffm_did_X_max_dyn[4] ECU_ADDRESS 0xc0000a94 FORMAT "%5.0" /end MEASUREMENT
/begin MEASUREMENT Sxx_ffm_did_1_min_dyn_7 "" UWORD _CNV_A_R_ECME_LINEA_0_CM 1 0. 0. 65535. DISPLAY_IDENTIFIER fm_dyn_eprm[7].Stx_ffm_did_X_min_dyn[0] ECU_ADDRESS 0xc0000a98 FORMAT "%5.0" /end MEASUREMENT
/begin MEASUREMENT Sxx_ffm_did_2_min_dyn_7 "" UWORD _CNV_A_R_ECME_LINEA_0_CM 1 0. 0. 65535. DISPLAY_IDENTIFIER fm_dyn_eprm[7].Stx_ffm_did_X_min_dyn[1] ECU_ADDRESS 0xc0000a9a FORMAT "%5.0" /end MEASUREMENT
/begin MEASUREMENT Sxx_ffm_did_3_min_dyn_7 "" UWORD _CNV_A_R_ECME_LINEA_0_CM 1 0. 0. 65535. DISPLAY_IDENTIFIER fm_dyn_eprm[7].Stx_ffm_did_X_min_dyn[2] ECU_ADDRESS 0xc0000a9c FORMAT "%5.0" /end MEASUREMENT
/begin MEASUREMENT Sxx_ffm_did_4_min_dyn_7 "" UWORD _CNV_A_R_ECME_LINEA_0_CM 1 0. 0. 65535. DISPLAY_IDENTIFIER fm_dyn_eprm[7].Stx_ffm_did_X_min_dyn[3] ECU_ADDRESS 0xc0000a9e FORMAT "%5.0" /end MEASUREMENT
/begin MEASUREMENT Sxx_ffm_did_5_min_dyn_7 "" UWORD _CNV_A_R_ECME_LINEA_0_CM 1 0. 0. 65535. DISPLAY_IDENTIFIER fm_dyn_eprm[7].Stx_ffm_did_X_min_dyn[4] ECU_ADDRESS 0xc0000aa0 FORMAT "%5.0" /end MEASUREMENT
/begin MEASUREMENT Sbx_pfo_dyn_7 "" UBYTE _CNV_A_R_A_165_CM 1 0. 0. 255. DISPLAY_IDENTIFIER fm_dyn_eprm[7].fm_dynamic_eprm_bitfield.Stx_pfo_dyn ECU_ADDRESS 0xc0000aa2 BIT_MASK 0x2 /end MEASUREMENT
/begin MEASUREMENT Sbx_mfo_dyn_7 "" UBYTE _CNV_A_R_A_165_CM 1 0. 0. 255. DISPLAY_IDENTIFIER fm_dyn_eprm[7].fm_dynamic_eprm_bitfield.Stx_mfo_dyn ECU_ADDRESS 0xc0000aa2 BIT_MASK 0x4 /end MEASUREMENT
/begin MEASUREMENT Sbx_obd_mreq_dyn_7 "" UBYTE _CNV_A_R_A_165_CM 1 0. 0. 255. DISPLAY_IDENTIFIER fm_dyn_eprm[7].fm_dynamic_eprm_bitfield.Stx_obd_mreq_dyn ECU_ADDRESS 0xc0000aa2 BIT_MASK 0x8 /end MEASUREMENT
/begin MEASUREMENT Sxx_obd_wctr_dyn_7 "" UBYTE _CNV_A_R_ECME_LINEA_0_CM 1 0. 0. 255. DISPLAY_IDENTIFIER fm_dyn_eprm[7].Stx_obd_wctr_dyn ECU_ADDRESS 0xc0000aa3 FORMAT "%3.0" /end MEASUREMENT
/begin MEASUREMENT Sxx_frq_dyn_7 "" UBYTE _CNV_A_R_ECME_LINEA_0_CM 1 0. 0. 255. DISPLAY_IDENTIFIER fm_dyn_eprm[7].Stx_frq_dyn ECU_ADDRESS 0xc0000aa4 FORMAT "%3.0" /end MEASUREMENT
/begin MEASUREMENT Sxx_obd_clfctr_dyn_7 "" UBYTE _CNV_A_R_ECME_LINEA_0_CM 1 0. 0. 10. DISPLAY_IDENTIFIER fm_dyn_eprm[7].Stx_obd_clfctr_dyn ECU_ADDRESS 0xc0000aa5 FORMAT "%3.0" /end MEASUREMENT
/begin MEASUREMENT Sxx_esd_siz_dyn_7 "" UBYTE _CNV_A_R_ECME_LINEA_0_CM 1 0. 0. 255. DISPLAY_IDENTIFIER fm_dyn_eprm[7].Stx_esd_siz_dyn ECU_ADDRESS 0xc0000aa6 FORMAT "%3.0" /end MEASUREMENT
/begin MEASUREMENT Sxx_pri_dyn_7 "" UBYTE _CNV_A_R_ECME_LINEA_0_CM 1 0. 0. 5. DISPLAY_IDENTIFIER fm_dyn_eprm[7].Stx_pri_dyn ECU_ADDRESS 0xc0000aa7 FORMAT "%3.0" /end MEASUREMENT
/begin MEASUREMENT Sxx_dist_fail_dyn_8 "" ULONG _CNV_A_R_LINEAR_____218_CM 1 0. 0. 16777215. DISPLAY_IDENTIFIER fm_dyn_eprm[8].Stx_dist_fail_dyn ECU_ADDRESS 0xc0000aa8 FORMAT "%10.0" /end MEASUREMENT
/begin MEASUREMENT Sxx_tmp_dist_dyn_8 "" ULONG _CNV_A_R_LINEAR_____218_CM 1 0. 0. 16777215. DISPLAY_IDENTIFIER fm_dyn_eprm[8].Stx_tmp_dist_dyn ECU_ADDRESS 0xc0000aac FORMAT "%10.0" /end MEASUREMENT
/begin MEASUREMENT Sxx_km_cf_dyn_8 "" ULONG _CNV_A_R_LINEAR_____218_CM 1 0. 0. 16777215. DISPLAY_IDENTIFIER fm_dyn_eprm[8].Stx_km_cf_dyn ECU_ADDRESS 0xc0000ab0 FORMAT "%10.0" /end MEASUREMENT
/begin MEASUREMENT Sxx_km_mf_dyn_8 "" ULONG _CNV_A_R_LINEAR_____218_CM 1 0. 0. 16777215. DISPLAY_IDENTIFIER fm_dyn_eprm[8].Stx_km_mf_dyn ECU_ADDRESS 0xc0000ab4 FORMAT "%10.0" /end MEASUREMENT
/begin MEASUREMENT Sxx_km_pass_dyn_8 "" ULONG _CNV_A_R_LINEAR_____218_CM 1 0. 0. 16777215. DISPLAY_IDENTIFIER fm_dyn_eprm[8].Stx_km_pass_dyn ECU_ADDRESS 0xc0000ab8 FORMAT "%10.0" /end MEASUREMENT
/begin MEASUREMENT Sxx_ind_dyn_8 "" UWORD _CNV_A_R_ECME_LINEA_0_CM 1 0. 0. 65535. DISPLAY_IDENTIFIER fm_dyn_eprm[8].Stx_ind_dyn ECU_ADDRESS 0xc0000abc FORMAT "%5.0" /end MEASUREMENT
/begin MEASUREMENT Sxx_ffm_esti_tqe_dyn_8 "" UWORD _CNV_A_R_LINEAR_____161_CM 1 0. -400. 1647.96875 DISPLAY_IDENTIFIER fm_dyn_eprm[8].Stx_ffm_esti_tqe_dyn ECU_ADDRESS 0xc0000abe FORMAT "%10.5" /end MEASUREMENT
/begin MEASUREMENT Sxx_ffm_esti_tqe_min_dyn_8 "" UWORD _CNV_A_R_LINEAR_____161_CM 1 0. -400. 1647.96875 DISPLAY_IDENTIFIER fm_dyn_eprm[8].Stx_ffm_esti_tqe_min_dyn ECU_ADDRESS 0xc0000ac0 FORMAT "%10.5" /end MEASUREMENT
/begin MEASUREMENT Sxx_ffm_esti_tqe_max_dyn_8 "" UWORD _CNV_A_R_LINEAR_____161_CM 1 0. -400. 1647.96875 DISPLAY_IDENTIFIER fm_dyn_eprm[8].Stx_ffm_esti_tqe_max_dyn ECU_ADDRESS 0xc0000ac2 FORMAT "%10.5" /end MEASUREMENT
/begin MEASUREMENT Sxx_ffm_n_dyn_8 "" UWORD _CNV_A_R_ENSD_LINEA_24_CM 1 0. 0. 16383.75 DISPLAY_IDENTIFIER fm_dyn_eprm[8].Stx_ffm_n_dyn ECU_ADDRESS 0xc0000ac4 FORMAT "%8.2" /end MEASUREMENT
/begin MEASUREMENT Sxx_ffm_n_min_dyn_8 "" UWORD _CNV_A_R_ENSD_LINEA_24_CM 1 0. 0. 16383.75 DISPLAY_IDENTIFIER fm_dyn_eprm[8].Stx_ffm_n_min_dyn ECU_ADDRESS 0xc0000ac6 FORMAT "%8.2" /end MEASUREMENT
/begin MEASUREMENT Sxx_ffm_n_max_dyn_8 "" UWORD _CNV_A_R_ENSD_LINEA_24_CM 1 0. 0. 16383.75 DISPLAY_IDENTIFIER fm_dyn_eprm[8].Stx_ffm_n_max_dyn ECU_ADDRESS 0xc0000ac8 FORMAT "%8.2" /end MEASUREMENT
/begin MEASUREMENT Sxx_ffm_tco_dyn_8 "" UWORD _CNV_A_R_LINEAR_____226_CM 1 0. -273. 6280.5 DISPLAY_IDENTIFIER fm_dyn_eprm[8].Stx_ffm_tco_dyn ECU_ADDRESS 0xc0000aca FORMAT "%6.1" /end MEASUREMENT
/begin MEASUREMENT Sxx_ffm_tco_min_dyn_8 "" UWORD _CNV_A_R_LINEAR_____226_CM 1 0. -273. 6280.5 DISPLAY_IDENTIFIER fm_dyn_eprm[8].Stx_ffm_tco_min_dyn ECU_ADDRESS 0xc0000acc FORMAT "%6.1" /end MEASUREMENT
/begin MEASUREMENT Sxx_ffm_tco_max_dyn_8 "" UWORD _CNV_A_R_LINEAR_____226_CM 1 0. -273. 6280.5 DISPLAY_IDENTIFIER fm_dyn_eprm[8].Stx_ffm_tco_max_dyn ECU_ADDRESS 0xc0000ace FORMAT "%6.1" /end MEASUREMENT
/begin MEASUREMENT Sxx_ffm_vb_dyn_8 "" UWORD _CNV_A_R_LINEAR_____150_CM 1 0. 0. 655.35 DISPLAY_IDENTIFIER fm_dyn_eprm[8].Stx_ffm_vb_dyn ECU_ADDRESS 0xc0000ad0 FORMAT "%6.2" /end MEASUREMENT
/begin MEASUREMENT Sxx_ffm_vb_min_dyn_8 "" UWORD _CNV_A_R_LINEAR_____150_CM 1 0. 0. 655.35 DISPLAY_IDENTIFIER fm_dyn_eprm[8].Stx_ffm_vb_min_dyn ECU_ADDRESS 0xc0000ad2 FORMAT "%6.2" /end MEASUREMENT
/begin MEASUREMENT Sxx_ffm_vb_max_dyn_8 "" UWORD _CNV_A_R_LINEAR_____150_CM 1 0. 0. 655.35 DISPLAY_IDENTIFIER fm_dyn_eprm[8].Stx_ffm_vb_max_dyn ECU_ADDRESS 0xc0000ad4 FORMAT "%6.2" /end MEASUREMENT
/begin MEASUREMENT Sxx_ffm_vs_dyn_8 "" UWORD _CNV_A_R_LINEAR_____70_CM 1 0. 0. 655.35 DISPLAY_IDENTIFIER fm_dyn_eprm[8].Stx_ffm_vs_dyn ECU_ADDRESS 0xc0000ad6 FORMAT "%6.2" /end MEASUREMENT
/begin MEASUREMENT Sxx_ffm_vs_min_dyn_8 "" UWORD _CNV_A_R_LINEAR_____70_CM 1 0. 0. 655.35 DISPLAY_IDENTIFIER fm_dyn_eprm[8].Stx_ffm_vs_min_dyn ECU_ADDRESS 0xc0000ad8 FORMAT "%6.2" /end MEASUREMENT
/begin MEASUREMENT Sxx_ffm_vs_max_dyn_8 "" UWORD _CNV_A_R_LINEAR_____70_CM 1 0. 0. 655.35 DISPLAY_IDENTIFIER fm_dyn_eprm[8].Stx_ffm_vs_max_dyn ECU_ADDRESS 0xc0000ada FORMAT "%6.2" /end MEASUREMENT
/begin MEASUREMENT Sxx_ffm_did_1_dyn_8 "" UWORD _CNV_A_R_ECME_LINEA_0_CM 1 0. 0. 65535. DISPLAY_IDENTIFIER fm_dyn_eprm[8].Stx_ffm_did_X_dyn[0] ECU_ADDRESS 0xc0000adc FORMAT "%5.0" /end MEASUREMENT
/begin MEASUREMENT Sxx_ffm_did_2_dyn_8 "" UWORD _CNV_A_R_ECME_LINEA_0_CM 1 0. 0. 65535. DISPLAY_IDENTIFIER fm_dyn_eprm[8].Stx_ffm_did_X_dyn[1] ECU_ADDRESS 0xc0000ade FORMAT "%5.0" /end MEASUREMENT
/begin MEASUREMENT Sxx_ffm_did_3_dyn_8 "" UWORD _CNV_A_R_ECME_LINEA_0_CM 1 0. 0. 65535. DISPLAY_IDENTIFIER fm_dyn_eprm[8].Stx_ffm_did_X_dyn[2] ECU_ADDRESS 0xc0000ae0 FORMAT "%5.0" /end MEASUREMENT
/begin MEASUREMENT Sxx_ffm_did_4_dyn_8 "" UWORD _CNV_A_R_ECME_LINEA_0_CM 1 0. 0. 65535. DISPLAY_IDENTIFIER fm_dyn_eprm[8].Stx_ffm_did_X_dyn[3] ECU_ADDRESS 0xc0000ae2 FORMAT "%5.0" /end MEASUREMENT
/begin MEASUREMENT Sxx_ffm_did_5_dyn_8 "" UWORD _CNV_A_R_ECME_LINEA_0_CM 1 0. 0. 65535. DISPLAY_IDENTIFIER fm_dyn_eprm[8].Stx_ffm_did_X_dyn[4] ECU_ADDRESS 0xc0000ae4 FORMAT "%5.0" /end MEASUREMENT
/begin MEASUREMENT Sxx_ffm_did_1_max_dyn_8 "" UWORD _CNV_A_R_ECME_LINEA_0_CM 1 0. 0. 65535. DISPLAY_IDENTIFIER fm_dyn_eprm[8].Stx_ffm_did_X_max_dyn[0] ECU_ADDRESS 0xc0000ae8 FORMAT "%5.0" /end MEASUREMENT
/begin MEASUREMENT Sxx_ffm_did_2_max_dyn_8 "" UWORD _CNV_A_R_ECME_LINEA_0_CM 1 0. 0. 65535. DISPLAY_IDENTIFIER fm_dyn_eprm[8].Stx_ffm_did_X_max_dyn[1] ECU_ADDRESS 0xc0000aea FORMAT "%5.0" /end MEASUREMENT
/begin MEASUREMENT Sxx_ffm_did_3_max_dyn_8 "" UWORD _CNV_A_R_ECME_LINEA_0_CM 1 0. 0. 65535. DISPLAY_IDENTIFIER fm_dyn_eprm[8].Stx_ffm_did_X_max_dyn[2] ECU_ADDRESS 0xc0000aec FORMAT "%5.0" /end MEASUREMENT
/begin MEASUREMENT Sxx_ffm_did_4_max_dyn_8 "" UWORD _CNV_A_R_ECME_LINEA_0_CM 1 0. 0. 65535. DISPLAY_IDENTIFIER fm_dyn_eprm[8].Stx_ffm_did_X_max_dyn[3] ECU_ADDRESS 0xc0000aee FORMAT "%5.0" /end MEASUREMENT
/begin MEASUREMENT Sxx_ffm_did_5_max_dyn_8 "" UWORD _CNV_A_R_ECME_LINEA_0_CM 1 0. 0. 65535. DISPLAY_IDENTIFIER fm_dyn_eprm[8].Stx_ffm_did_X_max_dyn[4] ECU_ADDRESS 0xc0000af0 FORMAT "%5.0" /end MEASUREMENT
/begin MEASUREMENT Sxx_ffm_did_1_min_dyn_8 "" UWORD _CNV_A_R_ECME_LINEA_0_CM 1 0. 0. 65535. DISPLAY_IDENTIFIER fm_dyn_eprm[8].Stx_ffm_did_X_min_dyn[0] ECU_ADDRESS 0xc0000af4 FORMAT "%5.0" /end MEASUREMENT
/begin MEASUREMENT Sxx_ffm_did_2_min_dyn_8 "" UWORD _CNV_A_R_ECME_LINEA_0_CM 1 0. 0. 65535. DISPLAY_IDENTIFIER fm_dyn_eprm[8].Stx_ffm_did_X_min_dyn[1] ECU_ADDRESS 0xc0000af6 FORMAT "%5.0" /end MEASUREMENT
/begin MEASUREMENT Sxx_ffm_did_3_min_dyn_8 "" UWORD _CNV_A_R_ECME_LINEA_0_CM 1 0. 0. 65535. DISPLAY_IDENTIFIER fm_dyn_eprm[8].Stx_ffm_did_X_min_dyn[2] ECU_ADDRESS 0xc0000af8 FORMAT "%5.0" /end MEASUREMENT
/begin MEASUREMENT Sxx_ffm_did_4_min_dyn_8 "" UWORD _CNV_A_R_ECME_LINEA_0_CM 1 0. 0. 65535. DISPLAY_IDENTIFIER fm_dyn_eprm[8].Stx_ffm_did_X_min_dyn[3] ECU_ADDRESS 0xc0000afa FORMAT "%5.0" /end MEASUREMENT
/begin MEASUREMENT Sxx_ffm_did_5_min_dyn_8 "" UWORD _CNV_A_R_ECME_LINEA_0_CM 1 0. 0. 65535. DISPLAY_IDENTIFIER fm_dyn_eprm[8].Stx_ffm_did_X_min_dyn[4] ECU_ADDRESS 0xc0000afc FORMAT "%5.0" /end MEASUREMENT
/begin MEASUREMENT Sbx_pfo_dyn_8 "" UBYTE _CNV_A_R_A_165_CM 1 0. 0. 255. DISPLAY_IDENTIFIER fm_dyn_eprm[8].fm_dynamic_eprm_bitfield.Stx_pfo_dyn ECU_ADDRESS 0xc0000afe BIT_MASK 0x2 /end MEASUREMENT
/begin MEASUREMENT Sbx_mfo_dyn_8 "" UBYTE _CNV_A_R_A_165_CM 1 0. 0. 255. DISPLAY_IDENTIFIER fm_dyn_eprm[8].fm_dynamic_eprm_bitfield.Stx_mfo_dyn ECU_ADDRESS 0xc0000afe BIT_MASK 0x4 /end MEASUREMENT
/begin MEASUREMENT Sbx_obd_mreq_dyn_8 "" UBYTE _CNV_A_R_A_165_CM 1 0. 0. 255. DISPLAY_IDENTIFIER fm_dyn_eprm[8].fm_dynamic_eprm_bitfield.Stx_obd_mreq_dyn ECU_ADDRESS 0xc0000afe BIT_MASK 0x8 /end MEASUREMENT
/begin MEASUREMENT Sxx_obd_wctr_dyn_8 "" UBYTE _CNV_A_R_ECME_LINEA_0_CM 1 0. 0. 255. DISPLAY_IDENTIFIER fm_dyn_eprm[8].Stx_obd_wctr_dyn ECU_ADDRESS 0xc0000aff FORMAT "%3.0" /end MEASUREMENT
/begin MEASUREMENT Sxx_frq_dyn_8 "" UBYTE _CNV_A_R_ECME_LINEA_0_CM 1 0. 0. 255. DISPLAY_IDENTIFIER fm_dyn_eprm[8].Stx_frq_dyn ECU_ADDRESS 0xc0000b00 FORMAT "%3.0" /end MEASUREMENT
/begin MEASUREMENT Sxx_obd_clfctr_dyn_8 "" UBYTE _CNV_A_R_ECME_LINEA_0_CM 1 0. 0. 10. DISPLAY_IDENTIFIER fm_dyn_eprm[8].Stx_obd_clfctr_dyn ECU_ADDRESS 0xc0000b01 FORMAT "%3.0" /end MEASUREMENT
/begin MEASUREMENT Sxx_esd_siz_dyn_8 "" UBYTE _CNV_A_R_ECME_LINEA_0_CM 1 0. 0. 255. DISPLAY_IDENTIFIER fm_dyn_eprm[8].Stx_esd_siz_dyn ECU_ADDRESS 0xc0000b02 FORMAT "%3.0" /end MEASUREMENT
/begin MEASUREMENT Sxx_pri_dyn_8 "" UBYTE _CNV_A_R_ECME_LINEA_0_CM 1 0. 0. 5. DISPLAY_IDENTIFIER fm_dyn_eprm[8].Stx_pri_dyn ECU_ADDRESS 0xc0000b03 FORMAT "%3.0" /end MEASUREMENT
/begin MEASUREMENT Sxx_dist_fail_dyn_9 "" ULONG _CNV_A_R_LINEAR_____218_CM 1 0. 0. 16777215. DISPLAY_IDENTIFIER fm_dyn_eprm[9].Stx_dist_fail_dyn ECU_ADDRESS 0xc0000b04 FORMAT "%10.0" /end MEASUREMENT
/begin MEASUREMENT Sxx_tmp_dist_dyn_9 "" ULONG _CNV_A_R_LINEAR_____218_CM 1 0. 0. 16777215. DISPLAY_IDENTIFIER fm_dyn_eprm[9].Stx_tmp_dist_dyn ECU_ADDRESS 0xc0000b08 FORMAT "%10.0" /end MEASUREMENT
/begin MEASUREMENT Sxx_km_cf_dyn_9 "" ULONG _CNV_A_R_LINEAR_____218_CM 1 0. 0. 16777215. DISPLAY_IDENTIFIER fm_dyn_eprm[9].Stx_km_cf_dyn ECU_ADDRESS 0xc0000b0c FORMAT "%10.0" /end MEASUREMENT
/begin MEASUREMENT Sxx_km_mf_dyn_9 "" ULONG _CNV_A_R_LINEAR_____218_CM 1 0. 0. 16777215. DISPLAY_IDENTIFIER fm_dyn_eprm[9].Stx_km_mf_dyn ECU_ADDRESS 0xc0000b10 FORMAT "%10.0" /end MEASUREMENT
/begin MEASUREMENT Sxx_km_pass_dyn_9 "" ULONG _CNV_A_R_LINEAR_____218_CM 1 0. 0. 16777215. DISPLAY_IDENTIFIER fm_dyn_eprm[9].Stx_km_pass_dyn ECU_ADDRESS 0xc0000b14 FORMAT "%10.0" /end MEASUREMENT
/begin MEASUREMENT Sxx_ind_dyn_9 "" UWORD _CNV_A_R_ECME_LINEA_0_CM 1 0. 0. 65535. DISPLAY_IDENTIFIER fm_dyn_eprm[9].Stx_ind_dyn ECU_ADDRESS 0xc0000b18 FORMAT "%5.0" /end MEASUREMENT
/begin MEASUREMENT Sxx_ffm_esti_tqe_dyn_9 "" UWORD _CNV_A_R_LINEAR_____161_CM 1 0. -400. 1647.96875 DISPLAY_IDENTIFIER fm_dyn_eprm[9].Stx_ffm_esti_tqe_dyn ECU_ADDRESS 0xc0000b1a FORMAT "%10.5" /end MEASUREMENT
/begin MEASUREMENT Sxx_ffm_esti_tqe_min_dyn_9 "" UWORD _CNV_A_R_LINEAR_____161_CM 1 0. -400. 1647.96875 DISPLAY_IDENTIFIER fm_dyn_eprm[9].Stx_ffm_esti_tqe_min_dyn ECU_ADDRESS 0xc0000b1c FORMAT "%10.5" /end MEASUREMENT
/begin MEASUREMENT Sxx_ffm_esti_tqe_max_dyn_9 "" UWORD _CNV_A_R_LINEAR_____161_CM 1 0. -400. 1647.96875 DISPLAY_IDENTIFIER fm_dyn_eprm[9].Stx_ffm_esti_tqe_max_dyn ECU_ADDRESS 0xc0000b1e FORMAT "%10.5" /end MEASUREMENT
/begin MEASUREMENT Sxx_ffm_n_dyn_9 "" UWORD _CNV_A_R_ENSD_LINEA_24_CM 1 0. 0. 16383.75 DISPLAY_IDENTIFIER fm_dyn_eprm[9].Stx_ffm_n_dyn ECU_ADDRESS 0xc0000b20 FORMAT "%8.2" /end MEASUREMENT
/begin MEASUREMENT Sxx_ffm_n_min_dyn_9 "" UWORD _CNV_A_R_ENSD_LINEA_24_CM 1 0. 0. 16383.75 DISPLAY_IDENTIFIER fm_dyn_eprm[9].Stx_ffm_n_min_dyn ECU_ADDRESS 0xc0000b22 FORMAT "%8.2" /end MEASUREMENT
/begin MEASUREMENT Sxx_ffm_n_max_dyn_9 "" UWORD _CNV_A_R_ENSD_LINEA_24_CM 1 0. 0. 16383.75 DISPLAY_IDENTIFIER fm_dyn_eprm[9].Stx_ffm_n_max_dyn ECU_ADDRESS 0xc0000b24 FORMAT "%8.2" /end MEASUREMENT
/begin MEASUREMENT Sxx_ffm_tco_dyn_9 "" UWORD _CNV_A_R_LINEAR_____226_CM 1 0. -273. 6280.5 DISPLAY_IDENTIFIER fm_dyn_eprm[9].Stx_ffm_tco_dyn ECU_ADDRESS 0xc0000b26 FORMAT "%6.1" /end MEASUREMENT
/begin MEASUREMENT Sxx_ffm_tco_min_dyn_9 "" UWORD _CNV_A_R_LINEAR_____226_CM 1 0. -273. 6280.5 DISPLAY_IDENTIFIER fm_dyn_eprm[9].Stx_ffm_tco_min_dyn ECU_ADDRESS 0xc0000b28 FORMAT "%6.1" /end MEASUREMENT
/begin MEASUREMENT Sxx_ffm_tco_max_dyn_9 "" UWORD _CNV_A_R_LINEAR_____226_CM 1 0. -273. 6280.5 DISPLAY_IDENTIFIER fm_dyn_eprm[9].Stx_ffm_tco_max_dyn ECU_ADDRESS 0xc0000b2a FORMAT "%6.1" /end MEASUREMENT
/begin MEASUREMENT Sxx_ffm_vb_dyn_9 "" UWORD _CNV_A_R_LINEAR_____150_CM 1 0. 0. 655.35 DISPLAY_IDENTIFIER fm_dyn_eprm[9].Stx_ffm_vb_dyn ECU_ADDRESS 0xc0000b2c FORMAT "%6.2" /end MEASUREMENT
/begin MEASUREMENT Sxx_ffm_vb_min_dyn_9 "" UWORD _CNV_A_R_LINEAR_____150_CM 1 0. 0. 655.35 DISPLAY_IDENTIFIER fm_dyn_eprm[9].Stx_ffm_vb_min_dyn ECU_ADDRESS 0xc0000b2e FORMAT "%6.2" /end MEASUREMENT
/begin MEASUREMENT Sxx_ffm_vb_max_dyn_9 "" UWORD _CNV_A_R_LINEAR_____150_CM 1 0. 0. 655.35 DISPLAY_IDENTIFIER fm_dyn_eprm[9].Stx_ffm_vb_max_dyn ECU_ADDRESS 0xc0000b30 FORMAT "%6.2" /end MEASUREMENT
/begin MEASUREMENT Sxx_ffm_vs_dyn_9 "" UWORD _CNV_A_R_LINEAR_____70_CM 1 0. 0. 655.35 DISPLAY_IDENTIFIER fm_dyn_eprm[9].Stx_ffm_vs_dyn ECU_ADDRESS 0xc0000b32 FORMAT "%6.2" /end MEASUREMENT
/begin MEASUREMENT Sxx_ffm_vs_min_dyn_9 "" UWORD _CNV_A_R_LINEAR_____70_CM 1 0. 0. 655.35 DISPLAY_IDENTIFIER fm_dyn_eprm[9].Stx_ffm_vs_min_dyn ECU_ADDRESS 0xc0000b34 FORMAT "%6.2" /end MEASUREMENT
/begin MEASUREMENT Sxx_ffm_vs_max_dyn_9 "" UWORD _CNV_A_R_LINEAR_____70_CM 1 0. 0. 655.35 DISPLAY_IDENTIFIER fm_dyn_eprm[9].Stx_ffm_vs_max_dyn ECU_ADDRESS 0xc0000b36 FORMAT "%6.2" /end MEASUREMENT
/begin MEASUREMENT Sxx_ffm_did_1_dyn_9 "" UWORD _CNV_A_R_ECME_LINEA_0_CM 1 0. 0. 65535. DISPLAY_IDENTIFIER fm_dyn_eprm[9].Stx_ffm_did_X_dyn[0] ECU_ADDRESS 0xc0000b38 FORMAT "%5.0" /end MEASUREMENT
/begin MEASUREMENT Sxx_ffm_did_2_dyn_9 "" UWORD _CNV_A_R_ECME_LINEA_0_CM 1 0. 0. 65535. DISPLAY_IDENTIFIER fm_dyn_eprm[9].Stx_ffm_did_X_dyn[1] ECU_ADDRESS 0xc0000b3a FORMAT "%5.0" /end MEASUREMENT
/begin MEASUREMENT Sxx_ffm_did_3_dyn_9 "" UWORD _CNV_A_R_ECME_LINEA_0_CM 1 0. 0. 65535. DISPLAY_IDENTIFIER fm_dyn_eprm[9].Stx_ffm_did_X_dyn[2] ECU_ADDRESS 0xc0000b3c FORMAT "%5.0" /end MEASUREMENT
/begin MEASUREMENT Sxx_ffm_did_4_dyn_9 "" UWORD _CNV_A_R_ECME_LINEA_0_CM 1 0. 0. 65535. DISPLAY_IDENTIFIER fm_dyn_eprm[9].Stx_ffm_did_X_dyn[3] ECU_ADDRESS 0xc0000b3e FORMAT "%5.0" /end MEASUREMENT
/begin MEASUREMENT Sxx_ffm_did_5_dyn_9 "" UWORD _CNV_A_R_ECME_LINEA_0_CM 1 0. 0. 65535. DISPLAY_IDENTIFIER fm_dyn_eprm[9].Stx_ffm_did_X_dyn[4] ECU_ADDRESS 0xc0000b40 FORMAT "%5.0" /end MEASUREMENT
/begin MEASUREMENT Sxx_ffm_did_1_max_dyn_9 "" UWORD _CNV_A_R_ECME_LINEA_0_CM 1 0. 0. 65535. DISPLAY_IDENTIFIER fm_dyn_eprm[9].Stx_ffm_did_X_max_dyn[0] ECU_ADDRESS 0xc0000b44 FORMAT "%5.0" /end MEASUREMENT
/begin MEASUREMENT Sxx_ffm_did_2_max_dyn_9 "" UWORD _CNV_A_R_ECME_LINEA_0_CM 1 0. 0. 65535. DISPLAY_IDENTIFIER fm_dyn_eprm[9].Stx_ffm_did_X_max_dyn[1] ECU_ADDRESS 0xc0000b46 FORMAT "%5.0" /end MEASUREMENT
/begin MEASUREMENT Sxx_ffm_did_3_max_dyn_9 "" UWORD _CNV_A_R_ECME_LINEA_0_CM 1 0. 0. 65535. DISPLAY_IDENTIFIER fm_dyn_eprm[9].Stx_ffm_did_X_max_dyn[2] ECU_ADDRESS 0xc0000b48 FORMAT "%5.0" /end MEASUREMENT
/begin MEASUREMENT Sxx_ffm_did_4_max_dyn_9 "" UWORD _CNV_A_R_ECME_LINEA_0_CM 1 0. 0. 65535. DISPLAY_IDENTIFIER fm_dyn_eprm[9].Stx_ffm_did_X_max_dyn[3] ECU_ADDRESS 0xc0000b4a FORMAT "%5.0" /end MEASUREMENT
/begin MEASUREMENT Sxx_ffm_did_5_max_dyn_9 "" UWORD _CNV_A_R_ECME_LINEA_0_CM 1 0. 0. 65535. DISPLAY_IDENTIFIER fm_dyn_eprm[9].Stx_ffm_did_X_max_dyn[4] ECU_ADDRESS 0xc0000b4c FORMAT "%5.0" /end MEASUREMENT
/begin MEASUREMENT Sxx_ffm_did_1_min_dyn_9 "" UWORD _CNV_A_R_ECME_LINEA_0_CM 1 0. 0. 65535. DISPLAY_IDENTIFIER fm_dyn_eprm[9].Stx_ffm_did_X_min_dyn[0] ECU_ADDRESS 0xc0000b50 FORMAT "%5.0" /end MEASUREMENT
/begin MEASUREMENT Sxx_ffm_did_2_min_dyn_9 "" UWORD _CNV_A_R_ECME_LINEA_0_CM 1 0. 0. 65535. DISPLAY_IDENTIFIER fm_dyn_eprm[9].Stx_ffm_did_X_min_dyn[1] ECU_ADDRESS 0xc0000b52 FORMAT "%5.0" /end MEASUREMENT
/begin MEASUREMENT Sxx_ffm_did_3_min_dyn_9 "" UWORD _CNV_A_R_ECME_LINEA_0_CM 1 0. 0. 65535. DISPLAY_IDENTIFIER fm_dyn_eprm[9].Stx_ffm_did_X_min_dyn[2] ECU_ADDRESS 0xc0000b54 FORMAT "%5.0" /end MEASUREMENT
/begin MEASUREMENT Sxx_ffm_did_4_min_dyn_9 "" UWORD _CNV_A_R_ECME_LINEA_0_CM 1 0. 0. 65535. DISPLAY_IDENTIFIER fm_dyn_eprm[9].Stx_ffm_did_X_min_dyn[3] ECU_ADDRESS 0xc0000b56 FORMAT "%5.0" /end MEASUREMENT
/begin MEASUREMENT Sxx_ffm_did_5_min_dyn_9 "" UWORD _CNV_A_R_ECME_LINEA_0_CM 1 0. 0. 65535. DISPLAY_IDENTIFIER fm_dyn_eprm[9].Stx_ffm_did_X_min_dyn[4] ECU_ADDRESS 0xc0000b58 FORMAT "%5.0" /end MEASUREMENT
/begin MEASUREMENT Sbx_pfo_dyn_9 "" UBYTE _CNV_A_R_A_165_CM 1 0. 0. 255. DISPLAY_IDENTIFIER fm_dyn_eprm[9].fm_dynamic_eprm_bitfield.Stx_pfo_dyn ECU_ADDRESS 0xc0000b5a BIT_MASK 0x2 /end MEASUREMENT
/begin MEASUREMENT Sbx_mfo_dyn_9 "" UBYTE _CNV_A_R_A_165_CM 1 0. 0. 255. DISPLAY_IDENTIFIER fm_dyn_eprm[9].fm_dynamic_eprm_bitfield.Stx_mfo_dyn ECU_ADDRESS 0xc0000b5a BIT_MASK 0x4 /end MEASUREMENT
/begin MEASUREMENT Sbx_obd_mreq_dyn_9 "" UBYTE _CNV_A_R_A_165_CM 1 0. 0. 255. DISPLAY_IDENTIFIER fm_dyn_eprm[9].fm_dynamic_eprm_bitfield.Stx_obd_mreq_dyn ECU_ADDRESS 0xc0000b5a BIT_MASK 0x8 /end MEASUREMENT
/begin MEASUREMENT Sxx_obd_wctr_dyn_9 "" UBYTE _CNV_A_R_ECME_LINEA_0_CM 1 0. 0. 255. DISPLAY_IDENTIFIER fm_dyn_eprm[9].Stx_obd_wctr_dyn ECU_ADDRESS 0xc0000b5b FORMAT "%3.0" /end MEASUREMENT
/begin MEASUREMENT Sxx_frq_dyn_9 "" UBYTE _CNV_A_R_ECME_LINEA_0_CM 1 0. 0. 255. DISPLAY_IDENTIFIER fm_dyn_eprm[9].Stx_frq_dyn ECU_ADDRESS 0xc0000b5c FORMAT "%3.0" /end MEASUREMENT
/begin MEASUREMENT Sxx_obd_clfctr_dyn_9 "" UBYTE _CNV_A_R_ECME_LINEA_0_CM 1 0. 0. 10. DISPLAY_IDENTIFIER fm_dyn_eprm[9].Stx_obd_clfctr_dyn ECU_ADDRESS 0xc0000b5d FORMAT "%3.0" /end MEASUREMENT
/begin MEASUREMENT Sxx_esd_siz_dyn_9 "" UBYTE _CNV_A_R_ECME_LINEA_0_CM 1 0. 0. 255. DISPLAY_IDENTIFIER fm_dyn_eprm[9].Stx_esd_siz_dyn ECU_ADDRESS 0xc0000b5e FORMAT "%3.0" /end MEASUREMENT
/begin MEASUREMENT Sxx_pri_dyn_9 "" UBYTE _CNV_A_R_ECME_LINEA_0_CM 1 0. 0. 5. DISPLAY_IDENTIFIER fm_dyn_eprm[9].Stx_pri_dyn ECU_ADDRESS 0xc0000b5f FORMAT "%3.0" /end MEASUREMENT
/begin COMPU_METHOD _CNV_A_R_ECME_LINEA_0_CM "" RAT_FUNC "%6.3" "-" COEFFS 0 1. 0. 0 0 1 /end COMPU_METHOD
/begin COMPU_METHOD _CNV_S_2_RANGE______3_CM "" TAB_VERB "%6.3" "-" COMPU_TAB_REF _CNV_S_2_RANGE______3 /end COMPU_METHOD
/begin COMPU_VTAB _CNV_S_2_RANGE______3 "" TAB_VERB 2 0 "0" 1 "1" /end COMPU_VTAB
/begin COMPU_METHOD _CNV_A_R_ENSD_LINEA_24_CM "" RAT_FUNC "%6.3" "rpm" COEFFS 0 4. 0. 0 0 1 /end COMPU_METHOD
/begin COMPU_METHOD _CNV_A_R_LINEAR_____54_CM "" RAT_FUNC "%6.3" "∞C" COEFFS 0 10. 400. 0 0 1 /end COMPU_METHOD
/begin COMPU_METHOD _CNV_A_R_LINEAR_____70_CM "" RAT_FUNC "%6.3" "km/h" COEFFS 0 100. 0. 0 0 1 /end COMPU_METHOD
/begin COMPU_METHOD _CNV_A_R_LINEAR_____150_CM "" RAT_FUNC "%6.3" "V" COEFFS 0 100. 0. 0 0 1 /end COMPU_METHOD
/begin COMPU_METHOD _CNV_A_R_LINEAR_____161_CM "" RAT_FUNC "%6.3" "Nm" COEFFS 0 32. 12800. 0 0 1 /end COMPU_METHOD
/begin COMPU_METHOD _CNV_A_R_A_165_CM "" RAT_FUNC "%6.3" "" COEFFS 0 1. 0. 0 0 1 /end COMPU_METHOD
/begin COMPU_METHOD _CNV_A_R_LINEAR_____218_CM "" RAT_FUNC "%6.3" "km" COEFFS 0 1. 0. 0 0 1 /end COMPU_METHOD
/begin COMPU_METHOD _CNV_S_690_FM_RANGE_D_225_CM "" TAB_VERB "%6.3" "" COMPU_TAB_REF _CNV_S_690_FM_RANGE_D_225 /end COMPU_METHOD
/begin COMPU_VTAB _CNV_S_690_FM_RANGE_D_225 "" TAB_VERB 690 0 "NO_ERROR" 1 "ac_prs_h" 2 "ac_prs_l" 3 "acel_pdl_chr" 4 "acel_pdl_secu_1" 5 "acel_pdl_secu_2" 6 "acel_pdl_tot" 7 "acel_pdl_v1_h" 8 "acel_pdl_v1_l" 9 "acel_pdl_v2_h" 10 "acel_pdl_v2_l" 11 "actr_rly_oc" 12 "actr_rly_scg" 13 "actr_rly_scw" 14 "agb_data_chr" 15 "agb_data_seq_ctr" 16 "agb_data_tout" 17 "agb_no_frm" 18 "cata_dirt_lkg" 19 "cata_nok_cge" 20 "cata1_dirt_lkg" 21 "cata2_dirt_lkg" 22 "clu_cnt_nok" 23 "comb_trs_tout" 24 "doc1_utp_chr" 25 "doc1_utp_h" 26 "doc1_utp_l" 27 "doc2_utp_chr" 28 "doc2_utp_h" 29 "doc2_utp_l" 30 "doc2_utp_neg_dev" 31 "doc2_utp_pos_dev" 32 "efi_inj_oc" 33 "efi_inj_scg" 34 "efi_inj_scw" 35 "efi_pump_oc" 36 "efi_pump_scg" 37 "efi_pump_scw" 38 "egr_byp_oc" 39 "egr_byp_scg" 40 "egr_byp_scw" 41 "emtv_flow_meca" 42 "emtv_hbdg_el" 43 "emtv_hbdg_ovh" 44 "emtv_ofs_no_norm" 45 "emtv_reg_blk" 46 "emtv_reg_blk_open" 47 "emtv_reg_dirt" 48 "esp_data_chr" 49 "esp_data_seq_ctr" 50 "esp_no_frm" 51 "ex_prs_no_lk" 52 "ex_prs_nok" 53 "exh_temp_cmp" 54 "gas_pump_oc" 55 "gas_pump_scg" 56 "gas_pump_scw" 57 "glow_cmd_oc" 58 "glow_cmd_scg" 59 "glow_cmd_scw" 60 "igc_1_4_oc" 61 "igc_1_4_scg" 62 "igc_1_4_scw" 63 "igc_2_3_oc" 64 "igc_2_3_scg" 65 "igc_2_3_scw" 66 "in_vvtc_blk" 67 "in_vvtc_dirt_lkg" 68 "in_vvtc_sldv_oc" 69 "in_vvtc_sldv_scg" 70 "in_vvtc_sldv_scw" 71 "inj_ecu_lbdw_icp" 72 "inj_ecu_lbup_icp" 73 "inj1_oc" 74 "inj1_scg" 75 "inj1_scw" 76 "inj2_oc" 77 "inj2_scg" 78 "inj2_scw" 79 "inj3_oc" 80 "inj3_scg" 81 "inj3_scw" 82 "inj4_oc" 83 "inj4_scg" 84 "inj4_scw" 85 "it_cmd_el" 86 "it_hbdg_el" 87 "it_hbdg_ovh" 88 "it_ofs_meca" 89 "it_ofs_no_norm" 90 "it_ofs_secu_nok" 91 "it_reg_blk" 92 "it_reg_blk_clos" 93 "it_reg_blk_open" 94 "it_reg_dirt" 95 "knk_oor" 96 "knk_shp" 97 "lbdw_oc" 98 "lbdw_scg" 99 "lbdw_scw" 100 "lbup_oc" 101 "lbup_scg" 102 "lbup_scw" 103 "maf_reg_neg_err" 104 "mafs_plau_diag_h" 105 "mafs_plau_diag_l" 106 "oil_dil_ovs" 107 "pft_dirt" 108 "pft_dirt_lkg" 109 "pft_dp_chr" 110 "pft_dp_dirt_lkg" 111 "pft_dtp_chr" 112 "pft_dtp_h" 113 "pft_dtp_l" 114 "pft_dtp_ovh" 115 "pft_no_lk" 116 "pft_rgn_max_err" 117 "pft_utp_chr" 118 "pft_utp_h" 119 "pft_utp_l" 120 "pft_utp_neg_err" 121 "pft_utp_ovh" 122 "pft_utp_pos_err" 123 "pftrelprs_chr" 124 "pftrelprs_dirt_lkg" 125 "ps_toil_max_h_t" 126 "ps_toil_max_l_t" 127 "ps_toil_min_h_t" 128 "ps_toil_min_l_t" 129 "ps_toil_sig_nok" 130 "psoilprty_max_h_t" 131 "psoilprty_max_l_t" 132 "psoilprty_min_h_t" 133 "psoilprty_min_l_t" 134 "psoilprty_sig_nok" 135 "psoilvisc_max_h_t" 136 "psoilvisc_max_l_t" 137 "psoilvisc_min_h_t" 138 "psoilvisc_min_l_t" 139 "psoilvisc_sig_nok" 140 "pws_1_h" 141 "pws_1_l" 142 "pws_2_h" 143 "pws_2_l" 144 "pws_3_h" 145 "pws_3_l" 146 "sens_amp_h" 147 "sens_amp_l" 148 "sens_amp_reg_chr" 149 "sens_emtv_nok" 150 "sens_ex_prs_h" 151 "sens_ex_prs_l" 152 "sens_it_1_nok" 153 "sens_it_2_nok" 154 "sens_it_chr" 155 "sens_it_nok" 156 "sens_it_sig_mcut" 157 "sens_maf_h" 158 "sens_maf_l" 159 "sens_map_h" 160 "sens_map_l" 161 "sens_map_nok" 162 "sens_map_oc" 163 "sens_map_scg" 164 "sens_map_scw" 165 "sens_pft_dp_h" 166 "sens_pft_dp_l" 167 "sens_pft_dp_oor" 168 "sens_pftrelprs_h" 169 "sens_pftrelprs_l" 170 "sens_pftrelprs_oor" 171 "sens_spg_h" 172 "sens_spg_l" 173 "sens_spg_nok" 174 "sens_spg_oc" 175 "sens_spg_scg" 176 "sens_spg_scw" 177 "sens_tco_h" 178 "sens_tco_l" 179 "sens_tia_h" 180 "sens_tia_l" 181 "sens_toil_h" 182 "sens_toil_l" 183 "sens_up_it_temp_h" 184 "sens_up_it_temp_l" 185 "spg_reg_apl_down" 186 "spg_reg_apl_up" 187 "spg_reg_neg_err" 188 "spg_reg_pos_err" 189 "tbt_chr" 190 "tbt_h" 191 "tbt_l" 192 "tbt_reg_neg_err" 193 "tbt_reg_pos_err" 194 "thpl_cmd1_oc" 195 "thpl_cmd1_scg" 196 "thpl_cmd1_scw" 197 "thpl_cmd2_oc" 198 "thpl_cmd2_scg" 199 "thpl_cmd2_scw" 200 "thpl_cmd3_oc" 201 "thpl_cmd3_scg" 202 "thpl_cmd3_scw" 203 "vb_h" 204 "vb_l" 205 "vb_rly_oc_scg" 206 "vb_rly_scw" 207 "vnt_oc" 208 "vnt_scg" 209 "vnt_scw" 210 "cp_oc" 211 "cp_scg" 212 "cp_scw" 213 "sens_mat_h" 214 "sens_mat_l" 215 "egr_cool_dirt_lkg" 216 "fuel_temp_l" 217 "fuel_temp_plaus" 218 "fuel_temp_scg" 219 "fuel_temp_h" 220 "fuel_temp_sig_mcut" 221 "maf_reg_dirt_lkg" 222 "pcv_h" 223 "pcv_oc" 224 "pcv_scg" 225 "pcv_scw" 226 "rail_prs_plaus" 227 "rail_prs_h_lvl" 228 "rail_prs_l" 229 "rail_prs_scg" 230 "rail_prs_h" 231 "rail_prs_sig_mcut" 232 "sens_amp_oc" 233 "sens_amp_scg" 234 "sens_amp_scw" 235 "sens_ex_prs_no_lk" 236 "sens_ex_prs_nok" 237 "sens_maf_oc" 238 "sens_maf_scg" 239 "sens_maf_scw" 240 "sens_tia_oc" 241 "sens_tia_scg" 242 "sens_tia_scw" 243 "vcv_h" 244 "vcv_oc" 245 "vcv_scg" 246 "vcv_scw" 247 "bgin_clu_cmp" 248 "bgin_clu_nok" 249 "brk_pdl_chr" 250 "brk_pdl_clos_nok" 251 "brk_pdl_cmp" 252 "brk_pdl_no_norm" 253 "brk_pdl_open_nok" 254 "cata_cpt" 255 "cru_cmp" 256 "cru_sl_swi_chr" 257 "cru_sl_tot" 258 "cru_vs_cmp" 259 "cru_whl_cmd_nok" 260 "cru_whl_cmd_oc_scw" 261 "cru_whl_cmd_oor" 262 "cyl_bal_1_h_lvl" 263 "cyl_bal_1_l_lvl" 264 "cyl_bal_2_h_lvl" 265 "cyl_bal_2_l_lvl" 266 "cyl_bal_3_h_lvl" 267 "cyl_bal_3_l_lvl" 268 "cyl_bal_4_h_lvl" 269 "cyl_bal_4_l_lvl" 270 "efi_sldv_oc" 271 "efi_sldv_scg" 272 "efi_sldv_scw" 273 "ff_actr_blk_clos" 274 "ff_actr_blk_open" 275 "ff_actr_crt_up" 276 "ff_fct_dirt_lkg" 277 "ff_fct_h_lvl" 278 "ff_fct_l_lvl" 279 "ff_fct_neg_err" 280 "ff_fct_pos_err" 281 "ff_fct_shp" 282 "fprs_actr_blk_clos" 283 "fprs_actr_blk_open" 284 "fprs_actr_crt_up" 285 "fprs_fct_dirt_lkg" 286 "fprs_fct_h_lvl" 287 "fprs_fct_l_lvl" 288 "fprs_fct_neg_err" 289 "fprs_fct_pos_err" 290 "fprs_fct_shp" 291 "fprs_h_oor" 292 "fprs_l_oor" 293 "fsys_cpt" 294 "fsys_lpg_cpt" 295 "inj1_chk_sum" 296 "inj1_crt_intv" 297 "inj1_fast_trs" 298 "inj1_slow_trs" 299 "inj2_chk_sum" 300 "inj2_crt_intv" 301 "inj2_fast_trs" 302 "inj2_slow_trs" 303 "inj3_chk_sum" 304 "inj3_crt_intv" 305 "inj3_fast_trs" 306 "inj3_slow_trs" 307 "inj4_chk_sum" 308 "inj4_crt_intv" 309 "inj4_fast_trs" 310 "inj4_slow_trs" 311 "lbdw_hot_oc" 312 "lbdw_hot_scg" 313 "lbdw_hot_scw" 314 "lbup_hot_oc" 315 "lbup_hot_scg" 316 "lbup_hot_scw" 317 "map_chr" 318 "map_oor" 319 "mis_1_cata" 320 "mis_1_lpg_cata" 321 "mis_1_lpg_trs_h" 322 "mis_1_trs_h" 323 "mis_2_cata" 324 "mis_2_lpg_cata" 325 "mis_2_lpg_trs_h" 326 "mis_2_trs_h" 327 "mis_3_cata" 328 "mis_3_lpg_cata" 329 "mis_3_lpg_trs_h" 330 "mis_3_trs_h" 331 "mis_4_cata" 332 "mis_4_lpg_cata" 333 "mis_4_lpg_trs_h" 334 "mis_4_trs_h" 335 "mis_cata" 336 "mis_lpg_cata" 337 "mis_lpg_trs_h" 338 "mis_min_fuel_cata" 339 "mis_min_fuel_trs_h" 340 "mis_trs_h" 341 "mis_unk_cata" 342 "mis_unk_lpg_cata" 343 "mis_unk_lpg_trs_h" 344 "mis_unk_trs_h" 345 "sens_wfl_h" 346 "sens_wfl_l" 347 "spg_chr" 348 "spg_oor" 349 "tlz_ad_b_cpt" 350 "unk_thpl_chr" 351 "unk_thpl1_chr" 352 "unk_thpl2_chr" 353 "unk_thpl3_chr" 354 "unk_thpl4_chr" 355 "wgc_oc" 356 "wgc_scg" 357 "wgc_scw" 358 "wpmp_tcr_oc" 359 "wpmp_tcr_scg" 360 "wpmp_tcr_scw" 361 "crk_chr" 362 "crk_cyc" 363 "crk_el" 364 "crk_no_norm" 365 "crk_syn" 366 "ex_cam_chr" 367 "ex_cam_crk_cmp" 368 "ex_cam_l_puls" 369 "ex_cam_syn" 370 "in_cam_chr" 371 "in_cam_crk_cmp" 372 "in_cam_frq_h" 373 "in_cam_l_puls" 374 "in_cam_no_sig" 375 "in_cam_syn" 376 "in_vvtc_ad" 377 "it_reg_el" 378 "lbup_cpt" 379 "sens_pftrelprs_lkg" 380 "sens_pftrelprs_nok" 381 "sens_wfl_oc" 382 "ups_crt_intv" 383 "ups_heat_scg" 384 "ups_heat_scw" 385 "ups_hot_chr" 386 "ups_lamb_oc" 387 "ups_lamb_scg" 388 "ups_lamb_scw" 389 "ups_pump_oc" 390 "ups_pump_scg" 391 "ups_pump_scw" 392 "ups_shp" 393 "ups_slow_trs" 394 "ups_trim_oc" 395 "ups_trim_scg" 396 "ups_trim_scw" 397 "ups_virt_scg" 398 "ups_virt_scw" 399 "egr_byp_h" 400 "egr_byp_l" 401 "vnt_h" 402 "vnt_l" 403 "oit_hbdg_el" 404 "oit_hbdg_ovh" 405 "sit_hbdg_el" 406 "sit_hbdg_ovh" 407 "sit_reg_el" 408 "sit_reg_blk" 409 "sit_reg_blk_open" 410 "ff_actr_blk" 411 "fprs_actr_blk" 412 "sens_rup_l" 413 "sens_rup_h" 414 "rup_dirt_lkg" 415 "rup_nok" 416 "sfty_tq_chr" 417 "sfty_tq_clc_chr" 418 "sfty_tq_lih_chr" 419 "ff_actr_crt_down" 420 "fprs_actr_crt_down" 421 "fprs_fct_chr" 422 "tbt_reg_apl_up" 423 "crk_no_sig" 424 "crk_puls" 425 "crk_trs" 426 "ecm_err_itl" 427 "ecm_mon_tron" 428 "glow_cmd_cpt_blk" 429 "glow_cmd_fail" 430 "inj_ecu_itl" 431 "inj1_4_oor" 432 "inj1_freq_l" 433 "inj1_h_lvl" 434 "inj1_h_puls" 435 "inj1_l_lvl" 436 "inj1_l_puls" 437 "inj1_nok" 438 "inj1_r" 439 "inj1_shp" 440 "inj2_3_oor" 441 "inj2_freq_l" 442 "inj2_h_lvl" 443 "inj2_h_puls" 444 "inj2_l_lvl" 445 "inj2_l_puls" 446 "inj2_nok" 447 "inj2_r" 448 "inj2_shp" 449 "inj3_freq_l" 450 "inj3_h_lvl" 451 "inj3_h_puls" 452 "inj3_l_lvl" 453 "inj3_l_puls" 454 "inj3_nok" 455 "inj3_r" 456 "inj3_shp" 457 "inj4_freq_l" 458 "inj4_h_lvl" 459 "inj4_h_puls" 460 "inj4_l_lvl" 461 "inj4_l_puls" 462 "inj4_nok" 463 "inj4_r" 464 "inj4_shp" 465 "ip_lght_tco_ovh" 466 "map_nok" 467 "ptc_rov_oc" 468 "ptc_rov_scg" 469 "ptc_rov_scw" 470 "sens_alt_pwm_h" 471 "sens_alt_pwm_l" 472 "sfty_tq_lim" 473 "spg_nok" 474 "tbf_fct_apl_down" 475 "tbf_fct_apl_up" 476 "in_cam_nok" 477 "in_cam_cyc" 478 "crk_cmp" 479 "crk_shp" 480 "crk_oc" 481 "inj_oor" 482 "ecm_inj_bus_mcut" 483 "ecm_inj_ini" 484 "ecm_inj_oor" 485 "cl_rich_chr" 486 "ecm_mon_secu_1" 487 "ecm_mon_secu_2" 488 "ecm_adc_tron" 489 "wpmp_egr_oc" 490 "wpmp_egr_scg" 491 "wpmp_egr_scw" 492 "mdf1_oc" 493 "mdf1_scg" 494 "mdf1_scw" 495 "mdf2_oc" 496 "mdf2_scg" 497 "mdf2_scw" 498 "pft_nok_cge" 499 "tqi_cor_chr" 500 "fsys_apl_down" 501 "fsys_apl_up" 502 "fsys_h_lvl" 503 "ff_fct_chr" 504 "ff_fct_no_norm" 505 "ecm_inj_h" 506 "ecm_inj_l" 507 "ecm_inj_cpt_blk" 508 "ecm_it_nok" 509 "ecm_inj_no_norm" 510 "ecm_err_no_norm" 511 "ecm_inj_cmp" 512 "ecm_mcw_clc_chr" 513 "ecm_mcw_nok" 514 "ecm_mcw_seq_ctr" 515 "amp_reg_chr" 516 "ups_ro2_oor" 517 "ups_ro2_slow_trs" 518 "ups_tip_oor" 519 "sens_tco_sig_mcut" 520 "igc_1_oc" 521 "alt_pwm_apl_down" 522 "igc_1_scg" 523 "igc_1_scw" 524 "igc_2_oc" 525 "inj_cpt_blk" 526 "inj1_frq_l" 527 "inj2_frq_l" 528 "inj3_frq_l" 529 "inj4_frq_l" 530 "ff_actr_ovh" 531 "fprs_actr_ovh" 532 "ac_clu_oc" 533 "ac_clu_scg" 534 "ac_clu_scw" 535 "sfty_tq_supl" 536 "ups_uo2_oor" 537 "ups_ecu_oor" 538 "ups_ecu_itl" 539 "ups_ecu_chr" 540 "sens_ups_wire_scw" 541 "sens_ups_wire_oc" 542 "sens_ups_virt_oc" 543 "sens_ups_pump_oc" 544 "sens_ups_lamb_oc" 545 "sens_ups_heat_oc" 546 "sens_ups_heat_ovh" 547 "sens_ups_heat_scg" 548 "sens_ups_heat_scw" 549 "ecm_it_lih_chr" 550 "sens_ups_wire_scg" 551 "wpmp_tcr_blk" 552 "ecm_temp_nok" 553 "cp_blk_open" 554 "evap_chr" 555 "eva_fcap_abn_cple" 556 "eva_fcap_no_lk" 557 "evap_lkg" 558 "eva_sldv_blk_clos" 559 "eva_sldv_oc" 560 "eva_sldv_scg" 561 "eva_sldv_scw" 562 "sens_rvc_h" 563 "sens_rvc_l" 564 "sens_rvc_nok" 565 "sens_rvc_sig_mcut" 566 "lbup_nok" 567 "lbup_hot_apl_down" 568 "igc_2_scg" 569 "igc_2_scw" 570 "igc_3_oc" 571 "igc_3_scg" 572 "igc_3_scw" 573 "igc_4_oc" 574 "igc_4_scg" 575 "igc_4_scw" 576 "egr_byp_blk" 577 "isr_h_lvl" 578 "isr_l_lvl" 579 "sfty_tq_fail" 580 "vb_clc_chr" 581 "lbdw_hot_dirt_lkg" 582 "lbup_hot_dirt_lkg" 583 "spg_cmd_blk_clos" 584 "sens_egr_temp_h" 585 "sens_egr_temp_l" 586 "tco_cl_no_norm" 587 "tsta_reg_no_norm" 588 "dps_ecu_chr" 589 "dps_ecu_itl" 590 "dps_ecu_oor" 591 "dps_ro2_oor" 592 "dps_ro2_slow_trs" 593 "dps_tip_oor" 594 "dps_uo2_oor" 595 "sens_dps_heat_oc" 596 "sens_dps_heat_ovh" 597 "sens_dps_heat_scg" 598 "sens_dps_heat_scw" 599 "sens_dps_lamb_oc" 600 "sens_dps_pump_oc" 601 "sens_dps_virt_oc" 602 "sens_dps_wire_scg" 603 "sens_dps_wire_scw" 604 "it_reg_ad" 605 "mafs_apl_down" 606 "mafs_apl_up" 607 "mvac_pump_rly_h" 608 "mvac_pump_rly_l" 609 "mvac_sys_cpt" 610 "oil_dil_nok" 611 "pft_rgn_dirt" 612 "ptc1_oc" 613 "ptc1_scg" 614 "ptc1_scw" 615 "ptc2_oc" 616 "ptc2_scg" 617 "ptc2_scw" 618 "ptc3_oc" 619 "ptc3_scg" 620 "ptc3_scw" 621 "inj_ecu_bus_mcut" 622 "wpmp_egr_2_freq_h" 623 "wpmp_egr_2_freq_l" 624 "wpmp_egr_2_no_sig" 625 "wpmp_egr_2_oc" 626 "wpmp_egr_2_scg" 627 "wpmp_egr_2_scw" 628 "wpmp_egr_freq_h" 629 "wpmp_egr_freq_l" 630 "wpmp_egr_no_sig" 631 "wpmp_egr_2_frq_h" 632 "wpmp_egr_2_frq_l" 633 "wpmp_egr_frq_h" 634 "wpmp_egr_frq_l" 635 "efi_sldv_2_oc" 636 "efi_sldv_2_scg" 637 "efi_sldv_2_scw" 638 "et_hbdg_el" 639 "et_hbdg_ovh" 640 "et_ofs_no_norm" 641 "et_reg_blk" 642 "et_reg_blk_clos" 643 "et_reg_blk_open" 644 "et_reg_dirt" 645 "fuel_csm_h" 646 "fuel_csm_l" 647 "fuel_lvl_h" 648 "fuel_lvl_l" 649 "gas_pump_2_oc" 650 "gas_pump_2_scg" 651 "gas_pump_2_scw" 652 "lpev_flow_meca" 653 "lpev_hbdg_el" 654 "lpev_hbdg_ovh" 655 "lpev_ofs_no_norm" 656 "lpev_reg_blk" 657 "lpev_reg_blk_open" 658 "lpev_reg_dirt" 659 "sens_et_nok" 660 "sens_lpev_nok" 661 "sens_vs_chr" 662 "sens_vs_h_puls" 663 "sens_vs_l_puls" 664 "fuel_csm_oc" 665 "fuel_csm_scg" 666 "fuel_csm_scw" 667 "etc_chr" 668 "etc_no_frm" 669 "etc_seq_ctr" 670 "sens_swrl_nok" 671 "swrl_hbdg_el" 672 "swrl_hbdg_ovh" 673 "swrl_ofs_no_norm" 674 "swrl_reg_blk_clos" 675 "swrl_reg_blk_open" 676 "swrl_reg_dirt" 677 "ecm_pws_oor" 678 "fco_vlv_oc" 679 "fco_vlv_scg" 680 "fco_vlv_scw" 681 "gas_slv_oc" 682 "gas_slv_scg" 683 "gas_slv_scw" 684 "lp_egr_cool_dtp_h" 685 "lp_egr_cool_dtp_l" 686 "mil_h" 687 "mil_l" 688 "tbf_mon_ovh" 689 "glow_cmd_ovh" /end COMPU_VTAB
/begin COMPU_METHOD _CNV_A_R_LINEAR_____226_CM "" RAT_FUNC "%6.3" "∞C" COEFFS 0 10. 2730. 0 0 1 /end COMPU_METHOD
/begin RECORD_LAYOUT _REC_S1VAL_20_u1 FNC_VALUES 1 UBYTE COLUMN_DIR DIRECT /end RECORD_LAYOUT
/begin RECORD_LAYOUT _REC_S1VAL_20_u2 FNC_VALUES 1 UWORD COLUMN_DIR DIRECT /end RECORD_LAYOUT
/begin FUNCTION DgDftMng_Failmgt ""
 /begin DEF_CHARACTERISTIC Cxx_dyn_thd Cxx_obd_dc_off Cxx_obd_wup_thd Cxx_wup_dif_thd_tco Cxx_wup_thd_tco /end DEF_CHARACTERISTIC
 /begin OUT_MEASUREMENT Stx_esd[0] Sxx_clr_dist Sxx_clr_wup Sxx_dyn_ctr Sxx_mil_on_km Sxx_tmp_dist_1 Sxx_tmp_dist_2 Vbx_eng_aut_fm Vbx_eng_stop Vbx_igk_on_sta_pws Vbx_mil_ecu_req Vbx_mil_prmt_req Vbx_obd_dc Vbx_obd_wup Vbx_wal_1_req Vbx_wal_2_req Vbx_wup Vxx_dtc_hmb_cf_redg_edic Vxx_dtc_lb_cf_redg_edic Vxx_esd_did_nr Vxx_esd_ind Vxx_esd_ind_ini Vxx_esd_ind_max Vxx_esd_siz Vxx_ind_fail_redg Vxx_ind_mfo_redg Vxx_ind_obd_clf_redg Vxx_ind_obd_fedg Vxx_ind_pfo_redg Vxx_tco_ini Vxx_tmp_pri Vtx_fail_dc_dyn_0 Vtx_ind_dyn_0 Vtx_fail_dc_dyn_1 Vtx_ind_dyn_1 Vtx_fail_dc_dyn_2 Vtx_ind_dyn_2 Vtx_fail_dc_dyn_3 Vtx_ind_dyn_3 Vtx_fail_dc_dyn_4 Vtx_ind_dyn_4 Vtx_fail_dc_dyn_5 Vtx_ind_dyn_5 Vtx_fail_dc_dyn_6 Vtx_ind_dyn_6 Vtx_fail_dc_dyn_7 Vtx_ind_dyn_7 Vtx_fail_dc_dyn_8 Vtx_ind_dyn_8 Vtx_fail_dc_dyn_9 Vtx_ind_dyn_9 Sxx_dist_fail_dyn_0 Sxx_tmp_dist_dyn_0 Sxx_km_cf_dyn_0 Sxx_km_mf_dyn_0 Sxx_km_pass_dyn_0 Sxx_ind_dyn_0 Sxx_ffm_esti_tqe_dyn_0 Sxx_ffm_esti_tqe_min_dyn_0 Sxx_ffm_esti_tqe_max_dyn_0 Sxx_ffm_n_dyn_0 Sxx_ffm_n_min_dyn_0 Sxx_ffm_n_max_dyn_0 Sxx_ffm_tco_dyn_0 Sxx_ffm_tco_min_dyn_0 Sxx_ffm_tco_max_dyn_0 Sxx_ffm_vb_dyn_0 Sxx_ffm_vb_min_dyn_0 Sxx_ffm_vb_max_dyn_0 Sxx_ffm_vs_dyn_0 Sxx_ffm_vs_min_dyn_0 Sxx_ffm_vs_max_dyn_0 Sxx_ffm_did_1_dyn_0 Sxx_ffm_did_2_dyn_0 Sxx_ffm_did_3_dyn_0 Sxx_ffm_did_4_dyn_0 Sxx_ffm_did_5_dyn_0 Sxx_ffm_did_1_max_dyn_0 Sxx_ffm_did_2_max_dyn_0 Sxx_ffm_did_3_max_dyn_0 Sxx_ffm_did_4_max_dyn_0 Sxx_ffm_did_5_max_dyn_0 Sxx_ffm_did_1_min_dyn_0 Sxx_ffm_did_2_min_dyn_0 Sxx_ffm_did_3_min_dyn_0 Sxx_ffm_did_4_min_dyn_0 Sxx_ffm_did_5_min_dyn_0 Sbx_pfo_dyn_0 Sbx_mfo_dyn_0 Sbx_obd_mreq_dyn_0 Sxx_obd_wctr_dyn_0 Sxx_frq_dyn_0 Sxx_obd_clfctr_dyn_0 Sxx_esd_siz_dyn_0 Sxx_pri_dyn_0 Sxx_dist_fail_dyn_1 Sxx_tmp_dist_dyn_1 Sxx_km_cf_dyn_1 Sxx_km_mf_dyn_1 Sxx_km_pass_dyn_1 Sxx_ind_dyn_1 Sxx_ffm_esti_tqe_dyn_1 Sxx_ffm_esti_tqe_min_dyn_1 Sxx_ffm_esti_tqe_max_dyn_1 Sxx_ffm_n_dyn_1 Sxx_ffm_n_min_dyn_1 Sxx_ffm_n_max_dyn_1 Sxx_ffm_tco_dyn_1 Sxx_ffm_tco_min_dyn_1 Sxx_ffm_tco_max_dyn_1 Sxx_ffm_vb_dyn_1 Sxx_ffm_vb_min_dyn_1 Sxx_ffm_vb_max_dyn_1 Sxx_ffm_vs_dyn_1 Sxx_ffm_vs_min_dyn_1 Sxx_ffm_vs_max_dyn_1 Sxx_ffm_did_1_dyn_1 Sxx_ffm_did_2_dyn_1 Sxx_ffm_did_3_dyn_1 Sxx_ffm_did_4_dyn_1 Sxx_ffm_did_5_dyn_1 Sxx_ffm_did_1_max_dyn_1 Sxx_ffm_did_2_max_dyn_1 Sxx_ffm_did_3_max_dyn_1 Sxx_ffm_did_4_max_dyn_1 Sxx_ffm_did_5_max_dyn_1 Sxx_ffm_did_1_min_dyn_1 Sxx_ffm_did_2_min_dyn_1 Sxx_ffm_did_3_min_dyn_1 Sxx_ffm_did_4_min_dyn_1 Sxx_ffm_did_5_min_dyn_1 Sbx_pfo_dyn_1 Sbx_mfo_dyn_1 Sbx_obd_mreq_dyn_1 Sxx_obd_wctr_dyn_1 Sxx_frq_dyn_1 Sxx_obd_clfctr_dyn_1 Sxx_esd_siz_dyn_1 Sxx_pri_dyn_1 Sxx_dist_fail_dyn_2 Sxx_tmp_dist_dyn_2 Sxx_km_cf_dyn_2 Sxx_km_mf_dyn_2 Sxx_km_pass_dyn_2 Sxx_ind_dyn_2 Sxx_ffm_esti_tqe_dyn_2 Sxx_ffm_esti_tqe_min_dyn_2 Sxx_ffm_esti_tqe_max_dyn_2 Sxx_ffm_n_dyn_2 Sxx_ffm_n_min_dyn_2 Sxx_ffm_n_max_dyn_2 Sxx_ffm_tco_dyn_2 Sxx_ffm_tco_min_dyn_2 Sxx_ffm_tco_max_dyn_2 Sxx_ffm_vb_dyn_2 Sxx_ffm_vb_min_dyn_2 Sxx_ffm_vb_max_dyn_2 Sxx_ffm_vs_dyn_2 Sxx_ffm_vs_min_dyn_2 Sxx_ffm_vs_max_dyn_2 Sxx_ffm_did_1_dyn_2 Sxx_ffm_did_2_dyn_2 Sxx_ffm_did_3_dyn_2 Sxx_ffm_did_4_dyn_2 Sxx_ffm_did_5_dyn_2 Sxx_ffm_did_1_max_dyn_2 Sxx_ffm_did_2_max_dyn_2 Sxx_ffm_did_3_max_dyn_2 Sxx_ffm_did_4_max_dyn_2 Sxx_ffm_did_5_max_dyn_2 Sxx_ffm_did_1_min_dyn_2 Sxx_ffm_did_2_min_dyn_2 Sxx_ffm_did_3_min_dyn_2 Sxx_ffm_did_4_min_dyn_2 Sxx_ffm_did_5_min_dyn_2 Sbx_pfo_dyn_2 Sbx_mfo_dyn_2 Sbx_obd_mreq_dyn_2 Sxx_obd_wctr_dyn_2 Sxx_frq_dyn_2 Sxx_obd_clfctr_dyn_2 Sxx_esd_siz_dyn_2 Sxx_pri_dyn_2 Sxx_dist_fail_dyn_3 Sxx_tmp_dist_dyn_3 Sxx_km_cf_dyn_3 Sxx_km_mf_dyn_3 Sxx_km_pass_dyn_3 Sxx_ind_dyn_3 Sxx_ffm_esti_tqe_dyn_3 Sxx_ffm_esti_tqe_min_dyn_3 Sxx_ffm_esti_tqe_max_dyn_3 Sxx_ffm_n_dyn_3 Sxx_ffm_n_min_dyn_3 Sxx_ffm_n_max_dyn_3 Sxx_ffm_tco_dyn_3 Sxx_ffm_tco_min_dyn_3 Sxx_ffm_tco_max_dyn_3 Sxx_ffm_vb_dyn_3 Sxx_ffm_vb_min_dyn_3 Sxx_ffm_vb_max_dyn_3 Sxx_ffm_vs_dyn_3 Sxx_ffm_vs_min_dyn_3 Sxx_ffm_vs_max_dyn_3 Sxx_ffm_did_1_dyn_3 Sxx_ffm_did_2_dyn_3 Sxx_ffm_did_3_dyn_3 Sxx_ffm_did_4_dyn_3 Sxx_ffm_did_5_dyn_3 Sxx_ffm_did_1_max_dyn_3 Sxx_ffm_did_2_max_dyn_3 Sxx_ffm_did_3_max_dyn_3 Sxx_ffm_did_4_max_dyn_3 Sxx_ffm_did_5_max_dyn_3 Sxx_ffm_did_1_min_dyn_3 Sxx_ffm_did_2_min_dyn_3 Sxx_ffm_did_3_min_dyn_3 Sxx_ffm_did_4_min_dyn_3 Sxx_ffm_did_5_min_dyn_3 Sbx_pfo_dyn_3 Sbx_mfo_dyn_3 Sbx_obd_mreq_dyn_3 Sxx_obd_wctr_dyn_3 Sxx_frq_dyn_3 Sxx_obd_clfctr_dyn_3 Sxx_esd_siz_dyn_3 Sxx_pri_dyn_3 Sxx_dist_fail_dyn_4 Sxx_tmp_dist_dyn_4 Sxx_km_cf_dyn_4 Sxx_km_mf_dyn_4 Sxx_km_pass_dyn_4 Sxx_ind_dyn_4 Sxx_ffm_esti_tqe_dyn_4 Sxx_ffm_esti_tqe_min_dyn_4 Sxx_ffm_esti_tqe_max_dyn_4 Sxx_ffm_n_dyn_4 Sxx_ffm_n_min_dyn_4 Sxx_ffm_n_max_dyn_4 Sxx_ffm_tco_dyn_4 Sxx_ffm_tco_min_dyn_4 Sxx_ffm_tco_max_dyn_4 Sxx_ffm_vb_dyn_4 Sxx_ffm_vb_min_dyn_4 Sxx_ffm_vb_max_dyn_4 Sxx_ffm_vs_dyn_4 Sxx_ffm_vs_min_dyn_4 Sxx_ffm_vs_max_dyn_4 Sxx_ffm_did_1_dyn_4 Sxx_ffm_did_2_dyn_4 Sxx_ffm_did_3_dyn_4 Sxx_ffm_did_4_dyn_4 Sxx_ffm_did_5_dyn_4 Sxx_ffm_did_1_max_dyn_4 Sxx_ffm_did_2_max_dyn_4 Sxx_ffm_did_3_max_dyn_4 Sxx_ffm_did_4_max_dyn_4 Sxx_ffm_did_5_max_dyn_4 Sxx_ffm_did_1_min_dyn_4 Sxx_ffm_did_2_min_dyn_4 Sxx_ffm_did_3_min_dyn_4 Sxx_ffm_did_4_min_dyn_4 Sxx_ffm_did_5_min_dyn_4 Sbx_pfo_dyn_4 Sbx_mfo_dyn_4 Sbx_obd_mreq_dyn_4 Sxx_obd_wctr_dyn_4 Sxx_frq_dyn_4 Sxx_obd_clfctr_dyn_4 Sxx_esd_siz_dyn_4 Sxx_pri_dyn_4 Sxx_dist_fail_dyn_5 Sxx_tmp_dist_dyn_5 Sxx_km_cf_dyn_5 Sxx_km_mf_dyn_5 Sxx_km_pass_dyn_5 Sxx_ind_dyn_5 Sxx_ffm_esti_tqe_dyn_5 Sxx_ffm_esti_tqe_min_dyn_5 Sxx_ffm_esti_tqe_max_dyn_5 Sxx_ffm_n_dyn_5 Sxx_ffm_n_min_dyn_5 Sxx_ffm_n_max_dyn_5 Sxx_ffm_tco_dyn_5 Sxx_ffm_tco_min_dyn_5 Sxx_ffm_tco_max_dyn_5 Sxx_ffm_vb_dyn_5 Sxx_ffm_vb_min_dyn_5 Sxx_ffm_vb_max_dyn_5 Sxx_ffm_vs_dyn_5 Sxx_ffm_vs_min_dyn_5 Sxx_ffm_vs_max_dyn_5 Sxx_ffm_did_1_dyn_5 Sxx_ffm_did_2_dyn_5 Sxx_ffm_did_3_dyn_5 Sxx_ffm_did_4_dyn_5 Sxx_ffm_did_5_dyn_5 Sxx_ffm_did_1_max_dyn_5 Sxx_ffm_did_2_max_dyn_5 Sxx_ffm_did_3_max_dyn_5 Sxx_ffm_did_4_max_dyn_5 Sxx_ffm_did_5_max_dyn_5 Sxx_ffm_did_1_min_dyn_5 Sxx_ffm_did_2_min_dyn_5 Sxx_ffm_did_3_min_dyn_5 Sxx_ffm_did_4_min_dyn_5 Sxx_ffm_did_5_min_dyn_5 Sbx_pfo_dyn_5 Sbx_mfo_dyn_5 Sbx_obd_mreq_dyn_5 Sxx_obd_wctr_dyn_5 Sxx_frq_dyn_5 Sxx_obd_clfctr_dyn_5 Sxx_esd_siz_dyn_5 Sxx_pri_dyn_5 Sxx_dist_fail_dyn_6 Sxx_tmp_dist_dyn_6 Sxx_km_cf_dyn_6 Sxx_km_mf_dyn_6 Sxx_km_pass_dyn_6 Sxx_ind_dyn_6 Sxx_ffm_esti_tqe_dyn_6 Sxx_ffm_esti_tqe_min_dyn_6 Sxx_ffm_esti_tqe_max_dyn_6 Sxx_ffm_n_dyn_6 Sxx_ffm_n_min_dyn_6 Sxx_ffm_n_max_dyn_6 Sxx_ffm_tco_dyn_6 Sxx_ffm_tco_min_dyn_6 Sxx_ffm_tco_max_dyn_6 Sxx_ffm_vb_dyn_6 Sxx_ffm_vb_min_dyn_6 Sxx_ffm_vb_max_dyn_6 Sxx_ffm_vs_dyn_6 Sxx_ffm_vs_min_dyn_6 Sxx_ffm_vs_max_dyn_6 Sxx_ffm_did_1_dyn_6 Sxx_ffm_did_2_dyn_6 Sxx_ffm_did_3_dyn_6 Sxx_ffm_did_4_dyn_6 Sxx_ffm_did_5_dyn_6 Sxx_ffm_did_1_max_dyn_6 Sxx_ffm_did_2_max_dyn_6 Sxx_ffm_did_3_max_dyn_6 Sxx_ffm_did_4_max_dyn_6 Sxx_ffm_did_5_max_dyn_6 Sxx_ffm_did_1_min_dyn_6 Sxx_ffm_did_2_min_dyn_6 Sxx_ffm_did_3_min_dyn_6 Sxx_ffm_did_4_min_dyn_6 Sxx_ffm_did_5_min_dyn_6 Sbx_pfo_dyn_6 Sbx_mfo_dyn_6 Sbx_obd_mreq_dyn_6 Sxx_obd_wctr_dyn_6 Sxx_frq_dyn_6 Sxx_obd_clfctr_dyn_6 Sxx_esd_siz_dyn_6 Sxx_pri_dyn_6 Sxx_dist_fail_dyn_7 Sxx_tmp_dist_dyn_7 Sxx_km_cf_dyn_7 Sxx_km_mf_dyn_7 Sxx_km_pass_dyn_7 Sxx_ind_dyn_7 Sxx_ffm_esti_tqe_dyn_7 Sxx_ffm_esti_tqe_min_dyn_7 Sxx_ffm_esti_tqe_max_dyn_7 Sxx_ffm_n_dyn_7 Sxx_ffm_n_min_dyn_7 Sxx_ffm_n_max_dyn_7 Sxx_ffm_tco_dyn_7 Sxx_ffm_tco_min_dyn_7 Sxx_ffm_tco_max_dyn_7 Sxx_ffm_vb_dyn_7 Sxx_ffm_vb_min_dyn_7 Sxx_ffm_vb_max_dyn_7 Sxx_ffm_vs_dyn_7 Sxx_ffm_vs_min_dyn_7 Sxx_ffm_vs_max_dyn_7 Sxx_ffm_did_1_dyn_7 Sxx_ffm_did_2_dyn_7 Sxx_ffm_did_3_dyn_7 Sxx_ffm_did_4_dyn_7 Sxx_ffm_did_5_dyn_7 Sxx_ffm_did_1_max_dyn_7 Sxx_ffm_did_2_max_dyn_7 Sxx_ffm_did_3_max_dyn_7 Sxx_ffm_did_4_max_dyn_7 Sxx_ffm_did_5_max_dyn_7 Sxx_ffm_did_1_min_dyn_7 Sxx_ffm_did_2_min_dyn_7 Sxx_ffm_did_3_min_dyn_7 Sxx_ffm_did_4_min_dyn_7 Sxx_ffm_did_5_min_dyn_7 Sbx_pfo_dyn_7 Sbx_mfo_dyn_7 Sbx_obd_mreq_dyn_7 Sxx_obd_wctr_dyn_7 Sxx_frq_dyn_7 Sxx_obd_clfctr_dyn_7 Sxx_esd_siz_dyn_7 Sxx_pri_dyn_7 Sxx_dist_fail_dyn_8 Sxx_tmp_dist_dyn_8 Sxx_km_cf_dyn_8 Sxx_km_mf_dyn_8 Sxx_km_pass_dyn_8 Sxx_ind_dyn_8 Sxx_ffm_esti_tqe_dyn_8 Sxx_ffm_esti_tqe_min_dyn_8 Sxx_ffm_esti_tqe_max_dyn_8 Sxx_ffm_n_dyn_8 Sxx_ffm_n_min_dyn_8 Sxx_ffm_n_max_dyn_8 Sxx_ffm_tco_dyn_8 Sxx_ffm_tco_min_dyn_8 Sxx_ffm_tco_max_dyn_8 Sxx_ffm_vb_dyn_8 Sxx_ffm_vb_min_dyn_8 Sxx_ffm_vb_max_dyn_8 Sxx_ffm_vs_dyn_8 Sxx_ffm_vs_min_dyn_8 Sxx_ffm_vs_max_dyn_8 Sxx_ffm_did_1_dyn_8 Sxx_ffm_did_2_dyn_8 Sxx_ffm_did_3_dyn_8 Sxx_ffm_did_4_dyn_8 Sxx_ffm_did_5_dyn_8 Sxx_ffm_did_1_max_dyn_8 Sxx_ffm_did_2_max_dyn_8 Sxx_ffm_did_3_max_dyn_8 Sxx_ffm_did_4_max_dyn_8 Sxx_ffm_did_5_max_dyn_8 Sxx_ffm_did_1_min_dyn_8 Sxx_ffm_did_2_min_dyn_8 Sxx_ffm_did_3_min_dyn_8 Sxx_ffm_did_4_min_dyn_8 Sxx_ffm_did_5_min_dyn_8 Sbx_pfo_dyn_8 Sbx_mfo_dyn_8 Sbx_obd_mreq_dyn_8 Sxx_obd_wctr_dyn_8 Sxx_frq_dyn_8 Sxx_obd_clfctr_dyn_8 Sxx_esd_siz_dyn_8 Sxx_pri_dyn_8 Sxx_dist_fail_dyn_9 Sxx_tmp_dist_dyn_9 Sxx_km_cf_dyn_9 Sxx_km_mf_dyn_9 Sxx_km_pass_dyn_9 Sxx_ind_dyn_9 Sxx_ffm_esti_tqe_dyn_9 Sxx_ffm_esti_tqe_min_dyn_9 Sxx_ffm_esti_tqe_max_dyn_9 Sxx_ffm_n_dyn_9 Sxx_ffm_n_min_dyn_9 Sxx_ffm_n_max_dyn_9 Sxx_ffm_tco_dyn_9 Sxx_ffm_tco_min_dyn_9 Sxx_ffm_tco_max_dyn_9 Sxx_ffm_vb_dyn_9 Sxx_ffm_vb_min_dyn_9 Sxx_ffm_vb_max_dyn_9 Sxx_ffm_vs_dyn_9 Sxx_ffm_vs_min_dyn_9 Sxx_ffm_vs_max_dyn_9 Sxx_ffm_did_1_dyn_9 Sxx_ffm_did_2_dyn_9 Sxx_ffm_did_3_dyn_9 Sxx_ffm_did_4_dyn_9 Sxx_ffm_did_5_dyn_9 Sxx_ffm_did_1_max_dyn_9 Sxx_ffm_did_2_max_dyn_9 Sxx_ffm_did_3_max_dyn_9 Sxx_ffm_did_4_max_dyn_9 Sxx_ffm_did_5_max_dyn_9 Sxx_ffm_did_1_min_dyn_9 Sxx_ffm_did_2_min_dyn_9 Sxx_ffm_did_3_min_dyn_9 Sxx_ffm_did_4_min_dyn_9 Sxx_ffm_did_5_min_dyn_9 Sbx_pfo_dyn_9 Sbx_mfo_dyn_9 Sbx_obd_mreq_dyn_9 Sxx_obd_wctr_dyn_9 Sxx_frq_dyn_9 Sxx_obd_clfctr_dyn_9 Sxx_esd_siz_dyn_9 Sxx_pri_dyn_9 /end OUT_MEASUREMENT
/end FUNCTION
/begin FUNCTION DgDftMng_Svcecom ""
 /begin DEF_CHARACTERISTIC Ntx_data_avl_list[0] Ntx_data_avl_list[1] Ntx_data_avl_list[2] Ntx_data_avl_list[3] Ntx_data_avl_list[4] Ntx_frm_avl_list[0] Ntx_frm_avl_list[1] Ntx_frm_avl_list[2] Ntx_frm_avl_list[3] /end DEF_CHARACTERISTIC
 /begin OUT_MEASUREMENT Vxx_capture_all_nr Vxx_capture_all_pres_iter Vxx_capture_obd_nr Vxx_capture_obd_pres_iter Vxx_get_ind_pres_iter /end OUT_MEASUREMENT
/end FUNCTION
/end MODULE
/end PROJECT
