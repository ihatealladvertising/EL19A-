ASAP2_VERSION 1 41
/begin PROJECT RD8 "_default_ProjectLongIdentifier"
/begin HEADER "_default_HeaderComment" PROJECT_NO RD9 /end HEADER
/begin MODULE _default_ModuleName "_default_ModuleLongIdentifier"
/begin MOD_COMMON "_default_ModCommonComment" DEPOSIT ABSOLUTE BYTE_ORDER MSB_LAST ALIGNMENT_BYTE 1 ALIGNMENT_WORD 2 ALIGNMENT_LONG 2 ALIGNMENT_FLOAT32_IEEE 2 ALIGNMENT_FLOAT64_IEEE 4 /end MOD_COMMON
/begin AXIS_PTS Ctb_tco2 "Engine coolant temperature breakpoints" 0xa002e01c Vxx_tco _REC_A2AXS_20_u2 240. _CNV_A_R_LINEAR_____54_CM 9 -40. 200. FORMAT "%5.1" /end AXIS_PTS
/begin AXIS_PTS Ctb_agb_tq_csm_is_n_sp "Breakpoint of the final idle speed setpoint" 0xa00295c4 Vxx_is_n_sp _REC_A2AXS_20_u2 16383.75 _CNV_A_R_ENSD_LINEA_24_CM 5 0. 16383.75 FORMAT "%8.2" /end AXIS_PTS
/begin CHARACTERISTIC Cmp_agb_csm_tq_brk_pdl_cor "Temporary brake torque correction" MAP 0xa00295d0 _REC_A1MAP_20_u2_u2_u2 2047.96875 _CNV_A_R_LINEAR_____123_CM 0. 2047.96875 FORMAT "%10.5"
 /begin AXIS_DESCR COM_AXIS Vxx_toil _CNV_A_R_LINEAR_____54_CM 16 -40. 200. FORMAT "%5.1" AXIS_PTS_REF Ctb_toil /end AXIS_DESCR
 /begin AXIS_DESCR COM_AXIS Vxx_is_n_sp _CNV_A_R_ENSD_LINEA_24_CM 5 0. 16383.75 FORMAT "%8.2" AXIS_PTS_REF Ctb_agb_tq_csm_is_n_sp /end AXIS_DESCR
/end CHARACTERISTIC
/begin CHARACTERISTIC Cmp_agb_csm_tq_drag_red_cor "Temporary drag reduction torque correction" MAP 0xa0029670 _REC_A1MAP_20_u2_u2_u2 2047.96875 _CNV_A_R_LINEAR_____123_CM 0. 2047.96875 FORMAT "%10.5"
 /begin AXIS_DESCR COM_AXIS Vxx_toil _CNV_A_R_LINEAR_____54_CM 16 -40. 200. FORMAT "%5.1" AXIS_PTS_REF Ctb_toil /end AXIS_DESCR
 /begin AXIS_DESCR COM_AXIS Vxx_is_n_sp _CNV_A_R_ENSD_LINEA_24_CM 5 0. 16383.75 FORMAT "%8.2" AXIS_PTS_REF Ctb_agb_tq_csm_is_n_sp /end AXIS_DESCR
/end CHARACTERISTIC
/begin CHARACTERISTIC Cmp_agb_csm_tq_neut_dri_cor "Temporary N->D torque correction" MAP 0xa0029710 _REC_A1MAP_20_u2_u2_u2 2047.96875 _CNV_A_R_LINEAR_____123_CM 0. 2047.96875 FORMAT "%10.5"
 /begin AXIS_DESCR COM_AXIS Vxx_toil _CNV_A_R_LINEAR_____54_CM 16 -40. 200. FORMAT "%5.1" AXIS_PTS_REF Ctb_toil /end AXIS_DESCR
 /begin AXIS_DESCR COM_AXIS Vxx_is_n_sp _CNV_A_R_ENSD_LINEA_24_CM 5 0. 16383.75 FORMAT "%8.2" AXIS_PTS_REF Ctb_agb_tq_csm_is_n_sp /end AXIS_DESCR
/end CHARACTERISTIC
/begin CHARACTERISTIC Ctp_agb_csm_brk_pdl_dly_cor "Duration of brake torque losses correction before decrementation" CURVE 0xa00297b0 _REC_A1CUR_20_u2_u2 655.35 _CNV_A_R_LINEAR_____34_CM 0. 655.35 FORMAT "%6.2"
 /begin AXIS_DESCR COM_AXIS Vxx_toil _CNV_A_R_LINEAR_____54_CM 16 -40. 200. FORMAT "%5.1" AXIS_PTS_REF Ctb_toil /end AXIS_DESCR
/end CHARACTERISTIC
/begin CHARACTERISTIC Ctp_agb_csm_drag_red_dly_cor "Duration of drag reduction torque correction before decrementation" CURVE 0xa00297d0 _REC_A1CUR_20_u2_u2 655.35 _CNV_A_R_LINEAR_____34_CM 0. 655.35 FORMAT "%6.2"
 /begin AXIS_DESCR COM_AXIS Vxx_toil _CNV_A_R_LINEAR_____54_CM 16 -40. 200. FORMAT "%5.1" AXIS_PTS_REF Ctb_toil /end AXIS_DESCR
/end CHARACTERISTIC
/begin CHARACTERISTIC Ctp_agb_csm_neut_dri_dly_cor "Duration of coupler torque losses correction before decrementation" CURVE 0xa00297f0 _REC_A1CUR_20_u2_u2 655.35 _CNV_A_R_LINEAR_____34_CM 0. 655.35 FORMAT "%6.2"
 /begin AXIS_DESCR COM_AXIS Vxx_toil _CNV_A_R_LINEAR_____54_CM 16 -40. 200. FORMAT "%5.1" AXIS_PTS_REF Ctb_toil /end AXIS_DESCR
/end CHARACTERISTIC
/begin CHARACTERISTIC Ctp_agb_tq_stop_max_cor "Maximum value of Stop Vehicle troque correction" CURVE 0xa0029810 _REC_A1CUR_20_u2_u2 2047.96875 _CNV_A_R_LINEAR_____123_CM 0. 2047.96875 FORMAT "%10.5"
 /begin AXIS_DESCR COM_AXIS Vxx_tco _CNV_A_R_LINEAR_____54_CM 9 -40. 200. FORMAT "%5.1" AXIS_PTS_REF Ctb_tco2 /end AXIS_DESCR
/end CHARACTERISTIC
/begin CHARACTERISTIC Ctp_agb_tq_stop_min_cor "Minimum value of Stop Vehicle troque correction" CURVE 0xa0029824 _REC_A1CUR_20_u2_u2 2047.96875 _CNV_A_R_LINEAR_____123_CM 0. 2047.96875 FORMAT "%10.5"
 /begin AXIS_DESCR COM_AXIS Vxx_tco _CNV_A_R_LINEAR_____54_CM 9 -40. 200. FORMAT "%5.1" AXIS_PTS_REF Ctb_tco2 /end AXIS_DESCR
/end CHARACTERISTIC
/begin CHARACTERISTIC Ctp_agb_tq_stop_prim_drv_fac "Factor to calculate the Stop Vehicle torque correction in function of the primary shaft speed derivate" CURVE 0xa0029838 _REC_A1CUR_20_u2_u2 1.99996948242188 _CNV_A_R_LINEAR_____381_CM -1.99996948242188 0. FORMAT "%9.6"
 /begin AXIS_DESCR COM_AXIS Vxx_tco _CNV_A_R_LINEAR_____54_CM 9 -40. 200. FORMAT "%5.1" AXIS_PTS_REF Ctb_tco2 /end AXIS_DESCR
/end CHARACTERISTIC
/begin CHARACTERISTIC Ctp_egb_neut_dri_dly_cor "Temporization between the transition neutral -> Drive" CURVE 0xa002984c _REC_A1CUR_20_u2_u2 655.35 _CNV_A_R_LINEAR_____34_CM 0. 655.35 FORMAT "%6.2"
 /begin AXIS_DESCR COM_AXIS Vxx_toil _CNV_A_R_LINEAR_____54_CM 16 -40. 200. FORMAT "%5.1" AXIS_PTS_REF Ctb_toil /end AXIS_DESCR
/end CHARACTERISTIC
/begin CHARACTERISTIC Ctp_egb_neut_rvr_dly_cor "Temporization between the transition neutral -> RvR" CURVE 0xa002986c _REC_A1CUR_20_u2_u2 655.35 _CNV_A_R_LINEAR_____34_CM 0. 655.35 FORMAT "%6.2"
 /begin AXIS_DESCR COM_AXIS Vxx_toil _CNV_A_R_LINEAR_____54_CM 16 -40. 200. FORMAT "%5.1" AXIS_PTS_REF Ctb_toil /end AXIS_DESCR
/end CHARACTERISTIC
/begin MEASUREMENT Vbx_agb_tq_brk_pdl "Brake pedal off consolidated" UBYTE _CNV_S_2_RANGE______3_CM 1 0. 0. 1. ECU_ADDRESS 0xd0004607 BIT_MASK 0x1 /end MEASUREMENT
/begin MEASUREMENT Vbx_agb_tq_brk_pdl_cor_act "Request for the brake pedal torque correction" UBYTE _CNV_S_2_RANGE______3_CM 1 0. 0. 1. ECU_ADDRESS 0xd0004608 BIT_MASK 0x1 /end MEASUREMENT
/begin MEASUREMENT Vbx_agb_tq_drag_red_cor_act "Request for the drag reduction torque correction" UBYTE _CNV_S_2_RANGE______3_CM 1 0. 0. 1. ECU_ADDRESS 0xd000527d BIT_MASK 0x1 /end MEASUREMENT
/begin MEASUREMENT Vbx_agb_tq_is_vs_cdn_cor "Boolean to authorize the crack on vehicle speed and idle speed conditions" UBYTE _CNV_S_2_RANGE______3_CM 1 0. 0. 1. ECU_ADDRESS 0xd0004609 BIT_MASK 0x1 /end MEASUREMENT
/begin MEASUREMENT Vbx_agb_tq_neut_dri_cor_act "Request for the coupler torque losses correction" UBYTE _CNV_S_2_RANGE______3_CM 1 0. 0. 1. ECU_ADDRESS 0xd000527e BIT_MASK 0x1 /end MEASUREMENT
/begin MEASUREMENT Vbx_agb_tq_stop_cor_act "Request for the stop vehicle torque losses correction (CVT)" UBYTE _CNV_S_2_RANGE______3_CM 1 0. 0. 1. ECU_ADDRESS 0xd000460a BIT_MASK 0x1 /end MEASUREMENT
/begin MEASUREMENT Vbx_n_egb_neut "Electronic gear box isn't in neutral position" UBYTE _CNV_S_2_RANGE______3_CM 1 0. 0. 1. ECU_ADDRESS 0xd000460b BIT_MASK 0x1 /end MEASUREMENT
/begin MEASUREMENT Vbx_n_egb_neut_dly "Electronic gear box isn't in neutral position with a delay" UBYTE _CNV_S_2_RANGE______3_CM 1 0. 0. 1. ECU_ADDRESS 0xd000460c BIT_MASK 0x1 /end MEASUREMENT
/begin MEASUREMENT Vxx_agb_csm_tq_brk_pdl_cor "Brake pedal torque correction" UWORD _CNV_A_R_LINEAR_____123_CM 1 0. 0. 2047.96875 ECU_ADDRESS 0xd0002f2c FORMAT "%10.5" /end MEASUREMENT
/begin MEASUREMENT Vxx_agb_csm_tq_brk_pdl_cor_1 "Brake pedal torque correction with delay" UWORD _CNV_A_R_LINEAR_____123_CM 1 0. 0. 2047.96875 ECU_ADDRESS 0xd0002f2e FORMAT "%10.5" /end MEASUREMENT
/begin MEASUREMENT Vxx_agb_csm_tq_cor "Agb torque correction for the idle speed regulation" UWORD _CNV_A_R_LINEAR_____123_CM 1 0. 0. 2047.96875 ECU_ADDRESS 0xd0002f30 FORMAT "%10.5" /end MEASUREMENT
/begin MEASUREMENT Vxx_agb_csm_tq_drag_red_cor "Drag reduction torque correction" UWORD _CNV_A_R_LINEAR_____123_CM 1 0. 0. 2047.96875 ECU_ADDRESS 0xd0005b02 FORMAT "%10.5" /end MEASUREMENT
/begin MEASUREMENT Vxx_agb_csm_tq_drag_red_cor_1 "Drag reduction torque correction with delay" UWORD _CNV_A_R_LINEAR_____123_CM 1 0. 0. 2047.96875 ECU_ADDRESS 0xd0005b04 FORMAT "%10.5" /end MEASUREMENT
/begin MEASUREMENT Vxx_agb_csm_tq_neut_cor "Coupler torque losses correction" UWORD _CNV_A_R_LINEAR_____123_CM 1 0. 0. 2047.96875 ECU_ADDRESS 0xd0005b06 FORMAT "%10.5" /end MEASUREMENT
/begin MEASUREMENT Vxx_agb_csm_tq_neut_cor_1 "Coupler torque losses correction with delay" UWORD _CNV_A_R_LINEAR_____123_CM 1 0. 0. 2047.96875 ECU_ADDRESS 0xd0005b08 FORMAT "%10.5" /end MEASUREMENT
/begin MEASUREMENT Vxx_agb_tq_stop_cor "Stop Vehicle torque correction (CVT)" UWORD _CNV_A_R_LINEAR_____123_CM 1 0. 0. 2047.96875 ECU_ADDRESS 0xd0002f32 FORMAT "%10.5" /end MEASUREMENT
/begin MEASUREMENT Vxx_agb_tq_stop_cor_1 "Stop Vehicle torque correction with delay (CVT)" UWORD _CNV_A_R_LINEAR_____123_CM 1 0. 0. 2047.96875 ECU_ADDRESS 0xd0002f34 FORMAT "%10.5" /end MEASUREMENT
/begin MEASUREMENT Vxx_prim_sha_spd_drv "Primary shaft speed derivate" SWORD _CNV_A_R_LINEAR_____382_CM 1 0. -8192. 8191.75 ECU_ADDRESS 0xd0002f36 FORMAT "%8.2" /end MEASUREMENT
/begin MEASUREMENT Vxx_prim_sha_spd_drv_mv "filtered primary shaft speed derivate" SWORD _CNV_A_R_LINEAR_____382_CM 1 0. -8192. 8191.75 ECU_ADDRESS 0xd0002f38 FORMAT "%8.2" /end MEASUREMENT
/begin CHARACTERISTIC Cbx_agb_csm_tq_cor_ad "Boolean, to add the torque correction on coupler torque losses. If false then maxinum with the AT_torque , if true additive on the AT_torque" VALUE 0xa0021710 _REC_S1VAL_20_u1 1. _CNV_S_2_RANGE______3_CM 0. 1. BIT_MASK 0x1 /end CHARACTERISTIC
/begin CHARACTERISTIC Cxx_agb_csm_tq_neut_rvr_fac "Facter on the coupler torque losses correction if to reserve gear is engaged" VALUE 0xa0021711 _REC_S1VAL_20_u1 3.984375 _CNV_A_R_LINEAR_____175_CM 0. 3.984375 FORMAT "%8.6" /end CHARACTERISTIC
/begin CHARACTERISTIC Cxx_agb_tq_brk_pdl_cor_slop "Brake torque correction slope" VALUE 0xa00216f2 _REC_S1VAL_20_u2 51199.21875 _CNV_A_R_LINEAR_____383_CM 0. 51199.21875 FORMAT "%11.5" /end CHARACTERISTIC
/begin CHARACTERISTIC Cxx_agb_tq_brk_pdl_n_hys "Engine speed hysteresis to disable the temporary brake torque correction" VALUE 0xa00216f4 _REC_S1VAL_20_u2 16383.75 _CNV_A_R_ENSD_LINEA_24_CM 0. 16383.75 FORMAT "%8.2" /end CHARACTERISTIC
/begin CHARACTERISTIC Cxx_agb_tq_brk_pdl_n_thd "Engine speed threshold to activate the temporary brake torque correction" VALUE 0xa00216f6 _REC_S1VAL_20_s2 16383.75 _CNV_A_R_ENSD_LINEA_24_CM -8192. 8191.75 FORMAT "%6.0" /end CHARACTERISTIC
/begin CHARACTERISTIC Cxx_agb_tq_brk_pdl_tco_thd "Engine coolant tempearture threshold to activate the temporary brake torque correction" VALUE 0xa00216f8 _REC_S1VAL_20_u2 240. _CNV_A_R_LINEAR_____54_CM -40. 200. FORMAT "%5.1" /end CHARACTERISTIC
/begin CHARACTERISTIC Cxx_agb_tq_drag_red_cor_slop "drag deduction torque correction slope" VALUE 0xa00216fa _REC_S1VAL_20_u2 51199.21875 _CNV_A_R_LINEAR_____383_CM 0. 51199.21875 FORMAT "%11.5" /end CHARACTERISTIC
/begin CHARACTERISTIC Cxx_agb_tq_neut_dri_cor_slop "Coupler torque losses correction slope" VALUE 0xa00216fc _REC_S1VAL_20_u2 51199.21875 _CNV_A_R_LINEAR_____383_CM 0. 51199.21875 FORMAT "%11.5" /end CHARACTERISTIC
/begin CHARACTERISTIC Cxx_agb_tq_stop_cor_slop "Stop Vehicle torque correction slope" VALUE 0xa00216fe _REC_S1VAL_20_u2 51199.21875 _CNV_A_R_LINEAR_____383_CM 0. 51199.21875 FORMAT "%11.5" /end CHARACTERISTIC
/begin CHARACTERISTIC Cxx_agb_tq_stop_dly_cor "Duration of stop vehicle torque correction before decrementation (CVT)" VALUE 0xa0021700 _REC_S1VAL_20_u2 655.35 _CNV_A_R_LINEAR_____34_CM 0. 655.35 FORMAT "%6.2" /end CHARACTERISTIC
/begin CHARACTERISTIC Cxx_agb_tq_stop_n_hys "Engine speed hysteresis to disable the temporary Stop Vehicle torque correction" VALUE 0xa0021702 _REC_S1VAL_20_u2 16383.75 _CNV_A_R_ENSD_LINEA_24_CM 0. 16383.75 FORMAT "%8.2" /end CHARACTERISTIC
/begin CHARACTERISTIC Cxx_agb_tq_stop_n_thd "Engine speed threshold to disable the temporary Stop Vehicle torque correction" VALUE 0xa0021704 _REC_S1VAL_20_u2 16383.75 _CNV_A_R_ENSD_LINEA_24_CM 0. 16383.75 FORMAT "%8.2" /end CHARACTERISTIC
/begin CHARACTERISTIC Cxx_agb_tq_stop_prim_drv_thd "Primary shaft speed derivate threshold to activate the Stop Vehicle torque correction" VALUE 0xa0021706 _REC_S1VAL_20_s2 16383.75 _CNV_A_R_LINEAR_____382_CM -8192. 8191.75 FORMAT "%8.2" /end CHARACTERISTIC
/begin CHARACTERISTIC Cxx_agb_tq_stop_prim_max_ofs "Maximum threshold to activate the temporary Stop Vehicle torque correction" VALUE 0xa0021708 _REC_S1VAL_20_s2 16383.75 _CNV_A_R_ENSD_LINEA_24_CM -8192. 8191.75 FORMAT "%8.2" /end CHARACTERISTIC
/begin CHARACTERISTIC Cxx_agb_tq_stop_prim_min_ofs "Miniimum threshold to activate the temporary Stop Vehicle torque correction" VALUE 0xa002170a _REC_S1VAL_20_s2 16383.75 _CNV_A_R_ENSD_LINEA_24_CM -8192. 8191.75 FORMAT "%8.2" /end CHARACTERISTIC
/begin CHARACTERISTIC Cxx_agb_tq_stop_vs_thd "Vehicle speed threshold to authorize the Stop Vehicle torque correction" VALUE 0xa002170c _REC_S1VAL_20_u2 655.35 _CNV_A_R_LINEAR_____70_CM 0. 655.35 FORMAT "%6.2" /end CHARACTERISTIC
/begin CHARACTERISTIC Cxx_prim_sha_spd_drv_ftc "Filtering time for primary shaft speed derivate" VALUE 0xa0021712 _REC_S1VAL_20_u1 2.55 _CNV_A_R_LINEAR_____34_CM 0. 2.55 FORMAT "%4.2" /end CHARACTERISTIC
/begin CHARACTERISTIC Cxx_prim_sha_spd_drv_thd "Primary shaft speed derivate threshold" VALUE 0xa002170e _REC_S1VAL_20_s2 16383.75 _CNV_A_R_ENSD_LINEA_24_CM -8192. 8191.75 FORMAT "%8.2" /end CHARACTERISTIC
/begin MEASUREMENT Vsx_ant_crt_slc "Anticipated current gear shift" UBYTE _CNV_S_3_STATUS_ANT_387_CM 1 0. 1. 3. ECU_ADDRESS 0xd0004887 /end MEASUREMENT
/begin MEASUREMENT Vsx_ant_crt_slc_vld "Anticipated current gear shift validity status" UBYTE _CNV_S_8_STATUS_OK__181_CM 1 0. 0. 7. ECU_ADDRESS 0xd0004888 /end MEASUREMENT
/begin CHARACTERISTIC Cbx_ant_crt_slc_pres_cfm "AnticipatedCurrentShift information is provided by CAN" VALUE 0xa0021a5a _REC_S1VAL_20_u1 1. _CNV_S_2_RANGE______3_CM 0. 1. BIT_MASK 0x1 /end CHARACTERISTIC
/begin MEASUREMENT Vsx_prim_sha_spd_vld "Primary shaft speed validity status" UBYTE _CNV_S_8_STATUS_OK__181_CM 1 0. 0. 7. ECU_ADDRESS 0xd0004627 /end MEASUREMENT
/begin MEASUREMENT Vxx_prim_sha_spd "Primary shaft speed" UWORD _CNV_A_R_ENSD_LINEA_24_CM 1 0. 0. 16383.75 ECU_ADDRESS 0xd0003014 FORMAT "%8.2" /end MEASUREMENT
/begin MEASUREMENT Vbx_prg_appl_key_stt "Diag bit indicating that the ECM is in serial production" UBYTE _CNV_S_2_RANGE______3_CM 1 0. 0. 1. ECU_ADDRESS 0xd000483e BIT_MASK 0x1 /end MEASUREMENT
/begin MEASUREMENT Vbx_prg_req "programming request" UBYTE _CNV_S_2_RANGE______3_CM 1 0. 0. 1. ECU_ADDRESS 0xd000483f BIT_MASK 0x1 /end MEASUREMENT
/begin MEASUREMENT Vxx_prg_appl_key "Application Key made available for further use" UWORD _CNV_A_R_ECME_LINEA_0_CM 1 0. 0. 65535. ECU_ADDRESS 0xd0002cc2 FORMAT "%5.0" /end MEASUREMENT
/begin MEASUREMENT Vxx_prg_ecm_stt "Engine Control Management status for reprogramming (application operating or not)" UBYTE _CNV_A_R_ECME_LINEA_0_CM 1 0. 0. 255. ECU_ADDRESS 0xd0004840 FORMAT "%3.0" /end MEASUREMENT
/begin MEASUREMENT Vxx_raw_ac_prs "Raw air conditioning pressure voltage" UWORD _CNV_A_R_LINEAR_____150_CM 1 0. 0. 60. ECU_ADDRESS 0xd0002d9a FORMAT "%5.2" /end MEASUREMENT
/begin MEASUREMENT v_acp "Air conditioning pressure voltage" UWORD _CNV_A_R_LINEAR_____16_CM 1 0. 0. 4.99984741210938 ECU_ADDRESS 0xd00030bc FORMAT "%6.4" /end MEASUREMENT
/begin MEASUREMENT Vbx_sens_bgin_clu_cnt_lk_stt "Begin clutch contactor connection status (1 = connected; 0 = not connected). Stored in EEPROM" UBYTE _CNV_S_2_RANGE______3_CM 1 0. 0. 1. DISPLAY_IDENTIFIER InPciDls_NVM.Vbx_sens_bgin_clu_cnt_lk_stt_NVM ECU_ADDRESS 0xd0004e76 BIT_MASK 0x1 /end MEASUREMENT
/begin MEASUREMENT Vxx_bgin_clu_off_no_chr_ctr_NVM "Number of incoherencies when the begin clutch contactor is OFF" UBYTE _CNV_A_R_ECME_LINEA_0_CM 1 0. 0. 255. DISPLAY_IDENTIFIER InPciDls_NVM.Vxx_bgin_clu_off_no_chr_ctr_NVM ECU_ADDRESS 0xd0004e77 FORMAT "%3.0" /end MEASUREMENT
/begin MEASUREMENT Vxx_bgin_clu_on_no_chr_ctr_NVM "Number of incoherencies when the begin clutch contactor is ON" UBYTE _CNV_A_R_ECME_LINEA_0_CM 1 0. 0. 255. DISPLAY_IDENTIFIER InPciDls_NVM.Vxx_bgin_clu_on_no_chr_ctr_NVM ECU_ADDRESS 0xd0004e78 FORMAT "%3.0" /end MEASUREMENT
/begin MEASUREMENT Vbx_n_rams_lim_spc_act_1 "Specific activation of safety engine speed limitation level 1" UBYTE _CNV_S_2_RANGE______3_CM 1 0. 0. 1. ECU_ADDRESS 0xd0005634 BIT_MASK 0x1 /end MEASUREMENT
/begin MEASUREMENT Vbx_n_rams_lim_spc_act_2 "Specific activation of safety engine speed limitation level 2" UBYTE _CNV_S_2_RANGE______3_CM 1 0. 0. 1. ECU_ADDRESS 0xd0005635 BIT_MASK 0x1 /end MEASUREMENT
/begin MEASUREMENT Vsx_agb_coup "Automatic gearbox coupler state" UBYTE _CNV_A_R_ECME_LINEA_0_CM 1 0. 0. 255. ECU_ADDRESS 0xd0004a38 FORMAT "%3.0" /end MEASUREMENT
/begin MEASUREMENT Vsx_agb_coup_vld "Automatic gearbox coupler state validity status" UBYTE _CNV_A_R_ECME_LINEA_0_CM 1 0. 0. 255. ECU_ADDRESS 0xd0004a39 FORMAT "%3.0" /end MEASUREMENT
/begin MEASUREMENT Vsx_rgb_coup "Robotized gearbox coupler state" UBYTE _CNV_A_R_ECME_LINEA_0_CM 1 0. 0. 255. ECU_ADDRESS 0xd0004a3a FORMAT "%3.0" /end MEASUREMENT
/begin MEASUREMENT Vsx_rgb_coup_vld "Robotized gearbox coupler state validity status" UBYTE _CNV_A_R_ECME_LINEA_0_CM 1 0. 0. 255. ECU_ADDRESS 0xd0004a3b FORMAT "%3.0" /end MEASUREMENT
/begin MEASUREMENT Vbx_drag_red_agb "Drag reduction mode" UBYTE _CNV_S_2_RANGE______3_CM 1 0. 0. 1. ECU_ADDRESS 0xd0004c12 BIT_MASK 0x1 /end MEASUREMENT
/begin MEASUREMENT Vbx_egb_neut "Electronic GearBox is in a configuration equivalent to Neutral for a manual gearbox." UBYTE _CNV_S_2_RANGE______3_CM 1 0. 0. 1. ECU_ADDRESS 0xd0004c13 BIT_MASK 0x1 /end MEASUREMENT
/begin MEASUREMENT Vsx_agb_vld "Automatic GearBox validity status" UBYTE _CNV_A_R_ECME_LINEA_0_CM 1 0. 0. 2. ECU_ADDRESS 0xd0004c14 FORMAT "%1.0" /end MEASUREMENT
/begin MEASUREMENT Vsx_drag_red_agb_vld "Drag reduction mode validity status" UBYTE _CNV_A_R_ECME_LINEA_0_CM 1 0. 0. 2. ECU_ADDRESS 0xd0004c15 FORMAT "%1.0" /end MEASUREMENT
/begin MEASUREMENT Vsx_egb_neut_vld "Electronic GearBox in a configuration equivalent to Neutral for a manual gearbox validity status" UBYTE _CNV_A_R_ECME_LINEA_0_CM 1 0. 0. 2. ECU_ADDRESS 0xd0004c16 FORMAT "%1.0" /end MEASUREMENT
/begin MEASUREMENT Vsx_raw_egb_ant_gear "Target raw gear due to electronic gearbox" UBYTE _CNV_A_R_LINEAR_____113_CM 1 0. -1. 15. ECU_ADDRESS 0xd0004c17 FORMAT "%3.0" /end MEASUREMENT
/begin MEASUREMENT Vsx_raw_egb_ant_gear_vld "Target raw gear due to electronic gearbox validity status" UBYTE _CNV_A_R_ECME_LINEA_0_CM 1 0. 0. 2. ECU_ADDRESS 0xd0004c18 FORMAT "%1.0" /end MEASUREMENT
/begin MEASUREMENT Vsx_raw_egb_gear "Current raw gear due to electronic gearbox" UBYTE _CNV_A_R_LINEAR_____113_CM 1 0. -1. 15. ECU_ADDRESS 0xd0004c19 FORMAT "%3.0" /end MEASUREMENT
/begin MEASUREMENT Vsx_raw_egb_gear_vld "Current raw gear due to electronic gearbox validity status" UBYTE _CNV_A_R_ECME_LINEA_0_CM 1 0. 0. 2. ECU_ADDRESS 0xd0004c1a FORMAT "%1.0" /end MEASUREMENT
/begin MEASUREMENT Vsx_end_str_clu_cnt "End stroke clutch pedal switch" UBYTE _CNV_S_3_CNT_INDICA_388_CM 1 0. 0. 2. ECU_ADDRESS 0xd0004662 /end MEASUREMENT
/begin MEASUREMENT Vsx_neut_cnt "Neutral engaged switch for manual gearbox" UBYTE _CNV_A_R_ECME_LINEA_0_CM 1 0. 0. 2. ECU_ADDRESS 0xd0004a74 FORMAT "%1.0" /end MEASUREMENT
/begin MEASUREMENT Vsx_rvr_cnt " Reverse gear engaged switch for manual gearbox" UBYTE _CNV_A_R_ECME_LINEA_0_CM 1 0. 0. 2. ECU_ADDRESS 0xd0004a75 FORMAT "%1.0" /end MEASUREMENT
/begin AXIS_PTS Ctb_coup "Breakpoint calibration of transmission coupler states" 0xa0021470 Vxx_ant_coup _REC_A2AXS_20_u1 255. _CNV_A_R_ECME_LINEA_0_CM 3 0. 255. FORMAT "%3.0" /end AXIS_PTS
/begin AXIS_PTS Ntb_coup "Coupler state breakpoint (1=close; 2=sliding; 8=open)" 0xa0021474 NO_INPUT_QUANTITY _REC_A2AXS_20_u1 255. _CNV_A_R_ECME_LINEA_0_CM 3 0. 255. READ_ONLY FORMAT "%3.0" /end AXIS_PTS
/begin AXIS_PTS Ntb_gear "Gearbox ratio breakpoint" 0xa002ac48 Vxx_gear _REC_A2AXS_20_u1 7. _CNV_A_R_LINEAR_____113_CM 8 -1. 6. READ_ONLY FORMAT "%2.0" /end AXIS_PTS
/begin MEASUREMENT Vsx_ant_coup_vld "Anticipated (forecast) transmission coupler state validity status" UBYTE _CNV_A_R_ECME_LINEA_0_CM 1 0. 0. 2. ECU_ADDRESS 0xd0003f8f FORMAT "%1.0" /end MEASUREMENT
/begin MEASUREMENT Vsx_ant_gear "Anticipated gear engaged" UBYTE _CNV_A_R_LINEAR_____113_CM 1 0. -1. 6. ECU_ADDRESS 0xd0003f90 FORMAT "%2.0" /end MEASUREMENT
/begin MEASUREMENT Vsx_ant_gear_vld "Anticipated gear engaged validity status" UBYTE _CNV_A_R_ECME_LINEA_0_CM 1 0. 0. 2. ECU_ADDRESS 0xd0003f91 FORMAT "%1.0" /end MEASUREMENT
/begin MEASUREMENT Vsx_coup_vld "Coupler state (1 : closed ; 2 : sliding ; 8 : open) validity status" UBYTE _CNV_A_R_ECME_LINEA_0_CM 1 0. 0. 2. ECU_ADDRESS 0xd0003f92 FORMAT "%1.0" /end MEASUREMENT
/begin MEASUREMENT Vsx_dlin_conf "State data of driveline configuration (Transmission type)." UBYTE _CNV_A_R_ECME_LINEA_0_CM 1 0. 0. 255. ECU_ADDRESS 0xd0003f93 FORMAT "%3.0" /end MEASUREMENT
/begin MEASUREMENT Vsx_gear "Gear engaged" UBYTE _CNV_A_R_LINEAR_____113_CM 1 0. -1. 6. ECU_ADDRESS 0xd0003f94 FORMAT "%2.0" /end MEASUREMENT
/begin MEASUREMENT Vsx_gear_vld "Gear engaged ( [-1 0 1 2 3 4 5 6] ) validity status" UBYTE _CNV_A_R_ECME_LINEA_0_CM 1 0. 0. 2. ECU_ADDRESS 0xd0003f95 FORMAT "%1.0" /end MEASUREMENT
/begin MEASUREMENT Vxx_ant_coup "Anticipated (forecast) transmission coupler state" UBYTE _CNV_A_R_ECME_LINEA_0_CM 1 0. 0. 255. ECU_ADDRESS 0xd0003f96 FORMAT "%3.0" /end MEASUREMENT
/begin MEASUREMENT Vxx_ant_gear "Anticipated gear engaged" UBYTE _CNV_A_R_LINEAR_____113_CM 1 0. -1. 6. ECU_ADDRESS 0xd0003f97 FORMAT "%2.0" /end MEASUREMENT
/begin MEASUREMENT Vxx_coup "Coupler state (1 : closed ; 2 : sliding ; 8 : open)" UBYTE _CNV_A_R_ECME_LINEA_0_CM 1 0. 0. 255. ECU_ADDRESS 0xd0003f98 FORMAT "%3.0" /end MEASUREMENT
/begin MEASUREMENT Vxx_gear "Gear engaged ( [-1 0 1 2 3 4 5 6] )" UBYTE _CNV_A_R_LINEAR_____113_CM 1 0. -1. 6. ECU_ADDRESS 0xd0003f99 FORMAT "%2.0" /end MEASUREMENT
/begin CHARACTERISTIC Csx_dlin_conf "Calibration which specifies the type of the transmission (transmission configuration)" VALUE 0xa0021478 _REC_S1VAL_20_u1 255. _CNV_A_R_ECME_LINEA_0_CM 0. 255. FORMAT "%3.0" /end CHARACTERISTIC
/begin MEASUREMENT Vbx_run_vh "Vehicle run detected" UBYTE _CNV_S_2_RANGE______3_CM 1 0. 0. 1. ECU_ADDRESS 0xd0004421 BIT_MASK 0x1 /end MEASUREMENT
/begin MEASUREMENT Vsx_run_vh_vld "Vehicle run detected validity status" UBYTE _CNV_A_R_ECME_LINEA_0_CM 1 0. 0. 2. ECU_ADDRESS 0xd0004422 FORMAT "%1.0" /end MEASUREMENT
/begin MEASUREMENT Vsx_vs_n_rat_fil_vld "Filtered Ratio validity status" UBYTE _CNV_A_R_ECME_LINEA_0_CM 1 0. 0. 2. ECU_ADDRESS 0xd0004423 FORMAT "%1.0" /end MEASUREMENT
/begin MEASUREMENT Vxx_vs_n_rat "Non filtered but quantized and saturated value of V/Neng ratio. If equal to -10, ratio is incorrect" SWORD _CNV_A_R_LINEAR_____331_CM 1 0. -10. 200. ECU_ADDRESS 0xd00031d6 FORMAT "%6.2" /end MEASUREMENT
/begin MEASUREMENT Vxx_vs_n_rat_fil "Vxx_vs_n_rat_fil : Filtered value of VehicleSpeed/Neng ratio. If equal to -10, ratio value is incoherent." UWORD _CNV_A_R_LINEAR_____140_CM 1 0. -10. 200. ECU_ADDRESS 0xd00031d8 FORMAT "%6.2" /end MEASUREMENT
/begin CHARACTERISTIC Cxx_down_bkp_vs_neut "Down breakpoint on vehicle speed in order to detect a vehicle stop" VALUE 0xa00215e4 _REC_S1VAL_20_u2 655.35 _CNV_A_R_LINEAR_____70_CM 0. 655.35 FORMAT "%6.2" /end CHARACTERISTIC
/begin CHARACTERISTIC Cxx_vs_n_rat_dft_max "Max value of V/Neng ratio." VALUE 0xa00215e6 _REC_S1VAL_20_s2 210. _CNV_A_R_LINEAR_____331_CM -10. 200. FORMAT "%6.2" /end CHARACTERISTIC
/begin CHARACTERISTIC Cxx_vs_n_rat_dft_min "Default value of V/Neng ratio if calculation of real value can't be done." VALUE 0xa00215e8 _REC_S1VAL_20_s2 210. _CNV_A_R_LINEAR_____331_CM -10. 200. FORMAT "%6.2" /end CHARACTERISTIC
/begin CHARACTERISTIC Cxx_vs_n_rat_fil_fac1 "First time constant of second order numeric filter of ratio V/N" VALUE 0xa00215ec _REC_S1VAL_20_u1 2.55 _CNV_A_R_LINEAR_____34_CM 0. 2.55 FORMAT "%4.2" /end CHARACTERISTIC
/begin CHARACTERISTIC Cxx_vs_n_rat_fil_fac2 "Second time constant of second order numeric filter of ratio V/N" VALUE 0xa00215ed _REC_S1VAL_20_u1 2.55 _CNV_A_R_LINEAR_____34_CM 0. 2.55 FORMAT "%4.2" /end CHARACTERISTIC
/begin CHARACTERISTIC Cxx_vs_n_rat_min_n_bkp "Minimal engine speed that enables Vehicle_speed/Engine_speed ratio calculation" VALUE 0xa00215ea _REC_S1VAL_20_u2 16383.75 _CNV_A_R_ENSD_LINEA_24_CM 0. 16383.75 FORMAT "%8.2" /end CHARACTERISTIC
/begin MEASUREMENT Vsx_ant_rat_gear "Anticipated Ratio Gear: identified with large true range of the ratio Vspeed/Neng." UBYTE _CNV_A_R_LINEAR_____113_CM 1 0. -1. 6. ECU_ADDRESS 0xd0004616 FORMAT "%2.0" /end MEASUREMENT
/begin MEASUREMENT Vsx_rat_gear "Ratio Gear:gearbox gear identified with thin true range of the ratio Vspeed/Neng." UBYTE _CNV_A_R_LINEAR_____113_CM 1 0. -1. 6. ECU_ADDRESS 0xd0004617 FORMAT "%2.0" /end MEASUREMENT
/begin MEASUREMENT Vtx_gear_rat_tgt[0] "Calibration vector of gear ratio targets: Neutral, 1st_gear,..., 6th_gear." UWORD _CNV_A_R_LINEAR_____331_CM 1 0. 0. 200. ECU_ADDRESS 0xd0003804 FORMAT "%6.2" /end MEASUREMENT
/begin MEASUREMENT Vtx_gear_rat_tgt[1] "Calibration vector of gear ratio targets: Neutral, 1st_gear,..., 6th_gear." UWORD _CNV_A_R_LINEAR_____331_CM 1 0. 0. 200. ECU_ADDRESS 0xd0003806 FORMAT "%6.2" /end MEASUREMENT
/begin MEASUREMENT Vtx_gear_rat_tgt[2] "Calibration vector of gear ratio targets: Neutral, 1st_gear,..., 6th_gear." UWORD _CNV_A_R_LINEAR_____331_CM 1 0. 0. 200. ECU_ADDRESS 0xd0003808 FORMAT "%6.2" /end MEASUREMENT
/begin MEASUREMENT Vtx_gear_rat_tgt[3] "Calibration vector of gear ratio targets: Neutral, 1st_gear,..., 6th_gear." UWORD _CNV_A_R_LINEAR_____331_CM 1 0. 0. 200. ECU_ADDRESS 0xd000380a FORMAT "%6.2" /end MEASUREMENT
/begin MEASUREMENT Vtx_gear_rat_tgt[4] "Calibration vector of gear ratio targets: Neutral, 1st_gear,..., 6th_gear." UWORD _CNV_A_R_LINEAR_____331_CM 1 0. 0. 200. ECU_ADDRESS 0xd000380c FORMAT "%6.2" /end MEASUREMENT
/begin MEASUREMENT Vtx_gear_rat_tgt[5] "Calibration vector of gear ratio targets: Neutral, 1st_gear,..., 6th_gear." UWORD _CNV_A_R_LINEAR_____331_CM 1 0. 0. 200. ECU_ADDRESS 0xd000380e FORMAT "%6.2" /end MEASUREMENT
/begin MEASUREMENT Vtx_gear_rat_tgt[6] "Calibration vector of gear ratio targets: Neutral, 1st_gear,..., 6th_gear." UWORD _CNV_A_R_LINEAR_____331_CM 1 0. 0. 200. ECU_ADDRESS 0xd0003810 FORMAT "%6.2" /end MEASUREMENT
/begin MEASUREMENT Vxx_down_rat_gear_bkp_tgt "Down limit of true range for the current anticipated ratio gear." UWORD _CNV_A_R_LINEAR_____331_CM 1 0. 0. 200. ECU_ADDRESS 0xd0003812 FORMAT "%6.2" /end MEASUREMENT
/begin MEASUREMENT Vxx_mv_1_2_gear_rat_tgt "Median value of gears ratio targets of the1st and the 2nd gears" UWORD _CNV_A_R_LINEAR_____331_CM 1 0. 0. 200. ECU_ADDRESS 0xd0003814 FORMAT "%6.2" /end MEASUREMENT
/begin MEASUREMENT Vxx_mv_2_3_gear_rat_tgt "Median value of gears ratio targets of the 2nd and the 3rd gears" UWORD _CNV_A_R_LINEAR_____331_CM 1 0. 0. 200. ECU_ADDRESS 0xd0003816 FORMAT "%6.2" /end MEASUREMENT
/begin MEASUREMENT Vxx_mv_3_4_gear_rat_tgt "Median value of gears ratio targets of the3rd and the 4th gears" UWORD _CNV_A_R_LINEAR_____331_CM 1 0. 0. 200. ECU_ADDRESS 0xd0003818 FORMAT "%6.2" /end MEASUREMENT
/begin MEASUREMENT Vxx_mv_4_5_gear_rat_tgt "Median value of gears ratio targets of the 4th and the 5th gears" UWORD _CNV_A_R_LINEAR_____331_CM 1 0. 0. 200. ECU_ADDRESS 0xd000381a FORMAT "%6.2" /end MEASUREMENT
/begin MEASUREMENT Vxx_mv_5_6_gear_rat_tgt "Median value of gears ratio targets of the 5th and the 6th gears" UWORD _CNV_A_R_LINEAR_____331_CM 1 0. 0. 200. ECU_ADDRESS 0xd000381c FORMAT "%6.2" /end MEASUREMENT
/begin MEASUREMENT Vxx_rat_tgt "Gear ratio target of the current possible gear." UWORD _CNV_A_R_LINEAR_____331_CM 1 0. 0. 200. ECU_ADDRESS 0xd000381e FORMAT "%6.2" /end MEASUREMENT
/begin MEASUREMENT Vxx_up_rat_gear_bkp_tgt "Up limit of true range for the current anticipated ratio gear." UWORD _CNV_A_R_LINEAR_____331_CM 1 0. 0. 200. ECU_ADDRESS 0xd0003820 FORMAT "%6.2" /end MEASUREMENT
/begin CHARACTERISTIC Cbx_no_ant_gear_fil_cfm "Boolean enabling the ratio filtering for ant gear detection" VALUE 0xa0021a06 _REC_S1VAL_20_u1 1. _CNV_A_R_ECME_LINEA_0_CM 0. 1. FORMAT "%1.0" BIT_MASK 0x1 /end CHARACTERISTIC
/begin CHARACTERISTIC Cxx_1_gear_rat_tgt "First gear ratio target" VALUE 0xa00219ee _REC_S1VAL_20_u2 200. _CNV_A_R_LINEAR_____331_CM 0. 200. FORMAT "%6.2" /end CHARACTERISTIC
/begin CHARACTERISTIC Cxx_2_gear_rat_tgt "Second gear ratio target" VALUE 0xa00219f0 _REC_S1VAL_20_u2 200. _CNV_A_R_LINEAR_____331_CM 0. 200. FORMAT "%6.2" /end CHARACTERISTIC
/begin CHARACTERISTIC Cxx_3_gear_rat_tgt "Third gear ratio target" VALUE 0xa00219f2 _REC_S1VAL_20_u2 200. _CNV_A_R_LINEAR_____331_CM 0. 200. FORMAT "%6.2" /end CHARACTERISTIC
/begin CHARACTERISTIC Cxx_4_gear_rat_tgt "Fourth gear ratio target" VALUE 0xa00219f4 _REC_S1VAL_20_u2 200. _CNV_A_R_LINEAR_____331_CM 0. 200. FORMAT "%6.2" /end CHARACTERISTIC
/begin CHARACTERISTIC Cxx_5_gear_rat_tgt "Fifth gear ratio target" VALUE 0xa00219f6 _REC_S1VAL_20_u2 200. _CNV_A_R_LINEAR_____331_CM 0. 200. FORMAT "%6.2" /end CHARACTERISTIC
/begin CHARACTERISTIC Cxx_6_gear_rat_tgt "Sixth gear ratio target" VALUE 0xa00219f8 _REC_S1VAL_20_u2 200. _CNV_A_R_LINEAR_____331_CM 0. 200. FORMAT "%6.2" /end CHARACTERISTIC
/begin CHARACTERISTIC Cxx_h_gear_win_thd " Window size calibration for detection of new gear engaged (high gears)" VALUE 0xa00219fa _REC_S1VAL_20_u2 200. _CNV_A_R_LINEAR_____331_CM 0. 200. FORMAT "%6.2" /end CHARACTERISTIC
/begin CHARACTERISTIC Cxx_l_gear_max "Gear ratio to searate low gears engaged from high gears engaged" VALUE 0xa00219fc _REC_S1VAL_20_u2 200. _CNV_A_R_LINEAR_____331_CM 0. 200. FORMAT "%6.2" /end CHARACTERISTIC
/begin CHARACTERISTIC Cxx_l_gear_win_thd " Window size calibration for detection of new gear engaged (low gears)" VALUE 0xa00219fe _REC_S1VAL_20_u2 200. _CNV_A_R_LINEAR_____331_CM 0. 200. FORMAT "%6.2" /end CHARACTERISTIC
/begin CHARACTERISTIC Cxx_max_vs_n_rat "Maximal Vspeed/Neng speed ratio before declaring that Rat Gear is Not Identified." VALUE 0xa0021a00 _REC_S1VAL_20_u2 200. _CNV_A_R_LINEAR_____331_CM 0. 200. FORMAT "%6.2" /end CHARACTERISTIC
/begin CHARACTERISTIC Cxx_min_vs_n_rat "Minimal Vspeed/Neng speed ratio before declaring that Rat Gear is Neutral." VALUE 0xa0021a02 _REC_S1VAL_20_u2 200. _CNV_A_R_LINEAR_____331_CM 0. 200. FORMAT "%6.2" /end CHARACTERISTIC
/begin CHARACTERISTIC Cxx_neut_gear_rat_tgt "Neutral gear ratio target" VALUE 0xa0021a04 _REC_S1VAL_20_u2 200. _CNV_A_R_LINEAR_____331_CM 0. 200. FORMAT "%6.2" /end CHARACTERISTIC
/begin CHARACTERISTIC Cxx_vs_n_rat_ant_gear_ftc1 "First time constant of second order numeric filter of ratio V/N for Ant Gear detection" VALUE 0xa0021a07 _REC_S1VAL_20_u1 2.55 _CNV_A_R_LINEAR_____34_CM 0. 2.55 FORMAT "%4.2" /end CHARACTERISTIC
/begin CHARACTERISTIC Cxx_vs_n_rat_ant_gear_ftc2 "Second time constant of second order numeric filter of ratio V/N for Ant Gear detection" VALUE 0xa0021a08 _REC_S1VAL_20_u1 2.55 _CNV_A_R_LINEAR_____34_CM 0. 2.55 FORMAT "%4.2" /end CHARACTERISTIC
/begin MEASUREMENT Vbx_bgin_clu_cnt_ena "Begin stroke sensor is functional" UBYTE _CNV_S_2_RANGE______3_CM 1 0. 0. 1. ECU_ADDRESS 0xd000429f BIT_MASK 0x1 /end MEASUREMENT
/begin MEASUREMENT Vbx_bgin_clu_cnt_on "Begin stroke sensor is activated" UBYTE _CNV_S_2_RANGE______3_CM 1 0. 0. 1. ECU_ADDRESS 0xd00042a0 BIT_MASK 0x1 /end MEASUREMENT
/begin MEASUREMENT Vbx_end_clu_cnt_on "End stroke sensor is activated" UBYTE _CNV_S_2_RANGE______3_CM 1 0. 0. 1. ECU_ADDRESS 0xd00042a1 BIT_MASK 0x1 /end MEASUREMENT
/begin CHARACTERISTIC Cxx_dfdec_clu_cnt_nok "a_in_pci_dls_seclcxx/Clutch contactors detected failure counter decrement" VALUE 0xa00214b0 _REC_S1VAL_20_u2 65535. _CNV_A_R_ECME_LINEA_0_CM 0. 65535. FORMAT "%5.0" /end CHARACTERISTIC
/begin CHARACTERISTIC Cxx_dfinc_clu_cnt_nok "a_in_pci_dls_seclcxx/Clutch contactors detected failure counter increment" VALUE 0xa00214b2 _REC_S1VAL_20_u2 65535. _CNV_A_R_ECME_LINEA_0_CM 0. 65535. FORMAT "%5.0" /end CHARACTERISTIC
/begin CHARACTERISTIC Cxx_dly_chr_bgin_end_clu_cnt "Delay to enable the coherency diag due to the different contactors information time refresh" VALUE 0xa00214b4 _REC_S1VAL_20_u1 2.55 _CNV_A_R_LINEAR_____34_CM 0. 2.55 FORMAT "%4.2" /end CHARACTERISTIC
/begin MEASUREMENT Vsx_egb_ant_coup "Anticipated (forecast) transmission coupler state for automatic transmission" UBYTE _CNV_A_R_ECME_LINEA_0_CM 1 0. 0. 255. ECU_ADDRESS 0xd00049eb FORMAT "%3.0" /end MEASUREMENT
/begin MEASUREMENT Vsx_egb_ant_coup_vld "Anticipated transmission coupler state for automatic transmission validity status" UBYTE _CNV_A_R_ECME_LINEA_0_CM 1 0. 0. 2. ECU_ADDRESS 0xd00049ec FORMAT "%1.0" /end MEASUREMENT
/begin MEASUREMENT Vsx_egb_ant_gear "Target gear due to electronic gearbox" UBYTE _CNV_A_R_LINEAR_____113_CM 1 0. -1. 6. ECU_ADDRESS 0xd00049ed FORMAT "%2.0" /end MEASUREMENT
/begin MEASUREMENT Vsx_egb_ant_gear_vld "Target gear due to electronic gearbox validity status" UBYTE _CNV_A_R_ECME_LINEA_0_CM 1 0. 0. 2. ECU_ADDRESS 0xd00049ee FORMAT "%1.0" /end MEASUREMENT
/begin MEASUREMENT Vsx_egb_coup "Automatic Transmission coupler state" UBYTE _CNV_A_R_ECME_LINEA_0_CM 1 0. 0. 255. ECU_ADDRESS 0xd00049ef FORMAT "%3.0" /end MEASUREMENT
/begin MEASUREMENT Vsx_egb_coup_vld "Automatic Transmission coupler state validity status" UBYTE _CNV_A_R_ECME_LINEA_0_CM 1 0. 0. 2. ECU_ADDRESS 0xd00049f0 FORMAT "%1.0" /end MEASUREMENT
/begin MEASUREMENT Vsx_egb_gear "Current gear due to electronic gearbox" UBYTE _CNV_A_R_LINEAR_____113_CM 1 0. -1. 6. ECU_ADDRESS 0xd00049f1 FORMAT "%2.0" /end MEASUREMENT
/begin MEASUREMENT Vsx_egb_gear_vld "Current gear due to electronic gearbox validity status" UBYTE _CNV_A_R_ECME_LINEA_0_CM 1 0. 0. 2. ECU_ADDRESS 0xd00049f2 FORMAT "%1.0" /end MEASUREMENT
/begin CHARACTERISTIC Csx_lih_egb_gear "Calibration value for the gear engaged when egb is in safety mode" VALUE 0xa0021bd1 _REC_S1VAL_20_u1 7. _CNV_A_R_LINEAR_____113_CM -1. 6. FORMAT "%2.0" /end CHARACTERISTIC
/begin CHARACTERISTIC Cxx_dly_coup_fail "Delay to detect a problem on the coupler frame on CAN" VALUE 0xa0021bd2 _REC_S1VAL_20_u1 2.55 _CNV_A_R_LINEAR_____34_CM 0. 2.55 FORMAT "%4.2" /end CHARACTERISTIC
/begin CHARACTERISTIC Cxx_dly_gear_fail "Delay to detect a problem on the gear frame on CAN" VALUE 0xa0021bd3 _REC_S1VAL_20_u1 2.55 _CNV_A_R_LINEAR_____34_CM 0. 2.55 FORMAT "%4.2" /end CHARACTERISTIC
/begin MEASUREMENT Vbx_bgin_clu_pdl_on "Begin stroke robustified information is 'pedal pressed'" UBYTE _CNV_S_2_RANGE______3_CM 1 0. 0. 1. ECU_ADDRESS 0xd00046f8 BIT_MASK 0x1 /end MEASUREMENT
/begin MEASUREMENT Vbx_gear_stab "Ratio is stabilised" UBYTE _CNV_S_2_RANGE______3_CM 1 0. 0. 1. ECU_ADDRESS 0xd00046f9 BIT_MASK 0x1 /end MEASUREMENT
/begin MEASUREMENT Vbx_neut_gear_act "Neutral gear detected with clutch contactors and software contactor" UBYTE _CNV_S_2_RANGE______3_CM 1 0. 0. 1. ECU_ADDRESS 0xd00046fa BIT_MASK 0x1 /end MEASUREMENT
/begin MEASUREMENT Vbx_neut_psn "Neutral position is detected with gearbox contactor" UBYTE _CNV_S_2_RANGE______3_CM 1 0. 0. 1. ECU_ADDRESS 0xd00046fb BIT_MASK 0x1 /end MEASUREMENT
/begin MEASUREMENT Vbx_ovn_ant_coup "" UBYTE _CNV_S_2_RANGE______3_CM 1 0. 0. 1. ECU_ADDRESS 0xd00046fc BIT_MASK 0x1 /end MEASUREMENT
/begin MEASUREMENT Vbx_pdl_use_rtn "Inform the driver retains its foot on pedal" UBYTE _CNV_S_2_RANGE______3_CM 1 0. 0. 1. ECU_ADDRESS 0xd00046fd BIT_MASK 0x1 /end MEASUREMENT
/begin MEASUREMENT Vsx_bgin_clu_nok_mgb_ant_coup "Anticipated coupler state calculated when begin clutch contactor is defective" UBYTE _CNV_S_3_RANGE_STAT_389_CM 1 0. 1. 8. ECU_ADDRESS 0xd00046fe /end MEASUREMENT
/begin MEASUREMENT Vsx_bgin_clu_nok_mgb_coup "Coupler state calculated when begin clutch contactor is defective" UBYTE _CNV_S_3_RANGE_STAT_389_CM 1 0. 1. 8. ECU_ADDRESS 0xd00046ff /end MEASUREMENT
/begin MEASUREMENT Vsx_bgin_clu_nok_mgb_coup_vld "Coupler state calculated when begin clutch contactor is defective validity status" UBYTE _CNV_S_3_STATUS_OK__158_CM 1 0. 0. 2. ECU_ADDRESS 0xd0004700 /end MEASUREMENT
/begin MEASUREMENT Vsx_bgin_clu_ok_mgb_ant_coup "Anticipated coupler state calculated when begin clutch contactor is functional" UBYTE _CNV_S_3_RANGE_STAT_389_CM 1 0. 1. 8. ECU_ADDRESS 0xd0004701 /end MEASUREMENT
/begin MEASUREMENT Vsx_bgin_clu_ok_mgb_coup "Coupler state calculated when begin clutch contactor is functional" UBYTE _CNV_S_3_RANGE_STAT_389_CM 1 0. 1. 8. ECU_ADDRESS 0xd0004702 /end MEASUREMENT
/begin MEASUREMENT Vsx_bgin_clu_ok_mgb_coup_vld "Coupler state calculated when begin clutch contactor is functional validity status" UBYTE _CNV_S_3_STATUS_OK__158_CM 1 0. 0. 2. ECU_ADDRESS 0xd0004703 /end MEASUREMENT
/begin MEASUREMENT Vsx_mgb_ant_coup "Manual transmission anticipated coupler state (faster opening and closing detection / Vxx_coup)" UBYTE _CNV_A_R_ECME_LINEA_0_CM 1 0. 0. 255. ECU_ADDRESS 0xd0004704 FORMAT "%3.0" /end MEASUREMENT
/begin MEASUREMENT Vsx_mgb_ant_gear "Anticipated gear engaged due to manual gearbox" UBYTE _CNV_A_R_LINEAR_____113_CM 1 0. -1. 6. ECU_ADDRESS 0xd0004705 FORMAT "%2.0" /end MEASUREMENT
/begin MEASUREMENT Vsx_mgb_coup "Manual transmission coupler state" UBYTE _CNV_A_R_ECME_LINEA_0_CM 1 0. 0. 255. ECU_ADDRESS 0xd0004706 FORMAT "%3.0" /end MEASUREMENT
/begin MEASUREMENT Vsx_mgb_coup_vld "Manual transmission coupler state validity status" UBYTE _CNV_A_R_ECME_LINEA_0_CM 1 0. 0. 2. ECU_ADDRESS 0xd0004707 FORMAT "%1.0" /end MEASUREMENT
/begin MEASUREMENT Vsx_mgb_gear "Gear engaged due to manual gearbox" UBYTE _CNV_A_R_LINEAR_____113_CM 1 0. -1. 6. ECU_ADDRESS 0xd0004708 FORMAT "%2.0" /end MEASUREMENT
/begin MEASUREMENT Vsx_mgb_gear_vld "Gear engaged due to manual gearbox validity status" UBYTE _CNV_A_R_ECME_LINEA_0_CM 1 0. 0. 2. ECU_ADDRESS 0xd0004709 FORMAT "%1.0" /end MEASUREMENT
/begin MEASUREMENT Vsx_rat_gear_stab "Stabilized ratio Gear:gearbox gear identified with thin true range of the ratio Vspeed/Neng and the stability of the ratio." UBYTE _CNV_A_R_LINEAR_____113_CM 1 0. -1. 6. ECU_ADDRESS 0xd000470a FORMAT "%2.0" /end MEASUREMENT
/begin CHARACTERISTIC Cbx_ant_coup_clos_clc_cfm "Determination of an anticipate coupler state when the coupler is closing" VALUE 0xa0021ab2 _REC_S1VAL_20_u1 1. _CNV_A_R_ECME_LINEA_0_CM 0. 1. FORMAT "%1.0" BIT_MASK 0x1 /end CHARACTERISTIC
/begin CHARACTERISTIC Cbx_bgin_clu_fail_cfm "Choice of degraded calculation of clutch state" VALUE 0xa0021ab3 _REC_S1VAL_20_u1 1. _CNV_A_R_ECME_LINEA_0_CM 0. 1. FORMAT "%1.0" BIT_MASK 0x1 /end CHARACTERISTIC
/begin CHARACTERISTIC Cbx_ovn_n_clu_det_cfm "Choice of enabling calculation strategy" VALUE 0xa0021ab4 _REC_S1VAL_20_u1 1. _CNV_A_R_ECME_LINEA_0_CM 0. 1. FORMAT "%1.0" BIT_MASK 0x1 /end CHARACTERISTIC
/begin CHARACTERISTIC Cxx_dly_clu_pdl_use_rtn "Delay before stating that the driver retain his foot on clutch pedal and stop declutching" VALUE 0xa0021ab5 _REC_S1VAL_20_u1 2.55 _CNV_A_R_LINEAR_____34_CM 0. 2.55 FORMAT "%4.2" /end CHARACTERISTIC
/begin CHARACTERISTIC Cxx_dly_neut_gear_act "Delay before stating that the driver has engeged the neutral gear and the vehicle is running" VALUE 0xa0021aa6 _REC_S1VAL_20_u2 65.535 _CNV_A_R_LINEAR_____58_CM 0. 65.535 /end CHARACTERISTIC
/begin CHARACTERISTIC Cxx_dly_neut_gear_cnt "Delay before stating that neutral gear is engaged, taken from neutral gear contactor." VALUE 0xa0021aa8 _REC_S1VAL_20_u2 65.535 _CNV_A_R_LINEAR_____58_CM 0. 65.535 /end CHARACTERISTIC
/begin CHARACTERISTIC Cxx_dly_pdl_rls "Delay before stating that the vehicle is declutched when the begin contactor was activated without a gear change" VALUE 0xa0021ab6 _REC_S1VAL_20_u1 2.55 _CNV_A_R_LINEAR_____34_CM 0. 2.55 FORMAT "%4.2" /end CHARACTERISTIC
/begin CHARACTERISTIC Cxx_ovn_n_clu_det_dly "Maximum time delay to detects the engine speed overshoot on an accelerator pedal release (driver tip-out)" VALUE 0xa0021aaa _REC_S1VAL_20_u2 655.35 _CNV_A_R_LINEAR_____34_CM 0. 655.35 FORMAT "%6.2" /end CHARACTERISTIC
/begin CHARACTERISTIC Cxx_ovn_n_clu_det_thd "Engine speed threshold autorization strategy calculation" VALUE 0xa0021aac _REC_S1VAL_20_u2 16383.75 _CNV_A_R_ENSD_LINEA_24_CM 0. 16383.75 FORMAT "%8.2" /end CHARACTERISTIC
/begin CHARACTERISTIC Cxx_ovn_n_dif_clu_det_thd "Engine speed overshoot threshold" VALUE 0xa0021aae _REC_S1VAL_20_u2 16383.75 _CNV_A_R_ENSD_LINEA_24_CM 0. 16383.75 FORMAT "%8.2" /end CHARACTERISTIC
/begin CHARACTERISTIC Cxx_rat_gear_stab_dly "Delay to identify the ratio stability" VALUE 0xa0021ab0 _REC_S1VAL_20_u2 65.535 _CNV_A_R_LINEAR_____58_CM 0. 65.535 /end CHARACTERISTIC
/begin CHARACTERISTIC Cxx_vs_vh_max "Maximum vehicle speed to enable the detection of a foot on clutch pedal" VALUE 0xa0021ab7 _REC_S1VAL_20_u1 255. _CNV_A_R_LINEAR_____212_CM 0. 255. FORMAT "%3.0" /end CHARACTERISTIC
/begin CHARACTERISTIC Cxx_vs_vh_min "Minimum vehicle speed to enable the detection of a foot on clutch pedal" VALUE 0xa0021ab8 _REC_S1VAL_20_u1 255. _CNV_A_R_LINEAR_____212_CM 0. 255. FORMAT "%3.0" /end CHARACTERISTIC
/begin MEASUREMENT Emul "Bit indicating that ECU works in emulated mode" UBYTE _CNV_S_2_RANGE______3_CM 1 0. 0. 1. DISPLAY_IDENTIFIER Vbx_supl_emul_ecm ECU_ADDRESS 0xd0001377 BIT_MASK 0x1 /end MEASUREMENT
/begin MEASUREMENT Vsx_bgin_str_clu_cnt "Begin stroke clutch pedal switch" UBYTE _CNV_A_R_ECME_LINEA_0_CM 1 0. 0. 255. ECU_ADDRESS 0xd000502e FORMAT "%3.0" /end MEASUREMENT
/begin MEASUREMENT Vsx_bgin_str_clu_cru "Begin stroke clutch pedal switch for cruise control" UBYTE _CNV_A_R_ECME_LINEA_0_CM 1 0. 0. 255. ECU_ADDRESS 0xd000502f FORMAT "%3.0" /end MEASUREMENT
/begin MEASUREMENT Vsx_bgin_str_clu_cru_rams "Begin stroke clutch pedal switch for cruise control safety" UBYTE _CNV_A_R_ECME_LINEA_0_CM 1 0. 0. 255. ECU_ADDRESS 0xd0005030 FORMAT "%3.0" /end MEASUREMENT
/begin MEASUREMENT Vsx_bgin_str_clu_cru_vld "Begin stroke clutch pedal switch for cruise control validity status" UBYTE _CNV_A_R_ECME_LINEA_0_CM 1 0. 0. 255. ECU_ADDRESS 0xd0005031 FORMAT "%3.0" /end MEASUREMENT
/begin CHARACTERISTIC Cbx_mux_clu_cnt_cfm "Choise using CAN data of begin clutch contactor" VALUE 0xa0020c82 _REC_S1VAL_20_u1 1. _CNV_S_2_RANGE______3_CM 0. 1. BIT_MASK 0x1 /end CHARACTERISTIC
/begin MEASUREMENT Vsx_mux_bgin_clu_cnt "Begin stroke clutch pedal switch (from a CAN parameter)" UBYTE _CNV_S_3_CNT_INDICA_388_CM 1 0. 0. 2. ECU_ADDRESS 0xd0004fd0 /end MEASUREMENT
/begin MEASUREMENT Vsx_mux_bgin_clu_cnt_vld "Begin stroke clutch pedal switch (from CAN parameter) validity status" UBYTE _CNV_S_4_STATUS_OK__121_CM 1 0. 0. 3. ECU_ADDRESS 0xd0004fd1 /end MEASUREMENT
/begin MEASUREMENT Vsx_sens_bgin_clu_cnt "Wire begin clutch contactor state" UBYTE _CNV_A_R_ECME_LINEA_0_CM 1 0. 0. 255. ECU_ADDRESS 0xd0004c04 FORMAT "%3.0" /end MEASUREMENT
/begin MEASUREMENT Vsx_sens_bgin_clu_cnt_vld "Wire begin clutch contactor state validity status" UBYTE _CNV_S_3_STATUS_OK__120_CM 1 0. 0. 2. ECU_ADDRESS 0xd0004c05 /end MEASUREMENT
/begin CHARACTERISTIC Cxx_sens_clu_lk_vb_dly "Filter time to enable the begin clutch contactor connection detection" VALUE 0xa0020a04 _REC_S1VAL_20_u1 25.5 _CNV_A_R_LINEAR_____4_CM 0. 25.5 FORMAT "%4.1" /end CHARACTERISTIC
/begin CHARACTERISTIC Cxx_sens_clu_lk_vb_thd "Minimum battery voltage to enable the begin cluch contactor connection detection" VALUE 0xa0020a02 _REC_S1VAL_20_u2 25000. _CNV_A_R_LINEAR_____52_CM 0. 25000. FORMAT "%5.0" /end CHARACTERISTIC
/begin MEASUREMENT Vbx_ant_gear_shf "Rising shift identification" UBYTE _CNV_S_2_RANGE______3_CM 1 0. 0. 1. ECU_ADDRESS 0xd0004adb BIT_MASK 0x1 /end MEASUREMENT
/begin MEASUREMENT Vbx_bgin_clu_off_nok "Incoherency confirmed when the begin clutch contactor is always OFF" UBYTE _CNV_S_2_RANGE______3_CM 1 0. 0. 1. ECU_ADDRESS 0xd0004adc BIT_MASK 0x1 /end MEASUREMENT
/begin MEASUREMENT Vbx_bgin_clu_on_nok "Incoherency confirmed when the begin clutch contactor is always ON" UBYTE _CNV_S_2_RANGE______3_CM 1 0. 0. 1. ECU_ADDRESS 0xd0004add BIT_MASK 0x1 /end MEASUREMENT
/begin MEASUREMENT Vbx_df_bgin_clu_nok "Wire begin clutch contactor detected failure" UBYTE _CNV_S_2_RANGE______3_CM 1 0. 0. 1. ECU_ADDRESS 0xd0004ade BIT_MASK 0x1 /end MEASUREMENT
/begin MEASUREMENT Vbx_raw_bgin_clu_off_no_chr "Incohernecy detected when the begin clutch contactor is always OFF" UBYTE _CNV_S_2_RANGE______3_CM 1 0. 0. 1. ECU_ADDRESS 0xd0004adf BIT_MASK 0x1 /end MEASUREMENT
/begin MEASUREMENT Vxx_ant_gear_2 "Anticipated gear engaged high precision" SWORD _CNV_A_R_LINEAR_____136_CM 1 0. -1. 6. ECU_ADDRESS 0xd0002ca0 FORMAT "%6.2" /end MEASUREMENT
/begin MEASUREMENT Vxx_ant_gear_mem "Last lower gear high precision" SWORD _CNV_A_R_LINEAR_____136_CM 1 0. -1. 6. ECU_ADDRESS 0xd0002ca2 FORMAT "%6.2" /end MEASUREMENT
/begin CHARACTERISTIC Cbx_bgin_clu_off_dg_cfm "Diag contactor always off activation" VALUE 0xa0021d2c _REC_S1VAL_20_u1 1. _CNV_A_R_ECME_LINEA_0_CM 0. 1. FORMAT "%1.0" BIT_MASK 0x1 /end CHARACTERISTIC
/begin CHARACTERISTIC Cbx_bgin_clu_on_dg_cfm "Diag contactor always on activation" VALUE 0xa0021d2d _REC_S1VAL_20_u1 1. _CNV_A_R_ECME_LINEA_0_CM 0. 1. FORMAT "%1.0" BIT_MASK 0x1 /end CHARACTERISTIC
/begin CHARACTERISTIC Cxx_ant_gear_dif_thd "Threshold for the rising shift detection" VALUE 0xa0021d22 _REC_S1VAL_20_s2 14. _CNV_A_R_LINEAR_____136_CM -7. 7. FORMAT "%6.2" /end CHARACTERISTIC
/begin CHARACTERISTIC Cxx_ant_gear_fil "Time constant value for the the gear shift filter" VALUE 0xa0021d2e _REC_S1VAL_20_u1 25.5 _CNV_A_R_LINEAR_____4_CM 0. 25.5 FORMAT "%4.1" /end CHARACTERISTIC
/begin CHARACTERISTIC Cxx_bgin_clu_dg_act_vs_max "Maximal vehicle speed of the activation of the diagnosis" VALUE 0xa0021d24 _REC_S1VAL_20_u2 655.35 _CNV_A_R_LINEAR_____70_CM 0. 655.35 FORMAT "%6.2" /end CHARACTERISTIC
/begin CHARACTERISTIC Cxx_bgin_clu_dg_act_vs_min "Minimal vehicle speed of the activation of the diagnosis" VALUE 0xa0021d26 _REC_S1VAL_20_u2 655.35 _CNV_A_R_LINEAR_____70_CM 0. 655.35 FORMAT "%6.2" /end CHARACTERISTIC
/begin CHARACTERISTIC Cxx_bgin_clu_off_no_chr_ctr "Number of incoherencies when the begin clutch contactor is OFF before activating the failure manager" VALUE 0xa0021d2f _REC_S1VAL_20_u1 255. _CNV_A_R_ECME_LINEA_0_CM 0. 255. FORMAT "%3.0" /end CHARACTERISTIC
/begin CHARACTERISTIC Cxx_bgin_clu_on_no_chr_ctr "Number of incoherencies when the begin clutch contactor is ON before activating the failure manager" VALUE 0xa0021d30 _REC_S1VAL_20_u1 255. _CNV_A_R_ECME_LINEA_0_CM 0. 255. FORMAT "%3.0" /end CHARACTERISTIC
/begin CHARACTERISTIC Cxx_dfdec_bgin_clu_nok "Wire begin clutch contactor detected failure counter decrement" VALUE 0xa0021d28 _REC_S1VAL_20_u2 65535. _CNV_A_R_ECME_LINEA_0_CM 0. 65535. FORMAT "%5.0" /end CHARACTERISTIC
/begin CHARACTERISTIC Cxx_dfinc_bgin_clu_nok "Wire begin clutch contactor detected failure counter increment" VALUE 0xa0021d2a _REC_S1VAL_20_u2 65535. _CNV_A_R_ECME_LINEA_0_CM 0. 65535. FORMAT "%5.0" /end CHARACTERISTIC
/begin MEASUREMENT Vbx_df_knk_oor "Voltage Outside the Expected Range of knock detected failure" UBYTE _CNV_S_2_RANGE______3_CM 1 0. 0. 1. ECU_ADDRESS 0xd0004357 BIT_MASK 0x1 /end MEASUREMENT
/begin MEASUREMENT Vbx_df_knk_shp "Improper Signal Shape of knock detected failure" UBYTE _CNV_S_2_RANGE______3_CM 1 0. 0. 1. ECU_ADDRESS 0xd0004358 BIT_MASK 0x1 /end MEASUREMENT
/begin MEASUREMENT Vbx_diag_ena_knk_oor "Voltage Outside the Expected Range of knock diagnosis authorization" UBYTE _CNV_S_2_RANGE______3_CM 1 0. 0. 1. ECU_ADDRESS 0xd0004359 BIT_MASK 0x1 /end MEASUREMENT
/begin MEASUREMENT Vbx_diag_ena_knk_shp "Improper Signal Shape of knock diagnosis authorization" UBYTE _CNV_S_2_RANGE______3_CM 1 0. 0. 1. ECU_ADDRESS 0xd000435a BIT_MASK 0x1 /end MEASUREMENT
/begin MEASUREMENT Vbx_knk_win_diag "Diagnosis of knock sensor in process" UBYTE _CNV_S_2_RANGE______3_CM 1 0. 0. 1. ECU_ADDRESS 0xd000435b BIT_MASK 0x1 /end MEASUREMENT
/begin MEASUREMENT Vtd_fil_acq_knk_cyl[0] "Instantaneous knock noise for each cylinder" UBYTE _CNV_A_R_ECME_LINEA_0_CM 1 0. 0. 255. ECU_ADDRESS 0xd0004350 FORMAT "%3.0" /end MEASUREMENT
/begin MEASUREMENT Vtd_fil_acq_knk_cyl[1] "Instantaneous knock noise for each cylinder" UBYTE _CNV_A_R_ECME_LINEA_0_CM 1 0. 0. 255. ECU_ADDRESS 0xd0004351 FORMAT "%3.0" /end MEASUREMENT
/begin MEASUREMENT Vtd_fil_acq_knk_cyl[2] "Instantaneous knock noise for each cylinder" UBYTE _CNV_A_R_ECME_LINEA_0_CM 1 0. 0. 255. ECU_ADDRESS 0xd0004352 FORMAT "%3.0" /end MEASUREMENT
/begin MEASUREMENT Vtd_fil_acq_knk_cyl[3] "Instantaneous knock noise for each cylinder" UBYTE _CNV_A_R_ECME_LINEA_0_CM 1 0. 0. 255. ECU_ADDRESS 0xd0004353 FORMAT "%3.0" /end MEASUREMENT
/begin MEASUREMENT Vxx_knk_tdc_ctr "TDC counter for knock detection, indicates for which cylinder the knock value is available." UBYTE _CNV_A_R_LINEAR_____55_CM 1 0. 0. 3. ECU_ADDRESS 0xd0004354 FORMAT "%1.0" /end MEASUREMENT
/begin AXIS_PTS ldp_n_32_ip_nl_gain_ad "" 0xa00212f0 n_32 _REC_A2AXS_20_u1 8160. _CNV_A_R_LINEAR_____2_CM 4 0. 8160. FORMAT "%4.0" /end AXIS_PTS
/begin CHARACTERISTIC id_fac_thd_knk[0] "Knock Factor Table per cylinder" MAP 0xa0022a70 _REC_A1MAP_20_u1_u1_u1 7.96875 _CNV_A_R_KNCK_LINEA_390_CM 0. 7.96875 FORMAT "%5.3"
 /begin AXIS_DESCR COM_AXIS n_32 _CNV_A_R_LINEAR_____2_CM 16 0. 8160. FORMAT "%4.0" AXIS_PTS_REF ldpm_n_32_2_knck /end AXIS_DESCR
 /begin AXIS_DESCR COM_AXIS maf_hb _CNV_A_R_LINEAR_____281_CM 4 0. 1389. FORMAT "%4.0" AXIS_PTS_REF ldpm_maf_hb_1_knck /end AXIS_DESCR
/end CHARACTERISTIC
/begin CHARACTERISTIC id_fac_thd_knk[1] "Knock Factor Table per cylinder" MAP 0xa0022ab0 _REC_A1MAP_20_u1_u1_u1 7.96875 _CNV_A_R_KNCK_LINEA_390_CM 0. 7.96875 FORMAT "%5.3"
 /begin AXIS_DESCR COM_AXIS n_32 _CNV_A_R_LINEAR_____2_CM 16 0. 8160. FORMAT "%4.0" AXIS_PTS_REF ldpm_n_32_2_knck /end AXIS_DESCR
 /begin AXIS_DESCR COM_AXIS maf_hb _CNV_A_R_LINEAR_____281_CM 4 0. 1389. FORMAT "%4.0" AXIS_PTS_REF ldpm_maf_hb_1_knck /end AXIS_DESCR
/end CHARACTERISTIC
/begin CHARACTERISTIC id_fac_thd_knk[2] "Knock Factor Table per cylinder" MAP 0xa0022af0 _REC_A1MAP_20_u1_u1_u1 7.96875 _CNV_A_R_KNCK_LINEA_390_CM 0. 7.96875 FORMAT "%5.3"
 /begin AXIS_DESCR COM_AXIS n_32 _CNV_A_R_LINEAR_____2_CM 16 0. 8160. FORMAT "%4.0" AXIS_PTS_REF ldpm_n_32_2_knck /end AXIS_DESCR
 /begin AXIS_DESCR COM_AXIS maf_hb _CNV_A_R_LINEAR_____281_CM 4 0. 1389. FORMAT "%4.0" AXIS_PTS_REF ldpm_maf_hb_1_knck /end AXIS_DESCR
/end CHARACTERISTIC
/begin CHARACTERISTIC id_fac_thd_knk[3] "Knock Factor Table per cylinder" MAP 0xa0022b30 _REC_A1MAP_20_u1_u1_u1 7.96875 _CNV_A_R_KNCK_LINEA_390_CM 0. 7.96875 FORMAT "%5.3"
 /begin AXIS_DESCR COM_AXIS n_32 _CNV_A_R_LINEAR_____2_CM 16 0. 8160. FORMAT "%4.0" AXIS_PTS_REF ldpm_n_32_2_knck /end AXIS_DESCR
 /begin AXIS_DESCR COM_AXIS maf_hb _CNV_A_R_LINEAR_____281_CM 4 0. 1389. FORMAT "%4.0" AXIS_PTS_REF ldpm_maf_hb_1_knck /end AXIS_DESCR
/end CHARACTERISTIC
/begin CHARACTERISTIC id_knks_fil_frq[0] "Knock Filter Frequency for each cylinder" MAP 0xa0022b70 _REC_A1MAP_20_u1_u1_u1 63. _CNV_A_R_ECME_LINEA_0_CM 0. 63. FORMAT "%3.0"
 /begin AXIS_DESCR COM_AXIS n_32 _CNV_A_R_LINEAR_____2_CM 8 0. 8160. FORMAT "%4.0" AXIS_PTS_REF ldpm_n_32_1_knck /end AXIS_DESCR
 /begin AXIS_DESCR COM_AXIS maf_hb _CNV_A_R_LINEAR_____281_CM 4 0. 1389. FORMAT "%4.0" AXIS_PTS_REF ldpm_maf_hb_1_knck /end AXIS_DESCR
/end CHARACTERISTIC
/begin CHARACTERISTIC id_knks_fil_frq[1] "Knock Filter Frequency for each cylinder" MAP 0xa0022b90 _REC_A1MAP_20_u1_u1_u1 63. _CNV_A_R_ECME_LINEA_0_CM 0. 63. FORMAT "%3.0"
 /begin AXIS_DESCR COM_AXIS n_32 _CNV_A_R_LINEAR_____2_CM 8 0. 8160. FORMAT "%4.0" AXIS_PTS_REF ldpm_n_32_1_knck /end AXIS_DESCR
 /begin AXIS_DESCR COM_AXIS maf_hb _CNV_A_R_LINEAR_____281_CM 4 0. 1389. FORMAT "%4.0" AXIS_PTS_REF ldpm_maf_hb_1_knck /end AXIS_DESCR
/end CHARACTERISTIC
/begin CHARACTERISTIC id_knks_fil_frq[2] "Knock Filter Frequency for each cylinder" MAP 0xa0022bb0 _REC_A1MAP_20_u1_u1_u1 63. _CNV_A_R_ECME_LINEA_0_CM 0. 63. FORMAT "%3.0"
 /begin AXIS_DESCR COM_AXIS n_32 _CNV_A_R_LINEAR_____2_CM 8 0. 8160. FORMAT "%4.0" AXIS_PTS_REF ldpm_n_32_1_knck /end AXIS_DESCR
 /begin AXIS_DESCR COM_AXIS maf_hb _CNV_A_R_LINEAR_____281_CM 4 0. 1389. FORMAT "%4.0" AXIS_PTS_REF ldpm_maf_hb_1_knck /end AXIS_DESCR
/end CHARACTERISTIC
/begin CHARACTERISTIC id_knks_fil_frq[3] "Knock Filter Frequency for each cylinder" MAP 0xa0022bd0 _REC_A1MAP_20_u1_u1_u1 63. _CNV_A_R_ECME_LINEA_0_CM 0. 63. FORMAT "%3.0"
 /begin AXIS_DESCR COM_AXIS n_32 _CNV_A_R_LINEAR_____2_CM 8 0. 8160. FORMAT "%4.0" AXIS_PTS_REF ldpm_n_32_1_knck /end AXIS_DESCR
 /begin AXIS_DESCR COM_AXIS maf_hb _CNV_A_R_LINEAR_____281_CM 4 0. 1389. FORMAT "%4.0" AXIS_PTS_REF ldpm_maf_hb_1_knck /end AXIS_DESCR
/end CHARACTERISTIC
/begin CHARACTERISTIC id_knks_thd_add "Knock summand" CURVE 0xa0022bf0 _REC_A1CUR_20_u1_u1 5.1 _CNV_A_R_KNCK_LINEA_391_CM -2.56 2.54 FORMAT "%8.6"
 /begin AXIS_DESCR COM_AXIS n_32 _CNV_A_R_LINEAR_____2_CM 16 0. 8160. FORMAT "%4.0" AXIS_PTS_REF ldpm_n_32_2_knck /end AXIS_DESCR
/end CHARACTERISTIC
/begin CHARACTERISTIC ip_itc_knk[0] "Integration Time Constant table defined per knock sensor" CURVE 0xa00212e0 _REC_A1CUR_20_u1_u1 31. _CNV_A_R_ECME_LINEA_0_CM 0. 31. FORMAT "%3.0"
 /begin AXIS_DESCR COM_AXIS n_32 _CNV_A_R_LINEAR_____2_CM 8 0. 8160. FORMAT "%4.0" AXIS_PTS_REF ldpm_n_32_1_knck /end AXIS_DESCR
/end CHARACTERISTIC
/begin CHARACTERISTIC ip_knks_gain[0] "Gain value for each cylinder" MAP 0xa0022c20 _REC_A1MAP_20_u1_u1_u1 63. _CNV_A_R_ECME_LINEA_0_CM 0. 63. FORMAT "%3.0"
 /begin AXIS_DESCR COM_AXIS n_32 _CNV_A_R_LINEAR_____2_CM 16 0. 8160. FORMAT "%4.0" AXIS_PTS_REF ldpm_n_32_2_knck /end AXIS_DESCR
 /begin AXIS_DESCR COM_AXIS maf_hb _CNV_A_R_LINEAR_____281_CM 12 0. 1389. FORMAT "%4.0" AXIS_PTS_REF ldpm_maf_hb_2_knck /end AXIS_DESCR
/end CHARACTERISTIC
/begin CHARACTERISTIC ip_knks_gain[1] "Gain value for each cylinder" MAP 0xa0022ce0 _REC_A1MAP_20_u1_u1_u1 63. _CNV_A_R_ECME_LINEA_0_CM 0. 63. FORMAT "%3.0"
 /begin AXIS_DESCR COM_AXIS n_32 _CNV_A_R_LINEAR_____2_CM 16 0. 8160. FORMAT "%4.0" AXIS_PTS_REF ldpm_n_32_2_knck /end AXIS_DESCR
 /begin AXIS_DESCR COM_AXIS maf_hb _CNV_A_R_LINEAR_____281_CM 12 0. 1389. FORMAT "%4.0" AXIS_PTS_REF ldpm_maf_hb_2_knck /end AXIS_DESCR
/end CHARACTERISTIC
/begin CHARACTERISTIC ip_knks_gain[2] "Gain value for each cylinder" MAP 0xa0022da0 _REC_A1MAP_20_u1_u1_u1 63. _CNV_A_R_ECME_LINEA_0_CM 0. 63. FORMAT "%3.0"
 /begin AXIS_DESCR COM_AXIS n_32 _CNV_A_R_LINEAR_____2_CM 16 0. 8160. FORMAT "%4.0" AXIS_PTS_REF ldpm_n_32_2_knck /end AXIS_DESCR
 /begin AXIS_DESCR COM_AXIS maf_hb _CNV_A_R_LINEAR_____281_CM 12 0. 1389. FORMAT "%4.0" AXIS_PTS_REF ldpm_maf_hb_2_knck /end AXIS_DESCR
/end CHARACTERISTIC
/begin CHARACTERISTIC ip_knks_gain[3] "Gain value for each cylinder" MAP 0xa0022e60 _REC_A1MAP_20_u1_u1_u1 63. _CNV_A_R_ECME_LINEA_0_CM 0. 63. FORMAT "%3.0"
 /begin AXIS_DESCR COM_AXIS n_32 _CNV_A_R_LINEAR_____2_CM 16 0. 8160. FORMAT "%4.0" AXIS_PTS_REF ldpm_n_32_2_knck /end AXIS_DESCR
 /begin AXIS_DESCR COM_AXIS maf_hb _CNV_A_R_LINEAR_____281_CM 12 0. 1389. FORMAT "%4.0" AXIS_PTS_REF ldpm_maf_hb_2_knck /end AXIS_DESCR
/end CHARACTERISTIC
/begin CHARACTERISTIC ip_knkwb[0] "Beginning of measurement knock window for each cylinder" MAP 0xa0022f20 _REC_A1MAP_20_u1_u1_u1 70.125 _CNV_A_R_LINEAR_____25_CM 0. 70.125
 /begin AXIS_DESCR COM_AXIS n_32 _CNV_A_R_LINEAR_____2_CM 8 0. 8160. FORMAT "%4.0" AXIS_PTS_REF ldpm_n_32_1_knck /end AXIS_DESCR
 /begin AXIS_DESCR COM_AXIS maf_hb _CNV_A_R_LINEAR_____281_CM 4 0. 1389. FORMAT "%4.0" AXIS_PTS_REF ldpm_maf_hb_1_knck /end AXIS_DESCR
/end CHARACTERISTIC
/begin CHARACTERISTIC ip_knkwb[1] "Beginning of measurement knock window for each cylinder" MAP 0xa0022f40 _REC_A1MAP_20_u1_u1_u1 70.125 _CNV_A_R_LINEAR_____25_CM 0. 70.125
 /begin AXIS_DESCR COM_AXIS n_32 _CNV_A_R_LINEAR_____2_CM 8 0. 8160. FORMAT "%4.0" AXIS_PTS_REF ldpm_n_32_1_knck /end AXIS_DESCR
 /begin AXIS_DESCR COM_AXIS maf_hb _CNV_A_R_LINEAR_____281_CM 4 0. 1389. FORMAT "%4.0" AXIS_PTS_REF ldpm_maf_hb_1_knck /end AXIS_DESCR
/end CHARACTERISTIC
/begin CHARACTERISTIC ip_knkwb[2] "Beginning of measurement knock window for each cylinder" MAP 0xa0022f60 _REC_A1MAP_20_u1_u1_u1 70.125 _CNV_A_R_LINEAR_____25_CM 0. 70.125
 /begin AXIS_DESCR COM_AXIS n_32 _CNV_A_R_LINEAR_____2_CM 8 0. 8160. FORMAT "%4.0" AXIS_PTS_REF ldpm_n_32_1_knck /end AXIS_DESCR
 /begin AXIS_DESCR COM_AXIS maf_hb _CNV_A_R_LINEAR_____281_CM 4 0. 1389. FORMAT "%4.0" AXIS_PTS_REF ldpm_maf_hb_1_knck /end AXIS_DESCR
/end CHARACTERISTIC
/begin CHARACTERISTIC ip_knkwb[3] "Beginning of measurement knock window for each cylinder" MAP 0xa0022f80 _REC_A1MAP_20_u1_u1_u1 70.125 _CNV_A_R_LINEAR_____25_CM 0. 70.125
 /begin AXIS_DESCR COM_AXIS n_32 _CNV_A_R_LINEAR_____2_CM 8 0. 8160. FORMAT "%4.0" AXIS_PTS_REF ldpm_n_32_1_knck /end AXIS_DESCR
 /begin AXIS_DESCR COM_AXIS maf_hb _CNV_A_R_LINEAR_____281_CM 4 0. 1389. FORMAT "%4.0" AXIS_PTS_REF ldpm_maf_hb_1_knck /end AXIS_DESCR
/end CHARACTERISTIC
/begin CHARACTERISTIC ip_knkwd[0] "Duration of measurement knock window for each cylinder" MAP 0xa0022fa0 _REC_A1MAP_20_u1_u1_u1 70.125 _CNV_A_R_LINEAR_____25_CM 0. 70.125
 /begin AXIS_DESCR COM_AXIS n_32 _CNV_A_R_LINEAR_____2_CM 8 0. 8160. FORMAT "%4.0" AXIS_PTS_REF ldpm_n_32_1_knck /end AXIS_DESCR
 /begin AXIS_DESCR COM_AXIS maf_hb _CNV_A_R_LINEAR_____281_CM 4 0. 1389. FORMAT "%4.0" AXIS_PTS_REF ldpm_maf_hb_1_knck /end AXIS_DESCR
/end CHARACTERISTIC
/begin CHARACTERISTIC ip_knkwd[1] "Duration of measurement knock window for each cylinder" MAP 0xa0022fc0 _REC_A1MAP_20_u1_u1_u1 70.125 _CNV_A_R_LINEAR_____25_CM 0. 70.125
 /begin AXIS_DESCR COM_AXIS n_32 _CNV_A_R_LINEAR_____2_CM 8 0. 8160. FORMAT "%4.0" AXIS_PTS_REF ldpm_n_32_1_knck /end AXIS_DESCR
 /begin AXIS_DESCR COM_AXIS maf_hb _CNV_A_R_LINEAR_____281_CM 4 0. 1389. FORMAT "%4.0" AXIS_PTS_REF ldpm_maf_hb_1_knck /end AXIS_DESCR
/end CHARACTERISTIC
/begin CHARACTERISTIC ip_knkwd[2] "Duration of measurement knock window for each cylinder" MAP 0xa0022fe0 _REC_A1MAP_20_u1_u1_u1 70.125 _CNV_A_R_LINEAR_____25_CM 0. 70.125
 /begin AXIS_DESCR COM_AXIS n_32 _CNV_A_R_LINEAR_____2_CM 8 0. 8160. FORMAT "%4.0" AXIS_PTS_REF ldpm_n_32_1_knck /end AXIS_DESCR
 /begin AXIS_DESCR COM_AXIS maf_hb _CNV_A_R_LINEAR_____281_CM 4 0. 1389. FORMAT "%4.0" AXIS_PTS_REF ldpm_maf_hb_1_knck /end AXIS_DESCR
/end CHARACTERISTIC
/begin CHARACTERISTIC ip_knkwd[3] "Duration of measurement knock window for each cylinder" MAP 0xa0023000 _REC_A1MAP_20_u1_u1_u1 70.125 _CNV_A_R_LINEAR_____25_CM 0. 70.125
 /begin AXIS_DESCR COM_AXIS n_32 _CNV_A_R_LINEAR_____2_CM 8 0. 8160. FORMAT "%4.0" AXIS_PTS_REF ldpm_n_32_1_knck /end AXIS_DESCR
 /begin AXIS_DESCR COM_AXIS maf_hb _CNV_A_R_LINEAR_____281_CM 4 0. 1389. FORMAT "%4.0" AXIS_PTS_REF ldpm_maf_hb_1_knck /end AXIS_DESCR
/end CHARACTERISTIC
/begin CHARACTERISTIC ip_nl_gain_ad "Target value of centred engine noise " CURVE 0xa00212e8 _REC_A1CUR_20_u2_u1 4.99992371 _CNV_A_R_KNCK_LINEA_392_CM 0. 4.99992371 FORMAT "%7.5"
 /begin AXIS_DESCR COM_AXIS n_32 _CNV_A_R_LINEAR_____2_CM 4 0. 8160. FORMAT "%4.0" AXIS_PTS_REF ldp_n_32_ip_nl_gain_ad /end AXIS_DESCR
/end CHARACTERISTIC
/begin MEASUREMENT egy_knk "Common variable of knock energy level " UWORD _CNV_A_R_LINEAR_____53_CM 1 0. 0. 3.99993896484375 ECU_ADDRESS 0xd0003232 FORMAT "%7.5" /end MEASUREMENT
/begin MEASUREMENT knks_cmd_conf[0] "Configuration value for the analogue channel of knock sensor" UBYTE _CNV_A_R_ECME_LINEA_0_CM 1 0. 0. 3. ECU_ADDRESS 0xd0004be4 FORMAT "%3.0" /end MEASUREMENT
/begin MEASUREMENT knks_cmd_conf[1] "Configuration value for the analogue channel of knock sensor" UBYTE _CNV_A_R_ECME_LINEA_0_CM 1 0. 0. 3. ECU_ADDRESS 0xd0004be5 FORMAT "%3.0" /end MEASUREMENT
/begin MEASUREMENT knks_cmd_conf[2] "Configuration value for the analogue channel of knock sensor" UBYTE _CNV_A_R_ECME_LINEA_0_CM 1 0. 0. 3. ECU_ADDRESS 0xd0004be6 FORMAT "%3.0" /end MEASUREMENT
/begin MEASUREMENT knks_cmd_conf[3] "Configuration value for the analogue channel of knock sensor" UBYTE _CNV_A_R_ECME_LINEA_0_CM 1 0. 0. 3. ECU_ADDRESS 0xd0004be7 FORMAT "%3.0" /end MEASUREMENT
/begin MEASUREMENT knks_cmd_fil[0] "Knock Filter Frequency for each cylinder" UBYTE _CNV_A_R_ECME_LINEA_0_CM 1 0. 0. 63. ECU_ADDRESS 0xd0004be8 FORMAT "%3.0" /end MEASUREMENT
/begin MEASUREMENT knks_cmd_fil[1] "Knock Filter Frequency for each cylinder" UBYTE _CNV_A_R_ECME_LINEA_0_CM 1 0. 0. 63. ECU_ADDRESS 0xd0004be9 FORMAT "%3.0" /end MEASUREMENT
/begin MEASUREMENT knks_cmd_fil[2] "Knock Filter Frequency for each cylinder" UBYTE _CNV_A_R_ECME_LINEA_0_CM 1 0. 0. 63. ECU_ADDRESS 0xd0004bea FORMAT "%3.0" /end MEASUREMENT
/begin MEASUREMENT knks_cmd_fil[3] "Knock Filter Frequency for each cylinder" UBYTE _CNV_A_R_ECME_LINEA_0_CM 1 0. 0. 63. ECU_ADDRESS 0xd0004beb FORMAT "%3.0" /end MEASUREMENT
/begin MEASUREMENT knks_cmd_gain[0] "Gain value for each cylinder" UBYTE _CNV_A_R_ECME_LINEA_0_CM 1 0. 0. 63. ECU_ADDRESS 0xd0004bec FORMAT "%3.0" /end MEASUREMENT
/begin MEASUREMENT knks_cmd_gain[1] "Gain value for each cylinder" UBYTE _CNV_A_R_ECME_LINEA_0_CM 1 0. 0. 63. ECU_ADDRESS 0xd0004bed FORMAT "%3.0" /end MEASUREMENT
/begin MEASUREMENT knks_cmd_gain[2] "Gain value for each cylinder" UBYTE _CNV_A_R_ECME_LINEA_0_CM 1 0. 0. 63. ECU_ADDRESS 0xd0004bee FORMAT "%3.0" /end MEASUREMENT
/begin MEASUREMENT knks_cmd_gain[3] "Gain value for each cylinder" UBYTE _CNV_A_R_ECME_LINEA_0_CM 1 0. 0. 63. ECU_ADDRESS 0xd0004bef FORMAT "%3.0" /end MEASUREMENT
/begin MEASUREMENT knks_cmd_gain_ad[0] "Signed Offset on programming gain of knock IC device for each cylinder by adaptation of the engine noise" SBYTE _CNV_A_R_ECME_LINEA_0_CM 1 0. -31. 31. ECU_ADDRESS 0xd0005290 FORMAT "%2.0" /end MEASUREMENT
/begin MEASUREMENT knks_cmd_gain_ad[1] "Signed Offset on programming gain of knock IC device for each cylinder by adaptation of the engine noise" SBYTE _CNV_A_R_ECME_LINEA_0_CM 1 0. -31. 31. ECU_ADDRESS 0xd0005291 FORMAT "%2.0" /end MEASUREMENT
/begin MEASUREMENT knks_cmd_gain_ad[2] "Signed Offset on programming gain of knock IC device for each cylinder by adaptation of the engine noise" SBYTE _CNV_A_R_ECME_LINEA_0_CM 1 0. -31. 31. ECU_ADDRESS 0xd0005292 FORMAT "%2.0" /end MEASUREMENT
/begin MEASUREMENT knks_cmd_gain_ad[3] "Signed Offset on programming gain of knock IC device for each cylinder by adaptation of the engine noise" SBYTE _CNV_A_R_ECME_LINEA_0_CM 1 0. -31. 31. ECU_ADDRESS 0xd0005293 FORMAT "%2.0" /end MEASUREMENT
/begin MEASUREMENT knks_cmd_int[0] "Integration Time Constant for each cylinder" UBYTE _CNV_A_R_ECME_LINEA_0_CM 1 0. 0. 255. ECU_ADDRESS 0xd0004bf0 FORMAT "%3.0" /end MEASUREMENT
/begin MEASUREMENT knks_cmd_int[1] "Integration Time Constant for each cylinder" UBYTE _CNV_A_R_ECME_LINEA_0_CM 1 0. 0. 255. ECU_ADDRESS 0xd0004bf1 FORMAT "%3.0" /end MEASUREMENT
/begin MEASUREMENT knks_cmd_int[2] "Integration Time Constant for each cylinder" UBYTE _CNV_A_R_ECME_LINEA_0_CM 1 0. 0. 255. ECU_ADDRESS 0xd0004bf2 FORMAT "%3.0" /end MEASUREMENT
/begin MEASUREMENT knks_cmd_int[3] "Integration Time Constant for each cylinder" UBYTE _CNV_A_R_ECME_LINEA_0_CM 1 0. 0. 255. ECU_ADDRESS 0xd0004bf3 FORMAT "%3.0" /end MEASUREMENT
/begin MEASUREMENT knks_thd[0] "Knock Threshold per cylinder" UBYTE _CNV_A_R_KNCK_LINEA_393_CM 1 0. 0. 4.98046875 ECU_ADDRESS 0xd0004bf4 FORMAT "%6.4" /end MEASUREMENT
/begin MEASUREMENT knks_thd[1] "Knock Threshold per cylinder" UBYTE _CNV_A_R_KNCK_LINEA_393_CM 1 0. 0. 4.98046875 ECU_ADDRESS 0xd0004bf5 FORMAT "%6.4" /end MEASUREMENT
/begin MEASUREMENT knks_thd[2] "Knock Threshold per cylinder" UBYTE _CNV_A_R_KNCK_LINEA_393_CM 1 0. 0. 4.98046875 ECU_ADDRESS 0xd0004bf6 FORMAT "%6.4" /end MEASUREMENT
/begin MEASUREMENT knks_thd[3] "Knock Threshold per cylinder" UBYTE _CNV_A_R_KNCK_LINEA_393_CM 1 0. 0. 4.98046875 ECU_ADDRESS 0xd0004bf7 FORMAT "%6.4" /end MEASUREMENT
/begin MEASUREMENT knkwb[0] "Beginning of measurement knock window for each cylinder" UBYTE _CNV_A_R_LINEAR_____25_CM 1 0. 0. 95.625 ECU_ADDRESS 0xd0004bf8 /end MEASUREMENT
/begin MEASUREMENT knkwb[1] "Beginning of measurement knock window for each cylinder" UBYTE _CNV_A_R_LINEAR_____25_CM 1 0. 0. 95.625 ECU_ADDRESS 0xd0004bf9 /end MEASUREMENT
/begin MEASUREMENT knkwb[2] "Beginning of measurement knock window for each cylinder" UBYTE _CNV_A_R_LINEAR_____25_CM 1 0. 0. 95.625 ECU_ADDRESS 0xd0004bfa /end MEASUREMENT
/begin MEASUREMENT knkwb[3] "Beginning of measurement knock window for each cylinder" UBYTE _CNV_A_R_LINEAR_____25_CM 1 0. 0. 95.625 ECU_ADDRESS 0xd0004bfb /end MEASUREMENT
/begin MEASUREMENT knkwd[0] "Duration of measurement knock window for each cylinder" UBYTE _CNV_A_R_LINEAR_____25_CM 1 0. 0. 95.625 ECU_ADDRESS 0xd0004bfc /end MEASUREMENT
/begin MEASUREMENT knkwd[1] "Duration of measurement knock window for each cylinder" UBYTE _CNV_A_R_LINEAR_____25_CM 1 0. 0. 95.625 ECU_ADDRESS 0xd0004bfd /end MEASUREMENT
/begin MEASUREMENT knkwd[2] "Duration of measurement knock window for each cylinder" UBYTE _CNV_A_R_LINEAR_____25_CM 1 0. 0. 95.625 ECU_ADDRESS 0xd0004bfe /end MEASUREMENT
/begin MEASUREMENT knkwd[3] "Duration of measurement knock window for each cylinder" UBYTE _CNV_A_R_LINEAR_____25_CM 1 0. 0. 95.625 ECU_ADDRESS 0xd0004bff /end MEASUREMENT
/begin MEASUREMENT lv_knk "Logical variable for recognition of knock detection" UBYTE _CNV_S_2_RANGE______3_CM 1 0. 0. 1. ECU_ADDRESS 0xd00041e0 BIT_MASK 0x1 /end MEASUREMENT
/begin MEASUREMENT nl[0] "Floating mean value of the noise signal" UWORD _CNV_A_R_KNCK_LINEA_392_CM 1 0. 0. 4.99992371 ECU_ADDRESS 0xd000323e FORMAT "%7.5" /end MEASUREMENT
/begin MEASUREMENT nl[1] "Floating mean value of the noise signal" UWORD _CNV_A_R_KNCK_LINEA_392_CM 1 0. 0. 4.99992371 ECU_ADDRESS 0xd0003240 FORMAT "%7.5" /end MEASUREMENT
/begin MEASUREMENT nl[2] "Floating mean value of the noise signal" UWORD _CNV_A_R_KNCK_LINEA_392_CM 1 0. 0. 4.99992371 ECU_ADDRESS 0xd0003242 FORMAT "%7.5" /end MEASUREMENT
/begin MEASUREMENT nl[3] "Floating mean value of the noise signal" UWORD _CNV_A_R_KNCK_LINEA_392_CM 1 0. 0. 4.99992371 ECU_ADDRESS 0xd0003244 FORMAT "%7.5" /end MEASUREMENT
/begin MEASUREMENT nl_dif "Adaptive learning of engine noise deviation for gain adaptation" SWORD _CNV_A_R_KNCK_LINEA_394_CM 1 0. -2.5 2.49992371 ECU_ADDRESS 0xd0003bd8 FORMAT "%7.4" /end MEASUREMENT
/begin CHARACTERISTIC c_cycnr_knk_det "Number of combustion cycles where the noise calculation is frozen after a knock detection " VALUE 0xa0021324 _REC_S1VAL_20_u1 254. _CNV_A_R_ECME_LINEA_0_CM 1. 255. FORMAT "%3.0" /end CHARACTERISTIC
/begin CHARACTERISTIC c_egy_thd_knk "Threshold on EGY_KNK for knock detection" VALUE 0xa002130c _REC_S1VAL_20_u2 3.99993896484375 _CNV_A_R_LINEAR_____53_CM 0. 3.99993896484375 FORMAT "%7.5" /end CHARACTERISTIC
/begin CHARACTERISTIC c_fac_tra_knk "correction factor for load dynamic active" VALUE 0xa0021326 _REC_S1VAL_20_u1 7.96875 _CNV_A_R_KNCK_LINEA_390_CM 0. 7.96875 FORMAT "%5.3" /end CHARACTERISTIC
/begin CHARACTERISTIC c_knks_cmd_gain_ad_max "maximum of adaptive command gain (typical value 15)" VALUE 0xa0021327 _REC_S1VAL_20_s1 62. _CNV_A_R_ECME_LINEA_0_CM -31. 31. FORMAT "%2.0" /end CHARACTERISTIC
/begin CHARACTERISTIC c_knks_cmd_gain_ad_min "Minimum of adaptive command gain (typical value -15)" VALUE 0xa0021328 _REC_S1VAL_20_s1 62. _CNV_A_R_ECME_LINEA_0_CM -31. 31. FORMAT "%2.0" /end CHARACTERISTIC
/begin CHARACTERISTIC c_knks_cyl_conf "Configuration of the knock sensors and the cylinders" VALUE 0xa0021329 _REC_S1VAL_20_u1 1. _CNV_A_R_ECME_LINEA_0_CM 0. 1. FORMAT "%1.0" /end CHARACTERISTIC
/begin CHARACTERISTIC c_nl_ad_ctr "Recurrence of adaptation computation (typical value 64 tdc)" VALUE 0xa0021332 _REC_S1VAL_20_u1 255. _CNV_A_R_ECME_LINEA_0_CM 0. 255. FORMAT "%3.0" /end CHARACTERISTIC
/begin CHARACTERISTIC c_nl_ad_thd "Threshold to enable the gain adaptation (typical value 0.2V)" VALUE 0xa0021310 _REC_S1VAL_20_u2 4.99992371 _CNV_A_R_KNCK_LINEA_392_CM 0. 4.99992371 FORMAT "%7.5" /end CHARACTERISTIC
/begin CHARACTERISTIC c_nl_fil_gain "Filter gain for Noise Value Calculation" VALUE 0xa0021333 _REC_S1VAL_20_u1 0.99609375 _CNV_A_R_LINEAR_____31_CM 0. 0.99609375 FORMAT "%5.3" /end CHARACTERISTIC
/begin CHARACTERISTIC c_nl_fil_gain_inc "Filter gain for Noise Value Calculation in case of increasing noise value " VALUE 0xa0021335 _REC_S1VAL_20_u1 0.99609375 _CNV_A_R_LINEAR_____31_CM 0. 0.99609375 FORMAT "%5.3" /end CHARACTERISTIC
/begin CHARACTERISTIC c_nl_fil_gain_tra "Filter gain for Noise Value Calculation in case of Transient Case" VALUE 0xa0021336 _REC_S1VAL_20_u1 0.99609375 _CNV_A_R_LINEAR_____31_CM 0. 0.99609375 FORMAT "%5.3" /end CHARACTERISTIC
/begin CHARACTERISTIC c_nl_inc "Increment on noise level in case of noise level calculation freeze" VALUE 0xa0021312 _REC_S1VAL_20_u2 4.99992371 _CNV_A_R_KNCK_LINEA_392_CM 0. 4.99992371 FORMAT "%7.5" /end CHARACTERISTIC
/begin CHARACTERISTIC c_nl_lih "Limp Home value for noise value" VALUE 0xa0021314 _REC_S1VAL_20_u2 4.99992371 _CNV_A_R_KNCK_LINEA_392_CM 0. 4.99992371 FORMAT "%7.5" /end CHARACTERISTIC
/begin CHARACTERISTIC c_nl_ofs "Offset on NL to decide which gain will be used" VALUE 0xa0021316 _REC_S1VAL_20_u2 4.99992371 _CNV_A_R_KNCK_LINEA_392_CM 0. 4.99992371 FORMAT "%7.5" /end CHARACTERISTIC
/begin AXIS_PTS ldpm_maf_hb_1_knck "" 0xa00212f6 maf_hb _REC_A2AXS_20_u1 1389. _CNV_A_R_LINEAR_____281_CM 4 0. 1389. FORMAT "%4.0" /end AXIS_PTS
/begin AXIS_PTS ldpm_maf_hb_2_knck "" 0xa0022a34 maf_hb _REC_A2AXS_20_u1 1389. _CNV_A_R_LINEAR_____281_CM 12 0. 1389. FORMAT "%4.0" /end AXIS_PTS
/begin AXIS_PTS ldpm_n_32_1_knck "" 0xa0022a44 n_32 _REC_A2AXS_20_u1 8160. _CNV_A_R_LINEAR_____2_CM 8 0. 8160. FORMAT "%4.0" /end AXIS_PTS
/begin AXIS_PTS ldpm_n_32_2_knck "" 0xa0022a50 n_32 _REC_A2AXS_20_u1 8160. _CNV_A_R_LINEAR_____2_CM 16 0. 8160. FORMAT "%4.0" /end AXIS_PTS
/begin AXIS_PTS ldpm_n_32_5_knck "" 0xa00212fc n_32 _REC_A2AXS_20_u1 8160. _CNV_A_R_LINEAR_____2_CM 4 0. 8160. FORMAT "%4.0" /end AXIS_PTS
/begin AXIS_PTS ldpm_tco_1_knck "" 0xa0021302 tco _REC_A2AXS_20_u1 190.5 _CNV_A_R_LINEAR_____42_CM 4 -48. 142.5 FORMAT "%6.2" /end AXIS_PTS
/begin AXIS_PTS ldpm_n_32_3_knck "" 0xa0022a64 n_32 _REC_A2AXS_20_u1 8160. _CNV_A_R_LINEAR_____2_CM 8 0. 8160. FORMAT "%4.0" /end AXIS_PTS
/begin CHARACTERISTIC id_cycnr_fac_tra_knk "Cycle counter during which the Load Dynamic Function stays active after triggering" CURVE 0xa0021308 _REC_A1CUR_20_u1_u1 255. _CNV_A_R_ECME_LINEA_0_CM 0. 255. FORMAT "%3.0"
 /begin AXIS_DESCR COM_AXIS n_32 _CNV_A_R_LINEAR_____2_CM 4 0. 8160. FORMAT "%4.0" AXIS_PTS_REF ldpm_n_32_5_knck /end AXIS_DESCR
/end CHARACTERISTIC
/begin CHARACTERISTIC id_maf_dif_tra_knk "MAF difference for Load Dynamic Recognition" CURVE 0xa00212c8 _REC_A1CUR_20_s2_u1 1389. _CNV_A_R_LINEAR_____395_CM -694.510597390707 694.4894026092931 FORMAT "%7.2"
 /begin AXIS_DESCR COM_AXIS n_32 _CNV_A_R_LINEAR_____2_CM 4 0. 8160. FORMAT "%4.0" AXIS_PTS_REF ldpm_n_32_5_knck /end AXIS_DESCR
/end CHARACTERISTIC
/begin CHARACTERISTIC id_maf_hb_min_knk_ad "MAF_HB-threshold for global adaptive circuit" CURVE 0xa0022c00 _REC_A1CUR_20_u1_u1 1389. _CNV_A_R_LINEAR_____281_CM 0. 1389. FORMAT "%4.0"
 /begin AXIS_DESCR COM_AXIS n_32 _CNV_A_R_LINEAR_____2_CM 16 0. 8160. FORMAT "%4.0" AXIS_PTS_REF ldpm_n_32_2_knck /end AXIS_DESCR
/end CHARACTERISTIC
/begin CHARACTERISTIC id_maf_min_ad_1_knk "Air-mass Threshold for Knock Adaptation of circuit 1" CURVE 0xa00212d0 _REC_A1CUR_20_u1_u1 1389. _CNV_A_R_LINEAR_____281_CM 0. 1389. FORMAT "%4.0"
 /begin AXIS_DESCR COM_AXIS n_32 _CNV_A_R_LINEAR_____2_CM 8 0. 8160. FORMAT "%4.0" AXIS_PTS_REF ldpm_n_32_3_knck /end AXIS_DESCR
/end CHARACTERISTIC
/begin CHARACTERISTIC id_n_grd_max_knk "Speed Gradient for dynamic identification" CURVE 0xa00212d8 _REC_A1CUR_20_u1_u1 4064. _CNV_A_R_LINEAR_____2_CM 0. 4064. FORMAT "%4.0"
 /begin AXIS_DESCR COM_AXIS n_32 _CNV_A_R_LINEAR_____2_CM 8 0. 8160. FORMAT "%4.0" AXIS_PTS_REF ldpm_n_32_3_knck /end AXIS_DESCR
/end CHARACTERISTIC
/begin CHARACTERISTIC ip_maf_hb_min_knk "Air-mass Threshold to enable knock control" MAP 0xa0023020 _REC_A1MAP_20_u1_u1_u1 1389. _CNV_A_R_LINEAR_____281_CM 0. 1389. FORMAT "%4.0"
 /begin AXIS_DESCR COM_AXIS n_32 _CNV_A_R_LINEAR_____2_CM 8 0. 8160. FORMAT "%4.0" AXIS_PTS_REF ldpm_n_32_1_knck /end AXIS_DESCR
 /begin AXIS_DESCR COM_AXIS tco _CNV_A_R_LINEAR_____42_CM 4 -48. 142.5 FORMAT "%6.2" AXIS_PTS_REF ldpm_tco_1_knck /end AXIS_DESCR
/end CHARACTERISTIC
/begin MEASUREMENT lv_fac_ad_knk_ena "Flag to enable global adaptation" UBYTE _CNV_S_2_RANGE______3_CM 1 0. 0. 1. ECU_ADDRESS 0xd00041d6 BIT_MASK 0x1 /end MEASUREMENT
/begin MEASUREMENT lv_knk_ad_1_ena "Flag to enable circuit 1 adaptation" UBYTE _CNV_S_2_RANGE______3_CM 1 0. 0. 1. ECU_ADDRESS 0xd00041e2 BIT_MASK 0x1 /end MEASUREMENT
/begin MEASUREMENT lv_knk_ad_ena "Flag to enable adaptive learning of engine noise for gain adaptation" UBYTE _CNV_S_2_RANGE______3_CM 1 0. 0. 1. ECU_ADDRESS 0xd00041e3 BIT_MASK 0x1 /end MEASUREMENT
/begin MEASUREMENT lv_knk_ctl_act_ena "Flag to enable knock control " UBYTE _CNV_S_2_RANGE______3_CM 1 0. 0. 1. ECU_ADDRESS 0xd00041e4 BIT_MASK 0x1 /end MEASUREMENT
/begin MEASUREMENT lv_knk_det_ena "Flag to enable knock detection " UBYTE _CNV_S_2_RANGE______3_CM 1 0. 0. 1. ECU_ADDRESS 0xd00041e5 BIT_MASK 0x1 /end MEASUREMENT
/begin MEASUREMENT lv_knk_lih "Flag to indicate that one or more cylinder is/are in Knock Limp Home" UBYTE _CNV_S_2_RANGE______3_CM 1 0. 0. 1. ECU_ADDRESS 0xd00041e6 BIT_MASK 0x1 /end MEASUREMENT
/begin MEASUREMENT lv_knk_lih_ena "Flag to enable knock limp home operation" UBYTE _CNV_S_2_RANGE______3_CM 1 0. 0. 1. ECU_ADDRESS 0xd00041e7 BIT_MASK 0x1 /end MEASUREMENT
/begin MEASUREMENT lv_maf_tra_knk "Logical variable for Load Dynamic Function active or passive" UBYTE _CNV_S_2_RANGE______3_CM 1 0. 0. 1. ECU_ADDRESS 0xd00041e9 BIT_MASK 0x1 /end MEASUREMENT
/begin MEASUREMENT lv_n_tra_knk "Logical variable for Engine Speed Dynamic Function active or passive" UBYTE _CNV_S_2_RANGE______3_CM 1 0. 0. 1. ECU_ADDRESS 0xd00041eb BIT_MASK 0x1 /end MEASUREMENT
/begin CHARACTERISTIC c_ctr_ad_1_knk "Number of tdc before enabling AD1 adaptation" VALUE 0xa0021320 _REC_S1VAL_20_u1 255. _CNV_A_R_ECME_LINEA_0_CM 0. 255. FORMAT "%3.0" /end CHARACTERISTIC
/begin CHARACTERISTIC c_ctr_nl_ad_knk "Number of tdc since the last knock detection before enabling the calculation of adaptation (typical value 16)" VALUE 0xa0021323 _REC_S1VAL_20_u1 255. _CNV_A_R_ECME_LINEA_0_CM 0. 255. FORMAT "%3.0" /end CHARACTERISTIC
/begin CHARACTERISTIC c_maf_min_knk_ad "Condition on load to authorise the calculation of adaptation (typical value 300 to 500 mg/tdc)" VALUE 0xa002132d _REC_S1VAL_20_u1 1389. _CNV_A_R_LINEAR_____281_CM 0. 1389. FORMAT "%4.0" /end CHARACTERISTIC
/begin CHARACTERISTIC c_n_max_knk_ad "Condition on maximum engine speed to enable the calculation of adaptation (typical value 4500 rpm)" VALUE 0xa0021330 _REC_S1VAL_20_u1 8160. _CNV_A_R_LINEAR_____2_CM 0. 8160. FORMAT "%4.0" /end CHARACTERISTIC
/begin CHARACTERISTIC c_n_min_knk_ad "Condition on minimum engine speed to enable the calculation of adaptation (typical value 1500 rpm)" VALUE 0xa0021331 _REC_S1VAL_20_u1 8160. _CNV_A_R_LINEAR_____2_CM 0. 8160. FORMAT "%4.0" /end CHARACTERISTIC
/begin CHARACTERISTIC c_tco_ad_knk_min "Bottom limit TCO" VALUE 0xa0021337 _REC_S1VAL_20_u1 190.5 _CNV_A_R_LINEAR_____42_CM -48. 142.5 FORMAT "%6.2" /end CHARACTERISTIC
/begin CHARACTERISTIC c_tco_knk_ad "Condition on TCO to authorise the calculation of adaptation (typical value 60∞C)" VALUE 0xa0021339 _REC_S1VAL_20_u1 190.5 _CNV_A_R_LINEAR_____42_CM -48. 142.5 FORMAT "%6.2" /end CHARACTERISTIC
/begin MEASUREMENT fac_ad_knk_app "Multiplicative factor on FAC_AD_KNK generated by application incidence (used when LV_FAC_AD_KNK_APP is active)" UBYTE _CNV_A_R_LINEAR_____43_CM 1 0. 0. 1. ECU_ADDRESS 0xd0004c02 FORMAT "%8.6" /end MEASUREMENT
/begin MEASUREMENT lv_fac_ad_knk_app "Flag to activate use of FAC_AD_KNK_APP (mult. factor on FAC_AD_KNK). Generated in application incidence" UBYTE _CNV_S_2_RANGE______3_CM 1 0. 0. 1. ECU_ADDRESS 0xd00041d5 BIT_MASK 0x1 /end MEASUREMENT
/begin MEASUREMENT lv_iga_tra_knk_app "Flag generated in application incidence to activate knock prevention in instationnary conditions" UBYTE _CNV_S_2_RANGE______3_CM 1 0. 0. 1. ECU_ADDRESS 0xd00041d7 BIT_MASK 0x1 /end MEASUREMENT
/begin MEASUREMENT lv_inh_fac_ad_knk "Application incidence for adaptation inhibition of global adaptation" UBYTE _CNV_S_2_RANGE______3_CM 1 0. 0. 1. ECU_ADDRESS 0xd00041db BIT_MASK 0x1 /end MEASUREMENT
/begin MEASUREMENT lv_inh_knk_ad_1 "Application incidence for adaptation inhibition of circuit 1 " UBYTE _CNV_S_2_RANGE______3_CM 1 0. 0. 1. ECU_ADDRESS 0xd00041dc BIT_MASK 0x1 /end MEASUREMENT
/begin MEASUREMENT lv_inh_knk_ctl "Application incidence for inhibition of knock control" UBYTE _CNV_S_2_RANGE______3_CM 1 0. 0. 1. ECU_ADDRESS 0xd00041dd BIT_MASK 0x1 /end MEASUREMENT
/begin MEASUREMENT lv_inh_knk_lih "Inhibition fag for knock limp home operation" UBYTE _CNV_S_2_RANGE______3_CM 1 0. 0. 1. ECU_ADDRESS 0xd00041de BIT_MASK 0x1 /end MEASUREMENT
/begin MEASUREMENT lv_inh_nl_ad_knk "Application incidence for knock adaptive gain" UBYTE _CNV_S_2_RANGE______3_CM 1 0. 0. 1. ECU_ADDRESS 0xd00041df BIT_MASK 0x1 /end MEASUREMENT
/begin MEASUREMENT lv_maf_tra_knk_act "Application incidence for activation of MAF transient for knock control" UBYTE _CNV_S_2_RANGE______3_CM 1 0. 0. 1. ECU_ADDRESS 0xd00041ea BIT_MASK 0x1 /end MEASUREMENT
/begin MEASUREMENT lv_n_tra_knk_act "Application incidence for activation of N transient for knock control" UBYTE _CNV_S_2_RANGE______3_CM 1 0. 0. 1. ECU_ADDRESS 0xd00041ec BIT_MASK 0x1 /end MEASUREMENT
/begin MEASUREMENT lv_nl_fil_gain_app "Flag generated by application incidence to use NL_FIL_GAIN_APP for noise calculation" UBYTE _CNV_S_2_RANGE______3_CM 1 0. 0. 1. ECU_ADDRESS 0xd00041ed BIT_MASK 0x1 /end MEASUREMENT
/begin MEASUREMENT nl_fil_gain_app "Filter gain for noise value calculation, provided by application incidence, used when LV_NL_FIL_GAIN_APP is active" UBYTE _CNV_A_R_LINEAR_____31_CM 1 0. 0. 0.99609375 ECU_ADDRESS 0xd0004c03 FORMAT "%5.3" /end MEASUREMENT
/begin CHARACTERISTIC c_fac_ad_knk_app "Generation of FAC_AD_KNK_APP. Used for aggregate test" VALUE 0xa0021325 _REC_S1VAL_20_u1 1. _CNV_A_R_LINEAR_____43_CM 0. 1. FORMAT "%8.6" /end CHARACTERISTIC
/begin CHARACTERISTIC c_nl_fil_gain_app "Application specific filter gain for noise calculation (test purpose)" VALUE 0xa0021334 _REC_S1VAL_20_u1 0.99609375 _CNV_A_R_LINEAR_____31_CM 0. 0.99609375 FORMAT "%5.3" /end CHARACTERISTIC
/begin CHARACTERISTIC c_state_test_knk_app "Generation of application incidence flags for KNCK. Aggregate test use only ! Default value 0" VALUE 0xa0021318 _REC_S1VAL_20_u2 65535. _CNV_A_R_ECME_LINEA_0_CM 0. 65535. FORMAT "%5.0" /end CHARACTERISTIC
/begin CHARACTERISTIC lc_knk_ad_clr "Logical value enabling reset of AD1, global adaptation and adaptive gain" VALUE 0xa002133a _REC_S1VAL_20_u1 1. _CNV_A_R_ECME_LINEA_0_CM 0. 1. FORMAT "%1.0" /end CHARACTERISTIC
/begin MEASUREMENT knk_loop_nr "Number of sw loop for knk filtering" UWORD _CNV_A_R_ECME_LINEA_0_CM 1 0. 0. 65535. ECU_ADDRESS 0xd0003234 FORMAT "%5.0" /end MEASUREMENT
/begin MEASUREMENT knks[0] "Knock noise signal for cylinder x" UWORD _CNV_A_R_KNCK_LINEA_392_CM 1 0. 0. 4.99992371 ECU_ADDRESS 0xd0003236 FORMAT "%7.5" /end MEASUREMENT
/begin MEASUREMENT knks[1] "Knock noise signal for cylinder x" UWORD _CNV_A_R_KNCK_LINEA_392_CM 1 0. 0. 4.99992371 ECU_ADDRESS 0xd0003238 FORMAT "%7.5" /end MEASUREMENT
/begin MEASUREMENT knks[2] "Knock noise signal for cylinder x" UWORD _CNV_A_R_KNCK_LINEA_392_CM 1 0. 0. 4.99992371 ECU_ADDRESS 0xd000323a FORMAT "%7.5" /end MEASUREMENT
/begin MEASUREMENT knks[3] "Knock noise signal for cylinder x" UWORD _CNV_A_R_KNCK_LINEA_392_CM 1 0. 0. 4.99992371 ECU_ADDRESS 0xd000323c FORMAT "%7.5" /end MEASUREMENT
/begin MEASUREMENT lv_knk_acq_err "Boolean for acquisition error (failure) on the signal acquisition chain" UBYTE _CNV_S_2_RANGE______3_CM 1 0. 0. 1. ECU_ADDRESS 0xd00041e1 BIT_MASK 0x1 /end MEASUREMENT
/begin MEASUREMENT state_knk_sw_acq_err "Shows on what cylinder there is an overlap in acquisition of Knk By Soft" UBYTE _CNV_A_R_ECME_LINEA_0_CM 1 0. 0. 255. ECU_ADDRESS 0xd000570e FORMAT "%3.0" /end MEASUREMENT
/begin CHARACTERISTIC ip_knks_err_rel[0] "Minimum threshold for relative knock failure detection (one threshold by sensor - typical value 0.06 volt)" CURVE 0xa0022c10 _REC_A1CUR_20_u2_u1 4.99992371 _CNV_A_R_KNCK_LINEA_392_CM 0. 4.99992371 FORMAT "%7.5"
 /begin AXIS_DESCR COM_AXIS n_32 _CNV_A_R_LINEAR_____2_CM 8 0. 8160. FORMAT "%4.0" AXIS_PTS_REF ldpm_n_32_1_knck /end AXIS_DESCR
/end CHARACTERISTIC
/begin MEASUREMENT ctr_err_sym_rel_knk[0] "Time counter for relative KNKS symptom filtering" UBYTE _CNV_A_R_LINEAR_____4_CM 1 0. 0. 25.5 ECU_ADDRESS 0xd0004c00 FORMAT "%4.1" /end MEASUREMENT
/begin MEASUREMENT knks_err_rel[0] "Absolute value of difference between KNKS[C_KNK_DIAG_CYL_IDC] and its sliding average" UWORD _CNV_A_R_KNCK_LINEA_392_CM 1 0. 0. 4.99992371 ECU_ADDRESS 0xd0003bd4 FORMAT "%7.5" /end MEASUREMENT
/begin MEASUREMENT knks_mmv_diag[0] "Sliding average of KNKS[C_KNK_DIAG_CYL_NB]" UWORD _CNV_A_R_KNCK_LINEA_392_CM 1 0. 0. 4.99992371 ECU_ADDRESS 0xd0003bd6 FORMAT "%7.5" /end MEASUREMENT
/begin MEASUREMENT lv_err_acq_knk "Boolean for confirmed error (failure) in acquisition chain (after de-bounce)" UBYTE _CNV_S_2_RANGE______3_CM 1 0. 0. 1. ECU_ADDRESS 0xd0004959 BIT_MASK 0x1 /end MEASUREMENT
/begin MEASUREMENT lv_err_bas_knk_0 "Error on basic knock signal after filtering" UBYTE _CNV_S_2_RANGE______3_CM 1 0. 0. 1. ECU_ADDRESS 0xd0004355 BIT_MASK 0x1 /end MEASUREMENT
/begin MEASUREMENT lv_err_knk "Boolean for confirmed global error (failure) on the signal acquisition chain " UBYTE _CNV_S_2_RANGE______3_CM 1 0. 0. 1. ECU_ADDRESS 0xd00041d3 BIT_MASK 0x1 /end MEASUREMENT
/begin MEASUREMENT lv_err_rel_knk_0 "Boolean for error on relative knock signal after filtering" UBYTE _CNV_S_2_RANGE______3_CM 1 0. 0. 1. ECU_ADDRESS 0xd0004356 BIT_MASK 0x1 /end MEASUREMENT
/begin MEASUREMENT lv_err_sym_knk "Boolean for instantaneous error (failure) on the signal acquisition chain" UBYTE _CNV_S_2_RANGE______3_CM 1 0. 0. 1. ECU_ADDRESS 0xd00041d4 BIT_MASK 0x1 /end MEASUREMENT
/begin MEASUREMENT lv_thd_err_rel_knk[0] "Boolean for threshold for REL_KNK symptom reached" UBYTE _CNV_S_2_RANGE______3_CM 1 0. 0. 1. ECU_ADDRESS 0xd000570d BIT_MASK 0x1 /end MEASUREMENT
/begin MEASUREMENT nr_knk_sens "Knock sensor counter for sensor identification" UBYTE _CNV_A_R_ECME_LINEA_0_CM 1 0. 0. 3. ECU_ADDRESS 0xd0005294 FORMAT "%3.0" /end MEASUREMENT
/begin CHARACTERISTIC c_ctr_dec_err_sym_rel_knk "Decrement value for C_CTR_ERR_SYM_REL_KNK" VALUE 0xa0021321 _REC_S1VAL_20_u1 25.5 _CNV_A_R_LINEAR_____4_CM 0. 25.5 FORMAT "%4.1" /end CHARACTERISTIC
/begin CHARACTERISTIC c_ctr_err_sym_rel_knk "Time value for relative KNKS symptom filtering" VALUE 0xa0021322 _REC_S1VAL_20_u1 25.5 _CNV_A_R_LINEAR_____4_CM 0. 25.5 FORMAT "%4.1" /end CHARACTERISTIC
/begin CHARACTERISTIC c_knks_bas_diag "Minimum threshold of KNKS[C_KNK_DIAG_CYL_NB] to detect failure of the knock sensor (typical value 0.4V)" VALUE 0xa002130e _REC_S1VAL_20_u2 4.99992371 _CNV_A_R_KNCK_LINEA_392_CM 0. 4.99992371 FORMAT "%7.5" /end CHARACTERISTIC
/begin CHARACTERISTIC c_knks_diag_cyl_idc[0] "Studied cylinder for failing detection (typically the nearest of the sensor)" VALUE 0xa002132a _REC_S1VAL_20_u1 7. _CNV_A_R_ECME_LINEA_0_CM 0. 7. FORMAT "%3.0" /end CHARACTERISTIC
/begin CHARACTERISTIC c_knks_rel_err_fil "Slope of the filter KNKS_MMV_DIAG (typical value 0.25: smooth the noise for 4 cycles - do not use too small value: minimum 0.1)" VALUE 0xa002132b _REC_S1VAL_20_u1 0.99609375 _CNV_A_R_LINEAR_____31_CM 0. 0.99609375 FORMAT "%5.3" /end CHARACTERISTIC
/begin CHARACTERISTIC c_maf_min_diag_knk "Minimum load for knock failure detection enabled (typical value 200 mbar)" VALUE 0xa002132c _REC_S1VAL_20_u1 1389. _CNV_A_R_LINEAR_____281_CM 0. 1389. FORMAT "%4.0" /end CHARACTERISTIC
/begin CHARACTERISTIC c_n_32_min_diag_knk "Minimum engine speed for knock failure detection enabled (typical value 1500 rpm)" VALUE 0xa002132f _REC_S1VAL_20_u1 8160. _CNV_A_R_LINEAR_____2_CM 0. 8160. FORMAT "%4.0" /end CHARACTERISTIC
/begin CHARACTERISTIC c_tco_diag_knk "Minimum threshold of TCO to detect failure of the knock sensor (typical value 60 ∞C)" VALUE 0xa0021338 _REC_S1VAL_20_u1 190.5 _CNV_A_R_LINEAR_____42_CM -48. 142.5 FORMAT "%6.2" /end CHARACTERISTIC
/begin MEASUREMENT lv_inh_diag_acq_knk "Inhibition flag for knock acquisition chain diagnosis" UBYTE _CNV_S_2_RANGE______3_CM 1 0. 0. 1. ECU_ADDRESS 0xd00041d8 BIT_MASK 0x1 /end MEASUREMENT
/begin MEASUREMENT lv_inh_diag_bas_knk "Inhibition flag for knock sensor basic diagnosis" UBYTE _CNV_S_2_RANGE______3_CM 1 0. 0. 1. ECU_ADDRESS 0xd00041d9 BIT_MASK 0x1 /end MEASUREMENT
/begin MEASUREMENT lv_inh_diag_rel_knk "Inhibition flag for knock sensor relative diagnosis" UBYTE _CNV_S_2_RANGE______3_CM 1 0. 0. 1. ECU_ADDRESS 0xd00041da BIT_MASK 0x1 /end MEASUREMENT
/begin CHARACTERISTIC c_n_32_max_diag_knk "Maximum engine speed for knock failure detection" VALUE 0xa002132e _REC_S1VAL_20_u1 8160. _CNV_A_R_LINEAR_____2_CM 0. 8160. FORMAT "%4.0" /end CHARACTERISTIC
/begin MEASUREMENT Vbx_diag_ena_comb_bas_req "Boolean indicates a request of combustion mode for OBD analysis" UBYTE _CNV_S_2_RANGE______3_CM 1 0. 0. 1. ECU_ADDRESS 0xd00055b7 BIT_MASK 0x1 /end MEASUREMENT
/begin MEASUREMENT Vbx_htg_dsb "Boolean indicating heating glow plug command disable (default to 1)" UBYTE _CNV_S_2_RANGE______3_CM 1 0. 0. 1. ECU_ADDRESS 0xd00055b8 BIT_MASK 0x1 /end MEASUREMENT
/begin MEASUREMENT Vbx_owe_tool_ini_req "Boolean sent by the diagnosis tool to initialise the strategy in case of oil drain" UBYTE _CNV_S_2_RANGE______3_CM 1 0. 0. 1. ECU_ADDRESS 0xd00055b9 BIT_MASK 0x1 /end MEASUREMENT
/begin MEASUREMENT Vsx_owe_tool_zon_req "Geographical zon selection request from the diagnosis tool" UBYTE _CNV_A_R_ECME_LINEA_0_CM 1 0. 1. 5. ECU_ADDRESS 0xd00055ba FORMAT "%1.0" /end MEASUREMENT
/begin MEASUREMENT Vxx_diag_comb_bas "OBD request of active combustion mode" UBYTE _CNV_A_R_ECME_LINEA_0_CM 1 0. 1. 15. ECU_ADDRESS 0xd00055bb FORMAT "%2.0" /end MEASUREMENT
/begin CHARACTERISTIC Cbx_s06_fsys_cpt_old "(=1) Old fuel system diagnostic activated" VALUE 0xa0021baa _REC_S1VAL_20_u1 1. _CNV_S_2_RANGE______3_CM 0. 1. BIT_MASK 0x1 /end CHARACTERISTIC
/begin CHARACTERISTIC Cxx_c_id1 "ASCII value of the first character of the CALID#2" VALUE 0xa0021bab _REC_S1VAL_20_u1 255. _CNV_A_R_ECME_LINEA_0_CM 0. 255. FORMAT "%3.0" /end CHARACTERISTIC
/begin CHARACTERISTIC Cxx_c_id10 "ASCII value of the tenth character of the CALID#2" VALUE 0xa0021bac _REC_S1VAL_20_u1 255. _CNV_A_R_ECME_LINEA_0_CM 0. 255. FORMAT "%3.0" /end CHARACTERISTIC
/begin CHARACTERISTIC Cxx_c_id11 "ASCII value of the eleventh character of the CALID#2" VALUE 0xa0021bad _REC_S1VAL_20_u1 255. _CNV_A_R_ECME_LINEA_0_CM 0. 255. FORMAT "%3.0" /end CHARACTERISTIC
/begin CHARACTERISTIC Cxx_c_id12 "ASCII value of the twelfth character of the CALID#2" VALUE 0xa0021bae _REC_S1VAL_20_u1 255. _CNV_A_R_ECME_LINEA_0_CM 0. 255. FORMAT "%3.0" /end CHARACTERISTIC
/begin CHARACTERISTIC Cxx_c_id13 "ASCII value of the thirteenth character of the CALID#2" VALUE 0xa0021baf _REC_S1VAL_20_u1 255. _CNV_A_R_ECME_LINEA_0_CM 0. 255. FORMAT "%3.0" /end CHARACTERISTIC
/begin CHARACTERISTIC Cxx_c_id14 "ASCII value of the fourteenth character of the CALID#2" VALUE 0xa0021bb0 _REC_S1VAL_20_u1 255. _CNV_A_R_ECME_LINEA_0_CM 0. 255. FORMAT "%3.0" /end CHARACTERISTIC
/begin CHARACTERISTIC Cxx_c_id15 "ASCII value of the fifteenth character of the CALID#2" VALUE 0xa0021bb1 _REC_S1VAL_20_u1 255. _CNV_A_R_ECME_LINEA_0_CM 0. 255. FORMAT "%3.0" /end CHARACTERISTIC
/begin CHARACTERISTIC Cxx_c_id16 "ASCII value of the sixteenth character of the CALID#2" VALUE 0xa0021bb2 _REC_S1VAL_20_u1 255. _CNV_A_R_ECME_LINEA_0_CM 0. 255. FORMAT "%3.0" /end CHARACTERISTIC
/begin CHARACTERISTIC Cxx_c_id2 "ASCII value of the second character of the CALID#2" VALUE 0xa0021bb3 _REC_S1VAL_20_u1 255. _CNV_A_R_ECME_LINEA_0_CM 0. 255. FORMAT "%3.0" /end CHARACTERISTIC
/begin CHARACTERISTIC Cxx_c_id3 "ASCII value of the third character of the CALID#2" VALUE 0xa0021bb4 _REC_S1VAL_20_u1 255. _CNV_A_R_ECME_LINEA_0_CM 0. 255. FORMAT "%3.0" /end CHARACTERISTIC
/begin CHARACTERISTIC Cxx_c_id4 "ASCII value of the fourth character of the CALID#2" VALUE 0xa0021bb5 _REC_S1VAL_20_u1 255. _CNV_A_R_ECME_LINEA_0_CM 0. 255. FORMAT "%3.0" /end CHARACTERISTIC
/begin CHARACTERISTIC Cxx_c_id5 "ASCII value of the fifth character of the CALID#2" VALUE 0xa0021bb6 _REC_S1VAL_20_u1 255. _CNV_A_R_ECME_LINEA_0_CM 0. 255. FORMAT "%3.0" /end CHARACTERISTIC
/begin CHARACTERISTIC Cxx_c_id6 "ASCII value of the sixth character of the CALID#2" VALUE 0xa0021bb7 _REC_S1VAL_20_u1 255. _CNV_A_R_ECME_LINEA_0_CM 0. 255. FORMAT "%3.0" /end CHARACTERISTIC
/begin CHARACTERISTIC Cxx_c_id7 "ASCII value of the seventh character of the CALID#2" VALUE 0xa0021bb8 _REC_S1VAL_20_u1 255. _CNV_A_R_ECME_LINEA_0_CM 0. 255. FORMAT "%3.0" /end CHARACTERISTIC
/begin CHARACTERISTIC Cxx_c_id8 "ASCII value of the eighth character of the CALID#2" VALUE 0xa0021bb9 _REC_S1VAL_20_u1 255. _CNV_A_R_ECME_LINEA_0_CM 0. 255. FORMAT "%3.0" /end CHARACTERISTIC
/begin CHARACTERISTIC Cxx_c_id9 "ASCII value of the ninth character of the CALID#2" VALUE 0xa0021bba _REC_S1VAL_20_u1 255. _CNV_A_R_ECME_LINEA_0_CM 0. 255. FORMAT "%3.0" /end CHARACTERISTIC
/begin CHARACTERISTIC Cxx_did_205F_writ_max "Maximum value authorized to write on DID $205F" VALUE 0xa0021b6e _REC_S1VAL_20_u2 16383.75 _CNV_A_R_ENSD_LINEA_24_CM 0. 16383.75 FORMAT "%8.2" /end CHARACTERISTIC
/begin CHARACTERISTIC Cxx_did_205F_writ_min "Minimum value authorized to write on DID $205F" VALUE 0xa0021b70 _REC_S1VAL_20_u2 16383.75 _CNV_A_R_ENSD_LINEA_24_CM 0. 16383.75 FORMAT "%8.2" /end CHARACTERISTIC
/begin CHARACTERISTIC Cxx_did_2105_writ_max "Maximum value authorized to write on DID $2105" VALUE 0xa0021bc9 _REC_S1VAL_20_u1 4. _CNV_A_R_ECME_LINEA_0_CM 1. 5. FORMAT "%3.0" /end CHARACTERISTIC
/begin CHARACTERISTIC Cxx_did_2105_writ_min "Minimum value authorized to write on DID $205F" VALUE 0xa0021bca _REC_S1VAL_20_u1 4. _CNV_A_R_ECME_LINEA_0_CM 1. 5. FORMAT "%3.0" /end CHARACTERISTIC
/begin CHARACTERISTIC Cxx_did_210D_writ_max "Maximum value authorized to write on DID $210D" VALUE 0xa0021b72 _REC_S1VAL_20_u4 65535000. _CNV_A_R_LINEAR_____396_CM 0. 65535000. FORMAT "%10.0" /end CHARACTERISTIC
/begin CHARACTERISTIC Cxx_did_210D_writ_min "Minimum value authorized to write on DID $210D" VALUE 0xa0021b76 _REC_S1VAL_20_u4 65535000. _CNV_A_R_LINEAR_____396_CM 0. 65535000. FORMAT "%10.0" /end CHARACTERISTIC
/begin CHARACTERISTIC Cxx_did_210E_writ_max "Maximum value authorized to write on DID $210E" VALUE 0xa0021b7a _REC_S1VAL_20_u4 300000000. _CNV_A_R_LINEAR_____397_CM 0. 300000000. FORMAT "%10.0" /end CHARACTERISTIC
/begin CHARACTERISTIC Cxx_did_210E_writ_min "Minimum value authorized to write on DID $210E" VALUE 0xa0021b7e _REC_S1VAL_20_u4 300000000. _CNV_A_R_LINEAR_____397_CM 0. 300000000. FORMAT "%10.0" /end CHARACTERISTIC
/begin CHARACTERISTIC Cxx_did_2113_writ_max "Maximum value authorized to write on DID $2113" VALUE 0xa0021b82 _REC_S1VAL_20_u2 240. _CNV_A_R_LINEAR_____54_CM -40. 200. FORMAT "%5.1" /end CHARACTERISTIC
/begin CHARACTERISTIC Cxx_did_2113_writ_min "Minimum value authorized to write on DID $2113" VALUE 0xa0021b84 _REC_S1VAL_20_u2 240. _CNV_A_R_LINEAR_____54_CM -40. 200. FORMAT "%5.1" /end CHARACTERISTIC
/begin CHARACTERISTIC Cxx_did_2141_writ_max "Maximum value authorized to write on DID $2141" VALUE 0xa0021b86 _REC_S1VAL_20_u2 65535. _CNV_A_R_ECME_LINEA_0_CM 0. 65535. FORMAT "%5.0" /end CHARACTERISTIC
/begin CHARACTERISTIC Cxx_did_2141_writ_min "Minimum value authorized to write on DID $2141" VALUE 0xa0021b88 _REC_S1VAL_20_u2 65535. _CNV_A_R_ECME_LINEA_0_CM 0. 65535. FORMAT "%5.0" /end CHARACTERISTIC
/begin CHARACTERISTIC Cxx_did_2143_writ_max "Maximum value authorized to write on DID $2143" VALUE 0xa0021b8a _REC_S1VAL_20_u2 65535. _CNV_A_R_ECME_LINEA_0_CM 0. 65535. FORMAT "%5.0" /end CHARACTERISTIC
/begin CHARACTERISTIC Cxx_did_2143_writ_min "Minimum value authorized to write on DID $2143" VALUE 0xa0021b8c _REC_S1VAL_20_u2 65535. _CNV_A_R_ECME_LINEA_0_CM 0. 65535. FORMAT "%5.0" /end CHARACTERISTIC
/begin CHARACTERISTIC Cxx_did_2147_writ_max "Maximum value authorized to write on DID $2147" VALUE 0xa0021bcb _REC_S1VAL_20_u1 2. _CNV_A_R_ECME_LINEA_0_CM 0. 2. FORMAT "%3.0" /end CHARACTERISTIC
/begin CHARACTERISTIC Cxx_did_2147_writ_min "Minimum value authorized to write on DID $2147" VALUE 0xa0021bcc _REC_S1VAL_20_u1 2. _CNV_A_R_ECME_LINEA_0_CM 0. 2. FORMAT "%3.0" /end CHARACTERISTIC
/begin CHARACTERISTIC Cxx_did_2156_writ_max "Maximum value authorized to write on DID $2156" VALUE 0xa0021bcd _REC_S1VAL_20_u1 6. _CNV_A_R_ECME_LINEA_0_CM 0. 6. FORMAT "%3.0" /end CHARACTERISTIC
/begin CHARACTERISTIC Cxx_did_2156_writ_min "Minimum value authorized to write on DID $2156" VALUE 0xa0021bce _REC_S1VAL_20_u1 6. _CNV_A_R_ECME_LINEA_0_CM 0. 6. FORMAT "%3.0" /end CHARACTERISTIC
/begin CHARACTERISTIC Cxx_did_2457_writ_max "Maximum value authorized to write on DID $2457" VALUE 0xa0021b8e _REC_S1VAL_20_u2 100. _CNV_A_R_LINEAR_____99_CM 0. 100. FORMAT "%6.2" /end CHARACTERISTIC
/begin CHARACTERISTIC Cxx_did_2457_writ_min "Minimum value authorized to write on DID $2457" VALUE 0xa0021b90 _REC_S1VAL_20_u2 100. _CNV_A_R_LINEAR_____99_CM 0. 100. FORMAT "%6.2" /end CHARACTERISTIC
/begin CHARACTERISTIC Cxx_did_2458_writ_max "Maximum value authorized to write on DID $2458" VALUE 0xa0021b92 _REC_S1VAL_20_u2 100. _CNV_A_R_LINEAR_____99_CM 0. 100. FORMAT "%6.2" /end CHARACTERISTIC
/begin CHARACTERISTIC Cxx_did_2458_writ_min "Minimum value authorized to write on DID $2458" VALUE 0xa0021b94 _REC_S1VAL_20_u2 100. _CNV_A_R_LINEAR_____99_CM 0. 100. FORMAT "%6.2" /end CHARACTERISTIC
/begin CHARACTERISTIC Cxx_did_2459_writ_max "Maximum value authorized to write on DID $2459" VALUE 0xa0021b96 _REC_S1VAL_20_u2 100. _CNV_A_R_LINEAR_____99_CM 0. 100. FORMAT "%6.2" /end CHARACTERISTIC
/begin CHARACTERISTIC Cxx_did_2459_writ_min "Minimum value authorized to write on DID $2459" VALUE 0xa0021b98 _REC_S1VAL_20_u2 100. _CNV_A_R_LINEAR_____99_CM 0. 100. FORMAT "%6.2" /end CHARACTERISTIC
/begin CHARACTERISTIC Cxx_did_245A_writ_max "Maximum value authorized to write on DID $245A" VALUE 0xa0021b9a _REC_S1VAL_20_u2 100. _CNV_A_R_LINEAR_____99_CM 0. 100. FORMAT "%6.2" /end CHARACTERISTIC
/begin CHARACTERISTIC Cxx_did_245A_writ_min "Minimum value authorized to write on DID $245A" VALUE 0xa0021b9c _REC_S1VAL_20_u2 100. _CNV_A_R_LINEAR_____99_CM 0. 100. FORMAT "%6.2" /end CHARACTERISTIC
/begin CHARACTERISTIC Cxx_did_245B_writ_max "Maximum value authorized to write on DID $245B" VALUE 0xa0021b9e _REC_S1VAL_20_u2 100. _CNV_A_R_LINEAR_____99_CM 0. 100. FORMAT "%6.2" /end CHARACTERISTIC
/begin CHARACTERISTIC Cxx_did_245B_writ_min "Minimum value authorized to write on DID $245B" VALUE 0xa0021ba0 _REC_S1VAL_20_u2 100. _CNV_A_R_LINEAR_____99_CM 0. 100. FORMAT "%6.2" /end CHARACTERISTIC
/begin CHARACTERISTIC Cxx_did_245C_writ_max "Maximum value authorized to write on DID $245C" VALUE 0xa0021ba2 _REC_S1VAL_20_u2 100. _CNV_A_R_LINEAR_____99_CM 0. 100. FORMAT "%6.2" /end CHARACTERISTIC
/begin CHARACTERISTIC Cxx_did_245C_writ_min "Minimum value authorized to write on DID $245C" VALUE 0xa0021ba4 _REC_S1VAL_20_u2 100. _CNV_A_R_LINEAR_____99_CM 0. 100. FORMAT "%6.2" /end CHARACTERISTIC
/begin CHARACTERISTIC Cxx_did_24C9_writ_max "Maximum value authorized to write on DID $24C9" VALUE 0xa0021ba6 _REC_S1VAL_20_u2 100. _CNV_A_R_LINEAR_____99_CM 0. 100. FORMAT "%6.2" /end CHARACTERISTIC
/begin CHARACTERISTIC Cxx_did_24C9_writ_min "Minimum value authorized to write on DID $24C9" VALUE 0xa0021ba8 _REC_S1VAL_20_u2 100. _CNV_A_R_LINEAR_____99_CM 0. 100. FORMAT "%6.2" /end CHARACTERISTIC
/begin CHARACTERISTIC Cxx_did_287F_writ_max "Maximum value authorized to write on DID $287F" VALUE 0xa0021bcf _REC_S1VAL_20_u1 80. _CNV_A_R_LINEAR_____215_CM 0. 80. FORMAT "%3.0" /end CHARACTERISTIC
/begin CHARACTERISTIC Cxx_did_287F_writ_min "Minimum value authorized to write on DID $287F" VALUE 0xa0021bd0 _REC_S1VAL_20_u1 80. _CNV_A_R_LINEAR_____215_CM 0. 80. FORMAT "%3.0" /end CHARACTERISTIC
/begin CHARACTERISTIC Cxx_obd_cert_nr1 "Approval number 1" VALUE 0xa0021bbb _REC_S1VAL_20_u1 255. _CNV_A_R_ECME_LINEA_0_CM 0. 255. FORMAT "%3.0" /end CHARACTERISTIC
/begin CHARACTERISTIC Cxx_obd_cert_nr10 "Approval number 10" VALUE 0xa0021bbc _REC_S1VAL_20_u1 255. _CNV_A_R_ECME_LINEA_0_CM 0. 255. FORMAT "%3.0" /end CHARACTERISTIC
/begin CHARACTERISTIC Cxx_obd_cert_nr2 "Approval number 2" VALUE 0xa0021bbd _REC_S1VAL_20_u1 255. _CNV_A_R_ECME_LINEA_0_CM 0. 255. FORMAT "%3.0" /end CHARACTERISTIC
/begin CHARACTERISTIC Cxx_obd_cert_nr3 "Approval number 3" VALUE 0xa0021bbe _REC_S1VAL_20_u1 255. _CNV_A_R_ECME_LINEA_0_CM 0. 255. FORMAT "%3.0" /end CHARACTERISTIC
/begin CHARACTERISTIC Cxx_obd_cert_nr4 "Approval number 4" VALUE 0xa0021bbf _REC_S1VAL_20_u1 255. _CNV_A_R_ECME_LINEA_0_CM 0. 255. FORMAT "%3.0" /end CHARACTERISTIC
/begin CHARACTERISTIC Cxx_obd_cert_nr5 "Approval number 5" VALUE 0xa0021bc0 _REC_S1VAL_20_u1 255. _CNV_A_R_ECME_LINEA_0_CM 0. 255. FORMAT "%3.0" /end CHARACTERISTIC
/begin CHARACTERISTIC Cxx_obd_cert_nr6 "Approval number 6" VALUE 0xa0021bc1 _REC_S1VAL_20_u1 255. _CNV_A_R_ECME_LINEA_0_CM 0. 255. FORMAT "%3.0" /end CHARACTERISTIC
/begin CHARACTERISTIC Cxx_obd_cert_nr7 "Approval number 7" VALUE 0xa0021bc2 _REC_S1VAL_20_u1 255. _CNV_A_R_ECME_LINEA_0_CM 0. 255. FORMAT "%3.0" /end CHARACTERISTIC
/begin CHARACTERISTIC Cxx_obd_cert_nr8 "Approval number 8" VALUE 0xa0021bc3 _REC_S1VAL_20_u1 255. _CNV_A_R_ECME_LINEA_0_CM 0. 255. FORMAT "%3.0" /end CHARACTERISTIC
/begin CHARACTERISTIC Cxx_obd_cert_nr9 "Approval number 9" VALUE 0xa0021bc4 _REC_S1VAL_20_u1 255. _CNV_A_R_ECME_LINEA_0_CM 0. 255. FORMAT "%3.0" /end CHARACTERISTIC
/begin CHARACTERISTIC Cxx_obd_conf_diag_prmt "" VALUE 0xa0021bc5 _REC_S1VAL_20_u1 255. _CNV_A_R_ECME_LINEA_0_CM 0. 255. FORMAT "%3.0" /end CHARACTERISTIC
/begin CHARACTERISTIC Cxx_obd_conf_diag_schd "" VALUE 0xa0021bc6 _REC_S1VAL_20_u1 255. _CNV_A_R_ECME_LINEA_0_CM 0. 255. FORMAT "%3.0" /end CHARACTERISTIC
/begin CHARACTERISTIC Cxx_obd_conf_lamb "" VALUE 0xa0021bc7 _REC_S1VAL_20_u1 255. _CNV_A_R_ECME_LINEA_0_CM 0. 255. FORMAT "%3.0" /end CHARACTERISTIC
/begin CHARACTERISTIC Cxx_obd_conf_obd "OBD requirements to which the vehicle is designed" VALUE 0xa0021bc8 _REC_S1VAL_20_u1 255. _CNV_A_R_ECME_LINEA_0_CM 0. 255. FORMAT "%3.0" /end CHARACTERISTIC
/begin MEASUREMENT Vxx_chks_c_sw_1 "Most significant byte of the CVN" UWORD _CNV_A_R_ECME_LINEA_0_CM 1 0. 0. 65535. ECU_ADDRESS 0xc0000bc4 FORMAT "%5.0" /end MEASUREMENT
/begin MEASUREMENT Vxx_chks_c_sw_2 "Less significant byte of the CVN" UWORD _CNV_A_R_ECME_LINEA_0_CM 1 0. 0. 65535. ECU_ADDRESS 0xc0000bc6 FORMAT "%5.0" /end MEASUREMENT
/begin MEASUREMENT Vxx_obd_eal "Calculated Load Value for the scantool" UBYTE _CNV_A_R_LINEAR_____114_CM 1 0. 0. 100. ECU_ADDRESS 0xd000570f FORMAT "%12.8" /end MEASUREMENT
/begin MEASUREMENT Vxx_bus_off_stt_ctr_mem "Bus Off Control Unit : current failures non-volatile counter" UBYTE _CNV_A_R_ECME_LINEA_0_CM 1 0. 0. 255. DISPLAY_IDENTIFIER CmMuxSer_NVM.Vxx_bus_off_stt_ctr_mem_NVM ECU_ADDRESS 0xd0003e44 FORMAT "%3.0" /end MEASUREMENT
/begin MEASUREMENT Vxx_mute_stt_ctr_mem "Mute : current failures non-volatile counter" UBYTE _CNV_A_R_ECME_LINEA_0_CM 1 0. 0. 255. DISPLAY_IDENTIFIER CmMuxSer_NVM.Vxx_mute_stt_ctr_mem_NVM ECU_ADDRESS 0xd0003e45 FORMAT "%3.0" /end MEASUREMENT
/begin MEASUREMENT Vxx_abs_ecu_stt_ctr_mem "Brake Control Unit : current failures non-volatile counter" UBYTE _CNV_A_R_ECME_LINEA_0_CM 1 0. 0. 255. DISPLAY_IDENTIFIER CmMuxSer_NVM.Vxx_abs_ecu_stt_ctr_mem_NVM ECU_ADDRESS 0xd0003e46 FORMAT "%3.0" /end MEASUREMENT
/begin MEASUREMENT Vxx_agb_ecu_stt_ctr_mem "Automatic Gear Box Control Unit : current failures non-volatile counter" UBYTE _CNV_A_R_ECME_LINEA_0_CM 1 0. 0. 255. DISPLAY_IDENTIFIER CmMuxSer_NVM.Vxx_agb_ecu_stt_ctr_mem_NVM ECU_ADDRESS 0xd0003e47 FORMAT "%3.0" /end MEASUREMENT
/begin MEASUREMENT Vxx_ccu_ecu_stt_ctr_mem "BCM Control Unit : current failures non-volatile counter" UBYTE _CNV_A_R_ECME_LINEA_0_CM 1 0. 0. 255. DISPLAY_IDENTIFIER CmMuxSer_NVM.Vxx_ccu_ecu_stt_ctr_mem_NVM ECU_ADDRESS 0xd0003e48 FORMAT "%3.0" /end MEASUREMENT
/begin MEASUREMENT Vxx_ddcm_ecu_stt_ctr_mem "DDCM Control Unit : current failures non-volatile counter" UBYTE _CNV_A_R_ECME_LINEA_0_CM 1 0. 0. 255. DISPLAY_IDENTIFIER CmMuxSer_NVM.Vxx_ddcm_ecu_stt_ctr_mem_NVM ECU_ADDRESS 0xd0003e49 FORMAT "%3.0" /end MEASUREMENT
/begin MEASUREMENT Vxx_ip_ecu_stt_ctr_mem "Cluster Control Unit : current failures non-volatile counter" UBYTE _CNV_A_R_ECME_LINEA_0_CM 1 0. 0. 255. DISPLAY_IDENTIFIER CmMuxSer_NVM.Vxx_ip_ecu_stt_ctr_mem_NVM ECU_ADDRESS 0xd0003e4a FORMAT "%3.0" /end MEASUREMENT
/begin MEASUREMENT Vxx_usm_ecu_stt_ctr_mem "USM Control Unit : current failures non-volatile counter" UBYTE _CNV_A_R_ECME_LINEA_0_CM 1 0. 0. 255. DISPLAY_IDENTIFIER CmMuxSer_NVM.Vxx_usm_ecu_stt_ctr_mem_NVM ECU_ADDRESS 0xd0003e4b FORMAT "%3.0" /end MEASUREMENT
/begin MEASUREMENT Vxx_ac_ecu_stt_ctr_mem "Climate Control Unit : current failures non-volatile counter" UBYTE _CNV_A_R_ECME_LINEA_0_CM 1 0. 0. 255. DISPLAY_IDENTIFIER CmMuxSer_NVM.Vxx_ac_ecu_stt_ctr_mem_NVM ECU_ADDRESS 0xd0003e4c FORMAT "%3.0" /end MEASUREMENT
/begin MEASUREMENT Vxx_acc_ecu_stt_ctr_mem "Automatic Cruise Control Unit : current failures non-volatile counter" UBYTE _CNV_A_R_ECME_LINEA_0_CM 1 0. 0. 255. DISPLAY_IDENTIFIER CmMuxSer_NVM.Vxx_acc_ecu_stt_ctr_mem_NVM ECU_ADDRESS 0xd0003e4d FORMAT "%3.0" /end MEASUREMENT
/begin MEASUREMENT Vxx_swa_ecu_stt_ctr_mem "Steering Wheel Angle Control Unit : current failures non-volatile counter" UBYTE _CNV_A_R_ECME_LINEA_0_CM 1 0. 0. 255. DISPLAY_IDENTIFIER CmMuxSer_NVM.Vxx_swa_ecu_stt_ctr_mem_NVM ECU_ADDRESS 0xd0003e4e FORMAT "%3.0" /end MEASUREMENT
/begin MEASUREMENT Vbx_abs_lk_stt "Mux Network configuration detection : Brake Control Unit status" UBYTE _CNV_S_2_RANGE______3_CM 1 0. 0. 1. DISPLAY_IDENTIFIER CmMuxSer_NVM.Vbx_abs_lk_stt_NVM ECU_ADDRESS 0xd0003e4f BIT_MASK 0x1 /end MEASUREMENT
/begin MEASUREMENT Vbx_agb_lk_stt "The transmission is automatic (known as soon as an AT frame is received)" UBYTE _CNV_S_2_RANGE______3_CM 1 0. 0. 1. DISPLAY_IDENTIFIER CmMuxSer_NVM.Vbx_agb_lk_stt_NVM ECU_ADDRESS 0xd0003e50 BIT_MASK 0x1 /end MEASUREMENT
/begin MEASUREMENT Vbx_ccu_lk_stt "Mux Network configuration detection : BCM Control Unit Status" UBYTE _CNV_S_2_RANGE______3_CM 1 0. 0. 1. DISPLAY_IDENTIFIER CmMuxSer_NVM.Vbx_ccu_lk_stt_NVM ECU_ADDRESS 0xd0003e51 BIT_MASK 0x1 /end MEASUREMENT
/begin MEASUREMENT Vbx_ip_lk_stt "Mux Network configuration detection : Cluster Control Unit Status" UBYTE _CNV_S_2_RANGE______3_CM 1 0. 0. 1. DISPLAY_IDENTIFIER CmMuxSer_NVM.Vbx_ip_lk_stt_NVM ECU_ADDRESS 0xd0003e52 BIT_MASK 0x1 /end MEASUREMENT
/begin MEASUREMENT Vbx_usm_lk_stt "Mux Network configuration detection : USM Control Unit Status" UBYTE _CNV_S_2_RANGE______3_CM 1 0. 0. 1. DISPLAY_IDENTIFIER CmMuxSer_NVM.Vbx_usm_lk_stt_NVM ECU_ADDRESS 0xd0003e53 BIT_MASK 0x1 /end MEASUREMENT
/begin MEASUREMENT Vbx_acc_lk_stt "ACC frame presence detection with security on configuration detection. Stored in E≤PROM" UBYTE _CNV_S_2_RANGE______3_CM 1 0. 0. 1. DISPLAY_IDENTIFIER CmMuxSer_NVM.Vbx_acc_lk_stt_NVM ECU_ADDRESS 0xd0003e54 BIT_MASK 0x1 /end MEASUREMENT
/begin MEASUREMENT Vbx_ac_lk_stt "Mux Network configuration detection : Air Conditioning Control Unit Status" UBYTE _CNV_S_2_RANGE______3_CM 1 0. 0. 1. DISPLAY_IDENTIFIER CmMuxSer_NVM.Vbx_ac_lk_stt_NVM ECU_ADDRESS 0xd0003e55 BIT_MASK 0x1 /end MEASUREMENT
/begin MEASUREMENT Vbx_sdl_lk_stt "Detect the Speed Distance Limiter option. Stored in E≤PROM." UBYTE _CNV_S_2_RANGE______3_CM 1 0. 0. 1. DISPLAY_IDENTIFIER CmMuxSer_NVM.Vbx_sdl_lk_stt_NVM ECU_ADDRESS 0xd0003e56 BIT_MASK 0x1 /end MEASUREMENT
/begin MEASUREMENT Vbx_swa_lk_stt "Mux Network configuration detection: Steering Wheel Angle Unit status" UBYTE _CNV_S_2_RANGE______3_CM 1 0. 0. 1. DISPLAY_IDENTIFIER CmMuxSer_NVM.Vbx_swa_lk_stt_NVM ECU_ADDRESS 0xd0003e57 BIT_MASK 0x1 /end MEASUREMENT
/begin MEASUREMENT Vbx_ddcm_lk_stt "Mux Network configuration detection : Driver Door Control Module status" UBYTE _CNV_S_2_RANGE______3_CM 1 0. 0. 1. DISPLAY_IDENTIFIER CmMuxSer_NVM.Vbx_ddcm_lk_stt_NVM ECU_ADDRESS 0xd0003e58 BIT_MASK 0x1 /end MEASUREMENT
/begin MEASUREMENT AIRBAGCrash[0] "Received CAN frame" UBYTE _CNV_A_R_A_165_CM 1 0. 0. 255. ECU_ADDRESS 0xd00053a4 /end MEASUREMENT
/begin MEASUREMENT AIRBAGCrash[1] "Received CAN frame" UBYTE _CNV_A_R_A_165_CM 1 0. 0. 255. ECU_ADDRESS 0xd00053a5 /end MEASUREMENT
/begin MEASUREMENT BCM_CANHS_RNr_01[0] "Received CAN frame" UBYTE _CNV_A_R_A_165_CM 1 0. 0. 255. ECU_ADDRESS 0xd0003e5c /end MEASUREMENT
/begin MEASUREMENT BCM_CANHS_RNr_01[1] "Received CAN frame" UBYTE _CNV_A_R_A_165_CM 1 0. 0. 255. ECU_ADDRESS 0xd0003e5d /end MEASUREMENT
/begin MEASUREMENT BCM_CANHS_RNr_01[2] "Received CAN frame" UBYTE _CNV_A_R_A_165_CM 1 0. 0. 255. ECU_ADDRESS 0xd0003e5e /end MEASUREMENT
/begin MEASUREMENT BCM_CANHS_RNr_01[3] "Received CAN frame" UBYTE _CNV_A_R_A_165_CM 1 0. 0. 255. ECU_ADDRESS 0xd0003e5f /end MEASUREMENT
/begin MEASUREMENT BCM_CANHS_RNr_01[4] "Received CAN frame" UBYTE _CNV_A_R_A_165_CM 1 0. 0. 255. ECU_ADDRESS 0xd0003e60 /end MEASUREMENT
/begin MEASUREMENT BCM_CANHS_RNr_01[5] "Received CAN frame" UBYTE _CNV_A_R_A_165_CM 1 0. 0. 255. ECU_ADDRESS 0xd0003e61 /end MEASUREMENT
/begin MEASUREMENT BCM_CANHS_RNr_01[6] "Received CAN frame" UBYTE _CNV_A_R_A_165_CM 1 0. 0. 255. ECU_ADDRESS 0xd0003e62 /end MEASUREMENT
/begin MEASUREMENT BCM_CANHS_RNr_01[7] "Received CAN frame" UBYTE _CNV_A_R_A_165_CM 1 0. 0. 255. ECU_ADDRESS 0xd0003e63 /end MEASUREMENT
/begin MEASUREMENT BCM_CANHS_RNr_02[0] "Received CAN frame" UBYTE _CNV_A_R_A_165_CM 1 0. 0. 255. ECU_ADDRESS 0xd0005394 /end MEASUREMENT
/begin MEASUREMENT BCM_CANHS_RNr_02[1] "Received CAN frame" UBYTE _CNV_A_R_A_165_CM 1 0. 0. 255. ECU_ADDRESS 0xd0005395 /end MEASUREMENT
/begin MEASUREMENT BCM_CANHS_RNr_02[2] "Received CAN frame" UBYTE _CNV_A_R_A_165_CM 1 0. 0. 255. ECU_ADDRESS 0xd0005396 /end MEASUREMENT
/begin MEASUREMENT BCM_CANHS_RNr_02[3] "Received CAN frame" UBYTE _CNV_A_R_A_165_CM 1 0. 0. 255. ECU_ADDRESS 0xd0005397 /end MEASUREMENT
/begin MEASUREMENT BCM_CANHS_RNr_02[4] "Received CAN frame" UBYTE _CNV_A_R_A_165_CM 1 0. 0. 255. ECU_ADDRESS 0xd0005398 /end MEASUREMENT
/begin MEASUREMENT BCM_CANHS_RNr_02[5] "Received CAN frame" UBYTE _CNV_A_R_A_165_CM 1 0. 0. 255. ECU_ADDRESS 0xd0005399 /end MEASUREMENT
/begin MEASUREMENT BCM_CANHS_RNr_02[6] "Received CAN frame" UBYTE _CNV_A_R_A_165_CM 1 0. 0. 255. ECU_ADDRESS 0xd000539a /end MEASUREMENT
/begin MEASUREMENT BCM_CANHS_RNr_02[7] "Received CAN frame" UBYTE _CNV_A_R_A_165_CM 1 0. 0. 255. ECU_ADDRESS 0xd000539b /end MEASUREMENT
/begin MEASUREMENT BCM_VERLOG[0] "Received CAN frame" UBYTE _CNV_A_R_A_165_CM 1 0. 0. 255. ECU_ADDRESS 0xd00053a6 /end MEASUREMENT
/begin MEASUREMENT BCM_VERLOG[1] "Received CAN frame" UBYTE _CNV_A_R_A_165_CM 1 0. 0. 255. ECU_ADDRESS 0xd00053a7 /end MEASUREMENT
/begin MEASUREMENT BCM_VERLOG[2] "Received CAN frame" UBYTE _CNV_A_R_A_165_CM 1 0. 0. 255. ECU_ADDRESS 0xd00053a8 /end MEASUREMENT
/begin MEASUREMENT BCM_VERLOG[3] "Received CAN frame" UBYTE _CNV_A_R_A_165_CM 1 0. 0. 255. ECU_ADDRESS 0xd00053a9 /end MEASUREMENT
/begin MEASUREMENT BCM_VERLOG[4] "Received CAN frame" UBYTE _CNV_A_R_A_165_CM 1 0. 0. 255. ECU_ADDRESS 0xd00053aa /end MEASUREMENT
/begin MEASUREMENT BRAKE_CANHS_RNr_01[0] "Received CAN frame" UBYTE _CNV_A_R_A_165_CM 1 0. 0. 255. ECU_ADDRESS 0xd0003e84 /end MEASUREMENT
/begin MEASUREMENT BRAKE_CANHS_RNr_01[1] "Received CAN frame" UBYTE _CNV_A_R_A_165_CM 1 0. 0. 255. ECU_ADDRESS 0xd0003e85 /end MEASUREMENT
/begin MEASUREMENT BRAKE_CANHS_RNr_01[2] "Received CAN frame" UBYTE _CNV_A_R_A_165_CM 1 0. 0. 255. ECU_ADDRESS 0xd0003e86 /end MEASUREMENT
/begin MEASUREMENT BRAKE_CANHS_RNr_01[3] "Received CAN frame" UBYTE _CNV_A_R_A_165_CM 1 0. 0. 255. ECU_ADDRESS 0xd0003e87 /end MEASUREMENT
/begin MEASUREMENT BRAKE_CANHS_RNr_01[4] "Received CAN frame" UBYTE _CNV_A_R_A_165_CM 1 0. 0. 255. ECU_ADDRESS 0xd0003e88 /end MEASUREMENT
/begin MEASUREMENT BRAKE_CANHS_RNr_01[5] "Received CAN frame" UBYTE _CNV_A_R_A_165_CM 1 0. 0. 255. ECU_ADDRESS 0xd0003e89 /end MEASUREMENT
/begin MEASUREMENT BRAKE_CANHS_RNr_01[6] "Received CAN frame" UBYTE _CNV_A_R_A_165_CM 1 0. 0. 255. ECU_ADDRESS 0xd0003e8a /end MEASUREMENT
/begin MEASUREMENT BRAKE_CANHS_RNr_02[0] "Received CAN frame" UBYTE _CNV_A_R_A_165_CM 1 0. 0. 255. ECU_ADDRESS 0xd0003e8c /end MEASUREMENT
/begin MEASUREMENT BRAKE_CANHS_RNr_02[1] "Received CAN frame" UBYTE _CNV_A_R_A_165_CM 1 0. 0. 255. ECU_ADDRESS 0xd0003e8d /end MEASUREMENT
/begin MEASUREMENT BRAKE_CANHS_RNr_02[2] "Received CAN frame" UBYTE _CNV_A_R_A_165_CM 1 0. 0. 255. ECU_ADDRESS 0xd0003e8e /end MEASUREMENT
/begin MEASUREMENT BRAKE_CANHS_RNr_02[3] "Received CAN frame" UBYTE _CNV_A_R_A_165_CM 1 0. 0. 255. ECU_ADDRESS 0xd0003e8f /end MEASUREMENT
/begin MEASUREMENT BRAKE_CANHS_RNr_02[4] "Received CAN frame" UBYTE _CNV_A_R_A_165_CM 1 0. 0. 255. ECU_ADDRESS 0xd0003e90 /end MEASUREMENT
/begin MEASUREMENT BRAKE_CANHS_RNr_02[5] "Received CAN frame" UBYTE _CNV_A_R_A_165_CM 1 0. 0. 255. ECU_ADDRESS 0xd0003e91 /end MEASUREMENT
/begin MEASUREMENT BRAKE_CANHS_RNr_03[0] "Received CAN frame" UBYTE _CNV_A_R_A_165_CM 1 0. 0. 255. ECU_ADDRESS 0xd0003e92 /end MEASUREMENT
/begin MEASUREMENT BRAKE_CANHS_RNr_03[1] "Received CAN frame" UBYTE _CNV_A_R_A_165_CM 1 0. 0. 255. ECU_ADDRESS 0xd0003e93 /end MEASUREMENT
/begin MEASUREMENT BRAKE_CANHS_RNr_03[2] "Received CAN frame" UBYTE _CNV_A_R_A_165_CM 1 0. 0. 255. ECU_ADDRESS 0xd0003e94 /end MEASUREMENT
/begin MEASUREMENT BRAKE_CANHS_RNr_03[3] "Received CAN frame" UBYTE _CNV_A_R_A_165_CM 1 0. 0. 255. ECU_ADDRESS 0xd0003e95 /end MEASUREMENT
/begin MEASUREMENT BRAKE_CANHS_RNr_03[4] "Received CAN frame" UBYTE _CNV_A_R_A_165_CM 1 0. 0. 255. ECU_ADDRESS 0xd0003e96 /end MEASUREMENT
/begin MEASUREMENT BRAKE_CANHS_RNr_03[5] "Received CAN frame" UBYTE _CNV_A_R_A_165_CM 1 0. 0. 255. ECU_ADDRESS 0xd0003e97 /end MEASUREMENT
/begin MEASUREMENT BRAKE_CANHS_RNr_04[0] "Received CAN frame" UBYTE _CNV_A_R_A_165_CM 1 0. 0. 255. ECU_ADDRESS 0xd0003e64 /end MEASUREMENT
/begin MEASUREMENT BRAKE_CANHS_RNr_04[1] "Received CAN frame" UBYTE _CNV_A_R_A_165_CM 1 0. 0. 255. ECU_ADDRESS 0xd0003e65 /end MEASUREMENT
/begin MEASUREMENT BRAKE_CANHS_RNr_04[2] "Received CAN frame" UBYTE _CNV_A_R_A_165_CM 1 0. 0. 255. ECU_ADDRESS 0xd0003e66 /end MEASUREMENT
/begin MEASUREMENT BRAKE_CANHS_RNr_04[3] "Received CAN frame" UBYTE _CNV_A_R_A_165_CM 1 0. 0. 255. ECU_ADDRESS 0xd0003e67 /end MEASUREMENT
/begin MEASUREMENT BRAKE_CANHS_RNr_04[4] "Received CAN frame" UBYTE _CNV_A_R_A_165_CM 1 0. 0. 255. ECU_ADDRESS 0xd0003e68 /end MEASUREMENT
/begin MEASUREMENT BRAKE_CANHS_RNr_04[5] "Received CAN frame" UBYTE _CNV_A_R_A_165_CM 1 0. 0. 255. ECU_ADDRESS 0xd0003e69 /end MEASUREMENT
/begin MEASUREMENT BRAKE_CANHS_RNr_04[6] "Received CAN frame" UBYTE _CNV_A_R_A_165_CM 1 0. 0. 255. ECU_ADDRESS 0xd0003e6a /end MEASUREMENT
/begin MEASUREMENT BRAKE_CANHS_RNr_04[7] "Received CAN frame" UBYTE _CNV_A_R_A_165_CM 1 0. 0. 255. ECU_ADDRESS 0xd0003e6b /end MEASUREMENT
/begin MEASUREMENT BRAKE_CANHS_R_01[0] "Received CAN frame" UBYTE _CNV_A_R_A_165_CM 1 0. 0. 255. ECU_ADDRESS 0xd00053ac /end MEASUREMENT
/begin MEASUREMENT BRAKE_CANHS_R_01[1] "Received CAN frame" UBYTE _CNV_A_R_A_165_CM 1 0. 0. 255. ECU_ADDRESS 0xd00053ad /end MEASUREMENT
/begin MEASUREMENT BRAKE_CANHS_R_01[2] "Received CAN frame" UBYTE _CNV_A_R_A_165_CM 1 0. 0. 255. ECU_ADDRESS 0xd00053ae /end MEASUREMENT
/begin MEASUREMENT BRAKE_CANHS_R_01[3] "Received CAN frame" UBYTE _CNV_A_R_A_165_CM 1 0. 0. 255. ECU_ADDRESS 0xd00053af /end MEASUREMENT
/begin MEASUREMENT BRAKE_CANHS_R_01[4] "Received CAN frame" UBYTE _CNV_A_R_A_165_CM 1 0. 0. 255. ECU_ADDRESS 0xd00053b0 /end MEASUREMENT
/begin MEASUREMENT BRAKE_CANHS_R_01[5] "Received CAN frame" UBYTE _CNV_A_R_A_165_CM 1 0. 0. 255. ECU_ADDRESS 0xd00053b1 /end MEASUREMENT
/begin MEASUREMENT BRAKE_CANHS_R_01[6] "Received CAN frame" UBYTE _CNV_A_R_A_165_CM 1 0. 0. 255. ECU_ADDRESS 0xd00053b2 /end MEASUREMENT
/begin MEASUREMENT CLIM_CANHS_R_01[0] "Received CAN frame" UBYTE _CNV_A_R_A_165_CM 1 0. 0. 255. ECU_ADDRESS 0xd0003e98 /end MEASUREMENT
/begin MEASUREMENT CLIM_CANHS_R_01[1] "Received CAN frame" UBYTE _CNV_A_R_A_165_CM 1 0. 0. 255. ECU_ADDRESS 0xd0003e99 /end MEASUREMENT
/begin MEASUREMENT CLIM_CANHS_R_01[2] "Received CAN frame" UBYTE _CNV_A_R_A_165_CM 1 0. 0. 255. ECU_ADDRESS 0xd0003e9a /end MEASUREMENT
/begin MEASUREMENT CLIM_CANHS_R_01[3] "Received CAN frame" UBYTE _CNV_A_R_A_165_CM 1 0. 0. 255. ECU_ADDRESS 0xd0003e9b /end MEASUREMENT
/begin MEASUREMENT CLIM_CANHS_R_01[4] "Received CAN frame" UBYTE _CNV_A_R_A_165_CM 1 0. 0. 255. ECU_ADDRESS 0xd0003e9c /end MEASUREMENT
/begin MEASUREMENT CLIM_CANHS_R_01[5] "Received CAN frame" UBYTE _CNV_A_R_A_165_CM 1 0. 0. 255. ECU_ADDRESS 0xd0003e9d /end MEASUREMENT
/begin MEASUREMENT CLUSTER_CANHS_RNr_01[0] "Received CAN frame" UBYTE _CNV_A_R_A_165_CM 1 0. 0. 255. ECU_ADDRESS 0xd00053b4 /end MEASUREMENT
/begin MEASUREMENT CLUSTER_CANHS_RNr_01[1] "Received CAN frame" UBYTE _CNV_A_R_A_165_CM 1 0. 0. 255. ECU_ADDRESS 0xd00053b5 /end MEASUREMENT
/begin MEASUREMENT CLUSTER_CANHS_RNr_01[2] "Received CAN frame" UBYTE _CNV_A_R_A_165_CM 1 0. 0. 255. ECU_ADDRESS 0xd00053b6 /end MEASUREMENT
/begin MEASUREMENT CLUSTER_CANHS_RNr_01[3] "Received CAN frame" UBYTE _CNV_A_R_A_165_CM 1 0. 0. 255. ECU_ADDRESS 0xd00053b7 /end MEASUREMENT
/begin MEASUREMENT CLUSTER_CANHS_RNr_01[4] "Received CAN frame" UBYTE _CNV_A_R_A_165_CM 1 0. 0. 255. ECU_ADDRESS 0xd00053b8 /end MEASUREMENT
/begin MEASUREMENT CLUSTER_CANHS_R_01[0] "Received CAN frame" UBYTE _CNV_A_R_A_165_CM 1 0. 0. 255. ECU_ADDRESS 0xd000539c /end MEASUREMENT
/begin MEASUREMENT CLUSTER_CANHS_R_01[1] "Received CAN frame" UBYTE _CNV_A_R_A_165_CM 1 0. 0. 255. ECU_ADDRESS 0xd000539d /end MEASUREMENT
/begin MEASUREMENT CLUSTER_CANHS_R_01[2] "Received CAN frame" UBYTE _CNV_A_R_A_165_CM 1 0. 0. 255. ECU_ADDRESS 0xd000539e /end MEASUREMENT
/begin MEASUREMENT CLUSTER_CANHS_R_01[3] "Received CAN frame" UBYTE _CNV_A_R_A_165_CM 1 0. 0. 255. ECU_ADDRESS 0xd000539f /end MEASUREMENT
/begin MEASUREMENT CLUSTER_CANHS_R_01[4] "Received CAN frame" UBYTE _CNV_A_R_A_165_CM 1 0. 0. 255. ECU_ADDRESS 0xd00053a0 /end MEASUREMENT
/begin MEASUREMENT CLUSTER_CANHS_R_01[5] "Received CAN frame" UBYTE _CNV_A_R_A_165_CM 1 0. 0. 255. ECU_ADDRESS 0xd00053a1 /end MEASUREMENT
/begin MEASUREMENT CLUSTER_CANHS_R_01[6] "Received CAN frame" UBYTE _CNV_A_R_A_165_CM 1 0. 0. 255. ECU_ADDRESS 0xd00053a2 /end MEASUREMENT
/begin MEASUREMENT CLUSTER_CANHS_R_01[7] "Received CAN frame" UBYTE _CNV_A_R_A_165_CM 1 0. 0. 255. ECU_ADDRESS 0xd00053a3 /end MEASUREMENT
/begin MEASUREMENT DDCM_CANLSFT_R_01[0] "Received CAN frame" UBYTE _CNV_A_R_A_165_CM 1 0. 0. 255. ECU_ADDRESS 0xd0003e9e /end MEASUREMENT
/begin MEASUREMENT DDCM_CANLSFT_R_01[1] "Received CAN frame" UBYTE _CNV_A_R_A_165_CM 1 0. 0. 255. ECU_ADDRESS 0xd0003e9f /end MEASUREMENT
/begin MEASUREMENT DDCM_CANLSFT_R_01[2] "Received CAN frame" UBYTE _CNV_A_R_A_165_CM 1 0. 0. 255. ECU_ADDRESS 0xd0003ea0 /end MEASUREMENT
/begin MEASUREMENT DDCM_CANLSFT_R_01[3] "Received CAN frame" UBYTE _CNV_A_R_A_165_CM 1 0. 0. 255. ECU_ADDRESS 0xd0003ea1 /end MEASUREMENT
/begin MEASUREMENT DDCM_CANLSFT_R_01[4] "Received CAN frame" UBYTE _CNV_A_R_A_165_CM 1 0. 0. 255. ECU_ADDRESS 0xd0003ea2 /end MEASUREMENT
/begin MEASUREMENT SWA_CANHS_RNr_01[0] "Received CAN frame" UBYTE _CNV_A_R_A_165_CM 1 0. 0. 255. ECU_ADDRESS 0xd0003e6c /end MEASUREMENT
/begin MEASUREMENT SWA_CANHS_RNr_01[1] "Received CAN frame" UBYTE _CNV_A_R_A_165_CM 1 0. 0. 255. ECU_ADDRESS 0xd0003e6d /end MEASUREMENT
/begin MEASUREMENT SWA_CANHS_RNr_01[2] "Received CAN frame" UBYTE _CNV_A_R_A_165_CM 1 0. 0. 255. ECU_ADDRESS 0xd0003e6e /end MEASUREMENT
/begin MEASUREMENT SWA_CANHS_RNr_01[3] "Received CAN frame" UBYTE _CNV_A_R_A_165_CM 1 0. 0. 255. ECU_ADDRESS 0xd0003e6f /end MEASUREMENT
/begin MEASUREMENT SWA_CANHS_RNr_01[4] "Received CAN frame" UBYTE _CNV_A_R_A_165_CM 1 0. 0. 255. ECU_ADDRESS 0xd0003e70 /end MEASUREMENT
/begin MEASUREMENT SWA_CANHS_RNr_01[5] "Received CAN frame" UBYTE _CNV_A_R_A_165_CM 1 0. 0. 255. ECU_ADDRESS 0xd0003e71 /end MEASUREMENT
/begin MEASUREMENT SWA_CANHS_RNr_01[6] "Received CAN frame" UBYTE _CNV_A_R_A_165_CM 1 0. 0. 255. ECU_ADDRESS 0xd0003e72 /end MEASUREMENT
/begin MEASUREMENT SWA_CANHS_RNr_01[7] "Received CAN frame" UBYTE _CNV_A_R_A_165_CM 1 0. 0. 255. ECU_ADDRESS 0xd0003e73 /end MEASUREMENT
/begin MEASUREMENT TORQUE_AT_CANHS_RNr_01[0] "Received CAN frame" UBYTE _CNV_A_R_A_165_CM 1 0. 0. 255. ECU_ADDRESS 0xd0003e74 /end MEASUREMENT
/begin MEASUREMENT TORQUE_AT_CANHS_RNr_01[1] "Received CAN frame" UBYTE _CNV_A_R_A_165_CM 1 0. 0. 255. ECU_ADDRESS 0xd0003e75 /end MEASUREMENT
/begin MEASUREMENT TORQUE_AT_CANHS_RNr_01[2] "Received CAN frame" UBYTE _CNV_A_R_A_165_CM 1 0. 0. 255. ECU_ADDRESS 0xd0003e76 /end MEASUREMENT
/begin MEASUREMENT TORQUE_AT_CANHS_RNr_01[3] "Received CAN frame" UBYTE _CNV_A_R_A_165_CM 1 0. 0. 255. ECU_ADDRESS 0xd0003e77 /end MEASUREMENT
/begin MEASUREMENT TORQUE_AT_CANHS_RNr_01[4] "Received CAN frame" UBYTE _CNV_A_R_A_165_CM 1 0. 0. 255. ECU_ADDRESS 0xd0003e78 /end MEASUREMENT
/begin MEASUREMENT TORQUE_AT_CANHS_RNr_01[5] "Received CAN frame" UBYTE _CNV_A_R_A_165_CM 1 0. 0. 255. ECU_ADDRESS 0xd0003e79 /end MEASUREMENT
/begin MEASUREMENT TORQUE_AT_CANHS_RNr_01[6] "Received CAN frame" UBYTE _CNV_A_R_A_165_CM 1 0. 0. 255. ECU_ADDRESS 0xd0003e7a /end MEASUREMENT
/begin MEASUREMENT TORQUE_AT_CANHS_RNr_01[7] "Received CAN frame" UBYTE _CNV_A_R_A_165_CM 1 0. 0. 255. ECU_ADDRESS 0xd0003e7b /end MEASUREMENT
/begin MEASUREMENT TORQUE_AT_CANHS_RNr_02[0] "Received CAN frame" UBYTE _CNV_A_R_A_165_CM 1 0. 0. 255. ECU_ADDRESS 0xd0003e7c /end MEASUREMENT
/begin MEASUREMENT TORQUE_AT_CANHS_RNr_02[1] "Received CAN frame" UBYTE _CNV_A_R_A_165_CM 1 0. 0. 255. ECU_ADDRESS 0xd0003e7d /end MEASUREMENT
/begin MEASUREMENT TORQUE_AT_CANHS_RNr_02[2] "Received CAN frame" UBYTE _CNV_A_R_A_165_CM 1 0. 0. 255. ECU_ADDRESS 0xd0003e7e /end MEASUREMENT
/begin MEASUREMENT TORQUE_AT_CANHS_RNr_02[3] "Received CAN frame" UBYTE _CNV_A_R_A_165_CM 1 0. 0. 255. ECU_ADDRESS 0xd0003e7f /end MEASUREMENT
/begin MEASUREMENT TORQUE_AT_CANHS_RNr_02[4] "Received CAN frame" UBYTE _CNV_A_R_A_165_CM 1 0. 0. 255. ECU_ADDRESS 0xd0003e80 /end MEASUREMENT
/begin MEASUREMENT TORQUE_AT_CANHS_RNr_02[5] "Received CAN frame" UBYTE _CNV_A_R_A_165_CM 1 0. 0. 255. ECU_ADDRESS 0xd0003e81 /end MEASUREMENT
/begin MEASUREMENT TORQUE_AT_CANHS_RNr_02[6] "Received CAN frame" UBYTE _CNV_A_R_A_165_CM 1 0. 0. 255. ECU_ADDRESS 0xd0003e82 /end MEASUREMENT
/begin MEASUREMENT TORQUE_AT_CANHS_RNr_02[7] "Received CAN frame" UBYTE _CNV_A_R_A_165_CM 1 0. 0. 255. ECU_ADDRESS 0xd0003e83 /end MEASUREMENT
/begin MEASUREMENT USM_CANHS_RNr_01[0] "Received CAN frame" UBYTE _CNV_A_R_A_165_CM 1 0. 0. 255. ECU_ADDRESS 0xd0003ea4 /end MEASUREMENT
/begin MEASUREMENT USM_CANHS_RNr_01[1] "Received CAN frame" UBYTE _CNV_A_R_A_165_CM 1 0. 0. 255. ECU_ADDRESS 0xd0003ea5 /end MEASUREMENT
/begin MEASUREMENT USM_CANHS_RNr_01[2] "Received CAN frame" UBYTE _CNV_A_R_A_165_CM 1 0. 0. 255. ECU_ADDRESS 0xd0003ea6 /end MEASUREMENT
/begin MEASUREMENT USM_CANHS_RNr_01[3] "Received CAN frame" UBYTE _CNV_A_R_A_165_CM 1 0. 0. 255. ECU_ADDRESS 0xd0003ea7 /end MEASUREMENT
/begin MEASUREMENT USM_CANHS_RNr_01[4] "Received CAN frame" UBYTE _CNV_A_R_A_165_CM 1 0. 0. 255. ECU_ADDRESS 0xd0003ea8 /end MEASUREMENT
/begin MEASUREMENT Vbx_abs_pws_typ_bc "Indicates the ABS power supply class" UBYTE _CNV_S_2_RANGE______3_CM 1 0. 0. 1. ECU_ADDRESS 0xd0003ee2 BIT_MASK 0x1 /end MEASUREMENT
/begin MEASUREMENT Vbx_ac_pws_typ_bc "Indicates the AC power supply class" UBYTE _CNV_S_2_RANGE______3_CM 1 0. 0. 1. ECU_ADDRESS 0xd0003ee3 BIT_MASK 0x1 /end MEASUREMENT
/begin MEASUREMENT Vbx_acc_pws_typ_bc "Indicates the ACC power supply class" UBYTE _CNV_S_2_RANGE______3_CM 1 0. 0. 1. ECU_ADDRESS 0xd0003ee4 BIT_MASK 0x1 /end MEASUREMENT
/begin MEASUREMENT Vbx_agb_pws_typ_bc "Indicates the AGB power supply class" UBYTE _CNV_S_2_RANGE______3_CM 1 0. 0. 1. ECU_ADDRESS 0xd0003ee5 BIT_MASK 0x1 /end MEASUREMENT
/begin MEASUREMENT Vbx_can_diag_bus_fail "Mux diagnostic activation indicator for network (CAN bus) failure detection." UBYTE _CNV_S_2_RANGE______3_CM 1 0. 0. 1. ECU_ADDRESS 0xd0003ee6 BIT_MASK 0x1 /end MEASUREMENT
/begin MEASUREMENT Vbx_can_diag_ecm "ECM reception diagnostic indicator" UBYTE _CNV_S_2_RANGE______3_CM 1 0. 0. 1. ECU_ADDRESS 0xd0003ee7 BIT_MASK 0x1 /end MEASUREMENT
/begin MEASUREMENT Vbx_ccu_pws_typ_bc "Indicates the BCM power supply class" UBYTE _CNV_S_2_RANGE______3_CM 1 0. 0. 1. ECU_ADDRESS 0xd0003ee8 BIT_MASK 0x1 /end MEASUREMENT
/begin MEASUREMENT Vbx_ddcm_pws_typ_bc "Indicates the DDCM power supply class" UBYTE _CNV_S_2_RANGE______3_CM 1 0. 0. 1. ECU_ADDRESS 0xd0003ee9 BIT_MASK 0x1 /end MEASUREMENT
/begin MEASUREMENT Vbx_ip_pws_typ_bc "Indicates the CLUSTER power supply class" UBYTE _CNV_S_2_RANGE______3_CM 1 0. 0. 1. ECU_ADDRESS 0xd0003eea BIT_MASK 0x1 /end MEASUREMENT
/begin MEASUREMENT Vbx_mute_pws_typ_bc "Mute power supply type (=1 if type BC, =0 if type AD)" UBYTE _CNV_S_2_RANGE______3_CM 1 0. 0. 1. ECU_ADDRESS 0xd0003eeb BIT_MASK 0x1 /end MEASUREMENT
/begin MEASUREMENT Vbx_sdl_pws_typ_bc "Indicates the SDL power supply class" UBYTE _CNV_S_2_RANGE______3_CM 1 0. 0. 1. ECU_ADDRESS 0xd0003eec BIT_MASK 0x1 /end MEASUREMENT
/begin MEASUREMENT Vbx_swa_pws_typ_bc "Indicates the SWA power supply class" UBYTE _CNV_S_2_RANGE______3_CM 1 0. 0. 1. ECU_ADDRESS 0xd0003eed BIT_MASK 0x1 /end MEASUREMENT
/begin MEASUREMENT Vbx_usm_pws_typ_bc "Indicates the USM power supply class" UBYTE _CNV_S_2_RANGE______3_CM 1 0. 0. 1. ECU_ADDRESS 0xd0003eee BIT_MASK 0x1 /end MEASUREMENT
/begin MEASUREMENT Vxx_abs_ecu_stt " State of Brake Control Unit for CAN failure detection." UBYTE _CNV_S_3_STATUS_CAN_398_CM 1 0. 0. 2. ECU_ADDRESS 0xd0003ea9 /end MEASUREMENT
/begin MEASUREMENT Vxx_abs_ecu_stt_ctr "Brake Control Unit counter for validated CAN failure detection." UBYTE _CNV_A_R_ECME_LINEA_0_CM 1 0. 0. 255. ECU_ADDRESS 0xd0003eaa FORMAT "%3.0" /end MEASUREMENT
/begin MEASUREMENT Vxx_abs_ecu_stt_ctr_mem_dec "Brake Control Unit : current failures non-volatile counter (previous value)" UBYTE _CNV_A_R_ECME_LINEA_0_CM 1 0. 0. 255. ECU_ADDRESS 0xd0003eab FORMAT "%3.0" /end MEASUREMENT
/begin MEASUREMENT Vxx_abs_ecu_stt_ctr_mem_prev "Brake Control Unit : current failures non-volatile counter (new value)" UBYTE _CNV_A_R_ECME_LINEA_0_CM 1 0. 0. 255. ECU_ADDRESS 0xd0003eac FORMAT "%3.0" /end MEASUREMENT
/begin MEASUREMENT Vxx_abs_ecu_stt_diag "State of Brake Control Unit failure detection for Mux Network frame" UBYTE _CNV_A_R_ECME_LINEA_0_CM 1 0. 0. 255. ECU_ADDRESS 0xd0003ead FORMAT "%3.0" /end MEASUREMENT
/begin MEASUREMENT Vxx_ac_ecu_stt " State of Climate Control Unit for CAN failure detection." UBYTE _CNV_S_3_STATUS_CAN_398_CM 1 0. 0. 2. ECU_ADDRESS 0xd0003eae /end MEASUREMENT
/begin MEASUREMENT Vxx_ac_ecu_stt_ctr "Climate Control Unit counter for validated CAN failure detection." UBYTE _CNV_A_R_ECME_LINEA_0_CM 1 0. 0. 255. ECU_ADDRESS 0xd0003eaf FORMAT "%3.0" /end MEASUREMENT
/begin MEASUREMENT Vxx_ac_ecu_stt_ctr_mem_dec "AC current failures non-volatile counter (new value)" UBYTE _CNV_A_R_ECME_LINEA_0_CM 1 0. 0. 255. ECU_ADDRESS 0xd0003eb0 FORMAT "%3.0" /end MEASUREMENT
/begin MEASUREMENT Vxx_ac_ecu_stt_ctr_mem_prev "AC current failures non-volatile counter (previous value)" UBYTE _CNV_A_R_ECME_LINEA_0_CM 1 0. 0. 255. ECU_ADDRESS 0xd0003eb1 FORMAT "%3.0" /end MEASUREMENT
/begin MEASUREMENT Vxx_ac_ecu_stt_diag "State of Climate Control Unit failure detection for Mux Network frame" UBYTE _CNV_A_R_ECME_LINEA_0_CM 1 0. 0. 255. ECU_ADDRESS 0xd0003eb2 FORMAT "%3.0" /end MEASUREMENT
/begin MEASUREMENT Vxx_acc_ecu_stt "State of Automatic Cruise Control Unit for CAN." UBYTE _CNV_S_3_STATUS_CAN_398_CM 1 0. 0. 2. ECU_ADDRESS 0xd0003eb3 /end MEASUREMENT
/begin MEASUREMENT Vxx_acc_ecu_stt_ctr "Automatic Cruise Control Unit counter for validated CAN failure detection." UBYTE _CNV_A_R_ECME_LINEA_0_CM 1 0. 0. 255. ECU_ADDRESS 0xd0003eb4 FORMAT "%3.0" /end MEASUREMENT
/begin MEASUREMENT Vxx_acc_ecu_stt_ctr_mem_dec "ACC current failures non-volatile counter (new value)" UBYTE _CNV_A_R_ECME_LINEA_0_CM 1 0. 0. 255. ECU_ADDRESS 0xd0003eb5 FORMAT "%3.0" /end MEASUREMENT
/begin MEASUREMENT Vxx_acc_ecu_stt_ctr_mem_prev "ACC current failures non-volatile counter (previous value)" UBYTE _CNV_A_R_ECME_LINEA_0_CM 1 0. 0. 255. ECU_ADDRESS 0xd0003eb6 FORMAT "%3.0" /end MEASUREMENT
/begin MEASUREMENT Vxx_acc_ecu_stt_diag "State of Automatic Cruise Control Unit failure detection for Mux Network frame≤" UBYTE _CNV_A_R_ECME_LINEA_0_CM 1 0. 0. 255. ECU_ADDRESS 0xd0003eb7 FORMAT "%3.0" /end MEASUREMENT
/begin MEASUREMENT Vxx_agb_ecu_stt "Automatic Gear Box Control Unit counter for validated CAN failure detection." UBYTE _CNV_S_3_STATUS_CAN_398_CM 1 0. 0. 2. ECU_ADDRESS 0xd0003eb8 /end MEASUREMENT
/begin MEASUREMENT Vxx_agb_ecu_stt_ctr "Automatic Gear Box Control Unit : current failures non-volatile counter" UBYTE _CNV_A_R_ECME_LINEA_0_CM 1 0. 0. 255. ECU_ADDRESS 0xd0003eb9 FORMAT "%3.0" /end MEASUREMENT
/begin MEASUREMENT Vxx_agb_ecu_stt_ctr_mem_dec "AGB : current failures non-volatile counter (new value)" UBYTE _CNV_A_R_ECME_LINEA_0_CM 1 0. 0. 255. ECU_ADDRESS 0xd0003eba FORMAT "%3.0" /end MEASUREMENT
/begin MEASUREMENT Vxx_agb_ecu_stt_ctr_mem_prev "AGB : current failures non-volatile counter (previous value)" UBYTE _CNV_A_R_ECME_LINEA_0_CM 1 0. 0. 255. ECU_ADDRESS 0xd0003ebb FORMAT "%3.0" /end MEASUREMENT
/begin MEASUREMENT Vxx_agb_ecu_stt_diag "State of Automatic Gear Box Control Unit failure detection for Mux Network frame" UBYTE _CNV_A_R_ECME_LINEA_0_CM 1 0. 0. 255. ECU_ADDRESS 0xd0003ebc FORMAT "%3.0" /end MEASUREMENT
/begin MEASUREMENT Vxx_bus_off_stt " State of Bus Off for CAN failure detection." UBYTE _CNV_A_R_ECME_LINEA_0_CM 1 0. 0. 2. ECU_ADDRESS 0xd0003ebd FORMAT "%1.0" /end MEASUREMENT
/begin MEASUREMENT Vxx_bus_off_stt_ctr "Bus Off counter for validated CAN failure detection." UBYTE _CNV_A_R_ECME_LINEA_0_CM 1 0. 0. 255. ECU_ADDRESS 0xd0003ebe FORMAT "%3.0" /end MEASUREMENT
/begin MEASUREMENT Vxx_bus_off_stt_ctr_mem_dec "Bus Off Control Unit : current failures non-volatile counter (new value)" UBYTE _CNV_A_R_ECME_LINEA_0_CM 1 0. 0. 255. ECU_ADDRESS 0xd0003ebf FORMAT "%3.0" /end MEASUREMENT
/begin MEASUREMENT Vxx_bus_off_stt_ctr_mem_prev "Bus Off Control Unit : current failures non-volatile counter (previous value)" UBYTE _CNV_A_R_ECME_LINEA_0_CM 1 0. 0. 255. ECU_ADDRESS 0xd0003ec0 FORMAT "%3.0" /end MEASUREMENT
/begin MEASUREMENT Vxx_bus_off_stt_diag "State of Bus Off Control Unit failure detection for Mux Network frame" UBYTE _CNV_A_R_ECME_LINEA_0_CM 1 0. 0. 255. ECU_ADDRESS 0xd0003ec1 FORMAT "%3.0" /end MEASUREMENT
/begin MEASUREMENT Vxx_ccu_ecu_stt " State of BCM Control Unit for CAN failure detection." UBYTE _CNV_S_3_STATUS_CAN_398_CM 1 0. 0. 2. ECU_ADDRESS 0xd0003ec2 /end MEASUREMENT
/begin MEASUREMENT Vxx_ccu_ecu_stt_ctr "BCM Control Unit counter for validated CAN failure detection." UBYTE _CNV_A_R_ECME_LINEA_0_CM 1 0. 0. 255. ECU_ADDRESS 0xd0003ec3 FORMAT "%3.0" /end MEASUREMENT
/begin MEASUREMENT Vxx_ccu_ecu_stt_ctr_mem_dec "BCM : current failures non-volatile counter (new value)" UBYTE _CNV_A_R_ECME_LINEA_0_CM 1 0. 0. 255. ECU_ADDRESS 0xd0003ec4 FORMAT "%3.0" /end MEASUREMENT
/begin MEASUREMENT Vxx_ccu_ecu_stt_ctr_mem_prev "BCM : current failures non-volatile counter (previous value)" UBYTE _CNV_A_R_ECME_LINEA_0_CM 1 0. 0. 255. ECU_ADDRESS 0xd0003ec5 FORMAT "%3.0" /end MEASUREMENT
/begin MEASUREMENT Vxx_ccu_ecu_stt_diag "State of BCM Control Unit failure detection for Mux Network frame" UBYTE _CNV_A_R_ECME_LINEA_0_CM 1 0. 0. 255. ECU_ADDRESS 0xd0003ec6 FORMAT "%3.0" /end MEASUREMENT
/begin MEASUREMENT Vxx_ddcm_ecu_stt "State of DDCM control unit for CAN failure detection" UBYTE _CNV_S_3_STATUS_CAN_398_CM 1 0. 0. 2. ECU_ADDRESS 0xd0003ec7 /end MEASUREMENT
/begin MEASUREMENT Vxx_ddcm_ecu_stt_ctr "DDCM Control Unit counter for validated CAN failure detection." UBYTE _CNV_A_R_ECME_LINEA_0_CM 1 0. 0. 255. ECU_ADDRESS 0xd0003ec8 FORMAT "%3.0" /end MEASUREMENT
/begin MEASUREMENT Vxx_ddcm_ecu_stt_ctr_mem_dec "DDCM current failures non-volatile counter (new value)" UBYTE _CNV_A_R_ECME_LINEA_0_CM 1 0. 0. 255. ECU_ADDRESS 0xd0003ec9 FORMAT "%3.0" /end MEASUREMENT
/begin MEASUREMENT Vxx_ddcm_ecu_stt_ctr_mem_prev "DDCM current failures non-volatile counter (previous value)" UBYTE _CNV_A_R_ECME_LINEA_0_CM 1 0. 0. 255. ECU_ADDRESS 0xd0003eca FORMAT "%3.0" /end MEASUREMENT
/begin MEASUREMENT Vxx_ddcm_ecu_stt_diag "State of DDCM Control Unit failure detection for Mux Network frame" UBYTE _CNV_A_R_ECME_LINEA_0_CM 1 0. 0. 255. ECU_ADDRESS 0xd0003ecb FORMAT "%3.0" /end MEASUREMENT
/begin MEASUREMENT Vxx_gcu_ecu_stt_diag "State of Gaz Control Unit failure detection for Mux Network frame" UBYTE _CNV_A_R_ECME_LINEA_0_CM 1 0. 0. 255. ECU_ADDRESS 0xd0003ecc FORMAT "%3.0" /end MEASUREMENT
/begin MEASUREMENT Vxx_ip_ecu_stt "cluster ECU status for CAN" UBYTE _CNV_S_3_STATUS_CAN_398_CM 1 0. 0. 2. ECU_ADDRESS 0xd0003ecd /end MEASUREMENT
/begin MEASUREMENT Vxx_ip_ecu_stt_ctr "Cluster Control Unit counter for validated CAN failure detection." UBYTE _CNV_A_R_ECME_LINEA_0_CM 1 0. 0. 255. ECU_ADDRESS 0xd0003ece FORMAT "%3.0" /end MEASUREMENT
/begin MEASUREMENT Vxx_ip_ecu_stt_ctr_mem_dec "CLUSTER : current failures non-volatile counter (new value)" UBYTE _CNV_A_R_ECME_LINEA_0_CM 1 0. 0. 255. ECU_ADDRESS 0xd0003ecf FORMAT "%3.0" /end MEASUREMENT
/begin MEASUREMENT Vxx_ip_ecu_stt_ctr_mem_prev "CLUSTER : current failures non-volatile counter (previous value)" UBYTE _CNV_A_R_ECME_LINEA_0_CM 1 0. 0. 255. ECU_ADDRESS 0xd0003ed0 FORMAT "%3.0" /end MEASUREMENT
/begin MEASUREMENT Vxx_ip_ecu_stt_diag "State of Cluster Control Unit failure detection for Mux Network frame" UBYTE _CNV_A_R_ECME_LINEA_0_CM 1 0. 0. 255. ECU_ADDRESS 0xd0003ed1 FORMAT "%3.0" /end MEASUREMENT
/begin MEASUREMENT Vxx_mute_stt " State of Mute for CAN failure detection." UBYTE _CNV_A_R_ECME_LINEA_0_CM 1 0. 0. 2. ECU_ADDRESS 0xd0003ed2 FORMAT "%1.0" /end MEASUREMENT
/begin MEASUREMENT Vxx_mute_stt_ctr "Mute counter for validated CAN failure detection." UBYTE _CNV_A_R_ECME_LINEA_0_CM 1 0. 0. 255. ECU_ADDRESS 0xd0003ed3 FORMAT "%3.0" /end MEASUREMENT
/begin MEASUREMENT Vxx_mute_stt_ctr_mem_dec "Mute : current failures non-volatile counter (new value)" UBYTE _CNV_A_R_ECME_LINEA_0_CM 1 0. 0. 255. ECU_ADDRESS 0xd0003ed4 FORMAT "%3.0" /end MEASUREMENT
/begin MEASUREMENT Vxx_mute_stt_ctr_mem_prev "Mute : current failures non-volatile counter (previous value)" UBYTE _CNV_A_R_ECME_LINEA_0_CM 1 0. 0. 255. ECU_ADDRESS 0xd0003ed5 FORMAT "%3.0" /end MEASUREMENT
/begin MEASUREMENT Vxx_mute_stt_diag "State of Mute failure detection for Mux Network frame" UBYTE _CNV_A_R_ECME_LINEA_0_CM 1 0. 0. 255. ECU_ADDRESS 0xd0003ed6 FORMAT "%3.0" /end MEASUREMENT
/begin MEASUREMENT Vxx_mux_frm_set_ref "Mux messaging set reference" UWORD _CNV_A_R_ECME_LINEA_0_CM 1 0. 0. 65535. ECU_ADDRESS 0xc0000c1a FORMAT "%5.0" /end MEASUREMENT
/begin MEASUREMENT Vxx_sdl_ecu_stt_diag "State of Speed and Distance Limiter Control Unit failure detection for Mux Network frame" UBYTE _CNV_A_R_ECME_LINEA_0_CM 1 0. 0. 255. ECU_ADDRESS 0xd0003ed7 FORMAT "%3.0" /end MEASUREMENT
/begin MEASUREMENT Vxx_swa_ecu_stt " State of Steering Wheel Angle Control Unit for CAN failure detection." UBYTE _CNV_S_3_STATUS_CAN_398_CM 1 0. 0. 2. ECU_ADDRESS 0xd0003ed8 /end MEASUREMENT
/begin MEASUREMENT Vxx_swa_ecu_stt_ctr "Steering Wheel Angle Control Unit counter for validated CAN failure detection." UBYTE _CNV_A_R_ECME_LINEA_0_CM 1 0. 0. 255. ECU_ADDRESS 0xd0003ed9 FORMAT "%3.0" /end MEASUREMENT
/begin MEASUREMENT Vxx_swa_ecu_stt_ctr_mem_dec "SWA current failures non-volatile counter (new value)" UBYTE _CNV_A_R_ECME_LINEA_0_CM 1 0. 0. 255. ECU_ADDRESS 0xd0003eda FORMAT "%3.0" /end MEASUREMENT
/begin MEASUREMENT Vxx_swa_ecu_stt_ctr_mem_prev "SWA current failures non-volatile counter (previous value)" UBYTE _CNV_A_R_ECME_LINEA_0_CM 1 0. 0. 255. ECU_ADDRESS 0xd0003edb FORMAT "%3.0" /end MEASUREMENT
/begin MEASUREMENT Vxx_swa_ecu_stt_diag "State of Steering Wheel Angle Control Unit failure detection for Mux Network frame" UBYTE _CNV_A_R_ECME_LINEA_0_CM 1 0. 0. 255. ECU_ADDRESS 0xd0003edc FORMAT "%3.0" /end MEASUREMENT
/begin MEASUREMENT Vxx_usm_ecu_stt "State of USM Control Unit for CAN failure detection" UBYTE _CNV_S_3_STATUS_CAN_398_CM 1 0. 0. 2. ECU_ADDRESS 0xd0003edd /end MEASUREMENT
/begin MEASUREMENT Vxx_usm_ecu_stt_ctr "USM Control Unit counter for validated CAN failure detection." UBYTE _CNV_A_R_ECME_LINEA_0_CM 1 0. 0. 255. ECU_ADDRESS 0xd0003ede FORMAT "%3.0" /end MEASUREMENT
/begin MEASUREMENT Vxx_usm_ecu_stt_ctr_mem_dec "USM : current failures non-volatile counter (new value)" UBYTE _CNV_A_R_ECME_LINEA_0_CM 1 0. 0. 255. ECU_ADDRESS 0xd0003edf FORMAT "%3.0" /end MEASUREMENT
/begin MEASUREMENT Vxx_usm_ecu_stt_ctr_mem_prev "USM : current failures non-volatile counter (previous value)" UBYTE _CNV_A_R_ECME_LINEA_0_CM 1 0. 0. 255. ECU_ADDRESS 0xd0003ee0 FORMAT "%3.0" /end MEASUREMENT
/begin MEASUREMENT Vxx_usm_ecu_stt_diag "State of USM Control Unit failure detection for Mux Network frame" UBYTE _CNV_A_R_ECME_LINEA_0_CM 1 0. 0. 255. ECU_ADDRESS 0xd0003ee1 FORMAT "%3.0" /end MEASUREMENT
/begin CHARACTERISTIC Cxx_ACC_CANHS_R_01_id "ACC_CANHS_RNr_01 CAN frame identifier" VALUE 0xa0020d38 _REC_S1VAL_20_u2 2047. _CNV_A_R_ECME_LINEA_0_CM 0. 2047. FORMAT "%1.0" /end CHARACTERISTIC
/begin CHARACTERISTIC Cxx_AIRBAGCrash_id "AIRBAGCrash frame identifier" VALUE 0xa0020d3a _REC_S1VAL_20_u2 2047. _CNV_A_R_ECME_LINEA_0_CM 0. 2047. FORMAT "%1.0" /end CHARACTERISTIC
/begin CHARACTERISTIC Cxx_BCM_CANHS_RNr_01_id "BCM_CANHS_RNr_01 CAN frame identifier" VALUE 0xa0020d3c _REC_S1VAL_20_u2 2047. _CNV_A_R_ECME_LINEA_0_CM 0. 2047. FORMAT "%1.0" /end CHARACTERISTIC
/begin CHARACTERISTIC Cxx_BCM_CANHS_RNr_02_id "BCM_CANHS_RNr_02 CAN frame identifier" VALUE 0xa0020d3e _REC_S1VAL_20_u2 2047. _CNV_A_R_ECME_LINEA_0_CM 0. 2047. FORMAT "%1.0" /end CHARACTERISTIC
/begin CHARACTERISTIC Cxx_BCM_VERLOG_id "BCM_VERLOG CAN frame identifier" VALUE 0xa0020d40 _REC_S1VAL_20_u2 2047. _CNV_A_R_ECME_LINEA_0_CM 0. 2047. FORMAT "%1.0" /end CHARACTERISTIC
/begin CHARACTERISTIC Cxx_BRAKE_CANHS_RNr_01_id "BRAKE_CANHS_RNr_01 frame identifier" VALUE 0xa0020d42 _REC_S1VAL_20_u2 2047. _CNV_A_R_ECME_LINEA_0_CM 0. 2047. FORMAT "%1.0" /end CHARACTERISTIC
/begin CHARACTERISTIC Cxx_BRAKE_CANHS_RNr_02_id "BRAKE_CANHS_RNr_02 frame identifier" VALUE 0xa0020d44 _REC_S1VAL_20_u2 2047. _CNV_A_R_ECME_LINEA_0_CM 0. 2047. FORMAT "%1.0" /end CHARACTERISTIC
/begin CHARACTERISTIC Cxx_BRAKE_CANHS_RNr_03_id "BRAKE_CANHS_RNr_03 frame identifier" VALUE 0xa0020d46 _REC_S1VAL_20_u2 2047. _CNV_A_R_ECME_LINEA_0_CM 0. 2047. FORMAT "%1.0" /end CHARACTERISTIC
/begin CHARACTERISTIC Cxx_BRAKE_CANHS_RNr_04_id "BRAKE_CANHS_RNr_04 frame identifier" VALUE 0xa0020d48 _REC_S1VAL_20_u2 2047. _CNV_A_R_ECME_LINEA_0_CM 0. 2047. FORMAT "%1.0" /end CHARACTERISTIC
/begin CHARACTERISTIC Cxx_BRAKE_CANHS_R_01_id "BRAKE_CANHS_R_01 CAN frame identifier" VALUE 0xa0020d4a _REC_S1VAL_20_u2 2047. _CNV_A_R_ECME_LINEA_0_CM 0. 2047. FORMAT "%1.0" /end CHARACTERISTIC
/begin CHARACTERISTIC Cxx_CLIM_CANHS_R_01_id "CLIM_CANHS_R_01 CAN frame identifier" VALUE 0xa0020d4c _REC_S1VAL_20_u2 2047. _CNV_A_R_ECME_LINEA_0_CM 0. 2047. FORMAT "%1.0" /end CHARACTERISTIC
/begin CHARACTERISTIC Cxx_CLUSTER_CANHS_RNr_01_id "CLUSTER_CANHS_RNr_01 CAN frame identifier" VALUE 0xa0020d4e _REC_S1VAL_20_u2 2047. _CNV_A_R_ECME_LINEA_0_CM 0. 2047. FORMAT "%1.0" /end CHARACTERISTIC
/begin CHARACTERISTIC Cxx_CLUSTER_CANHS_R_01_id "CLUSTER_CANHS_R_01 CAN frame identifier" VALUE 0xa0020d50 _REC_S1VAL_20_u2 2047. _CNV_A_R_ECME_LINEA_0_CM 0. 2047. FORMAT "%1.0" /end CHARACTERISTIC
/begin CHARACTERISTIC Cxx_DDCM_CANLSFT_R_01_id "DDCM_CANLSFT_R_01 CAN frame identifier" VALUE 0xa0020d52 _REC_S1VAL_20_u2 2047. _CNV_A_R_ECME_LINEA_0_CM 0. 2047. FORMAT "%1.0" /end CHARACTERISTIC
/begin CHARACTERISTIC Cxx_ECM_CANHS_RNr_01_id "ECM_CANHS_RNr_01 CAN frame identifier" VALUE 0xa0020d54 _REC_S1VAL_20_u2 2047. _CNV_A_R_ECME_LINEA_0_CM 0. 2047. FORMAT "%1.0" /end CHARACTERISTIC
/begin CHARACTERISTIC Cxx_ECM_CANHS_RNr_02_id "ECM_CANHS_RNr_02 CAN frame identifier" VALUE 0xa0020d56 _REC_S1VAL_20_u2 2047. _CNV_A_R_ECME_LINEA_0_CM 0. 2047. FORMAT "%1.0" /end CHARACTERISTIC
/begin CHARACTERISTIC Cxx_ECM_VERLOG_id "ECM_VERLOG CAN frame identifier" VALUE 0xa0020d58 _REC_S1VAL_20_u2 2047. _CNV_A_R_ECME_LINEA_0_CM 0. 2047. FORMAT "%1.0" /end CHARACTERISTIC
/begin CHARACTERISTIC Cxx_FORCE_ECM_CANHS_R_01_id "FORCE_ECM_CANHS_R_01 CAN frame identifier" VALUE 0xa0020d5a _REC_S1VAL_20_u2 2047. _CNV_A_R_ECME_LINEA_0_CM 0. 2047. FORMAT "%1.0" /end CHARACTERISTIC
/begin CHARACTERISTIC Cxx_MMI_ECM_CANHS_RNr_01_id "MMI_ECM_CANHS_RNr_01 CAN frame identifier" VALUE 0xa0020d5c _REC_S1VAL_20_u2 2047. _CNV_A_R_ECME_LINEA_0_CM 0. 2047. FORMAT "%1.0" /end CHARACTERISTIC
/begin CHARACTERISTIC Cxx_SWA_CANHS_RNr_01_id "SWA_CANHS_RNr_01 CAN frame identifier" VALUE 0xa0020d5e _REC_S1VAL_20_u2 2047. _CNV_A_R_ECME_LINEA_0_CM 0. 2047. FORMAT "%1.0" /end CHARACTERISTIC
/begin CHARACTERISTIC Cxx_TORQUE_AT_CANHS_RNr_01_id "TORQUE_AT_CANHS_RNr_01 CAN frame identifier" VALUE 0xa0020d60 _REC_S1VAL_20_u2 2047. _CNV_A_R_ECME_LINEA_0_CM 0. 2047. FORMAT "%1.0" /end CHARACTERISTIC
/begin CHARACTERISTIC Cxx_TORQUE_AT_CANHS_RNr_02_id "TORQUE_AT_CANHS_RNr_02 CAN frame identifier" VALUE 0xa0020d62 _REC_S1VAL_20_u2 2047. _CNV_A_R_ECME_LINEA_0_CM 0. 2047. FORMAT "%1.0" /end CHARACTERISTIC
/begin CHARACTERISTIC Cxx_TORQUE_ECM_CANHS_RNr_01_id "TORQUE_ECM_CANHS_RNr_01 CAN frame identifier" VALUE 0xa0020d64 _REC_S1VAL_20_u2 2047. _CNV_A_R_ECME_LINEA_0_CM 0. 2047. FORMAT "%1.0" /end CHARACTERISTIC
/begin CHARACTERISTIC Cxx_TORQUE_ECM_CANHS_RNr_02_id "TORQUE_ECM_CANHS_RNr_02 CAN frame identifier" VALUE 0xa0020d66 _REC_S1VAL_20_u2 2047. _CNV_A_R_ECME_LINEA_0_CM 0. 2047. FORMAT "%1.0" /end CHARACTERISTIC
/begin CHARACTERISTIC Cxx_TORQUE_ECM_CANHS_R_01_id "TORQUE_ECM_CANHS_R_01 CAN frame identifier" VALUE 0xa0020d68 _REC_S1VAL_20_u2 2047. _CNV_A_R_ECME_LINEA_0_CM 0. 2047. FORMAT "%1.0" /end CHARACTERISTIC
/begin CHARACTERISTIC Cxx_USM_CANHS_RNr_01_id "USM_CANHS_RNr_01 CAN frame identifier" VALUE 0xa0020d6a _REC_S1VAL_20_u2 2047. _CNV_A_R_ECME_LINEA_0_CM 0. 2047. FORMAT "%1.0" /end CHARACTERISTIC
/begin CHARACTERISTIC Cxx_abs_abst_frm_dly "Brake Control Unit absence detection time-out" VALUE 0xa0020d6e _REC_S1VAL_20_u1 2.55 _CNV_A_R_LINEAR_____34_CM 0. 2.55 FORMAT "%4.2" /end CHARACTERISTIC
/begin CHARACTERISTIC Cxx_abs_ecu_conf "Brake Control Unit feature for Mux Network configuration detection (always present or optional)" VALUE 0xa0020d6f _REC_S1VAL_20_u1 255. _CNV_A_R_ECME_LINEA_0_CM 0. 255. FORMAT "%3.0" /end CHARACTERISTIC
/begin CHARACTERISTIC Cxx_abs_vld_abst_frm_dec "Brake Control Unit : decrementation value for validated absent CAN failure counter." VALUE 0xa0020d70 _REC_S1VAL_20_u1 255. _CNV_A_R_ECME_LINEA_0_CM 0. 255. FORMAT "%3.0" /end CHARACTERISTIC
/begin CHARACTERISTIC Cxx_abs_vld_abst_frm_inc "Brake Control Unit : incrementation value for validated absent CAN failure counter." VALUE 0xa0020d71 _REC_S1VAL_20_u1 255. _CNV_A_R_ECME_LINEA_0_CM 0. 255. FORMAT "%3.0" /end CHARACTERISTIC
/begin CHARACTERISTIC Cxx_ac_abst_frm_dly "Climate Control Unit absence detection time-out" VALUE 0xa0020d72 _REC_S1VAL_20_u1 2.55 _CNV_A_R_LINEAR_____34_CM 0. 2.55 FORMAT "%4.2" /end CHARACTERISTIC
/begin CHARACTERISTIC Cxx_ac_ecu_conf "Climate Control Unit feature for Mux Network configuration detection (always present or optional)" VALUE 0xa0020d73 _REC_S1VAL_20_u1 255. _CNV_A_R_ECME_LINEA_0_CM 0. 255. FORMAT "%3.0" /end CHARACTERISTIC
/begin CHARACTERISTIC Cxx_ac_vld_abst_frm_dec "Climate Control Unit : decrementation value for validated absent CAN failure counter." VALUE 0xa0020d74 _REC_S1VAL_20_u1 255. _CNV_A_R_ECME_LINEA_0_CM 0. 255. FORMAT "%3.0" /end CHARACTERISTIC
/begin CHARACTERISTIC Cxx_ac_vld_abst_frm_inc "Climate Control Unit : incrementation value for validated absent CAN failure counter." VALUE 0xa0020d75 _REC_S1VAL_20_u1 255. _CNV_A_R_ECME_LINEA_0_CM 0. 255. FORMAT "%3.0" /end CHARACTERISTIC
/begin CHARACTERISTIC Cxx_acc_abst_frm_dly "Automatic Cruise Control Unit absence detection time-out" VALUE 0xa0020d76 _REC_S1VAL_20_u1 2.55 _CNV_A_R_LINEAR_____34_CM 0. 2.55 FORMAT "%4.2" /end CHARACTERISTIC
/begin CHARACTERISTIC Cxx_acc_ecu_conf "Automatic Cruise Control Unit feature for Mux Network config. detection (always present or optional)" VALUE 0xa0020d77 _REC_S1VAL_20_u1 255. _CNV_A_R_ECME_LINEA_0_CM 0. 255. FORMAT "%3.0" /end CHARACTERISTIC
/begin CHARACTERISTIC Cxx_acc_vld_abst_frm_dec "Automatic Cruise Control Unit : decrementation value for validated absent CAN failure counter." VALUE 0xa0020d78 _REC_S1VAL_20_u1 255. _CNV_A_R_ECME_LINEA_0_CM 0. 255. FORMAT "%3.0" /end CHARACTERISTIC
/begin CHARACTERISTIC Cxx_acc_vld_abst_frm_inc "Automatic Cruise Control Unit : incrementation value for validated absent CAN failure counter." VALUE 0xa0020d79 _REC_S1VAL_20_u1 255. _CNV_A_R_ECME_LINEA_0_CM 0. 255. FORMAT "%3.0" /end CHARACTERISTIC
/begin CHARACTERISTIC Cxx_agb_abst_frm_dly "Automatic Gear Box Control Unit absence detection time-out" VALUE 0xa0020d7a _REC_S1VAL_20_u1 2.55 _CNV_A_R_LINEAR_____34_CM 0. 2.55 FORMAT "%4.2" /end CHARACTERISTIC
/begin CHARACTERISTIC Cxx_agb_ecu_conf "Automatic Gear Box Control Unit feature for Mux configuration detection (always present or optional)" VALUE 0xa0020d7b _REC_S1VAL_20_u1 255. _CNV_A_R_ECME_LINEA_0_CM 0. 255. FORMAT "%3.0" /end CHARACTERISTIC
/begin CHARACTERISTIC Cxx_agb_vld_abst_frm_dec "Automatic Gear Box Control Unit : decrementation value for validated absent CAN failure counter." VALUE 0xa0020d7c _REC_S1VAL_20_u1 255. _CNV_A_R_ECME_LINEA_0_CM 0. 255. FORMAT "%3.0" /end CHARACTERISTIC
/begin CHARACTERISTIC Cxx_agb_vld_abst_frm_inc "Automatic Gear Box Control Unit : incrementation value for validated absent CAN failure counter." VALUE 0xa0020d7d _REC_S1VAL_20_u1 255. _CNV_A_R_ECME_LINEA_0_CM 0. 255. FORMAT "%3.0" /end CHARACTERISTIC
/begin CHARACTERISTIC Cxx_ccu_abst_frm_dly "BCM Control Unit absence detection time-out" VALUE 0xa0020d7e _REC_S1VAL_20_u1 2.55 _CNV_A_R_LINEAR_____34_CM 0. 2.55 FORMAT "%4.2" /end CHARACTERISTIC
/begin CHARACTERISTIC Cxx_ccu_ecu_conf "BCM Control Unit feature for Mux Network configuration detection (always present or optional)" VALUE 0xa0020d7f _REC_S1VAL_20_u1 255. _CNV_A_R_ECME_LINEA_0_CM 0. 255. FORMAT "%3.0" /end CHARACTERISTIC
/begin CHARACTERISTIC Cxx_ccu_vld_abst_frm_dec "BCM Control Unit : decrementation value for validated absent CAN failure counter." VALUE 0xa0020d80 _REC_S1VAL_20_u1 255. _CNV_A_R_ECME_LINEA_0_CM 0. 255. FORMAT "%3.0" /end CHARACTERISTIC
/begin CHARACTERISTIC Cxx_ccu_vld_abst_frm_inc "BCM Control Unit : incrementation value for validated absent CAN failure counter." VALUE 0xa0020d81 _REC_S1VAL_20_u1 255. _CNV_A_R_ECME_LINEA_0_CM 0. 255. FORMAT "%3.0" /end CHARACTERISTIC
/begin CHARACTERISTIC Cxx_ddcm_abst_frm_dly "DDCM Control Unit absence detection time-out" VALUE 0xa0020d82 _REC_S1VAL_20_u1 2.55 _CNV_A_R_LINEAR_____34_CM 0. 2.55 FORMAT "%4.2" /end CHARACTERISTIC
/begin CHARACTERISTIC Cxx_ddcm_ecu_conf "DDCM Control Unit feature for Mux configuration detection (always present or optional)" VALUE 0xa0020d83 _REC_S1VAL_20_u1 255. _CNV_A_R_ECME_LINEA_0_CM 0. 255. FORMAT "%3.0" /end CHARACTERISTIC
/begin CHARACTERISTIC Cxx_ddcm_vld_abst_frm_dec "DDCM Control Unit : decrementation value for validated absent CAN failure counter." VALUE 0xa0020d84 _REC_S1VAL_20_u1 255. _CNV_A_R_ECME_LINEA_0_CM 0. 255. FORMAT "%3.0" /end CHARACTERISTIC
/begin CHARACTERISTIC Cxx_ddcm_vld_abst_frm_inc "DDCM Control Unit : incrementation value for validated absent CAN failure counter." VALUE 0xa0020d85 _REC_S1VAL_20_u1 255. _CNV_A_R_ECME_LINEA_0_CM 0. 255. FORMAT "%3.0" /end CHARACTERISTIC
/begin CHARACTERISTIC Cxx_ecu_stt_ctr_dec "Decrement step of the non-volatile counters" VALUE 0xa0020d86 _REC_S1VAL_20_u1 255. _CNV_A_R_ECME_LINEA_0_CM 0. 255. FORMAT "%3.0" /end CHARACTERISTIC
/begin CHARACTERISTIC Cxx_ecu_stt_ctr_max "Maximum value of the non-volatile counters" VALUE 0xa0020d87 _REC_S1VAL_20_u1 255. _CNV_A_R_ECME_LINEA_0_CM 0. 255. FORMAT "%3.0" /end CHARACTERISTIC
/begin CHARACTERISTIC Cxx_ecu_stt_ctr_thd "Decrement threshold of the non volatile counters" VALUE 0xa0020d88 _REC_S1VAL_20_u1 255. _CNV_A_R_ECME_LINEA_0_CM 0. 255. FORMAT "%3.0" /end CHARACTERISTIC
/begin CHARACTERISTIC Cxx_ip_abst_frm_dly "Cluster Control Unit absence detection time-out" VALUE 0xa0020d89 _REC_S1VAL_20_u1 2.55 _CNV_A_R_LINEAR_____34_CM 0. 2.55 FORMAT "%4.2" /end CHARACTERISTIC
/begin CHARACTERISTIC Cxx_ip_ecu_conf "Cluster Control Unit feature for Mux Network configuration detection (always present or optional)" VALUE 0xa0020d8a _REC_S1VAL_20_u1 255. _CNV_A_R_ECME_LINEA_0_CM 0. 255. FORMAT "%3.0" /end CHARACTERISTIC
/begin CHARACTERISTIC Cxx_ip_vld_abst_frm_dec "Cluster Control Unit : decrementation value for validated absent CAN failure counter." VALUE 0xa0020d8b _REC_S1VAL_20_u1 255. _CNV_A_R_ECME_LINEA_0_CM 0. 255. FORMAT "%3.0" /end CHARACTERISTIC
/begin CHARACTERISTIC Cxx_ip_vld_abst_frm_inc "Cluster Control Unit : incrementation value for validated absent CAN failure counter." VALUE 0xa0020d8c _REC_S1VAL_20_u1 255. _CNV_A_R_ECME_LINEA_0_CM 0. 255. FORMAT "%3.0" /end CHARACTERISTIC
/begin CHARACTERISTIC Cxx_mute_abst_frm_dly "Mute (transmission failure) detection time-out" VALUE 0xa0020d8d _REC_S1VAL_20_u1 2.55 _CNV_A_R_LINEAR_____34_CM 0. 2.55 FORMAT "%4.2" /end CHARACTERISTIC
/begin CHARACTERISTIC Cxx_mute_ecu_conf "Mute (transmission failure detection) feature for Mux configuration detection (always present or opt" VALUE 0xa0020d8e _REC_S1VAL_20_u1 255. _CNV_A_R_ECME_LINEA_0_CM 0. 255. FORMAT "%3.0" /end CHARACTERISTIC
/begin CHARACTERISTIC Cxx_mute_vld_abst_frm_dec "Mute : decrementation value for validated absent CAN failure counter." VALUE 0xa0020d8f _REC_S1VAL_20_u1 255. _CNV_A_R_ECME_LINEA_0_CM 0. 255. FORMAT "%3.0" /end CHARACTERISTIC
/begin CHARACTERISTIC Cxx_mute_vld_abst_frm_inc "Mute : incrementation value for validated absent CAN failure counter." VALUE 0xa0020d90 _REC_S1VAL_20_u1 255. _CNV_A_R_ECME_LINEA_0_CM 0. 255. FORMAT "%3.0" /end CHARACTERISTIC
/begin CHARACTERISTIC Cxx_mux_diag_ena_dly "delay counter for data reception during initialization phase" VALUE 0xa0020d91 _REC_S1VAL_20_u1 25.5 _CNV_A_R_LINEAR_____4_CM 0. 25.5 FORMAT "%4.1" /end CHARACTERISTIC
/begin CHARACTERISTIC Cxx_mux_frm_set_ref "Mux messaging set reference" VALUE 0xa0020d6c _REC_S1VAL_20_u2 65535. _CNV_A_R_ECME_LINEA_0_CM 0. 65535. FORMAT "%5.0" /end CHARACTERISTIC
/begin CHARACTERISTIC Cxx_swa_abst_frm_dly "Steering Wheel Angle Control Unit absence detection time-out" VALUE 0xa0020d92 _REC_S1VAL_20_u1 2.55 _CNV_A_R_LINEAR_____34_CM 0. 2.55 FORMAT "%4.2" /end CHARACTERISTIC
/begin CHARACTERISTIC Cxx_swa_ecu_conf "Steering Wheel Angle Control Unit feature for Mux configuration detection (always present or opt.)" VALUE 0xa0020d93 _REC_S1VAL_20_u1 255. _CNV_A_R_ECME_LINEA_0_CM 0. 255. FORMAT "%3.0" /end CHARACTERISTIC
/begin CHARACTERISTIC Cxx_swa_vld_abst_frm_dec "Steering Wheel Angle Control Unit : decrementation value for validated absent CAN failure counter." VALUE 0xa0020d94 _REC_S1VAL_20_u1 255. _CNV_A_R_ECME_LINEA_0_CM 0. 255. FORMAT "%3.0" /end CHARACTERISTIC
/begin CHARACTERISTIC Cxx_swa_vld_abst_frm_inc "Steering Wheel Angle Control Unit : incrementation value for validated absent CAN failure counter." VALUE 0xa0020d95 _REC_S1VAL_20_u1 255. _CNV_A_R_ECME_LINEA_0_CM 0. 255. FORMAT "%3.0" /end CHARACTERISTIC
/begin CHARACTERISTIC Cxx_usm_abst_frm_dly "USM Control Unit absence detection time-out" VALUE 0xa0020d96 _REC_S1VAL_20_u1 2.55 _CNV_A_R_LINEAR_____34_CM 0. 2.55 FORMAT "%4.2" /end CHARACTERISTIC
/begin CHARACTERISTIC Cxx_usm_ecu_conf "USM Control Unit feature for Mux Network configuration detection (always present or optional)" VALUE 0xa0020d97 _REC_S1VAL_20_u1 255. _CNV_A_R_ECME_LINEA_0_CM 0. 255. FORMAT "%3.0" /end CHARACTERISTIC
/begin CHARACTERISTIC Cxx_usm_vld_abst_frm_dec "USM Control Unit : decrementation value for validated absent CAN failure counter." VALUE 0xa0020d98 _REC_S1VAL_20_u1 255. _CNV_A_R_ECME_LINEA_0_CM 0. 255. FORMAT "%3.0" /end CHARACTERISTIC
/begin CHARACTERISTIC Cxx_usm_vld_abst_frm_inc "USM Control Unit : incrementation value for validated absent CAN failure counter." VALUE 0xa0020d99 _REC_S1VAL_20_u1 255. _CNV_A_R_ECME_LINEA_0_CM 0. 255. FORMAT "%3.0" /end CHARACTERISTIC
/begin MEASUREMENT Vbx_mux_abs_reg "ABS in regulation received on the CAN" UBYTE _CNV_S_2_RANGE______3_CM 1 0. 0. 1. ECU_ADDRESS 0xd0005537 BIT_MASK 0x1 /end MEASUREMENT
/begin MEASUREMENT Vsx_mux_abs_reg_vld "ABS in regulation received on the CAN validity status" UBYTE _CNV_A_R_ECME_LINEA_0_CM 1 0. 0. 1. ECU_ADDRESS 0xd0005538 FORMAT "%1.0" /end MEASUREMENT
/begin MEASUREMENT ComputedOilDrainingRange "Transmitted CAN parameter" UWORD _CNV_A_R_ECME_LINEA_0_CM 1 0. 0. 65535. ECU_ADDRESS 0xd0005b10 FORMAT "%5.0" /end MEASUREMENT
/begin MEASUREMENT ECM_MechanicalLoadRequest "Transmitted CAN parameter" UBYTE _CNV_A_R_ECME_LINEA_0_CM 1 0. 0. 1. ECU_ADDRESS 0xd00056a5 FORMAT "%1.0" /end MEASUREMENT
/begin MEASUREMENT WarningWaterTemp "Transmitted CAN parameter" UBYTE _CNV_A_R_ECME_LINEA_0_CM 1 0. 0. 1. ECU_ADDRESS 0xd000570c FORMAT "%1.0" BIT_MASK 0x1 /end MEASUREMENT
/begin MEASUREMENT DownTransitionOfEngCoolantTemp "Transmitted CAN parameter" UBYTE _CNV_A_R_ECME_LINEA_0_CM 1 0. 0. 1. ECU_ADDRESS 0xd00055ab FORMAT "%1.0" /end MEASUREMENT
/begin MEASUREMENT EngineCoolantRegulationTemp "Transmitted CAN parameter" UBYTE _CNV_A_R_ECME_LINEA_0_CM 1 0. 0. 7. ECU_ADDRESS 0xd00055ac FORMAT "%1.0" /end MEASUREMENT
/begin MEASUREMENT EngineCoolantTemp "Transmitted CAN parameter" UBYTE _CNV_A_R_ECME_LINEA_0_CM 1 0. 0. 255. ECU_ADDRESS 0xd00055c6 FORMAT "%3.0" /end MEASUREMENT
/begin MEASUREMENT MILLamp "Transmitted CAN parameter" UBYTE _CNV_A_R_ECME_LINEA_0_CM 1 0. 0. 15. ECU_ADDRESS 0xd00056b8 FORMAT "%2.0" /end MEASUREMENT
/begin MEASUREMENT EngineControlFailureLevel1 "Transmitted CAN parameter" UBYTE _CNV_A_R_ECME_LINEA_0_CM 1 0. 0. 1. ECU_ADDRESS 0xd00055df FORMAT "%1.0" /end MEASUREMENT
/begin MEASUREMENT EngineControlFailureLevel2 "Transmitted CAN parameter" UBYTE _CNV_A_R_ECME_LINEA_0_CM 1 0. 0. 1. ECU_ADDRESS 0xd0005339 FORMAT "%1.0" /end MEASUREMENT
/begin MEASUREMENT FuelConsumption "Transmitted CAN parameter" UBYTE _CNV_A_R_ECME_LINEA_0_CM 1 0. 0. 255. ECU_ADDRESS 0xd00054fc FORMAT "%3.0" /end MEASUREMENT
/begin MEASUREMENT NominalFuelConsumption "Transmitted CAN parameter" UBYTE _CNV_A_R_ECME_LINEA_0_CM 1 0. 0. 255. ECU_ADDRESS 0xd00054fd FORMAT "%3.0" /end MEASUREMENT
/begin MEASUREMENT Vbx_mux_vh_dist_navl "indicates that total vehicle distance is unavailable" UBYTE _CNV_S_2_RANGE______3_CM 1 0. 0. 1. ECU_ADDRESS 0xd00056ac BIT_MASK 0x1 /end MEASUREMENT
/begin MEASUREMENT Vsx_mux_vh_dist_vld "Total vehicle distance received on the CAN validity status" UBYTE _CNV_S_3_STATUS_OK__120_CM 1 0. 0. 2. ECU_ADDRESS 0xd00056ad /end MEASUREMENT
/begin MEASUREMENT Vxx_mux_vh_dist "Total vehicle distance received on the CAN" ULONG _CNV_A_R_LINEAR_____218_CM 1 0. 0. 16777215. ECU_ADDRESS 0xd0002738 FORMAT "%8.0" /end MEASUREMENT
/begin MEASUREMENT Vbx_mil_gcu_req "MIL activation request of lpg control unit" UBYTE _CNV_S_2_RANGE______3_CM 1 0. 0. 1. ECU_ADDRESS 0xd0005200 BIT_MASK 0x1 /end MEASUREMENT
/begin MEASUREMENT Vbx_mux_bdu_ope "boolean that indicates BDU opening" UBYTE _CNV_S_2_RANGE______3_CM 1 0. 0. 1. ECU_ADDRESS 0xd0004abf BIT_MASK 0x1 /end MEASUREMENT
/begin MEASUREMENT Vbx_mux_bdu_ope_navl "Indicates that the boolean which indicates BDU opening is unavailable" UBYTE _CNV_S_2_RANGE______3_CM 1 0. 0. 1. ECU_ADDRESS 0xd0004ac0 BIT_MASK 0x1 /end MEASUREMENT
/begin MEASUREMENT Vsx_mux_bdu_ope_vld "BDU open information validity status" UBYTE _CNV_S_3_STATUS_OK__120_CM 1 0. 0. 2. ECU_ADDRESS 0xd0004ac1 /end MEASUREMENT
/begin MEASUREMENT DieselFilterWaterDetection "Transmitted CAN parameter" UBYTE _CNV_A_R_ECME_LINEA_0_CM 1 0. 0. 1. ECU_ADDRESS 0xd00050b8 FORMAT "%1.0" /end MEASUREMENT
/begin MEASUREMENT DieselPreHeating "Transmitted CAN parameter" UBYTE _CNV_A_R_ECME_LINEA_0_CM 1 0. 0. 1. ECU_ADDRESS 0xd00050b9 FORMAT "%1.0" /end MEASUREMENT
/begin MEASUREMENT Vbx_mil_tcu_req "MIL activation request of transmission control unit" UBYTE _CNV_S_2_RANGE______3_CM 1 0. 0. 1. ECU_ADDRESS 0xd0004b78 BIT_MASK 0x1 /end MEASUREMENT
/begin MEASUREMENT Vbx_mux_mil_tcu_req "MIL activation request of transmission control unit received on the CAN" UBYTE _CNV_S_2_RANGE______3_CM 1 0. 0. 1. ECU_ADDRESS 0xd0004b79 BIT_MASK 0x1 /end MEASUREMENT
/begin MEASUREMENT Vbx_frm_min_fuel "First CAN frame received" UBYTE _CNV_S_2_RANGE______3_CM 1 0. 0. 1. ECU_ADDRESS 0xd0005505 BIT_MASK 0x1 /end MEASUREMENT
/begin MEASUREMENT Vbx_min_fuel_navl "Minimum level of fuel level from DiagnoseFuelLow is not available" UBYTE _CNV_S_2_RANGE______3_CM 1 0. 0. 1. ECU_ADDRESS 0xd0005506 BIT_MASK 0x1 /end MEASUREMENT
/begin MEASUREMENT Vbx_mux_min_fuel_raw "Raw low level of fuel received on the CAN" UBYTE _CNV_S_2_RANGE______3_CM 1 0. 0. 1. ECU_ADDRESS 0xd0005507 BIT_MASK 0x1 /end MEASUREMENT
/begin MEASUREMENT Vsx_mux_fuel_lvl_vld "Petrol tank reserve received on the CAN validity status" UBYTE _CNV_S_8_STATUS_OK__181_CM 1 0. 0. 7. ECU_ADDRESS 0xd0005508 /end MEASUREMENT
/begin MEASUREMENT Vsx_mux_min_fuel_raw_vld "Raw low level of fuel received on the CAN validity status" UBYTE _CNV_S_3_STATUS_OK__120_CM 1 0. 0. 2. ECU_ADDRESS 0xd0005509 /end MEASUREMENT
/begin MEASUREMENT Vxx_mux_fuel_lvl "Petrol tank reserve received on the CAN" UBYTE _CNV_A_R_LINEAR_____215_CM 1 0. 0. 80. ECU_ADDRESS 0xd000550a FORMAT "%3.0" /end MEASUREMENT
/begin CHARACTERISTIC Cbx_diag_fuel_pres_cfm "DiagnoseFuelLow information is provided by CAN" VALUE 0xa0020834 _REC_S1VAL_20_u1 1. _CNV_S_2_RANGE______3_CM 0. 1. BIT_MASK 0x1 /end CHARACTERISTIC
/begin MEASUREMENT Vbx_owe_mnl_ini_req_mux "Input from the can to initialise the strategy as \"customer init\"" UBYTE _CNV_S_2_RANGE______3_CM 1 0. 0. 1. ECU_ADDRESS 0xd0005606 BIT_MASK 0x1 /end MEASUREMENT
/begin AXIS_PTS Ctb_toil "engine oil temperature breakpoints" 0xa002a6d8 Vxx_toil _REC_A2AXS_20_u2 240. _CNV_A_R_LINEAR_____54_CM 16 -40. 200. FORMAT "%5.1" /end AXIS_PTS
/begin COMPU_METHOD _CNV_A_R_ECME_LINEA_0_CM "" RAT_FUNC "%6.3" "-" COEFFS 0 1. 0. 0 0 1 /end COMPU_METHOD
/begin COMPU_METHOD _CNV_A_R_LINEAR_____2_CM "" RAT_FUNC "%6.3" "rpm" COEFFS 0 3.125e-002 0. 0 0 1 /end COMPU_METHOD
/begin COMPU_METHOD _CNV_S_2_RANGE______3_CM "" TAB_VERB "%6.3" "-" COMPU_TAB_REF _CNV_S_2_RANGE______3 /end COMPU_METHOD
/begin COMPU_VTAB _CNV_S_2_RANGE______3 "" TAB_VERB 2 0 "0" 1 "1" /end COMPU_VTAB
/begin COMPU_METHOD _CNV_A_R_LINEAR_____4_CM "" RAT_FUNC "%6.3" "s" COEFFS 0 10. 0. 0 0 1 /end COMPU_METHOD
/begin COMPU_METHOD _CNV_A_R_LINEAR_____16_CM "" RAT_FUNC "%6.3" "V" COEFFS 0 6553.599999999993 0. 0 0 1 /end COMPU_METHOD
/begin COMPU_METHOD _CNV_A_R_ENSD_LINEA_24_CM "" RAT_FUNC "%6.3" "rpm" COEFFS 0 4. 0. 0 0 1 /end COMPU_METHOD
/begin COMPU_METHOD _CNV_A_R_LINEAR_____25_CM "" RAT_FUNC "%6.3" "∞CRK" COEFFS 0 2.666666666666667 0. 0 0 1 /end COMPU_METHOD
/begin COMPU_METHOD _CNV_A_R_LINEAR_____31_CM "" RAT_FUNC "%6.3" "-" COEFFS 0 256. 0. 0 0 1 /end COMPU_METHOD
/begin COMPU_METHOD _CNV_A_R_LINEAR_____34_CM "" RAT_FUNC "%6.3" "s" COEFFS 0 100. 0. 0 0 1 /end COMPU_METHOD
/begin COMPU_METHOD _CNV_A_R_LINEAR_____42_CM "" RAT_FUNC "%6.3" "∞C" COEFFS 0 1.333333333333333 64. 0 0 1 /end COMPU_METHOD
/begin COMPU_METHOD _CNV_A_R_LINEAR_____43_CM "" RAT_FUNC "%6.3" "-" COEFFS 0 128. 0. 0 0 1 /end COMPU_METHOD
/begin COMPU_METHOD _CNV_A_R_LINEAR_____52_CM "" RAT_FUNC "%6.3" "mV" COEFFS 0 1. 0. 0 0 1 /end COMPU_METHOD
/begin COMPU_METHOD _CNV_A_R_LINEAR_____53_CM "" RAT_FUNC "%6.3" "-" COEFFS 0 16384. 0. 0 0 1 /end COMPU_METHOD
/begin COMPU_METHOD _CNV_A_R_LINEAR_____54_CM "" RAT_FUNC "%6.3" "∞C" COEFFS 0 10. 400. 0 0 1 /end COMPU_METHOD
/begin COMPU_METHOD _CNV_A_R_LINEAR_____55_CM "" RAT_FUNC "%6.3" "TDC" COEFFS 0 1. 0. 0 0 1 /end COMPU_METHOD
/begin COMPU_METHOD _CNV_A_R_LINEAR_____58_CM "" RAT_FUNC "%6.3" "s" COEFFS 0 1000. 0. 0 0 1 /end COMPU_METHOD
/begin COMPU_METHOD _CNV_A_R_LINEAR_____70_CM "" RAT_FUNC "%6.3" "km/h" COEFFS 0 100. 0. 0 0 1 /end COMPU_METHOD
/begin COMPU_METHOD _CNV_A_R_LINEAR_____99_CM "" RAT_FUNC "%6.3" "%" COEFFS 0 20. 0. 0 0 1 /end COMPU_METHOD
/begin COMPU_METHOD _CNV_A_R_LINEAR_____113_CM "" RAT_FUNC "%6.3" "-" COEFFS 0 1. 1. 0 0 1 /end COMPU_METHOD
/begin COMPU_METHOD _CNV_A_R_LINEAR_____114_CM "" RAT_FUNC "%6.3" "%" COEFFS 0 2.55 0. 0 0 1 /end COMPU_METHOD
/begin COMPU_METHOD _CNV_S_3_STATUS_OK__120_CM "" TAB_VERB "%6.3" "-" COMPU_TAB_REF _CNV_S_3_STATUS_OK__120 /end COMPU_METHOD
/begin COMPU_VTAB _CNV_S_3_STATUS_OK__120 "" TAB_VERB 3 0 "Nsx_vld_nok_0" 1 "Nsx_vld_ok_1" 2 "Nsx_vld_fail_2" /end COMPU_VTAB
/begin COMPU_METHOD _CNV_S_4_STATUS_OK__121_CM "" TAB_VERB "%6.3" "-" COMPU_TAB_REF _CNV_S_4_STATUS_OK__121 /end COMPU_METHOD
/begin COMPU_VTAB _CNV_S_4_STATUS_OK__121 "" TAB_VERB 4 0 "Nsx_vld_nok_0" 1 "Nsx_vld_ok_1" 2 "Nsx_vld_fail_2" 3 "Nsx_vld_fail_3" /end COMPU_VTAB
/begin COMPU_METHOD _CNV_A_R_LINEAR_____123_CM "" RAT_FUNC "%6.3" "Nm" COEFFS 0 32. 0. 0 0 1 /end COMPU_METHOD
/begin COMPU_METHOD _CNV_A_R_LINEAR_____136_CM "" RAT_FUNC "%6.3" "-" COEFFS 0 100. 0. 0 0 1 /end COMPU_METHOD
/begin COMPU_METHOD _CNV_A_R_LINEAR_____140_CM "" RAT_FUNC "%6.3" "(km/h)/K*rpm" COEFFS 0 100. 1000. 0 0 1 /end COMPU_METHOD
/begin COMPU_METHOD _CNV_A_R_LINEAR_____150_CM "" RAT_FUNC "%6.3" "V" COEFFS 0 100. 0. 0 0 1 /end COMPU_METHOD
/begin COMPU_METHOD _CNV_S_3_STATUS_OK__158_CM "" TAB_VERB "%6.3" "" COMPU_TAB_REF _CNV_S_3_STATUS_OK__158 /end COMPU_METHOD
/begin COMPU_VTAB _CNV_S_3_STATUS_OK__158 "" TAB_VERB 3 0 "Nsx_vld_nok_0" 1 "Nsx_vld_ok_1" 2 "Nsx_vld_fail_2" /end COMPU_VTAB
/begin COMPU_METHOD _CNV_A_R_A_165_CM "" RAT_FUNC "%6.3" "" COEFFS 0 1. 0. 0 0 1 /end COMPU_METHOD
/begin COMPU_METHOD _CNV_A_R_LINEAR_____175_CM "" RAT_FUNC "%6.3" "-" COEFFS 0 64. 0. 0 0 1 /end COMPU_METHOD
/begin COMPU_METHOD _CNV_S_8_STATUS_OK__181_CM "" TAB_VERB "%6.3" "-" COMPU_TAB_REF _CNV_S_8_STATUS_OK__181 /end COMPU_METHOD
/begin COMPU_VTAB _CNV_S_8_STATUS_OK__181 "" TAB_VERB 8 0 "Nsx_vld_nok_0" 1 "Nsx_vld_ok_1" 2 "Nsx_vld_fail_2" 3 "Nsx_vld_fail_3" 4 "Nsx_vld_fail_4" 5 "Nsx_vld_fail_5" 6 "Nsx_vld_fail_6" 7 "Nsx_vld_fail_7" /end COMPU_VTAB
/begin COMPU_METHOD _CNV_A_R_LINEAR_____212_CM "" RAT_FUNC "%6.3" "km/h" COEFFS 0 1. 0. 0 0 1 /end COMPU_METHOD
/begin COMPU_METHOD _CNV_A_R_LINEAR_____215_CM "" RAT_FUNC "%6.3" "l" COEFFS 0 1. 0. 0 0 1 /end COMPU_METHOD
/begin COMPU_METHOD _CNV_A_R_LINEAR_____218_CM "" RAT_FUNC "%6.3" "km" COEFFS 0 1. 0. 0 0 1 /end COMPU_METHOD
/begin COMPU_METHOD _CNV_A_R_LINEAR_____281_CM "" RAT_FUNC "%6.3" "mg/stk" COEFFS 0 0.183585313174946 0. 0 0 1 /end COMPU_METHOD
/begin COMPU_METHOD _CNV_A_R_LINEAR_____331_CM "" RAT_FUNC "%6.3" "(km/h)/K*rpm" COEFFS 0 100. 0. 0 0 1 /end COMPU_METHOD
/begin COMPU_METHOD _CNV_A_R_LINEAR_____381_CM "" RAT_FUNC "%6.3" "Nm/(rpm/s)" COEFFS 0 32767.99999999992 65535. 0 0 1 /end COMPU_METHOD
/begin COMPU_METHOD _CNV_A_R_LINEAR_____382_CM "" RAT_FUNC "%6.3" "rpm/s" COEFFS 0 4. 0. 0 0 1 /end COMPU_METHOD
/begin COMPU_METHOD _CNV_A_R_LINEAR_____383_CM "" RAT_FUNC "%6.3" "Nm/s" COEFFS 0 1.28 0. 0 0 1 /end COMPU_METHOD
/begin COMPU_METHOD _CNV_S_3_STATUS_ANT_387_CM "" TAB_VERB "%6.3" "-" COMPU_TAB_REF _CNV_S_3_STATUS_ANT_387 /end COMPU_METHOD
/begin COMPU_VTAB _CNV_S_3_STATUS_ANT_387 "" TAB_VERB 3 1 "Nsx_ant_neut" 2 "Nsx_ant_drag_red_agb" 3 "Nsx_ant_driv" /end COMPU_VTAB
/begin COMPU_METHOD _CNV_S_3_CNT_INDICA_388_CM "" TAB_VERB "%6.3" "" COMPU_TAB_REF _CNV_S_3_CNT_INDICA_388 /end COMPU_METHOD
/begin COMPU_VTAB _CNV_S_3_CNT_INDICA_388 "" TAB_VERB 3 0 "Nsx_cnt_off" 1 "Nsx_cnt_on" 2 "Nsx_no_cnt" /end COMPU_VTAB
/begin COMPU_METHOD _CNV_S_3_RANGE_STAT_389_CM "" TAB_VERB "%6.3" "" COMPU_TAB_REF _CNV_S_3_RANGE_STAT_389 /end COMPU_METHOD
/begin COMPU_VTAB _CNV_S_3_RANGE_STAT_389 "" TAB_VERB 3 1 "Nsx_coup_clos" 2 "Nsx_coup_sli" 8 "Nsx_coup_open" /end COMPU_VTAB
/begin COMPU_METHOD _CNV_A_R_KNCK_LINEA_390_CM "" RAT_FUNC "%6.3" "" COEFFS 0 32. 0. 0 0 1 /end COMPU_METHOD
/begin COMPU_METHOD _CNV_A_R_KNCK_LINEA_391_CM "Battery voltage" RAT_FUNC "%6.3" "V" COEFFS 0 50. 128. 0 0 1 /end COMPU_METHOD
/begin COMPU_METHOD _CNV_A_R_KNCK_LINEA_392_CM "" RAT_FUNC "%6.3" "V" COEFFS 0 13107.19998965744 0. 0 0 1 /end COMPU_METHOD
/begin COMPU_METHOD _CNV_A_R_KNCK_LINEA_393_CM "" RAT_FUNC "%6.3" "V" COEFFS 0 51.2 0. 0 0 1 /end COMPU_METHOD
/begin COMPU_METHOD _CNV_A_R_KNCK_LINEA_394_CM "" RAT_FUNC "%6.3" "V" COEFFS 0 13107.19998965744 -2.58563959505409e-005 0 0 1 /end COMPU_METHOD
/begin COMPU_METHOD _CNV_A_R_LINEAR_____395_CM "" RAT_FUNC "%6.3" "mg/stk" COEFFS 0 47.18142548596112 -1.455191522836685e-011 0 0 1 /end COMPU_METHOD
/begin COMPU_METHOD _CNV_A_R_LINEAR_____396_CM "" RAT_FUNC "%6.3" "m" COEFFS 0 1. 0. 0 0 1 /end COMPU_METHOD
/begin COMPU_METHOD _CNV_A_R_LINEAR_____397_CM "" RAT_FUNC "%6.3" "trs" COEFFS 0 1. 0. 0 0 1 /end COMPU_METHOD
/begin COMPU_METHOD _CNV_S_3_STATUS_CAN_398_CM "" TAB_VERB "%6.3" "" COMPU_TAB_REF _CNV_S_3_STATUS_CAN_398 /end COMPU_METHOD
/begin COMPU_VTAB _CNV_S_3_STATUS_CAN_398 "" TAB_VERB 3 0 "Nsx_pres" 1 "Nsx_abst" 2 "Nsx_vld_abst" /end COMPU_VTAB
/begin RECORD_LAYOUT _REC_S1VAL_20_u4 FNC_VALUES 1 ULONG COLUMN_DIR DIRECT /end RECORD_LAYOUT
/begin RECORD_LAYOUT _REC_S1VAL_20_u1 FNC_VALUES 1 UBYTE COLUMN_DIR DIRECT /end RECORD_LAYOUT
/begin RECORD_LAYOUT _REC_A2AXS_20_u1 NO_AXIS_PTS_X 1 UBYTE AXIS_PTS_X 2 UBYTE INDEX_INCR DIRECT /end RECORD_LAYOUT
/begin RECORD_LAYOUT _REC_S1VAL_20_u2 FNC_VALUES 1 UWORD COLUMN_DIR DIRECT /end RECORD_LAYOUT
/begin RECORD_LAYOUT _REC_S1VAL_20_s2 FNC_VALUES 1 SWORD COLUMN_DIR DIRECT /end RECORD_LAYOUT
/begin RECORD_LAYOUT _REC_A2AXS_20_u2 NO_AXIS_PTS_X 1 UWORD AXIS_PTS_X 2 UWORD INDEX_INCR DIRECT /end RECORD_LAYOUT
/begin RECORD_LAYOUT _REC_A1CUR_20_u1_u1 FNC_VALUES 1 UBYTE COLUMN_DIR DIRECT /end RECORD_LAYOUT
/begin RECORD_LAYOUT _REC_A1CUR_20_u2_u1 FNC_VALUES 1 UWORD COLUMN_DIR DIRECT /end RECORD_LAYOUT
/begin RECORD_LAYOUT _REC_A1MAP_20_u1_u1_u1 FNC_VALUES 1 UBYTE COLUMN_DIR DIRECT /end RECORD_LAYOUT
/begin RECORD_LAYOUT _REC_A1MAP_20_u2_u2_u2 FNC_VALUES 1 UWORD COLUMN_DIR DIRECT /end RECORD_LAYOUT
/begin RECORD_LAYOUT _REC_A1CUR_20_u2_u2 FNC_VALUES 1 UWORD COLUMN_DIR DIRECT /end RECORD_LAYOUT
/begin RECORD_LAYOUT _REC_S1VAL_20_s1 FNC_VALUES 1 SBYTE COLUMN_DIR DIRECT /end RECORD_LAYOUT
/begin RECORD_LAYOUT _REC_A1CUR_20_s2_u1 FNC_VALUES 1 SWORD COLUMN_DIR DIRECT /end RECORD_LAYOUT
/begin FUNCTION InPciAgb_Attqxco ""
 /begin DEF_CHARACTERISTIC Ctb_agb_tq_csm_is_n_sp Cmp_agb_csm_tq_brk_pdl_cor Cmp_agb_csm_tq_drag_red_cor Cmp_agb_csm_tq_neut_dri_cor Ctp_agb_csm_brk_pdl_dly_cor Ctp_agb_csm_drag_red_dly_cor Ctp_agb_csm_neut_dri_dly_cor Ctp_agb_tq_stop_max_cor Ctp_agb_tq_stop_min_cor Ctp_agb_tq_stop_prim_drv_fac Ctp_egb_neut_dri_dly_cor Ctp_egb_neut_rvr_dly_cor Cbx_agb_csm_tq_cor_ad Cxx_agb_csm_tq_neut_rvr_fac Cxx_agb_tq_brk_pdl_cor_slop Cxx_agb_tq_brk_pdl_n_hys Cxx_agb_tq_brk_pdl_n_thd Cxx_agb_tq_brk_pdl_tco_thd Cxx_agb_tq_drag_red_cor_slop Cxx_agb_tq_neut_dri_cor_slop Cxx_agb_tq_stop_cor_slop Cxx_agb_tq_stop_dly_cor Cxx_agb_tq_stop_n_hys Cxx_agb_tq_stop_n_thd Cxx_agb_tq_stop_prim_drv_thd Cxx_agb_tq_stop_prim_max_ofs Cxx_agb_tq_stop_prim_min_ofs Cxx_agb_tq_stop_vs_thd Cxx_prim_sha_spd_drv_ftc Cxx_prim_sha_spd_drv_thd /end DEF_CHARACTERISTIC
 /begin OUT_MEASUREMENT Vbx_agb_tq_brk_pdl Vbx_agb_tq_brk_pdl_cor_act Vbx_agb_tq_drag_red_cor_act Vbx_agb_tq_is_vs_cdn_cor Vbx_agb_tq_neut_dri_cor_act Vbx_agb_tq_stop_cor_act Vbx_n_egb_neut Vbx_n_egb_neut_dly Vxx_agb_csm_tq_brk_pdl_cor Vxx_agb_csm_tq_brk_pdl_cor_1 Vxx_agb_csm_tq_cor Vxx_agb_csm_tq_drag_red_cor Vxx_agb_csm_tq_drag_red_cor_1 Vxx_agb_csm_tq_neut_cor Vxx_agb_csm_tq_neut_cor_1 Vxx_agb_tq_stop_cor Vxx_agb_tq_stop_cor_1 Vxx_prim_sha_spd_drv Vxx_prim_sha_spd_drv_mv /end OUT_MEASUREMENT
/end FUNCTION
/begin FUNCTION InPciAgb_Antxxcs "" /begin DEF_CHARACTERISTIC Cbx_ant_crt_slc_pres_cfm /end DEF_CHARACTERISTIC /begin OUT_MEASUREMENT Vsx_ant_crt_slc Vsx_ant_crt_slc_vld /end OUT_MEASUREMENT /end FUNCTION
/begin FUNCTION InPciAgb_Tbspdcs "" /begin OUT_MEASUREMENT Vsx_prim_sha_spd_vld Vxx_prim_sha_spd /end OUT_MEASUREMENT /end FUNCTION
/begin FUNCTION DgDgtRpg "" /begin SUB_FUNCTION DgDgtRpg_Mngerxx_xxxxxx /end SUB_FUNCTION /end FUNCTION
/begin FUNCTION DgDgtRpg_Mngerxx_xxxxxx ""
 /begin OUT_MEASUREMENT Vbx_prg_appl_key_stt Vbx_prg_req Vxx_prg_appl_key Vxx_prg_ecm_stt /end OUT_MEASUREMENT
/end FUNCTION
/begin FUNCTION BiVfiAci "" /begin OUT_MEASUREMENT Vxx_raw_ac_prs v_acp /end OUT_MEASUREMENT /end FUNCTION
/begin FUNCTION InPciDls ""
 /begin OUT_MEASUREMENT Vbx_sens_bgin_clu_cnt_lk_stt Vxx_bgin_clu_off_no_chr_ctr_NVM Vxx_bgin_clu_on_no_chr_ctr_NVM /end OUT_MEASUREMENT
 /begin SUB_FUNCTION InPciDls_Clexxcs_xxxxxx InPciDls_Cnrvncs_xxxxxx InPciDls_Dlsttxx_xxxxxx InPciDls_Ratioxx_xxxxxx InPciDls_Rgearxx_xxxxxx InPciDls_Seclcxx_xxxxxx InPciDls_Tmdlsxx_xxxxxx InPciDls_Attcscs_xxxxxx InPciDls_Attrecs_xxxxxx InPciDls_Tadlsxx_xxxxxx InPciDls_Clb2xcs_xxxxxx InPciDls_Clbmucs_xxxxxx InPciDls_Clbsrcs_xxxxxx InPciDls_Clbxxsr_xxxxxx InPciDls_Clbdgxx_xxxxxx /end SUB_FUNCTION
/end FUNCTION
/begin FUNCTION InPciDls_Clexxcs_xxxxxx "" /begin OUT_MEASUREMENT Vsx_end_str_clu_cnt /end OUT_MEASUREMENT /end FUNCTION
/begin FUNCTION InPciDls_Cnrvncs_xxxxxx "" /begin OUT_MEASUREMENT Vsx_neut_cnt Vsx_rvr_cnt /end OUT_MEASUREMENT /end FUNCTION
/begin FUNCTION InPciDls_Dlsttxx_xxxxxx "" /begin DEF_CHARACTERISTIC Ctb_coup Ntb_coup Ntb_gear Csx_dlin_conf /end DEF_CHARACTERISTIC
 /begin OUT_MEASUREMENT Vsx_ant_coup_vld Vsx_ant_gear Vsx_ant_gear_vld Vsx_coup_vld Vsx_dlin_conf Vsx_gear Vsx_gear_vld Vxx_ant_coup Vxx_ant_gear Vxx_coup Vxx_gear /end OUT_MEASUREMENT
/end FUNCTION
/begin FUNCTION InPciDls_Ratioxx_xxxxxx ""
 /begin DEF_CHARACTERISTIC Cxx_down_bkp_vs_neut Cxx_vs_n_rat_dft_max Cxx_vs_n_rat_dft_min Cxx_vs_n_rat_fil_fac1 Cxx_vs_n_rat_fil_fac2 Cxx_vs_n_rat_min_n_bkp /end DEF_CHARACTERISTIC
 /begin OUT_MEASUREMENT Vbx_run_vh Vsx_run_vh_vld Vsx_vs_n_rat_fil_vld Vxx_vs_n_rat Vxx_vs_n_rat_fil /end OUT_MEASUREMENT
/end FUNCTION
/begin FUNCTION InPciDls_Rgearxx_xxxxxx ""
 /begin DEF_CHARACTERISTIC Cbx_no_ant_gear_fil_cfm Cxx_1_gear_rat_tgt Cxx_2_gear_rat_tgt Cxx_3_gear_rat_tgt Cxx_4_gear_rat_tgt Cxx_5_gear_rat_tgt Cxx_6_gear_rat_tgt Cxx_h_gear_win_thd Cxx_l_gear_max Cxx_l_gear_win_thd Cxx_max_vs_n_rat Cxx_min_vs_n_rat Cxx_neut_gear_rat_tgt Cxx_vs_n_rat_ant_gear_ftc1 Cxx_vs_n_rat_ant_gear_ftc2 /end DEF_CHARACTERISTIC
 /begin OUT_MEASUREMENT Vsx_ant_rat_gear Vsx_rat_gear Vtx_gear_rat_tgt[0] Vtx_gear_rat_tgt[1] Vtx_gear_rat_tgt[2] Vtx_gear_rat_tgt[3] Vtx_gear_rat_tgt[4] Vtx_gear_rat_tgt[5] Vtx_gear_rat_tgt[6] Vxx_down_rat_gear_bkp_tgt Vxx_mv_1_2_gear_rat_tgt Vxx_mv_2_3_gear_rat_tgt Vxx_mv_3_4_gear_rat_tgt Vxx_mv_4_5_gear_rat_tgt Vxx_mv_5_6_gear_rat_tgt Vxx_rat_tgt Vxx_up_rat_gear_bkp_tgt /end OUT_MEASUREMENT
/end FUNCTION
/begin FUNCTION InPciDls_Seclcxx_xxxxxx ""
 /begin DEF_CHARACTERISTIC Cxx_dfdec_clu_cnt_nok Cxx_dfinc_clu_cnt_nok Cxx_dly_chr_bgin_end_clu_cnt /end DEF_CHARACTERISTIC
 /begin OUT_MEASUREMENT Vbx_bgin_clu_cnt_ena Vbx_bgin_clu_cnt_on Vbx_end_clu_cnt_on /end OUT_MEASUREMENT
/end FUNCTION
/begin FUNCTION InPciDls_Tmdlsxx_xxxxxx ""
 /begin DEF_CHARACTERISTIC Cbx_ant_coup_clos_clc_cfm Cbx_bgin_clu_fail_cfm Cbx_ovn_n_clu_det_cfm Cxx_dly_clu_pdl_use_rtn Cxx_dly_neut_gear_act Cxx_dly_neut_gear_cnt Cxx_dly_pdl_rls Cxx_ovn_n_clu_det_dly Cxx_ovn_n_clu_det_thd Cxx_ovn_n_dif_clu_det_thd Cxx_rat_gear_stab_dly Cxx_vs_vh_max Cxx_vs_vh_min /end DEF_CHARACTERISTIC
 /begin OUT_MEASUREMENT Vbx_bgin_clu_pdl_on Vbx_gear_stab Vbx_neut_gear_act Vbx_neut_psn Vbx_ovn_ant_coup Vbx_pdl_use_rtn Vsx_bgin_clu_nok_mgb_ant_coup Vsx_bgin_clu_nok_mgb_coup Vsx_bgin_clu_nok_mgb_coup_vld Vsx_bgin_clu_ok_mgb_ant_coup Vsx_bgin_clu_ok_mgb_coup Vsx_bgin_clu_ok_mgb_coup_vld Vsx_mgb_ant_coup Vsx_mgb_ant_gear Vsx_mgb_coup Vsx_mgb_coup_vld Vsx_mgb_gear Vsx_mgb_gear_vld Vsx_rat_gear_stab /end OUT_MEASUREMENT
/end FUNCTION
/begin FUNCTION InPciDls_Attcscs_xxxxxx ""
 /begin OUT_MEASUREMENT Vsx_agb_coup Vsx_agb_coup_vld Vsx_rgb_coup Vsx_rgb_coup_vld /end OUT_MEASUREMENT
/end FUNCTION
/begin FUNCTION InPciDls_Attrecs_xxxxxx ""
 /begin OUT_MEASUREMENT Vbx_drag_red_agb Vbx_egb_neut Vsx_agb_vld Vsx_drag_red_agb_vld Vsx_egb_neut_vld Vsx_raw_egb_ant_gear Vsx_raw_egb_ant_gear_vld Vsx_raw_egb_gear Vsx_raw_egb_gear_vld /end OUT_MEASUREMENT
/end FUNCTION
/begin FUNCTION InPciDls_Tadlsxx_xxxxxx "" /begin DEF_CHARACTERISTIC Csx_lih_egb_gear Cxx_dly_coup_fail Cxx_dly_gear_fail /end DEF_CHARACTERISTIC
 /begin OUT_MEASUREMENT Vsx_egb_ant_coup Vsx_egb_ant_coup_vld Vsx_egb_ant_gear Vsx_egb_ant_gear_vld Vsx_egb_coup Vsx_egb_coup_vld Vsx_egb_gear Vsx_egb_gear_vld /end OUT_MEASUREMENT
/end FUNCTION
/begin FUNCTION InPciDls_Clb2xcs_xxxxxx "" /begin DEF_CHARACTERISTIC Cbx_mux_clu_cnt_cfm /end DEF_CHARACTERISTIC
 /begin OUT_MEASUREMENT Vsx_bgin_str_clu_cnt Vsx_bgin_str_clu_cru Vsx_bgin_str_clu_cru_rams Vsx_bgin_str_clu_cru_vld /end OUT_MEASUREMENT
/end FUNCTION
/begin FUNCTION InPciDls_Clbmucs_xxxxxx "" /begin OUT_MEASUREMENT Vsx_mux_bgin_clu_cnt Vsx_mux_bgin_clu_cnt_vld /end OUT_MEASUREMENT /end FUNCTION
/begin FUNCTION InPciDls_Clbsrcs_xxxxxx "" /begin OUT_MEASUREMENT Vsx_sens_bgin_clu_cnt Vsx_sens_bgin_clu_cnt_vld /end OUT_MEASUREMENT /end FUNCTION
/begin FUNCTION InPciDls_Clbxxsr_xxxxxx "" /begin DEF_CHARACTERISTIC Cxx_sens_clu_lk_vb_dly Cxx_sens_clu_lk_vb_thd /end DEF_CHARACTERISTIC /end FUNCTION
/begin FUNCTION InPciDls_Clbdgxx_xxxxxx ""
 /begin DEF_CHARACTERISTIC Cbx_bgin_clu_off_dg_cfm Cbx_bgin_clu_on_dg_cfm Cxx_ant_gear_dif_thd Cxx_ant_gear_fil Cxx_bgin_clu_dg_act_vs_max Cxx_bgin_clu_dg_act_vs_min Cxx_bgin_clu_off_no_chr_ctr Cxx_bgin_clu_on_no_chr_ctr Cxx_dfdec_bgin_clu_nok Cxx_dfinc_bgin_clu_nok /end DEF_CHARACTERISTIC
 /begin OUT_MEASUREMENT Vbx_ant_gear_shf Vbx_bgin_clu_off_nok Vbx_bgin_clu_on_nok Vbx_df_bgin_clu_nok Vbx_raw_bgin_clu_off_no_chr Vxx_ant_gear_2 Vxx_ant_gear_mem /end OUT_MEASUREMENT
/end FUNCTION
/begin FUNCTION SmLimPsp "" /begin SUB_FUNCTION SmLimPsp_Fsnprjx /end SUB_FUNCTION /end FUNCTION
/begin FUNCTION SmLimPsp_Fsnprjx "" /begin OUT_MEASUREMENT Vbx_n_rams_lim_spc_act_1 Vbx_n_rams_lim_spc_act_2 /end OUT_MEASUREMENT /end FUNCTION
/begin FUNCTION BiVfiSlk "" /begin OUT_MEASUREMENT Emul /end OUT_MEASUREMENT /end FUNCTION
/begin FUNCTION BiCbiKnk ""
 /begin OUT_MEASUREMENT Vbx_df_knk_oor Vbx_df_knk_shp Vbx_diag_ena_knk_oor Vbx_diag_ena_knk_shp Vbx_knk_win_diag Vtd_fil_acq_knk_cyl[0] Vtd_fil_acq_knk_cyl[1] Vtd_fil_acq_knk_cyl[2] Vtd_fil_acq_knk_cyl[3] Vxx_knk_tdc_ctr /end OUT_MEASUREMENT
/end FUNCTION
/begin FUNCTION C_2_KNCK "" /begin SUB_FUNCTION KNCK_Acq_of_knk_noise /end SUB_FUNCTION /end FUNCTION
/begin FUNCTION KNCK_Acq_of_knk_noise ""
 /begin OUT_MEASUREMENT knk_loop_nr knks[0] knks[1] knks[2] knks[3] lv_knk_acq_err state_knk_sw_acq_err /end OUT_MEASUREMENT
/end FUNCTION
/begin FUNCTION C_6_KNCK ""
 /begin SUB_FUNCTION KNCK_Control_Adapt_AI KNCK_Activation_cond KNCK_Detection KNCK_Control /end SUB_FUNCTION
/end FUNCTION
/begin FUNCTION KNCK_Control_Adapt_AI ""
 /begin DEF_CHARACTERISTIC c_fac_ad_knk_app c_nl_fil_gain_app c_state_test_knk_app lc_knk_ad_clr /end DEF_CHARACTERISTIC
 /begin OUT_MEASUREMENT fac_ad_knk_app lv_fac_ad_knk_app lv_iga_tra_knk_app lv_inh_fac_ad_knk lv_inh_knk_ad_1 lv_inh_knk_ctl lv_inh_knk_lih lv_inh_nl_ad_knk lv_maf_tra_knk_act lv_n_tra_knk_act lv_nl_fil_gain_app nl_fil_gain_app /end OUT_MEASUREMENT
/end FUNCTION
/begin FUNCTION KNCK_Activation_cond "Activation condition"
 /begin DEF_CHARACTERISTIC ldpm_n_32_2_knck ldpm_n_32_5_knck ldpm_tco_1_knck ldpm_n_32_3_knck id_cycnr_fac_tra_knk id_maf_dif_tra_knk id_maf_hb_min_knk_ad id_maf_min_ad_1_knk id_n_grd_max_knk ip_maf_hb_min_knk c_ctr_ad_1_knk c_ctr_nl_ad_knk c_maf_min_knk_ad c_n_max_knk_ad c_n_min_knk_ad c_tco_ad_knk_min c_tco_knk_ad /end DEF_CHARACTERISTIC
 /begin REF_CHARACTERISTIC ldpm_n_32_1_knck /end REF_CHARACTERISTIC
 /begin OUT_MEASUREMENT lv_fac_ad_knk_ena lv_knk_ad_1_ena lv_knk_ad_ena lv_knk_ctl_act_ena lv_knk_det_ena lv_knk_lih lv_knk_lih_ena lv_maf_tra_knk lv_n_tra_knk /end OUT_MEASUREMENT
/end FUNCTION
/begin FUNCTION KNCK_Detection ""
 /begin DEF_CHARACTERISTIC ldp_n_32_ip_nl_gain_ad id_fac_thd_knk[0] id_fac_thd_knk[1] id_fac_thd_knk[2] id_fac_thd_knk[3] id_knks_fil_frq[0] id_knks_fil_frq[1] id_knks_fil_frq[2] id_knks_fil_frq[3] id_knks_thd_add ip_itc_knk[0] ip_knks_gain[0] ip_knks_gain[1] ip_knks_gain[2] ip_knks_gain[3] ip_knkwb[0] ip_knkwb[1] ip_knkwb[2] ip_knkwb[3] ip_knkwd[0] ip_knkwd[1] ip_knkwd[2] ip_knkwd[3] ip_nl_gain_ad c_cycnr_knk_det c_egy_thd_knk c_fac_tra_knk c_knks_cmd_gain_ad_max c_knks_cmd_gain_ad_min c_knks_cyl_conf c_nl_ad_ctr c_nl_ad_thd c_nl_fil_gain c_nl_fil_gain_inc c_nl_fil_gain_tra c_nl_inc c_nl_lih c_nl_ofs ldpm_maf_hb_1_knck ldpm_maf_hb_2_knck /end DEF_CHARACTERISTIC
 /begin REF_CHARACTERISTIC ldpm_n_32_1_knck ldpm_n_32_2_knck /end REF_CHARACTERISTIC
 /begin OUT_MEASUREMENT egy_knk knks_cmd_conf[0] knks_cmd_conf[1] knks_cmd_conf[2] knks_cmd_conf[3] knks_cmd_fil[0] knks_cmd_fil[1] knks_cmd_fil[2] knks_cmd_fil[3] knks_cmd_gain[0] knks_cmd_gain[1] knks_cmd_gain[2] knks_cmd_gain[3] knks_cmd_gain_ad[0] knks_cmd_gain_ad[1] knks_cmd_gain_ad[2] knks_cmd_gain_ad[3] knks_cmd_int[0] knks_cmd_int[1] knks_cmd_int[2] knks_cmd_int[3] knks_thd[0] knks_thd[1] knks_thd[2] knks_thd[3] knkwb[0] knkwb[1] knkwb[2] knkwb[3] knkwd[0] knkwd[1] knkwd[2] knkwd[3] lv_knk nl[0] nl[1] nl[2] nl[3] nl_dif /end OUT_MEASUREMENT
/end FUNCTION
/begin FUNCTION KNCK_Control "" /begin REF_CHARACTERISTIC ldpm_n_32_3_knck /end REF_CHARACTERISTIC /end FUNCTION
/begin FUNCTION C_A_KNCK "" /begin SUB_FUNCTION KNCK_Sensor_diag_AI KNCK_Acq_chain_diag /end SUB_FUNCTION /end FUNCTION
/begin FUNCTION KNCK_Sensor_diag_AI ""
 /begin OUT_MEASUREMENT lv_inh_diag_acq_knk lv_inh_diag_bas_knk lv_inh_diag_rel_knk /end OUT_MEASUREMENT
/end FUNCTION
/begin FUNCTION KNCK_Acq_chain_diag ""
 /begin DEF_CHARACTERISTIC ldpm_n_32_1_knck ip_knks_err_rel[0] c_ctr_dec_err_sym_rel_knk c_ctr_err_sym_rel_knk c_knks_bas_diag c_knks_diag_cyl_idc[0] c_knks_rel_err_fil c_maf_min_diag_knk c_n_32_min_diag_knk c_tco_diag_knk c_n_32_max_diag_knk /end DEF_CHARACTERISTIC
 /begin OUT_MEASUREMENT ctr_err_sym_rel_knk[0] knks_err_rel[0] knks_mmv_diag[0] lv_err_acq_knk lv_err_bas_knk_0 lv_err_knk lv_err_rel_knk_0 lv_err_sym_knk lv_thd_err_rel_knk[0] nr_knk_sens /end OUT_MEASUREMENT
/end FUNCTION
/begin FUNCTION DgDgtDat ""
 /begin SUB_FUNCTION DgDgtDat_Msgdiag DgDgtDat_Cchkclc_xxxxxx DgDgtDat_Loadval_xxxxxx /end SUB_FUNCTION
/end FUNCTION
/begin FUNCTION DgDgtDat_Msgdiag ""
 /begin DEF_CHARACTERISTIC Cbx_s06_fsys_cpt_old Cxx_c_id1 Cxx_c_id10 Cxx_c_id11 Cxx_c_id12 Cxx_c_id13 Cxx_c_id14 Cxx_c_id15 Cxx_c_id16 Cxx_c_id2 Cxx_c_id3 Cxx_c_id4 Cxx_c_id5 Cxx_c_id6 Cxx_c_id7 Cxx_c_id8 Cxx_c_id9 Cxx_did_205F_writ_max Cxx_did_205F_writ_min Cxx_did_2105_writ_max Cxx_did_2105_writ_min Cxx_did_210D_writ_max Cxx_did_210D_writ_min Cxx_did_210E_writ_max Cxx_did_210E_writ_min Cxx_did_2113_writ_max Cxx_did_2113_writ_min Cxx_did_2141_writ_max Cxx_did_2141_writ_min Cxx_did_2143_writ_max Cxx_did_2143_writ_min Cxx_did_2147_writ_max Cxx_did_2147_writ_min Cxx_did_2156_writ_max Cxx_did_2156_writ_min Cxx_did_2457_writ_max Cxx_did_2457_writ_min Cxx_did_2458_writ_max Cxx_did_2458_writ_min Cxx_did_2459_writ_max Cxx_did_2459_writ_min Cxx_did_245A_writ_max Cxx_did_245A_writ_min Cxx_did_245B_writ_max Cxx_did_245B_writ_min Cxx_did_245C_writ_max Cxx_did_245C_writ_min Cxx_did_24C9_writ_max Cxx_did_24C9_writ_min Cxx_did_287F_writ_max Cxx_did_287F_writ_min Cxx_obd_cert_nr1 Cxx_obd_cert_nr10 Cxx_obd_cert_nr2 Cxx_obd_cert_nr3 Cxx_obd_cert_nr4 Cxx_obd_cert_nr5 Cxx_obd_cert_nr6 Cxx_obd_cert_nr7 Cxx_obd_cert_nr8 Cxx_obd_cert_nr9 Cxx_obd_conf_diag_prmt Cxx_obd_conf_diag_schd Cxx_obd_conf_lamb Cxx_obd_conf_obd /end DEF_CHARACTERISTIC
 /begin OUT_MEASUREMENT Vbx_diag_ena_comb_bas_req Vbx_htg_dsb Vbx_owe_tool_ini_req Vsx_owe_tool_zon_req Vxx_diag_comb_bas /end OUT_MEASUREMENT
/end FUNCTION
/begin FUNCTION DgDgtDat_Cchkclc_xxxxxx "" /begin OUT_MEASUREMENT Vxx_chks_c_sw_1 Vxx_chks_c_sw_2 /end OUT_MEASUREMENT /end FUNCTION
/begin FUNCTION DgDgtDat_Loadval_xxxxxx "" /begin OUT_MEASUREMENT Vxx_obd_eal /end OUT_MEASUREMENT /end FUNCTION
/begin FUNCTION CmMuxSer ""
 /begin OUT_MEASUREMENT Vxx_bus_off_stt_ctr_mem Vxx_mute_stt_ctr_mem Vxx_abs_ecu_stt_ctr_mem Vxx_agb_ecu_stt_ctr_mem Vxx_ccu_ecu_stt_ctr_mem Vxx_ddcm_ecu_stt_ctr_mem Vxx_ip_ecu_stt_ctr_mem Vxx_usm_ecu_stt_ctr_mem Vxx_ac_ecu_stt_ctr_mem Vxx_acc_ecu_stt_ctr_mem Vxx_swa_ecu_stt_ctr_mem Vbx_abs_lk_stt Vbx_agb_lk_stt Vbx_ccu_lk_stt Vbx_ip_lk_stt Vbx_usm_lk_stt Vbx_acc_lk_stt Vbx_ac_lk_stt Vbx_sdl_lk_stt Vbx_swa_lk_stt Vbx_ddcm_lk_stt /end OUT_MEASUREMENT
 /begin SUB_FUNCTION CmMuxSer_Cbadaou CmMuxSer_Cbfulin CmMuxSer_Cbxxxou CmMuxSer_Clatoou CmMuxSer_Clbduin CmMuxSer_Clkmxou CmMuxSer_Clrstin CmMuxSer_Clspoou CmMuxSer_Cltoxou CmMuxSer_Dgdtvin CmMuxSer_Dglpgin CmMuxSer_Dgmilou CmMuxSer_Dgmltin CmMuxSer_Dgwl1ou CmMuxSer_Dgwl2ou CmMuxSer_Ecmreqx CmMuxSer_Mngtxxx CmMuxSer_Pcabsin CmMuxSer_Pcaplou CmMuxSer_Pcatqin CmMuxSer_Pcbpkin CmMuxSer_Pcbrkin CmMuxSer_Pcbrkou CmMuxSer_Pcclbin CmMuxSer_Pcclein CmMuxSer_Pcespin CmMuxSer_Pcfshou CmMuxSer_Pcrvnin CmMuxSer_Pcspcin CmMuxSer_Pctcsin CmMuxSer_Pctqeou CmMuxSer_Pctrein CmMuxSer_Pftfdis CmMuxSer_Pftstat CmMuxSer_Rxfrmxx CmMuxSer_Rxp50in CmMuxSer_Smacsin CmMuxSer_Smat1in CmMuxSer_Smat2in CmMuxSer_Smengou CmMuxSer_Smlimin CmMuxSer_Smovnou CmMuxSer_Smptcin CmMuxSer_Smspdou CmMuxSer_Smsptou CmMuxSer_Tqampou CmMuxSer_Tqapgou CmMuxSer_Tqecfou CmMuxSer_Tqestou CmMuxSer_Tqlosou CmMuxSer_Tqmaxou CmMuxSer_Tqminou CmMuxSer_Tqmpaou CmMuxSer_Tqpalin CmMuxSer_Tqreqou CmMuxSer_Tqprgin CmMuxSer_Txfrmxx CmMuxSer_Txp50ou CmMuxSer_Smwixin CmMuxSer_Tqacxin CmMuxSer_Tqacxou CmMuxSer_Vfacxin CmMuxSer_Vfacxou CmMuxSer_Vfadfin CmMuxSer_Vffltou CmMuxSer_Vfpdain CmMuxSer_Vfptcin CmMuxSer_Vfrwsin CmMuxSer_Vftacin CmMuxSer_Pctbnin /end SUB_FUNCTION
/end FUNCTION
/begin FUNCTION CmMuxSer_Cbadaou "" /begin OUT_MEASUREMENT FuelConsumption NominalFuelConsumption /end OUT_MEASUREMENT /end FUNCTION
/begin FUNCTION CmMuxSer_Cbfulin "" /begin DEF_CHARACTERISTIC Cbx_diag_fuel_pres_cfm /end DEF_CHARACTERISTIC
 /begin OUT_MEASUREMENT Vbx_frm_min_fuel Vbx_min_fuel_navl Vbx_mux_min_fuel_raw Vsx_mux_fuel_lvl_vld Vsx_mux_min_fuel_raw_vld Vxx_mux_fuel_lvl /end OUT_MEASUREMENT
/end FUNCTION
/begin FUNCTION CmMuxSer_Cbxxxou "" /begin OUT_MEASUREMENT DieselFilterWaterDetection DieselPreHeating /end OUT_MEASUREMENT /end FUNCTION
/begin FUNCTION CmMuxSer_Clatoou "" /begin OUT_MEASUREMENT WarningWaterTemp /end OUT_MEASUREMENT /end FUNCTION
/begin FUNCTION CmMuxSer_Clbduin "" /begin OUT_MEASUREMENT Vbx_mux_bdu_ope Vbx_mux_bdu_ope_navl Vsx_mux_bdu_ope_vld /end OUT_MEASUREMENT /end FUNCTION
/begin FUNCTION CmMuxSer_Clkmxou "" /begin OUT_MEASUREMENT ComputedOilDrainingRange /end OUT_MEASUREMENT /end FUNCTION
/begin FUNCTION CmMuxSer_Clrstin "" /begin OUT_MEASUREMENT Vbx_owe_mnl_ini_req_mux /end OUT_MEASUREMENT /end FUNCTION
/begin FUNCTION CmMuxSer_Clspoou "" /begin OUT_MEASUREMENT DownTransitionOfEngCoolantTemp EngineCoolantRegulationTemp /end OUT_MEASUREMENT /end FUNCTION
/begin FUNCTION CmMuxSer_Cltoxou "" /begin OUT_MEASUREMENT EngineCoolantTemp /end OUT_MEASUREMENT /end FUNCTION
/begin FUNCTION CmMuxSer_Dgdtvin "" /begin OUT_MEASUREMENT Vbx_mux_vh_dist_navl Vsx_mux_vh_dist_vld Vxx_mux_vh_dist /end OUT_MEASUREMENT /end FUNCTION
/begin FUNCTION CmMuxSer_Dglpgin "" /begin OUT_MEASUREMENT Vbx_mil_gcu_req /end OUT_MEASUREMENT /end FUNCTION
/begin FUNCTION CmMuxSer_Dgmilou "" /begin OUT_MEASUREMENT MILLamp /end OUT_MEASUREMENT /end FUNCTION
/begin FUNCTION CmMuxSer_Dgmltin "" /begin OUT_MEASUREMENT Vbx_mil_tcu_req Vbx_mux_mil_tcu_req /end OUT_MEASUREMENT /end FUNCTION
/begin FUNCTION CmMuxSer_Dgwl1ou "" /begin OUT_MEASUREMENT EngineControlFailureLevel1 /end OUT_MEASUREMENT /end FUNCTION
/begin FUNCTION CmMuxSer_Dgwl2ou "" /begin OUT_MEASUREMENT EngineControlFailureLevel2 /end OUT_MEASUREMENT /end FUNCTION
/begin FUNCTION CmMuxSer_Ecmreqx "" /begin OUT_MEASUREMENT ECM_MechanicalLoadRequest /end OUT_MEASUREMENT /end FUNCTION
/begin FUNCTION CmMuxSer_Mngtxxx ""
 /begin DEF_CHARACTERISTIC Cxx_ACC_CANHS_R_01_id Cxx_AIRBAGCrash_id Cxx_BCM_CANHS_RNr_01_id Cxx_BCM_CANHS_RNr_02_id Cxx_BCM_VERLOG_id Cxx_BRAKE_CANHS_RNr_01_id Cxx_BRAKE_CANHS_RNr_02_id Cxx_BRAKE_CANHS_RNr_03_id Cxx_BRAKE_CANHS_RNr_04_id Cxx_BRAKE_CANHS_R_01_id Cxx_CLIM_CANHS_R_01_id Cxx_CLUSTER_CANHS_RNr_01_id Cxx_CLUSTER_CANHS_R_01_id Cxx_DDCM_CANLSFT_R_01_id Cxx_ECM_CANHS_RNr_01_id Cxx_ECM_CANHS_RNr_02_id Cxx_ECM_VERLOG_id Cxx_FORCE_ECM_CANHS_R_01_id Cxx_MMI_ECM_CANHS_RNr_01_id Cxx_SWA_CANHS_RNr_01_id Cxx_TORQUE_AT_CANHS_RNr_01_id Cxx_TORQUE_AT_CANHS_RNr_02_id Cxx_TORQUE_ECM_CANHS_RNr_01_id Cxx_TORQUE_ECM_CANHS_RNr_02_id Cxx_TORQUE_ECM_CANHS_R_01_id Cxx_USM_CANHS_RNr_01_id Cxx_abs_abst_frm_dly Cxx_abs_ecu_conf Cxx_abs_vld_abst_frm_dec Cxx_abs_vld_abst_frm_inc Cxx_ac_abst_frm_dly Cxx_ac_ecu_conf Cxx_ac_vld_abst_frm_dec Cxx_ac_vld_abst_frm_inc Cxx_acc_abst_frm_dly Cxx_acc_ecu_conf Cxx_acc_vld_abst_frm_dec Cxx_acc_vld_abst_frm_inc Cxx_agb_abst_frm_dly Cxx_agb_ecu_conf Cxx_agb_vld_abst_frm_dec Cxx_agb_vld_abst_frm_inc Cxx_ccu_abst_frm_dly Cxx_ccu_ecu_conf Cxx_ccu_vld_abst_frm_dec Cxx_ccu_vld_abst_frm_inc Cxx_ddcm_abst_frm_dly Cxx_ddcm_ecu_conf Cxx_ddcm_vld_abst_frm_dec Cxx_ddcm_vld_abst_frm_inc Cxx_ecu_stt_ctr_dec Cxx_ecu_stt_ctr_max Cxx_ecu_stt_ctr_thd Cxx_ip_abst_frm_dly Cxx_ip_ecu_conf Cxx_ip_vld_abst_frm_dec Cxx_ip_vld_abst_frm_inc Cxx_mute_abst_frm_dly Cxx_mute_ecu_conf Cxx_mute_vld_abst_frm_dec Cxx_mute_vld_abst_frm_inc Cxx_mux_diag_ena_dly Cxx_mux_frm_set_ref Cxx_swa_abst_frm_dly Cxx_swa_ecu_conf Cxx_swa_vld_abst_frm_dec Cxx_swa_vld_abst_frm_inc Cxx_usm_abst_frm_dly Cxx_usm_ecu_conf Cxx_usm_vld_abst_frm_dec Cxx_usm_vld_abst_frm_inc /end DEF_CHARACTERISTIC
 /begin OUT_MEASUREMENT AIRBAGCrash[0] AIRBAGCrash[1] BCM_CANHS_RNr_01[0] BCM_CANHS_RNr_01[1] BCM_CANHS_RNr_01[2] BCM_CANHS_RNr_01[3] BCM_CANHS_RNr_01[4] BCM_CANHS_RNr_01[5] BCM_CANHS_RNr_01[6] BCM_CANHS_RNr_01[7] BCM_CANHS_RNr_02[0] BCM_CANHS_RNr_02[1] BCM_CANHS_RNr_02[2] BCM_CANHS_RNr_02[3] BCM_CANHS_RNr_02[4] BCM_CANHS_RNr_02[5] BCM_CANHS_RNr_02[6] BCM_CANHS_RNr_02[7] BCM_VERLOG[0] BCM_VERLOG[1] BCM_VERLOG[2] BCM_VERLOG[3] BCM_VERLOG[4] BRAKE_CANHS_RNr_01[0] BRAKE_CANHS_RNr_01[1] BRAKE_CANHS_RNr_01[2] BRAKE_CANHS_RNr_01[3] BRAKE_CANHS_RNr_01[4] BRAKE_CANHS_RNr_01[5] BRAKE_CANHS_RNr_01[6] BRAKE_CANHS_RNr_02[0] BRAKE_CANHS_RNr_02[1] BRAKE_CANHS_RNr_02[2] BRAKE_CANHS_RNr_02[3] BRAKE_CANHS_RNr_02[4] BRAKE_CANHS_RNr_02[5] BRAKE_CANHS_RNr_03[0] BRAKE_CANHS_RNr_03[1] BRAKE_CANHS_RNr_03[2] BRAKE_CANHS_RNr_03[3] BRAKE_CANHS_RNr_03[4] BRAKE_CANHS_RNr_03[5] BRAKE_CANHS_RNr_04[0] BRAKE_CANHS_RNr_04[1] BRAKE_CANHS_RNr_04[2] BRAKE_CANHS_RNr_04[3] BRAKE_CANHS_RNr_04[4] BRAKE_CANHS_RNr_04[5] BRAKE_CANHS_RNr_04[6] BRAKE_CANHS_RNr_04[7] BRAKE_CANHS_R_01[0] BRAKE_CANHS_R_01[1] BRAKE_CANHS_R_01[2] BRAKE_CANHS_R_01[3] BRAKE_CANHS_R_01[4] BRAKE_CANHS_R_01[5] BRAKE_CANHS_R_01[6] CLIM_CANHS_R_01[0] CLIM_CANHS_R_01[1] CLIM_CANHS_R_01[2] CLIM_CANHS_R_01[3] CLIM_CANHS_R_01[4] CLIM_CANHS_R_01[5] CLUSTER_CANHS_RNr_01[0] CLUSTER_CANHS_RNr_01[1] CLUSTER_CANHS_RNr_01[2] CLUSTER_CANHS_RNr_01[3] CLUSTER_CANHS_RNr_01[4] CLUSTER_CANHS_R_01[0] CLUSTER_CANHS_R_01[1] CLUSTER_CANHS_R_01[2] CLUSTER_CANHS_R_01[3] CLUSTER_CANHS_R_01[4] CLUSTER_CANHS_R_01[5] CLUSTER_CANHS_R_01[6] CLUSTER_CANHS_R_01[7] DDCM_CANLSFT_R_01[0] DDCM_CANLSFT_R_01[1] DDCM_CANLSFT_R_01[2] DDCM_CANLSFT_R_01[3] DDCM_CANLSFT_R_01[4] SWA_CANHS_RNr_01[0] SWA_CANHS_RNr_01[1] SWA_CANHS_RNr_01[2] SWA_CANHS_RNr_01[3] SWA_CANHS_RNr_01[4] SWA_CANHS_RNr_01[5] SWA_CANHS_RNr_01[6] SWA_CANHS_RNr_01[7] TORQUE_AT_CANHS_RNr_01[0] TORQUE_AT_CANHS_RNr_01[1] TORQUE_AT_CANHS_RNr_01[2] TORQUE_AT_CANHS_RNr_01[3] TORQUE_AT_CANHS_RNr_01[4] TORQUE_AT_CANHS_RNr_01[5] TORQUE_AT_CANHS_RNr_01[6] TORQUE_AT_CANHS_RNr_01[7] TORQUE_AT_CANHS_RNr_02[0] TORQUE_AT_CANHS_RNr_02[1] TORQUE_AT_CANHS_RNr_02[2] TORQUE_AT_CANHS_RNr_02[3] TORQUE_AT_CANHS_RNr_02[4] TORQUE_AT_CANHS_RNr_02[5] TORQUE_AT_CANHS_RNr_02[6] TORQUE_AT_CANHS_RNr_02[7] USM_CANHS_RNr_01[0] USM_CANHS_RNr_01[1] USM_CANHS_RNr_01[2] USM_CANHS_RNr_01[3] USM_CANHS_RNr_01[4] Vbx_abs_pws_typ_bc Vbx_ac_pws_typ_bc Vbx_acc_pws_typ_bc Vbx_agb_pws_typ_bc Vbx_can_diag_bus_fail Vbx_can_diag_ecm Vbx_ccu_pws_typ_bc Vbx_ddcm_pws_typ_bc Vbx_ip_pws_typ_bc Vbx_mute_pws_typ_bc Vbx_sdl_pws_typ_bc Vbx_swa_pws_typ_bc Vbx_usm_pws_typ_bc Vxx_abs_ecu_stt Vxx_abs_ecu_stt_ctr Vxx_abs_ecu_stt_ctr_mem_dec Vxx_abs_ecu_stt_ctr_mem_prev Vxx_abs_ecu_stt_diag Vxx_ac_ecu_stt Vxx_ac_ecu_stt_ctr Vxx_ac_ecu_stt_ctr_mem_dec Vxx_ac_ecu_stt_ctr_mem_prev Vxx_ac_ecu_stt_diag Vxx_acc_ecu_stt Vxx_acc_ecu_stt_ctr Vxx_acc_ecu_stt_ctr_mem_dec Vxx_acc_ecu_stt_ctr_mem_prev Vxx_acc_ecu_stt_diag Vxx_agb_ecu_stt Vxx_agb_ecu_stt_ctr Vxx_agb_ecu_stt_ctr_mem_dec Vxx_agb_ecu_stt_ctr_mem_prev Vxx_agb_ecu_stt_diag Vxx_bus_off_stt Vxx_bus_off_stt_ctr Vxx_bus_off_stt_ctr_mem_dec Vxx_bus_off_stt_ctr_mem_prev Vxx_bus_off_stt_diag Vxx_ccu_ecu_stt Vxx_ccu_ecu_stt_ctr Vxx_ccu_ecu_stt_ctr_mem_dec Vxx_ccu_ecu_stt_ctr_mem_prev Vxx_ccu_ecu_stt_diag Vxx_ddcm_ecu_stt Vxx_ddcm_ecu_stt_ctr Vxx_ddcm_ecu_stt_ctr_mem_dec Vxx_ddcm_ecu_stt_ctr_mem_prev Vxx_ddcm_ecu_stt_diag Vxx_gcu_ecu_stt_diag Vxx_ip_ecu_stt Vxx_ip_ecu_stt_ctr Vxx_ip_ecu_stt_ctr_mem_dec Vxx_ip_ecu_stt_ctr_mem_prev Vxx_ip_ecu_stt_diag Vxx_mute_stt Vxx_mute_stt_ctr Vxx_mute_stt_ctr_mem_dec Vxx_mute_stt_ctr_mem_prev Vxx_mute_stt_diag Vxx_mux_frm_set_ref Vxx_sdl_ecu_stt_diag Vxx_swa_ecu_stt Vxx_swa_ecu_stt_ctr Vxx_swa_ecu_stt_ctr_mem_dec Vxx_swa_ecu_stt_ctr_mem_prev Vxx_swa_ecu_stt_diag Vxx_usm_ecu_stt Vxx_usm_ecu_stt_ctr Vxx_usm_ecu_stt_ctr_mem_dec Vxx_usm_ecu_stt_ctr_mem_prev Vxx_usm_ecu_stt_diag /end OUT_MEASUREMENT
/end FUNCTION
/begin FUNCTION CmMuxSer_Pcabsin "" /begin OUT_MEASUREMENT Vbx_mux_abs_reg Vsx_mux_abs_reg_vld /end OUT_MEASUREMENT /end FUNCTION
/end MODULE
/end PROJECT
