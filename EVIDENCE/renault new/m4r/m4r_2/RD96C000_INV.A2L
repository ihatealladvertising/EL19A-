ASAP2_VERSION 1 41
/begin PROJECT RD8 "_default_ProjectLongIdentifier"
/begin HEADER "_default_HeaderComment" PROJECT_NO RD9 /end HEADER
/begin MODULE _default_ModuleName "_default_ModuleLongIdentifier"
/begin MOD_COMMON "_default_ModCommonComment" DEPOSIT ABSOLUTE BYTE_ORDER MSB_LAST ALIGNMENT_BYTE 1 ALIGNMENT_WORD 2 ALIGNMENT_LONG 2 ALIGNMENT_FLOAT32_IEEE 2 ALIGNMENT_FLOAT64_IEEE 4 /end MOD_COMMON
/begin MEASUREMENT Vbx_actr_rly_cmd "State of the actuators relay" UBYTE _CNV_S_2_RANGE______3_CM 1 0. 0. 1. ECU_ADDRESS 0xd00052e2 BIT_MASK 0x1 /end MEASUREMENT
/begin MEASUREMENT Vbx_max_ecu_pws "Maximum retention of the power supply ECU" UBYTE _CNV_S_2_RANGE______3_CM 1 0. 0. 1. ECU_ADDRESS 0xd00052e3 BIT_MASK 0x1 /end MEASUREMENT
/begin MEASUREMENT Vbx_min_ecu_pws "Minimum retention of the power supply ECU" UBYTE _CNV_S_2_RANGE______3_CM 1 0. 0. 1. ECU_ADDRESS 0xd00052e4 BIT_MASK 0x1 /end MEASUREMENT
/begin MEASUREMENT Vbx_pwl_dly_pws "Boolean of the reset generated if Vxx_pwl_dly_pws >Cxx_pwl_dly_pws_max" UBYTE _CNV_S_2_RANGE______3_CM 1 0. 0. 1. ECU_ADDRESS 0xd00052e5 BIT_MASK 0x1 /end MEASUREMENT
/begin MEASUREMENT Vbx_pwl_dly_secu "Boolean of the reset generated if Vxx_pwl_dly_secu == 0" UBYTE _CNV_S_2_RANGE______3_CM 1 0. 0. 1. ECU_ADDRESS 0xd00052e6 BIT_MASK 0x1 /end MEASUREMENT
/begin MEASUREMENT Vbx_pwl_on "Power-latch state" UBYTE _CNV_S_2_RANGE______3_CM 1 0. 0. 1. ECU_ADDRESS 0xd00052e7 BIT_MASK 0x1 /end MEASUREMENT
/begin MEASUREMENT Vbx_rly_cmd_req "Retention request for the actuator relay command" UBYTE _CNV_S_2_RANGE______3_CM 1 0. 0. 1. ECU_ADDRESS 0xd00052e8 BIT_MASK 0x1 /end MEASUREMENT
/begin MEASUREMENT Vsx_actr_rly_vld "Actuators relay validity indicator" UBYTE _CNV_S_3_STATUS_OK__158_CM 1 0. 0. 2. ECU_ADDRESS 0xd00052e9 /end MEASUREMENT
/begin MEASUREMENT Vxx_pwl_dly "Power latch temporization" UWORD _CNV_A_R_LINEAR_____4_CM 1 0. 0. 6553.5 ECU_ADDRESS 0xd00057fa FORMAT "%6.1" /end MEASUREMENT
/begin MEASUREMENT Vxx_pwl_dly_pws "time-out temporization on abnormal key OFF duration" UWORD _CNV_A_R_LINEAR_____4_CM 1 0. 0. 6553.5 ECU_ADDRESS 0xd00057fc FORMAT "%6.1" /end MEASUREMENT
/begin CHARACTERISTIC Cbx_l_pwl_conf "Minimum power latch configuration" VALUE 0xa002148e _REC_S1VAL_20_u1 1. _CNV_A_R_ECME_LINEA_0_CM 0. 1. FORMAT "%1.0" BIT_MASK 0x1 /end CHARACTERISTIC
/begin CHARACTERISTIC Cxx_dfdec_actr_rly_oc "Open circuit on actuators relay detected failure counter decrement" VALUE 0xa002147a _REC_S1VAL_20_u2 65535. _CNV_A_R_ECME_LINEA_0_CM 0. 65535. FORMAT "%5.0" /end CHARACTERISTIC
/begin CHARACTERISTIC Cxx_dfdec_actr_rly_scg "Short circuit to ground on actuators relay detected failure counter decrement" VALUE 0xa002147c _REC_S1VAL_20_u2 65535. _CNV_A_R_ECME_LINEA_0_CM 0. 65535. FORMAT "%5.0" /end CHARACTERISTIC
/begin CHARACTERISTIC Cxx_dfdec_actr_rly_scw "Short circuit to battery on actuators relay detected failure counter decrement" VALUE 0xa002147e _REC_S1VAL_20_u2 65535. _CNV_A_R_ECME_LINEA_0_CM 0. 65535. FORMAT "%5.0" /end CHARACTERISTIC
/begin CHARACTERISTIC Cxx_dfinc_actr_rly_oc "Open circuit on actuators relay detected failure counter increment" VALUE 0xa0021480 _REC_S1VAL_20_u2 65535. _CNV_A_R_ECME_LINEA_0_CM 0. 65535. FORMAT "%5.0" /end CHARACTERISTIC
/begin CHARACTERISTIC Cxx_dfinc_actr_rly_scg "Short circuit to ground on actuators relay detected failure counter increment" VALUE 0xa0021482 _REC_S1VAL_20_u2 65535. _CNV_A_R_ECME_LINEA_0_CM 0. 65535. FORMAT "%5.0" /end CHARACTERISTIC
/begin CHARACTERISTIC Cxx_dfinc_actr_rly_scw "Short circuit to battery on actuators relay detected failure counter increment" VALUE 0xa0021484 _REC_S1VAL_20_u2 65535. _CNV_A_R_ECME_LINEA_0_CM 0. 65535. FORMAT "%5.0" /end CHARACTERISTIC
/begin CHARACTERISTIC Cxx_min_pwl_dly "Minimum temporization of power latch" VALUE 0xa0021486 _REC_S1VAL_20_u2 6553.5 _CNV_A_R_LINEAR_____4_CM 0. 6553.5 FORMAT "%6.1" /end CHARACTERISTIC
/begin CHARACTERISTIC Cxx_pwl_dly "maximum powerlatch delay" VALUE 0xa0021488 _REC_S1VAL_20_u2 6553.5 _CNV_A_R_LINEAR_____4_CM 0. 6553.5 FORMAT "%6.1" /end CHARACTERISTIC
/begin CHARACTERISTIC Cxx_pwl_dly_pws_max "Duration of the power latch time-out on key OFF" VALUE 0xa002148a _REC_S1VAL_20_u2 6553.5 _CNV_A_R_LINEAR_____4_CM 0. 6553.5 FORMAT "%6.1" /end CHARACTERISTIC
/begin CHARACTERISTIC Cxx_pwl_dly_secu "Duration of the power latch  time-out" VALUE 0xa002148c _REC_S1VAL_20_u2 6553.5 _CNV_A_R_LINEAR_____4_CM 0. 6553.5 FORMAT "%6.1" /end CHARACTERISTIC
/begin MEASUREMENT Vxx_brk_pdl_clos_blk_off_dly "Close active brake switch blocked off counter delay " UWORD _CNV_A_R_LINEAR_____82_CM 1 0. 0. 65535. DISPLAY_IDENTIFIER INPCIBKI_NVM.Vxx_brk_pdl_clos_blk_off_dly_NVM ECU_ADDRESS 0xd0003310 FORMAT "%5.0" /end MEASUREMENT
/begin MEASUREMENT Vxx_brk_pdl_clos_blk_on_dly "Close active brake switch blocked on counter delay " UWORD _CNV_A_R_LINEAR_____82_CM 1 0. 0. 65535. DISPLAY_IDENTIFIER INPCIBKI_NVM.Vxx_brk_pdl_clos_blk_on_dly_NVM ECU_ADDRESS 0xd0003312 FORMAT "%5.0" /end MEASUREMENT
/begin MEASUREMENT Vxx_brk_pdl_open_blk_off_dly "Open active brake switch blocked off counter delay" UWORD _CNV_A_R_LINEAR_____82_CM 1 0. 0. 65535. DISPLAY_IDENTIFIER INPCIBKI_NVM.Vxx_brk_pdl_open_blk_off_dly_NVM ECU_ADDRESS 0xd0003314 FORMAT "%5.0" /end MEASUREMENT
/begin MEASUREMENT Vxx_brk_pdl_open_blk_on_dly "Open active brake switch blocked on counter delay" UWORD _CNV_A_R_LINEAR_____82_CM 1 0. 0. 65535. DISPLAY_IDENTIFIER INPCIBKI_NVM.Vxx_brk_pdl_open_blk_on_dly_NVM ECU_ADDRESS 0xd0003316 FORMAT "%5.0" /end MEASUREMENT
/begin MEASUREMENT Vbx_sens_brk_pdl_open_lk_stt "" UBYTE _CNV_S_2_RANGE______3_CM 1 0. 0. 1. DISPLAY_IDENTIFIER INPCIBKI_NVM.Vbx_sens_brk_pdl_open_lk_stt_NVM ECU_ADDRESS 0xd0003318 BIT_MASK 0x1 /end MEASUREMENT
/begin MEASUREMENT Vbx_abs_reg "ABS in regulation" UBYTE _CNV_S_2_RANGE______3_CM 1 0. 0. 1. ECU_ADDRESS 0xd000417c BIT_MASK 0x1 /end MEASUREMENT
/begin MEASUREMENT Vbx_bpk "Automatic or manual parking brake detected" UBYTE _CNV_S_2_RANGE______3_CM 1 0. 0. 1. ECU_ADDRESS 0xd0004ada BIT_MASK 0x1 /end MEASUREMENT
/begin MEASUREMENT Vsx_brk_pdl "Brake pedal states" UBYTE _CNV_S_3_STATUS_BRK_159_CM 1 0. 1. 4. ECU_ADDRESS 0xd00046d9 /end MEASUREMENT
/begin MEASUREMENT Vsx_brk_pdl_cru_vld "Brake pedal states for cruise controlvalidity status" UBYTE _CNV_S_4_STATUS_OK__121_CM 1 0. 0. 3. ECU_ADDRESS 0xd00046da /end MEASUREMENT
/begin MEASUREMENT Vsx_brk_pdl_vld "Brake pedal states validity status" UBYTE _CNV_S_3_STATUS_OK__120_CM 1 0. 0. 2. ECU_ADDRESS 0xd00046db /end MEASUREMENT
/begin MEASUREMENT Vsx_brk_pdl_open "Open active brake switch" UBYTE _CNV_S_2_STATUS_BRK_160_CM 1 0. 1. 2. ECU_ADDRESS 0xd0003f08 /end MEASUREMENT
/begin MEASUREMENT Vsx_brk_pdl_open_vld "Open active brake switch validity status" UBYTE _CNV_S_3_STATUS_OK__158_CM 1 0. 0. 2. ECU_ADDRESS 0xd0003f09 /end MEASUREMENT
/begin CHARACTERISTIC Cxx_sens_brk_lk_vb_dly "Time to enable the open active brake switch conection status" VALUE 0xa0020dd6 _REC_S1VAL_20_u1 25.5 _CNV_A_R_LINEAR_____4_CM 0. 25.5 FORMAT "%4.1" /end CHARACTERISTIC
/begin CHARACTERISTIC Cxx_sens_brk_lk_vb_thd "Minimum battery voltage to enable the open active brake switch conection status" VALUE 0xa0020dd4 _REC_S1VAL_20_u2 25000. _CNV_A_R_LINEAR_____52_CM 0. 25000. FORMAT "%5.0" /end CHARACTERISTIC
/begin MEASUREMENT Vbx_asr_cdn "ASR conditions" UBYTE _CNV_S_2_RANGE______3_CM 1 0. 0. 1. ECU_ADDRESS 0xd0005719 BIT_MASK 0x1 /end MEASUREMENT
/begin MEASUREMENT Vbx_asr_msr_ack "ESP frame acknowledgement bit. this value is set to 1 if there is no request" UBYTE _CNV_S_2_RANGE______3_CM 1 0. 0. 1. ECU_ADDRESS 0xd0004aa6 BIT_MASK 0x1 /end MEASUREMENT
/begin MEASUREMENT Vbx_asr_msr_cdn "ASR MSR authorization" UBYTE _CNV_S_2_RANGE______3_CM 1 0. 0. 1. ECU_ADDRESS 0xd000571a BIT_MASK 0x1 /end MEASUREMENT
/begin MEASUREMENT Vbx_asr_msr_frm_abst_tmp "Absence of ESP frame reception" UBYTE _CNV_S_2_RANGE______3_CM 1 0. 0. 1. ECU_ADDRESS 0xd0004aa7 BIT_MASK 0x1 /end MEASUREMENT
/begin MEASUREMENT Vbx_asr_msr_lk "This boolean is memorized when the first esp frame occurs" UBYTE _CNV_S_2_RANGE______3_CM 1 0. 0. 1. ECU_ADDRESS 0xd000571b BIT_MASK 0x1 /end MEASUREMENT
/begin MEASUREMENT Vbx_asr_prot_dft "Protocol error (complement and clock) in ASR regulation (slew rate activation)" UBYTE _CNV_S_2_RANGE______3_CM 1 0. 0. 1. ECU_ADDRESS 0xd000571c BIT_MASK 0x1 /end MEASUREMENT
/begin MEASUREMENT Vbx_asr_tqe_req_ok "Authorized ASR torque request" UBYTE _CNV_S_2_RANGE______3_CM 1 0. 0. 1. ECU_ADDRESS 0xd000571d BIT_MASK 0x1 /end MEASUREMENT
/begin MEASUREMENT Vbx_df_esp_data_chr "ESP torque request coherency detected failure" UBYTE _CNV_S_2_RANGE______3_CM 1 0. 0. 1. ECU_ADDRESS 0xd000571e BIT_MASK 0x1 /end MEASUREMENT
/begin MEASUREMENT Vbx_df_esp_data_seq_ctr "ESP frame sequence counter detected failure" UBYTE _CNV_S_2_RANGE______3_CM 1 0. 0. 1. ECU_ADDRESS 0xd000571f BIT_MASK 0x1 /end MEASUREMENT
/begin MEASUREMENT Vbx_df_esp_no_frm "The engine control has lost communication with ESP" UBYTE _CNV_S_2_RANGE______3_CM 1 0. 0. 1. ECU_ADDRESS 0xd0005720 BIT_MASK 0x1 /end MEASUREMENT
/begin MEASUREMENT Vbx_msr_cdn "MSR conditions" UBYTE _CNV_S_2_RANGE______3_CM 1 0. 0. 1. ECU_ADDRESS 0xd0005721 BIT_MASK 0x1 /end MEASUREMENT
/begin MEASUREMENT Vbx_msr_tqe_req_ok "Authorized MSR torque request" UBYTE _CNV_S_2_RANGE______3_CM 1 0. 0. 1. ECU_ADDRESS 0xd0005722 BIT_MASK 0x1 /end MEASUREMENT
/begin MEASUREMENT Vbx_tmp_df_esp_data_chr "Single ESP torque request coherency failure" UBYTE _CNV_S_2_RANGE______3_CM 1 0. 0. 1. ECU_ADDRESS 0xd0004aa8 BIT_MASK 0x1 /end MEASUREMENT
/begin MEASUREMENT Vbx_tmp_df_esp_data_seq_ctr "Single ESP frame sequence counter failure" UBYTE _CNV_S_2_RANGE______3_CM 1 0. 0. 1. ECU_ADDRESS 0xd0004aa9 BIT_MASK 0x1 /end MEASUREMENT
/begin MEASUREMENT Vxx_asr_msr_20ms_t "Reccurence time of the block" UBYTE _CNV_A_R_LINEAR_____58_CM 1 0. 0. 0.255 ECU_ADDRESS 0xd0004aaa FORMAT "%5.3" /end MEASUREMENT
/begin MEASUREMENT Vxx_asr_tqe_sp "ASR setpoint torque sent to torque arbitration" UWORD _CNV_A_R_LINEAR_____161_CM 1 0. -400. 1647.96875 ECU_ADDRESS 0xd0003774 FORMAT "%10.5" /end MEASUREMENT
/begin MEASUREMENT Vxx_asr_tqe_tgt "ASR target torque sent to torque arbitration" UWORD _CNV_A_R_LINEAR_____161_CM 1 0. -400. 1647.96875 ECU_ADDRESS 0xd0003776 FORMAT "%10.5" /end MEASUREMENT
/begin MEASUREMENT Vxx_msr_tqe_sp "MSR torque setting sent to torque arbitration" UWORD _CNV_A_R_LINEAR_____161_CM 1 0. -400. 1647.96875 ECU_ADDRESS 0xd0003778 FORMAT "%10.5" /end MEASUREMENT
/begin CHARACTERISTIC Cxx_asr_msr_abst_dly "Calibration time to detect a lost frame" VALUE 0xa0021c64 _REC_S1VAL_20_u2 65.535 _CNV_A_R_LINEAR_____58_CM 0. 65.535 FORMAT "%5.3" /end CHARACTERISTIC
/begin CHARACTERISTIC Cxx_asr_msr_ctr_thd "This is a failure counter threshold. It authorize N successive failure before downgraded mode" VALUE 0xa0021c80 _REC_S1VAL_20_u1 255. _CNV_A_R_ECME_LINEA_0_CM 0. 255. FORMAT "%3.0" /end CHARACTERISTIC
/begin CHARACTERISTIC Cxx_asr_msr_max_tqe "Maximum allowable ASR/MSR torque request" VALUE 0xa0021c66 _REC_S1VAL_20_u2 2047.96875 _CNV_A_R_LINEAR_____161_CM -400. 1647.96875 FORMAT "%10.5" /end CHARACTERISTIC
/begin CHARACTERISTIC Cxx_asr_msr_raw_sum "Sum of raw ASR target and raw MSR setpoint" VALUE 0xa0021c68 _REC_S1VAL_20_u2 65535. _CNV_A_R_ECME_LINEA_0_CM 0. 65535. FORMAT "%5.0" /end CHARACTERISTIC
/begin CHARACTERISTIC Cxx_asr_slwr_neg "ASR slew rate negative curve in case of protocol error" VALUE 0xa0021c6a _REC_S1VAL_20_u2 10235. _CNV_A_R_LINEAR_____162_CM -10235. 0. FORMAT "%6.0" /end CHARACTERISTIC
/begin CHARACTERISTIC Cxx_asr_slwr_pos "ASR slew rate positive curve in case of protocol error" VALUE 0xa0021c6c _REC_S1VAL_20_u2 10235. _CNV_A_R_LINEAR_____163_CM 0. 10235. FORMAT "%5.0" /end CHARACTERISTIC
/begin CHARACTERISTIC Cxx_asr_tqe_sp_msr_raw "Unscaled (raw) value of ASR torque setpoint sent during MSR requests" VALUE 0xa0021c6e _REC_S1VAL_20_u2 65535. _CNV_A_R_ECME_LINEA_0_CM 0. 65535. FORMAT "%5.0" /end CHARACTERISTIC
/begin CHARACTERISTIC Cxx_dfdec_esp_data_chr "ESP data torque request coherency detected failure counter decrement" VALUE 0xa0021c70 _REC_S1VAL_20_u2 65535. _CNV_A_R_ECME_LINEA_0_CM 0. 65535. FORMAT "%5.0" /end CHARACTERISTIC
/begin CHARACTERISTIC Cxx_dfdec_esp_data_seq_ctr "ESP data frame sequence counter detected failure counter decrement" VALUE 0xa0021c72 _REC_S1VAL_20_u2 65535. _CNV_A_R_ECME_LINEA_0_CM 0. 65535. FORMAT "%5.0" /end CHARACTERISTIC
/begin CHARACTERISTIC Cxx_dfdec_esp_no_frm "ESP Missing Message detected failure counter decrement" VALUE 0xa0021c74 _REC_S1VAL_20_u2 65535. _CNV_A_R_ECME_LINEA_0_CM 0. 65535. FORMAT "%5.0" /end CHARACTERISTIC
/begin CHARACTERISTIC Cxx_dfinc_esp_data_chr "ESP data torque request coherency detected failure counter increment" VALUE 0xa0021c76 _REC_S1VAL_20_u2 65535. _CNV_A_R_ECME_LINEA_0_CM 0. 65535. FORMAT "%5.0" /end CHARACTERISTIC
/begin CHARACTERISTIC Cxx_dfinc_esp_data_seq_ctr "ESP data frame sequence counter detected failure counter increment" VALUE 0xa0021c78 _REC_S1VAL_20_u2 65535. _CNV_A_R_ECME_LINEA_0_CM 0. 65535. FORMAT "%5.0" /end CHARACTERISTIC
/begin CHARACTERISTIC Cxx_dfinc_esp_no_frm "ESP Missing Message detected failure counter increment " VALUE 0xa0021c7a _REC_S1VAL_20_u2 65535. _CNV_A_R_ECME_LINEA_0_CM 0. 65535. FORMAT "%5.0" /end CHARACTERISTIC
/begin CHARACTERISTIC Cxx_min_tqe_dsb "a_in_pci_esp_absctxx / Torque value to be sent to torque arbitration when there isn't any request for a minimum torque" VALUE 0xa0021c7c _REC_S1VAL_20_u2 2047.96875 _CNV_A_R_LINEAR_____161_CM -400. 1647.96875 FORMAT "%10.5" /end CHARACTERISTIC
/begin CHARACTERISTIC Cxx_mux_asr_msr_tqe_nok_raw "Unscaled (raw) invalid value of ASR and MSR torque requests" VALUE 0xa0021c7e _REC_S1VAL_20_u2 4095. _CNV_A_R_ECME_LINEA_0_CM 0. 4095. FORMAT "%4.0" /end CHARACTERISTIC
/begin MEASUREMENT Vbx_asr_reg "ASR in regulation" UBYTE _CNV_S_2_RANGE______3_CM 1 0. 0. 1. ECU_ADDRESS 0xd000575f BIT_MASK 0x1 /end MEASUREMENT
/begin MEASUREMENT Vbx_ayc_reg "AYC in regulation" UBYTE _CNV_S_2_RANGE______3_CM 1 0. 0. 1. ECU_ADDRESS 0xd0005760 BIT_MASK 0x1 /end MEASUREMENT
/begin MEASUREMENT Vsx_asr_msr_typ "Torque control type" UBYTE _CNV_S_4_STATUS_TQ__164_CM 1 0. 0. 6. ECU_ADDRESS 0xd0005761 /end MEASUREMENT
/begin AXIS_PTS Ctb_eal "16 breakpoint table for Engine air load" 0xa002a6fc Vxx_eal _REC_A2AXS_20_u2 3.99993896484375 _CNV_A_R_LINEAR_____53_CM 16 0. 3.99993896484375 FORMAT "%10.8" /end AXIS_PTS
/begin MEASUREMENT Vxb_eal.factor "" UWORD _CNV_A_R_A_165_CM 1 0. 0. 65535. ECU_ADDRESS 0xd000415a /end MEASUREMENT
/begin MEASUREMENT Vxb_eal.index "" UBYTE _CNV_A_R_A_165_CM 1 0. 0. 255. ECU_ADDRESS 0xd000415c /end MEASUREMENT
/begin MEASUREMENT Vxb_eal.num_dp "" UBYTE _CNV_A_R_A_165_CM 1 0. 0. 255. ECU_ADDRESS 0xd000415d /end MEASUREMENT
/begin MEASUREMENT Vxb_pred_eal.factor "" UWORD _CNV_A_R_A_165_CM 1 0. 0. 65535. ECU_ADDRESS 0xd000415e /end MEASUREMENT
/begin MEASUREMENT Vxb_pred_eal.index "" UBYTE _CNV_A_R_A_165_CM 1 0. 0. 255. ECU_ADDRESS 0xd0004160 /end MEASUREMENT
/begin MEASUREMENT Vxb_pred_eal.num_dp "" UBYTE _CNV_A_R_A_165_CM 1 0. 0. 255. ECU_ADDRESS 0xd0004161 /end MEASUREMENT
/begin MEASUREMENT Vsx_eal_vld "Validity indicator for engine air load" UBYTE _CNV_A_R_ECME_LINEA_0_CM 1 0. 0. 255. ECU_ADDRESS 0xd0004162 FORMAT "%3.0" /end MEASUREMENT
/begin MEASUREMENT Vxx_eal "Engine air load" UWORD _CNV_A_R_LINEAR_____53_CM 1 0. 0. 3.99993896484375 ECU_ADDRESS 0xd0002ed2 FORMAT "%7.5" /end MEASUREMENT
/begin MEASUREMENT Vxx_eal_tdc_2 "Engine air load 2 tdc earlier" UWORD _CNV_A_R_LINEAR_____53_CM 1 0. 0. 3.99993896484375 ECU_ADDRESS 0xd0002ed4 FORMAT "%7.5" /end MEASUREMENT
/begin MEASUREMENT Vxx_eal_tdc_4 "Engine air load 4 tdc earlier" UWORD _CNV_A_R_LINEAR_____53_CM 1 0. 0. 3.99993896484375 ECU_ADDRESS 0xd0002ed6 FORMAT "%7.5" /end MEASUREMENT
/begin MEASUREMENT Vxx_pred_air_wht_frh "Mass of air trapped in the cylinder for next ignition" UWORD _CNV_A_R_LINEAR_____166_CM 1 0. 0. 6553.5 ECU_ADDRESS 0xd0002ed8 FORMAT "%6.1" /end MEASUREMENT
/begin MEASUREMENT Vxx_pred_eal "Engine air load using predicted pressure" UWORD _CNV_A_R_LINEAR_____53_CM 1 0. 0. 3.99993896484375 ECU_ADDRESS 0xd0002eda FORMAT "%7.5" /end MEASUREMENT
/begin MEASUREMENT Vxx_pump_maf "Amount of air pumped into culinder" UWORD _CNV_A_R_LINEAR_____109_CM 1 0. 0. 3000. ECU_ADDRESS 0xd0002edc FORMAT "%4.3" /end MEASUREMENT
/begin MEASUREMENT Vxx_pump_maf_fil "Filtered amount of air pumped into cylinder." UWORD _CNV_A_R_LINEAR_____109_CM 1 0. 0. 3000. ECU_ADDRESS 0xd0002ede FORMAT "%4.3" /end MEASUREMENT
/begin CHARACTERISTIC Cxx_cyl_vol "Engine capacity displacement" VALUE 0xa0021202 _REC_S1VAL_20_u2 4.e-003 _CNV_A_R_LINEAR_____167_CM 0. 4.e-003 FORMAT "%8.6" /end CHARACTERISTIC
/begin CHARACTERISTIC Cxx_eng_air_wht_ref "Mass of air in the cylinder in standard condition" VALUE 0xa0021204 _REC_S1VAL_20_u2 6553.5 _CNV_A_R_LINEAR_____81_CM 0. 6553.5 /end CHARACTERISTIC
/begin CHARACTERISTIC Cxx_pump_maf_fil_ftc "Filter time constant for mass air flow pumped into cylinder." VALUE 0xa0021206 _REC_S1VAL_20_u2 655.35 _CNV_A_R_LINEAR_____34_CM 0. 655.35 FORMAT "%6.2" /end CHARACTERISTIC
/begin CHARACTERISTIC Cmp_n_map_fill_efv "Map giving the corrective term of mass efficiency for MAIRPRD computing" MAP 0xa002d284 _REC_A1MAP_20_u2_u2_u2 1.99996948242188 _CNV_A_R_LINEAR_____49_CM 0. 1.99996948242188 FORMAT "%7.5"
 /begin AXIS_DESCR COM_AXIS Vxx_n _CNV_A_R_ENSD_LINEA_24_CM 20 0. 16383.75 FORMAT "%8.2" AXIS_PTS_REF Ctb_n /end AXIS_DESCR
 /begin AXIS_DESCR COM_AXIS Vxx_map _CNV_A_R_LINEAR_____57_CM 17 0. 20000. FORMAT "%5.0" AXIS_PTS_REF Ctb_prs /end AXIS_DESCR
/end CHARACTERISTIC
/begin CHARACTERISTIC Cmp_vvt_fill_efv_cor_fac1 "Map of first coefficient of the parabolic correction of fill up efficiency for continuous intake VVT" MAP 0xa002d52c _REC_A1MAP_20_u2_u2_u2 1.99996948242187e-003 _CNV_A_R_LINEAR_____168_CM 0. 1.99996948242187e-003 FORMAT "%9.8"
 /begin AXIS_DESCR COM_AXIS Vxx_n _CNV_A_R_ENSD_LINEA_24_CM 20 0. 16383.75 FORMAT "%8.2" AXIS_PTS_REF Ctb_n /end AXIS_DESCR
 /begin AXIS_DESCR COM_AXIS Vxx_map _CNV_A_R_LINEAR_____57_CM 17 0. 20000. FORMAT "%5.0" AXIS_PTS_REF Ctb_prs /end AXIS_DESCR
/end CHARACTERISTIC
/begin CHARACTERISTIC Cmp_vvt_fill_efv_cor_fac2 "Map of second coefficient of the parabolic correction of fill up efficiency for continuous in VVT" MAP 0xa002d7d4 _REC_A1MAP_20_u2_u2_u2 7.812380790710449e-002 _CNV_A_R_LINEAR_____169_CM -3.90625e-002 3.90613079071045e-002 FORMAT "%10.7"
 /begin AXIS_DESCR COM_AXIS Vxx_n _CNV_A_R_ENSD_LINEA_24_CM 20 0. 16383.75 FORMAT "%8.2" AXIS_PTS_REF Ctb_n /end AXIS_DESCR
 /begin AXIS_DESCR COM_AXIS Vxx_map _CNV_A_R_LINEAR_____57_CM 17 0. 20000. FORMAT "%5.0" AXIS_PTS_REF Ctb_prs /end AXIS_DESCR
/end CHARACTERISTIC
/begin CHARACTERISTIC Ctp_vlv_air_temp_cor "Table of correction of cylinder fill up efficiency relative correction" CURVE 0xa002da7c _REC_A1CUR_20_u2_u2 1.999969482 _CNV_A_R_LINEAR_____96_CM 0. 1.999969482 FORMAT "%10.8"
 /begin AXIS_DESCR COM_AXIS NO_INPUT_QUANTITY _CNV_A_R_LINEAR_____54_CM 9 -40. 200. FORMAT "%5.1" AXIS_PTS_REF Ctb_mat2 /end AXIS_DESCR
/end CHARACTERISTIC
/begin MEASUREMENT Vsx_eng_vol_fill_efy_vld "Cylinder fill-up efficiency validity status" UBYTE _CNV_A_R_ECME_LINEA_0_CM 1 0. 0. 2. ECU_ADDRESS 0xd0004206 FORMAT "%1.0" /end MEASUREMENT
/begin MEASUREMENT Vxx_air_temp_inj_cor "Correction of cylinder fill up efficiency with valve gaz temperature" UWORD _CNV_A_R_LINEAR_____96_CM 1 0. 0. 1.999969482 ECU_ADDRESS 0xd0003342 FORMAT "%10.8" /end MEASUREMENT
/begin MEASUREMENT Vxx_eng_vol_fill_efy "Cylinder fill up efficiency" UWORD _CNV_A_R_LINEAR_____96_CM 1 0. 0. 1.999969482 ECU_ADDRESS 0xd0003344 FORMAT "%10.8" /end MEASUREMENT
/begin MEASUREMENT Vxx_eng_vol_fill_efy_fil "Cylinder fill up efficiency (filtered for throttle command)" UWORD _CNV_A_R_LINEAR_____96_CM 1 0. 0. 1.999969482 ECU_ADDRESS 0xd0003346 FORMAT "%10.8" /end MEASUREMENT
/begin MEASUREMENT Vxx_fill_efv_cor_rat "Cylinder fill up efficiency without temperature effect" UWORD _CNV_A_R_LINEAR_____96_CM 1 0. 0. 1.999969482 ECU_ADDRESS 0xd0003348 FORMAT "%10.8" /end MEASUREMENT
/begin MEASUREMENT Vxx_vvt_fill_efv_cor "Fill up efficiency correction for continous intake VVT " SWORD _CNV_A_R_LINEAR_____170_CM 1 0. -1. 0.999969482421875 ECU_ADDRESS 0xd000334a FORMAT "%8.5" /end MEASUREMENT
/begin MEASUREMENT Vxx_vvt_fill_efv_cor_fac1 "First coefficient of the parabolic correction of fill up efficiency for continuous intake VVT" UWORD _CNV_A_R_LINEAR_____168_CM 1 0. 0. 1.99996948242187e-003 ECU_ADDRESS 0xd000334c FORMAT "%9.8" /end MEASUREMENT
/begin MEASUREMENT Vxx_vvt_fill_efv_cor_fac2 "Second coefficient of the parabolic correction of fill up efficiency for continuous intake VVT" SWORD _CNV_A_R_LINEAR_____171_CM 1 0. -3.90625e-002 3.90613079071045e-002 ECU_ADDRESS 0xd000334e FORMAT "%10.7" /end MEASUREMENT
/begin CHARACTERISTIC Cbx_vvtc_in_ang_ofs "Correction relative to intake vvt angle setpoint (1) or offset (0)" VALUE 0xa0021374 _REC_S1VAL_20_u1 1. _CNV_A_R_ECME_LINEA_0_CM 0. 1. FORMAT "%1.0" BIT_MASK 0x1 /end CHARACTERISTIC
/begin CHARACTERISTIC Cxx_eng_vol_fill_efy_drv_max "Maximum slope for fill up efficiency." VALUE 0xa002136e _REC_S1VAL_20_u2 99.99847412109381 _CNV_A_R_LINEAR_____172_CM -50. 49.9984741210938 FORMAT "%9.6" /end CHARACTERISTIC
/begin CHARACTERISTIC Cxx_eng_vol_fill_efy_dz "Fill up efficiency deadzone" VALUE 0xa0021370 _REC_S1VAL_20_s2 1.999969482421875 _CNV_A_R_LINEAR_____170_CM -1. 0.999969482421875 FORMAT "%9.6" /end CHARACTERISTIC
/begin CHARACTERISTIC Cxx_vvt_fill_efv_cam_ofs "Offset angle for calculation of VVT fill up efficiency relative correction" VALUE 0xa0021372 _REC_S1VAL_20_s2 719.98 _CNV_A_R_LINEAR_____173_CM -360. 359.98 FORMAT "%7.2" /end CHARACTERISTIC
/begin MEASUREMENT Vxx_mfld_dly "Manifold time constant" UWORD _CNV_A_R_LINEAR_____58_CM 1 0. 0. 65.535 ECU_ADDRESS 0xd0003028 FORMAT "%5.3" /end MEASUREMENT
/begin CHARACTERISTIC Cxx_mfld_vol "Volume between the inlet throttle and the inlet ports" VALUE 0xa00215ee _REC_S1VAL_20_u2 4.e-002 _CNV_A_R_LINEAR_____174_CM 0. 4.e-002 FORMAT "%7.5" /end CHARACTERISTIC
/begin CHARACTERISTIC Cmp_prs_n_alti_min_map_cor "Factor applied on altimetric pressure to obtain variation of Pzero" MAP 0xa0023a00 _REC_A1MAP_20_u1_u2_u2 0.99609375 _CNV_A_R_LINEAR_____31_CM 0. 0.99609375 FORMAT "%10.8"
 /begin AXIS_DESCR COM_AXIS Vxx_map _CNV_A_R_LINEAR_____57_CM 9 0. 20000. FORMAT "%5.0" AXIS_PTS_REF Ctb_prs2 /end AXIS_DESCR
 /begin AXIS_DESCR COM_AXIS Vxx_n _CNV_A_R_ENSD_LINEA_24_CM 9 0. 16383.75 FORMAT "%8.2" AXIS_PTS_REF Ctb_n2 /end AXIS_DESCR
/end CHARACTERISTIC
/begin CHARACTERISTIC Ctp_min_map "Minimum manifold pressure to get engine mass air flow (depending on engine speed)" CURVE 0xa0023a54 _REC_A1CUR_20_u2_u2 20000. _CNV_A_R_LINEAR_____57_CM 0. 20000. FORMAT "%5.0"
 /begin AXIS_DESCR COM_AXIS Vxx_n _CNV_A_R_ENSD_LINEA_24_CM 20 0. 16383.75 FORMAT "%8.2" AXIS_PTS_REF Ctb_n /end AXIS_DESCR
/end CHARACTERISTIC
/begin MEASUREMENT Vsx_min_map_maf_vld "Validity indicator for minimum pressure for mass air flow" UBYTE _CNV_S_3_STATUS_OK__120_CM 1 0. 0. 2. ECU_ADDRESS 0xd0003e41 /end MEASUREMENT
/begin MEASUREMENT Vxx_min_map_maf "Minimum pressure under which there is no air flow into cylinder (including altimetry)" UWORD _CNV_A_R_LINEAR_____57_CM 1 0. 0. 20000. ECU_ADDRESS 0xd0003890 FORMAT "%5.0" /end MEASUREMENT
/begin AXIS_PTS Ctp_it_ar_psn "Throttle position setpoint depending on effective area." 0xa002ac7c Vxx_mv_it_rel_psn _REC_A2AXS_20_u2 100. _CNV_A_R_LINEAR_____99_CM 17 0. 100. FORMAT "%6.2" /end AXIS_PTS
/begin MEASUREMENT Vxx_pred_map_efv_it_ar "Effective intake throttle area" UWORD _CNV_A_R_LINEAR_____95_CM 1 0. 0. 3.90619e-003 ECU_ADDRESS 0xd0003130 FORMAT "%11.9" /end MEASUREMENT
/begin AXIS_PTS Ntb_100_9 "Table of breakpoints" 0xa0029004 Vxx_cp_pwm_appl _REC_A2AXS_20_u2 100. _CNV_A_R_LINEAR_____122_CM 9 0. 100. READ_ONLY FORMAT "%12.8" /end AXIS_PTS
/begin AXIS_PTS Ntb_1_9 "Table of breakpoints" 0xa0029018 Vxx_cp_rich_cor _REC_A2AXS_20_u2 0.666656494140625 _CNV_A_R_LINEAR_____63_CM 9 0. 0.666656494140625 READ_ONLY FORMAT "%8.7" /end AXIS_PTS
/begin CHARACTERISTIC Ctp_cp_load_fac_cor "Cartographie de correction du Cfe_value en fonction du taux d'essence dans le dÈbit de purge" CURVE 0xa002902c _REC_A1CUR_20_u1_u2 3.984375 _CNV_A_R_LINEAR_____175_CM 0. 3.984375 FORMAT "%8.6"
 /begin AXIS_DESCR COM_AXIS Vxx_cp_rich_cor _CNV_A_R_LINEAR_____63_CM 9 0. 0.666656494140625 READ_ONLY FORMAT "%8.7" AXIS_PTS_REF Ntb_1_9 /end AXIS_DESCR
/end CHARACTERISTIC
/begin CHARACTERISTIC Ctp_pwm_cp_efv_ar1 "Effective area of the canister purge at high frequency command" CURVE 0xa0029038 _REC_A1CUR_20_u2_u2 2.44136274662394e-004 _CNV_A_R_LINEAR_____176_CM 0. 2.44136274662394e-004 FORMAT "%11.9"
 /begin AXIS_DESCR COM_AXIS Vxx_cp_pwm_appl _CNV_A_R_LINEAR_____122_CM 9 0. 100. READ_ONLY FORMAT "%12.8" AXIS_PTS_REF Ntb_100_9 /end AXIS_DESCR
/end CHARACTERISTIC
/begin CHARACTERISTIC Ctp_pwm_cp_efv_ar2 "Effective area of the canister purge at low frequency command" CURVE 0xa002904c _REC_A1CUR_20_u2_u2 2.44136274662394e-004 _CNV_A_R_LINEAR_____176_CM 0. 2.44136274662394e-004 FORMAT "%11.9"
 /begin AXIS_DESCR COM_AXIS Vxx_cp_pwm_appl _CNV_A_R_LINEAR_____122_CM 9 0. 100. READ_ONLY FORMAT "%12.8" AXIS_PTS_REF Ntb_100_9 /end AXIS_DESCR
/end CHARACTERISTIC
/begin MEASUREMENT Vxx_clc_ar_cp_air_gas_maf "Theoretical mass air flow per unit of the effective surface valve of the canister purge" UWORD _CNV_A_R_LINEAR_____177_CM 1 0. 0. 510. ECU_ADDRESS 0xd0002d18 FORMAT "%11.7" /end MEASUREMENT
/begin MEASUREMENT Vxx_clc_ar_cp_air_gas_maf_cor "Corrected theoretical mass air flow per unit of the effective surface valve of the canister" UWORD _CNV_A_R_LINEAR_____177_CM 1 0. 0. 510. ECU_ADDRESS 0xd0002d1a FORMAT "%11.7" /end MEASUREMENT
/begin MEASUREMENT Vxx_cp_efv_ar "Effective area of the canister purge valve." UWORD _CNV_A_R_LINEAR_____178_CM 1 0. 0. 2.4414e-004 ECU_ADDRESS 0xd0002d1c FORMAT "%14.12" /end MEASUREMENT
/begin MEASUREMENT Vxx_cp_maf "Canister purge mass air flow" UWORD _CNV_A_R_LINEAR_____109_CM 1 0. 0. 3000. ECU_ADDRESS 0xd0002d1e FORMAT "%4.3" /end MEASUREMENT
/begin MEASUREMENT Vxx_raw_cp_maf "Canister purge mass air flow for EVAP calculation" UWORD _CNV_A_R_LINEAR_____109_CM 1 0. 0. 3000. ECU_ADDRESS 0xd0002d20 FORMAT "%7.2" /end MEASUREMENT
/begin CHARACTERISTIC Cbx_as_cpmaf_on_mod "Airpath flow correction by canister flow activation authorisation" VALUE 0xa002157a _REC_S1VAL_20_u1 1. _CNV_A_R_ECME_LINEA_0_CM 0. 1. FORMAT "%1.0" BIT_MASK 0x1 /end CHARACTERISTIC
/begin CHARACTERISTIC Cxx_dft_cp_load "Default canister charge" VALUE 0xa0021576 _REC_S1VAL_20_u2 0.666666733327059 _CNV_A_R_LINEAR_____179_CM 0. 0.666666733327059 FORMAT "%8.7" /end CHARACTERISTIC
/begin CHARACTERISTIC Cxx_flr_clc_dsb_prs_thd "Manifold pressure beyond which we inhibit the calculation of the mass air flow from the canister" VALUE 0xa0021578 _REC_S1VAL_20_u2 20000. _CNV_A_R_LINEAR_____57_CM 0. 20000. FORMAT "%5.0" /end CHARACTERISTIC
/begin AXIS_PTS Ctp_vlv_air_temp_cor_alco "Table of correction of cylinder fill-up efficiency with valve gaz temperature for alcool" 0xa0026738 Vxx_vlv_air_temp _REC_A2AXS_20_u2 1.999969482 _CNV_A_R_LINEAR_____96_CM 9 0. 1.999969482 FORMAT "%10.8" /end AXIS_PTS
/begin CHARACTERISTIC Cmp_n_map_fill_efv_ofs_alco "Map giving the corrective offset applied on gazonline fill up efficiency for alcool" MAP 0xa002674c _REC_A1MAP_20_u2_u2_u2 1.999969482421875 _CNV_A_R_LINEAR_____180_CM -1. 0.999969482421875 FORMAT "%10.8"
 /begin AXIS_DESCR COM_AXIS Vxx_n _CNV_A_R_ENSD_LINEA_24_CM 20 0. 16383.75 FORMAT "%8.2" AXIS_PTS_REF Ctb_n /end AXIS_DESCR
 /begin AXIS_DESCR COM_AXIS Vxx_map _CNV_A_R_LINEAR_____57_CM 17 0. 20000. FORMAT "%5.0" AXIS_PTS_REF Ctb_prs /end AXIS_DESCR
/end CHARACTERISTIC
/begin MEASUREMENT Vxx_fill_efv_ofs_alco "corrective term of fill up efficiency applied on gazoline settings" UWORD _CNV_A_R_LINEAR_____180_CM 1 0. -1. 0.999969482421875 ECU_ADDRESS 0xd00038d4 FORMAT "%10.8" /end MEASUREMENT
/begin MEASUREMENT Vxx_vlv_air_temp_cor_alco "Table of correction of cylinder fill-up efficiency with valve gaz temperature for alcool" UWORD _CNV_A_R_LINEAR_____96_CM 1 0. 0. 1.999969482 ECU_ADDRESS 0xd00038d6 FORMAT "%10.8" /end MEASUREMENT
/begin AXIS_PTS Ctb_sens_it_cor_1 "Breakpoint table used with the cartography Ctp_sens_it_cor_1." 0xa0024fec Vxx_sens_it_tmp_1 _REC_A2AXS_20_u2 100. _CNV_A_R_LINEAR_____99_CM 4 0. 100. FORMAT "%6.2" /end AXIS_PTS
/begin AXIS_PTS Ctb_sens_it_cor_2 "Breakpoint table used with the cartography Ctp_sens_it_cor_2." 0xa0024ff8 Vxx_sens_it_tmp_2 _REC_A2AXS_20_u2 100. _CNV_A_R_LINEAR_____99_CM 4 0. 100. FORMAT "%6.2" /end AXIS_PTS
/begin CHARACTERISTIC Ctp_sens_it_cor_1 "Cartography to convert the sensor 1 read position in V of a normalized position." CURVE 0xa0021960 _REC_A1CUR_20_u2_u2 100. _CNV_A_R_LINEAR_____99_CM 0. 100. FORMAT "%6.2"
 /begin AXIS_DESCR COM_AXIS Vxx_sens_it_tmp_1 _CNV_A_R_LINEAR_____99_CM 4 0. 100. FORMAT "%6.2" AXIS_PTS_REF Ctb_sens_it_cor_1 /end AXIS_DESCR
/end CHARACTERISTIC
/begin CHARACTERISTIC Ctp_sens_it_cor_2 "Cartography to convert the sensor 2 read position in V of a normalized position." CURVE 0xa0021968 _REC_A1CUR_20_u2_u2 100. _CNV_A_R_LINEAR_____99_CM 0. 100. FORMAT "%6.2"
 /begin AXIS_DESCR COM_AXIS Vxx_sens_it_tmp_2 _CNV_A_R_LINEAR_____99_CM 4 0. 100. FORMAT "%6.2" AXIS_PTS_REF Ctb_sens_it_cor_2 /end AXIS_DESCR
/end CHARACTERISTIC
/begin MEASUREMENT Vbx_df_sens_it_1_nok "IT Sensor 1 Plausibility detected failure" UBYTE _CNV_S_2_RANGE______3_CM 1 0. 0. 1. ECU_ADDRESS 0xd000480f BIT_MASK 0x1 /end MEASUREMENT
/begin MEASUREMENT Vbx_df_sens_it_2_nok "IT Sensor 2 Plausibility detected failure" UBYTE _CNV_S_2_RANGE______3_CM 1 0. 0. 1. ECU_ADDRESS 0xd0004810 BIT_MASK 0x1 /end MEASUREMENT
/begin MEASUREMENT Vbx_df_sens_it_chr "IT Sensors 1 and 2 Coherence detected failure" UBYTE _CNV_S_2_RANGE______3_CM 1 0. 0. 1. ECU_ADDRESS 0xd0004811 BIT_MASK 0x1 /end MEASUREMENT
/begin MEASUREMENT Vbx_df_sens_it_sig_mcut "IT Sensors microcut detected failure" UBYTE _CNV_S_2_RANGE______3_CM 1 0. 0. 1. ECU_ADDRESS 0xd0004812 BIT_MASK 0x1 /end MEASUREMENT
/begin MEASUREMENT Vbx_diag_ena_sens_it_chr "IT Sensors 1 and 2 Coherence diagnosis authorization" UBYTE _CNV_S_2_RANGE______3_CM 1 0. 0. 1. ECU_ADDRESS 0xd0004813 BIT_MASK 0x1 /end MEASUREMENT
/begin MEASUREMENT Vbx_it_psn_stab_1 "Indicates the stability of the sensor 1 position, during offset reading" UBYTE _CNV_S_2_RANGE______3_CM 1 0. 0. 1. ECU_ADDRESS 0xd0004814 BIT_MASK 0x1 /end MEASUREMENT
/begin MEASUREMENT Vbx_it_psn_stab_2 "Indicates the stability of the sensor 2 position, during offset reading" UBYTE _CNV_S_2_RANGE______3_CM 1 0. 0. 1. ECU_ADDRESS 0xd0004815 BIT_MASK 0x1 /end MEASUREMENT
/begin MEASUREMENT Vbx_it_psn_stab_det_1 "Indicates if a new sensor 1 position has to be taken in order to check the stability." UBYTE _CNV_S_2_RANGE______3_CM 1 0. 0. 1. ECU_ADDRESS 0xd0004816 BIT_MASK 0x1 /end MEASUREMENT
/begin MEASUREMENT Vbx_it_psn_stab_det_2 "Indicates if a new sensor 2 position has to be taken in order to check the stability." UBYTE _CNV_S_2_RANGE______3_CM 1 0. 0. 1. ECU_ADDRESS 0xd0004817 BIT_MASK 0x1 /end MEASUREMENT
/begin MEASUREMENT Vbx_sens_it_spd_chr_no_norm "Indicates that the speed of sensor 1 and 2 are not coherent." UBYTE _CNV_S_2_RANGE______3_CM 1 0. 0. 1. ECU_ADDRESS 0xd0004818 BIT_MASK 0x1 /end MEASUREMENT
/begin MEASUREMENT Vsx_it_sens_vld "Inlet throttle sensor validity status." UBYTE _CNV_S_8_STATUS_OK__181_CM 1 0. 0. 7. ECU_ADDRESS 0xd0004819 /end MEASUREMENT
/begin MEASUREMENT Vsx_it_sens_vld_prev "Inlet throttle sensor validity status, previous sample time." UBYTE _CNV_S_8_STATUS_OK__181_CM 1 0. 0. 7. ECU_ADDRESS 0xd000481a /end MEASUREMENT
/begin MEASUREMENT Vsx_it_sens_vld_tmp "Inlet throttle sensor validity status, temporary value." UBYTE _CNV_S_8_STATUS_OK__181_CM 1 0. 0. 7. ECU_ADDRESS 0xd000481b /end MEASUREMENT
/begin MEASUREMENT Vxx_it_psn "Throttle position in percent of the sensor supply voltage" UWORD _CNV_A_R_LINEAR_____99_CM 1 0. 0. 100. ECU_ADDRESS 0xd00039b0 FORMAT "%6.2" /end MEASUREMENT
/begin MEASUREMENT Vxx_it_psn_mv_1 "Sliding mean value, 1st sensor" UWORD _CNV_A_R_LINEAR_____99_CM 1 0. 0. 100. ECU_ADDRESS 0xd00039b2 FORMAT "%6.2" /end MEASUREMENT
/begin MEASUREMENT Vxx_it_psn_mv_2 "Sliding mean value, 2 nd sensor" UWORD _CNV_A_R_LINEAR_____99_CM 1 0. 0. 100. ECU_ADDRESS 0xd00039b4 FORMAT "%6.2" /end MEASUREMENT
/begin MEASUREMENT Vxx_it_psn_stab_1 "Value of the position used as a reference for the check of the stability, sensor 1." UWORD _CNV_A_R_LINEAR_____99_CM 1 0. 0. 100. ECU_ADDRESS 0xd00039b6 FORMAT "%6.2" /end MEASUREMENT
/begin MEASUREMENT Vxx_it_psn_stab_2 "Value of the position used as a reference for the check of the stability, sensor 2." UWORD _CNV_A_R_LINEAR_____99_CM 1 0. 0. 100. ECU_ADDRESS 0xd00039b8 FORMAT "%6.2" /end MEASUREMENT
/begin MEASUREMENT Vxx_sens_it_1 "Inlet throttle sensor 1 position." UWORD _CNV_A_R_LINEAR_____99_CM 1 0. 0. 100. ECU_ADDRESS 0xd00039ba FORMAT "%6.2" /end MEASUREMENT
/begin MEASUREMENT Vxx_sens_it_2 "Inlet throttle sensor 2 position." UWORD _CNV_A_R_LINEAR_____99_CM 1 0. 0. 100. ECU_ADDRESS 0xd00039bc FORMAT "%6.2" /end MEASUREMENT
/begin MEASUREMENT Vxx_sens_it_tmp_1 "Absolute position from the sensor 1, in percent of the sensor supply voltage. Before lin. carto." UWORD _CNV_A_R_LINEAR_____99_CM 1 0. 0. 100. ECU_ADDRESS 0xd00039be FORMAT "%6.2" /end MEASUREMENT
/begin MEASUREMENT Vxx_sens_it_tmp_2 "Absolute position from the sensor 2, in percent of the sensor supply voltage. Before lin. carto." UWORD _CNV_A_R_LINEAR_____99_CM 1 0. 0. 100. ECU_ADDRESS 0xd00039c0 FORMAT "%6.2" /end MEASUREMENT
/begin CHARACTERISTIC Cbx_sens_it_chr_fil_cho "Activation of filter for sensor incoherence detection." VALUE 0xa0021998 _REC_S1VAL_20_u1 1. _CNV_S_2_RANGE______3_CM 0. 1. /end CHARACTERISTIC
/begin CHARACTERISTIC Cbx_sens_it_mcut_cho "Microcut diag. configuration." VALUE 0xa0021999 _REC_S1VAL_20_u1 1. _CNV_S_2_RANGE______3_CM 0. 1. /end CHARACTERISTIC
/begin CHARACTERISTIC Cbx_sens_it_mcut_cho_2 "Mcut configuration for regulation on one sensor. On-> rise mcut diagnosis on src_df." VALUE 0xa002199a _REC_S1VAL_20_u1 1. _CNV_S_2_RANGE______3_CM 0. 1. /end CHARACTERISTIC
/begin CHARACTERISTIC Cbx_sens_it_typ_1 "Indicates if the sensor 1 technology obliges to adapt the signal with the sensor supply voltage." VALUE 0xa002199b _REC_S1VAL_20_u1 1. _CNV_S_2_RANGE______3_CM 0. 1. /end CHARACTERISTIC
/begin CHARACTERISTIC Cbx_sens_it_typ_2 "Indicates if the sensor 2 technology obliges to adapt the signal with the sensor supply voltage." VALUE 0xa002199c _REC_S1VAL_20_u1 1. _CNV_S_2_RANGE______3_CM 0. 1. /end CHARACTERISTIC
/begin CHARACTERISTIC Cbx_sens_it_vld_cho_1 "a_in_asi_iti_itposxx/Position value on failure 2. Off -> limp home, On -> remaining sensor." VALUE 0xa002199d _REC_S1VAL_20_u1 1. _CNV_S_2_RANGE______3_CM 0. 1. /end CHARACTERISTIC
/begin CHARACTERISTIC Cbx_sens_it_vld_cho_2 "a_in_asi_iti_itposxx/Position value on failure 3. Off -> limp home, On -> remaining sensor." VALUE 0xa002199e _REC_S1VAL_20_u1 1. _CNV_S_2_RANGE______3_CM 0. 1. /end CHARACTERISTIC
/begin CHARACTERISTIC Cbx_sens_it_vld_cho_3 "Position value on Vsx_it_clt_vld ==0. Off -> limp home, On -> sensor." VALUE 0xa002199f _REC_S1VAL_20_u1 1. _CNV_S_2_RANGE______3_CM 0. 1. /end CHARACTERISTIC
/begin CHARACTERISTIC Cxx_dfdec_sens_it_1_nok "a_in_asi_iti_itposxx/IT Sensor 1 Plausibility detected failure counter decrement" VALUE 0xa0021970 _REC_S1VAL_20_u2 65535. _CNV_A_R_ECME_LINEA_0_CM 0. 65535. FORMAT "%5.0" /end CHARACTERISTIC
/begin CHARACTERISTIC Cxx_dfdec_sens_it_2_nok "a_in_asi_iti_itposxx/IT Sensor 2 Plausibility detected failure counter decrement" VALUE 0xa0021972 _REC_S1VAL_20_u2 65535. _CNV_A_R_ECME_LINEA_0_CM 0. 65535. FORMAT "%5.0" /end CHARACTERISTIC
/begin CHARACTERISTIC Cxx_dfdec_sens_it_chr "a_in_asi_iti_itposxx/ IT Sensor 1 and 2 Coherence detected failure counter decrement" VALUE 0xa0021974 _REC_S1VAL_20_u2 65535. _CNV_A_R_ECME_LINEA_0_CM 0. 65535. FORMAT "%5.0" /end CHARACTERISTIC
/begin CHARACTERISTIC Cxx_dfdec_sens_it_sig_mcut "IT Sensor microcut detected failure counter decrement" VALUE 0xa0021976 _REC_S1VAL_20_u2 65535. _CNV_A_R_ECME_LINEA_0_CM 0. 65535. FORMAT "%5.0" /end CHARACTERISTIC
/begin CHARACTERISTIC Cxx_dfinc_sens_it_1_nok "a_in_asi_iti_itposxx/ IT Sensor 1 Plausibility detected failure counter increment" VALUE 0xa0021978 _REC_S1VAL_20_u2 65535. _CNV_A_R_ECME_LINEA_0_CM 0. 65535. FORMAT "%5.0" /end CHARACTERISTIC
/begin CHARACTERISTIC Cxx_dfinc_sens_it_2_nok "a_in_asi_iti_itposxx/ IT Sensor 2 Plausibility detected failure counter increment" VALUE 0xa002197a _REC_S1VAL_20_u2 65535. _CNV_A_R_ECME_LINEA_0_CM 0. 65535. FORMAT "%5.0" /end CHARACTERISTIC
/begin CHARACTERISTIC Cxx_dfinc_sens_it_chr "a_in_asi_iti_itposxx/ IT Sensor 1 and 2 Coherence detected failure counter increment" VALUE 0xa002197c _REC_S1VAL_20_u2 65535. _CNV_A_R_ECME_LINEA_0_CM 0. 65535. FORMAT "%5.0" /end CHARACTERISTIC
/begin CHARACTERISTIC Cxx_dfinc_sens_it_sig_mcut "IT Sensor microcut detected failure counter increment" VALUE 0xa002197e _REC_S1VAL_20_u2 65535. _CNV_A_R_ECME_LINEA_0_CM 0. 65535. FORMAT "%5.0" /end CHARACTERISTIC
/begin CHARACTERISTIC Cxx_it_psn_stab_dly_1 "Time period to declare the sensor 1 position \"stable\" (used during learning and check)." VALUE 0xa0021980 _REC_S1VAL_20_u2 65.535 _CNV_A_R_LINEAR_____58_CM 0. 65.535 /end CHARACTERISTIC
/begin CHARACTERISTIC Cxx_it_psn_stab_dly_2 "Time period to declare the sensor 2 position \"stable\" (used during learning and check)." VALUE 0xa0021982 _REC_S1VAL_20_u2 65.535 _CNV_A_R_LINEAR_____58_CM 0. 65.535 /end CHARACTERISTIC
/begin CHARACTERISTIC Cxx_it_psn_stab_thd_1 "Threshold value to consider the stability of sensor 1 position during the learning or reading cycle." VALUE 0xa0021984 _REC_S1VAL_20_u2 100. _CNV_A_R_LINEAR_____99_CM 0. 100. FORMAT "%6.2" /end CHARACTERISTIC
/begin CHARACTERISTIC Cxx_it_psn_stab_thd_2 "Threshold value to consider the stability of sensor 2 position during the learning or reading cycle." VALUE 0xa0021986 _REC_S1VAL_20_u2 100. _CNV_A_R_LINEAR_____99_CM 0. 100. FORMAT "%6.2" /end CHARACTERISTIC
/begin CHARACTERISTIC Cxx_sens_it_1_src_max "Maximum plausible value, sensor 1." VALUE 0xa0021988 _REC_S1VAL_20_u2 100. _CNV_A_R_LINEAR_____99_CM 0. 100. FORMAT "%6.2" /end CHARACTERISTIC
/begin CHARACTERISTIC Cxx_sens_it_1_src_min "Minimum plausible value, sensor 1." VALUE 0xa002198a _REC_S1VAL_20_u2 100. _CNV_A_R_LINEAR_____99_CM 0. 100. FORMAT "%6.2" /end CHARACTERISTIC
/begin CHARACTERISTIC Cxx_sens_it_2_src_max "Maximum plausible value, sensor 2." VALUE 0xa002198c _REC_S1VAL_20_u2 100. _CNV_A_R_LINEAR_____99_CM 0. 100. FORMAT "%6.2" /end CHARACTERISTIC
/begin CHARACTERISTIC Cxx_sens_it_2_src_min "Minimum plausible value, sensor 2." VALUE 0xa002198e _REC_S1VAL_20_u2 100. _CNV_A_R_LINEAR_____99_CM 0. 100. FORMAT "%6.2" /end CHARACTERISTIC
/begin CHARACTERISTIC Cxx_sens_it_chr_fil "Time constant of the coherence diagnosis first order filter." VALUE 0xa0021990 _REC_S1VAL_20_u2 65.535 _CNV_A_R_LINEAR_____58_CM 0. 65.535 /end CHARACTERISTIC
/begin CHARACTERISTIC Cxx_sens_it_max_chr_dif "Max. abs(sensor1-sensor2), for coherence diagnosis." VALUE 0xa0021992 _REC_S1VAL_20_u2 100. _CNV_A_R_LINEAR_____99_CM 0. 100. FORMAT "%6.2" /end CHARACTERISTIC
/begin CHARACTERISTIC Cxx_sens_it_mcut_det_dly "Microcut diagnosis detection delay." VALUE 0xa0021994 _REC_S1VAL_20_u2 65.535 _CNV_A_R_LINEAR_____58_CM 0. 65.535 /end CHARACTERISTIC
/begin CHARACTERISTIC Cxx_sens_it_spd_chr_thd "Microcut diagnosis speed cohenrence thresh." VALUE 0xa0021996 _REC_S1VAL_20_u2 100. _CNV_A_R_LINEAR_____99_CM 0. 100. FORMAT "%6.2" /end CHARACTERISTIC
/begin MEASUREMENT Vbx_it_pwl_ad_req "Request to learn on next power latch phase." UBYTE _CNV_S_2_RANGE______3_CM 1 0. 0. 1. DISPLAY_IDENTIFIER OuAsoIto_NVM.Vbx_it_pwl_ad_req_NVM ECU_ADDRESS 0xd00030dc BIT_MASK 0x1 /end MEASUREMENT
/begin MEASUREMENT Vbx_it_frst_ad_ok "First learning successfully completed." UBYTE _CNV_S_2_RANGE______3_CM 1 0. 0. 1. DISPLAY_IDENTIFIER OuAsoIto_NVM.Vbx_it_frst_ad_ok_NVM ECU_ADDRESS 0xd00030dd BIT_MASK 0x1 /end MEASUREMENT
/begin MEASUREMENT Vbx_it_frst_ad_stop "End of the first learning phase, after first key on." UBYTE _CNV_S_2_RANGE______3_CM 1 0. 0. 1. DISPLAY_IDENTIFIER OuAsoIto_NVM.Vbx_it_frst_ad_stop_NVM ECU_ADDRESS 0xd00030de BIT_MASK 0x1 /end MEASUREMENT
/begin MEASUREMENT Vxx_it_clos_psn_1 "Closed position learnt on the first sensor." UWORD _CNV_A_R_LINEAR_____99_CM 1 0. 0. 100. DISPLAY_IDENTIFIER OuAsoIto_NVM.Vxx_it_clos_psn_1_NVM ECU_ADDRESS 0xd00030e0 FORMAT "%6.2" /end MEASUREMENT
/begin MEASUREMENT Vxx_it_lih_psn_1 "Limp home position learnt on the first sensor." UWORD _CNV_A_R_LINEAR_____99_CM 1 0. 0. 100. DISPLAY_IDENTIFIER OuAsoIto_NVM.Vxx_it_lih_psn_1_NVM ECU_ADDRESS 0xd00030e2 FORMAT "%6.2" /end MEASUREMENT
/begin MEASUREMENT Vxx_it_open_psn_1 "Open position learnt on the first sensor." UWORD _CNV_A_R_LINEAR_____99_CM 1 0. 0. 100. DISPLAY_IDENTIFIER OuAsoIto_NVM.Vxx_it_open_psn_1_NVM ECU_ADDRESS 0xd00030e4 FORMAT "%6.2" /end MEASUREMENT
/begin MEASUREMENT Vxx_it_clos_psn_2 "Closed position learnt on the second sensor." UWORD _CNV_A_R_LINEAR_____99_CM 1 0. 0. 100. DISPLAY_IDENTIFIER OuAsoIto_NVM.Vxx_it_clos_psn_2_NVM ECU_ADDRESS 0xd00030e6 FORMAT "%6.2" /end MEASUREMENT
/begin MEASUREMENT Vxx_it_lih_psn_2 "Limp home position learnt on the second sensor." UWORD _CNV_A_R_LINEAR_____99_CM 1 0. 0. 100. DISPLAY_IDENTIFIER OuAsoIto_NVM.Vxx_it_lih_psn_2_NVM ECU_ADDRESS 0xd00030e8 FORMAT "%6.2" /end MEASUREMENT
/begin MEASUREMENT Vxx_it_open_psn_2 "Open position learnt on the second sensor." UWORD _CNV_A_R_LINEAR_____99_CM 1 0. 0. 100. DISPLAY_IDENTIFIER OuAsoIto_NVM.Vxx_it_open_psn_2_NVM ECU_ADDRESS 0xd00030ea FORMAT "%6.2" /end MEASUREMENT
/begin MEASUREMENT Vxx_it_ofs_secu_nok_ctr "Springs check detected failure local counter" UWORD _CNV_A_R_ECME_LINEA_0_CM 1 0. 0. 65535. DISPLAY_IDENTIFIER OuAsoIto_NVM.Vxx_it_ofs_secu_nok_ctr_NVM ECU_ADDRESS 0xd00030ec FORMAT "%5.0" /end MEASUREMENT
/begin MEASUREMENT Vxx_it_ofs_meca_ctr "Offset Deviation detected failure local counter" UWORD _CNV_A_R_ECME_LINEA_0_CM 1 0. 0. 65535. DISPLAY_IDENTIFIER OuAsoIto_NVM.Vxx_it_ofs_meca_ctr_NVM ECU_ADDRESS 0xd00030ee FORMAT "%5.0" /end MEASUREMENT
/begin MEASUREMENT Vxx_it_ofs_no_norm_ctr "First Offset detected failure local counter" UWORD _CNV_A_R_ECME_LINEA_0_CM 1 0. 0. 65535. DISPLAY_IDENTIFIER OuAsoIto_NVM.Vxx_it_ofs_no_norm_ctr_NVM ECU_ADDRESS 0xd00030f0 FORMAT "%5.0" /end MEASUREMENT
/begin MEASUREMENT Vbx_df_it_ofs_meca "IT Offset Deviation detected failure" UBYTE _CNV_S_2_RANGE______3_CM 1 0. 0. 1. ECU_ADDRESS 0xd000485b BIT_MASK 0x1 /end MEASUREMENT
/begin MEASUREMENT Vbx_df_it_ofs_meca_tmp "IT Offset Deviation detected failure, temporary value" UBYTE _CNV_S_2_RANGE______3_CM 1 0. 0. 1. ECU_ADDRESS 0xd000485c BIT_MASK 0x1 /end MEASUREMENT
/begin MEASUREMENT Vbx_df_it_ofs_no_norm "IT First Offset Learning detected failure" UBYTE _CNV_S_2_RANGE______3_CM 1 0. 0. 1. ECU_ADDRESS 0xd000485d BIT_MASK 0x1 /end MEASUREMENT
/begin MEASUREMENT Vbx_df_it_ofs_no_norm_tmp "IT First Offset Learning detected failure, temporary value" UBYTE _CNV_S_2_RANGE______3_CM 1 0. 0. 1. ECU_ADDRESS 0xd000485e BIT_MASK 0x1 /end MEASUREMENT
/begin MEASUREMENT Vbx_df_it_ofs_secu_nok "IT springs check detected failure" UBYTE _CNV_S_2_RANGE______3_CM 1 0. 0. 1. ECU_ADDRESS 0xd000485f BIT_MASK 0x1 /end MEASUREMENT
/begin MEASUREMENT Vbx_df_it_ofs_secu_nok_tmp "IT springs check detected failure, tempory value" UBYTE _CNV_S_2_RANGE______3_CM 1 0. 0. 1. ECU_ADDRESS 0xd0004860 BIT_MASK 0x1 /end MEASUREMENT
/begin MEASUREMENT Vbx_df_it_reg_blk "Blocked IT during regulation detected failure" UBYTE _CNV_S_2_RANGE______3_CM 1 0. 0. 1. ECU_ADDRESS 0xd0004861 BIT_MASK 0x1 /end MEASUREMENT
/begin MEASUREMENT Vbx_diag_ena_it_ofs_1 "Offset reading diagnosis authorization 1" UBYTE _CNV_S_2_RANGE______3_CM 1 0. 0. 1. ECU_ADDRESS 0xd0004862 BIT_MASK 0x1 /end MEASUREMENT
/begin MEASUREMENT Vbx_diag_ena_it_ofs_meca "IT Offset Deviation diagnosis authorization." UBYTE _CNV_S_2_RANGE______3_CM 1 0. 0. 1. ECU_ADDRESS 0xd0004863 BIT_MASK 0x1 /end MEASUREMENT
/begin MEASUREMENT Vbx_diag_ena_it_ofs_no_norm "IT First Offset Learning diagnosis authorization" UBYTE _CNV_S_2_RANGE______3_CM 1 0. 0. 1. ECU_ADDRESS 0xd0004864 BIT_MASK 0x1 /end MEASUREMENT
/begin MEASUREMENT Vbx_diag_ena_it_ofs_secu_nok "IT springs check diagnosis authorization" UBYTE _CNV_S_2_RANGE______3_CM 1 0. 0. 1. ECU_ADDRESS 0xd0004865 BIT_MASK 0x1 /end MEASUREMENT
/begin MEASUREMENT Vbx_it_diag_ad_1 "Result of the offset reading (adaptative) diagnosis , 1st sensor." UBYTE _CNV_S_2_RANGE______3_CM 1 0. 0. 1. ECU_ADDRESS 0xd0004866 BIT_MASK 0x1 /end MEASUREMENT
/begin MEASUREMENT Vbx_it_diag_ad_2 "Result of the offset reading (adaptative) diagnosis , 2nd sensor." UBYTE _CNV_S_2_RANGE______3_CM 1 0. 0. 1. ECU_ADDRESS 0xd0004867 BIT_MASK 0x1 /end MEASUREMENT
/begin MEASUREMENT Vbx_it_diag_ad_end_1 "Indicates the end of the adaptative (offset reading) diagnosis, 1st sensor." UBYTE _CNV_S_2_RANGE______3_CM 1 0. 0. 1. ECU_ADDRESS 0xd0004868 BIT_MASK 0x1 /end MEASUREMENT
/begin MEASUREMENT Vbx_it_diag_ad_end_2 "Indicates the end of the adaptative (offset reading) diagnosis, 2nd sensor." UBYTE _CNV_S_2_RANGE______3_CM 1 0. 0. 1. ECU_ADDRESS 0xd0004869 BIT_MASK 0x1 /end MEASUREMENT
/begin MEASUREMENT Vbx_it_diag_ad_fail "Indicates an adaptative request failure." UBYTE _CNV_S_2_RANGE______3_CM 1 0. 0. 1. ECU_ADDRESS 0xd000486a BIT_MASK 0x1 /end MEASUREMENT
/begin MEASUREMENT Vbx_it_diag_ini "Flag indicating diagnosis counters initialization request." UBYTE _CNV_S_2_RANGE______3_CM 1 0. 0. 1. ECU_ADDRESS 0xd000486b BIT_MASK 0x1 /end MEASUREMENT
/begin MEASUREMENT Vbx_it_diag_psn_stab "Abnormal stable position during regulation." UBYTE _CNV_S_2_RANGE______3_CM 1 0. 0. 1. ECU_ADDRESS 0xd000486c BIT_MASK 0x1 /end MEASUREMENT
/begin MEASUREMENT Vbx_it_diag_psn_stab_det_1 "Indicates if a new sensor 1 position has to be taken in order to check the stability." UBYTE _CNV_S_2_RANGE______3_CM 1 0. 0. 1. ECU_ADDRESS 0xd000486d BIT_MASK 0x1 /end MEASUREMENT
/begin MEASUREMENT Vbx_it_diag_stab_ena "Triggers stabilization check." UBYTE _CNV_S_2_RANGE______3_CM 1 0. 0. 1. ECU_ADDRESS 0xd000486e BIT_MASK 0x1 /end MEASUREMENT
/begin MEASUREMENT Vbx_it_reset_reg_blk "Flag that resets the regulation failure detection temporization." UBYTE _CNV_S_2_RANGE______3_CM 1 0. 0. 1. ECU_ADDRESS 0xd000486f BIT_MASK 0x1 /end MEASUREMENT
/begin MEASUREMENT Vxx_it_diag_psn_stab "Reference value for stabilization check." UWORD _CNV_A_R_LINEAR_____99_CM 1 0. 0. 100. ECU_ADDRESS 0xd0003032 FORMAT "%6.2" /end MEASUREMENT
/begin MEASUREMENT Vxx_it_ofs_meca_ctr_tmp "Offset Deviation detected failure local counter. Temp. value" UWORD _CNV_A_R_ECME_LINEA_0_CM 1 0. 0. 65535. ECU_ADDRESS 0xd0003034 FORMAT "%5.0" /end MEASUREMENT
/begin MEASUREMENT Vxx_it_ofs_no_norm_ctr_tmp "First Offset detected failure local counter. Temp. value" UWORD _CNV_A_R_ECME_LINEA_0_CM 1 0. 0. 65535. ECU_ADDRESS 0xd0003036 FORMAT "%5.0" /end MEASUREMENT
/begin MEASUREMENT Vxx_it_ofs_secu_nok_ctr_tmp "Springs check detected failure local counter. Temp. value" UWORD _CNV_A_R_ECME_LINEA_0_CM 1 0. 0. 65535. ECU_ADDRESS 0xd0003038 FORMAT "%5.0" /end MEASUREMENT
/begin MEASUREMENT Vxx_it_tempo_reg_blk "Temporization for regulation failure detection." UWORD _CNV_A_R_LINEAR_____58_CM 1 0. 0. 65.535 ECU_ADDRESS 0xd000303a FORMAT "%5.3" /end MEASUREMENT
/begin CHARACTERISTIC Cxx_dfdec_it_cmd_el "a_ou_aso_ito_itdiagx/Inlet Throttle HBridge detected failure counter decrement" VALUE 0xa0021a0a _REC_S1VAL_20_u2 65535. _CNV_A_R_ECME_LINEA_0_CM 0. 65535. FORMAT "%5.0" /end CHARACTERISTIC
/begin CHARACTERISTIC Cxx_dfdec_it_ofs_meca "a_ou_aso_ito_itdiagx/IT Offset Deviation detected failure counter decrement" VALUE 0xa0021a0c _REC_S1VAL_20_u2 65535. _CNV_A_R_ECME_LINEA_0_CM 0. 65535. FORMAT "%5.0" /end CHARACTERISTIC
/begin CHARACTERISTIC Cxx_dfdec_it_ofs_no_norm "a_ou_aso_ito_itdiagx/IT First Offset detected failure counter decrement" VALUE 0xa0021a0e _REC_S1VAL_20_u2 65535. _CNV_A_R_ECME_LINEA_0_CM 0. 65535. FORMAT "%5.0" /end CHARACTERISTIC
/begin CHARACTERISTIC Cxx_dfdec_it_ofs_secu_nok "a_ou_aso_ito_itdiagx/IT springs check detected failure counter decrement" VALUE 0xa0021a10 _REC_S1VAL_20_u2 65535. _CNV_A_R_ECME_LINEA_0_CM 0. 65535. FORMAT "%5.0" /end CHARACTERISTIC
/begin CHARACTERISTIC Cxx_dfdec_it_reg_blk "a_ou_aso_ito_itdiagx/Blocked IT during regulation detected failure counter decrement" VALUE 0xa0021a12 _REC_S1VAL_20_u2 65535. _CNV_A_R_ECME_LINEA_0_CM 0. 65535. FORMAT "%5.0" /end CHARACTERISTIC
/begin CHARACTERISTIC Cxx_dfinc_it_cmd_el "a_ou_aso_ito_itdiagx/Inlet Throttle HBridge detected failure counter increment" VALUE 0xa0021a14 _REC_S1VAL_20_u2 65535. _CNV_A_R_ECME_LINEA_0_CM 0. 65535. FORMAT "%5.0" /end CHARACTERISTIC
/begin CHARACTERISTIC Cxx_dfinc_it_ofs_meca "a_ou_aso_ito_itdiagx/IT Offset Deviation detected failure counter increment" VALUE 0xa0021a16 _REC_S1VAL_20_u2 65535. _CNV_A_R_ECME_LINEA_0_CM 0. 65535. FORMAT "%5.0" /end CHARACTERISTIC
/begin CHARACTERISTIC Cxx_dfinc_it_ofs_no_norm "a_ou_aso_ito_itdiagx/IT First Offset detected failure counter increment" VALUE 0xa0021a18 _REC_S1VAL_20_u2 65535. _CNV_A_R_ECME_LINEA_0_CM 0. 65535. FORMAT "%5.0" /end CHARACTERISTIC
/begin CHARACTERISTIC Cxx_dfinc_it_ofs_secu_nok "a_ou_aso_ito_itdiagx/IT springs check detected failure counter increment" VALUE 0xa0021a1a _REC_S1VAL_20_u2 65535. _CNV_A_R_ECME_LINEA_0_CM 0. 65535. FORMAT "%5.0" /end CHARACTERISTIC
/begin CHARACTERISTIC Cxx_dfinc_it_reg_blk "a_ou_aso_ito_itdiagx/Blocked IT during regulation detected failure counter increment" VALUE 0xa0021a1c _REC_S1VAL_20_u2 65535. _CNV_A_R_ECME_LINEA_0_CM 0. 65535. FORMAT "%5.0" /end CHARACTERISTIC
/begin CHARACTERISTIC Cxx_it_diag_psn_stab_dly "Delay to detect a position stuck and stable." VALUE 0xa0021a1e _REC_S1VAL_20_u2 65.535 _CNV_A_R_LINEAR_____58_CM 0. 65.535 FORMAT "%5.3" /end CHARACTERISTIC
/begin CHARACTERISTIC Cxx_it_diag_psn_stab_thd "Position error thresh to detect a position stuck and stable." VALUE 0xa0021a20 _REC_S1VAL_20_u2 100. _CNV_A_R_LINEAR_____99_CM 0. 100. FORMAT "%6.2" /end CHARACTERISTIC
/begin CHARACTERISTIC Cxx_it_max_clos_psn "Maximum coherent closed position." VALUE 0xa0021a22 _REC_S1VAL_20_u2 100. _CNV_A_R_LINEAR_____99_CM 0. 100. FORMAT "%6.2" /end CHARACTERISTIC
/begin CHARACTERISTIC Cxx_it_max_clos_psn_dev "Maximum admissible closed position deviation during power latch check." VALUE 0xa0021a24 _REC_S1VAL_20_u2 100. _CNV_A_R_LINEAR_____99_CM 0. 100. FORMAT "%6.2" /end CHARACTERISTIC
/begin CHARACTERISTIC Cxx_it_max_lih_psn "Maximum coherent limp home position." VALUE 0xa0021a26 _REC_S1VAL_20_u2 100. _CNV_A_R_LINEAR_____99_CM 0. 100. FORMAT "%6.2" /end CHARACTERISTIC
/begin CHARACTERISTIC Cxx_it_max_lih_psn_dev "Maximum admissible limp home position deviation during power latch check." VALUE 0xa0021a28 _REC_S1VAL_20_u2 100. _CNV_A_R_LINEAR_____99_CM 0. 100. FORMAT "%6.2" /end CHARACTERISTIC
/begin CHARACTERISTIC Cxx_it_max_open_psn "Maximum coherent open position." VALUE 0xa0021a2a _REC_S1VAL_20_u2 100. _CNV_A_R_LINEAR_____99_CM 0. 100. FORMAT "%6.2" /end CHARACTERISTIC
/begin CHARACTERISTIC Cxx_it_max_open_psn_dev "Maximum admissible open position deviation during power latch check." VALUE 0xa0021a2c _REC_S1VAL_20_u2 100. _CNV_A_R_LINEAR_____99_CM 0. 100. FORMAT "%6.2" /end CHARACTERISTIC
/begin CHARACTERISTIC Cxx_it_min_clos_psn "Minimum coherent closed position." VALUE 0xa0021a2e _REC_S1VAL_20_u2 100. _CNV_A_R_LINEAR_____99_CM 0. 100. FORMAT "%6.2" /end CHARACTERISTIC
/begin CHARACTERISTIC Cxx_it_min_lih_psn "Minimum coherent limp home position." VALUE 0xa0021a30 _REC_S1VAL_20_u2 100. _CNV_A_R_LINEAR_____99_CM 0. 100. FORMAT "%6.2" /end CHARACTERISTIC
/begin CHARACTERISTIC Cxx_it_min_open_psn "Minimum coherent open position." VALUE 0xa0021a32 _REC_S1VAL_20_u2 100. _CNV_A_R_LINEAR_____99_CM 0. 100. FORMAT "%6.2" /end CHARACTERISTIC
/begin CHARACTERISTIC Cxx_it_ofs_meca_decr "Offset Deviation detected failure local counter decrement" VALUE 0xa0021a34 _REC_S1VAL_20_u2 65535. _CNV_A_R_ECME_LINEA_0_CM 0. 65535. FORMAT "%5.0" /end CHARACTERISTIC
/begin CHARACTERISTIC Cxx_it_ofs_meca_incr "Offset Deviation detected failure local counter increment" VALUE 0xa0021a36 _REC_S1VAL_20_u2 65535. _CNV_A_R_ECME_LINEA_0_CM 0. 65535. FORMAT "%5.0" /end CHARACTERISTIC
/begin CHARACTERISTIC Cxx_it_ofs_no_norm_decr "First Offset detected failure local counter decrement" VALUE 0xa0021a38 _REC_S1VAL_20_u2 65535. _CNV_A_R_ECME_LINEA_0_CM 0. 65535. FORMAT "%5.0" /end CHARACTERISTIC
/begin CHARACTERISTIC Cxx_it_ofs_no_norm_incr "First Offset detected failure local counter increment" VALUE 0xa0021a3a _REC_S1VAL_20_u2 65535. _CNV_A_R_ECME_LINEA_0_CM 0. 65535. FORMAT "%5.0" /end CHARACTERISTIC
/begin CHARACTERISTIC Cxx_it_ofs_secu_nok_decr "Springs check detected failure local counter decrement" VALUE 0xa0021a3c _REC_S1VAL_20_u2 65535. _CNV_A_R_ECME_LINEA_0_CM 0. 65535. FORMAT "%5.0" /end CHARACTERISTIC
/begin CHARACTERISTIC Cxx_it_ofs_secu_nok_incr "Springs check detected failure local counter increment" VALUE 0xa0021a3e _REC_S1VAL_20_u2 65535. _CNV_A_R_ECME_LINEA_0_CM 0. 65535. FORMAT "%5.0" /end CHARACTERISTIC
/begin CHARACTERISTIC Cxx_it_reg_blk_det_dly "Delay to detect a regulation failure." VALUE 0xa0021a40 _REC_S1VAL_20_u2 65.535 _CNV_A_R_LINEAR_____58_CM 0. 65.535 FORMAT "%5.3" /end CHARACTERISTIC
/begin CHARACTERISTIC Cxx_it_reg_blk_max_err "Position error thresh to detect regulation failure." VALUE 0xa0021a42 _REC_S1VAL_20_u2 100. _CNV_A_R_LINEAR_____99_CM 0. 100. FORMAT "%6.2" /end CHARACTERISTIC
/begin CHARACTERISTIC Cxx_it_reg_blk_max_err_2 "Position error thresh to detect a blocked and stable position." VALUE 0xa0021a44 _REC_S1VAL_20_u2 100. _CNV_A_R_LINEAR_____99_CM 0. 100. FORMAT "%6.2" /end CHARACTERISTIC
/begin CHARACTERISTIC Cxx_it_reg_blk_v_max_thd "Voltage upper saturation thresh to detect regulation failure." VALUE 0xa0021a46 _REC_S1VAL_20_u2 25000. _CNV_A_R_LINEAR_____52_CM 0. 25000. FORMAT "%5.0" /end CHARACTERISTIC
/begin CHARACTERISTIC Cxx_it_reg_blk_v_min_thd "Voltage lower saturation thresh to detect regulation failure." VALUE 0xa0021a48 _REC_S1VAL_20_s2 25000. _CNV_A_R_LINEAR_____52_CM -25000. 0. FORMAT "%6.0" /end CHARACTERISTIC
/begin AXIS_PTS Ctb_it_frst_ad_t "Breakpoint table for the first learning cycle. Used for position setpoint." 0xa002a9b4 Vxx_it_cyc_remaining_t _REC_A2AXS_20_u2 65.535 _CNV_A_R_LINEAR_____58_CM 32 0. 65.535 FORMAT "%5.3" /end AXIS_PTS
/begin AXIS_PTS Ctb_it_frst_ad_t_2 "Breakpoint table for the first learning cycle. Used for cycle request." 0xa002a9f8 Vxx_it_cyc_remaining_t _REC_A2AXS_20_u2 65.535 _CNV_A_R_LINEAR_____58_CM 32 0. 65.535 FORMAT "%5.3" /end AXIS_PTS
/begin AXIS_PTS Ctb_it_ol_v_psn "Breakpoint table for open loop control." 0xa002aa3c Vxx_fil1_it_psn_sp _REC_A2AXS_20_u2 200. _CNV_A_R_LINEAR_____94_CM 16 0. 200. FORMAT "%4.2" /end AXIS_PTS
/begin AXIS_PTS Ctb_it_pwl_ad_t "Breakpoint table for the power latch cycle. Used for position setpoint." 0xa002aa60 Vxx_it_cyc_remaining_t _REC_A2AXS_20_u2 65.535 _CNV_A_R_LINEAR_____58_CM 32 0. 65.535 FORMAT "%5.3" /end AXIS_PTS
/begin AXIS_PTS Ctb_it_pwl_ad_t_2 "Breakpoint table for the power latch cycle. Used for cycle request." 0xa002aaa4 Vxx_it_cyc_remaining_t _REC_A2AXS_20_u2 65.535 _CNV_A_R_LINEAR_____58_CM 32 0. 65.535 FORMAT "%5.3" /end AXIS_PTS
/begin CHARACTERISTIC Ctd_it_frst_ad_deci "Indexed Table. Decision on reading failure, during first learning cycle." CURVE 0xa002aae8 _REC_A1CUR_20_u1_u2 5. _CNV_A_R_ECME_LINEA_0_CM 1. 6. FORMAT "%1.0"
 /begin AXIS_DESCR COM_AXIS Vxx_it_cyc_remaining_t _CNV_A_R_LINEAR_____58_CM 32 0. 65.535 FORMAT "%5.3" AXIS_PTS_REF Ctb_it_frst_ad_t_2 /end AXIS_DESCR
/end CHARACTERISTIC
/begin CHARACTERISTIC Ctd_it_frst_ad_req "Indexed table. Type of request profile during first learning." CURVE 0xa002ab08 _REC_A1CUR_20_u1_u2 12. _CNV_A_R_ECME_LINEA_0_CM 1. 13. FORMAT "%3.0"
 /begin AXIS_DESCR COM_AXIS Vxx_it_cyc_remaining_t _CNV_A_R_LINEAR_____58_CM 32 0. 65.535 FORMAT "%5.3" AXIS_PTS_REF Ctb_it_frst_ad_t_2 /end AXIS_DESCR
/end CHARACTERISTIC
/begin CHARACTERISTIC Ctd_it_frst_ad_v_cut "Indexed Table. H-Bridge shutdown requests for the first learning cycle." CURVE 0xa002ab28 _REC_A1CUR_20_u1_u2 1. _CNV_S_2_RANGE______3_CM 0. 1.
 /begin AXIS_DESCR COM_AXIS Vxx_it_cyc_remaining_t _CNV_A_R_LINEAR_____58_CM 32 0. 65.535 FORMAT "%5.3" AXIS_PTS_REF Ctb_it_frst_ad_t /end AXIS_DESCR
/end CHARACTERISTIC
/begin CHARACTERISTIC Ctd_it_pwl_ad_deci "Indexed Table. Decision on reading failure during power latch cycle." CURVE 0xa002ab48 _REC_A1CUR_20_u1_u2 5. _CNV_A_R_ECME_LINEA_0_CM 1. 6. FORMAT "%1.0"
 /begin AXIS_DESCR COM_AXIS Vxx_it_cyc_remaining_t _CNV_A_R_LINEAR_____58_CM 32 0. 65.535 FORMAT "%5.3" AXIS_PTS_REF Ctb_it_pwl_ad_t_2 /end AXIS_DESCR
/end CHARACTERISTIC
/begin CHARACTERISTIC Ctd_it_pwl_ad_req "Indexed Table. Type of request profile during  power latch check cycle." CURVE 0xa002ab68 _REC_A1CUR_20_u1_u2 12. _CNV_A_R_ECME_LINEA_0_CM 1. 13. FORMAT "%3.0"
 /begin AXIS_DESCR COM_AXIS Vxx_it_cyc_remaining_t _CNV_A_R_LINEAR_____58_CM 32 0. 65.535 FORMAT "%5.3" AXIS_PTS_REF Ctb_it_pwl_ad_t_2 /end AXIS_DESCR
/end CHARACTERISTIC
/begin CHARACTERISTIC Ctd_it_pwl_ad_v_cut "Indexed Table. H-Bridge shutdown requests for the power latch check cycle." CURVE 0xa002ab88 _REC_A1CUR_20_u1_u2 1. _CNV_S_2_RANGE______3_CM 0. 1.
 /begin AXIS_DESCR COM_AXIS Vxx_it_cyc_remaining_t _CNV_A_R_LINEAR_____58_CM 32 0. 65.535 FORMAT "%5.3" AXIS_PTS_REF Ctb_it_pwl_ad_t /end AXIS_DESCR
/end CHARACTERISTIC
/begin CHARACTERISTIC Ctp_it_frst_ad_sp "Cartography of the position setpoint for the first learning cycle." CURVE 0xa002aba8 _REC_A1CUR_20_u2_u2 100. _CNV_A_R_LINEAR_____99_CM 0. 100. FORMAT "%6.2"
 /begin AXIS_DESCR COM_AXIS Vxx_it_cyc_remaining_t _CNV_A_R_LINEAR_____58_CM 32 0. 65.535 FORMAT "%5.3" AXIS_PTS_REF Ctb_it_frst_ad_t /end AXIS_DESCR
/end CHARACTERISTIC
/begin CHARACTERISTIC Ctp_it_ol_v "Cartography of Voltage for open loop control." CURVE 0xa002abe8 _REC_A1CUR_20_u2_u2 50000. _CNV_A_R_LINEAR_____182_CM -25000. 25000. FORMAT "%6.0"
 /begin AXIS_DESCR COM_AXIS Vxx_fil1_it_psn_sp _CNV_A_R_LINEAR_____94_CM 16 0. 200. FORMAT "%4.2" AXIS_PTS_REF Ctb_it_ol_v_psn /end AXIS_DESCR
/end CHARACTERISTIC
/begin CHARACTERISTIC Ctp_it_pwl_ad_sp "Cartography of the position setpoint for the first power latch cycle." CURVE 0xa002ac08 _REC_A1CUR_20_u2_u2 100. _CNV_A_R_LINEAR_____99_CM 0. 100. FORMAT "%6.2"
 /begin AXIS_DESCR COM_AXIS Vxx_it_cyc_remaining_t _CNV_A_R_LINEAR_____58_CM 32 0. 65.535 FORMAT "%5.3" AXIS_PTS_REF Ctb_it_pwl_ad_t /end AXIS_DESCR
/end CHARACTERISTIC
/begin MEASUREMENT Vbx_diag_ena_it_ofs "Offset reading diagnosis authorization." UBYTE _CNV_S_2_RANGE______3_CM 1 0. 0. 1. ECU_ADDRESS 0xd0004b9a BIT_MASK 0x1 /end MEASUREMENT
/begin MEASUREMENT Vbx_diag_ena_it_reg_blk "Blocked IT during regulation diagnosis authorization" UBYTE _CNV_S_2_RANGE______3_CM 1 0. 0. 1. ECU_ADDRESS 0xd0004b9b BIT_MASK 0x1 /end MEASUREMENT
/begin MEASUREMENT Vbx_it_ad_cyc_end "Indicates the end of the learning or check cycle." UBYTE _CNV_S_2_RANGE______3_CM 1 0. 0. 1. ECU_ADDRESS 0xd0004b9c BIT_MASK 0x1 /end MEASUREMENT
/begin MEASUREMENT Vbx_it_ad_cyc_end_mem "Indicates the end of the learning or check cycle. Local variable of learning stateflow." UBYTE _CNV_S_2_RANGE______3_CM 1 0. 0. 1. ECU_ADDRESS 0xd0004b9d BIT_MASK 0x1 /end MEASUREMENT
/begin MEASUREMENT Vbx_it_ad_cyc_v_cut "Request from the Cycle Generation to cut the H-Bridge, during learning or check." UBYTE _CNV_S_2_RANGE______3_CM 1 0. 0. 1. ECU_ADDRESS 0xd0004b9e BIT_MASK 0x1 /end MEASUREMENT
/begin MEASUREMENT Vbx_it_ad_ena "Enables adaptative request." UBYTE _CNV_S_2_RANGE______3_CM 1 0. 0. 1. ECU_ADDRESS 0xd0004b9f BIT_MASK 0x1 /end MEASUREMENT
/begin MEASUREMENT Vbx_it_ad_v_lim_stop "Flag indicating the end of voltage limitation during thrust learning" UBYTE _CNV_S_2_RANGE______3_CM 1 0. 0. 1. ECU_ADDRESS 0xd0004ba0 BIT_MASK 0x1 /end MEASUREMENT
/begin MEASUREMENT Vbx_it_cyc_cho "Type of cycle that is executed (1: power latch check, 0 : complete learning)" UBYTE _CNV_S_2_RANGE______3_CM 1 0. 0. 1. ECU_ADDRESS 0xd0004ba1 BIT_MASK 0x1 /end MEASUREMENT
/begin MEASUREMENT Vbx_it_cyc_inter "Indicates that a check or relearning cycle was interrupted." UBYTE _CNV_S_2_RANGE______3_CM 1 0. 0. 1. ECU_ADDRESS 0xd0004ba2 BIT_MASK 0x1 /end MEASUREMENT
/begin MEASUREMENT Vbx_it_hbrg_inh "H-Bridge inhibition request." UBYTE _CNV_S_2_RANGE______3_CM 1 0. 0. 1. ECU_ADDRESS 0xd0004ba3 BIT_MASK 0x1 /end MEASUREMENT
/begin MEASUREMENT Vbx_it_igk_on "Indicates a key on interrupting a power latch phase." UBYTE _CNV_S_2_RANGE______3_CM 1 0. 0. 1. ECU_ADDRESS 0xd0004ba4 BIT_MASK 0x1 /end MEASUREMENT
/begin MEASUREMENT Vbx_it_imd_ad_req "Request to relearn immediately, during power latch phase." UBYTE _CNV_S_2_RANGE______3_CM 1 0. 0. 1. ECU_ADDRESS 0xd0004ba5 BIT_MASK 0x1 /end MEASUREMENT
/begin MEASUREMENT Vbx_it_imd_ad_req_tmp "Request to relearn immediately, during power latch phase. Temp.value" UBYTE _CNV_S_2_RANGE______3_CM 1 0. 0. 1. ECU_ADDRESS 0xd0004ba6 BIT_MASK 0x1 /end MEASUREMENT
/begin MEASUREMENT Vbx_it_mon_mv_ena_1 "Enables mean value calculation, 1st sensor." UBYTE _CNV_S_2_RANGE______3_CM 1 0. 0. 1. ECU_ADDRESS 0xd0004ba7 BIT_MASK 0x1 /end MEASUREMENT
/begin MEASUREMENT Vbx_it_mon_mv_ena_2 "Enables mean value calculation, 2nd sensor." UBYTE _CNV_S_2_RANGE______3_CM 1 0. 0. 1. ECU_ADDRESS 0xd0004ba8 BIT_MASK 0x1 /end MEASUREMENT
/begin MEASUREMENT Vbx_it_mon_read_ena "Enables reading and stability check." UBYTE _CNV_S_2_RANGE______3_CM 1 0. 0. 1. ECU_ADDRESS 0xd0004ba9 BIT_MASK 0x1 /end MEASUREMENT
/begin MEASUREMENT Vbx_it_ofs_diag_ena_1 "Enables offset reading diagnosis, 1st sensor." UBYTE _CNV_S_2_RANGE______3_CM 1 0. 0. 1. ECU_ADDRESS 0xd0004baa BIT_MASK 0x1 /end MEASUREMENT
/begin MEASUREMENT Vbx_it_ofs_diag_ena_2 "Enables offset reading diagnosis, 2nd sensor." UBYTE _CNV_S_2_RANGE______3_CM 1 0. 0. 1. ECU_ADDRESS 0xd0004bab BIT_MASK 0x1 /end MEASUREMENT
/begin MEASUREMENT Vbx_it_pwl_bgin "Indicates the beginning of the power latch phase." UBYTE _CNV_S_2_RANGE______3_CM 1 0. 0. 1. ECU_ADDRESS 0xd0004bac BIT_MASK 0x1 /end MEASUREMENT
/begin MEASUREMENT Vbx_it_pwl_end "End of powerlatch phase. IT available for basis software tests." UBYTE _CNV_S_2_RANGE______3_CM 1 0. 0. 1. ECU_ADDRESS 0xd0004bad BIT_MASK 0x1 /end MEASUREMENT
/begin MEASUREMENT Vbx_it_pws_req "Request to maintain the power latch." UBYTE _CNV_S_2_RANGE______3_CM 1 0. 0. 1. ECU_ADDRESS 0xd0004bae BIT_MASK 0x1 /end MEASUREMENT
/begin MEASUREMENT Vbx_it_read_ok_1 "Reading on 1st sensor was successfully completed." UBYTE _CNV_S_2_RANGE______3_CM 1 0. 0. 1. ECU_ADDRESS 0xd0004baf BIT_MASK 0x1 /end MEASUREMENT
/begin MEASUREMENT Vbx_it_read_ok_2 "Reading on 2nd sensor was successfully completed." UBYTE _CNV_S_2_RANGE______3_CM 1 0. 0. 1. ECU_ADDRESS 0xd0004bb0 BIT_MASK 0x1 /end MEASUREMENT
/begin MEASUREMENT Vbx_it_req_fail_1 "Indicates a request failure, first sensor." UBYTE _CNV_S_2_RANGE______3_CM 1 0. 0. 1. ECU_ADDRESS 0xd0004bb1 BIT_MASK 0x1 /end MEASUREMENT
/begin MEASUREMENT Vbx_it_req_fail_2 "Indicates a request failure, second sensor." UBYTE _CNV_S_2_RANGE______3_CM 1 0. 0. 1. ECU_ADDRESS 0xd0004bb2 BIT_MASK 0x1 /end MEASUREMENT
/begin MEASUREMENT Vbx_it_sta_dsb "Throttle not available for engine start (search phase)" UBYTE _CNV_S_2_RANGE______3_CM 1 0. 0. 1. ECU_ADDRESS 0xd0004bb3 BIT_MASK 0x1 /end MEASUREMENT
/begin MEASUREMENT Vbx_it_temp_no_ok "Indicates that the temperature is too high or too low to learn thrusts and limp home." UBYTE _CNV_S_2_RANGE______3_CM 1 0. 0. 1. ECU_ADDRESS 0xd0004bb4 BIT_MASK 0x1 /end MEASUREMENT
/begin MEASUREMENT Vbx_it_trigger_1 "Trigger. Local variable" UBYTE _CNV_S_2_RANGE______3_CM 1 0. 0. 1. ECU_ADDRESS 0xd0004bb5 BIT_MASK 0x1 /end MEASUREMENT
/begin MEASUREMENT Vbx_it_trigger_2 "Trigger. Local variable" UBYTE _CNV_S_2_RANGE______3_CM 1 0. 0. 1. ECU_ADDRESS 0xd0004bb6 BIT_MASK 0x1 /end MEASUREMENT
/begin MEASUREMENT Vbx_it_trigger_3 "Trigger. Local variable" UBYTE _CNV_S_2_RANGE______3_CM 1 0. 0. 1. ECU_ADDRESS 0xd0004bb7 BIT_MASK 0x1 /end MEASUREMENT
/begin MEASUREMENT Vbx_it_trigger_4 "Trigger. Local variable" UBYTE _CNV_S_2_RANGE______3_CM 1 0. 0. 1. ECU_ADDRESS 0xd0004bb8 BIT_MASK 0x1 /end MEASUREMENT
/begin MEASUREMENT Vbx_it_trigger_5 "Trigger. Local variable" UBYTE _CNV_S_2_RANGE______3_CM 1 0. 0. 1. ECU_ADDRESS 0xd0004bb9 BIT_MASK 0x1 /end MEASUREMENT
/begin MEASUREMENT Vbx_it_trigger_ofs_1 "Trigger. Local variable" UBYTE _CNV_S_2_RANGE______3_CM 1 0. 0. 1. ECU_ADDRESS 0xd0004bba BIT_MASK 0x1 /end MEASUREMENT
/begin MEASUREMENT Vbx_it_trigger_ofs_2 "Trigger. Local variable" UBYTE _CNV_S_2_RANGE______3_CM 1 0. 0. 1. ECU_ADDRESS 0xd0004bbb BIT_MASK 0x1 /end MEASUREMENT
/begin MEASUREMENT Vbx_it_trigger_ofs_3 "Trigger. Local variable" UBYTE _CNV_S_2_RANGE______3_CM 1 0. 0. 1. ECU_ADDRESS 0xd0004bbc BIT_MASK 0x1 /end MEASUREMENT
/begin MEASUREMENT Vbx_it_trigger_ofs_4 "Trigger. Local variable" UBYTE _CNV_S_2_RANGE______3_CM 1 0. 0. 1. ECU_ADDRESS 0xd0004bbd BIT_MASK 0x1 /end MEASUREMENT
/begin MEASUREMENT Vbx_it_trigger_ofs_5 "Trigger. Local variable" UBYTE _CNV_S_2_RANGE______3_CM 1 0. 0. 1. ECU_ADDRESS 0xd0004bbe BIT_MASK 0x1 /end MEASUREMENT
/begin MEASUREMENT Vbx_it_trigger_ofs_6 "Trigger. Local variable" UBYTE _CNV_S_2_RANGE______3_CM 1 0. 0. 1. ECU_ADDRESS 0xd0004bbf BIT_MASK 0x1 /end MEASUREMENT
/begin MEASUREMENT Vbx_it_v_sp_cho "Voltage setpoint choice (if one, regulation mode, if 0, open loop)." UBYTE _CNV_S_2_RANGE______3_CM 1 0. 0. 1. ECU_ADDRESS 0xd0004bc0 BIT_MASK 0x1 /end MEASUREMENT
/begin MEASUREMENT Vbx_it_write_ena "Enables offset writing" UBYTE _CNV_S_2_RANGE______3_CM 1 0. 0. 1. ECU_ADDRESS 0xd0004bc1 BIT_MASK 0x1 /end MEASUREMENT
/begin MEASUREMENT Vsx_it_ctl_vld "Inlet throttle control system validity status." UBYTE _CNV_A_R_ECME_LINEA_0_CM 1 0. 0. 255. ECU_ADDRESS 0xd0004bc2 FORMAT "%3.0" /end MEASUREMENT
/begin MEASUREMENT Vsx_it_vld "Inlet throttle validity status" UBYTE _CNV_A_R_ECME_LINEA_0_CM 1 0. 0. 255. ECU_ADDRESS 0xd0004bc3 FORMAT "%3.0" /end MEASUREMENT
/begin MEASUREMENT Vxx_fil1_it_abs_psn_sp "IT absolute position reference from the Air System." UWORD _CNV_A_R_LINEAR_____94_CM 1 0. 0. 200. ECU_ADDRESS 0xd00030f4 FORMAT "%6.2" /end MEASUREMENT
/begin MEASUREMENT Vxx_it_ad_cyc_req "Current learning or reading type of request. From the Cycle Generation." UBYTE _CNV_A_R_ECME_LINEA_0_CM 1 0. 1. 13. ECU_ADDRESS 0xd0004bc4 FORMAT "%3.0" /end MEASUREMENT
/begin MEASUREMENT Vxx_it_ad_cyc_sp "Position reference from the Cycle Generation (used during learning or check cycles)." UWORD _CNV_A_R_LINEAR_____99_CM 1 0. 0. 100. ECU_ADDRESS 0xd00030f6 FORMAT "%6.2" /end MEASUREMENT
/begin MEASUREMENT Vxx_it_ad_deci "Decision to execute in case of learning or check failure. After Dynamic Configuration." UBYTE _CNV_A_R_ECME_LINEA_0_CM 1 0. 1. 6. ECU_ADDRESS 0xd0004bc5 FORMAT "%1.0" /end MEASUREMENT
/begin MEASUREMENT Vxx_it_ad_fail_deci "Decision to execute in case of learning or check failure. From the Cycle Generation." UBYTE _CNV_A_R_ECME_LINEA_0_CM 1 0. 1. 6. ECU_ADDRESS 0xd0004bc6 FORMAT "%1.0" /end MEASUREMENT
/begin MEASUREMENT Vxx_it_ad_fail_deci_mem "Decision to execute in case of learning or check failure. Memorized value.  From Learning stateflow" UBYTE _CNV_A_R_ECME_LINEA_0_CM 1 0. 1. 6. ECU_ADDRESS 0xd0004bc7 FORMAT "%1.0" /end MEASUREMENT
/begin MEASUREMENT Vxx_it_ad_pb "A problem occured during reading request." UBYTE _CNV_A_R_ECME_LINEA_0_CM 1 0. 1. 6. ECU_ADDRESS 0xd0004bc8 FORMAT "%1.0" /end MEASUREMENT
/begin MEASUREMENT Vxx_it_ad_req "Current reading or learning type of request." UBYTE _CNV_A_R_ECME_LINEA_0_CM 1 0. 1. 13. ECU_ADDRESS 0xd0004bc9 FORMAT "%2.0" /end MEASUREMENT
/begin MEASUREMENT Vxx_it_ad_req_mem "Learning or reading type of request. Memorized value. From the Learn or Check state flow." UBYTE _CNV_A_R_ECME_LINEA_0_CM 1 0. 1. 13. ECU_ADDRESS 0xd0004bca FORMAT "%3.0" /end MEASUREMENT
/begin MEASUREMENT Vxx_it_ad_stt "State of the Learn or Check (adaptative) stateflow" UBYTE _CNV_A_R_ECME_LINEA_0_CM 1 0. 1. 5. ECU_ADDRESS 0xd0004bcb FORMAT "%3.0" /end MEASUREMENT
/begin MEASUREMENT Vxx_it_ad_typ "Type of cycle that is processing. 1 : first learning, 2 : pwl check, 3 : pwl relearning" UBYTE _CNV_A_R_ECME_LINEA_0_CM 1 0. 1. 4. ECU_ADDRESS 0xd0004bcc FORMAT "%3.0" /end MEASUREMENT
/begin MEASUREMENT Vxx_it_clos_psn "Closed position of the inlet throttle." UWORD _CNV_A_R_LINEAR_____99_CM 1 0. 0. 100. ECU_ADDRESS 0xd00030f8 FORMAT "%6.2" /end MEASUREMENT
/begin MEASUREMENT Vxx_it_cyc_nr "Number of learning or check cycles that occured." UBYTE _CNV_A_R_ECME_LINEA_0_CM 1 0. 0. 8. ECU_ADDRESS 0xd0004bcd FORMAT "%3.0" /end MEASUREMENT
/begin MEASUREMENT Vxx_it_cyc_remaining_t "Remaining time before end of learning or check cycle." UWORD _CNV_A_R_LINEAR_____58_CM 1 0. 0. 65.535 ECU_ADDRESS 0xd00030fa FORMAT "%5.3" /end MEASUREMENT
/begin MEASUREMENT Vxx_it_diag_fail_mode "Failure mode requested." UBYTE _CNV_A_R_ECME_LINEA_0_CM 1 0. 0. 2. ECU_ADDRESS 0xd0004bce FORMAT "%1.0" /end MEASUREMENT
/begin MEASUREMENT Vxx_it_lih_psn "Limp home position of the inlet throttle." UWORD _CNV_A_R_LINEAR_____99_CM 1 0. 0. 100. ECU_ADDRESS 0xd00030fc FORMAT "%6.2" /end MEASUREMENT
/begin MEASUREMENT Vxx_it_mon_psn_sp "Position setpoint sent by the monitoring system." UWORD _CNV_A_R_LINEAR_____99_CM 1 0. 0. 100. ECU_ADDRESS 0xd00030fe FORMAT "%6.2" /end MEASUREMENT
/begin MEASUREMENT Vxx_it_mon_v_sp "Voltage setpoint for open loop control. Value sent to the H bridge." SWORD _CNV_A_R_LINEAR_____52_CM 1 0. -25000. 25000. ECU_ADDRESS 0xd0003100 FORMAT "%6.0" /end MEASUREMENT
/begin MEASUREMENT Vxx_it_ofs_1 "Current value read by the Reading stateflow, 1st sensor." UWORD _CNV_A_R_LINEAR_____99_CM 1 0. 0. 100. ECU_ADDRESS 0xd0003102 FORMAT "%6.2" /end MEASUREMENT
/begin MEASUREMENT Vxx_it_ofs_2 "Current value read by the Reading stateflow, 2nd sensor." UWORD _CNV_A_R_LINEAR_____99_CM 1 0. 0. 100. ECU_ADDRESS 0xd0003104 FORMAT "%6.2" /end MEASUREMENT
/begin MEASUREMENT Vxx_it_ofs_ctr_1 "Internal counter, offset reading stateflow 1." UWORD _CNV_A_R_ECME_LINEA_0_CM 1 0. 1. 512. ECU_ADDRESS 0xd0003106 FORMAT "%3.0" /end MEASUREMENT
/begin MEASUREMENT Vxx_it_ofs_ctr_2 "Internal counter, offset reading stateflow 2." UWORD _CNV_A_R_ECME_LINEA_0_CM 1 0. 1. 512. ECU_ADDRESS 0xd0003108 FORMAT "%3.0" /end MEASUREMENT
/begin MEASUREMENT Vxx_it_ofs_down "Minimum value of the position setpoint." UWORD _CNV_A_R_LINEAR_____99_CM 1 0. 0. 100. ECU_ADDRESS 0xd000310a FORMAT "%6.2" /end MEASUREMENT
/begin MEASUREMENT Vxx_it_ofs_up "Maximum value of the position setpoint." UWORD _CNV_A_R_LINEAR_____99_CM 1 0. 0. 100. ECU_ADDRESS 0xd000310c FORMAT "%6.2" /end MEASUREMENT
/begin MEASUREMENT Vxx_it_ol_ctr "Counter for the open loop control request." UBYTE _CNV_A_R_ECME_LINEA_0_CM 1 0. 0. 3. ECU_ADDRESS 0xd0004bcf FORMAT "%1.0" /end MEASUREMENT
/begin MEASUREMENT Vxx_it_open_psn "Open position  of the inlet throttle" UWORD _CNV_A_R_LINEAR_____99_CM 1 0. 0. 100. ECU_ADDRESS 0xd000310e FORMAT "%6.2" /end MEASUREMENT
/begin MEASUREMENT Vxx_it_read_stt_1 "State of the Reading stateflow, 1st sensor." UBYTE _CNV_A_R_ECME_LINEA_0_CM 1 0. 1. 5. ECU_ADDRESS 0xd0004bd0 FORMAT "%3.0" /end MEASUREMENT
/begin MEASUREMENT Vxx_it_read_stt_2 "State of the Reading stateflow, 2nd sensor." UBYTE _CNV_A_R_ECME_LINEA_0_CM 1 0. 1. 5. ECU_ADDRESS 0xd0004bd1 FORMAT "%3.0" /end MEASUREMENT
/begin MEASUREMENT Vxx_it_rel_psn "Relative throttle position in percent of the sensor supply voltage." UWORD _CNV_A_R_LINEAR_____99_CM 1 0. 0. 100. ECU_ADDRESS 0xd0003110 FORMAT "%6.2" /end MEASUREMENT
/begin MEASUREMENT Vxx_it_rge_down "Range near the low voltage thrust where the thrust approach strategy is activated." UWORD _CNV_A_R_LINEAR_____99_CM 1 0. 0. 100. ECU_ADDRESS 0xd0003112 FORMAT "%6.2" /end MEASUREMENT
/begin MEASUREMENT Vxx_it_rge_up "Range near the high voltage thrust where the thrust approach strategy is activated." UWORD _CNV_A_R_LINEAR_____99_CM 1 0. 0. 100. ECU_ADDRESS 0xd0003114 FORMAT "%6.2" /end MEASUREMENT
/begin MEASUREMENT Vxx_it_stt "State of the main state flow." UBYTE _CNV_A_R_ECME_LINEA_0_CM 1 0. 1. 11. ECU_ADDRESS 0xd0004bd2 FORMAT "%3.0" /end MEASUREMENT
/begin MEASUREMENT Vxx_it_stt_ctr "Internal counter, main stateflow." UWORD _CNV_A_R_ECME_LINEA_0_CM 1 0. 0. 65535. ECU_ADDRESS 0xd0003116 FORMAT "%5.0" /end MEASUREMENT
/begin MEASUREMENT Vxx_it_v_lim_down "Minimum value of the it command voltage." SWORD _CNV_A_R_LINEAR_____52_CM 1 0. -25000. 0. ECU_ADDRESS 0xd0003118 FORMAT "%6.0" /end MEASUREMENT
/begin MEASUREMENT Vxx_it_v_lim_up "Maximum value of the it command voltage." UWORD _CNV_A_R_LINEAR_____52_CM 1 0. 0. 25000. ECU_ADDRESS 0xd000311a FORMAT "%5.0" /end MEASUREMENT
/begin MEASUREMENT Vxx_mv_it_rel_psn "Filtered relative throttle position in percent of the sensor supply voltage." UWORD _CNV_A_R_LINEAR_____99_CM 1 0. 0. 100. ECU_ADDRESS 0xd000311c FORMAT "%6.2" /end MEASUREMENT
/begin CHARACTERISTIC Cbx_it_ad_req "Forces complete learning cycle." VALUE 0xa0021e5c _REC_S1VAL_20_u1 1. _CNV_S_2_RANGE______3_CM 0. 1. /end CHARACTERISTIC
/begin CHARACTERISTIC Cbx_it_ad_sat_v_lim "Enables to saturate the command immediately during a learning request" VALUE 0xa0021e5d _REC_S1VAL_20_u1 1. _CNV_S_2_RANGE______3_CM 0. 1. /end CHARACTERISTIC
/begin CHARACTERISTIC Cbx_it_bch_mod_ena "Triggers the bench mode" VALUE 0xa0021e5e _REC_S1VAL_20_u1 1. _CNV_S_2_RANGE______3_CM 0. 1. /end CHARACTERISTIC
/begin CHARACTERISTIC Cbx_it_igk_on_ad_ena "Enables relearning during key on." VALUE 0xa0021e5f _REC_S1VAL_20_u1 1. _CNV_S_2_RANGE______3_CM 0. 1. /end CHARACTERISTIC
/begin CHARACTERISTIC Cbx_it_mon_1_sens_ad "Enables adaptative cycle while only one sensor is OK." VALUE 0xa0021e60 _REC_S1VAL_20_u1 1. _CNV_S_2_RANGE______3_CM 0. 1. /end CHARACTERISTIC
/begin CHARACTERISTIC Cbx_it_sens_vld_2_fail_cho "Global validity configuration on sensor Ivld==2." VALUE 0xa0021e61 _REC_S1VAL_20_u1 1. _CNV_S_2_RANGE______3_CM 0. 1. /end CHARACTERISTIC
/begin CHARACTERISTIC Cbx_it_sens_vld_3_fail_cho "Global validity configuration on sensor Ivld==3." VALUE 0xa0021e62 _REC_S1VAL_20_u1 1. _CNV_S_2_RANGE______3_CM 0. 1. /end CHARACTERISTIC
/begin CHARACTERISTIC Cxx_it_ad_rge_down "Range for the closed position approach, during learning or check." VALUE 0xa0021e30 _REC_S1VAL_20_u2 100. _CNV_A_R_LINEAR_____99_CM 0. 100. FORMAT "%6.2" /end CHARACTERISTIC
/begin CHARACTERISTIC Cxx_it_ad_rge_up "Range for the open position approach, during learning or check." VALUE 0xa0021e32 _REC_S1VAL_20_u2 100. _CNV_A_R_LINEAR_____99_CM 0. 100. FORMAT "%6.2" /end CHARACTERISTIC
/begin CHARACTERISTIC Cxx_it_ad_v_lim_down "Voltage lower saturation during learning or check cycle after first servo controller saturation.." VALUE 0xa0021e34 _REC_S1VAL_20_s2 25000. _CNV_A_R_LINEAR_____52_CM -25000. 0. FORMAT "%6.0" /end CHARACTERISTIC
/begin CHARACTERISTIC Cxx_it_ad_v_lim_up "Voltage upper saturation during learning or check cycle after first servo controller saturation.." VALUE 0xa0021e36 _REC_S1VAL_20_u2 25000. _CNV_A_R_LINEAR_____52_CM 0. 25000. FORMAT "%5.0" /end CHARACTERISTIC
/begin CHARACTERISTIC Cxx_it_clos_psn_ini "Closed position of the inlet throttle, default value." VALUE 0xa0021e38 _REC_S1VAL_20_u2 100. _CNV_A_R_LINEAR_____99_CM 0. 100. FORMAT "%6.2" /end CHARACTERISTIC
/begin CHARACTERISTIC Cxx_it_frst_ad_t "First learning cycle duration." VALUE 0xa0021e3a _REC_S1VAL_20_u2 65.535 _CNV_A_R_LINEAR_____58_CM 0. 65.535 FORMAT "%5.3" /end CHARACTERISTIC
/begin CHARACTERISTIC Cxx_it_learn_max_temp "Maximum temperature to allow learning." VALUE 0xa0021e3c _REC_S1VAL_20_u2 240. _CNV_A_R_LINEAR_____54_CM -40. 200. FORMAT "%5.1" /end CHARACTERISTIC
/begin CHARACTERISTIC Cxx_it_learn_min_temp "Minimum temperature to allow learning." VALUE 0xa0021e3e _REC_S1VAL_20_u2 240. _CNV_A_R_LINEAR_____54_CM -40. 200. FORMAT "%5.1" /end CHARACTERISTIC
/begin CHARACTERISTIC Cxx_it_lih_psn_ini "Limp home position of the inlet throttle, default value." VALUE 0xa0021e40 _REC_S1VAL_20_u2 100. _CNV_A_R_LINEAR_____99_CM 0. 100. FORMAT "%6.2" /end CHARACTERISTIC
/begin CHARACTERISTIC Cxx_it_ofs_ctr_max_1 "Number of samples for the mean value calculation, sensor 1." VALUE 0xa0021e42 _REC_S1VAL_20_u2 511. _CNV_A_R_ECME_LINEA_0_CM 1. 512. FORMAT "%3.0" /end CHARACTERISTIC
/begin CHARACTERISTIC Cxx_it_ofs_ctr_max_2 "Number of samples for the mean value calculation, sensor 2." VALUE 0xa0021e44 _REC_S1VAL_20_u2 511. _CNV_A_R_ECME_LINEA_0_CM 1. 512. FORMAT "%3.0" /end CHARACTERISTIC
/begin CHARACTERISTIC Cxx_it_open_psn_ini "Open position of the inlet throttle, default value." VALUE 0xa0021e46 _REC_S1VAL_20_u2 100. _CNV_A_R_LINEAR_____99_CM 0. 100. FORMAT "%6.2" /end CHARACTERISTIC
/begin CHARACTERISTIC Cxx_it_psn_ftc "Throttle position filtering factor" VALUE 0xa0021e48 _REC_S1VAL_20_u2 65.535 _CNV_A_R_LINEAR_____58_CM 0. 65.535 FORMAT "%5.3" /end CHARACTERISTIC
/begin CHARACTERISTIC Cxx_it_pwl_ad_t "Power latch check cycle duration." VALUE 0xa0021e4a _REC_S1VAL_20_u2 65.535 _CNV_A_R_LINEAR_____58_CM 0. 65.535 FORMAT "%5.3" /end CHARACTERISTIC
/begin CHARACTERISTIC Cxx_it_rge_down "Range for the closed position approach, during regulation." VALUE 0xa0021e4c _REC_S1VAL_20_u2 100. _CNV_A_R_LINEAR_____99_CM 0. 100. FORMAT "%6.2" /end CHARACTERISTIC
/begin CHARACTERISTIC Cxx_it_rge_up "Range for the open position approach, during regulation." VALUE 0xa0021e4e _REC_S1VAL_20_u2 100. _CNV_A_R_LINEAR_____99_CM 0. 100. FORMAT "%6.2" /end CHARACTERISTIC
/begin CHARACTERISTIC Cxx_it_stt_frst_ctr "Waiting time (number of samples) before first learning." VALUE 0xa0021e50 _REC_S1VAL_20_u2 65535. _CNV_A_R_ECME_LINEA_0_CM 0. 65535. FORMAT "%5.0" /end CHARACTERISTIC
/begin CHARACTERISTIC Cxx_it_stt_pwl_check_ctr "Waiting time (number of samples) before power latch check." VALUE 0xa0021e52 _REC_S1VAL_20_u2 65535. _CNV_A_R_ECME_LINEA_0_CM 0. 65535. FORMAT "%5.0" /end CHARACTERISTIC
/begin CHARACTERISTIC Cxx_it_stt_pwl_end_ctr "Waiting time (number of steps) after the end of the pwl cycle before shutdown." VALUE 0xa0021e54 _REC_S1VAL_20_u2 65535. _CNV_A_R_ECME_LINEA_0_CM 0. 65535. FORMAT "%5.0" /end CHARACTERISTIC
/begin CHARACTERISTIC Cxx_it_stt_pwl_learn_ctr "Waiting time (number of samples) before power latch relearning." VALUE 0xa0021e56 _REC_S1VAL_20_u2 65535. _CNV_A_R_ECME_LINEA_0_CM 0. 65535. FORMAT "%5.0" /end CHARACTERISTIC
/begin CHARACTERISTIC Cxx_it_v_lim_down "Minimum value of the it command voltage during regulation." VALUE 0xa0021e58 _REC_S1VAL_20_s2 25000. _CNV_A_R_LINEAR_____52_CM -25000. 0. FORMAT "%6.0" /end CHARACTERISTIC
/begin CHARACTERISTIC Cxx_it_v_lim_up "Maximum value of the it command voltage during regulation." VALUE 0xa0021e5a _REC_S1VAL_20_u2 25000. _CNV_A_R_LINEAR_____52_CM 0. 25000. FORMAT "%5.0" /end CHARACTERISTIC
/begin MEASUREMENT Vbx_it_psn_sp_slop_ena "Boolean to start the slope generation for the position setpoint, during thrust approach" UBYTE _CNV_S_2_RANGE______3_CM 1 0. 0. 1. ECU_ADDRESS 0xd0004ff7 BIT_MASK 0x1 /end MEASUREMENT
/begin MEASUREMENT Vbx_it_v_lim_down "Indicates that the maximum negative command voltage was reached." UBYTE _CNV_S_2_RANGE______3_CM 1 0. 0. 1. ECU_ADDRESS 0xd0004ff8 BIT_MASK 0x1 /end MEASUREMENT
/begin MEASUREMENT Vbx_it_v_lim_up "Indicates that the maximum positive command voltage was reached." UBYTE _CNV_S_2_RANGE______3_CM 1 0. 0. 1. ECU_ADDRESS 0xd0004ff9 BIT_MASK 0x1 /end MEASUREMENT
/begin MEASUREMENT Vxx_it_cmd_val "Output of the S controller." SLONG _CNV_A_R_LINEAR_____183_CM 1 0. -25. 24.9999990234375 ECU_ADDRESS 0xd00016e4 FORMAT "%16.12" /end MEASUREMENT
/begin MEASUREMENT Vxx_it_cmd_val_1 "Output of the S1 component of the S controller." SLONG _CNV_A_R_LINEAR_____183_CM 1 0. -25. 24.9999990234375 ECU_ADDRESS 0xd00016e8 FORMAT "%16.12" /end MEASUREMENT
/begin MEASUREMENT Vxx_it_cmd_val_2 "Output of the S2 component of the S controller." SLONG _CNV_A_R_LINEAR_____183_CM 1 0. -25. 24.9999990234375 ECU_ADDRESS 0xd00016ec FORMAT "%16.12" /end MEASUREMENT
/begin MEASUREMENT Vxx_it_cmd_val_3 "Output of the S3 component of the S controller." SLONG _CNV_A_R_LINEAR_____183_CM 1 0. -25. 24.9999990234375 ECU_ADDRESS 0xd00016f0 FORMAT "%16.12" /end MEASUREMENT
/begin MEASUREMENT Vxx_it_cmd_val_lim "Voltage setpoint given by the RST Controller." SWORD _CNV_A_R_LINEAR_____108_CM 1 0. -25. 25. ECU_ADDRESS 0xd0002efe FORMAT "%7.3" /end MEASUREMENT
/begin MEASUREMENT Vxx_it_cmd_val_lim_1 "Voltage setpoint given by the RST Controller in mV." SWORD _CNV_A_R_LINEAR_____52_CM 1 0. -25000. 25000. ECU_ADDRESS 0xd0002f00 FORMAT "%6.0" /end MEASUREMENT
/begin MEASUREMENT Vxx_it_ctl_err "Difference between the outputs of the T and R controller. Similar to a position error." SLONG _CNV_A_R_LINEAR_____184_CM 1 0. -8192. 8191.875 ECU_ADDRESS 0xd00016f4 FORMAT "%13.7" /end MEASUREMENT
/begin MEASUREMENT Vxx_it_ctl_err_lim "Saturated value of Vxx_it_ctl_err. Input of the S controller." SWORD _CNV_A_R_LINEAR_____108_CM 1 0. -25. 25. ECU_ADDRESS 0xd0002f02 FORMAT "%7.3" /end MEASUREMENT
/begin MEASUREMENT Vxx_it_frn_cps_v "Friction Compensation Voltage added to Vxx_it_cmd_val_lim." SWORD _CNV_A_R_LINEAR_____52_CM 1 0. -25000. 25000. ECU_ADDRESS 0xd0002f04 FORMAT "%6.0" /end MEASUREMENT
/begin MEASUREMENT Vxx_it_lim_down_thd "Position threshold to activate the approach strategy near the closed thrust." UWORD _CNV_A_R_LINEAR_____99_CM 1 0. 0. 100. ECU_ADDRESS 0xd0002f06 FORMAT "%6.2" /end MEASUREMENT
/begin MEASUREMENT Vxx_it_lim_up_thd "Position threshold to activate the approach strategy near the open thrust." UWORD _CNV_A_R_LINEAR_____99_CM 1 0. 0. 100. ECU_ADDRESS 0xd0002f08 FORMAT "%6.2" /end MEASUREMENT
/begin MEASUREMENT Vxx_it_psn_ctl "Output of the Controller R." SLONG _CNV_A_R_LINEAR_____184_CM 1 0. -8192. 8191.875 ECU_ADDRESS 0xd00016f8 FORMAT "%13.7" /end MEASUREMENT
/begin MEASUREMENT Vxx_it_psn_ctl_0 "Ouput of the coefficient R0 of the RST Controller." ULONG _CNV_A_R_LINEAR_____184_CM 1 0. 0. 8191.875 ECU_ADDRESS 0xd00016fc FORMAT "%12.7" /end MEASUREMENT
/begin MEASUREMENT Vxx_it_psn_ctl_1 "Ouput of the coefficient R1 of the RST Controller." ULONG _CNV_A_R_LINEAR_____184_CM 1 0. 0. 8191.875 ECU_ADDRESS 0xd0001700 FORMAT "%12.7" /end MEASUREMENT
/begin MEASUREMENT Vxx_it_psn_ctl_2 "Ouput of the coefficient R2 of the RST Controller." ULONG _CNV_A_R_LINEAR_____184_CM 1 0. 0. 8191.875 ECU_ADDRESS 0xd0001704 FORMAT "%12.7" /end MEASUREMENT
/begin MEASUREMENT Vxx_it_psn_ctl_3 "Ouput of the coefficient R3 of the RST Controller." ULONG _CNV_A_R_LINEAR_____184_CM 1 0. 0. 8191.875 ECU_ADDRESS 0xd0001708 FORMAT "%12.7" /end MEASUREMENT
/begin MEASUREMENT Vxx_it_psn_reg_1 "IT position used by the controller." UWORD _CNV_A_R_LINEAR_____99_CM 1 0. 0. 100. ECU_ADDRESS 0xd0002f0a FORMAT "%6.2" /end MEASUREMENT
/begin MEASUREMENT Vxx_it_psn_reg_3 "Output of the dead zone filter." UWORD _CNV_A_R_LINEAR_____99_CM 1 0. 0. 100. ECU_ADDRESS 0xd0002f0c FORMAT "%6.2" /end MEASUREMENT
/begin MEASUREMENT Vxx_it_psn_sp_cor_1 "Input of the position setpoint slope. Used during the thrust approach." UWORD _CNV_A_R_LINEAR_____99_CM 1 0. 0. 100. ECU_ADDRESS 0xd0002f0e FORMAT "%6.2" /end MEASUREMENT
/begin MEASUREMENT Vxx_it_psn_sp_ctl "Output of the T controller." SLONG _CNV_A_R_LINEAR_____184_CM 1 0. -8192. 8191.875 ECU_ADDRESS 0xd000170c FORMAT "%13.7" /end MEASUREMENT
/begin MEASUREMENT Vxx_it_psn_sp_ctl_0 "Output of the first component of the T controller." ULONG _CNV_A_R_LINEAR_____184_CM 1 0. 0. 8191.875 ECU_ADDRESS 0xd0001710 FORMAT "%12.7" /end MEASUREMENT
/begin MEASUREMENT Vxx_it_psn_sp_ctl_1 "Output of the second component of the T controller." ULONG _CNV_A_R_LINEAR_____184_CM 1 0. 0. 8191.875 ECU_ADDRESS 0xd0001714 FORMAT "%12.7" /end MEASUREMENT
/begin MEASUREMENT Vxx_it_psn_sp_ctl_2 "Output of the third component of the T controller." ULONG _CNV_A_R_LINEAR_____184_CM 1 0. 0. 8191.875 ECU_ADDRESS 0xd0001718 FORMAT "%12.7" /end MEASUREMENT
/begin MEASUREMENT Vxx_it_psn_sp_mod "Used to indicate if the position setpoint has to be modified by the thrust approach strategy." UBYTE _CNV_A_R_ECME_LINEA_0_CM 1 0. 0. 16. ECU_ADDRESS 0xd0004ffa FORMAT "%3.0" /end MEASUREMENT
/begin MEASUREMENT Vxx_it_psn_sp_reg "Absolute position setpoint really given to the RST controller." UWORD _CNV_A_R_LINEAR_____99_CM 1 0. 0. 100. ECU_ADDRESS 0xd0002f10 FORMAT "%6.2" /end MEASUREMENT
/begin MEASUREMENT Vxx_it_psn_sp_slop "Position setpoint given by a slope system, when position and setpoint are near a thrust." UWORD _CNV_A_R_LINEAR_____99_CM 1 0. 0. 100. ECU_ADDRESS 0xd0002f12 FORMAT "%6.2" /end MEASUREMENT
/begin MEASUREMENT Vxx_it_v_sp "Voltage setpoint given by the RST regulator and sent to the component." SWORD _CNV_A_R_LINEAR_____52_CM 1 0. -25000. 25000. ECU_ADDRESS 0xd0002f14 FORMAT "%6.0" /end MEASUREMENT
/begin MEASUREMENT Vxx_it_v_sp_cor_lim "Voltage setpoint given to the H bridge." SWORD _CNV_A_R_LINEAR_____52_CM 1 0. -25000. 25000. ECU_ADDRESS 0xd0002f16 FORMAT "%6.0" /end MEASUREMENT
/begin CHARACTERISTIC Cbx_it_psn_ctl_sgn "Allow to invert the sign of Vxx_it_psn_ctl." VALUE 0xa0020c76 _REC_S1VAL_20_u1 1. _CNV_S_2_RANGE______3_CM 0. 1. /end CHARACTERISTIC
/begin CHARACTERISTIC Cbx_it_psn_fil_cho_1 "Choice between the filtered position and the raw position. If 1, filtered." VALUE 0xa0020c77 _REC_S1VAL_20_u1 1. _CNV_S_2_RANGE______3_CM 0. 1. /end CHARACTERISTIC
/begin CHARACTERISTIC Cbx_it_psn_sp_ctl_sgn "Allow to invert the sign of  Vxx_it_psn_sp_ctl." VALUE 0xa0020c78 _REC_S1VAL_20_u1 1. _CNV_S_2_RANGE______3_CM 0. 1. /end CHARACTERISTIC
/begin CHARACTERISTIC Cxx_it_cmd_val_1 "Parameter corresponding to the S1 coefficient of the RST Controller." VALUE 0xa0020c4e _REC_S1VAL_20_s2 1.999969482421875 _CNV_A_R_LINEAR_____170_CM -1. 0.999969482421875 FORMAT "%9.6" /end CHARACTERISTIC
/begin CHARACTERISTIC Cxx_it_cmd_val_2 "Parameter corresponding to the S2 coefficient of the RST Controller." VALUE 0xa0020c50 _REC_S1VAL_20_s2 1.999969482421875 _CNV_A_R_LINEAR_____170_CM -1. 0.999969482421875 FORMAT "%9.6" /end CHARACTERISTIC
/begin CHARACTERISTIC Cxx_it_cmd_val_3 "Parameter corresponding to the S3 coefficient of the RST Controller." VALUE 0xa0020c52 _REC_S1VAL_20_s2 1.999969482421875 _CNV_A_R_LINEAR_____170_CM -1. 0.999969482421875 FORMAT "%9.6" /end CHARACTERISTIC
/begin CHARACTERISTIC Cxx_it_cps_v "Constant Compensation Voltage (if needed)." VALUE 0xa0020c54 _REC_S1VAL_20_s2 50000. _CNV_A_R_LINEAR_____52_CM -25000. 25000. FORMAT "%6.0" /end CHARACTERISTIC
/begin CHARACTERISTIC Cxx_it_ctl_lim "Limitation used in the RST controller to take into account the max. battery voltage." VALUE 0xa0020c56 _REC_S1VAL_20_s2 50. _CNV_A_R_LINEAR_____108_CM -25. 25. FORMAT "%7.3" /end CHARACTERISTIC
/begin CHARACTERISTIC Cxx_it_ctl_psn_sp_stab_thd "Range of setpoint variation under which the setpoint can be considered as stable." VALUE 0xa0020c58 _REC_S1VAL_20_u2 100. _CNV_A_R_LINEAR_____99_CM 0. 100. FORMAT "%6.2" /end CHARACTERISTIC
/begin CHARACTERISTIC Cxx_it_ctl_psn_stab_thd "Threshold value to consider the stability of position in the dead zone filter." VALUE 0xa0020c5a _REC_S1VAL_20_u2 100. _CNV_A_R_LINEAR_____99_CM 0. 100. FORMAT "%6.2" /end CHARACTERISTIC
/begin CHARACTERISTIC Cxx_it_ctl_psn_thd "Second position threshold to keep the dead zone filter active." VALUE 0xa0020c5c _REC_S1VAL_20_u2 100. _CNV_A_R_LINEAR_____99_CM 0. 100. FORMAT "%6.2" /end CHARACTERISTIC
/begin CHARACTERISTIC Cxx_it_ctl_stab_dly "Time period of the first position stability control before activating the Dead Zone Filter." VALUE 0xa0020c5e _REC_S1VAL_20_u2 65.535 _CNV_A_R_LINEAR_____58_CM 0. 65.535 FORMAT "%5.3" /end CHARACTERISTIC
/begin CHARACTERISTIC Cxx_it_frn_cps_v "Absolute value of the Friction Compensation Voltage." VALUE 0xa0020c60 _REC_S1VAL_20_s2 50000. _CNV_A_R_LINEAR_____52_CM -25000. 25000. FORMAT "%6.0" /end CHARACTERISTIC
/begin CHARACTERISTIC Cxx_it_psn_ctl_0 "Coefficient R0 of the RST Controller." VALUE 0xa0020c62 _REC_S1VAL_20_u2 81.91875 _CNV_A_R_LINEAR_____185_CM 0. 81.91875 FORMAT "%8.5" /end CHARACTERISTIC
/begin CHARACTERISTIC Cxx_it_psn_ctl_1 "Coefficient R1 of the RST Controller." VALUE 0xa0020c64 _REC_S1VAL_20_u2 81.91875 _CNV_A_R_LINEAR_____185_CM 0. 81.91875 FORMAT "%8.5" /end CHARACTERISTIC
/begin CHARACTERISTIC Cxx_it_psn_ctl_2 "Coefficient R2 of the RST Controller." VALUE 0xa0020c66 _REC_S1VAL_20_u2 81.91875 _CNV_A_R_LINEAR_____185_CM 0. 81.91875 FORMAT "%8.5" /end CHARACTERISTIC
/begin CHARACTERISTIC Cxx_it_psn_ctl_3 "Coefficient R3 of the RST Controller." VALUE 0xa0020c68 _REC_S1VAL_20_u2 81.91875 _CNV_A_R_LINEAR_____185_CM 0. 81.91875 FORMAT "%8.5" /end CHARACTERISTIC
/begin CHARACTERISTIC Cxx_it_psn_frn_cps_thd "Interval between the setpoint and the position where the friction compensation is disabled." VALUE 0xa0020c6a _REC_S1VAL_20_u2 100. _CNV_A_R_LINEAR_____99_CM 0. 100. FORMAT "%6.2" /end CHARACTERISTIC
/begin CHARACTERISTIC Cxx_it_psn_slop_lim_down "Slope corresponding to the maximum negative approach speed of the closed thrust." VALUE 0xa0020c6c _REC_S1VAL_20_u2 100. _CNV_A_R_LINEAR_____186_CM -100. 0. FORMAT "%6.2" /end CHARACTERISTIC
/begin CHARACTERISTIC Cxx_it_psn_slop_lim_up "Slope corresponding to the maximum approach speed of the open thrust." VALUE 0xa0020c6e _REC_S1VAL_20_u2 100. _CNV_A_R_LINEAR_____99_CM 0. 100. FORMAT "%6.2" /end CHARACTERISTIC
/begin CHARACTERISTIC Cxx_it_psn_sp_ctl_0 "Coefficient T0 of the RST Controller." VALUE 0xa0020c70 _REC_S1VAL_20_u2 81.91875 _CNV_A_R_LINEAR_____185_CM 0. 81.91875 FORMAT "%8.5" /end CHARACTERISTIC
/begin CHARACTERISTIC Cxx_it_psn_sp_ctl_1 "Coefficient T1 of the RST Controller." VALUE 0xa0020c72 _REC_S1VAL_20_u2 81.91875 _CNV_A_R_LINEAR_____185_CM 0. 81.91875 FORMAT "%8.5" /end CHARACTERISTIC
/begin CHARACTERISTIC Cxx_it_psn_sp_ctl_2 "Coefficient T2 of the RST Controller." VALUE 0xa0020c74 _REC_S1VAL_20_u2 81.91875 _CNV_A_R_LINEAR_____185_CM 0. 81.91875 FORMAT "%8.5" /end CHARACTERISTIC
/begin MEASUREMENT Vsx_wgc_vld "Wastegate validity status" UBYTE _CNV_S_3_STATUS_OK__120_CM 1 0. 0. 2. ECU_ADDRESS 0xd0004619 /end MEASUREMENT
/begin CHARACTERISTIC Cxx_dfdec_wgc_oc "Open circuit of wastegate detected failure counter decrement" VALUE 0xa0021714 _REC_S1VAL_20_u2 65535. _CNV_A_R_ECME_LINEA_0_CM 0. 65535. FORMAT "%5.0" /end CHARACTERISTIC
/begin CHARACTERISTIC Cxx_dfdec_wgc_scg "Short circuit to ground of wastegate detected failure counter decrement" VALUE 0xa0021716 _REC_S1VAL_20_u2 65535. _CNV_A_R_ECME_LINEA_0_CM 0. 65535. FORMAT "%5.0" /end CHARACTERISTIC
/begin CHARACTERISTIC Cxx_dfdec_wgc_scw "Short circuit to battery of wastegate detected failure counter decrement" VALUE 0xa0021718 _REC_S1VAL_20_u2 65535. _CNV_A_R_ECME_LINEA_0_CM 0. 65535. FORMAT "%5.0" /end CHARACTERISTIC
/begin CHARACTERISTIC Cxx_dfinc_wgc_oc "Short circuit of wastegate detected failure counter increment" VALUE 0xa002171a _REC_S1VAL_20_u2 65535. _CNV_A_R_ECME_LINEA_0_CM 0. 65535. FORMAT "%5.0" /end CHARACTERISTIC
/begin CHARACTERISTIC Cxx_dfinc_wgc_scg "Short circuit to ground of wastegate detected failure counter increment" VALUE 0xa002171c _REC_S1VAL_20_u2 65535. _CNV_A_R_ECME_LINEA_0_CM 0. 65535. FORMAT "%5.0" /end CHARACTERISTIC
/begin CHARACTERISTIC Cxx_dfinc_wgc_scw "Short circuit to battery of wastegate detected failure counter increment" VALUE 0xa002171e _REC_S1VAL_20_u2 65535. _CNV_A_R_ECME_LINEA_0_CM 0. 65535. FORMAT "%5.0" /end CHARACTERISTIC
/begin CHARACTERISTIC Cmp_n_prs_mat_ftc "Map of the filter time constant of the simulated valve gaz temperature." MAP 0xa002e6e8 _REC_A1MAP_20_u1_u2_u2 25.5 _CNV_A_R_LINEAR_____4_CM 0. 25.5 FORMAT "%4.1"
 /begin AXIS_DESCR COM_AXIS Vxx_n _CNV_A_R_ENSD_LINEA_24_CM 9 0. 16383.75 FORMAT "%8.2" AXIS_PTS_REF Ctb_n2 /end AXIS_DESCR
 /begin AXIS_DESCR COM_AXIS Vxx_map _CNV_A_R_LINEAR_____57_CM 9 0. 20000. FORMAT "%5.0" AXIS_PTS_REF Ctb_prs2 /end AXIS_DESCR
/end CHARACTERISTIC
/begin CHARACTERISTIC Ctp_n_mat_fac "Coefficient table n∞1 depending on engine speed" CURVE 0xa002e73c _REC_A1CUR_20_u1_u2 1. _CNV_A_R_LINEAR_____118_CM 0. 1. FORMAT "%9.7"
 /begin AXIS_DESCR COM_AXIS Vxx_n _CNV_A_R_ENSD_LINEA_24_CM 20 0. 16383.75 FORMAT "%8.2" AXIS_PTS_REF Ctb_n /end AXIS_DESCR
/end CHARACTERISTIC
/begin CHARACTERISTIC Ctp_prs_mat_fac "Coefficient table n∞2 depending on the pressure" CURVE 0xa002e750 _REC_A1CUR_20_u1_u2 1.9921875 _CNV_A_R_LINEAR_____187_CM -1. 0.9921875 FORMAT "%9.6"
 /begin AXIS_DESCR COM_AXIS Vxx_map _CNV_A_R_LINEAR_____57_CM 17 0. 20000. FORMAT "%5.0" AXIS_PTS_REF Ctb_prs /end AXIS_DESCR
/end CHARACTERISTIC
/begin MEASUREMENT Vsx_vlv_air_temp_vld "Validity indicator of valve air temperature" UBYTE _CNV_S_3_STATUS_OK__120_CM 1 0. 0. 2. ECU_ADDRESS 0xd0005690 /end MEASUREMENT
/begin MEASUREMENT Vxx_mat_fac "Coefficient between mat and tco to creat vlv_air_temp" UBYTE _CNV_A_R_LINEAR_____31_CM 1 0. 0. 0.99609375 ECU_ADDRESS 0xd0003d62 FORMAT "%5.3" /end MEASUREMENT
/begin MEASUREMENT Vxx_vlv_air_temp "Simulated valve gaz temperature" UWORD _CNV_A_R_LINEAR_____54_CM 1 0. -40. 200. ECU_ADDRESS 0xd0003604 FORMAT "%5.1" /end MEASUREMENT
/begin MEASUREMENT Vxx_vlv_air_temp_ftc "Filter time constant of the simulated valve gaz temperature" UBYTE _CNV_A_R_LINEAR_____4_CM 1 0. 0. 25.5 ECU_ADDRESS 0xd0005691 FORMAT "%4.1" /end MEASUREMENT
/begin CHARACTERISTIC Cxx_mat_fac "Coefficient n∞3" VALUE 0xa0020c84 _REC_S1VAL_20_u1 0.99609375 _CNV_A_R_LINEAR_____31_CM 0. 0.99609375 FORMAT "%5.3" /end CHARACTERISTIC
/begin AXIS_PTS Ctb_mat2 "Table of 9 programmable breakpoints of air temperature" 0xa0022a0c NO_INPUT_QUANTITY _REC_A2AXS_20_u2 240. _CNV_A_R_LINEAR_____54_CM 9 -40. 200. FORMAT "%5.1" /end AXIS_PTS
/begin MEASUREMENT Vsx_mdl_mat_vld "Manifold air temperature model validity status" UBYTE _CNV_S_2_STATUS_OK__188_CM 1 0. 0. 1. ECU_ADDRESS 0xd0005217 /end MEASUREMENT
/begin MEASUREMENT Vxx_mdl_mat "Manifold air temperature (model)" UWORD _CNV_A_R_LINEAR_____54_CM 1 0. -40. 200. ECU_ADDRESS 0xd0005ad2 FORMAT "%5.1" /end MEASUREMENT
/begin CHARACTERISTIC Cxx_mem_mat_fail_max_mat "Maximum MAT when the sensor failure is memorized" VALUE 0xa002159c _REC_S1VAL_20_u2 240. _CNV_A_R_LINEAR_____54_CM -40. 200. FORMAT "%5.1" /end CHARACTERISTIC
/begin MEASUREMENT Vsx_mat_vld "Manifold air temperature validity status" UBYTE _CNV_S_3_STATUS_OK__158_CM 1 0. 0. 2. ECU_ADDRESS 0xd000421b /end MEASUREMENT
/begin MEASUREMENT Vxx_mat "Manifold air temperature" UWORD _CNV_A_R_LINEAR_____54_CM 1 0. -40. 200. ECU_ADDRESS 0xd000580c FORMAT "%5.1" /end MEASUREMENT
/begin MEASUREMENT Vxx_sqrt_mat "Square root of the manifold temperature" UBYTE _CNV_A_R_LINEAR_____189_CM 1 0. 15. 21.97265625 ECU_ADDRESS 0xd000545a FORMAT "%10.8" /end MEASUREMENT
/begin CHARACTERISTIC Cxx_mat_fail_val "Mainfold air temperature default value" VALUE 0xa00213a4 _REC_S1VAL_20_u2 240. _CNV_A_R_LINEAR_____54_CM -40. 200. FORMAT "%5.1" /end CHARACTERISTIC
/begin MEASUREMENT Vsx_sens_mat_vld "Manifold air temperature sensor validity status" UBYTE _CNV_S_3_STATUS_OK__158_CM 1 0. 0. 2. ECU_ADDRESS 0xd0005723 /end MEASUREMENT
/begin MEASUREMENT Vxx_sens_mat "Manifold air temperature (sensor)" UWORD _CNV_A_R_LINEAR_____54_CM 1 0. -40. 200. ECU_ADDRESS 0xd0005b12 FORMAT "%5.1" /end MEASUREMENT
/begin CHARACTERISTIC Cxx_dfdec_sens_mat "Manifold air temperature sensor detected failure counter decrement" VALUE 0xa0021902 _REC_S1VAL_20_u2 65535. _CNV_A_R_ECME_LINEA_0_CM 0. 65535. FORMAT "%5.0" /end CHARACTERISTIC
/begin CHARACTERISTIC Cxx_dfinc_sens_mat "Manifold air temperature sensor detected failure counter increment" VALUE 0xa0021904 _REC_S1VAL_20_u2 65535. _CNV_A_R_ECME_LINEA_0_CM 0. 65535. FORMAT "%5.0" /end CHARACTERISTIC
/begin MEASUREMENT Vsx_up_it_temp_vld "Upstream throttle temperature validity status" UBYTE _CNV_S_3_STATUS_OK__120_CM 1 0. 0. 2. ECU_ADDRESS 0xd00052d4 /end MEASUREMENT
/begin MEASUREMENT Vxx_sqrt_up_it_temp "Square root of the inlet throttle upstream temperature in K^1/2" UBYTE _CNV_A_R_LINEAR_____189_CM 1 0. 15. 21.97265625 ECU_ADDRESS 0xd00052d5 FORMAT "%10.8" /end MEASUREMENT
/begin MEASUREMENT Vxx_up_it_temp "Intake throttle upstream air temperature" UWORD _CNV_A_R_LINEAR_____54_CM 1 0. -40. 200. ECU_ADDRESS 0xd0005986 FORMAT "%5.1" /end MEASUREMENT
/begin AXIS_PTS Ctb_sta_tco "Coolant temperature breakpoints for starting set point tables" 0xa002dfe4 Vxx_tco _REC_A2AXS_20_u2 240. _CNV_A_R_LINEAR_____54_CM 8 -40. 200. FORMAT "%5.1" /end AXIS_PTS
/begin AXIS_PTS Ctb_tco "16 engine coolant temperature breakpoints" 0xa002dff8 Vxx_tco _REC_A2AXS_20_u2 240. _CNV_A_R_LINEAR_____54_CM 16 -40. 200. FORMAT "%5.1" /end AXIS_PTS
/begin AXIS_PTS Ctb_tco2 "Engine coolant temperature breakpoints" 0xa002e01c Vxx_tco _REC_A2AXS_20_u2 240. _CNV_A_R_LINEAR_____54_CM 9 -40. 200. FORMAT "%5.1" /end AXIS_PTS
/begin MEASUREMENT Vxb_sta_tco.factor "" UWORD _CNV_A_R_A_165_CM 1 0. 0. 65535. ECU_ADDRESS 0xd0005570 /end MEASUREMENT
/begin MEASUREMENT Vxb_sta_tco.index "" UBYTE _CNV_A_R_A_165_CM 1 0. 0. 255. ECU_ADDRESS 0xd0005572 /end MEASUREMENT
/begin MEASUREMENT Vxb_sta_tco.num_dp "" UBYTE _CNV_A_R_A_165_CM 1 0. 0. 255. ECU_ADDRESS 0xd0005573 /end MEASUREMENT
/begin MEASUREMENT Vxb_tco.factor "" UWORD _CNV_A_R_A_165_CM 1 0. 0. 65535. ECU_ADDRESS 0xd0005574 /end MEASUREMENT
/begin MEASUREMENT Vxb_tco.index "" UBYTE _CNV_A_R_A_165_CM 1 0. 0. 255. ECU_ADDRESS 0xd0005576 /end MEASUREMENT
/begin MEASUREMENT Vxb_tco.num_dp "" UBYTE _CNV_A_R_A_165_CM 1 0. 0. 255. ECU_ADDRESS 0xd0005577 /end MEASUREMENT
/begin MEASUREMENT Vxb_tco2.factor "" UWORD _CNV_A_R_A_165_CM 1 0. 0. 65535. ECU_ADDRESS 0xd0005578 /end MEASUREMENT
/begin MEASUREMENT Vxb_tco2.index "" UBYTE _CNV_A_R_A_165_CM 1 0. 0. 255. ECU_ADDRESS 0xd000557a /end MEASUREMENT
/begin MEASUREMENT Vxb_tco2.num_dp "" UBYTE _CNV_A_R_A_165_CM 1 0. 0. 255. ECU_ADDRESS 0xd000557b /end MEASUREMENT
/begin MEASUREMENT Vsx_sta_tco_vld "Engine coolant temperature during engine starting validity status" UBYTE _CNV_S_3_STATUS_OK__120_CM 1 0. 0. 2. ECU_ADDRESS 0xd000557c /end MEASUREMENT
/begin MEASUREMENT Vsx_tco_vld "engine coolant temperature validity status" UBYTE _CNV_S_3_STATUS_OK__120_CM 1 0. 0. 2. ECU_ADDRESS 0xd000557d /end MEASUREMENT
/begin MEASUREMENT Vxx_sta_tco "Starting coolant temperature" UWORD _CNV_A_R_LINEAR_____54_CM 1 0. -40. 200. ECU_ADDRESS 0xd00059b6 FORMAT "%5.1" /end MEASUREMENT
/begin MEASUREMENT Vxx_tco "Engine coolant temperature" UWORD _CNV_A_R_LINEAR_____54_CM 1 0. -40. 200. ECU_ADDRESS 0xd00033e0 FORMAT "%5.1" /end MEASUREMENT
/begin CHARACTERISTIC Cxx_tco_inc "Max gradient of tco" VALUE 0xa0021eda _REC_S1VAL_20_u2 30. _CNV_A_R_LINEAR_____190_CM 0. 30. FORMAT "%4.1" /end CHARACTERISTIC
/begin MEASUREMENT Vbx_df_sens_tco "engine cooling temperature sensor detected failure" UBYTE _CNV_S_2_RANGE______3_CM 1 0. 0. 1. ECU_ADDRESS 0xd00057a8 BIT_MASK 0x1 /end MEASUREMENT
/begin MEASUREMENT Vsx_sens_tco_vld "engine coolant temperature sensor validity status" UBYTE _CNV_S_3_STATUS_OK__120_CM 1 0. 0. 2. ECU_ADDRESS 0xd00057a9 /end MEASUREMENT
/begin MEASUREMENT Vxx_sens_tco "Engine coolant temperature (sensor)" UWORD _CNV_A_R_LINEAR_____54_CM 1 0. -40. 200. ECU_ADDRESS 0xd0005826 FORMAT "%5.1" /end MEASUREMENT
/begin MEASUREMENT Vxx_sens_tco_frz "Frozen engine coolant temperature in case of detected failure (sensor)" UWORD _CNV_A_R_LINEAR_____54_CM 1 0. -40. 200. ECU_ADDRESS 0xd0005828 FORMAT "%5.1" /end MEASUREMENT
/begin CHARACTERISTIC Cxx_dfdec_sens_tco "engine cooling temperature sensor detected failure counter decrement" VALUE 0xa0020d9c _REC_S1VAL_20_u2 65535. _CNV_A_R_ECME_LINEA_0_CM 0. 65535. FORMAT "%5.0" /end CHARACTERISTIC
/begin CHARACTERISTIC Cxx_dfinc_sens_tco "engine cooling temperature sensor detected failure counter increment" VALUE 0xa0020d9e _REC_S1VAL_20_u2 65535. _CNV_A_R_ECME_LINEA_0_CM 0. 65535. FORMAT "%5.0" /end CHARACTERISTIC
/begin CHARACTERISTIC Cxx_raw_sens_tco_ini "Raw engine coolant temperature on init" VALUE 0xa0020da0 _REC_S1VAL_20_u2 240. _CNV_A_R_LINEAR_____54_CM -40. 200. FORMAT "%5.1" /end CHARACTERISTIC
/begin MEASUREMENT Vbx_tco_mdl_cnt "Top Dead Center counter" UBYTE _CNV_S_2_RANGE______3_CM 1 0. 0. 1. ECU_ADDRESS 0xd0003e2f BIT_MASK 0x1 /end MEASUREMENT
/begin MEASUREMENT Vsx_mdl_tco "State of Tco model" UBYTE _CNV_S_5_STATUS_TCO_191_CM 1 0. 0. 30. ECU_ADDRESS 0xd0003e30 /end MEASUREMENT
/begin MEASUREMENT Vsx_mdl_tco_vld "Engine coolant temperature model validity status" UBYTE _CNV_S_3_STATUS_OK__120_CM 1 0. 0. 2. ECU_ADDRESS 0xd0003e31 /end MEASUREMENT
/begin MEASUREMENT Vsx_mdl_tco_vld_2 "Engine coolant temperature model validity status 2" UBYTE _CNV_S_3_STATUS_OK__120_CM 1 0. 0. 2. ECU_ADDRESS 0xd0003e32 /end MEASUREMENT
/begin MEASUREMENT Vxx_mdl_tco "Engine coolant temperature (model)" UWORD _CNV_A_R_LINEAR_____54_CM 1 0. -40. 200. ECU_ADDRESS 0xd0003136 FORMAT "%5.1" /end MEASUREMENT
/begin CHARACTERISTIC Cxx_mdl_tco_inc "Engine coolant temperature model increment" VALUE 0xa0020cfe _REC_S1VAL_20_u2 240. _CNV_A_R_LINEAR_____54_CM -40. 200. FORMAT "%5.1" /end CHARACTERISTIC
/begin CHARACTERISTIC Cxx_mdl_tco_max "Max engine coolant temperature model" VALUE 0xa0020d00 _REC_S1VAL_20_u2 240. _CNV_A_R_LINEAR_____54_CM -40. 200. FORMAT "%5.1" /end CHARACTERISTIC
/begin CHARACTERISTIC Cxx_tdc_mdl_fail_tdc_cnt "Top Dead Center counter when Vsx_mdl_tco_vld == Nok." VALUE 0xa0020d02 _REC_S1VAL_20_u2 65535. _CNV_A_R_LINEAR_____55_CM 0. 65535. FORMAT "%5.0" /end CHARACTERISTIC
/begin CHARACTERISTIC Cxx_tdc_mdl_tdc_cnt "Top Dead Center counter." VALUE 0xa0020d04 _REC_S1VAL_20_u2 65535. _CNV_A_R_LINEAR_____55_CM 0. 65535. FORMAT "%5.0" /end CHARACTERISTIC
/begin MEASUREMENT Vbx_df_sens_tco_sig_mcut "Engine cooling temperature sensor signal momentarily implausible or discontinuous detected failure" UBYTE _CNV_S_2_RANGE______3_CM 1 0. 0. 1. ECU_ADDRESS 0xd00050ba BIT_MASK 0x1 /end MEASUREMENT
/begin CHARACTERISTIC Cxx_dfdec_sens_tco_sig_mcut "Engine cooling temperature sensor momentarily implausible or discontinuous diagnostic detected failure counter decrement" VALUE 0xa0021cf0 _REC_S1VAL_20_u2 65535. _CNV_A_R_ECME_LINEA_0_CM 0. 65535. FORMAT "%5.0" /end CHARACTERISTIC
/begin CHARACTERISTIC Cxx_dfinc_sens_tco_sig_mcut "Engine cooling temperature sensor momentarily implausible or discontinuous diagnostic detected failure counter increment" VALUE 0xa0021cf2 _REC_S1VAL_20_u2 65535. _CNV_A_R_ECME_LINEA_0_CM 0. 65535. FORMAT "%5.0" /end CHARACTERISTIC
/begin CHARACTERISTIC Cxx_tco_sig_mcut_max_slop "Slop of engine cooling temperature for micro cut detection" VALUE 0xa0021cf4 _REC_S1VAL_20_u2 240. _CNV_A_R_LINEAR_____54_CM -40. 200. FORMAT "%5.1" /end CHARACTERISTIC
/begin MEASUREMENT Vxx_pft_oil_csm "" UWORD _CNV_A_R_LINEAR_____192_CM 1 0. 0. 6.5535 DISPLAY_IDENTIFIER InCliLui_NVM.Vxx_pft_oil_csm_NVM ECU_ADDRESS 0xd00057e8 FORMAT "%6.4" /end MEASUREMENT
/begin MEASUREMENT Vxx_amp "" UWORD _CNV_A_R_LINEAR_____57_CM 1 0. 0. 20000. DISPLAY_IDENTIFIER InAsiIap_NVM.Vxx_amp_nvm ECU_ADDRESS 0xd00032ae FORMAT "%5.0" /end MEASUREMENT
/begin MEASUREMENT Vxx_map_spg_dif "" SWORD _CNV_A_R_LINEAR_____57_CM 1 0. -10000. 10000. DISPLAY_IDENTIFIER InAsiIap_NVM.Vxx_map_spg_dif_nvm ECU_ADDRESS 0xd00032b0 FORMAT "%6.0" /end MEASUREMENT
/begin MEASUREMENT Vsx_sens_spg_vld "Boost pressure sensor value validity status" UBYTE _CNV_S_3_STATUS_OK__120_CM 1 0. 0. 2. ECU_ADDRESS 0xd0004378 /end MEASUREMENT
/begin MEASUREMENT Vxx_sens_spg "Boost pressure measurement value from sensor" UWORD _CNV_A_R_LINEAR_____57_CM 1 0. 0. 20000. ECU_ADDRESS 0xd0002f3a FORMAT "%5.0" /end MEASUREMENT
/begin CHARACTERISTIC Cxx_dfdec_sens_spg_h "Boost pressure sensor high signal detected failure counter decrement" VALUE 0xa00217ee _REC_S1VAL_20_u2 65535. _CNV_A_R_ECME_LINEA_0_CM 0. 65535. FORMAT "%5.0" /end CHARACTERISTIC
/begin CHARACTERISTIC Cxx_dfdec_sens_spg_l "Boost pressure low signal circuit to ground detected failure counter decrement" VALUE 0xa00217f0 _REC_S1VAL_20_u2 65535. _CNV_A_R_ECME_LINEA_0_CM 0. 65535. FORMAT "%5.0" /end CHARACTERISTIC
/begin CHARACTERISTIC Cxx_dfinc_sens_spg_h "Boost pressure sensor high signal detected failure counter increment" VALUE 0xa00217f2 _REC_S1VAL_20_u2 65535. _CNV_A_R_ECME_LINEA_0_CM 0. 65535. FORMAT "%5.0" /end CHARACTERISTIC
/begin CHARACTERISTIC Cxx_dfinc_sens_spg_l "Boost pressure low signal circuit to ground detected failure counter increment" VALUE 0xa00217f4 _REC_S1VAL_20_u2 65535. _CNV_A_R_ECME_LINEA_0_CM 0. 65535. FORMAT "%5.0" /end CHARACTERISTIC
/begin MEASUREMENT Vxx_lim_pred_map "Predicted manifold pressure for next intake (limited)" UWORD _CNV_A_R_LINEAR_____57_CM 1 0. 0. 20000. ECU_ADDRESS 0xd0002cb8 FORMAT "%5.0" /end MEASUREMENT
/begin MEASUREMENT Vxx_lim_pred_map_dif "Predicted manifold pressure difference for next intake (limited)" SWORD _CNV_A_R_LINEAR_____57_CM 1 0. -10000. 10000. ECU_ADDRESS 0xd0002cba FORMAT "%6.0" /end MEASUREMENT
/begin MEASUREMENT Vxx_pred_map "Predicted manifold pressure for next intake" UWORD _CNV_A_R_LINEAR_____57_CM 1 0. 0. 20000. ECU_ADDRESS 0xd0002cbc FORMAT "%5.0" /end MEASUREMENT
/begin MEASUREMENT Vxx_pred_map_dif "Predicted manifold pressure difference for next intake." SWORD _CNV_A_R_LINEAR_____57_CM 1 0. -10000. 10000. ECU_ADDRESS 0xd0002cbe FORMAT "%6.0" /end MEASUREMENT
/begin CHARACTERISTIC Cxx_pred_map_dif_dz "Dead zone in Vxx_pred_map_dif application" VALUE 0xa0020c3a _REC_S1VAL_20_u2 20000. _CNV_A_R_LINEAR_____57_CM 0. 20000. FORMAT "%5.0" /end CHARACTERISTIC
/begin CHARACTERISTIC Cxx_pred_map_dif_max_fac "Factor applied on upstream pressure to saturate predicted manifold pressure difference" VALUE 0xa0020c42 _REC_S1VAL_20_u1 1.9921875 _CNV_A_R_LINEAR_____43_CM 0. 1.9921875 FORMAT "%8.6" /end CHARACTERISTIC
/begin CHARACTERISTIC Cxx_pred_map_dif_neg_fac "Predicted manifold pressure difference factor when negative" VALUE 0xa0020c43 _REC_S1VAL_20_u1 1.9921875 _CNV_A_R_LINEAR_____43_CM 0. 1.9921875 FORMAT "%8.6" /end CHARACTERISTIC
/begin CHARACTERISTIC Cxx_pred_map_dif_pos_fac "Predicted manifold pressure difference factor when positive" VALUE 0xa0020c44 _REC_S1VAL_20_u1 1.9921875 _CNV_A_R_LINEAR_____43_CM 0. 1.9921875 FORMAT "%8.6" /end CHARACTERISTIC
/begin CHARACTERISTIC Cxx_t_pred_dly_ref "Time term of the reference prediction delay" VALUE 0xa0020c3c _REC_S1VAL_20_u2 0.1 _CNV_A_R_LINEAR_____194_CM 0. 0.1 FORMAT "%5.4" /end CHARACTERISTIC
/begin CHARACTERISTIC Cxx_tdc_nr_pred_dly_ref "TDC term of the reference prediction delay" VALUE 0xa0020c3e _REC_S1VAL_20_u2 5. _CNV_A_R_LINEAR_____195_CM 0. 5. FORMAT "%8.7" /end CHARACTERISTIC
/begin CHARACTERISTIC Cxx_vvtc_angl_tdc_fac "Convertion factor between relative VVT angle ant TDC number." VALUE 0xa0020c40 _REC_S1VAL_20_s2 9.9998474e-002 _CNV_A_R_LINEAR_____196_CM -5.e-002 4.9998474e-002 FORMAT "%10.8" /end CHARACTERISTIC
/begin AXIS_PTS Ctb_prs "" 0xa0028dac Vxx_map _REC_A2AXS_20_u2 20000. _CNV_A_R_LINEAR_____57_CM 17 0. 20000. FORMAT "%5.0" /end AXIS_PTS
/begin AXIS_PTS Ctb_prs2 "9 programmable pressure breakpoint table" 0xa0028dd0 Vxx_map _REC_A2AXS_20_u2 20000. _CNV_A_R_LINEAR_____57_CM 9 0. 20000. FORMAT "%5.0" /end AXIS_PTS
/begin AXIS_PTS Ctb_cylr_map "Break point table of Ctp_cylr_prs_stab_dif" 0xa002e64c Vxx_map_cor _REC_A2AXS_20_u2 20000. _CNV_A_R_LINEAR_____57_CM 17 0. 20000. FORMAT "%5.0" /end AXIS_PTS
/begin CHARACTERISTIC Ctp_cylr_prs_stab_dif "Maximum difference of pressure for engine stability criteria of cylinder recognition" CURVE 0xa002e670 _REC_A1CUR_20_u2_u2 20000. _CNV_A_R_LINEAR_____57_CM 0. 20000. FORMAT "%5.0"
 /begin AXIS_DESCR COM_AXIS Vxx_map_cor _CNV_A_R_LINEAR_____57_CM 17 0. 20000. FORMAT "%5.0" AXIS_PTS_REF Ctb_cylr_map /end AXIS_DESCR
/end CHARACTERISTIC
/begin MEASUREMENT Vbx_ac_in_mem "Input state of air conditioning during cylinder recognition memorized" UBYTE _CNV_S_2_RANGE______3_CM 1 0. 0. 1. ECU_ADDRESS 0xd0004f6c BIT_MASK 0x1 /end MEASUREMENT
/begin MEASUREMENT Vbx_ac_out_mem "Output state of air conditioning during cylinder recognition memorized" UBYTE _CNV_S_2_RANGE______3_CM 1 0. 0. 1. ECU_ADDRESS 0xd0004f6d BIT_MASK 0x1 /end MEASUREMENT
/begin MEASUREMENT Vbx_clu_stal_ctr_ini "Initial value of Vbx_clu_stal_ctr" UBYTE _CNV_S_2_RANGE______3_CM 1 0. 0. 1. ECU_ADDRESS 0xd0004f6e BIT_MASK 0x1 /end MEASUREMENT
/begin MEASUREMENT Vbx_cylr_is_run_ctl_ini "Cylinder recognition in idle speed regulation wanted at initialization" UBYTE _CNV_S_2_RANGE______3_CM 1 0. 0. 1. ECU_ADDRESS 0xd0004f6f BIT_MASK 0x1 /end MEASUREMENT
/begin MEASUREMENT Vbx_cylr_is_run_mes "Cylinder recognition in idle speed regulation is done" UBYTE _CNV_S_2_RANGE______3_CM 1 0. 0. 1. ECU_ADDRESS 0xd0004f70 BIT_MASK 0x1 /end MEASUREMENT
/begin MEASUREMENT Vbx_cylr_is_run_req "Cylinder recognition is required in idle speed regulation" UBYTE _CNV_S_2_RANGE______3_CM 1 0. 0. 1. ECU_ADDRESS 0xd0004f71 BIT_MASK 0x1 /end MEASUREMENT
/begin MEASUREMENT Vbx_cylr_is_run_stab_cdn "Conditions of stability for cylinder recognition in idle speed regulation" UBYTE _CNV_S_2_RANGE______3_CM 1 0. 0. 1. ECU_ADDRESS 0xd0004f72 BIT_MASK 0x1 /end MEASUREMENT
/begin MEASUREMENT Vbx_cylr_is_run_stop "Cylinder recognition in ilde speed regulation is done" UBYTE _CNV_S_2_RANGE______3_CM 1 0. 0. 1. ECU_ADDRESS 0xd0004f73 BIT_MASK 0x1 /end MEASUREMENT
/begin MEASUREMENT Vbx_cylr_run_loop_stop "Cylinder recognition in close loop state and running vehicle" UBYTE _CNV_S_2_RANGE______3_CM 1 0. 0. 1. ECU_ADDRESS 0xd0004f74 BIT_MASK 0x1 /end MEASUREMENT
/begin MEASUREMENT Vbx_cylr_run_stab_cdn "Stability condition cylinder recognition running vehicle (close loop)" UBYTE _CNV_S_2_RANGE______3_CM 1 0. 0. 1. ECU_ADDRESS 0xd0004f75 BIT_MASK 0x1 /end MEASUREMENT
/begin MEASUREMENT Vbx_cylr_stab_cdn "Stability condition of cynlinder recognition (running vehicle or idle speed regulation)" UBYTE _CNV_S_2_RANGE______3_CM 1 0. 0. 1. ECU_ADDRESS 0xd0004f76 BIT_MASK 0x1 /end MEASUREMENT
/begin MEASUREMENT Vbx_cylr_stab_cdn_rtn "Freeze frame for stability condition for cylinder recognition" UBYTE _CNV_S_2_RANGE______3_CM 1 0. 0. 1. ECU_ADDRESS 0xd0004f77 BIT_MASK 0x1 /end MEASUREMENT
/begin MEASUREMENT Vbx_cylr_stop "Boolean indicating that partial injections, cylinder recognition, and, possibly, injection rephasing are ended or realized" UBYTE _CNV_S_2_RANGE______3_CM 1 0. 0. 1. ECU_ADDRESS 0xd0004f78 BIT_MASK 0x1 /end MEASUREMENT
/begin MEASUREMENT Vbx_cylr_tot_stab_cdn "General stability condition for cylinder recognition" UBYTE _CNV_S_2_RANGE______3_CM 1 0. 0. 1. ECU_ADDRESS 0xd0004f79 BIT_MASK 0x1 /end MEASUREMENT
/begin MEASUREMENT Vbx_gas_comb_mod "Boolean  indicating gazoline calibrations must be used" UBYTE _CNV_S_2_RANGE______3_CM 1 0. 0. 1. ECU_ADDRESS 0xd0004f7a BIT_MASK 0x1 /end MEASUREMENT
/begin MEASUREMENT Vbx_iga_re_syn_req "Boolean of ignition resynchro request" UBYTE _CNV_S_2_RANGE______3_CM 1 0. 0. 1. ECU_ADDRESS 0xd0004f7b BIT_MASK 0x1 /end MEASUREMENT
/begin MEASUREMENT Vbx_inj_dstb_act "Partial injections in progress (for cylinder recognition)" UBYTE _CNV_S_2_RANGE______3_CM 1 0. 0. 1. ECU_ADDRESS 0xd0004f7c BIT_MASK 0x1 /end MEASUREMENT
/begin MEASUREMENT Vbx_inj_dstb_phs1 "Phase 1 of partial injections" UBYTE _CNV_S_2_RANGE______3_CM 1 0. 0. 1. ECU_ADDRESS 0xd0004f7d BIT_MASK 0x1 /end MEASUREMENT
/begin MEASUREMENT Vbx_inj_dstb_phs2 "Phase 2 of partial injections" UBYTE _CNV_S_2_RANGE______3_CM 1 0. 0. 1. ECU_ADDRESS 0xd0004f7e BIT_MASK 0x1 /end MEASUREMENT
/begin MEASUREMENT Vbx_inj_re_phs_req "Demand of rephasage of the mark of phase of the injections" UBYTE _CNV_S_2_RANGE______3_CM 1 0. 0. 1. ECU_ADDRESS 0xd0004f7f BIT_MASK 0x1 /end MEASUREMENT
/begin MEASUREMENT Vbx_mdf1_cmd_mem "State command MDF1 memorized during cylinder recognition" UBYTE _CNV_S_2_RANGE______3_CM 1 0. 0. 1. ECU_ADDRESS 0xd0004f80 BIT_MASK 0x1 /end MEASUREMENT
/begin MEASUREMENT Vbx_mdf2_cmd_mem "State command MDF2 memorized during cylinder recognition" UBYTE _CNV_S_2_RANGE______3_CM 1 0. 0. 1. ECU_ADDRESS 0xd0004f81 BIT_MASK 0x1 /end MEASUREMENT
/begin MEASUREMENT Vbx_mis_inj_re_phs_done "Boolean indicating that rephasage is done on misfire request" UBYTE _CNV_S_2_RANGE______3_CM 1 0. 0. 1. ECU_ADDRESS 0xd0004f82 BIT_MASK 0x1 /end MEASUREMENT
/begin MEASUREMENT Vbx_rich_cl_cylr_mem "Richness loop state memorized during cylinder recognition" UBYTE _CNV_S_2_RANGE______3_CM 1 0. 0. 1. ECU_ADDRESS 0xd0004f83 BIT_MASK 0x1 /end MEASUREMENT
/begin MEASUREMENT Vbx_run_cylr_mem "Cylinder recognition memorized running vehicle" UBYTE _CNV_S_2_RANGE______3_CM 1 0. 0. 1. ECU_ADDRESS 0xd0004f84 BIT_MASK 0x1 /end MEASUREMENT
/begin MEASUREMENT Vbx_tdc_re_syn_ctr_req "Boolean of resynchro TDC counter request" UBYTE _CNV_S_2_RANGE______3_CM 1 0. 0. 1. ECU_ADDRESS 0xd0004f85 BIT_MASK 0x1 /end MEASUREMENT
/begin MEASUREMENT Vbx_tolo "Boolean indicating a loss of crankshaft synchronisation for resetting of recocyl stateflow" UBYTE _CNV_S_2_RANGE______3_CM 1 0. 0. 1. ECU_ADDRESS 0xd0004f86 BIT_MASK 0x1 /end MEASUREMENT
/begin MEASUREMENT Vxx_clu_stal_ctr_ini "Initial value of Vxx_clu_stal_ctr" UWORD _CNV_A_R_ECME_LINEA_0_CM 1 0. 0. 65535. ECU_ADDRESS 0xd000354a FORMAT "%5.0" /end MEASUREMENT
/begin MEASUREMENT Vxx_cylr_clc_ctr_yy "Duration of multiple injections in number of engine cycles (= 4TDC)" UWORD _CNV_A_R_LINEAR_____55_CM 1 0. 0. 65535. ECU_ADDRESS 0xd000354c FORMAT "%5.0" /end MEASUREMENT
/begin MEASUREMENT Vxx_cylr_ctl_phs "Cylinder recognition automate phase" UBYTE _CNV_A_R_ECME_LINEA_0_CM 1 0. 0. 255. ECU_ADDRESS 0xd0004f87 FORMAT "%3.0" /end MEASUREMENT
/begin MEASUREMENT Vxx_cylr_id_sta_ofs "Offset at the beginning of the strategy" UBYTE _CNV_A_R_LINEAR_____301_CM 1 0. 0. 255. ECU_ADDRESS 0xd0004f88 FORMAT "%3.0" /end MEASUREMENT
/begin MEASUREMENT Vxx_cylr_iga_mem "Ignition advance memorized due to stability during cylinder recognition" UBYTE _CNV_A_R_IGRE_LINEA_48_CM 1 0. -23.625 72. ECU_ADDRESS 0xd0004f89 FORMAT "%7.3" /end MEASUREMENT
/begin MEASUREMENT Vxx_cylr_is_clc_ctr_yy "Duration of multiple injection in number of engine cycle (= 4TDC) in idle speed regulation" UWORD _CNV_A_R_LINEAR_____55_CM 1 0. 0. 65535. ECU_ADDRESS 0xd000354e FORMAT "%5.0" /end MEASUREMENT
/begin MEASUREMENT Vxx_cylr_is_max_tq_dec_yy "Maximal deterioration of torque to refute the phasing of the injection mark in RR mode" SWORD _CNV_A_R_LINEAR_____302_CM 1 0. -3276.8 3276.7 ECU_ADDRESS 0xd0003550 FORMAT "%6.1" /end MEASUREMENT
/begin MEASUREMENT Vxx_cylr_is_min_tq_dec_yy "Minimal deterioration of torque to confirm the phasing of the injection mark in RR mode" SWORD _CNV_A_R_LINEAR_____302_CM 1 0. -3276.8 3276.7 ECU_ADDRESS 0xd0003552 FORMAT "%6.1" /end MEASUREMENT
/begin MEASUREMENT Vxx_cylr_is_run_test_ctr "Cylinder recognition attempts counter in idle speed regulation" UBYTE _CNV_A_R_ECME_LINEA_0_CM 1 0. 0. 255. ECU_ADDRESS 0xd0004f8a FORMAT "%3.0" /end MEASUREMENT
/begin MEASUREMENT Vxx_cylr_is_vld_ctr_ini "Initial value of Vxx_cylr_is_vld_ctr" UWORD _CNV_A_R_ECME_LINEA_0_CM 1 0. 0. 65535. ECU_ADDRESS 0xd0003554 FORMAT "%5.0" /end MEASUREMENT
/begin MEASUREMENT Vxx_cylr_max_n_yy "Maximal engine speed for cylinder recognition" UBYTE _CNV_A_R_LINEAR_____2_CM 1 0. 0. 8160. ECU_ADDRESS 0xd0004f8b FORMAT "%4.0" /end MEASUREMENT
/begin MEASUREMENT Vxx_cylr_max_prs_yy "Maximal pressure for cylinder recognition" UWORD _CNV_A_R_LINEAR_____57_CM 1 0. 0. 20000. ECU_ADDRESS 0xd0003556 FORMAT "%5.0" /end MEASUREMENT
/begin MEASUREMENT Vxx_cylr_max_tq_dec_yy "Maximal deterioration of torque to refute the phasing of the injection mark" SWORD _CNV_A_R_LINEAR_____302_CM 1 0. -3276.8 3276.7 ECU_ADDRESS 0xd0003558 FORMAT "%6.1" /end MEASUREMENT
/begin MEASUREMENT Vxx_cylr_min_n_yy "Minimal engine speed for cylinder recognition" UBYTE _CNV_A_R_LINEAR_____2_CM 1 0. 0. 8160. ECU_ADDRESS 0xd0004f8c FORMAT "%4.0" /end MEASUREMENT
/begin MEASUREMENT Vxx_cylr_min_prs_yy "Minimal pressure for cylinder recognition" UWORD _CNV_A_R_LINEAR_____57_CM 1 0. 0. 20000. ECU_ADDRESS 0xd000355a FORMAT "%5.0" /end MEASUREMENT
/begin MEASUREMENT Vxx_cylr_min_tq_dec_yy "Minimal deterioration of torque to confirm the phasing of the injection mark" SWORD _CNV_A_R_LINEAR_____302_CM 1 0. -3276.8 3276.7 ECU_ADDRESS 0xd000355c FORMAT "%6.1" /end MEASUREMENT
/begin MEASUREMENT Vxx_cylr_ok_aftr_stal_ctr_ini "Initial value of Vxx_cylr_ok_aftr_stal_ctr" UWORD _CNV_A_R_ECME_LINEA_0_CM 1 0. 0. 65535. ECU_ADDRESS 0xd000355e FORMAT "%5.0" /end MEASUREMENT
/begin MEASUREMENT Vxx_cylr_ok_ctr_ini "Initial value of Vxx_cylr_ok_ctr" UWORD _CNV_A_R_ECME_LINEA_0_CM 1 0. 0. 65535. ECU_ADDRESS 0xd0003560 FORMAT "%5.0" /end MEASUREMENT
/begin MEASUREMENT Vxx_cylr_prs_stab_dif "Maximum difference of pressure for engine stability criteria of cylinder recognition" UWORD _CNV_A_R_LINEAR_____57_CM 1 0. 0. 20000. ECU_ADDRESS 0xd0003562 FORMAT "%5.0" /end MEASUREMENT
/begin MEASUREMENT Vxx_cylr_stab_ctr_yy "Number of stability TDC to launch partial injection" UBYTE _CNV_A_R_LINEAR_____55_CM 1 0. 0. 255. ECU_ADDRESS 0xd0004f8d FORMAT "%3.0" /end MEASUREMENT
/begin MEASUREMENT Vxx_cylr_stab_is_ctr_yy "Number of stability TDC to launch partial injection in idle speed regulation" UBYTE _CNV_A_R_LINEAR_____55_CM 1 0. 0. 255. ECU_ADDRESS 0xd0004f8e FORMAT "%3.0" /end MEASUREMENT
/begin MEASUREMENT Vxx_cylr_tdc_ctr "TDC counter for cylinder recognition" UWORD _CNV_A_R_LINEAR_____55_CM 1 0. 0. 65535. ECU_ADDRESS 0xd0003564 FORMAT "%5.0" /end MEASUREMENT
/begin MEASUREMENT Vxx_cylr_test_ctr "Cylinder recognition attempts counter" UBYTE _CNV_A_R_ECME_LINEA_0_CM 1 0. 0. 255. ECU_ADDRESS 0xd0004f8f FORMAT "%3.0" /end MEASUREMENT
/begin MEASUREMENT Vxx_dyn_re_phs_ofs "Dynamic offset during rephasage" UBYTE _CNV_A_R_LINEAR_____301_CM 1 0. 0. 255. ECU_ADDRESS 0xd0004f90 FORMAT "%3.0" /end MEASUREMENT
/begin MEASUREMENT Vxx_err_cylr_ctr_ini "Initial value of Vxx_err_cylr_ctr" UWORD _CNV_A_R_ECME_LINEA_0_CM 1 0. 0. 65535. ECU_ADDRESS 0xd0003566 FORMAT "%5.0" /end MEASUREMENT
/begin MEASUREMENT Vxx_err_cylr_is_run_ctr_ini "Initial value of Vxx_err_cylr_is_run_ctr" UWORD _CNV_A_R_ECME_LINEA_0_CM 1 0. 0. 65535. ECU_ADDRESS 0xd0003568 FORMAT "%5.0" /end MEASUREMENT
/begin MEASUREMENT Vxx_err_id_is_run_ctr_ini "Initial value of Vxx_err_id_is_run_ctr" UWORD _CNV_A_R_ECME_LINEA_0_CM 1 0. 0. 65535. ECU_ADDRESS 0xd000356a FORMAT "%5.0" /end MEASUREMENT
/begin MEASUREMENT Vxx_inj_mov_ofs "Offset for mark injection gap" UBYTE _CNV_A_R_LINEAR_____301_CM 1 0. 0. 255. ECU_ADDRESS 0xd0004f91 FORMAT "%3.0" /end MEASUREMENT
/begin MEASUREMENT Vxx_is_cylr_ok_ctr_ini "initial value of Vxx_is_cylr_ok_ctr" UWORD _CNV_A_R_ECME_LINEA_0_CM 1 0. 0. 65535. ECU_ADDRESS 0xd000356c FORMAT "%5.0" /end MEASUREMENT
/begin MEASUREMENT Vxx_map_cor "Manifold pressure corrected as a function of atmospheric pressure" UWORD _CNV_A_R_LINEAR_____57_CM 1 0. 0. 20000. ECU_ADDRESS 0xd000356e FORMAT "%5.0" /end MEASUREMENT
/begin MEASUREMENT Vxx_n_cylr_mem "Engine speed memorized for stability for stability in idle speed regulation" UBYTE _CNV_A_R_LINEAR_____2_CM 1 0. 0. 8160. ECU_ADDRESS 0xd0004f92 FORMAT "%4.0" /end MEASUREMENT
/begin MEASUREMENT Vxx_no_deci_cylr_ctr_ini "Initial value of Vxx_no_deci_cylr_ctr" UWORD _CNV_A_R_ECME_LINEA_0_CM 1 0. 0. 65535. ECU_ADDRESS 0xd0003570 FORMAT "%5.0" /end MEASUREMENT
/begin MEASUREMENT Vxx_no_deci_id_is_ctr_ini "Initial value of Vxx_no_deci_id_is_ctr" UWORD _CNV_A_R_ECME_LINEA_0_CM 1 0. 0. 65535. ECU_ADDRESS 0xd0003572 FORMAT "%5.0" /end MEASUREMENT
/begin MEASUREMENT Vxx_prs_cylr_mem "Memorized pressure for stability during cylinder recognition" UWORD _CNV_A_R_LINEAR_____57_CM 1 0. 0. 20000. ECU_ADDRESS 0xd0003574 FORMAT "%5.0" /end MEASUREMENT
/begin MEASUREMENT Vxx_run_re_phs_ctr_ini "Initial value of Vxx_run_re_phs_ctr" UWORD _CNV_A_R_ECME_LINEA_0_CM 1 0. 0. 65535. ECU_ADDRESS 0xd0003576 FORMAT "%5.0" /end MEASUREMENT
/begin MEASUREMENT Vxx_ti_cylr_mem "Memorized effective time injection" ULONG _CNV_A_R_LINEAR_____50_CM 1 0. 0. 500000. ECU_ADDRESS 0xd0001c80 FORMAT "%6.0" /end MEASUREMENT
/begin MEASUREMENT Vxx_tq_dec "Torque deterioration" SWORD _CNV_A_R_LINEAR_____302_CM 1 0. -3276.8 3276.7 ECU_ADDRESS 0xd0003578 FORMAT "%6.1" /end MEASUREMENT
/begin MEASUREMENT Vxx_trz_cylr_mem "Raw gas torque memorized for cylinder recognition" SWORD _CNV_A_R_LINEAR_____302_CM 1 0. -3276.8 3276.7 ECU_ADDRESS 0xd000357a FORMAT "%6.1" /end MEASUREMENT
/begin CHARACTERISTIC Cbx_bch_cylr "Cylinder recognition in bench mode" VALUE 0xa0020f06 _REC_S1VAL_20_u1 1. _CNV_A_R_ECME_LINEA_0_CM 0. 1. FORMAT "%1.0" BIT_MASK 0x1 /end CHARACTERISTIC
/begin CHARACTERISTIC Cbx_cylr_bas_conf "Software configuration with/without cylinder recognition" VALUE 0xa0020f07 _REC_S1VAL_20_u1 1. _CNV_A_R_ECME_LINEA_0_CM 0. 1. FORMAT "%1.0" BIT_MASK 0x1 /end CHARACTERISTIC
/begin CHARACTERISTIC Cbx_cylr_bch_mod "Activation of cylinder recognition in bench mode" VALUE 0xa0020f08 _REC_S1VAL_20_u1 1. _CNV_A_R_ECME_LINEA_0_CM 0. 1. FORMAT "%1.0" BIT_MASK 0x1 /end CHARACTERISTIC
/begin CHARACTERISTIC Cbx_cylr_ena_re_phs "Rephasing of injection mark is authorised" VALUE 0xa0020f09 _REC_S1VAL_20_u1 1. _CNV_A_R_ECME_LINEA_0_CM 0. 1. FORMAT "%1.0" BIT_MASK 0x1 /end CHARACTERISTIC
/begin CHARACTERISTIC Cbx_cylr_is_neg_clu_stal "Cylinder recognition in idle speed regulation (looped or unlooped) authorized if no clutch stall" VALUE 0xa0020f0a _REC_S1VAL_20_u1 1. _CNV_A_R_ECME_LINEA_0_CM 0. 1. FORMAT "%1.0" BIT_MASK 0x1 /end CHARACTERISTIC
/begin CHARACTERISTIC Cbx_cylr_is_run_gex_appl "Compulsory cylinder recognition in idle speed regulation (looped or unlooped) if upstream lambda sensor is in GEX" VALUE 0xa0020f0b _REC_S1VAL_20_u1 1. _CNV_A_R_ECME_LINEA_0_CM 0. 1. FORMAT "%1.0" BIT_MASK 0x1 /end CHARACTERISTIC
/begin CHARACTERISTIC Cbx_cylr_loop "Cylinder recognition in infinite loop for tuning needs" VALUE 0xa0020f0c _REC_S1VAL_20_u1 1. _CNV_A_R_ECME_LINEA_0_CM 0. 1. FORMAT "%1.0" BIT_MASK 0x1 /end CHARACTERISTIC
/begin CHARACTERISTIC Cbx_cylr_run_ol "Cylinder recognition in richness open loop authorised" VALUE 0xa0020f0d _REC_S1VAL_20_u1 1. _CNV_A_R_ECME_LINEA_0_CM 0. 1. FORMAT "%1.0" BIT_MASK 0x1 /end CHARACTERISTIC
/begin CHARACTERISTIC Cxx_crk1_bas_toth_nr "Teeth number of crankshaft target seen by LDB" VALUE 0xa0020f0e _REC_S1VAL_20_u1 255. _CNV_A_R_LINEAR_____301_CM 0. 255. FORMAT "%3.0" /end CHARACTERISTIC
/begin CHARACTERISTIC Cxx_cylr_alti_prs_max_fac "Factor on the calculation of maximal pressure threshold depending on altitude for cylinder recognition" VALUE 0xa0020f0f _REC_S1VAL_20_u1 1. _CNV_A_R_LINEAR_____118_CM 0. 1. FORMAT "%9.7" /end CHARACTERISTIC
/begin CHARACTERISTIC Cxx_cylr_alti_prs_min_fac "Factor on the calculation of minimal pressure threshold depending on altitude for cylinder recognition" VALUE 0xa0020f10 _REC_S1VAL_20_u1 1. _CNV_A_R_LINEAR_____118_CM 0. 1. FORMAT "%9.7" /end CHARACTERISTIC
/begin CHARACTERISTIC Cxx_cylr_clc_ctr "Duration of multiple injections in number of engine cycles (= 4TDC)" VALUE 0xa0020f11 _REC_S1VAL_20_u1 1020. _CNV_A_R_LINEAR_____263_CM 0. 1020. FORMAT "%4.0" /end CHARACTERISTIC
/begin CHARACTERISTIC Cxx_cylr_clc_ctr_lpg "Duration of multiple injections in number of engine cycles (= 4TDC) in LPG" VALUE 0xa0020f12 _REC_S1VAL_20_u1 1020. _CNV_A_R_LINEAR_____263_CM 0. 1020. FORMAT "%4.0" /end CHARACTERISTIC
/begin CHARACTERISTIC Cxx_cylr_cold_is_stab_t "Duration of expectation period during multiple injection in idle speed regulation and cold engine" VALUE 0xa0020f13 _REC_S1VAL_20_u1 1020. _CNV_A_R_LINEAR_____263_CM 0. 1020. FORMAT "%4.0" /end CHARACTERISTIC
/begin CHARACTERISTIC Cxx_cylr_gear "Minimum value of VehicleSpeed/Neng ratio for cylinder recognition " VALUE 0xa0020eda _REC_S1VAL_20_u2 210. _CNV_A_R_LINEAR_____140_CM -10. 200. FORMAT "%6.2" /end CHARACTERISTIC
/begin CHARACTERISTIC Cxx_cylr_is_clc_ctr "Duration of multiple injection in number of engine cycle (= 4TDC) in idle speed regulation" VALUE 0xa0020f14 _REC_S1VAL_20_u1 1020. _CNV_A_R_LINEAR_____263_CM 0. 1020. FORMAT "%4.0" /end CHARACTERISTIC
/begin CHARACTERISTIC Cxx_cylr_is_clc_ctr_lpg "Duration of multiple injection in number of engine cycle (= 4TDC) in idle speed regulation for LPG" VALUE 0xa0020f15 _REC_S1VAL_20_u1 1020. _CNV_A_R_LINEAR_____263_CM 0. 1020. FORMAT "%4.0" /end CHARACTERISTIC
/begin CHARACTERISTIC Cxx_cylr_is_max_test_nr "Threshold of cylinder recognition attempts when RR is launched" VALUE 0xa0020f16 _REC_S1VAL_20_u1 255. _CNV_A_R_ECME_LINEA_0_CM 0. 255. FORMAT "%3.0" /end CHARACTERISTIC
/begin CHARACTERISTIC Cxx_cylr_is_max_tq_dec "Maximal deterioration of torque to refute the phasing of the injection mark in RR mode" VALUE 0xa0020edc _REC_S1VAL_20_s2 6553.5 _CNV_A_R_LINEAR_____302_CM -3276.8 3276.7 FORMAT "%6.1" /end CHARACTERISTIC
/begin CHARACTERISTIC Cxx_cylr_is_max_tq_dec_lpg "Maximal deterioration of torque to refute the phasing of the injection mark in RR mode for LPG" VALUE 0xa0020ede _REC_S1VAL_20_s2 6553.5 _CNV_A_R_LINEAR_____302_CM -3276.8 3276.7 FORMAT "%6.1" /end CHARACTERISTIC
/begin CHARACTERISTIC Cxx_cylr_is_min_tq_dec "Minimal deterioration of torque to confirm the phasing of the injection mark in RR mode" VALUE 0xa0020ee0 _REC_S1VAL_20_s2 6553.5 _CNV_A_R_LINEAR_____302_CM -3276.8 3276.7 FORMAT "%6.1" /end CHARACTERISTIC
/begin CHARACTERISTIC Cxx_cylr_is_min_tq_dec_lpg "Minimal deterioration of torque to confirm the phasing of the injection mark in RR mode" VALUE 0xa0020ee2 _REC_S1VAL_20_s2 6553.5 _CNV_A_R_LINEAR_____302_CM -3276.8 3276.7 FORMAT "%6.1" /end CHARACTERISTIC
/begin CHARACTERISTIC Cxx_cylr_is_run_max_tco "Maximal water temperature for Idle speed regulation cylinder recognition with extended wait" VALUE 0xa0020ee4 _REC_S1VAL_20_u2 240. _CNV_A_R_LINEAR_____54_CM -40. 200. FORMAT "%5.1" /end CHARACTERISTIC
/begin CHARACTERISTIC Cxx_cylr_is_run_min_tco "Minimal water temperature for Idle speed regulation cylinder recognition" VALUE 0xa0020ee6 _REC_S1VAL_20_u2 240. _CNV_A_R_LINEAR_____54_CM -40. 200. FORMAT "%5.1" /end CHARACTERISTIC
/begin CHARACTERISTIC Cxx_cylr_is_run_n_fac "Offset of zone of engine speed (on REGNOM) for cylinder recognition in RR" VALUE 0xa0020f17 _REC_S1VAL_20_u1 8160. _CNV_A_R_LINEAR_____2_CM 0. 8160. FORMAT "%4.0" /end CHARACTERISTIC
/begin CHARACTERISTIC Cxx_cylr_is_ti_cor_max "Maximum value of Vxx_tco_ti_cor for engine stabily tests in idle speed regulation" VALUE 0xa0020ee8 _REC_S1VAL_20_u2 3.99993896484375 _CNV_A_R_LINEAR_____261_CM 0.5 4.49993896484375 FORMAT "%10.8" /end CHARACTERISTIC
/begin CHARACTERISTIC Cxx_cylr_l_n_re_phs "Low engine speed for cylinder recognition rephasage" VALUE 0xa0020f18 _REC_S1VAL_20_u1 8160. _CNV_A_R_LINEAR_____2_CM 0. 8160. FORMAT "%4.0" /end CHARACTERISTIC
/begin CHARACTERISTIC Cxx_cylr_l_prs_dif_fac "Factor on the calculation of maximal pressure difference threshold depending on altitude for cylinder recognition" VALUE 0xa0020f19 _REC_S1VAL_20_u1 1. _CNV_A_R_LINEAR_____118_CM 0. 1. FORMAT "%9.7" /end CHARACTERISTIC
/begin CHARACTERISTIC Cxx_cylr_l_prs_re_phs "Low pressure for cylinder recognition regulation" VALUE 0xa0020eea _REC_S1VAL_20_u2 20000. _CNV_A_R_LINEAR_____57_CM 0. 20000. FORMAT "%5.0" /end CHARACTERISTIC
/begin CHARACTERISTIC Cxx_cylr_max_dif_iga "Maximal advance gap due to stability for cylinder recognition" VALUE 0xa0020f1a _REC_S1VAL_20_u1 95.625 _CNV_A_R_LINEAR_____25_CM 0. 95.625 /end CHARACTERISTIC
/begin CHARACTERISTIC Cxx_cylr_max_mv_lamb_fac "Maximal value of the lambda average factor for the cylinder recognition" VALUE 0xa0020eec _REC_S1VAL_20_u2 0.66665649414063 _CNV_A_R_LINEAR_____65_CM 0.6666666 1.33332309414063 FORMAT "%8.7" /end CHARACTERISTIC
/begin CHARACTERISTIC Cxx_cylr_max_n "Maximal engine speed for cylinder recognition" VALUE 0xa0020f1b _REC_S1VAL_20_u1 8160. _CNV_A_R_LINEAR_____2_CM 0. 8160. FORMAT "%4.0" /end CHARACTERISTIC
/begin CHARACTERISTIC Cxx_cylr_max_n_lpg "Maximal engine speed for cylinder recognition (LPG)" VALUE 0xa0020f1c _REC_S1VAL_20_u1 8160. _CNV_A_R_LINEAR_____2_CM 0. 8160. FORMAT "%4.0" /end CHARACTERISTIC
/begin CHARACTERISTIC Cxx_cylr_max_prs "Maximal pressure for cylinder recognition" VALUE 0xa0020eee _REC_S1VAL_20_u2 20000. _CNV_A_R_LINEAR_____57_CM 0. 20000. FORMAT "%5.0" /end CHARACTERISTIC
/begin CHARACTERISTIC Cxx_cylr_max_prs_lpg "Maximal pressure for cylinder recognition (LPG)" VALUE 0xa0020ef0 _REC_S1VAL_20_u2 20000. _CNV_A_R_LINEAR_____57_CM 0. 20000. FORMAT "%5.0" /end CHARACTERISTIC
/begin CHARACTERISTIC Cxx_cylr_max_tco "Maximal water temperature for cylinder recognition in idle speed regulation" VALUE 0xa0020ef2 _REC_S1VAL_20_u2 240. _CNV_A_R_LINEAR_____54_CM -40. 200. FORMAT "%5.1" /end CHARACTERISTIC
/begin CHARACTERISTIC Cxx_cylr_max_test_nr "Threshold of cylinder recognition attempts" VALUE 0xa0020f1d _REC_S1VAL_20_u1 255. _CNV_A_R_ECME_LINEA_0_CM 0. 255. FORMAT "%3.0" /end CHARACTERISTIC
/begin CHARACTERISTIC Cxx_cylr_max_tq_dec "Maximal deterioration of torque to refute the phasing of the injection mark" VALUE 0xa0020ef4 _REC_S1VAL_20_s2 6553.5 _CNV_A_R_LINEAR_____302_CM -3276.8 3276.7 FORMAT "%6.1" /end CHARACTERISTIC
/begin CHARACTERISTIC Cxx_cylr_max_tq_dec_lpg "Maximal deterioration of torque to refute the phasing of the injection mark for LPG" VALUE 0xa0020ef6 _REC_S1VAL_20_s2 6553.5 _CNV_A_R_LINEAR_____302_CM -3276.8 3276.7 FORMAT "%6.1" /end CHARACTERISTIC
/begin CHARACTERISTIC Cxx_cylr_min_mv_lamb_fac "Minimal value of the lambda average factor for the cylinder recognition" VALUE 0xa0020ef8 _REC_S1VAL_20_u2 0.66665649414063 _CNV_A_R_LINEAR_____65_CM 0.6666666 1.33332309414063 FORMAT "%8.7" /end CHARACTERISTIC
/begin CHARACTERISTIC Cxx_cylr_min_n "Minimal engine speed for cylinder recognition" VALUE 0xa0020f1e _REC_S1VAL_20_u1 8160. _CNV_A_R_LINEAR_____2_CM 0. 8160. FORMAT "%4.0" /end CHARACTERISTIC
/begin CHARACTERISTIC Cxx_cylr_min_n_lpg "Maximal engine speed for cylinder recognition (LPG)" VALUE 0xa0020f1f _REC_S1VAL_20_u1 8160. _CNV_A_R_LINEAR_____2_CM 0. 8160. FORMAT "%4.0" /end CHARACTERISTIC
/begin CHARACTERISTIC Cxx_cylr_min_prs "Minimal pressure for cylinder recognition" VALUE 0xa0020efa _REC_S1VAL_20_u2 20000. _CNV_A_R_LINEAR_____57_CM 0. 20000. FORMAT "%5.0" /end CHARACTERISTIC
/begin CHARACTERISTIC Cxx_cylr_min_prs_lpg "Minimal pressure for cylinder recognition (LPG)" VALUE 0xa0020efc _REC_S1VAL_20_u2 20000. _CNV_A_R_LINEAR_____57_CM 0. 20000. FORMAT "%5.0" /end CHARACTERISTIC
/begin CHARACTERISTIC Cxx_cylr_min_tco "Minimal water temperature for cylinder recognition" VALUE 0xa0020efe _REC_S1VAL_20_u2 240. _CNV_A_R_LINEAR_____54_CM -40. 200. FORMAT "%5.1" /end CHARACTERISTIC
/begin CHARACTERISTIC Cxx_cylr_min_tq_dec "Minimal deterioration of torque to confirm the phasing of the injection mark" VALUE 0xa0020f00 _REC_S1VAL_20_s2 6553.5 _CNV_A_R_LINEAR_____302_CM -3276.8 3276.7 FORMAT "%6.1" /end CHARACTERISTIC
/begin CHARACTERISTIC Cxx_cylr_min_tq_dec_lpg "Minimal deterioration of torque to confirm the phasing of the injection mark for LPG" VALUE 0xa0020f02 _REC_S1VAL_20_s2 6553.5 _CNV_A_R_LINEAR_____302_CM -3276.8 3276.7 FORMAT "%6.1" /end CHARACTERISTIC
/begin CHARACTERISTIC Cxx_cylr_n_stab_dif "maximal engine speed gap due to stability for cylinder recognition in idle speed regulation" VALUE 0xa0020f20 _REC_S1VAL_20_u1 8160. _CNV_A_R_LINEAR_____2_CM 0. 8160. FORMAT "%4.0" /end CHARACTERISTIC
/begin CHARACTERISTIC Cxx_cylr_stab_ctr "Number of stability TDC to launch partial injection" VALUE 0xa0020f21 _REC_S1VAL_20_u1 255. _CNV_A_R_LINEAR_____55_CM 0. 255. FORMAT "%3.0" /end CHARACTERISTIC
/begin CHARACTERISTIC Cxx_cylr_stab_ctr_lpg "Number of stability TDC to launch partial injection (LPG)" VALUE 0xa0020f22 _REC_S1VAL_20_u1 255. _CNV_A_R_LINEAR_____55_CM 0. 255. FORMAT "%3.0" /end CHARACTERISTIC
/begin CHARACTERISTIC Cxx_cylr_stab_inj_dif "Max percentage of injection time due to stability for cylinder recognition" VALUE 0xa0020f23 _REC_S1VAL_20_u1 1. _CNV_A_R_LINEAR_____118_CM 0. 1. FORMAT "%9.7" /end CHARACTERISTIC
/begin CHARACTERISTIC Cxx_cylr_stab_is_ctr "Number of stability TDC to launch partial injection in idle speed regulation" VALUE 0xa0020f24 _REC_S1VAL_20_u1 255. _CNV_A_R_LINEAR_____55_CM 0. 255. FORMAT "%3.0" /end CHARACTERISTIC
/begin CHARACTERISTIC Cxx_cylr_stab_is_ctr_lpg "Number of stability TDC to launch partial injection in idle speed regulation (LPG)" VALUE 0xa0020f25 _REC_S1VAL_20_u1 255. _CNV_A_R_LINEAR_____55_CM 0. 255. FORMAT "%3.0" /end CHARACTERISTIC
/begin CHARACTERISTIC Cxx_cylr_stab_t "Duration of the expectation period during the multiple injections" VALUE 0xa0020f26 _REC_S1VAL_20_u1 1020. _CNV_A_R_LINEAR_____263_CM 0. 1020. FORMAT "%4.0" /end CHARACTERISTIC
/begin CHARACTERISTIC Cxx_cylr_trz_stab_dif "Maximum difference of TRZ torque gap for engine stability criteria" VALUE 0xa0020f04 _REC_S1VAL_20_u2 6553.5 _CNV_A_R_LINEAR_____302_CM 0. 6553.5 FORMAT "%6.1" /end CHARACTERISTIC
/begin CHARACTERISTIC Cxx_is_run_stal_step "Step of gap in teeth during a rephasage in idle speed regulation" VALUE 0xa0020f27 _REC_S1VAL_20_u1 255. _CNV_A_R_LINEAR_____301_CM 0. 255. FORMAT "%3.0" /end CHARACTERISTIC
/begin CHARACTERISTIC Cxx_stal_step "Step of gap in teeth" VALUE 0xa0020f28 _REC_S1VAL_20_u1 255. _CNV_A_R_LINEAR_____301_CM 0. 255. FORMAT "%3.0" /end CHARACTERISTIC
/begin MEASUREMENT Vbx_in_cam_lvl "Consolidated intake camshaft level" UBYTE _CNV_S_2_RANGE______3_CM 1 0. 0. 1. ECU_ADDRESS 0xd00043d4 BIT_MASK 0x1 /end MEASUREMENT
/begin MEASUREMENT Vbx_pres_df_in_cam_chr "Consolidation of intake camshaft signal incoherency detected failure" UBYTE _CNV_S_2_RANGE______3_CM 1 0. 0. 1. ECU_ADDRESS 0xd00043d5 BIT_MASK 0x1 /end MEASUREMENT
/begin MEASUREMENT Vbx_pres_df_in_cam_crk_cmp "Consolidation of incoherency between intake camshaft signal and crankshaft signal detected failure" UBYTE _CNV_S_2_RANGE______3_CM 1 0. 0. 1. ECU_ADDRESS 0xd00043d6 BIT_MASK 0x1 /end MEASUREMENT
/begin MEASUREMENT Vbx_pres_df_in_cam_cyc "Consolidation of interference close to a intake camshaft edge confirmed failure" UBYTE _CNV_S_2_RANGE______3_CM 1 0. 0. 1. ECU_ADDRESS 0xd00043d7 BIT_MASK 0x1 /end MEASUREMENT
/begin MEASUREMENT Vbx_pres_df_in_cam_no_sig "Consolidation of no intake camshaft signal detected failure" UBYTE _CNV_S_2_RANGE______3_CM 1 0. 0. 1. ECU_ADDRESS 0xd00043d8 BIT_MASK 0x1 /end MEASUREMENT
/begin MEASUREMENT Vbx_pres_df_in_cam_nok "Consolidation of camshaft signal invalid for synchronisation detected failure" UBYTE _CNV_S_2_RANGE______3_CM 1 0. 0. 1. ECU_ADDRESS 0xd00043d9 BIT_MASK 0x1 /end MEASUREMENT
/begin MEASUREMENT Vsx_sens_in_cam_vld "Intake camshaft sensor validity status" UBYTE _CNV_S_3_STATUS_OK__120_CM 1 0. 0. 2. ECU_ADDRESS 0xd00043da /end MEASUREMENT
/begin MEASUREMENT Vxx_in_cam_toth_per "Duration between two intake camshaft events" UWORD _CNV_A_R_LINEAR_____145_CM 1 0. 0. 65535. ECU_ADDRESS 0xd0002d6a FORMAT "%5.0" /end MEASUREMENT
/begin CHARACTERISTIC Cxx_dfdec_in_cam_chr "intake camshaft signal incoherency detected failure counter decrement" VALUE 0xa0021588 _REC_S1VAL_20_u2 65535. _CNV_A_R_ECME_LINEA_0_CM 0. 65535. FORMAT "%5.0" /end CHARACTERISTIC
/begin CHARACTERISTIC Cxx_dfdec_in_cam_crk_cmp "incoherency between intake camshaft signal and crankshaft signal detected failure counter decrement" VALUE 0xa002158a _REC_S1VAL_20_u2 65535. _CNV_A_R_ECME_LINEA_0_CM 0. 65535. FORMAT "%5.0" /end CHARACTERISTIC
/begin CHARACTERISTIC Cxx_dfdec_in_cam_cyc "Interference close to a intake camshaft edge detected failure counter decrement" VALUE 0xa002158c _REC_S1VAL_20_u2 65535. _CNV_A_R_ECME_LINEA_0_CM 0. 65535. FORMAT "%5.0" /end CHARACTERISTIC
/begin CHARACTERISTIC Cxx_dfdec_in_cam_no_sig "no intake camshaft signal detected failure counter decrement" VALUE 0xa002158e _REC_S1VAL_20_u2 65535. _CNV_A_R_ECME_LINEA_0_CM 0. 65535. FORMAT "%5.0" /end CHARACTERISTIC
/begin CHARACTERISTIC Cxx_dfdec_in_cam_nok "Camshaft signal invalid for synchronisation detected failure counter decrement" VALUE 0xa0021590 _REC_S1VAL_20_u2 65535. _CNV_A_R_ECME_LINEA_0_CM 0. 65535. FORMAT "%5.0" /end CHARACTERISTIC
/begin CHARACTERISTIC Cxx_dfinc_in_cam_chr "intake camshaft signal incoherency detected failure counter increment" VALUE 0xa0021592 _REC_S1VAL_20_u2 65535. _CNV_A_R_ECME_LINEA_0_CM 0. 65535. FORMAT "%5.0" /end CHARACTERISTIC
/begin CHARACTERISTIC Cxx_dfinc_in_cam_crk_cmp "incoherency between intake camshaft signal and crankshaft signal detected failure counter increment" VALUE 0xa0021594 _REC_S1VAL_20_u2 65535. _CNV_A_R_ECME_LINEA_0_CM 0. 65535. FORMAT "%5.0" /end CHARACTERISTIC
/begin CHARACTERISTIC Cxx_dfinc_in_cam_cyc "Interference close to a intake camshaft edge detected failure counter increment" VALUE 0xa0021596 _REC_S1VAL_20_u2 65535. _CNV_A_R_ECME_LINEA_0_CM 0. 65535. FORMAT "%5.0" /end CHARACTERISTIC
/begin CHARACTERISTIC Cxx_dfinc_in_cam_no_sig "no intake camshaft signal detected failure counter increment" VALUE 0xa0021598 _REC_S1VAL_20_u2 65535. _CNV_A_R_ECME_LINEA_0_CM 0. 65535. FORMAT "%5.0" /end CHARACTERISTIC
/begin CHARACTERISTIC Cxx_dfinc_in_cam_nok "Camshaft signal invalid for synchronisation detected failure counter increment" VALUE 0xa002159a _REC_S1VAL_20_u2 65535. _CNV_A_R_ECME_LINEA_0_CM 0. 65535. FORMAT "%5.0" /end CHARACTERISTIC
/begin AXIS_PTS Ctb_n "20 programmable engine speed breakpoints map" 0xa00250e0 Vxx_n _REC_A2AXS_20_u2 16383.75 _CNV_A_R_ENSD_LINEA_24_CM 20 0. 16383.75 FORMAT "%8.2" /end AXIS_PTS
/begin AXIS_PTS Ctb_n2 "9 programmable engine speed breakpoints table" 0xa002510c Vxx_n _REC_A2AXS_20_u2 16383.75 _CNV_A_R_ENSD_LINEA_24_CM 9 0. 16383.75 FORMAT "%8.2" /end AXIS_PTS
/begin MEASUREMENT Vxx_n_tdc_2 "Engine speed tdc i-2" UWORD _CNV_A_R_ENSD_LINEA_24_CM 1 0. 0. 16383.75 ECU_ADDRESS 0xd00032aa FORMAT "%8.2" /end MEASUREMENT
/begin MEASUREMENT Vxx_n_tdc_4 "Engine speed tdc i-4" UWORD _CNV_A_R_ENSD_LINEA_24_CM 1 0. 0. 16383.75 ECU_ADDRESS 0xd00032ac FORMAT "%8.2" /end MEASUREMENT
/begin MEASUREMENT Vbx_in_vvt_cfm "Boolean indicating that intake VVT strategies must be activated" UBYTE _CNV_S_2_RANGE______3_CM 1 0. 0. 1. ECU_ADDRESS 0xd00050bb BIT_MASK 0x1 /end MEASUREMENT
/begin CHARACTERISTIC Cbx_in_vvtc_abst_pres_cfm "Boolean indicating that intake VVTC strategies must be enabled (in configuration Nxx_in_vvtc_cho)" VALUE 0xa00219b3 _REC_S1VAL_20_u1 1. _CNV_S_2_RANGE______3_CM 0. 1. BIT_MASK 0x1 /end CHARACTERISTIC
/begin MEASUREMENT Vsx_pws_sens_ac_prs_vld "Power supply of air cooling pressure sensor validity status" UBYTE _CNV_S_3_STATUS_OK__158_CM 1 0. 0. 2. ECU_ADDRESS 0xd000421e /end MEASUREMENT
/begin MEASUREMENT Vsx_pws_sens_acel_pdl_v1_vld "Power supply of accelerator pedal track 1 validity status" UBYTE _CNV_S_3_STATUS_OK__158_CM 1 0. 0. 2. ECU_ADDRESS 0xd000421f /end MEASUREMENT
/begin MEASUREMENT Vsx_pws_sens_acel_pdl_v2_vld "Power supply of accelerator pedal track 2 validity status" UBYTE _CNV_S_3_STATUS_OK__158_CM 1 0. 0. 2. ECU_ADDRESS 0xd0004220 /end MEASUREMENT
/begin MEASUREMENT Vsx_pws_sens_it_vld "Powerstage of the Inlet throttle sensor validity status." UBYTE _CNV_S_3_STATUS_OK__158_CM 1 0. 0. 2. ECU_ADDRESS 0xd0004221 /end MEASUREMENT
/begin MEASUREMENT Vsx_pws_sens_lbdw_vld "Power supply of lambda down sensor validity status" UBYTE _CNV_S_3_STATUS_OK__158_CM 1 0. 0. 2. ECU_ADDRESS 0xd0004222 /end MEASUREMENT
/begin MEASUREMENT Vsx_pws_sens_lbup_vld "Power supply of upstream sensor validity status" UBYTE _CNV_S_3_STATUS_OK__158_CM 1 0. 0. 2. ECU_ADDRESS 0xd0004223 /end MEASUREMENT
/begin MEASUREMENT Vsx_pws_sens_map_vld "Power supply of manifold pressure validity status" UBYTE _CNV_S_3_STATUS_OK__158_CM 1 0. 0. 2. ECU_ADDRESS 0xd0004224 /end MEASUREMENT
/begin MEASUREMENT Vsx_pws_sens_rvac_vld "Power supply of tank pressure validity status" UBYTE _CNV_S_3_STATUS_OK__120_CM 1 0. 0. 2. ECU_ADDRESS 0xd0004225 /end MEASUREMENT
/begin MEASUREMENT Vsx_pws_sens_spg_vld "Power supply of supercharging pressure validity status" UBYTE _CNV_S_3_STATUS_OK__158_CM 1 0. 0. 2. ECU_ADDRESS 0xd0004226 /end MEASUREMENT
/begin MEASUREMENT Vxx_pws_sens_it "Sensors power supply voltage raw acquisition" UWORD _CNV_A_R_LINEAR_____52_CM 1 0. 0. 25000. ECU_ADDRESS 0xd00038c6 FORMAT "%5.0" /end MEASUREMENT
/begin MEASUREMENT Vsx_pws_1_vld "Power supply 1 validity status" UBYTE _CNV_S_3_STATUS_OK__158_CM 1 0. 0. 2. ECU_ADDRESS 0xd000550e /end MEASUREMENT
/begin MEASUREMENT Vsx_pws_2_vld "Power supply 2 validity status" UBYTE _CNV_S_3_STATUS_OK__158_CM 1 0. 0. 2. ECU_ADDRESS 0xd000550f /end MEASUREMENT
/begin MEASUREMENT Vxx_pws_1 "Sensors power supply 1 voltage raw acquisition" UWORD _CNV_A_R_LINEAR_____52_CM 1 0. 0. 25000. ECU_ADDRESS 0xd00032fc FORMAT "%5.0" /end MEASUREMENT
/begin MEASUREMENT Vxx_pws_2 "Sensors power supply 2 voltage raw acquisition" UWORD _CNV_A_R_LINEAR_____52_CM 1 0. 0. 25000. ECU_ADDRESS 0xd00032fe FORMAT "%5.0" /end MEASUREMENT
/begin CHARACTERISTIC Cxx_dfdec_pws_1_h "Power supply 1 voltage above max threshold detected failure counter decrement" VALUE 0xa0020b7c _REC_S1VAL_20_u2 65535. _CNV_A_R_ECME_LINEA_0_CM 0. 65535. FORMAT "%5.0" /end CHARACTERISTIC
/begin CHARACTERISTIC Cxx_dfdec_pws_1_l "Power supply 1 voltage below min threshold detected failure counter decrement" VALUE 0xa0020b7e _REC_S1VAL_20_u2 65535. _CNV_A_R_ECME_LINEA_0_CM 0. 65535. FORMAT "%5.0" /end CHARACTERISTIC
/begin CHARACTERISTIC Cxx_dfdec_pws_2_h "Power supply 2 voltage above max threshold detected failure counter decrement" VALUE 0xa0020b80 _REC_S1VAL_20_u2 65535. _CNV_A_R_ECME_LINEA_0_CM 0. 65535. FORMAT "%5.0" /end CHARACTERISTIC
/begin CHARACTERISTIC Cxx_dfdec_pws_2_l "Power supply 2 voltage below min threshold detected failure counter decrement" VALUE 0xa0020b82 _REC_S1VAL_20_u2 65535. _CNV_A_R_ECME_LINEA_0_CM 0. 65535. FORMAT "%5.0" /end CHARACTERISTIC
/begin CHARACTERISTIC Cxx_dfinc_pws_1_h "Power supply 1 voltage above max threshold detected failure counter increment" VALUE 0xa0020b84 _REC_S1VAL_20_u2 65535. _CNV_A_R_ECME_LINEA_0_CM 0. 65535. FORMAT "%5.0" /end CHARACTERISTIC
/begin CHARACTERISTIC Cxx_dfinc_pws_1_l "Power supply 1 voltage below min threshold detected failure counter increment" VALUE 0xa0020b86 _REC_S1VAL_20_u2 65535. _CNV_A_R_ECME_LINEA_0_CM 0. 65535. FORMAT "%5.0" /end CHARACTERISTIC
/begin CHARACTERISTIC Cxx_dfinc_pws_2_h "Power supply 2 voltage above max threshold detected failure counter increment" VALUE 0xa0020b88 _REC_S1VAL_20_u2 65535. _CNV_A_R_ECME_LINEA_0_CM 0. 65535. FORMAT "%5.0" /end CHARACTERISTIC
/begin CHARACTERISTIC Cxx_dfinc_pws_2_l "Power supply 2 voltage below min threshold detected failure counter increment" VALUE 0xa0020b8a _REC_S1VAL_20_u2 65535. _CNV_A_R_ECME_LINEA_0_CM 0. 65535. FORMAT "%5.0" /end CHARACTERISTIC
/begin MEASUREMENT Vbx_rest_pwl_rtn "Power-latch retain for restart" UBYTE _CNV_S_2_RANGE______3_CM 1 0. 0. 1. ECU_ADDRESS 0xd0005504 BIT_MASK 0x1 /end MEASUREMENT
/begin MEASUREMENT Vsx_pws_3_vld "Power supply 3 validity status" UBYTE _CNV_S_3_STATUS_OK__120_CM 1 0. 0. 2. ECU_ADDRESS 0xd00045a7 /end MEASUREMENT
/begin MEASUREMENT Vxx_pws_3 "Sensors power supply 3 voltage raw acquisition." UWORD _CNV_A_R_LINEAR_____52_CM 1 0. 0. 25000. ECU_ADDRESS 0xd0002e80 FORMAT "%5.0" /end MEASUREMENT
/begin CHARACTERISTIC Cxx_dfdec_pws_3_h "Power supply 3 voltage above max threshold detected failure counter decrement" VALUE 0xa002190e _REC_S1VAL_20_u2 65535. _CNV_A_R_ECME_LINEA_0_CM 0. 65535. FORMAT "%5.0" /end CHARACTERISTIC
/begin CHARACTERISTIC Cxx_dfdec_pws_3_l "Power supply 3 voltage below min threshold detected failure counter decrement" VALUE 0xa0021910 _REC_S1VAL_20_u2 65535. _CNV_A_R_ECME_LINEA_0_CM 0. 65535. FORMAT "%5.0" /end CHARACTERISTIC
/begin CHARACTERISTIC Cxx_dfinc_pws_3_h "Power supply 3 voltage above max threshold detected failure counter increment" VALUE 0xa0021912 _REC_S1VAL_20_u2 65535. _CNV_A_R_ECME_LINEA_0_CM 0. 65535. FORMAT "%5.0" /end CHARACTERISTIC
/begin CHARACTERISTIC Cxx_dfinc_pws_3_l "Power supply 3 voltage below min threshold detected failure counter increment" VALUE 0xa0021914 _REC_S1VAL_20_u2 65535. _CNV_A_R_ECME_LINEA_0_CM 0. 65535. FORMAT "%5.0" /end CHARACTERISTIC
/begin AXIS_PTS Ctb_toil "engine oil temperature breakpoints" 0xa002a6d8 Vxx_toil _REC_A2AXS_20_u2 240. _CNV_A_R_LINEAR_____54_CM 16 -40. 200. FORMAT "%5.1" /end AXIS_PTS
/begin MEASUREMENT Vsx_toil_vld "Oil temperature validity status" UBYTE _CNV_S_3_STATUS_OK__120_CM 1 0. 0. 2. ECU_ADDRESS 0xd0005301 /end MEASUREMENT
/begin MEASUREMENT Vxx_toil "Oil temperature" UWORD _CNV_A_R_LINEAR_____54_CM 1 0. -40. 200. ECU_ADDRESS 0xd000582a FORMAT "%5.1" /end MEASUREMENT
/begin CHARACTERISTIC Cxx_mdl_toil_fail "Default value in case of mtl toil failure" VALUE 0xa00215f8 _REC_S1VAL_20_u2 240. _CNV_A_R_LINEAR_____54_CM -40. 200. FORMAT "%5.1" /end CHARACTERISTIC
/begin AXIS_PTS Ctb_n4 "Engine speed  breakpoints for oil temperature computing" 0xa0028e20 Vxx_n _REC_A2AXS_20_u2 16383.75 _CNV_A_R_ENSD_LINEA_24_CM 6 0. 16383.75 FORMAT "%8.2" /end AXIS_PTS
/begin AXIS_PTS Ctb_tco_dif "Table of Delta between water temp. and  reference  water temp. in running conditions (near 92 ∞c)" 0xa0028e30 Vxx_tco_dif _REC_A2AXS_20_u2 240. _CNV_A_R_LINEAR_____54_CM 17 -40. 200. FORMAT "%5.1" /end AXIS_PTS
/begin AXIS_PTS Ctb_tqi_rat "Indicated torque ratio breakpoints table" 0xa0028e54 Vxx_tqi_rat_tgt _REC_A2AXS_20_u2 1. _CNV_A_R_LINEAR_____125_CM 6 0. 1. FORMAT "%11.9" /end AXIS_PTS
/begin CHARACTERISTIC Cmp_n_toil "Map of oil temperature in stabilised and standard conditions [90-92'C]" MAP 0xa0028e64 _REC_A1MAP_20_u2_u2_u2 240. _CNV_A_R_LINEAR_____54_CM -40. 200. FORMAT "%5.1"
 /begin AXIS_DESCR COM_AXIS Vxx_tqi_rat_tgt _CNV_A_R_LINEAR_____125_CM 6 0. 1. FORMAT "%11.9" AXIS_PTS_REF Ctb_tqi_rat /end AXIS_DESCR
 /begin AXIS_DESCR COM_AXIS Vxx_n _CNV_A_R_ENSD_LINEA_24_CM 6 0. 16383.75 FORMAT "%8.2" AXIS_PTS_REF Ctb_n4 /end AXIS_DESCR
/end CHARACTERISTIC
/begin CHARACTERISTIC Ctp_tco_toil_ofs "Table of corrective terms for basic oil temerature computing" CURVE 0xa0028eac _REC_A1CUR_20_u2_u2 2400. _CNV_A_R_LINEAR_____421_CM -1200. 1200. FORMAT "%7.1"
 /begin AXIS_DESCR COM_AXIS Vxx_tco_dif _CNV_A_R_LINEAR_____54_CM 17 -40. 200. FORMAT "%5.1" AXIS_PTS_REF Ctb_tco_dif /end AXIS_DESCR
/end CHARACTERISTIC
/begin CHARACTERISTIC Ctp_toil_fil "Map of filtering coefficients for dynamic oil temperature computing  in engine running conditions" CURVE 0xa0028ed0 _REC_A1CUR_20_u2_u2 100. _CNV_A_R_LINEAR_____122_CM 0. 100. FORMAT "%12.8"
 /begin AXIS_DESCR COM_AXIS Vxx_n _CNV_A_R_ENSD_LINEA_24_CM 6 0. 16383.75 FORMAT "%8.2" AXIS_PTS_REF Ctb_n4 /end AXIS_DESCR
/end CHARACTERISTIC
/begin MEASUREMENT Vbx_toil_pws "Boolean used to ask ECU electrical supply for oil temperature computing" UBYTE _CNV_S_2_RANGE______3_CM 1 0. 0. 1. ECU_ADDRESS 0xd0005238 BIT_MASK 0x1 /end MEASUREMENT
/begin MEASUREMENT Vsx_mdl_toil_vld "Modelised oil temperature validity status" UBYTE _CNV_S_3_STATUS_OK__120_CM 1 0. 0. 2. ECU_ADDRESS 0xd0005239 /end MEASUREMENT
/begin MEASUREMENT Vxx_mdl_toil "Modelised oil temperature" UWORD _CNV_A_R_LINEAR_____54_CM 1 0. -40. 200. ECU_ADDRESS 0xd0005af0 FORMAT "%5.1" /end MEASUREMENT
/begin MEASUREMENT Vxx_stab_toil "Oil temperature in stabilised conditions" UWORD _CNV_A_R_LINEAR_____54_CM 1 0. -40. 200. ECU_ADDRESS 0xd0005af2 FORMAT "%5.1" /end MEASUREMENT
/begin MEASUREMENT Vxx_tco_dif "Delta between water temperature and reference water temperature in running conditions." UWORD _CNV_A_R_LINEAR_____54_CM 1 0. -40. 200. ECU_ADDRESS 0xd0005234 FORMAT "%5.1" /end MEASUREMENT
/begin MEASUREMENT Vxx_tco_fil "Filtered coolant temperature for oil temperature computing" UWORD _CNV_A_R_LINEAR_____54_CM 1 0. -40. 200. ECU_ADDRESS 0xd0005236 FORMAT "%5.1" /end MEASUREMENT
/begin MEASUREMENT Vxx_toil_pws_max_dly "Remaining duration after engine stall of maintain of the calculation of the oil temperature." UWORD _CNV_A_R_LINEAR_____4_CM 1 0. 0. 6553.5 ECU_ADDRESS 0xd0005af4 FORMAT "%6.1" /end MEASUREMENT
/begin CHARACTERISTIC Cxx_stop_toil_fil "Filtering coefficient for oil temperature computing in engine stop running conditions" VALUE 0xa0021b5a _REC_S1VAL_20_u2 100. _CNV_A_R_LINEAR_____122_CM 0. 100. FORMAT "%12.8" /end CHARACTERISTIC
/begin CHARACTERISTIC Cxx_tco_toil_fil "Filtering coefficient for water temperature." VALUE 0xa0021b5c _REC_S1VAL_20_u2 100. _CNV_A_R_LINEAR_____122_CM 0. 100. FORMAT "%12.8" /end CHARACTERISTIC
/begin CHARACTERISTIC Cxx_tco_toil_thd "Reference water temperature in usual running conditions for oil temperature computing" VALUE 0xa0021b5e _REC_S1VAL_20_u2 240. _CNV_A_R_LINEAR_____54_CM -40. 200. FORMAT "%5.1" /end CHARACTERISTIC
/begin CHARACTERISTIC Cxx_toil_pws_max_dly "Maximum duration after engine stall of maintain of the calculation of the oil temperature." VALUE 0xa0021b60 _REC_S1VAL_20_u2 6553.5 _CNV_A_R_LINEAR_____4_CM 0. 6553.5 FORMAT "%6.1" /end CHARACTERISTIC
/begin CHARACTERISTIC Cxx_toil_tco_cnt "Water temp minus Oil temperature value for 'power-latch' maintenance" VALUE 0xa0021b62 _REC_S1VAL_20_u2 240. _CNV_A_R_LINEAR_____54_CM -40. 200. FORMAT "%5.1" /end CHARACTERISTIC
/begin CHARACTERISTIC Cxx_tqi_rat_cut_thd "Threshold of indicated torque ratio used for the filtering of the oil temperature model" VALUE 0xa0021b64 _REC_S1VAL_20_u2 1. _CNV_A_R_LINEAR_____125_CM 0. 1. FORMAT "%11.9" /end CHARACTERISTIC
/begin MEASUREMENT Vsx_sens_toil_vld "Oil temperature analog sensor validity status" UBYTE _CNV_S_3_STATUS_OK__120_CM 1 0. 0. 2. ECU_ADDRESS 0xd0005610 /end MEASUREMENT
/begin MEASUREMENT Vxx_sens_toil "Oil temperature from sensor" UWORD _CNV_A_R_LINEAR_____54_CM 1 0. -40. 200. ECU_ADDRESS 0xd0005982 FORMAT "%5.1" /end MEASUREMENT
/begin MEASUREMENT Vbx_owe_ini_req_ok "Initialisation request (manual or after sale department) accepted" UBYTE _CNV_S_2_RANGE______3_CM 1 0. 0. 1. ECU_ADDRESS 0xd000528d BIT_MASK 0x1 /end MEASUREMENT
/begin MEASUREMENT Vbx_owe_mnl_ini_req_ok "Manual initialisation request accepted" UBYTE _CNV_S_2_RANGE______3_CM 1 0. 0. 1. ECU_ADDRESS 0xd000528e BIT_MASK 0x1 /end MEASUREMENT
/begin CHARACTERISTIC Cbx_owe_mnl_ini_req_ena "Calibration to forbid the use of manual init by pedals (to use the can information)" VALUE 0xa0021bfc _REC_S1VAL_20_u1 1. _CNV_S_2_RANGE______3_CM 0. 1. BIT_MASK 0x1 /end CHARACTERISTIC
/begin MEASUREMENT Sxx_owe_st3 "State of the third scheduler" UBYTE _CNV_A_R_ECME_LINEA_0_CM 1 0. 0. 20. ECU_ADDRESS 0xd000575a FORMAT "%2.0" /end MEASUREMENT
/begin MEASUREMENT Sxx_owe_st4 "State of the fourth scheduler" UBYTE _CNV_A_R_ECME_LINEA_0_CM 1 0. 0. 20. ECU_ADDRESS 0xd000575b FORMAT "%2.0" /end MEASUREMENT
/begin MEASUREMENT Vbx_brk "State of the break switch ( 1 if pushed)" UBYTE _CNV_S_2_RANGE______3_CM 1 0. 0. 1. ECU_ADDRESS 0xd000575c BIT_MASK 0x1 /end MEASUREMENT
/begin MEASUREMENT Vbx_owe_igk_on_igk_off "Rising edge of the ignition key" UBYTE _CNV_S_2_RANGE______3_CM 1 0. 0. 1. ECU_ADDRESS 0xd000575d BIT_MASK 0x1 /end MEASUREMENT
/begin MEASUREMENT Vbx_owe_mnl_ini_req "Manual initialisation request" UBYTE _CNV_S_2_RANGE______3_CM 1 0. 0. 1. ECU_ADDRESS 0xd000575e BIT_MASK 0x1 /end MEASUREMENT
/begin MEASUREMENT Vxx_owe_ctr4 "Value of the fourth counter" UWORD _CNV_A_R_ECME_LINEA_0_CM 1 0. 0. 65535. ECU_ADDRESS 0xd0005944 FORMAT "%5.0" /end MEASUREMENT
/begin MEASUREMENT Vxx_owe_ctr5 "Value of the fifth counter" UWORD _CNV_A_R_ECME_LINEA_0_CM 1 0. 0. 65535. ECU_ADDRESS 0xd0005946 FORMAT "%5.0" /end MEASUREMENT
/begin CHARACTERISTIC Cxx_owe_ctr4 "Counter 4 threshold calibration" VALUE 0xa0020f32 _REC_S1VAL_20_u2 65535. _CNV_A_R_ECME_LINEA_0_CM 0. 65535. FORMAT "%5.0" /end CHARACTERISTIC
/begin CHARACTERISTIC Cxx_owe_ctr5 "Counter 5 threshold calibration" VALUE 0xa0020f34 _REC_S1VAL_20_u2 65535. _CNV_A_R_ECME_LINEA_0_CM 0. 65535. FORMAT "%5.0" /end CHARACTERISTIC
/begin CHARACTERISTIC Cxx_owe_n "Engine speed threshold to go out of the manual reset strategy condition" VALUE 0xa0020f36 _REC_S1VAL_20_u2 6000. _CNV_A_R_LINEAR_____21_CM 0. 6000. FORMAT "%4.0" /end CHARACTERISTIC
/begin CHARACTERISTIC Cxx_owe_pdl_thd "Accelerator pedal threshold for the manual reset strategy" VALUE 0xa0020f38 _REC_S1VAL_20_u2 1.25 _CNV_A_R_LINEAR_____211_CM 0. 1.25 FORMAT "%7.5" /end CHARACTERISTIC
/begin MEASUREMENT Vbx_owe_cfm "OCS inhibition variable" UBYTE _CNV_S_2_RANGE______3_CM 1 0. 0. 1. ECU_ADDRESS 0xd000545b BIT_MASK 0x1 /end MEASUREMENT
/begin CHARACTERISTIC Cbx_owe_cfm "OCS inhibition parameter" VALUE 0xa0020cba _REC_S1VAL_20_u1 1. _CNV_S_2_RANGE______3_CM 0. 1. BIT_MASK 0x1 /end CHARACTERISTIC
/begin COMPU_METHOD _CNV_A_R_ECME_LINEA_0_CM "" RAT_FUNC "%6.3" "-" COEFFS 0 1. 0. 0 0 1 /end COMPU_METHOD
/begin COMPU_METHOD _CNV_A_R_LINEAR_____2_CM "" RAT_FUNC "%6.3" "rpm" COEFFS 0 3.125e-002 0. 0 0 1 /end COMPU_METHOD
/begin COMPU_METHOD _CNV_S_2_RANGE______3_CM "" TAB_VERB "%6.3" "-" COMPU_TAB_REF _CNV_S_2_RANGE______3 /end COMPU_METHOD
/begin COMPU_VTAB _CNV_S_2_RANGE______3 "" TAB_VERB 2 0 "0" 1 "1" /end COMPU_VTAB
/begin COMPU_METHOD _CNV_A_R_LINEAR_____4_CM "" RAT_FUNC "%6.3" "s" COEFFS 0 10. 0. 0 0 1 /end COMPU_METHOD
/begin COMPU_METHOD _CNV_A_R_LINEAR_____21_CM "" RAT_FUNC "%6.3" "rpm" COEFFS 0 1. 0. 0 0 1 /end COMPU_METHOD
/begin COMPU_METHOD _CNV_A_R_ENSD_LINEA_24_CM "" RAT_FUNC "%6.3" "rpm" COEFFS 0 4. 0. 0 0 1 /end COMPU_METHOD
/begin COMPU_METHOD _CNV_A_R_LINEAR_____25_CM "" RAT_FUNC "%6.3" "∞CRK" COEFFS 0 2.666666666666667 0. 0 0 1 /end COMPU_METHOD
/begin COMPU_METHOD _CNV_A_R_LINEAR_____31_CM "" RAT_FUNC "%6.3" "-" COEFFS 0 256. 0. 0 0 1 /end COMPU_METHOD
/begin COMPU_METHOD _CNV_A_R_LINEAR_____34_CM "" RAT_FUNC "%6.3" "s" COEFFS 0 100. 0. 0 0 1 /end COMPU_METHOD
/begin COMPU_METHOD _CNV_A_R_LINEAR_____43_CM "" RAT_FUNC "%6.3" "-" COEFFS 0 128. 0. 0 0 1 /end COMPU_METHOD
/begin COMPU_METHOD _CNV_A_R_IGRE_LINEA_48_CM "" RAT_FUNC "%6.3" "∞CRK" COEFFS 0 2.666666666666667 63. 0 0 1 /end COMPU_METHOD
/begin COMPU_METHOD _CNV_A_R_LINEAR_____49_CM "" RAT_FUNC "%6.3" "-" COEFFS 0 32767.99999999992 0. 0 0 1 /end COMPU_METHOD
/begin COMPU_METHOD _CNV_A_R_LINEAR_____50_CM "" RAT_FUNC "%6.3" "µs" COEFFS 0 0.25 0. 0 0 1 /end COMPU_METHOD
/begin COMPU_METHOD _CNV_A_R_LINEAR_____52_CM "" RAT_FUNC "%6.3" "mV" COEFFS 0 1. 0. 0 0 1 /end COMPU_METHOD
/begin COMPU_METHOD _CNV_A_R_LINEAR_____53_CM "" RAT_FUNC "%6.3" "-" COEFFS 0 16384. 0. 0 0 1 /end COMPU_METHOD
/begin COMPU_METHOD _CNV_A_R_LINEAR_____54_CM "" RAT_FUNC "%6.3" "∞C" COEFFS 0 10. 400. 0 0 1 /end COMPU_METHOD
/begin COMPU_METHOD _CNV_A_R_LINEAR_____55_CM "" RAT_FUNC "%6.3" "TDC" COEFFS 0 1. 0. 0 0 1 /end COMPU_METHOD
/begin COMPU_METHOD _CNV_A_R_LINEAR_____57_CM "" RAT_FUNC "%6.3" "hPa" COEFFS 0 1. 0. 0 0 1 /end COMPU_METHOD
/begin COMPU_METHOD _CNV_A_R_LINEAR_____58_CM "" RAT_FUNC "%6.3" "s" COEFFS 0 1000. 0. 0 0 1 /end COMPU_METHOD
/begin COMPU_METHOD _CNV_A_R_LINEAR_____63_CM "" RAT_FUNC "%6.3" "-" COEFFS 0 98304. 0. 0 0 1 /end COMPU_METHOD
/begin COMPU_METHOD _CNV_A_R_LINEAR_____65_CM "" RAT_FUNC "%6.3" "-" COEFFS 0 98303.99999999926 -65535.99344639951 0 0 1 /end COMPU_METHOD
/begin COMPU_METHOD _CNV_A_R_LINEAR_____81_CM "" RAT_FUNC "%6.3" "mg" COEFFS 0 10. 0. 0 0 1 /end COMPU_METHOD
/begin COMPU_METHOD _CNV_A_R_LINEAR_____82_CM "" RAT_FUNC "%6.3" "s" COEFFS 0 1. 0. 0 0 1 /end COMPU_METHOD
/begin COMPU_METHOD _CNV_A_R_LINEAR_____94_CM "" RAT_FUNC "%6.3" "%" COEFFS 0 100. 0. 0 0 1 /end COMPU_METHOD
/begin COMPU_METHOD _CNV_A_R_LINEAR_____95_CM "" RAT_FUNC "%6.3" "m≤" COEFFS 0 16777217.69806384 0. 0 0 1 /end COMPU_METHOD
/begin COMPU_METHOD _CNV_A_R_LINEAR_____96_CM "" RAT_FUNC "%6.3" "-" COEFFS 0 32768.0000069121 0. 0 0 1 /end COMPU_METHOD
/begin COMPU_METHOD _CNV_A_R_LINEAR_____99_CM "" RAT_FUNC "%6.3" "%" COEFFS 0 20. 0. 0 0 1 /end COMPU_METHOD
/begin COMPU_METHOD _CNV_A_R_LINEAR_____108_CM "" RAT_FUNC "%6.3" "-" COEFFS 0 1000. 0. 0 0 1 /end COMPU_METHOD
/begin COMPU_METHOD _CNV_A_R_LINEAR_____109_CM "" RAT_FUNC "%6.3" "kg/h" COEFFS 0 20. 0. 0 0 1 /end COMPU_METHOD
/begin COMPU_METHOD _CNV_A_R_LINEAR_____118_CM "" RAT_FUNC "%6.3" "-" COEFFS 0 255. 0. 0 0 1 /end COMPU_METHOD
/begin COMPU_METHOD _CNV_S_3_STATUS_OK__120_CM "" TAB_VERB "%6.3" "-" COMPU_TAB_REF _CNV_S_3_STATUS_OK__120 /end COMPU_METHOD
/begin COMPU_VTAB _CNV_S_3_STATUS_OK__120 "" TAB_VERB 3 0 "Nsx_vld_nok_0" 1 "Nsx_vld_ok_1" 2 "Nsx_vld_fail_2" /end COMPU_VTAB
/begin COMPU_METHOD _CNV_S_4_STATUS_OK__121_CM "" TAB_VERB "%6.3" "-" COMPU_TAB_REF _CNV_S_4_STATUS_OK__121 /end COMPU_METHOD
/begin COMPU_VTAB _CNV_S_4_STATUS_OK__121 "" TAB_VERB 4 0 "Nsx_vld_nok_0" 1 "Nsx_vld_ok_1" 2 "Nsx_vld_fail_2" 3 "Nsx_vld_fail_3" /end COMPU_VTAB
/begin COMPU_METHOD _CNV_A_R_LINEAR_____122_CM "" RAT_FUNC "%6.3" "%" COEFFS 0 655.35 0. 0 0 1 /end COMPU_METHOD
/begin COMPU_METHOD _CNV_A_R_LINEAR_____125_CM "" RAT_FUNC "%6.3" "-" COEFFS 0 1024. 0. 0 0 1 /end COMPU_METHOD
/begin COMPU_METHOD _CNV_A_R_LINEAR_____140_CM "" RAT_FUNC "%6.3" "(km/h)/K*rpm" COEFFS 0 100. 1000. 0 0 1 /end COMPU_METHOD
/begin COMPU_METHOD _CNV_A_R_LINEAR_____145_CM "" RAT_FUNC "%6.3" "µs" COEFFS 0 1. 0. 0 0 1 /end COMPU_METHOD
/begin COMPU_METHOD _CNV_S_3_STATUS_OK__158_CM "" TAB_VERB "%6.3" "" COMPU_TAB_REF _CNV_S_3_STATUS_OK__158 /end COMPU_METHOD
/begin COMPU_VTAB _CNV_S_3_STATUS_OK__158 "" TAB_VERB 3 0 "Nsx_vld_nok_0" 1 "Nsx_vld_ok_1" 2 "Nsx_vld_fail_2" /end COMPU_VTAB
/begin COMPU_METHOD _CNV_S_3_STATUS_BRK_159_CM "" TAB_VERB "%6.3" "" COMPU_TAB_REF _CNV_S_3_STATUS_BRK_159 /end COMPU_METHOD
/begin COMPU_VTAB _CNV_S_3_STATUS_BRK_159 "" TAB_VERB 3 1 "Nsx_brk_pdl_off" 2 "Nsx_brk_pdl_on" 4 "Nsx_brk_pdl_vld_on" /end COMPU_VTAB
/begin COMPU_METHOD _CNV_S_2_STATUS_BRK_160_CM "" TAB_VERB "%6.3" "" COMPU_TAB_REF _CNV_S_2_STATUS_BRK_160 /end COMPU_METHOD
/begin COMPU_VTAB _CNV_S_2_STATUS_BRK_160 "" TAB_VERB 2 1 "Nsx_brk_pdl_off" 2 "Nsx_brk_pdl_on" /end COMPU_VTAB
/begin COMPU_METHOD _CNV_A_R_LINEAR_____161_CM "" RAT_FUNC "%6.3" "Nm" COEFFS 0 32. 12800. 0 0 1 /end COMPU_METHOD
/begin COMPU_METHOD _CNV_A_R_LINEAR_____162_CM "" RAT_FUNC "%6.3" "Nm/s" COEFFS 0 -0.2 0. 0 0 1 /end COMPU_METHOD
/begin COMPU_METHOD _CNV_A_R_LINEAR_____163_CM "" RAT_FUNC "%6.3" "Nm/s" COEFFS 0 0.2 0. 0 0 1 /end COMPU_METHOD
/begin COMPU_METHOD _CNV_S_4_STATUS_TQ__164_CM "" TAB_VERB "%6.3" "-" COMPU_TAB_REF _CNV_S_4_STATUS_TQ__164 /end COMPU_METHOD
/begin COMPU_VTAB _CNV_S_4_STATUS_TQ__164 "" TAB_VERB 4 0 "Nsx_no_tq_req" 1 "Nsx_asr_msr_tq_req_nok" 5 "Nsx_asr_tq_req" 6 "Nsx_msr_tq_req" /end COMPU_VTAB
/begin COMPU_METHOD _CNV_A_R_A_165_CM "" RAT_FUNC "%6.3" "" COEFFS 0 1. 0. 0 0 1 /end COMPU_METHOD
/begin COMPU_METHOD _CNV_A_R_LINEAR_____166_CM "" RAT_FUNC "%6.3" "mg/stk" COEFFS 0 10. 0. 0 0 1 /end COMPU_METHOD
/begin COMPU_METHOD _CNV_A_R_LINEAR_____167_CM "" RAT_FUNC "%6.3" "m3" COEFFS 0 1000000. 0. 0 0 1 /end COMPU_METHOD
/begin COMPU_METHOD _CNV_A_R_LINEAR_____168_CM "" RAT_FUNC "%6.3" "-" COEFFS 0 32768000.00000008 0. 0 0 1 /end COMPU_METHOD
/begin COMPU_METHOD _CNV_A_R_LINEAR_____169_CM "" RAT_FUNC "%6.3" "-" COEFFS 0 838860.8000000001 32768. 0 0 1 /end COMPU_METHOD
/begin COMPU_METHOD _CNV_A_R_LINEAR_____170_CM "" RAT_FUNC "%6.3" "-" COEFFS 0 32768. 0. 0 0 1 /end COMPU_METHOD
/begin COMPU_METHOD _CNV_A_R_LINEAR_____171_CM "" RAT_FUNC "%6.3" "-" COEFFS 0 838860.8000000001 0. 0 0 1 /end COMPU_METHOD
/begin COMPU_METHOD _CNV_A_R_LINEAR_____172_CM "" RAT_FUNC "%6.3" "1/s" COEFFS 0 655.3599999999997 32767.99999999999 0 0 1 /end COMPU_METHOD
/begin COMPU_METHOD _CNV_A_R_LINEAR_____173_CM "" RAT_FUNC "%6.3" "∞CRK" COEFFS 0 49.99999999999999 -3.637978807091713e-012 0 0 1 /end COMPU_METHOD
/begin COMPU_METHOD _CNV_A_R_LINEAR_____174_CM "" RAT_FUNC "%6.3" "m3" COEFFS 0 100000. 0. 0 0 1 /end COMPU_METHOD
/begin COMPU_METHOD _CNV_A_R_LINEAR_____175_CM "" RAT_FUNC "%6.3" "-" COEFFS 0 64. 0. 0 0 1 /end COMPU_METHOD
/begin COMPU_METHOD _CNV_A_R_LINEAR_____176_CM "" RAT_FUNC "%6.3" "m≤" COEFFS 0 268435455.9999995 0. 0 0 1 /end COMPU_METHOD
/begin COMPU_METHOD _CNV_A_R_LINEAR_____177_CM "" RAT_FUNC "%6.3" "kg/(s*m≤)" COEFFS 0 128. 0. 0 0 1 /end COMPU_METHOD
/begin COMPU_METHOD _CNV_A_R_LINEAR_____178_CM "" RAT_FUNC "%6.3" "m≤" COEFFS 0 268432047.1860408 0. 0 0 1 /end COMPU_METHOD
/begin COMPU_METHOD _CNV_A_R_LINEAR_____179_CM "" RAT_FUNC "%6.3" "-" COEFFS 0 98302.49017067616 0. 0 0 1 /end COMPU_METHOD
/begin COMPU_METHOD _CNV_A_R_LINEAR_____180_CM "" RAT_FUNC "%6.3" "-" COEFFS 0 32768. 32768. 0 0 1 /end COMPU_METHOD
/begin COMPU_METHOD _CNV_S_8_STATUS_OK__181_CM "" TAB_VERB "%6.3" "-" COMPU_TAB_REF _CNV_S_8_STATUS_OK__181 /end COMPU_METHOD
/begin COMPU_VTAB _CNV_S_8_STATUS_OK__181 "" TAB_VERB 8 0 "Nsx_vld_nok_0" 1 "Nsx_vld_ok_1" 2 "Nsx_vld_fail_2" 3 "Nsx_vld_fail_3" 4 "Nsx_vld_fail_4" 5 "Nsx_vld_fail_5" 6 "Nsx_vld_fail_6" 7 "Nsx_vld_fail_7" /end COMPU_VTAB
/begin COMPU_METHOD _CNV_A_R_LINEAR_____182_CM "" RAT_FUNC "%6.3" "mV" COEFFS 0 1. 25000. 0 0 1 /end COMPU_METHOD
/begin COMPU_METHOD _CNV_A_R_LINEAR_____183_CM "" RAT_FUNC "%6.3" "-" COEFFS 0 32768000. 1.192092895507813e-007 0 0 1 /end COMPU_METHOD
/begin COMPU_METHOD _CNV_A_R_LINEAR_____184_CM "" RAT_FUNC "%6.3" "-" COEFFS 0 16000. 0. 0 0 1 /end COMPU_METHOD
/begin COMPU_METHOD _CNV_A_R_LINEAR_____185_CM "" RAT_FUNC "%6.3" "-" COEFFS 0 800. 0. 0 0 1 /end COMPU_METHOD
/begin COMPU_METHOD _CNV_A_R_LINEAR_____186_CM "" RAT_FUNC "%6.3" "%" COEFFS 0 -20. 0. 0 0 1 /end COMPU_METHOD
/begin COMPU_METHOD _CNV_A_R_LINEAR_____187_CM "" RAT_FUNC "%6.3" "-" COEFFS 0 128. 128. 0 0 1 /end COMPU_METHOD
/begin COMPU_METHOD _CNV_S_2_STATUS_OK__188_CM "" TAB_VERB "%6.3" "" COMPU_TAB_REF _CNV_S_2_STATUS_OK__188 /end COMPU_METHOD
/begin COMPU_VTAB _CNV_S_2_STATUS_OK__188 "" TAB_VERB 2 0 "Nsx_vld_nok_0" 1 "Nsx_vld_ok_1" /end COMPU_VTAB
/begin COMPU_METHOD _CNV_A_R_LINEAR_____189_CM "" RAT_FUNC "%6.3" "K^1/2" COEFFS 0 36.57142857142857 -548.5714285714286 0 0 1 /end COMPU_METHOD
/begin COMPU_METHOD _CNV_A_R_LINEAR_____190_CM "" RAT_FUNC "%6.3" "∞C/s" COEFFS 0 10. 0. 0 0 1 /end COMPU_METHOD
/begin COMPU_METHOD _CNV_S_5_STATUS_TCO_191_CM "" TAB_VERB "%6.3" "-" COMPU_TAB_REF _CNV_S_5_STATUS_TCO_191 /end COMPU_METHOD
/begin COMPU_VTAB _CNV_S_5_STATUS_TCO_191 "" TAB_VERB 5 0 "Nsx_init_tco_fail" 1 "Nsx_wait_tco_fail" 10 "Nsx_inc_mdl" 20 "Nsx_no_inc_mdl" 30 "Nsx_no_inc_max_mdl" /end COMPU_VTAB
/begin COMPU_METHOD _CNV_A_R_LINEAR_____192_CM "" RAT_FUNC "%6.3" "kg" COEFFS 0 10000. 0. 0 0 1 /end COMPU_METHOD
/begin COMPU_METHOD _CNV_A_R_LINEAR_____194_CM "" RAT_FUNC "%6.3" "s" COEFFS 0 10000. 0. 0 0 1 /end COMPU_METHOD
/begin COMPU_METHOD _CNV_A_R_LINEAR_____195_CM "" RAT_FUNC "%6.3" "TDC" COEFFS 0 128. 0. 0 0 1 /end COMPU_METHOD
/begin COMPU_METHOD _CNV_A_R_LINEAR_____196_CM "" RAT_FUNC "%6.3" "TDC/∞" COEFFS 0 655360.0007936121 3.96806062781252e-005 0 0 1 /end COMPU_METHOD
/begin COMPU_METHOD _CNV_A_R_LINEAR_____211_CM "" RAT_FUNC "%6.3" "%" COEFFS 0 800. 0. 0 0 1 /end COMPU_METHOD
/begin COMPU_METHOD _CNV_A_R_LINEAR_____261_CM "" RAT_FUNC "%6.3" "-" COEFFS 0 16384. -8192. 0 0 1 /end COMPU_METHOD
/begin COMPU_METHOD _CNV_A_R_LINEAR_____263_CM "" RAT_FUNC "%6.3" "TDC" COEFFS 0 0.25 0. 0 0 1 /end COMPU_METHOD
/begin COMPU_METHOD _CNV_A_R_LINEAR_____301_CM "" RAT_FUNC "%6.3" "dent" COEFFS 0 1. 0. 0 0 1 /end COMPU_METHOD
/begin COMPU_METHOD _CNV_A_R_LINEAR_____302_CM "" RAT_FUNC "%6.3" "Nm" COEFFS 0 10. 0. 0 0 1 /end COMPU_METHOD
/begin COMPU_METHOD _CNV_A_R_LINEAR_____421_CM "" RAT_FUNC "%6.3" "∞C" COEFFS 0 10. 12000. 0 0 1 /end COMPU_METHOD
/begin RECORD_LAYOUT _REC_S1VAL_20_u1 FNC_VALUES 1 UBYTE COLUMN_DIR DIRECT /end RECORD_LAYOUT
/begin RECORD_LAYOUT _REC_S1VAL_20_u2 FNC_VALUES 1 UWORD COLUMN_DIR DIRECT /end RECORD_LAYOUT
/begin RECORD_LAYOUT _REC_S1VAL_20_s2 FNC_VALUES 1 SWORD COLUMN_DIR DIRECT /end RECORD_LAYOUT
/begin RECORD_LAYOUT _REC_A2AXS_20_u2 NO_AXIS_PTS_X 1 UWORD AXIS_PTS_X 2 UWORD INDEX_INCR DIRECT /end RECORD_LAYOUT
/begin RECORD_LAYOUT _REC_A1CUR_20_u1_u2 FNC_VALUES 1 UBYTE COLUMN_DIR DIRECT /end RECORD_LAYOUT
/begin RECORD_LAYOUT _REC_A1MAP_20_u2_u2_u2 FNC_VALUES 1 UWORD COLUMN_DIR DIRECT /end RECORD_LAYOUT
/begin RECORD_LAYOUT _REC_A1CUR_20_u2_u2 FNC_VALUES 1 UWORD COLUMN_DIR DIRECT /end RECORD_LAYOUT
/begin RECORD_LAYOUT _REC_A1MAP_20_u1_u2_u2 FNC_VALUES 1 UBYTE COLUMN_DIR DIRECT /end RECORD_LAYOUT
/begin FUNCTION InSmiSyn_Camsixx ""
 /begin DEF_CHARACTERISTIC Cxx_dfdec_in_cam_chr Cxx_dfdec_in_cam_crk_cmp Cxx_dfdec_in_cam_cyc Cxx_dfdec_in_cam_no_sig Cxx_dfdec_in_cam_nok Cxx_dfinc_in_cam_chr Cxx_dfinc_in_cam_crk_cmp Cxx_dfinc_in_cam_cyc Cxx_dfinc_in_cam_no_sig Cxx_dfinc_in_cam_nok /end DEF_CHARACTERISTIC
 /begin OUT_MEASUREMENT Vbx_in_cam_lvl Vbx_pres_df_in_cam_chr Vbx_pres_df_in_cam_crk_cmp Vbx_pres_df_in_cam_cyc Vbx_pres_df_in_cam_no_sig Vbx_pres_df_in_cam_nok Vsx_sens_in_cam_vld Vxx_in_cam_toth_per /end OUT_MEASUREMENT
/end FUNCTION
/begin FUNCTION InSmiSyn_Recocxx ""
 /begin DEF_CHARACTERISTIC Ctb_cylr_map Ctp_cylr_prs_stab_dif Cbx_bch_cylr Cbx_cylr_bas_conf Cbx_cylr_bch_mod Cbx_cylr_ena_re_phs Cbx_cylr_is_neg_clu_stal Cbx_cylr_is_run_gex_appl Cbx_cylr_loop Cbx_cylr_run_ol Cxx_crk1_bas_toth_nr Cxx_cylr_alti_prs_max_fac Cxx_cylr_alti_prs_min_fac Cxx_cylr_clc_ctr Cxx_cylr_clc_ctr_lpg Cxx_cylr_cold_is_stab_t Cxx_cylr_gear Cxx_cylr_is_clc_ctr Cxx_cylr_is_clc_ctr_lpg Cxx_cylr_is_max_test_nr Cxx_cylr_is_max_tq_dec Cxx_cylr_is_max_tq_dec_lpg Cxx_cylr_is_min_tq_dec Cxx_cylr_is_min_tq_dec_lpg Cxx_cylr_is_run_max_tco Cxx_cylr_is_run_min_tco Cxx_cylr_is_run_n_fac Cxx_cylr_is_ti_cor_max Cxx_cylr_l_n_re_phs Cxx_cylr_l_prs_dif_fac Cxx_cylr_l_prs_re_phs Cxx_cylr_max_dif_iga Cxx_cylr_max_mv_lamb_fac Cxx_cylr_max_n Cxx_cylr_max_n_lpg Cxx_cylr_max_prs Cxx_cylr_max_prs_lpg Cxx_cylr_max_tco Cxx_cylr_max_test_nr Cxx_cylr_max_tq_dec Cxx_cylr_max_tq_dec_lpg Cxx_cylr_min_mv_lamb_fac Cxx_cylr_min_n Cxx_cylr_min_n_lpg Cxx_cylr_min_prs Cxx_cylr_min_prs_lpg Cxx_cylr_min_tco Cxx_cylr_min_tq_dec Cxx_cylr_min_tq_dec_lpg Cxx_cylr_n_stab_dif Cxx_cylr_stab_ctr Cxx_cylr_stab_ctr_lpg Cxx_cylr_stab_inj_dif Cxx_cylr_stab_is_ctr Cxx_cylr_stab_is_ctr_lpg Cxx_cylr_stab_t Cxx_cylr_trz_stab_dif Cxx_is_run_stal_step Cxx_stal_step /end DEF_CHARACTERISTIC
 /begin OUT_MEASUREMENT Vbx_ac_in_mem Vbx_ac_out_mem Vbx_clu_stal_ctr_ini Vbx_cylr_is_run_ctl_ini Vbx_cylr_is_run_mes Vbx_cylr_is_run_req Vbx_cylr_is_run_stab_cdn Vbx_cylr_is_run_stop Vbx_cylr_run_loop_stop Vbx_cylr_run_stab_cdn Vbx_cylr_stab_cdn Vbx_cylr_stab_cdn_rtn Vbx_cylr_stop Vbx_cylr_tot_stab_cdn Vbx_gas_comb_mod Vbx_iga_re_syn_req Vbx_inj_dstb_act Vbx_inj_dstb_phs1 Vbx_inj_dstb_phs2 Vbx_inj_re_phs_req Vbx_mdf1_cmd_mem Vbx_mdf2_cmd_mem Vbx_mis_inj_re_phs_done Vbx_rich_cl_cylr_mem Vbx_run_cylr_mem Vbx_tdc_re_syn_ctr_req Vbx_tolo Vxx_clu_stal_ctr_ini Vxx_cylr_clc_ctr_yy Vxx_cylr_ctl_phs Vxx_cylr_id_sta_ofs Vxx_cylr_iga_mem Vxx_cylr_is_clc_ctr_yy Vxx_cylr_is_max_tq_dec_yy Vxx_cylr_is_min_tq_dec_yy Vxx_cylr_is_run_test_ctr Vxx_cylr_is_vld_ctr_ini Vxx_cylr_max_n_yy Vxx_cylr_max_prs_yy Vxx_cylr_max_tq_dec_yy Vxx_cylr_min_n_yy Vxx_cylr_min_prs_yy Vxx_cylr_min_tq_dec_yy Vxx_cylr_ok_aftr_stal_ctr_ini Vxx_cylr_ok_ctr_ini Vxx_cylr_prs_stab_dif Vxx_cylr_stab_ctr_yy Vxx_cylr_stab_is_ctr_yy Vxx_cylr_tdc_ctr Vxx_cylr_test_ctr Vxx_dyn_re_phs_ofs Vxx_err_cylr_ctr_ini Vxx_err_cylr_is_run_ctr_ini Vxx_err_id_is_run_ctr_ini Vxx_inj_mov_ofs Vxx_is_cylr_ok_ctr_ini Vxx_map_cor Vxx_n_cylr_mem Vxx_no_deci_cylr_ctr_ini Vxx_no_deci_id_is_ctr_ini Vxx_prs_cylr_mem Vxx_run_re_phs_ctr_ini Vxx_ti_cylr_mem Vxx_tq_dec Vxx_trz_cylr_mem /end OUT_MEASUREMENT
/end FUNCTION
/begin FUNCTION InSmiSyn_Spdmfxx "" /begin OUT_MEASUREMENT Vxx_n_tdc_2 Vxx_n_tdc_4 /end OUT_MEASUREMENT /end FUNCTION
/begin FUNCTION InSmiSyn_Schedul "" /begin DEF_CHARACTERISTIC Cbx_in_vvtc_abst_pres_cfm /end DEF_CHARACTERISTIC /begin OUT_MEASUREMENT Vbx_in_vvt_cfm /end OUT_MEASUREMENT /end FUNCTION
/begin FUNCTION OuVfoSup ""
 /begin SUB_FUNCTION OuVfoSup_Actuaxx OuVfoSup_Pwsxxxx OuVfoSup_Pws3xxx OuVfoSup_Pwsxvld OuVfoSup_Pwlrtnx /end SUB_FUNCTION
/end FUNCTION
/begin FUNCTION OuVfoSup_Actuaxx ""
 /begin DEF_CHARACTERISTIC Cbx_l_pwl_conf Cxx_dfdec_actr_rly_oc Cxx_dfdec_actr_rly_scg Cxx_dfdec_actr_rly_scw Cxx_dfinc_actr_rly_oc Cxx_dfinc_actr_rly_scg Cxx_dfinc_actr_rly_scw Cxx_min_pwl_dly Cxx_pwl_dly Cxx_pwl_dly_pws_max Cxx_pwl_dly_secu /end DEF_CHARACTERISTIC
 /begin OUT_MEASUREMENT Vbx_actr_rly_cmd Vbx_max_ecu_pws Vbx_min_ecu_pws Vbx_pwl_dly_pws Vbx_pwl_dly_secu Vbx_pwl_on Vbx_rly_cmd_req Vsx_actr_rly_vld Vxx_pwl_dly Vxx_pwl_dly_pws /end OUT_MEASUREMENT
/end FUNCTION
/begin FUNCTION OuVfoSup_Pwsxxxx ""
 /begin DEF_CHARACTERISTIC Cxx_dfdec_pws_1_h Cxx_dfdec_pws_1_l Cxx_dfdec_pws_2_h Cxx_dfdec_pws_2_l Cxx_dfinc_pws_1_h Cxx_dfinc_pws_1_l Cxx_dfinc_pws_2_h Cxx_dfinc_pws_2_l /end DEF_CHARACTERISTIC
 /begin OUT_MEASUREMENT Vsx_pws_1_vld Vsx_pws_2_vld Vxx_pws_1 Vxx_pws_2 /end OUT_MEASUREMENT
/end FUNCTION
/begin FUNCTION OuVfoSup_Pws3xxx ""
 /begin DEF_CHARACTERISTIC Cxx_dfdec_pws_3_h Cxx_dfdec_pws_3_l Cxx_dfinc_pws_3_h Cxx_dfinc_pws_3_l /end DEF_CHARACTERISTIC
 /begin OUT_MEASUREMENT Vsx_pws_3_vld Vxx_pws_3 /end OUT_MEASUREMENT
/end FUNCTION
/begin FUNCTION OuVfoSup_Pwsxvld ""
 /begin OUT_MEASUREMENT Vsx_pws_sens_ac_prs_vld Vsx_pws_sens_acel_pdl_v1_vld Vsx_pws_sens_acel_pdl_v2_vld Vsx_pws_sens_it_vld Vsx_pws_sens_lbdw_vld Vsx_pws_sens_lbup_vld Vsx_pws_sens_map_vld Vsx_pws_sens_rvac_vld Vsx_pws_sens_spg_vld Vxx_pws_sens_it /end OUT_MEASUREMENT
/end FUNCTION
/begin FUNCTION OuVfoSup_Pwlrtnx "" /begin OUT_MEASUREMENT Vbx_rest_pwl_rtn /end OUT_MEASUREMENT /end FUNCTION
/begin FUNCTION InPciBki ""
 /begin OUT_MEASUREMENT Vxx_brk_pdl_clos_blk_off_dly Vxx_brk_pdl_clos_blk_on_dly Vxx_brk_pdl_open_blk_off_dly Vxx_brk_pdl_open_blk_on_dly Vbx_sens_brk_pdl_open_lk_stt /end OUT_MEASUREMENT
 /begin SUB_FUNCTION InPciBki_Absxxcs InPciBki_Brk1xcs InPciBki_Cnbkocs InPciBki_Bpkxxcs /end SUB_FUNCTION
/end FUNCTION
/begin FUNCTION InPciBki_Absxxcs "" /begin OUT_MEASUREMENT Vbx_abs_reg /end OUT_MEASUREMENT /end FUNCTION
/begin FUNCTION InPciBki_Brk1xcs "" /begin OUT_MEASUREMENT Vsx_brk_pdl Vsx_brk_pdl_cru_vld Vsx_brk_pdl_vld /end OUT_MEASUREMENT /end FUNCTION
/begin FUNCTION InPciBki_Cnbkocs "" /begin DEF_CHARACTERISTIC Cxx_sens_brk_lk_vb_dly Cxx_sens_brk_lk_vb_thd /end DEF_CHARACTERISTIC /begin OUT_MEASUREMENT Vsx_brk_pdl_open Vsx_brk_pdl_open_vld /end OUT_MEASUREMENT /end FUNCTION
/begin FUNCTION InPciBki_Bpkxxcs "" /begin OUT_MEASUREMENT Vbx_bpk /end OUT_MEASUREMENT /end FUNCTION
/begin FUNCTION InPciEsp "" /begin SUB_FUNCTION InPciEsp_Absctxx_xxxxxx InPciEsp_Espxxcs_xxxxxx /end SUB_FUNCTION /end FUNCTION
/begin FUNCTION InPciEsp_Absctxx_xxxxxx ""
 /begin DEF_CHARACTERISTIC Cxx_asr_msr_abst_dly Cxx_asr_msr_ctr_thd Cxx_asr_msr_max_tqe Cxx_asr_msr_raw_sum Cxx_asr_slwr_neg Cxx_asr_slwr_pos Cxx_asr_tqe_sp_msr_raw Cxx_dfdec_esp_data_chr Cxx_dfdec_esp_data_seq_ctr Cxx_dfdec_esp_no_frm Cxx_dfinc_esp_data_chr Cxx_dfinc_esp_data_seq_ctr Cxx_dfinc_esp_no_frm Cxx_min_tqe_dsb Cxx_mux_asr_msr_tqe_nok_raw /end DEF_CHARACTERISTIC
 /begin OUT_MEASUREMENT Vbx_asr_cdn Vbx_asr_msr_ack Vbx_asr_msr_cdn Vbx_asr_msr_frm_abst_tmp Vbx_asr_msr_lk Vbx_asr_prot_dft Vbx_asr_tqe_req_ok Vbx_df_esp_data_chr Vbx_df_esp_data_seq_ctr Vbx_df_esp_no_frm Vbx_msr_cdn Vbx_msr_tqe_req_ok Vbx_tmp_df_esp_data_chr Vbx_tmp_df_esp_data_seq_ctr Vxx_asr_msr_20ms_t Vxx_asr_tqe_sp Vxx_asr_tqe_tgt Vxx_msr_tqe_sp /end OUT_MEASUREMENT
/end FUNCTION
/begin FUNCTION InPciEsp_Espxxcs_xxxxxx "" /begin OUT_MEASUREMENT Vbx_asr_reg Vbx_ayc_reg Vsx_asr_msr_typ /end OUT_MEASUREMENT /end FUNCTION
/begin FUNCTION InAsiIaf ""
 /begin SUB_FUNCTION InAsiIaf_Airwhxx InAsiIaf_Cpmafxx InAsiIaf_Filupxx InAsiIaf_Macstxx InAsiIaf_Pzeroxx InAsiIaf_Itarexx InAsiIaf_Alcoxxx /end SUB_FUNCTION
/end FUNCTION
/begin FUNCTION InAsiIaf_Airwhxx ""
 /begin DEF_CHARACTERISTIC Ctb_eal Cxx_cyl_vol Cxx_eng_air_wht_ref Cxx_pump_maf_fil_ftc /end DEF_CHARACTERISTIC
 /begin OUT_MEASUREMENT Vxb_eal.factor Vxb_eal.index Vxb_eal.num_dp Vxb_pred_eal.factor Vxb_pred_eal.index Vxb_pred_eal.num_dp Vsx_eal_vld Vxx_eal Vxx_eal_tdc_2 Vxx_eal_tdc_4 Vxx_pred_air_wht_frh Vxx_pred_eal Vxx_pump_maf Vxx_pump_maf_fil /end OUT_MEASUREMENT
/end FUNCTION
/begin FUNCTION InAsiIaf_Cpmafxx ""
 /begin DEF_CHARACTERISTIC Ntb_100_9 Ntb_1_9 Ctp_cp_load_fac_cor Ctp_pwm_cp_efv_ar1 Ctp_pwm_cp_efv_ar2 Cbx_as_cpmaf_on_mod Cxx_dft_cp_load Cxx_flr_clc_dsb_prs_thd /end DEF_CHARACTERISTIC
 /begin OUT_MEASUREMENT Vxx_clc_ar_cp_air_gas_maf Vxx_clc_ar_cp_air_gas_maf_cor Vxx_cp_efv_ar Vxx_cp_maf Vxx_raw_cp_maf /end OUT_MEASUREMENT
/end FUNCTION
/begin FUNCTION InAsiIaf_Filupxx ""
 /begin DEF_CHARACTERISTIC Cmp_n_map_fill_efv Cmp_vvt_fill_efv_cor_fac1 Cmp_vvt_fill_efv_cor_fac2 Ctp_vlv_air_temp_cor Cbx_vvtc_in_ang_ofs Cxx_eng_vol_fill_efy_drv_max Cxx_eng_vol_fill_efy_dz Cxx_vvt_fill_efv_cam_ofs /end DEF_CHARACTERISTIC
 /begin OUT_MEASUREMENT Vsx_eng_vol_fill_efy_vld Vxx_air_temp_inj_cor Vxx_eng_vol_fill_efy Vxx_eng_vol_fill_efy_fil Vxx_fill_efv_cor_rat Vxx_vvt_fill_efv_cor Vxx_vvt_fill_efv_cor_fac1 Vxx_vvt_fill_efv_cor_fac2 /end OUT_MEASUREMENT
/end FUNCTION
/begin FUNCTION InAsiIaf_Macstxx "" /begin DEF_CHARACTERISTIC Cxx_mfld_vol /end DEF_CHARACTERISTIC /begin OUT_MEASUREMENT Vxx_mfld_dly /end OUT_MEASUREMENT /end FUNCTION
/begin FUNCTION InAsiIaf_Pzeroxx "" /begin DEF_CHARACTERISTIC Cmp_prs_n_alti_min_map_cor Ctp_min_map /end DEF_CHARACTERISTIC /begin OUT_MEASUREMENT Vsx_min_map_maf_vld Vxx_min_map_maf /end OUT_MEASUREMENT /end FUNCTION
/begin FUNCTION InAsiIaf_Itarexx "" /begin DEF_CHARACTERISTIC Ctp_it_ar_psn /end DEF_CHARACTERISTIC /begin OUT_MEASUREMENT Vxx_pred_map_efv_it_ar /end OUT_MEASUREMENT /end FUNCTION
/begin FUNCTION InAsiIaf_Alcoxxx "" /begin DEF_CHARACTERISTIC Ctp_vlv_air_temp_cor_alco Cmp_n_map_fill_efv_ofs_alco /end DEF_CHARACTERISTIC /begin OUT_MEASUREMENT Vxx_fill_efv_ofs_alco Vxx_vlv_air_temp_cor_alco /end OUT_MEASUREMENT /end FUNCTION
/begin FUNCTION InAsiIti "" /begin SUB_FUNCTION InAsiIti_Itposxx_xxxxxg /end SUB_FUNCTION /end FUNCTION
/begin FUNCTION InAsiIti_Itposxx_xxxxxg ""
 /begin DEF_CHARACTERISTIC Ctb_sens_it_cor_1 Ctb_sens_it_cor_2 Ctp_sens_it_cor_1 Ctp_sens_it_cor_2 Cbx_sens_it_chr_fil_cho Cbx_sens_it_mcut_cho Cbx_sens_it_mcut_cho_2 Cbx_sens_it_typ_1 Cbx_sens_it_typ_2 Cbx_sens_it_vld_cho_1 Cbx_sens_it_vld_cho_2 Cbx_sens_it_vld_cho_3 Cxx_dfdec_sens_it_1_nok Cxx_dfdec_sens_it_2_nok Cxx_dfdec_sens_it_chr Cxx_dfdec_sens_it_sig_mcut Cxx_dfinc_sens_it_1_nok Cxx_dfinc_sens_it_2_nok Cxx_dfinc_sens_it_chr Cxx_dfinc_sens_it_sig_mcut Cxx_it_psn_stab_dly_1 Cxx_it_psn_stab_dly_2 Cxx_it_psn_stab_thd_1 Cxx_it_psn_stab_thd_2 Cxx_sens_it_1_src_max Cxx_sens_it_1_src_min Cxx_sens_it_2_src_max Cxx_sens_it_2_src_min Cxx_sens_it_chr_fil Cxx_sens_it_max_chr_dif Cxx_sens_it_mcut_det_dly Cxx_sens_it_spd_chr_thd /end DEF_CHARACTERISTIC
 /begin OUT_MEASUREMENT Vbx_df_sens_it_1_nok Vbx_df_sens_it_2_nok Vbx_df_sens_it_chr Vbx_df_sens_it_sig_mcut Vbx_diag_ena_sens_it_chr Vbx_it_psn_stab_1 Vbx_it_psn_stab_2 Vbx_it_psn_stab_det_1 Vbx_it_psn_stab_det_2 Vbx_sens_it_spd_chr_no_norm Vsx_it_sens_vld Vsx_it_sens_vld_prev Vsx_it_sens_vld_tmp Vxx_it_psn Vxx_it_psn_mv_1 Vxx_it_psn_mv_2 Vxx_it_psn_stab_1 Vxx_it_psn_stab_2 Vxx_sens_it_1 Vxx_sens_it_2 Vxx_sens_it_tmp_1 Vxx_sens_it_tmp_2 /end OUT_MEASUREMENT
/end FUNCTION
/begin FUNCTION OuAsoIto "" /begin SUB_FUNCTION OuAsoIto_Itdiagx OuAsoIto_Itmonxx OuAsoIto_Itregul /end SUB_FUNCTION /end FUNCTION
/begin FUNCTION OuAsoIto_Itdiagx ""
 /begin DEF_CHARACTERISTIC Cxx_dfdec_it_cmd_el Cxx_dfdec_it_ofs_meca Cxx_dfdec_it_ofs_no_norm Cxx_dfdec_it_ofs_secu_nok Cxx_dfdec_it_reg_blk Cxx_dfinc_it_cmd_el Cxx_dfinc_it_ofs_meca Cxx_dfinc_it_ofs_no_norm Cxx_dfinc_it_ofs_secu_nok Cxx_dfinc_it_reg_blk Cxx_it_diag_psn_stab_dly Cxx_it_diag_psn_stab_thd Cxx_it_max_clos_psn Cxx_it_max_clos_psn_dev Cxx_it_max_lih_psn Cxx_it_max_lih_psn_dev Cxx_it_max_open_psn Cxx_it_max_open_psn_dev Cxx_it_min_clos_psn Cxx_it_min_lih_psn Cxx_it_min_open_psn Cxx_it_ofs_meca_decr Cxx_it_ofs_meca_incr Cxx_it_ofs_no_norm_decr Cxx_it_ofs_no_norm_incr Cxx_it_ofs_secu_nok_decr Cxx_it_ofs_secu_nok_incr Cxx_it_reg_blk_det_dly Cxx_it_reg_blk_max_err Cxx_it_reg_blk_max_err_2 Cxx_it_reg_blk_v_max_thd Cxx_it_reg_blk_v_min_thd /end DEF_CHARACTERISTIC
 /begin OUT_MEASUREMENT Vxx_it_open_psn_1 Vxx_it_open_psn_2 Vxx_it_ofs_secu_nok_ctr Vxx_it_ofs_meca_ctr Vxx_it_ofs_no_norm_ctr Vbx_df_it_ofs_meca Vbx_df_it_ofs_meca_tmp Vbx_df_it_ofs_no_norm Vbx_df_it_ofs_no_norm_tmp Vbx_df_it_ofs_secu_nok Vbx_df_it_ofs_secu_nok_tmp Vbx_df_it_reg_blk Vbx_diag_ena_it_ofs_1 Vbx_diag_ena_it_ofs_meca Vbx_diag_ena_it_ofs_no_norm Vbx_diag_ena_it_ofs_secu_nok Vbx_it_diag_ad_1 Vbx_it_diag_ad_2 Vbx_it_diag_ad_end_1 Vbx_it_diag_ad_end_2 Vbx_it_diag_ad_fail Vbx_it_diag_ini Vbx_it_diag_psn_stab Vbx_it_diag_psn_stab_det_1 Vbx_it_diag_stab_ena Vbx_it_reset_reg_blk Vxx_it_diag_psn_stab Vxx_it_ofs_meca_ctr_tmp Vxx_it_ofs_no_norm_ctr_tmp Vxx_it_ofs_secu_nok_ctr_tmp Vxx_it_tempo_reg_blk /end OUT_MEASUREMENT
/end FUNCTION
/begin FUNCTION OuAsoIto_Itmonxx ""
 /begin DEF_CHARACTERISTIC Ctb_it_frst_ad_t Ctb_it_frst_ad_t_2 Ctb_it_ol_v_psn Ctb_it_pwl_ad_t Ctb_it_pwl_ad_t_2 Ctd_it_frst_ad_deci Ctd_it_frst_ad_req Ctd_it_frst_ad_v_cut Ctd_it_pwl_ad_deci Ctd_it_pwl_ad_req Ctd_it_pwl_ad_v_cut Ctp_it_frst_ad_sp Ctp_it_ol_v Ctp_it_pwl_ad_sp Cbx_it_ad_req Cbx_it_ad_sat_v_lim Cbx_it_bch_mod_ena Cbx_it_igk_on_ad_ena Cbx_it_mon_1_sens_ad Cbx_it_sens_vld_2_fail_cho Cbx_it_sens_vld_3_fail_cho Cxx_it_ad_rge_down Cxx_it_ad_rge_up Cxx_it_ad_v_lim_down Cxx_it_ad_v_lim_up Cxx_it_clos_psn_ini Cxx_it_frst_ad_t Cxx_it_learn_max_temp Cxx_it_learn_min_temp Cxx_it_lih_psn_ini Cxx_it_ofs_ctr_max_1 Cxx_it_ofs_ctr_max_2 Cxx_it_open_psn_ini Cxx_it_psn_ftc Cxx_it_pwl_ad_t Cxx_it_rge_down Cxx_it_rge_up Cxx_it_stt_frst_ctr Cxx_it_stt_pwl_check_ctr Cxx_it_stt_pwl_end_ctr Cxx_it_stt_pwl_learn_ctr Cxx_it_v_lim_down Cxx_it_v_lim_up /end DEF_CHARACTERISTIC
 /begin OUT_MEASUREMENT Vbx_it_pwl_ad_req Vbx_it_frst_ad_ok Vbx_it_frst_ad_stop Vxx_it_clos_psn_1 Vxx_it_lih_psn_1 Vxx_it_clos_psn_2 Vxx_it_lih_psn_2 Vbx_diag_ena_it_ofs Vbx_diag_ena_it_reg_blk Vbx_it_ad_cyc_end Vbx_it_ad_cyc_end_mem Vbx_it_ad_cyc_v_cut Vbx_it_ad_ena Vbx_it_ad_v_lim_stop Vbx_it_cyc_cho Vbx_it_cyc_inter Vbx_it_hbrg_inh Vbx_it_igk_on Vbx_it_imd_ad_req Vbx_it_imd_ad_req_tmp Vbx_it_mon_mv_ena_1 Vbx_it_mon_mv_ena_2 Vbx_it_mon_read_ena Vbx_it_ofs_diag_ena_1 Vbx_it_ofs_diag_ena_2 Vbx_it_pwl_bgin Vbx_it_pwl_end Vbx_it_pws_req Vbx_it_read_ok_1 Vbx_it_read_ok_2 Vbx_it_req_fail_1 Vbx_it_req_fail_2 Vbx_it_sta_dsb Vbx_it_temp_no_ok Vbx_it_trigger_1 Vbx_it_trigger_2 Vbx_it_trigger_3 Vbx_it_trigger_4 Vbx_it_trigger_5 Vbx_it_trigger_ofs_1 Vbx_it_trigger_ofs_2 Vbx_it_trigger_ofs_3 Vbx_it_trigger_ofs_4 Vbx_it_trigger_ofs_5 Vbx_it_trigger_ofs_6 Vbx_it_v_sp_cho Vbx_it_write_ena Vsx_it_ctl_vld Vsx_it_vld Vxx_fil1_it_abs_psn_sp Vxx_it_ad_cyc_req Vxx_it_ad_cyc_sp Vxx_it_ad_deci Vxx_it_ad_fail_deci Vxx_it_ad_fail_deci_mem Vxx_it_ad_pb Vxx_it_ad_req Vxx_it_ad_req_mem Vxx_it_ad_stt Vxx_it_ad_typ Vxx_it_clos_psn Vxx_it_cyc_nr Vxx_it_cyc_remaining_t Vxx_it_diag_fail_mode Vxx_it_lih_psn Vxx_it_mon_psn_sp Vxx_it_mon_v_sp Vxx_it_ofs_1 Vxx_it_ofs_2 Vxx_it_ofs_ctr_1 Vxx_it_ofs_ctr_2 Vxx_it_ofs_down Vxx_it_ofs_up Vxx_it_ol_ctr Vxx_it_open_psn Vxx_it_read_stt_1 Vxx_it_read_stt_2 Vxx_it_rel_psn Vxx_it_rge_down Vxx_it_rge_up Vxx_it_stt Vxx_it_stt_ctr Vxx_it_v_lim_down Vxx_it_v_lim_up Vxx_mv_it_rel_psn /end OUT_MEASUREMENT
/end FUNCTION
/begin FUNCTION OuAsoIto_Itregul ""
 /begin DEF_CHARACTERISTIC Cbx_it_psn_ctl_sgn Cbx_it_psn_fil_cho_1 Cbx_it_psn_sp_ctl_sgn Cxx_it_cmd_val_1 Cxx_it_cmd_val_2 Cxx_it_cmd_val_3 Cxx_it_cps_v Cxx_it_ctl_lim Cxx_it_ctl_psn_sp_stab_thd Cxx_it_ctl_psn_stab_thd Cxx_it_ctl_psn_thd Cxx_it_ctl_stab_dly Cxx_it_frn_cps_v Cxx_it_psn_ctl_0 Cxx_it_psn_ctl_1 Cxx_it_psn_ctl_2 Cxx_it_psn_ctl_3 Cxx_it_psn_frn_cps_thd Cxx_it_psn_slop_lim_down Cxx_it_psn_slop_lim_up Cxx_it_psn_sp_ctl_0 Cxx_it_psn_sp_ctl_1 Cxx_it_psn_sp_ctl_2 /end DEF_CHARACTERISTIC
 /begin OUT_MEASUREMENT Vbx_it_psn_sp_slop_ena Vbx_it_v_lim_down Vbx_it_v_lim_up Vxx_it_cmd_val Vxx_it_cmd_val_1 Vxx_it_cmd_val_2 Vxx_it_cmd_val_3 Vxx_it_cmd_val_lim Vxx_it_cmd_val_lim_1 Vxx_it_ctl_err Vxx_it_ctl_err_lim Vxx_it_frn_cps_v Vxx_it_lim_down_thd Vxx_it_lim_up_thd Vxx_it_psn_ctl Vxx_it_psn_ctl_0 Vxx_it_psn_ctl_1 Vxx_it_psn_ctl_2 Vxx_it_psn_ctl_3 Vxx_it_psn_reg_1 Vxx_it_psn_reg_3 Vxx_it_psn_sp_cor_1 Vxx_it_psn_sp_ctl Vxx_it_psn_sp_ctl_0 Vxx_it_psn_sp_ctl_1 Vxx_it_psn_sp_ctl_2 Vxx_it_psn_sp_mod Vxx_it_psn_sp_reg Vxx_it_psn_sp_slop Vxx_it_v_sp Vxx_it_v_sp_cor_lim /end OUT_MEASUREMENT
/end FUNCTION
/begin FUNCTION OuAsoTco "" /begin SUB_FUNCTION OuAsoTco_Wgcdiag /end SUB_FUNCTION /end FUNCTION
/begin FUNCTION OuAsoTco_Wgcdiag ""
 /begin DEF_CHARACTERISTIC Cxx_dfdec_wgc_oc Cxx_dfdec_wgc_scg Cxx_dfdec_wgc_scw Cxx_dfinc_wgc_oc Cxx_dfinc_wgc_scg Cxx_dfinc_wgc_scw /end DEF_CHARACTERISTIC
 /begin OUT_MEASUREMENT Vsx_wgc_vld /end OUT_MEASUREMENT
/end FUNCTION
/begin FUNCTION InAsiIat ""
 /begin SUB_FUNCTION InAsiIat_Matxxmd InAsiIat_Matxxcs InAsiIat_Matxxsr InAsiIat_Upittxx InAsiIat_Vlvtpxx /end SUB_FUNCTION
/end FUNCTION
/begin FUNCTION InAsiIat_Matxxmd "" /begin DEF_CHARACTERISTIC Cxx_mem_mat_fail_max_mat /end DEF_CHARACTERISTIC /begin OUT_MEASUREMENT Vsx_mdl_mat_vld Vxx_mdl_mat /end OUT_MEASUREMENT /end FUNCTION
/begin FUNCTION InAsiIat_Matxxcs "" /begin DEF_CHARACTERISTIC Cxx_mat_fail_val /end DEF_CHARACTERISTIC /begin OUT_MEASUREMENT Vsx_mat_vld Vxx_mat Vxx_sqrt_mat /end OUT_MEASUREMENT /end FUNCTION
/begin FUNCTION InAsiIat_Matxxsr "" /begin DEF_CHARACTERISTIC Cxx_dfdec_sens_mat Cxx_dfinc_sens_mat /end DEF_CHARACTERISTIC /begin OUT_MEASUREMENT Vsx_sens_mat_vld Vxx_sens_mat /end OUT_MEASUREMENT /end FUNCTION
/begin FUNCTION InAsiIat_Upittxx "" /begin OUT_MEASUREMENT Vsx_up_it_temp_vld Vxx_sqrt_up_it_temp Vxx_up_it_temp /end OUT_MEASUREMENT /end FUNCTION
/begin FUNCTION InAsiIat_Vlvtpxx ""
 /begin DEF_CHARACTERISTIC Cmp_n_prs_mat_ftc Ctp_n_mat_fac Ctp_prs_mat_fac Cxx_mat_fac Ctb_mat2 /end DEF_CHARACTERISTIC
 /begin OUT_MEASUREMENT Vsx_vlv_air_temp_vld Vxx_mat_fac Vxx_vlv_air_temp Vxx_vlv_air_temp_ftc /end OUT_MEASUREMENT
/end FUNCTION
/begin FUNCTION InCliCoi ""
 /begin SUB_FUNCTION InCliCoi_Tcoxxcs InCliCoi_Tcoxxsr InCliCoi_Tcoxxmd InCliCoi_Tcomcsr /end SUB_FUNCTION
/end FUNCTION
/begin FUNCTION InCliCoi_Tcoxxcs "" /begin DEF_CHARACTERISTIC Ctb_sta_tco Ctb_tco Ctb_tco2 Cxx_tco_inc /end DEF_CHARACTERISTIC
 /begin OUT_MEASUREMENT Vxb_sta_tco.factor Vxb_sta_tco.index Vxb_sta_tco.num_dp Vxb_tco.factor Vxb_tco.index Vxb_tco.num_dp Vxb_tco2.factor Vxb_tco2.index Vxb_tco2.num_dp Vsx_sta_tco_vld Vsx_tco_vld Vxx_sta_tco Vxx_tco /end OUT_MEASUREMENT
/end FUNCTION
/begin FUNCTION InCliCoi_Tcoxxsr "" /begin DEF_CHARACTERISTIC Cxx_dfdec_sens_tco Cxx_dfinc_sens_tco Cxx_raw_sens_tco_ini /end DEF_CHARACTERISTIC
 /begin OUT_MEASUREMENT Vbx_df_sens_tco Vsx_sens_tco_vld Vxx_sens_tco Vxx_sens_tco_frz /end OUT_MEASUREMENT
/end FUNCTION
/begin FUNCTION InCliCoi_Tcoxxmd ""
 /begin DEF_CHARACTERISTIC Cxx_mdl_tco_inc Cxx_mdl_tco_max Cxx_tdc_mdl_fail_tdc_cnt Cxx_tdc_mdl_tdc_cnt /end DEF_CHARACTERISTIC
 /begin OUT_MEASUREMENT Vbx_tco_mdl_cnt Vsx_mdl_tco Vsx_mdl_tco_vld Vsx_mdl_tco_vld_2 Vxx_mdl_tco /end OUT_MEASUREMENT
/end FUNCTION
/begin FUNCTION InCliCoi_Tcomcsr ""
 /begin DEF_CHARACTERISTIC Cxx_dfdec_sens_tco_sig_mcut Cxx_dfinc_sens_tco_sig_mcut Cxx_tco_sig_mcut_max_slop /end DEF_CHARACTERISTIC
 /begin OUT_MEASUREMENT Vbx_df_sens_tco_sig_mcut /end OUT_MEASUREMENT
/end FUNCTION
/begin FUNCTION InCliLui "" /begin OUT_MEASUREMENT Vxx_pft_oil_csm /end OUT_MEASUREMENT
 /begin SUB_FUNCTION InCliLui_Toilxcs InCliLui_Toilxmd InCliLui_Toilubc InCliLui_Owpdlrx InCliLui_Owrstcs InCliLui_Schxxxx /end SUB_FUNCTION
/end FUNCTION
/begin FUNCTION InCliLui_Toilxcs "" /begin DEF_CHARACTERISTIC Ctb_toil Cxx_mdl_toil_fail /end DEF_CHARACTERISTIC /begin OUT_MEASUREMENT Vsx_toil_vld Vxx_toil /end OUT_MEASUREMENT /end FUNCTION
/begin FUNCTION InCliLui_Toilxmd ""
 /begin DEF_CHARACTERISTIC Ctb_n4 Ctb_tco_dif Ctb_tqi_rat Cmp_n_toil Ctp_tco_toil_ofs Ctp_toil_fil Cxx_stop_toil_fil Cxx_tco_toil_fil Cxx_tco_toil_thd Cxx_toil_pws_max_dly Cxx_toil_tco_cnt Cxx_tqi_rat_cut_thd /end DEF_CHARACTERISTIC
 /begin OUT_MEASUREMENT Vbx_toil_pws Vsx_mdl_toil_vld Vxx_mdl_toil Vxx_stab_toil Vxx_tco_dif Vxx_tco_fil Vxx_toil_pws_max_dly /end OUT_MEASUREMENT
/end FUNCTION
/begin FUNCTION InCliLui_Toilubc "" /begin OUT_MEASUREMENT Vsx_sens_toil_vld Vxx_sens_toil /end OUT_MEASUREMENT /end FUNCTION
/begin FUNCTION InCliLui_Owpdlrx "" /begin DEF_CHARACTERISTIC Cxx_owe_ctr4 Cxx_owe_ctr5 Cxx_owe_n Cxx_owe_pdl_thd /end DEF_CHARACTERISTIC
 /begin OUT_MEASUREMENT Sxx_owe_st3 Sxx_owe_st4 Vbx_brk Vbx_owe_igk_on_igk_off Vbx_owe_mnl_ini_req Vxx_owe_ctr4 Vxx_owe_ctr5 /end OUT_MEASUREMENT
/end FUNCTION
/begin FUNCTION InCliLui_Owrstcs "" /begin DEF_CHARACTERISTIC Cbx_owe_mnl_ini_req_ena /end DEF_CHARACTERISTIC /begin OUT_MEASUREMENT Vbx_owe_ini_req_ok Vbx_owe_mnl_ini_req_ok /end OUT_MEASUREMENT /end FUNCTION
/begin FUNCTION InCliLui_Schxxxx "" /begin DEF_CHARACTERISTIC Cbx_owe_cfm /end DEF_CHARACTERISTIC /begin OUT_MEASUREMENT Vbx_owe_cfm /end OUT_MEASUREMENT /end FUNCTION
/begin FUNCTION InAsiIap "" /begin OUT_MEASUREMENT Vxx_amp Vxx_map_spg_dif /end OUT_MEASUREMENT
 /begin SUB_FUNCTION InAsiIap_Spgxxsr InAsiIap_Ppredxx InAsiIap_Spgxxcs InAsiIap_Mapxxsr InAsiIap_Mapxxcs InAsiIap_Atmoxxx InAsiIap_Mapxxmd /end SUB_FUNCTION
/end FUNCTION
/begin FUNCTION InAsiIap_Spgxxsr ""
 /begin DEF_CHARACTERISTIC Cxx_dfdec_sens_spg_h Cxx_dfdec_sens_spg_l Cxx_dfinc_sens_spg_h Cxx_dfinc_sens_spg_l /end DEF_CHARACTERISTIC
 /begin OUT_MEASUREMENT Vsx_sens_spg_vld Vxx_sens_spg /end OUT_MEASUREMENT
/end FUNCTION
/begin FUNCTION InAsiIap_Ppredxx ""
 /begin DEF_CHARACTERISTIC Cxx_pred_map_dif_dz Cxx_pred_map_dif_max_fac Cxx_pred_map_dif_neg_fac Cxx_pred_map_dif_pos_fac Cxx_t_pred_dly_ref Cxx_tdc_nr_pred_dly_ref Cxx_vvtc_angl_tdc_fac /end DEF_CHARACTERISTIC
 /begin OUT_MEASUREMENT Vxx_lim_pred_map Vxx_lim_pred_map_dif Vxx_pred_map Vxx_pred_map_dif /end OUT_MEASUREMENT
/end FUNCTION
/end MODULE
/end PROJECT
