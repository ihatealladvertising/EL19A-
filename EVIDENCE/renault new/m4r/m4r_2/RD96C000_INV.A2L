ASAP2_VERSION 1 41
/begin PROJECT RD8 "_default_ProjectLongIdentifier"
/begin HEADER "_default_HeaderComment" PROJECT_NO RD9 /end HEADER
/begin MODULE _default_ModuleName "_default_ModuleLongIdentifier"
/begin MOD_COMMON "_default_ModCommonComment" DEPOSIT ABSOLUTE BYTE_ORDER MSB_LAST ALIGNMENT_BYTE 1 ALIGNMENT_WORD 2 ALIGNMENT_LONG 2 ALIGNMENT_FLOAT32_IEEE 2 ALIGNMENT_FLOAT64_IEEE 4 /end MOD_COMMON
/begin CHARACTERISTIC Cbx_obd_mena_inj1_scw "" VALUE 0xa002f150 _REC_S1VAL_20_u1 255. _CNV_A_R_A_165_CM 0. 255. DISPLAY_IDENTIFIER fm_cal_inj1_scw.fm_static_bitfield.Cbx_obd_mena_xxx BIT_MASK 0x8 /end CHARACTERISTIC
/begin CHARACTERISTIC Cxx_dtc_lb_inj1_scw "" VALUE 0xa002f151 _REC_S1VAL_20_u1 255. _CNV_A_R_A_165_CM 0. 255. DISPLAY_IDENTIFIER fm_cal_inj1_scw.Cxx_dtc_lb_xxx /end CHARACTERISTIC
/begin CHARACTERISTIC Cxx_obd_dc_inj1_scw "" VALUE 0xa002f152 _REC_S1VAL_20_u1 9. _CNV_A_R_A_165_CM 1. 10. DISPLAY_IDENTIFIER fm_cal_inj1_scw.Cxx_obd_dc_xxx /end CHARACTERISTIC
/begin CHARACTERISTIC Cxx_dtc_obd_inj2_oc "" VALUE 0xa002f15a _REC_S1VAL_20_u2 65535. _CNV_A_R_A_165_CM 0. 65535. DISPLAY_IDENTIFIER fm_cal_inj2_oc.Cxx_dtc_obd_xxx /end CHARACTERISTIC
/begin CHARACTERISTIC Cxx_conf_wal_inj2_oc "" VALUE 0xa002f15c _REC_S1VAL_20_u1 3. _CNV_A_R_A_165_CM 0. 3. DISPLAY_IDENTIFIER fm_cal_inj2_oc.fm_static_bitfield.Cxx_conf_wal_xxx BIT_MASK 0x3 /end CHARACTERISTIC
/begin CHARACTERISTIC Cbx_obd_inj2_oc "" VALUE 0xa002f15c _REC_S1VAL_20_u1 255. _CNV_A_R_A_165_CM 0. 255. DISPLAY_IDENTIFIER fm_cal_inj2_oc.fm_static_bitfield.Cbx_obd_xxx BIT_MASK 0x4 /end CHARACTERISTIC
/begin CHARACTERISTIC Cbx_obd_mena_inj2_oc "" VALUE 0xa002f15c _REC_S1VAL_20_u1 255. _CNV_A_R_A_165_CM 0. 255. DISPLAY_IDENTIFIER fm_cal_inj2_oc.fm_static_bitfield.Cbx_obd_mena_xxx BIT_MASK 0x8 /end CHARACTERISTIC
/begin CHARACTERISTIC Cxx_dtc_lb_inj2_oc "" VALUE 0xa002f15d _REC_S1VAL_20_u1 255. _CNV_A_R_A_165_CM 0. 255. DISPLAY_IDENTIFIER fm_cal_inj2_oc.Cxx_dtc_lb_xxx /end CHARACTERISTIC
/begin CHARACTERISTIC Cxx_obd_dc_inj2_oc "" VALUE 0xa002f15e _REC_S1VAL_20_u1 9. _CNV_A_R_A_165_CM 1. 10. DISPLAY_IDENTIFIER fm_cal_inj2_oc.Cxx_obd_dc_xxx /end CHARACTERISTIC
/begin CHARACTERISTIC Cxx_dtc_obd_inj2_scg "" VALUE 0xa002f166 _REC_S1VAL_20_u2 65535. _CNV_A_R_A_165_CM 0. 65535. DISPLAY_IDENTIFIER fm_cal_inj2_scg.Cxx_dtc_obd_xxx /end CHARACTERISTIC
/begin CHARACTERISTIC Cxx_conf_wal_inj2_scg "" VALUE 0xa002f168 _REC_S1VAL_20_u1 3. _CNV_A_R_A_165_CM 0. 3. DISPLAY_IDENTIFIER fm_cal_inj2_scg.fm_static_bitfield.Cxx_conf_wal_xxx BIT_MASK 0x3 /end CHARACTERISTIC
/begin CHARACTERISTIC Cbx_obd_inj2_scg "" VALUE 0xa002f168 _REC_S1VAL_20_u1 255. _CNV_A_R_A_165_CM 0. 255. DISPLAY_IDENTIFIER fm_cal_inj2_scg.fm_static_bitfield.Cbx_obd_xxx BIT_MASK 0x4 /end CHARACTERISTIC
/begin CHARACTERISTIC Cbx_obd_mena_inj2_scg "" VALUE 0xa002f168 _REC_S1VAL_20_u1 255. _CNV_A_R_A_165_CM 0. 255. DISPLAY_IDENTIFIER fm_cal_inj2_scg.fm_static_bitfield.Cbx_obd_mena_xxx BIT_MASK 0x8 /end CHARACTERISTIC
/begin CHARACTERISTIC Cxx_dtc_lb_inj2_scg "" VALUE 0xa002f169 _REC_S1VAL_20_u1 255. _CNV_A_R_A_165_CM 0. 255. DISPLAY_IDENTIFIER fm_cal_inj2_scg.Cxx_dtc_lb_xxx /end CHARACTERISTIC
/begin CHARACTERISTIC Cxx_obd_dc_inj2_scg "" VALUE 0xa002f16a _REC_S1VAL_20_u1 9. _CNV_A_R_A_165_CM 1. 10. DISPLAY_IDENTIFIER fm_cal_inj2_scg.Cxx_obd_dc_xxx /end CHARACTERISTIC
/begin CHARACTERISTIC Cxx_dtc_obd_inj2_scw "" VALUE 0xa002f172 _REC_S1VAL_20_u2 65535. _CNV_A_R_A_165_CM 0. 65535. DISPLAY_IDENTIFIER fm_cal_inj2_scw.Cxx_dtc_obd_xxx /end CHARACTERISTIC
/begin CHARACTERISTIC Cxx_conf_wal_inj2_scw "" VALUE 0xa002f174 _REC_S1VAL_20_u1 3. _CNV_A_R_A_165_CM 0. 3. DISPLAY_IDENTIFIER fm_cal_inj2_scw.fm_static_bitfield.Cxx_conf_wal_xxx BIT_MASK 0x3 /end CHARACTERISTIC
/begin CHARACTERISTIC Cbx_obd_inj2_scw "" VALUE 0xa002f174 _REC_S1VAL_20_u1 255. _CNV_A_R_A_165_CM 0. 255. DISPLAY_IDENTIFIER fm_cal_inj2_scw.fm_static_bitfield.Cbx_obd_xxx BIT_MASK 0x4 /end CHARACTERISTIC
/begin CHARACTERISTIC Cbx_obd_mena_inj2_scw "" VALUE 0xa002f174 _REC_S1VAL_20_u1 255. _CNV_A_R_A_165_CM 0. 255. DISPLAY_IDENTIFIER fm_cal_inj2_scw.fm_static_bitfield.Cbx_obd_mena_xxx BIT_MASK 0x8 /end CHARACTERISTIC
/begin CHARACTERISTIC Cxx_dtc_lb_inj2_scw "" VALUE 0xa002f175 _REC_S1VAL_20_u1 255. _CNV_A_R_A_165_CM 0. 255. DISPLAY_IDENTIFIER fm_cal_inj2_scw.Cxx_dtc_lb_xxx /end CHARACTERISTIC
/begin CHARACTERISTIC Cxx_obd_dc_inj2_scw "" VALUE 0xa002f176 _REC_S1VAL_20_u1 9. _CNV_A_R_A_165_CM 1. 10. DISPLAY_IDENTIFIER fm_cal_inj2_scw.Cxx_obd_dc_xxx /end CHARACTERISTIC
/begin CHARACTERISTIC Cxx_dtc_obd_inj3_oc "" VALUE 0xa002f17e _REC_S1VAL_20_u2 65535. _CNV_A_R_A_165_CM 0. 65535. DISPLAY_IDENTIFIER fm_cal_inj3_oc.Cxx_dtc_obd_xxx /end CHARACTERISTIC
/begin CHARACTERISTIC Cxx_conf_wal_inj3_oc "" VALUE 0xa002f180 _REC_S1VAL_20_u1 3. _CNV_A_R_A_165_CM 0. 3. DISPLAY_IDENTIFIER fm_cal_inj3_oc.fm_static_bitfield.Cxx_conf_wal_xxx BIT_MASK 0x3 /end CHARACTERISTIC
/begin CHARACTERISTIC Cbx_obd_inj3_oc "" VALUE 0xa002f180 _REC_S1VAL_20_u1 255. _CNV_A_R_A_165_CM 0. 255. DISPLAY_IDENTIFIER fm_cal_inj3_oc.fm_static_bitfield.Cbx_obd_xxx BIT_MASK 0x4 /end CHARACTERISTIC
/begin CHARACTERISTIC Cbx_obd_mena_inj3_oc "" VALUE 0xa002f180 _REC_S1VAL_20_u1 255. _CNV_A_R_A_165_CM 0. 255. DISPLAY_IDENTIFIER fm_cal_inj3_oc.fm_static_bitfield.Cbx_obd_mena_xxx BIT_MASK 0x8 /end CHARACTERISTIC
/begin CHARACTERISTIC Cxx_dtc_lb_inj3_oc "" VALUE 0xa002f181 _REC_S1VAL_20_u1 255. _CNV_A_R_A_165_CM 0. 255. DISPLAY_IDENTIFIER fm_cal_inj3_oc.Cxx_dtc_lb_xxx /end CHARACTERISTIC
/begin CHARACTERISTIC Cxx_obd_dc_inj3_oc "" VALUE 0xa002f182 _REC_S1VAL_20_u1 9. _CNV_A_R_A_165_CM 1. 10. DISPLAY_IDENTIFIER fm_cal_inj3_oc.Cxx_obd_dc_xxx /end CHARACTERISTIC
/begin CHARACTERISTIC Cxx_dtc_obd_inj3_scg "" VALUE 0xa002f18a _REC_S1VAL_20_u2 65535. _CNV_A_R_A_165_CM 0. 65535. DISPLAY_IDENTIFIER fm_cal_inj3_scg.Cxx_dtc_obd_xxx /end CHARACTERISTIC
/begin CHARACTERISTIC Cxx_conf_wal_inj3_scg "" VALUE 0xa002f18c _REC_S1VAL_20_u1 3. _CNV_A_R_A_165_CM 0. 3. DISPLAY_IDENTIFIER fm_cal_inj3_scg.fm_static_bitfield.Cxx_conf_wal_xxx BIT_MASK 0x3 /end CHARACTERISTIC
/begin CHARACTERISTIC Cbx_obd_inj3_scg "" VALUE 0xa002f18c _REC_S1VAL_20_u1 255. _CNV_A_R_A_165_CM 0. 255. DISPLAY_IDENTIFIER fm_cal_inj3_scg.fm_static_bitfield.Cbx_obd_xxx BIT_MASK 0x4 /end CHARACTERISTIC
/begin CHARACTERISTIC Cbx_obd_mena_inj3_scg "" VALUE 0xa002f18c _REC_S1VAL_20_u1 255. _CNV_A_R_A_165_CM 0. 255. DISPLAY_IDENTIFIER fm_cal_inj3_scg.fm_static_bitfield.Cbx_obd_mena_xxx BIT_MASK 0x8 /end CHARACTERISTIC
/begin CHARACTERISTIC Cxx_dtc_lb_inj3_scg "" VALUE 0xa002f18d _REC_S1VAL_20_u1 255. _CNV_A_R_A_165_CM 0. 255. DISPLAY_IDENTIFIER fm_cal_inj3_scg.Cxx_dtc_lb_xxx /end CHARACTERISTIC
/begin CHARACTERISTIC Cxx_obd_dc_inj3_scg "" VALUE 0xa002f18e _REC_S1VAL_20_u1 9. _CNV_A_R_A_165_CM 1. 10. DISPLAY_IDENTIFIER fm_cal_inj3_scg.Cxx_obd_dc_xxx /end CHARACTERISTIC
/begin CHARACTERISTIC Cxx_dtc_obd_inj3_scw "" VALUE 0xa002f196 _REC_S1VAL_20_u2 65535. _CNV_A_R_A_165_CM 0. 65535. DISPLAY_IDENTIFIER fm_cal_inj3_scw.Cxx_dtc_obd_xxx /end CHARACTERISTIC
/begin CHARACTERISTIC Cxx_conf_wal_inj3_scw "" VALUE 0xa002f198 _REC_S1VAL_20_u1 3. _CNV_A_R_A_165_CM 0. 3. DISPLAY_IDENTIFIER fm_cal_inj3_scw.fm_static_bitfield.Cxx_conf_wal_xxx BIT_MASK 0x3 /end CHARACTERISTIC
/begin CHARACTERISTIC Cbx_obd_inj3_scw "" VALUE 0xa002f198 _REC_S1VAL_20_u1 255. _CNV_A_R_A_165_CM 0. 255. DISPLAY_IDENTIFIER fm_cal_inj3_scw.fm_static_bitfield.Cbx_obd_xxx BIT_MASK 0x4 /end CHARACTERISTIC
/begin CHARACTERISTIC Cbx_obd_mena_inj3_scw "" VALUE 0xa002f198 _REC_S1VAL_20_u1 255. _CNV_A_R_A_165_CM 0. 255. DISPLAY_IDENTIFIER fm_cal_inj3_scw.fm_static_bitfield.Cbx_obd_mena_xxx BIT_MASK 0x8 /end CHARACTERISTIC
/begin CHARACTERISTIC Cxx_dtc_lb_inj3_scw "" VALUE 0xa002f199 _REC_S1VAL_20_u1 255. _CNV_A_R_A_165_CM 0. 255. DISPLAY_IDENTIFIER fm_cal_inj3_scw.Cxx_dtc_lb_xxx /end CHARACTERISTIC
/begin CHARACTERISTIC Cxx_obd_dc_inj3_scw "" VALUE 0xa002f19a _REC_S1VAL_20_u1 9. _CNV_A_R_A_165_CM 1. 10. DISPLAY_IDENTIFIER fm_cal_inj3_scw.Cxx_obd_dc_xxx /end CHARACTERISTIC
/begin CHARACTERISTIC Cxx_dtc_obd_inj4_oc "" VALUE 0xa002f1a2 _REC_S1VAL_20_u2 65535. _CNV_A_R_A_165_CM 0. 65535. DISPLAY_IDENTIFIER fm_cal_inj4_oc.Cxx_dtc_obd_xxx /end CHARACTERISTIC
/begin CHARACTERISTIC Cxx_conf_wal_inj4_oc "" VALUE 0xa002f1a4 _REC_S1VAL_20_u1 3. _CNV_A_R_A_165_CM 0. 3. DISPLAY_IDENTIFIER fm_cal_inj4_oc.fm_static_bitfield.Cxx_conf_wal_xxx BIT_MASK 0x3 /end CHARACTERISTIC
/begin CHARACTERISTIC Cbx_obd_inj4_oc "" VALUE 0xa002f1a4 _REC_S1VAL_20_u1 255. _CNV_A_R_A_165_CM 0. 255. DISPLAY_IDENTIFIER fm_cal_inj4_oc.fm_static_bitfield.Cbx_obd_xxx BIT_MASK 0x4 /end CHARACTERISTIC
/begin CHARACTERISTIC Cbx_obd_mena_inj4_oc "" VALUE 0xa002f1a4 _REC_S1VAL_20_u1 255. _CNV_A_R_A_165_CM 0. 255. DISPLAY_IDENTIFIER fm_cal_inj4_oc.fm_static_bitfield.Cbx_obd_mena_xxx BIT_MASK 0x8 /end CHARACTERISTIC
/begin CHARACTERISTIC Cxx_dtc_lb_inj4_oc "" VALUE 0xa002f1a5 _REC_S1VAL_20_u1 255. _CNV_A_R_A_165_CM 0. 255. DISPLAY_IDENTIFIER fm_cal_inj4_oc.Cxx_dtc_lb_xxx /end CHARACTERISTIC
/begin CHARACTERISTIC Cxx_obd_dc_inj4_oc "" VALUE 0xa002f1a6 _REC_S1VAL_20_u1 9. _CNV_A_R_A_165_CM 1. 10. DISPLAY_IDENTIFIER fm_cal_inj4_oc.Cxx_obd_dc_xxx /end CHARACTERISTIC
/begin CHARACTERISTIC Cxx_dtc_obd_inj4_scg "" VALUE 0xa002f1ae _REC_S1VAL_20_u2 65535. _CNV_A_R_A_165_CM 0. 65535. DISPLAY_IDENTIFIER fm_cal_inj4_scg.Cxx_dtc_obd_xxx /end CHARACTERISTIC
/begin CHARACTERISTIC Cxx_conf_wal_inj4_scg "" VALUE 0xa002f1b0 _REC_S1VAL_20_u1 3. _CNV_A_R_A_165_CM 0. 3. DISPLAY_IDENTIFIER fm_cal_inj4_scg.fm_static_bitfield.Cxx_conf_wal_xxx BIT_MASK 0x3 /end CHARACTERISTIC
/begin CHARACTERISTIC Cbx_obd_inj4_scg "" VALUE 0xa002f1b0 _REC_S1VAL_20_u1 255. _CNV_A_R_A_165_CM 0. 255. DISPLAY_IDENTIFIER fm_cal_inj4_scg.fm_static_bitfield.Cbx_obd_xxx BIT_MASK 0x4 /end CHARACTERISTIC
/begin CHARACTERISTIC Cbx_obd_mena_inj4_scg "" VALUE 0xa002f1b0 _REC_S1VAL_20_u1 255. _CNV_A_R_A_165_CM 0. 255. DISPLAY_IDENTIFIER fm_cal_inj4_scg.fm_static_bitfield.Cbx_obd_mena_xxx BIT_MASK 0x8 /end CHARACTERISTIC
/begin CHARACTERISTIC Cxx_dtc_lb_inj4_scg "" VALUE 0xa002f1b1 _REC_S1VAL_20_u1 255. _CNV_A_R_A_165_CM 0. 255. DISPLAY_IDENTIFIER fm_cal_inj4_scg.Cxx_dtc_lb_xxx /end CHARACTERISTIC
/begin CHARACTERISTIC Cxx_obd_dc_inj4_scg "" VALUE 0xa002f1b2 _REC_S1VAL_20_u1 9. _CNV_A_R_A_165_CM 1. 10. DISPLAY_IDENTIFIER fm_cal_inj4_scg.Cxx_obd_dc_xxx /end CHARACTERISTIC
/begin CHARACTERISTIC Cxx_dtc_obd_inj4_scw "" VALUE 0xa002f1ba _REC_S1VAL_20_u2 65535. _CNV_A_R_A_165_CM 0. 65535. DISPLAY_IDENTIFIER fm_cal_inj4_scw.Cxx_dtc_obd_xxx /end CHARACTERISTIC
/begin CHARACTERISTIC Cxx_conf_wal_inj4_scw "" VALUE 0xa002f1bc _REC_S1VAL_20_u1 3. _CNV_A_R_A_165_CM 0. 3. DISPLAY_IDENTIFIER fm_cal_inj4_scw.fm_static_bitfield.Cxx_conf_wal_xxx BIT_MASK 0x3 /end CHARACTERISTIC
/begin CHARACTERISTIC Cbx_obd_inj4_scw "" VALUE 0xa002f1bc _REC_S1VAL_20_u1 255. _CNV_A_R_A_165_CM 0. 255. DISPLAY_IDENTIFIER fm_cal_inj4_scw.fm_static_bitfield.Cbx_obd_xxx BIT_MASK 0x4 /end CHARACTERISTIC
/begin CHARACTERISTIC Cbx_obd_mena_inj4_scw "" VALUE 0xa002f1bc _REC_S1VAL_20_u1 255. _CNV_A_R_A_165_CM 0. 255. DISPLAY_IDENTIFIER fm_cal_inj4_scw.fm_static_bitfield.Cbx_obd_mena_xxx BIT_MASK 0x8 /end CHARACTERISTIC
/begin CHARACTERISTIC Cxx_dtc_lb_inj4_scw "" VALUE 0xa002f1bd _REC_S1VAL_20_u1 255. _CNV_A_R_A_165_CM 0. 255. DISPLAY_IDENTIFIER fm_cal_inj4_scw.Cxx_dtc_lb_xxx /end CHARACTERISTIC
/begin CHARACTERISTIC Cxx_obd_dc_inj4_scw "" VALUE 0xa002f1be _REC_S1VAL_20_u1 9. _CNV_A_R_A_165_CM 1. 10. DISPLAY_IDENTIFIER fm_cal_inj4_scw.Cxx_obd_dc_xxx /end CHARACTERISTIC
/begin CHARACTERISTIC Cxx_dtc_obd_inj_ecu_itl "" VALUE 0xa002f6d6 _REC_S1VAL_20_u2 65535. _CNV_A_R_A_165_CM 0. 65535. DISPLAY_IDENTIFIER fm_cal_inj_ecu_itl.Cxx_dtc_obd_xxx /end CHARACTERISTIC
/begin CHARACTERISTIC Cxx_conf_wal_inj_ecu_itl "" VALUE 0xa002f6d8 _REC_S1VAL_20_u1 3. _CNV_A_R_A_165_CM 0. 3. DISPLAY_IDENTIFIER fm_cal_inj_ecu_itl.fm_static_bitfield.Cxx_conf_wal_xxx BIT_MASK 0x3 /end CHARACTERISTIC
/begin CHARACTERISTIC Cbx_obd_inj_ecu_itl "" VALUE 0xa002f6d8 _REC_S1VAL_20_u1 255. _CNV_A_R_A_165_CM 0. 255. DISPLAY_IDENTIFIER fm_cal_inj_ecu_itl.fm_static_bitfield.Cbx_obd_xxx BIT_MASK 0x4 /end CHARACTERISTIC
/begin CHARACTERISTIC Cbx_obd_mena_inj_ecu_itl "" VALUE 0xa002f6d8 _REC_S1VAL_20_u1 255. _CNV_A_R_A_165_CM 0. 255. DISPLAY_IDENTIFIER fm_cal_inj_ecu_itl.fm_static_bitfield.Cbx_obd_mena_xxx BIT_MASK 0x8 /end CHARACTERISTIC
/begin CHARACTERISTIC Cxx_dtc_lb_inj_ecu_itl "" VALUE 0xa002f6d9 _REC_S1VAL_20_u1 255. _CNV_A_R_A_165_CM 0. 255. DISPLAY_IDENTIFIER fm_cal_inj_ecu_itl.Cxx_dtc_lb_xxx /end CHARACTERISTIC
/begin CHARACTERISTIC Cxx_obd_dc_inj_ecu_itl "" VALUE 0xa002f6da _REC_S1VAL_20_u1 9. _CNV_A_R_A_165_CM 1. 10. DISPLAY_IDENTIFIER fm_cal_inj_ecu_itl.Cxx_obd_dc_xxx /end CHARACTERISTIC
/begin CHARACTERISTIC Cxx_dtc_obd_inj_ecu_lbdw_icp "" VALUE 0xa002f11e _REC_S1VAL_20_u2 65535. _CNV_A_R_A_165_CM 0. 65535. DISPLAY_IDENTIFIER fm_cal_inj_ecu_lbdw_icp.Cxx_dtc_obd_xxx /end CHARACTERISTIC
/begin CHARACTERISTIC Cxx_conf_wal_inj_ecu_lbdw_icp "" VALUE 0xa002f120 _REC_S1VAL_20_u1 3. _CNV_A_R_A_165_CM 0. 3. DISPLAY_IDENTIFIER fm_cal_inj_ecu_lbdw_icp.fm_static_bitfield.Cxx_conf_wal_xxx BIT_MASK 0x3 /end CHARACTERISTIC
/begin CHARACTERISTIC Cbx_obd_inj_ecu_lbdw_icp "" VALUE 0xa002f120 _REC_S1VAL_20_u1 255. _CNV_A_R_A_165_CM 0. 255. DISPLAY_IDENTIFIER fm_cal_inj_ecu_lbdw_icp.fm_static_bitfield.Cbx_obd_xxx BIT_MASK 0x4 /end CHARACTERISTIC
/begin CHARACTERISTIC Cbx_obd_mena_inj_ecu_lbdw_icp "" VALUE 0xa002f120 _REC_S1VAL_20_u1 255. _CNV_A_R_A_165_CM 0. 255. DISPLAY_IDENTIFIER fm_cal_inj_ecu_lbdw_icp.fm_static_bitfield.Cbx_obd_mena_xxx BIT_MASK 0x8 /end CHARACTERISTIC
/begin CHARACTERISTIC Cxx_dtc_lb_inj_ecu_lbdw_icp "" VALUE 0xa002f121 _REC_S1VAL_20_u1 255. _CNV_A_R_A_165_CM 0. 255. DISPLAY_IDENTIFIER fm_cal_inj_ecu_lbdw_icp.Cxx_dtc_lb_xxx /end CHARACTERISTIC
/begin CHARACTERISTIC Cxx_obd_dc_inj_ecu_lbdw_icp "" VALUE 0xa002f122 _REC_S1VAL_20_u1 9. _CNV_A_R_A_165_CM 1. 10. DISPLAY_IDENTIFIER fm_cal_inj_ecu_lbdw_icp.Cxx_obd_dc_xxx /end CHARACTERISTIC
/begin CHARACTERISTIC Cxx_dtc_obd_inj_ecu_lbup_icp "" VALUE 0xa002f12a _REC_S1VAL_20_u2 65535. _CNV_A_R_A_165_CM 0. 65535. DISPLAY_IDENTIFIER fm_cal_inj_ecu_lbup_icp.Cxx_dtc_obd_xxx /end CHARACTERISTIC
/begin CHARACTERISTIC Cxx_conf_wal_inj_ecu_lbup_icp "" VALUE 0xa002f12c _REC_S1VAL_20_u1 3. _CNV_A_R_A_165_CM 0. 3. DISPLAY_IDENTIFIER fm_cal_inj_ecu_lbup_icp.fm_static_bitfield.Cxx_conf_wal_xxx BIT_MASK 0x3 /end CHARACTERISTIC
/begin CHARACTERISTIC Cbx_obd_inj_ecu_lbup_icp "" VALUE 0xa002f12c _REC_S1VAL_20_u1 255. _CNV_A_R_A_165_CM 0. 255. DISPLAY_IDENTIFIER fm_cal_inj_ecu_lbup_icp.fm_static_bitfield.Cbx_obd_xxx BIT_MASK 0x4 /end CHARACTERISTIC
/begin CHARACTERISTIC Cbx_obd_mena_inj_ecu_lbup_icp "" VALUE 0xa002f12c _REC_S1VAL_20_u1 255. _CNV_A_R_A_165_CM 0. 255. DISPLAY_IDENTIFIER fm_cal_inj_ecu_lbup_icp.fm_static_bitfield.Cbx_obd_mena_xxx BIT_MASK 0x8 /end CHARACTERISTIC
/begin CHARACTERISTIC Cxx_dtc_lb_inj_ecu_lbup_icp "" VALUE 0xa002f12d _REC_S1VAL_20_u1 255. _CNV_A_R_A_165_CM 0. 255. DISPLAY_IDENTIFIER fm_cal_inj_ecu_lbup_icp.Cxx_dtc_lb_xxx /end CHARACTERISTIC
/begin CHARACTERISTIC Cxx_obd_dc_inj_ecu_lbup_icp "" VALUE 0xa002f12e _REC_S1VAL_20_u1 9. _CNV_A_R_A_165_CM 1. 10. DISPLAY_IDENTIFIER fm_cal_inj_ecu_lbup_icp.Cxx_obd_dc_xxx /end CHARACTERISTIC
/begin CHARACTERISTIC Cxx_conf_wal_ip_lght_tco_ovh "" VALUE 0xa002f6e4 _REC_S1VAL_20_u1 3. _CNV_A_R_A_165_CM 0. 3. DISPLAY_IDENTIFIER fm_cal_ip_lght_tco_ovh.fm_static_bitfield.Cxx_conf_wal_xxx BIT_MASK 0x3 /end CHARACTERISTIC
/begin CHARACTERISTIC Cxx_dtc_lb_ip_lght_tco_ovh "" VALUE 0xa002f6e5 _REC_S1VAL_20_u1 255. _CNV_A_R_A_165_CM 0. 255. DISPLAY_IDENTIFIER fm_cal_ip_lght_tco_ovh.Cxx_dtc_lb_xxx /end CHARACTERISTIC
/begin CHARACTERISTIC Cxx_dtc_obd_it_cmd_el "" VALUE 0xa002f1c6 _REC_S1VAL_20_u2 65535. _CNV_A_R_A_165_CM 0. 65535. DISPLAY_IDENTIFIER fm_cal_it_cmd_el.Cxx_dtc_obd_xxx /end CHARACTERISTIC
/begin CHARACTERISTIC Cxx_conf_wal_it_cmd_el "" VALUE 0xa002f1c8 _REC_S1VAL_20_u1 3. _CNV_A_R_A_165_CM 0. 3. DISPLAY_IDENTIFIER fm_cal_it_cmd_el.fm_static_bitfield.Cxx_conf_wal_xxx BIT_MASK 0x3 /end CHARACTERISTIC
/begin CHARACTERISTIC Cbx_obd_it_cmd_el "" VALUE 0xa002f1c8 _REC_S1VAL_20_u1 255. _CNV_A_R_A_165_CM 0. 255. DISPLAY_IDENTIFIER fm_cal_it_cmd_el.fm_static_bitfield.Cbx_obd_xxx BIT_MASK 0x4 /end CHARACTERISTIC
/begin CHARACTERISTIC Cbx_obd_mena_it_cmd_el "" VALUE 0xa002f1c8 _REC_S1VAL_20_u1 255. _CNV_A_R_A_165_CM 0. 255. DISPLAY_IDENTIFIER fm_cal_it_cmd_el.fm_static_bitfield.Cbx_obd_mena_xxx BIT_MASK 0x8 /end CHARACTERISTIC
/begin CHARACTERISTIC Cxx_dtc_lb_it_cmd_el "" VALUE 0xa002f1c9 _REC_S1VAL_20_u1 255. _CNV_A_R_A_165_CM 0. 255. DISPLAY_IDENTIFIER fm_cal_it_cmd_el.Cxx_dtc_lb_xxx /end CHARACTERISTIC
/begin CHARACTERISTIC Cxx_obd_dc_it_cmd_el "" VALUE 0xa002f1ca _REC_S1VAL_20_u1 9. _CNV_A_R_A_165_CM 1. 10. DISPLAY_IDENTIFIER fm_cal_it_cmd_el.Cxx_obd_dc_xxx /end CHARACTERISTIC
/begin CHARACTERISTIC Cxx_dtc_obd_it_ofs_meca "" VALUE 0xa002f1d2 _REC_S1VAL_20_u2 65535. _CNV_A_R_A_165_CM 0. 65535. DISPLAY_IDENTIFIER fm_cal_it_ofs_meca.Cxx_dtc_obd_xxx /end CHARACTERISTIC
/begin CHARACTERISTIC Cxx_conf_wal_it_ofs_meca "" VALUE 0xa002f1d4 _REC_S1VAL_20_u1 3. _CNV_A_R_A_165_CM 0. 3. DISPLAY_IDENTIFIER fm_cal_it_ofs_meca.fm_static_bitfield.Cxx_conf_wal_xxx BIT_MASK 0x3 /end CHARACTERISTIC
/begin CHARACTERISTIC Cbx_obd_it_ofs_meca "" VALUE 0xa002f1d4 _REC_S1VAL_20_u1 255. _CNV_A_R_A_165_CM 0. 255. DISPLAY_IDENTIFIER fm_cal_it_ofs_meca.fm_static_bitfield.Cbx_obd_xxx BIT_MASK 0x4 /end CHARACTERISTIC
/begin CHARACTERISTIC Cbx_obd_mena_it_ofs_meca "" VALUE 0xa002f1d4 _REC_S1VAL_20_u1 255. _CNV_A_R_A_165_CM 0. 255. DISPLAY_IDENTIFIER fm_cal_it_ofs_meca.fm_static_bitfield.Cbx_obd_mena_xxx BIT_MASK 0x8 /end CHARACTERISTIC
/begin CHARACTERISTIC Cxx_dtc_lb_it_ofs_meca "" VALUE 0xa002f1d5 _REC_S1VAL_20_u1 255. _CNV_A_R_A_165_CM 0. 255. DISPLAY_IDENTIFIER fm_cal_it_ofs_meca.Cxx_dtc_lb_xxx /end CHARACTERISTIC
/begin CHARACTERISTIC Cxx_obd_dc_it_ofs_meca "" VALUE 0xa002f1d6 _REC_S1VAL_20_u1 9. _CNV_A_R_A_165_CM 1. 10. DISPLAY_IDENTIFIER fm_cal_it_ofs_meca.Cxx_obd_dc_xxx /end CHARACTERISTIC
/begin CHARACTERISTIC Cxx_dtc_obd_it_ofs_no_norm "" VALUE 0xa002f1de _REC_S1VAL_20_u2 65535. _CNV_A_R_A_165_CM 0. 65535. DISPLAY_IDENTIFIER fm_cal_it_ofs_no_norm.Cxx_dtc_obd_xxx /end CHARACTERISTIC
/begin CHARACTERISTIC Cxx_conf_wal_it_ofs_no_norm "" VALUE 0xa002f1e0 _REC_S1VAL_20_u1 3. _CNV_A_R_A_165_CM 0. 3. DISPLAY_IDENTIFIER fm_cal_it_ofs_no_norm.fm_static_bitfield.Cxx_conf_wal_xxx BIT_MASK 0x3 /end CHARACTERISTIC
/begin CHARACTERISTIC Cbx_obd_it_ofs_no_norm "" VALUE 0xa002f1e0 _REC_S1VAL_20_u1 255. _CNV_A_R_A_165_CM 0. 255. DISPLAY_IDENTIFIER fm_cal_it_ofs_no_norm.fm_static_bitfield.Cbx_obd_xxx BIT_MASK 0x4 /end CHARACTERISTIC
/begin CHARACTERISTIC Cbx_obd_mena_it_ofs_no_norm "" VALUE 0xa002f1e0 _REC_S1VAL_20_u1 255. _CNV_A_R_A_165_CM 0. 255. DISPLAY_IDENTIFIER fm_cal_it_ofs_no_norm.fm_static_bitfield.Cbx_obd_mena_xxx BIT_MASK 0x8 /end CHARACTERISTIC
/begin CHARACTERISTIC Cxx_dtc_lb_it_ofs_no_norm "" VALUE 0xa002f1e1 _REC_S1VAL_20_u1 255. _CNV_A_R_A_165_CM 0. 255. DISPLAY_IDENTIFIER fm_cal_it_ofs_no_norm.Cxx_dtc_lb_xxx /end CHARACTERISTIC
/begin CHARACTERISTIC Cxx_obd_dc_it_ofs_no_norm "" VALUE 0xa002f1e2 _REC_S1VAL_20_u1 9. _CNV_A_R_A_165_CM 1. 10. DISPLAY_IDENTIFIER fm_cal_it_ofs_no_norm.Cxx_obd_dc_xxx /end CHARACTERISTIC
/begin CHARACTERISTIC Cxx_dtc_obd_it_ofs_secu_nok "" VALUE 0xa002f1ea _REC_S1VAL_20_u2 65535. _CNV_A_R_A_165_CM 0. 65535. DISPLAY_IDENTIFIER fm_cal_it_ofs_secu_nok.Cxx_dtc_obd_xxx /end CHARACTERISTIC
/begin CHARACTERISTIC Cxx_conf_wal_it_ofs_secu_nok "" VALUE 0xa002f1ec _REC_S1VAL_20_u1 3. _CNV_A_R_A_165_CM 0. 3. DISPLAY_IDENTIFIER fm_cal_it_ofs_secu_nok.fm_static_bitfield.Cxx_conf_wal_xxx BIT_MASK 0x3 /end CHARACTERISTIC
/begin CHARACTERISTIC Cbx_obd_it_ofs_secu_nok "" VALUE 0xa002f1ec _REC_S1VAL_20_u1 255. _CNV_A_R_A_165_CM 0. 255. DISPLAY_IDENTIFIER fm_cal_it_ofs_secu_nok.fm_static_bitfield.Cbx_obd_xxx BIT_MASK 0x4 /end CHARACTERISTIC
/begin CHARACTERISTIC Cbx_obd_mena_it_ofs_secu_nok "" VALUE 0xa002f1ec _REC_S1VAL_20_u1 255. _CNV_A_R_A_165_CM 0. 255. DISPLAY_IDENTIFIER fm_cal_it_ofs_secu_nok.fm_static_bitfield.Cbx_obd_mena_xxx BIT_MASK 0x8 /end CHARACTERISTIC
/begin CHARACTERISTIC Cxx_dtc_lb_it_ofs_secu_nok "" VALUE 0xa002f1ed _REC_S1VAL_20_u1 255. _CNV_A_R_A_165_CM 0. 255. DISPLAY_IDENTIFIER fm_cal_it_ofs_secu_nok.Cxx_dtc_lb_xxx /end CHARACTERISTIC
/begin CHARACTERISTIC Cxx_obd_dc_it_ofs_secu_nok "" VALUE 0xa002f1ee _REC_S1VAL_20_u1 9. _CNV_A_R_A_165_CM 1. 10. DISPLAY_IDENTIFIER fm_cal_it_ofs_secu_nok.Cxx_obd_dc_xxx /end CHARACTERISTIC
/begin CHARACTERISTIC Cxx_dtc_obd_it_reg_blk "" VALUE 0xa002f1f6 _REC_S1VAL_20_u2 65535. _CNV_A_R_A_165_CM 0. 65535. DISPLAY_IDENTIFIER fm_cal_it_reg_blk.Cxx_dtc_obd_xxx /end CHARACTERISTIC
/begin CHARACTERISTIC Cxx_conf_wal_it_reg_blk "" VALUE 0xa002f1f8 _REC_S1VAL_20_u1 3. _CNV_A_R_A_165_CM 0. 3. DISPLAY_IDENTIFIER fm_cal_it_reg_blk.fm_static_bitfield.Cxx_conf_wal_xxx BIT_MASK 0x3 /end CHARACTERISTIC
/begin CHARACTERISTIC Cbx_obd_it_reg_blk "" VALUE 0xa002f1f8 _REC_S1VAL_20_u1 255. _CNV_A_R_A_165_CM 0. 255. DISPLAY_IDENTIFIER fm_cal_it_reg_blk.fm_static_bitfield.Cbx_obd_xxx BIT_MASK 0x4 /end CHARACTERISTIC
/begin CHARACTERISTIC Cbx_obd_mena_it_reg_blk "" VALUE 0xa002f1f8 _REC_S1VAL_20_u1 255. _CNV_A_R_A_165_CM 0. 255. DISPLAY_IDENTIFIER fm_cal_it_reg_blk.fm_static_bitfield.Cbx_obd_mena_xxx BIT_MASK 0x8 /end CHARACTERISTIC
/begin CHARACTERISTIC Cxx_dtc_lb_it_reg_blk "" VALUE 0xa002f1f9 _REC_S1VAL_20_u1 255. _CNV_A_R_A_165_CM 0. 255. DISPLAY_IDENTIFIER fm_cal_it_reg_blk.Cxx_dtc_lb_xxx /end CHARACTERISTIC
/begin CHARACTERISTIC Cxx_obd_dc_it_reg_blk "" VALUE 0xa002f1fa _REC_S1VAL_20_u1 9. _CNV_A_R_A_165_CM 1. 10. DISPLAY_IDENTIFIER fm_cal_it_reg_blk.Cxx_obd_dc_xxx /end CHARACTERISTIC
/begin CHARACTERISTIC Cxx_dtc_obd_knk_oor "" VALUE 0xa002f202 _REC_S1VAL_20_u2 65535. _CNV_A_R_A_165_CM 0. 65535. DISPLAY_IDENTIFIER fm_cal_knk_oor.Cxx_dtc_obd_xxx /end CHARACTERISTIC
/begin CHARACTERISTIC Cxx_conf_wal_knk_oor "" VALUE 0xa002f204 _REC_S1VAL_20_u1 3. _CNV_A_R_A_165_CM 0. 3. DISPLAY_IDENTIFIER fm_cal_knk_oor.fm_static_bitfield.Cxx_conf_wal_xxx BIT_MASK 0x3 /end CHARACTERISTIC
/begin CHARACTERISTIC Cbx_obd_knk_oor "" VALUE 0xa002f204 _REC_S1VAL_20_u1 255. _CNV_A_R_A_165_CM 0. 255. DISPLAY_IDENTIFIER fm_cal_knk_oor.fm_static_bitfield.Cbx_obd_xxx BIT_MASK 0x4 /end CHARACTERISTIC
/begin CHARACTERISTIC Cbx_obd_mena_knk_oor "" VALUE 0xa002f204 _REC_S1VAL_20_u1 255. _CNV_A_R_A_165_CM 0. 255. DISPLAY_IDENTIFIER fm_cal_knk_oor.fm_static_bitfield.Cbx_obd_mena_xxx BIT_MASK 0x8 /end CHARACTERISTIC
/begin CHARACTERISTIC Cxx_dtc_lb_knk_oor "" VALUE 0xa002f205 _REC_S1VAL_20_u1 255. _CNV_A_R_A_165_CM 0. 255. DISPLAY_IDENTIFIER fm_cal_knk_oor.Cxx_dtc_lb_xxx /end CHARACTERISTIC
/begin CHARACTERISTIC Cxx_obd_dc_knk_oor "" VALUE 0xa002f206 _REC_S1VAL_20_u1 9. _CNV_A_R_A_165_CM 1. 10. DISPLAY_IDENTIFIER fm_cal_knk_oor.Cxx_obd_dc_xxx /end CHARACTERISTIC
/begin CHARACTERISTIC Cxx_dtc_obd_knk_shp "" VALUE 0xa002f20e _REC_S1VAL_20_u2 65535. _CNV_A_R_A_165_CM 0. 65535. DISPLAY_IDENTIFIER fm_cal_knk_shp.Cxx_dtc_obd_xxx /end CHARACTERISTIC
/begin CHARACTERISTIC Cxx_conf_wal_knk_shp "" VALUE 0xa002f210 _REC_S1VAL_20_u1 3. _CNV_A_R_A_165_CM 0. 3. DISPLAY_IDENTIFIER fm_cal_knk_shp.fm_static_bitfield.Cxx_conf_wal_xxx BIT_MASK 0x3 /end CHARACTERISTIC
/begin CHARACTERISTIC Cbx_obd_knk_shp "" VALUE 0xa002f210 _REC_S1VAL_20_u1 255. _CNV_A_R_A_165_CM 0. 255. DISPLAY_IDENTIFIER fm_cal_knk_shp.fm_static_bitfield.Cbx_obd_xxx BIT_MASK 0x4 /end CHARACTERISTIC
/begin CHARACTERISTIC Cbx_obd_mena_knk_shp "" VALUE 0xa002f210 _REC_S1VAL_20_u1 255. _CNV_A_R_A_165_CM 0. 255. DISPLAY_IDENTIFIER fm_cal_knk_shp.fm_static_bitfield.Cbx_obd_mena_xxx BIT_MASK 0x8 /end CHARACTERISTIC
/begin CHARACTERISTIC Cxx_dtc_lb_knk_shp "" VALUE 0xa002f211 _REC_S1VAL_20_u1 255. _CNV_A_R_A_165_CM 0. 255. DISPLAY_IDENTIFIER fm_cal_knk_shp.Cxx_dtc_lb_xxx /end CHARACTERISTIC
/begin CHARACTERISTIC Cxx_obd_dc_knk_shp "" VALUE 0xa002f212 _REC_S1VAL_20_u1 9. _CNV_A_R_A_165_CM 1. 10. DISPLAY_IDENTIFIER fm_cal_knk_shp.Cxx_obd_dc_xxx /end CHARACTERISTIC
/begin CHARACTERISTIC Cxx_dtc_obd_lbdw_hot_oc "" VALUE 0xa002f436 _REC_S1VAL_20_u2 65535. _CNV_A_R_A_165_CM 0. 65535. DISPLAY_IDENTIFIER fm_cal_lbdw_hot_oc.Cxx_dtc_obd_xxx /end CHARACTERISTIC
/begin CHARACTERISTIC Cxx_conf_wal_lbdw_hot_oc "" VALUE 0xa002f438 _REC_S1VAL_20_u1 3. _CNV_A_R_A_165_CM 0. 3. DISPLAY_IDENTIFIER fm_cal_lbdw_hot_oc.fm_static_bitfield.Cxx_conf_wal_xxx BIT_MASK 0x3 /end CHARACTERISTIC
/begin CHARACTERISTIC Cbx_obd_lbdw_hot_oc "" VALUE 0xa002f438 _REC_S1VAL_20_u1 255. _CNV_A_R_A_165_CM 0. 255. DISPLAY_IDENTIFIER fm_cal_lbdw_hot_oc.fm_static_bitfield.Cbx_obd_xxx BIT_MASK 0x4 /end CHARACTERISTIC
/begin CHARACTERISTIC Cbx_obd_mena_lbdw_hot_oc "" VALUE 0xa002f438 _REC_S1VAL_20_u1 255. _CNV_A_R_A_165_CM 0. 255. DISPLAY_IDENTIFIER fm_cal_lbdw_hot_oc.fm_static_bitfield.Cbx_obd_mena_xxx BIT_MASK 0x8 /end CHARACTERISTIC
/begin CHARACTERISTIC Cxx_dtc_lb_lbdw_hot_oc "" VALUE 0xa002f439 _REC_S1VAL_20_u1 255. _CNV_A_R_A_165_CM 0. 255. DISPLAY_IDENTIFIER fm_cal_lbdw_hot_oc.Cxx_dtc_lb_xxx /end CHARACTERISTIC
/begin CHARACTERISTIC Cxx_obd_dc_lbdw_hot_oc "" VALUE 0xa002f43a _REC_S1VAL_20_u1 9. _CNV_A_R_A_165_CM 1. 10. DISPLAY_IDENTIFIER fm_cal_lbdw_hot_oc.Cxx_obd_dc_xxx /end CHARACTERISTIC
/begin CHARACTERISTIC Cxx_dtc_obd_lbdw_hot_scg "" VALUE 0xa002f442 _REC_S1VAL_20_u2 65535. _CNV_A_R_A_165_CM 0. 65535. DISPLAY_IDENTIFIER fm_cal_lbdw_hot_scg.Cxx_dtc_obd_xxx /end CHARACTERISTIC
/begin CHARACTERISTIC Cxx_conf_wal_lbdw_hot_scg "" VALUE 0xa002f444 _REC_S1VAL_20_u1 3. _CNV_A_R_A_165_CM 0. 3. DISPLAY_IDENTIFIER fm_cal_lbdw_hot_scg.fm_static_bitfield.Cxx_conf_wal_xxx BIT_MASK 0x3 /end CHARACTERISTIC
/begin CHARACTERISTIC Cbx_obd_lbdw_hot_scg "" VALUE 0xa002f444 _REC_S1VAL_20_u1 255. _CNV_A_R_A_165_CM 0. 255. DISPLAY_IDENTIFIER fm_cal_lbdw_hot_scg.fm_static_bitfield.Cbx_obd_xxx BIT_MASK 0x4 /end CHARACTERISTIC
/begin CHARACTERISTIC Cbx_obd_mena_lbdw_hot_scg "" VALUE 0xa002f444 _REC_S1VAL_20_u1 255. _CNV_A_R_A_165_CM 0. 255. DISPLAY_IDENTIFIER fm_cal_lbdw_hot_scg.fm_static_bitfield.Cbx_obd_mena_xxx BIT_MASK 0x8 /end CHARACTERISTIC
/begin CHARACTERISTIC Cxx_dtc_lb_lbdw_hot_scg "" VALUE 0xa002f445 _REC_S1VAL_20_u1 255. _CNV_A_R_A_165_CM 0. 255. DISPLAY_IDENTIFIER fm_cal_lbdw_hot_scg.Cxx_dtc_lb_xxx /end CHARACTERISTIC
/begin CHARACTERISTIC Cxx_obd_dc_lbdw_hot_scg "" VALUE 0xa002f446 _REC_S1VAL_20_u1 9. _CNV_A_R_A_165_CM 1. 10. DISPLAY_IDENTIFIER fm_cal_lbdw_hot_scg.Cxx_obd_dc_xxx /end CHARACTERISTIC
/begin CHARACTERISTIC Cxx_dtc_obd_lbdw_hot_scw "" VALUE 0xa002f44e _REC_S1VAL_20_u2 65535. _CNV_A_R_A_165_CM 0. 65535. DISPLAY_IDENTIFIER fm_cal_lbdw_hot_scw.Cxx_dtc_obd_xxx /end CHARACTERISTIC
/begin CHARACTERISTIC Cxx_conf_wal_lbdw_hot_scw "" VALUE 0xa002f450 _REC_S1VAL_20_u1 3. _CNV_A_R_A_165_CM 0. 3. DISPLAY_IDENTIFIER fm_cal_lbdw_hot_scw.fm_static_bitfield.Cxx_conf_wal_xxx BIT_MASK 0x3 /end CHARACTERISTIC
/begin CHARACTERISTIC Cbx_obd_lbdw_hot_scw "" VALUE 0xa002f450 _REC_S1VAL_20_u1 255. _CNV_A_R_A_165_CM 0. 255. DISPLAY_IDENTIFIER fm_cal_lbdw_hot_scw.fm_static_bitfield.Cbx_obd_xxx BIT_MASK 0x4 /end CHARACTERISTIC
/begin CHARACTERISTIC Cbx_obd_mena_lbdw_hot_scw "" VALUE 0xa002f450 _REC_S1VAL_20_u1 255. _CNV_A_R_A_165_CM 0. 255. DISPLAY_IDENTIFIER fm_cal_lbdw_hot_scw.fm_static_bitfield.Cbx_obd_mena_xxx BIT_MASK 0x8 /end CHARACTERISTIC
/begin CHARACTERISTIC Cxx_dtc_lb_lbdw_hot_scw "" VALUE 0xa002f451 _REC_S1VAL_20_u1 255. _CNV_A_R_A_165_CM 0. 255. DISPLAY_IDENTIFIER fm_cal_lbdw_hot_scw.Cxx_dtc_lb_xxx /end CHARACTERISTIC
/begin CHARACTERISTIC Cxx_obd_dc_lbdw_hot_scw "" VALUE 0xa002f452 _REC_S1VAL_20_u1 9. _CNV_A_R_A_165_CM 1. 10. DISPLAY_IDENTIFIER fm_cal_lbdw_hot_scw.Cxx_obd_dc_xxx /end CHARACTERISTIC
/begin CHARACTERISTIC Cxx_dtc_obd_lbdw_oc "" VALUE 0xa002f21a _REC_S1VAL_20_u2 65535. _CNV_A_R_A_165_CM 0. 65535. DISPLAY_IDENTIFIER fm_cal_lbdw_oc.Cxx_dtc_obd_xxx /end CHARACTERISTIC
/begin CHARACTERISTIC Cxx_conf_wal_lbdw_oc "" VALUE 0xa002f21c _REC_S1VAL_20_u1 3. _CNV_A_R_A_165_CM 0. 3. DISPLAY_IDENTIFIER fm_cal_lbdw_oc.fm_static_bitfield.Cxx_conf_wal_xxx BIT_MASK 0x3 /end CHARACTERISTIC
/begin CHARACTERISTIC Cbx_obd_lbdw_oc "" VALUE 0xa002f21c _REC_S1VAL_20_u1 255. _CNV_A_R_A_165_CM 0. 255. DISPLAY_IDENTIFIER fm_cal_lbdw_oc.fm_static_bitfield.Cbx_obd_xxx BIT_MASK 0x4 /end CHARACTERISTIC
/begin CHARACTERISTIC Cbx_obd_mena_lbdw_oc "" VALUE 0xa002f21c _REC_S1VAL_20_u1 255. _CNV_A_R_A_165_CM 0. 255. DISPLAY_IDENTIFIER fm_cal_lbdw_oc.fm_static_bitfield.Cbx_obd_mena_xxx BIT_MASK 0x8 /end CHARACTERISTIC
/begin CHARACTERISTIC Cxx_dtc_lb_lbdw_oc "" VALUE 0xa002f21d _REC_S1VAL_20_u1 255. _CNV_A_R_A_165_CM 0. 255. DISPLAY_IDENTIFIER fm_cal_lbdw_oc.Cxx_dtc_lb_xxx /end CHARACTERISTIC
/begin CHARACTERISTIC Cxx_obd_dc_lbdw_oc "" VALUE 0xa002f21e _REC_S1VAL_20_u1 9. _CNV_A_R_A_165_CM 1. 10. DISPLAY_IDENTIFIER fm_cal_lbdw_oc.Cxx_obd_dc_xxx /end CHARACTERISTIC
/begin CHARACTERISTIC Cxx_dtc_obd_lbdw_scg "" VALUE 0xa002f226 _REC_S1VAL_20_u2 65535. _CNV_A_R_A_165_CM 0. 65535. DISPLAY_IDENTIFIER fm_cal_lbdw_scg.Cxx_dtc_obd_xxx /end CHARACTERISTIC
/begin CHARACTERISTIC Cxx_conf_wal_lbdw_scg "" VALUE 0xa002f228 _REC_S1VAL_20_u1 3. _CNV_A_R_A_165_CM 0. 3. DISPLAY_IDENTIFIER fm_cal_lbdw_scg.fm_static_bitfield.Cxx_conf_wal_xxx BIT_MASK 0x3 /end CHARACTERISTIC
/begin CHARACTERISTIC Cbx_obd_lbdw_scg "" VALUE 0xa002f228 _REC_S1VAL_20_u1 255. _CNV_A_R_A_165_CM 0. 255. DISPLAY_IDENTIFIER fm_cal_lbdw_scg.fm_static_bitfield.Cbx_obd_xxx BIT_MASK 0x4 /end CHARACTERISTIC
/begin CHARACTERISTIC Cbx_obd_mena_lbdw_scg "" VALUE 0xa002f228 _REC_S1VAL_20_u1 255. _CNV_A_R_A_165_CM 0. 255. DISPLAY_IDENTIFIER fm_cal_lbdw_scg.fm_static_bitfield.Cbx_obd_mena_xxx BIT_MASK 0x8 /end CHARACTERISTIC
/begin CHARACTERISTIC Cxx_dtc_lb_lbdw_scg "" VALUE 0xa002f229 _REC_S1VAL_20_u1 255. _CNV_A_R_A_165_CM 0. 255. DISPLAY_IDENTIFIER fm_cal_lbdw_scg.Cxx_dtc_lb_xxx /end CHARACTERISTIC
/begin CHARACTERISTIC Cxx_obd_dc_lbdw_scg "" VALUE 0xa002f22a _REC_S1VAL_20_u1 9. _CNV_A_R_A_165_CM 1. 10. DISPLAY_IDENTIFIER fm_cal_lbdw_scg.Cxx_obd_dc_xxx /end CHARACTERISTIC
/begin CHARACTERISTIC Cxx_dtc_obd_lbdw_scw "" VALUE 0xa002f232 _REC_S1VAL_20_u2 65535. _CNV_A_R_A_165_CM 0. 65535. DISPLAY_IDENTIFIER fm_cal_lbdw_scw.Cxx_dtc_obd_xxx /end CHARACTERISTIC
/begin CHARACTERISTIC Cxx_conf_wal_lbdw_scw "" VALUE 0xa002f234 _REC_S1VAL_20_u1 3. _CNV_A_R_A_165_CM 0. 3. DISPLAY_IDENTIFIER fm_cal_lbdw_scw.fm_static_bitfield.Cxx_conf_wal_xxx BIT_MASK 0x3 /end CHARACTERISTIC
/begin CHARACTERISTIC Cbx_obd_lbdw_scw "" VALUE 0xa002f234 _REC_S1VAL_20_u1 255. _CNV_A_R_A_165_CM 0. 255. DISPLAY_IDENTIFIER fm_cal_lbdw_scw.fm_static_bitfield.Cbx_obd_xxx BIT_MASK 0x4 /end CHARACTERISTIC
/begin CHARACTERISTIC Cbx_obd_mena_lbdw_scw "" VALUE 0xa002f234 _REC_S1VAL_20_u1 255. _CNV_A_R_A_165_CM 0. 255. DISPLAY_IDENTIFIER fm_cal_lbdw_scw.fm_static_bitfield.Cbx_obd_mena_xxx BIT_MASK 0x8 /end CHARACTERISTIC
/begin CHARACTERISTIC Cxx_dtc_lb_lbdw_scw "" VALUE 0xa002f235 _REC_S1VAL_20_u1 255. _CNV_A_R_A_165_CM 0. 255. DISPLAY_IDENTIFIER fm_cal_lbdw_scw.Cxx_dtc_lb_xxx /end CHARACTERISTIC
/begin CHARACTERISTIC Cxx_obd_dc_lbdw_scw "" VALUE 0xa002f236 _REC_S1VAL_20_u1 9. _CNV_A_R_A_165_CM 1. 10. DISPLAY_IDENTIFIER fm_cal_lbdw_scw.Cxx_obd_dc_xxx /end CHARACTERISTIC
/begin CHARACTERISTIC Cxx_dtc_obd_lbup_cpt "" VALUE 0xa002f682 _REC_S1VAL_20_u2 65535. _CNV_A_R_A_165_CM 0. 65535. DISPLAY_IDENTIFIER fm_cal_lbup_cpt.Cxx_dtc_obd_xxx /end CHARACTERISTIC
/begin CHARACTERISTIC Cxx_conf_wal_lbup_cpt "" VALUE 0xa002f684 _REC_S1VAL_20_u1 3. _CNV_A_R_A_165_CM 0. 3. DISPLAY_IDENTIFIER fm_cal_lbup_cpt.fm_static_bitfield.Cxx_conf_wal_xxx BIT_MASK 0x3 /end CHARACTERISTIC
/begin CHARACTERISTIC Cbx_obd_lbup_cpt "" VALUE 0xa002f684 _REC_S1VAL_20_u1 255. _CNV_A_R_A_165_CM 0. 255. DISPLAY_IDENTIFIER fm_cal_lbup_cpt.fm_static_bitfield.Cbx_obd_xxx BIT_MASK 0x4 /end CHARACTERISTIC
/begin CHARACTERISTIC Cbx_obd_mena_lbup_cpt "" VALUE 0xa002f684 _REC_S1VAL_20_u1 255. _CNV_A_R_A_165_CM 0. 255. DISPLAY_IDENTIFIER fm_cal_lbup_cpt.fm_static_bitfield.Cbx_obd_mena_xxx BIT_MASK 0x8 /end CHARACTERISTIC
/begin CHARACTERISTIC Cxx_dtc_lb_lbup_cpt "" VALUE 0xa002f685 _REC_S1VAL_20_u1 255. _CNV_A_R_A_165_CM 0. 255. DISPLAY_IDENTIFIER fm_cal_lbup_cpt.Cxx_dtc_lb_xxx /end CHARACTERISTIC
/begin CHARACTERISTIC Cxx_obd_dc_lbup_cpt "" VALUE 0xa002f686 _REC_S1VAL_20_u1 9. _CNV_A_R_A_165_CM 1. 10. DISPLAY_IDENTIFIER fm_cal_lbup_cpt.Cxx_obd_dc_xxx /end CHARACTERISTIC
/begin CHARACTERISTIC Cxx_dtc_obd_lbup_hot_apl_down "" VALUE 0xa002f7d2 _REC_S1VAL_20_u2 65535. _CNV_A_R_A_165_CM 0. 65535. DISPLAY_IDENTIFIER fm_cal_lbup_hot_apl_down.Cxx_dtc_obd_xxx /end CHARACTERISTIC
/begin CHARACTERISTIC Cxx_conf_wal_lbup_hot_apl_down "" VALUE 0xa002f7d4 _REC_S1VAL_20_u1 3. _CNV_A_R_A_165_CM 0. 3. DISPLAY_IDENTIFIER fm_cal_lbup_hot_apl_down.fm_static_bitfield.Cxx_conf_wal_xxx BIT_MASK 0x3 /end CHARACTERISTIC
/begin CHARACTERISTIC Cbx_obd_lbup_hot_apl_down "" VALUE 0xa002f7d4 _REC_S1VAL_20_u1 255. _CNV_A_R_A_165_CM 0. 255. DISPLAY_IDENTIFIER fm_cal_lbup_hot_apl_down.fm_static_bitfield.Cbx_obd_xxx BIT_MASK 0x4 /end CHARACTERISTIC
/begin CHARACTERISTIC Cbx_obd_mena_lbup_hot_apl_down "" VALUE 0xa002f7d4 _REC_S1VAL_20_u1 255. _CNV_A_R_A_165_CM 0. 255. DISPLAY_IDENTIFIER fm_cal_lbup_hot_apl_down.fm_static_bitfield.Cbx_obd_mena_xxx BIT_MASK 0x8 /end CHARACTERISTIC
/begin CHARACTERISTIC Cxx_dtc_lb_lbup_hot_apl_down "" VALUE 0xa002f7d5 _REC_S1VAL_20_u1 255. _CNV_A_R_A_165_CM 0. 255. DISPLAY_IDENTIFIER fm_cal_lbup_hot_apl_down.Cxx_dtc_lb_xxx /end CHARACTERISTIC
/begin CHARACTERISTIC Cxx_obd_dc_lbup_hot_apl_down "" VALUE 0xa002f7d6 _REC_S1VAL_20_u1 9. _CNV_A_R_A_165_CM 1. 10. DISPLAY_IDENTIFIER fm_cal_lbup_hot_apl_down.Cxx_obd_dc_xxx /end CHARACTERISTIC
/begin CHARACTERISTIC Cxx_dtc_obd_lbup_hot_oc "" VALUE 0xa002f45a _REC_S1VAL_20_u2 65535. _CNV_A_R_A_165_CM 0. 65535. DISPLAY_IDENTIFIER fm_cal_lbup_hot_oc.Cxx_dtc_obd_xxx /end CHARACTERISTIC
/begin CHARACTERISTIC Cxx_conf_wal_lbup_hot_oc "" VALUE 0xa002f45c _REC_S1VAL_20_u1 3. _CNV_A_R_A_165_CM 0. 3. DISPLAY_IDENTIFIER fm_cal_lbup_hot_oc.fm_static_bitfield.Cxx_conf_wal_xxx BIT_MASK 0x3 /end CHARACTERISTIC
/begin CHARACTERISTIC Cbx_obd_lbup_hot_oc "" VALUE 0xa002f45c _REC_S1VAL_20_u1 255. _CNV_A_R_A_165_CM 0. 255. DISPLAY_IDENTIFIER fm_cal_lbup_hot_oc.fm_static_bitfield.Cbx_obd_xxx BIT_MASK 0x4 /end CHARACTERISTIC
/begin CHARACTERISTIC Cbx_obd_mena_lbup_hot_oc "" VALUE 0xa002f45c _REC_S1VAL_20_u1 255. _CNV_A_R_A_165_CM 0. 255. DISPLAY_IDENTIFIER fm_cal_lbup_hot_oc.fm_static_bitfield.Cbx_obd_mena_xxx BIT_MASK 0x8 /end CHARACTERISTIC
/begin CHARACTERISTIC Cxx_dtc_lb_lbup_hot_oc "" VALUE 0xa002f45d _REC_S1VAL_20_u1 255. _CNV_A_R_A_165_CM 0. 255. DISPLAY_IDENTIFIER fm_cal_lbup_hot_oc.Cxx_dtc_lb_xxx /end CHARACTERISTIC
/begin CHARACTERISTIC Cxx_obd_dc_lbup_hot_oc "" VALUE 0xa002f45e _REC_S1VAL_20_u1 9. _CNV_A_R_A_165_CM 1. 10. DISPLAY_IDENTIFIER fm_cal_lbup_hot_oc.Cxx_obd_dc_xxx /end CHARACTERISTIC
/begin CHARACTERISTIC Cxx_dtc_obd_lbup_hot_scg "" VALUE 0xa002f466 _REC_S1VAL_20_u2 65535. _CNV_A_R_A_165_CM 0. 65535. DISPLAY_IDENTIFIER fm_cal_lbup_hot_scg.Cxx_dtc_obd_xxx /end CHARACTERISTIC
/begin CHARACTERISTIC Cxx_conf_wal_lbup_hot_scg "" VALUE 0xa002f468 _REC_S1VAL_20_u1 3. _CNV_A_R_A_165_CM 0. 3. DISPLAY_IDENTIFIER fm_cal_lbup_hot_scg.fm_static_bitfield.Cxx_conf_wal_xxx BIT_MASK 0x3 /end CHARACTERISTIC
/begin CHARACTERISTIC Cbx_obd_lbup_hot_scg "" VALUE 0xa002f468 _REC_S1VAL_20_u1 255. _CNV_A_R_A_165_CM 0. 255. DISPLAY_IDENTIFIER fm_cal_lbup_hot_scg.fm_static_bitfield.Cbx_obd_xxx BIT_MASK 0x4 /end CHARACTERISTIC
/begin CHARACTERISTIC Cbx_obd_mena_lbup_hot_scg "" VALUE 0xa002f468 _REC_S1VAL_20_u1 255. _CNV_A_R_A_165_CM 0. 255. DISPLAY_IDENTIFIER fm_cal_lbup_hot_scg.fm_static_bitfield.Cbx_obd_mena_xxx BIT_MASK 0x8 /end CHARACTERISTIC
/begin CHARACTERISTIC Cxx_dtc_lb_lbup_hot_scg "" VALUE 0xa002f469 _REC_S1VAL_20_u1 255. _CNV_A_R_A_165_CM 0. 255. DISPLAY_IDENTIFIER fm_cal_lbup_hot_scg.Cxx_dtc_lb_xxx /end CHARACTERISTIC
/begin CHARACTERISTIC Cxx_obd_dc_lbup_hot_scg "" VALUE 0xa002f46a _REC_S1VAL_20_u1 9. _CNV_A_R_A_165_CM 1. 10. DISPLAY_IDENTIFIER fm_cal_lbup_hot_scg.Cxx_obd_dc_xxx /end CHARACTERISTIC
/begin CHARACTERISTIC Cxx_dtc_obd_lbup_hot_scw "" VALUE 0xa002f472 _REC_S1VAL_20_u2 65535. _CNV_A_R_A_165_CM 0. 65535. DISPLAY_IDENTIFIER fm_cal_lbup_hot_scw.Cxx_dtc_obd_xxx /end CHARACTERISTIC
/begin CHARACTERISTIC Cxx_conf_wal_lbup_hot_scw "" VALUE 0xa002f474 _REC_S1VAL_20_u1 3. _CNV_A_R_A_165_CM 0. 3. DISPLAY_IDENTIFIER fm_cal_lbup_hot_scw.fm_static_bitfield.Cxx_conf_wal_xxx BIT_MASK 0x3 /end CHARACTERISTIC
/begin CHARACTERISTIC Cbx_obd_lbup_hot_scw "" VALUE 0xa002f474 _REC_S1VAL_20_u1 255. _CNV_A_R_A_165_CM 0. 255. DISPLAY_IDENTIFIER fm_cal_lbup_hot_scw.fm_static_bitfield.Cbx_obd_xxx BIT_MASK 0x4 /end CHARACTERISTIC
/begin CHARACTERISTIC Cbx_obd_mena_lbup_hot_scw "" VALUE 0xa002f474 _REC_S1VAL_20_u1 255. _CNV_A_R_A_165_CM 0. 255. DISPLAY_IDENTIFIER fm_cal_lbup_hot_scw.fm_static_bitfield.Cbx_obd_mena_xxx BIT_MASK 0x8 /end CHARACTERISTIC
/begin CHARACTERISTIC Cxx_dtc_lb_lbup_hot_scw "" VALUE 0xa002f475 _REC_S1VAL_20_u1 255. _CNV_A_R_A_165_CM 0. 255. DISPLAY_IDENTIFIER fm_cal_lbup_hot_scw.Cxx_dtc_lb_xxx /end CHARACTERISTIC
/begin CHARACTERISTIC Cxx_obd_dc_lbup_hot_scw "" VALUE 0xa002f476 _REC_S1VAL_20_u1 9. _CNV_A_R_A_165_CM 1. 10. DISPLAY_IDENTIFIER fm_cal_lbup_hot_scw.Cxx_obd_dc_xxx /end CHARACTERISTIC
/begin CHARACTERISTIC Cxx_dtc_obd_lbup_nok "" VALUE 0xa002f7c6 _REC_S1VAL_20_u2 65535. _CNV_A_R_A_165_CM 0. 65535. DISPLAY_IDENTIFIER fm_cal_lbup_nok.Cxx_dtc_obd_xxx /end CHARACTERISTIC
/begin CHARACTERISTIC Cxx_conf_wal_lbup_nok "" VALUE 0xa002f7c8 _REC_S1VAL_20_u1 3. _CNV_A_R_A_165_CM 0. 3. DISPLAY_IDENTIFIER fm_cal_lbup_nok.fm_static_bitfield.Cxx_conf_wal_xxx BIT_MASK 0x3 /end CHARACTERISTIC
/begin CHARACTERISTIC Cbx_obd_lbup_nok "" VALUE 0xa002f7c8 _REC_S1VAL_20_u1 255. _CNV_A_R_A_165_CM 0. 255. DISPLAY_IDENTIFIER fm_cal_lbup_nok.fm_static_bitfield.Cbx_obd_xxx BIT_MASK 0x4 /end CHARACTERISTIC
/begin CHARACTERISTIC Cbx_obd_mena_lbup_nok "" VALUE 0xa002f7c8 _REC_S1VAL_20_u1 255. _CNV_A_R_A_165_CM 0. 255. DISPLAY_IDENTIFIER fm_cal_lbup_nok.fm_static_bitfield.Cbx_obd_mena_xxx BIT_MASK 0x8 /end CHARACTERISTIC
/begin CHARACTERISTIC Cxx_dtc_lb_lbup_nok "" VALUE 0xa002f7c9 _REC_S1VAL_20_u1 255. _CNV_A_R_A_165_CM 0. 255. DISPLAY_IDENTIFIER fm_cal_lbup_nok.Cxx_dtc_lb_xxx /end CHARACTERISTIC
/begin CHARACTERISTIC Cxx_obd_dc_lbup_nok "" VALUE 0xa002f7ca _REC_S1VAL_20_u1 9. _CNV_A_R_A_165_CM 1. 10. DISPLAY_IDENTIFIER fm_cal_lbup_nok.Cxx_obd_dc_xxx /end CHARACTERISTIC
/begin CHARACTERISTIC Cxx_dtc_obd_lbup_oc "" VALUE 0xa002f23e _REC_S1VAL_20_u2 65535. _CNV_A_R_A_165_CM 0. 65535. DISPLAY_IDENTIFIER fm_cal_lbup_oc.Cxx_dtc_obd_xxx /end CHARACTERISTIC
/begin CHARACTERISTIC Cxx_conf_wal_lbup_oc "" VALUE 0xa002f240 _REC_S1VAL_20_u1 3. _CNV_A_R_A_165_CM 0. 3. DISPLAY_IDENTIFIER fm_cal_lbup_oc.fm_static_bitfield.Cxx_conf_wal_xxx BIT_MASK 0x3 /end CHARACTERISTIC
/begin CHARACTERISTIC Cbx_obd_lbup_oc "" VALUE 0xa002f240 _REC_S1VAL_20_u1 255. _CNV_A_R_A_165_CM 0. 255. DISPLAY_IDENTIFIER fm_cal_lbup_oc.fm_static_bitfield.Cbx_obd_xxx BIT_MASK 0x4 /end CHARACTERISTIC
/begin CHARACTERISTIC Cbx_obd_mena_lbup_oc "" VALUE 0xa002f240 _REC_S1VAL_20_u1 255. _CNV_A_R_A_165_CM 0. 255. DISPLAY_IDENTIFIER fm_cal_lbup_oc.fm_static_bitfield.Cbx_obd_mena_xxx BIT_MASK 0x8 /end CHARACTERISTIC
/begin CHARACTERISTIC Cxx_dtc_lb_lbup_oc "" VALUE 0xa002f241 _REC_S1VAL_20_u1 255. _CNV_A_R_A_165_CM 0. 255. DISPLAY_IDENTIFIER fm_cal_lbup_oc.Cxx_dtc_lb_xxx /end CHARACTERISTIC
/begin CHARACTERISTIC Cxx_obd_dc_lbup_oc "" VALUE 0xa002f242 _REC_S1VAL_20_u1 9. _CNV_A_R_A_165_CM 1. 10. DISPLAY_IDENTIFIER fm_cal_lbup_oc.Cxx_obd_dc_xxx /end CHARACTERISTIC
/begin CHARACTERISTIC Cxx_dtc_obd_lbup_scg "" VALUE 0xa002f24a _REC_S1VAL_20_u2 65535. _CNV_A_R_A_165_CM 0. 65535. DISPLAY_IDENTIFIER fm_cal_lbup_scg.Cxx_dtc_obd_xxx /end CHARACTERISTIC
/begin CHARACTERISTIC Cxx_conf_wal_lbup_scg "" VALUE 0xa002f24c _REC_S1VAL_20_u1 3. _CNV_A_R_A_165_CM 0. 3. DISPLAY_IDENTIFIER fm_cal_lbup_scg.fm_static_bitfield.Cxx_conf_wal_xxx BIT_MASK 0x3 /end CHARACTERISTIC
/begin CHARACTERISTIC Cbx_obd_lbup_scg "" VALUE 0xa002f24c _REC_S1VAL_20_u1 255. _CNV_A_R_A_165_CM 0. 255. DISPLAY_IDENTIFIER fm_cal_lbup_scg.fm_static_bitfield.Cbx_obd_xxx BIT_MASK 0x4 /end CHARACTERISTIC
/begin CHARACTERISTIC Cbx_obd_mena_lbup_scg "" VALUE 0xa002f24c _REC_S1VAL_20_u1 255. _CNV_A_R_A_165_CM 0. 255. DISPLAY_IDENTIFIER fm_cal_lbup_scg.fm_static_bitfield.Cbx_obd_mena_xxx BIT_MASK 0x8 /end CHARACTERISTIC
/begin CHARACTERISTIC Cxx_dtc_lb_lbup_scg "" VALUE 0xa002f24d _REC_S1VAL_20_u1 255. _CNV_A_R_A_165_CM 0. 255. DISPLAY_IDENTIFIER fm_cal_lbup_scg.Cxx_dtc_lb_xxx /end CHARACTERISTIC
/begin CHARACTERISTIC Cxx_obd_dc_lbup_scg "" VALUE 0xa002f24e _REC_S1VAL_20_u1 9. _CNV_A_R_A_165_CM 1. 10. DISPLAY_IDENTIFIER fm_cal_lbup_scg.Cxx_obd_dc_xxx /end CHARACTERISTIC
/begin CHARACTERISTIC Cxx_dtc_obd_lbup_scw "" VALUE 0xa002f256 _REC_S1VAL_20_u2 65535. _CNV_A_R_A_165_CM 0. 65535. DISPLAY_IDENTIFIER fm_cal_lbup_scw.Cxx_dtc_obd_xxx /end CHARACTERISTIC
/begin CHARACTERISTIC Cxx_conf_wal_lbup_scw "" VALUE 0xa002f258 _REC_S1VAL_20_u1 3. _CNV_A_R_A_165_CM 0. 3. DISPLAY_IDENTIFIER fm_cal_lbup_scw.fm_static_bitfield.Cxx_conf_wal_xxx BIT_MASK 0x3 /end CHARACTERISTIC
/begin CHARACTERISTIC Cbx_obd_lbup_scw "" VALUE 0xa002f258 _REC_S1VAL_20_u1 255. _CNV_A_R_A_165_CM 0. 255. DISPLAY_IDENTIFIER fm_cal_lbup_scw.fm_static_bitfield.Cbx_obd_xxx BIT_MASK 0x4 /end CHARACTERISTIC
/begin CHARACTERISTIC Cbx_obd_mena_lbup_scw "" VALUE 0xa002f258 _REC_S1VAL_20_u1 255. _CNV_A_R_A_165_CM 0. 255. DISPLAY_IDENTIFIER fm_cal_lbup_scw.fm_static_bitfield.Cbx_obd_mena_xxx BIT_MASK 0x8 /end CHARACTERISTIC
/begin CHARACTERISTIC Cxx_dtc_lb_lbup_scw "" VALUE 0xa002f259 _REC_S1VAL_20_u1 255. _CNV_A_R_A_165_CM 0. 255. DISPLAY_IDENTIFIER fm_cal_lbup_scw.Cxx_dtc_lb_xxx /end CHARACTERISTIC
/begin CHARACTERISTIC Cxx_obd_dc_lbup_scw "" VALUE 0xa002f25a _REC_S1VAL_20_u1 9. _CNV_A_R_A_165_CM 1. 10. DISPLAY_IDENTIFIER fm_cal_lbup_scw.Cxx_obd_dc_xxx /end CHARACTERISTIC
/begin CHARACTERISTIC Cxx_dtc_obd_map_chr "" VALUE 0xa002f47e _REC_S1VAL_20_u2 65535. _CNV_A_R_A_165_CM 0. 65535. DISPLAY_IDENTIFIER fm_cal_map_chr.Cxx_dtc_obd_xxx /end CHARACTERISTIC
/begin CHARACTERISTIC Cxx_conf_wal_map_chr "" VALUE 0xa002f480 _REC_S1VAL_20_u1 3. _CNV_A_R_A_165_CM 0. 3. DISPLAY_IDENTIFIER fm_cal_map_chr.fm_static_bitfield.Cxx_conf_wal_xxx BIT_MASK 0x3 /end CHARACTERISTIC
/begin CHARACTERISTIC Cbx_obd_map_chr "" VALUE 0xa002f480 _REC_S1VAL_20_u1 255. _CNV_A_R_A_165_CM 0. 255. DISPLAY_IDENTIFIER fm_cal_map_chr.fm_static_bitfield.Cbx_obd_xxx BIT_MASK 0x4 /end CHARACTERISTIC
/begin CHARACTERISTIC Cbx_obd_mena_map_chr "" VALUE 0xa002f480 _REC_S1VAL_20_u1 255. _CNV_A_R_A_165_CM 0. 255. DISPLAY_IDENTIFIER fm_cal_map_chr.fm_static_bitfield.Cbx_obd_mena_xxx BIT_MASK 0x8 /end CHARACTERISTIC
/begin CHARACTERISTIC Cxx_dtc_lb_map_chr "" VALUE 0xa002f481 _REC_S1VAL_20_u1 255. _CNV_A_R_A_165_CM 0. 255. DISPLAY_IDENTIFIER fm_cal_map_chr.Cxx_dtc_lb_xxx /end CHARACTERISTIC
/begin CHARACTERISTIC Cxx_obd_dc_map_chr "" VALUE 0xa002f482 _REC_S1VAL_20_u1 9. _CNV_A_R_A_165_CM 1. 10. DISPLAY_IDENTIFIER fm_cal_map_chr.Cxx_obd_dc_xxx /end CHARACTERISTIC
/begin CHARACTERISTIC Cxx_dtc_obd_map_oor "" VALUE 0xa002f48a _REC_S1VAL_20_u2 65535. _CNV_A_R_A_165_CM 0. 65535. DISPLAY_IDENTIFIER fm_cal_map_oor.Cxx_dtc_obd_xxx /end CHARACTERISTIC
/begin CHARACTERISTIC Cxx_conf_wal_map_oor "" VALUE 0xa002f48c _REC_S1VAL_20_u1 3. _CNV_A_R_A_165_CM 0. 3. DISPLAY_IDENTIFIER fm_cal_map_oor.fm_static_bitfield.Cxx_conf_wal_xxx BIT_MASK 0x3 /end CHARACTERISTIC
/begin CHARACTERISTIC Cbx_obd_map_oor "" VALUE 0xa002f48c _REC_S1VAL_20_u1 255. _CNV_A_R_A_165_CM 0. 255. DISPLAY_IDENTIFIER fm_cal_map_oor.fm_static_bitfield.Cbx_obd_xxx BIT_MASK 0x4 /end CHARACTERISTIC
/begin CHARACTERISTIC Cbx_obd_mena_map_oor "" VALUE 0xa002f48c _REC_S1VAL_20_u1 255. _CNV_A_R_A_165_CM 0. 255. DISPLAY_IDENTIFIER fm_cal_map_oor.fm_static_bitfield.Cbx_obd_mena_xxx BIT_MASK 0x8 /end CHARACTERISTIC
/begin CHARACTERISTIC Cxx_dtc_lb_map_oor "" VALUE 0xa002f48d _REC_S1VAL_20_u1 255. _CNV_A_R_A_165_CM 0. 255. DISPLAY_IDENTIFIER fm_cal_map_oor.Cxx_dtc_lb_xxx /end CHARACTERISTIC
/begin CHARACTERISTIC Cxx_obd_dc_map_oor "" VALUE 0xa002f48e _REC_S1VAL_20_u1 9. _CNV_A_R_A_165_CM 1. 10. DISPLAY_IDENTIFIER fm_cal_map_oor.Cxx_obd_dc_xxx /end CHARACTERISTIC
/begin CHARACTERISTIC Cxx_dtc_obd_mis_1_cata "" VALUE 0xa002f496 _REC_S1VAL_20_u2 65535. _CNV_A_R_A_165_CM 0. 65535. DISPLAY_IDENTIFIER fm_cal_mis_1_cata.Cxx_dtc_obd_xxx /end CHARACTERISTIC
/begin CHARACTERISTIC Cxx_conf_wal_mis_1_cata "" VALUE 0xa002f498 _REC_S1VAL_20_u1 3. _CNV_A_R_A_165_CM 0. 3. DISPLAY_IDENTIFIER fm_cal_mis_1_cata.fm_static_bitfield.Cxx_conf_wal_xxx BIT_MASK 0x3 /end CHARACTERISTIC
/begin CHARACTERISTIC Cbx_obd_mis_1_cata "" VALUE 0xa002f498 _REC_S1VAL_20_u1 255. _CNV_A_R_A_165_CM 0. 255. DISPLAY_IDENTIFIER fm_cal_mis_1_cata.fm_static_bitfield.Cbx_obd_xxx BIT_MASK 0x4 /end CHARACTERISTIC
/begin CHARACTERISTIC Cbx_obd_mena_mis_1_cata "" VALUE 0xa002f498 _REC_S1VAL_20_u1 255. _CNV_A_R_A_165_CM 0. 255. DISPLAY_IDENTIFIER fm_cal_mis_1_cata.fm_static_bitfield.Cbx_obd_mena_xxx BIT_MASK 0x8 /end CHARACTERISTIC
/begin CHARACTERISTIC Cxx_dtc_lb_mis_1_cata "" VALUE 0xa002f499 _REC_S1VAL_20_u1 255. _CNV_A_R_A_165_CM 0. 255. DISPLAY_IDENTIFIER fm_cal_mis_1_cata.Cxx_dtc_lb_xxx /end CHARACTERISTIC
/begin CHARACTERISTIC Cxx_obd_dc_mis_1_cata "" VALUE 0xa002f49a _REC_S1VAL_20_u1 9. _CNV_A_R_A_165_CM 1. 10. DISPLAY_IDENTIFIER fm_cal_mis_1_cata.Cxx_obd_dc_xxx /end CHARACTERISTIC
/begin CHARACTERISTIC Cxx_dtc_obd_mis_1_lpg_cata "" VALUE 0xa002f4a2 _REC_S1VAL_20_u2 65535. _CNV_A_R_A_165_CM 0. 65535. DISPLAY_IDENTIFIER fm_cal_mis_1_lpg_cata.Cxx_dtc_obd_xxx /end CHARACTERISTIC
/begin CHARACTERISTIC Cxx_conf_wal_mis_1_lpg_cata "" VALUE 0xa002f4a4 _REC_S1VAL_20_u1 3. _CNV_A_R_A_165_CM 0. 3. DISPLAY_IDENTIFIER fm_cal_mis_1_lpg_cata.fm_static_bitfield.Cxx_conf_wal_xxx BIT_MASK 0x3 /end CHARACTERISTIC
/begin CHARACTERISTIC Cbx_obd_mis_1_lpg_cata "" VALUE 0xa002f4a4 _REC_S1VAL_20_u1 255. _CNV_A_R_A_165_CM 0. 255. DISPLAY_IDENTIFIER fm_cal_mis_1_lpg_cata.fm_static_bitfield.Cbx_obd_xxx BIT_MASK 0x4 /end CHARACTERISTIC
/begin CHARACTERISTIC Cbx_obd_mena_mis_1_lpg_cata "" VALUE 0xa002f4a4 _REC_S1VAL_20_u1 255. _CNV_A_R_A_165_CM 0. 255. DISPLAY_IDENTIFIER fm_cal_mis_1_lpg_cata.fm_static_bitfield.Cbx_obd_mena_xxx BIT_MASK 0x8 /end CHARACTERISTIC
/begin CHARACTERISTIC Cxx_dtc_lb_mis_1_lpg_cata "" VALUE 0xa002f4a5 _REC_S1VAL_20_u1 255. _CNV_A_R_A_165_CM 0. 255. DISPLAY_IDENTIFIER fm_cal_mis_1_lpg_cata.Cxx_dtc_lb_xxx /end CHARACTERISTIC
/begin CHARACTERISTIC Cxx_obd_dc_mis_1_lpg_cata "" VALUE 0xa002f4a6 _REC_S1VAL_20_u1 9. _CNV_A_R_A_165_CM 1. 10. DISPLAY_IDENTIFIER fm_cal_mis_1_lpg_cata.Cxx_obd_dc_xxx /end CHARACTERISTIC
/begin CHARACTERISTIC Cxx_dtc_obd_mis_1_lpg_trs_h "" VALUE 0xa002f4ae _REC_S1VAL_20_u2 65535. _CNV_A_R_A_165_CM 0. 65535. DISPLAY_IDENTIFIER fm_cal_mis_1_lpg_trs_h.Cxx_dtc_obd_xxx /end CHARACTERISTIC
/begin CHARACTERISTIC Cxx_conf_wal_mis_1_lpg_trs_h "" VALUE 0xa002f4b0 _REC_S1VAL_20_u1 3. _CNV_A_R_A_165_CM 0. 3. DISPLAY_IDENTIFIER fm_cal_mis_1_lpg_trs_h.fm_static_bitfield.Cxx_conf_wal_xxx BIT_MASK 0x3 /end CHARACTERISTIC
/begin CHARACTERISTIC Cbx_obd_mis_1_lpg_trs_h "" VALUE 0xa002f4b0 _REC_S1VAL_20_u1 255. _CNV_A_R_A_165_CM 0. 255. DISPLAY_IDENTIFIER fm_cal_mis_1_lpg_trs_h.fm_static_bitfield.Cbx_obd_xxx BIT_MASK 0x4 /end CHARACTERISTIC
/begin CHARACTERISTIC Cbx_obd_mena_mis_1_lpg_trs_h "" VALUE 0xa002f4b0 _REC_S1VAL_20_u1 255. _CNV_A_R_A_165_CM 0. 255. DISPLAY_IDENTIFIER fm_cal_mis_1_lpg_trs_h.fm_static_bitfield.Cbx_obd_mena_xxx BIT_MASK 0x8 /end CHARACTERISTIC
/begin CHARACTERISTIC Cxx_dtc_lb_mis_1_lpg_trs_h "" VALUE 0xa002f4b1 _REC_S1VAL_20_u1 255. _CNV_A_R_A_165_CM 0. 255. DISPLAY_IDENTIFIER fm_cal_mis_1_lpg_trs_h.Cxx_dtc_lb_xxx /end CHARACTERISTIC
/begin CHARACTERISTIC Cxx_obd_dc_mis_1_lpg_trs_h "" VALUE 0xa002f4b2 _REC_S1VAL_20_u1 9. _CNV_A_R_A_165_CM 1. 10. DISPLAY_IDENTIFIER fm_cal_mis_1_lpg_trs_h.Cxx_obd_dc_xxx /end CHARACTERISTIC
/begin CHARACTERISTIC Cxx_dtc_obd_mis_1_trs_h "" VALUE 0xa002f4ba _REC_S1VAL_20_u2 65535. _CNV_A_R_A_165_CM 0. 65535. DISPLAY_IDENTIFIER fm_cal_mis_1_trs_h.Cxx_dtc_obd_xxx /end CHARACTERISTIC
/begin CHARACTERISTIC Cxx_conf_wal_mis_1_trs_h "" VALUE 0xa002f4bc _REC_S1VAL_20_u1 3. _CNV_A_R_A_165_CM 0. 3. DISPLAY_IDENTIFIER fm_cal_mis_1_trs_h.fm_static_bitfield.Cxx_conf_wal_xxx BIT_MASK 0x3 /end CHARACTERISTIC
/begin CHARACTERISTIC Cbx_obd_mis_1_trs_h "" VALUE 0xa002f4bc _REC_S1VAL_20_u1 255. _CNV_A_R_A_165_CM 0. 255. DISPLAY_IDENTIFIER fm_cal_mis_1_trs_h.fm_static_bitfield.Cbx_obd_xxx BIT_MASK 0x4 /end CHARACTERISTIC
/begin CHARACTERISTIC Cbx_obd_mena_mis_1_trs_h "" VALUE 0xa002f4bc _REC_S1VAL_20_u1 255. _CNV_A_R_A_165_CM 0. 255. DISPLAY_IDENTIFIER fm_cal_mis_1_trs_h.fm_static_bitfield.Cbx_obd_mena_xxx BIT_MASK 0x8 /end CHARACTERISTIC
/begin CHARACTERISTIC Cxx_dtc_lb_mis_1_trs_h "" VALUE 0xa002f4bd _REC_S1VAL_20_u1 255. _CNV_A_R_A_165_CM 0. 255. DISPLAY_IDENTIFIER fm_cal_mis_1_trs_h.Cxx_dtc_lb_xxx /end CHARACTERISTIC
/begin CHARACTERISTIC Cxx_obd_dc_mis_1_trs_h "" VALUE 0xa002f4be _REC_S1VAL_20_u1 9. _CNV_A_R_A_165_CM 1. 10. DISPLAY_IDENTIFIER fm_cal_mis_1_trs_h.Cxx_obd_dc_xxx /end CHARACTERISTIC
/begin CHARACTERISTIC Cxx_dtc_obd_mis_2_cata "" VALUE 0xa002f4c6 _REC_S1VAL_20_u2 65535. _CNV_A_R_A_165_CM 0. 65535. DISPLAY_IDENTIFIER fm_cal_mis_2_cata.Cxx_dtc_obd_xxx /end CHARACTERISTIC
/begin CHARACTERISTIC Cxx_conf_wal_mis_2_cata "" VALUE 0xa002f4c8 _REC_S1VAL_20_u1 3. _CNV_A_R_A_165_CM 0. 3. DISPLAY_IDENTIFIER fm_cal_mis_2_cata.fm_static_bitfield.Cxx_conf_wal_xxx BIT_MASK 0x3 /end CHARACTERISTIC
/begin CHARACTERISTIC Cbx_obd_mis_2_cata "" VALUE 0xa002f4c8 _REC_S1VAL_20_u1 255. _CNV_A_R_A_165_CM 0. 255. DISPLAY_IDENTIFIER fm_cal_mis_2_cata.fm_static_bitfield.Cbx_obd_xxx BIT_MASK 0x4 /end CHARACTERISTIC
/begin CHARACTERISTIC Cbx_obd_mena_mis_2_cata "" VALUE 0xa002f4c8 _REC_S1VAL_20_u1 255. _CNV_A_R_A_165_CM 0. 255. DISPLAY_IDENTIFIER fm_cal_mis_2_cata.fm_static_bitfield.Cbx_obd_mena_xxx BIT_MASK 0x8 /end CHARACTERISTIC
/begin CHARACTERISTIC Cxx_dtc_lb_mis_2_cata "" VALUE 0xa002f4c9 _REC_S1VAL_20_u1 255. _CNV_A_R_A_165_CM 0. 255. DISPLAY_IDENTIFIER fm_cal_mis_2_cata.Cxx_dtc_lb_xxx /end CHARACTERISTIC
/begin CHARACTERISTIC Cxx_obd_dc_mis_2_cata "" VALUE 0xa002f4ca _REC_S1VAL_20_u1 9. _CNV_A_R_A_165_CM 1. 10. DISPLAY_IDENTIFIER fm_cal_mis_2_cata.Cxx_obd_dc_xxx /end CHARACTERISTIC
/begin CHARACTERISTIC Cxx_dtc_obd_mis_2_lpg_cata "" VALUE 0xa002f4d2 _REC_S1VAL_20_u2 65535. _CNV_A_R_A_165_CM 0. 65535. DISPLAY_IDENTIFIER fm_cal_mis_2_lpg_cata.Cxx_dtc_obd_xxx /end CHARACTERISTIC
/begin CHARACTERISTIC Cxx_conf_wal_mis_2_lpg_cata "" VALUE 0xa002f4d4 _REC_S1VAL_20_u1 3. _CNV_A_R_A_165_CM 0. 3. DISPLAY_IDENTIFIER fm_cal_mis_2_lpg_cata.fm_static_bitfield.Cxx_conf_wal_xxx BIT_MASK 0x3 /end CHARACTERISTIC
/begin CHARACTERISTIC Cbx_obd_mis_2_lpg_cata "" VALUE 0xa002f4d4 _REC_S1VAL_20_u1 255. _CNV_A_R_A_165_CM 0. 255. DISPLAY_IDENTIFIER fm_cal_mis_2_lpg_cata.fm_static_bitfield.Cbx_obd_xxx BIT_MASK 0x4 /end CHARACTERISTIC
/begin CHARACTERISTIC Cbx_obd_mena_mis_2_lpg_cata "" VALUE 0xa002f4d4 _REC_S1VAL_20_u1 255. _CNV_A_R_A_165_CM 0. 255. DISPLAY_IDENTIFIER fm_cal_mis_2_lpg_cata.fm_static_bitfield.Cbx_obd_mena_xxx BIT_MASK 0x8 /end CHARACTERISTIC
/begin CHARACTERISTIC Cxx_dtc_lb_mis_2_lpg_cata "" VALUE 0xa002f4d5 _REC_S1VAL_20_u1 255. _CNV_A_R_A_165_CM 0. 255. DISPLAY_IDENTIFIER fm_cal_mis_2_lpg_cata.Cxx_dtc_lb_xxx /end CHARACTERISTIC
/begin CHARACTERISTIC Cxx_obd_dc_mis_2_lpg_cata "" VALUE 0xa002f4d6 _REC_S1VAL_20_u1 9. _CNV_A_R_A_165_CM 1. 10. DISPLAY_IDENTIFIER fm_cal_mis_2_lpg_cata.Cxx_obd_dc_xxx /end CHARACTERISTIC
/begin CHARACTERISTIC Cxx_dtc_obd_mis_2_lpg_trs_h "" VALUE 0xa002f4de _REC_S1VAL_20_u2 65535. _CNV_A_R_A_165_CM 0. 65535. DISPLAY_IDENTIFIER fm_cal_mis_2_lpg_trs_h.Cxx_dtc_obd_xxx /end CHARACTERISTIC
/begin CHARACTERISTIC Cxx_conf_wal_mis_2_lpg_trs_h "" VALUE 0xa002f4e0 _REC_S1VAL_20_u1 3. _CNV_A_R_A_165_CM 0. 3. DISPLAY_IDENTIFIER fm_cal_mis_2_lpg_trs_h.fm_static_bitfield.Cxx_conf_wal_xxx BIT_MASK 0x3 /end CHARACTERISTIC
/begin CHARACTERISTIC Cbx_obd_mis_2_lpg_trs_h "" VALUE 0xa002f4e0 _REC_S1VAL_20_u1 255. _CNV_A_R_A_165_CM 0. 255. DISPLAY_IDENTIFIER fm_cal_mis_2_lpg_trs_h.fm_static_bitfield.Cbx_obd_xxx BIT_MASK 0x4 /end CHARACTERISTIC
/begin CHARACTERISTIC Cbx_obd_mena_mis_2_lpg_trs_h "" VALUE 0xa002f4e0 _REC_S1VAL_20_u1 255. _CNV_A_R_A_165_CM 0. 255. DISPLAY_IDENTIFIER fm_cal_mis_2_lpg_trs_h.fm_static_bitfield.Cbx_obd_mena_xxx BIT_MASK 0x8 /end CHARACTERISTIC
/begin CHARACTERISTIC Cxx_dtc_lb_mis_2_lpg_trs_h "" VALUE 0xa002f4e1 _REC_S1VAL_20_u1 255. _CNV_A_R_A_165_CM 0. 255. DISPLAY_IDENTIFIER fm_cal_mis_2_lpg_trs_h.Cxx_dtc_lb_xxx /end CHARACTERISTIC
/begin CHARACTERISTIC Cxx_obd_dc_mis_2_lpg_trs_h "" VALUE 0xa002f4e2 _REC_S1VAL_20_u1 9. _CNV_A_R_A_165_CM 1. 10. DISPLAY_IDENTIFIER fm_cal_mis_2_lpg_trs_h.Cxx_obd_dc_xxx /end CHARACTERISTIC
/begin CHARACTERISTIC Cxx_dtc_obd_mis_2_trs_h "" VALUE 0xa002f4ea _REC_S1VAL_20_u2 65535. _CNV_A_R_A_165_CM 0. 65535. DISPLAY_IDENTIFIER fm_cal_mis_2_trs_h.Cxx_dtc_obd_xxx /end CHARACTERISTIC
/begin CHARACTERISTIC Cxx_conf_wal_mis_2_trs_h "" VALUE 0xa002f4ec _REC_S1VAL_20_u1 3. _CNV_A_R_A_165_CM 0. 3. DISPLAY_IDENTIFIER fm_cal_mis_2_trs_h.fm_static_bitfield.Cxx_conf_wal_xxx BIT_MASK 0x3 /end CHARACTERISTIC
/begin CHARACTERISTIC Cbx_obd_mis_2_trs_h "" VALUE 0xa002f4ec _REC_S1VAL_20_u1 255. _CNV_A_R_A_165_CM 0. 255. DISPLAY_IDENTIFIER fm_cal_mis_2_trs_h.fm_static_bitfield.Cbx_obd_xxx BIT_MASK 0x4 /end CHARACTERISTIC
/begin CHARACTERISTIC Cbx_obd_mena_mis_2_trs_h "" VALUE 0xa002f4ec _REC_S1VAL_20_u1 255. _CNV_A_R_A_165_CM 0. 255. DISPLAY_IDENTIFIER fm_cal_mis_2_trs_h.fm_static_bitfield.Cbx_obd_mena_xxx BIT_MASK 0x8 /end CHARACTERISTIC
/begin CHARACTERISTIC Cxx_dtc_lb_mis_2_trs_h "" VALUE 0xa002f4ed _REC_S1VAL_20_u1 255. _CNV_A_R_A_165_CM 0. 255. DISPLAY_IDENTIFIER fm_cal_mis_2_trs_h.Cxx_dtc_lb_xxx /end CHARACTERISTIC
/begin CHARACTERISTIC Cxx_obd_dc_mis_2_trs_h "" VALUE 0xa002f4ee _REC_S1VAL_20_u1 9. _CNV_A_R_A_165_CM 1. 10. DISPLAY_IDENTIFIER fm_cal_mis_2_trs_h.Cxx_obd_dc_xxx /end CHARACTERISTIC
/begin CHARACTERISTIC Cxx_dtc_obd_mis_3_cata "" VALUE 0xa002f4f6 _REC_S1VAL_20_u2 65535. _CNV_A_R_A_165_CM 0. 65535. DISPLAY_IDENTIFIER fm_cal_mis_3_cata.Cxx_dtc_obd_xxx /end CHARACTERISTIC
/begin CHARACTERISTIC Cxx_conf_wal_mis_3_cata "" VALUE 0xa002f4f8 _REC_S1VAL_20_u1 3. _CNV_A_R_A_165_CM 0. 3. DISPLAY_IDENTIFIER fm_cal_mis_3_cata.fm_static_bitfield.Cxx_conf_wal_xxx BIT_MASK 0x3 /end CHARACTERISTIC
/begin CHARACTERISTIC Cbx_obd_mis_3_cata "" VALUE 0xa002f4f8 _REC_S1VAL_20_u1 255. _CNV_A_R_A_165_CM 0. 255. DISPLAY_IDENTIFIER fm_cal_mis_3_cata.fm_static_bitfield.Cbx_obd_xxx BIT_MASK 0x4 /end CHARACTERISTIC
/begin CHARACTERISTIC Cbx_obd_mena_mis_3_cata "" VALUE 0xa002f4f8 _REC_S1VAL_20_u1 255. _CNV_A_R_A_165_CM 0. 255. DISPLAY_IDENTIFIER fm_cal_mis_3_cata.fm_static_bitfield.Cbx_obd_mena_xxx BIT_MASK 0x8 /end CHARACTERISTIC
/begin CHARACTERISTIC Cxx_dtc_lb_mis_3_cata "" VALUE 0xa002f4f9 _REC_S1VAL_20_u1 255. _CNV_A_R_A_165_CM 0. 255. DISPLAY_IDENTIFIER fm_cal_mis_3_cata.Cxx_dtc_lb_xxx /end CHARACTERISTIC
/begin CHARACTERISTIC Cxx_obd_dc_mis_3_cata "" VALUE 0xa002f4fa _REC_S1VAL_20_u1 9. _CNV_A_R_A_165_CM 1. 10. DISPLAY_IDENTIFIER fm_cal_mis_3_cata.Cxx_obd_dc_xxx /end CHARACTERISTIC
/begin CHARACTERISTIC Cxx_dtc_obd_mis_3_lpg_cata "" VALUE 0xa002f502 _REC_S1VAL_20_u2 65535. _CNV_A_R_A_165_CM 0. 65535. DISPLAY_IDENTIFIER fm_cal_mis_3_lpg_cata.Cxx_dtc_obd_xxx /end CHARACTERISTIC
/begin CHARACTERISTIC Cxx_conf_wal_mis_3_lpg_cata "" VALUE 0xa002f504 _REC_S1VAL_20_u1 3. _CNV_A_R_A_165_CM 0. 3. DISPLAY_IDENTIFIER fm_cal_mis_3_lpg_cata.fm_static_bitfield.Cxx_conf_wal_xxx BIT_MASK 0x3 /end CHARACTERISTIC
/begin CHARACTERISTIC Cbx_obd_mis_3_lpg_cata "" VALUE 0xa002f504 _REC_S1VAL_20_u1 255. _CNV_A_R_A_165_CM 0. 255. DISPLAY_IDENTIFIER fm_cal_mis_3_lpg_cata.fm_static_bitfield.Cbx_obd_xxx BIT_MASK 0x4 /end CHARACTERISTIC
/begin CHARACTERISTIC Cbx_obd_mena_mis_3_lpg_cata "" VALUE 0xa002f504 _REC_S1VAL_20_u1 255. _CNV_A_R_A_165_CM 0. 255. DISPLAY_IDENTIFIER fm_cal_mis_3_lpg_cata.fm_static_bitfield.Cbx_obd_mena_xxx BIT_MASK 0x8 /end CHARACTERISTIC
/begin CHARACTERISTIC Cxx_dtc_lb_mis_3_lpg_cata "" VALUE 0xa002f505 _REC_S1VAL_20_u1 255. _CNV_A_R_A_165_CM 0. 255. DISPLAY_IDENTIFIER fm_cal_mis_3_lpg_cata.Cxx_dtc_lb_xxx /end CHARACTERISTIC
/begin CHARACTERISTIC Cxx_obd_dc_mis_3_lpg_cata "" VALUE 0xa002f506 _REC_S1VAL_20_u1 9. _CNV_A_R_A_165_CM 1. 10. DISPLAY_IDENTIFIER fm_cal_mis_3_lpg_cata.Cxx_obd_dc_xxx /end CHARACTERISTIC
/begin CHARACTERISTIC Cxx_dtc_obd_mis_3_lpg_trs_h "" VALUE 0xa002f50e _REC_S1VAL_20_u2 65535. _CNV_A_R_A_165_CM 0. 65535. DISPLAY_IDENTIFIER fm_cal_mis_3_lpg_trs_h.Cxx_dtc_obd_xxx /end CHARACTERISTIC
/begin CHARACTERISTIC Cxx_conf_wal_mis_3_lpg_trs_h "" VALUE 0xa002f510 _REC_S1VAL_20_u1 3. _CNV_A_R_A_165_CM 0. 3. DISPLAY_IDENTIFIER fm_cal_mis_3_lpg_trs_h.fm_static_bitfield.Cxx_conf_wal_xxx BIT_MASK 0x3 /end CHARACTERISTIC
/begin CHARACTERISTIC Cbx_obd_mis_3_lpg_trs_h "" VALUE 0xa002f510 _REC_S1VAL_20_u1 255. _CNV_A_R_A_165_CM 0. 255. DISPLAY_IDENTIFIER fm_cal_mis_3_lpg_trs_h.fm_static_bitfield.Cbx_obd_xxx BIT_MASK 0x4 /end CHARACTERISTIC
/begin CHARACTERISTIC Cbx_obd_mena_mis_3_lpg_trs_h "" VALUE 0xa002f510 _REC_S1VAL_20_u1 255. _CNV_A_R_A_165_CM 0. 255. DISPLAY_IDENTIFIER fm_cal_mis_3_lpg_trs_h.fm_static_bitfield.Cbx_obd_mena_xxx BIT_MASK 0x8 /end CHARACTERISTIC
/begin CHARACTERISTIC Cxx_dtc_lb_mis_3_lpg_trs_h "" VALUE 0xa002f511 _REC_S1VAL_20_u1 255. _CNV_A_R_A_165_CM 0. 255. DISPLAY_IDENTIFIER fm_cal_mis_3_lpg_trs_h.Cxx_dtc_lb_xxx /end CHARACTERISTIC
/begin CHARACTERISTIC Cxx_obd_dc_mis_3_lpg_trs_h "" VALUE 0xa002f512 _REC_S1VAL_20_u1 9. _CNV_A_R_A_165_CM 1. 10. DISPLAY_IDENTIFIER fm_cal_mis_3_lpg_trs_h.Cxx_obd_dc_xxx /end CHARACTERISTIC
/begin CHARACTERISTIC Cxx_dtc_obd_mis_3_trs_h "" VALUE 0xa002f51a _REC_S1VAL_20_u2 65535. _CNV_A_R_A_165_CM 0. 65535. DISPLAY_IDENTIFIER fm_cal_mis_3_trs_h.Cxx_dtc_obd_xxx /end CHARACTERISTIC
/begin CHARACTERISTIC Cxx_conf_wal_mis_3_trs_h "" VALUE 0xa002f51c _REC_S1VAL_20_u1 3. _CNV_A_R_A_165_CM 0. 3. DISPLAY_IDENTIFIER fm_cal_mis_3_trs_h.fm_static_bitfield.Cxx_conf_wal_xxx BIT_MASK 0x3 /end CHARACTERISTIC
/begin CHARACTERISTIC Cbx_obd_mis_3_trs_h "" VALUE 0xa002f51c _REC_S1VAL_20_u1 255. _CNV_A_R_A_165_CM 0. 255. DISPLAY_IDENTIFIER fm_cal_mis_3_trs_h.fm_static_bitfield.Cbx_obd_xxx BIT_MASK 0x4 /end CHARACTERISTIC
/begin CHARACTERISTIC Cbx_obd_mena_mis_3_trs_h "" VALUE 0xa002f51c _REC_S1VAL_20_u1 255. _CNV_A_R_A_165_CM 0. 255. DISPLAY_IDENTIFIER fm_cal_mis_3_trs_h.fm_static_bitfield.Cbx_obd_mena_xxx BIT_MASK 0x8 /end CHARACTERISTIC
/begin CHARACTERISTIC Cxx_dtc_lb_mis_3_trs_h "" VALUE 0xa002f51d _REC_S1VAL_20_u1 255. _CNV_A_R_A_165_CM 0. 255. DISPLAY_IDENTIFIER fm_cal_mis_3_trs_h.Cxx_dtc_lb_xxx /end CHARACTERISTIC
/begin CHARACTERISTIC Cxx_obd_dc_mis_3_trs_h "" VALUE 0xa002f51e _REC_S1VAL_20_u1 9. _CNV_A_R_A_165_CM 1. 10. DISPLAY_IDENTIFIER fm_cal_mis_3_trs_h.Cxx_obd_dc_xxx /end CHARACTERISTIC
/begin CHARACTERISTIC Cxx_dtc_obd_mis_4_cata "" VALUE 0xa002f526 _REC_S1VAL_20_u2 65535. _CNV_A_R_A_165_CM 0. 65535. DISPLAY_IDENTIFIER fm_cal_mis_4_cata.Cxx_dtc_obd_xxx /end CHARACTERISTIC
/begin CHARACTERISTIC Cxx_conf_wal_mis_4_cata "" VALUE 0xa002f528 _REC_S1VAL_20_u1 3. _CNV_A_R_A_165_CM 0. 3. DISPLAY_IDENTIFIER fm_cal_mis_4_cata.fm_static_bitfield.Cxx_conf_wal_xxx BIT_MASK 0x3 /end CHARACTERISTIC
/begin CHARACTERISTIC Cbx_obd_mis_4_cata "" VALUE 0xa002f528 _REC_S1VAL_20_u1 255. _CNV_A_R_A_165_CM 0. 255. DISPLAY_IDENTIFIER fm_cal_mis_4_cata.fm_static_bitfield.Cbx_obd_xxx BIT_MASK 0x4 /end CHARACTERISTIC
/begin CHARACTERISTIC Cbx_obd_mena_mis_4_cata "" VALUE 0xa002f528 _REC_S1VAL_20_u1 255. _CNV_A_R_A_165_CM 0. 255. DISPLAY_IDENTIFIER fm_cal_mis_4_cata.fm_static_bitfield.Cbx_obd_mena_xxx BIT_MASK 0x8 /end CHARACTERISTIC
/begin CHARACTERISTIC Cxx_dtc_lb_mis_4_cata "" VALUE 0xa002f529 _REC_S1VAL_20_u1 255. _CNV_A_R_A_165_CM 0. 255. DISPLAY_IDENTIFIER fm_cal_mis_4_cata.Cxx_dtc_lb_xxx /end CHARACTERISTIC
/begin CHARACTERISTIC Cxx_obd_dc_mis_4_cata "" VALUE 0xa002f52a _REC_S1VAL_20_u1 9. _CNV_A_R_A_165_CM 1. 10. DISPLAY_IDENTIFIER fm_cal_mis_4_cata.Cxx_obd_dc_xxx /end CHARACTERISTIC
/begin CHARACTERISTIC Cxx_dtc_obd_mis_4_lpg_cata "" VALUE 0xa002f532 _REC_S1VAL_20_u2 65535. _CNV_A_R_A_165_CM 0. 65535. DISPLAY_IDENTIFIER fm_cal_mis_4_lpg_cata.Cxx_dtc_obd_xxx /end CHARACTERISTIC
/begin CHARACTERISTIC Cxx_conf_wal_mis_4_lpg_cata "" VALUE 0xa002f534 _REC_S1VAL_20_u1 3. _CNV_A_R_A_165_CM 0. 3. DISPLAY_IDENTIFIER fm_cal_mis_4_lpg_cata.fm_static_bitfield.Cxx_conf_wal_xxx BIT_MASK 0x3 /end CHARACTERISTIC
/begin CHARACTERISTIC Cbx_obd_mis_4_lpg_cata "" VALUE 0xa002f534 _REC_S1VAL_20_u1 255. _CNV_A_R_A_165_CM 0. 255. DISPLAY_IDENTIFIER fm_cal_mis_4_lpg_cata.fm_static_bitfield.Cbx_obd_xxx BIT_MASK 0x4 /end CHARACTERISTIC
/begin CHARACTERISTIC Cbx_obd_mena_mis_4_lpg_cata "" VALUE 0xa002f534 _REC_S1VAL_20_u1 255. _CNV_A_R_A_165_CM 0. 255. DISPLAY_IDENTIFIER fm_cal_mis_4_lpg_cata.fm_static_bitfield.Cbx_obd_mena_xxx BIT_MASK 0x8 /end CHARACTERISTIC
/begin CHARACTERISTIC Cxx_dtc_lb_mis_4_lpg_cata "" VALUE 0xa002f535 _REC_S1VAL_20_u1 255. _CNV_A_R_A_165_CM 0. 255. DISPLAY_IDENTIFIER fm_cal_mis_4_lpg_cata.Cxx_dtc_lb_xxx /end CHARACTERISTIC
/begin CHARACTERISTIC Cxx_obd_dc_mis_4_lpg_cata "" VALUE 0xa002f536 _REC_S1VAL_20_u1 9. _CNV_A_R_A_165_CM 1. 10. DISPLAY_IDENTIFIER fm_cal_mis_4_lpg_cata.Cxx_obd_dc_xxx /end CHARACTERISTIC
/begin CHARACTERISTIC Cxx_dtc_obd_mis_4_lpg_trs_h "" VALUE 0xa002f53e _REC_S1VAL_20_u2 65535. _CNV_A_R_A_165_CM 0. 65535. DISPLAY_IDENTIFIER fm_cal_mis_4_lpg_trs_h.Cxx_dtc_obd_xxx /end CHARACTERISTIC
/begin CHARACTERISTIC Cxx_conf_wal_mis_4_lpg_trs_h "" VALUE 0xa002f540 _REC_S1VAL_20_u1 3. _CNV_A_R_A_165_CM 0. 3. DISPLAY_IDENTIFIER fm_cal_mis_4_lpg_trs_h.fm_static_bitfield.Cxx_conf_wal_xxx BIT_MASK 0x3 /end CHARACTERISTIC
/begin CHARACTERISTIC Cbx_obd_mis_4_lpg_trs_h "" VALUE 0xa002f540 _REC_S1VAL_20_u1 255. _CNV_A_R_A_165_CM 0. 255. DISPLAY_IDENTIFIER fm_cal_mis_4_lpg_trs_h.fm_static_bitfield.Cbx_obd_xxx BIT_MASK 0x4 /end CHARACTERISTIC
/begin CHARACTERISTIC Cbx_obd_mena_mis_4_lpg_trs_h "" VALUE 0xa002f540 _REC_S1VAL_20_u1 255. _CNV_A_R_A_165_CM 0. 255. DISPLAY_IDENTIFIER fm_cal_mis_4_lpg_trs_h.fm_static_bitfield.Cbx_obd_mena_xxx BIT_MASK 0x8 /end CHARACTERISTIC
/begin CHARACTERISTIC Cxx_dtc_lb_mis_4_lpg_trs_h "" VALUE 0xa002f541 _REC_S1VAL_20_u1 255. _CNV_A_R_A_165_CM 0. 255. DISPLAY_IDENTIFIER fm_cal_mis_4_lpg_trs_h.Cxx_dtc_lb_xxx /end CHARACTERISTIC
/begin CHARACTERISTIC Cxx_obd_dc_mis_4_lpg_trs_h "" VALUE 0xa002f542 _REC_S1VAL_20_u1 9. _CNV_A_R_A_165_CM 1. 10. DISPLAY_IDENTIFIER fm_cal_mis_4_lpg_trs_h.Cxx_obd_dc_xxx /end CHARACTERISTIC
/begin CHARACTERISTIC Cxx_dtc_obd_mis_4_trs_h "" VALUE 0xa002f54a _REC_S1VAL_20_u2 65535. _CNV_A_R_A_165_CM 0. 65535. DISPLAY_IDENTIFIER fm_cal_mis_4_trs_h.Cxx_dtc_obd_xxx /end CHARACTERISTIC
/begin CHARACTERISTIC Cxx_conf_wal_mis_4_trs_h "" VALUE 0xa002f54c _REC_S1VAL_20_u1 3. _CNV_A_R_A_165_CM 0. 3. DISPLAY_IDENTIFIER fm_cal_mis_4_trs_h.fm_static_bitfield.Cxx_conf_wal_xxx BIT_MASK 0x3 /end CHARACTERISTIC
/begin CHARACTERISTIC Cbx_obd_mis_4_trs_h "" VALUE 0xa002f54c _REC_S1VAL_20_u1 255. _CNV_A_R_A_165_CM 0. 255. DISPLAY_IDENTIFIER fm_cal_mis_4_trs_h.fm_static_bitfield.Cbx_obd_xxx BIT_MASK 0x4 /end CHARACTERISTIC
/begin CHARACTERISTIC Cbx_obd_mena_mis_4_trs_h "" VALUE 0xa002f54c _REC_S1VAL_20_u1 255. _CNV_A_R_A_165_CM 0. 255. DISPLAY_IDENTIFIER fm_cal_mis_4_trs_h.fm_static_bitfield.Cbx_obd_mena_xxx BIT_MASK 0x8 /end CHARACTERISTIC
/begin CHARACTERISTIC Cxx_dtc_lb_mis_4_trs_h "" VALUE 0xa002f54d _REC_S1VAL_20_u1 255. _CNV_A_R_A_165_CM 0. 255. DISPLAY_IDENTIFIER fm_cal_mis_4_trs_h.Cxx_dtc_lb_xxx /end CHARACTERISTIC
/begin CHARACTERISTIC Cxx_obd_dc_mis_4_trs_h "" VALUE 0xa002f54e _REC_S1VAL_20_u1 9. _CNV_A_R_A_165_CM 1. 10. DISPLAY_IDENTIFIER fm_cal_mis_4_trs_h.Cxx_obd_dc_xxx /end CHARACTERISTIC
/begin CHARACTERISTIC Cxx_dtc_obd_mis_cata "" VALUE 0xa002f556 _REC_S1VAL_20_u2 65535. _CNV_A_R_A_165_CM 0. 65535. DISPLAY_IDENTIFIER fm_cal_mis_cata.Cxx_dtc_obd_xxx /end CHARACTERISTIC
/begin CHARACTERISTIC Cxx_conf_wal_mis_cata "" VALUE 0xa002f558 _REC_S1VAL_20_u1 3. _CNV_A_R_A_165_CM 0. 3. DISPLAY_IDENTIFIER fm_cal_mis_cata.fm_static_bitfield.Cxx_conf_wal_xxx BIT_MASK 0x3 /end CHARACTERISTIC
/begin CHARACTERISTIC Cbx_obd_mis_cata "" VALUE 0xa002f558 _REC_S1VAL_20_u1 255. _CNV_A_R_A_165_CM 0. 255. DISPLAY_IDENTIFIER fm_cal_mis_cata.fm_static_bitfield.Cbx_obd_xxx BIT_MASK 0x4 /end CHARACTERISTIC
/begin CHARACTERISTIC Cbx_obd_mena_mis_cata "" VALUE 0xa002f558 _REC_S1VAL_20_u1 255. _CNV_A_R_A_165_CM 0. 255. DISPLAY_IDENTIFIER fm_cal_mis_cata.fm_static_bitfield.Cbx_obd_mena_xxx BIT_MASK 0x8 /end CHARACTERISTIC
/begin CHARACTERISTIC Cxx_dtc_lb_mis_cata "" VALUE 0xa002f559 _REC_S1VAL_20_u1 255. _CNV_A_R_A_165_CM 0. 255. DISPLAY_IDENTIFIER fm_cal_mis_cata.Cxx_dtc_lb_xxx /end CHARACTERISTIC
/begin CHARACTERISTIC Cxx_obd_dc_mis_cata "" VALUE 0xa002f55a _REC_S1VAL_20_u1 9. _CNV_A_R_A_165_CM 1. 10. DISPLAY_IDENTIFIER fm_cal_mis_cata.Cxx_obd_dc_xxx /end CHARACTERISTIC
/begin CHARACTERISTIC Cxx_dtc_obd_mis_lpg_cata "" VALUE 0xa002f562 _REC_S1VAL_20_u2 65535. _CNV_A_R_A_165_CM 0. 65535. DISPLAY_IDENTIFIER fm_cal_mis_lpg_cata.Cxx_dtc_obd_xxx /end CHARACTERISTIC
/begin CHARACTERISTIC Cxx_conf_wal_mis_lpg_cata "" VALUE 0xa002f564 _REC_S1VAL_20_u1 3. _CNV_A_R_A_165_CM 0. 3. DISPLAY_IDENTIFIER fm_cal_mis_lpg_cata.fm_static_bitfield.Cxx_conf_wal_xxx BIT_MASK 0x3 /end CHARACTERISTIC
/begin CHARACTERISTIC Cbx_obd_mis_lpg_cata "" VALUE 0xa002f564 _REC_S1VAL_20_u1 255. _CNV_A_R_A_165_CM 0. 255. DISPLAY_IDENTIFIER fm_cal_mis_lpg_cata.fm_static_bitfield.Cbx_obd_xxx BIT_MASK 0x4 /end CHARACTERISTIC
/begin CHARACTERISTIC Cbx_obd_mena_mis_lpg_cata "" VALUE 0xa002f564 _REC_S1VAL_20_u1 255. _CNV_A_R_A_165_CM 0. 255. DISPLAY_IDENTIFIER fm_cal_mis_lpg_cata.fm_static_bitfield.Cbx_obd_mena_xxx BIT_MASK 0x8 /end CHARACTERISTIC
/begin CHARACTERISTIC Cxx_dtc_lb_mis_lpg_cata "" VALUE 0xa002f565 _REC_S1VAL_20_u1 255. _CNV_A_R_A_165_CM 0. 255. DISPLAY_IDENTIFIER fm_cal_mis_lpg_cata.Cxx_dtc_lb_xxx /end CHARACTERISTIC
/begin CHARACTERISTIC Cxx_obd_dc_mis_lpg_cata "" VALUE 0xa002f566 _REC_S1VAL_20_u1 9. _CNV_A_R_A_165_CM 1. 10. DISPLAY_IDENTIFIER fm_cal_mis_lpg_cata.Cxx_obd_dc_xxx /end CHARACTERISTIC
/begin CHARACTERISTIC Cxx_dtc_obd_mis_lpg_trs_h "" VALUE 0xa002f56e _REC_S1VAL_20_u2 65535. _CNV_A_R_A_165_CM 0. 65535. DISPLAY_IDENTIFIER fm_cal_mis_lpg_trs_h.Cxx_dtc_obd_xxx /end CHARACTERISTIC
/begin CHARACTERISTIC Cxx_conf_wal_mis_lpg_trs_h "" VALUE 0xa002f570 _REC_S1VAL_20_u1 3. _CNV_A_R_A_165_CM 0. 3. DISPLAY_IDENTIFIER fm_cal_mis_lpg_trs_h.fm_static_bitfield.Cxx_conf_wal_xxx BIT_MASK 0x3 /end CHARACTERISTIC
/begin CHARACTERISTIC Cbx_obd_mis_lpg_trs_h "" VALUE 0xa002f570 _REC_S1VAL_20_u1 255. _CNV_A_R_A_165_CM 0. 255. DISPLAY_IDENTIFIER fm_cal_mis_lpg_trs_h.fm_static_bitfield.Cbx_obd_xxx BIT_MASK 0x4 /end CHARACTERISTIC
/begin CHARACTERISTIC Cbx_obd_mena_mis_lpg_trs_h "" VALUE 0xa002f570 _REC_S1VAL_20_u1 255. _CNV_A_R_A_165_CM 0. 255. DISPLAY_IDENTIFIER fm_cal_mis_lpg_trs_h.fm_static_bitfield.Cbx_obd_mena_xxx BIT_MASK 0x8 /end CHARACTERISTIC
/begin CHARACTERISTIC Cxx_dtc_lb_mis_lpg_trs_h "" VALUE 0xa002f571 _REC_S1VAL_20_u1 255. _CNV_A_R_A_165_CM 0. 255. DISPLAY_IDENTIFIER fm_cal_mis_lpg_trs_h.Cxx_dtc_lb_xxx /end CHARACTERISTIC
/begin CHARACTERISTIC Cxx_obd_dc_mis_lpg_trs_h "" VALUE 0xa002f572 _REC_S1VAL_20_u1 9. _CNV_A_R_A_165_CM 1. 10. DISPLAY_IDENTIFIER fm_cal_mis_lpg_trs_h.Cxx_obd_dc_xxx /end CHARACTERISTIC
/begin CHARACTERISTIC Cxx_dtc_obd_mis_min_fuel_cata "" VALUE 0xa002f57a _REC_S1VAL_20_u2 65535. _CNV_A_R_A_165_CM 0. 65535. DISPLAY_IDENTIFIER fm_cal_mis_min_fuel_cata.Cxx_dtc_obd_xxx /end CHARACTERISTIC
/begin CHARACTERISTIC Cxx_conf_wal_mis_min_fuel_cata "" VALUE 0xa002f57c _REC_S1VAL_20_u1 3. _CNV_A_R_A_165_CM 0. 3. DISPLAY_IDENTIFIER fm_cal_mis_min_fuel_cata.fm_static_bitfield.Cxx_conf_wal_xxx BIT_MASK 0x3 /end CHARACTERISTIC
/begin CHARACTERISTIC Cbx_obd_mis_min_fuel_cata "" VALUE 0xa002f57c _REC_S1VAL_20_u1 255. _CNV_A_R_A_165_CM 0. 255. DISPLAY_IDENTIFIER fm_cal_mis_min_fuel_cata.fm_static_bitfield.Cbx_obd_xxx BIT_MASK 0x4 /end CHARACTERISTIC
/begin CHARACTERISTIC Cbx_obd_mena_mis_min_fuel_cata "" VALUE 0xa002f57c _REC_S1VAL_20_u1 255. _CNV_A_R_A_165_CM 0. 255. DISPLAY_IDENTIFIER fm_cal_mis_min_fuel_cata.fm_static_bitfield.Cbx_obd_mena_xxx BIT_MASK 0x8 /end CHARACTERISTIC
/begin CHARACTERISTIC Cxx_dtc_lb_mis_min_fuel_cata "" VALUE 0xa002f57d _REC_S1VAL_20_u1 255. _CNV_A_R_A_165_CM 0. 255. DISPLAY_IDENTIFIER fm_cal_mis_min_fuel_cata.Cxx_dtc_lb_xxx /end CHARACTERISTIC
/begin CHARACTERISTIC Cxx_obd_dc_mis_min_fuel_cata "" VALUE 0xa002f57e _REC_S1VAL_20_u1 9. _CNV_A_R_A_165_CM 1. 10. DISPLAY_IDENTIFIER fm_cal_mis_min_fuel_cata.Cxx_obd_dc_xxx /end CHARACTERISTIC
/begin CHARACTERISTIC Cxx_dtc_obd_mis_min_fuel_trs_h "" VALUE 0xa002f586 _REC_S1VAL_20_u2 65535. _CNV_A_R_A_165_CM 0. 65535. DISPLAY_IDENTIFIER fm_cal_mis_min_fuel_trs_h.Cxx_dtc_obd_xxx /end CHARACTERISTIC
/begin CHARACTERISTIC Cxx_conf_wal_mis_min_fuel_trs_h "" VALUE 0xa002f588 _REC_S1VAL_20_u1 3. _CNV_A_R_A_165_CM 0. 3. DISPLAY_IDENTIFIER fm_cal_mis_min_fuel_trs_h.fm_static_bitfield.Cxx_conf_wal_xxx BIT_MASK 0x3 /end CHARACTERISTIC
/begin CHARACTERISTIC Cbx_obd_mis_min_fuel_trs_h "" VALUE 0xa002f588 _REC_S1VAL_20_u1 255. _CNV_A_R_A_165_CM 0. 255. DISPLAY_IDENTIFIER fm_cal_mis_min_fuel_trs_h.fm_static_bitfield.Cbx_obd_xxx BIT_MASK 0x4 /end CHARACTERISTIC
/begin CHARACTERISTIC Cbx_obd_mena_mis_min_fuel_trs_h "" VALUE 0xa002f588 _REC_S1VAL_20_u1 255. _CNV_A_R_A_165_CM 0. 255. DISPLAY_IDENTIFIER fm_cal_mis_min_fuel_trs_h.fm_static_bitfield.Cbx_obd_mena_xxx BIT_MASK 0x8 /end CHARACTERISTIC
/begin CHARACTERISTIC Cxx_dtc_lb_mis_min_fuel_trs_h "" VALUE 0xa002f589 _REC_S1VAL_20_u1 255. _CNV_A_R_A_165_CM 0. 255. DISPLAY_IDENTIFIER fm_cal_mis_min_fuel_trs_h.Cxx_dtc_lb_xxx /end CHARACTERISTIC
/begin CHARACTERISTIC Cxx_obd_dc_mis_min_fuel_trs_h "" VALUE 0xa002f58a _REC_S1VAL_20_u1 9. _CNV_A_R_A_165_CM 1. 10. DISPLAY_IDENTIFIER fm_cal_mis_min_fuel_trs_h.Cxx_obd_dc_xxx /end CHARACTERISTIC
/begin CHARACTERISTIC Cxx_dtc_obd_mis_trs_h "" VALUE 0xa002f592 _REC_S1VAL_20_u2 65535. _CNV_A_R_A_165_CM 0. 65535. DISPLAY_IDENTIFIER fm_cal_mis_trs_h.Cxx_dtc_obd_xxx /end CHARACTERISTIC
/begin CHARACTERISTIC Cxx_conf_wal_mis_trs_h "" VALUE 0xa002f594 _REC_S1VAL_20_u1 3. _CNV_A_R_A_165_CM 0. 3. DISPLAY_IDENTIFIER fm_cal_mis_trs_h.fm_static_bitfield.Cxx_conf_wal_xxx BIT_MASK 0x3 /end CHARACTERISTIC
/begin CHARACTERISTIC Cbx_obd_mis_trs_h "" VALUE 0xa002f594 _REC_S1VAL_20_u1 255. _CNV_A_R_A_165_CM 0. 255. DISPLAY_IDENTIFIER fm_cal_mis_trs_h.fm_static_bitfield.Cbx_obd_xxx BIT_MASK 0x4 /end CHARACTERISTIC
/begin CHARACTERISTIC Cbx_obd_mena_mis_trs_h "" VALUE 0xa002f594 _REC_S1VAL_20_u1 255. _CNV_A_R_A_165_CM 0. 255. DISPLAY_IDENTIFIER fm_cal_mis_trs_h.fm_static_bitfield.Cbx_obd_mena_xxx BIT_MASK 0x8 /end CHARACTERISTIC
/begin CHARACTERISTIC Cxx_dtc_lb_mis_trs_h "" VALUE 0xa002f595 _REC_S1VAL_20_u1 255. _CNV_A_R_A_165_CM 0. 255. DISPLAY_IDENTIFIER fm_cal_mis_trs_h.Cxx_dtc_lb_xxx /end CHARACTERISTIC
/begin CHARACTERISTIC Cxx_obd_dc_mis_trs_h "" VALUE 0xa002f596 _REC_S1VAL_20_u1 9. _CNV_A_R_A_165_CM 1. 10. DISPLAY_IDENTIFIER fm_cal_mis_trs_h.Cxx_obd_dc_xxx /end CHARACTERISTIC
/begin CHARACTERISTIC Cxx_dtc_obd_mis_unk_cata "" VALUE 0xa002f59e _REC_S1VAL_20_u2 65535. _CNV_A_R_A_165_CM 0. 65535. DISPLAY_IDENTIFIER fm_cal_mis_unk_cata.Cxx_dtc_obd_xxx /end CHARACTERISTIC
/begin CHARACTERISTIC Cxx_conf_wal_mis_unk_cata "" VALUE 0xa002f5a0 _REC_S1VAL_20_u1 3. _CNV_A_R_A_165_CM 0. 3. DISPLAY_IDENTIFIER fm_cal_mis_unk_cata.fm_static_bitfield.Cxx_conf_wal_xxx BIT_MASK 0x3 /end CHARACTERISTIC
/begin CHARACTERISTIC Cbx_obd_mis_unk_cata "" VALUE 0xa002f5a0 _REC_S1VAL_20_u1 255. _CNV_A_R_A_165_CM 0. 255. DISPLAY_IDENTIFIER fm_cal_mis_unk_cata.fm_static_bitfield.Cbx_obd_xxx BIT_MASK 0x4 /end CHARACTERISTIC
/begin CHARACTERISTIC Cbx_obd_mena_mis_unk_cata "" VALUE 0xa002f5a0 _REC_S1VAL_20_u1 255. _CNV_A_R_A_165_CM 0. 255. DISPLAY_IDENTIFIER fm_cal_mis_unk_cata.fm_static_bitfield.Cbx_obd_mena_xxx BIT_MASK 0x8 /end CHARACTERISTIC
/begin CHARACTERISTIC Cxx_dtc_lb_mis_unk_cata "" VALUE 0xa002f5a1 _REC_S1VAL_20_u1 255. _CNV_A_R_A_165_CM 0. 255. DISPLAY_IDENTIFIER fm_cal_mis_unk_cata.Cxx_dtc_lb_xxx /end CHARACTERISTIC
/begin CHARACTERISTIC Cxx_obd_dc_mis_unk_cata "" VALUE 0xa002f5a2 _REC_S1VAL_20_u1 9. _CNV_A_R_A_165_CM 1. 10. DISPLAY_IDENTIFIER fm_cal_mis_unk_cata.Cxx_obd_dc_xxx /end CHARACTERISTIC
/begin CHARACTERISTIC Cxx_dtc_obd_mis_unk_lpg_cata "" VALUE 0xa002f5aa _REC_S1VAL_20_u2 65535. _CNV_A_R_A_165_CM 0. 65535. DISPLAY_IDENTIFIER fm_cal_mis_unk_lpg_cata.Cxx_dtc_obd_xxx /end CHARACTERISTIC
/begin CHARACTERISTIC Cxx_conf_wal_mis_unk_lpg_cata "" VALUE 0xa002f5ac _REC_S1VAL_20_u1 3. _CNV_A_R_A_165_CM 0. 3. DISPLAY_IDENTIFIER fm_cal_mis_unk_lpg_cata.fm_static_bitfield.Cxx_conf_wal_xxx BIT_MASK 0x3 /end CHARACTERISTIC
/begin CHARACTERISTIC Cbx_obd_mis_unk_lpg_cata "" VALUE 0xa002f5ac _REC_S1VAL_20_u1 255. _CNV_A_R_A_165_CM 0. 255. DISPLAY_IDENTIFIER fm_cal_mis_unk_lpg_cata.fm_static_bitfield.Cbx_obd_xxx BIT_MASK 0x4 /end CHARACTERISTIC
/begin CHARACTERISTIC Cbx_obd_mena_mis_unk_lpg_cata "" VALUE 0xa002f5ac _REC_S1VAL_20_u1 255. _CNV_A_R_A_165_CM 0. 255. DISPLAY_IDENTIFIER fm_cal_mis_unk_lpg_cata.fm_static_bitfield.Cbx_obd_mena_xxx BIT_MASK 0x8 /end CHARACTERISTIC
/begin CHARACTERISTIC Cxx_dtc_lb_mis_unk_lpg_cata "" VALUE 0xa002f5ad _REC_S1VAL_20_u1 255. _CNV_A_R_A_165_CM 0. 255. DISPLAY_IDENTIFIER fm_cal_mis_unk_lpg_cata.Cxx_dtc_lb_xxx /end CHARACTERISTIC
/begin CHARACTERISTIC Cxx_obd_dc_mis_unk_lpg_cata "" VALUE 0xa002f5ae _REC_S1VAL_20_u1 9. _CNV_A_R_A_165_CM 1. 10. DISPLAY_IDENTIFIER fm_cal_mis_unk_lpg_cata.Cxx_obd_dc_xxx /end CHARACTERISTIC
/begin CHARACTERISTIC Cxx_dtc_obd_mis_unk_lpg_trs_h "" VALUE 0xa002f5b6 _REC_S1VAL_20_u2 65535. _CNV_A_R_A_165_CM 0. 65535. DISPLAY_IDENTIFIER fm_cal_mis_unk_lpg_trs_h.Cxx_dtc_obd_xxx /end CHARACTERISTIC
/begin CHARACTERISTIC Cxx_conf_wal_mis_unk_lpg_trs_h "" VALUE 0xa002f5b8 _REC_S1VAL_20_u1 3. _CNV_A_R_A_165_CM 0. 3. DISPLAY_IDENTIFIER fm_cal_mis_unk_lpg_trs_h.fm_static_bitfield.Cxx_conf_wal_xxx BIT_MASK 0x3 /end CHARACTERISTIC
/begin CHARACTERISTIC Cbx_obd_mis_unk_lpg_trs_h "" VALUE 0xa002f5b8 _REC_S1VAL_20_u1 255. _CNV_A_R_A_165_CM 0. 255. DISPLAY_IDENTIFIER fm_cal_mis_unk_lpg_trs_h.fm_static_bitfield.Cbx_obd_xxx BIT_MASK 0x4 /end CHARACTERISTIC
/begin CHARACTERISTIC Cbx_obd_mena_mis_unk_lpg_trs_h "" VALUE 0xa002f5b8 _REC_S1VAL_20_u1 255. _CNV_A_R_A_165_CM 0. 255. DISPLAY_IDENTIFIER fm_cal_mis_unk_lpg_trs_h.fm_static_bitfield.Cbx_obd_mena_xxx BIT_MASK 0x8 /end CHARACTERISTIC
/begin CHARACTERISTIC Cxx_dtc_lb_mis_unk_lpg_trs_h "" VALUE 0xa002f5b9 _REC_S1VAL_20_u1 255. _CNV_A_R_A_165_CM 0. 255. DISPLAY_IDENTIFIER fm_cal_mis_unk_lpg_trs_h.Cxx_dtc_lb_xxx /end CHARACTERISTIC
/begin CHARACTERISTIC Cxx_obd_dc_mis_unk_lpg_trs_h "" VALUE 0xa002f5ba _REC_S1VAL_20_u1 9. _CNV_A_R_A_165_CM 1. 10. DISPLAY_IDENTIFIER fm_cal_mis_unk_lpg_trs_h.Cxx_obd_dc_xxx /end CHARACTERISTIC
/begin CHARACTERISTIC Cxx_dtc_obd_mis_unk_trs_h "" VALUE 0xa002f5c2 _REC_S1VAL_20_u2 65535. _CNV_A_R_A_165_CM 0. 65535. DISPLAY_IDENTIFIER fm_cal_mis_unk_trs_h.Cxx_dtc_obd_xxx /end CHARACTERISTIC
/begin CHARACTERISTIC Cxx_conf_wal_mis_unk_trs_h "" VALUE 0xa002f5c4 _REC_S1VAL_20_u1 3. _CNV_A_R_A_165_CM 0. 3. DISPLAY_IDENTIFIER fm_cal_mis_unk_trs_h.fm_static_bitfield.Cxx_conf_wal_xxx BIT_MASK 0x3 /end CHARACTERISTIC
/begin CHARACTERISTIC Cbx_obd_mis_unk_trs_h "" VALUE 0xa002f5c4 _REC_S1VAL_20_u1 255. _CNV_A_R_A_165_CM 0. 255. DISPLAY_IDENTIFIER fm_cal_mis_unk_trs_h.fm_static_bitfield.Cbx_obd_xxx BIT_MASK 0x4 /end CHARACTERISTIC
/begin CHARACTERISTIC Cbx_obd_mena_mis_unk_trs_h "" VALUE 0xa002f5c4 _REC_S1VAL_20_u1 255. _CNV_A_R_A_165_CM 0. 255. DISPLAY_IDENTIFIER fm_cal_mis_unk_trs_h.fm_static_bitfield.Cbx_obd_mena_xxx BIT_MASK 0x8 /end CHARACTERISTIC
/begin CHARACTERISTIC Cxx_dtc_lb_mis_unk_trs_h "" VALUE 0xa002f5c5 _REC_S1VAL_20_u1 255. _CNV_A_R_A_165_CM 0. 255. DISPLAY_IDENTIFIER fm_cal_mis_unk_trs_h.Cxx_dtc_lb_xxx /end CHARACTERISTIC
/begin CHARACTERISTIC Cxx_obd_dc_mis_unk_trs_h "" VALUE 0xa002f5c6 _REC_S1VAL_20_u1 9. _CNV_A_R_A_165_CM 1. 10. DISPLAY_IDENTIFIER fm_cal_mis_unk_trs_h.Cxx_obd_dc_xxx /end CHARACTERISTIC
/begin CHARACTERISTIC Cxx_conf_wal_ptc_rov_oc "" VALUE 0xa002f6f0 _REC_S1VAL_20_u1 3. _CNV_A_R_A_165_CM 0. 3. DISPLAY_IDENTIFIER fm_cal_ptc_rov_oc.fm_static_bitfield.Cxx_conf_wal_xxx BIT_MASK 0x3 /end CHARACTERISTIC
/begin CHARACTERISTIC Cxx_dtc_lb_ptc_rov_oc "" VALUE 0xa002f6f1 _REC_S1VAL_20_u1 255. _CNV_A_R_A_165_CM 0. 255. DISPLAY_IDENTIFIER fm_cal_ptc_rov_oc.Cxx_dtc_lb_xxx /end CHARACTERISTIC
/begin CHARACTERISTIC Cxx_conf_wal_ptc_rov_scg "" VALUE 0xa002f6fc _REC_S1VAL_20_u1 3. _CNV_A_R_A_165_CM 0. 3. DISPLAY_IDENTIFIER fm_cal_ptc_rov_scg.fm_static_bitfield.Cxx_conf_wal_xxx BIT_MASK 0x3 /end CHARACTERISTIC
/begin CHARACTERISTIC Cxx_dtc_lb_ptc_rov_scg "" VALUE 0xa002f6fd _REC_S1VAL_20_u1 255. _CNV_A_R_A_165_CM 0. 255. DISPLAY_IDENTIFIER fm_cal_ptc_rov_scg.Cxx_dtc_lb_xxx /end CHARACTERISTIC
/begin CHARACTERISTIC Cxx_conf_wal_ptc_rov_scw "" VALUE 0xa002f708 _REC_S1VAL_20_u1 3. _CNV_A_R_A_165_CM 0. 3. DISPLAY_IDENTIFIER fm_cal_ptc_rov_scw.fm_static_bitfield.Cxx_conf_wal_xxx BIT_MASK 0x3 /end CHARACTERISTIC
/begin CHARACTERISTIC Cxx_dtc_lb_ptc_rov_scw "" VALUE 0xa002f709 _REC_S1VAL_20_u1 255. _CNV_A_R_A_165_CM 0. 255. DISPLAY_IDENTIFIER fm_cal_ptc_rov_scw.Cxx_dtc_lb_xxx /end CHARACTERISTIC
/begin CHARACTERISTIC Cxx_dtc_obd_pws_1_h "" VALUE 0xa002f262 _REC_S1VAL_20_u2 65535. _CNV_A_R_A_165_CM 0. 65535. DISPLAY_IDENTIFIER fm_cal_pws_1_h.Cxx_dtc_obd_xxx /end CHARACTERISTIC
/begin CHARACTERISTIC Cxx_conf_wal_pws_1_h "" VALUE 0xa002f264 _REC_S1VAL_20_u1 3. _CNV_A_R_A_165_CM 0. 3. DISPLAY_IDENTIFIER fm_cal_pws_1_h.fm_static_bitfield.Cxx_conf_wal_xxx BIT_MASK 0x3 /end CHARACTERISTIC
/begin CHARACTERISTIC Cbx_obd_pws_1_h "" VALUE 0xa002f264 _REC_S1VAL_20_u1 255. _CNV_A_R_A_165_CM 0. 255. DISPLAY_IDENTIFIER fm_cal_pws_1_h.fm_static_bitfield.Cbx_obd_xxx BIT_MASK 0x4 /end CHARACTERISTIC
/begin CHARACTERISTIC Cbx_obd_mena_pws_1_h "" VALUE 0xa002f264 _REC_S1VAL_20_u1 255. _CNV_A_R_A_165_CM 0. 255. DISPLAY_IDENTIFIER fm_cal_pws_1_h.fm_static_bitfield.Cbx_obd_mena_xxx BIT_MASK 0x8 /end CHARACTERISTIC
/begin CHARACTERISTIC Cxx_dtc_lb_pws_1_h "" VALUE 0xa002f265 _REC_S1VAL_20_u1 255. _CNV_A_R_A_165_CM 0. 255. DISPLAY_IDENTIFIER fm_cal_pws_1_h.Cxx_dtc_lb_xxx /end CHARACTERISTIC
/begin CHARACTERISTIC Cxx_obd_dc_pws_1_h "" VALUE 0xa002f266 _REC_S1VAL_20_u1 9. _CNV_A_R_A_165_CM 1. 10. DISPLAY_IDENTIFIER fm_cal_pws_1_h.Cxx_obd_dc_xxx /end CHARACTERISTIC
/begin CHARACTERISTIC Cxx_dtc_obd_pws_1_l "" VALUE 0xa002f26e _REC_S1VAL_20_u2 65535. _CNV_A_R_A_165_CM 0. 65535. DISPLAY_IDENTIFIER fm_cal_pws_1_l.Cxx_dtc_obd_xxx /end CHARACTERISTIC
/begin CHARACTERISTIC Cxx_conf_wal_pws_1_l "" VALUE 0xa002f270 _REC_S1VAL_20_u1 3. _CNV_A_R_A_165_CM 0. 3. DISPLAY_IDENTIFIER fm_cal_pws_1_l.fm_static_bitfield.Cxx_conf_wal_xxx BIT_MASK 0x3 /end CHARACTERISTIC
/begin CHARACTERISTIC Cbx_obd_pws_1_l "" VALUE 0xa002f270 _REC_S1VAL_20_u1 255. _CNV_A_R_A_165_CM 0. 255. DISPLAY_IDENTIFIER fm_cal_pws_1_l.fm_static_bitfield.Cbx_obd_xxx BIT_MASK 0x4 /end CHARACTERISTIC
/begin CHARACTERISTIC Cbx_obd_mena_pws_1_l "" VALUE 0xa002f270 _REC_S1VAL_20_u1 255. _CNV_A_R_A_165_CM 0. 255. DISPLAY_IDENTIFIER fm_cal_pws_1_l.fm_static_bitfield.Cbx_obd_mena_xxx BIT_MASK 0x8 /end CHARACTERISTIC
/begin CHARACTERISTIC Cxx_dtc_lb_pws_1_l "" VALUE 0xa002f271 _REC_S1VAL_20_u1 255. _CNV_A_R_A_165_CM 0. 255. DISPLAY_IDENTIFIER fm_cal_pws_1_l.Cxx_dtc_lb_xxx /end CHARACTERISTIC
/begin CHARACTERISTIC Cxx_obd_dc_pws_1_l "" VALUE 0xa002f272 _REC_S1VAL_20_u1 9. _CNV_A_R_A_165_CM 1. 10. DISPLAY_IDENTIFIER fm_cal_pws_1_l.Cxx_obd_dc_xxx /end CHARACTERISTIC
/begin CHARACTERISTIC Cxx_dtc_obd_pws_2_h "" VALUE 0xa002f27a _REC_S1VAL_20_u2 65535. _CNV_A_R_A_165_CM 0. 65535. DISPLAY_IDENTIFIER fm_cal_pws_2_h.Cxx_dtc_obd_xxx /end CHARACTERISTIC
/begin CHARACTERISTIC Cxx_conf_wal_pws_2_h "" VALUE 0xa002f27c _REC_S1VAL_20_u1 3. _CNV_A_R_A_165_CM 0. 3. DISPLAY_IDENTIFIER fm_cal_pws_2_h.fm_static_bitfield.Cxx_conf_wal_xxx BIT_MASK 0x3 /end CHARACTERISTIC
/begin CHARACTERISTIC Cbx_obd_pws_2_h "" VALUE 0xa002f27c _REC_S1VAL_20_u1 255. _CNV_A_R_A_165_CM 0. 255. DISPLAY_IDENTIFIER fm_cal_pws_2_h.fm_static_bitfield.Cbx_obd_xxx BIT_MASK 0x4 /end CHARACTERISTIC
/begin CHARACTERISTIC Cbx_obd_mena_pws_2_h "" VALUE 0xa002f27c _REC_S1VAL_20_u1 255. _CNV_A_R_A_165_CM 0. 255. DISPLAY_IDENTIFIER fm_cal_pws_2_h.fm_static_bitfield.Cbx_obd_mena_xxx BIT_MASK 0x8 /end CHARACTERISTIC
/begin CHARACTERISTIC Cxx_dtc_lb_pws_2_h "" VALUE 0xa002f27d _REC_S1VAL_20_u1 255. _CNV_A_R_A_165_CM 0. 255. DISPLAY_IDENTIFIER fm_cal_pws_2_h.Cxx_dtc_lb_xxx /end CHARACTERISTIC
/begin CHARACTERISTIC Cxx_obd_dc_pws_2_h "" VALUE 0xa002f27e _REC_S1VAL_20_u1 9. _CNV_A_R_A_165_CM 1. 10. DISPLAY_IDENTIFIER fm_cal_pws_2_h.Cxx_obd_dc_xxx /end CHARACTERISTIC
/begin CHARACTERISTIC Cxx_dtc_obd_pws_2_l "" VALUE 0xa002f286 _REC_S1VAL_20_u2 65535. _CNV_A_R_A_165_CM 0. 65535. DISPLAY_IDENTIFIER fm_cal_pws_2_l.Cxx_dtc_obd_xxx /end CHARACTERISTIC
/begin CHARACTERISTIC Cxx_conf_wal_pws_2_l "" VALUE 0xa002f288 _REC_S1VAL_20_u1 3. _CNV_A_R_A_165_CM 0. 3. DISPLAY_IDENTIFIER fm_cal_pws_2_l.fm_static_bitfield.Cxx_conf_wal_xxx BIT_MASK 0x3 /end CHARACTERISTIC
/begin CHARACTERISTIC Cbx_obd_pws_2_l "" VALUE 0xa002f288 _REC_S1VAL_20_u1 255. _CNV_A_R_A_165_CM 0. 255. DISPLAY_IDENTIFIER fm_cal_pws_2_l.fm_static_bitfield.Cbx_obd_xxx BIT_MASK 0x4 /end CHARACTERISTIC
/begin CHARACTERISTIC Cbx_obd_mena_pws_2_l "" VALUE 0xa002f288 _REC_S1VAL_20_u1 255. _CNV_A_R_A_165_CM 0. 255. DISPLAY_IDENTIFIER fm_cal_pws_2_l.fm_static_bitfield.Cbx_obd_mena_xxx BIT_MASK 0x8 /end CHARACTERISTIC
/begin CHARACTERISTIC Cxx_dtc_lb_pws_2_l "" VALUE 0xa002f289 _REC_S1VAL_20_u1 255. _CNV_A_R_A_165_CM 0. 255. DISPLAY_IDENTIFIER fm_cal_pws_2_l.Cxx_dtc_lb_xxx /end CHARACTERISTIC
/begin CHARACTERISTIC Cxx_obd_dc_pws_2_l "" VALUE 0xa002f28a _REC_S1VAL_20_u1 9. _CNV_A_R_A_165_CM 1. 10. DISPLAY_IDENTIFIER fm_cal_pws_2_l.Cxx_obd_dc_xxx /end CHARACTERISTIC
/begin CHARACTERISTIC Cxx_dtc_obd_pws_3_h "" VALUE 0xa002f292 _REC_S1VAL_20_u2 65535. _CNV_A_R_A_165_CM 0. 65535. DISPLAY_IDENTIFIER fm_cal_pws_3_h.Cxx_dtc_obd_xxx /end CHARACTERISTIC
/begin CHARACTERISTIC Cxx_conf_wal_pws_3_h "" VALUE 0xa002f294 _REC_S1VAL_20_u1 3. _CNV_A_R_A_165_CM 0. 3. DISPLAY_IDENTIFIER fm_cal_pws_3_h.fm_static_bitfield.Cxx_conf_wal_xxx BIT_MASK 0x3 /end CHARACTERISTIC
/begin CHARACTERISTIC Cbx_obd_pws_3_h "" VALUE 0xa002f294 _REC_S1VAL_20_u1 255. _CNV_A_R_A_165_CM 0. 255. DISPLAY_IDENTIFIER fm_cal_pws_3_h.fm_static_bitfield.Cbx_obd_xxx BIT_MASK 0x4 /end CHARACTERISTIC
/begin CHARACTERISTIC Cbx_obd_mena_pws_3_h "" VALUE 0xa002f294 _REC_S1VAL_20_u1 255. _CNV_A_R_A_165_CM 0. 255. DISPLAY_IDENTIFIER fm_cal_pws_3_h.fm_static_bitfield.Cbx_obd_mena_xxx BIT_MASK 0x8 /end CHARACTERISTIC
/begin CHARACTERISTIC Cxx_dtc_lb_pws_3_h "" VALUE 0xa002f295 _REC_S1VAL_20_u1 255. _CNV_A_R_A_165_CM 0. 255. DISPLAY_IDENTIFIER fm_cal_pws_3_h.Cxx_dtc_lb_xxx /end CHARACTERISTIC
/begin CHARACTERISTIC Cxx_obd_dc_pws_3_h "" VALUE 0xa002f296 _REC_S1VAL_20_u1 9. _CNV_A_R_A_165_CM 1. 10. DISPLAY_IDENTIFIER fm_cal_pws_3_h.Cxx_obd_dc_xxx /end CHARACTERISTIC
/begin CHARACTERISTIC Cxx_dtc_obd_pws_3_l "" VALUE 0xa002f29e _REC_S1VAL_20_u2 65535. _CNV_A_R_A_165_CM 0. 65535. DISPLAY_IDENTIFIER fm_cal_pws_3_l.Cxx_dtc_obd_xxx /end CHARACTERISTIC
/begin CHARACTERISTIC Cxx_conf_wal_pws_3_l "" VALUE 0xa002f2a0 _REC_S1VAL_20_u1 3. _CNV_A_R_A_165_CM 0. 3. DISPLAY_IDENTIFIER fm_cal_pws_3_l.fm_static_bitfield.Cxx_conf_wal_xxx BIT_MASK 0x3 /end CHARACTERISTIC
/begin CHARACTERISTIC Cbx_obd_pws_3_l "" VALUE 0xa002f2a0 _REC_S1VAL_20_u1 255. _CNV_A_R_A_165_CM 0. 255. DISPLAY_IDENTIFIER fm_cal_pws_3_l.fm_static_bitfield.Cbx_obd_xxx BIT_MASK 0x4 /end CHARACTERISTIC
/begin CHARACTERISTIC Cbx_obd_mena_pws_3_l "" VALUE 0xa002f2a0 _REC_S1VAL_20_u1 255. _CNV_A_R_A_165_CM 0. 255. DISPLAY_IDENTIFIER fm_cal_pws_3_l.fm_static_bitfield.Cbx_obd_mena_xxx BIT_MASK 0x8 /end CHARACTERISTIC
/begin CHARACTERISTIC Cxx_dtc_lb_pws_3_l "" VALUE 0xa002f2a1 _REC_S1VAL_20_u1 255. _CNV_A_R_A_165_CM 0. 255. DISPLAY_IDENTIFIER fm_cal_pws_3_l.Cxx_dtc_lb_xxx /end CHARACTERISTIC
/begin CHARACTERISTIC Cxx_obd_dc_pws_3_l "" VALUE 0xa002f2a2 _REC_S1VAL_20_u1 9. _CNV_A_R_A_165_CM 1. 10. DISPLAY_IDENTIFIER fm_cal_pws_3_l.Cxx_obd_dc_xxx /end CHARACTERISTIC
/begin CHARACTERISTIC Cxx_dtc_obd_sens_it_1_nok "" VALUE 0xa002f2aa _REC_S1VAL_20_u2 65535. _CNV_A_R_A_165_CM 0. 65535. DISPLAY_IDENTIFIER fm_cal_sens_it_1_nok.Cxx_dtc_obd_xxx /end CHARACTERISTIC
/begin CHARACTERISTIC Cxx_conf_wal_sens_it_1_nok "" VALUE 0xa002f2ac _REC_S1VAL_20_u1 3. _CNV_A_R_A_165_CM 0. 3. DISPLAY_IDENTIFIER fm_cal_sens_it_1_nok.fm_static_bitfield.Cxx_conf_wal_xxx BIT_MASK 0x3 /end CHARACTERISTIC
/begin CHARACTERISTIC Cbx_obd_sens_it_1_nok "" VALUE 0xa002f2ac _REC_S1VAL_20_u1 255. _CNV_A_R_A_165_CM 0. 255. DISPLAY_IDENTIFIER fm_cal_sens_it_1_nok.fm_static_bitfield.Cbx_obd_xxx BIT_MASK 0x4 /end CHARACTERISTIC
/begin CHARACTERISTIC Cbx_obd_mena_sens_it_1_nok "" VALUE 0xa002f2ac _REC_S1VAL_20_u1 255. _CNV_A_R_A_165_CM 0. 255. DISPLAY_IDENTIFIER fm_cal_sens_it_1_nok.fm_static_bitfield.Cbx_obd_mena_xxx BIT_MASK 0x8 /end CHARACTERISTIC
/begin CHARACTERISTIC Cxx_dtc_lb_sens_it_1_nok "" VALUE 0xa002f2ad _REC_S1VAL_20_u1 255. _CNV_A_R_A_165_CM 0. 255. DISPLAY_IDENTIFIER fm_cal_sens_it_1_nok.Cxx_dtc_lb_xxx /end CHARACTERISTIC
/begin CHARACTERISTIC Cxx_obd_dc_sens_it_1_nok "" VALUE 0xa002f2ae _REC_S1VAL_20_u1 9. _CNV_A_R_A_165_CM 1. 10. DISPLAY_IDENTIFIER fm_cal_sens_it_1_nok.Cxx_obd_dc_xxx /end CHARACTERISTIC
/begin CHARACTERISTIC Cxx_dtc_obd_sens_it_2_nok "" VALUE 0xa002f2b6 _REC_S1VAL_20_u2 65535. _CNV_A_R_A_165_CM 0. 65535. DISPLAY_IDENTIFIER fm_cal_sens_it_2_nok.Cxx_dtc_obd_xxx /end CHARACTERISTIC
/begin CHARACTERISTIC Cxx_conf_wal_sens_it_2_nok "" VALUE 0xa002f2b8 _REC_S1VAL_20_u1 3. _CNV_A_R_A_165_CM 0. 3. DISPLAY_IDENTIFIER fm_cal_sens_it_2_nok.fm_static_bitfield.Cxx_conf_wal_xxx BIT_MASK 0x3 /end CHARACTERISTIC
/begin CHARACTERISTIC Cbx_obd_sens_it_2_nok "" VALUE 0xa002f2b8 _REC_S1VAL_20_u1 255. _CNV_A_R_A_165_CM 0. 255. DISPLAY_IDENTIFIER fm_cal_sens_it_2_nok.fm_static_bitfield.Cbx_obd_xxx BIT_MASK 0x4 /end CHARACTERISTIC
/begin CHARACTERISTIC Cbx_obd_mena_sens_it_2_nok "" VALUE 0xa002f2b8 _REC_S1VAL_20_u1 255. _CNV_A_R_A_165_CM 0. 255. DISPLAY_IDENTIFIER fm_cal_sens_it_2_nok.fm_static_bitfield.Cbx_obd_mena_xxx BIT_MASK 0x8 /end CHARACTERISTIC
/begin CHARACTERISTIC Cxx_dtc_lb_sens_it_2_nok "" VALUE 0xa002f2b9 _REC_S1VAL_20_u1 255. _CNV_A_R_A_165_CM 0. 255. DISPLAY_IDENTIFIER fm_cal_sens_it_2_nok.Cxx_dtc_lb_xxx /end CHARACTERISTIC
/begin CHARACTERISTIC Cxx_obd_dc_sens_it_2_nok "" VALUE 0xa002f2ba _REC_S1VAL_20_u1 9. _CNV_A_R_A_165_CM 1. 10. DISPLAY_IDENTIFIER fm_cal_sens_it_2_nok.Cxx_obd_dc_xxx /end CHARACTERISTIC
/begin CHARACTERISTIC Cxx_dtc_obd_sens_it_chr "" VALUE 0xa002f2c2 _REC_S1VAL_20_u2 65535. _CNV_A_R_A_165_CM 0. 65535. DISPLAY_IDENTIFIER fm_cal_sens_it_chr.Cxx_dtc_obd_xxx /end CHARACTERISTIC
/begin CHARACTERISTIC Cxx_conf_wal_sens_it_chr "" VALUE 0xa002f2c4 _REC_S1VAL_20_u1 3. _CNV_A_R_A_165_CM 0. 3. DISPLAY_IDENTIFIER fm_cal_sens_it_chr.fm_static_bitfield.Cxx_conf_wal_xxx BIT_MASK 0x3 /end CHARACTERISTIC
/begin CHARACTERISTIC Cbx_obd_sens_it_chr "" VALUE 0xa002f2c4 _REC_S1VAL_20_u1 255. _CNV_A_R_A_165_CM 0. 255. DISPLAY_IDENTIFIER fm_cal_sens_it_chr.fm_static_bitfield.Cbx_obd_xxx BIT_MASK 0x4 /end CHARACTERISTIC
/begin CHARACTERISTIC Cbx_obd_mena_sens_it_chr "" VALUE 0xa002f2c4 _REC_S1VAL_20_u1 255. _CNV_A_R_A_165_CM 0. 255. DISPLAY_IDENTIFIER fm_cal_sens_it_chr.fm_static_bitfield.Cbx_obd_mena_xxx BIT_MASK 0x8 /end CHARACTERISTIC
/begin CHARACTERISTIC Cxx_dtc_lb_sens_it_chr "" VALUE 0xa002f2c5 _REC_S1VAL_20_u1 255. _CNV_A_R_A_165_CM 0. 255. DISPLAY_IDENTIFIER fm_cal_sens_it_chr.Cxx_dtc_lb_xxx /end CHARACTERISTIC
/begin CHARACTERISTIC Cxx_obd_dc_sens_it_chr "" VALUE 0xa002f2c6 _REC_S1VAL_20_u1 9. _CNV_A_R_A_165_CM 1. 10. DISPLAY_IDENTIFIER fm_cal_sens_it_chr.Cxx_obd_dc_xxx /end CHARACTERISTIC
/begin CHARACTERISTIC Cxx_dtc_obd_sens_it_sig_mcut "" VALUE 0xa002f2ce _REC_S1VAL_20_u2 65535. _CNV_A_R_A_165_CM 0. 65535. DISPLAY_IDENTIFIER fm_cal_sens_it_sig_mcut.Cxx_dtc_obd_xxx /end CHARACTERISTIC
/begin CHARACTERISTIC Cxx_conf_wal_sens_it_sig_mcut "" VALUE 0xa002f2d0 _REC_S1VAL_20_u1 3. _CNV_A_R_A_165_CM 0. 3. DISPLAY_IDENTIFIER fm_cal_sens_it_sig_mcut.fm_static_bitfield.Cxx_conf_wal_xxx BIT_MASK 0x3 /end CHARACTERISTIC
/begin CHARACTERISTIC Cbx_obd_sens_it_sig_mcut "" VALUE 0xa002f2d0 _REC_S1VAL_20_u1 255. _CNV_A_R_A_165_CM 0. 255. DISPLAY_IDENTIFIER fm_cal_sens_it_sig_mcut.fm_static_bitfield.Cbx_obd_xxx BIT_MASK 0x4 /end CHARACTERISTIC
/begin CHARACTERISTIC Cbx_obd_mena_sens_it_sig_mcut "" VALUE 0xa002f2d0 _REC_S1VAL_20_u1 255. _CNV_A_R_A_165_CM 0. 255. DISPLAY_IDENTIFIER fm_cal_sens_it_sig_mcut.fm_static_bitfield.Cbx_obd_mena_xxx BIT_MASK 0x8 /end CHARACTERISTIC
/begin CHARACTERISTIC Cxx_dtc_lb_sens_it_sig_mcut "" VALUE 0xa002f2d1 _REC_S1VAL_20_u1 255. _CNV_A_R_A_165_CM 0. 255. DISPLAY_IDENTIFIER fm_cal_sens_it_sig_mcut.Cxx_dtc_lb_xxx /end CHARACTERISTIC
/begin CHARACTERISTIC Cxx_obd_dc_sens_it_sig_mcut "" VALUE 0xa002f2d2 _REC_S1VAL_20_u1 9. _CNV_A_R_A_165_CM 1. 10. DISPLAY_IDENTIFIER fm_cal_sens_it_sig_mcut.Cxx_obd_dc_xxx /end CHARACTERISTIC
/begin CHARACTERISTIC Cxx_dtc_obd_sens_map_h "" VALUE 0xa002f2da _REC_S1VAL_20_u2 65535. _CNV_A_R_A_165_CM 0. 65535. DISPLAY_IDENTIFIER fm_cal_sens_map_h.Cxx_dtc_obd_xxx /end CHARACTERISTIC
/begin CHARACTERISTIC Cxx_conf_wal_sens_map_h "" VALUE 0xa002f2dc _REC_S1VAL_20_u1 3. _CNV_A_R_A_165_CM 0. 3. DISPLAY_IDENTIFIER fm_cal_sens_map_h.fm_static_bitfield.Cxx_conf_wal_xxx BIT_MASK 0x3 /end CHARACTERISTIC
/begin CHARACTERISTIC Cbx_obd_sens_map_h "" VALUE 0xa002f2dc _REC_S1VAL_20_u1 255. _CNV_A_R_A_165_CM 0. 255. DISPLAY_IDENTIFIER fm_cal_sens_map_h.fm_static_bitfield.Cbx_obd_xxx BIT_MASK 0x4 /end CHARACTERISTIC
/begin CHARACTERISTIC Cbx_obd_mena_sens_map_h "" VALUE 0xa002f2dc _REC_S1VAL_20_u1 255. _CNV_A_R_A_165_CM 0. 255. DISPLAY_IDENTIFIER fm_cal_sens_map_h.fm_static_bitfield.Cbx_obd_mena_xxx BIT_MASK 0x8 /end CHARACTERISTIC
/begin CHARACTERISTIC Cxx_dtc_lb_sens_map_h "" VALUE 0xa002f2dd _REC_S1VAL_20_u1 255. _CNV_A_R_A_165_CM 0. 255. DISPLAY_IDENTIFIER fm_cal_sens_map_h.Cxx_dtc_lb_xxx /end CHARACTERISTIC
/begin CHARACTERISTIC Cxx_obd_dc_sens_map_h "" VALUE 0xa002f2de _REC_S1VAL_20_u1 9. _CNV_A_R_A_165_CM 1. 10. DISPLAY_IDENTIFIER fm_cal_sens_map_h.Cxx_obd_dc_xxx /end CHARACTERISTIC
/begin CHARACTERISTIC Cxx_dtc_obd_sens_map_l "" VALUE 0xa002f2e6 _REC_S1VAL_20_u2 65535. _CNV_A_R_A_165_CM 0. 65535. DISPLAY_IDENTIFIER fm_cal_sens_map_l.Cxx_dtc_obd_xxx /end CHARACTERISTIC
/begin CHARACTERISTIC Cxx_conf_wal_sens_map_l "" VALUE 0xa002f2e8 _REC_S1VAL_20_u1 3. _CNV_A_R_A_165_CM 0. 3. DISPLAY_IDENTIFIER fm_cal_sens_map_l.fm_static_bitfield.Cxx_conf_wal_xxx BIT_MASK 0x3 /end CHARACTERISTIC
/begin CHARACTERISTIC Cbx_obd_sens_map_l "" VALUE 0xa002f2e8 _REC_S1VAL_20_u1 255. _CNV_A_R_A_165_CM 0. 255. DISPLAY_IDENTIFIER fm_cal_sens_map_l.fm_static_bitfield.Cbx_obd_xxx BIT_MASK 0x4 /end CHARACTERISTIC
/begin CHARACTERISTIC Cbx_obd_mena_sens_map_l "" VALUE 0xa002f2e8 _REC_S1VAL_20_u1 255. _CNV_A_R_A_165_CM 0. 255. DISPLAY_IDENTIFIER fm_cal_sens_map_l.fm_static_bitfield.Cbx_obd_mena_xxx BIT_MASK 0x8 /end CHARACTERISTIC
/begin CHARACTERISTIC Cxx_dtc_lb_sens_map_l "" VALUE 0xa002f2e9 _REC_S1VAL_20_u1 255. _CNV_A_R_A_165_CM 0. 255. DISPLAY_IDENTIFIER fm_cal_sens_map_l.Cxx_dtc_lb_xxx /end CHARACTERISTIC
/begin CHARACTERISTIC Cxx_obd_dc_sens_map_l "" VALUE 0xa002f2ea _REC_S1VAL_20_u1 9. _CNV_A_R_A_165_CM 1. 10. DISPLAY_IDENTIFIER fm_cal_sens_map_l.Cxx_obd_dc_xxx /end CHARACTERISTIC
/begin CHARACTERISTIC Cxx_dtc_obd_sens_mat_h "" VALUE 0xa002f38e _REC_S1VAL_20_u2 65535. _CNV_A_R_A_165_CM 0. 65535. DISPLAY_IDENTIFIER fm_cal_sens_mat_h.Cxx_dtc_obd_xxx /end CHARACTERISTIC
/begin CHARACTERISTIC Cxx_conf_wal_sens_mat_h "" VALUE 0xa002f390 _REC_S1VAL_20_u1 3. _CNV_A_R_A_165_CM 0. 3. DISPLAY_IDENTIFIER fm_cal_sens_mat_h.fm_static_bitfield.Cxx_conf_wal_xxx BIT_MASK 0x3 /end CHARACTERISTIC
/begin CHARACTERISTIC Cbx_obd_sens_mat_h "" VALUE 0xa002f390 _REC_S1VAL_20_u1 255. _CNV_A_R_A_165_CM 0. 255. DISPLAY_IDENTIFIER fm_cal_sens_mat_h.fm_static_bitfield.Cbx_obd_xxx BIT_MASK 0x4 /end CHARACTERISTIC
/begin CHARACTERISTIC Cbx_obd_mena_sens_mat_h "" VALUE 0xa002f390 _REC_S1VAL_20_u1 255. _CNV_A_R_A_165_CM 0. 255. DISPLAY_IDENTIFIER fm_cal_sens_mat_h.fm_static_bitfield.Cbx_obd_mena_xxx BIT_MASK 0x8 /end CHARACTERISTIC
/begin CHARACTERISTIC Cxx_dtc_lb_sens_mat_h "" VALUE 0xa002f391 _REC_S1VAL_20_u1 255. _CNV_A_R_A_165_CM 0. 255. DISPLAY_IDENTIFIER fm_cal_sens_mat_h.Cxx_dtc_lb_xxx /end CHARACTERISTIC
/begin CHARACTERISTIC Cxx_obd_dc_sens_mat_h "" VALUE 0xa002f392 _REC_S1VAL_20_u1 9. _CNV_A_R_A_165_CM 1. 10. DISPLAY_IDENTIFIER fm_cal_sens_mat_h.Cxx_obd_dc_xxx /end CHARACTERISTIC
/begin CHARACTERISTIC Cxx_dtc_obd_sens_mat_l "" VALUE 0xa002f39a _REC_S1VAL_20_u2 65535. _CNV_A_R_A_165_CM 0. 65535. DISPLAY_IDENTIFIER fm_cal_sens_mat_l.Cxx_dtc_obd_xxx /end CHARACTERISTIC
/begin CHARACTERISTIC Cxx_conf_wal_sens_mat_l "" VALUE 0xa002f39c _REC_S1VAL_20_u1 3. _CNV_A_R_A_165_CM 0. 3. DISPLAY_IDENTIFIER fm_cal_sens_mat_l.fm_static_bitfield.Cxx_conf_wal_xxx BIT_MASK 0x3 /end CHARACTERISTIC
/begin CHARACTERISTIC Cbx_obd_sens_mat_l "" VALUE 0xa002f39c _REC_S1VAL_20_u1 255. _CNV_A_R_A_165_CM 0. 255. DISPLAY_IDENTIFIER fm_cal_sens_mat_l.fm_static_bitfield.Cbx_obd_xxx BIT_MASK 0x4 /end CHARACTERISTIC
/begin CHARACTERISTIC Cbx_obd_mena_sens_mat_l "" VALUE 0xa002f39c _REC_S1VAL_20_u1 255. _CNV_A_R_A_165_CM 0. 255. DISPLAY_IDENTIFIER fm_cal_sens_mat_l.fm_static_bitfield.Cbx_obd_mena_xxx BIT_MASK 0x8 /end CHARACTERISTIC
/begin CHARACTERISTIC Cxx_dtc_lb_sens_mat_l "" VALUE 0xa002f39d _REC_S1VAL_20_u1 255. _CNV_A_R_A_165_CM 0. 255. DISPLAY_IDENTIFIER fm_cal_sens_mat_l.Cxx_dtc_lb_xxx /end CHARACTERISTIC
/begin CHARACTERISTIC Cxx_obd_dc_sens_mat_l "" VALUE 0xa002f39e _REC_S1VAL_20_u1 9. _CNV_A_R_A_165_CM 1. 10. DISPLAY_IDENTIFIER fm_cal_sens_mat_l.Cxx_obd_dc_xxx /end CHARACTERISTIC
/begin CHARACTERISTIC Cxx_dtc_obd_sens_spg_h "" VALUE 0xa002f2f2 _REC_S1VAL_20_u2 65535. _CNV_A_R_A_165_CM 0. 65535. DISPLAY_IDENTIFIER fm_cal_sens_spg_h.Cxx_dtc_obd_xxx /end CHARACTERISTIC
/begin CHARACTERISTIC Cxx_conf_wal_sens_spg_h "" VALUE 0xa002f2f4 _REC_S1VAL_20_u1 3. _CNV_A_R_A_165_CM 0. 3. DISPLAY_IDENTIFIER fm_cal_sens_spg_h.fm_static_bitfield.Cxx_conf_wal_xxx BIT_MASK 0x3 /end CHARACTERISTIC
/begin CHARACTERISTIC Cbx_obd_sens_spg_h "" VALUE 0xa002f2f4 _REC_S1VAL_20_u1 255. _CNV_A_R_A_165_CM 0. 255. DISPLAY_IDENTIFIER fm_cal_sens_spg_h.fm_static_bitfield.Cbx_obd_xxx BIT_MASK 0x4 /end CHARACTERISTIC
/begin CHARACTERISTIC Cbx_obd_mena_sens_spg_h "" VALUE 0xa002f2f4 _REC_S1VAL_20_u1 255. _CNV_A_R_A_165_CM 0. 255. DISPLAY_IDENTIFIER fm_cal_sens_spg_h.fm_static_bitfield.Cbx_obd_mena_xxx BIT_MASK 0x8 /end CHARACTERISTIC
/begin CHARACTERISTIC Cxx_dtc_lb_sens_spg_h "" VALUE 0xa002f2f5 _REC_S1VAL_20_u1 255. _CNV_A_R_A_165_CM 0. 255. DISPLAY_IDENTIFIER fm_cal_sens_spg_h.Cxx_dtc_lb_xxx /end CHARACTERISTIC
/begin CHARACTERISTIC Cxx_obd_dc_sens_spg_h "" VALUE 0xa002f2f6 _REC_S1VAL_20_u1 9. _CNV_A_R_A_165_CM 1. 10. DISPLAY_IDENTIFIER fm_cal_sens_spg_h.Cxx_obd_dc_xxx /end CHARACTERISTIC
/begin CHARACTERISTIC Cxx_dtc_obd_sens_spg_l "" VALUE 0xa002f2fe _REC_S1VAL_20_u2 65535. _CNV_A_R_A_165_CM 0. 65535. DISPLAY_IDENTIFIER fm_cal_sens_spg_l.Cxx_dtc_obd_xxx /end CHARACTERISTIC
/begin CHARACTERISTIC Cxx_conf_wal_sens_spg_l "" VALUE 0xa002f300 _REC_S1VAL_20_u1 3. _CNV_A_R_A_165_CM 0. 3. DISPLAY_IDENTIFIER fm_cal_sens_spg_l.fm_static_bitfield.Cxx_conf_wal_xxx BIT_MASK 0x3 /end CHARACTERISTIC
/begin CHARACTERISTIC Cbx_obd_sens_spg_l "" VALUE 0xa002f300 _REC_S1VAL_20_u1 255. _CNV_A_R_A_165_CM 0. 255. DISPLAY_IDENTIFIER fm_cal_sens_spg_l.fm_static_bitfield.Cbx_obd_xxx BIT_MASK 0x4 /end CHARACTERISTIC
/begin CHARACTERISTIC Cbx_obd_mena_sens_spg_l "" VALUE 0xa002f300 _REC_S1VAL_20_u1 255. _CNV_A_R_A_165_CM 0. 255. DISPLAY_IDENTIFIER fm_cal_sens_spg_l.fm_static_bitfield.Cbx_obd_mena_xxx BIT_MASK 0x8 /end CHARACTERISTIC
/begin CHARACTERISTIC Cxx_dtc_lb_sens_spg_l "" VALUE 0xa002f301 _REC_S1VAL_20_u1 255. _CNV_A_R_A_165_CM 0. 255. DISPLAY_IDENTIFIER fm_cal_sens_spg_l.Cxx_dtc_lb_xxx /end CHARACTERISTIC
/begin CHARACTERISTIC Cxx_obd_dc_sens_spg_l "" VALUE 0xa002f302 _REC_S1VAL_20_u1 9. _CNV_A_R_A_165_CM 1. 10. DISPLAY_IDENTIFIER fm_cal_sens_spg_l.Cxx_obd_dc_xxx /end CHARACTERISTIC
/begin CHARACTERISTIC Cxx_dtc_obd_sens_tco_h "" VALUE 0xa002f30a _REC_S1VAL_20_u2 65535. _CNV_A_R_A_165_CM 0. 65535. DISPLAY_IDENTIFIER fm_cal_sens_tco_h.Cxx_dtc_obd_xxx /end CHARACTERISTIC
/begin CHARACTERISTIC Cxx_conf_wal_sens_tco_h "" VALUE 0xa002f30c _REC_S1VAL_20_u1 3. _CNV_A_R_A_165_CM 0. 3. DISPLAY_IDENTIFIER fm_cal_sens_tco_h.fm_static_bitfield.Cxx_conf_wal_xxx BIT_MASK 0x3 /end CHARACTERISTIC
/begin CHARACTERISTIC Cbx_obd_sens_tco_h "" VALUE 0xa002f30c _REC_S1VAL_20_u1 255. _CNV_A_R_A_165_CM 0. 255. DISPLAY_IDENTIFIER fm_cal_sens_tco_h.fm_static_bitfield.Cbx_obd_xxx BIT_MASK 0x4 /end CHARACTERISTIC
/begin CHARACTERISTIC Cbx_obd_mena_sens_tco_h "" VALUE 0xa002f30c _REC_S1VAL_20_u1 255. _CNV_A_R_A_165_CM 0. 255. DISPLAY_IDENTIFIER fm_cal_sens_tco_h.fm_static_bitfield.Cbx_obd_mena_xxx BIT_MASK 0x8 /end CHARACTERISTIC
/begin CHARACTERISTIC Cxx_dtc_lb_sens_tco_h "" VALUE 0xa002f30d _REC_S1VAL_20_u1 255. _CNV_A_R_A_165_CM 0. 255. DISPLAY_IDENTIFIER fm_cal_sens_tco_h.Cxx_dtc_lb_xxx /end CHARACTERISTIC
/begin CHARACTERISTIC Cxx_obd_dc_sens_tco_h "" VALUE 0xa002f30e _REC_S1VAL_20_u1 9. _CNV_A_R_A_165_CM 1. 10. DISPLAY_IDENTIFIER fm_cal_sens_tco_h.Cxx_obd_dc_xxx /end CHARACTERISTIC
/begin CHARACTERISTIC Cxx_dtc_obd_sens_tco_l "" VALUE 0xa002f316 _REC_S1VAL_20_u2 65535. _CNV_A_R_A_165_CM 0. 65535. DISPLAY_IDENTIFIER fm_cal_sens_tco_l.Cxx_dtc_obd_xxx /end CHARACTERISTIC
/begin CHARACTERISTIC Cxx_conf_wal_sens_tco_l "" VALUE 0xa002f318 _REC_S1VAL_20_u1 3. _CNV_A_R_A_165_CM 0. 3. DISPLAY_IDENTIFIER fm_cal_sens_tco_l.fm_static_bitfield.Cxx_conf_wal_xxx BIT_MASK 0x3 /end CHARACTERISTIC
/begin CHARACTERISTIC Cbx_obd_sens_tco_l "" VALUE 0xa002f318 _REC_S1VAL_20_u1 255. _CNV_A_R_A_165_CM 0. 255. DISPLAY_IDENTIFIER fm_cal_sens_tco_l.fm_static_bitfield.Cbx_obd_xxx BIT_MASK 0x4 /end CHARACTERISTIC
/begin CHARACTERISTIC Cbx_obd_mena_sens_tco_l "" VALUE 0xa002f318 _REC_S1VAL_20_u1 255. _CNV_A_R_A_165_CM 0. 255. DISPLAY_IDENTIFIER fm_cal_sens_tco_l.fm_static_bitfield.Cbx_obd_mena_xxx BIT_MASK 0x8 /end CHARACTERISTIC
/begin CHARACTERISTIC Cxx_dtc_lb_sens_tco_l "" VALUE 0xa002f319 _REC_S1VAL_20_u1 255. _CNV_A_R_A_165_CM 0. 255. DISPLAY_IDENTIFIER fm_cal_sens_tco_l.Cxx_dtc_lb_xxx /end CHARACTERISTIC
/begin CHARACTERISTIC Cxx_obd_dc_sens_tco_l "" VALUE 0xa002f31a _REC_S1VAL_20_u1 9. _CNV_A_R_A_165_CM 1. 10. DISPLAY_IDENTIFIER fm_cal_sens_tco_l.Cxx_obd_dc_xxx /end CHARACTERISTIC
/begin CHARACTERISTIC Cxx_dtc_obd_sens_tco_sig_mcut "" VALUE 0xa002f77e _REC_S1VAL_20_u2 65535. _CNV_A_R_A_165_CM 0. 65535. DISPLAY_IDENTIFIER fm_cal_sens_tco_sig_mcut.Cxx_dtc_obd_xxx /end CHARACTERISTIC
/begin CHARACTERISTIC Cxx_conf_wal_sens_tco_sig_mcut "" VALUE 0xa002f780 _REC_S1VAL_20_u1 3. _CNV_A_R_A_165_CM 0. 3. DISPLAY_IDENTIFIER fm_cal_sens_tco_sig_mcut.fm_static_bitfield.Cxx_conf_wal_xxx BIT_MASK 0x3 /end CHARACTERISTIC
/begin CHARACTERISTIC Cbx_obd_sens_tco_sig_mcut "" VALUE 0xa002f780 _REC_S1VAL_20_u1 255. _CNV_A_R_A_165_CM 0. 255. DISPLAY_IDENTIFIER fm_cal_sens_tco_sig_mcut.fm_static_bitfield.Cbx_obd_xxx BIT_MASK 0x4 /end CHARACTERISTIC
/begin CHARACTERISTIC Cbx_obd_mena_sens_tco_sig_mcut "" VALUE 0xa002f780 _REC_S1VAL_20_u1 255. _CNV_A_R_A_165_CM 0. 255. DISPLAY_IDENTIFIER fm_cal_sens_tco_sig_mcut.fm_static_bitfield.Cbx_obd_mena_xxx BIT_MASK 0x8 /end CHARACTERISTIC
/begin CHARACTERISTIC Cxx_dtc_lb_sens_tco_sig_mcut "" VALUE 0xa002f781 _REC_S1VAL_20_u1 255. _CNV_A_R_A_165_CM 0. 255. DISPLAY_IDENTIFIER fm_cal_sens_tco_sig_mcut.Cxx_dtc_lb_xxx /end CHARACTERISTIC
/begin CHARACTERISTIC Cxx_obd_dc_sens_tco_sig_mcut "" VALUE 0xa002f782 _REC_S1VAL_20_u1 9. _CNV_A_R_A_165_CM 1. 10. DISPLAY_IDENTIFIER fm_cal_sens_tco_sig_mcut.Cxx_obd_dc_xxx /end CHARACTERISTIC
/begin CHARACTERISTIC Cxx_dtc_obd_sfty_tq_chr "" VALUE 0xa002f68e _REC_S1VAL_20_u2 65535. _CNV_A_R_A_165_CM 0. 65535. DISPLAY_IDENTIFIER fm_cal_sfty_tq_chr.Cxx_dtc_obd_xxx /end CHARACTERISTIC
/begin CHARACTERISTIC Cxx_conf_wal_sfty_tq_chr "" VALUE 0xa002f690 _REC_S1VAL_20_u1 3. _CNV_A_R_A_165_CM 0. 3. DISPLAY_IDENTIFIER fm_cal_sfty_tq_chr.fm_static_bitfield.Cxx_conf_wal_xxx BIT_MASK 0x3 /end CHARACTERISTIC
/begin CHARACTERISTIC Cbx_obd_sfty_tq_chr "" VALUE 0xa002f690 _REC_S1VAL_20_u1 255. _CNV_A_R_A_165_CM 0. 255. DISPLAY_IDENTIFIER fm_cal_sfty_tq_chr.fm_static_bitfield.Cbx_obd_xxx BIT_MASK 0x4 /end CHARACTERISTIC
/begin CHARACTERISTIC Cbx_obd_mena_sfty_tq_chr "" VALUE 0xa002f690 _REC_S1VAL_20_u1 255. _CNV_A_R_A_165_CM 0. 255. DISPLAY_IDENTIFIER fm_cal_sfty_tq_chr.fm_static_bitfield.Cbx_obd_mena_xxx BIT_MASK 0x8 /end CHARACTERISTIC
/begin CHARACTERISTIC Cxx_dtc_lb_sfty_tq_chr "" VALUE 0xa002f691 _REC_S1VAL_20_u1 255. _CNV_A_R_A_165_CM 0. 255. DISPLAY_IDENTIFIER fm_cal_sfty_tq_chr.Cxx_dtc_lb_xxx /end CHARACTERISTIC
/begin CHARACTERISTIC Cxx_obd_dc_sfty_tq_chr "" VALUE 0xa002f692 _REC_S1VAL_20_u1 9. _CNV_A_R_A_165_CM 1. 10. DISPLAY_IDENTIFIER fm_cal_sfty_tq_chr.Cxx_obd_dc_xxx /end CHARACTERISTIC
/begin CHARACTERISTIC Cxx_dtc_obd_sfty_tq_clc_chr "" VALUE 0xa002f69a _REC_S1VAL_20_u2 65535. _CNV_A_R_A_165_CM 0. 65535. DISPLAY_IDENTIFIER fm_cal_sfty_tq_clc_chr.Cxx_dtc_obd_xxx /end CHARACTERISTIC
/begin CHARACTERISTIC Cxx_conf_wal_sfty_tq_clc_chr "" VALUE 0xa002f69c _REC_S1VAL_20_u1 3. _CNV_A_R_A_165_CM 0. 3. DISPLAY_IDENTIFIER fm_cal_sfty_tq_clc_chr.fm_static_bitfield.Cxx_conf_wal_xxx BIT_MASK 0x3 /end CHARACTERISTIC
/begin CHARACTERISTIC Cbx_obd_sfty_tq_clc_chr "" VALUE 0xa002f69c _REC_S1VAL_20_u1 255. _CNV_A_R_A_165_CM 0. 255. DISPLAY_IDENTIFIER fm_cal_sfty_tq_clc_chr.fm_static_bitfield.Cbx_obd_xxx BIT_MASK 0x4 /end CHARACTERISTIC
/begin CHARACTERISTIC Cbx_obd_mena_sfty_tq_clc_chr "" VALUE 0xa002f69c _REC_S1VAL_20_u1 255. _CNV_A_R_A_165_CM 0. 255. DISPLAY_IDENTIFIER fm_cal_sfty_tq_clc_chr.fm_static_bitfield.Cbx_obd_mena_xxx BIT_MASK 0x8 /end CHARACTERISTIC
/begin CHARACTERISTIC Cxx_dtc_lb_sfty_tq_clc_chr "" VALUE 0xa002f69d _REC_S1VAL_20_u1 255. _CNV_A_R_A_165_CM 0. 255. DISPLAY_IDENTIFIER fm_cal_sfty_tq_clc_chr.Cxx_dtc_lb_xxx /end CHARACTERISTIC
/begin CHARACTERISTIC Cxx_obd_dc_sfty_tq_clc_chr "" VALUE 0xa002f69e _REC_S1VAL_20_u1 9. _CNV_A_R_A_165_CM 1. 10. DISPLAY_IDENTIFIER fm_cal_sfty_tq_clc_chr.Cxx_obd_dc_xxx /end CHARACTERISTIC
/begin CHARACTERISTIC Cxx_conf_wal_sfty_tq_lih_chr "" VALUE 0xa002f6a8 _REC_S1VAL_20_u1 3. _CNV_A_R_A_165_CM 0. 3. DISPLAY_IDENTIFIER fm_cal_sfty_tq_lih_chr.fm_static_bitfield.Cxx_conf_wal_xxx BIT_MASK 0x3 /end CHARACTERISTIC
/begin CHARACTERISTIC Cxx_dtc_lb_sfty_tq_lih_chr "" VALUE 0xa002f6a9 _REC_S1VAL_20_u1 255. _CNV_A_R_A_165_CM 0. 255. DISPLAY_IDENTIFIER fm_cal_sfty_tq_lih_chr.Cxx_dtc_lb_xxx /end CHARACTERISTIC
/begin CHARACTERISTIC Cxx_dtc_obd_spg_chr "" VALUE 0xa002f5ce _REC_S1VAL_20_u2 65535. _CNV_A_R_A_165_CM 0. 65535. DISPLAY_IDENTIFIER fm_cal_spg_chr.Cxx_dtc_obd_xxx /end CHARACTERISTIC
/begin CHARACTERISTIC Cxx_conf_wal_spg_chr "" VALUE 0xa002f5d0 _REC_S1VAL_20_u1 3. _CNV_A_R_A_165_CM 0. 3. DISPLAY_IDENTIFIER fm_cal_spg_chr.fm_static_bitfield.Cxx_conf_wal_xxx BIT_MASK 0x3 /end CHARACTERISTIC
/begin CHARACTERISTIC Cbx_obd_spg_chr "" VALUE 0xa002f5d0 _REC_S1VAL_20_u1 255. _CNV_A_R_A_165_CM 0. 255. DISPLAY_IDENTIFIER fm_cal_spg_chr.fm_static_bitfield.Cbx_obd_xxx BIT_MASK 0x4 /end CHARACTERISTIC
/begin CHARACTERISTIC Cbx_obd_mena_spg_chr "" VALUE 0xa002f5d0 _REC_S1VAL_20_u1 255. _CNV_A_R_A_165_CM 0. 255. DISPLAY_IDENTIFIER fm_cal_spg_chr.fm_static_bitfield.Cbx_obd_mena_xxx BIT_MASK 0x8 /end CHARACTERISTIC
/begin CHARACTERISTIC Cxx_dtc_lb_spg_chr "" VALUE 0xa002f5d1 _REC_S1VAL_20_u1 255. _CNV_A_R_A_165_CM 0. 255. DISPLAY_IDENTIFIER fm_cal_spg_chr.Cxx_dtc_lb_xxx /end CHARACTERISTIC
/begin CHARACTERISTIC Cxx_obd_dc_spg_chr "" VALUE 0xa002f5d2 _REC_S1VAL_20_u1 9. _CNV_A_R_A_165_CM 1. 10. DISPLAY_IDENTIFIER fm_cal_spg_chr.Cxx_obd_dc_xxx /end CHARACTERISTIC
/begin CHARACTERISTIC Cxx_dtc_obd_spg_oor "" VALUE 0xa002f5da _REC_S1VAL_20_u2 65535. _CNV_A_R_A_165_CM 0. 65535. DISPLAY_IDENTIFIER fm_cal_spg_oor.Cxx_dtc_obd_xxx /end CHARACTERISTIC
/begin CHARACTERISTIC Cxx_conf_wal_spg_oor "" VALUE 0xa002f5dc _REC_S1VAL_20_u1 3. _CNV_A_R_A_165_CM 0. 3. DISPLAY_IDENTIFIER fm_cal_spg_oor.fm_static_bitfield.Cxx_conf_wal_xxx BIT_MASK 0x3 /end CHARACTERISTIC
/begin CHARACTERISTIC Cbx_obd_spg_oor "" VALUE 0xa002f5dc _REC_S1VAL_20_u1 255. _CNV_A_R_A_165_CM 0. 255. DISPLAY_IDENTIFIER fm_cal_spg_oor.fm_static_bitfield.Cbx_obd_xxx BIT_MASK 0x4 /end CHARACTERISTIC
/begin CHARACTERISTIC Cbx_obd_mena_spg_oor "" VALUE 0xa002f5dc _REC_S1VAL_20_u1 255. _CNV_A_R_A_165_CM 0. 255. DISPLAY_IDENTIFIER fm_cal_spg_oor.fm_static_bitfield.Cbx_obd_mena_xxx BIT_MASK 0x8 /end CHARACTERISTIC
/begin CHARACTERISTIC Cxx_dtc_lb_spg_oor "" VALUE 0xa002f5dd _REC_S1VAL_20_u1 255. _CNV_A_R_A_165_CM 0. 255. DISPLAY_IDENTIFIER fm_cal_spg_oor.Cxx_dtc_lb_xxx /end CHARACTERISTIC
/begin CHARACTERISTIC Cxx_obd_dc_spg_oor "" VALUE 0xa002f5de _REC_S1VAL_20_u1 9. _CNV_A_R_A_165_CM 1. 10. DISPLAY_IDENTIFIER fm_cal_spg_oor.Cxx_obd_dc_xxx /end CHARACTERISTIC
/begin CHARACTERISTIC Cxx_dtc_obd_spg_reg_apl_down "" VALUE 0xa002f322 _REC_S1VAL_20_u2 65535. _CNV_A_R_A_165_CM 0. 65535. DISPLAY_IDENTIFIER fm_cal_spg_reg_apl_down.Cxx_dtc_obd_xxx /end CHARACTERISTIC
/begin CHARACTERISTIC Cxx_conf_wal_spg_reg_apl_down "" VALUE 0xa002f324 _REC_S1VAL_20_u1 3. _CNV_A_R_A_165_CM 0. 3. DISPLAY_IDENTIFIER fm_cal_spg_reg_apl_down.fm_static_bitfield.Cxx_conf_wal_xxx BIT_MASK 0x3 /end CHARACTERISTIC
/begin CHARACTERISTIC Cbx_obd_spg_reg_apl_down "" VALUE 0xa002f324 _REC_S1VAL_20_u1 255. _CNV_A_R_A_165_CM 0. 255. DISPLAY_IDENTIFIER fm_cal_spg_reg_apl_down.fm_static_bitfield.Cbx_obd_xxx BIT_MASK 0x4 /end CHARACTERISTIC
/begin CHARACTERISTIC Cbx_obd_mena_spg_reg_apl_down "" VALUE 0xa002f324 _REC_S1VAL_20_u1 255. _CNV_A_R_A_165_CM 0. 255. DISPLAY_IDENTIFIER fm_cal_spg_reg_apl_down.fm_static_bitfield.Cbx_obd_mena_xxx BIT_MASK 0x8 /end CHARACTERISTIC
/begin CHARACTERISTIC Cxx_dtc_lb_spg_reg_apl_down "" VALUE 0xa002f325 _REC_S1VAL_20_u1 255. _CNV_A_R_A_165_CM 0. 255. DISPLAY_IDENTIFIER fm_cal_spg_reg_apl_down.Cxx_dtc_lb_xxx /end CHARACTERISTIC
/begin CHARACTERISTIC Cxx_obd_dc_spg_reg_apl_down "" VALUE 0xa002f326 _REC_S1VAL_20_u1 9. _CNV_A_R_A_165_CM 1. 10. DISPLAY_IDENTIFIER fm_cal_spg_reg_apl_down.Cxx_obd_dc_xxx /end CHARACTERISTIC
/begin CHARACTERISTIC Cxx_dtc_obd_spg_reg_apl_up "" VALUE 0xa002f32e _REC_S1VAL_20_u2 65535. _CNV_A_R_A_165_CM 0. 65535. DISPLAY_IDENTIFIER fm_cal_spg_reg_apl_up.Cxx_dtc_obd_xxx /end CHARACTERISTIC
/begin CHARACTERISTIC Cxx_conf_wal_spg_reg_apl_up "" VALUE 0xa002f330 _REC_S1VAL_20_u1 3. _CNV_A_R_A_165_CM 0. 3. DISPLAY_IDENTIFIER fm_cal_spg_reg_apl_up.fm_static_bitfield.Cxx_conf_wal_xxx BIT_MASK 0x3 /end CHARACTERISTIC
/begin CHARACTERISTIC Cbx_obd_spg_reg_apl_up "" VALUE 0xa002f330 _REC_S1VAL_20_u1 255. _CNV_A_R_A_165_CM 0. 255. DISPLAY_IDENTIFIER fm_cal_spg_reg_apl_up.fm_static_bitfield.Cbx_obd_xxx BIT_MASK 0x4 /end CHARACTERISTIC
/begin CHARACTERISTIC Cbx_obd_mena_spg_reg_apl_up "" VALUE 0xa002f330 _REC_S1VAL_20_u1 255. _CNV_A_R_A_165_CM 0. 255. DISPLAY_IDENTIFIER fm_cal_spg_reg_apl_up.fm_static_bitfield.Cbx_obd_mena_xxx BIT_MASK 0x8 /end CHARACTERISTIC
/begin CHARACTERISTIC Cxx_dtc_lb_spg_reg_apl_up "" VALUE 0xa002f331 _REC_S1VAL_20_u1 255. _CNV_A_R_A_165_CM 0. 255. DISPLAY_IDENTIFIER fm_cal_spg_reg_apl_up.Cxx_dtc_lb_xxx /end CHARACTERISTIC
/begin CHARACTERISTIC Cxx_obd_dc_spg_reg_apl_up "" VALUE 0xa002f332 _REC_S1VAL_20_u1 9. _CNV_A_R_A_165_CM 1. 10. DISPLAY_IDENTIFIER fm_cal_spg_reg_apl_up.Cxx_obd_dc_xxx /end CHARACTERISTIC
/begin CHARACTERISTIC Cxx_dtc_obd_tlz_ad_b_cpt "" VALUE 0xa002f5e6 _REC_S1VAL_20_u2 65535. _CNV_A_R_A_165_CM 0. 65535. DISPLAY_IDENTIFIER fm_cal_tlz_ad_b_cpt.Cxx_dtc_obd_xxx /end CHARACTERISTIC
/begin CHARACTERISTIC Cxx_conf_wal_tlz_ad_b_cpt "" VALUE 0xa002f5e8 _REC_S1VAL_20_u1 3. _CNV_A_R_A_165_CM 0. 3. DISPLAY_IDENTIFIER fm_cal_tlz_ad_b_cpt.fm_static_bitfield.Cxx_conf_wal_xxx BIT_MASK 0x3 /end CHARACTERISTIC
/begin CHARACTERISTIC Cbx_obd_tlz_ad_b_cpt "" VALUE 0xa002f5e8 _REC_S1VAL_20_u1 255. _CNV_A_R_A_165_CM 0. 255. DISPLAY_IDENTIFIER fm_cal_tlz_ad_b_cpt.fm_static_bitfield.Cbx_obd_xxx BIT_MASK 0x4 /end CHARACTERISTIC
/begin CHARACTERISTIC Cbx_obd_mena_tlz_ad_b_cpt "" VALUE 0xa002f5e8 _REC_S1VAL_20_u1 255. _CNV_A_R_A_165_CM 0. 255. DISPLAY_IDENTIFIER fm_cal_tlz_ad_b_cpt.fm_static_bitfield.Cbx_obd_mena_xxx BIT_MASK 0x8 /end CHARACTERISTIC
/begin CHARACTERISTIC Cxx_dtc_lb_tlz_ad_b_cpt "" VALUE 0xa002f5e9 _REC_S1VAL_20_u1 255. _CNV_A_R_A_165_CM 0. 255. DISPLAY_IDENTIFIER fm_cal_tlz_ad_b_cpt.Cxx_dtc_lb_xxx /end CHARACTERISTIC
/begin CHARACTERISTIC Cxx_obd_dc_tlz_ad_b_cpt "" VALUE 0xa002f5ea _REC_S1VAL_20_u1 9. _CNV_A_R_A_165_CM 1. 10. DISPLAY_IDENTIFIER fm_cal_tlz_ad_b_cpt.Cxx_obd_dc_xxx /end CHARACTERISTIC
/begin CHARACTERISTIC Cxx_dtc_obd_vb_clc_chr "" VALUE 0xa002f83e _REC_S1VAL_20_u2 65535. _CNV_A_R_A_165_CM 0. 65535. DISPLAY_IDENTIFIER fm_cal_vb_clc_chr.Cxx_dtc_obd_xxx /end CHARACTERISTIC
/begin CHARACTERISTIC Cxx_conf_wal_vb_clc_chr "" VALUE 0xa002f840 _REC_S1VAL_20_u1 3. _CNV_A_R_A_165_CM 0. 3. DISPLAY_IDENTIFIER fm_cal_vb_clc_chr.fm_static_bitfield.Cxx_conf_wal_xxx BIT_MASK 0x3 /end CHARACTERISTIC
/begin CHARACTERISTIC Cbx_obd_vb_clc_chr "" VALUE 0xa002f840 _REC_S1VAL_20_u1 255. _CNV_A_R_A_165_CM 0. 255. DISPLAY_IDENTIFIER fm_cal_vb_clc_chr.fm_static_bitfield.Cbx_obd_xxx BIT_MASK 0x4 /end CHARACTERISTIC
/begin CHARACTERISTIC Cbx_obd_mena_vb_clc_chr "" VALUE 0xa002f840 _REC_S1VAL_20_u1 255. _CNV_A_R_A_165_CM 0. 255. DISPLAY_IDENTIFIER fm_cal_vb_clc_chr.fm_static_bitfield.Cbx_obd_mena_xxx BIT_MASK 0x8 /end CHARACTERISTIC
/begin CHARACTERISTIC Cxx_dtc_lb_vb_clc_chr "" VALUE 0xa002f841 _REC_S1VAL_20_u1 255. _CNV_A_R_A_165_CM 0. 255. DISPLAY_IDENTIFIER fm_cal_vb_clc_chr.Cxx_dtc_lb_xxx /end CHARACTERISTIC
/begin CHARACTERISTIC Cxx_obd_dc_vb_clc_chr "" VALUE 0xa002f842 _REC_S1VAL_20_u1 9. _CNV_A_R_A_165_CM 1. 10. DISPLAY_IDENTIFIER fm_cal_vb_clc_chr.Cxx_obd_dc_xxx /end CHARACTERISTIC
/begin CHARACTERISTIC Cxx_dtc_obd_vb_h "" VALUE 0xa002f33a _REC_S1VAL_20_u2 65535. _CNV_A_R_A_165_CM 0. 65535. DISPLAY_IDENTIFIER fm_cal_vb_h.Cxx_dtc_obd_xxx /end CHARACTERISTIC
/begin CHARACTERISTIC Cxx_conf_wal_vb_h "" VALUE 0xa002f33c _REC_S1VAL_20_u1 3. _CNV_A_R_A_165_CM 0. 3. DISPLAY_IDENTIFIER fm_cal_vb_h.fm_static_bitfield.Cxx_conf_wal_xxx BIT_MASK 0x3 /end CHARACTERISTIC
/begin CHARACTERISTIC Cbx_obd_vb_h "" VALUE 0xa002f33c _REC_S1VAL_20_u1 255. _CNV_A_R_A_165_CM 0. 255. DISPLAY_IDENTIFIER fm_cal_vb_h.fm_static_bitfield.Cbx_obd_xxx BIT_MASK 0x4 /end CHARACTERISTIC
/begin CHARACTERISTIC Cbx_obd_mena_vb_h "" VALUE 0xa002f33c _REC_S1VAL_20_u1 255. _CNV_A_R_A_165_CM 0. 255. DISPLAY_IDENTIFIER fm_cal_vb_h.fm_static_bitfield.Cbx_obd_mena_xxx BIT_MASK 0x8 /end CHARACTERISTIC
/begin CHARACTERISTIC Cxx_dtc_lb_vb_h "" VALUE 0xa002f33d _REC_S1VAL_20_u1 255. _CNV_A_R_A_165_CM 0. 255. DISPLAY_IDENTIFIER fm_cal_vb_h.Cxx_dtc_lb_xxx /end CHARACTERISTIC
/begin CHARACTERISTIC Cxx_obd_dc_vb_h "" VALUE 0xa002f33e _REC_S1VAL_20_u1 9. _CNV_A_R_A_165_CM 1. 10. DISPLAY_IDENTIFIER fm_cal_vb_h.Cxx_obd_dc_xxx /end CHARACTERISTIC
/begin CHARACTERISTIC Cxx_dtc_obd_vb_l "" VALUE 0xa002f346 _REC_S1VAL_20_u2 65535. _CNV_A_R_A_165_CM 0. 65535. DISPLAY_IDENTIFIER fm_cal_vb_l.Cxx_dtc_obd_xxx /end CHARACTERISTIC
/begin CHARACTERISTIC Cxx_conf_wal_vb_l "" VALUE 0xa002f348 _REC_S1VAL_20_u1 3. _CNV_A_R_A_165_CM 0. 3. DISPLAY_IDENTIFIER fm_cal_vb_l.fm_static_bitfield.Cxx_conf_wal_xxx BIT_MASK 0x3 /end CHARACTERISTIC
/begin CHARACTERISTIC Cbx_obd_vb_l "" VALUE 0xa002f348 _REC_S1VAL_20_u1 255. _CNV_A_R_A_165_CM 0. 255. DISPLAY_IDENTIFIER fm_cal_vb_l.fm_static_bitfield.Cbx_obd_xxx BIT_MASK 0x4 /end CHARACTERISTIC
/begin CHARACTERISTIC Cbx_obd_mena_vb_l "" VALUE 0xa002f348 _REC_S1VAL_20_u1 255. _CNV_A_R_A_165_CM 0. 255. DISPLAY_IDENTIFIER fm_cal_vb_l.fm_static_bitfield.Cbx_obd_mena_xxx BIT_MASK 0x8 /end CHARACTERISTIC
/begin CHARACTERISTIC Cxx_dtc_lb_vb_l "" VALUE 0xa002f349 _REC_S1VAL_20_u1 255. _CNV_A_R_A_165_CM 0. 255. DISPLAY_IDENTIFIER fm_cal_vb_l.Cxx_dtc_lb_xxx /end CHARACTERISTIC
/begin CHARACTERISTIC Cxx_obd_dc_vb_l "" VALUE 0xa002f34a _REC_S1VAL_20_u1 9. _CNV_A_R_A_165_CM 1. 10. DISPLAY_IDENTIFIER fm_cal_vb_l.Cxx_obd_dc_xxx /end CHARACTERISTIC
/begin CHARACTERISTIC Cxx_dtc_obd_vb_rly_oc_scg "" VALUE 0xa002f352 _REC_S1VAL_20_u2 65535. _CNV_A_R_A_165_CM 0. 65535. DISPLAY_IDENTIFIER fm_cal_vb_rly_oc_scg.Cxx_dtc_obd_xxx /end CHARACTERISTIC
/begin CHARACTERISTIC Cxx_conf_wal_vb_rly_oc_scg "" VALUE 0xa002f354 _REC_S1VAL_20_u1 3. _CNV_A_R_A_165_CM 0. 3. DISPLAY_IDENTIFIER fm_cal_vb_rly_oc_scg.fm_static_bitfield.Cxx_conf_wal_xxx BIT_MASK 0x3 /end CHARACTERISTIC
/begin CHARACTERISTIC Cbx_obd_vb_rly_oc_scg "" VALUE 0xa002f354 _REC_S1VAL_20_u1 255. _CNV_A_R_A_165_CM 0. 255. DISPLAY_IDENTIFIER fm_cal_vb_rly_oc_scg.fm_static_bitfield.Cbx_obd_xxx BIT_MASK 0x4 /end CHARACTERISTIC
/begin CHARACTERISTIC Cbx_obd_mena_vb_rly_oc_scg "" VALUE 0xa002f354 _REC_S1VAL_20_u1 255. _CNV_A_R_A_165_CM 0. 255. DISPLAY_IDENTIFIER fm_cal_vb_rly_oc_scg.fm_static_bitfield.Cbx_obd_mena_xxx BIT_MASK 0x8 /end CHARACTERISTIC
/begin CHARACTERISTIC Cxx_dtc_lb_vb_rly_oc_scg "" VALUE 0xa002f355 _REC_S1VAL_20_u1 255. _CNV_A_R_A_165_CM 0. 255. DISPLAY_IDENTIFIER fm_cal_vb_rly_oc_scg.Cxx_dtc_lb_xxx /end CHARACTERISTIC
/begin CHARACTERISTIC Cxx_obd_dc_vb_rly_oc_scg "" VALUE 0xa002f356 _REC_S1VAL_20_u1 9. _CNV_A_R_A_165_CM 1. 10. DISPLAY_IDENTIFIER fm_cal_vb_rly_oc_scg.Cxx_obd_dc_xxx /end CHARACTERISTIC
/begin CHARACTERISTIC Cxx_dtc_obd_vb_rly_scw "" VALUE 0xa002f35e _REC_S1VAL_20_u2 65535. _CNV_A_R_A_165_CM 0. 65535. DISPLAY_IDENTIFIER fm_cal_vb_rly_scw.Cxx_dtc_obd_xxx /end CHARACTERISTIC
/begin CHARACTERISTIC Cxx_conf_wal_vb_rly_scw "" VALUE 0xa002f360 _REC_S1VAL_20_u1 3. _CNV_A_R_A_165_CM 0. 3. DISPLAY_IDENTIFIER fm_cal_vb_rly_scw.fm_static_bitfield.Cxx_conf_wal_xxx BIT_MASK 0x3 /end CHARACTERISTIC
/begin CHARACTERISTIC Cbx_obd_vb_rly_scw "" VALUE 0xa002f360 _REC_S1VAL_20_u1 255. _CNV_A_R_A_165_CM 0. 255. DISPLAY_IDENTIFIER fm_cal_vb_rly_scw.fm_static_bitfield.Cbx_obd_xxx BIT_MASK 0x4 /end CHARACTERISTIC
/begin CHARACTERISTIC Cbx_obd_mena_vb_rly_scw "" VALUE 0xa002f360 _REC_S1VAL_20_u1 255. _CNV_A_R_A_165_CM 0. 255. DISPLAY_IDENTIFIER fm_cal_vb_rly_scw.fm_static_bitfield.Cbx_obd_mena_xxx BIT_MASK 0x8 /end CHARACTERISTIC
/begin CHARACTERISTIC Cxx_dtc_lb_vb_rly_scw "" VALUE 0xa002f361 _REC_S1VAL_20_u1 255. _CNV_A_R_A_165_CM 0. 255. DISPLAY_IDENTIFIER fm_cal_vb_rly_scw.Cxx_dtc_lb_xxx /end CHARACTERISTIC
/begin CHARACTERISTIC Cxx_obd_dc_vb_rly_scw "" VALUE 0xa002f362 _REC_S1VAL_20_u1 9. _CNV_A_R_A_165_CM 1. 10. DISPLAY_IDENTIFIER fm_cal_vb_rly_scw.Cxx_obd_dc_xxx /end CHARACTERISTIC
/begin CHARACTERISTIC Cxx_dtc_obd_wgc_oc "" VALUE 0xa002f5f2 _REC_S1VAL_20_u2 65535. _CNV_A_R_A_165_CM 0. 65535. DISPLAY_IDENTIFIER fm_cal_wgc_oc.Cxx_dtc_obd_xxx /end CHARACTERISTIC
/begin CHARACTERISTIC Cxx_conf_wal_wgc_oc "" VALUE 0xa002f5f4 _REC_S1VAL_20_u1 3. _CNV_A_R_A_165_CM 0. 3. DISPLAY_IDENTIFIER fm_cal_wgc_oc.fm_static_bitfield.Cxx_conf_wal_xxx BIT_MASK 0x3 /end CHARACTERISTIC
/begin CHARACTERISTIC Cbx_obd_wgc_oc "" VALUE 0xa002f5f4 _REC_S1VAL_20_u1 255. _CNV_A_R_A_165_CM 0. 255. DISPLAY_IDENTIFIER fm_cal_wgc_oc.fm_static_bitfield.Cbx_obd_xxx BIT_MASK 0x4 /end CHARACTERISTIC
/begin CHARACTERISTIC Cbx_obd_mena_wgc_oc "" VALUE 0xa002f5f4 _REC_S1VAL_20_u1 255. _CNV_A_R_A_165_CM 0. 255. DISPLAY_IDENTIFIER fm_cal_wgc_oc.fm_static_bitfield.Cbx_obd_mena_xxx BIT_MASK 0x8 /end CHARACTERISTIC
/begin CHARACTERISTIC Cxx_dtc_lb_wgc_oc "" VALUE 0xa002f5f5 _REC_S1VAL_20_u1 255. _CNV_A_R_A_165_CM 0. 255. DISPLAY_IDENTIFIER fm_cal_wgc_oc.Cxx_dtc_lb_xxx /end CHARACTERISTIC
/begin CHARACTERISTIC Cxx_obd_dc_wgc_oc "" VALUE 0xa002f5f6 _REC_S1VAL_20_u1 9. _CNV_A_R_A_165_CM 1. 10. DISPLAY_IDENTIFIER fm_cal_wgc_oc.Cxx_obd_dc_xxx /end CHARACTERISTIC
/begin CHARACTERISTIC Cxx_dtc_obd_wgc_scg "" VALUE 0xa002f5fe _REC_S1VAL_20_u2 65535. _CNV_A_R_A_165_CM 0. 65535. DISPLAY_IDENTIFIER fm_cal_wgc_scg.Cxx_dtc_obd_xxx /end CHARACTERISTIC
/begin CHARACTERISTIC Cxx_conf_wal_wgc_scg "" VALUE 0xa002f600 _REC_S1VAL_20_u1 3. _CNV_A_R_A_165_CM 0. 3. DISPLAY_IDENTIFIER fm_cal_wgc_scg.fm_static_bitfield.Cxx_conf_wal_xxx BIT_MASK 0x3 /end CHARACTERISTIC
/begin CHARACTERISTIC Cbx_obd_wgc_scg "" VALUE 0xa002f600 _REC_S1VAL_20_u1 255. _CNV_A_R_A_165_CM 0. 255. DISPLAY_IDENTIFIER fm_cal_wgc_scg.fm_static_bitfield.Cbx_obd_xxx BIT_MASK 0x4 /end CHARACTERISTIC
/begin CHARACTERISTIC Cbx_obd_mena_wgc_scg "" VALUE 0xa002f600 _REC_S1VAL_20_u1 255. _CNV_A_R_A_165_CM 0. 255. DISPLAY_IDENTIFIER fm_cal_wgc_scg.fm_static_bitfield.Cbx_obd_mena_xxx BIT_MASK 0x8 /end CHARACTERISTIC
/begin CHARACTERISTIC Cxx_dtc_lb_wgc_scg "" VALUE 0xa002f601 _REC_S1VAL_20_u1 255. _CNV_A_R_A_165_CM 0. 255. DISPLAY_IDENTIFIER fm_cal_wgc_scg.Cxx_dtc_lb_xxx /end CHARACTERISTIC
/begin CHARACTERISTIC Cxx_obd_dc_wgc_scg "" VALUE 0xa002f602 _REC_S1VAL_20_u1 9. _CNV_A_R_A_165_CM 1. 10. DISPLAY_IDENTIFIER fm_cal_wgc_scg.Cxx_obd_dc_xxx /end CHARACTERISTIC
/begin CHARACTERISTIC Cxx_dtc_obd_wgc_scw "" VALUE 0xa002f60a _REC_S1VAL_20_u2 65535. _CNV_A_R_A_165_CM 0. 65535. DISPLAY_IDENTIFIER fm_cal_wgc_scw.Cxx_dtc_obd_xxx /end CHARACTERISTIC
/begin CHARACTERISTIC Cxx_conf_wal_wgc_scw "" VALUE 0xa002f60c _REC_S1VAL_20_u1 3. _CNV_A_R_A_165_CM 0. 3. DISPLAY_IDENTIFIER fm_cal_wgc_scw.fm_static_bitfield.Cxx_conf_wal_xxx BIT_MASK 0x3 /end CHARACTERISTIC
/begin CHARACTERISTIC Cbx_obd_wgc_scw "" VALUE 0xa002f60c _REC_S1VAL_20_u1 255. _CNV_A_R_A_165_CM 0. 255. DISPLAY_IDENTIFIER fm_cal_wgc_scw.fm_static_bitfield.Cbx_obd_xxx BIT_MASK 0x4 /end CHARACTERISTIC
/begin CHARACTERISTIC Cbx_obd_mena_wgc_scw "" VALUE 0xa002f60c _REC_S1VAL_20_u1 255. _CNV_A_R_A_165_CM 0. 255. DISPLAY_IDENTIFIER fm_cal_wgc_scw.fm_static_bitfield.Cbx_obd_mena_xxx BIT_MASK 0x8 /end CHARACTERISTIC
/begin CHARACTERISTIC Cxx_dtc_lb_wgc_scw "" VALUE 0xa002f60d _REC_S1VAL_20_u1 255. _CNV_A_R_A_165_CM 0. 255. DISPLAY_IDENTIFIER fm_cal_wgc_scw.Cxx_dtc_lb_xxx /end CHARACTERISTIC
/begin CHARACTERISTIC Cxx_obd_dc_wgc_scw "" VALUE 0xa002f60e _REC_S1VAL_20_u1 9. _CNV_A_R_A_165_CM 1. 10. DISPLAY_IDENTIFIER fm_cal_wgc_scw.Cxx_obd_dc_xxx /end CHARACTERISTIC
/begin CHARACTERISTIC Cxx_conf_wal_wpmp_tcr_blk "" VALUE 0xa002f7bc _REC_S1VAL_20_u1 3. _CNV_A_R_A_165_CM 0. 3. DISPLAY_IDENTIFIER fm_cal_wpmp_tcr_blk.fm_static_bitfield.Cxx_conf_wal_xxx BIT_MASK 0x3 /end CHARACTERISTIC
/begin CHARACTERISTIC Cxx_dtc_lb_wpmp_tcr_blk "" VALUE 0xa002f7bd _REC_S1VAL_20_u1 255. _CNV_A_R_A_165_CM 0. 255. DISPLAY_IDENTIFIER fm_cal_wpmp_tcr_blk.Cxx_dtc_lb_xxx /end CHARACTERISTIC
/begin CHARACTERISTIC Cxx_conf_wal_wpmp_tcr_oc "" VALUE 0xa002f618 _REC_S1VAL_20_u1 3. _CNV_A_R_A_165_CM 0. 3. DISPLAY_IDENTIFIER fm_cal_wpmp_tcr_oc.fm_static_bitfield.Cxx_conf_wal_xxx BIT_MASK 0x3 /end CHARACTERISTIC
/begin CHARACTERISTIC Cxx_dtc_lb_wpmp_tcr_oc "" VALUE 0xa002f619 _REC_S1VAL_20_u1 255. _CNV_A_R_A_165_CM 0. 255. DISPLAY_IDENTIFIER fm_cal_wpmp_tcr_oc.Cxx_dtc_lb_xxx /end CHARACTERISTIC
/begin CHARACTERISTIC Cxx_conf_wal_wpmp_tcr_scg "" VALUE 0xa002f624 _REC_S1VAL_20_u1 3. _CNV_A_R_A_165_CM 0. 3. DISPLAY_IDENTIFIER fm_cal_wpmp_tcr_scg.fm_static_bitfield.Cxx_conf_wal_xxx BIT_MASK 0x3 /end CHARACTERISTIC
/begin CHARACTERISTIC Cxx_dtc_lb_wpmp_tcr_scg "" VALUE 0xa002f625 _REC_S1VAL_20_u1 255. _CNV_A_R_A_165_CM 0. 255. DISPLAY_IDENTIFIER fm_cal_wpmp_tcr_scg.Cxx_dtc_lb_xxx /end CHARACTERISTIC
/begin CHARACTERISTIC Cxx_conf_wal_wpmp_tcr_scw "" VALUE 0xa002f630 _REC_S1VAL_20_u1 3. _CNV_A_R_A_165_CM 0. 3. DISPLAY_IDENTIFIER fm_cal_wpmp_tcr_scw.fm_static_bitfield.Cxx_conf_wal_xxx BIT_MASK 0x3 /end CHARACTERISTIC
/begin CHARACTERISTIC Cxx_dtc_lb_wpmp_tcr_scw "" VALUE 0xa002f631 _REC_S1VAL_20_u1 255. _CNV_A_R_A_165_CM 0. 255. DISPLAY_IDENTIFIER fm_cal_wpmp_tcr_scw.Cxx_dtc_lb_xxx /end CHARACTERISTIC
/begin COMPU_METHOD _CNV_A_R_A_165_CM "" RAT_FUNC "%6.3" "" COEFFS 0 1. 0. 0 0 1 /end COMPU_METHOD
/begin RECORD_LAYOUT _REC_S1VAL_20_u1 FNC_VALUES 1 UBYTE COLUMN_DIR DIRECT /end RECORD_LAYOUT
/begin RECORD_LAYOUT _REC_S1VAL_20_u2 FNC_VALUES 1 UWORD COLUMN_DIR DIRECT /end RECORD_LAYOUT
/begin FUNCTION DgDftMng ""
 /begin DEF_CHARACTERISTIC Cbx_obd_mena_inj1_scw Cxx_dtc_lb_inj1_scw Cxx_obd_dc_inj1_scw Cxx_dtc_obd_inj2_oc Cxx_conf_wal_inj2_oc Cbx_obd_inj2_oc Cbx_obd_mena_inj2_oc Cxx_dtc_lb_inj2_oc Cxx_obd_dc_inj2_oc Cxx_dtc_obd_inj2_scg Cxx_conf_wal_inj2_scg Cbx_obd_inj2_scg Cbx_obd_mena_inj2_scg Cxx_dtc_lb_inj2_scg Cxx_obd_dc_inj2_scg Cxx_dtc_obd_inj2_scw Cxx_conf_wal_inj2_scw Cbx_obd_inj2_scw Cbx_obd_mena_inj2_scw Cxx_dtc_lb_inj2_scw Cxx_obd_dc_inj2_scw Cxx_dtc_obd_inj3_oc Cxx_conf_wal_inj3_oc Cbx_obd_inj3_oc Cbx_obd_mena_inj3_oc Cxx_dtc_lb_inj3_oc Cxx_obd_dc_inj3_oc Cxx_dtc_obd_inj3_scg Cxx_conf_wal_inj3_scg Cbx_obd_inj3_scg Cbx_obd_mena_inj3_scg Cxx_dtc_lb_inj3_scg Cxx_obd_dc_inj3_scg Cxx_dtc_obd_inj3_scw Cxx_conf_wal_inj3_scw Cbx_obd_inj3_scw Cbx_obd_mena_inj3_scw Cxx_dtc_lb_inj3_scw Cxx_obd_dc_inj3_scw Cxx_dtc_obd_inj4_oc Cxx_conf_wal_inj4_oc Cbx_obd_inj4_oc Cbx_obd_mena_inj4_oc Cxx_dtc_lb_inj4_oc Cxx_obd_dc_inj4_oc Cxx_dtc_obd_inj4_scg Cxx_conf_wal_inj4_scg Cbx_obd_inj4_scg Cbx_obd_mena_inj4_scg Cxx_dtc_lb_inj4_scg Cxx_obd_dc_inj4_scg Cxx_dtc_obd_inj4_scw Cxx_conf_wal_inj4_scw Cbx_obd_inj4_scw Cbx_obd_mena_inj4_scw Cxx_dtc_lb_inj4_scw Cxx_obd_dc_inj4_scw Cxx_dtc_obd_inj_ecu_itl Cxx_conf_wal_inj_ecu_itl Cbx_obd_inj_ecu_itl Cbx_obd_mena_inj_ecu_itl Cxx_dtc_lb_inj_ecu_itl Cxx_obd_dc_inj_ecu_itl Cxx_dtc_obd_inj_ecu_lbdw_icp Cxx_conf_wal_inj_ecu_lbdw_icp Cbx_obd_inj_ecu_lbdw_icp Cbx_obd_mena_inj_ecu_lbdw_icp Cxx_dtc_lb_inj_ecu_lbdw_icp Cxx_obd_dc_inj_ecu_lbdw_icp Cxx_dtc_obd_inj_ecu_lbup_icp Cxx_conf_wal_inj_ecu_lbup_icp Cbx_obd_inj_ecu_lbup_icp Cbx_obd_mena_inj_ecu_lbup_icp Cxx_dtc_lb_inj_ecu_lbup_icp Cxx_obd_dc_inj_ecu_lbup_icp Cxx_conf_wal_ip_lght_tco_ovh Cxx_dtc_lb_ip_lght_tco_ovh Cxx_dtc_obd_it_cmd_el Cxx_conf_wal_it_cmd_el Cbx_obd_it_cmd_el Cbx_obd_mena_it_cmd_el Cxx_dtc_lb_it_cmd_el Cxx_obd_dc_it_cmd_el Cxx_dtc_obd_it_ofs_meca Cxx_conf_wal_it_ofs_meca Cbx_obd_it_ofs_meca Cbx_obd_mena_it_ofs_meca Cxx_dtc_lb_it_ofs_meca Cxx_obd_dc_it_ofs_meca Cxx_dtc_obd_it_ofs_no_norm Cxx_conf_wal_it_ofs_no_norm Cbx_obd_it_ofs_no_norm Cbx_obd_mena_it_ofs_no_norm Cxx_dtc_lb_it_ofs_no_norm Cxx_obd_dc_it_ofs_no_norm Cxx_dtc_obd_it_ofs_secu_nok Cxx_conf_wal_it_ofs_secu_nok Cbx_obd_it_ofs_secu_nok Cbx_obd_mena_it_ofs_secu_nok Cxx_dtc_lb_it_ofs_secu_nok Cxx_obd_dc_it_ofs_secu_nok Cxx_dtc_obd_it_reg_blk Cxx_conf_wal_it_reg_blk Cbx_obd_it_reg_blk Cbx_obd_mena_it_reg_blk Cxx_dtc_lb_it_reg_blk Cxx_obd_dc_it_reg_blk Cxx_dtc_obd_knk_oor Cxx_conf_wal_knk_oor Cbx_obd_knk_oor Cbx_obd_mena_knk_oor Cxx_dtc_lb_knk_oor Cxx_obd_dc_knk_oor Cxx_dtc_obd_knk_shp Cxx_conf_wal_knk_shp Cbx_obd_knk_shp Cbx_obd_mena_knk_shp Cxx_dtc_lb_knk_shp Cxx_obd_dc_knk_shp Cxx_dtc_obd_lbdw_hot_oc Cxx_conf_wal_lbdw_hot_oc Cbx_obd_lbdw_hot_oc Cbx_obd_mena_lbdw_hot_oc Cxx_dtc_lb_lbdw_hot_oc Cxx_obd_dc_lbdw_hot_oc Cxx_dtc_obd_lbdw_hot_scg Cxx_conf_wal_lbdw_hot_scg Cbx_obd_lbdw_hot_scg Cbx_obd_mena_lbdw_hot_scg Cxx_dtc_lb_lbdw_hot_scg Cxx_obd_dc_lbdw_hot_scg Cxx_dtc_obd_lbdw_hot_scw Cxx_conf_wal_lbdw_hot_scw Cbx_obd_lbdw_hot_scw Cbx_obd_mena_lbdw_hot_scw Cxx_dtc_lb_lbdw_hot_scw Cxx_obd_dc_lbdw_hot_scw Cxx_dtc_obd_lbdw_oc Cxx_conf_wal_lbdw_oc Cbx_obd_lbdw_oc Cbx_obd_mena_lbdw_oc Cxx_dtc_lb_lbdw_oc Cxx_obd_dc_lbdw_oc Cxx_dtc_obd_lbdw_scg Cxx_conf_wal_lbdw_scg Cbx_obd_lbdw_scg Cbx_obd_mena_lbdw_scg Cxx_dtc_lb_lbdw_scg Cxx_obd_dc_lbdw_scg Cxx_dtc_obd_lbdw_scw Cxx_conf_wal_lbdw_scw Cbx_obd_lbdw_scw Cbx_obd_mena_lbdw_scw Cxx_dtc_lb_lbdw_scw Cxx_obd_dc_lbdw_scw Cxx_dtc_obd_lbup_cpt Cxx_conf_wal_lbup_cpt Cbx_obd_lbup_cpt Cbx_obd_mena_lbup_cpt Cxx_dtc_lb_lbup_cpt Cxx_obd_dc_lbup_cpt Cxx_dtc_obd_lbup_hot_apl_down Cxx_conf_wal_lbup_hot_apl_down Cbx_obd_lbup_hot_apl_down Cbx_obd_mena_lbup_hot_apl_down Cxx_dtc_lb_lbup_hot_apl_down Cxx_obd_dc_lbup_hot_apl_down Cxx_dtc_obd_lbup_hot_oc Cxx_conf_wal_lbup_hot_oc Cbx_obd_lbup_hot_oc Cbx_obd_mena_lbup_hot_oc Cxx_dtc_lb_lbup_hot_oc Cxx_obd_dc_lbup_hot_oc Cxx_dtc_obd_lbup_hot_scg Cxx_conf_wal_lbup_hot_scg Cbx_obd_lbup_hot_scg Cbx_obd_mena_lbup_hot_scg Cxx_dtc_lb_lbup_hot_scg Cxx_obd_dc_lbup_hot_scg Cxx_dtc_obd_lbup_hot_scw Cxx_conf_wal_lbup_hot_scw Cbx_obd_lbup_hot_scw Cbx_obd_mena_lbup_hot_scw Cxx_dtc_lb_lbup_hot_scw Cxx_obd_dc_lbup_hot_scw Cxx_dtc_obd_lbup_nok Cxx_conf_wal_lbup_nok Cbx_obd_lbup_nok Cbx_obd_mena_lbup_nok Cxx_dtc_lb_lbup_nok Cxx_obd_dc_lbup_nok Cxx_dtc_obd_lbup_oc Cxx_conf_wal_lbup_oc Cbx_obd_lbup_oc Cbx_obd_mena_lbup_oc Cxx_dtc_lb_lbup_oc Cxx_obd_dc_lbup_oc Cxx_dtc_obd_lbup_scg Cxx_conf_wal_lbup_scg Cbx_obd_lbup_scg Cbx_obd_mena_lbup_scg Cxx_dtc_lb_lbup_scg Cxx_obd_dc_lbup_scg Cxx_dtc_obd_lbup_scw Cxx_conf_wal_lbup_scw Cbx_obd_lbup_scw Cbx_obd_mena_lbup_scw Cxx_dtc_lb_lbup_scw Cxx_obd_dc_lbup_scw Cxx_dtc_obd_map_chr Cxx_conf_wal_map_chr Cbx_obd_map_chr Cbx_obd_mena_map_chr Cxx_dtc_lb_map_chr Cxx_obd_dc_map_chr Cxx_dtc_obd_map_oor Cxx_conf_wal_map_oor Cbx_obd_map_oor Cbx_obd_mena_map_oor Cxx_dtc_lb_map_oor Cxx_obd_dc_map_oor Cxx_dtc_obd_mis_1_cata Cxx_conf_wal_mis_1_cata Cbx_obd_mis_1_cata Cbx_obd_mena_mis_1_cata Cxx_dtc_lb_mis_1_cata Cxx_obd_dc_mis_1_cata Cxx_dtc_obd_mis_1_lpg_cata Cxx_conf_wal_mis_1_lpg_cata Cbx_obd_mis_1_lpg_cata Cbx_obd_mena_mis_1_lpg_cata Cxx_dtc_lb_mis_1_lpg_cata Cxx_obd_dc_mis_1_lpg_cata Cxx_dtc_obd_mis_1_lpg_trs_h Cxx_conf_wal_mis_1_lpg_trs_h Cbx_obd_mis_1_lpg_trs_h Cbx_obd_mena_mis_1_lpg_trs_h Cxx_dtc_lb_mis_1_lpg_trs_h Cxx_obd_dc_mis_1_lpg_trs_h Cxx_dtc_obd_mis_1_trs_h Cxx_conf_wal_mis_1_trs_h Cbx_obd_mis_1_trs_h Cbx_obd_mena_mis_1_trs_h Cxx_dtc_lb_mis_1_trs_h Cxx_obd_dc_mis_1_trs_h Cxx_dtc_obd_mis_2_cata Cxx_conf_wal_mis_2_cata Cbx_obd_mis_2_cata Cbx_obd_mena_mis_2_cata Cxx_dtc_lb_mis_2_cata Cxx_obd_dc_mis_2_cata Cxx_dtc_obd_mis_2_lpg_cata Cxx_conf_wal_mis_2_lpg_cata Cbx_obd_mis_2_lpg_cata Cbx_obd_mena_mis_2_lpg_cata Cxx_dtc_lb_mis_2_lpg_cata Cxx_obd_dc_mis_2_lpg_cata Cxx_dtc_obd_mis_2_lpg_trs_h Cxx_conf_wal_mis_2_lpg_trs_h Cbx_obd_mis_2_lpg_trs_h Cbx_obd_mena_mis_2_lpg_trs_h Cxx_dtc_lb_mis_2_lpg_trs_h Cxx_obd_dc_mis_2_lpg_trs_h Cxx_dtc_obd_mis_2_trs_h Cxx_conf_wal_mis_2_trs_h Cbx_obd_mis_2_trs_h Cbx_obd_mena_mis_2_trs_h Cxx_dtc_lb_mis_2_trs_h Cxx_obd_dc_mis_2_trs_h Cxx_dtc_obd_mis_3_cata Cxx_conf_wal_mis_3_cata Cbx_obd_mis_3_cata Cbx_obd_mena_mis_3_cata Cxx_dtc_lb_mis_3_cata Cxx_obd_dc_mis_3_cata Cxx_dtc_obd_mis_3_lpg_cata Cxx_conf_wal_mis_3_lpg_cata Cbx_obd_mis_3_lpg_cata Cbx_obd_mena_mis_3_lpg_cata Cxx_dtc_lb_mis_3_lpg_cata Cxx_obd_dc_mis_3_lpg_cata Cxx_dtc_obd_mis_3_lpg_trs_h Cxx_conf_wal_mis_3_lpg_trs_h Cbx_obd_mis_3_lpg_trs_h Cbx_obd_mena_mis_3_lpg_trs_h Cxx_dtc_lb_mis_3_lpg_trs_h Cxx_obd_dc_mis_3_lpg_trs_h Cxx_dtc_obd_mis_3_trs_h Cxx_conf_wal_mis_3_trs_h Cbx_obd_mis_3_trs_h Cbx_obd_mena_mis_3_trs_h Cxx_dtc_lb_mis_3_trs_h Cxx_obd_dc_mis_3_trs_h Cxx_dtc_obd_mis_4_cata Cxx_conf_wal_mis_4_cata Cbx_obd_mis_4_cata Cbx_obd_mena_mis_4_cata Cxx_dtc_lb_mis_4_cata Cxx_obd_dc_mis_4_cata Cxx_dtc_obd_mis_4_lpg_cata Cxx_conf_wal_mis_4_lpg_cata Cbx_obd_mis_4_lpg_cata Cbx_obd_mena_mis_4_lpg_cata Cxx_dtc_lb_mis_4_lpg_cata Cxx_obd_dc_mis_4_lpg_cata Cxx_dtc_obd_mis_4_lpg_trs_h Cxx_conf_wal_mis_4_lpg_trs_h Cbx_obd_mis_4_lpg_trs_h Cbx_obd_mena_mis_4_lpg_trs_h Cxx_dtc_lb_mis_4_lpg_trs_h Cxx_obd_dc_mis_4_lpg_trs_h Cxx_dtc_obd_mis_4_trs_h Cxx_conf_wal_mis_4_trs_h Cbx_obd_mis_4_trs_h Cbx_obd_mena_mis_4_trs_h Cxx_dtc_lb_mis_4_trs_h Cxx_obd_dc_mis_4_trs_h Cxx_dtc_obd_mis_cata Cxx_conf_wal_mis_cata Cbx_obd_mis_cata Cbx_obd_mena_mis_cata Cxx_dtc_lb_mis_cata Cxx_obd_dc_mis_cata Cxx_dtc_obd_mis_lpg_cata Cxx_conf_wal_mis_lpg_cata Cbx_obd_mis_lpg_cata Cbx_obd_mena_mis_lpg_cata Cxx_dtc_lb_mis_lpg_cata Cxx_obd_dc_mis_lpg_cata Cxx_dtc_obd_mis_lpg_trs_h Cxx_conf_wal_mis_lpg_trs_h Cbx_obd_mis_lpg_trs_h Cbx_obd_mena_mis_lpg_trs_h Cxx_dtc_lb_mis_lpg_trs_h Cxx_obd_dc_mis_lpg_trs_h Cxx_dtc_obd_mis_min_fuel_cata Cxx_conf_wal_mis_min_fuel_cata Cbx_obd_mis_min_fuel_cata Cbx_obd_mena_mis_min_fuel_cata Cxx_dtc_lb_mis_min_fuel_cata Cxx_obd_dc_mis_min_fuel_cata Cxx_dtc_obd_mis_min_fuel_trs_h Cxx_conf_wal_mis_min_fuel_trs_h Cbx_obd_mis_min_fuel_trs_h Cbx_obd_mena_mis_min_fuel_trs_h Cxx_dtc_lb_mis_min_fuel_trs_h Cxx_obd_dc_mis_min_fuel_trs_h Cxx_dtc_obd_mis_trs_h Cxx_conf_wal_mis_trs_h Cbx_obd_mis_trs_h Cbx_obd_mena_mis_trs_h Cxx_dtc_lb_mis_trs_h Cxx_obd_dc_mis_trs_h Cxx_dtc_obd_mis_unk_cata Cxx_conf_wal_mis_unk_cata Cbx_obd_mis_unk_cata Cbx_obd_mena_mis_unk_cata Cxx_dtc_lb_mis_unk_cata Cxx_obd_dc_mis_unk_cata Cxx_dtc_obd_mis_unk_lpg_cata Cxx_conf_wal_mis_unk_lpg_cata Cbx_obd_mis_unk_lpg_cata Cbx_obd_mena_mis_unk_lpg_cata Cxx_dtc_lb_mis_unk_lpg_cata Cxx_obd_dc_mis_unk_lpg_cata Cxx_dtc_obd_mis_unk_lpg_trs_h Cxx_conf_wal_mis_unk_lpg_trs_h Cbx_obd_mis_unk_lpg_trs_h Cbx_obd_mena_mis_unk_lpg_trs_h Cxx_dtc_lb_mis_unk_lpg_trs_h Cxx_obd_dc_mis_unk_lpg_trs_h Cxx_dtc_obd_mis_unk_trs_h Cxx_conf_wal_mis_unk_trs_h Cbx_obd_mis_unk_trs_h Cbx_obd_mena_mis_unk_trs_h Cxx_dtc_lb_mis_unk_trs_h Cxx_obd_dc_mis_unk_trs_h Cxx_conf_wal_ptc_rov_oc Cxx_dtc_lb_ptc_rov_oc Cxx_conf_wal_ptc_rov_scg Cxx_dtc_lb_ptc_rov_scg Cxx_conf_wal_ptc_rov_scw Cxx_dtc_lb_ptc_rov_scw Cxx_dtc_obd_pws_1_h Cxx_conf_wal_pws_1_h Cbx_obd_pws_1_h Cbx_obd_mena_pws_1_h Cxx_dtc_lb_pws_1_h Cxx_obd_dc_pws_1_h Cxx_dtc_obd_pws_1_l Cxx_conf_wal_pws_1_l Cbx_obd_pws_1_l Cbx_obd_mena_pws_1_l Cxx_dtc_lb_pws_1_l Cxx_obd_dc_pws_1_l Cxx_dtc_obd_pws_2_h Cxx_conf_wal_pws_2_h Cbx_obd_pws_2_h Cbx_obd_mena_pws_2_h Cxx_dtc_lb_pws_2_h Cxx_obd_dc_pws_2_h Cxx_dtc_obd_pws_2_l Cxx_conf_wal_pws_2_l Cbx_obd_pws_2_l Cbx_obd_mena_pws_2_l Cxx_dtc_lb_pws_2_l Cxx_obd_dc_pws_2_l Cxx_dtc_obd_pws_3_h Cxx_conf_wal_pws_3_h Cbx_obd_pws_3_h Cbx_obd_mena_pws_3_h Cxx_dtc_lb_pws_3_h Cxx_obd_dc_pws_3_h Cxx_dtc_obd_pws_3_l Cxx_conf_wal_pws_3_l Cbx_obd_pws_3_l Cbx_obd_mena_pws_3_l Cxx_dtc_lb_pws_3_l Cxx_obd_dc_pws_3_l Cxx_dtc_obd_sens_it_1_nok Cxx_conf_wal_sens_it_1_nok Cbx_obd_sens_it_1_nok Cbx_obd_mena_sens_it_1_nok Cxx_dtc_lb_sens_it_1_nok Cxx_obd_dc_sens_it_1_nok Cxx_dtc_obd_sens_it_2_nok Cxx_conf_wal_sens_it_2_nok Cbx_obd_sens_it_2_nok Cbx_obd_mena_sens_it_2_nok Cxx_dtc_lb_sens_it_2_nok Cxx_obd_dc_sens_it_2_nok Cxx_dtc_obd_sens_it_chr Cxx_conf_wal_sens_it_chr Cbx_obd_sens_it_chr Cbx_obd_mena_sens_it_chr Cxx_dtc_lb_sens_it_chr Cxx_obd_dc_sens_it_chr Cxx_dtc_obd_sens_it_sig_mcut Cxx_conf_wal_sens_it_sig_mcut Cbx_obd_sens_it_sig_mcut Cbx_obd_mena_sens_it_sig_mcut Cxx_dtc_lb_sens_it_sig_mcut Cxx_obd_dc_sens_it_sig_mcut Cxx_dtc_obd_sens_map_h Cxx_conf_wal_sens_map_h Cbx_obd_sens_map_h Cbx_obd_mena_sens_map_h Cxx_dtc_lb_sens_map_h Cxx_obd_dc_sens_map_h Cxx_dtc_obd_sens_map_l Cxx_conf_wal_sens_map_l Cbx_obd_sens_map_l Cbx_obd_mena_sens_map_l Cxx_dtc_lb_sens_map_l Cxx_obd_dc_sens_map_l Cxx_dtc_obd_sens_mat_h Cxx_conf_wal_sens_mat_h Cbx_obd_sens_mat_h Cbx_obd_mena_sens_mat_h Cxx_dtc_lb_sens_mat_h Cxx_obd_dc_sens_mat_h Cxx_dtc_obd_sens_mat_l Cxx_conf_wal_sens_mat_l Cbx_obd_sens_mat_l Cbx_obd_mena_sens_mat_l Cxx_dtc_lb_sens_mat_l Cxx_obd_dc_sens_mat_l Cxx_dtc_obd_sens_spg_h Cxx_conf_wal_sens_spg_h Cbx_obd_sens_spg_h Cbx_obd_mena_sens_spg_h Cxx_dtc_lb_sens_spg_h Cxx_obd_dc_sens_spg_h Cxx_dtc_obd_sens_spg_l Cxx_conf_wal_sens_spg_l Cbx_obd_sens_spg_l Cbx_obd_mena_sens_spg_l Cxx_dtc_lb_sens_spg_l Cxx_obd_dc_sens_spg_l Cxx_dtc_obd_sens_tco_h Cxx_conf_wal_sens_tco_h Cbx_obd_sens_tco_h Cbx_obd_mena_sens_tco_h Cxx_dtc_lb_sens_tco_h Cxx_obd_dc_sens_tco_h Cxx_dtc_obd_sens_tco_l Cxx_conf_wal_sens_tco_l Cbx_obd_sens_tco_l Cbx_obd_mena_sens_tco_l Cxx_dtc_lb_sens_tco_l Cxx_obd_dc_sens_tco_l Cxx_dtc_obd_sens_tco_sig_mcut Cxx_conf_wal_sens_tco_sig_mcut Cbx_obd_sens_tco_sig_mcut Cbx_obd_mena_sens_tco_sig_mcut Cxx_dtc_lb_sens_tco_sig_mcut Cxx_obd_dc_sens_tco_sig_mcut Cxx_dtc_obd_sfty_tq_chr Cxx_conf_wal_sfty_tq_chr Cbx_obd_sfty_tq_chr Cbx_obd_mena_sfty_tq_chr Cxx_dtc_lb_sfty_tq_chr Cxx_obd_dc_sfty_tq_chr Cxx_dtc_obd_sfty_tq_clc_chr Cxx_conf_wal_sfty_tq_clc_chr Cbx_obd_sfty_tq_clc_chr Cbx_obd_mena_sfty_tq_clc_chr Cxx_dtc_lb_sfty_tq_clc_chr Cxx_obd_dc_sfty_tq_clc_chr Cxx_conf_wal_sfty_tq_lih_chr Cxx_dtc_lb_sfty_tq_lih_chr Cxx_dtc_obd_spg_chr Cxx_conf_wal_spg_chr Cbx_obd_spg_chr Cbx_obd_mena_spg_chr Cxx_dtc_lb_spg_chr Cxx_obd_dc_spg_chr Cxx_dtc_obd_spg_oor Cxx_conf_wal_spg_oor Cbx_obd_spg_oor Cbx_obd_mena_spg_oor Cxx_dtc_lb_spg_oor Cxx_obd_dc_spg_oor Cxx_dtc_obd_spg_reg_apl_down Cxx_conf_wal_spg_reg_apl_down Cbx_obd_spg_reg_apl_down Cbx_obd_mena_spg_reg_apl_down Cxx_dtc_lb_spg_reg_apl_down Cxx_obd_dc_spg_reg_apl_down Cxx_dtc_obd_spg_reg_apl_up Cxx_conf_wal_spg_reg_apl_up Cbx_obd_spg_reg_apl_up Cbx_obd_mena_spg_reg_apl_up Cxx_dtc_lb_spg_reg_apl_up Cxx_obd_dc_spg_reg_apl_up Cxx_dtc_obd_tlz_ad_b_cpt Cxx_conf_wal_tlz_ad_b_cpt Cbx_obd_tlz_ad_b_cpt Cbx_obd_mena_tlz_ad_b_cpt Cxx_dtc_lb_tlz_ad_b_cpt Cxx_obd_dc_tlz_ad_b_cpt Cxx_dtc_obd_vb_clc_chr Cxx_conf_wal_vb_clc_chr Cbx_obd_vb_clc_chr Cbx_obd_mena_vb_clc_chr Cxx_dtc_lb_vb_clc_chr Cxx_obd_dc_vb_clc_chr Cxx_dtc_obd_vb_h Cxx_conf_wal_vb_h Cbx_obd_vb_h Cbx_obd_mena_vb_h Cxx_dtc_lb_vb_h Cxx_obd_dc_vb_h Cxx_dtc_obd_vb_l Cxx_conf_wal_vb_l Cbx_obd_vb_l Cbx_obd_mena_vb_l Cxx_dtc_lb_vb_l Cxx_obd_dc_vb_l Cxx_dtc_obd_vb_rly_oc_scg Cxx_conf_wal_vb_rly_oc_scg Cbx_obd_vb_rly_oc_scg Cbx_obd_mena_vb_rly_oc_scg Cxx_dtc_lb_vb_rly_oc_scg Cxx_obd_dc_vb_rly_oc_scg Cxx_dtc_obd_vb_rly_scw Cxx_conf_wal_vb_rly_scw Cbx_obd_vb_rly_scw Cbx_obd_mena_vb_rly_scw Cxx_dtc_lb_vb_rly_scw Cxx_obd_dc_vb_rly_scw Cxx_dtc_obd_wgc_oc Cxx_conf_wal_wgc_oc Cbx_obd_wgc_oc Cbx_obd_mena_wgc_oc Cxx_dtc_lb_wgc_oc Cxx_obd_dc_wgc_oc Cxx_dtc_obd_wgc_scg Cxx_conf_wal_wgc_scg Cbx_obd_wgc_scg Cbx_obd_mena_wgc_scg Cxx_dtc_lb_wgc_scg Cxx_obd_dc_wgc_scg Cxx_dtc_obd_wgc_scw Cxx_conf_wal_wgc_scw Cbx_obd_wgc_scw Cbx_obd_mena_wgc_scw Cxx_dtc_lb_wgc_scw Cxx_obd_dc_wgc_scw Cxx_conf_wal_wpmp_tcr_blk Cxx_dtc_lb_wpmp_tcr_blk Cxx_conf_wal_wpmp_tcr_oc Cxx_dtc_lb_wpmp_tcr_oc Cxx_conf_wal_wpmp_tcr_scg Cxx_dtc_lb_wpmp_tcr_scg Cxx_conf_wal_wpmp_tcr_scw Cxx_dtc_lb_wpmp_tcr_scw /end DEF_CHARACTERISTIC
/end FUNCTION
/end MODULE
/end PROJECT
