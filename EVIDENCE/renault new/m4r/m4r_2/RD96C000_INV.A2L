ASAP2_VERSION 1 41
/begin PROJECT RD8 "_default_ProjectLongIdentifier"
/begin HEADER "_default_HeaderComment" PROJECT_NO RD9 /end HEADER
/begin MODULE _default_ModuleName "_default_ModuleLongIdentifier"
/begin MOD_COMMON "_default_ModCommonComment" DEPOSIT ABSOLUTE BYTE_ORDER MSB_LAST ALIGNMENT_BYTE 1 ALIGNMENT_WORD 2 ALIGNMENT_LONG 2 ALIGNMENT_FLOAT32_IEEE 2 ALIGNMENT_FLOAT64_IEEE 4 /end MOD_COMMON
/begin AXIS_PTS Ctb_eal "16 breakpoint table for Engine air load" 0xa002a6fc Vxx_eal _REC_A2AXS_20_u2 3.99993896484375 _CNV_A_R_LINEAR_____53_CM 16 0. 3.99993896484375 FORMAT "%10.8" /end AXIS_PTS
/begin AXIS_PTS Ctb_sta_tco "Coolant temperature breakpoints for starting set point tables" 0xa002dfe4 Vxx_tco _REC_A2AXS_20_u2 240. _CNV_A_R_LINEAR_____54_CM 8 -40. 200. FORMAT "%5.1" /end AXIS_PTS
/begin AXIS_PTS Ctb_tco "16 engine coolant temperature breakpoints" 0xa002dff8 Vxx_tco _REC_A2AXS_20_u2 240. _CNV_A_R_LINEAR_____54_CM 16 -40. 200. FORMAT "%5.1" /end AXIS_PTS
/begin AXIS_PTS Ctb_prs "" 0xa0028dac Vxx_map _REC_A2AXS_20_u2 20000. _CNV_A_R_LINEAR_____57_CM 17 0. 20000. FORMAT "%5.0" /end AXIS_PTS
/begin MEASUREMENT Vbx_int_mfo_cata_cpt "Catalyst Component Internal memorised obd failure" UBYTE _CNV_S_2_RANGE______3_CM 1 0. 0. 1. ECU_ADDRESS 0xd0005627 BIT_MASK 0x1 /end MEASUREMENT
/begin MEASUREMENT Vbx_int_mfo_lbup_cpt "Front Oxygen Sensor (L/R) Component Internal memorised obd failure" UBYTE _CNV_S_2_RANGE______3_CM 1 0. 0. 1. ECU_ADDRESS 0xd0005628 BIT_MASK 0x1 /end MEASUREMENT
/begin MEASUREMENT Vbx_obd_rdn_cata_cpt "Stored status of the Catalyst Component OBD readiness code (0 = test complete)" UBYTE _CNV_S_2_RANGE______3_CM 1 0. 0. 1. ECU_ADDRESS 0xd0005629 BIT_MASK 0x1 /end MEASUREMENT
/begin MEASUREMENT Vbx_obd_rdn_cpt "Status of the comprehensive component OBD readiness code (0 = test complete)" UBYTE _CNV_S_2_RANGE______217_CM 1 0. 0. 1. ECU_ADDRESS 0xd000562a BIT_MASK 0x1 /end MEASUREMENT
/begin MEASUREMENT Vbx_obd_rdn_fsys "Status of the fuel system OBD readiness code (0 = test complete)" UBYTE _CNV_S_2_RANGE______217_CM 1 0. 0. 1. ECU_ADDRESS 0xd000562b BIT_MASK 0x1 /end MEASUREMENT
/begin MEASUREMENT Vbx_obd_rdn_full "All readiness codes completion status flag" UBYTE _CNV_S_2_RANGE______3_CM 1 0. 0. 1. ECU_ADDRESS 0xd000562c BIT_MASK 0x1 /end MEASUREMENT
/begin MEASUREMENT Vbx_obd_rdn_lbup_cpt "increment of the counter of engine start with extremes conditions" UBYTE _CNV_S_2_RANGE______3_CM 1 0. 0. 1. ECU_ADDRESS 0xd000562d BIT_MASK 0x1 /end MEASUREMENT
/begin MEASUREMENT Vbx_obd_rdn_mis "Status of the misfire OBD readiness code (0 = test complete)" UBYTE _CNV_S_2_RANGE______217_CM 1 0. 0. 1. ECU_ADDRESS 0xd000562e BIT_MASK 0x1 /end MEASUREMENT
/begin MEASUREMENT Stx_frm_pool[0].Vxx_rtn_n01 "Stored engine speed" UWORD _CNV_A_R_ENSD_LINEA_24_CM 1 0. 0. 16383.75 ECU_ADDRESS 0xc00005b4 FORMAT "%8.2" /end MEASUREMENT
/begin MEASUREMENT Stx_frm_pool[0].Vxx_obd_fail_code "DTC that caused required freeze frame data storage" UWORD _CNV_A_R_ECME_LINEA_0_CM 1 0. 0. 65535. ECU_ADDRESS 0xc00005b6 FORMAT "%5.0" /end MEASUREMENT
/begin MEASUREMENT Stx_frm_pool[0].Vxx_rtn_eal "Stored calculated load value for the scantool." UBYTE _CNV_A_R_LINEAR_____114_CM 1 0. 0. 100. ECU_ADDRESS 0xc00005b8 FORMAT "%12.8" /end MEASUREMENT
/begin MEASUREMENT Stx_frm_pool[0].Vxx_rtn_vs "Stored filtered vehicule speed." UBYTE _CNV_A_R_LINEAR_____212_CM 1 0. 0. 255. ECU_ADDRESS 0xc00005b9 FORMAT "%3.0" /end MEASUREMENT
/begin MEASUREMENT Stx_frm_pool[0].Vxx_rtn_map "Stored Manifold pressure value measurement" UBYTE _CNV_A_R_LINEAR_____219_CM 1 0. 0. 255. ECU_ADDRESS 0xc00005ba FORMAT "%3.0" /end MEASUREMENT
/begin MEASUREMENT Stx_frm_pool[0].Vxx_rtn_frm_tco "Stored engine coolant temperature." UBYTE _CNV_A_R_LINEAR_____220_CM 1 0. -40. 215. ECU_ADDRESS 0xc00005bb FORMAT "%3.0" /end MEASUREMENT
/begin MEASUREMENT Stx_frm_pool[0].Vxx_rtn_mv_ad_fac "Stored mean effective gain applied on injected fuel mass quantity" UBYTE _CNV_A_R_LINEAR_____221_CM 1 0. -100. 99.21875 ECU_ADDRESS 0xc00005bc FORMAT "%10.5" /end MEASUREMENT
/begin MEASUREMENT Stx_frm_pool[0].Vxx_rtn_rich_loop_ti_fac "Stored multiplicative factor from richness closed loop applied on injected fuel mass quantity" UBYTE _CNV_A_R_LINEAR_____221_CM 1 0. -100. 99.21875 ECU_ADDRESS 0xc00005bd FORMAT "%10.5" /end MEASUREMENT
/begin MEASUREMENT Stx_frm_pool[0].Vbx_rtn_clos_o2_phs "Stored richness regulation condition" UBYTE _CNV_S_2_RANGE______3_CM 1 0. 0. 1. ECU_ADDRESS 0xc00005be BIT_MASK 0x1 /end MEASUREMENT
/begin MEASUREMENT Stx_frm_pool[0].Vxx_rtn_mat "Stored intake air temperature" UBYTE _CNV_A_R_LINEAR_____220_CM 1 0. -40. 215. ECU_ADDRESS 0xc00005bf FORMAT "%3.0" /end MEASUREMENT
/begin MEASUREMENT Stx_frm_pool[0].Vxx_rtn_clr_dist "Stored distance travelled since last clear" UWORD _CNV_A_R_LINEAR_____218_CM 1 0. 0. 65535. ECU_ADDRESS 0xc00005c0 FORMAT "%5.0" /end MEASUREMENT
/begin MEASUREMENT Stx_frm_pool[0].Vxx_ind_xxx "static index" UWORD _CNV_A_R_ECME_LINEA_0_CM 1 0. 0. 65535. ECU_ADDRESS 0xc00005c2 FORMAT "%5.0" /end MEASUREMENT
/begin MEASUREMENT Stx_frm_pool[0].Vxx_rtn_maf "Stored Mass air flow" UWORD _CNV_A_R_LINEAR_____222_CM 1 0. 0. 655.35 ECU_ADDRESS 0xc00005c4 FORMAT "%6.2" /end MEASUREMENT
/begin MEASUREMENT Stx_frm_pool[0].Vxx_rtn_rail_prs "Stored Rail pressure measured" UWORD _CNV_A_R_LINEAR_____223_CM 1 0. 0. 655350. ECU_ADDRESS 0xc00005c6 FORMAT "%6.0" /end MEASUREMENT
/begin MEASUREMENT Stx_frm_pool[0].Vxx_rtn_tia "Stored intake air temperature" UBYTE _CNV_A_R_LINEAR_____220_CM 1 0. -40. 215. ECU_ADDRESS 0xc00005c8 FORMAT "%3.0" /end MEASUREMENT
/begin MEASUREMENT Stx_frm_pool[0].Vxx_dgdftmng_priority "Local frame priority" UBYTE _CNV_A_R_ECME_LINEA_0_CM 1 0. 0. 6. ECU_ADDRESS 0xc00005c9 FORMAT "%1.0" /end MEASUREMENT
/begin MEASUREMENT Stx_frm_pool[0].Vxx_rtn_rvac "Stored raw Tank differential pressure value for Scantool." SWORD _CNV_A_R_LINEAR_____224_CM 1 0. -8192. 8191.75 ECU_ADDRESS 0xc00005ca FORMAT "%8.2" /end MEASUREMENT
/begin MEASUREMENT Stx_frm_pool[1].Vxx_rtn_n01 "Stored engine speed" UWORD _CNV_A_R_ENSD_LINEA_24_CM 1 0. 0. 16383.75 ECU_ADDRESS 0xc00005cc FORMAT "%8.2" /end MEASUREMENT
/begin MEASUREMENT Stx_frm_pool[1].Vxx_obd_fail_code "DTC that caused required freeze frame data storage" UWORD _CNV_A_R_ECME_LINEA_0_CM 1 0. 0. 65535. ECU_ADDRESS 0xc00005ce FORMAT "%5.0" /end MEASUREMENT
/begin MEASUREMENT Stx_frm_pool[1].Vxx_rtn_eal "Stored calculated load value for the scantool." UBYTE _CNV_A_R_LINEAR_____114_CM 1 0. 0. 100. ECU_ADDRESS 0xc00005d0 FORMAT "%12.8" /end MEASUREMENT
/begin MEASUREMENT Stx_frm_pool[1].Vxx_rtn_vs "Stored filtered vehicule speed." UBYTE _CNV_A_R_LINEAR_____212_CM 1 0. 0. 255. ECU_ADDRESS 0xc00005d1 FORMAT "%3.0" /end MEASUREMENT
/begin MEASUREMENT Stx_frm_pool[1].Vxx_rtn_map "Stored Manifold pressure value measurement" UBYTE _CNV_A_R_LINEAR_____219_CM 1 0. 0. 255. ECU_ADDRESS 0xc00005d2 FORMAT "%3.0" /end MEASUREMENT
/begin MEASUREMENT Stx_frm_pool[1].Vxx_rtn_frm_tco "Stored engine coolant temperature." UBYTE _CNV_A_R_LINEAR_____220_CM 1 0. -40. 215. ECU_ADDRESS 0xc00005d3 FORMAT "%3.0" /end MEASUREMENT
/begin MEASUREMENT Stx_frm_pool[1].Vxx_rtn_mv_ad_fac "Stored mean effective gain applied on injected fuel mass quantity" UBYTE _CNV_A_R_LINEAR_____221_CM 1 0. -100. 99.21875 ECU_ADDRESS 0xc00005d4 FORMAT "%10.5" /end MEASUREMENT
/begin MEASUREMENT Stx_frm_pool[1].Vxx_rtn_rich_loop_ti_fac "Stored multiplicative factor from richness closed loop applied on injected fuel mass quantity" UBYTE _CNV_A_R_LINEAR_____221_CM 1 0. -100. 99.21875 ECU_ADDRESS 0xc00005d5 FORMAT "%10.5" /end MEASUREMENT
/begin MEASUREMENT Stx_frm_pool[1].Vbx_rtn_clos_o2_phs "Stored richness regulation condition" UBYTE _CNV_S_2_RANGE______3_CM 1 0. 0. 1. ECU_ADDRESS 0xc00005d6 BIT_MASK 0x1 /end MEASUREMENT
/begin MEASUREMENT Stx_frm_pool[1].Vxx_rtn_mat "Stored intake air temperature" UBYTE _CNV_A_R_LINEAR_____220_CM 1 0. -40. 215. ECU_ADDRESS 0xc00005d7 FORMAT "%3.0" /end MEASUREMENT
/begin MEASUREMENT Stx_frm_pool[1].Vxx_rtn_clr_dist "Stored distance travelled since last clear" UWORD _CNV_A_R_LINEAR_____218_CM 1 0. 0. 65535. ECU_ADDRESS 0xc00005d8 FORMAT "%5.0" /end MEASUREMENT
/begin MEASUREMENT Stx_frm_pool[1].Vxx_ind_xxx "static index" UWORD _CNV_A_R_ECME_LINEA_0_CM 1 0. 0. 65535. ECU_ADDRESS 0xc00005da FORMAT "%5.0" /end MEASUREMENT
/begin MEASUREMENT Stx_frm_pool[1].Vxx_rtn_maf "Stored Mass air flow" UWORD _CNV_A_R_LINEAR_____222_CM 1 0. 0. 655.35 ECU_ADDRESS 0xc00005dc FORMAT "%6.2" /end MEASUREMENT
/begin MEASUREMENT Stx_frm_pool[1].Vxx_rtn_rail_prs "Stored Rail pressure measured" UWORD _CNV_A_R_LINEAR_____223_CM 1 0. 0. 655350. ECU_ADDRESS 0xc00005de FORMAT "%6.0" /end MEASUREMENT
/begin MEASUREMENT Stx_frm_pool[1].Vxx_rtn_tia "Stored intake air temperature" UBYTE _CNV_A_R_LINEAR_____220_CM 1 0. -40. 215. ECU_ADDRESS 0xc00005e0 FORMAT "%3.0" /end MEASUREMENT
/begin MEASUREMENT Stx_frm_pool[1].Vxx_dgdftmng_priority "Local frame priority" UBYTE _CNV_A_R_ECME_LINEA_0_CM 1 0. 0. 6. ECU_ADDRESS 0xc00005e1 FORMAT "%1.0" /end MEASUREMENT
/begin MEASUREMENT Stx_frm_pool[1].Vxx_rtn_rvac "Stored raw Tank differential pressure value for Scantool." SWORD _CNV_A_R_LINEAR_____224_CM 1 0. -8192. 8191.75 ECU_ADDRESS 0xc00005e2 FORMAT "%8.2" /end MEASUREMENT
/begin MEASUREMENT Stx_frm_pool[2].Vxx_rtn_n01 "Stored engine speed" UWORD _CNV_A_R_ENSD_LINEA_24_CM 1 0. 0. 16383.75 ECU_ADDRESS 0xc00005e4 FORMAT "%8.2" /end MEASUREMENT
/begin MEASUREMENT Stx_frm_pool[2].Vxx_obd_fail_code "DTC that caused required freeze frame data storage" UWORD _CNV_A_R_ECME_LINEA_0_CM 1 0. 0. 65535. ECU_ADDRESS 0xc00005e6 FORMAT "%5.0" /end MEASUREMENT
/begin MEASUREMENT Stx_frm_pool[2].Vxx_rtn_eal "Stored calculated load value for the scantool." UBYTE _CNV_A_R_LINEAR_____114_CM 1 0. 0. 100. ECU_ADDRESS 0xc00005e8 FORMAT "%12.8" /end MEASUREMENT
/begin MEASUREMENT Stx_frm_pool[2].Vxx_rtn_vs "Stored filtered vehicule speed." UBYTE _CNV_A_R_LINEAR_____212_CM 1 0. 0. 255. ECU_ADDRESS 0xc00005e9 FORMAT "%3.0" /end MEASUREMENT
/begin MEASUREMENT Stx_frm_pool[2].Vxx_rtn_map "Stored Manifold pressure value measurement" UBYTE _CNV_A_R_LINEAR_____219_CM 1 0. 0. 255. ECU_ADDRESS 0xc00005ea FORMAT "%3.0" /end MEASUREMENT
/begin MEASUREMENT Stx_frm_pool[2].Vxx_rtn_frm_tco "Stored engine coolant temperature." UBYTE _CNV_A_R_LINEAR_____220_CM 1 0. -40. 215. ECU_ADDRESS 0xc00005eb FORMAT "%3.0" /end MEASUREMENT
/begin MEASUREMENT Stx_frm_pool[2].Vxx_rtn_mv_ad_fac "Stored mean effective gain applied on injected fuel mass quantity" UBYTE _CNV_A_R_LINEAR_____221_CM 1 0. -100. 99.21875 ECU_ADDRESS 0xc00005ec FORMAT "%10.5" /end MEASUREMENT
/begin MEASUREMENT Stx_frm_pool[2].Vxx_rtn_rich_loop_ti_fac "Stored multiplicative factor from richness closed loop applied on injected fuel mass quantity" UBYTE _CNV_A_R_LINEAR_____221_CM 1 0. -100. 99.21875 ECU_ADDRESS 0xc00005ed FORMAT "%10.5" /end MEASUREMENT
/begin MEASUREMENT Stx_frm_pool[2].Vbx_rtn_clos_o2_phs "Stored richness regulation condition" UBYTE _CNV_S_2_RANGE______3_CM 1 0. 0. 1. ECU_ADDRESS 0xc00005ee BIT_MASK 0x1 /end MEASUREMENT
/begin MEASUREMENT Stx_frm_pool[2].Vxx_rtn_mat "Stored intake air temperature" UBYTE _CNV_A_R_LINEAR_____220_CM 1 0. -40. 215. ECU_ADDRESS 0xc00005ef FORMAT "%3.0" /end MEASUREMENT
/begin MEASUREMENT Stx_frm_pool[2].Vxx_rtn_clr_dist "Stored distance travelled since last clear" UWORD _CNV_A_R_LINEAR_____218_CM 1 0. 0. 65535. ECU_ADDRESS 0xc00005f0 FORMAT "%5.0" /end MEASUREMENT
/begin MEASUREMENT Stx_frm_pool[2].Vxx_ind_xxx "static index" UWORD _CNV_A_R_ECME_LINEA_0_CM 1 0. 0. 65535. ECU_ADDRESS 0xc00005f2 FORMAT "%5.0" /end MEASUREMENT
/begin MEASUREMENT Stx_frm_pool[2].Vxx_rtn_maf "Stored Mass air flow" UWORD _CNV_A_R_LINEAR_____222_CM 1 0. 0. 655.35 ECU_ADDRESS 0xc00005f4 FORMAT "%6.2" /end MEASUREMENT
/begin MEASUREMENT Stx_frm_pool[2].Vxx_rtn_rail_prs "Stored Rail pressure measured" UWORD _CNV_A_R_LINEAR_____223_CM 1 0. 0. 655350. ECU_ADDRESS 0xc00005f6 FORMAT "%6.0" /end MEASUREMENT
/begin MEASUREMENT Stx_frm_pool[2].Vxx_rtn_tia "Stored intake air temperature" UBYTE _CNV_A_R_LINEAR_____220_CM 1 0. -40. 215. ECU_ADDRESS 0xc00005f8 FORMAT "%3.0" /end MEASUREMENT
/begin MEASUREMENT Stx_frm_pool[2].Vxx_dgdftmng_priority "Local frame priority" UBYTE _CNV_A_R_ECME_LINEA_0_CM 1 0. 0. 6. ECU_ADDRESS 0xc00005f9 FORMAT "%1.0" /end MEASUREMENT
/begin MEASUREMENT Stx_frm_pool[2].Vxx_rtn_rvac "Stored raw Tank differential pressure value for Scantool." SWORD _CNV_A_R_LINEAR_____224_CM 1 0. -8192. 8191.75 ECU_ADDRESS 0xc00005fa FORMAT "%8.2" /end MEASUREMENT
/begin MEASUREMENT Stx_frm_pool[3].Vxx_rtn_n01 "Stored engine speed" UWORD _CNV_A_R_ENSD_LINEA_24_CM 1 0. 0. 16383.75 ECU_ADDRESS 0xc00005fc FORMAT "%8.2" /end MEASUREMENT
/begin MEASUREMENT Stx_frm_pool[3].Vxx_obd_fail_code "DTC that caused required freeze frame data storage" UWORD _CNV_A_R_ECME_LINEA_0_CM 1 0. 0. 65535. ECU_ADDRESS 0xc00005fe FORMAT "%5.0" /end MEASUREMENT
/begin MEASUREMENT Stx_frm_pool[3].Vxx_rtn_eal "Stored calculated load value for the scantool." UBYTE _CNV_A_R_LINEAR_____114_CM 1 0. 0. 100. ECU_ADDRESS 0xc0000600 FORMAT "%12.8" /end MEASUREMENT
/begin MEASUREMENT Stx_frm_pool[3].Vxx_rtn_vs "Stored filtered vehicule speed." UBYTE _CNV_A_R_LINEAR_____212_CM 1 0. 0. 255. ECU_ADDRESS 0xc0000601 FORMAT "%3.0" /end MEASUREMENT
/begin MEASUREMENT Stx_frm_pool[3].Vxx_rtn_map "Stored Manifold pressure value measurement" UBYTE _CNV_A_R_LINEAR_____219_CM 1 0. 0. 255. ECU_ADDRESS 0xc0000602 FORMAT "%3.0" /end MEASUREMENT
/begin MEASUREMENT Stx_frm_pool[3].Vxx_rtn_frm_tco "Stored engine coolant temperature." UBYTE _CNV_A_R_LINEAR_____220_CM 1 0. -40. 215. ECU_ADDRESS 0xc0000603 FORMAT "%3.0" /end MEASUREMENT
/begin MEASUREMENT Stx_frm_pool[3].Vxx_rtn_mv_ad_fac "Stored mean effective gain applied on injected fuel mass quantity" UBYTE _CNV_A_R_LINEAR_____221_CM 1 0. -100. 99.21875 ECU_ADDRESS 0xc0000604 FORMAT "%10.5" /end MEASUREMENT
/begin MEASUREMENT Stx_frm_pool[3].Vxx_rtn_rich_loop_ti_fac "Stored multiplicative factor from richness closed loop applied on injected fuel mass quantity" UBYTE _CNV_A_R_LINEAR_____221_CM 1 0. -100. 99.21875 ECU_ADDRESS 0xc0000605 FORMAT "%10.5" /end MEASUREMENT
/begin MEASUREMENT Stx_frm_pool[3].Vbx_rtn_clos_o2_phs "Stored richness regulation condition" UBYTE _CNV_S_2_RANGE______3_CM 1 0. 0. 1. ECU_ADDRESS 0xc0000606 BIT_MASK 0x1 /end MEASUREMENT
/begin MEASUREMENT Stx_frm_pool[3].Vxx_rtn_mat "Stored intake air temperature" UBYTE _CNV_A_R_LINEAR_____220_CM 1 0. -40. 215. ECU_ADDRESS 0xc0000607 FORMAT "%3.0" /end MEASUREMENT
/begin MEASUREMENT Stx_frm_pool[3].Vxx_rtn_clr_dist "Stored distance travelled since last clear" UWORD _CNV_A_R_LINEAR_____218_CM 1 0. 0. 65535. ECU_ADDRESS 0xc0000608 FORMAT "%5.0" /end MEASUREMENT
/begin MEASUREMENT Stx_frm_pool[3].Vxx_ind_xxx "static index" UWORD _CNV_A_R_ECME_LINEA_0_CM 1 0. 0. 65535. ECU_ADDRESS 0xc000060a FORMAT "%5.0" /end MEASUREMENT
/begin MEASUREMENT Stx_frm_pool[3].Vxx_rtn_maf "Stored Mass air flow" UWORD _CNV_A_R_LINEAR_____222_CM 1 0. 0. 655.35 ECU_ADDRESS 0xc000060c FORMAT "%6.2" /end MEASUREMENT
/begin MEASUREMENT Stx_frm_pool[3].Vxx_rtn_rail_prs "Stored Rail pressure measured" UWORD _CNV_A_R_LINEAR_____223_CM 1 0. 0. 655350. ECU_ADDRESS 0xc000060e FORMAT "%6.0" /end MEASUREMENT
/begin MEASUREMENT Stx_frm_pool[3].Vxx_rtn_tia "Stored intake air temperature" UBYTE _CNV_A_R_LINEAR_____220_CM 1 0. -40. 215. ECU_ADDRESS 0xc0000610 FORMAT "%3.0" /end MEASUREMENT
/begin MEASUREMENT Stx_frm_pool[3].Vxx_dgdftmng_priority "Local frame priority" UBYTE _CNV_A_R_ECME_LINEA_0_CM 1 0. 0. 6. ECU_ADDRESS 0xc0000611 FORMAT "%1.0" /end MEASUREMENT
/begin MEASUREMENT Stx_frm_pool[3].Vxx_rtn_rvac "Stored raw Tank differential pressure value for Scantool." SWORD _CNV_A_R_LINEAR_____224_CM 1 0. -8192. 8191.75 ECU_ADDRESS 0xc0000612 FORMAT "%8.2" /end MEASUREMENT
/begin MEASUREMENT Stx_frm_pool[4].Vxx_rtn_n01 "Stored engine speed" UWORD _CNV_A_R_ENSD_LINEA_24_CM 1 0. 0. 16383.75 ECU_ADDRESS 0xc0000614 FORMAT "%8.2" /end MEASUREMENT
/begin MEASUREMENT Stx_frm_pool[4].Vxx_obd_fail_code "DTC that caused required freeze frame data storage" UWORD _CNV_A_R_ECME_LINEA_0_CM 1 0. 0. 65535. ECU_ADDRESS 0xc0000616 FORMAT "%5.0" /end MEASUREMENT
/begin MEASUREMENT Stx_frm_pool[4].Vxx_rtn_eal "Stored calculated load value for the scantool." UBYTE _CNV_A_R_LINEAR_____114_CM 1 0. 0. 100. ECU_ADDRESS 0xc0000618 FORMAT "%12.8" /end MEASUREMENT
/begin MEASUREMENT Stx_frm_pool[4].Vxx_rtn_vs "Stored filtered vehicule speed." UBYTE _CNV_A_R_LINEAR_____212_CM 1 0. 0. 255. ECU_ADDRESS 0xc0000619 FORMAT "%3.0" /end MEASUREMENT
/begin MEASUREMENT Stx_frm_pool[4].Vxx_rtn_map "Stored Manifold pressure value measurement" UBYTE _CNV_A_R_LINEAR_____219_CM 1 0. 0. 255. ECU_ADDRESS 0xc000061a FORMAT "%3.0" /end MEASUREMENT
/begin MEASUREMENT Stx_frm_pool[4].Vxx_rtn_frm_tco "Stored engine coolant temperature." UBYTE _CNV_A_R_LINEAR_____220_CM 1 0. -40. 215. ECU_ADDRESS 0xc000061b FORMAT "%3.0" /end MEASUREMENT
/begin MEASUREMENT Stx_frm_pool[4].Vxx_rtn_mv_ad_fac "Stored mean effective gain applied on injected fuel mass quantity" UBYTE _CNV_A_R_LINEAR_____221_CM 1 0. -100. 99.21875 ECU_ADDRESS 0xc000061c FORMAT "%10.5" /end MEASUREMENT
/begin MEASUREMENT Stx_frm_pool[4].Vxx_rtn_rich_loop_ti_fac "Stored multiplicative factor from richness closed loop applied on injected fuel mass quantity" UBYTE _CNV_A_R_LINEAR_____221_CM 1 0. -100. 99.21875 ECU_ADDRESS 0xc000061d FORMAT "%10.5" /end MEASUREMENT
/begin MEASUREMENT Stx_frm_pool[4].Vbx_rtn_clos_o2_phs "Stored richness regulation condition" UBYTE _CNV_S_2_RANGE______3_CM 1 0. 0. 1. ECU_ADDRESS 0xc000061e BIT_MASK 0x1 /end MEASUREMENT
/begin MEASUREMENT Stx_frm_pool[4].Vxx_rtn_mat "Stored intake air temperature" UBYTE _CNV_A_R_LINEAR_____220_CM 1 0. -40. 215. ECU_ADDRESS 0xc000061f FORMAT "%3.0" /end MEASUREMENT
/begin MEASUREMENT Stx_frm_pool[4].Vxx_rtn_clr_dist "Stored distance travelled since last clear" UWORD _CNV_A_R_LINEAR_____218_CM 1 0. 0. 65535. ECU_ADDRESS 0xc0000620 FORMAT "%5.0" /end MEASUREMENT
/begin MEASUREMENT Stx_frm_pool[4].Vxx_ind_xxx "static index" UWORD _CNV_A_R_ECME_LINEA_0_CM 1 0. 0. 65535. ECU_ADDRESS 0xc0000622 FORMAT "%5.0" /end MEASUREMENT
/begin MEASUREMENT Stx_frm_pool[4].Vxx_rtn_maf "Stored Mass air flow" UWORD _CNV_A_R_LINEAR_____222_CM 1 0. 0. 655.35 ECU_ADDRESS 0xc0000624 FORMAT "%6.2" /end MEASUREMENT
/begin MEASUREMENT Stx_frm_pool[4].Vxx_rtn_rail_prs "Stored Rail pressure measured" UWORD _CNV_A_R_LINEAR_____223_CM 1 0. 0. 655350. ECU_ADDRESS 0xc0000626 FORMAT "%6.0" /end MEASUREMENT
/begin MEASUREMENT Stx_frm_pool[4].Vxx_rtn_tia "Stored intake air temperature" UBYTE _CNV_A_R_LINEAR_____220_CM 1 0. -40. 215. ECU_ADDRESS 0xc0000628 FORMAT "%3.0" /end MEASUREMENT
/begin MEASUREMENT Stx_frm_pool[4].Vxx_dgdftmng_priority "Local frame priority" UBYTE _CNV_A_R_ECME_LINEA_0_CM 1 0. 0. 6. ECU_ADDRESS 0xc0000629 FORMAT "%1.0" /end MEASUREMENT
/begin MEASUREMENT Stx_frm_pool[4].Vxx_rtn_rvac "Stored raw Tank differential pressure value for Scantool." SWORD _CNV_A_R_LINEAR_____224_CM 1 0. -8192. 8191.75 ECU_ADDRESS 0xc000062a FORMAT "%8.2" /end MEASUREMENT
/begin MEASUREMENT Stx_frm_pool[5].Vxx_rtn_n01 "Stored engine speed" UWORD _CNV_A_R_ENSD_LINEA_24_CM 1 0. 0. 16383.75 ECU_ADDRESS 0xc000062c FORMAT "%8.2" /end MEASUREMENT
/begin MEASUREMENT Stx_frm_pool[5].Vxx_obd_fail_code "DTC that caused required freeze frame data storage" UWORD _CNV_A_R_ECME_LINEA_0_CM 1 0. 0. 65535. ECU_ADDRESS 0xc000062e FORMAT "%5.0" /end MEASUREMENT
/begin MEASUREMENT Stx_frm_pool[5].Vxx_rtn_eal "Stored calculated load value for the scantool." UBYTE _CNV_A_R_LINEAR_____114_CM 1 0. 0. 100. ECU_ADDRESS 0xc0000630 FORMAT "%12.8" /end MEASUREMENT
/begin MEASUREMENT Stx_frm_pool[5].Vxx_rtn_vs "Stored filtered vehicule speed." UBYTE _CNV_A_R_LINEAR_____212_CM 1 0. 0. 255. ECU_ADDRESS 0xc0000631 FORMAT "%3.0" /end MEASUREMENT
/begin MEASUREMENT Stx_frm_pool[5].Vxx_rtn_map "Stored Manifold pressure value measurement" UBYTE _CNV_A_R_LINEAR_____219_CM 1 0. 0. 255. ECU_ADDRESS 0xc0000632 FORMAT "%3.0" /end MEASUREMENT
/begin MEASUREMENT Stx_frm_pool[5].Vxx_rtn_frm_tco "Stored engine coolant temperature." UBYTE _CNV_A_R_LINEAR_____220_CM 1 0. -40. 215. ECU_ADDRESS 0xc0000633 FORMAT "%3.0" /end MEASUREMENT
/begin MEASUREMENT Stx_frm_pool[5].Vxx_rtn_mv_ad_fac "Stored mean effective gain applied on injected fuel mass quantity" UBYTE _CNV_A_R_LINEAR_____221_CM 1 0. -100. 99.21875 ECU_ADDRESS 0xc0000634 FORMAT "%10.5" /end MEASUREMENT
/begin MEASUREMENT Stx_frm_pool[5].Vxx_rtn_rich_loop_ti_fac "Stored multiplicative factor from richness closed loop applied on injected fuel mass quantity" UBYTE _CNV_A_R_LINEAR_____221_CM 1 0. -100. 99.21875 ECU_ADDRESS 0xc0000635 FORMAT "%10.5" /end MEASUREMENT
/begin MEASUREMENT Stx_frm_pool[5].Vbx_rtn_clos_o2_phs "Stored richness regulation condition" UBYTE _CNV_S_2_RANGE______3_CM 1 0. 0. 1. ECU_ADDRESS 0xc0000636 BIT_MASK 0x1 /end MEASUREMENT
/begin MEASUREMENT Stx_frm_pool[5].Vxx_rtn_mat "Stored intake air temperature" UBYTE _CNV_A_R_LINEAR_____220_CM 1 0. -40. 215. ECU_ADDRESS 0xc0000637 FORMAT "%3.0" /end MEASUREMENT
/begin MEASUREMENT Stx_frm_pool[5].Vxx_rtn_clr_dist "Stored distance travelled since last clear" UWORD _CNV_A_R_LINEAR_____218_CM 1 0. 0. 65535. ECU_ADDRESS 0xc0000638 FORMAT "%5.0" /end MEASUREMENT
/begin MEASUREMENT Stx_frm_pool[5].Vxx_ind_xxx "static index" UWORD _CNV_A_R_ECME_LINEA_0_CM 1 0. 0. 65535. ECU_ADDRESS 0xc000063a FORMAT "%5.0" /end MEASUREMENT
/begin MEASUREMENT Stx_frm_pool[5].Vxx_rtn_maf "Stored Mass air flow" UWORD _CNV_A_R_LINEAR_____222_CM 1 0. 0. 655.35 ECU_ADDRESS 0xc000063c FORMAT "%6.2" /end MEASUREMENT
/begin MEASUREMENT Stx_frm_pool[5].Vxx_rtn_rail_prs "Stored Rail pressure measured" UWORD _CNV_A_R_LINEAR_____223_CM 1 0. 0. 655350. ECU_ADDRESS 0xc000063e FORMAT "%6.0" /end MEASUREMENT
/begin MEASUREMENT Stx_frm_pool[5].Vxx_rtn_tia "Stored intake air temperature" UBYTE _CNV_A_R_LINEAR_____220_CM 1 0. -40. 215. ECU_ADDRESS 0xc0000640 FORMAT "%3.0" /end MEASUREMENT
/begin MEASUREMENT Stx_frm_pool[5].Vxx_dgdftmng_priority "Local frame priority" UBYTE _CNV_A_R_ECME_LINEA_0_CM 1 0. 0. 6. ECU_ADDRESS 0xc0000641 FORMAT "%1.0" /end MEASUREMENT
/begin MEASUREMENT Stx_frm_pool[5].Vxx_rtn_rvac "Stored raw Tank differential pressure value for Scantool." SWORD _CNV_A_R_LINEAR_____224_CM 1 0. -8192. 8191.75 ECU_ADDRESS 0xc0000642 FORMAT "%8.2" /end MEASUREMENT
/begin MEASUREMENT Stx_frm_pool[6].Vxx_rtn_n01 "Stored engine speed" UWORD _CNV_A_R_ENSD_LINEA_24_CM 1 0. 0. 16383.75 ECU_ADDRESS 0xc0000644 FORMAT "%8.2" /end MEASUREMENT
/begin MEASUREMENT Stx_frm_pool[6].Vxx_obd_fail_code "DTC that caused required freeze frame data storage" UWORD _CNV_A_R_ECME_LINEA_0_CM 1 0. 0. 65535. ECU_ADDRESS 0xc0000646 FORMAT "%5.0" /end MEASUREMENT
/begin MEASUREMENT Stx_frm_pool[6].Vxx_rtn_eal "Stored calculated load value for the scantool." UBYTE _CNV_A_R_LINEAR_____114_CM 1 0. 0. 100. ECU_ADDRESS 0xc0000648 FORMAT "%12.8" /end MEASUREMENT
/begin MEASUREMENT Stx_frm_pool[6].Vxx_rtn_vs "Stored filtered vehicule speed." UBYTE _CNV_A_R_LINEAR_____212_CM 1 0. 0. 255. ECU_ADDRESS 0xc0000649 FORMAT "%3.0" /end MEASUREMENT
/begin MEASUREMENT Stx_frm_pool[6].Vxx_rtn_map "Stored Manifold pressure value measurement" UBYTE _CNV_A_R_LINEAR_____219_CM 1 0. 0. 255. ECU_ADDRESS 0xc000064a FORMAT "%3.0" /end MEASUREMENT
/begin MEASUREMENT Stx_frm_pool[6].Vxx_rtn_frm_tco "Stored engine coolant temperature." UBYTE _CNV_A_R_LINEAR_____220_CM 1 0. -40. 215. ECU_ADDRESS 0xc000064b FORMAT "%3.0" /end MEASUREMENT
/begin MEASUREMENT Stx_frm_pool[6].Vxx_rtn_mv_ad_fac "Stored mean effective gain applied on injected fuel mass quantity" UBYTE _CNV_A_R_LINEAR_____221_CM 1 0. -100. 99.21875 ECU_ADDRESS 0xc000064c FORMAT "%10.5" /end MEASUREMENT
/begin MEASUREMENT Stx_frm_pool[6].Vxx_rtn_rich_loop_ti_fac "Stored multiplicative factor from richness closed loop applied on injected fuel mass quantity" UBYTE _CNV_A_R_LINEAR_____221_CM 1 0. -100. 99.21875 ECU_ADDRESS 0xc000064d FORMAT "%10.5" /end MEASUREMENT
/begin MEASUREMENT Stx_frm_pool[6].Vbx_rtn_clos_o2_phs "Stored richness regulation condition" UBYTE _CNV_S_2_RANGE______3_CM 1 0. 0. 1. ECU_ADDRESS 0xc000064e BIT_MASK 0x1 /end MEASUREMENT
/begin MEASUREMENT Stx_frm_pool[6].Vxx_rtn_mat "Stored intake air temperature" UBYTE _CNV_A_R_LINEAR_____220_CM 1 0. -40. 215. ECU_ADDRESS 0xc000064f FORMAT "%3.0" /end MEASUREMENT
/begin MEASUREMENT Stx_frm_pool[6].Vxx_rtn_clr_dist "Stored distance travelled since last clear" UWORD _CNV_A_R_LINEAR_____218_CM 1 0. 0. 65535. ECU_ADDRESS 0xc0000650 FORMAT "%5.0" /end MEASUREMENT
/begin MEASUREMENT Stx_frm_pool[6].Vxx_ind_xxx "static index" UWORD _CNV_A_R_ECME_LINEA_0_CM 1 0. 0. 65535. ECU_ADDRESS 0xc0000652 FORMAT "%5.0" /end MEASUREMENT
/begin MEASUREMENT Stx_frm_pool[6].Vxx_rtn_maf "Stored Mass air flow" UWORD _CNV_A_R_LINEAR_____222_CM 1 0. 0. 655.35 ECU_ADDRESS 0xc0000654 FORMAT "%6.2" /end MEASUREMENT
/begin MEASUREMENT Stx_frm_pool[6].Vxx_rtn_rail_prs "Stored Rail pressure measured" UWORD _CNV_A_R_LINEAR_____223_CM 1 0. 0. 655350. ECU_ADDRESS 0xc0000656 FORMAT "%6.0" /end MEASUREMENT
/begin MEASUREMENT Stx_frm_pool[6].Vxx_rtn_tia "Stored intake air temperature" UBYTE _CNV_A_R_LINEAR_____220_CM 1 0. -40. 215. ECU_ADDRESS 0xc0000658 FORMAT "%3.0" /end MEASUREMENT
/begin MEASUREMENT Stx_frm_pool[6].Vxx_dgdftmng_priority "Local frame priority" UBYTE _CNV_A_R_ECME_LINEA_0_CM 1 0. 0. 6. ECU_ADDRESS 0xc0000659 FORMAT "%1.0" /end MEASUREMENT
/begin MEASUREMENT Stx_frm_pool[6].Vxx_rtn_rvac "Stored raw Tank differential pressure value for Scantool." SWORD _CNV_A_R_LINEAR_____224_CM 1 0. -8192. 8191.75 ECU_ADDRESS 0xc000065a FORMAT "%8.2" /end MEASUREMENT
/begin MEASUREMENT Stx_frm_pool[7].Vxx_rtn_n01 "Stored engine speed" UWORD _CNV_A_R_ENSD_LINEA_24_CM 1 0. 0. 16383.75 ECU_ADDRESS 0xc000065c FORMAT "%8.2" /end MEASUREMENT
/begin MEASUREMENT Stx_frm_pool[7].Vxx_obd_fail_code "DTC that caused required freeze frame data storage" UWORD _CNV_A_R_ECME_LINEA_0_CM 1 0. 0. 65535. ECU_ADDRESS 0xc000065e FORMAT "%5.0" /end MEASUREMENT
/begin MEASUREMENT Stx_frm_pool[7].Vxx_rtn_eal "Stored calculated load value for the scantool." UBYTE _CNV_A_R_LINEAR_____114_CM 1 0. 0. 100. ECU_ADDRESS 0xc0000660 FORMAT "%12.8" /end MEASUREMENT
/begin MEASUREMENT Stx_frm_pool[7].Vxx_rtn_vs "Stored filtered vehicule speed." UBYTE _CNV_A_R_LINEAR_____212_CM 1 0. 0. 255. ECU_ADDRESS 0xc0000661 FORMAT "%3.0" /end MEASUREMENT
/begin MEASUREMENT Stx_frm_pool[7].Vxx_rtn_map "Stored Manifold pressure value measurement" UBYTE _CNV_A_R_LINEAR_____219_CM 1 0. 0. 255. ECU_ADDRESS 0xc0000662 FORMAT "%3.0" /end MEASUREMENT
/begin MEASUREMENT Stx_frm_pool[7].Vxx_rtn_frm_tco "Stored engine coolant temperature." UBYTE _CNV_A_R_LINEAR_____220_CM 1 0. -40. 215. ECU_ADDRESS 0xc0000663 FORMAT "%3.0" /end MEASUREMENT
/begin MEASUREMENT Stx_frm_pool[7].Vxx_rtn_mv_ad_fac "Stored mean effective gain applied on injected fuel mass quantity" UBYTE _CNV_A_R_LINEAR_____221_CM 1 0. -100. 99.21875 ECU_ADDRESS 0xc0000664 FORMAT "%10.5" /end MEASUREMENT
/begin MEASUREMENT Stx_frm_pool[7].Vxx_rtn_rich_loop_ti_fac "Stored multiplicative factor from richness closed loop applied on injected fuel mass quantity" UBYTE _CNV_A_R_LINEAR_____221_CM 1 0. -100. 99.21875 ECU_ADDRESS 0xc0000665 FORMAT "%10.5" /end MEASUREMENT
/begin MEASUREMENT Stx_frm_pool[7].Vbx_rtn_clos_o2_phs "Stored richness regulation condition" UBYTE _CNV_S_2_RANGE______3_CM 1 0. 0. 1. ECU_ADDRESS 0xc0000666 BIT_MASK 0x1 /end MEASUREMENT
/begin MEASUREMENT Stx_frm_pool[7].Vxx_rtn_mat "Stored intake air temperature" UBYTE _CNV_A_R_LINEAR_____220_CM 1 0. -40. 215. ECU_ADDRESS 0xc0000667 FORMAT "%3.0" /end MEASUREMENT
/begin MEASUREMENT Stx_frm_pool[7].Vxx_rtn_clr_dist "Stored distance travelled since last clear" UWORD _CNV_A_R_LINEAR_____218_CM 1 0. 0. 65535. ECU_ADDRESS 0xc0000668 FORMAT "%5.0" /end MEASUREMENT
/begin MEASUREMENT Stx_frm_pool[7].Vxx_ind_xxx "static index" UWORD _CNV_A_R_ECME_LINEA_0_CM 1 0. 0. 65535. ECU_ADDRESS 0xc000066a FORMAT "%5.0" /end MEASUREMENT
/begin MEASUREMENT Stx_frm_pool[7].Vxx_rtn_maf "Stored Mass air flow" UWORD _CNV_A_R_LINEAR_____222_CM 1 0. 0. 655.35 ECU_ADDRESS 0xc000066c FORMAT "%6.2" /end MEASUREMENT
/begin MEASUREMENT Stx_frm_pool[7].Vxx_rtn_rail_prs "Stored Rail pressure measured" UWORD _CNV_A_R_LINEAR_____223_CM 1 0. 0. 655350. ECU_ADDRESS 0xc000066e FORMAT "%6.0" /end MEASUREMENT
/begin MEASUREMENT Stx_frm_pool[7].Vxx_rtn_tia "Stored intake air temperature" UBYTE _CNV_A_R_LINEAR_____220_CM 1 0. -40. 215. ECU_ADDRESS 0xc0000670 FORMAT "%3.0" /end MEASUREMENT
/begin MEASUREMENT Stx_frm_pool[7].Vxx_dgdftmng_priority "Local frame priority" UBYTE _CNV_A_R_ECME_LINEA_0_CM 1 0. 0. 6. ECU_ADDRESS 0xc0000671 FORMAT "%1.0" /end MEASUREMENT
/begin MEASUREMENT Stx_frm_pool[7].Vxx_rtn_rvac "Stored raw Tank differential pressure value for Scantool." SWORD _CNV_A_R_LINEAR_____224_CM 1 0. -8192. 8191.75 ECU_ADDRESS 0xc0000672 FORMAT "%8.2" /end MEASUREMENT
/begin MEASUREMENT Stx_frm_pool[8].Vxx_rtn_n01 "Stored engine speed" UWORD _CNV_A_R_ENSD_LINEA_24_CM 1 0. 0. 16383.75 ECU_ADDRESS 0xc0000674 FORMAT "%8.2" /end MEASUREMENT
/begin MEASUREMENT Stx_frm_pool[8].Vxx_obd_fail_code "DTC that caused required freeze frame data storage" UWORD _CNV_A_R_ECME_LINEA_0_CM 1 0. 0. 65535. ECU_ADDRESS 0xc0000676 FORMAT "%5.0" /end MEASUREMENT
/begin MEASUREMENT Stx_frm_pool[8].Vxx_rtn_eal "Stored calculated load value for the scantool." UBYTE _CNV_A_R_LINEAR_____114_CM 1 0. 0. 100. ECU_ADDRESS 0xc0000678 FORMAT "%12.8" /end MEASUREMENT
/begin MEASUREMENT Stx_frm_pool[8].Vxx_rtn_vs "Stored filtered vehicule speed." UBYTE _CNV_A_R_LINEAR_____212_CM 1 0. 0. 255. ECU_ADDRESS 0xc0000679 FORMAT "%3.0" /end MEASUREMENT
/begin MEASUREMENT Stx_frm_pool[8].Vxx_rtn_map "Stored Manifold pressure value measurement" UBYTE _CNV_A_R_LINEAR_____219_CM 1 0. 0. 255. ECU_ADDRESS 0xc000067a FORMAT "%3.0" /end MEASUREMENT
/begin MEASUREMENT Stx_frm_pool[8].Vxx_rtn_frm_tco "Stored engine coolant temperature." UBYTE _CNV_A_R_LINEAR_____220_CM 1 0. -40. 215. ECU_ADDRESS 0xc000067b FORMAT "%3.0" /end MEASUREMENT
/begin MEASUREMENT Stx_frm_pool[8].Vxx_rtn_mv_ad_fac "Stored mean effective gain applied on injected fuel mass quantity" UBYTE _CNV_A_R_LINEAR_____221_CM 1 0. -100. 99.21875 ECU_ADDRESS 0xc000067c FORMAT "%10.5" /end MEASUREMENT
/begin MEASUREMENT Stx_frm_pool[8].Vxx_rtn_rich_loop_ti_fac "Stored multiplicative factor from richness closed loop applied on injected fuel mass quantity" UBYTE _CNV_A_R_LINEAR_____221_CM 1 0. -100. 99.21875 ECU_ADDRESS 0xc000067d FORMAT "%10.5" /end MEASUREMENT
/begin MEASUREMENT Stx_frm_pool[8].Vbx_rtn_clos_o2_phs "Stored richness regulation condition" UBYTE _CNV_S_2_RANGE______3_CM 1 0. 0. 1. ECU_ADDRESS 0xc000067e BIT_MASK 0x1 /end MEASUREMENT
/begin MEASUREMENT Stx_frm_pool[8].Vxx_rtn_mat "Stored intake air temperature" UBYTE _CNV_A_R_LINEAR_____220_CM 1 0. -40. 215. ECU_ADDRESS 0xc000067f FORMAT "%3.0" /end MEASUREMENT
/begin MEASUREMENT Stx_frm_pool[8].Vxx_rtn_clr_dist "Stored distance travelled since last clear" UWORD _CNV_A_R_LINEAR_____218_CM 1 0. 0. 65535. ECU_ADDRESS 0xc0000680 FORMAT "%5.0" /end MEASUREMENT
/begin MEASUREMENT Stx_frm_pool[8].Vxx_ind_xxx "static index" UWORD _CNV_A_R_ECME_LINEA_0_CM 1 0. 0. 65535. ECU_ADDRESS 0xc0000682 FORMAT "%5.0" /end MEASUREMENT
/begin MEASUREMENT Stx_frm_pool[8].Vxx_rtn_maf "Stored Mass air flow" UWORD _CNV_A_R_LINEAR_____222_CM 1 0. 0. 655.35 ECU_ADDRESS 0xc0000684 FORMAT "%6.2" /end MEASUREMENT
/begin MEASUREMENT Stx_frm_pool[8].Vxx_rtn_rail_prs "Stored Rail pressure measured" UWORD _CNV_A_R_LINEAR_____223_CM 1 0. 0. 655350. ECU_ADDRESS 0xc0000686 FORMAT "%6.0" /end MEASUREMENT
/begin MEASUREMENT Stx_frm_pool[8].Vxx_rtn_tia "Stored intake air temperature" UBYTE _CNV_A_R_LINEAR_____220_CM 1 0. -40. 215. ECU_ADDRESS 0xc0000688 FORMAT "%3.0" /end MEASUREMENT
/begin MEASUREMENT Stx_frm_pool[8].Vxx_dgdftmng_priority "Local frame priority" UBYTE _CNV_A_R_ECME_LINEA_0_CM 1 0. 0. 6. ECU_ADDRESS 0xc0000689 FORMAT "%1.0" /end MEASUREMENT
/begin MEASUREMENT Stx_frm_pool[8].Vxx_rtn_rvac "Stored raw Tank differential pressure value for Scantool." SWORD _CNV_A_R_LINEAR_____224_CM 1 0. -8192. 8191.75 ECU_ADDRESS 0xc000068a FORMAT "%8.2" /end MEASUREMENT
/begin MEASUREMENT Stx_frm_pool[9].Vxx_rtn_n01 "Stored engine speed" UWORD _CNV_A_R_ENSD_LINEA_24_CM 1 0. 0. 16383.75 ECU_ADDRESS 0xc000068c FORMAT "%8.2" /end MEASUREMENT
/begin MEASUREMENT Stx_frm_pool[9].Vxx_obd_fail_code "DTC that caused required freeze frame data storage" UWORD _CNV_A_R_ECME_LINEA_0_CM 1 0. 0. 65535. ECU_ADDRESS 0xc000068e FORMAT "%5.0" /end MEASUREMENT
/begin MEASUREMENT Stx_frm_pool[9].Vxx_rtn_eal "Stored calculated load value for the scantool." UBYTE _CNV_A_R_LINEAR_____114_CM 1 0. 0. 100. ECU_ADDRESS 0xc0000690 FORMAT "%12.8" /end MEASUREMENT
/begin MEASUREMENT Stx_frm_pool[9].Vxx_rtn_vs "Stored filtered vehicule speed." UBYTE _CNV_A_R_LINEAR_____212_CM 1 0. 0. 255. ECU_ADDRESS 0xc0000691 FORMAT "%3.0" /end MEASUREMENT
/begin MEASUREMENT Stx_frm_pool[9].Vxx_rtn_map "Stored Manifold pressure value measurement" UBYTE _CNV_A_R_LINEAR_____219_CM 1 0. 0. 255. ECU_ADDRESS 0xc0000692 FORMAT "%3.0" /end MEASUREMENT
/begin MEASUREMENT Stx_frm_pool[9].Vxx_rtn_frm_tco "Stored engine coolant temperature." UBYTE _CNV_A_R_LINEAR_____220_CM 1 0. -40. 215. ECU_ADDRESS 0xc0000693 FORMAT "%3.0" /end MEASUREMENT
/begin MEASUREMENT Stx_frm_pool[9].Vxx_rtn_mv_ad_fac "Stored mean effective gain applied on injected fuel mass quantity" UBYTE _CNV_A_R_LINEAR_____221_CM 1 0. -100. 99.21875 ECU_ADDRESS 0xc0000694 FORMAT "%10.5" /end MEASUREMENT
/begin MEASUREMENT Stx_frm_pool[9].Vxx_rtn_rich_loop_ti_fac "Stored multiplicative factor from richness closed loop applied on injected fuel mass quantity" UBYTE _CNV_A_R_LINEAR_____221_CM 1 0. -100. 99.21875 ECU_ADDRESS 0xc0000695 FORMAT "%10.5" /end MEASUREMENT
/begin MEASUREMENT Stx_frm_pool[9].Vbx_rtn_clos_o2_phs "Stored richness regulation condition" UBYTE _CNV_S_2_RANGE______3_CM 1 0. 0. 1. ECU_ADDRESS 0xc0000696 BIT_MASK 0x1 /end MEASUREMENT
/begin MEASUREMENT Stx_frm_pool[9].Vxx_rtn_mat "Stored intake air temperature" UBYTE _CNV_A_R_LINEAR_____220_CM 1 0. -40. 215. ECU_ADDRESS 0xc0000697 FORMAT "%3.0" /end MEASUREMENT
/begin MEASUREMENT Stx_frm_pool[9].Vxx_rtn_clr_dist "Stored distance travelled since last clear" UWORD _CNV_A_R_LINEAR_____218_CM 1 0. 0. 65535. ECU_ADDRESS 0xc0000698 FORMAT "%5.0" /end MEASUREMENT
/begin MEASUREMENT Stx_frm_pool[9].Vxx_ind_xxx "static index" UWORD _CNV_A_R_ECME_LINEA_0_CM 1 0. 0. 65535. ECU_ADDRESS 0xc000069a FORMAT "%5.0" /end MEASUREMENT
/begin MEASUREMENT Stx_frm_pool[9].Vxx_rtn_maf "Stored Mass air flow" UWORD _CNV_A_R_LINEAR_____222_CM 1 0. 0. 655.35 ECU_ADDRESS 0xc000069c FORMAT "%6.2" /end MEASUREMENT
/begin MEASUREMENT Stx_frm_pool[9].Vxx_rtn_rail_prs "Stored Rail pressure measured" UWORD _CNV_A_R_LINEAR_____223_CM 1 0. 0. 655350. ECU_ADDRESS 0xc000069e FORMAT "%6.0" /end MEASUREMENT
/begin MEASUREMENT Stx_frm_pool[9].Vxx_rtn_tia "Stored intake air temperature" UBYTE _CNV_A_R_LINEAR_____220_CM 1 0. -40. 215. ECU_ADDRESS 0xc00006a0 FORMAT "%3.0" /end MEASUREMENT
/begin MEASUREMENT Stx_frm_pool[9].Vxx_dgdftmng_priority "Local frame priority" UBYTE _CNV_A_R_ECME_LINEA_0_CM 1 0. 0. 6. ECU_ADDRESS 0xc00006a1 FORMAT "%1.0" /end MEASUREMENT
/begin MEASUREMENT Stx_frm_pool[9].Vxx_rtn_rvac "Stored raw Tank differential pressure value for Scantool." SWORD _CNV_A_R_LINEAR_____224_CM 1 0. -8192. 8191.75 ECU_ADDRESS 0xc00006a2 FORMAT "%8.2" /end MEASUREMENT
/begin MEASUREMENT Vtx_frm[0].Vxx_rtn_n01 "Stored engine speed" UWORD _CNV_A_R_ENSD_LINEA_24_CM 1 0. 0. 16383.75 ECU_ADDRESS 0xc00006a4 FORMAT "%8.2" /end MEASUREMENT
/begin MEASUREMENT Vtx_frm[0].Vxx_obd_fail_code "DTC that caused required freeze frame data storage" UWORD _CNV_A_R_ECME_LINEA_0_CM 1 0. 0. 65535. ECU_ADDRESS 0xc00006a6 FORMAT "%5.0" /end MEASUREMENT
/begin MEASUREMENT Vtx_frm[0].Vxx_rtn_eal "Stored calculated load value for the scantool." UBYTE _CNV_A_R_LINEAR_____114_CM 1 0. 0. 100. ECU_ADDRESS 0xc00006a8 FORMAT "%12.8" /end MEASUREMENT
/begin MEASUREMENT Vtx_frm[0].Vxx_rtn_vs "Stored filtered vehicule speed." UBYTE _CNV_A_R_LINEAR_____212_CM 1 0. 0. 255. ECU_ADDRESS 0xc00006a9 FORMAT "%3.0" /end MEASUREMENT
/begin MEASUREMENT Vtx_frm[0].Vxx_rtn_map "Stored Manifold pressure value measurement" UBYTE _CNV_A_R_LINEAR_____219_CM 1 0. 0. 255. ECU_ADDRESS 0xc00006aa FORMAT "%3.0" /end MEASUREMENT
/begin MEASUREMENT Vtx_frm[0].Vxx_rtn_frm_tco "Stored engine coolant temperature." UBYTE _CNV_A_R_LINEAR_____220_CM 1 0. -40. 215. ECU_ADDRESS 0xc00006ab FORMAT "%3.0" /end MEASUREMENT
/begin MEASUREMENT Vtx_frm[0].Vxx_rtn_mv_ad_fac "Stored mean effective gain applied on injected fuel mass quantity" UBYTE _CNV_A_R_LINEAR_____221_CM 1 0. -100. 99.21875 ECU_ADDRESS 0xc00006ac FORMAT "%10.5" /end MEASUREMENT
/begin MEASUREMENT Vtx_frm[0].Vxx_rtn_rich_loop_ti_fac "Stored multiplicative factor from richness closed loop applied on injected fuel mass quantity" UBYTE _CNV_A_R_LINEAR_____221_CM 1 0. -100. 99.21875 ECU_ADDRESS 0xc00006ad FORMAT "%10.5" /end MEASUREMENT
/begin MEASUREMENT Vtx_frm[0].Vbx_rtn_clos_o2_phs "Stored richness regulation condition" UBYTE _CNV_S_2_RANGE______3_CM 1 0. 0. 1. ECU_ADDRESS 0xc00006ae BIT_MASK 0x1 /end MEASUREMENT
/begin MEASUREMENT Vtx_frm[0].Vxx_rtn_mat "Stored intake air temperature" UBYTE _CNV_A_R_LINEAR_____220_CM 1 0. -40. 215. ECU_ADDRESS 0xc00006af FORMAT "%3.0" /end MEASUREMENT
/begin MEASUREMENT Vtx_frm[0].Vxx_rtn_clr_dist "Stored distance travelled since last clear" UWORD _CNV_A_R_LINEAR_____218_CM 1 0. 0. 65535. ECU_ADDRESS 0xc00006b0 FORMAT "%5.0" /end MEASUREMENT
/begin MEASUREMENT Vtx_frm[0].Vxx_ind_xxx "static index" UWORD _CNV_A_R_ECME_LINEA_0_CM 1 0. 0. 65535. ECU_ADDRESS 0xc00006b2 FORMAT "%5.0" /end MEASUREMENT
/begin MEASUREMENT Vtx_frm[0].Vxx_rtn_maf "Stored Mass air flow" UWORD _CNV_A_R_LINEAR_____222_CM 1 0. 0. 655.35 ECU_ADDRESS 0xc00006b4 FORMAT "%6.2" /end MEASUREMENT
/begin MEASUREMENT Vtx_frm[0].Vxx_rtn_rail_prs "Stored Rail pressure measured" UWORD _CNV_A_R_LINEAR_____223_CM 1 0. 0. 655350. ECU_ADDRESS 0xc00006b6 FORMAT "%6.0" /end MEASUREMENT
/begin MEASUREMENT Vtx_frm[0].Vxx_rtn_tia "Stored intake air temperature" UBYTE _CNV_A_R_LINEAR_____220_CM 1 0. -40. 215. ECU_ADDRESS 0xc00006b8 FORMAT "%3.0" /end MEASUREMENT
/begin MEASUREMENT Vtx_frm[0].Vxx_dgdftmng_priority "Local frame priority" UBYTE _CNV_A_R_ECME_LINEA_0_CM 1 0. 0. 6. ECU_ADDRESS 0xc00006b9 FORMAT "%1.0" /end MEASUREMENT
/begin MEASUREMENT Vtx_frm[0].Vxx_rtn_rvac "Stored raw Tank differential pressure value for Scantool." SWORD _CNV_A_R_LINEAR_____224_CM 1 0. -8192. 8191.75 ECU_ADDRESS 0xc00006ba FORMAT "%8.2" /end MEASUREMENT
/begin MEASUREMENT Vtx_frm[1].Vxx_rtn_n01 "Stored engine speed" UWORD _CNV_A_R_ENSD_LINEA_24_CM 1 0. 0. 16383.75 ECU_ADDRESS 0xc00006bc FORMAT "%8.2" /end MEASUREMENT
/begin MEASUREMENT Vtx_frm[1].Vxx_obd_fail_code "DTC that caused required freeze frame data storage" UWORD _CNV_A_R_ECME_LINEA_0_CM 1 0. 0. 65535. ECU_ADDRESS 0xc00006be FORMAT "%5.0" /end MEASUREMENT
/begin MEASUREMENT Vtx_frm[1].Vxx_rtn_eal "Stored calculated load value for the scantool." UBYTE _CNV_A_R_LINEAR_____114_CM 1 0. 0. 100. ECU_ADDRESS 0xc00006c0 FORMAT "%12.8" /end MEASUREMENT
/begin MEASUREMENT Vtx_frm[1].Vxx_rtn_vs "Stored filtered vehicule speed." UBYTE _CNV_A_R_LINEAR_____212_CM 1 0. 0. 255. ECU_ADDRESS 0xc00006c1 FORMAT "%3.0" /end MEASUREMENT
/begin MEASUREMENT Vtx_frm[1].Vxx_rtn_map "Stored Manifold pressure value measurement" UBYTE _CNV_A_R_LINEAR_____219_CM 1 0. 0. 255. ECU_ADDRESS 0xc00006c2 FORMAT "%3.0" /end MEASUREMENT
/begin MEASUREMENT Vtx_frm[1].Vxx_rtn_frm_tco "Stored engine coolant temperature." UBYTE _CNV_A_R_LINEAR_____220_CM 1 0. -40. 215. ECU_ADDRESS 0xc00006c3 FORMAT "%3.0" /end MEASUREMENT
/begin MEASUREMENT Vtx_frm[1].Vxx_rtn_mv_ad_fac "Stored mean effective gain applied on injected fuel mass quantity" UBYTE _CNV_A_R_LINEAR_____221_CM 1 0. -100. 99.21875 ECU_ADDRESS 0xc00006c4 FORMAT "%10.5" /end MEASUREMENT
/begin MEASUREMENT Vtx_frm[1].Vxx_rtn_rich_loop_ti_fac "Stored multiplicative factor from richness closed loop applied on injected fuel mass quantity" UBYTE _CNV_A_R_LINEAR_____221_CM 1 0. -100. 99.21875 ECU_ADDRESS 0xc00006c5 FORMAT "%10.5" /end MEASUREMENT
/begin MEASUREMENT Vtx_frm[1].Vbx_rtn_clos_o2_phs "Stored richness regulation condition" UBYTE _CNV_S_2_RANGE______3_CM 1 0. 0. 1. ECU_ADDRESS 0xc00006c6 BIT_MASK 0x1 /end MEASUREMENT
/begin MEASUREMENT Vtx_frm[1].Vxx_rtn_mat "Stored intake air temperature" UBYTE _CNV_A_R_LINEAR_____220_CM 1 0. -40. 215. ECU_ADDRESS 0xc00006c7 FORMAT "%3.0" /end MEASUREMENT
/begin MEASUREMENT Vtx_frm[1].Vxx_rtn_clr_dist "Stored distance travelled since last clear" UWORD _CNV_A_R_LINEAR_____218_CM 1 0. 0. 65535. ECU_ADDRESS 0xc00006c8 FORMAT "%5.0" /end MEASUREMENT
/begin MEASUREMENT Vtx_frm[1].Vxx_ind_xxx "static index" UWORD _CNV_A_R_ECME_LINEA_0_CM 1 0. 0. 65535. ECU_ADDRESS 0xc00006ca FORMAT "%5.0" /end MEASUREMENT
/begin MEASUREMENT Vtx_frm[1].Vxx_rtn_maf "Stored Mass air flow" UWORD _CNV_A_R_LINEAR_____222_CM 1 0. 0. 655.35 ECU_ADDRESS 0xc00006cc FORMAT "%6.2" /end MEASUREMENT
/begin MEASUREMENT Vtx_frm[1].Vxx_rtn_rail_prs "Stored Rail pressure measured" UWORD _CNV_A_R_LINEAR_____223_CM 1 0. 0. 655350. ECU_ADDRESS 0xc00006ce FORMAT "%6.0" /end MEASUREMENT
/begin MEASUREMENT Vtx_frm[1].Vxx_rtn_tia "Stored intake air temperature" UBYTE _CNV_A_R_LINEAR_____220_CM 1 0. -40. 215. ECU_ADDRESS 0xc00006d0 FORMAT "%3.0" /end MEASUREMENT
/begin MEASUREMENT Vtx_frm[1].Vxx_dgdftmng_priority "Local frame priority" UBYTE _CNV_A_R_ECME_LINEA_0_CM 1 0. 0. 6. ECU_ADDRESS 0xc00006d1 FORMAT "%1.0" /end MEASUREMENT
/begin MEASUREMENT Vtx_frm[1].Vxx_rtn_rvac "Stored raw Tank differential pressure value for Scantool." SWORD _CNV_A_R_LINEAR_____224_CM 1 0. -8192. 8191.75 ECU_ADDRESS 0xc00006d2 FORMAT "%8.2" /end MEASUREMENT
/begin MEASUREMENT Vtx_frm[2].Vxx_rtn_n01 "Stored engine speed" UWORD _CNV_A_R_ENSD_LINEA_24_CM 1 0. 0. 16383.75 ECU_ADDRESS 0xc00006d4 FORMAT "%8.2" /end MEASUREMENT
/begin MEASUREMENT Vtx_frm[2].Vxx_obd_fail_code "DTC that caused required freeze frame data storage" UWORD _CNV_A_R_ECME_LINEA_0_CM 1 0. 0. 65535. ECU_ADDRESS 0xc00006d6 FORMAT "%5.0" /end MEASUREMENT
/begin MEASUREMENT Vtx_frm[2].Vxx_rtn_eal "Stored calculated load value for the scantool." UBYTE _CNV_A_R_LINEAR_____114_CM 1 0. 0. 100. ECU_ADDRESS 0xc00006d8 FORMAT "%12.8" /end MEASUREMENT
/begin MEASUREMENT Vtx_frm[2].Vxx_rtn_vs "Stored filtered vehicule speed." UBYTE _CNV_A_R_LINEAR_____212_CM 1 0. 0. 255. ECU_ADDRESS 0xc00006d9 FORMAT "%3.0" /end MEASUREMENT
/begin MEASUREMENT Vtx_frm[2].Vxx_rtn_map "Stored Manifold pressure value measurement" UBYTE _CNV_A_R_LINEAR_____219_CM 1 0. 0. 255. ECU_ADDRESS 0xc00006da FORMAT "%3.0" /end MEASUREMENT
/begin MEASUREMENT Vtx_frm[2].Vxx_rtn_frm_tco "Stored engine coolant temperature." UBYTE _CNV_A_R_LINEAR_____220_CM 1 0. -40. 215. ECU_ADDRESS 0xc00006db FORMAT "%3.0" /end MEASUREMENT
/begin MEASUREMENT Vtx_frm[2].Vxx_rtn_mv_ad_fac "Stored mean effective gain applied on injected fuel mass quantity" UBYTE _CNV_A_R_LINEAR_____221_CM 1 0. -100. 99.21875 ECU_ADDRESS 0xc00006dc FORMAT "%10.5" /end MEASUREMENT
/begin MEASUREMENT Vtx_frm[2].Vxx_rtn_rich_loop_ti_fac "Stored multiplicative factor from richness closed loop applied on injected fuel mass quantity" UBYTE _CNV_A_R_LINEAR_____221_CM 1 0. -100. 99.21875 ECU_ADDRESS 0xc00006dd FORMAT "%10.5" /end MEASUREMENT
/begin MEASUREMENT Vtx_frm[2].Vbx_rtn_clos_o2_phs "Stored richness regulation condition" UBYTE _CNV_S_2_RANGE______3_CM 1 0. 0. 1. ECU_ADDRESS 0xc00006de BIT_MASK 0x1 /end MEASUREMENT
/begin MEASUREMENT Vtx_frm[2].Vxx_rtn_mat "Stored intake air temperature" UBYTE _CNV_A_R_LINEAR_____220_CM 1 0. -40. 215. ECU_ADDRESS 0xc00006df FORMAT "%3.0" /end MEASUREMENT
/begin MEASUREMENT Vtx_frm[2].Vxx_rtn_clr_dist "Stored distance travelled since last clear" UWORD _CNV_A_R_LINEAR_____218_CM 1 0. 0. 65535. ECU_ADDRESS 0xc00006e0 FORMAT "%5.0" /end MEASUREMENT
/begin MEASUREMENT Vtx_frm[2].Vxx_ind_xxx "static index" UWORD _CNV_A_R_ECME_LINEA_0_CM 1 0. 0. 65535. ECU_ADDRESS 0xc00006e2 FORMAT "%5.0" /end MEASUREMENT
/begin MEASUREMENT Vtx_frm[2].Vxx_rtn_maf "Stored Mass air flow" UWORD _CNV_A_R_LINEAR_____222_CM 1 0. 0. 655.35 ECU_ADDRESS 0xc00006e4 FORMAT "%6.2" /end MEASUREMENT
/begin MEASUREMENT Vtx_frm[2].Vxx_rtn_rail_prs "Stored Rail pressure measured" UWORD _CNV_A_R_LINEAR_____223_CM 1 0. 0. 655350. ECU_ADDRESS 0xc00006e6 FORMAT "%6.0" /end MEASUREMENT
/begin MEASUREMENT Vtx_frm[2].Vxx_rtn_tia "Stored intake air temperature" UBYTE _CNV_A_R_LINEAR_____220_CM 1 0. -40. 215. ECU_ADDRESS 0xc00006e8 FORMAT "%3.0" /end MEASUREMENT
/begin MEASUREMENT Vtx_frm[2].Vxx_dgdftmng_priority "Local frame priority" UBYTE _CNV_A_R_ECME_LINEA_0_CM 1 0. 0. 6. ECU_ADDRESS 0xc00006e9 FORMAT "%1.0" /end MEASUREMENT
/begin MEASUREMENT Vtx_frm[2].Vxx_rtn_rvac "Stored raw Tank differential pressure value for Scantool." SWORD _CNV_A_R_LINEAR_____224_CM 1 0. -8192. 8191.75 ECU_ADDRESS 0xc00006ea FORMAT "%8.2" /end MEASUREMENT
/begin MEASUREMENT Vtx_frm[3].Vxx_rtn_n01 "Stored engine speed" UWORD _CNV_A_R_ENSD_LINEA_24_CM 1 0. 0. 16383.75 ECU_ADDRESS 0xc00006ec FORMAT "%8.2" /end MEASUREMENT
/begin MEASUREMENT Vtx_frm[3].Vxx_obd_fail_code "DTC that caused required freeze frame data storage" UWORD _CNV_A_R_ECME_LINEA_0_CM 1 0. 0. 65535. ECU_ADDRESS 0xc00006ee FORMAT "%5.0" /end MEASUREMENT
/begin MEASUREMENT Vtx_frm[3].Vxx_rtn_eal "Stored calculated load value for the scantool." UBYTE _CNV_A_R_LINEAR_____114_CM 1 0. 0. 100. ECU_ADDRESS 0xc00006f0 FORMAT "%12.8" /end MEASUREMENT
/begin MEASUREMENT Vtx_frm[3].Vxx_rtn_vs "Stored filtered vehicule speed." UBYTE _CNV_A_R_LINEAR_____212_CM 1 0. 0. 255. ECU_ADDRESS 0xc00006f1 FORMAT "%3.0" /end MEASUREMENT
/begin MEASUREMENT Vtx_frm[3].Vxx_rtn_map "Stored Manifold pressure value measurement" UBYTE _CNV_A_R_LINEAR_____219_CM 1 0. 0. 255. ECU_ADDRESS 0xc00006f2 FORMAT "%3.0" /end MEASUREMENT
/begin MEASUREMENT Vtx_frm[3].Vxx_rtn_frm_tco "Stored engine coolant temperature." UBYTE _CNV_A_R_LINEAR_____220_CM 1 0. -40. 215. ECU_ADDRESS 0xc00006f3 FORMAT "%3.0" /end MEASUREMENT
/begin MEASUREMENT Vtx_frm[3].Vxx_rtn_mv_ad_fac "Stored mean effective gain applied on injected fuel mass quantity" UBYTE _CNV_A_R_LINEAR_____221_CM 1 0. -100. 99.21875 ECU_ADDRESS 0xc00006f4 FORMAT "%10.5" /end MEASUREMENT
/begin MEASUREMENT Vtx_frm[3].Vxx_rtn_rich_loop_ti_fac "Stored multiplicative factor from richness closed loop applied on injected fuel mass quantity" UBYTE _CNV_A_R_LINEAR_____221_CM 1 0. -100. 99.21875 ECU_ADDRESS 0xc00006f5 FORMAT "%10.5" /end MEASUREMENT
/begin MEASUREMENT Vtx_frm[3].Vbx_rtn_clos_o2_phs "Stored richness regulation condition" UBYTE _CNV_S_2_RANGE______3_CM 1 0. 0. 1. ECU_ADDRESS 0xc00006f6 BIT_MASK 0x1 /end MEASUREMENT
/begin MEASUREMENT Vtx_frm[3].Vxx_rtn_mat "Stored intake air temperature" UBYTE _CNV_A_R_LINEAR_____220_CM 1 0. -40. 215. ECU_ADDRESS 0xc00006f7 FORMAT "%3.0" /end MEASUREMENT
/begin MEASUREMENT Vtx_frm[3].Vxx_rtn_clr_dist "Stored distance travelled since last clear" UWORD _CNV_A_R_LINEAR_____218_CM 1 0. 0. 65535. ECU_ADDRESS 0xc00006f8 FORMAT "%5.0" /end MEASUREMENT
/begin MEASUREMENT Vtx_frm[3].Vxx_ind_xxx "static index" UWORD _CNV_A_R_ECME_LINEA_0_CM 1 0. 0. 65535. ECU_ADDRESS 0xc00006fa FORMAT "%5.0" /end MEASUREMENT
/begin MEASUREMENT Vtx_frm[3].Vxx_rtn_maf "Stored Mass air flow" UWORD _CNV_A_R_LINEAR_____222_CM 1 0. 0. 655.35 ECU_ADDRESS 0xc00006fc FORMAT "%6.2" /end MEASUREMENT
/begin MEASUREMENT Vtx_frm[3].Vxx_rtn_rail_prs "Stored Rail pressure measured" UWORD _CNV_A_R_LINEAR_____223_CM 1 0. 0. 655350. ECU_ADDRESS 0xc00006fe FORMAT "%6.0" /end MEASUREMENT
/begin MEASUREMENT Vtx_frm[3].Vxx_rtn_tia "Stored intake air temperature" UBYTE _CNV_A_R_LINEAR_____220_CM 1 0. -40. 215. ECU_ADDRESS 0xc0000700 FORMAT "%3.0" /end MEASUREMENT
/begin MEASUREMENT Vtx_frm[3].Vxx_dgdftmng_priority "Local frame priority" UBYTE _CNV_A_R_ECME_LINEA_0_CM 1 0. 0. 6. ECU_ADDRESS 0xc0000701 FORMAT "%1.0" /end MEASUREMENT
/begin MEASUREMENT Vtx_frm[3].Vxx_rtn_rvac "Stored raw Tank differential pressure value for Scantool." SWORD _CNV_A_R_LINEAR_____224_CM 1 0. -8192. 8191.75 ECU_ADDRESS 0xc0000702 FORMAT "%8.2" /end MEASUREMENT
/begin MEASUREMENT Vtx_frm[4].Vxx_rtn_n01 "Stored engine speed" UWORD _CNV_A_R_ENSD_LINEA_24_CM 1 0. 0. 16383.75 ECU_ADDRESS 0xc0000704 FORMAT "%8.2" /end MEASUREMENT
/begin MEASUREMENT Vtx_frm[4].Vxx_obd_fail_code "DTC that caused required freeze frame data storage" UWORD _CNV_A_R_ECME_LINEA_0_CM 1 0. 0. 65535. ECU_ADDRESS 0xc0000706 FORMAT "%5.0" /end MEASUREMENT
/begin MEASUREMENT Vtx_frm[4].Vxx_rtn_eal "Stored calculated load value for the scantool." UBYTE _CNV_A_R_LINEAR_____114_CM 1 0. 0. 100. ECU_ADDRESS 0xc0000708 FORMAT "%12.8" /end MEASUREMENT
/begin MEASUREMENT Vtx_frm[4].Vxx_rtn_vs "Stored filtered vehicule speed." UBYTE _CNV_A_R_LINEAR_____212_CM 1 0. 0. 255. ECU_ADDRESS 0xc0000709 FORMAT "%3.0" /end MEASUREMENT
/begin MEASUREMENT Vtx_frm[4].Vxx_rtn_map "Stored Manifold pressure value measurement" UBYTE _CNV_A_R_LINEAR_____219_CM 1 0. 0. 255. ECU_ADDRESS 0xc000070a FORMAT "%3.0" /end MEASUREMENT
/begin MEASUREMENT Vtx_frm[4].Vxx_rtn_frm_tco "Stored engine coolant temperature." UBYTE _CNV_A_R_LINEAR_____220_CM 1 0. -40. 215. ECU_ADDRESS 0xc000070b FORMAT "%3.0" /end MEASUREMENT
/begin MEASUREMENT Vtx_frm[4].Vxx_rtn_mv_ad_fac "Stored mean effective gain applied on injected fuel mass quantity" UBYTE _CNV_A_R_LINEAR_____221_CM 1 0. -100. 99.21875 ECU_ADDRESS 0xc000070c FORMAT "%10.5" /end MEASUREMENT
/begin MEASUREMENT Vtx_frm[4].Vxx_rtn_rich_loop_ti_fac "Stored multiplicative factor from richness closed loop applied on injected fuel mass quantity" UBYTE _CNV_A_R_LINEAR_____221_CM 1 0. -100. 99.21875 ECU_ADDRESS 0xc000070d FORMAT "%10.5" /end MEASUREMENT
/begin MEASUREMENT Vtx_frm[4].Vbx_rtn_clos_o2_phs "Stored richness regulation condition" UBYTE _CNV_S_2_RANGE______3_CM 1 0. 0. 1. ECU_ADDRESS 0xc000070e BIT_MASK 0x1 /end MEASUREMENT
/begin MEASUREMENT Vtx_frm[4].Vxx_rtn_mat "Stored intake air temperature" UBYTE _CNV_A_R_LINEAR_____220_CM 1 0. -40. 215. ECU_ADDRESS 0xc000070f FORMAT "%3.0" /end MEASUREMENT
/begin MEASUREMENT Vtx_frm[4].Vxx_rtn_clr_dist "Stored distance travelled since last clear" UWORD _CNV_A_R_LINEAR_____218_CM 1 0. 0. 65535. ECU_ADDRESS 0xc0000710 FORMAT "%5.0" /end MEASUREMENT
/begin MEASUREMENT Vtx_frm[4].Vxx_ind_xxx "static index" UWORD _CNV_A_R_ECME_LINEA_0_CM 1 0. 0. 65535. ECU_ADDRESS 0xc0000712 FORMAT "%5.0" /end MEASUREMENT
/begin MEASUREMENT Vtx_frm[4].Vxx_rtn_maf "Stored Mass air flow" UWORD _CNV_A_R_LINEAR_____222_CM 1 0. 0. 655.35 ECU_ADDRESS 0xc0000714 FORMAT "%6.2" /end MEASUREMENT
/begin MEASUREMENT Vtx_frm[4].Vxx_rtn_rail_prs "Stored Rail pressure measured" UWORD _CNV_A_R_LINEAR_____223_CM 1 0. 0. 655350. ECU_ADDRESS 0xc0000716 FORMAT "%6.0" /end MEASUREMENT
/begin MEASUREMENT Vtx_frm[4].Vxx_rtn_tia "Stored intake air temperature" UBYTE _CNV_A_R_LINEAR_____220_CM 1 0. -40. 215. ECU_ADDRESS 0xc0000718 FORMAT "%3.0" /end MEASUREMENT
/begin MEASUREMENT Vtx_frm[4].Vxx_dgdftmng_priority "Local frame priority" UBYTE _CNV_A_R_ECME_LINEA_0_CM 1 0. 0. 6. ECU_ADDRESS 0xc0000719 FORMAT "%1.0" /end MEASUREMENT
/begin MEASUREMENT Vtx_frm[4].Vxx_rtn_rvac "Stored raw Tank differential pressure value for Scantool." SWORD _CNV_A_R_LINEAR_____224_CM 1 0. -8192. 8191.75 ECU_ADDRESS 0xc000071a FORMAT "%8.2" /end MEASUREMENT
/begin MEASUREMENT Vtx_frm[5].Vxx_rtn_n01 "Stored engine speed" UWORD _CNV_A_R_ENSD_LINEA_24_CM 1 0. 0. 16383.75 ECU_ADDRESS 0xc000071c FORMAT "%8.2" /end MEASUREMENT
/begin MEASUREMENT Vtx_frm[5].Vxx_obd_fail_code "DTC that caused required freeze frame data storage" UWORD _CNV_A_R_ECME_LINEA_0_CM 1 0. 0. 65535. ECU_ADDRESS 0xc000071e FORMAT "%5.0" /end MEASUREMENT
/begin MEASUREMENT Vtx_frm[5].Vxx_rtn_eal "Stored calculated load value for the scantool." UBYTE _CNV_A_R_LINEAR_____114_CM 1 0. 0. 100. ECU_ADDRESS 0xc0000720 FORMAT "%12.8" /end MEASUREMENT
/begin MEASUREMENT Vtx_frm[5].Vxx_rtn_vs "Stored filtered vehicule speed." UBYTE _CNV_A_R_LINEAR_____212_CM 1 0. 0. 255. ECU_ADDRESS 0xc0000721 FORMAT "%3.0" /end MEASUREMENT
/begin MEASUREMENT Vtx_frm[5].Vxx_rtn_map "Stored Manifold pressure value measurement" UBYTE _CNV_A_R_LINEAR_____219_CM 1 0. 0. 255. ECU_ADDRESS 0xc0000722 FORMAT "%3.0" /end MEASUREMENT
/begin MEASUREMENT Vtx_frm[5].Vxx_rtn_frm_tco "Stored engine coolant temperature." UBYTE _CNV_A_R_LINEAR_____220_CM 1 0. -40. 215. ECU_ADDRESS 0xc0000723 FORMAT "%3.0" /end MEASUREMENT
/begin MEASUREMENT Vtx_frm[5].Vxx_rtn_mv_ad_fac "Stored mean effective gain applied on injected fuel mass quantity" UBYTE _CNV_A_R_LINEAR_____221_CM 1 0. -100. 99.21875 ECU_ADDRESS 0xc0000724 FORMAT "%10.5" /end MEASUREMENT
/begin MEASUREMENT Vtx_frm[5].Vxx_rtn_rich_loop_ti_fac "Stored multiplicative factor from richness closed loop applied on injected fuel mass quantity" UBYTE _CNV_A_R_LINEAR_____221_CM 1 0. -100. 99.21875 ECU_ADDRESS 0xc0000725 FORMAT "%10.5" /end MEASUREMENT
/begin MEASUREMENT Vtx_frm[5].Vbx_rtn_clos_o2_phs "Stored richness regulation condition" UBYTE _CNV_S_2_RANGE______3_CM 1 0. 0. 1. ECU_ADDRESS 0xc0000726 BIT_MASK 0x1 /end MEASUREMENT
/begin MEASUREMENT Vtx_frm[5].Vxx_rtn_mat "Stored intake air temperature" UBYTE _CNV_A_R_LINEAR_____220_CM 1 0. -40. 215. ECU_ADDRESS 0xc0000727 FORMAT "%3.0" /end MEASUREMENT
/begin MEASUREMENT Vtx_frm[5].Vxx_rtn_clr_dist "Stored distance travelled since last clear" UWORD _CNV_A_R_LINEAR_____218_CM 1 0. 0. 65535. ECU_ADDRESS 0xc0000728 FORMAT "%5.0" /end MEASUREMENT
/begin MEASUREMENT Vtx_frm[5].Vxx_ind_xxx "static index" UWORD _CNV_A_R_ECME_LINEA_0_CM 1 0. 0. 65535. ECU_ADDRESS 0xc000072a FORMAT "%5.0" /end MEASUREMENT
/begin MEASUREMENT Vtx_frm[5].Vxx_rtn_maf "Stored Mass air flow" UWORD _CNV_A_R_LINEAR_____222_CM 1 0. 0. 655.35 ECU_ADDRESS 0xc000072c FORMAT "%6.2" /end MEASUREMENT
/begin MEASUREMENT Vtx_frm[5].Vxx_rtn_rail_prs "Stored Rail pressure measured" UWORD _CNV_A_R_LINEAR_____223_CM 1 0. 0. 655350. ECU_ADDRESS 0xc000072e FORMAT "%6.0" /end MEASUREMENT
/begin MEASUREMENT Vtx_frm[5].Vxx_rtn_tia "Stored intake air temperature" UBYTE _CNV_A_R_LINEAR_____220_CM 1 0. -40. 215. ECU_ADDRESS 0xc0000730 FORMAT "%3.0" /end MEASUREMENT
/begin MEASUREMENT Vtx_frm[5].Vxx_dgdftmng_priority "Local frame priority" UBYTE _CNV_A_R_ECME_LINEA_0_CM 1 0. 0. 6. ECU_ADDRESS 0xc0000731 FORMAT "%1.0" /end MEASUREMENT
/begin MEASUREMENT Vtx_frm[5].Vxx_rtn_rvac "Stored raw Tank differential pressure value for Scantool." SWORD _CNV_A_R_LINEAR_____224_CM 1 0. -8192. 8191.75 ECU_ADDRESS 0xc0000732 FORMAT "%8.2" /end MEASUREMENT
/begin MEASUREMENT Vtx_frm[6].Vxx_rtn_n01 "Stored engine speed" UWORD _CNV_A_R_ENSD_LINEA_24_CM 1 0. 0. 16383.75 ECU_ADDRESS 0xc0000734 FORMAT "%8.2" /end MEASUREMENT
/begin MEASUREMENT Vtx_frm[6].Vxx_obd_fail_code "DTC that caused required freeze frame data storage" UWORD _CNV_A_R_ECME_LINEA_0_CM 1 0. 0. 65535. ECU_ADDRESS 0xc0000736 FORMAT "%5.0" /end MEASUREMENT
/begin MEASUREMENT Vtx_frm[6].Vxx_rtn_eal "Stored calculated load value for the scantool." UBYTE _CNV_A_R_LINEAR_____114_CM 1 0. 0. 100. ECU_ADDRESS 0xc0000738 FORMAT "%12.8" /end MEASUREMENT
/begin MEASUREMENT Vtx_frm[6].Vxx_rtn_vs "Stored filtered vehicule speed." UBYTE _CNV_A_R_LINEAR_____212_CM 1 0. 0. 255. ECU_ADDRESS 0xc0000739 FORMAT "%3.0" /end MEASUREMENT
/begin MEASUREMENT Vtx_frm[6].Vxx_rtn_map "Stored Manifold pressure value measurement" UBYTE _CNV_A_R_LINEAR_____219_CM 1 0. 0. 255. ECU_ADDRESS 0xc000073a FORMAT "%3.0" /end MEASUREMENT
/begin MEASUREMENT Vtx_frm[6].Vxx_rtn_frm_tco "Stored engine coolant temperature." UBYTE _CNV_A_R_LINEAR_____220_CM 1 0. -40. 215. ECU_ADDRESS 0xc000073b FORMAT "%3.0" /end MEASUREMENT
/begin MEASUREMENT Vtx_frm[6].Vxx_rtn_mv_ad_fac "Stored mean effective gain applied on injected fuel mass quantity" UBYTE _CNV_A_R_LINEAR_____221_CM 1 0. -100. 99.21875 ECU_ADDRESS 0xc000073c FORMAT "%10.5" /end MEASUREMENT
/begin MEASUREMENT Vtx_frm[6].Vxx_rtn_rich_loop_ti_fac "Stored multiplicative factor from richness closed loop applied on injected fuel mass quantity" UBYTE _CNV_A_R_LINEAR_____221_CM 1 0. -100. 99.21875 ECU_ADDRESS 0xc000073d FORMAT "%10.5" /end MEASUREMENT
/begin MEASUREMENT Vtx_frm[6].Vbx_rtn_clos_o2_phs "Stored richness regulation condition" UBYTE _CNV_S_2_RANGE______3_CM 1 0. 0. 1. ECU_ADDRESS 0xc000073e BIT_MASK 0x1 /end MEASUREMENT
/begin MEASUREMENT Vtx_frm[6].Vxx_rtn_mat "Stored intake air temperature" UBYTE _CNV_A_R_LINEAR_____220_CM 1 0. -40. 215. ECU_ADDRESS 0xc000073f FORMAT "%3.0" /end MEASUREMENT
/begin MEASUREMENT Vtx_frm[6].Vxx_rtn_clr_dist "Stored distance travelled since last clear" UWORD _CNV_A_R_LINEAR_____218_CM 1 0. 0. 65535. ECU_ADDRESS 0xc0000740 FORMAT "%5.0" /end MEASUREMENT
/begin MEASUREMENT Vtx_frm[6].Vxx_ind_xxx "static index" UWORD _CNV_A_R_ECME_LINEA_0_CM 1 0. 0. 65535. ECU_ADDRESS 0xc0000742 FORMAT "%5.0" /end MEASUREMENT
/begin MEASUREMENT Vtx_frm[6].Vxx_rtn_maf "Stored Mass air flow" UWORD _CNV_A_R_LINEAR_____222_CM 1 0. 0. 655.35 ECU_ADDRESS 0xc0000744 FORMAT "%6.2" /end MEASUREMENT
/begin MEASUREMENT Vtx_frm[6].Vxx_rtn_rail_prs "Stored Rail pressure measured" UWORD _CNV_A_R_LINEAR_____223_CM 1 0. 0. 655350. ECU_ADDRESS 0xc0000746 FORMAT "%6.0" /end MEASUREMENT
/begin MEASUREMENT Vtx_frm[6].Vxx_rtn_tia "Stored intake air temperature" UBYTE _CNV_A_R_LINEAR_____220_CM 1 0. -40. 215. ECU_ADDRESS 0xc0000748 FORMAT "%3.0" /end MEASUREMENT
/begin MEASUREMENT Vtx_frm[6].Vxx_dgdftmng_priority "Local frame priority" UBYTE _CNV_A_R_ECME_LINEA_0_CM 1 0. 0. 6. ECU_ADDRESS 0xc0000749 FORMAT "%1.0" /end MEASUREMENT
/begin MEASUREMENT Vtx_frm[6].Vxx_rtn_rvac "Stored raw Tank differential pressure value for Scantool." SWORD _CNV_A_R_LINEAR_____224_CM 1 0. -8192. 8191.75 ECU_ADDRESS 0xc000074a FORMAT "%8.2" /end MEASUREMENT
/begin MEASUREMENT Vtx_frm[7].Vxx_rtn_n01 "Stored engine speed" UWORD _CNV_A_R_ENSD_LINEA_24_CM 1 0. 0. 16383.75 ECU_ADDRESS 0xc000074c FORMAT "%8.2" /end MEASUREMENT
/begin MEASUREMENT Vtx_frm[7].Vxx_obd_fail_code "DTC that caused required freeze frame data storage" UWORD _CNV_A_R_ECME_LINEA_0_CM 1 0. 0. 65535. ECU_ADDRESS 0xc000074e FORMAT "%5.0" /end MEASUREMENT
/begin MEASUREMENT Vtx_frm[7].Vxx_rtn_eal "Stored calculated load value for the scantool." UBYTE _CNV_A_R_LINEAR_____114_CM 1 0. 0. 100. ECU_ADDRESS 0xc0000750 FORMAT "%12.8" /end MEASUREMENT
/begin MEASUREMENT Vtx_frm[7].Vxx_rtn_vs "Stored filtered vehicule speed." UBYTE _CNV_A_R_LINEAR_____212_CM 1 0. 0. 255. ECU_ADDRESS 0xc0000751 FORMAT "%3.0" /end MEASUREMENT
/begin MEASUREMENT Vtx_frm[7].Vxx_rtn_map "Stored Manifold pressure value measurement" UBYTE _CNV_A_R_LINEAR_____219_CM 1 0. 0. 255. ECU_ADDRESS 0xc0000752 FORMAT "%3.0" /end MEASUREMENT
/begin MEASUREMENT Vtx_frm[7].Vxx_rtn_frm_tco "Stored engine coolant temperature." UBYTE _CNV_A_R_LINEAR_____220_CM 1 0. -40. 215. ECU_ADDRESS 0xc0000753 FORMAT "%3.0" /end MEASUREMENT
/begin MEASUREMENT Vtx_frm[7].Vxx_rtn_mv_ad_fac "Stored mean effective gain applied on injected fuel mass quantity" UBYTE _CNV_A_R_LINEAR_____221_CM 1 0. -100. 99.21875 ECU_ADDRESS 0xc0000754 FORMAT "%10.5" /end MEASUREMENT
/begin MEASUREMENT Vtx_frm[7].Vxx_rtn_rich_loop_ti_fac "Stored multiplicative factor from richness closed loop applied on injected fuel mass quantity" UBYTE _CNV_A_R_LINEAR_____221_CM 1 0. -100. 99.21875 ECU_ADDRESS 0xc0000755 FORMAT "%10.5" /end MEASUREMENT
/begin MEASUREMENT Vtx_frm[7].Vbx_rtn_clos_o2_phs "Stored richness regulation condition" UBYTE _CNV_S_2_RANGE______3_CM 1 0. 0. 1. ECU_ADDRESS 0xc0000756 BIT_MASK 0x1 /end MEASUREMENT
/begin MEASUREMENT Vtx_frm[7].Vxx_rtn_mat "Stored intake air temperature" UBYTE _CNV_A_R_LINEAR_____220_CM 1 0. -40. 215. ECU_ADDRESS 0xc0000757 FORMAT "%3.0" /end MEASUREMENT
/begin MEASUREMENT Vtx_frm[7].Vxx_rtn_clr_dist "Stored distance travelled since last clear" UWORD _CNV_A_R_LINEAR_____218_CM 1 0. 0. 65535. ECU_ADDRESS 0xc0000758 FORMAT "%5.0" /end MEASUREMENT
/begin MEASUREMENT Vtx_frm[7].Vxx_ind_xxx "static index" UWORD _CNV_A_R_ECME_LINEA_0_CM 1 0. 0. 65535. ECU_ADDRESS 0xc000075a FORMAT "%5.0" /end MEASUREMENT
/begin MEASUREMENT Vtx_frm[7].Vxx_rtn_maf "Stored Mass air flow" UWORD _CNV_A_R_LINEAR_____222_CM 1 0. 0. 655.35 ECU_ADDRESS 0xc000075c FORMAT "%6.2" /end MEASUREMENT
/begin MEASUREMENT Vtx_frm[7].Vxx_rtn_rail_prs "Stored Rail pressure measured" UWORD _CNV_A_R_LINEAR_____223_CM 1 0. 0. 655350. ECU_ADDRESS 0xc000075e FORMAT "%6.0" /end MEASUREMENT
/begin MEASUREMENT Vtx_frm[7].Vxx_rtn_tia "Stored intake air temperature" UBYTE _CNV_A_R_LINEAR_____220_CM 1 0. -40. 215. ECU_ADDRESS 0xc0000760 FORMAT "%3.0" /end MEASUREMENT
/begin MEASUREMENT Vtx_frm[7].Vxx_dgdftmng_priority "Local frame priority" UBYTE _CNV_A_R_ECME_LINEA_0_CM 1 0. 0. 6. ECU_ADDRESS 0xc0000761 FORMAT "%1.0" /end MEASUREMENT
/begin MEASUREMENT Vtx_frm[7].Vxx_rtn_rvac "Stored raw Tank differential pressure value for Scantool." SWORD _CNV_A_R_LINEAR_____224_CM 1 0. -8192. 8191.75 ECU_ADDRESS 0xc0000762 FORMAT "%8.2" /end MEASUREMENT
/begin MEASUREMENT Vtx_frm[8].Vxx_rtn_n01 "Stored engine speed" UWORD _CNV_A_R_ENSD_LINEA_24_CM 1 0. 0. 16383.75 ECU_ADDRESS 0xc0000764 FORMAT "%8.2" /end MEASUREMENT
/begin MEASUREMENT Vtx_frm[8].Vxx_obd_fail_code "DTC that caused required freeze frame data storage" UWORD _CNV_A_R_ECME_LINEA_0_CM 1 0. 0. 65535. ECU_ADDRESS 0xc0000766 FORMAT "%5.0" /end MEASUREMENT
/begin MEASUREMENT Vtx_frm[8].Vxx_rtn_eal "Stored calculated load value for the scantool." UBYTE _CNV_A_R_LINEAR_____114_CM 1 0. 0. 100. ECU_ADDRESS 0xc0000768 FORMAT "%12.8" /end MEASUREMENT
/begin MEASUREMENT Vtx_frm[8].Vxx_rtn_vs "Stored filtered vehicule speed." UBYTE _CNV_A_R_LINEAR_____212_CM 1 0. 0. 255. ECU_ADDRESS 0xc0000769 FORMAT "%3.0" /end MEASUREMENT
/begin MEASUREMENT Vtx_frm[8].Vxx_rtn_map "Stored Manifold pressure value measurement" UBYTE _CNV_A_R_LINEAR_____219_CM 1 0. 0. 255. ECU_ADDRESS 0xc000076a FORMAT "%3.0" /end MEASUREMENT
/begin MEASUREMENT Vtx_frm[8].Vxx_rtn_frm_tco "Stored engine coolant temperature." UBYTE _CNV_A_R_LINEAR_____220_CM 1 0. -40. 215. ECU_ADDRESS 0xc000076b FORMAT "%3.0" /end MEASUREMENT
/begin MEASUREMENT Vtx_frm[8].Vxx_rtn_mv_ad_fac "Stored mean effective gain applied on injected fuel mass quantity" UBYTE _CNV_A_R_LINEAR_____221_CM 1 0. -100. 99.21875 ECU_ADDRESS 0xc000076c FORMAT "%10.5" /end MEASUREMENT
/begin MEASUREMENT Vtx_frm[8].Vxx_rtn_rich_loop_ti_fac "Stored multiplicative factor from richness closed loop applied on injected fuel mass quantity" UBYTE _CNV_A_R_LINEAR_____221_CM 1 0. -100. 99.21875 ECU_ADDRESS 0xc000076d FORMAT "%10.5" /end MEASUREMENT
/begin MEASUREMENT Vtx_frm[8].Vbx_rtn_clos_o2_phs "Stored richness regulation condition" UBYTE _CNV_S_2_RANGE______3_CM 1 0. 0. 1. ECU_ADDRESS 0xc000076e BIT_MASK 0x1 /end MEASUREMENT
/begin MEASUREMENT Vtx_frm[8].Vxx_rtn_mat "Stored intake air temperature" UBYTE _CNV_A_R_LINEAR_____220_CM 1 0. -40. 215. ECU_ADDRESS 0xc000076f FORMAT "%3.0" /end MEASUREMENT
/begin MEASUREMENT Vtx_frm[8].Vxx_rtn_clr_dist "Stored distance travelled since last clear" UWORD _CNV_A_R_LINEAR_____218_CM 1 0. 0. 65535. ECU_ADDRESS 0xc0000770 FORMAT "%5.0" /end MEASUREMENT
/begin MEASUREMENT Vtx_frm[8].Vxx_ind_xxx "static index" UWORD _CNV_A_R_ECME_LINEA_0_CM 1 0. 0. 65535. ECU_ADDRESS 0xc0000772 FORMAT "%5.0" /end MEASUREMENT
/begin MEASUREMENT Vtx_frm[8].Vxx_rtn_maf "Stored Mass air flow" UWORD _CNV_A_R_LINEAR_____222_CM 1 0. 0. 655.35 ECU_ADDRESS 0xc0000774 FORMAT "%6.2" /end MEASUREMENT
/begin MEASUREMENT Vtx_frm[8].Vxx_rtn_rail_prs "Stored Rail pressure measured" UWORD _CNV_A_R_LINEAR_____223_CM 1 0. 0. 655350. ECU_ADDRESS 0xc0000776 FORMAT "%6.0" /end MEASUREMENT
/begin MEASUREMENT Vtx_frm[8].Vxx_rtn_tia "Stored intake air temperature" UBYTE _CNV_A_R_LINEAR_____220_CM 1 0. -40. 215. ECU_ADDRESS 0xc0000778 FORMAT "%3.0" /end MEASUREMENT
/begin MEASUREMENT Vtx_frm[8].Vxx_dgdftmng_priority "Local frame priority" UBYTE _CNV_A_R_ECME_LINEA_0_CM 1 0. 0. 6. ECU_ADDRESS 0xc0000779 FORMAT "%1.0" /end MEASUREMENT
/begin MEASUREMENT Vtx_frm[8].Vxx_rtn_rvac "Stored raw Tank differential pressure value for Scantool." SWORD _CNV_A_R_LINEAR_____224_CM 1 0. -8192. 8191.75 ECU_ADDRESS 0xc000077a FORMAT "%8.2" /end MEASUREMENT
/begin MEASUREMENT Vtx_frm[9].Vxx_rtn_n01 "Stored engine speed" UWORD _CNV_A_R_ENSD_LINEA_24_CM 1 0. 0. 16383.75 ECU_ADDRESS 0xc000077c FORMAT "%8.2" /end MEASUREMENT
/begin MEASUREMENT Vtx_frm[9].Vxx_obd_fail_code "DTC that caused required freeze frame data storage" UWORD _CNV_A_R_ECME_LINEA_0_CM 1 0. 0. 65535. ECU_ADDRESS 0xc000077e FORMAT "%5.0" /end MEASUREMENT
/begin MEASUREMENT Vtx_frm[9].Vxx_rtn_eal "Stored calculated load value for the scantool." UBYTE _CNV_A_R_LINEAR_____114_CM 1 0. 0. 100. ECU_ADDRESS 0xc0000780 FORMAT "%12.8" /end MEASUREMENT
/begin MEASUREMENT Vtx_frm[9].Vxx_rtn_vs "Stored filtered vehicule speed." UBYTE _CNV_A_R_LINEAR_____212_CM 1 0. 0. 255. ECU_ADDRESS 0xc0000781 FORMAT "%3.0" /end MEASUREMENT
/begin MEASUREMENT Vtx_frm[9].Vxx_rtn_map "Stored Manifold pressure value measurement" UBYTE _CNV_A_R_LINEAR_____219_CM 1 0. 0. 255. ECU_ADDRESS 0xc0000782 FORMAT "%3.0" /end MEASUREMENT
/begin MEASUREMENT Vtx_frm[9].Vxx_rtn_frm_tco "Stored engine coolant temperature." UBYTE _CNV_A_R_LINEAR_____220_CM 1 0. -40. 215. ECU_ADDRESS 0xc0000783 FORMAT "%3.0" /end MEASUREMENT
/begin MEASUREMENT Vtx_frm[9].Vxx_rtn_mv_ad_fac "Stored mean effective gain applied on injected fuel mass quantity" UBYTE _CNV_A_R_LINEAR_____221_CM 1 0. -100. 99.21875 ECU_ADDRESS 0xc0000784 FORMAT "%10.5" /end MEASUREMENT
/begin MEASUREMENT Vtx_frm[9].Vxx_rtn_rich_loop_ti_fac "Stored multiplicative factor from richness closed loop applied on injected fuel mass quantity" UBYTE _CNV_A_R_LINEAR_____221_CM 1 0. -100. 99.21875 ECU_ADDRESS 0xc0000785 FORMAT "%10.5" /end MEASUREMENT
/begin MEASUREMENT Vtx_frm[9].Vbx_rtn_clos_o2_phs "Stored richness regulation condition" UBYTE _CNV_S_2_RANGE______3_CM 1 0. 0. 1. ECU_ADDRESS 0xc0000786 BIT_MASK 0x1 /end MEASUREMENT
/begin MEASUREMENT Vtx_frm[9].Vxx_rtn_mat "Stored intake air temperature" UBYTE _CNV_A_R_LINEAR_____220_CM 1 0. -40. 215. ECU_ADDRESS 0xc0000787 FORMAT "%3.0" /end MEASUREMENT
/begin MEASUREMENT Vtx_frm[9].Vxx_rtn_clr_dist "Stored distance travelled since last clear" UWORD _CNV_A_R_LINEAR_____218_CM 1 0. 0. 65535. ECU_ADDRESS 0xc0000788 FORMAT "%5.0" /end MEASUREMENT
/begin MEASUREMENT Vtx_frm[9].Vxx_ind_xxx "static index" UWORD _CNV_A_R_ECME_LINEA_0_CM 1 0. 0. 65535. ECU_ADDRESS 0xc000078a FORMAT "%5.0" /end MEASUREMENT
/begin MEASUREMENT Vtx_frm[9].Vxx_rtn_maf "Stored Mass air flow" UWORD _CNV_A_R_LINEAR_____222_CM 1 0. 0. 655.35 ECU_ADDRESS 0xc000078c FORMAT "%6.2" /end MEASUREMENT
/begin MEASUREMENT Vtx_frm[9].Vxx_rtn_rail_prs "Stored Rail pressure measured" UWORD _CNV_A_R_LINEAR_____223_CM 1 0. 0. 655350. ECU_ADDRESS 0xc000078e FORMAT "%6.0" /end MEASUREMENT
/begin MEASUREMENT Vtx_frm[9].Vxx_rtn_tia "Stored intake air temperature" UBYTE _CNV_A_R_LINEAR_____220_CM 1 0. -40. 215. ECU_ADDRESS 0xc0000790 FORMAT "%3.0" /end MEASUREMENT
/begin MEASUREMENT Vtx_frm[9].Vxx_dgdftmng_priority "Local frame priority" UBYTE _CNV_A_R_ECME_LINEA_0_CM 1 0. 0. 6. ECU_ADDRESS 0xc0000791 FORMAT "%1.0" /end MEASUREMENT
/begin MEASUREMENT Vtx_frm[9].Vxx_rtn_rvac "Stored raw Tank differential pressure value for Scantool." SWORD _CNV_A_R_LINEAR_____224_CM 1 0. -8192. 8191.75 ECU_ADDRESS 0xc0000792 FORMAT "%8.2" /end MEASUREMENT
/begin MEASUREMENT Sxx_sel_frm "Selected Legislative Freeze frame from the table of potential stored freeze frame" UBYTE _CNV_A_R_ECME_LINEA_0_CM 1 0. 0. 9. ECU_ADDRESS 0xd00056d0 FORMAT "%3.0" /end MEASUREMENT
/begin MEASUREMENT Vbx_rtn_clos_o2_phs "Stored Richness regulation condition" UBYTE _CNV_S_2_RANGE______3_CM 1 0. 0. 1. ECU_ADDRESS 0xd00056d9 BIT_MASK 0x1 /end MEASUREMENT
/begin MEASUREMENT Vxx_obd_fail_code "DTC that caused required freeze frame data storage" UWORD _CNV_A_R_ECME_LINEA_0_CM 1 0. 0. 65535. ECU_ADDRESS 0xc0000794 FORMAT "%5.0" /end MEASUREMENT
/begin MEASUREMENT Vxx_rtn_clr_dist "Stored distance travelled since last clear" UWORD _CNV_A_R_LINEAR_____218_CM 1 0. 0. 65535. ECU_ADDRESS 0xc0000796 FORMAT "%5.0" /end MEASUREMENT
/begin MEASUREMENT Vxx_rtn_eal "Stored calculated load value for the scantool." UBYTE _CNV_A_R_LINEAR_____114_CM 1 0. 0. 100. ECU_ADDRESS 0xd00056d1 FORMAT "%12.8" /end MEASUREMENT
/begin MEASUREMENT Vxx_rtn_frm_tco "Stored engine coolant temperature." UBYTE _CNV_A_R_LINEAR_____220_CM 1 0. -40. 215. ECU_ADDRESS 0xd00056d2 FORMAT "%3.0" /end MEASUREMENT
/begin MEASUREMENT Vxx_rtn_maf "Stored Mass air flow" UWORD _CNV_A_R_LINEAR_____222_CM 1 0. 0. 655.35 ECU_ADDRESS 0xc0000798 FORMAT "%6.2" /end MEASUREMENT
/begin MEASUREMENT Vxx_rtn_map "Stored Manifold pressure value measurement" UBYTE _CNV_A_R_LINEAR_____219_CM 1 0. 0. 255. ECU_ADDRESS 0xd00056d3 FORMAT "%3.0" /end MEASUREMENT
/begin MEASUREMENT Vxx_rtn_mat "Stored intake air temperature" UBYTE _CNV_A_R_LINEAR_____220_CM 1 0. -40. 215. ECU_ADDRESS 0xd00056d4 FORMAT "%3.0" /end MEASUREMENT
/begin MEASUREMENT Vxx_rtn_mv_ad_fac "Stored Mean effective gain applied on injected fuel mass quantity" UBYTE _CNV_A_R_LINEAR_____221_CM 1 0. -100. 99.21875 ECU_ADDRESS 0xd00056d5 FORMAT "%10.5" /end MEASUREMENT
/begin MEASUREMENT Vxx_rtn_n01 "Stored engine speed" UWORD _CNV_A_R_ENSD_LINEA_24_CM 1 0. 0. 16383.75 ECU_ADDRESS 0xc000079a FORMAT "%8.2" /end MEASUREMENT
/begin MEASUREMENT Vxx_rtn_rail_prs "Stored Rail pressure measured" UWORD _CNV_A_R_LINEAR_____223_CM 1 0. 0. 655350. ECU_ADDRESS 0xc000079c FORMAT "%6.0" /end MEASUREMENT
/begin MEASUREMENT Vxx_rtn_rich_loop_ti_fac "Stored multiplicative factor from richness closed loop applied on injected fuel mass quantity" UBYTE _CNV_A_R_LINEAR_____221_CM 1 0. -100. 99.21875 ECU_ADDRESS 0xd00056d6 FORMAT "%10.5" /end MEASUREMENT
/begin MEASUREMENT Vxx_rtn_rvac "Stored raw Tank differential pressure value for Scantool." SWORD _CNV_A_R_LINEAR_____224_CM 1 0. -8192. 8191.75 ECU_ADDRESS 0xc000079e FORMAT "%8.2" /end MEASUREMENT
/begin MEASUREMENT Vxx_rtn_tia "Stored intake air temperature" UBYTE _CNV_A_R_LINEAR_____220_CM 1 0. -40. 215. ECU_ADDRESS 0xd00056d7 FORMAT "%3.0" /end MEASUREMENT
/begin MEASUREMENT Vxx_rtn_vs "Stored filtered vehicule speed." UBYTE _CNV_A_R_LINEAR_____212_CM 1 0. 0. 255. ECU_ADDRESS 0xd00056d8 FORMAT "%3.0" /end MEASUREMENT
/begin CHARACTERISTIC Cbx_obd_off_cfm "OBD system inhibition" VALUE 0xa0021828 _REC_S1VAL_20_u1 1. _CNV_S_2_RANGE______3_CM 0. 1. BIT_MASK 0x1 /end CHARACTERISTIC
/begin CHARACTERISTIC Cxx_dtc_lb_cata "Diagnostic trouble code faulttype identifier of destructive catalyst for priority rules" VALUE 0xa0021829 _REC_S1VAL_20_u1 255. _CNV_A_R_ECME_LINEA_0_CM 0. 255. FORMAT "%3.0" /end CHARACTERISTIC
/begin CHARACTERISTIC Cxx_dtc_lb_fsys "Diagnostic trouble code faulttype identifier of fuel system for priority rules" VALUE 0xa002182a _REC_S1VAL_20_u1 255. _CNV_A_R_ECME_LINEA_0_CM 0. 255. FORMAT "%3.0" /end CHARACTERISTIC
/begin CHARACTERISTIC Cxx_dtc_msb_fsys "Diagnostic trouble code device or function identifier of fuel system for priority rules" VALUE 0xa0021826 _REC_S1VAL_20_u2 65535. _CNV_A_R_ECME_LINEA_0_CM 0. 65535. FORMAT "%5.0" /end CHARACTERISTIC
/begin MEASUREMENT Vbx_amp_obd_diag_ena "Autorization OBD diagnosis in function of Atmospheric pressure" UBYTE _CNV_S_2_RANGE______3_CM 1 0. 0. 1. ECU_ADDRESS 0xd0005066 BIT_MASK 0x1 /end MEASUREMENT
/begin MEASUREMENT Vbx_min_fuel_obd_diag_ena "Autorization OBD diagnosis in function of Filtered minimum fuel level detected" UBYTE _CNV_S_2_RANGE______3_CM 1 0. 0. 1. ECU_ADDRESS 0xd0005067 BIT_MASK 0x1 /end MEASUREMENT
/begin MEASUREMENT Vbx_temp_obd_diag_ena "Autorization OBD diagnosis in function of temperature" UBYTE _CNV_S_2_RANGE______3_CM 1 0. 0. 1. ECU_ADDRESS 0xd0005068 BIT_MASK 0x1 /end MEASUREMENT
/begin MEASUREMENT Vbx_vb_obd_diag_ena "Autorization OBD diagnosis in function of Battery voltage" UBYTE _CNV_S_2_RANGE______3_CM 1 0. 0. 1. ECU_ADDRESS 0xd0005069 BIT_MASK 0x1 /end MEASUREMENT
/begin CHARACTERISTIC Cxx_amp_obd_diag_ena_thd "Atmospheric pressure threshold for autorization OBD diagnosis" VALUE 0xa00215cc _REC_S1VAL_20_u2 20000. _CNV_A_R_LINEAR_____57_CM 0. 20000. FORMAT "%5.0" /end CHARACTERISTIC
/begin CHARACTERISTIC Cxx_mat_obd_diag_ena_thd "Manifold air temperature threshold for autorization OBD diagnosis " VALUE 0xa00215ce _REC_S1VAL_20_u2 240. _CNV_A_R_LINEAR_____54_CM -40. 200. FORMAT "%6.1" /end CHARACTERISTIC
/begin CHARACTERISTIC Cxx_tco_obd_diag_ena_thd "Engine coolant temperature threshold for autorization OBD diagnosis " VALUE 0xa00215d0 _REC_S1VAL_20_u2 240. _CNV_A_R_LINEAR_____54_CM -40. 200. FORMAT "%6.1" /end CHARACTERISTIC
/begin CHARACTERISTIC Cxx_vb_obd_diag_ena_thd "Battery voltage threshold for autorization OBD diagnosis" VALUE 0xa00215d2 _REC_S1VAL_20_u2 60. _CNV_A_R_LINEAR_____150_CM 0. 60. FORMAT "%6.2" /end CHARACTERISTIC
/begin MEASUREMENT Vbx_df_inj_ecu_lbdw_icp "Main CPU Lambda Sensor (down) pumping current detected failure" UBYTE _CNV_S_2_RANGE______3_CM 1 0. 0. 1. ECU_ADDRESS 0xd00049cf BIT_MASK 0x1 /end MEASUREMENT
/begin MEASUREMENT Vbx_df_lbdw_oc "Rear Oxygen Sensor (L/R) Open circuit detected failure" UBYTE _CNV_S_2_RANGE______3_CM 1 0. 0. 1. ECU_ADDRESS 0xd00049d0 BIT_MASK 0x1 /end MEASUREMENT
/begin MEASUREMENT Vbx_df_lbdw_scg "Rear Oxygen Sensor (L/R) Short circuit to ground detected failure" UBYTE _CNV_S_2_RANGE______3_CM 1 0. 0. 1. ECU_ADDRESS 0xd00049d1 BIT_MASK 0x1 /end MEASUREMENT
/begin MEASUREMENT Vbx_df_lbdw_scw "Rear Oxygen Sensor (L/R) Short circuit at battery + detected failure" UBYTE _CNV_S_2_RANGE______3_CM 1 0. 0. 1. ECU_ADDRESS 0xd00049d2 BIT_MASK 0x1 /end MEASUREMENT
/begin MEASUREMENT Vbx_diag_ena_inj_ecu_lbdw_icp "Main CPU Lambda Sensor (down) pumping current  diagnostic authorisation" UBYTE _CNV_S_2_RANGE______3_CM 1 0. 0. 1. ECU_ADDRESS 0xd00049d3 BIT_MASK 0x1 /end MEASUREMENT
/begin MEASUREMENT Vbx_diag_ena_lbdw_oc "Rear Oxygen Sensor (L/R) Open circuit diagnostic authorisation" UBYTE _CNV_S_2_RANGE______3_CM 1 0. 0. 1. ECU_ADDRESS 0xd00049d4 BIT_MASK 0x1 /end MEASUREMENT
/begin MEASUREMENT Vbx_diag_ena_lbdw_scg "Rear Oxygen Sensor (L/R) Short circuit to ground  diagnostic authorisation" UBYTE _CNV_S_2_RANGE______3_CM 1 0. 0. 1. ECU_ADDRESS 0xd00049d5 BIT_MASK 0x1 /end MEASUREMENT
/begin MEASUREMENT Vbx_diag_ena_lbdw_scw "Rear Oxygen Sensor (L/R) Short circuit at battery + diagnostic authorisation" UBYTE _CNV_S_2_RANGE______3_CM 1 0. 0. 1. ECU_ADDRESS 0xd00049d6 BIT_MASK 0x1 /end MEASUREMENT
/begin MEASUREMENT Vbx_lbdw_diag_ena "Indicateur de sonde prËte (chaude) pour les diagnostics sonde aval." UBYTE _CNV_S_2_RANGE______3_CM 1 0. 0. 1. ECU_ADDRESS 0xd00049d7 BIT_MASK 0x1 /end MEASUREMENT
/begin MEASUREMENT Vsx_lbdw_vld "Validity indicator of lambda down sensor" UBYTE _CNV_S_3_STATUS_OK__120_CM 1 0. 0. 2. ECU_ADDRESS 0xd00049d8 /end MEASUREMENT
/begin MEASUREMENT Vxx_cata_air_wht "Amount of air pumped into cylinder" UWORD _CNV_A_R_LINEAR_____109_CM 1 0. 0. 3000. ECU_ADDRESS 0xd000363a FORMAT "%7.2" /end MEASUREMENT
/begin MEASUREMENT Vxx_lbdw_diag_ena "compteur associe a l'indicateur de sonde prete (chaude) pour les diagnostics sonde aval." UWORD _CNV_A_R_LINEAR_____34_CM 1 0. 0. 655.35 ECU_ADDRESS 0xd000363c FORMAT "%6.2" /end MEASUREMENT
/begin MEASUREMENT Vxx_lbdw_pump_crt_t "Temps durant lequel on effectue le diagnostic du courant de pompage de la sonde aval" UWORD _CNV_A_R_LINEAR_____34_CM 1 0. 0. 655.35 ECU_ADDRESS 0xd000363e FORMAT "%6.2" /end MEASUREMENT
/begin CHARACTERISTIC Cbx_lbdw_osp_conf "Booleen de configuration pour selectionner une sonde aval de type OSP+ (Cbx_lbdw_osp_typ = on)" VALUE 0xa0021b1c _REC_S1VAL_20_u1 1. _CNV_A_R_ECME_LINEA_0_CM 0. 1. FORMAT "%1.0" BIT_MASK 0x1 /end CHARACTERISTIC
/begin CHARACTERISTIC Cxx_air_wht_fmt_fac "Facteur de formattage du debit d'air en masse d'air" VALUE 0xa0021b1d _REC_S1VAL_20_u1 0.99609375 _CNV_A_R_LINEAR_____227_CM 3.90625e-003 1. FORMAT "%12.8" /end CHARACTERISTIC
/begin CHARACTERISTIC Cxx_dfdec_inj_ecu_lbdw_icp "Main CPU Lambda Sensor (down) pumping current detected failure counter decrement" VALUE 0xa0021af6 _REC_S1VAL_20_u2 65535. _CNV_A_R_ECME_LINEA_0_CM 0. 65535. FORMAT "%5.0" /end CHARACTERISTIC
/begin CHARACTERISTIC Cxx_dfdec_lbdw_oc "Rear Oxygen Sensor (L/R) Open circuit detected failure counter decrement" VALUE 0xa0021af8 _REC_S1VAL_20_u2 65535. _CNV_A_R_ECME_LINEA_0_CM 0. 65535. FORMAT "%5.0" /end CHARACTERISTIC
/begin CHARACTERISTIC Cxx_dfdec_lbdw_scg "Rear Oxygen Sensor (L/R) Short circuit to ground detected failure counter decrement" VALUE 0xa0021afa _REC_S1VAL_20_u2 65535. _CNV_A_R_ECME_LINEA_0_CM 0. 65535. FORMAT "%5.0" /end CHARACTERISTIC
/begin CHARACTERISTIC Cxx_dfdec_lbdw_scw "Rear Oxygen Sensor (L/R) Short circuit at battery + detected failure counter decrement" VALUE 0xa0021afc _REC_S1VAL_20_u2 65535. _CNV_A_R_ECME_LINEA_0_CM 0. 65535. FORMAT "%5.0" /end CHARACTERISTIC
/begin CHARACTERISTIC Cxx_dfinc_inj_ecu_lbdw_icp "Main CPU Lambda Sensor (down) pumping current detected failure counter increment" VALUE 0xa0021afe _REC_S1VAL_20_u2 65535. _CNV_A_R_ECME_LINEA_0_CM 0. 65535. FORMAT "%5.0" /end CHARACTERISTIC
/begin CHARACTERISTIC Cxx_dfinc_lbdw_oc "Rear Oxygen Sensor (L/R) Open circuit detected failure counter increment" VALUE 0xa0021b00 _REC_S1VAL_20_u2 65535. _CNV_A_R_ECME_LINEA_0_CM 0. 65535. FORMAT "%5.0" /end CHARACTERISTIC
/begin CHARACTERISTIC Cxx_dfinc_lbdw_scg "Rear Oxygen Sensor (L/R) Short circuit to ground detected failure counter increment" VALUE 0xa0021b02 _REC_S1VAL_20_u2 65535. _CNV_A_R_ECME_LINEA_0_CM 0. 65535. FORMAT "%5.0" /end CHARACTERISTIC
/begin CHARACTERISTIC Cxx_dfinc_lbdw_scw "Rear Oxygen Sensor (L/R) Short circuit at battery + detected failure counter increment" VALUE 0xa0021b04 _REC_S1VAL_20_u2 65535. _CNV_A_R_ECME_LINEA_0_CM 0. 65535. FORMAT "%5.0" /end CHARACTERISTIC
/begin CHARACTERISTIC Cxx_lbdw_hot_stt_t "Duree, apres demarrage, au-dela de laquelle on considere la sonde aval chaude" VALUE 0xa0021b06 _REC_S1VAL_20_u2 655.35 _CNV_A_R_LINEAR_____34_CM 0. 655.35 FORMAT "%6.2" /end CHARACTERISTIC
/begin CHARACTERISTIC Cxx_lbdw_oc_air_wht "Amount of air pumped into cylinder." VALUE 0xa0021b08 _REC_S1VAL_20_u2 3000. _CNV_A_R_LINEAR_____109_CM 0. 3000. FORMAT "%7.2" /end CHARACTERISTIC
/begin CHARACTERISTIC Cxx_lbdw_oc_det_h_v "Seuil maxi de tension sonde aval pour detecter un defaut circuit ouvert" VALUE 0xa0021b0a _REC_S1VAL_20_u2 25000. _CNV_A_R_LINEAR_____52_CM 0. 25000. FORMAT "%5.0" /end CHARACTERISTIC
/begin CHARACTERISTIC Cxx_lbdw_osp_oc_det_h_v "Seuil haut d'encadrement tension de polarisation sonde aval OSP+ pour detection circuit ouvert" VALUE 0xa0021b0c _REC_S1VAL_20_u2 25000. _CNV_A_R_LINEAR_____52_CM 0. 25000. FORMAT "%5.0" /end CHARACTERISTIC
/begin CHARACTERISTIC Cxx_lbdw_osp_oc_det_l_v "Seuil bas d'encadrement de la tension de polarisation sonde aval OSP+ pour detection circuit ouvert" VALUE 0xa0021b0e _REC_S1VAL_20_u2 25000. _CNV_A_R_LINEAR_____52_CM 0. 25000. FORMAT "%5.0" /end CHARACTERISTIC
/begin CHARACTERISTIC Cxx_lbdw_osp_scg_det_v "Seuil bas de tension sonde aval OSP+ pour detecter le defaut court-circuit a la masse" VALUE 0xa0021b10 _REC_S1VAL_20_u2 25000. _CNV_A_R_LINEAR_____52_CM 0. 25000. FORMAT "%5.0" /end CHARACTERISTIC
/begin CHARACTERISTIC Cxx_lbdw_osp_scw_det_v "Seuil de tension sonde aval OSP+ au dela duquel on detecte un court-circuit au + batterie" VALUE 0xa0021b12 _REC_S1VAL_20_u2 25000. _CNV_A_R_LINEAR_____52_CM 0. 25000. FORMAT "%5.0" /end CHARACTERISTIC
/begin CHARACTERISTIC Cxx_lbdw_pump_crt_t "Duree durant laquelle on effectue le diagnostic du courant de pompage de la sonde aval" VALUE 0xa0021b14 _REC_S1VAL_20_u2 655.35 _CNV_A_R_LINEAR_____34_CM 0. 655.35 FORMAT "%6.2" /end CHARACTERISTIC
/begin CHARACTERISTIC Cxx_lbdw_pump_crt_v_thd "Seuil de tension au-dela duquel on detecte une panne du courant de pompage sonde aval" VALUE 0xa0021b16 _REC_S1VAL_20_u2 25000. _CNV_A_R_LINEAR_____52_CM 0. 25000. FORMAT "%5.0" /end CHARACTERISTIC
/begin CHARACTERISTIC Cxx_lbdw_scg_det_v "Seuil tension sonde aval sous lequel on detecte le defaut court-circuit a la masse (double boucle)" VALUE 0xa0021b18 _REC_S1VAL_20_u2 25000. _CNV_A_R_LINEAR_____52_CM 0. 25000. FORMAT "%5.0" /end CHARACTERISTIC
/begin CHARACTERISTIC Cxx_lbdw_scw_det_v "Seuil de tension sonde aval au dela duquel on detecte un defaut court-circuit au + batterie" VALUE 0xa0021b1a _REC_S1VAL_20_u2 25000. _CNV_A_R_LINEAR_____52_CM 0. 25000. FORMAT "%5.0" /end CHARACTERISTIC
/begin MEASUREMENT Vbx_stop_stal_eng "Indication of engine state (stop or stal)" UBYTE _CNV_S_2_RANGE______3_CM 1 0. 0. 1. ECU_ADDRESS 0xd00040f1 BIT_MASK 0x1 /end MEASUREMENT
/begin MEASUREMENT Vbx_stop_stal_eng_not_1 "Inverse indication of engine state (stop or stal) for filtering 1" UBYTE _CNV_S_2_RANGE______3_CM 1 0. 0. 1. ECU_ADDRESS 0xd00040f2 BIT_MASK 0x1 /end MEASUREMENT
/begin MEASUREMENT Vbx_stop_stal_eng_not_2 "Inverse indication of engine state (stop or stal) for filtering 2" UBYTE _CNV_S_2_RANGE______3_CM 1 0. 0. 1. ECU_ADDRESS 0xd00040f3 BIT_MASK 0x1 /end MEASUREMENT
/begin MEASUREMENT Vxx_lbdw_cata_fil_val "Filtered value by the tension of dowstream lambda sensor to AMPLIMOY (catalyst diagnosis)" UWORD _CNV_A_R_LINEAR_____52_CM 1 0. 0. 25000. ECU_ADDRESS 0xd000331c FORMAT "%5.0" /end MEASUREMENT
/begin MEASUREMENT Vxx_lbdw_h_lvl_fil_val "Filtered value by the tension of dowstream lambda sensor to judge the level of richness" UWORD _CNV_A_R_LINEAR_____52_CM 1 0. 0. 25000. ECU_ADDRESS 0xd000331e FORMAT "%5.0" /end MEASUREMENT
/begin CHARACTERISTIC Cxx_lbdw_cata_fil_ftc "Filtering time constant for filtered value by the tension of dowstream lambda sensor to AMPLMOY (catalyst diagnosis)" VALUE 0xa00214fe _REC_S1VAL_20_u2 65.535 _CNV_A_R_LINEAR_____58_CM 0. 65.535 /end CHARACTERISTIC
/begin CHARACTERISTIC Cxx_lbdw_h_lvl_fil_ftc "Filtering time constant for filtered value by the tension of dowstream lambda sensor to judge the level of richness" VALUE 0xa0021500 _REC_S1VAL_20_u2 65.535 _CNV_A_R_LINEAR_____58_CM 0. 65.535 /end CHARACTERISTIC
/begin MEASUREMENT Vbx_df_lbup_hot_oc "" UBYTE _CNV_S_2_RANGE______3_CM 1 0. 0. 1. ECU_ADDRESS 0xd0004cc0 BIT_MASK 0x1 /end MEASUREMENT
/begin MEASUREMENT Vbx_df_lbup_hot_scg "" UBYTE _CNV_S_2_RANGE______3_CM 1 0. 0. 1. ECU_ADDRESS 0xd0004cc1 BIT_MASK 0x1 /end MEASUREMENT
/begin MEASUREMENT Vbx_df_lbup_hot_scw "" UBYTE _CNV_S_2_RANGE______3_CM 1 0. 0. 1. ECU_ADDRESS 0xd0004cc2 BIT_MASK 0x1 /end MEASUREMENT
/begin MEASUREMENT Vbx_diag_ena_lbup_hot_oc "" UBYTE _CNV_S_2_RANGE______3_CM 1 0. 0. 1. ECU_ADDRESS 0xd0004cc3 BIT_MASK 0x1 /end MEASUREMENT
/begin MEASUREMENT Vbx_diag_ena_lbup_hot_scg "" UBYTE _CNV_S_2_RANGE______3_CM 1 0. 0. 1. ECU_ADDRESS 0xd0004cc4 BIT_MASK 0x1 /end MEASUREMENT
/begin MEASUREMENT Vbx_diag_ena_lbup_hot_scw "" UBYTE _CNV_S_2_RANGE______3_CM 1 0. 0. 1. ECU_ADDRESS 0xd0004cc5 BIT_MASK 0x1 /end MEASUREMENT
/begin MEASUREMENT cdn_diag_lsh_up "Diagnosis condition for each symptom of upstream heater diagnosis OBD I" UBYTE _CNV_A_R_ECME_LINEA_0_CM 1 0. 0. 7. ECU_ADDRESS 0xd0004cc7 FORMAT "%1.0" /end MEASUREMENT
/begin MEASUREMENT err_diag_lsh_up "raw value of error symptom for upstream heater diagnosis OBD I" UBYTE _CNV_S_16_RANGE_ERR__151_CM 1 0. 0. 15. ECU_ADDRESS 0xd0004cc6 /end MEASUREMENT
/begin MEASUREMENT Vbx_df_lbdw_hot_oc "" UBYTE _CNV_S_2_RANGE______3_CM 1 0. 0. 1. ECU_ADDRESS 0xd0004f2e BIT_MASK 0x1 /end MEASUREMENT
/begin MEASUREMENT Vbx_df_lbdw_hot_scg "" UBYTE _CNV_S_2_RANGE______3_CM 1 0. 0. 1. ECU_ADDRESS 0xd0004f2f BIT_MASK 0x1 /end MEASUREMENT
/begin MEASUREMENT Vbx_df_lbdw_hot_scw "" UBYTE _CNV_S_2_RANGE______3_CM 1 0. 0. 1. ECU_ADDRESS 0xd0004f30 BIT_MASK 0x1 /end MEASUREMENT
/begin MEASUREMENT Vbx_diag_ena_lbdw_hot_oc "" UBYTE _CNV_S_2_RANGE______3_CM 1 0. 0. 1. ECU_ADDRESS 0xd0004f31 BIT_MASK 0x1 /end MEASUREMENT
/begin MEASUREMENT Vbx_diag_ena_lbdw_hot_scg "" UBYTE _CNV_S_2_RANGE______3_CM 1 0. 0. 1. ECU_ADDRESS 0xd0004f32 BIT_MASK 0x1 /end MEASUREMENT
/begin MEASUREMENT Vbx_diag_ena_lbdw_hot_scw "" UBYTE _CNV_S_2_RANGE______3_CM 1 0. 0. 1. ECU_ADDRESS 0xd0004f33 BIT_MASK 0x1 /end MEASUREMENT
/begin MEASUREMENT cdn_diag_lsh_down "Diagnosis condition for each symptom of downstream heater diagnosis OBD I" UBYTE _CNV_A_R_ECME_LINEA_0_CM 1 0. 0. 7. ECU_ADDRESS 0xd0004f2d FORMAT "%1.0" /end MEASUREMENT
/begin MEASUREMENT err_diag_lsh_down "Raw value of error symptom for downstream heater diagnosis OBD I" UBYTE _CNV_S_16_RANGE_ERR__151_CM 1 0. 0. 15. ECU_ADDRESS 0xd0004f2c /end MEASUREMENT
/begin MEASUREMENT Vbx_df_cp_oc "Short circuit to battery of canister purge detected failure" UBYTE _CNV_S_2_RANGE______3_CM 1 0. 0. 1. ECU_ADDRESS 0xd0003dc1 BIT_MASK 0x1 /end MEASUREMENT
/begin MEASUREMENT Vbx_df_cp_scg "Short circuit to ground of canister purge detected failure" UBYTE _CNV_S_2_RANGE______3_CM 1 0. 0. 1. ECU_ADDRESS 0xd0003dc2 BIT_MASK 0x1 /end MEASUREMENT
/begin MEASUREMENT Vbx_df_cp_scw "open circuit of canister purge detected failure" UBYTE _CNV_S_2_RANGE______3_CM 1 0. 0. 1. ECU_ADDRESS 0xd0003dc3 BIT_MASK 0x1 /end MEASUREMENT
/begin MEASUREMENT Vbx_df_gas_pump_oc "Open circuit on gas pump detected failure" UBYTE _CNV_S_2_RANGE______3_CM 1 0. 0. 1. ECU_ADDRESS 0xd0003dbb BIT_MASK 0x1 /end MEASUREMENT
/begin MEASUREMENT Vbx_df_gas_pump_scg "Short circuit to ground on gas pump detected failure" UBYTE _CNV_S_2_RANGE______3_CM 1 0. 0. 1. ECU_ADDRESS 0xd0003dbc BIT_MASK 0x1 /end MEASUREMENT
/begin MEASUREMENT Vbx_df_gas_pump_scw "Short circuit to battery on gas pump detected failure" UBYTE _CNV_S_2_RANGE______3_CM 1 0. 0. 1. ECU_ADDRESS 0xd0003dbd BIT_MASK 0x1 /end MEASUREMENT
/begin MEASUREMENT Vbx_diag_ena_cp_oc "Open circuit of canister purge diagnosis information available" UBYTE _CNV_S_2_RANGE______3_CM 1 0. 0. 1. ECU_ADDRESS 0xd0003dc4 BIT_MASK 0x1 /end MEASUREMENT
/begin MEASUREMENT Vbx_diag_ena_cp_scg "Short circuit to ground of canister diagnosis information available" UBYTE _CNV_S_2_RANGE______3_CM 1 0. 0. 1. ECU_ADDRESS 0xd0003dc5 BIT_MASK 0x1 /end MEASUREMENT
/begin MEASUREMENT Vbx_diag_ena_cp_scw "Short circuit to battery of canister purge diagnosis information available" UBYTE _CNV_S_2_RANGE______3_CM 1 0. 0. 1. ECU_ADDRESS 0xd0003dc6 BIT_MASK 0x1 /end MEASUREMENT
/begin MEASUREMENT Vbx_diag_ena_gas_pump_oc "Open circuit on gas pump diagnosis information available" UBYTE _CNV_S_2_RANGE______3_CM 1 0. 0. 1. ECU_ADDRESS 0xd0003dbe BIT_MASK 0x1 /end MEASUREMENT
/begin MEASUREMENT Vbx_diag_ena_gas_pump_scg "Short circuit to ground on gas pump diagnosis information available" UBYTE _CNV_S_2_RANGE______3_CM 1 0. 0. 1. ECU_ADDRESS 0xd0003dbf BIT_MASK 0x1 /end MEASUREMENT
/begin MEASUREMENT Vbx_diag_ena_gas_pump_scw "Short circuit to battery on gas pump diagnosis information available" UBYTE _CNV_S_2_RANGE______3_CM 1 0. 0. 1. ECU_ADDRESS 0xd0003dc0 BIT_MASK 0x1 /end MEASUREMENT
/begin MEASUREMENT cdn_diag_el_cps "Diagnosis condition for each symptom of CPS" UBYTE _CNV_A_R_ECME_LINEA_0_CM 1 0. 0. 7. ECU_ADDRESS 0xd0003dc8 FORMAT "%1.0" /end MEASUREMENT
/begin MEASUREMENT cdn_diag_rly_fpmp_el "Diagnosis condition for each symptom of fuel pump relay control electrical diagnosis" UBYTE _CNV_A_R_ECME_LINEA_0_CM 1 0. 0. 7. ECU_ADDRESS 0xd0003dca FORMAT "%1.0" /end MEASUREMENT
/begin MEASUREMENT ctr_pulse_cps_dly "Time counter for pulse at key ON" UBYTE _CNV_A_R_LINEAR_____144_CM 1 0. 0. 255. ECU_ADDRESS 0xd000545c FORMAT "%3.0" /end MEASUREMENT
/begin MEASUREMENT err_diag_el_cps "Raw value of error symptom for CPS" UBYTE _CNV_S_16_RANGE_ERR__151_CM 1 0. 0. 15. ECU_ADDRESS 0xd0003dc9 /end MEASUREMENT
/begin MEASUREMENT err_diag_rly_fpmp_el "Detected symptom for fuel pump relay control diagnosis" UBYTE _CNV_S_16_RANGE_ERR__151_CM 1 0. 0. 15. ECU_ADDRESS 0xd0003dcb /end MEASUREMENT
/begin MEASUREMENT lv_pulse_cps "Flag to indicate that the pulse at key on was done" UBYTE _CNV_S_2_RANGE______3_CM 1 0. 0. 1. ECU_ADDRESS 0xd0003dc7 BIT_MASK 0x1 /end MEASUREMENT
/begin MEASUREMENT lv_pulse_cps_tmp "Flag to indicate that pulse is working" UBYTE _CNV_S_2_RANGE______3_CM 1 0. 0. 1. ECU_ADDRESS 0xd000545f BIT_MASK 0x1 /end MEASUREMENT
/begin CHARACTERISTIC Cxx_cp_frq_1 "Low frequency command for canister purge" VALUE 0xa00216a8 _REC_S1VAL_20_u1 255. _CNV_A_R_LINEAR_____231_CM 0. 255. FORMAT "%3.0" /end CHARACTERISTIC
/begin CHARACTERISTIC Cxx_cp_frq_2 "High frequency command for canister purge" VALUE 0xa00216a9 _REC_S1VAL_20_u1 255. _CNV_A_R_LINEAR_____231_CM 0. 255. FORMAT "%3.0" /end CHARACTERISTIC
/begin CHARACTERISTIC c_cppwm_diag_max_scg "Maximum threshold for SCG diagnosis window" VALUE 0xa00211c9 _REC_S1VAL_20_u1 99.609375 _CNV_A_R_LINEAR_____232_CM 0. 99.609375 FORMAT "%9.6" /end CHARACTERISTIC
/begin CHARACTERISTIC c_cppwm_diag_min_oc "Minimum threshold for OC diagnosis window" VALUE 0xa00211ca _REC_S1VAL_20_u1 99.609375 _CNV_A_R_LINEAR_____232_CM 0. 99.609375 FORMAT "%9.6" /end CHARACTERISTIC
/begin CHARACTERISTIC c_cppwm_diag_min_scp "Minimum threshold for SCP diagnosis window" VALUE 0xa00211cb _REC_S1VAL_20_u1 99.609375 _CNV_A_R_LINEAR_____232_CM 0. 99.609375 FORMAT "%9.6" /end CHARACTERISTIC
/begin CHARACTERISTIC c_ctr_pulse_cps_dly "Time value for pulse at key ON" VALUE 0xa00211cd _REC_S1VAL_20_u1 255. _CNV_A_R_LINEAR_____144_CM 0. 255. FORMAT "%3.0" /end CHARACTERISTIC
/begin MEASUREMENT Vbx_eng_off_mdf1_mem "Mdf1 state saved from EEPROM" UBYTE _CNV_S_2_RANGE______3_CM 1 0. 0. 1. DISPLAY_IDENTIFIER ClCooCtl_NVM.Vbx_eng_off_mdf1_mem_NVM ECU_ADDRESS 0xd00055a9 BIT_MASK 0x1 /end MEASUREMENT
/begin MEASUREMENT Vbx_eng_aut_fan "Engine in autonomous state" UBYTE _CNV_S_2_RANGE______3_CM 1 0. 0. 1. ECU_ADDRESS 0xd00051cc BIT_MASK 0x1 /end MEASUREMENT
/begin MEASUREMENT Vbx_eng_mdf1 "Fan 1 activation request from water temperature or engine management" UBYTE _CNV_S_2_RANGE______3_CM 1 0. 0. 1. ECU_ADDRESS 0xd00051cd BIT_MASK 0x1 /end MEASUREMENT
/begin MEASUREMENT Vbx_eng_mdf1_dly "Boolean to maintan the engine coolant ECU supply during watching for engine stop" UBYTE _CNV_S_2_RANGE______3_CM 1 0. 0. 1. ECU_ADDRESS 0xd00051ce BIT_MASK 0x1 /end MEASUREMENT
/begin MEASUREMENT Vbx_eng_mdf1_req "Fan 1 activation request from water temperature or engine management" UBYTE _CNV_S_2_RANGE______3_CM 1 0. 0. 1. ECU_ADDRESS 0xd00051cf BIT_MASK 0x1 /end MEASUREMENT
/begin MEASUREMENT Vbx_eng_mdf2 "Fan 2 activation request from water temperature or engine management" UBYTE _CNV_S_2_RANGE______3_CM 1 0. 0. 1. ECU_ADDRESS 0xd00051d0 BIT_MASK 0x1 /end MEASUREMENT
/begin MEASUREMENT Vbx_eng_mdf2_req "Fan 2 activation request from water temperature or engine management" UBYTE _CNV_S_2_RANGE______3_CM 1 0. 0. 1. ECU_ADDRESS 0xd00051d1 BIT_MASK 0x1 /end MEASUREMENT
/begin MEASUREMENT Vbx_eng_off_mdf1 "Fan 1 activation request (engine off)" UBYTE _CNV_S_2_RANGE______3_CM 1 0. 0. 1. ECU_ADDRESS 0xd00051d2 BIT_MASK 0x1 /end MEASUREMENT
/begin MEASUREMENT Vbx_mdf1 "Fan 1 activation request from water temperature or engine management" UBYTE _CNV_S_2_RANGE______3_CM 1 0. 0. 1. ECU_ADDRESS 0xd00051d3 BIT_MASK 0x1 /end MEASUREMENT
/begin MEASUREMENT Vbx_mdf2 "Fan 2 activation request from water temperature or engine management" UBYTE _CNV_S_2_RANGE______3_CM 1 0. 0. 1. ECU_ADDRESS 0xd00051d4 BIT_MASK 0x1 /end MEASUREMENT
/begin MEASUREMENT Vbx_mdf_pws "The engine coolant function wishes that the ECU remains supplied." UBYTE _CNV_S_2_RANGE______3_CM 1 0. 0. 1. ECU_ADDRESS 0xd00051d5 BIT_MASK 0x1 /end MEASUREMENT
/begin MEASUREMENT Vbx_tco_ac_dsb "Air conditioning deactivation request for engine thermal protection" UBYTE _CNV_S_2_RANGE______3_CM 1 0. 0. 1. ECU_ADDRESS 0xd00051d6 BIT_MASK 0x1 /end MEASUREMENT
/begin CHARACTERISTIC Cbx_eng_stop_mdf_cho "Choice of fan 1 or 2 during PWL (true : fan 2)" VALUE 0xa0021cbc _REC_S1VAL_20_u1 1. _CNV_A_R_ECME_LINEA_0_CM 0. 1. FORMAT "%1.0" BIT_MASK 0x1 /end CHARACTERISTIC
/begin CHARACTERISTIC Cxx_ac_dsb_tco_thd "Offset on Cxx_mdf_1_cmd_ena_thd_tco for the Water Temp. threshold to disable the air conditioning system." VALUE 0xa0021c8e _REC_S1VAL_20_u2 240. _CNV_A_R_LINEAR_____54_CM -40. 200. FORMAT "%5.1" /end CHARACTERISTIC
/begin CHARACTERISTIC Cxx_ac_dsb_tco_thd_h "Offset on Water Temp. to disable the air conditioning system on High Temp. regulation mode." VALUE 0xa0021c90 _REC_S1VAL_20_u2 240. _CNV_A_R_LINEAR_____54_CM -40. 200. FORMAT "%5.1" /end CHARACTERISTIC
/begin CHARACTERISTIC Cxx_ac_ena_tco_thd "Offset on Cxx_mdf_1_cmd_ena_thd_tco to enable the air conditioning system." VALUE 0xa0021c92 _REC_S1VAL_20_u2 240. _CNV_A_R_LINEAR_____54_CM -40. 200. FORMAT "%5.1" /end CHARACTERISTIC
/begin CHARACTERISTIC Cxx_ac_ena_tco_thd_h "Offset on Cxx_mdf_1_cmd_ena_thd_tco to enable the air conditioning system on High Temp. regulation mode." VALUE 0xa0021c94 _REC_S1VAL_20_u2 240. _CNV_A_R_LINEAR_____54_CM -40. 200. FORMAT "%5.1" /end CHARACTERISTIC
/begin CHARACTERISTIC Cxx_cmd_mdf_dly "Maximum duration of mdf1 activation (compromised between engine compartment cooling and electric balance)." VALUE 0xa0021c96 _REC_S1VAL_20_u2 65535. _CNV_A_R_LINEAR_____82_CM 0. 65535. FORMAT "%5.0" /end CHARACTERISTIC
/begin CHARACTERISTIC Cxx_mdf1_cmd_ena_thd_tco_h "Water temperature offset used to activate mdf1 on high temp mode." VALUE 0xa0021c98 _REC_S1VAL_20_u2 240. _CNV_A_R_LINEAR_____54_CM -40. 200. FORMAT "%5.1" /end CHARACTERISTIC
/begin CHARACTERISTIC Cxx_mdf1_off_tco_thd "Water temperature threshold used to desactivate mdf1 (engine stop)." VALUE 0xa0021c9a _REC_S1VAL_20_u2 240. _CNV_A_R_LINEAR_____54_CM -40. 200. FORMAT "%5.1" /end CHARACTERISTIC
/begin CHARACTERISTIC Cxx_mdf1_off_tco_thd_h "Water temperature offset used to deactivate mdf1 on high temp. mode (engine stop)." VALUE 0xa0021c9c _REC_S1VAL_20_u2 240. _CNV_A_R_LINEAR_____54_CM -40. 200. FORMAT "%5.1" /end CHARACTERISTIC
/begin CHARACTERISTIC Cxx_mdf1_on_tco_thd "Water temperature threshold used to activate mdf1 (engine stop)." VALUE 0xa0021c9e _REC_S1VAL_20_u2 240. _CNV_A_R_LINEAR_____54_CM -40. 200. FORMAT "%5.1" /end CHARACTERISTIC
/begin CHARACTERISTIC Cxx_mdf1_on_tco_thd_h "Water temperature offset used to activate mdf1 on high temp mode (engine stop)." VALUE 0xa0021ca0 _REC_S1VAL_20_u2 240. _CNV_A_R_LINEAR_____54_CM -40. 200. FORMAT "%5.1" /end CHARACTERISTIC
/begin CHARACTERISTIC Cxx_mdf1_on_tco_thd_hys "Water temperature threshold used to maintain the power supply request (engine stop)." VALUE 0xa0021ca2 _REC_S1VAL_20_u2 240. _CNV_A_R_LINEAR_____54_CM -40. 200. FORMAT "%5.1" /end CHARACTERISTIC
/begin CHARACTERISTIC Cxx_mdf1_on_tco_thd_hys_h "Water temperature offset used to maintain the power supply request on high temp mode (engine stop)." VALUE 0xa0021ca4 _REC_S1VAL_20_u2 240. _CNV_A_R_LINEAR_____54_CM -40. 200. FORMAT "%5.1" /end CHARACTERISTIC
/begin CHARACTERISTIC Cxx_mdf2_off_tco_thd "Water temperature offset on Cxx_mdf_1_cmd_ena_thd_tco used to deactivate mdf2 (engine running)." VALUE 0xa0021ca6 _REC_S1VAL_20_u2 240. _CNV_A_R_LINEAR_____54_CM -40. 200. FORMAT "%5.1" /end CHARACTERISTIC
/begin CHARACTERISTIC Cxx_mdf2_off_tco_thd_h "Water temperature offset used to deactivate mdf2 on high temp mode (engine running)." VALUE 0xa0021ca8 _REC_S1VAL_20_u2 240. _CNV_A_R_LINEAR_____54_CM -40. 200. FORMAT "%5.1" /end CHARACTERISTIC
/begin CHARACTERISTIC Cxx_mdf2_on_tco_thd "Water temperature offset on Cxx_mdf_1_cmd_ena_thd_tco used to activate mdf2 (engine running)." VALUE 0xa0021caa _REC_S1VAL_20_u2 240. _CNV_A_R_LINEAR_____54_CM -40. 200. FORMAT "%5.1" /end CHARACTERISTIC
/begin CHARACTERISTIC Cxx_mdf2_on_tco_thd_h "Water temperature offset used to activate mdf2 on high Temp. mode (engine running)." VALUE 0xa0021cac _REC_S1VAL_20_u2 240. _CNV_A_R_LINEAR_____54_CM -40. 200. FORMAT "%5.1" /end CHARACTERISTIC
/begin CHARACTERISTIC Cxx_mdf_1_cmd_ena_thd_tco "Water temperature threshold used to activate mdf1 (engine running)" VALUE 0xa0021cae _REC_S1VAL_20_u2 240. _CNV_A_R_LINEAR_____54_CM -40. 200. FORMAT "%5.1" /end CHARACTERISTIC
/begin CHARACTERISTIC Cxx_mon_stop_tco_thd "Water Temperature threshold used to stop the power supply request." VALUE 0xa0021cb0 _REC_S1VAL_20_u2 240. _CNV_A_R_LINEAR_____54_CM -40. 200. FORMAT "%5.1" /end CHARACTERISTIC
/begin CHARACTERISTIC Cxx_mon_stop_tco_thd_h "Water Temperature threshold used to stop the power supply request on high temperature mode." VALUE 0xa0021cb2 _REC_S1VAL_20_u2 240. _CNV_A_R_LINEAR_____54_CM -40. 200. FORMAT "%5.1" /end CHARACTERISTIC
/begin CHARACTERISTIC Cxx_run_mdf1_off_tco_thd "Offset on Cxx_mdf_1_cmd_ena_thd_tco to deactivate mdf1 (engine running)." VALUE 0xa0021cb4 _REC_S1VAL_20_u2 240. _CNV_A_R_LINEAR_____54_CM -40. 200. FORMAT "%5.1" /end CHARACTERISTIC
/begin CHARACTERISTIC Cxx_run_mdf1_off_tco_thd_h "Additive offset used to deactivate mdf1 on high temp. mode (engine running)." VALUE 0xa0021cb6 _REC_S1VAL_20_u2 240. _CNV_A_R_LINEAR_____54_CM -40. 200. FORMAT "%5.1" /end CHARACTERISTIC
/begin CHARACTERISTIC Cxx_tco_fail_cmd_mdf_dly "Maximum duration of mdf1 activation (compromised between engine compartment cooling and electric balance)." VALUE 0xa0021cb8 _REC_S1VAL_20_u2 65535. _CNV_A_R_LINEAR_____82_CM 0. 65535. FORMAT "%5.0" /end CHARACTERISTIC
/begin CHARACTERISTIC Cxx_tco_mdf_dly "Maximum duration of water temperature monitoring to activate mdf1 (compromised between engine compartment cooling and electric" VALUE 0xa0021cba _REC_S1VAL_20_u2 65535. _CNV_A_R_LINEAR_____82_CM 0. 65535. FORMAT "%5.0" /end CHARACTERISTIC
/begin AXIS_PTS Ctb_n_ovt_tq "Overtorque map X breakpoint" 0xa002a508 Vxx_n_mv _REC_A2AXS_20_u2 16383.75 _CNV_A_R_ENSD_LINEA_24_CM 9 0. 16383.75 FORMAT "%8.2" /end AXIS_PTS
/begin CHARACTERISTIC Cmp_ovt_tq "Overtorque calibration map" MAP 0xa002a51c _REC_A1MAP_20_u2_u2_u1 2047.96875 _CNV_A_R_LINEAR_____123_CM 0. 2047.96875 FORMAT "%10.5"
 /begin AXIS_DESCR COM_AXIS Vxx_n_mv _CNV_A_R_ENSD_LINEA_24_CM 9 0. 16383.75 FORMAT "%8.2" AXIS_PTS_REF Ctb_n_ovt_tq /end AXIS_DESCR
 /begin AXIS_DESCR COM_AXIS Vxx_gear _CNV_A_R_LINEAR_____113_CM 8 -1. 6. READ_ONLY FORMAT "%2.0" AXIS_PTS_REF Ntb_gear /end AXIS_DESCR
/end CHARACTERISTIC
/begin CHARACTERISTIC Ctd_ovt_tq_t_max "Overtorque limitation in N.m.s, Time en Frequency" CURVE 0xa002a5ac _REC_A1CUR_20_u2_u1 2047.96875 _CNV_A_R_LINEAR_____233_CM 0. 2047.96875 FORMAT "%10.5"
 /begin AXIS_DESCR COM_AXIS Vxx_gear _CNV_A_R_LINEAR_____113_CM 8 -1. 6. READ_ONLY FORMAT "%2.0" AXIS_PTS_REF Ntb_gear /end AXIS_DESCR
/end CHARACTERISTIC
/begin CHARACTERISTIC Ctp_ovt_lim_amp "Atmospheric pressure limitation map" CURVE 0xa0021e9e _REC_A1CUR_20_u1_u2 1. _CNV_A_R_LINEAR_____43_CM 0. 1. FORMAT "%9.7"
 /begin AXIS_DESCR COM_AXIS Vxx_amp _CNV_A_R_LINEAR_____57_CM 6 0. 20000. FORMAT "%5.0" AXIS_PTS_REF Ctb_eng_amp /end AXIS_DESCR
/end CHARACTERISTIC
/begin CHARACTERISTIC Ctp_ovt_lim_mat "Manifold air temperature limitation map" CURVE 0xa0021ea4 _REC_A1CUR_20_u1_u2 1. _CNV_A_R_LINEAR_____43_CM 0. 1. FORMAT "%9.7"
 /begin AXIS_DESCR COM_AXIS Vxx_up_it_temp _CNV_A_R_LINEAR_____54_CM 6 -40. 200. FORMAT "%5.1" AXIS_PTS_REF Ctb_ovh_up_it_temp /end AXIS_DESCR
/end CHARACTERISTIC
/begin CHARACTERISTIC Ctp_ovt_lim_tco "Engine coolant temperature limitation map" CURVE 0xa0021eaa _REC_A1CUR_20_u1_u2 1. _CNV_A_R_LINEAR_____43_CM 0. 1. FORMAT "%9.7"
 /begin AXIS_DESCR COM_AXIS Vxx_tco _CNV_A_R_LINEAR_____54_CM 6 -40. 200. FORMAT "%5.1" AXIS_PTS_REF Ctb_ovh_tco /end AXIS_DESCR
/end CHARACTERISTIC
/begin CHARACTERISTIC Ctp_ovt_lim_toil "Oil temperature limitation map" CURVE 0xa0021eb0 _REC_A1CUR_20_u1_u2 1. _CNV_A_R_LINEAR_____43_CM 0. 1. FORMAT "%9.7"
 /begin AXIS_DESCR COM_AXIS Vxx_toil _CNV_A_R_LINEAR_____54_CM 6 -40. 200. FORMAT "%5.1" AXIS_PTS_REF Ctb_ovh_toil /end AXIS_DESCR
/end CHARACTERISTIC
/begin MEASUREMENT Vbx_ovt_ena "Set if the overtorque is active" UBYTE _CNV_S_2_RANGE______3_CM 1 0. 0. 1. ECU_ADDRESS 0xd0004bdd BIT_MASK 0x1 /end MEASUREMENT
/begin MEASUREMENT Vxx_ovt_egy_fac "Factor of the frequency limitation and the time limitation of overtorque potential" UWORD _CNV_A_R_LINEAR_____125_CM 1 0. 0. 1. ECU_ADDRESS 0xd0002e3a FORMAT "%11.9" /end MEASUREMENT
/begin MEASUREMENT Vxx_ovt_fac_dly "Factor of the frequency limitation and the time limitation of overtorque potential with one step of delay" UWORD _CNV_A_R_LINEAR_____125_CM 1 0. 0. 1. ECU_ADDRESS 0xd0002e3c FORMAT "%11.9" /end MEASUREMENT
/begin MEASUREMENT Vxx_ovt_fac_lim "Physical limitation factor" UBYTE _CNV_A_R_LINEAR_____43_CM 1 0. 0. 1. ECU_ADDRESS 0xd0002e44 FORMAT "%9.7" /end MEASUREMENT
/begin MEASUREMENT Vxx_ovt_tq_appl "Offset of overtorque after diagnosis block applied to the torq structure" UWORD _CNV_A_R_LINEAR_____123_CM 1 0. 0. 2047.96875 ECU_ADDRESS 0xd0002e3e FORMAT "%10.5" /end MEASUREMENT
/begin MEASUREMENT Vxx_ovt_tq_ofs_raw "Overtorque offset in fonction of the engine speed and the gear engaged" UWORD _CNV_A_R_LINEAR_____123_CM 1 0. 0. 2047.96875 ECU_ADDRESS 0xd0002e40 FORMAT "%10.5" /end MEASUREMENT
/begin MEASUREMENT Vxx_ovt_tq_raw "Overtorque offset with limitation factors" UWORD _CNV_A_R_LINEAR_____123_CM 1 0. 0. 2047.96875 ECU_ADDRESS 0xd0002e42 FORMAT "%10.5" /end MEASUREMENT
/begin CHARACTERISTIC Cxx_ovt_inc_neg "Coefficient to decrease the overtorque limitation factor" VALUE 0xa0021eb6 _REC_S1VAL_20_u2 254.99609375 _CNV_A_R_LINEAR_____31_CM 1. 255.99609375 FORMAT "%12.8" /end CHARACTERISTIC
/begin CHARACTERISTIC Cxx_ovt_n_thd "Threshold of engine speed to cut the overtorque in the end of overtorque zone." VALUE 0xa0021eb8 _REC_S1VAL_20_u2 16383.75 _CNV_A_R_ENSD_LINEA_24_CM 0. 16383.75 FORMAT "%8.2" /end CHARACTERISTIC
/begin CHARACTERISTIC Cxx_ovt_neg_fac "Recovery torque of the frequency integrator when the OVT is switched off." VALUE 0xa0021eba _REC_S1VAL_20_s2 2047.96875 _CNV_A_R_LINEAR_____123_CM -1024. 1023.96875 FORMAT "%11.5" /end CHARACTERISTIC
/begin CHARACTERISTIC Cxx_ovt_ovn_ofs "engine speed threshold to cut the overtorque in the overspeed zone, in fonction of maximun engine speed" VALUE 0xa0021ebc _REC_S1VAL_20_u2 16383.75 _CNV_A_R_ENSD_LINEA_24_CM 0. 16383.75 FORMAT "%8.2" /end CHARACTERISTIC
/begin CHARACTERISTIC Cxx_ovt_tq_dly_max "Time limitation for the certification" VALUE 0xa0021ec4 _REC_S1VAL_20_u1 255. _CNV_A_R_LINEAR_____82_CM 0. 255. FORMAT "%3.0" /end CHARACTERISTIC
/begin CHARACTERISTIC Cxx_ovt_tq_fac_thd "Minimum factor to enable the overtorque" VALUE 0xa0021ebe _REC_S1VAL_20_u2 1. _CNV_A_R_LINEAR_____125_CM 0. 1. FORMAT "%11.9" /end CHARACTERISTIC
/begin CHARACTERISTIC Cxx_ovt_tq_max "Maximal value of over-torque" VALUE 0xa0021ec0 _REC_S1VAL_20_u2 2047.96875 _CNV_A_R_LINEAR_____123_CM 0. 2047.96875 FORMAT "%10.5" /end CHARACTERISTIC
/begin CHARACTERISTIC Cxx_ovt_tq_ofs_thd "Minimum offset to activate the overtorque" VALUE 0xa0021ec2 _REC_S1VAL_20_u2 2047.96875 _CNV_A_R_LINEAR_____123_CM 0. 2047.96875 FORMAT "%10.5" /end CHARACTERISTIC
/begin CHARACTERISTIC Cxx_ovt_tq_slop_neg "Value of the negative gradient of overtorque in case of overtorque inhibiton" VALUE 0xa0021ec5 _REC_S1VAL_20_u1 255. _CNV_A_R_LINEAR_____234_CM -255. 0. FORMAT "%4.0" /end CHARACTERISTIC
/begin CHARACTERISTIC Cxx_ovt_tq_slop_pos "Value of the positive gradient of overtorque in case of overtorque inhibiton" VALUE 0xa0021ec6 _REC_S1VAL_20_u1 255. _CNV_A_R_LINEAR_____235_CM 0. 255. FORMAT "%3.0" /end CHARACTERISTIC
/begin MEASUREMENT Vsx_eng_tql_vld "Engine torque losses validity status" UBYTE _CNV_S_2_STATUS_OK__214_CM 1 0. 0. 1. ECU_ADDRESS 0xd0004c5f /end MEASUREMENT
/begin MEASUREMENT Vxx_aux_tql_sp "Torque losses due to accessories" UWORD _CNV_A_R_LINEAR_____123_CM 1 0. 0. 2047.96875 ECU_ADDRESS 0xd0002fce FORMAT "%10.5" /end MEASUREMENT
/begin MEASUREMENT Vxx_eng_tql "Engine torque losses" UWORD _CNV_A_R_LINEAR_____123_CM 1 0. 0. 2047.96875 ECU_ADDRESS 0xd0002fd0 FORMAT "%10.5" /end MEASUREMENT
/begin MEASUREMENT Vxx_is_tql "engine torque losses for idle" UWORD _CNV_A_R_LINEAR_____123_CM 1 0. 0. 2047.96875 ECU_ADDRESS 0xd0002fd2 FORMAT "%10.5" /end MEASUREMENT
/begin CHARACTERISTIC Cbx_is_ad_eng_tql_cmf "add adaptive idle speed torques on engine torque losses or on minimum torque" VALUE 0xa00207da _REC_S1VAL_20_u1 1. _CNV_S_2_RANGE______3_CM 0. 1. /end CHARACTERISTIC
/begin CHARACTERISTIC Cxx_pwst_off_is_cor_dly "Inhibition time of the torque losses from power steering" VALUE 0xa00207d6 _REC_S1VAL_20_u2 655.35 _CNV_A_R_LINEAR_____34_CM 0. 655.35 FORMAT "%6.2" /end CHARACTERISTIC
/begin CHARACTERISTIC Cxx_pwst_prs_tql "Torque loss from power steering" VALUE 0xa00207d8 _REC_S1VAL_20_u2 2047.96875 _CNV_A_R_LINEAR_____123_CM 0. 2047.96875 FORMAT "%10.5" /end CHARACTERISTIC
/begin CHARACTERISTIC Cmp_tql_eng_frn "Engine rubbing torque losses map dependent on engine speed and temperature" MAP 0xa002fa58 _REC_A1MAP_20_u2_u2_u2 2047.96875 _CNV_A_R_LINEAR_____123_CM 0. 2047.96875 FORMAT "%10.5"
 /begin AXIS_DESCR COM_AXIS Vxx_n _CNV_A_R_ENSD_LINEA_24_CM 20 0. 16383.75 FORMAT "%8.2" AXIS_PTS_REF Ctb_n /end AXIS_DESCR
 /begin AXIS_DESCR COM_AXIS Vxx_tco _CNV_A_R_LINEAR_____54_CM 16 -40. 200. FORMAT "%5.1" AXIS_PTS_REF Ctb_tco /end AXIS_DESCR
/end CHARACTERISTIC
/begin MEASUREMENT Vsx_tql_eng_frn_vld "Engine rubbing torque losses validity status" UBYTE _CNV_S_2_STATUS_OK__214_CM 1 0. 0. 1. ECU_ADDRESS 0xd0004c9c /end MEASUREMENT
/begin MEASUREMENT Vxx_tql_eng_frn "Engine rubbing torque losses" UWORD _CNV_A_R_LINEAR_____123_CM 1 0. 0. 2047.96875 ECU_ADDRESS 0xd0003688 FORMAT "%10.5" /end MEASUREMENT
/begin CHARACTERISTIC Cbx_tql_temp_cfm "Choice of water or oil temperature permited, according with technical engine definition" VALUE 0xa00207dc _REC_S1VAL_20_u1 1. _CNV_S_2_RANGE______3_CM 0. 1. /end CHARACTERISTIC
/begin AXIS_PTS Ctb_ptq_dp_form_fac "Difference pressure axis for form factor map." 0xa002a7b8 Vxx_dp_fil _REC_A2AXS_20_u2 20000. _CNV_A_R_LINEAR_____107_CM 10 -10000. 10000. FORMAT "%6.0" /end AXIS_PTS
/begin CHARACTERISTIC Ctp_ptq_dp_form_fac "Curve of form factor for pumping torque calculation. Value is signed,so it can be + or - with losse" CURVE 0xa002a7d0 _REC_A1CUR_20_u1_u2 9.9609375 _CNV_A_R_LINEAR_____236_CM 0. 9.9609375 FORMAT "%9.7"
 /begin AXIS_DESCR COM_AXIS Vxx_dp_fil _CNV_A_R_LINEAR_____107_CM 10 -10000. 10000. FORMAT "%6.0" AXIS_PTS_REF Ctb_ptq_dp_form_fac /end AXIS_DESCR
/end CHARACTERISTIC
/begin MEASUREMENT Vsx_ptq_vld "Pumping torque validity status" UBYTE _CNV_S_2_STATUS_OK__214_CM 1 0. 0. 1. ECU_ADDRESS 0xd0004ffb /end MEASUREMENT
/begin MEASUREMENT Vxx_dp "Difference pressure between inlet manifold and in front of the turbine" SWORD _CNV_A_R_LINEAR_____57_CM 1 0. -10000. 10000. ECU_ADDRESS 0xd0005b14 FORMAT "%6.0" /end MEASUREMENT
/begin MEASUREMENT Vxx_dp_fil "Filtered difference pressure (between inlet manifold and in front of the turbine)" SWORD _CNV_A_R_LINEAR_____57_CM 1 0. -10000. 10000. ECU_ADDRESS 0xd0005b16 FORMAT "%6.0" /end MEASUREMENT
/begin MEASUREMENT Vxx_ptq "Value of the pumping torque" SWORD _CNV_A_R_LINEAR_____123_CM 1 0. -1024. 1023.96875 ECU_ADDRESS 0xd00030be FORMAT "%11.5" /end MEASUREMENT
/begin CHARACTERISTIC Cbx_ptq_ex_prs_mdl_ok_cfm "Exhaust manifold pressure model is considered sufficient to estimate pumping torque if the sensor is failing" VALUE 0xa0020c80 _REC_S1VAL_20_u1 1. _CNV_S_2_RANGE______3_CM 0. 1. /end CHARACTERISTIC
/begin CHARACTERISTIC Cxx_ptq_ftc "Time constant of difference pressure filtering curve" VALUE 0xa0020c7a _REC_S1VAL_20_u2 655.35 _CNV_A_R_LINEAR_____34_CM 0. 655.35 FORMAT "%6.2" /end CHARACTERISTIC
/begin CHARACTERISTIC Cxx_ptq_max "Max value of the pumping torque" VALUE 0xa0020c7c _REC_S1VAL_20_s2 2047.96875 _CNV_A_R_LINEAR_____123_CM -1024. 1023.96875 FORMAT "%11.5" /end CHARACTERISTIC
/begin CHARACTERISTIC Cxx_ptq_min "Minimum value of the pumping torque" VALUE 0xa0020c7e _REC_S1VAL_20_s2 2047.96875 _CNV_A_R_LINEAR_____123_CM -1024. 1023.96875 FORMAT "%11.5" /end CHARACTERISTIC
/begin MEASUREMENT Vbx_df_wpmp_tcr_blk "Unable to move the component to the commanded position of turbo water pump detected failure" UBYTE _CNV_S_2_RANGE______3_CM 1 0. 0. 1. ECU_ADDRESS 0xd0004af7 BIT_MASK 0x1 /end MEASUREMENT
/begin MEASUREMENT Vbx_df_wpmp_tcr_oc "Circuit Open of turbo water pump detected failure" UBYTE _CNV_S_2_RANGE______3_CM 1 0. 0. 1. ECU_ADDRESS 0xd0004af4 BIT_MASK 0x1 /end MEASUREMENT
/begin MEASUREMENT Vbx_df_wpmp_tcr_scg "Circuit Short to Ground of turbo water pump detected failure" UBYTE _CNV_S_2_RANGE______3_CM 1 0. 0. 1. ECU_ADDRESS 0xd0004af5 BIT_MASK 0x1 /end MEASUREMENT
/begin MEASUREMENT Vbx_df_wpmp_tcr_scw "Circuit Short to Battery of turbo water pump detected failure" UBYTE _CNV_S_2_RANGE______3_CM 1 0. 0. 1. ECU_ADDRESS 0xd0004af6 BIT_MASK 0x1 /end MEASUREMENT
/begin MEASUREMENT Vbx_diag_ena_wpmp_tcr_blk "Unable to move the component to the commanded position of turbo water pump diagnosis authorization" UBYTE _CNV_S_2_RANGE______3_CM 1 0. 0. 1. ECU_ADDRESS 0xd0004afb BIT_MASK 0x1 /end MEASUREMENT
/begin MEASUREMENT Vbx_diag_ena_wpmp_tcr_oc "Circuit Open of turbo water pump diagnosis authorization" UBYTE _CNV_S_2_RANGE______3_CM 1 0. 0. 1. ECU_ADDRESS 0xd0004af8 BIT_MASK 0x1 /end MEASUREMENT
/begin MEASUREMENT Vbx_diag_ena_wpmp_tcr_scg "Circuit Short to Ground of turbo water pump diagnosis authorization" UBYTE _CNV_S_2_RANGE______3_CM 1 0. 0. 1. ECU_ADDRESS 0xd0004af9 BIT_MASK 0x1 /end MEASUREMENT
/begin MEASUREMENT Vbx_diag_ena_wpmp_tcr_scw "Circuit Short to Battery of turbo water pump diagnosis authorization" UBYTE _CNV_S_2_RANGE______3_CM 1 0. 0. 1. ECU_ADDRESS 0xd0004afa BIT_MASK 0x1 /end MEASUREMENT
/begin MEASUREMENT cdn_diag_oil_heat_el "Diagnosis condition for each symptom of upstream heater diagnosis OBD I" UBYTE _CNV_A_R_ECME_LINEA_0_CM 1 0. 0. 7. ECU_ADDRESS 0xd0004afe FORMAT "%1.0" /end MEASUREMENT
/begin MEASUREMENT cdn_diag_wpmp_el "Diagnosis condition for each symptom of water pump control electrical diagnosis" UBYTE _CNV_A_R_ECME_LINEA_0_CM 1 0. 0. 15. ECU_ADDRESS 0xd0004afc FORMAT "%2.0" /end MEASUREMENT
/begin MEASUREMENT ctr_swi_on "Counter of recurrence" UBYTE _CNV_A_R_ECME_LINEA_0_CM 1 0. 0. 255. ECU_ADDRESS 0xd00052c8 FORMAT "%3.0" /end MEASUREMENT
/begin MEASUREMENT err_diag_oil_heat_el "Raw value of error symptom for upstream heater diagnosis OBD I" UBYTE _CNV_S_16_RANGE_ERR__151_CM 1 0. 0. 15. ECU_ADDRESS 0xd0004aff /end MEASUREMENT
/begin MEASUREMENT err_diag_wpmp_el "Detected symptom for water pump control diagnosis" UBYTE _CNV_S_16_RANGE_ERR__151_CM 1 0. 0. 15. ECU_ADDRESS 0xd0004afd /end MEASUREMENT
/begin MEASUREMENT lv_end_pump_stuck "Flag to indicate end of calculation of pump stuck detection" UBYTE _CNV_S_2_RANGE______3_CM 1 0. 0. 1. ECU_ADDRESS 0xd00052d1 BIT_MASK 0x1 /end MEASUREMENT
/begin MEASUREMENT lv_err_wpmp_el_scp "Short Cut to Plus confirmed failure on Water Pump" UBYTE _CNV_S_2_RANGE______3_CM 1 0. 0. 1. ECU_ADDRESS 0xd0004af2 BIT_MASK 0x1 /end MEASUREMENT
/begin MEASUREMENT lv_pulse_ack "Flag to indicate that pulse acquisition is done" UBYTE _CNV_S_2_RANGE______3_CM 1 0. 0. 1. ECU_ADDRESS 0xd00052cd BIT_MASK 0x1 /end MEASUREMENT
/begin MEASUREMENT lv_pulse_req "Request for pulse generation at key ON" UBYTE _CNV_S_2_RANGE______3_CM 1 0. 0. 1. ECU_ADDRESS 0xd00052ce BIT_MASK 0x1 /end MEASUREMENT
/begin MEASUREMENT lv_sta_mem_wpmp "Memorization of water pump state" UBYTE _CNV_S_2_RANGE______3_CM 1 0. 0. 1. ECU_ADDRESS 0xd00052cc BIT_MASK 0x1 /end MEASUREMENT
/begin MEASUREMENT lv_start_pump_stuck "flag to indicate key transition ON to OFF" UBYTE _CNV_S_2_RANGE______3_CM 1 0. 0. 1. ECU_ADDRESS 0xd00052cf BIT_MASK 0x1 /end MEASUREMENT
/begin MEASUREMENT lv_wpmp_on "Flag indicating water pump state" UBYTE _CNV_S_2_RANGE______3_CM 1 0. 0. 1. ECU_ADDRESS 0xd0004af3 BIT_MASK 0x1 /end MEASUREMENT
/begin MEASUREMENT lv_wpmp_position "Water Pump control command state (0H = pump shall be OFF, 1H = pump shall be ON)" UBYTE _CNV_S_2_RANGE______3_CM 1 0. 0. 1. ECU_ADDRESS 0xd0004af1 BIT_MASK 0x1 /end MEASUREMENT
/begin MEASUREMENT lv_wpmp_swi_on "Flag to indicate that water pump is on since c_wpmp_swi_on recurrence" UBYTE _CNV_S_2_RANGE______3_CM 1 0. 0. 1. ECU_ADDRESS 0xd00052d2 BIT_MASK 0x1 /end MEASUREMENT
/begin MEASUREMENT lv_wtpump "logical feedback of water pump discret stage" UBYTE _CNV_S_2_RANGE______3_CM 1 0. 0. 1. ECU_ADDRESS 0xd00052d0 BIT_MASK 0x1 /end MEASUREMENT
/begin MEASUREMENT v_adc_pulse "Raw signal acquisition during the pulse at key ON" UWORD _CNV_A_R_LINEAR_____237_CM 1 0. 0. 11.992722 ECU_ADDRESS 0xd0003c08 FORMAT "%9.7" /end MEASUREMENT
/begin MEASUREMENT v_diag_stu_mv_1 "Mean of 18 acquisition of v_diag_wpmp (used for pump stuck diagnosis)" UWORD _CNV_A_R_LINEAR_____237_CM 1 0. 0. 11.992722 ECU_ADDRESS 0xd0003c0c FORMAT "%9.7" /end MEASUREMENT
/begin MEASUREMENT v_diag_stu_mv_2 "Mean of 20 acquisition of v_diag_wpmp (used for pump stuck diagnosis)" UWORD _CNV_A_R_LINEAR_____237_CM 1 0. 0. 11.992722 ECU_ADDRESS 0xd0003c0e FORMAT "%9.7" /end MEASUREMENT
/begin MEASUREMENT v_diag_wpmp "Raw value for water pump control diagnosis" UWORD _CNV_A_R_LINEAR_____237_CM 1 0. 0. 11.992722 ECU_ADDRESS 0xd0003c0a FORMAT "%9.7" /end MEASUREMENT
/begin MEASUREMENT vp_wtpump "raw signal voltage of water pump discret stage" UWORD _CNV_A_R_LINEAR_____237_CM 1 0. 0. 11.992722 ECU_ADDRESS 0xd0003c10 FORMAT "%9.7" /end MEASUREMENT
/begin CHARACTERISTIC c_diag_wpmp "Hardware threshold for diagnosis of pump stuck symptom" VALUE 0xa00211d1 _REC_S1VAL_20_u1 1. _CNV_A_R_LINEAR_____136_CM 0. 1. FORMAT "%4.2" /end CHARACTERISTIC
/begin CHARACTERISTIC c_wpmp_swi_on "Number of recurrence since water pump is switched ON" VALUE 0xa00211e3 _REC_S1VAL_20_u1 255. _CNV_A_R_ECME_LINEA_0_CM 0. 255. FORMAT "%3.0" /end CHARACTERISTIC
/begin AXIS_PTS Ctp_iga_dif "advance degradation with regard to the optimal advance" 0xa0025314 NO_INPUT_QUANTITY _REC_A2AXS_20_u1 95.625 _CNV_A_R_LINEAR_____25_CM 33 0. 95.625 /end AXIS_PTS
/begin AXIS_PTS Ctp_iga_dif_sq "square of advance degradation" 0xa0025338 NO_INPUT_QUANTITY _REC_A2AXS_20_u2 9215.859375 _CNV_A_R_LINEAR_____238_CM 33 0. 9215.859375 FORMAT "%11.6" /end AXIS_PTS
/begin MEASUREMENT Vxx_iga "final ignition advance calculated by torque structure" UBYTE _CNV_A_R_IGRE_LINEA_48_CM 1 0. -23.625 72. ECU_ADDRESS 0xd0004b27 FORMAT "%7.3" /end MEASUREMENT
/begin MEASUREMENT Vxx_raw_iga "final ignition advance calculated by torque structure without limitations" UBYTE _CNV_A_R_IGRE_LINEA_48_CM 1 0. -23.625 72. ECU_ADDRESS 0xd0004b28 FORMAT "%7.3" /end MEASUREMENT
/begin MEASUREMENT Vxx_iga_efy "Final efficiency calculated by torque structure" UWORD _CNV_A_R_LINEAR_____125_CM 1 0. 0. 1. ECU_ADDRESS 0xd0003254 FORMAT "%11.9" /end MEASUREMENT
/begin MEASUREMENT Vxx_raw_iga_efy "Raw efficiency calculated by torque structure" UWORD _CNV_A_R_LINEAR_____125_CM 1 0. 0. 1. ECU_ADDRESS 0xd0003256 FORMAT "%11.9" /end MEASUREMENT
/begin MEASUREMENT Vxx_appl_iga_efy "torque efficiency corresponding to applied advance" UWORD _CNV_A_R_LINEAR_____125_CM 1 0. 0. 1. ECU_ADDRESS 0xd00031f8 FORMAT "%11.9" /end MEASUREMENT
/begin MEASUREMENT Vxx_appl_iga_efy_2 "torque efficiency corresponding to applied advance" UWORD _CNV_A_R_LINEAR_____125_CM 1 0. 0. 1. ECU_ADDRESS 0xd00031fa FORMAT "%11.9" /end MEASUREMENT
/begin MEASUREMENT Vxx_esti_tqe "Estimated effective engine torque" UWORD _CNV_A_R_LINEAR_____161_CM 1 0. -400. 1647.96875 ECU_ADDRESS 0xd00031fc FORMAT "%10.5" /end MEASUREMENT
/begin MEASUREMENT Vxx_esti_tqe_tgt "Estimated target effective engine torque (at maximum advance)" UWORD _CNV_A_R_LINEAR_____161_CM 1 0. -400. 1647.96875 ECU_ADDRESS 0xd00031fe FORMAT "%10.5" /end MEASUREMENT
/begin MEASUREMENT Vxx_esti_tqi "Estimated indicate engine torque" UWORD _CNV_A_R_LINEAR_____123_CM 1 0. 0. 2047.96875 ECU_ADDRESS 0xd0003200 FORMAT "%10.5" /end MEASUREMENT
/begin MEASUREMENT Vxx_eng_maf_efy_cor "torque efficiency correction to commpensate the fact that the target torque request (or manifold flow) cannot be realized" UWORD _CNV_A_R_LINEAR_____125_CM 1 0. 0. 4. ECU_ADDRESS 0xd00032e0 FORMAT "%11.9" /end MEASUREMENT
/begin MEASUREMENT Vxx_l_maf_efy_thd "low threshold for manifold dynamic compensation efficiency" UWORD _CNV_A_R_LINEAR_____125_CM 1 0. 0. 4. ECU_ADDRESS 0xd00032e2 FORMAT "%11.9" /end MEASUREMENT
/begin MEASUREMENT Vxx_maf_cyl_mdl "Modeled mass air flow pumped into cylinder" UWORD _CNV_A_R_LINEAR_____109_CM 1 0. 0. 3000. ECU_ADDRESS 0xd00032e4 FORMAT "%7.2" /end MEASUREMENT
/begin MEASUREMENT Vxx_maf_efy_cor "Torque efficiency correction to compensate the fact that the target torque request (or manifold flow) cannot be realized" UWORD _CNV_A_R_LINEAR_____125_CM 1 0. 0. 4. ECU_ADDRESS 0xd00032e6 FORMAT "%11.9" /end MEASUREMENT
/begin MEASUREMENT Vxx_maf_efy_ena_fac "factor to enable the compensation of manifold dynamic" UWORD _CNV_A_R_LINEAR_____125_CM 1 0. 0. 1. ECU_ADDRESS 0xd00032e8 FORMAT "%11.9" /end MEASUREMENT
/begin MEASUREMENT Vxx_maf_eng_mdl "Modeled mass air flow (manifold)" UWORD _CNV_A_R_LINEAR_____109_CM 1 0. 0. 3000. ECU_ADDRESS 0xd00032ea FORMAT "%7.2" /end MEASUREMENT
/begin MEASUREMENT Vxx_maf_it_mdl "Modeled mass air flow (throttle)" UWORD _CNV_A_R_LINEAR_____109_CM 1 0. 0. 3000. ECU_ADDRESS 0xd00032ec FORMAT "%7.2" /end MEASUREMENT
/begin MEASUREMENT Vxx_map_eng_mdl "modeled manifold pressure" UWORD _CNV_A_R_LINEAR_____57_CM 1 0. 0. 20000. ECU_ADDRESS 0xd00032ee FORMAT "%5.0" /end MEASUREMENT
/begin MEASUREMENT Vxx_raw_maf_efy_cor "Raw torque efficiency correction to commpensate the fact that the target torque request (or manifold flow) cannot be realized" UWORD _CNV_A_R_LINEAR_____125_CM 1 0. 0. 4. ECU_ADDRESS 0xd00032f0 FORMAT "%11.9" /end MEASUREMENT
/begin MEASUREMENT Vxx_sat_maf_efy_cor "torque efficiency correction to compensate the fact that the target torque request (or manifold flow) cannot be realized" UWORD _CNV_A_R_LINEAR_____125_CM 1 0. 0. 4. ECU_ADDRESS 0xd00032f2 FORMAT "%11.9" /end MEASUREMENT
/begin CHARACTERISTIC Cbx_maf_efy_cor_ena_cfm "enable manifold dynamic compensation" VALUE 0xa0021360 _REC_S1VAL_20_u1 1. _CNV_A_R_ECME_LINEA_0_CM 0. 1. FORMAT "%1.0" BIT_MASK 0x1 /end CHARACTERISTIC
/begin CHARACTERISTIC Cbx_maf_efy_tkof_cfm "enable the consideration of coupler state during take off" VALUE 0xa0021361 _REC_S1VAL_20_u1 1. _CNV_A_R_ECME_LINEA_0_CM 0. 1. FORMAT "%1.0" BIT_MASK 0x1 /end CHARACTERISTIC
/begin CHARACTERISTIC Cbx_maf_efy_tq_trs_cfm "enable manifold dynamic compensation for transient intersystem torque request" VALUE 0xa0021362 _REC_S1VAL_20_u1 1. _CNV_A_R_ECME_LINEA_0_CM 0. 1. FORMAT "%1.0" BIT_MASK 0x1 /end CHARACTERISTIC
/begin CHARACTERISTIC Cxx_eal_maf_efy_ena_thd "Engine air load threshold to enable the consideration of coupler state" VALUE 0xa002134a _REC_S1VAL_20_u2 3.99993896484375 _CNV_A_R_LINEAR_____53_CM 0. 3.99993896484375 FORMAT "%10.8" /end CHARACTERISTIC
/begin CHARACTERISTIC Cxx_h_maf_efy_thd "high threshold for manifold dynamic compensation efficiency" VALUE 0xa002134c _REC_S1VAL_20_u2 4. _CNV_A_R_LINEAR_____125_CM 0. 4. FORMAT "%11.9" /end CHARACTERISTIC
/begin CHARACTERISTIC Cxx_l_maf_efy_dly "delay to enable low threshold !=1" VALUE 0xa0021363 _REC_S1VAL_20_u1 2.55 _CNV_A_R_LINEAR_____34_CM 0. 2.55 FORMAT "%4.2" /end CHARACTERISTIC
/begin CHARACTERISTIC Cxx_l_maf_efy_neg_slop "negative slope for manifold compensation dynamic efficiency" VALUE 0xa002134e _REC_S1VAL_20_s2 199.90234375 _CNV_A_R_LINEAR_____239_CM -100. 99.90234375 FORMAT "%11.6" /end CHARACTERISTIC
/begin CHARACTERISTIC Cxx_l_maf_efy_pos_slop "positive slope for manifold compensation dynamic efficiency" VALUE 0xa0021350 _REC_S1VAL_20_s2 199.90234375 _CNV_A_R_LINEAR_____239_CM -100. 99.90234375 FORMAT "%11.6" /end CHARACTERISTIC
/begin CHARACTERISTIC Cxx_l_maf_efy_thd "low threshold for manifold dynamic compensation efficiency" VALUE 0xa0021352 _REC_S1VAL_20_u2 4. _CNV_A_R_LINEAR_____125_CM 0. 4. FORMAT "%11.9" /end CHARACTERISTIC
/begin CHARACTERISTIC Cxx_maf_cor_efy_dz "Dead zone for manifold dynamic compensation efficiency" VALUE 0xa0021354 _REC_S1VAL_20_u2 4. _CNV_A_R_LINEAR_____125_CM 0. 4. FORMAT "%11.9" /end CHARACTERISTIC
/begin CHARACTERISTIC Cxx_maf_efy_is_ena_thd "threshold on manifold dynamic compensation correction to stop correction during idle speed" VALUE 0xa0021356 _REC_S1VAL_20_u2 4. _CNV_A_R_LINEAR_____125_CM 0. 4. FORMAT "%11.9" /end CHARACTERISTIC
/begin CHARACTERISTIC Cxx_maf_efy_neg_slop "negative slope for manifold compensation dynamic efficiency" VALUE 0xa0021358 _REC_S1VAL_20_s2 199.90234375 _CNV_A_R_LINEAR_____239_CM -100. 99.90234375 FORMAT "%11.6" /end CHARACTERISTIC
/begin CHARACTERISTIC Cxx_n_maf_efy_ena_thd "engine speed threshold to enable torque efficiency correction" VALUE 0xa002135a _REC_S1VAL_20_u2 16383.75 _CNV_A_R_ENSD_LINEA_24_CM 0. 16383.75 FORMAT "%8.2" /end CHARACTERISTIC
/begin CHARACTERISTIC Cxx_sta_l_maf_efy_thd "low threshold for manifold dynamic compensation efficiency for start" VALUE 0xa002135c _REC_S1VAL_20_u2 4. _CNV_A_R_LINEAR_____125_CM 0. 4. FORMAT "%11.9" /end CHARACTERISTIC
/begin CHARACTERISTIC Cxx_tkof_h_maf_efy_thd "high threshold for manifold dynamic compensation efficiency (take off)" VALUE 0xa002135e _REC_S1VAL_20_u2 4. _CNV_A_R_LINEAR_____125_CM 0. 4. FORMAT "%11.9" /end CHARACTERISTIC
/begin MEASUREMENT Vbx_no_ajs_tq_efy_cut "Cut request if the final indicated target torque is inferior at the minimum torque threshold" UBYTE _CNV_S_2_RANGE______3_CM 1 0. 0. 1. ECU_ADDRESS 0xd0004365 BIT_MASK 0x1 /end MEASUREMENT
/begin MEASUREMENT Vxx_ajs_tq_efy "Torque efficiency correspond only to AJS" UWORD _CNV_A_R_LINEAR_____125_CM 1 0. 0. 4. ECU_ADDRESS 0xd00037f4 FORMAT "%11.9" /end MEASUREMENT
/begin MEASUREMENT Vxx_no_ajs_tq_efy "Torque efficiency correspond to ratio between setpoint and target indicated torques (without AJS)" UWORD _CNV_A_R_LINEAR_____125_CM 1 0. 0. 4. ECU_ADDRESS 0xd00037f6 FORMAT "%11.9" /end MEASUREMENT
/begin CHARACTERISTIC Cxx_dz_iga_efv "Cxx_dz_iga_efv : torque threshold under which the torque efficiency is set to 1 or 0." VALUE 0xa002150a _REC_S1VAL_20_u2 2047.96875 _CNV_A_R_LINEAR_____123_CM 0. 2047.96875 FORMAT "%10.5" /end CHARACTERISTIC
/begin MEASUREMENT Vxx_rich_dstb_cor_efy "Torque efficiency correction corresponding to richness correction for warm-up" UWORD _CNV_A_R_LINEAR_____125_CM 1 0. 0. 4. ECU_ADDRESS 0xd000389c FORMAT "%11.9" /end MEASUREMENT
/begin CHARACTERISTIC Cxx_rich_dstb_cor_efy_fac "torque efficiency correction corresponding to richness correction for warm-up factor" VALUE 0xa0020f45 _REC_S1VAL_20_u1 1.9921875 _CNV_A_R_LINEAR_____187_CM -1. 0.9921875 FORMAT "%9.6" /end CHARACTERISTIC
/begin CHARACTERISTIC Cxx_rich_dstb_cor_efy_fac_alco "torque efficiency correction corresponding to richness correction for warm-up factor (alcool)" VALUE 0xa0020f46 _REC_S1VAL_20_u1 1.9921875 _CNV_A_R_LINEAR_____187_CM -1. 0.9921875 FORMAT "%9.6" /end CHARACTERISTIC
/begin AXIS_PTS Ntb_cyl "Cylinder number breakpoint [0 1 2 3 4 5 6 7]" 0xa002e694 Vxx_req_inj_cut_nr_1 _REC_A2AXS_20_u1 7. _CNV_A_R_ECME_LINEA_0_CM 8 0. 7. READ_ONLY FORMAT "%1.0" /end AXIS_PTS
/begin CHARACTERISTIC Ctd_inj_efy_dz "dead zone to authorize the activation of on injector (efficiency is function of number of cut cylinder)" CURVE 0xa002e6a0 _REC_A1CUR_20_u2_u1 4. _CNV_A_R_LINEAR_____125_CM 0. 4. FORMAT "%11.9"
 /begin AXIS_DESCR COM_AXIS Vxx_req_inj_cut_nr_1 _CNV_A_R_ECME_LINEA_0_CM 8 0. 7. READ_ONLY FORMAT "%1.0" AXIS_PTS_REF Ntb_cyl /end AXIS_DESCR
/end CHARACTERISTIC
/begin MEASUREMENT Vbx_cut "The active cut flag" UBYTE _CNV_S_2_RANGE______3_CM 1 0. 0. 1. ECU_ADDRESS 0xd0004360 BIT_MASK 0x1 /end MEASUREMENT
/begin MEASUREMENT Vbx_cut_it_dft "limp home" UBYTE _CNV_S_2_RANGE______3_CM 1 0. 0. 1. ECU_ADDRESS 0xd0004361 BIT_MASK 0x1 /end MEASUREMENT
/begin MEASUREMENT Vxx_cut_efy_dz "dead zone to authorize the cut of on injector" UWORD _CNV_A_R_LINEAR_____125_CM 1 0. 0. 4. ECU_ADDRESS 0xd000358e FORMAT "%11.9" /end MEASUREMENT
/begin MEASUREMENT Vxx_cyl_cut_tq_efy "torque efficiency corrected by the number of cut cylinders" UWORD _CNV_A_R_LINEAR_____125_CM 1 0. 0. 4. ECU_ADDRESS 0xd0003590 FORMAT "%11.9" /end MEASUREMENT
/begin MEASUREMENT Vxx_h_req_inj_cut_nr "Maximum number of cylinders which can be cut" UBYTE _CNV_A_R_ECME_LINEA_0_CM 1 0. 0. 12. ECU_ADDRESS 0xd0004362 FORMAT "%2.0" /end MEASUREMENT
/begin MEASUREMENT Vxx_inj_efy_dz "Dead zone to authorize the activation of on injector" UWORD _CNV_A_R_LINEAR_____125_CM 1 0. 0. 4. ECU_ADDRESS 0xd0003592 FORMAT "%11.9" /end MEASUREMENT
/begin MEASUREMENT Vxx_req_inj_cut_nr "Number of cylinder to cut" UBYTE _CNV_A_R_ECME_LINEA_0_CM 1 0. 0. 12. ECU_ADDRESS 0xd0004363 FORMAT "%2.0" /end MEASUREMENT
/begin MEASUREMENT Vxx_req_inj_cut_nr_1 "Number of cylinder to cut (i-1)" UBYTE _CNV_A_R_ECME_LINEA_0_CM 1 0. 0. 12. ECU_ADDRESS 0xd0004364 FORMAT "%2.0" /end MEASUREMENT
/begin CHARACTERISTIC Cxx_cut_efy_dz "dead zone to authorize the cut of on injector (only applied to cut the last cylinder)" VALUE 0xa0021506 _REC_S1VAL_20_u2 4. _CNV_A_R_LINEAR_____125_CM 0. 4. FORMAT "%11.9" /end CHARACTERISTIC
/begin CHARACTERISTIC Cxx_lih_inj_cut_nr "" VALUE 0xa0021508 _REC_S1VAL_20_u2 12. _CNV_A_R_ECME_LINEA_0_CM 0. 12. FORMAT "%2.0" /end CHARACTERISTIC
/begin MEASUREMENT Vsx_tq_fct_vld "Torque realization validity status" UBYTE _CNV_A_R_ECME_LINEA_0_CM 1 0. 0. 3. ECU_ADDRESS 0xd0004a6d FORMAT "%1.0" /end MEASUREMENT
/begin CHARACTERISTIC Cbx_n_tq_fct_vld2_cfm "allow to choose torque validity level on Engine speed validity status" VALUE 0xa0020766 _REC_S1VAL_20_u1 1. _CNV_A_R_ECME_LINEA_0_CM 0. 1. FORMAT "%1.0" BIT_MASK 0x1 /end CHARACTERISTIC
/begin AXIS_PTS Ctb_rich_sp "richness setpoint breakpoints" 0xa0025134 Vxx_rich_sp _REC_A2AXS_20_u2 1.99996948242188 _CNV_A_R_LINEAR_____49_CM 9 0. 1.99996948242188 FORMAT "%7.5" /end AXIS_PTS
/begin CHARACTERISTIC Cmp_n_eal_otl_tqi_fac "Massic hp indicated torque factor depending on engine air load and engine speed" MAP 0xa0025148 _REC_A1MAP_20_u1_u2_u2 0.498046875 _CNV_A_R_LINEAR_____240_CM 0.501953125 1. FORMAT "%3.1"
 /begin AXIS_DESCR COM_AXIS Vxx_n _CNV_A_R_ENSD_LINEA_24_CM 20 0. 16383.75 FORMAT "%8.2" AXIS_PTS_REF Ctb_n /end AXIS_DESCR
 /begin AXIS_DESCR COM_AXIS Vxx_eal _CNV_A_R_LINEAR_____53_CM 16 0. 3.99993896484375 FORMAT "%10.8" AXIS_PTS_REF Ctb_eal /end AXIS_DESCR
/end CHARACTERISTIC
/begin CHARACTERISTIC Ctp_rich_otl_iga_tqi_fac "Massic hp indicated torque factor depending on Air/fuel ratio target" CURVE 0xa0025288 _REC_A1CUR_20_u2_u2 2. _CNV_A_R_LINEAR_____125_CM 0. 2. FORMAT "%10.8"
 /begin AXIS_DESCR COM_AXIS Vxx_rich_sp _CNV_A_R_LINEAR_____49_CM 9 0. 1.99996948242188 FORMAT "%7.5" AXIS_PTS_REF Ctb_rich_sp /end AXIS_DESCR
/end CHARACTERISTIC
/begin MEASUREMENT Vsx_otl_iga_mv_tqi_vld "HP indicated torque for 1kg of air at optimal advance validity status" UBYTE _CNV_S_3_STATUS_OK__120_CM 1 0. 0. 2. ECU_ADDRESS 0xd0004231 /end MEASUREMENT
/begin MEASUREMENT Vxx_otl_iga_mv_tqi "HP indicated torque for 1kg of air at optimal advance" UWORD _CNV_A_R_LINEAR_____241_CM 1 0. 0. 524280. ECU_ADDRESS 0xd000375c FORMAT "%6.0" /end MEASUREMENT
/begin MEASUREMENT Vxx_otl_iga_mv_tqi_gas "HP indicated torque for 1kg of air at optimal advance for gasoline" UWORD _CNV_A_R_LINEAR_____241_CM 1 0. 0. 524280. ECU_ADDRESS 0xd0005b5e FORMAT "%6.0" /end MEASUREMENT
/begin CHARACTERISTIC Cxx_otl_iga_tqi "massic hp indicated torque" VALUE 0xa002145c _REC_S1VAL_20_u2 524280. _CNV_A_R_LINEAR_____241_CM 0. 524280. FORMAT "%6.0" /end CHARACTERISTIC
/begin MEASUREMENT Vxx_maf_frh_eng_sp "fresh mass air flow (engine)" UWORD _CNV_A_R_LINEAR_____109_CM 1 0. 0. 3000. ECU_ADDRESS 0xd0003246 FORMAT "%7.2" /end MEASUREMENT
/begin MEASUREMENT Vxx_maf_frh_it_sp "fresh mass air flow (throttle)" UWORD _CNV_A_R_LINEAR_____109_CM 1 0. 0. 3000. ECU_ADDRESS 0xd0003248 FORMAT "%7.2" /end MEASUREMENT
/begin MEASUREMENT Vxx_pow_ant "anticipated power setpoint" UWORD _CNV_A_R_LINEAR_____128_CM 1 0. 0. 655350. ECU_ADDRESS 0xd000324a FORMAT "%6.0" /end MEASUREMENT
/begin MEASUREMENT Vxx_pow_tgt "target power setpoint" UWORD _CNV_A_R_LINEAR_____128_CM 1 0. 0. 655350. ECU_ADDRESS 0xd000324c FORMAT "%6.0" /end MEASUREMENT
/begin MEASUREMENT Vxx_tq_ant_is_cor "torque correction for idle speed activation" UWORD _CNV_A_R_LINEAR_____123_CM 1 0. 0. 2047.96875 ECU_ADDRESS 0xd000324e FORMAT "%10.5" /end MEASUREMENT
/begin MEASUREMENT Vxx_tqi_ant "final indicated anticipated torque" UWORD _CNV_A_R_LINEAR_____123_CM 1 0. 0. 2047.96875 ECU_ADDRESS 0xd0003250 FORMAT "%10.5" /end MEASUREMENT
/begin CHARACTERISTIC Cbx_ant_is_cor_cfm "Enable torque correction for idle speed activation" VALUE 0xa00211ec _REC_S1VAL_20_u1 1. _CNV_A_R_ECME_LINEA_0_CM 0. 1. FORMAT "%1.0" BIT_MASK 0x1 /end CHARACTERISTIC
/begin CHARACTERISTIC Cxx_ant_is_drv_thd "derivate of engine speed threshold" VALUE 0xa00211ea _REC_S1VAL_20_s2 16383. _CNV_A_R_LINEAR_____23_CM -8192. 8191. FORMAT "%5.0" /end CHARACTERISTIC
/begin CHARACTERISTIC Cxx_ant_is_tq_fac "factor" VALUE 0xa00211ed _REC_S1VAL_20_u1 19.921875 _CNV_A_R_LINEAR_____242_CM 0. 19.921875 FORMAT "%8.6" /end CHARACTERISTIC
/begin CHARACTERISTIC Cxx_ant_is_tq_n_drv_ftc "filtering time for derivate of engine speed" VALUE 0xa00211ee _REC_S1VAL_20_u1 2.55 _CNV_A_R_LINEAR_____34_CM 0. 2.55 FORMAT "%4.2" /end CHARACTERISTIC
/begin CHARACTERISTIC Cmp_iga_efv_degr_a "Coefficient a of the advance parabola function of engine speed and engine air load" MAP 0xa00257fc _REC_A1MAP_20_u2_u2_u2 1.99996948242187e-003 _CNV_A_R_LINEAR_____168_CM 0. 1.99996948242187e-003 FORMAT "%9.8"
 /begin AXIS_DESCR COM_AXIS Vxx_n _CNV_A_R_ENSD_LINEA_24_CM 20 0. 16383.75 FORMAT "%8.2" AXIS_PTS_REF Ctb_n /end AXIS_DESCR
 /begin AXIS_DESCR COM_AXIS Vxx_eal _CNV_A_R_LINEAR_____53_CM 16 0. 3.99993896484375 FORMAT "%10.8" AXIS_PTS_REF Ctb_eal /end AXIS_DESCR
/end CHARACTERISTIC
/begin MEASUREMENT Vxx_iga_efv_degr_a "Coefficient a of the advance parabola" UWORD _CNV_A_R_LINEAR_____168_CM 1 0. 0. 1.99996948242187e-003 ECU_ADDRESS 0xd0003822 FORMAT "%9.8" /end MEASUREMENT
/begin MEASUREMENT Vxx_max_iga_efy "torque efficiency corresponding to maximum ignition advance" UWORD _CNV_A_R_LINEAR_____125_CM 1 0. 0. 1. ECU_ADDRESS 0xd0003824 FORMAT "%11.9" /end MEASUREMENT
/begin MEASUREMENT Vxx_min_iga_efy "torque efficiency corresponding to minimum ignition advance" UWORD _CNV_A_R_LINEAR_____125_CM 1 0. 0. 1. ECU_ADDRESS 0xd0003826 FORMAT "%11.9" /end MEASUREMENT
/begin MEASUREMENT Vxx_stat_min_iga_efy "torque efficiency corresponding to minimum static ignition advance" UWORD _CNV_A_R_LINEAR_____125_CM 1 0. 0. 1. ECU_ADDRESS 0xd0003828 FORMAT "%11.9" /end MEASUREMENT
/begin AXIS_PTS Ctb_is_eal "Engine air load breakpoints for idle speed" 0xa002a60c Vxx_eal _REC_A2AXS_20_u2 3.99993896484375 _CNV_A_R_LINEAR_____53_CM 9 0. 3.99993896484375 FORMAT "%10.8" /end AXIS_PTS
/begin AXIS_PTS Ctb_is_n "engine speed breakpoints for idle speed" 0xa002a620 Vxx_is_n_sp _REC_A2AXS_20_u2 16383.75 _CNV_A_R_ENSD_LINEA_24_CM 9 0. 16383.75 FORMAT "%8.2" /end AXIS_PTS
/begin CHARACTERISTIC Cmp_n_eal_is_efy "Torque efficiency for idle speed" MAP 0xa002a634 _REC_A1MAP_20_u2_u2_u2 1. _CNV_A_R_LINEAR_____125_CM 0. 1. FORMAT "%11.9"
 /begin AXIS_DESCR COM_AXIS Vxx_is_n_sp _CNV_A_R_ENSD_LINEA_24_CM 9 0. 16383.75 FORMAT "%8.2" AXIS_PTS_REF Ctb_is_n /end AXIS_DESCR
 /begin AXIS_DESCR COM_AXIS Vxx_eal _CNV_A_R_LINEAR_____53_CM 9 0. 3.99993896484375 FORMAT "%10.8" AXIS_PTS_REF Ctb_is_eal /end AXIS_DESCR
/end CHARACTERISTIC
/begin MEASUREMENT Vxx_is_efy "torque efficiency for idle speed controller" UWORD _CNV_A_R_LINEAR_____125_CM 1 0. 0. 1. ECU_ADDRESS 0xd0002e78 FORMAT "%11.9" /end MEASUREMENT
/begin MEASUREMENT Vxx_raw_is_efy "raw torque efficiency for idle speed controller" UWORD _CNV_A_R_LINEAR_____125_CM 1 0. 0. 70. ECU_ADDRESS 0xd0002e7a FORMAT "%11.9" /end MEASUREMENT
/begin CHARACTERISTIC Cxx_is_efy_slop "maximum slop on idle speed efficiency" VALUE 0xa00215a4 _REC_S1VAL_20_u2 100. _CNV_A_R_LINEAR_____243_CM 0. 100. FORMAT "%4.2" /end CHARACTERISTIC
/begin AXIS_PTS Ctb_n_wup "Engine speed breakpoints for catalyst warm-up" 0xa002ba00 Vxx_n_mv _REC_A2AXS_20_u2 16383.75 _CNV_A_R_ENSD_LINEA_24_CM 9 0. 16383.75 FORMAT "%8.2" /end AXIS_PTS
/begin AXIS_PTS Ctb_wup_h_l_iga_efy_ctr "Breakpoints of number of TDC" 0xa002ba14 Vxx_cata_wup_ctr _REC_A2AXS_20_u2 65535. _CNV_A_R_LINEAR_____55_CM 9 0. 65535. FORMAT "%5.0" /end AXIS_PTS
/begin AXIS_PTS Ctb_wup_tq_rel "9 programmable relative torque ratio breakpoints linked to catalyst warm-up" 0xa002ba28 Vxx_tq_rel _REC_A2AXS_20_u2 4. _CNV_A_R_LINEAR_____228_CM 9 -2. 2. FORMAT "%7.4" /end AXIS_PTS
/begin CHARACTERISTIC Cmp_n_tq_rel_wup_cold_iga_efy "Torque efficiency correction for catalyst warm-up in cold start conditions" MAP 0xa002ba3c _REC_A1MAP_20_u2_u2_u2 1. _CNV_A_R_LINEAR_____125_CM 0. 1. FORMAT "%11.9"
 /begin AXIS_DESCR COM_AXIS Vxx_n_mv _CNV_A_R_ENSD_LINEA_24_CM 9 0. 16383.75 FORMAT "%8.2" AXIS_PTS_REF Ctb_n_wup /end AXIS_DESCR
 /begin AXIS_DESCR COM_AXIS Vxx_tq_rel _CNV_A_R_LINEAR_____228_CM 9 -2. 2. FORMAT "%7.4" AXIS_PTS_REF Ctb_wup_tq_rel /end AXIS_DESCR
/end CHARACTERISTIC
/begin CHARACTERISTIC Cmp_n_tq_rel_wup_h_iga_efy "High torque efficiency correction for catalyst warm-up" MAP 0xa002bae0 _REC_A1MAP_20_u2_u2_u2 1. _CNV_A_R_LINEAR_____125_CM 0. 1. FORMAT "%11.9"
 /begin AXIS_DESCR COM_AXIS Vxx_n_mv _CNV_A_R_ENSD_LINEA_24_CM 9 0. 16383.75 FORMAT "%8.2" AXIS_PTS_REF Ctb_n_wup /end AXIS_DESCR
 /begin AXIS_DESCR COM_AXIS Vxx_tq_rel _CNV_A_R_LINEAR_____228_CM 9 -2. 2. FORMAT "%7.4" AXIS_PTS_REF Ctb_wup_tq_rel /end AXIS_DESCR
/end CHARACTERISTIC
/begin CHARACTERISTIC Cmp_n_tq_rel_wup_l_iga_efy "\"Low\" torque efficiency correction for catalyst warm-up" MAP 0xa002bb84 _REC_A1MAP_20_u2_u2_u2 1. _CNV_A_R_LINEAR_____125_CM 0. 1. FORMAT "%11.9"
 /begin AXIS_DESCR COM_AXIS Vxx_n_mv _CNV_A_R_ENSD_LINEA_24_CM 9 0. 16383.75 FORMAT "%8.2" AXIS_PTS_REF Ctb_n_wup /end AXIS_DESCR
 /begin AXIS_DESCR COM_AXIS Vxx_tq_rel _CNV_A_R_LINEAR_____228_CM 9 -2. 2. FORMAT "%7.4" AXIS_PTS_REF Ctb_wup_tq_rel /end AXIS_DESCR
/end CHARACTERISTIC
/begin CHARACTERISTIC Ctp_wup_h_l_iga_efy_ctr "Factor to switch between the \"high\" parameters and the \"low\" parameters during the catalyst warm-up" CURVE 0xa002bc28 _REC_A1CUR_20_u2_u2 1. _CNV_A_R_LINEAR_____125_CM 0. 1. FORMAT "%11.9"
 /begin AXIS_DESCR COM_AXIS Vxx_cata_wup_ctr _CNV_A_R_LINEAR_____55_CM 9 0. 65535. FORMAT "%5.0" AXIS_PTS_REF Ctb_wup_h_l_iga_efy_ctr /end AXIS_DESCR
/end CHARACTERISTIC
/begin MEASUREMENT Vxx_tq_rel "Relative torque ratio" UWORD _CNV_A_R_LINEAR_____228_CM 1 0. -2. 2. ECU_ADDRESS 0xd000326a FORMAT "%7.4" /end MEASUREMENT
/begin MEASUREMENT Vxx_wup_cold_efy_cor "Torque efficiency correction for catalyst warm-up in cold start conditions" UWORD _CNV_A_R_LINEAR_____125_CM 1 0. 0. 1. ECU_ADDRESS 0xd000326c FORMAT "%11.9" /end MEASUREMENT
/begin MEASUREMENT Vxx_wup_efy "warm up efficiency correction" UWORD _CNV_A_R_LINEAR_____125_CM 1 0. 0. 1. ECU_ADDRESS 0xd000326e FORMAT "%11.9" /end MEASUREMENT
/begin MEASUREMENT Vxx_wup_efy_cor "Torque efficiency correction for catalyst warm-up with no cold start conditions" UWORD _CNV_A_R_LINEAR_____125_CM 1 0. 0. 1. ECU_ADDRESS 0xd0003270 FORMAT "%11.9" /end MEASUREMENT
/begin MEASUREMENT Vxx_wup_efy_fil_fac "Factor to filter the efficiency correction in entry and exit of the catalyst warm-up" UWORD _CNV_A_R_LINEAR_____125_CM 1 0. 0. 1. ECU_ADDRESS 0xd0003272 FORMAT "%11.9" /end MEASUREMENT
/begin MEASUREMENT Vxx_wup_h_l_ctr "Counter to switch between the \"high\" parameters and the \"low\" parameters during the catalyst warm-up" UWORD _CNV_A_R_LINEAR_____125_CM 1 0. 0. 1. ECU_ADDRESS 0xd0003274 FORMAT "%11.9" /end MEASUREMENT
/begin CHARACTERISTIC Cxx_diag_sta_cata_lbup_wup_efy "Final torque efficiency correction during diagnostic of catalyst or upstream lambda sensor in after sales" VALUE 0xa00219e8 _REC_S1VAL_20_u2 1. _CNV_A_R_LINEAR_____125_CM 0. 1. FORMAT "%11.9" /end CHARACTERISTIC
/begin CHARACTERISTIC Cxx_wup_cold_fil_pos_slop "Positive maximum slope parameter per second in cold start conditions" VALUE 0xa00219ea _REC_S1VAL_20_u1 50. _CNV_A_R_LINEAR_____244_CM 0. 50. FORMAT "%5.1" /end CHARACTERISTIC
/begin CHARACTERISTIC Cxx_wup_efy_ftc "Time constant of the filter on the torque efficiency in catalyst warm-up" VALUE 0xa00219eb _REC_S1VAL_20_u1 2.55 _CNV_A_R_LINEAR_____34_CM 0. 2.55 FORMAT "%4.2" /end CHARACTERISTIC
/begin CHARACTERISTIC Cxx_wup_fil_neg_slop "Negative maximum slope parameter per second" VALUE 0xa00219ec _REC_S1VAL_20_u1 50. _CNV_A_R_LINEAR_____245_CM -50. 0. FORMAT "%5.1" /end CHARACTERISTIC
/begin CHARACTERISTIC Cxx_wup_fil_pos_slop "Positive maximum slope parameter per second" VALUE 0xa00219ed _REC_S1VAL_20_u1 50. _CNV_A_R_LINEAR_____244_CM 0. 50. FORMAT "%5.1" /end CHARACTERISTIC
/begin CHARACTERISTIC Ctp_is_wup_cold_dri_efy_cor "Torque efficiency correction for catalyst warm-up in idle speed" CURVE 0xa00246b4 _REC_A1CUR_20_u2_u2 1. _CNV_A_R_LINEAR_____125_CM 0. 1. FORMAT "%11.9"
 /begin AXIS_DESCR COM_AXIS Vxx_cata_wup_ctr _CNV_A_R_LINEAR_____55_CM 17 0. 65535. FORMAT "%5.0" AXIS_PTS_REF Ctb_is_cata_wup_ctr /end AXIS_DESCR
/end CHARACTERISTIC
/begin CHARACTERISTIC Ctp_is_wup_cold_neut_efy_cor "Torque efficiency correction for catalyst warm-up in idle speed" CURVE 0xa00246d8 _REC_A1CUR_20_u2_u2 1. _CNV_A_R_LINEAR_____125_CM 0. 1. FORMAT "%11.9"
 /begin AXIS_DESCR COM_AXIS Vxx_cata_wup_ctr _CNV_A_R_LINEAR_____55_CM 17 0. 65535. FORMAT "%5.0" AXIS_PTS_REF Ctb_is_cata_wup_ctr /end AXIS_DESCR
/end CHARACTERISTIC
/begin CHARACTERISTIC Ctp_is_wup_dri_efy_cor "Torque efficiency correction for catalyst warm-up in idle speed" CURVE 0xa00246fc _REC_A1CUR_20_u2_u2 1. _CNV_A_R_LINEAR_____125_CM 0. 1. FORMAT "%11.9"
 /begin AXIS_DESCR COM_AXIS Vxx_cata_wup_ctr _CNV_A_R_LINEAR_____55_CM 17 0. 65535. FORMAT "%5.0" AXIS_PTS_REF Ctb_is_cata_wup_ctr /end AXIS_DESCR
/end CHARACTERISTIC
/begin CHARACTERISTIC Ctp_is_wup_neut_efy_cor "Torque efficiency correction for catalyst warm-up in idle speed" CURVE 0xa0024720 _REC_A1CUR_20_u2_u2 1. _CNV_A_R_LINEAR_____125_CM 0. 1. FORMAT "%11.9"
 /begin AXIS_DESCR COM_AXIS Vxx_cata_wup_ctr _CNV_A_R_LINEAR_____55_CM 17 0. 65535. FORMAT "%5.0" AXIS_PTS_REF Ctb_is_cata_wup_ctr /end AXIS_DESCR
/end CHARACTERISTIC
/begin MEASUREMENT Vbx_not_cold_sta_tco "Vxx_sta_tco is superior to Cxx_cold_sta_tco" UBYTE _CNV_S_2_RANGE______3_CM 1 0. 0. 1. ECU_ADDRESS 0xd000474f BIT_MASK 0x1 /end MEASUREMENT
/begin MEASUREMENT Vxx_is_wup_cold_neut_efy_cor "Torque efficiency correction for catalyst warm-up in idle speed and with a manual gearbox or in neutral state (AT)" UWORD _CNV_A_R_LINEAR_____125_CM 1 0. 0. 1. ECU_ADDRESS 0xd00036e2 FORMAT "%11.9" /end MEASUREMENT
/begin MEASUREMENT Vxx_is_wup_dri_efy_cor "Torque efficiency correction for catalyst warm-up in idle speed and in Drive state (AT)" UWORD _CNV_A_R_LINEAR_____125_CM 1 0. 0. 1. ECU_ADDRESS 0xd00036e4 FORMAT "%11.9" /end MEASUREMENT
/begin MEASUREMENT Vxx_is_wup_efy "Torque efficiency correction for catalyst warm-up in idle speed" UWORD _CNV_A_R_LINEAR_____125_CM 1 0. 0. 1. ECU_ADDRESS 0xd00036e6 FORMAT "%11.9" /end MEASUREMENT
/begin MEASUREMENT Vxx_is_wup_efy_fil_fac "Factor to filter the torque efficiency correction in entry and exit of the catalyst warm-up in idle speed" UWORD _CNV_A_R_LINEAR_____125_CM 1 0. 0. 1. ECU_ADDRESS 0xd00036e8 FORMAT "%11.9" /end MEASUREMENT
/begin MEASUREMENT Vxx_is_wup_neut_efy_cor "Torque efficiency correction for catalyst warm-up in idle speed and with a manual gearbox or in neutral state (AT)" UWORD _CNV_A_R_LINEAR_____125_CM 1 0. 0. 1. ECU_ADDRESS 0xd00036ea FORMAT "%11.9" /end MEASUREMENT
/begin CHARACTERISTIC Cxx_is_wup_fil_neg_slop "Negative maximum slope parameter per second" VALUE 0xa00218cc _REC_S1VAL_20_u1 50. _CNV_A_R_LINEAR_____245_CM -50. 0. FORMAT "%5.1" /end CHARACTERISTIC
/begin CHARACTERISTIC Cxx_is_wup_fil_pos_slop "Positive maximum slope parameter per second" VALUE 0xa00218cd _REC_S1VAL_20_u1 50. _CNV_A_R_LINEAR_____244_CM 0. 50. FORMAT "%5.1" /end CHARACTERISTIC
/begin AXIS_PTS Ctb_wup_h_l_iga_efy_ctr_alco "Breakpoints of number of TDC" 0xa0023ddc Vxx_cata_wup_ctr _REC_A2AXS_20_u2 65535. _CNV_A_R_LINEAR_____55_CM 9 0. 65535. FORMAT "%5.0" /end AXIS_PTS
/begin CHARACTERISTIC Cmp_iga_efv_degr_a_alco "Coefficient a of the advance parabola function of engine speed and engine air load for flex-fuel" MAP 0xa0023df0 _REC_A1MAP_20_u2_u2_u2 1.99996948242187e-003 _CNV_A_R_LINEAR_____168_CM 0. 1.99996948242187e-003 FORMAT "%9.8"
 /begin AXIS_DESCR COM_AXIS Vxx_n _CNV_A_R_ENSD_LINEA_24_CM 20 0. 16383.75 FORMAT "%8.2" AXIS_PTS_REF Ctb_n /end AXIS_DESCR
 /begin AXIS_DESCR COM_AXIS Vxx_eal _CNV_A_R_LINEAR_____53_CM 16 0. 3.99993896484375 FORMAT "%10.8" AXIS_PTS_REF Ctb_eal /end AXIS_DESCR
/end CHARACTERISTIC
/begin CHARACTERISTIC Cmp_n_eal_otl_tqi_fac_alco "Massic hp indicated torque factor depending on engine air load and engine speed" MAP 0xa0024070 _REC_A1MAP_20_u1_u2_u2 0.498046875 _CNV_A_R_LINEAR_____240_CM 0.501953125 1. FORMAT "%3.1"
 /begin AXIS_DESCR COM_AXIS Vxx_n _CNV_A_R_ENSD_LINEA_24_CM 20 0. 16383.75 FORMAT "%8.2" AXIS_PTS_REF Ctb_n /end AXIS_DESCR
 /begin AXIS_DESCR COM_AXIS Vxx_eal _CNV_A_R_LINEAR_____53_CM 16 0. 3.99993896484375 FORMAT "%10.8" AXIS_PTS_REF Ctb_eal /end AXIS_DESCR
/end CHARACTERISTIC
/begin CHARACTERISTIC Cmp_n_tq_wup_cold_efy_alco "Torque efficiency correction for catalyst warm-up in cold start conditions" MAP 0xa00241b0 _REC_A1MAP_20_u2_u2_u2 1. _CNV_A_R_LINEAR_____125_CM 0. 1. FORMAT "%11.9"
 /begin AXIS_DESCR COM_AXIS Vxx_n_mv _CNV_A_R_ENSD_LINEA_24_CM 9 0. 16383.75 FORMAT "%8.2" AXIS_PTS_REF Ctb_n_wup /end AXIS_DESCR
 /begin AXIS_DESCR COM_AXIS Vxx_tq_rel _CNV_A_R_LINEAR_____228_CM 9 -2. 2. FORMAT "%7.4" AXIS_PTS_REF Ctb_wup_tq_rel /end AXIS_DESCR
/end CHARACTERISTIC
/begin CHARACTERISTIC Cmp_n_tq_wup_h_iga_efy_alco "\"High\" torque efficiency correction for catalyst warm-up" MAP 0xa0024254 _REC_A1MAP_20_u2_u2_u2 1. _CNV_A_R_LINEAR_____125_CM 0. 1. FORMAT "%11.9"
 /begin AXIS_DESCR COM_AXIS Vxx_n_mv _CNV_A_R_ENSD_LINEA_24_CM 9 0. 16383.75 FORMAT "%8.2" AXIS_PTS_REF Ctb_n_wup /end AXIS_DESCR
 /begin AXIS_DESCR COM_AXIS Vxx_tq_rel _CNV_A_R_LINEAR_____228_CM 9 -2. 2. FORMAT "%7.4" AXIS_PTS_REF Ctb_wup_tq_rel /end AXIS_DESCR
/end CHARACTERISTIC
/begin CHARACTERISTIC Cmp_n_tq_wup_l_iga_efy_alco "\"Low\" torque efficiency correction for catalyst warm-up" MAP 0xa00242f8 _REC_A1MAP_20_u2_u2_u2 1. _CNV_A_R_LINEAR_____125_CM 0. 1. FORMAT "%11.9"
 /begin AXIS_DESCR COM_AXIS Vxx_n_mv _CNV_A_R_ENSD_LINEA_24_CM 9 0. 16383.75 FORMAT "%8.2" AXIS_PTS_REF Ctb_n_wup /end AXIS_DESCR
 /begin AXIS_DESCR COM_AXIS Vxx_tq_rel _CNV_A_R_LINEAR_____228_CM 9 -2. 2. FORMAT "%7.4" AXIS_PTS_REF Ctb_wup_tq_rel /end AXIS_DESCR
/end CHARACTERISTIC
/begin CHARACTERISTIC Ctp_is_wup_cold_neut_efy_alco "Torque efficiency correction for catalyst warm-up in idle speed" CURVE 0xa002439c _REC_A1CUR_20_u2_u2 1. _CNV_A_R_LINEAR_____125_CM 0. 1. FORMAT "%11.9"
 /begin AXIS_DESCR COM_AXIS Vxx_cata_wup_ctr _CNV_A_R_LINEAR_____55_CM 17 0. 65535. FORMAT "%5.0" AXIS_PTS_REF Ctb_is_cata_wup_ctr /end AXIS_DESCR
/end CHARACTERISTIC
/begin CHARACTERISTIC Ctp_is_wup_neut_efy_alco "Torque efficiency correction for catalyst warm-up in idle speed." CURVE 0xa00243c0 _REC_A1CUR_20_u2_u2 1. _CNV_A_R_LINEAR_____125_CM 0. 1. FORMAT "%11.9"
 /begin AXIS_DESCR COM_AXIS Vxx_cata_wup_ctr _CNV_A_R_LINEAR_____55_CM 17 0. 65535. FORMAT "%5.0" AXIS_PTS_REF Ctb_is_cata_wup_ctr /end AXIS_DESCR
/end CHARACTERISTIC
/begin CHARACTERISTIC Ctp_rich_otl_iga_tqi_fac_alco "Massic hp indicated torque factor depending on Air/fuel ratio target for flex-fuel." CURVE 0xa00243e4 _REC_A1CUR_20_u2_u2 2. _CNV_A_R_LINEAR_____125_CM 0. 2. FORMAT "%11.8"
 /begin AXIS_DESCR COM_AXIS Vxx_rich_sp _CNV_A_R_LINEAR_____49_CM 9 0. 1.99996948242188 FORMAT "%7.5" AXIS_PTS_REF Ctb_rich_sp /end AXIS_DESCR
/end CHARACTERISTIC
/begin CHARACTERISTIC Ctp_wup_h_l_iga_efy_ctr_alco "Factor to switch between the \"high\" parameters and the \"low\" parameters during the catalyst warm-up" CURVE 0xa00243f8 _REC_A1CUR_20_u2_u2 1. _CNV_A_R_LINEAR_____125_CM 0. 1. FORMAT "%11.9"
 /begin AXIS_DESCR COM_AXIS Vxx_cata_wup_ctr _CNV_A_R_LINEAR_____55_CM 9 0. 65535. FORMAT "%5.0" AXIS_PTS_REF Ctb_wup_h_l_iga_efy_ctr_alco /end AXIS_DESCR
/end CHARACTERISTIC
/begin MEASUREMENT Vxx_iga_efv_degr_a_alco "Coefficient a of the advance parabola for flex-fuel" UWORD _CNV_A_R_LINEAR_____168_CM 1 0. 0. 1.99996948242187e-003 ECU_ADDRESS 0xd000367e FORMAT "%9.8" /end MEASUREMENT
/begin MEASUREMENT Vxx_is_wup_cold_neut_efy_alco "Torque efficiency correction for catalyst warm-up in idle speed and with alcohol" UWORD _CNV_A_R_LINEAR_____125_CM 1 0. 0. 1. ECU_ADDRESS 0xd0003680 FORMAT "%11.9" /end MEASUREMENT
/begin MEASUREMENT Vxx_is_wup_neut_efy_alco "Torque efficiency correction for catalyst warm-up in idle speed, with MGB or in neutral state (AT), with alcohol" UWORD _CNV_A_R_LINEAR_____125_CM 1 0. 0. 1. ECU_ADDRESS 0xd0003682 FORMAT "%11.9" /end MEASUREMENT
/begin MEASUREMENT Vxx_otl_iga_mv_tqi_alco "HP indicated torque for 1kg of air at optimal advance for flex-fuel." UWORD _CNV_A_R_LINEAR_____241_CM 1 0. 0. 524280. ECU_ADDRESS 0xd0005b60 FORMAT "%6.0" /end MEASUREMENT
/begin MEASUREMENT Vxx_wup_cold_efy_cor_alco "Torque efficiency correction for catalyst warm-up in cold start conditions" UWORD _CNV_A_R_LINEAR_____125_CM 1 0. 0. 1. ECU_ADDRESS 0xd0003684 FORMAT "%11.9" /end MEASUREMENT
/begin MEASUREMENT Vxx_wup_efy_cor_alco "Torque efficiency correction for catalyst warm-up with no cold start conditions" UWORD _CNV_A_R_LINEAR_____125_CM 1 0. 0. 1. ECU_ADDRESS 0xd0003686 FORMAT "%11.9" /end MEASUREMENT
/begin MEASUREMENT Vxx_wup_h_l_ctr_alco "Counter to switch between the high parameters and the low parameters during the catalyst warm-up" UWORD _CNV_A_R_LINEAR_____125_CM 1 0. 0. 1. ECU_ADDRESS 0xd000140a FORMAT "%11.8" /end MEASUREMENT
/begin CHARACTERISTIC Cxx_otl_iga_tqi_alco "massic hp indicated torque for flex-fuel." VALUE 0xa0021e08 _REC_S1VAL_20_u2 524280. _CNV_A_R_LINEAR_____241_CM 0. 524280. FORMAT "%6.0" /end CHARACTERISTIC
/begin CHARACTERISTIC Cmp_n_map_cart_iga_bch "ignition advance map (bench mode only) function of engine speed and manifold pressure" MAP 0xa0023120 _REC_A1MAP_20_u1_u2_u2 95.625 _CNV_A_R_IGRE_LINEA_48_CM -23.625 72. FORMAT "%7.3"
 /begin AXIS_DESCR COM_AXIS Vxx_n _CNV_A_R_ENSD_LINEA_24_CM 20 0. 16383.75 FORMAT "%8.2" AXIS_PTS_REF Ctb_n /end AXIS_DESCR
 /begin AXIS_DESCR COM_AXIS Vxx_map _CNV_A_R_LINEAR_____57_CM 17 0. 20000. FORMAT "%5.0" AXIS_PTS_REF Ctb_prs /end AXIS_DESCR
/end CHARACTERISTIC
/begin MEASUREMENT Vxx_iga_appl "applied ignition advance after knock correction" UBYTE _CNV_A_R_IGRE_LINEA_48_CM 1 0. -23.625 72. ECU_ADDRESS 0xd0004f93 FORMAT "%7.3" /end MEASUREMENT
/begin MEASUREMENT Vxx_iga_pred "applied ignition advance after knock correction" UBYTE _CNV_A_R_IGRE_LINEA_48_CM 1 0. -23.625 72. ECU_ADDRESS 0xd0004f94 FORMAT "%7.3" /end MEASUREMENT
/begin MEASUREMENT Vxx_nom_iga "applied ignition advance after knock correction" UBYTE _CNV_A_R_IGRE_LINEA_48_CM 1 0. -23.625 72. ECU_ADDRESS 0xd0004f95 FORMAT "%7.3" /end MEASUREMENT
/begin CHARACTERISTIC Cbx_cart_iga_bch_cfm "bench mode for ignition (map)" VALUE 0xa0020f29 _REC_S1VAL_20_u1 1. _CNV_S_2_RANGE______3_CM 0. 1. /end CHARACTERISTIC
/begin CHARACTERISTIC Cbx_iga_bch_cfm "bench mode for ignition advance (calibration)" VALUE 0xa0020f2a _REC_S1VAL_20_u1 1. _CNV_S_2_RANGE______3_CM 0. 1. /end CHARACTERISTIC
/begin CHARACTERISTIC Cbx_iga_ofs_bch_cfm "ignition adavance bench mode (offset cylinder to cylinder)" VALUE 0xa0020f2b _REC_S1VAL_20_u1 1. _CNV_S_2_RANGE______3_CM 0. 1. /end CHARACTERISTIC
/begin CHARACTERISTIC Cxx_iga_appl_ini "Ignition advance initial value." VALUE 0xa0020f2c _REC_S1VAL_20_u1 95.625 _CNV_A_R_IGRE_LINEA_48_CM -23.625 72. FORMAT "%7.3" /end CHARACTERISTIC
/begin CHARACTERISTIC Cxx_iga_bch "ignition advance for bench mode" VALUE 0xa0020f2d _REC_S1VAL_20_u1 95.625 _CNV_A_R_IGRE_LINEA_48_CM -23.625 72. FORMAT "%7.3" /end CHARACTERISTIC
/begin CHARACTERISTIC Cxx_iga_ofs_cyl1 "ignition advance offset for bench mode (cylinder 1)" VALUE 0xa0020f2e _REC_S1VAL_20_u1 95.625 _CNV_A_R_IGRE_LINEA_48_CM -23.625 72. FORMAT "%7.3" /end CHARACTERISTIC
/begin CHARACTERISTIC Cxx_iga_ofs_cyl2 "ignition advance offset for bench mode (cylinder 2)" VALUE 0xa0020f2f _REC_S1VAL_20_u1 95.625 _CNV_A_R_IGRE_LINEA_48_CM -23.625 72. FORMAT "%7.3" /end CHARACTERISTIC
/begin CHARACTERISTIC Cxx_iga_ofs_cyl3 "ignition advance offset for bench mode (cylinder 3)" VALUE 0xa0020f30 _REC_S1VAL_20_u1 95.625 _CNV_A_R_IGRE_LINEA_48_CM -23.625 72. FORMAT "%7.3" /end CHARACTERISTIC
/begin CHARACTERISTIC Cxx_iga_ofs_cyl4 "ignition advance offset for bench mode (cylinder 4)" VALUE 0xa0020f31 _REC_S1VAL_20_u1 95.625 _CNV_A_R_IGRE_LINEA_48_CM -23.625 72. FORMAT "%7.3" /end CHARACTERISTIC
/begin CHARACTERISTIC Cmp_n_tco_sta_iga "Starting advance Table - coolant temperature and engine speed dependant" MAP 0xa0026afc _REC_A1MAP_20_u1_u2_u2 95.625 _CNV_A_R_IGRE_LINEA_48_CM -23.625 72. FORMAT "%7.3"
 /begin AXIS_DESCR COM_AXIS Vxx_tco _CNV_A_R_LINEAR_____54_CM 8 -40. 200. FORMAT "%5.1" AXIS_PTS_REF Ctb_sta_tco /end AXIS_DESCR
 /begin AXIS_DESCR COM_AXIS Vxx_n _CNV_A_R_ENSD_LINEA_24_CM 8 0. 16383.75 FORMAT "%8.2" AXIS_PTS_REF Ctb_sta_n /end AXIS_DESCR
/end CHARACTERISTIC
/begin MEASUREMENT Vxx_sta_iga "start ignition advance" UBYTE _CNV_A_R_IGRE_LINEA_48_CM 1 0. -23.625 72. ECU_ADDRESS 0xd0004dbf FORMAT "%7.3" /end MEASUREMENT
/begin CHARACTERISTIC Cmp_n_tco_sta_iga_alco "Starting advance Table - coolant temperature and engine speed dependant for flex-fuel" MAP 0xa002ebb0 _REC_A1MAP_20_u1_u2_u2 95.625 _CNV_A_R_IGRE_LINEA_48_CM -23.625 72. FORMAT "%7.3"
 /begin AXIS_DESCR COM_AXIS Vxx_tco _CNV_A_R_LINEAR_____54_CM 8 -40. 200. FORMAT "%5.1" AXIS_PTS_REF Ctb_sta_tco /end AXIS_DESCR
 /begin AXIS_DESCR COM_AXIS Vxx_n _CNV_A_R_ENSD_LINEA_24_CM 8 0. 16383.75 FORMAT "%8.2" AXIS_PTS_REF Ctb_sta_n /end AXIS_DESCR
/end CHARACTERISTIC
/begin MEASUREMENT Vxx_n_tco_sta_iga_alco "start ignition advance for Flex Fuel." UBYTE _CNV_A_R_IGRE_LINEA_48_CM 1 0. -23.625 72. ECU_ADDRESS 0xd00046ee FORMAT "%7.3" /end MEASUREMENT
/begin MEASUREMENT Vxx_knk_slow_cor_max_iga_NVM "Maximum ignition timing correction of the slow loop for all the cylinders" UBYTE _CNV_A_R_LINEAR_____25_CM 1 0. 0. 95.625 DISPLAY_IDENTIFIER CbIgnLim_NVM.Vxx_knk_slow_cor_max_iga_NVM ECU_ADDRESS 0xd0004714 /end MEASUREMENT
/begin MEASUREMENT Vtd_knk_slow_cor_iga_cyl[0] "Knock correction low bukle (4 composants vector)" UBYTE _CNV_A_R_LINEAR_____25_CM 1 0. 0. 95.625 DISPLAY_IDENTIFIER CbIgnLim_NVM.Vtd_knk_slow_cor_iga_cyl_NVM[0] ECU_ADDRESS 0xd0004716 /end MEASUREMENT
/begin MEASUREMENT Vtd_knk_slow_cor_iga_cyl[1] "Knock correction low bukle (4 composants vector)" UBYTE _CNV_A_R_LINEAR_____25_CM 1 0. 0. 95.625 DISPLAY_IDENTIFIER CbIgnLim_NVM.Vtd_knk_slow_cor_iga_cyl_NVM[1] ECU_ADDRESS 0xd0004717 /end MEASUREMENT
/begin MEASUREMENT Vtd_knk_slow_cor_iga_cyl[2] "Knock correction low bukle (4 composants vector)" UBYTE _CNV_A_R_LINEAR_____25_CM 1 0. 0. 95.625 DISPLAY_IDENTIFIER CbIgnLim_NVM.Vtd_knk_slow_cor_iga_cyl_NVM[2] ECU_ADDRESS 0xd0004718 /end MEASUREMENT
/begin MEASUREMENT Vtd_knk_slow_cor_iga_cyl[3] "Knock correction low bukle (4 composants vector)" UBYTE _CNV_A_R_LINEAR_____25_CM 1 0. 0. 95.625 DISPLAY_IDENTIFIER CbIgnLim_NVM.Vtd_knk_slow_cor_iga_cyl_NVM[3] ECU_ADDRESS 0xd0004719 /end MEASUREMENT
/begin AXIS_PTS Ctb_sta_n "Engine speed breakpoints for starting set point tables" 0xa002b17c Vxx_n _REC_A2AXS_20_u2 16383.75 _CNV_A_R_ENSD_LINEA_24_CM 8 0. 16383.75 FORMAT "%8.2" /end AXIS_PTS
/begin AXIS_PTS Ctb_eng_amp "atmospheric pressure breakpoint of full load torque limitation." 0xa00294c4 Vxx_amp _REC_A2AXS_20_u2 20000. _CNV_A_R_LINEAR_____57_CM 6 0. 20000. FORMAT "%5.0" /end AXIS_PTS
/begin AXIS_PTS Ctb_ovh_tco "Coolant temperature breakpoints map for over heating" 0xa0026a20 Vxx_tco _REC_A2AXS_20_u2 240. _CNV_A_R_LINEAR_____54_CM 6 -40. 200. FORMAT "%5.1" /end AXIS_PTS
/begin AXIS_PTS Ctb_ovh_toil "Oil temperature breakpoints map for over heating" 0xa0026a30 Vxx_toil _REC_A2AXS_20_u2 240. _CNV_A_R_LINEAR_____54_CM 6 -40. 200. FORMAT "%5.1" /end AXIS_PTS
/begin AXIS_PTS Ctb_ovh_up_it_temp "Manifold air temperature breakpoints map for over heating" 0xa0026a40 Vxx_up_it_temp _REC_A2AXS_20_u2 240. _CNV_A_R_LINEAR_____54_CM 6 -40. 200. FORMAT "%5.1" /end AXIS_PTS
/begin MEASUREMENT cppwm "PWM for the canister purge valve mass air flow" UBYTE _CNV_A_R_LINEAR_____232_CM 1 0. 0. 99.609375 ECU_ADDRESS 0xd0005ad8 FORMAT "%9.6" /end MEASUREMENT
/begin MEASUREMENT frq_req_cp "Frequency command of the canister purge" UBYTE _CNV_A_R_LINEAR_____231_CM 1 0. 0. 255. ECU_ADDRESS 0xd00055f7 FORMAT "%3.0" /end MEASUREMENT
/begin MEASUREMENT lv_rly_fpmp_position "Fuel pomp relay control command state (0 = relay shall be switched off, 1 = relay shall be switched on)" UBYTE _CNV_S_2_RANGE______3_CM 1 0. 0. 1. ECU_ADDRESS 0xd000142b BIT_MASK 0x1 /end MEASUREMENT
/begin AXIS_PTS Ctb_n "20 programmable engine speed breakpoints map" 0xa00250e0 Vxx_n _REC_A2AXS_20_u2 16383.75 _CNV_A_R_ENSD_LINEA_24_CM 20 0. 16383.75 FORMAT "%8.2" /end AXIS_PTS
/begin MEASUREMENT Vbx_eng_off_mdf1_on "Mdf1 sate saved(engine stop) in EEPROM" UBYTE _CNV_S_2_RANGE______3_CM 1 0. 0. 1. ECU_ADDRESS 0xd0005061 BIT_MASK 0x1 /end MEASUREMENT
/begin MEASUREMENT Vbx_mdf1_comb_mod_req "combustion mode fan 1 request" UBYTE _CNV_S_2_RANGE______3_CM 1 0. 0. 1. ECU_ADDRESS 0xd000526e BIT_MASK 0x1 /end MEASUREMENT
/begin MEASUREMENT Vbx_mdf2_comb_mod_req "combustion mode fan 2 request" UBYTE _CNV_S_2_RANGE______3_CM 1 0. 0. 1. ECU_ADDRESS 0xd000526f BIT_MASK 0x1 /end MEASUREMENT
/begin AXIS_PTS Ctb_is_cata_wup_ctr "Breakpoints use for catalyst warm-up sequences without cold start conditions" 0xa002331c Vxx_cata_wup_ctr _REC_A2AXS_20_u2 65535. _CNV_A_R_LINEAR_____55_CM 17 0. 65535. FORMAT "%5.0" /end AXIS_PTS
/begin AXIS_PTS Ntb_gear "Gearbox ratio breakpoint" 0xa002ac48 Vxx_gear _REC_A2AXS_20_u1 7. _CNV_A_R_LINEAR_____113_CM 8 -1. 6. READ_ONLY FORMAT "%2.0" /end AXIS_PTS
/begin COMPU_METHOD _CNV_A_R_ECME_LINEA_0_CM "" RAT_FUNC "%6.3" "-" COEFFS 0 1. 0. 0 0 1 /end COMPU_METHOD
/begin COMPU_METHOD _CNV_S_2_RANGE______3_CM "" TAB_VERB "%6.3" "-" COMPU_TAB_REF _CNV_S_2_RANGE______3 /end COMPU_METHOD
/begin COMPU_VTAB _CNV_S_2_RANGE______3 "" TAB_VERB 2 0 "0" 1 "1" /end COMPU_VTAB
/begin COMPU_METHOD _CNV_A_R_LINEAR_____23_CM "" RAT_FUNC "%6.3" "rpm/s" COEFFS 0 1. 0. 0 0 1 /end COMPU_METHOD
/begin COMPU_METHOD _CNV_A_R_ENSD_LINEA_24_CM "" RAT_FUNC "%6.3" "rpm" COEFFS 0 4. 0. 0 0 1 /end COMPU_METHOD
/begin COMPU_METHOD _CNV_A_R_LINEAR_____25_CM "" RAT_FUNC "%6.3" "∞CRK" COEFFS 0 2.666666666666667 0. 0 0 1 /end COMPU_METHOD
/begin COMPU_METHOD _CNV_A_R_LINEAR_____31_CM "" RAT_FUNC "%6.3" "-" COEFFS 0 256. 0. 0 0 1 /end COMPU_METHOD
/begin COMPU_METHOD _CNV_A_R_LINEAR_____34_CM "" RAT_FUNC "%6.3" "s" COEFFS 0 100. 0. 0 0 1 /end COMPU_METHOD
/begin COMPU_METHOD _CNV_A_R_LINEAR_____43_CM "" RAT_FUNC "%6.3" "-" COEFFS 0 128. 0. 0 0 1 /end COMPU_METHOD
/begin COMPU_METHOD _CNV_A_R_IGRE_LINEA_48_CM "" RAT_FUNC "%6.3" "∞CRK" COEFFS 0 2.666666666666667 63. 0 0 1 /end COMPU_METHOD
/begin COMPU_METHOD _CNV_A_R_LINEAR_____49_CM "" RAT_FUNC "%6.3" "-" COEFFS 0 32767.99999999992 0. 0 0 1 /end COMPU_METHOD
/begin COMPU_METHOD _CNV_A_R_LINEAR_____52_CM "" RAT_FUNC "%6.3" "mV" COEFFS 0 1. 0. 0 0 1 /end COMPU_METHOD
/begin COMPU_METHOD _CNV_A_R_LINEAR_____53_CM "" RAT_FUNC "%6.3" "-" COEFFS 0 16384. 0. 0 0 1 /end COMPU_METHOD
/begin COMPU_METHOD _CNV_A_R_LINEAR_____54_CM "" RAT_FUNC "%6.3" "∞C" COEFFS 0 10. 400. 0 0 1 /end COMPU_METHOD
/begin COMPU_METHOD _CNV_A_R_LINEAR_____55_CM "" RAT_FUNC "%6.3" "TDC" COEFFS 0 1. 0. 0 0 1 /end COMPU_METHOD
/begin COMPU_METHOD _CNV_A_R_LINEAR_____57_CM "" RAT_FUNC "%6.3" "hPa" COEFFS 0 1. 0. 0 0 1 /end COMPU_METHOD
/begin COMPU_METHOD _CNV_A_R_LINEAR_____58_CM "" RAT_FUNC "%6.3" "s" COEFFS 0 1000. 0. 0 0 1 /end COMPU_METHOD
/begin COMPU_METHOD _CNV_A_R_LINEAR_____82_CM "" RAT_FUNC "%6.3" "s" COEFFS 0 1. 0. 0 0 1 /end COMPU_METHOD
/begin COMPU_METHOD _CNV_A_R_LINEAR_____107_CM "" RAT_FUNC "%6.3" "hPa" COEFFS 0 1. 10000. 0 0 1 /end COMPU_METHOD
/begin COMPU_METHOD _CNV_A_R_LINEAR_____109_CM "" RAT_FUNC "%6.3" "kg/h" COEFFS 0 20. 0. 0 0 1 /end COMPU_METHOD
/begin COMPU_METHOD _CNV_A_R_LINEAR_____113_CM "" RAT_FUNC "%6.3" "-" COEFFS 0 1. 1. 0 0 1 /end COMPU_METHOD
/begin COMPU_METHOD _CNV_A_R_LINEAR_____114_CM "" RAT_FUNC "%6.3" "%" COEFFS 0 2.55 0. 0 0 1 /end COMPU_METHOD
/begin COMPU_METHOD _CNV_S_3_STATUS_OK__120_CM "" TAB_VERB "%6.3" "-" COMPU_TAB_REF _CNV_S_3_STATUS_OK__120 /end COMPU_METHOD
/begin COMPU_VTAB _CNV_S_3_STATUS_OK__120 "" TAB_VERB 3 0 "Nsx_vld_nok_0" 1 "Nsx_vld_ok_1" 2 "Nsx_vld_fail_2" /end COMPU_VTAB
/begin COMPU_METHOD _CNV_A_R_LINEAR_____123_CM "" RAT_FUNC "%6.3" "Nm" COEFFS 0 32. 0. 0 0 1 /end COMPU_METHOD
/begin COMPU_METHOD _CNV_A_R_LINEAR_____125_CM "" RAT_FUNC "%6.3" "-" COEFFS 0 1024. 0. 0 0 1 /end COMPU_METHOD
/begin COMPU_METHOD _CNV_A_R_LINEAR_____128_CM "" RAT_FUNC "%6.3" "W" COEFFS 0 0.1 0. 0 0 1 /end COMPU_METHOD
/begin COMPU_METHOD _CNV_A_R_LINEAR_____136_CM "" RAT_FUNC "%6.3" "-" COEFFS 0 100. 0. 0 0 1 /end COMPU_METHOD
/begin COMPU_METHOD _CNV_A_R_LINEAR_____144_CM "" RAT_FUNC "%6.3" "ms" COEFFS 0 1. 0. 0 0 1 /end COMPU_METHOD
/begin COMPU_METHOD _CNV_A_R_LINEAR_____150_CM "" RAT_FUNC "%6.3" "V" COEFFS 0 100. 0. 0 0 1 /end COMPU_METHOD
/begin COMPU_METHOD _CNV_S_16_RANGE_ERR__151_CM "" TAB_VERB "%6.3" "" COMPU_TAB_REF _CNV_S_16_RANGE_ERR__151 /end COMPU_METHOD
/begin COMPU_VTAB _CNV_S_16_RANGE_ERR__151 "" TAB_VERB 16 0 "NO_SYM" 1 "SYM_0" 2 "SYM_1" 3 "SYM_0, SYM_1" 4 "SYM_2" 5 "SYM_0, SYM_2" 6 "SYM_1, SYM_2" 7 "SYM_0, SYM_1, SYM_2" 8 "SYM_3" 9 "SYM_0, SYM_3" 10 "SYM_1, SYM_3" 11 "SYM_0, SYM_1,SYM_3" 12 "SYM_2, SYM_3" 13 "SYM_0, SYM_2, SYM_3" 14 "SYM_1, SYM_2, SYM_3" 15 "SYM_0, SYM_1, SYM_2, SYM_3" /end COMPU_VTAB
/begin COMPU_METHOD _CNV_A_R_LINEAR_____161_CM "" RAT_FUNC "%6.3" "Nm" COEFFS 0 32. 12800. 0 0 1 /end COMPU_METHOD
/begin COMPU_METHOD _CNV_A_R_LINEAR_____168_CM "" RAT_FUNC "%6.3" "-" COEFFS 0 32768000.00000008 0. 0 0 1 /end COMPU_METHOD
/begin COMPU_METHOD _CNV_A_R_LINEAR_____187_CM "" RAT_FUNC "%6.3" "-" COEFFS 0 128. 128. 0 0 1 /end COMPU_METHOD
/begin COMPU_METHOD _CNV_A_R_LINEAR_____212_CM "" RAT_FUNC "%6.3" "km/h" COEFFS 0 1. 0. 0 0 1 /end COMPU_METHOD
/begin COMPU_METHOD _CNV_S_2_STATUS_OK__214_CM "" TAB_VERB "%6.3" "-" COMPU_TAB_REF _CNV_S_2_STATUS_OK__214 /end COMPU_METHOD
/begin COMPU_VTAB _CNV_S_2_STATUS_OK__214 "" TAB_VERB 2 0 "Nsx_vld_nok_0" 1 "Nsx_vld_ok_1" /end COMPU_VTAB
/begin COMPU_METHOD _CNV_S_2_RANGE______217_CM "" TAB_VERB "%6.3" "-" COMPU_TAB_REF _CNV_S_2_RANGE______217 /end COMPU_METHOD
/begin COMPU_VTAB _CNV_S_2_RANGE______217 "" TAB_VERB 2 0 "COMPLETE" 1 "NO_COMPLETE" /end COMPU_VTAB
/begin COMPU_METHOD _CNV_A_R_LINEAR_____218_CM "" RAT_FUNC "%6.3" "km" COEFFS 0 1. 0. 0 0 1 /end COMPU_METHOD
/begin COMPU_METHOD _CNV_A_R_LINEAR_____219_CM "" RAT_FUNC "%6.3" "kPa" COEFFS 0 1. 0. 0 0 1 /end COMPU_METHOD
/begin COMPU_METHOD _CNV_A_R_LINEAR_____220_CM "" RAT_FUNC "%6.3" "∞C" COEFFS 0 1. 40. 0 0 1 /end COMPU_METHOD
/begin COMPU_METHOD _CNV_A_R_LINEAR_____221_CM "" RAT_FUNC "%6.3" "%" COEFFS 0 1.28 128. 0 0 1 /end COMPU_METHOD
/begin COMPU_METHOD _CNV_A_R_LINEAR_____222_CM "" RAT_FUNC "%6.3" "g/s" COEFFS 0 100. 0. 0 0 1 /end COMPU_METHOD
/begin COMPU_METHOD _CNV_A_R_LINEAR_____223_CM "" RAT_FUNC "%6.3" "kPa" COEFFS 0 0.1 0. 0 0 1 /end COMPU_METHOD
/begin COMPU_METHOD _CNV_A_R_LINEAR_____224_CM "" RAT_FUNC "%6.3" "Pa" COEFFS 0 4. 0. 0 0 1 /end COMPU_METHOD
/begin COMPU_METHOD _CNV_A_R_LINEAR_____227_CM "" RAT_FUNC "%6.3" "-" COEFFS 0 256. -1. 0 0 1 /end COMPU_METHOD
/begin COMPU_METHOD _CNV_A_R_LINEAR_____228_CM "" RAT_FUNC "%6.3" "-" COEFFS 0 1024. 32768. 0 0 1 /end COMPU_METHOD
/begin COMPU_METHOD _CNV_A_R_LINEAR_____231_CM "" RAT_FUNC "%6.3" "Hz" COEFFS 0 1. 0. 0 0 1 /end COMPU_METHOD
/begin COMPU_METHOD _CNV_A_R_LINEAR_____232_CM "" RAT_FUNC "%6.3" "%" COEFFS 0 2.56 0. 0 0 1 /end COMPU_METHOD
/begin COMPU_METHOD _CNV_A_R_LINEAR_____233_CM "" RAT_FUNC "%6.3" "Nms" COEFFS 0 32. 0. 0 0 1 /end COMPU_METHOD
/begin COMPU_METHOD _CNV_A_R_LINEAR_____234_CM "" RAT_FUNC "%6.3" "Nm/s" COEFFS 0 -1. 0. 0 0 1 /end COMPU_METHOD
/begin COMPU_METHOD _CNV_A_R_LINEAR_____235_CM "" RAT_FUNC "%6.3" "Nm/s" COEFFS 0 1. 0. 0 0 1 /end COMPU_METHOD
/begin COMPU_METHOD _CNV_A_R_LINEAR_____236_CM "" RAT_FUNC "%6.3" "-" COEFFS 0 25.6 0. 0 0 1 /end COMPU_METHOD
/begin COMPU_METHOD _CNV_A_R_LINEAR_____237_CM "" RAT_FUNC "%6.3" "V" COEFFS 0 2732.24043715847 0. 0 0 1 /end COMPU_METHOD
/begin COMPU_METHOD _CNV_A_R_LINEAR_____238_CM "" RAT_FUNC "%6.3" "∞CRK2" COEFFS 0 7.111111111111111 0. 0 0 1 /end COMPU_METHOD
/begin COMPU_METHOD _CNV_A_R_LINEAR_____239_CM "" RAT_FUNC "%6.3" "1/s" COEFFS 0 10.24 0. 0 0 1 /end COMPU_METHOD
/begin COMPU_METHOD _CNV_A_R_LINEAR_____240_CM "" RAT_FUNC "%6.3" "-" COEFFS 0 512. -257. 0 0 1 /end COMPU_METHOD
/begin COMPU_METHOD _CNV_A_R_LINEAR_____241_CM "" RAT_FUNC "%6.3" "Nm/kg" COEFFS 0 0.125 0. 0 0 1 /end COMPU_METHOD
/begin COMPU_METHOD _CNV_A_R_LINEAR_____242_CM "" RAT_FUNC "%6.3" "-" COEFFS 0 12.8 0. 0 0 1 /end COMPU_METHOD
/begin COMPU_METHOD _CNV_A_R_LINEAR_____243_CM "" RAT_FUNC "%6.3" "[1/s]" COEFFS 0 10.24 0. 0 0 1 /end COMPU_METHOD
/begin COMPU_METHOD _CNV_A_R_LINEAR_____244_CM "" RAT_FUNC "%6.3" "1/s" COEFFS 0 4. 0. 0 0 1 /end COMPU_METHOD
/begin COMPU_METHOD _CNV_A_R_LINEAR_____245_CM "" RAT_FUNC "%6.3" "1/s" COEFFS 0 4. 200. 0 0 1 /end COMPU_METHOD
/begin RECORD_LAYOUT _REC_S1VAL_20_u1 FNC_VALUES 1 UBYTE COLUMN_DIR DIRECT /end RECORD_LAYOUT
/begin RECORD_LAYOUT _REC_A2AXS_20_u1 NO_AXIS_PTS_X 1 UBYTE AXIS_PTS_X 2 UBYTE INDEX_INCR DIRECT /end RECORD_LAYOUT
/begin RECORD_LAYOUT _REC_S1VAL_20_u2 FNC_VALUES 1 UWORD COLUMN_DIR DIRECT /end RECORD_LAYOUT
/begin RECORD_LAYOUT _REC_S1VAL_20_s2 FNC_VALUES 1 SWORD COLUMN_DIR DIRECT /end RECORD_LAYOUT
/begin RECORD_LAYOUT _REC_A2AXS_20_u2 NO_AXIS_PTS_X 1 UWORD AXIS_PTS_X 2 UWORD INDEX_INCR DIRECT /end RECORD_LAYOUT
/begin RECORD_LAYOUT _REC_A1CUR_20_u1_u2 FNC_VALUES 1 UBYTE COLUMN_DIR DIRECT /end RECORD_LAYOUT
/begin RECORD_LAYOUT _REC_A1CUR_20_u2_u1 FNC_VALUES 1 UWORD COLUMN_DIR DIRECT /end RECORD_LAYOUT
/begin RECORD_LAYOUT _REC_A1MAP_20_u2_u2_u2 FNC_VALUES 1 UWORD COLUMN_DIR DIRECT /end RECORD_LAYOUT
/begin RECORD_LAYOUT _REC_A1CUR_20_u2_u2 FNC_VALUES 1 UWORD COLUMN_DIR DIRECT /end RECORD_LAYOUT
/begin RECORD_LAYOUT _REC_A1MAP_20_u1_u2_u2 FNC_VALUES 1 UBYTE COLUMN_DIR DIRECT /end RECORD_LAYOUT
/begin RECORD_LAYOUT _REC_A1MAP_20_u2_u2_u1 FNC_VALUES 1 UWORD COLUMN_DIR DIRECT /end RECORD_LAYOUT
/begin FUNCTION DgDftMng_Obdfram ""
 /begin DEF_CHARACTERISTIC Cbx_obd_off_cfm Cxx_dtc_lb_cata Cxx_dtc_lb_fsys Cxx_dtc_msb_fsys /end DEF_CHARACTERISTIC
 /begin OUT_MEASUREMENT Stx_frm_pool[0].Vxx_rtn_n01 Stx_frm_pool[0].Vxx_obd_fail_code Stx_frm_pool[0].Vxx_rtn_eal Stx_frm_pool[0].Vxx_rtn_vs Stx_frm_pool[0].Vxx_rtn_map Stx_frm_pool[0].Vxx_rtn_frm_tco Stx_frm_pool[0].Vxx_rtn_mv_ad_fac Stx_frm_pool[0].Vxx_rtn_rich_loop_ti_fac Stx_frm_pool[0].Vbx_rtn_clos_o2_phs Stx_frm_pool[0].Vxx_rtn_mat Stx_frm_pool[0].Vxx_rtn_clr_dist Stx_frm_pool[0].Vxx_ind_xxx Stx_frm_pool[0].Vxx_rtn_maf Stx_frm_pool[0].Vxx_rtn_rail_prs Stx_frm_pool[0].Vxx_rtn_tia Stx_frm_pool[0].Vxx_dgdftmng_priority Stx_frm_pool[0].Vxx_rtn_rvac Stx_frm_pool[1].Vxx_rtn_n01 Stx_frm_pool[1].Vxx_obd_fail_code Stx_frm_pool[1].Vxx_rtn_eal Stx_frm_pool[1].Vxx_rtn_vs Stx_frm_pool[1].Vxx_rtn_map Stx_frm_pool[1].Vxx_rtn_frm_tco Stx_frm_pool[1].Vxx_rtn_mv_ad_fac Stx_frm_pool[1].Vxx_rtn_rich_loop_ti_fac Stx_frm_pool[1].Vbx_rtn_clos_o2_phs Stx_frm_pool[1].Vxx_rtn_mat Stx_frm_pool[1].Vxx_rtn_clr_dist Stx_frm_pool[1].Vxx_ind_xxx Stx_frm_pool[1].Vxx_rtn_maf Stx_frm_pool[1].Vxx_rtn_rail_prs Stx_frm_pool[1].Vxx_rtn_tia Stx_frm_pool[1].Vxx_dgdftmng_priority Stx_frm_pool[1].Vxx_rtn_rvac Stx_frm_pool[2].Vxx_rtn_n01 Stx_frm_pool[2].Vxx_obd_fail_code Stx_frm_pool[2].Vxx_rtn_eal Stx_frm_pool[2].Vxx_rtn_vs Stx_frm_pool[2].Vxx_rtn_map Stx_frm_pool[2].Vxx_rtn_frm_tco Stx_frm_pool[2].Vxx_rtn_mv_ad_fac Stx_frm_pool[2].Vxx_rtn_rich_loop_ti_fac Stx_frm_pool[2].Vbx_rtn_clos_o2_phs Stx_frm_pool[2].Vxx_rtn_mat Stx_frm_pool[2].Vxx_rtn_clr_dist Stx_frm_pool[2].Vxx_ind_xxx Stx_frm_pool[2].Vxx_rtn_maf Stx_frm_pool[2].Vxx_rtn_rail_prs Stx_frm_pool[2].Vxx_rtn_tia Stx_frm_pool[2].Vxx_dgdftmng_priority Stx_frm_pool[2].Vxx_rtn_rvac Stx_frm_pool[3].Vxx_rtn_n01 Stx_frm_pool[3].Vxx_obd_fail_code Stx_frm_pool[3].Vxx_rtn_eal Stx_frm_pool[3].Vxx_rtn_vs Stx_frm_pool[3].Vxx_rtn_map Stx_frm_pool[3].Vxx_rtn_frm_tco Stx_frm_pool[3].Vxx_rtn_mv_ad_fac Stx_frm_pool[3].Vxx_rtn_rich_loop_ti_fac Stx_frm_pool[3].Vbx_rtn_clos_o2_phs Stx_frm_pool[3].Vxx_rtn_mat Stx_frm_pool[3].Vxx_rtn_clr_dist Stx_frm_pool[3].Vxx_ind_xxx Stx_frm_pool[3].Vxx_rtn_maf Stx_frm_pool[3].Vxx_rtn_rail_prs Stx_frm_pool[3].Vxx_rtn_tia Stx_frm_pool[3].Vxx_dgdftmng_priority Stx_frm_pool[3].Vxx_rtn_rvac Stx_frm_pool[4].Vxx_rtn_n01 Stx_frm_pool[4].Vxx_obd_fail_code Stx_frm_pool[4].Vxx_rtn_eal Stx_frm_pool[4].Vxx_rtn_vs Stx_frm_pool[4].Vxx_rtn_map Stx_frm_pool[4].Vxx_rtn_frm_tco Stx_frm_pool[4].Vxx_rtn_mv_ad_fac Stx_frm_pool[4].Vxx_rtn_rich_loop_ti_fac Stx_frm_pool[4].Vbx_rtn_clos_o2_phs Stx_frm_pool[4].Vxx_rtn_mat Stx_frm_pool[4].Vxx_rtn_clr_dist Stx_frm_pool[4].Vxx_ind_xxx Stx_frm_pool[4].Vxx_rtn_maf Stx_frm_pool[4].Vxx_rtn_rail_prs Stx_frm_pool[4].Vxx_rtn_tia Stx_frm_pool[4].Vxx_dgdftmng_priority Stx_frm_pool[4].Vxx_rtn_rvac Stx_frm_pool[5].Vxx_rtn_n01 Stx_frm_pool[5].Vxx_obd_fail_code Stx_frm_pool[5].Vxx_rtn_eal Stx_frm_pool[5].Vxx_rtn_vs Stx_frm_pool[5].Vxx_rtn_map Stx_frm_pool[5].Vxx_rtn_frm_tco Stx_frm_pool[5].Vxx_rtn_mv_ad_fac Stx_frm_pool[5].Vxx_rtn_rich_loop_ti_fac Stx_frm_pool[5].Vbx_rtn_clos_o2_phs Stx_frm_pool[5].Vxx_rtn_mat Stx_frm_pool[5].Vxx_rtn_clr_dist Stx_frm_pool[5].Vxx_ind_xxx Stx_frm_pool[5].Vxx_rtn_maf Stx_frm_pool[5].Vxx_rtn_rail_prs Stx_frm_pool[5].Vxx_rtn_tia Stx_frm_pool[5].Vxx_dgdftmng_priority Stx_frm_pool[5].Vxx_rtn_rvac Stx_frm_pool[6].Vxx_rtn_n01 Stx_frm_pool[6].Vxx_obd_fail_code Stx_frm_pool[6].Vxx_rtn_eal Stx_frm_pool[6].Vxx_rtn_vs Stx_frm_pool[6].Vxx_rtn_map Stx_frm_pool[6].Vxx_rtn_frm_tco Stx_frm_pool[6].Vxx_rtn_mv_ad_fac Stx_frm_pool[6].Vxx_rtn_rich_loop_ti_fac Stx_frm_pool[6].Vbx_rtn_clos_o2_phs Stx_frm_pool[6].Vxx_rtn_mat Stx_frm_pool[6].Vxx_rtn_clr_dist Stx_frm_pool[6].Vxx_ind_xxx Stx_frm_pool[6].Vxx_rtn_maf Stx_frm_pool[6].Vxx_rtn_rail_prs Stx_frm_pool[6].Vxx_rtn_tia Stx_frm_pool[6].Vxx_dgdftmng_priority Stx_frm_pool[6].Vxx_rtn_rvac Stx_frm_pool[7].Vxx_rtn_n01 Stx_frm_pool[7].Vxx_obd_fail_code Stx_frm_pool[7].Vxx_rtn_eal Stx_frm_pool[7].Vxx_rtn_vs Stx_frm_pool[7].Vxx_rtn_map Stx_frm_pool[7].Vxx_rtn_frm_tco Stx_frm_pool[7].Vxx_rtn_mv_ad_fac Stx_frm_pool[7].Vxx_rtn_rich_loop_ti_fac Stx_frm_pool[7].Vbx_rtn_clos_o2_phs Stx_frm_pool[7].Vxx_rtn_mat Stx_frm_pool[7].Vxx_rtn_clr_dist Stx_frm_pool[7].Vxx_ind_xxx Stx_frm_pool[7].Vxx_rtn_maf Stx_frm_pool[7].Vxx_rtn_rail_prs Stx_frm_pool[7].Vxx_rtn_tia Stx_frm_pool[7].Vxx_dgdftmng_priority Stx_frm_pool[7].Vxx_rtn_rvac Stx_frm_pool[8].Vxx_rtn_n01 Stx_frm_pool[8].Vxx_obd_fail_code Stx_frm_pool[8].Vxx_rtn_eal Stx_frm_pool[8].Vxx_rtn_vs Stx_frm_pool[8].Vxx_rtn_map Stx_frm_pool[8].Vxx_rtn_frm_tco Stx_frm_pool[8].Vxx_rtn_mv_ad_fac Stx_frm_pool[8].Vxx_rtn_rich_loop_ti_fac Stx_frm_pool[8].Vbx_rtn_clos_o2_phs Stx_frm_pool[8].Vxx_rtn_mat Stx_frm_pool[8].Vxx_rtn_clr_dist Stx_frm_pool[8].Vxx_ind_xxx Stx_frm_pool[8].Vxx_rtn_maf Stx_frm_pool[8].Vxx_rtn_rail_prs Stx_frm_pool[8].Vxx_rtn_tia Stx_frm_pool[8].Vxx_dgdftmng_priority Stx_frm_pool[8].Vxx_rtn_rvac Stx_frm_pool[9].Vxx_rtn_n01 Stx_frm_pool[9].Vxx_obd_fail_code Stx_frm_pool[9].Vxx_rtn_eal Stx_frm_pool[9].Vxx_rtn_vs Stx_frm_pool[9].Vxx_rtn_map Stx_frm_pool[9].Vxx_rtn_frm_tco Stx_frm_pool[9].Vxx_rtn_mv_ad_fac Stx_frm_pool[9].Vxx_rtn_rich_loop_ti_fac Stx_frm_pool[9].Vbx_rtn_clos_o2_phs Stx_frm_pool[9].Vxx_rtn_mat Stx_frm_pool[9].Vxx_rtn_clr_dist Stx_frm_pool[9].Vxx_ind_xxx Stx_frm_pool[9].Vxx_rtn_maf Stx_frm_pool[9].Vxx_rtn_rail_prs Stx_frm_pool[9].Vxx_rtn_tia Stx_frm_pool[9].Vxx_dgdftmng_priority Stx_frm_pool[9].Vxx_rtn_rvac Vtx_frm[0].Vxx_rtn_n01 Vtx_frm[0].Vxx_obd_fail_code Vtx_frm[0].Vxx_rtn_eal Vtx_frm[0].Vxx_rtn_vs Vtx_frm[0].Vxx_rtn_map Vtx_frm[0].Vxx_rtn_frm_tco Vtx_frm[0].Vxx_rtn_mv_ad_fac Vtx_frm[0].Vxx_rtn_rich_loop_ti_fac Vtx_frm[0].Vbx_rtn_clos_o2_phs Vtx_frm[0].Vxx_rtn_mat Vtx_frm[0].Vxx_rtn_clr_dist Vtx_frm[0].Vxx_ind_xxx Vtx_frm[0].Vxx_rtn_maf Vtx_frm[0].Vxx_rtn_rail_prs Vtx_frm[0].Vxx_rtn_tia Vtx_frm[0].Vxx_dgdftmng_priority Vtx_frm[0].Vxx_rtn_rvac Vtx_frm[1].Vxx_rtn_n01 Vtx_frm[1].Vxx_obd_fail_code Vtx_frm[1].Vxx_rtn_eal Vtx_frm[1].Vxx_rtn_vs Vtx_frm[1].Vxx_rtn_map Vtx_frm[1].Vxx_rtn_frm_tco Vtx_frm[1].Vxx_rtn_mv_ad_fac Vtx_frm[1].Vxx_rtn_rich_loop_ti_fac Vtx_frm[1].Vbx_rtn_clos_o2_phs Vtx_frm[1].Vxx_rtn_mat Vtx_frm[1].Vxx_rtn_clr_dist Vtx_frm[1].Vxx_ind_xxx Vtx_frm[1].Vxx_rtn_maf Vtx_frm[1].Vxx_rtn_rail_prs Vtx_frm[1].Vxx_rtn_tia Vtx_frm[1].Vxx_dgdftmng_priority Vtx_frm[1].Vxx_rtn_rvac Vtx_frm[2].Vxx_rtn_n01 Vtx_frm[2].Vxx_obd_fail_code Vtx_frm[2].Vxx_rtn_eal Vtx_frm[2].Vxx_rtn_vs Vtx_frm[2].Vxx_rtn_map Vtx_frm[2].Vxx_rtn_frm_tco Vtx_frm[2].Vxx_rtn_mv_ad_fac Vtx_frm[2].Vxx_rtn_rich_loop_ti_fac Vtx_frm[2].Vbx_rtn_clos_o2_phs Vtx_frm[2].Vxx_rtn_mat Vtx_frm[2].Vxx_rtn_clr_dist Vtx_frm[2].Vxx_ind_xxx Vtx_frm[2].Vxx_rtn_maf Vtx_frm[2].Vxx_rtn_rail_prs Vtx_frm[2].Vxx_rtn_tia Vtx_frm[2].Vxx_dgdftmng_priority Vtx_frm[2].Vxx_rtn_rvac Vtx_frm[3].Vxx_rtn_n01 Vtx_frm[3].Vxx_obd_fail_code Vtx_frm[3].Vxx_rtn_eal Vtx_frm[3].Vxx_rtn_vs Vtx_frm[3].Vxx_rtn_map Vtx_frm[3].Vxx_rtn_frm_tco Vtx_frm[3].Vxx_rtn_mv_ad_fac Vtx_frm[3].Vxx_rtn_rich_loop_ti_fac Vtx_frm[3].Vbx_rtn_clos_o2_phs Vtx_frm[3].Vxx_rtn_mat Vtx_frm[3].Vxx_rtn_clr_dist Vtx_frm[3].Vxx_ind_xxx Vtx_frm[3].Vxx_rtn_maf Vtx_frm[3].Vxx_rtn_rail_prs Vtx_frm[3].Vxx_rtn_tia Vtx_frm[3].Vxx_dgdftmng_priority Vtx_frm[3].Vxx_rtn_rvac Vtx_frm[4].Vxx_rtn_n01 Vtx_frm[4].Vxx_obd_fail_code Vtx_frm[4].Vxx_rtn_eal Vtx_frm[4].Vxx_rtn_vs Vtx_frm[4].Vxx_rtn_map Vtx_frm[4].Vxx_rtn_frm_tco Vtx_frm[4].Vxx_rtn_mv_ad_fac Vtx_frm[4].Vxx_rtn_rich_loop_ti_fac Vtx_frm[4].Vbx_rtn_clos_o2_phs Vtx_frm[4].Vxx_rtn_mat Vtx_frm[4].Vxx_rtn_clr_dist Vtx_frm[4].Vxx_ind_xxx Vtx_frm[4].Vxx_rtn_maf Vtx_frm[4].Vxx_rtn_rail_prs Vtx_frm[4].Vxx_rtn_tia Vtx_frm[4].Vxx_dgdftmng_priority Vtx_frm[4].Vxx_rtn_rvac Vtx_frm[5].Vxx_rtn_n01 Vtx_frm[5].Vxx_obd_fail_code Vtx_frm[5].Vxx_rtn_eal Vtx_frm[5].Vxx_rtn_vs Vtx_frm[5].Vxx_rtn_map Vtx_frm[5].Vxx_rtn_frm_tco Vtx_frm[5].Vxx_rtn_mv_ad_fac Vtx_frm[5].Vxx_rtn_rich_loop_ti_fac Vtx_frm[5].Vbx_rtn_clos_o2_phs Vtx_frm[5].Vxx_rtn_mat Vtx_frm[5].Vxx_rtn_clr_dist Vtx_frm[5].Vxx_ind_xxx Vtx_frm[5].Vxx_rtn_maf Vtx_frm[5].Vxx_rtn_rail_prs Vtx_frm[5].Vxx_rtn_tia Vtx_frm[5].Vxx_dgdftmng_priority Vtx_frm[5].Vxx_rtn_rvac Vtx_frm[6].Vxx_rtn_n01 Vtx_frm[6].Vxx_obd_fail_code Vtx_frm[6].Vxx_rtn_eal Vtx_frm[6].Vxx_rtn_vs Vtx_frm[6].Vxx_rtn_map Vtx_frm[6].Vxx_rtn_frm_tco Vtx_frm[6].Vxx_rtn_mv_ad_fac Vtx_frm[6].Vxx_rtn_rich_loop_ti_fac Vtx_frm[6].Vbx_rtn_clos_o2_phs Vtx_frm[6].Vxx_rtn_mat Vtx_frm[6].Vxx_rtn_clr_dist Vtx_frm[6].Vxx_ind_xxx Vtx_frm[6].Vxx_rtn_maf Vtx_frm[6].Vxx_rtn_rail_prs Vtx_frm[6].Vxx_rtn_tia Vtx_frm[6].Vxx_dgdftmng_priority Vtx_frm[6].Vxx_rtn_rvac Vtx_frm[7].Vxx_rtn_n01 Vtx_frm[7].Vxx_obd_fail_code Vtx_frm[7].Vxx_rtn_eal Vtx_frm[7].Vxx_rtn_vs Vtx_frm[7].Vxx_rtn_map Vtx_frm[7].Vxx_rtn_frm_tco Vtx_frm[7].Vxx_rtn_mv_ad_fac Vtx_frm[7].Vxx_rtn_rich_loop_ti_fac Vtx_frm[7].Vbx_rtn_clos_o2_phs Vtx_frm[7].Vxx_rtn_mat Vtx_frm[7].Vxx_rtn_clr_dist Vtx_frm[7].Vxx_ind_xxx Vtx_frm[7].Vxx_rtn_maf Vtx_frm[7].Vxx_rtn_rail_prs Vtx_frm[7].Vxx_rtn_tia Vtx_frm[7].Vxx_dgdftmng_priority Vtx_frm[7].Vxx_rtn_rvac Vtx_frm[8].Vxx_rtn_n01 Vtx_frm[8].Vxx_obd_fail_code Vtx_frm[8].Vxx_rtn_eal Vtx_frm[8].Vxx_rtn_vs Vtx_frm[8].Vxx_rtn_map Vtx_frm[8].Vxx_rtn_frm_tco Vtx_frm[8].Vxx_rtn_mv_ad_fac Vtx_frm[8].Vxx_rtn_rich_loop_ti_fac Vtx_frm[8].Vbx_rtn_clos_o2_phs Vtx_frm[8].Vxx_rtn_mat Vtx_frm[8].Vxx_rtn_clr_dist Vtx_frm[8].Vxx_ind_xxx Vtx_frm[8].Vxx_rtn_maf Vtx_frm[8].Vxx_rtn_rail_prs Vtx_frm[8].Vxx_rtn_tia Vtx_frm[8].Vxx_dgdftmng_priority Vtx_frm[8].Vxx_rtn_rvac Vtx_frm[9].Vxx_rtn_n01 Vtx_frm[9].Vxx_obd_fail_code Vtx_frm[9].Vxx_rtn_eal Vtx_frm[9].Vxx_rtn_vs Vtx_frm[9].Vxx_rtn_map Vtx_frm[9].Vxx_rtn_frm_tco Vtx_frm[9].Vxx_rtn_mv_ad_fac Vtx_frm[9].Vxx_rtn_rich_loop_ti_fac Vtx_frm[9].Vbx_rtn_clos_o2_phs Vtx_frm[9].Vxx_rtn_mat Vtx_frm[9].Vxx_rtn_clr_dist Vtx_frm[9].Vxx_ind_xxx Vtx_frm[9].Vxx_rtn_maf Vtx_frm[9].Vxx_rtn_rail_prs Vtx_frm[9].Vxx_rtn_tia Vtx_frm[9].Vxx_dgdftmng_priority Vtx_frm[9].Vxx_rtn_rvac Sxx_sel_frm Vbx_rtn_clos_o2_phs Vxx_obd_fail_code Vxx_rtn_clr_dist Vxx_rtn_eal Vxx_rtn_frm_tco Vxx_rtn_maf Vxx_rtn_map Vxx_rtn_mat Vxx_rtn_mv_ad_fac Vxx_rtn_n01 Vxx_rtn_rail_prs Vxx_rtn_rich_loop_ti_fac Vxx_rtn_rvac Vxx_rtn_tia Vxx_rtn_vs /end OUT_MEASUREMENT
/end FUNCTION
/begin FUNCTION DgDftMng_Rdnmgtx ""
 /begin OUT_MEASUREMENT Vbx_int_mfo_cata_cpt Vbx_int_mfo_lbup_cpt Vbx_obd_rdn_cata_cpt Vbx_obd_rdn_cpt Vbx_obd_rdn_fsys Vbx_obd_rdn_full Vbx_obd_rdn_lbup_cpt Vbx_obd_rdn_mis /end OUT_MEASUREMENT
/end FUNCTION
/begin FUNCTION DgDftMng_Obdenvx ""
 /begin DEF_CHARACTERISTIC Cxx_amp_obd_diag_ena_thd Cxx_mat_obd_diag_ena_thd Cxx_tco_obd_diag_ena_thd Cxx_vb_obd_diag_ena_thd /end DEF_CHARACTERISTIC
 /begin OUT_MEASUREMENT Vbx_amp_obd_diag_ena Vbx_min_fuel_obd_diag_ena Vbx_temp_obd_diag_ena Vbx_vb_obd_diag_ena /end OUT_MEASUREMENT
/end FUNCTION
/begin FUNCTION InAtiDli "" /begin SUB_FUNCTION InAtiDli_So2dwsr InAtiDli_Lbdwfil /end SUB_FUNCTION /end FUNCTION
/begin FUNCTION InAtiDli_So2dwsr ""
 /begin DEF_CHARACTERISTIC Cbx_lbdw_osp_conf Cxx_air_wht_fmt_fac Cxx_dfdec_inj_ecu_lbdw_icp Cxx_dfdec_lbdw_oc Cxx_dfdec_lbdw_scg Cxx_dfdec_lbdw_scw Cxx_dfinc_inj_ecu_lbdw_icp Cxx_dfinc_lbdw_oc Cxx_dfinc_lbdw_scg Cxx_dfinc_lbdw_scw Cxx_lbdw_hot_stt_t Cxx_lbdw_oc_air_wht Cxx_lbdw_oc_det_h_v Cxx_lbdw_osp_oc_det_h_v Cxx_lbdw_osp_oc_det_l_v Cxx_lbdw_osp_scg_det_v Cxx_lbdw_osp_scw_det_v Cxx_lbdw_pump_crt_t Cxx_lbdw_pump_crt_v_thd Cxx_lbdw_scg_det_v Cxx_lbdw_scw_det_v /end DEF_CHARACTERISTIC
 /begin OUT_MEASUREMENT Vbx_df_inj_ecu_lbdw_icp Vbx_df_lbdw_oc Vbx_df_lbdw_scg Vbx_df_lbdw_scw Vbx_diag_ena_inj_ecu_lbdw_icp Vbx_diag_ena_lbdw_oc Vbx_diag_ena_lbdw_scg Vbx_diag_ena_lbdw_scw Vbx_lbdw_diag_ena Vsx_lbdw_vld Vxx_cata_air_wht Vxx_lbdw_diag_ena Vxx_lbdw_pump_crt_t /end OUT_MEASUREMENT
/end FUNCTION
/begin FUNCTION InAtiDli_Lbdwfil "" /begin DEF_CHARACTERISTIC Cxx_lbdw_cata_fil_ftc Cxx_lbdw_h_lvl_fil_ftc /end DEF_CHARACTERISTIC
 /begin OUT_MEASUREMENT Vbx_stop_stal_eng Vbx_stop_stal_eng_not_1 Vbx_stop_stal_eng_not_2 Vxx_lbdw_cata_fil_val Vxx_lbdw_h_lvl_fil_val /end OUT_MEASUREMENT
/end FUNCTION
/begin FUNCTION BoCboUlo ""
 /begin OUT_MEASUREMENT Vbx_df_lbup_hot_oc Vbx_df_lbup_hot_scg Vbx_df_lbup_hot_scw Vbx_diag_ena_lbup_hot_oc Vbx_diag_ena_lbup_hot_scg Vbx_diag_ena_lbup_hot_scw cdn_diag_lsh_up err_diag_lsh_up /end OUT_MEASUREMENT
/end FUNCTION
/begin FUNCTION BoAtoDlo ""
 /begin OUT_MEASUREMENT Vbx_df_lbdw_hot_oc Vbx_df_lbdw_hot_scg Vbx_df_lbdw_hot_scw Vbx_diag_ena_lbdw_hot_oc Vbx_diag_ena_lbdw_hot_scg Vbx_diag_ena_lbdw_hot_scw cdn_diag_lsh_down err_diag_lsh_down /end OUT_MEASUREMENT
/end FUNCTION
/begin FUNCTION BoCboFuo ""
 /begin DEF_CHARACTERISTIC Cxx_cp_frq_1 Cxx_cp_frq_2 c_cppwm_diag_max_scg c_cppwm_diag_min_oc c_cppwm_diag_min_scp c_ctr_pulse_cps_dly /end DEF_CHARACTERISTIC
 /begin OUT_MEASUREMENT Vbx_df_cp_oc Vbx_df_cp_scg Vbx_df_cp_scw Vbx_df_gas_pump_oc Vbx_df_gas_pump_scg Vbx_df_gas_pump_scw Vbx_diag_ena_cp_oc Vbx_diag_ena_cp_scg Vbx_diag_ena_cp_scw Vbx_diag_ena_gas_pump_oc Vbx_diag_ena_gas_pump_scg Vbx_diag_ena_gas_pump_scw cdn_diag_el_cps cdn_diag_rly_fpmp_el ctr_pulse_cps_dly err_diag_el_cps err_diag_rly_fpmp_el lv_pulse_cps lv_pulse_cps_tmp cppwm frq_req_cp lv_rly_fpmp_position /end OUT_MEASUREMENT
/end FUNCTION
/begin FUNCTION ClCooCtl "" /begin OUT_MEASUREMENT Vbx_eng_off_mdf1_mem /end OUT_MEASUREMENT /begin SUB_FUNCTION ClCooCtl_Fanxxxx ClCooCtl_Fanmexx ClCooCtl_Fanrqbc /end SUB_FUNCTION /end FUNCTION
/begin FUNCTION ClCooCtl_Fanxxxx ""
 /begin DEF_CHARACTERISTIC Cbx_eng_stop_mdf_cho Cxx_ac_dsb_tco_thd Cxx_ac_dsb_tco_thd_h Cxx_ac_ena_tco_thd Cxx_ac_ena_tco_thd_h Cxx_cmd_mdf_dly Cxx_mdf1_cmd_ena_thd_tco_h Cxx_mdf1_off_tco_thd Cxx_mdf1_off_tco_thd_h Cxx_mdf1_on_tco_thd Cxx_mdf1_on_tco_thd_h Cxx_mdf1_on_tco_thd_hys Cxx_mdf1_on_tco_thd_hys_h Cxx_mdf2_off_tco_thd Cxx_mdf2_off_tco_thd_h Cxx_mdf2_on_tco_thd Cxx_mdf2_on_tco_thd_h Cxx_mdf_1_cmd_ena_thd_tco Cxx_mon_stop_tco_thd Cxx_mon_stop_tco_thd_h Cxx_run_mdf1_off_tco_thd Cxx_run_mdf1_off_tco_thd_h Cxx_tco_fail_cmd_mdf_dly Cxx_tco_mdf_dly /end DEF_CHARACTERISTIC
 /begin OUT_MEASUREMENT Vbx_eng_aut_fan Vbx_eng_mdf1 Vbx_eng_mdf1_dly Vbx_eng_mdf1_req Vbx_eng_mdf2 Vbx_eng_mdf2_req Vbx_eng_off_mdf1 Vbx_mdf1 Vbx_mdf2 Vbx_mdf_pws Vbx_tco_ac_dsb /end OUT_MEASUREMENT
/end FUNCTION
/begin FUNCTION ClCooCtl_Fanmexx "" /begin OUT_MEASUREMENT Vbx_eng_off_mdf1_on /end OUT_MEASUREMENT /end FUNCTION
/begin FUNCTION ClCooCtl_Fanrqbc "" /begin OUT_MEASUREMENT Vbx_mdf1_comb_mod_req Vbx_mdf2_comb_mod_req /end OUT_MEASUREMENT /end FUNCTION
/begin FUNCTION TqLimOvt "" /begin SUB_FUNCTION TqLimOvt_Ovetoxx /end SUB_FUNCTION /end FUNCTION
/begin FUNCTION TqLimOvt_Ovetoxx ""
 /begin DEF_CHARACTERISTIC Ctb_n_ovt_tq Cmp_ovt_tq Ctd_ovt_tq_t_max Ctp_ovt_lim_amp Ctp_ovt_lim_mat Ctp_ovt_lim_tco Ctp_ovt_lim_toil Cxx_ovt_inc_neg Cxx_ovt_n_thd Cxx_ovt_neg_fac Cxx_ovt_ovn_ofs Cxx_ovt_tq_dly_max Cxx_ovt_tq_fac_thd Cxx_ovt_tq_max Cxx_ovt_tq_ofs_thd Cxx_ovt_tq_slop_neg Cxx_ovt_tq_slop_pos /end DEF_CHARACTERISTIC
 /begin OUT_MEASUREMENT Vbx_ovt_ena Vxx_ovt_egy_fac Vxx_ovt_fac_dly Vxx_ovt_fac_lim Vxx_ovt_tq_appl Vxx_ovt_tq_ofs_raw Vxx_ovt_tq_raw /end OUT_MEASUREMENT
/end FUNCTION
/begin FUNCTION TqLimLos "" /begin SUB_FUNCTION TqLimLos_Lossxxx TqLimLos_Rubtqxx TqLimLos_Ptqxxxx /end SUB_FUNCTION /end FUNCTION
/begin FUNCTION TqLimLos_Lossxxx ""
 /begin DEF_CHARACTERISTIC Cbx_is_ad_eng_tql_cmf Cxx_pwst_off_is_cor_dly Cxx_pwst_prs_tql /end DEF_CHARACTERISTIC
 /begin OUT_MEASUREMENT Vsx_eng_tql_vld Vxx_aux_tql_sp Vxx_eng_tql Vxx_is_tql /end OUT_MEASUREMENT
/end FUNCTION
/begin FUNCTION TqLimLos_Rubtqxx "" /begin DEF_CHARACTERISTIC Cmp_tql_eng_frn Cbx_tql_temp_cfm /end DEF_CHARACTERISTIC /begin OUT_MEASUREMENT Vsx_tql_eng_frn_vld Vxx_tql_eng_frn /end OUT_MEASUREMENT /end FUNCTION
/begin FUNCTION TqLimLos_Ptqxxxx ""
 /begin DEF_CHARACTERISTIC Ctb_ptq_dp_form_fac Ctp_ptq_dp_form_fac Cbx_ptq_ex_prs_mdl_ok_cfm Cxx_ptq_ftc Cxx_ptq_max Cxx_ptq_min /end DEF_CHARACTERISTIC
 /begin OUT_MEASUREMENT Vsx_ptq_vld Vxx_dp Vxx_dp_fil Vxx_ptq /end OUT_MEASUREMENT
/end FUNCTION
/begin FUNCTION BoCloCoo "" /begin DEF_CHARACTERISTIC c_diag_wpmp c_wpmp_swi_on /end DEF_CHARACTERISTIC
 /begin OUT_MEASUREMENT Vbx_df_wpmp_tcr_blk Vbx_df_wpmp_tcr_oc Vbx_df_wpmp_tcr_scg Vbx_df_wpmp_tcr_scw Vbx_diag_ena_wpmp_tcr_blk Vbx_diag_ena_wpmp_tcr_oc Vbx_diag_ena_wpmp_tcr_scg Vbx_diag_ena_wpmp_tcr_scw cdn_diag_oil_heat_el cdn_diag_wpmp_el ctr_swi_on err_diag_oil_heat_el err_diag_wpmp_el lv_end_pump_stuck lv_err_wpmp_el_scp lv_pulse_ack lv_pulse_req lv_sta_mem_wpmp lv_start_pump_stuck lv_wpmp_on lv_wpmp_position lv_wpmp_swi_on lv_wtpump v_adc_pulse v_diag_stu_mv_1 v_diag_stu_mv_2 v_diag_wpmp vp_wtpump /end OUT_MEASUREMENT
/end FUNCTION
/begin FUNCTION TqMdlFsp ""
 /begin SUB_FUNCTION TqMdlFsp_Efyigxx TqMdlFsp_Estixxx TqMdlFsp_Laefyxx TqMdlFsp_Tqefyxx TqMdlFsp_Injctxx TqMdlFsp_Cdytqxx TqMdlFsp_Ivltqxx TqMdlFsp_Wefrixx /end SUB_FUNCTION
/end FUNCTION
/begin FUNCTION TqMdlFsp_Efyigxx "" /begin DEF_CHARACTERISTIC Ctp_iga_dif Ctp_iga_dif_sq /end DEF_CHARACTERISTIC /begin OUT_MEASUREMENT Vxx_iga Vxx_raw_iga /end OUT_MEASUREMENT /end FUNCTION
/begin FUNCTION TqMdlFsp_Estixxx ""
 /begin OUT_MEASUREMENT Vxx_appl_iga_efy Vxx_appl_iga_efy_2 Vxx_esti_tqe Vxx_esti_tqe_tgt Vxx_esti_tqi /end OUT_MEASUREMENT
/end FUNCTION
/begin FUNCTION TqMdlFsp_Laefyxx "" /begin OUT_MEASUREMENT Vxx_iga_efy Vxx_raw_iga_efy /end OUT_MEASUREMENT /end FUNCTION
/begin FUNCTION TqMdlFsp_Tqefyxx "" /begin DEF_CHARACTERISTIC Cxx_dz_iga_efv /end DEF_CHARACTERISTIC /begin OUT_MEASUREMENT Vbx_no_ajs_tq_efy_cut Vxx_ajs_tq_efy Vxx_no_ajs_tq_efy /end OUT_MEASUREMENT /end FUNCTION
/begin FUNCTION TqMdlFsp_Injctxx "" /begin DEF_CHARACTERISTIC Ntb_cyl Ctd_inj_efy_dz Cxx_cut_efy_dz Cxx_lih_inj_cut_nr /end DEF_CHARACTERISTIC
 /begin OUT_MEASUREMENT Vbx_cut Vbx_cut_it_dft Vxx_cut_efy_dz Vxx_cyl_cut_tq_efy Vxx_h_req_inj_cut_nr Vxx_inj_efy_dz Vxx_req_inj_cut_nr Vxx_req_inj_cut_nr_1 /end OUT_MEASUREMENT
/end FUNCTION
/begin FUNCTION TqMdlFsp_Cdytqxx ""
 /begin DEF_CHARACTERISTIC Cbx_maf_efy_cor_ena_cfm Cbx_maf_efy_tkof_cfm Cbx_maf_efy_tq_trs_cfm Cxx_eal_maf_efy_ena_thd Cxx_h_maf_efy_thd Cxx_l_maf_efy_dly Cxx_l_maf_efy_neg_slop Cxx_l_maf_efy_pos_slop Cxx_l_maf_efy_thd Cxx_maf_cor_efy_dz Cxx_maf_efy_is_ena_thd Cxx_maf_efy_neg_slop Cxx_n_maf_efy_ena_thd Cxx_sta_l_maf_efy_thd Cxx_tkof_h_maf_efy_thd /end DEF_CHARACTERISTIC
 /begin OUT_MEASUREMENT Vxx_eng_maf_efy_cor Vxx_l_maf_efy_thd Vxx_maf_cyl_mdl Vxx_maf_efy_cor Vxx_maf_efy_ena_fac Vxx_maf_eng_mdl Vxx_maf_it_mdl Vxx_map_eng_mdl Vxx_raw_maf_efy_cor Vxx_sat_maf_efy_cor /end OUT_MEASUREMENT
/end FUNCTION
/begin FUNCTION TqMdlFsp_Ivltqxx "" /begin DEF_CHARACTERISTIC Cbx_n_tq_fct_vld2_cfm /end DEF_CHARACTERISTIC /begin OUT_MEASUREMENT Vsx_tq_fct_vld /end OUT_MEASUREMENT /end FUNCTION
/begin FUNCTION TqMdlFsp_Wefrixx "" /begin DEF_CHARACTERISTIC Cxx_rich_dstb_cor_efy_fac Cxx_rich_dstb_cor_efy_fac_alco /end DEF_CHARACTERISTIC /begin OUT_MEASUREMENT Vxx_rich_dstb_cor_efy /end OUT_MEASUREMENT /end FUNCTION
/begin FUNCTION TqMdlSsp ""
 /begin SUB_FUNCTION TqMdlSsp_Tqiopxx TqMdlSsp_Airspxx TqMdlSsp_Igefyxx TqMdlSsp_Isefyxx TqMdlSsp_Wuefyxx TqMdlSsp_Iswuefy TqMdlSsp_Alcoxxx /end SUB_FUNCTION
/end FUNCTION
/begin FUNCTION TqMdlSsp_Tqiopxx ""
 /begin DEF_CHARACTERISTIC Ctb_rich_sp Cmp_n_eal_otl_tqi_fac Ctp_rich_otl_iga_tqi_fac Cxx_otl_iga_tqi /end DEF_CHARACTERISTIC
 /begin OUT_MEASUREMENT Vsx_otl_iga_mv_tqi_vld Vxx_otl_iga_mv_tqi Vxx_otl_iga_mv_tqi_gas /end OUT_MEASUREMENT
/end FUNCTION
/begin FUNCTION TqMdlSsp_Airspxx ""
 /begin DEF_CHARACTERISTIC Cbx_ant_is_cor_cfm Cxx_ant_is_drv_thd Cxx_ant_is_tq_fac Cxx_ant_is_tq_n_drv_ftc /end DEF_CHARACTERISTIC
 /begin OUT_MEASUREMENT Vxx_maf_frh_eng_sp Vxx_maf_frh_it_sp Vxx_pow_ant Vxx_pow_tgt Vxx_tq_ant_is_cor Vxx_tqi_ant /end OUT_MEASUREMENT
/end FUNCTION
/begin FUNCTION TqMdlSsp_Igefyxx "" /begin DEF_CHARACTERISTIC Cmp_iga_efv_degr_a /end DEF_CHARACTERISTIC
 /begin OUT_MEASUREMENT Vxx_iga_efv_degr_a Vxx_max_iga_efy Vxx_min_iga_efy Vxx_stat_min_iga_efy /end OUT_MEASUREMENT
/end FUNCTION
/begin FUNCTION TqMdlSsp_Isefyxx "" /begin DEF_CHARACTERISTIC Ctb_is_eal Ctb_is_n Cmp_n_eal_is_efy Cxx_is_efy_slop /end DEF_CHARACTERISTIC /begin OUT_MEASUREMENT Vxx_is_efy Vxx_raw_is_efy /end OUT_MEASUREMENT /end FUNCTION
/begin FUNCTION TqMdlSsp_Wuefyxx ""
 /begin DEF_CHARACTERISTIC Ctb_n_wup Ctb_wup_h_l_iga_efy_ctr Ctb_wup_tq_rel Cmp_n_tq_rel_wup_cold_iga_efy Cmp_n_tq_rel_wup_h_iga_efy Cmp_n_tq_rel_wup_l_iga_efy Ctp_wup_h_l_iga_efy_ctr Cxx_diag_sta_cata_lbup_wup_efy Cxx_wup_cold_fil_pos_slop Cxx_wup_efy_ftc Cxx_wup_fil_neg_slop Cxx_wup_fil_pos_slop /end DEF_CHARACTERISTIC
 /begin OUT_MEASUREMENT Vxx_tq_rel Vxx_wup_cold_efy_cor Vxx_wup_efy Vxx_wup_efy_cor Vxx_wup_efy_fil_fac Vxx_wup_h_l_ctr /end OUT_MEASUREMENT
/end FUNCTION
/begin FUNCTION TqMdlSsp_Iswuefy ""
 /begin DEF_CHARACTERISTIC Ctp_is_wup_cold_dri_efy_cor Ctp_is_wup_cold_neut_efy_cor Ctp_is_wup_dri_efy_cor Ctp_is_wup_neut_efy_cor Cxx_is_wup_fil_neg_slop Cxx_is_wup_fil_pos_slop /end DEF_CHARACTERISTIC
 /begin OUT_MEASUREMENT Vbx_not_cold_sta_tco Vxx_is_wup_cold_neut_efy_cor Vxx_is_wup_dri_efy_cor Vxx_is_wup_efy Vxx_is_wup_efy_fil_fac Vxx_is_wup_neut_efy_cor /end OUT_MEASUREMENT
/end FUNCTION
/begin FUNCTION TqMdlSsp_Alcoxxx ""
 /begin DEF_CHARACTERISTIC Ctb_wup_h_l_iga_efy_ctr_alco Cmp_iga_efv_degr_a_alco Cmp_n_eal_otl_tqi_fac_alco Cmp_n_tq_wup_cold_efy_alco Cmp_n_tq_wup_h_iga_efy_alco Cmp_n_tq_wup_l_iga_efy_alco Ctp_is_wup_cold_neut_efy_alco Ctp_is_wup_neut_efy_alco Ctp_rich_otl_iga_tqi_fac_alco Ctp_wup_h_l_iga_efy_ctr_alco Cxx_otl_iga_tqi_alco /end DEF_CHARACTERISTIC
 /begin OUT_MEASUREMENT Vxx_iga_efv_degr_a_alco Vxx_is_wup_cold_neut_efy_alco Vxx_is_wup_neut_efy_alco Vxx_otl_iga_mv_tqi_alco Vxx_wup_cold_efy_cor_alco Vxx_wup_efy_cor_alco Vxx_wup_h_l_ctr_alco /end OUT_MEASUREMENT
/end FUNCTION
/begin FUNCTION CbIgnSpt "" /begin SUB_FUNCTION CbIgnSpt_Alcoxxx CbIgnSpt_Igfinxx CbIgnSpt_Igstaxx /end SUB_FUNCTION /end FUNCTION
/begin FUNCTION CbIgnSpt_Alcoxxx "" /begin DEF_CHARACTERISTIC Cmp_n_tco_sta_iga_alco /end DEF_CHARACTERISTIC /begin OUT_MEASUREMENT Vxx_n_tco_sta_iga_alco /end OUT_MEASUREMENT /end FUNCTION
/begin FUNCTION CbIgnSpt_Igfinxx ""
 /begin DEF_CHARACTERISTIC Cmp_n_map_cart_iga_bch Cbx_cart_iga_bch_cfm Cbx_iga_bch_cfm Cbx_iga_ofs_bch_cfm Cxx_iga_appl_ini Cxx_iga_bch Cxx_iga_ofs_cyl1 Cxx_iga_ofs_cyl2 Cxx_iga_ofs_cyl3 Cxx_iga_ofs_cyl4 /end DEF_CHARACTERISTIC
 /begin OUT_MEASUREMENT Vxx_iga_appl Vxx_iga_pred Vxx_nom_iga /end OUT_MEASUREMENT
/end FUNCTION
/begin FUNCTION CbIgnSpt_Igstaxx "" /begin DEF_CHARACTERISTIC Cmp_n_tco_sta_iga /end DEF_CHARACTERISTIC /begin OUT_MEASUREMENT Vxx_sta_iga /end OUT_MEASUREMENT /end FUNCTION
/begin FUNCTION CbIgnLim ""
 /begin OUT_MEASUREMENT Vxx_knk_slow_cor_max_iga_NVM Vtd_knk_slow_cor_iga_cyl[0] Vtd_knk_slow_cor_iga_cyl[1] Vtd_knk_slow_cor_iga_cyl[2] Vtd_knk_slow_cor_iga_cyl[3] /end OUT_MEASUREMENT
 /begin SUB_FUNCTION CbIgnLim_Maxigxx CbIgnLim_Minigxx CbIgnLim_Pknkcxx CbIgnLim_Slcbcxx CbIgnLim_Kigacxx CbIgnLim_Alcoxxx /end SUB_FUNCTION
/end FUNCTION
/end MODULE
/end PROJECT
