ASAP2_VERSION 1 41
/begin PROJECT RD8 "_default_ProjectLongIdentifier"
/begin HEADER "_default_HeaderComment" PROJECT_NO RD9 /end HEADER
/begin MODULE _default_ModuleName "_default_ModuleLongIdentifier"
/begin MOD_COMMON "_default_ModCommonComment" DEPOSIT ABSOLUTE BYTE_ORDER MSB_LAST ALIGNMENT_BYTE 1 ALIGNMENT_WORD 2 ALIGNMENT_LONG 2 ALIGNMENT_FLOAT32_IEEE 2 ALIGNMENT_FLOAT64_IEEE 4 /end MOD_COMMON
/begin AXIS_PTS Ctb_gear_fs "Ctb_gear_fs" 0xa0021be6 NO_INPUT_QUANTITY _REC_A2AXS_20_u1 5. _CNV_R_R_VA_F_1_p1__440_CM 6 1. 6. FORMAT "%9.2" /end AXIS_PTS
/begin AXIS_PTS Ctb_tq_dif_tco "Ctb_tq_dif_tco" 0xa002537c Vxx_tco _REC_A2AXS_20_u2 240. _CNV_R_R_VA_F_0v1_m_461_CM 6 -40. 200. FORMAT "%9.2" /end AXIS_PTS
/begin AXIS_PTS Ctb_tq_dif_vs "Ctb_tq_dif_vs" 0xa002538c Vxx_vs _REC_A2AXS_20_u2 655.35 _CNV_R_R_VA_F_0v01__446_CM 10 0. 655.35 FORMAT "%9.2" /end AXIS_PTS
/begin CHARACTERISTIC Ctp_tq_dif_tco_fac "Ctp_tq_dif_tco_fac" CURVE 0xa0021bee _REC_A1CUR_20_u1_u2 1. _CNV_R_R_VA_F_0v004_462_CM 0. 1. FORMAT "%9.3"
 /begin AXIS_DESCR COM_AXIS Vxx_tco _CNV_R_R_VA_F_0v1_m_461_CM 6 -40. 200. FORMAT "%9.2" AXIS_PTS_REF Ctb_tq_dif_tco /end AXIS_DESCR
/end CHARACTERISTIC
/begin CHARACTERISTIC Ctp_tq_res "Ctp_tq_res" CURVE 0xa00253a4 _REC_A1CUR_20_u2_u2 32768. _CNV_R_R_VA_F_1_p0__456_CM 0. 32768. FORMAT "%9.2"
 /begin AXIS_DESCR COM_AXIS Vxx_vs _CNV_R_R_VA_F_0v01__446_CM 10 0. 655.35 FORMAT "%9.2" AXIS_PTS_REF Ctb_tq_dif_vs /end AXIS_DESCR
/end CHARACTERISTIC
/begin CHARACTERISTIC Ctp_vh_wht_eq "Ctp_vh_wht_eq" CURVE 0xa00253b8 _REC_A1CUR_20_u2_u1 4096. _CNV_R_R_VA_F_1_p0__463_CM 0. 4096. FORMAT "%9.2"
 /begin AXIS_DESCR COM_AXIS NO_INPUT_QUANTITY _CNV_R_R_VA_F_1_p1__440_CM 6 1. 6. FORMAT "%9.2" AXIS_PTS_REF Ctb_gear_fs /end AXIS_DESCR
/end CHARACTERISTIC
/begin MEASUREMENT Vbx_fil_rst "Vbx_fil_rst" UBYTE _CNV_S_2_VA_Bool_ON_448_CM 1 0. 0. 1. ECU_ADDRESS 0xd0004a01 BIT_MASK 0x1 /end MEASUREMENT
/begin MEASUREMENT Vbx_frz "Vbx_frz" UBYTE _CNV_S_2_VA_Bool_ON_448_CM 1 0. 0. 1. ECU_ADDRESS 0xd0004a02 BIT_MASK 0x1 /end MEASUREMENT
/begin MEASUREMENT Vbx_sip_frz "Vbx_sip_frz" UBYTE _CNV_S_2_VA_Bool_ON_448_CM 1 0. 0. 1. ECU_ADDRESS 0xd0004a04 BIT_MASK 0x1 /end MEASUREMENT
/begin MEASUREMENT Vsx_pow_r_vld "Vsx_pow_r_vld" UBYTE _CNV_R_R_VA_I_16_449_CM 1 0. 0. 255. ECU_ADDRESS 0xd00049f6 FORMAT "%9.2" /end MEASUREMENT
/begin MEASUREMENT Vsx_tq_dif_vld "Vsx_tq_dif_vld" UBYTE _CNV_R_R_VA_I_16_449_CM 1 0. 0. 255. ECU_ADDRESS 0xd00049f7 FORMAT "%9.2" /end MEASUREMENT
/begin MEASUREMENT Vxx_dly_pow_r "Vxx_dly_pow_r" SWORD _CNV_R_R_VA_F_10_p0_453_CM 1 0. -327680. 327670. ECU_ADDRESS 0xd0003792 FORMAT "%9.2" /end MEASUREMENT
/begin MEASUREMENT Vxx_dly_tq_dif "Vxx_dly_tq_dif" SWORD _CNV_R_R_VA_F_1_p0__456_CM 1 0. -32768. 32767. ECU_ADDRESS 0xd0003794 FORMAT "%9.2" /end MEASUREMENT
/begin MEASUREMENT Vxx_free_shf_acel "Vxx_free_shf_acel" SLONG _CNV_R_R_VA_F_0v000_442_CM 1 0. -858993.4592 858993.4588 ECU_ADDRESS 0xd0001e2c FORMAT "%9.4" /end MEASUREMENT
/begin MEASUREMENT Vxx_gear_lim_tq_dif "Vxx_gear_lim_tq_dif" UBYTE _CNV_R_R_VA_F_1_p1__440_CM 1 0. 1. 256. ECU_ADDRESS 0xd00049fa FORMAT "%9.2" /end MEASUREMENT
/begin MEASUREMENT Vxx_pow_r "Vxx_pow_r" SWORD _CNV_R_R_VA_F_10_p0_453_CM 1 0. -327680. 327670. ECU_ADDRESS 0xd0003796 FORMAT "%9.2" /end MEASUREMENT
/begin MEASUREMENT Vxx_pow_r_fil "Vxx_pow_r_fil" SWORD _CNV_R_R_VA_F_10_p0_453_CM 1 0. -327680. 327670. ECU_ADDRESS 0xd0003798 FORMAT "%9.2" /end MEASUREMENT
/begin MEASUREMENT Vxx_pow_r_raw "Vxx_pow_r_raw" SWORD _CNV_R_R_VA_F_10_p0_453_CM 1 0. -327680. 327670. ECU_ADDRESS 0xd000379c FORMAT "%9.2" /end MEASUREMENT
/begin MEASUREMENT Vxx_tq_dif "Vxx_tq_dif" SWORD _CNV_R_R_VA_F_1_p0__456_CM 1 0. -32768. 32767. ECU_ADDRESS 0xd000379e FORMAT "%9.2" /end MEASUREMENT
/begin MEASUREMENT Vxx_tq_dif_esti_tqe_fil "Vxx_tq_dif_esti_tqe_fil" UWORD _CNV_R_R_VA_F_0v031_464_CM 1 0. -400. 1647.96875 ECU_ADDRESS 0xd00037a4 FORMAT "%9.2" /end MEASUREMENT
/begin MEASUREMENT Vxx_tq_dif_fil "Vxx_tq_dif_fil" SWORD _CNV_R_R_VA_F_1_p0__456_CM 1 0. -32768. 32767. ECU_ADDRESS 0xd00037a0 FORMAT "%9.2" /end MEASUREMENT
/begin CHARACTERISTIC Cxx_end_sip_ena_dly "Cxx_end_sip_ena_dly" VALUE 0xa0021bf4 _REC_S1VAL_Normal_u1 10.2 _CNV_R_R_VA_F_0v04__465_CM 0. 10.2 FORMAT "%9.2" /end CHARACTERISTIC
/begin CHARACTERISTIC Cxx_pow_r_fil "Cxx_pow_r_fil" VALUE 0xa0021bf5 _REC_S1VAL_Normal_u1 10.2 _CNV_R_R_VA_F_0v04__465_CM 0. 10.2 FORMAT "%9.2" /end CHARACTERISTIC
/begin CHARACTERISTIC Cxx_tq_dif_acel_dec_fil "Cxx_tq_dif_acel_dec_fil" VALUE 0xa0021bf6 _REC_S1VAL_Normal_u1 10.2 _CNV_R_R_VA_F_0v04__465_CM 0. 10.2 FORMAT "%9.2" /end CHARACTERISTIC
/begin CHARACTERISTIC Cxx_tq_dif_acel_inc_fil "Cxx_tq_dif_acel_inc_fil" VALUE 0xa0021bf7 _REC_S1VAL_Normal_u1 10.2 _CNV_R_R_VA_F_0v04__465_CM 0. 10.2 FORMAT "%9.2" /end CHARACTERISTIC
/begin CHARACTERISTIC Cxx_tq_dif_degr_fac "Cxx_tq_dif_degr_fac" VALUE 0xa0021bfa _REC_S1VAL_Normal_u1 1. _CNV_R_R_VA_F_0v004_462_CM 0. 1. FORMAT "%9.3" /end CHARACTERISTIC
/begin CHARACTERISTIC Cxx_tq_dif_esti_tqe_fil "Cxx_tq_dif_esti_tqe_fil" VALUE 0xa0021bf8 _REC_S1VAL_Normal_u1 10.2 _CNV_R_R_VA_F_0v04__465_CM 0. 10.2 FORMAT "%9.2" /end CHARACTERISTIC
/begin CHARACTERISTIC Cxx_tq_dif_fil "Cxx_tq_dif_fil" VALUE 0xa0021bf9 _REC_S1VAL_Normal_u1 10.2 _CNV_R_R_VA_F_0v04__465_CM 0. 10.2 FORMAT "%9.2" /end CHARACTERISTIC
/begin CHARACTERISTIC Cxx_whl_rad "Cxx_whl_rad" VALUE 0xa0021bfb _REC_S1VAL_Normal_u1 0.25 _CNV_R_R_VA_F_0v001_466_CM 0.2 0.45 FORMAT "%9.3" /end CHARACTERISTIC
/begin MEASUREMENT Vbx_aut_eng_mil "Boolean indicating that the engine is in autonomous functioning" UBYTE _CNV_S_2_RANGE______3_CM 1 0. 0. 1. ECU_ADDRESS 0xd000579f BIT_MASK 0x1 /end MEASUREMENT
/begin MEASUREMENT Vxx_mux_mil_req_1 "MIL ignition state requested by MUX encoding" UBYTE _CNV_A_R_ECME_LINEA_0_CM 1 0. 0. 3. ECU_ADDRESS 0xd00057a0 FORMAT "%1.0" /end MEASUREMENT
/begin MEASUREMENT Vxx_mux_mil_req_2 "Readiness state indication by MIL" UBYTE _CNV_A_R_ECME_LINEA_0_CM 1 0. 0. 3. ECU_ADDRESS 0xd00057a1 FORMAT "%1.0" /end MEASUREMENT
/begin MEASUREMENT Vxx_mux_test_mil_dly "Current delay before readiness status check" UBYTE _CNV_A_R_LINEAR_____4_CM 1 0. 0. 25.5 ECU_ADDRESS 0xd00057a2 FORMAT "%4.1" /end MEASUREMENT
/begin MEASUREMENT Vxx_mux_test_rdn_mil_dly "MIL flashing current delay when readiness are not completed" UBYTE _CNV_A_R_LINEAR_____4_CM 1 0. 0. 25.5 ECU_ADDRESS 0xd00057a3 FORMAT "%4.1" /end MEASUREMENT
/begin CHARACTERISTIC Cbx_mux_mil_cfm "MIL configuration" VALUE 0xa00215a0 _REC_S1VAL_20_u1 1. _CNV_S_2_RANGE______3_CM 0. 1. /end CHARACTERISTIC
/begin CHARACTERISTIC Cxx_mux_test_mil_dly "Delay before readiness status check" VALUE 0xa00215a1 _REC_S1VAL_20_u1 25.5 _CNV_A_R_LINEAR_____4_CM 0. 25.5 FORMAT "%4.1" /end CHARACTERISTIC
/begin CHARACTERISTIC Cxx_mux_test_rdn_mil_dly "MIL flashing delay when readiness are not completed" VALUE 0xa00215a2 _REC_S1VAL_20_u1 25.5 _CNV_A_R_LINEAR_____4_CM 0. 25.5 FORMAT "%4.1" /end CHARACTERISTIC
/begin MEASUREMENT Vsx_egb_n_lim_vld "Engine speed limitation requested by EGB (CVT,...) validity status" UBYTE _CNV_S_3_STATUS_OK__120_CM 1 0. 0. 2. ECU_ADDRESS 0xd0004f6b /end MEASUREMENT
/begin MEASUREMENT Vxx_egb_n_lim "Engine speed limitation requested by EGB (CVT,...)" UWORD _CNV_A_R_ENSD_LINEA_24_CM 1 0. 0. 16383.75 ECU_ADDRESS 0xd0002f1e FORMAT "%8.2" /end MEASUREMENT
/begin CHARACTERISTIC Cxx_max_n_egb_dft "Maximum engine Speed when engine speed limitation requested by EGB (CVT,...) is not valid" VALUE 0xa0020ba2 _REC_S1VAL_20_u2 16383.75 _CNV_A_R_ENSD_LINEA_24_CM 0. 16383.75 FORMAT "%8.2" /end CHARACTERISTIC
/begin MEASUREMENT ctr_rst_fmy "Number of SV ASA erease performed" UBYTE _CNV_A_R_A_165_CM 1 0. 0. 255. DISPLAY_IDENTIFIER Asa_NVM.ctr_rst_fmy_NVM ECU_ADDRESS 0xd00044ec /end MEASUREMENT
/begin MEASUREMENT lv_reset_frf_asa "The after sale freeze frames have been reseted after the end of manufacturing line" UBYTE _CNV_S_2_RANGE______3_CM 1 0. 0. 1. DISPLAY_IDENTIFIER Asa_NVM.lv_reset_frf_asa_NVM ECU_ADDRESS 0xd00044ed /end MEASUREMENT
/begin MEASUREMENT lv_inh_frf[0] "Inhibition of after supplier freeze frames data" UBYTE _CNV_S_2_RANGE______3_CM 1 0. 0. 1. DISPLAY_IDENTIFIER Asa_NVM.lv_inh_frf_NVM[0] ECU_ADDRESS 0xd00044f0 /end MEASUREMENT
/begin MEASUREMENT lv_inh_frf[1] "Inhibition of after supplier freeze frames data" UBYTE _CNV_S_2_RANGE______3_CM 1 0. 0. 1. DISPLAY_IDENTIFIER Asa_NVM.lv_inh_frf_NVM[1] ECU_ADDRESS 0xd00044f1 /end MEASUREMENT
/begin MEASUREMENT lv_inh_frf[2] "Inhibition of after supplier freeze frames data" UBYTE _CNV_S_2_RANGE______3_CM 1 0. 0. 1. DISPLAY_IDENTIFIER Asa_NVM.lv_inh_frf_NVM[2] ECU_ADDRESS 0xd00044f2 /end MEASUREMENT
/begin MEASUREMENT lv_inh_frf[3] "Inhibition of after supplier freeze frames data" UBYTE _CNV_S_2_RANGE______3_CM 1 0. 0. 1. DISPLAY_IDENTIFIER Asa_NVM.lv_inh_frf_NVM[3] ECU_ADDRESS 0xd00044f3 /end MEASUREMENT
/begin MEASUREMENT Vbx_moni_xx_req[0] "Activation of the identifier 00" UBYTE _CNV_S_2_RANGE______3_CM 1 0. 0. 1. ECU_ADDRESS 0xd0004050 BIT_MASK 0x1 /end MEASUREMENT
/begin MEASUREMENT Vbx_moni_id_01_req "Activation of the identifier 01" UBYTE _CNV_S_2_RANGE______3_CM 1 0. 0. 1. DISPLAY_IDENTIFIER Vbx_moni_xx_req[1] ECU_ADDRESS 0xd0004051 BIT_MASK 0x1 /end MEASUREMENT
/begin MEASUREMENT Vbx_moni_xx_req[2] "Activation of the identifier 02" UBYTE _CNV_S_2_RANGE______3_CM 1 0. 0. 1. ECU_ADDRESS 0xd0004052 BIT_MASK 0x1 /end MEASUREMENT
/begin MEASUREMENT Vbx_byp_03_req "Activation of the identifier 03" UBYTE _CNV_S_2_RANGE______3_CM 1 0. 0. 1. DISPLAY_IDENTIFIER Vbx_moni_xx_req[3] ECU_ADDRESS 0xd0004053 BIT_MASK 0x1 /end MEASUREMENT
/begin MEASUREMENT Vbx_moni_xx_req[4] "Activation of the identifier 04" UBYTE _CNV_S_2_RANGE______3_CM 1 0. 0. 1. ECU_ADDRESS 0xd0004054 BIT_MASK 0x1 /end MEASUREMENT
/begin MEASUREMENT Vbx_moni_xx_req[5] "Activation of the identifier 05" UBYTE _CNV_S_2_RANGE______3_CM 1 0. 0. 1. ECU_ADDRESS 0xd0004055 BIT_MASK 0x1 /end MEASUREMENT
/begin MEASUREMENT Vbx_byp_06_req "Activation of the identifier 06" UBYTE _CNV_S_2_RANGE______3_CM 1 0. 0. 1. DISPLAY_IDENTIFIER Vbx_moni_xx_req[6] ECU_ADDRESS 0xd0004056 BIT_MASK 0x1 /end MEASUREMENT
/begin MEASUREMENT Vbx_moni_xx_req[7] "Activation of the identifier 07" UBYTE _CNV_S_2_RANGE______3_CM 1 0. 0. 1. ECU_ADDRESS 0xd0004057 BIT_MASK 0x1 /end MEASUREMENT
/begin MEASUREMENT Vbx_moni_xx_req[8] "Activation of the identifier 08" UBYTE _CNV_S_2_RANGE______3_CM 1 0. 0. 1. ECU_ADDRESS 0xd0004058 BIT_MASK 0x1 /end MEASUREMENT
/begin MEASUREMENT Vbx_moni_xx_req[9] "Activation of the identifier 09" UBYTE _CNV_S_2_RANGE______3_CM 1 0. 0. 1. ECU_ADDRESS 0xd0004059 BIT_MASK 0x1 /end MEASUREMENT
/begin MEASUREMENT Vbx_byp_0a_req "Activation of the identifier 0a" UBYTE _CNV_S_2_RANGE______3_CM 1 0. 0. 1. DISPLAY_IDENTIFIER Vbx_moni_xx_req[10] ECU_ADDRESS 0xd000405a BIT_MASK 0x1 /end MEASUREMENT
/begin MEASUREMENT Vbx_moni_xx_req[11] "Activation of the identifier 0b" UBYTE _CNV_S_2_RANGE______3_CM 1 0. 0. 1. ECU_ADDRESS 0xd000405b BIT_MASK 0x1 /end MEASUREMENT
/begin MEASUREMENT Vbx_moni_xx_req[12] "Activation of the identifier 0c" UBYTE _CNV_S_2_RANGE______3_CM 1 0. 0. 1. ECU_ADDRESS 0xd000405c BIT_MASK 0x1 /end MEASUREMENT
/begin MEASUREMENT Vbx_moni_xx_req[13] "Activation of the identifier 0d" UBYTE _CNV_S_2_RANGE______3_CM 1 0. 0. 1. ECU_ADDRESS 0xd000405d BIT_MASK 0x1 /end MEASUREMENT
/begin MEASUREMENT Vbx_moni_xx_req[14] "Activation of the identifier 0e" UBYTE _CNV_S_2_RANGE______3_CM 1 0. 0. 1. ECU_ADDRESS 0xd000405e BIT_MASK 0x1 /end MEASUREMENT
/begin MEASUREMENT Vbx_moni_xx_req[15] "Activation of the identifier 0f" UBYTE _CNV_S_2_RANGE______3_CM 1 0. 0. 1. ECU_ADDRESS 0xd000405f BIT_MASK 0x1 /end MEASUREMENT
/begin MEASUREMENT Vbx_moni_id_10_req "Activation of the identifier 10" UBYTE _CNV_S_2_RANGE______3_CM 1 0. 0. 1. DISPLAY_IDENTIFIER Vbx_moni_xx_req[16] ECU_ADDRESS 0xd0004060 BIT_MASK 0x1 /end MEASUREMENT
/begin MEASUREMENT Vbx_moni_id_11_req "Activation of the identifier 11" UBYTE _CNV_S_2_RANGE______3_CM 1 0. 0. 1. DISPLAY_IDENTIFIER Vbx_moni_xx_req[17] ECU_ADDRESS 0xd0004061 BIT_MASK 0x1 /end MEASUREMENT
/begin MEASUREMENT Vbx_moni_xx_req[18] "Activation of the identifier 12" UBYTE _CNV_S_2_RANGE______3_CM 1 0. 0. 1. ECU_ADDRESS 0xd0004062 BIT_MASK 0x1 /end MEASUREMENT
/begin MEASUREMENT Vbx_moni_id_13_req "Activation of the identifier 13" UBYTE _CNV_S_2_RANGE______3_CM 1 0. 0. 1. DISPLAY_IDENTIFIER Vbx_moni_xx_req[19] ECU_ADDRESS 0xd0004063 BIT_MASK 0x1 /end MEASUREMENT
/begin MEASUREMENT Vbx_moni_id_14_req "Activation of the identifier 14" UBYTE _CNV_S_2_RANGE______3_CM 1 0. 0. 1. DISPLAY_IDENTIFIER Vbx_moni_xx_req[20] ECU_ADDRESS 0xd0004064 BIT_MASK 0x1 /end MEASUREMENT
/begin MEASUREMENT Vbx_moni_xx_req[21] "Activation of the identifier 15" UBYTE _CNV_S_2_RANGE______3_CM 1 0. 0. 1. ECU_ADDRESS 0xd0004065 BIT_MASK 0x1 /end MEASUREMENT
/begin MEASUREMENT Vbx_moni_xx_req[22] "Activation of the identifier 16" UBYTE _CNV_S_2_RANGE______3_CM 1 0. 0. 1. ECU_ADDRESS 0xd0004066 BIT_MASK 0x1 /end MEASUREMENT
/begin MEASUREMENT Vbx_moni_xx_req[23] "Activation of the identifier 17" UBYTE _CNV_S_2_RANGE______3_CM 1 0. 0. 1. ECU_ADDRESS 0xd0004067 BIT_MASK 0x1 /end MEASUREMENT
/begin MEASUREMENT Vbx_moni_id_18_req "Activation of the identifier 18" UBYTE _CNV_S_2_RANGE______3_CM 1 0. 0. 1. DISPLAY_IDENTIFIER Vbx_moni_xx_req[24] ECU_ADDRESS 0xd0004068 BIT_MASK 0x1 /end MEASUREMENT
/begin MEASUREMENT Vbx_byp_19_req "Activation of the identifier 19" UBYTE _CNV_S_2_RANGE______3_CM 1 0. 0. 1. DISPLAY_IDENTIFIER Vbx_moni_xx_req[25] ECU_ADDRESS 0xd0004069 BIT_MASK 0x1 /end MEASUREMENT
/begin MEASUREMENT Vbx_moni_id_1a_req "Activation of the identifier 1a" UBYTE _CNV_S_2_RANGE______3_CM 1 0. 0. 1. DISPLAY_IDENTIFIER Vbx_moni_xx_req[26] ECU_ADDRESS 0xd000406a BIT_MASK 0x1 /end MEASUREMENT
/begin MEASUREMENT Vbx_moni_id_1b_req "Activation of the identifier 1b" UBYTE _CNV_S_2_RANGE______3_CM 1 0. 0. 1. DISPLAY_IDENTIFIER Vbx_moni_xx_req[27] ECU_ADDRESS 0xd000406b BIT_MASK 0x1 /end MEASUREMENT
/begin MEASUREMENT Vbx_byp_1c_req "Activation of the identifier 1c" UBYTE _CNV_S_2_RANGE______3_CM 1 0. 0. 1. DISPLAY_IDENTIFIER Vbx_moni_xx_req[28] ECU_ADDRESS 0xd000406c BIT_MASK 0x1 /end MEASUREMENT
/begin MEASUREMENT Vbx_byp_1d_req "Activation of the identifier 1d" UBYTE _CNV_S_2_RANGE______3_CM 1 0. 0. 1. DISPLAY_IDENTIFIER Vbx_moni_xx_req[29] ECU_ADDRESS 0xd000406d BIT_MASK 0x1 /end MEASUREMENT
/begin MEASUREMENT Vbx_byp_1e_req "Activation of the identifier 1e" UBYTE _CNV_S_2_RANGE______3_CM 1 0. 0. 1. DISPLAY_IDENTIFIER Vbx_moni_xx_req[30] ECU_ADDRESS 0xd000406e BIT_MASK 0x1 /end MEASUREMENT
/begin MEASUREMENT Vbx_byp_1f_req "Activation of the identifier 1f" UBYTE _CNV_S_2_RANGE______3_CM 1 0. 0. 1. DISPLAY_IDENTIFIER Vbx_moni_xx_req[31] ECU_ADDRESS 0xd000406f BIT_MASK 0x1 /end MEASUREMENT
/begin MEASUREMENT Vbx_moni_id_20_req "Activation of the identifier 20" UBYTE _CNV_S_2_RANGE______3_CM 1 0. 0. 1. DISPLAY_IDENTIFIER Vbx_moni_xx_req[32] ECU_ADDRESS 0xd0004070 BIT_MASK 0x1 /end MEASUREMENT
/begin MEASUREMENT Vbx_moni_id_21_req "Activation of the identifier 21" UBYTE _CNV_S_2_RANGE______3_CM 1 0. 0. 1. DISPLAY_IDENTIFIER Vbx_moni_xx_req[33] ECU_ADDRESS 0xd0004071 BIT_MASK 0x1 /end MEASUREMENT
/begin MEASUREMENT Vbx_moni_xx_req[34] "Activation of the identifier 22" UBYTE _CNV_S_2_RANGE______3_CM 1 0. 0. 1. ECU_ADDRESS 0xd0004072 BIT_MASK 0x1 /end MEASUREMENT
/begin MEASUREMENT Vbx_moni_xx_req[35] "Activation of the identifier 23" UBYTE _CNV_S_2_RANGE______3_CM 1 0. 0. 1. ECU_ADDRESS 0xd0004073 BIT_MASK 0x1 /end MEASUREMENT
/begin MEASUREMENT Vbx_moni_xx_req[36] "Activation of the identifier 24" UBYTE _CNV_S_2_RANGE______3_CM 1 0. 0. 1. ECU_ADDRESS 0xd0004074 BIT_MASK 0x1 /end MEASUREMENT
/begin MEASUREMENT Vbx_byp_25_req "Activation of the identifier 25" UBYTE _CNV_S_2_RANGE______3_CM 1 0. 0. 1. DISPLAY_IDENTIFIER Vbx_moni_xx_req[37] ECU_ADDRESS 0xd0004075 BIT_MASK 0x1 /end MEASUREMENT
/begin MEASUREMENT Vbx_byp_26_req "Activation of the identifier 26" UBYTE _CNV_S_2_RANGE______3_CM 1 0. 0. 1. DISPLAY_IDENTIFIER Vbx_moni_xx_req[38] ECU_ADDRESS 0xd0004076 BIT_MASK 0x1 /end MEASUREMENT
/begin MEASUREMENT Vbx_moni_xx_req[39] "Activation of the identifier 27" UBYTE _CNV_S_2_RANGE______3_CM 1 0. 0. 1. ECU_ADDRESS 0xd0004077 BIT_MASK 0x1 /end MEASUREMENT
/begin MEASUREMENT Vbx_moni_xx_req[40] "Activation of the identifier 28" UBYTE _CNV_S_2_RANGE______3_CM 1 0. 0. 1. ECU_ADDRESS 0xd0004078 BIT_MASK 0x1 /end MEASUREMENT
/begin MEASUREMENT Vbx_byp_29_req "Activation of the identifier 29" UBYTE _CNV_S_2_RANGE______3_CM 1 0. 0. 1. DISPLAY_IDENTIFIER Vbx_moni_xx_req[41] ECU_ADDRESS 0xd0004079 BIT_MASK 0x1 /end MEASUREMENT
/begin MEASUREMENT Vbx_moni_xx_req[42] "Activation of the identifier 2a" UBYTE _CNV_S_2_RANGE______3_CM 1 0. 0. 1. ECU_ADDRESS 0xd000407a BIT_MASK 0x1 /end MEASUREMENT
/begin MEASUREMENT Vbx_byp_2b_req "Activation of the identifier 2b" UBYTE _CNV_S_2_RANGE______3_CM 1 0. 0. 1. DISPLAY_IDENTIFIER Vbx_moni_xx_req[43] ECU_ADDRESS 0xd000407b BIT_MASK 0x1 /end MEASUREMENT
/begin MEASUREMENT Vbx_byp_2c_req "Activation of the identifier 2c" UBYTE _CNV_S_2_RANGE______3_CM 1 0. 0. 1. DISPLAY_IDENTIFIER Vbx_moni_xx_req[44] ECU_ADDRESS 0xd000407c BIT_MASK 0x1 /end MEASUREMENT
/begin MEASUREMENT Vbx_byp_2d_req "Activation of the identifier 2d" UBYTE _CNV_S_2_RANGE______3_CM 1 0. 0. 1. DISPLAY_IDENTIFIER Vbx_moni_xx_req[45] ECU_ADDRESS 0xd000407d BIT_MASK 0x1 /end MEASUREMENT
/begin MEASUREMENT Vbx_moni_xx_req[46] "Activation of the identifier 2e" UBYTE _CNV_S_2_RANGE______3_CM 1 0. 0. 1. ECU_ADDRESS 0xd000407e BIT_MASK 0x1 /end MEASUREMENT
/begin MEASUREMENT Vbx_moni_xx_req[47] "Activation of the identifier 2f" UBYTE _CNV_S_2_RANGE______3_CM 1 0. 0. 1. ECU_ADDRESS 0xd000407f BIT_MASK 0x1 /end MEASUREMENT
/begin MEASUREMENT Vbx_moni_id_30_req "Activation of the identifier 30" UBYTE _CNV_S_2_RANGE______3_CM 1 0. 0. 1. DISPLAY_IDENTIFIER Vbx_moni_xx_req[48] ECU_ADDRESS 0xd0004080 BIT_MASK 0x1 /end MEASUREMENT
/begin MEASUREMENT Vbx_moni_id_31_req "Activation of the identifier 31" UBYTE _CNV_S_2_RANGE______3_CM 1 0. 0. 1. DISPLAY_IDENTIFIER Vbx_moni_xx_req[49] ECU_ADDRESS 0xd0004081 BIT_MASK 0x1 /end MEASUREMENT
/begin MEASUREMENT Vbx_moni_id_32_req "Activation of the identifier 32" UBYTE _CNV_S_2_RANGE______3_CM 1 0. 0. 1. DISPLAY_IDENTIFIER Vbx_moni_xx_req[50] ECU_ADDRESS 0xd0004082 BIT_MASK 0x1 /end MEASUREMENT
/begin MEASUREMENT Vbx_moni_id_33_req "Activation of the identifier 33" UBYTE _CNV_S_2_RANGE______3_CM 1 0. 0. 1. DISPLAY_IDENTIFIER Vbx_moni_xx_req[51] ECU_ADDRESS 0xd0004083 BIT_MASK 0x1 /end MEASUREMENT
/begin MEASUREMENT Vbx_moni_id_34_req "Activation of the identifier 34" UBYTE _CNV_S_2_RANGE______3_CM 1 0. 0. 1. DISPLAY_IDENTIFIER Vbx_moni_xx_req[52] ECU_ADDRESS 0xd0004084 BIT_MASK 0x1 /end MEASUREMENT
/begin MEASUREMENT Vbx_moni_id_35_req "Activation of the identifier 35" UBYTE _CNV_S_2_RANGE______3_CM 1 0. 0. 1. DISPLAY_IDENTIFIER Vbx_moni_xx_req[53] ECU_ADDRESS 0xd0004085 BIT_MASK 0x1 /end MEASUREMENT
/begin MEASUREMENT Vbx_moni_id_36_req "Activation of the identifier 36" UBYTE _CNV_S_2_RANGE______3_CM 1 0. 0. 1. DISPLAY_IDENTIFIER Vbx_moni_xx_req[54] ECU_ADDRESS 0xd0004086 BIT_MASK 0x1 /end MEASUREMENT
/begin MEASUREMENT Vbx_moni_id_37_req "Activation of the identifier 37" UBYTE _CNV_S_2_RANGE______3_CM 1 0. 0. 1. DISPLAY_IDENTIFIER Vbx_moni_xx_req[55] ECU_ADDRESS 0xd0004087 BIT_MASK 0x1 /end MEASUREMENT
/begin MEASUREMENT Vbx_moni_id_38_req "Activation of the identifier 38" UBYTE _CNV_S_2_RANGE______3_CM 1 0. 0. 1. DISPLAY_IDENTIFIER Vbx_moni_xx_req[56] ECU_ADDRESS 0xd0004088 BIT_MASK 0x1 /end MEASUREMENT
/begin MEASUREMENT Vbx_moni_id_39_req "Activation of the identifier 39" UBYTE _CNV_S_2_RANGE______3_CM 1 0. 0. 1. DISPLAY_IDENTIFIER Vbx_moni_xx_req[57] ECU_ADDRESS 0xd0004089 BIT_MASK 0x1 /end MEASUREMENT
/begin MEASUREMENT Vbx_moni_id_3a_req "Activation of the identifier 3a" UBYTE _CNV_S_2_RANGE______3_CM 1 0. 0. 1. DISPLAY_IDENTIFIER Vbx_moni_xx_req[58] ECU_ADDRESS 0xd000408a BIT_MASK 0x1 /end MEASUREMENT
/begin MEASUREMENT Vbx_moni_id_3b_req "Activation of the identifier 3b" UBYTE _CNV_S_2_RANGE______3_CM 1 0. 0. 1. DISPLAY_IDENTIFIER Vbx_moni_xx_req[59] ECU_ADDRESS 0xd000408b BIT_MASK 0x1 /end MEASUREMENT
/begin MEASUREMENT Vbx_moni_id_3c_req "Activation of the identifier 3c" UBYTE _CNV_S_2_RANGE______3_CM 1 0. 0. 1. DISPLAY_IDENTIFIER Vbx_moni_xx_req[60] ECU_ADDRESS 0xd000408c BIT_MASK 0x1 /end MEASUREMENT
/begin MEASUREMENT Vbx_byp_3d_req "Activation of the identifier 3d" UBYTE _CNV_S_2_RANGE______3_CM 1 0. 0. 1. DISPLAY_IDENTIFIER Vbx_moni_xx_req[61] ECU_ADDRESS 0xd000408d BIT_MASK 0x1 /end MEASUREMENT
/begin MEASUREMENT Vbx_byp_3e_req "Activation of the identifier 3e" UBYTE _CNV_S_2_RANGE______3_CM 1 0. 0. 1. DISPLAY_IDENTIFIER Vbx_moni_xx_req[62] ECU_ADDRESS 0xd000408e BIT_MASK 0x1 /end MEASUREMENT
/begin MEASUREMENT Vbx_moni_xx_req[63] "Activation of the identifier 3f" UBYTE _CNV_S_2_RANGE______3_CM 1 0. 0. 1. ECU_ADDRESS 0xd000408f BIT_MASK 0x1 /end MEASUREMENT
/begin MEASUREMENT Vbx_byp_40_req "Activation of the identifier 40" UBYTE _CNV_S_2_RANGE______3_CM 1 0. 0. 1. DISPLAY_IDENTIFIER Vbx_moni_xx_req[64] ECU_ADDRESS 0xd0004090 BIT_MASK 0x1 /end MEASUREMENT
/begin MEASUREMENT Vbx_moni_xx_req[65] "Activation of the identifier 41" UBYTE _CNV_S_2_RANGE______3_CM 1 0. 0. 1. ECU_ADDRESS 0xd0004091 BIT_MASK 0x1 /end MEASUREMENT
/begin MEASUREMENT Vbx_moni_xx_req[66] "Activation of the identifier 42" UBYTE _CNV_S_2_RANGE______3_CM 1 0. 0. 1. ECU_ADDRESS 0xd0004092 BIT_MASK 0x1 /end MEASUREMENT
/begin MEASUREMENT Vbx_byp_43_req "Activation of the identifier 43" UBYTE _CNV_S_2_RANGE______3_CM 1 0. 0. 1. DISPLAY_IDENTIFIER Vbx_moni_xx_req[67] ECU_ADDRESS 0xd0004093 BIT_MASK 0x1 /end MEASUREMENT
/begin MEASUREMENT Vbx_byp_44_req "Activation of the identifier 44" UBYTE _CNV_S_2_RANGE______3_CM 1 0. 0. 1. DISPLAY_IDENTIFIER Vbx_moni_xx_req[68] ECU_ADDRESS 0xd0004094 BIT_MASK 0x1 /end MEASUREMENT
/begin MEASUREMENT Vbx_moni_xx_req[69] "Activation of the identifier 45" UBYTE _CNV_S_2_RANGE______3_CM 1 0. 0. 1. ECU_ADDRESS 0xd0004095 BIT_MASK 0x1 /end MEASUREMENT
/begin MEASUREMENT Vbx_byp_46_req "Activation of the identifier 46" UBYTE _CNV_S_2_RANGE______3_CM 1 0. 0. 1. DISPLAY_IDENTIFIER Vbx_moni_xx_req[70] ECU_ADDRESS 0xd0004096 BIT_MASK 0x1 /end MEASUREMENT
/begin MEASUREMENT Vbx_byp_47_req "Activation of the identifier 47" UBYTE _CNV_S_2_RANGE______3_CM 1 0. 0. 1. DISPLAY_IDENTIFIER Vbx_moni_xx_req[71] ECU_ADDRESS 0xd0004097 BIT_MASK 0x1 /end MEASUREMENT
/begin MEASUREMENT Vbx_byp_48_req "Activation of the identifier 48" UBYTE _CNV_S_2_RANGE______3_CM 1 0. 0. 1. DISPLAY_IDENTIFIER Vbx_moni_xx_req[72] ECU_ADDRESS 0xd0004098 BIT_MASK 0x1 /end MEASUREMENT
/begin MEASUREMENT Vbx_byp_49_req "Activation of the identifier 49" UBYTE _CNV_S_2_RANGE______3_CM 1 0. 0. 1. DISPLAY_IDENTIFIER Vbx_moni_xx_req[73] ECU_ADDRESS 0xd0004099 BIT_MASK 0x1 /end MEASUREMENT
/begin MEASUREMENT Vbx_byp_4a_req "Activation of the identifier 4a" UBYTE _CNV_S_2_RANGE______3_CM 1 0. 0. 1. DISPLAY_IDENTIFIER Vbx_moni_xx_req[74] ECU_ADDRESS 0xd000409a BIT_MASK 0x1 /end MEASUREMENT
/begin MEASUREMENT Vbx_byp_4b_req "Activation of the identifier 4b" UBYTE _CNV_S_2_RANGE______3_CM 1 0. 0. 1. DISPLAY_IDENTIFIER Vbx_moni_xx_req[75] ECU_ADDRESS 0xd000409b BIT_MASK 0x1 /end MEASUREMENT
/begin MEASUREMENT Vbx_byp_4c_req "Activation of the identifier 4c" UBYTE _CNV_S_2_RANGE______3_CM 1 0. 0. 1. DISPLAY_IDENTIFIER Vbx_moni_xx_req[76] ECU_ADDRESS 0xd000409c BIT_MASK 0x1 /end MEASUREMENT
/begin MEASUREMENT Vbx_moni_xx_req[77] "Activation of the identifier 4d" UBYTE _CNV_S_2_RANGE______3_CM 1 0. 0. 1. ECU_ADDRESS 0xd000409d BIT_MASK 0x1 /end MEASUREMENT
/begin MEASUREMENT Vbx_moni_xx_req[78] "Activation of the identifier 4e" UBYTE _CNV_S_2_RANGE______3_CM 1 0. 0. 1. ECU_ADDRESS 0xd000409e BIT_MASK 0x1 /end MEASUREMENT
/begin MEASUREMENT Vbx_moni_xx_req[79] "Activation of the identifier 4f" UBYTE _CNV_S_2_RANGE______3_CM 1 0. 0. 1. ECU_ADDRESS 0xd000409f BIT_MASK 0x1 /end MEASUREMENT
/begin MEASUREMENT Vbx_moni_xx_req[80] "Activation of the identifier 50" UBYTE _CNV_S_2_RANGE______3_CM 1 0. 0. 1. ECU_ADDRESS 0xd00040a0 BIT_MASK 0x1 /end MEASUREMENT
/begin MEASUREMENT Vbx_byp_51_req "Activation of the identifier 51" UBYTE _CNV_S_2_RANGE______3_CM 1 0. 0. 1. DISPLAY_IDENTIFIER Vbx_moni_xx_req[81] ECU_ADDRESS 0xd00040a1 BIT_MASK 0x1 /end MEASUREMENT
/begin MEASUREMENT Vbx_byp_52_req "Activation of the identifier 52" UBYTE _CNV_S_2_RANGE______3_CM 1 0. 0. 1. DISPLAY_IDENTIFIER Vbx_moni_xx_req[82] ECU_ADDRESS 0xd00040a2 BIT_MASK 0x1 /end MEASUREMENT
/begin MEASUREMENT Vbx_moni_xx_req[83] "Activation of the identifier 53" UBYTE _CNV_S_2_RANGE______3_CM 1 0. 0. 1. ECU_ADDRESS 0xd00040a3 BIT_MASK 0x1 /end MEASUREMENT
/begin MEASUREMENT Vbx_moni_xx_req[84] "Activation of the identifier 54" UBYTE _CNV_S_2_RANGE______3_CM 1 0. 0. 1. ECU_ADDRESS 0xd00040a4 BIT_MASK 0x1 /end MEASUREMENT
/begin MEASUREMENT Vbx_moni_xx_req[85] "Activation of the identifier 55" UBYTE _CNV_S_2_RANGE______3_CM 1 0. 0. 1. ECU_ADDRESS 0xd00040a5 BIT_MASK 0x1 /end MEASUREMENT
/begin MEASUREMENT Vbx_moni_xx_req[86] "Activation of the identifier 56" UBYTE _CNV_S_2_RANGE______3_CM 1 0. 0. 1. ECU_ADDRESS 0xd00040a6 BIT_MASK 0x1 /end MEASUREMENT
/begin MEASUREMENT Vbx_moni_xx_req[87] "Activation of the identifier 57" UBYTE _CNV_S_2_RANGE______3_CM 1 0. 0. 1. ECU_ADDRESS 0xd00040a7 BIT_MASK 0x1 /end MEASUREMENT
/begin MEASUREMENT Vbx_moni_xx_req[88] "Activation of the identifier 58" UBYTE _CNV_S_2_RANGE______3_CM 1 0. 0. 1. ECU_ADDRESS 0xd00040a8 BIT_MASK 0x1 /end MEASUREMENT
/begin MEASUREMENT Vbx_moni_xx_req[89] "Activation of the identifier 59" UBYTE _CNV_S_2_RANGE______3_CM 1 0. 0. 1. ECU_ADDRESS 0xd00040a9 BIT_MASK 0x1 /end MEASUREMENT
/begin MEASUREMENT Vbx_moni_xx_req[90] "Activation of the identifier 5a" UBYTE _CNV_S_2_RANGE______3_CM 1 0. 0. 1. ECU_ADDRESS 0xd00040aa BIT_MASK 0x1 /end MEASUREMENT
/begin MEASUREMENT Vbx_moni_xx_req[91] "Activation of the identifier 5b" UBYTE _CNV_S_2_RANGE______3_CM 1 0. 0. 1. ECU_ADDRESS 0xd00040ab BIT_MASK 0x1 /end MEASUREMENT
/begin MEASUREMENT Vbx_moni_xx_req[92] "Activation of the identifier 5c" UBYTE _CNV_S_2_RANGE______3_CM 1 0. 0. 1. ECU_ADDRESS 0xd00040ac BIT_MASK 0x1 /end MEASUREMENT
/begin MEASUREMENT Vbx_moni_xx_req[93] "Activation of the identifier 5d" UBYTE _CNV_S_2_RANGE______3_CM 1 0. 0. 1. ECU_ADDRESS 0xd00040ad BIT_MASK 0x1 /end MEASUREMENT
/begin MEASUREMENT Vbx_moni_xx_req[94] "Activation of the identifier 5e" UBYTE _CNV_S_2_RANGE______3_CM 1 0. 0. 1. ECU_ADDRESS 0xd00040ae BIT_MASK 0x1 /end MEASUREMENT
/begin MEASUREMENT Vbx_moni_xx_req[95] "Activation of the identifier 5f" UBYTE _CNV_S_2_RANGE______3_CM 1 0. 0. 1. ECU_ADDRESS 0xd00040af BIT_MASK 0x1 /end MEASUREMENT
/begin MEASUREMENT Vbx_byp_60_req "Activation of the identifier 60" UBYTE _CNV_S_2_RANGE______3_CM 1 0. 0. 1. DISPLAY_IDENTIFIER Vbx_moni_xx_req[96] ECU_ADDRESS 0xd00040b0 BIT_MASK 0x1 /end MEASUREMENT
/begin MEASUREMENT Vbx_byp_61_req "Activation of the identifier 61" UBYTE _CNV_S_2_RANGE______3_CM 1 0. 0. 1. DISPLAY_IDENTIFIER Vbx_moni_xx_req[97] ECU_ADDRESS 0xd00040b1 BIT_MASK 0x1 /end MEASUREMENT
/begin MEASUREMENT Vbx_byp_62_req "Activation of the identifier 62" UBYTE _CNV_S_2_RANGE______3_CM 1 0. 0. 1. DISPLAY_IDENTIFIER Vbx_moni_xx_req[98] ECU_ADDRESS 0xd00040b2 BIT_MASK 0x1 /end MEASUREMENT
/begin MEASUREMENT Vbx_byp_63_req "Activation of the identifier 63" UBYTE _CNV_S_2_RANGE______3_CM 1 0. 0. 1. DISPLAY_IDENTIFIER Vbx_moni_xx_req[99] ECU_ADDRESS 0xd00040b3 BIT_MASK 0x1 /end MEASUREMENT
/begin MEASUREMENT Vbx_byp_64_req "Activation of the identifier 64" UBYTE _CNV_S_2_RANGE______3_CM 1 0. 0. 1. DISPLAY_IDENTIFIER Vbx_moni_xx_req[100] ECU_ADDRESS 0xd00040b4 BIT_MASK 0x1 /end MEASUREMENT
/begin MEASUREMENT Vbx_byp_65_req "Activation of the identifier 65" UBYTE _CNV_S_2_RANGE______3_CM 1 0. 0. 1. DISPLAY_IDENTIFIER Vbx_moni_xx_req[101] ECU_ADDRESS 0xd00040b5 BIT_MASK 0x1 /end MEASUREMENT
/begin MEASUREMENT Vbx_byp_66_req "Activation of the identifier 66" UBYTE _CNV_S_2_RANGE______3_CM 1 0. 0. 1. DISPLAY_IDENTIFIER Vbx_moni_xx_req[102] ECU_ADDRESS 0xd00040b6 BIT_MASK 0x1 /end MEASUREMENT
/begin MEASUREMENT Vbx_byp_67_req "Activation of the identifier 67" UBYTE _CNV_S_2_RANGE______3_CM 1 0. 0. 1. DISPLAY_IDENTIFIER Vbx_moni_xx_req[103] ECU_ADDRESS 0xd00040b7 BIT_MASK 0x1 /end MEASUREMENT
/begin MEASUREMENT Vbx_byp_68_req "Activation of the identifier 68" UBYTE _CNV_S_2_RANGE______3_CM 1 0. 0. 1. DISPLAY_IDENTIFIER Vbx_moni_xx_req[104] ECU_ADDRESS 0xd00040b8 BIT_MASK 0x1 /end MEASUREMENT
/begin MEASUREMENT Vbx_byp_69_req "Activation of the identifier 69" UBYTE _CNV_S_2_RANGE______3_CM 1 0. 0. 1. DISPLAY_IDENTIFIER Vbx_moni_xx_req[105] ECU_ADDRESS 0xd00040b9 BIT_MASK 0x1 /end MEASUREMENT
/begin MEASUREMENT Vbx_byp_6a_req "Activation of the identifier 6a" UBYTE _CNV_S_2_RANGE______3_CM 1 0. 0. 1. DISPLAY_IDENTIFIER Vbx_moni_xx_req[106] ECU_ADDRESS 0xd00040ba BIT_MASK 0x1 /end MEASUREMENT
/begin MEASUREMENT Vbx_byp_6b_req "Activation of the identifier 6b" UBYTE _CNV_S_2_RANGE______3_CM 1 0. 0. 1. DISPLAY_IDENTIFIER Vbx_moni_xx_req[107] ECU_ADDRESS 0xd00040bb BIT_MASK 0x1 /end MEASUREMENT
/begin MEASUREMENT Vbx_byp_6c_req "Activation of the identifier 6c" UBYTE _CNV_S_2_RANGE______3_CM 1 0. 0. 1. DISPLAY_IDENTIFIER Vbx_moni_xx_req[108] ECU_ADDRESS 0xd00040bc BIT_MASK 0x1 /end MEASUREMENT
/begin MEASUREMENT Vbx_byp_6d_req "Activation of the identifier 6d" UBYTE _CNV_S_2_RANGE______3_CM 1 0. 0. 1. DISPLAY_IDENTIFIER Vbx_moni_xx_req[109] ECU_ADDRESS 0xd00040bd BIT_MASK 0x1 /end MEASUREMENT
/begin MEASUREMENT Vbx_byp_6e_req "Activation of the identifier 6e" UBYTE _CNV_S_2_RANGE______3_CM 1 0. 0. 1. DISPLAY_IDENTIFIER Vbx_moni_xx_req[110] ECU_ADDRESS 0xd00040be BIT_MASK 0x1 /end MEASUREMENT
/begin MEASUREMENT Vbx_byp_6f_req "Activation of the identifier 6f" UBYTE _CNV_S_2_RANGE______3_CM 1 0. 0. 1. DISPLAY_IDENTIFIER Vbx_moni_xx_req[111] ECU_ADDRESS 0xd00040bf BIT_MASK 0x1 /end MEASUREMENT
/begin MEASUREMENT Vbx_moni_xx_req[112] "Activation of the identifier 70" UBYTE _CNV_S_2_RANGE______3_CM 1 0. 0. 1. ECU_ADDRESS 0xd00040c0 BIT_MASK 0x1 /end MEASUREMENT
/begin MEASUREMENT Vbx_moni_xx_req[113] "Activation of the identifier 71" UBYTE _CNV_S_2_RANGE______3_CM 1 0. 0. 1. ECU_ADDRESS 0xd00040c1 BIT_MASK 0x1 /end MEASUREMENT
/begin MEASUREMENT Vbx_moni_xx_req[114] "Activation of the identifier 72" UBYTE _CNV_S_2_RANGE______3_CM 1 0. 0. 1. ECU_ADDRESS 0xd00040c2 BIT_MASK 0x1 /end MEASUREMENT
/begin MEASUREMENT Vbx_moni_xx_req[115] "Activation of the identifier 73" UBYTE _CNV_S_2_RANGE______3_CM 1 0. 0. 1. ECU_ADDRESS 0xd00040c3 BIT_MASK 0x1 /end MEASUREMENT
/begin MEASUREMENT Vbx_moni_xx_req[116] "Activation of the identifier 74" UBYTE _CNV_S_2_RANGE______3_CM 1 0. 0. 1. ECU_ADDRESS 0xd00040c4 BIT_MASK 0x1 /end MEASUREMENT
/begin MEASUREMENT Vbx_moni_xx_req[117] "Activation of the identifier 75" UBYTE _CNV_S_2_RANGE______3_CM 1 0. 0. 1. ECU_ADDRESS 0xd00040c5 BIT_MASK 0x1 /end MEASUREMENT
/begin MEASUREMENT Vbx_moni_xx_req[118] "Activation of the identifier 76" UBYTE _CNV_S_2_RANGE______3_CM 1 0. 0. 1. ECU_ADDRESS 0xd00040c6 BIT_MASK 0x1 /end MEASUREMENT
/begin MEASUREMENT Vbx_moni_xx_req[119] "Activation of the identifier 77" UBYTE _CNV_S_2_RANGE______3_CM 1 0. 0. 1. ECU_ADDRESS 0xd00040c7 BIT_MASK 0x1 /end MEASUREMENT
/begin MEASUREMENT Vbx_moni_xx_req[120] "Activation of the identifier 78" UBYTE _CNV_S_2_RANGE______3_CM 1 0. 0. 1. ECU_ADDRESS 0xd00040c8 BIT_MASK 0x1 /end MEASUREMENT
/begin MEASUREMENT Vbx_byp_79_req "Activation of the identifier 79" UBYTE _CNV_S_2_RANGE______3_CM 1 0. 0. 1. DISPLAY_IDENTIFIER Vbx_moni_xx_req[121] ECU_ADDRESS 0xd00040c9 BIT_MASK 0x1 /end MEASUREMENT
/begin MEASUREMENT Vxx_byp_06_sub_val "Replacement value requested to control identifier 06" UWORD _CNV_A_R_LINEAR_____467_CM 1 0. 0. 1. ECU_ADDRESS 0xd0003b56 FORMAT "%5.3" /end MEASUREMENT
/begin MEASUREMENT Vxx_byp_0a_sub_val "Replacement value requested by Monitool to control identifier 0a" UBYTE _CNV_S_2_RANGE______3_CM 1 0. 0. 1. ECU_ADDRESS 0xd00040ca BIT_MASK 0x1 /end MEASUREMENT
/begin MEASUREMENT Vxx_byp_19_sub_val "Replacement value requested to control identifier 19" UBYTE _CNV_A_R_LINEAR_____345_CM 1 0. 0. 100. ECU_ADDRESS 0xd00040cf FORMAT "%12.8" /end MEASUREMENT
/begin MEASUREMENT Vxx_byp_1c_sub_val "Replacement value requested to control identifier 1c" UWORD _CNV_A_R_LINEAR_____94_CM 1 0. 0. 200. ECU_ADDRESS 0xd0003b58 FORMAT "%6.2" /end MEASUREMENT
/begin MEASUREMENT Vxx_byp_2b_sub_val "Replacement value requested by Monitool to control identifier 2b" UBYTE _CNV_S_2_RANGE______3_CM 1 0. 0. 1. ECU_ADDRESS 0xd00040cb /end MEASUREMENT
/begin MEASUREMENT Vxx_byp_2c_sub_val "Replacement value requested to control identifier 2c" UWORD _CNV_A_R_LINEAR_____76_CM 1 0. 0. 720. ECU_ADDRESS 0xd0003b5a FORMAT "%5.2" /end MEASUREMENT
/begin MEASUREMENT Vxx_byp_2d_sub_val "Replacement value requested to control identifier 2d" UWORD _CNV_A_R_LINEAR_____94_CM 1 0. 0. 200. ECU_ADDRESS 0xd0003b5c FORMAT "%5.2" /end MEASUREMENT
/begin MEASUREMENT Vxx_byp_44_sub_val "Replacement value requested by Monitool to control identifier 44" UBYTE _CNV_S_2_RANGE______3_CM 1 0. 0. 1. ECU_ADDRESS 0xd00040cc BIT_MASK 0x1 /end MEASUREMENT
/begin MEASUREMENT Vxx_byp_46_sub_val "Replacement value requested by Monitool to control identifier 46" UBYTE _CNV_S_2_RANGE______3_CM 1 0. 0. 1. ECU_ADDRESS 0xd00040cd BIT_MASK 0x1 /end MEASUREMENT
/begin MEASUREMENT Vxx_byp_47_sub_val "Replacement value requested by Monitool to control identifier 47" UBYTE _CNV_S_2_RANGE______3_CM 1 0. 0. 1. ECU_ADDRESS 0xd00040ce BIT_MASK 0x1 /end MEASUREMENT
/begin MEASUREMENT Vxx_byp_51_sub_val "Replacement value requested by Monitool to control identifier 51" UBYTE _CNV_A_R_LINEAR_____114_CM 1 0. 0. 100. ECU_ADDRESS 0xd00040d0 FORMAT "%12.8" /end MEASUREMENT
/begin MEASUREMENT Vxx_byp_52_sub_val "Replacement value requested by Monitool to control identifier 52" UBYTE _CNV_A_R_LINEAR_____114_CM 1 0. 0. 100. ECU_ADDRESS 0xd00040d1 FORMAT "%12.8" /end MEASUREMENT
/begin MEASUREMENT Vxx_byp_60_sub_val "Replacement value requested by Monitool to control identifier 60" ULONG _CNV_A_R_LINEAR_____50_CM 1 0. 0. 500000. ECU_ADDRESS 0xd000243a FORMAT "%6.0" /end MEASUREMENT
/begin MEASUREMENT Vxx_byp_61_sub_val "Replacement value requested by Monitool to control identifier 61" ULONG _CNV_A_R_LINEAR_____50_CM 1 0. 0. 500000. ECU_ADDRESS 0xd000243e FORMAT "%6.0" /end MEASUREMENT
/begin MEASUREMENT Vxx_byp_62_sub_val "Replacement value requested by Monitool to control identifier 62" ULONG _CNV_A_R_LINEAR_____50_CM 1 0. 0. 500000. ECU_ADDRESS 0xd0002442 FORMAT "%6.0" /end MEASUREMENT
/begin MEASUREMENT Vxx_byp_63_sub_val "Replacement value requested by Monitool to control identifier 63" ULONG _CNV_A_R_LINEAR_____50_CM 1 0. 0. 500000. ECU_ADDRESS 0xd0002446 FORMAT "%6.0" /end MEASUREMENT
/begin MEASUREMENT Vxx_byp_64_sub_val "Replacement value requested by Monitool to control identifier 64" ULONG _CNV_A_R_LINEAR_____50_CM 1 0. 0. 500000. ECU_ADDRESS 0xd000244a FORMAT "%6.0" /end MEASUREMENT
/begin MEASUREMENT Vxx_byp_65_sub_val "Replacement value requested by Monitool to control identifier 65" ULONG _CNV_A_R_LINEAR_____50_CM 1 0. 0. 500000. ECU_ADDRESS 0xd000244e FORMAT "%6.0" /end MEASUREMENT
/begin MEASUREMENT Vxx_byp_66_sub_val "Replacement value requested by Monitool to control identifier 66" ULONG _CNV_A_R_LINEAR_____50_CM 1 0. 0. 500000. ECU_ADDRESS 0xd0002452 FORMAT "%6.0" /end MEASUREMENT
/begin MEASUREMENT Vxx_byp_67_sub_val "Replacement value requested by Monitool to control identifier 67" ULONG _CNV_A_R_LINEAR_____50_CM 1 0. 0. 500000. ECU_ADDRESS 0xd0002456 FORMAT "%6.0" /end MEASUREMENT
/begin MEASUREMENT Vxx_byp_68_sub_val "Replacement value requested by Monitool to control identifier 68" UBYTE _CNV_A_R_LINEAR_____264_CM 1 0. 0. 765. ECU_ADDRESS 0xd00040d2 FORMAT "%3.0" /end MEASUREMENT
/begin MEASUREMENT Vxx_byp_69_sub_val "Replacement value requested by Monitool to control identifier 69" UBYTE _CNV_A_R_LINEAR_____264_CM 1 0. 0. 765. ECU_ADDRESS 0xd00040d3 FORMAT "%3.0" /end MEASUREMENT
/begin MEASUREMENT Vxx_byp_6a_sub_val "Replacement value requested by Monitool to control identifier 6a" UBYTE _CNV_A_R_LINEAR_____264_CM 1 0. 0. 765. ECU_ADDRESS 0xd00040d4 FORMAT "%3.0" /end MEASUREMENT
/begin MEASUREMENT Vxx_byp_6b_sub_val "Replacement value requested by Monitool to control identifier 6b" UBYTE _CNV_A_R_LINEAR_____264_CM 1 0. 0. 765. ECU_ADDRESS 0xd00040d5 FORMAT "%3.0" /end MEASUREMENT
/begin MEASUREMENT Vxx_byp_6c_sub_val "Replacement value requested by Monitool to control identifier 6c" UBYTE _CNV_A_R_LINEAR_____264_CM 1 0. 0. 765. ECU_ADDRESS 0xd00040d6 FORMAT "%3.0" /end MEASUREMENT
/begin MEASUREMENT Vxx_byp_6d_sub_val "Replacement value requested by Monitool to control identifier 6d" UBYTE _CNV_A_R_LINEAR_____264_CM 1 0. 0. 765. ECU_ADDRESS 0xd00040d7 FORMAT "%3.0" /end MEASUREMENT
/begin MEASUREMENT Vxx_byp_6e_sub_val "Replacement value requested by Monitool to control identifier 6e" UBYTE _CNV_A_R_LINEAR_____264_CM 1 0. 0. 765. ECU_ADDRESS 0xd00040d8 FORMAT "%3.0" /end MEASUREMENT
/begin MEASUREMENT Vxx_byp_6f_sub_val "Replacement value requested by Monitool to control identifier 6f" UBYTE _CNV_A_R_LINEAR_____264_CM 1 0. 0. 765. ECU_ADDRESS 0xd00040d9 FORMAT "%3.0" /end MEASUREMENT
/begin MEASUREMENT Vxx_byp_79_sub_val "Replacement value requested by Monitool to control identifier 79" UWORD _CNV_A_R_LINEAR_____122_CM 1 0. 0. 100. ECU_ADDRESS 0xd0003b5e FORMAT "%12.8" /end MEASUREMENT
/begin MEASUREMENT Vxx_moni_id_01_sub_val "Replacement value requested by Monitool to control identifier 01" UWORD _CNV_A_R_ENSD_LINEA_24_CM 1 0. 0. 16383.75 ECU_ADDRESS 0xd0003b60 FORMAT "%8.2" /end MEASUREMENT
/begin CHARACTERISTIC Cxx_moni_id_01_max "Maximum value authorized for the replacement value of the identifier 01" VALUE 0xa0020f4e _REC_S1VAL_20_u2 16383.75 _CNV_A_R_ENSD_LINEA_24_CM 0. 16383.75 FORMAT "%8.2" /end CHARACTERISTIC
/begin CHARACTERISTIC Cxx_moni_id_01_min "Minimum value authorized for the replacement value of the identifier 01" VALUE 0xa0020f50 _REC_S1VAL_20_u2 16383.75 _CNV_A_R_ENSD_LINEA_24_CM 0. 16383.75 FORMAT "%8.2" /end CHARACTERISTIC
/begin CHARACTERISTIC Cxx_moni_id_06_max "Maximum value authorized for the replacement value of the identifier 06" VALUE 0xa0020f52 _REC_S1VAL_20_u2 1. _CNV_A_R_LINEAR_____467_CM 0. 1. FORMAT "%5.3" /end CHARACTERISTIC
/begin CHARACTERISTIC Cxx_moni_id_06_min "Minimum value authorized for the replacement value of the identifier 06" VALUE 0xa0020f54 _REC_S1VAL_20_u2 1. _CNV_A_R_LINEAR_____467_CM 0. 1. FORMAT "%5.3" /end CHARACTERISTIC
/begin CHARACTERISTIC Cxx_moni_id_0a_max "Maximum value authorized for the replacement value of the identifier 0a" VALUE 0xa0020fc6 _REC_S1VAL_20_u1 1. _CNV_S_2_RANGE______3_CM 0. 1. BIT_MASK 0x1 /end CHARACTERISTIC
/begin CHARACTERISTIC Cxx_moni_id_0a_min "Minimum value authorized for the replacement value of the identifier 0a" VALUE 0xa0020fc7 _REC_S1VAL_20_u1 1. _CNV_S_2_RANGE______3_CM 0. 1. BIT_MASK 0x1 /end CHARACTERISTIC
/begin CHARACTERISTIC Cxx_moni_id_19_max "Maximum value authorized for the replacement value of the identifier 19" VALUE 0xa0020fc8 _REC_S1VAL_20_u1 100. _CNV_A_R_LINEAR_____114_CM 0. 100. FORMAT "%12.8" /end CHARACTERISTIC
/begin CHARACTERISTIC Cxx_moni_id_19_min "Minimum value authorized for the replacement value of the identifier 19" VALUE 0xa0020fc9 _REC_S1VAL_20_u1 100. _CNV_A_R_LINEAR_____114_CM 0. 100. FORMAT "%12.8" /end CHARACTERISTIC
/begin CHARACTERISTIC Cxx_moni_id_1c_max "Maximum value authorized for the replacement value of the identifier 1c" VALUE 0xa0020f56 _REC_S1VAL_20_u2 200. _CNV_A_R_LINEAR_____94_CM 0. 200. FORMAT "%4.2" /end CHARACTERISTIC
/begin CHARACTERISTIC Cxx_moni_id_1c_min "Minimum value authorized for the replacement value of the identifier 1c" VALUE 0xa0020f58 _REC_S1VAL_20_u2 200. _CNV_A_R_LINEAR_____94_CM 0. 200. FORMAT "%4.2" /end CHARACTERISTIC
/begin CHARACTERISTIC Cxx_moni_id_2b_max "Maximum value authorized for the replacement value of the identifier 2b" VALUE 0xa0020fca _REC_S1VAL_20_u1 1. _CNV_S_2_RANGE______3_CM 0. 1. BIT_MASK 0x1 /end CHARACTERISTIC
/begin CHARACTERISTIC Cxx_moni_id_2b_min "Minimum value authorized for the replacement value of the identifier 2b" VALUE 0xa0020fcb _REC_S1VAL_20_u1 1. _CNV_S_2_RANGE______3_CM 0. 1. BIT_MASK 0x1 /end CHARACTERISTIC
/begin CHARACTERISTIC Cxx_moni_id_2c_max "Maximum value authorized for the replacement value of the identifier 2c" VALUE 0xa0020f5a _REC_S1VAL_20_u2 720. _CNV_A_R_LINEAR_____76_CM 0. 720. FORMAT "%5.2" /end CHARACTERISTIC
/begin CHARACTERISTIC Cxx_moni_id_2c_min "Minimum value authorized for the replacement value of the identifier 2c" VALUE 0xa0020f5c _REC_S1VAL_20_u2 720. _CNV_A_R_LINEAR_____76_CM 0. 720. FORMAT "%5.2" /end CHARACTERISTIC
/begin CHARACTERISTIC Cxx_moni_id_2d_max "Maximum value authorized for the replacement value of the identifier 2d" VALUE 0xa0020f5e _REC_S1VAL_20_u2 200. _CNV_A_R_LINEAR_____94_CM 0. 200. FORMAT "%5.2" /end CHARACTERISTIC
/begin CHARACTERISTIC Cxx_moni_id_2d_min "Minimum value authorized for the replacement value of the identifier 2d" VALUE 0xa0020f60 _REC_S1VAL_20_u2 200. _CNV_A_R_LINEAR_____94_CM 0. 200. FORMAT "%5.2" /end CHARACTERISTIC
/begin CHARACTERISTIC Cxx_moni_id_44_max "Maximum value authorized for the replacement value of the identifier 44" VALUE 0xa0020fcc _REC_S1VAL_20_u1 1. _CNV_S_2_RANGE______3_CM 0. 1. BIT_MASK 0x1 /end CHARACTERISTIC
/begin CHARACTERISTIC Cxx_moni_id_44_min "Minimum value authorized for the replacement value of the identifier 44" VALUE 0xa0020fcd _REC_S1VAL_20_u1 1. _CNV_S_2_RANGE______3_CM 0. 1. BIT_MASK 0x1 /end CHARACTERISTIC
/begin CHARACTERISTIC Cxx_moni_id_46_max "Maximum value authorized for the replacement value of the identifier 46" VALUE 0xa0020fce _REC_S1VAL_20_u1 1. _CNV_S_2_RANGE______3_CM 0. 1. BIT_MASK 0x1 /end CHARACTERISTIC
/begin CHARACTERISTIC Cxx_moni_id_46_min "Minimum value authorized for the replacement value of the identifier 46" VALUE 0xa0020fcf _REC_S1VAL_20_u1 1. _CNV_S_2_RANGE______3_CM 0. 1. BIT_MASK 0x1 /end CHARACTERISTIC
/begin CHARACTERISTIC Cxx_moni_id_47_max "Maximum value authorized for the replacement value of the identifier 47" VALUE 0xa0020fd0 _REC_S1VAL_20_u1 1. _CNV_S_2_RANGE______3_CM 0. 1. BIT_MASK 0x1 /end CHARACTERISTIC
/begin CHARACTERISTIC Cxx_moni_id_47_min "Minimum value authorized for the replacement value of the identifier 47" VALUE 0xa0020fd1 _REC_S1VAL_20_u1 1. _CNV_S_2_RANGE______3_CM 0. 1. BIT_MASK 0x1 /end CHARACTERISTIC
/begin CHARACTERISTIC Cxx_moni_id_51_max "Maximum value authorized for the replacement value of the identifier 51" VALUE 0xa0020fd2 _REC_S1VAL_20_u1 100. _CNV_A_R_LINEAR_____114_CM 0. 100. FORMAT "%12.8" /end CHARACTERISTIC
/begin CHARACTERISTIC Cxx_moni_id_51_min "Minimum value authorized for the replacement value of the identifier 51" VALUE 0xa0020fd3 _REC_S1VAL_20_u1 100. _CNV_A_R_LINEAR_____114_CM 0. 100. FORMAT "%12.8" /end CHARACTERISTIC
/begin CHARACTERISTIC Cxx_moni_id_52_max "Maximum value authorized for the replacement value of the identifier 52" VALUE 0xa0020fd4 _REC_S1VAL_20_u1 100. _CNV_A_R_LINEAR_____114_CM 0. 100. FORMAT "%12.8" /end CHARACTERISTIC
/begin CHARACTERISTIC Cxx_moni_id_52_min "Minimum value authorized for the replacement value of the identifier 52" VALUE 0xa0020fd5 _REC_S1VAL_20_u1 100. _CNV_A_R_LINEAR_____114_CM 0. 100. FORMAT "%12.8" /end CHARACTERISTIC
/begin CHARACTERISTIC Cxx_moni_id_60_max "Maximum value authorized for the replacement value of the identifier 60" VALUE 0xa0020f62 _REC_S1VAL_20_u4 500000. _CNV_A_R_LINEAR_____50_CM 0. 500000. FORMAT "%6.0" /end CHARACTERISTIC
/begin CHARACTERISTIC Cxx_moni_id_60_min "Minimum value authorized for the replacement value of the identifier 60" VALUE 0xa0020f66 _REC_S1VAL_20_u4 500000. _CNV_A_R_LINEAR_____50_CM 0. 500000. FORMAT "%6.0" /end CHARACTERISTIC
/begin CHARACTERISTIC Cxx_moni_id_61_max "Maximum value authorized for the replacement value of the identifier 61" VALUE 0xa0020f6a _REC_S1VAL_20_u4 500000. _CNV_A_R_LINEAR_____50_CM 0. 500000. FORMAT "%6.0" /end CHARACTERISTIC
/begin CHARACTERISTIC Cxx_moni_id_61_min "Minimum value authorized for the replacement value of the identifier 61" VALUE 0xa0020f6e _REC_S1VAL_20_u4 500000. _CNV_A_R_LINEAR_____50_CM 0. 500000. FORMAT "%6.0" /end CHARACTERISTIC
/begin CHARACTERISTIC Cxx_moni_id_62_max "Maximum value authorized for the replacement value of the identifier 62" VALUE 0xa0020f72 _REC_S1VAL_20_u4 500000. _CNV_A_R_LINEAR_____50_CM 0. 500000. FORMAT "%6.0" /end CHARACTERISTIC
/begin CHARACTERISTIC Cxx_moni_id_62_min "Minimum value authorized for the replacement value of the identifier 62" VALUE 0xa0020f76 _REC_S1VAL_20_u4 500000. _CNV_A_R_LINEAR_____50_CM 0. 500000. FORMAT "%6.0" /end CHARACTERISTIC
/begin CHARACTERISTIC Cxx_moni_id_63_max "Maximum value authorized for the replacement value of the identifier 63" VALUE 0xa0020f7a _REC_S1VAL_20_u4 500000. _CNV_A_R_LINEAR_____50_CM 0. 500000. FORMAT "%6.0" /end CHARACTERISTIC
/begin CHARACTERISTIC Cxx_moni_id_63_min "Minimum value authorized for the replacement value of the identifier 63" VALUE 0xa0020f7e _REC_S1VAL_20_u4 500000. _CNV_A_R_LINEAR_____50_CM 0. 500000. FORMAT "%6.0" /end CHARACTERISTIC
/begin CHARACTERISTIC Cxx_moni_id_64_max "Maximum value authorized for the replacement value of the identifier 64" VALUE 0xa0020f82 _REC_S1VAL_20_u4 500000. _CNV_A_R_LINEAR_____50_CM 0. 500000. FORMAT "%6.0" /end CHARACTERISTIC
/begin CHARACTERISTIC Cxx_moni_id_64_min "Minimum value authorized for the replacement value of the identifier 64" VALUE 0xa0020f86 _REC_S1VAL_20_u4 500000. _CNV_A_R_LINEAR_____50_CM 0. 500000. FORMAT "%6.0" /end CHARACTERISTIC
/begin CHARACTERISTIC Cxx_moni_id_65_max "Maximum value authorized for the replacement value of the identifier 65" VALUE 0xa0020f8a _REC_S1VAL_20_u4 500000. _CNV_A_R_LINEAR_____50_CM 0. 500000. FORMAT "%6.0" /end CHARACTERISTIC
/begin CHARACTERISTIC Cxx_moni_id_65_min "Minimum value authorized for the replacement value of the identifier 65" VALUE 0xa0020f8e _REC_S1VAL_20_u4 500000. _CNV_A_R_LINEAR_____50_CM 0. 500000. FORMAT "%6.0" /end CHARACTERISTIC
/begin CHARACTERISTIC Cxx_moni_id_66_max "Maximum value authorized for the replacement value of the identifier 66" VALUE 0xa0020f92 _REC_S1VAL_20_u4 500000. _CNV_A_R_LINEAR_____50_CM 0. 500000. FORMAT "%6.0" /end CHARACTERISTIC
/begin CHARACTERISTIC Cxx_moni_id_66_min "Minimum value authorized for the replacement value of the identifier 66" VALUE 0xa0020f96 _REC_S1VAL_20_u4 500000. _CNV_A_R_LINEAR_____50_CM 0. 500000. FORMAT "%6.0" /end CHARACTERISTIC
/begin CHARACTERISTIC Cxx_moni_id_67_max "Maximum value authorized for the replacement value of the identifier 67" VALUE 0xa0020f9a _REC_S1VAL_20_u4 500000. _CNV_A_R_LINEAR_____50_CM 0. 500000. FORMAT "%6.0" /end CHARACTERISTIC
/begin CHARACTERISTIC Cxx_moni_id_67_min "Minimum value authorized for the replacement value of the identifier 67" VALUE 0xa0020f9e _REC_S1VAL_20_u4 500000. _CNV_A_R_LINEAR_____50_CM 0. 500000. FORMAT "%6.0" /end CHARACTERISTIC
/begin CHARACTERISTIC Cxx_moni_id_68_max "Maximum value authorized for the replacement value of the identifier 68" VALUE 0xa0020fa2 _REC_S1VAL_20_u2 765. _CNV_A_R_LINEAR_____264_CM 0. 765. FORMAT "%3.0" /end CHARACTERISTIC
/begin CHARACTERISTIC Cxx_moni_id_68_min "Minimum value authorized for the replacement value of the identifier 68" VALUE 0xa0020fa4 _REC_S1VAL_20_u2 765. _CNV_A_R_LINEAR_____264_CM 0. 765. FORMAT "%3.0" /end CHARACTERISTIC
/begin CHARACTERISTIC Cxx_moni_id_69_max "Maximum value authorized for the replacement value of the identifier 69" VALUE 0xa0020fa6 _REC_S1VAL_20_u2 765. _CNV_A_R_LINEAR_____264_CM 0. 765. FORMAT "%3.0" /end CHARACTERISTIC
/begin CHARACTERISTIC Cxx_moni_id_69_min "Minimum value authorized for the replacement value of the identifier 69" VALUE 0xa0020fa8 _REC_S1VAL_20_u2 765. _CNV_A_R_LINEAR_____264_CM 0. 765. FORMAT "%3.0" /end CHARACTERISTIC
/begin CHARACTERISTIC Cxx_moni_id_6a_max "Maximum value authorized for the replacement value of the identifier 6a" VALUE 0xa0020faa _REC_S1VAL_20_u2 765. _CNV_A_R_LINEAR_____264_CM 0. 765. FORMAT "%3.0" /end CHARACTERISTIC
/begin CHARACTERISTIC Cxx_moni_id_6a_min "Minimum value authorized for the replacement value of the identifier 6a" VALUE 0xa0020fac _REC_S1VAL_20_u2 765. _CNV_A_R_LINEAR_____264_CM 0. 765. FORMAT "%3.0" /end CHARACTERISTIC
/begin CHARACTERISTIC Cxx_moni_id_6b_max "Maximum value authorized for the replacement value of the identifier 6b" VALUE 0xa0020fae _REC_S1VAL_20_u2 765. _CNV_A_R_LINEAR_____264_CM 0. 765. FORMAT "%3.0" /end CHARACTERISTIC
/begin CHARACTERISTIC Cxx_moni_id_6b_min "Minimum value authorized for the replacement value of the identifier 6b" VALUE 0xa0020fb0 _REC_S1VAL_20_u2 765. _CNV_A_R_LINEAR_____264_CM 0. 765. FORMAT "%3.0" /end CHARACTERISTIC
/begin CHARACTERISTIC Cxx_moni_id_6c_max "Maximum value authorized for the replacement value of the identifier 6c" VALUE 0xa0020fb2 _REC_S1VAL_20_u2 765. _CNV_A_R_LINEAR_____264_CM 0. 765. FORMAT "%3.0" /end CHARACTERISTIC
/begin CHARACTERISTIC Cxx_moni_id_6c_min "Minimum value authorized for the replacement value of the identifier 6c" VALUE 0xa0020fb4 _REC_S1VAL_20_u2 765. _CNV_A_R_LINEAR_____264_CM 0. 765. FORMAT "%3.0" /end CHARACTERISTIC
/begin CHARACTERISTIC Cxx_moni_id_6d_max "Maximum value authorized for the replacement value of the identifier 6d" VALUE 0xa0020fb6 _REC_S1VAL_20_u2 765. _CNV_A_R_LINEAR_____264_CM 0. 765. FORMAT "%3.0" /end CHARACTERISTIC
/begin CHARACTERISTIC Cxx_moni_id_6d_min "Minimum value authorized for the replacement value of the identifier 6d" VALUE 0xa0020fb8 _REC_S1VAL_20_u2 765. _CNV_A_R_LINEAR_____264_CM 0. 765. FORMAT "%3.0" /end CHARACTERISTIC
/begin CHARACTERISTIC Cxx_moni_id_6e_max "Maximum value authorized for the replacement value of the identifier 6e" VALUE 0xa0020fba _REC_S1VAL_20_u2 765. _CNV_A_R_LINEAR_____264_CM 0. 765. FORMAT "%3.0" /end CHARACTERISTIC
/begin CHARACTERISTIC Cxx_moni_id_6e_min "Minimum value authorized for the replacement value of the identifier 6e" VALUE 0xa0020fbc _REC_S1VAL_20_u2 765. _CNV_A_R_LINEAR_____264_CM 0. 765. FORMAT "%3.0" /end CHARACTERISTIC
/begin CHARACTERISTIC Cxx_moni_id_6f_max "Maximum value authorized for the replacement value of the identifier 6f" VALUE 0xa0020fbe _REC_S1VAL_20_u2 765. _CNV_A_R_LINEAR_____264_CM 0. 765. FORMAT "%3.0" /end CHARACTERISTIC
/begin CHARACTERISTIC Cxx_moni_id_6f_min "Minimum value authorized for the replacement value of the identifier 6f" VALUE 0xa0020fc0 _REC_S1VAL_20_u2 765. _CNV_A_R_LINEAR_____264_CM 0. 765. FORMAT "%3.0" /end CHARACTERISTIC
/begin CHARACTERISTIC Cxx_moni_id_79_max "Maximum value authorized for the replacement value of the identifier 79" VALUE 0xa0020fc2 _REC_S1VAL_20_u2 100. _CNV_A_R_LINEAR_____122_CM 0. 100. FORMAT "%12.8" /end CHARACTERISTIC
/begin CHARACTERISTIC Cxx_moni_id_79_min "Minimum value authorized for the replacement value of the identifier 79" VALUE 0xa0020fc4 _REC_S1VAL_20_u2 100. _CNV_A_R_LINEAR_____122_CM 0. 100. FORMAT "%12.8" /end CHARACTERISTIC
/begin MEASUREMENT Vxx_ext_ctrl_eng_test_sf "External controls denial engine status flags" UWORD _CNV_A_R_ECME_LINEA_0_CM 1 0. 0. 65535. ECU_ADDRESS 0xd0002cc0 FORMAT "%5.0" /end MEASUREMENT
/begin CHARACTERISTIC Cbx_ext_ctrl_sens_spg_dsb "Disable (for naturally aspirated engines) external controls condition on boost pressure" VALUE 0xa0021344 _REC_S1VAL_20_u1 1. _CNV_S_2_RANGE______3_CM 0. 1. /end CHARACTERISTIC
/begin CHARACTERISTIC Cxx_ext_ctrl_max_n "Max engine speed for external controls" VALUE 0xa002133c _REC_S1VAL_20_u2 16383.75 _CNV_A_R_ENSD_LINEA_24_CM 0. 16383.75 FORMAT "%8.2" /end CHARACTERISTIC
/begin CHARACTERISTIC Cxx_ext_ctrl_sens_spg_max "Maximum boost pressure measurement for external controls operation" VALUE 0xa002133e _REC_S1VAL_20_u2 20000. _CNV_A_R_LINEAR_____57_CM 0. 20000. FORMAT "%5.0" /end CHARACTERISTIC
/begin CHARACTERISTIC Cxx_ext_ctrl_sens_spg_max_t "Filtration time of boost overpressure pressure for external controls operation" VALUE 0xa0021340 _REC_S1VAL_20_u2 65.535 _CNV_A_R_LINEAR_____58_CM 0. 65.535 /end CHARACTERISTIC
/begin CHARACTERISTIC Cxx_ext_ctrl_sens_tco_max "Maximum engine coolant temperature (sensor) for external controls operation" VALUE 0xa0021342 _REC_S1VAL_20_u2 240. _CNV_A_R_LINEAR_____54_CM -40. 200. FORMAT "%5.1" /end CHARACTERISTIC
/begin MEASUREMENT Vbx_ext_ctrl_test_act "External controls tests activation" UBYTE _CNV_S_2_RANGE______3_CM 1 0. 0. 1. ECU_ADDRESS 0xd0004309 BIT_MASK 0x1 /end MEASUREMENT
/begin MEASUREMENT Vbx_ext_ctrl_ena "External controls safety authorization flag" UBYTE _CNV_S_2_RANGE______3_CM 1 0. 0. 1. ECU_ADDRESS 0xd0004efc BIT_MASK 0x1 /end MEASUREMENT
/begin MEASUREMENT Vxx_ext_ctrl_test_sf "External controls denial status flags" UWORD _CNV_A_R_ECME_LINEA_0_CM 1 0. 0. 65535. ECU_ADDRESS 0xc0000ba6 FORMAT "%5.0" /end MEASUREMENT
/begin CHARACTERISTIC Cbx_ext_ctrl_hot_test_vh_cdn_dsb "Disable vehicle safety conditions for external controls" VALUE 0xa0020e82 _REC_S1VAL_20_u1 1. _CNV_S_2_RANGE______3_CM 0. 1. BIT_MASK 0x1 /end CHARACTERISTIC
/begin CHARACTERISTIC Cbx_ext_ctrl_pdl_cdn_ena "Enable pedals safety conditions for external controls" VALUE 0xa0020e83 _REC_S1VAL_20_u1 1. _CNV_S_2_RANGE______3_CM 0. 1. BIT_MASK 0x1 /end CHARACTERISTIC
/begin CHARACTERISTIC Cxx_ext_ctrl_acel_pdl_rat_thd "Accelerator pedal foot-off ratio threshold for external controls" VALUE 0xa0020e80 _REC_S1VAL_20_u2 1.25 _CNV_A_R_LINEAR_____211_CM 0. 1.25 FORMAT "%7.5" /end CHARACTERISTIC
/begin CHARACTERISTIC Cxx_ext_ctrl_vs_thd "Vehicle speed threshold to authorize external controls operation." VALUE 0xa0020e84 _REC_S1VAL_20_u1 255. _CNV_A_R_LINEAR_____212_CM 0. 255. FORMAT "%3.0" /end CHARACTERISTIC
/begin MEASUREMENT Vbx_clock "Indicates if the number of the request (tool) is the same as the ECU" UBYTE _CNV_S_2_RANGE______3_CM 1 0. 0. 1. ECU_ADDRESS 0xd00047eb BIT_MASK 0x1 /end MEASUREMENT
/begin MEASUREMENT Vbx_com_err "Flag indicates if there is a security timeout or security clock problem" UBYTE _CNV_S_2_RANGE______3_CM 1 0. 0. 1. ECU_ADDRESS 0xd00047ec BIT_MASK 0x1 /end MEASUREMENT
/begin MEASUREMENT Vbx_diag_sta_moni_abrt "Monitool eabort" UBYTE _CNV_S_2_RANGE______3_CM 1 0. 0. 1. ECU_ADDRESS 0xd00047ed BIT_MASK 0x1 /end MEASUREMENT
/begin MEASUREMENT Vbx_diag_sta_moni_ena "Communication layer is authorizing Monitool" UBYTE _CNV_S_2_RANGE______3_CM 1 0. 0. 1. ECU_ADDRESS 0xd00047ee BIT_MASK 0x1 /end MEASUREMENT
/begin MEASUREMENT Vbx_diag_sta_moni_end "Monitool end" UBYTE _CNV_S_2_RANGE______3_CM 1 0. 0. 1. ECU_ADDRESS 0xd00047ef BIT_MASK 0x1 /end MEASUREMENT
/begin MEASUREMENT Vbx_init_timeout "New timeout initialization requested" UBYTE _CNV_S_2_RANGE______3_CM 1 0. 0. 1. ECU_ADDRESS 0xd00047f0 BIT_MASK 0x1 /end MEASUREMENT
/begin MEASUREMENT Vbx_moni_appl_err "Applicative error flag" UBYTE _CNV_S_2_RANGE______3_CM 1 0. 0. 1. ECU_ADDRESS 0xd00047f1 BIT_MASK 0x1 /end MEASUREMENT
/begin MEASUREMENT Vbx_moni_dbl_nok "Indicates if an identifier is duplicated in the request" UBYTE _CNV_S_2_RANGE______3_CM 1 0. 0. 1. ECU_ADDRESS 0xd00047f2 BIT_MASK 0x1 /end MEASUREMENT
/begin MEASUREMENT Vbx_moni_id_nok "Indicates if the requested identifiers are not ok (not supported or duplicated)" UBYTE _CNV_S_2_RANGE______3_CM 1 0. 0. 1. ECU_ADDRESS 0xd00047f3 BIT_MASK 0x1 /end MEASUREMENT
/begin MEASUREMENT Vbx_moni_nr_tot_id_nok "Indicates if the number of the requested identifiers is higher than 15" UBYTE _CNV_S_2_RANGE______3_CM 1 0. 0. 1. ECU_ADDRESS 0xd00047f4 BIT_MASK 0x1 /end MEASUREMENT
/begin MEASUREMENT Vbx_moni_oor "Indicates whether at least a replacement value requested for a component is out of range" UBYTE _CNV_S_2_RANGE______3_CM 1 0. 0. 1. ECU_ADDRESS 0xd00047f5 BIT_MASK 0x1 /end MEASUREMENT
/begin MEASUREMENT Vbx_moni_read_req_done "Indicates when the data extraction is finished" UBYTE _CNV_S_2_RANGE______3_CM 1 0. 0. 1. ECU_ADDRESS 0xd00047f6 BIT_MASK 0x1 /end MEASUREMENT
/begin MEASUREMENT Vbx_moni_req_analyse "Trigger request analyse" UBYTE _CNV_S_2_RANGE______3_CM 1 0. 0. 1. ECU_ADDRESS 0xd00047f7 BIT_MASK 0x1 /end MEASUREMENT
/begin MEASUREMENT Vbx_moni_req_data_changed "Request changed" UBYTE _CNV_S_2_RANGE______3_CM 1 0. 0. 1. ECU_ADDRESS 0xd00047f8 BIT_MASK 0x1 /end MEASUREMENT
/begin MEASUREMENT Vbx_moni_stop_diag "Monitool requests to stop all required diagnostics" UBYTE _CNV_S_2_RANGE______3_CM 1 0. 0. 1. ECU_ADDRESS 0xd00056b7 BIT_MASK 0x1 /end MEASUREMENT
/begin MEASUREMENT Vsx_diag_sta_moni_stt "Monitool routine status" UBYTE _CNV_A_R_ECME_LINEA_0_CM 1 0. 0. 255. ECU_ADDRESS 0xd00047f9 FORMAT "%3.0" /end MEASUREMENT
/begin MEASUREMENT Vxx_clock_ecu "Number of the trame in ECU" UBYTE _CNV_A_R_ECME_LINEA_0_CM 1 0. 0. 255. ECU_ADDRESS 0xd00047fa FORMAT "%3.0" /end MEASUREMENT
/begin MEASUREMENT Vxx_clock_init_timeout "Byte 5 of the request" UBYTE _CNV_A_R_ECME_LINEA_0_CM 1 0. 0. 255. ECU_ADDRESS 0xd00047fb FORMAT "%3.0" /end MEASUREMENT
/begin MEASUREMENT Vxx_moni_nr_tot_id "Number of identifiers in the request" UBYTE _CNV_A_R_ECME_LINEA_0_CM 1 0. 0. 255. ECU_ADDRESS 0xd00047fc FORMAT "%3.0" /end MEASUREMENT
/begin MEASUREMENT Vxx_moni_sf_spv "Monitool supervisor status byte" UBYTE _CNV_A_R_ECME_LINEA_0_CM 1 0. 0. 255. ECU_ADDRESS 0xd00047fd FORMAT "%3.0" /end MEASUREMENT
/begin MEASUREMENT Vxx_timeout "Byte 4 of the request" UBYTE _CNV_A_R_ECME_LINEA_0_CM 1 0. 0. 255. ECU_ADDRESS 0xd00047fe FORMAT "%3.0" /end MEASUREMENT
/begin CHARACTERISTIC Cxx_moni_stop_diag_dly "Delay between Monitool deactivation and diagnosis reactivation" VALUE 0xa0021948 _REC_S1VAL_20_u1 255. _CNV_A_R_ECME_LINEA_0_CM 0. 255. FORMAT "%3.0" /end CHARACTERISTIC
/begin MEASUREMENT Vbx_rout_run_stt "Routine running state (1=one routine running 0=no routine running)" UBYTE _CNV_S_2_RANGE______3_CM 1 0. 0. 1. ECU_ADDRESS 0xd0005033 BIT_MASK 0x1 /end MEASUREMENT
/begin MEASUREMENT Vbx_start_cdn "Routine start condtions satisfied (1=satisfied 0=not satisfied)" UBYTE _CNV_S_2_RANGE______3_CM 1 0. 0. 1. ECU_ADDRESS 0xd0005034 BIT_MASK 0x1 /end MEASUREMENT
/begin MEASUREMENT Vbx_stop_cdn "Routine stop condtions satisfied (1=satisfied 0=not satisfied)" UBYTE _CNV_S_2_RANGE______3_CM 1 0. 0. 1. ECU_ADDRESS 0xd0005035 BIT_MASK 0x1 /end MEASUREMENT
/begin MEASUREMENT Vbx_valid_req "Tool request validity (1=valid request 0=invalid request)" UBYTE _CNV_S_2_RANGE______3_CM 1 0. 0. 1. ECU_ADDRESS 0xd0005036 BIT_MASK 0x1 /end MEASUREMENT
/begin CHARACTERISTIC Cbx_diag_in_vvtc_ena_cam_crk_df "VVTC (aftersales) actuation tests allowd with detected failure on camshaft or crankshaft sensors" VALUE 0xa0021db4 _REC_S1VAL_20_u1 1. _CNV_S_2_RANGE______3_CM 0. 1. BIT_MASK 0x1 /end CHARACTERISTIC
/begin CHARACTERISTIC Cxx_diag_ffig_it_psn_min "Minimum ilet throttle measured position to allow ffig routine call" VALUE 0xa0021da6 _REC_S1VAL_20_u2 100. _CNV_A_R_LINEAR_____99_CM 0. 100. FORMAT "%6.2" /end CHARACTERISTIC
/begin CHARACTERISTIC Cxx_diag_in_vvtc_tco_max "Maximum engine coolant temperature to allow VVT aftersales routine execution" VALUE 0xa0021da8 _REC_S1VAL_20_u2 240. _CNV_A_R_LINEAR_____54_CM -40. 200. FORMAT "%5.1" /end CHARACTERISTIC
/begin CHARACTERISTIC Cxx_diag_in_vvtc_tco_min "Minimum engine coolant temperature to allow VVT aftersales routine execution" VALUE 0xa0021daa _REC_S1VAL_20_u2 240. _CNV_A_R_LINEAR_____54_CM -40. 200. FORMAT "%5.1" /end CHARACTERISTIC
/begin CHARACTERISTIC Cxx_diag_in_vvtc_toil_max "Maximum oil temperature to allow VVT aftersales routine execution" VALUE 0xa0021dac _REC_S1VAL_20_u2 240. _CNV_A_R_LINEAR_____54_CM -40. 200. FORMAT "%5.1" /end CHARACTERISTIC
/begin CHARACTERISTIC Cxx_diag_in_vvtc_toil_min "Minimum oil temperature to allow VVT aftersales routine execution" VALUE 0xa0021dae _REC_S1VAL_20_u2 240. _CNV_A_R_LINEAR_____54_CM -40. 200. FORMAT "%5.1" /end CHARACTERISTIC
/begin CHARACTERISTIC Cxx_diag_in_vvtc_vb_max "Maximum battery voltage to allow VVT aftersales routine execution" VALUE 0xa0021db0 _REC_S1VAL_20_u2 60. _CNV_A_R_LINEAR_____150_CM 0. 60. FORMAT "%5.2" /end CHARACTERISTIC
/begin CHARACTERISTIC Cxx_diag_in_vvtc_vb_min "Minimum battery voltage to allow VVT aftersales routine execution" VALUE 0xa0021db2 _REC_S1VAL_20_u2 60. _CNV_A_R_LINEAR_____150_CM 0. 60. FORMAT "%5.2" /end CHARACTERISTIC
/begin CHARACTERISTIC Cxx_tac_tini_io_01 "Initialization time for an I/O control test of gazoline electronic throttle" VALUE 0xa0027ba8 _REC_S1VAL_20_u2 65.535 _CNV_A_R_LINEAR_____58_CM 0. 65.535 DISPLAY_IDENTIFIER Tac_cal_set_01.Cxx_tac_tini_io_xx FORMAT "%5.3" /end CHARACTERISTIC
/begin CHARACTERISTIC Cxx_tac_ton_io_01 "Activation time for an I/O control test of gazoline electronic throttle" VALUE 0xa0027baa _REC_S1VAL_20_u2 65.535 _CNV_A_R_LINEAR_____58_CM 0. 65.535 DISPLAY_IDENTIFIER Tac_cal_set_01.Cxx_tac_ton_io_xx FORMAT "%5.3" /end CHARACTERISTIC
/begin CHARACTERISTIC Cxx_tac_toff_io_01 "Deactivation time for an I/O control test of gazoline electronic throttle" VALUE 0xa0027bac _REC_S1VAL_20_u2 65.535 _CNV_A_R_LINEAR_____58_CM 0. 65.535 DISPLAY_IDENTIFIER Tac_cal_set_01.Cxx_tac_toff_io_xx FORMAT "%5.3" /end CHARACTERISTIC
/begin CHARACTERISTIC Cxx_tac_tini_stac_01 "Initialization time for a static test of gazoline electronic throttle" VALUE 0xa0027bae _REC_S1VAL_20_u2 65.535 _CNV_A_R_LINEAR_____58_CM 0. 65.535 DISPLAY_IDENTIFIER Tac_cal_set_01.Cxx_tac_tini_stac_xx FORMAT "%5.3" /end CHARACTERISTIC
/begin CHARACTERISTIC Cxx_tac_ton_stac_01 "Activation time for a static test of gazoline electronic throttle" VALUE 0xa0027bb0 _REC_S1VAL_20_u2 65.535 _CNV_A_R_LINEAR_____58_CM 0. 65.535 DISPLAY_IDENTIFIER Tac_cal_set_01.Cxx_tac_ton_stac_xx FORMAT "%5.3" /end CHARACTERISTIC
/begin CHARACTERISTIC Cxx_tac_toff_stac_01 "Deactivation time for a static test of gazoline electronic throttle" VALUE 0xa0027bb2 _REC_S1VAL_20_u2 65.535 _CNV_A_R_LINEAR_____58_CM 0. 65.535 DISPLAY_IDENTIFIER Tac_cal_set_01.Cxx_tac_toff_stac_xx FORMAT "%5.3" /end CHARACTERISTIC
/begin CHARACTERISTIC Cxx_tac_von_io_01 "Higher substitution value for an I/O control test of gazoline electronic throttle" VALUE 0xa0027bb4 _REC_S1VAL_20_u2 200. _CNV_A_R_LINEAR_____94_CM 0. 200. DISPLAY_IDENTIFIER Tac_cal_set_01.Cxx_tac_von_io_xx FORMAT "%6.2" /end CHARACTERISTIC
/begin CHARACTERISTIC Cxx_tac_voff_io_01 "Lower substitution value for an I/O control test of gazoline electronic throttle" VALUE 0xa0027bb6 _REC_S1VAL_20_u2 200. _CNV_A_R_LINEAR_____94_CM 0. 200. DISPLAY_IDENTIFIER Tac_cal_set_01.Cxx_tac_voff_io_xx FORMAT "%6.2" /end CHARACTERISTIC
/begin CHARACTERISTIC Cxx_tac_von_stac_01 "Higher substitution value for the static test of gazoline electronic throttle" VALUE 0xa0027bb8 _REC_S1VAL_20_u2 200. _CNV_A_R_LINEAR_____94_CM 0. 200. DISPLAY_IDENTIFIER Tac_cal_set_01.Cxx_tac_von_stac_xx FORMAT "%6.2" /end CHARACTERISTIC
/begin CHARACTERISTIC Cxx_tac_voff_stac_01 "Lower substitution value for the static test of gazoline electronic throttle" VALUE 0xa0027bba _REC_S1VAL_20_u2 200. _CNV_A_R_LINEAR_____94_CM 0. 200. DISPLAY_IDENTIFIER Tac_cal_set_01.Cxx_tac_voff_stac_xx FORMAT "%6.2" /end CHARACTERISTIC
/begin CHARACTERISTIC Cxx_tac_nc_io_01 "Number of cycles to complete the I/O control test of gazoline electronic throttle" VALUE 0xa0027bbc _REC_S1VAL_20_u1 255. _CNV_A_R_ECME_LINEA_0_CM 0. 255. DISPLAY_IDENTIFIER Tac_cal_set_01.Cxx_tac_nc_io_xx FORMAT "%3.0" /end CHARACTERISTIC
/begin CHARACTERISTIC Cxx_tac_tini_io_02 "Initialization time for an I/O control test of fuel pump and its relay" VALUE 0xa0027bc0 _REC_S1VAL_20_u2 65.535 _CNV_A_R_LINEAR_____58_CM 0. 65.535 DISPLAY_IDENTIFIER Tac_cal_set_02.Cxx_tac_tini_io_xx FORMAT "%5.3" /end CHARACTERISTIC
/begin CHARACTERISTIC Cxx_tac_ton_io_02 "Activation time for an I/O control test of fuel pump and its relay" VALUE 0xa0027bc2 _REC_S1VAL_20_u2 65.535 _CNV_A_R_LINEAR_____58_CM 0. 65.535 DISPLAY_IDENTIFIER Tac_cal_set_02.Cxx_tac_ton_io_xx FORMAT "%5.3" /end CHARACTERISTIC
/begin CHARACTERISTIC Cxx_tac_toff_io_02 "Deactivation time for an I/O control test of fuel pump and its relay" VALUE 0xa0027bc4 _REC_S1VAL_20_u2 65.535 _CNV_A_R_LINEAR_____58_CM 0. 65.535 DISPLAY_IDENTIFIER Tac_cal_set_02.Cxx_tac_toff_io_xx FORMAT "%5.3" /end CHARACTERISTIC
/begin CHARACTERISTIC Cxx_tac_tini_stac_02 "Initialization time for a static test of fuel pump and its relay" VALUE 0xa0027bc6 _REC_S1VAL_20_u2 65.535 _CNV_A_R_LINEAR_____58_CM 0. 65.535 DISPLAY_IDENTIFIER Tac_cal_set_02.Cxx_tac_tini_stac_xx FORMAT "%5.3" /end CHARACTERISTIC
/begin CHARACTERISTIC Cxx_tac_ton_stac_02 "Activation time for a static test of fuel pump and its relay" VALUE 0xa0027bc8 _REC_S1VAL_20_u2 65.535 _CNV_A_R_LINEAR_____58_CM 0. 65.535 DISPLAY_IDENTIFIER Tac_cal_set_02.Cxx_tac_ton_stac_xx FORMAT "%5.3" /end CHARACTERISTIC
/begin CHARACTERISTIC Cxx_tac_toff_stac_02 "Deactivation time for a static test of fuel pump and its relay" VALUE 0xa0027bca _REC_S1VAL_20_u2 65.535 _CNV_A_R_LINEAR_____58_CM 0. 65.535 DISPLAY_IDENTIFIER Tac_cal_set_02.Cxx_tac_toff_stac_xx FORMAT "%5.3" /end CHARACTERISTIC
/begin CHARACTERISTIC Cxx_tac_nc_io_02 "Number of cycles to complete the I/O control test of fuel pump or its relay" VALUE 0xa0027bd4 _REC_S1VAL_20_u1 255. _CNV_A_R_ECME_LINEA_0_CM 0. 255. DISPLAY_IDENTIFIER Tac_cal_set_02.Cxx_tac_nc_io_xx FORMAT "%3.0" /end CHARACTERISTIC
/begin CHARACTERISTIC Cxx_tac_tini_io_03 "Initialization time for an I/O control test of FAN1 and its relay" VALUE 0xa0027bd8 _REC_S1VAL_20_u2 65.535 _CNV_A_R_LINEAR_____58_CM 0. 65.535 DISPLAY_IDENTIFIER Tac_cal_set_03.Cxx_tac_tini_io_xx FORMAT "%5.3" /end CHARACTERISTIC
/begin CHARACTERISTIC Cxx_tac_ton_io_03 "Activation time for an I/O control test of FAN1 and its relay" VALUE 0xa0027bda _REC_S1VAL_20_u2 65.535 _CNV_A_R_LINEAR_____58_CM 0. 65.535 DISPLAY_IDENTIFIER Tac_cal_set_03.Cxx_tac_ton_io_xx FORMAT "%5.3" /end CHARACTERISTIC
/begin CHARACTERISTIC Cxx_tac_toff_io_03 "Deactivation time for an I/O control test of FAN1 and its relay" VALUE 0xa0027bdc _REC_S1VAL_20_u2 65.535 _CNV_A_R_LINEAR_____58_CM 0. 65.535 DISPLAY_IDENTIFIER Tac_cal_set_03.Cxx_tac_toff_io_xx FORMAT "%5.3" /end CHARACTERISTIC
/begin CHARACTERISTIC Cxx_tac_tini_stac_03 "Initialization time for a static test of FAN1 and its relay" VALUE 0xa0027bde _REC_S1VAL_20_u2 65.535 _CNV_A_R_LINEAR_____58_CM 0. 65.535 DISPLAY_IDENTIFIER Tac_cal_set_03.Cxx_tac_tini_stac_xx FORMAT "%5.3" /end CHARACTERISTIC
/begin CHARACTERISTIC Cxx_tac_ton_stac_03 "Activation time for a static test of FAN1 and its relay" VALUE 0xa0027be0 _REC_S1VAL_20_u2 65.535 _CNV_A_R_LINEAR_____58_CM 0. 65.535 DISPLAY_IDENTIFIER Tac_cal_set_03.Cxx_tac_ton_stac_xx FORMAT "%5.3" /end CHARACTERISTIC
/begin CHARACTERISTIC Cxx_tac_toff_stac_03 "Deactivation time for a static test of FAN1 and its relay" VALUE 0xa0027be2 _REC_S1VAL_20_u2 65.535 _CNV_A_R_LINEAR_____58_CM 0. 65.535 DISPLAY_IDENTIFIER Tac_cal_set_03.Cxx_tac_toff_stac_xx FORMAT "%5.3" /end CHARACTERISTIC
/begin CHARACTERISTIC Cxx_tac_nc_io_03 "Number of cycles to complete the I/O control test of FAN1 or its relay" VALUE 0xa0027bec _REC_S1VAL_20_u1 255. _CNV_A_R_ECME_LINEA_0_CM 0. 255. DISPLAY_IDENTIFIER Tac_cal_set_03.Cxx_tac_nc_io_xx FORMAT "%3.0" /end CHARACTERISTIC
/begin CHARACTERISTIC Cxx_tac_tini_io_04 "Initialization time for an I/O control test of FAN2 and its relay" VALUE 0xa0027bf0 _REC_S1VAL_20_u2 65.535 _CNV_A_R_LINEAR_____58_CM 0. 65.535 DISPLAY_IDENTIFIER Tac_cal_set_04.Cxx_tac_tini_io_xx FORMAT "%5.3" /end CHARACTERISTIC
/begin CHARACTERISTIC Cxx_tac_ton_io_04 "Activation time for an I/O control test of FAN2 and its relay" VALUE 0xa0027bf2 _REC_S1VAL_20_u2 65.535 _CNV_A_R_LINEAR_____58_CM 0. 65.535 DISPLAY_IDENTIFIER Tac_cal_set_04.Cxx_tac_ton_io_xx FORMAT "%5.3" /end CHARACTERISTIC
/begin CHARACTERISTIC Cxx_tac_toff_io_04 "Deactivation time for an I/O control test of FAN2 and its relay" VALUE 0xa0027bf4 _REC_S1VAL_20_u2 65.535 _CNV_A_R_LINEAR_____58_CM 0. 65.535 DISPLAY_IDENTIFIER Tac_cal_set_04.Cxx_tac_toff_io_xx FORMAT "%5.3" /end CHARACTERISTIC
/begin CHARACTERISTIC Cxx_tac_tini_stac_04 "Initialization time for a static test of FAN2 and its relay" VALUE 0xa0027bf6 _REC_S1VAL_20_u2 65.535 _CNV_A_R_LINEAR_____58_CM 0. 65.535 DISPLAY_IDENTIFIER Tac_cal_set_04.Cxx_tac_tini_stac_xx FORMAT "%5.3" /end CHARACTERISTIC
/begin CHARACTERISTIC Cxx_tac_ton_stac_04 "Activation time for a static test of FAN2 and its relay" VALUE 0xa0027bf8 _REC_S1VAL_20_u2 65.535 _CNV_A_R_LINEAR_____58_CM 0. 65.535 DISPLAY_IDENTIFIER Tac_cal_set_04.Cxx_tac_ton_stac_xx FORMAT "%5.3" /end CHARACTERISTIC
/begin CHARACTERISTIC Cxx_tac_toff_stac_04 "Deactivation time for a static test of FAN2 and its relay" VALUE 0xa0027bfa _REC_S1VAL_20_u2 65.535 _CNV_A_R_LINEAR_____58_CM 0. 65.535 DISPLAY_IDENTIFIER Tac_cal_set_04.Cxx_tac_toff_stac_xx FORMAT "%5.3" /end CHARACTERISTIC
/begin CHARACTERISTIC Cxx_tac_nc_io_04 "Number of cycles to complete the I/O control test of FAN2 or its relay" VALUE 0xa0027c04 _REC_S1VAL_20_u1 255. _CNV_A_R_ECME_LINEA_0_CM 0. 255. DISPLAY_IDENTIFIER Tac_cal_set_04.Cxx_tac_nc_io_xx FORMAT "%3.0" /end CHARACTERISTIC
/begin CHARACTERISTIC Cxx_tac_tini_io_05 "Initialization time for an I/O control test of electronic water pump for turbocharger cooling" VALUE 0xa0027c08 _REC_S1VAL_20_u2 65.535 _CNV_A_R_LINEAR_____58_CM 0. 65.535 DISPLAY_IDENTIFIER Tac_cal_set_05.Cxx_tac_tini_io_xx FORMAT "%5.3" /end CHARACTERISTIC
/begin CHARACTERISTIC Cxx_tac_ton_io_05 "Activation time for an I/O control test of electronic water pump for turbocharger cooling" VALUE 0xa0027c0a _REC_S1VAL_20_u2 65.535 _CNV_A_R_LINEAR_____58_CM 0. 65.535 DISPLAY_IDENTIFIER Tac_cal_set_05.Cxx_tac_ton_io_xx FORMAT "%5.3" /end CHARACTERISTIC
/begin CHARACTERISTIC Cxx_tac_toff_io_05 "Deactivation time for an I/O control test of electronic water pump for turbocharger cooling" VALUE 0xa0027c0c _REC_S1VAL_20_u2 65.535 _CNV_A_R_LINEAR_____58_CM 0. 65.535 DISPLAY_IDENTIFIER Tac_cal_set_05.Cxx_tac_toff_io_xx FORMAT "%5.3" /end CHARACTERISTIC
/begin CHARACTERISTIC Cxx_tac_tini_stac_05 "Initialization time for a static test of electronic water pump for turbocharger cooling" VALUE 0xa0027c0e _REC_S1VAL_20_u2 65.535 _CNV_A_R_LINEAR_____58_CM 0. 65.535 DISPLAY_IDENTIFIER Tac_cal_set_05.Cxx_tac_tini_stac_xx FORMAT "%5.3" /end CHARACTERISTIC
/begin CHARACTERISTIC Cxx_tac_ton_stac_05 "Activation time for a static test of electronic water pump for turbocharger cooling" VALUE 0xa0027c10 _REC_S1VAL_20_u2 65.535 _CNV_A_R_LINEAR_____58_CM 0. 65.535 DISPLAY_IDENTIFIER Tac_cal_set_05.Cxx_tac_ton_stac_xx FORMAT "%5.3" /end CHARACTERISTIC
/begin CHARACTERISTIC Cxx_tac_toff_stac_05 "Deactivation time for a static test of electronic water pump for turbocharger cooling" VALUE 0xa0027c12 _REC_S1VAL_20_u2 65.535 _CNV_A_R_LINEAR_____58_CM 0. 65.535 DISPLAY_IDENTIFIER Tac_cal_set_05.Cxx_tac_toff_stac_xx FORMAT "%5.3" /end CHARACTERISTIC
/begin CHARACTERISTIC Cxx_tac_nc_io_05 "Number of cycles to complete the I/O control test of electronic water pump for turbocharger cooling" VALUE 0xa0027c1c _REC_S1VAL_20_u1 255. _CNV_A_R_ECME_LINEA_0_CM 0. 255. DISPLAY_IDENTIFIER Tac_cal_set_05.Cxx_tac_nc_io_xx FORMAT "%3.0" /end CHARACTERISTIC
/begin CHARACTERISTIC Cxx_tac_tini_io_06 "Initialization time for an I/O control test of defrosting PTC" VALUE 0xa0027c20 _REC_S1VAL_20_u2 65.535 _CNV_A_R_LINEAR_____58_CM 0. 65.535 DISPLAY_IDENTIFIER Tac_cal_set_06.Cxx_tac_tini_io_xx FORMAT "%5.3" /end CHARACTERISTIC
/begin CHARACTERISTIC Cxx_tac_ton_io_06 "Activation time for an I/O control test of defrosting PTC" VALUE 0xa0027c22 _REC_S1VAL_20_u2 65.535 _CNV_A_R_LINEAR_____58_CM 0. 65.535 DISPLAY_IDENTIFIER Tac_cal_set_06.Cxx_tac_ton_io_xx FORMAT "%5.3" /end CHARACTERISTIC
/begin CHARACTERISTIC Cxx_tac_toff_io_06 "Deactivation time for an I/O control test of defrosting PTC" VALUE 0xa0027c24 _REC_S1VAL_20_u2 65.535 _CNV_A_R_LINEAR_____58_CM 0. 65.535 DISPLAY_IDENTIFIER Tac_cal_set_06.Cxx_tac_toff_io_xx FORMAT "%5.3" /end CHARACTERISTIC
/begin CHARACTERISTIC Cxx_tac_tini_stac_06 "Initialization time for a static test of defrosting PTC" VALUE 0xa0027c26 _REC_S1VAL_20_u2 65.535 _CNV_A_R_LINEAR_____58_CM 0. 65.535 DISPLAY_IDENTIFIER Tac_cal_set_06.Cxx_tac_tini_stac_xx FORMAT "%5.3" /end CHARACTERISTIC
/begin CHARACTERISTIC Cxx_tac_ton_stac_06 "Activation time for a static test of defrosting PTC" VALUE 0xa0027c28 _REC_S1VAL_20_u2 65.535 _CNV_A_R_LINEAR_____58_CM 0. 65.535 DISPLAY_IDENTIFIER Tac_cal_set_06.Cxx_tac_ton_stac_xx FORMAT "%5.3" /end CHARACTERISTIC
/begin CHARACTERISTIC Cxx_tac_toff_stac_06 "Deactivation time for a static test of defrosting PTC" VALUE 0xa0027c2a _REC_S1VAL_20_u2 65.535 _CNV_A_R_LINEAR_____58_CM 0. 65.535 DISPLAY_IDENTIFIER Tac_cal_set_06.Cxx_tac_toff_stac_xx FORMAT "%5.3" /end CHARACTERISTIC
/begin CHARACTERISTIC Cxx_tac_nc_io_06 "Number of cycles to complete the I/O control test of defrosting PTC" VALUE 0xa0027c34 _REC_S1VAL_20_u1 255. _CNV_A_R_ECME_LINEA_0_CM 0. 255. DISPLAY_IDENTIFIER Tac_cal_set_06.Cxx_tac_nc_io_xx FORMAT "%3.0" /end CHARACTERISTIC
/begin CHARACTERISTIC Cxx_tac_tini_io_07 "Initialization time for an I/O control test of VVT control solenoid" VALUE 0xa0027c38 _REC_S1VAL_20_u2 65.535 _CNV_A_R_LINEAR_____58_CM 0. 65.535 DISPLAY_IDENTIFIER Tac_cal_set_07.Cxx_tac_tini_io_xx FORMAT "%5.3" /end CHARACTERISTIC
/begin CHARACTERISTIC Cxx_tac_ton_io_07 "Activation time for an I/O control test of VVT control solenoid" VALUE 0xa0027c3a _REC_S1VAL_20_u2 65.535 _CNV_A_R_LINEAR_____58_CM 0. 65.535 DISPLAY_IDENTIFIER Tac_cal_set_07.Cxx_tac_ton_io_xx FORMAT "%5.3" /end CHARACTERISTIC
/begin CHARACTERISTIC Cxx_tac_toff_io_07 "Deactivation time for an I/O control test of VVT control solenoid" VALUE 0xa0027c3c _REC_S1VAL_20_u2 65.535 _CNV_A_R_LINEAR_____58_CM 0. 65.535 DISPLAY_IDENTIFIER Tac_cal_set_07.Cxx_tac_toff_io_xx FORMAT "%5.3" /end CHARACTERISTIC
/begin CHARACTERISTIC Cxx_tac_tini_stac_07 "Initialization time for a static test of VVT control solenoid" VALUE 0xa0027c3e _REC_S1VAL_20_u2 65.535 _CNV_A_R_LINEAR_____58_CM 0. 65.535 DISPLAY_IDENTIFIER Tac_cal_set_07.Cxx_tac_tini_stac_xx FORMAT "%5.3" /end CHARACTERISTIC
/begin CHARACTERISTIC Cxx_tac_ton_stac_07 "Activation time for a static test of VVT control solenoid" VALUE 0xa0027c40 _REC_S1VAL_20_u2 65.535 _CNV_A_R_LINEAR_____58_CM 0. 65.535 DISPLAY_IDENTIFIER Tac_cal_set_07.Cxx_tac_ton_stac_xx FORMAT "%5.3" /end CHARACTERISTIC
/begin CHARACTERISTIC Cxx_tac_toff_stac_07 "Deactivation time for a static test of VVT control solenoid" VALUE 0xa0027c42 _REC_S1VAL_20_u2 65.535 _CNV_A_R_LINEAR_____58_CM 0. 65.535 DISPLAY_IDENTIFIER Tac_cal_set_07.Cxx_tac_toff_stac_xx FORMAT "%5.3" /end CHARACTERISTIC
/begin CHARACTERISTIC Cxx_tac_von_io_07 "Higher substitution value for an I/O control test of VVT control solenoid" VALUE 0xa0027c44 _REC_S1VAL_20_u2 200. _CNV_A_R_LINEAR_____94_CM 0. 200. DISPLAY_IDENTIFIER Tac_cal_set_07.Cxx_tac_von_io_xx FORMAT "%6.2" /end CHARACTERISTIC
/begin CHARACTERISTIC Cxx_tac_voff_io_07 "Lower substitution value for an I/O control test of VVT control solenoid" VALUE 0xa0027c46 _REC_S1VAL_20_u2 200. _CNV_A_R_LINEAR_____94_CM 0. 200. DISPLAY_IDENTIFIER Tac_cal_set_07.Cxx_tac_voff_io_xx FORMAT "%6.2" /end CHARACTERISTIC
/begin CHARACTERISTIC Cxx_tac_von_stac_07 "Higher substitution value for the static test of VVT control solenoid" VALUE 0xa0027c48 _REC_S1VAL_20_u2 200. _CNV_A_R_LINEAR_____94_CM 0. 200. DISPLAY_IDENTIFIER Tac_cal_set_07.Cxx_tac_von_stac_xx FORMAT "%6.2" /end CHARACTERISTIC
/begin CHARACTERISTIC Cxx_tac_voff_stac_07 "Lower substitution value for the static test of VVT control solenoid" VALUE 0xa0027c4a _REC_S1VAL_20_u2 200. _CNV_A_R_LINEAR_____94_CM 0. 200. DISPLAY_IDENTIFIER Tac_cal_set_07.Cxx_tac_voff_stac_xx FORMAT "%6.2" /end CHARACTERISTIC
/begin CHARACTERISTIC Cxx_tac_nc_io_07 "Number of cycles to complete the I/O control test of VVT control solenoid" VALUE 0xa0027c4c _REC_S1VAL_20_u1 255. _CNV_A_R_ECME_LINEA_0_CM 0. 255. DISPLAY_IDENTIFIER Tac_cal_set_07.Cxx_tac_nc_io_xx FORMAT "%3.0" /end CHARACTERISTIC
/begin CHARACTERISTIC Cxx_tac_tini_io_08 "Initialization time for an I/O control test of gazoline turbocharger command valve" VALUE 0xa0027c50 _REC_S1VAL_20_u2 65.535 _CNV_A_R_LINEAR_____58_CM 0. 65.535 DISPLAY_IDENTIFIER Tac_cal_set_08.Cxx_tac_tini_io_xx FORMAT "%5.3" /end CHARACTERISTIC
/begin CHARACTERISTIC Cxx_tac_ton_io_08 "Activation time for an I/O control test of gazoline turbocharger command valve" VALUE 0xa0027c52 _REC_S1VAL_20_u2 65.535 _CNV_A_R_LINEAR_____58_CM 0. 65.535 DISPLAY_IDENTIFIER Tac_cal_set_08.Cxx_tac_ton_io_xx FORMAT "%5.3" /end CHARACTERISTIC
/begin CHARACTERISTIC Cxx_tac_toff_io_08 "Deactivation time for an I/O control test of gazoline turbocharger command valve" VALUE 0xa0027c54 _REC_S1VAL_20_u2 65.535 _CNV_A_R_LINEAR_____58_CM 0. 65.535 DISPLAY_IDENTIFIER Tac_cal_set_08.Cxx_tac_toff_io_xx FORMAT "%5.3" /end CHARACTERISTIC
/begin CHARACTERISTIC Cxx_tac_tini_stac_08 "Initialization time for a static test of gazoline turbocharger command valve" VALUE 0xa0027c56 _REC_S1VAL_20_u2 65.535 _CNV_A_R_LINEAR_____58_CM 0. 65.535 DISPLAY_IDENTIFIER Tac_cal_set_08.Cxx_tac_tini_stac_xx FORMAT "%5.3" /end CHARACTERISTIC
/begin CHARACTERISTIC Cxx_tac_ton_stac_08 "Activation time for a static test of gazoline turbocharger command valve" VALUE 0xa0027c58 _REC_S1VAL_20_u2 65.535 _CNV_A_R_LINEAR_____58_CM 0. 65.535 DISPLAY_IDENTIFIER Tac_cal_set_08.Cxx_tac_ton_stac_xx FORMAT "%5.3" /end CHARACTERISTIC
/begin CHARACTERISTIC Cxx_tac_toff_stac_08 "Deactivation time for a static test of gazoline turbocharger command valve" VALUE 0xa0027c5a _REC_S1VAL_20_u2 65.535 _CNV_A_R_LINEAR_____58_CM 0. 65.535 DISPLAY_IDENTIFIER Tac_cal_set_08.Cxx_tac_toff_stac_xx FORMAT "%5.3" /end CHARACTERISTIC
/begin CHARACTERISTIC Cxx_tac_von_io_08 "Higher substitution value for an I/O control test of gazoline turbocharger command valve" VALUE 0xa0027c5c _REC_S1VAL_20_u2 100. _CNV_A_R_LINEAR_____114_CM 0. 100. DISPLAY_IDENTIFIER Tac_cal_set_08.Cxx_tac_von_io_xx FORMAT "%6.2" /end CHARACTERISTIC
/begin CHARACTERISTIC Cxx_tac_voff_io_08 "Lower substitution value for an I/O control test of gazoline turbocharger command valve" VALUE 0xa0027c5e _REC_S1VAL_20_u2 100. _CNV_A_R_LINEAR_____114_CM 0. 100. DISPLAY_IDENTIFIER Tac_cal_set_08.Cxx_tac_voff_io_xx FORMAT "%6.2" /end CHARACTERISTIC
/begin CHARACTERISTIC Cxx_tac_von_stac_08 "Higher substitution value for the static test of gazoline turbocharger command valve" VALUE 0xa0027c60 _REC_S1VAL_20_u2 100. _CNV_A_R_LINEAR_____114_CM 0. 100. DISPLAY_IDENTIFIER Tac_cal_set_08.Cxx_tac_von_stac_xx FORMAT "%6.2" /end CHARACTERISTIC
/begin CHARACTERISTIC Cxx_tac_voff_stac_08 "Lower substitution value for the static test of gazoline turbocharger command valve" VALUE 0xa0027c62 _REC_S1VAL_20_u2 100. _CNV_A_R_LINEAR_____114_CM 0. 100. DISPLAY_IDENTIFIER Tac_cal_set_08.Cxx_tac_voff_stac_xx FORMAT "%6.2" /end CHARACTERISTIC
/begin CHARACTERISTIC Cxx_tac_nc_io_08 "Number of cycles to complete the I/O control test of gazoline turbocharger command valve" VALUE 0xa0027c64 _REC_S1VAL_20_u1 255. _CNV_A_R_ECME_LINEA_0_CM 0. 255. DISPLAY_IDENTIFIER Tac_cal_set_08.Cxx_tac_nc_io_xx FORMAT "%3.0" /end CHARACTERISTIC
/begin CHARACTERISTIC Cxx_tac_tini_io_09 "Initialization time for an I/O control test of upstream oxygen lamda sensor (heater)" VALUE 0xa0027c68 _REC_S1VAL_20_u2 65.535 _CNV_A_R_LINEAR_____58_CM 0. 65.535 DISPLAY_IDENTIFIER Tac_cal_set_09.Cxx_tac_tini_io_xx FORMAT "%5.3" /end CHARACTERISTIC
/begin CHARACTERISTIC Cxx_tac_ton_io_09 "Activation time for an I/O control test of upstream oxygen lamda sensor (heater)" VALUE 0xa0027c6a _REC_S1VAL_20_u2 65.535 _CNV_A_R_LINEAR_____58_CM 0. 65.535 DISPLAY_IDENTIFIER Tac_cal_set_09.Cxx_tac_ton_io_xx FORMAT "%5.3" /end CHARACTERISTIC
/begin CHARACTERISTIC Cxx_tac_toff_io_09 "Deactivation time for an I/O control test of upstream oxygen lamda sensor (heater)" VALUE 0xa0027c6c _REC_S1VAL_20_u2 65.535 _CNV_A_R_LINEAR_____58_CM 0. 65.535 DISPLAY_IDENTIFIER Tac_cal_set_09.Cxx_tac_toff_io_xx FORMAT "%5.3" /end CHARACTERISTIC
/begin CHARACTERISTIC Cxx_tac_tini_stac_09 "Initialization time for a static test of upstream oxygen lamda sensor (heater)" VALUE 0xa0027c6e _REC_S1VAL_20_u2 65.535 _CNV_A_R_LINEAR_____58_CM 0. 65.535 DISPLAY_IDENTIFIER Tac_cal_set_09.Cxx_tac_tini_stac_xx FORMAT "%5.3" /end CHARACTERISTIC
/begin CHARACTERISTIC Cxx_tac_ton_stac_09 "Activation time for a static test of upstream oxygen lamda sensor (heater)" VALUE 0xa0027c70 _REC_S1VAL_20_u2 65.535 _CNV_A_R_LINEAR_____58_CM 0. 65.535 DISPLAY_IDENTIFIER Tac_cal_set_09.Cxx_tac_ton_stac_xx FORMAT "%5.3" /end CHARACTERISTIC
/begin CHARACTERISTIC Cxx_tac_toff_stac_09 "Deactivation time for a static test of upstream oxygen lamda sensor (heater)" VALUE 0xa0027c72 _REC_S1VAL_20_u2 65.535 _CNV_A_R_LINEAR_____58_CM 0. 65.535 DISPLAY_IDENTIFIER Tac_cal_set_09.Cxx_tac_toff_stac_xx FORMAT "%5.3" /end CHARACTERISTIC
/begin CHARACTERISTIC Cxx_tac_von_io_09 "Higher substitution value for an I/O control test of upstream oxygen lambda sensor (heater)" VALUE 0xa0027c74 _REC_S1VAL_20_u2 100. _CNV_A_R_LINEAR_____114_CM 0. 100. DISPLAY_IDENTIFIER Tac_cal_set_09.Cxx_tac_von_io_xx FORMAT "%6.2" /end CHARACTERISTIC
/begin CHARACTERISTIC Cxx_tac_voff_io_09 "Lower substitution value for an I/O control test of upstream oxygen lamda sensor (heater)" VALUE 0xa0027c76 _REC_S1VAL_20_u2 100. _CNV_A_R_LINEAR_____114_CM 0. 100. DISPLAY_IDENTIFIER Tac_cal_set_09.Cxx_tac_voff_io_xx FORMAT "%6.2" /end CHARACTERISTIC
/begin CHARACTERISTIC Cxx_tac_von_stac_09 "Higher substitution value for the static test of upstream oxygen lamda sensor (heater)" VALUE 0xa0027c78 _REC_S1VAL_20_u2 100. _CNV_A_R_LINEAR_____114_CM 0. 100. DISPLAY_IDENTIFIER Tac_cal_set_09.Cxx_tac_von_stac_xx FORMAT "%6.2" /end CHARACTERISTIC
/begin CHARACTERISTIC Cxx_tac_voff_stac_09 "Lower substitution value for the static test of upstream oxygen lamda sensor (heater)" VALUE 0xa0027c7a _REC_S1VAL_20_u2 100. _CNV_A_R_LINEAR_____114_CM 0. 100. DISPLAY_IDENTIFIER Tac_cal_set_09.Cxx_tac_voff_stac_xx FORMAT "%6.2" /end CHARACTERISTIC
/begin CHARACTERISTIC Cxx_tac_nc_io_09 "Number of cycles to complete the I/O control test of upstream oxygen lamda sensor (heater)" VALUE 0xa0027c7c _REC_S1VAL_20_u1 255. _CNV_A_R_ECME_LINEA_0_CM 0. 255. DISPLAY_IDENTIFIER Tac_cal_set_09.Cxx_tac_nc_io_xx FORMAT "%3.0" /end CHARACTERISTIC
/begin CHARACTERISTIC Cxx_tac_tini_io_10 "Initialization time for an I/O control test of downstream oxygen lamda sensor (heater)" VALUE 0xa0027c80 _REC_S1VAL_20_u2 65.535 _CNV_A_R_LINEAR_____58_CM 0. 65.535 DISPLAY_IDENTIFIER Tac_cal_set_10.Cxx_tac_tini_io_xx FORMAT "%5.3" /end CHARACTERISTIC
/begin CHARACTERISTIC Cxx_tac_ton_io_10 "Activation time for an I/O control test of downstream oxygen lamda sensor (heater)" VALUE 0xa0027c82 _REC_S1VAL_20_u2 65.535 _CNV_A_R_LINEAR_____58_CM 0. 65.535 DISPLAY_IDENTIFIER Tac_cal_set_10.Cxx_tac_ton_io_xx FORMAT "%5.3" /end CHARACTERISTIC
/begin CHARACTERISTIC Cxx_tac_toff_io_10 "Deactivation time for an I/O control test of downstream oxygen lamda sensor (heater)" VALUE 0xa0027c84 _REC_S1VAL_20_u2 65.535 _CNV_A_R_LINEAR_____58_CM 0. 65.535 DISPLAY_IDENTIFIER Tac_cal_set_10.Cxx_tac_toff_io_xx FORMAT "%5.3" /end CHARACTERISTIC
/begin CHARACTERISTIC Cxx_tac_tini_stac_10 "Initialization time for a static test of downstream oxygen lamda sensor (heater)" VALUE 0xa0027c86 _REC_S1VAL_20_u2 65.535 _CNV_A_R_LINEAR_____58_CM 0. 65.535 DISPLAY_IDENTIFIER Tac_cal_set_10.Cxx_tac_tini_stac_xx FORMAT "%5.3" /end CHARACTERISTIC
/begin CHARACTERISTIC Cxx_tac_ton_stac_10 "Activation time for a static test of downstream oxygen lamda sensor (heater)" VALUE 0xa0027c88 _REC_S1VAL_20_u2 65.535 _CNV_A_R_LINEAR_____58_CM 0. 65.535 DISPLAY_IDENTIFIER Tac_cal_set_10.Cxx_tac_ton_stac_xx FORMAT "%5.3" /end CHARACTERISTIC
/begin CHARACTERISTIC Cxx_tac_toff_stac_10 "Deactivation time for a static test of downstream oxygen lamda sensor (heater)" VALUE 0xa0027c8a _REC_S1VAL_20_u2 65.535 _CNV_A_R_LINEAR_____58_CM 0. 65.535 DISPLAY_IDENTIFIER Tac_cal_set_10.Cxx_tac_toff_stac_xx FORMAT "%5.3" /end CHARACTERISTIC
/begin CHARACTERISTIC Cxx_tac_von_io_10 "Higher substitution value for an I/O control test of downstream oxygen lamda sensor (heater)" VALUE 0xa0027c8c _REC_S1VAL_20_u2 100. _CNV_A_R_LINEAR_____114_CM 0. 100. DISPLAY_IDENTIFIER Tac_cal_set_10.Cxx_tac_von_io_xx FORMAT "%6.2" /end CHARACTERISTIC
/begin CHARACTERISTIC Cxx_tac_voff_io_10 "Lower substitution value for an I/O control test of downstream oxygen lamda sensor (heater)" VALUE 0xa0027c8e _REC_S1VAL_20_u2 100. _CNV_A_R_LINEAR_____114_CM 0. 100. DISPLAY_IDENTIFIER Tac_cal_set_10.Cxx_tac_voff_io_xx FORMAT "%6.2" /end CHARACTERISTIC
/begin CHARACTERISTIC Cxx_tac_von_stac_10 "Higher substitution value for the static test of downstream oxygen lamda sensor (heater)" VALUE 0xa0027c90 _REC_S1VAL_20_u2 100. _CNV_A_R_LINEAR_____114_CM 0. 100. DISPLAY_IDENTIFIER Tac_cal_set_10.Cxx_tac_von_stac_xx FORMAT "%6.2" /end CHARACTERISTIC
/begin CHARACTERISTIC Cxx_tac_voff_stac_10 "Lower substitution value for the static test of downstream oxygen lamda sensor (heater)" VALUE 0xa0027c92 _REC_S1VAL_20_u2 100. _CNV_A_R_LINEAR_____114_CM 0. 100. DISPLAY_IDENTIFIER Tac_cal_set_10.Cxx_tac_voff_stac_xx FORMAT "%6.2" /end CHARACTERISTIC
/begin CHARACTERISTIC Cxx_tac_nc_io_10 "Number of cycles to complete the I/O control test of downstream oxygen lamda sensor (heater)" VALUE 0xa0027c94 _REC_S1VAL_20_u1 255. _CNV_A_R_ECME_LINEA_0_CM 0. 255. DISPLAY_IDENTIFIER Tac_cal_set_10.Cxx_tac_nc_io_xx FORMAT "%3.0" /end CHARACTERISTIC
/begin CHARACTERISTIC Cxx_tac_tini_io_20 "Initialization time for an I/O control test of canister drain valve" VALUE 0xa0027c98 _REC_S1VAL_20_u2 65.535 _CNV_A_R_LINEAR_____58_CM 0. 65.535 DISPLAY_IDENTIFIER Tac_cal_set_20.Cxx_tac_tini_io_xx FORMAT "%5.3" /end CHARACTERISTIC
/begin CHARACTERISTIC Cxx_tac_ton_io_20 "Activation time for an I/O control test of canister drain valve" VALUE 0xa0027c9a _REC_S1VAL_20_u2 65.535 _CNV_A_R_LINEAR_____58_CM 0. 65.535 DISPLAY_IDENTIFIER Tac_cal_set_20.Cxx_tac_ton_io_xx FORMAT "%5.3" /end CHARACTERISTIC
/begin CHARACTERISTIC Cxx_tac_toff_io_20 "Deactivation time for an I/O control test of canister drain valve" VALUE 0xa0027c9c _REC_S1VAL_20_u2 65.535 _CNV_A_R_LINEAR_____58_CM 0. 65.535 DISPLAY_IDENTIFIER Tac_cal_set_20.Cxx_tac_toff_io_xx FORMAT "%5.3" /end CHARACTERISTIC
/begin CHARACTERISTIC Cxx_tac_tini_stac_20 "Initialization time for a static test of canister drain valve" VALUE 0xa0027c9e _REC_S1VAL_20_u2 65.535 _CNV_A_R_LINEAR_____58_CM 0. 65.535 DISPLAY_IDENTIFIER Tac_cal_set_20.Cxx_tac_tini_stac_xx FORMAT "%5.3" /end CHARACTERISTIC
/begin CHARACTERISTIC Cxx_tac_ton_stac_20 "Activation time for a static test of canister drain valve" VALUE 0xa0027ca0 _REC_S1VAL_20_u2 65.535 _CNV_A_R_LINEAR_____58_CM 0. 65.535 DISPLAY_IDENTIFIER Tac_cal_set_20.Cxx_tac_ton_stac_xx FORMAT "%5.3" /end CHARACTERISTIC
/begin CHARACTERISTIC Cxx_tac_toff_stac_20 "Deactivation time for a static test of canister drain valve" VALUE 0xa0027ca2 _REC_S1VAL_20_u2 65.535 _CNV_A_R_LINEAR_____58_CM 0. 65.535 DISPLAY_IDENTIFIER Tac_cal_set_20.Cxx_tac_toff_stac_xx FORMAT "%5.3" /end CHARACTERISTIC
/begin CHARACTERISTIC Cxx_tac_von_io_20 "Higher substitution value for an I/O control test of canister drain valve" VALUE 0xa0027ca4 _REC_S1VAL_20_u2 100. _CNV_A_R_LINEAR_____122_CM 0. 100. DISPLAY_IDENTIFIER Tac_cal_set_20.Cxx_tac_von_io_xx FORMAT "%6.2" /end CHARACTERISTIC
/begin CHARACTERISTIC Cxx_tac_voff_io_20 "Lower substitution value for an I/O control test of canister drain valve" VALUE 0xa0027ca6 _REC_S1VAL_20_u2 100. _CNV_A_R_LINEAR_____122_CM 0. 100. DISPLAY_IDENTIFIER Tac_cal_set_20.Cxx_tac_voff_io_xx FORMAT "%6.2" /end CHARACTERISTIC
/begin CHARACTERISTIC Cxx_tac_von_stac_20 "Higher substitution value for the static test of canister drain valve" VALUE 0xa0027ca8 _REC_S1VAL_20_u2 100. _CNV_A_R_LINEAR_____122_CM 0. 100. DISPLAY_IDENTIFIER Tac_cal_set_20.Cxx_tac_von_stac_xx FORMAT "%6.2" /end CHARACTERISTIC
/begin CHARACTERISTIC Cxx_tac_voff_stac_20 "Lower substitution value for the static test of canister drain valve" VALUE 0xa0027caa _REC_S1VAL_20_u2 100. _CNV_A_R_LINEAR_____122_CM 0. 100. DISPLAY_IDENTIFIER Tac_cal_set_20.Cxx_tac_voff_stac_xx FORMAT "%6.2" /end CHARACTERISTIC
/begin CHARACTERISTIC Cxx_tac_nc_io_20 "Number of cycles to complete the I/O control test of canister drain valve" VALUE 0xa0027cac _REC_S1VAL_20_u1 255. _CNV_A_R_ECME_LINEA_0_CM 0. 255. DISPLAY_IDENTIFIER Tac_cal_set_20.Cxx_tac_nc_io_xx FORMAT "%3.0" /end CHARACTERISTIC
/begin MEASUREMENT Vsx_tac_01_cdn "Gazoline electronic throttle intermediary status" UBYTE _CNV_S_3_ACTUATOR_T_468_CM 1 0. 0. 12. DISPLAY_IDENTIFIER Tac_data_set_01.Vsx_tac_xx_cdn ECU_ADDRESS 0xd0004dca /end MEASUREMENT
/begin MEASUREMENT Vbx_tac_01_req "Indicates if the I/O control test of gazoline electronic throttle is in porgress" UBYTE _CNV_S_2_RANGE______3_CM 1 0. 0. 1. DISPLAY_IDENTIFIER Tac_data_set_01.Vbx_tac_xx_req ECU_ADDRESS 0xd0004dcb BIT_MASK 0x1 /end MEASUREMENT
/begin MEASUREMENT Vsx_tac_02_cdn "Fuel pump and its relay intermediary status" UBYTE _CNV_S_3_ACTUATOR_T_468_CM 1 0. 0. 12. DISPLAY_IDENTIFIER Tac_data_set_02.Vsx_tac_xx_cdn ECU_ADDRESS 0xd0004dd2 /end MEASUREMENT
/begin MEASUREMENT Vbx_tac_02_req "Indicates if the I/O control test of fuel pump and its relay is in porgress" UBYTE _CNV_S_2_RANGE______3_CM 1 0. 0. 1. DISPLAY_IDENTIFIER Tac_data_set_02.Vbx_tac_xx_req ECU_ADDRESS 0xd0004dd3 BIT_MASK 0x1 /end MEASUREMENT
/begin MEASUREMENT Vsx_tac_03_cdn "FAN1 and its relay intermediary status" UBYTE _CNV_S_3_ACTUATOR_T_468_CM 1 0. 0. 12. DISPLAY_IDENTIFIER Tac_data_set_03.Vsx_tac_xx_cdn ECU_ADDRESS 0xd0004dda /end MEASUREMENT
/begin MEASUREMENT Vbx_tac_03_req "Indicates if the I/O control test of FAN1 and its relay is in porgress" UBYTE _CNV_S_2_RANGE______3_CM 1 0. 0. 1. DISPLAY_IDENTIFIER Tac_data_set_03.Vbx_tac_xx_req ECU_ADDRESS 0xd0004ddb BIT_MASK 0x1 /end MEASUREMENT
/begin MEASUREMENT Vsx_tac_04_cdn "FAN2 and its relay intermediary status" UBYTE _CNV_S_3_ACTUATOR_T_468_CM 1 0. 0. 12. DISPLAY_IDENTIFIER Tac_data_set_04.Vsx_tac_xx_cdn ECU_ADDRESS 0xd0004de2 /end MEASUREMENT
/begin MEASUREMENT Vbx_tac_04_req "Indicates if the I/O control test of FAN2 and its relay is in porgress" UBYTE _CNV_S_2_RANGE______3_CM 1 0. 0. 1. DISPLAY_IDENTIFIER Tac_data_set_04.Vbx_tac_xx_req ECU_ADDRESS 0xd0004de3 BIT_MASK 0x1 /end MEASUREMENT
/begin MEASUREMENT Vsx_tac_05_cdn "Electronic water pump for turbocharger cooling intermediary status" UBYTE _CNV_S_3_ACTUATOR_T_468_CM 1 0. 0. 12. DISPLAY_IDENTIFIER Tac_data_set_05.Vsx_tac_xx_cdn ECU_ADDRESS 0xd0004dea /end MEASUREMENT
/begin MEASUREMENT Vbx_tac_05_req "Indicates if the I/O control test of electronic water pump for turbocharger cooling is in porgress" UBYTE _CNV_S_2_RANGE______3_CM 1 0. 0. 1. DISPLAY_IDENTIFIER Tac_data_set_05.Vbx_tac_xx_req ECU_ADDRESS 0xd0004deb BIT_MASK 0x1 /end MEASUREMENT
/begin MEASUREMENT Vsx_tac_06_cdn "Defrosting PTC intermediary status" UBYTE _CNV_S_3_ACTUATOR_T_468_CM 1 0. 0. 12. DISPLAY_IDENTIFIER Tac_data_set_06.Vsx_tac_xx_cdn ECU_ADDRESS 0xd0004df2 /end MEASUREMENT
/begin MEASUREMENT Vbx_tac_06_req "Indicates if the I/O control test of defrosting PTC is in porgress" UBYTE _CNV_S_2_RANGE______3_CM 1 0. 0. 1. DISPLAY_IDENTIFIER Tac_data_set_06.Vbx_tac_xx_req ECU_ADDRESS 0xd0004df3 BIT_MASK 0x1 /end MEASUREMENT
/begin MEASUREMENT Vsx_tac_07_cdn "VVT control solenoid intermediary status" UBYTE _CNV_S_3_ACTUATOR_T_468_CM 1 0. 0. 12. DISPLAY_IDENTIFIER Tac_data_set_07.Vsx_tac_xx_cdn ECU_ADDRESS 0xd0004dfa /end MEASUREMENT
/begin MEASUREMENT Vbx_tac_07_req "Indicates if the I/O control test of VVT control solenoid is in porgress" UBYTE _CNV_S_2_RANGE______3_CM 1 0. 0. 1. DISPLAY_IDENTIFIER Tac_data_set_07.Vbx_tac_xx_req ECU_ADDRESS 0xd0004dfb BIT_MASK 0x1 /end MEASUREMENT
/begin MEASUREMENT Vsx_tac_08_cdn "Gazoline turbocharger command valve intermediary status" UBYTE _CNV_S_3_ACTUATOR_T_468_CM 1 0. 0. 12. DISPLAY_IDENTIFIER Tac_data_set_08.Vsx_tac_xx_cdn ECU_ADDRESS 0xd0004e02 /end MEASUREMENT
/begin MEASUREMENT Vbx_tac_08_req "Indicates if the I/O control test of gazoline turbocharger command valve is in porgress" UBYTE _CNV_S_2_RANGE______3_CM 1 0. 0. 1. DISPLAY_IDENTIFIER Tac_data_set_08.Vbx_tac_xx_req ECU_ADDRESS 0xd0004e03 BIT_MASK 0x1 /end MEASUREMENT
/begin MEASUREMENT Vsx_tac_09_cdn "Upstream oxygen lamda sensor (heater) intermediary status" UBYTE _CNV_S_3_ACTUATOR_T_468_CM 1 0. 0. 12. DISPLAY_IDENTIFIER Tac_data_set_09.Vsx_tac_xx_cdn ECU_ADDRESS 0xd0004e0a /end MEASUREMENT
/begin MEASUREMENT Vbx_tac_09_req "Indicates if the I/O control test of upstream oxygen lamda sensor (heater) is in porgress" UBYTE _CNV_S_2_RANGE______3_CM 1 0. 0. 1. DISPLAY_IDENTIFIER Tac_data_set_09.Vbx_tac_xx_req ECU_ADDRESS 0xd0004e0b BIT_MASK 0x1 /end MEASUREMENT
/begin MEASUREMENT Vsx_tac_10_cdn "Downstream oxygen lamda sensor (heater) intermediary status" UBYTE _CNV_S_3_ACTUATOR_T_468_CM 1 0. 0. 12. DISPLAY_IDENTIFIER Tac_data_set_10.Vsx_tac_xx_cdn ECU_ADDRESS 0xd0004e12 /end MEASUREMENT
/begin MEASUREMENT Vbx_tac_10_req "Indicates if the I/O control test of downstream oxygen lamda sensor (heater) is in porgress" UBYTE _CNV_S_2_RANGE______3_CM 1 0. 0. 1. DISPLAY_IDENTIFIER Tac_data_set_10.Vbx_tac_xx_req ECU_ADDRESS 0xd0004e13 BIT_MASK 0x1 /end MEASUREMENT
/begin MEASUREMENT Vsx_tac_20_cdn "Canister drain valve intermediary status" UBYTE _CNV_S_3_ACTUATOR_T_468_CM 1 0. 0. 12. DISPLAY_IDENTIFIER Tac_data_set_20.Vsx_tac_xx_cdn ECU_ADDRESS 0xd0004e1a /end MEASUREMENT
/begin MEASUREMENT Vbx_tac_20_req "Indicates if the I/O control test of canister drain valve is in porgress" UBYTE _CNV_S_2_RANGE______3_CM 1 0. 0. 1. DISPLAY_IDENTIFIER Tac_data_set_20.Vbx_tac_xx_req ECU_ADDRESS 0xd0004e1b BIT_MASK 0x1 /end MEASUREMENT
/begin MEASUREMENT Vsx_tac_22_cdn "Flow actuator (VCV) intermediary status" UBYTE _CNV_S_3_ACTUATOR_T_468_CM 1 0. 0. 12. DISPLAY_IDENTIFIER Tac_data_set_22.Vsx_tac_xx_cdn ECU_ADDRESS 0xd0004e22 /end MEASUREMENT
/begin MEASUREMENT Vbx_tac_22_req "Indicates if the I/O control test of flow actuator (VCV) is in porgress" UBYTE _CNV_S_2_RANGE______3_CM 1 0. 0. 1. DISPLAY_IDENTIFIER Tac_data_set_22.Vbx_tac_xx_req ECU_ADDRESS 0xd0004e23 BIT_MASK 0x1 /end MEASUREMENT
/begin MEASUREMENT Vsx_tac_23_cdn "Rail pressure regulator (PCV) intermediary status" UBYTE _CNV_S_3_ACTUATOR_T_468_CM 1 0. 0. 12. DISPLAY_IDENTIFIER Tac_data_set_23.Vsx_tac_xx_cdn ECU_ADDRESS 0xd0004e24 /end MEASUREMENT
/begin MEASUREMENT Vbx_tac_23_req "Indicates if the I/O control test of rail pressure regulator (PCV) is in porgress" UBYTE _CNV_S_2_RANGE______3_CM 1 0. 0. 1. DISPLAY_IDENTIFIER Tac_data_set_23.Vbx_tac_xx_req ECU_ADDRESS 0xd0004e25 BIT_MASK 0x1 /end MEASUREMENT
/begin MEASUREMENT Vsx_tac_24_cdn "Oxygen upper sensor heater intermediary status" UBYTE _CNV_S_3_ACTUATOR_T_468_CM 1 0. 0. 12. DISPLAY_IDENTIFIER Tac_data_set_24.Vsx_tac_xx_cdn ECU_ADDRESS 0xd0004e26 /end MEASUREMENT
/begin MEASUREMENT Vbx_tac_24_req "Indicates if the I/O control test of 02 upper sensor (heater) is in porgress" UBYTE _CNV_S_2_RANGE______3_CM 1 0. 0. 1. DISPLAY_IDENTIFIER Tac_data_set_24.Vbx_tac_xx_req ECU_ADDRESS 0xd0004e27 BIT_MASK 0x1 /end MEASUREMENT
/begin MEASUREMENT Vsx_tac_25_cdn "Oxygen lower sensor heater intermediary status" UBYTE _CNV_S_3_ACTUATOR_T_468_CM 1 0. 0. 12. DISPLAY_IDENTIFIER Tac_data_set_25.Vsx_tac_xx_cdn ECU_ADDRESS 0xd0004e28 /end MEASUREMENT
/begin MEASUREMENT Vbx_tac_25_req "Indicates if the I/O control test of 02 lower sensor (heater) is in porgress" UBYTE _CNV_S_2_RANGE______3_CM 1 0. 0. 1. DISPLAY_IDENTIFIER Tac_data_set_25.Vbx_tac_xx_req ECU_ADDRESS 0xd0004e29 BIT_MASK 0x1 /end MEASUREMENT
/begin MEASUREMENT Vsx_tac_29_cdn "Ignition coil 1 intermediary status" UBYTE _CNV_S_3_ACTUATOR_T_468_CM 1 0. 0. 12. DISPLAY_IDENTIFIER Tac_data_set_29.Vsx_tac_xx_cdn ECU_ADDRESS 0xd0004e2a /end MEASUREMENT
/begin MEASUREMENT Vbx_tac_29_req "Indicates if the I/O control test of ignition coil 1 is in porgress" UBYTE _CNV_S_2_RANGE______3_CM 1 0. 0. 1. DISPLAY_IDENTIFIER Tac_data_set_29.Vbx_tac_xx_req ECU_ADDRESS 0xd0004e2b BIT_MASK 0x1 /end MEASUREMENT
/begin MEASUREMENT Vsx_tac_30_cdn "Ignition coil 2 intermediary status" UBYTE _CNV_S_3_ACTUATOR_T_468_CM 1 0. 0. 12. DISPLAY_IDENTIFIER Tac_data_set_30.Vsx_tac_xx_cdn ECU_ADDRESS 0xd0004e2c /end MEASUREMENT
/begin MEASUREMENT Vbx_tac_30_req "Indicates if the I/O control test of ignition coil 2 is in porgress" UBYTE _CNV_S_2_RANGE______3_CM 1 0. 0. 1. DISPLAY_IDENTIFIER Tac_data_set_30.Vbx_tac_xx_req ECU_ADDRESS 0xd0004e2d BIT_MASK 0x1 /end MEASUREMENT
/begin MEASUREMENT Vsx_tac_31_cdn "Ignition coil 3 intermediary status" UBYTE _CNV_S_3_ACTUATOR_T_468_CM 1 0. 0. 12. DISPLAY_IDENTIFIER Tac_data_set_31.Vsx_tac_xx_cdn ECU_ADDRESS 0xd0004e2e /end MEASUREMENT
/begin MEASUREMENT Vbx_tac_31_req "Indicates if the I/O control test of ignition coil 3 is in porgress" UBYTE _CNV_S_2_RANGE______3_CM 1 0. 0. 1. DISPLAY_IDENTIFIER Tac_data_set_31.Vbx_tac_xx_req ECU_ADDRESS 0xd0004e2f BIT_MASK 0x1 /end MEASUREMENT
/begin MEASUREMENT Vsx_tac_32_cdn "Ignition coil 4 intermediary status" UBYTE _CNV_S_3_ACTUATOR_T_468_CM 1 0. 0. 12. DISPLAY_IDENTIFIER Tac_data_set_32.Vsx_tac_xx_cdn ECU_ADDRESS 0xd0004e30 /end MEASUREMENT
/begin MEASUREMENT Vbx_tac_32_req "Indicates if the I/O control test of ignition coil 4 is in porgress" UBYTE _CNV_S_2_RANGE______3_CM 1 0. 0. 1. DISPLAY_IDENTIFIER Tac_data_set_32.Vbx_tac_xx_req ECU_ADDRESS 0xd0004e31 BIT_MASK 0x1 /end MEASUREMENT
/begin MEASUREMENT Vsx_tac_35_cdn "Fuel injector 1 intermediary status" UBYTE _CNV_S_3_ACTUATOR_T_468_CM 1 0. 0. 12. DISPLAY_IDENTIFIER Tac_data_set_35.Vsx_tac_xx_cdn ECU_ADDRESS 0xd0004e32 /end MEASUREMENT
/begin MEASUREMENT Vbx_tac_35_req "Indicates if the I/O control test of fuel injector 1 is in porgress" UBYTE _CNV_S_2_RANGE______3_CM 1 0. 0. 1. DISPLAY_IDENTIFIER Tac_data_set_35.Vbx_tac_xx_req ECU_ADDRESS 0xd0004e33 BIT_MASK 0x1 /end MEASUREMENT
/begin MEASUREMENT Vsx_tac_36_cdn "Fuel injector 2 intermediary status" UBYTE _CNV_S_3_ACTUATOR_T_468_CM 1 0. 0. 12. DISPLAY_IDENTIFIER Tac_data_set_36.Vsx_tac_xx_cdn ECU_ADDRESS 0xd0004e34 /end MEASUREMENT
/begin MEASUREMENT Vbx_tac_36_req "Indicates if the I/O control test of fuel injector 2 is in porgress" UBYTE _CNV_S_2_RANGE______3_CM 1 0. 0. 1. DISPLAY_IDENTIFIER Tac_data_set_36.Vbx_tac_xx_req ECU_ADDRESS 0xd0004e35 BIT_MASK 0x1 /end MEASUREMENT
/begin MEASUREMENT Vsx_tac_37_cdn "Fuel injector 3 intermediary status" UBYTE _CNV_S_3_ACTUATOR_T_468_CM 1 0. 0. 12. DISPLAY_IDENTIFIER Tac_data_set_37.Vsx_tac_xx_cdn ECU_ADDRESS 0xd0004e36 /end MEASUREMENT
/begin MEASUREMENT Vbx_tac_37_req "Indicates if the I/O control test of fuel injector 3 is in porgress" UBYTE _CNV_S_2_RANGE______3_CM 1 0. 0. 1. DISPLAY_IDENTIFIER Tac_data_set_37.Vbx_tac_xx_req ECU_ADDRESS 0xd0004e37 BIT_MASK 0x1 /end MEASUREMENT
/begin MEASUREMENT Vsx_tac_38_cdn "Fuel injector 4 intermediary status" UBYTE _CNV_S_3_ACTUATOR_T_468_CM 1 0. 0. 12. DISPLAY_IDENTIFIER Tac_data_set_38.Vsx_tac_xx_cdn ECU_ADDRESS 0xd0004e38 /end MEASUREMENT
/begin MEASUREMENT Vbx_tac_38_req "Indicates if the I/O control test of fuel injector 4 is in porgress" UBYTE _CNV_S_2_RANGE______3_CM 1 0. 0. 1. DISPLAY_IDENTIFIER Tac_data_set_38.Vbx_tac_xx_req ECU_ADDRESS 0xd0004e39 BIT_MASK 0x1 /end MEASUREMENT
/begin MEASUREMENT Vxx_tmp_dly_01 "Signal generator timer for gazoline electronic throttle" UWORD _CNV_A_R_LINEAR_____58_CM 1 0. 0. 65.535 DISPLAY_IDENTIFIER Tac_data_set_rsa_01.Vxx_tmp_dly_xx ECU_ADDRESS 0xd0004dcc /end MEASUREMENT
/begin MEASUREMENT Vxx_tac_01_subval "Substitution value for a test of gazoline electronic throttle" UWORD _CNV_A_R_LINEAR_____94_CM 1 0. 0. 200. DISPLAY_IDENTIFIER Tac_data_set_rsa_01.Vxx_tac_xx_subval ECU_ADDRESS 0xd0004dce FORMAT "%6.2" /end MEASUREMENT
/begin MEASUREMENT Vxx_tac_01_nc "Current number of cycles done for the I/O control of fuel pump and its relay" UBYTE _CNV_A_R_ECME_LINEA_0_CM 1 0. 0. 255. DISPLAY_IDENTIFIER Tac_data_set_rsa_01.Vxx_tac_xx_nc ECU_ADDRESS 0xd0004dd0 FORMAT "%3.0" /end MEASUREMENT
/begin MEASUREMENT Vxx_tmp_dly_02 "Signal generator timer for fuel pump and its relay" UWORD _CNV_A_R_LINEAR_____58_CM 1 0. 0. 65.535 DISPLAY_IDENTIFIER Tac_data_set_rsa_02.Vxx_tmp_dly_xx ECU_ADDRESS 0xd0004dd4 /end MEASUREMENT
/begin MEASUREMENT Vxx_tac_02_subval "Substitution value for a test of fuel pump and its relay" UWORD _CNV_A_R_A_165_CM 1 0. 0. 65535. DISPLAY_IDENTIFIER Tac_data_set_rsa_02.Vxx_tac_xx_subval ECU_ADDRESS 0xd0004dd6 /end MEASUREMENT
/begin MEASUREMENT Vxx_tac_02_nc "Current number of cycles done for the I/O control of fuel pump and its relay" UBYTE _CNV_A_R_ECME_LINEA_0_CM 1 0. 0. 255. DISPLAY_IDENTIFIER Tac_data_set_rsa_02.Vxx_tac_xx_nc ECU_ADDRESS 0xd0004dd8 FORMAT "%3.0" /end MEASUREMENT
/begin MEASUREMENT Vxx_tmp_dly_03 "Signal generator timer for FAN1 and its relay" UWORD _CNV_A_R_LINEAR_____58_CM 1 0. 0. 65.535 DISPLAY_IDENTIFIER Tac_data_set_rsa_03.Vxx_tmp_dly_xx ECU_ADDRESS 0xd0004ddc /end MEASUREMENT
/begin MEASUREMENT Vxx_tac_03_subval "Substitution value for a test of FAN1 and its relay" UWORD _CNV_A_R_A_165_CM 1 0. 0. 65535. DISPLAY_IDENTIFIER Tac_data_set_rsa_03.Vxx_tac_xx_subval ECU_ADDRESS 0xd0004dde /end MEASUREMENT
/begin MEASUREMENT Vxx_tac_03_nc "Current number of cycles done for the I/O control of FAN1 and its relay" UBYTE _CNV_A_R_ECME_LINEA_0_CM 1 0. 0. 255. DISPLAY_IDENTIFIER Tac_data_set_rsa_03.Vxx_tac_xx_nc ECU_ADDRESS 0xd0004de0 FORMAT "%3.0" /end MEASUREMENT
/begin MEASUREMENT Vxx_tmp_dly_04 "Signal generator timer for FAN2 and its relay" UWORD _CNV_A_R_LINEAR_____58_CM 1 0. 0. 65.535 DISPLAY_IDENTIFIER Tac_data_set_rsa_04.Vxx_tmp_dly_xx ECU_ADDRESS 0xd0004de4 /end MEASUREMENT
/begin MEASUREMENT Vxx_tac_04_subval "Substitution value for a test of FAN2 and its relay" UWORD _CNV_A_R_A_165_CM 1 0. 0. 65535. DISPLAY_IDENTIFIER Tac_data_set_rsa_04.Vxx_tac_xx_subval ECU_ADDRESS 0xd0004de6 /end MEASUREMENT
/begin MEASUREMENT Vxx_tac_04_nc "Current number of cycles done for the I/O control of FAN2 and its relay" UBYTE _CNV_A_R_ECME_LINEA_0_CM 1 0. 0. 255. DISPLAY_IDENTIFIER Tac_data_set_rsa_04.Vxx_tac_xx_nc ECU_ADDRESS 0xd0004de8 FORMAT "%3.0" /end MEASUREMENT
/begin MEASUREMENT Vxx_tmp_dly_05 "Signal generator timer for electronic water pump for turbocharger cooling" UWORD _CNV_A_R_LINEAR_____58_CM 1 0. 0. 65.535 DISPLAY_IDENTIFIER Tac_data_set_rsa_05.Vxx_tmp_dly_xx ECU_ADDRESS 0xd0004dec /end MEASUREMENT
/begin MEASUREMENT Vxx_tac_05_subval "Substitution value for a test of electronic water pump for turbocharger cooling" UWORD _CNV_A_R_A_165_CM 1 0. 0. 65535. DISPLAY_IDENTIFIER Tac_data_set_rsa_05.Vxx_tac_xx_subval ECU_ADDRESS 0xd0004dee /end MEASUREMENT
/begin MEASUREMENT Vxx_tac_05_nc "Current number of cycles done for the I/O control of electronic water pump for turbocharger cooling" UBYTE _CNV_A_R_ECME_LINEA_0_CM 1 0. 0. 255. DISPLAY_IDENTIFIER Tac_data_set_rsa_05.Vxx_tac_xx_nc ECU_ADDRESS 0xd0004df0 FORMAT "%3.0" /end MEASUREMENT
/begin MEASUREMENT Vxx_tmp_dly_06 "Signal generator timer for defrosting PTC" UWORD _CNV_A_R_LINEAR_____58_CM 1 0. 0. 65.535 DISPLAY_IDENTIFIER Tac_data_set_rsa_06.Vxx_tmp_dly_xx ECU_ADDRESS 0xd0004df4 /end MEASUREMENT
/begin MEASUREMENT Vxx_tac_06_subval "Substitution value for a test of defrosting PTC" UWORD _CNV_A_R_A_165_CM 1 0. 0. 65535. DISPLAY_IDENTIFIER Tac_data_set_rsa_06.Vxx_tac_xx_subval ECU_ADDRESS 0xd0004df6 /end MEASUREMENT
/begin MEASUREMENT Vxx_tac_06_nc "Current number of cycles done for the I/O control of defrosting PTC" UBYTE _CNV_A_R_ECME_LINEA_0_CM 1 0. 0. 255. DISPLAY_IDENTIFIER Tac_data_set_rsa_06.Vxx_tac_xx_nc ECU_ADDRESS 0xd0004df8 FORMAT "%3.0" /end MEASUREMENT
/begin MEASUREMENT Vxx_tmp_dly_07 "Signal generator timer for VVT control solenoid" UWORD _CNV_A_R_LINEAR_____58_CM 1 0. 0. 65.535 DISPLAY_IDENTIFIER Tac_data_set_rsa_07.Vxx_tmp_dly_xx ECU_ADDRESS 0xd0004dfc /end MEASUREMENT
/begin MEASUREMENT Vxx_tac_07_subval "Substitution value for a test of VVT control solenoid" UWORD _CNV_A_R_LINEAR_____94_CM 1 0. 0. 200. DISPLAY_IDENTIFIER Tac_data_set_rsa_07.Vxx_tac_xx_subval ECU_ADDRESS 0xd0004dfe FORMAT "%6.2" /end MEASUREMENT
/begin MEASUREMENT Vxx_tac_07_nc "Current number of cycles done for the I/O control of VVT control solenoid" UBYTE _CNV_A_R_ECME_LINEA_0_CM 1 0. 0. 255. DISPLAY_IDENTIFIER Tac_data_set_rsa_07.Vxx_tac_xx_nc ECU_ADDRESS 0xd0004e00 FORMAT "%3.0" /end MEASUREMENT
/begin MEASUREMENT Vxx_tmp_dly_08 "Signal generator timer for gazoline turbocharger command valve" UWORD _CNV_A_R_LINEAR_____58_CM 1 0. 0. 65.535 DISPLAY_IDENTIFIER Tac_data_set_rsa_08.Vxx_tmp_dly_xx ECU_ADDRESS 0xd0004e04 /end MEASUREMENT
/begin MEASUREMENT Vxx_tac_08_subval "Substitution value for a test of gazoline turbocharger command valve" UWORD _CNV_A_R_LINEAR_____114_CM 1 0. 0. 100. DISPLAY_IDENTIFIER Tac_data_set_rsa_08.Vxx_tac_xx_subval ECU_ADDRESS 0xd0004e06 FORMAT "%6.2" /end MEASUREMENT
/begin MEASUREMENT Vxx_tac_08_nc "Current number of cycles done for the I/O control of gazoline turbocharger command valve" UBYTE _CNV_A_R_ECME_LINEA_0_CM 1 0. 0. 255. DISPLAY_IDENTIFIER Tac_data_set_rsa_08.Vxx_tac_xx_nc ECU_ADDRESS 0xd0004e08 FORMAT "%3.0" /end MEASUREMENT
/begin MEASUREMENT Vxx_tmp_dly_09 "Signal generator timer for upstream oxygen lamda sensor (heater)" UWORD _CNV_A_R_LINEAR_____58_CM 1 0. 0. 65.535 DISPLAY_IDENTIFIER Tac_data_set_rsa_09.Vxx_tmp_dly_xx ECU_ADDRESS 0xd0004e0c /end MEASUREMENT
/begin MEASUREMENT Vxx_tac_09_subval "Substitution value for a test of upstream oxygen lambda sensor (heater)" UWORD _CNV_A_R_LINEAR_____114_CM 1 0. 0. 100. DISPLAY_IDENTIFIER Tac_data_set_rsa_09.Vxx_tac_xx_subval ECU_ADDRESS 0xd0004e0e FORMAT "%6.2" /end MEASUREMENT
/begin MEASUREMENT Vxx_tac_09_nc "Current number of cycles done for the I/O control of upstream oxygen lamda sensor (heater)" UBYTE _CNV_A_R_ECME_LINEA_0_CM 1 0. 0. 255. DISPLAY_IDENTIFIER Tac_data_set_rsa_09.Vxx_tac_xx_nc ECU_ADDRESS 0xd0004e10 FORMAT "%3.0" /end MEASUREMENT
/begin MEASUREMENT Vxx_tmp_dly_10 "Signal generator timer for downstream oxygen lamda sensor (heater)" UWORD _CNV_A_R_LINEAR_____58_CM 1 0. 0. 65.535 DISPLAY_IDENTIFIER Tac_data_set_rsa_10.Vxx_tmp_dly_xx ECU_ADDRESS 0xd0004e14 /end MEASUREMENT
/begin MEASUREMENT Vxx_tac_10_subval "Substitution value for a test of downstream oxygen lamda sensor (heater)" UWORD _CNV_A_R_LINEAR_____114_CM 1 0. 0. 100. DISPLAY_IDENTIFIER Tac_data_set_rsa_10.Vxx_tac_xx_subval ECU_ADDRESS 0xd0004e16 FORMAT "%6.2" /end MEASUREMENT
/begin MEASUREMENT Vxx_tac_10_nc "Current number of cycles done for the I/O control of downstream oxygen lamda sensor (heater)" UBYTE _CNV_A_R_ECME_LINEA_0_CM 1 0. 0. 255. DISPLAY_IDENTIFIER Tac_data_set_rsa_10.Vxx_tac_xx_nc ECU_ADDRESS 0xd0004e18 FORMAT "%3.0" /end MEASUREMENT
/begin MEASUREMENT Vxx_tmp_dly_20 "Signal generator timer for canister drain valve" UWORD _CNV_A_R_LINEAR_____58_CM 1 0. 0. 65.535 DISPLAY_IDENTIFIER Tac_data_set_rsa_20.Vxx_tmp_dly_xx ECU_ADDRESS 0xd0004e1c /end MEASUREMENT
/begin MEASUREMENT Vxx_tac_20_subval "Substitution value for a test of canister drain valve" UWORD _CNV_A_R_LINEAR_____122_CM 1 0. 0. 100. DISPLAY_IDENTIFIER Tac_data_set_rsa_20.Vxx_tac_xx_subval ECU_ADDRESS 0xd0004e1e FORMAT "%6.2" /end MEASUREMENT
/begin MEASUREMENT Vxx_tac_20_nc "Current number of cycles done for the I/O control of canister drain valve" UBYTE _CNV_A_R_ECME_LINEA_0_CM 1 0. 0. 255. DISPLAY_IDENTIFIER Tac_data_set_rsa_20.Vxx_tac_xx_nc ECU_ADDRESS 0xd0004e20 FORMAT "%3.0" /end MEASUREMENT
/begin MEASUREMENT Vbx_diag_sta_stac_abrt "Static test routine aborted status" UBYTE _CNV_S_2_RANGE______3_CM 1 0. 0. 1. ECU_ADDRESS 0xd0004e49 BIT_MASK 0x1 /end MEASUREMENT
/begin MEASUREMENT Vbx_diag_sta_stac_ena "Static test routine activation status" UBYTE _CNV_S_2_RANGE______3_CM 1 0. 0. 1. ECU_ADDRESS 0xd0004e4a BIT_MASK 0x1 /end MEASUREMENT
/begin MEASUREMENT Vbx_diag_sta_stac_end "Static test routine completed status" UBYTE _CNV_S_2_RANGE______3_CM 1 0. 0. 1. ECU_ADDRESS 0xd0004e4b BIT_MASK 0x1 /end MEASUREMENT
/begin MEASUREMENT Vbx_tac_cdn "Indicates if generic actuator test conditions are fulfilled" UBYTE _CNV_S_2_RANGE______3_CM 1 0. 0. 1. ECU_ADDRESS 0xd0004e4c BIT_MASK 0x1 /end MEASUREMENT
/begin MEASUREMENT Vbx_tac_ena "Indicates if any I/O control is in progress" UBYTE _CNV_S_2_RANGE______3_CM 1 0. 0. 1. ECU_ADDRESS 0xd0004e4d BIT_MASK 0x1 /end MEASUREMENT
/begin MEASUREMENT Vbx_tac_tout "Indicates if a timeout occurs when a supplier component is driven" UBYTE _CNV_S_2_RANGE______3_CM 1 0. 0. 1. ECU_ADDRESS 0xd0004e4e BIT_MASK 0x1 /end MEASUREMENT
/begin MEASUREMENT Vsx_diag_sta_stac_stt "Supplier actuator LID intermediary status" UBYTE _CNV_A_R_ECME_LINEA_0_CM 1 0. 0. 255. ECU_ADDRESS 0xd0004e3a FORMAT "%3.0" /end MEASUREMENT
/begin MEASUREMENT Vsx_opt "Memorized option control" UBYTE _CNV_A_R_ECME_LINEA_0_CM 1 0. 0. 255. ECU_ADDRESS 0xd0004e3b FORMAT "%3.0" /end MEASUREMENT
/begin MEASUREMENT Vsx_tac_22_stt "Supplier flow actuator (VCV) intermediary status" UBYTE _CNV_A_R_ECME_LINEA_0_CM 1 0. 0. 255. ECU_ADDRESS 0xd0004e3c FORMAT "%3.0" /end MEASUREMENT
/begin MEASUREMENT Vsx_tac_23_stt "Supplier rail pressure regulator (PCV) intermediary status" UBYTE _CNV_A_R_ECME_LINEA_0_CM 1 0. 0. 255. ECU_ADDRESS 0xd0004e3d FORMAT "%3.0" /end MEASUREMENT
/begin MEASUREMENT Vsx_tac_24_stt "Supplier oxygen upper sensor heater intermediary status" UBYTE _CNV_A_R_ECME_LINEA_0_CM 1 0. 0. 255. ECU_ADDRESS 0xd0004e3e FORMAT "%3.0" /end MEASUREMENT
/begin MEASUREMENT Vsx_tac_25_stt "Supplier oxygen lower sensor heater intermediary status" UBYTE _CNV_A_R_ECME_LINEA_0_CM 1 0. 0. 255. ECU_ADDRESS 0xd0004e3f FORMAT "%3.0" /end MEASUREMENT
/begin MEASUREMENT Vsx_tac_29_stt "Supplier ignition coil 1 intermediary status" UBYTE _CNV_A_R_ECME_LINEA_0_CM 1 0. 0. 255. ECU_ADDRESS 0xd0004e40 FORMAT "%3.0" /end MEASUREMENT
/begin MEASUREMENT Vsx_tac_30_stt "Supplier ignition coil 2 intermediary status" UBYTE _CNV_A_R_ECME_LINEA_0_CM 1 0. 0. 255. ECU_ADDRESS 0xd0004e41 FORMAT "%3.0" /end MEASUREMENT
/begin MEASUREMENT Vsx_tac_31_stt "Supplier ignition coil 3 intermediary status" UBYTE _CNV_A_R_ECME_LINEA_0_CM 1 0. 0. 255. ECU_ADDRESS 0xd0004e42 FORMAT "%3.0" /end MEASUREMENT
/begin MEASUREMENT Vsx_tac_32_stt "Supplier ignition coil 4 intermediary status" UBYTE _CNV_A_R_ECME_LINEA_0_CM 1 0. 0. 255. ECU_ADDRESS 0xd0004e43 FORMAT "%3.0" /end MEASUREMENT
/begin MEASUREMENT Vsx_tac_35_stt "Supplier fuel injector 1 intermediary status" UBYTE _CNV_A_R_ECME_LINEA_0_CM 1 0. 0. 255. ECU_ADDRESS 0xd0004e44 FORMAT "%3.0" /end MEASUREMENT
/begin MEASUREMENT Vsx_tac_36_stt "Supplier fuel injector 2 intermediary status" UBYTE _CNV_A_R_ECME_LINEA_0_CM 1 0. 0. 255. ECU_ADDRESS 0xd0004e45 FORMAT "%3.0" /end MEASUREMENT
/begin MEASUREMENT Vsx_tac_37_stt "Supplier fuel injector 3 intermediary status" UBYTE _CNV_A_R_ECME_LINEA_0_CM 1 0. 0. 255. ECU_ADDRESS 0xd0004e46 FORMAT "%3.0" /end MEASUREMENT
/begin MEASUREMENT Vsx_tac_38_stt "Supplier fuel injector 4 intermediary status" UBYTE _CNV_A_R_ECME_LINEA_0_CM 1 0. 0. 255. ECU_ADDRESS 0xd0004e47 FORMAT "%3.0" /end MEASUREMENT
/begin MEASUREMENT Vsx_tac_stt "Current component status returned to build positive or negative answer" UBYTE _CNV_A_R_ECME_LINEA_0_CM 1 0. 0. 255. ECU_ADDRESS 0xd0004e48 FORMAT "%3.0" /end MEASUREMENT
/begin MEASUREMENT Vxx_LID "Memorized requested actuator identifier" UBYTE _CNV_A_R_ECME_LINEA_0_CM 1 0. 0. 255. ECU_ADDRESS 0xd0002d26 FORMAT "%3.0" /end MEASUREMENT
/begin MEASUREMENT Vxx_tac_tout_timer "Timeout timer" UWORD _CNV_A_R_LINEAR_____58_CM 1 0. 0. 65.535 ECU_ADDRESS 0xd0002d24 /end MEASUREMENT
/begin CHARACTERISTIC Cbx_it_ofs_clos_frst_dsb "Disables offset closed learning condition to allow throttle control " VALUE 0xa0020a25 _REC_S1VAL_20_u1 1. _CNV_S_2_RANGE______3_CM 0. 1. BIT_MASK 0x1 /end CHARACTERISTIC
/begin CHARACTERISTIC Cbx_it_ofs_open_frst_dsb "Disables offset open learning condition to allow throttle control " VALUE 0xa0020a26 _REC_S1VAL_20_u1 1. _CNV_S_2_RANGE______3_CM 0. 1. BIT_MASK 0x1 /end CHARACTERISTIC
/begin CHARACTERISTIC Csx_tac_01 "Allowed tests for gazoline electronic throttle" VALUE 0xa0020a1a _REC_S1VAL_20_u1 255. _CNV_A_R_ECME_LINEA_0_CM 0. 255. FORMAT "%3.0" /end CHARACTERISTIC
/begin CHARACTERISTIC Csx_tac_02 "Allowed tests for fuel pump and its relay" VALUE 0xa0020a1b _REC_S1VAL_20_u1 255. _CNV_A_R_ECME_LINEA_0_CM 0. 255. FORMAT "%3.0" /end CHARACTERISTIC
/begin CHARACTERISTIC Csx_tac_03 "Allowed tests for FAN1 and its relay" VALUE 0xa0020a1c _REC_S1VAL_20_u1 255. _CNV_A_R_ECME_LINEA_0_CM 0. 255. FORMAT "%3.0" /end CHARACTERISTIC
/begin CHARACTERISTIC Csx_tac_04 "Allowed tests for FAN2 and its relay" VALUE 0xa0020a1d _REC_S1VAL_20_u1 255. _CNV_A_R_ECME_LINEA_0_CM 0. 255. FORMAT "%3.0" /end CHARACTERISTIC
/begin CHARACTERISTIC Csx_tac_05 "Allowed tests for electronic water pump for turbocharger cooling" VALUE 0xa0020a1e _REC_S1VAL_20_u1 255. _CNV_A_R_ECME_LINEA_0_CM 0. 255. FORMAT "%3.0" /end CHARACTERISTIC
/begin CHARACTERISTIC Csx_tac_06 "Allowed tests for defrosting PTC" VALUE 0xa0020a1f _REC_S1VAL_20_u1 255. _CNV_A_R_ECME_LINEA_0_CM 0. 255. FORMAT "%3.0" /end CHARACTERISTIC
/begin CHARACTERISTIC Csx_tac_07 "Allowed tests for VVT control solenoid" VALUE 0xa0020a20 _REC_S1VAL_20_u1 255. _CNV_A_R_ECME_LINEA_0_CM 0. 255. FORMAT "%3.0" /end CHARACTERISTIC
/begin CHARACTERISTIC Csx_tac_08 "Allowed tests for gazoline turbocharger command valve" VALUE 0xa0020a21 _REC_S1VAL_20_u1 255. _CNV_A_R_ECME_LINEA_0_CM 0. 255. FORMAT "%3.0" /end CHARACTERISTIC
/begin CHARACTERISTIC Csx_tac_09 "Allowed tests for upstream oxygen lamda sensor" VALUE 0xa0020a22 _REC_S1VAL_20_u1 255. _CNV_A_R_ECME_LINEA_0_CM 0. 255. FORMAT "%3.0" /end CHARACTERISTIC
/begin CHARACTERISTIC Csx_tac_10 "Allowed tests for downstream oxygen lamda sensor" VALUE 0xa0020a23 _REC_S1VAL_20_u1 255. _CNV_A_R_ECME_LINEA_0_CM 0. 255. FORMAT "%3.0" /end CHARACTERISTIC
/begin CHARACTERISTIC Csx_tac_20 "Allowed test for Canister drain valve" VALUE 0xa0020a24 _REC_S1VAL_20_u1 255. _CNV_A_R_ECME_LINEA_0_CM 0. 255. FORMAT "%3.0" /end CHARACTERISTIC
/begin CHARACTERISTIC Csx_tac_22 "Allowed test for flow actuator" VALUE 0xa0020a27 _REC_S1VAL_20_u1 255. _CNV_A_R_ECME_LINEA_0_CM 0. 255. FORMAT "%3.0" /end CHARACTERISTIC
/begin CHARACTERISTIC Csx_tac_23 "Allowed test for rail pressure regulator" VALUE 0xa0020a28 _REC_S1VAL_20_u1 255. _CNV_A_R_ECME_LINEA_0_CM 0. 255. FORMAT "%3.0" /end CHARACTERISTIC
/begin CHARACTERISTIC Csx_tac_24 "Allowed test for O2 upper sensor heater" VALUE 0xa0020a29 _REC_S1VAL_20_u1 255. _CNV_A_R_ECME_LINEA_0_CM 0. 255. FORMAT "%3.0" /end CHARACTERISTIC
/begin CHARACTERISTIC Csx_tac_25 "Allowed test for O2 lower sensor heater" VALUE 0xa0020a2a _REC_S1VAL_20_u1 255. _CNV_A_R_ECME_LINEA_0_CM 0. 255. FORMAT "%3.0" /end CHARACTERISTIC
/begin CHARACTERISTIC Csx_tac_29 "Allowed test for spark plug 1" VALUE 0xa0020a2b _REC_S1VAL_20_u1 255. _CNV_A_R_ECME_LINEA_0_CM 0. 255. FORMAT "%3.0" /end CHARACTERISTIC
/begin CHARACTERISTIC Csx_tac_30 "Allowed test for spark plug 2" VALUE 0xa0020a2c _REC_S1VAL_20_u1 255. _CNV_A_R_ECME_LINEA_0_CM 0. 255. FORMAT "%3.0" /end CHARACTERISTIC
/begin CHARACTERISTIC Csx_tac_31 "Allowed test for spark plug 3" VALUE 0xa0020a2d _REC_S1VAL_20_u1 255. _CNV_A_R_ECME_LINEA_0_CM 0. 255. FORMAT "%3.0" /end CHARACTERISTIC
/begin CHARACTERISTIC Csx_tac_32 "Allowed test for spark plug 4" VALUE 0xa0020a2e _REC_S1VAL_20_u1 255. _CNV_A_R_ECME_LINEA_0_CM 0. 255. FORMAT "%3.0" /end CHARACTERISTIC
/begin CHARACTERISTIC Csx_tac_35 "Allowed test for fuel injector 1" VALUE 0xa0020a2f _REC_S1VAL_20_u1 255. _CNV_A_R_ECME_LINEA_0_CM 0. 255. FORMAT "%3.0" /end CHARACTERISTIC
/begin CHARACTERISTIC Csx_tac_36 "Allowed test for fuel injector 2" VALUE 0xa0020a30 _REC_S1VAL_20_u1 255. _CNV_A_R_ECME_LINEA_0_CM 0. 255. FORMAT "%3.0" /end CHARACTERISTIC
/begin CHARACTERISTIC Csx_tac_37 "Allowed test for fuel injector 3" VALUE 0xa0020a31 _REC_S1VAL_20_u1 255. _CNV_A_R_ECME_LINEA_0_CM 0. 255. FORMAT "%3.0" /end CHARACTERISTIC
/begin CHARACTERISTIC Csx_tac_38 "Allowed test for fuel injector 4" VALUE 0xa0020a32 _REC_S1VAL_20_u1 255. _CNV_A_R_ECME_LINEA_0_CM 0. 255. FORMAT "%3.0" /end CHARACTERISTIC
/begin CHARACTERISTIC Cxx_tac_tout_timer_io "Delay to declare timeout when a supplier I/O control is executed" VALUE 0xa0020a12 _REC_S1VAL_20_u2 65.535 _CNV_A_R_LINEAR_____58_CM 0. 65.535 /end CHARACTERISTIC
/begin CHARACTERISTIC Cxx_tac_tout_timer_stac "Delay to declare timeout when a static test supplier control is executed" VALUE 0xa0020a14 _REC_S1VAL_20_u2 65.535 _CNV_A_R_LINEAR_____58_CM 0. 65.535 /end CHARACTERISTIC
/begin CHARACTERISTIC Cxx_tac_vb_max "Maximum battery voltage to allow heat glow control" VALUE 0xa0020a16 _REC_S1VAL_20_u2 60. _CNV_A_R_LINEAR_____150_CM 0. 60. FORMAT "%5.2" /end CHARACTERISTIC
/begin CHARACTERISTIC Cxx_tac_vb_min "Calibration value of the minimum battery voltage for static test" VALUE 0xa0020a18 _REC_S1VAL_20_u2 60. _CNV_A_R_LINEAR_____150_CM 0. 60. FORMAT "%5.2" /end CHARACTERISTIC
/begin AXIS_PTS Ctb_sfty_sens_tco_v "coolant voltage signal breakpoints map (safety)" 0xa0021f78 NO_INPUT_QUANTITY _REC_A2AXS_20_u2 25000. _CNV_A_R_LINEAR_____52_CM 16 0. 25000. FORMAT "%5.0" /end AXIS_PTS
/begin CHARACTERISTIC Ctp_sfty_sens_tco "coolant sensor map (safety)" CURVE 0xa0021f9c _REC_A1CUR_20_u1_u2 240. _CNV_A_R_LINEAR_____220_CM -40. 200. FORMAT "%3.0"
 /begin AXIS_DESCR COM_AXIS NO_INPUT_QUANTITY _CNV_A_R_LINEAR_____52_CM 16 0. 25000. FORMAT "%5.0" AXIS_PTS_REF Ctb_sfty_sens_tco_v /end AXIS_DESCR
/end CHARACTERISTIC
/begin MEASUREMENT Vxx_sfty_raw_sens_tco "Raw engine coolant temperature for safety" UBYTE _CNV_A_R_LINEAR_____220_CM 1 0. -40. 200. ECU_ADDRESS 0xd0005c88 FORMAT "%3.0" /end MEASUREMENT
/begin MEASUREMENT Vxx_sfty_tco "Engine coolant temperature for safety" UBYTE _CNV_A_R_LINEAR_____220_CM 1 0. -40. 200. ECU_ADDRESS 0xd0005c89 FORMAT "%3.0" /end MEASUREMENT
/begin CHARACTERISTIC Cxx_sfty_tco_inc "Max gradient of tco" VALUE 0xa0021f30 _REC_S1VAL_20_u2 30. _CNV_A_R_LINEAR_____190_CM 0. 30. FORMAT "%4.1" /end CHARACTERISTIC
/begin MEASUREMENT Vxx_sfty_n "engine speed for safety monitoring" UBYTE _CNV_A_R_LINEAR_____2_CM 1 0. 0. 8160. ECU_ADDRESS 0xd0005c96 FORMAT "%4.0" /end MEASUREMENT
/begin MEASUREMENT Vxx_sfty_mux_agb_tqe_sp "Automatic transmission fast-acting torque setting acquired on the CAN ( for saffety monitoring)" UWORD _CNV_A_R_LINEAR_____161_CM 1 0. -400. 1647.96875 ECU_ADDRESS 0xd0005c9c FORMAT "%10.5" /end MEASUREMENT
/begin MEASUREMENT Vxx_sfty_mux_msr_tqe_sp "MSR torque setting acquired on the MUX ( for safety monitoring)" UWORD _CNV_A_R_LINEAR_____161_CM 1 0. -400. 1647.96875 ECU_ADDRESS 0xd0005c9e FORMAT "%10.5" /end MEASUREMENT
/begin AXIS_PTS Ctb_sfty_frn_tql_temp "Temperature breakpoints map for engine rubbing torque losses calculation for safety monitoring" 0xa0022530 Vxx_sfty_frn_tql_temp _REC_A2AXS_20_u1 240. _CNV_A_R_LINEAR_____220_CM 9 -40. 200. FORMAT "%3.0" /end AXIS_PTS
/begin AXIS_PTS Ctb_sfty_map "Maniflod pressure value break points" 0xa002253c Vxx_map _REC_A2AXS_20_u2 20000. _CNV_A_R_LINEAR_____57_CM 9 0. 20000. FORMAT "%5.0" /end AXIS_PTS
/begin AXIS_PTS Ctb_sfty_n "20 programmable engine speed breakpoints map" 0xa0022550 Vxx_sfty_n _REC_A2AXS_20_u1 8160. _CNV_A_R_LINEAR_____2_CM 11 0. 8160. FORMAT "%4.0" /end AXIS_PTS
/begin CHARACTERISTIC Cmp_sfty_frn_tql "Copy of rubing engine torque losses map depending of engine speed and coolant temperature for safety monitoring" MAP 0xa002255c _REC_A1MAP_20_u1_u1_u1 255. _CNV_A_R_LINEAR_____431_CM 0. 255. FORMAT "%3.0"
 /begin AXIS_DESCR COM_AXIS Vxx_sfty_frn_tql_temp _CNV_A_R_LINEAR_____220_CM 9 -40. 200. FORMAT "%3.0" AXIS_PTS_REF Ctb_sfty_frn_tql_temp /end AXIS_DESCR
 /begin AXIS_DESCR COM_AXIS Vxx_sfty_n _CNV_A_R_LINEAR_____2_CM 11 0. 8160. FORMAT "%4.0" AXIS_PTS_REF Ctb_sfty_n /end AXIS_DESCR
/end CHARACTERISTIC
/begin CHARACTERISTIC Cmp_sfty_pump_tql "Map of estimated pumping torque (for safety)" MAP 0xa00225c0 _REC_A1MAP_20_u1_u2_u1 255. _CNV_A_R_LINEAR_____431_CM 0. 255. FORMAT "%3.0"
 /begin AXIS_DESCR COM_AXIS Vxx_map _CNV_A_R_LINEAR_____57_CM 9 0. 20000. FORMAT "%5.0" AXIS_PTS_REF Ctb_sfty_map /end AXIS_DESCR
 /begin AXIS_DESCR COM_AXIS Vxx_sfty_n _CNV_A_R_LINEAR_____2_CM 11 0. 8160. FORMAT "%4.0" AXIS_PTS_REF Ctb_sfty_n /end AXIS_DESCR
/end CHARACTERISTIC
/begin MEASUREMENT Vxx_sfty_aux_tql_sp "torque losses due to accessories (for safety)" UBYTE _CNV_A_R_LINEAR_____431_CM 1 0. 0. 255. ECU_ADDRESS 0xd0005c5c FORMAT "%3.0" /end MEASUREMENT
/begin MEASUREMENT Vxx_sfty_eng_tql "Engine torque losses for safety" UWORD _CNV_A_R_LINEAR_____123_CM 1 0. 0. 2047.96875 ECU_ADDRESS 0xd0005c5a FORMAT "%10.5" /end MEASUREMENT
/begin MEASUREMENT Vxx_sfty_frn_tql "Estimated pumping torque (for safety)" UBYTE _CNV_A_R_LINEAR_____431_CM 1 0. 0. 255. ECU_ADDRESS 0xd0005c5d FORMAT "%3.0" /end MEASUREMENT
/begin MEASUREMENT Vxx_sfty_frn_tql_temp "Temperature for engine rubbing torque losses calculation for safety monitoring" UBYTE _CNV_A_R_LINEAR_____220_CM 1 0. -40. 200. ECU_ADDRESS 0xd0005c5e FORMAT "%3.0" /end MEASUREMENT
/begin MEASUREMENT Vxx_sfty_toil "Oil temperature for safety" UBYTE _CNV_A_R_LINEAR_____220_CM 1 0. -40. 200. ECU_ADDRESS 0xd0005c5f FORMAT "%3.0" /end MEASUREMENT
/begin CHARACTERISTIC Cbx_sfty_is_ad_eng_tql_cmf "Add adaptive idle speed torque on engine torque losses or on minimum torque (for safety monitoring)" VALUE 0xa0021f20 _REC_S1VAL_20_u1 1. _CNV_A_R_ECME_LINEA_0_CM 0. 1. FORMAT "%1.0" BIT_MASK 0x1 /end CHARACTERISTIC
/begin CHARACTERISTIC Cbx_sfty_tql_temp_cfm "Choice of water or oil temperature permited, according with technical engine definition (for safety monitoring)" VALUE 0xa0021f21 _REC_S1VAL_20_u1 1. _CNV_A_R_ECME_LINEA_0_CM 0. 1. FORMAT "%1.0" BIT_MASK 0x1 /end CHARACTERISTIC
/begin CHARACTERISTIC Cxx_sfty_ac_pow_thd "maximum value of air conditioning absorbed power (compressor) for safety monitoring" VALUE 0xa0021f22 _REC_S1VAL_20_u1 10200. _CNV_A_R_LINEAR_____469_CM 0. 10200. FORMAT "%5.0" /end CHARACTERISTIC
/begin CHARACTERISTIC Cxx_sfty_alt_pow_thd "maximum value of filtered alternator mechanical power for safety monitoring" VALUE 0xa0021f23 _REC_S1VAL_20_u1 10200. _CNV_A_R_LINEAR_____469_CM 0. 10200. FORMAT "%5.0" /end CHARACTERISTIC
/begin CHARACTERISTIC Cxx_sfty_max_is_ad_tq "Maximum of adaptive correction of iddle speed for safety monitoring" VALUE 0xa0021f1c _REC_S1VAL_20_s2 2047.96875 _CNV_A_R_LINEAR_____123_CM -1024. 1023.96875 FORMAT "%11.5" /end CHARACTERISTIC
/begin CHARACTERISTIC Cxx_sfty_min_is_ad_tq "Minimum of adaptive correction of iddle speed for safety monitoring" VALUE 0xa0021f1e _REC_S1VAL_20_s2 2047.96875 _CNV_A_R_LINEAR_____123_CM -1024. 1023.96875 FORMAT "%11.5" /end CHARACTERISTIC
/begin CHARACTERISTIC Cxx_sfty_pump_tql_thd "maximum value of pump torque lossses for safety monitoring" VALUE 0xa0021f24 _REC_S1VAL_20_u1 255. _CNV_A_R_LINEAR_____431_CM 0. 255. FORMAT "%3.0" /end CHARACTERISTIC
/begin CHARACTERISTIC Cxx_sfty_pwst_off_is_cor_dly "Inhibition time of the torque losses from power steering (for safety monitoring)" VALUE 0xa0021f25 _REC_S1VAL_20_u1 10.2 _CNV_A_R_LINEAR_____153_CM 0. 10.2 FORMAT "%4.2" /end CHARACTERISTIC
/begin CHARACTERISTIC Cxx_sfty_pwst_prs_tql "Torque loss from power steering for safety" VALUE 0xa0021f26 _REC_S1VAL_20_u1 255. _CNV_A_R_LINEAR_____431_CM 0. 255. FORMAT "%3.0" /end CHARACTERISTIC
/begin MEASUREMENT Vbx_sfty_agb_tq_req "Recent AGB torque request" UBYTE _CNV_S_2_RANGE______3_CM 1 0. 0. 1. ECU_ADDRESS 0xd0005ca0 BIT_MASK 0x1 /end MEASUREMENT
/begin MEASUREMENT Vbx_sfty_agb_tq_req_plau "Torque requests by AGB are plausible" UBYTE _CNV_S_2_RANGE______3_CM 1 0. 0. 1. ECU_ADDRESS 0xd0005ca1 BIT_MASK 0x1 /end MEASUREMENT
/begin MEASUREMENT Vbx_sfty_msr_tq_req "Recent MSR torque request" UBYTE _CNV_S_2_RANGE______3_CM 1 0. 0. 1. ECU_ADDRESS 0xd0005ca2 BIT_MASK 0x1 /end MEASUREMENT
/begin MEASUREMENT Vbx_sfty_msr_tq_req_plau "Torque requests by MSR are plausible" UBYTE _CNV_S_2_RANGE______3_CM 1 0. 0. 1. ECU_ADDRESS 0xd0005ca3 BIT_MASK 0x1 /end MEASUREMENT
/begin CHARACTERISTIC Cxx_sfty_asr_tqe_sp_msr_raw "Raw value of ASR setpoint during MSR requests" VALUE 0xa0021f14 _REC_S1VAL_20_u2 65535. _CNV_A_R_ECME_LINEA_0_CM 0. 65535. FORMAT "%5.0" /end CHARACTERISTIC
/begin CHARACTERISTIC Cxx_sfty_mux_agb_tqe_nok_raw "Raw invalid value of AGB torque requests" VALUE 0xa0021f16 _REC_S1VAL_20_u2 65535. _CNV_A_R_ECME_LINEA_0_CM 0. 65535. FORMAT "%5.0" /end CHARACTERISTIC
/begin CHARACTERISTIC Cxx_sfty_mux_asr_tqe_nok_raw "Raw invalid value of AGB torque requests" VALUE 0xa0021f18 _REC_S1VAL_20_u2 65535. _CNV_A_R_ECME_LINEA_0_CM 0. 65535. FORMAT "%5.0" /end CHARACTERISTIC
/begin MEASUREMENT Vbx_sfty_cru_brk "Brake pedal on for safety monitoring" UBYTE _CNV_S_2_RANGE______3_CM 1 0. 0. 1. ECU_ADDRESS 0xd0005d53 BIT_MASK 0x1 /end MEASUREMENT
/begin MEASUREMENT Vbx_sfty_cru_brk_pdl_ok "Valid brake pedal for safety monitoring" UBYTE _CNV_S_2_RANGE______3_CM 1 0. 0. 1. ECU_ADDRESS 0xd0005d54 BIT_MASK 0x1 /end MEASUREMENT
/begin MEASUREMENT Vbx_sfty_cru_brk_pdl_ok_tmp "Brake pedal information is valid" UBYTE _CNV_S_2_RANGE______3_CM 1 0. 0. 1. ECU_ADDRESS 0xd0005d55 BIT_MASK 0x1 /end MEASUREMENT
/begin MEASUREMENT Vbx_sfty_cru_forc_on "Cruise control requests force" UBYTE _CNV_S_2_RANGE______3_CM 1 0. 0. 1. ECU_ADDRESS 0xd0005d56 BIT_MASK 0x1 /end MEASUREMENT
/begin MEASUREMENT Vbx_sfty_cru_on "Cruise control is ON" UBYTE _CNV_S_2_RANGE______3_CM 1 0. 0. 1. ECU_ADDRESS 0xd0005d57 BIT_MASK 0x1 /end MEASUREMENT
/begin MEASUREMENT Vbx_sfty_cru_resu_acel_decl "Either resume, + or - cruise control switches are pressed" UBYTE _CNV_S_2_RANGE______3_CM 1 0. 0. 1. ECU_ADDRESS 0xd0005d58 BIT_MASK 0x1 /end MEASUREMENT
/begin MEASUREMENT Vbx_sfty_cru_stt_act "Cruise control is in active state" UBYTE _CNV_S_2_RANGE______3_CM 1 0. 0. 1. ECU_ADDRESS 0xd0005d59 BIT_MASK 0x1 /end MEASUREMENT
/begin MEASUREMENT Vbx_sfty_cru_tq_req_plau "A cruise control torque request is plausible" UBYTE _CNV_S_2_RANGE______3_CM 1 0. 0. 1. ECU_ADDRESS 0xd0005d5a BIT_MASK 0x1 /end MEASUREMENT
/begin MEASUREMENT Vbx_sfty_cru_tq_req_plau_tmp_1 "A cruise control torque request is plausible (before debounce)" UBYTE _CNV_S_2_RANGE______3_CM 1 0. 0. 1. ECU_ADDRESS 0xd0005d5b BIT_MASK 0x1 /end MEASUREMENT
/begin MEASUREMENT Vbx_sfty_cru_tq_req_plau_tmp_2 "A cruise control torque request is plausible (before debounce)" UBYTE _CNV_S_2_RANGE______3_CM 1 0. 0. 1. ECU_ADDRESS 0xd0005d5c BIT_MASK 0x1 /end MEASUREMENT
/begin MEASUREMENT Vxx_sfty_cru_brk_t_1 "Short brake pedal first confirmation timer" UBYTE _CNV_A_R_LINEAR_____153_CM 1 0. 0. 10.2 ECU_ADDRESS 0xd0005d5d FORMAT "%4.2" /end MEASUREMENT
/begin MEASUREMENT Vxx_sfty_cru_brk_t_2 "Short brake pedal second confirmation timer" UBYTE _CNV_A_R_LINEAR_____153_CM 1 0. 0. 10.2 ECU_ADDRESS 0xd0005d5e FORMAT "%4.2" /end MEASUREMENT
/begin MEASUREMENT Vxx_sfty_cru_brk_t_long "Long brake pedal confirmation timer" UBYTE _CNV_A_R_LINEAR_____153_CM 1 0. 0. 10.2 ECU_ADDRESS 0xd0005d5f FORMAT "%4.2" /end MEASUREMENT
/begin CHARACTERISTIC Cxx_sfty_cru_brk_nok_t "Invalid brake pedal confirmation time" VALUE 0xa0021f44 _REC_S1VAL_20_u1 10.2 _CNV_A_R_LINEAR_____153_CM 0. 10.2 FORMAT "%4.2" /end CHARACTERISTIC
/begin CHARACTERISTIC Cxx_sfty_cru_brk_tout_1 "Short brake pedal first confirmation time" VALUE 0xa0021f45 _REC_S1VAL_20_u1 10.2 _CNV_A_R_LINEAR_____153_CM 0. 10.2 FORMAT "%4.2" /end CHARACTERISTIC
/begin CHARACTERISTIC Cxx_sfty_cru_brk_tout_2 "Short brake pedal second confirmation time" VALUE 0xa0021f46 _REC_S1VAL_20_u1 10.2 _CNV_A_R_LINEAR_____153_CM 0. 10.2 FORMAT "%4.2" /end CHARACTERISTIC
/begin CHARACTERISTIC Cxx_sfty_cru_brk_tout_long "Long brake pedal confirmation time" VALUE 0xa0021f47 _REC_S1VAL_20_u1 10.2 _CNV_A_R_LINEAR_____153_CM 0. 10.2 FORMAT "%4.2" /end CHARACTERISTIC
/begin CHARACTERISTIC Cxx_sfty_cru_rest_max_v "Max voltage for wheel cruise control switch positions resume, +, or -" VALUE 0xa0021f40 _REC_S1VAL_20_u2 25000. _CNV_A_R_LINEAR_____52_CM 0. 25000. FORMAT "%5.0" /end CHARACTERISTIC
/begin CHARACTERISTIC Cxx_sfty_cru_rest_min_v "Min voltage for wheel cruise control switch positions resume, +, or -" VALUE 0xa0021f42 _REC_S1VAL_20_u2 25000. _CNV_A_R_LINEAR_____52_CM 0. 25000. FORMAT "%5.0" /end CHARACTERISTIC
/begin CHARACTERISTIC Cxx_sfty_cru_tq_req_t "Valid cruise control torque request debounce time" VALUE 0xa0021f48 _REC_S1VAL_20_u1 10.2 _CNV_A_R_LINEAR_____153_CM 0. 10.2 FORMAT "%4.2" /end CHARACTERISTIC
/begin AXIS_PTS Ctb_sfty_acel_pdl_fmt "Pedal ratio breakpoints for pedal progressivity maps (for safety)" 0xa00224c4 Vxx_sfty_acel_pdl_rat _REC_A2AXS_20_u2 1.25 _CNV_A_R_LINEAR_____257_CM 17 0. 1.25 FORMAT "%7.5" /end AXIS_PTS
/begin CHARACTERISTIC Ctp_sfty_acel_pdl_fmt_1 "Pedal progressivity map n∞1 (for safety)" CURVE 0xa00224e8 _REC_A1CUR_20_u2_u2 1. _CNV_A_R_LINEAR_____185_CM 0. 1. FORMAT "%7.5"
 /begin AXIS_DESCR COM_AXIS Vxx_sfty_acel_pdl_rat _CNV_A_R_LINEAR_____257_CM 17 0. 1.25 FORMAT "%7.5" AXIS_PTS_REF Ctb_sfty_acel_pdl_fmt /end AXIS_DESCR
/end CHARACTERISTIC
/begin CHARACTERISTIC Ctp_sfty_acel_pdl_fmt_2 "Pedal progressivity map n∞2 (for safety)" CURVE 0xa002250c _REC_A1CUR_20_u2_u2 1. _CNV_A_R_LINEAR_____185_CM 0. 1. FORMAT "%7.5"
 /begin AXIS_DESCR COM_AXIS Vxx_sfty_acel_pdl_rat _CNV_A_R_LINEAR_____257_CM 17 0. 1.25 FORMAT "%7.5" AXIS_PTS_REF Ctb_sfty_acel_pdl_fmt /end AXIS_DESCR
/end CHARACTERISTIC
/begin MEASUREMENT Vxx_sfty_acel_pdl_pwt_sp "Powertrain setpoint (%) requested by the driver via the accelerator pedal (for safety)" UWORD _CNV_A_R_LINEAR_____185_CM 1 0. 0. 1. ECU_ADDRESS 0xd0005c68 FORMAT "%7.5" /end MEASUREMENT
/begin MEASUREMENT Vxx_sfty_driv_pwt_sp "Powertrain setpoint (%) requested by real (pedal) and virtual (ACC/CC/SL) drivers (for safety)" UWORD _CNV_A_R_LINEAR_____185_CM 1 0. 0. 1. ECU_ADDRESS 0xd0005c6a FORMAT "%7.5" /end MEASUREMENT
/begin CHARACTERISTIC Cxx_sfty_acel_pdl_fmt_rvr_fac "Pedal progressivity correction factor for reverse gear (for safety)" VALUE 0xa0021f28 _REC_S1VAL_20_u1 2.55 _CNV_A_R_LINEAR_____136_CM 0. 2.55 FORMAT "%4.2" /end CHARACTERISTIC
/begin CHARACTERISTIC Cxx_sfty_lih_off_t "Pedal limp home zero-request confirmation time (for safety monitoring)" VALUE 0xa0021f29 _REC_S1VAL_20_u1 10.2 _CNV_A_R_LINEAR_____153_CM 0. 10.2 FORMAT "%4.2" /end CHARACTERISTIC
/begin AXIS_PTS Ctb_sfty_ajs_n "9 programmables engine speed breakpoints map" 0xa002214c Vxx_sfty_n _REC_A2AXS_20_u1 8160. _CNV_A_R_LINEAR_____2_CM 9 0. 8160. FORMAT "%4.0" /end AXIS_PTS
/begin AXIS_PTS Ctb_sfty_driv_tqe_map_n "Engine speed breakpoints for engine torque setpoint map for safety" 0xa0022158 Vxx_sfty_n _REC_A2AXS_20_u1 8160. _CNV_A_R_LINEAR_____2_CM 20 0. 8160. FORMAT "%4.0" /end AXIS_PTS
/begin AXIS_PTS Ctb_sfty_driv_tqe_map_pwt_sp "Powertrain setpoint breakpoints for engine torque setpoint map for safety" 0xa0022170 Vxx_sfty_driv_pwt_sp _REC_A2AXS_20_u2 1. _CNV_A_R_LINEAR_____185_CM 17 0. 1. FORMAT "%7.5" /end AXIS_PTS
/begin AXIS_PTS Ctb_sfty_min_driv_tqe_pwt_sp "Powertrain setpoint breakpoints for minimum driver engine torque factor (for safety monitoring)" 0xa0022194 Vxx_sfty_driv_pwt_sp _REC_A2AXS_20_u2 1. _CNV_A_R_LINEAR_____185_CM 17 0. 1. FORMAT "%7.5" /end AXIS_PTS
/begin AXIS_PTS Ctb_sfty_min_tqe_n "Engine speed breakpoint" 0xa0021ef8 Vxx_sfty_n_min_tqe_agb_fac _REC_A2AXS_20_u1 8160. _CNV_A_R_LINEAR_____2_CM 5 0. 8160. FORMAT "%4.0" /end AXIS_PTS
/begin CHARACTERISTIC Cmp_sfty_driv_tqe_map "Map giving effective engine torque setpoint from powertrain setpoint and engine speed for safety" MAP 0xa00221b8 _REC_A1MAP_20_u2_u2_u1 2047.96875 _CNV_A_R_LINEAR_____123_CM 0. 2047.96875 FORMAT "%10.5"
 /begin AXIS_DESCR COM_AXIS Vxx_sfty_driv_pwt_sp _CNV_A_R_LINEAR_____185_CM 17 0. 1. FORMAT "%7.5" AXIS_PTS_REF Ctb_sfty_driv_tqe_map_pwt_sp /end AXIS_DESCR
 /begin AXIS_DESCR COM_AXIS Vxx_sfty_n _CNV_A_R_LINEAR_____2_CM 20 0. 8160. FORMAT "%4.0" AXIS_PTS_REF Ctb_sfty_driv_tqe_map_n /end AXIS_DESCR
/end CHARACTERISTIC
/begin CHARACTERISTIC Ctp_sfty_driv_tq_fil_acel "filtering coefficient for driver torque request during acceleration phase (for safety)" CURVE 0xa0022460 _REC_A1CUR_20_u1_u1 0.99609375 _CNV_A_R_LINEAR_____31_CM 0. 0.99609375 FORMAT "%5.3"
 /begin AXIS_DESCR COM_AXIS Vxx_sfty_n _CNV_A_R_LINEAR_____2_CM 9 0. 8160. FORMAT "%4.0" AXIS_PTS_REF Ctb_sfty_ajs_n /end AXIS_DESCR
/end CHARACTERISTIC
/begin CHARACTERISTIC Ctp_sfty_driv_tq_fil_decl "filtering coefficient for driver torque request during deceleration phase (for safety)" CURVE 0xa002246c _REC_A1CUR_20_u1_u1 0.99609375 _CNV_A_R_LINEAR_____31_CM 0. 0.99609375 FORMAT "%5.3"
 /begin AXIS_DESCR COM_AXIS Vxx_sfty_n _CNV_A_R_LINEAR_____2_CM 9 0. 8160. FORMAT "%4.0" AXIS_PTS_REF Ctb_sfty_ajs_n /end AXIS_DESCR
/end CHARACTERISTIC
/begin CHARACTERISTIC Ctp_sfty_min_driv_tqe_map "Format the powertrain setpoint to disable the minimum driver engine torque (for safety monitoring)" CURVE 0xa0022478 _REC_A1CUR_20_u2_u2 1. _CNV_A_R_LINEAR_____185_CM 0. 1. FORMAT "%7.5"
 /begin AXIS_DESCR COM_AXIS Vxx_sfty_driv_pwt_sp _CNV_A_R_LINEAR_____185_CM 17 0. 1. FORMAT "%7.5" AXIS_PTS_REF Ctb_sfty_min_driv_tqe_pwt_sp /end AXIS_DESCR
/end CHARACTERISTIC
/begin CHARACTERISTIC Ctp_sfty_min_tqe_agb_fac "automatic gearbox torque factor" CURVE 0xa0021efe _REC_A1CUR_20_u1_u1 0.99609375 _CNV_A_R_LINEAR_____31_CM 0. 0.99609375 FORMAT "%5.3"
 /begin AXIS_DESCR COM_AXIS Vxx_sfty_n_min_tqe_agb_fac _CNV_A_R_LINEAR_____2_CM 5 0. 8160. FORMAT "%4.0" AXIS_PTS_REF Ctb_sfty_min_tqe_n /end AXIS_DESCR
/end CHARACTERISTIC
/begin MEASUREMENT Vbx_ajs_cut_mon "Boolean variable to cut (1) the anti-jerk strategy for fuel cut off monitoring" UBYTE _CNV_S_2_RANGE______3_CM 1 0. 0. 1. ECU_ADDRESS 0xd0005dac BIT_MASK 0x1 /end MEASUREMENT
/begin MEASUREMENT Vxx_sfty_ajs_modu_tqe "Final Torque after AJS Modulation action for safety" UWORD _CNV_A_R_LINEAR_____161_CM 1 0. -400. 1647.96875 ECU_ADDRESS 0xd0005da0 FORMAT "%10.5" /end MEASUREMENT
/begin MEASUREMENT Vxx_sfty_arb_tqe "Torque before AJS Correction action for safety" UWORD _CNV_A_R_LINEAR_____161_CM 1 0. -400. 1647.96875 ECU_ADDRESS 0xd0005da2 FORMAT "%10.5" /end MEASUREMENT
/begin MEASUREMENT Vxx_sfty_driv_tqe_sp "Effective engine torque requested by real (pedal) and virtual (ACC/CC/SL) drivers for safety" UWORD _CNV_A_R_LINEAR_____161_CM 1 0. -400. 1647.96875 ECU_ADDRESS 0xd0005da4 FORMAT "%10.5" /end MEASUREMENT
/begin MEASUREMENT Vxx_sfty_lim_driv_tqe "Effective engine torque requested by real (pedal) and virtual (ACC/CC/SL) drivers for safety" UWORD _CNV_A_R_LINEAR_____161_CM 1 0. -400. 1647.96875 ECU_ADDRESS 0xd0005da6 FORMAT "%10.5" /end MEASUREMENT
/begin MEASUREMENT Vxx_sfty_min_avl_tqe "minimum available engine torque for safety" UWORD _CNV_A_R_LINEAR_____161_CM 1 0. -400. 1647.96875 ECU_ADDRESS 0xd0005da8 FORMAT "%10.5" /end MEASUREMENT
/begin MEASUREMENT Vxx_sfty_n_min_tqe_agb_fac "Input variable for automatic gearbox torque calculation" UBYTE _CNV_A_R_LINEAR_____2_CM 1 0. 0. 8160. ECU_ADDRESS 0xd0005dad FORMAT "%4.0" /end MEASUREMENT
/begin MEASUREMENT Vxx_sfty_tqi_sp "Final indicated setpoint torque for safety" UWORD _CNV_A_R_LINEAR_____123_CM 1 0. 0. 2047.96875 ECU_ADDRESS 0xd0005daa FORMAT "%10.5" /end MEASUREMENT
/begin CHARACTERISTIC Cxx_sfty_agb_max_tqe_cor "Value of maximum torque allowed for AT torque converter (for safety)" VALUE 0xa0021f04 _REC_S1VAL_20_u2 2047.96875 _CNV_A_R_LINEAR_____123_CM 0. 2047.96875 FORMAT "%10.5" /end CHARACTERISTIC
/begin CHARACTERISTIC Cxx_sfty_is_n_t "Idle speed authorization exit time" VALUE 0xa0021f10 _REC_S1VAL_20_u1 10.2 _CNV_A_R_LINEAR_____153_CM 0. 10.2 FORMAT "%4.2" /end CHARACTERISTIC
/begin CHARACTERISTIC Cxx_sfty_is_n_thd "maximum engine speed value for authorized idle speed torque for safety" VALUE 0xa0021f11 _REC_S1VAL_20_u1 8160. _CNV_A_R_LINEAR_____2_CM 0. 8160. FORMAT "%4.0" /end CHARACTERISTIC
/begin CHARACTERISTIC Cxx_sfty_is_tqe_sp_max "maximum value for idle speed torque for safety" VALUE 0xa0021f06 _REC_S1VAL_20_s2 2047.96875 _CNV_A_R_LINEAR_____123_CM -1024. 1023.96875 FORMAT "%11.5" /end CHARACTERISTIC
/begin CHARACTERISTIC Cxx_sfty_max_is_n_sp "maximum value for Final idle speed setpoint for safety" VALUE 0xa0021f12 _REC_S1VAL_20_u1 8160. _CNV_A_R_LINEAR_____2_CM 0. 8160. FORMAT "%4.0" /end CHARACTERISTIC
/begin CHARACTERISTIC Cxx_sfty_max_l_eng_tq "Max value of low engine minimum torque (for safety monitoring)" VALUE 0xa0021f08 _REC_S1VAL_20_u2 2047.96875 _CNV_A_R_LINEAR_____123_CM 0. 2047.96875 FORMAT "%10.5" /end CHARACTERISTIC
/begin CHARACTERISTIC Cxx_sfty_tkof_end_vs_thd "Threshold of vehicle speed to exit of take off state (for safety monitoring)" VALUE 0xa0021f0a _REC_S1VAL_20_u2 655.35 _CNV_A_R_LINEAR_____70_CM 0. 655.35 FORMAT "%6.2" /end CHARACTERISTIC
/begin CHARACTERISTIC Cxx_sfty_tkof_n_thd "Engine speed threshold below which take off correction is applied (for safety)" VALUE 0xa0021f13 _REC_S1VAL_20_u1 8160. _CNV_A_R_LINEAR_____2_CM 0. 8160. FORMAT "%4.0" /end CHARACTERISTIC
/begin CHARACTERISTIC Cxx_sfty_tkof_pwt_sp_thd "Powertrain setpoint threshold for take off" VALUE 0xa0021f0c _REC_S1VAL_20_u2 1. _CNV_A_R_LINEAR_____185_CM 0. 1. FORMAT "%7.5" /end CHARACTERISTIC
/begin CHARACTERISTIC Cxx_sfty_tkof_tqe_cor "torque correction for take off (for safety)" VALUE 0xa0021f0e _REC_S1VAL_20_u2 2047.96875 _CNV_A_R_LINEAR_____161_CM -400. 1647.96875 FORMAT "%10.5" /end CHARACTERISTIC
/begin MEASUREMENT Vbx_sfty_acel_pdl_fil_sens_v1 "Accelerator pedal sensor track 1 evolution condition for safety" UBYTE _CNV_S_2_RANGE______3_CM 1 0. 0. 1. ECU_ADDRESS 0xd0005c76 BIT_MASK 0x1 /end MEASUREMENT
/begin MEASUREMENT Vbx_sfty_acel_pdl_fil_sens_v2 "Accelerator pedal sensor track 2 evolution condition for safety" UBYTE _CNV_S_2_RANGE______3_CM 1 0. 0. 1. ECU_ADDRESS 0xd0005c77 BIT_MASK 0x1 /end MEASUREMENT
/begin MEASUREMENT Vxx_sfty_acel_pdl_fil_sens_v1 "Filtered accelerator pedal sensor output voltage : track 1 for safety" UWORD _CNV_A_R_LINEAR_____125_CM 1 0. 0. 0.9990234375 ECU_ADDRESS 0xd0005c6c FORMAT "%11.9" /end MEASUREMENT
/begin MEASUREMENT Vxx_sfty_acel_pdl_fil_sens_v2 "Filtered accelerator pedal sensor output voltage : track 2 for safety" UWORD _CNV_A_R_LINEAR_____125_CM 1 0. 0. 0.9990234375 ECU_ADDRESS 0xd0005c6e FORMAT "%11.9" /end MEASUREMENT
/begin MEASUREMENT Vxx_sfty_acel_pdl_rat "Normalised accelerator pedal position (for safety)" UWORD _CNV_A_R_LINEAR_____257_CM 1 0. 0. 1.25 ECU_ADDRESS 0xd0005c70 FORMAT "%7.5" /end MEASUREMENT
/begin MEASUREMENT Vxx_sfty_acel_pdl_sens_rat1 "Accelerator pedal sensor output voltage ratio : track 1 for safety" UWORD _CNV_A_R_LINEAR_____125_CM 1 0. 0. 0.9990234375 ECU_ADDRESS 0xd0005c72 FORMAT "%11.9" /end MEASUREMENT
/begin MEASUREMENT Vxx_sfty_acel_pdl_sens_rat2 "Accelerator pedal sensor output voltage ratio : track 2 for safety" UWORD _CNV_A_R_LINEAR_____125_CM 1 0. 0. 0.9990234375 ECU_ADDRESS 0xd0005c74 FORMAT "%11.9" /end MEASUREMENT
/begin CHARACTERISTIC Cxx_sfty_acel_pdl_0_rat_v1 "Uref ratio value defining 0 pedal ratio position (for safety)" VALUE 0xa0021eec _REC_S1VAL_20_u2 0.9990234375 _CNV_A_R_LINEAR_____125_CM 0. 0.9990234375 FORMAT "%11.9" /end CHARACTERISTIC
/begin CHARACTERISTIC Cxx_sfty_acel_pdl_0_rat_v2 "Uref ratio value defining 0 pedal ratio position of track 2 (for safety)" VALUE 0xa0021eee _REC_S1VAL_20_u2 0.9990234375 _CNV_A_R_LINEAR_____125_CM 0. 0.9990234375 FORMAT "%11.9" /end CHARACTERISTIC
/begin CHARACTERISTIC Cxx_sfty_acel_pdl_100_rat_v1 "Uref ratio value defining 1 pedal ratio position (for safety)" VALUE 0xa0021ef0 _REC_S1VAL_20_u2 0.9990234375 _CNV_A_R_LINEAR_____125_CM 0. 0.9990234375 FORMAT "%11.9" /end CHARACTERISTIC
/begin CHARACTERISTIC Cxx_sfty_acel_pdl_100_rat_v2 "Uref ratio value defining 1 pedal ratio position of track 2 (for safety)" VALUE 0xa0021ef2 _REC_S1VAL_20_u2 0.9990234375 _CNV_A_R_LINEAR_____125_CM 0. 0.9990234375 FORMAT "%11.9" /end CHARACTERISTIC
/begin CHARACTERISTIC Cxx_sfty_acel_pdl_sens_pws "Accelerator pedal sensor power supply for safety" VALUE 0xa0021ef4 _REC_S1VAL_20_u2 25000. _CNV_A_R_LINEAR_____52_CM 0. 25000. FORMAT "%5.0" /end CHARACTERISTIC
/begin CHARACTERISTIC Cxx_sfty_acel_pdl_stab_thd "Accelerator pedal signal stabilization threshold for safety" VALUE 0xa0021ef6 _REC_S1VAL_20_u2 0.9990234375 _CNV_A_R_LINEAR_____125_CM 0. 0.9990234375 FORMAT "%11.9" /end CHARACTERISTIC
/begin AXIS_PTS Ctb_sfty_acel_fmt_tkof_fac_vs "Vehicle speed breakpoints for \"take off map\" giving transition factor between 2 progressivity maps (for safety torque monitoring)" 0xa0022104 Vxx_vs _REC_A2AXS_20_u2 655.35 _CNV_A_R_LINEAR_____70_CM 5 0. 655.35 FORMAT "%6.2" /end AXIS_PTS
/begin AXIS_PTS Ctb_sfty_acel_pdl_fmt_fac_vs "Vehicle speed breakpoints for map giving transition factor between 2 progressivity maps (for safety torque monitoring)" 0xa0022110 Vxx_vs _REC_A2AXS_20_u2 655.35 _CNV_A_R_LINEAR_____70_CM 9 0. 655.35 FORMAT "%6.2" /end AXIS_PTS
/begin AXIS_PTS Ctb_sfty_acel_tkof_fac_driv "take off assistance factor breakpoints for \"take off map\" giving transition factor between 2 progressivity maps (for safety torque" 0xa0021f34 Vxx_tkof_ass_fac _REC_A2AXS_20_u1 1. _CNV_A_R_LINEAR_____216_CM 5 0. 1. FORMAT "%5.3" /end AXIS_PTS
/begin CHARACTERISTIC Cmp_sfty_acel_pdl_fmt_fac "Vehicle speed and driving style map giving transition factor between 2 progressivity maps (for safety)" MAP 0xa0022124 _REC_A1MAP_20_u1_u2_u1 0.99609375 _CNV_A_R_LINEAR_____31_CM 0. 0.99609375 FORMAT "%5.3"
 /begin AXIS_DESCR COM_AXIS Vxx_vs _CNV_A_R_LINEAR_____70_CM 5 0. 655.35 FORMAT "%6.2" AXIS_PTS_REF Ctb_sfty_acel_fmt_tkof_fac_vs /end AXIS_DESCR
 /begin AXIS_DESCR COM_AXIS Vxx_tkof_ass_fac _CNV_A_R_LINEAR_____216_CM 5 0. 1. FORMAT "%5.3" AXIS_PTS_REF Ctb_sfty_acel_tkof_fac_driv /end AXIS_DESCR
/end CHARACTERISTIC
/begin CHARACTERISTIC Ctp_sfty_acel_pdl_fmt_fac "Vehicle speed map giving nominal factor between 2 progressivity maps (for torque safety monitoring)" CURVE 0xa0022140 _REC_A1CUR_20_u1_u2 0.99609375 _CNV_A_R_LINEAR_____31_CM 0. 0.99609375 FORMAT "%5.3"
 /begin AXIS_DESCR COM_AXIS Vxx_vs _CNV_A_R_LINEAR_____70_CM 9 0. 655.35 FORMAT "%6.2" AXIS_PTS_REF Ctb_sfty_acel_pdl_fmt_fac_vs /end AXIS_DESCR
/end CHARACTERISTIC
/begin MEASUREMENT Vxx_sfty_acel_pdl_fmt_fac "Interpolation factor between pedal progressivity maps (0<=>map1, 1<=>map2) (for safety torque monitoring)" UBYTE _CNV_A_R_LINEAR_____31_CM 1 0. 0. 0.99609375 ECU_ADDRESS 0xd0005dc8 FORMAT "%5.3" /end MEASUREMENT
/begin CHARACTERISTIC Cxx_sfty_pdl_fmt_slop_down "Slope constant used during the change of progressivity maps, when decreasing (for safety torque monitoring)" VALUE 0xa0021f3e _REC_S1VAL_20_u1 0.99609375 _CNV_A_R_LINEAR_____470_CM 0. 0.99609375 FORMAT "%5.3" /end CHARACTERISTIC
/begin CHARACTERISTIC Cxx_sfty_pdl_fmt_slop_up "Slope constant used during the change of progressivity maps, when increasing (for safety torque monitoring)" VALUE 0xa0021f3f _REC_S1VAL_20_u1 0.99609375 _CNV_A_R_LINEAR_____470_CM 0. 0.99609375 FORMAT "%5.3" /end CHARACTERISTIC
/begin CHARACTERISTIC Cxx_sfty_tkof_cdn_vs_max "Maximum vehicule speed to detect that the vehicules is in take off conditions (for safety torque monitoring)" VALUE 0xa0021f3a _REC_S1VAL_20_u2 655.35 _CNV_A_R_LINEAR_____70_CM 0. 655.35 FORMAT "%6.2" /end CHARACTERISTIC
/begin CHARACTERISTIC Cxx_sfty_tkof_stop_vs "Limit vehicule speed that determines the end of a take off (for safety torque monitoring)" VALUE 0xa0021f3c _REC_S1VAL_20_u2 655.35 _CNV_A_R_LINEAR_____70_CM 0. 655.35 FORMAT "%6.2" /end CHARACTERISTIC
/begin CHARACTERISTIC Cmp_sfty_map_n_esti_tqi "Map of estimated engine indicated torque from manifold air pressure (for safety)" MAP 0xa0021fac _REC_A1MAP_20_u2_u2_u1 2047.96875 _CNV_A_R_LINEAR_____123_CM 0. 2047.96875 FORMAT "%10.5"
 /begin AXIS_DESCR COM_AXIS Vxx_map _CNV_A_R_LINEAR_____57_CM 9 0. 20000. FORMAT "%5.0" AXIS_PTS_REF Ctb_sfty_map /end AXIS_DESCR
 /begin AXIS_DESCR COM_AXIS Vxx_sfty_n _CNV_A_R_LINEAR_____2_CM 11 0. 8160. FORMAT "%4.0" AXIS_PTS_REF Ctb_sfty_n /end AXIS_DESCR
/end CHARACTERISTIC
/begin MEASUREMENT Vxx_sfty_esti_tqi "Estimated indicated torque from manifold air pressure (for safety)" UWORD _CNV_A_R_LINEAR_____123_CM 1 0. 0. 2047.96875 ECU_ADDRESS 0xd0005c86 FORMAT "%10.5" /end MEASUREMENT
/begin MEASUREMENT Vxx_sfty_esti_tqi_ctr "Counter of near-failures of torque realization check" UWORD _CNV_A_R_ECME_LINEA_0_CM 1 0. 0. 65535. DISPLAY_IDENTIFIER TqSafTsm_NVM.Vxx_sfty_esti_tqi_ctr_NVM ECU_ADDRESS 0xd0003a70 FORMAT "%5.0" /end MEASUREMENT
/begin MEASUREMENT Vxx_sfty_tqi_sp_ctr "Counter of near-failures of torque request check" UWORD _CNV_A_R_ECME_LINEA_0_CM 1 0. 0. 65535. DISPLAY_IDENTIFIER TqSafTsm_NVM.Vxx_sfty_tqi_sp_ctr_NVM ECU_ADDRESS 0xd0003a72 FORMAT "%5.0" /end MEASUREMENT
/begin MEASUREMENT Vbx_sfty_esti_tqi_ctr_inc_tmp "Near-failure of torque estimation before debouncing" UBYTE _CNV_S_2_RANGE______3_CM 1 0. 0. 1. ECU_ADDRESS 0xd0005249 BIT_MASK 0x1 /end MEASUREMENT
/begin MEASUREMENT Vbx_sfty_tqi_sp_ctr_inc_tmp "Near-failure of torque request before debouncing" UBYTE _CNV_S_2_RANGE______3_CM 1 0. 0. 1. ECU_ADDRESS 0xd000524a BIT_MASK 0x1 /end MEASUREMENT
/begin MEASUREMENT Vxx_sfty_esti_tqi_ctr_inc "Near-failure of torque estimation" UBYTE _CNV_A_R_ECME_LINEA_0_CM 1 0. 0. 1. ECU_ADDRESS 0xd000524b FORMAT "%1.0" /end MEASUREMENT
/begin MEASUREMENT Vxx_sfty_esti_tqi_ctr_last "Last value of Counter of near-failures of torque realization check" UWORD _CNV_A_R_ECME_LINEA_0_CM 1 0. 0. 65535. ECU_ADDRESS 0xd0005a76 FORMAT "%5.0" /end MEASUREMENT
/begin MEASUREMENT Vxx_sfty_esti_tqi_deb_thd2 "Threshold for safety torque realization near-failure detection" UWORD _CNV_A_R_ECME_LINEA_0_CM 1 0. 0. 65535. ECU_ADDRESS 0xd0005a78 FORMAT "%5.0" /end MEASUREMENT
/begin MEASUREMENT Vxx_sfty_tqi_sp_ctr_inc "Near-failure of torque request" UBYTE _CNV_A_R_ECME_LINEA_0_CM 1 0. 0. 1. ECU_ADDRESS 0xd000524c FORMAT "%1.0" /end MEASUREMENT
/begin MEASUREMENT Vxx_sfty_tqi_sp_ctr_last "Last value of counter of near-failures of torque request check" UWORD _CNV_A_R_ECME_LINEA_0_CM 1 0. 0. 65535. ECU_ADDRESS 0xd0005a7a FORMAT "%5.0" /end MEASUREMENT
/begin MEASUREMENT Vxx_sfty_tqi_sp_deb_thd2 "Threshold for safety torque setpoint near-failure detection" UWORD _CNV_A_R_ECME_LINEA_0_CM 1 0. 0. 65535. ECU_ADDRESS 0xd0005a7c FORMAT "%5.0" /end MEASUREMENT
/begin CHARACTERISTIC Cxx_sfty_esti_tqi_deb_thd_ofs "Offset of threshold for safety torque realization failure detection" VALUE 0xa0021b66 _REC_S1VAL_20_u2 65535. _CNV_A_R_ECME_LINEA_0_CM 0. 65535. FORMAT "%5.0" /end CHARACTERISTIC
/begin CHARACTERISTIC Cxx_sfty_esti_tqi_pos_err_ofs "Torque margin used for torque realization near-failure counter (for safety)" VALUE 0xa0021b68 _REC_S1VAL_20_u2 2047.96875 _CNV_A_R_LINEAR_____123_CM 0. 2047.96875 FORMAT "%10.5" /end CHARACTERISTIC
/begin CHARACTERISTIC Cxx_sfty_tqi_req_pos_err_ofs "Torque margin used for torque request near-failure counter (for safety)" VALUE 0xa0021b6a _REC_S1VAL_20_u2 2047.96875 _CNV_A_R_LINEAR_____123_CM 0. 2047.96875 FORMAT "%10.5" /end CHARACTERISTIC
/begin CHARACTERISTIC Cxx_sfty_tqi_sp_deb_thd_ofs "Offset of threshold for safety torque setpoint failure detection" VALUE 0xa0021b6c _REC_S1VAL_20_u2 65535. _CNV_A_R_ECME_LINEA_0_CM 0. 65535. FORMAT "%5.0" /end CHARACTERISTIC
/begin AXIS_PTS Ctb_sfty_thr_lih_n "12 programmable engine speed breakpoints map" 0xa002249c Vxx_sfty_n _REC_A2AXS_20_u1 8160. _CNV_A_R_LINEAR_____2_CM 12 0. 8160. FORMAT "%4.0" /end AXIS_PTS
/begin CHARACTERISTIC Ctp_sfty_thr_lih_map "breakpoint for manifold pressure value during throttle limp home" CURVE 0xa00224ac _REC_A1CUR_20_u2_u1 20000. _CNV_A_R_LINEAR_____57_CM 0. 20000. FORMAT "%5.0"
 /begin AXIS_DESCR COM_AXIS Vxx_sfty_n _CNV_A_R_LINEAR_____2_CM 12 0. 8160. FORMAT "%4.0" AXIS_PTS_REF Ctb_sfty_thr_lih_n /end AXIS_DESCR
/end CHARACTERISTIC
/begin MEASUREMENT Vbx_sfty_thr_lih_mon_nok "boolean which indicates that the throttle limp home doesn't execut correctly for safety" UBYTE _CNV_S_2_RANGE______3_CM 1 0. 0. 1. ECU_ADDRESS 0xd0005ca9 BIT_MASK 0x1 /end MEASUREMENT
/begin CHARACTERISTIC Cxx_sfty_map_thd "manifold pressure threshold for detection that the throttle limp home doesn't execut correctly" VALUE 0xa0021f2c _REC_S1VAL_20_u2 20000. _CNV_A_R_LINEAR_____57_CM 0. 20000. FORMAT "%5.0" /end CHARACTERISTIC
/begin CHARACTERISTIC Cxx_sfty_thr_lih_mon_ini_dly "Initialization time of the throttle limp home manifold pressure failure detection" VALUE 0xa0021f2e _REC_S1VAL_20_u1 10.2 _CNV_A_R_LINEAR_____153_CM 0. 10.2 FORMAT "%4.2" /end CHARACTERISTIC
/begin COMPU_METHOD _CNV_A_R_ECME_LINEA_0_CM "" RAT_FUNC "%6.3" "-" COEFFS 0 1. 0. 0 0 1 /end COMPU_METHOD
/begin COMPU_METHOD _CNV_A_R_LINEAR_____2_CM "" RAT_FUNC "%6.3" "rpm" COEFFS 0 3.125e-002 0. 0 0 1 /end COMPU_METHOD
/begin COMPU_METHOD _CNV_S_2_RANGE______3_CM "" TAB_VERB "%6.3" "-" COMPU_TAB_REF _CNV_S_2_RANGE______3 /end COMPU_METHOD
/begin COMPU_VTAB _CNV_S_2_RANGE______3 "" TAB_VERB 2 0 "0" 1 "1" /end COMPU_VTAB
/begin COMPU_METHOD _CNV_A_R_LINEAR_____4_CM "" RAT_FUNC "%6.3" "s" COEFFS 0 10. 0. 0 0 1 /end COMPU_METHOD
/begin COMPU_METHOD _CNV_A_R_ENSD_LINEA_24_CM "" RAT_FUNC "%6.3" "rpm" COEFFS 0 4. 0. 0 0 1 /end COMPU_METHOD
/begin COMPU_METHOD _CNV_A_R_LINEAR_____31_CM "" RAT_FUNC "%6.3" "-" COEFFS 0 256. 0. 0 0 1 /end COMPU_METHOD
/begin COMPU_METHOD _CNV_A_R_LINEAR_____50_CM "" RAT_FUNC "%6.3" "µs" COEFFS 0 0.25 0. 0 0 1 /end COMPU_METHOD
/begin COMPU_METHOD _CNV_A_R_LINEAR_____52_CM "" RAT_FUNC "%6.3" "mV" COEFFS 0 1. 0. 0 0 1 /end COMPU_METHOD
/begin COMPU_METHOD _CNV_A_R_LINEAR_____54_CM "" RAT_FUNC "%6.3" "∞C" COEFFS 0 10. 400. 0 0 1 /end COMPU_METHOD
/begin COMPU_METHOD _CNV_A_R_LINEAR_____57_CM "" RAT_FUNC "%6.3" "hPa" COEFFS 0 1. 0. 0 0 1 /end COMPU_METHOD
/begin COMPU_METHOD _CNV_A_R_LINEAR_____58_CM "" RAT_FUNC "%6.3" "s" COEFFS 0 1000. 0. 0 0 1 /end COMPU_METHOD
/begin COMPU_METHOD _CNV_A_R_LINEAR_____70_CM "" RAT_FUNC "%6.3" "km/h" COEFFS 0 100. 0. 0 0 1 /end COMPU_METHOD
/begin COMPU_METHOD _CNV_A_R_LINEAR_____76_CM "" RAT_FUNC "%6.3" "∞CRK" COEFFS 0 50. 0. 0 0 1 /end COMPU_METHOD
/begin COMPU_METHOD _CNV_A_R_LINEAR_____94_CM "" RAT_FUNC "%6.3" "%" COEFFS 0 100. 0. 0 0 1 /end COMPU_METHOD
/begin COMPU_METHOD _CNV_A_R_LINEAR_____99_CM "" RAT_FUNC "%6.3" "%" COEFFS 0 20. 0. 0 0 1 /end COMPU_METHOD
/begin COMPU_METHOD _CNV_A_R_LINEAR_____114_CM "" RAT_FUNC "%6.3" "%" COEFFS 0 2.55 0. 0 0 1 /end COMPU_METHOD
/begin COMPU_METHOD _CNV_S_3_STATUS_OK__120_CM "" TAB_VERB "%6.3" "-" COMPU_TAB_REF _CNV_S_3_STATUS_OK__120 /end COMPU_METHOD
/begin COMPU_VTAB _CNV_S_3_STATUS_OK__120 "" TAB_VERB 3 0 "Nsx_vld_nok_0" 1 "Nsx_vld_ok_1" 2 "Nsx_vld_fail_2" /end COMPU_VTAB
/begin COMPU_METHOD _CNV_A_R_LINEAR_____122_CM "" RAT_FUNC "%6.3" "%" COEFFS 0 655.35 0. 0 0 1 /end COMPU_METHOD
/begin COMPU_METHOD _CNV_A_R_LINEAR_____123_CM "" RAT_FUNC "%6.3" "Nm" COEFFS 0 32. 0. 0 0 1 /end COMPU_METHOD
/begin COMPU_METHOD _CNV_A_R_LINEAR_____125_CM "" RAT_FUNC "%6.3" "-" COEFFS 0 1024. 0. 0 0 1 /end COMPU_METHOD
/begin COMPU_METHOD _CNV_A_R_LINEAR_____136_CM "" RAT_FUNC "%6.3" "-" COEFFS 0 100. 0. 0 0 1 /end COMPU_METHOD
/begin COMPU_METHOD _CNV_A_R_LINEAR_____150_CM "" RAT_FUNC "%6.3" "V" COEFFS 0 100. 0. 0 0 1 /end COMPU_METHOD
/begin COMPU_METHOD _CNV_A_R_LINEAR_____153_CM "" RAT_FUNC "%6.3" "s" COEFFS 0 25. 0. 0 0 1 /end COMPU_METHOD
/begin COMPU_METHOD _CNV_A_R_LINEAR_____161_CM "" RAT_FUNC "%6.3" "Nm" COEFFS 0 32. 12800. 0 0 1 /end COMPU_METHOD
/begin COMPU_METHOD _CNV_A_R_A_165_CM "" RAT_FUNC "%6.3" "" COEFFS 0 1. 0. 0 0 1 /end COMPU_METHOD
/begin COMPU_METHOD _CNV_A_R_LINEAR_____185_CM "" RAT_FUNC "%6.3" "-" COEFFS 0 800. 0. 0 0 1 /end COMPU_METHOD
/begin COMPU_METHOD _CNV_A_R_LINEAR_____190_CM "" RAT_FUNC "%6.3" "∞C/s" COEFFS 0 10. 0. 0 0 1 /end COMPU_METHOD
/begin COMPU_METHOD _CNV_A_R_LINEAR_____211_CM "" RAT_FUNC "%6.3" "%" COEFFS 0 800. 0. 0 0 1 /end COMPU_METHOD
/begin COMPU_METHOD _CNV_A_R_LINEAR_____212_CM "" RAT_FUNC "%6.3" "km/h" COEFFS 0 1. 0. 0 0 1 /end COMPU_METHOD
/begin COMPU_METHOD _CNV_A_R_LINEAR_____216_CM "" RAT_FUNC "%6.3" "ratio" COEFFS 0 255. 0. 0 0 1 /end COMPU_METHOD
/begin COMPU_METHOD _CNV_A_R_LINEAR_____220_CM "" RAT_FUNC "%6.3" "∞C" COEFFS 0 1. 40. 0 0 1 /end COMPU_METHOD
/begin COMPU_METHOD _CNV_A_R_LINEAR_____257_CM "" RAT_FUNC "%6.3" "ratio" COEFFS 0 800. 0. 0 0 1 /end COMPU_METHOD
/begin COMPU_METHOD _CNV_A_R_LINEAR_____264_CM "" RAT_FUNC "%6.3" "∞CRK" COEFFS 0 0.3333333333333333 0. 0 0 1 /end COMPU_METHOD
/begin COMPU_METHOD _CNV_A_R_LINEAR_____345_CM "" RAT_FUNC "%6.3" "-" COEFFS 0 2.55 0. 0 0 1 /end COMPU_METHOD
/begin COMPU_METHOD _CNV_A_R_LINEAR_____431_CM "" RAT_FUNC "%6.3" "Nm" COEFFS 0 1. 0. 0 0 1 /end COMPU_METHOD
/begin COMPU_METHOD _CNV_R_R_VA_F_1_p1__440_CM "" RAT_FUNC "%6.3" "-" COEFFS 0. 1. -1. 0. 0. 1. /end COMPU_METHOD
/begin COMPU_METHOD _CNV_R_R_VA_F_0v000_442_CM "" RAT_FUNC "%6.3" "m/s2" COEFFS 0. 1. 0. 0. 0. 4.e-004 /end COMPU_METHOD
/begin COMPU_METHOD _CNV_R_R_VA_F_0v01__446_CM "" RAT_FUNC "%6.3" "km/h" COEFFS 0. 1. 0. 0. 0. 1.e-002 /end COMPU_METHOD
/begin COMPU_METHOD _CNV_S_2_VA_Bool_ON_448_CM "" TAB_VERB "%6.3" "." COMPU_TAB_REF _CNV_S_2_VA_Bool_ON_448 /end COMPU_METHOD
/begin COMPU_VTAB _CNV_S_2_VA_Bool_ON_448 "" TAB_VERB 2 0 "OFF" 1 "ON" /end COMPU_VTAB
/begin COMPU_METHOD _CNV_R_R_VA_I_16_449_CM "" RAT_FUNC "%6.3" "-" COEFFS 0. 1. 0. 0. 0. 1. /end COMPU_METHOD
/begin COMPU_METHOD _CNV_R_R_VA_F_10_p0_453_CM "" RAT_FUNC "%6.3" "W" COEFFS 0. 1. 0. 0. 0. 10. /end COMPU_METHOD
/begin COMPU_METHOD _CNV_R_R_VA_F_1_p0__456_CM "" RAT_FUNC "%6.3" "N.m" COEFFS 0. 1. 0. 0. 0. 1. /end COMPU_METHOD
/begin COMPU_METHOD _CNV_R_R_VA_F_0v1_m_461_CM "" RAT_FUNC "%6.3" "C" COEFFS 0. 1. 40. 0. 0. 0.1 /end COMPU_METHOD
/begin COMPU_METHOD _CNV_R_R_VA_F_0v004_462_CM "" RAT_FUNC "%6.3" "-" COEFFS 0. 1. 0. 0. 0. 4.e-003 /end COMPU_METHOD
/begin COMPU_METHOD _CNV_R_R_VA_F_1_p0__463_CM "" RAT_FUNC "%6.3" "kg" COEFFS 0. 1. 0. 0. 0. 1. /end COMPU_METHOD
/begin COMPU_METHOD _CNV_R_R_VA_F_0v031_464_CM "" RAT_FUNC "%6.3" "N.m" COEFFS 0. 1. 400. 0. 0. 3.125e-002 /end COMPU_METHOD
/begin COMPU_METHOD _CNV_R_R_VA_F_0v04__465_CM "" RAT_FUNC "%6.3" "s" COEFFS 0. 1. 0. 0. 0. 4.e-002 /end COMPU_METHOD
/begin COMPU_METHOD _CNV_R_R_VA_F_0v001_466_CM "" RAT_FUNC "%6.3" "m" COEFFS 0. 1. -0.2 0. 0. 1.e-003 /end COMPU_METHOD
/begin COMPU_METHOD _CNV_A_R_LINEAR_____467_CM "" RAT_FUNC "%6.3" "[-]" COEFFS 0 800. 0. 0 0 1 /end COMPU_METHOD
/begin COMPU_METHOD _CNV_S_3_ACTUATOR_T_468_CM "" TAB_VERB "%6.3" "[-]" COMPU_TAB_REF _CNV_S_3_ACTUATOR_T_468 /end COMPU_METHOD
/begin COMPU_VTAB _CNV_S_3_ACTUATOR_T_468 "" TAB_VERB 3 0 "Nsx_tac_wait" 2 "Nsx_tac_end" 12 "Nsx_tac_abrt" /end COMPU_VTAB
/begin COMPU_METHOD _CNV_A_R_LINEAR_____469_CM "" RAT_FUNC "%6.3" "W" COEFFS 0 2.5e-002 0. 0 0 1 /end COMPU_METHOD
/begin COMPU_METHOD _CNV_A_R_LINEAR_____470_CM "" RAT_FUNC "%6.3" "ratio/s" COEFFS 0 256. 0. 0 0 1 /end COMPU_METHOD
/begin RECORD_LAYOUT _REC_S1VAL_20_u4 FNC_VALUES 1 ULONG COLUMN_DIR DIRECT /end RECORD_LAYOUT
/begin RECORD_LAYOUT _REC_S1VAL_20_u1 FNC_VALUES 1 UBYTE COLUMN_DIR DIRECT /end RECORD_LAYOUT
/begin RECORD_LAYOUT _REC_A2AXS_20_u1 NO_AXIS_PTS_X 1 UBYTE AXIS_PTS_X 2 UBYTE INDEX_INCR DIRECT /end RECORD_LAYOUT
/begin RECORD_LAYOUT _REC_S1VAL_20_u2 FNC_VALUES 1 UWORD COLUMN_DIR DIRECT /end RECORD_LAYOUT
/begin RECORD_LAYOUT _REC_S1VAL_20_s2 FNC_VALUES 1 SWORD COLUMN_DIR DIRECT /end RECORD_LAYOUT
/begin RECORD_LAYOUT _REC_A2AXS_20_u2 NO_AXIS_PTS_X 1 UWORD AXIS_PTS_X 2 UWORD INDEX_INCR DIRECT /end RECORD_LAYOUT
/begin RECORD_LAYOUT _REC_A1CUR_20_u1_u2 FNC_VALUES 1 UBYTE COLUMN_DIR DIRECT /end RECORD_LAYOUT
/begin RECORD_LAYOUT _REC_A1CUR_20_u1_u1 FNC_VALUES 1 UBYTE COLUMN_DIR DIRECT /end RECORD_LAYOUT
/begin RECORD_LAYOUT _REC_A1CUR_20_u2_u1 FNC_VALUES 1 UWORD COLUMN_DIR DIRECT /end RECORD_LAYOUT
/begin RECORD_LAYOUT _REC_A1MAP_20_u1_u1_u1 FNC_VALUES 1 UBYTE COLUMN_DIR DIRECT /end RECORD_LAYOUT
/begin RECORD_LAYOUT _REC_A1CUR_20_u2_u2 FNC_VALUES 1 UWORD COLUMN_DIR DIRECT /end RECORD_LAYOUT
/begin RECORD_LAYOUT _REC_A1MAP_20_u1_u2_u1 FNC_VALUES 1 UBYTE COLUMN_DIR DIRECT /end RECORD_LAYOUT
/begin RECORD_LAYOUT _REC_A1MAP_20_u2_u2_u1 FNC_VALUES 1 UWORD COLUMN_DIR DIRECT /end RECORD_LAYOUT
/begin RECORD_LAYOUT _REC_S1VAL_Normal_u1 FNC_VALUES 1 UBYTE COLUMN_DIR DIRECT /end RECORD_LAYOUT
/begin FUNCTION PcDrCRds_Fstqdxx_xxxxxx ""
 /begin DEF_CHARACTERISTIC Ctb_gear_fs Ctb_tq_dif_tco Ctb_tq_dif_vs Ctp_tq_dif_tco_fac Ctp_tq_res Ctp_vh_wht_eq Cxx_end_sip_ena_dly Cxx_pow_r_fil Cxx_tq_dif_acel_dec_fil Cxx_tq_dif_acel_inc_fil Cxx_tq_dif_degr_fac Cxx_tq_dif_esti_tqe_fil Cxx_tq_dif_fil Cxx_whl_rad /end DEF_CHARACTERISTIC
 /begin OUT_MEASUREMENT Vbx_fil_rst Vbx_frz Vbx_sip_frz Vsx_pow_r_vld Vsx_tq_dif_vld Vxx_dly_pow_r Vxx_dly_tq_dif Vxx_free_shf_acel Vxx_gear_lim_tq_dif Vxx_pow_r Vxx_pow_r_fil Vxx_pow_r_raw Vxx_tq_dif Vxx_tq_dif_esti_tqe_fil Vxx_tq_dif_fil /end OUT_MEASUREMENT
/end FUNCTION
/begin FUNCTION OuDgoLmp "" /begin SUB_FUNCTION OuDgoLmp_Milmgtx /end SUB_FUNCTION /end FUNCTION
/begin FUNCTION OuDgoLmp_Milmgtx ""
 /begin DEF_CHARACTERISTIC Cbx_mux_mil_cfm Cxx_mux_test_mil_dly Cxx_mux_test_rdn_mil_dly /end DEF_CHARACTERISTIC
 /begin OUT_MEASUREMENT Vbx_aut_eng_mil Vxx_mux_mil_req_1 Vxx_mux_mil_req_2 Vxx_mux_test_mil_dly Vxx_mux_test_rdn_mil_dly /end OUT_MEASUREMENT
/end FUNCTION
/begin FUNCTION InSmiLim "" /begin SUB_FUNCTION InSmiLim_Egbnlim /end SUB_FUNCTION /end FUNCTION
/begin FUNCTION InSmiLim_Egbnlim "" /begin DEF_CHARACTERISTIC Cxx_max_n_egb_dft /end DEF_CHARACTERISTIC /begin OUT_MEASUREMENT Vsx_egb_n_lim_vld Vxx_egb_n_lim /end OUT_MEASUREMENT /end FUNCTION
/begin FUNCTION Asa ""
 /begin OUT_MEASUREMENT ctr_rst_fmy lv_reset_frf_asa lv_inh_frf[0] lv_inh_frf[1] lv_inh_frf[2] lv_inh_frf[3] /end OUT_MEASUREMENT
/end FUNCTION
/begin FUNCTION DgDgtMon ""
 /begin SUB_FUNCTION DgDgtMon_Bypmngx DgDgtMon_Engsftx DgDgtMon_Evntmgr DgDgtMon_Monisft DgDgtMon_Monispv DgDgtMon_Routmng DgDgtMon_Tacmngx /end SUB_FUNCTION
/end FUNCTION
/begin FUNCTION DgDgtMon_Bypmngx ""
 /begin DEF_CHARACTERISTIC Cxx_moni_id_01_max Cxx_moni_id_01_min Cxx_moni_id_06_max Cxx_moni_id_06_min Cxx_moni_id_0a_max Cxx_moni_id_0a_min Cxx_moni_id_19_max Cxx_moni_id_19_min Cxx_moni_id_1c_max Cxx_moni_id_1c_min Cxx_moni_id_2b_max Cxx_moni_id_2b_min Cxx_moni_id_2c_max Cxx_moni_id_2c_min Cxx_moni_id_2d_max Cxx_moni_id_2d_min Cxx_moni_id_44_max Cxx_moni_id_44_min Cxx_moni_id_46_max Cxx_moni_id_46_min Cxx_moni_id_47_max Cxx_moni_id_47_min Cxx_moni_id_51_max Cxx_moni_id_51_min Cxx_moni_id_52_max Cxx_moni_id_52_min Cxx_moni_id_60_max Cxx_moni_id_60_min Cxx_moni_id_61_max Cxx_moni_id_61_min Cxx_moni_id_62_max Cxx_moni_id_62_min Cxx_moni_id_63_max Cxx_moni_id_63_min Cxx_moni_id_64_max Cxx_moni_id_64_min Cxx_moni_id_65_max Cxx_moni_id_65_min Cxx_moni_id_66_max Cxx_moni_id_66_min Cxx_moni_id_67_max Cxx_moni_id_67_min Cxx_moni_id_68_max Cxx_moni_id_68_min Cxx_moni_id_69_max Cxx_moni_id_69_min Cxx_moni_id_6a_max Cxx_moni_id_6a_min Cxx_moni_id_6b_max Cxx_moni_id_6b_min Cxx_moni_id_6c_max Cxx_moni_id_6c_min Cxx_moni_id_6d_max Cxx_moni_id_6d_min Cxx_moni_id_6e_max Cxx_moni_id_6e_min Cxx_moni_id_6f_max Cxx_moni_id_6f_min Cxx_moni_id_79_max Cxx_moni_id_79_min /end DEF_CHARACTERISTIC
 /begin OUT_MEASUREMENT Vbx_moni_xx_req[0] Vbx_moni_id_01_req Vbx_moni_xx_req[2] Vbx_byp_03_req Vbx_moni_xx_req[4] Vbx_moni_xx_req[5] Vbx_byp_06_req Vbx_moni_xx_req[7] Vbx_moni_xx_req[8] Vbx_moni_xx_req[9] Vbx_byp_0a_req Vbx_moni_xx_req[11] Vbx_moni_xx_req[12] Vbx_moni_xx_req[13] Vbx_moni_xx_req[14] Vbx_moni_xx_req[15] Vbx_moni_id_10_req Vbx_moni_id_11_req Vbx_moni_xx_req[18] Vbx_moni_id_13_req Vbx_moni_id_14_req Vbx_moni_xx_req[21] Vbx_moni_xx_req[22] Vbx_moni_xx_req[23] Vbx_moni_id_18_req Vbx_byp_19_req Vbx_moni_id_1a_req Vbx_moni_id_1b_req Vbx_byp_1c_req Vbx_byp_1d_req Vbx_byp_1e_req Vbx_byp_1f_req Vbx_moni_id_20_req Vbx_moni_id_21_req Vbx_moni_xx_req[34] Vbx_moni_xx_req[35] Vbx_moni_xx_req[36] Vbx_byp_25_req Vbx_byp_26_req Vbx_moni_xx_req[39] Vbx_moni_xx_req[40] Vbx_byp_29_req Vbx_moni_xx_req[42] Vbx_byp_2b_req Vbx_byp_2c_req Vbx_byp_2d_req Vbx_moni_xx_req[46] Vbx_moni_xx_req[47] Vbx_moni_id_30_req Vbx_moni_id_31_req Vbx_moni_id_32_req Vbx_moni_id_33_req Vbx_moni_id_34_req Vbx_moni_id_35_req Vbx_moni_id_36_req Vbx_moni_id_37_req Vbx_moni_id_38_req Vbx_moni_id_39_req Vbx_moni_id_3a_req Vbx_moni_id_3b_req Vbx_moni_id_3c_req Vbx_byp_3d_req Vbx_byp_3e_req Vbx_moni_xx_req[63] Vbx_byp_40_req Vbx_moni_xx_req[65] Vbx_moni_xx_req[66] Vbx_byp_43_req Vbx_byp_44_req Vbx_moni_xx_req[69] Vbx_byp_46_req Vbx_byp_47_req Vbx_byp_48_req Vbx_byp_49_req Vbx_byp_4a_req Vbx_byp_4b_req Vbx_byp_4c_req Vbx_moni_xx_req[77] Vbx_moni_xx_req[78] Vbx_moni_xx_req[79] Vbx_moni_xx_req[80] Vbx_byp_51_req Vbx_byp_52_req Vbx_moni_xx_req[83] Vbx_moni_xx_req[84] Vbx_moni_xx_req[85] Vbx_moni_xx_req[86] Vbx_moni_xx_req[87] Vbx_moni_xx_req[88] Vbx_moni_xx_req[89] Vbx_moni_xx_req[90] Vbx_moni_xx_req[91] Vbx_moni_xx_req[92] Vbx_moni_xx_req[93] Vbx_moni_xx_req[94] Vbx_moni_xx_req[95] Vbx_byp_60_req Vbx_byp_61_req Vbx_byp_62_req Vbx_byp_63_req Vbx_byp_64_req Vbx_byp_65_req Vbx_byp_66_req Vbx_byp_67_req Vbx_byp_68_req Vbx_byp_69_req Vbx_byp_6a_req Vbx_byp_6b_req Vbx_byp_6c_req Vbx_byp_6d_req Vbx_byp_6e_req Vbx_byp_6f_req Vbx_moni_xx_req[112] Vbx_moni_xx_req[113] Vbx_moni_xx_req[114] Vbx_moni_xx_req[115] Vbx_moni_xx_req[116] Vbx_moni_xx_req[117] Vbx_moni_xx_req[118] Vbx_moni_xx_req[119] Vbx_moni_xx_req[120] Vbx_byp_79_req Vxx_byp_06_sub_val Vxx_byp_0a_sub_val Vxx_byp_19_sub_val Vxx_byp_1c_sub_val Vxx_byp_2b_sub_val Vxx_byp_2c_sub_val Vxx_byp_2d_sub_val Vxx_byp_44_sub_val Vxx_byp_46_sub_val Vxx_byp_47_sub_val Vxx_byp_51_sub_val Vxx_byp_52_sub_val Vxx_byp_60_sub_val Vxx_byp_61_sub_val Vxx_byp_62_sub_val Vxx_byp_63_sub_val Vxx_byp_64_sub_val Vxx_byp_65_sub_val Vxx_byp_66_sub_val Vxx_byp_67_sub_val Vxx_byp_68_sub_val Vxx_byp_69_sub_val Vxx_byp_6a_sub_val Vxx_byp_6b_sub_val Vxx_byp_6c_sub_val Vxx_byp_6d_sub_val Vxx_byp_6e_sub_val Vxx_byp_6f_sub_val Vxx_byp_79_sub_val Vxx_moni_id_01_sub_val /end OUT_MEASUREMENT
/end FUNCTION
/begin FUNCTION DgDgtMon_Engsftx ""
 /begin DEF_CHARACTERISTIC Cbx_ext_ctrl_sens_spg_dsb Cxx_ext_ctrl_max_n Cxx_ext_ctrl_sens_spg_max Cxx_ext_ctrl_sens_spg_max_t Cxx_ext_ctrl_sens_tco_max /end DEF_CHARACTERISTIC
 /begin OUT_MEASUREMENT Vxx_ext_ctrl_eng_test_sf /end OUT_MEASUREMENT
/end FUNCTION
/begin FUNCTION DgDgtMon_Evntmgr "" /begin OUT_MEASUREMENT Vbx_ext_ctrl_test_act /end OUT_MEASUREMENT /end FUNCTION
/begin FUNCTION DgDgtMon_Monisft ""
 /begin DEF_CHARACTERISTIC Cbx_ext_ctrl_hot_test_vh_cdn_dsb Cbx_ext_ctrl_pdl_cdn_ena Cxx_ext_ctrl_acel_pdl_rat_thd Cxx_ext_ctrl_vs_thd /end DEF_CHARACTERISTIC
 /begin OUT_MEASUREMENT Vbx_ext_ctrl_ena Vxx_ext_ctrl_test_sf /end OUT_MEASUREMENT
/end FUNCTION
/begin FUNCTION DgDgtMon_Monispv "" /begin DEF_CHARACTERISTIC Cxx_moni_stop_diag_dly /end DEF_CHARACTERISTIC
 /begin OUT_MEASUREMENT Vbx_clock Vbx_com_err Vbx_diag_sta_moni_abrt Vbx_diag_sta_moni_ena Vbx_diag_sta_moni_end Vbx_init_timeout Vbx_moni_appl_err Vbx_moni_dbl_nok Vbx_moni_id_nok Vbx_moni_nr_tot_id_nok Vbx_moni_oor Vbx_moni_read_req_done Vbx_moni_req_analyse Vbx_moni_req_data_changed Vbx_moni_stop_diag Vsx_diag_sta_moni_stt Vxx_clock_ecu Vxx_clock_init_timeout Vxx_moni_nr_tot_id Vxx_moni_sf_spv Vxx_timeout /end OUT_MEASUREMENT
/end FUNCTION
/begin FUNCTION DgDgtMon_Routmng ""
 /begin DEF_CHARACTERISTIC Cbx_diag_in_vvtc_ena_cam_crk_df Cxx_diag_ffig_it_psn_min Cxx_diag_in_vvtc_tco_max Cxx_diag_in_vvtc_tco_min Cxx_diag_in_vvtc_toil_max Cxx_diag_in_vvtc_toil_min Cxx_diag_in_vvtc_vb_max Cxx_diag_in_vvtc_vb_min /end DEF_CHARACTERISTIC
 /begin OUT_MEASUREMENT Vbx_rout_run_stt Vbx_start_cdn Vbx_stop_cdn Vbx_valid_req /end OUT_MEASUREMENT
/end FUNCTION
/begin FUNCTION DgDgtMon_Tacmngx ""
 /begin DEF_CHARACTERISTIC Cxx_tac_tini_io_01 Cxx_tac_ton_io_01 Cxx_tac_toff_io_01 Cxx_tac_tini_stac_01 Cxx_tac_ton_stac_01 Cxx_tac_toff_stac_01 Cxx_tac_von_io_01 Cxx_tac_voff_io_01 Cxx_tac_von_stac_01 Cxx_tac_voff_stac_01 Cxx_tac_nc_io_01 Cxx_tac_tini_io_02 Cxx_tac_ton_io_02 Cxx_tac_toff_io_02 Cxx_tac_tini_stac_02 Cxx_tac_ton_stac_02 Cxx_tac_toff_stac_02 Cxx_tac_nc_io_02 Cxx_tac_tini_io_03 Cxx_tac_ton_io_03 Cxx_tac_toff_io_03 Cxx_tac_tini_stac_03 Cxx_tac_ton_stac_03 Cxx_tac_toff_stac_03 Cxx_tac_nc_io_03 Cxx_tac_tini_io_04 Cxx_tac_ton_io_04 Cxx_tac_toff_io_04 Cxx_tac_tini_stac_04 Cxx_tac_ton_stac_04 Cxx_tac_toff_stac_04 Cxx_tac_nc_io_04 Cxx_tac_tini_io_05 Cxx_tac_ton_io_05 Cxx_tac_toff_io_05 Cxx_tac_tini_stac_05 Cxx_tac_ton_stac_05 Cxx_tac_toff_stac_05 Cxx_tac_nc_io_05 Cxx_tac_tini_io_06 Cxx_tac_ton_io_06 Cxx_tac_toff_io_06 Cxx_tac_tini_stac_06 Cxx_tac_ton_stac_06 Cxx_tac_toff_stac_06 Cxx_tac_nc_io_06 Cxx_tac_tini_io_07 Cxx_tac_ton_io_07 Cxx_tac_toff_io_07 Cxx_tac_tini_stac_07 Cxx_tac_ton_stac_07 Cxx_tac_toff_stac_07 Cxx_tac_von_io_07 Cxx_tac_voff_io_07 Cxx_tac_von_stac_07 Cxx_tac_voff_stac_07 Cxx_tac_nc_io_07 Cxx_tac_tini_io_08 Cxx_tac_ton_io_08 Cxx_tac_toff_io_08 Cxx_tac_tini_stac_08 Cxx_tac_ton_stac_08 Cxx_tac_toff_stac_08 Cxx_tac_von_io_08 Cxx_tac_voff_io_08 Cxx_tac_von_stac_08 Cxx_tac_voff_stac_08 Cxx_tac_nc_io_08 Cxx_tac_tini_io_09 Cxx_tac_ton_io_09 Cxx_tac_toff_io_09 Cxx_tac_tini_stac_09 Cxx_tac_ton_stac_09 Cxx_tac_toff_stac_09 Cxx_tac_von_io_09 Cxx_tac_voff_io_09 Cxx_tac_von_stac_09 Cxx_tac_voff_stac_09 Cxx_tac_nc_io_09 Cxx_tac_tini_io_10 Cxx_tac_ton_io_10 Cxx_tac_toff_io_10 Cxx_tac_tini_stac_10 Cxx_tac_ton_stac_10 Cxx_tac_toff_stac_10 Cxx_tac_von_io_10 Cxx_tac_voff_io_10 Cxx_tac_von_stac_10 Cxx_tac_voff_stac_10 Cxx_tac_nc_io_10 Cxx_tac_tini_io_20 Cxx_tac_ton_io_20 Cxx_tac_toff_io_20 Cxx_tac_tini_stac_20 Cxx_tac_ton_stac_20 Cxx_tac_toff_stac_20 Cxx_tac_von_io_20 Cxx_tac_voff_io_20 Cxx_tac_von_stac_20 Cxx_tac_voff_stac_20 Cxx_tac_nc_io_20 Cbx_it_ofs_clos_frst_dsb Cbx_it_ofs_open_frst_dsb Csx_tac_01 Csx_tac_02 Csx_tac_03 Csx_tac_04 Csx_tac_05 Csx_tac_06 Csx_tac_07 Csx_tac_08 Csx_tac_09 Csx_tac_10 Csx_tac_20 Csx_tac_22 Csx_tac_23 Csx_tac_24 Csx_tac_25 Csx_tac_29 Csx_tac_30 Csx_tac_31 Csx_tac_32 Csx_tac_35 Csx_tac_36 Csx_tac_37 Csx_tac_38 Cxx_tac_tout_timer_io Cxx_tac_tout_timer_stac Cxx_tac_vb_max Cxx_tac_vb_min /end DEF_CHARACTERISTIC
 /begin OUT_MEASUREMENT Vsx_tac_01_cdn Vbx_tac_01_req Vsx_tac_02_cdn Vbx_tac_02_req Vsx_tac_03_cdn Vbx_tac_03_req Vsx_tac_04_cdn Vbx_tac_04_req Vsx_tac_05_cdn Vbx_tac_05_req Vsx_tac_06_cdn Vbx_tac_06_req Vsx_tac_07_cdn Vbx_tac_07_req Vsx_tac_08_cdn Vbx_tac_08_req Vsx_tac_09_cdn Vbx_tac_09_req Vsx_tac_10_cdn Vbx_tac_10_req Vsx_tac_20_cdn Vbx_tac_20_req Vsx_tac_22_cdn Vbx_tac_22_req Vsx_tac_23_cdn Vbx_tac_23_req Vsx_tac_24_cdn Vbx_tac_24_req Vsx_tac_25_cdn Vbx_tac_25_req Vsx_tac_29_cdn Vbx_tac_29_req Vsx_tac_30_cdn Vbx_tac_30_req Vsx_tac_31_cdn Vbx_tac_31_req Vsx_tac_32_cdn Vbx_tac_32_req Vsx_tac_35_cdn Vbx_tac_35_req Vsx_tac_36_cdn Vbx_tac_36_req Vsx_tac_37_cdn Vbx_tac_37_req Vsx_tac_38_cdn Vbx_tac_38_req Vxx_tmp_dly_01 Vxx_tac_01_subval Vxx_tac_01_nc Vxx_tmp_dly_02 Vxx_tac_02_subval Vxx_tac_02_nc Vxx_tmp_dly_03 Vxx_tac_03_subval Vxx_tac_03_nc Vxx_tmp_dly_04 Vxx_tac_04_subval Vxx_tac_04_nc Vxx_tmp_dly_05 Vxx_tac_05_subval Vxx_tac_05_nc Vxx_tmp_dly_06 Vxx_tac_06_subval Vxx_tac_06_nc Vxx_tmp_dly_07 Vxx_tac_07_subval Vxx_tac_07_nc Vxx_tmp_dly_08 Vxx_tac_08_subval Vxx_tac_08_nc Vxx_tmp_dly_09 Vxx_tac_09_subval Vxx_tac_09_nc Vxx_tmp_dly_10 Vxx_tac_10_subval Vxx_tac_10_nc Vxx_tmp_dly_20 Vxx_tac_20_subval Vxx_tac_20_nc Vbx_diag_sta_stac_abrt Vbx_diag_sta_stac_ena Vbx_diag_sta_stac_end Vbx_tac_cdn Vbx_tac_ena Vbx_tac_tout Vsx_diag_sta_stac_stt Vsx_opt Vsx_tac_22_stt Vsx_tac_23_stt Vsx_tac_24_stt Vsx_tac_25_stt Vsx_tac_29_stt Vsx_tac_30_stt Vsx_tac_31_stt Vsx_tac_32_stt Vsx_tac_35_stt Vsx_tac_36_stt Vsx_tac_37_stt Vsx_tac_38_stt Vsx_tac_stt Vxx_LID Vxx_tac_tout_timer /end OUT_MEASUREMENT
/end FUNCTION
/begin FUNCTION TqSafTdm ""
 /begin SUB_FUNCTION TqSafTdm_Inacelp TqSafTdm_Ccmonxx TqSafTdm_Canmonx TqSafTdm_Acelpdl TqSafTdm_Nomfmxx TqSafTdm_Tqitgtx TqSafTdm_Lossxxx TqSafTdm_Intcoxx TqSafTdm_Inspexx TqSafTdm_Incanxx /end SUB_FUNCTION
/end FUNCTION
/begin FUNCTION TqSafTdm_Inacelp ""
 /begin DEF_CHARACTERISTIC Cxx_sfty_acel_pdl_0_rat_v1 Cxx_sfty_acel_pdl_0_rat_v2 Cxx_sfty_acel_pdl_100_rat_v1 Cxx_sfty_acel_pdl_100_rat_v2 Cxx_sfty_acel_pdl_sens_pws Cxx_sfty_acel_pdl_stab_thd /end DEF_CHARACTERISTIC
 /begin OUT_MEASUREMENT Vbx_sfty_acel_pdl_fil_sens_v1 Vbx_sfty_acel_pdl_fil_sens_v2 Vxx_sfty_acel_pdl_fil_sens_v1 Vxx_sfty_acel_pdl_fil_sens_v2 Vxx_sfty_acel_pdl_rat Vxx_sfty_acel_pdl_sens_rat1 Vxx_sfty_acel_pdl_sens_rat2 /end OUT_MEASUREMENT
/end FUNCTION
/begin FUNCTION TqSafTdm_Ccmonxx ""
 /begin DEF_CHARACTERISTIC Cxx_sfty_cru_brk_nok_t Cxx_sfty_cru_brk_tout_1 Cxx_sfty_cru_brk_tout_2 Cxx_sfty_cru_brk_tout_long Cxx_sfty_cru_rest_max_v Cxx_sfty_cru_rest_min_v Cxx_sfty_cru_tq_req_t /end DEF_CHARACTERISTIC
 /begin OUT_MEASUREMENT Vbx_sfty_cru_brk Vbx_sfty_cru_brk_pdl_ok Vbx_sfty_cru_brk_pdl_ok_tmp Vbx_sfty_cru_forc_on Vbx_sfty_cru_on Vbx_sfty_cru_resu_acel_decl Vbx_sfty_cru_stt_act Vbx_sfty_cru_tq_req_plau Vbx_sfty_cru_tq_req_plau_tmp_1 Vbx_sfty_cru_tq_req_plau_tmp_2 Vxx_sfty_cru_brk_t_1 Vxx_sfty_cru_brk_t_2 Vxx_sfty_cru_brk_t_long /end OUT_MEASUREMENT
/end FUNCTION
/begin FUNCTION TqSafTdm_Canmonx ""
 /begin DEF_CHARACTERISTIC Cxx_sfty_asr_tqe_sp_msr_raw Cxx_sfty_mux_agb_tqe_nok_raw Cxx_sfty_mux_asr_tqe_nok_raw /end DEF_CHARACTERISTIC
 /begin OUT_MEASUREMENT Vbx_sfty_agb_tq_req Vbx_sfty_agb_tq_req_plau Vbx_sfty_msr_tq_req Vbx_sfty_msr_tq_req_plau /end OUT_MEASUREMENT
/end FUNCTION
/begin FUNCTION TqSafTdm_Acelpdl ""
 /begin DEF_CHARACTERISTIC Ctb_sfty_acel_pdl_fmt Ctp_sfty_acel_pdl_fmt_1 Ctp_sfty_acel_pdl_fmt_2 Cxx_sfty_acel_pdl_fmt_rvr_fac Cxx_sfty_lih_off_t /end DEF_CHARACTERISTIC
 /begin OUT_MEASUREMENT Vxx_sfty_acel_pdl_pwt_sp Vxx_sfty_driv_pwt_sp /end OUT_MEASUREMENT
/end FUNCTION
/begin FUNCTION TqSafTdm_Nomfmxx ""
 /begin DEF_CHARACTERISTIC Ctb_sfty_acel_fmt_tkof_fac_vs Ctb_sfty_acel_pdl_fmt_fac_vs Ctb_sfty_acel_tkof_fac_driv Cmp_sfty_acel_pdl_fmt_fac Ctp_sfty_acel_pdl_fmt_fac Cxx_sfty_pdl_fmt_slop_down Cxx_sfty_pdl_fmt_slop_up Cxx_sfty_tkof_cdn_vs_max Cxx_sfty_tkof_stop_vs /end DEF_CHARACTERISTIC
 /begin OUT_MEASUREMENT Vxx_sfty_acel_pdl_fmt_fac /end OUT_MEASUREMENT
/end FUNCTION
/begin FUNCTION TqSafTdm_Tqitgtx ""
 /begin DEF_CHARACTERISTIC Ctb_sfty_ajs_n Ctb_sfty_driv_tqe_map_n Ctb_sfty_driv_tqe_map_pwt_sp Ctb_sfty_min_driv_tqe_pwt_sp Ctb_sfty_min_tqe_n Cmp_sfty_driv_tqe_map Ctp_sfty_driv_tq_fil_acel Ctp_sfty_driv_tq_fil_decl Ctp_sfty_min_driv_tqe_map Ctp_sfty_min_tqe_agb_fac Cxx_sfty_agb_max_tqe_cor Cxx_sfty_is_n_t Cxx_sfty_is_n_thd Cxx_sfty_is_tqe_sp_max Cxx_sfty_max_is_n_sp Cxx_sfty_max_l_eng_tq Cxx_sfty_tkof_end_vs_thd Cxx_sfty_tkof_n_thd Cxx_sfty_tkof_pwt_sp_thd Cxx_sfty_tkof_tqe_cor /end DEF_CHARACTERISTIC
 /begin OUT_MEASUREMENT Vbx_ajs_cut_mon Vxx_sfty_ajs_modu_tqe Vxx_sfty_arb_tqe Vxx_sfty_driv_tqe_sp Vxx_sfty_lim_driv_tqe Vxx_sfty_min_avl_tqe Vxx_sfty_n_min_tqe_agb_fac Vxx_sfty_tqi_sp /end OUT_MEASUREMENT
/end FUNCTION
/begin FUNCTION TqSafTdm_Lossxxx ""
 /begin DEF_CHARACTERISTIC Ctb_sfty_frn_tql_temp Ctb_sfty_map Ctb_sfty_n Cmp_sfty_frn_tql Cmp_sfty_pump_tql Cbx_sfty_is_ad_eng_tql_cmf Cbx_sfty_tql_temp_cfm Cxx_sfty_ac_pow_thd Cxx_sfty_alt_pow_thd Cxx_sfty_max_is_ad_tq Cxx_sfty_min_is_ad_tq Cxx_sfty_pump_tql_thd Cxx_sfty_pwst_off_is_cor_dly Cxx_sfty_pwst_prs_tql /end DEF_CHARACTERISTIC
 /begin OUT_MEASUREMENT Vxx_sfty_aux_tql_sp Vxx_sfty_eng_tql Vxx_sfty_frn_tql Vxx_sfty_frn_tql_temp Vxx_sfty_toil /end OUT_MEASUREMENT
/end FUNCTION
/begin FUNCTION TqSafTdm_Intcoxx "" /begin DEF_CHARACTERISTIC Ctb_sfty_sens_tco_v Ctp_sfty_sens_tco Cxx_sfty_tco_inc /end DEF_CHARACTERISTIC /begin OUT_MEASUREMENT Vxx_sfty_raw_sens_tco Vxx_sfty_tco /end OUT_MEASUREMENT /end FUNCTION
/begin FUNCTION TqSafTdm_Inspexx "" /begin OUT_MEASUREMENT Vxx_sfty_n /end OUT_MEASUREMENT /end FUNCTION
/begin FUNCTION TqSafTdm_Incanxx "" /begin OUT_MEASUREMENT Vxx_sfty_mux_agb_tqe_sp Vxx_sfty_mux_msr_tqe_sp /end OUT_MEASUREMENT /end FUNCTION
/begin FUNCTION TqSafTrm "" /begin SUB_FUNCTION TqSafTrm_Estixxx /end SUB_FUNCTION /end FUNCTION
/begin FUNCTION TqSafTrm_Estixxx "" /begin DEF_CHARACTERISTIC Cmp_sfty_map_n_esti_tqi /end DEF_CHARACTERISTIC /begin OUT_MEASUREMENT Vxx_sfty_esti_tqi /end OUT_MEASUREMENT /end FUNCTION
/begin FUNCTION TqSafTsm "" /begin SUB_FUNCTION TqSafTsm_Lihmonx TqSafTsm_TqCtrxx TqSafTsm_TqMonxx /end SUB_FUNCTION /end FUNCTION
/begin FUNCTION TqSafTsm_Lihmonx ""
 /begin DEF_CHARACTERISTIC Ctb_sfty_thr_lih_n Ctp_sfty_thr_lih_map Cxx_sfty_map_thd Cxx_sfty_thr_lih_mon_ini_dly /end DEF_CHARACTERISTIC
 /begin OUT_MEASUREMENT Vbx_sfty_thr_lih_mon_nok /end OUT_MEASUREMENT
/end FUNCTION
/begin FUNCTION TqSafTsm_TqCtrxx ""
 /begin DEF_CHARACTERISTIC Cxx_sfty_esti_tqi_deb_thd_ofs Cxx_sfty_esti_tqi_pos_err_ofs Cxx_sfty_tqi_req_pos_err_ofs Cxx_sfty_tqi_sp_deb_thd_ofs /end DEF_CHARACTERISTIC
 /begin OUT_MEASUREMENT Vxx_sfty_esti_tqi_ctr Vxx_sfty_tqi_sp_ctr Vbx_sfty_esti_tqi_ctr_inc_tmp Vbx_sfty_tqi_sp_ctr_inc_tmp Vxx_sfty_esti_tqi_ctr_inc Vxx_sfty_esti_tqi_ctr_last Vxx_sfty_esti_tqi_deb_thd2 Vxx_sfty_tqi_sp_ctr_inc Vxx_sfty_tqi_sp_ctr_last Vxx_sfty_tqi_sp_deb_thd2 /end OUT_MEASUREMENT
/end FUNCTION
/end MODULE
/end PROJECT
