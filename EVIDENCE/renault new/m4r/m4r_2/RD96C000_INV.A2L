ASAP2_VERSION 1 41
/begin PROJECT RD8 "_default_ProjectLongIdentifier"
/begin HEADER "_default_HeaderComment" PROJECT_NO RD9 /end HEADER
/begin MODULE _default_ModuleName "_default_ModuleLongIdentifier"
/begin MOD_COMMON "_default_ModCommonComment" DEPOSIT ABSOLUTE BYTE_ORDER MSB_LAST ALIGNMENT_BYTE 1 ALIGNMENT_WORD 2 ALIGNMENT_LONG 2 ALIGNMENT_FLOAT32_IEEE 2 ALIGNMENT_FLOAT64_IEEE 4 /end MOD_COMMON
/begin AXIS_PTS Ctb_eal2 "9 breakpoint table for Engine air load" 0xa0026c14 Vxx_eal _REC_A2AXS_20_u2 3.99993896484375 _CNV_A_R_LINEAR_____53_CM 9 0. 3.99993896484375 FORMAT "%10.8" /end AXIS_PTS
/begin AXIS_PTS Ctb_eal "16 breakpoint table for Engine air load" 0xa002a6fc Vxx_eal _REC_A2AXS_20_u2 3.99993896484375 _CNV_A_R_LINEAR_____53_CM 16 0. 3.99993896484375 FORMAT "%10.8" /end AXIS_PTS
/begin AXIS_PTS Ctb_sta_tco "Coolant temperature breakpoints for starting set point tables" 0xa002dfe4 Vxx_tco _REC_A2AXS_20_u2 240. _CNV_A_R_LINEAR_____54_CM 8 -40. 200. FORMAT "%5.1" /end AXIS_PTS
/begin AXIS_PTS Ctb_tco "16 engine coolant temperature breakpoints" 0xa002dff8 Vxx_tco _REC_A2AXS_20_u2 240. _CNV_A_R_LINEAR_____54_CM 16 -40. 200. FORMAT "%5.1" /end AXIS_PTS
/begin AXIS_PTS Ctb_tco2 "Engine coolant temperature breakpoints" 0xa002e01c Vxx_tco _REC_A2AXS_20_u2 240. _CNV_A_R_LINEAR_____54_CM 9 -40. 200. FORMAT "%5.1" /end AXIS_PTS
/begin CHARACTERISTIC Cmp_n_eal_vvtc_iga_alco "Map of maximal advance for a camshaft position correcponding to warm engine valve timings for flex-fuel" MAP 0xa0027cb0 _REC_A1MAP_20_u1_u2_u2 95.625 _CNV_A_R_LINEAR_____30_CM -48. 47.625 FORMAT "%7.3"
 /begin AXIS_DESCR COM_AXIS Vxx_n _CNV_A_R_ENSD_LINEA_24_CM 20 0. 16383.75 FORMAT "%8.2" AXIS_PTS_REF Ctb_n /end AXIS_DESCR
 /begin AXIS_DESCR COM_AXIS Vxx_eal _CNV_A_R_LINEAR_____53_CM 16 0. 3.99993896484375 FORMAT "%10.8" AXIS_PTS_REF Ctb_eal /end AXIS_DESCR
/end CHARACTERISTIC
/begin CHARACTERISTIC Cmp_tco_slow_comb_iga_cor_alco "Advance correction for slow combustion (low temperature) for Flex-fuel." MAP 0xa0027df0 _REC_A1MAP_20_u1_u2_u2 95.625 _CNV_A_R_LINEAR_____30_CM -48. 47.625 FORMAT "%7.3"
 /begin AXIS_DESCR COM_AXIS Vxx_tco _CNV_A_R_LINEAR_____54_CM 16 -40. 200. FORMAT "%5.1" AXIS_PTS_REF Ctb_tco /end AXIS_DESCR
 /begin AXIS_DESCR COM_AXIS Vxx_eal _CNV_A_R_LINEAR_____53_CM 16 0. 3.99993896484375 FORMAT "%10.8" AXIS_PTS_REF Ctb_eal /end AXIS_DESCR
/end CHARACTERISTIC
/begin CHARACTERISTIC Ctp_n_slow_comb_fac_alco "Factor depending on engine speed on slow combustion advance correction for Flex-fuel." CURVE 0xa0027ef0 _REC_A1CUR_20_u1_u2 0.996078431372549 _CNV_A_R_LINEAR_____118_CM 3.92156862745098e-003 1. FORMAT "%9.7"
 /begin AXIS_DESCR COM_AXIS Vxx_n _CNV_A_R_ENSD_LINEA_24_CM 9 0. 16383.75 FORMAT "%8.2" AXIS_PTS_REF Ctb_n2 /end AXIS_DESCR
/end CHARACTERISTIC
/begin MEASUREMENT Vxx_slow_comb_iga_cor_alco "Advance correction for slow combustion for flex-fuel." SBYTE _CNV_A_R_LINEAR_____25_CM 1 0. -48. 47.625 ECU_ADDRESS 0xd0003f82 FORMAT "%7.3" /end MEASUREMENT
/begin MEASUREMENT Vxx_vvtc_iga_alco "Maximuml advance for a camshaft position corresponding to warm engine valve timings for flex-fuel." UBYTE _CNV_A_R_LINEAR_____30_CM 1 0. -48. 47.625 ECU_ADDRESS 0xd0003f83 FORMAT "%7.3" /end MEASUREMENT
/begin CHARACTERISTIC Ctp_n_knk_fast_inc_iga "Map of increase values for fast loop depending on engine speed" CURVE 0xa002fcd8 _REC_A1CUR_20_u1_u2 95.625 _CNV_A_R_LINEAR_____25_CM 0. 95.625
 /begin AXIS_DESCR COM_AXIS Vxx_n _CNV_A_R_ENSD_LINEA_24_CM 20 0. 16383.75 FORMAT "%8.2" AXIS_PTS_REF Ctb_n /end AXIS_DESCR
/end CHARACTERISTIC
/begin MEASUREMENT Vbx_knk_2_cyl_min "Boolean indicating that the knock is detected on at least two cylinders" UBYTE _CNV_S_2_RANGE______3_CM 1 0. 0. 1. ECU_ADDRESS 0xd000473d BIT_MASK 0x1 /end MEASUREMENT
/begin MEASUREMENT Vbx_knk_det_cyl1 "Knock detection on cylinder 1" UBYTE _CNV_S_2_RANGE______3_CM 1 0. 0. 1. ECU_ADDRESS 0xd000473e BIT_MASK 0x1 /end MEASUREMENT
/begin MEASUREMENT Vbx_knk_det_cyl2 "Knock detection on cylinder 2" UBYTE _CNV_S_2_RANGE______3_CM 1 0. 0. 1. ECU_ADDRESS 0xd000473f BIT_MASK 0x1 /end MEASUREMENT
/begin MEASUREMENT Vbx_knk_det_cyl3 "Knock detection on cylinder 3" UBYTE _CNV_S_2_RANGE______3_CM 1 0. 0. 1. ECU_ADDRESS 0xd0004740 BIT_MASK 0x1 /end MEASUREMENT
/begin MEASUREMENT Vbx_knk_det_cyl4 "Knock detection on cylinder 4" UBYTE _CNV_S_2_RANGE______3_CM 1 0. 0. 1. ECU_ADDRESS 0xd0004741 BIT_MASK 0x1 /end MEASUREMENT
/begin MEASUREMENT Vbx_knk_det_err_cyl1 "Wrong knock detection on cylinder 1" UBYTE _CNV_S_2_RANGE______3_CM 1 0. 0. 1. ECU_ADDRESS 0xd0004742 BIT_MASK 0x1 /end MEASUREMENT
/begin MEASUREMENT Vbx_knk_det_err_cyl2 "Wrong knock detection on cylinder 2" UBYTE _CNV_S_2_RANGE______3_CM 1 0. 0. 1. ECU_ADDRESS 0xd0004743 BIT_MASK 0x1 /end MEASUREMENT
/begin MEASUREMENT Vbx_knk_det_err_cyl3 "Wrong knock detection on cylinder 3" UBYTE _CNV_S_2_RANGE______3_CM 1 0. 0. 1. ECU_ADDRESS 0xd0004744 BIT_MASK 0x1 /end MEASUREMENT
/begin MEASUREMENT Vbx_knk_det_err_cyl4 "Wrong knock detection on cylinder 4" UBYTE _CNV_S_2_RANGE______3_CM 1 0. 0. 1. ECU_ADDRESS 0xd0004745 BIT_MASK 0x1 /end MEASUREMENT
/begin MEASUREMENT Vbx_knk_slow_cyl "Incrementation of slow loop correction in process" UBYTE _CNV_S_2_RANGE______3_CM 1 0. 0. 1. ECU_ADDRESS 0xd0004746 BIT_MASK 0x1 /end MEASUREMENT
/begin MEASUREMENT Vtd_knk_det_err_cyl[0] "Wrong knock detection for each cylinder" UBYTE _CNV_S_2_RANGE______3_CM 1 0. 0. 1. ECU_ADDRESS 0xd000472a /end MEASUREMENT
/begin MEASUREMENT Vtd_knk_det_err_cyl[1] "Wrong knock detection for each cylinder" UBYTE _CNV_S_2_RANGE______3_CM 1 0. 0. 1. ECU_ADDRESS 0xd000472b /end MEASUREMENT
/begin MEASUREMENT Vtd_knk_det_err_cyl[2] "Wrong knock detection for each cylinder" UBYTE _CNV_S_2_RANGE______3_CM 1 0. 0. 1. ECU_ADDRESS 0xd000472c /end MEASUREMENT
/begin MEASUREMENT Vtd_knk_det_err_cyl[3] "Wrong knock detection for each cylinder" UBYTE _CNV_S_2_RANGE______3_CM 1 0. 0. 1. ECU_ADDRESS 0xd000472d /end MEASUREMENT
/begin MEASUREMENT Vtd_knk_fast_cor_cyl[0] "Timing correction from increase block for each cylinder" UBYTE _CNV_A_R_LINEAR_____25_CM 1 0. 0. 95.625 ECU_ADDRESS 0xd000471a /end MEASUREMENT
/begin MEASUREMENT Vtd_knk_fast_cor_cyl[1] "Timing correction from increase block for each cylinder" UBYTE _CNV_A_R_LINEAR_____25_CM 1 0. 0. 95.625 ECU_ADDRESS 0xd000471b /end MEASUREMENT
/begin MEASUREMENT Vtd_knk_fast_cor_cyl[2] "Timing correction from increase block for each cylinder" UBYTE _CNV_A_R_LINEAR_____25_CM 1 0. 0. 95.625 ECU_ADDRESS 0xd000471c /end MEASUREMENT
/begin MEASUREMENT Vtd_knk_fast_cor_cyl[3] "Timing correction from increase block for each cylinder" UBYTE _CNV_A_R_LINEAR_____25_CM 1 0. 0. 95.625 ECU_ADDRESS 0xd000471d /end MEASUREMENT
/begin MEASUREMENT Vtd_knk_fast_cor_iga_cyl[0] "Timing correction from fast loop for each cylinder" UBYTE _CNV_A_R_LINEAR_____25_CM 1 0. 0. 95.625 ECU_ADDRESS 0xd000471e /end MEASUREMENT
/begin MEASUREMENT Vtd_knk_fast_cor_iga_cyl[1] "Timing correction from fast loop for each cylinder" UBYTE _CNV_A_R_LINEAR_____25_CM 1 0. 0. 95.625 ECU_ADDRESS 0xd000471f /end MEASUREMENT
/begin MEASUREMENT Vtd_knk_fast_cor_iga_cyl[2] "Timing correction from fast loop for each cylinder" UBYTE _CNV_A_R_LINEAR_____25_CM 1 0. 0. 95.625 ECU_ADDRESS 0xd0004720 /end MEASUREMENT
/begin MEASUREMENT Vtd_knk_fast_cor_iga_cyl[3] "Timing correction from fast loop for each cylinder" UBYTE _CNV_A_R_LINEAR_____25_CM 1 0. 0. 95.625 ECU_ADDRESS 0xd0004721 /end MEASUREMENT
/begin MEASUREMENT Vtd_knk_iga_cor_appl_cyl[0] "Currative knock correction cylinder to cylinder" UBYTE _CNV_A_R_LINEAR_____25_CM 1 0. 0. 95.625 ECU_ADDRESS 0xd0004722 /end MEASUREMENT
/begin MEASUREMENT Vtd_knk_iga_cor_appl_cyl[1] "Currative knock correction cylinder to cylinder" UBYTE _CNV_A_R_LINEAR_____25_CM 1 0. 0. 95.625 ECU_ADDRESS 0xd0004723 /end MEASUREMENT
/begin MEASUREMENT Vtd_knk_iga_cor_appl_cyl[2] "Currative knock correction cylinder to cylinder" UBYTE _CNV_A_R_LINEAR_____25_CM 1 0. 0. 95.625 ECU_ADDRESS 0xd0004724 /end MEASUREMENT
/begin MEASUREMENT Vtd_knk_iga_cor_appl_cyl[3] "Currative knock correction cylinder to cylinder" UBYTE _CNV_A_R_LINEAR_____25_CM 1 0. 0. 95.625 ECU_ADDRESS 0xd0004725 /end MEASUREMENT
/begin MEASUREMENT Vtd_knk_slow_iga_cyl_no_sat[0] "Knock correction low bukle before saturation (4 composants vector)" UBYTE _CNV_A_R_LINEAR_____25_CM 1 0. 0. 95.625 ECU_ADDRESS 0xd0004726 /end MEASUREMENT
/begin MEASUREMENT Vtd_knk_slow_iga_cyl_no_sat[1] "Knock correction low bukle before saturation (4 composants vector)" UBYTE _CNV_A_R_LINEAR_____25_CM 1 0. 0. 95.625 ECU_ADDRESS 0xd0004727 /end MEASUREMENT
/begin MEASUREMENT Vtd_knk_slow_iga_cyl_no_sat[2] "Knock correction low bukle before saturation (4 composants vector)" UBYTE _CNV_A_R_LINEAR_____25_CM 1 0. 0. 95.625 ECU_ADDRESS 0xd0004728 /end MEASUREMENT
/begin MEASUREMENT Vtd_knk_slow_iga_cyl_no_sat[3] "Knock correction low bukle before saturation (4 composants vector)" UBYTE _CNV_A_R_LINEAR_____25_CM 1 0. 0. 95.625 ECU_ADDRESS 0xd0004729 /end MEASUREMENT
/begin MEASUREMENT Vxx_knk_fast_cor_iga_cyl1 "Timing correction from fast loop for cylinder 1" UBYTE _CNV_A_R_LINEAR_____25_CM 1 0. 0. 95.625 ECU_ADDRESS 0xd000472e /end MEASUREMENT
/begin MEASUREMENT Vxx_knk_fast_cor_iga_cyl2 "Timing correction from fast loop for cylinder 2" UBYTE _CNV_A_R_LINEAR_____25_CM 1 0. 0. 95.625 ECU_ADDRESS 0xd000472f /end MEASUREMENT
/begin MEASUREMENT Vxx_knk_fast_cor_iga_cyl3 "Timing correction from fast loop for cylinder 3" UBYTE _CNV_A_R_LINEAR_____25_CM 1 0. 0. 95.625 ECU_ADDRESS 0xd0004730 /end MEASUREMENT
/begin MEASUREMENT Vxx_knk_fast_cor_iga_cyl4 "Timing correction from fast loop for cylinder 4" UBYTE _CNV_A_R_LINEAR_____25_CM 1 0. 0. 95.625 ECU_ADDRESS 0xd0004731 /end MEASUREMENT
/begin MEASUREMENT Vxx_knk_fast_cor_iga_cyl_i1 "Timing correction from fast loop for cylinder 1 before wrong detection test" UBYTE _CNV_A_R_LINEAR_____25_CM 1 0. 0. 95.625 ECU_ADDRESS 0xd0004732 /end MEASUREMENT
/begin MEASUREMENT Vxx_knk_fast_cor_iga_cyl_i2 "Timing correction from fast loop for cylinder 2 before wrong detection test" UBYTE _CNV_A_R_LINEAR_____25_CM 1 0. 0. 95.625 ECU_ADDRESS 0xd0004733 /end MEASUREMENT
/begin MEASUREMENT Vxx_knk_fast_cor_iga_cyl_i3 "Timing correction from fast loop for cylinder 3 before wrong detection test" UBYTE _CNV_A_R_LINEAR_____25_CM 1 0. 0. 95.625 ECU_ADDRESS 0xd0004734 /end MEASUREMENT
/begin MEASUREMENT Vxx_knk_fast_cor_iga_cyl_i4 "Timing correction from fast loop for cylinder 4 before wrong detection test" UBYTE _CNV_A_R_LINEAR_____25_CM 1 0. 0. 95.625 ECU_ADDRESS 0xd0004735 /end MEASUREMENT
/begin MEASUREMENT Vxx_knk_fast_dec_ctr_cyl1 "Counter for the fast loop decrease for cylinder 1" UWORD _CNV_A_R_LINEAR_____34_CM 1 0. 0. 655.35 ECU_ADDRESS 0xd000368a FORMAT "%6.2" /end MEASUREMENT
/begin MEASUREMENT Vxx_knk_fast_dec_ctr_cyl2 "Counter for the fast loop decrease for cylinder 2" UWORD _CNV_A_R_LINEAR_____34_CM 1 0. 0. 655.35 ECU_ADDRESS 0xd000368c FORMAT "%6.2" /end MEASUREMENT
/begin MEASUREMENT Vxx_knk_fast_dec_ctr_cyl3 "Counter for the fast loop decrease for cylinder 3" UWORD _CNV_A_R_LINEAR_____34_CM 1 0. 0. 655.35 ECU_ADDRESS 0xd000368e FORMAT "%6.2" /end MEASUREMENT
/begin MEASUREMENT Vxx_knk_fast_dec_ctr_cyl4 "Counter for the fast loop decrease for cylinder 4" UWORD _CNV_A_R_LINEAR_____34_CM 1 0. 0. 655.35 ECU_ADDRESS 0xd0003690 FORMAT "%6.2" /end MEASUREMENT
/begin MEASUREMENT Vxx_knk_iga_fast_cor_inc "Increase value for last loop" UBYTE _CNV_A_R_LINEAR_____25_CM 1 0. 0. 95.625 ECU_ADDRESS 0xd0004736 /end MEASUREMENT
/begin MEASUREMENT Vxx_knk_slow_cor_dec_ctr "Counter for the slow loop decrease" UBYTE _CNV_A_R_LINEAR_____82_CM 1 0. 0. 255. ECU_ADDRESS 0xd0004737 FORMAT "%3.0" /end MEASUREMENT
/begin MEASUREMENT Vxx_knk_slow_cor_iga_cyl1 "Timing correction from slow loop on cylinder 1" UBYTE _CNV_A_R_LINEAR_____25_CM 1 0. 0. 95.625 ECU_ADDRESS 0xd0004738 /end MEASUREMENT
/begin MEASUREMENT Vxx_knk_slow_cor_iga_cyl2 "Timing correction from slow loop on cylinder 2" UBYTE _CNV_A_R_LINEAR_____25_CM 1 0. 0. 95.625 ECU_ADDRESS 0xd0004739 /end MEASUREMENT
/begin MEASUREMENT Vxx_knk_slow_cor_iga_cyl3 "Timing correction from slow loop on cylinder 3" UBYTE _CNV_A_R_LINEAR_____25_CM 1 0. 0. 95.625 ECU_ADDRESS 0xd000473a /end MEASUREMENT
/begin MEASUREMENT Vxx_knk_slow_cor_iga_cyl4 "Timing correction from slow loop on cylinder 4" UBYTE _CNV_A_R_LINEAR_____25_CM 1 0. 0. 95.625 ECU_ADDRESS 0xd000473b /end MEASUREMENT
/begin MEASUREMENT Vxx_slow_ctr "Counter used to know the number of slow loop correction values different from 0" UBYTE _CNV_A_R_ECME_LINEA_0_CM 1 0. 0. 4. ECU_ADDRESS 0xd000473c FORMAT "%1.0" /end MEASUREMENT
/begin CHARACTERISTIC Cxx_fast_dec_step "Decrease step for fast loop" VALUE 0xa00218b8 _REC_S1VAL_20_u1 95.625 _CNV_A_R_LINEAR_____25_CM 0. 95.625 /end CHARACTERISTIC
/begin CHARACTERISTIC Cxx_knk_1cyl_slow_cor_max "Maximum value for slow correction with knock detection on only one cylinder" VALUE 0xa00218b9 _REC_S1VAL_20_u1 95.625 _CNV_A_R_LINEAR_____25_CM 0. 95.625 /end CHARACTERISTIC
/begin CHARACTERISTIC Cxx_knk_2cyl_slow_dif_max "Maximum gap between several slow loops" VALUE 0xa00218ba _REC_S1VAL_20_u1 95.625 _CNV_A_R_LINEAR_____25_CM 0. 95.625 /end CHARACTERISTIC
/begin CHARACTERISTIC Cxx_knk_fast_cor_dec_ctr "Threshold of the fast loop counter" VALUE 0xa00218b4 _REC_S1VAL_20_u2 655.35 _CNV_A_R_LINEAR_____34_CM 0. 655.35 FORMAT "%6.2" /end CHARACTERISTIC
/begin CHARACTERISTIC Cxx_knk_fast_cor_iga_max "Fast loop maximum value of the knock correction on timing" VALUE 0xa00218bb _REC_S1VAL_20_u1 95.625 _CNV_A_R_LINEAR_____25_CM 0. 95.625 /end CHARACTERISTIC
/begin CHARACTERISTIC Cxx_knk_fast_cor_iga_thd "Wrong detection threshold for the fast loop (knock correction)" VALUE 0xa00218bc _REC_S1VAL_20_u1 95.625 _CNV_A_R_LINEAR_____25_CM 0. 95.625 /end CHARACTERISTIC
/begin CHARACTERISTIC Cxx_knk_iga_cor "Value of the anti-knock ignition timing correction in degraded mode" VALUE 0xa00218bd _REC_S1VAL_20_u1 95.625 _CNV_A_R_LINEAR_____25_CM 0. 95.625 /end CHARACTERISTIC
/begin CHARACTERISTIC Cxx_knk_slow_cor_dec_ctr "Threshold of the slow loop counter" VALUE 0xa00218be _REC_S1VAL_20_u1 255. _CNV_A_R_LINEAR_____82_CM 0. 255. FORMAT "%3.0" /end CHARACTERISTIC
/begin CHARACTERISTIC Cxx_knk_slow_cor_iga_inc "Increase value for slow loop" VALUE 0xa00218bf _REC_S1VAL_20_u1 95.625 _CNV_A_R_LINEAR_____25_CM 0. 95.625 /end CHARACTERISTIC
/begin CHARACTERISTIC Cxx_knk_slow_cor_iga_max "Slow loop maximum value of the knock correction on timing" VALUE 0xa00218c0 _REC_S1VAL_20_u1 95.625 _CNV_A_R_LINEAR_____25_CM 0. 95.625 /end CHARACTERISTIC
/begin CHARACTERISTIC Cxx_knk_slow_cor_prs_dif "Maximum pressure gap for slow loop increase" VALUE 0xa00218b6 _REC_S1VAL_20_u2 20000. _CNV_A_R_LINEAR_____57_CM 0. 20000. FORMAT "%5.0" /end CHARACTERISTIC
/begin CHARACTERISTIC Cxx_slow_dec_step "Decrease value for slow loop" VALUE 0xa00218c1 _REC_S1VAL_20_u1 95.625 _CNV_A_R_LINEAR_____25_CM 0. 95.625 /end CHARACTERISTIC
/begin AXIS_PTS Ntb_vvtc_rel_angl "9 equidistant VVT intake relative angle breakpoints map" 0xa002dc00 NO_INPUT_QUANTITY _REC_A2AXS_20_u1 0.99609375 _CNV_A_R_LINEAR_____31_CM 9 0. 0.99609375 READ_ONLY FORMAT "%10.8" /end AXIS_PTS
/begin CHARACTERISTIC Cmp_n_eal_vvtc_iga "Map of maximal advance for a camshaft position corresponding to warm engine valve timings" MAP 0xa002dc0c _REC_A1MAP_20_u1_u2_u2 95.625 _CNV_A_R_IGRE_LINEA_48_CM -23.625 72. FORMAT "%7.3"
 /begin AXIS_DESCR COM_AXIS Vxx_n _CNV_A_R_ENSD_LINEA_24_CM 20 0. 16383.75 FORMAT "%8.2" AXIS_PTS_REF Ctb_n /end AXIS_DESCR
 /begin AXIS_DESCR COM_AXIS Vxx_eal _CNV_A_R_LINEAR_____53_CM 16 0. 3.99993896484375 FORMAT "%10.8" AXIS_PTS_REF Ctb_eal /end AXIS_DESCR
/end CHARACTERISTIC
/begin CHARACTERISTIC Cmp_n_eal_vvtc_off_iga "Map of maximum advance depending on engine speed and air load for VVT minimal reference angle" MAP 0xa002dd4c _REC_A1MAP_20_u1_u2_u2 95.625 _CNV_A_R_IGRE_LINEA_48_CM -23.625 72. FORMAT "%7.3"
 /begin AXIS_DESCR COM_AXIS Vxx_n _CNV_A_R_ENSD_LINEA_24_CM 20 0. 16383.75 FORMAT "%8.2" AXIS_PTS_REF Ctb_n /end AXIS_DESCR
 /begin AXIS_DESCR COM_AXIS Vxx_eal _CNV_A_R_LINEAR_____53_CM 16 0. 3.99993896484375 FORMAT "%10.8" AXIS_PTS_REF Ctb_eal /end AXIS_DESCR
/end CHARACTERISTIC
/begin CHARACTERISTIC Cmp_n_eal_vvtc_on_iga "Map of basic advance for a camshaft position corresponding to nominal engine valve timings" MAP 0xa002de8c _REC_A1MAP_20_u1_u2_u2 95.625 _CNV_A_R_IGRE_LINEA_48_CM -23.625 72. FORMAT "%7.3"
 /begin AXIS_DESCR COM_AXIS Vxx_n _CNV_A_R_ENSD_LINEA_24_CM 20 0. 16383.75 FORMAT "%8.2" AXIS_PTS_REF Ctb_n /end AXIS_DESCR
 /begin AXIS_DESCR COM_AXIS Vxx_eal _CNV_A_R_LINEAR_____53_CM 16 0. 3.99993896484375 FORMAT "%10.8" AXIS_PTS_REF Ctb_eal /end AXIS_DESCR
/end CHARACTERISTIC
/begin CHARACTERISTIC Ctp_vvtc_angl_iga_fac1 "Map of optimal advance weighting between two map of two stalling depending on VVT intake angle" CURVE 0xa002dfcc _REC_A1CUR_20_u1_u1 0.99609375 _CNV_A_R_LINEAR_____31_CM 0. 0.99609375 FORMAT "%10.8"
 /begin AXIS_DESCR COM_AXIS NO_INPUT_QUANTITY _CNV_A_R_LINEAR_____31_CM 9 0. 0.99609375 READ_ONLY FORMAT "%10.8" AXIS_PTS_REF Ntb_vvtc_rel_angl /end AXIS_DESCR
/end CHARACTERISTIC
/begin CHARACTERISTIC Ctp_vvtc_angl_iga_fac2 "Map of optimal advance weighting between two map of two stalling depending on VVT intake angle" CURVE 0xa002dfd8 _REC_A1CUR_20_u1_u1 0.99609375 _CNV_A_R_LINEAR_____31_CM 0. 0.99609375 FORMAT "%10.8"
 /begin AXIS_DESCR COM_AXIS NO_INPUT_QUANTITY _CNV_A_R_LINEAR_____31_CM 9 0. 0.99609375 READ_ONLY FORMAT "%10.8" AXIS_PTS_REF Ntb_vvtc_rel_angl /end AXIS_DESCR
/end CHARACTERISTIC
/begin MEASUREMENT Vxx_max_iga "maximum ignition advance" UBYTE _CNV_A_R_IGRE_LINEA_48_CM 1 0. -23.625 72. ECU_ADDRESS 0xd0004fa3 FORMAT "%7.3" /end MEASUREMENT
/begin MEASUREMENT Vxx_raw_max_iga "maximum ignition advance" UBYTE _CNV_A_R_IGRE_LINEA_48_CM 1 0. -23.625 72. ECU_ADDRESS 0xd0004fa4 FORMAT "%7.3" /end MEASUREMENT
/begin MEASUREMENT Vxx_raw_slow_max_iga "Raw maximum ignition advance with slow combustion correction." UBYTE _CNV_A_R_IGRE_LINEA_48_CM 1 0. -23.625 72. ECU_ADDRESS 0xd0004fa5 FORMAT "%7.3" /end MEASUREMENT
/begin MEASUREMENT Vxx_vvtc_iga "Maximuml advance for a camshaft position corresponding to warm engine valve timings" UBYTE _CNV_A_R_IGRE_LINEA_48_CM 1 0. -23.625 72. ECU_ADDRESS 0xd0004fa6 FORMAT "%7.3" /end MEASUREMENT
/begin MEASUREMENT Vxx_vvtc_iga_fac1 "Coef1 for optimal or nominal advance interpolation between the 3 ref MAPof optimal/nominal advances" UBYTE _CNV_A_R_LINEAR_____31_CM 1 0. 0. 0.99609375 ECU_ADDRESS 0xd0004fa7 FORMAT "%10.8" /end MEASUREMENT
/begin MEASUREMENT Vxx_vvtc_iga_fac2 "Coef2 for optimal or nominal advance interpolation between the 3 ref MAPof optimal/nominal advances" UBYTE _CNV_A_R_LINEAR_____31_CM 1 0. 0. 0.99609375 ECU_ADDRESS 0xd0004fa8 FORMAT "%10.8" /end MEASUREMENT
/begin MEASUREMENT Vxx_vvtc_off_iga "Maximum advance reference depending on engine speed and air load for VVT minimal reference angle" UBYTE _CNV_A_R_IGRE_LINEA_48_CM 1 0. -23.625 72. ECU_ADDRESS 0xd0004fa9 FORMAT "%7.3" /end MEASUREMENT
/begin MEASUREMENT Vxx_vvtc_on_iga "Maximum advance reference depending on engine speed and air load for VVT maximal reference angle" UBYTE _CNV_A_R_IGRE_LINEA_48_CM 1 0. -23.625 72. ECU_ADDRESS 0xd0004faa FORMAT "%7.3" /end MEASUREMENT
/begin CHARACTERISTIC Cxx_vvtc_h_trt "high stop of the camshaft" VALUE 0xa0020c36 _REC_S1VAL_20_u2 719.98 _CNV_A_R_LINEAR_____76_CM 0. 719.98 FORMAT "%6.2" /end CHARACTERISTIC
/begin CHARACTERISTIC Cxx_vvtc_min_iga_cor "dead zone where advance = advance for a camshaft position corresponding to warm engine valve timings" VALUE 0xa0020c38 _REC_S1VAL_20_u2 719.98 _CNV_A_R_LINEAR_____76_CM 0. 719.98 FORMAT "%6.2" /end CHARACTERISTIC
/begin AXIS_PTS Ntb_cyl_nr "Table of mumber of active cylinders  Ntb_cyl_nr = [2 3 4]" 0xa00218c2 Vxx_inj_cut_nr _REC_A2AXS_20_u1 4. _CNV_A_R_ECME_LINEA_0_CM 3 0. 4. READ_ONLY FORMAT "%1.0" /end AXIS_PTS
/begin CHARACTERISTIC Cmp_eal_n_min_iga_cor "Temporary advance correction applied on static minimal advance" MAP 0xa002fd74 _REC_A1MAP_20_u1_u2_u2 95.625 _CNV_A_R_IGRE_LINEA_48_CM -23.625 72. FORMAT "%7.3"
 /begin AXIS_DESCR COM_AXIS Vxx_eal _CNV_A_R_LINEAR_____53_CM 9 0. 3.99993896484375 FORMAT "%10.8" AXIS_PTS_REF Ctb_eal2 /end AXIS_DESCR
 /begin AXIS_DESCR COM_AXIS Vxx_n _CNV_A_R_ENSD_LINEA_24_CM 9 0. 16383.75 FORMAT "%8.2" AXIS_PTS_REF Ctb_n2 /end AXIS_DESCR
/end CHARACTERISTIC
/begin CHARACTERISTIC Cmp_iga_tco_cor "Minimal advance correction function of coolant temperature" MAP 0xa002fdc8 _REC_A1MAP_20_u1_u2_u2 95.625 _CNV_A_R_LINEAR_____25_CM 0. 95.625
 /begin AXIS_DESCR COM_AXIS Vxx_eal _CNV_A_R_LINEAR_____53_CM 9 0. 3.99993896484375 FORMAT "%10.8" AXIS_PTS_REF Ctb_eal2 /end AXIS_DESCR
 /begin AXIS_DESCR COM_AXIS Vxx_tco _CNV_A_R_LINEAR_____54_CM 16 -40. 200. FORMAT "%5.1" AXIS_PTS_REF Ctb_tco /end AXIS_DESCR
/end CHARACTERISTIC
/begin CHARACTERISTIC Cmp_iga_tq_min "Minimal advance function of engine speed and engine air load" MAP 0xa002fe58 _REC_A1MAP_20_u1_u2_u2 95.625 _CNV_A_R_IGRE_LINEA_48_CM -23.625 72. FORMAT "%7.3"
 /begin AXIS_DESCR COM_AXIS Vxx_eal _CNV_A_R_LINEAR_____53_CM 9 0. 3.99993896484375 FORMAT "%10.8" AXIS_PTS_REF Ctb_eal2 /end AXIS_DESCR
 /begin AXIS_DESCR COM_AXIS Vxx_n _CNV_A_R_ENSD_LINEA_24_CM 9 0. 16383.75 FORMAT "%8.2" AXIS_PTS_REF Ctb_n2 /end AXIS_DESCR
/end CHARACTERISTIC
/begin CHARACTERISTIC Cmx_n_iga_tq_min_lih "minimal advance in case of a loss control of the throttle" MAP 0xa002feac _REC_A1MAP_20_u1_u1_u2 95.625 _CNV_A_R_IGRE_LINEA_48_CM -23.625 72. FORMAT "%7.3"
 /begin AXIS_DESCR COM_AXIS Vxx_inj_cut_nr _CNV_A_R_ECME_LINEA_0_CM 3 0. 4. READ_ONLY FORMAT "%1.0" AXIS_PTS_REF Ntb_cyl_nr /end AXIS_DESCR
 /begin AXIS_DESCR COM_AXIS Vxx_n _CNV_A_R_ENSD_LINEA_24_CM 9 0. 16383.75 FORMAT "%8.2" AXIS_PTS_REF Ctb_n2 /end AXIS_DESCR
/end CHARACTERISTIC
/begin MEASUREMENT Vbx_it_dft "limp home" UBYTE _CNV_S_2_RANGE______3_CM 1 0. 0. 1. ECU_ADDRESS 0xd00055ae BIT_MASK 0x1 /end MEASUREMENT
/begin MEASUREMENT Vbx_l_min_iga "advance setpoint below static minimal advance" UBYTE _CNV_S_2_RANGE______3_CM 1 0. 0. 1. ECU_ADDRESS 0xd00055af BIT_MASK 0x1 /end MEASUREMENT
/begin MEASUREMENT Vbx_l_min_iga_ctr_thd "The time that can be spent below the minimal advance is reached" UBYTE _CNV_S_2_RANGE______3_CM 1 0. 0. 1. ECU_ADDRESS 0xd00055b0 BIT_MASK 0x1 /end MEASUREMENT
/begin MEASUREMENT Vbx_min_iga_dsb "The minimal advance is limited" UBYTE _CNV_S_2_RANGE______3_CM 1 0. 0. 1. ECU_ADDRESS 0xd00055b1 BIT_MASK 0x1 /end MEASUREMENT
/begin MEASUREMENT Vxx_cor_min_iga "Corrected minimal advance" UBYTE _CNV_A_R_IGRE_LINEA_48_CM 1 0. -23.625 72. ECU_ADDRESS 0xd00055b2 FORMAT "%7.3" /end MEASUREMENT
/begin MEASUREMENT Vxx_l_min_iga_ctr "activation counter of the offset on the static minimal advance" UBYTE _CNV_A_R_ECME_LINEA_0_CM 1 0. 0. 255. ECU_ADDRESS 0xd00055b3 FORMAT "%3.0" /end MEASUREMENT
/begin MEASUREMENT Vxx_min_iga "minimum ignition advance" UBYTE _CNV_A_R_IGRE_LINEA_48_CM 1 0. -23.625 72. ECU_ADDRESS 0xd00055b4 FORMAT "%7.3" /end MEASUREMENT
/begin MEASUREMENT Vxx_min_iga_dsb_t "Remaining time of inhibition of a new temporary correction of minimal advance" UBYTE _CNV_A_R_LINEAR_____4_CM 1 0. 0. 25.5 ECU_ADDRESS 0xd00055b5 FORMAT "%4.1" /end MEASUREMENT
/begin MEASUREMENT Vxx_stat_min_iga "minimum static ignition advance" UBYTE _CNV_A_R_IGRE_LINEA_48_CM 1 0. -23.625 72. ECU_ADDRESS 0xd00055b6 FORMAT "%7.3" /end MEASUREMENT
/begin CHARACTERISTIC Cxx_l_min_iga_ctr_dec "Decrement of time counter past under the minimal static" VALUE 0xa00218c6 _REC_S1VAL_20_u1 255. _CNV_A_R_ECME_LINEA_0_CM 0. 255. FORMAT "%3.0" /end CHARACTERISTIC
/begin CHARACTERISTIC Cxx_l_min_iga_ctr_inc "Increment of time counter past under the minimal static" VALUE 0xa00218c7 _REC_S1VAL_20_u1 255. _CNV_A_R_ECME_LINEA_0_CM 0. 255. FORMAT "%3.0" /end CHARACTERISTIC
/begin CHARACTERISTIC Cxx_l_min_iga_ctr_thd "Counter threshold to forbit temporary minimal advance" VALUE 0xa00218c8 _REC_S1VAL_20_u1 255. _CNV_A_R_ECME_LINEA_0_CM 0. 255. FORMAT "%3.0" /end CHARACTERISTIC
/begin CHARACTERISTIC Cxx_l_min_iga_inc "Increment of the smoothing between the dynamic minimal advance and the static minimal advance" VALUE 0xa00218c9 _REC_S1VAL_20_u1 95.625 _CNV_A_R_LINEAR_____25_CM 0. 95.625 /end CHARACTERISTIC
/begin CHARACTERISTIC Cxx_min_iga_dsb_t "advance requests smaller than static minimal advance are forbidden during Cxx_min_iga_dsb_t" VALUE 0xa00218ca _REC_S1VAL_20_u1 25.5 _CNV_A_R_LINEAR_____4_CM 0. 25.5 FORMAT "%4.1" /end CHARACTERISTIC
/begin AXIS_PTS Ctb_mat "breakpoints of manifold air temperature" 0xa0028ce8 Vxx_mat _REC_A2AXS_20_u2 240. _CNV_A_R_LINEAR_____54_CM 16 -40. 200. FORMAT "%5.1" /end AXIS_PTS
/begin CHARACTERISTIC Cmp_mat_n_ol_knk_iga_cor "preventive knock correction function of engine speed and manifold temperature." MAP 0xa0028d0c _REC_A1MAP_20_u1_u2_u2 95.625 _CNV_A_R_LINEAR_____30_CM -48. 47.625 FORMAT "%7.3"
 /begin AXIS_DESCR COM_AXIS Vxx_mat _CNV_A_R_LINEAR_____54_CM 16 -40. 200. FORMAT "%5.1" AXIS_PTS_REF Ctb_mat /end AXIS_DESCR
 /begin AXIS_DESCR COM_AXIS Vxx_n _CNV_A_R_ENSD_LINEA_24_CM 9 0. 16383.75 FORMAT "%8.2" AXIS_PTS_REF Ctb_n2 /end AXIS_DESCR
/end CHARACTERISTIC
/begin CHARACTERISTIC Ctp_eal_ol_knk_iga_cor_fac "corrective factor on preventive knock correction function of engine air load" CURVE 0xa0028d9c _REC_A1CUR_20_u1_u2 0.99609375 _CNV_A_R_LINEAR_____31_CM 0. 0.99609375 FORMAT "%10.8"
 /begin AXIS_DESCR COM_AXIS Vxx_eal _CNV_A_R_LINEAR_____53_CM 16 0. 3.99993896484375 FORMAT "%10.8" AXIS_PTS_REF Ctb_eal /end AXIS_DESCR
/end CHARACTERISTIC
/begin MEASUREMENT Vxx_ol_knk_iga_cor "Advance correction to prevent knock for high air temperature" SBYTE _CNV_A_R_LINEAR_____25_CM 1 0. -48. 47.625 ECU_ADDRESS 0xd0005213 FORMAT "%7.3" /end MEASUREMENT
/begin CHARACTERISTIC Cmp_tco_slow_comb_iga_cor "Advance correction for slow combustion (low temperature)." MAP 0xa002ff18 _REC_A1MAP_20_u1_u2_u2 95.625 _CNV_A_R_LINEAR_____30_CM -48. 47.625 FORMAT "%7.3"
 /begin AXIS_DESCR COM_AXIS Vxx_tco _CNV_A_R_LINEAR_____54_CM 16 -40. 200. FORMAT "%5.1" AXIS_PTS_REF Ctb_tco /end AXIS_DESCR
 /begin AXIS_DESCR COM_AXIS Vxx_eal _CNV_A_R_LINEAR_____53_CM 16 0. 3.99993896484375 FORMAT "%10.8" AXIS_PTS_REF Ctb_eal /end AXIS_DESCR
/end CHARACTERISTIC
/begin CHARACTERISTIC Ctp_n_slow_comb_fac "Factor depending on engine speed on slow combustion advance correction." CURVE 0xa0030018 _REC_A1CUR_20_u1_u2 0.996078431372549 _CNV_A_R_LINEAR_____118_CM 3.92156862745098e-003 1. FORMAT "%9.7"
 /begin AXIS_DESCR COM_AXIS Vxx_n _CNV_A_R_ENSD_LINEA_24_CM 9 0. 16383.75 FORMAT "%8.2" AXIS_PTS_REF Ctb_n2 /end AXIS_DESCR
/end CHARACTERISTIC
/begin MEASUREMENT Vxx_slow_comb_iga_cor "Advance correction for slow combustion." SBYTE _CNV_A_R_LINEAR_____25_CM 1 0. -48. 47.625 ECU_ADDRESS 0xd00055be FORMAT "%7.3" /end MEASUREMENT
/begin CHARACTERISTIC Cmp_eal_n_vvtc_off_otl_iga "Map of optimal advance depending on engine speed and air load for VVT minimal reference angle" MAP 0xa002264c _REC_A1MAP_20_u1_u2_u2 95.625 _CNV_A_R_IGRE_LINEA_48_CM -23.625 72. FORMAT "%7.3"
 /begin AXIS_DESCR COM_AXIS Vxx_n _CNV_A_R_ENSD_LINEA_24_CM 20 0. 16383.75 FORMAT "%8.2" AXIS_PTS_REF Ctb_n /end AXIS_DESCR
 /begin AXIS_DESCR COM_AXIS Vxx_eal _CNV_A_R_LINEAR_____53_CM 16 0. 3.99993896484375 FORMAT "%10.8" AXIS_PTS_REF Ctb_eal /end AXIS_DESCR
/end CHARACTERISTIC
/begin CHARACTERISTIC Cmp_eal_n_vvtc_on_otl_iga "Map of optimal advance depending on engine speed and air load for VVT maximal reference angle" MAP 0xa002278c _REC_A1MAP_20_u1_u2_u2 95.625 _CNV_A_R_IGRE_LINEA_48_CM -23.625 72. FORMAT "%7.3"
 /begin AXIS_DESCR COM_AXIS Vxx_n _CNV_A_R_ENSD_LINEA_24_CM 20 0. 16383.75 FORMAT "%8.2" AXIS_PTS_REF Ctb_n /end AXIS_DESCR
 /begin AXIS_DESCR COM_AXIS Vxx_eal _CNV_A_R_LINEAR_____53_CM 16 0. 3.99993896484375 FORMAT "%10.8" AXIS_PTS_REF Ctb_eal /end AXIS_DESCR
/end CHARACTERISTIC
/begin CHARACTERISTIC Cmp_eal_n_vvtc_otl_iga "Map of optimal advance for a camshaft position corresponding to warm engine valve timings" MAP 0xa00228cc _REC_A1MAP_20_u1_u2_u2 95.625 _CNV_A_R_IGRE_LINEA_48_CM -23.625 72. FORMAT "%7.3"
 /begin AXIS_DESCR COM_AXIS Vxx_n _CNV_A_R_ENSD_LINEA_24_CM 20 0. 16383.75 FORMAT "%8.2" AXIS_PTS_REF Ctb_n /end AXIS_DESCR
 /begin AXIS_DESCR COM_AXIS Vxx_eal _CNV_A_R_LINEAR_____53_CM 16 0. 3.99993896484375 FORMAT "%10.8" AXIS_PTS_REF Ctb_eal /end AXIS_DESCR
/end CHARACTERISTIC
/begin MEASUREMENT Vsx_otl_iga_vld "Optimal advance validity status" UBYTE _CNV_S_3_STATUS_OK__120_CM 1 0. 0. 2. ECU_ADDRESS 0xd0004c21 /end MEASUREMENT
/begin MEASUREMENT Vxx_otl_iga "Optimal advance" UBYTE _CNV_A_R_IGRE_LINEA_48_CM 1 0. -23.625 72. ECU_ADDRESS 0xd0004c22 FORMAT "%7.3" /end MEASUREMENT
/begin MEASUREMENT Vxx_raw_otl_iga "Optimal advance depending on engine speed, air load and VVT intake angle" UBYTE _CNV_A_R_IGRE_LINEA_48_CM 1 0. -23.625 72. ECU_ADDRESS 0xd0004c23 FORMAT "%7.3" /end MEASUREMENT
/begin MEASUREMENT Vxx_vvtc_off_otl_iga "Optimal advance reference depending on engine speed and air load for VVT minimal reference angle" UBYTE _CNV_A_R_IGRE_LINEA_48_CM 1 0. -23.625 72. ECU_ADDRESS 0xd0004c24 FORMAT "%7.3" /end MEASUREMENT
/begin MEASUREMENT Vxx_vvtc_on_otl_iga "Optimal advance reference depending on engine speed and air load for VVT maximal reference angle" UBYTE _CNV_A_R_IGRE_LINEA_48_CM 1 0. -23.625 72. ECU_ADDRESS 0xd0004c25 FORMAT "%7.3" /end MEASUREMENT
/begin MEASUREMENT Vxx_vvtc_otl_iga "Optimal advance for a camshaft position corresponding to warm engine valve timings" UBYTE _CNV_A_R_IGRE_LINEA_48_CM 1 0. -23.625 72. ECU_ADDRESS 0xd0004c26 FORMAT "%7.3" /end MEASUREMENT
/begin CHARACTERISTIC Cmp_eal_n_vvtc_otl_iga_alco "Map of Optimal advance correction for a camshaft position corresponding to warm engine valve timings for flex-fuel." MAP 0xa002e44c _REC_A1MAP_20_u1_u2_u2 95.625 _CNV_A_R_LINEAR_____30_CM -48. 47.625 FORMAT "%7.3"
 /begin AXIS_DESCR COM_AXIS Vxx_n _CNV_A_R_ENSD_LINEA_24_CM 20 0. 16383.75 FORMAT "%8.2" AXIS_PTS_REF Ctb_n /end AXIS_DESCR
 /begin AXIS_DESCR COM_AXIS Vxx_eal _CNV_A_R_LINEAR_____53_CM 16 0. 3.99993896484375 FORMAT "%10.8" AXIS_PTS_REF Ctb_eal /end AXIS_DESCR
/end CHARACTERISTIC
/begin MEASUREMENT Vxx_vvtc_otl_iga_alco "Optimal Advance correction for Flex Fuel." SBYTE _CNV_A_R_LINEAR_____25_CM 1 0. -48. 47.625 ECU_ADDRESS 0xd0004a72 FORMAT "%7.3" /end MEASUREMENT
/begin MEASUREMENT Vbx_df_igc_1_oc "Open circuit of ignition coil 1 detected failure" UBYTE _CNV_S_2_RANGE______3_CM 1 0. 0. 1. ECU_ADDRESS 0xd0004999 BIT_MASK 0x1 /end MEASUREMENT
/begin MEASUREMENT Vbx_df_igc_1_scg "Short Circuit to Ground of ignition coil 1 detected failure" UBYTE _CNV_S_2_RANGE______3_CM 1 0. 0. 1. ECU_ADDRESS 0xd000499a BIT_MASK 0x1 /end MEASUREMENT
/begin MEASUREMENT Vbx_df_igc_1_scw "Short Circuit to Battery of ignition coil 1 detected failure" UBYTE _CNV_S_2_RANGE______3_CM 1 0. 0. 1. ECU_ADDRESS 0xd000499b BIT_MASK 0x1 /end MEASUREMENT
/begin MEASUREMENT Vbx_df_igc_2_oc "Open circuit of ignition coil 2 detected failure" UBYTE _CNV_S_2_RANGE______3_CM 1 0. 0. 1. ECU_ADDRESS 0xd000499c BIT_MASK 0x1 /end MEASUREMENT
/begin MEASUREMENT Vbx_df_igc_2_scg "Short Circuit to Ground of ignition coil 2 detected failure" UBYTE _CNV_S_2_RANGE______3_CM 1 0. 0. 1. ECU_ADDRESS 0xd000499d BIT_MASK 0x1 /end MEASUREMENT
/begin MEASUREMENT Vbx_df_igc_2_scw "Short Circuit to Battery of ignition coil 2 detected failure" UBYTE _CNV_S_2_RANGE______3_CM 1 0. 0. 1. ECU_ADDRESS 0xd000499e BIT_MASK 0x1 /end MEASUREMENT
/begin MEASUREMENT Vbx_df_igc_3_oc "Open circuit of ignition coil 3 detected failure" UBYTE _CNV_S_2_RANGE______3_CM 1 0. 0. 1. ECU_ADDRESS 0xd000499f BIT_MASK 0x1 /end MEASUREMENT
/begin MEASUREMENT Vbx_df_igc_3_scg "Short Circuit to Ground of ignition coil 3 detected failure" UBYTE _CNV_S_2_RANGE______3_CM 1 0. 0. 1. ECU_ADDRESS 0xd00049a0 BIT_MASK 0x1 /end MEASUREMENT
/begin MEASUREMENT Vbx_df_igc_3_scw "Short Circuit to Battery of ignition coil 3 detected failure" UBYTE _CNV_S_2_RANGE______3_CM 1 0. 0. 1. ECU_ADDRESS 0xd00049a1 BIT_MASK 0x1 /end MEASUREMENT
/begin MEASUREMENT Vbx_df_igc_4_oc "Open circuit of ignition coil 4 detected failure" UBYTE _CNV_S_2_RANGE______3_CM 1 0. 0. 1. ECU_ADDRESS 0xd00049a2 BIT_MASK 0x1 /end MEASUREMENT
/begin MEASUREMENT Vbx_df_igc_4_scg "Short Circuit to Ground of ignition coil 4 detected failure" UBYTE _CNV_S_2_RANGE______3_CM 1 0. 0. 1. ECU_ADDRESS 0xd00049a3 BIT_MASK 0x1 /end MEASUREMENT
/begin MEASUREMENT Vbx_df_igc_4_scw "Short Circuit to Battery of ignition coil 4 detected failure" UBYTE _CNV_S_2_RANGE______3_CM 1 0. 0. 1. ECU_ADDRESS 0xd00049a4 BIT_MASK 0x1 /end MEASUREMENT
/begin MEASUREMENT Vbx_diag_ena_igc_1_oc "Open Circuit of ignition coil 1 diagnosis authorization" UBYTE _CNV_S_2_RANGE______3_CM 1 0. 0. 1. ECU_ADDRESS 0xd00049a5 BIT_MASK 0x1 /end MEASUREMENT
/begin MEASUREMENT Vbx_diag_ena_igc_1_scg "Short Circuit to Ground of ignition coil 1 diagnosis authorization" UBYTE _CNV_S_2_RANGE______3_CM 1 0. 0. 1. ECU_ADDRESS 0xd00049a6 BIT_MASK 0x1 /end MEASUREMENT
/begin MEASUREMENT Vbx_diag_ena_igc_1_scw "Short Circuit to Battery of ignition coil 1 diagnosis authorization" UBYTE _CNV_S_2_RANGE______3_CM 1 0. 0. 1. ECU_ADDRESS 0xd00049a7 BIT_MASK 0x1 /end MEASUREMENT
/begin MEASUREMENT Vbx_diag_ena_igc_2_oc "Open Circuit of ignition coil 2 diagnosis authorization" UBYTE _CNV_S_2_RANGE______3_CM 1 0. 0. 1. ECU_ADDRESS 0xd00049a8 BIT_MASK 0x1 /end MEASUREMENT
/begin MEASUREMENT Vbx_diag_ena_igc_2_scg "Short Circuit to Ground of ignition coil 2 diagnosis authorization" UBYTE _CNV_S_2_RANGE______3_CM 1 0. 0. 1. ECU_ADDRESS 0xd00049a9 BIT_MASK 0x1 /end MEASUREMENT
/begin MEASUREMENT Vbx_diag_ena_igc_2_scw "Short Circuit to Battery of ignition coil 2 diagnosis authorization" UBYTE _CNV_S_2_RANGE______3_CM 1 0. 0. 1. ECU_ADDRESS 0xd00049aa BIT_MASK 0x1 /end MEASUREMENT
/begin MEASUREMENT Vbx_diag_ena_igc_3_oc "Open Circuit of ignition coil 3 diagnosis authorization" UBYTE _CNV_S_2_RANGE______3_CM 1 0. 0. 1. ECU_ADDRESS 0xd00049ab BIT_MASK 0x1 /end MEASUREMENT
/begin MEASUREMENT Vbx_diag_ena_igc_3_scg "Short Circuit to Ground of ignition coil 3 diagnosis authorization" UBYTE _CNV_S_2_RANGE______3_CM 1 0. 0. 1. ECU_ADDRESS 0xd00049ac BIT_MASK 0x1 /end MEASUREMENT
/begin MEASUREMENT Vbx_diag_ena_igc_3_scw "Short Circuit to Battery of ignition coil 3 diagnosis authorization" UBYTE _CNV_S_2_RANGE______3_CM 1 0. 0. 1. ECU_ADDRESS 0xd00049ad BIT_MASK 0x1 /end MEASUREMENT
/begin MEASUREMENT Vbx_diag_ena_igc_4_oc "Open Circuit of ignition coil 4 diagnosis authorization" UBYTE _CNV_S_2_RANGE______3_CM 1 0. 0. 1. ECU_ADDRESS 0xd00049ae BIT_MASK 0x1 /end MEASUREMENT
/begin MEASUREMENT Vbx_diag_ena_igc_4_scg "Short Circuit to Ground of ignition coil 4 diagnosis authorization" UBYTE _CNV_S_2_RANGE______3_CM 1 0. 0. 1. ECU_ADDRESS 0xd00049af BIT_MASK 0x1 /end MEASUREMENT
/begin MEASUREMENT Vbx_diag_ena_igc_4_scw "Short Circuit to Battery of ignition coil 4 diagnosis authorization" UBYTE _CNV_S_2_RANGE______3_CM 1 0. 0. 1. ECU_ADDRESS 0xd00049b0 BIT_MASK 0x1 /end MEASUREMENT
/begin MEASUREMENT iga_av_shift_rng[0] "Applied ignition angle; all corrections, knock control, torque intervention and start management included. x equals to index cylinder index ie from 0 to NC_CYL_NR -1 with NC_CYL_NR = 4" UBYTE _CNV_A_R_IGRE_LINEA_48_CM 1 0. -23.625 72. ECU_ADDRESS 0xd0004f56 FORMAT "%7.3" /end MEASUREMENT
/begin MEASUREMENT iga_av_shift_rng[1] "Applied ignition angle; all corrections, knock control, torque intervention and start management included. x equals to index cylinder index ie from 0 to NC_CYL_NR -1 with NC_CYL_NR = 4" UBYTE _CNV_A_R_IGRE_LINEA_48_CM 1 0. -23.625 72. ECU_ADDRESS 0xd0004f57 FORMAT "%7.3" /end MEASUREMENT
/begin MEASUREMENT iga_av_shift_rng[2] "Applied ignition angle; all corrections, knock control, torque intervention and start management included. x equals to index cylinder index ie from 0 to NC_CYL_NR -1 with NC_CYL_NR = 4" UBYTE _CNV_A_R_IGRE_LINEA_48_CM 1 0. -23.625 72. ECU_ADDRESS 0xd0004f58 FORMAT "%7.3" /end MEASUREMENT
/begin MEASUREMENT iga_av_shift_rng[3] "Applied ignition angle; all corrections, knock control, torque intervention and start management included. x equals to index cylinder index ie from 0 to NC_CYL_NR -1 with NC_CYL_NR = 4" UBYTE _CNV_A_R_IGRE_LINEA_48_CM 1 0. -23.625 72. ECU_ADDRESS 0xd0004f59 FORMAT "%7.3" /end MEASUREMENT
/begin MEASUREMENT inh_igc_cus "Identification of cylinders shut off" UBYTE _CNV_A_R_ECME_LINEA_0_CM 1 0. 0. 255. ECU_ADDRESS 0xd0004f5a FORMAT "%3.0" /end MEASUREMENT
/begin MEASUREMENT lv_err_errm_igc_ol[0] "Table of open circuit ignition coil failure confirmed. x equals to index cylinder index ie from 0 to NC_CYL_NR-1 with NC_CYL_NR=4" UBYTE _CNV_S_2_RANGE______3_CM 1 0. 0. 1. ECU_ADDRESS 0xd0004f4a BIT_MASK 0x1 /end MEASUREMENT
/begin MEASUREMENT lv_err_errm_igc_ol[1] "Table of open circuit ignition coil failure confirmed. x equals to index cylinder index ie from 0 to NC_CYL_NR-1 with NC_CYL_NR=4" UBYTE _CNV_S_2_RANGE______3_CM 1 0. 0. 1. ECU_ADDRESS 0xd0004f4b BIT_MASK 0x1 /end MEASUREMENT
/begin MEASUREMENT lv_err_errm_igc_ol[2] "Table of open circuit ignition coil failure confirmed. x equals to index cylinder index ie from 0 to NC_CYL_NR-1 with NC_CYL_NR=4" UBYTE _CNV_S_2_RANGE______3_CM 1 0. 0. 1. ECU_ADDRESS 0xd0004f4c BIT_MASK 0x1 /end MEASUREMENT
/begin MEASUREMENT lv_err_errm_igc_ol[3] "Table of open circuit ignition coil failure confirmed. x equals to index cylinder index ie from 0 to NC_CYL_NR-1 with NC_CYL_NR=4" UBYTE _CNV_S_2_RANGE______3_CM 1 0. 0. 1. ECU_ADDRESS 0xd0004f4d BIT_MASK 0x1 /end MEASUREMENT
/begin MEASUREMENT lv_err_errm_igc_scg[0] "Table of short circuit to ground ignition coil failure confirmed. x equals to index cylinder index ie from 0 to NC_CYL_NR-1 with NC_CYL_NR=4" UBYTE _CNV_S_2_RANGE______3_CM 1 0. 0. 1. ECU_ADDRESS 0xd0004f52 BIT_MASK 0x1 /end MEASUREMENT
/begin MEASUREMENT lv_err_errm_igc_scg[1] "Table of short circuit to ground ignition coil failure confirmed. x equals to index cylinder index ie from 0 to NC_CYL_NR-1 with NC_CYL_NR=4" UBYTE _CNV_S_2_RANGE______3_CM 1 0. 0. 1. ECU_ADDRESS 0xd0004f53 BIT_MASK 0x1 /end MEASUREMENT
/begin MEASUREMENT lv_err_errm_igc_scg[2] "Table of short circuit to ground ignition coil failure confirmed. x equals to index cylinder index ie from 0 to NC_CYL_NR-1 with NC_CYL_NR=4" UBYTE _CNV_S_2_RANGE______3_CM 1 0. 0. 1. ECU_ADDRESS 0xd0004f54 BIT_MASK 0x1 /end MEASUREMENT
/begin MEASUREMENT lv_err_errm_igc_scg[3] "Table of short circuit to ground ignition coil failure confirmed. x equals to index cylinder index ie from 0 to NC_CYL_NR-1 with NC_CYL_NR=4" UBYTE _CNV_S_2_RANGE______3_CM 1 0. 0. 1. ECU_ADDRESS 0xd0004f55 BIT_MASK 0x1 /end MEASUREMENT
/begin MEASUREMENT lv_err_errm_igc_scp[0] "Table of short circuit to battery ignition coil failure confirmed. x equals to index cylinder index ie from 0 to NC_CYL_NR-1 with NC_CYL_NR=4" UBYTE _CNV_S_2_RANGE______3_CM 1 0. 0. 1. ECU_ADDRESS 0xd0004f4e BIT_MASK 0x1 /end MEASUREMENT
/begin MEASUREMENT lv_err_errm_igc_scp[1] "Table of short circuit to battery ignition coil failure confirmed. x equals to index cylinder index ie from 0 to NC_CYL_NR-1 with NC_CYL_NR=4" UBYTE _CNV_S_2_RANGE______3_CM 1 0. 0. 1. ECU_ADDRESS 0xd0004f4f BIT_MASK 0x1 /end MEASUREMENT
/begin MEASUREMENT lv_err_errm_igc_scp[2] "Table of short circuit to battery ignition coil failure confirmed. x equals to index cylinder index ie from 0 to NC_CYL_NR-1 with NC_CYL_NR=4" UBYTE _CNV_S_2_RANGE______3_CM 1 0. 0. 1. ECU_ADDRESS 0xd0004f50 BIT_MASK 0x1 /end MEASUREMENT
/begin MEASUREMENT lv_err_errm_igc_scp[3] "Table of short circuit to battery ignition coil failure confirmed. x equals to index cylinder index ie from 0 to NC_CYL_NR-1 with NC_CYL_NR=4" UBYTE _CNV_S_2_RANGE______3_CM 1 0. 0. 1. ECU_ADDRESS 0xd0004f51 BIT_MASK 0x1 /end MEASUREMENT
/begin MEASUREMENT state_td_boost "State for the dwell time boost: 0=no dwell boost; 1=dwell time boost at start; 2=dwell time boost at transient" UBYTE _CNV_A_R_ECME_LINEA_0_CM 1 0. 0. 2. ECU_ADDRESS 0xd0004f5b FORMAT "%3.0" /end MEASUREMENT
/begin AXIS_PTS ldp_n_32_ip_fac_add_pulse "" 0xa0021124 n_32 _REC_A2AXS_20_u1 8160. _CNV_A_R_LINEAR_____2_CM 6 0. 8160. FORMAT "%4.0" /end AXIS_PTS
/begin AXIS_PTS ldp_tco_ip_psn_dif_eng_syn_thd "" 0xa002112c tco _REC_A2AXS_20_u1 190.5 _CNV_A_R_LINEAR_____42_CM 4 -48. 142.5 FORMAT "%6.2" /end AXIS_PTS
/begin AXIS_PTS ldpm_vb_1_injr "" 0xa002c330 vb _REC_A2AXS_20_u1 25.8984375 _CNV_A_R_LINEAR_____41_CM 8 0. 25.8984375 FORMAT "%9.6" /end AXIS_PTS
/begin CHARACTERISTIC ip_fac_add_pulse "Weighting factor for additive pulses in case of injection time update at transient conditions" CURVE 0xa0021138 _REC_A1CUR_20_u1_u1 1.9921875 _CNV_A_R_LINEAR_____43_CM 0. 1.9921875 FORMAT "%8.6"
 /begin AXIS_DESCR COM_AXIS n_32 _CNV_A_R_LINEAR_____2_CM 6 0. 8160. FORMAT "%4.0" AXIS_PTS_REF ldp_n_32_ip_fac_add_pulse /end AXIS_DESCR
/end CHARACTERISTIC
/begin CHARACTERISTIC ip_psn_dif_eng_syn_thd "Lower threshold of the difference of the estimated engine position in the non syn. phase to allow a preinjection" CURVE 0xa0021110 _REC_A1CUR_20_u2_u1 720. _CNV_A_R_LINEAR_____25_CM 0. 720. FORMAT "%7.3"
 /begin AXIS_DESCR COM_AXIS tco _CNV_A_R_LINEAR_____42_CM 4 -48. 142.5 FORMAT "%6.2" AXIS_PTS_REF ldp_tco_ip_psn_dif_eng_syn_thd /end AXIS_DESCR
/end CHARACTERISTIC
/begin CHARACTERISTIC ip_ti_add_dly "Injector dead time correction" CURVE 0xa002d0ec _REC_A1CUR_20_u2_u1 262.14 _CNV_A_R_LINEAR_____246_CM -131.072 131.068 FORMAT "%8.3"
 /begin AXIS_DESCR COM_AXIS vb _CNV_A_R_LINEAR_____41_CM 8 0. 25.8984375 FORMAT "%9.6" AXIS_PTS_REF ldpm_vb_1_injr /end AXIS_DESCR
/end CHARACTERISTIC
/begin CHARACTERISTIC ip_ti_add_pulse_min "Minimum injection time for additive injection pulse, homogeneous mode" CURVE 0xa002d0fc _REC_A1CUR_20_u2_u1 262.14 _CNV_A_R_LINEAR_____44_CM 0. 262.14 FORMAT "%7.3"
 /begin AXIS_DESCR COM_AXIS vb _CNV_A_R_LINEAR_____41_CM 8 0. 25.8984375 FORMAT "%9.6" AXIS_PTS_REF ldpm_vb_1_injr /end AXIS_DESCR
/end CHARACTERISTIC
/begin MEASUREMENT Vbx_df_inj1_oc "Diagnosis Injector 1 (symptome)" UBYTE _CNV_S_2_RANGE______3_CM 1 0. 0. 1. ECU_ADDRESS 0xd0004787 BIT_MASK 0x1 /end MEASUREMENT
/begin MEASUREMENT Vbx_df_inj1_scg "Diagnosis Injector 1 (symptome)" UBYTE _CNV_S_2_RANGE______3_CM 1 0. 0. 1. ECU_ADDRESS 0xd0004788 BIT_MASK 0x1 /end MEASUREMENT
/begin MEASUREMENT Vbx_df_inj1_scw "Diagnosis Injector 1 (symptome)" UBYTE _CNV_S_2_RANGE______3_CM 1 0. 0. 1. ECU_ADDRESS 0xd0004789 BIT_MASK 0x1 /end MEASUREMENT
/begin MEASUREMENT Vbx_df_inj2_oc "Diagnosis Injector 2 (symptome)" UBYTE _CNV_S_2_RANGE______3_CM 1 0. 0. 1. ECU_ADDRESS 0xd000478a BIT_MASK 0x1 /end MEASUREMENT
/begin MEASUREMENT Vbx_df_inj2_scg "Diagnosis Injector 2 (symptome)" UBYTE _CNV_S_2_RANGE______3_CM 1 0. 0. 1. ECU_ADDRESS 0xd000478b BIT_MASK 0x1 /end MEASUREMENT
/begin MEASUREMENT Vbx_df_inj2_scw "Diagnosis Injector 2 (symptome)" UBYTE _CNV_S_2_RANGE______3_CM 1 0. 0. 1. ECU_ADDRESS 0xd000478c BIT_MASK 0x1 /end MEASUREMENT
/begin MEASUREMENT Vbx_df_inj3_oc "Diagnosis Injector 3 (symptome)" UBYTE _CNV_S_2_RANGE______3_CM 1 0. 0. 1. ECU_ADDRESS 0xd000478d BIT_MASK 0x1 /end MEASUREMENT
/begin MEASUREMENT Vbx_df_inj3_scg "Diagnosis Injector 3 (symptome)" UBYTE _CNV_S_2_RANGE______3_CM 1 0. 0. 1. ECU_ADDRESS 0xd000478e BIT_MASK 0x1 /end MEASUREMENT
/begin MEASUREMENT Vbx_df_inj3_scw "Diagnosis Injector 3 (symptome)" UBYTE _CNV_S_2_RANGE______3_CM 1 0. 0. 1. ECU_ADDRESS 0xd000478f BIT_MASK 0x1 /end MEASUREMENT
/begin MEASUREMENT Vbx_df_inj4_oc "Diagnosis Injector 4 (symptome)" UBYTE _CNV_S_2_RANGE______3_CM 1 0. 0. 1. ECU_ADDRESS 0xd0004790 BIT_MASK 0x1 /end MEASUREMENT
/begin MEASUREMENT Vbx_df_inj4_scg "Diagnosis Injector 4 (symptome)" UBYTE _CNV_S_2_RANGE______3_CM 1 0. 0. 1. ECU_ADDRESS 0xd0004791 BIT_MASK 0x1 /end MEASUREMENT
/begin MEASUREMENT Vbx_df_inj4_scw "Diagnosis Injector 4 (symptome)" UBYTE _CNV_S_2_RANGE______3_CM 1 0. 0. 1. ECU_ADDRESS 0xd0004792 BIT_MASK 0x1 /end MEASUREMENT
/begin MEASUREMENT Vbx_diag_ena_inj1_oc "Diagnosis Injector 1 (diag condition)" UBYTE _CNV_S_2_RANGE______3_CM 1 0. 0. 1. ECU_ADDRESS 0xd0004793 BIT_MASK 0x1 /end MEASUREMENT
/begin MEASUREMENT Vbx_diag_ena_inj1_scg "Diagnosis Injector 1 (diag condition)" UBYTE _CNV_S_2_RANGE______3_CM 1 0. 0. 1. ECU_ADDRESS 0xd0004794 BIT_MASK 0x1 /end MEASUREMENT
/begin MEASUREMENT Vbx_diag_ena_inj1_scw "Diagnosis Injector 1 (diag condition)" UBYTE _CNV_S_2_RANGE______3_CM 1 0. 0. 1. ECU_ADDRESS 0xd0004795 BIT_MASK 0x1 /end MEASUREMENT
/begin MEASUREMENT Vbx_diag_ena_inj2_oc "Diagnosis Injector 2 (diag condition)" UBYTE _CNV_S_2_RANGE______3_CM 1 0. 0. 1. ECU_ADDRESS 0xd0004796 BIT_MASK 0x1 /end MEASUREMENT
/begin MEASUREMENT Vbx_diag_ena_inj2_scg "Diagnosis Injector 2 (diag condition)" UBYTE _CNV_S_2_RANGE______3_CM 1 0. 0. 1. ECU_ADDRESS 0xd0004797 BIT_MASK 0x1 /end MEASUREMENT
/begin MEASUREMENT Vbx_diag_ena_inj2_scw "Diagnosis Injector 2 (diag condition)" UBYTE _CNV_S_2_RANGE______3_CM 1 0. 0. 1. ECU_ADDRESS 0xd0004798 BIT_MASK 0x1 /end MEASUREMENT
/begin MEASUREMENT Vbx_diag_ena_inj3_oc "Diagnosis Injector 3 (diag condition)" UBYTE _CNV_S_2_RANGE______3_CM 1 0. 0. 1. ECU_ADDRESS 0xd0004799 BIT_MASK 0x1 /end MEASUREMENT
/begin MEASUREMENT Vbx_diag_ena_inj3_scg "Diagnosis Injector 3 (diag condition)" UBYTE _CNV_S_2_RANGE______3_CM 1 0. 0. 1. ECU_ADDRESS 0xd000479a BIT_MASK 0x1 /end MEASUREMENT
/begin MEASUREMENT Vbx_diag_ena_inj3_scw "Diagnosis Injector 3 (diag condition)" UBYTE _CNV_S_2_RANGE______3_CM 1 0. 0. 1. ECU_ADDRESS 0xd000479b BIT_MASK 0x1 /end MEASUREMENT
/begin MEASUREMENT Vbx_diag_ena_inj4_oc "Diagnosis Injector 4 (diag condition)" UBYTE _CNV_S_2_RANGE______3_CM 1 0. 0. 1. ECU_ADDRESS 0xd000479c BIT_MASK 0x1 /end MEASUREMENT
/begin MEASUREMENT Vbx_diag_ena_inj4_scg "Diagnosis Injector 4 (diag condition)" UBYTE _CNV_S_2_RANGE______3_CM 1 0. 0. 1. ECU_ADDRESS 0xd000479d BIT_MASK 0x1 /end MEASUREMENT
/begin MEASUREMENT Vbx_diag_ena_inj4_scw "Diagnosis Injector 4 (diag condition)" UBYTE _CNV_S_2_RANGE______3_CM 1 0. 0. 1. ECU_ADDRESS 0xd000479e BIT_MASK 0x1 /end MEASUREMENT
/begin MEASUREMENT Vbx_inj_open "One (ore more) injector is open." UBYTE _CNV_S_2_RANGE______3_CM 1 0. 0. 1. ECU_ADDRESS 0xd0004786 BIT_MASK 0x1 /end MEASUREMENT
/begin MEASUREMENT cdn_diag_iv[0] "Diagnosis condition for injector [x]" UBYTE _CNV_A_R_ECME_LINEA_0_CM 1 0. 0. 255. ECU_ADDRESS 0xd000477a FORMAT "%3.0" /end MEASUREMENT
/begin MEASUREMENT cdn_diag_iv[1] "Diagnosis condition for injector [x]" UBYTE _CNV_A_R_ECME_LINEA_0_CM 1 0. 0. 255. ECU_ADDRESS 0xd000477b FORMAT "%3.0" /end MEASUREMENT
/begin MEASUREMENT cdn_diag_iv[2] "Diagnosis condition for injector [x]" UBYTE _CNV_A_R_ECME_LINEA_0_CM 1 0. 0. 255. ECU_ADDRESS 0xd000477c FORMAT "%3.0" /end MEASUREMENT
/begin MEASUREMENT cdn_diag_iv[3] "Diagnosis condition for injector [x]" UBYTE _CNV_A_R_ECME_LINEA_0_CM 1 0. 0. 255. ECU_ADDRESS 0xd000477d FORMAT "%3.0" /end MEASUREMENT
/begin MEASUREMENT crk_ctr_tmp "Number of teeth valid to launch the pre-injection" UBYTE _CNV_A_R_ECME_LINEA_0_CM 1 0. 0. 255. ECU_ADDRESS 0xd0005752 FORMAT "%3.0" /end MEASUREMENT
/begin MEASUREMENT crk_inj_ofs_cor_tmp "Temporary offset for progressive shift" UWORD _CNV_A_R_LINEAR_____25_CM 1 0. 0. 720. ECU_ADDRESS 0xd0003cb6 FORMAT "%7.3" /end MEASUREMENT
/begin MEASUREMENT crk_psn_eng_inj_upd "Engine position after injection data update" UWORD _CNV_A_R_LINEAR_____25_CM 1 0. 0. 720. ECU_ADDRESS 0xd00037e0 FORMAT "%7.3" /end MEASUREMENT
/begin MEASUREMENT eoi_1_mes[0] "Actual performed EOI of the first injection pulse, estimated" UWORD _CNV_A_R_LINEAR_____25_CM 1 0. 0. 720. ECU_ADDRESS 0xd00037b8 FORMAT "%7.3" /end MEASUREMENT
/begin MEASUREMENT eoi_1_mes[1] "Actual performed EOI of the first injection pulse, estimated" UWORD _CNV_A_R_LINEAR_____25_CM 1 0. 0. 720. ECU_ADDRESS 0xd00037ba FORMAT "%7.3" /end MEASUREMENT
/begin MEASUREMENT eoi_1_mes[2] "Actual performed EOI of the first injection pulse, estimated" UWORD _CNV_A_R_LINEAR_____25_CM 1 0. 0. 720. ECU_ADDRESS 0xd00037bc FORMAT "%7.3" /end MEASUREMENT
/begin MEASUREMENT eoi_1_mes[3] "Actual performed EOI of the first injection pulse, estimated" UWORD _CNV_A_R_LINEAR_____25_CM 1 0. 0. 720. ECU_ADDRESS 0xd00037be FORMAT "%7.3" /end MEASUREMENT
/begin MEASUREMENT eoi_2_mes[0] "Acual performed EOI of the second injection pulse" UWORD _CNV_A_R_LINEAR_____25_CM 1 0. 0. 720. ECU_ADDRESS 0xd00037c0 FORMAT "%7.3" /end MEASUREMENT
/begin MEASUREMENT eoi_2_mes[1] "Acual performed EOI of the second injection pulse" UWORD _CNV_A_R_LINEAR_____25_CM 1 0. 0. 720. ECU_ADDRESS 0xd00037c2 FORMAT "%7.3" /end MEASUREMENT
/begin MEASUREMENT eoi_2_mes[2] "Acual performed EOI of the second injection pulse" UWORD _CNV_A_R_LINEAR_____25_CM 1 0. 0. 720. ECU_ADDRESS 0xd00037c4 FORMAT "%7.3" /end MEASUREMENT
/begin MEASUREMENT eoi_2_mes[3] "Acual performed EOI of the second injection pulse" UWORD _CNV_A_R_LINEAR_____25_CM 1 0. 0. 720. ECU_ADDRESS 0xd00037c6 FORMAT "%7.3" /end MEASUREMENT
/begin MEASUREMENT err_sym_iv[0] "Error symptom for injector [x] filtered with CDN_DIAG_IV[nC_CYL_NR]" UBYTE _CNV_S_16_RANGE_ERR__151_CM 1 0. 0. 15. ECU_ADDRESS 0xd0004776 /end MEASUREMENT
/begin MEASUREMENT err_sym_iv[1] "Error symptom for injector [x] filtered with CDN_DIAG_IV[nC_CYL_NR]" UBYTE _CNV_S_16_RANGE_ERR__151_CM 1 0. 0. 15. ECU_ADDRESS 0xd0004777 /end MEASUREMENT
/begin MEASUREMENT err_sym_iv[2] "Error symptom for injector [x] filtered with CDN_DIAG_IV[nC_CYL_NR]" UBYTE _CNV_S_16_RANGE_ERR__151_CM 1 0. 0. 15. ECU_ADDRESS 0xd0004778 /end MEASUREMENT
/begin MEASUREMENT err_sym_iv[3] "Error symptom for injector [x] filtered with CDN_DIAG_IV[nC_CYL_NR]" UBYTE _CNV_S_16_RANGE_ERR__151_CM 1 0. 0. 15. ECU_ADDRESS 0xd0004779 /end MEASUREMENT
/begin MEASUREMENT fac_add_pulse "Weighting factor for injection time update at transient conditions (additive pulse)" UBYTE _CNV_A_R_LINEAR_____43_CM 1 0. 0. 1. ECU_ADDRESS 0xd000574b FORMAT "%8.6" /end MEASUREMENT
/begin MEASUREMENT inh_inj_tmp[0] "Temporary flag indicating that injection for cyl x is inhibited" UBYTE _CNV_S_2_RANGE______3_CM 1 0. 0. 1. ECU_ADDRESS 0xd000572a /end MEASUREMENT
/begin MEASUREMENT inh_inj_tmp[1] "Temporary flag indicating that injection for cyl x is inhibited" UBYTE _CNV_S_2_RANGE______3_CM 1 0. 0. 1. ECU_ADDRESS 0xd000572b /end MEASUREMENT
/begin MEASUREMENT inh_inj_tmp[2] "Temporary flag indicating that injection for cyl x is inhibited" UBYTE _CNV_S_2_RANGE______3_CM 1 0. 0. 1. ECU_ADDRESS 0xd000572c /end MEASUREMENT
/begin MEASUREMENT inh_inj_tmp[3] "Temporary flag indicating that injection for cyl x is inhibited" UBYTE _CNV_S_2_RANGE______3_CM 1 0. 0. 1. ECU_ADDRESS 0xd000572d /end MEASUREMENT
/begin MEASUREMENT inj_mod[0] "Cylinder individual injection mode" UBYTE _CNV_S_12_INJECTION__247_CM 1 0. 1. 130. ECU_ADDRESS 0xd000477e /end MEASUREMENT
/begin MEASUREMENT inj_mod[1] "Cylinder individual injection mode" UBYTE _CNV_S_12_INJECTION__247_CM 1 0. 1. 130. ECU_ADDRESS 0xd000477f /end MEASUREMENT
/begin MEASUREMENT inj_mod[2] "Cylinder individual injection mode" UBYTE _CNV_S_12_INJECTION__247_CM 1 0. 1. 130. ECU_ADDRESS 0xd0004780 /end MEASUREMENT
/begin MEASUREMENT inj_mod[3] "Cylinder individual injection mode" UBYTE _CNV_S_12_INJECTION__247_CM 1 0. 1. 130. ECU_ADDRESS 0xd0004781 /end MEASUREMENT
/begin MEASUREMENT inj_mod_global "Global injection mode for all cylinders" UBYTE _CNV_S_12_INJECTION__247_CM 1 0. 1. 130. ECU_ADDRESS 0xd00047a0 /end MEASUREMENT
/begin MEASUREMENT inj_mod_sp[0] "Injection mode set point, cylinder individual" UBYTE _CNV_S_12_INJECTION__247_CM 1 0. 1. 130. ECU_ADDRESS 0xd0004782 /end MEASUREMENT
/begin MEASUREMENT inj_mod_sp[1] "Injection mode set point, cylinder individual" UBYTE _CNV_S_12_INJECTION__247_CM 1 0. 1. 130. ECU_ADDRESS 0xd0004783 /end MEASUREMENT
/begin MEASUREMENT inj_mod_sp[2] "Injection mode set point, cylinder individual" UBYTE _CNV_S_12_INJECTION__247_CM 1 0. 1. 130. ECU_ADDRESS 0xd0004784 /end MEASUREMENT
/begin MEASUREMENT inj_mod_sp[3] "Injection mode set point, cylinder individual" UBYTE _CNV_S_12_INJECTION__247_CM 1 0. 1. 130. ECU_ADDRESS 0xd0004785 /end MEASUREMENT
/begin MEASUREMENT lv_add_pulse_ena "Switch to enable additional injection pulse at homogeneous mode, single injection mode (injection update at transient operation)" UBYTE _CNV_S_2_RANGE______3_CM 1 0. 0. 1. ECU_ADDRESS 0xd000479f /end MEASUREMENT
/begin MEASUREMENT lv_crash_act "Flag to enable or disable injector driver" UBYTE _CNV_S_2_RANGE______3_CM 1 0. 0. 1. ECU_ADDRESS 0xd0005745 BIT_MASK 0x1 /end MEASUREMENT
/begin MEASUREMENT lv_inj_open "At least one injector has been opened since last reset or engine stalling event" UBYTE _CNV_S_2_RANGE______3_CM 1 0. 0. 1. ECU_ADDRESS 0xd0005741 BIT_MASK 0x1 /end MEASUREMENT
/begin MEASUREMENT lv_inj_open_drv_cycle "At least one injector has been opened in the driving cycle" UBYTE _CNV_S_2_RANGE______3_CM 1 0. 0. 1. ECU_ADDRESS 0xd0005744 BIT_MASK 0x1 /end MEASUREMENT
/begin MEASUREMENT lv_inj_upd_ack[0] "Cylinder individual flag, which indicates when a requested injection parameter update during mode switch was fulfilled. Flag switches from 0 to 1." UBYTE _CNV_S_2_RANGE______3_CM 1 0. 0. 1. ECU_ADDRESS 0xd0005726 /end MEASUREMENT
/begin MEASUREMENT lv_inj_upd_ack[1] "Cylinder individual flag, which indicates when a requested injection parameter update during mode switch was fulfilled. Flag switches from 0 to 1." UBYTE _CNV_S_2_RANGE______3_CM 1 0. 0. 1. ECU_ADDRESS 0xd0005727 /end MEASUREMENT
/begin MEASUREMENT lv_inj_upd_ack[2] "Cylinder individual flag, which indicates when a requested injection parameter update during mode switch was fulfilled. Flag switches from 0 to 1." UBYTE _CNV_S_2_RANGE______3_CM 1 0. 0. 1. ECU_ADDRESS 0xd0005728 /end MEASUREMENT
/begin MEASUREMENT lv_inj_upd_ack[3] "Cylinder individual flag, which indicates when a requested injection parameter update during mode switch was fulfilled. Flag switches from 0 to 1." UBYTE _CNV_S_2_RANGE______3_CM 1 0. 0. 1. ECU_ADDRESS 0xd0005729 /end MEASUREMENT
/begin MEASUREMENT lv_state_prev_iv[0] "Cylinder individuel flag which indicates whether last injection was activated or deactivated" UBYTE _CNV_S_2_RANGE______3_CM 1 0. 0. 1. ECU_ADDRESS 0xd0004772 /end MEASUREMENT
/begin MEASUREMENT lv_state_prev_iv[1] "Cylinder individuel flag which indicates whether last injection was activated or deactivated" UBYTE _CNV_S_2_RANGE______3_CM 1 0. 0. 1. ECU_ADDRESS 0xd0004773 /end MEASUREMENT
/begin MEASUREMENT lv_state_prev_iv[2] "Cylinder individuel flag which indicates whether last injection was activated or deactivated" UBYTE _CNV_S_2_RANGE______3_CM 1 0. 0. 1. ECU_ADDRESS 0xd0004774 /end MEASUREMENT
/begin MEASUREMENT lv_state_prev_iv[3] "Cylinder individuel flag which indicates whether last injection was activated or deactivated" UBYTE _CNV_S_2_RANGE______3_CM 1 0. 0. 1. ECU_ADDRESS 0xd0004775 /end MEASUREMENT
/begin MEASUREMENT lv_test_out_eol_fim_shrt "Forces a short ton min for the injector diagnosis (ATIC 39)." UBYTE _CNV_S_2_RANGE______3_CM 1 0. 0. 1. ECU_ADDRESS 0xd0005743 /end MEASUREMENT
/begin MEASUREMENT nr_cyl_first "Number of first cylinder to be injected while going to sequential mode" UBYTE _CNV_A_R_ECME_LINEA_0_CM 1 0. 0. 255. ECU_ADDRESS 0xd0005754 FORMAT "%3.0" /end MEASUREMENT
/begin MEASUREMENT nr_cyl_first_1 "Number of first cylinder to be injected while going to sequential mode" UBYTE _CNV_A_R_ECME_LINEA_0_CM 1 0. 0. 255. ECU_ADDRESS 0xd0005755 FORMAT "%3.0" /end MEASUREMENT
/begin MEASUREMENT nr_cyl_first_2 "Number of first cylinder +2 (in fireing order) to be injected while going to sequential mode" UBYTE _CNV_A_R_ECME_LINEA_0_CM 1 0. 0. 255. ECU_ADDRESS 0xd0005756 FORMAT "%3.0" /end MEASUREMENT
/begin MEASUREMENT nr_cyl_first_3 "Number of first  cylinder +3 (in fireing order) to be injected while going to sequential mode" UBYTE _CNV_A_R_ECME_LINEA_0_CM 1 0. 0. 255. ECU_ADDRESS 0xd0005757 FORMAT "%3.0" /end MEASUREMENT
/begin MEASUREMENT nr_trig_eoi_lim_av "Indication of the actual number of TRIG_EOI_LIM[x]" UBYTE _CNV_A_R_ECME_LINEA_0_CM 1 0. 0. 7. ECU_ADDRESS 0xd0005746 FORMAT "%1.0" /end MEASUREMENT
/begin MEASUREMENT nr_trig_eoi_lim_prev "Indication of the previous number of TRIG_EOI_LIM[x]" UBYTE _CNV_A_R_ECME_LINEA_0_CM 1 0. 0. 7. ECU_ADDRESS 0xd0005747 FORMAT "%1.0" /end MEASUREMENT
/begin MEASUREMENT prev_state_iv "Status word disable injectors" UBYTE _CNV_A_R_ECME_LINEA_0_CM 1 0. 0. 255. ECU_ADDRESS 0xd00047a1 FORMAT "%3.0" /end MEASUREMENT
/begin MEASUREMENT psn_dif_eng_syn "Difference of the min and max estimated engine position in the mon syn. phase" UWORD _CNV_A_R_LINEAR_____25_CM 1 0. 0. 720. ECU_ADDRESS 0xd00037e6 FORMAT "%7.3" /end MEASUREMENT
/begin MEASUREMENT psn_dif_eng_syn_thd "Difference of the min and max estimated engine position in the mon syn. phase to trigger a preinjection " UWORD _CNV_A_R_LINEAR_____25_CM 1 0. 0. 720. ECU_ADDRESS 0xd00037e8 FORMAT "%7.3" /end MEASUREMENT
/begin MEASUREMENT soi_1_mes[0] "Actual performed SOI of the first injection pulse, estimated" UWORD _CNV_A_R_LINEAR_____25_CM 1 0. 0. 720. ECU_ADDRESS 0xd00037a8 FORMAT "%7.3" /end MEASUREMENT
/begin MEASUREMENT soi_1_mes[1] "Actual performed SOI of the first injection pulse, estimated" UWORD _CNV_A_R_LINEAR_____25_CM 1 0. 0. 720. ECU_ADDRESS 0xd00037aa FORMAT "%7.3" /end MEASUREMENT
/begin MEASUREMENT soi_1_mes[2] "Actual performed SOI of the first injection pulse, estimated" UWORD _CNV_A_R_LINEAR_____25_CM 1 0. 0. 720. ECU_ADDRESS 0xd00037ac FORMAT "%7.3" /end MEASUREMENT
/begin MEASUREMENT soi_1_mes[3] "Actual performed SOI of the first injection pulse, estimated" UWORD _CNV_A_R_LINEAR_____25_CM 1 0. 0. 720. ECU_ADDRESS 0xd00037ae FORMAT "%7.3" /end MEASUREMENT
/begin MEASUREMENT soi_2_mes[0] "Actual performed SOI of the second injection pulse, estimated" UWORD _CNV_A_R_LINEAR_____25_CM 1 0. 0. 720. ECU_ADDRESS 0xd00037b0 FORMAT "%7.3" /end MEASUREMENT
/begin MEASUREMENT soi_2_mes[1] "Actual performed SOI of the second injection pulse, estimated" UWORD _CNV_A_R_LINEAR_____25_CM 1 0. 0. 720. ECU_ADDRESS 0xd00037b2 FORMAT "%7.3" /end MEASUREMENT
/begin MEASUREMENT soi_2_mes[2] "Actual performed SOI of the second injection pulse, estimated" UWORD _CNV_A_R_LINEAR_____25_CM 1 0. 0. 720. ECU_ADDRESS 0xd00037b4 FORMAT "%7.3" /end MEASUREMENT
/begin MEASUREMENT soi_2_mes[3] "Actual performed SOI of the second injection pulse, estimated" UWORD _CNV_A_R_LINEAR_____25_CM 1 0. 0. 720. ECU_ADDRESS 0xd00037b6 FORMAT "%7.3" /end MEASUREMENT
/begin MEASUREMENT state_inj_mod_req "injection mode request for all cylinders for requested combustion mode" UBYTE _CNV_S_12_INJECTION__247_CM 1 0. 1. 130. ECU_ADDRESS 0xd00047a3 /end MEASUREMENT
/begin MEASUREMENT state_inj_upd_mod_cyl_ack "Feedback from IO-software of successful data transfer" UBYTE _CNV_A_R_ECME_LINEA_0_CM 1 0. 0. 255. ECU_ADDRESS 0xd00047a2 FORMAT "%3.0" /end MEASUREMENT
/begin MEASUREMENT state_sfg_upd "Feedback from IO-software of successful data transfer during semi full group begin." UBYTE _CNV_A_R_ECME_LINEA_0_CM 1 0. 0. 255. ECU_ADDRESS 0xd0005758 FORMAT "%3.0" /end MEASUREMENT
/begin MEASUREMENT state_st_pre "state for start pre injection" UBYTE _CNV_A_R_ECME_LINEA_0_CM 1 0. 0. 255. ECU_ADDRESS 0xd00047a4 FORMAT "%3.0" /end MEASUREMENT
/begin MEASUREMENT ti_1_mes[0] "Actual performed cylinder individual injection time, second pulse or additional pulse" UWORD _CNV_A_R_LINEAR_____44_CM 1 0. 0. 262.14 ECU_ADDRESS 0xd00037c8 FORMAT "%7.3" /end MEASUREMENT
/begin MEASUREMENT ti_1_mes[1] "Actual performed cylinder individual injection time, second pulse or additional pulse" UWORD _CNV_A_R_LINEAR_____44_CM 1 0. 0. 262.14 ECU_ADDRESS 0xd00037ca FORMAT "%7.3" /end MEASUREMENT
/begin MEASUREMENT ti_1_mes[2] "Actual performed cylinder individual injection time, second pulse or additional pulse" UWORD _CNV_A_R_LINEAR_____44_CM 1 0. 0. 262.14 ECU_ADDRESS 0xd00037cc FORMAT "%7.3" /end MEASUREMENT
/begin MEASUREMENT ti_1_mes[3] "Actual performed cylinder individual injection time, second pulse or additional pulse" UWORD _CNV_A_R_LINEAR_____44_CM 1 0. 0. 262.14 ECU_ADDRESS 0xd00037ce FORMAT "%7.3" /end MEASUREMENT
/begin MEASUREMENT ti_2_mes[0] "Actual performed cylinder individual injection time, second pulse or additional pulse" UWORD _CNV_A_R_LINEAR_____44_CM 1 0. 0. 262.14 ECU_ADDRESS 0xd00037d0 FORMAT "%7.3" /end MEASUREMENT
/begin MEASUREMENT ti_2_mes[1] "Actual performed cylinder individual injection time, second pulse or additional pulse" UWORD _CNV_A_R_LINEAR_____44_CM 1 0. 0. 262.14 ECU_ADDRESS 0xd00037d2 FORMAT "%7.3" /end MEASUREMENT
/begin MEASUREMENT ti_2_mes[2] "Actual performed cylinder individual injection time, second pulse or additional pulse" UWORD _CNV_A_R_LINEAR_____44_CM 1 0. 0. 262.14 ECU_ADDRESS 0xd00037d4 FORMAT "%7.3" /end MEASUREMENT
/begin MEASUREMENT ti_2_mes[3] "Actual performed cylinder individual injection time, second pulse or additional pulse" UWORD _CNV_A_R_LINEAR_____44_CM 1 0. 0. 262.14 ECU_ADDRESS 0xd00037d6 FORMAT "%7.3" /end MEASUREMENT
/begin MEASUREMENT ti_add_dly "Injector dead time correction, homogeneous mode 1. pulse" SWORD _CNV_A_R_LINEAR_____44_CM 1 0. -131.072 131.068 ECU_ADDRESS 0xd00037e2 FORMAT "%8.3" /end MEASUREMENT
/begin MEASUREMENT ti_add_pulse_min "Minimum injection time for additive injection pulse" UWORD _CNV_A_R_LINEAR_____44_CM 1 0. 0. 262.14 ECU_ADDRESS 0xd0003cb8 FORMAT "%7.3" /end MEASUREMENT
/begin MEASUREMENT timer_pre_inj_fg "Temporary counter for FG pre injection" SWORD _CNV_A_R_ECME_LINEA_0_CM 1 0. -32768. 32767. ECU_ADDRESS 0xd00037e4 FORMAT "%6.0" /end MEASUREMENT
/begin CHARACTERISTIC c_cdn_diag_iv "Diagnosis recurrence function engine speed" VALUE 0xa00211c7 _REC_S1VAL_20_u1 8160. _CNV_A_R_LINEAR_____2_CM 0. 8160. FORMAT "%4.0" /end CHARACTERISTIC
/begin CHARACTERISTIC c_n_low_ena_pre_thd "The pre injection will be switched off if this engine speed threshold is exceeded" VALUE 0xa002116a _REC_S1VAL_20_u2 8160. _CNV_A_R_LINEAR_____21_CM 0. 8160. FORMAT "%4.0" /end CHARACTERISTIC
/begin CHARACTERISTIC c_preinj_mode "Configuration of pre injection" VALUE 0xa00211d7 _REC_S1VAL_20_u1 255. _CNV_S_3_PRE_INJECT_248_R_CM 0. 255. /end CHARACTERISTIC
/begin CHARACTERISTIC c_rec_diag_iv "Diagnosis recurrence" VALUE 0xa00211d8 _REC_S1VAL_20_u1 2800. _CNV_A_R_LINEAR_____249_CM 200. 3000. FORMAT "%4.0" /end CHARACTERISTIC
/begin CHARACTERISTIC c_ti_eol "Time injection pulse for End Of Line test" VALUE 0xa002116e _REC_S1VAL_20_u2 262.14 _CNV_A_R_LINEAR_____44_CM 0. 262.14 FORMAT "%7.3" /end CHARACTERISTIC
/begin CHARACTERISTIC lc_add_pulse_ena "Logical constant for enabling additional pulses in case of injection time update at transient conditions, homogeneous mode" VALUE 0xa00211e4 _REC_S1VAL_20_u1 1. _CNV_S_2_RANGE______3_CM 0. 1. /end CHARACTERISTIC
/begin CHARACTERISTIC lc_state_inj_cus_seq "Calibration stub for transition beteween semi-full group and sequential during start phase" VALUE 0xa00211e8 _REC_S1VAL_20_u1 1. _CNV_S_2_RANGE______3_CM 0. 1. /end CHARACTERISTIC
/begin MEASUREMENT Vbx_sens_brk_pdl_open "(=1) Brake pedal pressed : information given by the opening brake signal." UBYTE _CNV_S_2_RANGE______3_CM 1 0. 0. 1. ECU_ADDRESS 0xd0004415 BIT_MASK 0x1 /end MEASUREMENT
/begin MEASUREMENT Vbx_sfty_sens_brk_pdl_open "Copy for safety monitoring of the information given by the opening brake signal ([=1] Brake pedal pressed)" UBYTE _CNV_S_2_RANGE______3_CM 1 0. 0. 1. ECU_ADDRESS 0xd0005d84 BIT_MASK 0x1 /end MEASUREMENT
/begin MEASUREMENT lv_bls "Flag for brake active (1=active; 0=inactive)." UBYTE _CNV_S_2_RANGE______3_CM 1 0. 0. 1. ECU_ADDRESS 0xd00043ce /end MEASUREMENT
/begin MEASUREMENT lv_bls_mon "Flag for safety brake active (1=active; 0=inactive)." UBYTE _CNV_S_2_RANGE______3_CM 1 0. 0. 1. ECU_ADDRESS 0xd0005b8a BIT_MASK 0x1 /end MEASUREMENT
/begin MEASUREMENT lv_bts "Flag for brake test switch (1=brake active; 0=brake inactive)." UBYTE _CNV_S_2_RANGE______3_CM 1 0. 0. 1. ECU_ADDRESS 0xd00043cf /end MEASUREMENT
/begin MEASUREMENT lv_bts_mon "Flag for safety brake test switch (1=brake active; 0=brake inactive)." UBYTE _CNV_S_2_RANGE______3_CM 1 0. 0. 1. ECU_ADDRESS 0xd0005b89 BIT_MASK 0x1 /end MEASUREMENT
/begin MEASUREMENT lv_clu_swi "Boolean for clutch switch detection." UBYTE _CNV_S_2_RANGE______3_CM 1 0. 0. 1. ECU_ADDRESS 0xd00043cd /end MEASUREMENT
/begin MEASUREMENT Vbx_raw_sens_bgin_clu_cnt "State of the begin of teh clutch pedal (0 = pedal released, 1 = pedal pressed)" UBYTE _CNV_S_2_RANGE______3_CM 1 0. 0. 1. ECU_ADDRESS 0xd000483d BIT_MASK 0x1 /end MEASUREMENT
/begin AXIS_PTS Ctb_ajs_driv_tq_drv "Breakpoint calibration of derivated driver torque" 0xa002939c Vxx_ajs_driv_tq_drv _REC_A2AXS_20_u2 10000. _CNV_A_R_LINEAR_____250_CM 7 -5000. 5000. FORMAT "%5.0" /end AXIS_PTS
/begin AXIS_PTS Ctb_ajs_gear_rat "Breakpoint calibration of \"vehicle_speed / rotary_engine_speed\" ratio" 0xa00293ac Vxx_ajs_gear_rat_n _REC_A2AXS_20_u2 210. _CNV_A_R_LINEAR_____251_CM 8 -10. 200. FORMAT "%6.2" /end AXIS_PTS
/begin AXIS_PTS Ctb_ajs_spv_drag_tq_fac "Breakpoint calibration of normalized driver torque factor for drag error correction." 0xa0021208 Vxx_ajs_spv_driv_tq_fac _REC_A2AXS_20_u1 1. _CNV_A_R_LINEAR_____136_CM 7 0. 1. FORMAT "%4.2" /end AXIS_PTS
/begin AXIS_PTS Ctb_ajs_spv_n "Breakpoint calibration of engine speed in AJSPV function" 0xa00293c0 Vxx_n_mv _REC_A2AXS_20_u2 16383.75 _CNV_A_R_ENSD_LINEA_24_CM 7 0. 16383.75 FORMAT "%8.2" /end AXIS_PTS
/begin AXIS_PTS Ctb_ajs_spv_tq_fac "Breakpoint calibration of normalized driver torque factor" 0xa0021210 Vxx_ajs_spv_driv_tq_fac _REC_A2AXS_20_u1 1. _CNV_A_R_LINEAR_____136_CM 7 0. 1. FORMAT "%4.2" /end AXIS_PTS
/begin CHARACTERISTIC Cmp_ajs_spv_fast_cor_dly "Cartography to select the maximum time for the application of the boost of the curative anti-jerk function." MAP 0xa00293d0 _REC_A1MAP_20_u2_u2_u1 655.35 _CNV_A_R_LINEAR_____34_CM 0. 655.35 FORMAT "%6.2"
 /begin AXIS_DESCR COM_AXIS Vxx_n_mv _CNV_A_R_ENSD_LINEA_24_CM 7 0. 16383.75 FORMAT "%8.2" AXIS_PTS_REF Ctb_ajs_spv_n /end AXIS_DESCR
 /begin AXIS_DESCR COM_AXIS Vxx_ajs_spv_driv_tq_fac _CNV_A_R_LINEAR_____136_CM 7 0. 1. FORMAT "%4.2" AXIS_PTS_REF Ctb_ajs_spv_tq_fac /end AXIS_DESCR
/end CHARACTERISTIC
/begin CHARACTERISTIC Ctp_ajs_coup_grip_rat "Cartography that converts transmission coupler state into coupler torque grip ratio" CURVE 0xa0021218 _REC_A1CUR_20_u1_u1 1. _CNV_A_R_LINEAR_____252_CM 0. 1. FORMAT "%3.1"
 /begin AXIS_DESCR COM_AXIS Vxx_ant_coup _CNV_A_R_ECME_LINEA_0_CM 3 0. 255. FORMAT "%3.0" AXIS_PTS_REF Ctb_coup /end AXIS_DESCR
/end CHARACTERISTIC
/begin CHARACTERISTIC Ctp_ajs_drag_acel_tq_diff_thd "Torque threshold to activate the drag error correction during acceleration." CURVE 0xa0029434 _REC_A1CUR_20_u2_u1 2047.96875 _CNV_A_R_LINEAR_____161_CM -400. 1647.96875 FORMAT "%11.5"
 /begin AXIS_DESCR COM_AXIS Vxx_ajs_spv_driv_tq_fac _CNV_A_R_LINEAR_____136_CM 7 0. 1. FORMAT "%4.2" AXIS_PTS_REF Ctb_ajs_spv_drag_tq_fac /end AXIS_DESCR
/end CHARACTERISTIC
/begin CHARACTERISTIC Ctp_ajs_drag_decl_tq_diff_thd "Torque threshold to activate the drag error correction during deceleration." CURVE 0xa0029444 _REC_A1CUR_20_u2_u1 2047.96875 _CNV_A_R_LINEAR_____161_CM -400. 1647.96875 FORMAT "%11.5"
 /begin AXIS_DESCR COM_AXIS Vxx_ajs_spv_driv_tq_fac _CNV_A_R_LINEAR_____136_CM 7 0. 1. FORMAT "%4.2" AXIS_PTS_REF Ctb_ajs_spv_drag_tq_fac /end AXIS_DESCR
/end CHARACTERISTIC
/begin CHARACTERISTIC Ctp_ajs_dt_gear_tq_rat "Cartography that converts \"vehicle_speed / rotary_engine_speed\" ratio into driveline torque ratio" CURVE 0xa0029454 _REC_A1CUR_20_u2_u2 210. _CNV_A_R_LINEAR_____251_CM -10. 200. FORMAT "%6.2"
 /begin AXIS_DESCR COM_AXIS Vxx_ajs_gear_rat_n _CNV_A_R_LINEAR_____251_CM 8 -10. 200. FORMAT "%6.2" AXIS_PTS_REF Ctb_ajs_gear_rat /end AXIS_DESCR
/end CHARACTERISTIC
/begin CHARACTERISTIC Ctp_ajs_gear_rat "Cartography that converts gear into vehicle_speed/rotary_engine_speed ratio for manual transmissions" CURVE 0xa0029464 _REC_A1CUR_20_u2_u1 210. _CNV_A_R_LINEAR_____251_CM -10. 200. FORMAT "%6.2"
 /begin AXIS_DESCR COM_AXIS Vxx_gear _CNV_A_R_LINEAR_____113_CM 8 -1. 6. READ_ONLY FORMAT "%2.0" AXIS_PTS_REF Ntb_gear /end AXIS_DESCR
/end CHARACTERISTIC
/begin CHARACTERISTIC Ctp_ajs_slk_tqe_off_acel "Torque high threshold to deactivate the slack effect for vehicle acceleration" CURVE 0xa0029474 _REC_A1CUR_20_u2_u2 2047.96875 _CNV_A_R_LINEAR_____161_CM -400. 1647.96875 FORMAT "%11.5"
 /begin AXIS_DESCR COM_AXIS Vxx_ajs_dt_tq_rat _CNV_A_R_LINEAR_____251_CM 8 -10. 200. FORMAT "%6.2" AXIS_PTS_REF Ctb_ajs_dt_tq_rat /end AXIS_DESCR
/end CHARACTERISTIC
/begin CHARACTERISTIC Ctp_ajs_slk_tqe_off_decl "Torque high threshold to deactivate the slack effect for vehicle deceleration" CURVE 0xa0029484 _REC_A1CUR_20_u2_u2 2047.96875 _CNV_A_R_LINEAR_____161_CM -400. 1647.96875 FORMAT "%11.5"
 /begin AXIS_DESCR COM_AXIS Vxx_ajs_dt_tq_rat _CNV_A_R_LINEAR_____251_CM 8 -10. 200. FORMAT "%6.2" AXIS_PTS_REF Ctb_ajs_dt_tq_rat /end AXIS_DESCR
/end CHARACTERISTIC
/begin CHARACTERISTIC Ctp_ajs_slk_tqe_on_acel "Torque low threshold to deactivate the slack effect for vehicle acceleration" CURVE 0xa0029494 _REC_A1CUR_20_u2_u2 2047.96875 _CNV_A_R_LINEAR_____161_CM -400. 1647.96875 FORMAT "%11.5"
 /begin AXIS_DESCR COM_AXIS Vxx_ajs_dt_tq_rat _CNV_A_R_LINEAR_____251_CM 8 -10. 200. FORMAT "%6.2" AXIS_PTS_REF Ctb_ajs_dt_tq_rat /end AXIS_DESCR
/end CHARACTERISTIC
/begin CHARACTERISTIC Ctp_ajs_slk_tqe_on_decl "Torque low threshold to deactivate the slack effect for vehicle deceleration" CURVE 0xa00294a4 _REC_A1CUR_20_u2_u2 2047.96875 _CNV_A_R_LINEAR_____161_CM -400. 1647.96875 FORMAT "%11.5"
 /begin AXIS_DESCR COM_AXIS Vxx_ajs_dt_tq_rat _CNV_A_R_LINEAR_____251_CM 8 -10. 200. FORMAT "%6.2" AXIS_PTS_REF Ctb_ajs_dt_tq_rat /end AXIS_DESCR
/end CHARACTERISTIC
/begin CHARACTERISTIC Ctp_ajs_spv_driv_tq_drv "Cartography that converts the derivated driver torque into unit ratio [-1 ; 1]" CURVE 0xa002121c _REC_A1CUR_20_u1_u2 2. _CNV_A_R_LINEAR_____253_CM -1. 1. FORMAT "%4.2"
 /begin AXIS_DESCR COM_AXIS Vxx_ajs_driv_tq_drv _CNV_A_R_LINEAR_____250_CM 7 -5000. 5000. FORMAT "%5.0" AXIS_PTS_REF Ctb_ajs_driv_tq_drv /end AXIS_DESCR
/end CHARACTERISTIC
/begin CHARACTERISTIC Ctp_ajs_spv_fast_cor_dly_fac "Table for the modulation of the maximum time to enable the boost of the curative anti-jerk function." CURVE 0xa00294b4 _REC_A1CUR_20_u2_u2 100. _CNV_A_R_LINEAR_____136_CM 0. 100.
 /begin AXIS_DESCR COM_AXIS Vxx_ajs_dt_tq_rat _CNV_A_R_LINEAR_____251_CM 8 -10. 200. FORMAT "%6.2" AXIS_PTS_REF Ctb_ajs_dt_tq_rat /end AXIS_DESCR
/end CHARACTERISTIC
/begin MEASUREMENT Vbx_ajs_acel_decl_stt "Acceleration (1) or deceleration (0) vehicle state" UBYTE _CNV_S_2_RANGE______3_CM 1 0. 0. 1. ECU_ADDRESS 0xd0004163 BIT_MASK 0x1 /end MEASUREMENT
/begin MEASUREMENT Vbx_ajs_cut_cdn_on "Boolean to enable the observation of driver demand condtions to enable the boost of the curative anti-jerk function." UBYTE _CNV_S_2_RANGE______3_CM 1 0. 0. 1. ECU_ADDRESS 0xd0004164 BIT_MASK 0x1 /end MEASUREMENT
/begin MEASUREMENT Vbx_ajs_fast_cor_on "Boolean to activate the boost of the curative anti-jerk function." UBYTE _CNV_S_2_RANGE______3_CM 1 0. 0. 1. ECU_ADDRESS 0xd0004165 BIT_MASK 0x1 /end MEASUREMENT
/begin MEASUREMENT Vbx_ajs_no_drag "Boolean variable activating the drag error correction" UBYTE _CNV_S_2_RANGE______3_CM 1 0. 0. 1. ECU_ADDRESS 0xd0004166 BIT_MASK 0x1 /end MEASUREMENT
/begin MEASUREMENT Vbx_ajs_pdl_cdn_on "Boolean to activate the boost of the curative anti-jerk function based on the driver pedal observation." UBYTE _CNV_S_2_RANGE______3_CM 1 0. 0. 1. ECU_ADDRESS 0xd0004167 BIT_MASK 0x1 /end MEASUREMENT
/begin MEASUREMENT Vbx_ajs_slk_decl_off "Boolean variable to detect crossing slack torque low threshold during vehicle deceleration" UBYTE _CNV_S_2_RANGE______3_CM 1 0. 0. 1. ECU_ADDRESS 0xd0004168 BIT_MASK 0x1 /end MEASUREMENT
/begin MEASUREMENT Vbx_ajs_slk_decl_on "Boolean variable to detect crossing slack torque high threshold during vehicle deceleration" UBYTE _CNV_S_2_RANGE______3_CM 1 0. 0. 1. ECU_ADDRESS 0xd0004169 BIT_MASK 0x1 /end MEASUREMENT
/begin MEASUREMENT Vbx_ajs_slk_on "Boolean variable activating the slack effect" UBYTE _CNV_S_2_RANGE______3_CM 1 0. 0. 1. ECU_ADDRESS 0xd000416a BIT_MASK 0x1 /end MEASUREMENT
/begin MEASUREMENT Vbx_ajs_slk_on_prev "Previous value of the boolean variable activating the slack effect" UBYTE _CNV_S_2_RANGE______3_CM 1 0. 0. 1. ECU_ADDRESS 0xd000416b BIT_MASK 0x1 /end MEASUREMENT
/begin MEASUREMENT Vbx_ajs_slk_tqe_decl_out "Boolean variable detecting the end of the slack effect correction during vehicle deceleration" UBYTE _CNV_S_2_RANGE______3_CM 1 0. 0. 1. ECU_ADDRESS 0xd000416c BIT_MASK 0x1 /end MEASUREMENT
/begin MEASUREMENT Vbx_ajs_spv_stt_cut "Preventive and curative anti-jerk functions are deactivated" UBYTE _CNV_S_2_RANGE______3_CM 1 0. 0. 1. ECU_ADDRESS 0xd000416d BIT_MASK 0x1 /end MEASUREMENT
/begin MEASUREMENT Vbx_ajs_tq_cdn_on "Boolean to enable the boost of the curative anti-jerk function based on the driver torque observation." UBYTE _CNV_S_2_RANGE______3_CM 1 0. 0. 1. ECU_ADDRESS 0xd000416e BIT_MASK 0x1 /end MEASUREMENT
/begin MEASUREMENT Vbx_vs_n_rat_fil_on "Filtered value of Vehicle Speed/Neng ratio is used (1) to calculate the gear ratio" UBYTE _CNV_S_2_RANGE______3_CM 1 0. 0. 1. ECU_ADDRESS 0xd000416f BIT_MASK 0x1 /end MEASUREMENT
/begin MEASUREMENT Vsx_ajs_dt_tq_rat_vld "Gear torque ratio : wheel_torque/engine_torque (tuned with gear ratio) validity status" UBYTE _CNV_S_3_STATUS_OK__120_CM 1 0. 0. 2. ECU_ADDRESS 0xd0004170 /end MEASUREMENT
/begin MEASUREMENT Vsx_ajs_spv_stt_para "State variable to select anti-jerk parameters" UBYTE _CNV_A_R_ECME_LINEA_0_CM 1 0. 1. 5. ECU_ADDRESS 0xd0004171 FORMAT "%1.0" /end MEASUREMENT
/begin MEASUREMENT Vxx_ajs_coup_grip_rat "Coupler grip ratio (tuned with coupler state)" UBYTE _CNV_A_R_LINEAR_____252_CM 1 0. 0. 1. ECU_ADDRESS 0xd0004172 FORMAT "%3.1" /end MEASUREMENT
/begin MEASUREMENT Vxx_ajs_driv_pwt_sp_grd "Driver powertrain setpoint derivative used in the anti-jerk strategy" UWORD _CNV_A_R_LINEAR_____254_CM 1 0. 0. 100. ECU_ADDRESS 0xd0002ee4 FORMAT "%8.3" /end MEASUREMENT
/begin MEASUREMENT Vxx_ajs_driv_tq_drv "Derivative of the driver torque demand" UWORD _CNV_A_R_LINEAR_____250_CM 1 0. -5000. 5000. ECU_ADDRESS 0xd0002ee6 FORMAT "%5.0" /end MEASUREMENT
/begin MEASUREMENT Vxx_ajs_dt_grip_rat "Driveline grip ratio (integrates coupler grip ratio and calculated declutch state)" UBYTE _CNV_A_R_LINEAR_____255_CM 1 0. 0. 1. ECU_ADDRESS 0xd0004173 FORMAT "%4.2" /end MEASUREMENT
/begin MEASUREMENT Vxx_ajs_dt_tq_rat "Driveline torque ratio : wheel_torque/engine_torque" UWORD _CNV_A_R_LINEAR_____251_CM 1 0. -10. 200. ECU_ADDRESS 0xd0002ee8 FORMAT "%6.2" /end MEASUREMENT
/begin MEASUREMENT Vxx_ajs_gear_rat_n "Gear rotary speed ratio : wheel_speed/engine_speed (tuned with gear state)" UWORD _CNV_A_R_LINEAR_____251_CM 1 0. -10. 200. ECU_ADDRESS 0xd0002eea FORMAT "%6.2" /end MEASUREMENT
/begin MEASUREMENT Vxx_ajs_slk_tqe_sp "Effective engine torque selected for the slack effect activation" UWORD _CNV_A_R_LINEAR_____161_CM 1 0. -400. 1647.96875 ECU_ADDRESS 0xd0002eec FORMAT "%10.5" /end MEASUREMENT
/begin MEASUREMENT Vxx_ajs_spd_diff "Difference between engine speed and primary shaft speed." SWORD _CNV_A_R_ENSD_LINEA_24_CM 1 0. -8192. 8191.75 ECU_ADDRESS 0xd0002eee FORMAT "%6.2" /end MEASUREMENT
/begin MEASUREMENT Vxx_ajs_spv_driv_tq_drv "Formated derivative of driver torque demand" UBYTE _CNV_A_R_LINEAR_____136_CM 1 0. 0. 1. ECU_ADDRESS 0xd0004174 FORMAT "%4.2" /end MEASUREMENT
/begin MEASUREMENT Vxx_ajs_spv_driv_tq_fac "Normalized driver torque factor" UBYTE _CNV_A_R_LINEAR_____136_CM 1 0. 0. 1. ECU_ADDRESS 0xd0004175 FORMAT "%4.2" /end MEASUREMENT
/begin MEASUREMENT Vxx_ajs_spv_driv_tq_rat "Torque ratio between the driver demand and the available torque" SBYTE _CNV_A_R_LINEAR_____256_CM 1 0. -1. 1. ECU_ADDRESS 0xd0004176 FORMAT "%8.5" /end MEASUREMENT
/begin MEASUREMENT Vxx_ajs_spv_fast_cor_dly "Maximum time for the application of the boost of the curative anti-jerk" UWORD _CNV_A_R_LINEAR_____34_CM 1 0. 0. 655.35 ECU_ADDRESS 0xd0002ef0 FORMAT "%6.2" /end MEASUREMENT
/begin CHARACTERISTIC Cbx_ajs_dt_open_slk_cfm "Boolean calibration to allow (=1) slack effect strategy with an open drivetrain (AJSPV 3 & 4 states)." VALUE 0xa0021244 _REC_S1VAL_20_u1 1. _CNV_A_R_ECME_LINEA_0_CM 0. 1. FORMAT "%1.0" BIT_MASK 0x1 /end CHARACTERISTIC
/begin CHARACTERISTIC Cbx_ajs_fast_cor_cfm "Boolean calibration to deactivate (=0) the boost of the curative anti-jerk function." VALUE 0xa0021245 _REC_S1VAL_20_u1 1. _CNV_A_R_ECME_LINEA_0_CM 0. 1. FORMAT "%1.0" BIT_MASK 0x1 /end CHARACTERISTIC
/begin CHARACTERISTIC Cbx_ajs_no_drag_cfm "Boolean calibration to deactivate (=0) the strategy for drag error correction." VALUE 0xa0021246 _REC_S1VAL_20_u1 1. _CNV_A_R_ECME_LINEA_0_CM 0. 1. FORMAT "%1.0" BIT_MASK 0x1 /end CHARACTERISTIC
/begin CHARACTERISTIC Cbx_ajs_spv_cut_cfm "Boolean calibration to select the tip-in condition in the case of a re-injection (=1) to enable the boost of the curative anti-jerk function." VALUE 0xa0021247 _REC_S1VAL_20_u1 1. _CNV_A_R_ECME_LINEA_0_CM 0. 1. FORMAT "%1.0" BIT_MASK 0x1 /end CHARACTERISTIC
/begin CHARACTERISTIC Cbx_ajs_spv_grd_cfm "Boolean calibration to select the driver conditions (=1 based on torque observation, = 0 based on pedal observation) to enable the boost of the curative anti-jerk function." VALUE 0xa0021248 _REC_S1VAL_20_u1 1. _CNV_A_R_ECME_LINEA_0_CM 0. 1. FORMAT "%1.0" BIT_MASK 0x1 /end CHARACTERISTIC
/begin CHARACTERISTIC Cbx_ajs_spv_stt_cfm "Boolean calibration to deactivate (=0) preventive et curative anti-jerk functions" VALUE 0xa0021249 _REC_S1VAL_20_u1 1. _CNV_A_R_ECME_LINEA_0_CM 0. 1. FORMAT "%1.0" BIT_MASK 0x1 /end CHARACTERISTIC
/begin CHARACTERISTIC Cbx_ajs_tqe_slk_cfm "Boolean calibration to select the torque observed (=1 to select an estimation of the engine torque, =0 the filtered torque setpoint) to activate the slack-effect strategy." VALUE 0xa002124a _REC_S1VAL_20_u1 1. _CNV_A_R_ECME_LINEA_0_CM 0. 1. FORMAT "%1.0" BIT_MASK 0x1 /end CHARACTERISTIC
/begin CHARACTERISTIC Cbx_dt_tq_rat_grip_cfm "Boolean calibration permits to choose the driveline torque ratio calculation" VALUE 0xa002124b _REC_S1VAL_20_u1 1. _CNV_A_R_ECME_LINEA_0_CM 0. 1. FORMAT "%1.0" BIT_MASK 0x1 /end CHARACTERISTIC
/begin CHARACTERISTIC Csx_spv_tq_rat_drv_cfm "Boolean calibration to choose the driver torque factor calculation" VALUE 0xa002124c _REC_S1VAL_20_u1 2. _CNV_A_R_ECME_LINEA_0_CM 0. 2. FORMAT "%1.0" /end CHARACTERISTIC
/begin CHARACTERISTIC Cxx_ajs_acel_tq_thd "Torque variation threshold to consider the engine in acceleration state" VALUE 0xa0021224 _REC_S1VAL_20_u2 2047.96875 _CNV_A_R_LINEAR_____161_CM -400. 1647.96875 FORMAT "%11.5" /end CHARACTERISTIC
/begin CHARACTERISTIC Cxx_ajs_decl_tq_thd "Torque variation threshold to consider the engine in deceleration state" VALUE 0xa0021226 _REC_S1VAL_20_u2 2047.96875 _CNV_A_R_LINEAR_____161_CM -400. 1647.96875 FORMAT "%11.5" /end CHARACTERISTIC
/begin CHARACTERISTIC Cxx_ajs_drag_pwt_sp_thd "Threshold for powertrain setpoint to enable the drag error correction." VALUE 0xa0021228 _REC_S1VAL_20_u2 1. _CNV_A_R_LINEAR_____257_CM 0. 1. FORMAT "%8.5" /end CHARACTERISTIC
/begin CHARACTERISTIC Cxx_ajs_drag_tq_drv_hys "Hysteresis for driver torque derivative threshold to disable the drag error correction." VALUE 0xa002124d _REC_S1VAL_20_u1 1. _CNV_A_R_LINEAR_____136_CM 0. 1. FORMAT "%4.2" /end CHARACTERISTIC
/begin CHARACTERISTIC Cxx_ajs_drag_tq_drv_thd "Threshold for driver torque derivative to disable the drag error correction." VALUE 0xa002124e _REC_S1VAL_20_u1 1. _CNV_A_R_LINEAR_____136_CM 0. 1. FORMAT "%4.2" /end CHARACTERISTIC
/begin CHARACTERISTIC Cxx_ajs_driv_pwt_sp_fil "Filter time constant for filtering of the driver powertrain setpoint derivate" VALUE 0xa002122a _REC_S1VAL_20_u2 65.535 _CNV_A_R_LINEAR_____58_CM 0. 65.535 /end CHARACTERISTIC
/begin CHARACTERISTIC Cxx_ajs_driv_pwt_sp_grd_hys "Driver powertrain setpoint derivative hysteresis used in antijerk strategy" VALUE 0xa002122c _REC_S1VAL_20_u2 100. _CNV_A_R_LINEAR_____254_CM 0. 100. FORMAT "%8.3" /end CHARACTERISTIC
/begin CHARACTERISTIC Cxx_ajs_driv_pwt_sp_grd_thd "Threshold for powertrain setpoint derivative to enable the boost of the curative anti-jerk function." VALUE 0xa002122e _REC_S1VAL_20_u2 100. _CNV_A_R_LINEAR_____254_CM 0. 100. FORMAT "%8.3" /end CHARACTERISTIC
/begin CHARACTERISTIC Cxx_ajs_driv_pwt_sp_thd "Threshold for powertrain setpoint to enable the boost of the curative anti-jerk function." VALUE 0xa0021230 _REC_S1VAL_20_u2 1. _CNV_A_R_LINEAR_____257_CM 0. 1. FORMAT "%8.5" /end CHARACTERISTIC
/begin CHARACTERISTIC Cxx_ajs_dt_grip_rat_clos "Value of coupler torque grip ratio to consider the driveline closed" VALUE 0xa002124f _REC_S1VAL_20_u1 1. _CNV_A_R_LINEAR_____255_CM 0. 1. FORMAT "%4.2" /end CHARACTERISTIC
/begin CHARACTERISTIC Cxx_ajs_dt_grip_rat_open "Value of coupler torque grip ratio to consider the driveline open" VALUE 0xa0021250 _REC_S1VAL_20_u1 1. _CNV_A_R_LINEAR_____255_CM 0. 1. FORMAT "%4.2" /end CHARACTERISTIC
/begin CHARACTERISTIC Cxx_ajs_slk_drv_tq_thd_off "Normalized driver torque factor high threshold to deactivate the slack effect" VALUE 0xa0021251 _REC_S1VAL_20_u1 1. _CNV_A_R_LINEAR_____136_CM 0. 1. FORMAT "%4.2" /end CHARACTERISTIC
/begin CHARACTERISTIC Cxx_ajs_slk_drv_tq_thd_on "Normalized driver torque factor low threshold to deactivate the slack effect" VALUE 0xa0021252 _REC_S1VAL_20_u1 1. _CNV_A_R_LINEAR_____136_CM 0. 1. FORMAT "%4.2" /end CHARACTERISTIC
/begin CHARACTERISTIC Cxx_ajs_spd_diff_thd_off "Speed difference high threshold to deactivate the slack effect." VALUE 0xa0021232 _REC_S1VAL_20_s2 16383.75 _CNV_A_R_ENSD_LINEA_24_CM -8192. 8191.75 FORMAT "%6.2" /end CHARACTERISTIC
/begin CHARACTERISTIC Cxx_ajs_spd_diff_thd_on "Speed difference low threshold to deactivate the slack effect." VALUE 0xa0021234 _REC_S1VAL_20_s2 16383.75 _CNV_A_R_ENSD_LINEA_24_CM -8192. 8191.75 FORMAT "%6.2" /end CHARACTERISTIC
/begin CHARACTERISTIC Cxx_ajs_spv_driv_tq_t1_fil "Filter time constant for calculation of the driver torque factor" VALUE 0xa0021236 _REC_S1VAL_20_u2 65.535 _CNV_A_R_LINEAR_____58_CM 0. 65.535 /end CHARACTERISTIC
/begin CHARACTERISTIC Cxx_ajs_spv_n_mv_thd "Engine speed threshold to enable the boost of the curative anti-jerk function." VALUE 0xa0021238 _REC_S1VAL_20_u2 16383.75 _CNV_A_R_ENSD_LINEA_24_CM 0. 16383.75 FORMAT "%8.2" /end CHARACTERISTIC
/begin CHARACTERISTIC Cxx_ajs_spv_slk_decl_dly "Time delay to detect the end of the slack effect correction during vehicle deceleration" VALUE 0xa002123a _REC_S1VAL_20_u2 655.35 _CNV_A_R_LINEAR_____34_CM 0. 655.35 FORMAT "%6.2" /end CHARACTERISTIC
/begin CHARACTERISTIC Cxx_ajs_spv_tco_thd "Engine temperature threshold to enable the boost of the curative anti-jerk function." VALUE 0xa002123c _REC_S1VAL_20_u2 240. _CNV_A_R_LINEAR_____54_CM -40. 200. FORMAT "%5.1" /end CHARACTERISTIC
/begin CHARACTERISTIC Cxx_ajs_spv_tq_drv_hys "hysteresis for Driver torque derivative threshold to enable the boost of the curative anti-jerk function." VALUE 0xa0021253 _REC_S1VAL_20_u1 1. _CNV_A_R_LINEAR_____136_CM 0. 1. FORMAT "%4.2" /end CHARACTERISTIC
/begin CHARACTERISTIC Cxx_ajs_spv_tq_drv_thd "Driver torque derivative threshold to enable the boost of the curative anti-jerk function." VALUE 0xa0021254 _REC_S1VAL_20_u1 1. _CNV_A_R_LINEAR_____136_CM 0. 1. FORMAT "%4.2" /end CHARACTERISTIC
/begin CHARACTERISTIC Cxx_ajs_spv_tq_rat_t1_fil "Filter time constant for filtering of the driver torque ratio" VALUE 0xa002123e _REC_S1VAL_20_u2 65.535 _CNV_A_R_LINEAR_____58_CM 0. 65.535 /end CHARACTERISTIC
/begin CHARACTERISTIC Cxx_ajs_spv_tqe_tgt_thd "Driver torque threshold to enable the boost of the curative anti-jerk function." VALUE 0xa0021240 _REC_S1VAL_20_u2 2047.96875 _CNV_A_R_LINEAR_____161_CM -400. 1647.96875 FORMAT "%10.5" /end CHARACTERISTIC
/begin CHARACTERISTIC Cxx_ajs_spv_wait_dly "Maximum time for the observation of driver pedal or torque conditions to enable the boost of the curative the anti-jerk function." VALUE 0xa0021242 _REC_S1VAL_20_u2 655.35 _CNV_A_R_LINEAR_____34_CM 0. 655.35 FORMAT "%6.2" /end CHARACTERISTIC
/begin AXIS_PTS Ctb_ajs_drag_tq_fac "Breakpoint calibration of normalized driver torque factor for drag error correction." 0xa0020b30 Vxx_ajs_spv_driv_tq_fac _REC_A2AXS_20_u1 1. _CNV_A_R_LINEAR_____136_CM 7 0. 1. FORMAT "%4.2" /end AXIS_PTS
/begin AXIS_PTS Ctb_ajs_modu_n "Breakpoint calibration of engine speed in AJMOD function" 0xa0028570 Vxx_ajs_modu_n_mv _REC_A2AXS_20_u2 16383.75 _CNV_A_R_ENSD_LINEA_24_CM 7 0. 16383.75 FORMAT "%8.2" /end AXIS_PTS
/begin AXIS_PTS Ctb_ajs_modu_tkof_spt_fac "Breakpoint calibration of sportivity factor during takeoff phase" 0xa0020b48 Vxx_ajs_driv_spt_fac _REC_A2AXS_20_u1 1. _CNV_A_R_LINEAR_____216_CM 5 0. 1. FORMAT "%9.7" /end AXIS_PTS
/begin AXIS_PTS Ctb_ajs_spv_spt_tq_fac "Breakpoint calibration of sportivity factor in AJMOD function" 0xa0020b38 Vxx_ajs_driv_spt_fac _REC_A2AXS_20_u1 1. _CNV_A_R_LINEAR_____216_CM 7 0. 1. FORMAT "%9.7" /end AXIS_PTS
/begin AXIS_PTS Ctb_ajs_tq_fac "Breakpoint calibration of normalized driver torque factor" 0xa0020b40 Vxx_ajs_spv_driv_tq_fac _REC_A2AXS_20_u1 1. _CNV_A_R_LINEAR_____136_CM 7 0. 1. FORMAT "%4.2" /end AXIS_PTS
/begin CHARACTERISTIC Cmp_ajs_acel_slk_dly_t1 "AJMOD cartography for selecting the delay of action of the slack effect for vehicle acceleration" MAP 0xa0028580 _REC_A1MAP_20_u2_u2_u2 65.535 _CNV_A_R_LINEAR_____58_CM 0. 65.535
 /begin AXIS_DESCR COM_AXIS Vxx_ajs_modu_n_mv _CNV_A_R_ENSD_LINEA_24_CM 7 0. 16383.75 FORMAT "%8.2" AXIS_PTS_REF Ctb_ajs_modu_n /end AXIS_DESCR
 /begin AXIS_DESCR COM_AXIS Vxx_ajs_dt_tq_rat _CNV_A_R_LINEAR_____251_CM 8 -10. 200. FORMAT "%6.2" AXIS_PTS_REF Ctb_ajs_dt_tq_rat /end AXIS_DESCR
/end CHARACTERISTIC
/begin CHARACTERISTIC Cmp_ajs_acel_slk_dly_t1_fac "AJMOD cartography for modulation factors of the delay of action of the slack effect for vehicle acceleration" MAP 0xa00285f0 _REC_A1MAP_20_u2_u1_u2 100. _CNV_A_R_LINEAR_____136_CM 0. 100.
 /begin AXIS_DESCR COM_AXIS Vxx_ajs_spv_driv_tq_fac _CNV_A_R_LINEAR_____136_CM 7 0. 1. FORMAT "%4.2" AXIS_PTS_REF Ctb_ajs_tq_fac /end AXIS_DESCR
 /begin AXIS_DESCR COM_AXIS Vxx_ajs_dt_tq_rat _CNV_A_R_LINEAR_____251_CM 8 -10. 200. FORMAT "%6.2" AXIS_PTS_REF Ctb_ajs_dt_tq_rat /end AXIS_DESCR
/end CHARACTERISTIC
/begin CHARACTERISTIC Cmp_ajs_acel_slk_t1_ini_max "AJMOD cartography for selecting the initial time constant offset added during slack effect activation for vehicle acceleration" MAP 0xa0028660 _REC_A1MAP_20_u2_u2_u2 65.535 _CNV_A_R_LINEAR_____58_CM 0. 65.535
 /begin AXIS_DESCR COM_AXIS Vxx_ajs_modu_n_mv _CNV_A_R_ENSD_LINEA_24_CM 7 0. 16383.75 FORMAT "%8.2" AXIS_PTS_REF Ctb_ajs_modu_n /end AXIS_DESCR
 /begin AXIS_DESCR COM_AXIS Vxx_ajs_dt_tq_rat _CNV_A_R_LINEAR_____251_CM 8 -10. 200. FORMAT "%6.2" AXIS_PTS_REF Ctb_ajs_dt_tq_rat /end AXIS_DESCR
/end CHARACTERISTIC
/begin CHARACTERISTIC Cmp_ajs_acel_slk_t1_ini_max_fac "AJMOD cartography for modulation factors of the initial time constant offset added during slack effect for vehicle acceleration" MAP 0xa00286d0 _REC_A1MAP_20_u2_u1_u2 100. _CNV_A_R_LINEAR_____136_CM 0. 100.
 /begin AXIS_DESCR COM_AXIS Vxx_ajs_spv_driv_tq_fac _CNV_A_R_LINEAR_____136_CM 7 0. 1. FORMAT "%4.2" AXIS_PTS_REF Ctb_ajs_tq_fac /end AXIS_DESCR
 /begin AXIS_DESCR COM_AXIS Vxx_ajs_dt_tq_rat _CNV_A_R_LINEAR_____251_CM 8 -10. 200. FORMAT "%6.2" AXIS_PTS_REF Ctb_ajs_dt_tq_rat /end AXIS_DESCR
/end CHARACTERISTIC
/begin CHARACTERISTIC Cmp_ajs_decl_slk_dly_t1 "AJMOD cartography for selecting the delay of action of the slack effect for vehicle deceleration" MAP 0xa0028740 _REC_A1MAP_20_u2_u2_u2 65.535 _CNV_A_R_LINEAR_____58_CM 0. 65.535
 /begin AXIS_DESCR COM_AXIS Vxx_ajs_modu_n_mv _CNV_A_R_ENSD_LINEA_24_CM 7 0. 16383.75 FORMAT "%8.2" AXIS_PTS_REF Ctb_ajs_modu_n /end AXIS_DESCR
 /begin AXIS_DESCR COM_AXIS Vxx_ajs_dt_tq_rat _CNV_A_R_LINEAR_____251_CM 8 -10. 200. FORMAT "%6.2" AXIS_PTS_REF Ctb_ajs_dt_tq_rat /end AXIS_DESCR
/end CHARACTERISTIC
/begin CHARACTERISTIC Cmp_ajs_decl_slk_dly_t1_fac "AJMOD cartography for modulation factors of the delay of action of the slack effect for vehicle deceleration" MAP 0xa00287b0 _REC_A1MAP_20_u2_u1_u2 100. _CNV_A_R_LINEAR_____136_CM 0. 100.
 /begin AXIS_DESCR COM_AXIS Vxx_ajs_spv_driv_tq_fac _CNV_A_R_LINEAR_____136_CM 7 0. 1. FORMAT "%4.2" AXIS_PTS_REF Ctb_ajs_tq_fac /end AXIS_DESCR
 /begin AXIS_DESCR COM_AXIS Vxx_ajs_dt_tq_rat _CNV_A_R_LINEAR_____251_CM 8 -10. 200. FORMAT "%6.2" AXIS_PTS_REF Ctb_ajs_dt_tq_rat /end AXIS_DESCR
/end CHARACTERISTIC
/begin CHARACTERISTIC Cmp_ajs_decl_slk_t1_ini_max "AJMOD cartography for selecting the initial time constant offset added during slack effect activation for vehicle deceleration" MAP 0xa0028820 _REC_A1MAP_20_u2_u2_u2 65.535 _CNV_A_R_LINEAR_____58_CM 0. 65.535
 /begin AXIS_DESCR COM_AXIS Vxx_ajs_modu_n_mv _CNV_A_R_ENSD_LINEA_24_CM 7 0. 16383.75 FORMAT "%8.2" AXIS_PTS_REF Ctb_ajs_modu_n /end AXIS_DESCR
 /begin AXIS_DESCR COM_AXIS Vxx_ajs_dt_tq_rat _CNV_A_R_LINEAR_____251_CM 8 -10. 200. FORMAT "%6.2" AXIS_PTS_REF Ctb_ajs_dt_tq_rat /end AXIS_DESCR
/end CHARACTERISTIC
/begin CHARACTERISTIC Cmp_ajs_decl_slk_t1_ini_max_fac "AJMOD cartography for modulation factors of the initial time constant offset added during slack effect activation for vehicle deceleration" MAP 0xa0028890 _REC_A1MAP_20_u2_u1_u2 100. _CNV_A_R_LINEAR_____136_CM 0. 100.
 /begin AXIS_DESCR COM_AXIS Vxx_ajs_spv_driv_tq_fac _CNV_A_R_LINEAR_____136_CM 7 0. 1. FORMAT "%4.2" AXIS_PTS_REF Ctb_ajs_tq_fac /end AXIS_DESCR
 /begin AXIS_DESCR COM_AXIS Vxx_ajs_dt_tq_rat _CNV_A_R_LINEAR_____251_CM 8 -10. 200. FORMAT "%6.2" AXIS_PTS_REF Ctb_ajs_dt_tq_rat /end AXIS_DESCR
/end CHARACTERISTIC
/begin CHARACTERISTIC Cmp_ajs_modu_t1_acel_driv_fac "AJMOD cartography for modulation factors of the filter time constant based on driver torque factor for vehicle acceleration" MAP 0xa0028900 _REC_A1MAP_20_u2_u1_u2 100. _CNV_A_R_LINEAR_____136_CM 0. 100.
 /begin AXIS_DESCR COM_AXIS Vxx_ajs_spv_driv_tq_fac _CNV_A_R_LINEAR_____136_CM 7 0. 1. FORMAT "%4.2" AXIS_PTS_REF Ctb_ajs_tq_fac /end AXIS_DESCR
 /begin AXIS_DESCR COM_AXIS Vxx_ajs_dt_tq_rat _CNV_A_R_LINEAR_____251_CM 8 -10. 200. FORMAT "%6.2" AXIS_PTS_REF Ctb_ajs_dt_tq_rat /end AXIS_DESCR
/end CHARACTERISTIC
/begin CHARACTERISTIC Cmp_ajs_modu_t1_acel_dt_clos "AJMOD time constant cartography for vehicle acceleration when driveline is closed" MAP 0xa0028970 _REC_A1MAP_20_u2_u2_u2 65.535 _CNV_A_R_LINEAR_____58_CM 0. 65.535
 /begin AXIS_DESCR COM_AXIS Vxx_ajs_modu_n_mv _CNV_A_R_ENSD_LINEA_24_CM 7 0. 16383.75 FORMAT "%8.2" AXIS_PTS_REF Ctb_ajs_modu_n /end AXIS_DESCR
 /begin AXIS_DESCR COM_AXIS Vxx_ajs_dt_tq_rat _CNV_A_R_LINEAR_____251_CM 8 -10. 200. FORMAT "%6.2" AXIS_PTS_REF Ctb_ajs_dt_tq_rat /end AXIS_DESCR
/end CHARACTERISTIC
/begin CHARACTERISTIC Cmp_ajs_modu_t1_decl_driv_fac "AJMOD cartography for modulation factors of the filter time constant based on driver torque factor for vehicle deceleration" MAP 0xa00289e0 _REC_A1MAP_20_u2_u1_u2 100. _CNV_A_R_LINEAR_____136_CM 0. 100.
 /begin AXIS_DESCR COM_AXIS Vxx_ajs_spv_driv_tq_fac _CNV_A_R_LINEAR_____136_CM 7 0. 1. FORMAT "%4.2" AXIS_PTS_REF Ctb_ajs_tq_fac /end AXIS_DESCR
 /begin AXIS_DESCR COM_AXIS Vxx_ajs_dt_tq_rat _CNV_A_R_LINEAR_____251_CM 8 -10. 200. FORMAT "%6.2" AXIS_PTS_REF Ctb_ajs_dt_tq_rat /end AXIS_DESCR
/end CHARACTERISTIC
/begin CHARACTERISTIC Cmp_ajs_modu_t1_decl_dt_clos "AJMOD time constant cartography for vehicle deceleration when driveline is closed" MAP 0xa0028a50 _REC_A1MAP_20_u2_u2_u2 65.535 _CNV_A_R_LINEAR_____58_CM 0. 65.535
 /begin AXIS_DESCR COM_AXIS Vxx_ajs_modu_n_mv _CNV_A_R_ENSD_LINEA_24_CM 7 0. 16383.75 FORMAT "%8.2" AXIS_PTS_REF Ctb_ajs_modu_n /end AXIS_DESCR
 /begin AXIS_DESCR COM_AXIS Vxx_ajs_dt_tq_rat _CNV_A_R_LINEAR_____251_CM 8 -10. 200. FORMAT "%6.2" AXIS_PTS_REF Ctb_ajs_dt_tq_rat /end AXIS_DESCR
/end CHARACTERISTIC
/begin CHARACTERISTIC Cmp_ajs_modu_td_acel_driv_fac "AJMOD cartography for modulation factors of the filter gain based on driver torque factor for vehicle acceleration" MAP 0xa0028ac0 _REC_A1MAP_20_u2_u1_u2 100. _CNV_A_R_LINEAR_____136_CM 0. 100.
 /begin AXIS_DESCR COM_AXIS Vxx_ajs_spv_driv_tq_fac _CNV_A_R_LINEAR_____136_CM 7 0. 1. FORMAT "%4.2" AXIS_PTS_REF Ctb_ajs_tq_fac /end AXIS_DESCR
 /begin AXIS_DESCR COM_AXIS Vxx_ajs_dt_tq_rat _CNV_A_R_LINEAR_____251_CM 8 -10. 200. FORMAT "%6.2" AXIS_PTS_REF Ctb_ajs_dt_tq_rat /end AXIS_DESCR
/end CHARACTERISTIC
/begin CHARACTERISTIC Cmp_ajs_modu_td_acel_dt_clos "AJMOD gain cartography for vehicle acceleration when driveline is closed" MAP 0xa0028b30 _REC_A1MAP_20_u2_u2_u2 1. _CNV_A_R_LINEAR_____108_CM 0. 1. FORMAT "%5.3"
 /begin AXIS_DESCR COM_AXIS Vxx_ajs_modu_n_mv _CNV_A_R_ENSD_LINEA_24_CM 7 0. 16383.75 FORMAT "%8.2" AXIS_PTS_REF Ctb_ajs_modu_n /end AXIS_DESCR
 /begin AXIS_DESCR COM_AXIS Vxx_ajs_dt_tq_rat _CNV_A_R_LINEAR_____251_CM 8 -10. 200. FORMAT "%6.2" AXIS_PTS_REF Ctb_ajs_dt_tq_rat /end AXIS_DESCR
/end CHARACTERISTIC
/begin CHARACTERISTIC Cmp_ajs_modu_td_decl_driv_fac "AJMOD cartography for modulation factors of the filter gain based on driver torque factor for vehicle deceleration" MAP 0xa0028ba0 _REC_A1MAP_20_u2_u1_u2 100. _CNV_A_R_LINEAR_____136_CM 0. 100.
 /begin AXIS_DESCR COM_AXIS Vxx_ajs_spv_driv_tq_fac _CNV_A_R_LINEAR_____136_CM 7 0. 1. FORMAT "%4.2" AXIS_PTS_REF Ctb_ajs_tq_fac /end AXIS_DESCR
 /begin AXIS_DESCR COM_AXIS Vxx_ajs_dt_tq_rat _CNV_A_R_LINEAR_____251_CM 8 -10. 200. FORMAT "%6.2" AXIS_PTS_REF Ctb_ajs_dt_tq_rat /end AXIS_DESCR
/end CHARACTERISTIC
/begin CHARACTERISTIC Cmp_ajs_modu_td_decl_dt_clos "AJMOD gain cartography for vehicle deceleration when driveline is closed" MAP 0xa0028c10 _REC_A1MAP_20_u2_u2_u2 1. _CNV_A_R_LINEAR_____108_CM 0. 1. FORMAT "%5.3"
 /begin AXIS_DESCR COM_AXIS Vxx_ajs_modu_n_mv _CNV_A_R_ENSD_LINEA_24_CM 7 0. 16383.75 FORMAT "%8.2" AXIS_PTS_REF Ctb_ajs_modu_n /end AXIS_DESCR
 /begin AXIS_DESCR COM_AXIS Vxx_ajs_dt_tq_rat _CNV_A_R_LINEAR_____251_CM 8 -10. 200. FORMAT "%6.2" AXIS_PTS_REF Ctb_ajs_dt_tq_rat /end AXIS_DESCR
/end CHARACTERISTIC
/begin CHARACTERISTIC Ctp_ajs_drag_t1_dly "Drag error correction delay for time constant modulation." CURVE 0xa0028c80 _REC_A1CUR_20_u2_u1 65.535 _CNV_A_R_LINEAR_____58_CM 0. 65.535 FORMAT "%5.3"
 /begin AXIS_DESCR COM_AXIS Vxx_ajs_spv_driv_tq_fac _CNV_A_R_LINEAR_____136_CM 7 0. 1. FORMAT "%4.2" AXIS_PTS_REF Ctb_ajs_drag_tq_fac /end AXIS_DESCR
/end CHARACTERISTIC
/begin CHARACTERISTIC Ctp_ajs_modu_t1_acel_spt_fac "AJMOD table for modulation factors of the filter time constant based on driver sportivity factor for vehicle acceleration" CURVE 0xa0028c90 _REC_A1CUR_20_u2_u1 100. _CNV_A_R_LINEAR_____136_CM 0. 100.
 /begin AXIS_DESCR COM_AXIS Vxx_ajs_driv_spt_fac _CNV_A_R_LINEAR_____216_CM 7 0. 1. FORMAT "%9.7" AXIS_PTS_REF Ctb_ajs_spv_spt_tq_fac /end AXIS_DESCR
/end CHARACTERISTIC
/begin CHARACTERISTIC Ctp_ajs_modu_t1_decl_spt_fac "AJMOD table for modulation factors of the filter time constant based on driver sportivity factor for vehicle deceleration" CURVE 0xa0028ca0 _REC_A1CUR_20_u2_u1 100. _CNV_A_R_LINEAR_____136_CM 0. 100.
 /begin AXIS_DESCR COM_AXIS Vxx_ajs_driv_spt_fac _CNV_A_R_LINEAR_____216_CM 7 0. 1. FORMAT "%9.7" AXIS_PTS_REF Ctb_ajs_spv_spt_tq_fac /end AXIS_DESCR
/end CHARACTERISTIC
/begin CHARACTERISTIC Ctp_ajs_modu_t1_tkof_dt_open "AJMOD table for the filter time constant based on driver sportivity factor during takeoff state for vehicle acceleration" CURVE 0xa0028cb0 _REC_A1CUR_20_u2_u1 65.535 _CNV_A_R_LINEAR_____58_CM 0. 65.535
 /begin AXIS_DESCR COM_AXIS Vxx_ajs_driv_spt_fac _CNV_A_R_LINEAR_____216_CM 5 0. 1. FORMAT "%9.7" AXIS_PTS_REF Ctb_ajs_modu_tkof_spt_fac /end AXIS_DESCR
/end CHARACTERISTIC
/begin CHARACTERISTIC Ctp_ajs_modu_td_acel_spt_fac "AJMOD table for modulation factors of the filter gain based on driver sportivity factor for vehicle acceleration" CURVE 0xa0028cbc _REC_A1CUR_20_u2_u1 100. _CNV_A_R_LINEAR_____136_CM 0. 100.
 /begin AXIS_DESCR COM_AXIS Vxx_ajs_driv_spt_fac _CNV_A_R_LINEAR_____216_CM 7 0. 1. FORMAT "%9.7" AXIS_PTS_REF Ctb_ajs_spv_spt_tq_fac /end AXIS_DESCR
/end CHARACTERISTIC
/begin CHARACTERISTIC Ctp_ajs_modu_td_decl_spt_fac "AJMOD table for modulation factors of the filter gain based on driver sportivity factor for vehicle deceleration" CURVE 0xa0028ccc _REC_A1CUR_20_u2_u1 100. _CNV_A_R_LINEAR_____136_CM 0. 100.
 /begin AXIS_DESCR COM_AXIS Vxx_ajs_driv_spt_fac _CNV_A_R_LINEAR_____216_CM 7 0. 1. FORMAT "%9.7" AXIS_PTS_REF Ctb_ajs_spv_spt_tq_fac /end AXIS_DESCR
/end CHARACTERISTIC
/begin CHARACTERISTIC Ctp_ajs_modu_td_tkof_dt_open "AJMOD table for the filter gain based on driver sportivity factor during takeoff state for vehicle acceleration" CURVE 0xa0028cdc _REC_A1CUR_20_u2_u1 1. _CNV_A_R_LINEAR_____108_CM 0. 1. FORMAT "%5.3"
 /begin AXIS_DESCR COM_AXIS Vxx_ajs_driv_spt_fac _CNV_A_R_LINEAR_____216_CM 5 0. 1. FORMAT "%9.7" AXIS_PTS_REF Ctb_ajs_modu_tkof_spt_fac /end AXIS_DESCR
/end CHARACTERISTIC
/begin MEASUREMENT Vbx_ajs_modu_loss_fil_cut "Boolean variable to detect engine torque losses filtering" UBYTE _CNV_S_2_RANGE______3_CM 1 0. 0. 1. ECU_ADDRESS 0xd0004f27 BIT_MASK 0x1 /end MEASUREMENT
/begin MEASUREMENT Vbx_ajs_modu_stt_cut "Boolean variable deactivating (1) AJMOD function" UBYTE _CNV_S_2_RANGE______3_CM 1 0. 0. 1. ECU_ADDRESS 0xd0004f28 BIT_MASK 0x1 /end MEASUREMENT
/begin MEASUREMENT Vbx_ajs_modu_tkof_ena "Boolean to activate parameters modulation during takeoff phase" UBYTE _CNV_S_2_RANGE______3_CM 1 0. 0. 1. ECU_ADDRESS 0xd0004f29 BIT_MASK 0x1 /end MEASUREMENT
/begin MEASUREMENT Vsx_ajs_modu_stt_para "State variable to select AJMOD parameters" UBYTE _CNV_A_R_ECME_LINEA_0_CM 1 0. 1. 5. ECU_ADDRESS 0xd0004f2a FORMAT "%1.0" /end MEASUREMENT
/begin MEASUREMENT Vxx_ajs_driv_spt_fac "Driver sportivity factor used in the anti-jerk strategy" UBYTE _CNV_A_R_LINEAR_____216_CM 1 0. 0. 1. ECU_ADDRESS 0xd0004f2b FORMAT "%9.7" /end MEASUREMENT
/begin MEASUREMENT Vxx_ajs_modu_n_mv "Filtered engine speed after status validation" UWORD _CNV_A_R_ENSD_LINEA_24_CM 1 0. 0. 16383.75 ECU_ADDRESS 0xd0002dac FORMAT "%8.2" /end MEASUREMENT
/begin MEASUREMENT Vxx_ajs_modu_t1 "AJMOD time constant value before slack effect" UWORD _CNV_A_R_LINEAR_____58_CM 1 0. 0. 65.535 ECU_ADDRESS 0xd0002dae /end MEASUREMENT
/begin MEASUREMENT Vxx_ajs_modu_t1_acel "AJMOD time constant value calculated for vehicle acceleration" UWORD _CNV_A_R_LINEAR_____58_CM 1 0. 0. 65.535 ECU_ADDRESS 0xd0002db0 /end MEASUREMENT
/begin MEASUREMENT Vxx_ajs_modu_t1_acel_dt_clos "AJMOD time constant value calculated when driveline is closed for vehicle acceleration" UWORD _CNV_A_R_LINEAR_____58_CM 1 0. 0. 65.535 ECU_ADDRESS 0xd0002db2 /end MEASUREMENT
/begin MEASUREMENT Vxx_ajs_modu_t1_acel_dt_open "AJMOD time constant value for the declutched state for vehicle acceleration" UWORD _CNV_A_R_LINEAR_____58_CM 1 0. 0. 65.535 ECU_ADDRESS 0xd0002db4 /end MEASUREMENT
/begin MEASUREMENT Vxx_ajs_modu_t1_acel_fac "AJMOD modulation factor for the filter time constant when driveline is closed for vehicle acceleration" UWORD _CNV_A_R_LINEAR_____136_CM 1 0. 0. 100. ECU_ADDRESS 0xd0002db6 /end MEASUREMENT
/begin MEASUREMENT Vxx_ajs_modu_t1_bfr_drag "AJMOD time constant value before drag error correction" UWORD _CNV_A_R_LINEAR_____58_CM 1 0. 0. 65.535 ECU_ADDRESS 0xd0002db8 /end MEASUREMENT
/begin MEASUREMENT Vxx_ajs_modu_t1_decl "AJMOD time constant value calculated for vehicle deceleration" UWORD _CNV_A_R_LINEAR_____58_CM 1 0. 0. 65.535 ECU_ADDRESS 0xd0002dba /end MEASUREMENT
/begin MEASUREMENT Vxx_ajs_modu_t1_decl_dt_clos "AJMOD time constant value calculated when driveline is closed for vehicle deceleration" UWORD _CNV_A_R_LINEAR_____58_CM 1 0. 0. 65.535 ECU_ADDRESS 0xd0002dbc /end MEASUREMENT
/begin MEASUREMENT Vxx_ajs_modu_t1_decl_fac "AJMOD modulation factor for the filter time constant when driveline is closed for vehicle deceleration" UWORD _CNV_A_R_LINEAR_____136_CM 1 0. 0. 100. ECU_ADDRESS 0xd0002dbe /end MEASUREMENT
/begin MEASUREMENT Vxx_ajs_modu_t1_sp "AJMOD time constant for filtering action on torque setpoint" UWORD _CNV_A_R_LINEAR_____58_CM 1 0. 0. 65.535 ECU_ADDRESS 0xd0002dc0 /end MEASUREMENT
/begin MEASUREMENT Vxx_ajs_modu_t1_tgt "AJMOD time constant for filtering action on torque target" UWORD _CNV_A_R_LINEAR_____58_CM 1 0. 0. 65.535 ECU_ADDRESS 0xd0002dc2 /end MEASUREMENT
/begin MEASUREMENT Vxx_ajs_modu_td "AJMOD gain value before slack effect" UWORD _CNV_A_R_LINEAR_____108_CM 1 0. 0. 1. ECU_ADDRESS 0xd0002dc4 FORMAT "%5.3" /end MEASUREMENT
/begin MEASUREMENT Vxx_ajs_modu_td_acel "AJMOD gain value calculated for vehicle acceleration" UWORD _CNV_A_R_LINEAR_____108_CM 1 0. 0. 1. ECU_ADDRESS 0xd0002dc6 FORMAT "%5.3" /end MEASUREMENT
/begin MEASUREMENT Vxx_ajs_modu_td_acel_dt_clos "AJMOD gain value calculated when driveline is closed for vehicle acceleration" UWORD _CNV_A_R_LINEAR_____108_CM 1 0. 0. 1. ECU_ADDRESS 0xd0002dc8 FORMAT "%5.3" /end MEASUREMENT
/begin MEASUREMENT Vxx_ajs_modu_td_acel_dt_open "AJMOD gain value for the declutched state for vehicle acceleration" UWORD _CNV_A_R_LINEAR_____108_CM 1 0. 0. 1. ECU_ADDRESS 0xd0002dca FORMAT "%5.3" /end MEASUREMENT
/begin MEASUREMENT Vxx_ajs_modu_td_acel_fac "AJMOD modulation factor for the filter gain when driveline is closed for vehicle acceleration" UWORD _CNV_A_R_LINEAR_____136_CM 1 0. 0. 100. ECU_ADDRESS 0xd0002dcc /end MEASUREMENT
/begin MEASUREMENT Vxx_ajs_modu_td_decl "AJMOD gain value calculated for vehicle deceleration" UWORD _CNV_A_R_LINEAR_____108_CM 1 0. 0. 1. ECU_ADDRESS 0xd0002dce FORMAT "%5.3" /end MEASUREMENT
/begin MEASUREMENT Vxx_ajs_modu_td_decl_dt_clos "AJMOD gain value calculated when driveline is closed for vehicle deceleration" UWORD _CNV_A_R_LINEAR_____108_CM 1 0. 0. 1. ECU_ADDRESS 0xd0002dd0 FORMAT "%9.7" /end MEASUREMENT
/begin MEASUREMENT Vxx_ajs_modu_td_decl_fac "AJMOD modulation factor for the filter gain when driveline is closed for vehicle deceleration" UWORD _CNV_A_R_LINEAR_____136_CM 1 0. 0. 100. ECU_ADDRESS 0xd0002dd2 /end MEASUREMENT
/begin MEASUREMENT Vxx_ajs_modu_td_sp "AJMOD gain for filtering action on torque setpoint" UWORD _CNV_A_R_LINEAR_____108_CM 1 0. 0. 1. ECU_ADDRESS 0xd0002dd4 FORMAT "%5.3" /end MEASUREMENT
/begin MEASUREMENT Vxx_ajs_modu_td_tgt "AJMOD gain for filtering action on torque target" UWORD _CNV_A_R_LINEAR_____108_CM 1 0. 0. 1. ECU_ADDRESS 0xd0002dd6 FORMAT "%5.3" /end MEASUREMENT
/begin MEASUREMENT Vxx_ajs_modu_tqe_sp "Final torque setpoint after AJMOD action" UWORD _CNV_A_R_LINEAR_____161_CM 1 0. -400. 1647.96875 ECU_ADDRESS 0xd0002dd8 FORMAT "%10.5" /end MEASUREMENT
/begin MEASUREMENT Vxx_ajs_modu_tqe_sp_fil "Torque setpoint after AJMOD filtering action" UWORD _CNV_A_R_LINEAR_____161_CM 1 0. -400. 1647.96875 ECU_ADDRESS 0xd0002dda FORMAT "%11.5" /end MEASUREMENT
/begin MEASUREMENT Vxx_ajs_modu_tqe_tgt "Final Torque Target after AJS Modulation action" UWORD _CNV_A_R_LINEAR_____161_CM 1 0. -400. 1647.96875 ECU_ADDRESS 0xd0002ddc FORMAT "%10.5" /end MEASUREMENT
/begin MEASUREMENT Vxx_ajs_modu_tqe_tgt_fil "Torque target after AJMOD filtering action" UWORD _CNV_A_R_LINEAR_____161_CM 1 0. -400. 1647.96875 ECU_ADDRESS 0xd0002dde FORMAT "%11.5" /end MEASUREMENT
/begin MEASUREMENT Vxx_ajs_slk_dly_t1 "Delay of action of the slack effect calculated" UWORD _CNV_A_R_LINEAR_____58_CM 1 0. 0. 65.535 ECU_ADDRESS 0xd0002de0 /end MEASUREMENT
/begin MEASUREMENT Vxx_ajs_slk_t1_ini_max "Calculated value of filter time constant initial offset added by the slack at it's activation" UWORD _CNV_A_R_LINEAR_____58_CM 1 0. 0. 65.535 ECU_ADDRESS 0xd0002de2 /end MEASUREMENT
/begin CHARACTERISTIC Cbx_ajs_dt_slk_cfm "a_pc_paj_ctl_ajspvxx_xxx_xx_x_a/Boolean calibration to cut (0) slack effect strategy in AJMOD" VALUE 0xa0020b78 _REC_S1VAL_20_u1 1. _CNV_A_R_ECME_LINEA_0_CM 0. 1. FORMAT "%1.0" BIT_MASK 0x1 /end CHARACTERISTIC
/begin CHARACTERISTIC Cbx_ajs_modu_stt_cfm "Boolean calibration to deactivate AJMOD function (0) manually" VALUE 0xa0020b79 _REC_S1VAL_20_u1 1. _CNV_A_R_ECME_LINEA_0_CM 0. 1. FORMAT "%1.0" BIT_MASK 0x1 /end CHARACTERISTIC
/begin CHARACTERISTIC Cbx_ajs_slk_td_cfm "Boolean calibration to autorize (1) manually the slack effect for td parameter" VALUE 0xa0020b7a _REC_S1VAL_20_u1 1. _CNV_A_R_ECME_LINEA_0_CM 0. 1. FORMAT "%1.0" BIT_MASK 0x1 /end CHARACTERISTIC
/begin CHARACTERISTIC Cxx_ajs_modu_loss_fil_cut_thd "Torque threshold for AJMOD engine torque losses filtering management" VALUE 0xa0020b4e _REC_S1VAL_20_u2 2047.96875 _CNV_A_R_LINEAR_____123_CM 0. 2047.96875 FORMAT "%10.5" /end CHARACTERISTIC
/begin CHARACTERISTIC Cxx_ajs_modu_slk_fil_t1_acel "Time constant for filtering the slack effect correction for vehicle acceleration" VALUE 0xa0020b50 _REC_S1VAL_20_u2 65.535 _CNV_A_R_LINEAR_____58_CM 0. 65.535 /end CHARACTERISTIC
/begin CHARACTERISTIC Cxx_ajs_modu_slk_fil_t1_decl "Time constant for filtering the slack effect correction for vehicle deceleration" VALUE 0xa0020b52 _REC_S1VAL_20_u2 65.535 _CNV_A_R_LINEAR_____58_CM 0. 65.535 /end CHARACTERISTIC
/begin CHARACTERISTIC Cxx_ajs_modu_t1_acel_dt_modu "AJMOD time constant value when driveline is in modulation mode for vehicle acceleration" VALUE 0xa0020b54 _REC_S1VAL_20_u2 65.535 _CNV_A_R_LINEAR_____58_CM 0. 65.535 /end CHARACTERISTIC
/begin CHARACTERISTIC Cxx_ajs_modu_t1_acel_dt_open "AJMOD time constant value when driveline is open for vehicle acceleration" VALUE 0xa0020b56 _REC_S1VAL_20_u2 65.535 _CNV_A_R_LINEAR_____58_CM 0. 65.535 /end CHARACTERISTIC
/begin CHARACTERISTIC Cxx_ajs_modu_t1_decl_dt_modu "AJMOD time constant value when driveline is in modulation mode for vehicle deceleration" VALUE 0xa0020b58 _REC_S1VAL_20_u2 65.535 _CNV_A_R_LINEAR_____58_CM 0. 65.535 /end CHARACTERISTIC
/begin CHARACTERISTIC Cxx_ajs_modu_t1_decl_dt_open "AJMOD time constant value when driveline is open for vehicle deceleration" VALUE 0xa0020b5a _REC_S1VAL_20_u2 65.535 _CNV_A_R_LINEAR_____58_CM 0. 65.535 /end CHARACTERISTIC
/begin CHARACTERISTIC Cxx_ajs_modu_t1_dt_clos_max "Maximum AJMOD time constant value when driveline is close" VALUE 0xa0020b5c _REC_S1VAL_20_u2 65.535 _CNV_A_R_LINEAR_____58_CM 0. 65.535 /end CHARACTERISTIC
/begin CHARACTERISTIC Cxx_ajs_modu_t1_dt_ini "AJMOD time constant value during initialisation" VALUE 0xa0020b5e _REC_S1VAL_20_u2 65.535 _CNV_A_R_LINEAR_____58_CM 0. 65.535 /end CHARACTERISTIC
/begin CHARACTERISTIC Cxx_ajs_modu_t1_fast_cor "AJMOD time constant value during a fast anti-jerk correction" VALUE 0xa0020b60 _REC_S1VAL_20_u2 65.535 _CNV_A_R_LINEAR_____58_CM 0. 65.535 /end CHARACTERISTIC
/begin CHARACTERISTIC Cxx_ajs_modu_td_acel_dt_modu "AJMOD gain value when driveline is in modulation mode for vehicle acceleration" VALUE 0xa0020b62 _REC_S1VAL_20_u2 1. _CNV_A_R_LINEAR_____108_CM 0. 1. FORMAT "%5.3" /end CHARACTERISTIC
/begin CHARACTERISTIC Cxx_ajs_modu_td_acel_dt_open "AJMOD gain value when driveline is open for vehicle acceleration" VALUE 0xa0020b64 _REC_S1VAL_20_u2 1. _CNV_A_R_LINEAR_____108_CM 0. 1. FORMAT "%5.3" /end CHARACTERISTIC
/begin CHARACTERISTIC Cxx_ajs_modu_td_decl_dt_modu "AJMOD gain value when driveline is in modulation mode for vehicle deceleration" VALUE 0xa0020b66 _REC_S1VAL_20_u2 1. _CNV_A_R_LINEAR_____108_CM 0. 1. FORMAT "%5.3" /end CHARACTERISTIC
/begin CHARACTERISTIC Cxx_ajs_modu_td_decl_dt_open "AJMOD gain value when driveline is open for vehicle deceleration" VALUE 0xa0020b68 _REC_S1VAL_20_u2 1. _CNV_A_R_LINEAR_____108_CM 0. 1. FORMAT "%5.3" /end CHARACTERISTIC
/begin CHARACTERISTIC Cxx_ajs_modu_td_dt_ini "AJMOD gain value during initialisation" VALUE 0xa0020b6a _REC_S1VAL_20_u2 1. _CNV_A_R_LINEAR_____108_CM 0. 1. FORMAT "%5.3" /end CHARACTERISTIC
/begin CHARACTERISTIC Cxx_ajs_modu_td_fast_cor "AJMOD gain value during a fast anti-jerk correction" VALUE 0xa0020b6c _REC_S1VAL_20_u2 1. _CNV_A_R_LINEAR_____108_CM 0. 1. FORMAT "%5.3" /end CHARACTERISTIC
/begin CHARACTERISTIC Cxx_ajs_modu_tkof_vs_thd "Vehicule speed threshold to deactivate parameters modulation during takeoff phase" VALUE 0xa0020b6e _REC_S1VAL_20_u2 655.35 _CNV_A_R_LINEAR_____70_CM 0. 655.35 FORMAT "%6.2" /end CHARACTERISTIC
/begin CHARACTERISTIC Cxx_ajs_modu_vs_thd_off "Vehicule speed high threshold to deactivate AJMOD function" VALUE 0xa0020b70 _REC_S1VAL_20_u2 655.35 _CNV_A_R_LINEAR_____70_CM 0. 655.35 FORMAT "%6.2" /end CHARACTERISTIC
/begin CHARACTERISTIC Cxx_ajs_modu_vs_thd_on "Vehicule speed low threshold to deactivate AJMOD function" VALUE 0xa0020b72 _REC_S1VAL_20_u2 655.35 _CNV_A_R_LINEAR_____70_CM 0. 655.35 FORMAT "%6.2" /end CHARACTERISTIC
/begin CHARACTERISTIC Cxx_ajs_n_mv_dft "Engine speed replacement value for invalid engine speed measure" VALUE 0xa0020b74 _REC_S1VAL_20_u2 16383.75 _CNV_A_R_ENSD_LINEA_24_CM 0. 16383.75 FORMAT "%8.2" /end CHARACTERISTIC
/begin CHARACTERISTIC Cxx_ajs_slk_act_ctr "Number of permitted activations of slack effect" VALUE 0xa0020b7b _REC_S1VAL_20_u1 255. _CNV_A_R_ECME_LINEA_0_CM 0. 255. FORMAT "%3.0" /end CHARACTERISTIC
/begin CHARACTERISTIC Cxx_ajs_slk_td_ini_fac "Corrective factor of Td added by the slack effect" VALUE 0xa0020b76 _REC_S1VAL_20_u2 100. _CNV_A_R_LINEAR_____136_CM 0. 100. /end CHARACTERISTIC
/begin MEASUREMENT Vxx_ajs_esti_tqe "Estimated effective engine torque used in the anti-jerk strategy" UWORD _CNV_A_R_LINEAR_____161_CM 1 0. -400. 1647.96875 ECU_ADDRESS 0xd0002ec4 FORMAT "%10.5" /end MEASUREMENT
/begin MEASUREMENT Vbx_sta_inj_stt "Vbx_sta_inj_stt : Boolean for the starting mode" UBYTE _CNV_S_2_RANGE______3_CM 1 0. 0. 1. DISPLAY_IDENTIFIER SmCrkCtl_NVM.Vbx_sta_inj_stt_NVM ECU_ADDRESS 0xd000321c BIT_MASK 0x1 /end MEASUREMENT
/begin MEASUREMENT Vbx_rest_stal "Restart after engine stall detected" UBYTE _CNV_S_2_RANGE______3_CM 1 0. 0. 1. DISPLAY_IDENTIFIER SmCrkCtl_NVM.Vbx_rest_stal_NVM ECU_ADDRESS 0xd000321d BIT_MASK 0x1 /end MEASUREMENT
/begin MEASUREMENT Vbx_rest_cdn "Indicator of restart condition" UBYTE _CNV_S_2_RANGE______3_CM 1 0. 0. 1. DISPLAY_IDENTIFIER SmCrkCtl_NVM.Vbx_rest_cdn_NVM ECU_ADDRESS 0xd000321e BIT_MASK 0x1 /end MEASUREMENT
/begin MEASUREMENT Vxx_inj_sta_dly "Vxx_inj_sta_dly : Maximum duration before out of Injection Start State" UBYTE _CNV_A_R_LINEAR_____4_CM 1 0. 0. 25.5 DISPLAY_IDENTIFIER SmCrkCtl_NVM.Vxx_inj_sta_dly_NVM ECU_ADDRESS 0xd000321f FORMAT "%4.1" /end MEASUREMENT
/begin MEASUREMENT Vxx_rest_ufld_ctr "Unflooding counter" UBYTE _CNV_A_R_ECME_LINEA_0_CM 1 0. 0. 255. DISPLAY_IDENTIFIER SmCrkCtl_NVM.Vxx_rest_ufld_ctr_NVM ECU_ADDRESS 0xd0003220 FORMAT "%3.0" /end MEASUREMENT
/begin MEASUREMENT Vxx_mem_rest_cor "Memorized (EEPROM) fuel Injection Mass correction factor for Re-Start" UWORD _CNV_A_R_LINEAR_____125_CM 1 0. 0. 1. DISPLAY_IDENTIFIER SmCrkCtl_NVM.Vxx_mem_rest_cor_NVM ECU_ADDRESS 0xd0003222 FORMAT "%11.9" /end MEASUREMENT
/begin MEASUREMENT Vxx_mem_rest_tco "Memorized (EEPROM) engine coolant temperature" UWORD _CNV_A_R_LINEAR_____54_CM 1 0. -40. 200. DISPLAY_IDENTIFIER SmCrkCtl_NVM.Vxx_mem_rest_tco_NVM ECU_ADDRESS 0xd0003224 FORMAT "%5.1" /end MEASUREMENT
/begin CHARACTERISTIC Ctp_tco_inj_sta_dly "Ctp_tco_inj_sta_dly : Maximum duration of Injection Start State coolant temperature dependant table" CURVE 0xa002628c _REC_A1CUR_20_u1_u2 25.5 _CNV_A_R_LINEAR_____4_CM 0. 25.5 FORMAT "%4.1"
 /begin AXIS_DESCR COM_AXIS Vxx_tco _CNV_A_R_LINEAR_____54_CM 9 -40. 200. FORMAT "%5.1" AXIS_PTS_REF Ctb_tco2 /end AXIS_DESCR
/end CHARACTERISTIC
/begin CHARACTERISTIC Ctp_tco_out_inj_sta_n_thd "Engine speed threshold for out of injection starting state" CURVE 0xa0026298 _REC_A1CUR_20_u2_u2 16383.75 _CNV_A_R_ENSD_LINEA_24_CM 0. 16383.75 FORMAT "%8.2"
 /begin AXIS_DESCR COM_AXIS Vxx_tco _CNV_A_R_LINEAR_____54_CM 8 -40. 200. FORMAT "%5.1" AXIS_PTS_REF Ctb_sta_tco /end AXIS_DESCR
/end CHARACTERISTIC
/begin AXIS_PTS Ctb_rest_ufld_ctr "Unflooding counter breakpoints" 0xa0029060 Vxx_rest_ufld_ctr _REC_A2AXS_20_u1 255. _CNV_A_R_ECME_LINEA_0_CM 9 0. 255. FORMAT "%3.0" /end AXIS_PTS
/begin CHARACTERISTIC Ctp_tco_min_rest_cor "Additive correction to the restart correction factor to avoid a too powerfull injection correction" CURVE 0xa002906c _REC_A1CUR_20_u1_u2 0.99609375 _CNV_A_R_LINEAR_____227_CM 3.90625e-003 1. FORMAT "%12.8"
 /begin AXIS_DESCR COM_AXIS Vxx_tco _CNV_A_R_LINEAR_____54_CM 9 -40. 200. FORMAT "%5.1" AXIS_PTS_REF Ctb_tco2 /end AXIS_DESCR
/end CHARACTERISTIC
/begin CHARACTERISTIC Ctp_ufld_rest_cor "Additive correction to the restart correction factor table dependant on the unflooding counter" CURVE 0xa0029078 _REC_A1CUR_20_u1_u1 0.99609375 _CNV_A_R_LINEAR_____31_CM 0. 0.99609375 FORMAT "%10.8"
 /begin AXIS_DESCR COM_AXIS Vxx_rest_ufld_ctr _CNV_A_R_ECME_LINEA_0_CM 9 0. 255. FORMAT "%3.0" AXIS_PTS_REF Ctb_rest_ufld_ctr /end AXIS_DESCR
/end CHARACTERISTIC
/begin MEASUREMENT Vbx_ctr_act "Reactivation of the unflooding counter during starting state" UBYTE _CNV_S_2_RANGE______3_CM 1 0. 0. 1. ECU_ADDRESS 0xd000487e BIT_MASK 0x1 /end MEASUREMENT
/begin MEASUREMENT Vbx_equ_tco "Boolean indicates that TCO had not change a lot since the last engine start." UBYTE _CNV_S_2_RANGE______3_CM 1 0. 0. 1. ECU_ADDRESS 0xd000487f BIT_MASK 0x1 /end MEASUREMENT
/begin MEASUREMENT Vbx_rest_set_pws "Retention of the power supply for restart" UBYTE _CNV_S_2_RANGE______3_CM 1 0. 0. 1. ECU_ADDRESS 0xd0004880 BIT_MASK 0x1 /end MEASUREMENT
/begin MEASUREMENT Vbx_t_ufld_ctr "Boolean indicating that the unflooding counter incrementation is temporal." UBYTE _CNV_S_2_RANGE______3_CM 1 0. 0. 1. ECU_ADDRESS 0xd0004881 BIT_MASK 0x1 /end MEASUREMENT
/begin MEASUREMENT Vbx_tdc_ufld_ctr "Boolean indicating that the unflooding counter incrementation is by tdc." UBYTE _CNV_S_2_RANGE______3_CM 1 0. 0. 1. ECU_ADDRESS 0xd0004882 BIT_MASK 0x1 /end MEASUREMENT
/begin MEASUREMENT Vsx_rst "Restart strategy States" UBYTE _CNV_S_4_RANGE_RESE_258_CM 1 0. 2. 16. ECU_ADDRESS 0xd0004883 /end MEASUREMENT
/begin MEASUREMENT Vxx_appl_rest_cor "Fuel Injection Mass correction factor for Re-Start" UWORD _CNV_A_R_LINEAR_____125_CM 1 0. 0. 1. ECU_ADDRESS 0xd000487a FORMAT "%11.9" /end MEASUREMENT
/begin MEASUREMENT Vxx_ref_rest_cor "Fuel Injection Mass reference correction factor for Re-Start" UWORD _CNV_A_R_LINEAR_____125_CM 1 0. 0. 1. ECU_ADDRESS 0xd000487c FORMAT "%11.9" /end MEASUREMENT
/begin CHARACTERISTIC Cxx_rest1_ufld_cor "First start correction factor" VALUE 0xa0021a52 _REC_S1VAL_20_u1 0.99609375 _CNV_A_R_LINEAR_____227_CM 3.90625e-003 1. FORMAT "%12.8" /end CHARACTERISTIC
/begin CHARACTERISTIC Cxx_rest_tco_l_ofs "Low tco offset on the memorized tco to detect tco evolution since last engine start" VALUE 0xa0021a4c _REC_S1VAL_20_u2 240. _CNV_A_R_LINEAR_____54_CM -40. 200. FORMAT "%5.1" /end CHARACTERISTIC
/begin CHARACTERISTIC Cxx_rest_tco_up_ofs "High tco offset on the memorized tco to detect tco evolution since last engine start" VALUE 0xa0021a4e _REC_S1VAL_20_u2 240. _CNV_A_R_LINEAR_____54_CM -40. 200. FORMAT "%5.1" /end CHARACTERISTIC
/begin CHARACTERISTIC Cxx_rest_ufld_cor "Successive restarts correction factor" VALUE 0xa0021a53 _REC_S1VAL_20_u1 0.99609375 _CNV_A_R_LINEAR_____227_CM 3.90625e-003 1. FORMAT "%12.8" /end CHARACTERISTIC
/begin CHARACTERISTIC Cxx_run_ufld_ctr_inc1 "Number of tdc to count between two unflooding counter incrementations (validity during the beginning of running only)" VALUE 0xa0021a54 _REC_S1VAL_20_u1 255. _CNV_A_R_LINEAR_____55_CM 0. 255. FORMAT "%3.0" /end CHARACTERISTIC
/begin CHARACTERISTIC Cxx_run_ufld_ctr_inc2 "Number of tdc to count between two unflooding counter incrementations (valid only after a delay)" VALUE 0xa0021a55 _REC_S1VAL_20_u1 255. _CNV_A_R_LINEAR_____55_CM 0. 255. FORMAT "%3.0" /end CHARACTERISTIC
/begin CHARACTERISTIC Cxx_stal_rest_fac "Specific restart correction after engine stall" VALUE 0xa0021a56 _REC_S1VAL_20_u1 0.99609375 _CNV_A_R_LINEAR_____227_CM 3.90625e-003 1. FORMAT "%12.8" /end CHARACTERISTIC
/begin CHARACTERISTIC Cxx_stop_rest_tco_thd "TCO value inhibiting the restart strategy" VALUE 0xa0021a50 _REC_S1VAL_20_u2 240. _CNV_A_R_LINEAR_____54_CM -40. 200. FORMAT "%5.1" /end CHARACTERISTIC
/begin CHARACTERISTIC Cxx_stop_rest_ufld_thd "Unflooding counter value inhibiting the specific maintain of ECU power supply " VALUE 0xa0021a57 _REC_S1VAL_20_u1 255. _CNV_A_R_ECME_LINEA_0_CM 0. 255. FORMAT "%3.0" /end CHARACTERISTIC
/begin CHARACTERISTIC Cxx_stop_ufld_ctr_inc "Time to count between two unflooding counter incrementations (when engine is not running)" VALUE 0xa0021a58 _REC_S1VAL_20_u1 51. _CNV_A_R_LINEAR_____259_CM 0. 51. FORMAT "%4.1" /end CHARACTERISTIC
/begin AXIS_PTS Ntb_mat "air temperature breakpoints table (17 breakpoints) [-40 -30 -20 -10 0 10 20 30 40 50 60 70 80 90 100 110 120]" 0xa0023a9c Vxx_mat _REC_A2AXS_20_u2 240. _CNV_A_R_LINEAR_____54_CM 17 -40. 200. READ_ONLY FORMAT "%5.1" /end AXIS_PTS
/begin AXIS_PTS Ntb_tco "water temperature breakpoints table (17 breakpoints) [-40 -30 -20 -10 0 10 20 30 40 50 60 70 80 90 100 110 120]" 0xa0023ac0 Vxx_tco _REC_A2AXS_20_u2 240. _CNV_A_R_LINEAR_____54_CM 17 -40. 200. READ_ONLY FORMAT "%5.1" /end AXIS_PTS
/begin CHARACTERISTIC Cmp_n_prs_lean_ti_ofs "MAP giving the richness offset for the lean mode" MAP 0xa0023ae4 _REC_A1MAP_20_u1_u2_u2 0.99609375 _CNV_A_R_LINEAR_____260_CM -0.5 0.49609375 FORMAT "%9.6"
 /begin AXIS_DESCR COM_AXIS Vxx_n _CNV_A_R_ENSD_LINEA_24_CM 20 0. 16383.75 FORMAT "%8.2" AXIS_PTS_REF Ctb_n /end AXIS_DESCR
 /begin AXIS_DESCR COM_AXIS Vxx_eal _CNV_A_R_LINEAR_____53_CM 16 0. 3.99993896484375 FORMAT "%10.8" AXIS_PTS_REF Ctb_eal /end AXIS_DESCR
/end CHARACTERISTIC
/begin CHARACTERISTIC Cmp_n_prs_tco_ti_fac "MAP giving the the correction factor for the K offset depending on RPM and EAL" MAP 0xa0023c24 _REC_A1MAP_20_u1_u2_u2 1.9921875 _CNV_A_R_LINEAR_____187_CM -1. 0.9921875 FORMAT "%9.6"
 /begin AXIS_DESCR COM_AXIS Vxx_n _CNV_A_R_ENSD_LINEA_24_CM 20 0. 16383.75 FORMAT "%8.2" AXIS_PTS_REF Ctb_n /end AXIS_DESCR
 /begin AXIS_DESCR COM_AXIS Vxx_eal _CNV_A_R_LINEAR_____53_CM 16 0. 3.99993896484375 FORMAT "%10.8" AXIS_PTS_REF Ctb_eal /end AXIS_DESCR
/end CHARACTERISTIC
/begin CHARACTERISTIC Ctp_tco_lean_ti_ofs "additionnal offset depending on the water temperature for the lean mode" CURVE 0xa0023d64 _REC_A1CUR_20_u1_u2 0.99609375 _CNV_A_R_LINEAR_____260_CM -0.5 0.49609375 FORMAT "%9.6"
 /begin AXIS_DESCR COM_AXIS Vxx_tco _CNV_A_R_LINEAR_____54_CM 17 -40. 200. READ_ONLY FORMAT "%5.1" AXIS_PTS_REF Ntb_tco /end AXIS_DESCR
/end CHARACTERISTIC
/begin CHARACTERISTIC Ctp_tco_sta_rich_dec "Table giving the number of tdc between 2 decrease of the A offset (if initialized with the water temperature)" CURVE 0xa0023d78 _REC_A1CUR_20_u1_u2 255. _CNV_A_R_LINEAR_____55_CM 0. 255. FORMAT "%3.0"
 /begin AXIS_DESCR COM_AXIS Vxx_tco _CNV_A_R_LINEAR_____54_CM 17 -40. 200. READ_ONLY FORMAT "%5.1" AXIS_PTS_REF Ntb_tco /end AXIS_DESCR
/end CHARACTERISTIC
/begin CHARACTERISTIC Ctp_tco_sta_ti_ofs "table giving the initial A offset depending on the water temperature" CURVE 0xa0023d8c _REC_A1CUR_20_u1_u2 1.9921875 _CNV_A_R_LINEAR_____43_CM 0. 1.9921875 FORMAT "%8.6"
 /begin AXIS_DESCR COM_AXIS Vxx_tco _CNV_A_R_LINEAR_____54_CM 17 -40. 200. READ_ONLY FORMAT "%5.1" AXIS_PTS_REF Ntb_tco /end AXIS_DESCR
/end CHARACTERISTIC
/begin CHARACTERISTIC Ctp_tco_ti_ofs1 "Table giving the B offset depending on the water temperature" CURVE 0xa0023da0 _REC_A1CUR_20_u1_u2 1.9921875 _CNV_A_R_LINEAR_____43_CM 0. 1.9921875 FORMAT "%8.6"
 /begin AXIS_DESCR COM_AXIS Vxx_tco _CNV_A_R_LINEAR_____54_CM 17 -40. 200. READ_ONLY FORMAT "%5.1" AXIS_PTS_REF Ntb_tco /end AXIS_DESCR
/end CHARACTERISTIC
/begin CHARACTERISTIC Ctp_tco_ti_ofs2 "Table giving the K offset depending on the water temperature" CURVE 0xa0023db4 _REC_A1CUR_20_u1_u2 0.99609375 _CNV_A_R_LINEAR_____31_CM 0. 0.99609375 FORMAT "%5.3"
 /begin AXIS_DESCR COM_AXIS Vxx_tco _CNV_A_R_LINEAR_____54_CM 17 -40. 200. READ_ONLY FORMAT "%5.1" AXIS_PTS_REF Ntb_tco /end AXIS_DESCR
/end CHARACTERISTIC
/begin CHARACTERISTIC Ctp_tia_sta_ti_ofs "table giving the initial A offset depending on the air temperature" CURVE 0xa0023dc8 _REC_A1CUR_20_u1_u2 1.9921875 _CNV_A_R_LINEAR_____43_CM 0. 1.9921875 FORMAT "%8.6"
 /begin AXIS_DESCR COM_AXIS Vxx_mat _CNV_A_R_LINEAR_____54_CM 17 -40. 200. READ_ONLY FORMAT "%5.1" AXIS_PTS_REF Ntb_mat /end AXIS_DESCR
/end CHARACTERISTIC
/begin MEASUREMENT Vbx_cata_wup_lean "Boolean of learn burn catalyst heating conditions" UBYTE _CNV_S_2_RANGE______3_CM 1 0. 0. 1. ECU_ADDRESS 0xd000430a BIT_MASK 0x1 /end MEASUREMENT
/begin MEASUREMENT Vbx_sta_tco_ti_ofs_mod "choice to initialize the A factor with a term depending on the water temperature " UBYTE _CNV_S_2_RANGE______3_CM 1 0. 0. 1. ECU_ADDRESS 0xd00056a7 BIT_MASK 0x1 /end MEASUREMENT
/begin MEASUREMENT Vbx_ti_cor_rest_pws_set "request of maintaining the microcontroller power suplly for a specific richness correction in case of restart" UBYTE _CNV_S_2_RANGE______3_CM 1 0. 0. 1. ECU_ADDRESS 0xd000430b BIT_MASK 0x1 /end MEASUREMENT
/begin MEASUREMENT Vxx_sta_rich_tdc_dec_nr "frequency of A offset decrementation (every X tdc)" UBYTE _CNV_A_R_LINEAR_____55_CM 1 0. 0. 255. ECU_ADDRESS 0xd000430c FORMAT "%3.0" /end MEASUREMENT
/begin MEASUREMENT Vxx_sta_tco_ti_ofs "after start richness factor" UWORD _CNV_A_R_LINEAR_____49_CM 1 0. 0. 1.99996948242188 ECU_ADDRESS 0xd0003644 FORMAT "%7.5" /end MEASUREMENT
/begin MEASUREMENT Vxx_sta_tco_ti_ofs_init "Initial A offset after the starting mode" UBYTE _CNV_A_R_LINEAR_____43_CM 1 0. 0. 1.9921875 ECU_ADDRESS 0xd000430d FORMAT "%8.6" /end MEASUREMENT
/begin MEASUREMENT Vxx_tco_lean_ti_fac "final richness factor in lean mode" UBYTE _CNV_A_R_LINEAR_____43_CM 1 0. 0. 1.9921875 ECU_ADDRESS 0xd000430e FORMAT "%8.6" /end MEASUREMENT
/begin MEASUREMENT Vxx_tco_rich_ti_fac "final richness factor in rich mode" UWORD _CNV_A_R_LINEAR_____261_CM 1 0. 0.5 4.49993896484375 ECU_ADDRESS 0xd0003646 FORMAT "%10.8" /end MEASUREMENT
/begin MEASUREMENT Vxx_tco_ti_cor "final richness factor in cold water temperature conditions" UWORD _CNV_A_R_LINEAR_____261_CM 1 0. 0.5 4.49993896484375 ECU_ADDRESS 0xd0003648 FORMAT "%10.8" /end MEASUREMENT
/begin MEASUREMENT Vxx_tco_ti_cor_fil_ctr "transition factor for the lean mode <--> rich mode transition" UBYTE _CNV_A_R_LINEAR_____118_CM 1 0. 0. 1. ECU_ADDRESS 0xd000430f FORMAT "%9.7" /end MEASUREMENT
/begin MEASUREMENT Vxx_tco_ti_fac "C factor" UBYTE _CNV_A_R_LINEAR_____187_CM 1 0. -1. 0.9921875 ECU_ADDRESS 0xd0004310 FORMAT "%9.6" /end MEASUREMENT
/begin MEASUREMENT Vxx_tco_ti_ofs1 "B offset" UBYTE _CNV_A_R_LINEAR_____43_CM 1 0. 0. 1.9921875 ECU_ADDRESS 0xd00056a8 FORMAT "%8.6" /end MEASUREMENT
/begin MEASUREMENT Vxx_tco_ti_ofs2 "K offset" UBYTE _CNV_A_R_LINEAR_____31_CM 1 0. 0. 0.99609375 ECU_ADDRESS 0xd00056a9 FORMAT "%5.3" /end MEASUREMENT
/begin CHARACTERISTIC Cxx_aper_rich_sta_tco_thd "water temperature under wich an overrichness is wanted (if no percolation stop)" VALUE 0xa00214d4 _REC_S1VAL_20_u2 240. _CNV_A_R_LINEAR_____54_CM -40. 200. FORMAT "%5.1" /end CHARACTERISTIC
/begin CHARACTERISTIC Cxx_aper_rich_sta_tia_thd "air temperature over which an overrichness is wanted (if percolation stop)" VALUE 0xa00214d6 _REC_S1VAL_20_u2 240. _CNV_A_R_LINEAR_____54_CM -40. 200. FORMAT "%5.1" /end CHARACTERISTIC
/begin CHARACTERISTIC Cxx_rest_mod_dsb_max_dly "maximum delay during which the A offset can't be initialized with the water temperature richness table if the anti-percolation fonction hasn't be enabled" VALUE 0xa00214d8 _REC_S1VAL_20_u2 6553.5 _CNV_A_R_LINEAR_____4_CM 0. 6553.5 FORMAT "%6.1" /end CHARACTERISTIC
/begin CHARACTERISTIC Cxx_rest_mod_dsb_tco_thd "Water temperature under which the engine can restart with the air temperature richness table" VALUE 0xa00214da _REC_S1VAL_20_u2 240. _CNV_A_R_LINEAR_____54_CM -40. 200. FORMAT "%5.1" /end CHARACTERISTIC
/begin CHARACTERISTIC Cxx_rich_sta_tco_thd "water temperature over wich an overrichness is wanted (if percolation stop)" VALUE 0xa00214dc _REC_S1VAL_20_u2 240. _CNV_A_R_LINEAR_____54_CM -40. 200. FORMAT "%5.1" /end CHARACTERISTIC
/begin CHARACTERISTIC Cxx_rich_tia_thd "air temperature over wich an overrichness is wanted (if no percolation stop)" VALUE 0xa00214de _REC_S1VAL_20_u2 240. _CNV_A_R_LINEAR_____54_CM -40. 200. FORMAT "%5.1" /end CHARACTERISTIC
/begin CHARACTERISTIC Cxx_sta_rich_dec_nr "Number of tdc between 2 decrease of the A offset (if initialized with the air temperature)" VALUE 0xa00214e0 _REC_S1VAL_20_u1 255. _CNV_A_R_LINEAR_____55_CM 0. 255. FORMAT "%3.0" /end CHARACTERISTIC
/begin CHARACTERISTIC Cxx_sta_tco_ti_dec_fac "decreasing factor for the calculation of the A offset" VALUE 0xa00214e1 _REC_S1VAL_20_u1 0.99609375 _CNV_A_R_LINEAR_____31_CM 0. 0.99609375 FORMAT "%10.8" /end CHARACTERISTIC
/begin CHARACTERISTIC Cxx_sta_tco_ti_dec_fac_alco "decreasing factor for the calculation of the A offset for flex-fuel." VALUE 0xa00214e2 _REC_S1VAL_20_u1 0.99609375 _CNV_A_R_LINEAR_____31_CM 0. 0.99609375 FORMAT "%10.8" /end CHARACTERISTIC
/begin CHARACTERISTIC Cxx_sta_tco_ti_dec_rest_fac "Weight factor on the restart correction of the A-offset decrease (after Start)" VALUE 0xa00214e3 _REC_S1VAL_20_u1 1.9921875 _CNV_A_R_LINEAR_____187_CM -1. 0.9921875 FORMAT "%9.6" /end CHARACTERISTIC
/begin CHARACTERISTIC Cxx_sta_tco_ti_rest_fac "Ponderation factor applied on the correction factor for Re-start (Vxx_appl_rest_cor)" VALUE 0xa00214e4 _REC_S1VAL_20_u1 0.99609375 _CNV_A_R_LINEAR_____31_CM 0. 0.99609375 FORMAT "%10.8" /end CHARACTERISTIC
/begin CHARACTERISTIC Cxx_tco_ti_fil_nr "Value of decrease for the lean richness factor" VALUE 0xa00214e5 _REC_S1VAL_20_u1 0.99609375 _CNV_A_R_LINEAR_____31_CM 0. 0.99609375 FORMAT "%10.8" /end CHARACTERISTIC
/begin AXIS_PTS Ctb_n_sta "Engine speed breakpoints for the fuel injection mass calculation during start" 0xa00298ec Vxx_n _REC_A2AXS_20_u2 16383.75 _CNV_A_R_ENSD_LINEA_24_CM 9 0. 16383.75 FORMAT "%8.2" /end AXIS_PTS
/begin CHARACTERISTIC Ctp_n_sta_fim_fac "Engine speed dependant correction for fuel injection mass calculation during start" CURVE 0xa0029900 _REC_A1CUR_20_u1_u2 0.99609375 _CNV_A_R_LINEAR_____31_CM 0. 0.99609375 FORMAT "%5.3"
 /begin AXIS_DESCR COM_AXIS Vxx_n _CNV_A_R_ENSD_LINEA_24_CM 9 0. 16383.75 FORMAT "%8.2" AXIS_PTS_REF Ctb_n_sta /end AXIS_DESCR
/end CHARACTERISTIC
/begin CHARACTERISTIC Ctp_tco_dec_sta_fim "Cooling temperature dependant decrementation value of Fuel Injection Mass just after start" CURVE 0xa002990c _REC_A1CUR_20_u2_u2 167.7696 _CNV_A_R_LINEAR_____83_CM 0. 167.7696 FORMAT "%9.5"
 /begin AXIS_DESCR COM_AXIS Vxx_tco _CNV_A_R_LINEAR_____54_CM 16 -40. 200. FORMAT "%5.1" AXIS_PTS_REF Ctb_tco /end AXIS_DESCR
/end CHARACTERISTIC
/begin CHARACTERISTIC Ctp_tco_sta_fim "Cooling temperature dependant table for Fuel Injection Mass during start" CURVE 0xa002992c _REC_A1CUR_20_u2_u2 4799.93856 _CNV_A_R_LINEAR_____262_CM 0. 4799.93856 FORMAT "%7.2"
 /begin AXIS_DESCR COM_AXIS Vxx_tco _CNV_A_R_LINEAR_____54_CM 16 -40. 200. FORMAT "%5.1" AXIS_PTS_REF Ctb_tco /end AXIS_DESCR
/end CHARACTERISTIC
/begin MEASUREMENT Vbx_tdc_sta_fim_ena "Boolean enabling sta_fim decrementation at TDC" UBYTE _CNV_S_2_RANGE______3_CM 1 0. 0. 1. ECU_ADDRESS 0xd0004c5c BIT_MASK 0x1 /end MEASUREMENT
/begin MEASUREMENT Vxx_dec_sta_fim "Fuel injection Mass decrementation just after start" UWORD _CNV_A_R_LINEAR_____83_CM 1 0. 0. 167.7696 ECU_ADDRESS 0xd0002fbe FORMAT "%9.5" /end MEASUREMENT
/begin MEASUREMENT Vxx_sta_fim "Injected fuel mass setpoint disrigarding cylinder (wall wetting to be added) for start" ULONG _CNV_A_R_LINEAR_____83_CM 1 0. 0. 4800. ECU_ADDRESS 0xd0001854 FORMAT "%14.5" /end MEASUREMENT
/begin CHARACTERISTIC Cxx_dec_sta_ti_rest_fac "Starting fuel mass Decrementation restart factor" VALUE 0xa00207b9 _REC_S1VAL_20_u1 1.9921875 _CNV_A_R_LINEAR_____187_CM -1. 0.9921875 FORMAT "%9.6" /end CHARACTERISTIC
/begin AXIS_PTS Ctb_eal_cylr "Table of 17 eal breakpoints specific for cylinder recognition" 0xa002b4a0 Vxx_eal _REC_A2AXS_20_u2 3.99993896484375 _CNV_A_R_LINEAR_____53_CM 17 0. 3.99993896484375 FORMAT "%7.5" /end AXIS_PTS
/begin AXIS_PTS Ctb_n_cylr "Table of 9 engine speed breakpoints specific for cylinder recognition" 0xa002b4c4 Vxx_n _REC_A2AXS_20_u2 16383.75 _CNV_A_R_ENSD_LINEA_24_CM 9 0. 16383.75 FORMAT "%8.2" /end AXIS_PTS
/begin AXIS_PTS Ctb_tco_ti_fac2 "A 9 water enrichment factor breackpoints table " 0xa002b4d8 Vxx_tco_ti_cor _REC_A2AXS_20_u2 3.99993896484375 _CNV_A_R_LINEAR_____261_CM 9 0.5 4.49993896484375 FORMAT "%10.8" /end AXIS_PTS
/begin CHARACTERISTIC Cmp_eal_n_lean_cylr "Map of the lean richness factor during cylinder recognition" MAP 0xa002b4ec _REC_A1MAP_20_u1_u2_u2 0.99609375 _CNV_A_R_LINEAR_____227_CM 3.90625e-003 1. FORMAT "%12.8"
 /begin AXIS_DESCR COM_AXIS Vxx_eal _CNV_A_R_LINEAR_____53_CM 17 0. 3.99993896484375 FORMAT "%7.5" AXIS_PTS_REF Ctb_eal_cylr /end AXIS_DESCR
 /begin AXIS_DESCR COM_AXIS Vxx_n _CNV_A_R_ENSD_LINEA_24_CM 9 0. 16383.75 FORMAT "%8.2" AXIS_PTS_REF Ctb_n_cylr /end AXIS_DESCR
/end CHARACTERISTIC
/begin CHARACTERISTIC Cmp_eal_n_rich_cylr "Map of the rich richness factor during cylinder recognition" MAP 0xa002b588 _REC_A1MAP_20_u1_u2_u2 0.99609375 _CNV_A_R_LINEAR_____102_CM 1. 1.99609375 FORMAT "%10.8"
 /begin AXIS_DESCR COM_AXIS Vxx_eal _CNV_A_R_LINEAR_____53_CM 17 0. 3.99993896484375 FORMAT "%7.5" AXIS_PTS_REF Ctb_eal_cylr /end AXIS_DESCR
 /begin AXIS_DESCR COM_AXIS Vxx_n _CNV_A_R_ENSD_LINEA_24_CM 9 0. 16383.75 FORMAT "%8.2" AXIS_PTS_REF Ctb_n_cylr /end AXIS_DESCR
/end CHARACTERISTIC
/begin CHARACTERISTIC Ctp_cl_is_lean_cylr "Richness factor for lean cylinders during cylinder recognition, Iddle Speed and closed loop" CURVE 0xa002b624 _REC_A1CUR_20_u1_u2 0.99609375 _CNV_A_R_LINEAR_____227_CM 3.90625e-003 1. FORMAT "%12.8"
 /begin AXIS_DESCR COM_AXIS Vxx_tco _CNV_A_R_LINEAR_____54_CM 9 -40. 200. FORMAT "%5.1" AXIS_PTS_REF Ctb_tco2 /end AXIS_DESCR
/end CHARACTERISTIC
/begin CHARACTERISTIC Ctp_cl_is_rich_cylr "Richness factor for rich cylinders during cylinder recognition, Iddle Speed and closed loop" CURVE 0xa002b630 _REC_A1CUR_20_u1_u2 0.99609375 _CNV_A_R_LINEAR_____102_CM 1. 1.99609375 FORMAT "%10.8"
 /begin AXIS_DESCR COM_AXIS Vxx_tco _CNV_A_R_LINEAR_____54_CM 9 -40. 200. FORMAT "%5.1" AXIS_PTS_REF Ctb_tco2 /end AXIS_DESCR
/end CHARACTERISTIC
/begin CHARACTERISTIC Ctp_ol_is_lean_cylr "Richness factor for lean cylinders during cylinder recognition, Iddle Speed and open loop" CURVE 0xa002b63c _REC_A1CUR_20_u1_u2 0.99609375 _CNV_A_R_LINEAR_____227_CM 3.90625e-003 1. FORMAT "%12.8"
 /begin AXIS_DESCR COM_AXIS Vxx_tco _CNV_A_R_LINEAR_____54_CM 9 -40. 200. FORMAT "%5.1" AXIS_PTS_REF Ctb_tco2 /end AXIS_DESCR
/end CHARACTERISTIC
/begin CHARACTERISTIC Ctp_ol_is_rich_cylr "Richness factor for rich cylinders during cylinder recognition, Iddle Speed and open loop" CURVE 0xa002b648 _REC_A1CUR_20_u1_u2 0.99609375 _CNV_A_R_LINEAR_____102_CM 1. 1.99609375 FORMAT "%10.8"
 /begin AXIS_DESCR COM_AXIS Vxx_tco _CNV_A_R_LINEAR_____54_CM 9 -40. 200. FORMAT "%5.1" AXIS_PTS_REF Ctb_tco2 /end AXIS_DESCR
/end CHARACTERISTIC
/begin CHARACTERISTIC Ctp_tco_lean_cylr "Richness factor for lean cylinders during cylinder recognition, engine cold and open loop" CURVE 0xa002b654 _REC_A1CUR_20_u1_u2 0.99609375 _CNV_A_R_LINEAR_____227_CM 3.90625e-003 1. FORMAT "%12.8"
 /begin AXIS_DESCR COM_AXIS Vxx_tco_ti_cor _CNV_A_R_LINEAR_____261_CM 9 0.5 4.49993896484375 FORMAT "%10.8" AXIS_PTS_REF Ctb_tco_ti_fac2 /end AXIS_DESCR
/end CHARACTERISTIC
/begin CHARACTERISTIC Ctp_tco_rich_cylr "Richness factor for rich cylinders during cylinder recognition, Engine cold and open loop" CURVE 0xa002b660 _REC_A1CUR_20_u1_u2 0.99609375 _CNV_A_R_LINEAR_____102_CM 1. 1.99609375 FORMAT "%10.8"
 /begin AXIS_DESCR COM_AXIS Vxx_tco_ti_cor _CNV_A_R_LINEAR_____261_CM 9 0.5 4.49993896484375 FORMAT "%10.8" AXIS_PTS_REF Ctb_tco_ti_fac2 /end AXIS_DESCR
/end CHARACTERISTIC
/begin CHARACTERISTIC Ctp_tco_sta_out_sfg_dly "Table giving the number of TDC  between start mode exit and first sequential transition" CURVE 0xa002b66c _REC_A1CUR_20_u1_u2 255. _CNV_A_R_LINEAR_____55_CM 0. 255. FORMAT "%3.0"
 /begin AXIS_DESCR COM_AXIS Vxx_tco _CNV_A_R_LINEAR_____54_CM 9 -40. 200. FORMAT "%5.1" AXIS_PTS_REF Ctb_tco2 /end AXIS_DESCR
/end CHARACTERISTIC
/begin MEASUREMENT Vbx_inj_efv_seq "Boolean indicating that sequential mode is activated on all cylinders" UBYTE _CNV_S_2_RANGE______3_CM 1 0. 0. 1. ECU_ADDRESS 0xd00040da BIT_MASK 0x1 /end MEASUREMENT
/begin MEASUREMENT Vsx_inj_stt "Injection mode." UWORD _CNV_A_R_ECME_LINEA_0_CM 1 0. 0. 65535. ECU_ADDRESS 0xd000301e FORMAT "%5.0" /end MEASUREMENT
/begin MEASUREMENT Vsx_inj_stt_cyl1 "Injection mode for cylinder 1." UWORD _CNV_A_R_ECME_LINEA_0_CM 1 0. 0. 65535. ECU_ADDRESS 0xd0003020 FORMAT "%5.0" /end MEASUREMENT
/begin MEASUREMENT Vsx_inj_stt_cyl2 "Injection mode for cylinder 2." UWORD _CNV_A_R_ECME_LINEA_0_CM 1 0. 0. 65535. ECU_ADDRESS 0xd0003022 FORMAT "%5.0" /end MEASUREMENT
/begin MEASUREMENT Vsx_inj_stt_cyl3 "Injection mode for cylinder 3." UWORD _CNV_A_R_ECME_LINEA_0_CM 1 0. 0. 65535. ECU_ADDRESS 0xd0003024 FORMAT "%5.0" /end MEASUREMENT
/begin MEASUREMENT Vsx_inj_stt_cyl4 "Injection mode for cylinder 4." UWORD _CNV_A_R_ECME_LINEA_0_CM 1 0. 0. 65535. ECU_ADDRESS 0xd0003026 FORMAT "%5.0" /end MEASUREMENT
/begin MEASUREMENT Vxx_adac_fim "Injected fuel mass for ADAC (fuel consumption)" ULONG _CNV_A_R_LINEAR_____83_CM 1 0. 0. 4800. ECU_ADDRESS 0xd00018fc FORMAT "%12.3" /end MEASUREMENT
/begin MEASUREMENT Vxx_cyl1_fim1 "Injected fuel mass on cylinder 1, first injection" ULONG _CNV_A_R_LINEAR_____83_CM 1 0. 0. 4800. ECU_ADDRESS 0xd0001900 FORMAT "%12.3" /end MEASUREMENT
/begin MEASUREMENT Vxx_cyl1_fim2 "Injected fuel mass on cylinder 1, second injection" ULONG _CNV_A_R_LINEAR_____83_CM 1 0. 0. 4800. ECU_ADDRESS 0xd0001904 FORMAT "%12.3" /end MEASUREMENT
/begin MEASUREMENT Vxx_cyl2_fim1 "Injected fuel mass on cylinder 2, first injection" ULONG _CNV_A_R_LINEAR_____83_CM 1 0. 0. 4800. ECU_ADDRESS 0xd0001908 FORMAT "%12.3" /end MEASUREMENT
/begin MEASUREMENT Vxx_cyl2_fim2 "Injected fuel mass on cylinder 2, second injection" ULONG _CNV_A_R_LINEAR_____83_CM 1 0. 0. 4800. ECU_ADDRESS 0xd000190c FORMAT "%12.3" /end MEASUREMENT
/begin MEASUREMENT Vxx_cyl3_fim1 "Injected fuel mass on cylinder 3, first injection" ULONG _CNV_A_R_LINEAR_____83_CM 1 0. 0. 4800. ECU_ADDRESS 0xd0001910 FORMAT "%12.3" /end MEASUREMENT
/begin MEASUREMENT Vxx_cyl3_fim2 "Injected fuel mass on cylinder 3, second injection" ULONG _CNV_A_R_LINEAR_____83_CM 1 0. 0. 4800. ECU_ADDRESS 0xd0001914 FORMAT "%12.3" /end MEASUREMENT
/begin MEASUREMENT Vxx_cyl4_fim1 "Injected fuel mass on cylinder 4, first injection" ULONG _CNV_A_R_LINEAR_____83_CM 1 0. 0. 4800. ECU_ADDRESS 0xd0001918 FORMAT "%12.3" /end MEASUREMENT
/begin MEASUREMENT Vxx_cyl4_fim2 "Injected fuel mass on cylinder 4, second injection" ULONG _CNV_A_R_LINEAR_____83_CM 1 0. 0. 4800. ECU_ADDRESS 0xd000191c FORMAT "%12.3" /end MEASUREMENT
/begin MEASUREMENT Vxx_cylr_lean_fac "Internal variable giving the lean richness factor depending on engine state for cyl reco." UBYTE _CNV_A_R_LINEAR_____227_CM 1 0. 3.90625e-003 1. ECU_ADDRESS 0xd00040db FORMAT "%12.8" /end MEASUREMENT
/begin MEASUREMENT Vxx_cylr_rich_fac "Internal variable giving the rich richness factor depending on engine state for cyl reco." UBYTE _CNV_A_R_LINEAR_____102_CM 1 0. 1. 1.99609375 ECU_ADDRESS 0xd00040dc FORMAT "%10.8" /end MEASUREMENT
/begin MEASUREMENT Vxx_sfg_seq_trs_ctr "TDC counter between the sfg to sequential transitions." UBYTE _CNV_A_R_LINEAR_____55_CM 1 0. 0. 255. ECU_ADDRESS 0xd00040dd FORMAT "%3.0" /end MEASUREMENT
/begin MEASUREMENT Vxx_sta_out_sfg_ti_ctr "TDC counter between start phase exit and first transition sfg to sequential" UBYTE _CNV_A_R_LINEAR_____55_CM 1 0. 0. 255. ECU_ADDRESS 0xd00040de FORMAT "%3.0" /end MEASUREMENT
/begin MEASUREMENT Vxx_sta_out_sfg_ti_ctr_ini "Init value for the TDC counter between start phase exit and first transition sfg to sequential" UBYTE _CNV_A_R_LINEAR_____55_CM 1 0. 0. 255. ECU_ADDRESS 0xd00040df FORMAT "%3.0" /end MEASUREMENT
/begin CHARACTERISTIC Cbx_inj_seq_sta "Engine will start in sequential injection mode instead of pre-inj & semi full group" VALUE 0xa0020fdc _REC_S1VAL_20_u1 1. _CNV_A_R_ECME_LINEA_0_CM 0. 1. FORMAT "%1.0" BIT_MASK 0x1 /end CHARACTERISTIC
/begin CHARACTERISTIC Cbx_inj_stt_tdc_ena "Activation of the computation of injection patterns at the event_tdc before sequential mode" VALUE 0xa0020fdd _REC_S1VAL_20_u1 1. _CNV_A_R_ECME_LINEA_0_CM 0. 1. FORMAT "%1.0" BIT_MASK 0x1 /end CHARACTERISTIC
/begin CHARACTERISTIC Cbx_sfg_bch_cfm "Disables the sequential mode after start" VALUE 0xa0020fde _REC_S1VAL_20_u1 1. _CNV_A_R_ECME_LINEA_0_CM 0. 1. FORMAT "%1.0" BIT_MASK 0x1 /end CHARACTERISTIC
/begin CHARACTERISTIC Cxx_cyl_nr "Number of cylinders" VALUE 0xa0020fdf _REC_S1VAL_20_u1 12. _CNV_A_R_ECME_LINEA_0_CM 0. 12. FORMAT "%2.0" /end CHARACTERISTIC
/begin CHARACTERISTIC Cxx_cylr_tco_thd "Coolant temp threshold underwhich cylinder recognition is in cold settings." VALUE 0xa0020fd8 _REC_S1VAL_20_u2 240. _CNV_A_R_LINEAR_____54_CM -40. 200. FORMAT "%5.1" /end CHARACTERISTIC
/begin CHARACTERISTIC Cxx_sfg_seq_trs_ctr "Number of TDC during sfg to sequential transition on each cylinder" VALUE 0xa0020fe0 _REC_S1VAL_20_u1 252. _CNV_A_R_LINEAR_____263_CM 0. 252. FORMAT "%4.0" /end CHARACTERISTIC
/begin CHARACTERISTIC Cxx_sfg_seq_trs_fim_fac "Factor applied on first injection during the transition cycle on an injector" VALUE 0xa0020fe1 _REC_S1VAL_20_u1 0.99609375 _CNV_A_R_LINEAR_____31_CM 0. 0.99609375 FORMAT "%10.8" /end CHARACTERISTIC
/begin CHARACTERISTIC Cxx_sfg_seq_trs_n_thd "Engine speed threshold over which sfg to sequential transition is authorized" VALUE 0xa0020fda _REC_S1VAL_20_u2 16383.75 _CNV_A_R_ENSD_LINEA_24_CM 0. 16383.75 FORMAT "%8.2" /end CHARACTERISTIC
/begin CHARACTERISTIC Cxx_tco_fail_sta_out_sfg_dly "Number of TDC between start mode exit and first sequential transition when failure on TCO" VALUE 0xa0020fe2 _REC_S1VAL_20_u1 255. _CNV_A_R_LINEAR_____55_CM 0. 255. FORMAT "%3.0" /end CHARACTERISTIC
/begin AXIS_PTS Ctb_vvtc_angl "16 breakpoints table for vvtc angle" 0xa002e30c Vxx_in_vvtc_angl _REC_A2AXS_20_u2 719.98 _CNV_A_R_LINEAR_____76_CM 6 0. 719.98 FORMAT "%6.2" /end AXIS_PTS
/begin CHARACTERISTIC Cmp_perf_inj_clos_angl "Engine speed and vvt angle dependant Injector Closure advance optimized for engine performance" MAP 0xa002e31c _REC_A1MAP_20_u1_u2_u2 765. _CNV_A_R_LINEAR_____264_CM 0. 765. FORMAT "%3.0"
 /begin AXIS_DESCR COM_AXIS Vxx_n _CNV_A_R_ENSD_LINEA_24_CM 20 0. 16383.75 FORMAT "%8.2" AXIS_PTS_REF Ctb_n /end AXIS_DESCR
 /begin AXIS_DESCR COM_AXIS Vxx_in_vvtc_angl _CNV_A_R_LINEAR_____76_CM 6 0. 719.98 FORMAT "%6.2" AXIS_PTS_REF Ctb_vvtc_angl /end AXIS_DESCR
/end CHARACTERISTIC
/begin CHARACTERISTIC Cmp_polu_inj_clos_angl "Engine speed and vvtc angle dependant Injector Closure advance optimized to minimize polution" MAP 0xa002e394 _REC_A1MAP_20_u1_u2_u2 765. _CNV_A_R_LINEAR_____264_CM 0. 765. FORMAT "%3.0"
 /begin AXIS_DESCR COM_AXIS Vxx_n _CNV_A_R_ENSD_LINEA_24_CM 20 0. 16383.75 FORMAT "%8.2" AXIS_PTS_REF Ctb_n /end AXIS_DESCR
 /begin AXIS_DESCR COM_AXIS Vxx_in_vvtc_angl _CNV_A_R_LINEAR_____76_CM 6 0. 719.98 FORMAT "%6.2" AXIS_PTS_REF Ctb_vvtc_angl /end AXIS_DESCR
/end CHARACTERISTIC
/begin CHARACTERISTIC Ctp_n_clos_angl_tq_rat_thd "Table depending on engine speed giving the torque ratio threshold to " CURVE 0xa002e40c _REC_A1CUR_20_u2_u2 1. _CNV_A_R_LINEAR_____125_CM 0. 1. FORMAT "%11.9"
 /begin AXIS_DESCR COM_AXIS Vxx_n _CNV_A_R_ENSD_LINEA_24_CM 20 0. 16383.75 FORMAT "%8.2" AXIS_PTS_REF Ctb_n /end AXIS_DESCR
/end CHARACTERISTIC
/begin MEASUREMENT Vxx_fil_inj_clos_angl_fac "Filtering factor to switch between polu and perfo closure advance tables" SWORD _CNV_A_R_LINEAR_____31_CM 1 0. 0. 1. ECU_ADDRESS 0xd000348a FORMAT "%9.6" /end MEASUREMENT
/begin MEASUREMENT Vxx_fil_inj_clos_angl_fac_inc "Filtering factor incrementation (or dec.) to switch between perfo and polu closure advance tables" SWORD _CNV_A_R_LINEAR_____31_CM 1 0. -1. 1. ECU_ADDRESS 0xd000348c FORMAT "%9.6" /end MEASUREMENT
/begin MEASUREMENT Vxx_inj_clos_angl "Injector closure advance set point" UBYTE _CNV_A_R_LINEAR_____264_CM 1 0. 0. 765. ECU_ADDRESS 0xd000497a FORMAT "%3.0" /end MEASUREMENT
/begin CHARACTERISTIC Cbx_inj_clos_angl_bch_cfm "Bench mode selection for injector closure advance" VALUE 0xa0021a92 _REC_S1VAL_20_u1 1. _CNV_A_R_ECME_LINEA_0_CM 0. 1. FORMAT "%1.0" BIT_MASK 0x1 /end CHARACTERISTIC
/begin CHARACTERISTIC Cxx_fil_perf_clos_angl_tdc_nr "TDC number to count in order to switch from polu to perfo injector closure advance tables" VALUE 0xa0021a8c _REC_S1VAL_20_u2 255. _CNV_A_R_ECME_LINEA_0_CM 1. 256. FORMAT "%5.0" /end CHARACTERISTIC
/begin CHARACTERISTIC Cxx_fil_polu_clos_angl_tdc_nr "TDC number to count in order to switch from perfo to polu injector closure advance tables" VALUE 0xa0021a8e _REC_S1VAL_20_u2 255. _CNV_A_R_ECME_LINEA_0_CM 1. 256. FORMAT "%5.0" /end CHARACTERISTIC
/begin CHARACTERISTIC Cxx_inj_clos_angl_bch "Injector closure advance for bench mode" VALUE 0xa0021a93 _REC_S1VAL_20_u1 765. _CNV_A_R_LINEAR_____264_CM 0. 765. FORMAT "%3.0" /end CHARACTERISTIC
/begin CHARACTERISTIC Cxx_perf_inj_tco_thd "Minimum coolant temperature available for using perfo Injector Closure advance table" VALUE 0xa0021a90 _REC_S1VAL_20_u2 240. _CNV_A_R_LINEAR_____54_CM -40. 200. FORMAT "%5.1" /end CHARACTERISTIC
/begin MEASUREMENT Vxx_fim_sp "Injected fuel mass setpoint disrigarding cylinder (wall wetting to be added)" ULONG _CNV_A_R_LINEAR_____83_CM 1 0. 0. 4800. ECU_ADDRESS 0xd0001960 FORMAT "%12.3" /end MEASUREMENT
/begin MEASUREMENT Vxx_rich_sp "Estimated richness setpoint." UWORD _CNV_A_R_LINEAR_____49_CM 1 0. 0. 1.99996948242188 ECU_ADDRESS 0xd0003134 FORMAT "%7.5" /end MEASUREMENT
/begin CHARACTERISTIC Cbx_fim_bch "Bench mode activation for Vxx_fim_sp" VALUE 0xa00217fa _REC_S1VAL_20_u1 1. _CNV_A_R_ECME_LINEA_0_CM 0. 1. FORMAT "%1.0" BIT_MASK 0x1 /end CHARACTERISTIC
/begin CHARACTERISTIC Cxx_fim_bch "Fuel mass bench mode (Vxx_fim_sp)" VALUE 0xa00217f6 _REC_S1VAL_20_u4 4800. _CNV_A_R_LINEAR_____83_CM 0. 4800. FORMAT "%12.3" /end CHARACTERISTIC
/begin CHARACTERISTIC Cxx_stoe_rat "Stoechiometric ratio for gazoline" VALUE 0xa00217fb _REC_S1VAL_20_u1 19.921875 _CNV_A_R_LINEAR_____265_CM 7.8125e-002 20. FORMAT "%8.6" /end CHARACTERISTIC
/begin CHARACTERISTIC Cxx_stoe_rat_alco "Stoechiometric ratio for exotic fuel" VALUE 0xa00217fc _REC_S1VAL_20_u1 19.921875 _CNV_A_R_LINEAR_____265_CM 7.8125e-002 20. FORMAT "%8.6" /end CHARACTERISTIC
/begin AXIS_PTS Ctb_prs_dif_ti "breakpoints for injector nozzle pressure difference" 0xa002994c Vxx_prs_dif_ti _REC_A2AXS_20_u2 20000. _CNV_A_R_LINEAR_____107_CM 17 -10000. 10000. FORMAT "%6.0" /end AXIS_PTS
/begin CHARACTERISTIC Cmp_prs_dif_ti_cor "injection time correction factor according to the injector pressure difference" MAP 0xa0029970 _REC_A1MAP_20_u2_u2_u2 1.999969482 _CNV_A_R_LINEAR_____96_CM 0. 1.999969482 FORMAT "%10.8"
 /begin AXIS_DESCR COM_AXIS Vxx_n _CNV_A_R_ENSD_LINEA_24_CM 20 0. 16383.75 FORMAT "%8.2" AXIS_PTS_REF Ctb_n /end AXIS_DESCR
 /begin AXIS_DESCR COM_AXIS Vxx_prs_dif_ti _CNV_A_R_LINEAR_____107_CM 17 -10000. 10000. FORMAT "%6.0" AXIS_PTS_REF Ctb_prs_dif_ti /end AXIS_DESCR
/end CHARACTERISTIC
/begin MEASUREMENT Vxx_prs_dif_ti "injector nozzle pressure difference" UWORD _CNV_A_R_LINEAR_____107_CM 1 0. -10000. 10000. ECU_ADDRESS 0xd0002fc2 FORMAT "%6.0" /end MEASUREMENT
/begin MEASUREMENT Vxx_prs_dif_ti_cor "Nozzle pressure correction factor" UWORD _CNV_A_R_LINEAR_____96_CM 1 0. 0. 1.999969482 ECU_ADDRESS 0xd0002fc4 FORMAT "%10.8" /end MEASUREMENT
/begin MEASUREMENT Vbx_dft_inj1_cut "Injector of cylinder 1 deactivated due to a default on the cylinder (spark, coil, injector...)" UBYTE _CNV_S_2_RANGE______3_CM 1 0. 0. 1. ECU_ADDRESS 0xd000488e BIT_MASK 0x1 /end MEASUREMENT
/begin MEASUREMENT Vbx_dft_inj2_cut "Injector of cylinder 2 deactivated due to a default on the cylinder (spark, coil, injector...)" UBYTE _CNV_S_2_RANGE______3_CM 1 0. 0. 1. ECU_ADDRESS 0xd000488f BIT_MASK 0x1 /end MEASUREMENT
/begin MEASUREMENT Vbx_dft_inj3_cut "Injector of cylinder 3 deactivated due to a default on the cylinder (spark, coil, injector...)" UBYTE _CNV_S_2_RANGE______3_CM 1 0. 0. 1. ECU_ADDRESS 0xd0004890 BIT_MASK 0x1 /end MEASUREMENT
/begin MEASUREMENT Vbx_dft_inj4_cut "Injector of cylinder 4 deactivated due to a default on the cylinder (spark, coil, injector...)" UBYTE _CNV_S_2_RANGE______3_CM 1 0. 0. 1. ECU_ADDRESS 0xd0004891 BIT_MASK 0x1 /end MEASUREMENT
/begin MEASUREMENT Vbx_inj1_cut "Cut command for cylinder 1 injector. Applied on next opening." UBYTE _CNV_S_2_RANGE______3_CM 1 0. 0. 1. ECU_ADDRESS 0xd0004892 BIT_MASK 0x1 /end MEASUREMENT
/begin MEASUREMENT Vbx_inj1_cut_req "Cut request for injector 1 not related to limp home or defaults" UBYTE _CNV_S_2_RANGE______3_CM 1 0. 0. 1. ECU_ADDRESS 0xd0004893 BIT_MASK 0x1 /end MEASUREMENT
/begin MEASUREMENT Vbx_inj2_cut "Cut command for cylinder 2 injector. Applied on next opening." UBYTE _CNV_S_2_RANGE______3_CM 1 0. 0. 1. ECU_ADDRESS 0xd0004894 BIT_MASK 0x1 /end MEASUREMENT
/begin MEASUREMENT Vbx_inj2_cut_req "Cut request for injector 2 not related to limp home or defaults" UBYTE _CNV_S_2_RANGE______3_CM 1 0. 0. 1. ECU_ADDRESS 0xd0004895 BIT_MASK 0x1 /end MEASUREMENT
/begin MEASUREMENT Vbx_inj3_cut "Cut command for cylinder 3 injector. Applied on next opening." UBYTE _CNV_S_2_RANGE______3_CM 1 0. 0. 1. ECU_ADDRESS 0xd0004896 BIT_MASK 0x1 /end MEASUREMENT
/begin MEASUREMENT Vbx_inj3_cut_req "Cut request for injector 3 not related to limp home or defaults" UBYTE _CNV_S_2_RANGE______3_CM 1 0. 0. 1. ECU_ADDRESS 0xd0004897 BIT_MASK 0x1 /end MEASUREMENT
/begin MEASUREMENT Vbx_inj4_cut "Cut command for cylinder 4 injector. Applied on next opening." UBYTE _CNV_S_2_RANGE______3_CM 1 0. 0. 1. ECU_ADDRESS 0xd0004898 BIT_MASK 0x1 /end MEASUREMENT
/begin MEASUREMENT Vbx_inj4_cut_req "Cut request for injector 4 not related to limp home or defaults" UBYTE _CNV_S_2_RANGE______3_CM 1 0. 0. 1. ECU_ADDRESS 0xd0004899 BIT_MASK 0x1 /end MEASUREMENT
/begin MEASUREMENT Vbx_inj_cut_rst "Reset on key of the injectors cut requests" UBYTE _CNV_S_2_RANGE______3_CM 1 0. 0. 1. ECU_ADDRESS 0xd000489a BIT_MASK 0x1 /end MEASUREMENT
/begin MEASUREMENT Vbx_inj_ena "Indicator of injection authorization (not cut)" UBYTE _CNV_S_2_RANGE______3_CM 1 0. 0. 1. ECU_ADDRESS 0xd000489b BIT_MASK 0x1 /end MEASUREMENT
/begin MEASUREMENT Vbx_lih_inj1_cut_req "Limp home cut request for cylinder 1" UBYTE _CNV_S_2_RANGE______3_CM 1 0. 0. 1. ECU_ADDRESS 0xd000489c BIT_MASK 0x1 /end MEASUREMENT
/begin MEASUREMENT Vbx_lih_inj2_cut_req "Limp home cut request for cylinder 2" UBYTE _CNV_S_2_RANGE______3_CM 1 0. 0. 1. ECU_ADDRESS 0xd000489d BIT_MASK 0x1 /end MEASUREMENT
/begin MEASUREMENT Vbx_lih_inj3_cut_req "Limp home cut request for cylinder 3" UBYTE _CNV_S_2_RANGE______3_CM 1 0. 0. 1. ECU_ADDRESS 0xd000489e BIT_MASK 0x1 /end MEASUREMENT
/begin MEASUREMENT Vbx_lih_inj4_cut_req "Limp home cut request for cylinder 4" UBYTE _CNV_S_2_RANGE______3_CM 1 0. 0. 1. ECU_ADDRESS 0xd000489f BIT_MASK 0x1 /end MEASUREMENT
/begin MEASUREMENT Vxx_efv_inj_cut_nr "Effective number of injector currently disabled." UBYTE _CNV_A_R_ECME_LINEA_0_CM 1 0. 0. 12. ECU_ADDRESS 0xd00048a0 FORMAT "%2.0" /end MEASUREMENT
/begin MEASUREMENT Vxx_efv_req_inj_cut_nr "Number of cylinder" UBYTE _CNV_A_R_ECME_LINEA_0_CM 1 0. 0. 12. ECU_ADDRESS 0xd00048a1 FORMAT "%2.0" /end MEASUREMENT
/begin MEASUREMENT Vxx_inj_avl_nr "Number of available cylinders. (Only failures decrease the number)" UBYTE _CNV_A_R_ECME_LINEA_0_CM 1 0. 0. 12. ECU_ADDRESS 0xd00048a2 FORMAT "%2.0" /end MEASUREMENT
/begin MEASUREMENT Vxx_inj_cut_nr "Number of cylinder cut" UBYTE _CNV_A_R_ECME_LINEA_0_CM 1 0. 0. 12. ECU_ADDRESS 0xd00048a3 FORMAT "%2.0" /end MEASUREMENT
/begin MEASUREMENT Vxx_next_inj_cut_tdc_nr "Number of the next injector that can be cut." UBYTE _CNV_A_R_ECME_LINEA_0_CM 1 0. 0. 12. ECU_ADDRESS 0xd00048a4 FORMAT "%2.0" /end MEASUREMENT
/begin MEASUREMENT Vxx_next_inj_open_tdc_nr "Number of the next injector that can be opened." UBYTE _CNV_A_R_ECME_LINEA_0_CM 1 0. 0. 12. ECU_ADDRESS 0xd00048a5 FORMAT "%2.0" /end MEASUREMENT
/begin MEASUREMENT Vxx_prev_inj_cut_nr "Number of the last injector that was cut." UBYTE _CNV_A_R_ECME_LINEA_0_CM 1 0. 0. 12. ECU_ADDRESS 0xd00048a6 FORMAT "%2.0" /end MEASUREMENT
/begin CHARACTERISTIC Cbx_bch_inj1_cut_req "Bench mode to cut injector on cylinder1" VALUE 0xa0021a7f _REC_S1VAL_20_u1 1. _CNV_A_R_ECME_LINEA_0_CM 0. 1. FORMAT "%1.0" BIT_MASK 0x1 /end CHARACTERISTIC
/begin CHARACTERISTIC Cbx_bch_inj2_cut_req "Bench mode to cut injector on cylinder2" VALUE 0xa0021a80 _REC_S1VAL_20_u1 1. _CNV_A_R_ECME_LINEA_0_CM 0. 1. FORMAT "%1.0" BIT_MASK 0x1 /end CHARACTERISTIC
/begin CHARACTERISTIC Cbx_bch_inj3_cut_req "Bench mode to cut injector on cylinder3" VALUE 0xa0021a81 _REC_S1VAL_20_u1 1. _CNV_A_R_ECME_LINEA_0_CM 0. 1. FORMAT "%1.0" BIT_MASK 0x1 /end CHARACTERISTIC
/begin CHARACTERISTIC Cbx_bch_inj4_cut_req "Bench mode to cut injector on cylinder4" VALUE 0xa0021a82 _REC_S1VAL_20_u1 1. _CNV_A_R_ECME_LINEA_0_CM 0. 1. FORMAT "%1.0" BIT_MASK 0x1 /end CHARACTERISTIC
/begin CHARACTERISTIC Cbx_inj_cut_seq "If ON, injectors will be disabled by following ignition sequence strictly, not randomly." VALUE 0xa0021a83 _REC_S1VAL_20_u1 1. _CNV_A_R_ECME_LINEA_0_CM 0. 1. FORMAT "%1.0" BIT_MASK 0x1 /end CHARACTERISTIC
/begin CHARACTERISTIC Cbx_wet_bch_mod "Bench mode wall wetting correction" VALUE 0xa0021a84 _REC_S1VAL_20_u1 1. _CNV_A_R_ECME_LINEA_0_CM 0. 1. FORMAT "%1.0" BIT_MASK 0x1 /end CHARACTERISTIC
/begin CHARACTERISTIC Cbx_wet_ti_cut_bch_mod "Bench mode for injection pulse" VALUE 0xa0021a85 _REC_S1VAL_20_u1 1. _CNV_A_R_ECME_LINEA_0_CM 0. 1. FORMAT "%1.0" BIT_MASK 0x1 /end CHARACTERISTIC
/begin CHARACTERISTIC Ctp_tco_amp_pinj_cor_fac "Multiplicativ factor of altimetric depression for Fuel Injection Mass correction during start" CURVE 0xa0021918 _REC_A1CUR_20_u1_u2 1.9921875 _CNV_A_R_LINEAR_____43_CM 0. 1.9921875 FORMAT "%8.6"
 /begin AXIS_DESCR COM_AXIS Vxx_tco _CNV_A_R_LINEAR_____54_CM 8 -40. 200. FORMAT "%5.1" AXIS_PTS_REF Ctb_sta_tco /end AXIS_DESCR
/end CHARACTERISTIC
/begin CHARACTERISTIC Ctp_tco_pinj_fim "Pre-injection fuel mass setpoint table, dependant on coolant temperature" CURVE 0xa0025aa4 _REC_A1CUR_20_u2_u2 6553.5 _CNV_A_R_LINEAR_____166_CM 0. 6553.5 FORMAT "%6.1"
 /begin AXIS_DESCR COM_AXIS Vxx_tco _CNV_A_R_LINEAR_____54_CM 8 -40. 200. FORMAT "%5.1" AXIS_PTS_REF Ctb_sta_tco /end AXIS_DESCR
/end CHARACTERISTIC
/begin MEASUREMENT Vbx_ecu_rst_pinj_dsb "Boolean indicating that the pre-injection is inhibited after an abnormal ECU reset" UBYTE _CNV_S_2_RANGE______3_CM 1 0. 0. 1. ECU_ADDRESS 0xd00047c3 BIT_MASK 0x1 /end MEASUREMENT
/begin MEASUREMENT Vbx_ecu_rst_pinj_ena "Boolean indicating that the pre-injection is not any more inhibited after an abnormal ECU reset" UBYTE _CNV_S_2_RANGE______3_CM 1 0. 0. 1. ECU_ADDRESS 0xd00047c4 BIT_MASK 0x1 /end MEASUREMENT
/begin MEASUREMENT Vbx_pinj "Pre-injection authorization" UBYTE _CNV_S_2_RANGE______3_CM 1 0. 0. 1. ECU_ADDRESS 0xd00047c5 BIT_MASK 0x1 /end MEASUREMENT
/begin MEASUREMENT Vbx_pinj_seq_cfm "Preinjection configuration : 1 = sequential preinjection, with opening angle set point" UBYTE _CNV_S_2_RANGE______3_CM 1 0. 0. 1. ECU_ADDRESS 0xd00047c6 BIT_MASK 0x1 /end MEASUREMENT
/begin MEASUREMENT Vxx_inj1_pinj_clos_angl "Pre-injection closure angle set point for injector n∞1" UBYTE _CNV_A_R_LINEAR_____264_CM 1 0. 0. 765. ECU_ADDRESS 0xd00047c7 FORMAT "%3.0" /end MEASUREMENT
/begin MEASUREMENT Vxx_inj2_pinj_clos_angl "Pre-injection closure angle set point for injector n∞2" UBYTE _CNV_A_R_LINEAR_____264_CM 1 0. 0. 765. ECU_ADDRESS 0xd00047c8 FORMAT "%3.0" /end MEASUREMENT
/begin MEASUREMENT Vxx_inj3_pinj_clos_angl "Pre-injection closure angle set point for injector n∞3" UBYTE _CNV_A_R_LINEAR_____264_CM 1 0. 0. 765. ECU_ADDRESS 0xd00047c9 FORMAT "%3.0" /end MEASUREMENT
/begin MEASUREMENT Vxx_inj4_pinj_clos_angl "Pre-injection closure angle set point for injector n∞4" UBYTE _CNV_A_R_LINEAR_____264_CM 1 0. 0. 765. ECU_ADDRESS 0xd00047ca FORMAT "%3.0" /end MEASUREMENT
/begin MEASUREMENT Vxx_pinj_fim "Pre-injection fuel mass setpoint disrigarding cylinder" UWORD _CNV_A_R_LINEAR_____166_CM 1 0. 0. 6553.5 ECU_ADDRESS 0xd0003868 FORMAT "%6.1" /end MEASUREMENT
/begin MEASUREMENT Vxx_sta_pinj_toth_nr "Crankshaft teeth number to count before first injection authorization" UBYTE _CNV_A_R_ECME_LINEA_0_CM 1 0. 0. 255. ECU_ADDRESS 0xd00047cb FORMAT "%3.0" /end MEASUREMENT
/begin MEASUREMENT Vxx_vld_tco "Engine coolant temperature" UWORD _CNV_A_R_LINEAR_____54_CM 1 0. -40. 200. ECU_ADDRESS 0xd000386a FORMAT "%5.1" /end MEASUREMENT
/begin CHARACTERISTIC Cbx_pinj_seq_cfm "Preinjection configuration : 1 = sequential preinjection, with opening angle set point" VALUE 0xa0021924 _REC_S1VAL_20_u1 1. _CNV_A_R_ECME_LINEA_0_CM 0. 1. FORMAT "%1.0" BIT_MASK 0x1 /end CHARACTERISTIC
/begin CHARACTERISTIC Cxx_inj1_pinj_clos_angl "Pre-injection closure angle for injector n∞1" VALUE 0xa0021925 _REC_S1VAL_20_u1 765. _CNV_A_R_LINEAR_____264_CM 0. 765. FORMAT "%3.0" /end CHARACTERISTIC
/begin CHARACTERISTIC Cxx_inj2_pinj_clos_angl "Pre-injection closure angle for injector n∞2" VALUE 0xa0021926 _REC_S1VAL_20_u1 765. _CNV_A_R_LINEAR_____264_CM 0. 765. FORMAT "%3.0" /end CHARACTERISTIC
/begin CHARACTERISTIC Cxx_inj3_pinj_clos_angl "Pre-injection closure angle for injector n∞3" VALUE 0xa0021927 _REC_S1VAL_20_u1 765. _CNV_A_R_LINEAR_____264_CM 0. 765. FORMAT "%3.0" /end CHARACTERISTIC
/begin CHARACTERISTIC Cxx_inj4_pinj_clos_angl "Pre-injection closure angle for injector n∞4" VALUE 0xa0021928 _REC_S1VAL_20_u1 765. _CNV_A_R_LINEAR_____264_CM 0. 765. FORMAT "%3.0" /end CHARACTERISTIC
/begin CHARACTERISTIC Cxx_rest_pinj_cor_fac "Pre-injection Fuel Mass correction factor for restart" VALUE 0xa0021920 _REC_S1VAL_20_u2 1. _CNV_A_R_LINEAR_____125_CM 0. 1. FORMAT "%11.9" /end CHARACTERISTIC
/begin CHARACTERISTIC Cxx_sta_pinj_toth_nr "Crankshaft teeth number to count before first injection authorization" VALUE 0xa0021929 _REC_S1VAL_20_u1 255. _CNV_A_R_ECME_LINEA_0_CM 0. 255. FORMAT "%3.0" /end CHARACTERISTIC
/begin CHARACTERISTIC Cxx_sta_tco_vld_nok "Engine coolant temperature replacement value in case of default" VALUE 0xa0021922 _REC_S1VAL_20_u2 240. _CNV_A_R_LINEAR_____54_CM -40. 200. FORMAT "%5.1" /end CHARACTERISTIC
/begin MEASUREMENT lv_state_inj_cus_seq "Flag of transition beteween semi-full group and sequential during start phase" UBYTE _CNV_S_2_RANGE______3_CM 1 0. 0. 1. ECU_ADDRESS 0xd00045ee /end MEASUREMENT
/begin MEASUREMENT nr_tooth_pre_inj "Number of teeth valid to launch the pre-injection" UBYTE _CNV_A_R_ECME_LINEA_0_CM 1 0. 0. 255. ECU_ADDRESS 0xd00045bf FORMAT "%3.0" /end MEASUREMENT
/begin CHARACTERISTIC c_nr_tooth_pre_inj "Number of valid tooth for launch pre-injection" VALUE 0xa00211d5 _REC_S1VAL_20_u1 255. _CNV_A_R_ECME_LINEA_0_CM 0. 255. FORMAT "%3.0" /end CHARACTERISTIC
/begin AXIS_PTS Ctb_n "20 programmable engine speed breakpoints map" 0xa00250e0 Vxx_n _REC_A2AXS_20_u2 16383.75 _CNV_A_R_ENSD_LINEA_24_CM 20 0. 16383.75 FORMAT "%8.2" /end AXIS_PTS
/begin AXIS_PTS Ctb_n2 "9 programmable engine speed breakpoints table" 0xa002510c Vxx_n _REC_A2AXS_20_u2 16383.75 _CNV_A_R_ENSD_LINEA_24_CM 9 0. 16383.75 FORMAT "%8.2" /end AXIS_PTS
/begin AXIS_PTS Ctb_coup "Breakpoint calibration of transmission coupler states" 0xa0021470 Vxx_ant_coup _REC_A2AXS_20_u1 255. _CNV_A_R_ECME_LINEA_0_CM 3 0. 255. FORMAT "%3.0" /end AXIS_PTS
/begin AXIS_PTS Ntb_gear "Gearbox ratio breakpoint" 0xa002ac48 Vxx_gear _REC_A2AXS_20_u1 7. _CNV_A_R_LINEAR_____113_CM 8 -1. 6. READ_ONLY FORMAT "%2.0" /end AXIS_PTS
/begin AXIS_PTS Ctb_ajs_dt_tq_rat "a_sm_caj_ctl_ajcorxx_xxx_xx_x_a/Breakpoint calibration of driveline torque ratio" 0xa0029c48 Vxx_ajs_dt_tq_rat _REC_A2AXS_20_u2 210. _CNV_A_R_LINEAR_____251_CM 8 -10. 200. FORMAT "%6.2" /end AXIS_PTS
/begin COMPU_METHOD _CNV_A_R_ECME_LINEA_0_CM "" RAT_FUNC "%6.3" "-" COEFFS 0 1. 0. 0 0 1 /end COMPU_METHOD
/begin COMPU_METHOD _CNV_A_R_LINEAR_____2_CM "" RAT_FUNC "%6.3" "rpm" COEFFS 0 3.125e-002 0. 0 0 1 /end COMPU_METHOD
/begin COMPU_METHOD _CNV_S_2_RANGE______3_CM "" TAB_VERB "%6.3" "-" COMPU_TAB_REF _CNV_S_2_RANGE______3 /end COMPU_METHOD
/begin COMPU_VTAB _CNV_S_2_RANGE______3 "" TAB_VERB 2 0 "0" 1 "1" /end COMPU_VTAB
/begin COMPU_METHOD _CNV_A_R_LINEAR_____4_CM "" RAT_FUNC "%6.3" "s" COEFFS 0 10. 0. 0 0 1 /end COMPU_METHOD
/begin COMPU_METHOD _CNV_A_R_LINEAR_____21_CM "" RAT_FUNC "%6.3" "rpm" COEFFS 0 1. 0. 0 0 1 /end COMPU_METHOD
/begin COMPU_METHOD _CNV_A_R_ENSD_LINEA_24_CM "" RAT_FUNC "%6.3" "rpm" COEFFS 0 4. 0. 0 0 1 /end COMPU_METHOD
/begin COMPU_METHOD _CNV_A_R_LINEAR_____25_CM "" RAT_FUNC "%6.3" "∞CRK" COEFFS 0 2.666666666666667 0. 0 0 1 /end COMPU_METHOD
/begin COMPU_METHOD _CNV_A_R_LINEAR_____30_CM "" RAT_FUNC "%6.3" "∞CRK" COEFFS 0 2.666666666666667 128. 0 0 1 /end COMPU_METHOD
/begin COMPU_METHOD _CNV_A_R_LINEAR_____31_CM "" RAT_FUNC "%6.3" "-" COEFFS 0 256. 0. 0 0 1 /end COMPU_METHOD
/begin COMPU_METHOD _CNV_A_R_LINEAR_____34_CM "" RAT_FUNC "%6.3" "s" COEFFS 0 100. 0. 0 0 1 /end COMPU_METHOD
/begin COMPU_METHOD _CNV_A_R_LINEAR_____41_CM "" RAT_FUNC "%6.3" "V" COEFFS 0 9.846153846153847 0. 0 0 1 /end COMPU_METHOD
/begin COMPU_METHOD _CNV_A_R_LINEAR_____42_CM "" RAT_FUNC "%6.3" "∞C" COEFFS 0 1.333333333333333 64. 0 0 1 /end COMPU_METHOD
/begin COMPU_METHOD _CNV_A_R_LINEAR_____43_CM "" RAT_FUNC "%6.3" "-" COEFFS 0 128. 0. 0 0 1 /end COMPU_METHOD
/begin COMPU_METHOD _CNV_A_R_LINEAR_____44_CM "" RAT_FUNC "%6.3" "ms" COEFFS 0 250. 0. 0 0 1 /end COMPU_METHOD
/begin COMPU_METHOD _CNV_A_R_IGRE_LINEA_48_CM "" RAT_FUNC "%6.3" "∞CRK" COEFFS 0 2.666666666666667 63. 0 0 1 /end COMPU_METHOD
/begin COMPU_METHOD _CNV_A_R_LINEAR_____49_CM "" RAT_FUNC "%6.3" "-" COEFFS 0 32767.99999999992 0. 0 0 1 /end COMPU_METHOD
/begin COMPU_METHOD _CNV_A_R_LINEAR_____53_CM "" RAT_FUNC "%6.3" "-" COEFFS 0 16384. 0. 0 0 1 /end COMPU_METHOD
/begin COMPU_METHOD _CNV_A_R_LINEAR_____54_CM "" RAT_FUNC "%6.3" "∞C" COEFFS 0 10. 400. 0 0 1 /end COMPU_METHOD
/begin COMPU_METHOD _CNV_A_R_LINEAR_____55_CM "" RAT_FUNC "%6.3" "TDC" COEFFS 0 1. 0. 0 0 1 /end COMPU_METHOD
/begin COMPU_METHOD _CNV_A_R_LINEAR_____57_CM "" RAT_FUNC "%6.3" "hPa" COEFFS 0 1. 0. 0 0 1 /end COMPU_METHOD
/begin COMPU_METHOD _CNV_A_R_LINEAR_____58_CM "" RAT_FUNC "%6.3" "s" COEFFS 0 1000. 0. 0 0 1 /end COMPU_METHOD
/begin COMPU_METHOD _CNV_A_R_LINEAR_____70_CM "" RAT_FUNC "%6.3" "km/h" COEFFS 0 100. 0. 0 0 1 /end COMPU_METHOD
/begin COMPU_METHOD _CNV_A_R_LINEAR_____76_CM "" RAT_FUNC "%6.3" "∞CRK" COEFFS 0 50. 0. 0 0 1 /end COMPU_METHOD
/begin COMPU_METHOD _CNV_A_R_LINEAR_____82_CM "" RAT_FUNC "%6.3" "s" COEFFS 0 1. 0. 0 0 1 /end COMPU_METHOD
/begin COMPU_METHOD _CNV_A_R_LINEAR_____83_CM "" RAT_FUNC "%6.3" "mg/stk" COEFFS 0 390.625 0. 0 0 1 /end COMPU_METHOD
/begin COMPU_METHOD _CNV_A_R_LINEAR_____96_CM "" RAT_FUNC "%6.3" "-" COEFFS 0 32768.0000069121 0. 0 0 1 /end COMPU_METHOD
/begin COMPU_METHOD _CNV_A_R_LINEAR_____102_CM "" RAT_FUNC "%6.3" "-" COEFFS 0 256. -256. 0 0 1 /end COMPU_METHOD
/begin COMPU_METHOD _CNV_A_R_LINEAR_____107_CM "" RAT_FUNC "%6.3" "hPa" COEFFS 0 1. 10000. 0 0 1 /end COMPU_METHOD
/begin COMPU_METHOD _CNV_A_R_LINEAR_____108_CM "" RAT_FUNC "%6.3" "-" COEFFS 0 1000. 0. 0 0 1 /end COMPU_METHOD
/begin COMPU_METHOD _CNV_A_R_LINEAR_____113_CM "" RAT_FUNC "%6.3" "-" COEFFS 0 1. 1. 0 0 1 /end COMPU_METHOD
/begin COMPU_METHOD _CNV_A_R_LINEAR_____118_CM "" RAT_FUNC "%6.3" "-" COEFFS 0 255. 0. 0 0 1 /end COMPU_METHOD
/begin COMPU_METHOD _CNV_S_3_STATUS_OK__120_CM "" TAB_VERB "%6.3" "-" COMPU_TAB_REF _CNV_S_3_STATUS_OK__120 /end COMPU_METHOD
/begin COMPU_VTAB _CNV_S_3_STATUS_OK__120 "" TAB_VERB 3 0 "Nsx_vld_nok_0" 1 "Nsx_vld_ok_1" 2 "Nsx_vld_fail_2" /end COMPU_VTAB
/begin COMPU_METHOD _CNV_A_R_LINEAR_____123_CM "" RAT_FUNC "%6.3" "Nm" COEFFS 0 32. 0. 0 0 1 /end COMPU_METHOD
/begin COMPU_METHOD _CNV_A_R_LINEAR_____125_CM "" RAT_FUNC "%6.3" "-" COEFFS 0 1024. 0. 0 0 1 /end COMPU_METHOD
/begin COMPU_METHOD _CNV_A_R_LINEAR_____136_CM "" RAT_FUNC "%6.3" "-" COEFFS 0 100. 0. 0 0 1 /end COMPU_METHOD
/begin COMPU_METHOD _CNV_S_16_RANGE_ERR__151_CM "" TAB_VERB "%6.3" "" COMPU_TAB_REF _CNV_S_16_RANGE_ERR__151 /end COMPU_METHOD
/begin COMPU_VTAB _CNV_S_16_RANGE_ERR__151 "" TAB_VERB 16 0 "NO_SYM" 1 "SYM_0" 2 "SYM_1" 3 "SYM_0, SYM_1" 4 "SYM_2" 5 "SYM_0, SYM_2" 6 "SYM_1, SYM_2" 7 "SYM_0, SYM_1, SYM_2" 8 "SYM_3" 9 "SYM_0, SYM_3" 10 "SYM_1, SYM_3" 11 "SYM_0, SYM_1,SYM_3" 12 "SYM_2, SYM_3" 13 "SYM_0, SYM_2, SYM_3" 14 "SYM_1, SYM_2, SYM_3" 15 "SYM_0, SYM_1, SYM_2, SYM_3" /end COMPU_VTAB
/begin COMPU_METHOD _CNV_A_R_LINEAR_____161_CM "" RAT_FUNC "%6.3" "Nm" COEFFS 0 32. 12800. 0 0 1 /end COMPU_METHOD
/begin COMPU_METHOD _CNV_A_R_LINEAR_____166_CM "" RAT_FUNC "%6.3" "mg/stk" COEFFS 0 10. 0. 0 0 1 /end COMPU_METHOD
/begin COMPU_METHOD _CNV_A_R_LINEAR_____187_CM "" RAT_FUNC "%6.3" "-" COEFFS 0 128. 128. 0 0 1 /end COMPU_METHOD
/begin COMPU_METHOD _CNV_A_R_LINEAR_____216_CM "" RAT_FUNC "%6.3" "ratio" COEFFS 0 255. 0. 0 0 1 /end COMPU_METHOD
/begin COMPU_METHOD _CNV_A_R_LINEAR_____227_CM "" RAT_FUNC "%6.3" "-" COEFFS 0 256. -1. 0 0 1 /end COMPU_METHOD
/begin COMPU_METHOD _CNV_A_R_LINEAR_____246_CM "" RAT_FUNC "%6.3" "ms" COEFFS 0 250. 32768. 0 0 1 /end COMPU_METHOD
/begin COMPU_METHOD _CNV_S_12_INJECTION__247_CM "" TAB_VERB "%6.3" "" COMPU_TAB_REF _CNV_S_12_INJECTION__247 /end COMPU_METHOD
/begin COMPU_VTAB _CNV_S_12_INJECTION__247 "" TAB_VERB 12 1 "SNGS" 2 "MPLS" 4 "PRE_INJ" 6 "CRASH" 7 "TEST_PULSE" 33 "SNGS+MPLP" 34 "MPLS+MPLP" 66 "HOMS" 98 "HOMS+MPLP" 128 "DISABLE" 129 "SNGH" 130 "MPLH" /end COMPU_VTAB
/begin COMPU_METHOD _CNV_S_3_PRE_INJECT_248_R_CM "" TAB_VERB "%6.3" "" COMPU_TAB_REF _CNV_S_3_PRE_INJECT_248_R /end COMPU_METHOD
/begin COMPU_VTAB_RANGE _CNV_S_3_PRE_INJECT_248_R "" 3 0 0 "Full Group" 1 1 "Semi-Full Group" 2 255 "Sequential" /end COMPU_VTAB_RANGE
/begin COMPU_METHOD _CNV_A_R_LINEAR_____249_CM "" RAT_FUNC "%6.3" "ms" COEFFS 0 5.e-003 0. 0 0 1 /end COMPU_METHOD
/begin COMPU_METHOD _CNV_A_R_LINEAR_____250_CM "" RAT_FUNC "%6.3" "-" COEFFS 0 4. 20000. 0 0 1 /end COMPU_METHOD
/begin COMPU_METHOD _CNV_A_R_LINEAR_____251_CM "" RAT_FUNC "%6.3" "-" COEFFS 0 100. 1000. 0 0 1 /end COMPU_METHOD
/begin COMPU_METHOD _CNV_A_R_LINEAR_____252_CM "" RAT_FUNC "%6.3" "-" COEFFS 0 10. 0. 0 0 1 /end COMPU_METHOD
/begin COMPU_METHOD _CNV_A_R_LINEAR_____253_CM "" RAT_FUNC "%6.3" "-" COEFFS 0 100. 100. 0 0 1 /end COMPU_METHOD
/begin COMPU_METHOD _CNV_A_R_LINEAR_____254_CM "" RAT_FUNC "%6.3" "ratio/s" COEFFS 0 8. 0. 0 0 1 /end COMPU_METHOD
/begin COMPU_METHOD _CNV_A_R_LINEAR_____255_CM "" RAT_FUNC "%6.3" "-" COEFFS 0 20. 0. 0 0 1 /end COMPU_METHOD
/begin COMPU_METHOD _CNV_A_R_LINEAR_____256_CM "" RAT_FUNC "%6.3" "-" COEFFS 0 32. 0. 0 0 1 /end COMPU_METHOD
/begin COMPU_METHOD _CNV_A_R_LINEAR_____257_CM "" RAT_FUNC "%6.3" "ratio" COEFFS 0 800. 0. 0 0 1 /end COMPU_METHOD
/begin COMPU_METHOD _CNV_S_4_RANGE_RESE_258_CM "" TAB_VERB "%6.3" "" COMPU_TAB_REF _CNV_S_4_RANGE_RESE_258 /end COMPU_METHOD
/begin COMPU_VTAB _CNV_S_4_RANGE_RESE_258 "" TAB_VERB 4 2 "Nsx_rst_igk_on" 4 "Nsx_rst_inj_sta" 8 "Nsx_rst_eng_run" 16 "Nsx_rst_igk_off" /end COMPU_VTAB
/begin COMPU_METHOD _CNV_A_R_LINEAR_____259_CM "" RAT_FUNC "%6.3" "s" COEFFS 0 5. 0. 0 0 1 /end COMPU_METHOD
/begin COMPU_METHOD _CNV_A_R_LINEAR_____260_CM "" RAT_FUNC "%6.3" "-" COEFFS 0 256. 128. 0 0 1 /end COMPU_METHOD
/begin COMPU_METHOD _CNV_A_R_LINEAR_____261_CM "" RAT_FUNC "%6.3" "-" COEFFS 0 16384. -8192. 0 0 1 /end COMPU_METHOD
/begin COMPU_METHOD _CNV_A_R_LINEAR_____262_CM "" RAT_FUNC "%6.3" "mg/stk" COEFFS 0 12.20703125 0. 0 0 1 /end COMPU_METHOD
/begin COMPU_METHOD _CNV_A_R_LINEAR_____263_CM "" RAT_FUNC "%6.3" "TDC" COEFFS 0 0.25 0. 0 0 1 /end COMPU_METHOD
/begin COMPU_METHOD _CNV_A_R_LINEAR_____264_CM "" RAT_FUNC "%6.3" "∞CRK" COEFFS 0 0.3333333333333333 0. 0 0 1 /end COMPU_METHOD
/begin COMPU_METHOD _CNV_A_R_LINEAR_____265_CM "" RAT_FUNC "%6.3" "-" COEFFS 0 12.8 -1. 0 0 1 /end COMPU_METHOD
/begin RECORD_LAYOUT _REC_S1VAL_20_u4 FNC_VALUES 1 ULONG COLUMN_DIR DIRECT /end RECORD_LAYOUT
/begin RECORD_LAYOUT _REC_S1VAL_20_u1 FNC_VALUES 1 UBYTE COLUMN_DIR DIRECT /end RECORD_LAYOUT
/begin RECORD_LAYOUT _REC_A2AXS_20_u1 NO_AXIS_PTS_X 1 UBYTE AXIS_PTS_X 2 UBYTE INDEX_INCR DIRECT /end RECORD_LAYOUT
/begin RECORD_LAYOUT _REC_S1VAL_20_u2 FNC_VALUES 1 UWORD COLUMN_DIR DIRECT /end RECORD_LAYOUT
/begin RECORD_LAYOUT _REC_S1VAL_20_s2 FNC_VALUES 1 SWORD COLUMN_DIR DIRECT /end RECORD_LAYOUT
/begin RECORD_LAYOUT _REC_A2AXS_20_u2 NO_AXIS_PTS_X 1 UWORD AXIS_PTS_X 2 UWORD INDEX_INCR DIRECT /end RECORD_LAYOUT
/begin RECORD_LAYOUT _REC_A1CUR_20_u1_u2 FNC_VALUES 1 UBYTE COLUMN_DIR DIRECT /end RECORD_LAYOUT
/begin RECORD_LAYOUT _REC_A1CUR_20_u1_u1 FNC_VALUES 1 UBYTE COLUMN_DIR DIRECT /end RECORD_LAYOUT
/begin RECORD_LAYOUT _REC_A1CUR_20_u2_u1 FNC_VALUES 1 UWORD COLUMN_DIR DIRECT /end RECORD_LAYOUT
/begin RECORD_LAYOUT _REC_A1MAP_20_u2_u2_u2 FNC_VALUES 1 UWORD COLUMN_DIR DIRECT /end RECORD_LAYOUT
/begin RECORD_LAYOUT _REC_A1CUR_20_u2_u2 FNC_VALUES 1 UWORD COLUMN_DIR DIRECT /end RECORD_LAYOUT
/begin RECORD_LAYOUT _REC_A1MAP_20_u1_u2_u2 FNC_VALUES 1 UBYTE COLUMN_DIR DIRECT /end RECORD_LAYOUT
/begin RECORD_LAYOUT _REC_A1MAP_20_u2_u1_u2 FNC_VALUES 1 UWORD COLUMN_DIR DIRECT /end RECORD_LAYOUT
/begin RECORD_LAYOUT _REC_A1MAP_20_u2_u2_u1 FNC_VALUES 1 UWORD COLUMN_DIR DIRECT /end RECORD_LAYOUT
/begin RECORD_LAYOUT _REC_A1MAP_20_u1_u1_u2 FNC_VALUES 1 UBYTE COLUMN_DIR DIRECT /end RECORD_LAYOUT
/begin FUNCTION CbIgnLim_Maxigxx ""
 /begin DEF_CHARACTERISTIC Ntb_vvtc_rel_angl Cmp_n_eal_vvtc_iga Cmp_n_eal_vvtc_off_iga Cmp_n_eal_vvtc_on_iga Ctp_vvtc_angl_iga_fac1 Ctp_vvtc_angl_iga_fac2 Cxx_vvtc_h_trt Cxx_vvtc_min_iga_cor /end DEF_CHARACTERISTIC
 /begin OUT_MEASUREMENT Vxx_max_iga Vxx_raw_max_iga Vxx_raw_slow_max_iga Vxx_vvtc_iga Vxx_vvtc_iga_fac1 Vxx_vvtc_iga_fac2 Vxx_vvtc_off_iga Vxx_vvtc_on_iga /end OUT_MEASUREMENT
/end FUNCTION
/begin FUNCTION CbIgnLim_Minigxx ""
 /begin DEF_CHARACTERISTIC Ntb_cyl_nr Cmp_eal_n_min_iga_cor Cmp_iga_tco_cor Cmp_iga_tq_min Cmx_n_iga_tq_min_lih Cxx_l_min_iga_ctr_dec Cxx_l_min_iga_ctr_inc Cxx_l_min_iga_ctr_thd Cxx_l_min_iga_inc Cxx_min_iga_dsb_t /end DEF_CHARACTERISTIC
 /begin OUT_MEASUREMENT Vbx_it_dft Vbx_l_min_iga Vbx_l_min_iga_ctr_thd Vbx_min_iga_dsb Vxx_cor_min_iga Vxx_l_min_iga_ctr Vxx_min_iga Vxx_min_iga_dsb_t Vxx_stat_min_iga /end OUT_MEASUREMENT
/end FUNCTION
/begin FUNCTION CbIgnLim_Pknkcxx ""
 /begin DEF_CHARACTERISTIC Ctb_mat Cmp_mat_n_ol_knk_iga_cor Ctp_eal_ol_knk_iga_cor_fac /end DEF_CHARACTERISTIC
 /begin OUT_MEASUREMENT Vxx_ol_knk_iga_cor /end OUT_MEASUREMENT
/end FUNCTION
/begin FUNCTION CbIgnLim_Slcbcxx "" /begin DEF_CHARACTERISTIC Cmp_tco_slow_comb_iga_cor Ctp_n_slow_comb_fac /end DEF_CHARACTERISTIC /begin OUT_MEASUREMENT Vxx_slow_comb_iga_cor /end OUT_MEASUREMENT /end FUNCTION
/begin FUNCTION CbIgnLim_Kigacxx ""
 /begin DEF_CHARACTERISTIC Ctp_n_knk_fast_inc_iga Cxx_fast_dec_step Cxx_knk_1cyl_slow_cor_max Cxx_knk_2cyl_slow_dif_max Cxx_knk_fast_cor_dec_ctr Cxx_knk_fast_cor_iga_max Cxx_knk_fast_cor_iga_thd Cxx_knk_iga_cor Cxx_knk_slow_cor_dec_ctr Cxx_knk_slow_cor_iga_inc Cxx_knk_slow_cor_iga_max Cxx_knk_slow_cor_prs_dif Cxx_slow_dec_step /end DEF_CHARACTERISTIC
 /begin OUT_MEASUREMENT Vbx_knk_2_cyl_min Vbx_knk_det_cyl1 Vbx_knk_det_cyl2 Vbx_knk_det_cyl3 Vbx_knk_det_cyl4 Vbx_knk_det_err_cyl1 Vbx_knk_det_err_cyl2 Vbx_knk_det_err_cyl3 Vbx_knk_det_err_cyl4 Vbx_knk_slow_cyl Vtd_knk_det_err_cyl[0] Vtd_knk_det_err_cyl[1] Vtd_knk_det_err_cyl[2] Vtd_knk_det_err_cyl[3] Vtd_knk_fast_cor_cyl[0] Vtd_knk_fast_cor_cyl[1] Vtd_knk_fast_cor_cyl[2] Vtd_knk_fast_cor_cyl[3] Vtd_knk_fast_cor_iga_cyl[0] Vtd_knk_fast_cor_iga_cyl[1] Vtd_knk_fast_cor_iga_cyl[2] Vtd_knk_fast_cor_iga_cyl[3] Vtd_knk_iga_cor_appl_cyl[0] Vtd_knk_iga_cor_appl_cyl[1] Vtd_knk_iga_cor_appl_cyl[2] Vtd_knk_iga_cor_appl_cyl[3] Vtd_knk_slow_iga_cyl_no_sat[0] Vtd_knk_slow_iga_cyl_no_sat[1] Vtd_knk_slow_iga_cyl_no_sat[2] Vtd_knk_slow_iga_cyl_no_sat[3] Vxx_knk_fast_cor_iga_cyl1 Vxx_knk_fast_cor_iga_cyl2 Vxx_knk_fast_cor_iga_cyl3 Vxx_knk_fast_cor_iga_cyl4 Vxx_knk_fast_cor_iga_cyl_i1 Vxx_knk_fast_cor_iga_cyl_i2 Vxx_knk_fast_cor_iga_cyl_i3 Vxx_knk_fast_cor_iga_cyl_i4 Vxx_knk_fast_dec_ctr_cyl1 Vxx_knk_fast_dec_ctr_cyl2 Vxx_knk_fast_dec_ctr_cyl3 Vxx_knk_fast_dec_ctr_cyl4 Vxx_knk_iga_fast_cor_inc Vxx_knk_slow_cor_dec_ctr Vxx_knk_slow_cor_iga_cyl1 Vxx_knk_slow_cor_iga_cyl2 Vxx_knk_slow_cor_iga_cyl3 Vxx_knk_slow_cor_iga_cyl4 Vxx_slow_ctr /end OUT_MEASUREMENT
/end FUNCTION
/begin FUNCTION CbIgnLim_Alcoxxx ""
 /begin DEF_CHARACTERISTIC Cmp_n_eal_vvtc_iga_alco Cmp_tco_slow_comb_iga_cor_alco Ctp_n_slow_comb_fac_alco /end DEF_CHARACTERISTIC
 /begin OUT_MEASUREMENT Vxx_slow_comb_iga_cor_alco Vxx_vvtc_iga_alco /end OUT_MEASUREMENT
/end FUNCTION
/begin FUNCTION CbIgnOpt "" /begin SUB_FUNCTION CbIgnOpt_Optigxx CbIgnOpt_Alcoxxx /end SUB_FUNCTION /end FUNCTION
/begin FUNCTION CbIgnOpt_Optigxx ""
 /begin DEF_CHARACTERISTIC Cmp_eal_n_vvtc_off_otl_iga Cmp_eal_n_vvtc_on_otl_iga Cmp_eal_n_vvtc_otl_iga /end DEF_CHARACTERISTIC
 /begin OUT_MEASUREMENT Vsx_otl_iga_vld Vxx_otl_iga Vxx_raw_otl_iga Vxx_vvtc_off_otl_iga Vxx_vvtc_on_otl_iga Vxx_vvtc_otl_iga /end OUT_MEASUREMENT
/end FUNCTION
/begin FUNCTION CbIgnOpt_Alcoxxx "" /begin DEF_CHARACTERISTIC Cmp_eal_n_vvtc_otl_iga_alco /end DEF_CHARACTERISTIC /begin OUT_MEASUREMENT Vxx_vvtc_otl_iga_alco /end OUT_MEASUREMENT /end FUNCTION
/begin FUNCTION BoCboIgn ""
 /begin OUT_MEASUREMENT Vbx_df_igc_1_oc Vbx_df_igc_1_scg Vbx_df_igc_1_scw Vbx_df_igc_2_oc Vbx_df_igc_2_scg Vbx_df_igc_2_scw Vbx_df_igc_3_oc Vbx_df_igc_3_scg Vbx_df_igc_3_scw Vbx_df_igc_4_oc Vbx_df_igc_4_scg Vbx_df_igc_4_scw Vbx_diag_ena_igc_1_oc Vbx_diag_ena_igc_1_scg Vbx_diag_ena_igc_1_scw Vbx_diag_ena_igc_2_oc Vbx_diag_ena_igc_2_scg Vbx_diag_ena_igc_2_scw Vbx_diag_ena_igc_3_oc Vbx_diag_ena_igc_3_scg Vbx_diag_ena_igc_3_scw Vbx_diag_ena_igc_4_oc Vbx_diag_ena_igc_4_scg Vbx_diag_ena_igc_4_scw iga_av_shift_rng[0] iga_av_shift_rng[1] iga_av_shift_rng[2] iga_av_shift_rng[3] inh_igc_cus lv_err_errm_igc_ol[0] lv_err_errm_igc_ol[1] lv_err_errm_igc_ol[2] lv_err_errm_igc_ol[3] lv_err_errm_igc_scg[0] lv_err_errm_igc_scg[1] lv_err_errm_igc_scg[2] lv_err_errm_igc_scg[3] lv_err_errm_igc_scp[0] lv_err_errm_igc_scp[1] lv_err_errm_igc_scp[2] lv_err_errm_igc_scp[3] state_td_boost /end OUT_MEASUREMENT
/end FUNCTION
/begin FUNCTION BoCboInj ""
 /begin DEF_CHARACTERISTIC ldp_n_32_ip_fac_add_pulse ldp_tco_ip_psn_dif_eng_syn_thd ldpm_vb_1_injr ip_fac_add_pulse ip_psn_dif_eng_syn_thd ip_ti_add_dly ip_ti_add_pulse_min c_cdn_diag_iv c_n_low_ena_pre_thd c_preinj_mode c_rec_diag_iv c_ti_eol lc_add_pulse_ena lc_state_inj_cus_seq c_nr_tooth_pre_inj /end DEF_CHARACTERISTIC
 /begin OUT_MEASUREMENT Vbx_df_inj1_oc Vbx_df_inj1_scg Vbx_df_inj1_scw Vbx_df_inj2_oc Vbx_df_inj2_scg Vbx_df_inj2_scw Vbx_df_inj3_oc Vbx_df_inj3_scg Vbx_df_inj3_scw Vbx_df_inj4_oc Vbx_df_inj4_scg Vbx_df_inj4_scw Vbx_diag_ena_inj1_oc Vbx_diag_ena_inj1_scg Vbx_diag_ena_inj1_scw Vbx_diag_ena_inj2_oc Vbx_diag_ena_inj2_scg Vbx_diag_ena_inj2_scw Vbx_diag_ena_inj3_oc Vbx_diag_ena_inj3_scg Vbx_diag_ena_inj3_scw Vbx_diag_ena_inj4_oc Vbx_diag_ena_inj4_scg Vbx_diag_ena_inj4_scw Vbx_inj_open cdn_diag_iv[0] cdn_diag_iv[1] cdn_diag_iv[2] cdn_diag_iv[3] crk_ctr_tmp crk_inj_ofs_cor_tmp crk_psn_eng_inj_upd eoi_1_mes[0] eoi_1_mes[1] eoi_1_mes[2] eoi_1_mes[3] eoi_2_mes[0] eoi_2_mes[1] eoi_2_mes[2] eoi_2_mes[3] err_sym_iv[0] err_sym_iv[1] err_sym_iv[2] err_sym_iv[3] fac_add_pulse inh_inj_tmp[0] inh_inj_tmp[1] inh_inj_tmp[2] inh_inj_tmp[3] inj_mod[0] inj_mod[1] inj_mod[2] inj_mod[3] inj_mod_global inj_mod_sp[0] inj_mod_sp[1] inj_mod_sp[2] inj_mod_sp[3] lv_add_pulse_ena lv_crash_act lv_inj_open lv_inj_open_drv_cycle lv_inj_upd_ack[0] lv_inj_upd_ack[1] lv_inj_upd_ack[2] lv_inj_upd_ack[3] lv_state_prev_iv[0] lv_state_prev_iv[1] lv_state_prev_iv[2] lv_state_prev_iv[3] lv_test_out_eol_fim_shrt nr_cyl_first nr_cyl_first_1 nr_cyl_first_2 nr_cyl_first_3 nr_trig_eoi_lim_av nr_trig_eoi_lim_prev prev_state_iv psn_dif_eng_syn psn_dif_eng_syn_thd soi_1_mes[0] soi_1_mes[1] soi_1_mes[2] soi_1_mes[3] soi_2_mes[0] soi_2_mes[1] soi_2_mes[2] soi_2_mes[3] state_inj_mod_req state_inj_upd_mod_cyl_ack state_sfg_upd state_st_pre ti_1_mes[0] ti_1_mes[1] ti_1_mes[2] ti_1_mes[3] ti_2_mes[0] ti_2_mes[1] ti_2_mes[2] ti_2_mes[3] ti_add_dly ti_add_pulse_min timer_pre_inj_fg lv_state_inj_cus_seq nr_tooth_pre_inj /end OUT_MEASUREMENT
/end FUNCTION
/begin FUNCTION BiPciBki ""
 /begin OUT_MEASUREMENT Vbx_sens_brk_pdl_open Vbx_sfty_sens_brk_pdl_open lv_bls lv_bls_mon lv_bts lv_bts_mon lv_clu_swi /end OUT_MEASUREMENT
/end FUNCTION
/begin FUNCTION BiPciDls "" /begin OUT_MEASUREMENT Vbx_raw_sens_bgin_clu_cnt /end OUT_MEASUREMENT /end FUNCTION
/begin FUNCTION PcPajCtl "" /begin SUB_FUNCTION PcPajCtl_Ajmodxx PcPajCtl_Ajspvxx PcPajCtl_Estixxx /end SUB_FUNCTION /end FUNCTION
/begin FUNCTION PcPajCtl_Ajmodxx ""
 /begin DEF_CHARACTERISTIC Ctb_ajs_drag_tq_fac Ctb_ajs_modu_n Ctb_ajs_modu_tkof_spt_fac Ctb_ajs_spv_spt_tq_fac Ctb_ajs_tq_fac Cmp_ajs_acel_slk_dly_t1 Cmp_ajs_acel_slk_dly_t1_fac Cmp_ajs_acel_slk_t1_ini_max Cmp_ajs_acel_slk_t1_ini_max_fac Cmp_ajs_decl_slk_dly_t1 Cmp_ajs_decl_slk_dly_t1_fac Cmp_ajs_decl_slk_t1_ini_max Cmp_ajs_decl_slk_t1_ini_max_fac Cmp_ajs_modu_t1_acel_driv_fac Cmp_ajs_modu_t1_acel_dt_clos Cmp_ajs_modu_t1_decl_driv_fac Cmp_ajs_modu_t1_decl_dt_clos Cmp_ajs_modu_td_acel_driv_fac Cmp_ajs_modu_td_acel_dt_clos Cmp_ajs_modu_td_decl_driv_fac Cmp_ajs_modu_td_decl_dt_clos Ctp_ajs_drag_t1_dly Ctp_ajs_modu_t1_acel_spt_fac Ctp_ajs_modu_t1_decl_spt_fac Ctp_ajs_modu_t1_tkof_dt_open Ctp_ajs_modu_td_acel_spt_fac Ctp_ajs_modu_td_decl_spt_fac Ctp_ajs_modu_td_tkof_dt_open Cbx_ajs_dt_slk_cfm Cbx_ajs_modu_stt_cfm Cbx_ajs_slk_td_cfm Cxx_ajs_modu_loss_fil_cut_thd Cxx_ajs_modu_slk_fil_t1_acel Cxx_ajs_modu_slk_fil_t1_decl Cxx_ajs_modu_t1_acel_dt_modu Cxx_ajs_modu_t1_acel_dt_open Cxx_ajs_modu_t1_decl_dt_modu Cxx_ajs_modu_t1_decl_dt_open Cxx_ajs_modu_t1_dt_clos_max Cxx_ajs_modu_t1_dt_ini Cxx_ajs_modu_t1_fast_cor Cxx_ajs_modu_td_acel_dt_modu Cxx_ajs_modu_td_acel_dt_open Cxx_ajs_modu_td_decl_dt_modu Cxx_ajs_modu_td_decl_dt_open Cxx_ajs_modu_td_dt_ini Cxx_ajs_modu_td_fast_cor Cxx_ajs_modu_tkof_vs_thd Cxx_ajs_modu_vs_thd_off Cxx_ajs_modu_vs_thd_on Cxx_ajs_n_mv_dft Cxx_ajs_slk_act_ctr Cxx_ajs_slk_td_ini_fac /end DEF_CHARACTERISTIC
 /begin OUT_MEASUREMENT Vbx_ajs_modu_loss_fil_cut Vbx_ajs_modu_stt_cut Vbx_ajs_modu_tkof_ena Vsx_ajs_modu_stt_para Vxx_ajs_driv_spt_fac Vxx_ajs_modu_n_mv Vxx_ajs_modu_t1 Vxx_ajs_modu_t1_acel Vxx_ajs_modu_t1_acel_dt_clos Vxx_ajs_modu_t1_acel_dt_open Vxx_ajs_modu_t1_acel_fac Vxx_ajs_modu_t1_bfr_drag Vxx_ajs_modu_t1_decl Vxx_ajs_modu_t1_decl_dt_clos Vxx_ajs_modu_t1_decl_fac Vxx_ajs_modu_t1_sp Vxx_ajs_modu_t1_tgt Vxx_ajs_modu_td Vxx_ajs_modu_td_acel Vxx_ajs_modu_td_acel_dt_clos Vxx_ajs_modu_td_acel_dt_open Vxx_ajs_modu_td_acel_fac Vxx_ajs_modu_td_decl Vxx_ajs_modu_td_decl_dt_clos Vxx_ajs_modu_td_decl_fac Vxx_ajs_modu_td_sp Vxx_ajs_modu_td_tgt Vxx_ajs_modu_tqe_sp Vxx_ajs_modu_tqe_sp_fil Vxx_ajs_modu_tqe_tgt Vxx_ajs_modu_tqe_tgt_fil Vxx_ajs_slk_dly_t1 Vxx_ajs_slk_t1_ini_max /end OUT_MEASUREMENT
/end FUNCTION
/begin FUNCTION PcPajCtl_Ajspvxx ""
 /begin DEF_CHARACTERISTIC Ctb_ajs_driv_tq_drv Ctb_ajs_gear_rat Ctb_ajs_spv_drag_tq_fac Ctb_ajs_spv_n Ctb_ajs_spv_tq_fac Cmp_ajs_spv_fast_cor_dly Ctp_ajs_coup_grip_rat Ctp_ajs_drag_acel_tq_diff_thd Ctp_ajs_drag_decl_tq_diff_thd Ctp_ajs_dt_gear_tq_rat Ctp_ajs_gear_rat Ctp_ajs_slk_tqe_off_acel Ctp_ajs_slk_tqe_off_decl Ctp_ajs_slk_tqe_on_acel Ctp_ajs_slk_tqe_on_decl Ctp_ajs_spv_driv_tq_drv Ctp_ajs_spv_fast_cor_dly_fac Cbx_ajs_dt_open_slk_cfm Cbx_ajs_fast_cor_cfm Cbx_ajs_no_drag_cfm Cbx_ajs_spv_cut_cfm Cbx_ajs_spv_grd_cfm Cbx_ajs_spv_stt_cfm Cbx_ajs_tqe_slk_cfm Cbx_dt_tq_rat_grip_cfm Csx_spv_tq_rat_drv_cfm Cxx_ajs_acel_tq_thd Cxx_ajs_decl_tq_thd Cxx_ajs_drag_pwt_sp_thd Cxx_ajs_drag_tq_drv_hys Cxx_ajs_drag_tq_drv_thd Cxx_ajs_driv_pwt_sp_fil Cxx_ajs_driv_pwt_sp_grd_hys Cxx_ajs_driv_pwt_sp_grd_thd Cxx_ajs_driv_pwt_sp_thd Cxx_ajs_dt_grip_rat_clos Cxx_ajs_dt_grip_rat_open Cxx_ajs_slk_drv_tq_thd_off Cxx_ajs_slk_drv_tq_thd_on Cxx_ajs_spd_diff_thd_off Cxx_ajs_spd_diff_thd_on Cxx_ajs_spv_driv_tq_t1_fil Cxx_ajs_spv_n_mv_thd Cxx_ajs_spv_slk_decl_dly Cxx_ajs_spv_tco_thd Cxx_ajs_spv_tq_drv_hys Cxx_ajs_spv_tq_drv_thd Cxx_ajs_spv_tq_rat_t1_fil Cxx_ajs_spv_tqe_tgt_thd Cxx_ajs_spv_wait_dly /end DEF_CHARACTERISTIC
 /begin OUT_MEASUREMENT Vbx_ajs_acel_decl_stt Vbx_ajs_cut_cdn_on Vbx_ajs_fast_cor_on Vbx_ajs_no_drag Vbx_ajs_pdl_cdn_on Vbx_ajs_slk_decl_off Vbx_ajs_slk_decl_on Vbx_ajs_slk_on Vbx_ajs_slk_on_prev Vbx_ajs_slk_tqe_decl_out Vbx_ajs_spv_stt_cut Vbx_ajs_tq_cdn_on Vbx_vs_n_rat_fil_on Vsx_ajs_dt_tq_rat_vld Vsx_ajs_spv_stt_para Vxx_ajs_coup_grip_rat Vxx_ajs_driv_pwt_sp_grd Vxx_ajs_driv_tq_drv Vxx_ajs_dt_grip_rat Vxx_ajs_dt_tq_rat Vxx_ajs_gear_rat_n Vxx_ajs_slk_tqe_sp Vxx_ajs_spd_diff Vxx_ajs_spv_driv_tq_drv Vxx_ajs_spv_driv_tq_fac Vxx_ajs_spv_driv_tq_rat Vxx_ajs_spv_fast_cor_dly /end OUT_MEASUREMENT
/end FUNCTION
/begin FUNCTION PcPajCtl_Estixxx "" /begin OUT_MEASUREMENT Vxx_ajs_esti_tqe /end OUT_MEASUREMENT /end FUNCTION
/begin FUNCTION SmCrkCtl ""
 /begin OUT_MEASUREMENT Vbx_sta_inj_stt Vbx_rest_stal Vbx_rest_cdn Vxx_inj_sta_dly Vxx_rest_ufld_ctr Vxx_mem_rest_cor Vxx_mem_rest_tco /end OUT_MEASUREMENT
 /begin SUB_FUNCTION SmCrkCtl_Rstxxxx SmCrkCtl_Ststtxx /end SUB_FUNCTION
/end FUNCTION
/begin FUNCTION SmCrkCtl_Rstxxxx ""
 /begin DEF_CHARACTERISTIC Ctb_rest_ufld_ctr Ctp_tco_min_rest_cor Ctp_ufld_rest_cor Cxx_rest1_ufld_cor Cxx_rest_tco_l_ofs Cxx_rest_tco_up_ofs Cxx_rest_ufld_cor Cxx_run_ufld_ctr_inc1 Cxx_run_ufld_ctr_inc2 Cxx_stal_rest_fac Cxx_stop_rest_tco_thd Cxx_stop_rest_ufld_thd Cxx_stop_ufld_ctr_inc /end DEF_CHARACTERISTIC
 /begin OUT_MEASUREMENT Vbx_ctr_act Vbx_equ_tco Vbx_rest_set_pws Vbx_t_ufld_ctr Vbx_tdc_ufld_ctr Vsx_rst Vxx_appl_rest_cor Vxx_ref_rest_cor /end OUT_MEASUREMENT
/end FUNCTION
/begin FUNCTION SmCrkCtl_Ststtxx "" /begin DEF_CHARACTERISTIC Ctp_tco_inj_sta_dly Ctp_tco_out_inj_sta_n_thd /end DEF_CHARACTERISTIC /end FUNCTION
/begin FUNCTION CbFfwTsp ""
 /begin SUB_FUNCTION CbFfwTsp_Clangxx CbFfwTsp_Fimspxx CbFfwTsp_Injstxx CbFfwTsp_Stfimxx CbFfwTsp_Waterxx CbFfwTsp_Dpresxx CbFfwTsp_Injctxx CbFfwTsp_Pinjxxx CbFfwTsp_Alcoxxx /end SUB_FUNCTION
/end FUNCTION
/begin FUNCTION CbFfwTsp_Clangxx ""
 /begin DEF_CHARACTERISTIC Ctb_vvtc_angl Cmp_perf_inj_clos_angl Cmp_polu_inj_clos_angl Ctp_n_clos_angl_tq_rat_thd Cbx_inj_clos_angl_bch_cfm Cxx_fil_perf_clos_angl_tdc_nr Cxx_fil_polu_clos_angl_tdc_nr Cxx_inj_clos_angl_bch Cxx_perf_inj_tco_thd /end DEF_CHARACTERISTIC
 /begin OUT_MEASUREMENT Vxx_fil_inj_clos_angl_fac Vxx_fil_inj_clos_angl_fac_inc Vxx_inj_clos_angl /end OUT_MEASUREMENT
/end FUNCTION
/begin FUNCTION CbFfwTsp_Fimspxx "" /begin DEF_CHARACTERISTIC Cbx_fim_bch Cxx_fim_bch Cxx_stoe_rat Cxx_stoe_rat_alco /end DEF_CHARACTERISTIC /begin OUT_MEASUREMENT Vxx_fim_sp Vxx_rich_sp /end OUT_MEASUREMENT /end FUNCTION
/begin FUNCTION CbFfwTsp_Injstxx ""
 /begin DEF_CHARACTERISTIC Ctb_eal_cylr Ctb_n_cylr Ctb_tco_ti_fac2 Cmp_eal_n_lean_cylr Cmp_eal_n_rich_cylr Ctp_cl_is_lean_cylr Ctp_cl_is_rich_cylr Ctp_ol_is_lean_cylr Ctp_ol_is_rich_cylr Ctp_tco_lean_cylr Ctp_tco_rich_cylr Ctp_tco_sta_out_sfg_dly Cbx_inj_seq_sta Cbx_inj_stt_tdc_ena Cbx_sfg_bch_cfm Cxx_cyl_nr Cxx_cylr_tco_thd Cxx_sfg_seq_trs_ctr Cxx_sfg_seq_trs_fim_fac Cxx_sfg_seq_trs_n_thd Cxx_tco_fail_sta_out_sfg_dly /end DEF_CHARACTERISTIC
 /begin OUT_MEASUREMENT Vbx_inj_efv_seq Vsx_inj_stt Vsx_inj_stt_cyl1 Vsx_inj_stt_cyl2 Vsx_inj_stt_cyl3 Vsx_inj_stt_cyl4 Vxx_adac_fim Vxx_cyl1_fim1 Vxx_cyl1_fim2 Vxx_cyl2_fim1 Vxx_cyl2_fim2 Vxx_cyl3_fim1 Vxx_cyl3_fim2 Vxx_cyl4_fim1 Vxx_cyl4_fim2 Vxx_cylr_lean_fac Vxx_cylr_rich_fac Vxx_sfg_seq_trs_ctr Vxx_sta_out_sfg_ti_ctr Vxx_sta_out_sfg_ti_ctr_ini /end OUT_MEASUREMENT
/end FUNCTION
/begin FUNCTION CbFfwTsp_Stfimxx ""
 /begin DEF_CHARACTERISTIC Ctb_n_sta Ctp_n_sta_fim_fac Ctp_tco_dec_sta_fim Ctp_tco_sta_fim Cxx_dec_sta_ti_rest_fac /end DEF_CHARACTERISTIC
 /begin OUT_MEASUREMENT Vbx_tdc_sta_fim_ena Vxx_dec_sta_fim Vxx_sta_fim /end OUT_MEASUREMENT
/end FUNCTION
/begin FUNCTION CbFfwTsp_Waterxx ""
 /begin DEF_CHARACTERISTIC Ntb_mat Ntb_tco Cmp_n_prs_lean_ti_ofs Cmp_n_prs_tco_ti_fac Ctp_tco_lean_ti_ofs Ctp_tco_sta_rich_dec Ctp_tco_sta_ti_ofs Ctp_tco_ti_ofs1 Ctp_tco_ti_ofs2 Ctp_tia_sta_ti_ofs Cxx_aper_rich_sta_tco_thd Cxx_aper_rich_sta_tia_thd Cxx_rest_mod_dsb_max_dly Cxx_rest_mod_dsb_tco_thd Cxx_rich_sta_tco_thd Cxx_rich_tia_thd Cxx_sta_rich_dec_nr Cxx_sta_tco_ti_dec_fac Cxx_sta_tco_ti_dec_fac_alco Cxx_sta_tco_ti_dec_rest_fac Cxx_sta_tco_ti_rest_fac Cxx_tco_ti_fil_nr /end DEF_CHARACTERISTIC
 /begin OUT_MEASUREMENT Vbx_cata_wup_lean Vbx_sta_tco_ti_ofs_mod Vbx_ti_cor_rest_pws_set Vxx_sta_rich_tdc_dec_nr Vxx_sta_tco_ti_ofs Vxx_sta_tco_ti_ofs_init Vxx_tco_lean_ti_fac Vxx_tco_rich_ti_fac Vxx_tco_ti_cor Vxx_tco_ti_cor_fil_ctr Vxx_tco_ti_fac Vxx_tco_ti_ofs1 Vxx_tco_ti_ofs2 /end OUT_MEASUREMENT
/end FUNCTION
/begin FUNCTION CbFfwTsp_Dpresxx "" /begin DEF_CHARACTERISTIC Ctb_prs_dif_ti Cmp_prs_dif_ti_cor /end DEF_CHARACTERISTIC /begin OUT_MEASUREMENT Vxx_prs_dif_ti Vxx_prs_dif_ti_cor /end OUT_MEASUREMENT /end FUNCTION
/begin FUNCTION CbFfwTsp_Injctxx ""
 /begin DEF_CHARACTERISTIC Cbx_bch_inj1_cut_req Cbx_bch_inj2_cut_req Cbx_bch_inj3_cut_req Cbx_bch_inj4_cut_req Cbx_inj_cut_seq Cbx_wet_bch_mod Cbx_wet_ti_cut_bch_mod /end DEF_CHARACTERISTIC
 /begin OUT_MEASUREMENT Vbx_dft_inj1_cut Vbx_dft_inj2_cut Vbx_dft_inj3_cut Vbx_dft_inj4_cut Vbx_inj1_cut Vbx_inj1_cut_req Vbx_inj2_cut Vbx_inj2_cut_req Vbx_inj3_cut Vbx_inj3_cut_req Vbx_inj4_cut Vbx_inj4_cut_req Vbx_inj_cut_rst Vbx_inj_ena Vbx_lih_inj1_cut_req Vbx_lih_inj2_cut_req Vbx_lih_inj3_cut_req Vbx_lih_inj4_cut_req Vxx_efv_inj_cut_nr Vxx_efv_req_inj_cut_nr Vxx_inj_avl_nr Vxx_inj_cut_nr Vxx_next_inj_cut_tdc_nr Vxx_next_inj_open_tdc_nr Vxx_prev_inj_cut_nr /end OUT_MEASUREMENT
/end FUNCTION
/begin FUNCTION CbFfwTsp_Pinjxxx ""
 /begin DEF_CHARACTERISTIC Ctp_tco_amp_pinj_cor_fac Ctp_tco_pinj_fim Cbx_pinj_seq_cfm Cxx_inj1_pinj_clos_angl Cxx_inj2_pinj_clos_angl Cxx_inj3_pinj_clos_angl Cxx_inj4_pinj_clos_angl Cxx_rest_pinj_cor_fac Cxx_sta_pinj_toth_nr Cxx_sta_tco_vld_nok /end DEF_CHARACTERISTIC
 /begin OUT_MEASUREMENT Vbx_ecu_rst_pinj_dsb Vbx_ecu_rst_pinj_ena Vbx_pinj Vbx_pinj_seq_cfm Vxx_inj1_pinj_clos_angl Vxx_inj2_pinj_clos_angl Vxx_inj3_pinj_clos_angl Vxx_inj4_pinj_clos_angl Vxx_pinj_fim Vxx_sta_pinj_toth_nr Vxx_vld_tco /end OUT_MEASUREMENT
/end FUNCTION
/end MODULE
/end PROJECT
