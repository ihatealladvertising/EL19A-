ASAP2_VERSION 1 41
/begin PROJECT RD8 "_default_ProjectLongIdentifier"
/begin HEADER "_default_HeaderComment" PROJECT_NO RD9 /end HEADER
/begin MODULE _default_ModuleName "_default_ModuleLongIdentifier"
/begin MOD_COMMON "_default_ModCommonComment" DEPOSIT ABSOLUTE BYTE_ORDER MSB_LAST ALIGNMENT_BYTE 1 ALIGNMENT_WORD 2 ALIGNMENT_LONG 2 ALIGNMENT_FLOAT32_IEEE 2 ALIGNMENT_FLOAT64_IEEE 4 /end MOD_COMMON
/begin AXIS_PTS Ctb_tco2 "Engine coolant temperature breakpoints" 0xa002e01c Vxx_tco _REC_A2AXS_20_u2 240. _CNV_A_R_LINEAR_____54_CM 9 -40. 200. FORMAT "%5.1" /end AXIS_PTS
/begin MEASUREMENT Vbx_alt_pwm_dft "Alternator load failure" UBYTE _CNV_S_2_RANGE______3_CM 1 0. 0. 1. ECU_ADDRESS 0xd00056c5 BIT_MASK 0x1 /end MEASUREMENT
/begin MEASUREMENT Vbx_ptc_pow_dec "PTC power decrease detected. Leads to current PTC power correction interuption." UBYTE _CNV_S_2_RANGE______3_CM 1 0. 0. 1. ECU_ADDRESS 0xd00056c6 BIT_MASK 0x1 /end MEASUREMENT
/begin MEASUREMENT Vbx_ptc_pow_inc "PTC power increase detected. Leads to PTC power correction activation" UBYTE _CNV_S_2_RANGE______3_CM 1 0. 0. 1. ECU_ADDRESS 0xd00056c7 BIT_MASK 0x1 /end MEASUREMENT
/begin MEASUREMENT Vbx_pwst_off_dly "Vbx_pwst_prs_stt has been off since Cxx_pwst_off_is_cor_dly" UBYTE _CNV_S_2_RANGE______3_CM 1 0. 0. 1. ECU_ADDRESS 0xd00056c8 BIT_MASK 0x1 /end MEASUREMENT
/begin MEASUREMENT Vxx_alt_pow_cor "Electrical consumer modelised power correction for activation" UWORD _CNV_A_R_LINEAR_____128_CM 1 0. 0. 655350. ECU_ADDRESS 0xd000596c FORMAT "%6.0" /end MEASUREMENT
/begin MEASUREMENT Vxx_el_bk_pow_cor "Electric backlite power correction" UWORD _CNV_A_R_LINEAR_____128_CM 1 0. 0. 655350. ECU_ADDRESS 0xd000596e FORMAT "%6.0" /end MEASUREMENT
/begin MEASUREMENT Vxx_el_wind_pow_cor "Electric windshield power correction" UWORD _CNV_A_R_LINEAR_____128_CM 1 0. 0. 655350. ECU_ADDRESS 0xd0005970 FORMAT "%6.0" /end MEASUREMENT
/begin MEASUREMENT Vxx_mdf1_pow_cor "low engine speed fan power correction" UWORD _CNV_A_R_LINEAR_____128_CM 1 0. 0. 655350. ECU_ADDRESS 0xd0005972 FORMAT "%6.0" /end MEASUREMENT
/begin MEASUREMENT Vxx_mdf2_pow_cor "High engine speed fan power correction" UWORD _CNV_A_R_LINEAR_____128_CM 1 0. 0. 655350. ECU_ADDRESS 0xd0005974 FORMAT "%6.0" /end MEASUREMENT
/begin MEASUREMENT Vxx_ptc_pow_cor "PTC power correction" UWORD _CNV_A_R_LINEAR_____128_CM 1 0. 0. 655350. ECU_ADDRESS 0xd0005976 FORMAT "%6.0" /end MEASUREMENT
/begin MEASUREMENT Vxx_ptc_pow_cor_dly "Remaining duration of PTC power correction" UWORD _CNV_A_R_LINEAR_____34_CM 1 0. 0. 655.35 ECU_ADDRESS 0xd0005978 FORMAT "%6.2" /end MEASUREMENT
/begin MEASUREMENT Vxx_ptc_pow_cor_dly1 "Remaining time before PTC power correction activation" UWORD _CNV_A_R_LINEAR_____34_CM 1 0. 0. 655.35 ECU_ADDRESS 0xd000597a FORMAT "%6.2" /end MEASUREMENT
/begin MEASUREMENT Vxx_ptc_pow_inc "PTC power increase value used to compute PTC power correction." UWORD _CNV_A_R_LINEAR_____128_CM 1 0. 0. 655350. ECU_ADDRESS 0xd000597c FORMAT "%6.0" /end MEASUREMENT
/begin MEASUREMENT Vxx_pwst_prs_pow_cor "Power steering manostat activation power correction" UWORD _CNV_A_R_LINEAR_____128_CM 1 0. 0. 655350. ECU_ADDRESS 0xd000597e FORMAT "%6.0" /end MEASUREMENT
/begin MEASUREMENT Vxx_rgb_pump_pow_cor "RGB power correction" UWORD _CNV_A_R_LINEAR_____128_CM 1 0. 0. 655350. ECU_ADDRESS 0xd0005980 FORMAT "%6.0" /end MEASUREMENT
/begin CHARACTERISTIC Cxx_alt_pow_cor_slop "Alternator power correction slope" VALUE 0xa00219b4 _REC_S1VAL_20_u2 655350. _CNV_A_R_LINEAR_____290_CM 0. 655350. FORMAT "%6.0" /end CHARACTERISTIC
/begin CHARACTERISTIC Cxx_alt_pwm_dft_alt_pow_fac "Factor on alt.power corr. in case of alternator load failure" VALUE 0xa00219dc _REC_S1VAL_20_u1 1. _CNV_A_R_LINEAR_____118_CM 0. 1. FORMAT "%9.7" /end CHARACTERISTIC
/begin CHARACTERISTIC Cxx_alt_pwm_dft_pwst_pow_fac "Factor on PWSTpower corr. in case of alternator load failure" VALUE 0xa00219dd _REC_S1VAL_20_u1 1. _CNV_A_R_LINEAR_____118_CM 0. 1. FORMAT "%9.7" /end CHARACTERISTIC
/begin CHARACTERISTIC Cxx_el_bk_wind_dly "Duration before alternator (electric backlite) power correction activation" VALUE 0xa00219b6 _REC_S1VAL_20_u2 655.35 _CNV_A_R_LINEAR_____34_CM 0. 655.35 FORMAT "%6.2" /end CHARACTERISTIC
/begin CHARACTERISTIC Cxx_el_bk_wind_pow_cor "alternator power correction for electric backlite activation" VALUE 0xa00219b8 _REC_S1VAL_20_u2 655350. _CNV_A_R_LINEAR_____128_CM 0. 655350. FORMAT "%6.0" /end CHARACTERISTIC
/begin CHARACTERISTIC Cxx_el_bk_wind_pow_cor_dly "Duration of alternator (electric backlite) power correction before decrementation" VALUE 0xa00219ba _REC_S1VAL_20_u2 655.35 _CNV_A_R_LINEAR_____34_CM 0. 655.35 FORMAT "%6.2" /end CHARACTERISTIC
/begin CHARACTERISTIC Cxx_el_wind_dly "Duration before alternator (electric windshield) power correction activation" VALUE 0xa00219bc _REC_S1VAL_20_u2 655.35 _CNV_A_R_LINEAR_____34_CM 0. 655.35 FORMAT "%6.2" /end CHARACTERISTIC
/begin CHARACTERISTIC Cxx_el_wind_pow_cor "alternator power correction for electric windshield activation" VALUE 0xa00219be _REC_S1VAL_20_u2 655350. _CNV_A_R_LINEAR_____128_CM 0. 655350. FORMAT "%6.0" /end CHARACTERISTIC
/begin CHARACTERISTIC Cxx_el_wind_pow_cor_dly "Duration of alternator (electric windshield) power correction before decrementation" VALUE 0xa00219c0 _REC_S1VAL_20_u2 655.35 _CNV_A_R_LINEAR_____34_CM 0. 655.35 FORMAT "%6.2" /end CHARACTERISTIC
/begin CHARACTERISTIC Cxx_mdf1_meca_pow_cor "alternator power correction for low engine speed fan activation" VALUE 0xa00219c2 _REC_S1VAL_20_u2 655350. _CNV_A_R_LINEAR_____128_CM 0. 655350. FORMAT "%6.0" /end CHARACTERISTIC
/begin CHARACTERISTIC Cxx_mdf1_meca_pow_cor_dly "Duration of alternator (MDF 1) power correction before decrementation" VALUE 0xa00219c4 _REC_S1VAL_20_u2 655.35 _CNV_A_R_LINEAR_____34_CM 0. 655.35 FORMAT "%6.2" /end CHARACTERISTIC
/begin CHARACTERISTIC Cxx_mdf2_meca_pow_cor "alternator power correction for high engine speed fan activation" VALUE 0xa00219c6 _REC_S1VAL_20_u2 655350. _CNV_A_R_LINEAR_____128_CM 0. 655350. FORMAT "%6.0" /end CHARACTERISTIC
/begin CHARACTERISTIC Cxx_mdf2_meca_pow_cor_dly "Duration of alternator (MDF 2) power correction before decrementation" VALUE 0xa00219c8 _REC_S1VAL_20_u2 655.35 _CNV_A_R_LINEAR_____34_CM 0. 655.35 FORMAT "%6.2" /end CHARACTERISTIC
/begin CHARACTERISTIC Cxx_mdf_meca_pow_cor_dly1 "Duration before alternator (MDF) power correction activation" VALUE 0xa00219ca _REC_S1VAL_20_u2 655.35 _CNV_A_R_LINEAR_____34_CM 0. 655.35 FORMAT "%6.2" /end CHARACTERISTIC
/begin CHARACTERISTIC Cxx_ptc_meca_pow_cor_dly "Duration of alternator (PTC) power correction before decrementation" VALUE 0xa00219cc _REC_S1VAL_20_u2 655.35 _CNV_A_R_LINEAR_____34_CM 0. 655.35 FORMAT "%6.2" /end CHARACTERISTIC
/begin CHARACTERISTIC Cxx_ptc_meca_pow_cor_dly1 "Duration before alternator (PTC) power correction activation" VALUE 0xa00219ce _REC_S1VAL_20_u2 655.35 _CNV_A_R_LINEAR_____34_CM 0. 655.35 FORMAT "%6.2" /end CHARACTERISTIC
/begin CHARACTERISTIC Cxx_ptc_meca_pow_cor_fac "Proportionnal factor on PTC power increase to compute alt.power corr. for PTC" VALUE 0xa00219de _REC_S1VAL_20_u1 1. _CNV_A_R_LINEAR_____118_CM 0. 1. FORMAT "%9.7" /end CHARACTERISTIC
/begin CHARACTERISTIC Cxx_pwst_on_is_cor_dly "Duration of (PDA) power correction before decrementation" VALUE 0xa00219d0 _REC_S1VAL_20_u2 655.35 _CNV_A_R_LINEAR_____34_CM 0. 655.35 FORMAT "%6.2" /end CHARACTERISTIC
/begin CHARACTERISTIC Cxx_rgb_pump_pow_cor "alternator power correction for Robotized gearbox electro hydraulical pump activation" VALUE 0xa00219d2 _REC_S1VAL_20_u2 655350. _CNV_A_R_LINEAR_____128_CM 0. 655350. FORMAT "%6.0" /end CHARACTERISTIC
/begin CHARACTERISTIC Cxx_rgb_pump_pow_cor_dly "Duration of alternator (Robotized gearbox electro hydraulical pump) power correction before decrementation" VALUE 0xa00219d4 _REC_S1VAL_20_u2 655.35 _CNV_A_R_LINEAR_____34_CM 0. 655.35 FORMAT "%6.2" /end CHARACTERISTIC
/begin CHARACTERISTIC Cxx_rgb_pump_pow_cor_dly1 "Duration before alternator (RGB electro. hydrau. pump) power correction activation" VALUE 0xa00219d6 _REC_S1VAL_20_u2 655.35 _CNV_A_R_LINEAR_____34_CM 0. 655.35 FORMAT "%6.2" /end CHARACTERISTIC
/begin CHARACTERISTIC Cxx_vh_run_tmp_pwst_cor "Power correction for PDA, running vehicle" VALUE 0xa00219d8 _REC_S1VAL_20_u2 655350. _CNV_A_R_LINEAR_____128_CM 0. 655350. FORMAT "%6.0" /end CHARACTERISTIC
/begin CHARACTERISTIC Cxx_vh_stop_tmp_pwst_cor "Power correction for PDA, stopped vehicle" VALUE 0xa00219da _REC_S1VAL_20_u2 655350. _CNV_A_R_LINEAR_____128_CM 0. 655350. FORMAT "%6.0" /end CHARACTERISTIC
/begin MEASUREMENT Vxx_mdl_ptc_pow "Modelised PTC power" UWORD _CNV_A_R_LINEAR_____128_CM 1 0. 0. 655350. ECU_ADDRESS 0xd0005b5c FORMAT "%6.0" /end MEASUREMENT
/begin AXIS_PTS Ctb_min_max_forc_vs "Vehicle speed  breakpoints for mi/max force tables" 0xa0028258 Vxx_vs _REC_A2AXS_20_u2 655.35 _CNV_A_R_LINEAR_____70_CM 9 0. 655.35 FORMAT "%6.2" /end AXIS_PTS
/begin CHARACTERISTIC Ctp_max_forc "Max force table for force => powertrain setpoint conversion" CURVE 0xa002826c _REC_A1CUR_20_u2_u2 131068. _CNV_A_R_LINEAR_____294_CM -20000. 111068. FORMAT "%6.0"
 /begin AXIS_DESCR COM_AXIS Vxx_vs _CNV_A_R_LINEAR_____70_CM 9 0. 655.35 FORMAT "%6.2" AXIS_PTS_REF Ctb_min_max_forc_vs /end AXIS_DESCR
/end CHARACTERISTIC
/begin CHARACTERISTIC Ctp_min_forc "Min force table for force => powertrain setpoint conversion" CURVE 0xa0028280 _REC_A1CUR_20_u2_u2 131068. _CNV_A_R_LINEAR_____294_CM -20000. 111068. FORMAT "%6.0"
 /begin AXIS_DESCR COM_AXIS Vxx_vs _CNV_A_R_LINEAR_____70_CM 9 0. 655.35 FORMAT "%6.2" AXIS_PTS_REF Ctb_min_max_forc_vs /end AXIS_DESCR
/end CHARACTERISTIC
/begin MEASUREMENT Vbx_cru_acc_virt_driv_on "Accelerator pedal request overrun by a cruise control virtual driver (CC/ACC only)" UBYTE _CNV_S_2_RANGE______3_CM 1 0. 0. 1. ECU_ADDRESS 0xd00043d0 BIT_MASK 0x1 /end MEASUREMENT
/begin MEASUREMENT Vbx_no_driv_pwt_sp "no powertrain setpoint requested by real (pedal) and virtual (ACC/CC/SL) drivers" UBYTE _CNV_S_2_RANGE______3_CM 1 0. 0. 1. ECU_ADDRESS 0xd00043d1 BIT_MASK 0x1 /end MEASUREMENT
/begin MEASUREMENT Vbx_virt_driv_on "Accelerator pedal request overrun by a virtual driver (CC/SL/ACC)" UBYTE _CNV_S_2_RANGE______3_CM 1 0. 0. 1. ECU_ADDRESS 0xd00043d2 BIT_MASK 0x1 /end MEASUREMENT
/begin MEASUREMENT Vsx_driv_pwt_sp_vld "Powertrain setpoint (%) requested by real (pedal) and virtual (ACC/CC/SL) drivers validity status" UBYTE _CNV_A_R_ECME_LINEA_0_CM 1 0. 0. 255. ECU_ADDRESS 0xd00043d3 FORMAT "%3.0" /end MEASUREMENT
/begin MEASUREMENT Vxx_acc_pwt_sp "Powertrain setpoint (%) requested by ACC" UWORD _CNV_A_R_LINEAR_____185_CM 1 0. 0. 1. ECU_ADDRESS 0xd0002d50 FORMAT "%7.5" /end MEASUREMENT
/begin MEASUREMENT Vxx_acel_pdl_forc_sp "Driving force requested by the driver via the accelerator pedal" SLONG _CNV_A_R_LINEAR_____295_CM 1 0. -20000. 111068. ECU_ADDRESS 0xd00014d0 FORMAT "%6.0" /end MEASUREMENT
/begin MEASUREMENT Vxx_arb_driv_pwt_sp "Powertrain setpoint (%) requested by real (pedal) and virtual (ACC/CC/SL) drivers before foot-up correction" UWORD _CNV_A_R_LINEAR_____185_CM 1 0. 0. 1. ECU_ADDRESS 0xd0002d52 FORMAT "%7.5" /end MEASUREMENT
/begin MEASUREMENT Vxx_cru_pwt_sp "Powertrain setpoint (%) requested by Cruise Control" UWORD _CNV_A_R_LINEAR_____185_CM 1 0. 0. 1. ECU_ADDRESS 0xd0002d54 FORMAT "%7.5" /end MEASUREMENT
/begin MEASUREMENT Vxx_driv_pwt_sp "Powertrain setpoint (%) requested by real (pedal) and virtual (ACC/CC/SL) drivers" UWORD _CNV_A_R_LINEAR_____185_CM 1 0. 0. 1. ECU_ADDRESS 0xd0002d56 FORMAT "%7.5" /end MEASUREMENT
/begin MEASUREMENT Vxx_max_forc "Longitudinal force equivalent to a 100% accelerator pedal demand" SLONG _CNV_A_R_LINEAR_____295_CM 1 0. -20000. 111068. ECU_ADDRESS 0xd00014d4 FORMAT "%6.0" /end MEASUREMENT
/begin MEASUREMENT Vxx_min_forc "Longitudinal force equivalent to a 0% accelerator pedal demand" SLONG _CNV_A_R_LINEAR_____295_CM 1 0. -20000. 111068. ECU_ADDRESS 0xd00014d8 FORMAT "%6.0" /end MEASUREMENT
/begin MEASUREMENT Vxx_sdl_pwt_sp "Powertrain setpoint (%) requested by SDL (Speed and distance limiter function located in ACC)" UWORD _CNV_A_R_LINEAR_____185_CM 1 0. 0. 1. ECU_ADDRESS 0xd0002d58 FORMAT "%7.5" /end MEASUREMENT
/begin MEASUREMENT Vxx_sl_pwt_sp "Powertrain setpoint (%) requested by Speed Limiter" UWORD _CNV_A_R_LINEAR_____185_CM 1 0. 0. 1. ECU_ADDRESS 0xd0002d5a FORMAT "%7.5" /end MEASUREMENT
/begin CHARACTERISTIC Cxx_no_driv_pwt_sp_hys "Hysteresis for no powertrain setpoint requested" VALUE 0xa002157c _REC_S1VAL_20_u2 1. _CNV_A_R_LINEAR_____185_CM 0. 1. FORMAT "%7.5" /end CHARACTERISTIC
/begin CHARACTERISTIC Cxx_no_driv_pwt_sp_thd "Threshold for no powertrain setpoint resquested" VALUE 0xa002157e _REC_S1VAL_20_u2 1. _CNV_A_R_LINEAR_____185_CM 0. 1. FORMAT "%7.5" /end CHARACTERISTIC
/begin CHARACTERISTIC Cxx_no_virt_driv_pwt_sp_hys "Hysteresis for no powertrain setpoint requested by virtual driver" VALUE 0xa0021580 _REC_S1VAL_20_u2 1. _CNV_A_R_LINEAR_____185_CM 0. 1. FORMAT "%7.5" /end CHARACTERISTIC
/begin CHARACTERISTIC Cxx_no_virt_driv_pwt_sp_thd "Threshold for no powertrain setpoint resquested by virtual driver" VALUE 0xa0021582 _REC_S1VAL_20_u2 1. _CNV_A_R_LINEAR_____185_CM 0. 1. FORMAT "%7.5" /end CHARACTERISTIC
/begin AXIS_PTS Ctb_driv_tqe_map_n "Engine speed breakpoints for engine torque setpoint map" 0xa00262d0 Vxx_n_mv _REC_A2AXS_20_u2 16383.75 _CNV_A_R_ENSD_LINEA_24_CM 20 0. 16383.75 FORMAT "%8.2" /end AXIS_PTS
/begin AXIS_PTS Ctb_driv_tqe_map_pwt_sp "Powertrain setpoint breakpoints for engine torque setpoint map" 0xa00262fc Vxx_driv_pwt_sp _REC_A2AXS_20_u2 1. _CNV_A_R_LINEAR_____185_CM 17 0. 1. FORMAT "%7.5" /end AXIS_PTS
/begin AXIS_PTS Ctb_min_driv_tqe_pwt_sp "Powertrain setpoint breakpoints for minimum driver engine torque factor" 0xa0026320 Vxx_driv_pwt_sp _REC_A2AXS_20_u2 1. _CNV_A_R_LINEAR_____185_CM 17 0. 1. FORMAT "%7.5" /end AXIS_PTS
/begin CHARACTERISTIC Cmp_driv_tqe_map "Map giving effective engine torque setpoint from powertrain setpoint and engine speed (only positiv" MAP 0xa0026344 _REC_A1MAP_20_u2_u2_u2 2047.96875 _CNV_A_R_LINEAR_____123_CM 0. 2047.96875 FORMAT "%10.5"
 /begin AXIS_DESCR COM_AXIS Vxx_driv_pwt_sp _CNV_A_R_LINEAR_____185_CM 17 0. 1. FORMAT "%7.5" AXIS_PTS_REF Ctb_driv_tqe_map_pwt_sp /end AXIS_DESCR
 /begin AXIS_DESCR COM_AXIS Vxx_n_mv _CNV_A_R_ENSD_LINEA_24_CM 20 0. 16383.75 FORMAT "%8.2" AXIS_PTS_REF Ctb_driv_tqe_map_n /end AXIS_DESCR
/end CHARACTERISTIC
/begin CHARACTERISTIC Cmp_min_driv_tqe_map "Format the powertrain setpoint to disable the minimum driver engine torque" MAP 0xa00265ec _REC_A1MAP_20_u2_u2_u2 1. _CNV_A_R_LINEAR_____185_CM 0. 1. FORMAT "%7.5"
 /begin AXIS_DESCR COM_AXIS Vxx_driv_pwt_sp _CNV_A_R_LINEAR_____185_CM 17 0. 1. FORMAT "%7.5" AXIS_PTS_REF Ctb_min_driv_tqe_pwt_sp /end AXIS_DESCR
 /begin AXIS_DESCR COM_AXIS Vxx_tco _CNV_A_R_LINEAR_____54_CM 9 -40. 200. FORMAT "%5.1" AXIS_PTS_REF Ctb_tco2 /end AXIS_DESCR
/end CHARACTERISTIC
/begin MEASUREMENT Vxx_driv_tqe_sp "Effective engine torque requested by real (pedal) and virtual (ACC/CC/SL) drivers" UWORD _CNV_A_R_LINEAR_____161_CM 1 0. -400. 1647.96875 ECU_ADDRESS 0xd0002c70 FORMAT "%10.5" /end MEASUREMENT
/begin MEASUREMENT Vxx_main_driv_tqe_sp "Driver engine torque setpoint without engine brake part (output of torque setpoint map)" UWORD _CNV_A_R_LINEAR_____161_CM 1 0. -400. 1647.96875 ECU_ADDRESS 0xd0002c72 FORMAT "%10.5" /end MEASUREMENT
/begin CHARACTERISTIC Cbx_ref_max_pow_cfm "Option selecting explicit power calculation of driver torque setpoint" VALUE 0xa0020a05 _REC_S1VAL_20_u1 1. _CNV_A_R_ECME_LINEA_0_CM 0. 1. FORMAT "%1.0" BIT_MASK 0x1 /end CHARACTERISTIC
/begin CHARACTERISTIC Cxx_ref_max_pow "Reference max power for powertrain setpoint normalisation" VALUE 0xa0020a06 _REC_S1VAL_20_u1 500000. _CNV_A_R_LINEAR_____296_CM 0. 500000. FORMAT "%6.0" /end CHARACTERISTIC
/begin AXIS_PTS Ctb_acel_pdl_fmt "Pedal ratio breakpoints for pedal progressivity maps" 0xa0026b3c Vxx_acel_pdl_rat _REC_A2AXS_20_u2 1. _CNV_A_R_LINEAR_____185_CM 17 0. 1. FORMAT "%7.5" /end AXIS_PTS
/begin AXIS_PTS Ctb_acel_pdl_fmt_fac_driv "Driving style breakpoints for map giving transition factor between 2 progressivity maps" 0xa0020976 Vxx_driv_spt_fac _REC_A2AXS_20_u1 1. _CNV_A_R_LINEAR_____118_CM 5 0. 1. FORMAT "%9.7" /end AXIS_PTS
/begin AXIS_PTS Ctb_acel_pdl_fmt_fac_vs "Vehicle speed breakpoints for map giving transition factor between 2 progressivity maps" 0xa0026b60 Vxx_vs _REC_A2AXS_20_u2 655.35 _CNV_A_R_LINEAR_____70_CM 9 0. 655.35 FORMAT "%6.2" /end AXIS_PTS
/begin AXIS_PTS Ctb_acel_pdl_fmt_tkof_fac_driv "take off assistance factor breakpoints for \"take off map\" giving transition factor between 2 progressivity maps" 0xa002097c Vxx_tkof_ass_fac _REC_A2AXS_20_u1 1. _CNV_A_R_LINEAR_____216_CM 5 0. 1. FORMAT "%5.3" /end AXIS_PTS
/begin AXIS_PTS Ctb_acel_pdl_fmt_tkof_fac_vs "Vehicle speed breakpoints for \"take off map\" giving transition factor between 2 progressivity maps" 0xa0026b74 Vxx_vs _REC_A2AXS_20_u2 655.35 _CNV_A_R_LINEAR_____70_CM 5 0. 655.35 FORMAT "%6.2" /end AXIS_PTS
/begin CHARACTERISTIC Cmp_acel_pdl_fmt_fac "Vehicle speed and driving style map giving transition factor between 2 progressivity maps" MAP 0xa0026b80 _REC_A1MAP_20_u1_u2_u1 1. _CNV_A_R_LINEAR_____118_CM 0. 1. FORMAT "%9.7"
 /begin AXIS_DESCR COM_AXIS Vxx_vs _CNV_A_R_LINEAR_____70_CM 9 0. 655.35 FORMAT "%6.2" AXIS_PTS_REF Ctb_acel_pdl_fmt_fac_vs /end AXIS_DESCR
 /begin AXIS_DESCR COM_AXIS Vxx_driv_spt_fac _CNV_A_R_LINEAR_____118_CM 5 0. 1. FORMAT "%9.7" AXIS_PTS_REF Ctb_acel_pdl_fmt_fac_driv /end AXIS_DESCR
/end CHARACTERISTIC
/begin CHARACTERISTIC Cmp_acel_pdl_fmt_tkof_fac "Vehicle speed and take off assistance factor map giving transition factor between 2 progressivity maps" MAP 0xa0026bb0 _REC_A1MAP_20_u1_u2_u1 1. _CNV_A_R_LINEAR_____216_CM 0. 1. FORMAT "%5.3"
 /begin AXIS_DESCR COM_AXIS Vxx_vs _CNV_A_R_LINEAR_____70_CM 5 0. 655.35 FORMAT "%6.2" AXIS_PTS_REF Ctb_acel_pdl_fmt_tkof_fac_vs /end AXIS_DESCR
 /begin AXIS_DESCR COM_AXIS Vxx_tkof_ass_fac _CNV_A_R_LINEAR_____216_CM 5 0. 1. FORMAT "%5.3" AXIS_PTS_REF Ctb_acel_pdl_fmt_tkof_fac_driv /end AXIS_DESCR
/end CHARACTERISTIC
/begin CHARACTERISTIC Ctp_acel_pdl_fmt_1 "Pedal progressivity map  n∞1" CURVE 0xa0026bcc _REC_A1CUR_20_u2_u2 1. _CNV_A_R_LINEAR_____93_CM 0. 1. FORMAT "%11.9"
 /begin AXIS_DESCR COM_AXIS Vxx_acel_pdl_rat _CNV_A_R_LINEAR_____185_CM 17 0. 1. FORMAT "%7.5" AXIS_PTS_REF Ctb_acel_pdl_fmt /end AXIS_DESCR
/end CHARACTERISTIC
/begin CHARACTERISTIC Ctp_acel_pdl_fmt_2 "Pedal progressivity map  n∞2" CURVE 0xa0026bf0 _REC_A1CUR_20_u2_u2 1. _CNV_A_R_LINEAR_____93_CM 0. 1. FORMAT "%11.9"
 /begin AXIS_DESCR COM_AXIS Vxx_acel_pdl_rat _CNV_A_R_LINEAR_____185_CM 17 0. 1. FORMAT "%7.5" AXIS_PTS_REF Ctb_acel_pdl_fmt /end AXIS_DESCR
/end CHARACTERISTIC
/begin MEASUREMENT Vsx_acel_pdl_pwt_sp_vld "Powertrain setpoint (%) requested by the driver via the accelerator pedal validity status" UBYTE _CNV_A_R_ECME_LINEA_0_CM 1 0. 0. 255. ECU_ADDRESS 0xd0004da7 FORMAT "%3.0" /end MEASUREMENT
/begin MEASUREMENT Vxx_acel_pdl_fmt_fac "Interpolation factor between pedal progressivity maps (0<=>map1, 1<=>map2)" UBYTE _CNV_A_R_LINEAR_____118_CM 1 0. 0. 1. ECU_ADDRESS 0xd0004da8 FORMAT "%9.7" /end MEASUREMENT
/begin MEASUREMENT Vxx_acel_pdl_pwt_sp "Powertrain setpoint (%) requested by the driver via the accelerator pedal" UWORD _CNV_A_R_LINEAR_____185_CM 1 0. 0. 1. ECU_ADDRESS 0xd00039c2 FORMAT "%7.5" /end MEASUREMENT
/begin CHARACTERISTIC Cbx_acel_pdl_fmt_mnl_cfm "Selects a manual interpolation factor between pedal progressivity maps (for tuning purposes)" VALUE 0xa0020986 _REC_S1VAL_20_u1 1. _CNV_A_R_ECME_LINEA_0_CM 0. 1. FORMAT "%1.0" BIT_MASK 0x1 /end CHARACTERISTIC
/begin CHARACTERISTIC Cxx_acel_pdl_fmt_mnl_fac "Manual interpolation factor between pedal progressivity maps (for tuning purposes)" VALUE 0xa0020987 _REC_S1VAL_20_u1 1. _CNV_A_R_LINEAR_____118_CM 0. 1. FORMAT "%9.7" /end CHARACTERISTIC
/begin CHARACTERISTIC Cxx_acel_pdl_fmt_rvr_fac "Pedal progressivity correction factor for reverse gear" VALUE 0xa0020988 _REC_S1VAL_20_u1 2.55 _CNV_A_R_LINEAR_____136_CM 0. 2.55 FORMAT "%4.2" /end CHARACTERISTIC
/begin CHARACTERISTIC Cxx_pdl_fmt_fac_slop_swi_down "Slope constant used during the change of progressivity maps, when decreasing" VALUE 0xa0020989 _REC_S1VAL_20_u1 1. _CNV_A_R_LINEAR_____297_CM 0. 1. FORMAT "%5.3" /end CHARACTERISTIC
/begin CHARACTERISTIC Cxx_pdl_fmt_fac_slop_swi_up "Slope constant used during the change of progressivity maps, when increasing" VALUE 0xa002098a _REC_S1VAL_20_u1 1. _CNV_A_R_LINEAR_____297_CM 0. 1. FORMAT "%5.3" /end CHARACTERISTIC
/begin CHARACTERISTIC Cxx_tkof_cdn_vs_max "Maximum vehicule speed to detect that the vehicules is in take off conditions" VALUE 0xa0020982 _REC_S1VAL_20_u2 655.35 _CNV_A_R_LINEAR_____70_CM 0. 655.35 FORMAT "%6.2" /end CHARACTERISTIC
/begin CHARACTERISTIC Cxx_tkof_stop_vs "Limit vehicule speed that determines the end of a take off" VALUE 0xa0020984 _REC_S1VAL_20_u2 655.35 _CNV_A_R_LINEAR_____70_CM 0. 655.35 FORMAT "%6.2" /end CHARACTERISTIC
/begin CHARACTERISTIC Ctp_acel_pdl_lih_hys_n_h "Pedal limp home max admissible engine speed function of gear ratio" CURVE 0xa0028294 _REC_A1CUR_20_u2_u1 16383.75 _CNV_A_R_ENSD_LINEA_24_CM 0. 16383.75 FORMAT "%8.2"
 /begin AXIS_DESCR COM_AXIS Vxx_gear _CNV_A_R_LINEAR_____113_CM 8 -1. 6. READ_ONLY FORMAT "%2.0" AXIS_PTS_REF Ntb_gear /end AXIS_DESCR
/end CHARACTERISTIC
/begin CHARACTERISTIC Ctp_acel_pdl_lih_n_sp "Pedal limp home engine speed setpoint function of gear ratio" CURVE 0xa00282a4 _REC_A1CUR_20_u2_u1 16383.75 _CNV_A_R_ENSD_LINEA_24_CM 0. 16383.75 FORMAT "%8.2"
 /begin AXIS_DESCR COM_AXIS Vxx_gear _CNV_A_R_LINEAR_____113_CM 8 -1. 6. READ_ONLY FORMAT "%2.0" AXIS_PTS_REF Ntb_gear /end AXIS_DESCR
/end CHARACTERISTIC
/begin MEASUREMENT Vbx_acel_pdl_lih_act "Accelerator pedal safety strategy activated" UBYTE _CNV_S_2_RANGE______3_CM 1 0. 0. 1. ECU_ADDRESS 0xd0004671 BIT_MASK 0x1 /end MEASUREMENT
/begin MEASUREMENT Vbx_acel_pdl_lih_dft_act "Activation of the accelerator pedal limp home strategy" UBYTE _CNV_S_2_RANGE______3_CM 1 0. 0. 1. ECU_ADDRESS 0xd0004672 BIT_MASK 0x1 /end MEASUREMENT
/begin MEASUREMENT Vbx_acel_pdl_lih_dft_prev "Pedal limp home downgraded mode at t-1" UBYTE _CNV_S_2_RANGE______3_CM 1 0. 0. 1. ECU_ADDRESS 0xd0004673 BIT_MASK 0x1 /end MEASUREMENT
/begin MEASUREMENT Vbx_acel_pdl_lih_i_rst "Conditions to reset integral term of pedal limp home regulators" UBYTE _CNV_S_2_RANGE______3_CM 1 0. 0. 1. ECU_ADDRESS 0xd0004674 BIT_MASK 0x1 /end MEASUREMENT
/begin MEASUREMENT Vbx_acel_pdl_lih_min_cdn "Conditions to apply the minimum available engine torque in pedal limp home" UBYTE _CNV_S_2_RANGE______3_CM 1 0. 0. 1. ECU_ADDRESS 0xd0004675 BIT_MASK 0x1 /end MEASUREMENT
/begin MEASUREMENT Vbx_acel_pdl_lih_n_i_frz "Conditions to freeze the integral term of the engine speed regulator in pedal limp home" UBYTE _CNV_S_2_RANGE______3_CM 1 0. 0. 1. ECU_ADDRESS 0xd0004676 BIT_MASK 0x1 /end MEASUREMENT
/begin MEASUREMENT Vbx_acel_pdl_lih_n_tqe_h "The maximum torque allowed by the engine speed regulator in pedal limp home is reached" UBYTE _CNV_S_2_RANGE______3_CM 1 0. 0. 1. ECU_ADDRESS 0xd0004677 BIT_MASK 0x1 /end MEASUREMENT
/begin MEASUREMENT Vbx_acel_pdl_lih_n_tqe_l "The minimum torque allowed by the engine speed regulator in pedal limp home is reached" UBYTE _CNV_S_2_RANGE______3_CM 1 0. 0. 1. ECU_ADDRESS 0xd0004678 BIT_MASK 0x1 /end MEASUREMENT
/begin MEASUREMENT Vbx_acel_pdl_lih_reg_swi "(1) vehicle speed regulator activated. (0) engine speed regulator activated in pedal limp home." UBYTE _CNV_S_2_RANGE______3_CM 1 0. 0. 1. ECU_ADDRESS 0xd0004679 BIT_MASK 0x1 /end MEASUREMENT
/begin MEASUREMENT Vbx_acel_pdl_lih_sp_cdn "Conditions to initialize the engine and vehicle speed setpoints to their current value" UBYTE _CNV_S_2_RANGE______3_CM 1 0. 0. 1. ECU_ADDRESS 0xd000467a BIT_MASK 0x1 /end MEASUREMENT
/begin MEASUREMENT Vbx_acel_pdl_lih_vs_i_frz "Conditions to freeze the integral term of vehicle speed regulator" UBYTE _CNV_S_2_RANGE______3_CM 1 0. 0. 1. ECU_ADDRESS 0xd000467b BIT_MASK 0x1 /end MEASUREMENT
/begin MEASUREMENT Vbx_acel_pdl_lih_vs_p_rst "Conditions to reset proportionnal term of vehicle speed pedal limp home regulator" UBYTE _CNV_S_2_RANGE______3_CM 1 0. 0. 1. ECU_ADDRESS 0xd000467c BIT_MASK 0x1 /end MEASUREMENT
/begin MEASUREMENT Vbx_acel_pdl_lih_vs_tqe_h "The maximum torque allowed by the vehicle speed regulator in pedal limp home is reached" UBYTE _CNV_S_2_RANGE______3_CM 1 0. 0. 1. ECU_ADDRESS 0xd000467d BIT_MASK 0x1 /end MEASUREMENT
/begin MEASUREMENT Vbx_acel_pdl_lih_vs_tqe_l "The minimum torque allowed by the vehicle speed regulator in pedal limp home is reached" UBYTE _CNV_S_2_RANGE______3_CM 1 0. 0. 1. ECU_ADDRESS 0xd000467e BIT_MASK 0x1 /end MEASUREMENT
/begin MEASUREMENT Vxx_acel_pdl_lih_n_dif "Difference between engine speed setpoint and measured engine speed in pedal limp home" SWORD _CNV_A_R_ENSD_LINEA_24_CM 1 0. -8192. 8191.75 ECU_ADDRESS 0xd0003aaa FORMAT "%6.0" /end MEASUREMENT
/begin MEASUREMENT Vxx_acel_pdl_lih_n_i "Integrate term of engine speed regulator in pedal limp home" UWORD _CNV_A_R_LINEAR_____161_CM 1 0. -400. 1647.96875 ECU_ADDRESS 0xd0003aac FORMAT "%11.5" /end MEASUREMENT
/begin MEASUREMENT Vxx_acel_pdl_lih_n_sp "Engine speed setpoint in pedal limp home (after slope)" UWORD _CNV_A_R_ENSD_LINEA_24_CM 1 0. 0. 16383.75 ECU_ADDRESS 0xd0003aae FORMAT "%8.2" /end MEASUREMENT
/begin MEASUREMENT Vxx_acel_pdl_lih_n_tqe "Pedal limp home engine torque from the engine speed regulator" UWORD _CNV_A_R_LINEAR_____161_CM 1 0. -400. 1647.96875 ECU_ADDRESS 0xd0003ab0 FORMAT "%11.5" /end MEASUREMENT
/begin MEASUREMENT Vxx_acel_pdl_lih_pwt "Powertrain setpoint calculated by the regulators (before the application of the foot-up)" UWORD _CNV_A_R_LINEAR_____185_CM 1 0. 0. 1. ECU_ADDRESS 0xd0003ab2 FORMAT "%7.5" /end MEASUREMENT
/begin MEASUREMENT Vxx_acel_pdl_lih_pwt_load "Powertrain setpoint calculated by the regulators (transition with normal mode and pedal level)" UWORD _CNV_A_R_LINEAR_____185_CM 1 0. 0. 1. ECU_ADDRESS 0xd0003ab4 FORMAT "%7.5" /end MEASUREMENT
/begin MEASUREMENT Vxx_acel_pdl_lih_pwt_sp "Powertrain setpoint (%) requested by accelerator pedal safety strategy" UWORD _CNV_A_R_LINEAR_____185_CM 1 0. 0. 1. ECU_ADDRESS 0xd0003ab6 FORMAT "%7.5" /end MEASUREMENT
/begin MEASUREMENT Vxx_acel_pdl_lih_tqe_sp "Accelerator pedal limp home engine torque" UWORD _CNV_A_R_LINEAR_____161_CM 1 0. -400. 1647.96875 ECU_ADDRESS 0xd0003ab8 FORMAT "%11.5" /end MEASUREMENT
/begin MEASUREMENT Vxx_acel_pdl_lih_vs_dif "Difference between vehicle speed setpoint and measured vehicle speed in pedal limp home" SWORD _CNV_A_R_LINEAR_____70_CM 1 0. -255. 255. ECU_ADDRESS 0xd0003aba FORMAT "%8.3" /end MEASUREMENT
/begin MEASUREMENT Vxx_acel_pdl_lih_vs_i "Integrate term of vehicle speed regulator in pedal limp home" UWORD _CNV_A_R_LINEAR_____161_CM 1 0. -400. 1647.96875 ECU_ADDRESS 0xd0003abc FORMAT "%11.5" /end MEASUREMENT
/begin MEASUREMENT Vxx_acel_pdl_lih_vs_sp "Vehicle speed setpoint in pedal limp home (after slope)" UWORD _CNV_A_R_LINEAR_____70_CM 1 0. 0. 655.35 ECU_ADDRESS 0xd0003abe FORMAT "%6.2" /end MEASUREMENT
/begin MEASUREMENT Vxx_acel_pdl_lih_vs_tqe "Pedal limp home engine torque from the vehicle speed regulator" UWORD _CNV_A_R_LINEAR_____161_CM 1 0. -400. 1647.96875 ECU_ADDRESS 0xd0003ac0 FORMAT "%11.5" /end MEASUREMENT
/begin CHARACTERISTIC Cbx_acel_pdl_lvl_cfm "Activation of a torque level to help in the calibration of the pedal limp home regulators" VALUE 0xa0021a6a _REC_S1VAL_20_u1 1. _CNV_A_R_ECME_LINEA_0_CM 0. 1. FORMAT "%1.0" BIT_MASK 0x1 /end CHARACTERISTIC
/begin CHARACTERISTIC Cxx_acel_pdl_lih_hys_n_l "Difference of engine speed for the hysteresis on max admissible engine speed in pedal limp home" VALUE 0xa0021a5c _REC_S1VAL_20_u2 16383.75 _CNV_A_R_ENSD_LINEA_24_CM 0. 16383.75 FORMAT "%8.2" /end CHARACTERISTIC
/begin CHARACTERISTIC Cxx_acel_pdl_lih_hys_vs_h "High vehicle speed threshold for the hysteresis on the regulators switch in pedal limp home" VALUE 0xa0021a6b _REC_S1VAL_20_u1 255. _CNV_A_R_LINEAR_____212_CM 0. 255. FORMAT "%3.0" /end CHARACTERISTIC
/begin CHARACTERISTIC Cxx_acel_pdl_lih_hys_vs_l "Low vehicle speed threshold for the hysteresis on the regulators switch in pedal limp home" VALUE 0xa0021a6c _REC_S1VAL_20_u1 255. _CNV_A_R_LINEAR_____212_CM 0. 255. FORMAT "%3.0" /end CHARACTERISTIC
/begin CHARACTERISTIC Cxx_acel_pdl_lih_max_vs "Maximum vehicle speed allowed in pedal limp home" VALUE 0xa0021a6d _REC_S1VAL_20_u1 255. _CNV_A_R_LINEAR_____212_CM 0. 255. FORMAT "%3.0" /end CHARACTERISTIC
/begin CHARACTERISTIC Cxx_acel_pdl_lih_min_l "Decreasing slope during the application of the foot-up accelerator pedal" VALUE 0xa0021a6e _REC_S1VAL_20_u1 1. _CNV_A_R_LINEAR_____254_CM 0. 1. FORMAT "%12.9" /end CHARACTERISTIC
/begin CHARACTERISTIC Cxx_acel_pdl_lih_n_ig "Integrate factor of pedal limp home engine speed regulator" VALUE 0xa0021a6f _REC_S1VAL_20_u1 25.5 _CNV_A_R_LINEAR_____4_CM 0. 25.5 FORMAT "%4.1" /end CHARACTERISTIC
/begin CHARACTERISTIC Cxx_acel_pdl_lih_n_pg "Proportional factor of pedal limp home engine speed regulator" VALUE 0xa0021a70 _REC_S1VAL_20_u1 1. _CNV_A_R_LINEAR_____298_CM 0. 1. FORMAT "%8.3" /end CHARACTERISTIC
/begin CHARACTERISTIC Cxx_acel_pdl_lih_n_sp_bpk_on "Pedal limp home engine speed setpoint if brake parking is applied" VALUE 0xa0021a5e _REC_S1VAL_20_u2 16383.75 _CNV_A_R_ENSD_LINEA_24_CM 0. 16383.75 FORMAT "%8.2" /end CHARACTERISTIC
/begin CHARACTERISTIC Cxx_acel_pdl_lih_n_sp_srs "Pedal limp home engine speed setpoint if vehicle speed failure (safety setpoint)" VALUE 0xa0021a60 _REC_S1VAL_20_u2 16383.75 _CNV_A_R_ENSD_LINEA_24_CM 0. 16383.75 FORMAT "%8.2" /end CHARACTERISTIC
/begin CHARACTERISTIC Cxx_acel_pdl_lih_n_tqe_h "Maximum torque setpoint allowed for the pedal limp home engine speed regulator" VALUE 0xa0021a62 _REC_S1VAL_20_u2 2047.96875 _CNV_A_R_LINEAR_____161_CM -400. 1647.96875 FORMAT "%11.5" /end CHARACTERISTIC
/begin CHARACTERISTIC Cxx_acel_pdl_lih_slop_h1 "Slope for the low vehicle speed and for the increasing vehicle speed setpoint in pedal limp home" VALUE 0xa0021a71 _REC_S1VAL_20_u1 255. _CNV_A_R_LINEAR_____288_CM 0. 255. FORMAT "%3.0" /end CHARACTERISTIC
/begin CHARACTERISTIC Cxx_acel_pdl_lih_slop_h2 "Slope for the high vehicle speed and for the increasing vehicle speed setpoint in pedal limp home" VALUE 0xa0021a72 _REC_S1VAL_20_u1 255. _CNV_A_R_LINEAR_____288_CM 0. 255. FORMAT "%3.0" /end CHARACTERISTIC
/begin CHARACTERISTIC Cxx_acel_pdl_lih_slop_n_h "Slope for the increasing engine speed setpoint in pedal limp home" VALUE 0xa0021a73 _REC_S1VAL_20_u1 25500. _CNV_A_R_LINEAR_____299_CM 0. 25500. FORMAT "%5.0" /end CHARACTERISTIC
/begin CHARACTERISTIC Cxx_acel_pdl_lih_slop_vs "Vehicle speed threshold for the change of the vehicle speed setpoint slope" VALUE 0xa0021a74 _REC_S1VAL_20_u1 255. _CNV_A_R_LINEAR_____212_CM 0. 255. FORMAT "%3.0" /end CHARACTERISTIC
/begin CHARACTERISTIC Cxx_acel_pdl_lih_vs_ig "Integrate factor of pedal limp home vehicle speed regulator" VALUE 0xa0021a75 _REC_S1VAL_20_u1 25.5 _CNV_A_R_LINEAR_____4_CM 0. 25.5 FORMAT "%4.1" /end CHARACTERISTIC
/begin CHARACTERISTIC Cxx_acel_pdl_lih_vs_pg "Proportional factor of pedal limp home vehicle speed regulator" VALUE 0xa0021a64 _REC_S1VAL_20_u2 24.902343 _CNV_A_R_LINEAR_____300_CM 0. 24.902343 FORMAT "%6.2" /end CHARACTERISTIC
/begin CHARACTERISTIC Cxx_acel_pdl_lih_vs_rvr "Pedal limp home vehicle speed setpoint in reverse gear" VALUE 0xa0021a76 _REC_S1VAL_20_u1 255. _CNV_A_R_LINEAR_____212_CM 0. 255. FORMAT "%3.0" /end CHARACTERISTIC
/begin CHARACTERISTIC Cxx_acel_pdl_lih_vs_sp "Pedal limp home vehicle speed setpoint" VALUE 0xa0021a77 _REC_S1VAL_20_u1 255. _CNV_A_R_LINEAR_____212_CM 0. 255. FORMAT "%3.0" /end CHARACTERISTIC
/begin CHARACTERISTIC Cxx_acel_pdl_lih_vs_tqe_h "Maximum torque setpoint allowed for the pedal limp home vehicle speed regulator" VALUE 0xa0021a66 _REC_S1VAL_20_u2 2047.96875 _CNV_A_R_LINEAR_____161_CM -400. 1647.96875 FORMAT "%11.5" /end CHARACTERISTIC
/begin CHARACTERISTIC Cxx_acel_pdl_lvl_tqe_thd "Imposed torque setpoint to help to the calibration of the accelerator pedal limp home regulators" VALUE 0xa0021a68 _REC_S1VAL_20_u2 2047.96875 _CNV_A_R_LINEAR_____161_CM -400. 1647.96875 FORMAT "%10.5" /end CHARACTERISTIC
/begin CHARACTERISTIC Cxx_acel_pdl_trs_slop_neg "Pedal slope during the decreasing transitions : normal mode <=> accelerator pedal limp home" VALUE 0xa0021a78 _REC_S1VAL_20_u1 1. _CNV_A_R_LINEAR_____254_CM 0. 1. FORMAT "%12.9" /end CHARACTERISTIC
/begin CHARACTERISTIC Cxx_acel_pdl_trs_slop_pos "Pedal slope during the increasing transitions : normal mode <=> accelerator pedal limp home" VALUE 0xa0021a79 _REC_S1VAL_20_u1 1. _CNV_A_R_LINEAR_____254_CM 0. 1. FORMAT "%12.9" /end CHARACTERISTIC
/begin CHARACTERISTIC Cxx_max_pow "Max power for accelerator pedal limp home powertrain setpoint" VALUE 0xa0021a7a _REC_S1VAL_20_u1 500000. _CNV_A_R_LINEAR_____296_CM 0. 500000. FORMAT "%6.0" /end CHARACTERISTIC
/begin MEASUREMENT Vbx_acel_pdl_lih_min_spc_cdn "Specific conditions to apply the minimum available engine torque in pedal limp home" UBYTE _CNV_S_2_RANGE______3_CM 1 0. 0. 1. ECU_ADDRESS 0xd0004f69 BIT_MASK 0x1 /end MEASUREMENT
/begin AXIS_PTS Ctb_n "20 programmable engine speed breakpoints map" 0xa00250e0 Vxx_n _REC_A2AXS_20_u2 16383.75 _CNV_A_R_ENSD_LINEA_24_CM 20 0. 16383.75 FORMAT "%8.2" /end AXIS_PTS
/begin AXIS_PTS Ctb_n2 "9 programmable engine speed breakpoints table" 0xa002510c Vxx_n _REC_A2AXS_20_u2 16383.75 _CNV_A_R_ENSD_LINEA_24_CM 9 0. 16383.75 FORMAT "%8.2" /end AXIS_PTS
/begin MEASUREMENT Vxx_trz_ad_b1_val "" UWORD _CNV_A_R_ECME_LINEA_0_CM 1 0. 0. 4096. DISPLAY_IDENTIFIER InTqiTrz_NVM.Vxx_trz_ad_b1_val_NVM ECU_ADDRESS 0xd0003664 FORMAT "%4.0" /end MEASUREMENT
/begin MEASUREMENT Vxx_trz_ad_b2_val "" UWORD _CNV_A_R_ECME_LINEA_0_CM 1 0. 0. 4096. DISPLAY_IDENTIFIER InTqiTrz_NVM.Vxx_trz_ad_b2_val_NVM ECU_ADDRESS 0xd0003666 FORMAT "%4.0" /end MEASUREMENT
/begin MEASUREMENT Vxx_trz_ad_b1_dif "" SWORD _CNV_A_R_ECME_LINEA_0_CM 1 0. -32768. 32767. DISPLAY_IDENTIFIER InTqiTrz_NVM.Vxx_trz_ad_b1_dif_NVM ECU_ADDRESS 0xd0003668 FORMAT "%6.0" /end MEASUREMENT
/begin MEASUREMENT Vxx_trz_ad_b2_dif "" SWORD _CNV_A_R_ECME_LINEA_0_CM 1 0. -32768. 32767. DISPLAY_IDENTIFIER InTqiTrz_NVM.Vxx_trz_ad_b2_dif_NVM ECU_ADDRESS 0xd000366a FORMAT "%6.0" /end MEASUREMENT
/begin MEASUREMENT Vxx_trz_ad_b1_fil "" UWORD _CNV_A_R_ECME_LINEA_0_CM 1 0. 0. 65535. DISPLAY_IDENTIFIER InTqiTrz_NVM.Vxx_trz_ad_b1_fil_NVM ECU_ADDRESS 0xd000366c FORMAT "%5.0" /end MEASUREMENT
/begin MEASUREMENT Vxx_trz_ad_b2_fil "" UWORD _CNV_A_R_ECME_LINEA_0_CM 1 0. 0. 65535. DISPLAY_IDENTIFIER InTqiTrz_NVM.Vxx_trz_ad_b2_fil_NVM ECU_ADDRESS 0xd000366e FORMAT "%5.0" /end MEASUREMENT
/begin MEASUREMENT Vxx_trz_ad_b_ctr_tdc "" UWORD _CNV_A_R_LINEAR_____55_CM 1 0. 0. 65535. DISPLAY_IDENTIFIER InTqiTrz_NVM.Vxx_trz_ad_b_ctr_tdc_NVM ECU_ADDRESS 0xd0003670 FORMAT "%5.0" /end MEASUREMENT
/begin MEASUREMENT Vbx_trz_ad_b_ok "" UBYTE _CNV_S_2_RANGE______3_CM 1 0. 0. 1. DISPLAY_IDENTIFIER InTqiTrz_NVM.Vbx_trz_ad_b_ok_NVM ECU_ADDRESS 0xd0003672 BIT_MASK 0x1 /end MEASUREMENT
/begin MEASUREMENT Vbx_trz_ad_b_ena "TLZ and TRZ calculation enabled" UBYTE _CNV_S_2_RANGE______3_CM 1 0. 0. 1. ECU_ADDRESS 0xd0004318 BIT_MASK 0x1 /end MEASUREMENT
/begin MEASUREMENT Vbx_trz_cyl_slc "Internal value for type cylinder selection (ad_b1 or ad_b2)" UBYTE _CNV_S_2_RANGE______3_CM 1 0. 0. 1. ECU_ADDRESS 0xd0004319 BIT_MASK 0x1 /end MEASUREMENT
/begin MEASUREMENT Vsx_trz_ad_b_stt "State number of the TRZ computation" UBYTE _CNV_A_R_ECME_LINEA_0_CM 1 0. 1. 3. ECU_ADDRESS 0xd000431a FORMAT "%1.0" /end MEASUREMENT
/begin CHARACTERISTIC Cbx_trz_ad_b1_fil_req "Boolean for ordering the reset of the filtered beta2 value to a specified ini value for tuning needs" VALUE 0xa00214f6 _REC_S1VAL_20_u1 1. _CNV_S_2_RANGE______3_CM 0. 1. /end CHARACTERISTIC
/begin CHARACTERISTIC Cbx_trz_ad_b1_val_req "Boolean for reseting the adapatative value of Vxx_ad_b1_val to a determined value Cxx_trz_ad_b1_val_ini" VALUE 0xa00214f7 _REC_S1VAL_20_u1 1. _CNV_S_2_RANGE______3_CM 0. 1. /end CHARACTERISTIC
/begin CHARACTERISTIC Cbx_trz_ad_b2_fil_req "Boolean for ordering the reset of the filtered beta1 value to a specified ini value for tuning needs" VALUE 0xa00214f8 _REC_S1VAL_20_u1 1. _CNV_S_2_RANGE______3_CM 0. 1. /end CHARACTERISTIC
/begin CHARACTERISTIC Cbx_trz_ad_b2_val_req "Boolean for reseting the adapatative value of beta2 to a determined value for tuning needs" VALUE 0xa00214f9 _REC_S1VAL_20_u1 1. _CNV_S_2_RANGE______3_CM 0. 1. /end CHARACTERISTIC
/begin CHARACTERISTIC Cxx_trz_ad_b1_fil_ini "Reset value of the filtered beta1 value for tuning needs" VALUE 0xa00214e6 _REC_S1VAL_20_u2 65535. _CNV_A_R_ECME_LINEA_0_CM 0. 65535. FORMAT "%5.0" /end CHARACTERISTIC
/begin CHARACTERISTIC Cxx_trz_ad_b1_val_ini "Initial value of coeficient beta 1 after a reset due to tuning needs" VALUE 0xa00214e8 _REC_S1VAL_20_u2 4096. _CNV_A_R_ECME_LINEA_0_CM 0. 4096. FORMAT "%4.0" /end CHARACTERISTIC
/begin CHARACTERISTIC Cxx_trz_ad_b2_fil_ini "Reset value of the filtered beta2 value for tuning needs" VALUE 0xa00214ea _REC_S1VAL_20_u2 65535. _CNV_A_R_ECME_LINEA_0_CM 0. 65535. FORMAT "%5.0" /end CHARACTERISTIC
/begin CHARACTERISTIC Cxx_trz_ad_b2_val_ini "Initial value of coeficient beta 2 after a reset due to tuning needs" VALUE 0xa00214ec _REC_S1VAL_20_u2 4096. _CNV_A_R_ECME_LINEA_0_CM 0. 4096. FORMAT "%4.0" /end CHARACTERISTIC
/begin CHARACTERISTIC Cxx_trz_ad_b_fil_fac "filter gain value for half turn adaptative correction" VALUE 0xa00214fa _REC_S1VAL_20_u1 255. _CNV_A_R_ECME_LINEA_0_CM 0. 255. FORMAT "%3.0" /end CHARACTERISTIC
/begin CHARACTERISTIC Cxx_trz_ad_b_grd_prs "Correction gain of manifold pressure" VALUE 0xa00214fb _REC_S1VAL_20_u1 255. _CNV_A_R_ECME_LINEA_0_CM 0. 255. FORMAT "%3.0" /end CHARACTERISTIC
/begin CHARACTERISTIC Cxx_trz_ad_b_n_max "Maximum Engine speed for adptative calculation of the correction TRZ Beta Coefficient" VALUE 0xa00214ee _REC_S1VAL_20_u2 16383.75 _CNV_A_R_ENSD_LINEA_24_CM 0. 16383.75 FORMAT "%8.2" /end CHARACTERISTIC
/begin CHARACTERISTIC Cxx_trz_ad_b_n_min "Minimum engine speed for adptative calculation of the correction TRZ Beta Coefficient" VALUE 0xa00214f0 _REC_S1VAL_20_u2 16383.75 _CNV_A_R_ENSD_LINEA_24_CM 0. 16383.75 FORMAT "%8.2" /end CHARACTERISTIC
/begin CHARACTERISTIC Cxx_trz_ad_b_nr_tdc "Minimum number of half turns necessary for learning cranck shaft defaults" VALUE 0xa00214f2 _REC_S1VAL_20_u2 65535. _CNV_A_R_LINEAR_____55_CM 0. 65535. FORMAT "%5.0" /end CHARACTERISTIC
/begin CHARACTERISTIC Cxx_trz_b_ini "Initial value of the beta coefficient cooresponding to 3 876 562 * B/A (A and B are the torque B4 coefficients)" VALUE 0xa00214f4 _REC_S1VAL_20_u2 65535. _CNV_A_R_ECME_LINEA_0_CM 0. 65535. FORMAT "%5.0" /end CHARACTERISTIC
/begin MEASUREMENT Vbx_trz_clc_ok "Flag for gaz torque TRZ computation finished" UBYTE _CNV_S_2_RANGE______3_CM 1 0. 0. 1. ECU_ADDRESS 0xd0004444 BIT_MASK 0x1 /end MEASUREMENT
/begin MEASUREMENT Vbx_trz_raw_clc "Flag for raw torque TRZ computation finished." UBYTE _CNV_S_2_RANGE______3_CM 1 0. 0. 1. ECU_ADDRESS 0xd0004445 BIT_MASK 0x1 /end MEASUREMENT
/begin MEASUREMENT Vbx_trz_raw_err "Overflow in calculation of the gaz torque TRZ" UBYTE _CNV_S_2_RANGE______3_CM 1 0. 0. 1. ECU_ADDRESS 0xd0004446 BIT_MASK 0x1 /end MEASUREMENT
/begin MEASUREMENT Vbx_trz_val_neg "Boolean true  for negative value of Vxx_trz_val equal to torque value" UBYTE _CNV_S_2_RANGE______3_CM 1 0. 0. 1. ECU_ADDRESS 0xd0004447 BIT_MASK 0x1 /end MEASUREMENT
/begin MEASUREMENT Vsx_trz_stt "Sate Number for determining the current state of the TRZ computation" UBYTE _CNV_A_R_ECME_LINEA_0_CM 1 0. 0. 2. ECU_ADDRESS 0xd0004448 FORMAT "%1.0" /end MEASUREMENT
/begin MEASUREMENT Vxx_trz_ad_b_val "Intermediate Value of the coeficient beta corrected by adaptative strategy during half-turn for cyl 1 and 4 or cyl 2 and 3" UWORD _CNV_A_R_ECME_LINEA_0_CM 1 0. 0. 4096. ECU_ADDRESS 0xd0003262 FORMAT "%4.0" /end MEASUREMENT
/begin MEASUREMENT Vxx_trz_raw_val "Raw TRZ torque " SWORD _CNV_A_R_LINEAR_____302_CM 1 0. -3276.8 3276.7 ECU_ADDRESS 0xd0003264 FORMAT "%6.1" /end MEASUREMENT
/begin MEASUREMENT Vxx_trz_val_tmp "Numerical Intermediary value in TRZ calculation " UWORD _CNV_A_R_ECME_LINEA_0_CM 1 0. 0. 65535. ECU_ADDRESS 0xd0003266 FORMAT "%5.0" /end MEASUREMENT
/begin MEASUREMENT Vxx_trz_val_tmp1 "Numerical Intermediary value in TRZ calculation" UWORD _CNV_A_R_ECME_LINEA_0_CM 1 0. 0. 65535. ECU_ADDRESS 0xd0003268 FORMAT "%5.0" /end MEASUREMENT
/begin CHARACTERISTIC Cxx_trz_a "A parameter of TRZ equal to 787.86 * physical (A)" VALUE 0xa00215f2 _REC_S1VAL_20_u2 65535. _CNV_A_R_ECME_LINEA_0_CM 0. 65535. FORMAT "%5.0" /end CHARACTERISTIC
/begin CHARACTERISTIC Cxx_trz_n_max "Max Engine speed value for TRZ computation" VALUE 0xa00215f4 _REC_S1VAL_20_u2 16383.75 _CNV_A_R_ENSD_LINEA_24_CM 0. 16383.75 FORMAT "%8.2" /end CHARACTERISTIC
/begin CHARACTERISTIC Cxx_trz_n_min "Min Engine speed value for TRZ computation" VALUE 0xa00215f6 _REC_S1VAL_20_u2 16383.75 _CNV_A_R_ENSD_LINEA_24_CM 0. 16383.75 FORMAT "%8.2" /end CHARACTERISTIC
/begin MEASUREMENT Vbx_ac_prs_lk_stt "Air conditioning pressure sensor detection. Stored in E≤PROM." UBYTE _CNV_S_2_RANGE______3_CM 1 0. 0. 1. DISPLAY_IDENTIFIER InVfiAci_NVM.Vbx_ac_prs_lk_stt_NVM ECU_ADDRESS 0xd0004f96 BIT_MASK 0x1 /end MEASUREMENT
/begin MEASUREMENT Vbx_ac_req_lk_stt "Air conditioning request detection. Stored in E≤PROM." UBYTE _CNV_S_2_RANGE______3_CM 1 0. 0. 1. DISPLAY_IDENTIFIER InVfiAci_NVM.Vbx_ac_req_lk_stt_NVM ECU_ADDRESS 0xd0004f97 BIT_MASK 0x1 /end MEASUREMENT
/begin MEASUREMENT Vbx_comp_cfa_lk_stt "Cabin fan request detection" UBYTE _CNV_S_2_RANGE______3_CM 1 0. 0. 1. DISPLAY_IDENTIFIER InVfiAci_NVM.Vbx_comp_cfa_lk_stt_NVM ECU_ADDRESS 0xd0004f98 BIT_MASK 0x1 /end MEASUREMENT
/begin MEASUREMENT Vbx_ac_clu_req "Air conditioning compressor clutching request sent from AC ECU to USM (M3 architecture)" UBYTE _CNV_S_2_RANGE______3_CM 1 0. 0. 1. ECU_ADDRESS 0xd0004e53 BIT_MASK 0x1 /end MEASUREMENT
/begin MEASUREMENT Vbx_ac_ext_pres "Air conditioning ECU detection. Equal to 0 if cold loop is present" UBYTE _CNV_S_2_RANGE______3_CM 1 0. 0. 1. ECU_ADDRESS 0xd0005794 BIT_MASK 0x1 /end MEASUREMENT
/begin MEASUREMENT Vbx_ac_pres "Air conditioning option detection with security on configuration detection." UBYTE _CNV_S_2_RANGE______3_CM 1 0. 0. 1. ECU_ADDRESS 0xd00046a9 BIT_MASK 0x1 /end MEASUREMENT
/begin MEASUREMENT Vbx_df_ac_prs_h "Air conditioning pressure sensor open circuit detected failure" UBYTE _CNV_S_2_RANGE______3_CM 1 0. 0. 1. ECU_ADDRESS 0xd0005795 BIT_MASK 0x1 /end MEASUREMENT
/begin MEASUREMENT Vbx_df_ac_prs_l "Air conditioning pressure sensor short circuit detected failure" UBYTE _CNV_S_2_RANGE______3_CM 1 0. 0. 1. ECU_ADDRESS 0xd0005796 BIT_MASK 0x1 /end MEASUREMENT
/begin MEASUREMENT Vsx_ac_prs_vld "Relative air conditioning pressure validity status" UBYTE _CNV_A_R_ECME_LINEA_0_CM 1 0. 0. 255. ECU_ADDRESS 0xd00046aa FORMAT "%3.0" /end MEASUREMENT
/begin MEASUREMENT Vxx_ac_prs "Relative air conditioning pressure" UWORD _CNV_A_R_LINEAR_____306_CM 1 0. 0. 6553.5 ECU_ADDRESS 0xd00038cc FORMAT "%6.1" /end MEASUREMENT
/begin CHARACTERISTIC Cxx_ac_lk_stt_dly "Duration of air conditioning connection/detection filtering" VALUE 0xa0021848 _REC_S1VAL_20_u2 655.35 _CNV_A_R_LINEAR_____34_CM 0. 655.35 FORMAT "%6.2" /end CHARACTERISTIC
/begin CHARACTERISTIC Cxx_ac_prs_fac "Air conditioning pressure sensor gain value" VALUE 0xa0021856 _REC_S1VAL_20_u1 0.255 _CNV_A_R_LINEAR_____307_CM 0. 0.255 FORMAT "%5.3" /end CHARACTERISTIC
/begin CHARACTERISTIC Cxx_ac_prs_lk_stt_dly "Duration of air conditioning pressure sensor connection filtering" VALUE 0xa002184a _REC_S1VAL_20_u2 655.35 _CNV_A_R_LINEAR_____34_CM 0. 655.35 FORMAT "%6.2" /end CHARACTERISTIC
/begin CHARACTERISTIC Cxx_ac_prs_ofs "Air conditioning pressure sensor offset value" VALUE 0xa002184c _REC_S1VAL_20_u2 60. _CNV_A_R_LINEAR_____150_CM 0. 60. FORMAT "%5.2" /end CHARACTERISTIC
/begin CHARACTERISTIC Cxx_ac_prs_v_max "High threshold for AC pressure sensor failure detection" VALUE 0xa002184e _REC_S1VAL_20_u2 60. _CNV_A_R_LINEAR_____150_CM 0. 60. FORMAT "%5.2" /end CHARACTERISTIC
/begin CHARACTERISTIC Cxx_ac_prs_v_min "Low threshold for AC pressure sensor failure detection" VALUE 0xa0021850 _REC_S1VAL_20_u2 60. _CNV_A_R_LINEAR_____150_CM 0. 60. FORMAT "%5.2" /end CHARACTERISTIC
/begin CHARACTERISTIC Cxx_dfdec_ac_prs "Sensor Detected Failure Counter Decrement" VALUE 0xa0021852 _REC_S1VAL_20_u2 65535. _CNV_A_R_ECME_LINEA_0_CM 0. 65535. FORMAT "%5.0" /end CHARACTERISTIC
/begin CHARACTERISTIC Cxx_dfinc_ac_prs "Sensor Detected Failure Counter Increment" VALUE 0xa0021854 _REC_S1VAL_20_u2 65535. _CNV_A_R_ECME_LINEA_0_CM 0. 65535. FORMAT "%5.0" /end CHARACTERISTIC
/begin MEASUREMENT Vbx_ac_mdf1_req_ext "Fan 1 activation request from air conditioning ECU" UBYTE _CNV_S_2_RANGE______3_CM 1 0. 0. 1. ECU_ADDRESS 0xd0004f9e BIT_MASK 0x1 /end MEASUREMENT
/begin MEASUREMENT Vbx_ac_mdf2_req_ext "Fan 2 activation request from air conditioning ECU" UBYTE _CNV_S_2_RANGE______3_CM 1 0. 0. 1. ECU_ADDRESS 0xd0004f9f BIT_MASK 0x1 /end MEASUREMENT
/begin MEASUREMENT Vbx_ac_req "Filtered air conditioning compressor activation request" UBYTE _CNV_S_2_RANGE______3_CM 1 0. 0. 1. ECU_ADDRESS 0xd0004fa0 BIT_MASK 0x1 /end MEASUREMENT
/begin MEASUREMENT Vbx_agb_mdf1_req "Fan 1 activation request from AGB" UBYTE _CNV_S_2_RANGE______3_CM 1 0. 0. 1. ECU_ADDRESS 0xd0004fa1 BIT_MASK 0x1 /end MEASUREMENT
/begin MEASUREMENT Vbx_agb_mdf2_req "Fan 2 activation request from AGB" UBYTE _CNV_S_2_RANGE______3_CM 1 0. 0. 1. ECU_ADDRESS 0xd0004fa2 BIT_MASK 0x1 /end MEASUREMENT
/begin CHARACTERISTIC Cxx_ac_req_dly "Delay to filter an AC clutching request" VALUE 0xa0020c2e _REC_S1VAL_20_u2 655.35 _CNV_A_R_LINEAR_____34_CM 0. 655.35 FORMAT "%6.2" /end CHARACTERISTIC
/begin CHARACTERISTIC Cxx_ac_req_dsb_dly "Delay to filter an AC clutching request inhibition" VALUE 0xa0020c30 _REC_S1VAL_20_u2 655.35 _CNV_A_R_LINEAR_____34_CM 0. 655.35 FORMAT "%6.2" /end CHARACTERISTIC
/begin CHARACTERISTIC Cxx_wf_ac_req_dly "Delay to filter a wire AC clutching request" VALUE 0xa0020c32 _REC_S1VAL_20_u2 655.35 _CNV_A_R_LINEAR_____34_CM 0. 655.35 FORMAT "%6.2" /end CHARACTERISTIC
/begin CHARACTERISTIC Cxx_wf_ac_req_dsb_dly "Delay to filter a wire AC clutching request inhibition" VALUE 0xa0020c34 _REC_S1VAL_20_u2 655.35 _CNV_A_R_LINEAR_____34_CM 0. 655.35 FORMAT "%6.2" /end CHARACTERISTIC
/begin MEASUREMENT Vbx_wf_ac_req "Climate cooling request from wire" UBYTE _CNV_S_2_RANGE______3_CM 1 0. 0. 1. ECU_ADDRESS 0xd0004122 BIT_MASK 0x1 /end MEASUREMENT
/begin MEASUREMENT Vsx_acc_sdl_ctl_typ "" UBYTE _CNV_A_R_ECME_LINEA_0_CM 1 0. 0. 255. ECU_ADDRESS 0xd000577d FORMAT "%3.0" /end MEASUREMENT
/begin MEASUREMENT Vxx_acc_forc_sp "Driving force requested by active cruise control." UWORD _CNV_A_R_LINEAR_____294_CM 1 0. -20000. 111068. ECU_ADDRESS 0xd00059ac FORMAT "%6.0" /end MEASUREMENT
/begin MEASUREMENT Vxx_sdl_forc_sp "Driving force requested by speed and distance limiter." UWORD _CNV_A_R_LINEAR_____294_CM 1 0. -20000. 111068. ECU_ADDRESS 0xd00059ae FORMAT "%6.0" /end MEASUREMENT
/begin MEASUREMENT Vbx_mdf2_reg "High temperature mode regulation authorisation for Mdf2." UBYTE _CNV_S_2_RANGE______3_CM 1 0. 0. 1. ECU_ADDRESS 0xd000557e BIT_MASK 0x1 /end MEASUREMENT
/begin MEASUREMENT Vbx_tco_sp_l_mod "Low cooling temperature mode request (interdiction de r√©gulation haute temp√©rature avec thermostat pilot√©)" UBYTE _CNV_S_2_RANGE______3_CM 1 0. 0. 1. ECU_ADDRESS 0xd000557f BIT_MASK 0x1 /end MEASUREMENT
/begin MEASUREMENT Vbx_tsta_ip_dft_lght_tco_h_sp "Switching to high temperature mode for the overheating alert lamp in the dashboard." UBYTE _CNV_S_2_RANGE______3_CM 1 0. 0. 1. ECU_ADDRESS 0xd0005580 BIT_MASK 0x1 /end MEASUREMENT
/begin MEASUREMENT Vxx_mdf2_reg_dly "Delay value before enabling low temperature mode regulation for mdf2." UBYTE _CNV_A_R_LINEAR_____82_CM 1 0. 0. 255. ECU_ADDRESS 0xd0005581 FORMAT "%3.0" /end MEASUREMENT
/begin MEASUREMENT Vxx_tco_sp "Water temperature set point for controlled thermostat." UWORD _CNV_A_R_LINEAR_____54_CM 1 0. -40. 200. ECU_ADDRESS 0xc0000c1e FORMAT "%5.1" /end MEASUREMENT
/begin MEASUREMENT Vsx_tsta_vld "Electronically controlled thermostat validity indicator" UBYTE _CNV_A_R_ECME_LINEA_0_CM 1 0. 0. 2. ECU_ADDRESS 0xd0005391 FORMAT "%1.0" /end MEASUREMENT
/begin MEASUREMENT Vbx_ac_mdf1_req "Fan 1 activation request from cold loop or air conditioning ECU" UBYTE _CNV_S_2_RANGE______3_CM 1 0. 0. 1. ECU_ADDRESS 0xd0004659 BIT_MASK 0x1 /end MEASUREMENT
/begin MEASUREMENT Vbx_ac_mdf2_req "Fan 2 activation request from cold loop or air conditioning ECU" UBYTE _CNV_S_2_RANGE______3_CM 1 0. 0. 1. ECU_ADDRESS 0xd000465a BIT_MASK 0x1 /end MEASUREMENT
/begin MEASUREMENT Vbx_mdf1_cmd "Low speed engine fan command" UBYTE _CNV_S_2_RANGE______3_CM 1 0. 0. 1. ECU_ADDRESS 0xd000465b BIT_MASK 0x1 /end MEASUREMENT
/begin MEASUREMENT Vbx_mdf1_cmd_dly "Low speed engine fan delayed command" UBYTE _CNV_S_2_RANGE______3_CM 1 0. 0. 1. ECU_ADDRESS 0xd000465c BIT_MASK 0x1 /end MEASUREMENT
/begin MEASUREMENT Vbx_mdf2_cmd "High speed engine fan command" UBYTE _CNV_S_2_RANGE______3_CM 1 0. 0. 1. ECU_ADDRESS 0xd000465d BIT_MASK 0x1 /end MEASUREMENT
/begin MEASUREMENT Vbx_mdf2_cmd_dly "High speed engine fan delayed command" UBYTE _CNV_S_2_RANGE______3_CM 1 0. 0. 1. ECU_ADDRESS 0xd000465e BIT_MASK 0x1 /end MEASUREMENT
/begin MEASUREMENT Vxx_mdf_min_dly_cnt "counter for the minimum duration of fan1 or fan2 activation" UWORD _CNV_A_R_LINEAR_____34_CM 1 0. 0. 655.35 ECU_ADDRESS 0xd0003300 FORMAT "%6.2" /end MEASUREMENT
/begin MEASUREMENT Vxx_mdf_min_dly_dt "dt for the minimum duration of fan1 or fan2 activation" UWORD _CNV_A_R_LINEAR_____34_CM 1 0. 0. 655.35 ECU_ADDRESS 0xd0003302 FORMAT "%6.2" /end MEASUREMENT
/begin CHARACTERISTIC Cxx_mdf_min_dly "Minimum duration of fan1 or fan2 activation" VALUE 0xa00217c6 _REC_S1VAL_20_u2 655.35 _CNV_A_R_LINEAR_____34_CM 0. 655.35 FORMAT "%6.2" /end CHARACTERISTIC
/begin CHARACTERISTIC Cxx_mdf_on_dly "Turn on delay of fan1 or fan2 activation" VALUE 0xa00217c8 _REC_S1VAL_20_u1 25.5 _CNV_A_R_LINEAR_____4_CM 0. 25.5 FORMAT "%4.1" /end CHARACTERISTIC
/begin MEASUREMENT Vbx_df_ip_lght_tco_ovh "Warning over heating lamp detected failure" UBYTE _CNV_S_2_RANGE______3_CM 1 0. 0. 1. ECU_ADDRESS 0xd000527a BIT_MASK 0x1 /end MEASUREMENT
/begin MEASUREMENT Vbx_ip_dft_lght_tco "Water temperature alert lamp." UBYTE _CNV_S_2_RANGE______3_CM 1 0. 0. 1. ECU_ADDRESS 0xd000527b BIT_MASK 0x1 /end MEASUREMENT
/begin MEASUREMENT Vbx_ip_lght_tco_ovh_igk_off_ena "ou_clo_coo_clatoxx/over heating lamp set of snapshot data identifiers" UBYTE _CNV_S_2_RANGE______3_CM 1 0. 0. 1. ECU_ADDRESS 0xd000527c BIT_MASK 0x1 /end MEASUREMENT
/begin CHARACTERISTIC Cbx_ip_lght_tco_ovh_igk_off_ena "State if warning over heating lamp in on when igk is off" VALUE 0xa00219b2 _REC_S1VAL_20_u1 1. _CNV_A_R_ECME_LINEA_0_CM 0. 1. FORMAT "%1.0" BIT_MASK 0x1 /end CHARACTERISTIC
/begin CHARACTERISTIC Cxx_dfdec_ip_lght_tco_ovh "ou_clo_coo_clatoxx/Warning over heating lamp detected failure counter decrement" VALUE 0xa00219a6 _REC_S1VAL_20_u2 65535. _CNV_A_R_ECME_LINEA_0_CM 0. 65535. FORMAT "%5.0" /end CHARACTERISTIC
/begin CHARACTERISTIC Cxx_dfinc_ip_lght_tco_ovh "ou_clo_coo_clatoxx/Warning over heating lamp detected failure counter increment" VALUE 0xa00219a8 _REC_S1VAL_20_u2 65535. _CNV_A_R_ECME_LINEA_0_CM 0. 65535. FORMAT "%5.0" /end CHARACTERISTIC
/begin CHARACTERISTIC Cxx_dft_lght_off_tco_thd "offset for switching off the alert temperature lamp" VALUE 0xa00219aa _REC_S1VAL_20_u2 240. _CNV_A_R_LINEAR_____54_CM -40. 200. FORMAT "%5.1" /end CHARACTERISTIC
/begin CHARACTERISTIC Cxx_dft_lght_on_tco_thd "offset for switching ON the alert temperature lamp" VALUE 0xa00219ac _REC_S1VAL_20_u2 240. _CNV_A_R_LINEAR_____54_CM -40. 200. FORMAT "%5.1" /end CHARACTERISTIC
/begin CHARACTERISTIC Cxx_tsta_dft_lght_off_tco_thd "offset for switching off the alert temperature lamp, in HIGH temperature mode." VALUE 0xa00219ae _REC_S1VAL_20_u2 240. _CNV_A_R_LINEAR_____54_CM -40. 200. FORMAT "%5.1" /end CHARACTERISTIC
/begin CHARACTERISTIC Cxx_tsta_dft_lght_on_tco_thd "offset for switching ON the alert temperature lamp, in HIGH temperature mode." VALUE 0xa00219b0 _REC_S1VAL_20_u2 240. _CNV_A_R_LINEAR_____54_CM -40. 200. FORMAT "%5.1" /end CHARACTERISTIC
/begin AXIS_PTS Ctb_tco_sp "Bkpt of Water temperature setpoint table." 0xa00239f0 Vxx_tco_sp _REC_A2AXS_20_u2 240. _CNV_A_R_LINEAR_____54_CM 7 -40. 200. FORMAT "%5.1" /end AXIS_PTS
/begin CHARACTERISTIC Ctd_tco_7 "Water temperature set point indicator." CURVE 0xa0020f3e _REC_A1CUR_20_u1_u2 6. _CNV_A_R_ECME_LINEA_0_CM 0. 6. FORMAT "%1.0"
 /begin AXIS_DESCR COM_AXIS Vxx_tco_sp _CNV_A_R_LINEAR_____54_CM 7 -40. 200. FORMAT "%5.1" AXIS_PTS_REF Ctb_tco_sp /end AXIS_DESCR
/end CHARACTERISTIC
/begin MEASUREMENT Vbx_tsta_ip_trs_l_mux "Boolean of changing mode for Information panel (delayed when changing from High temperature to Low temperature mode)" UBYTE _CNV_S_2_RANGE______3_CM 1 0. 0. 1. ECU_ADDRESS 0xd000576d BIT_MASK 0x1 /end MEASUREMENT
/begin MEASUREMENT Vxx_tco_sp_mux "Water temperature set point for controlled thermostat on MUX" UBYTE _CNV_A_R_ECME_LINEA_0_CM 1 0. 0. 7. ECU_ADDRESS 0xd000576e FORMAT "%1.0" /end MEASUREMENT
/begin MEASUREMENT Vbx_thpl_is_acel "Thermoplunger idle speed setpoint acceleration request" UBYTE _CNV_S_2_RANGE______3_CM 1 0. 0. 1. ECU_ADDRESS 0xd000552e BIT_MASK 0x1 /end MEASUREMENT
/begin MEASUREMENT Vbx_wpmp_tcr "Turbo water cooling pump command before monitool" UBYTE _CNV_S_2_RANGE______3_CM 1 0. 0. 1. ECU_ADDRESS 0xd00052f6 BIT_MASK 0x1 /end MEASUREMENT
/begin MEASUREMENT Vbx_wpmp_tcr_cmd "Turbo water cooling pump command" UBYTE _CNV_S_2_RANGE______3_CM 1 0. 0. 1. ECU_ADDRESS 0xd00052f7 BIT_MASK 0x1 /end MEASUREMENT
/begin MEASUREMENT Vbx_wpmp_tcr_pws "Boolean to maintain the water pump ECU power supply" UBYTE _CNV_S_2_RANGE______3_CM 1 0. 0. 1. ECU_ADDRESS 0xd00052f8 BIT_MASK 0x1 /end MEASUREMENT
/begin MEASUREMENT Vbx_wpmp_tcr_stop "MÈmorization of turbo water pump" UBYTE _CNV_S_2_RANGE______3_CM 1 0. 0. 1. ECU_ADDRESS 0xd00052f9 BIT_MASK 0x1 /end MEASUREMENT
/begin MEASUREMENT Vsx_wpmp_tcr "State variable for SF state machine" UBYTE _CNV_A_R_ECME_LINEA_0_CM 1 0. 0. 255. ECU_ADDRESS 0xd00052fa FORMAT "%3.0" /end MEASUREMENT
/begin MEASUREMENT Vxx_wpmp_tco_tcr_dly "Water temperature monitoring to command turbo water pump" UWORD _CNV_A_R_LINEAR_____4_CM 1 0. 0. 6553.5 ECU_ADDRESS 0xd00059a8 FORMAT "%6.1" /end MEASUREMENT
/begin MEASUREMENT Vxx_wpmp_tcr_dly "Turbo water pump delay command" UWORD _CNV_A_R_LINEAR_____4_CM 1 0. 0. 6553.5 ECU_ADDRESS 0xd00059aa FORMAT "%6.1" /end MEASUREMENT
/begin CHARACTERISTIC Cxx_dfdec_wpmp_tcr_blk "ou_clo_coo_paotxxx/unable to move the component to the commanded position of turbo water pump detected failure counter" VALUE 0xa0020b0c _REC_S1VAL_20_u2 65535. _CNV_A_R_ECME_LINEA_0_CM 0. 65535. FORMAT "%5.0" /end CHARACTERISTIC
/begin CHARACTERISTIC Cxx_dfdec_wpmp_tcr_oc "ou_clo_coo_paotxxx/Circuit Open of turbo water pump detected failure counter decrement" VALUE 0xa0020b0e _REC_S1VAL_20_u2 65535. _CNV_A_R_ECME_LINEA_0_CM 0. 65535. FORMAT "%5.0" /end CHARACTERISTIC
/begin CHARACTERISTIC Cxx_dfdec_wpmp_tcr_scg "ou_clo_coo_paotxxx/Circuit Short to Ground of turbo water pump detected failure counter decrement" VALUE 0xa0020b10 _REC_S1VAL_20_u2 65535. _CNV_A_R_ECME_LINEA_0_CM 0. 65535. FORMAT "%5.0" /end CHARACTERISTIC
/begin CHARACTERISTIC Cxx_dfdec_wpmp_tcr_scw "ou_clo_coo_paotxxx/Circuit Short to Battery of turbo water pump detected failure counter decrement" VALUE 0xa0020b12 _REC_S1VAL_20_u2 65535. _CNV_A_R_ECME_LINEA_0_CM 0. 65535. FORMAT "%5.0" /end CHARACTERISTIC
/begin CHARACTERISTIC Cxx_dfinc_wpmp_tcr_blk "ou_clo_coo_paotxxx/Unable to move the component to the commanded position of turbo water pump detected failure counter" VALUE 0xa0020b14 _REC_S1VAL_20_u2 65535. _CNV_A_R_ECME_LINEA_0_CM 0. 65535. FORMAT "%5.0" /end CHARACTERISTIC
/begin CHARACTERISTIC Cxx_dfinc_wpmp_tcr_oc "ou_clo_coo_paotxxx/Circuit Open of turbo water pump detected failure counter increment" VALUE 0xa0020b16 _REC_S1VAL_20_u2 65535. _CNV_A_R_ECME_LINEA_0_CM 0. 65535. FORMAT "%5.0" /end CHARACTERISTIC
/begin CHARACTERISTIC Cxx_dfinc_wpmp_tcr_scg "ou_clo_coo_paotxxx/Circuit Short to Ground of turbo water pump detected failure counter increment" VALUE 0xa0020b18 _REC_S1VAL_20_u2 65535. _CNV_A_R_ECME_LINEA_0_CM 0. 65535. FORMAT "%5.0" /end CHARACTERISTIC
/begin CHARACTERISTIC Cxx_dfinc_wpmp_tcr_scw "ou_clo_coo_paotxxx/Circuit Short to Battery of turbo water pump detected failure counter increment" VALUE 0xa0020b1a _REC_S1VAL_20_u2 65535. _CNV_A_R_ECME_LINEA_0_CM 0. 65535. FORMAT "%5.0" /end CHARACTERISTIC
/begin CHARACTERISTIC Cxx_wpmp_tcr_max_t "Max duration of pump command" VALUE 0xa0020b1c _REC_S1VAL_20_u2 6553.5 _CNV_A_R_LINEAR_____4_CM 0. 6553.5 FORMAT "%6.1" /end CHARACTERISTIC
/begin CHARACTERISTIC Cxx_wpmp_tcr_max_tco_t "Max duration of water cooling monitoring" VALUE 0xa0020b1e _REC_S1VAL_20_u2 6553.5 _CNV_A_R_LINEAR_____4_CM 0. 6553.5 FORMAT "%6.1" /end CHARACTERISTIC
/begin CHARACTERISTIC Cxx_wpmp_tcr_tco_hys "hysteresis for water temperarute monitoring" VALUE 0xa0020b20 _REC_S1VAL_20_u2 240. _CNV_A_R_LINEAR_____54_CM -40. 200. FORMAT "%5.1" /end CHARACTERISTIC
/begin CHARACTERISTIC Cxx_wpmp_tcr_tco_thd "Water temperarute threshold monitoring" VALUE 0xa0020b22 _REC_S1VAL_20_u2 240. _CNV_A_R_LINEAR_____54_CM -40. 200. FORMAT "%5.1" /end CHARACTERISTIC
/begin AXIS_PTS Ctb_it_psn "9 breakpoint table for the throttle position" 0xa00253c4 Vxx_fil1_it_psn_sp _REC_A2AXS_20_u2 200. _CNV_A_R_LINEAR_____94_CM 9 0. 200. FORMAT "%12.8" /end AXIS_PTS
/begin AXIS_PTS Ctb_spg_ar_maf_fac "9 breakpoint table of surfacic mass air flow" 0xa00253d8 Vxx_spg_ar_maf_fac _REC_A2AXS_20_u2 6.24990463256836e-002 _CNV_A_R_LINEAR_____308_CM 9 0. 6.24990463256836e-002 FORMAT "%7.6" /end AXIS_PTS
/begin CHARACTERISTIC Cmp_spg_sp_it_mod "Boost pressure setpoint in \"throttle and revs\" mode" MAP 0xa00253ec _REC_A1MAP_20_u2_u2_u2 20000. _CNV_A_R_LINEAR_____57_CM 0. 20000. FORMAT "%5.0"
 /begin AXIS_DESCR COM_AXIS Vxx_n _CNV_A_R_ENSD_LINEA_24_CM 9 0. 16383.75 FORMAT "%8.2" AXIS_PTS_REF Ctb_n2 /end AXIS_DESCR
 /begin AXIS_DESCR COM_AXIS Vxx_fil1_it_psn_sp _CNV_A_R_LINEAR_____94_CM 9 0. 200. FORMAT "%12.8" AXIS_PTS_REF Ctb_it_psn /end AXIS_DESCR
/end CHARACTERISTIC
/begin CHARACTERISTIC Ctp_inv_prs_rat "Table giving upstream/downstream pressure ratio depending on surfacic mass air flow ratio" CURVE 0xa0025490 _REC_A1CUR_20_u1_u2 0.2490234375 _CNV_A_R_LINEAR_____309_CM 1. 1.2490234375 FORMAT "%4.2"
 /begin AXIS_DESCR COM_AXIS Vxx_spg_ar_maf_fac _CNV_A_R_LINEAR_____308_CM 9 0. 6.24990463256836e-002 FORMAT "%7.6" AXIS_PTS_REF Ctb_spg_ar_maf_fac /end AXIS_DESCR
/end CHARACTERISTIC
/begin CHARACTERISTIC Ctp_spg_max_grd "Max increasing speed for boost pressure" CURVE 0xa002549c _REC_A1CUR_20_u2_u2 999960.9375 _CNV_A_R_LINEAR_____310_CM 0. 999960.9375 FORMAT "%11.5"
 /begin AXIS_DESCR COM_AXIS Vxx_n _CNV_A_R_ENSD_LINEA_24_CM 9 0. 16383.75 FORMAT "%8.2" AXIS_PTS_REF Ctb_n2 /end AXIS_DESCR
/end CHARACTERISTIC
/begin MEASUREMENT Vxx_spg_ar_maf_fac "Surfacic mass air flow used for load losses of the throttle." UWORD _CNV_A_R_LINEAR_____308_CM 1 0. 0. 6.24990463256836e-002 ECU_ADDRESS 0xd0003a44 FORMAT "%7.6" /end MEASUREMENT
/begin MEASUREMENT Vxx_spg_fil_spg_prs_sp "Boost pressure setpoint" UWORD _CNV_A_R_LINEAR_____57_CM 1 0. 0. 20000. ECU_ADDRESS 0xd0003a46 FORMAT "%5.0" /end MEASUREMENT
/begin MEASUREMENT Vxx_spg_prs_sp "Raw boost pressure setpoint" UWORD _CNV_A_R_LINEAR_____57_CM 1 0. 0. 20000. ECU_ADDRESS 0xd0003a48 FORMAT "%5.0" /end MEASUREMENT
/begin CHARACTERISTIC Cbx_spg_reg_cfm "Strategy choice : torque (1) or throttle & revs (0)" VALUE 0xa0021e2e _REC_S1VAL_20_u1 1. _CNV_A_R_ECME_LINEA_0_CM 0. 1. FORMAT "%1.0" BIT_MASK 0x1 /end CHARACTERISTIC
/begin CHARACTERISTIC Cxx_spg_max_prs_dif "Maximum load loss on throttle measured" VALUE 0xa0021e2c _REC_S1VAL_20_u2 20000. _CNV_A_R_LINEAR_____57_CM 0. 20000. FORMAT "%5.0" /end CHARACTERISTIC
/begin AXIS_PTS Ctb_n_lbdw_hot_dsb "Breakpoint table depending on manifold presure to inhibit the heater" 0xa002e200 Vxx_n _REC_A2AXS_20_u2 16383.75 _CNV_A_R_ENSD_LINEA_24_CM 9 0. 16383.75 FORMAT "%8.2" /end AXIS_PTS
/begin AXIS_PTS Ctb_t_lbdw_hot_rest "Breakpoint table for the restart strategy" 0xa002177c Vxx_lbdw_hot_t _REC_A2AXS_20_u2 65535. _CNV_A_R_LINEAR_____82_CM 3 0. 65535. FORMAT "%5.0" /end AXIS_PTS
/begin AXIS_PTS Ctb_t_lbdw_hot_sta "Breakpoint table for the start strategy" 0xa0021784 Vxx_lbdw_hot_t _REC_A2AXS_20_u2 65535. _CNV_A_R_LINEAR_____82_CM 3 0. 65535. FORMAT "%5.0" /end AXIS_PTS
/begin AXIS_PTS Ctb_tco_lbdw_hot_dly "Breakpoint for number of TDC necessary to switch the heater on" 0xa002e214 Vxx_tco _REC_A2AXS_20_u2 240. _CNV_A_R_LINEAR_____54_CM 9 -40. 200. FORMAT "%5.1" /end AXIS_PTS
/begin CHARACTERISTIC Ctd_t_rat_lbdw_rest "Upstream PWM map values for restart strategy" CURVE 0xa002178c _REC_A1CUR_20_u1_u2 100. _CNV_A_R_LINEAR_____114_CM 0. 100. FORMAT "%12.8"
 /begin AXIS_DESCR COM_AXIS Vxx_lbdw_hot_t _CNV_A_R_LINEAR_____82_CM 3 0. 65535. FORMAT "%5.0" AXIS_PTS_REF Ctb_t_lbdw_hot_rest /end AXIS_DESCR
/end CHARACTERISTIC
/begin CHARACTERISTIC Ctd_t_rat_lbdw_sta "Upstream PWM map values for start strategy" CURVE 0xa0021790 _REC_A1CUR_20_u1_u2 100. _CNV_A_R_LINEAR_____114_CM 0. 100. FORMAT "%12.8"
 /begin AXIS_DESCR COM_AXIS Vxx_lbdw_hot_t _CNV_A_R_LINEAR_____82_CM 3 0. 65535. FORMAT "%5.0" AXIS_PTS_REF Ctb_t_lbdw_hot_sta /end AXIS_DESCR
/end CHARACTERISTIC
/begin CHARACTERISTIC Ctp_n_lbdw_hot_dsb_map "Maximum manifold pressure to inhibit the heater power" CURVE 0xa002e228 _REC_A1CUR_20_u2_u2 20000. _CNV_A_R_LINEAR_____57_CM 0. 20000. FORMAT "%5.0"
 /begin AXIS_DESCR COM_AXIS Vxx_n _CNV_A_R_ENSD_LINEA_24_CM 9 0. 16383.75 FORMAT "%8.2" AXIS_PTS_REF Ctb_n_lbdw_hot_dsb /end AXIS_DESCR
/end CHARACTERISTIC
/begin CHARACTERISTIC Ctp_tco_lbdw_hot_dly "Number of TDC before applying the heater power" CURVE 0xa002e23c _REC_A1CUR_20_u2_u2 65535. _CNV_A_R_LINEAR_____55_CM 0. 65535. FORMAT "%5.0"
 /begin AXIS_DESCR COM_AXIS Vxx_tco _CNV_A_R_LINEAR_____54_CM 9 -40. 200. FORMAT "%5.1" AXIS_PTS_REF Ctb_tco_lbdw_hot_dly /end AXIS_DESCR
/end CHARACTERISTIC
/begin MEASUREMENT Vbx_aut_eng_lbdw_hot "Engine state : 1=autonomous engine, 0=other states" UBYTE _CNV_S_2_RANGE______3_CM 1 0. 0. 1. ECU_ADDRESS 0xd0004636 BIT_MASK 0x1 /end MEASUREMENT
/begin MEASUREMENT Vbx_lbdw_hot_cmd "Heater power command" UBYTE _CNV_S_2_RANGE______3_CM 1 0. 0. 1. ECU_ADDRESS 0xd0004638 BIT_MASK 0x1 /end MEASUREMENT
/begin MEASUREMENT Vbx_lbdw_hot_cmd_stt "State of the heater power command (temporary variable)" UBYTE _CNV_S_2_RANGE______3_CM 1 0. 0. 1. ECU_ADDRESS 0xd0004637 BIT_MASK 0x1 /end MEASUREMENT
/begin MEASUREMENT Vbx_lbdw_hot_t_rest "Reset of the hot time counter" UBYTE _CNV_S_2_RANGE______3_CM 1 0. 0. 1. ECU_ADDRESS 0xd00055c2 BIT_MASK 0x1 /end MEASUREMENT
/begin MEASUREMENT Vxx_lbdw_appl_pwm "PWM value apply to the sensor" UBYTE _CNV_A_R_LINEAR_____114_CM 1 0. 0. 100. ECU_ADDRESS 0xd0004639 FORMAT "%12.8" /end MEASUREMENT
/begin MEASUREMENT Vxx_lbdw_clc_pwm "PWM value corrected with the battery voltage" UBYTE _CNV_A_R_LINEAR_____114_CM 1 0. 0. 100. ECU_ADDRESS 0xd00055c3 FORMAT "%12.8" /end MEASUREMENT
/begin MEASUREMENT Vxx_lbdw_dly_rest_t "Timer use to control the heater restart command under power latch" UWORD _CNV_A_R_LINEAR_____82_CM 1 0. 0. 65535. ECU_ADDRESS 0xd00059be FORMAT "%5.0" /end MEASUREMENT
/begin MEASUREMENT Vxx_lbdw_hot_dly_ctr "Time expected to swith on the heating of the downstream sensor" UWORD _CNV_A_R_LINEAR_____55_CM 1 0. 0. 65535. ECU_ADDRESS 0xd0003476 FORMAT "%5.0" /end MEASUREMENT
/begin MEASUREMENT Vxx_lbdw_hot_rest_stt "Progress  in the heater strategy : 0=cold sensor 1=start strategy applied 2=restart" UBYTE _CNV_A_R_ECME_LINEA_0_CM 1 0. 0. 2. ECU_ADDRESS 0xd00055c4 FORMAT "%1.0" /end MEASUREMENT
/begin MEASUREMENT Vxx_lbdw_hot_t "Timer for heating period" UWORD _CNV_A_R_LINEAR_____82_CM 1 0. 0. 65535. ECU_ADDRESS 0xd00059c0 FORMAT "%5.0" /end MEASUREMENT
/begin MEASUREMENT Vxx_lbdw_hot_t_prev "Timer for the heating period (previous value)" UWORD _CNV_A_R_LINEAR_____82_CM 1 0. 0. 65535. ECU_ADDRESS 0xd00059c2 FORMAT "%5.0" /end MEASUREMENT
/begin MEASUREMENT Vxx_lbdw_pwm_ctr "Timer for PWM generation" UBYTE _CNV_A_R_ECME_LINEA_0_CM 1 0. 0. 255. ECU_ADDRESS 0xd000463a FORMAT "%3.0" /end MEASUREMENT
/begin MEASUREMENT Vxx_lbdw_ref_pwm "PWM heater value advised by the sensor supplier" UBYTE _CNV_A_R_LINEAR_____114_CM 1 0. 0. 100. ECU_ADDRESS 0xd00055c5 FORMAT "%12.8" /end MEASUREMENT
/begin MEASUREMENT Vxx_n_lbdw_hot_dsb_map "Maximum manifold pressure to inhibit the heater power" UWORD _CNV_A_R_LINEAR_____57_CM 1 0. 0. 20000. ECU_ADDRESS 0xd00059c4 FORMAT "%5.0" /end MEASUREMENT
/begin MEASUREMENT Vxx_t_lbdw_hot_sta "Variable for the breakpoint table for the start strategy" UWORD _CNV_A_R_LINEAR_____82_CM 1 0. 0. 65535. ECU_ADDRESS 0xd00059c6 FORMAT "%5.0" /end MEASUREMENT
/begin MEASUREMENT Vxx_t_rat_lbdw_rest "Downstream PWM map values for restart strategy" UBYTE _CNV_A_R_LINEAR_____114_CM 1 0. 0. 100. ECU_ADDRESS 0xd00059c8 FORMAT "%12.8" /end MEASUREMENT
/begin MEASUREMENT Vxx_t_rat_lbdw_sta "Downstream PWM map values for start strategy" UBYTE _CNV_A_R_LINEAR_____114_CM 1 0. 0. 100. ECU_ADDRESS 0xd00059c9 FORMAT "%12.8" /end MEASUREMENT
/begin CHARACTERISTIC Cbx_lbdw_dwpt_per_ena "Activation of the dew point strategy for the upstream sensor" VALUE 0xa002179c _REC_S1VAL_20_u1 1. _CNV_S_2_RANGE______3_CM 0. 1. /end CHARACTERISTIC
/begin CHARACTERISTIC Cxx_lbdw_cold_sta_rat "PWM before dewpoint detection (cold start)" VALUE 0xa002179d _REC_S1VAL_20_u1 100. _CNV_A_R_LINEAR_____114_CM 0. 100. FORMAT "%12.8" /end CHARACTERISTIC
/begin CHARACTERISTIC Cxx_lbdw_dft_pwm "PWM use in case of battery failure" VALUE 0xa002179e _REC_S1VAL_20_u1 100. _CNV_A_R_LINEAR_____114_CM 0. 100. FORMAT "%12.8" /end CHARACTERISTIC
/begin CHARACTERISTIC Cxx_lbdw_dly_rest_t "Time necessary to concider the sensor warm or cold (under power latch)" VALUE 0xa0021794 _REC_S1VAL_20_u2 65535. _CNV_A_R_LINEAR_____82_CM 0. 65535. FORMAT "%5.0" /end CHARACTERISTIC
/begin CHARACTERISTIC Cxx_lbdw_hot_cmd_map_hys "Maximum pressure value to switch on again the heater (hysteresis)" VALUE 0xa0021796 _REC_S1VAL_20_u2 20000. _CNV_A_R_LINEAR_____57_CM 0. 20000. FORMAT "%5.0" /end CHARACTERISTIC
/begin CHARACTERISTIC Cxx_lbdw_hot_cmd_vs_hys "Maximum speed vehicule to switch on again the heater (hysteresis)" VALUE 0xa002179f _REC_S1VAL_20_u1 255. _CNV_A_R_LINEAR_____212_CM 0. 255. FORMAT "%3.0" /end CHARACTERISTIC
/begin CHARACTERISTIC Cxx_lbdw_hot_dsb_vs "Maximum vehicule speed to heat the sensor" VALUE 0xa00217a0 _REC_S1VAL_20_u1 255. _CNV_A_R_LINEAR_____212_CM 0. 255. FORMAT "%3.0" /end CHARACTERISTIC
/begin CHARACTERISTIC Cxx_lbdw_hot_sta_end "Time necessary to concider a hot sensor" VALUE 0xa0021798 _REC_S1VAL_20_u2 65535. _CNV_A_R_LINEAR_____82_CM 0. 65535. FORMAT "%5.0" /end CHARACTERISTIC
/begin CHARACTERISTIC Cxx_lbdw_rms_v "Effective voltage recommanded by the sensor supplyer" VALUE 0xa00217a1 _REC_S1VAL_20_u1 255. _CNV_A_R_LINEAR_____311_CM 0. 255. FORMAT "%3.0" /end CHARACTERISTIC
/begin CHARACTERISTIC Cxx_lbdw_tco_rest_thd "Tco threshold activating the hot restart strategy" VALUE 0xa002179a _REC_S1VAL_20_u2 240. _CNV_A_R_LINEAR_____54_CM -40. 200. FORMAT "%5.1" /end CHARACTERISTIC
/begin MEASUREMENT Vsx_lbdw_hot_vld "Rear oxygen heating validity status" UBYTE _CNV_S_3_STATUS_OK__120_CM 1 0. 0. 2. ECU_ADDRESS 0xd00055ec /end MEASUREMENT
/begin CHARACTERISTIC Cxx_dfdec_lbdw_hot_oc "Downstream lambda sensor heating Open circuit diagnostic detected failure counter decrement" VALUE 0xa00217b4 _REC_S1VAL_20_u2 65535. _CNV_A_R_ECME_LINEA_0_CM 0. 65535. FORMAT "%5.0" /end CHARACTERISTIC
/begin CHARACTERISTIC Cxx_dfdec_lbdw_hot_scg "Downstream lambda sensor heating Short circuit to ground diagnostic detected failure counter decrement" VALUE 0xa00217b6 _REC_S1VAL_20_u2 65535. _CNV_A_R_ECME_LINEA_0_CM 0. 65535. FORMAT "%5.0" /end CHARACTERISTIC
/begin CHARACTERISTIC Cxx_dfdec_lbdw_hot_scw "Downstream lambda sensor heating Short circuit at battery + diagnostic detected failure counter decrement" VALUE 0xa00217b8 _REC_S1VAL_20_u2 65535. _CNV_A_R_ECME_LINEA_0_CM 0. 65535. FORMAT "%5.0" /end CHARACTERISTIC
/begin CHARACTERISTIC Cxx_dfinc_lbdw_hot_oc "Downstream lambda sensor heating Open circuit diagnostic detected failure counter increment" VALUE 0xa00217ba _REC_S1VAL_20_u2 65535. _CNV_A_R_ECME_LINEA_0_CM 0. 65535. FORMAT "%5.0" /end CHARACTERISTIC
/begin CHARACTERISTIC Cxx_dfinc_lbdw_hot_scg "Downstream lambda sensor heating Short circuit to ground diagnostic detected failure counter increment" VALUE 0xa00217bc _REC_S1VAL_20_u2 65535. _CNV_A_R_ECME_LINEA_0_CM 0. 65535. FORMAT "%5.0" /end CHARACTERISTIC
/begin CHARACTERISTIC Cxx_dfinc_lbdw_hot_scw "Downstream lambda sensor heating Short circuit at battery + diagnostic detected failure counter increment" VALUE 0xa00217be _REC_S1VAL_20_u2 65535. _CNV_A_R_ECME_LINEA_0_CM 0. 65535. FORMAT "%5.0" /end CHARACTERISTIC
/begin MEASUREMENT Vxx_lbup_hot_obd_crt_mv_rtn "Backup value of the heater current diagnosis criterion" UWORD _CNV_A_R_LINEAR_____312_CM 1 0. 0. 6.5535 DISPLAY_IDENTIFIER OuCboUlo_NVM.Vxx_lbup_hot_obd_crt_mv_rtn_NVM ECU_ADDRESS 0xd0002c68 FORMAT "%6.4" /end MEASUREMENT
/begin MEASUREMENT Vxx_lbup_hot_obd_crt_thd_rtn "Backup value of the heater current failure threshold" UWORD _CNV_A_R_LINEAR_____312_CM 1 0. 0. 6.5535 DISPLAY_IDENTIFIER OuCboUlo_NVM.Vxx_lbup_hot_obd_crt_thd_rtn_NVM ECU_ADDRESS 0xd0002c6a FORMAT "%6.4" /end MEASUREMENT
/begin AXIS_PTS Ctb_n_lbup_hot_dsb "Breakpoint table depending on manifold presure to inhibit the heater" 0xa002b11c Vxx_n _REC_A2AXS_20_u2 16383.75 _CNV_A_R_ENSD_LINEA_24_CM 9 0. 16383.75 FORMAT "%8.2" /end AXIS_PTS
/begin AXIS_PTS Ctb_t_lbup_hot_rest "Breakpoint table for the restart strategy" 0xa0020e00 Vxx_lbup_hot_t _REC_A2AXS_20_u2 65535. _CNV_A_R_LINEAR_____82_CM 3 0. 65535. FORMAT "%5.0" /end AXIS_PTS
/begin AXIS_PTS Ctb_t_lbup_hot_sta "Breakpoint table for the start strategy" 0xa0020e08 Vxx_lbup_hot_t _REC_A2AXS_20_u2 65535. _CNV_A_R_LINEAR_____82_CM 3 0. 65535. FORMAT "%5.0" /end AXIS_PTS
/begin AXIS_PTS Ctb_tco_lbup_hot_dly "Breakpoint for number of TDC necessary to switch the heater on" 0xa002b130 Vxx_tco _REC_A2AXS_20_u2 240. _CNV_A_R_LINEAR_____54_CM 13 -40. 200. FORMAT "%5.1" /end AXIS_PTS
/begin CHARACTERISTIC Ctd_t_rat_lbup_rest "Upstream PWM map values for restart strategy" CURVE 0xa0020e10 _REC_A1CUR_20_u1_u2 100. _CNV_A_R_LINEAR_____114_CM 0. 100. FORMAT "%12.8"
 /begin AXIS_DESCR COM_AXIS Vxx_lbup_hot_t _CNV_A_R_LINEAR_____82_CM 3 0. 65535. FORMAT "%5.0" AXIS_PTS_REF Ctb_t_lbup_hot_rest /end AXIS_DESCR
/end CHARACTERISTIC
/begin CHARACTERISTIC Ctd_t_rat_lbup_sta "Upstream PWM map values for start strategy" CURVE 0xa0020e14 _REC_A1CUR_20_u1_u2 100. _CNV_A_R_LINEAR_____114_CM 0. 100. FORMAT "%12.8"
 /begin AXIS_DESCR COM_AXIS Vxx_lbup_hot_t _CNV_A_R_LINEAR_____82_CM 3 0. 65535. FORMAT "%5.0" AXIS_PTS_REF Ctb_t_lbup_hot_sta /end AXIS_DESCR
/end CHARACTERISTIC
/begin CHARACTERISTIC Ctp_n_lbup_hot_dsb_map "Maximum manifold pressure to inhibit the heater power" CURVE 0xa002b14c _REC_A1CUR_20_u2_u2 20000. _CNV_A_R_LINEAR_____57_CM 0. 20000. FORMAT "%5.0"
 /begin AXIS_DESCR COM_AXIS Vxx_n _CNV_A_R_ENSD_LINEA_24_CM 9 0. 16383.75 FORMAT "%8.2" AXIS_PTS_REF Ctb_n_lbup_hot_dsb /end AXIS_DESCR
/end CHARACTERISTIC
/begin CHARACTERISTIC Ctp_tco_lbup_hot_dly "Number of TDC before applying the heater power" CURVE 0xa002b160 _REC_A1CUR_20_u2_u2 65535. _CNV_A_R_LINEAR_____55_CM 0. 65535. FORMAT "%5.0"
 /begin AXIS_DESCR COM_AXIS Vxx_tco _CNV_A_R_LINEAR_____54_CM 13 -40. 200. FORMAT "%5.1" AXIS_PTS_REF Ctb_tco_lbup_hot_dly /end AXIS_DESCR
/end CHARACTERISTIC
/begin MEASUREMENT Vbx_aut_eng_lbup_hot "Engine state : 1=autonomous engine, 0=other states" UBYTE _CNV_S_2_RANGE______3_CM 1 0. 0. 1. ECU_ADDRESS 0xd0004ecd BIT_MASK 0x1 /end MEASUREMENT
/begin MEASUREMENT Vbx_lbup_hot "Boolean indicating that upstream oxygen sensor is theoricaly hot" UBYTE _CNV_S_2_RANGE______3_CM 1 0. 0. 1. ECU_ADDRESS 0xd000537e BIT_MASK 0x1 /end MEASUREMENT
/begin MEASUREMENT Vbx_lbup_hot_cmd "Heater power command" UBYTE _CNV_S_2_RANGE______3_CM 1 0. 0. 1. ECU_ADDRESS 0xd0004ece BIT_MASK 0x1 /end MEASUREMENT
/begin MEASUREMENT Vbx_lbup_hot_cmd_stt "State of the heater power command (temporary variable)" UBYTE _CNV_S_2_RANGE______3_CM 1 0. 0. 1. ECU_ADDRESS 0xd000537f BIT_MASK 0x1 /end MEASUREMENT
/begin MEASUREMENT Vbx_lbup_hot_cmd_stt_sf "State of the heater power command (temporary variable) in state flow chart" UBYTE _CNV_S_2_RANGE______3_CM 1 0. 0. 1. ECU_ADDRESS 0xd0005380 BIT_MASK 0x1 /end MEASUREMENT
/begin MEASUREMENT Vxx_lbup_appl_pwm "PWM value apply to the sensor" UBYTE _CNV_A_R_LINEAR_____114_CM 1 0. 0. 100. ECU_ADDRESS 0xd0004ecf FORMAT "%12.8" /end MEASUREMENT
/begin MEASUREMENT Vxx_lbup_clc_pwm "PWM value corrected with the battery voltage" UBYTE _CNV_A_R_LINEAR_____114_CM 1 0. 0. 100. ECU_ADDRESS 0xd0005381 FORMAT "%12.8" /end MEASUREMENT
/begin MEASUREMENT Vxx_lbup_dly_rest_t "Timer use to control the heater restart command under power latch" UWORD _CNV_A_R_LINEAR_____82_CM 1 0. 0. 65535. ECU_ADDRESS 0xc0000bba FORMAT "%5.0" /end MEASUREMENT
/begin MEASUREMENT Vxx_lbup_heat_raw_pow "Raw power supplied by the heater power stage for the upstream oxygen sensor" UWORD _CNV_A_R_LINEAR_____313_CM 1 0. 0. 239.996337890625 ECU_ADDRESS 0xc0000bbc FORMAT "%7.3" /end MEASUREMENT
/begin MEASUREMENT Vxx_lbup_hot_dly_ctr "Time expected to reach the end of the dew point period for the upstream sensor" UWORD _CNV_A_R_LINEAR_____55_CM 1 0. 0. 65535. ECU_ADDRESS 0xd00031ae FORMAT "%5.0" /end MEASUREMENT
/begin MEASUREMENT Vxx_lbup_hot_rest_stt "Progress in the heater strategy : 0=cold sensor 1=start strategy applied 2=restart" UBYTE _CNV_A_R_ECME_LINEA_0_CM 1 0. 0. 2. ECU_ADDRESS 0xd0005382 FORMAT "%1.0" /end MEASUREMENT
/begin MEASUREMENT Vxx_lbup_hot_t "Timer for the heating period" UWORD _CNV_A_R_LINEAR_____82_CM 1 0. 0. 65535. ECU_ADDRESS 0xc0000bbe FORMAT "%5.0" /end MEASUREMENT
/begin MEASUREMENT Vxx_lbup_pwm_ctr "Timer for PWM generation" UBYTE _CNV_A_R_ECME_LINEA_0_CM 1 0. 0. 255. ECU_ADDRESS 0xd0004ed0 FORMAT "%3.0" /end MEASUREMENT
/begin MEASUREMENT Vxx_lbup_ref_pwm "PWM heater value advised by the sensor supplier" UBYTE _CNV_A_R_LINEAR_____114_CM 1 0. 0. 100. ECU_ADDRESS 0xd0005383 FORMAT "%12.8" /end MEASUREMENT
/begin MEASUREMENT Vxx_lbup_ref_pwm_sf "PWM heater value advised by the sensor supplier in state flow chart" UBYTE _CNV_A_R_LINEAR_____114_CM 1 0. 0. 100. ECU_ADDRESS 0xd0005384 FORMAT "%12.8" /end MEASUREMENT
/begin MEASUREMENT Vxx_n_lbup_hot_dsb_map "Maximum manifold pressure to inhibit the heater power" UWORD _CNV_A_R_LINEAR_____57_CM 1 0. 0. 20000. ECU_ADDRESS 0xc0000bc0 FORMAT "%5.0" /end MEASUREMENT
/begin MEASUREMENT Vxx_t_lbup_hot_sta "Time of the breakpoint table for the start strategy" UWORD _CNV_A_R_LINEAR_____82_CM 1 0. 0. 65535. ECU_ADDRESS 0xc0000bc2 FORMAT "%5.0" /end MEASUREMENT
/begin MEASUREMENT Vxx_t_rat_lbup_rest "Upstream PWM map values for restart strategy" UBYTE _CNV_A_R_LINEAR_____114_CM 1 0. 0. 100. ECU_ADDRESS 0xd0005385 FORMAT "%12.8" /end MEASUREMENT
/begin MEASUREMENT Vxx_t_rat_lbup_sta "Upstream PWM map values for start strategy" UBYTE _CNV_A_R_LINEAR_____114_CM 1 0. 0. 100. ECU_ADDRESS 0xd0005386 FORMAT "%12.8" /end MEASUREMENT
/begin CHARACTERISTIC Cbx_lbup_dwpt_per_ena "Activation of the dew point strategy for the upstream sensor" VALUE 0xa0020e26 _REC_S1VAL_20_u1 1. _CNV_A_R_ECME_LINEA_0_CM 0. 1. FORMAT "%1.0" BIT_MASK 0x1 /end CHARACTERISTIC
/begin CHARACTERISTIC Cxx_lbup_cold_sta_rat "PWM before dewpoint detection (cold start)" VALUE 0xa0020e27 _REC_S1VAL_20_u1 100. _CNV_A_R_LINEAR_____114_CM 0. 100. FORMAT "%12.8" /end CHARACTERISTIC
/begin CHARACTERISTIC Cxx_lbup_dft_pwm "PWM use in case of battery failure" VALUE 0xa0020e28 _REC_S1VAL_20_u1 100. _CNV_A_R_LINEAR_____114_CM 0. 100. FORMAT "%12.8" /end CHARACTERISTIC
/begin CHARACTERISTIC Cxx_lbup_dly_rest_t "Time necessary to concider the sensor warm or cold (under power latch)" VALUE 0xa0020e18 _REC_S1VAL_20_u2 65534. _CNV_A_R_LINEAR_____82_CM 1. 65535. FORMAT "%5.0" /end CHARACTERISTIC
/begin CHARACTERISTIC Cxx_lbup_heat_r "Resistence of the heating circuit of the upstream oxygen sensor" VALUE 0xa0020e29 _REC_S1VAL_20_u1 9.9609375 _CNV_A_R_LINEAR_____314_CM 0.1 10.0609375 FORMAT "%5.2" /end CHARACTERISTIC
/begin CHARACTERISTIC Cxx_lbup_hot_cmd_map_hys "Maximum pressure value to switch on again the heater (hysteresis)" VALUE 0xa0020e1a _REC_S1VAL_20_u2 20000. _CNV_A_R_LINEAR_____57_CM 0. 20000. FORMAT "%5.0" /end CHARACTERISTIC
/begin CHARACTERISTIC Cxx_lbup_hot_cmd_vs_hys "Maximum speed vehicule to switch on again the heater (hysteresis)" VALUE 0xa0020e2a _REC_S1VAL_20_u1 255. _CNV_A_R_LINEAR_____212_CM 0. 255. FORMAT "%3.0" /end CHARACTERISTIC
/begin CHARACTERISTIC Cxx_lbup_hot_dsb_vs "Maximum vehicule speed to heat the sensor" VALUE 0xa0020e2b _REC_S1VAL_20_u1 255. _CNV_A_R_LINEAR_____212_CM 0. 255. FORMAT "%3.0" /end CHARACTERISTIC
/begin CHARACTERISTIC Cxx_lbup_hot_egy "Heating energy threshold over wich upstream oxygen sensor is considered as hot" VALUE 0xa0020e1c _REC_S1VAL_20_u2 2399.96337890625 _CNV_A_R_LINEAR_____315_CM 0. 2399.96337890625 FORMAT "%7.2" /end CHARACTERISTIC
/begin CHARACTERISTIC Cxx_lbup_hot_egy_max "Maximum heating energy threshold over which upstream oxygen sensor is considered as constant hot" VALUE 0xa0020e1e _REC_S1VAL_20_u2 2399.96337890625 _CNV_A_R_LINEAR_____315_CM 0. 2399.96337890625 FORMAT "%7.2" /end CHARACTERISTIC
/begin CHARACTERISTIC Cxx_lbup_hot_sta_end "Time necessary to concider a hot sensor" VALUE 0xa0020e20 _REC_S1VAL_20_u2 65535. _CNV_A_R_LINEAR_____82_CM 0. 65535. FORMAT "%5.0" /end CHARACTERISTIC
/begin CHARACTERISTIC Cxx_lbup_loss_pow "Heating power lost during cooling phase (w/o haeting the sensor)" VALUE 0xa0020e22 _REC_S1VAL_20_u2 239.996337890625 _CNV_A_R_LINEAR_____313_CM 0. 239.996337890625 FORMAT "%7.3" /end CHARACTERISTIC
/begin CHARACTERISTIC Cxx_lbup_rms_v "Effective voltage recommanded by the sensor supplyer" VALUE 0xa0020e2c _REC_S1VAL_20_u1 255. _CNV_A_R_LINEAR_____311_CM 0. 255. FORMAT "%3.0" /end CHARACTERISTIC
/begin CHARACTERISTIC Cxx_lbup_tco_rest_thd "Tco threshold activating the hot restart strategy" VALUE 0xa0020e24 _REC_S1VAL_20_u2 240. _CNV_A_R_LINEAR_____54_CM -40. 200. FORMAT "%5.1" /end CHARACTERISTIC
/begin MEASUREMENT Vsx_lbup_hot_vld "Front Oxygen Heating Validity Status" UBYTE _CNV_S_3_STATUS_OK__120_CM 1 0. 0. 2. ECU_ADDRESS 0xd0005392 /end MEASUREMENT
/begin CHARACTERISTIC Cxx_dfdec_lbup_hot_oc "Upstream lambda sensor heating Open circuit diagnostic detected failure counter decrement" VALUE 0xa0020e2e _REC_S1VAL_20_u2 65535. _CNV_A_R_ECME_LINEA_0_CM 0. 65535. FORMAT "%5.0" /end CHARACTERISTIC
/begin CHARACTERISTIC Cxx_dfdec_lbup_hot_scg "Upstream lambda sensor heating Short circuit to ground diagnostic detected failure counter decrement" VALUE 0xa0020e30 _REC_S1VAL_20_u2 65535. _CNV_A_R_ECME_LINEA_0_CM 0. 65535. FORMAT "%5.0" /end CHARACTERISTIC
/begin CHARACTERISTIC Cxx_dfdec_lbup_hot_scw "Upstream lambda sensor heating Short circuit at battery + diagnostic detected failure counter decrement" VALUE 0xa0020e32 _REC_S1VAL_20_u2 65535. _CNV_A_R_ECME_LINEA_0_CM 0. 65535. FORMAT "%5.0" /end CHARACTERISTIC
/begin CHARACTERISTIC Cxx_dfinc_lbup_hot_oc "Upstream lambda sensor heating Open circuit diagnostic detected failure counter increment" VALUE 0xa0020e34 _REC_S1VAL_20_u2 65535. _CNV_A_R_ECME_LINEA_0_CM 0. 65535. FORMAT "%5.0" /end CHARACTERISTIC
/begin CHARACTERISTIC Cxx_dfinc_lbup_hot_scg "Upstream lambda sensor heating Short circuit to ground diagnostic detected failure counter increment" VALUE 0xa0020e36 _REC_S1VAL_20_u2 65535. _CNV_A_R_ECME_LINEA_0_CM 0. 65535. FORMAT "%5.0" /end CHARACTERISTIC
/begin CHARACTERISTIC Cxx_dfinc_lbup_hot_scw "Upstream lambda sensor heating Short circuit at battery + diagnostic detected failure counter increment" VALUE 0xa0020e38 _REC_S1VAL_20_u2 65535. _CNV_A_R_ECME_LINEA_0_CM 0. 65535. FORMAT "%5.0" /end CHARACTERISTIC
/begin AXIS_PTS Ctb_fct_tco_crkm "Equally distributed breakpoints for Ctp_fct_tco_dly" 0xa0022624 Vxx_tco _REC_A2AXS_20_u2 240. _CNV_A_R_LINEAR_____54_CM 9 -40. 200. FORMAT "%5.1" /end AXIS_PTS
/begin CHARACTERISTIC Ctp_fct_tco_dly "Table of starter time out function of the water temperature" CURVE 0xa0022638 _REC_A1CUR_20_u2_u2 6553.5 _CNV_A_R_LINEAR_____4_CM 0. 6553.5 FORMAT "%6.1"
 /begin AXIS_DESCR COM_AXIS Vxx_tco _CNV_A_R_LINEAR_____54_CM 9 -40. 200. FORMAT "%5.1" AXIS_PTS_REF Ctb_fct_tco_crkm /end AXIS_DESCR
/end CHARACTERISTIC
/begin MEASUREMENT Vbx_dft_sta "Flag indicating a starter activated but driven state not detected" UBYTE _CNV_S_2_RANGE______3_CM 1 0. 0. 1. ECU_ADDRESS 0xd00041f4 BIT_MASK 0x1 /end MEASUREMENT
/begin MEASUREMENT Vbx_long_crk_req "Long cranking request (request = 1)" UBYTE _CNV_S_2_RANGE______3_CM 1 0. 0. 1. ECU_ADDRESS 0xd00041f5 BIT_MASK 0x1 /end MEASUREMENT
/begin MEASUREMENT Vsx_ena_sta_agb_ecm "AT recopy Starter authorization or stop" UBYTE _CNV_A_R_ECME_LINEA_0_CM 1 0. 0. 3. ECU_ADDRESS 0xd00041f6 FORMAT "%1.0" /end MEASUREMENT
/begin MEASUREMENT Vsx_ena_sta_ecm "Data indicating the cranking authorization ECM" UBYTE _CNV_A_R_ECME_LINEA_0_CM 1 0. 0. 4. ECU_ADDRESS 0xd00041f7 FORMAT "%1.0" /end MEASUREMENT
/begin CHARACTERISTIC Cxx_ena_sta_agb_vld_dly "After this duration, the previous value of Vsx_ena_sta_agb will be copy in Vsx_ena_sta_agb_ecm" VALUE 0xa00215aa _REC_S1VAL_20_u1 2.55 _CNV_A_R_LINEAR_____34_CM 0. 2.55 FORMAT "%4.2" /end CHARACTERISTIC
/begin CHARACTERISTIC Cxx_frst_sta_dly "Specific time out before starter stop demand for the first engine cranking" VALUE 0xa00215a6 _REC_S1VAL_20_u2 6553.5 _CNV_A_R_LINEAR_____4_CM 0. 6553.5 FORMAT "%6.1" /end CHARACTERISTIC
/begin CHARACTERISTIC Cxx_sta_stt_vld_dly "Duration of the starter status validity status before starter status reading" VALUE 0xa00215ab _REC_S1VAL_20_u1 2.55 _CNV_A_R_LINEAR_____34_CM 0. 2.55 FORMAT "%4.2" /end CHARACTERISTIC
/begin CHARACTERISTIC Cxx_wait_sta_fail_dly "Duration in stopped engine state before making a starter stop request" VALUE 0xa00215a8 _REC_S1VAL_20_u2 6553.5 _CNV_A_R_LINEAR_____4_CM 0. 6553.5 FORMAT "%6.1" /end CHARACTERISTIC
/begin MEASUREMENT Vbx_eng_crk_wait "Active during waiting for engine conditions before cranking (preheating, system initialization, ... )" UBYTE _CNV_S_2_RANGE______3_CM 1 0. 0. 1. ECU_ADDRESS 0xd0004abd BIT_MASK 0x1 /end MEASUREMENT
/begin MEASUREMENT Vbx_swlk2_code_line_dfl "Bit indicating a problem on the coded line" UBYTE _CNV_S_2_RANGE______3_CM 1 0. 0. 1. ECU_ADDRESS 0xd00013e7 BIT_MASK 0x1 /end MEASUREMENT
/begin MEASUREMENT Vbx_swlk2_ecm_lck_stt "Bit indicating that the ECM is LOCKED" UBYTE _CNV_S_2_RANGE______3_CM 1 0. 0. 1. ECU_ADDRESS 0xd00013e8 BIT_MASK 0x1 /end MEASUREMENT
/begin MEASUREMENT Vbx_swlk2_ecm_prot_stt "Bit indicating the ECU is PROTECTED" UBYTE _CNV_S_2_RANGE______3_CM 1 0. 0. 1. ECU_ADDRESS 0xd00013e9 BIT_MASK 0x1 /end MEASUREMENT
/begin MEASUREMENT Vbx_swlk2_eprm_dfl "Bit indicating a problem on the EEPROM" UBYTE _CNV_S_2_RANGE______3_CM 1 0. 0. 1. ECU_ADDRESS 0xd00013ea BIT_MASK 0x1 /end MEASUREMENT
/begin MEASUREMENT Vbx_swlk2_key_mem_stt "Bit indicating that a CODE has been LEARNT" UBYTE _CNV_S_2_RANGE______3_CM 1 0. 0. 1. ECU_ADDRESS 0xd00013eb BIT_MASK 0x1 /end MEASUREMENT
/begin MEASUREMENT Vbx_swlk2_pwl_rtn_req "Request from SOFTWARE LOCK 2 to maintain power latch power supply" UBYTE _CNV_S_2_RANGE______3_CM 1 0. 0. 1. ECU_ADDRESS 0xd00013ec BIT_MASK 0x1 /end MEASUREMENT
/begin MEASUREMENT Vbx_swlk_ecm_prot_stt "protected state of the ECM" UBYTE _CNV_S_2_RANGE______3_CM 1 0. 0. 1. ECU_ADDRESS 0xd00013e4 BIT_MASK 0x1 /end MEASUREMENT
/begin MEASUREMENT Vbx_swlk_pwl_rtn_req "request to keep the power before going in protected state" UBYTE _CNV_S_2_RANGE______3_CM 1 0. 0. 1. ECU_ADDRESS 0xd00013e5 BIT_MASK 0x1 /end MEASUREMENT
/begin MEASUREMENT Vxx_eng_run_ena_swlk "Engine running authorisation dependent on the anti theft strategy" UBYTE _CNV_A_R_ECME_LINEA_0_CM 1 0. 0. 255. ECU_ADDRESS 0xd00013e6 FORMAT "%3.0" /end MEASUREMENT
/begin MEASUREMENT Vbx_swlk_2_4_cfm "Immobilizer 4 (=1) or 2 (=0) configuration" UBYTE _CNV_S_2_RANGE______3_CM 1 0. 0. 1. ECU_ADDRESS 0xd00013ed BIT_MASK 0x1 /end MEASUREMENT
/begin CHARACTERISTIC Cbx_swlk_2_4_cfm "Immobilizer 4 (=1) or 2 (=0) configuration" VALUE 0xa0021cee _REC_S1VAL_20_u1 1. _CNV_A_R_ECME_LINEA_0_CM 0. 1. FORMAT "%1.0" BIT_MASK 0x1 /end CHARACTERISTIC
/begin MEASUREMENT SLockRequestControl "Transmitted CAN parameter" UBYTE _CNV_A_R_ECME_LINEA_0_CM 1 0. 0. 15. ECU_ADDRESS 0xd00013d0 FORMAT "%2.0" /end MEASUREMENT
/begin MEASUREMENT SoftwareLockRequest[0] "Transmitted CAN parameter" UBYTE _CNV_A_R_ECME_LINEA_0_CM 1 0. 0. 255. ECU_ADDRESS 0xd00013ca FORMAT "%3.0" /end MEASUREMENT
/begin MEASUREMENT SoftwareLockRequest[1] "Transmitted CAN parameter" UBYTE _CNV_A_R_ECME_LINEA_0_CM 1 0. 0. 255. ECU_ADDRESS 0xd00013cb FORMAT "%3.0" /end MEASUREMENT
/begin MEASUREMENT SoftwareLockRequest[2] "Transmitted CAN parameter" UBYTE _CNV_A_R_ECME_LINEA_0_CM 1 0. 0. 255. ECU_ADDRESS 0xd00013cc FORMAT "%3.0" /end MEASUREMENT
/begin MEASUREMENT SoftwareLockRequest[3] "Transmitted CAN parameter" UBYTE _CNV_A_R_ECME_LINEA_0_CM 1 0. 0. 255. ECU_ADDRESS 0xd00013cd FORMAT "%3.0" /end MEASUREMENT
/begin MEASUREMENT SoftwareLockRequest[4] "Transmitted CAN parameter" UBYTE _CNV_A_R_ECME_LINEA_0_CM 1 0. 0. 255. ECU_ADDRESS 0xd00013ce FORMAT "%3.0" /end MEASUREMENT
/begin MEASUREMENT SoftwareLockRequest[5] "Transmitted CAN parameter" UBYTE _CNV_A_R_ECME_LINEA_0_CM 1 0. 0. 255. ECU_ADDRESS 0xd00013cf FORMAT "%3.0" /end MEASUREMENT
/begin MEASUREMENT Vbx_supl_key_bkup_ok "NVMY erasable area of secret key available" UBYTE _CNV_S_2_RANGE______3_CM 1 0. 0. 1. ECU_ADDRESS 0xd00013d1 BIT_MASK 0x1 /end MEASUREMENT
/begin MEASUREMENT Vbx_supl_key_norm_ok "NVMY not erasable area of secret key available" UBYTE _CNV_S_2_RANGE______3_CM 1 0. 0. 1. ECU_ADDRESS 0xd00013d2 BIT_MASK 0x1 /end MEASUREMENT
/begin MEASUREMENT Vbx_swlk_4_ecm_prot_stt "protected state of the ECM" UBYTE _CNV_S_2_RANGE______3_CM 1 0. 0. 1. ECU_ADDRESS 0xd00013d3 BIT_MASK 0x1 /end MEASUREMENT
/begin MEASUREMENT Vbx_swlk_4_pwl_rtn_req "request to keep the power before going in protected state" UBYTE _CNV_S_2_RANGE______3_CM 1 0. 0. 1. ECU_ADDRESS 0xd00013d4 BIT_MASK 0x1 /end MEASUREMENT
/begin MEASUREMENT Vbx_swlk_cnt_tool_req "informs that the learning request has failed" UBYTE _CNV_S_2_RANGE______3_CM 1 0. 0. 1. ECU_ADDRESS 0xd00013d5 BIT_MASK 0x1 /end MEASUREMENT
/begin MEASUREMENT Vbx_swlk_diag_avl "Bit indicating that the Immobiliser diagnosis is available" UBYTE _CNV_S_2_RANGE______3_CM 1 0. 0. 1. ECU_ADDRESS 0xd00013d6 BIT_MASK 0x1 /end MEASUREMENT
/begin MEASUREMENT Vbx_swlk_diag_ccu "Immobiliser diagnosis bit indicating that the engine isn't running due to no BCM authorisation" UBYTE _CNV_S_2_RANGE______3_CM 1 0. 0. 1. ECU_ADDRESS 0xd00013d7 BIT_MASK 0x1 /end MEASUREMENT
/begin MEASUREMENT Vbx_swlk_diag_ecm "Immobiliser diagnosis bit indicating that the engine isn't running due to ECM" UBYTE _CNV_S_2_RANGE______3_CM 1 0. 0. 1. ECU_ADDRESS 0xd00013d8 BIT_MASK 0x1 /end MEASUREMENT
/begin MEASUREMENT Vbx_swlk_diag_mux "Immobiliser diagnosis bit indicating that the engine isn't running due to a CAN problem with BCM" UBYTE _CNV_S_2_RANGE______3_CM 1 0. 0. 1. ECU_ADDRESS 0xd00013d9 BIT_MASK 0x1 /end MEASUREMENT
/begin MEASUREMENT Vbx_swlk_diag_tool "Immobiliser diagnosis bit indicating that the engine isn't running due to BCM secure mode" UBYTE _CNV_S_2_RANGE______3_CM 1 0. 0. 1. ECU_ADDRESS 0xd00013da BIT_MASK 0x1 /end MEASUREMENT
/begin MEASUREMENT Vbx_swlk_dsb_ena "Indicates if the inhibition of immobilizer strategy is allowed" UBYTE _CNV_S_2_RANGE______3_CM 1 0. 0. 1. ECU_ADDRESS 0xd00013db BIT_MASK 0x1 /end MEASUREMENT
/begin MEASUREMENT Vsx_swlk_stt "Immobiliser automaton phase number" UBYTE _CNV_A_R_ECME_LINEA_0_CM 1 0. 0. 255. ECU_ADDRESS 0xd00013dc FORMAT "%3.0" /end MEASUREMENT
/begin MEASUREMENT Vxx_swlk_4_eng_run_ena "Engine running authorisation dependent on the anti theft strategy" UBYTE _CNV_A_R_ECME_LINEA_0_CM 1 0. 0. 255. ECU_ADDRESS 0xd00013dd FORMAT "%3.0" /end MEASUREMENT
/begin MEASUREMENT Vxx_swlk_diag_1 "Byte used to allow Immobiliser diagnosis" UBYTE _CNV_A_R_ECME_LINEA_0_CM 1 0. 0. 255. ECU_ADDRESS 0xd00013de FORMAT "%3.0" /end MEASUREMENT
/begin MEASUREMENT Vxx_swlk_diag_2 "Byte used to allow Immobiliser diagnosis" UBYTE _CNV_A_R_ECME_LINEA_0_CM 1 0. 0. 255. ECU_ADDRESS 0xd00013df FORMAT "%3.0" /end MEASUREMENT
/begin MEASUREMENT Vxx_swlk_diag_3 "Byte used to allow Immobiliser diagnosis" UBYTE _CNV_A_R_ECME_LINEA_0_CM 1 0. 0. 255. ECU_ADDRESS 0xd00013e0 FORMAT "%3.0" /end MEASUREMENT
/begin MEASUREMENT Vxx_swlk_key_mem_stt "Secret key NVMY area" UBYTE _CNV_A_R_ECME_LINEA_0_CM 1 0. 0. 3. ECU_ADDRESS 0xd00013e1 FORMAT "%1.0" /end MEASUREMENT
/begin MEASUREMENT Vxx_swlk_nok_id_ctr "False authentications counter" UBYTE _CNV_A_R_ECME_LINEA_0_CM 1 0. 0. 255. ECU_ADDRESS 0xd00013e2 FORMAT "%3.0" /end MEASUREMENT
/begin CHARACTERISTIC Cbx_swlk_dsb "completely inhibits the immobilizer strategy for development purpose (on emulated ECM only)" VALUE 0xa0020a54 _REC_S1VAL_20_u1 1. _CNV_S_2_RANGE______3_CM 0. 1. BIT_MASK 0x1 /end CHARACTERISTIC
/begin CHARACTERISTIC Cbx_swlk_key_spc_req "indicates a specific request to learn the secret key without security tool" VALUE 0xa0020a55 _REC_S1VAL_20_u1 1. _CNV_S_2_RANGE______3_CM 0. 1. BIT_MASK 0x1 /end CHARACTERISTIC
/begin CHARACTERISTIC Cbx_swlk_req "set if immobilizer strategy is a base equipment" VALUE 0xa0020a56 _REC_S1VAL_20_u1 1. _CNV_S_2_RANGE______3_CM 0. 1. BIT_MASK 0x1 /end CHARACTERISTIC
/begin CHARACTERISTIC Cxx_swlk_chlg_dly "max delay for waiting the response to the challenge" VALUE 0xa0020a57 _REC_S1VAL_20_u1 2.55 _CNV_A_R_LINEAR_____34_CM 0. 2.55 FORMAT "%4.2" /end CHARACTERISTIC
/begin CHARACTERISTIC Cxx_swlk_diag_dly "Minimum delay for availability of Immobilizer diagnosis" VALUE 0xa0020a58 _REC_S1VAL_20_u1 2.55 _CNV_A_R_LINEAR_____34_CM 0. 2.55 FORMAT "%4.2" /end CHARACTERISTIC
/begin CHARACTERISTIC Cxx_swlk_id_forb_dly "max delay during which both engine running and exchanges with BCM are forbidden" VALUE 0xa0020a59 _REC_S1VAL_20_u1 25.5 _CNV_A_R_LINEAR_____4_CM 0. 25.5 FORMAT "%4.1" /end CHARACTERISTIC
/begin CHARACTERISTIC Cxx_swlk_id_nok_ctr_dec "max number of authentications allowed after the end of antiscanning timer" VALUE 0xa0020a5a _REC_S1VAL_20_u1 255. _CNV_A_R_ECME_LINEA_0_CM 0. 255. FORMAT "%3.0" /end CHARACTERISTIC
/begin CHARACTERISTIC Cxx_swlk_id_nr_ena "max number of false authentications allowed" VALUE 0xa0020a5b _REC_S1VAL_20_u1 255. _CNV_A_R_ECME_LINEA_0_CM 0. 255. FORMAT "%3.0" /end CHARACTERISTIC
/begin CHARACTERISTIC Cxx_swlk_key_dlt_dly "max time where clearing the secret key is allowed" VALUE 0xa0020a5c _REC_S1VAL_20_u1 2.55 _CNV_A_R_LINEAR_____34_CM 0. 2.55 FORMAT "%4.2" /end CHARACTERISTIC
/begin CHARACTERISTIC Cxx_swlk_key_dly "max waiting time for receiving secret key" VALUE 0xa0020a5d _REC_S1VAL_20_u1 2.55 _CNV_A_R_LINEAR_____34_CM 0. 2.55 FORMAT "%4.2" /end CHARACTERISTIC
/begin CHARACTERISTIC Cxx_swlk_noi_1 "Value used to calculate the first noise byte of the ECM_VERLOG frame" VALUE 0xa0020a4e _REC_S1VAL_20_u1 255. _CNV_A_R_ECME_LINEA_0_CM 0. 255. DISPLAY_IDENTIFIER Cxx_swlk_noi[0] FORMAT "%3.0" /end CHARACTERISTIC
/begin CHARACTERISTIC Cxx_swlk_noi_2 "Value used to calculate the first noise byte of the ECM_VERLOG frame" VALUE 0xa0020a4f _REC_S1VAL_20_u1 255. _CNV_A_R_ECME_LINEA_0_CM 0. 255. DISPLAY_IDENTIFIER Cxx_swlk_noi[1] FORMAT "%3.0" /end CHARACTERISTIC
/begin CHARACTERISTIC Cxx_swlk_noi_3 "Value used to calculate the first noise byte of the ECM_VERLOG frame" VALUE 0xa0020a50 _REC_S1VAL_20_u1 255. _CNV_A_R_ECME_LINEA_0_CM 0. 255. DISPLAY_IDENTIFIER Cxx_swlk_noi[2] FORMAT "%3.0" /end CHARACTERISTIC
/begin CHARACTERISTIC Cxx_swlk_noi_4 "Value used to calculate the first noise byte of the ECM_VERLOG frame" VALUE 0xa0020a51 _REC_S1VAL_20_u1 255. _CNV_A_R_ECME_LINEA_0_CM 0. 255. DISPLAY_IDENTIFIER Cxx_swlk_noi[3] FORMAT "%3.0" /end CHARACTERISTIC
/begin CHARACTERISTIC Cxx_swlk_noi_5 "Value used to calculate the first noise byte of the ECM_VERLOG frame" VALUE 0xa0020a52 _REC_S1VAL_20_u1 255. _CNV_A_R_ECME_LINEA_0_CM 0. 255. DISPLAY_IDENTIFIER Cxx_swlk_noi[4] FORMAT "%3.0" /end CHARACTERISTIC
/begin CHARACTERISTIC Cxx_swlk_noi_6 "Value used to calculate the first noise byte of the ECM_VERLOG frame" VALUE 0xa0020a53 _REC_S1VAL_20_u1 255. _CNV_A_R_ECME_LINEA_0_CM 0. 255. DISPLAY_IDENTIFIER Cxx_swlk_noi[5] FORMAT "%3.0" /end CHARACTERISTIC
/begin CHARACTERISTIC Cxx_swlk_pwl_dly "duration of the power lacth phase concerning the anti-theft strategy." VALUE 0xa0020a5e _REC_S1VAL_20_u1 25.5 _CNV_A_R_LINEAR_____4_CM 0. 25.5 FORMAT "%4.1" /end CHARACTERISTIC
/begin MEASUREMENT Vxx_it_maf_sp "Throttle mass air flow correxponding to the request of the torque structure" UWORD _CNV_A_R_LINEAR_____109_CM 1 0. 0. 3000. ECU_ADDRESS 0xd0003640 FORMAT "%7.2" /end MEASUREMENT
/begin MEASUREMENT Vxx_maf_eng_sp "Setpoint of the mass air flow pumped into cylinder" UWORD _CNV_A_R_LINEAR_____109_CM 1 0. 0. 3000. ECU_ADDRESS 0xd0003642 FORMAT "%7.2" /end MEASUREMENT
/begin MEASUREMENT Vxx_knk_ctr_cyl_1 "" UWORD _CNV_A_R_ECME_LINEA_0_CM 1 0. 0. 65535. DISPLAY_IDENTIFIER InCbiKnk_NVM.Vxx_knk_ctr_cyl_1_NVM ECU_ADDRESS 0xd0003608 FORMAT "%5.0" /end MEASUREMENT
/begin MEASUREMENT Vxx_knk_ctr_cyl_2 "" UWORD _CNV_A_R_ECME_LINEA_0_CM 1 0. 0. 65535. DISPLAY_IDENTIFIER InCbiKnk_NVM.Vxx_knk_ctr_cyl_2_NVM ECU_ADDRESS 0xd000360a FORMAT "%5.0" /end MEASUREMENT
/begin MEASUREMENT Vxx_knk_ctr_cyl_3 "" UWORD _CNV_A_R_ECME_LINEA_0_CM 1 0. 0. 65535. DISPLAY_IDENTIFIER InCbiKnk_NVM.Vxx_knk_ctr_cyl_3_NVM ECU_ADDRESS 0xd000360c FORMAT "%5.0" /end MEASUREMENT
/begin MEASUREMENT Vxx_knk_ctr_cyl_4 "" UWORD _CNV_A_R_ECME_LINEA_0_CM 1 0. 0. 65535. DISPLAY_IDENTIFIER InCbiKnk_NVM.Vxx_knk_ctr_cyl_4_NVM ECU_ADDRESS 0xd000360e FORMAT "%5.0" /end MEASUREMENT
/begin MEASUREMENT Vxx_mv_knk "Mean knock noise" UBYTE _CNV_A_R_ECME_LINEA_0_CM 1 0. 0. 255. ECU_ADDRESS 0xd0005501 FORMAT "%3.0" /end MEASUREMENT
/begin CHARACTERISTIC Cxx_knk_fil_ftc "mean knock filtering factor for diagnosis frame " VALUE 0xa00214fd _REC_S1VAL_20_u1 2.55 _CNV_A_R_LINEAR_____34_CM 0. 2.55 FORMAT "%4.2" /end CHARACTERISTIC
/begin AXIS_PTS Ctb_n_knk "20 programmable engine speed breakpoints map" 0xa00238fc Vxx_n _REC_A2AXS_20_u2 16383.75 _CNV_A_R_ENSD_LINEA_24_CM 20 0. 16383.75 FORMAT "%8.2" /end AXIS_PTS
/begin CHARACTERISTIC Ctp_n_knk_fac_cyl_0 "Factor on cylinder 1 knock for knock detection depending on engine speed" CURVE 0xa0023928 _REC_A1CUR_20_u1_u2 1. _CNV_A_R_LINEAR_____118_CM 0. 1. FORMAT "%9.7"
 /begin AXIS_DESCR COM_AXIS Vxx_n _CNV_A_R_ENSD_LINEA_24_CM 20 0. 16383.75 FORMAT "%8.2" AXIS_PTS_REF Ctb_n_knk /end AXIS_DESCR
/end CHARACTERISTIC
/begin CHARACTERISTIC Ctp_n_knk_fac_cyl_1 "Factor on cylinder 3 knock for knock detection depending on engine speed" CURVE 0xa002393c _REC_A1CUR_20_u1_u2 1. _CNV_A_R_LINEAR_____118_CM 0. 1. FORMAT "%9.7"
 /begin AXIS_DESCR COM_AXIS Vxx_n _CNV_A_R_ENSD_LINEA_24_CM 20 0. 16383.75 FORMAT "%8.2" AXIS_PTS_REF Ctb_n_knk /end AXIS_DESCR
/end CHARACTERISTIC
/begin CHARACTERISTIC Ctp_n_knk_fac_cyl_2 "Factor on cylinder 4 knock for knock detection depending on engine speed" CURVE 0xa0023950 _REC_A1CUR_20_u1_u2 1. _CNV_A_R_LINEAR_____118_CM 0. 1. FORMAT "%9.7"
 /begin AXIS_DESCR COM_AXIS Vxx_n _CNV_A_R_ENSD_LINEA_24_CM 20 0. 16383.75 FORMAT "%8.2" AXIS_PTS_REF Ctb_n_knk /end AXIS_DESCR
/end CHARACTERISTIC
/begin CHARACTERISTIC Ctp_n_knk_fac_cyl_3 "Factor on cylinder 2 knock for knock detection depending on engine speed" CURVE 0xa0023964 _REC_A1CUR_20_u1_u2 1. _CNV_A_R_LINEAR_____118_CM 0. 1. FORMAT "%9.7"
 /begin AXIS_DESCR COM_AXIS Vxx_n _CNV_A_R_ENSD_LINEA_24_CM 20 0. 16383.75 FORMAT "%8.2" AXIS_PTS_REF Ctb_n_knk /end AXIS_DESCR
/end CHARACTERISTIC
/begin CHARACTERISTIC Ctp_n_knk_ofs_cyl_0 "Offset on cylinder 1 knock for knock detection depending on engine speed" CURVE 0xa0023978 _REC_A1CUR_20_u1_u2 255. _CNV_A_R_ECME_LINEA_0_CM 0. 255. FORMAT "%3.0"
 /begin AXIS_DESCR COM_AXIS Vxx_n _CNV_A_R_ENSD_LINEA_24_CM 20 0. 16383.75 FORMAT "%8.2" AXIS_PTS_REF Ctb_n_knk /end AXIS_DESCR
/end CHARACTERISTIC
/begin CHARACTERISTIC Ctp_n_knk_ofs_cyl_1 "Offset on cylinder 3 knock for knock detection depending on engine speed" CURVE 0xa002398c _REC_A1CUR_20_u1_u2 255. _CNV_A_R_ECME_LINEA_0_CM 0. 255. FORMAT "%3.0"
 /begin AXIS_DESCR COM_AXIS Vxx_n _CNV_A_R_ENSD_LINEA_24_CM 20 0. 16383.75 FORMAT "%8.2" AXIS_PTS_REF Ctb_n_knk /end AXIS_DESCR
/end CHARACTERISTIC
/begin CHARACTERISTIC Ctp_n_knk_ofs_cyl_2 "Offset on cylinder 4 knock for knock detection depending on engine speed" CURVE 0xa00239a0 _REC_A1CUR_20_u1_u2 255. _CNV_A_R_ECME_LINEA_0_CM 0. 255. FORMAT "%3.0"
 /begin AXIS_DESCR COM_AXIS Vxx_n _CNV_A_R_ENSD_LINEA_24_CM 20 0. 16383.75 FORMAT "%8.2" AXIS_PTS_REF Ctb_n_knk /end AXIS_DESCR
/end CHARACTERISTIC
/begin CHARACTERISTIC Ctp_n_knk_ofs_cyl_3 "Offset on cylinder 2 knock for knock detection depending on engine speed" CURVE 0xa00239b4 _REC_A1CUR_20_u1_u2 255. _CNV_A_R_ECME_LINEA_0_CM 0. 255. FORMAT "%3.0"
 /begin AXIS_DESCR COM_AXIS Vxx_n _CNV_A_R_ENSD_LINEA_24_CM 20 0. 16383.75 FORMAT "%8.2" AXIS_PTS_REF Ctb_n_knk /end AXIS_DESCR
/end CHARACTERISTIC
/begin CHARACTERISTIC Ctp_n_knk_zon "Pressure threshold to critical zone depending on engine speed" CURVE 0xa00239c8 _REC_A1CUR_20_u2_u2 20000. _CNV_A_R_LINEAR_____57_CM 0. 20000. FORMAT "%5.0"
 /begin AXIS_DESCR COM_AXIS Vxx_n _CNV_A_R_ENSD_LINEA_24_CM 20 0. 16383.75 FORMAT "%8.2" AXIS_PTS_REF Ctb_n /end AXIS_DESCR
/end CHARACTERISTIC
/begin MEASUREMENT Vbx_fil_knk_noi_cyl_init "Filtered knock noise is initialized" UBYTE _CNV_S_2_RANGE______3_CM 1 0. 0. 1. ECU_ADDRESS 0xd0005692 BIT_MASK 0x1 /end MEASUREMENT
/begin MEASUREMENT Vbx_knk_det_cyl_1 "Knock detection on cylinder 1" UBYTE _CNV_S_2_RANGE______3_CM 1 0. 0. 1. ECU_ADDRESS 0xd00049b6 BIT_MASK 0x1 /end MEASUREMENT
/begin MEASUREMENT Vbx_knk_det_cyl_2 "Knock detection on cylinder 2" UBYTE _CNV_S_2_RANGE______3_CM 1 0. 0. 1. ECU_ADDRESS 0xd00049b7 BIT_MASK 0x1 /end MEASUREMENT
/begin MEASUREMENT Vbx_knk_det_cyl_3 "Knock detection on cylinder 3" UBYTE _CNV_S_2_RANGE______3_CM 1 0. 0. 1. ECU_ADDRESS 0xd00049b8 BIT_MASK 0x1 /end MEASUREMENT
/begin MEASUREMENT Vbx_knk_det_cyl_4 "Knock detection on cylinder 4" UBYTE _CNV_S_2_RANGE______3_CM 1 0. 0. 1. ECU_ADDRESS 0xd00049b9 BIT_MASK 0x1 /end MEASUREMENT
/begin MEASUREMENT Vbx_knk_det_ena "Knock detection enable " UBYTE _CNV_S_2_RANGE______3_CM 1 0. 0. 1. ECU_ADDRESS 0xd00049ba BIT_MASK 0x1 /end MEASUREMENT
/begin MEASUREMENT Vbx_knk_n_dsb "Inhibition of knock computations" UBYTE _CNV_S_2_RANGE______3_CM 1 0. 0. 1. ECU_ADDRESS 0xd00049bb BIT_MASK 0x1 /end MEASUREMENT
/begin MEASUREMENT Vbx_knk_zon "Indicator of knock zone" UBYTE _CNV_S_2_RANGE______3_CM 1 0. 0. 1. ECU_ADDRESS 0xd00049bc BIT_MASK 0x1 /end MEASUREMENT
/begin MEASUREMENT Vsx_knk_sens_vld "Breakdown of knock sensor" UBYTE _CNV_S_2_STATUS_OK__214_CM 1 0. 0. 1. ECU_ADDRESS 0xd00049bd /end MEASUREMENT
/begin MEASUREMENT Vtd_fil_knk_noi_cyl[0] "Filtered knock noise for each cylinder" UWORD _CNV_A_R_LINEAR_____31_CM 1 0. 0. 255.99609375 ECU_ADDRESS 0xd0003610 FORMAT "%10.6" /end MEASUREMENT
/begin MEASUREMENT Vtd_fil_knk_noi_cyl[1] "Filtered knock noise for each cylinder" UWORD _CNV_A_R_LINEAR_____31_CM 1 0. 0. 255.99609375 ECU_ADDRESS 0xd0003612 FORMAT "%10.6" /end MEASUREMENT
/begin MEASUREMENT Vtd_fil_knk_noi_cyl[2] "Filtered knock noise for each cylinder" UWORD _CNV_A_R_LINEAR_____31_CM 1 0. 0. 255.99609375 ECU_ADDRESS 0xd0003614 FORMAT "%10.6" /end MEASUREMENT
/begin MEASUREMENT Vtd_fil_knk_noi_cyl[3] "Filtered knock noise for each cylinder" UWORD _CNV_A_R_LINEAR_____31_CM 1 0. 0. 255.99609375 ECU_ADDRESS 0xd0003616 FORMAT "%10.6" /end MEASUREMENT
/begin MEASUREMENT Vtd_knk_det_cyl[0] "Knock detection for each cylinder" UBYTE _CNV_S_2_RANGE______3_CM 1 0. 0. 1. ECU_ADDRESS 0xd00049b2 BIT_MASK 0x1 /end MEASUREMENT
/begin MEASUREMENT Vtd_knk_det_cyl[1] "Knock detection for each cylinder" UBYTE _CNV_S_2_RANGE______3_CM 1 0. 0. 1. ECU_ADDRESS 0xd00049b3 BIT_MASK 0x1 /end MEASUREMENT
/begin MEASUREMENT Vtd_knk_det_cyl[2] "Knock detection for each cylinder" UBYTE _CNV_S_2_RANGE______3_CM 1 0. 0. 1. ECU_ADDRESS 0xd00049b4 BIT_MASK 0x1 /end MEASUREMENT
/begin MEASUREMENT Vtd_knk_det_cyl[3] "Knock detection for each cylinder" UBYTE _CNV_S_2_RANGE______3_CM 1 0. 0. 1. ECU_ADDRESS 0xd00049b5 BIT_MASK 0x1 /end MEASUREMENT
/begin MEASUREMENT Vxx_fil_acq_knk_cyl_1 "Instantaneous knock noise on cylinder 1" UBYTE _CNV_A_R_ECME_LINEA_0_CM 1 0. 0. 255. ECU_ADDRESS 0xd00049be FORMAT "%3.0" /end MEASUREMENT
/begin MEASUREMENT Vxx_fil_acq_knk_cyl_2 "Instantaneous knock noise on cylinder 2" UBYTE _CNV_A_R_ECME_LINEA_0_CM 1 0. 0. 255. ECU_ADDRESS 0xd00049bf FORMAT "%3.0" /end MEASUREMENT
/begin MEASUREMENT Vxx_fil_acq_knk_cyl_3 "Instantaneous knock noise on cylinder 3" UBYTE _CNV_A_R_ECME_LINEA_0_CM 1 0. 0. 255. ECU_ADDRESS 0xd00049c0 FORMAT "%3.0" /end MEASUREMENT
/begin MEASUREMENT Vxx_fil_acq_knk_cyl_4 "Instantaneous knock noise on cylinder 4" UBYTE _CNV_A_R_ECME_LINEA_0_CM 1 0. 0. 255. ECU_ADDRESS 0xd00049c1 FORMAT "%3.0" /end MEASUREMENT
/begin CHARACTERISTIC Cbx_knk_ini_req "Request for initialisation of knock variables" VALUE 0xa0021af2 _REC_S1VAL_20_u1 1. _CNV_A_R_ECME_LINEA_0_CM 0. 1. FORMAT "%1.0" BIT_MASK 0x1 /end CHARACTERISTIC
/begin CHARACTERISTIC Cxx_decl_knk_fil_fac "Knock filtering factor when knock increase" VALUE 0xa0021af3 _REC_S1VAL_20_u1 1. _CNV_A_R_LINEAR_____118_CM 0. 1. FORMAT "%9.7" /end CHARACTERISTIC
/begin CHARACTERISTIC Cxx_dfdec_knk_oor "a_in_cbi_knk_knkdtxx/Voltage Outside the Expected Range of knock detected failure counter decrement" VALUE 0xa0021ae0 _REC_S1VAL_20_u2 65535. _CNV_A_R_ECME_LINEA_0_CM 0. 65535. FORMAT "%5.0" /end CHARACTERISTIC
/begin CHARACTERISTIC Cxx_dfdec_knk_shp "a_in_cbi_knk_knkdtxx/Improper Signal Shape of knock detected failure counter decrement" VALUE 0xa0021ae2 _REC_S1VAL_20_u2 65535. _CNV_A_R_ECME_LINEA_0_CM 0. 65535. FORMAT "%5.0" /end CHARACTERISTIC
/begin CHARACTERISTIC Cxx_dfinc_knk_oor "a_in_cbi_knk_knkdtxx/Voltage Outside the Expected Range of knock detected failure counter increment" VALUE 0xa0021ae4 _REC_S1VAL_20_u2 65535. _CNV_A_R_ECME_LINEA_0_CM 0. 65535. FORMAT "%5.0" /end CHARACTERISTIC
/begin CHARACTERISTIC Cxx_dfinc_knk_shp "a_in_cbi_knk_knkdtxx/Improper Signal Shape of knock detected failure counter increment" VALUE 0xa0021ae6 _REC_S1VAL_20_u2 65535. _CNV_A_R_ECME_LINEA_0_CM 0. 65535. FORMAT "%5.0" /end CHARACTERISTIC
/begin CHARACTERISTIC Cxx_inc_knk_fil_fac "Knock filtering factor when knock decrease" VALUE 0xa0021af4 _REC_S1VAL_20_u1 1. _CNV_A_R_LINEAR_____118_CM 0. 1. FORMAT "%9.7" /end CHARACTERISTIC
/begin CHARACTERISTIC Cxx_knk_det_n_thd "Engine speed threshold above which no knock detection is made" VALUE 0xa0021ae8 _REC_S1VAL_20_u2 16383.75 _CNV_A_R_ENSD_LINEA_24_CM 0. 16383.75 FORMAT "%8.2" /end CHARACTERISTIC
/begin CHARACTERISTIC Cxx_knk_det_prs_thd "Pressure threshold below which no knock detection is made" VALUE 0xa0021aea _REC_S1VAL_20_u2 20000. _CNV_A_R_LINEAR_____57_CM 0. 20000. FORMAT "%5.0" /end CHARACTERISTIC
/begin CHARACTERISTIC Cxx_knk_det_tco_thd "Water temperature threshold below which no knock detection is made" VALUE 0xa0021aec _REC_S1VAL_20_u2 240. _CNV_A_R_LINEAR_____54_CM -40. 200. FORMAT "%5.1" /end CHARACTERISTIC
/begin CHARACTERISTIC Cxx_knk_fil_inc "Increment of Vtd_fil_knk_noi_cyl if knock detection is made" VALUE 0xa0021af5 _REC_S1VAL_20_u1 255. _CNV_A_R_ECME_LINEA_0_CM 0. 255. FORMAT "%3.0" /end CHARACTERISTIC
/begin CHARACTERISTIC Cxx_knk_n_dsb_thd "Engine speed threshold above which no knock calculation is made" VALUE 0xa0021aee _REC_S1VAL_20_u2 16383.75 _CNV_A_R_ENSD_LINEA_24_CM 0. 16383.75 FORMAT "%8.2" /end CHARACTERISTIC
/begin CHARACTERISTIC Cxx_knk_zon_tco_thd "Water temperature threshold above which critical zone can be" VALUE 0xa0021af0 _REC_S1VAL_20_u2 240. _CNV_A_R_LINEAR_____54_CM -40. 200. FORMAT "%5.1" /end CHARACTERISTIC
/begin MEASUREMENT Vxx_map_ref "Command of manifold pressure calculated by the torque structure" UWORD _CNV_A_R_LINEAR_____57_CM 1 0. 0. 20000. ECU_ADDRESS 0xd0003320 FORMAT "%5.0" /end MEASUREMENT
/begin MEASUREMENT Vxx_raw_map_ref "Command of manifold pressure calculated by the torque structure (without deadzone)" UWORD _CNV_A_R_LINEAR_____57_CM 1 0. 0. 20000. ECU_ADDRESS 0xd0003322 FORMAT "%5.0" /end MEASUREMENT
/begin CHARACTERISTIC Cxx_map_ref_dz "Command of manifold pressure deadzone" VALUE 0xa002159e _REC_S1VAL_20_u2 20000. _CNV_A_R_LINEAR_____57_CM 0. 20000. FORMAT "%5.0" /end CHARACTERISTIC
/begin MEASUREMENT Vxx_airb1 "Byte n∞1 of the AIRBAGCrash frame" UBYTE _CNV_A_R_ECME_LINEA_0_CM 1 0. 0. 255. ECU_ADDRESS 0xd0003f15 FORMAT "%3.0" /end MEASUREMENT
/begin MEASUREMENT Vxx_airb2 "Byte n∞2 of the AIRBAGCrash frame" UBYTE _CNV_A_R_ECME_LINEA_0_CM 1 0. 0. 255. ECU_ADDRESS 0xd0003f16 FORMAT "%3.0" /end MEASUREMENT
/begin MEASUREMENT Vxx_eng_stop_req_ccu "Emergency engine stop request" UBYTE _CNV_A_R_ECME_LINEA_0_CM 1 0. 0. 255. ECU_ADDRESS 0xd0003f17 FORMAT "%3.0" /end MEASUREMENT
/begin MEASUREMENT Vxx_eng_stop_req_rgb "Engine stop requested by robotized gearbox" UBYTE _CNV_A_R_ECME_LINEA_0_CM 1 0. 0. 255. ECU_ADDRESS 0xd0003f18 FORMAT "%3.0" /end MEASUREMENT
/begin MEASUREMENT Vxx_eng_stop_req_ssg "Engine stop requested by SSG" UBYTE _CNV_A_R_ECME_LINEA_0_CM 1 0. 0. 255. ECU_ADDRESS 0xd0003f19 FORMAT "%3.0" /end MEASUREMENT
/begin MEASUREMENT Vxx_vh_dist "" ULONG _CNV_A_R_LINEAR_____218_CM 1 0. 0. 16777215. DISPLAY_IDENTIFIER INVFIVSI_NVM.Vxx_vh_dist_NVM ECU_ADDRESS 0xd0001968 FORMAT "%8.0" /end MEASUREMENT
/begin MEASUREMENT Vbx_ecu_pres "Production control unit is present" UBYTE _CNV_S_2_RANGE______3_CM 1 0. 0. 1. ECU_ADDRESS 0xd0005375 BIT_MASK 0x1 /end MEASUREMENT
/begin MEASUREMENT Vsx_vh_dist_l_res_vld "Vehicle mileage with low resolution validity status" UBYTE _CNV_S_3_STATUS_OK__120_CM 1 0. 0. 2. ECU_ADDRESS 0xd0005376 /end MEASUREMENT
/begin MEASUREMENT Vsx_vh_dist_vld "Vehicle mileage validity status" UBYTE _CNV_S_3_STATUS_OK__120_CM 1 0. 0. 2. ECU_ADDRESS 0xd0005377 /end MEASUREMENT
/begin MEASUREMENT Vxx_vh_dist_l_res "Total vehicle distance with low resolution" UWORD _CNV_A_R_LINEAR_____316_CM 1 0. 0. 1048560. ECU_ADDRESS 0xd0005aae FORMAT "%7.0" /end MEASUREMENT
/begin CHARACTERISTIC Cxx_vh_dist_max_dif "Maximum allowed differential value of vehicle distance (for incrementing model)" VALUE 0xa0020c83 _REC_S1VAL_20_u1 255. _CNV_A_R_LINEAR_____218_CM 0. 255. FORMAT "%3.0" /end CHARACTERISTIC
/begin MEASUREMENT Vbx_dspl_vs_in_mph "The vehicule speed used for CC/SL is in mph" UBYTE _CNV_S_2_RANGE______3_CM 1 0. 0. 1. ECU_ADDRESS 0xd0003ffa BIT_MASK 0x1 /end MEASUREMENT
/begin MEASUREMENT Vsx_dspl_vs_vld "Displayed vehicule speed validity status" UBYTE _CNV_S_4_STATUS_OK__121_CM 1 0. 0. 3. ECU_ADDRESS 0xd0003ffb /end MEASUREMENT
/begin MEASUREMENT Vxx_dspl_vs "Displayed vehicle speed" UWORD _CNV_A_R_LINEAR_____70_CM 1 0. 0. 655.35 ECU_ADDRESS 0xd0003132 FORMAT "%6.2" /end MEASUREMENT
/begin MEASUREMENT Vxx_lg_acel "Longitudinal vehicle acceleration" SLONG _CNV_A_R_LINEAR_____317_CM 1 0. -12. 13.5 ECU_ADDRESS 0xd0001d7c FORMAT "%8.4" /end MEASUREMENT
/begin MEASUREMENT Vxx_lg_acel_raw "Longitudinal vehicle acceleration raw signal" SLONG _CNV_A_R_LINEAR_____317_CM 1 0. -12. 13.5 ECU_ADDRESS 0xd0001d80 FORMAT "%8.4" /end MEASUREMENT
/begin CHARACTERISTIC Cxx_lg_acel_fil "Time constant of the aceleration calcul filter" VALUE 0xa002195c _REC_S1VAL_20_u1 2.55 _CNV_A_R_LINEAR_____34_CM 0. 2.55 FORMAT "%4.2" /end CHARACTERISTIC
/begin CHARACTERISTIC Cxx_vs_tkof_thd "a_in_vfi_vsi_lacelmd_xxxx_xx_x_a/Take off vehicle speed value" VALUE 0xa002195a _REC_S1VAL_20_u2 655.35 _CNV_A_R_LINEAR_____70_CM 0. 655.35 FORMAT "%6.2" /end CHARACTERISTIC
/begin MEASUREMENT Vsx_vs_2_vld "Vehicle speed validity status" UBYTE _CNV_S_4_STATUS_OK__121_CM 1 0. 0. 3. ECU_ADDRESS 0xd000474d /end MEASUREMENT
/begin MEASUREMENT Vsx_vs_vld "Vehicule speed validity status" UBYTE _CNV_S_3_STATUS_OK__120_CM 1 0. 0. 2. ECU_ADDRESS 0xd000474e /end MEASUREMENT
/begin MEASUREMENT Vxx_vs "Vehicle speed" UWORD _CNV_A_R_LINEAR_____70_CM 1 0. 0. 655.35 ECU_ADDRESS 0xd00036e0 FORMAT "%6.2" /end MEASUREMENT
/begin CHARACTERISTIC Cbx_vs_vld_bch_mod_ena "Boolean to enable the bench mode for vehicle speed validity indicator (1 = enable, forbidden for serial vehicle)" VALUE 0xa00218cb _REC_S1VAL_20_u1 1. _CNV_S_2_RANGE______3_CM 0. 1. BIT_MASK 0x1 /end CHARACTERISTIC
/begin MEASUREMENT Vsx_lft_rwhs_vld "Rear left wheel speed validity status" UBYTE _CNV_S_3_STATUS_OK__120_CM 1 0. 0. 2. ECU_ADDRESS 0xd0004218 /end MEASUREMENT
/begin MEASUREMENT Vsx_rgt_rwhs_vld "Rear right wheel speed validity status" UBYTE _CNV_S_3_STATUS_OK__120_CM 1 0. 0. 2. ECU_ADDRESS 0xd0004219 /end MEASUREMENT
/begin MEASUREMENT Vxx_lft_rwhs "Rear left wheel speed" UWORD _CNV_A_R_LINEAR_____70_CM 1 0. 0. 655.34 ECU_ADDRESS 0xd00031d0 FORMAT "%6.2" /end MEASUREMENT
/begin MEASUREMENT Vxx_rgt_rwhs "Rear right wheel speed" UWORD _CNV_A_R_LINEAR_____70_CM 1 0. 0. 655.34 ECU_ADDRESS 0xd00031d2 FORMAT "%6.2" /end MEASUREMENT
/begin MEASUREMENT Vsx_tra_acel_vld "Transverse acceleration validity status" UBYTE _CNV_S_3_STATUS_OK__120_CM 1 0. 0. 2. ECU_ADDRESS 0xd0004134 /end MEASUREMENT
/begin MEASUREMENT Vxx_tra_acel "Transverse acceleration" SLONG _CNV_A_R_LINEAR_____317_CM 1 0. -12. 13.5 ECU_ADDRESS 0xd0001b1c FORMAT "%8.4" /end MEASUREMENT
/begin CHARACTERISTIC Cbx_tra_acel_cfm "Bit to switch the transversal acceleration source" VALUE 0xa00210c8 _REC_S1VAL_20_u1 1. _CNV_S_2_RANGE______3_CM 0. 1. BIT_MASK 0x1 /end CHARACTERISTIC
/begin MEASUREMENT Vbx_ini_rel_err_fil "Conditions of reinitialisation of the filter on the relative error" UBYTE _CNV_S_2_RANGE______3_CM 1 0. 0. 1. ECU_ADDRESS 0xd000461d BIT_MASK 0x1 /end MEASUREMENT
/begin MEASUREMENT Vbx_mdl_tra_acel_ok "The value of the transverse acceleration is valid" UBYTE _CNV_S_2_RANGE______3_CM 1 0. 0. 1. ECU_ADDRESS 0xd000461e BIT_MASK 0x1 /end MEASUREMENT
/begin MEASUREMENT Vbx_rwhs_ok "Criterion of validity of the  rear wheels speeds" UBYTE _CNV_S_2_RANGE______3_CM 1 0. 0. 1. ECU_ADDRESS 0xd000461f BIT_MASK 0x1 /end MEASUREMENT
/begin MEASUREMENT Vbx_t_end "Flag which indicates that the temporal convergence of the filters is OK" UBYTE _CNV_S_2_RANGE______3_CM 1 0. 0. 1. ECU_ADDRESS 0xd0004620 BIT_MASK 0x1 /end MEASUREMENT
/begin MEASUREMENT Vsx_mdl_tra_acel_vld "Transverse acceleration calculated from rear wheel speed validity status" UBYTE _CNV_S_3_STATUS_OK__120_CM 1 0. 0. 2. ECU_ADDRESS 0xd0004621 /end MEASUREMENT
/begin MEASUREMENT Vxx_abs_tra_acel_mv "Absolut value of the temporal average of the transverse acceleration" UWORD _CNV_A_R_LINEAR_____317_CM 1 0. 0. 13.5 ECU_ADDRESS 0xd0003006 FORMAT "%7.4" /end MEASUREMENT
/begin MEASUREMENT Vxx_diff_rel_err "Difference between relative error of the speeds of rear wheels and the delayed average relative error" SWORD _CNV_A_R_LINEAR_____318_CM 1 0. -0.450002 0.450002 ECU_ADDRESS 0xd0003008 FORMAT "%9.6" /end MEASUREMENT
/begin MEASUREMENT Vxx_mdl_tra_acel "Transverse acceleration calculated from rear wheel speed" SLONG _CNV_A_R_LINEAR_____317_CM 1 0. -12. 13.5 ECU_ADDRESS 0xd00018c4 FORMAT "%8.4" /end MEASUREMENT
/begin MEASUREMENT Vxx_mdl_tra_acel_clc "Transversal acceleration calculated from rear wheel speed" SLONG _CNV_A_R_LINEAR_____317_CM 1 0. -12. 13.5 ECU_ADDRESS 0xd00018c8 FORMAT "%8.4" /end MEASUREMENT
/begin MEASUREMENT Vxx_rel_err "Relative error of the speeds of rear wheels" SWORD _CNV_A_R_LINEAR_____318_CM 1 0. -0.450002 0.450002 ECU_ADDRESS 0xd000300a FORMAT "%9.6" /end MEASUREMENT
/begin MEASUREMENT Vxx_rel_err_mv "Relative error of the radiuses of rear wheels" SWORD _CNV_A_R_LINEAR_____318_CM 1 0. -0.450002 0.450002 ECU_ADDRESS 0xd000300c FORMAT "%9.6" /end MEASUREMENT
/begin MEASUREMENT Vxx_rel_err_mv_dly "Rel_error_avg value delayed from one sample time" SWORD _CNV_A_R_LINEAR_____318_CM 1 0. -0.450002 0.450002 ECU_ADDRESS 0xd000300e FORMAT "%9.6" /end MEASUREMENT
/begin MEASUREMENT Vxx_rwhs_diff "Difference between the speeds of rear wheels" SWORD _CNV_A_R_LINEAR_____319_CM 1 0. -32.768 32.767 ECU_ADDRESS 0xd0003010 FORMAT "%7.3" /end MEASUREMENT
/begin MEASUREMENT Vxx_rwhs_sum "Sum of the speeds of rear wheels" UWORD _CNV_A_R_LINEAR_____320_CM 1 0. 0. 655.35 ECU_ADDRESS 0xd0003012 FORMAT "%6.2" /end MEASUREMENT
/begin MEASUREMENT Vxx_t_wait_tra_acel_vld "Timer to wait the convergence of the filters" UBYTE _CNV_A_R_LINEAR_____321_CM 1 0. 0. 5.1 ECU_ADDRESS 0xd0004622 FORMAT "%4.2" /end MEASUREMENT
/begin MEASUREMENT Vxx_tra_acel_mv "Temporal average of the transverse acceleration" SLONG _CNV_A_R_LINEAR_____317_CM 1 0. -12. 13.5 ECU_ADDRESS 0xd00018cc FORMAT "%8.4" /end MEASUREMENT
/begin CHARACTERISTIC Cxx_h_thd_tra_acel_ok "High threshold of Abs_gt_avg to validate the information of the transverse acceleration" VALUE 0xa0021724 _REC_S1VAL_20_u2 13.5 _CNV_A_R_LINEAR_____317_CM 0. 13.5 FORMAT "%7.4" /end CHARACTERISTIC
/begin CHARACTERISTIC Cxx_l_thd_tra_acel_ok "Low threshold of Abs_gt_avg to validate the information of the transverse acceleration" VALUE 0xa0021726 _REC_S1VAL_20_u2 13.5 _CNV_A_R_LINEAR_____317_CM 0. 13.5 FORMAT "%7.4" /end CHARACTERISTIC
/begin CHARACTERISTIC Cxx_rel_err_fil "Time constant of the first order filter on the relative error" VALUE 0xa002172a _REC_S1VAL_20_u1 2550. _CNV_A_R_LINEAR_____322_CM 0. 2550. FORMAT "%4.0" /end CHARACTERISTIC
/begin CHARACTERISTIC Cxx_rel_err_thd_max "Maximal error of detection to avoid the errors due to the bends" VALUE 0xa0021728 _REC_S1VAL_20_u2 0.450002 _CNV_A_R_LINEAR_____323_CM 0. 0.450002 FORMAT "%8.6" /end CHARACTERISTIC
/begin CHARACTERISTIC Cxx_rwhb "Rear wheelbase" VALUE 0xa002172b _REC_S1VAL_20_u1 2.55 _CNV_A_R_LINEAR_____324_CM 0.5 3.05 FORMAT "%4.2" /end CHARACTERISTIC
/begin CHARACTERISTIC Cxx_rwhs_fil "Time constant of the first order filter of the rear wheels speed" VALUE 0xa002172c _REC_S1VAL_20_u1 5.1 _CNV_A_R_LINEAR_____321_CM 0. 5.1 FORMAT "%4.2" /end CHARACTERISTIC
/begin CHARACTERISTIC Cxx_rwhs_max_tra_acel "Threshold of maximum rear wheel speed to calculate the transverse acceleration" VALUE 0xa002172d _REC_S1VAL_20_u1 255. _CNV_A_R_LINEAR_____325_CM 5. 260. FORMAT "%3.0" /end CHARACTERISTIC
/begin CHARACTERISTIC Cxx_rwhs_min_tra_acel "Threshold of minimum rear wheel speed to calculate the transverse acceleration" VALUE 0xa002172e _REC_S1VAL_20_u1 255. _CNV_A_R_LINEAR_____325_CM 5. 260. FORMAT "%3.0" /end CHARACTERISTIC
/begin CHARACTERISTIC Cxx_tra_acel_mv_fil "Time constant of the first order filter on the average of the transverse acceleration" VALUE 0xa002172f _REC_S1VAL_20_u1 255. _CNV_A_R_LINEAR_____82_CM 0. 255. FORMAT "%3.0" /end CHARACTERISTIC
/begin CHARACTERISTIC Cxx_wait_tra_acel_vld "Temporization before to calculate the validity of the transverse acceleration" VALUE 0xa0021730 _REC_S1VAL_20_u1 25.5 _CNV_A_R_LINEAR_____4_CM 0. 25.5 FORMAT "%4.1" /end CHARACTERISTIC
/begin MEASUREMENT Vxx_crsh_det "" UBYTE _CNV_A_R_ECME_LINEA_0_CM 1 0. 0. 255. DISPLAY_IDENTIFIER VfEstMng_NVM.Vxx_crsh_det_NVM ECU_ADDRESS 0xd0004b40 FORMAT "%3.0" /end MEASUREMENT
/begin MEASUREMENT Vxx_crsh_mem "" UBYTE _CNV_A_R_ECME_LINEA_0_CM 1 0. 0. 255. DISPLAY_IDENTIFIER VfEstMng_NVM.Vxx_crsh_mem_NVM ECU_ADDRESS 0xd0004b41 FORMAT "%3.0" /end MEASUREMENT
/begin MEASUREMENT Vbx_crsh_lvl1_det "An airbag crash frame level 1 has been received" UBYTE _CNV_S_2_RANGE______3_CM 1 0. 0. 1. ECU_ADDRESS 0xd0004b47 BIT_MASK 0x1 /end MEASUREMENT
/begin MEASUREMENT Vbx_crsh_lvl2_det "An airbag crash frame level 2 has been received" UBYTE _CNV_S_2_RANGE______3_CM 1 0. 0. 1. ECU_ADDRESS 0xd0004b48 BIT_MASK 0x1 /end MEASUREMENT
/begin MEASUREMENT Vbx_crsh_lvl2_det_fmt "An airbag crash frame level 2 has been received" UBYTE _CNV_S_2_RANGE______3_CM 1 0. 0. 1. ECU_ADDRESS 0xd0004b49 BIT_MASK 0x1 /end MEASUREMENT
/begin MEASUREMENT Vbx_eng_stop_srce_dft "Engine stop origin: other cases" UBYTE _CNV_S_2_RANGE______3_CM 1 0. 0. 1. ECU_ADDRESS 0xd0004b4a BIT_MASK 0x1 /end MEASUREMENT
/begin MEASUREMENT Vbx_eng_stop_srce_norm_driv "Engine stop origin: normal driver request" UBYTE _CNV_S_2_RANGE______3_CM 1 0. 0. 1. ECU_ADDRESS 0xd0004b4b BIT_MASK 0x1 /end MEASUREMENT
/begin MEASUREMENT Vbx_eng_stop_srce_norm_sys "Engine stop origin: normal system request" UBYTE _CNV_S_2_RANGE______3_CM 1 0. 0. 1. ECU_ADDRESS 0xd0004b4c BIT_MASK 0x1 /end MEASUREMENT
/begin MEASUREMENT Vbx_eng_stop_srce_secu "Engine stop origin: emergency request" UBYTE _CNV_S_2_RANGE______3_CM 1 0. 0. 1. ECU_ADDRESS 0xd0004b4d BIT_MASK 0x1 /end MEASUREMENT
/begin MEASUREMENT Vxx_eng_run_ena_airb "Engine running authorisation dependent on airbag function" UBYTE _CNV_A_R_ECME_LINEA_0_CM 1 0. 0. 255. ECU_ADDRESS 0xd0004b42 FORMAT "%3.0" /end MEASUREMENT
/begin MEASUREMENT Vxx_eng_run_ena_ccu "Engine running authorisation dependent on emergency engine stop request" UBYTE _CNV_A_R_ECME_LINEA_0_CM 1 0. 0. 255. ECU_ADDRESS 0xd0004b43 FORMAT "%3.0" /end MEASUREMENT
/begin MEASUREMENT Vxx_eng_run_ena_rgb "Engine running authorisation dependent on robotized gearbox major failure" UBYTE _CNV_A_R_ECME_LINEA_0_CM 1 0. 0. 255. ECU_ADDRESS 0xd0004b44 FORMAT "%3.0" /end MEASUREMENT
/begin MEASUREMENT Vxx_eng_run_ena_ssg "Engine running authorisation dependent on SSG function" UBYTE _CNV_A_R_ECME_LINEA_0_CM 1 0. 0. 255. ECU_ADDRESS 0xd0004b45 FORMAT "%3.0" /end MEASUREMENT
/begin MEASUREMENT Vxx_run_eng_ena "synthesis of engine stop requests" UBYTE _CNV_A_R_ECME_LINEA_0_CM 1 0. 0. 255. ECU_ADDRESS 0xd0004b46 FORMAT "%3.0" /end MEASUREMENT
/begin CHARACTERISTIC Cbx_rest_aftr_crsh_ena "Authorization of restart after a crash" VALUE 0xa002082e _REC_S1VAL_20_u1 1. _CNV_S_2_RANGE______3_CM 0. 1. /end CHARACTERISTIC
/begin CHARACTERISTIC Cxx_eng_stop_req_airb2_lvl1 "Expected value of 2nd byte of received airbag crash frame for crash level 1" VALUE 0xa002082f _REC_S1VAL_20_u1 255. _CNV_A_R_ECME_LINEA_0_CM 0. 255. FORMAT "%3.0" /end CHARACTERISTIC
/begin CHARACTERISTIC Cxx_eng_stop_req_airb2_lvl2 "Expected value of 2nd byte of received airbag crash frame for crash level 2" VALUE 0xa0020830 _REC_S1VAL_20_u1 255. _CNV_A_R_ECME_LINEA_0_CM 0. 255. FORMAT "%3.0" /end CHARACTERISTIC
/begin CHARACTERISTIC Cxx_eng_stop_req_ccu "Coherence checking of the emergency engine stop request" VALUE 0xa0020831 _REC_S1VAL_20_u1 255. _CNV_A_R_ECME_LINEA_0_CM 0. 255. FORMAT "%3.0" /end CHARACTERISTIC
/begin CHARACTERISTIC Cxx_eng_stop_req_rgb "Coherence checking of the robotized gearbox engine stop request" VALUE 0xa0020832 _REC_S1VAL_20_u1 255. _CNV_A_R_ECME_LINEA_0_CM 0. 255. FORMAT "%3.0" /end CHARACTERISTIC
/begin CHARACTERISTIC Cxx_eng_stop_req_ssg "Coherence checking of the SSG engine stop request" VALUE 0xa0020833 _REC_S1VAL_20_u1 255. _CNV_A_R_ECME_LINEA_0_CM 0. 255. FORMAT "%3.0" /end CHARACTERISTIC
/begin CHARACTERISTIC Cxx_rest_aftr_crsh_dly "Time after crash to authorize an engine running" VALUE 0xa002082c _REC_S1VAL_20_u2 655.35 _CNV_A_R_LINEAR_____34_CM 0. 655.35 FORMAT "%6.2" /end CHARACTERISTIC
/begin AXIS_PTS Ctb_map "Maniflod pressure value break points" 0xa00254b0 Vxx_map _REC_A2AXS_20_u2 20000. _CNV_A_R_LINEAR_____57_CM 20 0. 20000. FORMAT "%5.0" /end AXIS_PTS
/begin CHARACTERISTIC Cmp_prs_n_pwm_cp "PWM of the constant rate purge canister" MAP 0xa00254dc _REC_A1MAP_20_u2_u2_u2 100. _CNV_A_R_LINEAR_____122_CM 0. 100. FORMAT "%12.8"
 /begin AXIS_DESCR COM_AXIS Vxx_map _CNV_A_R_LINEAR_____57_CM 20 0. 20000. FORMAT "%5.0" AXIS_PTS_REF Ctb_map /end AXIS_DESCR
 /begin AXIS_DESCR COM_AXIS Vxx_n _CNV_A_R_ENSD_LINEA_24_CM 20 0. 16383.75 FORMAT "%8.2" AXIS_PTS_REF Ctb_n /end AXIS_DESCR
/end CHARACTERISTIC
/begin MEASUREMENT Vbx_cp_clc_cdn "Condition for the calculation event" UBYTE _CNV_S_2_RANGE______3_CM 1 0. 0. 1. ECU_ADDRESS 0xd0004ab4 BIT_MASK 0x1 /end MEASUREMENT
/begin MEASUREMENT Vbx_cp_cmd_frq "Frequency command selection of the canister purge" UBYTE _CNV_S_2_RANGE______3_CM 1 0. 0. 1. ECU_ADDRESS 0xd0005062 BIT_MASK 0x1 /end MEASUREMENT
/begin MEASUREMENT Vxx_cp_pwm "Theoretical PWM allowing to obtain completely a constant rate of the canister purge" UWORD _CNV_A_R_LINEAR_____122_CM 1 0. 0. 100. ECU_ADDRESS 0xd00057ea FORMAT "%12.8" /end MEASUREMENT
/begin MEASUREMENT Vxx_cp_pwm_appl "PWM for the canister purge valve mass air flow" UWORD _CNV_A_R_LINEAR_____122_CM 1 0. 0. 100. ECU_ADDRESS 0xd00057ec FORMAT "%12.8" /end MEASUREMENT
/begin MEASUREMENT Vxx_cp_pwm_cmd "PWM for the canister purge valve mass air flow (PWM size)" UWORD _CNV_A_R_LINEAR_____122_CM 1 0. 0. 100. ECU_ADDRESS 0xd00057ee FORMAT "%12.8" /end MEASUREMENT
/begin MEASUREMENT Vxx_cp_pwm_cor "PWM for the canister purge valve" UWORD _CNV_A_R_LINEAR_____122_CM 1 0. 0. 100. ECU_ADDRESS 0xd00057f0 FORMAT "%12.8" /end MEASUREMENT
/begin MEASUREMENT Vxx_cp_pwm_efv_fac "Real factor of the canister purge rate" UBYTE _CNV_A_R_LINEAR_____118_CM 1 0. 0. 1. ECU_ADDRESS 0xd0005063 FORMAT "%9.7" /end MEASUREMENT
/begin MEASUREMENT Vxx_cp_pwm_fac "Canister purge rate factor" UWORD _CNV_A_R_LINEAR_____93_CM 1 0. 0. 1. ECU_ADDRESS 0xd0003a52 FORMAT "%10.9" /end MEASUREMENT
/begin MEASUREMENT Vxx_cp_pwm_max "Max of objective canister purge rate factor" UBYTE _CNV_A_R_LINEAR_____118_CM 1 0. 0. 1. ECU_ADDRESS 0xd0004ab5 FORMAT "%9.7" /end MEASUREMENT
/begin MEASUREMENT Vxx_cp_pwm_min "PWM for the canister purge valve minimum" UWORD _CNV_A_R_LINEAR_____122_CM 1 0. 0. 100. ECU_ADDRESS 0xd00057f2 FORMAT "%12.8" /end MEASUREMENT
/begin MEASUREMENT Vxx_cp_pwm_sp "Objective canister purge rate factor" UBYTE _CNV_A_R_LINEAR_____118_CM 1 0. 0. 1. ECU_ADDRESS 0xd0004ab6 FORMAT "%9.7" /end MEASUREMENT
/begin MEASUREMENT Vxx_cp_pwm_sp_cor "Objective canister purge rate factor correction" UWORD _CNV_A_R_LINEAR_____93_CM 1 0. 0. 1. ECU_ADDRESS 0xd00057f4 FORMAT "%10.9" /end MEASUREMENT
/begin MEASUREMENT Vxx_cp_pwm_step "Canister purge rate step" UWORD _CNV_A_R_LINEAR_____93_CM 1 0. 0. 1. ECU_ADDRESS 0xd00057f6 FORMAT "%10.9" /end MEASUREMENT
/begin MEASUREMENT Vxx_cp_pwm_step_cor "Canister purge rate step correction" UWORD _CNV_A_R_LINEAR_____122_CM 1 0. 0. 100. ECU_ADDRESS 0xd00057f8 FORMAT "%12.8" /end MEASUREMENT
/begin CHARACTERISTIC Cxx_cp_fac_pwm "Canister purge rate layout" VALUE 0xa0021cd6 _REC_S1VAL_20_u1 0.996078431372549 _CNV_A_R_LINEAR_____118_CM 3.92156862745098e-003 1. FORMAT "%12.8" /end CHARACTERISTIC
/begin CHARACTERISTIC Cxx_cp_flr_min_1 "Nominal value of the opening of the valve minimum slow  frequency beginning " VALUE 0xa0021cbe _REC_S1VAL_20_u2 100. _CNV_A_R_LINEAR_____122_CM 0. 100. FORMAT "%12.8" /end CHARACTERISTIC
/begin CHARACTERISTIC Cxx_cp_flr_min_2 "Nominal value of the opening of the valve minimum fast  frequency beginning " VALUE 0xa0021cc0 _REC_S1VAL_20_u2 100. _CNV_A_R_LINEAR_____122_CM 0. 100. FORMAT "%12.8" /end CHARACTERISTIC
/begin CHARACTERISTIC Cxx_cp_hys_n_frq "Engine hysterisis for the choice of the canister purge frequency command" VALUE 0xa0021cc2 _REC_S1VAL_20_u2 16383.75 _CNV_A_R_ENSD_LINEA_24_CM 0. 16383.75 FORMAT "%8.2" /end CHARACTERISTIC
/begin CHARACTERISTIC Cxx_cp_n_frq "Engine speed threshold for the choice of the canister purge frequency" VALUE 0xa0021cc4 _REC_S1VAL_20_u2 16383.75 _CNV_A_R_ENSD_LINEA_24_CM 0. 16383.75 FORMAT "%8.2" /end CHARACTERISTIC
/begin CHARACTERISTIC Cxx_cp_pwm_cor_max "Maximum value command for the closure of the purge and authorizing the diagnosis" VALUE 0xa0021cc6 _REC_S1VAL_20_u2 100. _CNV_A_R_LINEAR_____122_CM 0. 100. FORMAT "%12.8" /end CHARACTERISTIC
/begin CHARACTERISTIC Cxx_cp_pwm_efv_fac_zero "Division by zero : Real factor of the canister purge rate" VALUE 0xa0021cd7 _REC_S1VAL_20_u1 1. _CNV_A_R_LINEAR_____118_CM 0. 1. FORMAT "%9.7" /end CHARACTERISTIC
/begin CHARACTERISTIC Cxx_cp_pwm_max_1 "Canister purge rate limitation in phase NOMINAL PURGE" VALUE 0xa0021cd8 _REC_S1VAL_20_u1 1. _CNV_A_R_LINEAR_____118_CM 0. 1. FORMAT "%9.7" /end CHARACTERISTIC
/begin CHARACTERISTIC Cxx_cp_pwm_max_2 "Canister purge rate limitation in phase ADAPTATIVE PURGE" VALUE 0xa0021cd9 _REC_S1VAL_20_u1 1. _CNV_A_R_LINEAR_____118_CM 0. 1. FORMAT "%9.7" /end CHARACTERISTIC
/begin CHARACTERISTIC Cxx_cp_pwm_max_3 "Canister purge rate limitation in phase NOMINAL PURGE" VALUE 0xa0021cda _REC_S1VAL_20_u1 1. _CNV_A_R_LINEAR_____118_CM 0. 1. FORMAT "%9.7" /end CHARACTERISTIC
/begin CHARACTERISTIC Cxx_cp_pwm_max_4 "Canister purge rate limitation in phase ADAPTATIVE PURGE" VALUE 0xa0021cdb _REC_S1VAL_20_u1 1. _CNV_A_R_LINEAR_____118_CM 0. 1. FORMAT "%9.7" /end CHARACTERISTIC
/begin CHARACTERISTIC Cxx_cp_pwm_min_1 "Minimum value command for the closure of the purge and authorizing the diagnosis" VALUE 0xa0021cc8 _REC_S1VAL_20_u2 100. _CNV_A_R_LINEAR_____122_CM 0. 100. FORMAT "%12.8" /end CHARACTERISTIC
/begin CHARACTERISTIC Cxx_cp_pwm_min_2 "Minimum value command for the closure of the purge and authorizing the diagnosis" VALUE 0xa0021cca _REC_S1VAL_20_u2 100. _CNV_A_R_LINEAR_____122_CM 0. 100. FORMAT "%12.8" /end CHARACTERISTIC
/begin CHARACTERISTIC Cxx_cp_pwm_sp1 "Canister purge unadaptation set point" VALUE 0xa0021cdc _REC_S1VAL_20_u1 1. _CNV_A_R_LINEAR_____118_CM 0. 1. FORMAT "%9.7" /end CHARACTERISTIC
/begin CHARACTERISTIC Cxx_cp_pwm_sp2 "Canister purge unadaptation set point" VALUE 0xa0021cdd _REC_S1VAL_20_u1 1. _CNV_A_R_LINEAR_____118_CM 0. 1. FORMAT "%9.7" /end CHARACTERISTIC
/begin CHARACTERISTIC Cxx_cp_pwm_sp3 "Canister purge unadaptation set point" VALUE 0xa0021cde _REC_S1VAL_20_u1 1. _CNV_A_R_LINEAR_____118_CM 0. 1. FORMAT "%9.7" /end CHARACTERISTIC
/begin CHARACTERISTIC Cxx_cp_pwm_sp4 "Canister purge unadaptation set point" VALUE 0xa0021cdf _REC_S1VAL_20_u1 1. _CNV_A_R_LINEAR_____118_CM 0. 1. FORMAT "%9.7" /end CHARACTERISTIC
/begin CHARACTERISTIC Cxx_cp_pwm_sp_zero "Division by zero : Objective canister purge rate factor" VALUE 0xa0021ce0 _REC_S1VAL_20_u1 1. _CNV_A_R_LINEAR_____118_CM 0. 1. FORMAT "%9.7" /end CHARACTERISTIC
/begin CHARACTERISTIC Cxx_cp_pwm_step_1 "Canister purge rate step in phase PURGE ADAPTATIVE" VALUE 0xa0021ccc _REC_S1VAL_20_u2 100. _CNV_A_R_LINEAR_____122_CM 0. 100. FORMAT "%12.8" /end CHARACTERISTIC
/begin CHARACTERISTIC Cxx_cp_pwm_step_2 "Canister purge rate step in phase PURGE ADAPTATIVE" VALUE 0xa0021cce _REC_S1VAL_20_u2 100. _CNV_A_R_LINEAR_____122_CM 0. 100. FORMAT "%12.8" /end CHARACTERISTIC
/begin CHARACTERISTIC Cxx_cp_pwm_step_3 "Canister purge rate step in phase PURGE ADAPTATIVE" VALUE 0xa0021cd0 _REC_S1VAL_20_u2 100. _CNV_A_R_LINEAR_____122_CM 0. 100. FORMAT "%12.8" /end CHARACTERISTIC
/begin CHARACTERISTIC Cxx_cp_pwm_step_4 "Canister purge rate step in phase PURGE ADAPTATIVE" VALUE 0xa0021cd2 _REC_S1VAL_20_u2 100. _CNV_A_R_LINEAR_____122_CM 0. 100. FORMAT "%12.8" /end CHARACTERISTIC
/begin CHARACTERISTIC Cxx_cp_pwm_step_5 "Canister purge rate step in case of manager closure" VALUE 0xa0021cd4 _REC_S1VAL_20_u2 100. _CNV_A_R_LINEAR_____122_CM 0. 100. FORMAT "%12.8" /end CHARACTERISTIC
/begin CHARACTERISTIC Ctp_tco_is_l_it_psn "Low throttle position in idle speed ( depending on tco)" CURVE 0xa0022a20 _REC_A1CUR_20_u2_u2 100. _CNV_A_R_LINEAR_____99_CM 0. 100. FORMAT "%6.2"
 /begin AXIS_DESCR COM_AXIS Vxx_tco _CNV_A_R_LINEAR_____54_CM 9 -40. 200. FORMAT "%5.1" AXIS_PTS_REF Ctb_tco2 /end AXIS_DESCR
/end CHARACTERISTIC
/begin MEASUREMENT Vbx_cp_eng_cdn_cl_ena "Engine condition for the close loop purge" UBYTE _CNV_S_2_RANGE______3_CM 1 0. 0. 1. ECU_ADDRESS 0xd00055ed BIT_MASK 0x1 /end MEASUREMENT
/begin MEASUREMENT Vbx_cp_eng_cdn_is_ena "Engine condition for the idle speed canister purge" UBYTE _CNV_S_2_RANGE______3_CM 1 0. 0. 1. ECU_ADDRESS 0xd00055ee BIT_MASK 0x1 /end MEASUREMENT
/begin MEASUREMENT Vbx_cp_eng_cdn_ol_ena "Canister purge condition for the purge set point" UBYTE _CNV_S_2_RANGE______3_CM 1 0. 0. 1. ECU_ADDRESS 0xd00055ef BIT_MASK 0x1 /end MEASUREMENT
/begin MEASUREMENT Vbx_cp_eng_cdn_sp_ena "Engine condition for canister purge purpose" UBYTE _CNV_S_2_RANGE______3_CM 1 0. 0. 1. ECU_ADDRESS 0xd00055f0 BIT_MASK 0x1 /end MEASUREMENT
/begin MEASUREMENT Vbx_cp_fct "Nominal canister purge" UBYTE _CNV_S_2_RANGE______3_CM 1 0. 0. 1. ECU_ADDRESS 0xd0004da2 BIT_MASK 0x1 /end MEASUREMENT
/begin MEASUREMENT Vbx_cp_fct_ad "Adaptive canister purge" UBYTE _CNV_S_2_RANGE______3_CM 1 0. 0. 1. ECU_ADDRESS 0xd0004da3 BIT_MASK 0x1 /end MEASUREMENT
/begin MEASUREMENT Vbx_cp_load_ad "Canister purge load learnt" UBYTE _CNV_S_2_RANGE______3_CM 1 0. 0. 1. ECU_ADDRESS 0xd0004da4 BIT_MASK 0x1 /end MEASUREMENT
/begin MEASUREMENT Vbx_cp_req "Nominal canister purge request" UBYTE _CNV_S_2_RANGE______3_CM 1 0. 0. 1. ECU_ADDRESS 0xd0004da5 BIT_MASK 0x1 /end MEASUREMENT
/begin MEASUREMENT Vbx_cp_req_ad "Adaptive canister purge request" UBYTE _CNV_S_2_RANGE______3_CM 1 0. 0. 1. ECU_ADDRESS 0xd0004da6 BIT_MASK 0x1 /end MEASUREMENT
/begin MEASUREMENT Vbx_cp_stop_ad "Richness closed loop correction is requested to be set to 1" UBYTE _CNV_S_2_RANGE______3_CM 1 0. 0. 1. ECU_ADDRESS 0xd00055f1 BIT_MASK 0x1 /end MEASUREMENT
/begin MEASUREMENT Vbx_l_is_it_psn "Low throttle position in idle speed for PWM computation" UBYTE _CNV_S_2_RANGE______3_CM 1 0. 0. 1. ECU_ADDRESS 0xd00055f2 BIT_MASK 0x1 /end MEASUREMENT
/begin MEASUREMENT Vsx_cp "Canister purge state machine" UBYTE _CNV_S_5_CANISTER_P_326_CM 1 0. 0. 8. ECU_ADDRESS 0xd00055f3 /end MEASUREMENT
/begin MEASUREMENT Vxx_ad_cp_dly "Canister purge delay for the charge learning" UWORD _CNV_A_R_LINEAR_____34_CM 1 0. 0. 655.35 ECU_ADDRESS 0xc0000be2 FORMAT "%6.2" /end MEASUREMENT
/begin MEASUREMENT Vxx_ad_cp_fct_dly "Canister purge delay of the adaptive maximum duration " UWORD _CNV_A_R_LINEAR_____4_CM 1 0. 0. 6553.5 ECU_ADDRESS 0xc0000be4 FORMAT "%6.1" /end MEASUREMENT
/begin MEASUREMENT Vxx_cp_dly "Canister purge delay of the nominal duration " UWORD _CNV_A_R_LINEAR_____34_CM 1 0. 0. 655.35 ECU_ADDRESS 0xc0000be6 FORMAT "%6.2" /end MEASUREMENT
/begin MEASUREMENT Vxx_cp_rtn_dly "Canister purge delay of the maintain in nominal mode" UWORD _CNV_A_R_LINEAR_____34_CM 1 0. 0. 655.35 ECU_ADDRESS 0xc0000be8 FORMAT "%6.2" /end MEASUREMENT
/begin MEASUREMENT Vxx_mv_cl_ti_fac_cp_dly "Canister purge delay for the out of purge mode stabilization" UWORD _CNV_A_R_LINEAR_____34_CM 1 0. 0. 655.35 ECU_ADDRESS 0xc0000bea FORMAT "%6.2" /end MEASUREMENT
/begin CHARACTERISTIC Cxx_cp_ad_tco_min_thd "Minimal water temperature to authorize the end of the surveillance of the canister charge" VALUE 0xa0020958 _REC_S1VAL_20_u2 240. _CNV_A_R_LINEAR_____54_CM -40. 200. FORMAT "%5.1" /end CHARACTERISTIC
/begin CHARACTERISTIC Cxx_cp_ad_thd "Minimum canister charge to authorize the nominal mode" VALUE 0xa002095a _REC_S1VAL_20_u2 1. _CNV_A_R_LINEAR_____93_CM 0. 1. FORMAT "%10.9" /end CHARACTERISTIC
/begin CHARACTERISTIC Cxx_cp_is_tco_min_thd "Minimal water temperature to purge in idle speed (icing)" VALUE 0xa002095c _REC_S1VAL_20_u2 240. _CNV_A_R_LINEAR_____54_CM -40. 200. FORMAT "%5.1" /end CHARACTERISTIC
/begin CHARACTERISTIC Cxx_cp_is_tia_min_thd "Minimal water temperature to purge in idle speed (noise)" VALUE 0xa002095e _REC_S1VAL_20_u2 240. _CNV_A_R_LINEAR_____54_CM -40. 200. FORMAT "%5.1" /end CHARACTERISTIC
/begin CHARACTERISTIC Cxx_cp_max_ad_dly "Maximum delay in adaptive phase" VALUE 0xa0020960 _REC_S1VAL_20_u2 6553.5 _CNV_A_R_LINEAR_____4_CM 0. 6553.5 FORMAT "%6.1" /end CHARACTERISTIC
/begin CHARACTERISTIC Cxx_cp_max_dly "Maximal delay to authorize the nominal mode" VALUE 0xa0020962 _REC_S1VAL_20_u2 655.35 _CNV_A_R_LINEAR_____34_CM 0. 655.35 FORMAT "%6.2" /end CHARACTERISTIC
/begin CHARACTERISTIC Cxx_cp_max_prs_thd "Maximal pressure to learn the canister charge" VALUE 0xa0020964 _REC_S1VAL_20_u2 20000. _CNV_A_R_LINEAR_____57_CM 0. 20000. FORMAT "%5.0" /end CHARACTERISTIC
/begin CHARACTERISTIC Cxx_cp_min_ad_dly "Minimal delay in adaptive phase" VALUE 0xa0020966 _REC_S1VAL_20_u2 655.35 _CNV_A_R_LINEAR_____34_CM 0. 655.35 FORMAT "%6.2" /end CHARACTERISTIC
/begin CHARACTERISTIC Cxx_cp_min_dly "Minimal delay to authorize the nominal mode" VALUE 0xa0020968 _REC_S1VAL_20_u2 655.35 _CNV_A_R_LINEAR_____34_CM 0. 655.35 FORMAT "%6.2" /end CHARACTERISTIC
/begin CHARACTERISTIC Cxx_cp_n_thd "Minimal speed engine to purge in case of a throttle failure" VALUE 0xa002096a _REC_S1VAL_20_u2 16383.75 _CNV_A_R_ENSD_LINEA_24_CM 0. 16383.75 FORMAT "%8.2" /end CHARACTERISTIC
/begin CHARACTERISTIC Cxx_cp_ol_tco_min_thd "Water temperature under wich the purge before the closed loop is authorized" VALUE 0xa002096c _REC_S1VAL_20_u2 240. _CNV_A_R_LINEAR_____54_CM -40. 200. FORMAT "%5.1" /end CHARACTERISTIC
/begin CHARACTERISTIC Cxx_cp_rtn_dly_dec "Delay in out of purge mode" VALUE 0xa002096e _REC_S1VAL_20_u2 655.35 _CNV_A_R_LINEAR_____34_CM 0. 655.35 FORMAT "%6.2" /end CHARACTERISTIC
/begin CHARACTERISTIC Cxx_cp_stab_dly "Delay for the out of purge mode" VALUE 0xa0020970 _REC_S1VAL_20_u2 655.35 _CNV_A_R_LINEAR_____34_CM 0. 655.35 FORMAT "%6.2" /end CHARACTERISTIC
/begin CHARACTERISTIC Cxx_cp_tco_min_thd "Minimal water temperature to purge (noise)" VALUE 0xa0020972 _REC_S1VAL_20_u2 240. _CNV_A_R_LINEAR_____54_CM -40. 200. FORMAT "%5.1" /end CHARACTERISTIC
/begin CHARACTERISTIC Cxx_cp_tia_min_thd "Minimal water temperature to purge (icing)" VALUE 0xa0020974 _REC_S1VAL_20_u2 240. _CNV_A_R_LINEAR_____54_CM -40. 200. FORMAT "%5.1" /end CHARACTERISTIC
/begin MEASUREMENT Vbx_boost_td "Boolean indicating we enable \"to boost\" dwell" UBYTE _CNV_S_2_RANGE______3_CM 1 0. 0. 1. ECU_ADDRESS 0xd0004aae BIT_MASK 0x1 /end MEASUREMENT
/begin MEASUREMENT Vbx_igc_stt_ena "Start dwell boost authorization" UBYTE _CNV_S_2_RANGE______3_CM 1 0. 0. 1. ECU_ADDRESS 0xd0004aaf BIT_MASK 0x1 /end MEASUREMENT
/begin MEASUREMENT Vbx_trs_td "Boolean indicating that transition counter is not ended" UBYTE _CNV_S_2_RANGE______3_CM 1 0. 0. 1. ECU_ADDRESS 0xd0004ab0 BIT_MASK 0x1 /end MEASUREMENT
/begin MEASUREMENT Vxx_ctr_tdc_aftr_trs "Counter after transition." UBYTE _CNV_A_R_ECME_LINEA_0_CM 1 0. 0. 255. ECU_ADDRESS 0xd0004ab1 FORMAT "%3.0" /end MEASUREMENT
/begin MEASUREMENT Vxx_igc_stt_td "Counter of the start dwell boost mode" UWORD _CNV_A_R_LINEAR_____136_CM 1 0. 0. 655.35 ECU_ADDRESS 0xd0002d3a FORMAT "%6.2" /end MEASUREMENT
/begin MEASUREMENT Vxx_td_stab_min "Counter for minimum duration not to authorize \"to boost\" dwell (after transition mode)" UWORD _CNV_A_R_LINEAR_____34_CM 1 0. 0. 655.35 ECU_ADDRESS 0xd0002d3c FORMAT "%6.2" /end MEASUREMENT
/begin MEASUREMENT Vxx_td_tra_max "Counter for maximum duration to authorize \"to boost\" dwell (in transition mode)" UWORD _CNV_A_R_LINEAR_____34_CM 1 0. 0. 655.35 ECU_ADDRESS 0xd0002d3e FORMAT "%6.2" /end MEASUREMENT
/begin CHARACTERISTIC Cxx_igc_stt_dly "Start boost delay" VALUE 0xa0021c82 _REC_S1VAL_20_u2 655.35 _CNV_A_R_LINEAR_____34_CM 0. 655.35 FORMAT "%6.2" /end CHARACTERISTIC
/begin CHARACTERISTIC Cxx_igc_stt_tco_thd "Threshold above which start boost is inhibited" VALUE 0xa0021c84 _REC_S1VAL_20_u2 240. _CNV_A_R_LINEAR_____54_CM -40. 200. FORMAT "%5.1" /end CHARACTERISTIC
/begin CHARACTERISTIC Cxx_pap_dwl "Minimum throttle threshold to switch on map" VALUE 0xa0021c86 _REC_S1VAL_20_u2 100. _CNV_A_R_LINEAR_____99_CM 0. 100. FORMAT "%6.2" /end CHARACTERISTIC
/begin CHARACTERISTIC Cxx_td_stab_min "Minimum duration not to authorize \"to boost\" dwell (after transition mode)" VALUE 0xa0021c88 _REC_S1VAL_20_u2 655.35 _CNV_A_R_LINEAR_____34_CM 0. 655.35 FORMAT "%6.2" /end CHARACTERISTIC
/begin CHARACTERISTIC Cxx_td_tra_auth_max "Maximum duration to authorize \"to boost\" dwell (in transition mode)" VALUE 0xa0021c8a _REC_S1VAL_20_u2 655.35 _CNV_A_R_LINEAR_____34_CM 0. 655.35 FORMAT "%6.2" /end CHARACTERISTIC
/begin CHARACTERISTIC Cxx_tra_dwl "Number of TDC to apply map values in transition mode" VALUE 0xa0021c8c _REC_S1VAL_20_u1 255. _CNV_A_R_LINEAR_____55_CM 0. 255. FORMAT "%3.0" /end CHARACTERISTIC
/begin MEASUREMENT Vbx_ign_cut_cyl1 "No ignition command of cylinder 1" UBYTE _CNV_S_2_RANGE______3_CM 1 0. 0. 1. ECU_ADDRESS 0xd0003f2d BIT_MASK 0x1 /end MEASUREMENT
/begin MEASUREMENT Vbx_ign_cut_cyl2 "No ignition command of cylinder 2" UBYTE _CNV_S_2_RANGE______3_CM 1 0. 0. 1. ECU_ADDRESS 0xd0003f2e BIT_MASK 0x1 /end MEASUREMENT
/begin MEASUREMENT Vbx_ign_cut_cyl3 "No ignition command of cylinder 3" UBYTE _CNV_S_2_RANGE______3_CM 1 0. 0. 1. ECU_ADDRESS 0xd0003f2f BIT_MASK 0x1 /end MEASUREMENT
/begin MEASUREMENT Vbx_ign_cut_cyl4 "No ignition command of cylinder 4" UBYTE _CNV_S_2_RANGE______3_CM 1 0. 0. 1. ECU_ADDRESS 0xd0003f30 BIT_MASK 0x1 /end MEASUREMENT
/begin MEASUREMENT Vbx_mis_bch_cyl_0 "Current Ignition for Vxx_tdc_ctr = 0" UBYTE _CNV_S_2_RANGE______3_CM 1 0. 0. 1. ECU_ADDRESS 0xd0003f31 BIT_MASK 0x1 /end MEASUREMENT
/begin MEASUREMENT Vbx_mis_bch_cyl_1 "Current Ignition for Vxx_tdc_ctr = 1" UBYTE _CNV_S_2_RANGE______3_CM 1 0. 0. 1. ECU_ADDRESS 0xd0003f32 BIT_MASK 0x1 /end MEASUREMENT
/begin MEASUREMENT Vbx_mis_bch_cyl_2 "Current Ignition for Vxx_tdc_ctr = 2" UBYTE _CNV_S_2_RANGE______3_CM 1 0. 0. 1. ECU_ADDRESS 0xd0003f33 BIT_MASK 0x1 /end MEASUREMENT
/begin MEASUREMENT Vbx_mis_bch_cyl_3 "Current Ignition for Vxx_tdc_ctr = 3" UBYTE _CNV_S_2_RANGE______3_CM 1 0. 0. 1. ECU_ADDRESS 0xd0003f34 BIT_MASK 0x1 /end MEASUREMENT
/begin MEASUREMENT Vbx_mis_bch_igc_cut_req "No ignition request" UBYTE _CNV_S_2_RANGE______3_CM 1 0. 0. 1. ECU_ADDRESS 0xd0003f35 BIT_MASK 0x1 /end MEASUREMENT
/begin CHARACTERISTIC Cbx_mis_bch_mod "Misfire bench mode activation boolean" VALUE 0xa0020e3a _REC_S1VAL_20_u1 1. _CNV_A_R_ECME_LINEA_0_CM 0. 1. FORMAT "%1.0" BIT_MASK 0x1 /end CHARACTERISTIC
/begin CHARACTERISTIC Cxx_mis_bch_mis_rat "Misfire bench mode : rate of misfire" VALUE 0xa0020e3b _REC_S1VAL_20_u1 255. _CNV_A_R_ECME_LINEA_0_CM 0. 255. FORMAT "%3.0" /end CHARACTERISTIC
/begin MEASUREMENT Vsx_igc1_vld "Ignition coil 1 validity status." UBYTE _CNV_A_R_ECME_LINEA_0_CM 1 0. 0. 1. ECU_ADDRESS 0xd0004767 FORMAT "%1.0" /end MEASUREMENT
/begin MEASUREMENT Vsx_igc2_vld "Ignition coil 2 validity status." UBYTE _CNV_A_R_ECME_LINEA_0_CM 1 0. 0. 1. ECU_ADDRESS 0xd0004768 FORMAT "%1.0" /end MEASUREMENT
/begin MEASUREMENT Vsx_igc3_vld "Ignition coil 3 validity status." UBYTE _CNV_A_R_ECME_LINEA_0_CM 1 0. 0. 1. ECU_ADDRESS 0xd0004769 FORMAT "%1.0" /end MEASUREMENT
/begin MEASUREMENT Vsx_igc4_vld "Ignition coil 4 validity status." UBYTE _CNV_A_R_ECME_LINEA_0_CM 1 0. 0. 1. ECU_ADDRESS 0xd000476a FORMAT "%1.0" /end MEASUREMENT
/begin MEASUREMENT Vsx_igc_vld "Ignition coils validity status." UBYTE _CNV_A_R_ECME_LINEA_0_CM 1 0. 0. 1. ECU_ADDRESS 0xd000476b FORMAT "%1.0" /end MEASUREMENT
/begin CHARACTERISTIC Cxx_dfdec_igc_1_oc "Open Circuit of ignition coil 1 detected failure counter decrement." VALUE 0xa00218d2 _REC_S1VAL_20_u2 65535. _CNV_A_R_ECME_LINEA_0_CM 0. 65535. FORMAT "%5.0" /end CHARACTERISTIC
/begin CHARACTERISTIC Cxx_dfdec_igc_1_scg "Short Circuit to Ground of ignition coil 1 detected failure counter decrement." VALUE 0xa00218d4 _REC_S1VAL_20_u2 65535. _CNV_A_R_ECME_LINEA_0_CM 0. 65535. FORMAT "%5.0" /end CHARACTERISTIC
/begin CHARACTERISTIC Cxx_dfdec_igc_1_scw "Short Circuit to Battery of ignition coil 1 detected failure counter decrement." VALUE 0xa00218d6 _REC_S1VAL_20_u2 65535. _CNV_A_R_ECME_LINEA_0_CM 0. 65535. FORMAT "%5.0" /end CHARACTERISTIC
/begin CHARACTERISTIC Cxx_dfdec_igc_2_oc "Open Circuit of ignition coil 2 detected failure counter decrement." VALUE 0xa00218d8 _REC_S1VAL_20_u2 65535. _CNV_A_R_ECME_LINEA_0_CM 0. 65535. FORMAT "%5.0" /end CHARACTERISTIC
/begin CHARACTERISTIC Cxx_dfdec_igc_2_scg "Short Circuit to Ground of ignition coil 2 detected failure counter decrement." VALUE 0xa00218da _REC_S1VAL_20_u2 65535. _CNV_A_R_ECME_LINEA_0_CM 0. 65535. FORMAT "%5.0" /end CHARACTERISTIC
/begin CHARACTERISTIC Cxx_dfdec_igc_2_scw "Short Circuit to Battery of ignition coil 2 detected failure counter decrement." VALUE 0xa00218dc _REC_S1VAL_20_u2 65535. _CNV_A_R_ECME_LINEA_0_CM 0. 65535. FORMAT "%5.0" /end CHARACTERISTIC
/begin CHARACTERISTIC Cxx_dfdec_igc_3_oc "Open Circuit of ignition coil 3 detected failure counter decrement." VALUE 0xa00218de _REC_S1VAL_20_u2 65535. _CNV_A_R_ECME_LINEA_0_CM 0. 65535. FORMAT "%5.0" /end CHARACTERISTIC
/begin CHARACTERISTIC Cxx_dfdec_igc_3_scg "Short Circuit to Ground of ignition coil 3 detected failure counter decrement." VALUE 0xa00218e0 _REC_S1VAL_20_u2 65535. _CNV_A_R_ECME_LINEA_0_CM 0. 65535. FORMAT "%5.0" /end CHARACTERISTIC
/begin CHARACTERISTIC Cxx_dfdec_igc_3_scw "Short Circuit to Battery of ignition coil 3 detected failure counter decrement." VALUE 0xa00218e2 _REC_S1VAL_20_u2 65535. _CNV_A_R_ECME_LINEA_0_CM 0. 65535. FORMAT "%5.0" /end CHARACTERISTIC
/begin CHARACTERISTIC Cxx_dfdec_igc_4_oc "Open Circuit of ignition coil 4 detected failure counter decrement." VALUE 0xa00218e4 _REC_S1VAL_20_u2 65535. _CNV_A_R_ECME_LINEA_0_CM 0. 65535. FORMAT "%5.0" /end CHARACTERISTIC
/begin CHARACTERISTIC Cxx_dfdec_igc_4_scg "Short Circuit to Ground of ignition coil 4 detected failure counter decrement." VALUE 0xa00218e6 _REC_S1VAL_20_u2 65535. _CNV_A_R_ECME_LINEA_0_CM 0. 65535. FORMAT "%5.0" /end CHARACTERISTIC
/begin CHARACTERISTIC Cxx_dfdec_igc_4_scw "Short Circuit to Battery of ignition coil 4 detected failure counter decrement." VALUE 0xa00218e8 _REC_S1VAL_20_u2 65535. _CNV_A_R_ECME_LINEA_0_CM 0. 65535. FORMAT "%5.0" /end CHARACTERISTIC
/begin CHARACTERISTIC Cxx_dfinc_igc_1_oc "Open Circuit of ignition coil 1 detected failure counter increment." VALUE 0xa00218ea _REC_S1VAL_20_u2 65535. _CNV_A_R_ECME_LINEA_0_CM 0. 65535. FORMAT "%5.0" /end CHARACTERISTIC
/begin CHARACTERISTIC Cxx_dfinc_igc_1_scg "Short Circuit to Ground of ignition coil 1 detected failure counter increment." VALUE 0xa00218ec _REC_S1VAL_20_u2 65535. _CNV_A_R_ECME_LINEA_0_CM 0. 65535. FORMAT "%5.0" /end CHARACTERISTIC
/begin CHARACTERISTIC Cxx_dfinc_igc_1_scw "Short Circuit to Battery of ignition coil 1 detected failure counter increment." VALUE 0xa00218ee _REC_S1VAL_20_u2 65535. _CNV_A_R_ECME_LINEA_0_CM 0. 65535. FORMAT "%5.0" /end CHARACTERISTIC
/begin CHARACTERISTIC Cxx_dfinc_igc_2_oc "Open Circuit of ignition coil 2 detected failure counter increment." VALUE 0xa00218f0 _REC_S1VAL_20_u2 65535. _CNV_A_R_ECME_LINEA_0_CM 0. 65535. FORMAT "%5.0" /end CHARACTERISTIC
/begin CHARACTERISTIC Cxx_dfinc_igc_2_scg "Short Circuit to Ground of ignition coil 2 detected failure counter increment." VALUE 0xa00218f2 _REC_S1VAL_20_u2 65535. _CNV_A_R_ECME_LINEA_0_CM 0. 65535. FORMAT "%5.0" /end CHARACTERISTIC
/begin CHARACTERISTIC Cxx_dfinc_igc_2_scw "Short Circuit to Battery of ignition coil 2 detected failure counter increment." VALUE 0xa00218f4 _REC_S1VAL_20_u2 65535. _CNV_A_R_ECME_LINEA_0_CM 0. 65535. FORMAT "%5.0" /end CHARACTERISTIC
/begin CHARACTERISTIC Cxx_dfinc_igc_3_oc "Open Circuit of ignition coil 3 detected failure counter increment." VALUE 0xa00218f6 _REC_S1VAL_20_u2 65535. _CNV_A_R_ECME_LINEA_0_CM 0. 65535. FORMAT "%5.0" /end CHARACTERISTIC
/begin CHARACTERISTIC Cxx_dfinc_igc_3_scg "Short Circuit to Ground of ignition coil 3 detected failure counter increment." VALUE 0xa00218f8 _REC_S1VAL_20_u2 65535. _CNV_A_R_ECME_LINEA_0_CM 0. 65535. FORMAT "%5.0" /end CHARACTERISTIC
/begin CHARACTERISTIC Cxx_dfinc_igc_3_scw "Short Circuit to Battery of ignition coil 3 detected failure counter increment." VALUE 0xa00218fa _REC_S1VAL_20_u2 65535. _CNV_A_R_ECME_LINEA_0_CM 0. 65535. FORMAT "%5.0" /end CHARACTERISTIC
/begin CHARACTERISTIC Cxx_dfinc_igc_4_oc "Open Circuit of ignition coil 4 detected failure counter increment." VALUE 0xa00218fc _REC_S1VAL_20_u2 65535. _CNV_A_R_ECME_LINEA_0_CM 0. 65535. FORMAT "%5.0" /end CHARACTERISTIC
/begin CHARACTERISTIC Cxx_dfinc_igc_4_scg "Short Circuit to Ground of ignition coil 4 detected failure counter increment." VALUE 0xa00218fe _REC_S1VAL_20_u2 65535. _CNV_A_R_ECME_LINEA_0_CM 0. 65535. FORMAT "%5.0" /end CHARACTERISTIC
/begin CHARACTERISTIC Cxx_dfinc_igc_4_scw "Short Circuit to Battery of ignition coil 4 detected failure counter increment." VALUE 0xa0021900 _REC_S1VAL_20_u2 65535. _CNV_A_R_ECME_LINEA_0_CM 0. 65535. FORMAT "%5.0" /end CHARACTERISTIC
/begin MEASUREMENT Vbx_ac_mdf1_req_int "Fan 1 activation request from cold loop" UBYTE _CNV_S_2_RANGE______3_CM 1 0. 0. 1. ECU_ADDRESS 0xd00045fa BIT_MASK 0x1 /end MEASUREMENT
/begin MEASUREMENT Vbx_ac_mdf2_req_int "Fan 2 activation request from cold loop" UBYTE _CNV_S_2_RANGE______3_CM 1 0. 0. 1. ECU_ADDRESS 0xd00045fb BIT_MASK 0x1 /end MEASUREMENT
/begin MEASUREMENT Vxx_ac_prs_lvl "Climate pressure area" UBYTE _CNV_A_R_ECME_LINEA_0_CM 1 0. 0. 255. ECU_ADDRESS 0xd00045fc FORMAT "%3.0" /end MEASUREMENT
/begin CHARACTERISTIC Cxx_ac_mdf_prs_hys "AC pressure hysteresis for fans activation" VALUE 0xa00216e0 _REC_S1VAL_20_u2 6553.5 _CNV_A_R_LINEAR_____306_CM 0. 6553.5 FORMAT "%6.1" /end CHARACTERISTIC
/begin CHARACTERISTIC Cxx_ac_mdf_prs_thd1 "AC pressure threshold n∞ 1 for fans activation" VALUE 0xa00216e2 _REC_S1VAL_20_u2 6553.5 _CNV_A_R_LINEAR_____306_CM 0. 6553.5 FORMAT "%6.1" /end CHARACTERISTIC
/begin CHARACTERISTIC Cxx_ac_mdf_prs_thd2 "AC pressure threshold n∞ 2 for fans activation" VALUE 0xa00216e4 _REC_S1VAL_20_u2 6553.5 _CNV_A_R_LINEAR_____306_CM 0. 6553.5 FORMAT "%6.1" /end CHARACTERISTIC
/begin CHARACTERISTIC Cxx_ac_mdf_prs_thd3 "AC pressure threshold n∞ 3 for fans activation" VALUE 0xa00216e6 _REC_S1VAL_20_u2 6553.5 _CNV_A_R_LINEAR_____306_CM 0. 6553.5 FORMAT "%6.1" /end CHARACTERISTIC
/begin CHARACTERISTIC Cxx_ac_mdf_secu_prs_hys "Security AC pressure hysteresis for fans activation when there is no ac presnce" VALUE 0xa00216e8 _REC_S1VAL_20_u2 6553.5 _CNV_A_R_LINEAR_____306_CM 0. 6553.5 FORMAT "%6.1" /end CHARACTERISTIC
/begin CHARACTERISTIC Cxx_ac_mdf_secu_prs_thd "Security AC pressure threshold for fans activation when there is no ac request" VALUE 0xa00216ea _REC_S1VAL_20_u2 6553.5 _CNV_A_R_LINEAR_____306_CM 0. 6553.5 FORMAT "%6.1" /end CHARACTERISTIC
/begin CHARACTERISTIC Cxx_ac_mdf_vs_hys "Vehicle speed hysteresis for fans activation" VALUE 0xa00216ec _REC_S1VAL_20_u1 255. _CNV_A_R_LINEAR_____212_CM 0. 255. FORMAT "%3.0" /end CHARACTERISTIC
/begin CHARACTERISTIC Cxx_ac_mdf_vs_thd1 "Vehicle speed threshold n∞ 1 for fans activation" VALUE 0xa00216ed _REC_S1VAL_20_u1 255. _CNV_A_R_LINEAR_____212_CM 0. 255. FORMAT "%3.0" /end CHARACTERISTIC
/begin CHARACTERISTIC Cxx_ac_mdf_vs_thd2 "Vehicle speed threshold n∞ 2 for fans activation" VALUE 0xa00216ee _REC_S1VAL_20_u1 255. _CNV_A_R_LINEAR_____212_CM 0. 255. FORMAT "%3.0" /end CHARACTERISTIC
/begin CHARACTERISTIC Cxx_ac_mdf_vs_thd3 "Vehicle speed threshold n∞ 3 for fans activation" VALUE 0xa00216ef _REC_S1VAL_20_u1 255. _CNV_A_R_LINEAR_____212_CM 0. 255. FORMAT "%3.0" /end CHARACTERISTIC
/begin CHARACTERISTIC Cxx_ac_mdf_vs_thd4 "Vehicle speed threshold n∞ 4 for fans activation" VALUE 0xa00216f0 _REC_S1VAL_20_u1 255. _CNV_A_R_LINEAR_____212_CM 0. 255. FORMAT "%3.0" /end CHARACTERISTIC
/begin MEASUREMENT Vbx_ac_clu_dsb "Air conditioning compressor clutching interdiction" UBYTE _CNV_S_2_RANGE______3_CM 1 0. 0. 1. ECU_ADDRESS 0xd0004871 BIT_MASK 0x1 /end MEASUREMENT
/begin MEASUREMENT Vbx_ac_clu_ena "AC compressor clutching order" UBYTE _CNV_S_2_RANGE______3_CM 1 0. 0. 1. ECU_ADDRESS 0xd0004872 BIT_MASK 0x1 /end MEASUREMENT
/begin MEASUREMENT Vbx_ac_dclu_dsb "Air conditioning compressor declutching interdiction" UBYTE _CNV_S_2_RANGE______3_CM 1 0. 0. 1. ECU_ADDRESS 0xd0004873 BIT_MASK 0x1 /end MEASUREMENT
/begin MEASUREMENT Vbx_ac_dsb "Immediate AC compressor inhibition" UBYTE _CNV_S_2_RANGE______3_CM 1 0. 0. 1. ECU_ADDRESS 0xd0004874 BIT_MASK 0x1 /end MEASUREMENT
/begin MEASUREMENT Vsx_ac_cmd "Air conditioning compressor command" UBYTE _CNV_A_R_ECME_LINEA_0_CM 1 0. 0. 4. ECU_ADDRESS 0xd0004875 FORMAT "%1.0" /end MEASUREMENT
/begin MEASUREMENT Vsx_acr_stt "AC compressor management phases" UBYTE _CNV_A_R_ECME_LINEA_0_CM 1 0. 0. 255. ECU_ADDRESS 0xd0004876 FORMAT "%3.0" /end MEASUREMENT
/begin MEASUREMENT Vxx_ac_cmd_dly "Air conditioning compressor command timer" UBYTE _CNV_A_R_LINEAR_____34_CM 1 0. 0. 2.55 ECU_ADDRESS 0xd0004877 FORMAT "%4.2" /end MEASUREMENT
/begin MEASUREMENT Vxx_ac_stt_dly "Air conditioning compressor state timer" UBYTE _CNV_A_R_LINEAR_____34_CM 1 0. 0. 2.55 ECU_ADDRESS 0xd0004878 FORMAT "%4.2" /end MEASUREMENT
/begin CHARACTERISTIC Cxx_ac_bfr_clu_dly "Air conditioning compressor before clutching state delay" VALUE 0xa0021d31 _REC_S1VAL_20_u1 2.55 _CNV_A_R_LINEAR_____34_CM 0. 2.55 FORMAT "%4.2" /end CHARACTERISTIC
/begin CHARACTERISTIC Cxx_ac_clu_dly "Air conditioning compressor clutching delay" VALUE 0xa0021d32 _REC_S1VAL_20_u1 2.55 _CNV_A_R_LINEAR_____34_CM 0. 2.55 FORMAT "%4.2" /end CHARACTERISTIC
/begin CHARACTERISTIC Cxx_ac_dclu_dly "Air conditioning compressor declutching delay" VALUE 0xa0021d33 _REC_S1VAL_20_u1 2.55 _CNV_A_R_LINEAR_____34_CM 0. 2.55 FORMAT "%4.2" /end CHARACTERISTIC
/begin CHARACTERISTIC Cxx_ac_ext_clu_dly "Air conditioning compressor external clutching delay (USM delay)" VALUE 0xa0021d34 _REC_S1VAL_20_u1 2.55 _CNV_A_R_LINEAR_____34_CM 0. 2.55 FORMAT "%4.2" /end CHARACTERISTIC
/begin CHARACTERISTIC Cxx_ac_ext_dclu_dly "Air conditioning compressor external declutching delay (USM delay)" VALUE 0xa0021d35 _REC_S1VAL_20_u1 2.55 _CNV_A_R_LINEAR_____34_CM 0. 2.55 FORMAT "%4.2" /end CHARACTERISTIC
/begin CHARACTERISTIC Cxx_ac_rly_prot_dly "Minimum duration in clutched state for relay protection" VALUE 0xa0021d36 _REC_S1VAL_20_u1 2.55 _CNV_A_R_LINEAR_____34_CM 0. 2.55 FORMAT "%4.2" /end CHARACTERISTIC
/begin AXIS_PTS Ntb_gear "Gearbox ratio breakpoint" 0xa002ac48 Vxx_gear _REC_A2AXS_20_u1 7. _CNV_A_R_LINEAR_____113_CM 8 -1. 6. READ_ONLY FORMAT "%2.0" /end AXIS_PTS
/begin CHARACTERISTIC Ctp_tco_lbup_hot_dly_alco "Number of TDC before applying the heater power for alcool application" CURVE 0xa002823c _REC_A1CUR_20_u2_u2 65535. _CNV_A_R_LINEAR_____55_CM 0. 65535. FORMAT "%5.0"
 /begin AXIS_DESCR COM_AXIS Vxx_tco _CNV_A_R_LINEAR_____54_CM 13 -40. 200. FORMAT "%5.1" AXIS_PTS_REF Ctb_tco_lbup_hot_dly /end AXIS_DESCR
/end CHARACTERISTIC
/begin MEASUREMENT Vxx_lbup_hot_dly_ctr_alco "TDC calibration value for dewpoint detection for alcool applications" UWORD _CNV_A_R_LINEAR_____55_CM 1 0. 0. 65535. ECU_ADDRESS 0xd0002d46 FORMAT "%5.0" /end MEASUREMENT
/begin MEASUREMENT Vbx_rgb_pump "Robotized gearbox pump activation" UBYTE _CNV_S_2_RANGE______3_CM 1 0. 0. 1. ECU_ADDRESS 0xd00046dc BIT_MASK 0x1 /end MEASUREMENT
/begin CHARACTERISTIC Cxx_rgb_pump_act_dly "Delay before the authorization of the robotized gearbox pump activation." VALUE 0xa0021882 _REC_S1VAL_20_u1 2.55 _CNV_A_R_LINEAR_____34_CM 0. 2.55 FORMAT "%4.2" /end CHARACTERISTIC
/begin COMPU_METHOD _CNV_A_R_ECME_LINEA_0_CM "" RAT_FUNC "%6.3" "-" COEFFS 0 1. 0. 0 0 1 /end COMPU_METHOD
/begin COMPU_METHOD _CNV_S_2_RANGE______3_CM "" TAB_VERB "%6.3" "-" COMPU_TAB_REF _CNV_S_2_RANGE______3 /end COMPU_METHOD
/begin COMPU_VTAB _CNV_S_2_RANGE______3 "" TAB_VERB 2 0 "0" 1 "1" /end COMPU_VTAB
/begin COMPU_METHOD _CNV_A_R_LINEAR_____4_CM "" RAT_FUNC "%6.3" "s" COEFFS 0 10. 0. 0 0 1 /end COMPU_METHOD
/begin COMPU_METHOD _CNV_A_R_ENSD_LINEA_24_CM "" RAT_FUNC "%6.3" "rpm" COEFFS 0 4. 0. 0 0 1 /end COMPU_METHOD
/begin COMPU_METHOD _CNV_A_R_LINEAR_____31_CM "" RAT_FUNC "%6.3" "-" COEFFS 0 256. 0. 0 0 1 /end COMPU_METHOD
/begin COMPU_METHOD _CNV_A_R_LINEAR_____34_CM "" RAT_FUNC "%6.3" "s" COEFFS 0 100. 0. 0 0 1 /end COMPU_METHOD
/begin COMPU_METHOD _CNV_A_R_LINEAR_____54_CM "" RAT_FUNC "%6.3" "∞C" COEFFS 0 10. 400. 0 0 1 /end COMPU_METHOD
/begin COMPU_METHOD _CNV_A_R_LINEAR_____55_CM "" RAT_FUNC "%6.3" "TDC" COEFFS 0 1. 0. 0 0 1 /end COMPU_METHOD
/begin COMPU_METHOD _CNV_A_R_LINEAR_____57_CM "" RAT_FUNC "%6.3" "hPa" COEFFS 0 1. 0. 0 0 1 /end COMPU_METHOD
/begin COMPU_METHOD _CNV_A_R_LINEAR_____70_CM "" RAT_FUNC "%6.3" "km/h" COEFFS 0 100. 0. 0 0 1 /end COMPU_METHOD
/begin COMPU_METHOD _CNV_A_R_LINEAR_____82_CM "" RAT_FUNC "%6.3" "s" COEFFS 0 1. 0. 0 0 1 /end COMPU_METHOD
/begin COMPU_METHOD _CNV_A_R_LINEAR_____93_CM "" RAT_FUNC "%6.3" "-" COEFFS 0 65535. 0. 0 0 1 /end COMPU_METHOD
/begin COMPU_METHOD _CNV_A_R_LINEAR_____94_CM "" RAT_FUNC "%6.3" "%" COEFFS 0 100. 0. 0 0 1 /end COMPU_METHOD
/begin COMPU_METHOD _CNV_A_R_LINEAR_____99_CM "" RAT_FUNC "%6.3" "%" COEFFS 0 20. 0. 0 0 1 /end COMPU_METHOD
/begin COMPU_METHOD _CNV_A_R_LINEAR_____109_CM "" RAT_FUNC "%6.3" "kg/h" COEFFS 0 20. 0. 0 0 1 /end COMPU_METHOD
/begin COMPU_METHOD _CNV_A_R_LINEAR_____113_CM "" RAT_FUNC "%6.3" "-" COEFFS 0 1. 1. 0 0 1 /end COMPU_METHOD
/begin COMPU_METHOD _CNV_A_R_LINEAR_____114_CM "" RAT_FUNC "%6.3" "%" COEFFS 0 2.55 0. 0 0 1 /end COMPU_METHOD
/begin COMPU_METHOD _CNV_A_R_LINEAR_____118_CM "" RAT_FUNC "%6.3" "-" COEFFS 0 255. 0. 0 0 1 /end COMPU_METHOD
/begin COMPU_METHOD _CNV_S_3_STATUS_OK__120_CM "" TAB_VERB "%6.3" "-" COMPU_TAB_REF _CNV_S_3_STATUS_OK__120 /end COMPU_METHOD
/begin COMPU_VTAB _CNV_S_3_STATUS_OK__120 "" TAB_VERB 3 0 "Nsx_vld_nok_0" 1 "Nsx_vld_ok_1" 2 "Nsx_vld_fail_2" /end COMPU_VTAB
/begin COMPU_METHOD _CNV_S_4_STATUS_OK__121_CM "" TAB_VERB "%6.3" "-" COMPU_TAB_REF _CNV_S_4_STATUS_OK__121 /end COMPU_METHOD
/begin COMPU_VTAB _CNV_S_4_STATUS_OK__121 "" TAB_VERB 4 0 "Nsx_vld_nok_0" 1 "Nsx_vld_ok_1" 2 "Nsx_vld_fail_2" 3 "Nsx_vld_fail_3" /end COMPU_VTAB
/begin COMPU_METHOD _CNV_A_R_LINEAR_____122_CM "" RAT_FUNC "%6.3" "%" COEFFS 0 655.35 0. 0 0 1 /end COMPU_METHOD
/begin COMPU_METHOD _CNV_A_R_LINEAR_____123_CM "" RAT_FUNC "%6.3" "Nm" COEFFS 0 32. 0. 0 0 1 /end COMPU_METHOD
/begin COMPU_METHOD _CNV_A_R_LINEAR_____128_CM "" RAT_FUNC "%6.3" "W" COEFFS 0 0.1 0. 0 0 1 /end COMPU_METHOD
/begin COMPU_METHOD _CNV_A_R_LINEAR_____136_CM "" RAT_FUNC "%6.3" "-" COEFFS 0 100. 0. 0 0 1 /end COMPU_METHOD
/begin COMPU_METHOD _CNV_A_R_LINEAR_____150_CM "" RAT_FUNC "%6.3" "V" COEFFS 0 100. 0. 0 0 1 /end COMPU_METHOD
/begin COMPU_METHOD _CNV_A_R_LINEAR_____161_CM "" RAT_FUNC "%6.3" "Nm" COEFFS 0 32. 12800. 0 0 1 /end COMPU_METHOD
/begin COMPU_METHOD _CNV_A_R_LINEAR_____185_CM "" RAT_FUNC "%6.3" "-" COEFFS 0 800. 0. 0 0 1 /end COMPU_METHOD
/begin COMPU_METHOD _CNV_A_R_LINEAR_____212_CM "" RAT_FUNC "%6.3" "km/h" COEFFS 0 1. 0. 0 0 1 /end COMPU_METHOD
/begin COMPU_METHOD _CNV_S_2_STATUS_OK__214_CM "" TAB_VERB "%6.3" "-" COMPU_TAB_REF _CNV_S_2_STATUS_OK__214 /end COMPU_METHOD
/begin COMPU_VTAB _CNV_S_2_STATUS_OK__214 "" TAB_VERB 2 0 "Nsx_vld_nok_0" 1 "Nsx_vld_ok_1" /end COMPU_VTAB
/begin COMPU_METHOD _CNV_A_R_LINEAR_____216_CM "" RAT_FUNC "%6.3" "ratio" COEFFS 0 255. 0. 0 0 1 /end COMPU_METHOD
/begin COMPU_METHOD _CNV_A_R_LINEAR_____218_CM "" RAT_FUNC "%6.3" "km" COEFFS 0 1. 0. 0 0 1 /end COMPU_METHOD
/begin COMPU_METHOD _CNV_A_R_LINEAR_____254_CM "" RAT_FUNC "%6.3" "ratio/s" COEFFS 0 8. 0. 0 0 1 /end COMPU_METHOD
/begin COMPU_METHOD _CNV_A_R_LINEAR_____288_CM "" RAT_FUNC "%6.3" "km/h/s" COEFFS 0 1. 0. 0 0 1 /end COMPU_METHOD
/begin COMPU_METHOD _CNV_A_R_LINEAR_____290_CM "" RAT_FUNC "%6.3" "W/s" COEFFS 0 0.1 0. 0 0 1 /end COMPU_METHOD
/begin COMPU_METHOD _CNV_A_R_LINEAR_____294_CM "" RAT_FUNC "%6.3" "N" COEFFS 0 0.5 10000. 0 0 1 /end COMPU_METHOD
/begin COMPU_METHOD _CNV_A_R_LINEAR_____295_CM "" RAT_FUNC "%6.3" "N" COEFFS 0 0.5 0. 0 0 1 /end COMPU_METHOD
/begin COMPU_METHOD _CNV_A_R_LINEAR_____296_CM "" RAT_FUNC "%6.3" "W" COEFFS 0 5.e-004 0. 0 0 1 /end COMPU_METHOD
/begin COMPU_METHOD _CNV_A_R_LINEAR_____297_CM "" RAT_FUNC "%6.3" "ratio/s" COEFFS 0 255. 0. 0 0 1 /end COMPU_METHOD
/begin COMPU_METHOD _CNV_A_R_LINEAR_____298_CM "" RAT_FUNC "%6.3" "Nm/rpm" COEFFS 0 255. 0. 0 0 1 /end COMPU_METHOD
/begin COMPU_METHOD _CNV_A_R_LINEAR_____299_CM "" RAT_FUNC "%6.3" "rpm/s" COEFFS 0 1.e-002 0. 0 0 1 /end COMPU_METHOD
/begin COMPU_METHOD _CNV_A_R_LINEAR_____300_CM "" RAT_FUNC "%6.3" "Nm/km/h" COEFFS 0 10.28015717235924 0. 0 0 1 /end COMPU_METHOD
/begin COMPU_METHOD _CNV_A_R_LINEAR_____302_CM "" RAT_FUNC "%6.3" "Nm" COEFFS 0 10. 0. 0 0 1 /end COMPU_METHOD
/begin COMPU_METHOD _CNV_A_R_LINEAR_____306_CM "" RAT_FUNC "%6.3" "bar" COEFFS 0 10. 0. 0 0 1 /end COMPU_METHOD
/begin COMPU_METHOD _CNV_A_R_LINEAR_____307_CM "" RAT_FUNC "%6.3" "V/Bar" COEFFS 0 1000. 0. 0 0 1 /end COMPU_METHOD
/begin COMPU_METHOD _CNV_A_R_LINEAR_____308_CM "" RAT_FUNC "%6.3" "s/m.K^0.5" COEFFS 0 1048576. 0. 0 0 1 /end COMPU_METHOD
/begin COMPU_METHOD _CNV_A_R_LINEAR_____309_CM "" RAT_FUNC "%6.3" "-" COEFFS 0 1024. -1024. 0 0 1 /end COMPU_METHOD
/begin COMPU_METHOD _CNV_A_R_LINEAR_____310_CM "" RAT_FUNC "%6.3" "hPa/s" COEFFS 0 2.56e-002 0. 0 0 1 /end COMPU_METHOD
/begin COMPU_METHOD _CNV_A_R_LINEAR_____311_CM "" RAT_FUNC "%6.3" "V≤" COEFFS 0 1. 0. 0 0 1 /end COMPU_METHOD
/begin COMPU_METHOD _CNV_A_R_LINEAR_____312_CM "" RAT_FUNC "%6.3" "A" COEFFS 0 10000. 0. 0 0 1 /end COMPU_METHOD
/begin COMPU_METHOD _CNV_A_R_LINEAR_____313_CM "" RAT_FUNC "%6.3" "W" COEFFS 0 273.0666666666667 0. 0 0 1 /end COMPU_METHOD
/begin COMPU_METHOD _CNV_A_R_LINEAR_____314_CM "" RAT_FUNC "%6.3" "Ohm" COEFFS 0 25.6 -2.560000000000001 0 0 1 /end COMPU_METHOD
/begin COMPU_METHOD _CNV_A_R_LINEAR_____315_CM "" RAT_FUNC "%6.3" "J" COEFFS 0 27.30666666666667 0. 0 0 1 /end COMPU_METHOD
/begin COMPU_METHOD _CNV_A_R_LINEAR_____316_CM "" RAT_FUNC "%6.3" "km" COEFFS 0 6.25e-002 0. 0 0 1 /end COMPU_METHOD
/begin COMPU_METHOD _CNV_A_R_LINEAR_____317_CM "" RAT_FUNC "%6.3" "m/s≤" COEFFS 0 2500. 0. 0 0 1 /end COMPU_METHOD
/begin COMPU_METHOD _CNV_A_R_LINEAR_____318_CM "" RAT_FUNC "%6.3" "-" COEFFS 0 71428.57142857142 -3.637978807091713e-012 0 0 1 /end COMPU_METHOD
/begin COMPU_METHOD _CNV_A_R_LINEAR_____319_CM "" RAT_FUNC "%6.3" "m/s" COEFFS 0 1000. 0. 0 0 1 /end COMPU_METHOD
/begin COMPU_METHOD _CNV_A_R_LINEAR_____320_CM "" RAT_FUNC "%6.3" "m/s" COEFFS 0 100. 0. 0 0 1 /end COMPU_METHOD
/begin COMPU_METHOD _CNV_A_R_LINEAR_____321_CM "" RAT_FUNC "%6.3" "s" COEFFS 0 50. 0. 0 0 1 /end COMPU_METHOD
/begin COMPU_METHOD _CNV_A_R_LINEAR_____322_CM "" RAT_FUNC "%6.3" "s" COEFFS 0 0.1 0. 0 0 1 /end COMPU_METHOD
/begin COMPU_METHOD _CNV_A_R_LINEAR_____323_CM "" RAT_FUNC "%6.3" "-" COEFFS 0 71428.57142857142 0. 0 0 1 /end COMPU_METHOD
/begin COMPU_METHOD _CNV_A_R_LINEAR_____324_CM "" RAT_FUNC "%6.3" "m" COEFFS 0 100. -50. 0 0 1 /end COMPU_METHOD
/begin COMPU_METHOD _CNV_A_R_LINEAR_____325_CM "" RAT_FUNC "%6.3" "km/h" COEFFS 0 1. -5. 0 0 1 /end COMPU_METHOD
/begin COMPU_METHOD _CNV_S_5_CANISTER_P_326_CM "" TAB_VERB "%6.3" "-" COMPU_TAB_REF _CNV_S_5_CANISTER_P_326 /end COMPU_METHOD
/begin COMPU_VTAB _CNV_S_5_CANISTER_P_326 "" TAB_VERB 5 0 "Nsx_cp_ini" 1 "Nsx_cp_out" 2 "Nsx_cp_ad" 4 "Nsx_cp_nom" 8 "Nsx_cp_ol" /end COMPU_VTAB
/begin RECORD_LAYOUT _REC_S1VAL_20_u1 FNC_VALUES 1 UBYTE COLUMN_DIR DIRECT /end RECORD_LAYOUT
/begin RECORD_LAYOUT _REC_A2AXS_20_u1 NO_AXIS_PTS_X 1 UBYTE AXIS_PTS_X 2 UBYTE INDEX_INCR DIRECT /end RECORD_LAYOUT
/begin RECORD_LAYOUT _REC_S1VAL_20_u2 FNC_VALUES 1 UWORD COLUMN_DIR DIRECT /end RECORD_LAYOUT
/begin RECORD_LAYOUT _REC_A2AXS_20_u2 NO_AXIS_PTS_X 1 UWORD AXIS_PTS_X 2 UWORD INDEX_INCR DIRECT /end RECORD_LAYOUT
/begin RECORD_LAYOUT _REC_A1CUR_20_u1_u2 FNC_VALUES 1 UBYTE COLUMN_DIR DIRECT /end RECORD_LAYOUT
/begin RECORD_LAYOUT _REC_A1CUR_20_u2_u1 FNC_VALUES 1 UWORD COLUMN_DIR DIRECT /end RECORD_LAYOUT
/begin RECORD_LAYOUT _REC_A1MAP_20_u2_u2_u2 FNC_VALUES 1 UWORD COLUMN_DIR DIRECT /end RECORD_LAYOUT
/begin RECORD_LAYOUT _REC_A1CUR_20_u2_u2 FNC_VALUES 1 UWORD COLUMN_DIR DIRECT /end RECORD_LAYOUT
/begin RECORD_LAYOUT _REC_A1MAP_20_u1_u2_u1 FNC_VALUES 1 UBYTE COLUMN_DIR DIRECT /end RECORD_LAYOUT
/begin FUNCTION InTqiAcs_Paltcox ""
 /begin DEF_CHARACTERISTIC Cxx_alt_pow_cor_slop Cxx_alt_pwm_dft_alt_pow_fac Cxx_alt_pwm_dft_pwst_pow_fac Cxx_el_bk_wind_dly Cxx_el_bk_wind_pow_cor Cxx_el_bk_wind_pow_cor_dly Cxx_el_wind_dly Cxx_el_wind_pow_cor Cxx_el_wind_pow_cor_dly Cxx_mdf1_meca_pow_cor Cxx_mdf1_meca_pow_cor_dly Cxx_mdf2_meca_pow_cor Cxx_mdf2_meca_pow_cor_dly Cxx_mdf_meca_pow_cor_dly1 Cxx_ptc_meca_pow_cor_dly Cxx_ptc_meca_pow_cor_dly1 Cxx_ptc_meca_pow_cor_fac Cxx_pwst_on_is_cor_dly Cxx_rgb_pump_pow_cor Cxx_rgb_pump_pow_cor_dly Cxx_rgb_pump_pow_cor_dly1 Cxx_vh_run_tmp_pwst_cor Cxx_vh_stop_tmp_pwst_cor /end DEF_CHARACTERISTIC
 /begin OUT_MEASUREMENT Vbx_alt_pwm_dft Vbx_ptc_pow_dec Vbx_ptc_pow_inc Vbx_pwst_off_dly Vxx_alt_pow_cor Vxx_el_bk_pow_cor Vxx_el_wind_pow_cor Vxx_mdf1_pow_cor Vxx_mdf2_pow_cor Vxx_ptc_pow_cor Vxx_ptc_pow_cor_dly Vxx_ptc_pow_cor_dly1 Vxx_ptc_pow_inc Vxx_pwst_prs_pow_cor Vxx_rgb_pump_pow_cor /end OUT_MEASUREMENT
/end FUNCTION
/begin FUNCTION InTqiAcs_Rgbepcs "" /begin DEF_CHARACTERISTIC Cxx_rgb_pump_act_dly /end DEF_CHARACTERISTIC /begin OUT_MEASUREMENT Vbx_rgb_pump /end OUT_MEASUREMENT /end FUNCTION
/begin FUNCTION InTqiAcs_Ptcxxmd "" /begin OUT_MEASUREMENT Vxx_mdl_ptc_pow /end OUT_MEASUREMENT /end FUNCTION
/begin FUNCTION PcDrvDit ""
 /begin SUB_FUNCTION PcDrvDit_Pedlhxx PcDrvDit_Pedfmxx PcDrvDit_Drtqexx PcDrvDit_Drarbxx PcDrvDit_Ditcfxx /end SUB_FUNCTION
/end FUNCTION
/begin FUNCTION PcDrvDit_Pedlhxx ""
 /begin DEF_CHARACTERISTIC Ctp_acel_pdl_lih_hys_n_h Ctp_acel_pdl_lih_n_sp Cbx_acel_pdl_lvl_cfm Cxx_acel_pdl_lih_hys_n_l Cxx_acel_pdl_lih_hys_vs_h Cxx_acel_pdl_lih_hys_vs_l Cxx_acel_pdl_lih_max_vs Cxx_acel_pdl_lih_min_l Cxx_acel_pdl_lih_n_ig Cxx_acel_pdl_lih_n_pg Cxx_acel_pdl_lih_n_sp_bpk_on Cxx_acel_pdl_lih_n_sp_srs Cxx_acel_pdl_lih_n_tqe_h Cxx_acel_pdl_lih_slop_h1 Cxx_acel_pdl_lih_slop_h2 Cxx_acel_pdl_lih_slop_n_h Cxx_acel_pdl_lih_slop_vs Cxx_acel_pdl_lih_vs_ig Cxx_acel_pdl_lih_vs_pg Cxx_acel_pdl_lih_vs_rvr Cxx_acel_pdl_lih_vs_sp Cxx_acel_pdl_lih_vs_tqe_h Cxx_acel_pdl_lvl_tqe_thd Cxx_acel_pdl_trs_slop_neg Cxx_acel_pdl_trs_slop_pos Cxx_max_pow /end DEF_CHARACTERISTIC
 /begin OUT_MEASUREMENT Vbx_acel_pdl_lih_act Vbx_acel_pdl_lih_dft_act Vbx_acel_pdl_lih_dft_prev Vbx_acel_pdl_lih_i_rst Vbx_acel_pdl_lih_min_cdn Vbx_acel_pdl_lih_n_i_frz Vbx_acel_pdl_lih_n_tqe_h Vbx_acel_pdl_lih_n_tqe_l Vbx_acel_pdl_lih_reg_swi Vbx_acel_pdl_lih_sp_cdn Vbx_acel_pdl_lih_vs_i_frz Vbx_acel_pdl_lih_vs_p_rst Vbx_acel_pdl_lih_vs_tqe_h Vbx_acel_pdl_lih_vs_tqe_l Vxx_acel_pdl_lih_n_dif Vxx_acel_pdl_lih_n_i Vxx_acel_pdl_lih_n_sp Vxx_acel_pdl_lih_n_tqe Vxx_acel_pdl_lih_pwt Vxx_acel_pdl_lih_pwt_load Vxx_acel_pdl_lih_pwt_sp Vxx_acel_pdl_lih_tqe_sp Vxx_acel_pdl_lih_vs_dif Vxx_acel_pdl_lih_vs_i Vxx_acel_pdl_lih_vs_sp Vxx_acel_pdl_lih_vs_tqe /end OUT_MEASUREMENT
/end FUNCTION
/begin FUNCTION PcDrvDit_Pedfmxx ""
 /begin DEF_CHARACTERISTIC Ctb_acel_pdl_fmt Ctb_acel_pdl_fmt_fac_driv Ctb_acel_pdl_fmt_fac_vs Ctb_acel_pdl_fmt_tkof_fac_driv Ctb_acel_pdl_fmt_tkof_fac_vs Cmp_acel_pdl_fmt_fac Cmp_acel_pdl_fmt_tkof_fac Ctp_acel_pdl_fmt_1 Ctp_acel_pdl_fmt_2 Cbx_acel_pdl_fmt_mnl_cfm Cxx_acel_pdl_fmt_mnl_fac Cxx_acel_pdl_fmt_rvr_fac Cxx_pdl_fmt_fac_slop_swi_down Cxx_pdl_fmt_fac_slop_swi_up Cxx_tkof_cdn_vs_max Cxx_tkof_stop_vs /end DEF_CHARACTERISTIC
 /begin OUT_MEASUREMENT Vsx_acel_pdl_pwt_sp_vld Vxx_acel_pdl_fmt_fac Vxx_acel_pdl_pwt_sp /end OUT_MEASUREMENT
/end FUNCTION
/begin FUNCTION PcDrvDit_Drtqexx ""
 /begin DEF_CHARACTERISTIC Ctb_driv_tqe_map_n Ctb_driv_tqe_map_pwt_sp Ctb_min_driv_tqe_pwt_sp Cmp_driv_tqe_map Cmp_min_driv_tqe_map Cbx_ref_max_pow_cfm Cxx_ref_max_pow /end DEF_CHARACTERISTIC
 /begin OUT_MEASUREMENT Vxx_driv_tqe_sp Vxx_main_driv_tqe_sp /end OUT_MEASUREMENT
/end FUNCTION
/begin FUNCTION PcDrvDit_Drarbxx ""
 /begin DEF_CHARACTERISTIC Ctb_min_max_forc_vs Ctp_max_forc Ctp_min_forc Cxx_no_driv_pwt_sp_hys Cxx_no_driv_pwt_sp_thd Cxx_no_virt_driv_pwt_sp_hys Cxx_no_virt_driv_pwt_sp_thd /end DEF_CHARACTERISTIC
 /begin OUT_MEASUREMENT Vbx_cru_acc_virt_driv_on Vbx_no_driv_pwt_sp Vbx_virt_driv_on Vsx_driv_pwt_sp_vld Vxx_acc_pwt_sp Vxx_acel_pdl_forc_sp Vxx_arb_driv_pwt_sp Vxx_cru_pwt_sp Vxx_driv_pwt_sp Vxx_max_forc Vxx_min_forc Vxx_sdl_pwt_sp Vxx_sl_pwt_sp /end OUT_MEASUREMENT
/end FUNCTION
/begin FUNCTION PcDrvDit_Ditcfxx "" /begin OUT_MEASUREMENT Vbx_acel_pdl_lih_min_spc_cdn /end OUT_MEASUREMENT /end FUNCTION
/begin FUNCTION InTqiTrz "" /begin SUB_FUNCTION InTqiTrz_Corxxxx InTqiTrz_Mdlxxxx /end SUB_FUNCTION /end FUNCTION
/begin FUNCTION InTqiTrz_Corxxxx ""
 /begin DEF_CHARACTERISTIC Cbx_trz_ad_b1_fil_req Cbx_trz_ad_b1_val_req Cbx_trz_ad_b2_fil_req Cbx_trz_ad_b2_val_req Cxx_trz_ad_b1_fil_ini Cxx_trz_ad_b1_val_ini Cxx_trz_ad_b2_fil_ini Cxx_trz_ad_b2_val_ini Cxx_trz_ad_b_fil_fac Cxx_trz_ad_b_grd_prs Cxx_trz_ad_b_n_max Cxx_trz_ad_b_n_min Cxx_trz_ad_b_nr_tdc Cxx_trz_b_ini /end DEF_CHARACTERISTIC
 /begin OUT_MEASUREMENT Vxx_trz_ad_b1_val Vxx_trz_ad_b2_val Vxx_trz_ad_b1_dif Vxx_trz_ad_b2_dif Vxx_trz_ad_b1_fil Vxx_trz_ad_b2_fil Vxx_trz_ad_b_ctr_tdc Vbx_trz_ad_b_ok Vbx_trz_ad_b_ena Vbx_trz_cyl_slc Vsx_trz_ad_b_stt /end OUT_MEASUREMENT
/end FUNCTION
/begin FUNCTION InTqiTrz_Mdlxxxx "" /begin DEF_CHARACTERISTIC Cxx_trz_a Cxx_trz_n_max Cxx_trz_n_min /end DEF_CHARACTERISTIC
 /begin OUT_MEASUREMENT Vbx_trz_clc_ok Vbx_trz_raw_clc Vbx_trz_raw_err Vbx_trz_val_neg Vsx_trz_stt Vxx_trz_ad_b_val Vxx_trz_raw_val Vxx_trz_val_tmp Vxx_trz_val_tmp1 /end OUT_MEASUREMENT
/end FUNCTION
/begin FUNCTION InVfiAci "" /begin OUT_MEASUREMENT Vbx_ac_prs_lk_stt Vbx_ac_req_lk_stt Vbx_comp_cfa_lk_stt /end OUT_MEASUREMENT
 /begin SUB_FUNCTION InVfiAci_Mngtxcs InVfiAci_Acprssr InVfiAci_Acclucs InVfiAci_Acwfinx /end SUB_FUNCTION
/end FUNCTION
/begin FUNCTION InVfiAci_Mngtxcs ""
 /begin DEF_CHARACTERISTIC Cxx_ac_req_dly Cxx_ac_req_dsb_dly Cxx_wf_ac_req_dly Cxx_wf_ac_req_dsb_dly /end DEF_CHARACTERISTIC
 /begin OUT_MEASUREMENT Vbx_ac_mdf1_req_ext Vbx_ac_mdf2_req_ext Vbx_ac_req Vbx_agb_mdf1_req Vbx_agb_mdf2_req /end OUT_MEASUREMENT
/end FUNCTION
/begin FUNCTION InVfiAci_Acprssr ""
 /begin DEF_CHARACTERISTIC Cxx_ac_lk_stt_dly Cxx_ac_prs_fac Cxx_ac_prs_lk_stt_dly Cxx_ac_prs_ofs Cxx_ac_prs_v_max Cxx_ac_prs_v_min Cxx_dfdec_ac_prs Cxx_dfinc_ac_prs /end DEF_CHARACTERISTIC
 /begin OUT_MEASUREMENT Vbx_ac_ext_pres Vbx_ac_pres Vbx_df_ac_prs_h Vbx_df_ac_prs_l Vsx_ac_prs_vld Vxx_ac_prs /end OUT_MEASUREMENT
/end FUNCTION
/begin FUNCTION InVfiAci_Acclucs "" /begin OUT_MEASUREMENT Vbx_ac_clu_req /end OUT_MEASUREMENT /end FUNCTION
/begin FUNCTION InVfiAci_Acwfinx "" /begin OUT_MEASUREMENT Vbx_wf_ac_req /end OUT_MEASUREMENT /end FUNCTION
/begin FUNCTION InPciAcc "" /begin SUB_FUNCTION InPciAcc_Noaccxx /end SUB_FUNCTION /end FUNCTION
/begin FUNCTION InPciAcc_Noaccxx "" /begin OUT_MEASUREMENT Vsx_acc_sdl_ctl_typ Vxx_acc_forc_sp Vxx_sdl_forc_sp /end OUT_MEASUREMENT /end FUNCTION
/begin FUNCTION ClCooSpt "" /begin SUB_FUNCTION ClCooSpt_Cteaubc ClCooSpt_Tstaxbc /end SUB_FUNCTION /end FUNCTION
/begin FUNCTION ClCooSpt_Cteaubc ""
 /begin OUT_MEASUREMENT Vbx_mdf2_reg Vbx_tco_sp_l_mod Vbx_tsta_ip_dft_lght_tco_h_sp Vxx_mdf2_reg_dly Vxx_tco_sp /end OUT_MEASUREMENT
/end FUNCTION
/begin FUNCTION ClCooSpt_Tstaxbc "" /begin OUT_MEASUREMENT Vsx_tsta_vld /end OUT_MEASUREMENT /end FUNCTION
/begin FUNCTION OuCloCoo ""
 /begin SUB_FUNCTION OuCloCoo_Chvcmdx OuCloCoo_Mdfanxx OuCloCoo_Tceauxx OuCloCoo_Clatoxx OuCloCoo_Paotxxx /end SUB_FUNCTION
/end FUNCTION
/begin FUNCTION OuCloCoo_Chvcmdx "" /begin OUT_MEASUREMENT Vbx_thpl_is_acel /end OUT_MEASUREMENT /end FUNCTION
/begin FUNCTION OuCloCoo_Mdfanxx "" /begin DEF_CHARACTERISTIC Cxx_mdf_min_dly Cxx_mdf_on_dly /end DEF_CHARACTERISTIC
 /begin OUT_MEASUREMENT Vbx_ac_mdf1_req Vbx_ac_mdf2_req Vbx_mdf1_cmd Vbx_mdf1_cmd_dly Vbx_mdf2_cmd Vbx_mdf2_cmd_dly Vxx_mdf_min_dly_cnt Vxx_mdf_min_dly_dt /end OUT_MEASUREMENT
/end FUNCTION
/begin FUNCTION OuCloCoo_Tceauxx "" /begin DEF_CHARACTERISTIC Ctb_tco_sp Ctd_tco_7 /end DEF_CHARACTERISTIC /begin OUT_MEASUREMENT Vbx_tsta_ip_trs_l_mux Vxx_tco_sp_mux /end OUT_MEASUREMENT /end FUNCTION
/begin FUNCTION OuCloCoo_Clatoxx ""
 /begin DEF_CHARACTERISTIC Cbx_ip_lght_tco_ovh_igk_off_ena Cxx_dfdec_ip_lght_tco_ovh Cxx_dfinc_ip_lght_tco_ovh Cxx_dft_lght_off_tco_thd Cxx_dft_lght_on_tco_thd Cxx_tsta_dft_lght_off_tco_thd Cxx_tsta_dft_lght_on_tco_thd /end DEF_CHARACTERISTIC
 /begin OUT_MEASUREMENT Vbx_df_ip_lght_tco_ovh Vbx_ip_dft_lght_tco Vbx_ip_lght_tco_ovh_igk_off_ena /end OUT_MEASUREMENT
/end FUNCTION
/begin FUNCTION OuCloCoo_Paotxxx ""
 /begin DEF_CHARACTERISTIC Cxx_dfdec_wpmp_tcr_blk Cxx_dfdec_wpmp_tcr_oc Cxx_dfdec_wpmp_tcr_scg Cxx_dfdec_wpmp_tcr_scw Cxx_dfinc_wpmp_tcr_blk Cxx_dfinc_wpmp_tcr_oc Cxx_dfinc_wpmp_tcr_scg Cxx_dfinc_wpmp_tcr_scw Cxx_wpmp_tcr_max_t Cxx_wpmp_tcr_max_tco_t Cxx_wpmp_tcr_tco_hys Cxx_wpmp_tcr_tco_thd /end DEF_CHARACTERISTIC
 /begin OUT_MEASUREMENT Vbx_wpmp_tcr Vbx_wpmp_tcr_cmd Vbx_wpmp_tcr_pws Vbx_wpmp_tcr_stop Vsx_wpmp_tcr Vxx_wpmp_tco_tcr_dly Vxx_wpmp_tcr_dly /end OUT_MEASUREMENT
/end FUNCTION
/begin FUNCTION AsBstSpt "" /begin SUB_FUNCTION AsBstSpt_Spgspxx /end SUB_FUNCTION /end FUNCTION
/begin FUNCTION AsBstSpt_Spgspxx ""
 /begin DEF_CHARACTERISTIC Ctb_it_psn Ctb_spg_ar_maf_fac Cmp_spg_sp_it_mod Ctp_inv_prs_rat Ctp_spg_max_grd Cbx_spg_reg_cfm Cxx_spg_max_prs_dif /end DEF_CHARACTERISTIC
 /begin OUT_MEASUREMENT Vxx_spg_ar_maf_fac Vxx_spg_fil_spg_prs_sp Vxx_spg_prs_sp /end OUT_MEASUREMENT
/end FUNCTION
/begin FUNCTION OuAtoDlo "" /begin SUB_FUNCTION OuAtoDlo_Heating OuAtoDlo_Heatdgn /end SUB_FUNCTION /end FUNCTION
/begin FUNCTION OuAtoDlo_Heating ""
 /begin DEF_CHARACTERISTIC Ctb_n_lbdw_hot_dsb Ctb_t_lbdw_hot_rest Ctb_t_lbdw_hot_sta Ctb_tco_lbdw_hot_dly Ctd_t_rat_lbdw_rest Ctd_t_rat_lbdw_sta Ctp_n_lbdw_hot_dsb_map Ctp_tco_lbdw_hot_dly Cbx_lbdw_dwpt_per_ena Cxx_lbdw_cold_sta_rat Cxx_lbdw_dft_pwm Cxx_lbdw_dly_rest_t Cxx_lbdw_hot_cmd_map_hys Cxx_lbdw_hot_cmd_vs_hys Cxx_lbdw_hot_dsb_vs Cxx_lbdw_hot_sta_end Cxx_lbdw_rms_v Cxx_lbdw_tco_rest_thd /end DEF_CHARACTERISTIC
 /begin OUT_MEASUREMENT Vbx_aut_eng_lbdw_hot Vbx_lbdw_hot_cmd Vbx_lbdw_hot_cmd_stt Vbx_lbdw_hot_t_rest Vxx_lbdw_appl_pwm Vxx_lbdw_clc_pwm Vxx_lbdw_dly_rest_t Vxx_lbdw_hot_dly_ctr Vxx_lbdw_hot_rest_stt Vxx_lbdw_hot_t Vxx_lbdw_hot_t_prev Vxx_lbdw_pwm_ctr Vxx_lbdw_ref_pwm Vxx_n_lbdw_hot_dsb_map Vxx_t_lbdw_hot_sta Vxx_t_rat_lbdw_rest Vxx_t_rat_lbdw_sta /end OUT_MEASUREMENT
/end FUNCTION
/begin FUNCTION OuAtoDlo_Heatdgn ""
 /begin DEF_CHARACTERISTIC Cxx_dfdec_lbdw_hot_oc Cxx_dfdec_lbdw_hot_scg Cxx_dfdec_lbdw_hot_scw Cxx_dfinc_lbdw_hot_oc Cxx_dfinc_lbdw_hot_scg Cxx_dfinc_lbdw_hot_scw /end DEF_CHARACTERISTIC
 /begin OUT_MEASUREMENT Vsx_lbdw_hot_vld /end OUT_MEASUREMENT
/end FUNCTION
/begin FUNCTION OuCboUlo "" /begin OUT_MEASUREMENT Vxx_lbup_hot_obd_crt_mv_rtn Vxx_lbup_hot_obd_crt_thd_rtn /end OUT_MEASUREMENT /begin SUB_FUNCTION OuCboUlo_Heating OuCboUlo_Heatdgn OuCboUlo_Alcoxxx /end SUB_FUNCTION /end FUNCTION
/begin FUNCTION OuCboUlo_Heating ""
 /begin DEF_CHARACTERISTIC Ctb_n_lbup_hot_dsb Ctb_t_lbup_hot_rest Ctb_t_lbup_hot_sta Ctb_tco_lbup_hot_dly Ctd_t_rat_lbup_rest Ctd_t_rat_lbup_sta Ctp_n_lbup_hot_dsb_map Ctp_tco_lbup_hot_dly Cbx_lbup_dwpt_per_ena Cxx_lbup_cold_sta_rat Cxx_lbup_dft_pwm Cxx_lbup_dly_rest_t Cxx_lbup_heat_r Cxx_lbup_hot_cmd_map_hys Cxx_lbup_hot_cmd_vs_hys Cxx_lbup_hot_dsb_vs Cxx_lbup_hot_egy Cxx_lbup_hot_egy_max Cxx_lbup_hot_sta_end Cxx_lbup_loss_pow Cxx_lbup_rms_v Cxx_lbup_tco_rest_thd /end DEF_CHARACTERISTIC
 /begin OUT_MEASUREMENT Vbx_aut_eng_lbup_hot Vbx_lbup_hot Vbx_lbup_hot_cmd Vbx_lbup_hot_cmd_stt Vbx_lbup_hot_cmd_stt_sf Vxx_lbup_appl_pwm Vxx_lbup_clc_pwm Vxx_lbup_dly_rest_t Vxx_lbup_heat_raw_pow Vxx_lbup_hot_dly_ctr Vxx_lbup_hot_rest_stt Vxx_lbup_hot_t Vxx_lbup_pwm_ctr Vxx_lbup_ref_pwm Vxx_lbup_ref_pwm_sf Vxx_n_lbup_hot_dsb_map Vxx_t_lbup_hot_sta Vxx_t_rat_lbup_rest Vxx_t_rat_lbup_sta /end OUT_MEASUREMENT
/end FUNCTION
/begin FUNCTION OuCboUlo_Heatdgn ""
 /begin DEF_CHARACTERISTIC Cxx_dfdec_lbup_hot_oc Cxx_dfdec_lbup_hot_scg Cxx_dfdec_lbup_hot_scw Cxx_dfinc_lbup_hot_oc Cxx_dfinc_lbup_hot_scg Cxx_dfinc_lbup_hot_scw /end DEF_CHARACTERISTIC
 /begin OUT_MEASUREMENT Vsx_lbup_hot_vld /end OUT_MEASUREMENT
/end FUNCTION
/begin FUNCTION OuCboUlo_Alcoxxx "" /begin DEF_CHARACTERISTIC Ctp_tco_lbup_hot_dly_alco /end DEF_CHARACTERISTIC /begin OUT_MEASUREMENT Vxx_lbup_hot_dly_ctr_alco /end OUT_MEASUREMENT /end FUNCTION
/begin FUNCTION VfCrkMng "" /begin SUB_FUNCTION VfCrkMng_Mngtxxx VfCrkMng_Engreqx /end SUB_FUNCTION /end FUNCTION
/begin FUNCTION VfCrkMng_Mngtxxx ""
 /begin DEF_CHARACTERISTIC Ctb_fct_tco_crkm Ctp_fct_tco_dly Cxx_ena_sta_agb_vld_dly Cxx_frst_sta_dly Cxx_sta_stt_vld_dly Cxx_wait_sta_fail_dly /end DEF_CHARACTERISTIC
 /begin OUT_MEASUREMENT Vbx_dft_sta Vbx_long_crk_req Vsx_ena_sta_agb_ecm Vsx_ena_sta_ecm /end OUT_MEASUREMENT
/end FUNCTION
/begin FUNCTION VfCrkMng_Engreqx "" /begin OUT_MEASUREMENT Vbx_eng_crk_wait /end OUT_MEASUREMENT /end FUNCTION
/begin FUNCTION VfSlkMng ""
 /begin SUB_FUNCTION VfSlkMng_Lockxv4 VfSlkMng_Lockxv2 VfSlkMng_Lockxcs VfSlkMng_Schxxxx /end SUB_FUNCTION
/end FUNCTION
/begin FUNCTION VfSlkMng_Lockxv4 ""
 /begin DEF_CHARACTERISTIC Cbx_swlk_dsb Cbx_swlk_key_spc_req Cbx_swlk_req Cxx_swlk_chlg_dly Cxx_swlk_diag_dly Cxx_swlk_id_forb_dly Cxx_swlk_id_nok_ctr_dec Cxx_swlk_id_nr_ena Cxx_swlk_key_dlt_dly Cxx_swlk_key_dly Cxx_swlk_noi_1 Cxx_swlk_noi_2 Cxx_swlk_noi_3 Cxx_swlk_noi_4 Cxx_swlk_noi_5 Cxx_swlk_noi_6 Cxx_swlk_pwl_dly /end DEF_CHARACTERISTIC
 /begin OUT_MEASUREMENT SLockRequestControl SoftwareLockRequest[0] SoftwareLockRequest[1] SoftwareLockRequest[2] SoftwareLockRequest[3] SoftwareLockRequest[4] SoftwareLockRequest[5] Vbx_supl_key_bkup_ok Vbx_supl_key_norm_ok Vbx_swlk_4_ecm_prot_stt Vbx_swlk_4_pwl_rtn_req Vbx_swlk_cnt_tool_req Vbx_swlk_diag_avl Vbx_swlk_diag_ccu Vbx_swlk_diag_ecm Vbx_swlk_diag_mux Vbx_swlk_diag_tool Vbx_swlk_dsb_ena Vsx_swlk_stt Vxx_swlk_4_eng_run_ena Vxx_swlk_diag_1 Vxx_swlk_diag_2 Vxx_swlk_diag_3 Vxx_swlk_key_mem_stt Vxx_swlk_nok_id_ctr /end OUT_MEASUREMENT
/end FUNCTION
/begin FUNCTION VfSlkMng_Lockxv2 ""
 /begin OUT_MEASUREMENT Vbx_swlk2_code_line_dfl Vbx_swlk2_ecm_lck_stt Vbx_swlk2_ecm_prot_stt Vbx_swlk2_eprm_dfl Vbx_swlk2_key_mem_stt Vbx_swlk2_pwl_rtn_req /end OUT_MEASUREMENT
/end FUNCTION
/begin FUNCTION VfSlkMng_Lockxcs ""
 /begin OUT_MEASUREMENT Vbx_swlk_ecm_prot_stt Vbx_swlk_pwl_rtn_req Vxx_eng_run_ena_swlk /end OUT_MEASUREMENT
/end FUNCTION
/begin FUNCTION VfSlkMng_Schxxxx "" /begin DEF_CHARACTERISTIC Cbx_swlk_2_4_cfm /end DEF_CHARACTERISTIC /begin OUT_MEASUREMENT Vbx_swlk_2_4_cfm /end OUT_MEASUREMENT /end FUNCTION
/begin FUNCTION AsMafSpt "" /begin SUB_FUNCTION AsMafSpt_Mafspxx /end SUB_FUNCTION /end FUNCTION
/begin FUNCTION AsMafSpt_Mafspxx "" /begin OUT_MEASUREMENT Vxx_it_maf_sp Vxx_maf_eng_sp /end OUT_MEASUREMENT /end FUNCTION
/begin FUNCTION InCbiKnk "" /begin SUB_FUNCTION InCbiKnk_Emnoixx InCbiKnk_Knkdtxx /end SUB_FUNCTION /end FUNCTION
/begin FUNCTION InCbiKnk_Emnoixx "" /begin DEF_CHARACTERISTIC Cxx_knk_fil_ftc /end DEF_CHARACTERISTIC /begin OUT_MEASUREMENT Vxx_mv_knk /end OUT_MEASUREMENT /end FUNCTION
/begin FUNCTION InCbiKnk_Knkdtxx ""
 /begin DEF_CHARACTERISTIC Ctb_n_knk Ctp_n_knk_fac_cyl_0 Ctp_n_knk_fac_cyl_1 Ctp_n_knk_fac_cyl_2 Ctp_n_knk_fac_cyl_3 Ctp_n_knk_ofs_cyl_0 Ctp_n_knk_ofs_cyl_1 Ctp_n_knk_ofs_cyl_2 Ctp_n_knk_ofs_cyl_3 Ctp_n_knk_zon Cbx_knk_ini_req Cxx_decl_knk_fil_fac Cxx_dfdec_knk_oor Cxx_dfdec_knk_shp Cxx_dfinc_knk_oor Cxx_dfinc_knk_shp Cxx_inc_knk_fil_fac Cxx_knk_det_n_thd Cxx_knk_det_prs_thd Cxx_knk_det_tco_thd Cxx_knk_fil_inc Cxx_knk_n_dsb_thd Cxx_knk_zon_tco_thd /end DEF_CHARACTERISTIC
 /begin OUT_MEASUREMENT Vxx_knk_ctr_cyl_1 Vxx_knk_ctr_cyl_2 Vxx_knk_ctr_cyl_3 Vxx_knk_ctr_cyl_4 Vbx_fil_knk_noi_cyl_init Vbx_knk_det_cyl_1 Vbx_knk_det_cyl_2 Vbx_knk_det_cyl_3 Vbx_knk_det_cyl_4 Vbx_knk_det_ena Vbx_knk_n_dsb Vbx_knk_zon Vsx_knk_sens_vld Vtd_fil_knk_noi_cyl[0] Vtd_fil_knk_noi_cyl[1] Vtd_fil_knk_noi_cyl[2] Vtd_fil_knk_noi_cyl[3] Vtd_knk_det_cyl[0] Vtd_knk_det_cyl[1] Vtd_knk_det_cyl[2] Vtd_knk_det_cyl[3] Vxx_fil_acq_knk_cyl_1 Vxx_fil_acq_knk_cyl_2 Vxx_fil_acq_knk_cyl_3 Vxx_fil_acq_knk_cyl_4 /end OUT_MEASUREMENT
/end FUNCTION
/begin FUNCTION AsMapSpt "" /begin SUB_FUNCTION AsMapSpt_Maprfxx /end SUB_FUNCTION /end FUNCTION
/begin FUNCTION AsMapSpt_Maprfxx "" /begin DEF_CHARACTERISTIC Cxx_map_ref_dz /end DEF_CHARACTERISTIC /begin OUT_MEASUREMENT Vxx_map_ref Vxx_raw_map_ref /end OUT_MEASUREMENT /end FUNCTION
/begin FUNCTION InVfiEsi "" /begin SUB_FUNCTION InVfiEsi_Mngtxcs /end SUB_FUNCTION /end FUNCTION
/begin FUNCTION InVfiEsi_Mngtxcs ""
 /begin OUT_MEASUREMENT Vxx_airb1 Vxx_airb2 Vxx_eng_stop_req_ccu Vxx_eng_stop_req_rgb Vxx_eng_stop_req_ssg /end OUT_MEASUREMENT
/end FUNCTION
/begin FUNCTION InVfiVsi ""
 /begin SUB_FUNCTION InVfiVsi_Mngtxcs InVfiVsi_Dgtdvcs InVfiVsi_Tacelmd InVfiVsi_Dsplvcs InVfiVsi_Lacelmd InVfiVsi_Rwsxxcs InVfiVsi_Tacelcs /end SUB_FUNCTION
/end FUNCTION
/begin FUNCTION InVfiVsi_Mngtxcs "" /begin DEF_CHARACTERISTIC Cbx_vs_vld_bch_mod_ena /end DEF_CHARACTERISTIC /begin OUT_MEASUREMENT Vsx_vs_2_vld Vsx_vs_vld Vxx_vs /end OUT_MEASUREMENT /end FUNCTION
/begin FUNCTION InVfiVsi_Dgtdvcs "" /begin DEF_CHARACTERISTIC Cxx_vh_dist_max_dif /end DEF_CHARACTERISTIC
 /begin OUT_MEASUREMENT Vxx_vh_dist Vbx_ecu_pres Vsx_vh_dist_l_res_vld Vsx_vh_dist_vld Vxx_vh_dist_l_res /end OUT_MEASUREMENT
/end FUNCTION
/begin FUNCTION InVfiVsi_Tacelmd ""
 /begin DEF_CHARACTERISTIC Cxx_h_thd_tra_acel_ok Cxx_l_thd_tra_acel_ok Cxx_rel_err_fil Cxx_rel_err_thd_max Cxx_rwhb Cxx_rwhs_fil Cxx_rwhs_max_tra_acel Cxx_rwhs_min_tra_acel Cxx_tra_acel_mv_fil Cxx_wait_tra_acel_vld /end DEF_CHARACTERISTIC
 /begin OUT_MEASUREMENT Vbx_ini_rel_err_fil Vbx_mdl_tra_acel_ok Vbx_rwhs_ok Vbx_t_end Vsx_mdl_tra_acel_vld Vxx_abs_tra_acel_mv Vxx_diff_rel_err Vxx_mdl_tra_acel Vxx_mdl_tra_acel_clc Vxx_rel_err Vxx_rel_err_mv Vxx_rel_err_mv_dly Vxx_rwhs_diff Vxx_rwhs_sum Vxx_t_wait_tra_acel_vld Vxx_tra_acel_mv /end OUT_MEASUREMENT
/end FUNCTION
/begin FUNCTION InVfiVsi_Dsplvcs "" /begin OUT_MEASUREMENT Vbx_dspl_vs_in_mph Vsx_dspl_vs_vld Vxx_dspl_vs /end OUT_MEASUREMENT /end FUNCTION
/begin FUNCTION InVfiVsi_Lacelmd "" /begin DEF_CHARACTERISTIC Cxx_lg_acel_fil Cxx_vs_tkof_thd /end DEF_CHARACTERISTIC /begin OUT_MEASUREMENT Vxx_lg_acel Vxx_lg_acel_raw /end OUT_MEASUREMENT /end FUNCTION
/begin FUNCTION InVfiVsi_Rwsxxcs ""
 /begin OUT_MEASUREMENT Vsx_lft_rwhs_vld Vsx_rgt_rwhs_vld Vxx_lft_rwhs Vxx_rgt_rwhs /end OUT_MEASUREMENT
/end FUNCTION
/begin FUNCTION InVfiVsi_Tacelcs "" /begin DEF_CHARACTERISTIC Cbx_tra_acel_cfm /end DEF_CHARACTERISTIC /begin OUT_MEASUREMENT Vsx_tra_acel_vld Vxx_tra_acel /end OUT_MEASUREMENT /end FUNCTION
/begin FUNCTION VfEstMng "" /begin OUT_MEASUREMENT Vxx_crsh_det Vxx_crsh_mem /end OUT_MEASUREMENT /begin SUB_FUNCTION VfEstMng_Mngtxxx /end SUB_FUNCTION /end FUNCTION
/begin FUNCTION VfEstMng_Mngtxxx ""
 /begin DEF_CHARACTERISTIC Cbx_rest_aftr_crsh_ena Cxx_eng_stop_req_airb2_lvl1 Cxx_eng_stop_req_airb2_lvl2 Cxx_eng_stop_req_ccu Cxx_eng_stop_req_rgb Cxx_eng_stop_req_ssg Cxx_rest_aftr_crsh_dly /end DEF_CHARACTERISTIC
 /begin OUT_MEASUREMENT Vbx_crsh_lvl1_det Vbx_crsh_lvl2_det Vbx_crsh_lvl2_det_fmt Vbx_eng_stop_srce_dft Vbx_eng_stop_srce_norm_driv Vbx_eng_stop_srce_norm_sys Vbx_eng_stop_srce_secu Vxx_eng_run_ena_airb Vxx_eng_run_ena_ccu Vxx_eng_run_ena_rgb Vxx_eng_run_ena_ssg Vxx_run_eng_ena /end OUT_MEASUREMENT
/end FUNCTION
/begin FUNCTION CbRicCan "" /begin SUB_FUNCTION CbRicCan_Cppwmxx CbRicCan_Cpopenx /end SUB_FUNCTION /end FUNCTION
/begin FUNCTION CbRicCan_Cppwmxx ""
 /begin DEF_CHARACTERISTIC Ctb_map Cmp_prs_n_pwm_cp Cxx_cp_fac_pwm Cxx_cp_flr_min_1 Cxx_cp_flr_min_2 Cxx_cp_hys_n_frq Cxx_cp_n_frq Cxx_cp_pwm_cor_max Cxx_cp_pwm_efv_fac_zero Cxx_cp_pwm_max_1 Cxx_cp_pwm_max_2 Cxx_cp_pwm_max_3 Cxx_cp_pwm_max_4 Cxx_cp_pwm_min_1 Cxx_cp_pwm_min_2 Cxx_cp_pwm_sp1 Cxx_cp_pwm_sp2 Cxx_cp_pwm_sp3 Cxx_cp_pwm_sp4 Cxx_cp_pwm_sp_zero Cxx_cp_pwm_step_1 Cxx_cp_pwm_step_2 Cxx_cp_pwm_step_3 Cxx_cp_pwm_step_4 Cxx_cp_pwm_step_5 /end DEF_CHARACTERISTIC
 /begin OUT_MEASUREMENT Vbx_cp_clc_cdn Vbx_cp_cmd_frq Vxx_cp_pwm Vxx_cp_pwm_appl Vxx_cp_pwm_cmd Vxx_cp_pwm_cor Vxx_cp_pwm_efv_fac Vxx_cp_pwm_fac Vxx_cp_pwm_max Vxx_cp_pwm_min Vxx_cp_pwm_sp Vxx_cp_pwm_sp_cor Vxx_cp_pwm_step Vxx_cp_pwm_step_cor /end OUT_MEASUREMENT
/end FUNCTION
/begin FUNCTION CbRicCan_Cpopenx ""
 /begin DEF_CHARACTERISTIC Ctp_tco_is_l_it_psn Cxx_cp_ad_tco_min_thd Cxx_cp_ad_thd Cxx_cp_is_tco_min_thd Cxx_cp_is_tia_min_thd Cxx_cp_max_ad_dly Cxx_cp_max_dly Cxx_cp_max_prs_thd Cxx_cp_min_ad_dly Cxx_cp_min_dly Cxx_cp_n_thd Cxx_cp_ol_tco_min_thd Cxx_cp_rtn_dly_dec Cxx_cp_stab_dly Cxx_cp_tco_min_thd Cxx_cp_tia_min_thd /end DEF_CHARACTERISTIC
 /begin OUT_MEASUREMENT Vbx_cp_eng_cdn_cl_ena Vbx_cp_eng_cdn_is_ena Vbx_cp_eng_cdn_ol_ena Vbx_cp_eng_cdn_sp_ena Vbx_cp_fct Vbx_cp_fct_ad Vbx_cp_load_ad Vbx_cp_req Vbx_cp_req_ad Vbx_cp_stop_ad Vbx_l_is_it_psn Vsx_cp Vxx_ad_cp_dly Vxx_ad_cp_fct_dly Vxx_cp_dly Vxx_cp_rtn_dly Vxx_mv_cl_ti_fac_cp_dly /end OUT_MEASUREMENT
/end FUNCTION
/begin FUNCTION OuCboIgn "" /begin SUB_FUNCTION OuCboIgn_Dwellxx OuCboIgn_Igncutx OuCboIgn_Dgigcxx /end SUB_FUNCTION /end FUNCTION
/begin FUNCTION OuCboIgn_Dwellxx ""
 /begin DEF_CHARACTERISTIC Cxx_igc_stt_dly Cxx_igc_stt_tco_thd Cxx_pap_dwl Cxx_td_stab_min Cxx_td_tra_auth_max Cxx_tra_dwl /end DEF_CHARACTERISTIC
 /begin OUT_MEASUREMENT Vbx_boost_td Vbx_igc_stt_ena Vbx_trs_td Vxx_ctr_tdc_aftr_trs Vxx_igc_stt_td Vxx_td_stab_min Vxx_td_tra_max /end OUT_MEASUREMENT
/end FUNCTION
/begin FUNCTION OuCboIgn_Igncutx "" /begin DEF_CHARACTERISTIC Cbx_mis_bch_mod Cxx_mis_bch_mis_rat /end DEF_CHARACTERISTIC
 /begin OUT_MEASUREMENT Vbx_ign_cut_cyl1 Vbx_ign_cut_cyl2 Vbx_ign_cut_cyl3 Vbx_ign_cut_cyl4 Vbx_mis_bch_cyl_0 Vbx_mis_bch_cyl_1 Vbx_mis_bch_cyl_2 Vbx_mis_bch_cyl_3 Vbx_mis_bch_igc_cut_req /end OUT_MEASUREMENT
/end FUNCTION
/begin FUNCTION OuCboIgn_Dgigcxx ""
 /begin DEF_CHARACTERISTIC Cxx_dfdec_igc_1_oc Cxx_dfdec_igc_1_scg Cxx_dfdec_igc_1_scw Cxx_dfdec_igc_2_oc Cxx_dfdec_igc_2_scg Cxx_dfdec_igc_2_scw Cxx_dfdec_igc_3_oc Cxx_dfdec_igc_3_scg Cxx_dfdec_igc_3_scw Cxx_dfdec_igc_4_oc Cxx_dfdec_igc_4_scg Cxx_dfdec_igc_4_scw Cxx_dfinc_igc_1_oc Cxx_dfinc_igc_1_scg Cxx_dfinc_igc_1_scw Cxx_dfinc_igc_2_oc Cxx_dfinc_igc_2_scg Cxx_dfinc_igc_2_scw Cxx_dfinc_igc_3_oc Cxx_dfinc_igc_3_scg Cxx_dfinc_igc_3_scw Cxx_dfinc_igc_4_oc Cxx_dfinc_igc_4_scg Cxx_dfinc_igc_4_scw /end DEF_CHARACTERISTIC
 /begin OUT_MEASUREMENT Vsx_igc1_vld Vsx_igc2_vld Vsx_igc3_vld Vsx_igc4_vld Vsx_igc_vld /end OUT_MEASUREMENT
/end FUNCTION
/begin FUNCTION VfAcoMng ""
 /begin SUB_FUNCTION VfAcoMng_Acfanxx_xxxxxx VfAcoMng_Compxxx_xxxxxx VfAcoMng_Noacvxx_xxxxxx /end SUB_FUNCTION
/end FUNCTION
/begin FUNCTION VfAcoMng_Acfanxx_xxxxxx ""
 /begin DEF_CHARACTERISTIC Cxx_ac_mdf_prs_hys Cxx_ac_mdf_prs_thd1 Cxx_ac_mdf_prs_thd2 Cxx_ac_mdf_prs_thd3 Cxx_ac_mdf_secu_prs_hys Cxx_ac_mdf_secu_prs_thd Cxx_ac_mdf_vs_hys Cxx_ac_mdf_vs_thd1 Cxx_ac_mdf_vs_thd2 Cxx_ac_mdf_vs_thd3 Cxx_ac_mdf_vs_thd4 /end DEF_CHARACTERISTIC
 /begin OUT_MEASUREMENT Vbx_ac_mdf1_req_int Vbx_ac_mdf2_req_int Vxx_ac_prs_lvl /end OUT_MEASUREMENT
/end FUNCTION
/begin FUNCTION VfAcoMng_Compxxx_xxxxxx ""
 /begin DEF_CHARACTERISTIC Cxx_ac_bfr_clu_dly Cxx_ac_clu_dly Cxx_ac_dclu_dly Cxx_ac_ext_clu_dly Cxx_ac_ext_dclu_dly Cxx_ac_rly_prot_dly /end DEF_CHARACTERISTIC
 /begin OUT_MEASUREMENT Vbx_ac_clu_dsb Vbx_ac_clu_ena Vbx_ac_dclu_dsb Vbx_ac_dsb Vsx_ac_cmd Vsx_acr_stt Vxx_ac_cmd_dly Vxx_ac_stt_dly /end OUT_MEASUREMENT
/end FUNCTION
/end MODULE
/end PROJECT
