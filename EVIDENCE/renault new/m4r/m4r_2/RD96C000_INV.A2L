ASAP2_VERSION 1 41
/begin PROJECT RD8 "_default_ProjectLongIdentifier"
/begin HEADER "_default_HeaderComment" PROJECT_NO RD9 /end HEADER
/begin MODULE _default_ModuleName "_default_ModuleLongIdentifier"
/begin MOD_COMMON "_default_ModCommonComment" DEPOSIT ABSOLUTE BYTE_ORDER MSB_LAST ALIGNMENT_BYTE 1 ALIGNMENT_WORD 2 ALIGNMENT_LONG 2 ALIGNMENT_FLOAT32_IEEE 2 ALIGNMENT_FLOAT64_IEEE 4 /end MOD_COMMON
/begin MEASUREMENT ABSinRegulation "Received CAN parameter" UBYTE _CNV_A_R_ECME_LINEA_0_CM 1 0. 0. 1. ECU_ADDRESS 0xd00046b2 FORMAT "%1.0" /end MEASUREMENT
/begin MEASUREMENT ACCompClutchRequest "Received CAN parameter" UBYTE _CNV_A_R_ECME_LINEA_0_CM 1 0. 0. 1. ECU_ADDRESS 0xd000503c FORMAT "%1.0" /end MEASUREMENT
/begin MEASUREMENT ACCompClutchStatus "Received CAN parameter" UBYTE _CNV_A_R_ECME_LINEA_0_CM 1 0. 0. 1. ECU_ADDRESS 0xd00046b3 FORMAT "%1.0" /end MEASUREMENT
/begin MEASUREMENT ACCompPowerUsed "Received CAN parameter" UBYTE _CNV_A_R_ECME_LINEA_0_CM 1 0. 0. 255. ECU_ADDRESS 0xd00046b4 FORMAT "%3.0" /end MEASUREMENT
/begin MEASUREMENT ACCompRequest "Received CAN parameter" UBYTE _CNV_A_R_ECME_LINEA_0_CM 1 0. 0. 1. ECU_ADDRESS 0xd00046b5 FORMAT "%1.0" /end MEASUREMENT
/begin MEASUREMENT ACCoolingFanSpeedRequest "Received CAN parameter" UBYTE _CNV_A_R_ECME_LINEA_0_CM 1 0. 0. 3. ECU_ADDRESS 0xd00046b6 FORMAT "%1.0" /end MEASUREMENT
/begin MEASUREMENT ACMinEngineIdleSpeedRequest "Received CAN parameter" UBYTE _CNV_A_R_ECME_LINEA_0_CM 1 0. 0. 15. ECU_ADDRESS 0xd00046b7 FORMAT "%2.0" /end MEASUREMENT
/begin MEASUREMENT ASRDynamicTorqueRequest "Received CAN parameter" UWORD _CNV_A_R_ECME_LINEA_0_CM 1 0. 0. 4095. ECU_ADDRESS 0xd00039e2 FORMAT "%4.0" /end MEASUREMENT
/begin MEASUREMENT ASRStaticTorqueRequest "Received CAN parameter" UWORD _CNV_A_R_ECME_LINEA_0_CM 1 0. 0. 4095. ECU_ADDRESS 0xd00039e4 FORMAT "%4.0" /end MEASUREMENT
/begin MEASUREMENT ASRinRegulation "Received CAN parameter" UBYTE _CNV_A_R_ECME_LINEA_0_CM 1 0. 0. 1. ECU_ADDRESS 0xd00046b8 FORMAT "%1.0" /end MEASUREMENT
/begin MEASUREMENT ATCoolingFanSpeedRequest "Received CAN parameter" UBYTE _CNV_A_R_ECME_LINEA_0_CM 1 0. 0. 3. ECU_ADDRESS 0xd00046b9 FORMAT "%1.0" /end MEASUREMENT
/begin MEASUREMENT AT_Clock "Received CAN parameter" UBYTE _CNV_A_R_ECME_LINEA_0_CM 1 0. 0. 15. ECU_ADDRESS 0xd00046ba FORMAT "%2.0" /end MEASUREMENT
/begin MEASUREMENT AT_MILRequest "Received CAN parameter" UBYTE _CNV_A_R_ECME_LINEA_0_CM 1 0. 0. 7. ECU_ADDRESS 0xd00046bb FORMAT "%1.0" /end MEASUREMENT
/begin MEASUREMENT AT_Minimum_IdleSpeedRequest "Received CAN parameter" UBYTE _CNV_A_R_ECME_LINEA_0_CM 1 0. 0. 255. ECU_ADDRESS 0xd00046bc FORMAT "%3.0" /end MEASUREMENT
/begin MEASUREMENT AT_TorqueControlType "Received CAN parameter" UBYTE _CNV_A_R_ECME_LINEA_0_CM 1 0. 0. 7. ECU_ADDRESS 0xd00046bd FORMAT "%1.0" /end MEASUREMENT
/begin MEASUREMENT AT_TorqueLosses "Received CAN parameter" UBYTE _CNV_A_R_ECME_LINEA_0_CM 1 0. 0. 255. ECU_ADDRESS 0xd00046be FORMAT "%3.0" /end MEASUREMENT
/begin MEASUREMENT AYCinRegulation "Received CAN parameter" UBYTE _CNV_A_R_ECME_LINEA_0_CM 1 0. 0. 1. ECU_ADDRESS 0xd000503d FORMAT "%1.0" /end MEASUREMENT
/begin MEASUREMENT AccurateOdometer "Received CAN parameter" UBYTE _CNV_A_R_ECME_LINEA_0_CM 1 0. 0. 31. ECU_ADDRESS 0xd000503e FORMAT "%2.0" /end MEASUREMENT
/begin MEASUREMENT AirbagCrashOrder "Received CAN parameter" UWORD _CNV_A_R_ECME_LINEA_0_CM 1 0. 0. 65535. ECU_ADDRESS 0xd00059b0 FORMAT "%5.0" /end MEASUREMENT
/begin MEASUREMENT AlternatorLoad "Received CAN parameter" UBYTE _CNV_A_R_ECME_LINEA_0_CM 1 0. 0. 255. ECU_ADDRESS 0xd00046bf FORMAT "%3.0" /end MEASUREMENT
/begin MEASUREMENT AnticipatedCurrentShift "Received CAN parameter" UBYTE _CNV_A_R_ECME_LINEA_0_CM 1 0. 0. 3. ECU_ADDRESS 0xd00046c0 FORMAT "%3.0" /end MEASUREMENT
/begin MEASUREMENT BrakeInfoStatus "Received CAN parameter" UBYTE _CNV_A_R_ECME_LINEA_0_CM 1 0. 0. 7. ECU_ADDRESS 0xd00046c1 FORMAT "%1.0" /end MEASUREMENT
/begin MEASUREMENT BrakeSwitchFailure "Received CAN parameter" UBYTE _CNV_A_R_ECME_LINEA_0_CM 1 0. 0. 3. ECU_ADDRESS 0xd00046c2 FORMAT "%1.0" /end MEASUREMENT
/begin MEASUREMENT ClimateCoolingRequest "Received CAN parameter" UBYTE _CNV_A_R_ECME_LINEA_0_CM 1 0. 0. 1. ECU_ADDRESS 0xd000503f FORMAT "%1.0" /end MEASUREMENT
/begin MEASUREMENT ClutchSwitchMaximumTravel "Received CAN parameter" UBYTE _CNV_A_R_ECME_LINEA_0_CM 1 0. 0. 3. ECU_ADDRESS 0xd00046c3 FORMAT "%1.0" /end MEASUREMENT
/begin MEASUREMENT ClutchSwitchMinimumTravel "Received CAN parameter" UBYTE _CNV_A_R_ECME_LINEA_0_CM 1 0. 0. 3. ECU_ADDRESS 0xd00046c4 FORMAT "%1.0" /end MEASUREMENT
/begin MEASUREMENT DiagMuxOn_BCM "Received CAN parameter" UBYTE _CNV_A_R_ECME_LINEA_0_CM 1 0. 0. 1. ECU_ADDRESS 0xd00046c5 FORMAT "%1.0" /end MEASUREMENT
/begin MEASUREMENT DiagnoseFuelLow "Received CAN parameter" UBYTE _CNV_A_R_ECME_LINEA_0_CM 1 0. 0. 3. ECU_ADDRESS 0xd0005040 FORMAT "%1.0" /end MEASUREMENT
/begin MEASUREMENT DisplayedSpeed "Received CAN parameter" UWORD _CNV_A_R_ECME_LINEA_0_CM 1 0. 0. 65535. ECU_ADDRESS 0xd00059b2 FORMAT "%5.0" /end MEASUREMENT
/begin MEASUREMENT DisplayedSpeedUnit "Received CAN parameter" UBYTE _CNV_A_R_ECME_LINEA_0_CM 1 0. 0. 1. ECU_ADDRESS 0xd0005041 FORMAT "%1.0" /end MEASUREMENT
/begin MEASUREMENT DistanceTotalizer "Received CAN parameter" ULONG _CNV_A_R_ECME_LINEA_0_CM 1 0. 0. 268435455. ECU_ADDRESS 0xd0002b78 FORMAT "%9.0" /end MEASUREMENT
/begin MEASUREMENT ESP_Clock "Received CAN parameter" UBYTE _CNV_A_R_ECME_LINEA_0_CM 1 0. 0. 15. ECU_ADDRESS 0xd00046c6 FORMAT "%2.0" /end MEASUREMENT
/begin MEASUREMENT ESP_TorqueControlType "Received CAN parameter" UBYTE _CNV_A_R_ECME_LINEA_0_CM 1 0. 0. 7. ECU_ADDRESS 0xd00046c7 FORMAT "%1.0" /end MEASUREMENT
/begin MEASUREMENT ElectricalPowerDrived "Received CAN parameter" UBYTE _CNV_A_R_ECME_LINEA_0_CM 1 0. 0. 31. ECU_ADDRESS 0xd0005042 FORMAT "%2.0" /end MEASUREMENT
/begin MEASUREMENT EmergencyEngineStop "Received CAN parameter" UBYTE _CNV_A_R_ECME_LINEA_0_CM 1 0. 0. 15. ECU_ADDRESS 0xd00046c8 FORMAT "%2.0" /end MEASUREMENT
/begin MEASUREMENT ExternalTemp "Received CAN parameter" UBYTE _CNV_A_R_ECME_LINEA_0_CM 1 0. 0. 255. ECU_ADDRESS 0xd00046c9 FORMAT "%3.0" /end MEASUREMENT
/begin MEASUREMENT FastTorqueRequest "Received CAN parameter" UWORD _CNV_A_R_ECME_LINEA_0_CM 1 0. 0. 4095. ECU_ADDRESS 0xd00039e6 FORMAT "%4.0" /end MEASUREMENT
/begin MEASUREMENT FrontDefrostEngaged "Received CAN parameter" UBYTE _CNV_A_R_ECME_LINEA_0_CM 1 0. 0. 1. ECU_ADDRESS 0xd00046ca FORMAT "%1.0" /end MEASUREMENT
/begin MEASUREMENT FuelCutRequestedEngineSpeed "Received CAN parameter for engine speed limitation from EGB (CVT, ...)" UBYTE _CNV_A_R_ECME_LINEA_0_CM 1 0. 0. 255. ECU_ADDRESS 0xd00046cb FORMAT "%3.0" /end MEASUREMENT
/begin MEASUREMENT FuelLevelDisplayed "Received CAN parameter" UBYTE _CNV_A_R_ECME_LINEA_0_CM 1 0. 0. 127. ECU_ADDRESS 0xd0005043 FORMAT "%3.0" /end MEASUREMENT
/begin MEASUREMENT FuelLow "Received CAN parameter" UBYTE _CNV_A_R_ECME_LINEA_0_CM 1 0. 0. 1. ECU_ADDRESS 0xd0005044 FORMAT "%1.0" /end MEASUREMENT
/begin MEASUREMENT GenericApplicativeDiagEnable "Received CAN parameter" UBYTE _CNV_A_R_ECME_LINEA_0_CM 1 0. 0. 3. ECU_ADDRESS 0xd00046cc FORMAT "%1.0" /end MEASUREMENT
/begin MEASUREMENT InputShaftRevolution "Received CAN parameter" UWORD _CNV_A_R_ECME_LINEA_0_CM 1 0. 0. 65535. ECU_ADDRESS 0xd00039e8 FORMAT "%5.0" /end MEASUREMENT
/begin MEASUREMENT InstantMecanicalPowerByAlt "Received CAN parameter" UBYTE _CNV_A_R_ECME_LINEA_0_CM 1 0. 0. 255. ECU_ADDRESS 0xd00046cd FORMAT "%3.0" /end MEASUREMENT
/begin MEASUREMENT KeyVehicle "Received CAN parameter" UBYTE _CNV_A_R_ECME_LINEA_0_CM 1 0. 0. 3. ECU_ADDRESS 0xd0005045 FORMAT "%1.0" /end MEASUREMENT
/begin MEASUREMENT Limit_SlowTorqueRequest "Received CAN parameter" UWORD _CNV_A_R_ECME_LINEA_0_CM 1 0. 0. 4095. ECU_ADDRESS 0xd00039ea FORMAT "%4.0" /end MEASUREMENT
/begin MEASUREMENT MSRTorqueRequest " Received CAN parameter" UWORD _CNV_A_R_ECME_LINEA_0_CM 1 0. 0. 4095. ECU_ADDRESS 0xd00039ec FORMAT "%4.0" /end MEASUREMENT
/begin MEASUREMENT MSRinRegulation "Received CAN parameter" UBYTE _CNV_A_R_ECME_LINEA_0_CM 1 0. 0. 1. ECU_ADDRESS 0xd00046ce FORMAT "%1.0" /end MEASUREMENT
/begin MEASUREMENT MiniConsumptionRequest "Received CAN parameter" UBYTE _CNV_A_R_ECME_LINEA_0_CM 1 0. 0. 3. ECU_ADDRESS 0xd00046cf FORMAT "%1.0" /end MEASUREMENT
/begin MEASUREMENT NeutralContact "Received CAN parameter" UBYTE _CNV_A_R_ECME_LINEA_0_CM 1 0. 0. 3. ECU_ADDRESS 0xd00046d0 FORMAT "%1.0" /end MEASUREMENT
/begin MEASUREMENT OilDrainAlertResetRequest "Received CAN parameter" UBYTE _CNV_A_R_ECME_LINEA_0_CM 1 0. 0. 1. ECU_ADDRESS 0xd0005046 FORMAT "%1.0" /end MEASUREMENT
/begin MEASUREMENT PTCEngineIdleSpeedRequest "Received CAN parameter" UBYTE _CNV_A_R_ECME_LINEA_0_CM 1 0. 0. 1. ECU_ADDRESS 0xd0005047 FORMAT "%1.0" /end MEASUREMENT
/begin MEASUREMENT ParkingBrakeStatus "Received CAN parameter" UBYTE _CNV_A_R_ECME_LINEA_0_CM 1 0. 0. 3. ECU_ADDRESS 0xd00046d1 FORMAT "%1.0" /end MEASUREMENT
/begin MEASUREMENT RearDefrostEngaged "Received CAN parameter" UBYTE _CNV_A_R_ECME_LINEA_0_CM 1 0. 0. 1. ECU_ADDRESS 0xd0005048 FORMAT "%1.0" /end MEASUREMENT
/begin MEASUREMENT RearGearEngaged "Received CAN parameter" UBYTE _CNV_A_R_ECME_LINEA_0_CM 1 0. 0. 3. ECU_ADDRESS 0xd00046d2 FORMAT "%1.0" /end MEASUREMENT
/begin MEASUREMENT SLockValueControl "Received CAN parameter" UBYTE _CNV_A_R_ECME_LINEA_0_CM 1 0. 0. 31. ECU_ADDRESS 0xd0005049 FORMAT "%2.0" /end MEASUREMENT
/begin MEASUREMENT SoftwareLockValue[0] "Received CAN parameter" UBYTE _CNV_A_R_ECME_LINEA_0_CM 1 0. 0. 255. ECU_ADDRESS 0xd0005038 FORMAT "%3.0" /end MEASUREMENT
/begin MEASUREMENT SoftwareLockValue[1] "Received CAN parameter" UBYTE _CNV_A_R_ECME_LINEA_0_CM 1 0. 0. 255. ECU_ADDRESS 0xd0005039 FORMAT "%3.0" /end MEASUREMENT
/begin MEASUREMENT SoftwareLockValue[2] "Received CAN parameter" UBYTE _CNV_A_R_ECME_LINEA_0_CM 1 0. 0. 255. ECU_ADDRESS 0xd000503a FORMAT "%3.0" /end MEASUREMENT
/begin MEASUREMENT SoftwareLockValue[3] "Received CAN parameter" UBYTE _CNV_A_R_ECME_LINEA_0_CM 1 0. 0. 255. ECU_ADDRESS 0xd000503b FORMAT "%3.0" /end MEASUREMENT
/begin MEASUREMENT SportivityCriteria "Received CAN parameter" UBYTE _CNV_A_R_ECME_LINEA_0_CM 1 0. 0. 255. ECU_ADDRESS 0xd00046d3 FORMAT "%3.0" /end MEASUREMENT
/begin MEASUREMENT StartButtonPushed "Received CAN parameter" UBYTE _CNV_A_R_ECME_LINEA_0_CM 1 0. 0. 7. ECU_ADDRESS 0xd000504a FORMAT "%1.0" /end MEASUREMENT
/begin MEASUREMENT StarterStatus "Received CAN parameter" UBYTE _CNV_A_R_ECME_LINEA_0_CM 1 0. 0. 3. ECU_ADDRESS 0xd00046d4 FORMAT "%1.0" /end MEASUREMENT
/begin MEASUREMENT StartingMode_BCM_R "Received CAN parameter" UBYTE _CNV_A_R_ECME_LINEA_0_CM 1 0. 0. 3. ECU_ADDRESS 0xd00046d5 FORMAT "%1.0" /end MEASUREMENT
/begin MEASUREMENT SteeringWheelAngle "Received CAN parameter" UWORD _CNV_A_R_ECME_LINEA_0_CM 1 0. 0. 65535. ECU_ADDRESS 0xd00039ee FORMAT "%5.0" /end MEASUREMENT
/begin MEASUREMENT TorqueConverterState "Received CAN parameter" UBYTE _CNV_A_R_ECME_LINEA_0_CM 1 0. 0. 3. ECU_ADDRESS 0xd00046d6 FORMAT "%1.0" /end MEASUREMENT
/begin MEASUREMENT TransmRangeEngaged_Current "Received CAN parameter" UBYTE _CNV_A_R_ECME_LINEA_0_CM 1 0. 0. 15. ECU_ADDRESS 0xd00046d7 FORMAT "%2.0" /end MEASUREMENT
/begin MEASUREMENT TransmRangeEngaged_Target "Received CAN parameter" UBYTE _CNV_A_R_ECME_LINEA_0_CM 1 0. 0. 15. ECU_ADDRESS 0xd00046d8 FORMAT "%2.0" /end MEASUREMENT
/begin MEASUREMENT TransversalAcceleration "Received CAN parameter" UWORD _CNV_A_R_ECME_LINEA_0_CM 1 0. 0. 65535. ECU_ADDRESS 0xd00039f0 FORMAT "%5.0" /end MEASUREMENT
/begin MEASUREMENT VehicleSpeed "Received CAN parameter" UWORD _CNV_A_R_ECME_LINEA_0_CM 1 0. 0. 65535. ECU_ADDRESS 0xd00039f2 FORMAT "%5.0" /end MEASUREMENT
/begin MEASUREMENT WheelSpeedRL "Received CAN parameter" UWORD _CNV_A_R_ECME_LINEA_0_CM 1 0. 0. 65535. ECU_ADDRESS 0xd00039f4 FORMAT "%5.0" /end MEASUREMENT
/begin MEASUREMENT WheelSpeedRR "Received CAN parameter" UWORD _CNV_A_R_ECME_LINEA_0_CM 1 0. 0. 65535. ECU_ADDRESS 0xd00039f6 FORMAT "%5.0" /end MEASUREMENT
/begin MEASUREMENT AlternatorMaximumPower "Transmitted CAN parameter" UBYTE _CNV_A_R_ECME_LINEA_0_CM 1 0. 0. 255. ECU_ADDRESS 0xd0004d9f FORMAT "%3.0" /end MEASUREMENT
/begin MEASUREMENT MinimumInstantTorque "Transmitted CAN parameter" UWORD _CNV_A_R_ECME_LINEA_0_CM 1 0. 0. 4095. ECU_ADDRESS 0xd00038e4 FORMAT "%4.0" /end MEASUREMENT
/begin MEASUREMENT EngineRPM "Transmitted CAN parameter" UWORD _CNV_A_R_ECME_LINEA_0_CM 1 0. 0. 65535. ECU_ADDRESS 0xd0002f3c FORMAT "%5.0" /end MEASUREMENT
/begin MEASUREMENT FreeShift "Transmitted CAN parameter" UBYTE _CNV_A_R_ECME_LINEA_0_CM 1 0. 0. 3. ECU_ADDRESS 0xd0005759 FORMAT "%1.0" /end MEASUREMENT
/begin CHARACTERISTIC Cxx_free_shf_dft_val "value send if free shit can't be calculated (0 or 3)" VALUE 0xa00217fd _REC_S1VAL_20_u1 3. _CNV_A_R_ECME_LINEA_0_CM 0. 3. FORMAT "%1.0" /end CHARACTERISTIC
/begin CHARACTERISTIC Cxx_free_shf_ini_val "Freeshift initial value sent on the CAN." VALUE 0xa00217fe _REC_S1VAL_20_u1 3. _CNV_A_R_ECME_LINEA_0_CM 0. 3. FORMAT "%3.0" /end CHARACTERISTIC
/begin MEASUREMENT ACHighPressureSensor "Transmitted CAN parameter" UWORD _CNV_A_R_ECME_LINEA_0_CM 1 0. 0. 511. ECU_ADDRESS 0xd0003b62 FORMAT "%3.0" /end MEASUREMENT
/begin MEASUREMENT CCSpeedReachedDisplayReq "Transmitted CAN parameter" UBYTE _CNV_A_R_ECME_LINEA_0_CM 1 0. 0. 1. ECU_ADDRESS 0xd00050bf FORMAT "%1.0" /end MEASUREMENT
/begin MEASUREMENT CrankingAuthorization_ECM "Transmitted CAN parameter" UBYTE _CNV_A_R_ECME_LINEA_0_CM 1 0. 0. 3. ECU_ADDRESS 0xd0004311 FORMAT "%1.0" /end MEASUREMENT
/begin MEASUREMENT CruiseControlStatusDisplay "Transmitted CAN parameter" UBYTE _CNV_A_R_ECME_LINEA_0_CM 1 0. 0. 7. ECU_ADDRESS 0xd00050bc FORMAT "%1.0" /end MEASUREMENT
/begin MEASUREMENT CruiseControlStatus_forTM "Transmitted CAN parameter" UBYTE _CNV_A_R_ECME_LINEA_0_CM 1 0. 0. 3. ECU_ADDRESS 0xd0004312 FORMAT "%1.0" /end MEASUREMENT
/begin MEASUREMENT EngineFanSpeedRequest "Transmitted CAN parameter" UBYTE _CNV_A_R_ECME_LINEA_0_CM 1 0. 0. 3. ECU_ADDRESS 0xd0004313 FORMAT "%1.0" /end MEASUREMENT
/begin MEASUREMENT EngineStopRequestOrigine "Transmitted CAN parameter" UBYTE _CNV_A_R_ECME_LINEA_0_CM 1 0. 0. 15. ECU_ADDRESS 0xd0004314 FORMAT "%2.0" /end MEASUREMENT
/begin MEASUREMENT OverspeedIndicationDisplayReq "Transmitted CAN parameter" UBYTE _CNV_A_R_ECME_LINEA_0_CM 1 0. 0. 1. ECU_ADDRESS 0xd00050bd FORMAT "%1.0" /end MEASUREMENT
/begin MEASUREMENT RequestedSpeedDisplayRequest "Transmitted CAN parameter" UBYTE _CNV_A_R_ECME_LINEA_0_CM 1 0. 0. 255. ECU_ADDRESS 0xd00050be FORMAT "%3.0" /end MEASUREMENT
/begin MEASUREMENT ParticulateFilterFailureDisplay "Transmitted CAN parameter" UBYTE _CNV_A_R_ECME_LINEA_0_CM 1 0. 0. 1. ECU_ADDRESS 0xd000538b FORMAT "%1.0" /end MEASUREMENT
/begin MEASUREMENT ParticulateFilterState "Transmitted CAN parameter" UBYTE _CNV_A_R_ECME_LINEA_0_CM 1 0. 0. 1. ECU_ADDRESS 0xd0005057 FORMAT "%1.0" /end MEASUREMENT
/begin MEASUREMENT EngineStatus_R "Transmitted CAN parameter" UBYTE _CNV_A_R_ECME_LINEA_0_CM 1 0. 0. 3. ECU_ADDRESS 0xd0004824 FORMAT "%1.0" /end MEASUREMENT
/begin MEASUREMENT MaxEngineSpeedRequest "Transmitted CAN parameter" UBYTE _CNV_A_R_ECME_LINEA_0_CM 1 0. 0. 255. ECU_ADDRESS 0xd000577e FORMAT "%3.0" /end MEASUREMENT
/begin MEASUREMENT MinEngineSpeedRequest "Transmitted CAN parameter" UBYTE _CNV_A_R_ECME_LINEA_0_CM 1 0. 0. 255. ECU_ADDRESS 0xd000577f FORMAT "%3.0" /end MEASUREMENT
/begin MEASUREMENT KickDownActivated "Transmitted CAN parameter" UBYTE _CNV_A_R_ECME_LINEA_0_CM 1 0. 0. 1. ECU_ADDRESS 0xd0004412 FORMAT "%1.0" /end MEASUREMENT
/begin MEASUREMENT PedalError "Transmitted CAN parameter" UBYTE _CNV_A_R_ECME_LINEA_0_CM 1 0. 0. 3. ECU_ADDRESS 0xd0004413 FORMAT "%1.0" /end MEASUREMENT
/begin MEASUREMENT PowerTrainSetPoint "Transmitted CAN parameter" UWORD _CNV_A_R_ECME_LINEA_0_CM 1 0. 0. 1023. ECU_ADDRESS 0xd000333e FORMAT "%2.0" /end MEASUREMENT
/begin MEASUREMENT RawSensor "Transmitted CAN parameter" UWORD _CNV_A_R_ECME_LINEA_0_CM 1 0. 0. 1023. ECU_ADDRESS 0xd0003340 FORMAT "%2.0" /end MEASUREMENT
/begin CHARACTERISTIC Cbx_acel_pdl_rat_secu_1_cfm "Configuration of the value sent on CAN during detected failure of reversible pedal safety case" VALUE 0xa002190c _REC_S1VAL_20_u1 1. _CNV_S_2_RANGE______3_CM 0. 1. /end CHARACTERISTIC
/begin CHARACTERISTIC Cbx_mux_driv_pwt_sp_fail "Configuration of invalid value of Powertrain Setpoint CAN signal." VALUE 0xa002190d _REC_S1VAL_20_u1 1. _CNV_S_2_RANGE______3_CM 0. 1. /end CHARACTERISTIC
/begin CHARACTERISTIC Cxx_acel_pdl_rat_secu_1_val "Value sent on CAN during detected failure of accelerator pedal safety case N∞1 (reversible)" VALUE 0xa002190a _REC_S1VAL_20_u2 1.25 _CNV_A_R_LINEAR_____211_CM 0. 1.25 FORMAT "%7.5" /end CHARACTERISTIC
/begin MEASUREMENT MaximumInstantTorque "Transmitted CAN parameter" UWORD _CNV_A_R_ECME_LINEA_0_CM 1 0. 0. 4095. ECU_ADDRESS 0xd0002fd4 /end MEASUREMENT
/begin MEASUREMENT MaxElectricalPowerAllowed "Transmitted CAN parameter" UBYTE _CNV_A_R_ECME_LINEA_0_CM 1 0. 0. 31. ECU_ADDRESS 0xd00042a2 FORMAT "%2.0" /end MEASUREMENT
/begin MEASUREMENT ECM_TorqueRequestStatus "Transmitted CAN parameter" UBYTE _CNV_A_R_ECME_LINEA_0_CM 1 0. 0. 3. ECU_ADDRESS 0xd0003f6e FORMAT "%1.0" /end MEASUREMENT
/begin MEASUREMENT FrictionTorque "Transmitted CAN parameter" UWORD _CNV_A_R_ECME_LINEA_0_CM 1 0. 0. 4095. ECU_ADDRESS 0xd0002de4 /end MEASUREMENT
/begin MEASUREMENT IdleSpeedControlInternalRequest "Transmitted CAN parameter" UBYTE _CNV_A_R_ECME_LINEA_0_CM 1 0. 0. 255. ECU_ADDRESS 0xd0005713 FORMAT "%3.0" /end MEASUREMENT
/begin MEASUREMENT AllowedPowerGradient "Transmitted CAN parameter" UBYTE _CNV_A_R_ECME_LINEA_0_CM 1 0. 0. 255. ECU_ADDRESS 0xd0004157 FORMAT "%3.0" /end MEASUREMENT
/begin MEASUREMENT Vbx_mux_acs_acel_is_req "Request of idle speed acceleration for accessories received on the CAN" UBYTE _CNV_S_2_RANGE______3_CM 1 0. 0. 1. ECU_ADDRESS 0xd00054e6 BIT_MASK 0x1 /end MEASUREMENT
/begin MEASUREMENT Vsx_mux_acs_acel_is_req_vld "Request of idle speed acceleration for accessories received on the CAN validity status" UBYTE _CNV_A_R_ECME_LINEA_0_CM 1 0. 0. 2. ECU_ADDRESS 0xd00054e7 FORMAT "%1.0" /end MEASUREMENT
/begin MEASUREMENT Vbx_mux_agb_is_acel_req "AT Idle speed setpoint acceleration request from CAN" UBYTE _CNV_S_2_RANGE______3_CM 1 0. 0. 1. ECU_ADDRESS 0xd00051ae BIT_MASK 0x1 /end MEASUREMENT
/begin MEASUREMENT Vsx_mux_agb_is_acel_req_vld "CAN message validity : Idle speed setpoint acceleration request by AT" UBYTE _CNV_A_R_ECME_LINEA_0_CM 1 0. 0. 2. ECU_ADDRESS 0xd00051af FORMAT "%1.0" /end MEASUREMENT
/begin MEASUREMENT Vbx_mux_agb_is_acel_sp_navl "indicates that AT minimum idle speed is unavailable" UBYTE _CNV_S_2_RANGE______3_CM 1 0. 0. 1. ECU_ADDRESS 0xd0004fef BIT_MASK 0x1 /end MEASUREMENT
/begin MEASUREMENT Vsx_mux_agb_is_acel_sp_vld "Automated Gearbox idle speed setpoint CAN validity status" UBYTE _CNV_S_3_STATUS_OK__120_CM 1 0. 0. 2. ECU_ADDRESS 0xd0004ff0 /end MEASUREMENT
/begin MEASUREMENT Vxx_mux_agb_is_acel_sp "Automatic Transmission idle speed setpoint acceleration required received on CAN" UWORD _CNV_A_R_LINEAR_____399_CM 1 0. 0. 16383.75 ECU_ADDRESS 0xd00036f6 FORMAT "%8.2" /end MEASUREMENT
/begin MEASUREMENT ElectricalPowerCutFreeze "Transmitted CAN parameter" UBYTE _CNV_A_R_ECME_LINEA_0_CM 1 0. 0. 3. ECU_ADDRESS 0xd0004a40 FORMAT "%1.0" /end MEASUREMENT
/begin MEASUREMENT MeanEffectiveTorque "Transmitted CAN parameter" UWORD _CNV_A_R_ECME_LINEA_0_CM 1 0. 0. 4095. ECU_ADDRESS 0xd0003872 FORMAT "%4.0" /end MEASUREMENT
/begin MEASUREMENT Vbx_mux_ptc_pow_navl "PTC power from CAN is not available" UBYTE _CNV_S_2_RANGE______3_CM 1 0. 0. 1. ECU_ADDRESS 0xd0004766 BIT_MASK 0x1 /end MEASUREMENT
/begin MEASUREMENT Vsx_mux_ptc_pow_vld "PTC power (from CAN) validity status" UBYTE _CNV_S_3_STATUS_OK__120_CM 1 0. 0. 2. ECU_ADDRESS 0xd0005263 /end MEASUREMENT
/begin MEASUREMENT Vxx_mux_ptc_pow "PTC power consumed received from CAN" UWORD _CNV_A_R_LINEAR_____128_CM 1 0. 0. 655350. ECU_ADDRESS 0xd0005852 FORMAT "%6.0" /end MEASUREMENT
/begin MEASUREMENT Vbx_mux_lft_rwhs_navl "Indicates that the left right wheel speed received on the CAN is unavailable" UBYTE _CNV_S_2_RANGE______3_CM 1 0. 0. 1. ECU_ADDRESS 0xd0004889 BIT_MASK 0x1 /end MEASUREMENT
/begin MEASUREMENT Vbx_mux_rgt_rwhs_navl "Indicates that the rear right wheel speed received on the CAN is unavailable" UBYTE _CNV_S_2_RANGE______3_CM 1 0. 0. 1. ECU_ADDRESS 0xd000488a BIT_MASK 0x1 /end MEASUREMENT
/begin MEASUREMENT Vsx_mux_lft_rwhs_vld "Rear left wheel speed received on the CAN validity status" UBYTE _CNV_S_3_STATUS_OK__120_CM 1 0. 0. 2. ECU_ADDRESS 0xd000488b /end MEASUREMENT
/begin MEASUREMENT Vsx_mux_rgt_rwhs_vld "Rear right wheel speed received on the CAN validity status" UBYTE _CNV_S_3_STATUS_OK__120_CM 1 0. 0. 2. ECU_ADDRESS 0xd000488c /end MEASUREMENT
/begin MEASUREMENT Vxx_mux_lft_rwhs "Rear left wheel speed received on the CAN" UWORD _CNV_A_R_LINEAR_____70_CM 1 0. 0. 655.34 ECU_ADDRESS 0xd0003594 FORMAT "%6.2" /end MEASUREMENT
/begin MEASUREMENT Vxx_mux_rgt_rwhs "Rear right wheel speed received on the CAN" UWORD _CNV_A_R_LINEAR_____70_CM 1 0. 0. 655.34 ECU_ADDRESS 0xd0003596 FORMAT "%6.2" /end MEASUREMENT
/begin MEASUREMENT Vbx_mux_tra_acel_in_navl "Indicates that the transversal acceleration sensor received on the CAN is unavailable" UBYTE _CNV_S_2_RANGE______3_CM 1 0. 0. 1. ECU_ADDRESS 0xd000422d BIT_MASK 0x1 /end MEASUREMENT
/begin MEASUREMENT Vsx_mux_tra_acel_vld "Transversal acceleration sensor received on the CAN validity status" UBYTE _CNV_S_3_STATUS_OK__120_CM 1 0. 0. 2. ECU_ADDRESS 0xd000422e /end MEASUREMENT
/begin MEASUREMENT Vxx_mux_tra_acel "Transversal acceleration sensor received on the CAN" SLONG _CNV_A_R_LINEAR_____317_CM 1 0. -12. 13.5 ECU_ADDRESS 0xd0001d74 FORMAT "%8.4" /end MEASUREMENT
/begin MEASUREMENT Vxx_mux_agb_driv_spt_fac "Sportivity factor calculated by Automatic Transmission received on the CAN" UBYTE _CNV_A_R_LINEAR_____118_CM 1 0. 0. 1. ECU_ADDRESS 0xd0003fdf FORMAT "%9.7" /end MEASUREMENT
/begin MEASUREMENT Vbx_mux_agb_coup_navl "Indicates that the automatic gearbox coupler state received on the CAN is unavailable" UBYTE _CNV_S_2_RANGE______3_CM 1 0. 0. 1. ECU_ADDRESS 0xd0004f61 BIT_MASK 0x1 /end MEASUREMENT
/begin MEASUREMENT Vbx_mux_ant_crt_slc_navl "Indicates that the anticipated current gear shift is unavailable" UBYTE _CNV_S_2_RANGE______3_CM 1 0. 0. 1. ECU_ADDRESS 0xd0004f62 BIT_MASK 0x1 /end MEASUREMENT
/begin MEASUREMENT Vsx_mux_agb_coup "Automatic gearbox coupler state received on the CAN" UBYTE _CNV_A_R_ECME_LINEA_0_CM 1 0. 0. 255. ECU_ADDRESS 0xd0004f63 FORMAT "%3.0" /end MEASUREMENT
/begin MEASUREMENT Vsx_mux_agb_coup_vld "Automatic gearbox coupler state received on the CAN validity status" UBYTE _CNV_A_R_ECME_LINEA_0_CM 1 0. 0. 3. ECU_ADDRESS 0xd0004f64 FORMAT "%1.0" /end MEASUREMENT
/begin MEASUREMENT Vsx_mux_ant_crt_slc "Anticipated current gear shift received on the CAN" UBYTE _CNV_S_3_STATUS_ANT_387_CM 1 0. 1. 3. ECU_ADDRESS 0xd0004f65 /end MEASUREMENT
/begin MEASUREMENT Vsx_mux_ant_crt_slc_vld "Anticipated current gear shift received on the CAN validity status" UBYTE _CNV_S_8_STATUS_OK__181_CM 1 0. 0. 7. ECU_ADDRESS 0xd0004f66 /end MEASUREMENT
/begin MEASUREMENT Vsx_mux_rgb_coup "Robotized gearbox coupler state received on the CAN" UBYTE _CNV_A_R_ECME_LINEA_0_CM 1 0. 0. 3. ECU_ADDRESS 0xd0004f67 FORMAT "%1.0" /end MEASUREMENT
/begin MEASUREMENT Vsx_mux_rgb_coup_vld "Robotized gearbox coupler state received on the CAN validity status" UBYTE _CNV_A_R_ECME_LINEA_0_CM 1 0. 0. 2. ECU_ADDRESS 0xd0004f68 FORMAT "%1.0" /end MEASUREMENT
/begin MEASUREMENT Vbx_mux_brk_pdl_navl "indicates that the brake pedals states switch is unavailable" UBYTE _CNV_S_2_RANGE______3_CM 1 0. 0. 1. ECU_ADDRESS 0xd000461a BIT_MASK 0x1 /end MEASUREMENT
/begin MEASUREMENT Vsx_mux_brk_pdl "Brake pedal states received on the CAN" UBYTE _CNV_A_R_ECME_LINEA_0_CM 1 0. 1. 7. ECU_ADDRESS 0xd000461b FORMAT "%1.0" /end MEASUREMENT
/begin MEASUREMENT Vsx_mux_brk_pdl_vld "Brake pedal states received on the CAN validity status" UBYTE _CNV_S_4_STATUS_OK__121_CM 1 0. 0. 3. ECU_ADDRESS 0xd000461c /end MEASUREMENT
/begin MEASUREMENT Vbx_mux_bgin_str_clu_cnt_navl "indicates that end stroke clutch pedal switch received on the CAN is unavailable" UBYTE _CNV_S_2_RANGE______3_CM 1 0. 0. 1. ECU_ADDRESS 0xd0004da9 BIT_MASK 0x1 /end MEASUREMENT
/begin MEASUREMENT Vsx_mux_bgin_str_clu_cnt "Begin stroke clutch pedal switch received on the CAN" UBYTE _CNV_A_R_ECME_LINEA_0_CM 1 0. 0. 3. ECU_ADDRESS 0xd0004daa FORMAT "%1.0" /end MEASUREMENT
/begin MEASUREMENT Vsx_mux_bgin_str_clu_cnt_vld "Begin stroke clutch pedal switch received on the CAN validity status" UBYTE _CNV_S_4_STATUS_OK__121_CM 1 0. 0. 3. ECU_ADDRESS 0xd0004dab /end MEASUREMENT
/begin MEASUREMENT Vbx_mux_end_str_clu_cnt_navl "indicates that end stroke clutch pedal switch received on the CAN is unavailable" UBYTE _CNV_S_2_RANGE______3_CM 1 0. 0. 1. ECU_ADDRESS 0xd000459b BIT_MASK 0x1 /end MEASUREMENT
/begin MEASUREMENT Vsx_mux_end_str_clu_cnt "End stroke clutch pedal switch received on the CAN" UBYTE _CNV_A_R_ECME_LINEA_0_CM 1 0. 0. 3. ECU_ADDRESS 0xd000459c FORMAT "%1.0" /end MEASUREMENT
/begin MEASUREMENT Vsx_mux_end_str_clu_cnt_vld "End stroke clutch pedal switch received on the CAN validity status" UBYTE _CNV_A_R_ECME_LINEA_0_CM 1 0. 0. 2. ECU_ADDRESS 0xd000459d FORMAT "%1.0" /end MEASUREMENT
/begin MEASUREMENT Vbx_mux_aod_vs_navl "Unavailable value of the accurate odometer" UBYTE _CNV_S_2_RANGE______3_CM 1 0. 0. 1. ECU_ADDRESS 0xd0004d68 BIT_MASK 0x1 /end MEASUREMENT
/begin MEASUREMENT Vbx_mux_raw_whl_angl_navl "Unavailable value of the steering wheel angle" UBYTE _CNV_S_2_RANGE______3_CM 1 0. 0. 1. ECU_ADDRESS 0xd0004d69 BIT_MASK 0x1 /end MEASUREMENT
/begin MEASUREMENT Vsx_mux_aod_vs_vld "Accurate odometer CAN validity status" UBYTE _CNV_S_3_STATUS_OK__120_CM 1 0. 0. 2. ECU_ADDRESS 0xd0004d6a /end MEASUREMENT
/begin MEASUREMENT Vsx_mux_raw_whl_angl_vld "Steering wheel angle CAN validity status" UBYTE _CNV_S_3_STATUS_OK__120_CM 1 0. 0. 2. ECU_ADDRESS 0xd0004d6b /end MEASUREMENT
/begin MEASUREMENT Vxx_mux_aod_vs "Accurate odometer coming to the CAN" SBYTE _CNV_A_R_LINEAR_____400_CM 1 0. -60. 60. ECU_ADDRESS 0xd0005777 FORMAT "%3.0" /end MEASUREMENT
/begin MEASUREMENT Vxx_mux_raw_whl_angl "Steering wheel angle coming to the CAN" SWORD _CNV_A_R_LINEAR_____401_CM 1 0. -3276.7 3276.7 ECU_ADDRESS 0xd00038a2 FORMAT "%7.1" /end MEASUREMENT
/begin MEASUREMENT Vbx_mux_alt_pwm_navl "indicates that alternator load is unavailable" UBYTE _CNV_S_2_RANGE______3_CM 1 0. 0. 1. ECU_ADDRESS 0xd000460d BIT_MASK 0x1 /end MEASUREMENT
/begin MEASUREMENT Vsx_mux_alt_pwm_vld "Multiplexed alternator load validity status" UBYTE _CNV_S_3_STATUS_OK__120_CM 1 0. 0. 2. ECU_ADDRESS 0xd000460e /end MEASUREMENT
/begin MEASUREMENT Vxx_mux_alt_pwm "Multiplexed alternator load" UBYTE _CNV_A_R_LINEAR_____114_CM 1 0. 0. 100. ECU_ADDRESS 0xd000460f FORMAT "%12.8" /end MEASUREMENT
/begin MEASUREMENT Vbx_mux_agb_csm_tq_navl "indicates that converter friction Torque received on the CAN is unavailable" UBYTE _CNV_S_2_RANGE______3_CM 1 0. 0. 1. ECU_ADDRESS 0xd0004756 BIT_MASK 0x1 /end MEASUREMENT
/begin MEASUREMENT Vbx_mux_gear_cge "Gear change in progress. Boolean transmitted by automatic transmissions." UBYTE _CNV_S_2_RANGE______3_CM 1 0. 0. 1. ECU_ADDRESS 0xd0004757 BIT_MASK 0x1 /end MEASUREMENT
/begin MEASUREMENT Vsx_mux_agb_csm_tq_vld "Converter friction torque received on the CAN validity status" UBYTE _CNV_S_3_STATUS_OK__158_CM 1 0. 0. 2. ECU_ADDRESS 0xd0004758 /end MEASUREMENT
/begin MEASUREMENT Vsx_mux_agb_tq_ctl_typ "AGB Torque control type" UBYTE _CNV_A_R_ECME_LINEA_0_CM 1 0. 0. 7. ECU_ADDRESS 0xd0004759 FORMAT "%1.0" /end MEASUREMENT
/begin MEASUREMENT Vxx_mux_agb_clck "clock value for the last frame acquired on the mux" UBYTE _CNV_A_R_ECME_LINEA_0_CM 1 0. 0. 15. ECU_ADDRESS 0xd000475a FORMAT "%2.0" /end MEASUREMENT
/begin MEASUREMENT Vxx_mux_agb_csm_tq "Converter friction Torque acquired on MUX" UWORD _CNV_A_R_LINEAR_____161_CM 1 0. -400. 1647.96875 ECU_ADDRESS 0xd0002eb6 FORMAT "%10.5" /end MEASUREMENT
/begin MEASUREMENT Vxx_mux_agb_tqe_sp "Automatic transmission fast-acting torque setting acquired on the CAN" UWORD _CNV_A_R_LINEAR_____161_CM 1 0. -400. 1647.96875 ECU_ADDRESS 0xd0002eb8 FORMAT "%10.5" /end MEASUREMENT
/begin MEASUREMENT Vxx_mux_agb_tqe_sp_raw "Automatic transmission fast-acting raw torque setting acquired on the CAN" UWORD _CNV_A_R_ECME_LINEA_0_CM 1 0. 0. 4095. ECU_ADDRESS 0xd0002eba FORMAT "%4.0" /end MEASUREMENT
/begin MEASUREMENT Vxx_mux_agb_tqe_tgt_lim "Automatic transmission slow-acting torque setting acquired on the CAN" UWORD _CNV_A_R_LINEAR_____161_CM 1 0. -400. 1647.96875 ECU_ADDRESS 0xd0002ebc FORMAT "%10.5" /end MEASUREMENT
/begin MEASUREMENT Vxx_mux_agb_tqe_tgt_lim_raw "Automatic transmission slow-acting raw torque setting acquired on the CAN" UWORD _CNV_A_R_ECME_LINEA_0_CM 1 0. 0. 4095. ECU_ADDRESS 0xd0002ebe FORMAT "%4.0" /end MEASUREMENT
/begin MEASUREMENT Vbx_mux_bpk "Automatic or manual parking brake detected recieved on the CAN" UBYTE _CNV_S_2_RANGE______3_CM 1 0. 0. 1. ECU_ADDRESS 0xd0004ed9 BIT_MASK 0x1 /end MEASUREMENT
/begin MEASUREMENT Vbx_mux_bpk_navl "Indicates that the automatic or manual parking brake detected received on the CAN is unavailable" UBYTE _CNV_S_2_RANGE______3_CM 1 0. 0. 1. ECU_ADDRESS 0xd0004eda BIT_MASK 0x1 /end MEASUREMENT
/begin MEASUREMENT Vsx_mux_bpk_vld "Automatic or manual parking brake detected received on the CAN validity status" UBYTE _CNV_S_3_STATUS_OK__158_CM 1 0. 0. 2. ECU_ADDRESS 0xd0004edb /end MEASUREMENT
/begin MEASUREMENT Vbx_mux_ptc_is_acel_req "PTC idle speed request from CAN" UBYTE _CNV_S_2_RANGE______3_CM 1 0. 0. 1. ECU_ADDRESS 0xd00052b7 BIT_MASK 0x1 /end MEASUREMENT
/begin MEASUREMENT Vsx_mux_ptc_is_acel_vld "" UBYTE _CNV_A_R_ECME_LINEA_0_CM 1 0. 0. 1. ECU_ADDRESS 0xd0003d63 FORMAT "%1.0" /end MEASUREMENT
/begin MEASUREMENT Vbx_mux_neut_cnt_navl "Indicates Neutral engaged switch received on the CAN is unavailable" UBYTE _CNV_S_2_RANGE______3_CM 1 0. 0. 1. ECU_ADDRESS 0xd0004b94 BIT_MASK 0x1 /end MEASUREMENT
/begin MEASUREMENT Vbx_mux_rvr_cnt_navl "indicates that Reverse gear engaged switch received on the CAN is unavailable" UBYTE _CNV_S_2_RANGE______3_CM 1 0. 0. 1. ECU_ADDRESS 0xd0004b95 BIT_MASK 0x1 /end MEASUREMENT
/begin MEASUREMENT Vsx_mux_neut_cnt "Neutral engaged switch for manual gearbox received on the CAN" UBYTE _CNV_A_R_ECME_LINEA_0_CM 1 0. 0. 3. ECU_ADDRESS 0xd0004b96 FORMAT "%1.0" /end MEASUREMENT
/begin MEASUREMENT Vsx_mux_neut_cnt_vld "Neutral engaged switch for manual gearbox received on the CAN validity status" UBYTE _CNV_S_3_STATUS_OK__120_CM 1 0. 0. 2. ECU_ADDRESS 0xd0004b97 /end MEASUREMENT
/begin MEASUREMENT Vsx_mux_rvr_cnt "Reverse gear engaged switch for manual gearbox received on the CAN" UBYTE _CNV_A_R_ECME_LINEA_0_CM 1 0. 0. 3. ECU_ADDRESS 0xd0004b98 FORMAT "%1.0" /end MEASUREMENT
/begin MEASUREMENT Vsx_mux_rvr_cnt_vld " Reverse gear engaged switch for manual gearbox received on the CAN validity status" UBYTE _CNV_S_3_STATUS_OK__120_CM 1 0. 0. 2. ECU_ADDRESS 0xd0004b99 /end MEASUREMENT
/begin MEASUREMENT Vbx_mux_alt_pow_navl "Alternator power from CAN is not available" UBYTE _CNV_S_2_RANGE______3_CM 1 0. 0. 1. ECU_ADDRESS 0xd0004b1a BIT_MASK 0x1 /end MEASUREMENT
/begin MEASUREMENT Vsx_mux_alt_pow_vld "Alternator power from CAN validity status" UBYTE _CNV_S_3_STATUS_OK__120_CM 1 0. 0. 2. ECU_ADDRESS 0xd0004b1b /end MEASUREMENT
/begin MEASUREMENT Vxx_mux_alt_pow "Alternator power from CAN" UWORD _CNV_A_R_LINEAR_____128_CM 1 0. 0. 655350. ECU_ADDRESS 0xd0003054 FORMAT "%6.0" /end MEASUREMENT
/begin MEASUREMENT ASR_MSRAcknowledgement "Transmitted CAN parameter" UBYTE _CNV_A_R_ECME_LINEA_0_CM 1 0. 0. 1. ECU_ADDRESS 0xd0004ed7 FORMAT "%1.0" /end MEASUREMENT
/begin MEASUREMENT AT_TorqueAcknowledgement "Transmitted CAN parameter" UBYTE _CNV_A_R_ECME_LINEA_0_CM 1 0. 0. 1. ECU_ADDRESS 0xd0004ed8 FORMAT "%1.0" /end MEASUREMENT
/begin MEASUREMENT EngineTorque_WithoutTMReq "Transmitted CAN parameter" UWORD _CNV_A_R_ECME_LINEA_0_CM 1 0. 0. 4095. ECU_ADDRESS 0xd00031dc FORMAT "%4.0" /end MEASUREMENT
/begin MEASUREMENT RawEngineTorque_WithoutTMReq "Transmitted CAN parameter" UWORD _CNV_A_R_ECME_LINEA_0_CM 1 0. 0. 4095. ECU_ADDRESS 0xd00031de FORMAT "%4.0" /end MEASUREMENT
/begin MEASUREMENT RequestedTorqueAfterProc "Transmitted CAN parameter" UWORD _CNV_A_R_ECME_LINEA_0_CM 1 0. 0. 4095. ECU_ADDRESS 0xd00031e0 FORMAT "%4.0" /end MEASUREMENT
/begin MEASUREMENT Vbx_mux_drag_red_agb "Drag reduction mode received on the CAN" UBYTE _CNV_S_2_RANGE______3_CM 1 0. 0. 1. ECU_ADDRESS 0xd00042a3 BIT_MASK 0x1 /end MEASUREMENT
/begin MEASUREMENT Vbx_mux_egb_neut "Electronic GearBox in a configuration equivalent to Neutral for a manual gearbox received on the CAN" UBYTE _CNV_S_2_RANGE______3_CM 1 0. 0. 1. ECU_ADDRESS 0xd00042a4 BIT_MASK 0x1 /end MEASUREMENT
/begin MEASUREMENT Vbx_mux_raw_egb_ant_gear_navl "Indicates taht target raw gear due to electronic gearbox received on the CAN is unavailable" UBYTE _CNV_S_2_RANGE______3_CM 1 0. 0. 1. ECU_ADDRESS 0xd00042a5 BIT_MASK 0x1 /end MEASUREMENT
/begin MEASUREMENT Vbx_mux_raw_egb_gear_navl "Indicates that current raw gear due to electronic gearbox received on the CAN is unavailable" UBYTE _CNV_S_2_RANGE______3_CM 1 0. 0. 1. ECU_ADDRESS 0xd00042a6 BIT_MASK 0x1 /end MEASUREMENT
/begin MEASUREMENT Vsx_mux_drag_red_agb_vld "Drag reduction mode received on the CAN validity status" UBYTE _CNV_S_3_STATUS_OK__120_CM 1 0. 0. 2. ECU_ADDRESS 0xd00042a7 /end MEASUREMENT
/begin MEASUREMENT Vsx_mux_egb_neut_vld "Electronic GearBox in a configuration equivalent to Neutral for a manual gearbox received on the CAN validity status" UBYTE _CNV_S_3_STATUS_OK__120_CM 1 0. 0. 2. ECU_ADDRESS 0xd00042a8 /end MEASUREMENT
/begin MEASUREMENT Vsx_mux_raw_egb_ant_gear "Target raw gear due to electronic gearbox received on the CAN" SBYTE _CNV_A_R_ECME_LINEA_0_CM 1 0. -128. 127. ECU_ADDRESS 0xd00042a9 FORMAT "%3.0" /end MEASUREMENT
/begin MEASUREMENT Vsx_mux_raw_egb_ant_gear_vld "Target raw gear due to electronic gearbox  (7th and lih also possible) received on the CAN validity status" UBYTE _CNV_S_3_STATUS_OK__120_CM 1 0. 0. 2. ECU_ADDRESS 0xd00042aa /end MEASUREMENT
/begin MEASUREMENT Vsx_mux_raw_egb_gear "Current raw gear due to electronic gearbox received on the CAN" SBYTE _CNV_A_R_ECME_LINEA_0_CM 1 0. -128. 127. ECU_ADDRESS 0xd00042ab FORMAT "%3.0" /end MEASUREMENT
/begin MEASUREMENT Vsx_mux_raw_egb_gear_vld "Current raw gear due to electronic gearbox  (7 and lih also possible) received on the CAN validity status" UBYTE _CNV_S_3_STATUS_OK__120_CM 1 0. 0. 2. ECU_ADDRESS 0xd00042ac /end MEASUREMENT
/begin MEASUREMENT Vbx_mux_asr_reg "ASR in regulation received on the CAN" UBYTE _CNV_S_2_RANGE______3_CM 1 0. 0. 1. ECU_ADDRESS 0xd0004ac2 BIT_MASK 0x1 /end MEASUREMENT
/begin MEASUREMENT Vbx_mux_ayc_reg "AYC in regulation received on the CAN" UBYTE _CNV_S_2_RANGE______3_CM 1 0. 0. 1. ECU_ADDRESS 0xd0004ac3 BIT_MASK 0x1 /end MEASUREMENT
/begin MEASUREMENT Vsx_mux_asr_msr_typ "Torque control type received on the CAN" UBYTE _CNV_S_4_STATUS_TQ__164_CM 1 0. 0. 6. ECU_ADDRESS 0xd0004ac4 /end MEASUREMENT
/begin MEASUREMENT Vsx_mux_asr_msr_typ_vld "Torque control type received on the CAN validity status" UBYTE _CNV_A_R_ECME_LINEA_0_CM 1 0. 0. 2. ECU_ADDRESS 0xd0004ac5 FORMAT "%1.0" /end MEASUREMENT
/begin MEASUREMENT Vsx_mux_asr_reg_vld "ASR in regulation received on the CAN validity status" UBYTE _CNV_A_R_ECME_LINEA_0_CM 1 0. 0. 1. ECU_ADDRESS 0xd0004ac6 FORMAT "%1.0" /end MEASUREMENT
/begin MEASUREMENT Vsx_mux_ayc_reg_vld "AYC in regulation received on the CAN validity status" UBYTE _CNV_A_R_ECME_LINEA_0_CM 1 0. 0. 1. ECU_ADDRESS 0xd0004ac7 FORMAT "%1.0" /end MEASUREMENT
/begin MEASUREMENT Vxx_mux_asr_msr_clck "clock value for the last frame" UBYTE _CNV_A_R_ECME_LINEA_0_CM 1 0. 0. 255. ECU_ADDRESS 0xd0004ac8 FORMAT "%3.0" /end MEASUREMENT
/begin MEASUREMENT Vxx_mux_asr_tqe_sp "ASR setpoint torque acquired on the MUX" UWORD _CNV_A_R_LINEAR_____161_CM 1 0. -400. 1647.96875 ECU_ADDRESS 0xd0002d9c FORMAT "%10.5" /end MEASUREMENT
/begin MEASUREMENT Vxx_mux_asr_tqe_sp_raw "ASR setpoint torque acquired on the MUX (unscaled)" UWORD _CNV_A_R_ECME_LINEA_0_CM 1 0. 0. 4095. ECU_ADDRESS 0xd0002d9e FORMAT "%4.0" /end MEASUREMENT
/begin MEASUREMENT Vxx_mux_asr_tqe_tgt "ASR target torque acquired on the MUX" UWORD _CNV_A_R_LINEAR_____161_CM 1 0. -400. 1647.96875 ECU_ADDRESS 0xd0002da0 FORMAT "%10.5" /end MEASUREMENT
/begin MEASUREMENT Vxx_mux_asr_tqe_tgt_raw "Raw unscaled ASR target torque" UWORD _CNV_A_R_ECME_LINEA_0_CM 1 0. 0. 4095. ECU_ADDRESS 0xd0002da2 FORMAT "%4.0" /end MEASUREMENT
/begin MEASUREMENT Vxx_mux_msr_tqe_sp "MSR torque setting acquired on the MUX" UWORD _CNV_A_R_LINEAR_____161_CM 1 0. -400. 1647.96875 ECU_ADDRESS 0xd0002da4 FORMAT "%10.5" /end MEASUREMENT
/begin MEASUREMENT Vxx_mux_msr_tqe_sp_raw "Raw unscaled MSR torque setting" UWORD _CNV_A_R_ECME_LINEA_0_CM 1 0. 0. 4095. ECU_ADDRESS 0xd0002da6 FORMAT "%4.0" /end MEASUREMENT
/begin MEASUREMENT ECM_CANHS_RNr_01[0] "Transmitted CAN frame" UBYTE _CNV_A_R_ECME_LINEA_0_CM 1 0. 0. 255. ECU_ADDRESS 0xd00041a0 FORMAT "%3.0" /end MEASUREMENT
/begin MEASUREMENT ECM_CANHS_RNr_01[1] "Transmitted CAN frame" UBYTE _CNV_A_R_ECME_LINEA_0_CM 1 0. 0. 255. ECU_ADDRESS 0xd00041a1 FORMAT "%3.0" /end MEASUREMENT
/begin MEASUREMENT ECM_CANHS_RNr_01[2] "Transmitted CAN frame" UBYTE _CNV_A_R_ECME_LINEA_0_CM 1 0. 0. 255. ECU_ADDRESS 0xd00041a2 FORMAT "%3.0" /end MEASUREMENT
/begin MEASUREMENT ECM_CANHS_RNr_01[3] "Transmitted CAN frame" UBYTE _CNV_A_R_ECME_LINEA_0_CM 1 0. 0. 255. ECU_ADDRESS 0xd00041a3 FORMAT "%3.0" /end MEASUREMENT
/begin MEASUREMENT ECM_CANHS_RNr_01[4] "Transmitted CAN frame" UBYTE _CNV_A_R_ECME_LINEA_0_CM 1 0. 0. 255. ECU_ADDRESS 0xd00041a4 FORMAT "%3.0" /end MEASUREMENT
/begin MEASUREMENT ECM_CANHS_RNr_01[5] "Transmitted CAN frame" UBYTE _CNV_A_R_ECME_LINEA_0_CM 1 0. 0. 255. ECU_ADDRESS 0xd00041a5 FORMAT "%3.0" /end MEASUREMENT
/begin MEASUREMENT ECM_CANHS_RNr_01[6] "Transmitted CAN frame" UBYTE _CNV_A_R_ECME_LINEA_0_CM 1 0. 0. 255. ECU_ADDRESS 0xd00041a6 FORMAT "%3.0" /end MEASUREMENT
/begin MEASUREMENT ECM_CANHS_RNr_01[7] "Transmitted CAN frame" UBYTE _CNV_A_R_ECME_LINEA_0_CM 1 0. 0. 255. ECU_ADDRESS 0xd00041a7 FORMAT "%3.0" /end MEASUREMENT
/begin MEASUREMENT ECM_CANHS_RNr_02[0] "Transmitted CAN frame" UBYTE _CNV_A_R_ECME_LINEA_0_CM 1 0. 0. 255. ECU_ADDRESS 0xd0005544 FORMAT "%3.0" /end MEASUREMENT
/begin MEASUREMENT ECM_CANHS_RNr_02[1] "Transmitted CAN frame" UBYTE _CNV_A_R_ECME_LINEA_0_CM 1 0. 0. 255. ECU_ADDRESS 0xd0005545 FORMAT "%3.0" /end MEASUREMENT
/begin MEASUREMENT ECM_CANHS_RNr_02[2] "Transmitted CAN frame" UBYTE _CNV_A_R_ECME_LINEA_0_CM 1 0. 0. 255. ECU_ADDRESS 0xd0005546 FORMAT "%3.0" /end MEASUREMENT
/begin MEASUREMENT ECM_CANHS_RNr_02[3] "Transmitted CAN frame" UBYTE _CNV_A_R_ECME_LINEA_0_CM 1 0. 0. 255. ECU_ADDRESS 0xd0005547 FORMAT "%3.0" /end MEASUREMENT
/begin MEASUREMENT ECM_CANHS_RNr_02[4] "Transmitted CAN frame" UBYTE _CNV_A_R_ECME_LINEA_0_CM 1 0. 0. 255. ECU_ADDRESS 0xd0005548 FORMAT "%3.0" /end MEASUREMENT
/begin MEASUREMENT ECM_CANHS_RNr_02[5] "Transmitted CAN frame" UBYTE _CNV_A_R_ECME_LINEA_0_CM 1 0. 0. 255. ECU_ADDRESS 0xd0005549 FORMAT "%3.0" /end MEASUREMENT
/begin MEASUREMENT ECM_CANHS_RNr_02[6] "Transmitted CAN frame" UBYTE _CNV_A_R_ECME_LINEA_0_CM 1 0. 0. 255. ECU_ADDRESS 0xd000554a FORMAT "%3.0" /end MEASUREMENT
/begin MEASUREMENT ECM_VERLOG[0] "Transmitted CAN frame" UBYTE _CNV_A_R_ECME_LINEA_0_CM 1 0. 0. 255. ECU_ADDRESS 0xd000554c FORMAT "%3.0" /end MEASUREMENT
/begin MEASUREMENT ECM_VERLOG[1] "Transmitted CAN frame" UBYTE _CNV_A_R_ECME_LINEA_0_CM 1 0. 0. 255. ECU_ADDRESS 0xd000554d FORMAT "%3.0" /end MEASUREMENT
/begin MEASUREMENT ECM_VERLOG[2] "Transmitted CAN frame" UBYTE _CNV_A_R_ECME_LINEA_0_CM 1 0. 0. 255. ECU_ADDRESS 0xd000554e FORMAT "%3.0" /end MEASUREMENT
/begin MEASUREMENT ECM_VERLOG[3] "Transmitted CAN frame" UBYTE _CNV_A_R_ECME_LINEA_0_CM 1 0. 0. 255. ECU_ADDRESS 0xd000554f FORMAT "%3.0" /end MEASUREMENT
/begin MEASUREMENT ECM_VERLOG[4] "Transmitted CAN frame" UBYTE _CNV_A_R_ECME_LINEA_0_CM 1 0. 0. 255. ECU_ADDRESS 0xd0005550 FORMAT "%3.0" /end MEASUREMENT
/begin MEASUREMENT ECM_VERLOG[5] "Transmitted CAN frame" UBYTE _CNV_A_R_ECME_LINEA_0_CM 1 0. 0. 255. ECU_ADDRESS 0xd0005551 FORMAT "%3.0" /end MEASUREMENT
/begin MEASUREMENT ECM_VERLOG[6] "Transmitted CAN frame" UBYTE _CNV_A_R_ECME_LINEA_0_CM 1 0. 0. 255. ECU_ADDRESS 0xd0005552 FORMAT "%3.0" /end MEASUREMENT
/begin MEASUREMENT FORCE_ECM_CANHS_R_01[0] "Transmitted CAN frame" UBYTE _CNV_A_R_ECME_LINEA_0_CM 1 0. 0. 255. ECU_ADDRESS 0xd000553c FORMAT "%3.0" /end MEASUREMENT
/begin MEASUREMENT FORCE_ECM_CANHS_R_01[1] "Transmitted CAN frame" UBYTE _CNV_A_R_ECME_LINEA_0_CM 1 0. 0. 255. ECU_ADDRESS 0xd000553d FORMAT "%3.0" /end MEASUREMENT
/begin MEASUREMENT FORCE_ECM_CANHS_R_01[2] "Transmitted CAN frame" UBYTE _CNV_A_R_ECME_LINEA_0_CM 1 0. 0. 255. ECU_ADDRESS 0xd000553e FORMAT "%3.0" /end MEASUREMENT
/begin MEASUREMENT FORCE_ECM_CANHS_R_01[3] "Transmitted CAN frame" UBYTE _CNV_A_R_ECME_LINEA_0_CM 1 0. 0. 255. ECU_ADDRESS 0xd000553f FORMAT "%3.0" /end MEASUREMENT
/begin MEASUREMENT FORCE_ECM_CANHS_R_01[4] "Transmitted CAN frame" UBYTE _CNV_A_R_ECME_LINEA_0_CM 1 0. 0. 255. ECU_ADDRESS 0xd0005540 FORMAT "%3.0" /end MEASUREMENT
/begin MEASUREMENT FORCE_ECM_CANHS_R_01[5] "Transmitted CAN frame" UBYTE _CNV_A_R_ECME_LINEA_0_CM 1 0. 0. 255. ECU_ADDRESS 0xd0005541 FORMAT "%3.0" /end MEASUREMENT
/begin MEASUREMENT FORCE_ECM_CANHS_R_01[6] "Transmitted CAN frame" UBYTE _CNV_A_R_ECME_LINEA_0_CM 1 0. 0. 255. ECU_ADDRESS 0xd0005542 FORMAT "%3.0" /end MEASUREMENT
/begin MEASUREMENT FORCE_ECM_CANHS_R_01[7] "Transmitted CAN frame" UBYTE _CNV_A_R_ECME_LINEA_0_CM 1 0. 0. 255. ECU_ADDRESS 0xd0005543 FORMAT "%3.0" /end MEASUREMENT
/begin MEASUREMENT MMI_ECM_CANHS_RNr_01[0] "Transmitted CAN frame" UBYTE _CNV_A_R_ECME_LINEA_0_CM 1 0. 0. 255. ECU_ADDRESS 0xd0005554 FORMAT "%3.0" /end MEASUREMENT
/begin MEASUREMENT MMI_ECM_CANHS_RNr_01[1] "Transmitted CAN frame" UBYTE _CNV_A_R_ECME_LINEA_0_CM 1 0. 0. 255. ECU_ADDRESS 0xd0005555 FORMAT "%3.0" /end MEASUREMENT
/begin MEASUREMENT MMI_ECM_CANHS_RNr_01[2] "Transmitted CAN frame" UBYTE _CNV_A_R_ECME_LINEA_0_CM 1 0. 0. 255. ECU_ADDRESS 0xd0005556 FORMAT "%3.0" /end MEASUREMENT
/begin MEASUREMENT MMI_ECM_CANHS_RNr_01[3] "Transmitted CAN frame" UBYTE _CNV_A_R_ECME_LINEA_0_CM 1 0. 0. 255. ECU_ADDRESS 0xd0005557 FORMAT "%3.0" /end MEASUREMENT
/begin MEASUREMENT MMI_ECM_CANHS_RNr_01[4] "Transmitted CAN frame" UBYTE _CNV_A_R_ECME_LINEA_0_CM 1 0. 0. 255. ECU_ADDRESS 0xd0005558 FORMAT "%3.0" /end MEASUREMENT
/begin MEASUREMENT MMI_ECM_CANHS_RNr_01[5] "Transmitted CAN frame" UBYTE _CNV_A_R_ECME_LINEA_0_CM 1 0. 0. 255. ECU_ADDRESS 0xd0005559 FORMAT "%3.0" /end MEASUREMENT
/begin MEASUREMENT TORQUE_ECM_CANHS_RNr_01[0] "Transmitted CAN frame" UBYTE _CNV_A_R_ECME_LINEA_0_CM 1 0. 0. 255. ECU_ADDRESS 0xd00041a8 FORMAT "%3.0" /end MEASUREMENT
/begin MEASUREMENT TORQUE_ECM_CANHS_RNr_01[1] "Transmitted CAN frame" UBYTE _CNV_A_R_ECME_LINEA_0_CM 1 0. 0. 255. ECU_ADDRESS 0xd00041a9 FORMAT "%3.0" /end MEASUREMENT
/begin MEASUREMENT TORQUE_ECM_CANHS_RNr_01[2] "Transmitted CAN frame" UBYTE _CNV_A_R_ECME_LINEA_0_CM 1 0. 0. 255. ECU_ADDRESS 0xd00041aa FORMAT "%3.0" /end MEASUREMENT
/begin MEASUREMENT TORQUE_ECM_CANHS_RNr_01[3] "Transmitted CAN frame" UBYTE _CNV_A_R_ECME_LINEA_0_CM 1 0. 0. 255. ECU_ADDRESS 0xd00041ab FORMAT "%3.0" /end MEASUREMENT
/begin MEASUREMENT TORQUE_ECM_CANHS_RNr_01[4] "Transmitted CAN frame" UBYTE _CNV_A_R_ECME_LINEA_0_CM 1 0. 0. 255. ECU_ADDRESS 0xd00041ac FORMAT "%3.0" /end MEASUREMENT
/begin MEASUREMENT TORQUE_ECM_CANHS_RNr_01[5] "Transmitted CAN frame" UBYTE _CNV_A_R_ECME_LINEA_0_CM 1 0. 0. 255. ECU_ADDRESS 0xd00041ad FORMAT "%3.0" /end MEASUREMENT
/begin MEASUREMENT TORQUE_ECM_CANHS_RNr_01[6] "Transmitted CAN frame" UBYTE _CNV_A_R_ECME_LINEA_0_CM 1 0. 0. 255. ECU_ADDRESS 0xd00041ae FORMAT "%3.0" /end MEASUREMENT
/begin MEASUREMENT TORQUE_ECM_CANHS_RNr_02[0] "Transmitted CAN frame" UBYTE _CNV_A_R_ECME_LINEA_0_CM 1 0. 0. 255. ECU_ADDRESS 0xd00041b0 FORMAT "%3.0" /end MEASUREMENT
/begin MEASUREMENT TORQUE_ECM_CANHS_RNr_02[1] "Transmitted CAN frame" UBYTE _CNV_A_R_ECME_LINEA_0_CM 1 0. 0. 255. ECU_ADDRESS 0xd00041b1 FORMAT "%3.0" /end MEASUREMENT
/begin MEASUREMENT TORQUE_ECM_CANHS_RNr_02[2] "Transmitted CAN frame" UBYTE _CNV_A_R_ECME_LINEA_0_CM 1 0. 0. 255. ECU_ADDRESS 0xd00041b2 FORMAT "%3.0" /end MEASUREMENT
/begin MEASUREMENT TORQUE_ECM_CANHS_RNr_02[3] "Transmitted CAN frame" UBYTE _CNV_A_R_ECME_LINEA_0_CM 1 0. 0. 255. ECU_ADDRESS 0xd00041b3 FORMAT "%3.0" /end MEASUREMENT
/begin MEASUREMENT TORQUE_ECM_CANHS_RNr_02[4] "Transmitted CAN frame" UBYTE _CNV_A_R_ECME_LINEA_0_CM 1 0. 0. 255. ECU_ADDRESS 0xd00041b4 FORMAT "%3.0" /end MEASUREMENT
/begin MEASUREMENT TORQUE_ECM_CANHS_RNr_02[5] "Transmitted CAN frame" UBYTE _CNV_A_R_ECME_LINEA_0_CM 1 0. 0. 255. ECU_ADDRESS 0xd00041b5 FORMAT "%3.0" /end MEASUREMENT
/begin MEASUREMENT TORQUE_ECM_CANHS_R_01[0] "Transmitted CAN frame" UBYTE _CNV_A_R_ECME_LINEA_0_CM 1 0. 0. 255. ECU_ADDRESS 0xd00041b6 FORMAT "%3.0" /end MEASUREMENT
/begin MEASUREMENT TORQUE_ECM_CANHS_R_01[1] "Transmitted CAN frame" UBYTE _CNV_A_R_ECME_LINEA_0_CM 1 0. 0. 255. ECU_ADDRESS 0xd00041b7 FORMAT "%3.0" /end MEASUREMENT
/begin MEASUREMENT TORQUE_ECM_CANHS_R_01[2] "Transmitted CAN frame" UBYTE _CNV_A_R_ECME_LINEA_0_CM 1 0. 0. 255. ECU_ADDRESS 0xd00041b8 FORMAT "%3.0" /end MEASUREMENT
/begin MEASUREMENT TORQUE_ECM_CANHS_R_01[3] "Transmitted CAN frame" UBYTE _CNV_A_R_ECME_LINEA_0_CM 1 0. 0. 255. ECU_ADDRESS 0xd00041b9 FORMAT "%3.0" /end MEASUREMENT
/begin MEASUREMENT TORQUE_ECM_CANHS_R_01[4] "Transmitted CAN frame" UBYTE _CNV_A_R_ECME_LINEA_0_CM 1 0. 0. 255. ECU_ADDRESS 0xd00041ba FORMAT "%3.0" /end MEASUREMENT
/begin MEASUREMENT ACCompMaximumPower "Transmitted CAN parameter" UBYTE _CNV_A_R_ECME_LINEA_0_CM 1 0. 0. 255. ECU_ADDRESS 0xd0003d5b FORMAT "%3.0" /end MEASUREMENT
/begin MEASUREMENT Vbx_mux_ac_pow_navl "air conditionning power unavailability" UBYTE _CNV_S_2_RANGE______3_CM 1 0. 0. 1. ECU_ADDRESS 0xd000488d BIT_MASK 0x1 /end MEASUREMENT
/begin MEASUREMENT Vsx_mux_ac_pow_vld "air conditionning power received from CAN validity status" UBYTE _CNV_S_3_STATUS_OK__120_CM 1 0. 0. 2. ECU_ADDRESS 0xd0005216 /end MEASUREMENT
/begin MEASUREMENT Vxx_mux_ac_pow "air conditionning power received from CAN" UWORD _CNV_A_R_LINEAR_____128_CM 1 0. 0. 655350. ECU_ADDRESS 0xd0002df6 FORMAT "%6.0" /end MEASUREMENT
/begin MEASUREMENT OpenActiveBrakeSwitch_ECM "Transmitted CAN parameter" UBYTE _CNV_A_R_ECME_LINEA_0_CM 1 0. 0. 3. ECU_ADDRESS 0xd0004f6a FORMAT "%1.0" /end MEASUREMENT
/begin MEASUREMENT Vbx_mux_el_bk_wind "Electric backlite request from CAN" UBYTE _CNV_S_2_RANGE______3_CM 1 0. 0. 1. ECU_ADDRESS 0xd0004ad1 BIT_MASK 0x1 /end MEASUREMENT
/begin MEASUREMENT Vbx_mux_el_wind_is_acel "Electric windshield idle speed setpoint acceleration request from CAN" UBYTE _CNV_S_2_RANGE______3_CM 1 0. 0. 1. ECU_ADDRESS 0xd0004ad2 BIT_MASK 0x1 /end MEASUREMENT
/begin MEASUREMENT ACCompAuthorized "Transmitted CAN parameter" UBYTE _CNV_A_R_ECME_LINEA_0_CM 1 0. 0. 1. ECU_ADDRESS 0xd0004efa FORMAT "%1.0" /end MEASUREMENT
/begin MEASUREMENT ACCompClutchActivation "Transmitted CAN parameter" UBYTE _CNV_A_R_ECME_LINEA_0_CM 1 0. 0. 1. ECU_ADDRESS 0xd0004efb FORMAT "%1.0" /end MEASUREMENT
/begin MEASUREMENT Vbx_mux_ac_clu_req "air conditionning compressor request sent from AC ECU to USM (M3 architecture) received from CAN" UBYTE _CNV_S_2_RANGE______3_CM 1 0. 0. 1. ECU_ADDRESS 0xd0004835 BIT_MASK 0x1 /end MEASUREMENT
/begin MEASUREMENT Vsx_mux_ac_clu_req_vld "air conditionning compressor request sent from AC ECU to USM (M3 architecture) validity status" UBYTE _CNV_S_3_STATUS_OK__120_CM 1 0. 0. 2. ECU_ADDRESS 0xd0004836 /end MEASUREMENT
/begin MEASUREMENT Vbx_mux_egb_n_lim_navl "indicates that FuelCutRequestedEngineSpeed is unavailable" UBYTE _CNV_S_2_RANGE______3_CM 1 0. 0. 1. ECU_ADDRESS 0xd0004ff5 BIT_MASK 0x1 /end MEASUREMENT
/begin MEASUREMENT Vsx_mux_egb_n_lim_vld "engine speed limitation validity status" UBYTE _CNV_S_3_STATUS_OK__120_CM 1 0. 0. 2. ECU_ADDRESS 0xd0004ff6 /end MEASUREMENT
/begin MEASUREMENT Vxx_mux_egb_n_lim "Engine speed limitation requested by electronic gear box (CVT,...)" UWORD _CNV_A_R_ENSD_LINEA_24_CM 1 0. 0. 16383.75 ECU_ADDRESS 0xd00032bc FORMAT "%8.2" /end MEASUREMENT
/begin MEASUREMENT Vbx_can_diag "Mux diagnostic activation indicator for network (CAN bus) failure detection" UBYTE _CNV_S_2_RANGE______3_CM 1 0. 0. 1. ECU_ADDRESS 0xd0005762 BIT_MASK 0x1 /end MEASUREMENT
/begin MEASUREMENT Vbx_can_diag_raw "Raw Mux diagnostic activation indicator" UBYTE _CNV_S_2_RANGE______3_CM 1 0. 0. 1. ECU_ADDRESS 0xd0003fe1 BIT_MASK 0x1 /end MEASUREMENT
/begin MEASUREMENT Vbx_mux_ac_acel_is_sp_navl "Accelerated engine idle speed setpoint request for air conditionning from CAN not available" UBYTE _CNV_S_2_RANGE______3_CM 1 0. 0. 1. ECU_ADDRESS 0xd0003fe2 BIT_MASK 0x1 /end MEASUREMENT
/begin MEASUREMENT Vbx_mux_ac_mdf1_req "Fan 1 activation request from air conditioning ECU received on the CAN network" UBYTE _CNV_S_2_RANGE______3_CM 1 0. 0. 1. ECU_ADDRESS 0xd0003fe3 BIT_MASK 0x1 /end MEASUREMENT
/begin MEASUREMENT Vbx_mux_ac_mdf2_req "Fan 2 activation request from air conditioning ECU received on the CAN network" UBYTE _CNV_S_2_RANGE______3_CM 1 0. 0. 1. ECU_ADDRESS 0xd0003fe4 BIT_MASK 0x1 /end MEASUREMENT
/begin MEASUREMENT Vbx_mux_ac_req "Climate cooling request from CAN network" UBYTE _CNV_S_2_RANGE______3_CM 1 0. 0. 1. ECU_ADDRESS 0xd0003fe5 BIT_MASK 0x1 /end MEASUREMENT
/begin MEASUREMENT Vbx_mux_ac_req_ext "Climate cooling request from AC ECU (cold loop outside ECM)" UBYTE _CNV_S_2_RANGE______3_CM 1 0. 0. 1. ECU_ADDRESS 0xd0003fe6 BIT_MASK 0x1 /end MEASUREMENT
/begin MEASUREMENT Vbx_mux_ac_req_int "Climate cooling request from CAN ECU when cold loop is in ECM" UBYTE _CNV_S_2_RANGE______3_CM 1 0. 0. 1. ECU_ADDRESS 0xd0003fe7 BIT_MASK 0x1 /end MEASUREMENT
/begin MEASUREMENT Vbx_mux_agb_mdf1_req "Fan 1 activation request from AGB received on the CAN network" UBYTE _CNV_S_2_RANGE______3_CM 1 0. 0. 1. ECU_ADDRESS 0xd0003fe8 BIT_MASK 0x1 /end MEASUREMENT
/begin MEASUREMENT Vbx_mux_agb_mdf2_req "Fan 2 activation request from AGB received on the CAN network" UBYTE _CNV_S_2_RANGE______3_CM 1 0. 0. 1. ECU_ADDRESS 0xd0003fe9 BIT_MASK 0x1 /end MEASUREMENT
/begin MEASUREMENT Vbx_mux_can_diag "Counting and storage of CAN mute/absent failure authorization" UBYTE _CNV_S_2_RANGE______3_CM 1 0. 0. 1. ECU_ADDRESS 0xd0003fea BIT_MASK 0x1 /end MEASUREMENT
/begin MEASUREMENT Vbx_mux_dspl_vs_in_mph "The vehicule speed used for CC/SL is in mph" UBYTE _CNV_S_2_RANGE______3_CM 1 0. 0. 1. ECU_ADDRESS 0xd0005763 BIT_MASK 0x1 /end MEASUREMENT
/begin MEASUREMENT Vbx_mux_dspl_vs_navl "Displayed vehicle speed received on the CAN network not available" UBYTE _CNV_S_2_RANGE______3_CM 1 0. 0. 1. ECU_ADDRESS 0xd0005764 BIT_MASK 0x1 /end MEASUREMENT
/begin MEASUREMENT Vbx_mux_vh_key "CAN input data indicating if the key vehicle is present (1=vehicle with key)" UBYTE _CNV_S_2_RANGE______3_CM 1 0. 0. 1. ECU_ADDRESS 0xd0005765 BIT_MASK 0x1 /end MEASUREMENT
/begin MEASUREMENT Vbx_mux_vs_navl "Vehicle speed received on the CAN network not available" UBYTE _CNV_S_2_RANGE______3_CM 1 0. 0. 1. ECU_ADDRESS 0xd0003feb BIT_MASK 0x1 /end MEASUREMENT
/begin MEASUREMENT Vsx_mux_ac_acel_is_sp_vld "Accelerated engine idle speed setpoint request for air conditionning from CAN validity status" UBYTE _CNV_S_3_STATUS_OK__120_CM 1 0. 0. 2. ECU_ADDRESS 0xd0003fec /end MEASUREMENT
/begin MEASUREMENT Vsx_mux_ac_mdf_req_vld "Fans activation request from air conditioning ECU received on the CAN network validity status" UBYTE _CNV_S_4_STATUS_OK__121_CM 1 0. 0. 3. ECU_ADDRESS 0xd0003fed /end MEASUREMENT
/begin MEASUREMENT Vsx_mux_ac_req_ext_vld "Climate cooling request from AC ECU validity status" UBYTE _CNV_S_4_STATUS_OK__275_CM 1 0. 0. 3. ECU_ADDRESS 0xd0003fee /end MEASUREMENT
/begin MEASUREMENT Vsx_mux_ac_req_int_vld "Climate cooling request from CAN ECU (when cold loop is in ECM) validity status" UBYTE _CNV_S_4_STATUS_OK__275_CM 1 0. 0. 3. ECU_ADDRESS 0xd0003fef /end MEASUREMENT
/begin MEASUREMENT Vsx_mux_ac_req_vld "Climate cooling request from CAN network validity status" UBYTE _CNV_S_4_STATUS_OK__121_CM 1 0. 0. 3. ECU_ADDRESS 0xd0003ff0 /end MEASUREMENT
/begin MEASUREMENT Vsx_mux_agb_mdf_req_vld "Fans activation request from AGB received on the CAN network validity status" UBYTE _CNV_S_4_STATUS_OK__121_CM 1 0. 0. 3. ECU_ADDRESS 0xd0003ff1 /end MEASUREMENT
/begin MEASUREMENT Vsx_mux_dspl_vs_vld "Displayed vehicle speed received on the CAN network validity status " UBYTE _CNV_S_4_STATUS_OK__121_CM 1 0. 0. 3. ECU_ADDRESS 0xd0005766 /end MEASUREMENT
/begin MEASUREMENT Vsx_mux_ena_sta_agb "AT Starter authorization or stop received on the CAN network" UBYTE _CNV_A_R_ECME_LINEA_0_CM 1 0. 0. 3. ECU_ADDRESS 0xd0003ff2 FORMAT "%1.0" /end MEASUREMENT
/begin MEASUREMENT Vsx_mux_ena_sta_agb_vld "AT Starter authorization or stop received on the CAN network validity status" UBYTE _CNV_S_4_STATUS_OK__121_CM 1 0. 0. 3. ECU_ADDRESS 0xd0003ff3 /end MEASUREMENT
/begin MEASUREMENT Vsx_mux_sta_stt_vld "Starter status received on the CAN network validity status" UBYTE _CNV_S_4_STATUS_OK__121_CM 1 0. 0. 3. ECU_ADDRESS 0xd0003ff4 /end MEASUREMENT
/begin MEASUREMENT Vsx_mux_vs_vld "Vehicle speed received on the CAN network validity status " UBYTE _CNV_S_4_STATUS_OK__121_CM 1 0. 0. 3. ECU_ADDRESS 0xd0003ff5 /end MEASUREMENT
/begin MEASUREMENT Vxx_mux_ac_acel_is_sp "Accelerated engine idle speed setpoint request for air conditionning from CAN" UWORD _CNV_A_R_ENSD_LINEA_24_CM 1 0. 0. 16383.75 ECU_ADDRESS 0xd0003840 FORMAT "%8.2" /end MEASUREMENT
/begin MEASUREMENT Vxx_mux_airb1 "Byte n∞1 of the AIRBAGCrash frame recieved on the CAN network" UBYTE _CNV_A_R_ECME_LINEA_0_CM 1 0. 0. 255. ECU_ADDRESS 0xd0005767 FORMAT "%3.0" /end MEASUREMENT
/begin MEASUREMENT Vxx_mux_airb2 "Byte n∞2 of the AIRBAGCrash frame recieved on the CAN network" UBYTE _CNV_A_R_ECME_LINEA_0_CM 1 0. 0. 255. ECU_ADDRESS 0xd0005768 FORMAT "%3.0" /end MEASUREMENT
/begin MEASUREMENT Vxx_mux_dspl_vs "Displayed vehicle speed received on the CAN network" UWORD _CNV_A_R_LINEAR_____70_CM 1 0. 0. 655.35 ECU_ADDRESS 0xd0005abe FORMAT "%6.2" /end MEASUREMENT
/begin MEASUREMENT Vxx_mux_eng_stop_req_ccu "Emergency engine stop request received on the CAN network" UBYTE _CNV_A_R_ECME_LINEA_0_CM 1 0. 0. 255. ECU_ADDRESS 0xd0003ff6 FORMAT "%3.0" /end MEASUREMENT
/begin MEASUREMENT Vxx_mux_eng_stop_req_rgb "Engine stop requested by robotized gearbox received on the CAN network" UBYTE _CNV_A_R_ECME_LINEA_0_CM 1 0. 0. 255. ECU_ADDRESS 0xd0003ff7 FORMAT "%3.0" /end MEASUREMENT
/begin MEASUREMENT Vxx_mux_eng_stop_req_ssg "Engine stop requested by SSG received on the CAN network" UBYTE _CNV_A_R_ECME_LINEA_0_CM 1 0. 0. 255. ECU_ADDRESS 0xd0003ff8 FORMAT "%3.0" /end MEASUREMENT
/begin MEASUREMENT Vxx_mux_sta_stt "Starter status received on the CAN network" UBYTE _CNV_A_R_ECME_LINEA_0_CM 1 0. 0. 3. ECU_ADDRESS 0xd0003ff9 FORMAT "%1.0" /end MEASUREMENT
/begin MEASUREMENT Vxx_mux_sta_swi_act_ctr "Starter status received on the CAN network" UBYTE _CNV_A_R_ECME_LINEA_0_CM 1 0. 0. 7. ECU_ADDRESS 0xd0005769 FORMAT "%1.0" /end MEASUREMENT
/begin MEASUREMENT Vxx_mux_vs "Vehicle speed received on the CAN network" UWORD _CNV_A_R_LINEAR_____70_CM 1 0. 0. 655.35 ECU_ADDRESS 0xd0003842 FORMAT "%6.2" /end MEASUREMENT
/begin CHARACTERISTIC Cbx_vh_key_navl_val "Boolean to choose the default value when the KeyVehicle is received to an unavailable value (1 = key vehicle; 0 = without key vehicle)" VALUE 0xa0020f3c _REC_S1VAL_20_u1 1. _CNV_S_2_RANGE______3_CM 0. 1. BIT_MASK 0x1 /end CHARACTERISTIC
/begin CHARACTERISTIC Cxx_eng_aut_can_diag_dly "Delay between the moment when the engine is autonomous and the authorization to set Vbx_can_diag to 1" VALUE 0xa0020f3a _REC_S1VAL_20_u2 655.35 _CNV_A_R_LINEAR_____34_CM 0. 655.35 FORMAT "%6.2" /end CHARACTERISTIC
/begin MEASUREMENT Vsx_mux_rgb_pump_vld "Robotized gearbox pump activation received on the CAN validity status" UBYTE _CNV_S_3_STATUS_OK__120_CM 1 0. 0. 2. ECU_ADDRESS 0xd0005389 /end MEASUREMENT
/begin MEASUREMENT Vxx_mux_rgb_pump "Robotized gearbox pump activation received on the CAN" UBYTE _CNV_A_R_ECME_LINEA_0_CM 1 0. 0. 3. ECU_ADDRESS 0xd000538a FORMAT "%1.0" /end MEASUREMENT
/begin MEASUREMENT FloatingInhibition "Transmitted CAN parameter" UBYTE _CNV_A_R_ECME_LINEA_0_CM 1 0. 0. 3. ECU_ADDRESS 0xd00052a9 FORMAT "%1.0" /end MEASUREMENT
/begin MEASUREMENT Vbx_mux_prim_sha_spd_navl "indicates that primary shaft speed received on the CAN is unavailable" UBYTE _CNV_S_2_RANGE______3_CM 1 0. 0. 1. ECU_ADDRESS 0xd00049f4 BIT_MASK 0x1 /end MEASUREMENT
/begin MEASUREMENT Vsx_mux_prim_sha_spd_vld "Primary shaft speed received on the CAN validity status" UBYTE _CNV_S_8_STATUS_OK__181_CM 1 0. 0. 7. ECU_ADDRESS 0xd00049f5 /end MEASUREMENT
/begin MEASUREMENT Vxx_mux_prim_sha_spd "Primary shaft speed received on the CAN" UWORD _CNV_A_R_ENSD_LINEA_24_CM 1 0. 0. 16383.75 ECU_ADDRESS 0xd000311e FORMAT "%8.2" /end MEASUREMENT
/begin AXIS_PTS Ctb_ajs_cor_driv_tq_fac "Breakpoint calibration of normalized driver torque factor in AJCOR function" 0xa0029c18 Vxx_ajs_spv_driv_tq_fac _REC_A2AXS_20_u1 1. _CNV_A_R_LINEAR_____136_CM 11 0. 1. FORMAT "%4.2" /end AXIS_PTS
/begin AXIS_PTS Ctb_ajs_cor_n "Breakpoint calibration of engine speed in AJCOR function" 0xa0029c24 Vxx_n _REC_A2AXS_20_u2 16383.75 _CNV_A_R_ENSD_LINEA_24_CM 9 0. 16383.75 FORMAT "%8.2" /end AXIS_PTS
/begin AXIS_PTS Ctb_ajs_cor_tco "Breakpoint calibration of engine coolant temperature in AJCOR function" 0xa0029c38 Vxx_tco _REC_A2AXS_20_u2 240. _CNV_A_R_LINEAR_____54_CM 6 -40. 200. FORMAT "%5.1" /end AXIS_PTS
/begin AXIS_PTS Ctb_ajs_dt_tq_rat "a_sm_caj_ctl_ajcorxx_xxx_xx_x_a/Breakpoint calibration of driveline torque ratio" 0xa0029c48 Vxx_ajs_dt_tq_rat _REC_A2AXS_20_u2 210. _CNV_A_R_LINEAR_____251_CM 8 -10. 200. FORMAT "%6.2" /end AXIS_PTS
/begin CHARACTERISTIC Cmp_ajs_cor_fast_cor_dly "AJCOR cartography for the maximum time to delay the fast anti-jerk correction." MAP 0xa0029c5c _REC_A1MAP_20_u2_u2_u1 655.35 _CNV_A_R_LINEAR_____34_CM 0. 655.35 FORMAT "%6.2"
 /begin AXIS_DESCR COM_AXIS Vxx_n _CNV_A_R_ENSD_LINEA_24_CM 9 0. 16383.75 FORMAT "%8.2" AXIS_PTS_REF Ctb_ajs_cor_n /end AXIS_DESCR
 /begin AXIS_DESCR COM_AXIS Vxx_ajs_spv_driv_tq_fac _CNV_A_R_LINEAR_____136_CM 11 0. 1. FORMAT "%4.2" AXIS_PTS_REF Ctb_ajs_cor_driv_tq_fac /end AXIS_DESCR
/end CHARACTERISTIC
/begin CHARACTERISTIC Cmp_ajs_cor_t1_acel_dt_clos "AJCOR time constant cartography for vehicle acceleration when driveline is closed" MAP 0xa0029d24 _REC_A1MAP_20_u2_u2_u2 65.535 _CNV_A_R_LINEAR_____58_CM 0. 65.535
 /begin AXIS_DESCR COM_AXIS Vxx_n _CNV_A_R_ENSD_LINEA_24_CM 9 0. 16383.75 FORMAT "%8.2" AXIS_PTS_REF Ctb_ajs_cor_n /end AXIS_DESCR
 /begin AXIS_DESCR COM_AXIS Vxx_ajs_dt_tq_rat _CNV_A_R_LINEAR_____251_CM 8 -10. 200. FORMAT "%6.2" AXIS_PTS_REF Ctb_ajs_dt_tq_rat /end AXIS_DESCR
/end CHARACTERISTIC
/begin CHARACTERISTIC Cmp_ajs_cor_t1_decl_dt_clos "AJCOR time constant cartography for vehicle deceleration when driveline is closed" MAP 0xa0029db4 _REC_A1MAP_20_u2_u2_u2 65.535 _CNV_A_R_LINEAR_____58_CM 0. 65.535
 /begin AXIS_DESCR COM_AXIS Vxx_n _CNV_A_R_ENSD_LINEA_24_CM 9 0. 16383.75 FORMAT "%8.2" AXIS_PTS_REF Ctb_ajs_cor_n /end AXIS_DESCR
 /begin AXIS_DESCR COM_AXIS Vxx_ajs_dt_tq_rat _CNV_A_R_LINEAR_____251_CM 8 -10. 200. FORMAT "%6.2" AXIS_PTS_REF Ctb_ajs_dt_tq_rat /end AXIS_DESCR
/end CHARACTERISTIC
/begin CHARACTERISTIC Cmp_ajs_cor_t1_fast_cor "AJCOR time constant cartography used during the boost of the curative anti-jerk function." MAP 0xa0029e44 _REC_A1MAP_20_u2_u2_u1 65.535 _CNV_A_R_LINEAR_____58_CM 0. 65.535
 /begin AXIS_DESCR COM_AXIS Vxx_n _CNV_A_R_ENSD_LINEA_24_CM 9 0. 16383.75 FORMAT "%8.2" AXIS_PTS_REF Ctb_ajs_cor_n /end AXIS_DESCR
 /begin AXIS_DESCR COM_AXIS Vxx_ajs_spv_driv_tq_fac _CNV_A_R_LINEAR_____136_CM 11 0. 1. FORMAT "%4.2" AXIS_PTS_REF Ctb_ajs_cor_driv_tq_fac /end AXIS_DESCR
/end CHARACTERISTIC
/begin CHARACTERISTIC Cmp_ajs_cor_td_acel_dt_clos "AJCOR gain cartography for vehicle acceleration when driveline is closed (unit=(N.m/rpm)^(1/2))" MAP 0xa0029f0c _REC_A1MAP_20_u2_u2_u2 1. _CNV_A_R_LINEAR_____402_CM 0. 1. FORMAT "%5.3"
 /begin AXIS_DESCR COM_AXIS Vxx_n _CNV_A_R_ENSD_LINEA_24_CM 9 0. 16383.75 FORMAT "%8.2" AXIS_PTS_REF Ctb_ajs_cor_n /end AXIS_DESCR
 /begin AXIS_DESCR COM_AXIS Vxx_ajs_dt_tq_rat _CNV_A_R_LINEAR_____251_CM 8 -10. 200. FORMAT "%6.2" AXIS_PTS_REF Ctb_ajs_dt_tq_rat /end AXIS_DESCR
/end CHARACTERISTIC
/begin CHARACTERISTIC Cmp_ajs_cor_td_decl_dt_clos "AJCOR gain cartography for vehicle deceleration when driveline is closed (unit=(N.m/rpm)^(1/2))" MAP 0xa0029f9c _REC_A1MAP_20_u2_u2_u2 1. _CNV_A_R_LINEAR_____402_CM 0. 1. FORMAT "%5.3"
 /begin AXIS_DESCR COM_AXIS Vxx_n _CNV_A_R_ENSD_LINEA_24_CM 9 0. 16383.75 FORMAT "%8.2" AXIS_PTS_REF Ctb_ajs_cor_n /end AXIS_DESCR
 /begin AXIS_DESCR COM_AXIS Vxx_ajs_dt_tq_rat _CNV_A_R_LINEAR_____251_CM 8 -10. 200. FORMAT "%6.2" AXIS_PTS_REF Ctb_ajs_dt_tq_rat /end AXIS_DESCR
/end CHARACTERISTIC
/begin CHARACTERISTIC Cmp_ajs_cor_td_fast_cor "AJCOR gain cartography used during the boost of the curative anti-jerk function (unit=(N.m/rpm)^(1/2))" MAP 0xa002a02c _REC_A1MAP_20_u2_u2_u1 1. _CNV_A_R_LINEAR_____402_CM 0. 1. FORMAT "%5.3"
 /begin AXIS_DESCR COM_AXIS Vxx_n _CNV_A_R_ENSD_LINEA_24_CM 9 0. 16383.75 FORMAT "%8.2" AXIS_PTS_REF Ctb_ajs_cor_n /end AXIS_DESCR
 /begin AXIS_DESCR COM_AXIS Vxx_ajs_spv_driv_tq_fac _CNV_A_R_LINEAR_____136_CM 11 0. 1. FORMAT "%4.2" AXIS_PTS_REF Ctb_ajs_cor_driv_tq_fac /end AXIS_DESCR
/end CHARACTERISTIC
/begin CHARACTERISTIC Cmp_ajs_cor_td_tq_fac "AJCOR cartography for modulation factors of the filter gain when driveline is closed" MAP 0xa002a0f4 _REC_A1MAP_20_u2_u1_u2 100. _CNV_A_R_LINEAR_____136_CM 0. 100.
 /begin AXIS_DESCR COM_AXIS Vxx_ajs_spv_driv_tq_fac _CNV_A_R_LINEAR_____136_CM 11 0. 1. FORMAT "%4.2" AXIS_PTS_REF Ctb_ajs_cor_driv_tq_fac /end AXIS_DESCR
 /begin AXIS_DESCR COM_AXIS Vxx_ajs_dt_tq_rat _CNV_A_R_LINEAR_____251_CM 8 -10. 200. FORMAT "%6.2" AXIS_PTS_REF Ctb_ajs_dt_tq_rat /end AXIS_DESCR
/end CHARACTERISTIC
/begin CHARACTERISTIC Ctp_ajs_cor_dz_tqe "AJCOR table for torque thresholds of the dead zone" CURVE 0xa002a1a4 _REC_A1CUR_20_u2_u2 2047.96875 _CNV_A_R_LINEAR_____123_CM 0. 2047.96875 FORMAT "%10.5"
 /begin AXIS_DESCR COM_AXIS Vxx_n _CNV_A_R_ENSD_LINEA_24_CM 9 0. 16383.75 FORMAT "%8.2" AXIS_PTS_REF Ctb_ajs_cor_n /end AXIS_DESCR
/end CHARACTERISTIC
/begin CHARACTERISTIC Ctp_ajs_cor_fast_cor_dly_fac "AJCOR table for the modulation of the maximum time to delay the boosted anti-jerk correction." CURVE 0xa002a1b8 _REC_A1CUR_20_u2_u2 100. _CNV_A_R_LINEAR_____136_CM 0. 100.
 /begin AXIS_DESCR COM_AXIS Vxx_ajs_dt_tq_rat _CNV_A_R_LINEAR_____251_CM 8 -10. 200. FORMAT "%6.2" AXIS_PTS_REF Ctb_ajs_dt_tq_rat /end AXIS_DESCR
/end CHARACTERISTIC
/begin CHARACTERISTIC Ctp_ajs_cor_max_cor_dyn_tqe "AJCOR table for the selection of the maximum dynamique torque correction" CURVE 0xa002a1c8 _REC_A1CUR_20_u2_u2 2047.96875 _CNV_A_R_LINEAR_____123_CM 0. 2047.96875 FORMAT "%10.5"
 /begin AXIS_DESCR COM_AXIS Vxx_tco _CNV_A_R_LINEAR_____54_CM 6 -40. 200. FORMAT "%5.1" AXIS_PTS_REF Ctb_ajs_cor_tco /end AXIS_DESCR
/end CHARACTERISTIC
/begin CHARACTERISTIC Ctp_ajs_cor_t1_fast_cor_fac "AJCOR table for the modulation of the time constant used during the boost of the curative anti-jerk function." CURVE 0xa002a1d4 _REC_A1CUR_20_u2_u2 100. _CNV_A_R_LINEAR_____136_CM 0. 100.
 /begin AXIS_DESCR COM_AXIS Vxx_ajs_dt_tq_rat _CNV_A_R_LINEAR_____251_CM 8 -10. 200. FORMAT "%6.2" AXIS_PTS_REF Ctb_ajs_dt_tq_rat /end AXIS_DESCR
/end CHARACTERISTIC
/begin CHARACTERISTIC Ctp_ajs_cor_td_fast_cor_fac "AJCOR table for the modulation of the gain used during the boost of the curative anti-jerk function." CURVE 0xa002a1e4 _REC_A1CUR_20_u2_u2 100. _CNV_A_R_LINEAR_____136_CM 0. 100.
 /begin AXIS_DESCR COM_AXIS Vxx_ajs_dt_tq_rat _CNV_A_R_LINEAR_____251_CM 8 -10. 200. FORMAT "%6.2" AXIS_PTS_REF Ctb_ajs_dt_tq_rat /end AXIS_DESCR
/end CHARACTERISTIC
/begin MEASUREMENT Vbx_ajs_cor_fast_cor_off "The fast anti-jerk correction is not active." UBYTE _CNV_S_2_RANGE______3_CM 1 0. 0. 1. ECU_ADDRESS 0xd00041bf BIT_MASK 0x1 /end MEASUREMENT
/begin MEASUREMENT Vbx_ajs_cor_fast_cor_on "The fast anti-jerk correction is active." UBYTE _CNV_S_2_RANGE______3_CM 1 0. 0. 1. ECU_ADDRESS 0xd00041c0 BIT_MASK 0x1 /end MEASUREMENT
/begin MEASUREMENT Vbx_ajs_cor_stt_cut "Boolean variable deactivating (1) the AJCOR function" UBYTE _CNV_S_2_RANGE______3_CM 1 0. 0. 1. ECU_ADDRESS 0xd00041c1 BIT_MASK 0x1 /end MEASUREMENT
/begin MEASUREMENT Vsx_ajs_cor_stt_para "State variable to select AJCOR parameters" UBYTE _CNV_A_R_A_165_CM 1 0. 1. 5. ECU_ADDRESS 0xd00041c2 /end MEASUREMENT
/begin MEASUREMENT Vxx_ajs_cor_dyn_tqe "Torque correction calculated by AJCOR function" SWORD _CNV_A_R_LINEAR_____123_CM 1 0. -1024. 1023.96875 ECU_ADDRESS 0xd0002fd6 FORMAT "%11.5" /end MEASUREMENT
/begin MEASUREMENT Vxx_ajs_cor_dz_tqe "torque value threshold of AJCOR dead zone" UWORD _CNV_A_R_LINEAR_____123_CM 1 0. 0. 2047.96875 ECU_ADDRESS 0xd0002fd8 FORMAT "%10.5" /end MEASUREMENT
/begin MEASUREMENT Vxx_ajs_cor_fast_cor_dly "Maximum time to inhibate the anti-jerk correction during the boost of the curative anti-jerk function." UWORD _CNV_A_R_LINEAR_____34_CM 1 0. 0. 655.35 ECU_ADDRESS 0xd0002fda FORMAT "%6.2" /end MEASUREMENT
/begin MEASUREMENT Vxx_ajs_cor_lim_dyn_tqe "Limited torque correction calculated by AJCOR function" UWORD _CNV_A_R_LINEAR_____161_CM 1 0. -400. 1647.96875 ECU_ADDRESS 0xd0002fdc FORMAT "%11.5" /end MEASUREMENT
/begin MEASUREMENT Vxx_ajs_cor_lim_dz_dyn_tqe "Limited torque correction calculated by AJCOR function. This torque calculation included dead zone" UWORD _CNV_A_R_LINEAR_____161_CM 1 0. -400. 1647.96875 ECU_ADDRESS 0xd0002fde FORMAT "%11.5" /end MEASUREMENT
/begin MEASUREMENT Vxx_ajs_cor_max_cor_dyn "Maximum dynamic torque correction autorized for AJCOR when driveline is closed" UWORD _CNV_A_R_LINEAR_____123_CM 1 0. 0. 2047.96875 ECU_ADDRESS 0xd0002fe0 FORMAT "%10.5" /end MEASUREMENT
/begin MEASUREMENT Vxx_ajs_cor_min_cor_dyn "Minimum dynamic torque correction autorized for AJCOR when driveline is closed" UWORD _CNV_A_R_LINEAR_____127_CM 1 0. -1024. 1023.96875 ECU_ADDRESS 0xd0002fe2 FORMAT "%11.5" /end MEASUREMENT
/begin MEASUREMENT Vxx_ajs_cor_t1 "AJCOR final time constant value" UWORD _CNV_A_R_LINEAR_____58_CM 1 0. 0. 65.535 ECU_ADDRESS 0xd0002fe4 /end MEASUREMENT
/begin MEASUREMENT Vxx_ajs_cor_t1_acel "AJCOR time constant value calculated for vehicle acceleration" UWORD _CNV_A_R_LINEAR_____58_CM 1 0. 0. 65.535 ECU_ADDRESS 0xd0002fe6 /end MEASUREMENT
/begin MEASUREMENT Vxx_ajs_cor_t1_decl "AJCOR time constant value calculated for vehicle deceleration" UWORD _CNV_A_R_LINEAR_____58_CM 1 0. 0. 65.535 ECU_ADDRESS 0xd0002fe8 /end MEASUREMENT
/begin MEASUREMENT Vxx_ajs_cor_t1_fast_cor "AJCOR time constant value used during the boost of the curative anti-jerk function" UWORD _CNV_A_R_LINEAR_____58_CM 1 0. 0. 65.535 ECU_ADDRESS 0xd0002fea /end MEASUREMENT
/begin MEASUREMENT Vxx_ajs_cor_td "AJCOR final gain value (NB:unit=(N.m/rpm)^(1/2))" UWORD _CNV_A_R_LINEAR_____402_CM 1 0. 0. 1. ECU_ADDRESS 0xd0002fec FORMAT "%5.3" /end MEASUREMENT
/begin MEASUREMENT Vxx_ajs_cor_td_acel "AJCOR gain value calculated for vehicle acceleration (unit=(N.m/rpm)^(1/2))" UWORD _CNV_A_R_LINEAR_____402_CM 1 0. 0. 1. ECU_ADDRESS 0xd0002fee FORMAT "%5.3" /end MEASUREMENT
/begin MEASUREMENT Vxx_ajs_cor_td_decl "AJCOR gain value calculated for vehicle deceleration (unit=(N.m/rpm)^(1/2))" UWORD _CNV_A_R_LINEAR_____402_CM 1 0. 0. 1. ECU_ADDRESS 0xd0002ff0 FORMAT "%5.3" /end MEASUREMENT
/begin MEASUREMENT Vxx_ajs_cor_td_fast_cor "AJCOR gain value used during the boost of the curative anti-jerk function (NB:unit=(N.m/rpm)^(1/2))" UWORD _CNV_A_R_LINEAR_____402_CM 1 0. 0. 1. ECU_ADDRESS 0xd0002ff2 FORMAT "%5.3" /end MEASUREMENT
/begin MEASUREMENT Vxx_ajs_cor_td_tq_fac "AjCOR modulation factor for the filter gain" UWORD _CNV_A_R_LINEAR_____136_CM 1 0. 0. 100. ECU_ADDRESS 0xd0002ff4 /end MEASUREMENT
/begin MEASUREMENT Vxx_ajs_cor_tqe "Torque correction calculated by AJCOR function but not limited" UWORD _CNV_A_R_LINEAR_____161_CM 1 0. -400. 1647.96875 ECU_ADDRESS 0xd0002ff6 FORMAT "%11.5" /end MEASUREMENT
/begin MEASUREMENT Vxx_ajs_cor_tqe_tmp "Intermediate calculation of the torque correction in the AJCOR filter" UWORD _CNV_A_R_LINEAR_____403_CM 1 0. -400. 1647.96875 ECU_ADDRESS 0xd0002ff8 FORMAT "%10.5" /end MEASUREMENT
/begin CHARACTERISTIC Cbx_ajs_cor_driv_cut_cfm "Boolean calibration to cut AJCOR if an injection cut is requested" VALUE 0xa00212c2 _REC_S1VAL_20_u1 1. _CNV_A_R_ECME_LINEA_0_CM 0. 1. FORMAT "%1.0" /end CHARACTERISTIC
/begin CHARACTERISTIC Cbx_ajs_cor_dz_cfm "Boolean calibration to active AJCOR dead zone" VALUE 0xa00212c3 _REC_S1VAL_20_u1 1. _CNV_A_R_ECME_LINEA_0_CM 0. 1. FORMAT "%1.0" /end CHARACTERISTIC
/begin CHARACTERISTIC Cbx_ajs_cor_stt_cfm "Boolean calibration to deactivate AJCOR function (0) manually" VALUE 0xa00212c4 _REC_S1VAL_20_u1 1. _CNV_A_R_ECME_LINEA_0_CM 0. 1. FORMAT "%1.0" /end CHARACTERISTIC
/begin CHARACTERISTIC Cxx_ajs_cor_dz_dly "Time delay of AJCOR dead zone" VALUE 0xa00212c5 _REC_S1VAL_20_u1 25.5 _CNV_A_R_LINEAR_____4_CM 0. 25.5 FORMAT "%4.1" /end CHARACTERISTIC
/begin CHARACTERISTIC Cxx_ajs_cor_max_cor_dyn_dt_open "Maximum dynamic torque correction autorized for AJCOR when driveline is open" VALUE 0xa00212a6 _REC_S1VAL_20_u2 2047.96875 _CNV_A_R_LINEAR_____127_CM -1024. 1023.96875 FORMAT "%10.5" /end CHARACTERISTIC
/begin CHARACTERISTIC Cxx_ajs_cor_min_cor_dyn_dt_clos "Minimum dynamic torque correction autorized for AJCOR when driveline is closed" VALUE 0xa00212a8 _REC_S1VAL_20_u2 2047.96875 _CNV_A_R_LINEAR_____127_CM -1024. 1023.96875 FORMAT "%10.5" /end CHARACTERISTIC
/begin CHARACTERISTIC Cxx_ajs_cor_min_cor_dyn_dt_open "Minimum dynamic torque correction autorized for AJCOR when driveline is opened" VALUE 0xa00212aa _REC_S1VAL_20_u2 2047.96875 _CNV_A_R_LINEAR_____127_CM -1024. 1023.96875 FORMAT "%10.5" /end CHARACTERISTIC
/begin CHARACTERISTIC Cxx_ajs_cor_t1_acel_dt_modu "AJCOR time constant value when driveline is in modulation mode for vehicle acceleration" VALUE 0xa00212ac _REC_S1VAL_20_u2 65.535 _CNV_A_R_LINEAR_____58_CM 0. 65.535 /end CHARACTERISTIC
/begin CHARACTERISTIC Cxx_ajs_cor_t1_acel_dt_open "AJCOR time constant value when driveline is open for vehicle acceleration" VALUE 0xa00212ae _REC_S1VAL_20_u2 65.535 _CNV_A_R_LINEAR_____58_CM 0. 65.535 /end CHARACTERISTIC
/begin CHARACTERISTIC Cxx_ajs_cor_t1_decl_dt_modu "AJCOR time constant value when driveline is in modulation mode for vehicle deceleration" VALUE 0xa00212b0 _REC_S1VAL_20_u2 65.535 _CNV_A_R_LINEAR_____58_CM 0. 65.535 /end CHARACTERISTIC
/begin CHARACTERISTIC Cxx_ajs_cor_t1_decl_dt_open "AJCOR time constant value when driveline is open for vehicle deceleration" VALUE 0xa00212b2 _REC_S1VAL_20_u2 65.535 _CNV_A_R_LINEAR_____58_CM 0. 65.535 /end CHARACTERISTIC
/begin CHARACTERISTIC Cxx_ajs_cor_t1_dt_ini "AJCOR time constant value during initialisation" VALUE 0xa00212b4 _REC_S1VAL_20_u2 65.535 _CNV_A_R_LINEAR_____58_CM 0. 65.535 /end CHARACTERISTIC
/begin CHARACTERISTIC Cxx_ajs_cor_td_acel_dt_modu "AJCOR gain value when driveline is in modulation mode for vehicle acceleration (unit=(N.m/rpm)^(1/2)" VALUE 0xa00212b6 _REC_S1VAL_20_u2 1. _CNV_A_R_LINEAR_____402_CM 0. 1. FORMAT "%5.3" /end CHARACTERISTIC
/begin CHARACTERISTIC Cxx_ajs_cor_td_acel_dt_open "AJCOR gain value when driveline is open for vehicle acceleration (unit=(N.m/rpm)^(1/2))" VALUE 0xa00212b8 _REC_S1VAL_20_u2 1. _CNV_A_R_LINEAR_____402_CM 0. 1. FORMAT "%5.3" /end CHARACTERISTIC
/begin CHARACTERISTIC Cxx_ajs_cor_td_decl_dt_modu "AJCOR gain value when driveline is in modulation for vehicle deceleration (unit=(N.m/rpm)^(1/2))" VALUE 0xa00212ba _REC_S1VAL_20_u2 1. _CNV_A_R_LINEAR_____402_CM 0. 1. FORMAT "%5.3" /end CHARACTERISTIC
/begin CHARACTERISTIC Cxx_ajs_cor_td_decl_dt_open "AJCOR gain value when driveline is open for vehicle deceleration (unit=(N.m/rpm)^(1/2))" VALUE 0xa00212bc _REC_S1VAL_20_u2 1. _CNV_A_R_LINEAR_____402_CM 0. 1. FORMAT "%5.3" /end CHARACTERISTIC
/begin CHARACTERISTIC Cxx_ajs_cor_td_dt_ini "AJCOR gain value during initialisation (unit=(N.m/rpm)^(1/2))" VALUE 0xa00212be _REC_S1VAL_20_u2 1. _CNV_A_R_LINEAR_____402_CM 0. 1. FORMAT "%5.3" /end CHARACTERISTIC
/begin CHARACTERISTIC Cxx_ajs_cor_tkof_vs_thd "Threshold of vehicle speed to activate the anti-jerk correction during take off" VALUE 0xa00212c0 _REC_S1VAL_20_u2 655.35 _CNV_A_R_LINEAR_____70_CM 0. 655.35 FORMAT "%6.2" /end CHARACTERISTIC
/begin MEASUREMENT Vbx_cru_on_off_in "Input of the cruise control main switch" UBYTE _CNV_S_2_RANGE______3_CM 1 0. 0. 1. ECU_ADDRESS 0xd0004b56 BIT_MASK 0x1 /end MEASUREMENT
/begin MEASUREMENT Vbx_eprm_rdy "The EEPROM is ready to be written" UBYTE _CNV_S_2_RANGE______3_CM 1 0. 0. 1. ECU_ADDRESS 0xd0004b58 BIT_MASK 0x1 /end MEASUREMENT
/begin MEASUREMENT Vbx_sl_on_off_in "Input of the speed limiter main switch" UBYTE _CNV_S_2_RANGE______3_CM 1 0. 0. 1. ECU_ADDRESS 0xd0004b57 BIT_MASK 0x1 /end MEASUREMENT
/begin MEASUREMENT Vxx_cru_sl_whl_cmd_in "Input of the cruise control and speed limiter steering wheel push buttons" UWORD _CNV_A_R_LINEAR_____52_CM 1 0. 0. 25000. ECU_ADDRESS 0xd00038b2 FORMAT "%5.0" /end MEASUREMENT
/begin MEASUREMENT lv_cru_swi_on_off "Cruise control main switch (inverted or not)" UBYTE _CNV_S_2_RANGE______3_CM 1 0. 0. 1. ECU_ADDRESS 0xd0004b52 /end MEASUREMENT
/begin MEASUREMENT lv_pin_cru_swi_on_off "Cruise control main switch" UBYTE _CNV_S_2_RANGE______3_CM 1 0. 0. 1. ECU_ADDRESS 0xd0004b54 /end MEASUREMENT
/begin MEASUREMENT lv_pin_vvsl_swi_on_off "Speed limiter main switch" UBYTE _CNV_S_2_RANGE______3_CM 1 0. 0. 1. ECU_ADDRESS 0xd0004b55 /end MEASUREMENT
/begin MEASUREMENT lv_vvsl_swi_on_off "Speed limiter main switch (inverted or not)" UBYTE _CNV_S_2_RANGE______3_CM 1 0. 0. 1. ECU_ADDRESS 0xd0004b53 /end MEASUREMENT
/begin MEASUREMENT v_cru "Cruise control analog input" UWORD _CNV_A_R_LINEAR_____16_CM 1 0. 0. 4.99984741210938 ECU_ADDRESS 0xd00038b0 FORMAT "%6.4" /end MEASUREMENT
/begin CHARACTERISTIC c_ctr_fil_asw "Filter Time for Cruise Control and Speed Limiter Logical Inputs" VALUE 0xa00211cc _REC_S1VAL_20_u1 255. _CNV_A_R_LINEAR_____144_CM 0. 255. FORMAT "%3.0" /end CHARACTERISTIC
/begin CHARACTERISTIC lc_linp_conv_cru_swi "Switch if logical cruise controle main switch signal input should be inverted" VALUE 0xa00211e5 _REC_S1VAL_20_u1 1. _CNV_S_2_RANGE______3_CM 0. 1. /end CHARACTERISTIC
/begin CHARACTERISTIC lc_linp_conv_vvsl_swi "Switch if logical speed limiter main switch signal input should be inverted" VALUE 0xa00211e6 _REC_S1VAL_20_u1 1. _CNV_S_2_RANGE______3_CM 0. 1. /end CHARACTERISTIC
/begin MEASUREMENT Vtx_vin_crc_data[0] "Value of VIN and CRC data" UBYTE _CNV_A_R_A_165_CM 1 0. 0. 255. DISPLAY_IDENTIFIER DgDgtSer_0_NVM.Vtx_vin_crc_data_NVM[0] ECU_ADDRESS 0xd0005324 /end MEASUREMENT
/begin MEASUREMENT Vtx_vin_crc_data[1] "Value of VIN and CRC data" UBYTE _CNV_A_R_A_165_CM 1 0. 0. 255. DISPLAY_IDENTIFIER DgDgtSer_0_NVM.Vtx_vin_crc_data_NVM[1] ECU_ADDRESS 0xd0005325 /end MEASUREMENT
/begin MEASUREMENT Vtx_vin_crc_data[2] "Value of VIN and CRC data" UBYTE _CNV_A_R_A_165_CM 1 0. 0. 255. DISPLAY_IDENTIFIER DgDgtSer_0_NVM.Vtx_vin_crc_data_NVM[2] ECU_ADDRESS 0xd0005326 /end MEASUREMENT
/begin MEASUREMENT Vtx_vin_crc_data[3] "Value of VIN and CRC data" UBYTE _CNV_A_R_A_165_CM 1 0. 0. 255. DISPLAY_IDENTIFIER DgDgtSer_0_NVM.Vtx_vin_crc_data_NVM[3] ECU_ADDRESS 0xd0005327 /end MEASUREMENT
/begin MEASUREMENT Vtx_vin_crc_data[4] "Value of VIN and CRC data" UBYTE _CNV_A_R_A_165_CM 1 0. 0. 255. DISPLAY_IDENTIFIER DgDgtSer_0_NVM.Vtx_vin_crc_data_NVM[4] ECU_ADDRESS 0xd0005328 /end MEASUREMENT
/begin MEASUREMENT Vtx_vin_crc_data[5] "Value of VIN and CRC data" UBYTE _CNV_A_R_A_165_CM 1 0. 0. 255. DISPLAY_IDENTIFIER DgDgtSer_0_NVM.Vtx_vin_crc_data_NVM[5] ECU_ADDRESS 0xd0005329 /end MEASUREMENT
/begin MEASUREMENT Vtx_vin_crc_data[6] "Value of VIN and CRC data" UBYTE _CNV_A_R_A_165_CM 1 0. 0. 255. DISPLAY_IDENTIFIER DgDgtSer_0_NVM.Vtx_vin_crc_data_NVM[6] ECU_ADDRESS 0xd000532a /end MEASUREMENT
/begin MEASUREMENT Vtx_vin_crc_data[7] "Value of VIN and CRC data" UBYTE _CNV_A_R_A_165_CM 1 0. 0. 255. DISPLAY_IDENTIFIER DgDgtSer_0_NVM.Vtx_vin_crc_data_NVM[7] ECU_ADDRESS 0xd000532b /end MEASUREMENT
/begin MEASUREMENT Vtx_vin_crc_data[8] "Value of VIN and CRC data" UBYTE _CNV_A_R_A_165_CM 1 0. 0. 255. DISPLAY_IDENTIFIER DgDgtSer_0_NVM.Vtx_vin_crc_data_NVM[8] ECU_ADDRESS 0xd000532c /end MEASUREMENT
/begin MEASUREMENT Vtx_vin_crc_data[9] "Value of VIN and CRC data" UBYTE _CNV_A_R_A_165_CM 1 0. 0. 255. DISPLAY_IDENTIFIER DgDgtSer_0_NVM.Vtx_vin_crc_data_NVM[9] ECU_ADDRESS 0xd000532d /end MEASUREMENT
/begin MEASUREMENT Vtx_vin_crc_data[10] "Value of VIN and CRC data" UBYTE _CNV_A_R_A_165_CM 1 0. 0. 255. DISPLAY_IDENTIFIER DgDgtSer_0_NVM.Vtx_vin_crc_data_NVM[10] ECU_ADDRESS 0xd000532e /end MEASUREMENT
/begin MEASUREMENT Vtx_vin_crc_data[11] "Value of VIN and CRC data" UBYTE _CNV_A_R_A_165_CM 1 0. 0. 255. DISPLAY_IDENTIFIER DgDgtSer_0_NVM.Vtx_vin_crc_data_NVM[11] ECU_ADDRESS 0xd000532f /end MEASUREMENT
/begin MEASUREMENT Vtx_vin_crc_data[12] "Value of VIN and CRC data" UBYTE _CNV_A_R_A_165_CM 1 0. 0. 255. DISPLAY_IDENTIFIER DgDgtSer_0_NVM.Vtx_vin_crc_data_NVM[12] ECU_ADDRESS 0xd0005330 /end MEASUREMENT
/begin MEASUREMENT Vtx_vin_crc_data[13] "Value of VIN and CRC data" UBYTE _CNV_A_R_A_165_CM 1 0. 0. 255. DISPLAY_IDENTIFIER DgDgtSer_0_NVM.Vtx_vin_crc_data_NVM[13] ECU_ADDRESS 0xd0005331 /end MEASUREMENT
/begin MEASUREMENT Vtx_vin_crc_data[14] "Value of VIN and CRC data" UBYTE _CNV_A_R_A_165_CM 1 0. 0. 255. DISPLAY_IDENTIFIER DgDgtSer_0_NVM.Vtx_vin_crc_data_NVM[14] ECU_ADDRESS 0xd0005332 /end MEASUREMENT
/begin MEASUREMENT Vtx_vin_crc_data[15] "Value of VIN and CRC data" UBYTE _CNV_A_R_A_165_CM 1 0. 0. 255. DISPLAY_IDENTIFIER DgDgtSer_0_NVM.Vtx_vin_crc_data_NVM[15] ECU_ADDRESS 0xd0005333 /end MEASUREMENT
/begin MEASUREMENT Vtx_vin_crc_data[16] "Value of VIN and CRC data" UBYTE _CNV_A_R_A_165_CM 1 0. 0. 255. DISPLAY_IDENTIFIER DgDgtSer_0_NVM.Vtx_vin_crc_data_NVM[16] ECU_ADDRESS 0xd0005334 /end MEASUREMENT
/begin MEASUREMENT Vtx_vin_crc_data[17] "Value of VIN and CRC data" UBYTE _CNV_A_R_A_165_CM 1 0. 0. 255. DISPLAY_IDENTIFIER DgDgtSer_0_NVM.Vtx_vin_crc_data_NVM[17] ECU_ADDRESS 0xd0005335 /end MEASUREMENT
/begin MEASUREMENT Vtx_vin_crc_data[18] "Value of VIN and CRC data" UBYTE _CNV_A_R_A_165_CM 1 0. 0. 255. DISPLAY_IDENTIFIER DgDgtSer_0_NVM.Vtx_vin_crc_data_NVM[18] ECU_ADDRESS 0xd0005336 /end MEASUREMENT
/begin MEASUREMENT Vsx_diag_sess "Diagnostic session table" UBYTE _CNV_A_R_ECME_LINEA_0_CM 1 0. 0. 255. ECU_ADDRESS 0xd0001433 FORMAT "%3.0" /end MEASUREMENT
/begin CHARACTERISTIC Cbx_fail_dft_ini_req "Clear diagnostics information request" VALUE 0xa0021448 _REC_S1VAL_20_u1 1. _CNV_S_2_RANGE______3_CM 0. 1. /end CHARACTERISTIC
/begin CHARACTERISTIC Ctx_vin_crc_ini_data[0] "Calibration value of VIN and CRC data" VALUE 0xa002a7a4 _REC_S1VAL_20_u1 255. _CNV_A_R_ECME_LINEA_0_CM 0. 255. FORMAT "%1.0" /end CHARACTERISTIC
/begin CHARACTERISTIC Ctx_vin_crc_ini_data[1] "Calibration value of VIN and CRC data" VALUE 0xa002a7a5 _REC_S1VAL_20_u1 255. _CNV_A_R_ECME_LINEA_0_CM 0. 255. FORMAT "%1.0" /end CHARACTERISTIC
/begin CHARACTERISTIC Ctx_vin_crc_ini_data[2] "Calibration value of VIN and CRC data" VALUE 0xa002a7a6 _REC_S1VAL_20_u1 255. _CNV_A_R_ECME_LINEA_0_CM 0. 255. FORMAT "%1.0" /end CHARACTERISTIC
/begin CHARACTERISTIC Ctx_vin_crc_ini_data[3] "Calibration value of VIN and CRC data" VALUE 0xa002a7a7 _REC_S1VAL_20_u1 255. _CNV_A_R_ECME_LINEA_0_CM 0. 255. FORMAT "%1.0" /end CHARACTERISTIC
/begin CHARACTERISTIC Ctx_vin_crc_ini_data[4] "Calibration value of VIN and CRC data" VALUE 0xa002a7a8 _REC_S1VAL_20_u1 255. _CNV_A_R_ECME_LINEA_0_CM 0. 255. FORMAT "%1.0" /end CHARACTERISTIC
/begin CHARACTERISTIC Ctx_vin_crc_ini_data[5] "Calibration value of VIN and CRC data" VALUE 0xa002a7a9 _REC_S1VAL_20_u1 255. _CNV_A_R_ECME_LINEA_0_CM 0. 255. FORMAT "%1.0" /end CHARACTERISTIC
/begin CHARACTERISTIC Ctx_vin_crc_ini_data[6] "Calibration value of VIN and CRC data" VALUE 0xa002a7aa _REC_S1VAL_20_u1 255. _CNV_A_R_ECME_LINEA_0_CM 0. 255. FORMAT "%1.0" /end CHARACTERISTIC
/begin CHARACTERISTIC Ctx_vin_crc_ini_data[7] "Calibration value of VIN and CRC data" VALUE 0xa002a7ab _REC_S1VAL_20_u1 255. _CNV_A_R_ECME_LINEA_0_CM 0. 255. FORMAT "%1.0" /end CHARACTERISTIC
/begin CHARACTERISTIC Ctx_vin_crc_ini_data[8] "Calibration value of VIN and CRC data" VALUE 0xa002a7ac _REC_S1VAL_20_u1 255. _CNV_A_R_ECME_LINEA_0_CM 0. 255. FORMAT "%1.0" /end CHARACTERISTIC
/begin CHARACTERISTIC Ctx_vin_crc_ini_data[9] "Calibration value of VIN and CRC data" VALUE 0xa002a7ad _REC_S1VAL_20_u1 255. _CNV_A_R_ECME_LINEA_0_CM 0. 255. FORMAT "%1.0" /end CHARACTERISTIC
/begin CHARACTERISTIC Ctx_vin_crc_ini_data[10] "Calibration value of VIN and CRC data" VALUE 0xa002a7ae _REC_S1VAL_20_u1 255. _CNV_A_R_ECME_LINEA_0_CM 0. 255. FORMAT "%1.0" /end CHARACTERISTIC
/begin CHARACTERISTIC Ctx_vin_crc_ini_data[11] "Calibration value of VIN and CRC data" VALUE 0xa002a7af _REC_S1VAL_20_u1 255. _CNV_A_R_ECME_LINEA_0_CM 0. 255. FORMAT "%1.0" /end CHARACTERISTIC
/begin CHARACTERISTIC Ctx_vin_crc_ini_data[12] "Calibration value of VIN and CRC data" VALUE 0xa002a7b0 _REC_S1VAL_20_u1 255. _CNV_A_R_ECME_LINEA_0_CM 0. 255. FORMAT "%1.0" /end CHARACTERISTIC
/begin CHARACTERISTIC Ctx_vin_crc_ini_data[13] "Calibration value of VIN and CRC data" VALUE 0xa002a7b1 _REC_S1VAL_20_u1 255. _CNV_A_R_ECME_LINEA_0_CM 0. 255. FORMAT "%1.0" /end CHARACTERISTIC
/begin CHARACTERISTIC Ctx_vin_crc_ini_data[14] "Calibration value of VIN and CRC data" VALUE 0xa002a7b2 _REC_S1VAL_20_u1 255. _CNV_A_R_ECME_LINEA_0_CM 0. 255. FORMAT "%1.0" /end CHARACTERISTIC
/begin CHARACTERISTIC Ctx_vin_crc_ini_data[15] "Calibration value of VIN and CRC data" VALUE 0xa002a7b3 _REC_S1VAL_20_u1 255. _CNV_A_R_ECME_LINEA_0_CM 0. 255. FORMAT "%1.0" /end CHARACTERISTIC
/begin CHARACTERISTIC Ctx_vin_crc_ini_data[16] "Calibration value of VIN and CRC data" VALUE 0xa002a7b4 _REC_S1VAL_20_u1 255. _CNV_A_R_ECME_LINEA_0_CM 0. 255. FORMAT "%1.0" /end CHARACTERISTIC
/begin CHARACTERISTIC Ctx_vin_crc_ini_data[17] "Calibration value of VIN and CRC data" VALUE 0xa002a7b5 _REC_S1VAL_20_u1 255. _CNV_A_R_ECME_LINEA_0_CM 0. 255. FORMAT "%1.0" /end CHARACTERISTIC
/begin CHARACTERISTIC Ctx_vin_crc_ini_data[18] "Calibration value of VIN and CRC data" VALUE 0xa002a7b6 _REC_S1VAL_20_u1 255. _CNV_A_R_ECME_LINEA_0_CM 0. 255. FORMAT "%1.0" /end CHARACTERISTIC
/begin CHARACTERISTIC Cxx_c_nr1 "Calibration number (byte 0)" VALUE 0xa0021449 _REC_S1VAL_20_u1 255. _CNV_A_R_ECME_LINEA_0_CM 0. 255. FORMAT "%3.0" /end CHARACTERISTIC
/begin CHARACTERISTIC Cxx_c_nr2 "Calibration number (byte 1)" VALUE 0xa002144a _REC_S1VAL_20_u1 255. _CNV_A_R_ECME_LINEA_0_CM 0. 255. FORMAT "%3.0" /end CHARACTERISTIC
/begin CHARACTERISTIC Cxx_cert_id "Approval Number basic part list" VALUE 0xa002144b _REC_S1VAL_20_u1 255. _CNV_A_R_ECME_LINEA_0_CM 0. 255. FORMAT "%3.0" /end CHARACTERISTIC
/begin CHARACTERISTIC Cxx_diag_nr "Diagnostic identification code" VALUE 0xa002144c _REC_S1VAL_20_u1 255. _CNV_A_R_ECME_LINEA_0_CM 0. 255. FORMAT "%3.0" /end CHARACTERISTIC
/begin CHARACTERISTIC Cxx_ecu_nr1 "PartNumber.LowerPart (byte 0)" VALUE 0xa002144d _REC_S1VAL_20_u1 255. _CNV_A_R_ECME_LINEA_0_CM 0. 255. FORMAT "%3.0" /end CHARACTERISTIC
/begin CHARACTERISTIC Cxx_ecu_nr2 "PartNumber.LowerPart (byte 1)" VALUE 0xa002144e _REC_S1VAL_20_u1 255. _CNV_A_R_ECME_LINEA_0_CM 0. 255. FORMAT "%3.0" /end CHARACTERISTIC
/begin CHARACTERISTIC Cxx_ecu_nr3 "PartNumber.LowerPart (byte 2)" VALUE 0xa002144f _REC_S1VAL_20_u1 255. _CNV_A_R_ECME_LINEA_0_CM 0. 255. FORMAT "%3.0" /end CHARACTERISTIC
/begin CHARACTERISTIC Cxx_ecu_nr4 "PartNumber.LowerPart (byte 3)" VALUE 0xa0021450 _REC_S1VAL_20_u1 255. _CNV_A_R_ECME_LINEA_0_CM 0. 255. FORMAT "%3.0" /end CHARACTERISTIC
/begin CHARACTERISTIC Cxx_ecu_nr5 "PartNumber.LowerPart (byte 4)" VALUE 0xa0021451 _REC_S1VAL_20_u1 255. _CNV_A_R_ECME_LINEA_0_CM 0. 255. FORMAT "%3.0" /end CHARACTERISTIC
/begin CHARACTERISTIC Cxx_etun_nr "Other system features" VALUE 0xa0021452 _REC_S1VAL_20_u1 255. _CNV_A_R_ECME_LINEA_0_CM 0. 255. FORMAT "%3.0" /end CHARACTERISTIC
/begin CHARACTERISTIC Cxx_oem_id "Car manufacturer identification code" VALUE 0xa0021453 _REC_S1VAL_20_u1 255. _CNV_A_R_ECME_LINEA_0_CM 0. 255. FORMAT "%3.0" /end CHARACTERISTIC
/begin CHARACTERISTIC Cxx_prog_nr1 "Software number (byte 0)" VALUE 0xa0021454 _REC_S1VAL_20_u1 255. _CNV_A_R_ECME_LINEA_0_CM 0. 255. FORMAT "%3.0" /end CHARACTERISTIC
/begin CHARACTERISTIC Cxx_prog_nr2 "Software number (byte 1)" VALUE 0xa0021455 _REC_S1VAL_20_u1 255. _CNV_A_R_ECME_LINEA_0_CM 0. 255. FORMAT "%3.0" /end CHARACTERISTIC
/begin CHARACTERISTIC Cxx_rsa_did_lim_val_cfm "Limit identifier of RSA DID part" VALUE 0xa0021446 _REC_S1VAL_20_u2 65535. _CNV_A_R_ECME_LINEA_0_CM 0. 65535. FORMAT "%5.0" /end CHARACTERISTIC
/begin CHARACTERISTIC Cxx_supl_nr1 "Supplier number (byte 0)" VALUE 0xa0021456 _REC_S1VAL_20_u1 255. _CNV_A_R_ECME_LINEA_0_CM 0. 255. FORMAT "%3.0" /end CHARACTERISTIC
/begin CHARACTERISTIC Cxx_supl_nr2 "Supplier number (byte 1)" VALUE 0xa0021457 _REC_S1VAL_20_u1 255. _CNV_A_R_ECME_LINEA_0_CM 0. 255. FORMAT "%3.0" /end CHARACTERISTIC
/begin CHARACTERISTIC Cxx_supl_nr3 "Supplier number (byte 2)" VALUE 0xa0021458 _REC_S1VAL_20_u1 255. _CNV_A_R_ECME_LINEA_0_CM 0. 255. FORMAT "%3.0" /end CHARACTERISTIC
/begin CHARACTERISTIC Cxx_sys_c_nr "Other system features" VALUE 0xa0021459 _REC_S1VAL_20_u1 255. _CNV_A_R_ECME_LINEA_0_CM 0. 255. FORMAT "%3.0" /end CHARACTERISTIC
/begin CHARACTERISTIC Cxx_vers_nr1 "Edition number (byte 0)" VALUE 0xa002145a _REC_S1VAL_20_u1 255. _CNV_A_R_ECME_LINEA_0_CM 0. 255. FORMAT "%3.0" /end CHARACTERISTIC
/begin CHARACTERISTIC Cxx_vers_nr2 "Edition number (byte 1)" VALUE 0xa002145b _REC_S1VAL_20_u1 255. _CNV_A_R_ECME_LINEA_0_CM 0. 255. FORMAT "%3.0" /end CHARACTERISTIC
/begin CHARACTERISTIC Cbx_obd_fail_dft_ini_req "Initialisation request of OBD data." VALUE 0xa00207b8 _REC_S1VAL_20_u1 1. _CNV_S_2_RANGE______3_CM 0. 1. /end CHARACTERISTIC
/begin MEASUREMENT Vxx_fsl_km_NVM "Mileage recording" ULONG _CNV_A_R_LINEAR_____404_CM 1 0. 0. 16000000. DISPLAY_IDENTIFIER PcCruSpt_NVM.Vxx_fsl_km_NVM ECU_ADDRESS 0xd00020d8 FORMAT "%10.1" /end MEASUREMENT
/begin MEASUREMENT Vxx_max_vs_NVM "Dynamic requested speed for FSL as read in EEPROM(default value $FFFE)." UWORD _CNV_A_R_LINEAR_____70_CM 1 0. 0. 655.35 DISPLAY_IDENTIFIER PcCruSpt_NVM.Vxx_max_vs_NVM ECU_ADDRESS 0xd00020e0 FORMAT "%6.2" /end MEASUREMENT
/begin MEASUREMENT Vxx_cru_fail_NVM "Carrier of all the failures which cause CC failure" UBYTE _CNV_A_R_ECME_LINEA_0_CM 1 0. 0. 255. DISPLAY_IDENTIFIER PcCruSpt_NVM.Vxx_cru_fail_NVM ECU_ADDRESS 0xd00020e2 FORMAT "%3.0" /end MEASUREMENT
/begin MEASUREMENT Vxx_cru_sl_fail_NVM "Carrier of all the failures which cause CC/SL failure" UBYTE _CNV_A_R_ECME_LINEA_0_CM 1 0. 0. 255. DISPLAY_IDENTIFIER PcCruSpt_NVM.Vxx_cru_sl_fail_NVM ECU_ADDRESS 0xd00020e3 FORMAT "%3.0" /end MEASUREMENT
/begin MEASUREMENT Vxx_cru_sl_dacn_sys_NVM "Compilation of all the cru/sl normal deactivations due to system causes. Saved in E≤PROM." UBYTE _CNV_A_R_ECME_LINEA_0_CM 1 0. 0. 255. DISPLAY_IDENTIFIER PcCruSpt_NVM.Vxx_cru_sl_dacn_sys_NVM ECU_ADDRESS 0xd00020e4 FORMAT "%3.0" /end MEASUREMENT
/begin MEASUREMENT Vbx_sli_buf_sf_NVM "1 = The 4 buffers (Sxx_sli_brk_buf, Sxx_sli_clu_buf, Sxx_sli_cru_stt_buf and Sxx_sli_vs_buf) correspond to the last shut off / 0 = the" UBYTE _CNV_S_2_RANGE______3_CM 1 0. 0. 1. DISPLAY_IDENTIFIER PcCruSpt_NVM.Vbx_sli_buf_sf_NVM ECU_ADDRESS 0xd00020e5 BIT_MASK 0x1 /end MEASUREMENT
/begin MEASUREMENT Sxx_sli_brk_buf_NVM "Buffer of the 16 last seconds of the brake status stored in EEPROM" UWORD _CNV_A_R_ECME_LINEA_0_CM 1 0. 0. 65535. DISPLAY_IDENTIFIER PcCruSpt_RVLV2_NVM.Sxx_sli_brk_buf_NVM ECU_ADDRESS 0xd00020e8 FORMAT "%5.0" /end MEASUREMENT
/begin MEASUREMENT Sxx_sli_clu_buf_NVM "Buffer of the 16 last seconds of the clutch status stored in EEPROM" UWORD _CNV_A_R_ECME_LINEA_0_CM 1 0. 0. 65535. DISPLAY_IDENTIFIER PcCruSpt_RVLV2_NVM.Sxx_sli_clu_buf_NVM ECU_ADDRESS 0xd00020ea FORMAT "%5.0" /end MEASUREMENT
/begin MEASUREMENT Sxx_sli_cru_stt_buf_NVM "Buffer of the 16 last seconds of the cruise control status stored in EEPROM" UWORD _CNV_A_R_ECME_LINEA_0_CM 1 0. 0. 65535. DISPLAY_IDENTIFIER PcCruSpt_RVLV2_NVM.Sxx_sli_cru_stt_buf_NVM ECU_ADDRESS 0xd00020ec FORMAT "%5.0" /end MEASUREMENT
/begin MEASUREMENT Sxx_sli_vs_buf[0] "Buffer of the 16 last seconds of the vehicle speed stored in EEPROM" UBYTE _CNV_A_R_ECME_LINEA_0_CM 1 0. 0. 255. DISPLAY_IDENTIFIER PcCruSpt_RVLV2_NVM.Sxx_sli_vs_buf_NVM[0] ECU_ADDRESS 0xd00020f0 FORMAT "%3.0" /end MEASUREMENT
/begin MEASUREMENT Sxx_sli_vs_buf[1] "Buffer of the 16 last seconds of the vehicle speed stored in EEPROM" UBYTE _CNV_A_R_ECME_LINEA_0_CM 1 0. 0. 255. DISPLAY_IDENTIFIER PcCruSpt_RVLV2_NVM.Sxx_sli_vs_buf_NVM[1] ECU_ADDRESS 0xd00020f1 FORMAT "%3.0" /end MEASUREMENT
/begin MEASUREMENT Sxx_sli_vs_buf[2] "Buffer of the 16 last seconds of the vehicle speed stored in EEPROM" UBYTE _CNV_A_R_ECME_LINEA_0_CM 1 0. 0. 255. DISPLAY_IDENTIFIER PcCruSpt_RVLV2_NVM.Sxx_sli_vs_buf_NVM[2] ECU_ADDRESS 0xd00020f2 FORMAT "%3.0" /end MEASUREMENT
/begin MEASUREMENT Sxx_sli_vs_buf[3] "Buffer of the 16 last seconds of the vehicle speed stored in EEPROM" UBYTE _CNV_A_R_ECME_LINEA_0_CM 1 0. 0. 255. DISPLAY_IDENTIFIER PcCruSpt_RVLV2_NVM.Sxx_sli_vs_buf_NVM[3] ECU_ADDRESS 0xd00020f3 FORMAT "%3.0" /end MEASUREMENT
/begin MEASUREMENT Sxx_sli_vs_buf[4] "Buffer of the 16 last seconds of the vehicle speed stored in EEPROM" UBYTE _CNV_A_R_ECME_LINEA_0_CM 1 0. 0. 255. DISPLAY_IDENTIFIER PcCruSpt_RVLV2_NVM.Sxx_sli_vs_buf_NVM[4] ECU_ADDRESS 0xd00020f4 FORMAT "%3.0" /end MEASUREMENT
/begin MEASUREMENT Sxx_sli_vs_buf[5] "Buffer of the 16 last seconds of the vehicle speed stored in EEPROM" UBYTE _CNV_A_R_ECME_LINEA_0_CM 1 0. 0. 255. DISPLAY_IDENTIFIER PcCruSpt_RVLV2_NVM.Sxx_sli_vs_buf_NVM[5] ECU_ADDRESS 0xd00020f5 FORMAT "%3.0" /end MEASUREMENT
/begin MEASUREMENT Sxx_sli_vs_buf[6] "Buffer of the 16 last seconds of the vehicle speed stored in EEPROM" UBYTE _CNV_A_R_ECME_LINEA_0_CM 1 0. 0. 255. DISPLAY_IDENTIFIER PcCruSpt_RVLV2_NVM.Sxx_sli_vs_buf_NVM[6] ECU_ADDRESS 0xd00020f6 FORMAT "%3.0" /end MEASUREMENT
/begin MEASUREMENT Sxx_sli_vs_buf[7] "Buffer of the 16 last seconds of the vehicle speed stored in EEPROM" UBYTE _CNV_A_R_ECME_LINEA_0_CM 1 0. 0. 255. DISPLAY_IDENTIFIER PcCruSpt_RVLV2_NVM.Sxx_sli_vs_buf_NVM[7] ECU_ADDRESS 0xd00020f7 FORMAT "%3.0" /end MEASUREMENT
/begin MEASUREMENT Sxx_sli_vs_buf[8] "Buffer of the 16 last seconds of the vehicle speed stored in EEPROM" UBYTE _CNV_A_R_ECME_LINEA_0_CM 1 0. 0. 255. DISPLAY_IDENTIFIER PcCruSpt_RVLV2_NVM.Sxx_sli_vs_buf_NVM[8] ECU_ADDRESS 0xd00020f8 FORMAT "%3.0" /end MEASUREMENT
/begin MEASUREMENT Sxx_sli_vs_buf[9] "Buffer of the 16 last seconds of the vehicle speed stored in EEPROM" UBYTE _CNV_A_R_ECME_LINEA_0_CM 1 0. 0. 255. DISPLAY_IDENTIFIER PcCruSpt_RVLV2_NVM.Sxx_sli_vs_buf_NVM[9] ECU_ADDRESS 0xd00020f9 FORMAT "%3.0" /end MEASUREMENT
/begin MEASUREMENT Sxx_sli_vs_buf[10] "Buffer of the 16 last seconds of the vehicle speed stored in EEPROM" UBYTE _CNV_A_R_ECME_LINEA_0_CM 1 0. 0. 255. DISPLAY_IDENTIFIER PcCruSpt_RVLV2_NVM.Sxx_sli_vs_buf_NVM[10] ECU_ADDRESS 0xd00020fa FORMAT "%3.0" /end MEASUREMENT
/begin MEASUREMENT Sxx_sli_vs_buf[11] "Buffer of the 16 last seconds of the vehicle speed stored in EEPROM" UBYTE _CNV_A_R_ECME_LINEA_0_CM 1 0. 0. 255. DISPLAY_IDENTIFIER PcCruSpt_RVLV2_NVM.Sxx_sli_vs_buf_NVM[11] ECU_ADDRESS 0xd00020fb FORMAT "%3.0" /end MEASUREMENT
/begin MEASUREMENT Sxx_sli_vs_buf[12] "Buffer of the 16 last seconds of the vehicle speed stored in EEPROM" UBYTE _CNV_A_R_ECME_LINEA_0_CM 1 0. 0. 255. DISPLAY_IDENTIFIER PcCruSpt_RVLV2_NVM.Sxx_sli_vs_buf_NVM[12] ECU_ADDRESS 0xd00020fc FORMAT "%3.0" /end MEASUREMENT
/begin MEASUREMENT Sxx_sli_vs_buf[13] "Buffer of the 16 last seconds of the vehicle speed stored in EEPROM" UBYTE _CNV_A_R_ECME_LINEA_0_CM 1 0. 0. 255. DISPLAY_IDENTIFIER PcCruSpt_RVLV2_NVM.Sxx_sli_vs_buf_NVM[13] ECU_ADDRESS 0xd00020fd FORMAT "%3.0" /end MEASUREMENT
/begin MEASUREMENT Sxx_sli_vs_buf[14] "Buffer of the 16 last seconds of the vehicle speed stored in EEPROM" UBYTE _CNV_A_R_ECME_LINEA_0_CM 1 0. 0. 255. DISPLAY_IDENTIFIER PcCruSpt_RVLV2_NVM.Sxx_sli_vs_buf_NVM[14] ECU_ADDRESS 0xd00020fe FORMAT "%3.0" /end MEASUREMENT
/begin MEASUREMENT Sxx_sli_vs_buf[15] "Buffer of the 16 last seconds of the vehicle speed stored in EEPROM" UBYTE _CNV_A_R_ECME_LINEA_0_CM 1 0. 0. 255. DISPLAY_IDENTIFIER PcCruSpt_RVLV2_NVM.Sxx_sli_vs_buf_NVM[15] ECU_ADDRESS 0xd00020ff FORMAT "%3.0" /end MEASUREMENT
/begin MEASUREMENT Vxx_crsh_dly_ctr_NVM "Last shut off / activation -- crash duration counter" UBYTE _CNV_A_R_LINEAR_____82_CM 1 0. 0. 255. DISPLAY_IDENTIFIER PcCruSpt_RVLV2_NVM.Vxx_crsh_dly_ctr_NVM ECU_ADDRESS 0xd0002100 FORMAT "%3.0" /end MEASUREMENT
/begin MEASUREMENT Vxx_cru_dgn_diag_NVM "Carrier of information about the diag add on" UBYTE _CNV_A_R_ECME_LINEA_0_CM 1 0. 0. 255. DISPLAY_IDENTIFIER PcCruSpt_RVLV2_NVM.Vxx_cru_dgn_diag_NVM ECU_ADDRESS 0xd0002101 FORMAT "%3.0" /end MEASUREMENT
/begin MEASUREMENT Vbx_crsh_end_rec_eprm_NVM "A crash occured and the diagnostic add-on strategy is frozen" UBYTE _CNV_S_2_RANGE______3_CM 1 0. 0. 1. DISPLAY_IDENTIFIER PcCruSpt_RVLV2_NVM.Vbx_crsh_end_rec_eprm_NVM ECU_ADDRESS 0xd0002102 BIT_MASK 0x1 /end MEASUREMENT
/begin MEASUREMENT Sxx_cru_dist_buf[0] "Buffer of the 20 last mileages associated to an activation or shut off" ULONG _CNV_A_R_LINEAR_____218_CM 1 0. 0. 16777215. DISPLAY_IDENTIFIER PcCruSpt_RVLV_NVM.Sxx_cru_dist_buf_NVM[0] ECU_ADDRESS 0xd0002104 FORMAT "%8.0" /end MEASUREMENT
/begin MEASUREMENT Sxx_cru_dist_buf[1] "Buffer of the 20 last mileages associated to an activation or shut off" ULONG _CNV_A_R_LINEAR_____218_CM 1 0. 0. 16777215. DISPLAY_IDENTIFIER PcCruSpt_RVLV_NVM.Sxx_cru_dist_buf_NVM[1] ECU_ADDRESS 0xd0002108 FORMAT "%8.0" /end MEASUREMENT
/begin MEASUREMENT Sxx_cru_dist_buf[2] "Buffer of the 20 last mileages associated to an activation or shut off" ULONG _CNV_A_R_LINEAR_____218_CM 1 0. 0. 16777215. DISPLAY_IDENTIFIER PcCruSpt_RVLV_NVM.Sxx_cru_dist_buf_NVM[2] ECU_ADDRESS 0xd000210c FORMAT "%8.0" /end MEASUREMENT
/begin MEASUREMENT Sxx_cru_dist_buf[3] "Buffer of the 20 last mileages associated to an activation or shut off" ULONG _CNV_A_R_LINEAR_____218_CM 1 0. 0. 16777215. DISPLAY_IDENTIFIER PcCruSpt_RVLV_NVM.Sxx_cru_dist_buf_NVM[3] ECU_ADDRESS 0xd0002110 FORMAT "%8.0" /end MEASUREMENT
/begin MEASUREMENT Sxx_cru_dist_buf[4] "Buffer of the 20 last mileages associated to an activation or shut off" ULONG _CNV_A_R_LINEAR_____218_CM 1 0. 0. 16777215. DISPLAY_IDENTIFIER PcCruSpt_RVLV_NVM.Sxx_cru_dist_buf_NVM[4] ECU_ADDRESS 0xd0002114 FORMAT "%8.0" /end MEASUREMENT
/begin MEASUREMENT Sxx_cru_dist_buf[5] "Buffer of the 20 last mileages associated to an activation or shut off" ULONG _CNV_A_R_LINEAR_____218_CM 1 0. 0. 16777215. DISPLAY_IDENTIFIER PcCruSpt_RVLV_NVM.Sxx_cru_dist_buf_NVM[5] ECU_ADDRESS 0xd0002118 FORMAT "%8.0" /end MEASUREMENT
/begin MEASUREMENT Sxx_cru_dist_buf[6] "Buffer of the 20 last mileages associated to an activation or shut off" ULONG _CNV_A_R_LINEAR_____218_CM 1 0. 0. 16777215. DISPLAY_IDENTIFIER PcCruSpt_RVLV_NVM.Sxx_cru_dist_buf_NVM[6] ECU_ADDRESS 0xd000211c FORMAT "%8.0" /end MEASUREMENT
/begin MEASUREMENT Sxx_cru_dist_buf[7] "Buffer of the 20 last mileages associated to an activation or shut off" ULONG _CNV_A_R_LINEAR_____218_CM 1 0. 0. 16777215. DISPLAY_IDENTIFIER PcCruSpt_RVLV_NVM.Sxx_cru_dist_buf_NVM[7] ECU_ADDRESS 0xd0002120 FORMAT "%8.0" /end MEASUREMENT
/begin MEASUREMENT Sxx_cru_dist_buf[8] "Buffer of the 20 last mileages associated to an activation or shut off" ULONG _CNV_A_R_LINEAR_____218_CM 1 0. 0. 16777215. DISPLAY_IDENTIFIER PcCruSpt_RVLV_NVM.Sxx_cru_dist_buf_NVM[8] ECU_ADDRESS 0xd0002124 FORMAT "%8.0" /end MEASUREMENT
/begin MEASUREMENT Sxx_cru_dist_buf[9] "Buffer of the 20 last mileages associated to an activation or shut off" ULONG _CNV_A_R_LINEAR_____218_CM 1 0. 0. 16777215. DISPLAY_IDENTIFIER PcCruSpt_RVLV_NVM.Sxx_cru_dist_buf_NVM[9] ECU_ADDRESS 0xd0002128 FORMAT "%8.0" /end MEASUREMENT
/begin MEASUREMENT Sxx_cru_dist_buf[10] "Buffer of the 20 last mileages associated to an activation or shut off" ULONG _CNV_A_R_LINEAR_____218_CM 1 0. 0. 16777215. DISPLAY_IDENTIFIER PcCruSpt_RVLV_NVM.Sxx_cru_dist_buf_NVM[10] ECU_ADDRESS 0xd000212c FORMAT "%8.0" /end MEASUREMENT
/begin MEASUREMENT Sxx_cru_dist_buf[11] "Buffer of the 20 last mileages associated to an activation or shut off" ULONG _CNV_A_R_LINEAR_____218_CM 1 0. 0. 16777215. DISPLAY_IDENTIFIER PcCruSpt_RVLV_NVM.Sxx_cru_dist_buf_NVM[11] ECU_ADDRESS 0xd0002130 FORMAT "%8.0" /end MEASUREMENT
/begin MEASUREMENT Sxx_cru_dist_buf[12] "Buffer of the 20 last mileages associated to an activation or shut off" ULONG _CNV_A_R_LINEAR_____218_CM 1 0. 0. 16777215. DISPLAY_IDENTIFIER PcCruSpt_RVLV_NVM.Sxx_cru_dist_buf_NVM[12] ECU_ADDRESS 0xd0002134 FORMAT "%8.0" /end MEASUREMENT
/begin MEASUREMENT Sxx_cru_dist_buf[13] "Buffer of the 20 last mileages associated to an activation or shut off" ULONG _CNV_A_R_LINEAR_____218_CM 1 0. 0. 16777215. DISPLAY_IDENTIFIER PcCruSpt_RVLV_NVM.Sxx_cru_dist_buf_NVM[13] ECU_ADDRESS 0xd0002138 FORMAT "%8.0" /end MEASUREMENT
/begin MEASUREMENT Sxx_cru_dist_buf[14] "Buffer of the 20 last mileages associated to an activation or shut off" ULONG _CNV_A_R_LINEAR_____218_CM 1 0. 0. 16777215. DISPLAY_IDENTIFIER PcCruSpt_RVLV_NVM.Sxx_cru_dist_buf_NVM[14] ECU_ADDRESS 0xd000213c FORMAT "%8.0" /end MEASUREMENT
/begin MEASUREMENT Sxx_cru_dist_buf[15] "Buffer of the 20 last mileages associated to an activation or shut off" ULONG _CNV_A_R_LINEAR_____218_CM 1 0. 0. 16777215. DISPLAY_IDENTIFIER PcCruSpt_RVLV_NVM.Sxx_cru_dist_buf_NVM[15] ECU_ADDRESS 0xd0002140 FORMAT "%8.0" /end MEASUREMENT
/begin MEASUREMENT Sxx_cru_dist_buf[16] "Buffer of the 20 last mileages associated to an activation or shut off" ULONG _CNV_A_R_LINEAR_____218_CM 1 0. 0. 16777215. DISPLAY_IDENTIFIER PcCruSpt_RVLV_NVM.Sxx_cru_dist_buf_NVM[16] ECU_ADDRESS 0xd0002144 FORMAT "%8.0" /end MEASUREMENT
/begin MEASUREMENT Sxx_cru_dist_buf[17] "Buffer of the 20 last mileages associated to an activation or shut off" ULONG _CNV_A_R_LINEAR_____218_CM 1 0. 0. 16777215. DISPLAY_IDENTIFIER PcCruSpt_RVLV_NVM.Sxx_cru_dist_buf_NVM[17] ECU_ADDRESS 0xd0002148 FORMAT "%8.0" /end MEASUREMENT
/begin MEASUREMENT Sxx_cru_dist_buf[18] "Buffer of the 20 last mileages associated to an activation or shut off" ULONG _CNV_A_R_LINEAR_____218_CM 1 0. 0. 16777215. DISPLAY_IDENTIFIER PcCruSpt_RVLV_NVM.Sxx_cru_dist_buf_NVM[18] ECU_ADDRESS 0xd000214c FORMAT "%8.0" /end MEASUREMENT
/begin MEASUREMENT Sxx_cru_dist_buf[19] "Buffer of the 20 last mileages associated to an activation or shut off" ULONG _CNV_A_R_LINEAR_____218_CM 1 0. 0. 16777215. DISPLAY_IDENTIFIER PcCruSpt_RVLV_NVM.Sxx_cru_dist_buf_NVM[19] ECU_ADDRESS 0xd0002150 FORMAT "%8.0" /end MEASUREMENT
/begin MEASUREMENT Sxx_cru_dsb_buf[0] "Buffer of the 20 last CC activations or deactivations root cause" UBYTE _CNV_A_R_ECME_LINEA_0_CM 1 0. 0. 255. DISPLAY_IDENTIFIER PcCruSpt_RVLV_NVM.Sxx_cru_dsb_buf_NVM[0] ECU_ADDRESS 0xd0002154 FORMAT "%3.0" /end MEASUREMENT
/begin MEASUREMENT Sxx_cru_dsb_buf[1] "Buffer of the 20 last CC activations or deactivations root cause" UBYTE _CNV_A_R_ECME_LINEA_0_CM 1 0. 0. 255. DISPLAY_IDENTIFIER PcCruSpt_RVLV_NVM.Sxx_cru_dsb_buf_NVM[1] ECU_ADDRESS 0xd0002155 FORMAT "%3.0" /end MEASUREMENT
/begin MEASUREMENT Sxx_cru_dsb_buf[2] "Buffer of the 20 last CC activations or deactivations root cause" UBYTE _CNV_A_R_ECME_LINEA_0_CM 1 0. 0. 255. DISPLAY_IDENTIFIER PcCruSpt_RVLV_NVM.Sxx_cru_dsb_buf_NVM[2] ECU_ADDRESS 0xd0002156 FORMAT "%3.0" /end MEASUREMENT
/begin MEASUREMENT Sxx_cru_dsb_buf[3] "Buffer of the 20 last CC activations or deactivations root cause" UBYTE _CNV_A_R_ECME_LINEA_0_CM 1 0. 0. 255. DISPLAY_IDENTIFIER PcCruSpt_RVLV_NVM.Sxx_cru_dsb_buf_NVM[3] ECU_ADDRESS 0xd0002157 FORMAT "%3.0" /end MEASUREMENT
/begin MEASUREMENT Sxx_cru_dsb_buf[4] "Buffer of the 20 last CC activations or deactivations root cause" UBYTE _CNV_A_R_ECME_LINEA_0_CM 1 0. 0. 255. DISPLAY_IDENTIFIER PcCruSpt_RVLV_NVM.Sxx_cru_dsb_buf_NVM[4] ECU_ADDRESS 0xd0002158 FORMAT "%3.0" /end MEASUREMENT
/begin MEASUREMENT Sxx_cru_dsb_buf[5] "Buffer of the 20 last CC activations or deactivations root cause" UBYTE _CNV_A_R_ECME_LINEA_0_CM 1 0. 0. 255. DISPLAY_IDENTIFIER PcCruSpt_RVLV_NVM.Sxx_cru_dsb_buf_NVM[5] ECU_ADDRESS 0xd0002159 FORMAT "%3.0" /end MEASUREMENT
/begin MEASUREMENT Sxx_cru_dsb_buf[6] "Buffer of the 20 last CC activations or deactivations root cause" UBYTE _CNV_A_R_ECME_LINEA_0_CM 1 0. 0. 255. DISPLAY_IDENTIFIER PcCruSpt_RVLV_NVM.Sxx_cru_dsb_buf_NVM[6] ECU_ADDRESS 0xd000215a FORMAT "%3.0" /end MEASUREMENT
/begin MEASUREMENT Sxx_cru_dsb_buf[7] "Buffer of the 20 last CC activations or deactivations root cause" UBYTE _CNV_A_R_ECME_LINEA_0_CM 1 0. 0. 255. DISPLAY_IDENTIFIER PcCruSpt_RVLV_NVM.Sxx_cru_dsb_buf_NVM[7] ECU_ADDRESS 0xd000215b FORMAT "%3.0" /end MEASUREMENT
/begin MEASUREMENT Sxx_cru_dsb_buf[8] "Buffer of the 20 last CC activations or deactivations root cause" UBYTE _CNV_A_R_ECME_LINEA_0_CM 1 0. 0. 255. DISPLAY_IDENTIFIER PcCruSpt_RVLV_NVM.Sxx_cru_dsb_buf_NVM[8] ECU_ADDRESS 0xd000215c FORMAT "%3.0" /end MEASUREMENT
/begin MEASUREMENT Sxx_cru_dsb_buf[9] "Buffer of the 20 last CC activations or deactivations root cause" UBYTE _CNV_A_R_ECME_LINEA_0_CM 1 0. 0. 255. DISPLAY_IDENTIFIER PcCruSpt_RVLV_NVM.Sxx_cru_dsb_buf_NVM[9] ECU_ADDRESS 0xd000215d FORMAT "%3.0" /end MEASUREMENT
/begin MEASUREMENT Sxx_cru_dsb_buf[10] "Buffer of the 20 last CC activations or deactivations root cause" UBYTE _CNV_A_R_ECME_LINEA_0_CM 1 0. 0. 255. DISPLAY_IDENTIFIER PcCruSpt_RVLV_NVM.Sxx_cru_dsb_buf_NVM[10] ECU_ADDRESS 0xd000215e FORMAT "%3.0" /end MEASUREMENT
/begin MEASUREMENT Sxx_cru_dsb_buf[11] "Buffer of the 20 last CC activations or deactivations root cause" UBYTE _CNV_A_R_ECME_LINEA_0_CM 1 0. 0. 255. DISPLAY_IDENTIFIER PcCruSpt_RVLV_NVM.Sxx_cru_dsb_buf_NVM[11] ECU_ADDRESS 0xd000215f FORMAT "%3.0" /end MEASUREMENT
/begin MEASUREMENT Sxx_cru_dsb_buf[12] "Buffer of the 20 last CC activations or deactivations root cause" UBYTE _CNV_A_R_ECME_LINEA_0_CM 1 0. 0. 255. DISPLAY_IDENTIFIER PcCruSpt_RVLV_NVM.Sxx_cru_dsb_buf_NVM[12] ECU_ADDRESS 0xd0002160 FORMAT "%3.0" /end MEASUREMENT
/begin MEASUREMENT Sxx_cru_dsb_buf[13] "Buffer of the 20 last CC activations or deactivations root cause" UBYTE _CNV_A_R_ECME_LINEA_0_CM 1 0. 0. 255. DISPLAY_IDENTIFIER PcCruSpt_RVLV_NVM.Sxx_cru_dsb_buf_NVM[13] ECU_ADDRESS 0xd0002161 FORMAT "%3.0" /end MEASUREMENT
/begin MEASUREMENT Sxx_cru_dsb_buf[14] "Buffer of the 20 last CC activations or deactivations root cause" UBYTE _CNV_A_R_ECME_LINEA_0_CM 1 0. 0. 255. DISPLAY_IDENTIFIER PcCruSpt_RVLV_NVM.Sxx_cru_dsb_buf_NVM[14] ECU_ADDRESS 0xd0002162 FORMAT "%3.0" /end MEASUREMENT
/begin MEASUREMENT Sxx_cru_dsb_buf[15] "Buffer of the 20 last CC activations or deactivations root cause" UBYTE _CNV_A_R_ECME_LINEA_0_CM 1 0. 0. 255. DISPLAY_IDENTIFIER PcCruSpt_RVLV_NVM.Sxx_cru_dsb_buf_NVM[15] ECU_ADDRESS 0xd0002163 FORMAT "%3.0" /end MEASUREMENT
/begin MEASUREMENT Sxx_cru_dsb_buf[16] "Buffer of the 20 last CC activations or deactivations root cause" UBYTE _CNV_A_R_ECME_LINEA_0_CM 1 0. 0. 255. DISPLAY_IDENTIFIER PcCruSpt_RVLV_NVM.Sxx_cru_dsb_buf_NVM[16] ECU_ADDRESS 0xd0002164 FORMAT "%3.0" /end MEASUREMENT
/begin MEASUREMENT Sxx_cru_dsb_buf[17] "Buffer of the 20 last CC activations or deactivations root cause" UBYTE _CNV_A_R_ECME_LINEA_0_CM 1 0. 0. 255. DISPLAY_IDENTIFIER PcCruSpt_RVLV_NVM.Sxx_cru_dsb_buf_NVM[17] ECU_ADDRESS 0xd0002165 FORMAT "%3.0" /end MEASUREMENT
/begin MEASUREMENT Sxx_cru_dsb_buf[18] "Buffer of the 20 last CC activations or deactivations root cause" UBYTE _CNV_A_R_ECME_LINEA_0_CM 1 0. 0. 255. DISPLAY_IDENTIFIER PcCruSpt_RVLV_NVM.Sxx_cru_dsb_buf_NVM[18] ECU_ADDRESS 0xd0002166 FORMAT "%3.0" /end MEASUREMENT
/begin MEASUREMENT Sxx_cru_dsb_buf[19] "Buffer of the 20 last CC activations or deactivations root cause" UBYTE _CNV_A_R_ECME_LINEA_0_CM 1 0. 0. 255. DISPLAY_IDENTIFIER PcCruSpt_RVLV_NVM.Sxx_cru_dsb_buf_NVM[19] ECU_ADDRESS 0xd0002167 FORMAT "%3.0" /end MEASUREMENT
/begin MEASUREMENT Vbx_brk_pdl_vld_fail "Brake pedal states validity indicator is in the \"limp home data\" status" UBYTE _CNV_S_2_RANGE______3_CM 1 0. 0. 1. ECU_ADDRESS 0xd0003e35 BIT_MASK 0x1 /end MEASUREMENT
/begin MEASUREMENT Vbx_brk_pdl_vld_nok "Brake pedal states validity indicator is in the \"invalid data\" status" UBYTE _CNV_S_2_RANGE______3_CM 1 0. 0. 1. ECU_ADDRESS 0xd0003e36 BIT_MASK 0x1 /end MEASUREMENT
/begin MEASUREMENT Vbx_cru_brk_det "Braking detected for cruise control" UBYTE _CNV_S_2_RANGE______3_CM 1 0. 0. 1. ECU_ADDRESS 0xd0003e37 BIT_MASK 0x1 /end MEASUREMENT
/begin MEASUREMENT Vbx_cru_brk_det_sudn "Sudden braking detected for cruise control" UBYTE _CNV_S_2_RANGE______3_CM 1 0. 0. 1. ECU_ADDRESS 0xd0003e38 BIT_MASK 0x1 /end MEASUREMENT
/begin MEASUREMENT Vbx_cru_clu_abst_fil "Filtered clutch pedal status information absence" UBYTE _CNV_S_2_RANGE______3_CM 1 0. 0. 1. ECU_ADDRESS 0xd0003e39 BIT_MASK 0x1 /end MEASUREMENT
/begin MEASUREMENT Vbx_cru_clu_navl_fil "Filtered unavailable clutch pedal status information" UBYTE _CNV_S_2_RANGE______3_CM 1 0. 0. 1. ECU_ADDRESS 0xd0003e3a BIT_MASK 0x1 /end MEASUREMENT
/begin MEASUREMENT Vbx_diag_ena_cru "Diag Authorization for Cruise Control" UBYTE _CNV_S_2_RANGE______3_CM 1 0. 0. 1. ECU_ADDRESS 0xd0003e3b BIT_MASK 0x1 /end MEASUREMENT
/begin MEASUREMENT Vbx_diag_ena_cru_sl "Diag Authorization for Cruise Control and Speed limiter" UBYTE _CNV_S_2_RANGE______3_CM 1 0. 0. 1. ECU_ADDRESS 0xd0003e3c BIT_MASK 0x1 /end MEASUREMENT
/begin MEASUREMENT Vbx_diag_ena_cru_sl_dtc "Diag Authorization for Cruise Control and Speed limiter DTC" UBYTE _CNV_S_2_RANGE______3_CM 1 0. 0. 1. ECU_ADDRESS 0xd0003e3d BIT_MASK 0x1 /end MEASUREMENT
/begin MEASUREMENT Vbx_gear_vld_nok_fail "Gear engaged validity indicator is in the invalidity status \"invalid data\" or \"limp home data\"" UBYTE _CNV_S_2_RANGE______3_CM 1 0. 0. 1. ECU_ADDRESS 0xd0003e3e BIT_MASK 0x1 /end MEASUREMENT
/begin MEASUREMENT Vsx_cru_vld "Cruise control validity status" UBYTE _CNV_S_3_STATUS_OK__120_CM 1 0. 0. 2. ECU_ADDRESS 0xd0003e3f /end MEASUREMENT
/begin MEASUREMENT Vsx_sl_vld "Speed limiter validity status" UBYTE _CNV_S_3_STATUS_OK__120_CM 1 0. 0. 2. ECU_ADDRESS 0xd0003e40 /end MEASUREMENT
/begin CHARACTERISTIC Cxx_brk_det_dly "Minimum time to detect ‡ brake pedal press" VALUE 0xa0020d06 _REC_S1VAL_20_u2 655.35 _CNV_A_R_LINEAR_____34_CM 0. 655.35 FORMAT "%6.2" /end CHARACTERISTIC
/begin CHARACTERISTIC Cxx_brk_min_decl_thd "Minimum deceleration value to detect braking" VALUE 0xa0020d08 _REC_S1VAL_20_s2 25.5 _CNV_A_R_LINEAR_____405_CM -12. 13.5 FORMAT "%5.1" /end CHARACTERISTIC
/begin CHARACTERISTIC Cxx_cru_brk_fail_dly "Minimum time to detect a brake information absence." VALUE 0xa0020d0a _REC_S1VAL_20_u2 655.35 _CNV_A_R_LINEAR_____34_CM 0. 655.35 FORMAT "%6.2" /end CHARACTERISTIC
/begin CHARACTERISTIC Cxx_cru_brk_nok_dly "Minimum time to detect a non available brake information." VALUE 0xa0020d0c _REC_S1VAL_20_u2 655.35 _CNV_A_R_LINEAR_____34_CM 0. 655.35 FORMAT "%6.2" /end CHARACTERISTIC
/begin CHARACTERISTIC Cxx_cru_clu_navl_dly "Minimum time to detect a clutch information absence" VALUE 0xa0020d0e _REC_S1VAL_20_u2 655.35 _CNV_A_R_LINEAR_____34_CM 0. 655.35 FORMAT "%6.2" /end CHARACTERISTIC
/begin CHARACTERISTIC Cxx_cru_clu_nok_dly "Minimum time to detect a non available clutch information" VALUE 0xa0020d10 _REC_S1VAL_20_u2 655.35 _CNV_A_R_LINEAR_____34_CM 0. 655.35 FORMAT "%6.2" /end CHARACTERISTIC
/begin CHARACTERISTIC Cxx_dfdec_cru_sl_tot "Cruise control and speed limiter common failures Detected Failure Counter Decrement" VALUE 0xa0020d12 _REC_S1VAL_20_u2 65535. _CNV_A_R_ECME_LINEA_0_CM 0. 65535. FORMAT "%5.0" /end CHARACTERISTIC
/begin CHARACTERISTIC Cxx_dfinc_cru_sl_tot "Cruise control and speed limiter common failures Detected Failure Counter Increment" VALUE 0xa0020d14 _REC_S1VAL_20_u2 65535. _CNV_A_R_ECME_LINEA_0_CM 0. 65535. FORMAT "%5.0" /end CHARACTERISTIC
/begin CHARACTERISTIC Cxx_lih_dly "Sufficient time to confirm limphome mode in automatic gearbox" VALUE 0xa0020d1c _REC_S1VAL_20_u1 2.55 _CNV_A_R_LINEAR_____34_CM 0. 2.55 FORMAT "%4.2" /end CHARACTERISTIC
/begin CHARACTERISTIC Cxx_sp_vs_dif_brk_det "Difference between requested speed and vehicle speed to detect braking" VALUE 0xa0020d16 _REC_S1VAL_20_u2 655.35 _CNV_A_R_LINEAR_____70_CM 0. 655.35 FORMAT "%6.2" /end CHARACTERISTIC
/begin CHARACTERISTIC Cxx_sudn_brk_det_dly "Minimum time to detect a sudden braking" VALUE 0xa0020d18 _REC_S1VAL_20_u2 655.35 _CNV_A_R_LINEAR_____34_CM 0. 655.35 FORMAT "%6.2" /end CHARACTERISTIC
/begin CHARACTERISTIC Cxx_sudn_brk_min_decl_thd "Minimum deceleration value to detect sudden braking" VALUE 0xa0020d1a _REC_S1VAL_20_s2 25.5 _CNV_A_R_LINEAR_____405_CM -12. 13.5 FORMAT "%5.1" /end CHARACTERISTIC
/begin MEASUREMENT Vbx_crsh_det "A crash has been detected" UBYTE _CNV_S_2_RANGE______3_CM 1 0. 0. 1. ECU_ADDRESS 0xd0003de0 BIT_MASK 0x1 /end MEASUREMENT
/begin MEASUREMENT Vbx_cru_dgn_eprm_writ_off "Boolean that indicates the write-on-the-flight storage in EEPROM on cruise control activation or deactivation is inhibited" UBYTE _CNV_S_2_RANGE______3_CM 1 0. 0. 1. ECU_ADDRESS 0xd0003de1 BIT_MASK 0x1 /end MEASUREMENT
/begin MEASUREMENT Vbx_cru_dgn_eprm_writ_on "Boolean that indicates the write-on-the-flight storage in EEPROM on cruise control activation or deactivation is enable" UBYTE _CNV_S_2_RANGE______3_CM 1 0. 0. 1. ECU_ADDRESS 0xd0003de2 BIT_MASK 0x1 /end MEASUREMENT
/begin MEASUREMENT Vbx_cru_diag_ena "1 : Means the diag is enable (Cbx_cru_diag_add_on == 1 and Vbx_crsh_end_rec_eprm == 0)  / 0 : means it is disable" UBYTE _CNV_S_2_RANGE______3_CM 1 0. 0. 1. ECU_ADDRESS 0xd0003de3 BIT_MASK 0x1 /end MEASUREMENT
/begin MEASUREMENT Vbx_cru_sl_dacn_bit0 "bit 0 of Vxx_cru_sl_dacn" UBYTE _CNV_S_2_RANGE______3_CM 1 0. 0. 1. ECU_ADDRESS 0xd0003de4 BIT_MASK 0x1 /end MEASUREMENT
/begin MEASUREMENT Vbx_cru_sl_dacn_bit1 "bit 1 of Vxx_cru_sl_dacn" UBYTE _CNV_S_2_RANGE______3_CM 1 0. 0. 1. ECU_ADDRESS 0xd0003de5 BIT_MASK 0x1 /end MEASUREMENT
/begin MEASUREMENT Vbx_ram_full "A root cause and milleage are stored in the second buffer in RAM so no other deactivation or activation can be stored until the EEPROM is ready" UBYTE _CNV_S_2_RANGE______3_CM 1 0. 0. 1. ECU_ADDRESS 0xd0003de6 BIT_MASK 0x1 /end MEASUREMENT
/begin MEASUREMENT Vbx_ram_full_prev "Previous compilation of Vbx_ram_full" UBYTE _CNV_S_2_RANGE______3_CM 1 0. 0. 1. ECU_ADDRESS 0xd0003de7 BIT_MASK 0x1 /end MEASUREMENT
/begin MEASUREMENT Vbx_set_id_bit6 "Set the bit 6 of the RC marker" UBYTE _CNV_S_2_RANGE______3_CM 1 0. 0. 1. ECU_ADDRESS 0xd0003de8 BIT_MASK 0x1 /end MEASUREMENT
/begin MEASUREMENT Vbx_set_id_bit7 "Set the bit 7 of the RC marker" UBYTE _CNV_S_2_RANGE______3_CM 1 0. 0. 1. ECU_ADDRESS 0xd0003de9 BIT_MASK 0x1 /end MEASUREMENT
/begin MEASUREMENT Vxx_act_deact_id_buf_2 "Root cause of the deactivation or activation stored in RAM in the second buffer" UBYTE _CNV_A_R_ECME_LINEA_0_CM 1 0. 0. 255. ECU_ADDRESS 0xd0003dea FORMAT "%3.0" /end MEASUREMENT
/begin MEASUREMENT Vxx_cru_act_deact_id "Root cause of the deactivation or activation stored in RAM in the first buffer" UBYTE _CNV_A_R_ECME_LINEA_0_CM 1 0. 0. 255. ECU_ADDRESS 0xd0003deb FORMAT "%3.0" /end MEASUREMENT
/begin MEASUREMENT Vxx_cru_act_deact_id_to_saved "Root cause of the deactivation or activation to be stored from the buffer 1 or 2" UBYTE _CNV_A_R_ECME_LINEA_0_CM 1 0. 0. 255. ECU_ADDRESS 0xd0003dec FORMAT "%3.0" /end MEASUREMENT
/begin MEASUREMENT Vxx_cru_dist_buf[0] "Mileage associated to the activation or shut off n∞ 1" ULONG _CNV_A_R_LINEAR_____218_CM 1 0. 0. 16777215. ECU_ADDRESS 0xd0001f94 FORMAT "%8.0" /end MEASUREMENT
/begin MEASUREMENT Vxx_cru_dist_buf[1] "Mileage associated to the activation or shut off n∞ 1" ULONG _CNV_A_R_LINEAR_____218_CM 1 0. 0. 16777215. ECU_ADDRESS 0xd0001f98 FORMAT "%8.0" /end MEASUREMENT
/begin MEASUREMENT Vxx_cru_dist_buf[2] "Mileage associated to the activation or shut off n∞ 1" ULONG _CNV_A_R_LINEAR_____218_CM 1 0. 0. 16777215. ECU_ADDRESS 0xd0001f9c FORMAT "%8.0" /end MEASUREMENT
/begin MEASUREMENT Vxx_cru_dist_buf[3] "Mileage associated to the activation or shut off n∞ 1" ULONG _CNV_A_R_LINEAR_____218_CM 1 0. 0. 16777215. ECU_ADDRESS 0xd0001fa0 FORMAT "%8.0" /end MEASUREMENT
/begin MEASUREMENT Vxx_cru_dist_buf[4] "Mileage associated to the activation or shut off n∞ 1" ULONG _CNV_A_R_LINEAR_____218_CM 1 0. 0. 16777215. ECU_ADDRESS 0xd0001fa4 FORMAT "%8.0" /end MEASUREMENT
/begin MEASUREMENT Vxx_cru_dist_buf[5] "Mileage associated to the activation or shut off n∞ 1" ULONG _CNV_A_R_LINEAR_____218_CM 1 0. 0. 16777215. ECU_ADDRESS 0xd0001fa8 FORMAT "%8.0" /end MEASUREMENT
/begin MEASUREMENT Vxx_cru_dist_buf[6] "Mileage associated to the activation or shut off n∞ 1" ULONG _CNV_A_R_LINEAR_____218_CM 1 0. 0. 16777215. ECU_ADDRESS 0xd0001fac FORMAT "%8.0" /end MEASUREMENT
/begin MEASUREMENT Vxx_cru_dist_buf[7] "Mileage associated to the activation or shut off n∞ 1" ULONG _CNV_A_R_LINEAR_____218_CM 1 0. 0. 16777215. ECU_ADDRESS 0xd0001fb0 FORMAT "%8.0" /end MEASUREMENT
/begin MEASUREMENT Vxx_cru_dist_buf[8] "Mileage associated to the activation or shut off n∞ 1" ULONG _CNV_A_R_LINEAR_____218_CM 1 0. 0. 16777215. ECU_ADDRESS 0xd0001fb4 FORMAT "%8.0" /end MEASUREMENT
/begin MEASUREMENT Vxx_cru_dist_buf[9] "Mileage associated to the activation or shut off n∞ 1" ULONG _CNV_A_R_LINEAR_____218_CM 1 0. 0. 16777215. ECU_ADDRESS 0xd0001fb8 FORMAT "%8.0" /end MEASUREMENT
/begin MEASUREMENT Vxx_cru_dist_buf[10] "Mileage associated to the activation or shut off n∞ 1" ULONG _CNV_A_R_LINEAR_____218_CM 1 0. 0. 16777215. ECU_ADDRESS 0xd0001fbc FORMAT "%8.0" /end MEASUREMENT
/begin MEASUREMENT Vxx_cru_dist_buf[11] "Mileage associated to the activation or shut off n∞ 1" ULONG _CNV_A_R_LINEAR_____218_CM 1 0. 0. 16777215. ECU_ADDRESS 0xd0001fc0 FORMAT "%8.0" /end MEASUREMENT
/begin MEASUREMENT Vxx_cru_dist_buf[12] "Mileage associated to the activation or shut off n∞ 1" ULONG _CNV_A_R_LINEAR_____218_CM 1 0. 0. 16777215. ECU_ADDRESS 0xd0001fc4 FORMAT "%8.0" /end MEASUREMENT
/begin MEASUREMENT Vxx_cru_dist_buf[13] "Mileage associated to the activation or shut off n∞ 1" ULONG _CNV_A_R_LINEAR_____218_CM 1 0. 0. 16777215. ECU_ADDRESS 0xd0001fc8 FORMAT "%8.0" /end MEASUREMENT
/begin MEASUREMENT Vxx_cru_dist_buf[14] "Mileage associated to the activation or shut off n∞ 1" ULONG _CNV_A_R_LINEAR_____218_CM 1 0. 0. 16777215. ECU_ADDRESS 0xd0001fcc FORMAT "%8.0" /end MEASUREMENT
/begin MEASUREMENT Vxx_cru_dist_buf[15] "Mileage associated to the activation or shut off n∞ 1" ULONG _CNV_A_R_LINEAR_____218_CM 1 0. 0. 16777215. ECU_ADDRESS 0xd0001fd0 FORMAT "%8.0" /end MEASUREMENT
/begin MEASUREMENT Vxx_cru_dist_buf[16] "Mileage associated to the activation or shut off n∞ 1" ULONG _CNV_A_R_LINEAR_____218_CM 1 0. 0. 16777215. ECU_ADDRESS 0xd0001fd4 FORMAT "%8.0" /end MEASUREMENT
/begin MEASUREMENT Vxx_cru_dist_buf[17] "Mileage associated to the activation or shut off n∞ 1" ULONG _CNV_A_R_LINEAR_____218_CM 1 0. 0. 16777215. ECU_ADDRESS 0xd0001fd8 FORMAT "%8.0" /end MEASUREMENT
/begin MEASUREMENT Vxx_cru_dist_buf[18] "Mileage associated to the activation or shut off n∞ 1" ULONG _CNV_A_R_LINEAR_____218_CM 1 0. 0. 16777215. ECU_ADDRESS 0xd0001fdc FORMAT "%8.0" /end MEASUREMENT
/begin MEASUREMENT Vxx_cru_dist_buf[19] "Mileage associated to the activation or shut off n∞ 1" ULONG _CNV_A_R_LINEAR_____218_CM 1 0. 0. 16777215. ECU_ADDRESS 0xd0001fe0 FORMAT "%8.0" /end MEASUREMENT
/begin MEASUREMENT Vxx_cru_dsb_buf[0] "Root cause of the activation or shut off n∞1" UBYTE _CNV_A_R_ECME_LINEA_0_CM 1 0. 0. 255. ECU_ADDRESS 0xd0003dcc FORMAT "%3.0" /end MEASUREMENT
/begin MEASUREMENT Vxx_cru_dsb_buf[1] "Root cause of the activation or shut off n∞1" UBYTE _CNV_A_R_ECME_LINEA_0_CM 1 0. 0. 255. ECU_ADDRESS 0xd0003dcd FORMAT "%3.0" /end MEASUREMENT
/begin MEASUREMENT Vxx_cru_dsb_buf[2] "Root cause of the activation or shut off n∞1" UBYTE _CNV_A_R_ECME_LINEA_0_CM 1 0. 0. 255. ECU_ADDRESS 0xd0003dce FORMAT "%3.0" /end MEASUREMENT
/begin MEASUREMENT Vxx_cru_dsb_buf[3] "Root cause of the activation or shut off n∞1" UBYTE _CNV_A_R_ECME_LINEA_0_CM 1 0. 0. 255. ECU_ADDRESS 0xd0003dcf FORMAT "%3.0" /end MEASUREMENT
/begin MEASUREMENT Vxx_cru_dsb_buf[4] "Root cause of the activation or shut off n∞1" UBYTE _CNV_A_R_ECME_LINEA_0_CM 1 0. 0. 255. ECU_ADDRESS 0xd0003dd0 FORMAT "%3.0" /end MEASUREMENT
/begin MEASUREMENT Vxx_cru_dsb_buf[5] "Root cause of the activation or shut off n∞1" UBYTE _CNV_A_R_ECME_LINEA_0_CM 1 0. 0. 255. ECU_ADDRESS 0xd0003dd1 FORMAT "%3.0" /end MEASUREMENT
/begin MEASUREMENT Vxx_cru_dsb_buf[6] "Root cause of the activation or shut off n∞1" UBYTE _CNV_A_R_ECME_LINEA_0_CM 1 0. 0. 255. ECU_ADDRESS 0xd0003dd2 FORMAT "%3.0" /end MEASUREMENT
/begin MEASUREMENT Vxx_cru_dsb_buf[7] "Root cause of the activation or shut off n∞1" UBYTE _CNV_A_R_ECME_LINEA_0_CM 1 0. 0. 255. ECU_ADDRESS 0xd0003dd3 FORMAT "%3.0" /end MEASUREMENT
/begin MEASUREMENT Vxx_cru_dsb_buf[8] "Root cause of the activation or shut off n∞1" UBYTE _CNV_A_R_ECME_LINEA_0_CM 1 0. 0. 255. ECU_ADDRESS 0xd0003dd4 FORMAT "%3.0" /end MEASUREMENT
/begin MEASUREMENT Vxx_cru_dsb_buf[9] "Root cause of the activation or shut off n∞1" UBYTE _CNV_A_R_ECME_LINEA_0_CM 1 0. 0. 255. ECU_ADDRESS 0xd0003dd5 FORMAT "%3.0" /end MEASUREMENT
/begin MEASUREMENT Vxx_cru_dsb_buf[10] "Root cause of the activation or shut off n∞1" UBYTE _CNV_A_R_ECME_LINEA_0_CM 1 0. 0. 255. ECU_ADDRESS 0xd0003dd6 FORMAT "%3.0" /end MEASUREMENT
/begin MEASUREMENT Vxx_cru_dsb_buf[11] "Root cause of the activation or shut off n∞1" UBYTE _CNV_A_R_ECME_LINEA_0_CM 1 0. 0. 255. ECU_ADDRESS 0xd0003dd7 FORMAT "%3.0" /end MEASUREMENT
/begin MEASUREMENT Vxx_cru_dsb_buf[12] "Root cause of the activation or shut off n∞1" UBYTE _CNV_A_R_ECME_LINEA_0_CM 1 0. 0. 255. ECU_ADDRESS 0xd0003dd8 FORMAT "%3.0" /end MEASUREMENT
/begin MEASUREMENT Vxx_cru_dsb_buf[13] "Root cause of the activation or shut off n∞1" UBYTE _CNV_A_R_ECME_LINEA_0_CM 1 0. 0. 255. ECU_ADDRESS 0xd0003dd9 FORMAT "%3.0" /end MEASUREMENT
/begin MEASUREMENT Vxx_cru_dsb_buf[14] "Root cause of the activation or shut off n∞1" UBYTE _CNV_A_R_ECME_LINEA_0_CM 1 0. 0. 255. ECU_ADDRESS 0xd0003dda FORMAT "%3.0" /end MEASUREMENT
/begin MEASUREMENT Vxx_cru_dsb_buf[15] "Root cause of the activation or shut off n∞1" UBYTE _CNV_A_R_ECME_LINEA_0_CM 1 0. 0. 255. ECU_ADDRESS 0xd0003ddb FORMAT "%3.0" /end MEASUREMENT
/begin MEASUREMENT Vxx_cru_dsb_buf[16] "Root cause of the activation or shut off n∞1" UBYTE _CNV_A_R_ECME_LINEA_0_CM 1 0. 0. 255. ECU_ADDRESS 0xd0003ddc FORMAT "%3.0" /end MEASUREMENT
/begin MEASUREMENT Vxx_cru_dsb_buf[17] "Root cause of the activation or shut off n∞1" UBYTE _CNV_A_R_ECME_LINEA_0_CM 1 0. 0. 255. ECU_ADDRESS 0xd0003ddd FORMAT "%3.0" /end MEASUREMENT
/begin MEASUREMENT Vxx_cru_dsb_buf[18] "Root cause of the activation or shut off n∞1" UBYTE _CNV_A_R_ECME_LINEA_0_CM 1 0. 0. 255. ECU_ADDRESS 0xd0003dde FORMAT "%3.0" /end MEASUREMENT
/begin MEASUREMENT Vxx_cru_dsb_buf[19] "Root cause of the activation or shut off n∞1" UBYTE _CNV_A_R_ECME_LINEA_0_CM 1 0. 0. 255. ECU_ADDRESS 0xd0003ddf FORMAT "%3.0" /end MEASUREMENT
/begin MEASUREMENT Vxx_sli_brk_buf "Buffer of the 16 last seconds of the brake status" UWORD _CNV_A_R_ECME_LINEA_0_CM 1 0. 0. 65535. ECU_ADDRESS 0xd0005860 FORMAT "%5.0" /end MEASUREMENT
/begin MEASUREMENT Vxx_sli_clu_buf "Buffer of the 16 last seconds of the clutch status" UWORD _CNV_A_R_ECME_LINEA_0_CM 1 0. 0. 65535. ECU_ADDRESS 0xd0005862 FORMAT "%5.0" /end MEASUREMENT
/begin MEASUREMENT Vxx_sli_cru_stt_buf "Buffer of the 16 last seconds of the cruise control status" UWORD _CNV_A_R_ECME_LINEA_0_CM 1 0. 0. 65535. ECU_ADDRESS 0xd0005864 FORMAT "%5.0" /end MEASUREMENT
/begin MEASUREMENT Vxx_sli_vs_buf[0] "Buffer of the 16 last seconds of the vehicle speed" UBYTE _CNV_A_R_ECME_LINEA_0_CM 1 0. 0. 255. ECU_ADDRESS 0xd0005784 FORMAT "%3.0" /end MEASUREMENT
/begin MEASUREMENT Vxx_sli_vs_buf[1] "Buffer of the 16 last seconds of the vehicle speed" UBYTE _CNV_A_R_ECME_LINEA_0_CM 1 0. 0. 255. ECU_ADDRESS 0xd0005785 FORMAT "%3.0" /end MEASUREMENT
/begin MEASUREMENT Vxx_sli_vs_buf[2] "Buffer of the 16 last seconds of the vehicle speed" UBYTE _CNV_A_R_ECME_LINEA_0_CM 1 0. 0. 255. ECU_ADDRESS 0xd0005786 FORMAT "%3.0" /end MEASUREMENT
/begin MEASUREMENT Vxx_sli_vs_buf[3] "Buffer of the 16 last seconds of the vehicle speed" UBYTE _CNV_A_R_ECME_LINEA_0_CM 1 0. 0. 255. ECU_ADDRESS 0xd0005787 FORMAT "%3.0" /end MEASUREMENT
/begin MEASUREMENT Vxx_sli_vs_buf[4] "Buffer of the 16 last seconds of the vehicle speed" UBYTE _CNV_A_R_ECME_LINEA_0_CM 1 0. 0. 255. ECU_ADDRESS 0xd0005788 FORMAT "%3.0" /end MEASUREMENT
/begin MEASUREMENT Vxx_sli_vs_buf[5] "Buffer of the 16 last seconds of the vehicle speed" UBYTE _CNV_A_R_ECME_LINEA_0_CM 1 0. 0. 255. ECU_ADDRESS 0xd0005789 FORMAT "%3.0" /end MEASUREMENT
/begin MEASUREMENT Vxx_sli_vs_buf[6] "Buffer of the 16 last seconds of the vehicle speed" UBYTE _CNV_A_R_ECME_LINEA_0_CM 1 0. 0. 255. ECU_ADDRESS 0xd000578a FORMAT "%3.0" /end MEASUREMENT
/begin MEASUREMENT Vxx_sli_vs_buf[7] "Buffer of the 16 last seconds of the vehicle speed" UBYTE _CNV_A_R_ECME_LINEA_0_CM 1 0. 0. 255. ECU_ADDRESS 0xd000578b FORMAT "%3.0" /end MEASUREMENT
/begin MEASUREMENT Vxx_sli_vs_buf[8] "Buffer of the 16 last seconds of the vehicle speed" UBYTE _CNV_A_R_ECME_LINEA_0_CM 1 0. 0. 255. ECU_ADDRESS 0xd000578c FORMAT "%3.0" /end MEASUREMENT
/begin MEASUREMENT Vxx_sli_vs_buf[9] "Buffer of the 16 last seconds of the vehicle speed" UBYTE _CNV_A_R_ECME_LINEA_0_CM 1 0. 0. 255. ECU_ADDRESS 0xd000578d FORMAT "%3.0" /end MEASUREMENT
/begin MEASUREMENT Vxx_sli_vs_buf[10] "Buffer of the 16 last seconds of the vehicle speed" UBYTE _CNV_A_R_ECME_LINEA_0_CM 1 0. 0. 255. ECU_ADDRESS 0xd000578e FORMAT "%3.0" /end MEASUREMENT
/begin MEASUREMENT Vxx_sli_vs_buf[11] "Buffer of the 16 last seconds of the vehicle speed" UBYTE _CNV_A_R_ECME_LINEA_0_CM 1 0. 0. 255. ECU_ADDRESS 0xd000578f FORMAT "%3.0" /end MEASUREMENT
/begin MEASUREMENT Vxx_sli_vs_buf[12] "Buffer of the 16 last seconds of the vehicle speed" UBYTE _CNV_A_R_ECME_LINEA_0_CM 1 0. 0. 255. ECU_ADDRESS 0xd0005790 FORMAT "%3.0" /end MEASUREMENT
/begin MEASUREMENT Vxx_sli_vs_buf[13] "Buffer of the 16 last seconds of the vehicle speed" UBYTE _CNV_A_R_ECME_LINEA_0_CM 1 0. 0. 255. ECU_ADDRESS 0xd0005791 FORMAT "%3.0" /end MEASUREMENT
/begin MEASUREMENT Vxx_sli_vs_buf[14] "Buffer of the 16 last seconds of the vehicle speed" UBYTE _CNV_A_R_ECME_LINEA_0_CM 1 0. 0. 255. ECU_ADDRESS 0xd0005792 FORMAT "%3.0" /end MEASUREMENT
/begin MEASUREMENT Vxx_sli_vs_buf[15] "Buffer of the 16 last seconds of the vehicle speed" UBYTE _CNV_A_R_ECME_LINEA_0_CM 1 0. 0. 255. ECU_ADDRESS 0xd0005793 FORMAT "%3.0" /end MEASUREMENT
/begin MEASUREMENT Vxx_togl_ctr "Counter to detect toggling effect" UBYTE _CNV_A_R_ECME_LINEA_0_CM 1 0. 0. 255. ECU_ADDRESS 0xd0003ded FORMAT "%3.0" /end MEASUREMENT
/begin MEASUREMENT Vxx_togl_tmr "Timer to detect toggling effect" UBYTE _CNV_A_R_LINEAR_____136_CM 1 0. 0. 2.55 ECU_ADDRESS 0xd0003dee FORMAT "%4.2" /end MEASUREMENT
/begin MEASUREMENT Vxx_vh_dist_buf_2 "milleage of the deactivation or activation stored in RAM in the second buffer" ULONG _CNV_A_R_ECME_LINEA_0_CM 1 0. 0. 16777215. ECU_ADDRESS 0xd0001fe4 FORMAT "%8.0" /end MEASUREMENT
/begin CHARACTERISTIC Cbx_cru_diag_add_on "Activate the cruise control diagnostic add-on (1= activated)" VALUE 0xa002103a _REC_S1VAL_20_u1 1. _CNV_S_2_RANGE______3_CM 0. 1. BIT_MASK 0x1 /end CHARACTERISTIC
/begin CHARACTERISTIC Cxx_cru_dgn_eprm_imd_writ_thr "Threshold to stop root cause and mileage EEPROM write-on-the-flight" VALUE 0xa0021036 _REC_S1VAL_20_u4 16777215. _CNV_A_R_ECME_LINEA_0_CM 0. 16777215. FORMAT "%8.0" /end CHARACTERISTIC
/begin CHARACTERISTIC Cxx_togl_dly "Delay to consider toggling phenomena" VALUE 0xa002103b _REC_S1VAL_20_u1 2.55 _CNV_A_R_LINEAR_____34_CM 0. 2.55 FORMAT "%4.2" /end CHARACTERISTIC
/begin CHARACTERISTIC Cxx_togl_thr "Maximum number of activation/deactivation before a calibrated delay to consider toggling" VALUE 0xa002103c _REC_S1VAL_20_u1 255. _CNV_A_R_ECME_LINEA_0_CM 0. 255. FORMAT "%3.0" /end CHARACTERISTIC
/begin MEASUREMENT Vbx_cru_eng_dsb "Engine control request for cruise control abnormal deactivation " UBYTE _CNV_S_2_RANGE______3_CM 1 0. 0. 1. ECU_ADDRESS 0xd0004a3c BIT_MASK 0x1 /end MEASUREMENT
/begin MEASUREMENT Vbx_cru_eng_dsb_sys "Engine control request for cruise control system deactivation" UBYTE _CNV_S_2_RANGE______3_CM 1 0. 0. 1. ECU_ADDRESS 0xd0004a3d BIT_MASK 0x1 /end MEASUREMENT
/begin MEASUREMENT Vbx_sl_eng_dsb "Engine control request for speed limiter abnormal deactivation " UBYTE _CNV_S_2_RANGE______3_CM 1 0. 0. 1. ECU_ADDRESS 0xd0004a3e BIT_MASK 0x1 /end MEASUREMENT
/begin MEASUREMENT Vbx_sl_eng_dsb_sys "Engine control request for speed limiter system deactivation" UBYTE _CNV_S_2_RANGE______3_CM 1 0. 0. 1. ECU_ADDRESS 0xd0004a3f BIT_MASK 0x1 /end MEASUREMENT
/begin CHARACTERISTIC Cbx_cru_eng_dsb_wal_1_req_cfm "Configuration bit for cruise control deactivation by engine control on warning lamp level 1 request." VALUE 0xa0021ee5 _REC_S1VAL_20_u1 1. _CNV_A_R_ECME_LINEA_0_CM 0. 1. FORMAT "%1.0" BIT_MASK 0x1 /end CHARACTERISTIC
/begin CHARACTERISTIC Cbx_cru_sl_eng_dsb_vld_cfm "Configuration bit for cruise control and speed limiter deactivation by engine control on IVLD" VALUE 0xa0021ee6 _REC_S1VAL_20_u1 1. _CNV_A_R_ECME_LINEA_0_CM 0. 1. FORMAT "%1.0" BIT_MASK 0x1 /end CHARACTERISTIC
/begin CHARACTERISTIC Cbx_sl_eng_dsb_wal_1_req_cfm "Configuration bit for speed limiter deactivation by engine control on warning lamp level 1 request." VALUE 0xa0021ee7 _REC_S1VAL_20_u1 1. _CNV_A_R_ECME_LINEA_0_CM 0. 1. FORMAT "%1.0" BIT_MASK 0x1 /end CHARACTERISTIC
/begin MEASUREMENT Vbx_cru_sl_warn "Cruise control and speed limiter warning (overspeed)" UBYTE _CNV_S_2_RANGE______3_CM 1 0. 0. 1. ECU_ADDRESS 0xd0004cb6 BIT_MASK 0x1 /end MEASUREMENT
/begin MEASUREMENT Vbx_cru_sl_warn_prev "Previous value of the cruise control and speed limiter warning (overspeed)" UBYTE _CNV_S_2_RANGE______3_CM 1 0. 0. 1. ECU_ADDRESS 0xd0004cb7 BIT_MASK 0x1 /end MEASUREMENT
/begin MEASUREMENT Vbx_cru_sl_warn_raw "Stateflow output: Cruise control and speed limiter warning (overspeed)" UBYTE _CNV_S_2_RANGE______3_CM 1 0. 0. 1. ECU_ADDRESS 0xd0004cb8 BIT_MASK 0x1 /end MEASUREMENT
/begin MEASUREMENT Vbx_vs_clos_spt_lamp "Cruise control and speed limiter : the speed is reaching the setpoint (sent on the CAN network)" UBYTE _CNV_S_2_RANGE______3_CM 1 0. 0. 1. ECU_ADDRESS 0xd0004cb9 BIT_MASK 0x1 /end MEASUREMENT
/begin MEASUREMENT Vxx_cru_sl_driv_vs_sp "Requested speed selected by the driver (Cruise Control or Speed Limiter)" UBYTE _CNV_A_R_ECME_LINEA_0_CM 1 0. 0. 255. ECU_ADDRESS 0xd0004cba FORMAT "%3.0" /end MEASUREMENT
/begin MEASUREMENT Vxx_cru_sl_driv_vs_sp_kmh "Requested speed selected by the driver (Cruise Control or Speed Limiter) in km/h" UBYTE _CNV_A_R_LINEAR_____212_CM 1 0. 0. 255. ECU_ADDRESS 0xd0004cbb FORMAT "%3.0" /end MEASUREMENT
/begin MEASUREMENT Vxx_cru_sl_sp_inc_dec_dly_cnt "Timer for long switch press" UBYTE _CNV_A_R_LINEAR_____34_CM 1 0. 0. 2.55 ECU_ADDRESS 0xd0004cbc FORMAT "%4.2" /end MEASUREMENT
/begin MEASUREMENT Vxx_cru_sl_stt_ip_nom "Cruise control and speed limiter status : parameter sent to the cluster by CAN for display" UBYTE _CNV_A_R_ECME_LINEA_0_CM 1 0. 0. 7. ECU_ADDRESS 0xd0004cbd FORMAT "%1.0" /end MEASUREMENT
/begin MEASUREMENT Vxx_cru_sl_vs_sp_nom "Cruise control or speed limiter requested speed sent to the cluster by CAN for display" UBYTE _CNV_A_R_ECME_LINEA_0_CM 1 0. 0. 255. ECU_ADDRESS 0xd0004cbe FORMAT "%3.0" /end MEASUREMENT
/begin CHARACTERISTIC Cbx_ena_reg_decl_resu_on "This calibration authorise or not the entry in regulation by pressing resume or set/+ ( 1 : enable / 0 : disable)" VALUE 0xa0020839 _REC_S1VAL_20_u1 1. _CNV_S_2_RANGE______3_CM 0. 1. BIT_MASK 0x1 /end CHARACTERISTIC
/begin CHARACTERISTIC Cxx_cru_ovs_warn_thd "Speed theshold to activate the warning in case of volontary cruise control overspeed" VALUE 0xa002083a _REC_S1VAL_20_u1 25.5 _CNV_A_R_LINEAR_____406_CM 0. 25.5 FORMAT "%4.1" /end CHARACTERISTIC
/begin CHARACTERISTIC Cxx_cru_ovs_warn_thd_mph "Speed theshold in mph to activate the warning in case of volontary cruise control overspeed" VALUE 0xa002083b _REC_S1VAL_20_u1 25.5 _CNV_A_R_LINEAR_____407_CM 0. 25.5 FORMAT "%4.1" /end CHARACTERISTIC
/begin CHARACTERISTIC Cxx_cru_sl_long_sp_dec_t "pc_cru_spt_setptxx/Minimum duration of a push button press for continuous decrease of requested speed" VALUE 0xa002083c _REC_S1VAL_20_u1 2.55 _CNV_A_R_LINEAR_____34_CM 0. 2.55 FORMAT "%4.2" /end CHARACTERISTIC
/begin CHARACTERISTIC Cxx_cru_sl_long_sp_inc_t "pc_cru_spt_setptxx/Minimum duration of a push button press for continuous increase of requested speed" VALUE 0xa002083d _REC_S1VAL_20_u1 2.55 _CNV_A_R_LINEAR_____34_CM 0. 2.55 FORMAT "%4.2" /end CHARACTERISTIC
/begin CHARACTERISTIC Cxx_cru_sl_sp_inc_t "Time between two requested speed increments or decrements when button is pressed continuously" VALUE 0xa002083e _REC_S1VAL_20_u1 25.5 _CNV_A_R_LINEAR_____4_CM 0. 25.5 FORMAT "%4.1" /end CHARACTERISTIC
/begin CHARACTERISTIC Cxx_cru_sl_warn_dly "Filtering delay before transmission of a CRU/SL warning" VALUE 0xa002083f _REC_S1VAL_20_u1 25.5 _CNV_A_R_LINEAR_____4_CM 0. 25.5 FORMAT "%4.1" /end CHARACTERISTIC
/begin CHARACTERISTIC Cxx_sl_ovs_warn_thd "Speed theshold to activate the warning in case of volontary speed limiter overspeed" VALUE 0xa0020840 _REC_S1VAL_20_s1 25.5 _CNV_A_R_LINEAR_____406_CM -12.8 12.7 FORMAT "%6.2" /end CHARACTERISTIC
/begin CHARACTERISTIC Cxx_sl_ovs_warn_thd_mph "Speed theshold in mph to activate the warning in case of volontary speed limiter overspeed" VALUE 0xa0020841 _REC_S1VAL_20_s1 25.5 _CNV_A_R_LINEAR_____407_CM -12.8 12.7 FORMAT "%6.2" /end CHARACTERISTIC
/begin MEASUREMENT Vbx_cru_cmf_cut "Comfortable stop of the speed regulation" UBYTE _CNV_S_2_RANGE______3_CM 1 0. 0. 1. ECU_ADDRESS 0xd0003f0d BIT_MASK 0x1 /end MEASUREMENT
/begin MEASUREMENT Vbx_sta_swi_act "The START button has been pressed" UBYTE _CNV_S_2_RANGE______3_CM 1 0. 0. 1. ECU_ADDRESS 0xd0003f0e BIT_MASK 0x1 /end MEASUREMENT
/begin MEASUREMENT Vsx_cru_stt "Cruise control state" UBYTE _CNV_A_R_ECME_LINEA_0_CM 1 0. 0. 255. ECU_ADDRESS 0xd0003f0f FORMAT "%3.0" /end MEASUREMENT
/begin MEASUREMENT Vsx_sl_stt "Speed limiter state" UBYTE _CNV_A_R_ECME_LINEA_0_CM 1 0. 0. 4. ECU_ADDRESS 0xd0003f10 FORMAT "%1.0" /end MEASUREMENT
/begin MEASUREMENT Vxx_cru_sl_dacn "Compilation of all the cru/sl normal causes of deactivation." UBYTE _CNV_A_R_ECME_LINEA_0_CM 1 0. 0. 255. ECU_ADDRESS 0xd0003f11 FORMAT "%3.0" /end MEASUREMENT
/begin MEASUREMENT Vxx_cru_sl_dacn_prev "Previous compilation of all the cru/sl normal causes of deactivation" UBYTE _CNV_A_R_ECME_LINEA_0_CM 1 0. 0. 255. ECU_ADDRESS 0xd0003f12 FORMAT "%3.0" /end MEASUREMENT
/begin MEASUREMENT Vxx_cru_sl_dacn_sys_prev "Previous compilation of all the cru/sl normal deactivations due to system causes." UBYTE _CNV_A_R_ECME_LINEA_0_CM 1 0. 0. 255. ECU_ADDRESS 0xd0003f13 FORMAT "%3.0" /end MEASUREMENT
/begin MEASUREMENT Vxx_cru_sl_stt_nom "Cruise control and speed limiter status : parameter sent to the gearbox on the CAN network" UBYTE _CNV_A_R_ECME_LINEA_0_CM 1 0. 0. 3. ECU_ADDRESS 0xd0003f14 FORMAT "%1.0" /end MEASUREMENT
/begin MEASUREMENT Vbx_cru_sl_kmh_mph_cge "The displayed speed unit has changed during CC/SL activation" UBYTE _CNV_S_2_RANGE______3_CM 1 0. 0. 1. ECU_ADDRESS 0xd0004c30 BIT_MASK 0x1 /end MEASUREMENT
/begin MEASUREMENT Vbx_cru_sl_oor_vs "Vehicle speed outside the speed acceptance domain of CC/SL" UBYTE _CNV_S_2_RANGE______3_CM 1 0. 0. 1. ECU_ADDRESS 0xd0004c31 BIT_MASK 0x1 /end MEASUREMENT
/begin MEASUREMENT Vbx_cru_smal_vs_sp_rat "Vehicle speed is too small in comparison on the requested speed to enter in speed regulation" UBYTE _CNV_S_2_RANGE______3_CM 1 0. 0. 1. ECU_ADDRESS 0xd0004c32 BIT_MASK 0x1 /end MEASUREMENT
/begin MEASUREMENT Vbx_df_cru_vs_cmp "CCSL mux vehicle speed Coherence detected failure" UBYTE _CNV_S_2_RANGE______3_CM 1 0. 0. 1. ECU_ADDRESS 0xd0004c33 BIT_MASK 0x1 /end MEASUREMENT
/begin MEASUREMENT Vbx_dspl_vs_abst_fil "Displayed vehicle speed received on the CAN network not present after a filtering time" UBYTE _CNV_S_2_RANGE______3_CM 1 0. 0. 1. ECU_ADDRESS 0xd0004c34 BIT_MASK 0x1 /end MEASUREMENT
/begin MEASUREMENT Vbx_dspl_vs_navl_fil "Displayed vehicle speed received on the CAN network not available after a filtering time" UBYTE _CNV_S_2_RANGE______3_CM 1 0. 0. 1. ECU_ADDRESS 0xd0004c35 BIT_MASK 0x1 /end MEASUREMENT
/begin MEASUREMENT Vbx_vs_abst_fil "Vehicle speed received on the CAN network not present after a filtering time" UBYTE _CNV_S_2_RANGE______3_CM 1 0. 0. 1. ECU_ADDRESS 0xd0004c36 BIT_MASK 0x1 /end MEASUREMENT
/begin MEASUREMENT Vbx_vs_navl_fil "Vehicle speed received on the CAN network not available after a filtering time" UBYTE _CNV_S_2_RANGE______3_CM 1 0. 0. 1. ECU_ADDRESS 0xd0004c37 BIT_MASK 0x1 /end MEASUREMENT
/begin MEASUREMENT Vbx_vs_nok "Invalid or absent vehicle speed" UBYTE _CNV_S_2_RANGE______3_CM 1 0. 0. 1. ECU_ADDRESS 0xd0004c38 BIT_MASK 0x1 /end MEASUREMENT
/begin MEASUREMENT Vxx_cru_sl_acel "Filtered vehicle acceleration for cruise control  and speed limiter" SWORD _CNV_A_R_LINEAR_____405_CM 1 0. -12. 13.5 ECU_ADDRESS 0xd00030d4 FORMAT "%5.1" /end MEASUREMENT
/begin MEASUREMENT Vxx_cru_sl_long_step "Value of requested speed step when accel or decel switch pressed continuously" UBYTE _CNV_A_R_ECME_LINEA_0_CM 1 0. 0. 255. ECU_ADDRESS 0xd0004c39 FORMAT "%3.0" /end MEASUREMENT
/begin MEASUREMENT Vxx_cru_sl_max_vs "CC/SL maximal speed setpoint" UBYTE _CNV_A_R_ECME_LINEA_0_CM 1 0. 0. 255. ECU_ADDRESS 0xd0004c3a FORMAT "%3.0" /end MEASUREMENT
/begin MEASUREMENT Vxx_cru_sl_min_vs "CC/SL minimal speed setpoint" UBYTE _CNV_A_R_ECME_LINEA_0_CM 1 0. 0. 255. ECU_ADDRESS 0xd0004c3b FORMAT "%3.0" /end MEASUREMENT
/begin MEASUREMENT Vxx_cru_sl_no_efv_vs_thd "Difference between vehicle speed and requested speed to declare CC/SL ineffective" UBYTE _CNV_A_R_LINEAR_____252_CM 1 0. 0. 25.5 ECU_ADDRESS 0xd0004c3c FORMAT "%4.1" /end MEASUREMENT
/begin MEASUREMENT Vxx_cru_sl_raw_vs "Raw vehicle speed for cruise control and speed limiter strategy" UWORD _CNV_A_R_LINEAR_____136_CM 1 0. 0. 655.35 ECU_ADDRESS 0xd00030d6 FORMAT "%4.2" /end MEASUREMENT
/begin MEASUREMENT Vxx_cru_sl_smal_step "Value of requested speed step when accel or decel switch pressed during a short time" UBYTE _CNV_A_R_ECME_LINEA_0_CM 1 0. 0. 255. ECU_ADDRESS 0xd0004c3d FORMAT "%3.0" /end MEASUREMENT
/begin MEASUREMENT Vxx_cru_sl_vs "Vehicle speed filtered by the cruise control/speed limiter strategy" UWORD _CNV_A_R_LINEAR_____136_CM 1 0. 0. 655.35 ECU_ADDRESS 0xd00030d8 FORMAT "%4.2" /end MEASUREMENT
/begin MEASUREMENT Vxx_cru_sl_vs_kmh "Vehicle speed filtered by the cruise control/speed limiter strategy in km/h" UWORD _CNV_A_R_LINEAR_____70_CM 1 0. 0. 655.35 ECU_ADDRESS 0xd00030da FORMAT "%6.2" /end MEASUREMENT
/begin MEASUREMENT Vxx_vs_clos_spt_lamp_off_thd "Difference between vehicle speed and requested speed to turn OFF the lamp indicating that vehicle speed is reaching the setpoint." UBYTE _CNV_A_R_LINEAR_____252_CM 1 0. 0. 25.5 ECU_ADDRESS 0xd0004c3e FORMAT "%4.1" /end MEASUREMENT
/begin MEASUREMENT Vxx_vs_clos_spt_lamp_on_thd "Difference between vehicle speed and requested speed to turn ON the lamp indicating that vehicle speed is reaching the setpoint." UBYTE _CNV_A_R_LINEAR_____252_CM 1 0. 0. 25.5 ECU_ADDRESS 0xd0004c3f FORMAT "%4.1" /end MEASUREMENT
/begin CHARACTERISTIC Cbx_cru_sl_vs_cmp_prmt "The CC/SL failure due to vehicle speed incoherence is irreversible (1 = irreversible)" VALUE 0xa0020795 _REC_S1VAL_20_u1 1. _CNV_S_2_RANGE______3_CM 0. 1. BIT_MASK 0x1 /end CHARACTERISTIC
/begin CHARACTERISTIC Cbx_fsl_ena_cfm "" VALUE 0xa0020794 _REC_S1VAL_20_u1 1. _CNV_S_2_RANGE______3_CM 0. 1. BIT_MASK 0x1 /end CHARACTERISTIC
/begin CHARACTERISTIC Cxx_cru_abst_dspl_vs_dly "Frame absence duration to declare unavailable displayed vehicle speed" VALUE 0xa0020796 _REC_S1VAL_20_u1 2.55 _CNV_A_R_LINEAR_____34_CM 0. 2.55 FORMAT "%4.2" /end CHARACTERISTIC
/begin CHARACTERISTIC Cxx_cru_abst_vs_dly "Frame absence duration to declare unavailable vehicle speed" VALUE 0xa0020797 _REC_S1VAL_20_u1 2.55 _CNV_A_R_LINEAR_____34_CM 0. 2.55 FORMAT "%4.2" /end CHARACTERISTIC
/begin CHARACTERISTIC Cxx_cru_long_step "Value of requested speed step in cruise control mode when accel or decel switch pressed continuously" VALUE 0xa0020798 _REC_S1VAL_20_u1 255. _CNV_A_R_LINEAR_____212_CM 0. 255. FORMAT "%3.0" /end CHARACTERISTIC
/begin CHARACTERISTIC Cxx_cru_long_step_mph "Value of requested speed step in Cruise control mode when accel or decel switch pressed continuously in mph" VALUE 0xa0020799 _REC_S1VAL_20_u1 255. _CNV_A_R_LINEAR_____408_CM 0. 255. FORMAT "%1.0" /end CHARACTERISTIC
/begin CHARACTERISTIC Cxx_cru_nok_vs_dly "Invalid value duration to  declare invalid vehicle speed" VALUE 0xa002079a _REC_S1VAL_20_u1 2.55 _CNV_A_R_LINEAR_____34_CM 0. 2.55 FORMAT "%4.2" /end CHARACTERISTIC
/begin CHARACTERISTIC Cxx_cru_sl_fil_acel_fac "Acceleration digital filtering parameter" VALUE 0xa002079b _REC_S1VAL_20_u1 0.99609375 _CNV_A_R_LINEAR_____31_CM 0. 0.99609375 FORMAT "%5.3" /end CHARACTERISTIC
/begin CHARACTERISTIC Cxx_cru_sl_fil_vs_fac "Speed digital filtering parameter" VALUE 0xa002079c _REC_S1VAL_20_u1 0.99609375 _CNV_A_R_LINEAR_____31_CM 0. 0.99609375 FORMAT "%5.3" /end CHARACTERISTIC
/begin CHARACTERISTIC Cxx_cru_sl_max_vs "CC/SL maximal speed setpoint" VALUE 0xa002079d _REC_S1VAL_20_u1 255. _CNV_A_R_LINEAR_____212_CM 0. 255. FORMAT "%3.0" /end CHARACTERISTIC
/begin CHARACTERISTIC Cxx_cru_sl_max_vs_mph "CC/SL maximal speed setpoint in mph" VALUE 0xa002079e _REC_S1VAL_20_u1 255. _CNV_A_R_LINEAR_____408_CM 0. 255. FORMAT "%1.0" /end CHARACTERISTIC
/begin CHARACTERISTIC Cxx_cru_sl_min_vs "CC/SL minimal speed setpoint" VALUE 0xa002079f _REC_S1VAL_20_u1 255. _CNV_A_R_LINEAR_____212_CM 0. 255. FORMAT "%3.0" /end CHARACTERISTIC
/begin CHARACTERISTIC Cxx_cru_sl_min_vs_mph "CC/SL minimal speed setpoint in mph" VALUE 0xa00207a0 _REC_S1VAL_20_u1 255. _CNV_A_R_LINEAR_____408_CM 0. 255. FORMAT "%1.0" /end CHARACTERISTIC
/begin CHARACTERISTIC Cxx_cru_sl_no_efv_vs_thd "Difference between vehicle speed and requested speed to declare CC/SL ineffective" VALUE 0xa00207a1 _REC_S1VAL_20_u1 25.5 _CNV_A_R_LINEAR_____406_CM 0. 25.5 FORMAT "%4.1" /end CHARACTERISTIC
/begin CHARACTERISTIC Cxx_cru_sl_no_efv_vs_thd_mph "Difference between vehicle speed and requested speed to declare CC/SL ineffective in mph" VALUE 0xa00207a2 _REC_S1VAL_20_u1 25.5 _CNV_A_R_LINEAR_____407_CM 0. 25.5 FORMAT "%4.1" /end CHARACTERISTIC
/begin CHARACTERISTIC Cxx_cru_sl_smal_step "Value of requested speed step when accel or decel switch pressed during a short time" VALUE 0xa00207a3 _REC_S1VAL_20_u1 255. _CNV_A_R_LINEAR_____212_CM 0. 255. FORMAT "%3.0" /end CHARACTERISTIC
/begin CHARACTERISTIC Cxx_cru_sl_smal_step_mph "Value of requested speed step when accel or decel switch pressed during a short time in mph" VALUE 0xa00207a4 _REC_S1VAL_20_u1 255. _CNV_A_R_LINEAR_____408_CM 0. 255. FORMAT "%1.0" /end CHARACTERISTIC
/begin CHARACTERISTIC Cxx_cru_vs_secu_min "Minimum speed to test the speed coherence" VALUE 0xa00207a5 _REC_S1VAL_20_u1 255. _CNV_A_R_LINEAR_____212_CM 0. 255. FORMAT "%3.0" /end CHARACTERISTIC
/begin CHARACTERISTIC Cxx_cru_vs_sp_rat "Minimum vehicle speed/requested speed ratio to disconnect cruise control" VALUE 0xa002078a _REC_S1VAL_20_u2 200. _CNV_A_R_LINEAR_____94_CM 0. 200. FORMAT "%6.2" /end CHARACTERISTIC
/begin CHARACTERISTIC Cxx_dfdec_cru_vs_cmp "CC/SL mux vehicle speed coherence Detected Failure Counter Decrement" VALUE 0xa002078c _REC_S1VAL_20_u2 65535. _CNV_A_R_ECME_LINEA_0_CM 0. 65535. FORMAT "%5.0" /end CHARACTERISTIC
/begin CHARACTERISTIC Cxx_dfinc_cru_vs_cmp "CC/SL mux vehicle speed coherence Detected Failure Counter Increment" VALUE 0xa002078e _REC_S1VAL_20_u2 65535. _CNV_A_R_ECME_LINEA_0_CM 0. 65535. FORMAT "%5.0" /end CHARACTERISTIC
/begin CHARACTERISTIC Cxx_dspl_vs_secu_fac "Factor to detect bad received displayed vehicle speed" VALUE 0xa00207a6 _REC_S1VAL_20_u1 0.255 _CNV_A_R_LINEAR_____108_CM 0. 0.255 FORMAT "%5.3" /end CHARACTERISTIC
/begin CHARACTERISTIC Cxx_dspl_vs_secu_ofs "Offset to detect bad received displayed vehicle speed" VALUE 0xa0020790 _REC_S1VAL_20_u2 655.35 _CNV_A_R_LINEAR_____70_CM 0. 655.35 FORMAT "%6.2" /end CHARACTERISTIC
/begin CHARACTERISTIC Cxx_dspl_vs_secu_thd "Threshold to detect bad received displayed vehicle speed" VALUE 0xa0020792 _REC_S1VAL_20_u2 655.35 _CNV_A_R_LINEAR_____70_CM 0. 655.35 FORMAT "%6.2" /end CHARACTERISTIC
/begin CHARACTERISTIC Cxx_sl_long_step "Value of requested speed step in speed limiter mode when accel or decel switch pressed continuously" VALUE 0xa00207a7 _REC_S1VAL_20_u1 255. _CNV_A_R_LINEAR_____212_CM 0. 255. FORMAT "%3.0" /end CHARACTERISTIC
/begin CHARACTERISTIC Cxx_sl_long_step_mph "Value of requested speed step in Speed limiter mode when accel or decel switch pressed continuously in mph" VALUE 0xa00207a8 _REC_S1VAL_20_u1 255. _CNV_A_R_LINEAR_____408_CM 0. 255. FORMAT "%1.0" /end CHARACTERISTIC
/begin CHARACTERISTIC Cxx_vs_clos_spt_lamp_off_thd "Difference between vehicle speed and requested speed to turn OFF the lamp indicating that vehicle speed is reaching the setpoint." VALUE 0xa00207a9 _REC_S1VAL_20_u1 25.5 _CNV_A_R_LINEAR_____407_CM 0. 25.5 FORMAT "%3.1" /end CHARACTERISTIC
/begin CHARACTERISTIC Cxx_vs_clos_spt_lamp_off_thd_mph "Difference between vehicle speed and requested speed to turn OFF the lamp indicating that vehicle speed is reaching the setpoint  in mph." VALUE 0xa00207aa _REC_S1VAL_20_u1 25.5 _CNV_A_R_LINEAR_____407_CM 0. 25.5 FORMAT "%3.1" /end CHARACTERISTIC
/begin CHARACTERISTIC Cxx_vs_clos_spt_lamp_on_thd "Difference between vehicle speed and requested speed to turn ON the lamp indicating that vehicle speed is reaching the setpoint." VALUE 0xa00207ab _REC_S1VAL_20_u1 25.5 _CNV_A_R_LINEAR_____407_CM 0. 25.5 FORMAT "%3.1" /end CHARACTERISTIC
/begin CHARACTERISTIC Cxx_vs_clos_spt_lamp_on_thd_mph "Difference between vehicle speed and requested speed to turn ON the lamp indicating that vehicle speed is reaching the setpoint  in mph." VALUE 0xa00207ac _REC_S1VAL_20_u1 25.5 _CNV_A_R_LINEAR_____407_CM 0. 25.5 FORMAT "%3.1" /end CHARACTERISTIC
/begin MEASUREMENT Vxx_fsl_max_vs_sp_kmh "Requested speed for fixed speed limiter or statutory limiter" UWORD _CNV_A_R_LINEAR_____70_CM 1 0. 0. 655.35 ECU_ADDRESS 0xd0003a6e FORMAT "%6.2" /end MEASUREMENT
/begin MEASUREMENT Vbx_fsl_cfm "Fixed Speed Limiter activated." UBYTE _CNV_S_2_RANGE______3_CM 1 0. 0. 1. ECU_ADDRESS 0xd00043a6 BIT_MASK 0x1 /end MEASUREMENT
/begin CHARACTERISTIC Cbx_fsl_cfm "(=1) Fixed Speed Limiter activated" VALUE 0xa002157b _REC_S1VAL_20_u1 1. _CNV_S_2_RANGE______3_CM 0. 1. BIT_MASK 0x1 /end CHARACTERISTIC
/begin MEASUREMENT Vbx_whl_lk_stt_NVM "Steering wheel switches connection detection. Stored in E≤PROM." UBYTE _CNV_S_2_RANGE______3_CM 1 0. 0. 1. DISPLAY_IDENTIFIER InPciCci_NVM.Vbx_whl_lk_stt_NVM ECU_ADDRESS 0xd0004d80 BIT_MASK 0x1 /end MEASUREMENT
/begin MEASUREMENT Vxx_cru_sl_resu_blk_dly_max_NVM "Maximum duration of RESUME button press" UBYTE _CNV_A_R_LINEAR_____82_CM 1 0. 0. 255. DISPLAY_IDENTIFIER InPciCci_NVM.Vxx_cru_sl_resu_blk_dly_max_NVM ECU_ADDRESS 0xd0004d81 FORMAT "%3.0" /end MEASUREMENT
/begin MEASUREMENT Vxx_cru_sl_acel_blk_dly_max_NVM "Maximum duration of SET+ button press" UBYTE _CNV_A_R_LINEAR_____82_CM 1 0. 0. 255. DISPLAY_IDENTIFIER InPciCci_NVM.Vxx_cru_sl_acel_blk_dly_max_NVM ECU_ADDRESS 0xd0004d82 FORMAT "%3.0" /end MEASUREMENT
/begin MEASUREMENT Vxx_cru_sl_decl_blk_dly_max_NVM "Maximum duration of SET- button press" UBYTE _CNV_A_R_LINEAR_____82_CM 1 0. 0. 255. DISPLAY_IDENTIFIER InPciCci_NVM.Vxx_cru_sl_decl_blk_dly_max_NVM ECU_ADDRESS 0xd0004d83 FORMAT "%3.0" /end MEASUREMENT
/begin MEASUREMENT Vxx_cru_sl_susp_blk_dly_max "Maximum duration of SUSPEND button press" UBYTE _CNV_A_R_LINEAR_____82_CM 1 0. 0. 255. DISPLAY_IDENTIFIER InPciCci_NVM.Vxx_cru_sl_susp_blk_dly_max_NVM ECU_ADDRESS 0xd0004d84 FORMAT "%3.0" /end MEASUREMENT
/begin MEASUREMENT Vxx_cru_sl_cmd_blk_ctr_max_NVM "Maximum value of counter for detection of blocked button. Saved in EEPROM" UBYTE _CNV_A_R_ECME_LINEA_0_CM 1 0. 0. 255. DISPLAY_IDENTIFIER InPciCci_NVM.Vxx_cru_sl_cmd_blk_ctr_max_NVM ECU_ADDRESS 0xd0004d85 FORMAT "%3.0" /end MEASUREMENT
/begin MEASUREMENT Vbx_cru_swi_lk_stt_NVM "Detect the cruise control switch connection. Stored in E≤PROM." UBYTE _CNV_S_2_RANGE______3_CM 1 0. 0. 1. DISPLAY_IDENTIFIER InPciCci_NVM.Vbx_cru_swi_lk_stt_NVM ECU_ADDRESS 0xd0004d86 BIT_MASK 0x1 /end MEASUREMENT
/begin MEASUREMENT Vbx_cru_lk_stt_NVM "Detect cruise control option with security on configuration detection. Stored in E≤PROM." UBYTE _CNV_S_2_RANGE______3_CM 1 0. 0. 1. DISPLAY_IDENTIFIER InPciCci_NVM.Vbx_cru_lk_stt_NVM ECU_ADDRESS 0xd0004d87 BIT_MASK 0x1 /end MEASUREMENT
/begin MEASUREMENT Vbx_sl_swi_lk_stt_NVM "Detect the speed limiter switch connection. Stored in E≤PROM." UBYTE _CNV_S_2_RANGE______3_CM 1 0. 0. 1. DISPLAY_IDENTIFIER InPciCci_NVM.Vbx_sl_swi_lk_stt_NVM ECU_ADDRESS 0xd0004d88 BIT_MASK 0x1 /end MEASUREMENT
/begin MEASUREMENT Vbx_sl_lk_stt_NVM "speed limiter option detection with security on configuration detection. Stored in E≤PROM." UBYTE _CNV_S_2_RANGE______3_CM 1 0. 0. 1. DISPLAY_IDENTIFIER InPciCci_NVM.Vbx_sl_lk_stt_NVM ECU_ADDRESS 0xd0004d89 BIT_MASK 0x1 /end MEASUREMENT
/begin COMPU_METHOD _CNV_A_R_ECME_LINEA_0_CM "" RAT_FUNC "%6.3" "-" COEFFS 0 1. 0. 0 0 1 /end COMPU_METHOD
/begin COMPU_METHOD _CNV_S_2_RANGE______3_CM "" TAB_VERB "%6.3" "-" COMPU_TAB_REF _CNV_S_2_RANGE______3 /end COMPU_METHOD
/begin COMPU_VTAB _CNV_S_2_RANGE______3 "" TAB_VERB 2 0 "0" 1 "1" /end COMPU_VTAB
/begin COMPU_METHOD _CNV_A_R_LINEAR_____4_CM "" RAT_FUNC "%6.3" "s" COEFFS 0 10. 0. 0 0 1 /end COMPU_METHOD
/begin COMPU_METHOD _CNV_A_R_LINEAR_____16_CM "" RAT_FUNC "%6.3" "V" COEFFS 0 6553.599999999993 0. 0 0 1 /end COMPU_METHOD
/begin COMPU_METHOD _CNV_A_R_ENSD_LINEA_24_CM "" RAT_FUNC "%6.3" "rpm" COEFFS 0 4. 0. 0 0 1 /end COMPU_METHOD
/begin COMPU_METHOD _CNV_A_R_LINEAR_____31_CM "" RAT_FUNC "%6.3" "-" COEFFS 0 256. 0. 0 0 1 /end COMPU_METHOD
/begin COMPU_METHOD _CNV_A_R_LINEAR_____34_CM "" RAT_FUNC "%6.3" "s" COEFFS 0 100. 0. 0 0 1 /end COMPU_METHOD
/begin COMPU_METHOD _CNV_A_R_LINEAR_____52_CM "" RAT_FUNC "%6.3" "mV" COEFFS 0 1. 0. 0 0 1 /end COMPU_METHOD
/begin COMPU_METHOD _CNV_A_R_LINEAR_____54_CM "" RAT_FUNC "%6.3" "∞C" COEFFS 0 10. 400. 0 0 1 /end COMPU_METHOD
/begin COMPU_METHOD _CNV_A_R_LINEAR_____58_CM "" RAT_FUNC "%6.3" "s" COEFFS 0 1000. 0. 0 0 1 /end COMPU_METHOD
/begin COMPU_METHOD _CNV_A_R_LINEAR_____70_CM "" RAT_FUNC "%6.3" "km/h" COEFFS 0 100. 0. 0 0 1 /end COMPU_METHOD
/begin COMPU_METHOD _CNV_A_R_LINEAR_____82_CM "" RAT_FUNC "%6.3" "s" COEFFS 0 1. 0. 0 0 1 /end COMPU_METHOD
/begin COMPU_METHOD _CNV_A_R_LINEAR_____94_CM "" RAT_FUNC "%6.3" "%" COEFFS 0 100. 0. 0 0 1 /end COMPU_METHOD
/begin COMPU_METHOD _CNV_A_R_LINEAR_____108_CM "" RAT_FUNC "%6.3" "-" COEFFS 0 1000. 0. 0 0 1 /end COMPU_METHOD
/begin COMPU_METHOD _CNV_A_R_LINEAR_____114_CM "" RAT_FUNC "%6.3" "%" COEFFS 0 2.55 0. 0 0 1 /end COMPU_METHOD
/begin COMPU_METHOD _CNV_A_R_LINEAR_____118_CM "" RAT_FUNC "%6.3" "-" COEFFS 0 255. 0. 0 0 1 /end COMPU_METHOD
/begin COMPU_METHOD _CNV_S_3_STATUS_OK__120_CM "" TAB_VERB "%6.3" "-" COMPU_TAB_REF _CNV_S_3_STATUS_OK__120 /end COMPU_METHOD
/begin COMPU_VTAB _CNV_S_3_STATUS_OK__120 "" TAB_VERB 3 0 "Nsx_vld_nok_0" 1 "Nsx_vld_ok_1" 2 "Nsx_vld_fail_2" /end COMPU_VTAB
/begin COMPU_METHOD _CNV_S_4_STATUS_OK__121_CM "" TAB_VERB "%6.3" "-" COMPU_TAB_REF _CNV_S_4_STATUS_OK__121 /end COMPU_METHOD
/begin COMPU_VTAB _CNV_S_4_STATUS_OK__121 "" TAB_VERB 4 0 "Nsx_vld_nok_0" 1 "Nsx_vld_ok_1" 2 "Nsx_vld_fail_2" 3 "Nsx_vld_fail_3" /end COMPU_VTAB
/begin COMPU_METHOD _CNV_A_R_LINEAR_____123_CM "" RAT_FUNC "%6.3" "Nm" COEFFS 0 32. 0. 0 0 1 /end COMPU_METHOD
/begin COMPU_METHOD _CNV_A_R_LINEAR_____127_CM "" RAT_FUNC "%6.3" "Nm" COEFFS 0 32. 32768. 0 0 1 /end COMPU_METHOD
/begin COMPU_METHOD _CNV_A_R_LINEAR_____128_CM "" RAT_FUNC "%6.3" "W" COEFFS 0 0.1 0. 0 0 1 /end COMPU_METHOD
/begin COMPU_METHOD _CNV_A_R_LINEAR_____136_CM "" RAT_FUNC "%6.3" "-" COEFFS 0 100. 0. 0 0 1 /end COMPU_METHOD
/begin COMPU_METHOD _CNV_A_R_LINEAR_____144_CM "" RAT_FUNC "%6.3" "ms" COEFFS 0 1. 0. 0 0 1 /end COMPU_METHOD
/begin COMPU_METHOD _CNV_S_3_STATUS_OK__158_CM "" TAB_VERB "%6.3" "" COMPU_TAB_REF _CNV_S_3_STATUS_OK__158 /end COMPU_METHOD
/begin COMPU_VTAB _CNV_S_3_STATUS_OK__158 "" TAB_VERB 3 0 "Nsx_vld_nok_0" 1 "Nsx_vld_ok_1" 2 "Nsx_vld_fail_2" /end COMPU_VTAB
/begin COMPU_METHOD _CNV_A_R_LINEAR_____161_CM "" RAT_FUNC "%6.3" "Nm" COEFFS 0 32. 12800. 0 0 1 /end COMPU_METHOD
/begin COMPU_METHOD _CNV_S_4_STATUS_TQ__164_CM "" TAB_VERB "%6.3" "-" COMPU_TAB_REF _CNV_S_4_STATUS_TQ__164 /end COMPU_METHOD
/begin COMPU_VTAB _CNV_S_4_STATUS_TQ__164 "" TAB_VERB 4 0 "Nsx_no_tq_req" 1 "Nsx_asr_msr_tq_req_nok" 5 "Nsx_asr_tq_req" 6 "Nsx_msr_tq_req" /end COMPU_VTAB
/begin COMPU_METHOD _CNV_A_R_A_165_CM "" RAT_FUNC "%6.3" "" COEFFS 0 1. 0. 0 0 1 /end COMPU_METHOD
/begin COMPU_METHOD _CNV_S_8_STATUS_OK__181_CM "" TAB_VERB "%6.3" "-" COMPU_TAB_REF _CNV_S_8_STATUS_OK__181 /end COMPU_METHOD
/begin COMPU_VTAB _CNV_S_8_STATUS_OK__181 "" TAB_VERB 8 0 "Nsx_vld_nok_0" 1 "Nsx_vld_ok_1" 2 "Nsx_vld_fail_2" 3 "Nsx_vld_fail_3" 4 "Nsx_vld_fail_4" 5 "Nsx_vld_fail_5" 6 "Nsx_vld_fail_6" 7 "Nsx_vld_fail_7" /end COMPU_VTAB
/begin COMPU_METHOD _CNV_A_R_LINEAR_____211_CM "" RAT_FUNC "%6.3" "%" COEFFS 0 800. 0. 0 0 1 /end COMPU_METHOD
/begin COMPU_METHOD _CNV_A_R_LINEAR_____212_CM "" RAT_FUNC "%6.3" "km/h" COEFFS 0 1. 0. 0 0 1 /end COMPU_METHOD
/begin COMPU_METHOD _CNV_A_R_LINEAR_____218_CM "" RAT_FUNC "%6.3" "km" COEFFS 0 1. 0. 0 0 1 /end COMPU_METHOD
/begin COMPU_METHOD _CNV_A_R_LINEAR_____251_CM "" RAT_FUNC "%6.3" "-" COEFFS 0 100. 1000. 0 0 1 /end COMPU_METHOD
/begin COMPU_METHOD _CNV_A_R_LINEAR_____252_CM "" RAT_FUNC "%6.3" "-" COEFFS 0 10. 0. 0 0 1 /end COMPU_METHOD
/begin COMPU_METHOD _CNV_S_4_STATUS_OK__275_CM "" TAB_VERB "%6.3" "" COMPU_TAB_REF _CNV_S_4_STATUS_OK__275 /end COMPU_METHOD
/begin COMPU_VTAB _CNV_S_4_STATUS_OK__275 "" TAB_VERB 4 0 "Nsx_vld_nok_0" 1 "Nsx_vld_ok_1" 2 "Nsx_vld_fail_2" 3 "Nsx_vld_fail_3" /end COMPU_VTAB
/begin COMPU_METHOD _CNV_A_R_LINEAR_____317_CM "" RAT_FUNC "%6.3" "m/s≤" COEFFS 0 2500. 0. 0 0 1 /end COMPU_METHOD
/begin COMPU_METHOD _CNV_S_3_STATUS_ANT_387_CM "" TAB_VERB "%6.3" "-" COMPU_TAB_REF _CNV_S_3_STATUS_ANT_387 /end COMPU_METHOD
/begin COMPU_VTAB _CNV_S_3_STATUS_ANT_387 "" TAB_VERB 3 1 "Nsx_ant_neut" 2 "Nsx_ant_drag_red_agb" 3 "Nsx_ant_driv" /end COMPU_VTAB
/begin COMPU_METHOD _CNV_A_R_LINEAR_____399_CM "" RAT_FUNC "%6.3" "-" COEFFS 0 4. 0. 0 0 1 /end COMPU_METHOD
/begin COMPU_METHOD _CNV_A_R_LINEAR_____400_CM "" RAT_FUNC "%6.3" "cm" COEFFS 0 0.25 0. 0 0 1 /end COMPU_METHOD
/begin COMPU_METHOD _CNV_A_R_LINEAR_____401_CM "" RAT_FUNC "%6.3" "∞C" COEFFS 0 10. 3.637978807091713e-012 0 0 1 /end COMPU_METHOD
/begin COMPU_METHOD _CNV_A_R_LINEAR_____402_CM "" RAT_FUNC "%6.3" "(Nm/rpm)^(1/2)" COEFFS 0 1000. 0. 0 0 1 /end COMPU_METHOD
/begin COMPU_METHOD _CNV_A_R_LINEAR_____403_CM "" RAT_FUNC "%6.3" "(Nm/rpm)^(1/2)" COEFFS 0 32. 12800. 0 0 1 /end COMPU_METHOD
/begin COMPU_METHOD _CNV_A_R_LINEAR_____404_CM "" RAT_FUNC "%6.3" "km" COEFFS 0 10. 0. 0 0 1 /end COMPU_METHOD
/begin COMPU_METHOD _CNV_A_R_LINEAR_____405_CM "" RAT_FUNC "%6.3" "m/s≤" COEFFS 0 10. 0. 0 0 1 /end COMPU_METHOD
/begin COMPU_METHOD _CNV_A_R_LINEAR_____406_CM "" RAT_FUNC "%6.3" "km/h" COEFFS 0 10. 0. 0 0 1 /end COMPU_METHOD
/begin COMPU_METHOD _CNV_A_R_LINEAR_____407_CM "" RAT_FUNC "%6.3" "mph" COEFFS 0 10. 0. 0 0 1 /end COMPU_METHOD
/begin COMPU_METHOD _CNV_A_R_LINEAR_____408_CM "" RAT_FUNC "%6.3" "mph" COEFFS 0 1. 0. 0 0 1 /end COMPU_METHOD
/begin RECORD_LAYOUT _REC_S1VAL_20_u4 FNC_VALUES 1 ULONG COLUMN_DIR DIRECT /end RECORD_LAYOUT
/begin RECORD_LAYOUT _REC_S1VAL_20_u1 FNC_VALUES 1 UBYTE COLUMN_DIR DIRECT /end RECORD_LAYOUT
/begin RECORD_LAYOUT _REC_A2AXS_20_u1 NO_AXIS_PTS_X 1 UBYTE AXIS_PTS_X 2 UBYTE INDEX_INCR DIRECT /end RECORD_LAYOUT
/begin RECORD_LAYOUT _REC_S1VAL_20_u2 FNC_VALUES 1 UWORD COLUMN_DIR DIRECT /end RECORD_LAYOUT
/begin RECORD_LAYOUT _REC_S1VAL_20_s2 FNC_VALUES 1 SWORD COLUMN_DIR DIRECT /end RECORD_LAYOUT
/begin RECORD_LAYOUT _REC_A2AXS_20_u2 NO_AXIS_PTS_X 1 UWORD AXIS_PTS_X 2 UWORD INDEX_INCR DIRECT /end RECORD_LAYOUT
/begin RECORD_LAYOUT _REC_A1MAP_20_u2_u2_u2 FNC_VALUES 1 UWORD COLUMN_DIR DIRECT /end RECORD_LAYOUT
/begin RECORD_LAYOUT _REC_A1CUR_20_u2_u2 FNC_VALUES 1 UWORD COLUMN_DIR DIRECT /end RECORD_LAYOUT
/begin RECORD_LAYOUT _REC_S1VAL_20_s1 FNC_VALUES 1 SBYTE COLUMN_DIR DIRECT /end RECORD_LAYOUT
/begin RECORD_LAYOUT _REC_A1MAP_20_u2_u1_u2 FNC_VALUES 1 UWORD COLUMN_DIR DIRECT /end RECORD_LAYOUT
/begin RECORD_LAYOUT _REC_A1MAP_20_u2_u2_u1 FNC_VALUES 1 UWORD COLUMN_DIR DIRECT /end RECORD_LAYOUT
/begin FUNCTION CmMuxSer_Pcaplou ""
 /begin DEF_CHARACTERISTIC Cbx_acel_pdl_rat_secu_1_cfm Cbx_mux_driv_pwt_sp_fail Cxx_acel_pdl_rat_secu_1_val /end DEF_CHARACTERISTIC
 /begin OUT_MEASUREMENT KickDownActivated PedalError PowerTrainSetPoint RawSensor /end OUT_MEASUREMENT
/end FUNCTION
/begin FUNCTION CmMuxSer_Pcatqin ""
 /begin OUT_MEASUREMENT Vbx_mux_agb_csm_tq_navl Vbx_mux_gear_cge Vsx_mux_agb_csm_tq_vld Vsx_mux_agb_tq_ctl_typ Vxx_mux_agb_clck Vxx_mux_agb_csm_tq Vxx_mux_agb_tqe_sp Vxx_mux_agb_tqe_sp_raw Vxx_mux_agb_tqe_tgt_lim Vxx_mux_agb_tqe_tgt_lim_raw /end OUT_MEASUREMENT
/end FUNCTION
/begin FUNCTION CmMuxSer_Pcbpkin "" /begin OUT_MEASUREMENT Vbx_mux_bpk Vbx_mux_bpk_navl Vsx_mux_bpk_vld /end OUT_MEASUREMENT /end FUNCTION
/begin FUNCTION CmMuxSer_Pcbrkin "" /begin OUT_MEASUREMENT Vbx_mux_brk_pdl_navl Vsx_mux_brk_pdl Vsx_mux_brk_pdl_vld /end OUT_MEASUREMENT /end FUNCTION
/begin FUNCTION CmMuxSer_Pcbrkou "" /begin OUT_MEASUREMENT OpenActiveBrakeSwitch_ECM /end OUT_MEASUREMENT /end FUNCTION
/begin FUNCTION CmMuxSer_Pcclbin ""
 /begin OUT_MEASUREMENT Vbx_mux_bgin_str_clu_cnt_navl Vsx_mux_bgin_str_clu_cnt Vsx_mux_bgin_str_clu_cnt_vld /end OUT_MEASUREMENT
/end FUNCTION
/begin FUNCTION CmMuxSer_Pcclein ""
 /begin OUT_MEASUREMENT Vbx_mux_end_str_clu_cnt_navl Vsx_mux_end_str_clu_cnt Vsx_mux_end_str_clu_cnt_vld /end OUT_MEASUREMENT
/end FUNCTION
/begin FUNCTION CmMuxSer_Pcespin ""
 /begin OUT_MEASUREMENT Vbx_mux_asr_reg Vbx_mux_ayc_reg Vsx_mux_asr_msr_typ Vsx_mux_asr_msr_typ_vld Vsx_mux_asr_reg_vld Vsx_mux_ayc_reg_vld Vxx_mux_asr_msr_clck Vxx_mux_asr_tqe_sp Vxx_mux_asr_tqe_sp_raw Vxx_mux_asr_tqe_tgt Vxx_mux_asr_tqe_tgt_raw Vxx_mux_msr_tqe_sp Vxx_mux_msr_tqe_sp_raw /end OUT_MEASUREMENT
/end FUNCTION
/begin FUNCTION CmMuxSer_Pcfshou "" /begin DEF_CHARACTERISTIC Cxx_free_shf_dft_val Cxx_free_shf_ini_val /end DEF_CHARACTERISTIC /begin OUT_MEASUREMENT FreeShift /end OUT_MEASUREMENT /end FUNCTION
/begin FUNCTION CmMuxSer_Pcrvnin ""
 /begin OUT_MEASUREMENT Vbx_mux_neut_cnt_navl Vbx_mux_rvr_cnt_navl Vsx_mux_neut_cnt Vsx_mux_neut_cnt_vld Vsx_mux_rvr_cnt Vsx_mux_rvr_cnt_vld /end OUT_MEASUREMENT
/end FUNCTION
/begin FUNCTION CmMuxSer_Pcspcin "" /begin OUT_MEASUREMENT Vxx_mux_agb_driv_spt_fac /end OUT_MEASUREMENT /end FUNCTION
/begin FUNCTION CmMuxSer_Pctcsin ""
 /begin OUT_MEASUREMENT Vbx_mux_agb_coup_navl Vbx_mux_ant_crt_slc_navl Vsx_mux_agb_coup Vsx_mux_agb_coup_vld Vsx_mux_ant_crt_slc Vsx_mux_ant_crt_slc_vld Vsx_mux_rgb_coup Vsx_mux_rgb_coup_vld /end OUT_MEASUREMENT
/end FUNCTION
/begin FUNCTION CmMuxSer_Pctqeou ""
 /begin OUT_MEASUREMENT ASR_MSRAcknowledgement AT_TorqueAcknowledgement EngineTorque_WithoutTMReq RawEngineTorque_WithoutTMReq RequestedTorqueAfterProc /end OUT_MEASUREMENT
/end FUNCTION
/begin FUNCTION CmMuxSer_Pctrein ""
 /begin OUT_MEASUREMENT Vbx_mux_drag_red_agb Vbx_mux_egb_neut Vbx_mux_raw_egb_ant_gear_navl Vbx_mux_raw_egb_gear_navl Vsx_mux_drag_red_agb_vld Vsx_mux_egb_neut_vld Vsx_mux_raw_egb_ant_gear Vsx_mux_raw_egb_ant_gear_vld Vsx_mux_raw_egb_gear Vsx_mux_raw_egb_gear_vld /end OUT_MEASUREMENT
/end FUNCTION
/begin FUNCTION CmMuxSer_Pftfdis "" /begin OUT_MEASUREMENT ParticulateFilterFailureDisplay /end OUT_MEASUREMENT /end FUNCTION
/begin FUNCTION CmMuxSer_Pftstat "" /begin OUT_MEASUREMENT ParticulateFilterState /end OUT_MEASUREMENT /end FUNCTION
/begin FUNCTION CmMuxSer_Rxfrmxx ""
 /begin OUT_MEASUREMENT ABSinRegulation ACCompClutchRequest ACCompClutchStatus ACCompPowerUsed ACCompRequest ACCoolingFanSpeedRequest ACMinEngineIdleSpeedRequest ASRDynamicTorqueRequest ASRStaticTorqueRequest ASRinRegulation ATCoolingFanSpeedRequest AT_Clock AT_MILRequest AT_Minimum_IdleSpeedRequest AT_TorqueControlType AT_TorqueLosses AYCinRegulation AccurateOdometer AirbagCrashOrder AlternatorLoad AnticipatedCurrentShift BrakeInfoStatus BrakeSwitchFailure ClimateCoolingRequest ClutchSwitchMaximumTravel ClutchSwitchMinimumTravel DiagMuxOn_BCM DiagnoseFuelLow DisplayedSpeed DisplayedSpeedUnit DistanceTotalizer ESP_Clock ESP_TorqueControlType ElectricalPowerDrived EmergencyEngineStop ExternalTemp FastTorqueRequest FrontDefrostEngaged FuelCutRequestedEngineSpeed FuelLevelDisplayed FuelLow GenericApplicativeDiagEnable InputShaftRevolution InstantMecanicalPowerByAlt KeyVehicle Limit_SlowTorqueRequest MSRTorqueRequest MSRinRegulation MiniConsumptionRequest NeutralContact OilDrainAlertResetRequest PTCEngineIdleSpeedRequest ParkingBrakeStatus RearDefrostEngaged RearGearEngaged SLockValueControl SoftwareLockValue[0] SoftwareLockValue[1] SoftwareLockValue[2] SoftwareLockValue[3] SportivityCriteria StartButtonPushed StarterStatus StartingMode_BCM_R SteeringWheelAngle TorqueConverterState TransmRangeEngaged_Current TransmRangeEngaged_Target TransversalAcceleration VehicleSpeed WheelSpeedRL WheelSpeedRR /end OUT_MEASUREMENT
/end FUNCTION
/begin FUNCTION CmMuxSer_Rxp50in "" /begin DEF_CHARACTERISTIC Cbx_vh_key_navl_val Cxx_eng_aut_can_diag_dly /end DEF_CHARACTERISTIC
 /begin OUT_MEASUREMENT Vbx_can_diag Vbx_can_diag_raw Vbx_mux_ac_acel_is_sp_navl Vbx_mux_ac_mdf1_req Vbx_mux_ac_mdf2_req Vbx_mux_ac_req Vbx_mux_ac_req_ext Vbx_mux_ac_req_int Vbx_mux_agb_mdf1_req Vbx_mux_agb_mdf2_req Vbx_mux_can_diag Vbx_mux_dspl_vs_in_mph Vbx_mux_dspl_vs_navl Vbx_mux_vh_key Vbx_mux_vs_navl Vsx_mux_ac_acel_is_sp_vld Vsx_mux_ac_mdf_req_vld Vsx_mux_ac_req_ext_vld Vsx_mux_ac_req_int_vld Vsx_mux_ac_req_vld Vsx_mux_agb_mdf_req_vld Vsx_mux_dspl_vs_vld Vsx_mux_ena_sta_agb Vsx_mux_ena_sta_agb_vld Vsx_mux_sta_stt_vld Vsx_mux_vs_vld Vxx_mux_ac_acel_is_sp Vxx_mux_airb1 Vxx_mux_airb2 Vxx_mux_dspl_vs Vxx_mux_eng_stop_req_ccu Vxx_mux_eng_stop_req_rgb Vxx_mux_eng_stop_req_ssg Vxx_mux_sta_stt Vxx_mux_sta_swi_act_ctr Vxx_mux_vs /end OUT_MEASUREMENT
/end FUNCTION
/begin FUNCTION CmMuxSer_Smacsin "" /begin OUT_MEASUREMENT Vbx_mux_acs_acel_is_req Vsx_mux_acs_acel_is_req_vld /end OUT_MEASUREMENT /end FUNCTION
/begin FUNCTION CmMuxSer_Smat1in "" /begin OUT_MEASUREMENT Vbx_mux_agb_is_acel_req Vsx_mux_agb_is_acel_req_vld /end OUT_MEASUREMENT /end FUNCTION
/begin FUNCTION CmMuxSer_Smat2in ""
 /begin OUT_MEASUREMENT Vbx_mux_agb_is_acel_sp_navl Vsx_mux_agb_is_acel_sp_vld Vxx_mux_agb_is_acel_sp /end OUT_MEASUREMENT
/end FUNCTION
/begin FUNCTION CmMuxSer_Smengou "" /begin OUT_MEASUREMENT EngineStatus_R /end OUT_MEASUREMENT /end FUNCTION
/begin FUNCTION CmMuxSer_Smlimin ""
 /begin OUT_MEASUREMENT Vbx_mux_egb_n_lim_navl Vsx_mux_egb_n_lim_vld Vxx_mux_egb_n_lim /end OUT_MEASUREMENT
/end FUNCTION
/begin FUNCTION CmMuxSer_Smovnou "" /begin OUT_MEASUREMENT MaxEngineSpeedRequest MinEngineSpeedRequest /end OUT_MEASUREMENT /end FUNCTION
/begin FUNCTION CmMuxSer_Smptcin "" /begin OUT_MEASUREMENT Vbx_mux_ptc_is_acel_req Vsx_mux_ptc_is_acel_vld /end OUT_MEASUREMENT /end FUNCTION
/begin FUNCTION CmMuxSer_Smspdou "" /begin OUT_MEASUREMENT EngineRPM /end OUT_MEASUREMENT /end FUNCTION
/begin FUNCTION CmMuxSer_Smsptou "" /begin OUT_MEASUREMENT IdleSpeedControlInternalRequest /end OUT_MEASUREMENT /end FUNCTION
/begin FUNCTION CmMuxSer_Tqampou "" /begin OUT_MEASUREMENT AlternatorMaximumPower /end OUT_MEASUREMENT /end FUNCTION
/begin FUNCTION CmMuxSer_Tqapgou "" /begin OUT_MEASUREMENT AllowedPowerGradient /end OUT_MEASUREMENT /end FUNCTION
/begin FUNCTION CmMuxSer_Tqecfou "" /begin OUT_MEASUREMENT ElectricalPowerCutFreeze /end OUT_MEASUREMENT /end FUNCTION
/begin FUNCTION CmMuxSer_Tqestou "" /begin OUT_MEASUREMENT MeanEffectiveTorque /end OUT_MEASUREMENT /end FUNCTION
/begin FUNCTION CmMuxSer_Tqlosou "" /begin OUT_MEASUREMENT FrictionTorque /end OUT_MEASUREMENT /end FUNCTION
/begin FUNCTION CmMuxSer_Tqmaxou "" /begin OUT_MEASUREMENT MaximumInstantTorque /end OUT_MEASUREMENT /end FUNCTION
/begin FUNCTION CmMuxSer_Tqminou "" /begin OUT_MEASUREMENT MinimumInstantTorque /end OUT_MEASUREMENT /end FUNCTION
/begin FUNCTION CmMuxSer_Tqmpaou "" /begin OUT_MEASUREMENT MaxElectricalPowerAllowed /end OUT_MEASUREMENT /end FUNCTION
/begin FUNCTION CmMuxSer_Tqpalin "" /begin OUT_MEASUREMENT Vbx_mux_alt_pow_navl Vsx_mux_alt_pow_vld Vxx_mux_alt_pow /end OUT_MEASUREMENT /end FUNCTION
/begin FUNCTION CmMuxSer_Tqreqou "" /begin OUT_MEASUREMENT ECM_TorqueRequestStatus /end OUT_MEASUREMENT /end FUNCTION
/begin FUNCTION CmMuxSer_Tqprgin "" /begin OUT_MEASUREMENT Vsx_mux_rgb_pump_vld Vxx_mux_rgb_pump /end OUT_MEASUREMENT /end FUNCTION
/begin FUNCTION CmMuxSer_Txfrmxx ""
 /begin OUT_MEASUREMENT ECM_CANHS_RNr_01[0] ECM_CANHS_RNr_01[1] ECM_CANHS_RNr_01[2] ECM_CANHS_RNr_01[3] ECM_CANHS_RNr_01[4] ECM_CANHS_RNr_01[5] ECM_CANHS_RNr_01[6] ECM_CANHS_RNr_01[7] ECM_CANHS_RNr_02[0] ECM_CANHS_RNr_02[1] ECM_CANHS_RNr_02[2] ECM_CANHS_RNr_02[3] ECM_CANHS_RNr_02[4] ECM_CANHS_RNr_02[5] ECM_CANHS_RNr_02[6] ECM_VERLOG[0] ECM_VERLOG[1] ECM_VERLOG[2] ECM_VERLOG[3] ECM_VERLOG[4] ECM_VERLOG[5] ECM_VERLOG[6] FORCE_ECM_CANHS_R_01[0] FORCE_ECM_CANHS_R_01[1] FORCE_ECM_CANHS_R_01[2] FORCE_ECM_CANHS_R_01[3] FORCE_ECM_CANHS_R_01[4] FORCE_ECM_CANHS_R_01[5] FORCE_ECM_CANHS_R_01[6] FORCE_ECM_CANHS_R_01[7] MMI_ECM_CANHS_RNr_01[0] MMI_ECM_CANHS_RNr_01[1] MMI_ECM_CANHS_RNr_01[2] MMI_ECM_CANHS_RNr_01[3] MMI_ECM_CANHS_RNr_01[4] MMI_ECM_CANHS_RNr_01[5] TORQUE_ECM_CANHS_RNr_01[0] TORQUE_ECM_CANHS_RNr_01[1] TORQUE_ECM_CANHS_RNr_01[2] TORQUE_ECM_CANHS_RNr_01[3] TORQUE_ECM_CANHS_RNr_01[4] TORQUE_ECM_CANHS_RNr_01[5] TORQUE_ECM_CANHS_RNr_01[6] TORQUE_ECM_CANHS_RNr_02[0] TORQUE_ECM_CANHS_RNr_02[1] TORQUE_ECM_CANHS_RNr_02[2] TORQUE_ECM_CANHS_RNr_02[3] TORQUE_ECM_CANHS_RNr_02[4] TORQUE_ECM_CANHS_RNr_02[5] TORQUE_ECM_CANHS_R_01[0] TORQUE_ECM_CANHS_R_01[1] TORQUE_ECM_CANHS_R_01[2] TORQUE_ECM_CANHS_R_01[3] TORQUE_ECM_CANHS_R_01[4] /end OUT_MEASUREMENT
/end FUNCTION
/begin FUNCTION CmMuxSer_Txp50ou ""
 /begin OUT_MEASUREMENT ACHighPressureSensor CCSpeedReachedDisplayReq CrankingAuthorization_ECM CruiseControlStatusDisplay CruiseControlStatus_forTM EngineFanSpeedRequest EngineStopRequestOrigine OverspeedIndicationDisplayReq RequestedSpeedDisplayRequest /end OUT_MEASUREMENT
/end FUNCTION
/begin FUNCTION CmMuxSer_Smwixin "" /begin OUT_MEASUREMENT Vbx_mux_el_bk_wind Vbx_mux_el_wind_is_acel /end OUT_MEASUREMENT /end FUNCTION
/begin FUNCTION CmMuxSer_Tqacxin "" /begin OUT_MEASUREMENT Vbx_mux_ac_pow_navl Vsx_mux_ac_pow_vld Vxx_mux_ac_pow /end OUT_MEASUREMENT /end FUNCTION
/begin FUNCTION CmMuxSer_Tqacxou "" /begin OUT_MEASUREMENT ACCompMaximumPower /end OUT_MEASUREMENT /end FUNCTION
/begin FUNCTION CmMuxSer_Vfacxin "" /begin OUT_MEASUREMENT Vbx_mux_ac_clu_req Vsx_mux_ac_clu_req_vld /end OUT_MEASUREMENT /end FUNCTION
/begin FUNCTION CmMuxSer_Vfacxou "" /begin OUT_MEASUREMENT ACCompAuthorized ACCompClutchActivation /end OUT_MEASUREMENT /end FUNCTION
/begin FUNCTION CmMuxSer_Vfadfin "" /begin OUT_MEASUREMENT Vbx_mux_alt_pwm_navl Vsx_mux_alt_pwm_vld Vxx_mux_alt_pwm /end OUT_MEASUREMENT /end FUNCTION
/begin FUNCTION CmMuxSer_Vffltou "" /begin OUT_MEASUREMENT FloatingInhibition /end OUT_MEASUREMENT /end FUNCTION
/begin FUNCTION CmMuxSer_Vfpdain ""
 /begin OUT_MEASUREMENT Vbx_mux_aod_vs_navl Vbx_mux_raw_whl_angl_navl Vsx_mux_aod_vs_vld Vsx_mux_raw_whl_angl_vld Vxx_mux_aod_vs Vxx_mux_raw_whl_angl /end OUT_MEASUREMENT
/end FUNCTION
/begin FUNCTION CmMuxSer_Vfptcin "" /begin OUT_MEASUREMENT Vbx_mux_ptc_pow_navl Vsx_mux_ptc_pow_vld Vxx_mux_ptc_pow /end OUT_MEASUREMENT /end FUNCTION
/begin FUNCTION CmMuxSer_Vfrwsin ""
 /begin OUT_MEASUREMENT Vbx_mux_lft_rwhs_navl Vbx_mux_rgt_rwhs_navl Vsx_mux_lft_rwhs_vld Vsx_mux_rgt_rwhs_vld Vxx_mux_lft_rwhs Vxx_mux_rgt_rwhs /end OUT_MEASUREMENT
/end FUNCTION
/begin FUNCTION CmMuxSer_Vftacin ""
 /begin OUT_MEASUREMENT Vbx_mux_tra_acel_in_navl Vsx_mux_tra_acel_vld Vxx_mux_tra_acel /end OUT_MEASUREMENT
/end FUNCTION
/begin FUNCTION CmMuxSer_Pctbnin ""
 /begin OUT_MEASUREMENT Vbx_mux_prim_sha_spd_navl Vsx_mux_prim_sha_spd_vld Vxx_mux_prim_sha_spd /end OUT_MEASUREMENT
/end FUNCTION
/begin FUNCTION SmCajCtl "" /begin SUB_FUNCTION SmCajCtl_Ajcorxx_xxxxxx /end SUB_FUNCTION /end FUNCTION
/begin FUNCTION SmCajCtl_Ajcorxx_xxxxxx ""
 /begin DEF_CHARACTERISTIC Ctb_ajs_cor_driv_tq_fac Ctb_ajs_cor_n Ctb_ajs_cor_tco Ctb_ajs_dt_tq_rat Cmp_ajs_cor_fast_cor_dly Cmp_ajs_cor_t1_acel_dt_clos Cmp_ajs_cor_t1_decl_dt_clos Cmp_ajs_cor_t1_fast_cor Cmp_ajs_cor_td_acel_dt_clos Cmp_ajs_cor_td_decl_dt_clos Cmp_ajs_cor_td_fast_cor Cmp_ajs_cor_td_tq_fac Ctp_ajs_cor_dz_tqe Ctp_ajs_cor_fast_cor_dly_fac Ctp_ajs_cor_max_cor_dyn_tqe Ctp_ajs_cor_t1_fast_cor_fac Ctp_ajs_cor_td_fast_cor_fac Cbx_ajs_cor_driv_cut_cfm Cbx_ajs_cor_dz_cfm Cbx_ajs_cor_stt_cfm Cxx_ajs_cor_dz_dly Cxx_ajs_cor_max_cor_dyn_dt_open Cxx_ajs_cor_min_cor_dyn_dt_clos Cxx_ajs_cor_min_cor_dyn_dt_open Cxx_ajs_cor_t1_acel_dt_modu Cxx_ajs_cor_t1_acel_dt_open Cxx_ajs_cor_t1_decl_dt_modu Cxx_ajs_cor_t1_decl_dt_open Cxx_ajs_cor_t1_dt_ini Cxx_ajs_cor_td_acel_dt_modu Cxx_ajs_cor_td_acel_dt_open Cxx_ajs_cor_td_decl_dt_modu Cxx_ajs_cor_td_decl_dt_open Cxx_ajs_cor_td_dt_ini Cxx_ajs_cor_tkof_vs_thd /end DEF_CHARACTERISTIC
 /begin OUT_MEASUREMENT Vbx_ajs_cor_fast_cor_off Vbx_ajs_cor_fast_cor_on Vbx_ajs_cor_stt_cut Vsx_ajs_cor_stt_para Vxx_ajs_cor_dyn_tqe Vxx_ajs_cor_dz_tqe Vxx_ajs_cor_fast_cor_dly Vxx_ajs_cor_lim_dyn_tqe Vxx_ajs_cor_lim_dz_dyn_tqe Vxx_ajs_cor_max_cor_dyn Vxx_ajs_cor_min_cor_dyn Vxx_ajs_cor_t1 Vxx_ajs_cor_t1_acel Vxx_ajs_cor_t1_decl Vxx_ajs_cor_t1_fast_cor Vxx_ajs_cor_td Vxx_ajs_cor_td_acel Vxx_ajs_cor_td_decl Vxx_ajs_cor_td_fast_cor Vxx_ajs_cor_td_tq_fac Vxx_ajs_cor_tqe Vxx_ajs_cor_tqe_tmp /end OUT_MEASUREMENT
/end FUNCTION
/begin FUNCTION BiPciCci "" /begin DEF_CHARACTERISTIC c_ctr_fil_asw lc_linp_conv_cru_swi lc_linp_conv_vvsl_swi /end DEF_CHARACTERISTIC
 /begin OUT_MEASUREMENT Vbx_cru_on_off_in Vbx_eprm_rdy Vbx_sl_on_off_in Vxx_cru_sl_whl_cmd_in lv_cru_swi_on_off lv_pin_cru_swi_on_off lv_pin_vvsl_swi_on_off lv_vvsl_swi_on_off v_cru /end OUT_MEASUREMENT
/end FUNCTION
/begin FUNCTION DgDgtSer "" /begin SUB_FUNCTION DgDgtSer_docserx_xxxxxx DgDgtSer_obdserx_xxxxxx /end SUB_FUNCTION /end FUNCTION
/begin FUNCTION DgDgtSer_docserx_xxxxxx ""
 /begin DEF_CHARACTERISTIC Cbx_fail_dft_ini_req Ctx_vin_crc_ini_data[0] Ctx_vin_crc_ini_data[1] Ctx_vin_crc_ini_data[2] Ctx_vin_crc_ini_data[3] Ctx_vin_crc_ini_data[4] Ctx_vin_crc_ini_data[5] Ctx_vin_crc_ini_data[6] Ctx_vin_crc_ini_data[7] Ctx_vin_crc_ini_data[8] Ctx_vin_crc_ini_data[9] Ctx_vin_crc_ini_data[10] Ctx_vin_crc_ini_data[11] Ctx_vin_crc_ini_data[12] Ctx_vin_crc_ini_data[13] Ctx_vin_crc_ini_data[14] Ctx_vin_crc_ini_data[15] Ctx_vin_crc_ini_data[16] Ctx_vin_crc_ini_data[17] Ctx_vin_crc_ini_data[18] Cxx_c_nr1 Cxx_c_nr2 Cxx_cert_id Cxx_diag_nr Cxx_ecu_nr1 Cxx_ecu_nr2 Cxx_ecu_nr3 Cxx_ecu_nr4 Cxx_ecu_nr5 Cxx_etun_nr Cxx_oem_id Cxx_prog_nr1 Cxx_prog_nr2 Cxx_rsa_did_lim_val_cfm Cxx_supl_nr1 Cxx_supl_nr2 Cxx_supl_nr3 Cxx_sys_c_nr Cxx_vers_nr1 Cxx_vers_nr2 /end DEF_CHARACTERISTIC
 /begin OUT_MEASUREMENT Vtx_vin_crc_data[0] Vtx_vin_crc_data[1] Vtx_vin_crc_data[2] Vtx_vin_crc_data[3] Vtx_vin_crc_data[4] Vtx_vin_crc_data[5] Vtx_vin_crc_data[6] Vtx_vin_crc_data[7] Vtx_vin_crc_data[8] Vtx_vin_crc_data[9] Vtx_vin_crc_data[10] Vtx_vin_crc_data[11] Vtx_vin_crc_data[12] Vtx_vin_crc_data[13] Vtx_vin_crc_data[14] Vtx_vin_crc_data[15] Vtx_vin_crc_data[16] Vtx_vin_crc_data[17] Vtx_vin_crc_data[18] Vsx_diag_sess /end OUT_MEASUREMENT
/end FUNCTION
/begin FUNCTION DgDgtSer_obdserx_xxxxxx "" /begin DEF_CHARACTERISTIC Cbx_obd_fail_dft_ini_req /end DEF_CHARACTERISTIC /end FUNCTION
/begin FUNCTION PcCruSpt ""
 /begin OUT_MEASUREMENT Vxx_fsl_km_NVM Vxx_max_vs_NVM Vxx_cru_fail_NVM Vxx_cru_sl_fail_NVM Vxx_cru_sl_dacn_sys_NVM Vbx_sli_buf_sf_NVM Sxx_sli_brk_buf_NVM Sxx_sli_clu_buf_NVM Sxx_sli_cru_stt_buf_NVM Sxx_sli_vs_buf[0] Sxx_sli_vs_buf[1] Sxx_sli_vs_buf[2] Sxx_sli_vs_buf[3] Sxx_sli_vs_buf[4] Sxx_sli_vs_buf[5] Sxx_sli_vs_buf[6] Sxx_sli_vs_buf[7] Sxx_sli_vs_buf[8] Sxx_sli_vs_buf[9] Sxx_sli_vs_buf[10] Sxx_sli_vs_buf[11] Sxx_sli_vs_buf[12] Sxx_sli_vs_buf[13] Sxx_sli_vs_buf[14] Sxx_sli_vs_buf[15] Vxx_crsh_dly_ctr_NVM Vxx_cru_dgn_diag_NVM Vbx_crsh_end_rec_eprm_NVM Sxx_cru_dist_buf[0] Sxx_cru_dist_buf[1] Sxx_cru_dist_buf[2] Sxx_cru_dist_buf[3] Sxx_cru_dist_buf[4] Sxx_cru_dist_buf[5] Sxx_cru_dist_buf[6] Sxx_cru_dist_buf[7] Sxx_cru_dist_buf[8] Sxx_cru_dist_buf[9] Sxx_cru_dist_buf[10] Sxx_cru_dist_buf[11] Sxx_cru_dist_buf[12] Sxx_cru_dist_buf[13] Sxx_cru_dist_buf[14] Sxx_cru_dist_buf[15] Sxx_cru_dist_buf[16] Sxx_cru_dist_buf[17] Sxx_cru_dist_buf[18] Sxx_cru_dist_buf[19] Sxx_cru_dsb_buf[0] Sxx_cru_dsb_buf[1] Sxx_cru_dsb_buf[2] Sxx_cru_dsb_buf[3] Sxx_cru_dsb_buf[4] Sxx_cru_dsb_buf[5] Sxx_cru_dsb_buf[6] Sxx_cru_dsb_buf[7] Sxx_cru_dsb_buf[8] Sxx_cru_dsb_buf[9] Sxx_cru_dsb_buf[10] Sxx_cru_dsb_buf[11] Sxx_cru_dsb_buf[12] Sxx_cru_dsb_buf[13] Sxx_cru_dsb_buf[14] Sxx_cru_dsb_buf[15] Sxx_cru_dsb_buf[16] Sxx_cru_dsb_buf[17] Sxx_cru_dsb_buf[18] Sxx_cru_dsb_buf[19] /end OUT_MEASUREMENT
 /begin SUB_FUNCTION PcCruSpt_Dacaxxx PcCruSpt_Dgaddon PcCruSpt_Dsbccxx PcCruSpt_Schxxxx PcCruSpt_Setptxx PcCruSpt_Stflwxx PcCruSpt_Vsintxx PcCruSpt_Fslinxx /end SUB_FUNCTION
/end FUNCTION
/begin FUNCTION PcCruSpt_Dacaxxx ""
 /begin DEF_CHARACTERISTIC Cxx_brk_det_dly Cxx_brk_min_decl_thd Cxx_cru_brk_fail_dly Cxx_cru_brk_nok_dly Cxx_cru_clu_navl_dly Cxx_cru_clu_nok_dly Cxx_dfdec_cru_sl_tot Cxx_dfinc_cru_sl_tot Cxx_lih_dly Cxx_sp_vs_dif_brk_det Cxx_sudn_brk_det_dly Cxx_sudn_brk_min_decl_thd /end DEF_CHARACTERISTIC
 /begin OUT_MEASUREMENT Vbx_brk_pdl_vld_fail Vbx_brk_pdl_vld_nok Vbx_cru_brk_det Vbx_cru_brk_det_sudn Vbx_cru_clu_abst_fil Vbx_cru_clu_navl_fil Vbx_diag_ena_cru Vbx_diag_ena_cru_sl Vbx_diag_ena_cru_sl_dtc Vbx_gear_vld_nok_fail Vsx_cru_vld Vsx_sl_vld /end OUT_MEASUREMENT
/end FUNCTION
/begin FUNCTION PcCruSpt_Dgaddon ""
 /begin DEF_CHARACTERISTIC Cbx_cru_diag_add_on Cxx_cru_dgn_eprm_imd_writ_thr Cxx_togl_dly Cxx_togl_thr /end DEF_CHARACTERISTIC
 /begin OUT_MEASUREMENT Vbx_crsh_det Vbx_cru_dgn_eprm_writ_off Vbx_cru_dgn_eprm_writ_on Vbx_cru_diag_ena Vbx_cru_sl_dacn_bit0 Vbx_cru_sl_dacn_bit1 Vbx_ram_full Vbx_ram_full_prev Vbx_set_id_bit6 Vbx_set_id_bit7 Vxx_act_deact_id_buf_2 Vxx_cru_act_deact_id Vxx_cru_act_deact_id_to_saved Vxx_cru_dist_buf[0] Vxx_cru_dist_buf[1] Vxx_cru_dist_buf[2] Vxx_cru_dist_buf[3] Vxx_cru_dist_buf[4] Vxx_cru_dist_buf[5] Vxx_cru_dist_buf[6] Vxx_cru_dist_buf[7] Vxx_cru_dist_buf[8] Vxx_cru_dist_buf[9] Vxx_cru_dist_buf[10] Vxx_cru_dist_buf[11] Vxx_cru_dist_buf[12] Vxx_cru_dist_buf[13] Vxx_cru_dist_buf[14] Vxx_cru_dist_buf[15] Vxx_cru_dist_buf[16] Vxx_cru_dist_buf[17] Vxx_cru_dist_buf[18] Vxx_cru_dist_buf[19] Vxx_cru_dsb_buf[0] Vxx_cru_dsb_buf[1] Vxx_cru_dsb_buf[2] Vxx_cru_dsb_buf[3] Vxx_cru_dsb_buf[4] Vxx_cru_dsb_buf[5] Vxx_cru_dsb_buf[6] Vxx_cru_dsb_buf[7] Vxx_cru_dsb_buf[8] Vxx_cru_dsb_buf[9] Vxx_cru_dsb_buf[10] Vxx_cru_dsb_buf[11] Vxx_cru_dsb_buf[12] Vxx_cru_dsb_buf[13] Vxx_cru_dsb_buf[14] Vxx_cru_dsb_buf[15] Vxx_cru_dsb_buf[16] Vxx_cru_dsb_buf[17] Vxx_cru_dsb_buf[18] Vxx_cru_dsb_buf[19] Vxx_sli_brk_buf Vxx_sli_clu_buf Vxx_sli_cru_stt_buf Vxx_sli_vs_buf[0] Vxx_sli_vs_buf[1] Vxx_sli_vs_buf[2] Vxx_sli_vs_buf[3] Vxx_sli_vs_buf[4] Vxx_sli_vs_buf[5] Vxx_sli_vs_buf[6] Vxx_sli_vs_buf[7] Vxx_sli_vs_buf[8] Vxx_sli_vs_buf[9] Vxx_sli_vs_buf[10] Vxx_sli_vs_buf[11] Vxx_sli_vs_buf[12] Vxx_sli_vs_buf[13] Vxx_sli_vs_buf[14] Vxx_sli_vs_buf[15] Vxx_togl_ctr Vxx_togl_tmr Vxx_vh_dist_buf_2 /end OUT_MEASUREMENT
/end FUNCTION
/begin FUNCTION PcCruSpt_Dsbccxx ""
 /begin DEF_CHARACTERISTIC Cbx_cru_eng_dsb_wal_1_req_cfm Cbx_cru_sl_eng_dsb_vld_cfm Cbx_sl_eng_dsb_wal_1_req_cfm /end DEF_CHARACTERISTIC
 /begin OUT_MEASUREMENT Vbx_cru_eng_dsb Vbx_cru_eng_dsb_sys Vbx_sl_eng_dsb Vbx_sl_eng_dsb_sys /end OUT_MEASUREMENT
/end FUNCTION
/begin FUNCTION PcCruSpt_Schxxxx "" /begin DEF_CHARACTERISTIC Cbx_fsl_cfm /end DEF_CHARACTERISTIC /begin OUT_MEASUREMENT Vbx_fsl_cfm /end OUT_MEASUREMENT /end FUNCTION
/begin FUNCTION PcCruSpt_Setptxx ""
 /begin DEF_CHARACTERISTIC Cbx_ena_reg_decl_resu_on Cxx_cru_ovs_warn_thd Cxx_cru_ovs_warn_thd_mph Cxx_cru_sl_long_sp_dec_t Cxx_cru_sl_long_sp_inc_t Cxx_cru_sl_sp_inc_t Cxx_cru_sl_warn_dly Cxx_sl_ovs_warn_thd Cxx_sl_ovs_warn_thd_mph /end DEF_CHARACTERISTIC
 /begin OUT_MEASUREMENT Vbx_cru_sl_warn Vbx_cru_sl_warn_prev Vbx_cru_sl_warn_raw Vbx_vs_clos_spt_lamp Vxx_cru_sl_driv_vs_sp Vxx_cru_sl_driv_vs_sp_kmh Vxx_cru_sl_sp_inc_dec_dly_cnt Vxx_cru_sl_stt_ip_nom Vxx_cru_sl_vs_sp_nom /end OUT_MEASUREMENT
/end FUNCTION
/begin FUNCTION PcCruSpt_Stflwxx ""
 /begin OUT_MEASUREMENT Vbx_cru_cmf_cut Vbx_sta_swi_act Vsx_cru_stt Vsx_sl_stt Vxx_cru_sl_dacn Vxx_cru_sl_dacn_prev Vxx_cru_sl_dacn_sys_prev Vxx_cru_sl_stt_nom /end OUT_MEASUREMENT
/end FUNCTION
/begin FUNCTION PcCruSpt_Vsintxx ""
 /begin DEF_CHARACTERISTIC Cbx_cru_sl_vs_cmp_prmt Cbx_fsl_ena_cfm Cxx_cru_abst_dspl_vs_dly Cxx_cru_abst_vs_dly Cxx_cru_long_step Cxx_cru_long_step_mph Cxx_cru_nok_vs_dly Cxx_cru_sl_fil_acel_fac Cxx_cru_sl_fil_vs_fac Cxx_cru_sl_max_vs Cxx_cru_sl_max_vs_mph Cxx_cru_sl_min_vs Cxx_cru_sl_min_vs_mph Cxx_cru_sl_no_efv_vs_thd Cxx_cru_sl_no_efv_vs_thd_mph Cxx_cru_sl_smal_step Cxx_cru_sl_smal_step_mph Cxx_cru_vs_secu_min Cxx_cru_vs_sp_rat Cxx_dfdec_cru_vs_cmp Cxx_dfinc_cru_vs_cmp Cxx_dspl_vs_secu_fac Cxx_dspl_vs_secu_ofs Cxx_dspl_vs_secu_thd Cxx_sl_long_step Cxx_sl_long_step_mph Cxx_vs_clos_spt_lamp_off_thd Cxx_vs_clos_spt_lamp_off_thd_mph Cxx_vs_clos_spt_lamp_on_thd Cxx_vs_clos_spt_lamp_on_thd_mph /end DEF_CHARACTERISTIC
 /begin OUT_MEASUREMENT Vbx_cru_sl_kmh_mph_cge Vbx_cru_sl_oor_vs Vbx_cru_smal_vs_sp_rat Vbx_df_cru_vs_cmp Vbx_dspl_vs_abst_fil Vbx_dspl_vs_navl_fil Vbx_vs_abst_fil Vbx_vs_navl_fil Vbx_vs_nok Vxx_cru_sl_acel Vxx_cru_sl_long_step Vxx_cru_sl_max_vs Vxx_cru_sl_min_vs Vxx_cru_sl_no_efv_vs_thd Vxx_cru_sl_raw_vs Vxx_cru_sl_smal_step Vxx_cru_sl_vs Vxx_cru_sl_vs_kmh Vxx_vs_clos_spt_lamp_off_thd Vxx_vs_clos_spt_lamp_on_thd /end OUT_MEASUREMENT
/end FUNCTION
/begin FUNCTION PcCruSpt_Fslinxx "" /begin OUT_MEASUREMENT Vxx_fsl_max_vs_sp_kmh /end OUT_MEASUREMENT /end FUNCTION
/begin FUNCTION InPciCci ""
 /begin OUT_MEASUREMENT Vbx_whl_lk_stt_NVM Vxx_cru_sl_resu_blk_dly_max_NVM Vxx_cru_sl_acel_blk_dly_max_NVM Vxx_cru_sl_decl_blk_dly_max_NVM Vxx_cru_sl_susp_blk_dly_max Vxx_cru_sl_cmd_blk_ctr_max_NVM Vbx_cru_swi_lk_stt_NVM Vbx_cru_lk_stt_NVM Vbx_sl_swi_lk_stt_NVM Vbx_sl_lk_stt_NVM /end OUT_MEASUREMENT
 /begin SUB_FUNCTION InPciCci_Swtchsr /end SUB_FUNCTION
/end FUNCTION
/end MODULE
/end PROJECT
