ASAP2_VERSION 1 41
/begin PROJECT RD8 "_default_ProjectLongIdentifier"
/begin HEADER "_default_HeaderComment" PROJECT_NO RD9 /end HEADER
/begin MODULE _default_ModuleName "_default_ModuleLongIdentifier"
/begin MOD_COMMON "_default_ModCommonComment" DEPOSIT ABSOLUTE BYTE_ORDER MSB_LAST ALIGNMENT_BYTE 1 ALIGNMENT_WORD 2 ALIGNMENT_LONG 2 ALIGNMENT_FLOAT32_IEEE 2 ALIGNMENT_FLOAT64_IEEE 4 /end MOD_COMMON
/begin CHARACTERISTIC Ctx_ffm_did_ac_prs[0] "" VALUE 0xa002ebf0 _REC_S1VAL_20_u2 65535. _CNV_A_R_A_165_CM 0. 65535. DISPLAY_IDENTIFIER Pxx_dgdftmng_dtc_ac_prs.Ctx_ffm_did_xxx[0] /end CHARACTERISTIC
/begin CHARACTERISTIC Ctx_ffm_did_ac_prs[1] "" VALUE 0xa002ebf2 _REC_S1VAL_20_u2 65535. _CNV_A_R_A_165_CM 0. 65535. DISPLAY_IDENTIFIER Pxx_dgdftmng_dtc_ac_prs.Ctx_ffm_did_xxx[1] /end CHARACTERISTIC
/begin CHARACTERISTIC Ctx_ffm_did_ac_prs[2] "" VALUE 0xa002ebf4 _REC_S1VAL_20_u2 65535. _CNV_A_R_A_165_CM 0. 65535. DISPLAY_IDENTIFIER Pxx_dgdftmng_dtc_ac_prs.Ctx_ffm_did_xxx[2] /end CHARACTERISTIC
/begin CHARACTERISTIC Ctx_ffm_did_ac_prs[3] "" VALUE 0xa002ebf6 _REC_S1VAL_20_u2 65535. _CNV_A_R_A_165_CM 0. 65535. DISPLAY_IDENTIFIER Pxx_dgdftmng_dtc_ac_prs.Ctx_ffm_did_xxx[3] /end CHARACTERISTIC
/begin CHARACTERISTIC Ctx_ffm_did_ac_prs[4] "" VALUE 0xa002ebf8 _REC_S1VAL_20_u2 65535. _CNV_A_R_A_165_CM 0. 65535. DISPLAY_IDENTIFIER Pxx_dgdftmng_dtc_ac_prs.Ctx_ffm_did_xxx[4] /end CHARACTERISTIC
/begin CHARACTERISTIC Cxx_dtc_hmb_ac_prs "" VALUE 0xa002ebfa _REC_S1VAL_20_u2 65535. _CNV_A_R_A_165_CM 0. 65535. DISPLAY_IDENTIFIER Pxx_dgdftmng_dtc_ac_prs.Cxx_dtc_hmb_xxx /end CHARACTERISTIC
/begin CHARACTERISTIC Ctx_ffm_did_acel_pdl[0] "" VALUE 0xa002ebfc _REC_S1VAL_20_u2 65535. _CNV_A_R_A_165_CM 0. 65535. DISPLAY_IDENTIFIER Pxx_dgdftmng_dtc_acel_pdl.Ctx_ffm_did_xxx[0] /end CHARACTERISTIC
/begin CHARACTERISTIC Ctx_ffm_did_acel_pdl[1] "" VALUE 0xa002ebfe _REC_S1VAL_20_u2 65535. _CNV_A_R_A_165_CM 0. 65535. DISPLAY_IDENTIFIER Pxx_dgdftmng_dtc_acel_pdl.Ctx_ffm_did_xxx[1] /end CHARACTERISTIC
/begin CHARACTERISTIC Ctx_ffm_did_acel_pdl[2] "" VALUE 0xa002ec00 _REC_S1VAL_20_u2 65535. _CNV_A_R_A_165_CM 0. 65535. DISPLAY_IDENTIFIER Pxx_dgdftmng_dtc_acel_pdl.Ctx_ffm_did_xxx[2] /end CHARACTERISTIC
/begin CHARACTERISTIC Ctx_ffm_did_acel_pdl[3] "" VALUE 0xa002ec02 _REC_S1VAL_20_u2 65535. _CNV_A_R_A_165_CM 0. 65535. DISPLAY_IDENTIFIER Pxx_dgdftmng_dtc_acel_pdl.Ctx_ffm_did_xxx[3] /end CHARACTERISTIC
/begin CHARACTERISTIC Ctx_ffm_did_acel_pdl[4] "" VALUE 0xa002ec04 _REC_S1VAL_20_u2 65535. _CNV_A_R_A_165_CM 0. 65535. DISPLAY_IDENTIFIER Pxx_dgdftmng_dtc_acel_pdl.Ctx_ffm_did_xxx[4] /end CHARACTERISTIC
/begin CHARACTERISTIC Cxx_dtc_hmb_acel_pdl "" VALUE 0xa002ec06 _REC_S1VAL_20_u2 65535. _CNV_A_R_A_165_CM 0. 65535. DISPLAY_IDENTIFIER Pxx_dgdftmng_dtc_acel_pdl.Cxx_dtc_hmb_xxx /end CHARACTERISTIC
/begin CHARACTERISTIC Ctx_ffm_did_acel_pdl_v1[0] "" VALUE 0xa002ec08 _REC_S1VAL_20_u2 65535. _CNV_A_R_A_165_CM 0. 65535. DISPLAY_IDENTIFIER Pxx_dgdftmng_dtc_acel_pdl_v1.Ctx_ffm_did_xxx[0] /end CHARACTERISTIC
/begin CHARACTERISTIC Ctx_ffm_did_acel_pdl_v1[1] "" VALUE 0xa002ec0a _REC_S1VAL_20_u2 65535. _CNV_A_R_A_165_CM 0. 65535. DISPLAY_IDENTIFIER Pxx_dgdftmng_dtc_acel_pdl_v1.Ctx_ffm_did_xxx[1] /end CHARACTERISTIC
/begin CHARACTERISTIC Ctx_ffm_did_acel_pdl_v1[2] "" VALUE 0xa002ec0c _REC_S1VAL_20_u2 65535. _CNV_A_R_A_165_CM 0. 65535. DISPLAY_IDENTIFIER Pxx_dgdftmng_dtc_acel_pdl_v1.Ctx_ffm_did_xxx[2] /end CHARACTERISTIC
/begin CHARACTERISTIC Ctx_ffm_did_acel_pdl_v1[3] "" VALUE 0xa002ec0e _REC_S1VAL_20_u2 65535. _CNV_A_R_A_165_CM 0. 65535. DISPLAY_IDENTIFIER Pxx_dgdftmng_dtc_acel_pdl_v1.Ctx_ffm_did_xxx[3] /end CHARACTERISTIC
/begin CHARACTERISTIC Ctx_ffm_did_acel_pdl_v1[4] "" VALUE 0xa002ec10 _REC_S1VAL_20_u2 65535. _CNV_A_R_A_165_CM 0. 65535. DISPLAY_IDENTIFIER Pxx_dgdftmng_dtc_acel_pdl_v1.Ctx_ffm_did_xxx[4] /end CHARACTERISTIC
/begin CHARACTERISTIC Cxx_dtc_hmb_acel_pdl_v1 "" VALUE 0xa002ec12 _REC_S1VAL_20_u2 65535. _CNV_A_R_A_165_CM 0. 65535. DISPLAY_IDENTIFIER Pxx_dgdftmng_dtc_acel_pdl_v1.Cxx_dtc_hmb_xxx /end CHARACTERISTIC
/begin CHARACTERISTIC Ctx_ffm_did_acel_pdl_v2[0] "" VALUE 0xa002ec14 _REC_S1VAL_20_u2 65535. _CNV_A_R_A_165_CM 0. 65535. DISPLAY_IDENTIFIER Pxx_dgdftmng_dtc_acel_pdl_v2.Ctx_ffm_did_xxx[0] /end CHARACTERISTIC
/begin CHARACTERISTIC Ctx_ffm_did_acel_pdl_v2[1] "" VALUE 0xa002ec16 _REC_S1VAL_20_u2 65535. _CNV_A_R_A_165_CM 0. 65535. DISPLAY_IDENTIFIER Pxx_dgdftmng_dtc_acel_pdl_v2.Ctx_ffm_did_xxx[1] /end CHARACTERISTIC
/begin CHARACTERISTIC Ctx_ffm_did_acel_pdl_v2[2] "" VALUE 0xa002ec18 _REC_S1VAL_20_u2 65535. _CNV_A_R_A_165_CM 0. 65535. DISPLAY_IDENTIFIER Pxx_dgdftmng_dtc_acel_pdl_v2.Ctx_ffm_did_xxx[2] /end CHARACTERISTIC
/begin CHARACTERISTIC Ctx_ffm_did_acel_pdl_v2[3] "" VALUE 0xa002ec1a _REC_S1VAL_20_u2 65535. _CNV_A_R_A_165_CM 0. 65535. DISPLAY_IDENTIFIER Pxx_dgdftmng_dtc_acel_pdl_v2.Ctx_ffm_did_xxx[3] /end CHARACTERISTIC
/begin CHARACTERISTIC Ctx_ffm_did_acel_pdl_v2[4] "" VALUE 0xa002ec1c _REC_S1VAL_20_u2 65535. _CNV_A_R_A_165_CM 0. 65535. DISPLAY_IDENTIFIER Pxx_dgdftmng_dtc_acel_pdl_v2.Ctx_ffm_did_xxx[4] /end CHARACTERISTIC
/begin CHARACTERISTIC Cxx_dtc_hmb_acel_pdl_v2 "" VALUE 0xa002ec1e _REC_S1VAL_20_u2 65535. _CNV_A_R_A_165_CM 0. 65535. DISPLAY_IDENTIFIER Pxx_dgdftmng_dtc_acel_pdl_v2.Cxx_dtc_hmb_xxx /end CHARACTERISTIC
/begin CHARACTERISTIC Ctx_ffm_did_actr_rly[0] "" VALUE 0xa002ec20 _REC_S1VAL_20_u2 65535. _CNV_A_R_A_165_CM 0. 65535. DISPLAY_IDENTIFIER Pxx_dgdftmng_dtc_actr_rly.Ctx_ffm_did_xxx[0] /end CHARACTERISTIC
/begin CHARACTERISTIC Ctx_ffm_did_actr_rly[1] "" VALUE 0xa002ec22 _REC_S1VAL_20_u2 65535. _CNV_A_R_A_165_CM 0. 65535. DISPLAY_IDENTIFIER Pxx_dgdftmng_dtc_actr_rly.Ctx_ffm_did_xxx[1] /end CHARACTERISTIC
/begin CHARACTERISTIC Ctx_ffm_did_actr_rly[2] "" VALUE 0xa002ec24 _REC_S1VAL_20_u2 65535. _CNV_A_R_A_165_CM 0. 65535. DISPLAY_IDENTIFIER Pxx_dgdftmng_dtc_actr_rly.Ctx_ffm_did_xxx[2] /end CHARACTERISTIC
/begin CHARACTERISTIC Ctx_ffm_did_actr_rly[3] "" VALUE 0xa002ec26 _REC_S1VAL_20_u2 65535. _CNV_A_R_A_165_CM 0. 65535. DISPLAY_IDENTIFIER Pxx_dgdftmng_dtc_actr_rly.Ctx_ffm_did_xxx[3] /end CHARACTERISTIC
/begin CHARACTERISTIC Ctx_ffm_did_actr_rly[4] "" VALUE 0xa002ec28 _REC_S1VAL_20_u2 65535. _CNV_A_R_A_165_CM 0. 65535. DISPLAY_IDENTIFIER Pxx_dgdftmng_dtc_actr_rly.Ctx_ffm_did_xxx[4] /end CHARACTERISTIC
/begin CHARACTERISTIC Cxx_dtc_hmb_actr_rly "" VALUE 0xa002ec2a _REC_S1VAL_20_u2 65535. _CNV_A_R_A_165_CM 0. 65535. DISPLAY_IDENTIFIER Pxx_dgdftmng_dtc_actr_rly.Cxx_dtc_hmb_xxx /end CHARACTERISTIC
/begin CHARACTERISTIC Ctx_ffm_did_agb[0] "" VALUE 0xa002ec38 _REC_S1VAL_20_u2 65535. _CNV_A_R_A_165_CM 0. 65535. DISPLAY_IDENTIFIER Pxx_dgdftmng_dtc_agb.Ctx_ffm_did_xxx[0] /end CHARACTERISTIC
/begin CHARACTERISTIC Ctx_ffm_did_agb[1] "" VALUE 0xa002ec3a _REC_S1VAL_20_u2 65535. _CNV_A_R_A_165_CM 0. 65535. DISPLAY_IDENTIFIER Pxx_dgdftmng_dtc_agb.Ctx_ffm_did_xxx[1] /end CHARACTERISTIC
/begin CHARACTERISTIC Ctx_ffm_did_agb[2] "" VALUE 0xa002ec3c _REC_S1VAL_20_u2 65535. _CNV_A_R_A_165_CM 0. 65535. DISPLAY_IDENTIFIER Pxx_dgdftmng_dtc_agb.Ctx_ffm_did_xxx[2] /end CHARACTERISTIC
/begin CHARACTERISTIC Ctx_ffm_did_agb[3] "" VALUE 0xa002ec3e _REC_S1VAL_20_u2 65535. _CNV_A_R_A_165_CM 0. 65535. DISPLAY_IDENTIFIER Pxx_dgdftmng_dtc_agb.Ctx_ffm_did_xxx[3] /end CHARACTERISTIC
/begin MEASUREMENT Vbx_dfctr_sat_inj1_scw "" UBYTE _CNV_A_R_A_165_CM 1 0. 0. 255. DISPLAY_IDENTIFIER fm_sta_inj1_scw.fm_static_bitfield.Vbx_dfctr_sat_xxx ECU_ADDRESS 0xc00000ce BIT_MASK 0x8 /end MEASUREMENT
/begin MEASUREMENT Vbx_rdn_inj1_scw "" UBYTE _CNV_A_R_A_165_CM 1 0. 0. 255. DISPLAY_IDENTIFIER fm_sta_inj1_scw.fm_static_bitfield.Vbx_rdn_xxx ECU_ADDRESS 0xc00000ce BIT_MASK 0x40 /end MEASUREMENT
/begin MEASUREMENT Vxx_dtc_stt_inj1_scw "" UBYTE _CNV_A_R_A_165_CM 1 0. 0. 255. DISPLAY_IDENTIFIER fm_sta_inj1_scw.Vxx_dtc_stt_xxx ECU_ADDRESS 0xc00000cf /end MEASUREMENT
/begin MEASUREMENT Vxx_dfctr_inj2_oc "" UWORD _CNV_A_R_A_165_CM 1 0. 0. 65535. DISPLAY_IDENTIFIER fm_sta_inj2_oc.Vxx_dfctr_xxx ECU_ADDRESS 0xc00000d0 /end MEASUREMENT
/begin MEASUREMENT Vxx_rdn_inj2_oc "" UWORD _CNV_A_R_A_165_CM 1 0. 0. 65535. DISPLAY_IDENTIFIER fm_sta_inj2_oc.Vxx_rdn_xxx ECU_ADDRESS 0xc00000d2 /end MEASUREMENT
/begin MEASUREMENT Vbx_cf_inj2_oc "" UBYTE _CNV_A_R_A_165_CM 1 0. 0. 255. DISPLAY_IDENTIFIER fm_sta_inj2_oc.fm_static_bitfield.Vbx_cf_xxx ECU_ADDRESS 0xc00000d4 BIT_MASK 0x1 /end MEASUREMENT
/begin MEASUREMENT Vbx_clf_inj2_oc "" UBYTE _CNV_A_R_A_165_CM 1 0. 0. 255. DISPLAY_IDENTIFIER fm_sta_inj2_oc.fm_static_bitfield.Vbx_clf_xxx ECU_ADDRESS 0xc00000d4 BIT_MASK 0x2 /end MEASUREMENT
/begin MEASUREMENT Vbx_df_old_inj2_oc "" UBYTE _CNV_A_R_A_165_CM 1 0. 0. 255. DISPLAY_IDENTIFIER fm_sta_inj2_oc.fm_static_bitfield.Vbx_df_old_xxx ECU_ADDRESS 0xc00000d4 BIT_MASK 0x4 /end MEASUREMENT
/begin MEASUREMENT Vbx_dfctr_sat_inj2_oc "" UBYTE _CNV_A_R_A_165_CM 1 0. 0. 255. DISPLAY_IDENTIFIER fm_sta_inj2_oc.fm_static_bitfield.Vbx_dfctr_sat_xxx ECU_ADDRESS 0xc00000d4 BIT_MASK 0x8 /end MEASUREMENT
/begin MEASUREMENT Vbx_rdn_inj2_oc "" UBYTE _CNV_A_R_A_165_CM 1 0. 0. 255. DISPLAY_IDENTIFIER fm_sta_inj2_oc.fm_static_bitfield.Vbx_rdn_xxx ECU_ADDRESS 0xc00000d4 BIT_MASK 0x40 /end MEASUREMENT
/begin MEASUREMENT Vxx_dtc_stt_inj2_oc "" UBYTE _CNV_A_R_A_165_CM 1 0. 0. 255. DISPLAY_IDENTIFIER fm_sta_inj2_oc.Vxx_dtc_stt_xxx ECU_ADDRESS 0xc00000d5 /end MEASUREMENT
/begin MEASUREMENT Vxx_dfctr_inj2_scg "" UWORD _CNV_A_R_A_165_CM 1 0. 0. 65535. DISPLAY_IDENTIFIER fm_sta_inj2_scg.Vxx_dfctr_xxx ECU_ADDRESS 0xc00000d6 /end MEASUREMENT
/begin MEASUREMENT Vxx_rdn_inj2_scg "" UWORD _CNV_A_R_A_165_CM 1 0. 0. 65535. DISPLAY_IDENTIFIER fm_sta_inj2_scg.Vxx_rdn_xxx ECU_ADDRESS 0xc00000d8 /end MEASUREMENT
/begin MEASUREMENT Vbx_cf_inj2_scg "" UBYTE _CNV_A_R_A_165_CM 1 0. 0. 255. DISPLAY_IDENTIFIER fm_sta_inj2_scg.fm_static_bitfield.Vbx_cf_xxx ECU_ADDRESS 0xc00000da BIT_MASK 0x1 /end MEASUREMENT
/begin MEASUREMENT Vbx_clf_inj2_scg "" UBYTE _CNV_A_R_A_165_CM 1 0. 0. 255. DISPLAY_IDENTIFIER fm_sta_inj2_scg.fm_static_bitfield.Vbx_clf_xxx ECU_ADDRESS 0xc00000da BIT_MASK 0x2 /end MEASUREMENT
/begin MEASUREMENT Vbx_df_old_inj2_scg "" UBYTE _CNV_A_R_A_165_CM 1 0. 0. 255. DISPLAY_IDENTIFIER fm_sta_inj2_scg.fm_static_bitfield.Vbx_df_old_xxx ECU_ADDRESS 0xc00000da BIT_MASK 0x4 /end MEASUREMENT
/begin MEASUREMENT Vbx_dfctr_sat_inj2_scg "" UBYTE _CNV_A_R_A_165_CM 1 0. 0. 255. DISPLAY_IDENTIFIER fm_sta_inj2_scg.fm_static_bitfield.Vbx_dfctr_sat_xxx ECU_ADDRESS 0xc00000da BIT_MASK 0x8 /end MEASUREMENT
/begin MEASUREMENT Vbx_rdn_inj2_scg "" UBYTE _CNV_A_R_A_165_CM 1 0. 0. 255. DISPLAY_IDENTIFIER fm_sta_inj2_scg.fm_static_bitfield.Vbx_rdn_xxx ECU_ADDRESS 0xc00000da BIT_MASK 0x40 /end MEASUREMENT
/begin MEASUREMENT Vxx_dtc_stt_inj2_scg "" UBYTE _CNV_A_R_A_165_CM 1 0. 0. 255. DISPLAY_IDENTIFIER fm_sta_inj2_scg.Vxx_dtc_stt_xxx ECU_ADDRESS 0xc00000db /end MEASUREMENT
/begin MEASUREMENT Vxx_dfctr_inj2_scw "" UWORD _CNV_A_R_A_165_CM 1 0. 0. 65535. DISPLAY_IDENTIFIER fm_sta_inj2_scw.Vxx_dfctr_xxx ECU_ADDRESS 0xc00000dc /end MEASUREMENT
/begin MEASUREMENT Vxx_rdn_inj2_scw "" UWORD _CNV_A_R_A_165_CM 1 0. 0. 65535. DISPLAY_IDENTIFIER fm_sta_inj2_scw.Vxx_rdn_xxx ECU_ADDRESS 0xc00000de /end MEASUREMENT
/begin MEASUREMENT Vbx_cf_inj2_scw "" UBYTE _CNV_A_R_A_165_CM 1 0. 0. 255. DISPLAY_IDENTIFIER fm_sta_inj2_scw.fm_static_bitfield.Vbx_cf_xxx ECU_ADDRESS 0xc00000e0 BIT_MASK 0x1 /end MEASUREMENT
/begin MEASUREMENT Vbx_clf_inj2_scw "" UBYTE _CNV_A_R_A_165_CM 1 0. 0. 255. DISPLAY_IDENTIFIER fm_sta_inj2_scw.fm_static_bitfield.Vbx_clf_xxx ECU_ADDRESS 0xc00000e0 BIT_MASK 0x2 /end MEASUREMENT
/begin MEASUREMENT Vbx_df_old_inj2_scw "" UBYTE _CNV_A_R_A_165_CM 1 0. 0. 255. DISPLAY_IDENTIFIER fm_sta_inj2_scw.fm_static_bitfield.Vbx_df_old_xxx ECU_ADDRESS 0xc00000e0 BIT_MASK 0x4 /end MEASUREMENT
/begin MEASUREMENT Vbx_dfctr_sat_inj2_scw "" UBYTE _CNV_A_R_A_165_CM 1 0. 0. 255. DISPLAY_IDENTIFIER fm_sta_inj2_scw.fm_static_bitfield.Vbx_dfctr_sat_xxx ECU_ADDRESS 0xc00000e0 BIT_MASK 0x8 /end MEASUREMENT
/begin MEASUREMENT Vbx_rdn_inj2_scw "" UBYTE _CNV_A_R_A_165_CM 1 0. 0. 255. DISPLAY_IDENTIFIER fm_sta_inj2_scw.fm_static_bitfield.Vbx_rdn_xxx ECU_ADDRESS 0xc00000e0 BIT_MASK 0x40 /end MEASUREMENT
/begin MEASUREMENT Vxx_dtc_stt_inj2_scw "" UBYTE _CNV_A_R_A_165_CM 1 0. 0. 255. DISPLAY_IDENTIFIER fm_sta_inj2_scw.Vxx_dtc_stt_xxx ECU_ADDRESS 0xc00000e1 /end MEASUREMENT
/begin MEASUREMENT Vxx_dfctr_inj3_oc "" UWORD _CNV_A_R_A_165_CM 1 0. 0. 65535. DISPLAY_IDENTIFIER fm_sta_inj3_oc.Vxx_dfctr_xxx ECU_ADDRESS 0xc00000e2 /end MEASUREMENT
/begin MEASUREMENT Vxx_rdn_inj3_oc "" UWORD _CNV_A_R_A_165_CM 1 0. 0. 65535. DISPLAY_IDENTIFIER fm_sta_inj3_oc.Vxx_rdn_xxx ECU_ADDRESS 0xc00000e4 /end MEASUREMENT
/begin MEASUREMENT Vbx_cf_inj3_oc "" UBYTE _CNV_A_R_A_165_CM 1 0. 0. 255. DISPLAY_IDENTIFIER fm_sta_inj3_oc.fm_static_bitfield.Vbx_cf_xxx ECU_ADDRESS 0xc00000e6 BIT_MASK 0x1 /end MEASUREMENT
/begin MEASUREMENT Vbx_clf_inj3_oc "" UBYTE _CNV_A_R_A_165_CM 1 0. 0. 255. DISPLAY_IDENTIFIER fm_sta_inj3_oc.fm_static_bitfield.Vbx_clf_xxx ECU_ADDRESS 0xc00000e6 BIT_MASK 0x2 /end MEASUREMENT
/begin MEASUREMENT Vbx_df_old_inj3_oc "" UBYTE _CNV_A_R_A_165_CM 1 0. 0. 255. DISPLAY_IDENTIFIER fm_sta_inj3_oc.fm_static_bitfield.Vbx_df_old_xxx ECU_ADDRESS 0xc00000e6 BIT_MASK 0x4 /end MEASUREMENT
/begin MEASUREMENT Vbx_dfctr_sat_inj3_oc "" UBYTE _CNV_A_R_A_165_CM 1 0. 0. 255. DISPLAY_IDENTIFIER fm_sta_inj3_oc.fm_static_bitfield.Vbx_dfctr_sat_xxx ECU_ADDRESS 0xc00000e6 BIT_MASK 0x8 /end MEASUREMENT
/begin MEASUREMENT Vbx_rdn_inj3_oc "" UBYTE _CNV_A_R_A_165_CM 1 0. 0. 255. DISPLAY_IDENTIFIER fm_sta_inj3_oc.fm_static_bitfield.Vbx_rdn_xxx ECU_ADDRESS 0xc00000e6 BIT_MASK 0x40 /end MEASUREMENT
/begin MEASUREMENT Vxx_dtc_stt_inj3_oc "" UBYTE _CNV_A_R_A_165_CM 1 0. 0. 255. DISPLAY_IDENTIFIER fm_sta_inj3_oc.Vxx_dtc_stt_xxx ECU_ADDRESS 0xc00000e7 /end MEASUREMENT
/begin MEASUREMENT Vxx_dfctr_inj3_scg "" UWORD _CNV_A_R_A_165_CM 1 0. 0. 65535. DISPLAY_IDENTIFIER fm_sta_inj3_scg.Vxx_dfctr_xxx ECU_ADDRESS 0xc00000e8 /end MEASUREMENT
/begin MEASUREMENT Vxx_rdn_inj3_scg "" UWORD _CNV_A_R_A_165_CM 1 0. 0. 65535. DISPLAY_IDENTIFIER fm_sta_inj3_scg.Vxx_rdn_xxx ECU_ADDRESS 0xc00000ea /end MEASUREMENT
/begin MEASUREMENT Vbx_cf_inj3_scg "" UBYTE _CNV_A_R_A_165_CM 1 0. 0. 255. DISPLAY_IDENTIFIER fm_sta_inj3_scg.fm_static_bitfield.Vbx_cf_xxx ECU_ADDRESS 0xc00000ec BIT_MASK 0x1 /end MEASUREMENT
/begin MEASUREMENT Vbx_clf_inj3_scg "" UBYTE _CNV_A_R_A_165_CM 1 0. 0. 255. DISPLAY_IDENTIFIER fm_sta_inj3_scg.fm_static_bitfield.Vbx_clf_xxx ECU_ADDRESS 0xc00000ec BIT_MASK 0x2 /end MEASUREMENT
/begin MEASUREMENT Vbx_df_old_inj3_scg "" UBYTE _CNV_A_R_A_165_CM 1 0. 0. 255. DISPLAY_IDENTIFIER fm_sta_inj3_scg.fm_static_bitfield.Vbx_df_old_xxx ECU_ADDRESS 0xc00000ec BIT_MASK 0x4 /end MEASUREMENT
/begin MEASUREMENT Vbx_dfctr_sat_inj3_scg "" UBYTE _CNV_A_R_A_165_CM 1 0. 0. 255. DISPLAY_IDENTIFIER fm_sta_inj3_scg.fm_static_bitfield.Vbx_dfctr_sat_xxx ECU_ADDRESS 0xc00000ec BIT_MASK 0x8 /end MEASUREMENT
/begin MEASUREMENT Vbx_rdn_inj3_scg "" UBYTE _CNV_A_R_A_165_CM 1 0. 0. 255. DISPLAY_IDENTIFIER fm_sta_inj3_scg.fm_static_bitfield.Vbx_rdn_xxx ECU_ADDRESS 0xc00000ec BIT_MASK 0x40 /end MEASUREMENT
/begin MEASUREMENT Vxx_dtc_stt_inj3_scg "" UBYTE _CNV_A_R_A_165_CM 1 0. 0. 255. DISPLAY_IDENTIFIER fm_sta_inj3_scg.Vxx_dtc_stt_xxx ECU_ADDRESS 0xc00000ed /end MEASUREMENT
/begin MEASUREMENT Vxx_dfctr_inj3_scw "" UWORD _CNV_A_R_A_165_CM 1 0. 0. 65535. DISPLAY_IDENTIFIER fm_sta_inj3_scw.Vxx_dfctr_xxx ECU_ADDRESS 0xc00000ee /end MEASUREMENT
/begin MEASUREMENT Vxx_rdn_inj3_scw "" UWORD _CNV_A_R_A_165_CM 1 0. 0. 65535. DISPLAY_IDENTIFIER fm_sta_inj3_scw.Vxx_rdn_xxx ECU_ADDRESS 0xc00000f0 /end MEASUREMENT
/begin MEASUREMENT Vbx_cf_inj3_scw "" UBYTE _CNV_A_R_A_165_CM 1 0. 0. 255. DISPLAY_IDENTIFIER fm_sta_inj3_scw.fm_static_bitfield.Vbx_cf_xxx ECU_ADDRESS 0xc00000f2 BIT_MASK 0x1 /end MEASUREMENT
/begin MEASUREMENT Vbx_clf_inj3_scw "" UBYTE _CNV_A_R_A_165_CM 1 0. 0. 255. DISPLAY_IDENTIFIER fm_sta_inj3_scw.fm_static_bitfield.Vbx_clf_xxx ECU_ADDRESS 0xc00000f2 BIT_MASK 0x2 /end MEASUREMENT
/begin MEASUREMENT Vbx_df_old_inj3_scw "" UBYTE _CNV_A_R_A_165_CM 1 0. 0. 255. DISPLAY_IDENTIFIER fm_sta_inj3_scw.fm_static_bitfield.Vbx_df_old_xxx ECU_ADDRESS 0xc00000f2 BIT_MASK 0x4 /end MEASUREMENT
/begin MEASUREMENT Vbx_dfctr_sat_inj3_scw "" UBYTE _CNV_A_R_A_165_CM 1 0. 0. 255. DISPLAY_IDENTIFIER fm_sta_inj3_scw.fm_static_bitfield.Vbx_dfctr_sat_xxx ECU_ADDRESS 0xc00000f2 BIT_MASK 0x8 /end MEASUREMENT
/begin MEASUREMENT Vbx_rdn_inj3_scw "" UBYTE _CNV_A_R_A_165_CM 1 0. 0. 255. DISPLAY_IDENTIFIER fm_sta_inj3_scw.fm_static_bitfield.Vbx_rdn_xxx ECU_ADDRESS 0xc00000f2 BIT_MASK 0x40 /end MEASUREMENT
/begin MEASUREMENT Vxx_dtc_stt_inj3_scw "" UBYTE _CNV_A_R_A_165_CM 1 0. 0. 255. DISPLAY_IDENTIFIER fm_sta_inj3_scw.Vxx_dtc_stt_xxx ECU_ADDRESS 0xc00000f3 /end MEASUREMENT
/begin MEASUREMENT Vxx_dfctr_inj4_oc "" UWORD _CNV_A_R_A_165_CM 1 0. 0. 65535. DISPLAY_IDENTIFIER fm_sta_inj4_oc.Vxx_dfctr_xxx ECU_ADDRESS 0xc00000f4 /end MEASUREMENT
/begin MEASUREMENT Vxx_rdn_inj4_oc "" UWORD _CNV_A_R_A_165_CM 1 0. 0. 65535. DISPLAY_IDENTIFIER fm_sta_inj4_oc.Vxx_rdn_xxx ECU_ADDRESS 0xc00000f6 /end MEASUREMENT
/begin MEASUREMENT Vbx_cf_inj4_oc "" UBYTE _CNV_A_R_A_165_CM 1 0. 0. 255. DISPLAY_IDENTIFIER fm_sta_inj4_oc.fm_static_bitfield.Vbx_cf_xxx ECU_ADDRESS 0xc00000f8 BIT_MASK 0x1 /end MEASUREMENT
/begin MEASUREMENT Vbx_clf_inj4_oc "" UBYTE _CNV_A_R_A_165_CM 1 0. 0. 255. DISPLAY_IDENTIFIER fm_sta_inj4_oc.fm_static_bitfield.Vbx_clf_xxx ECU_ADDRESS 0xc00000f8 BIT_MASK 0x2 /end MEASUREMENT
/begin MEASUREMENT Vbx_df_old_inj4_oc "" UBYTE _CNV_A_R_A_165_CM 1 0. 0. 255. DISPLAY_IDENTIFIER fm_sta_inj4_oc.fm_static_bitfield.Vbx_df_old_xxx ECU_ADDRESS 0xc00000f8 BIT_MASK 0x4 /end MEASUREMENT
/begin MEASUREMENT Vbx_dfctr_sat_inj4_oc "" UBYTE _CNV_A_R_A_165_CM 1 0. 0. 255. DISPLAY_IDENTIFIER fm_sta_inj4_oc.fm_static_bitfield.Vbx_dfctr_sat_xxx ECU_ADDRESS 0xc00000f8 BIT_MASK 0x8 /end MEASUREMENT
/begin MEASUREMENT Vbx_rdn_inj4_oc "" UBYTE _CNV_A_R_A_165_CM 1 0. 0. 255. DISPLAY_IDENTIFIER fm_sta_inj4_oc.fm_static_bitfield.Vbx_rdn_xxx ECU_ADDRESS 0xc00000f8 BIT_MASK 0x40 /end MEASUREMENT
/begin MEASUREMENT Vxx_dtc_stt_inj4_oc "" UBYTE _CNV_A_R_A_165_CM 1 0. 0. 255. DISPLAY_IDENTIFIER fm_sta_inj4_oc.Vxx_dtc_stt_xxx ECU_ADDRESS 0xc00000f9 /end MEASUREMENT
/begin MEASUREMENT Vxx_dfctr_inj4_scg "" UWORD _CNV_A_R_A_165_CM 1 0. 0. 65535. DISPLAY_IDENTIFIER fm_sta_inj4_scg.Vxx_dfctr_xxx ECU_ADDRESS 0xc00000fa /end MEASUREMENT
/begin MEASUREMENT Vxx_rdn_inj4_scg "" UWORD _CNV_A_R_A_165_CM 1 0. 0. 65535. DISPLAY_IDENTIFIER fm_sta_inj4_scg.Vxx_rdn_xxx ECU_ADDRESS 0xc00000fc /end MEASUREMENT
/begin MEASUREMENT Vbx_cf_inj4_scg "" UBYTE _CNV_A_R_A_165_CM 1 0. 0. 255. DISPLAY_IDENTIFIER fm_sta_inj4_scg.fm_static_bitfield.Vbx_cf_xxx ECU_ADDRESS 0xc00000fe BIT_MASK 0x1 /end MEASUREMENT
/begin MEASUREMENT Vbx_clf_inj4_scg "" UBYTE _CNV_A_R_A_165_CM 1 0. 0. 255. DISPLAY_IDENTIFIER fm_sta_inj4_scg.fm_static_bitfield.Vbx_clf_xxx ECU_ADDRESS 0xc00000fe BIT_MASK 0x2 /end MEASUREMENT
/begin MEASUREMENT Vbx_df_old_inj4_scg "" UBYTE _CNV_A_R_A_165_CM 1 0. 0. 255. DISPLAY_IDENTIFIER fm_sta_inj4_scg.fm_static_bitfield.Vbx_df_old_xxx ECU_ADDRESS 0xc00000fe BIT_MASK 0x4 /end MEASUREMENT
/begin MEASUREMENT Vbx_dfctr_sat_inj4_scg "" UBYTE _CNV_A_R_A_165_CM 1 0. 0. 255. DISPLAY_IDENTIFIER fm_sta_inj4_scg.fm_static_bitfield.Vbx_dfctr_sat_xxx ECU_ADDRESS 0xc00000fe BIT_MASK 0x8 /end MEASUREMENT
/begin MEASUREMENT Vbx_rdn_inj4_scg "" UBYTE _CNV_A_R_A_165_CM 1 0. 0. 255. DISPLAY_IDENTIFIER fm_sta_inj4_scg.fm_static_bitfield.Vbx_rdn_xxx ECU_ADDRESS 0xc00000fe BIT_MASK 0x40 /end MEASUREMENT
/begin MEASUREMENT Vxx_dtc_stt_inj4_scg "" UBYTE _CNV_A_R_A_165_CM 1 0. 0. 255. DISPLAY_IDENTIFIER fm_sta_inj4_scg.Vxx_dtc_stt_xxx ECU_ADDRESS 0xc00000ff /end MEASUREMENT
/begin MEASUREMENT Vxx_dfctr_inj4_scw "" UWORD _CNV_A_R_A_165_CM 1 0. 0. 65535. DISPLAY_IDENTIFIER fm_sta_inj4_scw.Vxx_dfctr_xxx ECU_ADDRESS 0xc0000100 /end MEASUREMENT
/begin MEASUREMENT Vxx_rdn_inj4_scw "" UWORD _CNV_A_R_A_165_CM 1 0. 0. 65535. DISPLAY_IDENTIFIER fm_sta_inj4_scw.Vxx_rdn_xxx ECU_ADDRESS 0xc0000102 /end MEASUREMENT
/begin MEASUREMENT Vbx_cf_inj4_scw "" UBYTE _CNV_A_R_A_165_CM 1 0. 0. 255. DISPLAY_IDENTIFIER fm_sta_inj4_scw.fm_static_bitfield.Vbx_cf_xxx ECU_ADDRESS 0xc0000104 BIT_MASK 0x1 /end MEASUREMENT
/begin MEASUREMENT Vbx_clf_inj4_scw "" UBYTE _CNV_A_R_A_165_CM 1 0. 0. 255. DISPLAY_IDENTIFIER fm_sta_inj4_scw.fm_static_bitfield.Vbx_clf_xxx ECU_ADDRESS 0xc0000104 BIT_MASK 0x2 /end MEASUREMENT
/begin MEASUREMENT Vbx_df_old_inj4_scw "" UBYTE _CNV_A_R_A_165_CM 1 0. 0. 255. DISPLAY_IDENTIFIER fm_sta_inj4_scw.fm_static_bitfield.Vbx_df_old_xxx ECU_ADDRESS 0xc0000104 BIT_MASK 0x4 /end MEASUREMENT
/begin MEASUREMENT Vbx_dfctr_sat_inj4_scw "" UBYTE _CNV_A_R_A_165_CM 1 0. 0. 255. DISPLAY_IDENTIFIER fm_sta_inj4_scw.fm_static_bitfield.Vbx_dfctr_sat_xxx ECU_ADDRESS 0xc0000104 BIT_MASK 0x8 /end MEASUREMENT
/begin MEASUREMENT Vbx_rdn_inj4_scw "" UBYTE _CNV_A_R_A_165_CM 1 0. 0. 255. DISPLAY_IDENTIFIER fm_sta_inj4_scw.fm_static_bitfield.Vbx_rdn_xxx ECU_ADDRESS 0xc0000104 BIT_MASK 0x40 /end MEASUREMENT
/begin MEASUREMENT Vxx_dtc_stt_inj4_scw "" UBYTE _CNV_A_R_A_165_CM 1 0. 0. 255. DISPLAY_IDENTIFIER fm_sta_inj4_scw.Vxx_dtc_stt_xxx ECU_ADDRESS 0xc0000105 /end MEASUREMENT
/begin MEASUREMENT Vxx_dfctr_inj_ecu_itl "" UWORD _CNV_A_R_A_165_CM 1 0. 0. 65535. DISPLAY_IDENTIFIER fm_sta_inj_ecu_itl.Vxx_dfctr_xxx ECU_ADDRESS 0xc000038e /end MEASUREMENT
/begin MEASUREMENT Vxx_rdn_inj_ecu_itl "" UWORD _CNV_A_R_A_165_CM 1 0. 0. 65535. DISPLAY_IDENTIFIER fm_sta_inj_ecu_itl.Vxx_rdn_xxx ECU_ADDRESS 0xc0000390 /end MEASUREMENT
/begin MEASUREMENT Vbx_cf_inj_ecu_itl "" UBYTE _CNV_A_R_A_165_CM 1 0. 0. 255. DISPLAY_IDENTIFIER fm_sta_inj_ecu_itl.fm_static_bitfield.Vbx_cf_xxx ECU_ADDRESS 0xc0000392 BIT_MASK 0x1 /end MEASUREMENT
/begin MEASUREMENT Vbx_clf_inj_ecu_itl "" UBYTE _CNV_A_R_A_165_CM 1 0. 0. 255. DISPLAY_IDENTIFIER fm_sta_inj_ecu_itl.fm_static_bitfield.Vbx_clf_xxx ECU_ADDRESS 0xc0000392 BIT_MASK 0x2 /end MEASUREMENT
/begin MEASUREMENT Vbx_df_old_inj_ecu_itl "" UBYTE _CNV_A_R_A_165_CM 1 0. 0. 255. DISPLAY_IDENTIFIER fm_sta_inj_ecu_itl.fm_static_bitfield.Vbx_df_old_xxx ECU_ADDRESS 0xc0000392 BIT_MASK 0x4 /end MEASUREMENT
/begin MEASUREMENT Vbx_dfctr_sat_inj_ecu_itl "" UBYTE _CNV_A_R_A_165_CM 1 0. 0. 255. DISPLAY_IDENTIFIER fm_sta_inj_ecu_itl.fm_static_bitfield.Vbx_dfctr_sat_xxx ECU_ADDRESS 0xc0000392 BIT_MASK 0x8 /end MEASUREMENT
/begin MEASUREMENT Vbx_rdn_inj_ecu_itl "" UBYTE _CNV_A_R_A_165_CM 1 0. 0. 255. DISPLAY_IDENTIFIER fm_sta_inj_ecu_itl.fm_static_bitfield.Vbx_rdn_xxx ECU_ADDRESS 0xc0000392 BIT_MASK 0x40 /end MEASUREMENT
/begin MEASUREMENT Vxx_dtc_stt_inj_ecu_itl "" UBYTE _CNV_A_R_A_165_CM 1 0. 0. 255. DISPLAY_IDENTIFIER fm_sta_inj_ecu_itl.Vxx_dtc_stt_xxx ECU_ADDRESS 0xc0000393 /end MEASUREMENT
/begin MEASUREMENT Vxx_dfctr_inj_ecu_lbdw_icp "" UWORD _CNV_A_R_A_165_CM 1 0. 0. 65535. DISPLAY_IDENTIFIER fm_sta_inj_ecu_lbdw_icp.Vxx_dfctr_xxx ECU_ADDRESS 0xc00000b2 /end MEASUREMENT
/begin MEASUREMENT Vxx_rdn_inj_ecu_lbdw_icp "" UWORD _CNV_A_R_A_165_CM 1 0. 0. 65535. DISPLAY_IDENTIFIER fm_sta_inj_ecu_lbdw_icp.Vxx_rdn_xxx ECU_ADDRESS 0xc00000b4 /end MEASUREMENT
/begin MEASUREMENT Vbx_cf_inj_ecu_lbdw_icp "" UBYTE _CNV_A_R_A_165_CM 1 0. 0. 255. DISPLAY_IDENTIFIER fm_sta_inj_ecu_lbdw_icp.fm_static_bitfield.Vbx_cf_xxx ECU_ADDRESS 0xc00000b6 BIT_MASK 0x1 /end MEASUREMENT
/begin MEASUREMENT Vbx_clf_inj_ecu_lbdw_icp "" UBYTE _CNV_A_R_A_165_CM 1 0. 0. 255. DISPLAY_IDENTIFIER fm_sta_inj_ecu_lbdw_icp.fm_static_bitfield.Vbx_clf_xxx ECU_ADDRESS 0xc00000b6 BIT_MASK 0x2 /end MEASUREMENT
/begin MEASUREMENT Vbx_df_old_inj_ecu_lbdw_icp "" UBYTE _CNV_A_R_A_165_CM 1 0. 0. 255. DISPLAY_IDENTIFIER fm_sta_inj_ecu_lbdw_icp.fm_static_bitfield.Vbx_df_old_xxx ECU_ADDRESS 0xc00000b6 BIT_MASK 0x4 /end MEASUREMENT
/begin MEASUREMENT Vbx_dfctr_sat_inj_ecu_lbdw_icp "" UBYTE _CNV_A_R_A_165_CM 1 0. 0. 255. DISPLAY_IDENTIFIER fm_sta_inj_ecu_lbdw_icp.fm_static_bitfield.Vbx_dfctr_sat_xxx ECU_ADDRESS 0xc00000b6 BIT_MASK 0x8 /end MEASUREMENT
/begin MEASUREMENT Vbx_rdn_inj_ecu_lbdw_icp "" UBYTE _CNV_A_R_A_165_CM 1 0. 0. 255. DISPLAY_IDENTIFIER fm_sta_inj_ecu_lbdw_icp.fm_static_bitfield.Vbx_rdn_xxx ECU_ADDRESS 0xc00000b6 BIT_MASK 0x40 /end MEASUREMENT
/begin MEASUREMENT Vxx_dtc_stt_inj_ecu_lbdw_icp "" UBYTE _CNV_A_R_A_165_CM 1 0. 0. 255. DISPLAY_IDENTIFIER fm_sta_inj_ecu_lbdw_icp.Vxx_dtc_stt_xxx ECU_ADDRESS 0xc00000b7 /end MEASUREMENT
/begin MEASUREMENT Vxx_dfctr_inj_ecu_lbup_icp "" UWORD _CNV_A_R_A_165_CM 1 0. 0. 65535. DISPLAY_IDENTIFIER fm_sta_inj_ecu_lbup_icp.Vxx_dfctr_xxx ECU_ADDRESS 0xc00000b8 /end MEASUREMENT
/begin MEASUREMENT Vxx_rdn_inj_ecu_lbup_icp "" UWORD _CNV_A_R_A_165_CM 1 0. 0. 65535. DISPLAY_IDENTIFIER fm_sta_inj_ecu_lbup_icp.Vxx_rdn_xxx ECU_ADDRESS 0xc00000ba /end MEASUREMENT
/begin MEASUREMENT Vbx_cf_inj_ecu_lbup_icp "" UBYTE _CNV_A_R_A_165_CM 1 0. 0. 255. DISPLAY_IDENTIFIER fm_sta_inj_ecu_lbup_icp.fm_static_bitfield.Vbx_cf_xxx ECU_ADDRESS 0xc00000bc BIT_MASK 0x1 /end MEASUREMENT
/begin MEASUREMENT Vbx_clf_inj_ecu_lbup_icp "" UBYTE _CNV_A_R_A_165_CM 1 0. 0. 255. DISPLAY_IDENTIFIER fm_sta_inj_ecu_lbup_icp.fm_static_bitfield.Vbx_clf_xxx ECU_ADDRESS 0xc00000bc BIT_MASK 0x2 /end MEASUREMENT
/begin MEASUREMENT Vbx_df_old_inj_ecu_lbup_icp "" UBYTE _CNV_A_R_A_165_CM 1 0. 0. 255. DISPLAY_IDENTIFIER fm_sta_inj_ecu_lbup_icp.fm_static_bitfield.Vbx_df_old_xxx ECU_ADDRESS 0xc00000bc BIT_MASK 0x4 /end MEASUREMENT
/begin MEASUREMENT Vbx_dfctr_sat_inj_ecu_lbup_icp "" UBYTE _CNV_A_R_A_165_CM 1 0. 0. 255. DISPLAY_IDENTIFIER fm_sta_inj_ecu_lbup_icp.fm_static_bitfield.Vbx_dfctr_sat_xxx ECU_ADDRESS 0xc00000bc BIT_MASK 0x8 /end MEASUREMENT
/begin MEASUREMENT Vbx_rdn_inj_ecu_lbup_icp "" UBYTE _CNV_A_R_A_165_CM 1 0. 0. 255. DISPLAY_IDENTIFIER fm_sta_inj_ecu_lbup_icp.fm_static_bitfield.Vbx_rdn_xxx ECU_ADDRESS 0xc00000bc BIT_MASK 0x40 /end MEASUREMENT
/begin MEASUREMENT Vxx_dtc_stt_inj_ecu_lbup_icp "" UBYTE _CNV_A_R_A_165_CM 1 0. 0. 255. DISPLAY_IDENTIFIER fm_sta_inj_ecu_lbup_icp.Vxx_dtc_stt_xxx ECU_ADDRESS 0xc00000bd /end MEASUREMENT
/begin MEASUREMENT Vxx_dfctr_ip_lght_tco_ovh "" UWORD _CNV_A_R_A_165_CM 1 0. 0. 65535. DISPLAY_IDENTIFIER fm_sta_ip_lght_tco_ovh.Vxx_dfctr_xxx ECU_ADDRESS 0xc0000394 /end MEASUREMENT
/begin MEASUREMENT Vxx_rdn_ip_lght_tco_ovh "" UWORD _CNV_A_R_A_165_CM 1 0. 0. 65535. DISPLAY_IDENTIFIER fm_sta_ip_lght_tco_ovh.Vxx_rdn_xxx ECU_ADDRESS 0xc0000396 /end MEASUREMENT
/begin MEASUREMENT Vbx_cf_ip_lght_tco_ovh "" UBYTE _CNV_A_R_A_165_CM 1 0. 0. 255. DISPLAY_IDENTIFIER fm_sta_ip_lght_tco_ovh.fm_static_bitfield.Vbx_cf_xxx ECU_ADDRESS 0xc0000398 BIT_MASK 0x1 /end MEASUREMENT
/begin MEASUREMENT Vbx_clf_ip_lght_tco_ovh "" UBYTE _CNV_A_R_A_165_CM 1 0. 0. 255. DISPLAY_IDENTIFIER fm_sta_ip_lght_tco_ovh.fm_static_bitfield.Vbx_clf_xxx ECU_ADDRESS 0xc0000398 BIT_MASK 0x2 /end MEASUREMENT
/begin MEASUREMENT Vbx_df_old_ip_lght_tco_ovh "" UBYTE _CNV_A_R_A_165_CM 1 0. 0. 255. DISPLAY_IDENTIFIER fm_sta_ip_lght_tco_ovh.fm_static_bitfield.Vbx_df_old_xxx ECU_ADDRESS 0xc0000398 BIT_MASK 0x4 /end MEASUREMENT
/begin MEASUREMENT Vbx_dfctr_sat_ip_lght_tco_ovh "" UBYTE _CNV_A_R_A_165_CM 1 0. 0. 255. DISPLAY_IDENTIFIER fm_sta_ip_lght_tco_ovh.fm_static_bitfield.Vbx_dfctr_sat_xxx ECU_ADDRESS 0xc0000398 BIT_MASK 0x8 /end MEASUREMENT
/begin MEASUREMENT Vbx_rdn_ip_lght_tco_ovh "" UBYTE _CNV_A_R_A_165_CM 1 0. 0. 255. DISPLAY_IDENTIFIER fm_sta_ip_lght_tco_ovh.fm_static_bitfield.Vbx_rdn_xxx ECU_ADDRESS 0xc0000398 BIT_MASK 0x40 /end MEASUREMENT
/begin MEASUREMENT Vxx_dtc_stt_ip_lght_tco_ovh "" UBYTE _CNV_A_R_A_165_CM 1 0. 0. 255. DISPLAY_IDENTIFIER fm_sta_ip_lght_tco_ovh.Vxx_dtc_stt_xxx ECU_ADDRESS 0xc0000399 /end MEASUREMENT
/begin MEASUREMENT Vxx_dfctr_it_cmd_el "" UWORD _CNV_A_R_A_165_CM 1 0. 0. 65535. DISPLAY_IDENTIFIER fm_sta_it_cmd_el.Vxx_dfctr_xxx ECU_ADDRESS 0xc0000106 /end MEASUREMENT
/begin MEASUREMENT Vxx_rdn_it_cmd_el "" UWORD _CNV_A_R_A_165_CM 1 0. 0. 65535. DISPLAY_IDENTIFIER fm_sta_it_cmd_el.Vxx_rdn_xxx ECU_ADDRESS 0xc0000108 /end MEASUREMENT
/begin MEASUREMENT Vbx_cf_it_cmd_el "" UBYTE _CNV_A_R_A_165_CM 1 0. 0. 255. DISPLAY_IDENTIFIER fm_sta_it_cmd_el.fm_static_bitfield.Vbx_cf_xxx ECU_ADDRESS 0xc000010a BIT_MASK 0x1 /end MEASUREMENT
/begin MEASUREMENT Vbx_clf_it_cmd_el "" UBYTE _CNV_A_R_A_165_CM 1 0. 0. 255. DISPLAY_IDENTIFIER fm_sta_it_cmd_el.fm_static_bitfield.Vbx_clf_xxx ECU_ADDRESS 0xc000010a BIT_MASK 0x2 /end MEASUREMENT
/begin MEASUREMENT Vbx_df_old_it_cmd_el "" UBYTE _CNV_A_R_A_165_CM 1 0. 0. 255. DISPLAY_IDENTIFIER fm_sta_it_cmd_el.fm_static_bitfield.Vbx_df_old_xxx ECU_ADDRESS 0xc000010a BIT_MASK 0x4 /end MEASUREMENT
/begin MEASUREMENT Vbx_dfctr_sat_it_cmd_el "" UBYTE _CNV_A_R_A_165_CM 1 0. 0. 255. DISPLAY_IDENTIFIER fm_sta_it_cmd_el.fm_static_bitfield.Vbx_dfctr_sat_xxx ECU_ADDRESS 0xc000010a BIT_MASK 0x8 /end MEASUREMENT
/begin MEASUREMENT Vbx_rdn_it_cmd_el "" UBYTE _CNV_A_R_A_165_CM 1 0. 0. 255. DISPLAY_IDENTIFIER fm_sta_it_cmd_el.fm_static_bitfield.Vbx_rdn_xxx ECU_ADDRESS 0xc000010a BIT_MASK 0x40 /end MEASUREMENT
/begin MEASUREMENT Vxx_dtc_stt_it_cmd_el "" UBYTE _CNV_A_R_A_165_CM 1 0. 0. 255. DISPLAY_IDENTIFIER fm_sta_it_cmd_el.Vxx_dtc_stt_xxx ECU_ADDRESS 0xc000010b /end MEASUREMENT
/begin MEASUREMENT Vxx_dfctr_it_ofs_meca "" UWORD _CNV_A_R_A_165_CM 1 0. 0. 65535. DISPLAY_IDENTIFIER fm_sta_it_ofs_meca.Vxx_dfctr_xxx ECU_ADDRESS 0xc000010c /end MEASUREMENT
/begin MEASUREMENT Vxx_rdn_it_ofs_meca "" UWORD _CNV_A_R_A_165_CM 1 0. 0. 65535. DISPLAY_IDENTIFIER fm_sta_it_ofs_meca.Vxx_rdn_xxx ECU_ADDRESS 0xc000010e /end MEASUREMENT
/begin MEASUREMENT Vbx_cf_it_ofs_meca "" UBYTE _CNV_A_R_A_165_CM 1 0. 0. 255. DISPLAY_IDENTIFIER fm_sta_it_ofs_meca.fm_static_bitfield.Vbx_cf_xxx ECU_ADDRESS 0xc0000110 BIT_MASK 0x1 /end MEASUREMENT
/begin MEASUREMENT Vbx_clf_it_ofs_meca "" UBYTE _CNV_A_R_A_165_CM 1 0. 0. 255. DISPLAY_IDENTIFIER fm_sta_it_ofs_meca.fm_static_bitfield.Vbx_clf_xxx ECU_ADDRESS 0xc0000110 BIT_MASK 0x2 /end MEASUREMENT
/begin MEASUREMENT Vbx_df_old_it_ofs_meca "" UBYTE _CNV_A_R_A_165_CM 1 0. 0. 255. DISPLAY_IDENTIFIER fm_sta_it_ofs_meca.fm_static_bitfield.Vbx_df_old_xxx ECU_ADDRESS 0xc0000110 BIT_MASK 0x4 /end MEASUREMENT
/begin MEASUREMENT Vbx_dfctr_sat_it_ofs_meca "" UBYTE _CNV_A_R_A_165_CM 1 0. 0. 255. DISPLAY_IDENTIFIER fm_sta_it_ofs_meca.fm_static_bitfield.Vbx_dfctr_sat_xxx ECU_ADDRESS 0xc0000110 BIT_MASK 0x8 /end MEASUREMENT
/begin MEASUREMENT Vbx_rdn_it_ofs_meca "" UBYTE _CNV_A_R_A_165_CM 1 0. 0. 255. DISPLAY_IDENTIFIER fm_sta_it_ofs_meca.fm_static_bitfield.Vbx_rdn_xxx ECU_ADDRESS 0xc0000110 BIT_MASK 0x40 /end MEASUREMENT
/begin MEASUREMENT Vxx_dtc_stt_it_ofs_meca "" UBYTE _CNV_A_R_A_165_CM 1 0. 0. 255. DISPLAY_IDENTIFIER fm_sta_it_ofs_meca.Vxx_dtc_stt_xxx ECU_ADDRESS 0xc0000111 /end MEASUREMENT
/begin MEASUREMENT Vxx_dfctr_it_ofs_no_norm "" UWORD _CNV_A_R_A_165_CM 1 0. 0. 65535. DISPLAY_IDENTIFIER fm_sta_it_ofs_no_norm.Vxx_dfctr_xxx ECU_ADDRESS 0xc0000112 /end MEASUREMENT
/begin MEASUREMENT Vxx_rdn_it_ofs_no_norm "" UWORD _CNV_A_R_A_165_CM 1 0. 0. 65535. DISPLAY_IDENTIFIER fm_sta_it_ofs_no_norm.Vxx_rdn_xxx ECU_ADDRESS 0xc0000114 /end MEASUREMENT
/begin MEASUREMENT Vbx_cf_it_ofs_no_norm "" UBYTE _CNV_A_R_A_165_CM 1 0. 0. 255. DISPLAY_IDENTIFIER fm_sta_it_ofs_no_norm.fm_static_bitfield.Vbx_cf_xxx ECU_ADDRESS 0xc0000116 BIT_MASK 0x1 /end MEASUREMENT
/begin MEASUREMENT Vbx_clf_it_ofs_no_norm "" UBYTE _CNV_A_R_A_165_CM 1 0. 0. 255. DISPLAY_IDENTIFIER fm_sta_it_ofs_no_norm.fm_static_bitfield.Vbx_clf_xxx ECU_ADDRESS 0xc0000116 BIT_MASK 0x2 /end MEASUREMENT
/begin MEASUREMENT Vbx_df_old_it_ofs_no_norm "" UBYTE _CNV_A_R_A_165_CM 1 0. 0. 255. DISPLAY_IDENTIFIER fm_sta_it_ofs_no_norm.fm_static_bitfield.Vbx_df_old_xxx ECU_ADDRESS 0xc0000116 BIT_MASK 0x4 /end MEASUREMENT
/begin MEASUREMENT Vbx_dfctr_sat_it_ofs_no_norm "" UBYTE _CNV_A_R_A_165_CM 1 0. 0. 255. DISPLAY_IDENTIFIER fm_sta_it_ofs_no_norm.fm_static_bitfield.Vbx_dfctr_sat_xxx ECU_ADDRESS 0xc0000116 BIT_MASK 0x8 /end MEASUREMENT
/begin MEASUREMENT Vbx_rdn_it_ofs_no_norm "" UBYTE _CNV_A_R_A_165_CM 1 0. 0. 255. DISPLAY_IDENTIFIER fm_sta_it_ofs_no_norm.fm_static_bitfield.Vbx_rdn_xxx ECU_ADDRESS 0xc0000116 BIT_MASK 0x40 /end MEASUREMENT
/begin MEASUREMENT Vxx_dtc_stt_it_ofs_no_norm "" UBYTE _CNV_A_R_A_165_CM 1 0. 0. 255. DISPLAY_IDENTIFIER fm_sta_it_ofs_no_norm.Vxx_dtc_stt_xxx ECU_ADDRESS 0xc0000117 /end MEASUREMENT
/begin MEASUREMENT Vxx_dfctr_it_ofs_secu_nok "" UWORD _CNV_A_R_A_165_CM 1 0. 0. 65535. DISPLAY_IDENTIFIER fm_sta_it_ofs_secu_nok.Vxx_dfctr_xxx ECU_ADDRESS 0xc0000118 /end MEASUREMENT
/begin MEASUREMENT Vxx_rdn_it_ofs_secu_nok "" UWORD _CNV_A_R_A_165_CM 1 0. 0. 65535. DISPLAY_IDENTIFIER fm_sta_it_ofs_secu_nok.Vxx_rdn_xxx ECU_ADDRESS 0xc000011a /end MEASUREMENT
/begin MEASUREMENT Vbx_cf_it_ofs_secu_nok "" UBYTE _CNV_A_R_A_165_CM 1 0. 0. 255. DISPLAY_IDENTIFIER fm_sta_it_ofs_secu_nok.fm_static_bitfield.Vbx_cf_xxx ECU_ADDRESS 0xc000011c BIT_MASK 0x1 /end MEASUREMENT
/begin MEASUREMENT Vbx_clf_it_ofs_secu_nok "" UBYTE _CNV_A_R_A_165_CM 1 0. 0. 255. DISPLAY_IDENTIFIER fm_sta_it_ofs_secu_nok.fm_static_bitfield.Vbx_clf_xxx ECU_ADDRESS 0xc000011c BIT_MASK 0x2 /end MEASUREMENT
/begin MEASUREMENT Vbx_df_old_it_ofs_secu_nok "" UBYTE _CNV_A_R_A_165_CM 1 0. 0. 255. DISPLAY_IDENTIFIER fm_sta_it_ofs_secu_nok.fm_static_bitfield.Vbx_df_old_xxx ECU_ADDRESS 0xc000011c BIT_MASK 0x4 /end MEASUREMENT
/begin MEASUREMENT Vbx_dfctr_sat_it_ofs_secu_nok "" UBYTE _CNV_A_R_A_165_CM 1 0. 0. 255. DISPLAY_IDENTIFIER fm_sta_it_ofs_secu_nok.fm_static_bitfield.Vbx_dfctr_sat_xxx ECU_ADDRESS 0xc000011c BIT_MASK 0x8 /end MEASUREMENT
/begin MEASUREMENT Vbx_rdn_it_ofs_secu_nok "" UBYTE _CNV_A_R_A_165_CM 1 0. 0. 255. DISPLAY_IDENTIFIER fm_sta_it_ofs_secu_nok.fm_static_bitfield.Vbx_rdn_xxx ECU_ADDRESS 0xc000011c BIT_MASK 0x40 /end MEASUREMENT
/begin MEASUREMENT Vxx_dtc_stt_it_ofs_secu_nok "" UBYTE _CNV_A_R_A_165_CM 1 0. 0. 255. DISPLAY_IDENTIFIER fm_sta_it_ofs_secu_nok.Vxx_dtc_stt_xxx ECU_ADDRESS 0xc000011d /end MEASUREMENT
/begin MEASUREMENT Vxx_dfctr_it_reg_blk "" UWORD _CNV_A_R_A_165_CM 1 0. 0. 65535. DISPLAY_IDENTIFIER fm_sta_it_reg_blk.Vxx_dfctr_xxx ECU_ADDRESS 0xc000011e /end MEASUREMENT
/begin MEASUREMENT Vxx_rdn_it_reg_blk "" UWORD _CNV_A_R_A_165_CM 1 0. 0. 65535. DISPLAY_IDENTIFIER fm_sta_it_reg_blk.Vxx_rdn_xxx ECU_ADDRESS 0xc0000120 /end MEASUREMENT
/begin MEASUREMENT Vbx_cf_it_reg_blk "" UBYTE _CNV_A_R_A_165_CM 1 0. 0. 255. DISPLAY_IDENTIFIER fm_sta_it_reg_blk.fm_static_bitfield.Vbx_cf_xxx ECU_ADDRESS 0xc0000122 BIT_MASK 0x1 /end MEASUREMENT
/begin MEASUREMENT Vbx_clf_it_reg_blk "" UBYTE _CNV_A_R_A_165_CM 1 0. 0. 255. DISPLAY_IDENTIFIER fm_sta_it_reg_blk.fm_static_bitfield.Vbx_clf_xxx ECU_ADDRESS 0xc0000122 BIT_MASK 0x2 /end MEASUREMENT
/begin MEASUREMENT Vbx_df_old_it_reg_blk "" UBYTE _CNV_A_R_A_165_CM 1 0. 0. 255. DISPLAY_IDENTIFIER fm_sta_it_reg_blk.fm_static_bitfield.Vbx_df_old_xxx ECU_ADDRESS 0xc0000122 BIT_MASK 0x4 /end MEASUREMENT
/begin MEASUREMENT Vbx_dfctr_sat_it_reg_blk "" UBYTE _CNV_A_R_A_165_CM 1 0. 0. 255. DISPLAY_IDENTIFIER fm_sta_it_reg_blk.fm_static_bitfield.Vbx_dfctr_sat_xxx ECU_ADDRESS 0xc0000122 BIT_MASK 0x8 /end MEASUREMENT
/begin MEASUREMENT Vbx_rdn_it_reg_blk "" UBYTE _CNV_A_R_A_165_CM 1 0. 0. 255. DISPLAY_IDENTIFIER fm_sta_it_reg_blk.fm_static_bitfield.Vbx_rdn_xxx ECU_ADDRESS 0xc0000122 BIT_MASK 0x40 /end MEASUREMENT
/begin MEASUREMENT Vxx_dtc_stt_it_reg_blk "" UBYTE _CNV_A_R_A_165_CM 1 0. 0. 255. DISPLAY_IDENTIFIER fm_sta_it_reg_blk.Vxx_dtc_stt_xxx ECU_ADDRESS 0xc0000123 /end MEASUREMENT
/begin MEASUREMENT Vxx_dfctr_knk_oor "" UWORD _CNV_A_R_A_165_CM 1 0. 0. 65535. DISPLAY_IDENTIFIER fm_sta_knk_oor.Vxx_dfctr_xxx ECU_ADDRESS 0xc0000124 /end MEASUREMENT
/begin MEASUREMENT Vxx_rdn_knk_oor "" UWORD _CNV_A_R_A_165_CM 1 0. 0. 65535. DISPLAY_IDENTIFIER fm_sta_knk_oor.Vxx_rdn_xxx ECU_ADDRESS 0xc0000126 /end MEASUREMENT
/begin MEASUREMENT Vbx_cf_knk_oor "" UBYTE _CNV_A_R_A_165_CM 1 0. 0. 255. DISPLAY_IDENTIFIER fm_sta_knk_oor.fm_static_bitfield.Vbx_cf_xxx ECU_ADDRESS 0xc0000128 BIT_MASK 0x1 /end MEASUREMENT
/begin MEASUREMENT Vbx_clf_knk_oor "" UBYTE _CNV_A_R_A_165_CM 1 0. 0. 255. DISPLAY_IDENTIFIER fm_sta_knk_oor.fm_static_bitfield.Vbx_clf_xxx ECU_ADDRESS 0xc0000128 BIT_MASK 0x2 /end MEASUREMENT
/begin MEASUREMENT Vbx_df_old_knk_oor "" UBYTE _CNV_A_R_A_165_CM 1 0. 0. 255. DISPLAY_IDENTIFIER fm_sta_knk_oor.fm_static_bitfield.Vbx_df_old_xxx ECU_ADDRESS 0xc0000128 BIT_MASK 0x4 /end MEASUREMENT
/begin MEASUREMENT Vbx_dfctr_sat_knk_oor "" UBYTE _CNV_A_R_A_165_CM 1 0. 0. 255. DISPLAY_IDENTIFIER fm_sta_knk_oor.fm_static_bitfield.Vbx_dfctr_sat_xxx ECU_ADDRESS 0xc0000128 BIT_MASK 0x8 /end MEASUREMENT
/begin MEASUREMENT Vbx_rdn_knk_oor "" UBYTE _CNV_A_R_A_165_CM 1 0. 0. 255. DISPLAY_IDENTIFIER fm_sta_knk_oor.fm_static_bitfield.Vbx_rdn_xxx ECU_ADDRESS 0xc0000128 BIT_MASK 0x40 /end MEASUREMENT
/begin MEASUREMENT Vxx_dtc_stt_knk_oor "" UBYTE _CNV_A_R_A_165_CM 1 0. 0. 255. DISPLAY_IDENTIFIER fm_sta_knk_oor.Vxx_dtc_stt_xxx ECU_ADDRESS 0xc0000129 /end MEASUREMENT
/begin MEASUREMENT Vxx_dfctr_knk_shp "" UWORD _CNV_A_R_A_165_CM 1 0. 0. 65535. DISPLAY_IDENTIFIER fm_sta_knk_shp.Vxx_dfctr_xxx ECU_ADDRESS 0xc000012a /end MEASUREMENT
/begin MEASUREMENT Vxx_rdn_knk_shp "" UWORD _CNV_A_R_A_165_CM 1 0. 0. 65535. DISPLAY_IDENTIFIER fm_sta_knk_shp.Vxx_rdn_xxx ECU_ADDRESS 0xc000012c /end MEASUREMENT
/begin MEASUREMENT Vbx_cf_knk_shp "" UBYTE _CNV_A_R_A_165_CM 1 0. 0. 255. DISPLAY_IDENTIFIER fm_sta_knk_shp.fm_static_bitfield.Vbx_cf_xxx ECU_ADDRESS 0xc000012e BIT_MASK 0x1 /end MEASUREMENT
/begin MEASUREMENT Vbx_clf_knk_shp "" UBYTE _CNV_A_R_A_165_CM 1 0. 0. 255. DISPLAY_IDENTIFIER fm_sta_knk_shp.fm_static_bitfield.Vbx_clf_xxx ECU_ADDRESS 0xc000012e BIT_MASK 0x2 /end MEASUREMENT
/begin MEASUREMENT Vbx_df_old_knk_shp "" UBYTE _CNV_A_R_A_165_CM 1 0. 0. 255. DISPLAY_IDENTIFIER fm_sta_knk_shp.fm_static_bitfield.Vbx_df_old_xxx ECU_ADDRESS 0xc000012e BIT_MASK 0x4 /end MEASUREMENT
/begin MEASUREMENT Vbx_dfctr_sat_knk_shp "" UBYTE _CNV_A_R_A_165_CM 1 0. 0. 255. DISPLAY_IDENTIFIER fm_sta_knk_shp.fm_static_bitfield.Vbx_dfctr_sat_xxx ECU_ADDRESS 0xc000012e BIT_MASK 0x8 /end MEASUREMENT
/begin MEASUREMENT Vbx_rdn_knk_shp "" UBYTE _CNV_A_R_A_165_CM 1 0. 0. 255. DISPLAY_IDENTIFIER fm_sta_knk_shp.fm_static_bitfield.Vbx_rdn_xxx ECU_ADDRESS 0xc000012e BIT_MASK 0x40 /end MEASUREMENT
/begin MEASUREMENT Vxx_dtc_stt_knk_shp "" UBYTE _CNV_A_R_A_165_CM 1 0. 0. 255. DISPLAY_IDENTIFIER fm_sta_knk_shp.Vxx_dtc_stt_xxx ECU_ADDRESS 0xc000012f /end MEASUREMENT
/begin MEASUREMENT Vxx_dfctr_lbdw_hot_oc "" UWORD _CNV_A_R_A_165_CM 1 0. 0. 65535. DISPLAY_IDENTIFIER fm_sta_lbdw_hot_oc.Vxx_dfctr_xxx ECU_ADDRESS 0xc000023e /end MEASUREMENT
/begin MEASUREMENT Vxx_rdn_lbdw_hot_oc "" UWORD _CNV_A_R_A_165_CM 1 0. 0. 65535. DISPLAY_IDENTIFIER fm_sta_lbdw_hot_oc.Vxx_rdn_xxx ECU_ADDRESS 0xc0000240 /end MEASUREMENT
/begin MEASUREMENT Vbx_cf_lbdw_hot_oc "" UBYTE _CNV_A_R_A_165_CM 1 0. 0. 255. DISPLAY_IDENTIFIER fm_sta_lbdw_hot_oc.fm_static_bitfield.Vbx_cf_xxx ECU_ADDRESS 0xc0000242 BIT_MASK 0x1 /end MEASUREMENT
/begin MEASUREMENT Vbx_clf_lbdw_hot_oc "" UBYTE _CNV_A_R_A_165_CM 1 0. 0. 255. DISPLAY_IDENTIFIER fm_sta_lbdw_hot_oc.fm_static_bitfield.Vbx_clf_xxx ECU_ADDRESS 0xc0000242 BIT_MASK 0x2 /end MEASUREMENT
/begin MEASUREMENT Vbx_df_old_lbdw_hot_oc "" UBYTE _CNV_A_R_A_165_CM 1 0. 0. 255. DISPLAY_IDENTIFIER fm_sta_lbdw_hot_oc.fm_static_bitfield.Vbx_df_old_xxx ECU_ADDRESS 0xc0000242 BIT_MASK 0x4 /end MEASUREMENT
/begin MEASUREMENT Vbx_dfctr_sat_lbdw_hot_oc "" UBYTE _CNV_A_R_A_165_CM 1 0. 0. 255. DISPLAY_IDENTIFIER fm_sta_lbdw_hot_oc.fm_static_bitfield.Vbx_dfctr_sat_xxx ECU_ADDRESS 0xc0000242 BIT_MASK 0x8 /end MEASUREMENT
/begin MEASUREMENT Vbx_rdn_lbdw_hot_oc "" UBYTE _CNV_A_R_A_165_CM 1 0. 0. 255. DISPLAY_IDENTIFIER fm_sta_lbdw_hot_oc.fm_static_bitfield.Vbx_rdn_xxx ECU_ADDRESS 0xc0000242 BIT_MASK 0x40 /end MEASUREMENT
/begin MEASUREMENT Vxx_dtc_stt_lbdw_hot_oc "" UBYTE _CNV_A_R_A_165_CM 1 0. 0. 255. DISPLAY_IDENTIFIER fm_sta_lbdw_hot_oc.Vxx_dtc_stt_xxx ECU_ADDRESS 0xc0000243 /end MEASUREMENT
/begin MEASUREMENT Vxx_dfctr_lbdw_hot_scg "" UWORD _CNV_A_R_A_165_CM 1 0. 0. 65535. DISPLAY_IDENTIFIER fm_sta_lbdw_hot_scg.Vxx_dfctr_xxx ECU_ADDRESS 0xc0000244 /end MEASUREMENT
/begin MEASUREMENT Vxx_rdn_lbdw_hot_scg "" UWORD _CNV_A_R_A_165_CM 1 0. 0. 65535. DISPLAY_IDENTIFIER fm_sta_lbdw_hot_scg.Vxx_rdn_xxx ECU_ADDRESS 0xc0000246 /end MEASUREMENT
/begin MEASUREMENT Vbx_cf_lbdw_hot_scg "" UBYTE _CNV_A_R_A_165_CM 1 0. 0. 255. DISPLAY_IDENTIFIER fm_sta_lbdw_hot_scg.fm_static_bitfield.Vbx_cf_xxx ECU_ADDRESS 0xc0000248 BIT_MASK 0x1 /end MEASUREMENT
/begin MEASUREMENT Vbx_clf_lbdw_hot_scg "" UBYTE _CNV_A_R_A_165_CM 1 0. 0. 255. DISPLAY_IDENTIFIER fm_sta_lbdw_hot_scg.fm_static_bitfield.Vbx_clf_xxx ECU_ADDRESS 0xc0000248 BIT_MASK 0x2 /end MEASUREMENT
/begin MEASUREMENT Vbx_df_old_lbdw_hot_scg "" UBYTE _CNV_A_R_A_165_CM 1 0. 0. 255. DISPLAY_IDENTIFIER fm_sta_lbdw_hot_scg.fm_static_bitfield.Vbx_df_old_xxx ECU_ADDRESS 0xc0000248 BIT_MASK 0x4 /end MEASUREMENT
/begin MEASUREMENT Vbx_dfctr_sat_lbdw_hot_scg "" UBYTE _CNV_A_R_A_165_CM 1 0. 0. 255. DISPLAY_IDENTIFIER fm_sta_lbdw_hot_scg.fm_static_bitfield.Vbx_dfctr_sat_xxx ECU_ADDRESS 0xc0000248 BIT_MASK 0x8 /end MEASUREMENT
/begin MEASUREMENT Vbx_rdn_lbdw_hot_scg "" UBYTE _CNV_A_R_A_165_CM 1 0. 0. 255. DISPLAY_IDENTIFIER fm_sta_lbdw_hot_scg.fm_static_bitfield.Vbx_rdn_xxx ECU_ADDRESS 0xc0000248 BIT_MASK 0x40 /end MEASUREMENT
/begin MEASUREMENT Vxx_dtc_stt_lbdw_hot_scg "" UBYTE _CNV_A_R_A_165_CM 1 0. 0. 255. DISPLAY_IDENTIFIER fm_sta_lbdw_hot_scg.Vxx_dtc_stt_xxx ECU_ADDRESS 0xc0000249 /end MEASUREMENT
/begin MEASUREMENT Vxx_dfctr_lbdw_hot_scw "" UWORD _CNV_A_R_A_165_CM 1 0. 0. 65535. DISPLAY_IDENTIFIER fm_sta_lbdw_hot_scw.Vxx_dfctr_xxx ECU_ADDRESS 0xc000024a /end MEASUREMENT
/begin MEASUREMENT Vxx_rdn_lbdw_hot_scw "" UWORD _CNV_A_R_A_165_CM 1 0. 0. 65535. DISPLAY_IDENTIFIER fm_sta_lbdw_hot_scw.Vxx_rdn_xxx ECU_ADDRESS 0xc000024c /end MEASUREMENT
/begin MEASUREMENT Vbx_cf_lbdw_hot_scw "" UBYTE _CNV_A_R_A_165_CM 1 0. 0. 255. DISPLAY_IDENTIFIER fm_sta_lbdw_hot_scw.fm_static_bitfield.Vbx_cf_xxx ECU_ADDRESS 0xc000024e BIT_MASK 0x1 /end MEASUREMENT
/begin MEASUREMENT Vbx_clf_lbdw_hot_scw "" UBYTE _CNV_A_R_A_165_CM 1 0. 0. 255. DISPLAY_IDENTIFIER fm_sta_lbdw_hot_scw.fm_static_bitfield.Vbx_clf_xxx ECU_ADDRESS 0xc000024e BIT_MASK 0x2 /end MEASUREMENT
/begin MEASUREMENT Vbx_df_old_lbdw_hot_scw "" UBYTE _CNV_A_R_A_165_CM 1 0. 0. 255. DISPLAY_IDENTIFIER fm_sta_lbdw_hot_scw.fm_static_bitfield.Vbx_df_old_xxx ECU_ADDRESS 0xc000024e BIT_MASK 0x4 /end MEASUREMENT
/begin MEASUREMENT Vbx_dfctr_sat_lbdw_hot_scw "" UBYTE _CNV_A_R_A_165_CM 1 0. 0. 255. DISPLAY_IDENTIFIER fm_sta_lbdw_hot_scw.fm_static_bitfield.Vbx_dfctr_sat_xxx ECU_ADDRESS 0xc000024e BIT_MASK 0x8 /end MEASUREMENT
/begin MEASUREMENT Vbx_rdn_lbdw_hot_scw "" UBYTE _CNV_A_R_A_165_CM 1 0. 0. 255. DISPLAY_IDENTIFIER fm_sta_lbdw_hot_scw.fm_static_bitfield.Vbx_rdn_xxx ECU_ADDRESS 0xc000024e BIT_MASK 0x40 /end MEASUREMENT
/begin MEASUREMENT Vxx_dtc_stt_lbdw_hot_scw "" UBYTE _CNV_A_R_A_165_CM 1 0. 0. 255. DISPLAY_IDENTIFIER fm_sta_lbdw_hot_scw.Vxx_dtc_stt_xxx ECU_ADDRESS 0xc000024f /end MEASUREMENT
/begin MEASUREMENT Vxx_dfctr_lbdw_oc "" UWORD _CNV_A_R_A_165_CM 1 0. 0. 65535. DISPLAY_IDENTIFIER fm_sta_lbdw_oc.Vxx_dfctr_xxx ECU_ADDRESS 0xc0000130 /end MEASUREMENT
/begin MEASUREMENT Vxx_rdn_lbdw_oc "" UWORD _CNV_A_R_A_165_CM 1 0. 0. 65535. DISPLAY_IDENTIFIER fm_sta_lbdw_oc.Vxx_rdn_xxx ECU_ADDRESS 0xc0000132 /end MEASUREMENT
/begin MEASUREMENT Vbx_cf_lbdw_oc "" UBYTE _CNV_A_R_A_165_CM 1 0. 0. 255. DISPLAY_IDENTIFIER fm_sta_lbdw_oc.fm_static_bitfield.Vbx_cf_xxx ECU_ADDRESS 0xc0000134 BIT_MASK 0x1 /end MEASUREMENT
/begin MEASUREMENT Vbx_clf_lbdw_oc "" UBYTE _CNV_A_R_A_165_CM 1 0. 0. 255. DISPLAY_IDENTIFIER fm_sta_lbdw_oc.fm_static_bitfield.Vbx_clf_xxx ECU_ADDRESS 0xc0000134 BIT_MASK 0x2 /end MEASUREMENT
/begin MEASUREMENT Vbx_df_old_lbdw_oc "" UBYTE _CNV_A_R_A_165_CM 1 0. 0. 255. DISPLAY_IDENTIFIER fm_sta_lbdw_oc.fm_static_bitfield.Vbx_df_old_xxx ECU_ADDRESS 0xc0000134 BIT_MASK 0x4 /end MEASUREMENT
/begin MEASUREMENT Vbx_dfctr_sat_lbdw_oc "" UBYTE _CNV_A_R_A_165_CM 1 0. 0. 255. DISPLAY_IDENTIFIER fm_sta_lbdw_oc.fm_static_bitfield.Vbx_dfctr_sat_xxx ECU_ADDRESS 0xc0000134 BIT_MASK 0x8 /end MEASUREMENT
/begin MEASUREMENT Vbx_rdn_lbdw_oc "" UBYTE _CNV_A_R_A_165_CM 1 0. 0. 255. DISPLAY_IDENTIFIER fm_sta_lbdw_oc.fm_static_bitfield.Vbx_rdn_xxx ECU_ADDRESS 0xc0000134 BIT_MASK 0x40 /end MEASUREMENT
/begin MEASUREMENT Vxx_dtc_stt_lbdw_oc "" UBYTE _CNV_A_R_A_165_CM 1 0. 0. 255. DISPLAY_IDENTIFIER fm_sta_lbdw_oc.Vxx_dtc_stt_xxx ECU_ADDRESS 0xc0000135 /end MEASUREMENT
/begin MEASUREMENT Vxx_dfctr_lbdw_scg "" UWORD _CNV_A_R_A_165_CM 1 0. 0. 65535. DISPLAY_IDENTIFIER fm_sta_lbdw_scg.Vxx_dfctr_xxx ECU_ADDRESS 0xc0000136 /end MEASUREMENT
/begin MEASUREMENT Vxx_rdn_lbdw_scg "" UWORD _CNV_A_R_A_165_CM 1 0. 0. 65535. DISPLAY_IDENTIFIER fm_sta_lbdw_scg.Vxx_rdn_xxx ECU_ADDRESS 0xc0000138 /end MEASUREMENT
/begin MEASUREMENT Vbx_cf_lbdw_scg "" UBYTE _CNV_A_R_A_165_CM 1 0. 0. 255. DISPLAY_IDENTIFIER fm_sta_lbdw_scg.fm_static_bitfield.Vbx_cf_xxx ECU_ADDRESS 0xc000013a BIT_MASK 0x1 /end MEASUREMENT
/begin MEASUREMENT Vbx_clf_lbdw_scg "" UBYTE _CNV_A_R_A_165_CM 1 0. 0. 255. DISPLAY_IDENTIFIER fm_sta_lbdw_scg.fm_static_bitfield.Vbx_clf_xxx ECU_ADDRESS 0xc000013a BIT_MASK 0x2 /end MEASUREMENT
/begin MEASUREMENT Vbx_df_old_lbdw_scg "" UBYTE _CNV_A_R_A_165_CM 1 0. 0. 255. DISPLAY_IDENTIFIER fm_sta_lbdw_scg.fm_static_bitfield.Vbx_df_old_xxx ECU_ADDRESS 0xc000013a BIT_MASK 0x4 /end MEASUREMENT
/begin MEASUREMENT Vbx_dfctr_sat_lbdw_scg "" UBYTE _CNV_A_R_A_165_CM 1 0. 0. 255. DISPLAY_IDENTIFIER fm_sta_lbdw_scg.fm_static_bitfield.Vbx_dfctr_sat_xxx ECU_ADDRESS 0xc000013a BIT_MASK 0x8 /end MEASUREMENT
/begin MEASUREMENT Vbx_rdn_lbdw_scg "" UBYTE _CNV_A_R_A_165_CM 1 0. 0. 255. DISPLAY_IDENTIFIER fm_sta_lbdw_scg.fm_static_bitfield.Vbx_rdn_xxx ECU_ADDRESS 0xc000013a BIT_MASK 0x40 /end MEASUREMENT
/begin MEASUREMENT Vxx_dtc_stt_lbdw_scg "" UBYTE _CNV_A_R_A_165_CM 1 0. 0. 255. DISPLAY_IDENTIFIER fm_sta_lbdw_scg.Vxx_dtc_stt_xxx ECU_ADDRESS 0xc000013b /end MEASUREMENT
/begin MEASUREMENT Vxx_dfctr_lbdw_scw "" UWORD _CNV_A_R_A_165_CM 1 0. 0. 65535. DISPLAY_IDENTIFIER fm_sta_lbdw_scw.Vxx_dfctr_xxx ECU_ADDRESS 0xc000013c /end MEASUREMENT
/begin MEASUREMENT Vxx_rdn_lbdw_scw "" UWORD _CNV_A_R_A_165_CM 1 0. 0. 65535. DISPLAY_IDENTIFIER fm_sta_lbdw_scw.Vxx_rdn_xxx ECU_ADDRESS 0xc000013e /end MEASUREMENT
/begin MEASUREMENT Vbx_cf_lbdw_scw "" UBYTE _CNV_A_R_A_165_CM 1 0. 0. 255. DISPLAY_IDENTIFIER fm_sta_lbdw_scw.fm_static_bitfield.Vbx_cf_xxx ECU_ADDRESS 0xc0000140 BIT_MASK 0x1 /end MEASUREMENT
/begin MEASUREMENT Vbx_clf_lbdw_scw "" UBYTE _CNV_A_R_A_165_CM 1 0. 0. 255. DISPLAY_IDENTIFIER fm_sta_lbdw_scw.fm_static_bitfield.Vbx_clf_xxx ECU_ADDRESS 0xc0000140 BIT_MASK 0x2 /end MEASUREMENT
/begin MEASUREMENT Vbx_df_old_lbdw_scw "" UBYTE _CNV_A_R_A_165_CM 1 0. 0. 255. DISPLAY_IDENTIFIER fm_sta_lbdw_scw.fm_static_bitfield.Vbx_df_old_xxx ECU_ADDRESS 0xc0000140 BIT_MASK 0x4 /end MEASUREMENT
/begin MEASUREMENT Vbx_dfctr_sat_lbdw_scw "" UBYTE _CNV_A_R_A_165_CM 1 0. 0. 255. DISPLAY_IDENTIFIER fm_sta_lbdw_scw.fm_static_bitfield.Vbx_dfctr_sat_xxx ECU_ADDRESS 0xc0000140 BIT_MASK 0x8 /end MEASUREMENT
/begin MEASUREMENT Vbx_rdn_lbdw_scw "" UBYTE _CNV_A_R_A_165_CM 1 0. 0. 255. DISPLAY_IDENTIFIER fm_sta_lbdw_scw.fm_static_bitfield.Vbx_rdn_xxx ECU_ADDRESS 0xc0000140 BIT_MASK 0x40 /end MEASUREMENT
/begin MEASUREMENT Vxx_dtc_stt_lbdw_scw "" UBYTE _CNV_A_R_A_165_CM 1 0. 0. 255. DISPLAY_IDENTIFIER fm_sta_lbdw_scw.Vxx_dtc_stt_xxx ECU_ADDRESS 0xc0000141 /end MEASUREMENT
/begin MEASUREMENT Vxx_dfctr_lbup_cpt "" UWORD _CNV_A_R_A_165_CM 1 0. 0. 65535. DISPLAY_IDENTIFIER fm_sta_lbup_cpt.Vxx_dfctr_xxx ECU_ADDRESS 0xc0000364 /end MEASUREMENT
/begin MEASUREMENT Vxx_rdn_lbup_cpt "" UWORD _CNV_A_R_A_165_CM 1 0. 0. 65535. DISPLAY_IDENTIFIER fm_sta_lbup_cpt.Vxx_rdn_xxx ECU_ADDRESS 0xc0000366 /end MEASUREMENT
/begin MEASUREMENT Vbx_cf_lbup_cpt "" UBYTE _CNV_A_R_A_165_CM 1 0. 0. 255. DISPLAY_IDENTIFIER fm_sta_lbup_cpt.fm_static_bitfield.Vbx_cf_xxx ECU_ADDRESS 0xc0000368 BIT_MASK 0x1 /end MEASUREMENT
/begin MEASUREMENT Vbx_clf_lbup_cpt "" UBYTE _CNV_A_R_A_165_CM 1 0. 0. 255. DISPLAY_IDENTIFIER fm_sta_lbup_cpt.fm_static_bitfield.Vbx_clf_xxx ECU_ADDRESS 0xc0000368 BIT_MASK 0x2 /end MEASUREMENT
/begin MEASUREMENT Vbx_df_old_lbup_cpt "" UBYTE _CNV_A_R_A_165_CM 1 0. 0. 255. DISPLAY_IDENTIFIER fm_sta_lbup_cpt.fm_static_bitfield.Vbx_df_old_xxx ECU_ADDRESS 0xc0000368 BIT_MASK 0x4 /end MEASUREMENT
/begin MEASUREMENT Vbx_dfctr_sat_lbup_cpt "" UBYTE _CNV_A_R_A_165_CM 1 0. 0. 255. DISPLAY_IDENTIFIER fm_sta_lbup_cpt.fm_static_bitfield.Vbx_dfctr_sat_xxx ECU_ADDRESS 0xc0000368 BIT_MASK 0x8 /end MEASUREMENT
/begin MEASUREMENT Vbx_rdn_lbup_cpt "" UBYTE _CNV_A_R_A_165_CM 1 0. 0. 255. DISPLAY_IDENTIFIER fm_sta_lbup_cpt.fm_static_bitfield.Vbx_rdn_xxx ECU_ADDRESS 0xc0000368 BIT_MASK 0x40 /end MEASUREMENT
/begin MEASUREMENT Vxx_dtc_stt_lbup_cpt "" UBYTE _CNV_A_R_A_165_CM 1 0. 0. 255. DISPLAY_IDENTIFIER fm_sta_lbup_cpt.Vxx_dtc_stt_xxx ECU_ADDRESS 0xc0000369 /end MEASUREMENT
/begin MEASUREMENT Vxx_dfctr_lbup_hot_apl_down "" UWORD _CNV_A_R_A_165_CM 1 0. 0. 65535. DISPLAY_IDENTIFIER fm_sta_lbup_hot_apl_down.Vxx_dfctr_xxx ECU_ADDRESS 0xc000040c /end MEASUREMENT
/begin MEASUREMENT Vxx_rdn_lbup_hot_apl_down "" UWORD _CNV_A_R_A_165_CM 1 0. 0. 65535. DISPLAY_IDENTIFIER fm_sta_lbup_hot_apl_down.Vxx_rdn_xxx ECU_ADDRESS 0xc000040e /end MEASUREMENT
/begin MEASUREMENT Vbx_cf_lbup_hot_apl_down "" UBYTE _CNV_A_R_A_165_CM 1 0. 0. 255. DISPLAY_IDENTIFIER fm_sta_lbup_hot_apl_down.fm_static_bitfield.Vbx_cf_xxx ECU_ADDRESS 0xc0000410 BIT_MASK 0x1 /end MEASUREMENT
/begin MEASUREMENT Vbx_clf_lbup_hot_apl_down "" UBYTE _CNV_A_R_A_165_CM 1 0. 0. 255. DISPLAY_IDENTIFIER fm_sta_lbup_hot_apl_down.fm_static_bitfield.Vbx_clf_xxx ECU_ADDRESS 0xc0000410 BIT_MASK 0x2 /end MEASUREMENT
/begin MEASUREMENT Vbx_df_old_lbup_hot_apl_down "" UBYTE _CNV_A_R_A_165_CM 1 0. 0. 255. DISPLAY_IDENTIFIER fm_sta_lbup_hot_apl_down.fm_static_bitfield.Vbx_df_old_xxx ECU_ADDRESS 0xc0000410 BIT_MASK 0x4 /end MEASUREMENT
/begin MEASUREMENT Vbx_dfctr_sat_lbup_hot_apl_down "" UBYTE _CNV_A_R_A_165_CM 1 0. 0. 255. DISPLAY_IDENTIFIER fm_sta_lbup_hot_apl_down.fm_static_bitfield.Vbx_dfctr_sat_xxx ECU_ADDRESS 0xc0000410 BIT_MASK 0x8 /end MEASUREMENT
/begin MEASUREMENT Vbx_rdn_lbup_hot_apl_down "" UBYTE _CNV_A_R_A_165_CM 1 0. 0. 255. DISPLAY_IDENTIFIER fm_sta_lbup_hot_apl_down.fm_static_bitfield.Vbx_rdn_xxx ECU_ADDRESS 0xc0000410 BIT_MASK 0x40 /end MEASUREMENT
/begin MEASUREMENT Vxx_dtc_stt_lbup_hot_apl_down "" UBYTE _CNV_A_R_A_165_CM 1 0. 0. 255. DISPLAY_IDENTIFIER fm_sta_lbup_hot_apl_down.Vxx_dtc_stt_xxx ECU_ADDRESS 0xc0000411 /end MEASUREMENT
/begin MEASUREMENT Vxx_dfctr_lbup_hot_oc "" UWORD _CNV_A_R_A_165_CM 1 0. 0. 65535. DISPLAY_IDENTIFIER fm_sta_lbup_hot_oc.Vxx_dfctr_xxx ECU_ADDRESS 0xc0000250 /end MEASUREMENT
/begin MEASUREMENT Vxx_rdn_lbup_hot_oc "" UWORD _CNV_A_R_A_165_CM 1 0. 0. 65535. DISPLAY_IDENTIFIER fm_sta_lbup_hot_oc.Vxx_rdn_xxx ECU_ADDRESS 0xc0000252 /end MEASUREMENT
/begin MEASUREMENT Vbx_cf_lbup_hot_oc "" UBYTE _CNV_A_R_A_165_CM 1 0. 0. 255. DISPLAY_IDENTIFIER fm_sta_lbup_hot_oc.fm_static_bitfield.Vbx_cf_xxx ECU_ADDRESS 0xc0000254 BIT_MASK 0x1 /end MEASUREMENT
/begin MEASUREMENT Vbx_clf_lbup_hot_oc "" UBYTE _CNV_A_R_A_165_CM 1 0. 0. 255. DISPLAY_IDENTIFIER fm_sta_lbup_hot_oc.fm_static_bitfield.Vbx_clf_xxx ECU_ADDRESS 0xc0000254 BIT_MASK 0x2 /end MEASUREMENT
/begin MEASUREMENT Vbx_df_old_lbup_hot_oc "" UBYTE _CNV_A_R_A_165_CM 1 0. 0. 255. DISPLAY_IDENTIFIER fm_sta_lbup_hot_oc.fm_static_bitfield.Vbx_df_old_xxx ECU_ADDRESS 0xc0000254 BIT_MASK 0x4 /end MEASUREMENT
/begin MEASUREMENT Vbx_dfctr_sat_lbup_hot_oc "" UBYTE _CNV_A_R_A_165_CM 1 0. 0. 255. DISPLAY_IDENTIFIER fm_sta_lbup_hot_oc.fm_static_bitfield.Vbx_dfctr_sat_xxx ECU_ADDRESS 0xc0000254 BIT_MASK 0x8 /end MEASUREMENT
/begin MEASUREMENT Vbx_rdn_lbup_hot_oc "" UBYTE _CNV_A_R_A_165_CM 1 0. 0. 255. DISPLAY_IDENTIFIER fm_sta_lbup_hot_oc.fm_static_bitfield.Vbx_rdn_xxx ECU_ADDRESS 0xc0000254 BIT_MASK 0x40 /end MEASUREMENT
/begin MEASUREMENT Vxx_dtc_stt_lbup_hot_oc "" UBYTE _CNV_A_R_A_165_CM 1 0. 0. 255. DISPLAY_IDENTIFIER fm_sta_lbup_hot_oc.Vxx_dtc_stt_xxx ECU_ADDRESS 0xc0000255 /end MEASUREMENT
/begin MEASUREMENT Vxx_dfctr_lbup_hot_scg "" UWORD _CNV_A_R_A_165_CM 1 0. 0. 65535. DISPLAY_IDENTIFIER fm_sta_lbup_hot_scg.Vxx_dfctr_xxx ECU_ADDRESS 0xc0000256 /end MEASUREMENT
/begin MEASUREMENT Vxx_rdn_lbup_hot_scg "" UWORD _CNV_A_R_A_165_CM 1 0. 0. 65535. DISPLAY_IDENTIFIER fm_sta_lbup_hot_scg.Vxx_rdn_xxx ECU_ADDRESS 0xc0000258 /end MEASUREMENT
/begin MEASUREMENT Vbx_cf_lbup_hot_scg "" UBYTE _CNV_A_R_A_165_CM 1 0. 0. 255. DISPLAY_IDENTIFIER fm_sta_lbup_hot_scg.fm_static_bitfield.Vbx_cf_xxx ECU_ADDRESS 0xc000025a BIT_MASK 0x1 /end MEASUREMENT
/begin MEASUREMENT Vbx_clf_lbup_hot_scg "" UBYTE _CNV_A_R_A_165_CM 1 0. 0. 255. DISPLAY_IDENTIFIER fm_sta_lbup_hot_scg.fm_static_bitfield.Vbx_clf_xxx ECU_ADDRESS 0xc000025a BIT_MASK 0x2 /end MEASUREMENT
/begin MEASUREMENT Vbx_df_old_lbup_hot_scg "" UBYTE _CNV_A_R_A_165_CM 1 0. 0. 255. DISPLAY_IDENTIFIER fm_sta_lbup_hot_scg.fm_static_bitfield.Vbx_df_old_xxx ECU_ADDRESS 0xc000025a BIT_MASK 0x4 /end MEASUREMENT
/begin MEASUREMENT Vbx_dfctr_sat_lbup_hot_scg "" UBYTE _CNV_A_R_A_165_CM 1 0. 0. 255. DISPLAY_IDENTIFIER fm_sta_lbup_hot_scg.fm_static_bitfield.Vbx_dfctr_sat_xxx ECU_ADDRESS 0xc000025a BIT_MASK 0x8 /end MEASUREMENT
/begin MEASUREMENT Vbx_rdn_lbup_hot_scg "" UBYTE _CNV_A_R_A_165_CM 1 0. 0. 255. DISPLAY_IDENTIFIER fm_sta_lbup_hot_scg.fm_static_bitfield.Vbx_rdn_xxx ECU_ADDRESS 0xc000025a BIT_MASK 0x40 /end MEASUREMENT
/begin MEASUREMENT Vxx_dtc_stt_lbup_hot_scg "" UBYTE _CNV_A_R_A_165_CM 1 0. 0. 255. DISPLAY_IDENTIFIER fm_sta_lbup_hot_scg.Vxx_dtc_stt_xxx ECU_ADDRESS 0xc000025b /end MEASUREMENT
/begin MEASUREMENT Vxx_dfctr_lbup_hot_scw "" UWORD _CNV_A_R_A_165_CM 1 0. 0. 65535. DISPLAY_IDENTIFIER fm_sta_lbup_hot_scw.Vxx_dfctr_xxx ECU_ADDRESS 0xc000025c /end MEASUREMENT
/begin MEASUREMENT Vxx_rdn_lbup_hot_scw "" UWORD _CNV_A_R_A_165_CM 1 0. 0. 65535. DISPLAY_IDENTIFIER fm_sta_lbup_hot_scw.Vxx_rdn_xxx ECU_ADDRESS 0xc000025e /end MEASUREMENT
/begin MEASUREMENT Vbx_cf_lbup_hot_scw "" UBYTE _CNV_A_R_A_165_CM 1 0. 0. 255. DISPLAY_IDENTIFIER fm_sta_lbup_hot_scw.fm_static_bitfield.Vbx_cf_xxx ECU_ADDRESS 0xc0000260 BIT_MASK 0x1 /end MEASUREMENT
/begin MEASUREMENT Vbx_clf_lbup_hot_scw "" UBYTE _CNV_A_R_A_165_CM 1 0. 0. 255. DISPLAY_IDENTIFIER fm_sta_lbup_hot_scw.fm_static_bitfield.Vbx_clf_xxx ECU_ADDRESS 0xc0000260 BIT_MASK 0x2 /end MEASUREMENT
/begin MEASUREMENT Vbx_df_old_lbup_hot_scw "" UBYTE _CNV_A_R_A_165_CM 1 0. 0. 255. DISPLAY_IDENTIFIER fm_sta_lbup_hot_scw.fm_static_bitfield.Vbx_df_old_xxx ECU_ADDRESS 0xc0000260 BIT_MASK 0x4 /end MEASUREMENT
/begin MEASUREMENT Vbx_dfctr_sat_lbup_hot_scw "" UBYTE _CNV_A_R_A_165_CM 1 0. 0. 255. DISPLAY_IDENTIFIER fm_sta_lbup_hot_scw.fm_static_bitfield.Vbx_dfctr_sat_xxx ECU_ADDRESS 0xc0000260 BIT_MASK 0x8 /end MEASUREMENT
/begin MEASUREMENT Vbx_rdn_lbup_hot_scw "" UBYTE _CNV_A_R_A_165_CM 1 0. 0. 255. DISPLAY_IDENTIFIER fm_sta_lbup_hot_scw.fm_static_bitfield.Vbx_rdn_xxx ECU_ADDRESS 0xc0000260 BIT_MASK 0x40 /end MEASUREMENT
/begin MEASUREMENT Vxx_dtc_stt_lbup_hot_scw "" UBYTE _CNV_A_R_A_165_CM 1 0. 0. 255. DISPLAY_IDENTIFIER fm_sta_lbup_hot_scw.Vxx_dtc_stt_xxx ECU_ADDRESS 0xc0000261 /end MEASUREMENT
/begin MEASUREMENT Vxx_dfctr_lbup_nok "" UWORD _CNV_A_R_A_165_CM 1 0. 0. 65535. DISPLAY_IDENTIFIER fm_sta_lbup_nok.Vxx_dfctr_xxx ECU_ADDRESS 0xc0000406 /end MEASUREMENT
/begin MEASUREMENT Vxx_rdn_lbup_nok "" UWORD _CNV_A_R_A_165_CM 1 0. 0. 65535. DISPLAY_IDENTIFIER fm_sta_lbup_nok.Vxx_rdn_xxx ECU_ADDRESS 0xc0000408 /end MEASUREMENT
/begin MEASUREMENT Vbx_cf_lbup_nok "" UBYTE _CNV_A_R_A_165_CM 1 0. 0. 255. DISPLAY_IDENTIFIER fm_sta_lbup_nok.fm_static_bitfield.Vbx_cf_xxx ECU_ADDRESS 0xc000040a BIT_MASK 0x1 /end MEASUREMENT
/begin MEASUREMENT Vbx_clf_lbup_nok "" UBYTE _CNV_A_R_A_165_CM 1 0. 0. 255. DISPLAY_IDENTIFIER fm_sta_lbup_nok.fm_static_bitfield.Vbx_clf_xxx ECU_ADDRESS 0xc000040a BIT_MASK 0x2 /end MEASUREMENT
/begin MEASUREMENT Vbx_df_old_lbup_nok "" UBYTE _CNV_A_R_A_165_CM 1 0. 0. 255. DISPLAY_IDENTIFIER fm_sta_lbup_nok.fm_static_bitfield.Vbx_df_old_xxx ECU_ADDRESS 0xc000040a BIT_MASK 0x4 /end MEASUREMENT
/begin MEASUREMENT Vbx_dfctr_sat_lbup_nok "" UBYTE _CNV_A_R_A_165_CM 1 0. 0. 255. DISPLAY_IDENTIFIER fm_sta_lbup_nok.fm_static_bitfield.Vbx_dfctr_sat_xxx ECU_ADDRESS 0xc000040a BIT_MASK 0x8 /end MEASUREMENT
/begin MEASUREMENT Vbx_rdn_lbup_nok "" UBYTE _CNV_A_R_A_165_CM 1 0. 0. 255. DISPLAY_IDENTIFIER fm_sta_lbup_nok.fm_static_bitfield.Vbx_rdn_xxx ECU_ADDRESS 0xc000040a BIT_MASK 0x40 /end MEASUREMENT
/begin MEASUREMENT Vxx_dtc_stt_lbup_nok "" UBYTE _CNV_A_R_A_165_CM 1 0. 0. 255. DISPLAY_IDENTIFIER fm_sta_lbup_nok.Vxx_dtc_stt_xxx ECU_ADDRESS 0xc000040b /end MEASUREMENT
/begin MEASUREMENT Vxx_dfctr_lbup_oc "" UWORD _CNV_A_R_A_165_CM 1 0. 0. 65535. DISPLAY_IDENTIFIER fm_sta_lbup_oc.Vxx_dfctr_xxx ECU_ADDRESS 0xc0000142 /end MEASUREMENT
/begin MEASUREMENT Vxx_rdn_lbup_oc "" UWORD _CNV_A_R_A_165_CM 1 0. 0. 65535. DISPLAY_IDENTIFIER fm_sta_lbup_oc.Vxx_rdn_xxx ECU_ADDRESS 0xc0000144 /end MEASUREMENT
/begin MEASUREMENT Vbx_cf_lbup_oc "" UBYTE _CNV_A_R_A_165_CM 1 0. 0. 255. DISPLAY_IDENTIFIER fm_sta_lbup_oc.fm_static_bitfield.Vbx_cf_xxx ECU_ADDRESS 0xc0000146 BIT_MASK 0x1 /end MEASUREMENT
/begin MEASUREMENT Vbx_clf_lbup_oc "" UBYTE _CNV_A_R_A_165_CM 1 0. 0. 255. DISPLAY_IDENTIFIER fm_sta_lbup_oc.fm_static_bitfield.Vbx_clf_xxx ECU_ADDRESS 0xc0000146 BIT_MASK 0x2 /end MEASUREMENT
/begin MEASUREMENT Vbx_df_old_lbup_oc "" UBYTE _CNV_A_R_A_165_CM 1 0. 0. 255. DISPLAY_IDENTIFIER fm_sta_lbup_oc.fm_static_bitfield.Vbx_df_old_xxx ECU_ADDRESS 0xc0000146 BIT_MASK 0x4 /end MEASUREMENT
/begin MEASUREMENT Vbx_dfctr_sat_lbup_oc "" UBYTE _CNV_A_R_A_165_CM 1 0. 0. 255. DISPLAY_IDENTIFIER fm_sta_lbup_oc.fm_static_bitfield.Vbx_dfctr_sat_xxx ECU_ADDRESS 0xc0000146 BIT_MASK 0x8 /end MEASUREMENT
/begin MEASUREMENT Vbx_rdn_lbup_oc "" UBYTE _CNV_A_R_A_165_CM 1 0. 0. 255. DISPLAY_IDENTIFIER fm_sta_lbup_oc.fm_static_bitfield.Vbx_rdn_xxx ECU_ADDRESS 0xc0000146 BIT_MASK 0x40 /end MEASUREMENT
/begin MEASUREMENT Vxx_dtc_stt_lbup_oc "" UBYTE _CNV_A_R_A_165_CM 1 0. 0. 255. DISPLAY_IDENTIFIER fm_sta_lbup_oc.Vxx_dtc_stt_xxx ECU_ADDRESS 0xc0000147 /end MEASUREMENT
/begin MEASUREMENT Vxx_dfctr_lbup_scg "" UWORD _CNV_A_R_A_165_CM 1 0. 0. 65535. DISPLAY_IDENTIFIER fm_sta_lbup_scg.Vxx_dfctr_xxx ECU_ADDRESS 0xc0000148 /end MEASUREMENT
/begin MEASUREMENT Vxx_rdn_lbup_scg "" UWORD _CNV_A_R_A_165_CM 1 0. 0. 65535. DISPLAY_IDENTIFIER fm_sta_lbup_scg.Vxx_rdn_xxx ECU_ADDRESS 0xc000014a /end MEASUREMENT
/begin MEASUREMENT Vbx_cf_lbup_scg "" UBYTE _CNV_A_R_A_165_CM 1 0. 0. 255. DISPLAY_IDENTIFIER fm_sta_lbup_scg.fm_static_bitfield.Vbx_cf_xxx ECU_ADDRESS 0xc000014c BIT_MASK 0x1 /end MEASUREMENT
/begin MEASUREMENT Vbx_clf_lbup_scg "" UBYTE _CNV_A_R_A_165_CM 1 0. 0. 255. DISPLAY_IDENTIFIER fm_sta_lbup_scg.fm_static_bitfield.Vbx_clf_xxx ECU_ADDRESS 0xc000014c BIT_MASK 0x2 /end MEASUREMENT
/begin MEASUREMENT Vbx_df_old_lbup_scg "" UBYTE _CNV_A_R_A_165_CM 1 0. 0. 255. DISPLAY_IDENTIFIER fm_sta_lbup_scg.fm_static_bitfield.Vbx_df_old_xxx ECU_ADDRESS 0xc000014c BIT_MASK 0x4 /end MEASUREMENT
/begin MEASUREMENT Vbx_dfctr_sat_lbup_scg "" UBYTE _CNV_A_R_A_165_CM 1 0. 0. 255. DISPLAY_IDENTIFIER fm_sta_lbup_scg.fm_static_bitfield.Vbx_dfctr_sat_xxx ECU_ADDRESS 0xc000014c BIT_MASK 0x8 /end MEASUREMENT
/begin MEASUREMENT Vbx_rdn_lbup_scg "" UBYTE _CNV_A_R_A_165_CM 1 0. 0. 255. DISPLAY_IDENTIFIER fm_sta_lbup_scg.fm_static_bitfield.Vbx_rdn_xxx ECU_ADDRESS 0xc000014c BIT_MASK 0x40 /end MEASUREMENT
/begin MEASUREMENT Vxx_dtc_stt_lbup_scg "" UBYTE _CNV_A_R_A_165_CM 1 0. 0. 255. DISPLAY_IDENTIFIER fm_sta_lbup_scg.Vxx_dtc_stt_xxx ECU_ADDRESS 0xc000014d /end MEASUREMENT
/begin MEASUREMENT Vxx_dfctr_lbup_scw "" UWORD _CNV_A_R_A_165_CM 1 0. 0. 65535. DISPLAY_IDENTIFIER fm_sta_lbup_scw.Vxx_dfctr_xxx ECU_ADDRESS 0xc000014e /end MEASUREMENT
/begin MEASUREMENT Vxx_rdn_lbup_scw "" UWORD _CNV_A_R_A_165_CM 1 0. 0. 65535. DISPLAY_IDENTIFIER fm_sta_lbup_scw.Vxx_rdn_xxx ECU_ADDRESS 0xc0000150 /end MEASUREMENT
/begin MEASUREMENT Vbx_cf_lbup_scw "" UBYTE _CNV_A_R_A_165_CM 1 0. 0. 255. DISPLAY_IDENTIFIER fm_sta_lbup_scw.fm_static_bitfield.Vbx_cf_xxx ECU_ADDRESS 0xc0000152 BIT_MASK 0x1 /end MEASUREMENT
/begin MEASUREMENT Vbx_clf_lbup_scw "" UBYTE _CNV_A_R_A_165_CM 1 0. 0. 255. DISPLAY_IDENTIFIER fm_sta_lbup_scw.fm_static_bitfield.Vbx_clf_xxx ECU_ADDRESS 0xc0000152 BIT_MASK 0x2 /end MEASUREMENT
/begin MEASUREMENT Vbx_df_old_lbup_scw "" UBYTE _CNV_A_R_A_165_CM 1 0. 0. 255. DISPLAY_IDENTIFIER fm_sta_lbup_scw.fm_static_bitfield.Vbx_df_old_xxx ECU_ADDRESS 0xc0000152 BIT_MASK 0x4 /end MEASUREMENT
/begin MEASUREMENT Vbx_dfctr_sat_lbup_scw "" UBYTE _CNV_A_R_A_165_CM 1 0. 0. 255. DISPLAY_IDENTIFIER fm_sta_lbup_scw.fm_static_bitfield.Vbx_dfctr_sat_xxx ECU_ADDRESS 0xc0000152 BIT_MASK 0x8 /end MEASUREMENT
/begin MEASUREMENT Vbx_rdn_lbup_scw "" UBYTE _CNV_A_R_A_165_CM 1 0. 0. 255. DISPLAY_IDENTIFIER fm_sta_lbup_scw.fm_static_bitfield.Vbx_rdn_xxx ECU_ADDRESS 0xc0000152 BIT_MASK 0x40 /end MEASUREMENT
/begin MEASUREMENT Vxx_dtc_stt_lbup_scw "" UBYTE _CNV_A_R_A_165_CM 1 0. 0. 255. DISPLAY_IDENTIFIER fm_sta_lbup_scw.Vxx_dtc_stt_xxx ECU_ADDRESS 0xc0000153 /end MEASUREMENT
/begin MEASUREMENT Vxx_dfctr_map_chr "" UWORD _CNV_A_R_A_165_CM 1 0. 0. 65535. DISPLAY_IDENTIFIER fm_sta_map_chr.Vxx_dfctr_xxx ECU_ADDRESS 0xc0000262 /end MEASUREMENT
/begin MEASUREMENT Vxx_rdn_map_chr "" UWORD _CNV_A_R_A_165_CM 1 0. 0. 65535. DISPLAY_IDENTIFIER fm_sta_map_chr.Vxx_rdn_xxx ECU_ADDRESS 0xc0000264 /end MEASUREMENT
/begin MEASUREMENT Vbx_cf_map_chr "" UBYTE _CNV_A_R_A_165_CM 1 0. 0. 255. DISPLAY_IDENTIFIER fm_sta_map_chr.fm_static_bitfield.Vbx_cf_xxx ECU_ADDRESS 0xc0000266 BIT_MASK 0x1 /end MEASUREMENT
/begin MEASUREMENT Vbx_clf_map_chr "" UBYTE _CNV_A_R_A_165_CM 1 0. 0. 255. DISPLAY_IDENTIFIER fm_sta_map_chr.fm_static_bitfield.Vbx_clf_xxx ECU_ADDRESS 0xc0000266 BIT_MASK 0x2 /end MEASUREMENT
/begin MEASUREMENT Vbx_df_old_map_chr "" UBYTE _CNV_A_R_A_165_CM 1 0. 0. 255. DISPLAY_IDENTIFIER fm_sta_map_chr.fm_static_bitfield.Vbx_df_old_xxx ECU_ADDRESS 0xc0000266 BIT_MASK 0x4 /end MEASUREMENT
/begin MEASUREMENT Vbx_dfctr_sat_map_chr "" UBYTE _CNV_A_R_A_165_CM 1 0. 0. 255. DISPLAY_IDENTIFIER fm_sta_map_chr.fm_static_bitfield.Vbx_dfctr_sat_xxx ECU_ADDRESS 0xc0000266 BIT_MASK 0x8 /end MEASUREMENT
/begin MEASUREMENT Vbx_rdn_map_chr "" UBYTE _CNV_A_R_A_165_CM 1 0. 0. 255. DISPLAY_IDENTIFIER fm_sta_map_chr.fm_static_bitfield.Vbx_rdn_xxx ECU_ADDRESS 0xc0000266 BIT_MASK 0x40 /end MEASUREMENT
/begin MEASUREMENT Vxx_dtc_stt_map_chr "" UBYTE _CNV_A_R_A_165_CM 1 0. 0. 255. DISPLAY_IDENTIFIER fm_sta_map_chr.Vxx_dtc_stt_xxx ECU_ADDRESS 0xc0000267 /end MEASUREMENT
/begin MEASUREMENT Vxx_dfctr_map_oor "" UWORD _CNV_A_R_A_165_CM 1 0. 0. 65535. DISPLAY_IDENTIFIER fm_sta_map_oor.Vxx_dfctr_xxx ECU_ADDRESS 0xc0000268 /end MEASUREMENT
/begin MEASUREMENT Vxx_rdn_map_oor "" UWORD _CNV_A_R_A_165_CM 1 0. 0. 65535. DISPLAY_IDENTIFIER fm_sta_map_oor.Vxx_rdn_xxx ECU_ADDRESS 0xc000026a /end MEASUREMENT
/begin MEASUREMENT Vbx_cf_map_oor "" UBYTE _CNV_A_R_A_165_CM 1 0. 0. 255. DISPLAY_IDENTIFIER fm_sta_map_oor.fm_static_bitfield.Vbx_cf_xxx ECU_ADDRESS 0xc000026c BIT_MASK 0x1 /end MEASUREMENT
/begin MEASUREMENT Vbx_clf_map_oor "" UBYTE _CNV_A_R_A_165_CM 1 0. 0. 255. DISPLAY_IDENTIFIER fm_sta_map_oor.fm_static_bitfield.Vbx_clf_xxx ECU_ADDRESS 0xc000026c BIT_MASK 0x2 /end MEASUREMENT
/begin MEASUREMENT Vbx_df_old_map_oor "" UBYTE _CNV_A_R_A_165_CM 1 0. 0. 255. DISPLAY_IDENTIFIER fm_sta_map_oor.fm_static_bitfield.Vbx_df_old_xxx ECU_ADDRESS 0xc000026c BIT_MASK 0x4 /end MEASUREMENT
/begin MEASUREMENT Vbx_dfctr_sat_map_oor "" UBYTE _CNV_A_R_A_165_CM 1 0. 0. 255. DISPLAY_IDENTIFIER fm_sta_map_oor.fm_static_bitfield.Vbx_dfctr_sat_xxx ECU_ADDRESS 0xc000026c BIT_MASK 0x8 /end MEASUREMENT
/begin MEASUREMENT Vbx_rdn_map_oor "" UBYTE _CNV_A_R_A_165_CM 1 0. 0. 255. DISPLAY_IDENTIFIER fm_sta_map_oor.fm_static_bitfield.Vbx_rdn_xxx ECU_ADDRESS 0xc000026c BIT_MASK 0x40 /end MEASUREMENT
/begin MEASUREMENT Vxx_dtc_stt_map_oor "" UBYTE _CNV_A_R_A_165_CM 1 0. 0. 255. DISPLAY_IDENTIFIER fm_sta_map_oor.Vxx_dtc_stt_xxx ECU_ADDRESS 0xc000026d /end MEASUREMENT
/begin MEASUREMENT Vxx_dfctr_mis_1_cata "" UWORD _CNV_A_R_A_165_CM 1 0. 0. 65535. DISPLAY_IDENTIFIER fm_sta_mis_1_cata.Vxx_dfctr_xxx ECU_ADDRESS 0xc000026e /end MEASUREMENT
/begin MEASUREMENT Vxx_rdn_mis_1_cata "" UWORD _CNV_A_R_A_165_CM 1 0. 0. 65535. DISPLAY_IDENTIFIER fm_sta_mis_1_cata.Vxx_rdn_xxx ECU_ADDRESS 0xc0000270 /end MEASUREMENT
/begin MEASUREMENT Vbx_cf_mis_1_cata "" UBYTE _CNV_A_R_A_165_CM 1 0. 0. 255. DISPLAY_IDENTIFIER fm_sta_mis_1_cata.fm_static_bitfield.Vbx_cf_xxx ECU_ADDRESS 0xc0000272 BIT_MASK 0x1 /end MEASUREMENT
/begin MEASUREMENT Vbx_clf_mis_1_cata "" UBYTE _CNV_A_R_A_165_CM 1 0. 0. 255. DISPLAY_IDENTIFIER fm_sta_mis_1_cata.fm_static_bitfield.Vbx_clf_xxx ECU_ADDRESS 0xc0000272 BIT_MASK 0x2 /end MEASUREMENT
/begin MEASUREMENT Vbx_df_old_mis_1_cata "" UBYTE _CNV_A_R_A_165_CM 1 0. 0. 255. DISPLAY_IDENTIFIER fm_sta_mis_1_cata.fm_static_bitfield.Vbx_df_old_xxx ECU_ADDRESS 0xc0000272 BIT_MASK 0x4 /end MEASUREMENT
/begin MEASUREMENT Vbx_dfctr_sat_mis_1_cata "" UBYTE _CNV_A_R_A_165_CM 1 0. 0. 255. DISPLAY_IDENTIFIER fm_sta_mis_1_cata.fm_static_bitfield.Vbx_dfctr_sat_xxx ECU_ADDRESS 0xc0000272 BIT_MASK 0x8 /end MEASUREMENT
/begin MEASUREMENT Vbx_rdn_mis_1_cata "" UBYTE _CNV_A_R_A_165_CM 1 0. 0. 255. DISPLAY_IDENTIFIER fm_sta_mis_1_cata.fm_static_bitfield.Vbx_rdn_xxx ECU_ADDRESS 0xc0000272 BIT_MASK 0x40 /end MEASUREMENT
/begin MEASUREMENT Vxx_dtc_stt_mis_1_cata "" UBYTE _CNV_A_R_A_165_CM 1 0. 0. 255. DISPLAY_IDENTIFIER fm_sta_mis_1_cata.Vxx_dtc_stt_xxx ECU_ADDRESS 0xc0000273 /end MEASUREMENT
/begin MEASUREMENT Vxx_dfctr_mis_1_lpg_cata "" UWORD _CNV_A_R_A_165_CM 1 0. 0. 65535. DISPLAY_IDENTIFIER fm_sta_mis_1_lpg_cata.Vxx_dfctr_xxx ECU_ADDRESS 0xc0000274 /end MEASUREMENT
/begin MEASUREMENT Vxx_rdn_mis_1_lpg_cata "" UWORD _CNV_A_R_A_165_CM 1 0. 0. 65535. DISPLAY_IDENTIFIER fm_sta_mis_1_lpg_cata.Vxx_rdn_xxx ECU_ADDRESS 0xc0000276 /end MEASUREMENT
/begin MEASUREMENT Vbx_cf_mis_1_lpg_cata "" UBYTE _CNV_A_R_A_165_CM 1 0. 0. 255. DISPLAY_IDENTIFIER fm_sta_mis_1_lpg_cata.fm_static_bitfield.Vbx_cf_xxx ECU_ADDRESS 0xc0000278 BIT_MASK 0x1 /end MEASUREMENT
/begin MEASUREMENT Vbx_clf_mis_1_lpg_cata "" UBYTE _CNV_A_R_A_165_CM 1 0. 0. 255. DISPLAY_IDENTIFIER fm_sta_mis_1_lpg_cata.fm_static_bitfield.Vbx_clf_xxx ECU_ADDRESS 0xc0000278 BIT_MASK 0x2 /end MEASUREMENT
/begin MEASUREMENT Vbx_df_old_mis_1_lpg_cata "" UBYTE _CNV_A_R_A_165_CM 1 0. 0. 255. DISPLAY_IDENTIFIER fm_sta_mis_1_lpg_cata.fm_static_bitfield.Vbx_df_old_xxx ECU_ADDRESS 0xc0000278 BIT_MASK 0x4 /end MEASUREMENT
/begin MEASUREMENT Vbx_dfctr_sat_mis_1_lpg_cata "" UBYTE _CNV_A_R_A_165_CM 1 0. 0. 255. DISPLAY_IDENTIFIER fm_sta_mis_1_lpg_cata.fm_static_bitfield.Vbx_dfctr_sat_xxx ECU_ADDRESS 0xc0000278 BIT_MASK 0x8 /end MEASUREMENT
/begin MEASUREMENT Vbx_rdn_mis_1_lpg_cata "" UBYTE _CNV_A_R_A_165_CM 1 0. 0. 255. DISPLAY_IDENTIFIER fm_sta_mis_1_lpg_cata.fm_static_bitfield.Vbx_rdn_xxx ECU_ADDRESS 0xc0000278 BIT_MASK 0x40 /end MEASUREMENT
/begin MEASUREMENT Vxx_dtc_stt_mis_1_lpg_cata "" UBYTE _CNV_A_R_A_165_CM 1 0. 0. 255. DISPLAY_IDENTIFIER fm_sta_mis_1_lpg_cata.Vxx_dtc_stt_xxx ECU_ADDRESS 0xc0000279 /end MEASUREMENT
/begin MEASUREMENT Vxx_dfctr_mis_1_lpg_trs_h "" UWORD _CNV_A_R_A_165_CM 1 0. 0. 65535. DISPLAY_IDENTIFIER fm_sta_mis_1_lpg_trs_h.Vxx_dfctr_xxx ECU_ADDRESS 0xc000027a /end MEASUREMENT
/begin MEASUREMENT Vxx_rdn_mis_1_lpg_trs_h "" UWORD _CNV_A_R_A_165_CM 1 0. 0. 65535. DISPLAY_IDENTIFIER fm_sta_mis_1_lpg_trs_h.Vxx_rdn_xxx ECU_ADDRESS 0xc000027c /end MEASUREMENT
/begin MEASUREMENT Vbx_cf_mis_1_lpg_trs_h "" UBYTE _CNV_A_R_A_165_CM 1 0. 0. 255. DISPLAY_IDENTIFIER fm_sta_mis_1_lpg_trs_h.fm_static_bitfield.Vbx_cf_xxx ECU_ADDRESS 0xc000027e BIT_MASK 0x1 /end MEASUREMENT
/begin MEASUREMENT Vbx_clf_mis_1_lpg_trs_h "" UBYTE _CNV_A_R_A_165_CM 1 0. 0. 255. DISPLAY_IDENTIFIER fm_sta_mis_1_lpg_trs_h.fm_static_bitfield.Vbx_clf_xxx ECU_ADDRESS 0xc000027e BIT_MASK 0x2 /end MEASUREMENT
/begin MEASUREMENT Vbx_df_old_mis_1_lpg_trs_h "" UBYTE _CNV_A_R_A_165_CM 1 0. 0. 255. DISPLAY_IDENTIFIER fm_sta_mis_1_lpg_trs_h.fm_static_bitfield.Vbx_df_old_xxx ECU_ADDRESS 0xc000027e BIT_MASK 0x4 /end MEASUREMENT
/begin MEASUREMENT Vbx_dfctr_sat_mis_1_lpg_trs_h "" UBYTE _CNV_A_R_A_165_CM 1 0. 0. 255. DISPLAY_IDENTIFIER fm_sta_mis_1_lpg_trs_h.fm_static_bitfield.Vbx_dfctr_sat_xxx ECU_ADDRESS 0xc000027e BIT_MASK 0x8 /end MEASUREMENT
/begin MEASUREMENT Vbx_rdn_mis_1_lpg_trs_h "" UBYTE _CNV_A_R_A_165_CM 1 0. 0. 255. DISPLAY_IDENTIFIER fm_sta_mis_1_lpg_trs_h.fm_static_bitfield.Vbx_rdn_xxx ECU_ADDRESS 0xc000027e BIT_MASK 0x40 /end MEASUREMENT
/begin MEASUREMENT Vxx_dtc_stt_mis_1_lpg_trs_h "" UBYTE _CNV_A_R_A_165_CM 1 0. 0. 255. DISPLAY_IDENTIFIER fm_sta_mis_1_lpg_trs_h.Vxx_dtc_stt_xxx ECU_ADDRESS 0xc000027f /end MEASUREMENT
/begin MEASUREMENT Vxx_dfctr_mis_1_trs_h "" UWORD _CNV_A_R_A_165_CM 1 0. 0. 65535. DISPLAY_IDENTIFIER fm_sta_mis_1_trs_h.Vxx_dfctr_xxx ECU_ADDRESS 0xc0000280 /end MEASUREMENT
/begin MEASUREMENT Vxx_rdn_mis_1_trs_h "" UWORD _CNV_A_R_A_165_CM 1 0. 0. 65535. DISPLAY_IDENTIFIER fm_sta_mis_1_trs_h.Vxx_rdn_xxx ECU_ADDRESS 0xc0000282 /end MEASUREMENT
/begin MEASUREMENT Vbx_cf_mis_1_trs_h "" UBYTE _CNV_A_R_A_165_CM 1 0. 0. 255. DISPLAY_IDENTIFIER fm_sta_mis_1_trs_h.fm_static_bitfield.Vbx_cf_xxx ECU_ADDRESS 0xc0000284 BIT_MASK 0x1 /end MEASUREMENT
/begin MEASUREMENT Vbx_clf_mis_1_trs_h "" UBYTE _CNV_A_R_A_165_CM 1 0. 0. 255. DISPLAY_IDENTIFIER fm_sta_mis_1_trs_h.fm_static_bitfield.Vbx_clf_xxx ECU_ADDRESS 0xc0000284 BIT_MASK 0x2 /end MEASUREMENT
/begin MEASUREMENT Vbx_df_old_mis_1_trs_h "" UBYTE _CNV_A_R_A_165_CM 1 0. 0. 255. DISPLAY_IDENTIFIER fm_sta_mis_1_trs_h.fm_static_bitfield.Vbx_df_old_xxx ECU_ADDRESS 0xc0000284 BIT_MASK 0x4 /end MEASUREMENT
/begin MEASUREMENT Vbx_dfctr_sat_mis_1_trs_h "" UBYTE _CNV_A_R_A_165_CM 1 0. 0. 255. DISPLAY_IDENTIFIER fm_sta_mis_1_trs_h.fm_static_bitfield.Vbx_dfctr_sat_xxx ECU_ADDRESS 0xc0000284 BIT_MASK 0x8 /end MEASUREMENT
/begin MEASUREMENT Vbx_rdn_mis_1_trs_h "" UBYTE _CNV_A_R_A_165_CM 1 0. 0. 255. DISPLAY_IDENTIFIER fm_sta_mis_1_trs_h.fm_static_bitfield.Vbx_rdn_xxx ECU_ADDRESS 0xc0000284 BIT_MASK 0x40 /end MEASUREMENT
/begin MEASUREMENT Vxx_dtc_stt_mis_1_trs_h "" UBYTE _CNV_A_R_A_165_CM 1 0. 0. 255. DISPLAY_IDENTIFIER fm_sta_mis_1_trs_h.Vxx_dtc_stt_xxx ECU_ADDRESS 0xc0000285 /end MEASUREMENT
/begin MEASUREMENT Vxx_dfctr_mis_2_cata "" UWORD _CNV_A_R_A_165_CM 1 0. 0. 65535. DISPLAY_IDENTIFIER fm_sta_mis_2_cata.Vxx_dfctr_xxx ECU_ADDRESS 0xc0000286 /end MEASUREMENT
/begin MEASUREMENT Vxx_rdn_mis_2_cata "" UWORD _CNV_A_R_A_165_CM 1 0. 0. 65535. DISPLAY_IDENTIFIER fm_sta_mis_2_cata.Vxx_rdn_xxx ECU_ADDRESS 0xc0000288 /end MEASUREMENT
/begin MEASUREMENT Vbx_cf_mis_2_cata "" UBYTE _CNV_A_R_A_165_CM 1 0. 0. 255. DISPLAY_IDENTIFIER fm_sta_mis_2_cata.fm_static_bitfield.Vbx_cf_xxx ECU_ADDRESS 0xc000028a BIT_MASK 0x1 /end MEASUREMENT
/begin MEASUREMENT Vbx_clf_mis_2_cata "" UBYTE _CNV_A_R_A_165_CM 1 0. 0. 255. DISPLAY_IDENTIFIER fm_sta_mis_2_cata.fm_static_bitfield.Vbx_clf_xxx ECU_ADDRESS 0xc000028a BIT_MASK 0x2 /end MEASUREMENT
/begin MEASUREMENT Vbx_df_old_mis_2_cata "" UBYTE _CNV_A_R_A_165_CM 1 0. 0. 255. DISPLAY_IDENTIFIER fm_sta_mis_2_cata.fm_static_bitfield.Vbx_df_old_xxx ECU_ADDRESS 0xc000028a BIT_MASK 0x4 /end MEASUREMENT
/begin MEASUREMENT Vbx_dfctr_sat_mis_2_cata "" UBYTE _CNV_A_R_A_165_CM 1 0. 0. 255. DISPLAY_IDENTIFIER fm_sta_mis_2_cata.fm_static_bitfield.Vbx_dfctr_sat_xxx ECU_ADDRESS 0xc000028a BIT_MASK 0x8 /end MEASUREMENT
/begin MEASUREMENT Vbx_rdn_mis_2_cata "" UBYTE _CNV_A_R_A_165_CM 1 0. 0. 255. DISPLAY_IDENTIFIER fm_sta_mis_2_cata.fm_static_bitfield.Vbx_rdn_xxx ECU_ADDRESS 0xc000028a BIT_MASK 0x40 /end MEASUREMENT
/begin MEASUREMENT Vxx_dtc_stt_mis_2_cata "" UBYTE _CNV_A_R_A_165_CM 1 0. 0. 255. DISPLAY_IDENTIFIER fm_sta_mis_2_cata.Vxx_dtc_stt_xxx ECU_ADDRESS 0xc000028b /end MEASUREMENT
/begin MEASUREMENT Vxx_dfctr_mis_2_lpg_cata "" UWORD _CNV_A_R_A_165_CM 1 0. 0. 65535. DISPLAY_IDENTIFIER fm_sta_mis_2_lpg_cata.Vxx_dfctr_xxx ECU_ADDRESS 0xc000028c /end MEASUREMENT
/begin MEASUREMENT Vxx_rdn_mis_2_lpg_cata "" UWORD _CNV_A_R_A_165_CM 1 0. 0. 65535. DISPLAY_IDENTIFIER fm_sta_mis_2_lpg_cata.Vxx_rdn_xxx ECU_ADDRESS 0xc000028e /end MEASUREMENT
/begin MEASUREMENT Vbx_cf_mis_2_lpg_cata "" UBYTE _CNV_A_R_A_165_CM 1 0. 0. 255. DISPLAY_IDENTIFIER fm_sta_mis_2_lpg_cata.fm_static_bitfield.Vbx_cf_xxx ECU_ADDRESS 0xc0000290 BIT_MASK 0x1 /end MEASUREMENT
/begin MEASUREMENT Vbx_clf_mis_2_lpg_cata "" UBYTE _CNV_A_R_A_165_CM 1 0. 0. 255. DISPLAY_IDENTIFIER fm_sta_mis_2_lpg_cata.fm_static_bitfield.Vbx_clf_xxx ECU_ADDRESS 0xc0000290 BIT_MASK 0x2 /end MEASUREMENT
/begin MEASUREMENT Vbx_df_old_mis_2_lpg_cata "" UBYTE _CNV_A_R_A_165_CM 1 0. 0. 255. DISPLAY_IDENTIFIER fm_sta_mis_2_lpg_cata.fm_static_bitfield.Vbx_df_old_xxx ECU_ADDRESS 0xc0000290 BIT_MASK 0x4 /end MEASUREMENT
/begin MEASUREMENT Vbx_dfctr_sat_mis_2_lpg_cata "" UBYTE _CNV_A_R_A_165_CM 1 0. 0. 255. DISPLAY_IDENTIFIER fm_sta_mis_2_lpg_cata.fm_static_bitfield.Vbx_dfctr_sat_xxx ECU_ADDRESS 0xc0000290 BIT_MASK 0x8 /end MEASUREMENT
/begin MEASUREMENT Vbx_rdn_mis_2_lpg_cata "" UBYTE _CNV_A_R_A_165_CM 1 0. 0. 255. DISPLAY_IDENTIFIER fm_sta_mis_2_lpg_cata.fm_static_bitfield.Vbx_rdn_xxx ECU_ADDRESS 0xc0000290 BIT_MASK 0x40 /end MEASUREMENT
/begin MEASUREMENT Vxx_dtc_stt_mis_2_lpg_cata "" UBYTE _CNV_A_R_A_165_CM 1 0. 0. 255. DISPLAY_IDENTIFIER fm_sta_mis_2_lpg_cata.Vxx_dtc_stt_xxx ECU_ADDRESS 0xc0000291 /end MEASUREMENT
/begin MEASUREMENT Vxx_dfctr_mis_2_lpg_trs_h "" UWORD _CNV_A_R_A_165_CM 1 0. 0. 65535. DISPLAY_IDENTIFIER fm_sta_mis_2_lpg_trs_h.Vxx_dfctr_xxx ECU_ADDRESS 0xc0000292 /end MEASUREMENT
/begin MEASUREMENT Vxx_rdn_mis_2_lpg_trs_h "" UWORD _CNV_A_R_A_165_CM 1 0. 0. 65535. DISPLAY_IDENTIFIER fm_sta_mis_2_lpg_trs_h.Vxx_rdn_xxx ECU_ADDRESS 0xc0000294 /end MEASUREMENT
/begin MEASUREMENT Vbx_cf_mis_2_lpg_trs_h "" UBYTE _CNV_A_R_A_165_CM 1 0. 0. 255. DISPLAY_IDENTIFIER fm_sta_mis_2_lpg_trs_h.fm_static_bitfield.Vbx_cf_xxx ECU_ADDRESS 0xc0000296 BIT_MASK 0x1 /end MEASUREMENT
/begin MEASUREMENT Vbx_clf_mis_2_lpg_trs_h "" UBYTE _CNV_A_R_A_165_CM 1 0. 0. 255. DISPLAY_IDENTIFIER fm_sta_mis_2_lpg_trs_h.fm_static_bitfield.Vbx_clf_xxx ECU_ADDRESS 0xc0000296 BIT_MASK 0x2 /end MEASUREMENT
/begin MEASUREMENT Vbx_df_old_mis_2_lpg_trs_h "" UBYTE _CNV_A_R_A_165_CM 1 0. 0. 255. DISPLAY_IDENTIFIER fm_sta_mis_2_lpg_trs_h.fm_static_bitfield.Vbx_df_old_xxx ECU_ADDRESS 0xc0000296 BIT_MASK 0x4 /end MEASUREMENT
/begin MEASUREMENT Vbx_dfctr_sat_mis_2_lpg_trs_h "" UBYTE _CNV_A_R_A_165_CM 1 0. 0. 255. DISPLAY_IDENTIFIER fm_sta_mis_2_lpg_trs_h.fm_static_bitfield.Vbx_dfctr_sat_xxx ECU_ADDRESS 0xc0000296 BIT_MASK 0x8 /end MEASUREMENT
/begin MEASUREMENT Vbx_rdn_mis_2_lpg_trs_h "" UBYTE _CNV_A_R_A_165_CM 1 0. 0. 255. DISPLAY_IDENTIFIER fm_sta_mis_2_lpg_trs_h.fm_static_bitfield.Vbx_rdn_xxx ECU_ADDRESS 0xc0000296 BIT_MASK 0x40 /end MEASUREMENT
/begin MEASUREMENT Vxx_dtc_stt_mis_2_lpg_trs_h "" UBYTE _CNV_A_R_A_165_CM 1 0. 0. 255. DISPLAY_IDENTIFIER fm_sta_mis_2_lpg_trs_h.Vxx_dtc_stt_xxx ECU_ADDRESS 0xc0000297 /end MEASUREMENT
/begin MEASUREMENT Vxx_dfctr_mis_2_trs_h "" UWORD _CNV_A_R_A_165_CM 1 0. 0. 65535. DISPLAY_IDENTIFIER fm_sta_mis_2_trs_h.Vxx_dfctr_xxx ECU_ADDRESS 0xc0000298 /end MEASUREMENT
/begin MEASUREMENT Vxx_rdn_mis_2_trs_h "" UWORD _CNV_A_R_A_165_CM 1 0. 0. 65535. DISPLAY_IDENTIFIER fm_sta_mis_2_trs_h.Vxx_rdn_xxx ECU_ADDRESS 0xc000029a /end MEASUREMENT
/begin MEASUREMENT Vbx_cf_mis_2_trs_h "" UBYTE _CNV_A_R_A_165_CM 1 0. 0. 255. DISPLAY_IDENTIFIER fm_sta_mis_2_trs_h.fm_static_bitfield.Vbx_cf_xxx ECU_ADDRESS 0xc000029c BIT_MASK 0x1 /end MEASUREMENT
/begin MEASUREMENT Vbx_clf_mis_2_trs_h "" UBYTE _CNV_A_R_A_165_CM 1 0. 0. 255. DISPLAY_IDENTIFIER fm_sta_mis_2_trs_h.fm_static_bitfield.Vbx_clf_xxx ECU_ADDRESS 0xc000029c BIT_MASK 0x2 /end MEASUREMENT
/begin MEASUREMENT Vbx_df_old_mis_2_trs_h "" UBYTE _CNV_A_R_A_165_CM 1 0. 0. 255. DISPLAY_IDENTIFIER fm_sta_mis_2_trs_h.fm_static_bitfield.Vbx_df_old_xxx ECU_ADDRESS 0xc000029c BIT_MASK 0x4 /end MEASUREMENT
/begin MEASUREMENT Vbx_dfctr_sat_mis_2_trs_h "" UBYTE _CNV_A_R_A_165_CM 1 0. 0. 255. DISPLAY_IDENTIFIER fm_sta_mis_2_trs_h.fm_static_bitfield.Vbx_dfctr_sat_xxx ECU_ADDRESS 0xc000029c BIT_MASK 0x8 /end MEASUREMENT
/begin MEASUREMENT Vbx_rdn_mis_2_trs_h "" UBYTE _CNV_A_R_A_165_CM 1 0. 0. 255. DISPLAY_IDENTIFIER fm_sta_mis_2_trs_h.fm_static_bitfield.Vbx_rdn_xxx ECU_ADDRESS 0xc000029c BIT_MASK 0x40 /end MEASUREMENT
/begin MEASUREMENT Vxx_dtc_stt_mis_2_trs_h "" UBYTE _CNV_A_R_A_165_CM 1 0. 0. 255. DISPLAY_IDENTIFIER fm_sta_mis_2_trs_h.Vxx_dtc_stt_xxx ECU_ADDRESS 0xc000029d /end MEASUREMENT
/begin MEASUREMENT Vxx_dfctr_mis_3_cata "" UWORD _CNV_A_R_A_165_CM 1 0. 0. 65535. DISPLAY_IDENTIFIER fm_sta_mis_3_cata.Vxx_dfctr_xxx ECU_ADDRESS 0xc000029e /end MEASUREMENT
/begin MEASUREMENT Vxx_rdn_mis_3_cata "" UWORD _CNV_A_R_A_165_CM 1 0. 0. 65535. DISPLAY_IDENTIFIER fm_sta_mis_3_cata.Vxx_rdn_xxx ECU_ADDRESS 0xc00002a0 /end MEASUREMENT
/begin MEASUREMENT Vbx_cf_mis_3_cata "" UBYTE _CNV_A_R_A_165_CM 1 0. 0. 255. DISPLAY_IDENTIFIER fm_sta_mis_3_cata.fm_static_bitfield.Vbx_cf_xxx ECU_ADDRESS 0xc00002a2 BIT_MASK 0x1 /end MEASUREMENT
/begin MEASUREMENT Vbx_clf_mis_3_cata "" UBYTE _CNV_A_R_A_165_CM 1 0. 0. 255. DISPLAY_IDENTIFIER fm_sta_mis_3_cata.fm_static_bitfield.Vbx_clf_xxx ECU_ADDRESS 0xc00002a2 BIT_MASK 0x2 /end MEASUREMENT
/begin MEASUREMENT Vbx_df_old_mis_3_cata "" UBYTE _CNV_A_R_A_165_CM 1 0. 0. 255. DISPLAY_IDENTIFIER fm_sta_mis_3_cata.fm_static_bitfield.Vbx_df_old_xxx ECU_ADDRESS 0xc00002a2 BIT_MASK 0x4 /end MEASUREMENT
/begin MEASUREMENT Vbx_dfctr_sat_mis_3_cata "" UBYTE _CNV_A_R_A_165_CM 1 0. 0. 255. DISPLAY_IDENTIFIER fm_sta_mis_3_cata.fm_static_bitfield.Vbx_dfctr_sat_xxx ECU_ADDRESS 0xc00002a2 BIT_MASK 0x8 /end MEASUREMENT
/begin MEASUREMENT Vbx_rdn_mis_3_cata "" UBYTE _CNV_A_R_A_165_CM 1 0. 0. 255. DISPLAY_IDENTIFIER fm_sta_mis_3_cata.fm_static_bitfield.Vbx_rdn_xxx ECU_ADDRESS 0xc00002a2 BIT_MASK 0x40 /end MEASUREMENT
/begin MEASUREMENT Vxx_dtc_stt_mis_3_cata "" UBYTE _CNV_A_R_A_165_CM 1 0. 0. 255. DISPLAY_IDENTIFIER fm_sta_mis_3_cata.Vxx_dtc_stt_xxx ECU_ADDRESS 0xc00002a3 /end MEASUREMENT
/begin MEASUREMENT Vxx_dfctr_mis_3_lpg_cata "" UWORD _CNV_A_R_A_165_CM 1 0. 0. 65535. DISPLAY_IDENTIFIER fm_sta_mis_3_lpg_cata.Vxx_dfctr_xxx ECU_ADDRESS 0xc00002a4 /end MEASUREMENT
/begin MEASUREMENT Vxx_rdn_mis_3_lpg_cata "" UWORD _CNV_A_R_A_165_CM 1 0. 0. 65535. DISPLAY_IDENTIFIER fm_sta_mis_3_lpg_cata.Vxx_rdn_xxx ECU_ADDRESS 0xc00002a6 /end MEASUREMENT
/begin MEASUREMENT Vbx_cf_mis_3_lpg_cata "" UBYTE _CNV_A_R_A_165_CM 1 0. 0. 255. DISPLAY_IDENTIFIER fm_sta_mis_3_lpg_cata.fm_static_bitfield.Vbx_cf_xxx ECU_ADDRESS 0xc00002a8 BIT_MASK 0x1 /end MEASUREMENT
/begin MEASUREMENT Vbx_clf_mis_3_lpg_cata "" UBYTE _CNV_A_R_A_165_CM 1 0. 0. 255. DISPLAY_IDENTIFIER fm_sta_mis_3_lpg_cata.fm_static_bitfield.Vbx_clf_xxx ECU_ADDRESS 0xc00002a8 BIT_MASK 0x2 /end MEASUREMENT
/begin MEASUREMENT Vbx_df_old_mis_3_lpg_cata "" UBYTE _CNV_A_R_A_165_CM 1 0. 0. 255. DISPLAY_IDENTIFIER fm_sta_mis_3_lpg_cata.fm_static_bitfield.Vbx_df_old_xxx ECU_ADDRESS 0xc00002a8 BIT_MASK 0x4 /end MEASUREMENT
/begin MEASUREMENT Vbx_dfctr_sat_mis_3_lpg_cata "" UBYTE _CNV_A_R_A_165_CM 1 0. 0. 255. DISPLAY_IDENTIFIER fm_sta_mis_3_lpg_cata.fm_static_bitfield.Vbx_dfctr_sat_xxx ECU_ADDRESS 0xc00002a8 BIT_MASK 0x8 /end MEASUREMENT
/begin MEASUREMENT Vbx_rdn_mis_3_lpg_cata "" UBYTE _CNV_A_R_A_165_CM 1 0. 0. 255. DISPLAY_IDENTIFIER fm_sta_mis_3_lpg_cata.fm_static_bitfield.Vbx_rdn_xxx ECU_ADDRESS 0xc00002a8 BIT_MASK 0x40 /end MEASUREMENT
/begin MEASUREMENT Vxx_dtc_stt_mis_3_lpg_cata "" UBYTE _CNV_A_R_A_165_CM 1 0. 0. 255. DISPLAY_IDENTIFIER fm_sta_mis_3_lpg_cata.Vxx_dtc_stt_xxx ECU_ADDRESS 0xc00002a9 /end MEASUREMENT
/begin MEASUREMENT Vxx_dfctr_mis_3_lpg_trs_h "" UWORD _CNV_A_R_A_165_CM 1 0. 0. 65535. DISPLAY_IDENTIFIER fm_sta_mis_3_lpg_trs_h.Vxx_dfctr_xxx ECU_ADDRESS 0xc00002aa /end MEASUREMENT
/begin MEASUREMENT Vxx_rdn_mis_3_lpg_trs_h "" UWORD _CNV_A_R_A_165_CM 1 0. 0. 65535. DISPLAY_IDENTIFIER fm_sta_mis_3_lpg_trs_h.Vxx_rdn_xxx ECU_ADDRESS 0xc00002ac /end MEASUREMENT
/begin MEASUREMENT Vbx_cf_mis_3_lpg_trs_h "" UBYTE _CNV_A_R_A_165_CM 1 0. 0. 255. DISPLAY_IDENTIFIER fm_sta_mis_3_lpg_trs_h.fm_static_bitfield.Vbx_cf_xxx ECU_ADDRESS 0xc00002ae BIT_MASK 0x1 /end MEASUREMENT
/begin MEASUREMENT Vbx_clf_mis_3_lpg_trs_h "" UBYTE _CNV_A_R_A_165_CM 1 0. 0. 255. DISPLAY_IDENTIFIER fm_sta_mis_3_lpg_trs_h.fm_static_bitfield.Vbx_clf_xxx ECU_ADDRESS 0xc00002ae BIT_MASK 0x2 /end MEASUREMENT
/begin MEASUREMENT Vbx_df_old_mis_3_lpg_trs_h "" UBYTE _CNV_A_R_A_165_CM 1 0. 0. 255. DISPLAY_IDENTIFIER fm_sta_mis_3_lpg_trs_h.fm_static_bitfield.Vbx_df_old_xxx ECU_ADDRESS 0xc00002ae BIT_MASK 0x4 /end MEASUREMENT
/begin MEASUREMENT Vbx_dfctr_sat_mis_3_lpg_trs_h "" UBYTE _CNV_A_R_A_165_CM 1 0. 0. 255. DISPLAY_IDENTIFIER fm_sta_mis_3_lpg_trs_h.fm_static_bitfield.Vbx_dfctr_sat_xxx ECU_ADDRESS 0xc00002ae BIT_MASK 0x8 /end MEASUREMENT
/begin MEASUREMENT Vbx_rdn_mis_3_lpg_trs_h "" UBYTE _CNV_A_R_A_165_CM 1 0. 0. 255. DISPLAY_IDENTIFIER fm_sta_mis_3_lpg_trs_h.fm_static_bitfield.Vbx_rdn_xxx ECU_ADDRESS 0xc00002ae BIT_MASK 0x40 /end MEASUREMENT
/begin MEASUREMENT Vxx_dtc_stt_mis_3_lpg_trs_h "" UBYTE _CNV_A_R_A_165_CM 1 0. 0. 255. DISPLAY_IDENTIFIER fm_sta_mis_3_lpg_trs_h.Vxx_dtc_stt_xxx ECU_ADDRESS 0xc00002af /end MEASUREMENT
/begin MEASUREMENT Vxx_dfctr_mis_3_trs_h "" UWORD _CNV_A_R_A_165_CM 1 0. 0. 65535. DISPLAY_IDENTIFIER fm_sta_mis_3_trs_h.Vxx_dfctr_xxx ECU_ADDRESS 0xc00002b0 /end MEASUREMENT
/begin MEASUREMENT Vxx_rdn_mis_3_trs_h "" UWORD _CNV_A_R_A_165_CM 1 0. 0. 65535. DISPLAY_IDENTIFIER fm_sta_mis_3_trs_h.Vxx_rdn_xxx ECU_ADDRESS 0xc00002b2 /end MEASUREMENT
/begin MEASUREMENT Vbx_cf_mis_3_trs_h "" UBYTE _CNV_A_R_A_165_CM 1 0. 0. 255. DISPLAY_IDENTIFIER fm_sta_mis_3_trs_h.fm_static_bitfield.Vbx_cf_xxx ECU_ADDRESS 0xc00002b4 BIT_MASK 0x1 /end MEASUREMENT
/begin MEASUREMENT Vbx_clf_mis_3_trs_h "" UBYTE _CNV_A_R_A_165_CM 1 0. 0. 255. DISPLAY_IDENTIFIER fm_sta_mis_3_trs_h.fm_static_bitfield.Vbx_clf_xxx ECU_ADDRESS 0xc00002b4 BIT_MASK 0x2 /end MEASUREMENT
/begin MEASUREMENT Vbx_df_old_mis_3_trs_h "" UBYTE _CNV_A_R_A_165_CM 1 0. 0. 255. DISPLAY_IDENTIFIER fm_sta_mis_3_trs_h.fm_static_bitfield.Vbx_df_old_xxx ECU_ADDRESS 0xc00002b4 BIT_MASK 0x4 /end MEASUREMENT
/begin MEASUREMENT Vbx_dfctr_sat_mis_3_trs_h "" UBYTE _CNV_A_R_A_165_CM 1 0. 0. 255. DISPLAY_IDENTIFIER fm_sta_mis_3_trs_h.fm_static_bitfield.Vbx_dfctr_sat_xxx ECU_ADDRESS 0xc00002b4 BIT_MASK 0x8 /end MEASUREMENT
/begin MEASUREMENT Vbx_rdn_mis_3_trs_h "" UBYTE _CNV_A_R_A_165_CM 1 0. 0. 255. DISPLAY_IDENTIFIER fm_sta_mis_3_trs_h.fm_static_bitfield.Vbx_rdn_xxx ECU_ADDRESS 0xc00002b4 BIT_MASK 0x40 /end MEASUREMENT
/begin MEASUREMENT Vxx_dtc_stt_mis_3_trs_h "" UBYTE _CNV_A_R_A_165_CM 1 0. 0. 255. DISPLAY_IDENTIFIER fm_sta_mis_3_trs_h.Vxx_dtc_stt_xxx ECU_ADDRESS 0xc00002b5 /end MEASUREMENT
/begin MEASUREMENT Vxx_dfctr_mis_4_cata "" UWORD _CNV_A_R_A_165_CM 1 0. 0. 65535. DISPLAY_IDENTIFIER fm_sta_mis_4_cata.Vxx_dfctr_xxx ECU_ADDRESS 0xc00002b6 /end MEASUREMENT
/begin MEASUREMENT Vxx_rdn_mis_4_cata "" UWORD _CNV_A_R_A_165_CM 1 0. 0. 65535. DISPLAY_IDENTIFIER fm_sta_mis_4_cata.Vxx_rdn_xxx ECU_ADDRESS 0xc00002b8 /end MEASUREMENT
/begin MEASUREMENT Vbx_cf_mis_4_cata "" UBYTE _CNV_A_R_A_165_CM 1 0. 0. 255. DISPLAY_IDENTIFIER fm_sta_mis_4_cata.fm_static_bitfield.Vbx_cf_xxx ECU_ADDRESS 0xc00002ba BIT_MASK 0x1 /end MEASUREMENT
/begin MEASUREMENT Vbx_clf_mis_4_cata "" UBYTE _CNV_A_R_A_165_CM 1 0. 0. 255. DISPLAY_IDENTIFIER fm_sta_mis_4_cata.fm_static_bitfield.Vbx_clf_xxx ECU_ADDRESS 0xc00002ba BIT_MASK 0x2 /end MEASUREMENT
/begin MEASUREMENT Vbx_df_old_mis_4_cata "" UBYTE _CNV_A_R_A_165_CM 1 0. 0. 255. DISPLAY_IDENTIFIER fm_sta_mis_4_cata.fm_static_bitfield.Vbx_df_old_xxx ECU_ADDRESS 0xc00002ba BIT_MASK 0x4 /end MEASUREMENT
/begin MEASUREMENT Vbx_dfctr_sat_mis_4_cata "" UBYTE _CNV_A_R_A_165_CM 1 0. 0. 255. DISPLAY_IDENTIFIER fm_sta_mis_4_cata.fm_static_bitfield.Vbx_dfctr_sat_xxx ECU_ADDRESS 0xc00002ba BIT_MASK 0x8 /end MEASUREMENT
/begin MEASUREMENT Vbx_rdn_mis_4_cata "" UBYTE _CNV_A_R_A_165_CM 1 0. 0. 255. DISPLAY_IDENTIFIER fm_sta_mis_4_cata.fm_static_bitfield.Vbx_rdn_xxx ECU_ADDRESS 0xc00002ba BIT_MASK 0x40 /end MEASUREMENT
/begin MEASUREMENT Vxx_dtc_stt_mis_4_cata "" UBYTE _CNV_A_R_A_165_CM 1 0. 0. 255. DISPLAY_IDENTIFIER fm_sta_mis_4_cata.Vxx_dtc_stt_xxx ECU_ADDRESS 0xc00002bb /end MEASUREMENT
/begin MEASUREMENT Vxx_dfctr_mis_4_lpg_cata "" UWORD _CNV_A_R_A_165_CM 1 0. 0. 65535. DISPLAY_IDENTIFIER fm_sta_mis_4_lpg_cata.Vxx_dfctr_xxx ECU_ADDRESS 0xc00002bc /end MEASUREMENT
/begin MEASUREMENT Vxx_rdn_mis_4_lpg_cata "" UWORD _CNV_A_R_A_165_CM 1 0. 0. 65535. DISPLAY_IDENTIFIER fm_sta_mis_4_lpg_cata.Vxx_rdn_xxx ECU_ADDRESS 0xc00002be /end MEASUREMENT
/begin MEASUREMENT Vbx_cf_mis_4_lpg_cata "" UBYTE _CNV_A_R_A_165_CM 1 0. 0. 255. DISPLAY_IDENTIFIER fm_sta_mis_4_lpg_cata.fm_static_bitfield.Vbx_cf_xxx ECU_ADDRESS 0xc00002c0 BIT_MASK 0x1 /end MEASUREMENT
/begin MEASUREMENT Vbx_clf_mis_4_lpg_cata "" UBYTE _CNV_A_R_A_165_CM 1 0. 0. 255. DISPLAY_IDENTIFIER fm_sta_mis_4_lpg_cata.fm_static_bitfield.Vbx_clf_xxx ECU_ADDRESS 0xc00002c0 BIT_MASK 0x2 /end MEASUREMENT
/begin MEASUREMENT Vbx_df_old_mis_4_lpg_cata "" UBYTE _CNV_A_R_A_165_CM 1 0. 0. 255. DISPLAY_IDENTIFIER fm_sta_mis_4_lpg_cata.fm_static_bitfield.Vbx_df_old_xxx ECU_ADDRESS 0xc00002c0 BIT_MASK 0x4 /end MEASUREMENT
/begin MEASUREMENT Vbx_dfctr_sat_mis_4_lpg_cata "" UBYTE _CNV_A_R_A_165_CM 1 0. 0. 255. DISPLAY_IDENTIFIER fm_sta_mis_4_lpg_cata.fm_static_bitfield.Vbx_dfctr_sat_xxx ECU_ADDRESS 0xc00002c0 BIT_MASK 0x8 /end MEASUREMENT
/begin MEASUREMENT Vbx_rdn_mis_4_lpg_cata "" UBYTE _CNV_A_R_A_165_CM 1 0. 0. 255. DISPLAY_IDENTIFIER fm_sta_mis_4_lpg_cata.fm_static_bitfield.Vbx_rdn_xxx ECU_ADDRESS 0xc00002c0 BIT_MASK 0x40 /end MEASUREMENT
/begin MEASUREMENT Vxx_dtc_stt_mis_4_lpg_cata "" UBYTE _CNV_A_R_A_165_CM 1 0. 0. 255. DISPLAY_IDENTIFIER fm_sta_mis_4_lpg_cata.Vxx_dtc_stt_xxx ECU_ADDRESS 0xc00002c1 /end MEASUREMENT
/begin MEASUREMENT Vxx_dfctr_mis_4_lpg_trs_h "" UWORD _CNV_A_R_A_165_CM 1 0. 0. 65535. DISPLAY_IDENTIFIER fm_sta_mis_4_lpg_trs_h.Vxx_dfctr_xxx ECU_ADDRESS 0xc00002c2 /end MEASUREMENT
/begin MEASUREMENT Vxx_rdn_mis_4_lpg_trs_h "" UWORD _CNV_A_R_A_165_CM 1 0. 0. 65535. DISPLAY_IDENTIFIER fm_sta_mis_4_lpg_trs_h.Vxx_rdn_xxx ECU_ADDRESS 0xc00002c4 /end MEASUREMENT
/begin MEASUREMENT Vbx_cf_mis_4_lpg_trs_h "" UBYTE _CNV_A_R_A_165_CM 1 0. 0. 255. DISPLAY_IDENTIFIER fm_sta_mis_4_lpg_trs_h.fm_static_bitfield.Vbx_cf_xxx ECU_ADDRESS 0xc00002c6 BIT_MASK 0x1 /end MEASUREMENT
/begin MEASUREMENT Vbx_clf_mis_4_lpg_trs_h "" UBYTE _CNV_A_R_A_165_CM 1 0. 0. 255. DISPLAY_IDENTIFIER fm_sta_mis_4_lpg_trs_h.fm_static_bitfield.Vbx_clf_xxx ECU_ADDRESS 0xc00002c6 BIT_MASK 0x2 /end MEASUREMENT
/begin MEASUREMENT Vbx_df_old_mis_4_lpg_trs_h "" UBYTE _CNV_A_R_A_165_CM 1 0. 0. 255. DISPLAY_IDENTIFIER fm_sta_mis_4_lpg_trs_h.fm_static_bitfield.Vbx_df_old_xxx ECU_ADDRESS 0xc00002c6 BIT_MASK 0x4 /end MEASUREMENT
/begin MEASUREMENT Vbx_dfctr_sat_mis_4_lpg_trs_h "" UBYTE _CNV_A_R_A_165_CM 1 0. 0. 255. DISPLAY_IDENTIFIER fm_sta_mis_4_lpg_trs_h.fm_static_bitfield.Vbx_dfctr_sat_xxx ECU_ADDRESS 0xc00002c6 BIT_MASK 0x8 /end MEASUREMENT
/begin MEASUREMENT Vbx_rdn_mis_4_lpg_trs_h "" UBYTE _CNV_A_R_A_165_CM 1 0. 0. 255. DISPLAY_IDENTIFIER fm_sta_mis_4_lpg_trs_h.fm_static_bitfield.Vbx_rdn_xxx ECU_ADDRESS 0xc00002c6 BIT_MASK 0x40 /end MEASUREMENT
/begin MEASUREMENT Vxx_dtc_stt_mis_4_lpg_trs_h "" UBYTE _CNV_A_R_A_165_CM 1 0. 0. 255. DISPLAY_IDENTIFIER fm_sta_mis_4_lpg_trs_h.Vxx_dtc_stt_xxx ECU_ADDRESS 0xc00002c7 /end MEASUREMENT
/begin MEASUREMENT Vxx_dfctr_mis_4_trs_h "" UWORD _CNV_A_R_A_165_CM 1 0. 0. 65535. DISPLAY_IDENTIFIER fm_sta_mis_4_trs_h.Vxx_dfctr_xxx ECU_ADDRESS 0xc00002c8 /end MEASUREMENT
/begin MEASUREMENT Vxx_rdn_mis_4_trs_h "" UWORD _CNV_A_R_A_165_CM 1 0. 0. 65535. DISPLAY_IDENTIFIER fm_sta_mis_4_trs_h.Vxx_rdn_xxx ECU_ADDRESS 0xc00002ca /end MEASUREMENT
/begin MEASUREMENT Vbx_cf_mis_4_trs_h "" UBYTE _CNV_A_R_A_165_CM 1 0. 0. 255. DISPLAY_IDENTIFIER fm_sta_mis_4_trs_h.fm_static_bitfield.Vbx_cf_xxx ECU_ADDRESS 0xc00002cc BIT_MASK 0x1 /end MEASUREMENT
/begin MEASUREMENT Vbx_clf_mis_4_trs_h "" UBYTE _CNV_A_R_A_165_CM 1 0. 0. 255. DISPLAY_IDENTIFIER fm_sta_mis_4_trs_h.fm_static_bitfield.Vbx_clf_xxx ECU_ADDRESS 0xc00002cc BIT_MASK 0x2 /end MEASUREMENT
/begin MEASUREMENT Vbx_df_old_mis_4_trs_h "" UBYTE _CNV_A_R_A_165_CM 1 0. 0. 255. DISPLAY_IDENTIFIER fm_sta_mis_4_trs_h.fm_static_bitfield.Vbx_df_old_xxx ECU_ADDRESS 0xc00002cc BIT_MASK 0x4 /end MEASUREMENT
/begin MEASUREMENT Vbx_dfctr_sat_mis_4_trs_h "" UBYTE _CNV_A_R_A_165_CM 1 0. 0. 255. DISPLAY_IDENTIFIER fm_sta_mis_4_trs_h.fm_static_bitfield.Vbx_dfctr_sat_xxx ECU_ADDRESS 0xc00002cc BIT_MASK 0x8 /end MEASUREMENT
/begin MEASUREMENT Vbx_rdn_mis_4_trs_h "" UBYTE _CNV_A_R_A_165_CM 1 0. 0. 255. DISPLAY_IDENTIFIER fm_sta_mis_4_trs_h.fm_static_bitfield.Vbx_rdn_xxx ECU_ADDRESS 0xc00002cc BIT_MASK 0x40 /end MEASUREMENT
/begin MEASUREMENT Vxx_dtc_stt_mis_4_trs_h "" UBYTE _CNV_A_R_A_165_CM 1 0. 0. 255. DISPLAY_IDENTIFIER fm_sta_mis_4_trs_h.Vxx_dtc_stt_xxx ECU_ADDRESS 0xc00002cd /end MEASUREMENT
/begin MEASUREMENT Vxx_dfctr_mis_cata "" UWORD _CNV_A_R_A_165_CM 1 0. 0. 65535. DISPLAY_IDENTIFIER fm_sta_mis_cata.Vxx_dfctr_xxx ECU_ADDRESS 0xc00002ce /end MEASUREMENT
/begin MEASUREMENT Vxx_rdn_mis_cata "" UWORD _CNV_A_R_A_165_CM 1 0. 0. 65535. DISPLAY_IDENTIFIER fm_sta_mis_cata.Vxx_rdn_xxx ECU_ADDRESS 0xc00002d0 /end MEASUREMENT
/begin MEASUREMENT Vbx_cf_mis_cata "" UBYTE _CNV_A_R_A_165_CM 1 0. 0. 255. DISPLAY_IDENTIFIER fm_sta_mis_cata.fm_static_bitfield.Vbx_cf_xxx ECU_ADDRESS 0xc00002d2 BIT_MASK 0x1 /end MEASUREMENT
/begin MEASUREMENT Vbx_clf_mis_cata "" UBYTE _CNV_A_R_A_165_CM 1 0. 0. 255. DISPLAY_IDENTIFIER fm_sta_mis_cata.fm_static_bitfield.Vbx_clf_xxx ECU_ADDRESS 0xc00002d2 BIT_MASK 0x2 /end MEASUREMENT
/begin MEASUREMENT Vbx_df_old_mis_cata "" UBYTE _CNV_A_R_A_165_CM 1 0. 0. 255. DISPLAY_IDENTIFIER fm_sta_mis_cata.fm_static_bitfield.Vbx_df_old_xxx ECU_ADDRESS 0xc00002d2 BIT_MASK 0x4 /end MEASUREMENT
/begin MEASUREMENT Vbx_dfctr_sat_mis_cata "" UBYTE _CNV_A_R_A_165_CM 1 0. 0. 255. DISPLAY_IDENTIFIER fm_sta_mis_cata.fm_static_bitfield.Vbx_dfctr_sat_xxx ECU_ADDRESS 0xc00002d2 BIT_MASK 0x8 /end MEASUREMENT
/begin MEASUREMENT Vbx_rdn_mis_cata "" UBYTE _CNV_A_R_A_165_CM 1 0. 0. 255. DISPLAY_IDENTIFIER fm_sta_mis_cata.fm_static_bitfield.Vbx_rdn_xxx ECU_ADDRESS 0xc00002d2 BIT_MASK 0x40 /end MEASUREMENT
/begin MEASUREMENT Vxx_dtc_stt_mis_cata "" UBYTE _CNV_A_R_A_165_CM 1 0. 0. 255. DISPLAY_IDENTIFIER fm_sta_mis_cata.Vxx_dtc_stt_xxx ECU_ADDRESS 0xc00002d3 /end MEASUREMENT
/begin MEASUREMENT Vxx_dfctr_mis_lpg_cata "" UWORD _CNV_A_R_A_165_CM 1 0. 0. 65535. DISPLAY_IDENTIFIER fm_sta_mis_lpg_cata.Vxx_dfctr_xxx ECU_ADDRESS 0xc00002d4 /end MEASUREMENT
/begin MEASUREMENT Vxx_rdn_mis_lpg_cata "" UWORD _CNV_A_R_A_165_CM 1 0. 0. 65535. DISPLAY_IDENTIFIER fm_sta_mis_lpg_cata.Vxx_rdn_xxx ECU_ADDRESS 0xc00002d6 /end MEASUREMENT
/begin MEASUREMENT Vbx_cf_mis_lpg_cata "" UBYTE _CNV_A_R_A_165_CM 1 0. 0. 255. DISPLAY_IDENTIFIER fm_sta_mis_lpg_cata.fm_static_bitfield.Vbx_cf_xxx ECU_ADDRESS 0xc00002d8 BIT_MASK 0x1 /end MEASUREMENT
/begin MEASUREMENT Vbx_clf_mis_lpg_cata "" UBYTE _CNV_A_R_A_165_CM 1 0. 0. 255. DISPLAY_IDENTIFIER fm_sta_mis_lpg_cata.fm_static_bitfield.Vbx_clf_xxx ECU_ADDRESS 0xc00002d8 BIT_MASK 0x2 /end MEASUREMENT
/begin MEASUREMENT Vbx_df_old_mis_lpg_cata "" UBYTE _CNV_A_R_A_165_CM 1 0. 0. 255. DISPLAY_IDENTIFIER fm_sta_mis_lpg_cata.fm_static_bitfield.Vbx_df_old_xxx ECU_ADDRESS 0xc00002d8 BIT_MASK 0x4 /end MEASUREMENT
/begin MEASUREMENT Vbx_dfctr_sat_mis_lpg_cata "" UBYTE _CNV_A_R_A_165_CM 1 0. 0. 255. DISPLAY_IDENTIFIER fm_sta_mis_lpg_cata.fm_static_bitfield.Vbx_dfctr_sat_xxx ECU_ADDRESS 0xc00002d8 BIT_MASK 0x8 /end MEASUREMENT
/begin MEASUREMENT Vbx_rdn_mis_lpg_cata "" UBYTE _CNV_A_R_A_165_CM 1 0. 0. 255. DISPLAY_IDENTIFIER fm_sta_mis_lpg_cata.fm_static_bitfield.Vbx_rdn_xxx ECU_ADDRESS 0xc00002d8 BIT_MASK 0x40 /end MEASUREMENT
/begin MEASUREMENT Vxx_dtc_stt_mis_lpg_cata "" UBYTE _CNV_A_R_A_165_CM 1 0. 0. 255. DISPLAY_IDENTIFIER fm_sta_mis_lpg_cata.Vxx_dtc_stt_xxx ECU_ADDRESS 0xc00002d9 /end MEASUREMENT
/begin MEASUREMENT Vxx_dfctr_mis_lpg_trs_h "" UWORD _CNV_A_R_A_165_CM 1 0. 0. 65535. DISPLAY_IDENTIFIER fm_sta_mis_lpg_trs_h.Vxx_dfctr_xxx ECU_ADDRESS 0xc00002da /end MEASUREMENT
/begin MEASUREMENT Vxx_rdn_mis_lpg_trs_h "" UWORD _CNV_A_R_A_165_CM 1 0. 0. 65535. DISPLAY_IDENTIFIER fm_sta_mis_lpg_trs_h.Vxx_rdn_xxx ECU_ADDRESS 0xc00002dc /end MEASUREMENT
/begin MEASUREMENT Vbx_cf_mis_lpg_trs_h "" UBYTE _CNV_A_R_A_165_CM 1 0. 0. 255. DISPLAY_IDENTIFIER fm_sta_mis_lpg_trs_h.fm_static_bitfield.Vbx_cf_xxx ECU_ADDRESS 0xc00002de BIT_MASK 0x1 /end MEASUREMENT
/begin MEASUREMENT Vbx_clf_mis_lpg_trs_h "" UBYTE _CNV_A_R_A_165_CM 1 0. 0. 255. DISPLAY_IDENTIFIER fm_sta_mis_lpg_trs_h.fm_static_bitfield.Vbx_clf_xxx ECU_ADDRESS 0xc00002de BIT_MASK 0x2 /end MEASUREMENT
/begin MEASUREMENT Vbx_df_old_mis_lpg_trs_h "" UBYTE _CNV_A_R_A_165_CM 1 0. 0. 255. DISPLAY_IDENTIFIER fm_sta_mis_lpg_trs_h.fm_static_bitfield.Vbx_df_old_xxx ECU_ADDRESS 0xc00002de BIT_MASK 0x4 /end MEASUREMENT
/begin MEASUREMENT Vbx_dfctr_sat_mis_lpg_trs_h "" UBYTE _CNV_A_R_A_165_CM 1 0. 0. 255. DISPLAY_IDENTIFIER fm_sta_mis_lpg_trs_h.fm_static_bitfield.Vbx_dfctr_sat_xxx ECU_ADDRESS 0xc00002de BIT_MASK 0x8 /end MEASUREMENT
/begin MEASUREMENT Vbx_rdn_mis_lpg_trs_h "" UBYTE _CNV_A_R_A_165_CM 1 0. 0. 255. DISPLAY_IDENTIFIER fm_sta_mis_lpg_trs_h.fm_static_bitfield.Vbx_rdn_xxx ECU_ADDRESS 0xc00002de BIT_MASK 0x40 /end MEASUREMENT
/begin MEASUREMENT Vxx_dtc_stt_mis_lpg_trs_h "" UBYTE _CNV_A_R_A_165_CM 1 0. 0. 255. DISPLAY_IDENTIFIER fm_sta_mis_lpg_trs_h.Vxx_dtc_stt_xxx ECU_ADDRESS 0xc00002df /end MEASUREMENT
/begin MEASUREMENT Vxx_dfctr_mis_min_fuel_cata "" UWORD _CNV_A_R_A_165_CM 1 0. 0. 65535. DISPLAY_IDENTIFIER fm_sta_mis_min_fuel_cata.Vxx_dfctr_xxx ECU_ADDRESS 0xc00002e0 /end MEASUREMENT
/begin MEASUREMENT Vxx_rdn_mis_min_fuel_cata "" UWORD _CNV_A_R_A_165_CM 1 0. 0. 65535. DISPLAY_IDENTIFIER fm_sta_mis_min_fuel_cata.Vxx_rdn_xxx ECU_ADDRESS 0xc00002e2 /end MEASUREMENT
/begin MEASUREMENT Vbx_cf_mis_min_fuel_cata "" UBYTE _CNV_A_R_A_165_CM 1 0. 0. 255. DISPLAY_IDENTIFIER fm_sta_mis_min_fuel_cata.fm_static_bitfield.Vbx_cf_xxx ECU_ADDRESS 0xc00002e4 BIT_MASK 0x1 /end MEASUREMENT
/begin MEASUREMENT Vbx_clf_mis_min_fuel_cata "" UBYTE _CNV_A_R_A_165_CM 1 0. 0. 255. DISPLAY_IDENTIFIER fm_sta_mis_min_fuel_cata.fm_static_bitfield.Vbx_clf_xxx ECU_ADDRESS 0xc00002e4 BIT_MASK 0x2 /end MEASUREMENT
/begin MEASUREMENT Vbx_df_old_mis_min_fuel_cata "" UBYTE _CNV_A_R_A_165_CM 1 0. 0. 255. DISPLAY_IDENTIFIER fm_sta_mis_min_fuel_cata.fm_static_bitfield.Vbx_df_old_xxx ECU_ADDRESS 0xc00002e4 BIT_MASK 0x4 /end MEASUREMENT
/begin MEASUREMENT Vbx_dfctr_sat_mis_min_fuel_cata "" UBYTE _CNV_A_R_A_165_CM 1 0. 0. 255. DISPLAY_IDENTIFIER fm_sta_mis_min_fuel_cata.fm_static_bitfield.Vbx_dfctr_sat_xxx ECU_ADDRESS 0xc00002e4 BIT_MASK 0x8 /end MEASUREMENT
/begin MEASUREMENT Vbx_rdn_mis_min_fuel_cata "" UBYTE _CNV_A_R_A_165_CM 1 0. 0. 255. DISPLAY_IDENTIFIER fm_sta_mis_min_fuel_cata.fm_static_bitfield.Vbx_rdn_xxx ECU_ADDRESS 0xc00002e4 BIT_MASK 0x40 /end MEASUREMENT
/begin MEASUREMENT Vxx_dtc_stt_mis_min_fuel_cata "" UBYTE _CNV_A_R_A_165_CM 1 0. 0. 255. DISPLAY_IDENTIFIER fm_sta_mis_min_fuel_cata.Vxx_dtc_stt_xxx ECU_ADDRESS 0xc00002e5 /end MEASUREMENT
/begin MEASUREMENT Vxx_dfctr_mis_min_fuel_trs_h "" UWORD _CNV_A_R_A_165_CM 1 0. 0. 65535. DISPLAY_IDENTIFIER fm_sta_mis_min_fuel_trs_h.Vxx_dfctr_xxx ECU_ADDRESS 0xc00002e6 /end MEASUREMENT
/begin MEASUREMENT Vxx_rdn_mis_min_fuel_trs_h "" UWORD _CNV_A_R_A_165_CM 1 0. 0. 65535. DISPLAY_IDENTIFIER fm_sta_mis_min_fuel_trs_h.Vxx_rdn_xxx ECU_ADDRESS 0xc00002e8 /end MEASUREMENT
/begin MEASUREMENT Vbx_cf_mis_min_fuel_trs_h "" UBYTE _CNV_A_R_A_165_CM 1 0. 0. 255. DISPLAY_IDENTIFIER fm_sta_mis_min_fuel_trs_h.fm_static_bitfield.Vbx_cf_xxx ECU_ADDRESS 0xc00002ea BIT_MASK 0x1 /end MEASUREMENT
/begin MEASUREMENT Vbx_clf_mis_min_fuel_trs_h "" UBYTE _CNV_A_R_A_165_CM 1 0. 0. 255. DISPLAY_IDENTIFIER fm_sta_mis_min_fuel_trs_h.fm_static_bitfield.Vbx_clf_xxx ECU_ADDRESS 0xc00002ea BIT_MASK 0x2 /end MEASUREMENT
/begin MEASUREMENT Vbx_df_old_mis_min_fuel_trs_h "" UBYTE _CNV_A_R_A_165_CM 1 0. 0. 255. DISPLAY_IDENTIFIER fm_sta_mis_min_fuel_trs_h.fm_static_bitfield.Vbx_df_old_xxx ECU_ADDRESS 0xc00002ea BIT_MASK 0x4 /end MEASUREMENT
/begin MEASUREMENT Vbx_dfctr_sat_mis_min_fuel_trs_h "" UBYTE _CNV_A_R_A_165_CM 1 0. 0. 255. DISPLAY_IDENTIFIER fm_sta_mis_min_fuel_trs_h.fm_static_bitfield.Vbx_dfctr_sat_xxx ECU_ADDRESS 0xc00002ea BIT_MASK 0x8 /end MEASUREMENT
/begin MEASUREMENT Vbx_rdn_mis_min_fuel_trs_h "" UBYTE _CNV_A_R_A_165_CM 1 0. 0. 255. DISPLAY_IDENTIFIER fm_sta_mis_min_fuel_trs_h.fm_static_bitfield.Vbx_rdn_xxx ECU_ADDRESS 0xc00002ea BIT_MASK 0x40 /end MEASUREMENT
/begin MEASUREMENT Vxx_dtc_stt_mis_min_fuel_trs_h "" UBYTE _CNV_A_R_A_165_CM 1 0. 0. 255. DISPLAY_IDENTIFIER fm_sta_mis_min_fuel_trs_h.Vxx_dtc_stt_xxx ECU_ADDRESS 0xc00002eb /end MEASUREMENT
/begin MEASUREMENT Vxx_dfctr_mis_trs_h "" UWORD _CNV_A_R_A_165_CM 1 0. 0. 65535. DISPLAY_IDENTIFIER fm_sta_mis_trs_h.Vxx_dfctr_xxx ECU_ADDRESS 0xc00002ec /end MEASUREMENT
/begin MEASUREMENT Vxx_rdn_mis_trs_h "" UWORD _CNV_A_R_A_165_CM 1 0. 0. 65535. DISPLAY_IDENTIFIER fm_sta_mis_trs_h.Vxx_rdn_xxx ECU_ADDRESS 0xc00002ee /end MEASUREMENT
/begin MEASUREMENT Vbx_cf_mis_trs_h "" UBYTE _CNV_A_R_A_165_CM 1 0. 0. 255. DISPLAY_IDENTIFIER fm_sta_mis_trs_h.fm_static_bitfield.Vbx_cf_xxx ECU_ADDRESS 0xc00002f0 BIT_MASK 0x1 /end MEASUREMENT
/begin MEASUREMENT Vbx_clf_mis_trs_h "" UBYTE _CNV_A_R_A_165_CM 1 0. 0. 255. DISPLAY_IDENTIFIER fm_sta_mis_trs_h.fm_static_bitfield.Vbx_clf_xxx ECU_ADDRESS 0xc00002f0 BIT_MASK 0x2 /end MEASUREMENT
/begin MEASUREMENT Vbx_df_old_mis_trs_h "" UBYTE _CNV_A_R_A_165_CM 1 0. 0. 255. DISPLAY_IDENTIFIER fm_sta_mis_trs_h.fm_static_bitfield.Vbx_df_old_xxx ECU_ADDRESS 0xc00002f0 BIT_MASK 0x4 /end MEASUREMENT
/begin MEASUREMENT Vbx_dfctr_sat_mis_trs_h "" UBYTE _CNV_A_R_A_165_CM 1 0. 0. 255. DISPLAY_IDENTIFIER fm_sta_mis_trs_h.fm_static_bitfield.Vbx_dfctr_sat_xxx ECU_ADDRESS 0xc00002f0 BIT_MASK 0x8 /end MEASUREMENT
/begin MEASUREMENT Vbx_rdn_mis_trs_h "" UBYTE _CNV_A_R_A_165_CM 1 0. 0. 255. DISPLAY_IDENTIFIER fm_sta_mis_trs_h.fm_static_bitfield.Vbx_rdn_xxx ECU_ADDRESS 0xc00002f0 BIT_MASK 0x40 /end MEASUREMENT
/begin MEASUREMENT Vxx_dtc_stt_mis_trs_h "" UBYTE _CNV_A_R_A_165_CM 1 0. 0. 255. DISPLAY_IDENTIFIER fm_sta_mis_trs_h.Vxx_dtc_stt_xxx ECU_ADDRESS 0xc00002f1 /end MEASUREMENT
/begin MEASUREMENT Vxx_dfctr_mis_unk_cata "" UWORD _CNV_A_R_A_165_CM 1 0. 0. 65535. DISPLAY_IDENTIFIER fm_sta_mis_unk_cata.Vxx_dfctr_xxx ECU_ADDRESS 0xc00002f2 /end MEASUREMENT
/begin MEASUREMENT Vxx_rdn_mis_unk_cata "" UWORD _CNV_A_R_A_165_CM 1 0. 0. 65535. DISPLAY_IDENTIFIER fm_sta_mis_unk_cata.Vxx_rdn_xxx ECU_ADDRESS 0xc00002f4 /end MEASUREMENT
/begin MEASUREMENT Vbx_cf_mis_unk_cata "" UBYTE _CNV_A_R_A_165_CM 1 0. 0. 255. DISPLAY_IDENTIFIER fm_sta_mis_unk_cata.fm_static_bitfield.Vbx_cf_xxx ECU_ADDRESS 0xc00002f6 BIT_MASK 0x1 /end MEASUREMENT
/begin MEASUREMENT Vbx_clf_mis_unk_cata "" UBYTE _CNV_A_R_A_165_CM 1 0. 0. 255. DISPLAY_IDENTIFIER fm_sta_mis_unk_cata.fm_static_bitfield.Vbx_clf_xxx ECU_ADDRESS 0xc00002f6 BIT_MASK 0x2 /end MEASUREMENT
/begin MEASUREMENT Vbx_df_old_mis_unk_cata "" UBYTE _CNV_A_R_A_165_CM 1 0. 0. 255. DISPLAY_IDENTIFIER fm_sta_mis_unk_cata.fm_static_bitfield.Vbx_df_old_xxx ECU_ADDRESS 0xc00002f6 BIT_MASK 0x4 /end MEASUREMENT
/begin MEASUREMENT Vbx_dfctr_sat_mis_unk_cata "" UBYTE _CNV_A_R_A_165_CM 1 0. 0. 255. DISPLAY_IDENTIFIER fm_sta_mis_unk_cata.fm_static_bitfield.Vbx_dfctr_sat_xxx ECU_ADDRESS 0xc00002f6 BIT_MASK 0x8 /end MEASUREMENT
/begin MEASUREMENT Vbx_rdn_mis_unk_cata "" UBYTE _CNV_A_R_A_165_CM 1 0. 0. 255. DISPLAY_IDENTIFIER fm_sta_mis_unk_cata.fm_static_bitfield.Vbx_rdn_xxx ECU_ADDRESS 0xc00002f6 BIT_MASK 0x40 /end MEASUREMENT
/begin MEASUREMENT Vxx_dtc_stt_mis_unk_cata "" UBYTE _CNV_A_R_A_165_CM 1 0. 0. 255. DISPLAY_IDENTIFIER fm_sta_mis_unk_cata.Vxx_dtc_stt_xxx ECU_ADDRESS 0xc00002f7 /end MEASUREMENT
/begin MEASUREMENT Vxx_dfctr_mis_unk_lpg_cata "" UWORD _CNV_A_R_A_165_CM 1 0. 0. 65535. DISPLAY_IDENTIFIER fm_sta_mis_unk_lpg_cata.Vxx_dfctr_xxx ECU_ADDRESS 0xc00002f8 /end MEASUREMENT
/begin MEASUREMENT Vxx_rdn_mis_unk_lpg_cata "" UWORD _CNV_A_R_A_165_CM 1 0. 0. 65535. DISPLAY_IDENTIFIER fm_sta_mis_unk_lpg_cata.Vxx_rdn_xxx ECU_ADDRESS 0xc00002fa /end MEASUREMENT
/begin MEASUREMENT Vbx_cf_mis_unk_lpg_cata "" UBYTE _CNV_A_R_A_165_CM 1 0. 0. 255. DISPLAY_IDENTIFIER fm_sta_mis_unk_lpg_cata.fm_static_bitfield.Vbx_cf_xxx ECU_ADDRESS 0xc00002fc BIT_MASK 0x1 /end MEASUREMENT
/begin MEASUREMENT Vbx_clf_mis_unk_lpg_cata "" UBYTE _CNV_A_R_A_165_CM 1 0. 0. 255. DISPLAY_IDENTIFIER fm_sta_mis_unk_lpg_cata.fm_static_bitfield.Vbx_clf_xxx ECU_ADDRESS 0xc00002fc BIT_MASK 0x2 /end MEASUREMENT
/begin MEASUREMENT Vbx_df_old_mis_unk_lpg_cata "" UBYTE _CNV_A_R_A_165_CM 1 0. 0. 255. DISPLAY_IDENTIFIER fm_sta_mis_unk_lpg_cata.fm_static_bitfield.Vbx_df_old_xxx ECU_ADDRESS 0xc00002fc BIT_MASK 0x4 /end MEASUREMENT
/begin MEASUREMENT Vbx_dfctr_sat_mis_unk_lpg_cata "" UBYTE _CNV_A_R_A_165_CM 1 0. 0. 255. DISPLAY_IDENTIFIER fm_sta_mis_unk_lpg_cata.fm_static_bitfield.Vbx_dfctr_sat_xxx ECU_ADDRESS 0xc00002fc BIT_MASK 0x8 /end MEASUREMENT
/begin MEASUREMENT Vbx_rdn_mis_unk_lpg_cata "" UBYTE _CNV_A_R_A_165_CM 1 0. 0. 255. DISPLAY_IDENTIFIER fm_sta_mis_unk_lpg_cata.fm_static_bitfield.Vbx_rdn_xxx ECU_ADDRESS 0xc00002fc BIT_MASK 0x40 /end MEASUREMENT
/begin MEASUREMENT Vxx_dtc_stt_mis_unk_lpg_cata "" UBYTE _CNV_A_R_A_165_CM 1 0. 0. 255. DISPLAY_IDENTIFIER fm_sta_mis_unk_lpg_cata.Vxx_dtc_stt_xxx ECU_ADDRESS 0xc00002fd /end MEASUREMENT
/begin MEASUREMENT Vxx_dfctr_mis_unk_lpg_trs_h "" UWORD _CNV_A_R_A_165_CM 1 0. 0. 65535. DISPLAY_IDENTIFIER fm_sta_mis_unk_lpg_trs_h.Vxx_dfctr_xxx ECU_ADDRESS 0xc00002fe /end MEASUREMENT
/begin MEASUREMENT Vxx_rdn_mis_unk_lpg_trs_h "" UWORD _CNV_A_R_A_165_CM 1 0. 0. 65535. DISPLAY_IDENTIFIER fm_sta_mis_unk_lpg_trs_h.Vxx_rdn_xxx ECU_ADDRESS 0xc0000300 /end MEASUREMENT
/begin MEASUREMENT Vbx_cf_mis_unk_lpg_trs_h "" UBYTE _CNV_A_R_A_165_CM 1 0. 0. 255. DISPLAY_IDENTIFIER fm_sta_mis_unk_lpg_trs_h.fm_static_bitfield.Vbx_cf_xxx ECU_ADDRESS 0xc0000302 BIT_MASK 0x1 /end MEASUREMENT
/begin MEASUREMENT Vbx_clf_mis_unk_lpg_trs_h "" UBYTE _CNV_A_R_A_165_CM 1 0. 0. 255. DISPLAY_IDENTIFIER fm_sta_mis_unk_lpg_trs_h.fm_static_bitfield.Vbx_clf_xxx ECU_ADDRESS 0xc0000302 BIT_MASK 0x2 /end MEASUREMENT
/begin MEASUREMENT Vbx_df_old_mis_unk_lpg_trs_h "" UBYTE _CNV_A_R_A_165_CM 1 0. 0. 255. DISPLAY_IDENTIFIER fm_sta_mis_unk_lpg_trs_h.fm_static_bitfield.Vbx_df_old_xxx ECU_ADDRESS 0xc0000302 BIT_MASK 0x4 /end MEASUREMENT
/begin MEASUREMENT Vbx_dfctr_sat_mis_unk_lpg_trs_h "" UBYTE _CNV_A_R_A_165_CM 1 0. 0. 255. DISPLAY_IDENTIFIER fm_sta_mis_unk_lpg_trs_h.fm_static_bitfield.Vbx_dfctr_sat_xxx ECU_ADDRESS 0xc0000302 BIT_MASK 0x8 /end MEASUREMENT
/begin MEASUREMENT Vbx_rdn_mis_unk_lpg_trs_h "" UBYTE _CNV_A_R_A_165_CM 1 0. 0. 255. DISPLAY_IDENTIFIER fm_sta_mis_unk_lpg_trs_h.fm_static_bitfield.Vbx_rdn_xxx ECU_ADDRESS 0xc0000302 BIT_MASK 0x40 /end MEASUREMENT
/begin MEASUREMENT Vxx_dtc_stt_mis_unk_lpg_trs_h "" UBYTE _CNV_A_R_A_165_CM 1 0. 0. 255. DISPLAY_IDENTIFIER fm_sta_mis_unk_lpg_trs_h.Vxx_dtc_stt_xxx ECU_ADDRESS 0xc0000303 /end MEASUREMENT
/begin MEASUREMENT Vxx_dfctr_mis_unk_trs_h "" UWORD _CNV_A_R_A_165_CM 1 0. 0. 65535. DISPLAY_IDENTIFIER fm_sta_mis_unk_trs_h.Vxx_dfctr_xxx ECU_ADDRESS 0xc0000304 /end MEASUREMENT
/begin MEASUREMENT Vxx_rdn_mis_unk_trs_h "" UWORD _CNV_A_R_A_165_CM 1 0. 0. 65535. DISPLAY_IDENTIFIER fm_sta_mis_unk_trs_h.Vxx_rdn_xxx ECU_ADDRESS 0xc0000306 /end MEASUREMENT
/begin MEASUREMENT Vbx_cf_mis_unk_trs_h "" UBYTE _CNV_A_R_A_165_CM 1 0. 0. 255. DISPLAY_IDENTIFIER fm_sta_mis_unk_trs_h.fm_static_bitfield.Vbx_cf_xxx ECU_ADDRESS 0xc0000308 BIT_MASK 0x1 /end MEASUREMENT
/begin MEASUREMENT Vbx_clf_mis_unk_trs_h "" UBYTE _CNV_A_R_A_165_CM 1 0. 0. 255. DISPLAY_IDENTIFIER fm_sta_mis_unk_trs_h.fm_static_bitfield.Vbx_clf_xxx ECU_ADDRESS 0xc0000308 BIT_MASK 0x2 /end MEASUREMENT
/begin MEASUREMENT Vbx_df_old_mis_unk_trs_h "" UBYTE _CNV_A_R_A_165_CM 1 0. 0. 255. DISPLAY_IDENTIFIER fm_sta_mis_unk_trs_h.fm_static_bitfield.Vbx_df_old_xxx ECU_ADDRESS 0xc0000308 BIT_MASK 0x4 /end MEASUREMENT
/begin MEASUREMENT Vbx_dfctr_sat_mis_unk_trs_h "" UBYTE _CNV_A_R_A_165_CM 1 0. 0. 255. DISPLAY_IDENTIFIER fm_sta_mis_unk_trs_h.fm_static_bitfield.Vbx_dfctr_sat_xxx ECU_ADDRESS 0xc0000308 BIT_MASK 0x8 /end MEASUREMENT
/begin MEASUREMENT Vbx_rdn_mis_unk_trs_h "" UBYTE _CNV_A_R_A_165_CM 1 0. 0. 255. DISPLAY_IDENTIFIER fm_sta_mis_unk_trs_h.fm_static_bitfield.Vbx_rdn_xxx ECU_ADDRESS 0xc0000308 BIT_MASK 0x40 /end MEASUREMENT
/begin MEASUREMENT Vxx_dtc_stt_mis_unk_trs_h "" UBYTE _CNV_A_R_A_165_CM 1 0. 0. 255. DISPLAY_IDENTIFIER fm_sta_mis_unk_trs_h.Vxx_dtc_stt_xxx ECU_ADDRESS 0xc0000309 /end MEASUREMENT
/begin MEASUREMENT Vxx_dfctr_ptc_rov_oc "" UWORD _CNV_A_R_A_165_CM 1 0. 0. 65535. DISPLAY_IDENTIFIER fm_sta_ptc_rov_oc.Vxx_dfctr_xxx ECU_ADDRESS 0xc000039a /end MEASUREMENT
/begin MEASUREMENT Vxx_rdn_ptc_rov_oc "" UWORD _CNV_A_R_A_165_CM 1 0. 0. 65535. DISPLAY_IDENTIFIER fm_sta_ptc_rov_oc.Vxx_rdn_xxx ECU_ADDRESS 0xc000039c /end MEASUREMENT
/begin MEASUREMENT Vbx_cf_ptc_rov_oc "" UBYTE _CNV_A_R_A_165_CM 1 0. 0. 255. DISPLAY_IDENTIFIER fm_sta_ptc_rov_oc.fm_static_bitfield.Vbx_cf_xxx ECU_ADDRESS 0xc000039e BIT_MASK 0x1 /end MEASUREMENT
/begin MEASUREMENT Vbx_clf_ptc_rov_oc "" UBYTE _CNV_A_R_A_165_CM 1 0. 0. 255. DISPLAY_IDENTIFIER fm_sta_ptc_rov_oc.fm_static_bitfield.Vbx_clf_xxx ECU_ADDRESS 0xc000039e BIT_MASK 0x2 /end MEASUREMENT
/begin MEASUREMENT Vbx_df_old_ptc_rov_oc "" UBYTE _CNV_A_R_A_165_CM 1 0. 0. 255. DISPLAY_IDENTIFIER fm_sta_ptc_rov_oc.fm_static_bitfield.Vbx_df_old_xxx ECU_ADDRESS 0xc000039e BIT_MASK 0x4 /end MEASUREMENT
/begin MEASUREMENT Vbx_dfctr_sat_ptc_rov_oc "" UBYTE _CNV_A_R_A_165_CM 1 0. 0. 255. DISPLAY_IDENTIFIER fm_sta_ptc_rov_oc.fm_static_bitfield.Vbx_dfctr_sat_xxx ECU_ADDRESS 0xc000039e BIT_MASK 0x8 /end MEASUREMENT
/begin MEASUREMENT Vbx_rdn_ptc_rov_oc "" UBYTE _CNV_A_R_A_165_CM 1 0. 0. 255. DISPLAY_IDENTIFIER fm_sta_ptc_rov_oc.fm_static_bitfield.Vbx_rdn_xxx ECU_ADDRESS 0xc000039e BIT_MASK 0x40 /end MEASUREMENT
/begin MEASUREMENT Vxx_dtc_stt_ptc_rov_oc "" UBYTE _CNV_A_R_A_165_CM 1 0. 0. 255. DISPLAY_IDENTIFIER fm_sta_ptc_rov_oc.Vxx_dtc_stt_xxx ECU_ADDRESS 0xc000039f /end MEASUREMENT
/begin MEASUREMENT Vxx_dfctr_ptc_rov_scg "" UWORD _CNV_A_R_A_165_CM 1 0. 0. 65535. DISPLAY_IDENTIFIER fm_sta_ptc_rov_scg.Vxx_dfctr_xxx ECU_ADDRESS 0xc00003a0 /end MEASUREMENT
/begin MEASUREMENT Vxx_rdn_ptc_rov_scg "" UWORD _CNV_A_R_A_165_CM 1 0. 0. 65535. DISPLAY_IDENTIFIER fm_sta_ptc_rov_scg.Vxx_rdn_xxx ECU_ADDRESS 0xc00003a2 /end MEASUREMENT
/begin MEASUREMENT Vbx_cf_ptc_rov_scg "" UBYTE _CNV_A_R_A_165_CM 1 0. 0. 255. DISPLAY_IDENTIFIER fm_sta_ptc_rov_scg.fm_static_bitfield.Vbx_cf_xxx ECU_ADDRESS 0xc00003a4 BIT_MASK 0x1 /end MEASUREMENT
/begin MEASUREMENT Vbx_clf_ptc_rov_scg "" UBYTE _CNV_A_R_A_165_CM 1 0. 0. 255. DISPLAY_IDENTIFIER fm_sta_ptc_rov_scg.fm_static_bitfield.Vbx_clf_xxx ECU_ADDRESS 0xc00003a4 BIT_MASK 0x2 /end MEASUREMENT
/begin MEASUREMENT Vbx_df_old_ptc_rov_scg "" UBYTE _CNV_A_R_A_165_CM 1 0. 0. 255. DISPLAY_IDENTIFIER fm_sta_ptc_rov_scg.fm_static_bitfield.Vbx_df_old_xxx ECU_ADDRESS 0xc00003a4 BIT_MASK 0x4 /end MEASUREMENT
/begin MEASUREMENT Vbx_dfctr_sat_ptc_rov_scg "" UBYTE _CNV_A_R_A_165_CM 1 0. 0. 255. DISPLAY_IDENTIFIER fm_sta_ptc_rov_scg.fm_static_bitfield.Vbx_dfctr_sat_xxx ECU_ADDRESS 0xc00003a4 BIT_MASK 0x8 /end MEASUREMENT
/begin MEASUREMENT Vbx_rdn_ptc_rov_scg "" UBYTE _CNV_A_R_A_165_CM 1 0. 0. 255. DISPLAY_IDENTIFIER fm_sta_ptc_rov_scg.fm_static_bitfield.Vbx_rdn_xxx ECU_ADDRESS 0xc00003a4 BIT_MASK 0x40 /end MEASUREMENT
/begin MEASUREMENT Vxx_dtc_stt_ptc_rov_scg "" UBYTE _CNV_A_R_A_165_CM 1 0. 0. 255. DISPLAY_IDENTIFIER fm_sta_ptc_rov_scg.Vxx_dtc_stt_xxx ECU_ADDRESS 0xc00003a5 /end MEASUREMENT
/begin MEASUREMENT Vxx_dfctr_ptc_rov_scw "" UWORD _CNV_A_R_A_165_CM 1 0. 0. 65535. DISPLAY_IDENTIFIER fm_sta_ptc_rov_scw.Vxx_dfctr_xxx ECU_ADDRESS 0xc00003a6 /end MEASUREMENT
/begin MEASUREMENT Vxx_rdn_ptc_rov_scw "" UWORD _CNV_A_R_A_165_CM 1 0. 0. 65535. DISPLAY_IDENTIFIER fm_sta_ptc_rov_scw.Vxx_rdn_xxx ECU_ADDRESS 0xc00003a8 /end MEASUREMENT
/begin MEASUREMENT Vbx_cf_ptc_rov_scw "" UBYTE _CNV_A_R_A_165_CM 1 0. 0. 255. DISPLAY_IDENTIFIER fm_sta_ptc_rov_scw.fm_static_bitfield.Vbx_cf_xxx ECU_ADDRESS 0xc00003aa BIT_MASK 0x1 /end MEASUREMENT
/begin MEASUREMENT Vbx_clf_ptc_rov_scw "" UBYTE _CNV_A_R_A_165_CM 1 0. 0. 255. DISPLAY_IDENTIFIER fm_sta_ptc_rov_scw.fm_static_bitfield.Vbx_clf_xxx ECU_ADDRESS 0xc00003aa BIT_MASK 0x2 /end MEASUREMENT
/begin MEASUREMENT Vbx_df_old_ptc_rov_scw "" UBYTE _CNV_A_R_A_165_CM 1 0. 0. 255. DISPLAY_IDENTIFIER fm_sta_ptc_rov_scw.fm_static_bitfield.Vbx_df_old_xxx ECU_ADDRESS 0xc00003aa BIT_MASK 0x4 /end MEASUREMENT
/begin MEASUREMENT Vbx_dfctr_sat_ptc_rov_scw "" UBYTE _CNV_A_R_A_165_CM 1 0. 0. 255. DISPLAY_IDENTIFIER fm_sta_ptc_rov_scw.fm_static_bitfield.Vbx_dfctr_sat_xxx ECU_ADDRESS 0xc00003aa BIT_MASK 0x8 /end MEASUREMENT
/begin MEASUREMENT Vbx_rdn_ptc_rov_scw "" UBYTE _CNV_A_R_A_165_CM 1 0. 0. 255. DISPLAY_IDENTIFIER fm_sta_ptc_rov_scw.fm_static_bitfield.Vbx_rdn_xxx ECU_ADDRESS 0xc00003aa BIT_MASK 0x40 /end MEASUREMENT
/begin MEASUREMENT Vxx_dtc_stt_ptc_rov_scw "" UBYTE _CNV_A_R_A_165_CM 1 0. 0. 255. DISPLAY_IDENTIFIER fm_sta_ptc_rov_scw.Vxx_dtc_stt_xxx ECU_ADDRESS 0xc00003ab /end MEASUREMENT
/begin MEASUREMENT Vxx_dfctr_pws_1_h "" UWORD _CNV_A_R_A_165_CM 1 0. 0. 65535. DISPLAY_IDENTIFIER fm_sta_pws_1_h.Vxx_dfctr_xxx ECU_ADDRESS 0xc0000154 /end MEASUREMENT
/begin MEASUREMENT Vxx_rdn_pws_1_h "" UWORD _CNV_A_R_A_165_CM 1 0. 0. 65535. DISPLAY_IDENTIFIER fm_sta_pws_1_h.Vxx_rdn_xxx ECU_ADDRESS 0xc0000156 /end MEASUREMENT
/begin MEASUREMENT Vbx_cf_pws_1_h "" UBYTE _CNV_A_R_A_165_CM 1 0. 0. 255. DISPLAY_IDENTIFIER fm_sta_pws_1_h.fm_static_bitfield.Vbx_cf_xxx ECU_ADDRESS 0xc0000158 BIT_MASK 0x1 /end MEASUREMENT
/begin MEASUREMENT Vbx_clf_pws_1_h "" UBYTE _CNV_A_R_A_165_CM 1 0. 0. 255. DISPLAY_IDENTIFIER fm_sta_pws_1_h.fm_static_bitfield.Vbx_clf_xxx ECU_ADDRESS 0xc0000158 BIT_MASK 0x2 /end MEASUREMENT
/begin MEASUREMENT Vbx_df_old_pws_1_h "" UBYTE _CNV_A_R_A_165_CM 1 0. 0. 255. DISPLAY_IDENTIFIER fm_sta_pws_1_h.fm_static_bitfield.Vbx_df_old_xxx ECU_ADDRESS 0xc0000158 BIT_MASK 0x4 /end MEASUREMENT
/begin MEASUREMENT Vbx_dfctr_sat_pws_1_h "" UBYTE _CNV_A_R_A_165_CM 1 0. 0. 255. DISPLAY_IDENTIFIER fm_sta_pws_1_h.fm_static_bitfield.Vbx_dfctr_sat_xxx ECU_ADDRESS 0xc0000158 BIT_MASK 0x8 /end MEASUREMENT
/begin MEASUREMENT Vbx_rdn_pws_1_h "" UBYTE _CNV_A_R_A_165_CM 1 0. 0. 255. DISPLAY_IDENTIFIER fm_sta_pws_1_h.fm_static_bitfield.Vbx_rdn_xxx ECU_ADDRESS 0xc0000158 BIT_MASK 0x40 /end MEASUREMENT
/begin MEASUREMENT Vxx_dtc_stt_pws_1_h "" UBYTE _CNV_A_R_A_165_CM 1 0. 0. 255. DISPLAY_IDENTIFIER fm_sta_pws_1_h.Vxx_dtc_stt_xxx ECU_ADDRESS 0xc0000159 /end MEASUREMENT
/begin MEASUREMENT Vxx_dfctr_pws_1_l "" UWORD _CNV_A_R_A_165_CM 1 0. 0. 65535. DISPLAY_IDENTIFIER fm_sta_pws_1_l.Vxx_dfctr_xxx ECU_ADDRESS 0xc000015a /end MEASUREMENT
/begin MEASUREMENT Vxx_rdn_pws_1_l "" UWORD _CNV_A_R_A_165_CM 1 0. 0. 65535. DISPLAY_IDENTIFIER fm_sta_pws_1_l.Vxx_rdn_xxx ECU_ADDRESS 0xc000015c /end MEASUREMENT
/begin MEASUREMENT Vbx_cf_pws_1_l "" UBYTE _CNV_A_R_A_165_CM 1 0. 0. 255. DISPLAY_IDENTIFIER fm_sta_pws_1_l.fm_static_bitfield.Vbx_cf_xxx ECU_ADDRESS 0xc000015e BIT_MASK 0x1 /end MEASUREMENT
/begin MEASUREMENT Vbx_clf_pws_1_l "" UBYTE _CNV_A_R_A_165_CM 1 0. 0. 255. DISPLAY_IDENTIFIER fm_sta_pws_1_l.fm_static_bitfield.Vbx_clf_xxx ECU_ADDRESS 0xc000015e BIT_MASK 0x2 /end MEASUREMENT
/begin MEASUREMENT Vbx_df_old_pws_1_l "" UBYTE _CNV_A_R_A_165_CM 1 0. 0. 255. DISPLAY_IDENTIFIER fm_sta_pws_1_l.fm_static_bitfield.Vbx_df_old_xxx ECU_ADDRESS 0xc000015e BIT_MASK 0x4 /end MEASUREMENT
/begin MEASUREMENT Vbx_dfctr_sat_pws_1_l "" UBYTE _CNV_A_R_A_165_CM 1 0. 0. 255. DISPLAY_IDENTIFIER fm_sta_pws_1_l.fm_static_bitfield.Vbx_dfctr_sat_xxx ECU_ADDRESS 0xc000015e BIT_MASK 0x8 /end MEASUREMENT
/begin MEASUREMENT Vbx_rdn_pws_1_l "" UBYTE _CNV_A_R_A_165_CM 1 0. 0. 255. DISPLAY_IDENTIFIER fm_sta_pws_1_l.fm_static_bitfield.Vbx_rdn_xxx ECU_ADDRESS 0xc000015e BIT_MASK 0x40 /end MEASUREMENT
/begin MEASUREMENT Vxx_dtc_stt_pws_1_l "" UBYTE _CNV_A_R_A_165_CM 1 0. 0. 255. DISPLAY_IDENTIFIER fm_sta_pws_1_l.Vxx_dtc_stt_xxx ECU_ADDRESS 0xc000015f /end MEASUREMENT
/begin MEASUREMENT Vxx_dfctr_pws_2_h "" UWORD _CNV_A_R_A_165_CM 1 0. 0. 65535. DISPLAY_IDENTIFIER fm_sta_pws_2_h.Vxx_dfctr_xxx ECU_ADDRESS 0xc0000160 /end MEASUREMENT
/begin MEASUREMENT Vxx_rdn_pws_2_h "" UWORD _CNV_A_R_A_165_CM 1 0. 0. 65535. DISPLAY_IDENTIFIER fm_sta_pws_2_h.Vxx_rdn_xxx ECU_ADDRESS 0xc0000162 /end MEASUREMENT
/begin MEASUREMENT Vbx_cf_pws_2_h "" UBYTE _CNV_A_R_A_165_CM 1 0. 0. 255. DISPLAY_IDENTIFIER fm_sta_pws_2_h.fm_static_bitfield.Vbx_cf_xxx ECU_ADDRESS 0xc0000164 BIT_MASK 0x1 /end MEASUREMENT
/begin MEASUREMENT Vbx_clf_pws_2_h "" UBYTE _CNV_A_R_A_165_CM 1 0. 0. 255. DISPLAY_IDENTIFIER fm_sta_pws_2_h.fm_static_bitfield.Vbx_clf_xxx ECU_ADDRESS 0xc0000164 BIT_MASK 0x2 /end MEASUREMENT
/begin MEASUREMENT Vbx_df_old_pws_2_h "" UBYTE _CNV_A_R_A_165_CM 1 0. 0. 255. DISPLAY_IDENTIFIER fm_sta_pws_2_h.fm_static_bitfield.Vbx_df_old_xxx ECU_ADDRESS 0xc0000164 BIT_MASK 0x4 /end MEASUREMENT
/begin MEASUREMENT Vbx_dfctr_sat_pws_2_h "" UBYTE _CNV_A_R_A_165_CM 1 0. 0. 255. DISPLAY_IDENTIFIER fm_sta_pws_2_h.fm_static_bitfield.Vbx_dfctr_sat_xxx ECU_ADDRESS 0xc0000164 BIT_MASK 0x8 /end MEASUREMENT
/begin MEASUREMENT Vbx_rdn_pws_2_h "" UBYTE _CNV_A_R_A_165_CM 1 0. 0. 255. DISPLAY_IDENTIFIER fm_sta_pws_2_h.fm_static_bitfield.Vbx_rdn_xxx ECU_ADDRESS 0xc0000164 BIT_MASK 0x40 /end MEASUREMENT
/begin MEASUREMENT Vxx_dtc_stt_pws_2_h "" UBYTE _CNV_A_R_A_165_CM 1 0. 0. 255. DISPLAY_IDENTIFIER fm_sta_pws_2_h.Vxx_dtc_stt_xxx ECU_ADDRESS 0xc0000165 /end MEASUREMENT
/begin MEASUREMENT Vxx_dfctr_pws_2_l "" UWORD _CNV_A_R_A_165_CM 1 0. 0. 65535. DISPLAY_IDENTIFIER fm_sta_pws_2_l.Vxx_dfctr_xxx ECU_ADDRESS 0xc0000166 /end MEASUREMENT
/begin MEASUREMENT Vxx_rdn_pws_2_l "" UWORD _CNV_A_R_A_165_CM 1 0. 0. 65535. DISPLAY_IDENTIFIER fm_sta_pws_2_l.Vxx_rdn_xxx ECU_ADDRESS 0xc0000168 /end MEASUREMENT
/begin MEASUREMENT Vbx_cf_pws_2_l "" UBYTE _CNV_A_R_A_165_CM 1 0. 0. 255. DISPLAY_IDENTIFIER fm_sta_pws_2_l.fm_static_bitfield.Vbx_cf_xxx ECU_ADDRESS 0xc000016a BIT_MASK 0x1 /end MEASUREMENT
/begin MEASUREMENT Vbx_clf_pws_2_l "" UBYTE _CNV_A_R_A_165_CM 1 0. 0. 255. DISPLAY_IDENTIFIER fm_sta_pws_2_l.fm_static_bitfield.Vbx_clf_xxx ECU_ADDRESS 0xc000016a BIT_MASK 0x2 /end MEASUREMENT
/begin MEASUREMENT Vbx_df_old_pws_2_l "" UBYTE _CNV_A_R_A_165_CM 1 0. 0. 255. DISPLAY_IDENTIFIER fm_sta_pws_2_l.fm_static_bitfield.Vbx_df_old_xxx ECU_ADDRESS 0xc000016a BIT_MASK 0x4 /end MEASUREMENT
/begin MEASUREMENT Vbx_dfctr_sat_pws_2_l "" UBYTE _CNV_A_R_A_165_CM 1 0. 0. 255. DISPLAY_IDENTIFIER fm_sta_pws_2_l.fm_static_bitfield.Vbx_dfctr_sat_xxx ECU_ADDRESS 0xc000016a BIT_MASK 0x8 /end MEASUREMENT
/begin MEASUREMENT Vbx_rdn_pws_2_l "" UBYTE _CNV_A_R_A_165_CM 1 0. 0. 255. DISPLAY_IDENTIFIER fm_sta_pws_2_l.fm_static_bitfield.Vbx_rdn_xxx ECU_ADDRESS 0xc000016a BIT_MASK 0x40 /end MEASUREMENT
/begin MEASUREMENT Vxx_dtc_stt_pws_2_l "" UBYTE _CNV_A_R_A_165_CM 1 0. 0. 255. DISPLAY_IDENTIFIER fm_sta_pws_2_l.Vxx_dtc_stt_xxx ECU_ADDRESS 0xc000016b /end MEASUREMENT
/begin MEASUREMENT Vxx_dfctr_pws_3_h "" UWORD _CNV_A_R_A_165_CM 1 0. 0. 65535. DISPLAY_IDENTIFIER fm_sta_pws_3_h.Vxx_dfctr_xxx ECU_ADDRESS 0xc000016c /end MEASUREMENT
/begin MEASUREMENT Vxx_rdn_pws_3_h "" UWORD _CNV_A_R_A_165_CM 1 0. 0. 65535. DISPLAY_IDENTIFIER fm_sta_pws_3_h.Vxx_rdn_xxx ECU_ADDRESS 0xc000016e /end MEASUREMENT
/begin MEASUREMENT Vbx_cf_pws_3_h "" UBYTE _CNV_A_R_A_165_CM 1 0. 0. 255. DISPLAY_IDENTIFIER fm_sta_pws_3_h.fm_static_bitfield.Vbx_cf_xxx ECU_ADDRESS 0xc0000170 BIT_MASK 0x1 /end MEASUREMENT
/begin MEASUREMENT Vbx_clf_pws_3_h "" UBYTE _CNV_A_R_A_165_CM 1 0. 0. 255. DISPLAY_IDENTIFIER fm_sta_pws_3_h.fm_static_bitfield.Vbx_clf_xxx ECU_ADDRESS 0xc0000170 BIT_MASK 0x2 /end MEASUREMENT
/begin MEASUREMENT Vbx_df_old_pws_3_h "" UBYTE _CNV_A_R_A_165_CM 1 0. 0. 255. DISPLAY_IDENTIFIER fm_sta_pws_3_h.fm_static_bitfield.Vbx_df_old_xxx ECU_ADDRESS 0xc0000170 BIT_MASK 0x4 /end MEASUREMENT
/begin MEASUREMENT Vbx_dfctr_sat_pws_3_h "" UBYTE _CNV_A_R_A_165_CM 1 0. 0. 255. DISPLAY_IDENTIFIER fm_sta_pws_3_h.fm_static_bitfield.Vbx_dfctr_sat_xxx ECU_ADDRESS 0xc0000170 BIT_MASK 0x8 /end MEASUREMENT
/begin MEASUREMENT Vbx_rdn_pws_3_h "" UBYTE _CNV_A_R_A_165_CM 1 0. 0. 255. DISPLAY_IDENTIFIER fm_sta_pws_3_h.fm_static_bitfield.Vbx_rdn_xxx ECU_ADDRESS 0xc0000170 BIT_MASK 0x40 /end MEASUREMENT
/begin MEASUREMENT Vxx_dtc_stt_pws_3_h "" UBYTE _CNV_A_R_A_165_CM 1 0. 0. 255. DISPLAY_IDENTIFIER fm_sta_pws_3_h.Vxx_dtc_stt_xxx ECU_ADDRESS 0xc0000171 /end MEASUREMENT
/begin MEASUREMENT Vxx_dfctr_pws_3_l "" UWORD _CNV_A_R_A_165_CM 1 0. 0. 65535. DISPLAY_IDENTIFIER fm_sta_pws_3_l.Vxx_dfctr_xxx ECU_ADDRESS 0xc0000172 /end MEASUREMENT
/begin MEASUREMENT Vxx_rdn_pws_3_l "" UWORD _CNV_A_R_A_165_CM 1 0. 0. 65535. DISPLAY_IDENTIFIER fm_sta_pws_3_l.Vxx_rdn_xxx ECU_ADDRESS 0xc0000174 /end MEASUREMENT
/begin MEASUREMENT Vbx_cf_pws_3_l "" UBYTE _CNV_A_R_A_165_CM 1 0. 0. 255. DISPLAY_IDENTIFIER fm_sta_pws_3_l.fm_static_bitfield.Vbx_cf_xxx ECU_ADDRESS 0xc0000176 BIT_MASK 0x1 /end MEASUREMENT
/begin MEASUREMENT Vbx_clf_pws_3_l "" UBYTE _CNV_A_R_A_165_CM 1 0. 0. 255. DISPLAY_IDENTIFIER fm_sta_pws_3_l.fm_static_bitfield.Vbx_clf_xxx ECU_ADDRESS 0xc0000176 BIT_MASK 0x2 /end MEASUREMENT
/begin MEASUREMENT Vbx_df_old_pws_3_l "" UBYTE _CNV_A_R_A_165_CM 1 0. 0. 255. DISPLAY_IDENTIFIER fm_sta_pws_3_l.fm_static_bitfield.Vbx_df_old_xxx ECU_ADDRESS 0xc0000176 BIT_MASK 0x4 /end MEASUREMENT
/begin MEASUREMENT Vbx_dfctr_sat_pws_3_l "" UBYTE _CNV_A_R_A_165_CM 1 0. 0. 255. DISPLAY_IDENTIFIER fm_sta_pws_3_l.fm_static_bitfield.Vbx_dfctr_sat_xxx ECU_ADDRESS 0xc0000176 BIT_MASK 0x8 /end MEASUREMENT
/begin MEASUREMENT Vbx_rdn_pws_3_l "" UBYTE _CNV_A_R_A_165_CM 1 0. 0. 255. DISPLAY_IDENTIFIER fm_sta_pws_3_l.fm_static_bitfield.Vbx_rdn_xxx ECU_ADDRESS 0xc0000176 BIT_MASK 0x40 /end MEASUREMENT
/begin MEASUREMENT Vxx_dtc_stt_pws_3_l "" UBYTE _CNV_A_R_A_165_CM 1 0. 0. 255. DISPLAY_IDENTIFIER fm_sta_pws_3_l.Vxx_dtc_stt_xxx ECU_ADDRESS 0xc0000177 /end MEASUREMENT
/begin MEASUREMENT Vxx_dfctr_sens_it_1_nok "" UWORD _CNV_A_R_A_165_CM 1 0. 0. 65535. DISPLAY_IDENTIFIER fm_sta_sens_it_1_nok.Vxx_dfctr_xxx ECU_ADDRESS 0xc0000178 /end MEASUREMENT
/begin MEASUREMENT Vxx_rdn_sens_it_1_nok "" UWORD _CNV_A_R_A_165_CM 1 0. 0. 65535. DISPLAY_IDENTIFIER fm_sta_sens_it_1_nok.Vxx_rdn_xxx ECU_ADDRESS 0xc000017a /end MEASUREMENT
/begin MEASUREMENT Vbx_cf_sens_it_1_nok "" UBYTE _CNV_A_R_A_165_CM 1 0. 0. 255. DISPLAY_IDENTIFIER fm_sta_sens_it_1_nok.fm_static_bitfield.Vbx_cf_xxx ECU_ADDRESS 0xc000017c BIT_MASK 0x1 /end MEASUREMENT
/begin MEASUREMENT Vbx_clf_sens_it_1_nok "" UBYTE _CNV_A_R_A_165_CM 1 0. 0. 255. DISPLAY_IDENTIFIER fm_sta_sens_it_1_nok.fm_static_bitfield.Vbx_clf_xxx ECU_ADDRESS 0xc000017c BIT_MASK 0x2 /end MEASUREMENT
/begin MEASUREMENT Vbx_df_old_sens_it_1_nok "" UBYTE _CNV_A_R_A_165_CM 1 0. 0. 255. DISPLAY_IDENTIFIER fm_sta_sens_it_1_nok.fm_static_bitfield.Vbx_df_old_xxx ECU_ADDRESS 0xc000017c BIT_MASK 0x4 /end MEASUREMENT
/begin MEASUREMENT Vbx_dfctr_sat_sens_it_1_nok "" UBYTE _CNV_A_R_A_165_CM 1 0. 0. 255. DISPLAY_IDENTIFIER fm_sta_sens_it_1_nok.fm_static_bitfield.Vbx_dfctr_sat_xxx ECU_ADDRESS 0xc000017c BIT_MASK 0x8 /end MEASUREMENT
/begin MEASUREMENT Vbx_rdn_sens_it_1_nok "" UBYTE _CNV_A_R_A_165_CM 1 0. 0. 255. DISPLAY_IDENTIFIER fm_sta_sens_it_1_nok.fm_static_bitfield.Vbx_rdn_xxx ECU_ADDRESS 0xc000017c BIT_MASK 0x40 /end MEASUREMENT
/begin MEASUREMENT Vxx_dtc_stt_sens_it_1_nok "" UBYTE _CNV_A_R_A_165_CM 1 0. 0. 255. DISPLAY_IDENTIFIER fm_sta_sens_it_1_nok.Vxx_dtc_stt_xxx ECU_ADDRESS 0xc000017d /end MEASUREMENT
/begin MEASUREMENT Vxx_dfctr_sens_it_2_nok "" UWORD _CNV_A_R_A_165_CM 1 0. 0. 65535. DISPLAY_IDENTIFIER fm_sta_sens_it_2_nok.Vxx_dfctr_xxx ECU_ADDRESS 0xc000017e /end MEASUREMENT
/begin MEASUREMENT Vxx_rdn_sens_it_2_nok "" UWORD _CNV_A_R_A_165_CM 1 0. 0. 65535. DISPLAY_IDENTIFIER fm_sta_sens_it_2_nok.Vxx_rdn_xxx ECU_ADDRESS 0xc0000180 /end MEASUREMENT
/begin MEASUREMENT Vbx_cf_sens_it_2_nok "" UBYTE _CNV_A_R_A_165_CM 1 0. 0. 255. DISPLAY_IDENTIFIER fm_sta_sens_it_2_nok.fm_static_bitfield.Vbx_cf_xxx ECU_ADDRESS 0xc0000182 BIT_MASK 0x1 /end MEASUREMENT
/begin MEASUREMENT Vbx_clf_sens_it_2_nok "" UBYTE _CNV_A_R_A_165_CM 1 0. 0. 255. DISPLAY_IDENTIFIER fm_sta_sens_it_2_nok.fm_static_bitfield.Vbx_clf_xxx ECU_ADDRESS 0xc0000182 BIT_MASK 0x2 /end MEASUREMENT
/begin MEASUREMENT Vbx_df_old_sens_it_2_nok "" UBYTE _CNV_A_R_A_165_CM 1 0. 0. 255. DISPLAY_IDENTIFIER fm_sta_sens_it_2_nok.fm_static_bitfield.Vbx_df_old_xxx ECU_ADDRESS 0xc0000182 BIT_MASK 0x4 /end MEASUREMENT
/begin MEASUREMENT Vbx_dfctr_sat_sens_it_2_nok "" UBYTE _CNV_A_R_A_165_CM 1 0. 0. 255. DISPLAY_IDENTIFIER fm_sta_sens_it_2_nok.fm_static_bitfield.Vbx_dfctr_sat_xxx ECU_ADDRESS 0xc0000182 BIT_MASK 0x8 /end MEASUREMENT
/begin MEASUREMENT Vbx_rdn_sens_it_2_nok "" UBYTE _CNV_A_R_A_165_CM 1 0. 0. 255. DISPLAY_IDENTIFIER fm_sta_sens_it_2_nok.fm_static_bitfield.Vbx_rdn_xxx ECU_ADDRESS 0xc0000182 BIT_MASK 0x40 /end MEASUREMENT
/begin MEASUREMENT Vxx_dtc_stt_sens_it_2_nok "" UBYTE _CNV_A_R_A_165_CM 1 0. 0. 255. DISPLAY_IDENTIFIER fm_sta_sens_it_2_nok.Vxx_dtc_stt_xxx ECU_ADDRESS 0xc0000183 /end MEASUREMENT
/begin MEASUREMENT Vxx_dfctr_sens_it_chr "" UWORD _CNV_A_R_A_165_CM 1 0. 0. 65535. DISPLAY_IDENTIFIER fm_sta_sens_it_chr.Vxx_dfctr_xxx ECU_ADDRESS 0xc0000184 /end MEASUREMENT
/begin MEASUREMENT Vxx_rdn_sens_it_chr "" UWORD _CNV_A_R_A_165_CM 1 0. 0. 65535. DISPLAY_IDENTIFIER fm_sta_sens_it_chr.Vxx_rdn_xxx ECU_ADDRESS 0xc0000186 /end MEASUREMENT
/begin MEASUREMENT Vbx_cf_sens_it_chr "" UBYTE _CNV_A_R_A_165_CM 1 0. 0. 255. DISPLAY_IDENTIFIER fm_sta_sens_it_chr.fm_static_bitfield.Vbx_cf_xxx ECU_ADDRESS 0xc0000188 BIT_MASK 0x1 /end MEASUREMENT
/begin MEASUREMENT Vbx_clf_sens_it_chr "" UBYTE _CNV_A_R_A_165_CM 1 0. 0. 255. DISPLAY_IDENTIFIER fm_sta_sens_it_chr.fm_static_bitfield.Vbx_clf_xxx ECU_ADDRESS 0xc0000188 BIT_MASK 0x2 /end MEASUREMENT
/begin MEASUREMENT Vbx_df_old_sens_it_chr "" UBYTE _CNV_A_R_A_165_CM 1 0. 0. 255. DISPLAY_IDENTIFIER fm_sta_sens_it_chr.fm_static_bitfield.Vbx_df_old_xxx ECU_ADDRESS 0xc0000188 BIT_MASK 0x4 /end MEASUREMENT
/begin MEASUREMENT Vbx_dfctr_sat_sens_it_chr "" UBYTE _CNV_A_R_A_165_CM 1 0. 0. 255. DISPLAY_IDENTIFIER fm_sta_sens_it_chr.fm_static_bitfield.Vbx_dfctr_sat_xxx ECU_ADDRESS 0xc0000188 BIT_MASK 0x8 /end MEASUREMENT
/begin MEASUREMENT Vbx_rdn_sens_it_chr "" UBYTE _CNV_A_R_A_165_CM 1 0. 0. 255. DISPLAY_IDENTIFIER fm_sta_sens_it_chr.fm_static_bitfield.Vbx_rdn_xxx ECU_ADDRESS 0xc0000188 BIT_MASK 0x40 /end MEASUREMENT
/begin MEASUREMENT Vxx_dtc_stt_sens_it_chr "" UBYTE _CNV_A_R_A_165_CM 1 0. 0. 255. DISPLAY_IDENTIFIER fm_sta_sens_it_chr.Vxx_dtc_stt_xxx ECU_ADDRESS 0xc0000189 /end MEASUREMENT
/begin MEASUREMENT Vxx_dfctr_sens_it_sig_mcut "" UWORD _CNV_A_R_A_165_CM 1 0. 0. 65535. DISPLAY_IDENTIFIER fm_sta_sens_it_sig_mcut.Vxx_dfctr_xxx ECU_ADDRESS 0xc000018a /end MEASUREMENT
/begin MEASUREMENT Vxx_rdn_sens_it_sig_mcut "" UWORD _CNV_A_R_A_165_CM 1 0. 0. 65535. DISPLAY_IDENTIFIER fm_sta_sens_it_sig_mcut.Vxx_rdn_xxx ECU_ADDRESS 0xc000018c /end MEASUREMENT
/begin MEASUREMENT Vbx_cf_sens_it_sig_mcut "" UBYTE _CNV_A_R_A_165_CM 1 0. 0. 255. DISPLAY_IDENTIFIER fm_sta_sens_it_sig_mcut.fm_static_bitfield.Vbx_cf_xxx ECU_ADDRESS 0xc000018e BIT_MASK 0x1 /end MEASUREMENT
/begin MEASUREMENT Vbx_clf_sens_it_sig_mcut "" UBYTE _CNV_A_R_A_165_CM 1 0. 0. 255. DISPLAY_IDENTIFIER fm_sta_sens_it_sig_mcut.fm_static_bitfield.Vbx_clf_xxx ECU_ADDRESS 0xc000018e BIT_MASK 0x2 /end MEASUREMENT
/begin MEASUREMENT Vbx_df_old_sens_it_sig_mcut "" UBYTE _CNV_A_R_A_165_CM 1 0. 0. 255. DISPLAY_IDENTIFIER fm_sta_sens_it_sig_mcut.fm_static_bitfield.Vbx_df_old_xxx ECU_ADDRESS 0xc000018e BIT_MASK 0x4 /end MEASUREMENT
/begin MEASUREMENT Vbx_dfctr_sat_sens_it_sig_mcut "" UBYTE _CNV_A_R_A_165_CM 1 0. 0. 255. DISPLAY_IDENTIFIER fm_sta_sens_it_sig_mcut.fm_static_bitfield.Vbx_dfctr_sat_xxx ECU_ADDRESS 0xc000018e BIT_MASK 0x8 /end MEASUREMENT
/begin MEASUREMENT Vbx_rdn_sens_it_sig_mcut "" UBYTE _CNV_A_R_A_165_CM 1 0. 0. 255. DISPLAY_IDENTIFIER fm_sta_sens_it_sig_mcut.fm_static_bitfield.Vbx_rdn_xxx ECU_ADDRESS 0xc000018e BIT_MASK 0x40 /end MEASUREMENT
/begin MEASUREMENT Vxx_dtc_stt_sens_it_sig_mcut "" UBYTE _CNV_A_R_A_165_CM 1 0. 0. 255. DISPLAY_IDENTIFIER fm_sta_sens_it_sig_mcut.Vxx_dtc_stt_xxx ECU_ADDRESS 0xc000018f /end MEASUREMENT
/begin MEASUREMENT Vxx_dfctr_sens_map_h "" UWORD _CNV_A_R_A_165_CM 1 0. 0. 65535. DISPLAY_IDENTIFIER fm_sta_sens_map_h.Vxx_dfctr_xxx ECU_ADDRESS 0xc0000190 /end MEASUREMENT
/begin MEASUREMENT Vxx_rdn_sens_map_h "" UWORD _CNV_A_R_A_165_CM 1 0. 0. 65535. DISPLAY_IDENTIFIER fm_sta_sens_map_h.Vxx_rdn_xxx ECU_ADDRESS 0xc0000192 /end MEASUREMENT
/begin MEASUREMENT Vbx_cf_sens_map_h "" UBYTE _CNV_A_R_A_165_CM 1 0. 0. 255. DISPLAY_IDENTIFIER fm_sta_sens_map_h.fm_static_bitfield.Vbx_cf_xxx ECU_ADDRESS 0xc0000194 BIT_MASK 0x1 /end MEASUREMENT
/begin MEASUREMENT Vbx_clf_sens_map_h "" UBYTE _CNV_A_R_A_165_CM 1 0. 0. 255. DISPLAY_IDENTIFIER fm_sta_sens_map_h.fm_static_bitfield.Vbx_clf_xxx ECU_ADDRESS 0xc0000194 BIT_MASK 0x2 /end MEASUREMENT
/begin MEASUREMENT Vbx_df_old_sens_map_h "" UBYTE _CNV_A_R_A_165_CM 1 0. 0. 255. DISPLAY_IDENTIFIER fm_sta_sens_map_h.fm_static_bitfield.Vbx_df_old_xxx ECU_ADDRESS 0xc0000194 BIT_MASK 0x4 /end MEASUREMENT
/begin MEASUREMENT Vbx_dfctr_sat_sens_map_h "" UBYTE _CNV_A_R_A_165_CM 1 0. 0. 255. DISPLAY_IDENTIFIER fm_sta_sens_map_h.fm_static_bitfield.Vbx_dfctr_sat_xxx ECU_ADDRESS 0xc0000194 BIT_MASK 0x8 /end MEASUREMENT
/begin MEASUREMENT Vbx_rdn_sens_map_h "" UBYTE _CNV_A_R_A_165_CM 1 0. 0. 255. DISPLAY_IDENTIFIER fm_sta_sens_map_h.fm_static_bitfield.Vbx_rdn_xxx ECU_ADDRESS 0xc0000194 BIT_MASK 0x40 /end MEASUREMENT
/begin MEASUREMENT Vxx_dtc_stt_sens_map_h "" UBYTE _CNV_A_R_A_165_CM 1 0. 0. 255. DISPLAY_IDENTIFIER fm_sta_sens_map_h.Vxx_dtc_stt_xxx ECU_ADDRESS 0xc0000195 /end MEASUREMENT
/begin MEASUREMENT Vxx_dfctr_sens_map_l "" UWORD _CNV_A_R_A_165_CM 1 0. 0. 65535. DISPLAY_IDENTIFIER fm_sta_sens_map_l.Vxx_dfctr_xxx ECU_ADDRESS 0xc0000196 /end MEASUREMENT
/begin MEASUREMENT Vxx_rdn_sens_map_l "" UWORD _CNV_A_R_A_165_CM 1 0. 0. 65535. DISPLAY_IDENTIFIER fm_sta_sens_map_l.Vxx_rdn_xxx ECU_ADDRESS 0xc0000198 /end MEASUREMENT
/begin MEASUREMENT Vbx_cf_sens_map_l "" UBYTE _CNV_A_R_A_165_CM 1 0. 0. 255. DISPLAY_IDENTIFIER fm_sta_sens_map_l.fm_static_bitfield.Vbx_cf_xxx ECU_ADDRESS 0xc000019a BIT_MASK 0x1 /end MEASUREMENT
/begin MEASUREMENT Vbx_clf_sens_map_l "" UBYTE _CNV_A_R_A_165_CM 1 0. 0. 255. DISPLAY_IDENTIFIER fm_sta_sens_map_l.fm_static_bitfield.Vbx_clf_xxx ECU_ADDRESS 0xc000019a BIT_MASK 0x2 /end MEASUREMENT
/begin MEASUREMENT Vbx_df_old_sens_map_l "" UBYTE _CNV_A_R_A_165_CM 1 0. 0. 255. DISPLAY_IDENTIFIER fm_sta_sens_map_l.fm_static_bitfield.Vbx_df_old_xxx ECU_ADDRESS 0xc000019a BIT_MASK 0x4 /end MEASUREMENT
/begin MEASUREMENT Vbx_dfctr_sat_sens_map_l "" UBYTE _CNV_A_R_A_165_CM 1 0. 0. 255. DISPLAY_IDENTIFIER fm_sta_sens_map_l.fm_static_bitfield.Vbx_dfctr_sat_xxx ECU_ADDRESS 0xc000019a BIT_MASK 0x8 /end MEASUREMENT
/begin MEASUREMENT Vbx_rdn_sens_map_l "" UBYTE _CNV_A_R_A_165_CM 1 0. 0. 255. DISPLAY_IDENTIFIER fm_sta_sens_map_l.fm_static_bitfield.Vbx_rdn_xxx ECU_ADDRESS 0xc000019a BIT_MASK 0x40 /end MEASUREMENT
/begin MEASUREMENT Vxx_dtc_stt_sens_map_l "" UBYTE _CNV_A_R_A_165_CM 1 0. 0. 255. DISPLAY_IDENTIFIER fm_sta_sens_map_l.Vxx_dtc_stt_xxx ECU_ADDRESS 0xc000019b /end MEASUREMENT
/begin MEASUREMENT Vxx_dfctr_sens_mat_h "" UWORD _CNV_A_R_A_165_CM 1 0. 0. 65535. DISPLAY_IDENTIFIER fm_sta_sens_mat_h.Vxx_dfctr_xxx ECU_ADDRESS 0xc00001ea /end MEASUREMENT
/begin MEASUREMENT Vxx_rdn_sens_mat_h "" UWORD _CNV_A_R_A_165_CM 1 0. 0. 65535. DISPLAY_IDENTIFIER fm_sta_sens_mat_h.Vxx_rdn_xxx ECU_ADDRESS 0xc00001ec /end MEASUREMENT
/begin MEASUREMENT Vbx_cf_sens_mat_h "" UBYTE _CNV_A_R_A_165_CM 1 0. 0. 255. DISPLAY_IDENTIFIER fm_sta_sens_mat_h.fm_static_bitfield.Vbx_cf_xxx ECU_ADDRESS 0xc00001ee BIT_MASK 0x1 /end MEASUREMENT
/begin MEASUREMENT Vbx_clf_sens_mat_h "" UBYTE _CNV_A_R_A_165_CM 1 0. 0. 255. DISPLAY_IDENTIFIER fm_sta_sens_mat_h.fm_static_bitfield.Vbx_clf_xxx ECU_ADDRESS 0xc00001ee BIT_MASK 0x2 /end MEASUREMENT
/begin MEASUREMENT Vbx_df_old_sens_mat_h "" UBYTE _CNV_A_R_A_165_CM 1 0. 0. 255. DISPLAY_IDENTIFIER fm_sta_sens_mat_h.fm_static_bitfield.Vbx_df_old_xxx ECU_ADDRESS 0xc00001ee BIT_MASK 0x4 /end MEASUREMENT
/begin MEASUREMENT Vbx_dfctr_sat_sens_mat_h "" UBYTE _CNV_A_R_A_165_CM 1 0. 0. 255. DISPLAY_IDENTIFIER fm_sta_sens_mat_h.fm_static_bitfield.Vbx_dfctr_sat_xxx ECU_ADDRESS 0xc00001ee BIT_MASK 0x8 /end MEASUREMENT
/begin MEASUREMENT Vbx_rdn_sens_mat_h "" UBYTE _CNV_A_R_A_165_CM 1 0. 0. 255. DISPLAY_IDENTIFIER fm_sta_sens_mat_h.fm_static_bitfield.Vbx_rdn_xxx ECU_ADDRESS 0xc00001ee BIT_MASK 0x40 /end MEASUREMENT
/begin MEASUREMENT Vxx_dtc_stt_sens_mat_h "" UBYTE _CNV_A_R_A_165_CM 1 0. 0. 255. DISPLAY_IDENTIFIER fm_sta_sens_mat_h.Vxx_dtc_stt_xxx ECU_ADDRESS 0xc00001ef /end MEASUREMENT
/begin MEASUREMENT Vxx_dfctr_sens_mat_l "" UWORD _CNV_A_R_A_165_CM 1 0. 0. 65535. DISPLAY_IDENTIFIER fm_sta_sens_mat_l.Vxx_dfctr_xxx ECU_ADDRESS 0xc00001f0 /end MEASUREMENT
/begin MEASUREMENT Vxx_rdn_sens_mat_l "" UWORD _CNV_A_R_A_165_CM 1 0. 0. 65535. DISPLAY_IDENTIFIER fm_sta_sens_mat_l.Vxx_rdn_xxx ECU_ADDRESS 0xc00001f2 /end MEASUREMENT
/begin MEASUREMENT Vbx_cf_sens_mat_l "" UBYTE _CNV_A_R_A_165_CM 1 0. 0. 255. DISPLAY_IDENTIFIER fm_sta_sens_mat_l.fm_static_bitfield.Vbx_cf_xxx ECU_ADDRESS 0xc00001f4 BIT_MASK 0x1 /end MEASUREMENT
/begin MEASUREMENT Vbx_clf_sens_mat_l "" UBYTE _CNV_A_R_A_165_CM 1 0. 0. 255. DISPLAY_IDENTIFIER fm_sta_sens_mat_l.fm_static_bitfield.Vbx_clf_xxx ECU_ADDRESS 0xc00001f4 BIT_MASK 0x2 /end MEASUREMENT
/begin MEASUREMENT Vbx_df_old_sens_mat_l "" UBYTE _CNV_A_R_A_165_CM 1 0. 0. 255. DISPLAY_IDENTIFIER fm_sta_sens_mat_l.fm_static_bitfield.Vbx_df_old_xxx ECU_ADDRESS 0xc00001f4 BIT_MASK 0x4 /end MEASUREMENT
/begin MEASUREMENT Vbx_dfctr_sat_sens_mat_l "" UBYTE _CNV_A_R_A_165_CM 1 0. 0. 255. DISPLAY_IDENTIFIER fm_sta_sens_mat_l.fm_static_bitfield.Vbx_dfctr_sat_xxx ECU_ADDRESS 0xc00001f4 BIT_MASK 0x8 /end MEASUREMENT
/begin MEASUREMENT Vbx_rdn_sens_mat_l "" UBYTE _CNV_A_R_A_165_CM 1 0. 0. 255. DISPLAY_IDENTIFIER fm_sta_sens_mat_l.fm_static_bitfield.Vbx_rdn_xxx ECU_ADDRESS 0xc00001f4 BIT_MASK 0x40 /end MEASUREMENT
/begin MEASUREMENT Vxx_dtc_stt_sens_mat_l "" UBYTE _CNV_A_R_A_165_CM 1 0. 0. 255. DISPLAY_IDENTIFIER fm_sta_sens_mat_l.Vxx_dtc_stt_xxx ECU_ADDRESS 0xc00001f5 /end MEASUREMENT
/begin MEASUREMENT Vxx_dfctr_sens_spg_h "" UWORD _CNV_A_R_A_165_CM 1 0. 0. 65535. DISPLAY_IDENTIFIER fm_sta_sens_spg_h.Vxx_dfctr_xxx ECU_ADDRESS 0xc000019c /end MEASUREMENT
/begin MEASUREMENT Vxx_rdn_sens_spg_h "" UWORD _CNV_A_R_A_165_CM 1 0. 0. 65535. DISPLAY_IDENTIFIER fm_sta_sens_spg_h.Vxx_rdn_xxx ECU_ADDRESS 0xc000019e /end MEASUREMENT
/begin MEASUREMENT Vbx_cf_sens_spg_h "" UBYTE _CNV_A_R_A_165_CM 1 0. 0. 255. DISPLAY_IDENTIFIER fm_sta_sens_spg_h.fm_static_bitfield.Vbx_cf_xxx ECU_ADDRESS 0xc00001a0 BIT_MASK 0x1 /end MEASUREMENT
/begin MEASUREMENT Vbx_clf_sens_spg_h "" UBYTE _CNV_A_R_A_165_CM 1 0. 0. 255. DISPLAY_IDENTIFIER fm_sta_sens_spg_h.fm_static_bitfield.Vbx_clf_xxx ECU_ADDRESS 0xc00001a0 BIT_MASK 0x2 /end MEASUREMENT
/begin MEASUREMENT Vbx_df_old_sens_spg_h "" UBYTE _CNV_A_R_A_165_CM 1 0. 0. 255. DISPLAY_IDENTIFIER fm_sta_sens_spg_h.fm_static_bitfield.Vbx_df_old_xxx ECU_ADDRESS 0xc00001a0 BIT_MASK 0x4 /end MEASUREMENT
/begin MEASUREMENT Vbx_dfctr_sat_sens_spg_h "" UBYTE _CNV_A_R_A_165_CM 1 0. 0. 255. DISPLAY_IDENTIFIER fm_sta_sens_spg_h.fm_static_bitfield.Vbx_dfctr_sat_xxx ECU_ADDRESS 0xc00001a0 BIT_MASK 0x8 /end MEASUREMENT
/begin MEASUREMENT Vbx_rdn_sens_spg_h "" UBYTE _CNV_A_R_A_165_CM 1 0. 0. 255. DISPLAY_IDENTIFIER fm_sta_sens_spg_h.fm_static_bitfield.Vbx_rdn_xxx ECU_ADDRESS 0xc00001a0 BIT_MASK 0x40 /end MEASUREMENT
/begin MEASUREMENT Vxx_dtc_stt_sens_spg_h "" UBYTE _CNV_A_R_A_165_CM 1 0. 0. 255. DISPLAY_IDENTIFIER fm_sta_sens_spg_h.Vxx_dtc_stt_xxx ECU_ADDRESS 0xc00001a1 /end MEASUREMENT
/begin MEASUREMENT Vxx_dfctr_sens_spg_l "" UWORD _CNV_A_R_A_165_CM 1 0. 0. 65535. DISPLAY_IDENTIFIER fm_sta_sens_spg_l.Vxx_dfctr_xxx ECU_ADDRESS 0xc00001a2 /end MEASUREMENT
/begin MEASUREMENT Vxx_rdn_sens_spg_l "" UWORD _CNV_A_R_A_165_CM 1 0. 0. 65535. DISPLAY_IDENTIFIER fm_sta_sens_spg_l.Vxx_rdn_xxx ECU_ADDRESS 0xc00001a4 /end MEASUREMENT
/begin MEASUREMENT Vbx_cf_sens_spg_l "" UBYTE _CNV_A_R_A_165_CM 1 0. 0. 255. DISPLAY_IDENTIFIER fm_sta_sens_spg_l.fm_static_bitfield.Vbx_cf_xxx ECU_ADDRESS 0xc00001a6 BIT_MASK 0x1 /end MEASUREMENT
/begin MEASUREMENT Vbx_clf_sens_spg_l "" UBYTE _CNV_A_R_A_165_CM 1 0. 0. 255. DISPLAY_IDENTIFIER fm_sta_sens_spg_l.fm_static_bitfield.Vbx_clf_xxx ECU_ADDRESS 0xc00001a6 BIT_MASK 0x2 /end MEASUREMENT
/begin MEASUREMENT Vbx_df_old_sens_spg_l "" UBYTE _CNV_A_R_A_165_CM 1 0. 0. 255. DISPLAY_IDENTIFIER fm_sta_sens_spg_l.fm_static_bitfield.Vbx_df_old_xxx ECU_ADDRESS 0xc00001a6 BIT_MASK 0x4 /end MEASUREMENT
/begin MEASUREMENT Vbx_dfctr_sat_sens_spg_l "" UBYTE _CNV_A_R_A_165_CM 1 0. 0. 255. DISPLAY_IDENTIFIER fm_sta_sens_spg_l.fm_static_bitfield.Vbx_dfctr_sat_xxx ECU_ADDRESS 0xc00001a6 BIT_MASK 0x8 /end MEASUREMENT
/begin MEASUREMENT Vbx_rdn_sens_spg_l "" UBYTE _CNV_A_R_A_165_CM 1 0. 0. 255. DISPLAY_IDENTIFIER fm_sta_sens_spg_l.fm_static_bitfield.Vbx_rdn_xxx ECU_ADDRESS 0xc00001a6 BIT_MASK 0x40 /end MEASUREMENT
/begin MEASUREMENT Vxx_dtc_stt_sens_spg_l "" UBYTE _CNV_A_R_A_165_CM 1 0. 0. 255. DISPLAY_IDENTIFIER fm_sta_sens_spg_l.Vxx_dtc_stt_xxx ECU_ADDRESS 0xc00001a7 /end MEASUREMENT
/begin MEASUREMENT Vxx_dfctr_sens_tco_h "" UWORD _CNV_A_R_A_165_CM 1 0. 0. 65535. DISPLAY_IDENTIFIER fm_sta_sens_tco_h.Vxx_dfctr_xxx ECU_ADDRESS 0xc00001a8 /end MEASUREMENT
/begin MEASUREMENT Vxx_rdn_sens_tco_h "" UWORD _CNV_A_R_A_165_CM 1 0. 0. 65535. DISPLAY_IDENTIFIER fm_sta_sens_tco_h.Vxx_rdn_xxx ECU_ADDRESS 0xc00001aa /end MEASUREMENT
/begin MEASUREMENT Vbx_cf_sens_tco_h "" UBYTE _CNV_A_R_A_165_CM 1 0. 0. 255. DISPLAY_IDENTIFIER fm_sta_sens_tco_h.fm_static_bitfield.Vbx_cf_xxx ECU_ADDRESS 0xc00001ac BIT_MASK 0x1 /end MEASUREMENT
/begin MEASUREMENT Vbx_clf_sens_tco_h "" UBYTE _CNV_A_R_A_165_CM 1 0. 0. 255. DISPLAY_IDENTIFIER fm_sta_sens_tco_h.fm_static_bitfield.Vbx_clf_xxx ECU_ADDRESS 0xc00001ac BIT_MASK 0x2 /end MEASUREMENT
/begin MEASUREMENT Vbx_df_old_sens_tco_h "" UBYTE _CNV_A_R_A_165_CM 1 0. 0. 255. DISPLAY_IDENTIFIER fm_sta_sens_tco_h.fm_static_bitfield.Vbx_df_old_xxx ECU_ADDRESS 0xc00001ac BIT_MASK 0x4 /end MEASUREMENT
/begin MEASUREMENT Vbx_dfctr_sat_sens_tco_h "" UBYTE _CNV_A_R_A_165_CM 1 0. 0. 255. DISPLAY_IDENTIFIER fm_sta_sens_tco_h.fm_static_bitfield.Vbx_dfctr_sat_xxx ECU_ADDRESS 0xc00001ac BIT_MASK 0x8 /end MEASUREMENT
/begin MEASUREMENT Vbx_rdn_sens_tco_h "" UBYTE _CNV_A_R_A_165_CM 1 0. 0. 255. DISPLAY_IDENTIFIER fm_sta_sens_tco_h.fm_static_bitfield.Vbx_rdn_xxx ECU_ADDRESS 0xc00001ac BIT_MASK 0x40 /end MEASUREMENT
/begin MEASUREMENT Vxx_dtc_stt_sens_tco_h "" UBYTE _CNV_A_R_A_165_CM 1 0. 0. 255. DISPLAY_IDENTIFIER fm_sta_sens_tco_h.Vxx_dtc_stt_xxx ECU_ADDRESS 0xc00001ad /end MEASUREMENT
/begin MEASUREMENT Vxx_dfctr_sens_tco_l "" UWORD _CNV_A_R_A_165_CM 1 0. 0. 65535. DISPLAY_IDENTIFIER fm_sta_sens_tco_l.Vxx_dfctr_xxx ECU_ADDRESS 0xc00001ae /end MEASUREMENT
/begin MEASUREMENT Vxx_rdn_sens_tco_l "" UWORD _CNV_A_R_A_165_CM 1 0. 0. 65535. DISPLAY_IDENTIFIER fm_sta_sens_tco_l.Vxx_rdn_xxx ECU_ADDRESS 0xc00001b0 /end MEASUREMENT
/begin MEASUREMENT Vbx_cf_sens_tco_l "" UBYTE _CNV_A_R_A_165_CM 1 0. 0. 255. DISPLAY_IDENTIFIER fm_sta_sens_tco_l.fm_static_bitfield.Vbx_cf_xxx ECU_ADDRESS 0xc00001b2 BIT_MASK 0x1 /end MEASUREMENT
/begin MEASUREMENT Vbx_clf_sens_tco_l "" UBYTE _CNV_A_R_A_165_CM 1 0. 0. 255. DISPLAY_IDENTIFIER fm_sta_sens_tco_l.fm_static_bitfield.Vbx_clf_xxx ECU_ADDRESS 0xc00001b2 BIT_MASK 0x2 /end MEASUREMENT
/begin MEASUREMENT Vbx_df_old_sens_tco_l "" UBYTE _CNV_A_R_A_165_CM 1 0. 0. 255. DISPLAY_IDENTIFIER fm_sta_sens_tco_l.fm_static_bitfield.Vbx_df_old_xxx ECU_ADDRESS 0xc00001b2 BIT_MASK 0x4 /end MEASUREMENT
/begin MEASUREMENT Vbx_dfctr_sat_sens_tco_l "" UBYTE _CNV_A_R_A_165_CM 1 0. 0. 255. DISPLAY_IDENTIFIER fm_sta_sens_tco_l.fm_static_bitfield.Vbx_dfctr_sat_xxx ECU_ADDRESS 0xc00001b2 BIT_MASK 0x8 /end MEASUREMENT
/begin MEASUREMENT Vbx_rdn_sens_tco_l "" UBYTE _CNV_A_R_A_165_CM 1 0. 0. 255. DISPLAY_IDENTIFIER fm_sta_sens_tco_l.fm_static_bitfield.Vbx_rdn_xxx ECU_ADDRESS 0xc00001b2 BIT_MASK 0x40 /end MEASUREMENT
/begin MEASUREMENT Vxx_dtc_stt_sens_tco_l "" UBYTE _CNV_A_R_A_165_CM 1 0. 0. 255. DISPLAY_IDENTIFIER fm_sta_sens_tco_l.Vxx_dtc_stt_xxx ECU_ADDRESS 0xc00001b3 /end MEASUREMENT
/begin MEASUREMENT Vxx_dfctr_sens_tco_sig_mcut "" UWORD _CNV_A_R_A_165_CM 1 0. 0. 65535. DISPLAY_IDENTIFIER fm_sta_sens_tco_sig_mcut.Vxx_dfctr_xxx ECU_ADDRESS 0xc00003e2 /end MEASUREMENT
/begin MEASUREMENT Vxx_rdn_sens_tco_sig_mcut "" UWORD _CNV_A_R_A_165_CM 1 0. 0. 65535. DISPLAY_IDENTIFIER fm_sta_sens_tco_sig_mcut.Vxx_rdn_xxx ECU_ADDRESS 0xc00003e4 /end MEASUREMENT
/begin MEASUREMENT Vbx_cf_sens_tco_sig_mcut "" UBYTE _CNV_A_R_A_165_CM 1 0. 0. 255. DISPLAY_IDENTIFIER fm_sta_sens_tco_sig_mcut.fm_static_bitfield.Vbx_cf_xxx ECU_ADDRESS 0xc00003e6 BIT_MASK 0x1 /end MEASUREMENT
/begin MEASUREMENT Vbx_clf_sens_tco_sig_mcut "" UBYTE _CNV_A_R_A_165_CM 1 0. 0. 255. DISPLAY_IDENTIFIER fm_sta_sens_tco_sig_mcut.fm_static_bitfield.Vbx_clf_xxx ECU_ADDRESS 0xc00003e6 BIT_MASK 0x2 /end MEASUREMENT
/begin MEASUREMENT Vbx_df_old_sens_tco_sig_mcut "" UBYTE _CNV_A_R_A_165_CM 1 0. 0. 255. DISPLAY_IDENTIFIER fm_sta_sens_tco_sig_mcut.fm_static_bitfield.Vbx_df_old_xxx ECU_ADDRESS 0xc00003e6 BIT_MASK 0x4 /end MEASUREMENT
/begin MEASUREMENT Vbx_dfctr_sat_sens_tco_sig_mcut "" UBYTE _CNV_A_R_A_165_CM 1 0. 0. 255. DISPLAY_IDENTIFIER fm_sta_sens_tco_sig_mcut.fm_static_bitfield.Vbx_dfctr_sat_xxx ECU_ADDRESS 0xc00003e6 BIT_MASK 0x8 /end MEASUREMENT
/begin MEASUREMENT Vbx_rdn_sens_tco_sig_mcut "" UBYTE _CNV_A_R_A_165_CM 1 0. 0. 255. DISPLAY_IDENTIFIER fm_sta_sens_tco_sig_mcut.fm_static_bitfield.Vbx_rdn_xxx ECU_ADDRESS 0xc00003e6 BIT_MASK 0x40 /end MEASUREMENT
/begin MEASUREMENT Vxx_dtc_stt_sens_tco_sig_mcut "" UBYTE _CNV_A_R_A_165_CM 1 0. 0. 255. DISPLAY_IDENTIFIER fm_sta_sens_tco_sig_mcut.Vxx_dtc_stt_xxx ECU_ADDRESS 0xc00003e7 /end MEASUREMENT
/begin MEASUREMENT Vxx_dfctr_sfty_tq_chr "" UWORD _CNV_A_R_A_165_CM 1 0. 0. 65535. DISPLAY_IDENTIFIER fm_sta_sfty_tq_chr.Vxx_dfctr_xxx ECU_ADDRESS 0xc000036a /end MEASUREMENT
/begin MEASUREMENT Vxx_rdn_sfty_tq_chr "" UWORD _CNV_A_R_A_165_CM 1 0. 0. 65535. DISPLAY_IDENTIFIER fm_sta_sfty_tq_chr.Vxx_rdn_xxx ECU_ADDRESS 0xc000036c /end MEASUREMENT
/begin MEASUREMENT Vbx_cf_sfty_tq_chr "" UBYTE _CNV_A_R_A_165_CM 1 0. 0. 255. DISPLAY_IDENTIFIER fm_sta_sfty_tq_chr.fm_static_bitfield.Vbx_cf_xxx ECU_ADDRESS 0xc000036e BIT_MASK 0x1 /end MEASUREMENT
/begin MEASUREMENT Vbx_clf_sfty_tq_chr "" UBYTE _CNV_A_R_A_165_CM 1 0. 0. 255. DISPLAY_IDENTIFIER fm_sta_sfty_tq_chr.fm_static_bitfield.Vbx_clf_xxx ECU_ADDRESS 0xc000036e BIT_MASK 0x2 /end MEASUREMENT
/begin MEASUREMENT Vbx_df_old_sfty_tq_chr "" UBYTE _CNV_A_R_A_165_CM 1 0. 0. 255. DISPLAY_IDENTIFIER fm_sta_sfty_tq_chr.fm_static_bitfield.Vbx_df_old_xxx ECU_ADDRESS 0xc000036e BIT_MASK 0x4 /end MEASUREMENT
/begin MEASUREMENT Vbx_dfctr_sat_sfty_tq_chr "" UBYTE _CNV_A_R_A_165_CM 1 0. 0. 255. DISPLAY_IDENTIFIER fm_sta_sfty_tq_chr.fm_static_bitfield.Vbx_dfctr_sat_xxx ECU_ADDRESS 0xc000036e BIT_MASK 0x8 /end MEASUREMENT
/begin MEASUREMENT Vbx_rdn_sfty_tq_chr "" UBYTE _CNV_A_R_A_165_CM 1 0. 0. 255. DISPLAY_IDENTIFIER fm_sta_sfty_tq_chr.fm_static_bitfield.Vbx_rdn_xxx ECU_ADDRESS 0xc000036e BIT_MASK 0x40 /end MEASUREMENT
/begin MEASUREMENT Vxx_dtc_stt_sfty_tq_chr "" UBYTE _CNV_A_R_A_165_CM 1 0. 0. 255. DISPLAY_IDENTIFIER fm_sta_sfty_tq_chr.Vxx_dtc_stt_xxx ECU_ADDRESS 0xc000036f /end MEASUREMENT
/begin MEASUREMENT Vxx_dfctr_sfty_tq_clc_chr "" UWORD _CNV_A_R_A_165_CM 1 0. 0. 65535. DISPLAY_IDENTIFIER fm_sta_sfty_tq_clc_chr.Vxx_dfctr_xxx ECU_ADDRESS 0xc0000370 /end MEASUREMENT
/begin MEASUREMENT Vxx_rdn_sfty_tq_clc_chr "" UWORD _CNV_A_R_A_165_CM 1 0. 0. 65535. DISPLAY_IDENTIFIER fm_sta_sfty_tq_clc_chr.Vxx_rdn_xxx ECU_ADDRESS 0xc0000372 /end MEASUREMENT
/begin MEASUREMENT Vbx_cf_sfty_tq_clc_chr "" UBYTE _CNV_A_R_A_165_CM 1 0. 0. 255. DISPLAY_IDENTIFIER fm_sta_sfty_tq_clc_chr.fm_static_bitfield.Vbx_cf_xxx ECU_ADDRESS 0xc0000374 BIT_MASK 0x1 /end MEASUREMENT
/begin MEASUREMENT Vbx_clf_sfty_tq_clc_chr "" UBYTE _CNV_A_R_A_165_CM 1 0. 0. 255. DISPLAY_IDENTIFIER fm_sta_sfty_tq_clc_chr.fm_static_bitfield.Vbx_clf_xxx ECU_ADDRESS 0xc0000374 BIT_MASK 0x2 /end MEASUREMENT
/begin MEASUREMENT Vbx_df_old_sfty_tq_clc_chr "" UBYTE _CNV_A_R_A_165_CM 1 0. 0. 255. DISPLAY_IDENTIFIER fm_sta_sfty_tq_clc_chr.fm_static_bitfield.Vbx_df_old_xxx ECU_ADDRESS 0xc0000374 BIT_MASK 0x4 /end MEASUREMENT
/begin MEASUREMENT Vbx_dfctr_sat_sfty_tq_clc_chr "" UBYTE _CNV_A_R_A_165_CM 1 0. 0. 255. DISPLAY_IDENTIFIER fm_sta_sfty_tq_clc_chr.fm_static_bitfield.Vbx_dfctr_sat_xxx ECU_ADDRESS 0xc0000374 BIT_MASK 0x8 /end MEASUREMENT
/begin MEASUREMENT Vbx_rdn_sfty_tq_clc_chr "" UBYTE _CNV_A_R_A_165_CM 1 0. 0. 255. DISPLAY_IDENTIFIER fm_sta_sfty_tq_clc_chr.fm_static_bitfield.Vbx_rdn_xxx ECU_ADDRESS 0xc0000374 BIT_MASK 0x40 /end MEASUREMENT
/begin MEASUREMENT Vxx_dtc_stt_sfty_tq_clc_chr "" UBYTE _CNV_A_R_A_165_CM 1 0. 0. 255. DISPLAY_IDENTIFIER fm_sta_sfty_tq_clc_chr.Vxx_dtc_stt_xxx ECU_ADDRESS 0xc0000375 /end MEASUREMENT
/begin MEASUREMENT Vxx_dfctr_sfty_tq_lih_chr "" UWORD _CNV_A_R_A_165_CM 1 0. 0. 65535. DISPLAY_IDENTIFIER fm_sta_sfty_tq_lih_chr.Vxx_dfctr_xxx ECU_ADDRESS 0xc0000376 /end MEASUREMENT
/begin MEASUREMENT Vxx_rdn_sfty_tq_lih_chr "" UWORD _CNV_A_R_A_165_CM 1 0. 0. 65535. DISPLAY_IDENTIFIER fm_sta_sfty_tq_lih_chr.Vxx_rdn_xxx ECU_ADDRESS 0xc0000378 /end MEASUREMENT
/begin MEASUREMENT Vbx_cf_sfty_tq_lih_chr "" UBYTE _CNV_A_R_A_165_CM 1 0. 0. 255. DISPLAY_IDENTIFIER fm_sta_sfty_tq_lih_chr.fm_static_bitfield.Vbx_cf_xxx ECU_ADDRESS 0xc000037a BIT_MASK 0x1 /end MEASUREMENT
/begin MEASUREMENT Vbx_clf_sfty_tq_lih_chr "" UBYTE _CNV_A_R_A_165_CM 1 0. 0. 255. DISPLAY_IDENTIFIER fm_sta_sfty_tq_lih_chr.fm_static_bitfield.Vbx_clf_xxx ECU_ADDRESS 0xc000037a BIT_MASK 0x2 /end MEASUREMENT
/begin MEASUREMENT Vbx_df_old_sfty_tq_lih_chr "" UBYTE _CNV_A_R_A_165_CM 1 0. 0. 255. DISPLAY_IDENTIFIER fm_sta_sfty_tq_lih_chr.fm_static_bitfield.Vbx_df_old_xxx ECU_ADDRESS 0xc000037a BIT_MASK 0x4 /end MEASUREMENT
/begin MEASUREMENT Vbx_dfctr_sat_sfty_tq_lih_chr "" UBYTE _CNV_A_R_A_165_CM 1 0. 0. 255. DISPLAY_IDENTIFIER fm_sta_sfty_tq_lih_chr.fm_static_bitfield.Vbx_dfctr_sat_xxx ECU_ADDRESS 0xc000037a BIT_MASK 0x8 /end MEASUREMENT
/begin MEASUREMENT Vbx_rdn_sfty_tq_lih_chr "" UBYTE _CNV_A_R_A_165_CM 1 0. 0. 255. DISPLAY_IDENTIFIER fm_sta_sfty_tq_lih_chr.fm_static_bitfield.Vbx_rdn_xxx ECU_ADDRESS 0xc000037a BIT_MASK 0x40 /end MEASUREMENT
/begin MEASUREMENT Vxx_dtc_stt_sfty_tq_lih_chr "" UBYTE _CNV_A_R_A_165_CM 1 0. 0. 255. DISPLAY_IDENTIFIER fm_sta_sfty_tq_lih_chr.Vxx_dtc_stt_xxx ECU_ADDRESS 0xc000037b /end MEASUREMENT
/begin MEASUREMENT Vxx_dfctr_spg_chr "" UWORD _CNV_A_R_A_165_CM 1 0. 0. 65535. DISPLAY_IDENTIFIER fm_sta_spg_chr.Vxx_dfctr_xxx ECU_ADDRESS 0xc000030a /end MEASUREMENT
/begin MEASUREMENT Vxx_rdn_spg_chr "" UWORD _CNV_A_R_A_165_CM 1 0. 0. 65535. DISPLAY_IDENTIFIER fm_sta_spg_chr.Vxx_rdn_xxx ECU_ADDRESS 0xc000030c /end MEASUREMENT
/begin MEASUREMENT Vbx_cf_spg_chr "" UBYTE _CNV_A_R_A_165_CM 1 0. 0. 255. DISPLAY_IDENTIFIER fm_sta_spg_chr.fm_static_bitfield.Vbx_cf_xxx ECU_ADDRESS 0xc000030e BIT_MASK 0x1 /end MEASUREMENT
/begin MEASUREMENT Vbx_clf_spg_chr "" UBYTE _CNV_A_R_A_165_CM 1 0. 0. 255. DISPLAY_IDENTIFIER fm_sta_spg_chr.fm_static_bitfield.Vbx_clf_xxx ECU_ADDRESS 0xc000030e BIT_MASK 0x2 /end MEASUREMENT
/begin MEASUREMENT Vbx_df_old_spg_chr "" UBYTE _CNV_A_R_A_165_CM 1 0. 0. 255. DISPLAY_IDENTIFIER fm_sta_spg_chr.fm_static_bitfield.Vbx_df_old_xxx ECU_ADDRESS 0xc000030e BIT_MASK 0x4 /end MEASUREMENT
/begin MEASUREMENT Vbx_dfctr_sat_spg_chr "" UBYTE _CNV_A_R_A_165_CM 1 0. 0. 255. DISPLAY_IDENTIFIER fm_sta_spg_chr.fm_static_bitfield.Vbx_dfctr_sat_xxx ECU_ADDRESS 0xc000030e BIT_MASK 0x8 /end MEASUREMENT
/begin MEASUREMENT Vbx_rdn_spg_chr "" UBYTE _CNV_A_R_A_165_CM 1 0. 0. 255. DISPLAY_IDENTIFIER fm_sta_spg_chr.fm_static_bitfield.Vbx_rdn_xxx ECU_ADDRESS 0xc000030e BIT_MASK 0x40 /end MEASUREMENT
/begin MEASUREMENT Vxx_dtc_stt_spg_chr "" UBYTE _CNV_A_R_A_165_CM 1 0. 0. 255. DISPLAY_IDENTIFIER fm_sta_spg_chr.Vxx_dtc_stt_xxx ECU_ADDRESS 0xc000030f /end MEASUREMENT
/begin MEASUREMENT Vxx_dfctr_spg_oor "" UWORD _CNV_A_R_A_165_CM 1 0. 0. 65535. DISPLAY_IDENTIFIER fm_sta_spg_oor.Vxx_dfctr_xxx ECU_ADDRESS 0xc0000310 /end MEASUREMENT
/begin MEASUREMENT Vxx_rdn_spg_oor "" UWORD _CNV_A_R_A_165_CM 1 0. 0. 65535. DISPLAY_IDENTIFIER fm_sta_spg_oor.Vxx_rdn_xxx ECU_ADDRESS 0xc0000312 /end MEASUREMENT
/begin MEASUREMENT Vbx_cf_spg_oor "" UBYTE _CNV_A_R_A_165_CM 1 0. 0. 255. DISPLAY_IDENTIFIER fm_sta_spg_oor.fm_static_bitfield.Vbx_cf_xxx ECU_ADDRESS 0xc0000314 BIT_MASK 0x1 /end MEASUREMENT
/begin MEASUREMENT Vbx_clf_spg_oor "" UBYTE _CNV_A_R_A_165_CM 1 0. 0. 255. DISPLAY_IDENTIFIER fm_sta_spg_oor.fm_static_bitfield.Vbx_clf_xxx ECU_ADDRESS 0xc0000314 BIT_MASK 0x2 /end MEASUREMENT
/begin MEASUREMENT Vbx_df_old_spg_oor "" UBYTE _CNV_A_R_A_165_CM 1 0. 0. 255. DISPLAY_IDENTIFIER fm_sta_spg_oor.fm_static_bitfield.Vbx_df_old_xxx ECU_ADDRESS 0xc0000314 BIT_MASK 0x4 /end MEASUREMENT
/begin MEASUREMENT Vbx_dfctr_sat_spg_oor "" UBYTE _CNV_A_R_A_165_CM 1 0. 0. 255. DISPLAY_IDENTIFIER fm_sta_spg_oor.fm_static_bitfield.Vbx_dfctr_sat_xxx ECU_ADDRESS 0xc0000314 BIT_MASK 0x8 /end MEASUREMENT
/begin MEASUREMENT Vbx_rdn_spg_oor "" UBYTE _CNV_A_R_A_165_CM 1 0. 0. 255. DISPLAY_IDENTIFIER fm_sta_spg_oor.fm_static_bitfield.Vbx_rdn_xxx ECU_ADDRESS 0xc0000314 BIT_MASK 0x40 /end MEASUREMENT
/begin MEASUREMENT Vxx_dtc_stt_spg_oor "" UBYTE _CNV_A_R_A_165_CM 1 0. 0. 255. DISPLAY_IDENTIFIER fm_sta_spg_oor.Vxx_dtc_stt_xxx ECU_ADDRESS 0xc0000315 /end MEASUREMENT
/begin MEASUREMENT Vxx_dfctr_spg_reg_apl_down "" UWORD _CNV_A_R_A_165_CM 1 0. 0. 65535. DISPLAY_IDENTIFIER fm_sta_spg_reg_apl_down.Vxx_dfctr_xxx ECU_ADDRESS 0xc00001b4 /end MEASUREMENT
/begin MEASUREMENT Vxx_rdn_spg_reg_apl_down "" UWORD _CNV_A_R_A_165_CM 1 0. 0. 65535. DISPLAY_IDENTIFIER fm_sta_spg_reg_apl_down.Vxx_rdn_xxx ECU_ADDRESS 0xc00001b6 /end MEASUREMENT
/begin MEASUREMENT Vbx_cf_spg_reg_apl_down "" UBYTE _CNV_A_R_A_165_CM 1 0. 0. 255. DISPLAY_IDENTIFIER fm_sta_spg_reg_apl_down.fm_static_bitfield.Vbx_cf_xxx ECU_ADDRESS 0xc00001b8 BIT_MASK 0x1 /end MEASUREMENT
/begin MEASUREMENT Vbx_clf_spg_reg_apl_down "" UBYTE _CNV_A_R_A_165_CM 1 0. 0. 255. DISPLAY_IDENTIFIER fm_sta_spg_reg_apl_down.fm_static_bitfield.Vbx_clf_xxx ECU_ADDRESS 0xc00001b8 BIT_MASK 0x2 /end MEASUREMENT
/begin MEASUREMENT Vbx_df_old_spg_reg_apl_down "" UBYTE _CNV_A_R_A_165_CM 1 0. 0. 255. DISPLAY_IDENTIFIER fm_sta_spg_reg_apl_down.fm_static_bitfield.Vbx_df_old_xxx ECU_ADDRESS 0xc00001b8 BIT_MASK 0x4 /end MEASUREMENT
/begin MEASUREMENT Vbx_dfctr_sat_spg_reg_apl_down "" UBYTE _CNV_A_R_A_165_CM 1 0. 0. 255. DISPLAY_IDENTIFIER fm_sta_spg_reg_apl_down.fm_static_bitfield.Vbx_dfctr_sat_xxx ECU_ADDRESS 0xc00001b8 BIT_MASK 0x8 /end MEASUREMENT
/begin MEASUREMENT Vbx_rdn_spg_reg_apl_down "" UBYTE _CNV_A_R_A_165_CM 1 0. 0. 255. DISPLAY_IDENTIFIER fm_sta_spg_reg_apl_down.fm_static_bitfield.Vbx_rdn_xxx ECU_ADDRESS 0xc00001b8 BIT_MASK 0x40 /end MEASUREMENT
/begin MEASUREMENT Vxx_dtc_stt_spg_reg_apl_down "" UBYTE _CNV_A_R_A_165_CM 1 0. 0. 255. DISPLAY_IDENTIFIER fm_sta_spg_reg_apl_down.Vxx_dtc_stt_xxx ECU_ADDRESS 0xc00001b9 /end MEASUREMENT
/begin MEASUREMENT Vxx_dfctr_spg_reg_apl_up "" UWORD _CNV_A_R_A_165_CM 1 0. 0. 65535. DISPLAY_IDENTIFIER fm_sta_spg_reg_apl_up.Vxx_dfctr_xxx ECU_ADDRESS 0xc00001ba /end MEASUREMENT
/begin MEASUREMENT Vxx_rdn_spg_reg_apl_up "" UWORD _CNV_A_R_A_165_CM 1 0. 0. 65535. DISPLAY_IDENTIFIER fm_sta_spg_reg_apl_up.Vxx_rdn_xxx ECU_ADDRESS 0xc00001bc /end MEASUREMENT
/begin MEASUREMENT Vbx_cf_spg_reg_apl_up "" UBYTE _CNV_A_R_A_165_CM 1 0. 0. 255. DISPLAY_IDENTIFIER fm_sta_spg_reg_apl_up.fm_static_bitfield.Vbx_cf_xxx ECU_ADDRESS 0xc00001be BIT_MASK 0x1 /end MEASUREMENT
/begin MEASUREMENT Vbx_clf_spg_reg_apl_up "" UBYTE _CNV_A_R_A_165_CM 1 0. 0. 255. DISPLAY_IDENTIFIER fm_sta_spg_reg_apl_up.fm_static_bitfield.Vbx_clf_xxx ECU_ADDRESS 0xc00001be BIT_MASK 0x2 /end MEASUREMENT
/begin MEASUREMENT Vbx_df_old_spg_reg_apl_up "" UBYTE _CNV_A_R_A_165_CM 1 0. 0. 255. DISPLAY_IDENTIFIER fm_sta_spg_reg_apl_up.fm_static_bitfield.Vbx_df_old_xxx ECU_ADDRESS 0xc00001be BIT_MASK 0x4 /end MEASUREMENT
/begin MEASUREMENT Vbx_dfctr_sat_spg_reg_apl_up "" UBYTE _CNV_A_R_A_165_CM 1 0. 0. 255. DISPLAY_IDENTIFIER fm_sta_spg_reg_apl_up.fm_static_bitfield.Vbx_dfctr_sat_xxx ECU_ADDRESS 0xc00001be BIT_MASK 0x8 /end MEASUREMENT
/begin MEASUREMENT Vbx_rdn_spg_reg_apl_up "" UBYTE _CNV_A_R_A_165_CM 1 0. 0. 255. DISPLAY_IDENTIFIER fm_sta_spg_reg_apl_up.fm_static_bitfield.Vbx_rdn_xxx ECU_ADDRESS 0xc00001be BIT_MASK 0x40 /end MEASUREMENT
/begin MEASUREMENT Vxx_dtc_stt_spg_reg_apl_up "" UBYTE _CNV_A_R_A_165_CM 1 0. 0. 255. DISPLAY_IDENTIFIER fm_sta_spg_reg_apl_up.Vxx_dtc_stt_xxx ECU_ADDRESS 0xc00001bf /end MEASUREMENT
/begin MEASUREMENT Vxx_dfctr_tlz_ad_b_cpt "" UWORD _CNV_A_R_A_165_CM 1 0. 0. 65535. DISPLAY_IDENTIFIER fm_sta_tlz_ad_b_cpt.Vxx_dfctr_xxx ECU_ADDRESS 0xc0000316 /end MEASUREMENT
/begin MEASUREMENT Vxx_rdn_tlz_ad_b_cpt "" UWORD _CNV_A_R_A_165_CM 1 0. 0. 65535. DISPLAY_IDENTIFIER fm_sta_tlz_ad_b_cpt.Vxx_rdn_xxx ECU_ADDRESS 0xc0000318 /end MEASUREMENT
/begin MEASUREMENT Vbx_cf_tlz_ad_b_cpt "" UBYTE _CNV_A_R_A_165_CM 1 0. 0. 255. DISPLAY_IDENTIFIER fm_sta_tlz_ad_b_cpt.fm_static_bitfield.Vbx_cf_xxx ECU_ADDRESS 0xc000031a BIT_MASK 0x1 /end MEASUREMENT
/begin MEASUREMENT Vbx_clf_tlz_ad_b_cpt "" UBYTE _CNV_A_R_A_165_CM 1 0. 0. 255. DISPLAY_IDENTIFIER fm_sta_tlz_ad_b_cpt.fm_static_bitfield.Vbx_clf_xxx ECU_ADDRESS 0xc000031a BIT_MASK 0x2 /end MEASUREMENT
/begin MEASUREMENT Vbx_df_old_tlz_ad_b_cpt "" UBYTE _CNV_A_R_A_165_CM 1 0. 0. 255. DISPLAY_IDENTIFIER fm_sta_tlz_ad_b_cpt.fm_static_bitfield.Vbx_df_old_xxx ECU_ADDRESS 0xc000031a BIT_MASK 0x4 /end MEASUREMENT
/begin MEASUREMENT Vbx_dfctr_sat_tlz_ad_b_cpt "" UBYTE _CNV_A_R_A_165_CM 1 0. 0. 255. DISPLAY_IDENTIFIER fm_sta_tlz_ad_b_cpt.fm_static_bitfield.Vbx_dfctr_sat_xxx ECU_ADDRESS 0xc000031a BIT_MASK 0x8 /end MEASUREMENT
/begin MEASUREMENT Vbx_rdn_tlz_ad_b_cpt "" UBYTE _CNV_A_R_A_165_CM 1 0. 0. 255. DISPLAY_IDENTIFIER fm_sta_tlz_ad_b_cpt.fm_static_bitfield.Vbx_rdn_xxx ECU_ADDRESS 0xc000031a BIT_MASK 0x40 /end MEASUREMENT
/begin MEASUREMENT Vxx_dtc_stt_tlz_ad_b_cpt "" UBYTE _CNV_A_R_A_165_CM 1 0. 0. 255. DISPLAY_IDENTIFIER fm_sta_tlz_ad_b_cpt.Vxx_dtc_stt_xxx ECU_ADDRESS 0xc000031b /end MEASUREMENT
/begin MEASUREMENT Vxx_dfctr_vb_clc_chr "" UWORD _CNV_A_R_A_165_CM 1 0. 0. 65535. DISPLAY_IDENTIFIER fm_sta_vb_clc_chr.Vxx_dfctr_xxx ECU_ADDRESS 0xc0000442 /end MEASUREMENT
/begin MEASUREMENT Vxx_rdn_vb_clc_chr "" UWORD _CNV_A_R_A_165_CM 1 0. 0. 65535. DISPLAY_IDENTIFIER fm_sta_vb_clc_chr.Vxx_rdn_xxx ECU_ADDRESS 0xc0000444 /end MEASUREMENT
/begin MEASUREMENT Vbx_cf_vb_clc_chr "" UBYTE _CNV_A_R_A_165_CM 1 0. 0. 255. DISPLAY_IDENTIFIER fm_sta_vb_clc_chr.fm_static_bitfield.Vbx_cf_xxx ECU_ADDRESS 0xc0000446 BIT_MASK 0x1 /end MEASUREMENT
/begin MEASUREMENT Vbx_clf_vb_clc_chr "" UBYTE _CNV_A_R_A_165_CM 1 0. 0. 255. DISPLAY_IDENTIFIER fm_sta_vb_clc_chr.fm_static_bitfield.Vbx_clf_xxx ECU_ADDRESS 0xc0000446 BIT_MASK 0x2 /end MEASUREMENT
/begin MEASUREMENT Vbx_df_old_vb_clc_chr "" UBYTE _CNV_A_R_A_165_CM 1 0. 0. 255. DISPLAY_IDENTIFIER fm_sta_vb_clc_chr.fm_static_bitfield.Vbx_df_old_xxx ECU_ADDRESS 0xc0000446 BIT_MASK 0x4 /end MEASUREMENT
/begin MEASUREMENT Vbx_dfctr_sat_vb_clc_chr "" UBYTE _CNV_A_R_A_165_CM 1 0. 0. 255. DISPLAY_IDENTIFIER fm_sta_vb_clc_chr.fm_static_bitfield.Vbx_dfctr_sat_xxx ECU_ADDRESS 0xc0000446 BIT_MASK 0x8 /end MEASUREMENT
/begin MEASUREMENT Vbx_rdn_vb_clc_chr "" UBYTE _CNV_A_R_A_165_CM 1 0. 0. 255. DISPLAY_IDENTIFIER fm_sta_vb_clc_chr.fm_static_bitfield.Vbx_rdn_xxx ECU_ADDRESS 0xc0000446 BIT_MASK 0x40 /end MEASUREMENT
/begin MEASUREMENT Vxx_dtc_stt_vb_clc_chr "" UBYTE _CNV_A_R_A_165_CM 1 0. 0. 255. DISPLAY_IDENTIFIER fm_sta_vb_clc_chr.Vxx_dtc_stt_xxx ECU_ADDRESS 0xc0000447 /end MEASUREMENT
/begin MEASUREMENT Vxx_dfctr_vb_h "" UWORD _CNV_A_R_A_165_CM 1 0. 0. 65535. DISPLAY_IDENTIFIER fm_sta_vb_h.Vxx_dfctr_xxx ECU_ADDRESS 0xc00001c0 /end MEASUREMENT
/begin MEASUREMENT Vxx_rdn_vb_h "" UWORD _CNV_A_R_A_165_CM 1 0. 0. 65535. DISPLAY_IDENTIFIER fm_sta_vb_h.Vxx_rdn_xxx ECU_ADDRESS 0xc00001c2 /end MEASUREMENT
/begin MEASUREMENT Vbx_cf_vb_h "" UBYTE _CNV_A_R_A_165_CM 1 0. 0. 255. DISPLAY_IDENTIFIER fm_sta_vb_h.fm_static_bitfield.Vbx_cf_xxx ECU_ADDRESS 0xc00001c4 BIT_MASK 0x1 /end MEASUREMENT
/begin MEASUREMENT Vbx_clf_vb_h "" UBYTE _CNV_A_R_A_165_CM 1 0. 0. 255. DISPLAY_IDENTIFIER fm_sta_vb_h.fm_static_bitfield.Vbx_clf_xxx ECU_ADDRESS 0xc00001c4 BIT_MASK 0x2 /end MEASUREMENT
/begin MEASUREMENT Vbx_df_old_vb_h "" UBYTE _CNV_A_R_A_165_CM 1 0. 0. 255. DISPLAY_IDENTIFIER fm_sta_vb_h.fm_static_bitfield.Vbx_df_old_xxx ECU_ADDRESS 0xc00001c4 BIT_MASK 0x4 /end MEASUREMENT
/begin MEASUREMENT Vbx_dfctr_sat_vb_h "" UBYTE _CNV_A_R_A_165_CM 1 0. 0. 255. DISPLAY_IDENTIFIER fm_sta_vb_h.fm_static_bitfield.Vbx_dfctr_sat_xxx ECU_ADDRESS 0xc00001c4 BIT_MASK 0x8 /end MEASUREMENT
/begin MEASUREMENT Vbx_rdn_vb_h "" UBYTE _CNV_A_R_A_165_CM 1 0. 0. 255. DISPLAY_IDENTIFIER fm_sta_vb_h.fm_static_bitfield.Vbx_rdn_xxx ECU_ADDRESS 0xc00001c4 BIT_MASK 0x40 /end MEASUREMENT
/begin MEASUREMENT Vxx_dtc_stt_vb_h "" UBYTE _CNV_A_R_A_165_CM 1 0. 0. 255. DISPLAY_IDENTIFIER fm_sta_vb_h.Vxx_dtc_stt_xxx ECU_ADDRESS 0xc00001c5 /end MEASUREMENT
/begin MEASUREMENT Vxx_dfctr_vb_l "" UWORD _CNV_A_R_A_165_CM 1 0. 0. 65535. DISPLAY_IDENTIFIER fm_sta_vb_l.Vxx_dfctr_xxx ECU_ADDRESS 0xc00001c6 /end MEASUREMENT
/begin MEASUREMENT Vxx_rdn_vb_l "" UWORD _CNV_A_R_A_165_CM 1 0. 0. 65535. DISPLAY_IDENTIFIER fm_sta_vb_l.Vxx_rdn_xxx ECU_ADDRESS 0xc00001c8 /end MEASUREMENT
/begin MEASUREMENT Vbx_cf_vb_l "" UBYTE _CNV_A_R_A_165_CM 1 0. 0. 255. DISPLAY_IDENTIFIER fm_sta_vb_l.fm_static_bitfield.Vbx_cf_xxx ECU_ADDRESS 0xc00001ca BIT_MASK 0x1 /end MEASUREMENT
/begin MEASUREMENT Vbx_clf_vb_l "" UBYTE _CNV_A_R_A_165_CM 1 0. 0. 255. DISPLAY_IDENTIFIER fm_sta_vb_l.fm_static_bitfield.Vbx_clf_xxx ECU_ADDRESS 0xc00001ca BIT_MASK 0x2 /end MEASUREMENT
/begin MEASUREMENT Vbx_df_old_vb_l "" UBYTE _CNV_A_R_A_165_CM 1 0. 0. 255. DISPLAY_IDENTIFIER fm_sta_vb_l.fm_static_bitfield.Vbx_df_old_xxx ECU_ADDRESS 0xc00001ca BIT_MASK 0x4 /end MEASUREMENT
/begin MEASUREMENT Vbx_dfctr_sat_vb_l "" UBYTE _CNV_A_R_A_165_CM 1 0. 0. 255. DISPLAY_IDENTIFIER fm_sta_vb_l.fm_static_bitfield.Vbx_dfctr_sat_xxx ECU_ADDRESS 0xc00001ca BIT_MASK 0x8 /end MEASUREMENT
/begin MEASUREMENT Vbx_rdn_vb_l "" UBYTE _CNV_A_R_A_165_CM 1 0. 0. 255. DISPLAY_IDENTIFIER fm_sta_vb_l.fm_static_bitfield.Vbx_rdn_xxx ECU_ADDRESS 0xc00001ca BIT_MASK 0x40 /end MEASUREMENT
/begin MEASUREMENT Vxx_dtc_stt_vb_l "" UBYTE _CNV_A_R_A_165_CM 1 0. 0. 255. DISPLAY_IDENTIFIER fm_sta_vb_l.Vxx_dtc_stt_xxx ECU_ADDRESS 0xc00001cb /end MEASUREMENT
/begin MEASUREMENT Vxx_dfctr_vb_rly_oc_scg "" UWORD _CNV_A_R_A_165_CM 1 0. 0. 65535. DISPLAY_IDENTIFIER fm_sta_vb_rly_oc_scg.Vxx_dfctr_xxx ECU_ADDRESS 0xc00001cc /end MEASUREMENT
/begin MEASUREMENT Vxx_rdn_vb_rly_oc_scg "" UWORD _CNV_A_R_A_165_CM 1 0. 0. 65535. DISPLAY_IDENTIFIER fm_sta_vb_rly_oc_scg.Vxx_rdn_xxx ECU_ADDRESS 0xc00001ce /end MEASUREMENT
/begin MEASUREMENT Vbx_cf_vb_rly_oc_scg "" UBYTE _CNV_A_R_A_165_CM 1 0. 0. 255. DISPLAY_IDENTIFIER fm_sta_vb_rly_oc_scg.fm_static_bitfield.Vbx_cf_xxx ECU_ADDRESS 0xc00001d0 BIT_MASK 0x1 /end MEASUREMENT
/begin MEASUREMENT Vbx_clf_vb_rly_oc_scg "" UBYTE _CNV_A_R_A_165_CM 1 0. 0. 255. DISPLAY_IDENTIFIER fm_sta_vb_rly_oc_scg.fm_static_bitfield.Vbx_clf_xxx ECU_ADDRESS 0xc00001d0 BIT_MASK 0x2 /end MEASUREMENT
/begin MEASUREMENT Vbx_df_old_vb_rly_oc_scg "" UBYTE _CNV_A_R_A_165_CM 1 0. 0. 255. DISPLAY_IDENTIFIER fm_sta_vb_rly_oc_scg.fm_static_bitfield.Vbx_df_old_xxx ECU_ADDRESS 0xc00001d0 BIT_MASK 0x4 /end MEASUREMENT
/begin MEASUREMENT Vbx_dfctr_sat_vb_rly_oc_scg "" UBYTE _CNV_A_R_A_165_CM 1 0. 0. 255. DISPLAY_IDENTIFIER fm_sta_vb_rly_oc_scg.fm_static_bitfield.Vbx_dfctr_sat_xxx ECU_ADDRESS 0xc00001d0 BIT_MASK 0x8 /end MEASUREMENT
/begin MEASUREMENT Vbx_rdn_vb_rly_oc_scg "" UBYTE _CNV_A_R_A_165_CM 1 0. 0. 255. DISPLAY_IDENTIFIER fm_sta_vb_rly_oc_scg.fm_static_bitfield.Vbx_rdn_xxx ECU_ADDRESS 0xc00001d0 BIT_MASK 0x40 /end MEASUREMENT
/begin MEASUREMENT Vxx_dtc_stt_vb_rly_oc_scg "" UBYTE _CNV_A_R_A_165_CM 1 0. 0. 255. DISPLAY_IDENTIFIER fm_sta_vb_rly_oc_scg.Vxx_dtc_stt_xxx ECU_ADDRESS 0xc00001d1 /end MEASUREMENT
/begin MEASUREMENT Vxx_dfctr_vb_rly_scw "" UWORD _CNV_A_R_A_165_CM 1 0. 0. 65535. DISPLAY_IDENTIFIER fm_sta_vb_rly_scw.Vxx_dfctr_xxx ECU_ADDRESS 0xc00001d2 /end MEASUREMENT
/begin MEASUREMENT Vxx_rdn_vb_rly_scw "" UWORD _CNV_A_R_A_165_CM 1 0. 0. 65535. DISPLAY_IDENTIFIER fm_sta_vb_rly_scw.Vxx_rdn_xxx ECU_ADDRESS 0xc00001d4 /end MEASUREMENT
/begin MEASUREMENT Vbx_cf_vb_rly_scw "" UBYTE _CNV_A_R_A_165_CM 1 0. 0. 255. DISPLAY_IDENTIFIER fm_sta_vb_rly_scw.fm_static_bitfield.Vbx_cf_xxx ECU_ADDRESS 0xc00001d6 BIT_MASK 0x1 /end MEASUREMENT
/begin MEASUREMENT Vbx_clf_vb_rly_scw "" UBYTE _CNV_A_R_A_165_CM 1 0. 0. 255. DISPLAY_IDENTIFIER fm_sta_vb_rly_scw.fm_static_bitfield.Vbx_clf_xxx ECU_ADDRESS 0xc00001d6 BIT_MASK 0x2 /end MEASUREMENT
/begin MEASUREMENT Vbx_df_old_vb_rly_scw "" UBYTE _CNV_A_R_A_165_CM 1 0. 0. 255. DISPLAY_IDENTIFIER fm_sta_vb_rly_scw.fm_static_bitfield.Vbx_df_old_xxx ECU_ADDRESS 0xc00001d6 BIT_MASK 0x4 /end MEASUREMENT
/begin MEASUREMENT Vbx_dfctr_sat_vb_rly_scw "" UBYTE _CNV_A_R_A_165_CM 1 0. 0. 255. DISPLAY_IDENTIFIER fm_sta_vb_rly_scw.fm_static_bitfield.Vbx_dfctr_sat_xxx ECU_ADDRESS 0xc00001d6 BIT_MASK 0x8 /end MEASUREMENT
/begin MEASUREMENT Vbx_rdn_vb_rly_scw "" UBYTE _CNV_A_R_A_165_CM 1 0. 0. 255. DISPLAY_IDENTIFIER fm_sta_vb_rly_scw.fm_static_bitfield.Vbx_rdn_xxx ECU_ADDRESS 0xc00001d6 BIT_MASK 0x40 /end MEASUREMENT
/begin MEASUREMENT Vxx_dtc_stt_vb_rly_scw "" UBYTE _CNV_A_R_A_165_CM 1 0. 0. 255. DISPLAY_IDENTIFIER fm_sta_vb_rly_scw.Vxx_dtc_stt_xxx ECU_ADDRESS 0xc00001d7 /end MEASUREMENT
/begin MEASUREMENT Vxx_dfctr_wgc_oc "" UWORD _CNV_A_R_A_165_CM 1 0. 0. 65535. DISPLAY_IDENTIFIER fm_sta_wgc_oc.Vxx_dfctr_xxx ECU_ADDRESS 0xc000031c /end MEASUREMENT
/begin MEASUREMENT Vxx_rdn_wgc_oc "" UWORD _CNV_A_R_A_165_CM 1 0. 0. 65535. DISPLAY_IDENTIFIER fm_sta_wgc_oc.Vxx_rdn_xxx ECU_ADDRESS 0xc000031e /end MEASUREMENT
/begin MEASUREMENT Vbx_cf_wgc_oc "" UBYTE _CNV_A_R_A_165_CM 1 0. 0. 255. DISPLAY_IDENTIFIER fm_sta_wgc_oc.fm_static_bitfield.Vbx_cf_xxx ECU_ADDRESS 0xc0000320 BIT_MASK 0x1 /end MEASUREMENT
/begin MEASUREMENT Vbx_clf_wgc_oc "" UBYTE _CNV_A_R_A_165_CM 1 0. 0. 255. DISPLAY_IDENTIFIER fm_sta_wgc_oc.fm_static_bitfield.Vbx_clf_xxx ECU_ADDRESS 0xc0000320 BIT_MASK 0x2 /end MEASUREMENT
/begin MEASUREMENT Vbx_df_old_wgc_oc "" UBYTE _CNV_A_R_A_165_CM 1 0. 0. 255. DISPLAY_IDENTIFIER fm_sta_wgc_oc.fm_static_bitfield.Vbx_df_old_xxx ECU_ADDRESS 0xc0000320 BIT_MASK 0x4 /end MEASUREMENT
/begin MEASUREMENT Vbx_dfctr_sat_wgc_oc "" UBYTE _CNV_A_R_A_165_CM 1 0. 0. 255. DISPLAY_IDENTIFIER fm_sta_wgc_oc.fm_static_bitfield.Vbx_dfctr_sat_xxx ECU_ADDRESS 0xc0000320 BIT_MASK 0x8 /end MEASUREMENT
/begin MEASUREMENT Vbx_rdn_wgc_oc "" UBYTE _CNV_A_R_A_165_CM 1 0. 0. 255. DISPLAY_IDENTIFIER fm_sta_wgc_oc.fm_static_bitfield.Vbx_rdn_xxx ECU_ADDRESS 0xc0000320 BIT_MASK 0x40 /end MEASUREMENT
/begin MEASUREMENT Vxx_dtc_stt_wgc_oc "" UBYTE _CNV_A_R_A_165_CM 1 0. 0. 255. DISPLAY_IDENTIFIER fm_sta_wgc_oc.Vxx_dtc_stt_xxx ECU_ADDRESS 0xc0000321 /end MEASUREMENT
/begin MEASUREMENT Vxx_dfctr_wgc_scg "" UWORD _CNV_A_R_A_165_CM 1 0. 0. 65535. DISPLAY_IDENTIFIER fm_sta_wgc_scg.Vxx_dfctr_xxx ECU_ADDRESS 0xc0000322 /end MEASUREMENT
/begin MEASUREMENT Vxx_rdn_wgc_scg "" UWORD _CNV_A_R_A_165_CM 1 0. 0. 65535. DISPLAY_IDENTIFIER fm_sta_wgc_scg.Vxx_rdn_xxx ECU_ADDRESS 0xc0000324 /end MEASUREMENT
/begin MEASUREMENT Vbx_cf_wgc_scg "" UBYTE _CNV_A_R_A_165_CM 1 0. 0. 255. DISPLAY_IDENTIFIER fm_sta_wgc_scg.fm_static_bitfield.Vbx_cf_xxx ECU_ADDRESS 0xc0000326 BIT_MASK 0x1 /end MEASUREMENT
/begin MEASUREMENT Vbx_clf_wgc_scg "" UBYTE _CNV_A_R_A_165_CM 1 0. 0. 255. DISPLAY_IDENTIFIER fm_sta_wgc_scg.fm_static_bitfield.Vbx_clf_xxx ECU_ADDRESS 0xc0000326 BIT_MASK 0x2 /end MEASUREMENT
/begin MEASUREMENT Vbx_df_old_wgc_scg "" UBYTE _CNV_A_R_A_165_CM 1 0. 0. 255. DISPLAY_IDENTIFIER fm_sta_wgc_scg.fm_static_bitfield.Vbx_df_old_xxx ECU_ADDRESS 0xc0000326 BIT_MASK 0x4 /end MEASUREMENT
/begin MEASUREMENT Vbx_dfctr_sat_wgc_scg "" UBYTE _CNV_A_R_A_165_CM 1 0. 0. 255. DISPLAY_IDENTIFIER fm_sta_wgc_scg.fm_static_bitfield.Vbx_dfctr_sat_xxx ECU_ADDRESS 0xc0000326 BIT_MASK 0x8 /end MEASUREMENT
/begin MEASUREMENT Vbx_rdn_wgc_scg "" UBYTE _CNV_A_R_A_165_CM 1 0. 0. 255. DISPLAY_IDENTIFIER fm_sta_wgc_scg.fm_static_bitfield.Vbx_rdn_xxx ECU_ADDRESS 0xc0000326 BIT_MASK 0x40 /end MEASUREMENT
/begin MEASUREMENT Vxx_dtc_stt_wgc_scg "" UBYTE _CNV_A_R_A_165_CM 1 0. 0. 255. DISPLAY_IDENTIFIER fm_sta_wgc_scg.Vxx_dtc_stt_xxx ECU_ADDRESS 0xc0000327 /end MEASUREMENT
/begin MEASUREMENT Vxx_dfctr_wgc_scw "" UWORD _CNV_A_R_A_165_CM 1 0. 0. 65535. DISPLAY_IDENTIFIER fm_sta_wgc_scw.Vxx_dfctr_xxx ECU_ADDRESS 0xc0000328 /end MEASUREMENT
/begin MEASUREMENT Vxx_rdn_wgc_scw "" UWORD _CNV_A_R_A_165_CM 1 0. 0. 65535. DISPLAY_IDENTIFIER fm_sta_wgc_scw.Vxx_rdn_xxx ECU_ADDRESS 0xc000032a /end MEASUREMENT
/begin MEASUREMENT Vbx_cf_wgc_scw "" UBYTE _CNV_A_R_A_165_CM 1 0. 0. 255. DISPLAY_IDENTIFIER fm_sta_wgc_scw.fm_static_bitfield.Vbx_cf_xxx ECU_ADDRESS 0xc000032c BIT_MASK 0x1 /end MEASUREMENT
/begin MEASUREMENT Vbx_clf_wgc_scw "" UBYTE _CNV_A_R_A_165_CM 1 0. 0. 255. DISPLAY_IDENTIFIER fm_sta_wgc_scw.fm_static_bitfield.Vbx_clf_xxx ECU_ADDRESS 0xc000032c BIT_MASK 0x2 /end MEASUREMENT
/begin MEASUREMENT Vbx_df_old_wgc_scw "" UBYTE _CNV_A_R_A_165_CM 1 0. 0. 255. DISPLAY_IDENTIFIER fm_sta_wgc_scw.fm_static_bitfield.Vbx_df_old_xxx ECU_ADDRESS 0xc000032c BIT_MASK 0x4 /end MEASUREMENT
/begin MEASUREMENT Vbx_dfctr_sat_wgc_scw "" UBYTE _CNV_A_R_A_165_CM 1 0. 0. 255. DISPLAY_IDENTIFIER fm_sta_wgc_scw.fm_static_bitfield.Vbx_dfctr_sat_xxx ECU_ADDRESS 0xc000032c BIT_MASK 0x8 /end MEASUREMENT
/begin MEASUREMENT Vbx_rdn_wgc_scw "" UBYTE _CNV_A_R_A_165_CM 1 0. 0. 255. DISPLAY_IDENTIFIER fm_sta_wgc_scw.fm_static_bitfield.Vbx_rdn_xxx ECU_ADDRESS 0xc000032c BIT_MASK 0x40 /end MEASUREMENT
/begin MEASUREMENT Vxx_dtc_stt_wgc_scw "" UBYTE _CNV_A_R_A_165_CM 1 0. 0. 255. DISPLAY_IDENTIFIER fm_sta_wgc_scw.Vxx_dtc_stt_xxx ECU_ADDRESS 0xc000032d /end MEASUREMENT
/begin MEASUREMENT Vxx_dfctr_wpmp_tcr_blk "" UWORD _CNV_A_R_A_165_CM 1 0. 0. 65535. DISPLAY_IDENTIFIER fm_sta_wpmp_tcr_blk.Vxx_dfctr_xxx ECU_ADDRESS 0xc0000400 /end MEASUREMENT
/begin MEASUREMENT Vxx_rdn_wpmp_tcr_blk "" UWORD _CNV_A_R_A_165_CM 1 0. 0. 65535. DISPLAY_IDENTIFIER fm_sta_wpmp_tcr_blk.Vxx_rdn_xxx ECU_ADDRESS 0xc0000402 /end MEASUREMENT
/begin MEASUREMENT Vbx_cf_wpmp_tcr_blk "" UBYTE _CNV_A_R_A_165_CM 1 0. 0. 255. DISPLAY_IDENTIFIER fm_sta_wpmp_tcr_blk.fm_static_bitfield.Vbx_cf_xxx ECU_ADDRESS 0xc0000404 BIT_MASK 0x1 /end MEASUREMENT
/begin MEASUREMENT Vbx_clf_wpmp_tcr_blk "" UBYTE _CNV_A_R_A_165_CM 1 0. 0. 255. DISPLAY_IDENTIFIER fm_sta_wpmp_tcr_blk.fm_static_bitfield.Vbx_clf_xxx ECU_ADDRESS 0xc0000404 BIT_MASK 0x2 /end MEASUREMENT
/begin MEASUREMENT Vbx_df_old_wpmp_tcr_blk "" UBYTE _CNV_A_R_A_165_CM 1 0. 0. 255. DISPLAY_IDENTIFIER fm_sta_wpmp_tcr_blk.fm_static_bitfield.Vbx_df_old_xxx ECU_ADDRESS 0xc0000404 BIT_MASK 0x4 /end MEASUREMENT
/begin MEASUREMENT Vbx_dfctr_sat_wpmp_tcr_blk "" UBYTE _CNV_A_R_A_165_CM 1 0. 0. 255. DISPLAY_IDENTIFIER fm_sta_wpmp_tcr_blk.fm_static_bitfield.Vbx_dfctr_sat_xxx ECU_ADDRESS 0xc0000404 BIT_MASK 0x8 /end MEASUREMENT
/begin MEASUREMENT Vbx_rdn_wpmp_tcr_blk "" UBYTE _CNV_A_R_A_165_CM 1 0. 0. 255. DISPLAY_IDENTIFIER fm_sta_wpmp_tcr_blk.fm_static_bitfield.Vbx_rdn_xxx ECU_ADDRESS 0xc0000404 BIT_MASK 0x40 /end MEASUREMENT
/begin MEASUREMENT Vxx_dtc_stt_wpmp_tcr_blk "" UBYTE _CNV_A_R_A_165_CM 1 0. 0. 255. DISPLAY_IDENTIFIER fm_sta_wpmp_tcr_blk.Vxx_dtc_stt_xxx ECU_ADDRESS 0xc0000405 /end MEASUREMENT
/begin MEASUREMENT Vxx_dfctr_wpmp_tcr_oc "" UWORD _CNV_A_R_A_165_CM 1 0. 0. 65535. DISPLAY_IDENTIFIER fm_sta_wpmp_tcr_oc.Vxx_dfctr_xxx ECU_ADDRESS 0xc000032e /end MEASUREMENT
/begin MEASUREMENT Vxx_rdn_wpmp_tcr_oc "" UWORD _CNV_A_R_A_165_CM 1 0. 0. 65535. DISPLAY_IDENTIFIER fm_sta_wpmp_tcr_oc.Vxx_rdn_xxx ECU_ADDRESS 0xc0000330 /end MEASUREMENT
/begin MEASUREMENT Vbx_cf_wpmp_tcr_oc "" UBYTE _CNV_A_R_A_165_CM 1 0. 0. 255. DISPLAY_IDENTIFIER fm_sta_wpmp_tcr_oc.fm_static_bitfield.Vbx_cf_xxx ECU_ADDRESS 0xc0000332 BIT_MASK 0x1 /end MEASUREMENT
/begin MEASUREMENT Vbx_clf_wpmp_tcr_oc "" UBYTE _CNV_A_R_A_165_CM 1 0. 0. 255. DISPLAY_IDENTIFIER fm_sta_wpmp_tcr_oc.fm_static_bitfield.Vbx_clf_xxx ECU_ADDRESS 0xc0000332 BIT_MASK 0x2 /end MEASUREMENT
/begin MEASUREMENT Vbx_df_old_wpmp_tcr_oc "" UBYTE _CNV_A_R_A_165_CM 1 0. 0. 255. DISPLAY_IDENTIFIER fm_sta_wpmp_tcr_oc.fm_static_bitfield.Vbx_df_old_xxx ECU_ADDRESS 0xc0000332 BIT_MASK 0x4 /end MEASUREMENT
/begin MEASUREMENT Vbx_dfctr_sat_wpmp_tcr_oc "" UBYTE _CNV_A_R_A_165_CM 1 0. 0. 255. DISPLAY_IDENTIFIER fm_sta_wpmp_tcr_oc.fm_static_bitfield.Vbx_dfctr_sat_xxx ECU_ADDRESS 0xc0000332 BIT_MASK 0x8 /end MEASUREMENT
/begin MEASUREMENT Vbx_rdn_wpmp_tcr_oc "" UBYTE _CNV_A_R_A_165_CM 1 0. 0. 255. DISPLAY_IDENTIFIER fm_sta_wpmp_tcr_oc.fm_static_bitfield.Vbx_rdn_xxx ECU_ADDRESS 0xc0000332 BIT_MASK 0x40 /end MEASUREMENT
/begin MEASUREMENT Vxx_dtc_stt_wpmp_tcr_oc "" UBYTE _CNV_A_R_A_165_CM 1 0. 0. 255. DISPLAY_IDENTIFIER fm_sta_wpmp_tcr_oc.Vxx_dtc_stt_xxx ECU_ADDRESS 0xc0000333 /end MEASUREMENT
/begin MEASUREMENT Vxx_dfctr_wpmp_tcr_scg "" UWORD _CNV_A_R_A_165_CM 1 0. 0. 65535. DISPLAY_IDENTIFIER fm_sta_wpmp_tcr_scg.Vxx_dfctr_xxx ECU_ADDRESS 0xc0000334 /end MEASUREMENT
/begin MEASUREMENT Vxx_rdn_wpmp_tcr_scg "" UWORD _CNV_A_R_A_165_CM 1 0. 0. 65535. DISPLAY_IDENTIFIER fm_sta_wpmp_tcr_scg.Vxx_rdn_xxx ECU_ADDRESS 0xc0000336 /end MEASUREMENT
/begin MEASUREMENT Vbx_cf_wpmp_tcr_scg "" UBYTE _CNV_A_R_A_165_CM 1 0. 0. 255. DISPLAY_IDENTIFIER fm_sta_wpmp_tcr_scg.fm_static_bitfield.Vbx_cf_xxx ECU_ADDRESS 0xc0000338 BIT_MASK 0x1 /end MEASUREMENT
/begin MEASUREMENT Vbx_clf_wpmp_tcr_scg "" UBYTE _CNV_A_R_A_165_CM 1 0. 0. 255. DISPLAY_IDENTIFIER fm_sta_wpmp_tcr_scg.fm_static_bitfield.Vbx_clf_xxx ECU_ADDRESS 0xc0000338 BIT_MASK 0x2 /end MEASUREMENT
/begin MEASUREMENT Vbx_df_old_wpmp_tcr_scg "" UBYTE _CNV_A_R_A_165_CM 1 0. 0. 255. DISPLAY_IDENTIFIER fm_sta_wpmp_tcr_scg.fm_static_bitfield.Vbx_df_old_xxx ECU_ADDRESS 0xc0000338 BIT_MASK 0x4 /end MEASUREMENT
/begin MEASUREMENT Vbx_dfctr_sat_wpmp_tcr_scg "" UBYTE _CNV_A_R_A_165_CM 1 0. 0. 255. DISPLAY_IDENTIFIER fm_sta_wpmp_tcr_scg.fm_static_bitfield.Vbx_dfctr_sat_xxx ECU_ADDRESS 0xc0000338 BIT_MASK 0x8 /end MEASUREMENT
/begin MEASUREMENT Vbx_rdn_wpmp_tcr_scg "" UBYTE _CNV_A_R_A_165_CM 1 0. 0. 255. DISPLAY_IDENTIFIER fm_sta_wpmp_tcr_scg.fm_static_bitfield.Vbx_rdn_xxx ECU_ADDRESS 0xc0000338 BIT_MASK 0x40 /end MEASUREMENT
/begin MEASUREMENT Vxx_dtc_stt_wpmp_tcr_scg "" UBYTE _CNV_A_R_A_165_CM 1 0. 0. 255. DISPLAY_IDENTIFIER fm_sta_wpmp_tcr_scg.Vxx_dtc_stt_xxx ECU_ADDRESS 0xc0000339 /end MEASUREMENT
/begin MEASUREMENT Vxx_dfctr_wpmp_tcr_scw "" UWORD _CNV_A_R_A_165_CM 1 0. 0. 65535. DISPLAY_IDENTIFIER fm_sta_wpmp_tcr_scw.Vxx_dfctr_xxx ECU_ADDRESS 0xc000033a /end MEASUREMENT
/begin MEASUREMENT Vxx_rdn_wpmp_tcr_scw "" UWORD _CNV_A_R_A_165_CM 1 0. 0. 65535. DISPLAY_IDENTIFIER fm_sta_wpmp_tcr_scw.Vxx_rdn_xxx ECU_ADDRESS 0xc000033c /end MEASUREMENT
/begin MEASUREMENT Vbx_cf_wpmp_tcr_scw "" UBYTE _CNV_A_R_A_165_CM 1 0. 0. 255. DISPLAY_IDENTIFIER fm_sta_wpmp_tcr_scw.fm_static_bitfield.Vbx_cf_xxx ECU_ADDRESS 0xc000033e BIT_MASK 0x1 /end MEASUREMENT
/begin MEASUREMENT Vbx_clf_wpmp_tcr_scw "" UBYTE _CNV_A_R_A_165_CM 1 0. 0. 255. DISPLAY_IDENTIFIER fm_sta_wpmp_tcr_scw.fm_static_bitfield.Vbx_clf_xxx ECU_ADDRESS 0xc000033e BIT_MASK 0x2 /end MEASUREMENT
/begin MEASUREMENT Vbx_df_old_wpmp_tcr_scw "" UBYTE _CNV_A_R_A_165_CM 1 0. 0. 255. DISPLAY_IDENTIFIER fm_sta_wpmp_tcr_scw.fm_static_bitfield.Vbx_df_old_xxx ECU_ADDRESS 0xc000033e BIT_MASK 0x4 /end MEASUREMENT
/begin MEASUREMENT Vbx_dfctr_sat_wpmp_tcr_scw "" UBYTE _CNV_A_R_A_165_CM 1 0. 0. 255. DISPLAY_IDENTIFIER fm_sta_wpmp_tcr_scw.fm_static_bitfield.Vbx_dfctr_sat_xxx ECU_ADDRESS 0xc000033e BIT_MASK 0x8 /end MEASUREMENT
/begin MEASUREMENT Vbx_rdn_wpmp_tcr_scw "" UBYTE _CNV_A_R_A_165_CM 1 0. 0. 255. DISPLAY_IDENTIFIER fm_sta_wpmp_tcr_scw.fm_static_bitfield.Vbx_rdn_xxx ECU_ADDRESS 0xc000033e BIT_MASK 0x40 /end MEASUREMENT
/begin MEASUREMENT Vxx_dtc_stt_wpmp_tcr_scw "" UBYTE _CNV_A_R_A_165_CM 1 0. 0. 255. DISPLAY_IDENTIFIER fm_sta_wpmp_tcr_scw.Vxx_dtc_stt_xxx ECU_ADDRESS 0xc000033f /end MEASUREMENT
/begin COMPU_METHOD _CNV_A_R_A_165_CM "" RAT_FUNC "%6.3" "" COEFFS 0 1. 0. 0 0 1 /end COMPU_METHOD
/begin RECORD_LAYOUT _REC_S1VAL_20_u2 FNC_VALUES 1 UWORD COLUMN_DIR DIRECT /end RECORD_LAYOUT
/begin FUNCTION DgDftMng ""
 /begin DEF_CHARACTERISTIC Ctx_ffm_did_ac_prs[0] Ctx_ffm_did_ac_prs[1] Ctx_ffm_did_ac_prs[2] Ctx_ffm_did_ac_prs[3] Ctx_ffm_did_ac_prs[4] Cxx_dtc_hmb_ac_prs Ctx_ffm_did_acel_pdl[0] Ctx_ffm_did_acel_pdl[1] Ctx_ffm_did_acel_pdl[2] Ctx_ffm_did_acel_pdl[3] Ctx_ffm_did_acel_pdl[4] Cxx_dtc_hmb_acel_pdl Ctx_ffm_did_acel_pdl_v1[0] Ctx_ffm_did_acel_pdl_v1[1] Ctx_ffm_did_acel_pdl_v1[2] Ctx_ffm_did_acel_pdl_v1[3] Ctx_ffm_did_acel_pdl_v1[4] Cxx_dtc_hmb_acel_pdl_v1 Ctx_ffm_did_acel_pdl_v2[0] Ctx_ffm_did_acel_pdl_v2[1] Ctx_ffm_did_acel_pdl_v2[2] Ctx_ffm_did_acel_pdl_v2[3] Ctx_ffm_did_acel_pdl_v2[4] Cxx_dtc_hmb_acel_pdl_v2 Ctx_ffm_did_actr_rly[0] Ctx_ffm_did_actr_rly[1] Ctx_ffm_did_actr_rly[2] Ctx_ffm_did_actr_rly[3] Ctx_ffm_did_actr_rly[4] Cxx_dtc_hmb_actr_rly Ctx_ffm_did_agb[0] Ctx_ffm_did_agb[1] Ctx_ffm_did_agb[2] Ctx_ffm_did_agb[3] /end DEF_CHARACTERISTIC
 /begin OUT_MEASUREMENT Vbx_dfctr_sat_inj1_scw Vbx_rdn_inj1_scw Vxx_dtc_stt_inj1_scw Vxx_dfctr_inj2_oc Vxx_rdn_inj2_oc Vbx_cf_inj2_oc Vbx_clf_inj2_oc Vbx_df_old_inj2_oc Vbx_dfctr_sat_inj2_oc Vbx_rdn_inj2_oc Vxx_dtc_stt_inj2_oc Vxx_dfctr_inj2_scg Vxx_rdn_inj2_scg Vbx_cf_inj2_scg Vbx_clf_inj2_scg Vbx_df_old_inj2_scg Vbx_dfctr_sat_inj2_scg Vbx_rdn_inj2_scg Vxx_dtc_stt_inj2_scg Vxx_dfctr_inj2_scw Vxx_rdn_inj2_scw Vbx_cf_inj2_scw Vbx_clf_inj2_scw Vbx_df_old_inj2_scw Vbx_dfctr_sat_inj2_scw Vbx_rdn_inj2_scw Vxx_dtc_stt_inj2_scw Vxx_dfctr_inj3_oc Vxx_rdn_inj3_oc Vbx_cf_inj3_oc Vbx_clf_inj3_oc Vbx_df_old_inj3_oc Vbx_dfctr_sat_inj3_oc Vbx_rdn_inj3_oc Vxx_dtc_stt_inj3_oc Vxx_dfctr_inj3_scg Vxx_rdn_inj3_scg Vbx_cf_inj3_scg Vbx_clf_inj3_scg Vbx_df_old_inj3_scg Vbx_dfctr_sat_inj3_scg Vbx_rdn_inj3_scg Vxx_dtc_stt_inj3_scg Vxx_dfctr_inj3_scw Vxx_rdn_inj3_scw Vbx_cf_inj3_scw Vbx_clf_inj3_scw Vbx_df_old_inj3_scw Vbx_dfctr_sat_inj3_scw Vbx_rdn_inj3_scw Vxx_dtc_stt_inj3_scw Vxx_dfctr_inj4_oc Vxx_rdn_inj4_oc Vbx_cf_inj4_oc Vbx_clf_inj4_oc Vbx_df_old_inj4_oc Vbx_dfctr_sat_inj4_oc Vbx_rdn_inj4_oc Vxx_dtc_stt_inj4_oc Vxx_dfctr_inj4_scg Vxx_rdn_inj4_scg Vbx_cf_inj4_scg Vbx_clf_inj4_scg Vbx_df_old_inj4_scg Vbx_dfctr_sat_inj4_scg Vbx_rdn_inj4_scg Vxx_dtc_stt_inj4_scg Vxx_dfctr_inj4_scw Vxx_rdn_inj4_scw Vbx_cf_inj4_scw Vbx_clf_inj4_scw Vbx_df_old_inj4_scw Vbx_dfctr_sat_inj4_scw Vbx_rdn_inj4_scw Vxx_dtc_stt_inj4_scw Vxx_dfctr_inj_ecu_itl Vxx_rdn_inj_ecu_itl Vbx_cf_inj_ecu_itl Vbx_clf_inj_ecu_itl Vbx_df_old_inj_ecu_itl Vbx_dfctr_sat_inj_ecu_itl Vbx_rdn_inj_ecu_itl Vxx_dtc_stt_inj_ecu_itl Vxx_dfctr_inj_ecu_lbdw_icp Vxx_rdn_inj_ecu_lbdw_icp Vbx_cf_inj_ecu_lbdw_icp Vbx_clf_inj_ecu_lbdw_icp Vbx_df_old_inj_ecu_lbdw_icp Vbx_dfctr_sat_inj_ecu_lbdw_icp Vbx_rdn_inj_ecu_lbdw_icp Vxx_dtc_stt_inj_ecu_lbdw_icp Vxx_dfctr_inj_ecu_lbup_icp Vxx_rdn_inj_ecu_lbup_icp Vbx_cf_inj_ecu_lbup_icp Vbx_clf_inj_ecu_lbup_icp Vbx_df_old_inj_ecu_lbup_icp Vbx_dfctr_sat_inj_ecu_lbup_icp Vbx_rdn_inj_ecu_lbup_icp Vxx_dtc_stt_inj_ecu_lbup_icp Vxx_dfctr_ip_lght_tco_ovh Vxx_rdn_ip_lght_tco_ovh Vbx_cf_ip_lght_tco_ovh Vbx_clf_ip_lght_tco_ovh Vbx_df_old_ip_lght_tco_ovh Vbx_dfctr_sat_ip_lght_tco_ovh Vbx_rdn_ip_lght_tco_ovh Vxx_dtc_stt_ip_lght_tco_ovh Vxx_dfctr_it_cmd_el Vxx_rdn_it_cmd_el Vbx_cf_it_cmd_el Vbx_clf_it_cmd_el Vbx_df_old_it_cmd_el Vbx_dfctr_sat_it_cmd_el Vbx_rdn_it_cmd_el Vxx_dtc_stt_it_cmd_el Vxx_dfctr_it_ofs_meca Vxx_rdn_it_ofs_meca Vbx_cf_it_ofs_meca Vbx_clf_it_ofs_meca Vbx_df_old_it_ofs_meca Vbx_dfctr_sat_it_ofs_meca Vbx_rdn_it_ofs_meca Vxx_dtc_stt_it_ofs_meca Vxx_dfctr_it_ofs_no_norm Vxx_rdn_it_ofs_no_norm Vbx_cf_it_ofs_no_norm Vbx_clf_it_ofs_no_norm Vbx_df_old_it_ofs_no_norm Vbx_dfctr_sat_it_ofs_no_norm Vbx_rdn_it_ofs_no_norm Vxx_dtc_stt_it_ofs_no_norm Vxx_dfctr_it_ofs_secu_nok Vxx_rdn_it_ofs_secu_nok Vbx_cf_it_ofs_secu_nok Vbx_clf_it_ofs_secu_nok Vbx_df_old_it_ofs_secu_nok Vbx_dfctr_sat_it_ofs_secu_nok Vbx_rdn_it_ofs_secu_nok Vxx_dtc_stt_it_ofs_secu_nok Vxx_dfctr_it_reg_blk Vxx_rdn_it_reg_blk Vbx_cf_it_reg_blk Vbx_clf_it_reg_blk Vbx_df_old_it_reg_blk Vbx_dfctr_sat_it_reg_blk Vbx_rdn_it_reg_blk Vxx_dtc_stt_it_reg_blk Vxx_dfctr_knk_oor Vxx_rdn_knk_oor Vbx_cf_knk_oor Vbx_clf_knk_oor Vbx_df_old_knk_oor Vbx_dfctr_sat_knk_oor Vbx_rdn_knk_oor Vxx_dtc_stt_knk_oor Vxx_dfctr_knk_shp Vxx_rdn_knk_shp Vbx_cf_knk_shp Vbx_clf_knk_shp Vbx_df_old_knk_shp Vbx_dfctr_sat_knk_shp Vbx_rdn_knk_shp Vxx_dtc_stt_knk_shp Vxx_dfctr_lbdw_hot_oc Vxx_rdn_lbdw_hot_oc Vbx_cf_lbdw_hot_oc Vbx_clf_lbdw_hot_oc Vbx_df_old_lbdw_hot_oc Vbx_dfctr_sat_lbdw_hot_oc Vbx_rdn_lbdw_hot_oc Vxx_dtc_stt_lbdw_hot_oc Vxx_dfctr_lbdw_hot_scg Vxx_rdn_lbdw_hot_scg Vbx_cf_lbdw_hot_scg Vbx_clf_lbdw_hot_scg Vbx_df_old_lbdw_hot_scg Vbx_dfctr_sat_lbdw_hot_scg Vbx_rdn_lbdw_hot_scg Vxx_dtc_stt_lbdw_hot_scg Vxx_dfctr_lbdw_hot_scw Vxx_rdn_lbdw_hot_scw Vbx_cf_lbdw_hot_scw Vbx_clf_lbdw_hot_scw Vbx_df_old_lbdw_hot_scw Vbx_dfctr_sat_lbdw_hot_scw Vbx_rdn_lbdw_hot_scw Vxx_dtc_stt_lbdw_hot_scw Vxx_dfctr_lbdw_oc Vxx_rdn_lbdw_oc Vbx_cf_lbdw_oc Vbx_clf_lbdw_oc Vbx_df_old_lbdw_oc Vbx_dfctr_sat_lbdw_oc Vbx_rdn_lbdw_oc Vxx_dtc_stt_lbdw_oc Vxx_dfctr_lbdw_scg Vxx_rdn_lbdw_scg Vbx_cf_lbdw_scg Vbx_clf_lbdw_scg Vbx_df_old_lbdw_scg Vbx_dfctr_sat_lbdw_scg Vbx_rdn_lbdw_scg Vxx_dtc_stt_lbdw_scg Vxx_dfctr_lbdw_scw Vxx_rdn_lbdw_scw Vbx_cf_lbdw_scw Vbx_clf_lbdw_scw Vbx_df_old_lbdw_scw Vbx_dfctr_sat_lbdw_scw Vbx_rdn_lbdw_scw Vxx_dtc_stt_lbdw_scw Vxx_dfctr_lbup_cpt Vxx_rdn_lbup_cpt Vbx_cf_lbup_cpt Vbx_clf_lbup_cpt Vbx_df_old_lbup_cpt Vbx_dfctr_sat_lbup_cpt Vbx_rdn_lbup_cpt Vxx_dtc_stt_lbup_cpt Vxx_dfctr_lbup_hot_apl_down Vxx_rdn_lbup_hot_apl_down Vbx_cf_lbup_hot_apl_down Vbx_clf_lbup_hot_apl_down Vbx_df_old_lbup_hot_apl_down Vbx_dfctr_sat_lbup_hot_apl_down Vbx_rdn_lbup_hot_apl_down Vxx_dtc_stt_lbup_hot_apl_down Vxx_dfctr_lbup_hot_oc Vxx_rdn_lbup_hot_oc Vbx_cf_lbup_hot_oc Vbx_clf_lbup_hot_oc Vbx_df_old_lbup_hot_oc Vbx_dfctr_sat_lbup_hot_oc Vbx_rdn_lbup_hot_oc Vxx_dtc_stt_lbup_hot_oc Vxx_dfctr_lbup_hot_scg Vxx_rdn_lbup_hot_scg Vbx_cf_lbup_hot_scg Vbx_clf_lbup_hot_scg Vbx_df_old_lbup_hot_scg Vbx_dfctr_sat_lbup_hot_scg Vbx_rdn_lbup_hot_scg Vxx_dtc_stt_lbup_hot_scg Vxx_dfctr_lbup_hot_scw Vxx_rdn_lbup_hot_scw Vbx_cf_lbup_hot_scw Vbx_clf_lbup_hot_scw Vbx_df_old_lbup_hot_scw Vbx_dfctr_sat_lbup_hot_scw Vbx_rdn_lbup_hot_scw Vxx_dtc_stt_lbup_hot_scw Vxx_dfctr_lbup_nok Vxx_rdn_lbup_nok Vbx_cf_lbup_nok Vbx_clf_lbup_nok Vbx_df_old_lbup_nok Vbx_dfctr_sat_lbup_nok Vbx_rdn_lbup_nok Vxx_dtc_stt_lbup_nok Vxx_dfctr_lbup_oc Vxx_rdn_lbup_oc Vbx_cf_lbup_oc Vbx_clf_lbup_oc Vbx_df_old_lbup_oc Vbx_dfctr_sat_lbup_oc Vbx_rdn_lbup_oc Vxx_dtc_stt_lbup_oc Vxx_dfctr_lbup_scg Vxx_rdn_lbup_scg Vbx_cf_lbup_scg Vbx_clf_lbup_scg Vbx_df_old_lbup_scg Vbx_dfctr_sat_lbup_scg Vbx_rdn_lbup_scg Vxx_dtc_stt_lbup_scg Vxx_dfctr_lbup_scw Vxx_rdn_lbup_scw Vbx_cf_lbup_scw Vbx_clf_lbup_scw Vbx_df_old_lbup_scw Vbx_dfctr_sat_lbup_scw Vbx_rdn_lbup_scw Vxx_dtc_stt_lbup_scw Vxx_dfctr_map_chr Vxx_rdn_map_chr Vbx_cf_map_chr Vbx_clf_map_chr Vbx_df_old_map_chr Vbx_dfctr_sat_map_chr Vbx_rdn_map_chr Vxx_dtc_stt_map_chr Vxx_dfctr_map_oor Vxx_rdn_map_oor Vbx_cf_map_oor Vbx_clf_map_oor Vbx_df_old_map_oor Vbx_dfctr_sat_map_oor Vbx_rdn_map_oor Vxx_dtc_stt_map_oor Vxx_dfctr_mis_1_cata Vxx_rdn_mis_1_cata Vbx_cf_mis_1_cata Vbx_clf_mis_1_cata Vbx_df_old_mis_1_cata Vbx_dfctr_sat_mis_1_cata Vbx_rdn_mis_1_cata Vxx_dtc_stt_mis_1_cata Vxx_dfctr_mis_1_lpg_cata Vxx_rdn_mis_1_lpg_cata Vbx_cf_mis_1_lpg_cata Vbx_clf_mis_1_lpg_cata Vbx_df_old_mis_1_lpg_cata Vbx_dfctr_sat_mis_1_lpg_cata Vbx_rdn_mis_1_lpg_cata Vxx_dtc_stt_mis_1_lpg_cata Vxx_dfctr_mis_1_lpg_trs_h Vxx_rdn_mis_1_lpg_trs_h Vbx_cf_mis_1_lpg_trs_h Vbx_clf_mis_1_lpg_trs_h Vbx_df_old_mis_1_lpg_trs_h Vbx_dfctr_sat_mis_1_lpg_trs_h Vbx_rdn_mis_1_lpg_trs_h Vxx_dtc_stt_mis_1_lpg_trs_h Vxx_dfctr_mis_1_trs_h Vxx_rdn_mis_1_trs_h Vbx_cf_mis_1_trs_h Vbx_clf_mis_1_trs_h Vbx_df_old_mis_1_trs_h Vbx_dfctr_sat_mis_1_trs_h Vbx_rdn_mis_1_trs_h Vxx_dtc_stt_mis_1_trs_h Vxx_dfctr_mis_2_cata Vxx_rdn_mis_2_cata Vbx_cf_mis_2_cata Vbx_clf_mis_2_cata Vbx_df_old_mis_2_cata Vbx_dfctr_sat_mis_2_cata Vbx_rdn_mis_2_cata Vxx_dtc_stt_mis_2_cata Vxx_dfctr_mis_2_lpg_cata Vxx_rdn_mis_2_lpg_cata Vbx_cf_mis_2_lpg_cata Vbx_clf_mis_2_lpg_cata Vbx_df_old_mis_2_lpg_cata Vbx_dfctr_sat_mis_2_lpg_cata Vbx_rdn_mis_2_lpg_cata Vxx_dtc_stt_mis_2_lpg_cata Vxx_dfctr_mis_2_lpg_trs_h Vxx_rdn_mis_2_lpg_trs_h Vbx_cf_mis_2_lpg_trs_h Vbx_clf_mis_2_lpg_trs_h Vbx_df_old_mis_2_lpg_trs_h Vbx_dfctr_sat_mis_2_lpg_trs_h Vbx_rdn_mis_2_lpg_trs_h Vxx_dtc_stt_mis_2_lpg_trs_h Vxx_dfctr_mis_2_trs_h Vxx_rdn_mis_2_trs_h Vbx_cf_mis_2_trs_h Vbx_clf_mis_2_trs_h Vbx_df_old_mis_2_trs_h Vbx_dfctr_sat_mis_2_trs_h Vbx_rdn_mis_2_trs_h Vxx_dtc_stt_mis_2_trs_h Vxx_dfctr_mis_3_cata Vxx_rdn_mis_3_cata Vbx_cf_mis_3_cata Vbx_clf_mis_3_cata Vbx_df_old_mis_3_cata Vbx_dfctr_sat_mis_3_cata Vbx_rdn_mis_3_cata Vxx_dtc_stt_mis_3_cata Vxx_dfctr_mis_3_lpg_cata Vxx_rdn_mis_3_lpg_cata Vbx_cf_mis_3_lpg_cata Vbx_clf_mis_3_lpg_cata Vbx_df_old_mis_3_lpg_cata Vbx_dfctr_sat_mis_3_lpg_cata Vbx_rdn_mis_3_lpg_cata Vxx_dtc_stt_mis_3_lpg_cata Vxx_dfctr_mis_3_lpg_trs_h Vxx_rdn_mis_3_lpg_trs_h Vbx_cf_mis_3_lpg_trs_h Vbx_clf_mis_3_lpg_trs_h Vbx_df_old_mis_3_lpg_trs_h Vbx_dfctr_sat_mis_3_lpg_trs_h Vbx_rdn_mis_3_lpg_trs_h Vxx_dtc_stt_mis_3_lpg_trs_h Vxx_dfctr_mis_3_trs_h Vxx_rdn_mis_3_trs_h Vbx_cf_mis_3_trs_h Vbx_clf_mis_3_trs_h Vbx_df_old_mis_3_trs_h Vbx_dfctr_sat_mis_3_trs_h Vbx_rdn_mis_3_trs_h Vxx_dtc_stt_mis_3_trs_h Vxx_dfctr_mis_4_cata Vxx_rdn_mis_4_cata Vbx_cf_mis_4_cata Vbx_clf_mis_4_cata Vbx_df_old_mis_4_cata Vbx_dfctr_sat_mis_4_cata Vbx_rdn_mis_4_cata Vxx_dtc_stt_mis_4_cata Vxx_dfctr_mis_4_lpg_cata Vxx_rdn_mis_4_lpg_cata Vbx_cf_mis_4_lpg_cata Vbx_clf_mis_4_lpg_cata Vbx_df_old_mis_4_lpg_cata Vbx_dfctr_sat_mis_4_lpg_cata Vbx_rdn_mis_4_lpg_cata Vxx_dtc_stt_mis_4_lpg_cata Vxx_dfctr_mis_4_lpg_trs_h Vxx_rdn_mis_4_lpg_trs_h Vbx_cf_mis_4_lpg_trs_h Vbx_clf_mis_4_lpg_trs_h Vbx_df_old_mis_4_lpg_trs_h Vbx_dfctr_sat_mis_4_lpg_trs_h Vbx_rdn_mis_4_lpg_trs_h Vxx_dtc_stt_mis_4_lpg_trs_h Vxx_dfctr_mis_4_trs_h Vxx_rdn_mis_4_trs_h Vbx_cf_mis_4_trs_h Vbx_clf_mis_4_trs_h Vbx_df_old_mis_4_trs_h Vbx_dfctr_sat_mis_4_trs_h Vbx_rdn_mis_4_trs_h Vxx_dtc_stt_mis_4_trs_h Vxx_dfctr_mis_cata Vxx_rdn_mis_cata Vbx_cf_mis_cata Vbx_clf_mis_cata Vbx_df_old_mis_cata Vbx_dfctr_sat_mis_cata Vbx_rdn_mis_cata Vxx_dtc_stt_mis_cata Vxx_dfctr_mis_lpg_cata Vxx_rdn_mis_lpg_cata Vbx_cf_mis_lpg_cata Vbx_clf_mis_lpg_cata Vbx_df_old_mis_lpg_cata Vbx_dfctr_sat_mis_lpg_cata Vbx_rdn_mis_lpg_cata Vxx_dtc_stt_mis_lpg_cata Vxx_dfctr_mis_lpg_trs_h Vxx_rdn_mis_lpg_trs_h Vbx_cf_mis_lpg_trs_h Vbx_clf_mis_lpg_trs_h Vbx_df_old_mis_lpg_trs_h Vbx_dfctr_sat_mis_lpg_trs_h Vbx_rdn_mis_lpg_trs_h Vxx_dtc_stt_mis_lpg_trs_h Vxx_dfctr_mis_min_fuel_cata Vxx_rdn_mis_min_fuel_cata Vbx_cf_mis_min_fuel_cata Vbx_clf_mis_min_fuel_cata Vbx_df_old_mis_min_fuel_cata Vbx_dfctr_sat_mis_min_fuel_cata Vbx_rdn_mis_min_fuel_cata Vxx_dtc_stt_mis_min_fuel_cata Vxx_dfctr_mis_min_fuel_trs_h Vxx_rdn_mis_min_fuel_trs_h Vbx_cf_mis_min_fuel_trs_h Vbx_clf_mis_min_fuel_trs_h Vbx_df_old_mis_min_fuel_trs_h Vbx_dfctr_sat_mis_min_fuel_trs_h Vbx_rdn_mis_min_fuel_trs_h Vxx_dtc_stt_mis_min_fuel_trs_h Vxx_dfctr_mis_trs_h Vxx_rdn_mis_trs_h Vbx_cf_mis_trs_h Vbx_clf_mis_trs_h Vbx_df_old_mis_trs_h Vbx_dfctr_sat_mis_trs_h Vbx_rdn_mis_trs_h Vxx_dtc_stt_mis_trs_h Vxx_dfctr_mis_unk_cata Vxx_rdn_mis_unk_cata Vbx_cf_mis_unk_cata Vbx_clf_mis_unk_cata Vbx_df_old_mis_unk_cata Vbx_dfctr_sat_mis_unk_cata Vbx_rdn_mis_unk_cata Vxx_dtc_stt_mis_unk_cata Vxx_dfctr_mis_unk_lpg_cata Vxx_rdn_mis_unk_lpg_cata Vbx_cf_mis_unk_lpg_cata Vbx_clf_mis_unk_lpg_cata Vbx_df_old_mis_unk_lpg_cata Vbx_dfctr_sat_mis_unk_lpg_cata Vbx_rdn_mis_unk_lpg_cata Vxx_dtc_stt_mis_unk_lpg_cata Vxx_dfctr_mis_unk_lpg_trs_h Vxx_rdn_mis_unk_lpg_trs_h Vbx_cf_mis_unk_lpg_trs_h Vbx_clf_mis_unk_lpg_trs_h Vbx_df_old_mis_unk_lpg_trs_h Vbx_dfctr_sat_mis_unk_lpg_trs_h Vbx_rdn_mis_unk_lpg_trs_h Vxx_dtc_stt_mis_unk_lpg_trs_h Vxx_dfctr_mis_unk_trs_h Vxx_rdn_mis_unk_trs_h Vbx_cf_mis_unk_trs_h Vbx_clf_mis_unk_trs_h Vbx_df_old_mis_unk_trs_h Vbx_dfctr_sat_mis_unk_trs_h Vbx_rdn_mis_unk_trs_h Vxx_dtc_stt_mis_unk_trs_h Vxx_dfctr_ptc_rov_oc Vxx_rdn_ptc_rov_oc Vbx_cf_ptc_rov_oc Vbx_clf_ptc_rov_oc Vbx_df_old_ptc_rov_oc Vbx_dfctr_sat_ptc_rov_oc Vbx_rdn_ptc_rov_oc Vxx_dtc_stt_ptc_rov_oc Vxx_dfctr_ptc_rov_scg Vxx_rdn_ptc_rov_scg Vbx_cf_ptc_rov_scg Vbx_clf_ptc_rov_scg Vbx_df_old_ptc_rov_scg Vbx_dfctr_sat_ptc_rov_scg Vbx_rdn_ptc_rov_scg Vxx_dtc_stt_ptc_rov_scg Vxx_dfctr_ptc_rov_scw Vxx_rdn_ptc_rov_scw Vbx_cf_ptc_rov_scw Vbx_clf_ptc_rov_scw Vbx_df_old_ptc_rov_scw Vbx_dfctr_sat_ptc_rov_scw Vbx_rdn_ptc_rov_scw Vxx_dtc_stt_ptc_rov_scw Vxx_dfctr_pws_1_h Vxx_rdn_pws_1_h Vbx_cf_pws_1_h Vbx_clf_pws_1_h Vbx_df_old_pws_1_h Vbx_dfctr_sat_pws_1_h Vbx_rdn_pws_1_h Vxx_dtc_stt_pws_1_h Vxx_dfctr_pws_1_l Vxx_rdn_pws_1_l Vbx_cf_pws_1_l Vbx_clf_pws_1_l Vbx_df_old_pws_1_l Vbx_dfctr_sat_pws_1_l Vbx_rdn_pws_1_l Vxx_dtc_stt_pws_1_l Vxx_dfctr_pws_2_h Vxx_rdn_pws_2_h Vbx_cf_pws_2_h Vbx_clf_pws_2_h Vbx_df_old_pws_2_h Vbx_dfctr_sat_pws_2_h Vbx_rdn_pws_2_h Vxx_dtc_stt_pws_2_h Vxx_dfctr_pws_2_l Vxx_rdn_pws_2_l Vbx_cf_pws_2_l Vbx_clf_pws_2_l Vbx_df_old_pws_2_l Vbx_dfctr_sat_pws_2_l Vbx_rdn_pws_2_l Vxx_dtc_stt_pws_2_l Vxx_dfctr_pws_3_h Vxx_rdn_pws_3_h Vbx_cf_pws_3_h Vbx_clf_pws_3_h Vbx_df_old_pws_3_h Vbx_dfctr_sat_pws_3_h Vbx_rdn_pws_3_h Vxx_dtc_stt_pws_3_h Vxx_dfctr_pws_3_l Vxx_rdn_pws_3_l Vbx_cf_pws_3_l Vbx_clf_pws_3_l Vbx_df_old_pws_3_l Vbx_dfctr_sat_pws_3_l Vbx_rdn_pws_3_l Vxx_dtc_stt_pws_3_l Vxx_dfctr_sens_it_1_nok Vxx_rdn_sens_it_1_nok Vbx_cf_sens_it_1_nok Vbx_clf_sens_it_1_nok Vbx_df_old_sens_it_1_nok Vbx_dfctr_sat_sens_it_1_nok Vbx_rdn_sens_it_1_nok Vxx_dtc_stt_sens_it_1_nok Vxx_dfctr_sens_it_2_nok Vxx_rdn_sens_it_2_nok Vbx_cf_sens_it_2_nok Vbx_clf_sens_it_2_nok Vbx_df_old_sens_it_2_nok Vbx_dfctr_sat_sens_it_2_nok Vbx_rdn_sens_it_2_nok Vxx_dtc_stt_sens_it_2_nok Vxx_dfctr_sens_it_chr Vxx_rdn_sens_it_chr Vbx_cf_sens_it_chr Vbx_clf_sens_it_chr Vbx_df_old_sens_it_chr Vbx_dfctr_sat_sens_it_chr Vbx_rdn_sens_it_chr Vxx_dtc_stt_sens_it_chr Vxx_dfctr_sens_it_sig_mcut Vxx_rdn_sens_it_sig_mcut Vbx_cf_sens_it_sig_mcut Vbx_clf_sens_it_sig_mcut Vbx_df_old_sens_it_sig_mcut Vbx_dfctr_sat_sens_it_sig_mcut Vbx_rdn_sens_it_sig_mcut Vxx_dtc_stt_sens_it_sig_mcut Vxx_dfctr_sens_map_h Vxx_rdn_sens_map_h Vbx_cf_sens_map_h Vbx_clf_sens_map_h Vbx_df_old_sens_map_h Vbx_dfctr_sat_sens_map_h Vbx_rdn_sens_map_h Vxx_dtc_stt_sens_map_h Vxx_dfctr_sens_map_l Vxx_rdn_sens_map_l Vbx_cf_sens_map_l Vbx_clf_sens_map_l Vbx_df_old_sens_map_l Vbx_dfctr_sat_sens_map_l Vbx_rdn_sens_map_l Vxx_dtc_stt_sens_map_l Vxx_dfctr_sens_mat_h Vxx_rdn_sens_mat_h Vbx_cf_sens_mat_h Vbx_clf_sens_mat_h Vbx_df_old_sens_mat_h Vbx_dfctr_sat_sens_mat_h Vbx_rdn_sens_mat_h Vxx_dtc_stt_sens_mat_h Vxx_dfctr_sens_mat_l Vxx_rdn_sens_mat_l Vbx_cf_sens_mat_l Vbx_clf_sens_mat_l Vbx_df_old_sens_mat_l Vbx_dfctr_sat_sens_mat_l Vbx_rdn_sens_mat_l Vxx_dtc_stt_sens_mat_l Vxx_dfctr_sens_spg_h Vxx_rdn_sens_spg_h Vbx_cf_sens_spg_h Vbx_clf_sens_spg_h Vbx_df_old_sens_spg_h Vbx_dfctr_sat_sens_spg_h Vbx_rdn_sens_spg_h Vxx_dtc_stt_sens_spg_h Vxx_dfctr_sens_spg_l Vxx_rdn_sens_spg_l Vbx_cf_sens_spg_l Vbx_clf_sens_spg_l Vbx_df_old_sens_spg_l Vbx_dfctr_sat_sens_spg_l Vbx_rdn_sens_spg_l Vxx_dtc_stt_sens_spg_l Vxx_dfctr_sens_tco_h Vxx_rdn_sens_tco_h Vbx_cf_sens_tco_h Vbx_clf_sens_tco_h Vbx_df_old_sens_tco_h Vbx_dfctr_sat_sens_tco_h Vbx_rdn_sens_tco_h Vxx_dtc_stt_sens_tco_h Vxx_dfctr_sens_tco_l Vxx_rdn_sens_tco_l Vbx_cf_sens_tco_l Vbx_clf_sens_tco_l Vbx_df_old_sens_tco_l Vbx_dfctr_sat_sens_tco_l Vbx_rdn_sens_tco_l Vxx_dtc_stt_sens_tco_l Vxx_dfctr_sens_tco_sig_mcut Vxx_rdn_sens_tco_sig_mcut Vbx_cf_sens_tco_sig_mcut Vbx_clf_sens_tco_sig_mcut Vbx_df_old_sens_tco_sig_mcut Vbx_dfctr_sat_sens_tco_sig_mcut Vbx_rdn_sens_tco_sig_mcut Vxx_dtc_stt_sens_tco_sig_mcut Vxx_dfctr_sfty_tq_chr Vxx_rdn_sfty_tq_chr Vbx_cf_sfty_tq_chr Vbx_clf_sfty_tq_chr Vbx_df_old_sfty_tq_chr Vbx_dfctr_sat_sfty_tq_chr Vbx_rdn_sfty_tq_chr Vxx_dtc_stt_sfty_tq_chr Vxx_dfctr_sfty_tq_clc_chr Vxx_rdn_sfty_tq_clc_chr Vbx_cf_sfty_tq_clc_chr Vbx_clf_sfty_tq_clc_chr Vbx_df_old_sfty_tq_clc_chr Vbx_dfctr_sat_sfty_tq_clc_chr Vbx_rdn_sfty_tq_clc_chr Vxx_dtc_stt_sfty_tq_clc_chr Vxx_dfctr_sfty_tq_lih_chr Vxx_rdn_sfty_tq_lih_chr Vbx_cf_sfty_tq_lih_chr Vbx_clf_sfty_tq_lih_chr Vbx_df_old_sfty_tq_lih_chr Vbx_dfctr_sat_sfty_tq_lih_chr Vbx_rdn_sfty_tq_lih_chr Vxx_dtc_stt_sfty_tq_lih_chr Vxx_dfctr_spg_chr Vxx_rdn_spg_chr Vbx_cf_spg_chr Vbx_clf_spg_chr Vbx_df_old_spg_chr Vbx_dfctr_sat_spg_chr Vbx_rdn_spg_chr Vxx_dtc_stt_spg_chr Vxx_dfctr_spg_oor Vxx_rdn_spg_oor Vbx_cf_spg_oor Vbx_clf_spg_oor Vbx_df_old_spg_oor Vbx_dfctr_sat_spg_oor Vbx_rdn_spg_oor Vxx_dtc_stt_spg_oor Vxx_dfctr_spg_reg_apl_down Vxx_rdn_spg_reg_apl_down Vbx_cf_spg_reg_apl_down Vbx_clf_spg_reg_apl_down Vbx_df_old_spg_reg_apl_down Vbx_dfctr_sat_spg_reg_apl_down Vbx_rdn_spg_reg_apl_down Vxx_dtc_stt_spg_reg_apl_down Vxx_dfctr_spg_reg_apl_up Vxx_rdn_spg_reg_apl_up Vbx_cf_spg_reg_apl_up Vbx_clf_spg_reg_apl_up Vbx_df_old_spg_reg_apl_up Vbx_dfctr_sat_spg_reg_apl_up Vbx_rdn_spg_reg_apl_up Vxx_dtc_stt_spg_reg_apl_up Vxx_dfctr_tlz_ad_b_cpt Vxx_rdn_tlz_ad_b_cpt Vbx_cf_tlz_ad_b_cpt Vbx_clf_tlz_ad_b_cpt Vbx_df_old_tlz_ad_b_cpt Vbx_dfctr_sat_tlz_ad_b_cpt Vbx_rdn_tlz_ad_b_cpt Vxx_dtc_stt_tlz_ad_b_cpt Vxx_dfctr_vb_clc_chr Vxx_rdn_vb_clc_chr Vbx_cf_vb_clc_chr Vbx_clf_vb_clc_chr Vbx_df_old_vb_clc_chr Vbx_dfctr_sat_vb_clc_chr Vbx_rdn_vb_clc_chr Vxx_dtc_stt_vb_clc_chr Vxx_dfctr_vb_h Vxx_rdn_vb_h Vbx_cf_vb_h Vbx_clf_vb_h Vbx_df_old_vb_h Vbx_dfctr_sat_vb_h Vbx_rdn_vb_h Vxx_dtc_stt_vb_h Vxx_dfctr_vb_l Vxx_rdn_vb_l Vbx_cf_vb_l Vbx_clf_vb_l Vbx_df_old_vb_l Vbx_dfctr_sat_vb_l Vbx_rdn_vb_l Vxx_dtc_stt_vb_l Vxx_dfctr_vb_rly_oc_scg Vxx_rdn_vb_rly_oc_scg Vbx_cf_vb_rly_oc_scg Vbx_clf_vb_rly_oc_scg Vbx_df_old_vb_rly_oc_scg Vbx_dfctr_sat_vb_rly_oc_scg Vbx_rdn_vb_rly_oc_scg Vxx_dtc_stt_vb_rly_oc_scg Vxx_dfctr_vb_rly_scw Vxx_rdn_vb_rly_scw Vbx_cf_vb_rly_scw Vbx_clf_vb_rly_scw Vbx_df_old_vb_rly_scw Vbx_dfctr_sat_vb_rly_scw Vbx_rdn_vb_rly_scw Vxx_dtc_stt_vb_rly_scw Vxx_dfctr_wgc_oc Vxx_rdn_wgc_oc Vbx_cf_wgc_oc Vbx_clf_wgc_oc Vbx_df_old_wgc_oc Vbx_dfctr_sat_wgc_oc Vbx_rdn_wgc_oc Vxx_dtc_stt_wgc_oc Vxx_dfctr_wgc_scg Vxx_rdn_wgc_scg Vbx_cf_wgc_scg Vbx_clf_wgc_scg Vbx_df_old_wgc_scg Vbx_dfctr_sat_wgc_scg Vbx_rdn_wgc_scg Vxx_dtc_stt_wgc_scg Vxx_dfctr_wgc_scw Vxx_rdn_wgc_scw Vbx_cf_wgc_scw Vbx_clf_wgc_scw Vbx_df_old_wgc_scw Vbx_dfctr_sat_wgc_scw Vbx_rdn_wgc_scw Vxx_dtc_stt_wgc_scw Vxx_dfctr_wpmp_tcr_blk Vxx_rdn_wpmp_tcr_blk Vbx_cf_wpmp_tcr_blk Vbx_clf_wpmp_tcr_blk Vbx_df_old_wpmp_tcr_blk Vbx_dfctr_sat_wpmp_tcr_blk Vbx_rdn_wpmp_tcr_blk Vxx_dtc_stt_wpmp_tcr_blk Vxx_dfctr_wpmp_tcr_oc Vxx_rdn_wpmp_tcr_oc Vbx_cf_wpmp_tcr_oc Vbx_clf_wpmp_tcr_oc Vbx_df_old_wpmp_tcr_oc Vbx_dfctr_sat_wpmp_tcr_oc Vbx_rdn_wpmp_tcr_oc Vxx_dtc_stt_wpmp_tcr_oc Vxx_dfctr_wpmp_tcr_scg Vxx_rdn_wpmp_tcr_scg Vbx_cf_wpmp_tcr_scg Vbx_clf_wpmp_tcr_scg Vbx_df_old_wpmp_tcr_scg Vbx_dfctr_sat_wpmp_tcr_scg Vbx_rdn_wpmp_tcr_scg Vxx_dtc_stt_wpmp_tcr_scg Vxx_dfctr_wpmp_tcr_scw Vxx_rdn_wpmp_tcr_scw Vbx_cf_wpmp_tcr_scw Vbx_clf_wpmp_tcr_scw Vbx_df_old_wpmp_tcr_scw Vbx_dfctr_sat_wpmp_tcr_scw Vbx_rdn_wpmp_tcr_scw Vxx_dtc_stt_wpmp_tcr_scw /end OUT_MEASUREMENT
/end FUNCTION
/end MODULE
/end PROJECT
