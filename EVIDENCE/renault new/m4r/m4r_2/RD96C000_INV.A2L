ASAP2_VERSION 1 41
/begin PROJECT RD8 "_default_ProjectLongIdentifier"
/begin HEADER "_default_HeaderComment" PROJECT_NO RD9 /end HEADER
/begin MODULE _default_ModuleName "_default_ModuleLongIdentifier"
/begin MOD_COMMON "_default_ModCommonComment" DEPOSIT ABSOLUTE BYTE_ORDER MSB_LAST ALIGNMENT_BYTE 1 ALIGNMENT_WORD 2 ALIGNMENT_LONG 2 ALIGNMENT_FLOAT32_IEEE 2 ALIGNMENT_FLOAT64_IEEE 4 /end MOD_COMMON
/begin AXIS_PTS Ctb_sta_tco "Coolant temperature breakpoints for starting set point tables" 0xa002dfe4 Vxx_tco _REC_A2AXS_20_u2 240. _CNV_A_R_LINEAR_____54_CM 8 -40. 200. FORMAT "%5.1" /end AXIS_PTS
/begin AXIS_PTS Ctb_tco "16 engine coolant temperature breakpoints" 0xa002dff8 Vxx_tco _REC_A2AXS_20_u2 240. _CNV_A_R_LINEAR_____54_CM 16 -40. 200. FORMAT "%5.1" /end AXIS_PTS
/begin CHARACTERISTIC Ctd_n_prop_thd "offset of proportional activation" CURVE 0xa002e58c _REC_A1CUR_20_u2_u1 16383.75 _CNV_A_R_ENSD_LINEA_24_CM 0. 16383.75 FORMAT "%8.2"
 /begin AXIS_DESCR COM_AXIS Vxx_gear _CNV_A_R_LINEAR_____113_CM 8 -1. 6. READ_ONLY FORMAT "%2.0" AXIS_PTS_REF Ntb_gear /end AXIS_DESCR
/end CHARACTERISTIC
/begin CHARACTERISTIC Ctd_ovn_tq_int_k "Gain for the Integrator" CURVE 0xa002e59c _REC_A1CUR_20_u2_u1 255. _CNV_A_R_LINEAR_____347_CM 0. 255. FORMAT "%6.2"
 /begin AXIS_DESCR COM_AXIS Vxx_gear _CNV_A_R_LINEAR_____113_CM 8 -1. 6. READ_ONLY FORMAT "%2.0" AXIS_PTS_REF Ntb_gear /end AXIS_DESCR
/end CHARACTERISTIC
/begin CHARACTERISTIC Ctd_ovn_tq_prop_k "Gain for proportional" CURVE 0xa002e5ac _REC_A1CUR_20_u2_u1 255. _CNV_A_R_LINEAR_____347_CM 0. 255. FORMAT "%6.2"
 /begin AXIS_DESCR COM_AXIS Vxx_gear _CNV_A_R_LINEAR_____113_CM 8 -1. 6. READ_ONLY FORMAT "%2.0" AXIS_PTS_REF Ntb_gear /end AXIS_DESCR
/end CHARACTERISTIC
/begin MEASUREMENT Vxx_lim_dif_n "difference between the setpoint and the engine speed" SWORD _CNV_A_R_ENSD_LINEA_24_CM 1 0. -8192. 8191.75 ECU_ADDRESS 0xd0003532 FORMAT "%8.2" /end MEASUREMENT
/begin MEASUREMENT Vxx_lim_dif_n_prop "difference between the setpiont and the engine speed  + offset of proportional activation" SWORD _CNV_A_R_ENSD_LINEA_24_CM 1 0. -8192. 8191.75 ECU_ADDRESS 0xd0003534 FORMAT "%8.2" /end MEASUREMENT
/begin MEASUREMENT Vxx_ovn_tq_cor "final torque corrective applied on maximum torque in case of overspeed." SWORD _CNV_A_R_LINEAR_____123_CM 1 0. -1024. 1023.96875 ECU_ADDRESS 0xd0003536 FORMAT "%11.5" /end MEASUREMENT
/begin MEASUREMENT Vxx_ovn_tq_cor_p_i "torque corrective output of the PI" SWORD _CNV_A_R_LINEAR_____123_CM 1 0. -1024. 1023.96875 ECU_ADDRESS 0xd0003538 FORMAT "%11.5" /end MEASUREMENT
/begin MEASUREMENT Vxx_ovn_tq_int "torque corrective output of the integrator" SWORD _CNV_A_R_LINEAR_____123_CM 1 0. -1024. 1023.96875 ECU_ADDRESS 0xd000353a FORMAT "%11.5" /end MEASUREMENT
/begin MEASUREMENT Vxx_ovn_tq_prop "torque corrective output of the proportional" SWORD _CNV_A_R_LINEAR_____123_CM 1 0. -1024. 1023.96875 ECU_ADDRESS 0xd000353c FORMAT "%11.5" /end MEASUREMENT
/begin CHARACTERISTIC Cxx_ovn_tq_prop_t_fil "Filter timer constant for engine speed in the loop proportional" VALUE 0xa0020838 _REC_S1VAL_20_u1 2.55 _CNV_A_R_LINEAR_____34_CM 0. 2.55 FORMAT "%4.2" /end CHARACTERISTIC
/begin CHARACTERISTIC Cxx_tqe_max_ovn "torque saturation for the controller PI" VALUE 0xa0020836 _REC_S1VAL_20_s2 2047.96875 _CNV_A_R_LINEAR_____123_CM -1024. 1023.96875 FORMAT "%11.5" /end CHARACTERISTIC
/begin MEASUREMENT Vbx_ovn_cut_sp "setpoint torque cut for over speed" UBYTE _CNV_S_2_RANGE______3_CM 1 0. 0. 1. ECU_ADDRESS 0xd0003eef BIT_MASK 0x1 /end MEASUREMENT
/begin CHARACTERISTIC Cxx_inj_stop_n_ofs "injection stop offset" VALUE 0xa0020d9a _REC_S1VAL_20_u2 16383.75 _CNV_A_R_ENSD_LINEA_24_CM 0. 16383.75 FORMAT "%8.2" /end CHARACTERISTIC
/begin CHARACTERISTIC Ctd_gear_cge_max_n_ofs "Offset on nominal engine speed limitation (for gear change indicator light)" CURVE 0xa002389c _REC_A1CUR_20_u2_u1 16383.75 _CNV_A_R_ENSD_LINEA_24_CM 0. 16383.75 FORMAT "%8.2"
 /begin AXIS_DESCR COM_AXIS Vxx_gear _CNV_A_R_LINEAR_____113_CM 8 -1. 6. READ_ONLY FORMAT "%2.0" AXIS_PTS_REF Ntb_gear /end AXIS_DESCR
/end CHARACTERISTIC
/begin CHARACTERISTIC Ctp_max_n_gear "Maximum engine speed depending on gearbox ratio" CURVE 0xa00238ac _REC_A1CUR_20_u2_u1 16383.75 _CNV_A_R_ENSD_LINEA_24_CM 0. 16383.75 FORMAT "%8.2"
 /begin AXIS_DESCR COM_AXIS Vxx_gear _CNV_A_R_LINEAR_____113_CM 8 -1. 6. READ_ONLY FORMAT "%2.0" AXIS_PTS_REF Ntb_gear /end AXIS_DESCR
/end CHARACTERISTIC
/begin CHARACTERISTIC Ctp_max_n_tco "Maximum engine speed depending on coolant temperature" CURVE 0xa00238bc _REC_A1CUR_20_u2_u2 16383.75 _CNV_A_R_ENSD_LINEA_24_CM 0. 16383.75 FORMAT "%8.2"
 /begin AXIS_DESCR COM_AXIS Vxx_tco _CNV_A_R_LINEAR_____54_CM 16 -40. 200. FORMAT "%5.1" AXIS_PTS_REF Ctb_tco /end AXIS_DESCR
/end CHARACTERISTIC
/begin CHARACTERISTIC Ctp_max_n_toil "Maximum engine speed depending on oil temperature" CURVE 0xa00238dc _REC_A1CUR_20_u2_u2 16383.75 _CNV_A_R_ENSD_LINEA_24_CM 0. 16383.75 FORMAT "%8.2"
 /begin AXIS_DESCR COM_AXIS Vxx_toil _CNV_A_R_LINEAR_____54_CM 16 -40. 200. FORMAT "%5.1" AXIS_PTS_REF Ctb_toil /end AXIS_DESCR
/end CHARACTERISTIC
/begin CHARACTERISTIC Ctp_ovn_tq_cor_ena "Choose to enable soft engine speed limitation for each engaged gearbox ratio" CURVE 0xa0021dc8 _REC_A1CUR_20_u1_u1 1. _CNV_S_2_RANGE______3_CM 0. 1.
 /begin AXIS_DESCR COM_AXIS Vxx_gear _CNV_A_R_LINEAR_____113_CM 8 -1. 6. READ_ONLY FORMAT "%2.0" AXIS_PTS_REF Ntb_gear /end AXIS_DESCR
/end CHARACTERISTIC
/begin CHARACTERISTIC Ctp_sta_tco_dly "Time value depending on starting coolant temperature" CURVE 0xa0021dd0 _REC_A1CUR_20_u1_u2 25.5 _CNV_A_R_LINEAR_____4_CM 0. 25.5 FORMAT "%4.1"
 /begin AXIS_DESCR COM_AXIS Vxx_tco _CNV_A_R_LINEAR_____54_CM 8 -40. 200. FORMAT "%5.1" AXIS_PTS_REF Ctb_sta_tco /end AXIS_DESCR
/end CHARACTERISTIC
/begin MEASUREMENT Vbx_gear_cge_max_n "gear change indicator light flag" UBYTE _CNV_S_2_RANGE______3_CM 1 0. 0. 1. ECU_ADDRESS 0xd0004b29 BIT_MASK 0x1 /end MEASUREMENT
/begin MEASUREMENT Vbx_max_n_fl_tkof_act "Specific limitation during the take off (idiot start)" UBYTE _CNV_S_2_RANGE______3_CM 1 0. 0. 1. ECU_ADDRESS 0xd0004b2a BIT_MASK 0x1 /end MEASUREMENT
/begin MEASUREMENT Vbx_max_n_fl_tkof_cdn "Condition for the specific limitation during the take off" UBYTE _CNV_S_2_RANGE______3_CM 1 0. 0. 1. ECU_ADDRESS 0xd0004b2b BIT_MASK 0x1 /end MEASUREMENT
/begin MEASUREMENT Vbx_ovn_sta_ena "specific limitation during startup" UBYTE _CNV_S_2_RANGE______3_CM 1 0. 0. 1. ECU_ADDRESS 0xd0004b2c BIT_MASK 0x1 /end MEASUREMENT
/begin MEASUREMENT Vbx_ovn_tq_cor_ena "Enable soft engine speed limitation" UBYTE _CNV_S_2_RANGE______3_CM 1 0. 0. 1. ECU_ADDRESS 0xd0004b2d BIT_MASK 0x1 /end MEASUREMENT
/begin MEASUREMENT Vxx_max_n_inj "Maximum engine speed for fuel management" UWORD _CNV_A_R_ENSD_LINEA_24_CM 1 0. 0. 16383.75 ECU_ADDRESS 0xd0003862 FORMAT "%8.2" /end MEASUREMENT
/begin MEASUREMENT Vxx_max_n_nom "Maximum nominal engine speed" UWORD _CNV_A_R_ENSD_LINEA_24_CM 1 0. 0. 16383.75 ECU_ADDRESS 0xd0003864 FORMAT "%8.2" /end MEASUREMENT
/begin MEASUREMENT Vxx_max_n_ovn "Maximum engine speed for overspeed function" UWORD _CNV_A_R_ENSD_LINEA_24_CM 1 0. 0. 16383.75 ECU_ADDRESS 0xd0003866 FORMAT "%8.2" /end MEASUREMENT
/begin CHARACTERISTIC Cbx_max_n_fl_tkof_ant_coup_dsb "Disable the specific limitation during the take off on the condition open coupler" VALUE 0xa0021de8 _REC_S1VAL_20_u1 1. _CNV_S_2_RANGE______3_CM 0. 1. /end CHARACTERISTIC
/begin CHARACTERISTIC Cbx_max_n_fl_tkof_ena "Boolean to activate the take off limitation" VALUE 0xa0021de9 _REC_S1VAL_20_u1 1. _CNV_S_2_RANGE______3_CM 0. 1. /end CHARACTERISTIC
/begin CHARACTERISTIC Cbx_max_n_fl_tkof_ovn_tq_ena "Boolean to enable the torque engine speed limitation for take off limitation" VALUE 0xa0021dea _REC_S1VAL_20_u1 1. _CNV_S_2_RANGE______3_CM 0. 1. /end CHARACTERISTIC
/begin CHARACTERISTIC Cxx_max_n_dec_slop "Negatif slope for the engine speed limitation" VALUE 0xa0021dd8 _REC_S1VAL_20_u2 65535. _CNV_A_R_LINEAR_____330_CM -65535. 0. FORMAT "%4.0" /end CHARACTERISTIC
/begin CHARACTERISTIC Cxx_max_n_fl_tkof "Engine speed limitation during the take off (idiot start)" VALUE 0xa0021dda _REC_S1VAL_20_u2 16383.75 _CNV_A_R_ENSD_LINEA_24_CM 0. 16383.75 FORMAT "%8.2" /end CHARACTERISTIC
/begin CHARACTERISTIC Cxx_max_n_fl_tkof_ext_ctrl_dly "Delay to consolidate the external controls" VALUE 0xa0021deb _REC_S1VAL_20_u1 2.55 _CNV_A_R_LINEAR_____34_CM 0. 2.55 FORMAT "%4.2" /end CHARACTERISTIC
/begin CHARACTERISTIC Cxx_max_n_fl_tkof_vs_thd "Vehicle speed threshold to activate the take off engine speed limitation (idiot start)" VALUE 0xa0021ddc _REC_S1VAL_20_u2 655.35 _CNV_A_R_LINEAR_____70_CM 0. 655.35 FORMAT "%6.2" /end CHARACTERISTIC
/begin CHARACTERISTIC Cxx_max_n_gear_dft "Maximum engine speed for gearbox default" VALUE 0xa0021dde _REC_S1VAL_20_u2 16383.75 _CNV_A_R_ENSD_LINEA_24_CM 0. 16383.75 FORMAT "%8.2" /end CHARACTERISTIC
/begin CHARACTERISTIC Cxx_max_n_inc_slop "Positive slope for the engine speed limitation" VALUE 0xa0021de0 _REC_S1VAL_20_u2 65535. _CNV_A_R_LINEAR_____23_CM 0. 65535. FORMAT "%4.0" /end CHARACTERISTIC
/begin CHARACTERISTIC Cxx_max_n_ovn_ofs "Engine speed offset on maximum engine speed" VALUE 0xa0021de2 _REC_S1VAL_20_s2 16383.75 _CNV_A_R_ENSD_LINEA_24_CM -8192. 8191.75 FORMAT "%8.2" /end CHARACTERISTIC
/begin CHARACTERISTIC Cxx_max_n_tco_toil_dft "maximum engine speed depending on coolant temperature (default value)" VALUE 0xa0021de4 _REC_S1VAL_20_u2 16383.75 _CNV_A_R_ENSD_LINEA_24_CM 0. 16383.75 FORMAT "%8.2" /end CHARACTERISTIC
/begin CHARACTERISTIC Cxx_max_n_thd_oil_ovn "Maximum engine speed in start operation" VALUE 0xa0021de6 _REC_S1VAL_20_u2 16383.75 _CNV_A_R_ENSD_LINEA_24_CM 0. 16383.75 FORMAT "%8.2" /end CHARACTERISTIC
/begin CHARACTERISTIC Cxx_sta_tco_dly_dft "time value depending on starting coolant temperature (default value)" VALUE 0xa0021dec _REC_S1VAL_20_u1 25.5 _CNV_A_R_LINEAR_____4_CM 0. 25.5 FORMAT "%4.1" /end CHARACTERISTIC
/begin CHARACTERISTIC Ctp_max_rams_n_dec "Engine speed decreasing for the safety engine speed  limitation function of the gear ratio" CURVE 0xa0023a7c _REC_A1CUR_20_u2_u1 16383.75 _CNV_A_R_ENSD_LINEA_24_CM 0. 16383.75 FORMAT "%8.2"
 /begin AXIS_DESCR COM_AXIS Vxx_gear _CNV_A_R_LINEAR_____113_CM 8 -1. 6. READ_ONLY FORMAT "%2.0" AXIS_PTS_REF Ntb_gear /end AXIS_DESCR
/end CHARACTERISTIC
/begin MEASUREMENT Vbx_n_rams_lim_act "Activation of safety engine speed limitation" UBYTE _CNV_S_2_RANGE______3_CM 1 0. 0. 1. ECU_ADDRESS 0xd000470b BIT_MASK 0x1 /end MEASUREMENT
/begin MEASUREMENT Vsx_n_rams_lim_vld "Safety engine speed limitation validity status" UBYTE _CNV_A_R_ECME_LINEA_0_CM 1 0. 0. 1. ECU_ADDRESS 0xd000470c FORMAT "%1.0" /end MEASUREMENT
/begin MEASUREMENT Vxx_max_rams_n "Maximum engine speed allowed by the safety" UWORD _CNV_A_R_ENSD_LINEA_24_CM 1 0. 0. 16383.75 ECU_ADDRESS 0xd0003892 FORMAT "%8.2" /end MEASUREMENT
/begin CHARACTERISTIC Cxx_max_rams_n_1 "Failsafe maximum engine speed level 1" VALUE 0xa0021884 _REC_S1VAL_20_u2 16383.75 _CNV_A_R_ENSD_LINEA_24_CM 0. 16383.75 FORMAT "%8.2" /end CHARACTERISTIC
/begin CHARACTERISTIC Cxx_max_rams_n_2 "Failsafe maximum engine speed level 2" VALUE 0xa0021886 _REC_S1VAL_20_u2 16383.75 _CNV_A_R_ENSD_LINEA_24_CM 0. 16383.75 FORMAT "%8.2" /end CHARACTERISTIC
/begin MEASUREMENT Vbx_n_rams_lim_act_1 "Activation of safety engine speed limitation level 1" UBYTE _CNV_S_2_RANGE______3_CM 1 0. 0. 1. ECU_ADDRESS 0xd0004884 BIT_MASK 0x1 /end MEASUREMENT
/begin MEASUREMENT Vbx_n_rams_lim_act_2 "Activation of safety engine speed limitation level 2" UBYTE _CNV_S_2_RANGE______3_CM 1 0. 0. 1. ECU_ADDRESS 0xd0004885 BIT_MASK 0x1 /end MEASUREMENT
/begin MEASUREMENT Vbx_ovn_tq_cor_dft_dsb "Soft engine speed limitation disabled due to an engine default (e.g. limp-home)" UBYTE _CNV_S_2_RANGE______3_CM 1 0. 0. 1. ECU_ADDRESS 0xd0004886 BIT_MASK 0x1 /end MEASUREMENT
/begin CHARACTERISTIC Cxx_n_lim_crk_cfm "Activation of engine speed limitation by crankshaft back-up mode (0: no limitation, 1: limitation level 1, 2: limitation level 2)" VALUE 0xa0021a59 _REC_S1VAL_20_u1 2. _CNV_A_R_ECME_LINEA_0_CM 0. 2. FORMAT "%1.0" /end CHARACTERISTIC
/begin AXIS_PTS Ctb_ac_acel_is "Breakpoint table for engine idle speed need for AC" 0xa0028edc Vxx_tair_ext _REC_A2AXS_20_u2 240. _CNV_A_R_LINEAR_____54_CM 9 -40. 200. FORMAT "%5.1" /end AXIS_PTS
/begin CHARACTERISTIC Ctp_ac_acel_is_swi_off "Breakpoint for switch off the idle speed for AC" CURVE 0xa0028ef0 _REC_A1CUR_20_u2_u2 6553.5 _CNV_A_R_LINEAR_____306_CM 0. 6553.5 FORMAT "%6.1"
 /begin AXIS_DESCR COM_AXIS Vxx_tair_ext _CNV_A_R_LINEAR_____54_CM 9 -40. 200. FORMAT "%5.1" AXIS_PTS_REF Ctb_ac_acel_is /end AXIS_DESCR
/end CHARACTERISTIC
/begin CHARACTERISTIC Ctp_ac_acel_is_swi_on "Breakpoint for switch on the idle speed for AC" CURVE 0xa0028f04 _REC_A1CUR_20_u2_u2 6553.5 _CNV_A_R_LINEAR_____306_CM 0. 6553.5 FORMAT "%6.1"
 /begin AXIS_DESCR COM_AXIS Vxx_tair_ext _CNV_A_R_LINEAR_____54_CM 9 -40. 200. FORMAT "%5.1" AXIS_PTS_REF Ctb_ac_acel_is /end AXIS_DESCR
/end CHARACTERISTIC
/begin CHARACTERISTIC Ctp_ac_acel_is_val_off "Breakpoint for engine idle speed off value for AC" CURVE 0xa0028f18 _REC_A1CUR_20_u2_u2 16383.75 _CNV_A_R_ENSD_LINEA_24_CM 0. 16383.75 FORMAT "%8.2"
 /begin AXIS_DESCR COM_AXIS Vxx_tair_ext _CNV_A_R_LINEAR_____54_CM 9 -40. 200. FORMAT "%5.1" AXIS_PTS_REF Ctb_ac_acel_is /end AXIS_DESCR
/end CHARACTERISTIC
/begin CHARACTERISTIC Ctp_ac_acel_is_val_on "Breakpoint for engine idle speed on value for AC" CURVE 0xa0028f2c _REC_A1CUR_20_u2_u2 16383.75 _CNV_A_R_ENSD_LINEA_24_CM 0. 16383.75 FORMAT "%8.2"
 /begin AXIS_DESCR COM_AXIS Vxx_tair_ext _CNV_A_R_LINEAR_____54_CM 9 -40. 200. FORMAT "%5.1" AXIS_PTS_REF Ctb_ac_acel_is /end AXIS_DESCR
/end CHARACTERISTIC
/begin MEASUREMENT Vsx_mdl_ac_acel_is_sp_vld "Accelerated engine idle speed setpoint request for air conditionning from model validity status" UBYTE _CNV_S_3_STATUS_OK__348_CM 1 0. 0. 2. ECU_ADDRESS 0xd00051be /end MEASUREMENT
/begin MEASUREMENT Vxx_mdl_ac_acel_is_sp "Accelerated engine idle speed setpoint request for air conditionning from model" UWORD _CNV_A_R_ENSD_LINEA_24_CM 1 0. 0. 16383.75 ECU_ADDRESS 0xd0005818 FORMAT "%8.2" /end MEASUREMENT
/begin CHARACTERISTIC Cxx_ac_req_off_ac_acel_is_sp "Default value of engine idle speed setpoint for AC when calculation is disabled" VALUE 0xa0021a4a _REC_S1VAL_20_u2 16383.75 _CNV_A_R_ENSD_LINEA_24_CM 0. 16383.75 FORMAT "%8.2" /end CHARACTERISTIC
/begin MEASUREMENT Vbx_agb_is_acel_req "Idle speed setpoint acceleration by AT is requested" UBYTE _CNV_S_2_RANGE______3_CM 1 0. 0. 1. ECU_ADDRESS 0xd00050af BIT_MASK 0x1 /end MEASUREMENT
/begin MEASUREMENT Vsx_agb_is_acel_req_vld "Idle speed setpoint acceleration by AT is requested validity status" UBYTE _CNV_S_3_STATUS_OK__158_CM 1 0. 0. 2. ECU_ADDRESS 0xd00050b0 /end MEASUREMENT
/begin MEASUREMENT Vbx_ptc_is_acel_req "PTC engine idle speed increase request from CAN" UBYTE _CNV_S_2_RANGE______3_CM 1 0. 0. 1. ECU_ADDRESS 0xd0005215 BIT_MASK 0x1 /end MEASUREMENT
/begin MEASUREMENT Vsx_agb_is_acel_sp_vld "Automatic Transmission idle speed setpoint acceleration required validity status" UBYTE _CNV_S_3_STATUS_OK__158_CM 1 0. 0. 2. ECU_ADDRESS 0xd0005214 /end MEASUREMENT
/begin MEASUREMENT Vxx_agb_is_acel_sp "Automatic Transmission idle speed setpoint acceleration required" UWORD _CNV_A_R_ENSD_LINEA_24_CM 1 0. 0. 16383.75 ECU_ADDRESS 0xc0000b92 FORMAT "%8.2" /end MEASUREMENT
/begin MEASUREMENT Vxx_ac_acel_is_sp "Accelerated engine idle speed setpoint request for air conditionning" UWORD _CNV_A_R_ENSD_LINEA_24_CM 1 0. 0. 16383.75 ECU_ADDRESS 0xc0000b94 FORMAT "%8.2" /end MEASUREMENT
/begin MEASUREMENT Vbx_el_bk_wind "Electric backlite  idle speed setpoint acceleration request" UBYTE _CNV_S_2_RANGE______3_CM 1 0. 0. 1. ECU_ADDRESS 0xd0005387 BIT_MASK 0x1 /end MEASUREMENT
/begin MEASUREMENT Vbx_el_wind_is_acel "Electric windshield  idle speed setpoint acceleration request" UBYTE _CNV_S_2_RANGE______3_CM 1 0. 0. 1. ECU_ADDRESS 0xd0005388 BIT_MASK 0x1 /end MEASUREMENT
/begin MEASUREMENT Vbx_acs_acel_is_req "Accelerated idle speed request for commercial vehicle accessories" UBYTE _CNV_S_2_RANGE______3_CM 1 0. 0. 1. ECU_ADDRESS 0xd0005054 BIT_MASK 0x1 /end MEASUREMENT
/begin MEASUREMENT Vxx_tair_ext "Environmental temperature" UWORD _CNV_A_R_LINEAR_____54_CM 1 0. -40. 200. ECU_ADDRESS 0xd0002f1c FORMAT "%5.1" /end MEASUREMENT
/begin MEASUREMENT Vbx_df_in_vvtc_sldv_oc "VVTC control solenoÔd valve open circuit detected failure" UBYTE _CNV_S_2_RANGE______3_CM 1 0. 0. 1. ECU_ADDRESS 0xd0004247 BIT_MASK 0x1 /end MEASUREMENT
/begin MEASUREMENT Vbx_df_in_vvtc_sldv_scg "VVTC control solenoÔd valve short circuit to ground detected failure" UBYTE _CNV_S_2_RANGE______3_CM 1 0. 0. 1. ECU_ADDRESS 0xd0004248 BIT_MASK 0x1 /end MEASUREMENT
/begin MEASUREMENT Vbx_df_in_vvtc_sldv_scw "VVTC control solenoÔd valve short circuit to battery detected failure" UBYTE _CNV_S_2_RANGE______3_CM 1 0. 0. 1. ECU_ADDRESS 0xd0004249 BIT_MASK 0x1 /end MEASUREMENT
/begin MEASUREMENT Vbx_diag_ena_in_vvtc_sldv_oc "VVTC control solenoÔd valve open circuit diagnostic information available" UBYTE _CNV_S_2_RANGE______3_CM 1 0. 0. 1. ECU_ADDRESS 0xd000424a BIT_MASK 0x1 /end MEASUREMENT
/begin MEASUREMENT Vbx_diag_ena_in_vvtc_sldv_scg "VVTC control solenoÔd valve short circuit to ground diagnosis information available" UBYTE _CNV_S_2_RANGE______3_CM 1 0. 0. 1. ECU_ADDRESS 0xd000424b BIT_MASK 0x1 /end MEASUREMENT
/begin MEASUREMENT Vbx_diag_ena_in_vvtc_sldv_scw "VVTC control solenoÔd valve short circuit to battery diagnostic information available" UBYTE _CNV_S_2_RANGE______3_CM 1 0. 0. 1. ECU_ADDRESS 0xd000424c BIT_MASK 0x1 /end MEASUREMENT
/begin MEASUREMENT cdn_diag_slv_ivvt_ex[0] "" UBYTE _CNV_A_R_ECME_LINEA_0_CM 1 0. 0. 7. ECU_ADDRESS 0xd0004244 FORMAT "%1.0" /end MEASUREMENT
/begin MEASUREMENT cdn_diag_slv_ivvt_in[0] "" UBYTE _CNV_A_R_ECME_LINEA_0_CM 1 0. 0. 7. ECU_ADDRESS 0xd0004243 FORMAT "%1.0" /end MEASUREMENT
/begin MEASUREMENT ctr_pulse_ivvt_dly "Time counter for pulse at key ON" UBYTE _CNV_A_R_LINEAR_____144_CM 1 0. 0. 255. ECU_ADDRESS 0xd0005611 FORMAT "%3.0" /end MEASUREMENT
/begin MEASUREMENT err_diag_slv_ivvt_ex[0] "" UBYTE _CNV_S_16_RANGE_ERR__151_CM 1 0. 0. 15. ECU_ADDRESS 0xd0004246 /end MEASUREMENT
/begin MEASUREMENT err_diag_slv_ivvt_in[0] "" UBYTE _CNV_S_16_RANGE_ERR__151_CM 1 0. 0. 15. ECU_ADDRESS 0xd0004245 /end MEASUREMENT
/begin MEASUREMENT frq_ivvthpwm "Frequency of holding pulse with modulation; both inlet and exhaust" UWORD _CNV_A_R_LINEAR_____231_CM 1 0. 50. 500. ECU_ADDRESS 0xd0003548 FORMAT "%3.0" /end MEASUREMENT
/begin MEASUREMENT lv_cam_sp_ref_ad_di_ivvt "1= reference position adaptation if setpoint in ref pos disabled, 0=not disabled" UBYTE _CNV_S_2_RANGE______3_CM 1 0. 0. 1. ECU_ADDRESS 0xd000424e BIT_MASK 0x1 /end MEASUREMENT
/begin MEASUREMENT lv_di_ad_ref_cam_ivvt_in "Adaptation of inlet camshaft reference position : 0=enabled, 1=disabled" UBYTE _CNV_S_2_RANGE______3_CM 1 0. 0. 1. ECU_ADDRESS 0xd000424f BIT_MASK 0x1 /end MEASUREMENT
/begin MEASUREMENT lv_pulse_ivvt "Flag to indicate that pulse at key on was done" UBYTE _CNV_S_2_RANGE______3_CM 1 0. 0. 1. ECU_ADDRESS 0xd000424d BIT_MASK 0x1 /end MEASUREMENT
/begin MEASUREMENT lv_pulse_ivvt_tmp "Flag to indicate that pulse is working" UBYTE _CNV_S_2_RANGE______3_CM 1 0. 0. 1. ECU_ADDRESS 0xd0005613 BIT_MASK 0x1 /end MEASUREMENT
/begin MEASUREMENT vvtpwm "Flag to request an engine phasing update" UWORD _CNV_A_R_LINEAR_____94_CM 1 0. 0. 200. ECU_ADDRESS 0xd0003546 FORMAT "%4.2" /end MEASUREMENT
/begin CHARACTERISTIC c_ctr_pulse_ivvt_dly "Time value for pulse at key ON" VALUE 0xa00211ce _REC_S1VAL_20_u1 255. _CNV_A_R_LINEAR_____144_CM 0. 255. FORMAT "%3.0" /end CHARACTERISTIC
/begin CHARACTERISTIC c_frq_ivvthpwm "Frequency of holding pulse with modulation; both inlet and exhaust" VALUE 0xa0021162 _REC_S1VAL_20_u2 450. _CNV_A_R_LINEAR_____231_CM 50. 500. FORMAT "%3.0" /end CHARACTERISTIC
/begin CHARACTERISTIC c_maf_hb_max_ad_ref_di_ivvt "Maximum allowed engine load for IVVT reference position adaptation" VALUE 0xa00211d2 _REC_S1VAL_20_u1 1389. _CNV_A_R_LINEAR_____281_CM 0. 1389. FORMAT "%4.0" /end CHARACTERISTIC
/begin CHARACTERISTIC c_n_32_max_ad_ref_di_ivvt "Maximum required engine speed for IVVT reference position adaptation" VALUE 0xa00211d3 _REC_S1VAL_20_u1 8160. _CNV_A_R_LINEAR_____2_CM 0. 8160. FORMAT "%4.0" /end CHARACTERISTIC
/begin CHARACTERISTIC c_n_32_min_ad_ref_di_ivvt "Minimum required engine speed for IVVT reference position adaptation" VALUE 0xa00211d4 _REC_S1VAL_20_u1 8160. _CNV_A_R_LINEAR_____2_CM 0. 8160. FORMAT "%4.0" /end CHARACTERISTIC
/begin CHARACTERISTIC c_toil_max_ad_ref_di_ivvt "Maximum allowed oil temperature for IVVT reference position adaptation" VALUE 0xa00211db _REC_S1VAL_20_u1 200. _CNV_A_R_LINEAR_____220_CM -40. 160. FORMAT "%3.0" /end CHARACTERISTIC
/begin CHARACTERISTIC c_toil_min_ad_ref_di_ivvt "Minimum required oil temperature for IVVT reference position adaptation" VALUE 0xa00211dc _REC_S1VAL_20_u1 200. _CNV_A_R_LINEAR_____220_CM -40. 160. FORMAT "%3.0" /end CHARACTERISTIC
/begin CHARACTERISTIC c_vvtpwm_diag_max_scg "Maximum threshold for SCG diagnosis window" VALUE 0xa0021196 _REC_S1VAL_20_u2 100. _CNV_A_R_LINEAR_____94_CM 0. 100. FORMAT "%6.2" /end CHARACTERISTIC
/begin CHARACTERISTIC c_vvtpwm_diag_min_oc "Minimum threshold for OC diagnosis window" VALUE 0xa0021198 _REC_S1VAL_20_u2 100. _CNV_A_R_LINEAR_____94_CM 0. 100. FORMAT "%6.2" /end CHARACTERISTIC
/begin CHARACTERISTIC c_vvtpwm_diag_min_scp "Minimum threshold for SCP diagnosis window" VALUE 0xa002119a _REC_S1VAL_20_u2 100. _CNV_A_R_LINEAR_____94_CM 0. 100. FORMAT "%6.2" /end CHARACTERISTIC
/begin MEASUREMENT Vbx_df_in_vvtc_blk "VVTC defaut position blocking detected failure" UBYTE _CNV_S_2_RANGE______3_CM 1 0. 0. 1. ECU_ADDRESS 0xd0004336 BIT_MASK 0x1 /end MEASUREMENT
/begin MEASUREMENT Vbx_df_in_vvtc_dirt_lkg "VVTC lost of controllability detected failure" UBYTE _CNV_S_2_RANGE______3_CM 1 0. 0. 1. ECU_ADDRESS 0xd0004337 BIT_MASK 0x1 /end MEASUREMENT
/begin MEASUREMENT Vbx_diag_ena_in_vvtc_ad "VVTC first offset learning diagnostic information available" UBYTE _CNV_S_2_RANGE______3_CM 1 0. 0. 1. ECU_ADDRESS 0xd0004338 BIT_MASK 0x1 /end MEASUREMENT
/begin MEASUREMENT Vbx_diag_ena_in_vvtc_blk "VVTC defaut position blocking diagnostic information available" UBYTE _CNV_S_2_RANGE______3_CM 1 0. 0. 1. ECU_ADDRESS 0xd0004339 BIT_MASK 0x1 /end MEASUREMENT
/begin MEASUREMENT Vbx_diag_ena_in_vvtc_dirt_lkg "VVTC lost of controllability diagnostic information available" UBYTE _CNV_S_2_RANGE______3_CM 1 0. 0. 1. ECU_ADDRESS 0xd000433a BIT_MASK 0x1 /end MEASUREMENT
/begin MEASUREMENT Vbx_in_vvtc_ctl_sat_det "Detect a saturation of the control in closed loop mode (=> VVTC not able to reach the setpoint)" UBYTE _CNV_S_2_RANGE______3_CM 1 0. 0. 1. ECU_ADDRESS 0xd000433b BIT_MASK 0x1 /end MEASUREMENT
/begin MEASUREMENT Vbx_in_vvtc_ctl_sat_det_risk "Detect a saturation of the control in closed loop mode in the risk zon (=> VVTC not able to reach the setpoint)" UBYTE _CNV_S_2_RANGE______3_CM 1 0. 0. 1. ECU_ADDRESS 0xd000433c BIT_MASK 0x1 /end MEASUREMENT
/begin MEASUREMENT Vbx_in_vvtc_ctl_sat_ini "Indicate that the control in closed loop mode is saturated (start timer decrementation)" UBYTE _CNV_S_2_RANGE______3_CM 1 0. 0. 1. ECU_ADDRESS 0xd000433d BIT_MASK 0x1 /end MEASUREMENT
/begin MEASUREMENT Vbx_in_vvtc_ctl_sat_ini_risk "Indicate that the control in closed loop mode is saturated in the risk zon (start timer decrementation)" UBYTE _CNV_S_2_RANGE______3_CM 1 0. 0. 1. ECU_ADDRESS 0xd000433e BIT_MASK 0x1 /end MEASUREMENT
/begin MEASUREMENT Vbx_in_vvtc_ena_diag "Enable diagnosis of the VVTC system (soleino√Ød valve and phaser)" UBYTE _CNV_S_2_RANGE______3_CM 1 0. 0. 1. ECU_ADDRESS 0xd000433f BIT_MASK 0x1 /end MEASUREMENT
/begin MEASUREMENT Vbx_in_vvtc_fail_det "Detect a failure on the VVTC system (soleno√Ød valve or phaser)" UBYTE _CNV_S_2_RANGE______3_CM 1 0. 0. 1. ECU_ADDRESS 0xd0004340 BIT_MASK 0x1 /end MEASUREMENT
/begin MEASUREMENT Vbx_in_vvtc_inh_risk_zon "Inhibition of the VVTC (limit behavior in risk zone)" UBYTE _CNV_S_2_RANGE______3_CM 1 0. 0. 1. ECU_ADDRESS 0xd0004341 BIT_MASK 0x1 /end MEASUREMENT
/begin MEASUREMENT Vbx_in_vvtc_lim "Indicate a limit behavior of the system (because of a lack of oil pressure)" UBYTE _CNV_S_2_RANGE______3_CM 1 0. 0. 1. ECU_ADDRESS 0xd0004342 BIT_MASK 0x1 /end MEASUREMENT
/begin MEASUREMENT Vbx_in_vvtc_reg_err_det "Detect a permanent position deviation (=> VVTC not able to reach the setpoint)" UBYTE _CNV_S_2_RANGE______3_CM 1 0. 0. 1. ECU_ADDRESS 0xd0004343 BIT_MASK 0x1 /end MEASUREMENT
/begin MEASUREMENT Vbx_in_vvtc_reg_err_det_risk "Detect a permanent position deviation in the risk zon (=> VVTC not able to reach the setpoint)" UBYTE _CNV_S_2_RANGE______3_CM 1 0. 0. 1. ECU_ADDRESS 0xd0004344 BIT_MASK 0x1 /end MEASUREMENT
/begin MEASUREMENT Vbx_in_vvtc_reg_err_ini "Indicate a regulation error (start timer decrementation)" UBYTE _CNV_S_2_RANGE______3_CM 1 0. 0. 1. ECU_ADDRESS 0xd0004345 BIT_MASK 0x1 /end MEASUREMENT
/begin MEASUREMENT Vbx_in_vvtc_trt_psn_det "Indicate the system is in defaut stopper position during the confirmation of a failure" UBYTE _CNV_S_2_RANGE______3_CM 1 0. 0. 1. ECU_ADDRESS 0xd0004346 BIT_MASK 0x1 /end MEASUREMENT
/begin MEASUREMENT Vsx_in_vvtc_vld "Intake VVTC actuator validity status" UBYTE _CNV_S_3_STATUS_OK__120_CM 1 0. 0. 2. ECU_ADDRESS 0xd0004347 /end MEASUREMENT
/begin CHARACTERISTIC Cbx_diag_in_vvtc_ena_diag "Enable functionnal diagnosis duing the activation of the VVTC aftersales routine" VALUE 0xa0021776 _REC_S1VAL_20_u1 1. _CNV_A_R_ECME_LINEA_0_CM 0. 1. FORMAT "%1.0" BIT_MASK 0x1 /end CHARACTERISTIC
/begin CHARACTERISTIC Cbx_in_vvtc_cho_ad_fail_mod "Select reversible/non reversible failure mode on a confirmed failure on camshaft wheel learning " VALUE 0xa0021777 _REC_S1VAL_20_u1 1. _CNV_A_R_ECME_LINEA_0_CM 0. 1. FORMAT "%1.0" BIT_MASK 0x1 /end CHARACTERISTIC
/begin CHARACTERISTIC Cbx_in_vvtc_cho_blk_fail_mod "Select reversible/non reversible failure mode on a confirmed  bloking of VVTC system" VALUE 0xa0021778 _REC_S1VAL_20_u1 1. _CNV_A_R_ECME_LINEA_0_CM 0. 1. FORMAT "%1.0" BIT_MASK 0x1 /end CHARACTERISTIC
/begin CHARACTERISTIC Cbx_in_vvtc_ena_inh_risk_zon "Enable the inhibtion of the VVTC if a failure is detected in the risk zon" VALUE 0xa0021779 _REC_S1VAL_20_u1 1. _CNV_A_R_ECME_LINEA_0_CM 0. 1. FORMAT "%1.0" BIT_MASK 0x1 /end CHARACTERISTIC
/begin CHARACTERISTIC Cbx_in_vvtc_temp_cho_ena_diag "Select coolant or oil temperature to determine activation condition of the diagnosis at cold system operating" VALUE 0xa002177a _REC_S1VAL_20_u1 1. _CNV_A_R_ECME_LINEA_0_CM 0. 1. FORMAT "%1.0" BIT_MASK 0x1 /end CHARACTERISTIC
/begin CHARACTERISTIC Cxx_dfdec_in_vvtc_ad "VVTC first offset learning detected failure counter decrement" VALUE 0xa0021740 _REC_S1VAL_20_u2 65535. _CNV_A_R_ECME_LINEA_0_CM 0. 65535. FORMAT "%5.0" /end CHARACTERISTIC
/begin CHARACTERISTIC Cxx_dfdec_in_vvtc_blk "VVTC defaut position blocking detected failure counter decrement" VALUE 0xa0021742 _REC_S1VAL_20_u2 65535. _CNV_A_R_ECME_LINEA_0_CM 0. 65535. FORMAT "%5.0" /end CHARACTERISTIC
/begin CHARACTERISTIC Cxx_dfdec_in_vvtc_dirt_lkg "VVTC lost of controllability detected failure counter decrement" VALUE 0xa0021744 _REC_S1VAL_20_u2 65535. _CNV_A_R_ECME_LINEA_0_CM 0. 65535. FORMAT "%5.0" /end CHARACTERISTIC
/begin CHARACTERISTIC Cxx_dfdec_in_vvtc_sldv_oc "detected failure counter decrement" VALUE 0xa0021746 _REC_S1VAL_20_u2 65535. _CNV_A_R_ECME_LINEA_0_CM 0. 65535. FORMAT "%5.0" /end CHARACTERISTIC
/begin CHARACTERISTIC Cxx_dfdec_in_vvtc_sldv_scg "VVTC control soleno√Ød valve short circuit to ground detected failure counter decrement" VALUE 0xa0021748 _REC_S1VAL_20_u2 65535. _CNV_A_R_ECME_LINEA_0_CM 0. 65535. FORMAT "%5.0" /end CHARACTERISTIC
/begin CHARACTERISTIC Cxx_dfdec_in_vvtc_sldv_scw "VVTC control soleno√Ød valve short circuit to battery detected failure counter decrement" VALUE 0xa002174a _REC_S1VAL_20_u2 65535. _CNV_A_R_ECME_LINEA_0_CM 0. 65535. FORMAT "%5.0" /end CHARACTERISTIC
/begin CHARACTERISTIC Cxx_dfinc_in_vvtc_ad "VVTC first offset learning detected failure counter increment" VALUE 0xa002174c _REC_S1VAL_20_u2 65535. _CNV_A_R_ECME_LINEA_0_CM 0. 65535. FORMAT "%5.0" /end CHARACTERISTIC
/begin CHARACTERISTIC Cxx_dfinc_in_vvtc_blk "VVTC defaut position blocking detected failure counter increment" VALUE 0xa002174e _REC_S1VAL_20_u2 65535. _CNV_A_R_ECME_LINEA_0_CM 0. 65535. FORMAT "%5.0" /end CHARACTERISTIC
/begin CHARACTERISTIC Cxx_dfinc_in_vvtc_dirt_lkg "VVTC lost of controllability detected failure counter increment" VALUE 0xa0021750 _REC_S1VAL_20_u2 65535. _CNV_A_R_ECME_LINEA_0_CM 0. 65535. FORMAT "%5.0" /end CHARACTERISTIC
/begin CHARACTERISTIC Cxx_dfinc_in_vvtc_sldv_oc "VVTC control soleno√Ød valve open circuit detected failure counter increment" VALUE 0xa0021752 _REC_S1VAL_20_u2 65535. _CNV_A_R_ECME_LINEA_0_CM 0. 65535. FORMAT "%5.0" /end CHARACTERISTIC
/begin CHARACTERISTIC Cxx_dfinc_in_vvtc_sldv_scg "VVTC control soleno√Ød valve short circuit to ground detected failure counter increment" VALUE 0xa0021754 _REC_S1VAL_20_u2 65535. _CNV_A_R_ECME_LINEA_0_CM 0. 65535. FORMAT "%5.0" /end CHARACTERISTIC
/begin CHARACTERISTIC Cxx_dfinc_in_vvtc_sldv_scw "VVTC control soleno√Ød valve short circuit to battery detected failure counter increment" VALUE 0xa0021756 _REC_S1VAL_20_u2 65535. _CNV_A_R_ECME_LINEA_0_CM 0. 65535. FORMAT "%5.0" /end CHARACTERISTIC
/begin CHARACTERISTIC Cxx_in_vvtc_ctl_sat_inh_thd "Position theshold to inhib diagnosis near the stoppers" VALUE 0xa0021758 _REC_S1VAL_20_u2 719.98 _CNV_A_R_LINEAR_____76_CM 0. 719.98 FORMAT "%6.2" /end CHARACTERISTIC
/begin CHARACTERISTIC Cxx_in_vvtc_ctl_sat_max_thd "High threshold on the value of the closed loop control " VALUE 0xa002175a _REC_S1VAL_20_u2 200. _CNV_A_R_LINEAR_____94_CM 0. 200. FORMAT "%6.2" /end CHARACTERISTIC
/begin CHARACTERISTIC Cxx_in_vvtc_ctl_sat_min_thd "Low threshold on the value of the closed loop control " VALUE 0xa002175c _REC_S1VAL_20_u2 200. _CNV_A_R_LINEAR_____94_CM 0. 200. FORMAT "%6.2" /end CHARACTERISTIC
/begin CHARACTERISTIC Cxx_in_vvtc_ctl_sat_t "Delay to confirm a failure on the system (due to a saturation of the contol)" VALUE 0xa002175e _REC_S1VAL_20_u2 655.35 _CNV_A_R_LINEAR_____34_CM 0. 655.35 FORMAT "%6.2" /end CHARACTERISTIC
/begin CHARACTERISTIC Cxx_in_vvtc_ctl_sat_t_risk_zon "Delay to confirm a failure on the system in the risk zon (due to a saturation of the contol)" VALUE 0xa0021760 _REC_S1VAL_20_u2 655.35 _CNV_A_R_LINEAR_____34_CM 0. 655.35 FORMAT "%6.2" /end CHARACTERISTIC
/begin CHARACTERISTIC Cxx_in_vvtc_n_min_ena_diag "Minimum engine speed to enable diagnosis of the system (soleno√Ød valve and phaser componensts)" VALUE 0xa0021762 _REC_S1VAL_20_u2 16383.75 _CNV_A_R_ENSD_LINEA_24_CM 0. 16383.75 FORMAT "%8.2" /end CHARACTERISTIC
/begin CHARACTERISTIC Cxx_in_vvtc_reg_err_t "Delay to detect confirm permanent error" VALUE 0xa0021764 _REC_S1VAL_20_u2 655.35 _CNV_A_R_LINEAR_____34_CM 0. 655.35 FORMAT "%6.2" /end CHARACTERISTIC
/begin CHARACTERISTIC Cxx_in_vvtc_reg_err_t_risk_zon "Delay to detect confirm permanent error in the risk zon" VALUE 0xa0021766 _REC_S1VAL_20_u2 655.35 _CNV_A_R_LINEAR_____34_CM 0. 655.35 FORMAT "%6.2" /end CHARACTERISTIC
/begin CHARACTERISTIC Cxx_in_vvtc_reg_err_thd "Theshold to consider a regulation error" VALUE 0xa0021768 _REC_S1VAL_20_u2 719.98 _CNV_A_R_LINEAR_____76_CM 0. 719.98 FORMAT "%6.2" /end CHARACTERISTIC
/begin CHARACTERISTIC Cxx_in_vvtc_reg_err_thd_risk "Theshold to consider a regulation error in the risk zon" VALUE 0xa002176a _REC_S1VAL_20_u2 719.98 _CNV_A_R_LINEAR_____76_CM 0. 719.98 FORMAT "%6.2" /end CHARACTERISTIC
/begin CHARACTERISTIC Cxx_in_vvtc_temp_min_ena_diag "Minimum engine coolant temperature to enable diagnosis of the system (soleno√Ød valve and phaser components)" VALUE 0xa002176c _REC_S1VAL_20_u2 240. _CNV_A_R_LINEAR_____54_CM -40. 200. FORMAT "%5.1" /end CHARACTERISTIC
/begin CHARACTERISTIC Cxx_in_vvtc_trt_blk_dlt_t "Delay to reset the variable Vbx_df_in_vvtc_blk if the failure disappears" VALUE 0xa002176e _REC_S1VAL_20_u2 655.35 _CNV_A_R_LINEAR_____34_CM 0. 655.35 FORMAT "%6.2" /end CHARACTERISTIC
/begin CHARACTERISTIC Cxx_in_vvtc_trt_oor_t "Delay to consider a movement out of the defaut stopper" VALUE 0xa0021770 _REC_S1VAL_20_u2 655.35 _CNV_A_R_LINEAR_____34_CM 0. 655.35 FORMAT "%6.2" /end CHARACTERISTIC
/begin CHARACTERISTIC Cxx_in_vvtc_trt_psn_thd "Theshold to consider the system in the defaut stopper position" VALUE 0xa0021772 _REC_S1VAL_20_u2 719.98 _CNV_A_R_LINEAR_____76_CM 0. 719.98 FORMAT "%6.2" /end CHARACTERISTIC
/begin CHARACTERISTIC Cxx_in_vvtc_v_min_ena_diag "Minimum battery voltage to enable diagnosis of the system (soleno√Ød valve and phaser components)" VALUE 0xa0021774 _REC_S1VAL_20_u2 60. _CNV_A_R_LINEAR_____150_CM 0. 60. FORMAT "%5.2" /end CHARACTERISTIC
/begin AXIS_PTS Ctb_in_vvtc_lck_cyc_t "Table of PWM breakpoints for each phase of the unlocking strategy mode" 0xa0020a60 Vxx_in_vvtc_lck_cyc_t _REC_A2AXS_20_u2 65.535 _CNV_A_R_LINEAR_____58_CM 3 0. 65.535 /end AXIS_PTS
/begin AXIS_PTS Ctb_in_vvtc_n_bkpt "Table of engine engine speed breakpoints used with the cartography Ctp_in_vvtc_awg" 0xa0024f70 Vxx_n _REC_A2AXS_20_u2 16383.75 _CNV_A_R_ENSD_LINEA_24_CM 12 0. 16383.75 FORMAT "%8.2" /end AXIS_PTS
/begin CHARACTERISTIC Ctp_in_vvtc_awg "Cartography with gains for anti-windup action (to avoid saturation of the integral term)" CURVE 0xa0024f8c _REC_A1CUR_20_u2_u2 200. _CNV_A_R_LINEAR_____349_CM 0. 200. FORMAT "%10.6"
 /begin AXIS_DESCR COM_AXIS Vxx_n _CNV_A_R_ENSD_LINEA_24_CM 12 0. 16383.75 FORMAT "%8.2" AXIS_PTS_REF Ctb_in_vvtc_n_bkpt /end AXIS_DESCR
/end CHARACTERISTIC
/begin CHARACTERISTIC Ctp_in_vvtc_awg_max_thd "Cartography of high thresholds on the PWM control" CURVE 0xa0024fa4 _REC_A1CUR_20_u2_u2 255.99609375 _CNV_A_R_LINEAR_____350_CM 0. 255.99609375 FORMAT "%6.2"
 /begin AXIS_DESCR COM_AXIS Vxx_n _CNV_A_R_ENSD_LINEA_24_CM 12 0. 16383.75 FORMAT "%8.2" AXIS_PTS_REF Ctb_in_vvtc_n_bkpt /end AXIS_DESCR
/end CHARACTERISTIC
/begin CHARACTERISTIC Ctp_in_vvtc_awg_min_thd "Cartography of low thresholds on the PWM control" CURVE 0xa0024fbc _REC_A1CUR_20_u2_u2 255.99609375 _CNV_A_R_LINEAR_____350_CM 0. 255.99609375 FORMAT "%6.2"
 /begin AXIS_DESCR COM_AXIS Vxx_n _CNV_A_R_ENSD_LINEA_24_CM 12 0. 16383.75 FORMAT "%8.2" AXIS_PTS_REF Ctb_in_vvtc_n_bkpt /end AXIS_DESCR
/end CHARACTERISTIC
/begin CHARACTERISTIC Ctp_in_vvtc_lck_pwm_thd "Cartography with PWM cycles peaks (RCO1 and RCO2) of the unlocking strategy mode" CURVE 0xa0020a68 _REC_A1CUR_20_u2_u2 200. _CNV_A_R_LINEAR_____94_CM 0. 200. FORMAT "%6.2"
 /begin AXIS_DESCR COM_AXIS Vxx_in_vvtc_lck_cyc_t _CNV_A_R_LINEAR_____58_CM 3 0. 65.535 AXIS_PTS_REF Ctb_in_vvtc_lck_cyc_t /end AXIS_DESCR
/end CHARACTERISTIC
/begin CHARACTERISTIC Ctp_in_vvtc_pg "Cartography with the propotionnal gains of the controller" CURVE 0xa0024fd4 _REC_A1CUR_20_u2_u2 200. _CNV_A_R_LINEAR_____351_CM 0. 200. FORMAT "%6.2"
 /begin AXIS_DESCR COM_AXIS Vxx_n _CNV_A_R_ENSD_LINEA_24_CM 12 0. 16383.75 FORMAT "%8.2" AXIS_PTS_REF Ctb_in_vvtc_n_bkpt /end AXIS_DESCR
/end CHARACTERISTIC
/begin MEASUREMENT Vbx_in_vvtc_ad_end "All learning finished (camshaft wheel and intergral term)" UBYTE _CNV_S_2_RANGE______3_CM 1 0. 0. 1. ECU_ADDRESS 0xd0004ee1 BIT_MASK 0x1 /end MEASUREMENT
/begin MEASUREMENT Vbx_in_vvtc_ad_int_val "Learning of integral term finished" UBYTE _CNV_S_2_RANGE______3_CM 1 0. 0. 1. ECU_ADDRESS 0xd0004ee2 BIT_MASK 0x1 /end MEASUREMENT
/begin MEASUREMENT Vbx_in_vvtc_cl_ctl "VVTC system in closed loop control mode" UBYTE _CNV_S_2_RANGE______3_CM 1 0. 0. 1. ECU_ADDRESS 0xd0004ee3 BIT_MASK 0x1 /end MEASUREMENT
/begin MEASUREMENT Vbx_in_vvtc_cl_out_l_trt "VVTC system in closed loop control mode out of the low thrust" UBYTE _CNV_S_2_RANGE______3_CM 1 0. 0. 1. ECU_ADDRESS 0xd0004ee4 BIT_MASK 0x1 /end MEASUREMENT
/begin MEASUREMENT Vbx_in_vvtc_crk_syn "Indicate crankshaft synchronisation" UBYTE _CNV_S_2_RANGE______3_CM 1 0. 0. 1. ECU_ADDRESS 0xd0004ee5 BIT_MASK 0x1 /end MEASUREMENT
/begin MEASUREMENT Vbx_in_vvtc_int_val_ini "Initialisation of the integral term (at the beginning of the learning stage)" UBYTE _CNV_S_2_RANGE______3_CM 1 0. 0. 1. ECU_ADDRESS 0xd0004ee6 BIT_MASK 0x1 /end MEASUREMENT
/begin MEASUREMENT Vbx_in_vvtc_lck_act_sta_det "Detection of the start of the VVTC unlocking strategy mode" UBYTE _CNV_S_2_RANGE______3_CM 1 0. 0. 1. ECU_ADDRESS 0xd0004ee7 BIT_MASK 0x1 /end MEASUREMENT
/begin MEASUREMENT Vbx_in_vvtc_lck_cyc_sta_det "Detection of the start of each cycle of the VVTC unlocking strategy mode" UBYTE _CNV_S_2_RANGE______3_CM 1 0. 0. 1. ECU_ADDRESS 0xd0004ee8 BIT_MASK 0x1 /end MEASUREMENT
/begin MEASUREMENT Vxx_in_cam_toth_per_sat "Duration between two intake camshaft events (with Min/Max saturation)" UWORD _CNV_A_R_LINEAR_____145_CM 1 0. 0. 65535. ECU_ADDRESS 0xd0003908 FORMAT "%5.0" /end MEASUREMENT
/begin MEASUREMENT Vxx_in_cam_toth_per_sat_sq "Square value of the variable Vxx_in_cam_toth_per_sat" UWORD _CNV_A_R_LINEAR_____352_CM 1 0. 0. 4294836225. ECU_ADDRESS 0xd000390a FORMAT "%9.8" /end MEASUREMENT
/begin MEASUREMENT Vxx_in_vvtc_angl_sp_1 "Correspond to the previous value of the variable Vxx_in_vvtc_angl_sp" UWORD _CNV_A_R_LINEAR_____76_CM 1 0. 0. 719.98 ECU_ADDRESS 0xd000390c FORMAT "%6.2" /end MEASUREMENT
/begin MEASUREMENT Vxx_in_vvtc_angl_sp_2 "Correspond to the previous value of the variable Vxx_in_vvtc_angl_sp_1" UWORD _CNV_A_R_LINEAR_____76_CM 1 0. 0. 719.98 ECU_ADDRESS 0xd000390e FORMAT "%6.2" /end MEASUREMENT
/begin MEASUREMENT Vxx_in_vvtc_angl_sp_lck "Angular position setpoint of the intake VVTC system after the unlocking strategy mode treatment" UWORD _CNV_A_R_LINEAR_____76_CM 1 0. 0. 719.98 ECU_ADDRESS 0xd0003910 FORMAT "%6.2" /end MEASUREMENT
/begin MEASUREMENT Vxx_in_vvtc_awg_lp "Value of the anti-windup correction" SWORD _CNV_A_R_LINEAR_____353_CM 1 0. -2048. 2047.9375 ECU_ADDRESS 0xd0003912 FORMAT "%9.4" /end MEASUREMENT
/begin MEASUREMENT Vxx_in_vvtc_cl_cps "Internal variable used for the calculation of the closed loop compensation" UWORD _CNV_A_R_LINEAR_____354_CM 1 0. -256. 255.99 ECU_ADDRESS 0xd0003914 FORMAT "%11.7" /end MEASUREMENT
/begin MEASUREMENT Vxx_in_vvtc_cl_cps_1 "Previous value of the variable Vxx_in_vvtc_cl_cps" UWORD _CNV_A_R_LINEAR_____355_CM 1 0. -256. 255.9921875 ECU_ADDRESS 0xd0003916 FORMAT "%12.7" /end MEASUREMENT
/begin MEASUREMENT Vxx_in_vvtc_cl_cps_tmp "Internal variable used for the calculation of the closed loop compensation" ULONG _CNV_A_R_LINEAR_____356_CM 1 0. -256. 255.99999988079 ECU_ADDRESS 0xd0002018 FORMAT "%12.8" /end MEASUREMENT
/begin MEASUREMENT Vxx_in_vvtc_cl_ctl "Closed loop control (output of the RST controller)" UWORD _CNV_A_R_LINEAR_____357_CM 1 0. -200. 200. ECU_ADDRESS 0xd0003918 FORMAT "%7.2" /end MEASUREMENT
/begin MEASUREMENT Vxx_in_vvtc_cl_ctl_dif "Value used for the calculation of the anti-windup action" UWORD _CNV_A_R_LINEAR_____354_CM 1 0. -256. 255.99 ECU_ADDRESS 0xd000391a FORMAT "%11.7" /end MEASUREMENT
/begin MEASUREMENT Vxx_in_vvtc_cl_ctl_wio_sat "Closed loop control without saturations (used for the anti-windup action)" UWORD _CNV_A_R_LINEAR_____354_CM 1 0. -256. 255.99 ECU_ADDRESS 0xd000391c FORMAT "%11.7" /end MEASUREMENT
/begin MEASUREMENT Vxx_in_vvtc_cl_ctl_wit_sat "Closed loop control with saturations (for the anti-windup action)" UWORD _CNV_A_R_LINEAR_____354_CM 1 0. -256. 255.99 ECU_ADDRESS 0xd000391e FORMAT "%11.7" /end MEASUREMENT
/begin MEASUREMENT Vxx_in_vvtc_den_cl_cps_0 "Coefficient used for the calculation of the closed loop compensation" UWORD _CNV_A_R_LINEAR_____358_CM 1 0. 0. 15.999755859375 ECU_ADDRESS 0xd0003920 FORMAT "%11.8" /end MEASUREMENT
/begin MEASUREMENT Vxx_in_vvtc_den_cl_cps_1 "Coefficient used for the calculation of the closed loop compensation" UWORD _CNV_A_R_LINEAR_____358_CM 1 0. 0. 15.999755859375 ECU_ADDRESS 0xd0003922 FORMAT "%11.8" /end MEASUREMENT
/begin MEASUREMENT Vxx_in_vvtc_den_cl_cps_tmp "Internal variable used for the calculation of the closed loop compensation" ULONG _CNV_A_R_LINEAR_____356_CM 1 0. -256. 255.99999988079 ECU_ADDRESS 0xd000201c FORMAT "%12.8" /end MEASUREMENT
/begin MEASUREMENT Vxx_in_vvtc_den_pcmd_tmp "Internal variable used for the calculation of the feedforward control" ULONG _CNV_A_R_LINEAR_____356_CM 1 0. -256. 255.99999988079 ECU_ADDRESS 0xd0002020 FORMAT "%12.8" /end MEASUREMENT
/begin MEASUREMENT Vxx_in_vvtc_den_pcmd_tmp_1 "Internal variable used for the calculation of the feedforward control" ULONG _CNV_A_R_LINEAR_____356_CM 1 0. -256. 255.99999988079 ECU_ADDRESS 0xd0002024 FORMAT "%12.8" /end MEASUREMENT
/begin MEASUREMENT Vxx_in_vvtc_den_pcmd_tmp_2 "Internal variable used for the calculation of the feedforward control" ULONG _CNV_A_R_LINEAR_____356_CM 1 0. -256. 255.99999988079 ECU_ADDRESS 0xd0002028 FORMAT "%12.8" /end MEASUREMENT
/begin MEASUREMENT Vxx_in_vvtc_den_tgt_sp_0 "Coefficient used for the calculation of the target setpoint" UWORD _CNV_A_R_LINEAR_____358_CM 1 0. 0. 15.999755859375 ECU_ADDRESS 0xd0003924 FORMAT "%11.8" /end MEASUREMENT
/begin MEASUREMENT Vxx_in_vvtc_den_tgt_sp_1 "Coefficient used for the calculation of the target setpoint" UWORD _CNV_A_R_LINEAR_____358_CM 1 0. 0. 15.999755859375 ECU_ADDRESS 0xd0003926 FORMAT "%11.8" /end MEASUREMENT
/begin MEASUREMENT Vxx_in_vvtc_den_tgt_sp_2 "Coefficient used for the calculation of the target setpoint" UWORD _CNV_A_R_LINEAR_____358_CM 1 0. 0. 15.999755859375 ECU_ADDRESS 0xd0003928 FORMAT "%11.8" /end MEASUREMENT
/begin MEASUREMENT Vxx_in_vvtc_den_tgt_sp_tmp "Internal variable used for the calculation of the target setpoint" SLONG _CNV_A_R_LINEAR_____359_CM 1 0. -256. 255.999999880791 ECU_ADDRESS 0xd000202c FORMAT "%16.12" /end MEASUREMENT
/begin MEASUREMENT Vxx_in_vvtc_den_tgt_sp_tmp_1 "Internal variable used for the calculation of the target setpoint" ULONG _CNV_A_R_LINEAR_____360_CM 1 0. 0. 255.999999940395 ECU_ADDRESS 0xd0002030 FORMAT "%12.8" /end MEASUREMENT
/begin MEASUREMENT Vxx_in_vvtc_den_tgt_sp_tmp_2 "Internal variable used for the calculation of the target setpoint" ULONG _CNV_A_R_LINEAR_____360_CM 1 0. 0. 255.999999940395 ECU_ADDRESS 0xd0002034 FORMAT "%12.8" /end MEASUREMENT
/begin MEASUREMENT Vxx_in_vvtc_int_val "Integral term of the controller" UWORD _CNV_A_R_LINEAR_____355_CM 1 0. -256. 255.9921875 ECU_ADDRESS 0xd000392a FORMAT "%12.7" /end MEASUREMENT
/begin MEASUREMENT Vxx_in_vvtc_int_val_tmp "Internal variable used for the calculation of the closed loop compensation" UWORD _CNV_A_R_LINEAR_____354_CM 1 0. -256. 255.99 ECU_ADDRESS 0xd000392c FORMAT "%11.7" /end MEASUREMENT
/begin MEASUREMENT Vxx_in_vvtc_lck_cyc_t "VVTC unlocking strategy mode duration" UWORD _CNV_A_R_LINEAR_____58_CM 1 0. 0. 65.535 ECU_ADDRESS 0xd000392e /end MEASUREMENT
/begin MEASUREMENT Vxx_in_vvtc_num_cl_cps_0 "Coefficient used for the calculation of the closed loop compensation" UWORD _CNV_A_R_LINEAR_____361_CM 1 0. -8. 7.999755859375 ECU_ADDRESS 0xd0003930 FORMAT "%10.8" /end MEASUREMENT
/begin MEASUREMENT Vxx_in_vvtc_num_cl_cps_1 "Coefficient used for the calculation of the closed loop compensation" UWORD _CNV_A_R_LINEAR_____361_CM 1 0. -8. 7.999755859375 ECU_ADDRESS 0xd0003932 FORMAT "%10.8" /end MEASUREMENT
/begin MEASUREMENT Vxx_in_vvtc_num_cl_cps_tmp "Internal variable used for the calculation of the closed loop compensation" ULONG _CNV_A_R_LINEAR_____356_CM 1 0. -256. 255.99999988079 ECU_ADDRESS 0xd0002038 FORMAT "%12.8" /end MEASUREMENT
/begin MEASUREMENT Vxx_in_vvtc_num_cl_cps_tmp_0 "Internal variable used for the calculation of the closed loop compensation" ULONG _CNV_A_R_LINEAR_____356_CM 1 0. -256. 255.99999988079 ECU_ADDRESS 0xd000203c FORMAT "%12.8" /end MEASUREMENT
/begin MEASUREMENT Vxx_in_vvtc_num_cl_cps_tmp_1 "Internal variable used for the calculation of the closed loop compensation" ULONG _CNV_A_R_LINEAR_____356_CM 1 0. -256. 255.99999988079 ECU_ADDRESS 0xd0002040 FORMAT "%12.8" /end MEASUREMENT
/begin MEASUREMENT Vxx_in_vvtc_num_pcmd_0 "Coefficient used for the calculation of the feedforward control" UWORD _CNV_A_R_LINEAR_____361_CM 1 0. -8. 7.999755859375 ECU_ADDRESS 0xd0003934 FORMAT "%10.8" /end MEASUREMENT
/begin MEASUREMENT Vxx_in_vvtc_num_pcmd_1 "Coefficient used for the calculation of the feedforward control" UWORD _CNV_A_R_LINEAR_____361_CM 1 0. -8. 7.999755859375 ECU_ADDRESS 0xd0003936 FORMAT "%10.8" /end MEASUREMENT
/begin MEASUREMENT Vxx_in_vvtc_num_pcmd_2 "Coefficient used for the calculation of the feedforward control" UWORD _CNV_A_R_LINEAR_____361_CM 1 0. -8. 7.999755859375 ECU_ADDRESS 0xd0003938 FORMAT "%10.8" /end MEASUREMENT
/begin MEASUREMENT Vxx_in_vvtc_num_pcmd_tmp "Internal variable used for the calculation of the feedforward control" ULONG _CNV_A_R_LINEAR_____356_CM 1 0. -256. 255.99999988079 ECU_ADDRESS 0xd0002044 FORMAT "%12.8" /end MEASUREMENT
/begin MEASUREMENT Vxx_in_vvtc_num_pcmd_tmp_0 "Internal variable used for the calculation of the feedforward control" ULONG _CNV_A_R_LINEAR_____356_CM 1 0. -256. 255.99999988079 ECU_ADDRESS 0xd0002048 FORMAT "%12.8" /end MEASUREMENT
/begin MEASUREMENT Vxx_in_vvtc_num_pcmd_tmp_1 "Internal variable used for the calculation of the feedforward control" ULONG _CNV_A_R_LINEAR_____356_CM 1 0. -256. 255.99999988079 ECU_ADDRESS 0xd000204c FORMAT "%12.8" /end MEASUREMENT
/begin MEASUREMENT Vxx_in_vvtc_num_pcmd_tmp_2 "Internal variable used for the calculation of the feedforward control" ULONG _CNV_A_R_LINEAR_____356_CM 1 0. -256. 255.99999988079 ECU_ADDRESS 0xd0002050 FORMAT "%12.8" /end MEASUREMENT
/begin MEASUREMENT Vxx_in_vvtc_num_tgt_sp_0 "Coefficient used for the calculation of the target setpoint" SWORD _CNV_A_R_LINEAR_____362_CM 1 0. -8. 7.999755859375 ECU_ADDRESS 0xd000393a FORMAT "%10.8" /end MEASUREMENT
/begin MEASUREMENT Vxx_in_vvtc_num_tgt_sp_1 "Coefficient used for the calculation of the target setpoint" SWORD _CNV_A_R_LINEAR_____362_CM 1 0. -8. 7.999755859375 ECU_ADDRESS 0xd000393c FORMAT "%10.8" /end MEASUREMENT
/begin MEASUREMENT Vxx_in_vvtc_num_tgt_sp_2 "Coefficient used for the calculation of the target setpoint" SWORD _CNV_A_R_LINEAR_____362_CM 1 0. -8. 7.999755859375 ECU_ADDRESS 0xd000393e FORMAT "%10.8" /end MEASUREMENT
/begin MEASUREMENT Vxx_in_vvtc_num_tgt_sp_tmp "Internal variable used for the calculation of the target setpoint" SLONG _CNV_A_R_LINEAR_____359_CM 1 0. -256. 255.999999880791 ECU_ADDRESS 0xd0002054 FORMAT "%16.12" /end MEASUREMENT
/begin MEASUREMENT Vxx_in_vvtc_num_tgt_sp_tmp_0 "Internal variable used for the calculation of the target setpoint" SLONG _CNV_A_R_LINEAR_____359_CM 1 0. -256. 255.999999880791 ECU_ADDRESS 0xd0002058 FORMAT "%16.12" /end MEASUREMENT
/begin MEASUREMENT Vxx_in_vvtc_num_tgt_sp_tmp_1 "Internal variable used for the calculation of the target setpoint" SLONG _CNV_A_R_LINEAR_____359_CM 1 0. -256. 255.999999880791 ECU_ADDRESS 0xd000205c FORMAT "%16.12" /end MEASUREMENT
/begin MEASUREMENT Vxx_in_vvtc_num_tgt_sp_tmp_2 "Internal variable used for the calculation of the target setpoint" SLONG _CNV_A_R_LINEAR_____359_CM 1 0. -256. 255.999999880791 ECU_ADDRESS 0xd0002060 FORMAT "%16.12" /end MEASUREMENT
/begin MEASUREMENT Vxx_in_vvtc_p_val "Proporionnal term of the RST controller" UWORD _CNV_A_R_LINEAR_____354_CM 1 0. -256. 255.99 ECU_ADDRESS 0xd0003940 FORMAT "%11.7" /end MEASUREMENT
/begin MEASUREMENT Vxx_in_vvtc_pcmd "Value of the feedforward control" UWORD _CNV_A_R_LINEAR_____354_CM 1 0. -256. 255.99 ECU_ADDRESS 0xd0003942 FORMAT "%11.7" /end MEASUREMENT
/begin MEASUREMENT Vxx_in_vvtc_pcmd_1 "Correspond to the previous value of the variable Vxx_in_vvtc_pcmd" UWORD _CNV_A_R_LINEAR_____355_CM 1 0. -256. 255.9921875 ECU_ADDRESS 0xd0003944 FORMAT "%12.7" /end MEASUREMENT
/begin MEASUREMENT Vxx_in_vvtc_pcmd_2 "Correspond to the previous value of the variable Vxx_in_vvtc_pcmd_1" UWORD _CNV_A_R_LINEAR_____355_CM 1 0. -256. 255.9921875 ECU_ADDRESS 0xd0003946 FORMAT "%12.7" /end MEASUREMENT
/begin MEASUREMENT Vxx_in_vvtc_pcmd_tmp "Internal variable for the calculation of the feedforward control" ULONG _CNV_A_R_LINEAR_____363_CM 1 0. -256. 255.99999988079 ECU_ADDRESS 0xd0002064 FORMAT "%12.8" /end MEASUREMENT
/begin MEASUREMENT Vxx_in_vvtc_pwm "PWM control applied to the driver of the VVTC Solenoid valve" UWORD _CNV_A_R_LINEAR_____94_CM 1 0. 0. 200. ECU_ADDRESS 0xd0003948 FORMAT "%6.2" /end MEASUREMENT
/begin MEASUREMENT Vxx_in_vvtc_pwm_val "Value of the PWM control with Min/Max saturation" UWORD _CNV_A_R_LINEAR_____94_CM 1 0. 0. 200. ECU_ADDRESS 0xd000394a FORMAT "%6.2" /end MEASUREMENT
/begin MEASUREMENT Vxx_in_vvtc_pwm_vb_cps "PWM control with battery voltage compensation" UWORD _CNV_A_R_LINEAR_____94_CM 1 0. 0. 200. ECU_ADDRESS 0xd000394c FORMAT "%6.2" /end MEASUREMENT
/begin MEASUREMENT Vxx_in_vvtc_reg_err "Regulation error (difference between setpoint and the actual angular position of the VVTC system)" UWORD _CNV_A_R_LINEAR_____364_CM 1 0. -360. 360. ECU_ADDRESS 0xd000394e FORMAT "%7.2" /end MEASUREMENT
/begin MEASUREMENT Vxx_in_vvtc_reg_err_1 "Previous value of the varaible Vxx_in_vvtc_reg_err" UWORD _CNV_A_R_LINEAR_____364_CM 1 0. -360. 360. ECU_ADDRESS 0xd0003950 FORMAT "%7.2" /end MEASUREMENT
/begin MEASUREMENT Vxx_in_vvtc_sum_pint_val "Proportionnal and integral terms of the RST controller" UWORD _CNV_A_R_LINEAR_____354_CM 1 0. -256. 255.99 ECU_ADDRESS 0xd0003952 FORMAT "%11.7" /end MEASUREMENT
/begin MEASUREMENT Vxx_in_vvtc_tgt_sp "Target setpoint for the closed loop control of the VVTC angular position" UWORD _CNV_A_R_LINEAR_____365_CM 1 0. 0. 127.998046875 ECU_ADDRESS 0xd0003954 FORMAT "%10.6" /end MEASUREMENT
/begin MEASUREMENT Vxx_in_vvtc_tgt_sp_1 "Previous value of the variable Vxx_in_vvtc_angl_sp" UWORD _CNV_A_R_LINEAR_____365_CM 1 0. 0. 127.998046875 ECU_ADDRESS 0xd0003956 FORMAT "%10.6" /end MEASUREMENT
/begin MEASUREMENT Vxx_in_vvtc_tgt_sp_2 "Previous value of the variable Vxx_in_vvtc_tgt_sp_1" UWORD _CNV_A_R_LINEAR_____365_CM 1 0. 0. 127.998046875 ECU_ADDRESS 0xd0003958 FORMAT "%10.6" /end MEASUREMENT
/begin MEASUREMENT Vxx_in_vvtc_tgt_sp_cho "Target setpoint for the closed loop control of the VVTC angular position" UWORD _CNV_A_R_LINEAR_____76_CM 1 0. 0. 719.98 ECU_ADDRESS 0xd000395a FORMAT "%6.2" /end MEASUREMENT
/begin MEASUREMENT Vxx_in_vvtc_tgt_sp_ftc "Target setpoint from first order filter for the closed loop control of the VVTC angular position" UWORD _CNV_A_R_LINEAR_____76_CM 1 0. 0. 719.98 ECU_ADDRESS 0xd000395c FORMAT "%6.2" /end MEASUREMENT
/begin MEASUREMENT Vxx_in_vvtc_tgt_sp_tmp "Internal variable for the calculation of the target setpoint" ULONG _CNV_A_R_LINEAR_____360_CM 1 0. 0. 255.999999940395 ECU_ADDRESS 0xd0002068 FORMAT "%12.8" /end MEASUREMENT
/begin MEASUREMENT Vxx_in_vvtc_vb_cps "Battery voltage compensation" UWORD _CNV_A_R_LINEAR_____366_CM 1 0. 0. 100. ECU_ADDRESS 0xd000395e FORMAT "%12.8" /end MEASUREMENT
/begin MEASUREMENT Vxx_in_vvtc_vb_fil "Filtered battery voltage" UWORD _CNV_A_R_LINEAR_____150_CM 1 0. 0. 60. ECU_ADDRESS 0xd0003960 FORMAT "%5.2" /end MEASUREMENT
/begin CHARACTERISTIC Cbx_in_vvtc_cho_tgt_sp "Select filter for target setpoint computation (1 : 1st order filter ; 0 : RST filter)" VALUE 0xa0020aa6 _REC_S1VAL_20_u1 1. _CNV_A_R_ECME_LINEA_0_CM 0. 1. FORMAT "%1.0" BIT_MASK 0x1 /end CHARACTERISTIC
/begin CHARACTERISTIC Cbx_in_vvtc_ena_inh_cmd "Allow control inhibition of the VVTC system in the risk zon (limit behavior)" VALUE 0xa0020aa7 _REC_S1VAL_20_u1 1. _CNV_A_R_ECME_LINEA_0_CM 0. 1. FORMAT "%1.0" BIT_MASK 0x1 /end CHARACTERISTIC
/begin CHARACTERISTIC Cbx_in_vvtc_ena_int_ad "Allow learning of the integral term" VALUE 0xa0020aa8 _REC_S1VAL_20_u1 1. _CNV_A_R_ECME_LINEA_0_CM 0. 1. FORMAT "%1.0" BIT_MASK 0x1 /end CHARACTERISTIC
/begin CHARACTERISTIC Cbx_in_vvtc_ena_vb_cps "Enable compensation of the PWM control with regard to battery voltage" VALUE 0xa0020aa9 _REC_S1VAL_20_u1 1. _CNV_A_R_ECME_LINEA_0_CM 0. 1. FORMAT "%1.0" BIT_MASK 0x1 /end CHARACTERISTIC
/begin CHARACTERISTIC Cbx_in_vvtc_pwm_bch "Select open loop control" VALUE 0xa0020aaa _REC_S1VAL_20_u1 1. _CNV_A_R_ECME_LINEA_0_CM 0. 1. FORMAT "%1.0" BIT_MASK 0x1 /end CHARACTERISTIC
/begin CHARACTERISTIC Cxx_in_cam_toth_per_max "Maximum duration between two intake camshaft events" VALUE 0xa0020a6e _REC_S1VAL_20_u2 65535. _CNV_A_R_LINEAR_____145_CM 0. 65535. FORMAT "%5.0" /end CHARACTERISTIC
/begin CHARACTERISTIC Cxx_in_cam_toth_per_min "Maximum duration between two intake camshaft events" VALUE 0xa0020a70 _REC_S1VAL_20_u2 65535. _CNV_A_R_LINEAR_____145_CM 0. 65535. FORMAT "%5.0" /end CHARACTERISTIC
/begin CHARACTERISTIC Cxx_in_vvtc_angl_max_str "Maximum angular displacement of the intake VVTC actuator (component characteristic)" VALUE 0xa0020a72 _REC_S1VAL_20_u2 719.98 _CNV_A_R_LINEAR_____76_CM 0. 719.98 FORMAT "%6.2" /end CHARACTERISTIC
/begin CHARACTERISTIC Cxx_in_vvtc_den_cl_cps_0 "RST controller parameter used for the calculation of the closed loop compensation" VALUE 0xa0020a74 _REC_S1VAL_20_u2 511.99 _CNV_A_R_LINEAR_____367_CM 0. 511.99 FORMAT "%11.7" /end CHARACTERISTIC
/begin CHARACTERISTIC Cxx_in_vvtc_den_tgt_sp_1 "RST controller parameter used for the calculation of the target setpoint" VALUE 0xa0020a76 _REC_S1VAL_20_u2 255.99609375 _CNV_A_R_LINEAR_____368_CM 0. 255.99609375 FORMAT "%9.8" /end CHARACTERISTIC
/begin CHARACTERISTIC Cxx_in_vvtc_ftc_vb "Time constante for filtering battery voltage" VALUE 0xa0020a78 _REC_S1VAL_20_u2 65.535 _CNV_A_R_LINEAR_____58_CM 0. 65.535 /end CHARACTERISTIC
/begin CHARACTERISTIC Cxx_in_vvtc_h_psn_thd_ol_cl "High position threshold for which closed loop control = 100%" VALUE 0xa0020a7a _REC_S1VAL_20_u2 719.98 _CNV_A_R_LINEAR_____76_CM 0. 719.98 FORMAT "%6.2" /end CHARACTERISTIC
/begin CHARACTERISTIC Cxx_in_vvtc_int_max_thd "Maximum integral value to end integral learning" VALUE 0xa0020a7c _REC_S1VAL_20_u2 200. _CNV_A_R_LINEAR_____94_CM 0. 200. FORMAT "%6.2" /end CHARACTERISTIC
/begin CHARACTERISTIC Cxx_in_vvtc_int_val "Initial value of the integral terme when integral learning is disable" VALUE 0xa0020a7e _REC_S1VAL_20_u2 200. _CNV_A_R_LINEAR_____94_CM 0. 200. FORMAT "%6.2" /end CHARACTERISTIC
/begin CHARACTERISTIC Cxx_in_vvtc_int_val_inc "Value of the increment " VALUE 0xa0020a80 _REC_S1VAL_20_u2 200. _CNV_A_R_LINEAR_____94_CM 0. 200. FORMAT "%6.2" /end CHARACTERISTIC
/begin CHARACTERISTIC Cxx_in_vvtc_int_val_ini "Initial value of the integral terme before learning" VALUE 0xa0020a82 _REC_S1VAL_20_u2 200. _CNV_A_R_LINEAR_____94_CM 0. 200. FORMAT "%6.2" /end CHARACTERISTIC
/begin CHARACTERISTIC Cxx_in_vvtc_l_psn_thd_ol_cl "low position threshold for which closed loop control = 0%" VALUE 0xa0020a84 _REC_S1VAL_20_u2 719.98 _CNV_A_R_LINEAR_____76_CM 0. 719.98 FORMAT "%6.2" /end CHARACTERISTIC
/begin CHARACTERISTIC Cxx_in_vvtc_lck_cyc_t_1 "Time of the rising slope of the specific RCO for unlocking strategy" VALUE 0xa0020a86 _REC_S1VAL_20_u2 65.535 _CNV_A_R_LINEAR_____58_CM 0. 65.535 FORMAT "%5.3" /end CHARACTERISTIC
/begin CHARACTERISTIC Cxx_in_vvtc_lck_cyc_t_2 "Time of the decreasing slope of the specific RCO for unlocking strategy" VALUE 0xa0020a88 _REC_S1VAL_20_u2 65.535 _CNV_A_R_LINEAR_____58_CM 0. 65.535 FORMAT "%5.3" /end CHARACTERISTIC
/begin CHARACTERISTIC Cxx_in_vvtc_mov_det_thd "Threshold to detect actuator movement" VALUE 0xa0020a8a _REC_S1VAL_20_u2 719.98 _CNV_A_R_LINEAR_____76_CM 0. 719.98 FORMAT "%6.2" /end CHARACTERISTIC
/begin CHARACTERISTIC Cxx_in_vvtc_nom_vb "Nominal value of battery voltage " VALUE 0xa0020a8c _REC_S1VAL_20_u2 60. _CNV_A_R_LINEAR_____150_CM 0. 60. FORMAT "%5.2" /end CHARACTERISTIC
/begin CHARACTERISTIC Cxx_in_vvtc_num_cl_cps_0 "RST controller parameter used for the calculation of the closed loop compensation" VALUE 0xa0020a8e _REC_S1VAL_20_u2 511.99 _CNV_A_R_LINEAR_____369_CM 0. 511.99 FORMAT "%9.8" /end CHARACTERISTIC
/begin CHARACTERISTIC Cxx_in_vvtc_num_cl_cps_1 "RST controller parameter used for the calculation of the closed loop compensation" VALUE 0xa0020a90 _REC_S1VAL_20_u2 15.999755859375 _CNV_A_R_LINEAR_____361_CM -8. 7.999755859375 FORMAT "%10.8" /end CHARACTERISTIC
/begin CHARACTERISTIC Cxx_in_vvtc_num_pcmd_0 "RST controller parameter used for the calculation of the feedforward control" VALUE 0xa0020a92 _REC_S1VAL_20_s2 511.99609375 _CNV_A_R_LINEAR_____370_CM -256. 255.99609375 FORMAT "%9.8" /end CHARACTERISTIC
/begin CHARACTERISTIC Cxx_in_vvtc_num_pcmd_1 "RST controller parameter used for the calculation of the feedforward control" VALUE 0xa0020a94 _REC_S1VAL_20_s2 511.99609375 _CNV_A_R_LINEAR_____371_CM -256. 255.99609375 FORMAT "%9.8" /end CHARACTERISTIC
/begin CHARACTERISTIC Cxx_in_vvtc_num_pcmd_2 "RST controller parameter used for the calculation of the feedforward control" VALUE 0xa0020a96 _REC_S1VAL_20_u2 15.999755859375 _CNV_A_R_LINEAR_____372_CM 0. 15.999755859375 FORMAT "%6.2" /end CHARACTERISTIC
/begin CHARACTERISTIC Cxx_in_vvtc_num_tgt_sp_0 "RST controller parameter used for the calculation of the target setpoint" VALUE 0xa0020a98 _REC_S1VAL_20_u2 2047.96875 _CNV_A_R_LINEAR_____373_CM 0. 2047.96875 FORMAT "%9.8" /end CHARACTERISTIC
/begin CHARACTERISTIC Cxx_in_vvtc_num_tgt_sp_1 "RST controller parameter used for the calculation of the target setpoint" VALUE 0xa0020a9a _REC_S1VAL_20_s2 255.99609375 _CNV_A_R_LINEAR_____368_CM -128. 127.99609375 FORMAT "%9.8" /end CHARACTERISTIC
/begin CHARACTERISTIC Cxx_in_vvtc_num_tgt_sp_2 "RST controller parameter used for the calculation of the target setpoint" VALUE 0xa0020a9c _REC_S1VAL_20_u2 15.999755859375 _CNV_A_R_LINEAR_____358_CM 0. 15.999755859375 FORMAT "%11.8" /end CHARACTERISTIC
/begin CHARACTERISTIC Cxx_in_vvtc_pwm_bch "Value of PWM control applied in open loop" VALUE 0xa0020a9e _REC_S1VAL_20_u2 200. _CNV_A_R_LINEAR_____94_CM 0. 200. FORMAT "%6.2" /end CHARACTERISTIC
/begin CHARACTERISTIC Cxx_in_vvtc_t_sldv_cln_cyc "Maximum duration between two intake camshaft events" VALUE 0xa0020aa0 _REC_S1VAL_20_u2 655.35 _CNV_A_R_LINEAR_____34_CM 0. 655.35 FORMAT "%6.2" /end CHARACTERISTIC
/begin CHARACTERISTIC Cxx_in_vvtc_t_sldv_cln_cyc_on "Duration of the solenoid valve autocleaning period while the PWM control is 100%" VALUE 0xa0020aa2 _REC_S1VAL_20_u2 65.535 _CNV_A_R_LINEAR_____58_CM 0. 65.535 /end CHARACTERISTIC
/begin CHARACTERISTIC Cxx_in_vvtc_tgt_sp_ftc "Target setpoint from first order filter for the closed loop control of the VVTC angular position" VALUE 0xa0020aa4 _REC_S1VAL_20_u2 65.535 _CNV_A_R_LINEAR_____58_CM 0. 65.535 FORMAT "%5.3" /end CHARACTERISTIC
/begin MEASUREMENT Vbx_in_vvtc_cdt_ena_lck "Unlocking strategy mode allowed by engine conditions" UBYTE _CNV_S_2_RANGE______3_CM 1 0. 0. 1. ECU_ADDRESS 0xd0004d7b BIT_MASK 0x1 /end MEASUREMENT
/begin MEASUREMENT Vbx_in_vvtc_ena_lck "All conditions gathered enabling the camshaft wheel unlocking strategy mode" UBYTE _CNV_S_2_RANGE______3_CM 1 0. 0. 1. ECU_ADDRESS 0xd0004d7c BIT_MASK 0x1 /end MEASUREMENT
/begin MEASUREMENT Vbx_in_vvtc_ena_lck_act "Allow VVTC unlocking strategy mode" UBYTE _CNV_S_2_RANGE______3_CM 1 0. 0. 1. ECU_ADDRESS 0xd0004d7d BIT_MASK 0x1 /end MEASUREMENT
/begin MEASUREMENT Vbx_in_vvtc_vvtc_lck "Information the VVTC is locked in its default position" UBYTE _CNV_S_2_RANGE______3_CM 1 0. 0. 1. ECU_ADDRESS 0xd0004d7e BIT_MASK 0x1 /end MEASUREMENT
/begin CHARACTERISTIC Cbx_diag_in_vvtc_ena_lck "Allow to application of the unlocking strategyt during the activation of the VVTC actuation tests (after sale routine)" VALUE 0xa002091e _REC_S1VAL_20_u1 1. _CNV_A_R_ECME_LINEA_0_CM 0. 1. FORMAT "%1.0" BIT_MASK 0x1 /end CHARACTERISTIC
/begin CHARACTERISTIC Cbx_in_vvtc_lck_cho_tco_toil "Select coolant or oil temperature to determine the activation/deactivation condition of the VVTC unlocking strategy mode" VALUE 0xa002091f _REC_S1VAL_20_u1 1. _CNV_A_R_ECME_LINEA_0_CM 0. 1. FORMAT "%1.0" BIT_MASK 0x1 /end CHARACTERISTIC
/begin CHARACTERISTIC Cxx_in_vvtc_lck_cyc_nr "Number of the PWM phases for the VVTC unlocking strategy mode" VALUE 0xa0020920 _REC_S1VAL_20_u1 25. _CNV_A_R_ECME_LINEA_0_CM 0. 25. FORMAT "%3.0" /end CHARACTERISTIC
/begin CHARACTERISTIC Cxx_in_vvtc_lck_load_h_thd "Traget torque ratio upper limit enabling the unlocking strategy mode" VALUE 0xa002090c _REC_S1VAL_20_u2 1. _CNV_A_R_LINEAR_____125_CM 0. 1. FORMAT "%11.9" /end CHARACTERISTIC
/begin CHARACTERISTIC Cxx_in_vvtc_lck_load_l_thd "Traget torque ratio lower limit enabling the unlocking strategy mode" VALUE 0xa002090e _REC_S1VAL_20_u2 1. _CNV_A_R_LINEAR_____125_CM 0. 1. FORMAT "%11.9" /end CHARACTERISTIC
/begin CHARACTERISTIC Cxx_in_vvtc_lck_n_h_thd "Engine speed upper limit enabling the unlocking strategy mode" VALUE 0xa0020910 _REC_S1VAL_20_u2 16383.75 _CNV_A_R_ENSD_LINEA_24_CM 0. 16383.75 FORMAT "%8.2" /end CHARACTERISTIC
/begin CHARACTERISTIC Cxx_in_vvtc_lck_n_l_thd "Engine speed lower limit enabling the unlocking strategy mode" VALUE 0xa0020912 _REC_S1VAL_20_u2 16383.75 _CNV_A_R_ENSD_LINEA_24_CM 0. 16383.75 FORMAT "%8.2" /end CHARACTERISTIC
/begin CHARACTERISTIC Cxx_in_vvtc_lck_t_mes "Duration confirm the VVTC is locked in its default position" VALUE 0xa0020914 _REC_S1VAL_20_u2 6553.5 _CNV_A_R_LINEAR_____4_CM 0. 6553.5 FORMAT "%6.1" /end CHARACTERISTIC
/begin CHARACTERISTIC Cxx_in_vvtc_lck_temp_h_thd "Oil and Coolant Temperature upper limit enabling the unlocking strategy mode" VALUE 0xa0020916 _REC_S1VAL_20_u2 240. _CNV_A_R_LINEAR_____54_CM -40. 200. FORMAT "%5.1" /end CHARACTERISTIC
/begin CHARACTERISTIC Cxx_in_vvtc_lck_temp_l_thd "Oil and Coolant Temperature lower limit enabling the unlocking strategy mode" VALUE 0xa0020918 _REC_S1VAL_20_u2 240. _CNV_A_R_LINEAR_____54_CM -40. 200. FORMAT "%5.1" /end CHARACTERISTIC
/begin CHARACTERISTIC Cxx_in_vvtc_lck_thd_angl_sp "Angular position setpoint threshold to confirm the lock of the VVT" VALUE 0xa002091a _REC_S1VAL_20_u2 719.98 _CNV_A_R_LINEAR_____76_CM 0. 719.98 FORMAT "%6.2" /end CHARACTERISTIC
/begin CHARACTERISTIC Cxx_in_vvtc_lck_thd_dft_psn "Angular VVTC measure threshold to confirm the VVTC is locked in its default position" VALUE 0xa002091c _REC_S1VAL_20_u2 719.98 _CNV_A_R_LINEAR_____76_CM 0. 719.98 FORMAT "%6.2" /end CHARACTERISTIC
/begin CHARACTERISTIC Cbx_in_vvtc_lck_cfm "Configuration of the unlocking strategy mode (1 : present / 0 : missing)" VALUE 0xa0020cb9 _REC_S1VAL_20_u1 1. _CNV_A_R_ECME_LINEA_0_CM 0. 1. FORMAT "%1.0" BIT_MASK 0x1 /end CHARACTERISTIC
/begin MEASUREMENT Vbx_df_wgc_oc "Open Circuit of wastegate detected failure" UBYTE _CNV_S_2_RANGE______3_CM 1 0. 0. 1. ECU_ADDRESS 0xd0004a1c BIT_MASK 0x1 /end MEASUREMENT
/begin MEASUREMENT Vbx_df_wgc_scg "Short Circuit to ground of wastegate detected failure" UBYTE _CNV_S_2_RANGE______3_CM 1 0. 0. 1. ECU_ADDRESS 0xd0004a1d BIT_MASK 0x1 /end MEASUREMENT
/begin MEASUREMENT Vbx_df_wgc_scw "Short Circuit to battery of wastegate detected failure" UBYTE _CNV_S_2_RANGE______3_CM 1 0. 0. 1. ECU_ADDRESS 0xd0004a1e BIT_MASK 0x1 /end MEASUREMENT
/begin MEASUREMENT Vbx_diag_ena_wgc_oc "Open Circuit of wastegate diagnosis information available" UBYTE _CNV_S_2_RANGE______3_CM 1 0. 0. 1. ECU_ADDRESS 0xd0004a1f BIT_MASK 0x1 /end MEASUREMENT
/begin MEASUREMENT Vbx_diag_ena_wgc_scg "Short Circuit to ground of wastegate diagnosis information available" UBYTE _CNV_S_2_RANGE______3_CM 1 0. 0. 1. ECU_ADDRESS 0xd0004a20 BIT_MASK 0x1 /end MEASUREMENT
/begin MEASUREMENT Vbx_diag_ena_wgc_scw "Short Circuit to battery of wastegate diagnosis information available" UBYTE _CNV_S_2_RANGE______3_CM 1 0. 0. 1. ECU_ADDRESS 0xd0004a21 BIT_MASK 0x1 /end MEASUREMENT
/begin MEASUREMENT CDN_DIAG_WG "Diagnosis condition for each symptom of WG electrical diagnosis" UBYTE _CNV_A_R_ECME_LINEA_0_CM 1 0. 0. 7. DISPLAY_IDENTIFIER cdn_diag_wg ECU_ADDRESS 0xd0004a23 FORMAT "%1.0" /end MEASUREMENT
/begin MEASUREMENT ctr_pulse_wg_dly "Time counter for pulse at key ON" UBYTE _CNV_A_R_LINEAR_____144_CM 1 0. 0. 255. ECU_ADDRESS 0xd000576a FORMAT "%3.0" /end MEASUREMENT
/begin MEASUREMENT ERR_DIAG_WG "Detected symptom for WG diagnosis" UBYTE _CNV_S_16_RANGE_ERR__151_CM 1 0. 0. 15. DISPLAY_IDENTIFIER err_diag_wg ECU_ADDRESS 0xd0004a24 /end MEASUREMENT
/begin MEASUREMENT lv_pulse_wg "Flag to indicate that pulse at key on was done" UBYTE _CNV_S_2_RANGE______3_CM 1 0. 0. 1. ECU_ADDRESS 0xd0004a22 BIT_MASK 0x1 /end MEASUREMENT
/begin MEASUREMENT lv_pulse_wg_tmp "Flag to indicate that pulse is working" UBYTE _CNV_S_2_RANGE______3_CM 1 0. 0. 1. ECU_ADDRESS 0xd000576c BIT_MASK 0x1 /end MEASUREMENT
/begin MEASUREMENT pwm_wg "WG PWM command" UWORD _CNV_A_R_LINEAR_____94_CM 1 0. 0. 100. ECU_ADDRESS 0xd0003844 FORMAT "%6.2" /end MEASUREMENT
/begin CHARACTERISTIC c_ctr_pulse_wg_dly "Time value for pulse key ON" VALUE 0xa00211cf _REC_S1VAL_20_u1 255. _CNV_A_R_LINEAR_____144_CM 0. 255. FORMAT "%3.0" /end CHARACTERISTIC
/begin CHARACTERISTIC c_d4ft_ena "Calibration for Turbo configuration = 1" VALUE 0xa00211d0 _REC_S1VAL_20_u1 1. _CNV_S_2_RANGE______3_CM 0. 1. /end CHARACTERISTIC
/begin CHARACTERISTIC c_wgpwm_diag_max_scg "Maximum threshold for SCG diagnosis window" VALUE 0xa002119c _REC_S1VAL_20_u2 100. _CNV_A_R_LINEAR_____94_CM 0. 100. FORMAT "%6.2" /end CHARACTERISTIC
/begin CHARACTERISTIC c_wgpwm_diag_min_oc "Minimum threshold for OC diagnosis window" VALUE 0xa002119e _REC_S1VAL_20_u2 100. _CNV_A_R_LINEAR_____94_CM 0. 100. FORMAT "%6.2" /end CHARACTERISTIC
/begin CHARACTERISTIC c_wgpwm_diag_min_scp "Minimum threshold for SCP diagnosis window" VALUE 0xa00211a0 _REC_S1VAL_20_u2 100. _CNV_A_R_LINEAR_____94_CM 0. 100. FORMAT "%6.2" /end CHARACTERISTIC
/begin MEASUREMENT Vbx_in_cam_ena_cmp_eprm_psn "Allow comparision between measured angular positions of the camshaft wheel active edges and values stored in Eeprom " UBYTE _CNV_S_2_RANGE______3_CM 1 0. 0. 1. DISPLAY_IDENTIFIER InAsiAei_NVM.Vbx_in_cam_ena_cmp_eprm_psn_NVM ECU_ADDRESS 0xd0001784 BIT_MASK 0x1 /end MEASUREMENT
/begin MEASUREMENT Vxx_in_cam_eprm_psn_redg_0 "Angular position stored in Eeprom for the active edge n∞0 (camshaft wheel)" UWORD _CNV_A_R_LINEAR_____76_CM 1 0. 0. 719.98 DISPLAY_IDENTIFIER InAsiAei_NVM.Vxx_in_cam_eprm_psn_redg_0_NVM ECU_ADDRESS 0xd0001786 FORMAT "%6.2" /end MEASUREMENT
/begin MEASUREMENT Vxx_in_cam_eprm_psn_redg_1 "Angular position stored in Eeprom for the active edge n∞1 (camshaft wheel)" UWORD _CNV_A_R_LINEAR_____76_CM 1 0. 0. 719.98 DISPLAY_IDENTIFIER InAsiAei_NVM.Vxx_in_cam_eprm_psn_redg_1_NVM ECU_ADDRESS 0xd0001788 FORMAT "%6.2" /end MEASUREMENT
/begin MEASUREMENT Vxx_in_cam_eprm_psn_redg_2 "Angular position stored in Eeprom for the active edge n∞2 (camshaft wheel)" UWORD _CNV_A_R_LINEAR_____76_CM 1 0. 0. 719.98 DISPLAY_IDENTIFIER InAsiAei_NVM.Vxx_in_cam_eprm_psn_redg_2_NVM ECU_ADDRESS 0xd000178a FORMAT "%6.2" /end MEASUREMENT
/begin MEASUREMENT Vxx_in_cam_eprm_psn_redg_3 "Angular position stored in Eeprom for the active edge n∞3 (camshaft wheel)" UWORD _CNV_A_R_LINEAR_____76_CM 1 0. 0. 719.98 DISPLAY_IDENTIFIER InAsiAei_NVM.Vxx_in_cam_eprm_psn_redg_3_NVM ECU_ADDRESS 0xd000178c FORMAT "%6.2" /end MEASUREMENT
/begin AXIS_PTS Ctb_in_cam_angl_redg_n_bkp "Table of engine speed breakpoints used with the cartography Ctp_in_cam_angl_cps" 0xa0026aa8 Vxx_n _REC_A2AXS_20_u2 16383.75 _CNV_A_R_ENSD_LINEA_24_CM 20 0. 16383.75 FORMAT "%8.2" /end AXIS_PTS
/begin CHARACTERISTIC Ctp_in_cam_angl_redg_cps "Cartography used to compensate the engine speed effect on the VVTC angular position" CURVE 0xa0026ad4 _REC_A1CUR_20_u2_u2 720. _CNV_A_R_LINEAR_____364_CM -360. 360. FORMAT "%7.2"
 /begin AXIS_DESCR COM_AXIS Vxx_n _CNV_A_R_ENSD_LINEA_24_CM 20 0. 16383.75 FORMAT "%8.2" AXIS_PTS_REF Ctb_in_cam_angl_redg_n_bkp /end AXIS_DESCR
/end CHARACTERISTIC
/begin MEASUREMENT Vbx_df_in_vvtc_ad "VVTC first offset learning detected failure" UBYTE _CNV_S_2_RANGE______3_CM 1 0. 0. 1. ECU_ADDRESS 0xd0004135 BIT_MASK 0x1 /end MEASUREMENT
/begin MEASUREMENT Vbx_in_cam_ad_whl "Learning of the camshaft wheel finished" UBYTE _CNV_S_2_RANGE______3_CM 1 0. 0. 1. ECU_ADDRESS 0xd0004136 BIT_MASK 0x1 /end MEASUREMENT
/begin MEASUREMENT Vbx_in_cam_crk_syn "Indicate crankshaft synchronization" UBYTE _CNV_S_2_RANGE______3_CM 1 0. 0. 1. ECU_ADDRESS 0xd0004137 BIT_MASK 0x1 /end MEASUREMENT
/begin MEASUREMENT Vbx_in_cam_dft_ad_whl "Learning of the camshaft wheel failed" UBYTE _CNV_S_2_RANGE______3_CM 1 0. 0. 1. ECU_ADDRESS 0xd0004138 BIT_MASK 0x1 /end MEASUREMENT
/begin MEASUREMENT Vbx_in_cam_dft_chr_cam_or_crk "Failure detected on the camshaft or on the crankshaft during camshaft wheel learning" UBYTE _CNV_S_2_RANGE______3_CM 1 0. 0. 1. ECU_ADDRESS 0xd0004139 BIT_MASK 0x1 /end MEASUREMENT
/begin MEASUREMENT Vbx_in_cam_dft_eprm_cmp "Difference between measured angular positions of the camshaft wheel active edges and values stored in Eeprom" UBYTE _CNV_S_2_RANGE______3_CM 1 0. 0. 1. ECU_ADDRESS 0xd000413a BIT_MASK 0x1 /end MEASUREMENT
/begin MEASUREMENT Vbx_in_cam_dft_phs_ad_whl "Failure detected during the learning stage of the camshaft wheel" UBYTE _CNV_S_2_RANGE______3_CM 1 0. 0. 1. ECU_ADDRESS 0xd000413b BIT_MASK 0x1 /end MEASUREMENT
/begin MEASUREMENT Vbx_in_cam_dft_ref_cmp "Difference between measured angular positions of the camshaft wheel active edges and reference values" UBYTE _CNV_S_2_RANGE______3_CM 1 0. 0. 1. ECU_ADDRESS 0xd000413c BIT_MASK 0x1 /end MEASUREMENT
/begin MEASUREMENT Vbx_in_cam_dsb_ad_whl "Inhib the use of the learned angular positions of the camshaft wheel active edges" UBYTE _CNV_S_2_RANGE______3_CM 1 0. 0. 1. ECU_ADDRESS 0xd000413d BIT_MASK 0x1 /end MEASUREMENT
/begin MEASUREMENT Vbx_in_cam_ena_acq "Enable the learning stage of the camshaft wheel" UBYTE _CNV_S_2_RANGE______3_CM 1 0. 0. 1. ECU_ADDRESS 0xd000413e BIT_MASK 0x1 /end MEASUREMENT
/begin MEASUREMENT Vbx_in_cam_ena_act_test "Allow VVTC open loop control after a first incoherent camshaft wheel learning" UBYTE _CNV_S_2_RANGE______3_CM 1 0. 0. 1. ECU_ADDRESS 0xd000413f BIT_MASK 0x1 /end MEASUREMENT
/begin MEASUREMENT Vbx_in_cam_ena_cmp_ref_psn "Allow comparision between measured angular positions of the camshaft wheel active edges and pre-determined values (reference)" UBYTE _CNV_S_2_RANGE______3_CM 1 0. 0. 1. ECU_ADDRESS 0xd0004140 BIT_MASK 0x1 /end MEASUREMENT
/begin MEASUREMENT Vbx_in_cam_ena_diag_ad_whl "Allow diagnosis of the measured angular position of the camshaft wheel active edges" UBYTE _CNV_S_2_RANGE______3_CM 1 0. 0. 1. ECU_ADDRESS 0xd0004141 BIT_MASK 0x1 /end MEASUREMENT
/begin MEASUREMENT Vbx_in_cam_ena_new_ad_whl "Allow a new learning of the camshaft wheel active edges (engine running)" UBYTE _CNV_S_2_RANGE______3_CM 1 0. 0. 1. ECU_ADDRESS 0xd0004142 BIT_MASK 0x1 /end MEASUREMENT
/begin MEASUREMENT Vbx_in_cam_ena_writ_eprm "Allow the storage in Eeprom of the learned angular positions of camshaft wheel active edges" UBYTE _CNV_S_2_RANGE______3_CM 1 0. 0. 1. ECU_ADDRESS 0xd0004143 BIT_MASK 0x1 /end MEASUREMENT
/begin MEASUREMENT Vbx_in_cam_end_acq_phs_ad "Camshaft wheel learning stage finished" UBYTE _CNV_S_2_RANGE______3_CM 1 0. 0. 1. ECU_ADDRESS 0xd0004144 BIT_MASK 0x1 /end MEASUREMENT
/begin MEASUREMENT Vbx_in_cam_end_act_test "VVTC open loop control after a first incoherent camshaft wheel learning finished" UBYTE _CNV_S_2_RANGE______3_CM 1 0. 0. 1. ECU_ADDRESS 0xd0004145 BIT_MASK 0x1 /end MEASUREMENT
/begin MEASUREMENT Vbx_in_cam_inh_ad_whl "Inhib the learned angular positions of the camshaft wheel active edges" UBYTE _CNV_S_2_RANGE______3_CM 1 0. 0. 1. ECU_ADDRESS 0xd0004146 BIT_MASK 0x1 /end MEASUREMENT
/begin MEASUREMENT Vbx_in_cam_ini_psn_redg "Indicate initialization of the angular position for each active edge of the camshaft wheel" UBYTE _CNV_S_2_RANGE______3_CM 1 0. 0. 1. ECU_ADDRESS 0xd0004147 BIT_MASK 0x1 /end MEASUREMENT
/begin MEASUREMENT Vbx_in_cam_stop_act_test "Open control after first camshaft wheel learning stopped" UBYTE _CNV_S_2_RANGE______3_CM 1 0. 0. 1. ECU_ADDRESS 0xd0004148 BIT_MASK 0x1 /end MEASUREMENT
/begin MEASUREMENT Vbx_in_cam_stop_new_ad_whl "Stop the learning stage of the camshaft wheel (a failure is detected or the VVTC is controlled)" UBYTE _CNV_S_2_RANGE______3_CM 1 0. 0. 1. ECU_ADDRESS 0xd0004149 BIT_MASK 0x1 /end MEASUREMENT
/begin MEASUREMENT Vbx_in_vvtc_angl_mes_nok "Measured value of the VVTC angular position invalid (out of validity range)" UBYTE _CNV_S_2_RANGE______3_CM 1 0. 0. 1. ECU_ADDRESS 0xd000414a BIT_MASK 0x1 /end MEASUREMENT
/begin MEASUREMENT Vbx_in_vvtc_dft_blk_frst_ad "Detection of a blocking of the VVTC during first camshaft wheel learning (out of the default position)" UBYTE _CNV_S_2_RANGE______3_CM 1 0. 0. 1. ECU_ADDRESS 0xd000414b BIT_MASK 0x1 /end MEASUREMENT
/begin MEASUREMENT Vbx_in_vvtc_dft_mov_fsrt_ad "Detection of a movement of the VVTC during first camshaft wheel learning" UBYTE _CNV_S_2_RANGE______3_CM 1 0. 0. 1. ECU_ADDRESS 0xd000414c BIT_MASK 0x1 /end MEASUREMENT
/begin MEASUREMENT Vbx_in_vvtc_dft_psn "VVTC detected in default position (information used by the basic software for CAM/CRAN coherence diagnosis)" UBYTE _CNV_S_2_RANGE______3_CM 1 0. 0. 1. ECU_ADDRESS 0xd000414d BIT_MASK 0x1 /end MEASUREMENT
/begin MEASUREMENT Vbx_in_vvtc_nul_pwm "Indicate a nul PWM control during the duration Cxx_in_vvtc_t_pwm_nul" UBYTE _CNV_S_2_RANGE______3_CM 1 0. 0. 1. ECU_ADDRESS 0xd000414e BIT_MASK 0x1 /end MEASUREMENT
/begin MEASUREMENT Vsx_in_vvtc_angl_vld "Intake VVTC angle validity status" UBYTE _CNV_S_3_STATUS_OK__158_CM 1 0. 0. 2. ECU_ADDRESS 0xd000414f /end MEASUREMENT
/begin MEASUREMENT Vtx_in_cam_eprm_psn_redg[0] "Vector containing angular positions stored in Eeprom of the camshaft wheel active edges" UWORD _CNV_A_R_LINEAR_____76_CM 1 0. 0. 719.98 ECU_ADDRESS 0xc0000bd0 FORMAT "%6.2" /end MEASUREMENT
/begin MEASUREMENT Vtx_in_cam_eprm_psn_redg[1] "Vector containing angular positions stored in Eeprom of the camshaft wheel active edges" UWORD _CNV_A_R_LINEAR_____76_CM 1 0. 0. 719.98 ECU_ADDRESS 0xc0000bd2 FORMAT "%6.2" /end MEASUREMENT
/begin MEASUREMENT Vtx_in_cam_eprm_psn_redg[2] "Vector containing angular positions stored in Eeprom of the camshaft wheel active edges" UWORD _CNV_A_R_LINEAR_____76_CM 1 0. 0. 719.98 ECU_ADDRESS 0xc0000bd4 FORMAT "%6.2" /end MEASUREMENT
/begin MEASUREMENT Vtx_in_cam_eprm_psn_redg[3] "Vector containing angular positions stored in Eeprom of the camshaft wheel active edges" UWORD _CNV_A_R_LINEAR_____76_CM 1 0. 0. 719.98 ECU_ADDRESS 0xc0000bd6 FORMAT "%6.2" /end MEASUREMENT
/begin MEASUREMENT Vtx_in_cam_ini_psn_redg[0] "Initial values of the angular positions of the camshaft wheel active edges " UWORD _CNV_A_R_LINEAR_____76_CM 1 0. 0. 719.98 ECU_ADDRESS 0xd0002cc4 FORMAT "%6.2" /end MEASUREMENT
/begin MEASUREMENT Vtx_in_cam_ini_psn_redg[1] "Initial values of the angular positions of the camshaft wheel active edges " UWORD _CNV_A_R_LINEAR_____76_CM 1 0. 0. 719.98 ECU_ADDRESS 0xd0002cc6 FORMAT "%6.2" /end MEASUREMENT
/begin MEASUREMENT Vtx_in_cam_ini_psn_redg[2] "Initial values of the angular positions of the camshaft wheel active edges " UWORD _CNV_A_R_LINEAR_____76_CM 1 0. 0. 719.98 ECU_ADDRESS 0xd0002cc8 FORMAT "%6.2" /end MEASUREMENT
/begin MEASUREMENT Vtx_in_cam_ini_psn_redg[3] "Initial values of the angular positions of the camshaft wheel active edges " UWORD _CNV_A_R_LINEAR_____76_CM 1 0. 0. 719.98 ECU_ADDRESS 0xd0002cca FORMAT "%6.2" /end MEASUREMENT
/begin MEASUREMENT Vtx_in_cam_mes_psn_redg[0] "Vector with measured angular positions of the camshaft wheel active edges" UWORD _CNV_A_R_LINEAR_____76_CM 1 0. 0. 719.98 ECU_ADDRESS 0xd0002ccc FORMAT "%6.2" /end MEASUREMENT
/begin MEASUREMENT Vtx_in_cam_mes_psn_redg[1] "Vector with measured angular positions of the camshaft wheel active edges" UWORD _CNV_A_R_LINEAR_____76_CM 1 0. 0. 719.98 ECU_ADDRESS 0xd0002cce FORMAT "%6.2" /end MEASUREMENT
/begin MEASUREMENT Vtx_in_cam_mes_psn_redg[2] "Vector with measured angular positions of the camshaft wheel active edges" UWORD _CNV_A_R_LINEAR_____76_CM 1 0. 0. 719.98 ECU_ADDRESS 0xd0002cd0 FORMAT "%6.2" /end MEASUREMENT
/begin MEASUREMENT Vtx_in_cam_mes_psn_redg[3] "Vector with measured angular positions of the camshaft wheel active edges" UWORD _CNV_A_R_LINEAR_____76_CM 1 0. 0. 719.98 ECU_ADDRESS 0xd0002cd2 FORMAT "%6.2" /end MEASUREMENT
/begin MEASUREMENT Vtx_in_cam_mv_psn_redg[0] "Vector with mean values of the angular positions of the camshaft wheel active edges" UWORD _CNV_A_R_LINEAR_____76_CM 1 0. 0. 719.98 ECU_ADDRESS 0xd0002cd4 FORMAT "%6.2" /end MEASUREMENT
/begin MEASUREMENT Vtx_in_cam_mv_psn_redg[1] "Vector with mean values of the angular positions of the camshaft wheel active edges" UWORD _CNV_A_R_LINEAR_____76_CM 1 0. 0. 719.98 ECU_ADDRESS 0xd0002cd6 FORMAT "%6.2" /end MEASUREMENT
/begin MEASUREMENT Vtx_in_cam_mv_psn_redg[2] "Vector with mean values of the angular positions of the camshaft wheel active edges" UWORD _CNV_A_R_LINEAR_____76_CM 1 0. 0. 719.98 ECU_ADDRESS 0xd0002cd8 FORMAT "%6.2" /end MEASUREMENT
/begin MEASUREMENT Vtx_in_cam_mv_psn_redg[3] "Vector with mean values of the angular positions of the camshaft wheel active edges" UWORD _CNV_A_R_LINEAR_____76_CM 1 0. 0. 719.98 ECU_ADDRESS 0xd0002cda FORMAT "%6.2" /end MEASUREMENT
/begin MEASUREMENT Vtx_in_cam_sum_psn_redg[0] "Vector with sum of the angular position of each camshaft wheel active edge during learning stage " ULONG _CNV_A_R_LINEAR_____76_CM 1 0. 0. 184320. ECU_ADDRESS 0xd0001490 FORMAT "%4.2" /end MEASUREMENT
/begin MEASUREMENT Vtx_in_cam_sum_psn_redg[1] "Vector with sum of the angular position of each camshaft wheel active edge during learning stage " ULONG _CNV_A_R_LINEAR_____76_CM 1 0. 0. 184320. ECU_ADDRESS 0xd0001494 FORMAT "%4.2" /end MEASUREMENT
/begin MEASUREMENT Vtx_in_cam_sum_psn_redg[2] "Vector with sum of the angular position of each camshaft wheel active edge during learning stage " ULONG _CNV_A_R_LINEAR_____76_CM 1 0. 0. 184320. ECU_ADDRESS 0xd0001498 FORMAT "%4.2" /end MEASUREMENT
/begin MEASUREMENT Vtx_in_cam_sum_psn_redg[3] "Vector with sum of the angular position of each camshaft wheel active edge during learning stage " ULONG _CNV_A_R_LINEAR_____76_CM 1 0. 0. 184320. ECU_ADDRESS 0xd000149c FORMAT "%4.2" /end MEASUREMENT
/begin MEASUREMENT Vxx_in_cam_angl_redg "Angular position of an active edge of the camshaft wheel (obtained from the engine position)" UWORD _CNV_A_R_LINEAR_____76_CM 1 0. 0. 719.98 ECU_ADDRESS 0xd0002cdc FORMAT "%6.2" /end MEASUREMENT
/begin MEASUREMENT Vxx_in_cam_ctr "Camshaft wheel tooth counter" UBYTE _CNV_A_R_ECME_LINEA_0_CM 1 0. 0. 3. ECU_ADDRESS 0xd0004150 FORMAT "%1.0" /end MEASUREMENT
/begin MEASUREMENT Vxx_in_cam_ctr_dft_psn "Counter of camshaft wheel learning with detection of the VVTC in default position" UBYTE _CNV_A_R_ECME_LINEA_0_CM 1 0. 0. 255. ECU_ADDRESS 0xd0004151 FORMAT "%3.0" /end MEASUREMENT
/begin MEASUREMENT Vxx_in_cam_ctr_phs_ad "Camshaft active edges during learning stage" UBYTE _CNV_A_R_ECME_LINEA_0_CM 1 0. 0. 255. ECU_ADDRESS 0xd0004152 FORMAT "%3.0" /end MEASUREMENT
/begin MEASUREMENT Vxx_in_cam_ctr_phs_ini_psn_redg "Counter used to detect one revolution of the camshaft during learning stage" UBYTE _CNV_A_R_ECME_LINEA_0_CM 1 0. 0. 3. ECU_ADDRESS 0xd0004153 FORMAT "%1.0" /end MEASUREMENT
/begin MEASUREMENT Vxx_in_cam_ctr_rest_ad_whl "Counter of camshaft wheel learning" UBYTE _CNV_A_R_ECME_LINEA_0_CM 1 0. 0. 255. ECU_ADDRESS 0xd0004154 FORMAT "%3.0" /end MEASUREMENT
/begin MEASUREMENT Vxx_in_cam_mes_psn_redg_0 "Measured angular position for active edge n∞0 (camshaft wheel)" UWORD _CNV_A_R_LINEAR_____76_CM 1 0. 0. 719.98 ECU_ADDRESS 0xd0002cde FORMAT "%6.2" /end MEASUREMENT
/begin MEASUREMENT Vxx_in_cam_mes_psn_redg_1 "Measured angular position for active edge n∞1 (camshaft wheel)" UWORD _CNV_A_R_LINEAR_____76_CM 1 0. 0. 719.98 ECU_ADDRESS 0xd0002ce0 FORMAT "%6.2" /end MEASUREMENT
/begin MEASUREMENT Vxx_in_cam_mes_psn_redg_2 "Measured angular position for active edge n∞2 (camshaft wheel)" UWORD _CNV_A_R_LINEAR_____76_CM 1 0. 0. 719.98 ECU_ADDRESS 0xd0002ce2 FORMAT "%6.2" /end MEASUREMENT
/begin MEASUREMENT Vxx_in_cam_mes_psn_redg_3 "Measured angular position for active edge n∞3 (camshaft wheel)" UWORD _CNV_A_R_LINEAR_____76_CM 1 0. 0. 719.98 ECU_ADDRESS 0xd0002ce4 FORMAT "%6.2" /end MEASUREMENT
/begin MEASUREMENT Vxx_in_cam_mv_psn_redg_0 "Mean value of angular position for active edge n∞0 (camshaft wheel)" UWORD _CNV_A_R_LINEAR_____76_CM 1 0. 0. 719.98 ECU_ADDRESS 0xd0002ce6 FORMAT "%6.2" /end MEASUREMENT
/begin MEASUREMENT Vxx_in_cam_mv_psn_redg_1 "Mean value of angular position for active edge n∞1 (camshaft wheel)" UWORD _CNV_A_R_LINEAR_____76_CM 1 0. 0. 719.98 ECU_ADDRESS 0xd0002ce8 FORMAT "%6.2" /end MEASUREMENT
/begin MEASUREMENT Vxx_in_cam_mv_psn_redg_2 "Mean value of angular position for active edge n∞2 (camshaft wheel)" UWORD _CNV_A_R_LINEAR_____76_CM 1 0. 0. 719.98 ECU_ADDRESS 0xd0002cea FORMAT "%6.2" /end MEASUREMENT
/begin MEASUREMENT Vxx_in_cam_mv_psn_redg_3 "Mean value of angular position for active edge n∞3 (camshaft wheel)" UWORD _CNV_A_R_LINEAR_____76_CM 1 0. 0. 719.98 ECU_ADDRESS 0xd0002cec FORMAT "%6.2" /end MEASUREMENT
/begin MEASUREMENT Vxx_in_cam_sum_psn_redg_0 "Sum of the angular positions for active edge n∞0 (camshaft wheel)" ULONG _CNV_A_R_LINEAR_____76_CM 1 0. 0. 184320. ECU_ADDRESS 0xd00014a0 FORMAT "%4.2" /end MEASUREMENT
/begin MEASUREMENT Vxx_in_cam_sum_psn_redg_1 "Sum of the angular positions for active edge n∞1 (camshaft wheel)" ULONG _CNV_A_R_LINEAR_____76_CM 1 0. 0. 184320. ECU_ADDRESS 0xd00014a4 FORMAT "%4.2" /end MEASUREMENT
/begin MEASUREMENT Vxx_in_cam_sum_psn_redg_2 "Sum of the angular positions for active edge n∞2 (camshaft wheel)" ULONG _CNV_A_R_LINEAR_____76_CM 1 0. 0. 184320. ECU_ADDRESS 0xd00014a8 FORMAT "%4.2" /end MEASUREMENT
/begin MEASUREMENT Vxx_in_cam_sum_psn_redg_3 "Sum of the angular positions for active edge n∞3 (camshaft wheel)" ULONG _CNV_A_R_LINEAR_____76_CM 1 0. 0. 184320. ECU_ADDRESS 0xd00014ac FORMAT "%4.2" /end MEASUREMENT
/begin MEASUREMENT Vxx_in_cam_vvtc_ol_ctl "PWM control applied after first camshaft wheel learning" UWORD _CNV_A_R_LINEAR_____94_CM 1 0. 0. 200. ECU_ADDRESS 0xd0002cee FORMAT "%6.2" /end MEASUREMENT
/begin MEASUREMENT Vxx_in_vvtc_angl "Angular position of the VVTC system (with safe modes)" UWORD _CNV_A_R_LINEAR_____76_CM 1 0. 0. 719.98 ECU_ADDRESS 0xd0002cf0 FORMAT "%6.2" /end MEASUREMENT
/begin MEASUREMENT Vxx_in_vvtc_angl_fil "Filtered value of the angular position of the VVTC system" UWORD _CNV_A_R_LINEAR_____76_CM 1 0. 0. 719.98 ECU_ADDRESS 0xd0002cf2 FORMAT "%6.2" /end MEASUREMENT
/begin MEASUREMENT Vxx_in_vvtc_angl_ftc "Time constant applied to filter the variable Vxx_in_vvtc_angl_mes_tmp" UWORD _CNV_A_R_LINEAR_____34_CM 1 0. 0. 655.35 ECU_ADDRESS 0xd0002cf4 FORMAT "%6.2" /end MEASUREMENT
/begin MEASUREMENT Vxx_in_vvtc_angl_mes "Angular position of the intake VVTC system (for closed loop control)" UWORD _CNV_A_R_LINEAR_____76_CM 1 0. 0. 719.98 ECU_ADDRESS 0xd0002cf6 FORMAT "%6.2" /end MEASUREMENT
/begin MEASUREMENT Vxx_in_vvtc_angl_mes_tmp "Intermediate variable to determine the angular position of the VVTC system (with safe modes)" UWORD _CNV_A_R_LINEAR_____76_CM 1 0. 0. 719.98 ECU_ADDRESS 0xd0002cf8 FORMAT "%6.2" /end MEASUREMENT
/begin MEASUREMENT Vxx_in_vvtc_angl_raw "Raw value of the (measured) angular position of the VVTC actuator" SWORD _CNV_A_R_LINEAR_____76_CM 1 0. -360. 360. ECU_ADDRESS 0xd0002cfa FORMAT "%7.2" /end MEASUREMENT
/begin MEASUREMENT Vxx_in_vvtc_ctr_dft_blk_frst_ad "Counter of camshaft wheel learning with a detection of a blocked VVTC" UBYTE _CNV_A_R_ECME_LINEA_0_CM 1 0. 0. 255. ECU_ADDRESS 0xd0004155 FORMAT "%3.0" /end MEASUREMENT
/begin MEASUREMENT Vxx_in_vvtc_ctr_mov_phs_ad_whl "Counter of camshaft learning with VVTC movement detected" UBYTE _CNV_A_R_ECME_LINEA_0_CM 1 0. 0. 255. ECU_ADDRESS 0xd0004156 FORMAT "%3.0" /end MEASUREMENT
/begin CHARACTERISTIC Cbx_in_cam_conf_sens_sig "Configuration of the camshaft sensor (= 1 signal reversing/ = 0 none)" VALUE 0xa00210f8 _REC_S1VAL_20_u1 1. _CNV_S_2_RANGE______3_CM 0. 1. BIT_MASK 0x1 /end CHARACTERISTIC
/begin CHARACTERISTIC Cbx_in_cam_ena_new_eprm_writ "Allow an EEPROM write at each end of Power Latch" VALUE 0xa00210f9 _REC_S1VAL_20_u1 1. _CNV_S_2_RANGE______3_CM 0. 1. BIT_MASK 0x1 /end CHARACTERISTIC
/begin CHARACTERISTIC Cbx_in_cam_ena_rest_ad_whl "Allow to restart the learning of the angular position of the camshaft wheel active edges (if a failure occurs during the current one)" VALUE 0xa00210fa _REC_S1VAL_20_u1 1. _CNV_S_2_RANGE______3_CM 0. 1. BIT_MASK 0x1 /end CHARACTERISTIC
/begin CHARACTERISTIC Cbx_in_cam_forc_ad_whl "Force the learning of the angular positions of the camshaft wheel active edges" VALUE 0xa00210fb _REC_S1VAL_20_u1 1. _CNV_S_2_RANGE______3_CM 0. 1. BIT_MASK 0x1 /end CHARACTERISTIC
/begin CHARACTERISTIC Cbx_in_cam_inh_ad_whl "Inhib learning of the camshaft wheel" VALUE 0xa00210fc _REC_S1VAL_20_u1 1. _CNV_S_2_RANGE______3_CM 0. 1. BIT_MASK 0x1 /end CHARACTERISTIC
/begin CHARACTERISTIC Cbx_in_cam_inh_ad_whl_eng_resta "Inhibition of new learnings of the camshaft wheel at engine start when one is stored in EEPROM" VALUE 0xa00210fd _REC_S1VAL_20_u1 1. _CNV_S_2_RANGE______3_CM 0. 1. BIT_MASK 0x1 /end CHARACTERISTIC
/begin CHARACTERISTIC Cbx_in_cam_inh_cmp_aftr_frst_ad "Inhibition of the comparison of measured and reference values when a first storage in Eeprom  is performed" VALUE 0xa00210fe _REC_S1VAL_20_u1 1. _CNV_S_2_RANGE______3_CM 0. 1. BIT_MASK 0x1 /end CHARACTERISTIC
/begin CHARACTERISTIC Cbx_in_vvtc_actr_cfm "Retard/advance actuator configuration(=0 for retard / =1 for advance)" VALUE 0xa00210ff _REC_S1VAL_20_u1 1. _CNV_S_2_RANGE______3_CM 0. 1. BIT_MASK 0x1 /end CHARACTERISTIC
/begin CHARACTERISTIC Ctx_in_cam_ref_psn_redg[0] "Array with the reference (pre-determined) angular positions of the 4 camshaft wheel active edges" VALUE 0xa00210cc _REC_S1VAL_20_u2 719.98 _CNV_A_R_LINEAR_____76_CM 0. 719.98 FORMAT "%6.2" /end CHARACTERISTIC
/begin CHARACTERISTIC Ctx_in_cam_ref_psn_redg[1] "Array with the reference (pre-determined) angular positions of the 4 camshaft wheel active edges" VALUE 0xa00210ce _REC_S1VAL_20_u2 719.98 _CNV_A_R_LINEAR_____76_CM 0. 719.98 FORMAT "%6.2" /end CHARACTERISTIC
/begin CHARACTERISTIC Ctx_in_cam_ref_psn_redg[2] "Array with the reference (pre-determined) angular positions of the 4 camshaft wheel active edges" VALUE 0xa00210d0 _REC_S1VAL_20_u2 719.98 _CNV_A_R_LINEAR_____76_CM 0. 719.98 FORMAT "%6.2" /end CHARACTERISTIC
/begin CHARACTERISTIC Ctx_in_cam_ref_psn_redg[3] "Array with the reference (pre-determined) angular positions of the 4 camshaft wheel active edges" VALUE 0xa00210d2 _REC_S1VAL_20_u2 719.98 _CNV_A_R_LINEAR_____76_CM 0. 719.98 FORMAT "%6.2" /end CHARACTERISTIC
/begin CHARACTERISTIC Cxx_in_cam_angl_max_flu "Maximum fluctuation on the relative angular position of the VVTC during the learning stage of the camshaft wheel" VALUE 0xa00210d4 _REC_S1VAL_20_u2 719.98 _CNV_A_R_LINEAR_____76_CM 0. 719.98 FORMAT "%6.2" /end CHARACTERISTIC
/begin CHARACTERISTIC Cxx_in_cam_angl_redg_shf "Offset to apply on the camshaft wheel actives angular position in order to avoid that the values cross the cranshaft reference position" VALUE 0xa00210d6 _REC_S1VAL_20_s2 720. _CNV_A_R_LINEAR_____76_CM -360. 360. FORMAT "%7.2" /end CHARACTERISTIC
/begin CHARACTERISTIC Cxx_in_cam_ctr_dft_psn "Number of camshaft wheel learnings before detecting a default position of the VVTC" VALUE 0xa0021100 _REC_S1VAL_20_u1 255. _CNV_A_R_ECME_LINEA_0_CM 0. 255. FORMAT "%3.0" /end CHARACTERISTIC
/begin CHARACTERISTIC Cxx_in_cam_dly_sta_ad_whl "Delay after engine start to allow learning of the angular positions of the camhaft wheel active edges" VALUE 0xa00210d8 _REC_S1VAL_20_u2 65.535 _CNV_A_R_LINEAR_____58_CM 0. 65.535 FORMAT "%5.3" /end CHARACTERISTIC
/begin CHARACTERISTIC Cxx_in_cam_eprm_psn_dev "Maximum difference between the measured angular positions of the camshaft wheel actives edges and the values stored in Eeprom" VALUE 0xa00210da _REC_S1VAL_20_u2 719.98 _CNV_A_R_LINEAR_____76_CM 0. 719.98 FORMAT "%6.2" /end CHARACTERISTIC
/begin CHARACTERISTIC Cxx_in_cam_max_n_inh_ad_whl "Maximun engine speed to inhib the learning of the camshaft wheel (when engine running)" VALUE 0xa00210dc _REC_S1VAL_20_u2 16383.75 _CNV_A_R_ENSD_LINEA_24_CM 0. 16383.75 FORMAT "%8.2" /end CHARACTERISTIC
/begin CHARACTERISTIC Cxx_in_cam_min_n_ena_ad_whl "Minimum engine speed, after start, to allow the learning of the camshaft wheel" VALUE 0xa00210de _REC_S1VAL_20_u2 16383.75 _CNV_A_R_ENSD_LINEA_24_CM 0. 16383.75 FORMAT "%8.2" /end CHARACTERISTIC
/begin CHARACTERISTIC Cxx_in_cam_nr_rev "Number of camshaft revolutions (for learning stage)" VALUE 0xa0021101 _REC_S1VAL_20_u1 255. _CNV_A_R_ECME_LINEA_0_CM 0. 255. FORMAT "%3.0" /end CHARACTERISTIC
/begin CHARACTERISTIC Cxx_in_cam_ref_psn_dev "Maximum difference between the measured angular positions of the camshaft wheel actives edges and reference angular positions" VALUE 0xa00210e0 _REC_S1VAL_20_u2 719.98 _CNV_A_R_LINEAR_____76_CM 0. 719.98 FORMAT "%6.2" /end CHARACTERISTIC
/begin CHARACTERISTIC Cxx_in_cam_t_new_ad_whl "Minimum period to allow a new learning of the camhaft wheel (with engine running)" VALUE 0xa00210e2 _REC_S1VAL_20_u2 655.35 _CNV_A_R_LINEAR_____34_CM 0. 655.35 FORMAT "%6.2" /end CHARACTERISTIC
/begin CHARACTERISTIC Cxx_in_cam_tdc_ctr_0 "TDC counter of tooth (counter = zero) / calibration for CAM counter initialisation" VALUE 0xa0021102 _REC_S1VAL_20_u1 3. _CNV_A_R_ECME_LINEA_0_CM 0. 3. FORMAT "%1.0" /end CHARACTERISTIC
/begin CHARACTERISTIC Cxx_in_cam_tdc_ctr_1 "TDC counter of tooth (counter = one) / calibration for CAM counter initialisation" VALUE 0xa0021103 _REC_S1VAL_20_u1 3. _CNV_A_R_ECME_LINEA_0_CM 0. 3. FORMAT "%1.0" /end CHARACTERISTIC
/begin CHARACTERISTIC Cxx_in_cam_tdc_ctr_2 "TDC counter of tooth (counter = two) / calibration for CAM counter initialisation" VALUE 0xa0021104 _REC_S1VAL_20_u1 3. _CNV_A_R_ECME_LINEA_0_CM 0. 3. FORMAT "%1.0" /end CHARACTERISTIC
/begin CHARACTERISTIC Cxx_in_cam_tdc_ctr_3 "TDC counter of tooth (counter = three) / calibration for CAM counter initialisation" VALUE 0xa0021105 _REC_S1VAL_20_u1 3. _CNV_A_R_ECME_LINEA_0_CM 0. 3. FORMAT "%1.0" /end CHARACTERISTIC
/begin CHARACTERISTIC Cxx_in_cam_vvtc_ol_ctl_inc "Increment of the open control applied after first camshaft wheel learning" VALUE 0xa00210e4 _REC_S1VAL_20_u2 200. _CNV_A_R_LINEAR_____94_CM 0. 200. FORMAT "%6.2" /end CHARACTERISTIC
/begin CHARACTERISTIC Cxx_in_vvtc_angl_mes_h_ftc "Time constant for high filtering in steady state of the VVTC angular position" VALUE 0xa00210e6 _REC_S1VAL_20_u2 655.35 _CNV_A_R_LINEAR_____34_CM 0. 655.35 FORMAT "%6.2" /end CHARACTERISTIC
/begin CHARACTERISTIC Cxx_in_vvtc_angl_mes_l_ftc "Time constant for low filtering in steady state of the VVTC angular position" VALUE 0xa00210e8 _REC_S1VAL_20_u2 655.35 _CNV_A_R_LINEAR_____34_CM 0. 655.35 FORMAT "%6.2" /end CHARACTERISTIC
/begin CHARACTERISTIC Cxx_in_vvtc_angl_mes_thd "Threshold to consider not valid the measured angular position of the VVTC" VALUE 0xa00210ea _REC_S1VAL_20_u2 719.98 _CNV_A_R_LINEAR_____76_CM 0. 719.98 FORMAT "%6.2" /end CHARACTERISTIC
/begin CHARACTERISTIC Cxx_in_vvtc_ctr_dft_blk_fsrt_ad "Number of camshaft wheel learnings allowed with a blocked VVTC before detection of a failure" VALUE 0xa0021106 _REC_S1VAL_20_u1 255. _CNV_A_R_ECME_LINEA_0_CM 0. 255. FORMAT "%3.0" /end CHARACTERISTIC
/begin CHARACTERISTIC Cxx_in_vvtc_ctr_mov_phs_ad_whl "Number of camshaft wheel learnings allowed with a VVTC movement before detection of a failure" VALUE 0xa0021107 _REC_S1VAL_20_u1 255. _CNV_A_R_ECME_LINEA_0_CM 0. 255. FORMAT "%3.0" /end CHARACTERISTIC
/begin CHARACTERISTIC Cxx_in_vvtc_ftc_trs_thd "Threshold for enabling high filtering of the measured VVTC angular position" VALUE 0xa00210ec _REC_S1VAL_20_u2 719.98 _CNV_A_R_LINEAR_____76_CM 0. 719.98 FORMAT "%6.2" /end CHARACTERISTIC
/begin CHARACTERISTIC Cxx_in_vvtc_sp_ftc "Time constant to filter setpoint (to simulate VVTC transient dynamic)" VALUE 0xa00210ee _REC_S1VAL_20_u2 655.35 _CNV_A_R_LINEAR_____34_CM 0. 655.35 FORMAT "%6.2" /end CHARACTERISTIC
/begin CHARACTERISTIC Cxx_in_vvtc_t_dft_psn "Number of camshaft wheel learnings allowed with a VVTC movement before detection of a failure" VALUE 0xa00210f0 _REC_S1VAL_20_u2 655.35 _CNV_A_R_LINEAR_____34_CM 0. 655.35 FORMAT "%6.2" /end CHARACTERISTIC
/begin CHARACTERISTIC Cxx_in_vvtc_t_pwm_nul "Duration without contol of the VVTC (the system can be considered in the default position stopper)" VALUE 0xa00210f2 _REC_S1VAL_20_u2 655.35 _CNV_A_R_LINEAR_____34_CM 0. 655.35 FORMAT "%6.2" /end CHARACTERISTIC
/begin CHARACTERISTIC Cxx_in_vvtc_t_vld_dft_psn "Duration to confirm that VVTC is in its default position (information used by the basic software for CAM/CRAN coherence diagnosis)" VALUE 0xa00210f4 _REC_S1VAL_20_u2 655.35 _CNV_A_R_LINEAR_____34_CM 0. 655.35 FORMAT "%6.2" /end CHARACTERISTIC
/begin CHARACTERISTIC Cxx_in_vvtc_thd_dft_psn "Threshold on the VVTC measured angular position to determinate the information \"VVTC in default position\"" VALUE 0xa00210f6 _REC_S1VAL_20_u2 719.98 _CNV_A_R_LINEAR_____76_CM 0. 719.98 FORMAT "%6.2" /end CHARACTERISTIC
/begin AXIS_PTS Ctb_cata_wup_sta_tco "Starting water temperature breakpoints for catalyst warm-up" 0xa00291d8 Vxx_sta_tco _REC_A2AXS_20_u2 240. _CNV_A_R_LINEAR_____54_CM 10 -40. 200. FORMAT "%5.1" /end AXIS_PTS
/begin AXIS_PTS Ntb_cata_wup_phs_order "Breakpoints [1 2 3 4 5 6 7 8 9 10 11 12 13 14 15] for the order of the warm-up phases" 0xa002934c Vxx_cata_wup_phs_nr _REC_A2AXS_20_u1 14. _CNV_A_R_ECME_LINEA_0_CM 15 1. 15. READ_ONLY FORMAT "%3.0" /end AXIS_PTS
/begin AXIS_PTS Ntb_fuel_typ_zon "Breakpoints for the zones of fuel type" 0xa0020ed4 Vsx_wup_fuel_typ _REC_A2AXS_20_u1 2. _CNV_A_R_ECME_LINEA_0_CM 3 1. 3. READ_ONLY FORMAT "%1.0" /end AXIS_PTS
/begin CHARACTERISTIC Cmp_cata_wup_cold "Duration of the 'Cold start conditions' phase function of the chosen tuning and the initial water temperature" MAP 0xa00291f0 _REC_A1MAP_20_u2_u1_u2 65535. _CNV_A_R_LINEAR_____55_CM 0. 65535. FORMAT "%5.0"
 /begin AXIS_DESCR COM_AXIS Vsx_wup_fuel_typ _CNV_A_R_ECME_LINEA_0_CM 3 1. 3. READ_ONLY FORMAT "%1.0" AXIS_PTS_REF Ntb_fuel_typ_zon /end AXIS_DESCR
 /begin AXIS_DESCR COM_AXIS Vxx_sta_tco _CNV_A_R_LINEAR_____54_CM 10 -40. 200. FORMAT "%5.1" AXIS_PTS_REF Ctb_cata_wup_sta_tco /end AXIS_DESCR
/end CHARACTERISTIC
/begin CHARACTERISTIC Cmp_cata_wup_dstb "Duration of the 'Richness distribution' phase function of the chosen tuning and the initial water temperature" MAP 0xa002922c _REC_A1MAP_20_u2_u1_u2 65535. _CNV_A_R_LINEAR_____55_CM 0. 65535. FORMAT "%5.0"
 /begin AXIS_DESCR COM_AXIS Vsx_wup_fuel_typ _CNV_A_R_ECME_LINEA_0_CM 3 1. 3. READ_ONLY FORMAT "%1.0" AXIS_PTS_REF Ntb_fuel_typ_zon /end AXIS_DESCR
 /begin AXIS_DESCR COM_AXIS Vxx_sta_tco _CNV_A_R_LINEAR_____54_CM 10 -40. 200. FORMAT "%5.1" AXIS_PTS_REF Ctb_cata_wup_sta_tco /end AXIS_DESCR
/end CHARACTERISTIC
/begin CHARACTERISTIC Cmp_cata_wup_eng "Duration of the 'Catalyst heating' phase function of the chosen tuning and the initial water temperature" MAP 0xa0029268 _REC_A1MAP_20_u2_u1_u2 65535. _CNV_A_R_LINEAR_____55_CM 0. 65535. FORMAT "%5.0"
 /begin AXIS_DESCR COM_AXIS Vsx_wup_fuel_typ _CNV_A_R_ECME_LINEA_0_CM 3 1. 3. READ_ONLY FORMAT "%1.0" AXIS_PTS_REF Ntb_fuel_typ_zon /end AXIS_DESCR
 /begin AXIS_DESCR COM_AXIS Vxx_sta_tco _CNV_A_R_LINEAR_____54_CM 10 -40. 200. FORMAT "%5.1" AXIS_PTS_REF Ctb_cata_wup_sta_tco /end AXIS_DESCR
/end CHARACTERISTIC
/begin CHARACTERISTIC Cmp_cata_wup_lean "Duration of the 'Lean mixture' phase function of the chosen tuning and the initial water temperature" MAP 0xa00292a4 _REC_A1MAP_20_u2_u1_u2 65535. _CNV_A_R_LINEAR_____55_CM 0. 65535. FORMAT "%5.0"
 /begin AXIS_DESCR COM_AXIS Vsx_wup_fuel_typ _CNV_A_R_ECME_LINEA_0_CM 3 1. 3. READ_ONLY FORMAT "%1.0" AXIS_PTS_REF Ntb_fuel_typ_zon /end AXIS_DESCR
 /begin AXIS_DESCR COM_AXIS Vxx_sta_tco _CNV_A_R_LINEAR_____54_CM 10 -40. 200. FORMAT "%5.1" AXIS_PTS_REF Ctb_cata_wup_sta_tco /end AXIS_DESCR
/end CHARACTERISTIC
/begin CHARACTERISTIC Cmp_comp_wup "Duration of the 'Compartment heating' phase function of the chosen tuning and the initial water temperature" MAP 0xa00292e0 _REC_A1MAP_20_u2_u1_u2 65535. _CNV_A_R_LINEAR_____55_CM 0. 65535. FORMAT "%5.0"
 /begin AXIS_DESCR COM_AXIS Vsx_wup_fuel_typ _CNV_A_R_ECME_LINEA_0_CM 3 1. 3. READ_ONLY FORMAT "%1.0" AXIS_PTS_REF Ntb_fuel_typ_zon /end AXIS_DESCR
 /begin AXIS_DESCR COM_AXIS Vxx_sta_tco _CNV_A_R_LINEAR_____54_CM 10 -40. 200. FORMAT "%5.1" AXIS_PTS_REF Ctb_cata_wup_sta_tco /end AXIS_DESCR
/end CHARACTERISTIC
/begin CHARACTERISTIC Ctd_cata_wup_phs_order1 "Order of the catalyst warm-up phases in fuel zone 1" CURVE 0xa002931c _REC_A1CUR_20_u1_u1 70. _CNV_A_R_LINEAR_____374_CM 0. 70. FORMAT "%2.0"
 /begin AXIS_DESCR COM_AXIS Vxx_cata_wup_phs_nr _CNV_A_R_ECME_LINEA_0_CM 15 1. 15. READ_ONLY FORMAT "%3.0" AXIS_PTS_REF Ntb_cata_wup_phs_order /end AXIS_DESCR
/end CHARACTERISTIC
/begin CHARACTERISTIC Ctd_cata_wup_phs_order2 "Order of the catalyst warm-up phases in fuel zone 2" CURVE 0xa002932c _REC_A1CUR_20_u1_u1 70. _CNV_A_R_LINEAR_____374_CM 0. 70. FORMAT "%2.0"
 /begin AXIS_DESCR COM_AXIS Vxx_cata_wup_phs_nr _CNV_A_R_ECME_LINEA_0_CM 15 1. 15. READ_ONLY FORMAT "%3.0" AXIS_PTS_REF Ntb_cata_wup_phs_order /end AXIS_DESCR
/end CHARACTERISTIC
/begin CHARACTERISTIC Ctd_cata_wup_phs_order3 "Order of the catalyst warm-up phases in fuel zone 3" CURVE 0xa002933c _REC_A1CUR_20_u1_u1 70. _CNV_A_R_LINEAR_____374_CM 0. 70. FORMAT "%2.0"
 /begin AXIS_DESCR COM_AXIS Vxx_cata_wup_phs_nr _CNV_A_R_ECME_LINEA_0_CM 15 1. 15. READ_ONLY FORMAT "%3.0" AXIS_PTS_REF Ntb_cata_wup_phs_order /end AXIS_DESCR
/end CHARACTERISTIC
/begin MEASUREMENT Vbx_cata_rich_dstb_efv "richness distribution between cylinders is enabled" UBYTE _CNV_S_2_RANGE______3_CM 1 0. 0. 1. ECU_ADDRESS 0xd0005265 BIT_MASK 0x1 /end MEASUREMENT
/begin MEASUREMENT Vbx_cata_wup_phs_cge "Detection of change of warm-up phase" UBYTE _CNV_S_2_RANGE______3_CM 1 0. 0. 1. ECU_ADDRESS 0xd0005266 BIT_MASK 0x1 /end MEASUREMENT
/begin MEASUREMENT Vsx_cata_wup_phs "State of catalist warm-up" UBYTE _CNV_A_R_ECME_LINEA_0_CM 1 0. 0. 70. ECU_ADDRESS 0xd0003fd8 FORMAT "%3.0" /end MEASUREMENT
/begin MEASUREMENT Vsx_cata_wup_phs_req "Requested state of catalyst warm-up" UBYTE _CNV_A_R_ECME_LINEA_0_CM 1 0. 0. 70. ECU_ADDRESS 0xd0005267 FORMAT "%3.0" /end MEASUREMENT
/begin MEASUREMENT Vxx_cata_wup_ctr "TDC counter used to manage warm up sequences." UWORD _CNV_A_R_LINEAR_____55_CM 1 0. 0. 65535. ECU_ADDRESS 0xd0002ee0 FORMAT "%5.0" /end MEASUREMENT
/begin MEASUREMENT Vxx_cata_wup_ctr_clc "TDC counter which represents the duration of each warm-up phase" UWORD _CNV_A_R_LINEAR_____55_CM 1 0. 0. 65535. ECU_ADDRESS 0xd00059cc FORMAT "%5.0" /end MEASUREMENT
/begin MEASUREMENT Vxx_cata_wup_phs_ctr "Total duration of the current warm-up phase" UWORD _CNV_A_R_LINEAR_____55_CM 1 0. 0. 65535. ECU_ADDRESS 0xd00059ce FORMAT "%5.0" /end MEASUREMENT
/begin MEASUREMENT Vxx_cata_wup_phs_nr "Number of the current warm-up phase" UBYTE _CNV_A_R_ECME_LINEA_0_CM 1 0. 1. 15. ECU_ADDRESS 0xd0005268 FORMAT "%3.0" /end MEASUREMENT
/begin CHARACTERISTIC Cbx_cata_wup_vvt_on "Activation of VVT strategy linked to catalyst warm-up" VALUE 0xa0020ed8 _REC_S1VAL_20_u1 1. _CNV_S_2_RANGE______3_CM 0. 1. BIT_MASK 0x1 /end CHARACTERISTIC
/begin CHARACTERISTIC Cbx_wup_stop_ac "To authorize the exit ot the catalyst warm-up sequences on air conditioning request" VALUE 0xa0020ed9 _REC_S1VAL_20_u1 1. _CNV_S_2_RANGE______3_CM 0. 1. BIT_MASK 0x1 /end CHARACTERISTIC
/begin CHARACTERISTIC Cxx_cata_wup_dstb_n_max "Maximun engine speed inhibiting the richness distribution" VALUE 0xa0020ecc _REC_S1VAL_20_u2 16383.75 _CNV_A_R_ENSD_LINEA_24_CM 0. 16383.75 FORMAT "%8.2" /end CHARACTERISTIC
/begin CHARACTERISTIC Cxx_cata_wup_dstb_ofs "Offset to substract from the duration of the richness distribution phase when idle speed is active" VALUE 0xa0020ece _REC_S1VAL_20_u2 65535. _CNV_A_R_LINEAR_____55_CM 0. 65535. FORMAT "%5.0" /end CHARACTERISTIC
/begin CHARACTERISTIC Cxx_cata_wup_dstb_prs_max "Maximal manifold pressure inhibiting the richness distribution" VALUE 0xa0020ed0 _REC_S1VAL_20_u2 20000. _CNV_A_R_LINEAR_____57_CM 0. 20000. FORMAT "%5.0" /end CHARACTERISTIC
/begin CHARACTERISTIC Cxx_cata_wup_dstb_prs_min "Minimal manifold pressure inhibiting the richness distribution" VALUE 0xa0020ed2 _REC_S1VAL_20_u2 20000. _CNV_A_R_LINEAR_____57_CM 0. 20000. FORMAT "%5.0" /end CHARACTERISTIC
/begin MEASUREMENT Vxx_cata_lbdw_mes_rtn "Backup value of the catalyst diagnostic criteria" UWORD _CNV_A_R_ECME_LINEA_0_CM 1 0. 0. 65535. DISPLAY_IDENTIFIER AtCatDgn_NVM.Vxx_cata_lbdw_mes_rtn_NVM ECU_ADDRESS 0xd0002e84 FORMAT "%5.0" /end MEASUREMENT
/begin MEASUREMENT Vxx_cata_fail_thd_rtn "Backup value of the catalyst failure threshold" UBYTE _CNV_A_R_ECME_LINEA_0_CM 1 0. 0. 255. DISPLAY_IDENTIFIER AtCatDgn_NVM.Vxx_cata_fail_thd_rtn_NVM ECU_ADDRESS 0xd0002e86 FORMAT "%3.0" /end MEASUREMENT
/begin MEASUREMENT Vtx_in_mem_cata_cpt[0] "Number of times the system enters in each diagnosis conditions" UWORD _CNV_A_R_ECME_LINEA_0_CM 1 0. 0. 65535. DISPLAY_IDENTIFIER AtCatDgn_NVM.Vtx_in_mem_cata_cpt_NVM[0] ECU_ADDRESS 0xd0002e88 FORMAT "%5.0" /end MEASUREMENT
/begin MEASUREMENT Vtx_in_mem_cata_cpt[1] "Number of times the system enters in each diagnosis conditions" UWORD _CNV_A_R_ECME_LINEA_0_CM 1 0. 0. 65535. DISPLAY_IDENTIFIER AtCatDgn_NVM.Vtx_in_mem_cata_cpt_NVM[1] ECU_ADDRESS 0xd0002e8a FORMAT "%5.0" /end MEASUREMENT
/begin MEASUREMENT Vtx_in_mem_cata_cpt[2] "Number of times the system enters in each diagnosis conditions" UWORD _CNV_A_R_ECME_LINEA_0_CM 1 0. 0. 65535. DISPLAY_IDENTIFIER AtCatDgn_NVM.Vtx_in_mem_cata_cpt_NVM[2] ECU_ADDRESS 0xd0002e8c FORMAT "%5.0" /end MEASUREMENT
/begin MEASUREMENT Vtx_in_mem_cata_cpt[3] "Number of times the system enters in each diagnosis conditions" UWORD _CNV_A_R_ECME_LINEA_0_CM 1 0. 0. 65535. DISPLAY_IDENTIFIER AtCatDgn_NVM.Vtx_in_mem_cata_cpt_NVM[3] ECU_ADDRESS 0xd0002e8e FORMAT "%5.0" /end MEASUREMENT
/begin MEASUREMENT Vtx_in_mem_cata_cpt[4] "Number of times the system enters in each diagnosis conditions" UWORD _CNV_A_R_ECME_LINEA_0_CM 1 0. 0. 65535. DISPLAY_IDENTIFIER AtCatDgn_NVM.Vtx_in_mem_cata_cpt_NVM[4] ECU_ADDRESS 0xd0002e90 FORMAT "%5.0" /end MEASUREMENT
/begin MEASUREMENT Vtx_mem_crit_cata_cpt[0] "Number of criteria calculated by resolution" UWORD _CNV_A_R_ECME_LINEA_0_CM 1 0. 0. 65535. DISPLAY_IDENTIFIER AtCatDgn_NVM.Vtx_mem_crit_cata_cpt_NVM[0] ECU_ADDRESS 0xd0002e94 FORMAT "%5.0" /end MEASUREMENT
/begin MEASUREMENT Vtx_mem_crit_cata_cpt[1] "Number of criteria calculated by resolution" UWORD _CNV_A_R_ECME_LINEA_0_CM 1 0. 0. 65535. DISPLAY_IDENTIFIER AtCatDgn_NVM.Vtx_mem_crit_cata_cpt_NVM[1] ECU_ADDRESS 0xd0002e96 FORMAT "%5.0" /end MEASUREMENT
/begin MEASUREMENT Vtx_mem_crit_cata_cpt[2] "Number of criteria calculated by resolution" UWORD _CNV_A_R_ECME_LINEA_0_CM 1 0. 0. 65535. DISPLAY_IDENTIFIER AtCatDgn_NVM.Vtx_mem_crit_cata_cpt_NVM[2] ECU_ADDRESS 0xd0002e98 FORMAT "%5.0" /end MEASUREMENT
/begin MEASUREMENT Vtx_mem_crit_cata_cpt[3] "Number of criteria calculated by resolution" UWORD _CNV_A_R_ECME_LINEA_0_CM 1 0. 0. 65535. DISPLAY_IDENTIFIER AtCatDgn_NVM.Vtx_mem_crit_cata_cpt_NVM[3] ECU_ADDRESS 0xd0002e9a FORMAT "%5.0" /end MEASUREMENT
/begin MEASUREMENT Vtx_mem_crit_cata_cpt[4] "Number of criteria calculated by resolution" UWORD _CNV_A_R_ECME_LINEA_0_CM 1 0. 0. 65535. DISPLAY_IDENTIFIER AtCatDgn_NVM.Vtx_mem_crit_cata_cpt_NVM[4] ECU_ADDRESS 0xd0002e9c FORMAT "%5.0" /end MEASUREMENT
/begin MEASUREMENT Vtx_mem_crit_cata_cpt[5] "Number of criteria calculated by resolution" UWORD _CNV_A_R_ECME_LINEA_0_CM 1 0. 0. 65535. DISPLAY_IDENTIFIER AtCatDgn_NVM.Vtx_mem_crit_cata_cpt_NVM[5] ECU_ADDRESS 0xd0002e9e FORMAT "%5.0" /end MEASUREMENT
/begin MEASUREMENT Vtx_mem_crit_cata_cpt[6] "Number of criteria calculated by resolution" UWORD _CNV_A_R_ECME_LINEA_0_CM 1 0. 0. 65535. DISPLAY_IDENTIFIER AtCatDgn_NVM.Vtx_mem_crit_cata_cpt_NVM[6] ECU_ADDRESS 0xd0002ea0 FORMAT "%5.0" /end MEASUREMENT
/begin MEASUREMENT Vtx_out_mem_cata_cpt[0] "Number of times the system quits each diagnosis conditions" UWORD _CNV_A_R_ECME_LINEA_0_CM 1 0. 0. 65535. DISPLAY_IDENTIFIER AtCatDgn_NVM.Vtx_out_mem_cata_cpt_NVM[0] ECU_ADDRESS 0xd0002ea4 FORMAT "%5.0" /end MEASUREMENT
/begin MEASUREMENT Vtx_out_mem_cata_cpt[1] "Number of times the system quits each diagnosis conditions" UWORD _CNV_A_R_ECME_LINEA_0_CM 1 0. 0. 65535. DISPLAY_IDENTIFIER AtCatDgn_NVM.Vtx_out_mem_cata_cpt_NVM[1] ECU_ADDRESS 0xd0002ea6 FORMAT "%5.0" /end MEASUREMENT
/begin MEASUREMENT Vtx_out_mem_cata_cpt[2] "Number of times the system quits each diagnosis conditions" UWORD _CNV_A_R_ECME_LINEA_0_CM 1 0. 0. 65535. DISPLAY_IDENTIFIER AtCatDgn_NVM.Vtx_out_mem_cata_cpt_NVM[2] ECU_ADDRESS 0xd0002ea8 FORMAT "%5.0" /end MEASUREMENT
/begin MEASUREMENT Vtx_out_mem_cata_cpt[3] "Number of times the system quits each diagnosis conditions" UWORD _CNV_A_R_ECME_LINEA_0_CM 1 0. 0. 65535. DISPLAY_IDENTIFIER AtCatDgn_NVM.Vtx_out_mem_cata_cpt_NVM[3] ECU_ADDRESS 0xd0002eaa FORMAT "%5.0" /end MEASUREMENT
/begin MEASUREMENT Vtx_out_mem_cata_cpt[4] "Number of times the system quits each diagnosis conditions" UWORD _CNV_A_R_ECME_LINEA_0_CM 1 0. 0. 65535. DISPLAY_IDENTIFIER AtCatDgn_NVM.Vtx_out_mem_cata_cpt_NVM[4] ECU_ADDRESS 0xd0002eac FORMAT "%5.0" /end MEASUREMENT
/begin MEASUREMENT Vxx_nr_dc_cdn_ok_cata_cpt_NVM "Number of driving cycle with diagnosis done" UWORD _CNV_A_R_ECME_LINEA_0_CM 1 0. 0. 65535. DISPLAY_IDENTIFIER AtCatDgn_NVM.Vxx_nr_dc_cdn_ok_cata_cpt_NVM ECU_ADDRESS 0xd0002eae FORMAT "%5.0" /end MEASUREMENT
/begin MEASUREMENT Vxx_t_mv_cdn_ok_cata_cpt_NVM "Average of the maximum durations in diagnosis conditions without diagnosis done" UBYTE _CNV_A_R_LINEAR_____267_CM 1 0. 0. 63.75 DISPLAY_IDENTIFIER AtCatDgn_NVM.Vxx_t_mv_cdn_ok_cata_cpt_NVM ECU_ADDRESS 0xd0002eb0 FORMAT "%5.2" /end MEASUREMENT
/begin AXIS_PTS Ntb_cata_maf "17 Break point for the \"Vxx_pump_maf_fil_cata\" interpolation" 0xa00284ec Vxx_pump_maf_fil_cata _REC_A2AXS_20_u2 3000. _CNV_A_R_LINEAR_____109_CM 17 0. 3000. READ_ONLY FORMAT "%4.3" /end AXIS_PTS
/begin CHARACTERISTIC Ctp_cata_lbdw_max_maf "Threshold of fault detection f(Filtered amount of air pumped into cylinder)" CURVE 0xa0028510 _REC_A1CUR_20_u1_u2 255. _CNV_A_R_ECME_LINEA_0_CM 0. 255. FORMAT "%3.0"
 /begin AXIS_DESCR COM_AXIS Vxx_pump_maf_fil_cata _CNV_A_R_LINEAR_____109_CM 17 0. 3000. READ_ONLY FORMAT "%4.3" AXIS_PTS_REF Ntb_cata_maf /end AXIS_DESCR
/end CHARACTERISTIC
/begin CHARACTERISTIC Ctp_cata_lbdw_max_maf_alco "Threshold of fault detection f(Filtered amount of air pumped into cylinder) in alcohol" CURVE 0xa0028524 _REC_A1CUR_20_u1_u2 255. _CNV_A_R_ECME_LINEA_0_CM 0. 255. FORMAT "%3.0"
 /begin AXIS_DESCR COM_AXIS Vxx_pump_maf_fil_cata _CNV_A_R_LINEAR_____109_CM 17 0. 3000. READ_ONLY FORMAT "%4.3" AXIS_PTS_REF Ntb_cata_maf /end AXIS_DESCR
/end CHARACTERISTIC
/begin CHARACTERISTIC Ctp_cata_ol_per_dly_maf "Duration of the half periode of the richness at the beginning of the open loop regulation." CURVE 0xa0028538 _REC_A1CUR_20_u1_u2 2.55 _CNV_A_R_LINEAR_____34_CM 0. 2.55 FORMAT "%4.2"
 /begin AXIS_DESCR COM_AXIS Vxx_pump_maf_fil_cata _CNV_A_R_LINEAR_____109_CM 17 0. 3000. READ_ONLY FORMAT "%4.3" AXIS_PTS_REF Ntb_cata_maf /end AXIS_DESCR
/end CHARACTERISTIC
/begin CHARACTERISTIC Ctp_cata_ol_per_dly_maf_alco "Duration of the half periode of the richness at the beginning of the open loop regulation in alcohol" CURVE 0xa002854c _REC_A1CUR_20_u2_u2 655.35 _CNV_A_R_LINEAR_____34_CM 0. 655.35 FORMAT "%6.2"
 /begin AXIS_DESCR COM_AXIS Vxx_pump_maf_fil_cata _CNV_A_R_LINEAR_____109_CM 17 0. 3000. READ_ONLY FORMAT "%4.3" AXIS_PTS_REF Ntb_cata_maf /end AXIS_DESCR
/end CHARACTERISTIC
/begin MEASUREMENT Vbx_cata_diag_stop "Catalyst diagnostic is complete" UBYTE _CNV_S_2_RANGE______3_CM 1 0. 0. 1. ECU_ADDRESS 0xd000418d BIT_MASK 0x1 /end MEASUREMENT
/begin MEASUREMENT Vbx_cata_dsb_ad_rich "Catalyst diagnostic asks for the inhibition of the richness adaptive" UBYTE _CNV_S_2_RANGE______3_CM 1 0. 0. 1. ECU_ADDRESS 0xd000418e BIT_MASK 0x1 /end MEASUREMENT
/begin MEASUREMENT Vbx_cata_dsb_cp "Catalyst diagnostic asks for the inhibition of the canister purge" UBYTE _CNV_S_2_RANGE______3_CM 1 0. 0. 1. ECU_ADDRESS 0xd000418f BIT_MASK 0x1 /end MEASUREMENT
/begin MEASUREMENT Vbx_cata_ol_cl_ti_fac "Boolean indicating that catalyst diag takes over richness regulation." UBYTE _CNV_S_2_RANGE______3_CM 1 0. 0. 1. ECU_ADDRESS 0xd0004190 BIT_MASK 0x1 /end MEASUREMENT
/begin MEASUREMENT Vbx_cata_ol_stop "Command the exit of catalyst diag mode." UBYTE _CNV_S_2_RANGE______3_CM 1 0. 0. 1. ECU_ADDRESS 0xd0004191 BIT_MASK 0x1 /end MEASUREMENT
/begin MEASUREMENT Vbx_cata_req "OBD Catalyst diagnosis request" UBYTE _CNV_S_2_RANGE______3_CM 1 0. 0. 1. ECU_ADDRESS 0xd0004192 BIT_MASK 0x1 /end MEASUREMENT
/begin MEASUREMENT Vbx_cata_stab_rich "Richness is stabilized in catalyst window" UBYTE _CNV_S_2_RANGE______3_CM 1 0. 0. 1. ECU_ADDRESS 0xd0004193 BIT_MASK 0x1 /end MEASUREMENT
/begin MEASUREMENT Vbx_cata_stab_rich_dsb "Impossibility to stabilize richness in catalyst window" UBYTE _CNV_S_2_RANGE______3_CM 1 0. 0. 1. ECU_ADDRESS 0xd0004194 BIT_MASK 0x1 /end MEASUREMENT
/begin MEASUREMENT Vbx_df_cata_cpt "Lack efficiency of catalyst detected failure" UBYTE _CNV_S_2_RANGE______3_CM 1 0. 0. 1. ECU_ADDRESS 0xd0004195 BIT_MASK 0x1 /end MEASUREMENT
/begin MEASUREMENT Vbx_diag_ena_cata_cpt "Lack efficiency of catalyst diagnostic authorization" UBYTE _CNV_S_2_RANGE______3_CM 1 0. 0. 1. ECU_ADDRESS 0xd0004196 BIT_MASK 0x1 /end MEASUREMENT
/begin MEASUREMENT Vbx_diag_sta_cata_abrt "Catalyst routine aborted status" UBYTE _CNV_S_2_RANGE______3_CM 1 0. 0. 1. ECU_ADDRESS 0xd0004197 BIT_MASK 0x1 /end MEASUREMENT
/begin MEASUREMENT Vbx_diag_sta_cata_ena "Catalyst routine activation status" UBYTE _CNV_S_2_RANGE______3_CM 1 0. 0. 1. ECU_ADDRESS 0xd0004198 BIT_MASK 0x1 /end MEASUREMENT
/begin MEASUREMENT Vbx_diag_sta_cata_end "Catalyst routine completed status" UBYTE _CNV_S_2_RANGE______3_CM 1 0. 0. 1. ECU_ADDRESS 0xd0004199 BIT_MASK 0x1 /end MEASUREMENT
/begin MEASUREMENT Vbx_ena_diag_cata "OBD Catalyst diagnosis authorization" UBYTE _CNV_S_2_RANGE______3_CM 1 0. 0. 1. ECU_ADDRESS 0xd000419a BIT_MASK 0x1 /end MEASUREMENT
/begin MEASUREMENT Vbx_inhi_ena_diag_cata "Inibition condition" UBYTE _CNV_S_2_RANGE______3_CM 1 0. 0. 1. ECU_ADDRESS 0xd000419b BIT_MASK 0x1 /end MEASUREMENT
/begin MEASUREMENT Vbx_phy_ena_diag_cata "Physical condition" UBYTE _CNV_S_2_RANGE______3_CM 1 0. 0. 1. ECU_ADDRESS 0xd000419c BIT_MASK 0x1 /end MEASUREMENT
/begin MEASUREMENT Vbx_sw_ena_diag_cata "Software condition" UBYTE _CNV_S_2_RANGE______3_CM 1 0. 0. 1. ECU_ADDRESS 0xd000419d BIT_MASK 0x1 /end MEASUREMENT
/begin MEASUREMENT Vsx_cata_stt "Catalyst diagnostic states" UBYTE _CNV_A_R_ECME_LINEA_0_CM 1 0. 0. 255. ECU_ADDRESS 0xd0004182 FORMAT "%3.0" /end MEASUREMENT
/begin MEASUREMENT Vsx_diag_sta_cata_stt "Catalyst routine status" UBYTE _CNV_A_R_ECME_LINEA_0_CM 1 0. 0. 255. ECU_ADDRESS 0xd0004183 FORMAT "%3.0" /end MEASUREMENT
/begin MEASUREMENT Vxx_cata_asd_diag_ctr "counter of diagnostic in after sales mode" UBYTE _CNV_A_R_ECME_LINEA_0_CM 1 0. 0. 255. ECU_ADDRESS 0xd0004184 FORMAT "%3.0" /end MEASUREMENT
/begin MEASUREMENT Vxx_cata_asd_sf "Catalyst efficiency for after sale mode" UBYTE _CNV_A_R_ECME_LINEA_0_CM 1 0. 0. 3. ECU_ADDRESS 0xd0004185 FORMAT "%1.0" /end MEASUREMENT
/begin MEASUREMENT Vxx_cata_asd_sf_ctr "Counter of diagnostic result consecutive in the same state for after sale diagnostic" UBYTE _CNV_A_R_ECME_LINEA_0_CM 1 0. 0. 255. ECU_ADDRESS 0xd0004186 FORMAT "%3.0" /end MEASUREMENT
/begin MEASUREMENT Vxx_cata_asd_tout_dly "Timeout for after sale diagnostic if the request can't switch to on" UWORD _CNV_A_R_LINEAR_____34_CM 1 0. 0. 655.35 ECU_ADDRESS 0xd0002d80 FORMAT "%6.2" /end MEASUREMENT
/begin MEASUREMENT Vxx_cata_fail_thd "Value of the catalyst failure threshold" UBYTE _CNV_A_R_ECME_LINEA_0_CM 1 0. 0. 255. ECU_ADDRESS 0xd0004187 FORMAT "%3.0" /end MEASUREMENT
/begin MEASUREMENT Vxx_cata_in_ctr "Counter of transition Nsx_cata_cpt_dg_dsb to Nsx_cata_cpt_stab_cl" UBYTE _CNV_A_R_ECME_LINEA_0_CM 1 0. 0. 255. ECU_ADDRESS 0xd0004188 FORMAT "%3.0" /end MEASUREMENT
/begin MEASUREMENT Vxx_cata_lbdw_h_fil_val "Filtered value of the tension downstream lambda sensor at the beginning of the open loop" UWORD _CNV_A_R_LINEAR_____52_CM 1 0. 0. 25000. ECU_ADDRESS 0xd0002d82 FORMAT "%5.0" /end MEASUREMENT
/begin MEASUREMENT Vxx_cata_lbdw_mes "Value of the catalyst diagnostic criteria" UWORD _CNV_A_R_ECME_LINEA_0_CM 1 0. 0. 65535. ECU_ADDRESS 0xd0002d84 FORMAT "%5.0" /end MEASUREMENT
/begin MEASUREMENT Vxx_cata_mem_ol_cl_ti_fac "Mean value of Vxx_cl_ti_fac at the begining of catalyst diag phase." UWORD _CNV_A_R_LINEAR_____375_CM 1 0. 0.66666667 1.33332316414063 ECU_ADDRESS 0xd0002d86 FORMAT "%10.8" /end MEASUREMENT
/begin MEASUREMENT Vxx_cata_ol_apl "Half amplitude of the richness correction for the open loop regulation" UWORD _CNV_A_R_LINEAR_____376_CM 1 0. 0. 0.333328247070313 ECU_ADDRESS 0xd0002d88 FORMAT "%8.6" /end MEASUREMENT
/begin MEASUREMENT Vxx_cata_ol_mv_cl_ti_fac "Middle value of Vxx_diag_cata_cl_ti_fac which is used for the catalyst diagnosis richness regulation" UWORD _CNV_A_R_LINEAR_____375_CM 1 0. 0.66666667 1.33332316414063 ECU_ADDRESS 0xd0002d8a FORMAT "%10.8" /end MEASUREMENT
/begin MEASUREMENT Vxx_cata_ol_per_ctr "Counter of half periode of the richness correction in the open loop regulation" UBYTE _CNV_A_R_ECME_LINEA_0_CM 1 0. 0. 255. ECU_ADDRESS 0xd0004189 FORMAT "%3.0" /end MEASUREMENT
/begin MEASUREMENT Vxx_cata_ol_per_dly "Timer of the half periode of the richness correction in the open loop regulation" UBYTE _CNV_A_R_LINEAR_____34_CM 1 0. 0. 2.55 ECU_ADDRESS 0xd000418a FORMAT "%4.2" /end MEASUREMENT
/begin MEASUREMENT Vxx_cata_ol_per_dly_clc "Calculation of duration of the half periode of the richness correction at the beginning of the open loop regulation." UBYTE _CNV_A_R_LINEAR_____34_CM 1 0. 0. 2.55 ECU_ADDRESS 0xd000418b FORMAT "%4.2" /end MEASUREMENT
/begin MEASUREMENT Vxx_cata_ol_stab_test "Counter of stabilzation attempt of the richness in the catalyst window during open loop regulation" UBYTE _CNV_A_R_ECME_LINEA_0_CM 1 0. 0. 255. ECU_ADDRESS 0xd000418c FORMAT "%3.0" /end MEASUREMENT
/begin MEASUREMENT Vxx_cata_stab_dly "Timer for stabilisation in closed loop" UWORD _CNV_A_R_LINEAR_____34_CM 1 0. 0. 655.35 ECU_ADDRESS 0xd0002d8c FORMAT "%6.2" /end MEASUREMENT
/begin MEASUREMENT Vxx_diag_cata_cl_ti_fac "Command value from catalyst diag applied on Vxx_cl_ti_fac. (when diag mode enabled)" UWORD _CNV_A_R_LINEAR_____375_CM 1 0. 0.66666667 1.33332316414063 ECU_ADDRESS 0xd0002d8e FORMAT "%10.8" /end MEASUREMENT
/begin MEASUREMENT Vxx_edic_cata_dly "Timer for minimal waiting between two diagnoses for edic needs" UWORD _CNV_A_R_LINEAR_____34_CM 1 0. 0. 655.35 ECU_ADDRESS 0xd0002d90 FORMAT "%6.2" /end MEASUREMENT
/begin MEASUREMENT Vxx_lbdw_h_lvl_fil_val_prev "Filtered value by the tension of dowstream lambda sensor to judge the level of richness at i-1" UWORD _CNV_A_R_LINEAR_____52_CM 1 0. 0. 25000. ECU_ADDRESS 0xd0002d92 FORMAT "%5.0" /end MEASUREMENT
/begin MEASUREMENT Vxx_lgl_dly_diag_cata "Timer before catalyst diagnosis" UWORD _CNV_A_R_LINEAR_____4_CM 1 0. 0. 6553.5 ECU_ADDRESS 0xd0002d94 FORMAT "%6.1" /end MEASUREMENT
/begin MEASUREMENT Vxx_pump_maf_cata_mem "Amount of air pumped into cylinder memorised for the diagnosis stability ." UWORD _CNV_A_R_LINEAR_____109_CM 1 0. 0. 3000. ECU_ADDRESS 0xd0002d96 FORMAT "%4.3" /end MEASUREMENT
/begin MEASUREMENT Vxx_pump_maf_fil_cata "Filtered amount of air pumped into cylinder for Ctp_cata_ol_per_dly_maf and Ctp_cata_lbdw_max_maf" UWORD _CNV_A_R_LINEAR_____109_CM 1 0. 0. 3000. ECU_ADDRESS 0xd0002d98 FORMAT "%4.3" /end MEASUREMENT
/begin CHARACTERISTIC Cxx_cata_asd_diag_nr "Maximum number of diagnostic in after sales mode" VALUE 0xa0021296 _REC_S1VAL_20_u1 255. _CNV_A_R_ECME_LINEA_0_CM 0. 255. FORMAT "%3.0" /end CHARACTERISTIC
/begin CHARACTERISTIC Cxx_cata_asd_in_nr "Number of attempt for diagnosis in after sales mode" VALUE 0xa0021297 _REC_S1VAL_20_u1 255. _CNV_A_R_ECME_LINEA_0_CM 0. 255. FORMAT "%3.0" /end CHARACTERISTIC
/begin CHARACTERISTIC Cxx_cata_asd_sf_nr "Number of diagnostic result consecutive in the same state for after sale diagnostic" VALUE 0xa0021298 _REC_S1VAL_20_u1 255. _CNV_A_R_ECME_LINEA_0_CM 0. 255. FORMAT "%3.0" /end CHARACTERISTIC
/begin CHARACTERISTIC Cxx_cata_asd_tout_dly "Value of the timeout for after sale diagnostic if the request can't switch to on" VALUE 0xa0021262 _REC_S1VAL_20_u2 655.35 _CNV_A_R_LINEAR_____34_CM 0. 655.35 FORMAT "%6.2" /end CHARACTERISTIC
/begin CHARACTERISTIC Cxx_cata_cl_stab_dly_min "Duration for stabilisation in closed loop" VALUE 0xa0021264 _REC_S1VAL_20_u2 655.35 _CNV_A_R_LINEAR_____34_CM 0. 655.35 FORMAT "%6.2" /end CHARACTERISTIC
/begin CHARACTERISTIC Cxx_cata_diag_gear "Gear engaged ([-1 0 1 2 3 4 5 6]) for catalyst diagnostic autorisation" VALUE 0xa0021299 _REC_S1VAL_20_u1 7. _CNV_A_R_LINEAR_____113_CM -1. 6. FORMAT "%2.0" /end CHARACTERISTIC
/begin CHARACTERISTIC Cxx_cata_fuel_typ_rat_max_1 "First maximum rate of exotic fuel to authorize the diagnosis of the catalyst" VALUE 0xa0021266 _REC_S1VAL_20_u2 1. _CNV_A_R_LINEAR_____108_CM 0. 1. FORMAT "%5.3" /end CHARACTERISTIC
/begin CHARACTERISTIC Cxx_cata_fuel_typ_rat_max_2 "Second maximum rate of exotic fuel to authorize the diagnosis of the catalyst" VALUE 0xa0021268 _REC_S1VAL_20_u2 1. _CNV_A_R_LINEAR_____108_CM 0. 1. FORMAT "%5.3" /end CHARACTERISTIC
/begin CHARACTERISTIC Cxx_cata_fuel_typ_rat_min_1 "First minimum rate of exotic fuel to authorize the diagnosis of the catalyst" VALUE 0xa002126a _REC_S1VAL_20_u2 1. _CNV_A_R_LINEAR_____108_CM 0. 1. FORMAT "%5.3" /end CHARACTERISTIC
/begin CHARACTERISTIC Cxx_cata_fuel_typ_rat_min_2 "Second minimum rate of exotic fuel to authorize the diagnosis of the catalyst" VALUE 0xa002126c _REC_S1VAL_20_u2 1. _CNV_A_R_LINEAR_____108_CM 0. 1. FORMAT "%5.3" /end CHARACTERISTIC
/begin CHARACTERISTIC Cxx_cata_hys_maf "Hysteresis on Amount of air pumped into cylinder for diagnosis conditions" VALUE 0xa002126e _REC_S1VAL_20_u2 3000. _CNV_A_R_LINEAR_____109_CM 0. 3000. FORMAT "%4.3" /end CHARACTERISTIC
/begin CHARACTERISTIC Cxx_cata_hys_n "Hysteresis on engine speed for diagnosis conditions" VALUE 0xa0021270 _REC_S1VAL_20_u2 16383.75 _CNV_A_R_ENSD_LINEA_24_CM 0. 16383.75 FORMAT "%8.2" /end CHARACTERISTIC
/begin CHARACTERISTIC Cxx_cata_in_nr "Number of attempt for diagnosis" VALUE 0xa002129a _REC_S1VAL_20_u1 255. _CNV_A_R_ECME_LINEA_0_CM 0. 255. FORMAT "%3.0" /end CHARACTERISTIC
/begin CHARACTERISTIC Cxx_cata_maf_dif_max "Maximum variation of amount of air pumped into cylinder for diagnosis conditions." VALUE 0xa0021272 _REC_S1VAL_20_u2 3000. _CNV_A_R_LINEAR_____109_CM 0. 3000. FORMAT "%4.3" /end CHARACTERISTIC
/begin CHARACTERISTIC Cxx_cata_maf_max "Maximum value of amount of air pumped into cylinder for diagnosis conditions." VALUE 0xa0021274 _REC_S1VAL_20_u2 3000. _CNV_A_R_LINEAR_____109_CM 0. 3000. FORMAT "%4.3" /end CHARACTERISTIC
/begin CHARACTERISTIC Cxx_cata_maf_mes_max "Maximum drift of air pumped into cylinder for diagnosis condition in open loop regulation" VALUE 0xa0021276 _REC_S1VAL_20_u2 3000. _CNV_A_R_LINEAR_____109_CM 0. 3000. FORMAT "%4.3" /end CHARACTERISTIC
/begin CHARACTERISTIC Cxx_cata_maf_min "Minimum value of amount of air pumped into cylinder for diagnosis conditions." VALUE 0xa0021278 _REC_S1VAL_20_u2 3000. _CNV_A_R_LINEAR_____109_CM 0. 3000. FORMAT "%4.3" /end CHARACTERISTIC
/begin CHARACTERISTIC Cxx_cata_n_max "Maximum value of engine speed for diagnosis conditions." VALUE 0xa002127a _REC_S1VAL_20_u2 16383.75 _CNV_A_R_ENSD_LINEA_24_CM 0. 16383.75 FORMAT "%8.2" /end CHARACTERISTIC
/begin CHARACTERISTIC Cxx_cata_n_min "Minimum value of engine speed for diagnosis conditions." VALUE 0xa002127c _REC_S1VAL_20_u2 16383.75 _CNV_A_R_ENSD_LINEA_24_CM 0. 16383.75 FORMAT "%8.2" /end CHARACTERISTIC
/begin CHARACTERISTIC Cxx_cata_ofs_neg_1 "First negative offset applied on Vxx_cata_ol_mv_cl_ti_fac" VALUE 0xa002129b _REC_S1VAL_20_u1 0.333323120948235 _CNV_A_R_LINEAR_____377_CM 0.666676879051765 1. FORMAT "%8.7" /end CHARACTERISTIC
/begin CHARACTERISTIC Cxx_cata_ofs_neg_2 "Second negative offset applied on Vxx_cata_ol_mv_cl_ti_fac" VALUE 0xa002129c _REC_S1VAL_20_u1 0.333323120948235 _CNV_A_R_LINEAR_____377_CM 0.666676879051765 1. FORMAT "%8.7" /end CHARACTERISTIC
/begin CHARACTERISTIC Cxx_cata_ofs_ol_lbdw_fil "Offset on Cxx_cata_ol_thd_lbdw_fil" VALUE 0xa002127e _REC_S1VAL_20_u2 25000. _CNV_A_R_LINEAR_____52_CM 0. 25000. FORMAT "%5.0" /end CHARACTERISTIC
/begin CHARACTERISTIC Cxx_cata_ofs_pos_1 "First positive offset applied on Vxx_cata_ol_mv_cl_ti_fac" VALUE 0xa002129d _REC_S1VAL_20_u1 0.3320312999999999 _CNV_A_R_LINEAR_____378_CM 1. 1.3320313 FORMAT "%8.7" /end CHARACTERISTIC
/begin CHARACTERISTIC Cxx_cata_ofs_pos_2 "Second positive offset applied on Vxx_cata_ol_mv_cl_ti_fac" VALUE 0xa002129e _REC_S1VAL_20_u1 0.3320312999999999 _CNV_A_R_LINEAR_____378_CM 1. 1.3320313 FORMAT "%8.7" /end CHARACTERISTIC
/begin CHARACTERISTIC Cxx_cata_ol_apl "Half amplitude of the richness correction for the open loop regulation" VALUE 0xa0021280 _REC_S1VAL_20_u2 0.333333333307501 _CNV_A_R_LINEAR_____379_CM 0. 0.333333333307501 FORMAT "%10.8" /end CHARACTERISTIC
/begin CHARACTERISTIC Cxx_cata_ol_apl_alco "Half amplitude of the richness correction for the open loop regulation in alcohol" VALUE 0xa0021282 _REC_S1VAL_20_u2 0.333328247070313 _CNV_A_R_LINEAR_____376_CM 0. 0.333328247070313 FORMAT "%8.6" /end CHARACTERISTIC
/begin CHARACTERISTIC Cxx_cata_ol_per_dly_mes "Number of half periode of the richness correction for the open loop regulation in \"Measure state\"" VALUE 0xa002129f _REC_S1VAL_20_u1 255. _CNV_A_R_ECME_LINEA_0_CM 0. 255. FORMAT "%3.0" /end CHARACTERISTIC
/begin CHARACTERISTIC Cxx_cata_ol_per_dly_stab "Number of half periode of the richness correction for the open loop regulation in \"Open loop stabilization state\"" VALUE 0xa00212a0 _REC_S1VAL_20_u1 255. _CNV_A_R_ECME_LINEA_0_CM 0. 255. FORMAT "%3.0" /end CHARACTERISTIC
/begin CHARACTERISTIC Cxx_cata_ol_test_max_nr "Maximum number of attempt of stabilisation in open loop regulation" VALUE 0xa00212a1 _REC_S1VAL_20_u1 255. _CNV_A_R_ECME_LINEA_0_CM 0. 255. FORMAT "%3.0" /end CHARACTERISTIC
/begin CHARACTERISTIC Cxx_cata_ol_thd_lbdw_fil "threshold of strong filtering for the open loop regulation" VALUE 0xa0021284 _REC_S1VAL_20_u2 25000. _CNV_A_R_LINEAR_____52_CM 0. 25000. FORMAT "%5.0" /end CHARACTERISTIC
/begin CHARACTERISTIC Cxx_cata_tco_min "Minimum value of engine coolant temperature for diagnosis conditions." VALUE 0xa0021286 _REC_S1VAL_20_u2 240. _CNV_A_R_LINEAR_____54_CM -40. 200. FORMAT "%5.1" /end CHARACTERISTIC
/begin CHARACTERISTIC Cxx_cata_win_max "High threshold of the catalyst windows" VALUE 0xa0021288 _REC_S1VAL_20_u2 25000. _CNV_A_R_LINEAR_____52_CM 0. 25000. FORMAT "%5.0" /end CHARACTERISTIC
/begin CHARACTERISTIC Cxx_cata_win_min "low threshold of the catalyst windows" VALUE 0xa002128a _REC_S1VAL_20_u2 25000. _CNV_A_R_LINEAR_____52_CM 0. 25000. FORMAT "%5.0" /end CHARACTERISTIC
/begin CHARACTERISTIC Cxx_conf_diag_cata "Catalyst Diagnostic is: 0=forbidden; 1=conventional mode; 2=bench mode" VALUE 0xa00212a2 _REC_S1VAL_20_u1 3. _CNV_A_R_ECME_LINEA_0_CM 0. 3. FORMAT "%1.0" /end CHARACTERISTIC
/begin CHARACTERISTIC Cxx_dfdec_cata_cpt "Lack efficiency of catalyst detected failure counter decrement" VALUE 0xa002128c _REC_S1VAL_20_u2 65535. _CNV_A_R_ECME_LINEA_0_CM 0. 65535. FORMAT "%5.0" /end CHARACTERISTIC
/begin CHARACTERISTIC Cxx_dfinc_cata_cpt "Lack efficiency of catalyst detected failure counter increment" VALUE 0xa002128e _REC_S1VAL_20_u2 65535. _CNV_A_R_ECME_LINEA_0_CM 0. 65535. FORMAT "%5.0" /end CHARACTERISTIC
/begin CHARACTERISTIC Cxx_diag_sta_cata_lbup_pwt_sp "Powertrain set point requested by Catalyst or Lambda routines" VALUE 0xa0021290 _REC_S1VAL_20_u2 1. _CNV_A_R_LINEAR_____257_CM 0. 1. FORMAT "%8.5" /end CHARACTERISTIC
/begin CHARACTERISTIC Cxx_edic_cata_dly "Minimum duration waiting between two diagnoses for edic needs" VALUE 0xa0021292 _REC_S1VAL_20_u2 655.35 _CNV_A_R_LINEAR_____34_CM 0. 655.35 FORMAT "%6.2" /end CHARACTERISTIC
/begin CHARACTERISTIC Cxx_ex_gaz_cata_max_temp "Max temp for diagnosis catalys autorisation" VALUE 0xa00212a3 _REC_S1VAL_20_u1 1020. _CNV_A_R_LINEAR_____380_CM -40. 980. FORMAT "%3.0" /end CHARACTERISTIC
/begin CHARACTERISTIC Cxx_ex_gaz_cata_min_temp "Min temp for diagnosis catalys autorisation" VALUE 0xa00212a4 _REC_S1VAL_20_u1 1020. _CNV_A_R_LINEAR_____380_CM -40. 980. FORMAT "%3.0" /end CHARACTERISTIC
/begin CHARACTERISTIC Cxx_lgl_dly_diag_cata "Duration before catalyst diagnosis" VALUE 0xa0021294 _REC_S1VAL_20_u2 6553.5 _CNV_A_R_LINEAR_____4_CM 0. 6553.5 FORMAT "%6.1" /end CHARACTERISTIC
/begin MEASUREMENT Vbx_agb_tq_req_full_ctl "Requested AGB torque intervention of full control type (corresponding to shift in progress in M2S)" UBYTE _CNV_S_2_RANGE______3_CM 1 0. 0. 1. ECU_ADDRESS 0xd0003f37 BIT_MASK 0x1 /end MEASUREMENT
/begin MEASUREMENT Vbx_agb_tq_req_h_lim "Requested AGB torque intervention of upper limitation type" UBYTE _CNV_S_2_RANGE______3_CM 1 0. 0. 1. ECU_ADDRESS 0xd0003f38 BIT_MASK 0x1 /end MEASUREMENT
/begin MEASUREMENT Vbx_agb_tq_req_l_lim "Requested AGB torque intervention of lower limitation type" UBYTE _CNV_S_2_RANGE______3_CM 1 0. 0. 1. ECU_ADDRESS 0xd0003f39 BIT_MASK 0x1 /end MEASUREMENT
/begin AXIS_PTS Ctb_agb_csm_tq_is_n_sp_dif "Breakpoint on the difference between nominal engine speed setpoint and the real setpoint" 0xa002c084 Vxx_is_n_sp_dif _REC_A2AXS_20_u2 16383.75 _CNV_A_R_ENSD_LINEA_24_CM 5 0. 16383.75 FORMAT "%8.2" /end AXIS_PTS
/begin AXIS_PTS Ctb_agb_tq_dif_n_is_n_sp "Breakpoint on the difference between the engine speed and the engine setpoint" 0xa002c090 Vxx_agb_tq_dif_n_is_n_sp _REC_A2AXS_20_u2 16383.75 _CNV_A_R_ENSD_LINEA_24_CM 9 0. 16383.75 FORMAT "%8.2" /end AXIS_PTS
/begin AXIS_PTS Ctb_agb_tq_vs "Breakpoint of Vehicle speed, to disable the coupler torque" 0xa002c0a4 Vxx_vs _REC_A2AXS_20_u2 655.35 _CNV_A_R_LINEAR_____70_CM 9 0. 655.35 FORMAT "%6.2" /end AXIS_PTS
/begin CHARACTERISTIC Ctp_agb_csm_tq_drag_red_ofs "Torque offset to estimate the gearbox losses in the drag reduction mode" CURVE 0xa002c0b8 _REC_A1CUR_20_u2_u2 2047.96875 _CNV_A_R_LINEAR_____127_CM -1024. 1023.96875 FORMAT "%10.5"
 /begin AXIS_DESCR COM_AXIS Vxx_toil _CNV_A_R_LINEAR_____54_CM 16 -40. 200. FORMAT "%5.1" AXIS_PTS_REF Ctb_toil /end AXIS_DESCR
/end CHARACTERISTIC
/begin CHARACTERISTIC Ctp_agb_csm_tq_dri_ofs "Torque offset to estimate the gearbox losses in the drive mode" CURVE 0xa002c0d8 _REC_A1CUR_20_u2_u2 2047.96875 _CNV_A_R_LINEAR_____127_CM -1024. 1023.96875 FORMAT "%10.5"
 /begin AXIS_DESCR COM_AXIS Vxx_toil _CNV_A_R_LINEAR_____54_CM 16 -40. 200. FORMAT "%5.1" AXIS_PTS_REF Ctb_toil /end AXIS_DESCR
/end CHARACTERISTIC
/begin CHARACTERISTIC Ctp_agb_csm_tq_dri_ofs_dft "Degraded mode of the coupler torque losses in the drive mode" CURVE 0xa002c0f8 _REC_A1CUR_20_u2_u2 2047.96875 _CNV_A_R_LINEAR_____123_CM 0. 2047.96875 FORMAT "%10.5"
 /begin AXIS_DESCR COM_AXIS Vxx_toil _CNV_A_R_LINEAR_____54_CM 16 -40. 200. FORMAT "%5.1" AXIS_PTS_REF Ctb_toil /end AXIS_DESCR
/end CHARACTERISTIC
/begin CHARACTERISTIC Ctp_agb_csm_tq_ftc_temp_fast "Fast filter factor to coupler torque losses in the neutral position or the drag reduction mode (depending on engine coolant temperature)" CURVE 0xa002c118 _REC_A1CUR_20_u1_u2 2.55 _CNV_A_R_LINEAR_____34_CM 0. 2.55 FORMAT "%4.2"
 /begin AXIS_DESCR COM_AXIS Vxx_toil _CNV_A_R_LINEAR_____54_CM 16 -40. 200. FORMAT "%5.1" AXIS_PTS_REF Ctb_toil /end AXIS_DESCR
/end CHARACTERISTIC
/begin CHARACTERISTIC Ctp_agb_csm_tq_ftc_temp_slow "Slow filter factor to coupler torque losses in the neutral position or the drag reduction mode (depending on engine coolant temperature)" CURVE 0xa002c128 _REC_A1CUR_20_u1_u2 2.55 _CNV_A_R_LINEAR_____34_CM 0. 2.55 FORMAT "%4.2"
 /begin AXIS_DESCR COM_AXIS Vxx_toil _CNV_A_R_LINEAR_____54_CM 16 -40. 200. FORMAT "%5.1" AXIS_PTS_REF Ctb_toil /end AXIS_DESCR
/end CHARACTERISTIC
/begin CHARACTERISTIC Ctp_agb_csm_tq_is_n_sp_fac "Factor on torque converter losses according to the difference between the nominal engine speed setpoint and the real setpoint" CURVE 0xa0020cc6 _REC_A1CUR_20_u1_u2 3.984375 _CNV_A_R_LINEAR_____175_CM 0. 3.984375 FORMAT "%8.6"
 /begin AXIS_DESCR COM_AXIS Vxx_is_n_sp_dif _CNV_A_R_ENSD_LINEA_24_CM 5 0. 16383.75 FORMAT "%8.2" AXIS_PTS_REF Ctb_agb_csm_tq_is_n_sp_dif /end AXIS_DESCR
/end CHARACTERISTIC
/begin CHARACTERISTIC Ctp_agb_csm_tq_n_fac "Factor to disable the coupler torque, depending of the engine speed" CURVE 0xa002c138 _REC_A1CUR_20_u1_u2 1. _CNV_A_R_LINEAR_____43_CM 0. 1. FORMAT "%9.7"
 /begin AXIS_DESCR COM_AXIS Vxx_agb_tq_dif_n_is_n_sp _CNV_A_R_ENSD_LINEA_24_CM 9 0. 16383.75 FORMAT "%8.2" AXIS_PTS_REF Ctb_agb_tq_dif_n_is_n_sp /end AXIS_DESCR
/end CHARACTERISTIC
/begin CHARACTERISTIC Ctp_agb_csm_tq_neut_ofs "Torque offset to estimate the gearbox losses in the neutral position or the park position" CURVE 0xa002c144 _REC_A1CUR_20_u2_u2 2047.96875 _CNV_A_R_LINEAR_____127_CM -1024. 1023.96875 FORMAT "%10.5"
 /begin AXIS_DESCR COM_AXIS Vxx_toil _CNV_A_R_LINEAR_____54_CM 16 -40. 200. FORMAT "%5.1" AXIS_PTS_REF Ctb_toil /end AXIS_DESCR
/end CHARACTERISTIC
/begin CHARACTERISTIC Ctp_agb_csm_tq_neut_ofs_dft "Degraded mode of the coupler torque losses in the neutral position" CURVE 0xa002c164 _REC_A1CUR_20_u2_u2 2047.96875 _CNV_A_R_LINEAR_____123_CM 0. 2047.96875 FORMAT "%10.5"
 /begin AXIS_DESCR COM_AXIS Vxx_toil _CNV_A_R_LINEAR_____54_CM 16 -40. 200. FORMAT "%5.1" AXIS_PTS_REF Ctb_toil /end AXIS_DESCR
/end CHARACTERISTIC
/begin CHARACTERISTIC Ctp_agb_csm_tq_vs_fac "Factor to disable the coupler torque, depending of the vehicle speed" CURVE 0xa002c184 _REC_A1CUR_20_u1_u2 1. _CNV_A_R_LINEAR_____43_CM 0. 1. FORMAT "%9.7"
 /begin AXIS_DESCR COM_AXIS Vxx_vs _CNV_A_R_LINEAR_____70_CM 9 0. 655.35 FORMAT "%6.2" AXIS_PTS_REF Ctb_agb_tq_vs /end AXIS_DESCR
/end CHARACTERISTIC
/begin CHARACTERISTIC Ctp_egb_dri_drag_red_dly_temp "Temporization between the transition Drive - > drag reduction" CURVE 0xa002c190 _REC_A1CUR_20_u2_u2 655.35 _CNV_A_R_LINEAR_____34_CM 0. 655.35 FORMAT "%6.2"
 /begin AXIS_DESCR COM_AXIS Vxx_toil _CNV_A_R_LINEAR_____54_CM 16 -40. 200. FORMAT "%5.1" AXIS_PTS_REF Ctb_toil /end AXIS_DESCR
/end CHARACTERISTIC
/begin CHARACTERISTIC Ctp_egb_dri_neut_dly_temp "Temporization between the transition Drive -> neutral" CURVE 0xa002c1b0 _REC_A1CUR_20_u2_u2 655.35 _CNV_A_R_LINEAR_____34_CM 0. 655.35 FORMAT "%6.2"
 /begin AXIS_DESCR COM_AXIS Vxx_toil _CNV_A_R_LINEAR_____54_CM 16 -40. 200. FORMAT "%5.1" AXIS_PTS_REF Ctb_toil /end AXIS_DESCR
/end CHARACTERISTIC
/begin MEASUREMENT Vbx_stat_drag_red_agb "Drag reduction mode with the temporization between Drive mode -> Drag reduction" UBYTE _CNV_S_2_RANGE______3_CM 1 0. 0. 1. ECU_ADDRESS 0xd0005353 BIT_MASK 0x1 /end MEASUREMENT
/begin MEASUREMENT Vbx_stat_egb_neut "Electronic GearBox is in a configuration equivalent to Neutral for a manual gearbox, with the temporization between Drive -> Neut" UBYTE _CNV_S_2_RANGE______3_CM 1 0. 0. 1. ECU_ADDRESS 0xd0005354 BIT_MASK 0x1 /end MEASUREMENT
/begin MEASUREMENT Vsx_agb_csm_tq_vld "Converter friction torque validity status" UBYTE _CNV_S_3_STATUS_OK__120_CM 1 0. 0. 2. ECU_ADDRESS 0xd0003e22 /end MEASUREMENT
/begin MEASUREMENT Vxx_agb_csm_tq "coupler torque losses" UWORD _CNV_A_R_LINEAR_____161_CM 1 0. -400. 1647.96875 ECU_ADDRESS 0xd00030c8 FORMAT "%11.5" /end MEASUREMENT
/begin MEASUREMENT Vxx_agb_csm_tq_dft "coupler torque losses in degraded mode" UWORD _CNV_A_R_LINEAR_____123_CM 1 0. 0. 2047.96875 ECU_ADDRESS 0xd0005b64 FORMAT "%10.5" /end MEASUREMENT
/begin MEASUREMENT Vxx_agb_csm_tq_fil "coupler torque losses filtered" UWORD _CNV_A_R_LINEAR_____161_CM 1 0. -400. 1647.96875 ECU_ADDRESS 0xd0005b66 FORMAT "%10.5" /end MEASUREMENT
/begin MEASUREMENT Vxx_agb_csm_tq_is_n_fac "Factor on torque converter losses according to the difference between the nominal engine speed setpoint and the real setpoint" UBYTE _CNV_A_R_LINEAR_____175_CM 1 0. 0. 3.984375 ECU_ADDRESS 0xd0005355 FORMAT "%8.6" /end MEASUREMENT
/begin MEASUREMENT Vxx_agb_csm_tq_ofs "Torque offset to estimate the gearbox losses" UWORD _CNV_A_R_LINEAR_____123_CM 1 0. 0. 2047.96875 ECU_ADDRESS 0xd0005b68 FORMAT "%10.5" /end MEASUREMENT
/begin MEASUREMENT Vxx_agb_csm_tq_slop "coupler torque losses with the slew rate" UWORD _CNV_A_R_LINEAR_____161_CM 1 0. -400. 1647.96875 ECU_ADDRESS 0xd0005b6a FORMAT "%10.5" /end MEASUREMENT
/begin MEASUREMENT Vxx_agb_tq_dif_n_is_n_sp "Difference between the engine speed and the idle speed setpoint" UWORD _CNV_A_R_ENSD_LINEA_24_CM 1 0. 0. 16383.75 ECU_ADDRESS 0xd00030ca FORMAT "%8.2" /end MEASUREMENT
/begin MEASUREMENT Vxx_is_n_sp_dif "Difference between nomimal engine speed setpoint and the final setpoint" UWORD _CNV_A_R_ENSD_LINEA_24_CM 1 0. 0. 16383.75 ECU_ADDRESS 0xd00030cc FORMAT "%8.2" /end MEASUREMENT
/begin CHARACTERISTIC Cbx_agb_csm_ofs_cfm "Configuration boolean, To calculate the torque offset to estimate the gearbox losses" VALUE 0xa0020cf8 _REC_S1VAL_20_u1 1. _CNV_A_R_ECME_LINEA_0_CM 0. 1. FORMAT "%1.0" BIT_MASK 0x1 /end CHARACTERISTIC
/begin CHARACTERISTIC Cbx_agb_csm_slop_cfm "Flag to disable the slew rate on the converter torque losses" VALUE 0xa0020cf9 _REC_S1VAL_20_u1 1. _CNV_A_R_ECME_LINEA_0_CM 0. 1. FORMAT "%1.0" BIT_MASK 0x1 /end CHARACTERISTIC
/begin CHARACTERISTIC Cbx_agb_csm_tq_temp_cfm "Configuration boolean, To calculate the thermic dependence according to water temperature or oil temperature" VALUE 0xa0020cfa _REC_S1VAL_20_u1 1. _CNV_A_R_ECME_LINEA_0_CM 0. 1. FORMAT "%1.0" BIT_MASK 0x1 /end CHARACTERISTIC
/begin CHARACTERISTIC Cxx_agb_csm_ofs_slop_neg "Negative slope on torque offset to estimate the gearbox losses" VALUE 0xa0020ccc _REC_S1VAL_20_u2 12799.8046875 _CNV_A_R_LINEAR_____384_CM -12799.8046875 0. FORMAT "%14.7" /end CHARACTERISTIC
/begin CHARACTERISTIC Cxx_agb_csm_ofs_slop_neg_dft "Negative slope on torque offset to estimate the gearbox losses in degraded mode" VALUE 0xa0020cce _REC_S1VAL_20_u2 12799.8046875 _CNV_A_R_LINEAR_____384_CM -12799.8046875 0. FORMAT "%14.7" /end CHARACTERISTIC
/begin CHARACTERISTIC Cxx_agb_csm_ofs_slop_pos "Positive slope on torque offset to estimate the gearbox losses" VALUE 0xa0020cd0 _REC_S1VAL_20_u2 12799.8046875 _CNV_A_R_LINEAR_____385_CM 0. 12799.8046875 FORMAT "%13.7" /end CHARACTERISTIC
/begin CHARACTERISTIC Cxx_agb_csm_ofs_slop_pos_dft "Positive slope on torque offset to estimate the gearbox losses in degraded mode" VALUE 0xa0020cd2 _REC_S1VAL_20_u2 12799.8046875 _CNV_A_R_LINEAR_____385_CM 0. 12799.8046875 FORMAT "%13.7" /end CHARACTERISTIC
/begin CHARACTERISTIC Cxx_agb_csm_tq_ftc_fast "Fast filter factor to coupler torque losses in the neutral position or the drag reduction mode" VALUE 0xa0020cfb _REC_S1VAL_20_u1 2.55 _CNV_A_R_LINEAR_____34_CM 0. 2.55 FORMAT "%4.2" /end CHARACTERISTIC
/begin CHARACTERISTIC Cxx_agb_csm_tq_ftc_slow "Slow filter factor to coupler torque losses in the neutral position or the drag reduction mode" VALUE 0xa0020cfc _REC_S1VAL_20_u1 2.55 _CNV_A_R_LINEAR_____34_CM 0. 2.55 FORMAT "%4.2" /end CHARACTERISTIC
/begin CHARACTERISTIC Cxx_agb_csm_tq_ftc_vs_thd "Vehicle speed threshold to switch between a simple filter time or a depending on engine coolant temperature one" VALUE 0xa0020cd4 _REC_S1VAL_20_u2 655.35 _CNV_A_R_LINEAR_____70_CM 0. 655.35 FORMAT "%6.2" /end CHARACTERISTIC
/begin CHARACTERISTIC Cxx_agb_csm_tq_is_n_hys "Engine speed hysteresis on the threshold of the idle speed regulation zone" VALUE 0xa0020cd6 _REC_S1VAL_20_u2 16383.75 _CNV_A_R_ENSD_LINEA_24_CM 0. 16383.75 FORMAT "%8.2" /end CHARACTERISTIC
/begin CHARACTERISTIC Cxx_agb_csm_tq_is_n_thd "Engine speed threshold to bound the low zone and the high zone of idle speed regulation" VALUE 0xa0020cd8 _REC_S1VAL_20_u2 16383.75 _CNV_A_R_ENSD_LINEA_24_CM 0. 16383.75 FORMAT "%8.2" /end CHARACTERISTIC
/begin CHARACTERISTIC Cxx_agb_csm_tq_slop_neg "Negative slope on torque converter losses in the low zone of idle speed" VALUE 0xa0020cda _REC_S1VAL_20_u2 12799.8046875 _CNV_A_R_LINEAR_____384_CM -12799.8046875 0. FORMAT "%14.7" /end CHARACTERISTIC
/begin CHARACTERISTIC Cxx_agb_csm_tq_slop_neg_1 "Negative slope on torque converter losses in the high zone of idle speed" VALUE 0xa0020cdc _REC_S1VAL_20_u2 12799.8046875 _CNV_A_R_LINEAR_____384_CM -12799.8046875 0. FORMAT "%14.7" /end CHARACTERISTIC
/begin CHARACTERISTIC Cxx_agb_csm_tq_slop_neg_1_rvr "Negative slope on torque converter losses in the high zone of idle speed, (reserve gear)" VALUE 0xa0020cde _REC_S1VAL_20_u2 12799.8046875 _CNV_A_R_LINEAR_____384_CM -12799.8046875 0. FORMAT "%14.7" /end CHARACTERISTIC
/begin CHARACTERISTIC Cxx_agb_csm_tq_slop_neg_2 "Negative slope on torque converter losses in the zone out of idle speed" VALUE 0xa0020ce0 _REC_S1VAL_20_u2 12799.8046875 _CNV_A_R_LINEAR_____384_CM -12799.8046875 0. FORMAT "%14.7" /end CHARACTERISTIC
/begin CHARACTERISTIC Cxx_agb_csm_tq_slop_neg_rvr "Negative slope on torque converter losses in the low zone of idle speed, (reserve gear)" VALUE 0xa0020ce2 _REC_S1VAL_20_u2 12799.8046875 _CNV_A_R_LINEAR_____384_CM -12799.8046875 0. FORMAT "%14.7" /end CHARACTERISTIC
/begin CHARACTERISTIC Cxx_agb_csm_tq_slop_pos "Positive slope on torque converter losses in the low zone of idle speed" VALUE 0xa0020ce4 _REC_S1VAL_20_u2 12799.8046875 _CNV_A_R_LINEAR_____385_CM 0. 12799.8046875 FORMAT "%13.7" /end CHARACTERISTIC
/begin CHARACTERISTIC Cxx_agb_csm_tq_slop_pos_1 "Positive slope on torque converter losses in the high zone of idle speed" VALUE 0xa0020ce6 _REC_S1VAL_20_u2 12799.8046875 _CNV_A_R_LINEAR_____385_CM 0. 12799.8046875 FORMAT "%13.7" /end CHARACTERISTIC
/begin CHARACTERISTIC Cxx_agb_csm_tq_slop_pos_1_rvr "Positive slope on torque converter losses in the high zone of idle speed, (reserve gear)" VALUE 0xa0020ce8 _REC_S1VAL_20_u2 12799.8046875 _CNV_A_R_LINEAR_____385_CM 0. 12799.8046875 FORMAT "%13.7" /end CHARACTERISTIC
/begin CHARACTERISTIC Cxx_agb_csm_tq_slop_pos_2 "Positive slope on torque converter losses in the zone out of idle speed" VALUE 0xa0020cea _REC_S1VAL_20_u2 12799.8046875 _CNV_A_R_LINEAR_____385_CM 0. 12799.8046875 FORMAT "%13.7" /end CHARACTERISTIC
/begin CHARACTERISTIC Cxx_agb_csm_tq_slop_pos_rvr "Positive slope on torque converter losses in the low zone of idle speed, (reserve gear)" VALUE 0xa0020cec _REC_S1VAL_20_u2 12799.8046875 _CNV_A_R_LINEAR_____385_CM 0. 12799.8046875 FORMAT "%13.7" /end CHARACTERISTIC
/begin CHARACTERISTIC Cxx_agb_csm_tq_vs_thd "Vehicle speed threshold to authorize the egb torque correction" VALUE 0xa0020cee _REC_S1VAL_20_u2 655.35 _CNV_A_R_LINEAR_____70_CM 0. 655.35 FORMAT "%6.2" /end CHARACTERISTIC
/begin CHARACTERISTIC Cxx_agb_tq_slop_drag_red_neg "Negative slope on torque converter losses in the drag reduction mode" VALUE 0xa0020cf0 _REC_S1VAL_20_u2 12799.8046875 _CNV_A_R_LINEAR_____384_CM -12799.8046875 0. FORMAT "%14.7" /end CHARACTERISTIC
/begin CHARACTERISTIC Cxx_agb_tq_slop_drag_red_pos "Positive slope on torque converter losses in the drag reduction mode" VALUE 0xa0020cf2 _REC_S1VAL_20_u2 12799.8046875 _CNV_A_R_LINEAR_____385_CM 0. 12799.8046875 FORMAT "%13.7" /end CHARACTERISTIC
/begin CHARACTERISTIC Cxx_agb_tq_slop_dsb_neg "Negative slope to disable the Slew Rate on the AT_torque" VALUE 0xa0020cf4 _REC_S1VAL_20_u2 12799.8046875 _CNV_A_R_LINEAR_____384_CM -12799.8046875 0. FORMAT "%14.7" /end CHARACTERISTIC
/begin CHARACTERISTIC Cxx_agb_tq_slop_dsb_pos "Positive slope to disable the Slew Rate on the AT_torque" VALUE 0xa0020cf6 _REC_S1VAL_20_u2 12799.8046875 _CNV_A_R_LINEAR_____385_CM 0. 12799.8046875 FORMAT "%13.7" /end CHARACTERISTIC
/begin MEASUREMENT Vbx_agb_ack "AT frame acknowledgment. This value is set to 1 if there is no torque request" UBYTE _CNV_S_2_RANGE______3_CM 1 0. 0. 1. ECU_ADDRESS 0xd000426b BIT_MASK 0x1 /end MEASUREMENT
/begin MEASUREMENT Vbx_agb_clck_fail "the AT frame clock value is not coherent with the last AT frame clock" UBYTE _CNV_S_2_RANGE______3_CM 1 0. 0. 1. ECU_ADDRESS 0xd000426c BIT_MASK 0x1 /end MEASUREMENT
/begin MEASUREMENT Vbx_agb_cmd "Validation of AT protocol conditions" UBYTE _CNV_S_2_RANGE______3_CM 1 0. 0. 1. ECU_ADDRESS 0xd000426d BIT_MASK 0x1 /end MEASUREMENT
/begin MEASUREMENT Vbx_agb_dft "Protocol error detected (to activate slew rate)" UBYTE _CNV_S_2_RANGE______3_CM 1 0. 0. 1. ECU_ADDRESS 0xd000426e BIT_MASK 0x1 /end MEASUREMENT
/begin MEASUREMENT Vbx_agb_gear_mod_ok "Boolean indicating that the AGB requests are authorized" UBYTE _CNV_S_2_RANGE______3_CM 1 0. 0. 1. ECU_ADDRESS 0xd000426f BIT_MASK 0x1 /end MEASUREMENT
/begin MEASUREMENT Vbx_agb_tq_int_rst "Reset of AGB torque integretar diagnostic" UBYTE _CNV_S_2_RANGE______3_CM 1 0. 0. 1. ECU_ADDRESS 0xd0004270 BIT_MASK 0x1 /end MEASUREMENT
/begin MEASUREMENT Vbx_agb_tq_lim_dft "When this flag is set to 1, Agb torque limitation will be set to a default calibration" UBYTE _CNV_S_2_RANGE______3_CM 1 0. 0. 1. ECU_ADDRESS 0xd0004271 BIT_MASK 0x1 /end MEASUREMENT
/begin MEASUREMENT Vbx_agb_tq_req "Agb torque request in progress" UBYTE _CNV_S_2_RANGE______3_CM 1 0. 0. 1. ECU_ADDRESS 0xd0004272 BIT_MASK 0x1 /end MEASUREMENT
/begin MEASUREMENT Vbx_agb_tq_req_full_ctl_vld "Validated AGB torque intervention of full control type (corresponding to shift in progress in M2S)" UBYTE _CNV_S_2_RANGE______3_CM 1 0. 0. 1. ECU_ADDRESS 0xd0004273 BIT_MASK 0x1 /end MEASUREMENT
/begin MEASUREMENT Vbx_agb_tq_req_h_lim_vld "Validated AGB torque intervention of upper limitation type" UBYTE _CNV_S_2_RANGE______3_CM 1 0. 0. 1. ECU_ADDRESS 0xd0004274 BIT_MASK 0x1 /end MEASUREMENT
/begin MEASUREMENT Vbx_agb_tq_req_l_lim_vld "Validated AGB torque intervention of lower limitation type" UBYTE _CNV_S_2_RANGE______3_CM 1 0. 0. 1. ECU_ADDRESS 0xd0004275 BIT_MASK 0x1 /end MEASUREMENT
/begin MEASUREMENT Vbx_df_agb_data_chr "AGB data coherence detected failure" UBYTE _CNV_S_2_RANGE______3_CM 1 0. 0. 1. ECU_ADDRESS 0xd0004276 BIT_MASK 0x1 /end MEASUREMENT
/begin MEASUREMENT Vbx_df_agb_data_seq_ctr "AGB data clock detected failure" UBYTE _CNV_S_2_RANGE______3_CM 1 0. 0. 1. ECU_ADDRESS 0xd0004277 BIT_MASK 0x1 /end MEASUREMENT
/begin MEASUREMENT Vbx_df_agb_data_tout "AGB data time-out detected failure" UBYTE _CNV_S_2_RANGE______3_CM 1 0. 0. 1. ECU_ADDRESS 0xd0004278 BIT_MASK 0x1 /end MEASUREMENT
/begin MEASUREMENT Vbx_df_agb_no_frm "AGB Missing Message detected failure" UBYTE _CNV_S_2_RANGE______3_CM 1 0. 0. 1. ECU_ADDRESS 0xd0004279 BIT_MASK 0x1 /end MEASUREMENT
/begin MEASUREMENT Vbx_egb_conf_ena "Booleen permettant d'activer le bloc de surveillance du protocole en couple avec une TA" UBYTE _CNV_S_2_RANGE______3_CM 1 0. 0. 1. ECU_ADDRESS 0xd000427a BIT_MASK 0x1 /end MEASUREMENT
/begin MEASUREMENT Vbx_i_dsb "Integrator inhibit" UBYTE _CNV_S_2_RANGE______3_CM 1 0. 0. 1. ECU_ADDRESS 0xd000427b BIT_MASK 0x1 /end MEASUREMENT
/begin MEASUREMENT Vxx_agb_10ms_t "Scheduler recurence" UBYTE _CNV_A_R_LINEAR_____58_CM 1 0. 0. 0.255 ECU_ADDRESS 0xd0005584 FORMAT "%5.3" /end MEASUREMENT
/begin MEASUREMENT Vxx_agb_int_t "Delay between two consecutive calls to SDFTA" UBYTE _CNV_A_R_LINEAR_____58_CM 1 0. 0. 0.255 ECU_ADDRESS 0xd0005585 FORMAT "%5.3" /end MEASUREMENT
/begin MEASUREMENT Vxx_agb_lim_tqe "AGB engine torque limitation" UWORD _CNV_A_R_LINEAR_____161_CM 1 0. -400. 1647.96875 ECU_ADDRESS 0xd00033e2 FORMAT "%10.5" /end MEASUREMENT
/begin MEASUREMENT Vxx_agb_max_tqe_sp "setpoint request wich will be sent to torque arbitration in max bloc" UWORD _CNV_A_R_LINEAR_____161_CM 1 0. -400. 1647.96875 ECU_ADDRESS 0xd00033e4 FORMAT "%10.5" /end MEASUREMENT
/begin MEASUREMENT Vxx_agb_max_tqe_tgt "Slow request wich will be sent to torque arbitration in max bloc" UWORD _CNV_A_R_LINEAR_____161_CM 1 0. -400. 1647.96875 ECU_ADDRESS 0xd00033e6 FORMAT "%10.5" /end MEASUREMENT
/begin MEASUREMENT Vxx_agb_min_tqe_sp "Setpoint request wich will be sent to torque arbitration in min bloc" UWORD _CNV_A_R_LINEAR_____161_CM 1 0. -400. 1647.96875 ECU_ADDRESS 0xd00033e8 FORMAT "%10.5" /end MEASUREMENT
/begin MEASUREMENT Vxx_agb_min_tqe_tgt "Slow request wich will be sent to torque arbitration in min bloc" UWORD _CNV_A_R_LINEAR_____161_CM 1 0. -400. 1647.96875 ECU_ADDRESS 0xd00033ea FORMAT "%10.5" /end MEASUREMENT
/begin CHARACTERISTIC Cbx_max_gear_cge_dly_ena_cfm "activation of max gear change delay diagnosis. Inactive only on bench (for tunning features)" VALUE 0xa00214a6 _REC_S1VAL_20_u1 1. _CNV_A_R_ECME_LINEA_0_CM 0. 1. FORMAT "%1.0" BIT_MASK 0x1 /end CHARACTERISTIC
/begin CHARACTERISTIC Cbx_tq_cmd_typ_cfm "in_pci_agb_sdftaxx/Torque command type : 1 (new torque protocol) - Shift in progress : 0 (old torque protocol)" VALUE 0xa00214a7 _REC_S1VAL_20_u1 1. _CNV_A_R_ECME_LINEA_0_CM 0. 1. FORMAT "%1.0" BIT_MASK 0x1 /end CHARACTERISTIC
/begin CHARACTERISTIC Cxx_agb_abst_dly "Maximum permitted time without frame, before fault detection" VALUE 0xa0021490 _REC_S1VAL_20_u2 65.535 _CNV_A_R_LINEAR_____58_CM 0. 65.535 FORMAT "%5.3" /end CHARACTERISTIC
/begin CHARACTERISTIC Cxx_agb_clck_max_step "Maximum AGB clock step" VALUE 0xa00214a8 _REC_S1VAL_20_u1 255. _CNV_A_R_ECME_LINEA_0_CM 0. 255. FORMAT "%3.0" /end CHARACTERISTIC
/begin CHARACTERISTIC Cxx_agb_ctr_max_thd "Failure counter threshold. It authorize N successive failures before downgraded mode activation" VALUE 0xa00214a9 _REC_S1VAL_20_u1 15. _CNV_A_R_ECME_LINEA_0_CM 0. 15. FORMAT "%2.0" /end CHARACTERISTIC
/begin CHARACTERISTIC Cxx_agb_int_rst_t "Time after we reset the integrator after a shift" VALUE 0xa00214aa _REC_S1VAL_20_u1 255. _CNV_A_R_LINEAR_____82_CM 0. 255. FORMAT "%3.0" /end CHARACTERISTIC
/begin CHARACTERISTIC Cxx_agb_max_tqe "Max value which can be set in CAN message list for torque" VALUE 0xa0021492 _REC_S1VAL_20_u2 2047.96875 _CNV_A_R_LINEAR_____161_CM -400. 1647.96875 FORMAT "%10.5" /end CHARACTERISTIC
/begin CHARACTERISTIC Cxx_agb_slwr_neg "Negative torque slew rate calibration in case of protocol error" VALUE 0xa0021494 _REC_S1VAL_20_u2 10235. _CNV_A_R_LINEAR_____162_CM -10235. 0. FORMAT "%6.0" /end CHARACTERISTIC
/begin CHARACTERISTIC Cxx_agb_slwr_pos "Positive torque slew rate calibration in case of protocol error" VALUE 0xa0021496 _REC_S1VAL_20_u2 10235. _CNV_A_R_LINEAR_____163_CM 0. 10235. FORMAT "%5.0" /end CHARACTERISTIC
/begin CHARACTERISTIC Cxx_dfdec_agb_data "AGB data detected failure counter decrement" VALUE 0xa0021498 _REC_S1VAL_20_u2 65535. _CNV_A_R_ECME_LINEA_0_CM 0. 65535. FORMAT "%5.0" /end CHARACTERISTIC
/begin CHARACTERISTIC Cxx_dfdec_agb_no_frm "AGB Missing Message detected failure counter decrement" VALUE 0xa002149a _REC_S1VAL_20_u2 65535. _CNV_A_R_ECME_LINEA_0_CM 0. 65535. FORMAT "%5.0" /end CHARACTERISTIC
/begin CHARACTERISTIC Cxx_dfinc_agb_data "AGB data detected failure counter increment" VALUE 0xa002149c _REC_S1VAL_20_u2 65535. _CNV_A_R_ECME_LINEA_0_CM 0. 65535. FORMAT "%5.0" /end CHARACTERISTIC
/begin CHARACTERISTIC Cxx_dfinc_agb_no_frm "AGB Missing Message detected failure counter increment" VALUE 0xa002149e _REC_S1VAL_20_u2 65535. _CNV_A_R_ECME_LINEA_0_CM 0. 65535. FORMAT "%5.0" /end CHARACTERISTIC
/begin CHARACTERISTIC Cxx_dft_agb_tq_sp_lim "torque limitation applied when a wrong gear request occurs" VALUE 0xa00214a0 _REC_S1VAL_20_u2 2047.96875 _CNV_A_R_LINEAR_____161_CM -400. 1647.96875 FORMAT "%10.5" /end CHARACTERISTIC
/begin CHARACTERISTIC Cxx_i_agb_driv_tq_thd "Upper threshold of torque integrator detecting irregular shifts" VALUE 0xa00214a2 _REC_S1VAL_20_u2 6553.5 _CNV_A_R_LINEAR_____386_CM 0. 6553.5 FORMAT "%6.4" /end CHARACTERISTIC
/begin CHARACTERISTIC Cxx_max_gear_cge_dly "Maximum time allowed for a gear shift" VALUE 0xa00214ab _REC_S1VAL_20_u1 255. _CNV_A_R_LINEAR_____82_CM 0. 255. FORMAT "%3.0" /end CHARACTERISTIC
/begin CHARACTERISTIC Cxx_mux_agb_tqe_nok_raw "Raw CAN invalid value for AGB torque" VALUE 0xa00214a4 _REC_S1VAL_20_u2 4095. _CNV_A_R_ECME_LINEA_0_CM 0. 4095. FORMAT "%4.0" /end CHARACTERISTIC
/begin MEASUREMENT Vxx_agb_driv_spt_fac "Sportivity factor calculated by Automatic Transmission" UBYTE _CNV_A_R_LINEAR_____118_CM 1 0. 0. 1. ECU_ADDRESS 0xd0004c2f FORMAT "%9.7" /end MEASUREMENT
/begin AXIS_PTS Ntb_gear "Gearbox ratio breakpoint" 0xa002ac48 Vxx_gear _REC_A2AXS_20_u1 7. _CNV_A_R_LINEAR_____113_CM 8 -1. 6. READ_ONLY FORMAT "%2.0" /end AXIS_PTS
/begin AXIS_PTS Ctb_toil "engine oil temperature breakpoints" 0xa002a6d8 Vxx_toil _REC_A2AXS_20_u2 240. _CNV_A_R_LINEAR_____54_CM 16 -40. 200. FORMAT "%5.1" /end AXIS_PTS
/begin COMPU_METHOD _CNV_A_R_ECME_LINEA_0_CM "" RAT_FUNC "%6.3" "-" COEFFS 0 1. 0. 0 0 1 /end COMPU_METHOD
/begin COMPU_METHOD _CNV_A_R_LINEAR_____2_CM "" RAT_FUNC "%6.3" "rpm" COEFFS 0 3.125e-002 0. 0 0 1 /end COMPU_METHOD
/begin COMPU_METHOD _CNV_S_2_RANGE______3_CM "" TAB_VERB "%6.3" "-" COMPU_TAB_REF _CNV_S_2_RANGE______3 /end COMPU_METHOD
/begin COMPU_VTAB _CNV_S_2_RANGE______3 "" TAB_VERB 2 0 "0" 1 "1" /end COMPU_VTAB
/begin COMPU_METHOD _CNV_A_R_LINEAR_____4_CM "" RAT_FUNC "%6.3" "s" COEFFS 0 10. 0. 0 0 1 /end COMPU_METHOD
/begin COMPU_METHOD _CNV_A_R_LINEAR_____23_CM "" RAT_FUNC "%6.3" "rpm/s" COEFFS 0 1. 0. 0 0 1 /end COMPU_METHOD
/begin COMPU_METHOD _CNV_A_R_ENSD_LINEA_24_CM "" RAT_FUNC "%6.3" "rpm" COEFFS 0 4. 0. 0 0 1 /end COMPU_METHOD
/begin COMPU_METHOD _CNV_A_R_LINEAR_____34_CM "" RAT_FUNC "%6.3" "s" COEFFS 0 100. 0. 0 0 1 /end COMPU_METHOD
/begin COMPU_METHOD _CNV_A_R_LINEAR_____43_CM "" RAT_FUNC "%6.3" "-" COEFFS 0 128. 0. 0 0 1 /end COMPU_METHOD
/begin COMPU_METHOD _CNV_A_R_LINEAR_____52_CM "" RAT_FUNC "%6.3" "mV" COEFFS 0 1. 0. 0 0 1 /end COMPU_METHOD
/begin COMPU_METHOD _CNV_A_R_LINEAR_____54_CM "" RAT_FUNC "%6.3" "∞C" COEFFS 0 10. 400. 0 0 1 /end COMPU_METHOD
/begin COMPU_METHOD _CNV_A_R_LINEAR_____55_CM "" RAT_FUNC "%6.3" "TDC" COEFFS 0 1. 0. 0 0 1 /end COMPU_METHOD
/begin COMPU_METHOD _CNV_A_R_LINEAR_____57_CM "" RAT_FUNC "%6.3" "hPa" COEFFS 0 1. 0. 0 0 1 /end COMPU_METHOD
/begin COMPU_METHOD _CNV_A_R_LINEAR_____58_CM "" RAT_FUNC "%6.3" "s" COEFFS 0 1000. 0. 0 0 1 /end COMPU_METHOD
/begin COMPU_METHOD _CNV_A_R_LINEAR_____70_CM "" RAT_FUNC "%6.3" "km/h" COEFFS 0 100. 0. 0 0 1 /end COMPU_METHOD
/begin COMPU_METHOD _CNV_A_R_LINEAR_____76_CM "" RAT_FUNC "%6.3" "∞CRK" COEFFS 0 50. 0. 0 0 1 /end COMPU_METHOD
/begin COMPU_METHOD _CNV_A_R_LINEAR_____82_CM "" RAT_FUNC "%6.3" "s" COEFFS 0 1. 0. 0 0 1 /end COMPU_METHOD
/begin COMPU_METHOD _CNV_A_R_LINEAR_____94_CM "" RAT_FUNC "%6.3" "%" COEFFS 0 100. 0. 0 0 1 /end COMPU_METHOD
/begin COMPU_METHOD _CNV_A_R_LINEAR_____108_CM "" RAT_FUNC "%6.3" "-" COEFFS 0 1000. 0. 0 0 1 /end COMPU_METHOD
/begin COMPU_METHOD _CNV_A_R_LINEAR_____109_CM "" RAT_FUNC "%6.3" "kg/h" COEFFS 0 20. 0. 0 0 1 /end COMPU_METHOD
/begin COMPU_METHOD _CNV_A_R_LINEAR_____113_CM "" RAT_FUNC "%6.3" "-" COEFFS 0 1. 1. 0 0 1 /end COMPU_METHOD
/begin COMPU_METHOD _CNV_A_R_LINEAR_____118_CM "" RAT_FUNC "%6.3" "-" COEFFS 0 255. 0. 0 0 1 /end COMPU_METHOD
/begin COMPU_METHOD _CNV_S_3_STATUS_OK__120_CM "" TAB_VERB "%6.3" "-" COMPU_TAB_REF _CNV_S_3_STATUS_OK__120 /end COMPU_METHOD
/begin COMPU_VTAB _CNV_S_3_STATUS_OK__120 "" TAB_VERB 3 0 "Nsx_vld_nok_0" 1 "Nsx_vld_ok_1" 2 "Nsx_vld_fail_2" /end COMPU_VTAB
/begin COMPU_METHOD _CNV_A_R_LINEAR_____123_CM "" RAT_FUNC "%6.3" "Nm" COEFFS 0 32. 0. 0 0 1 /end COMPU_METHOD
/begin COMPU_METHOD _CNV_A_R_LINEAR_____125_CM "" RAT_FUNC "%6.3" "-" COEFFS 0 1024. 0. 0 0 1 /end COMPU_METHOD
/begin COMPU_METHOD _CNV_A_R_LINEAR_____127_CM "" RAT_FUNC "%6.3" "Nm" COEFFS 0 32. 32768. 0 0 1 /end COMPU_METHOD
/begin COMPU_METHOD _CNV_A_R_LINEAR_____144_CM "" RAT_FUNC "%6.3" "ms" COEFFS 0 1. 0. 0 0 1 /end COMPU_METHOD
/begin COMPU_METHOD _CNV_A_R_LINEAR_____145_CM "" RAT_FUNC "%6.3" "µs" COEFFS 0 1. 0. 0 0 1 /end COMPU_METHOD
/begin COMPU_METHOD _CNV_A_R_LINEAR_____150_CM "" RAT_FUNC "%6.3" "V" COEFFS 0 100. 0. 0 0 1 /end COMPU_METHOD
/begin COMPU_METHOD _CNV_S_16_RANGE_ERR__151_CM "" TAB_VERB "%6.3" "" COMPU_TAB_REF _CNV_S_16_RANGE_ERR__151 /end COMPU_METHOD
/begin COMPU_VTAB _CNV_S_16_RANGE_ERR__151 "" TAB_VERB 16 0 "NO_SYM" 1 "SYM_0" 2 "SYM_1" 3 "SYM_0, SYM_1" 4 "SYM_2" 5 "SYM_0, SYM_2" 6 "SYM_1, SYM_2" 7 "SYM_0, SYM_1, SYM_2" 8 "SYM_3" 9 "SYM_0, SYM_3" 10 "SYM_1, SYM_3" 11 "SYM_0, SYM_1,SYM_3" 12 "SYM_2, SYM_3" 13 "SYM_0, SYM_2, SYM_3" 14 "SYM_1, SYM_2, SYM_3" 15 "SYM_0, SYM_1, SYM_2, SYM_3" /end COMPU_VTAB
/begin COMPU_METHOD _CNV_S_3_STATUS_OK__158_CM "" TAB_VERB "%6.3" "" COMPU_TAB_REF _CNV_S_3_STATUS_OK__158 /end COMPU_METHOD
/begin COMPU_VTAB _CNV_S_3_STATUS_OK__158 "" TAB_VERB 3 0 "Nsx_vld_nok_0" 1 "Nsx_vld_ok_1" 2 "Nsx_vld_fail_2" /end COMPU_VTAB
/begin COMPU_METHOD _CNV_A_R_LINEAR_____161_CM "" RAT_FUNC "%6.3" "Nm" COEFFS 0 32. 12800. 0 0 1 /end COMPU_METHOD
/begin COMPU_METHOD _CNV_A_R_LINEAR_____162_CM "" RAT_FUNC "%6.3" "Nm/s" COEFFS 0 -0.2 0. 0 0 1 /end COMPU_METHOD
/begin COMPU_METHOD _CNV_A_R_LINEAR_____163_CM "" RAT_FUNC "%6.3" "Nm/s" COEFFS 0 0.2 0. 0 0 1 /end COMPU_METHOD
/begin COMPU_METHOD _CNV_A_R_LINEAR_____175_CM "" RAT_FUNC "%6.3" "-" COEFFS 0 64. 0. 0 0 1 /end COMPU_METHOD
/begin COMPU_METHOD _CNV_A_R_LINEAR_____220_CM "" RAT_FUNC "%6.3" "∞C" COEFFS 0 1. 40. 0 0 1 /end COMPU_METHOD
/begin COMPU_METHOD _CNV_A_R_LINEAR_____231_CM "" RAT_FUNC "%6.3" "Hz" COEFFS 0 1. 0. 0 0 1 /end COMPU_METHOD
/begin COMPU_METHOD _CNV_A_R_LINEAR_____257_CM "" RAT_FUNC "%6.3" "ratio" COEFFS 0 800. 0. 0 0 1 /end COMPU_METHOD
/begin COMPU_METHOD _CNV_A_R_LINEAR_____267_CM "" RAT_FUNC "%6.3" "s" COEFFS 0 4. 0. 0 0 1 /end COMPU_METHOD
/begin COMPU_METHOD _CNV_A_R_LINEAR_____281_CM "" RAT_FUNC "%6.3" "mg/stk" COEFFS 0 0.183585313174946 0. 0 0 1 /end COMPU_METHOD
/begin COMPU_METHOD _CNV_A_R_LINEAR_____306_CM "" RAT_FUNC "%6.3" "bar" COEFFS 0 10. 0. 0 0 1 /end COMPU_METHOD
/begin COMPU_METHOD _CNV_A_R_LINEAR_____330_CM "" RAT_FUNC "%6.3" "rpm/s" COEFFS 0 -1. 0. 0 0 1 /end COMPU_METHOD
/begin COMPU_METHOD _CNV_A_R_LINEAR_____347_CM "" RAT_FUNC "%6.3" "Nm/(rpm.s)" COEFFS 0 100. 0. 0 0 1 /end COMPU_METHOD
/begin COMPU_METHOD _CNV_S_3_STATUS_OK__348_CM "" TAB_VERB "%6.3" "[-]" COMPU_TAB_REF _CNV_S_3_STATUS_OK__348 /end COMPU_METHOD
/begin COMPU_VTAB _CNV_S_3_STATUS_OK__348 "" TAB_VERB 3 0 "Nsx_vld_nok_0" 1 "Nsx_vld_ok_1" 2 "Nsx_vld_fail_2" /end COMPU_VTAB
/begin COMPU_METHOD _CNV_A_R_LINEAR_____349_CM "" RAT_FUNC "%6.3" "1/s" COEFFS 0 100. 0. 0 0 1 /end COMPU_METHOD
/begin COMPU_METHOD _CNV_A_R_LINEAR_____350_CM "" RAT_FUNC "%6.3" "%" COEFFS 0 256. 0. 0 0 1 /end COMPU_METHOD
/begin COMPU_METHOD _CNV_A_R_LINEAR_____351_CM "" RAT_FUNC "%6.3" "%/∞Crk" COEFFS 0 100. 0. 0 0 1 /end COMPU_METHOD
/begin COMPU_METHOD _CNV_A_R_LINEAR_____352_CM "" RAT_FUNC "%6.3" "µs≤" COEFFS 0 1.525902189669642e-005 0. 0 0 1 /end COMPU_METHOD
/begin COMPU_METHOD _CNV_A_R_LINEAR_____353_CM "" RAT_FUNC "%6.3" "%/s" COEFFS 0 16. 0. 0 0 1 /end COMPU_METHOD
/begin COMPU_METHOD _CNV_A_R_LINEAR_____354_CM "" RAT_FUNC "%6.3" "%" COEFFS 0 128.0005468856814 32768.14000273443 0 0 1 /end COMPU_METHOD
/begin COMPU_METHOD _CNV_A_R_LINEAR_____355_CM "" RAT_FUNC "%6.3" "%" COEFFS 0 128. 32768. 0 0 1 /end COMPU_METHOD
/begin COMPU_METHOD _CNV_A_R_LINEAR_____356_CM "" RAT_FUNC "%6.3" "%" COEFFS 0 8388608.000000011 2147483648.000003 0 0 1 /end COMPU_METHOD
/begin COMPU_METHOD _CNV_A_R_LINEAR_____357_CM "" RAT_FUNC "%6.3" "%" COEFFS 0 100. 20000. 0 0 1 /end COMPU_METHOD
/begin COMPU_METHOD _CNV_A_R_LINEAR_____358_CM "" RAT_FUNC "%6.3" "-" COEFFS 0 4096. 0. 0 0 1 /end COMPU_METHOD
/begin COMPU_METHOD _CNV_A_R_LINEAR_____359_CM "" RAT_FUNC "%6.3" "∞CRK" COEFFS 0 8388607.999999995 -1.192092895507813e-006 0 0 1 /end COMPU_METHOD
/begin COMPU_METHOD _CNV_A_R_LINEAR_____360_CM "" RAT_FUNC "%6.3" "∞CRK" COEFFS 0 16777216.00000002 0. 0 0 1 /end COMPU_METHOD
/begin COMPU_METHOD _CNV_A_R_LINEAR_____361_CM "" RAT_FUNC "%6.3" "%/∞Crk" COEFFS 0 4096. 32768. 0 0 1 /end COMPU_METHOD
/begin COMPU_METHOD _CNV_A_R_LINEAR_____362_CM "" RAT_FUNC "%6.3" "" COEFFS 0 4096. 0. 0 0 1 /end COMPU_METHOD
/begin COMPU_METHOD _CNV_A_R_LINEAR_____363_CM "" RAT_FUNC "%6.3" "-" COEFFS 0 8388608.000000011 2147483648.000003 0 0 1 /end COMPU_METHOD
/begin COMPU_METHOD _CNV_A_R_LINEAR_____364_CM "" RAT_FUNC "%6.3" "∞CRK" COEFFS 0 50. 18000. 0 0 1 /end COMPU_METHOD
/begin COMPU_METHOD _CNV_A_R_LINEAR_____365_CM "" RAT_FUNC "%6.3" "∞CRK" COEFFS 0 512. 0. 0 0 1 /end COMPU_METHOD
/begin COMPU_METHOD _CNV_A_R_LINEAR_____366_CM "" RAT_FUNC "%6.3" "-" COEFFS 0 655.35 0. 0 0 1 /end COMPU_METHOD
/begin COMPU_METHOD _CNV_A_R_LINEAR_____367_CM "" RAT_FUNC "%6.3" "1/s" COEFFS 0 128.0005468856814 0. 0 0 1 /end COMPU_METHOD
/begin COMPU_METHOD _CNV_A_R_LINEAR_____368_CM "" RAT_FUNC "%6.3" "[1/s]" COEFFS 0 256. 0. 0 0 1 /end COMPU_METHOD
/begin COMPU_METHOD _CNV_A_R_LINEAR_____369_CM "" RAT_FUNC "%6.3" "%/(∞Crk*s)" COEFFS 0 128.0005468856814 0. 0 0 1 /end COMPU_METHOD
/begin COMPU_METHOD _CNV_A_R_LINEAR_____370_CM "" RAT_FUNC "%6.3" "%/(∞Crk*s≤)" COEFFS 0 127.9990234300494 -0.2500019073631847 0 0 1 /end COMPU_METHOD
/begin COMPU_METHOD _CNV_A_R_LINEAR_____371_CM "" RAT_FUNC "%6.3" "%/(∞Crk*s)" COEFFS 0 127.9990234300494 -0.2500019073631847 0 0 1 /end COMPU_METHOD
/begin COMPU_METHOD _CNV_A_R_LINEAR_____372_CM "" RAT_FUNC "%6.3" "%/∞Crk" COEFFS 0 4096. 0. 0 0 1 /end COMPU_METHOD
/begin COMPU_METHOD _CNV_A_R_LINEAR_____373_CM "" RAT_FUNC "%6.3" "[1/s≤]" COEFFS 0 32. 0. 0 0 1 /end COMPU_METHOD
/begin COMPU_METHOD _CNV_A_R_LINEAR_____374_CM "" RAT_FUNC "%6.3" "-" COEFFS 0 0.1 0. 0 0 1 /end COMPU_METHOD
/begin COMPU_METHOD _CNV_A_R_LINEAR_____375_CM "" RAT_FUNC "%6.3" "-" COEFFS 0 98303.99999999926 -65536.0003276795 0 0 1 /end COMPU_METHOD
/begin COMPU_METHOD _CNV_A_R_LINEAR_____376_CM "" RAT_FUNC "%6.3" "-" COEFFS 0 196607.9999999997 0. 0 0 1 /end COMPU_METHOD
/begin COMPU_METHOD _CNV_A_R_LINEAR_____377_CM "" RAT_FUNC "%6.3" "-" COEFFS 0 762.0233462275968 -507.0233462275968 0 0 1 /end COMPU_METHOD
/begin COMPU_METHOD _CNV_A_R_LINEAR_____378_CM "" RAT_FUNC "%6.3" "-" COEFFS 0 767.9998843482529 -767.9998843482529 0 0 1 /end COMPU_METHOD
/begin COMPU_METHOD _CNV_A_R_LINEAR_____379_CM "" RAT_FUNC "%6.3" "-" COEFFS 0 196605.0000152363 0. 0 0 1 /end COMPU_METHOD
/begin COMPU_METHOD _CNV_A_R_LINEAR_____380_CM "" RAT_FUNC "%6.3" "∞C" COEFFS 0 0.25 10. 0 0 1 /end COMPU_METHOD
/begin COMPU_METHOD _CNV_A_R_LINEAR_____384_CM "" RAT_FUNC "%6.3" "Nm/s" COEFFS 0 -5.12 0. 0 0 1 /end COMPU_METHOD
/begin COMPU_METHOD _CNV_A_R_LINEAR_____385_CM "" RAT_FUNC "%6.3" "Nm/s" COEFFS 0 5.12 0. 0 0 1 /end COMPU_METHOD
/begin COMPU_METHOD _CNV_A_R_LINEAR_____386_CM "" RAT_FUNC "%6.3" "Nms" COEFFS 0 10. 0. 0 0 1 /end COMPU_METHOD
/begin RECORD_LAYOUT _REC_S1VAL_20_u1 FNC_VALUES 1 UBYTE COLUMN_DIR DIRECT /end RECORD_LAYOUT
/begin RECORD_LAYOUT _REC_A2AXS_20_u1 NO_AXIS_PTS_X 1 UBYTE AXIS_PTS_X 2 UBYTE INDEX_INCR DIRECT /end RECORD_LAYOUT
/begin RECORD_LAYOUT _REC_S1VAL_20_u2 FNC_VALUES 1 UWORD COLUMN_DIR DIRECT /end RECORD_LAYOUT
/begin RECORD_LAYOUT _REC_S1VAL_20_s2 FNC_VALUES 1 SWORD COLUMN_DIR DIRECT /end RECORD_LAYOUT
/begin RECORD_LAYOUT _REC_A2AXS_20_u2 NO_AXIS_PTS_X 1 UWORD AXIS_PTS_X 2 UWORD INDEX_INCR DIRECT /end RECORD_LAYOUT
/begin RECORD_LAYOUT _REC_A1CUR_20_u1_u2 FNC_VALUES 1 UBYTE COLUMN_DIR DIRECT /end RECORD_LAYOUT
/begin RECORD_LAYOUT _REC_A1CUR_20_u1_u1 FNC_VALUES 1 UBYTE COLUMN_DIR DIRECT /end RECORD_LAYOUT
/begin RECORD_LAYOUT _REC_A1CUR_20_u2_u1 FNC_VALUES 1 UWORD COLUMN_DIR DIRECT /end RECORD_LAYOUT
/begin RECORD_LAYOUT _REC_A1CUR_20_u2_u2 FNC_VALUES 1 UWORD COLUMN_DIR DIRECT /end RECORD_LAYOUT
/begin RECORD_LAYOUT _REC_A1MAP_20_u2_u1_u2 FNC_VALUES 1 UWORD COLUMN_DIR DIRECT /end RECORD_LAYOUT
/begin FUNCTION SmLimCtl_Ntqcxxx ""
 /begin DEF_CHARACTERISTIC Ctd_n_prop_thd Ctd_ovn_tq_int_k Ctd_ovn_tq_prop_k Cxx_ovn_tq_prop_t_fil Cxx_tqe_max_ovn /end DEF_CHARACTERISTIC
 /begin OUT_MEASUREMENT Vxx_lim_dif_n Vxx_lim_dif_n_prop Vxx_ovn_tq_cor Vxx_ovn_tq_cor_p_i Vxx_ovn_tq_int Vxx_ovn_tq_prop /end OUT_MEASUREMENT
/end FUNCTION
/begin FUNCTION SmLimCtl_Ntspcxx "" /begin DEF_CHARACTERISTIC Cxx_inj_stop_n_ofs /end DEF_CHARACTERISTIC /begin OUT_MEASUREMENT Vbx_ovn_cut_sp /end OUT_MEASUREMENT /end FUNCTION
/begin FUNCTION SmLimSpt "" /begin SUB_FUNCTION SmLimSpt_Nramsxx SmLimSpt_Nlimxxx SmLimSpt_Fsncfxx /end SUB_FUNCTION /end FUNCTION
/begin FUNCTION SmLimSpt_Nramsxx "" /begin DEF_CHARACTERISTIC Ctp_max_rams_n_dec Cxx_max_rams_n_1 Cxx_max_rams_n_2 /end DEF_CHARACTERISTIC /begin OUT_MEASUREMENT Vbx_n_rams_lim_act Vsx_n_rams_lim_vld Vxx_max_rams_n /end OUT_MEASUREMENT /end FUNCTION
/begin FUNCTION SmLimSpt_Nlimxxx ""
 /begin DEF_CHARACTERISTIC Ctd_gear_cge_max_n_ofs Ctp_max_n_gear Ctp_max_n_tco Ctp_max_n_toil Ctp_ovn_tq_cor_ena Ctp_sta_tco_dly Cbx_max_n_fl_tkof_ant_coup_dsb Cbx_max_n_fl_tkof_ena Cbx_max_n_fl_tkof_ovn_tq_ena Cxx_max_n_dec_slop Cxx_max_n_fl_tkof Cxx_max_n_fl_tkof_ext_ctrl_dly Cxx_max_n_fl_tkof_vs_thd Cxx_max_n_gear_dft Cxx_max_n_inc_slop Cxx_max_n_ovn_ofs Cxx_max_n_tco_toil_dft Cxx_max_n_thd_oil_ovn Cxx_sta_tco_dly_dft /end DEF_CHARACTERISTIC
 /begin OUT_MEASUREMENT Vbx_gear_cge_max_n Vbx_max_n_fl_tkof_act Vbx_max_n_fl_tkof_cdn Vbx_ovn_sta_ena Vbx_ovn_tq_cor_ena Vxx_max_n_inj Vxx_max_n_nom Vxx_max_n_ovn /end OUT_MEASUREMENT
/end FUNCTION
/begin FUNCTION SmLimSpt_Fsncfxx "" /begin DEF_CHARACTERISTIC Cxx_n_lim_crk_cfm /end DEF_CHARACTERISTIC
 /begin OUT_MEASUREMENT Vbx_n_rams_lim_act_1 Vbx_n_rams_lim_act_2 Vbx_ovn_tq_cor_dft_dsb /end OUT_MEASUREMENT
/end FUNCTION
/begin FUNCTION InSmiSsr ""
 /begin SUB_FUNCTION InSmiSsr_Accluxx InSmiSsr_Acclucs InSmiSsr_Agbspcs InSmiSsr_Agbxxcs InSmiSsr_Ptcxxcs InSmiSsr_Windxcs InSmiSsr_Acsiscs InSmiSsr_Acclumd /end SUB_FUNCTION
/end FUNCTION
/begin FUNCTION InSmiSsr_Accluxx ""
 /begin DEF_CHARACTERISTIC Ctb_ac_acel_is Ctp_ac_acel_is_swi_off Ctp_ac_acel_is_swi_on Ctp_ac_acel_is_val_off Ctp_ac_acel_is_val_on Cxx_ac_req_off_ac_acel_is_sp /end DEF_CHARACTERISTIC
 /begin OUT_MEASUREMENT Vsx_mdl_ac_acel_is_sp_vld Vxx_mdl_ac_acel_is_sp /end OUT_MEASUREMENT
/end FUNCTION
/begin FUNCTION InSmiSsr_Acclucs "" /begin OUT_MEASUREMENT Vxx_ac_acel_is_sp /end OUT_MEASUREMENT /end FUNCTION
/begin FUNCTION InSmiSsr_Agbspcs "" /begin OUT_MEASUREMENT Vsx_agb_is_acel_sp_vld Vxx_agb_is_acel_sp /end OUT_MEASUREMENT /end FUNCTION
/begin FUNCTION InSmiSsr_Agbxxcs "" /begin OUT_MEASUREMENT Vbx_agb_is_acel_req Vsx_agb_is_acel_req_vld /end OUT_MEASUREMENT /end FUNCTION
/begin FUNCTION InSmiSsr_Ptcxxcs "" /begin OUT_MEASUREMENT Vbx_ptc_is_acel_req /end OUT_MEASUREMENT /end FUNCTION
/begin FUNCTION InSmiSsr_Windxcs "" /begin OUT_MEASUREMENT Vbx_el_bk_wind Vbx_el_wind_is_acel /end OUT_MEASUREMENT /end FUNCTION
/begin FUNCTION InSmiSsr_Acsiscs "" /begin OUT_MEASUREMENT Vbx_acs_acel_is_req /end OUT_MEASUREMENT /end FUNCTION
/begin FUNCTION InSmiSsr_Acclumd "" /begin OUT_MEASUREMENT Vxx_tair_ext /end OUT_MEASUREMENT /end FUNCTION
/begin FUNCTION BoAsoAeo ""
 /begin DEF_CHARACTERISTIC c_ctr_pulse_ivvt_dly c_frq_ivvthpwm c_maf_hb_max_ad_ref_di_ivvt c_n_32_max_ad_ref_di_ivvt c_n_32_min_ad_ref_di_ivvt c_toil_max_ad_ref_di_ivvt c_toil_min_ad_ref_di_ivvt c_vvtpwm_diag_max_scg c_vvtpwm_diag_min_oc c_vvtpwm_diag_min_scp /end DEF_CHARACTERISTIC
 /begin OUT_MEASUREMENT Vbx_df_in_vvtc_sldv_oc Vbx_df_in_vvtc_sldv_scg Vbx_df_in_vvtc_sldv_scw Vbx_diag_ena_in_vvtc_sldv_oc Vbx_diag_ena_in_vvtc_sldv_scg Vbx_diag_ena_in_vvtc_sldv_scw cdn_diag_slv_ivvt_ex[0] cdn_diag_slv_ivvt_in[0] ctr_pulse_ivvt_dly err_diag_slv_ivvt_ex[0] err_diag_slv_ivvt_in[0] frq_ivvthpwm lv_cam_sp_ref_ad_di_ivvt lv_di_ad_ref_cam_ivvt_in lv_pulse_ivvt lv_pulse_ivvt_tmp vvtpwm /end OUT_MEASUREMENT
/end FUNCTION
/begin FUNCTION OuAsoAeo ""
 /begin SUB_FUNCTION OuAsoAeo_Schxxxx OuAsoAeo_Ivvtctl OuAsoAeo_Ivvtdgx OuAsoAeo_Ivvtlck /end SUB_FUNCTION
/end FUNCTION
/begin FUNCTION OuAsoAeo_Schxxxx "" /begin DEF_CHARACTERISTIC Cbx_in_vvtc_lck_cfm /end DEF_CHARACTERISTIC /end FUNCTION
/begin FUNCTION OuAsoAeo_Ivvtctl ""
 /begin DEF_CHARACTERISTIC Ctb_in_vvtc_lck_cyc_t Ctb_in_vvtc_n_bkpt Ctp_in_vvtc_awg Ctp_in_vvtc_awg_max_thd Ctp_in_vvtc_awg_min_thd Ctp_in_vvtc_lck_pwm_thd Ctp_in_vvtc_pg Cbx_in_vvtc_cho_tgt_sp Cbx_in_vvtc_ena_inh_cmd Cbx_in_vvtc_ena_int_ad Cbx_in_vvtc_ena_vb_cps Cbx_in_vvtc_pwm_bch Cxx_in_cam_toth_per_max Cxx_in_cam_toth_per_min Cxx_in_vvtc_angl_max_str Cxx_in_vvtc_den_cl_cps_0 Cxx_in_vvtc_den_tgt_sp_1 Cxx_in_vvtc_ftc_vb Cxx_in_vvtc_h_psn_thd_ol_cl Cxx_in_vvtc_int_max_thd Cxx_in_vvtc_int_val Cxx_in_vvtc_int_val_inc Cxx_in_vvtc_int_val_ini Cxx_in_vvtc_l_psn_thd_ol_cl Cxx_in_vvtc_lck_cyc_t_1 Cxx_in_vvtc_lck_cyc_t_2 Cxx_in_vvtc_mov_det_thd Cxx_in_vvtc_nom_vb Cxx_in_vvtc_num_cl_cps_0 Cxx_in_vvtc_num_cl_cps_1 Cxx_in_vvtc_num_pcmd_0 Cxx_in_vvtc_num_pcmd_1 Cxx_in_vvtc_num_pcmd_2 Cxx_in_vvtc_num_tgt_sp_0 Cxx_in_vvtc_num_tgt_sp_1 Cxx_in_vvtc_num_tgt_sp_2 Cxx_in_vvtc_pwm_bch Cxx_in_vvtc_t_sldv_cln_cyc Cxx_in_vvtc_t_sldv_cln_cyc_on Cxx_in_vvtc_tgt_sp_ftc /end DEF_CHARACTERISTIC
 /begin OUT_MEASUREMENT Vbx_in_vvtc_ad_end Vbx_in_vvtc_ad_int_val Vbx_in_vvtc_cl_ctl Vbx_in_vvtc_cl_out_l_trt Vbx_in_vvtc_crk_syn Vbx_in_vvtc_int_val_ini Vbx_in_vvtc_lck_act_sta_det Vbx_in_vvtc_lck_cyc_sta_det Vxx_in_cam_toth_per_sat Vxx_in_cam_toth_per_sat_sq Vxx_in_vvtc_angl_sp_1 Vxx_in_vvtc_angl_sp_2 Vxx_in_vvtc_angl_sp_lck Vxx_in_vvtc_awg_lp Vxx_in_vvtc_cl_cps Vxx_in_vvtc_cl_cps_1 Vxx_in_vvtc_cl_cps_tmp Vxx_in_vvtc_cl_ctl Vxx_in_vvtc_cl_ctl_dif Vxx_in_vvtc_cl_ctl_wio_sat Vxx_in_vvtc_cl_ctl_wit_sat Vxx_in_vvtc_den_cl_cps_0 Vxx_in_vvtc_den_cl_cps_1 Vxx_in_vvtc_den_cl_cps_tmp Vxx_in_vvtc_den_pcmd_tmp Vxx_in_vvtc_den_pcmd_tmp_1 Vxx_in_vvtc_den_pcmd_tmp_2 Vxx_in_vvtc_den_tgt_sp_0 Vxx_in_vvtc_den_tgt_sp_1 Vxx_in_vvtc_den_tgt_sp_2 Vxx_in_vvtc_den_tgt_sp_tmp Vxx_in_vvtc_den_tgt_sp_tmp_1 Vxx_in_vvtc_den_tgt_sp_tmp_2 Vxx_in_vvtc_int_val Vxx_in_vvtc_int_val_tmp Vxx_in_vvtc_lck_cyc_t Vxx_in_vvtc_num_cl_cps_0 Vxx_in_vvtc_num_cl_cps_1 Vxx_in_vvtc_num_cl_cps_tmp Vxx_in_vvtc_num_cl_cps_tmp_0 Vxx_in_vvtc_num_cl_cps_tmp_1 Vxx_in_vvtc_num_pcmd_0 Vxx_in_vvtc_num_pcmd_1 Vxx_in_vvtc_num_pcmd_2 Vxx_in_vvtc_num_pcmd_tmp Vxx_in_vvtc_num_pcmd_tmp_0 Vxx_in_vvtc_num_pcmd_tmp_1 Vxx_in_vvtc_num_pcmd_tmp_2 Vxx_in_vvtc_num_tgt_sp_0 Vxx_in_vvtc_num_tgt_sp_1 Vxx_in_vvtc_num_tgt_sp_2 Vxx_in_vvtc_num_tgt_sp_tmp Vxx_in_vvtc_num_tgt_sp_tmp_0 Vxx_in_vvtc_num_tgt_sp_tmp_1 Vxx_in_vvtc_num_tgt_sp_tmp_2 Vxx_in_vvtc_p_val Vxx_in_vvtc_pcmd Vxx_in_vvtc_pcmd_1 Vxx_in_vvtc_pcmd_2 Vxx_in_vvtc_pcmd_tmp Vxx_in_vvtc_pwm Vxx_in_vvtc_pwm_val Vxx_in_vvtc_pwm_vb_cps Vxx_in_vvtc_reg_err Vxx_in_vvtc_reg_err_1 Vxx_in_vvtc_sum_pint_val Vxx_in_vvtc_tgt_sp Vxx_in_vvtc_tgt_sp_1 Vxx_in_vvtc_tgt_sp_2 Vxx_in_vvtc_tgt_sp_cho Vxx_in_vvtc_tgt_sp_ftc Vxx_in_vvtc_tgt_sp_tmp Vxx_in_vvtc_vb_cps Vxx_in_vvtc_vb_fil /end OUT_MEASUREMENT
/end FUNCTION
/begin FUNCTION OuAsoAeo_Ivvtdgx ""
 /begin DEF_CHARACTERISTIC Cbx_diag_in_vvtc_ena_diag Cbx_in_vvtc_cho_ad_fail_mod Cbx_in_vvtc_cho_blk_fail_mod Cbx_in_vvtc_ena_inh_risk_zon Cbx_in_vvtc_temp_cho_ena_diag Cxx_dfdec_in_vvtc_ad Cxx_dfdec_in_vvtc_blk Cxx_dfdec_in_vvtc_dirt_lkg Cxx_dfdec_in_vvtc_sldv_oc Cxx_dfdec_in_vvtc_sldv_scg Cxx_dfdec_in_vvtc_sldv_scw Cxx_dfinc_in_vvtc_ad Cxx_dfinc_in_vvtc_blk Cxx_dfinc_in_vvtc_dirt_lkg Cxx_dfinc_in_vvtc_sldv_oc Cxx_dfinc_in_vvtc_sldv_scg Cxx_dfinc_in_vvtc_sldv_scw Cxx_in_vvtc_ctl_sat_inh_thd Cxx_in_vvtc_ctl_sat_max_thd Cxx_in_vvtc_ctl_sat_min_thd Cxx_in_vvtc_ctl_sat_t Cxx_in_vvtc_ctl_sat_t_risk_zon Cxx_in_vvtc_n_min_ena_diag Cxx_in_vvtc_reg_err_t Cxx_in_vvtc_reg_err_t_risk_zon Cxx_in_vvtc_reg_err_thd Cxx_in_vvtc_reg_err_thd_risk Cxx_in_vvtc_temp_min_ena_diag Cxx_in_vvtc_trt_blk_dlt_t Cxx_in_vvtc_trt_oor_t Cxx_in_vvtc_trt_psn_thd Cxx_in_vvtc_v_min_ena_diag /end DEF_CHARACTERISTIC
 /begin OUT_MEASUREMENT Vbx_df_in_vvtc_blk Vbx_df_in_vvtc_dirt_lkg Vbx_diag_ena_in_vvtc_ad Vbx_diag_ena_in_vvtc_blk Vbx_diag_ena_in_vvtc_dirt_lkg Vbx_in_vvtc_ctl_sat_det Vbx_in_vvtc_ctl_sat_det_risk Vbx_in_vvtc_ctl_sat_ini Vbx_in_vvtc_ctl_sat_ini_risk Vbx_in_vvtc_ena_diag Vbx_in_vvtc_fail_det Vbx_in_vvtc_inh_risk_zon Vbx_in_vvtc_lim Vbx_in_vvtc_reg_err_det Vbx_in_vvtc_reg_err_det_risk Vbx_in_vvtc_reg_err_ini Vbx_in_vvtc_trt_psn_det Vsx_in_vvtc_vld /end OUT_MEASUREMENT
/end FUNCTION
/begin FUNCTION OuAsoAeo_Ivvtlck ""
 /begin DEF_CHARACTERISTIC Cbx_diag_in_vvtc_ena_lck Cbx_in_vvtc_lck_cho_tco_toil Cxx_in_vvtc_lck_cyc_nr Cxx_in_vvtc_lck_load_h_thd Cxx_in_vvtc_lck_load_l_thd Cxx_in_vvtc_lck_n_h_thd Cxx_in_vvtc_lck_n_l_thd Cxx_in_vvtc_lck_t_mes Cxx_in_vvtc_lck_temp_h_thd Cxx_in_vvtc_lck_temp_l_thd Cxx_in_vvtc_lck_thd_angl_sp Cxx_in_vvtc_lck_thd_dft_psn /end DEF_CHARACTERISTIC
 /begin OUT_MEASUREMENT Vbx_in_vvtc_cdt_ena_lck Vbx_in_vvtc_ena_lck Vbx_in_vvtc_ena_lck_act Vbx_in_vvtc_vvtc_lck /end OUT_MEASUREMENT
/end FUNCTION
/begin FUNCTION BoAsoTco ""
 /begin DEF_CHARACTERISTIC c_ctr_pulse_wg_dly c_d4ft_ena c_wgpwm_diag_max_scg c_wgpwm_diag_min_oc c_wgpwm_diag_min_scp /end DEF_CHARACTERISTIC
 /begin OUT_MEASUREMENT Vbx_df_wgc_oc Vbx_df_wgc_scg Vbx_df_wgc_scw Vbx_diag_ena_wgc_oc Vbx_diag_ena_wgc_scg Vbx_diag_ena_wgc_scw CDN_DIAG_WG ctr_pulse_wg_dly ERR_DIAG_WG lv_pulse_wg lv_pulse_wg_tmp pwm_wg /end OUT_MEASUREMENT
/end FUNCTION
/begin FUNCTION InAsiAei ""
 /begin OUT_MEASUREMENT Vbx_in_cam_ena_cmp_eprm_psn Vxx_in_cam_eprm_psn_redg_0 Vxx_in_cam_eprm_psn_redg_1 Vxx_in_cam_eprm_psn_redg_2 Vxx_in_cam_eprm_psn_redg_3 /end OUT_MEASUREMENT
 /begin SUB_FUNCTION InAsiAei_Ivvtpsn /end SUB_FUNCTION
/end FUNCTION
/begin FUNCTION InAsiAei_Ivvtpsn ""
 /begin DEF_CHARACTERISTIC Ctb_in_cam_angl_redg_n_bkp Ctp_in_cam_angl_redg_cps Cbx_in_cam_conf_sens_sig Cbx_in_cam_ena_new_eprm_writ Cbx_in_cam_ena_rest_ad_whl Cbx_in_cam_forc_ad_whl Cbx_in_cam_inh_ad_whl Cbx_in_cam_inh_ad_whl_eng_resta Cbx_in_cam_inh_cmp_aftr_frst_ad Cbx_in_vvtc_actr_cfm Ctx_in_cam_ref_psn_redg[0] Ctx_in_cam_ref_psn_redg[1] Ctx_in_cam_ref_psn_redg[2] Ctx_in_cam_ref_psn_redg[3] Cxx_in_cam_angl_max_flu Cxx_in_cam_angl_redg_shf Cxx_in_cam_ctr_dft_psn Cxx_in_cam_dly_sta_ad_whl Cxx_in_cam_eprm_psn_dev Cxx_in_cam_max_n_inh_ad_whl Cxx_in_cam_min_n_ena_ad_whl Cxx_in_cam_nr_rev Cxx_in_cam_ref_psn_dev Cxx_in_cam_t_new_ad_whl Cxx_in_cam_tdc_ctr_0 Cxx_in_cam_tdc_ctr_1 Cxx_in_cam_tdc_ctr_2 Cxx_in_cam_tdc_ctr_3 Cxx_in_cam_vvtc_ol_ctl_inc Cxx_in_vvtc_angl_mes_h_ftc Cxx_in_vvtc_angl_mes_l_ftc Cxx_in_vvtc_angl_mes_thd Cxx_in_vvtc_ctr_dft_blk_fsrt_ad Cxx_in_vvtc_ctr_mov_phs_ad_whl Cxx_in_vvtc_ftc_trs_thd Cxx_in_vvtc_sp_ftc Cxx_in_vvtc_t_dft_psn Cxx_in_vvtc_t_pwm_nul Cxx_in_vvtc_t_vld_dft_psn Cxx_in_vvtc_thd_dft_psn /end DEF_CHARACTERISTIC
 /begin OUT_MEASUREMENT Vbx_df_in_vvtc_ad Vbx_in_cam_ad_whl Vbx_in_cam_crk_syn Vbx_in_cam_dft_ad_whl Vbx_in_cam_dft_chr_cam_or_crk Vbx_in_cam_dft_eprm_cmp Vbx_in_cam_dft_phs_ad_whl Vbx_in_cam_dft_ref_cmp Vbx_in_cam_dsb_ad_whl Vbx_in_cam_ena_acq Vbx_in_cam_ena_act_test Vbx_in_cam_ena_cmp_ref_psn Vbx_in_cam_ena_diag_ad_whl Vbx_in_cam_ena_new_ad_whl Vbx_in_cam_ena_writ_eprm Vbx_in_cam_end_acq_phs_ad Vbx_in_cam_end_act_test Vbx_in_cam_inh_ad_whl Vbx_in_cam_ini_psn_redg Vbx_in_cam_stop_act_test Vbx_in_cam_stop_new_ad_whl Vbx_in_vvtc_angl_mes_nok Vbx_in_vvtc_dft_blk_frst_ad Vbx_in_vvtc_dft_mov_fsrt_ad Vbx_in_vvtc_dft_psn Vbx_in_vvtc_nul_pwm Vsx_in_vvtc_angl_vld Vtx_in_cam_eprm_psn_redg[0] Vtx_in_cam_eprm_psn_redg[1] Vtx_in_cam_eprm_psn_redg[2] Vtx_in_cam_eprm_psn_redg[3] Vtx_in_cam_ini_psn_redg[0] Vtx_in_cam_ini_psn_redg[1] Vtx_in_cam_ini_psn_redg[2] Vtx_in_cam_ini_psn_redg[3] Vtx_in_cam_mes_psn_redg[0] Vtx_in_cam_mes_psn_redg[1] Vtx_in_cam_mes_psn_redg[2] Vtx_in_cam_mes_psn_redg[3] Vtx_in_cam_mv_psn_redg[0] Vtx_in_cam_mv_psn_redg[1] Vtx_in_cam_mv_psn_redg[2] Vtx_in_cam_mv_psn_redg[3] Vtx_in_cam_sum_psn_redg[0] Vtx_in_cam_sum_psn_redg[1] Vtx_in_cam_sum_psn_redg[2] Vtx_in_cam_sum_psn_redg[3] Vxx_in_cam_angl_redg Vxx_in_cam_ctr Vxx_in_cam_ctr_dft_psn Vxx_in_cam_ctr_phs_ad Vxx_in_cam_ctr_phs_ini_psn_redg Vxx_in_cam_ctr_rest_ad_whl Vxx_in_cam_mes_psn_redg_0 Vxx_in_cam_mes_psn_redg_1 Vxx_in_cam_mes_psn_redg_2 Vxx_in_cam_mes_psn_redg_3 Vxx_in_cam_mv_psn_redg_0 Vxx_in_cam_mv_psn_redg_1 Vxx_in_cam_mv_psn_redg_2 Vxx_in_cam_mv_psn_redg_3 Vxx_in_cam_sum_psn_redg_0 Vxx_in_cam_sum_psn_redg_1 Vxx_in_cam_sum_psn_redg_2 Vxx_in_cam_sum_psn_redg_3 Vxx_in_cam_vvtc_ol_ctl Vxx_in_vvtc_angl Vxx_in_vvtc_angl_fil Vxx_in_vvtc_angl_ftc Vxx_in_vvtc_angl_mes Vxx_in_vvtc_angl_mes_tmp Vxx_in_vvtc_angl_raw Vxx_in_vvtc_ctr_dft_blk_frst_ad Vxx_in_vvtc_ctr_mov_phs_ad_whl /end OUT_MEASUREMENT
/end FUNCTION
/begin FUNCTION AtCatMng "" /begin SUB_FUNCTION AtCatMng_Catawup /end SUB_FUNCTION /end FUNCTION
/begin FUNCTION AtCatMng_Catawup ""
 /begin DEF_CHARACTERISTIC Ctb_cata_wup_sta_tco Ntb_cata_wup_phs_order Ntb_fuel_typ_zon Cmp_cata_wup_cold Cmp_cata_wup_dstb Cmp_cata_wup_eng Cmp_cata_wup_lean Cmp_comp_wup Ctd_cata_wup_phs_order1 Ctd_cata_wup_phs_order2 Ctd_cata_wup_phs_order3 Cbx_cata_wup_vvt_on Cbx_wup_stop_ac Cxx_cata_wup_dstb_n_max Cxx_cata_wup_dstb_ofs Cxx_cata_wup_dstb_prs_max Cxx_cata_wup_dstb_prs_min /end DEF_CHARACTERISTIC
 /begin OUT_MEASUREMENT Vbx_cata_rich_dstb_efv Vbx_cata_wup_phs_cge Vsx_cata_wup_phs Vsx_cata_wup_phs_req Vxx_cata_wup_ctr Vxx_cata_wup_ctr_clc Vxx_cata_wup_phs_ctr Vxx_cata_wup_phs_nr /end OUT_MEASUREMENT
/end FUNCTION
/begin FUNCTION AtCatDgn ""
 /begin OUT_MEASUREMENT Vxx_cata_lbdw_mes_rtn Vxx_cata_fail_thd_rtn Vtx_in_mem_cata_cpt[0] Vtx_in_mem_cata_cpt[1] Vtx_in_mem_cata_cpt[2] Vtx_in_mem_cata_cpt[3] Vtx_in_mem_cata_cpt[4] Vtx_mem_crit_cata_cpt[0] Vtx_mem_crit_cata_cpt[1] Vtx_mem_crit_cata_cpt[2] Vtx_mem_crit_cata_cpt[3] Vtx_mem_crit_cata_cpt[4] Vtx_mem_crit_cata_cpt[5] Vtx_out_mem_cata_cpt[0] Vtx_out_mem_cata_cpt[1] Vtx_out_mem_cata_cpt[2] Vtx_out_mem_cata_cpt[3] Vtx_out_mem_cata_cpt[4] Vxx_nr_dc_cdn_ok_cata_cpt_NVM Vxx_t_mv_cdn_ok_cata_cpt_NVM /end OUT_MEASUREMENT
 /begin SUB_FUNCTION AtCatDgn_Obdcata /end SUB_FUNCTION
/end FUNCTION
/begin FUNCTION AtCatDgn_Obdcata ""
 /begin DEF_CHARACTERISTIC Ntb_cata_maf Ctp_cata_lbdw_max_maf Ctp_cata_lbdw_max_maf_alco Ctp_cata_ol_per_dly_maf Ctp_cata_ol_per_dly_maf_alco Cxx_cata_asd_diag_nr Cxx_cata_asd_in_nr Cxx_cata_asd_sf_nr Cxx_cata_asd_tout_dly Cxx_cata_cl_stab_dly_min Cxx_cata_diag_gear Cxx_cata_fuel_typ_rat_max_1 Cxx_cata_fuel_typ_rat_max_2 Cxx_cata_fuel_typ_rat_min_1 Cxx_cata_fuel_typ_rat_min_2 Cxx_cata_hys_maf Cxx_cata_hys_n Cxx_cata_in_nr Cxx_cata_maf_dif_max Cxx_cata_maf_max Cxx_cata_maf_mes_max Cxx_cata_maf_min Cxx_cata_n_max Cxx_cata_n_min Cxx_cata_ofs_neg_1 Cxx_cata_ofs_neg_2 Cxx_cata_ofs_ol_lbdw_fil Cxx_cata_ofs_pos_1 Cxx_cata_ofs_pos_2 Cxx_cata_ol_apl Cxx_cata_ol_apl_alco Cxx_cata_ol_per_dly_mes Cxx_cata_ol_per_dly_stab Cxx_cata_ol_test_max_nr Cxx_cata_ol_thd_lbdw_fil Cxx_cata_tco_min Cxx_cata_win_max Cxx_cata_win_min Cxx_conf_diag_cata Cxx_dfdec_cata_cpt Cxx_dfinc_cata_cpt Cxx_diag_sta_cata_lbup_pwt_sp Cxx_edic_cata_dly Cxx_ex_gaz_cata_max_temp Cxx_ex_gaz_cata_min_temp Cxx_lgl_dly_diag_cata /end DEF_CHARACTERISTIC
 /begin OUT_MEASUREMENT Vtx_mem_crit_cata_cpt[6] Vbx_cata_diag_stop Vbx_cata_dsb_ad_rich Vbx_cata_dsb_cp Vbx_cata_ol_cl_ti_fac Vbx_cata_ol_stop Vbx_cata_req Vbx_cata_stab_rich Vbx_cata_stab_rich_dsb Vbx_df_cata_cpt Vbx_diag_ena_cata_cpt Vbx_diag_sta_cata_abrt Vbx_diag_sta_cata_ena Vbx_diag_sta_cata_end Vbx_ena_diag_cata Vbx_inhi_ena_diag_cata Vbx_phy_ena_diag_cata Vbx_sw_ena_diag_cata Vsx_cata_stt Vsx_diag_sta_cata_stt Vxx_cata_asd_diag_ctr Vxx_cata_asd_sf Vxx_cata_asd_sf_ctr Vxx_cata_asd_tout_dly Vxx_cata_fail_thd Vxx_cata_in_ctr Vxx_cata_lbdw_h_fil_val Vxx_cata_lbdw_mes Vxx_cata_mem_ol_cl_ti_fac Vxx_cata_ol_apl Vxx_cata_ol_mv_cl_ti_fac Vxx_cata_ol_per_ctr Vxx_cata_ol_per_dly Vxx_cata_ol_per_dly_clc Vxx_cata_ol_stab_test Vxx_cata_stab_dly Vxx_diag_cata_cl_ti_fac Vxx_edic_cata_dly Vxx_lbdw_h_lvl_fil_val_prev Vxx_lgl_dly_diag_cata Vxx_pump_maf_cata_mem Vxx_pump_maf_fil_cata /end OUT_MEASUREMENT
/end FUNCTION
/begin FUNCTION InPciAgb ""
 /begin SUB_FUNCTION InPciAgb_Atsipxx InPciAgb_Attqxcs InPciAgb_Sdftaxx InPciAgb_Spcxxcs InPciAgb_Attqxco InPciAgb_Antxxcs InPciAgb_Tbspdcs /end SUB_FUNCTION
/end FUNCTION
/begin FUNCTION InPciAgb_Atsipxx ""
 /begin OUT_MEASUREMENT Vbx_agb_tq_req_full_ctl Vbx_agb_tq_req_h_lim Vbx_agb_tq_req_l_lim /end OUT_MEASUREMENT
/end FUNCTION
/begin FUNCTION InPciAgb_Attqxcs ""
 /begin DEF_CHARACTERISTIC Ctb_agb_csm_tq_is_n_sp_dif Ctb_agb_tq_dif_n_is_n_sp Ctb_agb_tq_vs Ctp_agb_csm_tq_drag_red_ofs Ctp_agb_csm_tq_dri_ofs Ctp_agb_csm_tq_dri_ofs_dft Ctp_agb_csm_tq_ftc_temp_fast Ctp_agb_csm_tq_ftc_temp_slow Ctp_agb_csm_tq_is_n_sp_fac Ctp_agb_csm_tq_n_fac Ctp_agb_csm_tq_neut_ofs Ctp_agb_csm_tq_neut_ofs_dft Ctp_agb_csm_tq_vs_fac Ctp_egb_dri_drag_red_dly_temp Ctp_egb_dri_neut_dly_temp Cbx_agb_csm_ofs_cfm Cbx_agb_csm_slop_cfm Cbx_agb_csm_tq_temp_cfm Cxx_agb_csm_ofs_slop_neg Cxx_agb_csm_ofs_slop_neg_dft Cxx_agb_csm_ofs_slop_pos Cxx_agb_csm_ofs_slop_pos_dft Cxx_agb_csm_tq_ftc_fast Cxx_agb_csm_tq_ftc_slow Cxx_agb_csm_tq_ftc_vs_thd Cxx_agb_csm_tq_is_n_hys Cxx_agb_csm_tq_is_n_thd Cxx_agb_csm_tq_slop_neg Cxx_agb_csm_tq_slop_neg_1 Cxx_agb_csm_tq_slop_neg_1_rvr Cxx_agb_csm_tq_slop_neg_2 Cxx_agb_csm_tq_slop_neg_rvr Cxx_agb_csm_tq_slop_pos Cxx_agb_csm_tq_slop_pos_1 Cxx_agb_csm_tq_slop_pos_1_rvr Cxx_agb_csm_tq_slop_pos_2 Cxx_agb_csm_tq_slop_pos_rvr Cxx_agb_csm_tq_vs_thd Cxx_agb_tq_slop_drag_red_neg Cxx_agb_tq_slop_drag_red_pos Cxx_agb_tq_slop_dsb_neg Cxx_agb_tq_slop_dsb_pos /end DEF_CHARACTERISTIC
 /begin OUT_MEASUREMENT Vbx_stat_drag_red_agb Vbx_stat_egb_neut Vsx_agb_csm_tq_vld Vxx_agb_csm_tq Vxx_agb_csm_tq_dft Vxx_agb_csm_tq_fil Vxx_agb_csm_tq_is_n_fac Vxx_agb_csm_tq_ofs Vxx_agb_csm_tq_slop Vxx_agb_tq_dif_n_is_n_sp Vxx_is_n_sp_dif /end OUT_MEASUREMENT
/end FUNCTION
/begin FUNCTION InPciAgb_Sdftaxx ""
 /begin DEF_CHARACTERISTIC Cbx_max_gear_cge_dly_ena_cfm Cbx_tq_cmd_typ_cfm Cxx_agb_abst_dly Cxx_agb_clck_max_step Cxx_agb_ctr_max_thd Cxx_agb_int_rst_t Cxx_agb_max_tqe Cxx_agb_slwr_neg Cxx_agb_slwr_pos Cxx_dfdec_agb_data Cxx_dfdec_agb_no_frm Cxx_dfinc_agb_data Cxx_dfinc_agb_no_frm Cxx_dft_agb_tq_sp_lim Cxx_i_agb_driv_tq_thd Cxx_max_gear_cge_dly Cxx_mux_agb_tqe_nok_raw /end DEF_CHARACTERISTIC
 /begin OUT_MEASUREMENT Vbx_agb_ack Vbx_agb_clck_fail Vbx_agb_cmd Vbx_agb_dft Vbx_agb_gear_mod_ok Vbx_agb_tq_int_rst Vbx_agb_tq_lim_dft Vbx_agb_tq_req Vbx_agb_tq_req_full_ctl_vld Vbx_agb_tq_req_h_lim_vld Vbx_agb_tq_req_l_lim_vld Vbx_df_agb_data_chr Vbx_df_agb_data_seq_ctr Vbx_df_agb_data_tout Vbx_df_agb_no_frm Vbx_egb_conf_ena Vbx_i_dsb Vxx_agb_10ms_t Vxx_agb_int_t Vxx_agb_lim_tqe Vxx_agb_max_tqe_sp Vxx_agb_max_tqe_tgt Vxx_agb_min_tqe_sp Vxx_agb_min_tqe_tgt /end OUT_MEASUREMENT
/end FUNCTION
/begin FUNCTION InPciAgb_Spcxxcs "" /begin OUT_MEASUREMENT Vxx_agb_driv_spt_fac /end OUT_MEASUREMENT /end FUNCTION
/end MODULE
/end PROJECT
