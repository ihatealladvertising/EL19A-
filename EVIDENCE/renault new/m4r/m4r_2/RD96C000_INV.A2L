ASAP2_VERSION 1 41
/begin PROJECT RD8 "_default_ProjectLongIdentifier"
/begin HEADER "_default_HeaderComment" PROJECT_NO RD9 /end HEADER
/begin MODULE _default_ModuleName "_default_ModuleLongIdentifier"
/begin MOD_COMMON "_default_ModCommonComment" DEPOSIT ABSOLUTE BYTE_ORDER MSB_LAST ALIGNMENT_BYTE 1 ALIGNMENT_WORD 2 ALIGNMENT_LONG 2 ALIGNMENT_FLOAT32_IEEE 2 ALIGNMENT_FLOAT64_IEEE 4 /end MOD_COMMON
/begin MEASUREMENT lv_end_diag_win_fsd_1 "" UBYTE _CNV_S_2_RANGE______3_CM 1 0. 0. 1. ECU_ADDRESS 0xd00046ea /end MEASUREMENT
/begin MEASUREMENT lv_end_diag_win_fsd_2 "" UBYTE _CNV_S_2_RANGE______3_CM 1 0. 0. 1. ECU_ADDRESS 0xd00046eb /end MEASUREMENT
/begin MEASUREMENT lv_end_diag_win_fsd_lam_lim_1 "" UBYTE _CNV_S_2_RANGE______3_CM 1 0. 0. 1. ECU_ADDRESS 0xd00046ec /end MEASUREMENT
/begin MEASUREMENT lv_end_diag_win_fsd_lam_lim_2 "" UBYTE _CNV_S_2_RANGE______3_CM 1 0. 0. 1. ECU_ADDRESS 0xd00046ed /end MEASUREMENT
/begin MEASUREMENT lv_eol_obd_dc "" UBYTE _CNV_A_R_ECME_LINEA_0_CM 1 0. 0. 1. ECU_ADDRESS 0xd00047ff FORMAT "%1.0" /end MEASUREMENT
/begin MEASUREMENT t_ast "" UWORD _CNV_A_R_LINEAR_____4_CM 1 0. 0. 6553.5 ECU_ADDRESS 0xd00030d2 FORMAT "%6.1" /end MEASUREMENT
/begin MEASUREMENT amp "" UWORD _CNV_A_R_LINEAR_____5_CM 1 0. 0. 5434. ECU_ADDRESS 0xd0002fc0 FORMAT "%7.2" /end MEASUREMENT
/begin MEASUREMENT inh_iv_mis "" UBYTE _CNV_A_R_ECME_LINEA_0_CM 1 0. 0. 255. ECU_ADDRESS 0xd000422f FORMAT "%3.0" /end MEASUREMENT
/begin MEASUREMENT lv_inh_iv_mis_a "At least one cylinder is shutt-off by a CARB A misfire criterion confirmed." UBYTE _CNV_S_2_RANGE______3_CM 1 0. 0. 1. ECU_ADDRESS 0xd0004e4f /end MEASUREMENT
/begin MEASUREMENT lv_mis_state_a "CARB A misfire criterion confirmed (debounced)" UBYTE _CNV_S_2_RANGE______3_CM 1 0. 0. 1. ECU_ADDRESS 0xd0004e50 /end MEASUREMENT
/begin MEASUREMENT lv_mis_state_b1 "CARB B1 misfire criterion confirmed (debounced)" UBYTE _CNV_S_2_RANGE______3_CM 1 0. 0. 1. ECU_ADDRESS 0xd0004e51 /end MEASUREMENT
/begin MEASUREMENT lv_mis_state_b4 "CARB B4 misfire criterion confirmed (debounced)" UBYTE _CNV_S_2_RANGE______3_CM 1 0. 0. 1. ECU_ADDRESS 0xd0004e52 /end MEASUREMENT
/begin MEASUREMENT sym_cyl_mis_a "" UWORD _CNV_S_15_RANGE_SYM__6_CM 1 0. 0. 8192. ECU_ADDRESS 0xd0003336 /end MEASUREMENT
/begin MEASUREMENT sym_cyl_mis_b1 "" UWORD _CNV_S_15_RANGE_SYM__6_CM 1 0. 0. 8192. ECU_ADDRESS 0xd0003338 /end MEASUREMENT
/begin MEASUREMENT sym_cyl_mis_b4 "" UWORD _CNV_S_15_RANGE_SYM__6_CM 1 0. 0. 8192. ECU_ADDRESS 0xd000333a /end MEASUREMENT
/begin CHARACTERISTIC c_ccp_pt_act "Security pattern to activate the CCP on powertrain CAN" VALUE 0xa0021bfe _REC_S1VAL_20_u2 65535. _CNV_A_R_ECME_LINEA_0_CM 0. 65535. FORMAT "%5.0" /end CHARACTERISTIC
/begin MEASUREMENT pv "" UWORD _CNV_A_R_CPULOAD__0_7_CM 1 0. 0. 99.90234375 ECU_ADDRESS 0xd0002ffa FORMAT "%5.2" /end MEASUREMENT
/begin MEASUREMENT daq_ovld "DAQ overload indication" UBYTE _CNV_A_R_ECME_LINEA_0_CM 1 0. 0. 255. ECU_ADDRESS 0xd0004ec7 FORMAT "%3.0" /end MEASUREMENT
/begin CHARACTERISTIC c_ensd_eng_dyn_conf "" VALUE 0xa0021653 _REC_S1VAL_20_u1 1. _CNV_A_R_LINEAR_____33_CM 1. 2. FORMAT "%3.0" /end CHARACTERISTIC
/begin MEASUREMENT ctr_vld_block "" UWORD _CNV_A_R_ECME_LINEA_0_CM 1 0. 0. 65535. DISPLAY_IDENTIFIER BoVfoSup_NVM.ctr_vld_block_NVM ECU_ADDRESS 0xd0005854 FORMAT "%5.0" /end MEASUREMENT
/begin MEASUREMENT lv_warm_rst "Flag which indicates a hot reset occured" UBYTE _CNV_S_2_RANGE______3_CM 1 0. 0. 1. ECU_ADDRESS 0xd0003fcc BIT_MASK 0x1 /end MEASUREMENT
/begin MEASUREMENT Vp_map_fil "Filtered Voltage of the intake manifold Pressure Sensor" UWORD _CNV_A_R_LINEAR_____16_CM 1 0. 0. 4.99984741210938 ECU_ADDRESS 0xd0003886 FORMAT "%6.4" /end MEASUREMENT
/begin MEASUREMENT vp_map "Voltage of the intake manifold pressure sensor" UWORD _CNV_A_R_LINEAR_____16_CM 1 0. 0. 4.99984741210938 ECU_ADDRESS 0xd0003882 FORMAT "%6.4" /end MEASUREMENT
/begin MEASUREMENT vp_put "digitalized voltage of air Pressure Upstream Throttle data acquisition" UWORD _CNV_A_R_LINEAR_____16_CM 1 0. 0. 4.99984741210938 ECU_ADDRESS 0xd000387e FORMAT "%6.4" /end MEASUREMENT
/begin MEASUREMENT Vxx_sens_it_v_1 "Raw voltage of inlet throttle sensor 1 position" UWORD _CNV_A_R_LINEAR_____52_CM 1 0. 0. 25000. ECU_ADDRESS 0xd0002efa FORMAT "%5.0" /end MEASUREMENT
/begin MEASUREMENT Vxx_sens_it_v_2 "Raw voltage of inlet throttle sensor 2 position" UWORD _CNV_A_R_LINEAR_____52_CM 1 0. 0. 25000. ECU_ADDRESS 0xd0002efc FORMAT "%5.0" /end MEASUREMENT
/begin MEASUREMENT vp_tps_1_bas "Raw voltage throttle position sensor 1" SWORD _CNV_A_R_LINEAR_____149_CM 1 0. -5. 4.99984741210938 ECU_ADDRESS 0xd0002ef6 FORMAT "%7.4" /end MEASUREMENT
/begin MEASUREMENT vp_tps_2_bas "Raw voltage throttle position sensor 2" SWORD _CNV_A_R_LINEAR_____149_CM 1 0. -5. 4.99984741210938 ECU_ADDRESS 0xd0002ef8 FORMAT "%7.4" /end MEASUREMENT
/begin MEASUREMENT err_sym_tco_el "Symptom for coolant temperature signal range error" UBYTE _CNV_S_16_RANGE_ERR__151_CM 1 0. 0. 15. ECU_ADDRESS 0xd0005295 /end MEASUREMENT
/begin MEASUREMENT lv_cdn_diag_tco_el "Boolean for coolant temperature signal range diagnosis conditions" UBYTE _CNV_S_2_RANGE______3_CM 1 0. 0. 1. ECU_ADDRESS 0xd0004bd3 BIT_MASK 0x1 /end MEASUREMENT
/begin MEASUREMENT tco_mes "Measured coolant temperature" UBYTE _CNV_A_R_LINEAR_____42_CM 1 0. -48. 142.5 ECU_ADDRESS 0xd0005296 FORMAT "%6.2" /end MEASUREMENT
/begin MEASUREMENT vp_tco[0] "Coolant temperature sensor raw acquisition." UWORD _CNV_A_R_LINEAR_____16_CM 1 0. 0. 4.99984741210938 ECU_ADDRESS 0xd0005984 FORMAT "%6.4" /end MEASUREMENT
/begin MEASUREMENT lv_igk "" UBYTE _CNV_A_R_ECME_LINEA_0_CM 1 0. 0. 255. ECU_ADDRESS 0xd000498c FORMAT "%3.0" /end MEASUREMENT
/begin MEASUREMENT lv_igk_bas "Basic ignition key detection" UBYTE _CNV_S_2_RANGE______3_CM 1 0. 0. 1. ECU_ADDRESS 0xd000552d BIT_MASK 0x1 /end MEASUREMENT
/begin MEASUREMENT v_igk_mes "Acquisition of after key battery voltage" UWORD _CNV_A_R_LINEAR_____19_CM 1 0. 0. 40.99937 ECU_ADDRESS 0xd000333c FORMAT "%7.4" /end MEASUREMENT
/begin MEASUREMENT err_sym_rly_main_plaus_on "Detected symptom for main relay on output plausibility" UBYTE _CNV_S_16_RANGE_ERR__151_CM 1 0. 0. 15. ECU_ADDRESS 0xd0004a0d /end MEASUREMENT
/begin MEASUREMENT err_sym_vcc_1 "symptom:  failure without filtering of diagnosis for VCC_1 " UBYTE _CNV_S_16_RANGE_ERR__151_CM 1 0. 0. 15. ECU_ADDRESS 0xd0004a0a /end MEASUREMENT
/begin MEASUREMENT err_sym_vcc_2 "symptom:  failure without filtering of diagnosis for VCC_2 " UBYTE _CNV_S_16_RANGE_ERR__151_CM 1 0. 0. 15. ECU_ADDRESS 0xd0004a0b /end MEASUREMENT
/begin MEASUREMENT err_sym_vcc_3 "symptom:  failure without filtering of diagnosis for VCC_3" UBYTE _CNV_S_16_RANGE_ERR__151_CM 1 0. 0. 15. ECU_ADDRESS 0xd0004a0c /end MEASUREMENT
/begin MEASUREMENT lv_cdn_diag_rly_main_plaus_on "Diagnosis condition for main relay on output plausibility (set to 1 when condition is fulfilled)" UBYTE _CNV_S_2_RANGE______3_CM 1 0. 0. 1. ECU_ADDRESS 0xd0004a13 BIT_MASK 0x1 /end MEASUREMENT
/begin MEASUREMENT lv_cdn_diag_vcc_1 "Condition for VCC1 diagnosis" UBYTE _CNV_S_2_RANGE______3_CM 1 0. 0. 1. ECU_ADDRESS 0xd0004a10 BIT_MASK 0x1 /end MEASUREMENT
/begin MEASUREMENT lv_cdn_diag_vcc_2 "Condition for VCC2 diagnosis" UBYTE _CNV_S_2_RANGE______3_CM 1 0. 0. 1. ECU_ADDRESS 0xd0004a11 BIT_MASK 0x1 /end MEASUREMENT
/begin MEASUREMENT lv_cdn_diag_vcc_3 "Condition for VCC3 diagnosis" UBYTE _CNV_S_2_RANGE______3_CM 1 0. 0. 1. ECU_ADDRESS 0xd0004a12 BIT_MASK 0x1 /end MEASUREMENT
/begin MEASUREMENT lv_cdn_vb_min_diag "Boolean for battery voltage condition fulfilled for sensor diagnosis" UBYTE _CNV_S_2_RANGE______3_CM 1 0. 0. 1. ECU_ADDRESS 0xd0004a0f BIT_MASK 0x1 /end MEASUREMENT
/begin MEASUREMENT lv_cdn_vb_obd1 "" UBYTE _CNV_S_2_RANGE______3_CM 1 0. 0. 1. ECU_ADDRESS 0xd0004a14 /end MEASUREMENT
/begin MEASUREMENT lv_cdn_vb_obd2 "boolean for battery voltage condition fulfilled for OBD diagnosis" UBYTE _CNV_S_2_RANGE______3_CM 1 0. 0. 1. ECU_ADDRESS 0xd0004a16 /end MEASUREMENT
/begin MEASUREMENT lv_vb_cdn_obd_1 "" UBYTE _CNV_S_2_RANGE______3_CM 1 0. 0. 1. ECU_ADDRESS 0xd0004a15 /end MEASUREMENT
/begin MEASUREMENT lv_vb_cdn_obd_2 "Boolean for battery voltage condition fulfilled for OBD diagnosis" UBYTE _CNV_S_2_RANGE______3_CM 1 0. 0. 1. ECU_ADDRESS 0xd0004a17 BIT_MASK 0x1 /end MEASUREMENT
/begin MEASUREMENT lv_vb_inh_diag "Flag inhibiting diagnosis because of a raw VB too low" UBYTE _CNV_S_2_RANGE______3_CM 1 0. 0. 1. ECU_ADDRESS 0xd0004a0e BIT_MASK 0x1 /end MEASUREMENT
/begin MEASUREMENT v_rly_main_mes "Acquisition of after relay battery voltage" UWORD _CNV_A_R_LINEAR_____19_CM 1 0. 0. 40.99937 ECU_ADDRESS 0xd000359a FORMAT "%7.4" /end MEASUREMENT
/begin MEASUREMENT vb "Battery voltage" UBYTE _CNV_A_R_LINEAR_____41_CM 1 0. 0. 25.8984375 ECU_ADDRESS 0xd0004a08 FORMAT "%9.6" /end MEASUREMENT
/begin MEASUREMENT vb_raw "Raw battery voltage" UBYTE _CNV_A_R_LINEAR_____41_CM 1 0. 0. 25.8984375 ECU_ADDRESS 0xd0004a09 FORMAT "%9.6" /end MEASUREMENT
/begin MEASUREMENT vcc_1 "Sensors power supply voltage raw acquisition (x  = 1 or 2 versus the voltage supply)" UWORD _CNV_A_R_LINEAR_____152_CM 1 0. 0. 10. ECU_ADDRESS 0xd000359c FORMAT "%7.4" /end MEASUREMENT
/begin MEASUREMENT vcc_2 "Sensors power supply voltage raw acquisition (x  = 1 or 2 versus the voltage supply)" UWORD _CNV_A_R_LINEAR_____152_CM 1 0. 0. 10. ECU_ADDRESS 0xd000359e FORMAT "%7.4" /end MEASUREMENT
/begin MEASUREMENT vcc_3 "Sensors power supply voltage raw acquisition (x  = 1, 2 or 3 versus the voltage supply)" UWORD _CNV_A_R_LINEAR_____152_CM 1 0. 0. 10. ECU_ADDRESS 0xd00035a0 FORMAT "%7.4" /end MEASUREMENT
/begin MEASUREMENT vp_vcc_1 "Sensors power supply voltage raw acquisition (x  = 1 or 2 versus the voltage supply)" UWORD _CNV_A_R_LINEAR_____16_CM 1 0. 0. 4.99984741210938 ECU_ADDRESS 0xd00035a2 FORMAT "%6.4" /end MEASUREMENT
/begin MEASUREMENT vp_vcc_2 "Sensors power supply voltage raw acquisition (x  = 1 or 2 versus the voltage supply)" UWORD _CNV_A_R_LINEAR_____16_CM 1 0. 0. 4.99984741210938 ECU_ADDRESS 0xd00035a4 FORMAT "%6.4" /end MEASUREMENT
/begin MEASUREMENT vp_vcc_3 "Sensors power supply voltage raw acquisition (x  = 3 versus the voltage supply)" UWORD _CNV_A_R_LINEAR_____16_CM 1 0. 0. 4.99984741210938 ECU_ADDRESS 0xd00035a6 FORMAT "%6.4" /end MEASUREMENT
/begin AXIS_PTS ldp_vb__pwm_cor "" 0xa002c2f0 NO_INPUT_QUANTITY _REC_A2AXS_20_u1 25.8984375 _CNV_A_R_LINEAR_____41_CM 8 0. 25.8984375 FORMAT "%9.6" /end AXIS_PTS
/begin CHARACTERISTIC ip_pwm_cor "Interpolation table for voltage battery compensation" CURVE 0xa002d0cc _REC_A1CUR_20_u2_u1 27.777 _CNV_A_R_LINEAR_____155_CM 0. 27.777 FORMAT "%11.8"
 /begin AXIS_DESCR COM_AXIS NO_INPUT_QUANTITY _CNV_A_R_LINEAR_____41_CM 8 0. 25.8984375 FORMAT "%9.6" AXIS_PTS_REF ldp_vb__pwm_cor /end AXIS_DESCR
/end CHARACTERISTIC
/begin MEASUREMENT lv_inh_diag_etc_dr "Inhibition condition for the power stage diagnosis based on SF" UBYTE _CNV_S_2_RANGE______3_CM 1 0. 0. 1. ECU_ADDRESS 0xd0004acf /end MEASUREMENT
/begin MEASUREMENT lv_mtc_cur_off "The logical variable indicate the state of the ETC Power stage" UBYTE _CNV_S_2_RANGE______3_CM 1 0. 0. 1. ECU_ADDRESS 0xd0004ace /end MEASUREMENT
/begin MEASUREMENT pwm_etc "PWM for the H-bridge" SWORD _CNV_A_R_LINEAR_____156_CM 1 0. -100. 99.9969482421875 ECU_ADDRESS 0xd0002da8 FORMAT "%8.3" /end MEASUREMENT
/begin CHARACTERISTIC c_vb_min_etc_dr_diag "Battery voltage threshold to inhibit the ETC power stage diagnosis" VALUE 0xa00211df _REC_S1VAL_20_u1 25.8984375 _CNV_A_R_LINEAR_____41_CM 0. 25.8984375 FORMAT "%9.6" /end CHARACTERISTIC
/begin MEASUREMENT Vbx_act_test_eol "Test start EOBD End of line" UBYTE _CNV_S_2_RANGE______3_CM 1 0. 0. 1. ECU_ADDRESS 0xd000431b BIT_MASK 0x1 /end MEASUREMENT
/begin MEASUREMENT Vbx_alco_ad_cold_frst "At least one fast correction shot has occured during the driving cycle" UBYTE _CNV_S_2_RANGE______3_CM 1 0. 0. 1. ECU_ADDRESS 0xd00056bb BIT_MASK 0x1 /end MEASUREMENT
/begin MEASUREMENT Vbx_ecm_mon_rst_req "ECU reset request due to an ecm_mon failure" UBYTE _CNV_S_2_RANGE______3_CM 1 0. 0. 1. ECU_ADDRESS 0xd00056bd BIT_MASK 0x1 /end MEASUREMENT
/begin MEASUREMENT Vbx_it_ofs_clos_frst "Indicates if the next closed thrust learning is the first one or not. Stored in Sbx_it_ofs_clos_frst" UBYTE _CNV_S_2_RANGE______3_CM 1 0. 0. 1. ECU_ADDRESS 0xd000431d BIT_MASK 0x1 /end MEASUREMENT
/begin MEASUREMENT Vbx_it_ofs_open_frst "Indicates wether the current open thrust learning is the first learning or not." UBYTE _CNV_S_2_RANGE______3_CM 1 0. 0. 1. ECU_ADDRESS 0xd000431e BIT_MASK 0x1 /end MEASUREMENT
/begin MEASUREMENT Vbx_lpg_cyl1_cut "Active when an  injection cut is done on  cylinder 1." UBYTE _CNV_S_2_RANGE______3_CM 1 0. 0. 1. ECU_ADDRESS 0xd000431f BIT_MASK 0x1 /end MEASUREMENT
/begin MEASUREMENT Vbx_lpg_cyl2_cut "Active when an  injection cut is done on  cylinder 2." UBYTE _CNV_S_2_RANGE______3_CM 1 0. 0. 1. ECU_ADDRESS 0xd0004320 BIT_MASK 0x1 /end MEASUREMENT
/begin MEASUREMENT Vbx_lpg_cyl3_cut "Active when an  injection cut is done on  cylinder 3." UBYTE _CNV_S_2_RANGE______3_CM 1 0. 0. 1. ECU_ADDRESS 0xd0004321 BIT_MASK 0x1 /end MEASUREMENT
/begin MEASUREMENT Vbx_lpg_cyl4_cut "Active when an  injection cut is done on  cylinder 4." UBYTE _CNV_S_2_RANGE______3_CM 1 0. 0. 1. ECU_ADDRESS 0xd0004322 BIT_MASK 0x1 /end MEASUREMENT
/begin MEASUREMENT Vbx_lpg_gas_lpg_trs "Fuelling transcient mode gasoline to LPG / CNG" UBYTE _CNV_S_2_RANGE______3_CM 1 0. 0. 1. ECU_ADDRESS 0xd0004323 BIT_MASK 0x1 /end MEASUREMENT
/begin MEASUREMENT Vbx_lpg_gas_mod "Normal LPG / GAS running mode" UBYTE _CNV_S_2_RANGE______3_CM 1 0. 0. 1. ECU_ADDRESS 0xd0004324 BIT_MASK 0x1 /end MEASUREMENT
/begin MEASUREMENT Vbx_lpg_lpg_gas_trs "Fuelling transcient mode LPG / CNG to gasoline" UBYTE _CNV_S_2_RANGE______3_CM 1 0. 0. 1. ECU_ADDRESS 0xd0004325 BIT_MASK 0x1 /end MEASUREMENT
/begin MEASUREMENT Vbx_lpg_min_lpg_lvl "Etat mini carburant GPL" UBYTE _CNV_S_2_RANGE______3_CM 1 0. 0. 1. ECU_ADDRESS 0xd0004326 BIT_MASK 0x1 /end MEASUREMENT
/begin MEASUREMENT Vbx_mvac_cut_req "Cut request from vaccum brake system" UBYTE _CNV_S_2_RANGE______3_CM 1 0. 0. 1. ECU_ADDRESS 0xd0004327 BIT_MASK 0x1 /end MEASUREMENT
/begin MEASUREMENT Vbx_pwst_prs_stt "Power steering manostat activation" UBYTE _CNV_S_2_RANGE______3_CM 1 0. 0. 1. ECU_ADDRESS 0xd0004328 BIT_MASK 0x1 /end MEASUREMENT
/begin MEASUREMENT Vbx_vb_flot_dsb "" UBYTE _CNV_S_2_RANGE______3_CM 1 0. 0. 1. ECU_ADDRESS 0xd0004329 BIT_MASK 0x1 /end MEASUREMENT
/begin MEASUREMENT Vbx_wf_alt_cfm "Wire frame alternator presence configuration boolean (1 = wire frame present)" UBYTE _CNV_S_2_RANGE______3_CM 1 0. 0. 1. ECU_ADDRESS 0xd00056c1 BIT_MASK 0x1 /end MEASUREMENT
/begin MEASUREMENT Vbx_wf_ptc_cfm "PTC management present (=1) or absent (=0)" UBYTE _CNV_S_2_RANGE______3_CM 1 0. 0. 1. ECU_ADDRESS 0xd00056c3 BIT_MASK 0x1 /end MEASUREMENT
/begin MEASUREMENT Vbx_wup_cmd "Preheating lamp illumination command (diesel engine only)" UBYTE _CNV_S_2_RANGE______3_CM 1 0. 0. 1. ECU_ADDRESS 0xd000432a BIT_MASK 0x1 /end MEASUREMENT
/begin MEASUREMENT Vbx_wup_req "Preheating diesel to be done (diesel engine only)" UBYTE _CNV_S_2_RANGE______3_CM 1 0. 0. 1. ECU_ADDRESS 0xd000432b BIT_MASK 0x1 /end MEASUREMENT
/begin MEASUREMENT Vxx_alco_ad_ctr "Current value of the counter of slow alcohol adaptive computing phases" UBYTE _CNV_A_R_ECME_LINEA_0_CM 1 0. 0. 255. ECU_ADDRESS 0xd000432c FORMAT "%3.0" /end MEASUREMENT
/begin MEASUREMENT Vxx_alco_rat "Alcohol rate for the after sale" UWORD _CNV_A_R_LINEAR_____122_CM 1 0. 0. 100. ECU_ADDRESS 0xd0003674 FORMAT "%12.8" /end MEASUREMENT
/begin MEASUREMENT Vxx_driv_spt_fac "Driver sportivity factor, including 'slow' and 'fast' adaptation algorithms" UBYTE _CNV_A_R_LINEAR_____118_CM 1 0. 0. 70. ECU_ADDRESS 0xd000432d FORMAT "%9.7" /end MEASUREMENT
/begin MEASUREMENT Vxx_eai_ti_cl_ctr "Counter indicating the number of TDC remaining before closed loop authorization in EAI" UWORD _CNV_A_R_LINEAR_____55_CM 1 0. 0. 65535. ECU_ADDRESS 0xd0003676 FORMAT "%5.0" /end MEASUREMENT
/begin MEASUREMENT Vxx_emtv_clos_rat "OBD ratio indicating the number of measured postions under the turbo threshold" UBYTE _CNV_A_R_LINEAR_____136_CM 1 0. 0. 70. ECU_ADDRESS 0xd000432e FORMAT "%4.2" /end MEASUREMENT
/begin MEASUREMENT Vxx_evap_dgn_fim_cor "Injected fuel mass correction during evaporation diagnosis" ULONG _CNV_A_R_LINEAR_____83_CM 1 0. 0. 4800. ECU_ADDRESS 0xd0002968 FORMAT "%14.5" /end MEASUREMENT
/begin MEASUREMENT Vxx_fuel_lvl_mem "Memorized value of the fuel level" UBYTE _CNV_A_R_LINEAR_____215_CM 1 0. 0. 80. ECU_ADDRESS 0xd000432f FORMAT "%3.0" /end MEASUREMENT
/begin MEASUREMENT Vxx_is_fuel_typ_rat "Ratio dedicated to the idle speed regulation" UWORD _CNV_A_R_LINEAR_____108_CM 1 0. 0. 1. ECU_ADDRESS 0xd0005802 /end MEASUREMENT
/begin MEASUREMENT Vxx_raw_sens_rvac "stub" SBYTE _CNV_A_R_LINEAR_____57_CM 1 0. -100. 100. ECU_ADDRESS 0xd0004330 FORMAT "%4.0" /end MEASUREMENT
/begin MEASUREMENT Vxx_ti_alco_cor "Final alcohol adaptattive" UWORD _CNV_A_R_LINEAR_____122_CM 1 0. 0. 100. ECU_ADDRESS 0xd0005804 FORMAT "%12.8" /end MEASUREMENT
/begin MEASUREMENT Vxx_ti_alco_cor_h "High limit of the adaptattive" UWORD _CNV_A_R_LINEAR_____122_CM 1 0. 0. 100. ECU_ADDRESS 0xd0005806 FORMAT "%12.8" /end MEASUREMENT
/begin MEASUREMENT Vxx_ti_alco_cor_l "Low limit of the adaptattive" UWORD _CNV_A_R_LINEAR_____122_CM 1 0. 0. 100. ECU_ADDRESS 0xd0005808 FORMAT "%12.8" /end MEASUREMENT
/begin MEASUREMENT Vxx_tkof_ass_fac "Take off assistance factor" UBYTE _CNV_A_R_LINEAR_____216_CM 1 0. 0. 1. ECU_ADDRESS 0xd00056c4 FORMAT "%5.3" /end MEASUREMENT
/begin CHARACTERISTIC Cbx_lpg_gas_lpg_trs "Fuelling transcient mode gasoline to LPG / CNG" VALUE 0xa00214b5 _REC_S1VAL_20_u1 1. _CNV_S_2_RANGE______3_CM 0. 1. /end CHARACTERISTIC
/begin CHARACTERISTIC Cbx_lpg_gas_mod "Normal LPG / GAS running mode" VALUE 0xa00214b6 _REC_S1VAL_20_u1 1. _CNV_S_2_RANGE______3_CM 0. 1. /end CHARACTERISTIC
/begin CHARACTERISTIC Cbx_lpg_lpg_gas_trs "Fuelling transcient mode LPG / CNG to gasoline" VALUE 0xa00214b7 _REC_S1VAL_20_u1 1. _CNV_S_2_RANGE______3_CM 0. 1. /end CHARACTERISTIC
/begin CHARACTERISTIC Cbx_sens_rvac_cfm "Stub" VALUE 0xa00214b8 _REC_S1VAL_20_u1 1. _CNV_A_R_ECME_LINEA_0_CM 0. 1. FORMAT "%1.0" BIT_MASK 0x1 /end CHARACTERISTIC
/begin CHARACTERISTIC Cbx_vb_flot_dsb "Calibration for battery voltage floating inhibition" VALUE 0xa00214b9 _REC_S1VAL_20_u1 1. _CNV_S_2_RANGE______3_CM 0. 1. /end CHARACTERISTIC
/begin MEASUREMENT err_sym_bas_knk[0] "Symptom error on basic knock signal" UBYTE _CNV_S_16_RANGE_ERR__151_CM 1 0. 0. 15. ECU_ADDRESS 0xd000496e /end MEASUREMENT
/begin MEASUREMENT err_sym_crk_oc "Symptom of the crankshaft sensor failure open or short circuit" UBYTE _CNV_S_16_RANGE_ERR__151_CM 1 0. 0. 15. ECU_ADDRESS 0xd0004974 /end MEASUREMENT
/begin MEASUREMENT err_sym_crk_plaus "" UBYTE _CNV_S_16_RANGE_ERR__151_CM 1 0. 0. 15. ECU_ADDRESS 0xd0004973 /end MEASUREMENT
/begin MEASUREMENT err_sym_crk_syn "" UBYTE _CNV_S_16_RANGE_ERR__151_CM 1 0. 0. 15. ECU_ADDRESS 0xd0004972 /end MEASUREMENT
/begin MEASUREMENT err_sym_crk_tooth "" UBYTE _CNV_S_16_RANGE_ERR__151_CM 1 0. 0. 15. ECU_ADDRESS 0xd0004970 /end MEASUREMENT
/begin MEASUREMENT err_sym_crk_tooth_per "" UBYTE _CNV_S_16_RANGE_ERR__151_CM 1 0. 0. 15. ECU_ADDRESS 0xd0004971 /end MEASUREMENT
/begin MEASUREMENT err_sym_igc_ol[0] "" UBYTE _CNV_S_16_RANGE_ERR__151_CM 1 0. 0. 15. ECU_ADDRESS 0xd0004952 /end MEASUREMENT
/begin MEASUREMENT err_sym_igc_ol[1] "" UBYTE _CNV_S_16_RANGE_ERR__151_CM 1 0. 0. 15. ECU_ADDRESS 0xd0004953 /end MEASUREMENT
/begin MEASUREMENT err_sym_igc_ol[2] "" UBYTE _CNV_S_16_RANGE_ERR__151_CM 1 0. 0. 15. ECU_ADDRESS 0xd0004954 /end MEASUREMENT
/begin MEASUREMENT err_sym_igc_ol[3] "" UBYTE _CNV_S_16_RANGE_ERR__151_CM 1 0. 0. 15. ECU_ADDRESS 0xd0004955 /end MEASUREMENT
/begin MEASUREMENT err_sym_igc_scg[0] "" UBYTE _CNV_S_16_RANGE_ERR__151_CM 1 0. 0. 15. ECU_ADDRESS 0xd000494e /end MEASUREMENT
/begin MEASUREMENT err_sym_igc_scg[1] "" UBYTE _CNV_S_16_RANGE_ERR__151_CM 1 0. 0. 15. ECU_ADDRESS 0xd000494f /end MEASUREMENT
/begin MEASUREMENT err_sym_igc_scg[2] "" UBYTE _CNV_S_16_RANGE_ERR__151_CM 1 0. 0. 15. ECU_ADDRESS 0xd0004950 /end MEASUREMENT
/begin MEASUREMENT err_sym_igc_scg[3] "" UBYTE _CNV_S_16_RANGE_ERR__151_CM 1 0. 0. 15. ECU_ADDRESS 0xd0004951 /end MEASUREMENT
/begin MEASUREMENT err_sym_igc_scp[0] "" UBYTE _CNV_S_16_RANGE_ERR__151_CM 1 0. 0. 15. ECU_ADDRESS 0xd000494a /end MEASUREMENT
/begin MEASUREMENT err_sym_igc_scp[1] "" UBYTE _CNV_S_16_RANGE_ERR__151_CM 1 0. 0. 15. ECU_ADDRESS 0xd000494b /end MEASUREMENT
/begin MEASUREMENT err_sym_igc_scp[2] "" UBYTE _CNV_S_16_RANGE_ERR__151_CM 1 0. 0. 15. ECU_ADDRESS 0xd000494c /end MEASUREMENT
/begin MEASUREMENT err_sym_igc_scp[3] "" UBYTE _CNV_S_16_RANGE_ERR__151_CM 1 0. 0. 15. ECU_ADDRESS 0xd000494d /end MEASUREMENT
/begin MEASUREMENT err_sym_per_cam_in[0] "" UBYTE _CNV_S_16_RANGE_ERR__151_CM 1 0. 0. 15. ECU_ADDRESS 0xd0004975 /end MEASUREMENT
/begin MEASUREMENT err_sym_plaus_cam_in[0] "" UBYTE _CNV_S_16_RANGE_ERR__151_CM 1 0. 0. 15. ECU_ADDRESS 0xd0004978 /end MEASUREMENT
/begin MEASUREMENT err_sym_ref_crk_cam_in[0] "" UBYTE _CNV_S_16_RANGE_ERR__151_CM 1 0. 0. 15. ECU_ADDRESS 0xd0004977 /end MEASUREMENT
/begin MEASUREMENT err_sym_rel_knk[0] "Symptom error on relative knock signal" UBYTE _CNV_S_16_RANGE_ERR__151_CM 1 0. 0. 15. ECU_ADDRESS 0xd000496f /end MEASUREMENT
/begin MEASUREMENT err_sym_syn_cam_in[0] "" UBYTE _CNV_S_16_RANGE_ERR__151_CM 1 0. 0. 15. ECU_ADDRESS 0xd0004976 /end MEASUREMENT
/begin MEASUREMENT err_sym_syn_crk_cam_in[0] "" UBYTE _CNV_S_16_RANGE_ERR__151_CM 1 0. 0. 15. ECU_ADDRESS 0xd0004979 /end MEASUREMENT
/begin MEASUREMENT lv_cdn_diag_bas_knk[0] "Engine state condition to authorise the basic diagnosis" UBYTE _CNV_S_2_RANGE______3_CM 1 0. 0. 1. ECU_ADDRESS 0xd0004957 /end MEASUREMENT
/begin MEASUREMENT lv_cdn_diag_crk_oc "Diagnosis condition" UBYTE _CNV_S_2_RANGE______3_CM 1 0. 0. 1. ECU_ADDRESS 0xd0004963 BIT_MASK 0x1 /end MEASUREMENT
/begin MEASUREMENT lv_cdn_diag_crk_plaus "" UBYTE _CNV_S_2_RANGE______3_CM 1 0. 0. 1. ECU_ADDRESS 0xd0004961 BIT_MASK 0x1 /end MEASUREMENT
/begin MEASUREMENT lv_cdn_diag_crk_syn "" UBYTE _CNV_S_2_RANGE______3_CM 1 0. 0. 1. ECU_ADDRESS 0xd000495f BIT_MASK 0x1 /end MEASUREMENT
/begin MEASUREMENT lv_cdn_diag_crk_tooth "" UBYTE _CNV_S_2_RANGE______3_CM 1 0. 0. 1. ECU_ADDRESS 0xd000495b BIT_MASK 0x1 /end MEASUREMENT
/begin MEASUREMENT lv_cdn_diag_crk_tooth_per "" UBYTE _CNV_S_2_RANGE______3_CM 1 0. 0. 1. ECU_ADDRESS 0xd000495d BIT_MASK 0x1 /end MEASUREMENT
/begin MEASUREMENT lv_cdn_diag_igc_ol[0] "" UBYTE _CNV_S_2_RANGE______3_CM 1 0. 0. 1. ECU_ADDRESS 0xd0004946 /end MEASUREMENT
/begin MEASUREMENT lv_cdn_diag_igc_ol[1] "" UBYTE _CNV_S_2_RANGE______3_CM 1 0. 0. 1. ECU_ADDRESS 0xd0004947 /end MEASUREMENT
/begin MEASUREMENT lv_cdn_diag_igc_ol[2] "" UBYTE _CNV_S_2_RANGE______3_CM 1 0. 0. 1. ECU_ADDRESS 0xd0004948 /end MEASUREMENT
/begin MEASUREMENT lv_cdn_diag_igc_ol[3] "" UBYTE _CNV_S_2_RANGE______3_CM 1 0. 0. 1. ECU_ADDRESS 0xd0004949 /end MEASUREMENT
/begin MEASUREMENT lv_cdn_diag_igc_scg[0] "" UBYTE _CNV_S_2_RANGE______3_CM 1 0. 0. 1. ECU_ADDRESS 0xd0004942 /end MEASUREMENT
/begin MEASUREMENT lv_cdn_diag_igc_scg[1] "" UBYTE _CNV_S_2_RANGE______3_CM 1 0. 0. 1. ECU_ADDRESS 0xd0004943 /end MEASUREMENT
/begin MEASUREMENT lv_cdn_diag_igc_scg[2] "" UBYTE _CNV_S_2_RANGE______3_CM 1 0. 0. 1. ECU_ADDRESS 0xd0004944 /end MEASUREMENT
/begin MEASUREMENT lv_cdn_diag_igc_scg[3] "" UBYTE _CNV_S_2_RANGE______3_CM 1 0. 0. 1. ECU_ADDRESS 0xd0004945 /end MEASUREMENT
/begin MEASUREMENT lv_cdn_diag_igc_scp[0] "" UBYTE _CNV_S_2_RANGE______3_CM 1 0. 0. 1. ECU_ADDRESS 0xd000493e /end MEASUREMENT
/begin MEASUREMENT lv_cdn_diag_igc_scp[1] "" UBYTE _CNV_S_2_RANGE______3_CM 1 0. 0. 1. ECU_ADDRESS 0xd000493f /end MEASUREMENT
/begin MEASUREMENT lv_cdn_diag_igc_scp[2] "" UBYTE _CNV_S_2_RANGE______3_CM 1 0. 0. 1. ECU_ADDRESS 0xd0004940 /end MEASUREMENT
/begin MEASUREMENT lv_cdn_diag_igc_scp[3] "" UBYTE _CNV_S_2_RANGE______3_CM 1 0. 0. 1. ECU_ADDRESS 0xd0004941 /end MEASUREMENT
/begin MEASUREMENT lv_cdn_diag_per_cam_in[0] "" UBYTE _CNV_S_2_RANGE______3_CM 1 0. 0. 1. ECU_ADDRESS 0xd0004964 BIT_MASK 0x1 /end MEASUREMENT
/begin MEASUREMENT lv_cdn_diag_plaus_cam_in[0] "" UBYTE _CNV_S_2_RANGE______3_CM 1 0. 0. 1. ECU_ADDRESS 0xd000496a BIT_MASK 0x1 /end MEASUREMENT
/begin MEASUREMENT lv_cdn_diag_ref_crk_cam_in[0] "" UBYTE _CNV_S_2_RANGE______3_CM 1 0. 0. 1. ECU_ADDRESS 0xd0004968 BIT_MASK 0x1 /end MEASUREMENT
/begin MEASUREMENT lv_cdn_diag_rel_knk[0] "Engine state condition to authorise the relative diagnosis" UBYTE _CNV_S_2_RANGE______3_CM 1 0. 0. 1. ECU_ADDRESS 0xd0004958 /end MEASUREMENT
/begin MEASUREMENT lv_cdn_diag_syn_cam_in[0] "" UBYTE _CNV_S_2_RANGE______3_CM 1 0. 0. 1. ECU_ADDRESS 0xd0004966 BIT_MASK 0x1 /end MEASUREMENT
/begin MEASUREMENT lv_cdn_diag_syn_crk_cam_in[0] "" UBYTE _CNV_S_2_RANGE______3_CM 1 0. 0. 1. ECU_ADDRESS 0xd000496c BIT_MASK 0x1 /end MEASUREMENT
/begin MEASUREMENT err_sym_el_sov "Symptom of the failure for SOV diagnosis" UBYTE _CNV_S_16_RANGE_ERR__147_CM 1 0. 0. 15. ECU_ADDRESS 0xd00055f6 /end MEASUREMENT
/begin MEASUREMENT err_sym_map "Detected symptom MAP sensor" UBYTE _CNV_S_16_RANGE_ERR__147_CM 1 0. 0. 15. ECU_ADDRESS 0xd00045b7 /end MEASUREMENT
/begin MEASUREMENT err_sym_put "Detected symptom PUT sensor" UBYTE _CNV_S_16_RANGE_ERR__147_CM 1 0. 0. 15. ECU_ADDRESS 0xd00045b8 /end MEASUREMENT
/begin MEASUREMENT iga_av_shift_rng_1 "Ignition angle at cylinder 1" UBYTE _CNV_A_R_IGRE_LINEA_48_CM 1 0. -23.625 72. ECU_ADDRESS 0xd00045ba FORMAT "%7.3" /end MEASUREMENT
/begin MEASUREMENT iga_av_shift_rng_2 "Ignition angle at cylinder 2" UBYTE _CNV_A_R_IGRE_LINEA_48_CM 1 0. -23.625 72. ECU_ADDRESS 0xd00045bb FORMAT "%7.3" /end MEASUREMENT
/begin MEASUREMENT iga_av_shift_rng_3 "ignition angle at cylinder 3" UBYTE _CNV_A_R_IGRE_LINEA_48_CM 1 0. -23.625 72. ECU_ADDRESS 0xd00045bc FORMAT "%7.3" /end MEASUREMENT
/begin MEASUREMENT iga_av_shift_rng_4 "ignition angle at cylinder 4" UBYTE _CNV_A_R_IGRE_LINEA_48_CM 1 0. -23.625 72. ECU_ADDRESS 0xd00045bd FORMAT "%7.3" /end MEASUREMENT
/begin MEASUREMENT lv_cdn_diag_map "Status od diagnosis for MAP sensor" UBYTE _CNV_S_2_RANGE______3_CM 1 0. 0. 1. ECU_ADDRESS 0xd00045e2 BIT_MASK 0x1 /end MEASUREMENT
/begin MEASUREMENT lv_cdn_diag_put "Status od diagnosis for PUT sensor" UBYTE _CNV_S_2_RANGE______3_CM 1 0. 0. 1. ECU_ADDRESS 0xd00045e3 BIT_MASK 0x1 /end MEASUREMENT
/begin MEASUREMENT lv_conf_pre_inj "Configuration of pre-injection type" UBYTE _CNV_S_2_RANGE______3_CM 1 0. 0. 1. ECU_ADDRESS 0xd00055fe /end MEASUREMENT
/begin MEASUREMENT lv_igk_on "Key-on Flag" UBYTE _CNV_S_2_RANGE______3_CM 1 0. 0. 1. ECU_ADDRESS 0xd00045e5 BIT_MASK 0x1 /end MEASUREMENT
/begin MEASUREMENT lv_inh_inj[0] "Cylinder individual inhibition" UBYTE _CNV_S_2_RANGE______3_CM 1 0. 0. 1. ECU_ADDRESS 0xd00045b0 /end MEASUREMENT
/begin MEASUREMENT lv_inh_inj[1] "Cylinder individual inhibition" UBYTE _CNV_S_2_RANGE______3_CM 1 0. 0. 1. ECU_ADDRESS 0xd00045b1 /end MEASUREMENT
/begin MEASUREMENT lv_inh_inj[2] "Cylinder individual inhibition" UBYTE _CNV_S_2_RANGE______3_CM 1 0. 0. 1. ECU_ADDRESS 0xd00045b2 /end MEASUREMENT
/begin MEASUREMENT lv_inh_inj[3] "Cylinder individual inhibition" UBYTE _CNV_S_2_RANGE______3_CM 1 0. 0. 1. ECU_ADDRESS 0xd00045b3 /end MEASUREMENT
/begin MEASUREMENT lv_lsh_down "Heater driver ON/OFF; acquired also by BSW" UBYTE _CNV_S_2_RANGE______3_CM 1 0. 0. 1. ECU_ADDRESS 0xd00045e8 BIT_MASK 0x1 /end MEASUREMENT
/begin MEASUREMENT lv_lsh_up "Heater driver ON/OFF, acquired also by BSW" UBYTE _CNV_S_2_RANGE______3_CM 1 0. 0. 1. ECU_ADDRESS 0xd00045e9 BIT_MASK 0x1 /end MEASUREMENT
/begin MEASUREMENT lv_pre_inj_ena "Flag to enable the pre_injection" UBYTE _CNV_S_2_RANGE______3_CM 1 0. 0. 1. ECU_ADDRESS 0xd00045eb /end MEASUREMENT
/begin MEASUREMENT lv_st_end "end of the engine operating state \"start\"" UBYTE _CNV_S_2_RANGE______3_CM 1 0. 0. 1. ECU_ADDRESS 0xd00045ed /end MEASUREMENT
/begin MEASUREMENT lv_vs_run "Boolean for running vehicle" UBYTE _CNV_S_2_RANGE______3_CM 1 0. 0. 1. ECU_ADDRESS 0xd00045f9 BIT_MASK 0x1 /end MEASUREMENT
/begin MEASUREMENT maf_hb "Air mass (predicted) for calculation of basic fuel injection (lower resol)" UBYTE _CNV_A_R_LINEAR_____281_CM 1 0. 0. 1389. ECU_ADDRESS 0xd0001421 FORMAT "%13.8" /end MEASUREMENT
/begin MEASUREMENT ofs_ref_inj "Injection reference offset" UWORD _CNV_A_R_LINEAR_____25_CM 1 0. 0. 720. ECU_ADDRESS 0xd0005ad6 FORMAT "%7.3" /end MEASUREMENT
/begin MEASUREMENT soi_1_hom[0] "Start of injection for homogeneous mode, for the first injection - cylinder individual" UWORD _CNV_A_R_LINEAR_____25_CM 1 0. 0. 720. ECU_ADDRESS 0xd00034ec FORMAT "%7.3" /end MEASUREMENT
/begin MEASUREMENT soi_1_hom[1] "Start of injection for homogeneous mode, for the first injection - cylinder individual" UWORD _CNV_A_R_LINEAR_____25_CM 1 0. 0. 720. ECU_ADDRESS 0xd00034ee FORMAT "%7.3" /end MEASUREMENT
/begin MEASUREMENT soi_1_hom[2] "Start of injection for homogeneous mode, for the first injection - cylinder individual" UWORD _CNV_A_R_LINEAR_____25_CM 1 0. 0. 720. ECU_ADDRESS 0xd00034f0 FORMAT "%7.3" /end MEASUREMENT
/begin MEASUREMENT soi_1_hom[3] "Start of injection for homogeneous mode, for the first injection - cylinder individual" UWORD _CNV_A_R_LINEAR_____25_CM 1 0. 0. 720. ECU_ADDRESS 0xd00034f2 FORMAT "%7.3" /end MEASUREMENT
/begin MEASUREMENT soi_2_hom[0] "Start of injection for homogeneous mode, for the second injection - cylinder individual" UWORD _CNV_A_R_LINEAR_____25_CM 1 0. 0. 720. ECU_ADDRESS 0xd00034f4 FORMAT "%7.3" /end MEASUREMENT
/begin MEASUREMENT soi_2_hom[1] "Start of injection for homogeneous mode, for the second injection - cylinder individual" UWORD _CNV_A_R_LINEAR_____25_CM 1 0. 0. 720. ECU_ADDRESS 0xd00034f6 FORMAT "%7.3" /end MEASUREMENT
/begin MEASUREMENT soi_2_hom[2] "Start of injection for homogeneous mode, for the second injection - cylinder individual" UWORD _CNV_A_R_LINEAR_____25_CM 1 0. 0. 720. ECU_ADDRESS 0xd00034f8 FORMAT "%7.3" /end MEASUREMENT
/begin MEASUREMENT soi_2_hom[3] "Start of injection for homogeneous mode, for the second injection - cylinder individual" UWORD _CNV_A_R_LINEAR_____25_CM 1 0. 0. 720. ECU_ADDRESS 0xd00034fa FORMAT "%7.3" /end MEASUREMENT
/begin MEASUREMENT soi_pre_inj[0] "Start of injection for preinjection" UWORD _CNV_A_R_LINEAR_____25_CM 1 0. 0. 720. ECU_ADDRESS 0xd00034fc FORMAT "%7.3" /end MEASUREMENT
/begin MEASUREMENT soi_pre_inj[1] "Start of injection for preinjection" UWORD _CNV_A_R_LINEAR_____25_CM 1 0. 0. 720. ECU_ADDRESS 0xd00034fe FORMAT "%7.3" /end MEASUREMENT
/begin MEASUREMENT soi_pre_inj[2] "Start of injection for preinjection" UWORD _CNV_A_R_LINEAR_____25_CM 1 0. 0. 720. ECU_ADDRESS 0xd0003500 FORMAT "%7.3" /end MEASUREMENT
/begin MEASUREMENT soi_pre_inj[3] "Start of injection for preinjection" UWORD _CNV_A_R_LINEAR_____25_CM 1 0. 0. 720. ECU_ADDRESS 0xd0003502 FORMAT "%7.3" /end MEASUREMENT
/begin MEASUREMENT tco "coolant temperature" UBYTE _CNV_A_R_LINEAR_____42_CM 1 0. -48. 142.5 ECU_ADDRESS 0xd00045c0 FORMAT "%6.2" /end MEASUREMENT
/begin MEASUREMENT ti_1_hom[0] "Cylinder individual injection time, homogeneous mode, first pulse" UWORD _CNV_A_R_LINEAR_____44_CM 1 0. 0. 262.14 ECU_ADDRESS 0xd0003504 FORMAT "%7.3" /end MEASUREMENT
/begin MEASUREMENT ti_1_hom[1] "Cylinder individual injection time, homogeneous mode, first pulse" UWORD _CNV_A_R_LINEAR_____44_CM 1 0. 0. 262.14 ECU_ADDRESS 0xd0003506 FORMAT "%7.3" /end MEASUREMENT
/begin MEASUREMENT ti_1_hom[2] "Cylinder individual injection time, homogeneous mode, first pulse" UWORD _CNV_A_R_LINEAR_____44_CM 1 0. 0. 262.14 ECU_ADDRESS 0xd0003508 FORMAT "%7.3" /end MEASUREMENT
/begin MEASUREMENT ti_1_hom[3] "Cylinder individual injection time, homogeneous mode, first pulse" UWORD _CNV_A_R_LINEAR_____44_CM 1 0. 0. 262.14 ECU_ADDRESS 0xd000350a FORMAT "%7.3" /end MEASUREMENT
/begin MEASUREMENT ti_2_hom[0] "cylinder  individual injection time, homogeneous mode, second pulse" UWORD _CNV_A_R_LINEAR_____44_CM 1 0. 0. 262.14 ECU_ADDRESS 0xd000350c FORMAT "%7.3" /end MEASUREMENT
/begin MEASUREMENT ti_2_hom[1] "cylinder  individual injection time, homogeneous mode, second pulse" UWORD _CNV_A_R_LINEAR_____44_CM 1 0. 0. 262.14 ECU_ADDRESS 0xd000350e FORMAT "%7.3" /end MEASUREMENT
/begin MEASUREMENT ti_2_hom[2] "cylinder  individual injection time, homogeneous mode, second pulse" UWORD _CNV_A_R_LINEAR_____44_CM 1 0. 0. 262.14 ECU_ADDRESS 0xd0003510 FORMAT "%7.3" /end MEASUREMENT
/begin MEASUREMENT ti_2_hom[3] "cylinder  individual injection time, homogeneous mode, second pulse" UWORD _CNV_A_R_LINEAR_____44_CM 1 0. 0. 262.14 ECU_ADDRESS 0xd0003512 FORMAT "%7.3" /end MEASUREMENT
/begin MEASUREMENT ti_pre_inj[0] "Pre-injection time" UWORD _CNV_A_R_LINEAR_____44_CM 1 0. 0. 262.14 ECU_ADDRESS 0xd0003514 FORMAT "%7.3" /end MEASUREMENT
/begin MEASUREMENT ti_pre_inj[1] "Pre-injection time" UWORD _CNV_A_R_LINEAR_____44_CM 1 0. 0. 262.14 ECU_ADDRESS 0xd0003516 FORMAT "%7.3" /end MEASUREMENT
/begin MEASUREMENT ti_pre_inj[2] "Pre-injection time" UWORD _CNV_A_R_LINEAR_____44_CM 1 0. 0. 262.14 ECU_ADDRESS 0xd0003518 FORMAT "%7.3" /end MEASUREMENT
/begin MEASUREMENT ti_pre_inj[3] "Pre-injection time" UWORD _CNV_A_R_LINEAR_____44_CM 1 0. 0. 262.14 ECU_ADDRESS 0xd000351a FORMAT "%7.3" /end MEASUREMENT
/begin MEASUREMENT v_dtp "Differential fuel tank pressure sensor ADC result stored at 10 bits" UWORD _CNV_A_R_LINEAR_____269_CM 1 0. 0. 4.9951171875 ECU_ADDRESS 0xc0000000 FORMAT "%5.3" /end MEASUREMENT
/begin CHARACTERISTIC c_ofs_ref_inj "value of offset for progressive shift of injection" VALUE 0xa00214ac _REC_S1VAL_20_u2 720. _CNV_A_R_LINEAR_____25_CM 0. 720. FORMAT "%7.3" /end CHARACTERISTIC
/begin CHARACTERISTIC lc_eng_pha_upd_req "Configuration of pre-injection type (=1 Renault Configuration ie Full group and launch after x teeth valid" VALUE 0xa00214ae _REC_S1VAL_20_u1 1. _CNV_S_2_RANGE______3_CM 0. 1. /end CHARACTERISTIC
/begin MEASUREMENT Vsx_maf_fct_vld "Validity indicator for the whole mass air flow to throttle setpoint conversion function" UBYTE _CNV_S_3_STATUS_OK__120_CM 1 0. 0. 2. ECU_ADDRESS 0xd00048a7 /end MEASUREMENT
/begin MEASUREMENT lv_cam_lock_ref_pos_ivvt_in "VVTC detected in default position (information used by the basic software for CAM/CRAN coherence diagnosis)" UBYTE _CNV_S_2_RANGE______3_CM 1 0. 0. 1. ECU_ADDRESS 0xd0003f43 BIT_MASK 0x1 /end MEASUREMENT
/begin MEASUREMENT lv_eng_pha_upd_req "Flag to request an engine phasing update" UBYTE _CNV_S_2_RANGE______3_CM 1 0. 0. 1. ECU_ADDRESS 0xd0003f42 BIT_MASK 0x1 /end MEASUREMENT
/begin MEASUREMENT toil "Oil temperature" UWORD _CNV_A_R_LINEAR_____54_CM 1 0. -40. 200. ECU_ADDRESS 0xc0000bd8 FORMAT "%6.1" /end MEASUREMENT
/begin MEASUREMENT lv_emul "" UBYTE _CNV_S_2_RANGE______3_CM 1 0. 0. 1. ECU_ADDRESS 0xd000404f /end MEASUREMENT
/begin MEASUREMENT Vxx_ovt_acel_pdl_dif "Accelerator pedal ratio difference for driver overtorque request condition" UWORD _CNV_A_R_LINEAR_____211_CM 1 0. 0. 1.25 ECU_ADDRESS 0xd0003a1a FORMAT "%7.5" /end MEASUREMENT
/begin MEASUREMENT ctr_loss_tsk_ecu_run_cyc "Number of task losses within the ECU running cycle. The ECU running cycle corresponds to the time between end of reset phase and the end of the power latch phase. This counter does not overrun." UWORD _CNV_A_R_ECME_LINEA_0_CM 1 0. 0. 65535. ECU_ADDRESS 0xd0002ef2 FORMAT "%5.0" /end MEASUREMENT
/begin MEASUREMENT ctr_loss_tsk_sw_cyc "Number of task losses within the SW life cycle or since erasing. This counter does not overrun." UWORD _CNV_A_R_ECME_LINEA_0_CM 1 0. 0. 65535. ECU_ADDRESS 0xd0002ef4 FORMAT "%5.0" /end MEASUREMENT
/begin MEASUREMENT lf_state_os_tsk_loss_ecu_cyc[0] "Operating system status information: Bitfield indicating which task activations are lost within the current ECU running cycle. The ECU running cycle corresponds to the time since power up." ULONG _CNV_A_R_A_165_CM 1 0. 0. 4294967295. ECU_ADDRESS 0xd0001680 /end MEASUREMENT
/begin MEASUREMENT lf_state_os_tsk_loss_prev[0] "Operating system status information: Bitfield indicating the task activation which is is lost last within the current ECU running cycle. In case no task is lost within the current ECU running cycle no bit is set." ULONG _CNV_A_R_A_165_CM 1 0. 0. 4294967295. ECU_ADDRESS 0xd0001684 /end MEASUREMENT
/begin MEASUREMENT lf_state_os_tsk_loss_sw_cyc[0] "Operating system status information: Bitfield indicating which task activations are lost within the SW life cycle or since erasing. The SW life cycle corresponds to the time since the last SW reprogramming." ULONG _CNV_A_R_A_165_CM 1 0. 0. 4294967295. ECU_ADDRESS 0xd0001688 /end MEASUREMENT
/begin MEASUREMENT stack_cns[0] "Table of maximum used stack in percent" UBYTE _CNV_A_R_LINEAR_____114_CM 1 0. 0. 100. ECU_ADDRESS 0xd0004aac FORMAT "%3.1" /end MEASUREMENT
/begin MEASUREMENT stack_cns[1] "Table of maximum used stack in percent" UBYTE _CNV_A_R_LINEAR_____114_CM 1 0. 0. 100. ECU_ADDRESS 0xd0004aad FORMAT "%3.1" /end MEASUREMENT
/begin MEASUREMENT ctr_wrt_fly "" UBYTE _CNV_A_R_ECME_LINEA_0_CM 1 0. 0. 255. ECU_ADDRESS 0xd000441f FORMAT "%3.0" /end MEASUREMENT
/begin MEASUREMENT ctr_wrt_fly_swt "Counter to stop write-on the fly on bank switch" ULONG _CNV_A_R_A_165_CM 1 0. 0. 16777215. ECU_ADDRESS 0xd0001ac8 /end MEASUREMENT
/begin MEASUREMENT lv_cru_wrt_req "Writing request in the fly zone" UBYTE _CNV_S_2_RANGE______3_CM 1 0. 0. 1. ECU_ADDRESS 0xd0004420 /end MEASUREMENT
/begin MEASUREMENT switch_type " = 0 : No switch" UBYTE _CNV_A_R_ECME_LINEA_0_CM 1 0. 0. 2. ECU_ADDRESS 0xd000555a FORMAT "%1.0" /end MEASUREMENT
/begin AXIS_PTS Ctb_sfty_esti_tqi "Map of indicated torque breakpoints (for safety)" 0xa0022074 Vxx_sfty_tqi_sp _REC_A2AXS_20_u2 2047.96875 _CNV_A_R_LINEAR_____123_CM 17 0. 2047.96875 FORMAT "%10.5" /end AXIS_PTS
/begin AXIS_PTS Ctb_sfty_tqi_req "Map of indicated torque breakpoints (for safety)" 0xa0022098 Vxx_sfty_tqi_sp _REC_A2AXS_20_u2 2047.96875 _CNV_A_R_LINEAR_____123_CM 17 0. 2047.96875 FORMAT "%10.5" /end AXIS_PTS
/begin CHARACTERISTIC Ctp_sfty_esti_tqi_pos_err "Map of maximum positive error authorised between realized and safe torque for safety" CURVE 0xa00220bc _REC_A1CUR_20_u2_u2 2047.96875 _CNV_A_R_LINEAR_____123_CM 0. 2047.96875 FORMAT "%10.5"
 /begin AXIS_DESCR COM_AXIS Vxx_sfty_tqi_sp _CNV_A_R_LINEAR_____123_CM 17 0. 2047.96875 FORMAT "%10.5" AXIS_PTS_REF Ctb_sfty_esti_tqi /end AXIS_DESCR
/end CHARACTERISTIC
/begin CHARACTERISTIC Ctp_sfty_tqi_req_pos_err "Map of maximum positive error authorised between main and safe torque for safety" CURVE 0xa00220e0 _REC_A1CUR_20_u2_u2 2047.96875 _CNV_A_R_LINEAR_____123_CM 0. 2047.96875 FORMAT "%10.5"
 /begin AXIS_DESCR COM_AXIS Vxx_sfty_tqi_sp _CNV_A_R_LINEAR_____123_CM 17 0. 2047.96875 FORMAT "%10.5" AXIS_PTS_REF Ctb_sfty_tqi_req /end AXIS_DESCR
/end CHARACTERISTIC
/begin MEASUREMENT Vbx_df_sfty_tq_chr "ECM torque plausibility detected failure" UBYTE _CNV_S_2_RANGE______3_CM 1 0. 0. 1. ECU_ADDRESS 0xd0005d6a BIT_MASK 0x1 /end MEASUREMENT
/begin MEASUREMENT Vbx_df_sfty_tq_clc_chr "ECM torque calculation plausibility detected failure" UBYTE _CNV_S_2_RANGE______3_CM 1 0. 0. 1. ECU_ADDRESS 0xd0005d6b BIT_MASK 0x1 /end MEASUREMENT
/begin MEASUREMENT Vbx_df_sfty_tq_lih_chr "throttle limp home for safety detected failure" UBYTE _CNV_S_2_RANGE______3_CM 1 0. 0. 1. ECU_ADDRESS 0xd0005d6c BIT_MASK 0x1 /end MEASUREMENT
/begin MEASUREMENT Vbx_prev_df_sfty_tq_chr "Previous value of ECM torque plausibility detected failure" UBYTE _CNV_S_2_RANGE______3_CM 1 0. 0. 1. ECU_ADDRESS 0xd0005d6d BIT_MASK 0x1 /end MEASUREMENT
/begin MEASUREMENT Vbx_sfty_aftr_rst "After an ECU reset requested safety monitoring" UBYTE _CNV_S_2_RANGE______3_CM 1 0. 0. 1. ECU_ADDRESS 0xd0005d6e BIT_MASK 0x1 /end MEASUREMENT
/begin MEASUREMENT Vbx_sfty_aftr_rst_ini "In the initial period after an ECU reset requested safety monitoring" UBYTE _CNV_S_2_RANGE______3_CM 1 0. 0. 1. ECU_ADDRESS 0xd0005d6f BIT_MASK 0x1 /end MEASUREMENT
/begin MEASUREMENT Vbx_sfty_aftr_rst_mem "After an ECU reset requested safety monitoring (stored in hot-reset proof memory)" UBYTE _CNV_S_2_RANGE______3_CM 1 0. 0. 1. ECU_ADDRESS 0xd0005d70 BIT_MASK 0x1 /end MEASUREMENT
/begin MEASUREMENT Vbx_sfty_diag_ena_tqi "boolean which indicates that the diagnosis conditions are ok" UBYTE _CNV_S_2_RANGE______3_CM 1 0. 0. 1. ECU_ADDRESS 0xd0005d71 BIT_MASK 0x1 /end MEASUREMENT
/begin MEASUREMENT Vbx_sfty_esti_tqi_nok "boolean which indicates that torque realization is not coherent with safe torque" UBYTE _CNV_S_2_RANGE______3_CM 1 0. 0. 1. ECU_ADDRESS 0xd0005d72 BIT_MASK 0x1 /end MEASUREMENT
/begin MEASUREMENT Vbx_sfty_esti_tqi_nok_tmp "boolean which indicates that torque realization is temporarly not coherent with safe torque" UBYTE _CNV_S_2_RANGE______3_CM 1 0. 0. 1. ECU_ADDRESS 0xd0005d73 BIT_MASK 0x1 /end MEASUREMENT
/begin MEASUREMENT Vbx_sfty_lih_mon_ena "Throttle limp home monitoring enabled" UBYTE _CNV_S_2_RANGE______3_CM 1 0. 0. 1. ECU_ADDRESS 0xd0005d74 BIT_MASK 0x1 /end MEASUREMENT
/begin MEASUREMENT Vbx_sfty_moni_bch_ok "Monitool or bench mode are active" UBYTE _CNV_S_2_RANGE______3_CM 1 0. 0. 1. ECU_ADDRESS 0xd0005d75 BIT_MASK 0x1 /end MEASUREMENT
/begin MEASUREMENT Vbx_sfty_rst_req "ECU reset request by safety monitoring" UBYTE _CNV_S_2_RANGE______3_CM 1 0. 0. 1. ECU_ADDRESS 0xd0005d76 BIT_MASK 0x1 /end MEASUREMENT
/begin MEASUREMENT Vbx_sfty_stop_req "Engine stop request by safety monitoring" UBYTE _CNV_S_2_RANGE______3_CM 1 0. 0. 1. ECU_ADDRESS 0xd0005d77 BIT_MASK 0x1 /end MEASUREMENT
/begin MEASUREMENT Vbx_sfty_stop_req_aftr_rst "Engine stop request by safety monitoring (sfter reset value)" UBYTE _CNV_S_2_RANGE______3_CM 1 0. 0. 1. ECU_ADDRESS 0xd0005d78 BIT_MASK 0x1 /end MEASUREMENT
/begin MEASUREMENT Vbx_sfty_stop_req_mem "Engine stop request by safety monitoring (stored in hot-reset proof memory)" UBYTE _CNV_S_2_RANGE______3_CM 1 0. 0. 1. ECU_ADDRESS 0xd0005d79 BIT_MASK 0x1 /end MEASUREMENT
/begin MEASUREMENT Vbx_sfty_thr_lih_mon_nok_fil "throttle limp home doesn't execut correctly for safety (filtered)" UBYTE _CNV_S_2_RANGE______3_CM 1 0. 0. 1. ECU_ADDRESS 0xd0005d7a BIT_MASK 0x1 /end MEASUREMENT
/begin MEASUREMENT Vbx_sfty_tq_mon_nok "boolean which indicates a failure detection in the torque structure for safety" UBYTE _CNV_S_2_RANGE______3_CM 1 0. 0. 1. ECU_ADDRESS 0xd0005d7b BIT_MASK 0x1 /end MEASUREMENT
/begin MEASUREMENT Vbx_sfty_tqi_sp_nok "Boolean which indicates that main torque request is not coherent with safe torque request" UBYTE _CNV_S_2_RANGE______3_CM 1 0. 0. 1. ECU_ADDRESS 0xd0005d7c BIT_MASK 0x1 /end MEASUREMENT
/begin MEASUREMENT Vbx_sfty_tqi_sp_nok_tmp "Boolean which indicates that main torque request is temporarly not coherent with safe torque request" UBYTE _CNV_S_2_RANGE______3_CM 1 0. 0. 1. ECU_ADDRESS 0xd0005d7d BIT_MASK 0x1 /end MEASUREMENT
/begin MEASUREMENT Vbx_sfty_vs_dsb "Inhibition of safety monitoring on vehicle speed conditions" UBYTE _CNV_S_2_RANGE______3_CM 1 0. 0. 1. ECU_ADDRESS 0xd0005d7e BIT_MASK 0x1 /end MEASUREMENT
/begin MEASUREMENT Vsx_sfty_tq_mon_vld "Safety torque monitoring validity status" UBYTE _CNV_S_2_STATUS_OK__214_CM 1 0. 0. 1. ECU_ADDRESS 0xd0005d7f /end MEASUREMENT
/begin MEASUREMENT Vxx_sfty_esti_err "Positive error authorised between main and safe torque for safety" UWORD _CNV_A_R_LINEAR_____123_CM 1 0. 0. 2047.96875 ECU_ADDRESS 0xd0005d60 FORMAT "%10.5" /end MEASUREMENT
/begin MEASUREMENT Vxx_sfty_esti_err_max "Positive error authorised between main and safe torque for safety (max-over-time filtered)" UWORD _CNV_A_R_LINEAR_____123_CM 1 0. 0. 2047.96875 ECU_ADDRESS 0xd0005d62 FORMAT "%10.5" /end MEASUREMENT
/begin MEASUREMENT Vxx_sfty_esti_tqi_t_fil_min "Positive error authorised between main and safe torque for safety (min-over-time filtered)" UWORD _CNV_A_R_LINEAR_____123_CM 1 0. 0. 2047.96875 ECU_ADDRESS 0xd0005d64 FORMAT "%10.5" /end MEASUREMENT
/begin MEASUREMENT Vxx_sfty_tq_ffm_data_sf "Torque safety monitoring status flags for snapshot data" UBYTE _CNV_A_R_ECME_LINEA_0_CM 1 0. 0. 255. ECU_ADDRESS 0xd0005d80 FORMAT "%3.0" /end MEASUREMENT
/begin MEASUREMENT Vxx_sfty_tqi_sp_t_fil_max "Final indicated setpoint torque for safety (max-over-time filtered)" UWORD _CNV_A_R_LINEAR_____123_CM 1 0. 0. 2047.96875 ECU_ADDRESS 0xd0005d66 FORMAT "%10.5" /end MEASUREMENT
/begin MEASUREMENT Vxx_tqi_esti_sp_dif "Difference between safety estimation of realized torque and safety estimation of torque setpoint" UWORD _CNV_A_R_LINEAR_____123_CM 1 0. 0. 2047.96875 ECU_ADDRESS 0xd0005d68 FORMAT "%10.5" /end MEASUREMENT
/begin CHARACTERISTIC Cxx_dfdec_sfty_tq_chr "ECM torque plausibility detected failure counter decrement" VALUE 0xa0021f54 _REC_S1VAL_20_u2 65535. _CNV_A_R_ECME_LINEA_0_CM 0. 65535. FORMAT "%5.0" /end CHARACTERISTIC
/begin CHARACTERISTIC Cxx_dfdec_sfty_tq_clc_chr "ECM torque calculation plausibility detected failure counter decrement" VALUE 0xa0021f56 _REC_S1VAL_20_u2 65535. _CNV_A_R_ECME_LINEA_0_CM 0. 65535. FORMAT "%5.0" /end CHARACTERISTIC
/begin CHARACTERISTIC Cxx_dfdec_sfty_tq_lih_chr "throttle limp home for safety detected failure counter decrement" VALUE 0xa0021f58 _REC_S1VAL_20_u2 65535. _CNV_A_R_ECME_LINEA_0_CM 0. 65535. FORMAT "%5.0" /end CHARACTERISTIC
/begin CHARACTERISTIC Cxx_dfinc_sfty_tq_chr "ECM torque plausibility detected failure counter increment" VALUE 0xa0021f5a _REC_S1VAL_20_u2 65535. _CNV_A_R_ECME_LINEA_0_CM 0. 65535. FORMAT "%5.0" /end CHARACTERISTIC
/begin CHARACTERISTIC Cxx_dfinc_sfty_tq_clc_chr "ECM torque calculation plausibility detected failure counter increment" VALUE 0xa0021f5c _REC_S1VAL_20_u2 65535. _CNV_A_R_ECME_LINEA_0_CM 0. 65535. FORMAT "%5.0" /end CHARACTERISTIC
/begin CHARACTERISTIC Cxx_dfinc_sfty_tq_lih_chr "throttle limp home for safety detected failure counter increment" VALUE 0xa0021f5e _REC_S1VAL_20_u2 65535. _CNV_A_R_ECME_LINEA_0_CM 0. 65535. FORMAT "%5.0" /end CHARACTERISTIC
/begin CHARACTERISTIC Cxx_sfty_cyl_nr "Copy of number of cylinder for safety monitoring" VALUE 0xa0021f60 _REC_S1VAL_20_u1 12. _CNV_A_R_ECME_LINEA_0_CM 0. 12. FORMAT "%2.0" /end CHARACTERISTIC
/begin CHARACTERISTIC Cxx_sfty_diag_ena_cata_dly "Diagnostic inhibition delay after catalyst warm up" VALUE 0xa0021f61 _REC_S1VAL_20_u1 255. _CNV_A_R_LINEAR_____82_CM 0. 255. FORMAT "%3.0" /end CHARACTERISTIC
/begin CHARACTERISTIC Cxx_sfty_diag_ena_cata_dly_rst "Diagnostic inhibition delay after catalyst warm up (after safety reset)" VALUE 0xa0021f62 _REC_S1VAL_20_u1 255. _CNV_A_R_LINEAR_____82_CM 0. 255. FORMAT "%3.0" /end CHARACTERISTIC
/begin CHARACTERISTIC Cxx_sfty_diag_ena_eng_dly "Diagnostic inhibition delay after autonomous engine" VALUE 0xa0021f63 _REC_S1VAL_20_u1 255. _CNV_A_R_LINEAR_____82_CM 0. 255. FORMAT "%3.0" /end CHARACTERISTIC
/begin CHARACTERISTIC Cxx_sfty_diag_ena_eng_dly_rst "Diagnostic inhibition delay after autonomous engine (after safety reset)" VALUE 0xa0021f64 _REC_S1VAL_20_u1 255. _CNV_A_R_LINEAR_____82_CM 0. 255. FORMAT "%3.0" /end CHARACTERISTIC
/begin CHARACTERISTIC Cxx_sfty_diag_ena_n_thd "engine speed value to authorize the diagnostic" VALUE 0xa0021f65 _REC_S1VAL_20_u1 8160. _CNV_A_R_LINEAR_____2_CM 0. 8160. FORMAT "%4.0" /end CHARACTERISTIC
/begin CHARACTERISTIC Cxx_sfty_diag_ena_tco_thd "coolant temperature value to authorize the diagnostic" VALUE 0xa0021f66 _REC_S1VAL_20_u1 240. _CNV_A_R_LINEAR_____220_CM -40. 200. FORMAT "%3.0" /end CHARACTERISTIC
/begin CHARACTERISTIC Cxx_sfty_err_esti_t_fil_step "Number of steps for time filtering of estimation error" VALUE 0xa0021f67 _REC_S1VAL_20_u1 255. _CNV_A_R_ECME_LINEA_0_CM 0. 255. FORMAT "%3.0" /end CHARACTERISTIC
/begin CHARACTERISTIC Cxx_sfty_esti_tqi_deb_dec "Decrement value for safety torque realization failure detection" VALUE 0xa0021f68 _REC_S1VAL_20_u1 255. _CNV_A_R_ECME_LINEA_0_CM 0. 255. FORMAT "%3.0" /end CHARACTERISTIC
/begin CHARACTERISTIC Cxx_sfty_esti_tqi_deb_thd "Threshold for safety torque realization failure detection" VALUE 0xa0021f69 _REC_S1VAL_20_u1 255. _CNV_A_R_ECME_LINEA_0_CM 0. 255. FORMAT "%3.0" /end CHARACTERISTIC
/begin CHARACTERISTIC Cxx_sfty_esti_tqi_t_fil_step "Number of steps for time filtering of Vxx_sfty_esti_tqi" VALUE 0xa0021f6a _REC_S1VAL_20_u1 255. _CNV_A_R_ECME_LINEA_0_CM 0. 255. FORMAT "%3.0" /end CHARACTERISTIC
/begin CHARACTERISTIC Cxx_sfty_ext_ctrl_bch_vs_thd "Vehicle speed threshold for external controls and bench mode safety monitoring" VALUE 0xa0021f6b _REC_S1VAL_20_u1 255. _CNV_A_R_LINEAR_____212_CM 0. 255. FORMAT "%3.0" /end CHARACTERISTIC
/begin CHARACTERISTIC Cxx_sfty_ext_ctrl_t "External controls exit phase duration" VALUE 0xa0021f6c _REC_S1VAL_20_u1 10.2 _CNV_A_R_LINEAR_____153_CM 0. 10.2 FORMAT "%4.2" /end CHARACTERISTIC
/begin CHARACTERISTIC Cxx_sfty_gear_cge_dec_dly "Time required for safety monitoring inhibition after the end of a manual gear shift (due to target torque provision)" VALUE 0xa0021f6d _REC_S1VAL_20_u1 10.2 _CNV_A_R_LINEAR_____153_CM 0. 10.2 FORMAT "%4.2" /end CHARACTERISTIC
/begin CHARACTERISTIC Cxx_sfty_gear_cge_dec_dly_rst "Time required for safety monitoring inhibition after the end of a manual gear shift (due to target torque provision) (after safety reset)" VALUE 0xa0021f6e _REC_S1VAL_20_u1 10.2 _CNV_A_R_LINEAR_____153_CM 0. 10.2 FORMAT "%4.2" /end CHARACTERISTIC
/begin CHARACTERISTIC Cxx_sfty_rst_t "Duration of safety after-reset period" VALUE 0xa0021f6f _REC_S1VAL_20_u1 10.2 _CNV_A_R_LINEAR_____153_CM 0. 10.2 FORMAT "%4.2" /end CHARACTERISTIC
/begin CHARACTERISTIC Cxx_sfty_stop_req_igk_rst_t "key-off confirmation time to reauthorize engine start (for safety monitoring)" VALUE 0xa0021f70 _REC_S1VAL_20_u1 10.2 _CNV_A_R_LINEAR_____153_CM 0. 10.2 FORMAT "%4.2" /end CHARACTERISTIC
/begin CHARACTERISTIC Cxx_sfty_thr_lih_mon_deb_dec "Decrement value for throttle limp-home failure detection" VALUE 0xa0021f71 _REC_S1VAL_20_u1 255. _CNV_A_R_ECME_LINEA_0_CM 0. 255. FORMAT "%3.0" /end CHARACTERISTIC
/begin CHARACTERISTIC Cxx_sfty_thr_lih_mon_deb_thd "Threshold for throttle limp-home failure detection debouncing" VALUE 0xa0021f72 _REC_S1VAL_20_u1 255. _CNV_A_R_ECME_LINEA_0_CM 0. 255. FORMAT "%3.0" /end CHARACTERISTIC
/begin CHARACTERISTIC Cxx_sfty_tqi_sp_deb_dec "Decrement value for safety torque setpoint failure detection" VALUE 0xa0021f73 _REC_S1VAL_20_u1 255. _CNV_A_R_ECME_LINEA_0_CM 0. 255. FORMAT "%3.0" /end CHARACTERISTIC
/begin CHARACTERISTIC Cxx_sfty_tqi_sp_deb_thd "Threshold for safety torque setpoint failure detection" VALUE 0xa0021f74 _REC_S1VAL_20_u1 255. _CNV_A_R_ECME_LINEA_0_CM 0. 255. FORMAT "%3.0" /end CHARACTERISTIC
/begin CHARACTERISTIC Cxx_sfty_tqi_sp_t_fil_step "Number of steps for time filtering of Vxx_sfty_tqi_sp" VALUE 0xa0021f75 _REC_S1VAL_20_u1 255. _CNV_A_R_ECME_LINEA_0_CM 0. 255. FORMAT "%3.0" /end CHARACTERISTIC
/begin CHARACTERISTIC Cxx_sfty_vs_dsb_t "Low vehicle speed exit phase duration" VALUE 0xa0021f76 _REC_S1VAL_20_u1 10.2 _CNV_A_R_LINEAR_____153_CM 0. 10.2 FORMAT "%4.2" /end CHARACTERISTIC
/begin CHARACTERISTIC Cxx_sfty_vs_dsb_vs_thd "Vehicle speed threshold for safety monitoring" VALUE 0xa0021f77 _REC_S1VAL_20_u1 255. _CNV_A_R_LINEAR_____212_CM 0. 255. FORMAT "%3.0" /end CHARACTERISTIC
/begin MEASUREMENT ctr_err_ecc "ECC Error counter" UBYTE _CNV_A_R_ECME_LINEA_0_CM 1 0. 0. 255. ECU_ADDRESS 0xd0004faf FORMAT "%3.0" /end MEASUREMENT
/begin MEASUREMENT ctr_err_nvmy "NVMY error counter" UBYTE _CNV_A_R_ECME_LINEA_0_CM 1 0. 0. 255. ECU_ADDRESS 0xd0004fb0 FORMAT "%3.0" /end MEASUREMENT
/begin MEASUREMENT ctr_err_nvmy_dec "NVMY error counter decrement" UBYTE _CNV_A_R_ECME_LINEA_0_CM 1 0. 0. 255. ECU_ADDRESS 0xd0004fb1 FORMAT "%3.0" /end MEASUREMENT
/begin MEASUREMENT ctr_err_ram "RAM error counter" UBYTE _CNV_A_R_ECME_LINEA_0_CM 1 0. 0. 255. ECU_ADDRESS 0xd0004fb2 FORMAT "%3.0" /end MEASUREMENT
/begin MEASUREMENT ctr_err_rom "ROM error counter" UBYTE _CNV_A_R_ECME_LINEA_0_CM 1 0. 0. 255. ECU_ADDRESS 0xd0004fb3 FORMAT "%3.0" /end MEASUREMENT
/begin MEASUREMENT ctr_err_spi "SPI error counter" UBYTE _CNV_A_R_ECME_LINEA_0_CM 1 0. 0. 255. ECU_ADDRESS 0xd0004fb4 FORMAT "%3.0" /end MEASUREMENT
/begin MEASUREMENT ctr_err_ver "VER Error counter" UBYTE _CNV_A_R_ECME_LINEA_0_CM 1 0. 0. 255. ECU_ADDRESS 0xd0004fb5 FORMAT "%3.0" /end MEASUREMENT
/begin MEASUREMENT ctr_rst "Reset counter (WARM, COLD, WTD)" UWORD _CNV_A_R_ECME_LINEA_0_CM 1 0. 0. 65535. ECU_ADDRESS 0xd00031b0 FORMAT "%5.0" /end MEASUREMENT
/begin MEASUREMENT ctr_rst_cold "Cold Reset counter (COLD)" UWORD _CNV_A_R_ECME_LINEA_0_CM 1 0. 0. 65535. ECU_ADDRESS 0xd00031b2 FORMAT "%5.0" /end MEASUREMENT
/begin MEASUREMENT ctr_rst_warm "Warm Reset counter (WARM)" UWORD _CNV_A_R_ECME_LINEA_0_CM 1 0. 0. 65535. ECU_ADDRESS 0xd00031b4 FORMAT "%5.0" /end MEASUREMENT
/begin MEASUREMENT ctr_rst_wtd "Watchdog Reset counter (WTD)" UWORD _CNV_A_R_ECME_LINEA_0_CM 1 0. 0. 65535. ECU_ADDRESS 0xd00031b6 FORMAT "%5.0" /end MEASUREMENT
/begin MEASUREMENT err_sym_ecu_1 "symptoms of the diagnosis instance ECU 1 (level 1) not leading to the ECU dismantlings" UBYTE _CNV_A_R_ECME_LINEA_0_CM 1 0. 0. 255. ECU_ADDRESS 0xd0004fb6 FORMAT "%3.0" /end MEASUREMENT
/begin MEASUREMENT err_sym_ecu_2 "symptoms of the diagnosis instance ECU 2 (level 2) not leading to the ECU dismantlings" UWORD _CNV_A_R_ECME_LINEA_0_CM 1 0. 0. 65535. ECU_ADDRESS 0xd00031b8 FORMAT "%5.0" /end MEASUREMENT
/begin MEASUREMENT err_sym_nvmy "symptoms of the diagnosis instance NVMY (here a FLASH EEPROM emulation)" UBYTE _CNV_S_6_RANGE_ERR__471_CM 1 0. 0. 15. ECU_ADDRESS 0xd0004fb7 /end MEASUREMENT
/begin MEASUREMENT err_sym_ram "symptoms of the diagnosis instance RAM" UBYTE _CNV_S_6_RANGE_ERR__471_CM 1 0. 0. 15. ECU_ADDRESS 0xd0004fb8 /end MEASUREMENT
/begin MEASUREMENT err_sym_rom "symptoms of the diagnosis instance ROM" UBYTE _CNV_S_6_RANGE_ERR__471_CM 1 0. 0. 15. ECU_ADDRESS 0xd0004fb9 /end MEASUREMENT
/begin MEASUREMENT err_sym_spi "symptoms of the diagnosis instance SPI resulting from the detailed SPI_xxx symptoms" UBYTE _CNV_S_6_RANGE_ERR__471_CM 1 0. 0. 15. ECU_ADDRESS 0xd0004fba /end MEASUREMENT
/begin MEASUREMENT err_sym_spi_mps "symptoms of the diagnosis instance SPI_MPS" UBYTE _CNV_S_6_RANGE_ERR__471_CM 1 0. 0. 15. ECU_ADDRESS 0xd0004fbb /end MEASUREMENT
/begin MEASUREMENT err_sym_spi_qps "symptoms of the diagnosis instance SPI_QPS" UBYTE _CNV_S_6_RANGE_ERR__471_CM 1 0. 0. 15. ECU_ADDRESS 0xd0004fbc /end MEASUREMENT
/begin MEASUREMENT fls_reg "Flash Status Register" ULONG _CNV_A_R_ECME_LINEA_0_CM 1 0. 0. 4294967295. ECU_ADDRESS 0xd0001e88 FORMAT "%10.0" /end MEASUREMENT
/begin MEASUREMENT lv_cdn_diag_ecu "diagnosis condition for diagnosis instance ECU 1 and 2" UBYTE _CNV_S_2_RANGE______3_CM 1 0. 0. 1. ECU_ADDRESS 0xd00042ee BIT_MASK 0x1 /end MEASUREMENT
/begin MEASUREMENT lv_cdn_diag_nvmy "diagnosis condition for diagnosis instance NVMY (here a FLASH EEPROM emulation)" UBYTE _CNV_S_2_RANGE______3_CM 1 0. 0. 1. ECU_ADDRESS 0xd00042ef BIT_MASK 0x1 /end MEASUREMENT
/begin MEASUREMENT lv_cdn_diag_ram "diagnosis condition for diagnosis instance RAM" UBYTE _CNV_S_2_RANGE______3_CM 1 0. 0. 1. ECU_ADDRESS 0xd00042f0 BIT_MASK 0x1 /end MEASUREMENT
/begin MEASUREMENT lv_cdn_diag_rom "diagnosis condition for diagnosis instance ROM" UBYTE _CNV_S_2_RANGE______3_CM 1 0. 0. 1. ECU_ADDRESS 0xd00042f1 BIT_MASK 0x1 /end MEASUREMENT
/begin MEASUREMENT lv_cdn_diag_spi_mps "diagnosis condition for diagnosis instance SPI_MPS" UBYTE _CNV_S_2_RANGE______3_CM 1 0. 0. 1. ECU_ADDRESS 0xd00042f2 BIT_MASK 0x1 /end MEASUREMENT
/begin MEASUREMENT lv_cdn_diag_spi_qps "diagnosis condition for diagnosis instance SPI_QPS" UBYTE _CNV_S_2_RANGE______3_CM 1 0. 0. 1. ECU_ADDRESS 0xd00042f3 BIT_MASK 0x1 /end MEASUREMENT
/begin MEASUREMENT lv_end_diag_rom "ROM diagnosis performed" UBYTE _CNV_S_2_RANGE______3_CM 1 0. 0. 1. ECU_ADDRESS 0xd00042f4 BIT_MASK 0x1 /end MEASUREMENT
/begin MEASUREMENT lv_err_ecu_1 "error flag to indicate a level 1- ECU failure" UBYTE _CNV_S_2_RANGE______3_CM 1 0. 0. 1. ECU_ADDRESS 0xd00042f5 BIT_MASK 0x1 /end MEASUREMENT
/begin MEASUREMENT lv_err_ecu_2 "error flag to indicate a level 2- ECU failure" UBYTE _CNV_S_2_RANGE______3_CM 1 0. 0. 1. ECU_ADDRESS 0xd00042f6 BIT_MASK 0x1 /end MEASUREMENT
/begin MEASUREMENT lv_err_nvmy "Error flag for NVMY diagnosis" UBYTE _CNV_S_2_RANGE______3_CM 1 0. 0. 1. ECU_ADDRESS 0xd00042f7 BIT_MASK 0x1 /end MEASUREMENT
/begin MEASUREMENT lv_err_ram "Error flag for RAM diagnosis" UBYTE _CNV_S_2_RANGE______3_CM 1 0. 0. 1. ECU_ADDRESS 0xd00042f8 BIT_MASK 0x1 /end MEASUREMENT
/begin MEASUREMENT lv_err_rom "Error flag for ROM diagnosis" UBYTE _CNV_S_2_RANGE______3_CM 1 0. 0. 1. ECU_ADDRESS 0xd00042f9 BIT_MASK 0x1 /end MEASUREMENT
/begin MEASUREMENT lv_err_spi "Error flag for SPI_xxx diagnosis" UBYTE _CNV_S_2_RANGE______3_CM 1 0. 0. 1. ECU_ADDRESS 0xd00042fa BIT_MASK 0x1 /end MEASUREMENT
/begin MEASUREMENT lv_nvmy_init_old "Flag indicating that the NVMY did not retreive the last saved data" UBYTE _CNV_S_2_RANGE______3_CM 1 0. 0. 1. ECU_ADDRESS 0xd0004804 BIT_MASK 0x1 /end MEASUREMENT
/begin MEASUREMENT rst_type "Reset type: WARM, COLD, WTD" UBYTE _CNV_S_4_RANGE______472_CM 1 0. 0. 3. ECU_ADDRESS 0xd0004fbd /end MEASUREMENT
/begin CHARACTERISTIC c_ctr_err_nvmy_max "Calibration of the maximum number of NVMY error allowed" VALUE 0xa0021d66 _REC_S1VAL_20_u1 255. _CNV_A_R_ECME_LINEA_0_CM 0. 255. FORMAT "%3.0" /end CHARACTERISTIC
/begin CHARACTERISTIC c_ctr_err_ram_max "Calibration of the maximum number of RAM error allowed" VALUE 0xa0021d67 _REC_S1VAL_20_u1 255. _CNV_A_R_ECME_LINEA_0_CM 0. 255. FORMAT "%3.0" /end CHARACTERISTIC
/begin CHARACTERISTIC c_ctr_err_rom_max "Calibration of the maximum number of ROM error allowed" VALUE 0xa0021d68 _REC_S1VAL_20_u1 255. _CNV_A_R_ECME_LINEA_0_CM 0. 255. FORMAT "%3.0" /end CHARACTERISTIC
/begin CHARACTERISTIC c_ctr_err_spi_max "Calibration of the maximum number of SPI error allowed" VALUE 0xa0021d64 _REC_S1VAL_20_u2 65535. _CNV_A_R_ECME_LINEA_0_CM 0. 65535. FORMAT "%5.0" /end CHARACTERISTIC
/begin CHARACTERISTIC lc_spi_mps_drv_avl "MPS Driver (ATIC39) available on the project" VALUE 0xa0021d69 _REC_S1VAL_20_u1 1. _CNV_S_2_RANGE______3_CM 0. 1. BIT_MASK 0x1 /end CHARACTERISTIC
/begin CHARACTERISTIC lc_spi_qps_drv_avl "QPS Driver (ATM36, 38) available on the project" VALUE 0xa0021d6a _REC_S1VAL_20_u1 1. _CNV_S_2_RANGE______3_CM 0. 1. BIT_MASK 0x1 /end CHARACTERISTIC
/begin MEASUREMENT lv_test_run_ign_0 "" UBYTE _CNV_S_2_RANGE______3_CM 1 0. 0. 1. DISPLAY_IDENTIFIER test_eol_ign_0.lv_test_run_x ECU_ADDRESS 0xd0004b69 BIT_MASK 0x8 /end MEASUREMENT
/begin MEASUREMENT lv_test_out_ign_0 "" UBYTE _CNV_S_2_RANGE______3_CM 1 0. 0. 1. DISPLAY_IDENTIFIER test_eol_ign_0.lv_test_out_x ECU_ADDRESS 0xd0004b69 BIT_MASK 0x4 /end MEASUREMENT
/begin MEASUREMENT test_eol_ign_0.lv_test_out_cus_x "" UBYTE _CNV_S_2_RANGE______3_CM 1 0. 0. 1. ECU_ADDRESS 0xd0004b69 BIT_MASK 0x2 /end MEASUREMENT
/begin MEASUREMENT lv_test_req_ign_0 "" UBYTE _CNV_S_2_RANGE______3_CM 1 0. 0. 1. DISPLAY_IDENTIFIER test_eol_ign_0.lv_test_req_x ECU_ADDRESS 0xd0004b69 BIT_MASK 0x1 /end MEASUREMENT
/begin MEASUREMENT test_eol_ign_0.lv_adj_out_x "" UBYTE _CNV_S_2_RANGE______3_CM 1 0. 0. 1. ECU_ADDRESS 0xd0004b69 BIT_MASK 0x10 /end MEASUREMENT
/begin MEASUREMENT test_eol_ign_0.lv_adj_dec_x "" UBYTE _CNV_S_2_RANGE______3_CM 1 0. 0. 1. ECU_ADDRESS 0xd0004b69 BIT_MASK 0x20 /end MEASUREMENT
/begin MEASUREMENT test_eol_ign_0.lv_adj_inc_x "" UBYTE _CNV_S_2_RANGE______3_CM 1 0. 0. 1. ECU_ADDRESS 0xd0004b69 BIT_MASK 0x40 /end MEASUREMENT
/begin MEASUREMENT test_eol_ign_0.lv_adj_save_x "" UBYTE _CNV_S_2_RANGE______3_CM 1 0. 0. 1. ECU_ADDRESS 0xd0004b69 BIT_MASK 0x80 /end MEASUREMENT
/begin MEASUREMENT lv_test_run_ign_1 "" UBYTE _CNV_S_2_RANGE______3_CM 1 0. 0. 1. DISPLAY_IDENTIFIER test_eol_ign_1.lv_test_run_x ECU_ADDRESS 0xd0004b6a BIT_MASK 0x8 /end MEASUREMENT
/begin MEASUREMENT lv_test_out_ign_1 "" UBYTE _CNV_S_2_RANGE______3_CM 1 0. 0. 1. DISPLAY_IDENTIFIER test_eol_ign_1.lv_test_out_x ECU_ADDRESS 0xd0004b6a BIT_MASK 0x4 /end MEASUREMENT
/begin MEASUREMENT test_eol_ign_1.lv_test_out_cus_x "" UBYTE _CNV_S_2_RANGE______3_CM 1 0. 0. 1. ECU_ADDRESS 0xd0004b6a BIT_MASK 0x2 /end MEASUREMENT
/begin MEASUREMENT lv_test_req_ign_1 "" UBYTE _CNV_S_2_RANGE______3_CM 1 0. 0. 1. DISPLAY_IDENTIFIER test_eol_ign_1.lv_test_req_x ECU_ADDRESS 0xd0004b6a BIT_MASK 0x1 /end MEASUREMENT
/begin MEASUREMENT test_eol_ign_1.lv_adj_out_x "" UBYTE _CNV_S_2_RANGE______3_CM 1 0. 0. 1. ECU_ADDRESS 0xd0004b6a BIT_MASK 0x10 /end MEASUREMENT
/begin MEASUREMENT test_eol_ign_1.lv_adj_dec_x "" UBYTE _CNV_S_2_RANGE______3_CM 1 0. 0. 1. ECU_ADDRESS 0xd0004b6a BIT_MASK 0x20 /end MEASUREMENT
/begin MEASUREMENT test_eol_ign_1.lv_adj_inc_x "" UBYTE _CNV_S_2_RANGE______3_CM 1 0. 0. 1. ECU_ADDRESS 0xd0004b6a BIT_MASK 0x40 /end MEASUREMENT
/begin MEASUREMENT test_eol_ign_1.lv_adj_save_x "" UBYTE _CNV_S_2_RANGE______3_CM 1 0. 0. 1. ECU_ADDRESS 0xd0004b6a BIT_MASK 0x80 /end MEASUREMENT
/begin MEASUREMENT lv_test_run_ign_2 "" UBYTE _CNV_S_2_RANGE______3_CM 1 0. 0. 1. DISPLAY_IDENTIFIER test_eol_ign_2.lv_test_run_x ECU_ADDRESS 0xd0004b6b BIT_MASK 0x8 /end MEASUREMENT
/begin MEASUREMENT lv_test_out_ign_2 "" UBYTE _CNV_S_2_RANGE______3_CM 1 0. 0. 1. DISPLAY_IDENTIFIER test_eol_ign_2.lv_test_out_x ECU_ADDRESS 0xd0004b6b BIT_MASK 0x4 /end MEASUREMENT
/begin MEASUREMENT test_eol_ign_2.lv_test_out_cus_x "" UBYTE _CNV_S_2_RANGE______3_CM 1 0. 0. 1. ECU_ADDRESS 0xd0004b6b BIT_MASK 0x2 /end MEASUREMENT
/begin MEASUREMENT lv_test_req_ign_2 "" UBYTE _CNV_S_2_RANGE______3_CM 1 0. 0. 1. DISPLAY_IDENTIFIER test_eol_ign_2.lv_test_req_x ECU_ADDRESS 0xd0004b6b BIT_MASK 0x1 /end MEASUREMENT
/begin MEASUREMENT test_eol_ign_2.lv_adj_out_x "" UBYTE _CNV_S_2_RANGE______3_CM 1 0. 0. 1. ECU_ADDRESS 0xd0004b6b BIT_MASK 0x10 /end MEASUREMENT
/begin MEASUREMENT test_eol_ign_2.lv_adj_dec_x "" UBYTE _CNV_S_2_RANGE______3_CM 1 0. 0. 1. ECU_ADDRESS 0xd0004b6b BIT_MASK 0x20 /end MEASUREMENT
/begin MEASUREMENT test_eol_ign_2.lv_adj_inc_x "" UBYTE _CNV_S_2_RANGE______3_CM 1 0. 0. 1. ECU_ADDRESS 0xd0004b6b BIT_MASK 0x40 /end MEASUREMENT
/begin MEASUREMENT test_eol_ign_2.lv_adj_save_x "" UBYTE _CNV_S_2_RANGE______3_CM 1 0. 0. 1. ECU_ADDRESS 0xd0004b6b BIT_MASK 0x80 /end MEASUREMENT
/begin MEASUREMENT lv_test_run_ign_3 "" UBYTE _CNV_S_2_RANGE______3_CM 1 0. 0. 1. DISPLAY_IDENTIFIER test_eol_ign_3.lv_test_run_x ECU_ADDRESS 0xd0004b6c BIT_MASK 0x8 /end MEASUREMENT
/begin MEASUREMENT lv_test_out_ign_3 "" UBYTE _CNV_S_2_RANGE______3_CM 1 0. 0. 1. DISPLAY_IDENTIFIER test_eol_ign_3.lv_test_out_x ECU_ADDRESS 0xd0004b6c BIT_MASK 0x4 /end MEASUREMENT
/begin MEASUREMENT test_eol_ign_3.lv_test_out_cus_x "" UBYTE _CNV_S_2_RANGE______3_CM 1 0. 0. 1. ECU_ADDRESS 0xd0004b6c BIT_MASK 0x2 /end MEASUREMENT
/begin MEASUREMENT lv_test_req_ign_3 "" UBYTE _CNV_S_2_RANGE______3_CM 1 0. 0. 1. DISPLAY_IDENTIFIER test_eol_ign_3.lv_test_req_x ECU_ADDRESS 0xd0004b6c BIT_MASK 0x1 /end MEASUREMENT
/begin MEASUREMENT test_eol_ign_3.lv_adj_out_x "" UBYTE _CNV_S_2_RANGE______3_CM 1 0. 0. 1. ECU_ADDRESS 0xd0004b6c BIT_MASK 0x10 /end MEASUREMENT
/begin MEASUREMENT test_eol_ign_3.lv_adj_dec_x "" UBYTE _CNV_S_2_RANGE______3_CM 1 0. 0. 1. ECU_ADDRESS 0xd0004b6c BIT_MASK 0x20 /end MEASUREMENT
/begin MEASUREMENT test_eol_ign_3.lv_adj_inc_x "" UBYTE _CNV_S_2_RANGE______3_CM 1 0. 0. 1. ECU_ADDRESS 0xd0004b6c BIT_MASK 0x40 /end MEASUREMENT
/begin MEASUREMENT test_eol_ign_3.lv_adj_save_x "" UBYTE _CNV_S_2_RANGE______3_CM 1 0. 0. 1. ECU_ADDRESS 0xd0004b6c BIT_MASK 0x80 /end MEASUREMENT
/begin MEASUREMENT lv_test_run_inj_0 "" UBYTE _CNV_S_2_RANGE______3_CM 1 0. 0. 1. DISPLAY_IDENTIFIER test_eol_inj_0.lv_test_run_x ECU_ADDRESS 0xd0004b65 BIT_MASK 0x8 /end MEASUREMENT
/begin MEASUREMENT lv_test_out_inj_0 "" UBYTE _CNV_S_2_RANGE______3_CM 1 0. 0. 1. DISPLAY_IDENTIFIER test_eol_inj_0.lv_test_out_x ECU_ADDRESS 0xd0004b65 BIT_MASK 0x4 /end MEASUREMENT
/begin MEASUREMENT test_eol_inj_0.lv_test_out_cus_x "" UBYTE _CNV_S_2_RANGE______3_CM 1 0. 0. 1. ECU_ADDRESS 0xd0004b65 BIT_MASK 0x2 /end MEASUREMENT
/begin MEASUREMENT lv_test_req_inj_0 "" UBYTE _CNV_S_2_RANGE______3_CM 1 0. 0. 1. DISPLAY_IDENTIFIER test_eol_inj_0.lv_test_req_x ECU_ADDRESS 0xd0004b65 BIT_MASK 0x1 /end MEASUREMENT
/begin MEASUREMENT test_eol_inj_0.lv_adj_out_x "" UBYTE _CNV_S_2_RANGE______3_CM 1 0. 0. 1. ECU_ADDRESS 0xd0004b65 BIT_MASK 0x10 /end MEASUREMENT
/begin MEASUREMENT test_eol_inj_0.lv_adj_dec_x "" UBYTE _CNV_S_2_RANGE______3_CM 1 0. 0. 1. ECU_ADDRESS 0xd0004b65 BIT_MASK 0x20 /end MEASUREMENT
/begin MEASUREMENT test_eol_inj_0.lv_adj_inc_x "" UBYTE _CNV_S_2_RANGE______3_CM 1 0. 0. 1. ECU_ADDRESS 0xd0004b65 BIT_MASK 0x40 /end MEASUREMENT
/begin MEASUREMENT test_eol_inj_0.lv_adj_save_x "" UBYTE _CNV_S_2_RANGE______3_CM 1 0. 0. 1. ECU_ADDRESS 0xd0004b65 BIT_MASK 0x80 /end MEASUREMENT
/begin MEASUREMENT lv_test_run_inj_1 "" UBYTE _CNV_S_2_RANGE______3_CM 1 0. 0. 1. DISPLAY_IDENTIFIER test_eol_inj_1.lv_test_run_x ECU_ADDRESS 0xd0004b66 BIT_MASK 0x8 /end MEASUREMENT
/begin MEASUREMENT lv_test_out_inj_1 "" UBYTE _CNV_S_2_RANGE______3_CM 1 0. 0. 1. DISPLAY_IDENTIFIER test_eol_inj_1.lv_test_out_x ECU_ADDRESS 0xd0004b66 BIT_MASK 0x4 /end MEASUREMENT
/begin MEASUREMENT test_eol_inj_1.lv_test_out_cus_x "" UBYTE _CNV_S_2_RANGE______3_CM 1 0. 0. 1. ECU_ADDRESS 0xd0004b66 BIT_MASK 0x2 /end MEASUREMENT
/begin MEASUREMENT lv_test_req_inj_1 "" UBYTE _CNV_S_2_RANGE______3_CM 1 0. 0. 1. DISPLAY_IDENTIFIER test_eol_inj_1.lv_test_req_x ECU_ADDRESS 0xd0004b66 BIT_MASK 0x1 /end MEASUREMENT
/begin MEASUREMENT test_eol_inj_1.lv_adj_out_x "" UBYTE _CNV_S_2_RANGE______3_CM 1 0. 0. 1. ECU_ADDRESS 0xd0004b66 BIT_MASK 0x10 /end MEASUREMENT
/begin MEASUREMENT test_eol_inj_1.lv_adj_dec_x "" UBYTE _CNV_S_2_RANGE______3_CM 1 0. 0. 1. ECU_ADDRESS 0xd0004b66 BIT_MASK 0x20 /end MEASUREMENT
/begin MEASUREMENT test_eol_inj_1.lv_adj_inc_x "" UBYTE _CNV_S_2_RANGE______3_CM 1 0. 0. 1. ECU_ADDRESS 0xd0004b66 BIT_MASK 0x40 /end MEASUREMENT
/begin MEASUREMENT test_eol_inj_1.lv_adj_save_x "" UBYTE _CNV_S_2_RANGE______3_CM 1 0. 0. 1. ECU_ADDRESS 0xd0004b66 BIT_MASK 0x80 /end MEASUREMENT
/begin MEASUREMENT lv_test_run_inj_2 "" UBYTE _CNV_S_2_RANGE______3_CM 1 0. 0. 1. DISPLAY_IDENTIFIER test_eol_inj_2.lv_test_run_x ECU_ADDRESS 0xd0004b67 BIT_MASK 0x8 /end MEASUREMENT
/begin MEASUREMENT lv_test_out_inj_2 "" UBYTE _CNV_S_2_RANGE______3_CM 1 0. 0. 1. DISPLAY_IDENTIFIER test_eol_inj_2.lv_test_out_x ECU_ADDRESS 0xd0004b67 BIT_MASK 0x4 /end MEASUREMENT
/begin MEASUREMENT test_eol_inj_2.lv_test_out_cus_x "" UBYTE _CNV_S_2_RANGE______3_CM 1 0. 0. 1. ECU_ADDRESS 0xd0004b67 BIT_MASK 0x2 /end MEASUREMENT
/begin MEASUREMENT lv_test_req_inj_2 "" UBYTE _CNV_S_2_RANGE______3_CM 1 0. 0. 1. DISPLAY_IDENTIFIER test_eol_inj_2.lv_test_req_x ECU_ADDRESS 0xd0004b67 BIT_MASK 0x1 /end MEASUREMENT
/begin MEASUREMENT test_eol_inj_2.lv_adj_out_x "" UBYTE _CNV_S_2_RANGE______3_CM 1 0. 0. 1. ECU_ADDRESS 0xd0004b67 BIT_MASK 0x10 /end MEASUREMENT
/begin MEASUREMENT test_eol_inj_2.lv_adj_dec_x "" UBYTE _CNV_S_2_RANGE______3_CM 1 0. 0. 1. ECU_ADDRESS 0xd0004b67 BIT_MASK 0x20 /end MEASUREMENT
/begin MEASUREMENT test_eol_inj_2.lv_adj_inc_x "" UBYTE _CNV_S_2_RANGE______3_CM 1 0. 0. 1. ECU_ADDRESS 0xd0004b67 BIT_MASK 0x40 /end MEASUREMENT
/begin MEASUREMENT test_eol_inj_2.lv_adj_save_x "" UBYTE _CNV_S_2_RANGE______3_CM 1 0. 0. 1. ECU_ADDRESS 0xd0004b67 BIT_MASK 0x80 /end MEASUREMENT
/begin MEASUREMENT lv_test_run_inj_3 "" UBYTE _CNV_S_2_RANGE______3_CM 1 0. 0. 1. DISPLAY_IDENTIFIER test_eol_inj_3.lv_test_run_x ECU_ADDRESS 0xd0004b68 BIT_MASK 0x8 /end MEASUREMENT
/begin MEASUREMENT lv_test_out_inj_3 "" UBYTE _CNV_S_2_RANGE______3_CM 1 0. 0. 1. DISPLAY_IDENTIFIER test_eol_inj_3.lv_test_out_x ECU_ADDRESS 0xd0004b68 BIT_MASK 0x4 /end MEASUREMENT
/begin MEASUREMENT test_eol_inj_3.lv_test_out_cus_x "" UBYTE _CNV_S_2_RANGE______3_CM 1 0. 0. 1. ECU_ADDRESS 0xd0004b68 BIT_MASK 0x2 /end MEASUREMENT
/begin MEASUREMENT lv_test_req_inj_3 "" UBYTE _CNV_S_2_RANGE______3_CM 1 0. 0. 1. DISPLAY_IDENTIFIER test_eol_inj_3.lv_test_req_x ECU_ADDRESS 0xd0004b68 BIT_MASK 0x1 /end MEASUREMENT
/begin MEASUREMENT test_eol_inj_3.lv_adj_out_x "" UBYTE _CNV_S_2_RANGE______3_CM 1 0. 0. 1. ECU_ADDRESS 0xd0004b68 BIT_MASK 0x10 /end MEASUREMENT
/begin MEASUREMENT test_eol_inj_3.lv_adj_dec_x "" UBYTE _CNV_S_2_RANGE______3_CM 1 0. 0. 1. ECU_ADDRESS 0xd0004b68 BIT_MASK 0x20 /end MEASUREMENT
/begin MEASUREMENT test_eol_inj_3.lv_adj_inc_x "" UBYTE _CNV_S_2_RANGE______3_CM 1 0. 0. 1. ECU_ADDRESS 0xd0004b68 BIT_MASK 0x40 /end MEASUREMENT
/begin MEASUREMENT test_eol_inj_3.lv_adj_save_x "" UBYTE _CNV_S_2_RANGE______3_CM 1 0. 0. 1. ECU_ADDRESS 0xd0004b68 BIT_MASK 0x80 /end MEASUREMENT
/begin MEASUREMENT igc_x_ext_adj[0] "Boolean indicating Ignition Actuator tests request" UBYTE _CNV_S_2_RANGE______3_CM 1 0. 0. 1. ECU_ADDRESS 0xd0004b5e BIT_MASK 0x1 /end MEASUREMENT
/begin MEASUREMENT igc_x_ext_adj[1] "Boolean indicating Ignition Actuator tests request" UBYTE _CNV_S_2_RANGE______3_CM 1 0. 0. 1. ECU_ADDRESS 0xd0004b5f BIT_MASK 0x1 /end MEASUREMENT
/begin MEASUREMENT igc_x_ext_adj[2] "Boolean indicating Ignition Actuator tests request" UBYTE _CNV_S_2_RANGE______3_CM 1 0. 0. 1. ECU_ADDRESS 0xd0004b60 BIT_MASK 0x1 /end MEASUREMENT
/begin MEASUREMENT igc_x_ext_adj[3] "Boolean indicating Ignition Actuator tests request" UBYTE _CNV_S_2_RANGE______3_CM 1 0. 0. 1. ECU_ADDRESS 0xd0004b61 BIT_MASK 0x1 /end MEASUREMENT
/begin MEASUREMENT lv_cdn_test_eol_ena "booleean that indicates if conditions are set to activate EOL test" UBYTE _CNV_S_2_RANGE______3_CM 1 0. 0. 1. ECU_ADDRESS 0xd0004b75 /end MEASUREMENT
/begin MEASUREMENT lv_end_test_req "Exit request for parallel EOL test or unitary test of the actuator x" UBYTE _CNV_S_2_RANGE______3_CM 1 0. 0. 1. ECU_ADDRESS 0xd0004a85 /end MEASUREMENT
/begin MEASUREMENT lv_eol_act "Flag for end of line test active" UBYTE _CNV_S_2_RANGE______3_CM 1 0. 0. 1. ECU_ADDRESS 0xd0004a87 /end MEASUREMENT
/begin MEASUREMENT lv_igc_x_ext_adj[0] "Boolean indicating Ignition Actuator tests request" UBYTE _CNV_S_2_RANGE______3_CM 1 0. 0. 1. ECU_ADDRESS 0xd0004b5a BIT_MASK 0x1 /end MEASUREMENT
/begin MEASUREMENT lv_igc_x_ext_adj[1] "Boolean indicating Ignition Actuator tests request" UBYTE _CNV_S_2_RANGE______3_CM 1 0. 0. 1. ECU_ADDRESS 0xd0004b5b BIT_MASK 0x1 /end MEASUREMENT
/begin MEASUREMENT lv_igc_x_ext_adj[2] "Boolean indicating Ignition Actuator tests request" UBYTE _CNV_S_2_RANGE______3_CM 1 0. 0. 1. ECU_ADDRESS 0xd0004b5c BIT_MASK 0x1 /end MEASUREMENT
/begin MEASUREMENT lv_igc_x_ext_adj[3] "Boolean indicating Ignition Actuator tests request" UBYTE _CNV_S_2_RANGE______3_CM 1 0. 0. 1. ECU_ADDRESS 0xd0004b5d BIT_MASK 0x1 /end MEASUREMENT
/begin MEASUREMENT lv_stop_test_req "Abord request for parallel EOL test or unitary test of the actuator x" UBYTE _CNV_S_2_RANGE______3_CM 1 0. 0. 1. ECU_ADDRESS 0xd0004a86 /end MEASUREMENT
/begin MEASUREMENT lv_test_out_eol "Flag for parallel test at EOL" UBYTE _CNV_S_2_RANGE______3_CM 1 0. 0. 1. ECU_ADDRESS 0xd0004a84 /end MEASUREMENT
/begin MEASUREMENT lv_test_out_eol_end "End of the EOL test or end of the unitary test" UBYTE _CNV_S_2_RANGE______3_CM 1 0. 0. 1. ECU_ADDRESS 0xd0004b77 /end MEASUREMENT
/begin MEASUREMENT test_out_ign_0 "Required command of the IGNition coil 0 during a test sequence" UBYTE _CNV_S_2_RANGE______3_CM 1 0. 0. 1. ECU_ADDRESS 0xd0004b6d /end MEASUREMENT
/begin MEASUREMENT test_out_ign_1 "Required command of the IGNition coil 1 during a test sequence" UBYTE _CNV_S_2_RANGE______3_CM 1 0. 0. 1. ECU_ADDRESS 0xd0004b6e /end MEASUREMENT
/begin MEASUREMENT test_out_ign_2 "Required command of the IGNition coil 2 during a test sequence" UBYTE _CNV_S_2_RANGE______3_CM 1 0. 0. 1. ECU_ADDRESS 0xd0004b6f /end MEASUREMENT
/begin MEASUREMENT test_out_ign_3 "Required command of the IGNition coil 3 during a test sequence" UBYTE _CNV_S_2_RANGE______3_CM 1 0. 0. 1. ECU_ADDRESS 0xd0004b70 /end MEASUREMENT
/begin MEASUREMENT test_out_inj_0 "Required command of the INJector 0 during a test sequence" UBYTE _CNV_S_2_RANGE______3_CM 1 0. 0. 1. ECU_ADDRESS 0xd0004b71 /end MEASUREMENT
/begin MEASUREMENT test_out_inj_1 "Required command of the INJector 1 during a test sequence" UBYTE _CNV_S_2_RANGE______3_CM 1 0. 0. 1. ECU_ADDRESS 0xd0004b72 /end MEASUREMENT
/begin MEASUREMENT test_out_inj_2 "Required command of the INJector 2 during a test sequence" UBYTE _CNV_S_2_RANGE______3_CM 1 0. 0. 1. ECU_ADDRESS 0xd0004b73 /end MEASUREMENT
/begin MEASUREMENT test_out_inj_3 "Required command of the INJector 3 during a test sequencee" UBYTE _CNV_S_2_RANGE______3_CM 1 0. 0. 1. ECU_ADDRESS 0xd0004b74 /end MEASUREMENT
/begin CHARACTERISTIC c_t_ini_test_ign_0 "Time of the initial period of the test sequence of the IGNition coil 0" VALUE 0xa0021404 _REC_S1VAL_20_u2 655350. _CNV_A_R_LINEAR_____40_CM 0. 655350. FORMAT "%4.0" /end CHARACTERISTIC
/begin CHARACTERISTIC c_t_ini_test_ign_1 "Time of the initial period of the test sequence of the IGNition coil 1" VALUE 0xa0021406 _REC_S1VAL_20_u2 655350. _CNV_A_R_LINEAR_____40_CM 0. 655350. FORMAT "%4.0" /end CHARACTERISTIC
/begin CHARACTERISTIC c_t_ini_test_ign_2 "Time of the initial period of the test sequence of the IGNition coil 2" VALUE 0xa0021408 _REC_S1VAL_20_u2 655350. _CNV_A_R_LINEAR_____40_CM 0. 655350. FORMAT "%4.0" /end CHARACTERISTIC
/begin CHARACTERISTIC c_t_ini_test_ign_3 "Time of the initial period of the test sequence of the IGNition coil 3" VALUE 0xa002140a _REC_S1VAL_20_u2 655350. _CNV_A_R_LINEAR_____40_CM 0. 655350. FORMAT "%4.0" /end CHARACTERISTIC
/begin CHARACTERISTIC c_t_ini_test_inj_0 "Time of the initial period of the test sequence of the INJector 0" VALUE 0xa002140c _REC_S1VAL_20_u2 655350. _CNV_A_R_LINEAR_____40_CM 0. 655350. FORMAT "%4.0" /end CHARACTERISTIC
/begin CHARACTERISTIC c_t_ini_test_inj_1 "Time of the initial period of the test sequence of the INJector 1" VALUE 0xa002140e _REC_S1VAL_20_u2 655350. _CNV_A_R_LINEAR_____40_CM 0. 655350. FORMAT "%4.0" /end CHARACTERISTIC
/begin CHARACTERISTIC c_t_ini_test_inj_2 "Time of the initial period of the test sequence of the INJector 2" VALUE 0xa0021410 _REC_S1VAL_20_u2 655350. _CNV_A_R_LINEAR_____40_CM 0. 655350. FORMAT "%4.0" /end CHARACTERISTIC
/begin CHARACTERISTIC c_t_ini_test_inj_3 "Time of the initial period of the test sequence of the INJector 3" VALUE 0xa0021412 _REC_S1VAL_20_u2 655350. _CNV_A_R_LINEAR_____40_CM 0. 655350. FORMAT "%4.0" /end CHARACTERISTIC
/begin CHARACTERISTIC c_t_off_test_ign_0 "Time OFF for the test sequence of the IGNition coil 0" VALUE 0xa0021414 _REC_S1VAL_20_u2 655350. _CNV_A_R_LINEAR_____40_CM 0. 655350. FORMAT "%4.0" /end CHARACTERISTIC
/begin CHARACTERISTIC c_t_off_test_ign_1 "Time OFF for the test sequence of the IGNition coil 1" VALUE 0xa0021416 _REC_S1VAL_20_u2 655350. _CNV_A_R_LINEAR_____40_CM 0. 655350. FORMAT "%4.0" /end CHARACTERISTIC
/begin CHARACTERISTIC c_t_off_test_ign_2 "Time OFF for the test sequence of the IGNition coil 2" VALUE 0xa0021418 _REC_S1VAL_20_u2 655350. _CNV_A_R_LINEAR_____40_CM 0. 655350. FORMAT "%4.0" /end CHARACTERISTIC
/begin CHARACTERISTIC c_t_off_test_ign_3 "Time OFF for the test sequence of the IGNition coil 3" VALUE 0xa002141a _REC_S1VAL_20_u2 655350. _CNV_A_R_LINEAR_____40_CM 0. 655350. FORMAT "%4.0" /end CHARACTERISTIC
/begin CHARACTERISTIC c_t_off_test_inj_0 "Time OFF for the test sequence of the INJector 0" VALUE 0xa002141c _REC_S1VAL_20_u2 655350. _CNV_A_R_LINEAR_____40_CM 0. 655350. FORMAT "%4.0" /end CHARACTERISTIC
/begin CHARACTERISTIC c_t_off_test_inj_1 "Time OFF for the test sequence of the INJector 1" VALUE 0xa002141e _REC_S1VAL_20_u2 655350. _CNV_A_R_LINEAR_____40_CM 0. 655350. FORMAT "%4.0" /end CHARACTERISTIC
/begin CHARACTERISTIC c_t_off_test_inj_2 "Time OFF for the test sequence of the INJector 2" VALUE 0xa0021420 _REC_S1VAL_20_u2 655350. _CNV_A_R_LINEAR_____40_CM 0. 655350. FORMAT "%4.0" /end CHARACTERISTIC
/begin CHARACTERISTIC c_t_off_test_inj_3 "Time OFF for the test sequence of the INJector 3" VALUE 0xa0021422 _REC_S1VAL_20_u2 655350. _CNV_A_R_LINEAR_____40_CM 0. 655350. FORMAT "%4.0" /end CHARACTERISTIC
/begin CHARACTERISTIC c_t_on_test_ign_0 "Time ON for the test sequence of the IGNition coil 0" VALUE 0xa0021424 _REC_S1VAL_20_u2 655350. _CNV_A_R_LINEAR_____40_CM 0. 655350. FORMAT "%4.0" /end CHARACTERISTIC
/begin CHARACTERISTIC c_t_on_test_ign_1 "Time ON for the test sequence of the IGNition coil 1" VALUE 0xa0021426 _REC_S1VAL_20_u2 655350. _CNV_A_R_LINEAR_____40_CM 0. 655350. FORMAT "%4.0" /end CHARACTERISTIC
/begin CHARACTERISTIC c_t_on_test_ign_2 "Time ON for the test sequence of the IGNition coil 2" VALUE 0xa0021428 _REC_S1VAL_20_u2 655350. _CNV_A_R_LINEAR_____40_CM 0. 655350. FORMAT "%4.0" /end CHARACTERISTIC
/begin CHARACTERISTIC c_t_on_test_ign_3 "Time ON for the test sequence of the IGNition coil 3" VALUE 0xa002142a _REC_S1VAL_20_u2 655350. _CNV_A_R_LINEAR_____40_CM 0. 655350. FORMAT "%4.0" /end CHARACTERISTIC
/begin CHARACTERISTIC c_t_on_test_inj_0 "Time ON for the test sequence of the INJector 0" VALUE 0xa002142c _REC_S1VAL_20_u2 655350. _CNV_A_R_LINEAR_____40_CM 0. 655350. FORMAT "%4.0" /end CHARACTERISTIC
/begin CHARACTERISTIC c_t_on_test_inj_1 "Time ON for the test sequence of the INJector 1" VALUE 0xa002142e _REC_S1VAL_20_u2 655350. _CNV_A_R_LINEAR_____40_CM 0. 655350. FORMAT "%4.0" /end CHARACTERISTIC
/begin CHARACTERISTIC c_t_on_test_inj_2 "Time ON for the test sequence of the INJector 2" VALUE 0xa0021430 _REC_S1VAL_20_u2 655350. _CNV_A_R_LINEAR_____40_CM 0. 655350. FORMAT "%4.0" /end CHARACTERISTIC
/begin CHARACTERISTIC c_t_on_test_inj_3 "Time ON for the test sequence of the INJector 3" VALUE 0xa0021432 _REC_S1VAL_20_u2 655350. _CNV_A_R_LINEAR_____40_CM 0. 655350. FORMAT "%4.0" /end CHARACTERISTIC
/begin CHARACTERISTIC c_test_out_cyc_ign_0 "Number of test cycle for the IGNition coil 0" VALUE 0xa0021434 _REC_S1VAL_20_u1 255. _CNV_A_R_ECME_LINEA_0_CM 0. 255. FORMAT "%3.0" /end CHARACTERISTIC
/begin CHARACTERISTIC c_test_out_cyc_ign_1 "Number of test cycle for the IGNition coil 1" VALUE 0xa0021435 _REC_S1VAL_20_u1 255. _CNV_A_R_ECME_LINEA_0_CM 0. 255. FORMAT "%3.0" /end CHARACTERISTIC
/begin CHARACTERISTIC c_test_out_cyc_ign_2 "Number of test cycle for the IGNition coil 2" VALUE 0xa0021436 _REC_S1VAL_20_u1 255. _CNV_A_R_ECME_LINEA_0_CM 0. 255. FORMAT "%3.0" /end CHARACTERISTIC
/begin CHARACTERISTIC c_test_out_cyc_ign_3 "Number of test cycle for the IGNition coil 3" VALUE 0xa0021437 _REC_S1VAL_20_u1 255. _CNV_A_R_ECME_LINEA_0_CM 0. 255. FORMAT "%3.0" /end CHARACTERISTIC
/begin CHARACTERISTIC c_test_out_cyc_inj_0 "Number of test cycle for the INJector 0" VALUE 0xa0021438 _REC_S1VAL_20_u1 255. _CNV_A_R_ECME_LINEA_0_CM 0. 255. FORMAT "%3.0" /end CHARACTERISTIC
/begin CHARACTERISTIC c_test_out_cyc_inj_1 "Number of test cycle for the INJector 1" VALUE 0xa0021439 _REC_S1VAL_20_u1 255. _CNV_A_R_ECME_LINEA_0_CM 0. 255. FORMAT "%3.0" /end CHARACTERISTIC
/begin CHARACTERISTIC c_test_out_cyc_inj_2 "Number of test cycle for the INJector 2" VALUE 0xa002143a _REC_S1VAL_20_u1 255. _CNV_A_R_ECME_LINEA_0_CM 0. 255. FORMAT "%3.0" /end CHARACTERISTIC
/begin CHARACTERISTIC c_test_out_cyc_inj_3 "Number of test cycle for the INJector 3" VALUE 0xa002143b _REC_S1VAL_20_u1 255. _CNV_A_R_ECME_LINEA_0_CM 0. 255. FORMAT "%3.0" /end CHARACTERISTIC
/begin CHARACTERISTIC c_vs_eol_diag_max "Maximum VS to authorize self test" VALUE 0xa002143c _REC_S1VAL_20_u1 255. _CNV_A_R_LINEAR_____212_CM 0. 255. FORMAT "%3.0" /end CHARACTERISTIC
/begin CHARACTERISTIC lc_test_out_eol_ign_0 "Authorisation of the EOL test for the IGNition coil 0" VALUE 0xa002143d _REC_S1VAL_20_u1 1. _CNV_A_R_ECME_LINEA_0_CM 0. 1. FORMAT "%1.0" /end CHARACTERISTIC
/begin CHARACTERISTIC lc_test_out_eol_ign_1 "Authorisation of the EOL test for the IGNition coil 1" VALUE 0xa002143e _REC_S1VAL_20_u1 1. _CNV_A_R_ECME_LINEA_0_CM 0. 1. FORMAT "%1.0" /end CHARACTERISTIC
/begin CHARACTERISTIC lc_test_out_eol_ign_2 "Authorisation of the EOL test for the IGNition coil 2" VALUE 0xa002143f _REC_S1VAL_20_u1 1. _CNV_A_R_ECME_LINEA_0_CM 0. 1. FORMAT "%1.0" /end CHARACTERISTIC
/begin CHARACTERISTIC lc_test_out_eol_ign_3 "Authorisation of the EOL test for the IGNition coil 3" VALUE 0xa0021440 _REC_S1VAL_20_u1 1. _CNV_A_R_ECME_LINEA_0_CM 0. 1. FORMAT "%1.0" /end CHARACTERISTIC
/begin CHARACTERISTIC lc_test_out_eol_inj_0 "Authorisation of the EOL test for the INJector 0" VALUE 0xa0021441 _REC_S1VAL_20_u1 1. _CNV_A_R_ECME_LINEA_0_CM 0. 1. FORMAT "%1.0" /end CHARACTERISTIC
/begin CHARACTERISTIC lc_test_out_eol_inj_1 "Authorisation of the EOL test for the INJector 1" VALUE 0xa0021442 _REC_S1VAL_20_u1 1. _CNV_A_R_ECME_LINEA_0_CM 0. 1. FORMAT "%1.0" /end CHARACTERISTIC
/begin CHARACTERISTIC lc_test_out_eol_inj_2 "Authorisation of the EOL test for the INJector 2" VALUE 0xa0021443 _REC_S1VAL_20_u1 1. _CNV_A_R_ECME_LINEA_0_CM 0. 1. FORMAT "%1.0" /end CHARACTERISTIC
/begin CHARACTERISTIC lc_test_out_eol_inj_3 "Authorisation of the EOL test for the INJector 3" VALUE 0xa0021444 _REC_S1VAL_20_u1 1. _CNV_A_R_ECME_LINEA_0_CM 0. 1. FORMAT "%1.0" /end CHARACTERISTIC
/begin MEASUREMENT Vbx_df_ecm_err_itl "ECM performance internal error detected failure" UBYTE _CNV_S_2_RANGE______3_CM 1 0. 0. 1. ECU_ADDRESS 0xd00056c9 BIT_MASK 0x1 /end MEASUREMENT
/begin MEASUREMENT Vbx_df_inj_ecu_itl "Main CPU internal error detected failure" UBYTE _CNV_S_2_RANGE______3_CM 1 0. 0. 1. ECU_ADDRESS 0xd00056ca BIT_MASK 0x1 /end MEASUREMENT
/begin MEASUREMENT Vbx_diag_ena_ecm_err_itl "ECM performance internal error diagnosis authorization" UBYTE _CNV_S_2_RANGE______3_CM 1 0. 0. 1. ECU_ADDRESS 0xd00056cb BIT_MASK 0x1 /end MEASUREMENT
/begin MEASUREMENT Vbx_diag_ena_inj_ecu_itl "Main CPU internal error diagnosis authorization" UBYTE _CNV_S_2_RANGE______3_CM 1 0. 0. 1. ECU_ADDRESS 0xd00056cc BIT_MASK 0x1 /end MEASUREMENT
/begin MEASUREMENT Vsx_inj_ecu_vld "Engine control ECU validity status" UBYTE _CNV_S_8_STATUS_OK__181_CM 1 0. 0. 7. ECU_ADDRESS 0xd000533a /end MEASUREMENT
/begin MEASUREMENT Vsx_inj_ecu_vld_1 "Engine control ECU validity status" UBYTE _CNV_S_8_STATUS_OK__181_CM 1 0. 0. 7. ECU_ADDRESS 0xd000533b /end MEASUREMENT
/begin MEASUREMENT Vsx_inj_ecu_vld_init "Engine control ECU validity status" UBYTE _CNV_S_8_STATUS_OK__181_CM 1 0. 0. 7. ECU_ADDRESS 0xd000533c /end MEASUREMENT
/begin CHARACTERISTIC Cxx_dfdec_ecm_err_itl "ECM performance internal error detected failure counter decrement" VALUE 0xa0021df4 _REC_S1VAL_20_u2 65535. _CNV_A_R_ECME_LINEA_0_CM 0. 65535. FORMAT "%5.0" /end CHARACTERISTIC
/begin CHARACTERISTIC Cxx_dfdec_inj_ecu_itl "Main CPU internal error detected failure counter decrement" VALUE 0xa0021df6 _REC_S1VAL_20_u2 65535. _CNV_A_R_ECME_LINEA_0_CM 0. 65535. FORMAT "%5.0" /end CHARACTERISTIC
/begin CHARACTERISTIC Cxx_dfinc_ecm_err_itl "ECM performance internal error detected failure counter increment" VALUE 0xa0021df8 _REC_S1VAL_20_u2 65535. _CNV_A_R_ECME_LINEA_0_CM 0. 65535. FORMAT "%5.0" /end CHARACTERISTIC
/begin CHARACTERISTIC Cxx_dfinc_inj_ecu_itl "Main CPU internal error detected failure counter increment" VALUE 0xa0021dfa _REC_S1VAL_20_u2 65535. _CNV_A_R_ECME_LINEA_0_CM 0. 65535. FORMAT "%5.0" /end CHARACTERISTIC
/begin MEASUREMENT Vbx_df_ecm_adc_tron "Engine Control Module Analogic / Numeric Convertor failure detected failure" UBYTE _CNV_S_2_RANGE______3_CM 1 0. 0. 1. ECU_ADDRESS 0xd0005640 BIT_MASK 0x1 /end MEASUREMENT
/begin MEASUREMENT Vbx_df_ecm_mon_secu_1 "Internal Control Module Monitoring Processor Performance Safety case 1 detected failure" UBYTE _CNV_S_2_RANGE______3_CM 1 0. 0. 1. ECU_ADDRESS 0xd0005641 BIT_MASK 0x1 /end MEASUREMENT
/begin MEASUREMENT Vbx_df_ecm_mon_secu_2 "Internal Control Module Monitoring Processor Performance Safety case 2 detected failure" UBYTE _CNV_S_2_RANGE______3_CM 1 0. 0. 1. ECU_ADDRESS 0xd0005642 BIT_MASK 0x1 /end MEASUREMENT
/begin MEASUREMENT Vbx_df_ecm_mon_tron "Internal Control Module Monitoring Processor Performance Internal Circuit failure detected failure" UBYTE _CNV_S_2_RANGE______3_CM 1 0. 0. 1. ECU_ADDRESS 0xd0005643 BIT_MASK 0x1 /end MEASUREMENT
/begin MEASUREMENT Vbx_df_vb_clc_chr "System Voltage Algorithm Based Calculation Failure detected failure" UBYTE _CNV_S_2_RANGE______3_CM 1 0. 0. 1. ECU_ADDRESS 0xd0004618 BIT_MASK 0x1 /end MEASUREMENT
/begin MEASUREMENT Vsx_ecm_mon_vld "Internal Control Module Monitoring Processor Performance validity status" UBYTE _CNV_S_8_STATUS_OK__181_CM 1 0. 0. 7. ECU_ADDRESS 0xd0004158 /end MEASUREMENT
/begin CHARACTERISTIC Cxx_dfdec_ecm_adc_tron "a_dg_ecu_sft_sfthwfm/Engine control module Analogic / Numeric Converter failure detected failure counter decrement" VALUE 0xa00214c0 _REC_S1VAL_20_u2 65535. _CNV_A_R_ECME_LINEA_0_CM 0. 65535. FORMAT "%5.0" /end CHARACTERISTIC
/begin CHARACTERISTIC Cxx_dfdec_ecm_mon_secu_1 "a_dg_ecu_sft_sfthwfm/Internal Control Module Monitoring Processor Performance Safety Case 1 detected failure counter decrement" VALUE 0xa00214c2 _REC_S1VAL_20_u2 65535. _CNV_A_R_ECME_LINEA_0_CM 0. 65535. FORMAT "%5.0" /end CHARACTERISTIC
/begin CHARACTERISTIC Cxx_dfdec_ecm_mon_secu_2 "a_dg_ecu_sft_sfthwfm/Internal Control Module Monitoring Processor Performance Safety Case 2 detected failure counter decrement" VALUE 0xa00214c4 _REC_S1VAL_20_u2 65535. _CNV_A_R_ECME_LINEA_0_CM 0. 65535. FORMAT "%5.0" /end CHARACTERISTIC
/begin CHARACTERISTIC Cxx_dfdec_ecm_mon_tron "a_dg_ecu_sft_sfthwfm/Internal Control Module Monitoring Processor Performance Internal Circuit Failure detected failure counter decrement" VALUE 0xa00214c6 _REC_S1VAL_20_u2 65535. _CNV_A_R_ECME_LINEA_0_CM 0. 65535. FORMAT "%5.0" /end CHARACTERISTIC
/begin CHARACTERISTIC Cxx_dfdec_vb_clc_chr "a_dg_ecu_sft_sfthwfm/System Voltage Algorithm Based Calculation Failure detected failure counter decrement" VALUE 0xa00214c8 _REC_S1VAL_20_u2 65535. _CNV_A_R_ECME_LINEA_0_CM 0. 65535. FORMAT "%5.0" /end CHARACTERISTIC
/begin CHARACTERISTIC Cxx_dfinc_ecm_adc_tron "a_dg_ecu_sft_sfthwfm/Engine control module Analogic / Numeric Converter failure detected failure counter increment" VALUE 0xa00214ca _REC_S1VAL_20_u2 65535. _CNV_A_R_ECME_LINEA_0_CM 0. 65535. FORMAT "%5.0" /end CHARACTERISTIC
/begin CHARACTERISTIC Cxx_dfinc_ecm_mon_secu_1 "a_dg_ecu_sft_sfthwfm/Internal Control Module Monitoring Processor Performance Safety Case 1 detected failure counter increment" VALUE 0xa00214cc _REC_S1VAL_20_u2 65535. _CNV_A_R_ECME_LINEA_0_CM 0. 65535. FORMAT "%5.0" /end CHARACTERISTIC
/begin CHARACTERISTIC Cxx_dfinc_ecm_mon_secu_2 "a_dg_ecu_sft_sfthwfm/Internal Control Module Monitoring Processor Performance Safety Case 2 detected failure counter increment" VALUE 0xa00214ce _REC_S1VAL_20_u2 65535. _CNV_A_R_ECME_LINEA_0_CM 0. 65535. FORMAT "%5.0" /end CHARACTERISTIC
/begin CHARACTERISTIC Cxx_dfinc_ecm_mon_tron "a_dg_ecu_sft_sfthwfm/Internal Control Module Monitoring Processor Performance Internal Circuit Failure detected failure counter increment" VALUE 0xa00214d0 _REC_S1VAL_20_u2 65535. _CNV_A_R_ECME_LINEA_0_CM 0. 65535. FORMAT "%5.0" /end CHARACTERISTIC
/begin CHARACTERISTIC Cxx_dfinc_vb_clc_chr "a_dg_ecu_sft_sfthwfm/System Voltage Algorithm Based Calculation Failure detected failure counter increment" VALUE 0xa00214d2 _REC_S1VAL_20_u2 65535. _CNV_A_R_ECME_LINEA_0_CM 0. 65535. FORMAT "%5.0" /end CHARACTERISTIC
/begin AXIS_PTS Ctb_owe_oil_dil "Ctp_owe_dil _breakpoints" 0xa002e16c Vxx_oil_dil _REC_A2AXS_20_u2 100. _CNV_R_R_RB_CONV_10_473_CM 8 0. 100. FORMAT "%6.6" /end AXIS_PTS
/begin AXIS_PTS Ctb_owe_toil "Ctp_owe_toil breakpoints" 0xa002e180 Vxx_toil _REC_A2AXS_20_u2 240. _CNV_R_R_RB_CONV_De_474_CM 8 -40. 200. FORMAT "%8.2" /end AXIS_PTS
/begin AXIS_PTS Ctb_owe_toil_fac "Ctp_owe_toil_fac  breakpoints" 0xa002e194 Vxx_owe_toil_tco _REC_A2AXS_20_u2 240. _CNV_R_R_RB_CONV_De_474_CM 8 -40. 200. FORMAT "%8.2" /end AXIS_PTS
/begin AXIS_PTS Ctb_owe_toil_off "Cmp_owe_toil_prev_crkg  X breakpoints" 0xa002e1a8 Vxx_owe_toil_eng_off_prev _REC_A2AXS_20_u2 240. _CNV_R_R_RB_CONV_De_474_CM 8 -40. 200. FORMAT "%8.2" /end AXIS_PTS
/begin AXIS_PTS Ctb_owe_toil_sta "Cmp_owe_toil_prev_crkg  Y breakpoints" 0xa002e1bc Vxx_owe_toil_sta _REC_A2AXS_20_u2 240. _CNV_R_R_RB_CONV_De_474_CM 8 -40. 200. FORMAT "%8.2" /end AXIS_PTS
/begin MEASUREMENT Vbx_owe_ini_0 "Type of initialisation when the state of the counter is  0" UBYTE _CNV_R_R_VA_I_16_449_CM 1 0. 0. 1. DISPLAY_IDENTIFIER ClLubWea_NVM.Vbx_owe_ini_0_NVM ECU_ADDRESS 0xd0002c1a FORMAT "%6.2" BIT_MASK 0x1 /end MEASUREMENT
/begin MEASUREMENT Vbx_owe_ini_1 "Type of initialisation when the state of the counter is  1" UBYTE _CNV_R_R_VA_I_16_449_CM 1 0. 0. 1. DISPLAY_IDENTIFIER ClLubWea_NVM.Vbx_owe_ini_1_NVM ECU_ADDRESS 0xd0002c1b FORMAT "%6.2" BIT_MASK 0x1 /end MEASUREMENT
/begin MEASUREMENT Vbx_owe_ini_2 "Type of initialisation when the state of the counter is  2" UBYTE _CNV_R_R_VA_I_16_449_CM 1 0. 0. 1. DISPLAY_IDENTIFIER ClLubWea_NVM.Vbx_owe_ini_2_NVM ECU_ADDRESS 0xd0002c1c FORMAT "%6.2" BIT_MASK 0x1 /end MEASUREMENT
/begin MEASUREMENT Vbx_owe_ini_3 "Type of initialisation when the state of the counter is  3" UBYTE _CNV_R_R_VA_I_16_449_CM 1 0. 0. 1. DISPLAY_IDENTIFIER ClLubWea_NVM.Vbx_owe_ini_3_NVM ECU_ADDRESS 0xd0002c1d FORMAT "%6.2" BIT_MASK 0x1 /end MEASUREMENT
/begin MEASUREMENT Vbx_owe_ini_prev "State of the previous initialisation of the strategy (0 = after sales department)" UBYTE _CNV_R_R_VA_I_16_449_CM 1 0. 0. 1. DISPLAY_IDENTIFIER ClLubWea_NVM.Vbx_owe_ini_prev_NVM ECU_ADDRESS 0xd0002c1e FORMAT "%6.2" BIT_MASK 0x1 /end MEASUREMENT
/begin MEASUREMENT Vsx_owe_act_zon "Actual geographical zon" UBYTE _CNV_R_R_VA_I_16_449_CM 1 0. 1. 5. DISPLAY_IDENTIFIER ClLubWea_NVM.Vsx_owe_act_zon_NVM ECU_ADDRESS 0xd0002c19 FORMAT "%6.2" /end MEASUREMENT
/begin MEASUREMENT Vxx_oil_dil_raw "Current oil dilution rate" ULONG _CNV_R_R_RB_CONV_00_475_CM 1 0. 0. 100. DISPLAY_IDENTIFIER ClLubWea_NVM.Vxx_oil_dil_raw_NVM ECU_ADDRESS 0xd0002c04 FORMAT "%10.10" /end MEASUREMENT
/begin MEASUREMENT Vxx_oil_dil_rij "Current normal mode oil dilution rate" ULONG _CNV_A_R_A_476_CM 1 0. 0. 42.94 DISPLAY_IDENTIFIER ClLubWea_NVM.Vxx_oil_dil_rij_NVM ECU_ADDRESS 0xd0002c08 FORMAT "%10.10" /end MEASUREMENT
/begin MEASUREMENT Vxx_owe_ctr_stt "Counter state stored on EEPROM" UBYTE _CNV_R_R_VA_I_16_449_CM 1 0. 0. 3. DISPLAY_IDENTIFIER ClLubWea_NVM.Vxx_owe_ctr_stt_NVM ECU_ADDRESS 0xd0002c18 FORMAT "%6.2" /end MEASUREMENT
/begin MEASUREMENT Vxx_owe_dil_req_km "Total vehicle distance when the oil dilution becomes to high stored on EEPROM" ULONG _CNV_R_R_RB_CONV_Di_477_CM 1 0. 0. 16777215. DISPLAY_IDENTIFIER ClLubWea_NVM.Vxx_owe_dil_req_km_NVM ECU_ADDRESS 0xd0002bd8 FORMAT "%12.2" /end MEASUREMENT
/begin MEASUREMENT Vxx_owe_eng_rev_act_sum_0 "Number of engine turns on initialisation when the state of the counter is 0 (on EEPROM)" ULONG _CNV_R_R_RB_CONV_1T_478_CM 1 0. 0. 300000000. DISPLAY_IDENTIFIER ClLubWea_NVM.Vxx_owe_eng_rev_act_sum_0_NVM ECU_ADDRESS 0xd0002bf0 FORMAT "%12.2" /end MEASUREMENT
/begin MEASUREMENT Vxx_owe_eng_rev_act_sum_1 "Number of engine turns on initialisation when the state of the counter is 1 (on EEPROM)" ULONG _CNV_R_R_RB_CONV_1T_478_CM 1 0. 0. 300000000. DISPLAY_IDENTIFIER ClLubWea_NVM.Vxx_owe_eng_rev_act_sum_1_NVM ECU_ADDRESS 0xd0002bf4 FORMAT "%12.2" /end MEASUREMENT
/begin MEASUREMENT Vxx_owe_eng_rev_act_sum_2 "Number of engine turns on initialisation when the state of the counter is 2 (on EEPROM)" ULONG _CNV_R_R_RB_CONV_1T_478_CM 1 0. 0. 300000000. DISPLAY_IDENTIFIER ClLubWea_NVM.Vxx_owe_eng_rev_act_sum_2_NVM ECU_ADDRESS 0xd0002bf8 FORMAT "%12.2" /end MEASUREMENT
/begin MEASUREMENT Vxx_owe_eng_rev_act_sum_3 "Number of engine turns on initialisation when the state of the counter is 3 (on EEPROM)" ULONG _CNV_R_R_RB_CONV_1T_478_CM 1 0. 0. 300000000. DISPLAY_IDENTIFIER ClLubWea_NVM.Vxx_owe_eng_rev_act_sum_3_NVM ECU_ADDRESS 0xd0002bfc FORMAT "%12.2" /end MEASUREMENT
/begin MEASUREMENT Vxx_owe_eng_rev_prev_sum "Previous engine revolutions sum stored in EEPROM" ULONG _CNV_R_R_RB_CONV_1T_478_CM 1 0. 0. 300000000. DISPLAY_IDENTIFIER ClLubWea_NVM.Vxx_owe_eng_rev_prev_sum_NVM ECU_ADDRESS 0xd0002c00 FORMAT "%12.2" /end MEASUREMENT
/begin MEASUREMENT Vxx_owe_km_0 "Number of kilometers travelled on initialisation when the state of the counter is 0 (on EEPROM)" ULONG _CNV_R_R_RB_CONV_Di_477_CM 1 0. 0. 16777215. DISPLAY_IDENTIFIER ClLubWea_NVM.Vxx_owe_km_0_NVM ECU_ADDRESS 0xd0002be0 FORMAT "%12.2" /end MEASUREMENT
/begin MEASUREMENT Vxx_owe_km_1 "Number of kilometers travelled on initialisation when the state of the counter is 1 (on EEPROM)" ULONG _CNV_R_R_RB_CONV_Di_477_CM 1 0. 0. 16777215. DISPLAY_IDENTIFIER ClLubWea_NVM.Vxx_owe_km_1_NVM ECU_ADDRESS 0xd0002be4 FORMAT "%12.2" /end MEASUREMENT
/begin MEASUREMENT Vxx_owe_km_2 "Number of kilometers travelled on initialisation when the state of the counter is  2  (on EEPROM)" ULONG _CNV_R_R_RB_CONV_Di_477_CM 1 0. 0. 16777215. DISPLAY_IDENTIFIER ClLubWea_NVM.Vxx_owe_km_2_NVM ECU_ADDRESS 0xd0002be8 FORMAT "%12.2" /end MEASUREMENT
/begin MEASUREMENT Vxx_owe_km_3 "Number of kilometers travelled on initialisation when the state of the counter is  3  (on EEPROM)" ULONG _CNV_R_R_RB_CONV_Di_477_CM 1 0. 0. 16777215. DISPLAY_IDENTIFIER ClLubWea_NVM.Vxx_owe_km_3_NVM ECU_ADDRESS 0xd0002bec FORMAT "%12.2" /end MEASUREMENT
/begin MEASUREMENT Vxx_owe_pot_km_0 "Potential kilometer storred when the counter is 0 (on EEPROM)" UWORD _CNV_R_R_VA_I_16_449_CM 1 0. 0. 65535. DISPLAY_IDENTIFIER ClLubWea_NVM.Vxx_owe_pot_km_0_NVM ECU_ADDRESS 0xd0002c0e FORMAT "%6.2" /end MEASUREMENT
/begin MEASUREMENT Vxx_owe_pot_km_1 "Potential kilometer storred when the counter is 1 (on EEPROM)" UWORD _CNV_R_R_VA_I_16_449_CM 1 0. 0. 65535. DISPLAY_IDENTIFIER ClLubWea_NVM.Vxx_owe_pot_km_1_NVM ECU_ADDRESS 0xd0002c10 FORMAT "%6.2" /end MEASUREMENT
/begin MEASUREMENT Vxx_owe_pot_km_2 "Potential kilometer storred when the counter is 2 (on EEPROM)" UWORD _CNV_R_R_VA_I_16_449_CM 1 0. 0. 65535. DISPLAY_IDENTIFIER ClLubWea_NVM.Vxx_owe_pot_km_2_NVM ECU_ADDRESS 0xd0002c12 FORMAT "%6.2" /end MEASUREMENT
/begin MEASUREMENT Vxx_owe_pot_km_3 "Potential kilometer storred when the counter is 3 (on EEPROM)" UWORD _CNV_R_R_VA_I_16_449_CM 1 0. 0. 65535. DISPLAY_IDENTIFIER ClLubWea_NVM.Vxx_owe_pot_km_3_NVM ECU_ADDRESS 0xd0002c14 FORMAT "%6.2" /end MEASUREMENT
/begin MEASUREMENT Vxx_owe_prev_ini_km "Vehicle kilometers on the previous oil drain" ULONG _CNV_R_R_RB_CONV_Di_477_CM 1 0. 0. 16777215. DISPLAY_IDENTIFIER ClLubWea_NVM.Vxx_owe_prev_ini_km_NVM ECU_ADDRESS 0xd0002bd4 FORMAT "%12.2" /end MEASUREMENT
/begin MEASUREMENT Vxx_owe_toil_eng_off_prev "Oil temperature for oil wear estimation strategy (with saturation) on previous engine off" UWORD _CNV_R_R_RB_CONV_De_474_CM 1 0. -40. 200. DISPLAY_IDENTIFIER ClLubWea_NVM.Vxx_owe_toil_eng_off_prev_NVM ECU_ADDRESS 0xd0002c0c FORMAT "%8.2" /end MEASUREMENT
/begin MEASUREMENT Vxx_owe_warn_req_km "Vehilcle kilometers when the pre alert appear" ULONG _CNV_R_R_RB_CONV_Di_477_CM 1 0. 0. 16777215. DISPLAY_IDENTIFIER ClLubWea_NVM.Vxx_owe_warn_req_km_NVM ECU_ADDRESS 0xd0002bdc FORMAT "%12.2" /end MEASUREMENT
/begin MEASUREMENT Vxx_pft_oil_dil_max "Maximum oil dilution rate during the calibrated distance" UWORD _CNV_R_R_RB_CONV_10_473_CM 1 0. 0. 100. DISPLAY_IDENTIFIER ClLubWea_NVM.Vxx_pft_oil_dil_max_NVM ECU_ADDRESS 0xd0002c16 FORMAT "%6.6" /end MEASUREMENT
/begin CHARACTERISTIC Cmp_owe_toil_prev_sta "This map produce a number of engine turn in function of cranking oil temperature and engine stop" MAP 0xa002e0ec _REC_A1MAP_20_u2_u2_u2 500000. _CNV_R_R_RB_CONV_10_479_CM 0. 500000. FORMAT "%8.3"
 /begin AXIS_DESCR COM_AXIS Vxx_owe_toil_eng_off_prev _CNV_R_R_RB_CONV_De_474_CM 8 -40. 200. FORMAT "%8.2" AXIS_PTS_REF Ctb_owe_toil_off /end AXIS_DESCR
 /begin AXIS_DESCR COM_AXIS Vxx_owe_toil_sta _CNV_R_R_RB_CONV_De_474_CM 8 -40. 200. FORMAT "%8.2" AXIS_PTS_REF Ctb_owe_toil_sta /end AXIS_DESCR
/end CHARACTERISTIC
/begin CHARACTERISTIC Ctp_owe_dil "Oil dilution effect table" CURVE 0xa002e1d0 _REC_A1CUR_20_u2_u2 10. _CNV_R_R_RB_CONV_Re_480_CM 0. 10. FORMAT "%6.4"
 /begin AXIS_DESCR COM_AXIS Vxx_oil_dil _CNV_R_R_RB_CONV_10_473_CM 8 0. 100. FORMAT "%6.6" AXIS_PTS_REF Ctb_owe_oil_dil /end AXIS_DESCR
/end CHARACTERISTIC
/begin CHARACTERISTIC Ctp_owe_toil "PWM to oil temperature conversion table" CURVE 0xa002e1e0 _REC_A1CUR_20_u2_u2 240. _CNV_R_R_RB_CONV_De_474_CM -40. 200. FORMAT "%8.2"
 /begin AXIS_DESCR COM_AXIS Vxx_toil _CNV_R_R_RB_CONV_De_474_CM 8 -40. 200. FORMAT "%8.2" AXIS_PTS_REF Ctb_owe_toil /end AXIS_DESCR
/end CHARACTERISTIC
/begin CHARACTERISTIC Ctp_owe_toil_fac "Oil temperature effect table" CURVE 0xa002e1f0 _REC_A1CUR_20_u2_u2 10. _CNV_R_R_RB_CONV_Re_480_CM 0. 10. FORMAT "%6.4"
 /begin AXIS_DESCR COM_AXIS Vxx_owe_toil_tco _CNV_R_R_RB_CONV_De_474_CM 8 -40. 200. FORMAT "%8.2" AXIS_PTS_REF Ctb_owe_toil_fac /end AXIS_DESCR
/end CHARACTERISTIC
/begin MEASUREMENT Vbx_owe_eng_aut "Engine in autonomous state" UBYTE _CNV_R_R_VA_I_16_449_CM 1 0. 0. 1. ECU_ADDRESS 0xd00055bf FORMAT "%6.2" BIT_MASK 0x1 /end MEASUREMENT
/begin MEASUREMENT Vbx_owe_eng_aut_dly "Set when the engine is autonomous and the delay is expired" UBYTE _CNV_R_R_VA_I_16_449_CM 1 0. 0. 1. ECU_ADDRESS 0xd00055c0 FORMAT "%6.2" BIT_MASK 0x1 /end MEASUREMENT
/begin MEASUREMENT Vbx_owe_fac_toil_act "Output of the SR_Flip_Flop" UBYTE _CNV_R_R_VA_I_16_449_CM 1 0. 0. 1. ECU_ADDRESS 0xd00055c1 FORMAT "%6.2" BIT_MASK 0x1 /end MEASUREMENT
/begin MEASUREMENT Vbx_owe_ini_0_trg "Writing trigger for the type of initialisation (asd or not) for EEPROM memorisation" UBYTE _CNV_R_R_VA_I_16_449_CM 1 0. 0. 1. ECU_ADDRESS 0xd0005288 FORMAT "%6.2" BIT_MASK 0x1 /end MEASUREMENT
/begin MEASUREMENT Vbx_owe_ini_1_trg "Writing trigger for the type of initialisation (asd or not) for EEPROM memorisation" UBYTE _CNV_R_R_VA_I_16_449_CM 1 0. 0. 1. ECU_ADDRESS 0xd0005289 FORMAT "%6.2" BIT_MASK 0x1 /end MEASUREMENT
/begin MEASUREMENT Vbx_owe_ini_2_trg "Writing trigger for the type of initialisation (asd or not) for EEPROM memorisation" UBYTE _CNV_R_R_VA_I_16_449_CM 1 0. 0. 1. ECU_ADDRESS 0xd000528a FORMAT "%6.2" BIT_MASK 0x1 /end MEASUREMENT
/begin MEASUREMENT Vbx_owe_ini_3_trg "Writing trigger for the type of initialisation (asd or not) for EEPROM memorisation" UBYTE _CNV_R_R_VA_I_16_449_CM 1 0. 0. 1. ECU_ADDRESS 0xd000528b FORMAT "%6.2" BIT_MASK 0x1 /end MEASUREMENT
/begin MEASUREMENT Vbx_owe_off "Set if the oil wear estimation is inibited" UBYTE _CNV_R_R_VA_I_16_449_CM 1 0. 0. 1. ECU_ADDRESS 0xd00056cd FORMAT "%6.2" BIT_MASK 0x1 /end MEASUREMENT
/begin MEASUREMENT Vbx_owe_zon_writ "Boolean set when a geographical zon is wroten" UBYTE _CNV_R_R_VA_I_16_449_CM 1 0. 0. 1. ECU_ADDRESS 0xd00056ce FORMAT "%6.2" BIT_MASK 0x1 /end MEASUREMENT
/begin MEASUREMENT Vtx_owe_eng_rev_act_sum[0] "Table of actual engine revolution sum for the oil wear estimation strategy" ULONG _CNV_R_R_RB_CONV_1T_478_CM 1 0. 0. 300000000. ECU_ADDRESS 0xd00028c0 FORMAT "%12.2" /end MEASUREMENT
/begin MEASUREMENT Vtx_owe_eng_rev_act_sum[1] "Table of actual engine revolution sum for the oil wear estimation strategy" ULONG _CNV_R_R_RB_CONV_1T_478_CM 1 0. 0. 300000000. ECU_ADDRESS 0xd00028c4 FORMAT "%12.2" /end MEASUREMENT
/begin MEASUREMENT Vtx_owe_eng_rev_act_sum[2] "Table of actual engine revolution sum for the oil wear estimation strategy" ULONG _CNV_R_R_RB_CONV_1T_478_CM 1 0. 0. 300000000. ECU_ADDRESS 0xd00028c8 FORMAT "%12.2" /end MEASUREMENT
/begin MEASUREMENT Vtx_owe_eng_rev_act_sum[3] "Table of actual engine revolution sum for the oil wear estimation strategy" ULONG _CNV_R_R_RB_CONV_1T_478_CM 1 0. 0. 300000000. ECU_ADDRESS 0xd00028cc FORMAT "%12.2" /end MEASUREMENT
/begin MEASUREMENT Vtx_owe_km[0] "Table of number of kilometers travelled on initialisation" ULONG _CNV_R_R_RB_CONV_Di_477_CM 1 0. 0. 16777215. ECU_ADDRESS 0xd00028d0 FORMAT "%12.2" /end MEASUREMENT
/begin MEASUREMENT Vtx_owe_km[1] "Table of number of kilometers travelled on initialisation" ULONG _CNV_R_R_RB_CONV_Di_477_CM 1 0. 0. 16777215. ECU_ADDRESS 0xd00028d4 FORMAT "%12.2" /end MEASUREMENT
/begin MEASUREMENT Vtx_owe_km[2] "Table of number of kilometers travelled on initialisation" ULONG _CNV_R_R_RB_CONV_Di_477_CM 1 0. 0. 16777215. ECU_ADDRESS 0xd00028d8 FORMAT "%12.2" /end MEASUREMENT
/begin MEASUREMENT Vtx_owe_km[3] "Table of number of kilometers travelled on initialisation" ULONG _CNV_R_R_RB_CONV_Di_477_CM 1 0. 0. 16777215. ECU_ADDRESS 0xd00028dc FORMAT "%12.2" /end MEASUREMENT
/begin MEASUREMENT Vtx_owe_pot_km[0] "Table of potential kilometer" UWORD _CNV_R_R_VA_I_16_449_CM 1 0. 0. 65535. ECU_ADDRESS 0xd0005af8 FORMAT "%6.2" /end MEASUREMENT
/begin MEASUREMENT Vtx_owe_pot_km[1] "Table of potential kilometer" UWORD _CNV_R_R_VA_I_16_449_CM 1 0. 0. 65535. ECU_ADDRESS 0xd0005afa FORMAT "%6.2" /end MEASUREMENT
/begin MEASUREMENT Vtx_owe_pot_km[2] "Table of potential kilometer" UWORD _CNV_R_R_VA_I_16_449_CM 1 0. 0. 65535. ECU_ADDRESS 0xd0005afc FORMAT "%6.2" /end MEASUREMENT
/begin MEASUREMENT Vtx_owe_pot_km[3] "Table of potential kilometer" UWORD _CNV_R_R_VA_I_16_449_CM 1 0. 0. 65535. ECU_ADDRESS 0xd0005afe FORMAT "%6.2" /end MEASUREMENT
/begin MEASUREMENT Vxx_oil_dil "Current oil dilution rate" UWORD _CNV_R_R_RB_CONV_10_473_CM 1 0. 0. 100. ECU_ADDRESS 0xd000585e FORMAT "%6.6" /end MEASUREMENT
/begin MEASUREMENT Vxx_owe_cmp_toil "Value of the output of the  CMP_owe_toil_prev_sta" UWORD _CNV_R_R_RB_CONV_10_479_CM 1 0. 0. 500000. ECU_ADDRESS 0xd0005b56 FORMAT "%8.3" /end MEASUREMENT
/begin MEASUREMENT Vxx_owe_ctp_dil "Value of the output of the   Ctp_owe_dil  table" UWORD _CNV_R_R_RB_CONV_Re_480_CM 1 0. 0. 10. ECU_ADDRESS 0xd0005b4e FORMAT "%6.4" /end MEASUREMENT
/begin MEASUREMENT Vxx_owe_ctp_toil "Value of the output of the   Ctp_owe_toil  table" UWORD _CNV_R_R_RB_CONV_Re_480_CM 1 0. 0. 10. ECU_ADDRESS 0xd0005b50 FORMAT "%6.4" /end MEASUREMENT
/begin MEASUREMENT Vxx_owe_eng_rev_act_sum "Actual engine revolution sum for the oil wear estimation strategy" ULONG _CNV_R_R_RB_CONV_1T_478_CM 1 0. 0. 300000000. ECU_ADDRESS 0xd0002ad4 FORMAT "%12.2" /end MEASUREMENT
/begin MEASUREMENT Vxx_owe_eng_rev_act_sum_mem "Memorized actual engine revolution sum for the oil wear estimation strategy" ULONG _CNV_R_R_RB_CONV_1T_478_CM 1 0. 0. 300000000. ECU_ADDRESS 0xd00028e0 FORMAT "%12.2" /end MEASUREMENT
/begin MEASUREMENT Vxx_owe_fac_toil_act "Actual oil temperatrure factor" ULONG _CNV_R_R_RB_CONV_1T_478_CM 1 0. 0. 500000. ECU_ADDRESS 0xd0002ad8 FORMAT "%12.2" /end MEASUREMENT
/begin MEASUREMENT Vxx_owe_fac_toil_tot "Total oil temperature factor" ULONG _CNV_R_R_RB_CONV_1T_478_CM 1 0. 0. 500000. ECU_ADDRESS 0xd0002adc FORMAT "%12.2" /end MEASUREMENT
/begin MEASUREMENT Vxx_owe_ini "Type of initialisation word" UBYTE _CNV_R_R_VA_I_16_449_CM 1 0. 0. 255. ECU_ADDRESS 0xd000528c FORMAT "%6.2" /end MEASUREMENT
/begin MEASUREMENT Vxx_owe_km_pot "Potential kilometers" UWORD _CNV_R_R_RB_CONV_Di_477_CM 1 0. 0. 65535. ECU_ADDRESS 0xd00057b4 FORMAT "%12.2" /end MEASUREMENT
/begin MEASUREMENT Vxx_owe_max_drn_km "Maximal travelled kilometer between oil drain" UWORD _CNV_R_R_RB_CONV_Di_477_CM 1 0. 0. 65535. ECU_ADDRESS 0xd00057b6 FORMAT "%12.2" /end MEASUREMENT
/begin MEASUREMENT Vxx_owe_min_drn_km "Minimal travelled kilometer between oil drain" UWORD _CNV_R_R_RB_CONV_Di_477_CM 1 0. 0. 20000. ECU_ADDRESS 0xd00057b8 FORMAT "%12.2" /end MEASUREMENT
/begin MEASUREMENT Vxx_owe_n_aut "Number engine revolutions per time" ULONG _CNV_R_R_RB_CONV_Re_481_CM 1 0. 0. 20. ECU_ADDRESS 0xd0002ae0 FORMAT "%6.6" /end MEASUREMENT
/begin MEASUREMENT Vxx_owe_n_mnl_asd "Maximal number of engine revolutions" ULONG _CNV_R_R_RB_CONV_1T_478_CM 1 0. 0. 300000000. ECU_ADDRESS 0xd00028bc FORMAT "%12.2" /end MEASUREMENT
/begin MEASUREMENT Vxx_owe_n_toil_dil_u32 "Actual engine revolution sum (since the last  engine on time)" ULONG _CNV_R_R_RB_CONV_Tr_482_CM 1 0. 0. 109951162. ECU_ADDRESS 0xd0002ae4 FORMAT "%8.3" /end MEASUREMENT
/begin MEASUREMENT Vxx_owe_prev_drn_dist "Travelled distance from the last oil drain" UWORD _CNV_R_R_RB_CONV_Di_477_CM 1 0. 0. 65535. ECU_ADDRESS 0xd0005b00 FORMAT "%12.2" /end MEASUREMENT
/begin MEASUREMENT Vxx_owe_toil_sta "Oil temperature for oil wear estimation strategy (with saturation) on engine cranking" UWORD _CNV_R_R_RB_CONV_De_474_CM 1 0. -40. 200. ECU_ADDRESS 0xd0005b52 FORMAT "%8.2" /end MEASUREMENT
/begin MEASUREMENT Vxx_owe_toil_tco "Oil temperature for oil wear estimation strategy (with saturation)" UWORD _CNV_R_R_RB_CONV_De_474_CM 1 0. -40. 200. ECU_ADDRESS 0xd0005b54 FORMAT "%8.2" /end MEASUREMENT
/begin CHARACTERISTIC Cbx_owe_toil_tco "Calibration to choose between Oil and Colant temperature (0 is for oil)" VALUE 0xa0020c4c _REC_S1VAL_Normal_u1 1. _CNV_R_R_VA_I_16_449_CM 0. 1. FORMAT "%6.2" /end CHARACTERISTIC
/begin CHARACTERISTIC Cxx_owe_eng_aut_dly "Delay time before the first value of the engine oil temperature" VALUE 0xa0020c46 _REC_S1VAL_Normal_u2 6553.5 _CNV_R_R_RB_CONV_Ti_483_CM 0. 6553.5 FORMAT "%8.2" /end CHARACTERISTIC
/begin CHARACTERISTIC Cxx_owe_km_pot_1 "Potential kilometer on initialisation for zone 1" VALUE 0xa0021b42 _REC_S1VAL_Normal_u2 65535. _CNV_R_R_RB_CONV_Di_477_CM 0. 65535. FORMAT "%12.2" /end CHARACTERISTIC
/begin CHARACTERISTIC Cxx_owe_km_pot_2 "Potential kilometer on initialisation for zone 2" VALUE 0xa0021b44 _REC_S1VAL_Normal_u2 65535. _CNV_R_R_RB_CONV_Di_477_CM 0. 65535. FORMAT "%12.2" /end CHARACTERISTIC
/begin CHARACTERISTIC Cxx_owe_km_pot_3 "Potential kilometer on initialisation for zone 3" VALUE 0xa0021b46 _REC_S1VAL_Normal_u2 65535. _CNV_R_R_RB_CONV_Di_477_CM 0. 65535. FORMAT "%12.2" /end CHARACTERISTIC
/begin CHARACTERISTIC Cxx_owe_km_pot_4 "Potential kilometer on initialisation for zone 4" VALUE 0xa0021b48 _REC_S1VAL_Normal_u2 65535. _CNV_R_R_RB_CONV_Di_477_CM 0. 65535. FORMAT "%12.2" /end CHARACTERISTIC
/begin CHARACTERISTIC Cxx_owe_max_drn_km_1 "Calibration to activate the drain request if the travelled distance is to big on zone 1" VALUE 0xa0021b4a _REC_S1VAL_Normal_u2 65535. _CNV_R_R_RB_CONV_Di_477_CM 0. 65535. FORMAT "%12.2" /end CHARACTERISTIC
/begin CHARACTERISTIC Cxx_owe_max_drn_km_2 "Calibration to activate the drain request if the travelled distance is to big on zone 2" VALUE 0xa0021b4c _REC_S1VAL_Normal_u2 65535. _CNV_R_R_RB_CONV_Di_477_CM 0. 65535. FORMAT "%12.2" /end CHARACTERISTIC
/begin CHARACTERISTIC Cxx_owe_max_drn_km_3 "Calibration to activate the drain request if the travelled distance is to big on zone 3" VALUE 0xa0021b4e _REC_S1VAL_Normal_u2 65535. _CNV_R_R_RB_CONV_Di_477_CM 0. 65535. FORMAT "%12.2" /end CHARACTERISTIC
/begin CHARACTERISTIC Cxx_owe_max_drn_km_4 "Calibration to activate the drain request if the travelled distance is to big on zone 4" VALUE 0xa0021b50 _REC_S1VAL_Normal_u2 65535. _CNV_R_R_RB_CONV_Di_477_CM 0. 65535. FORMAT "%12.2" /end CHARACTERISTIC
/begin CHARACTERISTIC Cxx_owe_min_drn_km_1 "Calibration to forbid the drain request if the travelled distance is to small on zone 1" VALUE 0xa0021b52 _REC_S1VAL_Normal_u2 20000. _CNV_R_R_RB_CONV_Di_477_CM 0. 20000. FORMAT "%12.2" /end CHARACTERISTIC
/begin CHARACTERISTIC Cxx_owe_min_drn_km_2 "Calibration to forbid the drain request if the travelled distance is to small on zone 2" VALUE 0xa0021b54 _REC_S1VAL_Normal_u2 20000. _CNV_R_R_RB_CONV_Di_477_CM 0. 20000. FORMAT "%12.2" /end CHARACTERISTIC
/begin CHARACTERISTIC Cxx_owe_min_drn_km_3 "Calibration to forbid the drain request if the travelled distance is to small on zone 3" VALUE 0xa0021b56 _REC_S1VAL_Normal_u2 20000. _CNV_R_R_RB_CONV_Di_477_CM 0. 20000. FORMAT "%12.2" /end CHARACTERISTIC
/begin CHARACTERISTIC Cxx_owe_min_drn_km_4 "Calibration to forbid the drain request if the travelled distance is to small on zone 4" VALUE 0xa0021b58 _REC_S1VAL_Normal_u2 20000. _CNV_R_R_RB_CONV_Di_477_CM 0. 20000. FORMAT "%12.2" /end CHARACTERISTIC
/begin CHARACTERISTIC Cxx_owe_n_mnl_asd_1 "Maximal number of engine revolutions on zone 1" VALUE 0xa0021b32 _REC_S1VAL_Normal_u4 300000000. _CNV_R_R_RB_CONV_1T_478_CM 0. 300000000. FORMAT "%12.2" /end CHARACTERISTIC
/begin CHARACTERISTIC Cxx_owe_n_mnl_asd_2 "Maximal number of engine revolutions on zone 2" VALUE 0xa0021b36 _REC_S1VAL_Normal_u4 300000000. _CNV_R_R_RB_CONV_1T_478_CM 0. 300000000. FORMAT "%12.2" /end CHARACTERISTIC
/begin CHARACTERISTIC Cxx_owe_n_mnl_asd_3 "Maximal number of engine revolutions on zone 3" VALUE 0xa0021b3a _REC_S1VAL_Normal_u4 300000000. _CNV_R_R_RB_CONV_1T_478_CM 0. 300000000. FORMAT "%12.2" /end CHARACTERISTIC
/begin CHARACTERISTIC Cxx_owe_n_mnl_asd_4 "Maximal number of engine revolutions on zone 4" VALUE 0xa0021b3e _REC_S1VAL_Normal_u4 300000000. _CNV_R_R_RB_CONV_1T_478_CM 0. 300000000. FORMAT "%12.2" /end CHARACTERISTIC
/begin CHARACTERISTIC Cxx_owe_tco_sub "Coolant substitution value in case of failure" VALUE 0xa0020c48 _REC_S1VAL_Normal_u2 240. _CNV_R_R_RB_CONV_De_474_CM -40. 200. FORMAT "%8.2" /end CHARACTERISTIC
/begin CHARACTERISTIC Cxx_owe_toil_sub "Substitute value of oil temperature if the sensor is failed" VALUE 0xa0020c4a _REC_S1VAL_Normal_u2 240. _CNV_R_R_RB_CONV_De_474_CM -40. 200. FORMAT "%8.2" /end CHARACTERISTIC
/begin MEASUREMENT Vbx_owe_dil_req_km_2_clc "Boolean set if the oil dilution threshold is passed" UBYTE _CNV_R_R_VA_I_16_449_CM 1 0. 0. 1. DISPLAY_IDENTIFIER OuCloLuo_NVM.Vbx_owe_dil_req_km_2_clc_NVM ECU_ADDRESS 0xd00027dc FORMAT "%6.2" BIT_MASK 0x1 /end MEASUREMENT
/begin MEASUREMENT Vbx_owe_oil_drn_req_2 "Oil drain requested by the strategy (level 2)" UBYTE _CNV_R_R_VA_I_16_449_CM 1 0. 0. 1. DISPLAY_IDENTIFIER OuCloLuo_NVM.Vbx_owe_oil_drn_req_2_NVM ECU_ADDRESS 0xd00027dd FORMAT "%6.2" BIT_MASK 0x1 /end MEASUREMENT
/begin MEASUREMENT Vbx_owe_oil_drn_req "Oil drain requested by the strategy" UBYTE _CNV_R_R_VA_I_16_449_CM 1 0. 0. 1. DISPLAY_IDENTIFIER OuCloLuo_NVM.Vbx_owe_oil_drn_req_NVM ECU_ADDRESS 0xd00027de FORMAT "%6.2" BIT_MASK 0x1 /end MEASUREMENT
/begin MEASUREMENT Vbx_owe_warn_req_km_mem "Vehicle kilometers memorisation trigger before rising edge" UBYTE _CNV_R_R_VA_I_16_449_CM 1 0. 0. 1. DISPLAY_IDENTIFIER OuCloLuo_NVM.Vbx_owe_warn_req_km_mem_NVM ECU_ADDRESS 0xd00027df FORMAT "%6.2" BIT_MASK 0x1 /end MEASUREMENT
/begin MEASUREMENT Vxx_owe_dil "Current oil dilution rate for oil wear estimation" UWORD _CNV_R_R_RB_CONV_10_473_CM 1 0. 0. 100. DISPLAY_IDENTIFIER OuCloLuo_NVM.Vxx_owe_dil_NVM ECU_ADDRESS 0xd00027d0 FORMAT "%6.4" /end MEASUREMENT
/begin MEASUREMENT Vxx_owe_km1 "Oil kilometer value for the first reference point" UWORD _CNV_R_R_RB_CONV_Di_477_CM 1 0. 0. 65535. DISPLAY_IDENTIFIER OuCloLuo_NVM.Vxx_owe_km1_NVM ECU_ADDRESS 0xd00027c8 FORMAT "%12.2" /end MEASUREMENT
/begin MEASUREMENT Vxx_owe_km1_dil "Oil kilometer value for the first reference point for dilution potential kilometer calculation" UWORD _CNV_R_R_RB_CONV_Di_477_CM 1 0. 0. 65535. DISPLAY_IDENTIFIER OuCloLuo_NVM.Vxx_owe_km1_dil_NVM ECU_ADDRESS 0xd00027da FORMAT "%12.2" /end MEASUREMENT
/begin MEASUREMENT Vxx_owe_km2 "Oil kilometer value for the second reference point" UWORD _CNV_R_R_RB_CONV_Di_477_CM 1 0. 0. 65535. DISPLAY_IDENTIFIER OuCloLuo_NVM.Vxx_owe_km2_NVM ECU_ADDRESS 0xd00027cc FORMAT "%12.2" /end MEASUREMENT
/begin MEASUREMENT Vxx_owe_km2_dil "Oil kilometer value for the second reference point for dilution potential kilometer calculation" UWORD _CNV_R_R_RB_CONV_Di_477_CM 1 0. 0. 65535. DISPLAY_IDENTIFIER OuCloLuo_NVM.Vxx_owe_km2_dil_NVM ECU_ADDRESS 0xd00027d2 FORMAT "%12.2" /end MEASUREMENT
/begin MEASUREMENT Vxx_owe_oxy_dil_fac_raw "Interpolation raw factor" UWORD _CNV_R_R_RB_CONV_1__484_CM 1 0. 0. 1. DISPLAY_IDENTIFIER OuCloLuo_NVM.Vxx_owe_oxy_dil_fac_raw_NVM ECU_ADDRESS 0xd00027d8 FORMAT "%6.6" /end MEASUREMENT
/begin MEASUREMENT Vxx_owe_pot_km_pot "Oil potential meters" ULONG _CNV_R_R_RB_CONV_di_485_CM 1 0. 0. 65535000. DISPLAY_IDENTIFIER OuCloLuo_NVM.Vxx_owe_pot_km_pot_NVM ECU_ADDRESS 0xd00027c0 FORMAT "%12.2" /end MEASUREMENT
/begin MEASUREMENT Vxx_owe_pot_km_rnd_dil "Rounded oil dilution potential meters" ULONG _CNV_R_R_RB_CONV_di_485_CM 1 0. 0. 65535000. DISPLAY_IDENTIFIER OuCloLuo_NVM.Vxx_owe_pot_km_rnd_dil_NVM ECU_ADDRESS 0xd00027c4 FORMAT "%12.2" /end MEASUREMENT
/begin MEASUREMENT Vxx_owe_wea1 "Oil wear when the first point is learned" UWORD _CNV_R_R_RB_CONV_1__484_CM 1 0. 0. 1. DISPLAY_IDENTIFIER OuCloLuo_NVM.Vxx_owe_wea1_NVM ECU_ADDRESS 0xd00027ca FORMAT "%6.6" /end MEASUREMENT
/begin MEASUREMENT Vxx_owe_wea1_dil "Oil dilution wear when the first point is learned" UWORD _CNV_R_R_RB_CONV_1__484_CM 1 0. 0. 1. DISPLAY_IDENTIFIER OuCloLuo_NVM.Vxx_owe_wea1_dil_NVM ECU_ADDRESS 0xd00027d6 FORMAT "%6.6" /end MEASUREMENT
/begin MEASUREMENT Vxx_owe_wea2 "Oil wear when the second point is learned" UWORD _CNV_R_R_RB_CONV_1__484_CM 1 0. 0. 1. DISPLAY_IDENTIFIER OuCloLuo_NVM.Vxx_owe_wea2_NVM ECU_ADDRESS 0xd00027ce FORMAT "%6.6" /end MEASUREMENT
/begin MEASUREMENT Vxx_owe_wea2_dil "Oil dilution wear when the second point is learned" UWORD _CNV_R_R_RB_CONV_1__484_CM 1 0. 0. 1. DISPLAY_IDENTIFIER OuCloLuo_NVM.Vxx_owe_wea2_dil_NVM ECU_ADDRESS 0xd00027d4 FORMAT "%6.6" /end MEASUREMENT
/begin MEASUREMENT Vbx_oil_heat_abst_pres_cho "Presence of oil heater vapours conf choice" UBYTE _CNV_R_R_VA_I_16_449_CM 1 0. 0. 1. ECU_ADDRESS 0xd0005725 FORMAT "%6.2" BIT_MASK 0x1 /end MEASUREMENT
/begin MEASUREMENT Vbx_owe_dil_req_km "This bit is set if the oil dilution level is higher than  Cxx_owe_oil_dil_thd" UBYTE _CNV_R_R_VA_I_16_449_CM 1 0. 0. 1. ECU_ADDRESS 0xd00051e0 FORMAT "%6.2" BIT_MASK 0x1 /end MEASUREMENT
/begin MEASUREMENT Vbx_owe_dil_req_km_1_clc "Boolean set if the oil dilution threshold is passed" UBYTE _CNV_R_R_VA_I_16_449_CM 1 0. 0. 1. ECU_ADDRESS 0xd00055a4 FORMAT "%6.2" BIT_MASK 0x1 /end MEASUREMENT
/begin MEASUREMENT Vbx_owe_drn_req "Oil drain requested" UBYTE _CNV_R_R_VA_I_16_449_CM 1 0. 0. 1. ECU_ADDRESS 0xd00055a0 FORMAT "%6.2" BIT_MASK 0x1 /end MEASUREMENT
/begin MEASUREMENT Vbx_owe_drn_req_ok_2 "Equivalent to  Vbx_owe_drn_req_ok_1   plus the initialisation request condition" UBYTE _CNV_R_R_VA_I_16_449_CM 1 0. 0. 1. ECU_ADDRESS 0xd00055a1 FORMAT "%6.2" BIT_MASK 0x1 /end MEASUREMENT
/begin MEASUREMENT Vbx_owe_drn_req_rst "Reset condition of the SR Fip Flop" UBYTE _CNV_R_R_VA_I_16_449_CM 1 0. 0. 1. ECU_ADDRESS 0xd00055a2 FORMAT "%6.2" BIT_MASK 0x1 /end MEASUREMENT
/begin MEASUREMENT Vbx_owe_hmi_warn_emb_cho "Warning or kilometers alert conf choice" UBYTE _CNV_R_R_VA_I_16_449_CM 1 0. 0. 1. ECU_ADDRESS 0xd0005724 FORMAT "%6.2" BIT_MASK 0x1 /end MEASUREMENT
/begin MEASUREMENT Vbx_owe_ini_req_tmp "Initialisation request (manual or after sale department) accepted rising edge widened" UBYTE _CNV_R_R_VA_I_16_449_CM 1 0. 0. 1. ECU_ADDRESS 0xd000550b FORMAT "%6.2" BIT_MASK 0x1 /end MEASUREMENT
/begin MEASUREMENT Vbx_owe_n_drn_req "This bit is set when the oxidation level of the oil is to high" UBYTE _CNV_R_R_VA_I_16_449_CM 1 0. 0. 1. ECU_ADDRESS 0xd00055a3 FORMAT "%6.2" BIT_MASK 0x1 /end MEASUREMENT
/begin MEASUREMENT Vbx_owe_oil_drn_req_2_clc "Oil drain requested by the strategy (level 2)" UBYTE _CNV_R_R_VA_I_16_449_CM 1 0. 0. 1. ECU_ADDRESS 0xd000559d FORMAT "%6.2" BIT_MASK 0x1 /end MEASUREMENT
/begin MEASUREMENT Vbx_owe_oil_drn_req_2_mux "Oil drain requested by the strategy (level 2) sent on can interface" UBYTE _CNV_R_R_VA_I_16_449_CM 1 0. 0. 1. ECU_ADDRESS 0xd00051e1 FORMAT "%6.2" BIT_MASK 0x1 /end MEASUREMENT
/begin MEASUREMENT Vbx_owe_oil_drn_req_2_mux_raw "Oil drain requested by the strategy before replacement value" UBYTE _CNV_R_R_VA_I_16_449_CM 1 0. 0. 1. ECU_ADDRESS 0xd00055a5 FORMAT "%6.2" BIT_MASK 0x1 /end MEASUREMENT
/begin MEASUREMENT Vbx_owe_oil_drn_req_clc "Oil drain requested by the strategy" UBYTE _CNV_R_R_VA_I_16_449_CM 1 0. 0. 1. ECU_ADDRESS 0xd000559e FORMAT "%6.2" BIT_MASK 0x1 /end MEASUREMENT
/begin MEASUREMENT Vbx_owe_oil_drn_req_mux "Oil drain requested by the strategy sent on can interface" UBYTE _CNV_R_R_VA_I_16_449_CM 1 0. 0. 1. ECU_ADDRESS 0xd00051e2 FORMAT "%6.2" BIT_MASK 0x1 /end MEASUREMENT
/begin MEASUREMENT Vbx_owe_oil_drn_req_mux_raw "Oil drain requested by the strategy (level 2) before replacement value" UBYTE _CNV_R_R_VA_I_16_449_CM 1 0. 0. 1. ECU_ADDRESS 0xd00055a6 FORMAT "%6.2" BIT_MASK 0x1 /end MEASUREMENT
/begin MEASUREMENT Vbx_owe_prg "Boolean variable to forbid an OCS event after an ECU reprogrammation" UBYTE _CNV_R_R_VA_I_16_449_CM 1 0. 0. 1. ECU_ADDRESS 0xd00055a7 FORMAT "%6.2" BIT_MASK 0x1 /end MEASUREMENT
/begin MEASUREMENT Vbx_owe_ref_2_ok "Point 2 learned" UBYTE _CNV_R_R_VA_I_16_449_CM 1 0. 0. 1. ECU_ADDRESS 0xd000550c FORMAT "%6.2" BIT_MASK 0x1 /end MEASUREMENT
/begin MEASUREMENT Vbx_owe_ref_2_upd "Point 2 up-dated" UBYTE _CNV_R_R_VA_I_16_449_CM 1 0. 0. 1. ECU_ADDRESS 0xd000550d FORMAT "%6.2" BIT_MASK 0x1 /end MEASUREMENT
/begin MEASUREMENT Vbx_owe_req_km_2_clc "Boolean set if the oil dilution threshold is passed" UBYTE _CNV_R_R_VA_I_16_449_CM 1 0. 0. 1. ECU_ADDRESS 0xd00051e4 FORMAT "%6.2" BIT_MASK 0x1 /end MEASUREMENT
/begin MEASUREMENT Vbx_owe_warn_req "Set when the pre-alert is requered to memorize the vehicle kilometers." UBYTE _CNV_R_R_VA_I_16_449_CM 1 0. 0. 1. ECU_ADDRESS 0xd00051e3 FORMAT "%6.2" BIT_MASK 0x1 /end MEASUREMENT
/begin MEASUREMENT Vbx_owe_warn_req_km_clc "Set when the pre-alert is requered to memorize the vehicle kilometers. (calculated value)" UBYTE _CNV_R_R_VA_I_16_449_CM 1 0. 0. 1. ECU_ADDRESS 0xd000559f FORMAT "%6.2" BIT_MASK 0x1 /end MEASUREMENT
/begin MEASUREMENT Vbx_ptc_rov "Turbo water cooling pump command before monitool" UBYTE _CNV_R_R_VA_I_16_449_CM 1 0. 0. 1. ECU_ADDRESS 0xd000577c FORMAT "%6.2" BIT_MASK 0x1 /end MEASUREMENT
/begin MEASUREMENT Vbx_ptc_rov_cmd "PTC anti-icing output state" UBYTE _CNV_R_R_VA_I_16_449_CM 1 0. 0. 1. ECU_ADDRESS 0xd000577b FORMAT "%6.2" BIT_MASK 0x1 /end MEASUREMENT
/begin MEASUREMENT Vxx_owe_ant "Anticipation factor to converge to the  one by one  kilometer decrement" UWORD _CNV_R_R_RB_CONV_Di_477_CM 1 0. 0. 65535. ECU_ADDRESS 0xd000594a FORMAT "%12.2" /end MEASUREMENT
/begin MEASUREMENT Vxx_owe_km1_prev "Previous oil kilometer value for the first reference point" UWORD _CNV_R_R_RB_CONV_Di_477_CM 1 0. 0. 65535. ECU_ADDRESS 0xd000594c FORMAT "%12.2" /end MEASUREMENT
/begin MEASUREMENT Vxx_owe_km2_prev "Previous oil kilometer value for the second reference point" UWORD _CNV_R_R_RB_CONV_Di_477_CM 1 0. 0. 65535. ECU_ADDRESS 0xd000594e FORMAT "%12.2" /end MEASUREMENT
/begin MEASUREMENT Vxx_owe_km_sat_max "Oil potential kilometer maximal saturation value" UWORD _CNV_R_R_RB_CONV_Di_477_CM 1 0. 0. 65535. ECU_ADDRESS 0xd0005a00 FORMAT "%12.2" /end MEASUREMENT
/begin MEASUREMENT Vxx_owe_km_slop "Slop of the remainig kilometers" UWORD _CNV_R_R_RB_CONV_00_486_CM 1 0. 0. 196.605 ECU_ADDRESS 0xd0005950 /end MEASUREMENT
/begin MEASUREMENT Vxx_owe_km_var1 "Smoothed kilometer intermediary variable" ULONG _CNV_R_R_RB_CONV_di_485_CM 1 0. 0. 65535000. ECU_ADDRESS 0xd0002af0 FORMAT "%12.2" /end MEASUREMENT
/begin MEASUREMENT Vxx_owe_km_var2 "Smoothed kilometer intermediary variable" ULONG _CNV_R_R_RB_CONV_di_485_CM 1 0. 0. 65535000. ECU_ADDRESS 0xd0002af4 FORMAT "%12.2" /end MEASUREMENT
/begin MEASUREMENT Vxx_owe_km_var3 "Smoothed kilometer intermediary variable" UWORD _CNV_R_R_RB_CONV_di_487_CM 1 0. 0. 196605. ECU_ADDRESS 0xd0005968 FORMAT "%12.2" /end MEASUREMENT
/begin MEASUREMENT Vxx_owe_pot_km "Oil potential kilometers calculated" UWORD _CNV_R_R_RB_CONV_Di_477_CM 1 0. 0. 65535. ECU_ADDRESS 0xd00059fe FORMAT "%12.2" /end MEASUREMENT
/begin MEASUREMENT Vxx_owe_pot_km_clc "Oil potential kilometers calculated" UWORD _CNV_R_R_RB_CONV_Di_477_CM 1 0. 0. 65535. ECU_ADDRESS 0xd0005948 FORMAT "%12.2" /end MEASUREMENT
/begin MEASUREMENT Vxx_owe_pot_km_clc_2 "Oil potential kilometers calculated" UWORD _CNV_R_R_RB_CONV_Di_477_CM 1 0. 0. 65535. ECU_ADDRESS 0xd0005a02 FORMAT "%12.2" /end MEASUREMENT
/begin MEASUREMENT Vxx_owe_pot_km_pot_oxy_dil "Oil potential kilometers from oil oxidation and dilution factor" UWORD _CNV_R_R_RB_CONV_Di_477_CM 1 0. 0. 65535. ECU_ADDRESS 0xc0000c18 FORMAT "%12.2" /end MEASUREMENT
/begin MEASUREMENT Vxx_owe_pot_km_prev "Previous oil potential kilometers" UWORD _CNV_R_R_RB_CONV_Di_477_CM 1 0. 0. 65535. ECU_ADDRESS 0xd0005952 FORMAT "%12.2" /end MEASUREMENT
/begin MEASUREMENT Vxx_owe_pot_km_rnd "Rounded oil potential meters" ULONG _CNV_R_R_RB_CONV_di_485_CM 1 0. 0. 65535000. ECU_ADDRESS 0xd0002af8 FORMAT "%12.2" /end MEASUREMENT
/begin MEASUREMENT Vxx_owe_pot_km_step "Potential kilometer  one by one  decremented" UWORD _CNV_R_R_RB_CONV_Di_477_CM 1 0. 0. 65535. ECU_ADDRESS 0xd0005954 FORMAT "%12.2" /end MEASUREMENT
/begin MEASUREMENT Vxx_owe_prev_drn_dist_prev "Previous rounded oil kilometers" UWORD _CNV_R_R_RB_CONV_Di_477_CM 1 0. 0. 65535. ECU_ADDRESS 0xd0005956 FORMAT "%12.2" /end MEASUREMENT
/begin MEASUREMENT Vxx_owe_raw_pot_km "Raw oil potential kilometers" UWORD _CNV_R_R_RB_CONV_Di_477_CM 1 0. 0. 65535. ECU_ADDRESS 0xd0005958 FORMAT "%12.2" /end MEASUREMENT
/begin MEASUREMENT Vxx_owe_raw_pot_km_prev "Previous raw oil potential kilometers" UWORD _CNV_R_R_RB_CONV_Di_477_CM 1 0. 0. 65535. ECU_ADDRESS 0xd000595a FORMAT "%12.2" /end MEASUREMENT
/begin MEASUREMENT Vxx_owe_wea1_prev "Previous oil wear when the first point is learned" UWORD _CNV_R_R_RB_CONV_1__484_CM 1 0. 0. 1. ECU_ADDRESS 0xd000595c FORMAT "%6.6" /end MEASUREMENT
/begin MEASUREMENT Vxx_owe_wea2_prev "Previous oil wear when the second point is learned" UWORD _CNV_R_R_RB_CONV_1__484_CM 1 0. 0. 1. ECU_ADDRESS 0xd000595e FORMAT "%6.6" /end MEASUREMENT
/begin MEASUREMENT Vxx_owe_wea_act "Actual oil wear" UWORD _CNV_R_R_RB_CONV_1__484_CM 1 0. 0. 1. ECU_ADDRESS 0xd0005960 FORMAT "%6.6" /end MEASUREMENT
/begin MEASUREMENT Vxx_owe_wea_act_pot "Actual potential oil wear" UWORD _CNV_R_R_RB_CONV_1__484_CM 1 0. 0. 1. ECU_ADDRESS 0xd0005962 FORMAT "%6.6" /end MEASUREMENT
/begin MEASUREMENT Vxx_owe_wea_act_prev "Previous actual potential oil wear" UWORD _CNV_R_R_RB_CONV_1__484_CM 1 0. 0. 1. ECU_ADDRESS 0xd0005964 FORMAT "%6.6" /end MEASUREMENT
/begin MEASUREMENT Vxx_owe_wea_spd "Oil wearing speed" UWORD _CNV_R_R_RB_CONV_00_488_CM 1 0. 0. 6.5535e-003 ECU_ADDRESS 0xd0005966 FORMAT "%6.8" /end MEASUREMENT
/begin CHARACTERISTIC Cbx_oil_heat_abst_pres_cho "Choice manager of presence of oil vapours heater" VALUE 0xa0020b2f _REC_S1VAL_Normal_u1 1. _CNV_R_R_VA_I_16_449_CM 0. 1. FORMAT "%6.2" /end CHARACTERISTIC
/begin CHARACTERISTIC Cbx_owe_avl "Calibration to send on can when the function is  off" VALUE 0xa002155e _REC_S1VAL_Normal_u1 1. _CNV_R_R_VA_I_16_449_CM 0. 1. FORMAT "%6.2" /end CHARACTERISTIC
/begin CHARACTERISTIC Cbx_owe_avl_2 "Calibration to send on can when the function is  off" VALUE 0xa002155f _REC_S1VAL_Normal_u1 1. _CNV_R_R_VA_I_16_449_CM 0. 1. FORMAT "%6.2" /end CHARACTERISTIC
/begin CHARACTERISTIC Cbx_owe_dil_req_2_ena "Calibration to enable the dasboard alert on dilution condition" VALUE 0xa0021560 _REC_S1VAL_Normal_u1 1. _CNV_R_R_VA_I_16_449_CM 0. 1. FORMAT "%6.2" /end CHARACTERISTIC
/begin CHARACTERISTIC Cbx_owe_ena_1 "Calibration of the output bits truth table" VALUE 0xa0021561 _REC_S1VAL_Normal_u1 1. _CNV_R_R_VA_I_16_449_CM 0. 1. FORMAT "%6.2" /end CHARACTERISTIC
/begin CHARACTERISTIC Cbx_owe_ena_2 "Calibration of the output bits truth table" VALUE 0xa0021562 _REC_S1VAL_Normal_u1 1. _CNV_R_R_VA_I_16_449_CM 0. 1. FORMAT "%6.2" /end CHARACTERISTIC
/begin CHARACTERISTIC Cbx_owe_ena_3 "Calibration of the output bits truth table" VALUE 0xa0021563 _REC_S1VAL_Normal_u1 1. _CNV_R_R_VA_I_16_449_CM 0. 1. FORMAT "%6.2" /end CHARACTERISTIC
/begin CHARACTERISTIC Cbx_owe_ena_4 "Calibration of the output bits truth table" VALUE 0xa0021564 _REC_S1VAL_Normal_u1 1. _CNV_R_R_VA_I_16_449_CM 0. 1. FORMAT "%6.2" /end CHARACTERISTIC
/begin CHARACTERISTIC Cbx_owe_ena_5 "Calibration of the output bits truth table" VALUE 0xa0021565 _REC_S1VAL_Normal_u1 1. _CNV_R_R_VA_I_16_449_CM 0. 1. FORMAT "%6.2" /end CHARACTERISTIC
/begin CHARACTERISTIC Cbx_owe_ena_6 "Calibration of the output bits truth table" VALUE 0xa0021566 _REC_S1VAL_Normal_u1 1. _CNV_R_R_VA_I_16_449_CM 0. 1. FORMAT "%6.2" /end CHARACTERISTIC
/begin CHARACTERISTIC Cbx_owe_ena_7 "Calibration of the output bits truth table" VALUE 0xa0021567 _REC_S1VAL_Normal_u1 1. _CNV_R_R_VA_I_16_449_CM 0. 1. FORMAT "%6.2" /end CHARACTERISTIC
/begin CHARACTERISTIC Cbx_owe_ena_8 "Calibration of the output bits truth table" VALUE 0xa0021568 _REC_S1VAL_Normal_u1 1. _CNV_R_R_VA_I_16_449_CM 0. 1. FORMAT "%6.2" /end CHARACTERISTIC
/begin CHARACTERISTIC Cbx_owe_hmi_warn "Choice manager of alert pre-alert hmi" VALUE 0xa0020b2e _REC_S1VAL_Normal_u1 1. _CNV_R_R_VA_I_16_449_CM 0. 1. FORMAT "%6.2" /end CHARACTERISTIC
/begin CHARACTERISTIC Cbx_owe_sat_ena "Calibration to enable the saturation made by the initial potential kilometer" VALUE 0xa0021260 _REC_S1VAL_Normal_u1 1. _CNV_R_R_VA_I_16_449_CM 0. 1. FORMAT "%6.2" /end CHARACTERISTIC
/begin CHARACTERISTIC Cxx_dfdec_ptc_rov_oc "ou_clo_luo_ptcgixx/Circuit Open of oil vapors heater detected failure counter decrement" VALUE 0xa002194a _REC_S1VAL_Normal_u2 65535. _CNV_R_R_VA_I_16_449_CM 0. 65535. FORMAT "%6.2" /end CHARACTERISTIC
/begin CHARACTERISTIC Cxx_dfdec_ptc_rov_scg "ou_clo_luo_ptcgixx Circuit Short to Ground of oil vapors heater detected failure counter decrement" VALUE 0xa002194c _REC_S1VAL_Normal_u2 65535. _CNV_R_R_VA_I_16_449_CM 0. 65535. FORMAT "%6.2" /end CHARACTERISTIC
/begin CHARACTERISTIC Cxx_dfdec_ptc_rov_scw "ou_clo_luo_ptcgixx Circuit Short to Battery of oil vapors heater detected failure counter decrement" VALUE 0xa002194e _REC_S1VAL_Normal_u2 65535. _CNV_R_R_VA_I_16_449_CM 0. 65535. FORMAT "%6.2" /end CHARACTERISTIC
/begin CHARACTERISTIC Cxx_dfinc_ptc_rov_oc "ou_clo_luo_ptcgixx Circuit Open of oil vapors heater detected failure counter increment" VALUE 0xa0021950 _REC_S1VAL_Normal_u2 65535. _CNV_R_R_VA_I_16_449_CM 0. 65535. FORMAT "%6.2" /end CHARACTERISTIC
/begin CHARACTERISTIC Cxx_dfinc_ptc_rov_scg "ou_clo_luo_ptcgixx Circuit Short to Ground of oil vapors heater detected failure counter increment" VALUE 0xa0021952 _REC_S1VAL_Normal_u2 65535. _CNV_R_R_VA_I_16_449_CM 0. 65535. FORMAT "%6.2" /end CHARACTERISTIC
/begin CHARACTERISTIC Cxx_dfinc_ptc_rov_scw "ou_clo_luo_ptcgixx Circuit Short to Battery of oil vapors heater detected failure counter increment" VALUE 0xa0021954 _REC_S1VAL_Normal_u2 65535. _CNV_R_R_VA_I_16_449_CM 0. 65535. FORMAT "%6.2" /end CHARACTERISTIC
/begin CHARACTERISTIC Cxx_owe_avl "Calibration to send on can when the function is  off" VALUE 0xa0021256 _REC_S1VAL_Normal_u2 65535. _CNV_R_R_RB_CONV_Di_477_CM 0. 65535. FORMAT "%12.2" /end CHARACTERISTIC
/begin CHARACTERISTIC Cxx_owe_drn_dist_max_prg "Calibration to forbid an OCS event after an ECU reprogrammation" VALUE 0xa002155c _REC_S1VAL_Normal_u2 65535. _CNV_R_R_RB_CONV_Di_477_CM 0. 65535. FORMAT "%12.2" /end CHARACTERISTIC
/begin CHARACTERISTIC Cxx_owe_drn_req_dly "Calibration of the duration to maintain the drain request signal." VALUE 0xa002155a _REC_S1VAL_Normal_u2 6553.5 _CNV_R_R_RB_CONV_Ti_483_CM 0. 6553.5 FORMAT "%8.2" /end CHARACTERISTIC
/begin CHARACTERISTIC Cxx_owe_km1 "Kilometer threshold to learn the first point" VALUE 0xa0021bd8 _REC_S1VAL_Normal_u2 65535. _CNV_R_R_RB_CONV_Di_477_CM 0. 65535. FORMAT "%12.2" /end CHARACTERISTIC
/begin CHARACTERISTIC Cxx_owe_km2 "Kilometer threshold to learn the second point (first time)" VALUE 0xa0021bda _REC_S1VAL_Normal_u2 65535. _CNV_R_R_RB_CONV_Di_477_CM 0. 65535. FORMAT "%12.2" /end CHARACTERISTIC
/begin CHARACTERISTIC Cxx_owe_km3 "Potential kilometers before switching to  one by one  kilometer decrement" VALUE 0xa0021bdc _REC_S1VAL_Normal_u2 65535. _CNV_R_R_RB_CONV_Di_477_CM 0. 65535. FORMAT "%12.2" /end CHARACTERISTIC
/begin CHARACTERISTIC Cxx_owe_km4 "Potential kilometer to convergne to the  one by one  decrement in the end of potential" VALUE 0xa0021bde _REC_S1VAL_Normal_u2 65535. _CNV_R_R_RB_CONV_Di_477_CM 0. 65535. FORMAT "%12.2" /end CHARACTERISTIC
/begin CHARACTERISTIC Cxx_owe_km5 "Potential kilometer when the remainnig km is converged to the  one by one" VALUE 0xa0021be0 _REC_S1VAL_Normal_u2 65535. _CNV_R_R_RB_CONV_Di_477_CM 0. 65535. FORMAT "%12.2" /end CHARACTERISTIC
/begin CHARACTERISTIC Cxx_owe_km7 "Saturation of the potential kilometer" VALUE 0xa0021258 _REC_S1VAL_Normal_u2 65535. _CNV_R_R_RB_CONV_Di_477_CM 0. 65535. FORMAT "%12.2" /end CHARACTERISTIC
/begin CHARACTERISTIC Cxx_owe_km_slop_max "Maximal slope of the potential km sended to the customer" VALUE 0xa0021be2 _REC_S1VAL_Normal_u2 196.605 _CNV_R_R_RB_CONV_00_486_CM 0. 196.605 /end CHARACTERISTIC
/begin CHARACTERISTIC Cxx_owe_km_slop_min "Minimal slope of the potential km sended to the customer" VALUE 0xa0021be4 _REC_S1VAL_Normal_u2 196.605 _CNV_R_R_RB_CONV_00_486_CM 0. 196.605 /end CHARACTERISTIC
/begin CHARACTERISTIC Cxx_owe_oil_dil_max_km "Maximal traveled kilometers to allow  oil dilution alert" VALUE 0xa002125a _REC_S1VAL_Normal_u2 65535. _CNV_R_R_RB_CONV_Di_477_CM 0. 65535. FORMAT "%12.2" /end CHARACTERISTIC
/begin CHARACTERISTIC Cxx_owe_oil_dil_min_km "Minimal traveled kilometers to allow  oil dilution alert" VALUE 0xa002125c _REC_S1VAL_Normal_u2 65535. _CNV_R_R_RB_CONV_Di_477_CM 0. 65535. FORMAT "%12.2" /end CHARACTERISTIC
/begin CHARACTERISTIC Cxx_owe_oil_dil_thd "Maximal oil dilution rate" VALUE 0xa002125e _REC_S1VAL_Normal_u2 100. _CNV_R_R_RB_CONV_10_473_CM 0. 100. FORMAT "%6.4" /end CHARACTERISTIC
/begin CHARACTERISTIC Cxx_ptc_rov_tia_hys "Air temperature hysterisis for PTC anti-icing command" VALUE 0xa0021956 _REC_S1VAL_Normal_u2 240. _CNV_R_R_RB_CONV_De_474_CM -40. 200. FORMAT "%8.2" /end CHARACTERISTIC
/begin CHARACTERISTIC Cxx_ptc_rov_tia_thd "Air temperature threshold for PTC anti-icing command" VALUE 0xa0021958 _REC_S1VAL_Normal_u2 240. _CNV_R_R_RB_CONV_De_474_CM -40. 200. FORMAT "%8.2" /end CHARACTERISTIC
/begin MEASUREMENT Vbx_df_ptc_rov_oc "Circuit Open of oil vapors heater detected failure" UBYTE _CNV_S_2_RANGE______3_CM 1 0. 0. 1. ECU_ADDRESS 0xd0004667 BIT_MASK 0x1 /end MEASUREMENT
/begin MEASUREMENT Vbx_df_ptc_rov_scg "Circuit Short to Ground of oil vapors heater detected failure" UBYTE _CNV_S_2_RANGE______3_CM 1 0. 0. 1. ECU_ADDRESS 0xd0004666 BIT_MASK 0x1 /end MEASUREMENT
/begin MEASUREMENT Vbx_df_ptc_rov_scw "Circuit Short to Battery of oil vapors heater detected failure" UBYTE _CNV_S_2_RANGE______3_CM 1 0. 0. 1. ECU_ADDRESS 0xd0004665 BIT_MASK 0x1 /end MEASUREMENT
/begin MEASUREMENT Vbx_diag_ena_ptc_rov_oc "Circuit Open of oil vapors heater diagnosis authorization" UBYTE _CNV_S_2_RANGE______3_CM 1 0. 0. 1. ECU_ADDRESS 0xd000466a BIT_MASK 0x1 /end MEASUREMENT
/begin MEASUREMENT Vbx_diag_ena_ptc_rov_scg "Circuit Short to Ground of oil vapors heater diagnosis authorization" UBYTE _CNV_S_2_RANGE______3_CM 1 0. 0. 1. ECU_ADDRESS 0xd0004669 BIT_MASK 0x1 /end MEASUREMENT
/begin MEASUREMENT Vbx_diag_ena_ptc_rov_scw "Circuit Short to Battery of oil vapors heater diagnosis authorization" UBYTE _CNV_S_2_RANGE______3_CM 1 0. 0. 1. ECU_ADDRESS 0xd0004668 BIT_MASK 0x1 /end MEASUREMENT
/begin MEASUREMENT lv_oil_heat "Oil heater control command state" UBYTE _CNV_S_2_RANGE______3_CM 1 0. 0. 1. ECU_ADDRESS 0xd0004663 BIT_MASK 0x1 /end MEASUREMENT
/begin MEASUREMENT lv_oil_heat_pres "Presence of oil heater vapours" UBYTE _CNV_S_2_RANGE______3_CM 1 0. 0. 1. ECU_ADDRESS 0xd0004664 BIT_MASK 0x1 /end MEASUREMENT
/begin MEASUREMENT dur_work_ecu "Utilization duration of the ECM" ULONG _CNV_A_R_LINEAR_____489_CM 1 0. 0. 2048000000. ECU_ADDRESS 0xd0001d1e FORMAT "%12.0" /end MEASUREMENT
/begin MEASUREMENT t_on_ecu "Key ON duration" UWORD _CNV_A_R_LINEAR_____490_CM 1 0. 0. 65535. ECU_ADDRESS 0xd0003660 FORMAT "%5.0" /end MEASUREMENT
/begin MEASUREMENT Vbx_blow_det "The blow by phenomenon is detected" UBYTE _CNV_S_2_RANGE______3_CM 1 0. 0. 1. ECU_ADDRESS 0xd00056bc BIT_MASK 0x1 /end MEASUREMENT
/begin MEASUREMENT Vbx_diag_in_vvtc_n_cdn_nok "stub" UBYTE _CNV_S_2_RANGE______3_CM 1 0. 0. 1. ECU_ADDRESS 0xd000431c /end MEASUREMENT
/begin MEASUREMENT Vbx_evap_dgn "Flag indicating canister purge not active and DIAGCP active (1), or the opposite (0)" UBYTE _CNV_S_2_RANGE______3_CM 1 0. 0. 1. ECU_ADDRESS 0xd00056be BIT_MASK 0x1 /end MEASUREMENT
/begin MEASUREMENT Vbx_raw_wf_ac_req "" UBYTE _CNV_S_2_RANGE______3_CM 1 0. 0. 1. ECU_ADDRESS 0xd00056bf BIT_MASK 0x1 /end MEASUREMENT
/begin MEASUREMENT Vbx_wf_ac_req_cfm "Wire frame air conditionning request presence configuration boolean (1 = wire frame present)" UBYTE _CNV_S_2_RANGE______3_CM 1 0. 0. 1. ECU_ADDRESS 0xd00056c0 BIT_MASK 0x1 /end MEASUREMENT
/begin MEASUREMENT Vbx_wf_comp_cfa_cfm "Wire frame passenger compartment cooling fan presence configuration boolean (1 = wire frame present)" UBYTE _CNV_S_2_RANGE______3_CM 1 0. 0. 1. ECU_ADDRESS 0xd00056c2 BIT_MASK 0x1 /end MEASUREMENT
/begin MEASUREMENT Vxx_wg_fuel_typ_rat "Ratio dedicated to the boost pressure correction adjustment" UWORD _CNV_A_R_LINEAR_____108_CM 1 0. 0. 1. ECU_ADDRESS 0xd000580a /end MEASUREMENT
/begin MEASUREMENT lv_immo_unlock_auth "Flag to indicate if unlock is authorized" UBYTE _CNV_S_2_RANGE______3_CM 1 0. 0. 1. ECU_ADDRESS 0xd00013e3 BIT_MASK 0x1 /end MEASUREMENT
/begin COMPU_METHOD _CNV_A_R_ECME_LINEA_0_CM "" RAT_FUNC "%6.3" "-" COEFFS 0 1. 0. 0 0 1 /end COMPU_METHOD
/begin COMPU_METHOD _CNV_A_R_LINEAR_____2_CM "" RAT_FUNC "%6.3" "rpm" COEFFS 0 3.125e-002 0. 0 0 1 /end COMPU_METHOD
/begin COMPU_METHOD _CNV_S_2_RANGE______3_CM "" TAB_VERB "%6.3" "-" COMPU_TAB_REF _CNV_S_2_RANGE______3 /end COMPU_METHOD
/begin COMPU_VTAB _CNV_S_2_RANGE______3 "" TAB_VERB 2 0 "0" 1 "1" /end COMPU_VTAB
/begin COMPU_METHOD _CNV_A_R_LINEAR_____4_CM "" RAT_FUNC "%6.3" "s" COEFFS 0 10. 0. 0 0 1 /end COMPU_METHOD
/begin COMPU_METHOD _CNV_A_R_LINEAR_____5_CM "" RAT_FUNC "%6.3" "hPa" COEFFS 0 12.06017666543982 0. 0 0 1 /end COMPU_METHOD
/begin COMPU_METHOD _CNV_S_15_RANGE_SYM__6_CM "" TAB_VERB "%6.3" "-" COMPU_TAB_REF _CNV_S_15_RANGE_SYM__6 /end COMPU_METHOD
/begin COMPU_VTAB _CNV_S_15_RANGE_SYM__6 "" TAB_VERB 15 0 "NO_SYM" 1 "CYL_0" 2 "CYL_1" 4 "CYL_2" 8 "CYL_3" 16 "CYL_4" 32 "CYL_5" 64 "CYL_6" 128 "CYL_7" 256 "CYL_8" 512 "CYL_9" 1024 "CYL_10" 2048 "CYL_11" 4096 "RND" 8192 "MPL" /end COMPU_VTAB
/begin COMPU_METHOD _CNV_A_R_CPULOAD__0_7_CM "" RAT_FUNC "%6.3" "%" COEFFS 0 10.24 0. 0 0 1 /end COMPU_METHOD
/begin COMPU_METHOD _CNV_A_R_LINEAR_____16_CM "" RAT_FUNC "%6.3" "V" COEFFS 0 6553.599999999993 0. 0 0 1 /end COMPU_METHOD
/begin COMPU_METHOD _CNV_A_R_LINEAR_____19_CM "" RAT_FUNC "%6.3" "V" COEFFS 0 1598.439195529102 0. 0 0 1 /end COMPU_METHOD
/begin COMPU_METHOD _CNV_A_R_LINEAR_____25_CM "" RAT_FUNC "%6.3" "∞CRK" COEFFS 0 2.666666666666667 0. 0 0 1 /end COMPU_METHOD
/begin COMPU_METHOD _CNV_A_R_LINEAR_____33_CM "" RAT_FUNC "%6.3" "-" COEFFS 0 1. -1. 0 0 1 /end COMPU_METHOD
/begin COMPU_METHOD _CNV_A_R_LINEAR_____40_CM "" RAT_FUNC "%6.3" "ms" COEFFS 0 0.1 0. 0 0 1 /end COMPU_METHOD
/begin COMPU_METHOD _CNV_A_R_LINEAR_____41_CM "" RAT_FUNC "%6.3" "V" COEFFS 0 9.846153846153847 0. 0 0 1 /end COMPU_METHOD
/begin COMPU_METHOD _CNV_A_R_LINEAR_____42_CM "" RAT_FUNC "%6.3" "∞C" COEFFS 0 1.333333333333333 64. 0 0 1 /end COMPU_METHOD
/begin COMPU_METHOD _CNV_A_R_LINEAR_____44_CM "" RAT_FUNC "%6.3" "ms" COEFFS 0 250. 0. 0 0 1 /end COMPU_METHOD
/begin COMPU_METHOD _CNV_A_R_IGRE_LINEA_48_CM "" RAT_FUNC "%6.3" "∞CRK" COEFFS 0 2.666666666666667 63. 0 0 1 /end COMPU_METHOD
/begin COMPU_METHOD _CNV_A_R_LINEAR_____52_CM "" RAT_FUNC "%6.3" "mV" COEFFS 0 1. 0. 0 0 1 /end COMPU_METHOD
/begin COMPU_METHOD _CNV_A_R_LINEAR_____54_CM "" RAT_FUNC "%6.3" "∞C" COEFFS 0 10. 400. 0 0 1 /end COMPU_METHOD
/begin COMPU_METHOD _CNV_A_R_LINEAR_____55_CM "" RAT_FUNC "%6.3" "TDC" COEFFS 0 1. 0. 0 0 1 /end COMPU_METHOD
/begin COMPU_METHOD _CNV_A_R_LINEAR_____57_CM "" RAT_FUNC "%6.3" "hPa" COEFFS 0 1. 0. 0 0 1 /end COMPU_METHOD
/begin COMPU_METHOD _CNV_A_R_LINEAR_____82_CM "" RAT_FUNC "%6.3" "s" COEFFS 0 1. 0. 0 0 1 /end COMPU_METHOD
/begin COMPU_METHOD _CNV_A_R_LINEAR_____83_CM "" RAT_FUNC "%6.3" "mg/stk" COEFFS 0 390.625 0. 0 0 1 /end COMPU_METHOD
/begin COMPU_METHOD _CNV_A_R_LINEAR_____108_CM "" RAT_FUNC "%6.3" "-" COEFFS 0 1000. 0. 0 0 1 /end COMPU_METHOD
/begin COMPU_METHOD _CNV_A_R_LINEAR_____114_CM "" RAT_FUNC "%6.3" "%" COEFFS 0 2.55 0. 0 0 1 /end COMPU_METHOD
/begin COMPU_METHOD _CNV_A_R_LINEAR_____118_CM "" RAT_FUNC "%6.3" "-" COEFFS 0 255. 0. 0 0 1 /end COMPU_METHOD
/begin COMPU_METHOD _CNV_S_3_STATUS_OK__120_CM "" TAB_VERB "%6.3" "-" COMPU_TAB_REF _CNV_S_3_STATUS_OK__120 /end COMPU_METHOD
/begin COMPU_VTAB _CNV_S_3_STATUS_OK__120 "" TAB_VERB 3 0 "Nsx_vld_nok_0" 1 "Nsx_vld_ok_1" 2 "Nsx_vld_fail_2" /end COMPU_VTAB
/begin COMPU_METHOD _CNV_A_R_LINEAR_____122_CM "" RAT_FUNC "%6.3" "%" COEFFS 0 655.35 0. 0 0 1 /end COMPU_METHOD
/begin COMPU_METHOD _CNV_A_R_LINEAR_____123_CM "" RAT_FUNC "%6.3" "Nm" COEFFS 0 32. 0. 0 0 1 /end COMPU_METHOD
/begin COMPU_METHOD _CNV_A_R_LINEAR_____136_CM "" RAT_FUNC "%6.3" "-" COEFFS 0 100. 0. 0 0 1 /end COMPU_METHOD
/begin COMPU_METHOD _CNV_S_16_RANGE_ERR__147_CM "" TAB_VERB "%6.3" "-" COMPU_TAB_REF _CNV_S_16_RANGE_ERR__147 /end COMPU_METHOD
/begin COMPU_VTAB _CNV_S_16_RANGE_ERR__147 "" TAB_VERB 16 0 "NO_SYM" 1 "SYM_0" 2 "SYM_1" 3 "SYM_0, SYM_1" 4 "SYM_2" 5 "SYM_0, SYM_2" 6 "SYM_1, SYM_2" 7 "SYM_0, SYM_1, SYM_2" 8 "SYM_3" 9 "SYM_0, SYM_3" 10 "SYM_1, SYM_3" 11 "SYM_0, SYM_1,SYM_3" 12 "SYM_2, SYM_3" 13 "SYM_0, SYM_2, SYM_3" 14 "SYM_1, SYM_2, SYM_3" 15 "SYM_0, SYM_1, SYM_2, SYM_3" /end COMPU_VTAB
/begin COMPU_METHOD _CNV_A_R_LINEAR_____149_CM "" RAT_FUNC "%6.3" "V" COEFFS 0 6553.599999999997 -1.455191522836685e-011 0 0 1 /end COMPU_METHOD
/begin COMPU_METHOD _CNV_S_16_RANGE_ERR__151_CM "" TAB_VERB "%6.3" "" COMPU_TAB_REF _CNV_S_16_RANGE_ERR__151 /end COMPU_METHOD
/begin COMPU_VTAB _CNV_S_16_RANGE_ERR__151 "" TAB_VERB 16 0 "NO_SYM" 1 "SYM_0" 2 "SYM_1" 3 "SYM_0, SYM_1" 4 "SYM_2" 5 "SYM_0, SYM_2" 6 "SYM_1, SYM_2" 7 "SYM_0, SYM_1, SYM_2" 8 "SYM_3" 9 "SYM_0, SYM_3" 10 "SYM_1, SYM_3" 11 "SYM_0, SYM_1,SYM_3" 12 "SYM_2, SYM_3" 13 "SYM_0, SYM_2, SYM_3" 14 "SYM_1, SYM_2, SYM_3" 15 "SYM_0, SYM_1, SYM_2, SYM_3" /end COMPU_VTAB
/begin COMPU_METHOD _CNV_A_R_LINEAR_____152_CM "" RAT_FUNC "%6.3" "V" COEFFS 0 102.4 0. 0 0 1 /end COMPU_METHOD
/begin COMPU_METHOD _CNV_A_R_LINEAR_____153_CM "" RAT_FUNC "%6.3" "s" COEFFS 0 25. 0. 0 0 1 /end COMPU_METHOD
/begin COMPU_METHOD _CNV_A_R_LINEAR_____155_CM "" RAT_FUNC "%6.3" "%" COEFFS 0 2359.326061129711 0. 0 0 1 /end COMPU_METHOD
/begin COMPU_METHOD _CNV_A_R_LINEAR_____156_CM "" RAT_FUNC "%6.3" "%" COEFFS 0 327.68 0. 0 0 1 /end COMPU_METHOD
/begin COMPU_METHOD _CNV_A_R_A_165_CM "" RAT_FUNC "%6.3" "" COEFFS 0 1. 0. 0 0 1 /end COMPU_METHOD
/begin COMPU_METHOD _CNV_S_8_STATUS_OK__181_CM "" TAB_VERB "%6.3" "-" COMPU_TAB_REF _CNV_S_8_STATUS_OK__181 /end COMPU_METHOD
/begin COMPU_VTAB _CNV_S_8_STATUS_OK__181 "" TAB_VERB 8 0 "Nsx_vld_nok_0" 1 "Nsx_vld_ok_1" 2 "Nsx_vld_fail_2" 3 "Nsx_vld_fail_3" 4 "Nsx_vld_fail_4" 5 "Nsx_vld_fail_5" 6 "Nsx_vld_fail_6" 7 "Nsx_vld_fail_7" /end COMPU_VTAB
/begin COMPU_METHOD _CNV_A_R_LINEAR_____211_CM "" RAT_FUNC "%6.3" "%" COEFFS 0 800. 0. 0 0 1 /end COMPU_METHOD
/begin COMPU_METHOD _CNV_A_R_LINEAR_____212_CM "" RAT_FUNC "%6.3" "km/h" COEFFS 0 1. 0. 0 0 1 /end COMPU_METHOD
/begin COMPU_METHOD _CNV_S_2_STATUS_OK__214_CM "" TAB_VERB "%6.3" "-" COMPU_TAB_REF _CNV_S_2_STATUS_OK__214 /end COMPU_METHOD
/begin COMPU_VTAB _CNV_S_2_STATUS_OK__214 "" TAB_VERB 2 0 "Nsx_vld_nok_0" 1 "Nsx_vld_ok_1" /end COMPU_VTAB
/begin COMPU_METHOD _CNV_A_R_LINEAR_____215_CM "" RAT_FUNC "%6.3" "l" COEFFS 0 1. 0. 0 0 1 /end COMPU_METHOD
/begin COMPU_METHOD _CNV_A_R_LINEAR_____216_CM "" RAT_FUNC "%6.3" "ratio" COEFFS 0 255. 0. 0 0 1 /end COMPU_METHOD
/begin COMPU_METHOD _CNV_A_R_LINEAR_____220_CM "" RAT_FUNC "%6.3" "∞C" COEFFS 0 1. 40. 0 0 1 /end COMPU_METHOD
/begin COMPU_METHOD _CNV_A_R_LINEAR_____269_CM "" RAT_FUNC "%6.3" "V" COEFFS 0 204.8 0. 0 0 1 /end COMPU_METHOD
/begin COMPU_METHOD _CNV_A_R_LINEAR_____281_CM "" RAT_FUNC "%6.3" "mg/stk" COEFFS 0 0.183585313174946 0. 0 0 1 /end COMPU_METHOD
/begin COMPU_METHOD _CNV_R_R_VA_I_16_449_CM "" RAT_FUNC "%6.3" "-" COEFFS 0. 1. 0. 0. 0. 1. /end COMPU_METHOD
/begin COMPU_METHOD _CNV_S_6_RANGE_ERR__471_CM "" TAB_VERB "%6.3" "" COMPU_TAB_REF _CNV_S_6_RANGE_ERR__471 /end COMPU_METHOD
/begin COMPU_VTAB _CNV_S_6_RANGE_ERR__471 "" TAB_VERB 6 0 "NO_SYM" 1 "SYM_0" 2 "SYM_1" 4 "SYM_2" 8 "SYM_3" 15 "BENCH_MODE" /end COMPU_VTAB
/begin COMPU_METHOD _CNV_S_4_RANGE______472_CM "" TAB_VERB "%6.3" "" COMPU_TAB_REF _CNV_S_4_RANGE______472 /end COMPU_METHOD
/begin COMPU_VTAB _CNV_S_4_RANGE______472 "" TAB_VERB 4 0 "NO_RST" 1 "WARM_RST" 2 "COLD_RST" 3 "WTD_RST" /end COMPU_VTAB
/begin COMPU_METHOD _CNV_R_R_RB_CONV_10_473_CM "" RAT_FUNC "%6.3" "%" COEFFS 0. 65535. 0. 0. 0. 100. /end COMPU_METHOD
/begin COMPU_METHOD _CNV_R_R_RB_CONV_De_474_CM "" RAT_FUNC "%6.3" "deg C" COEFFS 0. 10. 400. 0. 0. 1. /end COMPU_METHOD
/begin COMPU_METHOD _CNV_R_R_RB_CONV_00_475_CM "" RAT_FUNC "%6.3" "%" COEFFS 0. 1000000. 0. 0. 0. 1. /end COMPU_METHOD
/begin COMPU_METHOD _CNV_A_R_A_476_CM "" RAT_FUNC "%6.3" "%" COEFFS 0 1. 0. 0 0 1 /end COMPU_METHOD
/begin COMPU_METHOD _CNV_R_R_RB_CONV_Di_477_CM "" RAT_FUNC "%6.3" "km" COEFFS 0. 1. 0. 0. 0. 1. /end COMPU_METHOD
/begin COMPU_METHOD _CNV_R_R_RB_CONV_1T_478_CM "" RAT_FUNC "%6.3" "trs" COEFFS 0. 1. 0. 0. 0. 1. /end COMPU_METHOD
/begin COMPU_METHOD _CNV_R_R_RB_CONV_10_479_CM "" RAT_FUNC "%6.3" "trs" COEFFS 0. 1. 0. 0. 0. 10. /end COMPU_METHOD
/begin COMPU_METHOD _CNV_R_R_RB_CONV_Re_480_CM "" RAT_FUNC "%6.3" "-" COEFFS 0. 1000. 0. 0. 0. 1. /end COMPU_METHOD
/begin COMPU_METHOD _CNV_R_R_RB_CONV_Re_481_CM "" RAT_FUNC "%6.3" "-" COEFFS 0. 10000. 0. 0. 0. 1. /end COMPU_METHOD
/begin COMPU_METHOD _CNV_R_R_RB_CONV_Tr_482_CM "" RAT_FUNC "%6.3" "trs" COEFFS 0. 10. 0. 0. 0. 1. /end COMPU_METHOD
/begin COMPU_METHOD _CNV_R_R_RB_CONV_Ti_483_CM "" RAT_FUNC "%6.3" "s" COEFFS 0. 10. 0. 0. 0. 1. /end COMPU_METHOD
/begin COMPU_METHOD _CNV_R_R_RB_CONV_1__484_CM "" RAT_FUNC "%6.3" "wu" COEFFS 0. 65535. 0. 0. 0. 1. /end COMPU_METHOD
/begin COMPU_METHOD _CNV_R_R_RB_CONV_di_485_CM "" RAT_FUNC "%6.3" "m" COEFFS 0. 1. 0. 0. 0. 1. /end COMPU_METHOD
/begin COMPU_METHOD _CNV_R_R_RB_CONV_00_486_CM "" RAT_FUNC "%6.3" "km/km" COEFFS 0. 1000. 0. 0. 0. 3. /end COMPU_METHOD
/begin COMPU_METHOD _CNV_R_R_RB_CONV_di_487_CM "" RAT_FUNC "%6.3" "m" COEFFS 0. 1. 0. 0. 0. 3. /end COMPU_METHOD
/begin COMPU_METHOD _CNV_R_R_RB_CONV_00_488_CM "" RAT_FUNC "%6.3" "1/km" COEFFS 0. 1. 0. 0. 0. 1.e-007 /end COMPU_METHOD
/begin COMPU_METHOD _CNV_A_R_LINEAR_____489_CM "" RAT_FUNC "%6.3" "[min]" COEFFS 0 1. 0. 0 0 1 /end COMPU_METHOD
/begin COMPU_METHOD _CNV_A_R_LINEAR_____490_CM "" RAT_FUNC "%6.3" "[s]" COEFFS 0 1. 0. 0 0 1 /end COMPU_METHOD
/begin RECORD_LAYOUT _REC_S1VAL_20_u1 FNC_VALUES 1 UBYTE COLUMN_DIR DIRECT /end RECORD_LAYOUT
/begin RECORD_LAYOUT _REC_A2AXS_20_u1 NO_AXIS_PTS_X 1 UBYTE AXIS_PTS_X 2 UBYTE INDEX_INCR DIRECT /end RECORD_LAYOUT
/begin RECORD_LAYOUT _REC_S1VAL_20_u2 FNC_VALUES 1 UWORD COLUMN_DIR DIRECT /end RECORD_LAYOUT
/begin RECORD_LAYOUT _REC_A2AXS_20_u2 NO_AXIS_PTS_X 1 UWORD AXIS_PTS_X 2 UWORD INDEX_INCR DIRECT /end RECORD_LAYOUT
/begin RECORD_LAYOUT _REC_A1CUR_20_u2_u1 FNC_VALUES 1 UWORD COLUMN_DIR DIRECT /end RECORD_LAYOUT
/begin RECORD_LAYOUT _REC_A1MAP_20_u2_u2_u2 FNC_VALUES 1 UWORD COLUMN_DIR DIRECT /end RECORD_LAYOUT
/begin RECORD_LAYOUT _REC_A1CUR_20_u2_u2 FNC_VALUES 1 UWORD COLUMN_DIR DIRECT /end RECORD_LAYOUT
/begin RECORD_LAYOUT _REC_S1VAL_Normal_u1 FNC_VALUES 1 UBYTE COLUMN_DIR DIRECT /end RECORD_LAYOUT
/begin RECORD_LAYOUT _REC_S1VAL_Normal_u2 FNC_VALUES 1 UWORD COLUMN_DIR DIRECT /end RECORD_LAYOUT
/begin RECORD_LAYOUT _REC_S1VAL_Normal_u4 FNC_VALUES 1 ULONG COLUMN_DIR DIRECT /end RECORD_LAYOUT
/begin FUNCTION TqSafTsm_TqMonxx ""
 /begin DEF_CHARACTERISTIC Ctb_sfty_esti_tqi Ctb_sfty_tqi_req Ctp_sfty_esti_tqi_pos_err Ctp_sfty_tqi_req_pos_err Cxx_dfdec_sfty_tq_chr Cxx_dfdec_sfty_tq_clc_chr Cxx_dfdec_sfty_tq_lih_chr Cxx_dfinc_sfty_tq_chr Cxx_dfinc_sfty_tq_clc_chr Cxx_dfinc_sfty_tq_lih_chr Cxx_sfty_cyl_nr Cxx_sfty_diag_ena_cata_dly Cxx_sfty_diag_ena_cata_dly_rst Cxx_sfty_diag_ena_eng_dly Cxx_sfty_diag_ena_eng_dly_rst Cxx_sfty_diag_ena_n_thd Cxx_sfty_diag_ena_tco_thd Cxx_sfty_err_esti_t_fil_step Cxx_sfty_esti_tqi_deb_dec Cxx_sfty_esti_tqi_deb_thd Cxx_sfty_esti_tqi_t_fil_step Cxx_sfty_ext_ctrl_bch_vs_thd Cxx_sfty_ext_ctrl_t Cxx_sfty_gear_cge_dec_dly Cxx_sfty_gear_cge_dec_dly_rst Cxx_sfty_rst_t Cxx_sfty_stop_req_igk_rst_t Cxx_sfty_thr_lih_mon_deb_dec Cxx_sfty_thr_lih_mon_deb_thd Cxx_sfty_tqi_sp_deb_dec Cxx_sfty_tqi_sp_deb_thd Cxx_sfty_tqi_sp_t_fil_step Cxx_sfty_vs_dsb_t Cxx_sfty_vs_dsb_vs_thd /end DEF_CHARACTERISTIC
 /begin OUT_MEASUREMENT Vbx_df_sfty_tq_chr Vbx_df_sfty_tq_clc_chr Vbx_df_sfty_tq_lih_chr Vbx_prev_df_sfty_tq_chr Vbx_sfty_aftr_rst Vbx_sfty_aftr_rst_ini Vbx_sfty_aftr_rst_mem Vbx_sfty_diag_ena_tqi Vbx_sfty_esti_tqi_nok Vbx_sfty_esti_tqi_nok_tmp Vbx_sfty_lih_mon_ena Vbx_sfty_moni_bch_ok Vbx_sfty_rst_req Vbx_sfty_stop_req Vbx_sfty_stop_req_aftr_rst Vbx_sfty_stop_req_mem Vbx_sfty_thr_lih_mon_nok_fil Vbx_sfty_tq_mon_nok Vbx_sfty_tqi_sp_nok Vbx_sfty_tqi_sp_nok_tmp Vbx_sfty_vs_dsb Vsx_sfty_tq_mon_vld Vxx_sfty_esti_err Vxx_sfty_esti_err_max Vxx_sfty_esti_tqi_t_fil_min Vxx_sfty_tq_ffm_data_sf Vxx_sfty_tqi_sp_t_fil_max Vxx_tqi_esti_sp_dif /end OUT_MEASUREMENT
/end FUNCTION
/begin FUNCTION DgEcuDft "" /begin SUB_FUNCTION DgEcuDft_Ecuhwfm DgEcuDft_Dataxxx /end SUB_FUNCTION /end FUNCTION
/begin FUNCTION DgEcuDft_Ecuhwfm ""
 /begin DEF_CHARACTERISTIC Cxx_dfdec_ecm_err_itl Cxx_dfdec_inj_ecu_itl Cxx_dfinc_ecm_err_itl Cxx_dfinc_inj_ecu_itl /end DEF_CHARACTERISTIC
 /begin OUT_MEASUREMENT Vsx_inj_ecu_vld Vsx_inj_ecu_vld_1 Vsx_inj_ecu_vld_init /end OUT_MEASUREMENT
/end FUNCTION
/begin FUNCTION DgEcuDft_Dataxxx ""
 /begin OUT_MEASUREMENT Vbx_df_ecm_err_itl Vbx_df_inj_ecu_itl Vbx_diag_ena_ecm_err_itl Vbx_diag_ena_inj_ecu_itl /end OUT_MEASUREMENT
/end FUNCTION
/begin FUNCTION DgEcuSaf "" /begin SUB_FUNCTION DgEcuSaf_Dataxxx DgEcuSaf_Sfthwfm /end SUB_FUNCTION /end FUNCTION
/begin FUNCTION DgEcuSaf_Dataxxx ""
 /begin OUT_MEASUREMENT Vbx_df_ecm_adc_tron Vbx_df_ecm_mon_secu_1 Vbx_df_ecm_mon_secu_2 Vbx_df_ecm_mon_tron Vbx_df_vb_clc_chr /end OUT_MEASUREMENT
/end FUNCTION
/begin FUNCTION DgEcuSaf_Sfthwfm ""
 /begin DEF_CHARACTERISTIC Cxx_dfdec_ecm_adc_tron Cxx_dfdec_ecm_mon_secu_1 Cxx_dfdec_ecm_mon_secu_2 Cxx_dfdec_ecm_mon_tron Cxx_dfdec_vb_clc_chr Cxx_dfinc_ecm_adc_tron Cxx_dfinc_ecm_mon_secu_1 Cxx_dfinc_ecm_mon_secu_2 Cxx_dfinc_ecm_mon_tron Cxx_dfinc_vb_clc_chr /end DEF_CHARACTERISTIC
 /begin OUT_MEASUREMENT Vsx_ecm_mon_vld /end OUT_MEASUREMENT
/end FUNCTION
/begin FUNCTION cllubwea ""
 /begin SUB_FUNCTION cllubwea_owhisxx cllubwea_oildilx cllubwea_owzoncs cllubwea_oxixxxx /end SUB_FUNCTION
/end FUNCTION
/begin FUNCTION cllubwea_owhisxx "Oil Wear Estimation History function"
 /begin OUT_MEASUREMENT Vbx_owe_ini_0 Vbx_owe_ini_1 Vbx_owe_ini_2 Vbx_owe_ini_3 Vbx_owe_ini_prev Vxx_owe_ctr_stt Vxx_owe_dil_req_km Vxx_owe_eng_rev_act_sum_0 Vxx_owe_eng_rev_act_sum_1 Vxx_owe_eng_rev_act_sum_2 Vxx_owe_eng_rev_act_sum_3 Vxx_owe_km_0 Vxx_owe_km_1 Vxx_owe_km_2 Vxx_owe_km_3 Vxx_owe_pot_km_0 Vxx_owe_pot_km_1 Vxx_owe_pot_km_2 Vxx_owe_pot_km_3 Vxx_owe_prev_ini_km Vxx_owe_warn_req_km Vbx_owe_ini_0_trg Vbx_owe_ini_1_trg Vbx_owe_ini_2_trg Vbx_owe_ini_3_trg Vtx_owe_eng_rev_act_sum[0] Vtx_owe_eng_rev_act_sum[1] Vtx_owe_eng_rev_act_sum[2] Vtx_owe_eng_rev_act_sum[3] Vtx_owe_km[0] Vtx_owe_km[1] Vtx_owe_km[2] Vtx_owe_km[3] Vtx_owe_pot_km[0] Vtx_owe_pot_km[1] Vtx_owe_pot_km[2] Vtx_owe_pot_km[3] Vxx_owe_eng_rev_act_sum_mem Vxx_owe_ini Vxx_owe_prev_drn_dist /end OUT_MEASUREMENT
/end FUNCTION
/begin FUNCTION cllubwea_oildilx "Oil dilution model" /begin OUT_MEASUREMENT Vxx_oil_dil_raw Vxx_pft_oil_dil_max Vxx_oil_dil /end OUT_MEASUREMENT /begin LOC_MEASUREMENT Vxx_oil_dil_rij /end LOC_MEASUREMENT /end FUNCTION
/begin FUNCTION cllubwea_owzoncs "Oil Wear Estimation Geographic area selection"
 /begin DEF_CHARACTERISTIC Cxx_owe_km_pot_1 Cxx_owe_km_pot_2 Cxx_owe_km_pot_3 Cxx_owe_km_pot_4 Cxx_owe_max_drn_km_1 Cxx_owe_max_drn_km_2 Cxx_owe_max_drn_km_3 Cxx_owe_max_drn_km_4 Cxx_owe_min_drn_km_1 Cxx_owe_min_drn_km_2 Cxx_owe_min_drn_km_3 Cxx_owe_min_drn_km_4 Cxx_owe_n_mnl_asd_1 Cxx_owe_n_mnl_asd_2 Cxx_owe_n_mnl_asd_3 Cxx_owe_n_mnl_asd_4 /end DEF_CHARACTERISTIC
 /begin OUT_MEASUREMENT Vsx_owe_act_zon Vbx_owe_off Vbx_owe_zon_writ Vxx_owe_km_pot Vxx_owe_max_drn_km Vxx_owe_min_drn_km Vxx_owe_n_mnl_asd /end OUT_MEASUREMENT
/end FUNCTION
/begin FUNCTION cllubwea_oxixxxx "Oil Wear Estimation lubricant oxydation with engine revolutions count"
 /begin DEF_CHARACTERISTIC Ctb_owe_oil_dil Ctb_owe_toil Ctb_owe_toil_fac Ctb_owe_toil_off Ctb_owe_toil_sta Cmp_owe_toil_prev_sta Ctp_owe_dil Ctp_owe_toil Ctp_owe_toil_fac Cbx_owe_toil_tco Cxx_owe_eng_aut_dly Cxx_owe_tco_sub Cxx_owe_toil_sub /end DEF_CHARACTERISTIC
 /begin OUT_MEASUREMENT Vxx_owe_eng_rev_prev_sum Vxx_owe_toil_eng_off_prev Vbx_owe_eng_aut Vbx_owe_eng_aut_dly Vbx_owe_fac_toil_act Vxx_owe_cmp_toil Vxx_owe_ctp_dil Vxx_owe_ctp_toil Vxx_owe_eng_rev_act_sum Vxx_owe_fac_toil_act Vxx_owe_fac_toil_tot Vxx_owe_n_aut Vxx_owe_n_toil_dil_u32 Vxx_owe_toil_sta Vxx_owe_toil_tco /end OUT_MEASUREMENT
/end FUNCTION
/begin FUNCTION oucloluo ""
 /begin SUB_FUNCTION oucloluo_owkmdil oucloluo_schxxxx oucloluo_owkmwir oucloluo_ptcgixx oucloluo_owihmcs oucloluo_owihmpa oucloluo_owihmkm /end SUB_FUNCTION
/end FUNCTION
/begin FUNCTION oucloluo_owkmdil "Oil Wear Estimation remaining kilometers interface with dilution parameters"
 /begin OUT_MEASUREMENT Vxx_owe_dil Vxx_owe_km1_dil Vxx_owe_km2_dil Vxx_owe_oxy_dil_fac_raw Vxx_owe_pot_km_rnd_dil Vxx_owe_wea1_dil Vxx_owe_wea2_dil /end OUT_MEASUREMENT
/end FUNCTION
/begin FUNCTION oucloluo_schxxxx "Output cooling lubrification schedulers" /begin DEF_CHARACTERISTIC Cbx_oil_heat_abst_pres_cho Cbx_owe_hmi_warn /end DEF_CHARACTERISTIC /begin OUT_MEASUREMENT Vbx_oil_heat_abst_pres_cho Vbx_owe_hmi_warn_emb_cho /end OUT_MEASUREMENT /end FUNCTION
/begin FUNCTION oucloluo_owkmwir "Oil wear estimation wire" /begin OUT_MEASUREMENT Vxx_owe_pot_km_pot_oxy_dil /end OUT_MEASUREMENT /end FUNCTION
/begin FUNCTION oucloluo_ptcgixx "PTC command of the circuit of reabsorption of oil vapours"
 /begin DEF_CHARACTERISTIC Cxx_dfdec_ptc_rov_oc Cxx_dfdec_ptc_rov_scg Cxx_dfdec_ptc_rov_scw Cxx_dfinc_ptc_rov_oc Cxx_dfinc_ptc_rov_scg Cxx_dfinc_ptc_rov_scw Cxx_ptc_rov_tia_hys Cxx_ptc_rov_tia_thd /end DEF_CHARACTERISTIC
 /begin OUT_MEASUREMENT Vbx_ptc_rov_cmd /end OUT_MEASUREMENT
 /begin LOC_MEASUREMENT Vbx_ptc_rov /end LOC_MEASUREMENT
/end FUNCTION
/begin FUNCTION oucloluo_owihmcs "Oil Wear Estimation Dashboard interface configuration"
 /begin DEF_CHARACTERISTIC Cbx_owe_sat_ena Cxx_owe_avl Cxx_owe_km7 Cxx_owe_oil_dil_max_km /end DEF_CHARACTERISTIC
 /begin OUT_MEASUREMENT Vbx_owe_dil_req_km_2_clc Vbx_owe_dil_req_km Vbx_owe_oil_drn_req_2_mux Vbx_owe_oil_drn_req_mux Vbx_owe_warn_req Vxx_owe_pot_km /end OUT_MEASUREMENT
 /begin LOC_MEASUREMENT Vbx_owe_req_km_2_clc Vxx_owe_km_sat_max Vxx_owe_pot_km_clc_2 /end LOC_MEASUREMENT
/end FUNCTION
/begin FUNCTION oucloluo_owihmpa "Oil Wear Estimation pre-alert/alert interface"
 /begin DEF_CHARACTERISTIC Cbx_owe_avl Cbx_owe_avl_2 Cbx_owe_dil_req_2_ena Cbx_owe_ena_1 Cbx_owe_ena_2 Cbx_owe_ena_3 Cbx_owe_ena_4 Cbx_owe_ena_5 Cbx_owe_ena_6 Cbx_owe_ena_7 Cbx_owe_ena_8 Cxx_owe_drn_dist_max_prg Cxx_owe_drn_req_dly Cxx_owe_oil_dil_min_km Cxx_owe_oil_dil_thd /end DEF_CHARACTERISTIC
 /begin OUT_MEASUREMENT Vbx_owe_oil_drn_req_2 Vbx_owe_oil_drn_req Vbx_owe_warn_req_km_mem Vbx_owe_dil_req_km_1_clc Vbx_owe_oil_drn_req_2_clc Vbx_owe_oil_drn_req_clc Vbx_owe_warn_req_km_clc /end OUT_MEASUREMENT
 /begin LOC_MEASUREMENT Vbx_owe_drn_req Vbx_owe_drn_req_ok_2 Vbx_owe_drn_req_rst Vbx_owe_n_drn_req Vbx_owe_oil_drn_req_2_mux_raw Vbx_owe_oil_drn_req_mux_raw Vbx_owe_prg /end LOC_MEASUREMENT
/end FUNCTION
/begin FUNCTION oucloluo_owihmkm "Oil Wear Estimation remaining kilometers interface"
 /begin DEF_CHARACTERISTIC Cxx_owe_km1 Cxx_owe_km2 Cxx_owe_km3 Cxx_owe_km4 Cxx_owe_km5 Cxx_owe_km_slop_max Cxx_owe_km_slop_min /end DEF_CHARACTERISTIC
 /begin OUT_MEASUREMENT Vxx_owe_km1 Vxx_owe_km2 Vxx_owe_pot_km_pot Vxx_owe_wea1 Vxx_owe_wea2 Vxx_owe_pot_km_clc /end OUT_MEASUREMENT
 /begin LOC_MEASUREMENT Vbx_owe_ini_req_tmp Vbx_owe_ref_2_ok Vbx_owe_ref_2_upd Vxx_owe_ant Vxx_owe_km1_prev Vxx_owe_km2_prev Vxx_owe_km_slop Vxx_owe_km_var1 Vxx_owe_km_var2 Vxx_owe_km_var3 Vxx_owe_pot_km_prev Vxx_owe_pot_km_rnd Vxx_owe_pot_km_step Vxx_owe_prev_drn_dist_prev Vxx_owe_raw_pot_km Vxx_owe_raw_pot_km_prev Vxx_owe_wea1_prev Vxx_owe_wea2_prev Vxx_owe_wea_act Vxx_owe_wea_act_pot Vxx_owe_wea_act_prev Vxx_owe_wea_spd /end LOC_MEASUREMENT
/end FUNCTION
/begin FUNCTION BoCloLuo ""
 /begin OUT_MEASUREMENT Vbx_df_ptc_rov_oc Vbx_df_ptc_rov_scg Vbx_df_ptc_rov_scw Vbx_diag_ena_ptc_rov_oc Vbx_diag_ena_ptc_rov_scg Vbx_diag_ena_ptc_rov_scw lv_oil_heat lv_oil_heat_pres /end OUT_MEASUREMENT
/end FUNCTION
/begin FUNCTION C_4_SYS_VAR "" /begin SUB_FUNCTION SYS_VAR_ATIMER /end SUB_FUNCTION /end FUNCTION
/begin FUNCTION SYS_VAR_ATIMER "" /begin OUT_MEASUREMENT dur_work_ecu t_on_ecu /end OUT_MEASUREMENT /end FUNCTION
/begin FUNCTION iastuce "" /begin OUT_MEASUREMENT lv_immo_unlock_auth /end OUT_MEASUREMENT /end FUNCTION
/begin FUNCTION __DDS_EXPA2_DEFAULT_FUNC__ "__DDS_EXPA2_DEFAULT_FUNC__"
 /begin DEF_CHARACTERISTIC c_ccp_pt_act c_ensd_eng_dyn_conf ldp_vb__pwm_cor ip_pwm_cor c_vb_min_etc_dr_diag Cbx_lpg_gas_lpg_trs Cbx_lpg_gas_mod Cbx_lpg_lpg_gas_trs Cbx_sens_rvac_cfm Cbx_vb_flot_dsb c_ofs_ref_inj lc_eng_pha_upd_req c_ctr_err_nvmy_max c_ctr_err_ram_max c_ctr_err_rom_max c_ctr_err_spi_max lc_spi_mps_drv_avl lc_spi_qps_drv_avl c_t_ini_test_ign_0 c_t_ini_test_ign_1 c_t_ini_test_ign_2 c_t_ini_test_ign_3 c_t_ini_test_inj_0 c_t_ini_test_inj_1 c_t_ini_test_inj_2 c_t_ini_test_inj_3 c_t_off_test_ign_0 c_t_off_test_ign_1 c_t_off_test_ign_2 c_t_off_test_ign_3 c_t_off_test_inj_0 c_t_off_test_inj_1 c_t_off_test_inj_2 c_t_off_test_inj_3 c_t_on_test_ign_0 c_t_on_test_ign_1 c_t_on_test_ign_2 c_t_on_test_ign_3 c_t_on_test_inj_0 c_t_on_test_inj_1 c_t_on_test_inj_2 c_t_on_test_inj_3 c_test_out_cyc_ign_0 c_test_out_cyc_ign_1 c_test_out_cyc_ign_2 c_test_out_cyc_ign_3 c_test_out_cyc_inj_0 c_test_out_cyc_inj_1 c_test_out_cyc_inj_2 c_test_out_cyc_inj_3 c_vs_eol_diag_max lc_test_out_eol_ign_0 lc_test_out_eol_ign_1 lc_test_out_eol_ign_2 lc_test_out_eol_ign_3 lc_test_out_eol_inj_0 lc_test_out_eol_inj_1 lc_test_out_eol_inj_2 lc_test_out_eol_inj_3 /end DEF_CHARACTERISTIC
 /begin OUT_MEASUREMENT lv_end_diag_win_fsd_1 lv_end_diag_win_fsd_2 lv_end_diag_win_fsd_lam_lim_1 lv_end_diag_win_fsd_lam_lim_2 lv_eol_obd_dc t_ast amp inh_iv_mis lv_inh_iv_mis_a lv_mis_state_a lv_mis_state_b1 lv_mis_state_b4 sym_cyl_mis_a sym_cyl_mis_b1 sym_cyl_mis_b4 pv daq_ovld ctr_vld_block lv_warm_rst Vp_map_fil vp_map vp_put Vxx_sens_it_v_1 Vxx_sens_it_v_2 vp_tps_1_bas vp_tps_2_bas err_sym_tco_el lv_cdn_diag_tco_el tco_mes vp_tco[0] lv_igk lv_igk_bas v_igk_mes err_sym_rly_main_plaus_on err_sym_vcc_1 err_sym_vcc_2 err_sym_vcc_3 lv_cdn_diag_rly_main_plaus_on lv_cdn_diag_vcc_1 lv_cdn_diag_vcc_2 lv_cdn_diag_vcc_3 lv_cdn_vb_min_diag lv_cdn_vb_obd1 lv_cdn_vb_obd2 lv_vb_cdn_obd_1 lv_vb_cdn_obd_2 lv_vb_inh_diag v_rly_main_mes vb vb_raw vcc_1 vcc_2 vcc_3 vp_vcc_1 vp_vcc_2 vp_vcc_3 lv_inh_diag_etc_dr lv_mtc_cur_off pwm_etc Vbx_act_test_eol Vbx_alco_ad_cold_frst Vbx_ecm_mon_rst_req Vbx_it_ofs_clos_frst Vbx_it_ofs_open_frst Vbx_lpg_cyl1_cut Vbx_lpg_cyl2_cut Vbx_lpg_cyl3_cut Vbx_lpg_cyl4_cut Vbx_lpg_gas_lpg_trs Vbx_lpg_gas_mod Vbx_lpg_lpg_gas_trs Vbx_lpg_min_lpg_lvl Vbx_mvac_cut_req Vbx_pwst_prs_stt Vbx_vb_flot_dsb Vbx_wf_alt_cfm Vbx_wf_ptc_cfm Vbx_wup_cmd Vbx_wup_req Vxx_alco_ad_ctr Vxx_alco_rat Vxx_driv_spt_fac Vxx_eai_ti_cl_ctr Vxx_emtv_clos_rat Vxx_evap_dgn_fim_cor Vxx_fuel_lvl_mem Vxx_is_fuel_typ_rat Vxx_raw_sens_rvac Vxx_ti_alco_cor Vxx_ti_alco_cor_h Vxx_ti_alco_cor_l Vxx_tkof_ass_fac err_sym_bas_knk[0] err_sym_crk_oc err_sym_crk_plaus err_sym_crk_syn err_sym_crk_tooth err_sym_crk_tooth_per err_sym_igc_ol[0] err_sym_igc_ol[1] err_sym_igc_ol[2] err_sym_igc_ol[3] err_sym_igc_scg[0] err_sym_igc_scg[1] err_sym_igc_scg[2] err_sym_igc_scg[3] err_sym_igc_scp[0] err_sym_igc_scp[1] err_sym_igc_scp[2] err_sym_igc_scp[3] err_sym_per_cam_in[0] err_sym_plaus_cam_in[0] err_sym_ref_crk_cam_in[0] err_sym_rel_knk[0] err_sym_syn_cam_in[0] err_sym_syn_crk_cam_in[0] lv_cdn_diag_bas_knk[0] lv_cdn_diag_crk_oc lv_cdn_diag_crk_plaus lv_cdn_diag_crk_syn lv_cdn_diag_crk_tooth lv_cdn_diag_crk_tooth_per lv_cdn_diag_igc_ol[0] lv_cdn_diag_igc_ol[1] lv_cdn_diag_igc_ol[2] lv_cdn_diag_igc_ol[3] lv_cdn_diag_igc_scg[0] lv_cdn_diag_igc_scg[1] lv_cdn_diag_igc_scg[2] lv_cdn_diag_igc_scg[3] lv_cdn_diag_igc_scp[0] lv_cdn_diag_igc_scp[1] lv_cdn_diag_igc_scp[2] lv_cdn_diag_igc_scp[3] lv_cdn_diag_per_cam_in[0] lv_cdn_diag_plaus_cam_in[0] lv_cdn_diag_ref_crk_cam_in[0] lv_cdn_diag_rel_knk[0] lv_cdn_diag_syn_cam_in[0] lv_cdn_diag_syn_crk_cam_in[0] err_sym_el_sov err_sym_map err_sym_put iga_av_shift_rng_1 iga_av_shift_rng_2 iga_av_shift_rng_3 iga_av_shift_rng_4 lv_cdn_diag_map lv_cdn_diag_put lv_conf_pre_inj lv_igk_on lv_inh_inj[0] lv_inh_inj[1] lv_inh_inj[2] lv_inh_inj[3] lv_lsh_down lv_lsh_up lv_pre_inj_ena lv_st_end lv_vs_run maf_hb ofs_ref_inj soi_1_hom[0] soi_1_hom[1] soi_1_hom[2] soi_1_hom[3] soi_2_hom[0] soi_2_hom[1] soi_2_hom[2] soi_2_hom[3] soi_pre_inj[0] soi_pre_inj[1] soi_pre_inj[2] soi_pre_inj[3] tco ti_1_hom[0] ti_1_hom[1] ti_1_hom[2] ti_1_hom[3] ti_2_hom[0] ti_2_hom[1] ti_2_hom[2] ti_2_hom[3] ti_pre_inj[0] ti_pre_inj[1] ti_pre_inj[2] ti_pre_inj[3] v_dtp Vsx_maf_fct_vld lv_cam_lock_ref_pos_ivvt_in lv_eng_pha_upd_req toil lv_emul Vxx_ovt_acel_pdl_dif ctr_loss_tsk_ecu_run_cyc ctr_loss_tsk_sw_cyc lf_state_os_tsk_loss_ecu_cyc[0] lf_state_os_tsk_loss_prev[0] lf_state_os_tsk_loss_sw_cyc[0] stack_cns[0] stack_cns[1] ctr_wrt_fly ctr_wrt_fly_swt lv_cru_wrt_req switch_type ctr_err_ecc ctr_err_nvmy ctr_err_nvmy_dec ctr_err_ram ctr_err_rom ctr_err_spi ctr_err_ver ctr_rst ctr_rst_cold ctr_rst_warm ctr_rst_wtd err_sym_ecu_1 err_sym_ecu_2 err_sym_nvmy err_sym_ram err_sym_rom err_sym_spi err_sym_spi_mps err_sym_spi_qps fls_reg lv_cdn_diag_ecu lv_cdn_diag_nvmy lv_cdn_diag_ram lv_cdn_diag_rom lv_cdn_diag_spi_mps lv_cdn_diag_spi_qps lv_end_diag_rom lv_err_ecu_1 lv_err_ecu_2 lv_err_nvmy lv_err_ram lv_err_rom lv_err_spi lv_nvmy_init_old rst_type lv_test_run_ign_0 lv_test_out_ign_0 test_eol_ign_0.lv_test_out_cus_x lv_test_req_ign_0 test_eol_ign_0.lv_adj_out_x test_eol_ign_0.lv_adj_dec_x test_eol_ign_0.lv_adj_inc_x test_eol_ign_0.lv_adj_save_x lv_test_run_ign_1 lv_test_out_ign_1 test_eol_ign_1.lv_test_out_cus_x lv_test_req_ign_1 test_eol_ign_1.lv_adj_out_x test_eol_ign_1.lv_adj_dec_x test_eol_ign_1.lv_adj_inc_x test_eol_ign_1.lv_adj_save_x lv_test_run_ign_2 lv_test_out_ign_2 test_eol_ign_2.lv_test_out_cus_x lv_test_req_ign_2 test_eol_ign_2.lv_adj_out_x test_eol_ign_2.lv_adj_dec_x test_eol_ign_2.lv_adj_inc_x test_eol_ign_2.lv_adj_save_x lv_test_run_ign_3 lv_test_out_ign_3 test_eol_ign_3.lv_test_out_cus_x lv_test_req_ign_3 test_eol_ign_3.lv_adj_out_x test_eol_ign_3.lv_adj_dec_x test_eol_ign_3.lv_adj_inc_x test_eol_ign_3.lv_adj_save_x lv_test_run_inj_0 lv_test_out_inj_0 test_eol_inj_0.lv_test_out_cus_x lv_test_req_inj_0 test_eol_inj_0.lv_adj_out_x test_eol_inj_0.lv_adj_dec_x test_eol_inj_0.lv_adj_inc_x test_eol_inj_0.lv_adj_save_x lv_test_run_inj_1 lv_test_out_inj_1 test_eol_inj_1.lv_test_out_cus_x lv_test_req_inj_1 test_eol_inj_1.lv_adj_out_x test_eol_inj_1.lv_adj_dec_x test_eol_inj_1.lv_adj_inc_x test_eol_inj_1.lv_adj_save_x lv_test_run_inj_2 lv_test_out_inj_2 test_eol_inj_2.lv_test_out_cus_x lv_test_req_inj_2 test_eol_inj_2.lv_adj_out_x test_eol_inj_2.lv_adj_dec_x test_eol_inj_2.lv_adj_inc_x test_eol_inj_2.lv_adj_save_x lv_test_run_inj_3 lv_test_out_inj_3 test_eol_inj_3.lv_test_out_cus_x lv_test_req_inj_3 test_eol_inj_3.lv_adj_out_x test_eol_inj_3.lv_adj_dec_x test_eol_inj_3.lv_adj_inc_x test_eol_inj_3.lv_adj_save_x igc_x_ext_adj[0] igc_x_ext_adj[1] igc_x_ext_adj[2] igc_x_ext_adj[3] lv_cdn_test_eol_ena lv_end_test_req lv_eol_act lv_igc_x_ext_adj[0] lv_igc_x_ext_adj[1] lv_igc_x_ext_adj[2] lv_igc_x_ext_adj[3] lv_stop_test_req lv_test_out_eol lv_test_out_eol_end test_out_ign_0 test_out_ign_1 test_out_ign_2 test_out_ign_3 test_out_inj_0 test_out_inj_1 test_out_inj_2 test_out_inj_3 Vbx_blow_det Vbx_diag_in_vvtc_n_cdn_nok Vbx_evap_dgn Vbx_raw_wf_ac_req Vbx_wf_ac_req_cfm Vbx_wf_comp_cfa_cfm Vxx_wg_fuel_typ_rat /end OUT_MEASUREMENT
/end FUNCTION
/end MODULE
/end PROJECT
