ASAP2_VERSION 1 41
/begin PROJECT RD8 "_default_ProjectLongIdentifier"
/begin HEADER "_default_HeaderComment" PROJECT_NO RD9 /end HEADER
/begin MODULE _default_ModuleName "_default_ModuleLongIdentifier"
/begin MOD_COMMON "_default_ModCommonComment" DEPOSIT ABSOLUTE BYTE_ORDER MSB_LAST ALIGNMENT_BYTE 1 ALIGNMENT_WORD 2 ALIGNMENT_LONG 2 ALIGNMENT_FLOAT32_IEEE 2 ALIGNMENT_FLOAT64_IEEE 4 /end MOD_COMMON
/begin MEASUREMENT Sbx_cf_cru_whl_cmd_oc_scw "" UBYTE _CNV_A_R_A_165_CM 1 0. 0. 255. DISPLAY_IDENTIFIER fm_sta_eprm_cru_whl_cmd_oc_scw.fm_static_eprm_bitfield.Sbx_cf_xxx ECU_ADDRESS 0xc0000500 BIT_MASK 0x80 /end MEASUREMENT
/begin MEASUREMENT Sbx_dyn_cru_whl_cmd_oor "" UBYTE _CNV_A_R_A_165_CM 1 0. 0. 255. DISPLAY_IDENTIFIER fm_sta_eprm_cru_whl_cmd_oor.fm_static_eprm_bitfield.Sbx_dyn_xxx ECU_ADDRESS 0xc0000502 BIT_MASK 0x8 /end MEASUREMENT
/begin MEASUREMENT Sbx_rdn_cru_whl_cmd_oor "" UBYTE _CNV_A_R_A_165_CM 1 0. 0. 255. DISPLAY_IDENTIFIER fm_sta_eprm_cru_whl_cmd_oor.fm_static_eprm_bitfield.Sbx_rdn_xxx ECU_ADDRESS 0xc0000502 BIT_MASK 0x10 /end MEASUREMENT
/begin MEASUREMENT Sbx_mf_cru_whl_cmd_oor "" UBYTE _CNV_A_R_A_165_CM 1 0. 0. 255. DISPLAY_IDENTIFIER fm_sta_eprm_cru_whl_cmd_oor.fm_static_eprm_bitfield.Sbx_mf_xxx ECU_ADDRESS 0xc0000502 BIT_MASK 0x20 /end MEASUREMENT
/begin MEASUREMENT Sbx_cf_cru_whl_cmd_oor "" UBYTE _CNV_A_R_A_165_CM 1 0. 0. 255. DISPLAY_IDENTIFIER fm_sta_eprm_cru_whl_cmd_oor.fm_static_eprm_bitfield.Sbx_cf_xxx ECU_ADDRESS 0xc0000502 BIT_MASK 0x80 /end MEASUREMENT
/begin MEASUREMENT Sbx_dyn_ecm_adc_tron "" UBYTE _CNV_A_R_A_165_CM 1 0. 0. 255. DISPLAY_IDENTIFIER fm_sta_eprm_ecm_adc_tron.fm_static_eprm_bitfield.Sbx_dyn_xxx ECU_ADDRESS 0xc0000590 BIT_MASK 0x8 /end MEASUREMENT
/begin MEASUREMENT Sbx_rdn_ecm_adc_tron "" UBYTE _CNV_A_R_A_165_CM 1 0. 0. 255. DISPLAY_IDENTIFIER fm_sta_eprm_ecm_adc_tron.fm_static_eprm_bitfield.Sbx_rdn_xxx ECU_ADDRESS 0xc0000590 BIT_MASK 0x10 /end MEASUREMENT
/begin MEASUREMENT Sbx_mf_ecm_adc_tron "" UBYTE _CNV_A_R_A_165_CM 1 0. 0. 255. DISPLAY_IDENTIFIER fm_sta_eprm_ecm_adc_tron.fm_static_eprm_bitfield.Sbx_mf_xxx ECU_ADDRESS 0xc0000590 BIT_MASK 0x20 /end MEASUREMENT
/begin MEASUREMENT Sbx_cf_ecm_adc_tron "" UBYTE _CNV_A_R_A_165_CM 1 0. 0. 255. DISPLAY_IDENTIFIER fm_sta_eprm_ecm_adc_tron.fm_static_eprm_bitfield.Sbx_cf_xxx ECU_ADDRESS 0xc0000590 BIT_MASK 0x80 /end MEASUREMENT
/begin MEASUREMENT Sbx_dyn_ecm_err_itl "" UBYTE _CNV_A_R_A_165_CM 1 0. 0. 255. DISPLAY_IDENTIFIER fm_sta_eprm_ecm_err_itl.fm_static_eprm_bitfield.Sbx_dyn_xxx ECU_ADDRESS 0xc0000572 BIT_MASK 0x8 /end MEASUREMENT
/begin MEASUREMENT Sbx_rdn_ecm_err_itl "" UBYTE _CNV_A_R_A_165_CM 1 0. 0. 255. DISPLAY_IDENTIFIER fm_sta_eprm_ecm_err_itl.fm_static_eprm_bitfield.Sbx_rdn_xxx ECU_ADDRESS 0xc0000572 BIT_MASK 0x10 /end MEASUREMENT
/begin MEASUREMENT Sbx_mf_ecm_err_itl "" UBYTE _CNV_A_R_A_165_CM 1 0. 0. 255. DISPLAY_IDENTIFIER fm_sta_eprm_ecm_err_itl.fm_static_eprm_bitfield.Sbx_mf_xxx ECU_ADDRESS 0xc0000572 BIT_MASK 0x20 /end MEASUREMENT
/begin MEASUREMENT Sbx_cf_ecm_err_itl "" UBYTE _CNV_A_R_A_165_CM 1 0. 0. 255. DISPLAY_IDENTIFIER fm_sta_eprm_ecm_err_itl.fm_static_eprm_bitfield.Sbx_cf_xxx ECU_ADDRESS 0xc0000572 BIT_MASK 0x80 /end MEASUREMENT
/begin MEASUREMENT Sbx_dyn_ecm_mon_secu_1 "" UBYTE _CNV_A_R_A_165_CM 1 0. 0. 255. DISPLAY_IDENTIFIER fm_sta_eprm_ecm_mon_secu_1.fm_static_eprm_bitfield.Sbx_dyn_xxx ECU_ADDRESS 0xc000058c BIT_MASK 0x8 /end MEASUREMENT
/begin MEASUREMENT Sbx_rdn_ecm_mon_secu_1 "" UBYTE _CNV_A_R_A_165_CM 1 0. 0. 255. DISPLAY_IDENTIFIER fm_sta_eprm_ecm_mon_secu_1.fm_static_eprm_bitfield.Sbx_rdn_xxx ECU_ADDRESS 0xc000058c BIT_MASK 0x10 /end MEASUREMENT
/begin MEASUREMENT Sbx_mf_ecm_mon_secu_1 "" UBYTE _CNV_A_R_A_165_CM 1 0. 0. 255. DISPLAY_IDENTIFIER fm_sta_eprm_ecm_mon_secu_1.fm_static_eprm_bitfield.Sbx_mf_xxx ECU_ADDRESS 0xc000058c BIT_MASK 0x20 /end MEASUREMENT
/begin MEASUREMENT Sbx_cf_ecm_mon_secu_1 "" UBYTE _CNV_A_R_A_165_CM 1 0. 0. 255. DISPLAY_IDENTIFIER fm_sta_eprm_ecm_mon_secu_1.fm_static_eprm_bitfield.Sbx_cf_xxx ECU_ADDRESS 0xc000058c BIT_MASK 0x80 /end MEASUREMENT
/begin MEASUREMENT Sbx_dyn_ecm_mon_secu_2 "" UBYTE _CNV_A_R_A_165_CM 1 0. 0. 255. DISPLAY_IDENTIFIER fm_sta_eprm_ecm_mon_secu_2.fm_static_eprm_bitfield.Sbx_dyn_xxx ECU_ADDRESS 0xc000058e BIT_MASK 0x8 /end MEASUREMENT
/begin MEASUREMENT Sbx_rdn_ecm_mon_secu_2 "" UBYTE _CNV_A_R_A_165_CM 1 0. 0. 255. DISPLAY_IDENTIFIER fm_sta_eprm_ecm_mon_secu_2.fm_static_eprm_bitfield.Sbx_rdn_xxx ECU_ADDRESS 0xc000058e BIT_MASK 0x10 /end MEASUREMENT
/begin MEASUREMENT Sbx_mf_ecm_mon_secu_2 "" UBYTE _CNV_A_R_A_165_CM 1 0. 0. 255. DISPLAY_IDENTIFIER fm_sta_eprm_ecm_mon_secu_2.fm_static_eprm_bitfield.Sbx_mf_xxx ECU_ADDRESS 0xc000058e BIT_MASK 0x20 /end MEASUREMENT
/begin MEASUREMENT Sbx_cf_ecm_mon_secu_2 "" UBYTE _CNV_A_R_A_165_CM 1 0. 0. 255. DISPLAY_IDENTIFIER fm_sta_eprm_ecm_mon_secu_2.fm_static_eprm_bitfield.Sbx_cf_xxx ECU_ADDRESS 0xc000058e BIT_MASK 0x80 /end MEASUREMENT
/begin MEASUREMENT Sbx_dyn_ecm_mon_tron "" UBYTE _CNV_A_R_A_165_CM 1 0. 0. 255. DISPLAY_IDENTIFIER fm_sta_eprm_ecm_mon_tron.fm_static_eprm_bitfield.Sbx_dyn_xxx ECU_ADDRESS 0xc0000574 BIT_MASK 0x8 /end MEASUREMENT
/begin MEASUREMENT Sbx_rdn_ecm_mon_tron "" UBYTE _CNV_A_R_A_165_CM 1 0. 0. 255. DISPLAY_IDENTIFIER fm_sta_eprm_ecm_mon_tron.fm_static_eprm_bitfield.Sbx_rdn_xxx ECU_ADDRESS 0xc0000574 BIT_MASK 0x10 /end MEASUREMENT
/begin MEASUREMENT Sbx_mf_ecm_mon_tron "" UBYTE _CNV_A_R_A_165_CM 1 0. 0. 255. DISPLAY_IDENTIFIER fm_sta_eprm_ecm_mon_tron.fm_static_eprm_bitfield.Sbx_mf_xxx ECU_ADDRESS 0xc0000574 BIT_MASK 0x20 /end MEASUREMENT
/begin MEASUREMENT Sbx_cf_ecm_mon_tron "" UBYTE _CNV_A_R_A_165_CM 1 0. 0. 255. DISPLAY_IDENTIFIER fm_sta_eprm_ecm_mon_tron.fm_static_eprm_bitfield.Sbx_cf_xxx ECU_ADDRESS 0xc0000574 BIT_MASK 0x80 /end MEASUREMENT
/begin MEASUREMENT Sbx_dyn_esp_data_chr "" UBYTE _CNV_A_R_A_165_CM 1 0. 0. 255. DISPLAY_IDENTIFIER fm_sta_eprm_esp_data_chr.fm_static_eprm_bitfield.Sbx_dyn_xxx ECU_ADDRESS 0xc000046c BIT_MASK 0x8 /end MEASUREMENT
/begin MEASUREMENT Sbx_rdn_esp_data_chr "" UBYTE _CNV_A_R_A_165_CM 1 0. 0. 255. DISPLAY_IDENTIFIER fm_sta_eprm_esp_data_chr.fm_static_eprm_bitfield.Sbx_rdn_xxx ECU_ADDRESS 0xc000046c BIT_MASK 0x10 /end MEASUREMENT
/begin MEASUREMENT Sbx_mf_esp_data_chr "" UBYTE _CNV_A_R_A_165_CM 1 0. 0. 255. DISPLAY_IDENTIFIER fm_sta_eprm_esp_data_chr.fm_static_eprm_bitfield.Sbx_mf_xxx ECU_ADDRESS 0xc000046c BIT_MASK 0x20 /end MEASUREMENT
/begin MEASUREMENT Sbx_cf_esp_data_chr "" UBYTE _CNV_A_R_A_165_CM 1 0. 0. 255. DISPLAY_IDENTIFIER fm_sta_eprm_esp_data_chr.fm_static_eprm_bitfield.Sbx_cf_xxx ECU_ADDRESS 0xc000046c BIT_MASK 0x80 /end MEASUREMENT
/begin MEASUREMENT Sbx_dyn_esp_data_seq_ctr "" UBYTE _CNV_A_R_A_165_CM 1 0. 0. 255. DISPLAY_IDENTIFIER fm_sta_eprm_esp_data_seq_ctr.fm_static_eprm_bitfield.Sbx_dyn_xxx ECU_ADDRESS 0xc000046e BIT_MASK 0x8 /end MEASUREMENT
/begin MEASUREMENT Sbx_rdn_esp_data_seq_ctr "" UBYTE _CNV_A_R_A_165_CM 1 0. 0. 255. DISPLAY_IDENTIFIER fm_sta_eprm_esp_data_seq_ctr.fm_static_eprm_bitfield.Sbx_rdn_xxx ECU_ADDRESS 0xc000046e BIT_MASK 0x10 /end MEASUREMENT
/begin MEASUREMENT Sbx_mf_esp_data_seq_ctr "" UBYTE _CNV_A_R_A_165_CM 1 0. 0. 255. DISPLAY_IDENTIFIER fm_sta_eprm_esp_data_seq_ctr.fm_static_eprm_bitfield.Sbx_mf_xxx ECU_ADDRESS 0xc000046e BIT_MASK 0x20 /end MEASUREMENT
/begin MEASUREMENT Sbx_cf_esp_data_seq_ctr "" UBYTE _CNV_A_R_A_165_CM 1 0. 0. 255. DISPLAY_IDENTIFIER fm_sta_eprm_esp_data_seq_ctr.fm_static_eprm_bitfield.Sbx_cf_xxx ECU_ADDRESS 0xc000046e BIT_MASK 0x80 /end MEASUREMENT
/begin MEASUREMENT Sbx_dyn_esp_no_frm "" UBYTE _CNV_A_R_A_165_CM 1 0. 0. 255. DISPLAY_IDENTIFIER fm_sta_eprm_esp_no_frm.fm_static_eprm_bitfield.Sbx_dyn_xxx ECU_ADDRESS 0xc0000470 BIT_MASK 0x8 /end MEASUREMENT
/begin MEASUREMENT Sbx_rdn_esp_no_frm "" UBYTE _CNV_A_R_A_165_CM 1 0. 0. 255. DISPLAY_IDENTIFIER fm_sta_eprm_esp_no_frm.fm_static_eprm_bitfield.Sbx_rdn_xxx ECU_ADDRESS 0xc0000470 BIT_MASK 0x10 /end MEASUREMENT
/begin MEASUREMENT Sbx_mf_esp_no_frm "" UBYTE _CNV_A_R_A_165_CM 1 0. 0. 255. DISPLAY_IDENTIFIER fm_sta_eprm_esp_no_frm.fm_static_eprm_bitfield.Sbx_mf_xxx ECU_ADDRESS 0xc0000470 BIT_MASK 0x20 /end MEASUREMENT
/begin MEASUREMENT Sbx_cf_esp_no_frm "" UBYTE _CNV_A_R_A_165_CM 1 0. 0. 255. DISPLAY_IDENTIFIER fm_sta_eprm_esp_no_frm.fm_static_eprm_bitfield.Sbx_cf_xxx ECU_ADDRESS 0xc0000470 BIT_MASK 0x80 /end MEASUREMENT
/begin MEASUREMENT Sbx_dyn_fsys_cpt "" UBYTE _CNV_A_R_A_165_CM 1 0. 0. 255. DISPLAY_IDENTIFIER fm_sta_eprm_fsys_cpt.fm_static_eprm_bitfield.Sbx_dyn_xxx ECU_ADDRESS 0xc0000504 BIT_MASK 0x8 /end MEASUREMENT
/begin MEASUREMENT Sbx_rdn_fsys_cpt "" UBYTE _CNV_A_R_A_165_CM 1 0. 0. 255. DISPLAY_IDENTIFIER fm_sta_eprm_fsys_cpt.fm_static_eprm_bitfield.Sbx_rdn_xxx ECU_ADDRESS 0xc0000504 BIT_MASK 0x10 /end MEASUREMENT
/begin MEASUREMENT Sbx_mf_fsys_cpt "" UBYTE _CNV_A_R_A_165_CM 1 0. 0. 255. DISPLAY_IDENTIFIER fm_sta_eprm_fsys_cpt.fm_static_eprm_bitfield.Sbx_mf_xxx ECU_ADDRESS 0xc0000504 BIT_MASK 0x20 /end MEASUREMENT
/begin MEASUREMENT Sbx_cf_fsys_cpt "" UBYTE _CNV_A_R_A_165_CM 1 0. 0. 255. DISPLAY_IDENTIFIER fm_sta_eprm_fsys_cpt.fm_static_eprm_bitfield.Sbx_cf_xxx ECU_ADDRESS 0xc0000504 BIT_MASK 0x80 /end MEASUREMENT
/begin MEASUREMENT Sbx_dyn_gas_pump_oc "" UBYTE _CNV_A_R_A_165_CM 1 0. 0. 255. DISPLAY_IDENTIFIER fm_sta_eprm_gas_pump_oc.fm_static_eprm_bitfield.Sbx_dyn_xxx ECU_ADDRESS 0xc0000472 BIT_MASK 0x8 /end MEASUREMENT
/begin MEASUREMENT Sbx_rdn_gas_pump_oc "" UBYTE _CNV_A_R_A_165_CM 1 0. 0. 255. DISPLAY_IDENTIFIER fm_sta_eprm_gas_pump_oc.fm_static_eprm_bitfield.Sbx_rdn_xxx ECU_ADDRESS 0xc0000472 BIT_MASK 0x10 /end MEASUREMENT
/begin MEASUREMENT Sbx_mf_gas_pump_oc "" UBYTE _CNV_A_R_A_165_CM 1 0. 0. 255. DISPLAY_IDENTIFIER fm_sta_eprm_gas_pump_oc.fm_static_eprm_bitfield.Sbx_mf_xxx ECU_ADDRESS 0xc0000472 BIT_MASK 0x20 /end MEASUREMENT
/begin MEASUREMENT Sbx_cf_gas_pump_oc "" UBYTE _CNV_A_R_A_165_CM 1 0. 0. 255. DISPLAY_IDENTIFIER fm_sta_eprm_gas_pump_oc.fm_static_eprm_bitfield.Sbx_cf_xxx ECU_ADDRESS 0xc0000472 BIT_MASK 0x80 /end MEASUREMENT
/begin MEASUREMENT Sbx_dyn_gas_pump_scg "" UBYTE _CNV_A_R_A_165_CM 1 0. 0. 255. DISPLAY_IDENTIFIER fm_sta_eprm_gas_pump_scg.fm_static_eprm_bitfield.Sbx_dyn_xxx ECU_ADDRESS 0xc0000474 BIT_MASK 0x8 /end MEASUREMENT
/begin MEASUREMENT Sbx_rdn_gas_pump_scg "" UBYTE _CNV_A_R_A_165_CM 1 0. 0. 255. DISPLAY_IDENTIFIER fm_sta_eprm_gas_pump_scg.fm_static_eprm_bitfield.Sbx_rdn_xxx ECU_ADDRESS 0xc0000474 BIT_MASK 0x10 /end MEASUREMENT
/begin MEASUREMENT Sbx_mf_gas_pump_scg "" UBYTE _CNV_A_R_A_165_CM 1 0. 0. 255. DISPLAY_IDENTIFIER fm_sta_eprm_gas_pump_scg.fm_static_eprm_bitfield.Sbx_mf_xxx ECU_ADDRESS 0xc0000474 BIT_MASK 0x20 /end MEASUREMENT
/begin MEASUREMENT Sbx_cf_gas_pump_scg "" UBYTE _CNV_A_R_A_165_CM 1 0. 0. 255. DISPLAY_IDENTIFIER fm_sta_eprm_gas_pump_scg.fm_static_eprm_bitfield.Sbx_cf_xxx ECU_ADDRESS 0xc0000474 BIT_MASK 0x80 /end MEASUREMENT
/begin MEASUREMENT Sbx_dyn_gas_pump_scw "" UBYTE _CNV_A_R_A_165_CM 1 0. 0. 255. DISPLAY_IDENTIFIER fm_sta_eprm_gas_pump_scw.fm_static_eprm_bitfield.Sbx_dyn_xxx ECU_ADDRESS 0xc0000476 BIT_MASK 0x8 /end MEASUREMENT
/begin MEASUREMENT Sbx_rdn_gas_pump_scw "" UBYTE _CNV_A_R_A_165_CM 1 0. 0. 255. DISPLAY_IDENTIFIER fm_sta_eprm_gas_pump_scw.fm_static_eprm_bitfield.Sbx_rdn_xxx ECU_ADDRESS 0xc0000476 BIT_MASK 0x10 /end MEASUREMENT
/begin MEASUREMENT Sbx_mf_gas_pump_scw "" UBYTE _CNV_A_R_A_165_CM 1 0. 0. 255. DISPLAY_IDENTIFIER fm_sta_eprm_gas_pump_scw.fm_static_eprm_bitfield.Sbx_mf_xxx ECU_ADDRESS 0xc0000476 BIT_MASK 0x20 /end MEASUREMENT
/begin MEASUREMENT Sbx_cf_gas_pump_scw "" UBYTE _CNV_A_R_A_165_CM 1 0. 0. 255. DISPLAY_IDENTIFIER fm_sta_eprm_gas_pump_scw.fm_static_eprm_bitfield.Sbx_cf_xxx ECU_ADDRESS 0xc0000476 BIT_MASK 0x80 /end MEASUREMENT
/begin MEASUREMENT Sbx_dyn_igc_1_oc "" UBYTE _CNV_A_R_A_165_CM 1 0. 0. 255. DISPLAY_IDENTIFIER fm_sta_eprm_igc_1_oc.fm_static_eprm_bitfield.Sbx_dyn_xxx ECU_ADDRESS 0xc0000594 BIT_MASK 0x8 /end MEASUREMENT
/begin MEASUREMENT Sbx_rdn_igc_1_oc "" UBYTE _CNV_A_R_A_165_CM 1 0. 0. 255. DISPLAY_IDENTIFIER fm_sta_eprm_igc_1_oc.fm_static_eprm_bitfield.Sbx_rdn_xxx ECU_ADDRESS 0xc0000594 BIT_MASK 0x10 /end MEASUREMENT
/begin MEASUREMENT Sbx_mf_igc_1_oc "" UBYTE _CNV_A_R_A_165_CM 1 0. 0. 255. DISPLAY_IDENTIFIER fm_sta_eprm_igc_1_oc.fm_static_eprm_bitfield.Sbx_mf_xxx ECU_ADDRESS 0xc0000594 BIT_MASK 0x20 /end MEASUREMENT
/begin MEASUREMENT Sbx_cf_igc_1_oc "" UBYTE _CNV_A_R_A_165_CM 1 0. 0. 255. DISPLAY_IDENTIFIER fm_sta_eprm_igc_1_oc.fm_static_eprm_bitfield.Sbx_cf_xxx ECU_ADDRESS 0xc0000594 BIT_MASK 0x80 /end MEASUREMENT
/begin MEASUREMENT Sbx_dyn_igc_1_scg "" UBYTE _CNV_A_R_A_165_CM 1 0. 0. 255. DISPLAY_IDENTIFIER fm_sta_eprm_igc_1_scg.fm_static_eprm_bitfield.Sbx_dyn_xxx ECU_ADDRESS 0xc0000596 BIT_MASK 0x8 /end MEASUREMENT
/begin MEASUREMENT Sbx_rdn_igc_1_scg "" UBYTE _CNV_A_R_A_165_CM 1 0. 0. 255. DISPLAY_IDENTIFIER fm_sta_eprm_igc_1_scg.fm_static_eprm_bitfield.Sbx_rdn_xxx ECU_ADDRESS 0xc0000596 BIT_MASK 0x10 /end MEASUREMENT
/begin MEASUREMENT Sbx_mf_igc_1_scg "" UBYTE _CNV_A_R_A_165_CM 1 0. 0. 255. DISPLAY_IDENTIFIER fm_sta_eprm_igc_1_scg.fm_static_eprm_bitfield.Sbx_mf_xxx ECU_ADDRESS 0xc0000596 BIT_MASK 0x20 /end MEASUREMENT
/begin MEASUREMENT Sbx_cf_igc_1_scg "" UBYTE _CNV_A_R_A_165_CM 1 0. 0. 255. DISPLAY_IDENTIFIER fm_sta_eprm_igc_1_scg.fm_static_eprm_bitfield.Sbx_cf_xxx ECU_ADDRESS 0xc0000596 BIT_MASK 0x80 /end MEASUREMENT
/begin MEASUREMENT Sbx_dyn_igc_1_scw "" UBYTE _CNV_A_R_A_165_CM 1 0. 0. 255. DISPLAY_IDENTIFIER fm_sta_eprm_igc_1_scw.fm_static_eprm_bitfield.Sbx_dyn_xxx ECU_ADDRESS 0xc0000598 BIT_MASK 0x8 /end MEASUREMENT
/begin MEASUREMENT Sbx_rdn_igc_1_scw "" UBYTE _CNV_A_R_A_165_CM 1 0. 0. 255. DISPLAY_IDENTIFIER fm_sta_eprm_igc_1_scw.fm_static_eprm_bitfield.Sbx_rdn_xxx ECU_ADDRESS 0xc0000598 BIT_MASK 0x10 /end MEASUREMENT
/begin MEASUREMENT Sbx_mf_igc_1_scw "" UBYTE _CNV_A_R_A_165_CM 1 0. 0. 255. DISPLAY_IDENTIFIER fm_sta_eprm_igc_1_scw.fm_static_eprm_bitfield.Sbx_mf_xxx ECU_ADDRESS 0xc0000598 BIT_MASK 0x20 /end MEASUREMENT
/begin MEASUREMENT Sbx_cf_igc_1_scw "" UBYTE _CNV_A_R_A_165_CM 1 0. 0. 255. DISPLAY_IDENTIFIER fm_sta_eprm_igc_1_scw.fm_static_eprm_bitfield.Sbx_cf_xxx ECU_ADDRESS 0xc0000598 BIT_MASK 0x80 /end MEASUREMENT
/begin MEASUREMENT Sbx_dyn_igc_2_oc "" UBYTE _CNV_A_R_A_165_CM 1 0. 0. 255. DISPLAY_IDENTIFIER fm_sta_eprm_igc_2_oc.fm_static_eprm_bitfield.Sbx_dyn_xxx ECU_ADDRESS 0xc000059a BIT_MASK 0x8 /end MEASUREMENT
/begin MEASUREMENT Sbx_rdn_igc_2_oc "" UBYTE _CNV_A_R_A_165_CM 1 0. 0. 255. DISPLAY_IDENTIFIER fm_sta_eprm_igc_2_oc.fm_static_eprm_bitfield.Sbx_rdn_xxx ECU_ADDRESS 0xc000059a BIT_MASK 0x10 /end MEASUREMENT
/begin MEASUREMENT Sbx_mf_igc_2_oc "" UBYTE _CNV_A_R_A_165_CM 1 0. 0. 255. DISPLAY_IDENTIFIER fm_sta_eprm_igc_2_oc.fm_static_eprm_bitfield.Sbx_mf_xxx ECU_ADDRESS 0xc000059a BIT_MASK 0x20 /end MEASUREMENT
/begin MEASUREMENT Sbx_cf_igc_2_oc "" UBYTE _CNV_A_R_A_165_CM 1 0. 0. 255. DISPLAY_IDENTIFIER fm_sta_eprm_igc_2_oc.fm_static_eprm_bitfield.Sbx_cf_xxx ECU_ADDRESS 0xc000059a BIT_MASK 0x80 /end MEASUREMENT
/begin MEASUREMENT Sbx_dyn_igc_2_scg "" UBYTE _CNV_A_R_A_165_CM 1 0. 0. 255. DISPLAY_IDENTIFIER fm_sta_eprm_igc_2_scg.fm_static_eprm_bitfield.Sbx_dyn_xxx ECU_ADDRESS 0xc00005a2 BIT_MASK 0x8 /end MEASUREMENT
/begin MEASUREMENT Sbx_rdn_igc_2_scg "" UBYTE _CNV_A_R_A_165_CM 1 0. 0. 255. DISPLAY_IDENTIFIER fm_sta_eprm_igc_2_scg.fm_static_eprm_bitfield.Sbx_rdn_xxx ECU_ADDRESS 0xc00005a2 BIT_MASK 0x10 /end MEASUREMENT
/begin MEASUREMENT Sbx_mf_igc_2_scg "" UBYTE _CNV_A_R_A_165_CM 1 0. 0. 255. DISPLAY_IDENTIFIER fm_sta_eprm_igc_2_scg.fm_static_eprm_bitfield.Sbx_mf_xxx ECU_ADDRESS 0xc00005a2 BIT_MASK 0x20 /end MEASUREMENT
/begin MEASUREMENT Sbx_cf_igc_2_scg "" UBYTE _CNV_A_R_A_165_CM 1 0. 0. 255. DISPLAY_IDENTIFIER fm_sta_eprm_igc_2_scg.fm_static_eprm_bitfield.Sbx_cf_xxx ECU_ADDRESS 0xc00005a2 BIT_MASK 0x80 /end MEASUREMENT
/begin MEASUREMENT Sbx_dyn_igc_2_scw "" UBYTE _CNV_A_R_A_165_CM 1 0. 0. 255. DISPLAY_IDENTIFIER fm_sta_eprm_igc_2_scw.fm_static_eprm_bitfield.Sbx_dyn_xxx ECU_ADDRESS 0xc00005a4 BIT_MASK 0x8 /end MEASUREMENT
/begin MEASUREMENT Sbx_rdn_igc_2_scw "" UBYTE _CNV_A_R_A_165_CM 1 0. 0. 255. DISPLAY_IDENTIFIER fm_sta_eprm_igc_2_scw.fm_static_eprm_bitfield.Sbx_rdn_xxx ECU_ADDRESS 0xc00005a4 BIT_MASK 0x10 /end MEASUREMENT
/begin MEASUREMENT Sbx_mf_igc_2_scw "" UBYTE _CNV_A_R_A_165_CM 1 0. 0. 255. DISPLAY_IDENTIFIER fm_sta_eprm_igc_2_scw.fm_static_eprm_bitfield.Sbx_mf_xxx ECU_ADDRESS 0xc00005a4 BIT_MASK 0x20 /end MEASUREMENT
/begin MEASUREMENT Sbx_cf_igc_2_scw "" UBYTE _CNV_A_R_A_165_CM 1 0. 0. 255. DISPLAY_IDENTIFIER fm_sta_eprm_igc_2_scw.fm_static_eprm_bitfield.Sbx_cf_xxx ECU_ADDRESS 0xc00005a4 BIT_MASK 0x80 /end MEASUREMENT
/begin MEASUREMENT Sbx_dyn_igc_3_oc "" UBYTE _CNV_A_R_A_165_CM 1 0. 0. 255. DISPLAY_IDENTIFIER fm_sta_eprm_igc_3_oc.fm_static_eprm_bitfield.Sbx_dyn_xxx ECU_ADDRESS 0xc00005a6 BIT_MASK 0x8 /end MEASUREMENT
/begin MEASUREMENT Sbx_rdn_igc_3_oc "" UBYTE _CNV_A_R_A_165_CM 1 0. 0. 255. DISPLAY_IDENTIFIER fm_sta_eprm_igc_3_oc.fm_static_eprm_bitfield.Sbx_rdn_xxx ECU_ADDRESS 0xc00005a6 BIT_MASK 0x10 /end MEASUREMENT
/begin MEASUREMENT Sbx_mf_igc_3_oc "" UBYTE _CNV_A_R_A_165_CM 1 0. 0. 255. DISPLAY_IDENTIFIER fm_sta_eprm_igc_3_oc.fm_static_eprm_bitfield.Sbx_mf_xxx ECU_ADDRESS 0xc00005a6 BIT_MASK 0x20 /end MEASUREMENT
/begin MEASUREMENT Sbx_cf_igc_3_oc "" UBYTE _CNV_A_R_A_165_CM 1 0. 0. 255. DISPLAY_IDENTIFIER fm_sta_eprm_igc_3_oc.fm_static_eprm_bitfield.Sbx_cf_xxx ECU_ADDRESS 0xc00005a6 BIT_MASK 0x80 /end MEASUREMENT
/begin MEASUREMENT Sbx_dyn_igc_3_scg "" UBYTE _CNV_A_R_A_165_CM 1 0. 0. 255. DISPLAY_IDENTIFIER fm_sta_eprm_igc_3_scg.fm_static_eprm_bitfield.Sbx_dyn_xxx ECU_ADDRESS 0xc00005a8 BIT_MASK 0x8 /end MEASUREMENT
/begin MEASUREMENT Sbx_rdn_igc_3_scg "" UBYTE _CNV_A_R_A_165_CM 1 0. 0. 255. DISPLAY_IDENTIFIER fm_sta_eprm_igc_3_scg.fm_static_eprm_bitfield.Sbx_rdn_xxx ECU_ADDRESS 0xc00005a8 BIT_MASK 0x10 /end MEASUREMENT
/begin MEASUREMENT Sbx_mf_igc_3_scg "" UBYTE _CNV_A_R_A_165_CM 1 0. 0. 255. DISPLAY_IDENTIFIER fm_sta_eprm_igc_3_scg.fm_static_eprm_bitfield.Sbx_mf_xxx ECU_ADDRESS 0xc00005a8 BIT_MASK 0x20 /end MEASUREMENT
/begin MEASUREMENT Sbx_cf_igc_3_scg "" UBYTE _CNV_A_R_A_165_CM 1 0. 0. 255. DISPLAY_IDENTIFIER fm_sta_eprm_igc_3_scg.fm_static_eprm_bitfield.Sbx_cf_xxx ECU_ADDRESS 0xc00005a8 BIT_MASK 0x80 /end MEASUREMENT
/begin MEASUREMENT Sbx_dyn_igc_3_scw "" UBYTE _CNV_A_R_A_165_CM 1 0. 0. 255. DISPLAY_IDENTIFIER fm_sta_eprm_igc_3_scw.fm_static_eprm_bitfield.Sbx_dyn_xxx ECU_ADDRESS 0xc00005aa BIT_MASK 0x8 /end MEASUREMENT
/begin MEASUREMENT Sbx_rdn_igc_3_scw "" UBYTE _CNV_A_R_A_165_CM 1 0. 0. 255. DISPLAY_IDENTIFIER fm_sta_eprm_igc_3_scw.fm_static_eprm_bitfield.Sbx_rdn_xxx ECU_ADDRESS 0xc00005aa BIT_MASK 0x10 /end MEASUREMENT
/begin MEASUREMENT Sbx_mf_igc_3_scw "" UBYTE _CNV_A_R_A_165_CM 1 0. 0. 255. DISPLAY_IDENTIFIER fm_sta_eprm_igc_3_scw.fm_static_eprm_bitfield.Sbx_mf_xxx ECU_ADDRESS 0xc00005aa BIT_MASK 0x20 /end MEASUREMENT
/begin MEASUREMENT Sbx_cf_igc_3_scw "" UBYTE _CNV_A_R_A_165_CM 1 0. 0. 255. DISPLAY_IDENTIFIER fm_sta_eprm_igc_3_scw.fm_static_eprm_bitfield.Sbx_cf_xxx ECU_ADDRESS 0xc00005aa BIT_MASK 0x80 /end MEASUREMENT
/begin MEASUREMENT Sbx_dyn_igc_4_oc "" UBYTE _CNV_A_R_A_165_CM 1 0. 0. 255. DISPLAY_IDENTIFIER fm_sta_eprm_igc_4_oc.fm_static_eprm_bitfield.Sbx_dyn_xxx ECU_ADDRESS 0xc00005ac BIT_MASK 0x8 /end MEASUREMENT
/begin MEASUREMENT Sbx_rdn_igc_4_oc "" UBYTE _CNV_A_R_A_165_CM 1 0. 0. 255. DISPLAY_IDENTIFIER fm_sta_eprm_igc_4_oc.fm_static_eprm_bitfield.Sbx_rdn_xxx ECU_ADDRESS 0xc00005ac BIT_MASK 0x10 /end MEASUREMENT
/begin MEASUREMENT Sbx_mf_igc_4_oc "" UBYTE _CNV_A_R_A_165_CM 1 0. 0. 255. DISPLAY_IDENTIFIER fm_sta_eprm_igc_4_oc.fm_static_eprm_bitfield.Sbx_mf_xxx ECU_ADDRESS 0xc00005ac BIT_MASK 0x20 /end MEASUREMENT
/begin MEASUREMENT Sbx_cf_igc_4_oc "" UBYTE _CNV_A_R_A_165_CM 1 0. 0. 255. DISPLAY_IDENTIFIER fm_sta_eprm_igc_4_oc.fm_static_eprm_bitfield.Sbx_cf_xxx ECU_ADDRESS 0xc00005ac BIT_MASK 0x80 /end MEASUREMENT
/begin MEASUREMENT Sbx_dyn_igc_4_scg "" UBYTE _CNV_A_R_A_165_CM 1 0. 0. 255. DISPLAY_IDENTIFIER fm_sta_eprm_igc_4_scg.fm_static_eprm_bitfield.Sbx_dyn_xxx ECU_ADDRESS 0xc00005ae BIT_MASK 0x8 /end MEASUREMENT
/begin MEASUREMENT Sbx_rdn_igc_4_scg "" UBYTE _CNV_A_R_A_165_CM 1 0. 0. 255. DISPLAY_IDENTIFIER fm_sta_eprm_igc_4_scg.fm_static_eprm_bitfield.Sbx_rdn_xxx ECU_ADDRESS 0xc00005ae BIT_MASK 0x10 /end MEASUREMENT
/begin MEASUREMENT Sbx_mf_igc_4_scg "" UBYTE _CNV_A_R_A_165_CM 1 0. 0. 255. DISPLAY_IDENTIFIER fm_sta_eprm_igc_4_scg.fm_static_eprm_bitfield.Sbx_mf_xxx ECU_ADDRESS 0xc00005ae BIT_MASK 0x20 /end MEASUREMENT
/begin MEASUREMENT Sbx_cf_igc_4_scg "" UBYTE _CNV_A_R_A_165_CM 1 0. 0. 255. DISPLAY_IDENTIFIER fm_sta_eprm_igc_4_scg.fm_static_eprm_bitfield.Sbx_cf_xxx ECU_ADDRESS 0xc00005ae BIT_MASK 0x80 /end MEASUREMENT
/begin MEASUREMENT Sbx_dyn_igc_4_scw "" UBYTE _CNV_A_R_A_165_CM 1 0. 0. 255. DISPLAY_IDENTIFIER fm_sta_eprm_igc_4_scw.fm_static_eprm_bitfield.Sbx_dyn_xxx ECU_ADDRESS 0xc00005b0 BIT_MASK 0x8 /end MEASUREMENT
/begin MEASUREMENT Sbx_rdn_igc_4_scw "" UBYTE _CNV_A_R_A_165_CM 1 0. 0. 255. DISPLAY_IDENTIFIER fm_sta_eprm_igc_4_scw.fm_static_eprm_bitfield.Sbx_rdn_xxx ECU_ADDRESS 0xc00005b0 BIT_MASK 0x10 /end MEASUREMENT
/begin MEASUREMENT Sbx_mf_igc_4_scw "" UBYTE _CNV_A_R_A_165_CM 1 0. 0. 255. DISPLAY_IDENTIFIER fm_sta_eprm_igc_4_scw.fm_static_eprm_bitfield.Sbx_mf_xxx ECU_ADDRESS 0xc00005b0 BIT_MASK 0x20 /end MEASUREMENT
/begin MEASUREMENT Sbx_cf_igc_4_scw "" UBYTE _CNV_A_R_A_165_CM 1 0. 0. 255. DISPLAY_IDENTIFIER fm_sta_eprm_igc_4_scw.fm_static_eprm_bitfield.Sbx_cf_xxx ECU_ADDRESS 0xc00005b0 BIT_MASK 0x80 /end MEASUREMENT
/begin MEASUREMENT Sbx_dyn_in_cam_chr "" UBYTE _CNV_A_R_A_165_CM 1 0. 0. 255. DISPLAY_IDENTIFIER fm_sta_eprm_in_cam_chr.fm_static_eprm_bitfield.Sbx_dyn_xxx ECU_ADDRESS 0xc0000560 BIT_MASK 0x8 /end MEASUREMENT
/begin MEASUREMENT Sbx_rdn_in_cam_chr "" UBYTE _CNV_A_R_A_165_CM 1 0. 0. 255. DISPLAY_IDENTIFIER fm_sta_eprm_in_cam_chr.fm_static_eprm_bitfield.Sbx_rdn_xxx ECU_ADDRESS 0xc0000560 BIT_MASK 0x10 /end MEASUREMENT
/begin MEASUREMENT Sbx_mf_in_cam_chr "" UBYTE _CNV_A_R_A_165_CM 1 0. 0. 255. DISPLAY_IDENTIFIER fm_sta_eprm_in_cam_chr.fm_static_eprm_bitfield.Sbx_mf_xxx ECU_ADDRESS 0xc0000560 BIT_MASK 0x20 /end MEASUREMENT
/begin MEASUREMENT Sbx_cf_in_cam_chr "" UBYTE _CNV_A_R_A_165_CM 1 0. 0. 255. DISPLAY_IDENTIFIER fm_sta_eprm_in_cam_chr.fm_static_eprm_bitfield.Sbx_cf_xxx ECU_ADDRESS 0xc0000560 BIT_MASK 0x80 /end MEASUREMENT
/begin MEASUREMENT Sbx_dyn_in_cam_crk_cmp "" UBYTE _CNV_A_R_A_165_CM 1 0. 0. 255. DISPLAY_IDENTIFIER fm_sta_eprm_in_cam_crk_cmp.fm_static_eprm_bitfield.Sbx_dyn_xxx ECU_ADDRESS 0xc0000562 BIT_MASK 0x8 /end MEASUREMENT
/begin MEASUREMENT Sbx_rdn_in_cam_crk_cmp "" UBYTE _CNV_A_R_A_165_CM 1 0. 0. 255. DISPLAY_IDENTIFIER fm_sta_eprm_in_cam_crk_cmp.fm_static_eprm_bitfield.Sbx_rdn_xxx ECU_ADDRESS 0xc0000562 BIT_MASK 0x10 /end MEASUREMENT
/begin MEASUREMENT Sbx_mf_in_cam_crk_cmp "" UBYTE _CNV_A_R_A_165_CM 1 0. 0. 255. DISPLAY_IDENTIFIER fm_sta_eprm_in_cam_crk_cmp.fm_static_eprm_bitfield.Sbx_mf_xxx ECU_ADDRESS 0xc0000562 BIT_MASK 0x20 /end MEASUREMENT
/begin MEASUREMENT Sbx_cf_in_cam_crk_cmp "" UBYTE _CNV_A_R_A_165_CM 1 0. 0. 255. DISPLAY_IDENTIFIER fm_sta_eprm_in_cam_crk_cmp.fm_static_eprm_bitfield.Sbx_cf_xxx ECU_ADDRESS 0xc0000562 BIT_MASK 0x80 /end MEASUREMENT
/begin MEASUREMENT Sbx_dyn_in_cam_cyc "" UBYTE _CNV_A_R_A_165_CM 1 0. 0. 255. DISPLAY_IDENTIFIER fm_sta_eprm_in_cam_cyc.fm_static_eprm_bitfield.Sbx_dyn_xxx ECU_ADDRESS 0xc0000582 BIT_MASK 0x8 /end MEASUREMENT
/begin MEASUREMENT Sbx_rdn_in_cam_cyc "" UBYTE _CNV_A_R_A_165_CM 1 0. 0. 255. DISPLAY_IDENTIFIER fm_sta_eprm_in_cam_cyc.fm_static_eprm_bitfield.Sbx_rdn_xxx ECU_ADDRESS 0xc0000582 BIT_MASK 0x10 /end MEASUREMENT
/begin MEASUREMENT Sbx_mf_in_cam_cyc "" UBYTE _CNV_A_R_A_165_CM 1 0. 0. 255. DISPLAY_IDENTIFIER fm_sta_eprm_in_cam_cyc.fm_static_eprm_bitfield.Sbx_mf_xxx ECU_ADDRESS 0xc0000582 BIT_MASK 0x20 /end MEASUREMENT
/begin MEASUREMENT Sbx_cf_in_cam_cyc "" UBYTE _CNV_A_R_A_165_CM 1 0. 0. 255. DISPLAY_IDENTIFIER fm_sta_eprm_in_cam_cyc.fm_static_eprm_bitfield.Sbx_cf_xxx ECU_ADDRESS 0xc0000582 BIT_MASK 0x80 /end MEASUREMENT
/begin MEASUREMENT Sbx_dyn_in_cam_no_sig "" UBYTE _CNV_A_R_A_165_CM 1 0. 0. 255. DISPLAY_IDENTIFIER fm_sta_eprm_in_cam_no_sig.fm_static_eprm_bitfield.Sbx_dyn_xxx ECU_ADDRESS 0xc0000564 BIT_MASK 0x8 /end MEASUREMENT
/begin MEASUREMENT Sbx_rdn_in_cam_no_sig "" UBYTE _CNV_A_R_A_165_CM 1 0. 0. 255. DISPLAY_IDENTIFIER fm_sta_eprm_in_cam_no_sig.fm_static_eprm_bitfield.Sbx_rdn_xxx ECU_ADDRESS 0xc0000564 BIT_MASK 0x10 /end MEASUREMENT
/begin MEASUREMENT Sbx_mf_in_cam_no_sig "" UBYTE _CNV_A_R_A_165_CM 1 0. 0. 255. DISPLAY_IDENTIFIER fm_sta_eprm_in_cam_no_sig.fm_static_eprm_bitfield.Sbx_mf_xxx ECU_ADDRESS 0xc0000564 BIT_MASK 0x20 /end MEASUREMENT
/begin MEASUREMENT Sbx_cf_in_cam_no_sig "" UBYTE _CNV_A_R_A_165_CM 1 0. 0. 255. DISPLAY_IDENTIFIER fm_sta_eprm_in_cam_no_sig.fm_static_eprm_bitfield.Sbx_cf_xxx ECU_ADDRESS 0xc0000564 BIT_MASK 0x80 /end MEASUREMENT
/begin MEASUREMENT Sbx_dyn_in_cam_nok "" UBYTE _CNV_A_R_A_165_CM 1 0. 0. 255. DISPLAY_IDENTIFIER fm_sta_eprm_in_cam_nok.fm_static_eprm_bitfield.Sbx_dyn_xxx ECU_ADDRESS 0xc0000580 BIT_MASK 0x8 /end MEASUREMENT
/begin MEASUREMENT Sbx_rdn_in_cam_nok "" UBYTE _CNV_A_R_A_165_CM 1 0. 0. 255. DISPLAY_IDENTIFIER fm_sta_eprm_in_cam_nok.fm_static_eprm_bitfield.Sbx_rdn_xxx ECU_ADDRESS 0xc0000580 BIT_MASK 0x10 /end MEASUREMENT
/begin MEASUREMENT Sbx_mf_in_cam_nok "" UBYTE _CNV_A_R_A_165_CM 1 0. 0. 255. DISPLAY_IDENTIFIER fm_sta_eprm_in_cam_nok.fm_static_eprm_bitfield.Sbx_mf_xxx ECU_ADDRESS 0xc0000580 BIT_MASK 0x20 /end MEASUREMENT
/begin MEASUREMENT Sbx_cf_in_cam_nok "" UBYTE _CNV_A_R_A_165_CM 1 0. 0. 255. DISPLAY_IDENTIFIER fm_sta_eprm_in_cam_nok.fm_static_eprm_bitfield.Sbx_cf_xxx ECU_ADDRESS 0xc0000580 BIT_MASK 0x80 /end MEASUREMENT
/begin MEASUREMENT Sbx_dyn_in_vvtc_ad "" UBYTE _CNV_A_R_A_165_CM 1 0. 0. 255. DISPLAY_IDENTIFIER fm_sta_eprm_in_vvtc_ad.fm_static_eprm_bitfield.Sbx_dyn_xxx ECU_ADDRESS 0xc0000566 BIT_MASK 0x8 /end MEASUREMENT
/begin MEASUREMENT Sbx_rdn_in_vvtc_ad "" UBYTE _CNV_A_R_A_165_CM 1 0. 0. 255. DISPLAY_IDENTIFIER fm_sta_eprm_in_vvtc_ad.fm_static_eprm_bitfield.Sbx_rdn_xxx ECU_ADDRESS 0xc0000566 BIT_MASK 0x10 /end MEASUREMENT
/begin MEASUREMENT Sbx_mf_in_vvtc_ad "" UBYTE _CNV_A_R_A_165_CM 1 0. 0. 255. DISPLAY_IDENTIFIER fm_sta_eprm_in_vvtc_ad.fm_static_eprm_bitfield.Sbx_mf_xxx ECU_ADDRESS 0xc0000566 BIT_MASK 0x20 /end MEASUREMENT
/begin MEASUREMENT Sbx_cf_in_vvtc_ad "" UBYTE _CNV_A_R_A_165_CM 1 0. 0. 255. DISPLAY_IDENTIFIER fm_sta_eprm_in_vvtc_ad.fm_static_eprm_bitfield.Sbx_cf_xxx ECU_ADDRESS 0xc0000566 BIT_MASK 0x80 /end MEASUREMENT
/begin MEASUREMENT Sbx_dyn_in_vvtc_blk "" UBYTE _CNV_A_R_A_165_CM 1 0. 0. 255. DISPLAY_IDENTIFIER fm_sta_eprm_in_vvtc_blk.fm_static_eprm_bitfield.Sbx_dyn_xxx ECU_ADDRESS 0xc0000478 BIT_MASK 0x8 /end MEASUREMENT
/begin MEASUREMENT Sbx_rdn_in_vvtc_blk "" UBYTE _CNV_A_R_A_165_CM 1 0. 0. 255. DISPLAY_IDENTIFIER fm_sta_eprm_in_vvtc_blk.fm_static_eprm_bitfield.Sbx_rdn_xxx ECU_ADDRESS 0xc0000478 BIT_MASK 0x10 /end MEASUREMENT
/begin MEASUREMENT Sbx_mf_in_vvtc_blk "" UBYTE _CNV_A_R_A_165_CM 1 0. 0. 255. DISPLAY_IDENTIFIER fm_sta_eprm_in_vvtc_blk.fm_static_eprm_bitfield.Sbx_mf_xxx ECU_ADDRESS 0xc0000478 BIT_MASK 0x20 /end MEASUREMENT
/begin MEASUREMENT Sbx_cf_in_vvtc_blk "" UBYTE _CNV_A_R_A_165_CM 1 0. 0. 255. DISPLAY_IDENTIFIER fm_sta_eprm_in_vvtc_blk.fm_static_eprm_bitfield.Sbx_cf_xxx ECU_ADDRESS 0xc0000478 BIT_MASK 0x80 /end MEASUREMENT
/begin MEASUREMENT Sbx_dyn_in_vvtc_dirt_lkg "" UBYTE _CNV_A_R_A_165_CM 1 0. 0. 255. DISPLAY_IDENTIFIER fm_sta_eprm_in_vvtc_dirt_lkg.fm_static_eprm_bitfield.Sbx_dyn_xxx ECU_ADDRESS 0xc000047a BIT_MASK 0x8 /end MEASUREMENT
/begin MEASUREMENT Sbx_rdn_in_vvtc_dirt_lkg "" UBYTE _CNV_A_R_A_165_CM 1 0. 0. 255. DISPLAY_IDENTIFIER fm_sta_eprm_in_vvtc_dirt_lkg.fm_static_eprm_bitfield.Sbx_rdn_xxx ECU_ADDRESS 0xc000047a BIT_MASK 0x10 /end MEASUREMENT
/begin MEASUREMENT Sbx_mf_in_vvtc_dirt_lkg "" UBYTE _CNV_A_R_A_165_CM 1 0. 0. 255. DISPLAY_IDENTIFIER fm_sta_eprm_in_vvtc_dirt_lkg.fm_static_eprm_bitfield.Sbx_mf_xxx ECU_ADDRESS 0xc000047a BIT_MASK 0x20 /end MEASUREMENT
/begin MEASUREMENT Sbx_cf_in_vvtc_dirt_lkg "" UBYTE _CNV_A_R_A_165_CM 1 0. 0. 255. DISPLAY_IDENTIFIER fm_sta_eprm_in_vvtc_dirt_lkg.fm_static_eprm_bitfield.Sbx_cf_xxx ECU_ADDRESS 0xc000047a BIT_MASK 0x80 /end MEASUREMENT
/begin MEASUREMENT Sbx_dyn_in_vvtc_sldv_oc "" UBYTE _CNV_A_R_A_165_CM 1 0. 0. 255. DISPLAY_IDENTIFIER fm_sta_eprm_in_vvtc_sldv_oc.fm_static_eprm_bitfield.Sbx_dyn_xxx ECU_ADDRESS 0xc000047c BIT_MASK 0x8 /end MEASUREMENT
/begin MEASUREMENT Sbx_rdn_in_vvtc_sldv_oc "" UBYTE _CNV_A_R_A_165_CM 1 0. 0. 255. DISPLAY_IDENTIFIER fm_sta_eprm_in_vvtc_sldv_oc.fm_static_eprm_bitfield.Sbx_rdn_xxx ECU_ADDRESS 0xc000047c BIT_MASK 0x10 /end MEASUREMENT
/begin MEASUREMENT Sbx_mf_in_vvtc_sldv_oc "" UBYTE _CNV_A_R_A_165_CM 1 0. 0. 255. DISPLAY_IDENTIFIER fm_sta_eprm_in_vvtc_sldv_oc.fm_static_eprm_bitfield.Sbx_mf_xxx ECU_ADDRESS 0xc000047c BIT_MASK 0x20 /end MEASUREMENT
/begin MEASUREMENT Sbx_cf_in_vvtc_sldv_oc "" UBYTE _CNV_A_R_A_165_CM 1 0. 0. 255. DISPLAY_IDENTIFIER fm_sta_eprm_in_vvtc_sldv_oc.fm_static_eprm_bitfield.Sbx_cf_xxx ECU_ADDRESS 0xc000047c BIT_MASK 0x80 /end MEASUREMENT
/begin MEASUREMENT Sbx_dyn_in_vvtc_sldv_scg "" UBYTE _CNV_A_R_A_165_CM 1 0. 0. 255. DISPLAY_IDENTIFIER fm_sta_eprm_in_vvtc_sldv_scg.fm_static_eprm_bitfield.Sbx_dyn_xxx ECU_ADDRESS 0xc000047e BIT_MASK 0x8 /end MEASUREMENT
/begin MEASUREMENT Sbx_rdn_in_vvtc_sldv_scg "" UBYTE _CNV_A_R_A_165_CM 1 0. 0. 255. DISPLAY_IDENTIFIER fm_sta_eprm_in_vvtc_sldv_scg.fm_static_eprm_bitfield.Sbx_rdn_xxx ECU_ADDRESS 0xc000047e BIT_MASK 0x10 /end MEASUREMENT
/begin MEASUREMENT Sbx_mf_in_vvtc_sldv_scg "" UBYTE _CNV_A_R_A_165_CM 1 0. 0. 255. DISPLAY_IDENTIFIER fm_sta_eprm_in_vvtc_sldv_scg.fm_static_eprm_bitfield.Sbx_mf_xxx ECU_ADDRESS 0xc000047e BIT_MASK 0x20 /end MEASUREMENT
/begin MEASUREMENT Sbx_cf_in_vvtc_sldv_scg "" UBYTE _CNV_A_R_A_165_CM 1 0. 0. 255. DISPLAY_IDENTIFIER fm_sta_eprm_in_vvtc_sldv_scg.fm_static_eprm_bitfield.Sbx_cf_xxx ECU_ADDRESS 0xc000047e BIT_MASK 0x80 /end MEASUREMENT
/begin MEASUREMENT Sbx_dyn_in_vvtc_sldv_scw "" UBYTE _CNV_A_R_A_165_CM 1 0. 0. 255. DISPLAY_IDENTIFIER fm_sta_eprm_in_vvtc_sldv_scw.fm_static_eprm_bitfield.Sbx_dyn_xxx ECU_ADDRESS 0xc0000480 BIT_MASK 0x8 /end MEASUREMENT
/begin MEASUREMENT Sbx_rdn_in_vvtc_sldv_scw "" UBYTE _CNV_A_R_A_165_CM 1 0. 0. 255. DISPLAY_IDENTIFIER fm_sta_eprm_in_vvtc_sldv_scw.fm_static_eprm_bitfield.Sbx_rdn_xxx ECU_ADDRESS 0xc0000480 BIT_MASK 0x10 /end MEASUREMENT
/begin MEASUREMENT Sbx_mf_in_vvtc_sldv_scw "" UBYTE _CNV_A_R_A_165_CM 1 0. 0. 255. DISPLAY_IDENTIFIER fm_sta_eprm_in_vvtc_sldv_scw.fm_static_eprm_bitfield.Sbx_mf_xxx ECU_ADDRESS 0xc0000480 BIT_MASK 0x20 /end MEASUREMENT
/begin MEASUREMENT Sbx_cf_in_vvtc_sldv_scw "" UBYTE _CNV_A_R_A_165_CM 1 0. 0. 255. DISPLAY_IDENTIFIER fm_sta_eprm_in_vvtc_sldv_scw.fm_static_eprm_bitfield.Sbx_cf_xxx ECU_ADDRESS 0xc0000480 BIT_MASK 0x80 /end MEASUREMENT
/begin MEASUREMENT Sbx_dyn_inj1_oc "" UBYTE _CNV_A_R_A_165_CM 1 0. 0. 255. DISPLAY_IDENTIFIER fm_sta_eprm_inj1_oc.fm_static_eprm_bitfield.Sbx_dyn_xxx ECU_ADDRESS 0xc0000486 BIT_MASK 0x8 /end MEASUREMENT
/begin MEASUREMENT Sbx_rdn_inj1_oc "" UBYTE _CNV_A_R_A_165_CM 1 0. 0. 255. DISPLAY_IDENTIFIER fm_sta_eprm_inj1_oc.fm_static_eprm_bitfield.Sbx_rdn_xxx ECU_ADDRESS 0xc0000486 BIT_MASK 0x10 /end MEASUREMENT
/begin MEASUREMENT Sbx_mf_inj1_oc "" UBYTE _CNV_A_R_A_165_CM 1 0. 0. 255. DISPLAY_IDENTIFIER fm_sta_eprm_inj1_oc.fm_static_eprm_bitfield.Sbx_mf_xxx ECU_ADDRESS 0xc0000486 BIT_MASK 0x20 /end MEASUREMENT
/begin MEASUREMENT Sbx_cf_inj1_oc "" UBYTE _CNV_A_R_A_165_CM 1 0. 0. 255. DISPLAY_IDENTIFIER fm_sta_eprm_inj1_oc.fm_static_eprm_bitfield.Sbx_cf_xxx ECU_ADDRESS 0xc0000486 BIT_MASK 0x80 /end MEASUREMENT
/begin MEASUREMENT Sbx_dyn_inj1_scg "" UBYTE _CNV_A_R_A_165_CM 1 0. 0. 255. DISPLAY_IDENTIFIER fm_sta_eprm_inj1_scg.fm_static_eprm_bitfield.Sbx_dyn_xxx ECU_ADDRESS 0xc0000488 BIT_MASK 0x8 /end MEASUREMENT
/begin MEASUREMENT Sbx_rdn_inj1_scg "" UBYTE _CNV_A_R_A_165_CM 1 0. 0. 255. DISPLAY_IDENTIFIER fm_sta_eprm_inj1_scg.fm_static_eprm_bitfield.Sbx_rdn_xxx ECU_ADDRESS 0xc0000488 BIT_MASK 0x10 /end MEASUREMENT
/begin MEASUREMENT Sbx_mf_inj1_scg "" UBYTE _CNV_A_R_A_165_CM 1 0. 0. 255. DISPLAY_IDENTIFIER fm_sta_eprm_inj1_scg.fm_static_eprm_bitfield.Sbx_mf_xxx ECU_ADDRESS 0xc0000488 BIT_MASK 0x20 /end MEASUREMENT
/begin MEASUREMENT Sbx_cf_inj1_scg "" UBYTE _CNV_A_R_A_165_CM 1 0. 0. 255. DISPLAY_IDENTIFIER fm_sta_eprm_inj1_scg.fm_static_eprm_bitfield.Sbx_cf_xxx ECU_ADDRESS 0xc0000488 BIT_MASK 0x80 /end MEASUREMENT
/begin MEASUREMENT Sbx_dyn_inj1_scw "" UBYTE _CNV_A_R_A_165_CM 1 0. 0. 255. DISPLAY_IDENTIFIER fm_sta_eprm_inj1_scw.fm_static_eprm_bitfield.Sbx_dyn_xxx ECU_ADDRESS 0xc000048a BIT_MASK 0x8 /end MEASUREMENT
/begin MEASUREMENT Sbx_rdn_inj1_scw "" UBYTE _CNV_A_R_A_165_CM 1 0. 0. 255. DISPLAY_IDENTIFIER fm_sta_eprm_inj1_scw.fm_static_eprm_bitfield.Sbx_rdn_xxx ECU_ADDRESS 0xc000048a BIT_MASK 0x10 /end MEASUREMENT
/begin MEASUREMENT Sbx_mf_inj1_scw "" UBYTE _CNV_A_R_A_165_CM 1 0. 0. 255. DISPLAY_IDENTIFIER fm_sta_eprm_inj1_scw.fm_static_eprm_bitfield.Sbx_mf_xxx ECU_ADDRESS 0xc000048a BIT_MASK 0x20 /end MEASUREMENT
/begin MEASUREMENT Sbx_cf_inj1_scw "" UBYTE _CNV_A_R_A_165_CM 1 0. 0. 255. DISPLAY_IDENTIFIER fm_sta_eprm_inj1_scw.fm_static_eprm_bitfield.Sbx_cf_xxx ECU_ADDRESS 0xc000048a BIT_MASK 0x80 /end MEASUREMENT
/begin MEASUREMENT Sbx_dyn_inj2_oc "" UBYTE _CNV_A_R_A_165_CM 1 0. 0. 255. DISPLAY_IDENTIFIER fm_sta_eprm_inj2_oc.fm_static_eprm_bitfield.Sbx_dyn_xxx ECU_ADDRESS 0xc000048c BIT_MASK 0x8 /end MEASUREMENT
/begin MEASUREMENT Sbx_rdn_inj2_oc "" UBYTE _CNV_A_R_A_165_CM 1 0. 0. 255. DISPLAY_IDENTIFIER fm_sta_eprm_inj2_oc.fm_static_eprm_bitfield.Sbx_rdn_xxx ECU_ADDRESS 0xc000048c BIT_MASK 0x10 /end MEASUREMENT
/begin MEASUREMENT Sbx_mf_inj2_oc "" UBYTE _CNV_A_R_A_165_CM 1 0. 0. 255. DISPLAY_IDENTIFIER fm_sta_eprm_inj2_oc.fm_static_eprm_bitfield.Sbx_mf_xxx ECU_ADDRESS 0xc000048c BIT_MASK 0x20 /end MEASUREMENT
/begin MEASUREMENT Sbx_cf_inj2_oc "" UBYTE _CNV_A_R_A_165_CM 1 0. 0. 255. DISPLAY_IDENTIFIER fm_sta_eprm_inj2_oc.fm_static_eprm_bitfield.Sbx_cf_xxx ECU_ADDRESS 0xc000048c BIT_MASK 0x80 /end MEASUREMENT
/begin MEASUREMENT Sbx_dyn_inj2_scg "" UBYTE _CNV_A_R_A_165_CM 1 0. 0. 255. DISPLAY_IDENTIFIER fm_sta_eprm_inj2_scg.fm_static_eprm_bitfield.Sbx_dyn_xxx ECU_ADDRESS 0xc000048e BIT_MASK 0x8 /end MEASUREMENT
/begin MEASUREMENT Sbx_rdn_inj2_scg "" UBYTE _CNV_A_R_A_165_CM 1 0. 0. 255. DISPLAY_IDENTIFIER fm_sta_eprm_inj2_scg.fm_static_eprm_bitfield.Sbx_rdn_xxx ECU_ADDRESS 0xc000048e BIT_MASK 0x10 /end MEASUREMENT
/begin MEASUREMENT Sbx_mf_inj2_scg "" UBYTE _CNV_A_R_A_165_CM 1 0. 0. 255. DISPLAY_IDENTIFIER fm_sta_eprm_inj2_scg.fm_static_eprm_bitfield.Sbx_mf_xxx ECU_ADDRESS 0xc000048e BIT_MASK 0x20 /end MEASUREMENT
/begin MEASUREMENT Sbx_cf_inj2_scg "" UBYTE _CNV_A_R_A_165_CM 1 0. 0. 255. DISPLAY_IDENTIFIER fm_sta_eprm_inj2_scg.fm_static_eprm_bitfield.Sbx_cf_xxx ECU_ADDRESS 0xc000048e BIT_MASK 0x80 /end MEASUREMENT
/begin MEASUREMENT Sbx_dyn_inj2_scw "" UBYTE _CNV_A_R_A_165_CM 1 0. 0. 255. DISPLAY_IDENTIFIER fm_sta_eprm_inj2_scw.fm_static_eprm_bitfield.Sbx_dyn_xxx ECU_ADDRESS 0xc0000490 BIT_MASK 0x8 /end MEASUREMENT
/begin MEASUREMENT Sbx_rdn_inj2_scw "" UBYTE _CNV_A_R_A_165_CM 1 0. 0. 255. DISPLAY_IDENTIFIER fm_sta_eprm_inj2_scw.fm_static_eprm_bitfield.Sbx_rdn_xxx ECU_ADDRESS 0xc0000490 BIT_MASK 0x10 /end MEASUREMENT
/begin MEASUREMENT Sbx_mf_inj2_scw "" UBYTE _CNV_A_R_A_165_CM 1 0. 0. 255. DISPLAY_IDENTIFIER fm_sta_eprm_inj2_scw.fm_static_eprm_bitfield.Sbx_mf_xxx ECU_ADDRESS 0xc0000490 BIT_MASK 0x20 /end MEASUREMENT
/begin MEASUREMENT Sbx_cf_inj2_scw "" UBYTE _CNV_A_R_A_165_CM 1 0. 0. 255. DISPLAY_IDENTIFIER fm_sta_eprm_inj2_scw.fm_static_eprm_bitfield.Sbx_cf_xxx ECU_ADDRESS 0xc0000490 BIT_MASK 0x80 /end MEASUREMENT
/begin MEASUREMENT Sbx_dyn_inj3_oc "" UBYTE _CNV_A_R_A_165_CM 1 0. 0. 255. DISPLAY_IDENTIFIER fm_sta_eprm_inj3_oc.fm_static_eprm_bitfield.Sbx_dyn_xxx ECU_ADDRESS 0xc0000492 BIT_MASK 0x8 /end MEASUREMENT
/begin MEASUREMENT Sbx_rdn_inj3_oc "" UBYTE _CNV_A_R_A_165_CM 1 0. 0. 255. DISPLAY_IDENTIFIER fm_sta_eprm_inj3_oc.fm_static_eprm_bitfield.Sbx_rdn_xxx ECU_ADDRESS 0xc0000492 BIT_MASK 0x10 /end MEASUREMENT
/begin MEASUREMENT Sbx_mf_inj3_oc "" UBYTE _CNV_A_R_A_165_CM 1 0. 0. 255. DISPLAY_IDENTIFIER fm_sta_eprm_inj3_oc.fm_static_eprm_bitfield.Sbx_mf_xxx ECU_ADDRESS 0xc0000492 BIT_MASK 0x20 /end MEASUREMENT
/begin MEASUREMENT Sbx_cf_inj3_oc "" UBYTE _CNV_A_R_A_165_CM 1 0. 0. 255. DISPLAY_IDENTIFIER fm_sta_eprm_inj3_oc.fm_static_eprm_bitfield.Sbx_cf_xxx ECU_ADDRESS 0xc0000492 BIT_MASK 0x80 /end MEASUREMENT
/begin MEASUREMENT Sbx_dyn_inj3_scg "" UBYTE _CNV_A_R_A_165_CM 1 0. 0. 255. DISPLAY_IDENTIFIER fm_sta_eprm_inj3_scg.fm_static_eprm_bitfield.Sbx_dyn_xxx ECU_ADDRESS 0xc0000494 BIT_MASK 0x8 /end MEASUREMENT
/begin MEASUREMENT Sbx_rdn_inj3_scg "" UBYTE _CNV_A_R_A_165_CM 1 0. 0. 255. DISPLAY_IDENTIFIER fm_sta_eprm_inj3_scg.fm_static_eprm_bitfield.Sbx_rdn_xxx ECU_ADDRESS 0xc0000494 BIT_MASK 0x10 /end MEASUREMENT
/begin MEASUREMENT Sbx_mf_inj3_scg "" UBYTE _CNV_A_R_A_165_CM 1 0. 0. 255. DISPLAY_IDENTIFIER fm_sta_eprm_inj3_scg.fm_static_eprm_bitfield.Sbx_mf_xxx ECU_ADDRESS 0xc0000494 BIT_MASK 0x20 /end MEASUREMENT
/begin MEASUREMENT Sbx_cf_inj3_scg "" UBYTE _CNV_A_R_A_165_CM 1 0. 0. 255. DISPLAY_IDENTIFIER fm_sta_eprm_inj3_scg.fm_static_eprm_bitfield.Sbx_cf_xxx ECU_ADDRESS 0xc0000494 BIT_MASK 0x80 /end MEASUREMENT
/begin MEASUREMENT Sbx_dyn_inj3_scw "" UBYTE _CNV_A_R_A_165_CM 1 0. 0. 255. DISPLAY_IDENTIFIER fm_sta_eprm_inj3_scw.fm_static_eprm_bitfield.Sbx_dyn_xxx ECU_ADDRESS 0xc0000496 BIT_MASK 0x8 /end MEASUREMENT
/begin MEASUREMENT Sbx_rdn_inj3_scw "" UBYTE _CNV_A_R_A_165_CM 1 0. 0. 255. DISPLAY_IDENTIFIER fm_sta_eprm_inj3_scw.fm_static_eprm_bitfield.Sbx_rdn_xxx ECU_ADDRESS 0xc0000496 BIT_MASK 0x10 /end MEASUREMENT
/begin MEASUREMENT Sbx_mf_inj3_scw "" UBYTE _CNV_A_R_A_165_CM 1 0. 0. 255. DISPLAY_IDENTIFIER fm_sta_eprm_inj3_scw.fm_static_eprm_bitfield.Sbx_mf_xxx ECU_ADDRESS 0xc0000496 BIT_MASK 0x20 /end MEASUREMENT
/begin MEASUREMENT Sbx_cf_inj3_scw "" UBYTE _CNV_A_R_A_165_CM 1 0. 0. 255. DISPLAY_IDENTIFIER fm_sta_eprm_inj3_scw.fm_static_eprm_bitfield.Sbx_cf_xxx ECU_ADDRESS 0xc0000496 BIT_MASK 0x80 /end MEASUREMENT
/begin MEASUREMENT Sbx_dyn_inj4_oc "" UBYTE _CNV_A_R_A_165_CM 1 0. 0. 255. DISPLAY_IDENTIFIER fm_sta_eprm_inj4_oc.fm_static_eprm_bitfield.Sbx_dyn_xxx ECU_ADDRESS 0xc0000498 BIT_MASK 0x8 /end MEASUREMENT
/begin MEASUREMENT Sbx_rdn_inj4_oc "" UBYTE _CNV_A_R_A_165_CM 1 0. 0. 255. DISPLAY_IDENTIFIER fm_sta_eprm_inj4_oc.fm_static_eprm_bitfield.Sbx_rdn_xxx ECU_ADDRESS 0xc0000498 BIT_MASK 0x10 /end MEASUREMENT
/begin MEASUREMENT Sbx_mf_inj4_oc "" UBYTE _CNV_A_R_A_165_CM 1 0. 0. 255. DISPLAY_IDENTIFIER fm_sta_eprm_inj4_oc.fm_static_eprm_bitfield.Sbx_mf_xxx ECU_ADDRESS 0xc0000498 BIT_MASK 0x20 /end MEASUREMENT
/begin MEASUREMENT Sbx_cf_inj4_oc "" UBYTE _CNV_A_R_A_165_CM 1 0. 0. 255. DISPLAY_IDENTIFIER fm_sta_eprm_inj4_oc.fm_static_eprm_bitfield.Sbx_cf_xxx ECU_ADDRESS 0xc0000498 BIT_MASK 0x80 /end MEASUREMENT
/begin MEASUREMENT Sbx_dyn_inj4_scg "" UBYTE _CNV_A_R_A_165_CM 1 0. 0. 255. DISPLAY_IDENTIFIER fm_sta_eprm_inj4_scg.fm_static_eprm_bitfield.Sbx_dyn_xxx ECU_ADDRESS 0xc000049a BIT_MASK 0x8 /end MEASUREMENT
/begin MEASUREMENT Sbx_rdn_inj4_scg "" UBYTE _CNV_A_R_A_165_CM 1 0. 0. 255. DISPLAY_IDENTIFIER fm_sta_eprm_inj4_scg.fm_static_eprm_bitfield.Sbx_rdn_xxx ECU_ADDRESS 0xc000049a BIT_MASK 0x10 /end MEASUREMENT
/begin MEASUREMENT Sbx_mf_inj4_scg "" UBYTE _CNV_A_R_A_165_CM 1 0. 0. 255. DISPLAY_IDENTIFIER fm_sta_eprm_inj4_scg.fm_static_eprm_bitfield.Sbx_mf_xxx ECU_ADDRESS 0xc000049a BIT_MASK 0x20 /end MEASUREMENT
/begin MEASUREMENT Sbx_cf_inj4_scg "" UBYTE _CNV_A_R_A_165_CM 1 0. 0. 255. DISPLAY_IDENTIFIER fm_sta_eprm_inj4_scg.fm_static_eprm_bitfield.Sbx_cf_xxx ECU_ADDRESS 0xc000049a BIT_MASK 0x80 /end MEASUREMENT
/begin MEASUREMENT Sbx_dyn_inj4_scw "" UBYTE _CNV_A_R_A_165_CM 1 0. 0. 255. DISPLAY_IDENTIFIER fm_sta_eprm_inj4_scw.fm_static_eprm_bitfield.Sbx_dyn_xxx ECU_ADDRESS 0xc000049c BIT_MASK 0x8 /end MEASUREMENT
/begin MEASUREMENT Sbx_rdn_inj4_scw "" UBYTE _CNV_A_R_A_165_CM 1 0. 0. 255. DISPLAY_IDENTIFIER fm_sta_eprm_inj4_scw.fm_static_eprm_bitfield.Sbx_rdn_xxx ECU_ADDRESS 0xc000049c BIT_MASK 0x10 /end MEASUREMENT
/begin MEASUREMENT Sbx_mf_inj4_scw "" UBYTE _CNV_A_R_A_165_CM 1 0. 0. 255. DISPLAY_IDENTIFIER fm_sta_eprm_inj4_scw.fm_static_eprm_bitfield.Sbx_mf_xxx ECU_ADDRESS 0xc000049c BIT_MASK 0x20 /end MEASUREMENT
/begin MEASUREMENT Sbx_cf_inj4_scw "" UBYTE _CNV_A_R_A_165_CM 1 0. 0. 255. DISPLAY_IDENTIFIER fm_sta_eprm_inj4_scw.fm_static_eprm_bitfield.Sbx_cf_xxx ECU_ADDRESS 0xc000049c BIT_MASK 0x80 /end MEASUREMENT
/begin MEASUREMENT Sbx_dyn_inj_ecu_itl "" UBYTE _CNV_A_R_A_165_CM 1 0. 0. 255. DISPLAY_IDENTIFIER fm_sta_eprm_inj_ecu_itl.fm_static_eprm_bitfield.Sbx_dyn_xxx ECU_ADDRESS 0xc0000576 BIT_MASK 0x8 /end MEASUREMENT
/begin MEASUREMENT Sbx_rdn_inj_ecu_itl "" UBYTE _CNV_A_R_A_165_CM 1 0. 0. 255. DISPLAY_IDENTIFIER fm_sta_eprm_inj_ecu_itl.fm_static_eprm_bitfield.Sbx_rdn_xxx ECU_ADDRESS 0xc0000576 BIT_MASK 0x10 /end MEASUREMENT
/begin MEASUREMENT Sbx_mf_inj_ecu_itl "" UBYTE _CNV_A_R_A_165_CM 1 0. 0. 255. DISPLAY_IDENTIFIER fm_sta_eprm_inj_ecu_itl.fm_static_eprm_bitfield.Sbx_mf_xxx ECU_ADDRESS 0xc0000576 BIT_MASK 0x20 /end MEASUREMENT
/begin MEASUREMENT Sbx_cf_inj_ecu_itl "" UBYTE _CNV_A_R_A_165_CM 1 0. 0. 255. DISPLAY_IDENTIFIER fm_sta_eprm_inj_ecu_itl.fm_static_eprm_bitfield.Sbx_cf_xxx ECU_ADDRESS 0xc0000576 BIT_MASK 0x80 /end MEASUREMENT
/begin MEASUREMENT Sbx_dyn_inj_ecu_lbdw_icp "" UBYTE _CNV_A_R_A_165_CM 1 0. 0. 255. DISPLAY_IDENTIFIER fm_sta_eprm_inj_ecu_lbdw_icp.fm_static_eprm_bitfield.Sbx_dyn_xxx ECU_ADDRESS 0xc0000482 BIT_MASK 0x8 /end MEASUREMENT
/begin MEASUREMENT Sbx_rdn_inj_ecu_lbdw_icp "" UBYTE _CNV_A_R_A_165_CM 1 0. 0. 255. DISPLAY_IDENTIFIER fm_sta_eprm_inj_ecu_lbdw_icp.fm_static_eprm_bitfield.Sbx_rdn_xxx ECU_ADDRESS 0xc0000482 BIT_MASK 0x10 /end MEASUREMENT
/begin MEASUREMENT Sbx_mf_inj_ecu_lbdw_icp "" UBYTE _CNV_A_R_A_165_CM 1 0. 0. 255. DISPLAY_IDENTIFIER fm_sta_eprm_inj_ecu_lbdw_icp.fm_static_eprm_bitfield.Sbx_mf_xxx ECU_ADDRESS 0xc0000482 BIT_MASK 0x20 /end MEASUREMENT
/begin MEASUREMENT Sbx_cf_inj_ecu_lbdw_icp "" UBYTE _CNV_A_R_A_165_CM 1 0. 0. 255. DISPLAY_IDENTIFIER fm_sta_eprm_inj_ecu_lbdw_icp.fm_static_eprm_bitfield.Sbx_cf_xxx ECU_ADDRESS 0xc0000482 BIT_MASK 0x80 /end MEASUREMENT
/begin MEASUREMENT Sbx_dyn_inj_ecu_lbup_icp "" UBYTE _CNV_A_R_A_165_CM 1 0. 0. 255. DISPLAY_IDENTIFIER fm_sta_eprm_inj_ecu_lbup_icp.fm_static_eprm_bitfield.Sbx_dyn_xxx ECU_ADDRESS 0xc0000484 BIT_MASK 0x8 /end MEASUREMENT
/begin MEASUREMENT Sbx_rdn_inj_ecu_lbup_icp "" UBYTE _CNV_A_R_A_165_CM 1 0. 0. 255. DISPLAY_IDENTIFIER fm_sta_eprm_inj_ecu_lbup_icp.fm_static_eprm_bitfield.Sbx_rdn_xxx ECU_ADDRESS 0xc0000484 BIT_MASK 0x10 /end MEASUREMENT
/begin MEASUREMENT Sbx_mf_inj_ecu_lbup_icp "" UBYTE _CNV_A_R_A_165_CM 1 0. 0. 255. DISPLAY_IDENTIFIER fm_sta_eprm_inj_ecu_lbup_icp.fm_static_eprm_bitfield.Sbx_mf_xxx ECU_ADDRESS 0xc0000484 BIT_MASK 0x20 /end MEASUREMENT
/begin MEASUREMENT Sbx_cf_inj_ecu_lbup_icp "" UBYTE _CNV_A_R_A_165_CM 1 0. 0. 255. DISPLAY_IDENTIFIER fm_sta_eprm_inj_ecu_lbup_icp.fm_static_eprm_bitfield.Sbx_cf_xxx ECU_ADDRESS 0xc0000484 BIT_MASK 0x80 /end MEASUREMENT
/begin MEASUREMENT Sbx_dyn_ip_lght_tco_ovh "" UBYTE _CNV_A_R_A_165_CM 1 0. 0. 255. DISPLAY_IDENTIFIER fm_sta_eprm_ip_lght_tco_ovh.fm_static_eprm_bitfield.Sbx_dyn_xxx ECU_ADDRESS 0xc0000578 BIT_MASK 0x8 /end MEASUREMENT
/begin MEASUREMENT Sbx_rdn_ip_lght_tco_ovh "" UBYTE _CNV_A_R_A_165_CM 1 0. 0. 255. DISPLAY_IDENTIFIER fm_sta_eprm_ip_lght_tco_ovh.fm_static_eprm_bitfield.Sbx_rdn_xxx ECU_ADDRESS 0xc0000578 BIT_MASK 0x10 /end MEASUREMENT
/begin MEASUREMENT Sbx_mf_ip_lght_tco_ovh "" UBYTE _CNV_A_R_A_165_CM 1 0. 0. 255. DISPLAY_IDENTIFIER fm_sta_eprm_ip_lght_tco_ovh.fm_static_eprm_bitfield.Sbx_mf_xxx ECU_ADDRESS 0xc0000578 BIT_MASK 0x20 /end MEASUREMENT
/begin MEASUREMENT Sbx_cf_ip_lght_tco_ovh "" UBYTE _CNV_A_R_A_165_CM 1 0. 0. 255. DISPLAY_IDENTIFIER fm_sta_eprm_ip_lght_tco_ovh.fm_static_eprm_bitfield.Sbx_cf_xxx ECU_ADDRESS 0xc0000578 BIT_MASK 0x80 /end MEASUREMENT
/begin MEASUREMENT Sbx_dyn_it_cmd_el "" UBYTE _CNV_A_R_A_165_CM 1 0. 0. 255. DISPLAY_IDENTIFIER fm_sta_eprm_it_cmd_el.fm_static_eprm_bitfield.Sbx_dyn_xxx ECU_ADDRESS 0xc000049e BIT_MASK 0x8 /end MEASUREMENT
/begin MEASUREMENT Sbx_rdn_it_cmd_el "" UBYTE _CNV_A_R_A_165_CM 1 0. 0. 255. DISPLAY_IDENTIFIER fm_sta_eprm_it_cmd_el.fm_static_eprm_bitfield.Sbx_rdn_xxx ECU_ADDRESS 0xc000049e BIT_MASK 0x10 /end MEASUREMENT
/begin MEASUREMENT Sbx_mf_it_cmd_el "" UBYTE _CNV_A_R_A_165_CM 1 0. 0. 255. DISPLAY_IDENTIFIER fm_sta_eprm_it_cmd_el.fm_static_eprm_bitfield.Sbx_mf_xxx ECU_ADDRESS 0xc000049e BIT_MASK 0x20 /end MEASUREMENT
/begin MEASUREMENT Sbx_cf_it_cmd_el "" UBYTE _CNV_A_R_A_165_CM 1 0. 0. 255. DISPLAY_IDENTIFIER fm_sta_eprm_it_cmd_el.fm_static_eprm_bitfield.Sbx_cf_xxx ECU_ADDRESS 0xc000049e BIT_MASK 0x80 /end MEASUREMENT
/begin MEASUREMENT Sbx_dyn_it_ofs_meca "" UBYTE _CNV_A_R_A_165_CM 1 0. 0. 255. DISPLAY_IDENTIFIER fm_sta_eprm_it_ofs_meca.fm_static_eprm_bitfield.Sbx_dyn_xxx ECU_ADDRESS 0xc00004a0 BIT_MASK 0x8 /end MEASUREMENT
/begin MEASUREMENT Sbx_rdn_it_ofs_meca "" UBYTE _CNV_A_R_A_165_CM 1 0. 0. 255. DISPLAY_IDENTIFIER fm_sta_eprm_it_ofs_meca.fm_static_eprm_bitfield.Sbx_rdn_xxx ECU_ADDRESS 0xc00004a0 BIT_MASK 0x10 /end MEASUREMENT
/begin MEASUREMENT Sbx_mf_it_ofs_meca "" UBYTE _CNV_A_R_A_165_CM 1 0. 0. 255. DISPLAY_IDENTIFIER fm_sta_eprm_it_ofs_meca.fm_static_eprm_bitfield.Sbx_mf_xxx ECU_ADDRESS 0xc00004a0 BIT_MASK 0x20 /end MEASUREMENT
/begin MEASUREMENT Sbx_cf_it_ofs_meca "" UBYTE _CNV_A_R_A_165_CM 1 0. 0. 255. DISPLAY_IDENTIFIER fm_sta_eprm_it_ofs_meca.fm_static_eprm_bitfield.Sbx_cf_xxx ECU_ADDRESS 0xc00004a0 BIT_MASK 0x80 /end MEASUREMENT
/begin MEASUREMENT Sbx_dyn_it_ofs_no_norm "" UBYTE _CNV_A_R_A_165_CM 1 0. 0. 255. DISPLAY_IDENTIFIER fm_sta_eprm_it_ofs_no_norm.fm_static_eprm_bitfield.Sbx_dyn_xxx ECU_ADDRESS 0xc00004a2 BIT_MASK 0x8 /end MEASUREMENT
/begin MEASUREMENT Sbx_rdn_it_ofs_no_norm "" UBYTE _CNV_A_R_A_165_CM 1 0. 0. 255. DISPLAY_IDENTIFIER fm_sta_eprm_it_ofs_no_norm.fm_static_eprm_bitfield.Sbx_rdn_xxx ECU_ADDRESS 0xc00004a2 BIT_MASK 0x10 /end MEASUREMENT
/begin MEASUREMENT Sbx_mf_it_ofs_no_norm "" UBYTE _CNV_A_R_A_165_CM 1 0. 0. 255. DISPLAY_IDENTIFIER fm_sta_eprm_it_ofs_no_norm.fm_static_eprm_bitfield.Sbx_mf_xxx ECU_ADDRESS 0xc00004a2 BIT_MASK 0x20 /end MEASUREMENT
/begin MEASUREMENT Sbx_cf_it_ofs_no_norm "" UBYTE _CNV_A_R_A_165_CM 1 0. 0. 255. DISPLAY_IDENTIFIER fm_sta_eprm_it_ofs_no_norm.fm_static_eprm_bitfield.Sbx_cf_xxx ECU_ADDRESS 0xc00004a2 BIT_MASK 0x80 /end MEASUREMENT
/begin MEASUREMENT Sbx_dyn_it_ofs_secu_nok "" UBYTE _CNV_A_R_A_165_CM 1 0. 0. 255. DISPLAY_IDENTIFIER fm_sta_eprm_it_ofs_secu_nok.fm_static_eprm_bitfield.Sbx_dyn_xxx ECU_ADDRESS 0xc00004a4 BIT_MASK 0x8 /end MEASUREMENT
/begin MEASUREMENT Sbx_rdn_it_ofs_secu_nok "" UBYTE _CNV_A_R_A_165_CM 1 0. 0. 255. DISPLAY_IDENTIFIER fm_sta_eprm_it_ofs_secu_nok.fm_static_eprm_bitfield.Sbx_rdn_xxx ECU_ADDRESS 0xc00004a4 BIT_MASK 0x10 /end MEASUREMENT
/begin MEASUREMENT Sbx_mf_it_ofs_secu_nok "" UBYTE _CNV_A_R_A_165_CM 1 0. 0. 255. DISPLAY_IDENTIFIER fm_sta_eprm_it_ofs_secu_nok.fm_static_eprm_bitfield.Sbx_mf_xxx ECU_ADDRESS 0xc00004a4 BIT_MASK 0x20 /end MEASUREMENT
/begin MEASUREMENT Sbx_cf_it_ofs_secu_nok "" UBYTE _CNV_A_R_A_165_CM 1 0. 0. 255. DISPLAY_IDENTIFIER fm_sta_eprm_it_ofs_secu_nok.fm_static_eprm_bitfield.Sbx_cf_xxx ECU_ADDRESS 0xc00004a4 BIT_MASK 0x80 /end MEASUREMENT
/begin MEASUREMENT Sbx_dyn_it_reg_blk "" UBYTE _CNV_A_R_A_165_CM 1 0. 0. 255. DISPLAY_IDENTIFIER fm_sta_eprm_it_reg_blk.fm_static_eprm_bitfield.Sbx_dyn_xxx ECU_ADDRESS 0xc00004a6 BIT_MASK 0x8 /end MEASUREMENT
/begin MEASUREMENT Sbx_rdn_it_reg_blk "" UBYTE _CNV_A_R_A_165_CM 1 0. 0. 255. DISPLAY_IDENTIFIER fm_sta_eprm_it_reg_blk.fm_static_eprm_bitfield.Sbx_rdn_xxx ECU_ADDRESS 0xc00004a6 BIT_MASK 0x10 /end MEASUREMENT
/begin MEASUREMENT Sbx_mf_it_reg_blk "" UBYTE _CNV_A_R_A_165_CM 1 0. 0. 255. DISPLAY_IDENTIFIER fm_sta_eprm_it_reg_blk.fm_static_eprm_bitfield.Sbx_mf_xxx ECU_ADDRESS 0xc00004a6 BIT_MASK 0x20 /end MEASUREMENT
/begin MEASUREMENT Sbx_cf_it_reg_blk "" UBYTE _CNV_A_R_A_165_CM 1 0. 0. 255. DISPLAY_IDENTIFIER fm_sta_eprm_it_reg_blk.fm_static_eprm_bitfield.Sbx_cf_xxx ECU_ADDRESS 0xc00004a6 BIT_MASK 0x80 /end MEASUREMENT
/begin MEASUREMENT Sbx_dyn_knk_oor "" UBYTE _CNV_A_R_A_165_CM 1 0. 0. 255. DISPLAY_IDENTIFIER fm_sta_eprm_knk_oor.fm_static_eprm_bitfield.Sbx_dyn_xxx ECU_ADDRESS 0xc00004a8 BIT_MASK 0x8 /end MEASUREMENT
/begin MEASUREMENT Sbx_rdn_knk_oor "" UBYTE _CNV_A_R_A_165_CM 1 0. 0. 255. DISPLAY_IDENTIFIER fm_sta_eprm_knk_oor.fm_static_eprm_bitfield.Sbx_rdn_xxx ECU_ADDRESS 0xc00004a8 BIT_MASK 0x10 /end MEASUREMENT
/begin MEASUREMENT Sbx_mf_knk_oor "" UBYTE _CNV_A_R_A_165_CM 1 0. 0. 255. DISPLAY_IDENTIFIER fm_sta_eprm_knk_oor.fm_static_eprm_bitfield.Sbx_mf_xxx ECU_ADDRESS 0xc00004a8 BIT_MASK 0x20 /end MEASUREMENT
/begin MEASUREMENT Sbx_cf_knk_oor "" UBYTE _CNV_A_R_A_165_CM 1 0. 0. 255. DISPLAY_IDENTIFIER fm_sta_eprm_knk_oor.fm_static_eprm_bitfield.Sbx_cf_xxx ECU_ADDRESS 0xc00004a8 BIT_MASK 0x80 /end MEASUREMENT
/begin MEASUREMENT Sbx_dyn_knk_shp "" UBYTE _CNV_A_R_A_165_CM 1 0. 0. 255. DISPLAY_IDENTIFIER fm_sta_eprm_knk_shp.fm_static_eprm_bitfield.Sbx_dyn_xxx ECU_ADDRESS 0xc00004aa BIT_MASK 0x8 /end MEASUREMENT
/begin MEASUREMENT Sbx_rdn_knk_shp "" UBYTE _CNV_A_R_A_165_CM 1 0. 0. 255. DISPLAY_IDENTIFIER fm_sta_eprm_knk_shp.fm_static_eprm_bitfield.Sbx_rdn_xxx ECU_ADDRESS 0xc00004aa BIT_MASK 0x10 /end MEASUREMENT
/begin MEASUREMENT Sbx_mf_knk_shp "" UBYTE _CNV_A_R_A_165_CM 1 0. 0. 255. DISPLAY_IDENTIFIER fm_sta_eprm_knk_shp.fm_static_eprm_bitfield.Sbx_mf_xxx ECU_ADDRESS 0xc00004aa BIT_MASK 0x20 /end MEASUREMENT
/begin MEASUREMENT Sbx_cf_knk_shp "" UBYTE _CNV_A_R_A_165_CM 1 0. 0. 255. DISPLAY_IDENTIFIER fm_sta_eprm_knk_shp.fm_static_eprm_bitfield.Sbx_cf_xxx ECU_ADDRESS 0xc00004aa BIT_MASK 0x80 /end MEASUREMENT
/begin MEASUREMENT Sbx_dyn_lbdw_hot_oc "" UBYTE _CNV_A_R_A_165_CM 1 0. 0. 255. DISPLAY_IDENTIFIER fm_sta_eprm_lbdw_hot_oc.fm_static_eprm_bitfield.Sbx_dyn_xxx ECU_ADDRESS 0xc0000506 BIT_MASK 0x8 /end MEASUREMENT
/begin MEASUREMENT Sbx_rdn_lbdw_hot_oc "" UBYTE _CNV_A_R_A_165_CM 1 0. 0. 255. DISPLAY_IDENTIFIER fm_sta_eprm_lbdw_hot_oc.fm_static_eprm_bitfield.Sbx_rdn_xxx ECU_ADDRESS 0xc0000506 BIT_MASK 0x10 /end MEASUREMENT
/begin MEASUREMENT Sbx_mf_lbdw_hot_oc "" UBYTE _CNV_A_R_A_165_CM 1 0. 0. 255. DISPLAY_IDENTIFIER fm_sta_eprm_lbdw_hot_oc.fm_static_eprm_bitfield.Sbx_mf_xxx ECU_ADDRESS 0xc0000506 BIT_MASK 0x20 /end MEASUREMENT
/begin MEASUREMENT Sbx_cf_lbdw_hot_oc "" UBYTE _CNV_A_R_A_165_CM 1 0. 0. 255. DISPLAY_IDENTIFIER fm_sta_eprm_lbdw_hot_oc.fm_static_eprm_bitfield.Sbx_cf_xxx ECU_ADDRESS 0xc0000506 BIT_MASK 0x80 /end MEASUREMENT
/begin MEASUREMENT Sbx_dyn_lbdw_hot_scg "" UBYTE _CNV_A_R_A_165_CM 1 0. 0. 255. DISPLAY_IDENTIFIER fm_sta_eprm_lbdw_hot_scg.fm_static_eprm_bitfield.Sbx_dyn_xxx ECU_ADDRESS 0xc0000508 BIT_MASK 0x8 /end MEASUREMENT
/begin MEASUREMENT Sbx_rdn_lbdw_hot_scg "" UBYTE _CNV_A_R_A_165_CM 1 0. 0. 255. DISPLAY_IDENTIFIER fm_sta_eprm_lbdw_hot_scg.fm_static_eprm_bitfield.Sbx_rdn_xxx ECU_ADDRESS 0xc0000508 BIT_MASK 0x10 /end MEASUREMENT
/begin MEASUREMENT Sbx_mf_lbdw_hot_scg "" UBYTE _CNV_A_R_A_165_CM 1 0. 0. 255. DISPLAY_IDENTIFIER fm_sta_eprm_lbdw_hot_scg.fm_static_eprm_bitfield.Sbx_mf_xxx ECU_ADDRESS 0xc0000508 BIT_MASK 0x20 /end MEASUREMENT
/begin MEASUREMENT Sbx_cf_lbdw_hot_scg "" UBYTE _CNV_A_R_A_165_CM 1 0. 0. 255. DISPLAY_IDENTIFIER fm_sta_eprm_lbdw_hot_scg.fm_static_eprm_bitfield.Sbx_cf_xxx ECU_ADDRESS 0xc0000508 BIT_MASK 0x80 /end MEASUREMENT
/begin MEASUREMENT Sbx_dyn_lbdw_hot_scw "" UBYTE _CNV_A_R_A_165_CM 1 0. 0. 255. DISPLAY_IDENTIFIER fm_sta_eprm_lbdw_hot_scw.fm_static_eprm_bitfield.Sbx_dyn_xxx ECU_ADDRESS 0xc000050a BIT_MASK 0x8 /end MEASUREMENT
/begin MEASUREMENT Sbx_rdn_lbdw_hot_scw "" UBYTE _CNV_A_R_A_165_CM 1 0. 0. 255. DISPLAY_IDENTIFIER fm_sta_eprm_lbdw_hot_scw.fm_static_eprm_bitfield.Sbx_rdn_xxx ECU_ADDRESS 0xc000050a BIT_MASK 0x10 /end MEASUREMENT
/begin MEASUREMENT Sbx_mf_lbdw_hot_scw "" UBYTE _CNV_A_R_A_165_CM 1 0. 0. 255. DISPLAY_IDENTIFIER fm_sta_eprm_lbdw_hot_scw.fm_static_eprm_bitfield.Sbx_mf_xxx ECU_ADDRESS 0xc000050a BIT_MASK 0x20 /end MEASUREMENT
/begin MEASUREMENT Sbx_cf_lbdw_hot_scw "" UBYTE _CNV_A_R_A_165_CM 1 0. 0. 255. DISPLAY_IDENTIFIER fm_sta_eprm_lbdw_hot_scw.fm_static_eprm_bitfield.Sbx_cf_xxx ECU_ADDRESS 0xc000050a BIT_MASK 0x80 /end MEASUREMENT
/begin MEASUREMENT Sbx_dyn_lbdw_oc "" UBYTE _CNV_A_R_A_165_CM 1 0. 0. 255. DISPLAY_IDENTIFIER fm_sta_eprm_lbdw_oc.fm_static_eprm_bitfield.Sbx_dyn_xxx ECU_ADDRESS 0xc00004ac BIT_MASK 0x8 /end MEASUREMENT
/begin MEASUREMENT Sbx_rdn_lbdw_oc "" UBYTE _CNV_A_R_A_165_CM 1 0. 0. 255. DISPLAY_IDENTIFIER fm_sta_eprm_lbdw_oc.fm_static_eprm_bitfield.Sbx_rdn_xxx ECU_ADDRESS 0xc00004ac BIT_MASK 0x10 /end MEASUREMENT
/begin MEASUREMENT Sbx_mf_lbdw_oc "" UBYTE _CNV_A_R_A_165_CM 1 0. 0. 255. DISPLAY_IDENTIFIER fm_sta_eprm_lbdw_oc.fm_static_eprm_bitfield.Sbx_mf_xxx ECU_ADDRESS 0xc00004ac BIT_MASK 0x20 /end MEASUREMENT
/begin MEASUREMENT Sbx_cf_lbdw_oc "" UBYTE _CNV_A_R_A_165_CM 1 0. 0. 255. DISPLAY_IDENTIFIER fm_sta_eprm_lbdw_oc.fm_static_eprm_bitfield.Sbx_cf_xxx ECU_ADDRESS 0xc00004ac BIT_MASK 0x80 /end MEASUREMENT
/begin MEASUREMENT Sbx_dyn_lbdw_scg "" UBYTE _CNV_A_R_A_165_CM 1 0. 0. 255. DISPLAY_IDENTIFIER fm_sta_eprm_lbdw_scg.fm_static_eprm_bitfield.Sbx_dyn_xxx ECU_ADDRESS 0xc00004ae BIT_MASK 0x8 /end MEASUREMENT
/begin MEASUREMENT Sbx_rdn_lbdw_scg "" UBYTE _CNV_A_R_A_165_CM 1 0. 0. 255. DISPLAY_IDENTIFIER fm_sta_eprm_lbdw_scg.fm_static_eprm_bitfield.Sbx_rdn_xxx ECU_ADDRESS 0xc00004ae BIT_MASK 0x10 /end MEASUREMENT
/begin MEASUREMENT Sbx_mf_lbdw_scg "" UBYTE _CNV_A_R_A_165_CM 1 0. 0. 255. DISPLAY_IDENTIFIER fm_sta_eprm_lbdw_scg.fm_static_eprm_bitfield.Sbx_mf_xxx ECU_ADDRESS 0xc00004ae BIT_MASK 0x20 /end MEASUREMENT
/begin MEASUREMENT Sbx_cf_lbdw_scg "" UBYTE _CNV_A_R_A_165_CM 1 0. 0. 255. DISPLAY_IDENTIFIER fm_sta_eprm_lbdw_scg.fm_static_eprm_bitfield.Sbx_cf_xxx ECU_ADDRESS 0xc00004ae BIT_MASK 0x80 /end MEASUREMENT
/begin MEASUREMENT Sbx_dyn_lbdw_scw "" UBYTE _CNV_A_R_A_165_CM 1 0. 0. 255. DISPLAY_IDENTIFIER fm_sta_eprm_lbdw_scw.fm_static_eprm_bitfield.Sbx_dyn_xxx ECU_ADDRESS 0xc00004b0 BIT_MASK 0x8 /end MEASUREMENT
/begin MEASUREMENT Sbx_rdn_lbdw_scw "" UBYTE _CNV_A_R_A_165_CM 1 0. 0. 255. DISPLAY_IDENTIFIER fm_sta_eprm_lbdw_scw.fm_static_eprm_bitfield.Sbx_rdn_xxx ECU_ADDRESS 0xc00004b0 BIT_MASK 0x10 /end MEASUREMENT
/begin MEASUREMENT Sbx_mf_lbdw_scw "" UBYTE _CNV_A_R_A_165_CM 1 0. 0. 255. DISPLAY_IDENTIFIER fm_sta_eprm_lbdw_scw.fm_static_eprm_bitfield.Sbx_mf_xxx ECU_ADDRESS 0xc00004b0 BIT_MASK 0x20 /end MEASUREMENT
/begin MEASUREMENT Sbx_cf_lbdw_scw "" UBYTE _CNV_A_R_A_165_CM 1 0. 0. 255. DISPLAY_IDENTIFIER fm_sta_eprm_lbdw_scw.fm_static_eprm_bitfield.Sbx_cf_xxx ECU_ADDRESS 0xc00004b0 BIT_MASK 0x80 /end MEASUREMENT
/begin MEASUREMENT Sbx_dyn_lbup_cpt "" UBYTE _CNV_A_R_A_165_CM 1 0. 0. 255. DISPLAY_IDENTIFIER fm_sta_eprm_lbup_cpt.fm_static_eprm_bitfield.Sbx_dyn_xxx ECU_ADDRESS 0xc0000568 BIT_MASK 0x8 /end MEASUREMENT
/begin MEASUREMENT Sbx_rdn_lbup_cpt "" UBYTE _CNV_A_R_A_165_CM 1 0. 0. 255. DISPLAY_IDENTIFIER fm_sta_eprm_lbup_cpt.fm_static_eprm_bitfield.Sbx_rdn_xxx ECU_ADDRESS 0xc0000568 BIT_MASK 0x10 /end MEASUREMENT
/begin MEASUREMENT Sbx_mf_lbup_cpt "" UBYTE _CNV_A_R_A_165_CM 1 0. 0. 255. DISPLAY_IDENTIFIER fm_sta_eprm_lbup_cpt.fm_static_eprm_bitfield.Sbx_mf_xxx ECU_ADDRESS 0xc0000568 BIT_MASK 0x20 /end MEASUREMENT
/begin MEASUREMENT Sbx_cf_lbup_cpt "" UBYTE _CNV_A_R_A_165_CM 1 0. 0. 255. DISPLAY_IDENTIFIER fm_sta_eprm_lbup_cpt.fm_static_eprm_bitfield.Sbx_cf_xxx ECU_ADDRESS 0xc0000568 BIT_MASK 0x80 /end MEASUREMENT
/begin MEASUREMENT Sbx_dyn_lbup_hot_apl_down "" UBYTE _CNV_A_R_A_165_CM 1 0. 0. 255. DISPLAY_IDENTIFIER fm_sta_eprm_lbup_hot_apl_down.fm_static_eprm_bitfield.Sbx_dyn_xxx ECU_ADDRESS 0xc00005a0 BIT_MASK 0x8 /end MEASUREMENT
/begin MEASUREMENT Sbx_rdn_lbup_hot_apl_down "" UBYTE _CNV_A_R_A_165_CM 1 0. 0. 255. DISPLAY_IDENTIFIER fm_sta_eprm_lbup_hot_apl_down.fm_static_eprm_bitfield.Sbx_rdn_xxx ECU_ADDRESS 0xc00005a0 BIT_MASK 0x10 /end MEASUREMENT
/begin MEASUREMENT Sbx_mf_lbup_hot_apl_down "" UBYTE _CNV_A_R_A_165_CM 1 0. 0. 255. DISPLAY_IDENTIFIER fm_sta_eprm_lbup_hot_apl_down.fm_static_eprm_bitfield.Sbx_mf_xxx ECU_ADDRESS 0xc00005a0 BIT_MASK 0x20 /end MEASUREMENT
/begin MEASUREMENT Sbx_cf_lbup_hot_apl_down "" UBYTE _CNV_A_R_A_165_CM 1 0. 0. 255. DISPLAY_IDENTIFIER fm_sta_eprm_lbup_hot_apl_down.fm_static_eprm_bitfield.Sbx_cf_xxx ECU_ADDRESS 0xc00005a0 BIT_MASK 0x80 /end MEASUREMENT
/begin MEASUREMENT Sbx_dyn_lbup_hot_oc "" UBYTE _CNV_A_R_A_165_CM 1 0. 0. 255. DISPLAY_IDENTIFIER fm_sta_eprm_lbup_hot_oc.fm_static_eprm_bitfield.Sbx_dyn_xxx ECU_ADDRESS 0xc000050c BIT_MASK 0x8 /end MEASUREMENT
/begin MEASUREMENT Sbx_rdn_lbup_hot_oc "" UBYTE _CNV_A_R_A_165_CM 1 0. 0. 255. DISPLAY_IDENTIFIER fm_sta_eprm_lbup_hot_oc.fm_static_eprm_bitfield.Sbx_rdn_xxx ECU_ADDRESS 0xc000050c BIT_MASK 0x10 /end MEASUREMENT
/begin MEASUREMENT Sbx_mf_lbup_hot_oc "" UBYTE _CNV_A_R_A_165_CM 1 0. 0. 255. DISPLAY_IDENTIFIER fm_sta_eprm_lbup_hot_oc.fm_static_eprm_bitfield.Sbx_mf_xxx ECU_ADDRESS 0xc000050c BIT_MASK 0x20 /end MEASUREMENT
/begin MEASUREMENT Sbx_cf_lbup_hot_oc "" UBYTE _CNV_A_R_A_165_CM 1 0. 0. 255. DISPLAY_IDENTIFIER fm_sta_eprm_lbup_hot_oc.fm_static_eprm_bitfield.Sbx_cf_xxx ECU_ADDRESS 0xc000050c BIT_MASK 0x80 /end MEASUREMENT
/begin MEASUREMENT Sbx_dyn_lbup_hot_scg "" UBYTE _CNV_A_R_A_165_CM 1 0. 0. 255. DISPLAY_IDENTIFIER fm_sta_eprm_lbup_hot_scg.fm_static_eprm_bitfield.Sbx_dyn_xxx ECU_ADDRESS 0xc000050e BIT_MASK 0x8 /end MEASUREMENT
/begin MEASUREMENT Sbx_rdn_lbup_hot_scg "" UBYTE _CNV_A_R_A_165_CM 1 0. 0. 255. DISPLAY_IDENTIFIER fm_sta_eprm_lbup_hot_scg.fm_static_eprm_bitfield.Sbx_rdn_xxx ECU_ADDRESS 0xc000050e BIT_MASK 0x10 /end MEASUREMENT
/begin MEASUREMENT Sbx_mf_lbup_hot_scg "" UBYTE _CNV_A_R_A_165_CM 1 0. 0. 255. DISPLAY_IDENTIFIER fm_sta_eprm_lbup_hot_scg.fm_static_eprm_bitfield.Sbx_mf_xxx ECU_ADDRESS 0xc000050e BIT_MASK 0x20 /end MEASUREMENT
/begin MEASUREMENT Sbx_cf_lbup_hot_scg "" UBYTE _CNV_A_R_A_165_CM 1 0. 0. 255. DISPLAY_IDENTIFIER fm_sta_eprm_lbup_hot_scg.fm_static_eprm_bitfield.Sbx_cf_xxx ECU_ADDRESS 0xc000050e BIT_MASK 0x80 /end MEASUREMENT
/begin MEASUREMENT Sbx_dyn_lbup_hot_scw "" UBYTE _CNV_A_R_A_165_CM 1 0. 0. 255. DISPLAY_IDENTIFIER fm_sta_eprm_lbup_hot_scw.fm_static_eprm_bitfield.Sbx_dyn_xxx ECU_ADDRESS 0xc0000510 BIT_MASK 0x8 /end MEASUREMENT
/begin MEASUREMENT Sbx_rdn_lbup_hot_scw "" UBYTE _CNV_A_R_A_165_CM 1 0. 0. 255. DISPLAY_IDENTIFIER fm_sta_eprm_lbup_hot_scw.fm_static_eprm_bitfield.Sbx_rdn_xxx ECU_ADDRESS 0xc0000510 BIT_MASK 0x10 /end MEASUREMENT
/begin MEASUREMENT Sbx_mf_lbup_hot_scw "" UBYTE _CNV_A_R_A_165_CM 1 0. 0. 255. DISPLAY_IDENTIFIER fm_sta_eprm_lbup_hot_scw.fm_static_eprm_bitfield.Sbx_mf_xxx ECU_ADDRESS 0xc0000510 BIT_MASK 0x20 /end MEASUREMENT
/begin MEASUREMENT Sbx_cf_lbup_hot_scw "" UBYTE _CNV_A_R_A_165_CM 1 0. 0. 255. DISPLAY_IDENTIFIER fm_sta_eprm_lbup_hot_scw.fm_static_eprm_bitfield.Sbx_cf_xxx ECU_ADDRESS 0xc0000510 BIT_MASK 0x80 /end MEASUREMENT
/begin MEASUREMENT Sbx_dyn_lbup_nok "" UBYTE _CNV_A_R_A_165_CM 1 0. 0. 255. DISPLAY_IDENTIFIER fm_sta_eprm_lbup_nok.fm_static_eprm_bitfield.Sbx_dyn_xxx ECU_ADDRESS 0xc000059e BIT_MASK 0x8 /end MEASUREMENT
/begin MEASUREMENT Sbx_rdn_lbup_nok "" UBYTE _CNV_A_R_A_165_CM 1 0. 0. 255. DISPLAY_IDENTIFIER fm_sta_eprm_lbup_nok.fm_static_eprm_bitfield.Sbx_rdn_xxx ECU_ADDRESS 0xc000059e BIT_MASK 0x10 /end MEASUREMENT
/begin MEASUREMENT Sbx_mf_lbup_nok "" UBYTE _CNV_A_R_A_165_CM 1 0. 0. 255. DISPLAY_IDENTIFIER fm_sta_eprm_lbup_nok.fm_static_eprm_bitfield.Sbx_mf_xxx ECU_ADDRESS 0xc000059e BIT_MASK 0x20 /end MEASUREMENT
/begin MEASUREMENT Sbx_cf_lbup_nok "" UBYTE _CNV_A_R_A_165_CM 1 0. 0. 255. DISPLAY_IDENTIFIER fm_sta_eprm_lbup_nok.fm_static_eprm_bitfield.Sbx_cf_xxx ECU_ADDRESS 0xc000059e BIT_MASK 0x80 /end MEASUREMENT
/begin MEASUREMENT Sbx_dyn_lbup_oc "" UBYTE _CNV_A_R_A_165_CM 1 0. 0. 255. DISPLAY_IDENTIFIER fm_sta_eprm_lbup_oc.fm_static_eprm_bitfield.Sbx_dyn_xxx ECU_ADDRESS 0xc00004b2 BIT_MASK 0x8 /end MEASUREMENT
/begin MEASUREMENT Sbx_rdn_lbup_oc "" UBYTE _CNV_A_R_A_165_CM 1 0. 0. 255. DISPLAY_IDENTIFIER fm_sta_eprm_lbup_oc.fm_static_eprm_bitfield.Sbx_rdn_xxx ECU_ADDRESS 0xc00004b2 BIT_MASK 0x10 /end MEASUREMENT
/begin MEASUREMENT Sbx_mf_lbup_oc "" UBYTE _CNV_A_R_A_165_CM 1 0. 0. 255. DISPLAY_IDENTIFIER fm_sta_eprm_lbup_oc.fm_static_eprm_bitfield.Sbx_mf_xxx ECU_ADDRESS 0xc00004b2 BIT_MASK 0x20 /end MEASUREMENT
/begin MEASUREMENT Sbx_cf_lbup_oc "" UBYTE _CNV_A_R_A_165_CM 1 0. 0. 255. DISPLAY_IDENTIFIER fm_sta_eprm_lbup_oc.fm_static_eprm_bitfield.Sbx_cf_xxx ECU_ADDRESS 0xc00004b2 BIT_MASK 0x80 /end MEASUREMENT
/begin MEASUREMENT Sbx_dyn_lbup_scg "" UBYTE _CNV_A_R_A_165_CM 1 0. 0. 255. DISPLAY_IDENTIFIER fm_sta_eprm_lbup_scg.fm_static_eprm_bitfield.Sbx_dyn_xxx ECU_ADDRESS 0xc00004b4 BIT_MASK 0x8 /end MEASUREMENT
/begin MEASUREMENT Sbx_rdn_lbup_scg "" UBYTE _CNV_A_R_A_165_CM 1 0. 0. 255. DISPLAY_IDENTIFIER fm_sta_eprm_lbup_scg.fm_static_eprm_bitfield.Sbx_rdn_xxx ECU_ADDRESS 0xc00004b4 BIT_MASK 0x10 /end MEASUREMENT
/begin MEASUREMENT Sbx_mf_lbup_scg "" UBYTE _CNV_A_R_A_165_CM 1 0. 0. 255. DISPLAY_IDENTIFIER fm_sta_eprm_lbup_scg.fm_static_eprm_bitfield.Sbx_mf_xxx ECU_ADDRESS 0xc00004b4 BIT_MASK 0x20 /end MEASUREMENT
/begin MEASUREMENT Sbx_cf_lbup_scg "" UBYTE _CNV_A_R_A_165_CM 1 0. 0. 255. DISPLAY_IDENTIFIER fm_sta_eprm_lbup_scg.fm_static_eprm_bitfield.Sbx_cf_xxx ECU_ADDRESS 0xc00004b4 BIT_MASK 0x80 /end MEASUREMENT
/begin MEASUREMENT Sbx_dyn_lbup_scw "" UBYTE _CNV_A_R_A_165_CM 1 0. 0. 255. DISPLAY_IDENTIFIER fm_sta_eprm_lbup_scw.fm_static_eprm_bitfield.Sbx_dyn_xxx ECU_ADDRESS 0xc00004b6 BIT_MASK 0x8 /end MEASUREMENT
/begin MEASUREMENT Sbx_rdn_lbup_scw "" UBYTE _CNV_A_R_A_165_CM 1 0. 0. 255. DISPLAY_IDENTIFIER fm_sta_eprm_lbup_scw.fm_static_eprm_bitfield.Sbx_rdn_xxx ECU_ADDRESS 0xc00004b6 BIT_MASK 0x10 /end MEASUREMENT
/begin MEASUREMENT Sbx_mf_lbup_scw "" UBYTE _CNV_A_R_A_165_CM 1 0. 0. 255. DISPLAY_IDENTIFIER fm_sta_eprm_lbup_scw.fm_static_eprm_bitfield.Sbx_mf_xxx ECU_ADDRESS 0xc00004b6 BIT_MASK 0x20 /end MEASUREMENT
/begin MEASUREMENT Sbx_cf_lbup_scw "" UBYTE _CNV_A_R_A_165_CM 1 0. 0. 255. DISPLAY_IDENTIFIER fm_sta_eprm_lbup_scw.fm_static_eprm_bitfield.Sbx_cf_xxx ECU_ADDRESS 0xc00004b6 BIT_MASK 0x80 /end MEASUREMENT
/begin MEASUREMENT Sbx_dyn_map_chr "" UBYTE _CNV_A_R_A_165_CM 1 0. 0. 255. DISPLAY_IDENTIFIER fm_sta_eprm_map_chr.fm_static_eprm_bitfield.Sbx_dyn_xxx ECU_ADDRESS 0xc0000512 BIT_MASK 0x8 /end MEASUREMENT
/begin MEASUREMENT Sbx_rdn_map_chr "" UBYTE _CNV_A_R_A_165_CM 1 0. 0. 255. DISPLAY_IDENTIFIER fm_sta_eprm_map_chr.fm_static_eprm_bitfield.Sbx_rdn_xxx ECU_ADDRESS 0xc0000512 BIT_MASK 0x10 /end MEASUREMENT
/begin MEASUREMENT Sbx_mf_map_chr "" UBYTE _CNV_A_R_A_165_CM 1 0. 0. 255. DISPLAY_IDENTIFIER fm_sta_eprm_map_chr.fm_static_eprm_bitfield.Sbx_mf_xxx ECU_ADDRESS 0xc0000512 BIT_MASK 0x20 /end MEASUREMENT
/begin MEASUREMENT Sbx_cf_map_chr "" UBYTE _CNV_A_R_A_165_CM 1 0. 0. 255. DISPLAY_IDENTIFIER fm_sta_eprm_map_chr.fm_static_eprm_bitfield.Sbx_cf_xxx ECU_ADDRESS 0xc0000512 BIT_MASK 0x80 /end MEASUREMENT
/begin MEASUREMENT Sbx_dyn_map_oor "" UBYTE _CNV_A_R_A_165_CM 1 0. 0. 255. DISPLAY_IDENTIFIER fm_sta_eprm_map_oor.fm_static_eprm_bitfield.Sbx_dyn_xxx ECU_ADDRESS 0xc0000514 BIT_MASK 0x8 /end MEASUREMENT
/begin MEASUREMENT Sbx_rdn_map_oor "" UBYTE _CNV_A_R_A_165_CM 1 0. 0. 255. DISPLAY_IDENTIFIER fm_sta_eprm_map_oor.fm_static_eprm_bitfield.Sbx_rdn_xxx ECU_ADDRESS 0xc0000514 BIT_MASK 0x10 /end MEASUREMENT
/begin MEASUREMENT Sbx_mf_map_oor "" UBYTE _CNV_A_R_A_165_CM 1 0. 0. 255. DISPLAY_IDENTIFIER fm_sta_eprm_map_oor.fm_static_eprm_bitfield.Sbx_mf_xxx ECU_ADDRESS 0xc0000514 BIT_MASK 0x20 /end MEASUREMENT
/begin MEASUREMENT Sbx_cf_map_oor "" UBYTE _CNV_A_R_A_165_CM 1 0. 0. 255. DISPLAY_IDENTIFIER fm_sta_eprm_map_oor.fm_static_eprm_bitfield.Sbx_cf_xxx ECU_ADDRESS 0xc0000514 BIT_MASK 0x80 /end MEASUREMENT
/begin MEASUREMENT Sbx_dyn_mis_1_cata "" UBYTE _CNV_A_R_A_165_CM 1 0. 0. 255. DISPLAY_IDENTIFIER fm_sta_eprm_mis_1_cata.fm_static_eprm_bitfield.Sbx_dyn_xxx ECU_ADDRESS 0xc0000516 BIT_MASK 0x8 /end MEASUREMENT
/begin MEASUREMENT Sbx_rdn_mis_1_cata "" UBYTE _CNV_A_R_A_165_CM 1 0. 0. 255. DISPLAY_IDENTIFIER fm_sta_eprm_mis_1_cata.fm_static_eprm_bitfield.Sbx_rdn_xxx ECU_ADDRESS 0xc0000516 BIT_MASK 0x10 /end MEASUREMENT
/begin MEASUREMENT Sbx_mf_mis_1_cata "" UBYTE _CNV_A_R_A_165_CM 1 0. 0. 255. DISPLAY_IDENTIFIER fm_sta_eprm_mis_1_cata.fm_static_eprm_bitfield.Sbx_mf_xxx ECU_ADDRESS 0xc0000516 BIT_MASK 0x20 /end MEASUREMENT
/begin MEASUREMENT Sbx_cf_mis_1_cata "" UBYTE _CNV_A_R_A_165_CM 1 0. 0. 255. DISPLAY_IDENTIFIER fm_sta_eprm_mis_1_cata.fm_static_eprm_bitfield.Sbx_cf_xxx ECU_ADDRESS 0xc0000516 BIT_MASK 0x80 /end MEASUREMENT
/begin MEASUREMENT Sbx_dyn_mis_1_lpg_cata "" UBYTE _CNV_A_R_A_165_CM 1 0. 0. 255. DISPLAY_IDENTIFIER fm_sta_eprm_mis_1_lpg_cata.fm_static_eprm_bitfield.Sbx_dyn_xxx ECU_ADDRESS 0xc0000518 BIT_MASK 0x8 /end MEASUREMENT
/begin MEASUREMENT Sbx_rdn_mis_1_lpg_cata "" UBYTE _CNV_A_R_A_165_CM 1 0. 0. 255. DISPLAY_IDENTIFIER fm_sta_eprm_mis_1_lpg_cata.fm_static_eprm_bitfield.Sbx_rdn_xxx ECU_ADDRESS 0xc0000518 BIT_MASK 0x10 /end MEASUREMENT
/begin MEASUREMENT Sbx_mf_mis_1_lpg_cata "" UBYTE _CNV_A_R_A_165_CM 1 0. 0. 255. DISPLAY_IDENTIFIER fm_sta_eprm_mis_1_lpg_cata.fm_static_eprm_bitfield.Sbx_mf_xxx ECU_ADDRESS 0xc0000518 BIT_MASK 0x20 /end MEASUREMENT
/begin MEASUREMENT Sbx_cf_mis_1_lpg_cata "" UBYTE _CNV_A_R_A_165_CM 1 0. 0. 255. DISPLAY_IDENTIFIER fm_sta_eprm_mis_1_lpg_cata.fm_static_eprm_bitfield.Sbx_cf_xxx ECU_ADDRESS 0xc0000518 BIT_MASK 0x80 /end MEASUREMENT
/begin MEASUREMENT Sbx_dyn_mis_1_lpg_trs_h "" UBYTE _CNV_A_R_A_165_CM 1 0. 0. 255. DISPLAY_IDENTIFIER fm_sta_eprm_mis_1_lpg_trs_h.fm_static_eprm_bitfield.Sbx_dyn_xxx ECU_ADDRESS 0xc000051a BIT_MASK 0x8 /end MEASUREMENT
/begin MEASUREMENT Sbx_rdn_mis_1_lpg_trs_h "" UBYTE _CNV_A_R_A_165_CM 1 0. 0. 255. DISPLAY_IDENTIFIER fm_sta_eprm_mis_1_lpg_trs_h.fm_static_eprm_bitfield.Sbx_rdn_xxx ECU_ADDRESS 0xc000051a BIT_MASK 0x10 /end MEASUREMENT
/begin MEASUREMENT Sbx_mf_mis_1_lpg_trs_h "" UBYTE _CNV_A_R_A_165_CM 1 0. 0. 255. DISPLAY_IDENTIFIER fm_sta_eprm_mis_1_lpg_trs_h.fm_static_eprm_bitfield.Sbx_mf_xxx ECU_ADDRESS 0xc000051a BIT_MASK 0x20 /end MEASUREMENT
/begin MEASUREMENT Sbx_cf_mis_1_lpg_trs_h "" UBYTE _CNV_A_R_A_165_CM 1 0. 0. 255. DISPLAY_IDENTIFIER fm_sta_eprm_mis_1_lpg_trs_h.fm_static_eprm_bitfield.Sbx_cf_xxx ECU_ADDRESS 0xc000051a BIT_MASK 0x80 /end MEASUREMENT
/begin MEASUREMENT Sbx_dyn_mis_1_trs_h "" UBYTE _CNV_A_R_A_165_CM 1 0. 0. 255. DISPLAY_IDENTIFIER fm_sta_eprm_mis_1_trs_h.fm_static_eprm_bitfield.Sbx_dyn_xxx ECU_ADDRESS 0xc000051c BIT_MASK 0x8 /end MEASUREMENT
/begin MEASUREMENT Sbx_rdn_mis_1_trs_h "" UBYTE _CNV_A_R_A_165_CM 1 0. 0. 255. DISPLAY_IDENTIFIER fm_sta_eprm_mis_1_trs_h.fm_static_eprm_bitfield.Sbx_rdn_xxx ECU_ADDRESS 0xc000051c BIT_MASK 0x10 /end MEASUREMENT
/begin MEASUREMENT Sbx_mf_mis_1_trs_h "" UBYTE _CNV_A_R_A_165_CM 1 0. 0. 255. DISPLAY_IDENTIFIER fm_sta_eprm_mis_1_trs_h.fm_static_eprm_bitfield.Sbx_mf_xxx ECU_ADDRESS 0xc000051c BIT_MASK 0x20 /end MEASUREMENT
/begin MEASUREMENT Sbx_cf_mis_1_trs_h "" UBYTE _CNV_A_R_A_165_CM 1 0. 0. 255. DISPLAY_IDENTIFIER fm_sta_eprm_mis_1_trs_h.fm_static_eprm_bitfield.Sbx_cf_xxx ECU_ADDRESS 0xc000051c BIT_MASK 0x80 /end MEASUREMENT
/begin MEASUREMENT Sbx_dyn_mis_2_cata "" UBYTE _CNV_A_R_A_165_CM 1 0. 0. 255. DISPLAY_IDENTIFIER fm_sta_eprm_mis_2_cata.fm_static_eprm_bitfield.Sbx_dyn_xxx ECU_ADDRESS 0xc000051e BIT_MASK 0x8 /end MEASUREMENT
/begin MEASUREMENT Sbx_rdn_mis_2_cata "" UBYTE _CNV_A_R_A_165_CM 1 0. 0. 255. DISPLAY_IDENTIFIER fm_sta_eprm_mis_2_cata.fm_static_eprm_bitfield.Sbx_rdn_xxx ECU_ADDRESS 0xc000051e BIT_MASK 0x10 /end MEASUREMENT
/begin MEASUREMENT Sbx_mf_mis_2_cata "" UBYTE _CNV_A_R_A_165_CM 1 0. 0. 255. DISPLAY_IDENTIFIER fm_sta_eprm_mis_2_cata.fm_static_eprm_bitfield.Sbx_mf_xxx ECU_ADDRESS 0xc000051e BIT_MASK 0x20 /end MEASUREMENT
/begin MEASUREMENT Sbx_cf_mis_2_cata "" UBYTE _CNV_A_R_A_165_CM 1 0. 0. 255. DISPLAY_IDENTIFIER fm_sta_eprm_mis_2_cata.fm_static_eprm_bitfield.Sbx_cf_xxx ECU_ADDRESS 0xc000051e BIT_MASK 0x80 /end MEASUREMENT
/begin MEASUREMENT Sbx_dyn_mis_2_lpg_cata "" UBYTE _CNV_A_R_A_165_CM 1 0. 0. 255. DISPLAY_IDENTIFIER fm_sta_eprm_mis_2_lpg_cata.fm_static_eprm_bitfield.Sbx_dyn_xxx ECU_ADDRESS 0xc0000520 BIT_MASK 0x8 /end MEASUREMENT
/begin MEASUREMENT Sbx_rdn_mis_2_lpg_cata "" UBYTE _CNV_A_R_A_165_CM 1 0. 0. 255. DISPLAY_IDENTIFIER fm_sta_eprm_mis_2_lpg_cata.fm_static_eprm_bitfield.Sbx_rdn_xxx ECU_ADDRESS 0xc0000520 BIT_MASK 0x10 /end MEASUREMENT
/begin MEASUREMENT Sbx_mf_mis_2_lpg_cata "" UBYTE _CNV_A_R_A_165_CM 1 0. 0. 255. DISPLAY_IDENTIFIER fm_sta_eprm_mis_2_lpg_cata.fm_static_eprm_bitfield.Sbx_mf_xxx ECU_ADDRESS 0xc0000520 BIT_MASK 0x20 /end MEASUREMENT
/begin MEASUREMENT Sbx_cf_mis_2_lpg_cata "" UBYTE _CNV_A_R_A_165_CM 1 0. 0. 255. DISPLAY_IDENTIFIER fm_sta_eprm_mis_2_lpg_cata.fm_static_eprm_bitfield.Sbx_cf_xxx ECU_ADDRESS 0xc0000520 BIT_MASK 0x80 /end MEASUREMENT
/begin MEASUREMENT Sbx_dyn_mis_2_lpg_trs_h "" UBYTE _CNV_A_R_A_165_CM 1 0. 0. 255. DISPLAY_IDENTIFIER fm_sta_eprm_mis_2_lpg_trs_h.fm_static_eprm_bitfield.Sbx_dyn_xxx ECU_ADDRESS 0xc0000522 BIT_MASK 0x8 /end MEASUREMENT
/begin MEASUREMENT Sbx_rdn_mis_2_lpg_trs_h "" UBYTE _CNV_A_R_A_165_CM 1 0. 0. 255. DISPLAY_IDENTIFIER fm_sta_eprm_mis_2_lpg_trs_h.fm_static_eprm_bitfield.Sbx_rdn_xxx ECU_ADDRESS 0xc0000522 BIT_MASK 0x10 /end MEASUREMENT
/begin MEASUREMENT Sbx_mf_mis_2_lpg_trs_h "" UBYTE _CNV_A_R_A_165_CM 1 0. 0. 255. DISPLAY_IDENTIFIER fm_sta_eprm_mis_2_lpg_trs_h.fm_static_eprm_bitfield.Sbx_mf_xxx ECU_ADDRESS 0xc0000522 BIT_MASK 0x20 /end MEASUREMENT
/begin MEASUREMENT Sbx_cf_mis_2_lpg_trs_h "" UBYTE _CNV_A_R_A_165_CM 1 0. 0. 255. DISPLAY_IDENTIFIER fm_sta_eprm_mis_2_lpg_trs_h.fm_static_eprm_bitfield.Sbx_cf_xxx ECU_ADDRESS 0xc0000522 BIT_MASK 0x80 /end MEASUREMENT
/begin MEASUREMENT Sbx_dyn_mis_2_trs_h "" UBYTE _CNV_A_R_A_165_CM 1 0. 0. 255. DISPLAY_IDENTIFIER fm_sta_eprm_mis_2_trs_h.fm_static_eprm_bitfield.Sbx_dyn_xxx ECU_ADDRESS 0xc0000524 BIT_MASK 0x8 /end MEASUREMENT
/begin MEASUREMENT Sbx_rdn_mis_2_trs_h "" UBYTE _CNV_A_R_A_165_CM 1 0. 0. 255. DISPLAY_IDENTIFIER fm_sta_eprm_mis_2_trs_h.fm_static_eprm_bitfield.Sbx_rdn_xxx ECU_ADDRESS 0xc0000524 BIT_MASK 0x10 /end MEASUREMENT
/begin MEASUREMENT Sbx_mf_mis_2_trs_h "" UBYTE _CNV_A_R_A_165_CM 1 0. 0. 255. DISPLAY_IDENTIFIER fm_sta_eprm_mis_2_trs_h.fm_static_eprm_bitfield.Sbx_mf_xxx ECU_ADDRESS 0xc0000524 BIT_MASK 0x20 /end MEASUREMENT
/begin MEASUREMENT Sbx_cf_mis_2_trs_h "" UBYTE _CNV_A_R_A_165_CM 1 0. 0. 255. DISPLAY_IDENTIFIER fm_sta_eprm_mis_2_trs_h.fm_static_eprm_bitfield.Sbx_cf_xxx ECU_ADDRESS 0xc0000524 BIT_MASK 0x80 /end MEASUREMENT
/begin MEASUREMENT Sbx_dyn_mis_3_cata "" UBYTE _CNV_A_R_A_165_CM 1 0. 0. 255. DISPLAY_IDENTIFIER fm_sta_eprm_mis_3_cata.fm_static_eprm_bitfield.Sbx_dyn_xxx ECU_ADDRESS 0xc0000526 BIT_MASK 0x8 /end MEASUREMENT
/begin MEASUREMENT Sbx_rdn_mis_3_cata "" UBYTE _CNV_A_R_A_165_CM 1 0. 0. 255. DISPLAY_IDENTIFIER fm_sta_eprm_mis_3_cata.fm_static_eprm_bitfield.Sbx_rdn_xxx ECU_ADDRESS 0xc0000526 BIT_MASK 0x10 /end MEASUREMENT
/begin MEASUREMENT Sbx_mf_mis_3_cata "" UBYTE _CNV_A_R_A_165_CM 1 0. 0. 255. DISPLAY_IDENTIFIER fm_sta_eprm_mis_3_cata.fm_static_eprm_bitfield.Sbx_mf_xxx ECU_ADDRESS 0xc0000526 BIT_MASK 0x20 /end MEASUREMENT
/begin MEASUREMENT Sbx_cf_mis_3_cata "" UBYTE _CNV_A_R_A_165_CM 1 0. 0. 255. DISPLAY_IDENTIFIER fm_sta_eprm_mis_3_cata.fm_static_eprm_bitfield.Sbx_cf_xxx ECU_ADDRESS 0xc0000526 BIT_MASK 0x80 /end MEASUREMENT
/begin MEASUREMENT Sbx_dyn_mis_3_lpg_cata "" UBYTE _CNV_A_R_A_165_CM 1 0. 0. 255. DISPLAY_IDENTIFIER fm_sta_eprm_mis_3_lpg_cata.fm_static_eprm_bitfield.Sbx_dyn_xxx ECU_ADDRESS 0xc0000528 BIT_MASK 0x8 /end MEASUREMENT
/begin MEASUREMENT Sbx_rdn_mis_3_lpg_cata "" UBYTE _CNV_A_R_A_165_CM 1 0. 0. 255. DISPLAY_IDENTIFIER fm_sta_eprm_mis_3_lpg_cata.fm_static_eprm_bitfield.Sbx_rdn_xxx ECU_ADDRESS 0xc0000528 BIT_MASK 0x10 /end MEASUREMENT
/begin MEASUREMENT Sbx_mf_mis_3_lpg_cata "" UBYTE _CNV_A_R_A_165_CM 1 0. 0. 255. DISPLAY_IDENTIFIER fm_sta_eprm_mis_3_lpg_cata.fm_static_eprm_bitfield.Sbx_mf_xxx ECU_ADDRESS 0xc0000528 BIT_MASK 0x20 /end MEASUREMENT
/begin MEASUREMENT Sbx_cf_mis_3_lpg_cata "" UBYTE _CNV_A_R_A_165_CM 1 0. 0. 255. DISPLAY_IDENTIFIER fm_sta_eprm_mis_3_lpg_cata.fm_static_eprm_bitfield.Sbx_cf_xxx ECU_ADDRESS 0xc0000528 BIT_MASK 0x80 /end MEASUREMENT
/begin MEASUREMENT Sbx_dyn_mis_3_lpg_trs_h "" UBYTE _CNV_A_R_A_165_CM 1 0. 0. 255. DISPLAY_IDENTIFIER fm_sta_eprm_mis_3_lpg_trs_h.fm_static_eprm_bitfield.Sbx_dyn_xxx ECU_ADDRESS 0xc000052a BIT_MASK 0x8 /end MEASUREMENT
/begin MEASUREMENT Sbx_rdn_mis_3_lpg_trs_h "" UBYTE _CNV_A_R_A_165_CM 1 0. 0. 255. DISPLAY_IDENTIFIER fm_sta_eprm_mis_3_lpg_trs_h.fm_static_eprm_bitfield.Sbx_rdn_xxx ECU_ADDRESS 0xc000052a BIT_MASK 0x10 /end MEASUREMENT
/begin MEASUREMENT Sbx_mf_mis_3_lpg_trs_h "" UBYTE _CNV_A_R_A_165_CM 1 0. 0. 255. DISPLAY_IDENTIFIER fm_sta_eprm_mis_3_lpg_trs_h.fm_static_eprm_bitfield.Sbx_mf_xxx ECU_ADDRESS 0xc000052a BIT_MASK 0x20 /end MEASUREMENT
/begin MEASUREMENT Sbx_cf_mis_3_lpg_trs_h "" UBYTE _CNV_A_R_A_165_CM 1 0. 0. 255. DISPLAY_IDENTIFIER fm_sta_eprm_mis_3_lpg_trs_h.fm_static_eprm_bitfield.Sbx_cf_xxx ECU_ADDRESS 0xc000052a BIT_MASK 0x80 /end MEASUREMENT
/begin MEASUREMENT Sbx_dyn_mis_3_trs_h "" UBYTE _CNV_A_R_A_165_CM 1 0. 0. 255. DISPLAY_IDENTIFIER fm_sta_eprm_mis_3_trs_h.fm_static_eprm_bitfield.Sbx_dyn_xxx ECU_ADDRESS 0xc000052c BIT_MASK 0x8 /end MEASUREMENT
/begin MEASUREMENT Sbx_rdn_mis_3_trs_h "" UBYTE _CNV_A_R_A_165_CM 1 0. 0. 255. DISPLAY_IDENTIFIER fm_sta_eprm_mis_3_trs_h.fm_static_eprm_bitfield.Sbx_rdn_xxx ECU_ADDRESS 0xc000052c BIT_MASK 0x10 /end MEASUREMENT
/begin MEASUREMENT Sbx_mf_mis_3_trs_h "" UBYTE _CNV_A_R_A_165_CM 1 0. 0. 255. DISPLAY_IDENTIFIER fm_sta_eprm_mis_3_trs_h.fm_static_eprm_bitfield.Sbx_mf_xxx ECU_ADDRESS 0xc000052c BIT_MASK 0x20 /end MEASUREMENT
/begin MEASUREMENT Sbx_cf_mis_3_trs_h "" UBYTE _CNV_A_R_A_165_CM 1 0. 0. 255. DISPLAY_IDENTIFIER fm_sta_eprm_mis_3_trs_h.fm_static_eprm_bitfield.Sbx_cf_xxx ECU_ADDRESS 0xc000052c BIT_MASK 0x80 /end MEASUREMENT
/begin MEASUREMENT Sbx_dyn_mis_4_cata "" UBYTE _CNV_A_R_A_165_CM 1 0. 0. 255. DISPLAY_IDENTIFIER fm_sta_eprm_mis_4_cata.fm_static_eprm_bitfield.Sbx_dyn_xxx ECU_ADDRESS 0xc000052e BIT_MASK 0x8 /end MEASUREMENT
/begin MEASUREMENT Sbx_rdn_mis_4_cata "" UBYTE _CNV_A_R_A_165_CM 1 0. 0. 255. DISPLAY_IDENTIFIER fm_sta_eprm_mis_4_cata.fm_static_eprm_bitfield.Sbx_rdn_xxx ECU_ADDRESS 0xc000052e BIT_MASK 0x10 /end MEASUREMENT
/begin MEASUREMENT Sbx_mf_mis_4_cata "" UBYTE _CNV_A_R_A_165_CM 1 0. 0. 255. DISPLAY_IDENTIFIER fm_sta_eprm_mis_4_cata.fm_static_eprm_bitfield.Sbx_mf_xxx ECU_ADDRESS 0xc000052e BIT_MASK 0x20 /end MEASUREMENT
/begin MEASUREMENT Sbx_cf_mis_4_cata "" UBYTE _CNV_A_R_A_165_CM 1 0. 0. 255. DISPLAY_IDENTIFIER fm_sta_eprm_mis_4_cata.fm_static_eprm_bitfield.Sbx_cf_xxx ECU_ADDRESS 0xc000052e BIT_MASK 0x80 /end MEASUREMENT
/begin MEASUREMENT Sbx_dyn_mis_4_lpg_cata "" UBYTE _CNV_A_R_A_165_CM 1 0. 0. 255. DISPLAY_IDENTIFIER fm_sta_eprm_mis_4_lpg_cata.fm_static_eprm_bitfield.Sbx_dyn_xxx ECU_ADDRESS 0xc0000530 BIT_MASK 0x8 /end MEASUREMENT
/begin MEASUREMENT Sbx_rdn_mis_4_lpg_cata "" UBYTE _CNV_A_R_A_165_CM 1 0. 0. 255. DISPLAY_IDENTIFIER fm_sta_eprm_mis_4_lpg_cata.fm_static_eprm_bitfield.Sbx_rdn_xxx ECU_ADDRESS 0xc0000530 BIT_MASK 0x10 /end MEASUREMENT
/begin MEASUREMENT Sbx_mf_mis_4_lpg_cata "" UBYTE _CNV_A_R_A_165_CM 1 0. 0. 255. DISPLAY_IDENTIFIER fm_sta_eprm_mis_4_lpg_cata.fm_static_eprm_bitfield.Sbx_mf_xxx ECU_ADDRESS 0xc0000530 BIT_MASK 0x20 /end MEASUREMENT
/begin MEASUREMENT Sbx_cf_mis_4_lpg_cata "" UBYTE _CNV_A_R_A_165_CM 1 0. 0. 255. DISPLAY_IDENTIFIER fm_sta_eprm_mis_4_lpg_cata.fm_static_eprm_bitfield.Sbx_cf_xxx ECU_ADDRESS 0xc0000530 BIT_MASK 0x80 /end MEASUREMENT
/begin MEASUREMENT Sbx_dyn_mis_4_lpg_trs_h "" UBYTE _CNV_A_R_A_165_CM 1 0. 0. 255. DISPLAY_IDENTIFIER fm_sta_eprm_mis_4_lpg_trs_h.fm_static_eprm_bitfield.Sbx_dyn_xxx ECU_ADDRESS 0xc0000532 BIT_MASK 0x8 /end MEASUREMENT
/begin MEASUREMENT Sbx_rdn_mis_4_lpg_trs_h "" UBYTE _CNV_A_R_A_165_CM 1 0. 0. 255. DISPLAY_IDENTIFIER fm_sta_eprm_mis_4_lpg_trs_h.fm_static_eprm_bitfield.Sbx_rdn_xxx ECU_ADDRESS 0xc0000532 BIT_MASK 0x10 /end MEASUREMENT
/begin MEASUREMENT Sbx_mf_mis_4_lpg_trs_h "" UBYTE _CNV_A_R_A_165_CM 1 0. 0. 255. DISPLAY_IDENTIFIER fm_sta_eprm_mis_4_lpg_trs_h.fm_static_eprm_bitfield.Sbx_mf_xxx ECU_ADDRESS 0xc0000532 BIT_MASK 0x20 /end MEASUREMENT
/begin MEASUREMENT Sbx_cf_mis_4_lpg_trs_h "" UBYTE _CNV_A_R_A_165_CM 1 0. 0. 255. DISPLAY_IDENTIFIER fm_sta_eprm_mis_4_lpg_trs_h.fm_static_eprm_bitfield.Sbx_cf_xxx ECU_ADDRESS 0xc0000532 BIT_MASK 0x80 /end MEASUREMENT
/begin MEASUREMENT Sbx_dyn_mis_4_trs_h "" UBYTE _CNV_A_R_A_165_CM 1 0. 0. 255. DISPLAY_IDENTIFIER fm_sta_eprm_mis_4_trs_h.fm_static_eprm_bitfield.Sbx_dyn_xxx ECU_ADDRESS 0xc0000534 BIT_MASK 0x8 /end MEASUREMENT
/begin MEASUREMENT Sbx_rdn_mis_4_trs_h "" UBYTE _CNV_A_R_A_165_CM 1 0. 0. 255. DISPLAY_IDENTIFIER fm_sta_eprm_mis_4_trs_h.fm_static_eprm_bitfield.Sbx_rdn_xxx ECU_ADDRESS 0xc0000534 BIT_MASK 0x10 /end MEASUREMENT
/begin MEASUREMENT Sbx_mf_mis_4_trs_h "" UBYTE _CNV_A_R_A_165_CM 1 0. 0. 255. DISPLAY_IDENTIFIER fm_sta_eprm_mis_4_trs_h.fm_static_eprm_bitfield.Sbx_mf_xxx ECU_ADDRESS 0xc0000534 BIT_MASK 0x20 /end MEASUREMENT
/begin MEASUREMENT Sbx_cf_mis_4_trs_h "" UBYTE _CNV_A_R_A_165_CM 1 0. 0. 255. DISPLAY_IDENTIFIER fm_sta_eprm_mis_4_trs_h.fm_static_eprm_bitfield.Sbx_cf_xxx ECU_ADDRESS 0xc0000534 BIT_MASK 0x80 /end MEASUREMENT
/begin MEASUREMENT Sbx_dyn_mis_cata "" UBYTE _CNV_A_R_A_165_CM 1 0. 0. 255. DISPLAY_IDENTIFIER fm_sta_eprm_mis_cata.fm_static_eprm_bitfield.Sbx_dyn_xxx ECU_ADDRESS 0xc0000536 BIT_MASK 0x8 /end MEASUREMENT
/begin MEASUREMENT Sbx_rdn_mis_cata "" UBYTE _CNV_A_R_A_165_CM 1 0. 0. 255. DISPLAY_IDENTIFIER fm_sta_eprm_mis_cata.fm_static_eprm_bitfield.Sbx_rdn_xxx ECU_ADDRESS 0xc0000536 BIT_MASK 0x10 /end MEASUREMENT
/begin MEASUREMENT Sbx_mf_mis_cata "" UBYTE _CNV_A_R_A_165_CM 1 0. 0. 255. DISPLAY_IDENTIFIER fm_sta_eprm_mis_cata.fm_static_eprm_bitfield.Sbx_mf_xxx ECU_ADDRESS 0xc0000536 BIT_MASK 0x20 /end MEASUREMENT
/begin MEASUREMENT Sbx_cf_mis_cata "" UBYTE _CNV_A_R_A_165_CM 1 0. 0. 255. DISPLAY_IDENTIFIER fm_sta_eprm_mis_cata.fm_static_eprm_bitfield.Sbx_cf_xxx ECU_ADDRESS 0xc0000536 BIT_MASK 0x80 /end MEASUREMENT
/begin MEASUREMENT Sbx_dyn_mis_lpg_cata "" UBYTE _CNV_A_R_A_165_CM 1 0. 0. 255. DISPLAY_IDENTIFIER fm_sta_eprm_mis_lpg_cata.fm_static_eprm_bitfield.Sbx_dyn_xxx ECU_ADDRESS 0xc0000538 BIT_MASK 0x8 /end MEASUREMENT
/begin MEASUREMENT Sbx_rdn_mis_lpg_cata "" UBYTE _CNV_A_R_A_165_CM 1 0. 0. 255. DISPLAY_IDENTIFIER fm_sta_eprm_mis_lpg_cata.fm_static_eprm_bitfield.Sbx_rdn_xxx ECU_ADDRESS 0xc0000538 BIT_MASK 0x10 /end MEASUREMENT
/begin MEASUREMENT Sbx_mf_mis_lpg_cata "" UBYTE _CNV_A_R_A_165_CM 1 0. 0. 255. DISPLAY_IDENTIFIER fm_sta_eprm_mis_lpg_cata.fm_static_eprm_bitfield.Sbx_mf_xxx ECU_ADDRESS 0xc0000538 BIT_MASK 0x20 /end MEASUREMENT
/begin MEASUREMENT Sbx_cf_mis_lpg_cata "" UBYTE _CNV_A_R_A_165_CM 1 0. 0. 255. DISPLAY_IDENTIFIER fm_sta_eprm_mis_lpg_cata.fm_static_eprm_bitfield.Sbx_cf_xxx ECU_ADDRESS 0xc0000538 BIT_MASK 0x80 /end MEASUREMENT
/begin MEASUREMENT Sbx_dyn_mis_lpg_trs_h "" UBYTE _CNV_A_R_A_165_CM 1 0. 0. 255. DISPLAY_IDENTIFIER fm_sta_eprm_mis_lpg_trs_h.fm_static_eprm_bitfield.Sbx_dyn_xxx ECU_ADDRESS 0xc000053a BIT_MASK 0x8 /end MEASUREMENT
/begin MEASUREMENT Sbx_rdn_mis_lpg_trs_h "" UBYTE _CNV_A_R_A_165_CM 1 0. 0. 255. DISPLAY_IDENTIFIER fm_sta_eprm_mis_lpg_trs_h.fm_static_eprm_bitfield.Sbx_rdn_xxx ECU_ADDRESS 0xc000053a BIT_MASK 0x10 /end MEASUREMENT
/begin MEASUREMENT Sbx_mf_mis_lpg_trs_h "" UBYTE _CNV_A_R_A_165_CM 1 0. 0. 255. DISPLAY_IDENTIFIER fm_sta_eprm_mis_lpg_trs_h.fm_static_eprm_bitfield.Sbx_mf_xxx ECU_ADDRESS 0xc000053a BIT_MASK 0x20 /end MEASUREMENT
/begin MEASUREMENT Sbx_cf_mis_lpg_trs_h "" UBYTE _CNV_A_R_A_165_CM 1 0. 0. 255. DISPLAY_IDENTIFIER fm_sta_eprm_mis_lpg_trs_h.fm_static_eprm_bitfield.Sbx_cf_xxx ECU_ADDRESS 0xc000053a BIT_MASK 0x80 /end MEASUREMENT
/begin MEASUREMENT Sbx_dyn_mis_min_fuel_cata "" UBYTE _CNV_A_R_A_165_CM 1 0. 0. 255. DISPLAY_IDENTIFIER fm_sta_eprm_mis_min_fuel_cata.fm_static_eprm_bitfield.Sbx_dyn_xxx ECU_ADDRESS 0xc000053c BIT_MASK 0x8 /end MEASUREMENT
/begin MEASUREMENT Sbx_rdn_mis_min_fuel_cata "" UBYTE _CNV_A_R_A_165_CM 1 0. 0. 255. DISPLAY_IDENTIFIER fm_sta_eprm_mis_min_fuel_cata.fm_static_eprm_bitfield.Sbx_rdn_xxx ECU_ADDRESS 0xc000053c BIT_MASK 0x10 /end MEASUREMENT
/begin MEASUREMENT Sbx_mf_mis_min_fuel_cata "" UBYTE _CNV_A_R_A_165_CM 1 0. 0. 255. DISPLAY_IDENTIFIER fm_sta_eprm_mis_min_fuel_cata.fm_static_eprm_bitfield.Sbx_mf_xxx ECU_ADDRESS 0xc000053c BIT_MASK 0x20 /end MEASUREMENT
/begin MEASUREMENT Sbx_cf_mis_min_fuel_cata "" UBYTE _CNV_A_R_A_165_CM 1 0. 0. 255. DISPLAY_IDENTIFIER fm_sta_eprm_mis_min_fuel_cata.fm_static_eprm_bitfield.Sbx_cf_xxx ECU_ADDRESS 0xc000053c BIT_MASK 0x80 /end MEASUREMENT
/begin MEASUREMENT Sbx_dyn_mis_min_fuel_trs_h "" UBYTE _CNV_A_R_A_165_CM 1 0. 0. 255. DISPLAY_IDENTIFIER fm_sta_eprm_mis_min_fuel_trs_h.fm_static_eprm_bitfield.Sbx_dyn_xxx ECU_ADDRESS 0xc000053e BIT_MASK 0x8 /end MEASUREMENT
/begin MEASUREMENT Sbx_rdn_mis_min_fuel_trs_h "" UBYTE _CNV_A_R_A_165_CM 1 0. 0. 255. DISPLAY_IDENTIFIER fm_sta_eprm_mis_min_fuel_trs_h.fm_static_eprm_bitfield.Sbx_rdn_xxx ECU_ADDRESS 0xc000053e BIT_MASK 0x10 /end MEASUREMENT
/begin MEASUREMENT Sbx_mf_mis_min_fuel_trs_h "" UBYTE _CNV_A_R_A_165_CM 1 0. 0. 255. DISPLAY_IDENTIFIER fm_sta_eprm_mis_min_fuel_trs_h.fm_static_eprm_bitfield.Sbx_mf_xxx ECU_ADDRESS 0xc000053e BIT_MASK 0x20 /end MEASUREMENT
/begin MEASUREMENT Sbx_cf_mis_min_fuel_trs_h "" UBYTE _CNV_A_R_A_165_CM 1 0. 0. 255. DISPLAY_IDENTIFIER fm_sta_eprm_mis_min_fuel_trs_h.fm_static_eprm_bitfield.Sbx_cf_xxx ECU_ADDRESS 0xc000053e BIT_MASK 0x80 /end MEASUREMENT
/begin MEASUREMENT Sbx_dyn_mis_trs_h "" UBYTE _CNV_A_R_A_165_CM 1 0. 0. 255. DISPLAY_IDENTIFIER fm_sta_eprm_mis_trs_h.fm_static_eprm_bitfield.Sbx_dyn_xxx ECU_ADDRESS 0xc0000540 BIT_MASK 0x8 /end MEASUREMENT
/begin MEASUREMENT Sbx_rdn_mis_trs_h "" UBYTE _CNV_A_R_A_165_CM 1 0. 0. 255. DISPLAY_IDENTIFIER fm_sta_eprm_mis_trs_h.fm_static_eprm_bitfield.Sbx_rdn_xxx ECU_ADDRESS 0xc0000540 BIT_MASK 0x10 /end MEASUREMENT
/begin MEASUREMENT Sbx_mf_mis_trs_h "" UBYTE _CNV_A_R_A_165_CM 1 0. 0. 255. DISPLAY_IDENTIFIER fm_sta_eprm_mis_trs_h.fm_static_eprm_bitfield.Sbx_mf_xxx ECU_ADDRESS 0xc0000540 BIT_MASK 0x20 /end MEASUREMENT
/begin MEASUREMENT Sbx_cf_mis_trs_h "" UBYTE _CNV_A_R_A_165_CM 1 0. 0. 255. DISPLAY_IDENTIFIER fm_sta_eprm_mis_trs_h.fm_static_eprm_bitfield.Sbx_cf_xxx ECU_ADDRESS 0xc0000540 BIT_MASK 0x80 /end MEASUREMENT
/begin MEASUREMENT Sbx_dyn_mis_unk_cata "" UBYTE _CNV_A_R_A_165_CM 1 0. 0. 255. DISPLAY_IDENTIFIER fm_sta_eprm_mis_unk_cata.fm_static_eprm_bitfield.Sbx_dyn_xxx ECU_ADDRESS 0xc0000542 BIT_MASK 0x8 /end MEASUREMENT
/begin MEASUREMENT Sbx_rdn_mis_unk_cata "" UBYTE _CNV_A_R_A_165_CM 1 0. 0. 255. DISPLAY_IDENTIFIER fm_sta_eprm_mis_unk_cata.fm_static_eprm_bitfield.Sbx_rdn_xxx ECU_ADDRESS 0xc0000542 BIT_MASK 0x10 /end MEASUREMENT
/begin MEASUREMENT Sbx_mf_mis_unk_cata "" UBYTE _CNV_A_R_A_165_CM 1 0. 0. 255. DISPLAY_IDENTIFIER fm_sta_eprm_mis_unk_cata.fm_static_eprm_bitfield.Sbx_mf_xxx ECU_ADDRESS 0xc0000542 BIT_MASK 0x20 /end MEASUREMENT
/begin MEASUREMENT Sbx_cf_mis_unk_cata "" UBYTE _CNV_A_R_A_165_CM 1 0. 0. 255. DISPLAY_IDENTIFIER fm_sta_eprm_mis_unk_cata.fm_static_eprm_bitfield.Sbx_cf_xxx ECU_ADDRESS 0xc0000542 BIT_MASK 0x80 /end MEASUREMENT
/begin MEASUREMENT Sbx_dyn_mis_unk_lpg_cata "" UBYTE _CNV_A_R_A_165_CM 1 0. 0. 255. DISPLAY_IDENTIFIER fm_sta_eprm_mis_unk_lpg_cata.fm_static_eprm_bitfield.Sbx_dyn_xxx ECU_ADDRESS 0xc0000544 BIT_MASK 0x8 /end MEASUREMENT
/begin MEASUREMENT Sbx_rdn_mis_unk_lpg_cata "" UBYTE _CNV_A_R_A_165_CM 1 0. 0. 255. DISPLAY_IDENTIFIER fm_sta_eprm_mis_unk_lpg_cata.fm_static_eprm_bitfield.Sbx_rdn_xxx ECU_ADDRESS 0xc0000544 BIT_MASK 0x10 /end MEASUREMENT
/begin MEASUREMENT Sbx_mf_mis_unk_lpg_cata "" UBYTE _CNV_A_R_A_165_CM 1 0. 0. 255. DISPLAY_IDENTIFIER fm_sta_eprm_mis_unk_lpg_cata.fm_static_eprm_bitfield.Sbx_mf_xxx ECU_ADDRESS 0xc0000544 BIT_MASK 0x20 /end MEASUREMENT
/begin MEASUREMENT Sbx_cf_mis_unk_lpg_cata "" UBYTE _CNV_A_R_A_165_CM 1 0. 0. 255. DISPLAY_IDENTIFIER fm_sta_eprm_mis_unk_lpg_cata.fm_static_eprm_bitfield.Sbx_cf_xxx ECU_ADDRESS 0xc0000544 BIT_MASK 0x80 /end MEASUREMENT
/begin MEASUREMENT Sbx_dyn_mis_unk_lpg_trs_h "" UBYTE _CNV_A_R_A_165_CM 1 0. 0. 255. DISPLAY_IDENTIFIER fm_sta_eprm_mis_unk_lpg_trs_h.fm_static_eprm_bitfield.Sbx_dyn_xxx ECU_ADDRESS 0xc0000546 BIT_MASK 0x8 /end MEASUREMENT
/begin MEASUREMENT Sbx_rdn_mis_unk_lpg_trs_h "" UBYTE _CNV_A_R_A_165_CM 1 0. 0. 255. DISPLAY_IDENTIFIER fm_sta_eprm_mis_unk_lpg_trs_h.fm_static_eprm_bitfield.Sbx_rdn_xxx ECU_ADDRESS 0xc0000546 BIT_MASK 0x10 /end MEASUREMENT
/begin MEASUREMENT Sbx_mf_mis_unk_lpg_trs_h "" UBYTE _CNV_A_R_A_165_CM 1 0. 0. 255. DISPLAY_IDENTIFIER fm_sta_eprm_mis_unk_lpg_trs_h.fm_static_eprm_bitfield.Sbx_mf_xxx ECU_ADDRESS 0xc0000546 BIT_MASK 0x20 /end MEASUREMENT
/begin MEASUREMENT Sbx_cf_mis_unk_lpg_trs_h "" UBYTE _CNV_A_R_A_165_CM 1 0. 0. 255. DISPLAY_IDENTIFIER fm_sta_eprm_mis_unk_lpg_trs_h.fm_static_eprm_bitfield.Sbx_cf_xxx ECU_ADDRESS 0xc0000546 BIT_MASK 0x80 /end MEASUREMENT
/begin MEASUREMENT Sbx_dyn_mis_unk_trs_h "" UBYTE _CNV_A_R_A_165_CM 1 0. 0. 255. DISPLAY_IDENTIFIER fm_sta_eprm_mis_unk_trs_h.fm_static_eprm_bitfield.Sbx_dyn_xxx ECU_ADDRESS 0xc0000548 BIT_MASK 0x8 /end MEASUREMENT
/begin MEASUREMENT Sbx_rdn_mis_unk_trs_h "" UBYTE _CNV_A_R_A_165_CM 1 0. 0. 255. DISPLAY_IDENTIFIER fm_sta_eprm_mis_unk_trs_h.fm_static_eprm_bitfield.Sbx_rdn_xxx ECU_ADDRESS 0xc0000548 BIT_MASK 0x10 /end MEASUREMENT
/begin MEASUREMENT Sbx_mf_mis_unk_trs_h "" UBYTE _CNV_A_R_A_165_CM 1 0. 0. 255. DISPLAY_IDENTIFIER fm_sta_eprm_mis_unk_trs_h.fm_static_eprm_bitfield.Sbx_mf_xxx ECU_ADDRESS 0xc0000548 BIT_MASK 0x20 /end MEASUREMENT
/begin MEASUREMENT Sbx_cf_mis_unk_trs_h "" UBYTE _CNV_A_R_A_165_CM 1 0. 0. 255. DISPLAY_IDENTIFIER fm_sta_eprm_mis_unk_trs_h.fm_static_eprm_bitfield.Sbx_cf_xxx ECU_ADDRESS 0xc0000548 BIT_MASK 0x80 /end MEASUREMENT
/begin MEASUREMENT Sbx_dyn_ptc_rov_oc "" UBYTE _CNV_A_R_A_165_CM 1 0. 0. 255. DISPLAY_IDENTIFIER fm_sta_eprm_ptc_rov_oc.fm_static_eprm_bitfield.Sbx_dyn_xxx ECU_ADDRESS 0xc000057a BIT_MASK 0x8 /end MEASUREMENT
/begin MEASUREMENT Sbx_rdn_ptc_rov_oc "" UBYTE _CNV_A_R_A_165_CM 1 0. 0. 255. DISPLAY_IDENTIFIER fm_sta_eprm_ptc_rov_oc.fm_static_eprm_bitfield.Sbx_rdn_xxx ECU_ADDRESS 0xc000057a BIT_MASK 0x10 /end MEASUREMENT
/begin MEASUREMENT Sbx_mf_ptc_rov_oc "" UBYTE _CNV_A_R_A_165_CM 1 0. 0. 255. DISPLAY_IDENTIFIER fm_sta_eprm_ptc_rov_oc.fm_static_eprm_bitfield.Sbx_mf_xxx ECU_ADDRESS 0xc000057a BIT_MASK 0x20 /end MEASUREMENT
/begin MEASUREMENT Sbx_cf_ptc_rov_oc "" UBYTE _CNV_A_R_A_165_CM 1 0. 0. 255. DISPLAY_IDENTIFIER fm_sta_eprm_ptc_rov_oc.fm_static_eprm_bitfield.Sbx_cf_xxx ECU_ADDRESS 0xc000057a BIT_MASK 0x80 /end MEASUREMENT
/begin MEASUREMENT Sbx_dyn_ptc_rov_scg "" UBYTE _CNV_A_R_A_165_CM 1 0. 0. 255. DISPLAY_IDENTIFIER fm_sta_eprm_ptc_rov_scg.fm_static_eprm_bitfield.Sbx_dyn_xxx ECU_ADDRESS 0xc000057c BIT_MASK 0x8 /end MEASUREMENT
/begin MEASUREMENT Sbx_rdn_ptc_rov_scg "" UBYTE _CNV_A_R_A_165_CM 1 0. 0. 255. DISPLAY_IDENTIFIER fm_sta_eprm_ptc_rov_scg.fm_static_eprm_bitfield.Sbx_rdn_xxx ECU_ADDRESS 0xc000057c BIT_MASK 0x10 /end MEASUREMENT
/begin MEASUREMENT Sbx_mf_ptc_rov_scg "" UBYTE _CNV_A_R_A_165_CM 1 0. 0. 255. DISPLAY_IDENTIFIER fm_sta_eprm_ptc_rov_scg.fm_static_eprm_bitfield.Sbx_mf_xxx ECU_ADDRESS 0xc000057c BIT_MASK 0x20 /end MEASUREMENT
/begin MEASUREMENT Sbx_cf_ptc_rov_scg "" UBYTE _CNV_A_R_A_165_CM 1 0. 0. 255. DISPLAY_IDENTIFIER fm_sta_eprm_ptc_rov_scg.fm_static_eprm_bitfield.Sbx_cf_xxx ECU_ADDRESS 0xc000057c BIT_MASK 0x80 /end MEASUREMENT
/begin MEASUREMENT Sbx_dyn_ptc_rov_scw "" UBYTE _CNV_A_R_A_165_CM 1 0. 0. 255. DISPLAY_IDENTIFIER fm_sta_eprm_ptc_rov_scw.fm_static_eprm_bitfield.Sbx_dyn_xxx ECU_ADDRESS 0xc000057e BIT_MASK 0x8 /end MEASUREMENT
/begin MEASUREMENT Sbx_rdn_ptc_rov_scw "" UBYTE _CNV_A_R_A_165_CM 1 0. 0. 255. DISPLAY_IDENTIFIER fm_sta_eprm_ptc_rov_scw.fm_static_eprm_bitfield.Sbx_rdn_xxx ECU_ADDRESS 0xc000057e BIT_MASK 0x10 /end MEASUREMENT
/begin MEASUREMENT Sbx_mf_ptc_rov_scw "" UBYTE _CNV_A_R_A_165_CM 1 0. 0. 255. DISPLAY_IDENTIFIER fm_sta_eprm_ptc_rov_scw.fm_static_eprm_bitfield.Sbx_mf_xxx ECU_ADDRESS 0xc000057e BIT_MASK 0x20 /end MEASUREMENT
/begin MEASUREMENT Sbx_cf_ptc_rov_scw "" UBYTE _CNV_A_R_A_165_CM 1 0. 0. 255. DISPLAY_IDENTIFIER fm_sta_eprm_ptc_rov_scw.fm_static_eprm_bitfield.Sbx_cf_xxx ECU_ADDRESS 0xc000057e BIT_MASK 0x80 /end MEASUREMENT
/begin MEASUREMENT Sbx_dyn_pws_1_h "" UBYTE _CNV_A_R_A_165_CM 1 0. 0. 255. DISPLAY_IDENTIFIER fm_sta_eprm_pws_1_h.fm_static_eprm_bitfield.Sbx_dyn_xxx ECU_ADDRESS 0xc00004b8 BIT_MASK 0x8 /end MEASUREMENT
/begin MEASUREMENT Sbx_rdn_pws_1_h "" UBYTE _CNV_A_R_A_165_CM 1 0. 0. 255. DISPLAY_IDENTIFIER fm_sta_eprm_pws_1_h.fm_static_eprm_bitfield.Sbx_rdn_xxx ECU_ADDRESS 0xc00004b8 BIT_MASK 0x10 /end MEASUREMENT
/begin MEASUREMENT Sbx_mf_pws_1_h "" UBYTE _CNV_A_R_A_165_CM 1 0. 0. 255. DISPLAY_IDENTIFIER fm_sta_eprm_pws_1_h.fm_static_eprm_bitfield.Sbx_mf_xxx ECU_ADDRESS 0xc00004b8 BIT_MASK 0x20 /end MEASUREMENT
/begin MEASUREMENT Sbx_cf_pws_1_h "" UBYTE _CNV_A_R_A_165_CM 1 0. 0. 255. DISPLAY_IDENTIFIER fm_sta_eprm_pws_1_h.fm_static_eprm_bitfield.Sbx_cf_xxx ECU_ADDRESS 0xc00004b8 BIT_MASK 0x80 /end MEASUREMENT
/begin MEASUREMENT Sbx_dyn_pws_1_l "" UBYTE _CNV_A_R_A_165_CM 1 0. 0. 255. DISPLAY_IDENTIFIER fm_sta_eprm_pws_1_l.fm_static_eprm_bitfield.Sbx_dyn_xxx ECU_ADDRESS 0xc00004ba BIT_MASK 0x8 /end MEASUREMENT
/begin MEASUREMENT Sbx_rdn_pws_1_l "" UBYTE _CNV_A_R_A_165_CM 1 0. 0. 255. DISPLAY_IDENTIFIER fm_sta_eprm_pws_1_l.fm_static_eprm_bitfield.Sbx_rdn_xxx ECU_ADDRESS 0xc00004ba BIT_MASK 0x10 /end MEASUREMENT
/begin MEASUREMENT Sbx_mf_pws_1_l "" UBYTE _CNV_A_R_A_165_CM 1 0. 0. 255. DISPLAY_IDENTIFIER fm_sta_eprm_pws_1_l.fm_static_eprm_bitfield.Sbx_mf_xxx ECU_ADDRESS 0xc00004ba BIT_MASK 0x20 /end MEASUREMENT
/begin MEASUREMENT Sbx_cf_pws_1_l "" UBYTE _CNV_A_R_A_165_CM 1 0. 0. 255. DISPLAY_IDENTIFIER fm_sta_eprm_pws_1_l.fm_static_eprm_bitfield.Sbx_cf_xxx ECU_ADDRESS 0xc00004ba BIT_MASK 0x80 /end MEASUREMENT
/begin MEASUREMENT Sbx_dyn_pws_2_h "" UBYTE _CNV_A_R_A_165_CM 1 0. 0. 255. DISPLAY_IDENTIFIER fm_sta_eprm_pws_2_h.fm_static_eprm_bitfield.Sbx_dyn_xxx ECU_ADDRESS 0xc00004bc BIT_MASK 0x8 /end MEASUREMENT
/begin MEASUREMENT Sbx_rdn_pws_2_h "" UBYTE _CNV_A_R_A_165_CM 1 0. 0. 255. DISPLAY_IDENTIFIER fm_sta_eprm_pws_2_h.fm_static_eprm_bitfield.Sbx_rdn_xxx ECU_ADDRESS 0xc00004bc BIT_MASK 0x10 /end MEASUREMENT
/begin MEASUREMENT Sbx_mf_pws_2_h "" UBYTE _CNV_A_R_A_165_CM 1 0. 0. 255. DISPLAY_IDENTIFIER fm_sta_eprm_pws_2_h.fm_static_eprm_bitfield.Sbx_mf_xxx ECU_ADDRESS 0xc00004bc BIT_MASK 0x20 /end MEASUREMENT
/begin MEASUREMENT Sbx_cf_pws_2_h "" UBYTE _CNV_A_R_A_165_CM 1 0. 0. 255. DISPLAY_IDENTIFIER fm_sta_eprm_pws_2_h.fm_static_eprm_bitfield.Sbx_cf_xxx ECU_ADDRESS 0xc00004bc BIT_MASK 0x80 /end MEASUREMENT
/begin MEASUREMENT Sbx_dyn_pws_2_l "" UBYTE _CNV_A_R_A_165_CM 1 0. 0. 255. DISPLAY_IDENTIFIER fm_sta_eprm_pws_2_l.fm_static_eprm_bitfield.Sbx_dyn_xxx ECU_ADDRESS 0xc00004be BIT_MASK 0x8 /end MEASUREMENT
/begin MEASUREMENT Sbx_rdn_pws_2_l "" UBYTE _CNV_A_R_A_165_CM 1 0. 0. 255. DISPLAY_IDENTIFIER fm_sta_eprm_pws_2_l.fm_static_eprm_bitfield.Sbx_rdn_xxx ECU_ADDRESS 0xc00004be BIT_MASK 0x10 /end MEASUREMENT
/begin MEASUREMENT Sbx_mf_pws_2_l "" UBYTE _CNV_A_R_A_165_CM 1 0. 0. 255. DISPLAY_IDENTIFIER fm_sta_eprm_pws_2_l.fm_static_eprm_bitfield.Sbx_mf_xxx ECU_ADDRESS 0xc00004be BIT_MASK 0x20 /end MEASUREMENT
/begin MEASUREMENT Sbx_cf_pws_2_l "" UBYTE _CNV_A_R_A_165_CM 1 0. 0. 255. DISPLAY_IDENTIFIER fm_sta_eprm_pws_2_l.fm_static_eprm_bitfield.Sbx_cf_xxx ECU_ADDRESS 0xc00004be BIT_MASK 0x80 /end MEASUREMENT
/begin MEASUREMENT Sbx_dyn_pws_3_h "" UBYTE _CNV_A_R_A_165_CM 1 0. 0. 255. DISPLAY_IDENTIFIER fm_sta_eprm_pws_3_h.fm_static_eprm_bitfield.Sbx_dyn_xxx ECU_ADDRESS 0xc00004c0 BIT_MASK 0x8 /end MEASUREMENT
/begin MEASUREMENT Sbx_rdn_pws_3_h "" UBYTE _CNV_A_R_A_165_CM 1 0. 0. 255. DISPLAY_IDENTIFIER fm_sta_eprm_pws_3_h.fm_static_eprm_bitfield.Sbx_rdn_xxx ECU_ADDRESS 0xc00004c0 BIT_MASK 0x10 /end MEASUREMENT
/begin MEASUREMENT Sbx_mf_pws_3_h "" UBYTE _CNV_A_R_A_165_CM 1 0. 0. 255. DISPLAY_IDENTIFIER fm_sta_eprm_pws_3_h.fm_static_eprm_bitfield.Sbx_mf_xxx ECU_ADDRESS 0xc00004c0 BIT_MASK 0x20 /end MEASUREMENT
/begin MEASUREMENT Sbx_cf_pws_3_h "" UBYTE _CNV_A_R_A_165_CM 1 0. 0. 255. DISPLAY_IDENTIFIER fm_sta_eprm_pws_3_h.fm_static_eprm_bitfield.Sbx_cf_xxx ECU_ADDRESS 0xc00004c0 BIT_MASK 0x80 /end MEASUREMENT
/begin MEASUREMENT Sbx_dyn_pws_3_l "" UBYTE _CNV_A_R_A_165_CM 1 0. 0. 255. DISPLAY_IDENTIFIER fm_sta_eprm_pws_3_l.fm_static_eprm_bitfield.Sbx_dyn_xxx ECU_ADDRESS 0xc00004c2 BIT_MASK 0x8 /end MEASUREMENT
/begin MEASUREMENT Sbx_rdn_pws_3_l "" UBYTE _CNV_A_R_A_165_CM 1 0. 0. 255. DISPLAY_IDENTIFIER fm_sta_eprm_pws_3_l.fm_static_eprm_bitfield.Sbx_rdn_xxx ECU_ADDRESS 0xc00004c2 BIT_MASK 0x10 /end MEASUREMENT
/begin MEASUREMENT Sbx_mf_pws_3_l "" UBYTE _CNV_A_R_A_165_CM 1 0. 0. 255. DISPLAY_IDENTIFIER fm_sta_eprm_pws_3_l.fm_static_eprm_bitfield.Sbx_mf_xxx ECU_ADDRESS 0xc00004c2 BIT_MASK 0x20 /end MEASUREMENT
/begin MEASUREMENT Sbx_cf_pws_3_l "" UBYTE _CNV_A_R_A_165_CM 1 0. 0. 255. DISPLAY_IDENTIFIER fm_sta_eprm_pws_3_l.fm_static_eprm_bitfield.Sbx_cf_xxx ECU_ADDRESS 0xc00004c2 BIT_MASK 0x80 /end MEASUREMENT
/begin MEASUREMENT Sbx_dyn_sens_it_1_nok "" UBYTE _CNV_A_R_A_165_CM 1 0. 0. 255. DISPLAY_IDENTIFIER fm_sta_eprm_sens_it_1_nok.fm_static_eprm_bitfield.Sbx_dyn_xxx ECU_ADDRESS 0xc00004c4 BIT_MASK 0x8 /end MEASUREMENT
/begin MEASUREMENT Sbx_rdn_sens_it_1_nok "" UBYTE _CNV_A_R_A_165_CM 1 0. 0. 255. DISPLAY_IDENTIFIER fm_sta_eprm_sens_it_1_nok.fm_static_eprm_bitfield.Sbx_rdn_xxx ECU_ADDRESS 0xc00004c4 BIT_MASK 0x10 /end MEASUREMENT
/begin MEASUREMENT Sbx_mf_sens_it_1_nok "" UBYTE _CNV_A_R_A_165_CM 1 0. 0. 255. DISPLAY_IDENTIFIER fm_sta_eprm_sens_it_1_nok.fm_static_eprm_bitfield.Sbx_mf_xxx ECU_ADDRESS 0xc00004c4 BIT_MASK 0x20 /end MEASUREMENT
/begin MEASUREMENT Sbx_cf_sens_it_1_nok "" UBYTE _CNV_A_R_A_165_CM 1 0. 0. 255. DISPLAY_IDENTIFIER fm_sta_eprm_sens_it_1_nok.fm_static_eprm_bitfield.Sbx_cf_xxx ECU_ADDRESS 0xc00004c4 BIT_MASK 0x80 /end MEASUREMENT
/begin MEASUREMENT Sbx_dyn_sens_it_2_nok "" UBYTE _CNV_A_R_A_165_CM 1 0. 0. 255. DISPLAY_IDENTIFIER fm_sta_eprm_sens_it_2_nok.fm_static_eprm_bitfield.Sbx_dyn_xxx ECU_ADDRESS 0xc00004c6 BIT_MASK 0x8 /end MEASUREMENT
/begin MEASUREMENT Sbx_rdn_sens_it_2_nok "" UBYTE _CNV_A_R_A_165_CM 1 0. 0. 255. DISPLAY_IDENTIFIER fm_sta_eprm_sens_it_2_nok.fm_static_eprm_bitfield.Sbx_rdn_xxx ECU_ADDRESS 0xc00004c6 BIT_MASK 0x10 /end MEASUREMENT
/begin MEASUREMENT Sbx_mf_sens_it_2_nok "" UBYTE _CNV_A_R_A_165_CM 1 0. 0. 255. DISPLAY_IDENTIFIER fm_sta_eprm_sens_it_2_nok.fm_static_eprm_bitfield.Sbx_mf_xxx ECU_ADDRESS 0xc00004c6 BIT_MASK 0x20 /end MEASUREMENT
/begin MEASUREMENT Sbx_cf_sens_it_2_nok "" UBYTE _CNV_A_R_A_165_CM 1 0. 0. 255. DISPLAY_IDENTIFIER fm_sta_eprm_sens_it_2_nok.fm_static_eprm_bitfield.Sbx_cf_xxx ECU_ADDRESS 0xc00004c6 BIT_MASK 0x80 /end MEASUREMENT
/begin MEASUREMENT Sbx_dyn_sens_it_chr "" UBYTE _CNV_A_R_A_165_CM 1 0. 0. 255. DISPLAY_IDENTIFIER fm_sta_eprm_sens_it_chr.fm_static_eprm_bitfield.Sbx_dyn_xxx ECU_ADDRESS 0xc00004c8 BIT_MASK 0x8 /end MEASUREMENT
/begin MEASUREMENT Sbx_rdn_sens_it_chr "" UBYTE _CNV_A_R_A_165_CM 1 0. 0. 255. DISPLAY_IDENTIFIER fm_sta_eprm_sens_it_chr.fm_static_eprm_bitfield.Sbx_rdn_xxx ECU_ADDRESS 0xc00004c8 BIT_MASK 0x10 /end MEASUREMENT
/begin MEASUREMENT Sbx_mf_sens_it_chr "" UBYTE _CNV_A_R_A_165_CM 1 0. 0. 255. DISPLAY_IDENTIFIER fm_sta_eprm_sens_it_chr.fm_static_eprm_bitfield.Sbx_mf_xxx ECU_ADDRESS 0xc00004c8 BIT_MASK 0x20 /end MEASUREMENT
/begin MEASUREMENT Sbx_cf_sens_it_chr "" UBYTE _CNV_A_R_A_165_CM 1 0. 0. 255. DISPLAY_IDENTIFIER fm_sta_eprm_sens_it_chr.fm_static_eprm_bitfield.Sbx_cf_xxx ECU_ADDRESS 0xc00004c8 BIT_MASK 0x80 /end MEASUREMENT
/begin MEASUREMENT Sbx_dyn_sens_it_sig_mcut "" UBYTE _CNV_A_R_A_165_CM 1 0. 0. 255. DISPLAY_IDENTIFIER fm_sta_eprm_sens_it_sig_mcut.fm_static_eprm_bitfield.Sbx_dyn_xxx ECU_ADDRESS 0xc00004ca BIT_MASK 0x8 /end MEASUREMENT
/begin MEASUREMENT Sbx_rdn_sens_it_sig_mcut "" UBYTE _CNV_A_R_A_165_CM 1 0. 0. 255. DISPLAY_IDENTIFIER fm_sta_eprm_sens_it_sig_mcut.fm_static_eprm_bitfield.Sbx_rdn_xxx ECU_ADDRESS 0xc00004ca BIT_MASK 0x10 /end MEASUREMENT
/begin MEASUREMENT Sbx_mf_sens_it_sig_mcut "" UBYTE _CNV_A_R_A_165_CM 1 0. 0. 255. DISPLAY_IDENTIFIER fm_sta_eprm_sens_it_sig_mcut.fm_static_eprm_bitfield.Sbx_mf_xxx ECU_ADDRESS 0xc00004ca BIT_MASK 0x20 /end MEASUREMENT
/begin MEASUREMENT Sbx_cf_sens_it_sig_mcut "" UBYTE _CNV_A_R_A_165_CM 1 0. 0. 255. DISPLAY_IDENTIFIER fm_sta_eprm_sens_it_sig_mcut.fm_static_eprm_bitfield.Sbx_cf_xxx ECU_ADDRESS 0xc00004ca BIT_MASK 0x80 /end MEASUREMENT
/begin MEASUREMENT Sbx_dyn_sens_map_h "" UBYTE _CNV_A_R_A_165_CM 1 0. 0. 255. DISPLAY_IDENTIFIER fm_sta_eprm_sens_map_h.fm_static_eprm_bitfield.Sbx_dyn_xxx ECU_ADDRESS 0xc00004cc BIT_MASK 0x8 /end MEASUREMENT
/begin MEASUREMENT Sbx_rdn_sens_map_h "" UBYTE _CNV_A_R_A_165_CM 1 0. 0. 255. DISPLAY_IDENTIFIER fm_sta_eprm_sens_map_h.fm_static_eprm_bitfield.Sbx_rdn_xxx ECU_ADDRESS 0xc00004cc BIT_MASK 0x10 /end MEASUREMENT
/begin MEASUREMENT Sbx_mf_sens_map_h "" UBYTE _CNV_A_R_A_165_CM 1 0. 0. 255. DISPLAY_IDENTIFIER fm_sta_eprm_sens_map_h.fm_static_eprm_bitfield.Sbx_mf_xxx ECU_ADDRESS 0xc00004cc BIT_MASK 0x20 /end MEASUREMENT
/begin MEASUREMENT Sbx_cf_sens_map_h "" UBYTE _CNV_A_R_A_165_CM 1 0. 0. 255. DISPLAY_IDENTIFIER fm_sta_eprm_sens_map_h.fm_static_eprm_bitfield.Sbx_cf_xxx ECU_ADDRESS 0xc00004cc BIT_MASK 0x80 /end MEASUREMENT
/begin MEASUREMENT Sbx_dyn_sens_map_l "" UBYTE _CNV_A_R_A_165_CM 1 0. 0. 255. DISPLAY_IDENTIFIER fm_sta_eprm_sens_map_l.fm_static_eprm_bitfield.Sbx_dyn_xxx ECU_ADDRESS 0xc00004ce BIT_MASK 0x8 /end MEASUREMENT
/begin MEASUREMENT Sbx_rdn_sens_map_l "" UBYTE _CNV_A_R_A_165_CM 1 0. 0. 255. DISPLAY_IDENTIFIER fm_sta_eprm_sens_map_l.fm_static_eprm_bitfield.Sbx_rdn_xxx ECU_ADDRESS 0xc00004ce BIT_MASK 0x10 /end MEASUREMENT
/begin MEASUREMENT Sbx_mf_sens_map_l "" UBYTE _CNV_A_R_A_165_CM 1 0. 0. 255. DISPLAY_IDENTIFIER fm_sta_eprm_sens_map_l.fm_static_eprm_bitfield.Sbx_mf_xxx ECU_ADDRESS 0xc00004ce BIT_MASK 0x20 /end MEASUREMENT
/begin MEASUREMENT Sbx_cf_sens_map_l "" UBYTE _CNV_A_R_A_165_CM 1 0. 0. 255. DISPLAY_IDENTIFIER fm_sta_eprm_sens_map_l.fm_static_eprm_bitfield.Sbx_cf_xxx ECU_ADDRESS 0xc00004ce BIT_MASK 0x80 /end MEASUREMENT
/begin MEASUREMENT Sbx_dyn_sens_mat_h "" UBYTE _CNV_A_R_A_165_CM 1 0. 0. 255. DISPLAY_IDENTIFIER fm_sta_eprm_sens_mat_h.fm_static_eprm_bitfield.Sbx_dyn_xxx ECU_ADDRESS 0xc00004ea BIT_MASK 0x8 /end MEASUREMENT
/begin MEASUREMENT Sbx_rdn_sens_mat_h "" UBYTE _CNV_A_R_A_165_CM 1 0. 0. 255. DISPLAY_IDENTIFIER fm_sta_eprm_sens_mat_h.fm_static_eprm_bitfield.Sbx_rdn_xxx ECU_ADDRESS 0xc00004ea BIT_MASK 0x10 /end MEASUREMENT
/begin MEASUREMENT Sbx_mf_sens_mat_h "" UBYTE _CNV_A_R_A_165_CM 1 0. 0. 255. DISPLAY_IDENTIFIER fm_sta_eprm_sens_mat_h.fm_static_eprm_bitfield.Sbx_mf_xxx ECU_ADDRESS 0xc00004ea BIT_MASK 0x20 /end MEASUREMENT
/begin MEASUREMENT Sbx_cf_sens_mat_h "" UBYTE _CNV_A_R_A_165_CM 1 0. 0. 255. DISPLAY_IDENTIFIER fm_sta_eprm_sens_mat_h.fm_static_eprm_bitfield.Sbx_cf_xxx ECU_ADDRESS 0xc00004ea BIT_MASK 0x80 /end MEASUREMENT
/begin MEASUREMENT Sbx_dyn_sens_mat_l "" UBYTE _CNV_A_R_A_165_CM 1 0. 0. 255. DISPLAY_IDENTIFIER fm_sta_eprm_sens_mat_l.fm_static_eprm_bitfield.Sbx_dyn_xxx ECU_ADDRESS 0xc00004ec BIT_MASK 0x8 /end MEASUREMENT
/begin MEASUREMENT Sbx_rdn_sens_mat_l "" UBYTE _CNV_A_R_A_165_CM 1 0. 0. 255. DISPLAY_IDENTIFIER fm_sta_eprm_sens_mat_l.fm_static_eprm_bitfield.Sbx_rdn_xxx ECU_ADDRESS 0xc00004ec BIT_MASK 0x10 /end MEASUREMENT
/begin MEASUREMENT Sbx_mf_sens_mat_l "" UBYTE _CNV_A_R_A_165_CM 1 0. 0. 255. DISPLAY_IDENTIFIER fm_sta_eprm_sens_mat_l.fm_static_eprm_bitfield.Sbx_mf_xxx ECU_ADDRESS 0xc00004ec BIT_MASK 0x20 /end MEASUREMENT
/begin MEASUREMENT Sbx_cf_sens_mat_l "" UBYTE _CNV_A_R_A_165_CM 1 0. 0. 255. DISPLAY_IDENTIFIER fm_sta_eprm_sens_mat_l.fm_static_eprm_bitfield.Sbx_cf_xxx ECU_ADDRESS 0xc00004ec BIT_MASK 0x80 /end MEASUREMENT
/begin MEASUREMENT Sbx_dyn_sens_spg_h "" UBYTE _CNV_A_R_A_165_CM 1 0. 0. 255. DISPLAY_IDENTIFIER fm_sta_eprm_sens_spg_h.fm_static_eprm_bitfield.Sbx_dyn_xxx ECU_ADDRESS 0xc00004d0 BIT_MASK 0x8 /end MEASUREMENT
/begin MEASUREMENT Sbx_rdn_sens_spg_h "" UBYTE _CNV_A_R_A_165_CM 1 0. 0. 255. DISPLAY_IDENTIFIER fm_sta_eprm_sens_spg_h.fm_static_eprm_bitfield.Sbx_rdn_xxx ECU_ADDRESS 0xc00004d0 BIT_MASK 0x10 /end MEASUREMENT
/begin MEASUREMENT Sbx_mf_sens_spg_h "" UBYTE _CNV_A_R_A_165_CM 1 0. 0. 255. DISPLAY_IDENTIFIER fm_sta_eprm_sens_spg_h.fm_static_eprm_bitfield.Sbx_mf_xxx ECU_ADDRESS 0xc00004d0 BIT_MASK 0x20 /end MEASUREMENT
/begin MEASUREMENT Sbx_cf_sens_spg_h "" UBYTE _CNV_A_R_A_165_CM 1 0. 0. 255. DISPLAY_IDENTIFIER fm_sta_eprm_sens_spg_h.fm_static_eprm_bitfield.Sbx_cf_xxx ECU_ADDRESS 0xc00004d0 BIT_MASK 0x80 /end MEASUREMENT
/begin MEASUREMENT Sbx_dyn_sens_spg_l "" UBYTE _CNV_A_R_A_165_CM 1 0. 0. 255. DISPLAY_IDENTIFIER fm_sta_eprm_sens_spg_l.fm_static_eprm_bitfield.Sbx_dyn_xxx ECU_ADDRESS 0xc00004d2 BIT_MASK 0x8 /end MEASUREMENT
/begin MEASUREMENT Sbx_rdn_sens_spg_l "" UBYTE _CNV_A_R_A_165_CM 1 0. 0. 255. DISPLAY_IDENTIFIER fm_sta_eprm_sens_spg_l.fm_static_eprm_bitfield.Sbx_rdn_xxx ECU_ADDRESS 0xc00004d2 BIT_MASK 0x10 /end MEASUREMENT
/begin MEASUREMENT Sbx_mf_sens_spg_l "" UBYTE _CNV_A_R_A_165_CM 1 0. 0. 255. DISPLAY_IDENTIFIER fm_sta_eprm_sens_spg_l.fm_static_eprm_bitfield.Sbx_mf_xxx ECU_ADDRESS 0xc00004d2 BIT_MASK 0x20 /end MEASUREMENT
/begin MEASUREMENT Sbx_cf_sens_spg_l "" UBYTE _CNV_A_R_A_165_CM 1 0. 0. 255. DISPLAY_IDENTIFIER fm_sta_eprm_sens_spg_l.fm_static_eprm_bitfield.Sbx_cf_xxx ECU_ADDRESS 0xc00004d2 BIT_MASK 0x80 /end MEASUREMENT
/begin MEASUREMENT Sbx_dyn_sens_tco_h "" UBYTE _CNV_A_R_A_165_CM 1 0. 0. 255. DISPLAY_IDENTIFIER fm_sta_eprm_sens_tco_h.fm_static_eprm_bitfield.Sbx_dyn_xxx ECU_ADDRESS 0xc00004d4 BIT_MASK 0x8 /end MEASUREMENT
/begin MEASUREMENT Sbx_rdn_sens_tco_h "" UBYTE _CNV_A_R_A_165_CM 1 0. 0. 255. DISPLAY_IDENTIFIER fm_sta_eprm_sens_tco_h.fm_static_eprm_bitfield.Sbx_rdn_xxx ECU_ADDRESS 0xc00004d4 BIT_MASK 0x10 /end MEASUREMENT
/begin MEASUREMENT Sbx_mf_sens_tco_h "" UBYTE _CNV_A_R_A_165_CM 1 0. 0. 255. DISPLAY_IDENTIFIER fm_sta_eprm_sens_tco_h.fm_static_eprm_bitfield.Sbx_mf_xxx ECU_ADDRESS 0xc00004d4 BIT_MASK 0x20 /end MEASUREMENT
/begin MEASUREMENT Sbx_cf_sens_tco_h "" UBYTE _CNV_A_R_A_165_CM 1 0. 0. 255. DISPLAY_IDENTIFIER fm_sta_eprm_sens_tco_h.fm_static_eprm_bitfield.Sbx_cf_xxx ECU_ADDRESS 0xc00004d4 BIT_MASK 0x80 /end MEASUREMENT
/begin MEASUREMENT Sbx_dyn_sens_tco_l "" UBYTE _CNV_A_R_A_165_CM 1 0. 0. 255. DISPLAY_IDENTIFIER fm_sta_eprm_sens_tco_l.fm_static_eprm_bitfield.Sbx_dyn_xxx ECU_ADDRESS 0xc00004d6 BIT_MASK 0x8 /end MEASUREMENT
/begin MEASUREMENT Sbx_rdn_sens_tco_l "" UBYTE _CNV_A_R_A_165_CM 1 0. 0. 255. DISPLAY_IDENTIFIER fm_sta_eprm_sens_tco_l.fm_static_eprm_bitfield.Sbx_rdn_xxx ECU_ADDRESS 0xc00004d6 BIT_MASK 0x10 /end MEASUREMENT
/begin MEASUREMENT Sbx_mf_sens_tco_l "" UBYTE _CNV_A_R_A_165_CM 1 0. 0. 255. DISPLAY_IDENTIFIER fm_sta_eprm_sens_tco_l.fm_static_eprm_bitfield.Sbx_mf_xxx ECU_ADDRESS 0xc00004d6 BIT_MASK 0x20 /end MEASUREMENT
/begin MEASUREMENT Sbx_cf_sens_tco_l "" UBYTE _CNV_A_R_A_165_CM 1 0. 0. 255. DISPLAY_IDENTIFIER fm_sta_eprm_sens_tco_l.fm_static_eprm_bitfield.Sbx_cf_xxx ECU_ADDRESS 0xc00004d6 BIT_MASK 0x80 /end MEASUREMENT
/begin MEASUREMENT Sbx_dyn_sens_tco_sig_mcut "" UBYTE _CNV_A_R_A_165_CM 1 0. 0. 255. DISPLAY_IDENTIFIER fm_sta_eprm_sens_tco_sig_mcut.fm_static_eprm_bitfield.Sbx_dyn_xxx ECU_ADDRESS 0xc0000592 BIT_MASK 0x8 /end MEASUREMENT
/begin MEASUREMENT Sbx_rdn_sens_tco_sig_mcut "" UBYTE _CNV_A_R_A_165_CM 1 0. 0. 255. DISPLAY_IDENTIFIER fm_sta_eprm_sens_tco_sig_mcut.fm_static_eprm_bitfield.Sbx_rdn_xxx ECU_ADDRESS 0xc0000592 BIT_MASK 0x10 /end MEASUREMENT
/begin MEASUREMENT Sbx_mf_sens_tco_sig_mcut "" UBYTE _CNV_A_R_A_165_CM 1 0. 0. 255. DISPLAY_IDENTIFIER fm_sta_eprm_sens_tco_sig_mcut.fm_static_eprm_bitfield.Sbx_mf_xxx ECU_ADDRESS 0xc0000592 BIT_MASK 0x20 /end MEASUREMENT
/begin MEASUREMENT Sbx_cf_sens_tco_sig_mcut "" UBYTE _CNV_A_R_A_165_CM 1 0. 0. 255. DISPLAY_IDENTIFIER fm_sta_eprm_sens_tco_sig_mcut.fm_static_eprm_bitfield.Sbx_cf_xxx ECU_ADDRESS 0xc0000592 BIT_MASK 0x80 /end MEASUREMENT
/begin MEASUREMENT Sbx_dyn_sfty_tq_chr "" UBYTE _CNV_A_R_A_165_CM 1 0. 0. 255. DISPLAY_IDENTIFIER fm_sta_eprm_sfty_tq_chr.fm_static_eprm_bitfield.Sbx_dyn_xxx ECU_ADDRESS 0xc000056a BIT_MASK 0x8 /end MEASUREMENT
/begin MEASUREMENT Sbx_rdn_sfty_tq_chr "" UBYTE _CNV_A_R_A_165_CM 1 0. 0. 255. DISPLAY_IDENTIFIER fm_sta_eprm_sfty_tq_chr.fm_static_eprm_bitfield.Sbx_rdn_xxx ECU_ADDRESS 0xc000056a BIT_MASK 0x10 /end MEASUREMENT
/begin MEASUREMENT Sbx_mf_sfty_tq_chr "" UBYTE _CNV_A_R_A_165_CM 1 0. 0. 255. DISPLAY_IDENTIFIER fm_sta_eprm_sfty_tq_chr.fm_static_eprm_bitfield.Sbx_mf_xxx ECU_ADDRESS 0xc000056a BIT_MASK 0x20 /end MEASUREMENT
/begin MEASUREMENT Sbx_cf_sfty_tq_chr "" UBYTE _CNV_A_R_A_165_CM 1 0. 0. 255. DISPLAY_IDENTIFIER fm_sta_eprm_sfty_tq_chr.fm_static_eprm_bitfield.Sbx_cf_xxx ECU_ADDRESS 0xc000056a BIT_MASK 0x80 /end MEASUREMENT
/begin MEASUREMENT Sbx_dyn_sfty_tq_clc_chr "" UBYTE _CNV_A_R_A_165_CM 1 0. 0. 255. DISPLAY_IDENTIFIER fm_sta_eprm_sfty_tq_clc_chr.fm_static_eprm_bitfield.Sbx_dyn_xxx ECU_ADDRESS 0xc000056c BIT_MASK 0x8 /end MEASUREMENT
/begin MEASUREMENT Sbx_rdn_sfty_tq_clc_chr "" UBYTE _CNV_A_R_A_165_CM 1 0. 0. 255. DISPLAY_IDENTIFIER fm_sta_eprm_sfty_tq_clc_chr.fm_static_eprm_bitfield.Sbx_rdn_xxx ECU_ADDRESS 0xc000056c BIT_MASK 0x10 /end MEASUREMENT
/begin MEASUREMENT Sbx_mf_sfty_tq_clc_chr "" UBYTE _CNV_A_R_A_165_CM 1 0. 0. 255. DISPLAY_IDENTIFIER fm_sta_eprm_sfty_tq_clc_chr.fm_static_eprm_bitfield.Sbx_mf_xxx ECU_ADDRESS 0xc000056c BIT_MASK 0x20 /end MEASUREMENT
/begin MEASUREMENT Sbx_cf_sfty_tq_clc_chr "" UBYTE _CNV_A_R_A_165_CM 1 0. 0. 255. DISPLAY_IDENTIFIER fm_sta_eprm_sfty_tq_clc_chr.fm_static_eprm_bitfield.Sbx_cf_xxx ECU_ADDRESS 0xc000056c BIT_MASK 0x80 /end MEASUREMENT
/begin MEASUREMENT Sbx_dyn_sfty_tq_lih_chr "" UBYTE _CNV_A_R_A_165_CM 1 0. 0. 255. DISPLAY_IDENTIFIER fm_sta_eprm_sfty_tq_lih_chr.fm_static_eprm_bitfield.Sbx_dyn_xxx ECU_ADDRESS 0xc000056e BIT_MASK 0x8 /end MEASUREMENT
/begin MEASUREMENT Sbx_rdn_sfty_tq_lih_chr "" UBYTE _CNV_A_R_A_165_CM 1 0. 0. 255. DISPLAY_IDENTIFIER fm_sta_eprm_sfty_tq_lih_chr.fm_static_eprm_bitfield.Sbx_rdn_xxx ECU_ADDRESS 0xc000056e BIT_MASK 0x10 /end MEASUREMENT
/begin MEASUREMENT Sbx_mf_sfty_tq_lih_chr "" UBYTE _CNV_A_R_A_165_CM 1 0. 0. 255. DISPLAY_IDENTIFIER fm_sta_eprm_sfty_tq_lih_chr.fm_static_eprm_bitfield.Sbx_mf_xxx ECU_ADDRESS 0xc000056e BIT_MASK 0x20 /end MEASUREMENT
/begin MEASUREMENT Sbx_cf_sfty_tq_lih_chr "" UBYTE _CNV_A_R_A_165_CM 1 0. 0. 255. DISPLAY_IDENTIFIER fm_sta_eprm_sfty_tq_lih_chr.fm_static_eprm_bitfield.Sbx_cf_xxx ECU_ADDRESS 0xc000056e BIT_MASK 0x80 /end MEASUREMENT
/begin MEASUREMENT Sbx_dyn_spg_chr "" UBYTE _CNV_A_R_A_165_CM 1 0. 0. 255. DISPLAY_IDENTIFIER fm_sta_eprm_spg_chr.fm_static_eprm_bitfield.Sbx_dyn_xxx ECU_ADDRESS 0xc000054a BIT_MASK 0x8 /end MEASUREMENT
/begin MEASUREMENT Sbx_rdn_spg_chr "" UBYTE _CNV_A_R_A_165_CM 1 0. 0. 255. DISPLAY_IDENTIFIER fm_sta_eprm_spg_chr.fm_static_eprm_bitfield.Sbx_rdn_xxx ECU_ADDRESS 0xc000054a BIT_MASK 0x10 /end MEASUREMENT
/begin MEASUREMENT Sbx_mf_spg_chr "" UBYTE _CNV_A_R_A_165_CM 1 0. 0. 255. DISPLAY_IDENTIFIER fm_sta_eprm_spg_chr.fm_static_eprm_bitfield.Sbx_mf_xxx ECU_ADDRESS 0xc000054a BIT_MASK 0x20 /end MEASUREMENT
/begin MEASUREMENT Sbx_cf_spg_chr "" UBYTE _CNV_A_R_A_165_CM 1 0. 0. 255. DISPLAY_IDENTIFIER fm_sta_eprm_spg_chr.fm_static_eprm_bitfield.Sbx_cf_xxx ECU_ADDRESS 0xc000054a BIT_MASK 0x80 /end MEASUREMENT
/begin MEASUREMENT Sbx_dyn_spg_oor "" UBYTE _CNV_A_R_A_165_CM 1 0. 0. 255. DISPLAY_IDENTIFIER fm_sta_eprm_spg_oor.fm_static_eprm_bitfield.Sbx_dyn_xxx ECU_ADDRESS 0xc000054c BIT_MASK 0x8 /end MEASUREMENT
/begin MEASUREMENT Sbx_rdn_spg_oor "" UBYTE _CNV_A_R_A_165_CM 1 0. 0. 255. DISPLAY_IDENTIFIER fm_sta_eprm_spg_oor.fm_static_eprm_bitfield.Sbx_rdn_xxx ECU_ADDRESS 0xc000054c BIT_MASK 0x10 /end MEASUREMENT
/begin MEASUREMENT Sbx_mf_spg_oor "" UBYTE _CNV_A_R_A_165_CM 1 0. 0. 255. DISPLAY_IDENTIFIER fm_sta_eprm_spg_oor.fm_static_eprm_bitfield.Sbx_mf_xxx ECU_ADDRESS 0xc000054c BIT_MASK 0x20 /end MEASUREMENT
/begin MEASUREMENT Sbx_cf_spg_oor "" UBYTE _CNV_A_R_A_165_CM 1 0. 0. 255. DISPLAY_IDENTIFIER fm_sta_eprm_spg_oor.fm_static_eprm_bitfield.Sbx_cf_xxx ECU_ADDRESS 0xc000054c BIT_MASK 0x80 /end MEASUREMENT
/begin MEASUREMENT Sbx_dyn_spg_reg_apl_down "" UBYTE _CNV_A_R_A_165_CM 1 0. 0. 255. DISPLAY_IDENTIFIER fm_sta_eprm_spg_reg_apl_down.fm_static_eprm_bitfield.Sbx_dyn_xxx ECU_ADDRESS 0xc00004d8 BIT_MASK 0x8 /end MEASUREMENT
/begin MEASUREMENT Sbx_rdn_spg_reg_apl_down "" UBYTE _CNV_A_R_A_165_CM 1 0. 0. 255. DISPLAY_IDENTIFIER fm_sta_eprm_spg_reg_apl_down.fm_static_eprm_bitfield.Sbx_rdn_xxx ECU_ADDRESS 0xc00004d8 BIT_MASK 0x10 /end MEASUREMENT
/begin MEASUREMENT Sbx_mf_spg_reg_apl_down "" UBYTE _CNV_A_R_A_165_CM 1 0. 0. 255. DISPLAY_IDENTIFIER fm_sta_eprm_spg_reg_apl_down.fm_static_eprm_bitfield.Sbx_mf_xxx ECU_ADDRESS 0xc00004d8 BIT_MASK 0x20 /end MEASUREMENT
/begin MEASUREMENT Sbx_cf_spg_reg_apl_down "" UBYTE _CNV_A_R_A_165_CM 1 0. 0. 255. DISPLAY_IDENTIFIER fm_sta_eprm_spg_reg_apl_down.fm_static_eprm_bitfield.Sbx_cf_xxx ECU_ADDRESS 0xc00004d8 BIT_MASK 0x80 /end MEASUREMENT
/begin MEASUREMENT Sbx_dyn_spg_reg_apl_up "" UBYTE _CNV_A_R_A_165_CM 1 0. 0. 255. DISPLAY_IDENTIFIER fm_sta_eprm_spg_reg_apl_up.fm_static_eprm_bitfield.Sbx_dyn_xxx ECU_ADDRESS 0xc00004da BIT_MASK 0x8 /end MEASUREMENT
/begin MEASUREMENT Sbx_rdn_spg_reg_apl_up "" UBYTE _CNV_A_R_A_165_CM 1 0. 0. 255. DISPLAY_IDENTIFIER fm_sta_eprm_spg_reg_apl_up.fm_static_eprm_bitfield.Sbx_rdn_xxx ECU_ADDRESS 0xc00004da BIT_MASK 0x10 /end MEASUREMENT
/begin MEASUREMENT Sbx_mf_spg_reg_apl_up "" UBYTE _CNV_A_R_A_165_CM 1 0. 0. 255. DISPLAY_IDENTIFIER fm_sta_eprm_spg_reg_apl_up.fm_static_eprm_bitfield.Sbx_mf_xxx ECU_ADDRESS 0xc00004da BIT_MASK 0x20 /end MEASUREMENT
/begin MEASUREMENT Sbx_cf_spg_reg_apl_up "" UBYTE _CNV_A_R_A_165_CM 1 0. 0. 255. DISPLAY_IDENTIFIER fm_sta_eprm_spg_reg_apl_up.fm_static_eprm_bitfield.Sbx_cf_xxx ECU_ADDRESS 0xc00004da BIT_MASK 0x80 /end MEASUREMENT
/begin MEASUREMENT Sbx_dyn_tlz_ad_b_cpt "" UBYTE _CNV_A_R_A_165_CM 1 0. 0. 255. DISPLAY_IDENTIFIER fm_sta_eprm_tlz_ad_b_cpt.fm_static_eprm_bitfield.Sbx_dyn_xxx ECU_ADDRESS 0xc000054e BIT_MASK 0x8 /end MEASUREMENT
/begin MEASUREMENT Sbx_rdn_tlz_ad_b_cpt "" UBYTE _CNV_A_R_A_165_CM 1 0. 0. 255. DISPLAY_IDENTIFIER fm_sta_eprm_tlz_ad_b_cpt.fm_static_eprm_bitfield.Sbx_rdn_xxx ECU_ADDRESS 0xc000054e BIT_MASK 0x10 /end MEASUREMENT
/begin MEASUREMENT Sbx_mf_tlz_ad_b_cpt "" UBYTE _CNV_A_R_A_165_CM 1 0. 0. 255. DISPLAY_IDENTIFIER fm_sta_eprm_tlz_ad_b_cpt.fm_static_eprm_bitfield.Sbx_mf_xxx ECU_ADDRESS 0xc000054e BIT_MASK 0x20 /end MEASUREMENT
/begin MEASUREMENT Sbx_cf_tlz_ad_b_cpt "" UBYTE _CNV_A_R_A_165_CM 1 0. 0. 255. DISPLAY_IDENTIFIER fm_sta_eprm_tlz_ad_b_cpt.fm_static_eprm_bitfield.Sbx_cf_xxx ECU_ADDRESS 0xc000054e BIT_MASK 0x80 /end MEASUREMENT
/begin MEASUREMENT Sbx_dyn_vb_clc_chr "" UBYTE _CNV_A_R_A_165_CM 1 0. 0. 255. DISPLAY_IDENTIFIER fm_sta_eprm_vb_clc_chr.fm_static_eprm_bitfield.Sbx_dyn_xxx ECU_ADDRESS 0xc00005b2 BIT_MASK 0x8 /end MEASUREMENT
/begin MEASUREMENT Sbx_rdn_vb_clc_chr "" UBYTE _CNV_A_R_A_165_CM 1 0. 0. 255. DISPLAY_IDENTIFIER fm_sta_eprm_vb_clc_chr.fm_static_eprm_bitfield.Sbx_rdn_xxx ECU_ADDRESS 0xc00005b2 BIT_MASK 0x10 /end MEASUREMENT
/begin MEASUREMENT Sbx_mf_vb_clc_chr "" UBYTE _CNV_A_R_A_165_CM 1 0. 0. 255. DISPLAY_IDENTIFIER fm_sta_eprm_vb_clc_chr.fm_static_eprm_bitfield.Sbx_mf_xxx ECU_ADDRESS 0xc00005b2 BIT_MASK 0x20 /end MEASUREMENT
/begin MEASUREMENT Sbx_cf_vb_clc_chr "" UBYTE _CNV_A_R_A_165_CM 1 0. 0. 255. DISPLAY_IDENTIFIER fm_sta_eprm_vb_clc_chr.fm_static_eprm_bitfield.Sbx_cf_xxx ECU_ADDRESS 0xc00005b2 BIT_MASK 0x80 /end MEASUREMENT
/begin MEASUREMENT Sbx_dyn_vb_h "" UBYTE _CNV_A_R_A_165_CM 1 0. 0. 255. DISPLAY_IDENTIFIER fm_sta_eprm_vb_h.fm_static_eprm_bitfield.Sbx_dyn_xxx ECU_ADDRESS 0xc00004dc BIT_MASK 0x8 /end MEASUREMENT
/begin MEASUREMENT Sbx_rdn_vb_h "" UBYTE _CNV_A_R_A_165_CM 1 0. 0. 255. DISPLAY_IDENTIFIER fm_sta_eprm_vb_h.fm_static_eprm_bitfield.Sbx_rdn_xxx ECU_ADDRESS 0xc00004dc BIT_MASK 0x10 /end MEASUREMENT
/begin MEASUREMENT Sbx_mf_vb_h "" UBYTE _CNV_A_R_A_165_CM 1 0. 0. 255. DISPLAY_IDENTIFIER fm_sta_eprm_vb_h.fm_static_eprm_bitfield.Sbx_mf_xxx ECU_ADDRESS 0xc00004dc BIT_MASK 0x20 /end MEASUREMENT
/begin MEASUREMENT Sbx_cf_vb_h "" UBYTE _CNV_A_R_A_165_CM 1 0. 0. 255. DISPLAY_IDENTIFIER fm_sta_eprm_vb_h.fm_static_eprm_bitfield.Sbx_cf_xxx ECU_ADDRESS 0xc00004dc BIT_MASK 0x80 /end MEASUREMENT
/begin MEASUREMENT Sbx_dyn_vb_l "" UBYTE _CNV_A_R_A_165_CM 1 0. 0. 255. DISPLAY_IDENTIFIER fm_sta_eprm_vb_l.fm_static_eprm_bitfield.Sbx_dyn_xxx ECU_ADDRESS 0xc00004de BIT_MASK 0x8 /end MEASUREMENT
/begin MEASUREMENT Sbx_rdn_vb_l "" UBYTE _CNV_A_R_A_165_CM 1 0. 0. 255. DISPLAY_IDENTIFIER fm_sta_eprm_vb_l.fm_static_eprm_bitfield.Sbx_rdn_xxx ECU_ADDRESS 0xc00004de BIT_MASK 0x10 /end MEASUREMENT
/begin MEASUREMENT Sbx_mf_vb_l "" UBYTE _CNV_A_R_A_165_CM 1 0. 0. 255. DISPLAY_IDENTIFIER fm_sta_eprm_vb_l.fm_static_eprm_bitfield.Sbx_mf_xxx ECU_ADDRESS 0xc00004de BIT_MASK 0x20 /end MEASUREMENT
/begin MEASUREMENT Sbx_cf_vb_l "" UBYTE _CNV_A_R_A_165_CM 1 0. 0. 255. DISPLAY_IDENTIFIER fm_sta_eprm_vb_l.fm_static_eprm_bitfield.Sbx_cf_xxx ECU_ADDRESS 0xc00004de BIT_MASK 0x80 /end MEASUREMENT
/begin MEASUREMENT Sbx_dyn_vb_rly_oc_scg "" UBYTE _CNV_A_R_A_165_CM 1 0. 0. 255. DISPLAY_IDENTIFIER fm_sta_eprm_vb_rly_oc_scg.fm_static_eprm_bitfield.Sbx_dyn_xxx ECU_ADDRESS 0xc00004e0 BIT_MASK 0x8 /end MEASUREMENT
/begin MEASUREMENT Sbx_rdn_vb_rly_oc_scg "" UBYTE _CNV_A_R_A_165_CM 1 0. 0. 255. DISPLAY_IDENTIFIER fm_sta_eprm_vb_rly_oc_scg.fm_static_eprm_bitfield.Sbx_rdn_xxx ECU_ADDRESS 0xc00004e0 BIT_MASK 0x10 /end MEASUREMENT
/begin MEASUREMENT Sbx_mf_vb_rly_oc_scg "" UBYTE _CNV_A_R_A_165_CM 1 0. 0. 255. DISPLAY_IDENTIFIER fm_sta_eprm_vb_rly_oc_scg.fm_static_eprm_bitfield.Sbx_mf_xxx ECU_ADDRESS 0xc00004e0 BIT_MASK 0x20 /end MEASUREMENT
/begin MEASUREMENT Sbx_cf_vb_rly_oc_scg "" UBYTE _CNV_A_R_A_165_CM 1 0. 0. 255. DISPLAY_IDENTIFIER fm_sta_eprm_vb_rly_oc_scg.fm_static_eprm_bitfield.Sbx_cf_xxx ECU_ADDRESS 0xc00004e0 BIT_MASK 0x80 /end MEASUREMENT
/begin MEASUREMENT Sbx_dyn_vb_rly_scw "" UBYTE _CNV_A_R_A_165_CM 1 0. 0. 255. DISPLAY_IDENTIFIER fm_sta_eprm_vb_rly_scw.fm_static_eprm_bitfield.Sbx_dyn_xxx ECU_ADDRESS 0xc00004e2 BIT_MASK 0x8 /end MEASUREMENT
/begin MEASUREMENT Sbx_rdn_vb_rly_scw "" UBYTE _CNV_A_R_A_165_CM 1 0. 0. 255. DISPLAY_IDENTIFIER fm_sta_eprm_vb_rly_scw.fm_static_eprm_bitfield.Sbx_rdn_xxx ECU_ADDRESS 0xc00004e2 BIT_MASK 0x10 /end MEASUREMENT
/begin MEASUREMENT Sbx_mf_vb_rly_scw "" UBYTE _CNV_A_R_A_165_CM 1 0. 0. 255. DISPLAY_IDENTIFIER fm_sta_eprm_vb_rly_scw.fm_static_eprm_bitfield.Sbx_mf_xxx ECU_ADDRESS 0xc00004e2 BIT_MASK 0x20 /end MEASUREMENT
/begin MEASUREMENT Sbx_cf_vb_rly_scw "" UBYTE _CNV_A_R_A_165_CM 1 0. 0. 255. DISPLAY_IDENTIFIER fm_sta_eprm_vb_rly_scw.fm_static_eprm_bitfield.Sbx_cf_xxx ECU_ADDRESS 0xc00004e2 BIT_MASK 0x80 /end MEASUREMENT
/begin MEASUREMENT Sbx_dyn_wgc_oc "" UBYTE _CNV_A_R_A_165_CM 1 0. 0. 255. DISPLAY_IDENTIFIER fm_sta_eprm_wgc_oc.fm_static_eprm_bitfield.Sbx_dyn_xxx ECU_ADDRESS 0xc0000550 BIT_MASK 0x8 /end MEASUREMENT
/begin MEASUREMENT Sbx_rdn_wgc_oc "" UBYTE _CNV_A_R_A_165_CM 1 0. 0. 255. DISPLAY_IDENTIFIER fm_sta_eprm_wgc_oc.fm_static_eprm_bitfield.Sbx_rdn_xxx ECU_ADDRESS 0xc0000550 BIT_MASK 0x10 /end MEASUREMENT
/begin MEASUREMENT Sbx_mf_wgc_oc "" UBYTE _CNV_A_R_A_165_CM 1 0. 0. 255. DISPLAY_IDENTIFIER fm_sta_eprm_wgc_oc.fm_static_eprm_bitfield.Sbx_mf_xxx ECU_ADDRESS 0xc0000550 BIT_MASK 0x20 /end MEASUREMENT
/begin MEASUREMENT Sbx_cf_wgc_oc "" UBYTE _CNV_A_R_A_165_CM 1 0. 0. 255. DISPLAY_IDENTIFIER fm_sta_eprm_wgc_oc.fm_static_eprm_bitfield.Sbx_cf_xxx ECU_ADDRESS 0xc0000550 BIT_MASK 0x80 /end MEASUREMENT
/begin MEASUREMENT Sbx_dyn_wgc_scg "" UBYTE _CNV_A_R_A_165_CM 1 0. 0. 255. DISPLAY_IDENTIFIER fm_sta_eprm_wgc_scg.fm_static_eprm_bitfield.Sbx_dyn_xxx ECU_ADDRESS 0xc0000552 BIT_MASK 0x8 /end MEASUREMENT
/begin MEASUREMENT Sbx_rdn_wgc_scg "" UBYTE _CNV_A_R_A_165_CM 1 0. 0. 255. DISPLAY_IDENTIFIER fm_sta_eprm_wgc_scg.fm_static_eprm_bitfield.Sbx_rdn_xxx ECU_ADDRESS 0xc0000552 BIT_MASK 0x10 /end MEASUREMENT
/begin MEASUREMENT Sbx_mf_wgc_scg "" UBYTE _CNV_A_R_A_165_CM 1 0. 0. 255. DISPLAY_IDENTIFIER fm_sta_eprm_wgc_scg.fm_static_eprm_bitfield.Sbx_mf_xxx ECU_ADDRESS 0xc0000552 BIT_MASK 0x20 /end MEASUREMENT
/begin MEASUREMENT Sbx_cf_wgc_scg "" UBYTE _CNV_A_R_A_165_CM 1 0. 0. 255. DISPLAY_IDENTIFIER fm_sta_eprm_wgc_scg.fm_static_eprm_bitfield.Sbx_cf_xxx ECU_ADDRESS 0xc0000552 BIT_MASK 0x80 /end MEASUREMENT
/begin MEASUREMENT Sbx_dyn_wgc_scw "" UBYTE _CNV_A_R_A_165_CM 1 0. 0. 255. DISPLAY_IDENTIFIER fm_sta_eprm_wgc_scw.fm_static_eprm_bitfield.Sbx_dyn_xxx ECU_ADDRESS 0xc0000554 BIT_MASK 0x8 /end MEASUREMENT
/begin MEASUREMENT Sbx_rdn_wgc_scw "" UBYTE _CNV_A_R_A_165_CM 1 0. 0. 255. DISPLAY_IDENTIFIER fm_sta_eprm_wgc_scw.fm_static_eprm_bitfield.Sbx_rdn_xxx ECU_ADDRESS 0xc0000554 BIT_MASK 0x10 /end MEASUREMENT
/begin MEASUREMENT Sbx_mf_wgc_scw "" UBYTE _CNV_A_R_A_165_CM 1 0. 0. 255. DISPLAY_IDENTIFIER fm_sta_eprm_wgc_scw.fm_static_eprm_bitfield.Sbx_mf_xxx ECU_ADDRESS 0xc0000554 BIT_MASK 0x20 /end MEASUREMENT
/begin MEASUREMENT Sbx_cf_wgc_scw "" UBYTE _CNV_A_R_A_165_CM 1 0. 0. 255. DISPLAY_IDENTIFIER fm_sta_eprm_wgc_scw.fm_static_eprm_bitfield.Sbx_cf_xxx ECU_ADDRESS 0xc0000554 BIT_MASK 0x80 /end MEASUREMENT
/begin MEASUREMENT Sbx_dyn_wpmp_tcr_blk "" UBYTE _CNV_A_R_A_165_CM 1 0. 0. 255. DISPLAY_IDENTIFIER fm_sta_eprm_wpmp_tcr_blk.fm_static_eprm_bitfield.Sbx_dyn_xxx ECU_ADDRESS 0xc000059c BIT_MASK 0x8 /end MEASUREMENT
/begin MEASUREMENT Sbx_rdn_wpmp_tcr_blk "" UBYTE _CNV_A_R_A_165_CM 1 0. 0. 255. DISPLAY_IDENTIFIER fm_sta_eprm_wpmp_tcr_blk.fm_static_eprm_bitfield.Sbx_rdn_xxx ECU_ADDRESS 0xc000059c BIT_MASK 0x10 /end MEASUREMENT
/begin MEASUREMENT Sbx_mf_wpmp_tcr_blk "" UBYTE _CNV_A_R_A_165_CM 1 0. 0. 255. DISPLAY_IDENTIFIER fm_sta_eprm_wpmp_tcr_blk.fm_static_eprm_bitfield.Sbx_mf_xxx ECU_ADDRESS 0xc000059c BIT_MASK 0x20 /end MEASUREMENT
/begin MEASUREMENT Sbx_cf_wpmp_tcr_blk "" UBYTE _CNV_A_R_A_165_CM 1 0. 0. 255. DISPLAY_IDENTIFIER fm_sta_eprm_wpmp_tcr_blk.fm_static_eprm_bitfield.Sbx_cf_xxx ECU_ADDRESS 0xc000059c BIT_MASK 0x80 /end MEASUREMENT
/begin MEASUREMENT Sbx_dyn_wpmp_tcr_oc "" UBYTE _CNV_A_R_A_165_CM 1 0. 0. 255. DISPLAY_IDENTIFIER fm_sta_eprm_wpmp_tcr_oc.fm_static_eprm_bitfield.Sbx_dyn_xxx ECU_ADDRESS 0xc0000556 BIT_MASK 0x8 /end MEASUREMENT
/begin MEASUREMENT Sbx_rdn_wpmp_tcr_oc "" UBYTE _CNV_A_R_A_165_CM 1 0. 0. 255. DISPLAY_IDENTIFIER fm_sta_eprm_wpmp_tcr_oc.fm_static_eprm_bitfield.Sbx_rdn_xxx ECU_ADDRESS 0xc0000556 BIT_MASK 0x10 /end MEASUREMENT
/begin MEASUREMENT Sbx_mf_wpmp_tcr_oc "" UBYTE _CNV_A_R_A_165_CM 1 0. 0. 255. DISPLAY_IDENTIFIER fm_sta_eprm_wpmp_tcr_oc.fm_static_eprm_bitfield.Sbx_mf_xxx ECU_ADDRESS 0xc0000556 BIT_MASK 0x20 /end MEASUREMENT
/begin MEASUREMENT Sbx_cf_wpmp_tcr_oc "" UBYTE _CNV_A_R_A_165_CM 1 0. 0. 255. DISPLAY_IDENTIFIER fm_sta_eprm_wpmp_tcr_oc.fm_static_eprm_bitfield.Sbx_cf_xxx ECU_ADDRESS 0xc0000556 BIT_MASK 0x80 /end MEASUREMENT
/begin MEASUREMENT Sbx_dyn_wpmp_tcr_scg "" UBYTE _CNV_A_R_A_165_CM 1 0. 0. 255. DISPLAY_IDENTIFIER fm_sta_eprm_wpmp_tcr_scg.fm_static_eprm_bitfield.Sbx_dyn_xxx ECU_ADDRESS 0xc0000558 BIT_MASK 0x8 /end MEASUREMENT
/begin MEASUREMENT Sbx_rdn_wpmp_tcr_scg "" UBYTE _CNV_A_R_A_165_CM 1 0. 0. 255. DISPLAY_IDENTIFIER fm_sta_eprm_wpmp_tcr_scg.fm_static_eprm_bitfield.Sbx_rdn_xxx ECU_ADDRESS 0xc0000558 BIT_MASK 0x10 /end MEASUREMENT
/begin MEASUREMENT Sbx_mf_wpmp_tcr_scg "" UBYTE _CNV_A_R_A_165_CM 1 0. 0. 255. DISPLAY_IDENTIFIER fm_sta_eprm_wpmp_tcr_scg.fm_static_eprm_bitfield.Sbx_mf_xxx ECU_ADDRESS 0xc0000558 BIT_MASK 0x20 /end MEASUREMENT
/begin MEASUREMENT Sbx_cf_wpmp_tcr_scg "" UBYTE _CNV_A_R_A_165_CM 1 0. 0. 255. DISPLAY_IDENTIFIER fm_sta_eprm_wpmp_tcr_scg.fm_static_eprm_bitfield.Sbx_cf_xxx ECU_ADDRESS 0xc0000558 BIT_MASK 0x80 /end MEASUREMENT
/begin MEASUREMENT Sbx_dyn_wpmp_tcr_scw "" UBYTE _CNV_A_R_A_165_CM 1 0. 0. 255. DISPLAY_IDENTIFIER fm_sta_eprm_wpmp_tcr_scw.fm_static_eprm_bitfield.Sbx_dyn_xxx ECU_ADDRESS 0xc000055a BIT_MASK 0x8 /end MEASUREMENT
/begin MEASUREMENT Sbx_rdn_wpmp_tcr_scw "" UBYTE _CNV_A_R_A_165_CM 1 0. 0. 255. DISPLAY_IDENTIFIER fm_sta_eprm_wpmp_tcr_scw.fm_static_eprm_bitfield.Sbx_rdn_xxx ECU_ADDRESS 0xc000055a BIT_MASK 0x10 /end MEASUREMENT
/begin MEASUREMENT Sbx_mf_wpmp_tcr_scw "" UBYTE _CNV_A_R_A_165_CM 1 0. 0. 255. DISPLAY_IDENTIFIER fm_sta_eprm_wpmp_tcr_scw.fm_static_eprm_bitfield.Sbx_mf_xxx ECU_ADDRESS 0xc000055a BIT_MASK 0x20 /end MEASUREMENT
/begin MEASUREMENT Sbx_cf_wpmp_tcr_scw "" UBYTE _CNV_A_R_A_165_CM 1 0. 0. 255. DISPLAY_IDENTIFIER fm_sta_eprm_wpmp_tcr_scw.fm_static_eprm_bitfield.Sbx_cf_xxx ECU_ADDRESS 0xc000055a BIT_MASK 0x80 /end MEASUREMENT
/begin MEASUREMENT Vxx_dfctr_esp_data_chr "" UWORD _CNV_A_R_A_165_CM 1 0. 0. 65535. DISPLAY_IDENTIFIER fm_sta_esp_data_chr.Vxx_dfctr_xxx ECU_ADDRESS 0xc0000070 /end MEASUREMENT
/begin MEASUREMENT Vxx_rdn_esp_data_chr "" UWORD _CNV_A_R_A_165_CM 1 0. 0. 65535. DISPLAY_IDENTIFIER fm_sta_esp_data_chr.Vxx_rdn_xxx ECU_ADDRESS 0xc0000072 /end MEASUREMENT
/begin MEASUREMENT Vbx_cf_esp_data_chr "" UBYTE _CNV_A_R_A_165_CM 1 0. 0. 255. DISPLAY_IDENTIFIER fm_sta_esp_data_chr.fm_static_bitfield.Vbx_cf_xxx ECU_ADDRESS 0xc0000074 BIT_MASK 0x1 /end MEASUREMENT
/begin MEASUREMENT Vbx_clf_esp_data_chr "" UBYTE _CNV_A_R_A_165_CM 1 0. 0. 255. DISPLAY_IDENTIFIER fm_sta_esp_data_chr.fm_static_bitfield.Vbx_clf_xxx ECU_ADDRESS 0xc0000074 BIT_MASK 0x2 /end MEASUREMENT
/begin MEASUREMENT Vbx_df_old_esp_data_chr "" UBYTE _CNV_A_R_A_165_CM 1 0. 0. 255. DISPLAY_IDENTIFIER fm_sta_esp_data_chr.fm_static_bitfield.Vbx_df_old_xxx ECU_ADDRESS 0xc0000074 BIT_MASK 0x4 /end MEASUREMENT
/begin MEASUREMENT Vbx_dfctr_sat_esp_data_chr "" UBYTE _CNV_A_R_A_165_CM 1 0. 0. 255. DISPLAY_IDENTIFIER fm_sta_esp_data_chr.fm_static_bitfield.Vbx_dfctr_sat_xxx ECU_ADDRESS 0xc0000074 BIT_MASK 0x8 /end MEASUREMENT
/begin MEASUREMENT Vbx_rdn_esp_data_chr "" UBYTE _CNV_A_R_A_165_CM 1 0. 0. 255. DISPLAY_IDENTIFIER fm_sta_esp_data_chr.fm_static_bitfield.Vbx_rdn_xxx ECU_ADDRESS 0xc0000074 BIT_MASK 0x40 /end MEASUREMENT
/begin MEASUREMENT Vxx_dtc_stt_esp_data_chr "" UBYTE _CNV_A_R_A_165_CM 1 0. 0. 255. DISPLAY_IDENTIFIER fm_sta_esp_data_chr.Vxx_dtc_stt_xxx ECU_ADDRESS 0xc0000075 /end MEASUREMENT
/begin MEASUREMENT Vxx_dfctr_esp_data_seq_ctr "" UWORD _CNV_A_R_A_165_CM 1 0. 0. 65535. DISPLAY_IDENTIFIER fm_sta_esp_data_seq_ctr.Vxx_dfctr_xxx ECU_ADDRESS 0xc0000076 /end MEASUREMENT
/begin MEASUREMENT Vxx_rdn_esp_data_seq_ctr "" UWORD _CNV_A_R_A_165_CM 1 0. 0. 65535. DISPLAY_IDENTIFIER fm_sta_esp_data_seq_ctr.Vxx_rdn_xxx ECU_ADDRESS 0xc0000078 /end MEASUREMENT
/begin MEASUREMENT Vbx_cf_esp_data_seq_ctr "" UBYTE _CNV_A_R_A_165_CM 1 0. 0. 255. DISPLAY_IDENTIFIER fm_sta_esp_data_seq_ctr.fm_static_bitfield.Vbx_cf_xxx ECU_ADDRESS 0xc000007a BIT_MASK 0x1 /end MEASUREMENT
/begin MEASUREMENT Vbx_clf_esp_data_seq_ctr "" UBYTE _CNV_A_R_A_165_CM 1 0. 0. 255. DISPLAY_IDENTIFIER fm_sta_esp_data_seq_ctr.fm_static_bitfield.Vbx_clf_xxx ECU_ADDRESS 0xc000007a BIT_MASK 0x2 /end MEASUREMENT
/begin MEASUREMENT Vbx_df_old_esp_data_seq_ctr "" UBYTE _CNV_A_R_A_165_CM 1 0. 0. 255. DISPLAY_IDENTIFIER fm_sta_esp_data_seq_ctr.fm_static_bitfield.Vbx_df_old_xxx ECU_ADDRESS 0xc000007a BIT_MASK 0x4 /end MEASUREMENT
/begin MEASUREMENT Vbx_dfctr_sat_esp_data_seq_ctr "" UBYTE _CNV_A_R_A_165_CM 1 0. 0. 255. DISPLAY_IDENTIFIER fm_sta_esp_data_seq_ctr.fm_static_bitfield.Vbx_dfctr_sat_xxx ECU_ADDRESS 0xc000007a BIT_MASK 0x8 /end MEASUREMENT
/begin MEASUREMENT Vbx_rdn_esp_data_seq_ctr "" UBYTE _CNV_A_R_A_165_CM 1 0. 0. 255. DISPLAY_IDENTIFIER fm_sta_esp_data_seq_ctr.fm_static_bitfield.Vbx_rdn_xxx ECU_ADDRESS 0xc000007a BIT_MASK 0x40 /end MEASUREMENT
/begin MEASUREMENT Vxx_dtc_stt_esp_data_seq_ctr "" UBYTE _CNV_A_R_A_165_CM 1 0. 0. 255. DISPLAY_IDENTIFIER fm_sta_esp_data_seq_ctr.Vxx_dtc_stt_xxx ECU_ADDRESS 0xc000007b /end MEASUREMENT
/begin MEASUREMENT Vxx_dfctr_esp_no_frm "" UWORD _CNV_A_R_A_165_CM 1 0. 0. 65535. DISPLAY_IDENTIFIER fm_sta_esp_no_frm.Vxx_dfctr_xxx ECU_ADDRESS 0xc000007c /end MEASUREMENT
/begin MEASUREMENT Vxx_rdn_esp_no_frm "" UWORD _CNV_A_R_A_165_CM 1 0. 0. 65535. DISPLAY_IDENTIFIER fm_sta_esp_no_frm.Vxx_rdn_xxx ECU_ADDRESS 0xc000007e /end MEASUREMENT
/begin MEASUREMENT Vbx_cf_esp_no_frm "" UBYTE _CNV_A_R_A_165_CM 1 0. 0. 255. DISPLAY_IDENTIFIER fm_sta_esp_no_frm.fm_static_bitfield.Vbx_cf_xxx ECU_ADDRESS 0xc0000080 BIT_MASK 0x1 /end MEASUREMENT
/begin MEASUREMENT Vbx_clf_esp_no_frm "" UBYTE _CNV_A_R_A_165_CM 1 0. 0. 255. DISPLAY_IDENTIFIER fm_sta_esp_no_frm.fm_static_bitfield.Vbx_clf_xxx ECU_ADDRESS 0xc0000080 BIT_MASK 0x2 /end MEASUREMENT
/begin MEASUREMENT Vbx_df_old_esp_no_frm "" UBYTE _CNV_A_R_A_165_CM 1 0. 0. 255. DISPLAY_IDENTIFIER fm_sta_esp_no_frm.fm_static_bitfield.Vbx_df_old_xxx ECU_ADDRESS 0xc0000080 BIT_MASK 0x4 /end MEASUREMENT
/begin MEASUREMENT Vbx_dfctr_sat_esp_no_frm "" UBYTE _CNV_A_R_A_165_CM 1 0. 0. 255. DISPLAY_IDENTIFIER fm_sta_esp_no_frm.fm_static_bitfield.Vbx_dfctr_sat_xxx ECU_ADDRESS 0xc0000080 BIT_MASK 0x8 /end MEASUREMENT
/begin MEASUREMENT Vbx_rdn_esp_no_frm "" UBYTE _CNV_A_R_A_165_CM 1 0. 0. 255. DISPLAY_IDENTIFIER fm_sta_esp_no_frm.fm_static_bitfield.Vbx_rdn_xxx ECU_ADDRESS 0xc0000080 BIT_MASK 0x40 /end MEASUREMENT
/begin MEASUREMENT Vxx_dtc_stt_esp_no_frm "" UBYTE _CNV_A_R_A_165_CM 1 0. 0. 255. DISPLAY_IDENTIFIER fm_sta_esp_no_frm.Vxx_dtc_stt_xxx ECU_ADDRESS 0xc0000081 /end MEASUREMENT
/begin MEASUREMENT Vxx_dfctr_fsys_cpt "" UWORD _CNV_A_R_A_165_CM 1 0. 0. 65535. DISPLAY_IDENTIFIER fm_sta_fsys_cpt.Vxx_dfctr_xxx ECU_ADDRESS 0xc0000238 /end MEASUREMENT
/begin MEASUREMENT Vxx_rdn_fsys_cpt "" UWORD _CNV_A_R_A_165_CM 1 0. 0. 65535. DISPLAY_IDENTIFIER fm_sta_fsys_cpt.Vxx_rdn_xxx ECU_ADDRESS 0xc000023a /end MEASUREMENT
/begin MEASUREMENT Vbx_cf_fsys_cpt "" UBYTE _CNV_A_R_A_165_CM 1 0. 0. 255. DISPLAY_IDENTIFIER fm_sta_fsys_cpt.fm_static_bitfield.Vbx_cf_xxx ECU_ADDRESS 0xc000023c BIT_MASK 0x1 /end MEASUREMENT
/begin MEASUREMENT Vbx_clf_fsys_cpt "" UBYTE _CNV_A_R_A_165_CM 1 0. 0. 255. DISPLAY_IDENTIFIER fm_sta_fsys_cpt.fm_static_bitfield.Vbx_clf_xxx ECU_ADDRESS 0xc000023c BIT_MASK 0x2 /end MEASUREMENT
/begin MEASUREMENT Vbx_df_old_fsys_cpt "" UBYTE _CNV_A_R_A_165_CM 1 0. 0. 255. DISPLAY_IDENTIFIER fm_sta_fsys_cpt.fm_static_bitfield.Vbx_df_old_xxx ECU_ADDRESS 0xc000023c BIT_MASK 0x4 /end MEASUREMENT
/begin MEASUREMENT Vbx_dfctr_sat_fsys_cpt "" UBYTE _CNV_A_R_A_165_CM 1 0. 0. 255. DISPLAY_IDENTIFIER fm_sta_fsys_cpt.fm_static_bitfield.Vbx_dfctr_sat_xxx ECU_ADDRESS 0xc000023c BIT_MASK 0x8 /end MEASUREMENT
/begin MEASUREMENT Vbx_rdn_fsys_cpt "" UBYTE _CNV_A_R_A_165_CM 1 0. 0. 255. DISPLAY_IDENTIFIER fm_sta_fsys_cpt.fm_static_bitfield.Vbx_rdn_xxx ECU_ADDRESS 0xc000023c BIT_MASK 0x40 /end MEASUREMENT
/begin MEASUREMENT Vxx_dtc_stt_fsys_cpt "" UBYTE _CNV_A_R_A_165_CM 1 0. 0. 255. DISPLAY_IDENTIFIER fm_sta_fsys_cpt.Vxx_dtc_stt_xxx ECU_ADDRESS 0xc000023d /end MEASUREMENT
/begin MEASUREMENT Vxx_dfctr_gas_pump_oc "" UWORD _CNV_A_R_A_165_CM 1 0. 0. 65535. DISPLAY_IDENTIFIER fm_sta_gas_pump_oc.Vxx_dfctr_xxx ECU_ADDRESS 0xc0000082 /end MEASUREMENT
/begin MEASUREMENT Vxx_rdn_gas_pump_oc "" UWORD _CNV_A_R_A_165_CM 1 0. 0. 65535. DISPLAY_IDENTIFIER fm_sta_gas_pump_oc.Vxx_rdn_xxx ECU_ADDRESS 0xc0000084 /end MEASUREMENT
/begin MEASUREMENT Vbx_cf_gas_pump_oc "" UBYTE _CNV_A_R_A_165_CM 1 0. 0. 255. DISPLAY_IDENTIFIER fm_sta_gas_pump_oc.fm_static_bitfield.Vbx_cf_xxx ECU_ADDRESS 0xc0000086 BIT_MASK 0x1 /end MEASUREMENT
/begin MEASUREMENT Vbx_clf_gas_pump_oc "" UBYTE _CNV_A_R_A_165_CM 1 0. 0. 255. DISPLAY_IDENTIFIER fm_sta_gas_pump_oc.fm_static_bitfield.Vbx_clf_xxx ECU_ADDRESS 0xc0000086 BIT_MASK 0x2 /end MEASUREMENT
/begin MEASUREMENT Vbx_df_old_gas_pump_oc "" UBYTE _CNV_A_R_A_165_CM 1 0. 0. 255. DISPLAY_IDENTIFIER fm_sta_gas_pump_oc.fm_static_bitfield.Vbx_df_old_xxx ECU_ADDRESS 0xc0000086 BIT_MASK 0x4 /end MEASUREMENT
/begin MEASUREMENT Vbx_dfctr_sat_gas_pump_oc "" UBYTE _CNV_A_R_A_165_CM 1 0. 0. 255. DISPLAY_IDENTIFIER fm_sta_gas_pump_oc.fm_static_bitfield.Vbx_dfctr_sat_xxx ECU_ADDRESS 0xc0000086 BIT_MASK 0x8 /end MEASUREMENT
/begin MEASUREMENT Vbx_rdn_gas_pump_oc "" UBYTE _CNV_A_R_A_165_CM 1 0. 0. 255. DISPLAY_IDENTIFIER fm_sta_gas_pump_oc.fm_static_bitfield.Vbx_rdn_xxx ECU_ADDRESS 0xc0000086 BIT_MASK 0x40 /end MEASUREMENT
/begin MEASUREMENT Vxx_dtc_stt_gas_pump_oc "" UBYTE _CNV_A_R_A_165_CM 1 0. 0. 255. DISPLAY_IDENTIFIER fm_sta_gas_pump_oc.Vxx_dtc_stt_xxx ECU_ADDRESS 0xc0000087 /end MEASUREMENT
/begin MEASUREMENT Vxx_dfctr_gas_pump_scg "" UWORD _CNV_A_R_A_165_CM 1 0. 0. 65535. DISPLAY_IDENTIFIER fm_sta_gas_pump_scg.Vxx_dfctr_xxx ECU_ADDRESS 0xc0000088 /end MEASUREMENT
/begin MEASUREMENT Vxx_rdn_gas_pump_scg "" UWORD _CNV_A_R_A_165_CM 1 0. 0. 65535. DISPLAY_IDENTIFIER fm_sta_gas_pump_scg.Vxx_rdn_xxx ECU_ADDRESS 0xc000008a /end MEASUREMENT
/begin MEASUREMENT Vbx_cf_gas_pump_scg "" UBYTE _CNV_A_R_A_165_CM 1 0. 0. 255. DISPLAY_IDENTIFIER fm_sta_gas_pump_scg.fm_static_bitfield.Vbx_cf_xxx ECU_ADDRESS 0xc000008c BIT_MASK 0x1 /end MEASUREMENT
/begin MEASUREMENT Vbx_clf_gas_pump_scg "" UBYTE _CNV_A_R_A_165_CM 1 0. 0. 255. DISPLAY_IDENTIFIER fm_sta_gas_pump_scg.fm_static_bitfield.Vbx_clf_xxx ECU_ADDRESS 0xc000008c BIT_MASK 0x2 /end MEASUREMENT
/begin MEASUREMENT Vbx_df_old_gas_pump_scg "" UBYTE _CNV_A_R_A_165_CM 1 0. 0. 255. DISPLAY_IDENTIFIER fm_sta_gas_pump_scg.fm_static_bitfield.Vbx_df_old_xxx ECU_ADDRESS 0xc000008c BIT_MASK 0x4 /end MEASUREMENT
/begin MEASUREMENT Vbx_dfctr_sat_gas_pump_scg "" UBYTE _CNV_A_R_A_165_CM 1 0. 0. 255. DISPLAY_IDENTIFIER fm_sta_gas_pump_scg.fm_static_bitfield.Vbx_dfctr_sat_xxx ECU_ADDRESS 0xc000008c BIT_MASK 0x8 /end MEASUREMENT
/begin MEASUREMENT Vbx_rdn_gas_pump_scg "" UBYTE _CNV_A_R_A_165_CM 1 0. 0. 255. DISPLAY_IDENTIFIER fm_sta_gas_pump_scg.fm_static_bitfield.Vbx_rdn_xxx ECU_ADDRESS 0xc000008c BIT_MASK 0x40 /end MEASUREMENT
/begin MEASUREMENT Vxx_dtc_stt_gas_pump_scg "" UBYTE _CNV_A_R_A_165_CM 1 0. 0. 255. DISPLAY_IDENTIFIER fm_sta_gas_pump_scg.Vxx_dtc_stt_xxx ECU_ADDRESS 0xc000008d /end MEASUREMENT
/begin MEASUREMENT Vxx_dfctr_gas_pump_scw "" UWORD _CNV_A_R_A_165_CM 1 0. 0. 65535. DISPLAY_IDENTIFIER fm_sta_gas_pump_scw.Vxx_dfctr_xxx ECU_ADDRESS 0xc000008e /end MEASUREMENT
/begin MEASUREMENT Vxx_rdn_gas_pump_scw "" UWORD _CNV_A_R_A_165_CM 1 0. 0. 65535. DISPLAY_IDENTIFIER fm_sta_gas_pump_scw.Vxx_rdn_xxx ECU_ADDRESS 0xc0000090 /end MEASUREMENT
/begin MEASUREMENT Vbx_cf_gas_pump_scw "" UBYTE _CNV_A_R_A_165_CM 1 0. 0. 255. DISPLAY_IDENTIFIER fm_sta_gas_pump_scw.fm_static_bitfield.Vbx_cf_xxx ECU_ADDRESS 0xc0000092 BIT_MASK 0x1 /end MEASUREMENT
/begin MEASUREMENT Vbx_clf_gas_pump_scw "" UBYTE _CNV_A_R_A_165_CM 1 0. 0. 255. DISPLAY_IDENTIFIER fm_sta_gas_pump_scw.fm_static_bitfield.Vbx_clf_xxx ECU_ADDRESS 0xc0000092 BIT_MASK 0x2 /end MEASUREMENT
/begin MEASUREMENT Vbx_df_old_gas_pump_scw "" UBYTE _CNV_A_R_A_165_CM 1 0. 0. 255. DISPLAY_IDENTIFIER fm_sta_gas_pump_scw.fm_static_bitfield.Vbx_df_old_xxx ECU_ADDRESS 0xc0000092 BIT_MASK 0x4 /end MEASUREMENT
/begin MEASUREMENT Vbx_dfctr_sat_gas_pump_scw "" UBYTE _CNV_A_R_A_165_CM 1 0. 0. 255. DISPLAY_IDENTIFIER fm_sta_gas_pump_scw.fm_static_bitfield.Vbx_dfctr_sat_xxx ECU_ADDRESS 0xc0000092 BIT_MASK 0x8 /end MEASUREMENT
/begin MEASUREMENT Vbx_rdn_gas_pump_scw "" UBYTE _CNV_A_R_A_165_CM 1 0. 0. 255. DISPLAY_IDENTIFIER fm_sta_gas_pump_scw.fm_static_bitfield.Vbx_rdn_xxx ECU_ADDRESS 0xc0000092 BIT_MASK 0x40 /end MEASUREMENT
/begin MEASUREMENT Vxx_dtc_stt_gas_pump_scw "" UBYTE _CNV_A_R_A_165_CM 1 0. 0. 255. DISPLAY_IDENTIFIER fm_sta_gas_pump_scw.Vxx_dtc_stt_xxx ECU_ADDRESS 0xc0000093 /end MEASUREMENT
/begin MEASUREMENT Vxx_dfctr_igc_1_oc "" UWORD _CNV_A_R_A_165_CM 1 0. 0. 65535. DISPLAY_IDENTIFIER fm_sta_igc_1_oc.Vxx_dfctr_xxx ECU_ADDRESS 0xc00003e8 /end MEASUREMENT
/begin MEASUREMENT Vxx_rdn_igc_1_oc "" UWORD _CNV_A_R_A_165_CM 1 0. 0. 65535. DISPLAY_IDENTIFIER fm_sta_igc_1_oc.Vxx_rdn_xxx ECU_ADDRESS 0xc00003ea /end MEASUREMENT
/begin MEASUREMENT Vbx_cf_igc_1_oc "" UBYTE _CNV_A_R_A_165_CM 1 0. 0. 255. DISPLAY_IDENTIFIER fm_sta_igc_1_oc.fm_static_bitfield.Vbx_cf_xxx ECU_ADDRESS 0xc00003ec BIT_MASK 0x1 /end MEASUREMENT
/begin MEASUREMENT Vbx_clf_igc_1_oc "" UBYTE _CNV_A_R_A_165_CM 1 0. 0. 255. DISPLAY_IDENTIFIER fm_sta_igc_1_oc.fm_static_bitfield.Vbx_clf_xxx ECU_ADDRESS 0xc00003ec BIT_MASK 0x2 /end MEASUREMENT
/begin MEASUREMENT Vbx_df_old_igc_1_oc "" UBYTE _CNV_A_R_A_165_CM 1 0. 0. 255. DISPLAY_IDENTIFIER fm_sta_igc_1_oc.fm_static_bitfield.Vbx_df_old_xxx ECU_ADDRESS 0xc00003ec BIT_MASK 0x4 /end MEASUREMENT
/begin MEASUREMENT Vbx_dfctr_sat_igc_1_oc "" UBYTE _CNV_A_R_A_165_CM 1 0. 0. 255. DISPLAY_IDENTIFIER fm_sta_igc_1_oc.fm_static_bitfield.Vbx_dfctr_sat_xxx ECU_ADDRESS 0xc00003ec BIT_MASK 0x8 /end MEASUREMENT
/begin MEASUREMENT Vbx_rdn_igc_1_oc "" UBYTE _CNV_A_R_A_165_CM 1 0. 0. 255. DISPLAY_IDENTIFIER fm_sta_igc_1_oc.fm_static_bitfield.Vbx_rdn_xxx ECU_ADDRESS 0xc00003ec BIT_MASK 0x40 /end MEASUREMENT
/begin MEASUREMENT Vxx_dtc_stt_igc_1_oc "" UBYTE _CNV_A_R_A_165_CM 1 0. 0. 255. DISPLAY_IDENTIFIER fm_sta_igc_1_oc.Vxx_dtc_stt_xxx ECU_ADDRESS 0xc00003ed /end MEASUREMENT
/begin MEASUREMENT Vxx_dfctr_igc_1_scg "" UWORD _CNV_A_R_A_165_CM 1 0. 0. 65535. DISPLAY_IDENTIFIER fm_sta_igc_1_scg.Vxx_dfctr_xxx ECU_ADDRESS 0xc00003ee /end MEASUREMENT
/begin MEASUREMENT Vxx_rdn_igc_1_scg "" UWORD _CNV_A_R_A_165_CM 1 0. 0. 65535. DISPLAY_IDENTIFIER fm_sta_igc_1_scg.Vxx_rdn_xxx ECU_ADDRESS 0xc00003f0 /end MEASUREMENT
/begin MEASUREMENT Vbx_cf_igc_1_scg "" UBYTE _CNV_A_R_A_165_CM 1 0. 0. 255. DISPLAY_IDENTIFIER fm_sta_igc_1_scg.fm_static_bitfield.Vbx_cf_xxx ECU_ADDRESS 0xc00003f2 BIT_MASK 0x1 /end MEASUREMENT
/begin MEASUREMENT Vbx_clf_igc_1_scg "" UBYTE _CNV_A_R_A_165_CM 1 0. 0. 255. DISPLAY_IDENTIFIER fm_sta_igc_1_scg.fm_static_bitfield.Vbx_clf_xxx ECU_ADDRESS 0xc00003f2 BIT_MASK 0x2 /end MEASUREMENT
/begin MEASUREMENT Vbx_df_old_igc_1_scg "" UBYTE _CNV_A_R_A_165_CM 1 0. 0. 255. DISPLAY_IDENTIFIER fm_sta_igc_1_scg.fm_static_bitfield.Vbx_df_old_xxx ECU_ADDRESS 0xc00003f2 BIT_MASK 0x4 /end MEASUREMENT
/begin MEASUREMENT Vbx_dfctr_sat_igc_1_scg "" UBYTE _CNV_A_R_A_165_CM 1 0. 0. 255. DISPLAY_IDENTIFIER fm_sta_igc_1_scg.fm_static_bitfield.Vbx_dfctr_sat_xxx ECU_ADDRESS 0xc00003f2 BIT_MASK 0x8 /end MEASUREMENT
/begin MEASUREMENT Vbx_rdn_igc_1_scg "" UBYTE _CNV_A_R_A_165_CM 1 0. 0. 255. DISPLAY_IDENTIFIER fm_sta_igc_1_scg.fm_static_bitfield.Vbx_rdn_xxx ECU_ADDRESS 0xc00003f2 BIT_MASK 0x40 /end MEASUREMENT
/begin MEASUREMENT Vxx_dtc_stt_igc_1_scg "" UBYTE _CNV_A_R_A_165_CM 1 0. 0. 255. DISPLAY_IDENTIFIER fm_sta_igc_1_scg.Vxx_dtc_stt_xxx ECU_ADDRESS 0xc00003f3 /end MEASUREMENT
/begin MEASUREMENT Vxx_dfctr_igc_1_scw "" UWORD _CNV_A_R_A_165_CM 1 0. 0. 65535. DISPLAY_IDENTIFIER fm_sta_igc_1_scw.Vxx_dfctr_xxx ECU_ADDRESS 0xc00003f4 /end MEASUREMENT
/begin MEASUREMENT Vxx_rdn_igc_1_scw "" UWORD _CNV_A_R_A_165_CM 1 0. 0. 65535. DISPLAY_IDENTIFIER fm_sta_igc_1_scw.Vxx_rdn_xxx ECU_ADDRESS 0xc00003f6 /end MEASUREMENT
/begin MEASUREMENT Vbx_cf_igc_1_scw "" UBYTE _CNV_A_R_A_165_CM 1 0. 0. 255. DISPLAY_IDENTIFIER fm_sta_igc_1_scw.fm_static_bitfield.Vbx_cf_xxx ECU_ADDRESS 0xc00003f8 BIT_MASK 0x1 /end MEASUREMENT
/begin MEASUREMENT Vbx_clf_igc_1_scw "" UBYTE _CNV_A_R_A_165_CM 1 0. 0. 255. DISPLAY_IDENTIFIER fm_sta_igc_1_scw.fm_static_bitfield.Vbx_clf_xxx ECU_ADDRESS 0xc00003f8 BIT_MASK 0x2 /end MEASUREMENT
/begin MEASUREMENT Vbx_df_old_igc_1_scw "" UBYTE _CNV_A_R_A_165_CM 1 0. 0. 255. DISPLAY_IDENTIFIER fm_sta_igc_1_scw.fm_static_bitfield.Vbx_df_old_xxx ECU_ADDRESS 0xc00003f8 BIT_MASK 0x4 /end MEASUREMENT
/begin MEASUREMENT Vbx_dfctr_sat_igc_1_scw "" UBYTE _CNV_A_R_A_165_CM 1 0. 0. 255. DISPLAY_IDENTIFIER fm_sta_igc_1_scw.fm_static_bitfield.Vbx_dfctr_sat_xxx ECU_ADDRESS 0xc00003f8 BIT_MASK 0x8 /end MEASUREMENT
/begin MEASUREMENT Vbx_rdn_igc_1_scw "" UBYTE _CNV_A_R_A_165_CM 1 0. 0. 255. DISPLAY_IDENTIFIER fm_sta_igc_1_scw.fm_static_bitfield.Vbx_rdn_xxx ECU_ADDRESS 0xc00003f8 BIT_MASK 0x40 /end MEASUREMENT
/begin MEASUREMENT Vxx_dtc_stt_igc_1_scw "" UBYTE _CNV_A_R_A_165_CM 1 0. 0. 255. DISPLAY_IDENTIFIER fm_sta_igc_1_scw.Vxx_dtc_stt_xxx ECU_ADDRESS 0xc00003f9 /end MEASUREMENT
/begin MEASUREMENT Vxx_dfctr_igc_2_oc "" UWORD _CNV_A_R_A_165_CM 1 0. 0. 65535. DISPLAY_IDENTIFIER fm_sta_igc_2_oc.Vxx_dfctr_xxx ECU_ADDRESS 0xc00003fa /end MEASUREMENT
/begin MEASUREMENT Vxx_rdn_igc_2_oc "" UWORD _CNV_A_R_A_165_CM 1 0. 0. 65535. DISPLAY_IDENTIFIER fm_sta_igc_2_oc.Vxx_rdn_xxx ECU_ADDRESS 0xc00003fc /end MEASUREMENT
/begin MEASUREMENT Vbx_cf_igc_2_oc "" UBYTE _CNV_A_R_A_165_CM 1 0. 0. 255. DISPLAY_IDENTIFIER fm_sta_igc_2_oc.fm_static_bitfield.Vbx_cf_xxx ECU_ADDRESS 0xc00003fe BIT_MASK 0x1 /end MEASUREMENT
/begin MEASUREMENT Vbx_clf_igc_2_oc "" UBYTE _CNV_A_R_A_165_CM 1 0. 0. 255. DISPLAY_IDENTIFIER fm_sta_igc_2_oc.fm_static_bitfield.Vbx_clf_xxx ECU_ADDRESS 0xc00003fe BIT_MASK 0x2 /end MEASUREMENT
/begin MEASUREMENT Vbx_df_old_igc_2_oc "" UBYTE _CNV_A_R_A_165_CM 1 0. 0. 255. DISPLAY_IDENTIFIER fm_sta_igc_2_oc.fm_static_bitfield.Vbx_df_old_xxx ECU_ADDRESS 0xc00003fe BIT_MASK 0x4 /end MEASUREMENT
/begin MEASUREMENT Vbx_dfctr_sat_igc_2_oc "" UBYTE _CNV_A_R_A_165_CM 1 0. 0. 255. DISPLAY_IDENTIFIER fm_sta_igc_2_oc.fm_static_bitfield.Vbx_dfctr_sat_xxx ECU_ADDRESS 0xc00003fe BIT_MASK 0x8 /end MEASUREMENT
/begin MEASUREMENT Vbx_rdn_igc_2_oc "" UBYTE _CNV_A_R_A_165_CM 1 0. 0. 255. DISPLAY_IDENTIFIER fm_sta_igc_2_oc.fm_static_bitfield.Vbx_rdn_xxx ECU_ADDRESS 0xc00003fe BIT_MASK 0x40 /end MEASUREMENT
/begin MEASUREMENT Vxx_dtc_stt_igc_2_oc "" UBYTE _CNV_A_R_A_165_CM 1 0. 0. 255. DISPLAY_IDENTIFIER fm_sta_igc_2_oc.Vxx_dtc_stt_xxx ECU_ADDRESS 0xc00003ff /end MEASUREMENT
/begin MEASUREMENT Vxx_dfctr_igc_2_scg "" UWORD _CNV_A_R_A_165_CM 1 0. 0. 65535. DISPLAY_IDENTIFIER fm_sta_igc_2_scg.Vxx_dfctr_xxx ECU_ADDRESS 0xc0000412 /end MEASUREMENT
/begin MEASUREMENT Vxx_rdn_igc_2_scg "" UWORD _CNV_A_R_A_165_CM 1 0. 0. 65535. DISPLAY_IDENTIFIER fm_sta_igc_2_scg.Vxx_rdn_xxx ECU_ADDRESS 0xc0000414 /end MEASUREMENT
/begin MEASUREMENT Vbx_cf_igc_2_scg "" UBYTE _CNV_A_R_A_165_CM 1 0. 0. 255. DISPLAY_IDENTIFIER fm_sta_igc_2_scg.fm_static_bitfield.Vbx_cf_xxx ECU_ADDRESS 0xc0000416 BIT_MASK 0x1 /end MEASUREMENT
/begin MEASUREMENT Vbx_clf_igc_2_scg "" UBYTE _CNV_A_R_A_165_CM 1 0. 0. 255. DISPLAY_IDENTIFIER fm_sta_igc_2_scg.fm_static_bitfield.Vbx_clf_xxx ECU_ADDRESS 0xc0000416 BIT_MASK 0x2 /end MEASUREMENT
/begin MEASUREMENT Vbx_df_old_igc_2_scg "" UBYTE _CNV_A_R_A_165_CM 1 0. 0. 255. DISPLAY_IDENTIFIER fm_sta_igc_2_scg.fm_static_bitfield.Vbx_df_old_xxx ECU_ADDRESS 0xc0000416 BIT_MASK 0x4 /end MEASUREMENT
/begin MEASUREMENT Vbx_dfctr_sat_igc_2_scg "" UBYTE _CNV_A_R_A_165_CM 1 0. 0. 255. DISPLAY_IDENTIFIER fm_sta_igc_2_scg.fm_static_bitfield.Vbx_dfctr_sat_xxx ECU_ADDRESS 0xc0000416 BIT_MASK 0x8 /end MEASUREMENT
/begin MEASUREMENT Vbx_rdn_igc_2_scg "" UBYTE _CNV_A_R_A_165_CM 1 0. 0. 255. DISPLAY_IDENTIFIER fm_sta_igc_2_scg.fm_static_bitfield.Vbx_rdn_xxx ECU_ADDRESS 0xc0000416 BIT_MASK 0x40 /end MEASUREMENT
/begin MEASUREMENT Vxx_dtc_stt_igc_2_scg "" UBYTE _CNV_A_R_A_165_CM 1 0. 0. 255. DISPLAY_IDENTIFIER fm_sta_igc_2_scg.Vxx_dtc_stt_xxx ECU_ADDRESS 0xc0000417 /end MEASUREMENT
/begin MEASUREMENT Vxx_dfctr_igc_2_scw "" UWORD _CNV_A_R_A_165_CM 1 0. 0. 65535. DISPLAY_IDENTIFIER fm_sta_igc_2_scw.Vxx_dfctr_xxx ECU_ADDRESS 0xc0000418 /end MEASUREMENT
/begin MEASUREMENT Vxx_rdn_igc_2_scw "" UWORD _CNV_A_R_A_165_CM 1 0. 0. 65535. DISPLAY_IDENTIFIER fm_sta_igc_2_scw.Vxx_rdn_xxx ECU_ADDRESS 0xc000041a /end MEASUREMENT
/begin MEASUREMENT Vbx_cf_igc_2_scw "" UBYTE _CNV_A_R_A_165_CM 1 0. 0. 255. DISPLAY_IDENTIFIER fm_sta_igc_2_scw.fm_static_bitfield.Vbx_cf_xxx ECU_ADDRESS 0xc000041c BIT_MASK 0x1 /end MEASUREMENT
/begin MEASUREMENT Vbx_clf_igc_2_scw "" UBYTE _CNV_A_R_A_165_CM 1 0. 0. 255. DISPLAY_IDENTIFIER fm_sta_igc_2_scw.fm_static_bitfield.Vbx_clf_xxx ECU_ADDRESS 0xc000041c BIT_MASK 0x2 /end MEASUREMENT
/begin MEASUREMENT Vbx_df_old_igc_2_scw "" UBYTE _CNV_A_R_A_165_CM 1 0. 0. 255. DISPLAY_IDENTIFIER fm_sta_igc_2_scw.fm_static_bitfield.Vbx_df_old_xxx ECU_ADDRESS 0xc000041c BIT_MASK 0x4 /end MEASUREMENT
/begin MEASUREMENT Vbx_dfctr_sat_igc_2_scw "" UBYTE _CNV_A_R_A_165_CM 1 0. 0. 255. DISPLAY_IDENTIFIER fm_sta_igc_2_scw.fm_static_bitfield.Vbx_dfctr_sat_xxx ECU_ADDRESS 0xc000041c BIT_MASK 0x8 /end MEASUREMENT
/begin MEASUREMENT Vbx_rdn_igc_2_scw "" UBYTE _CNV_A_R_A_165_CM 1 0. 0. 255. DISPLAY_IDENTIFIER fm_sta_igc_2_scw.fm_static_bitfield.Vbx_rdn_xxx ECU_ADDRESS 0xc000041c BIT_MASK 0x40 /end MEASUREMENT
/begin MEASUREMENT Vxx_dtc_stt_igc_2_scw "" UBYTE _CNV_A_R_A_165_CM 1 0. 0. 255. DISPLAY_IDENTIFIER fm_sta_igc_2_scw.Vxx_dtc_stt_xxx ECU_ADDRESS 0xc000041d /end MEASUREMENT
/begin MEASUREMENT Vxx_dfctr_igc_3_oc "" UWORD _CNV_A_R_A_165_CM 1 0. 0. 65535. DISPLAY_IDENTIFIER fm_sta_igc_3_oc.Vxx_dfctr_xxx ECU_ADDRESS 0xc000041e /end MEASUREMENT
/begin MEASUREMENT Vxx_rdn_igc_3_oc "" UWORD _CNV_A_R_A_165_CM 1 0. 0. 65535. DISPLAY_IDENTIFIER fm_sta_igc_3_oc.Vxx_rdn_xxx ECU_ADDRESS 0xc0000420 /end MEASUREMENT
/begin MEASUREMENT Vbx_cf_igc_3_oc "" UBYTE _CNV_A_R_A_165_CM 1 0. 0. 255. DISPLAY_IDENTIFIER fm_sta_igc_3_oc.fm_static_bitfield.Vbx_cf_xxx ECU_ADDRESS 0xc0000422 BIT_MASK 0x1 /end MEASUREMENT
/begin MEASUREMENT Vbx_clf_igc_3_oc "" UBYTE _CNV_A_R_A_165_CM 1 0. 0. 255. DISPLAY_IDENTIFIER fm_sta_igc_3_oc.fm_static_bitfield.Vbx_clf_xxx ECU_ADDRESS 0xc0000422 BIT_MASK 0x2 /end MEASUREMENT
/begin MEASUREMENT Vbx_df_old_igc_3_oc "" UBYTE _CNV_A_R_A_165_CM 1 0. 0. 255. DISPLAY_IDENTIFIER fm_sta_igc_3_oc.fm_static_bitfield.Vbx_df_old_xxx ECU_ADDRESS 0xc0000422 BIT_MASK 0x4 /end MEASUREMENT
/begin MEASUREMENT Vbx_dfctr_sat_igc_3_oc "" UBYTE _CNV_A_R_A_165_CM 1 0. 0. 255. DISPLAY_IDENTIFIER fm_sta_igc_3_oc.fm_static_bitfield.Vbx_dfctr_sat_xxx ECU_ADDRESS 0xc0000422 BIT_MASK 0x8 /end MEASUREMENT
/begin MEASUREMENT Vbx_rdn_igc_3_oc "" UBYTE _CNV_A_R_A_165_CM 1 0. 0. 255. DISPLAY_IDENTIFIER fm_sta_igc_3_oc.fm_static_bitfield.Vbx_rdn_xxx ECU_ADDRESS 0xc0000422 BIT_MASK 0x40 /end MEASUREMENT
/begin MEASUREMENT Vxx_dtc_stt_igc_3_oc "" UBYTE _CNV_A_R_A_165_CM 1 0. 0. 255. DISPLAY_IDENTIFIER fm_sta_igc_3_oc.Vxx_dtc_stt_xxx ECU_ADDRESS 0xc0000423 /end MEASUREMENT
/begin MEASUREMENT Vxx_dfctr_igc_3_scg "" UWORD _CNV_A_R_A_165_CM 1 0. 0. 65535. DISPLAY_IDENTIFIER fm_sta_igc_3_scg.Vxx_dfctr_xxx ECU_ADDRESS 0xc0000424 /end MEASUREMENT
/begin MEASUREMENT Vxx_rdn_igc_3_scg "" UWORD _CNV_A_R_A_165_CM 1 0. 0. 65535. DISPLAY_IDENTIFIER fm_sta_igc_3_scg.Vxx_rdn_xxx ECU_ADDRESS 0xc0000426 /end MEASUREMENT
/begin MEASUREMENT Vbx_cf_igc_3_scg "" UBYTE _CNV_A_R_A_165_CM 1 0. 0. 255. DISPLAY_IDENTIFIER fm_sta_igc_3_scg.fm_static_bitfield.Vbx_cf_xxx ECU_ADDRESS 0xc0000428 BIT_MASK 0x1 /end MEASUREMENT
/begin MEASUREMENT Vbx_clf_igc_3_scg "" UBYTE _CNV_A_R_A_165_CM 1 0. 0. 255. DISPLAY_IDENTIFIER fm_sta_igc_3_scg.fm_static_bitfield.Vbx_clf_xxx ECU_ADDRESS 0xc0000428 BIT_MASK 0x2 /end MEASUREMENT
/begin MEASUREMENT Vbx_df_old_igc_3_scg "" UBYTE _CNV_A_R_A_165_CM 1 0. 0. 255. DISPLAY_IDENTIFIER fm_sta_igc_3_scg.fm_static_bitfield.Vbx_df_old_xxx ECU_ADDRESS 0xc0000428 BIT_MASK 0x4 /end MEASUREMENT
/begin MEASUREMENT Vbx_dfctr_sat_igc_3_scg "" UBYTE _CNV_A_R_A_165_CM 1 0. 0. 255. DISPLAY_IDENTIFIER fm_sta_igc_3_scg.fm_static_bitfield.Vbx_dfctr_sat_xxx ECU_ADDRESS 0xc0000428 BIT_MASK 0x8 /end MEASUREMENT
/begin MEASUREMENT Vbx_rdn_igc_3_scg "" UBYTE _CNV_A_R_A_165_CM 1 0. 0. 255. DISPLAY_IDENTIFIER fm_sta_igc_3_scg.fm_static_bitfield.Vbx_rdn_xxx ECU_ADDRESS 0xc0000428 BIT_MASK 0x40 /end MEASUREMENT
/begin MEASUREMENT Vxx_dtc_stt_igc_3_scg "" UBYTE _CNV_A_R_A_165_CM 1 0. 0. 255. DISPLAY_IDENTIFIER fm_sta_igc_3_scg.Vxx_dtc_stt_xxx ECU_ADDRESS 0xc0000429 /end MEASUREMENT
/begin MEASUREMENT Vxx_dfctr_igc_3_scw "" UWORD _CNV_A_R_A_165_CM 1 0. 0. 65535. DISPLAY_IDENTIFIER fm_sta_igc_3_scw.Vxx_dfctr_xxx ECU_ADDRESS 0xc000042a /end MEASUREMENT
/begin MEASUREMENT Vxx_rdn_igc_3_scw "" UWORD _CNV_A_R_A_165_CM 1 0. 0. 65535. DISPLAY_IDENTIFIER fm_sta_igc_3_scw.Vxx_rdn_xxx ECU_ADDRESS 0xc000042c /end MEASUREMENT
/begin MEASUREMENT Vbx_cf_igc_3_scw "" UBYTE _CNV_A_R_A_165_CM 1 0. 0. 255. DISPLAY_IDENTIFIER fm_sta_igc_3_scw.fm_static_bitfield.Vbx_cf_xxx ECU_ADDRESS 0xc000042e BIT_MASK 0x1 /end MEASUREMENT
/begin MEASUREMENT Vbx_clf_igc_3_scw "" UBYTE _CNV_A_R_A_165_CM 1 0. 0. 255. DISPLAY_IDENTIFIER fm_sta_igc_3_scw.fm_static_bitfield.Vbx_clf_xxx ECU_ADDRESS 0xc000042e BIT_MASK 0x2 /end MEASUREMENT
/begin MEASUREMENT Vbx_df_old_igc_3_scw "" UBYTE _CNV_A_R_A_165_CM 1 0. 0. 255. DISPLAY_IDENTIFIER fm_sta_igc_3_scw.fm_static_bitfield.Vbx_df_old_xxx ECU_ADDRESS 0xc000042e BIT_MASK 0x4 /end MEASUREMENT
/begin MEASUREMENT Vbx_dfctr_sat_igc_3_scw "" UBYTE _CNV_A_R_A_165_CM 1 0. 0. 255. DISPLAY_IDENTIFIER fm_sta_igc_3_scw.fm_static_bitfield.Vbx_dfctr_sat_xxx ECU_ADDRESS 0xc000042e BIT_MASK 0x8 /end MEASUREMENT
/begin MEASUREMENT Vbx_rdn_igc_3_scw "" UBYTE _CNV_A_R_A_165_CM 1 0. 0. 255. DISPLAY_IDENTIFIER fm_sta_igc_3_scw.fm_static_bitfield.Vbx_rdn_xxx ECU_ADDRESS 0xc000042e BIT_MASK 0x40 /end MEASUREMENT
/begin MEASUREMENT Vxx_dtc_stt_igc_3_scw "" UBYTE _CNV_A_R_A_165_CM 1 0. 0. 255. DISPLAY_IDENTIFIER fm_sta_igc_3_scw.Vxx_dtc_stt_xxx ECU_ADDRESS 0xc000042f /end MEASUREMENT
/begin MEASUREMENT Vxx_dfctr_igc_4_oc "" UWORD _CNV_A_R_A_165_CM 1 0. 0. 65535. DISPLAY_IDENTIFIER fm_sta_igc_4_oc.Vxx_dfctr_xxx ECU_ADDRESS 0xc0000430 /end MEASUREMENT
/begin MEASUREMENT Vxx_rdn_igc_4_oc "" UWORD _CNV_A_R_A_165_CM 1 0. 0. 65535. DISPLAY_IDENTIFIER fm_sta_igc_4_oc.Vxx_rdn_xxx ECU_ADDRESS 0xc0000432 /end MEASUREMENT
/begin MEASUREMENT Vbx_cf_igc_4_oc "" UBYTE _CNV_A_R_A_165_CM 1 0. 0. 255. DISPLAY_IDENTIFIER fm_sta_igc_4_oc.fm_static_bitfield.Vbx_cf_xxx ECU_ADDRESS 0xc0000434 BIT_MASK 0x1 /end MEASUREMENT
/begin MEASUREMENT Vbx_clf_igc_4_oc "" UBYTE _CNV_A_R_A_165_CM 1 0. 0. 255. DISPLAY_IDENTIFIER fm_sta_igc_4_oc.fm_static_bitfield.Vbx_clf_xxx ECU_ADDRESS 0xc0000434 BIT_MASK 0x2 /end MEASUREMENT
/begin MEASUREMENT Vbx_df_old_igc_4_oc "" UBYTE _CNV_A_R_A_165_CM 1 0. 0. 255. DISPLAY_IDENTIFIER fm_sta_igc_4_oc.fm_static_bitfield.Vbx_df_old_xxx ECU_ADDRESS 0xc0000434 BIT_MASK 0x4 /end MEASUREMENT
/begin MEASUREMENT Vbx_dfctr_sat_igc_4_oc "" UBYTE _CNV_A_R_A_165_CM 1 0. 0. 255. DISPLAY_IDENTIFIER fm_sta_igc_4_oc.fm_static_bitfield.Vbx_dfctr_sat_xxx ECU_ADDRESS 0xc0000434 BIT_MASK 0x8 /end MEASUREMENT
/begin MEASUREMENT Vbx_rdn_igc_4_oc "" UBYTE _CNV_A_R_A_165_CM 1 0. 0. 255. DISPLAY_IDENTIFIER fm_sta_igc_4_oc.fm_static_bitfield.Vbx_rdn_xxx ECU_ADDRESS 0xc0000434 BIT_MASK 0x40 /end MEASUREMENT
/begin MEASUREMENT Vxx_dtc_stt_igc_4_oc "" UBYTE _CNV_A_R_A_165_CM 1 0. 0. 255. DISPLAY_IDENTIFIER fm_sta_igc_4_oc.Vxx_dtc_stt_xxx ECU_ADDRESS 0xc0000435 /end MEASUREMENT
/begin MEASUREMENT Vxx_dfctr_igc_4_scg "" UWORD _CNV_A_R_A_165_CM 1 0. 0. 65535. DISPLAY_IDENTIFIER fm_sta_igc_4_scg.Vxx_dfctr_xxx ECU_ADDRESS 0xc0000436 /end MEASUREMENT
/begin MEASUREMENT Vxx_rdn_igc_4_scg "" UWORD _CNV_A_R_A_165_CM 1 0. 0. 65535. DISPLAY_IDENTIFIER fm_sta_igc_4_scg.Vxx_rdn_xxx ECU_ADDRESS 0xc0000438 /end MEASUREMENT
/begin MEASUREMENT Vbx_cf_igc_4_scg "" UBYTE _CNV_A_R_A_165_CM 1 0. 0. 255. DISPLAY_IDENTIFIER fm_sta_igc_4_scg.fm_static_bitfield.Vbx_cf_xxx ECU_ADDRESS 0xc000043a BIT_MASK 0x1 /end MEASUREMENT
/begin MEASUREMENT Vbx_clf_igc_4_scg "" UBYTE _CNV_A_R_A_165_CM 1 0. 0. 255. DISPLAY_IDENTIFIER fm_sta_igc_4_scg.fm_static_bitfield.Vbx_clf_xxx ECU_ADDRESS 0xc000043a BIT_MASK 0x2 /end MEASUREMENT
/begin MEASUREMENT Vbx_df_old_igc_4_scg "" UBYTE _CNV_A_R_A_165_CM 1 0. 0. 255. DISPLAY_IDENTIFIER fm_sta_igc_4_scg.fm_static_bitfield.Vbx_df_old_xxx ECU_ADDRESS 0xc000043a BIT_MASK 0x4 /end MEASUREMENT
/begin MEASUREMENT Vbx_dfctr_sat_igc_4_scg "" UBYTE _CNV_A_R_A_165_CM 1 0. 0. 255. DISPLAY_IDENTIFIER fm_sta_igc_4_scg.fm_static_bitfield.Vbx_dfctr_sat_xxx ECU_ADDRESS 0xc000043a BIT_MASK 0x8 /end MEASUREMENT
/begin MEASUREMENT Vbx_rdn_igc_4_scg "" UBYTE _CNV_A_R_A_165_CM 1 0. 0. 255. DISPLAY_IDENTIFIER fm_sta_igc_4_scg.fm_static_bitfield.Vbx_rdn_xxx ECU_ADDRESS 0xc000043a BIT_MASK 0x40 /end MEASUREMENT
/begin MEASUREMENT Vxx_dtc_stt_igc_4_scg "" UBYTE _CNV_A_R_A_165_CM 1 0. 0. 255. DISPLAY_IDENTIFIER fm_sta_igc_4_scg.Vxx_dtc_stt_xxx ECU_ADDRESS 0xc000043b /end MEASUREMENT
/begin MEASUREMENT Vxx_dfctr_igc_4_scw "" UWORD _CNV_A_R_A_165_CM 1 0. 0. 65535. DISPLAY_IDENTIFIER fm_sta_igc_4_scw.Vxx_dfctr_xxx ECU_ADDRESS 0xc000043c /end MEASUREMENT
/begin MEASUREMENT Vxx_rdn_igc_4_scw "" UWORD _CNV_A_R_A_165_CM 1 0. 0. 65535. DISPLAY_IDENTIFIER fm_sta_igc_4_scw.Vxx_rdn_xxx ECU_ADDRESS 0xc000043e /end MEASUREMENT
/begin MEASUREMENT Vbx_cf_igc_4_scw "" UBYTE _CNV_A_R_A_165_CM 1 0. 0. 255. DISPLAY_IDENTIFIER fm_sta_igc_4_scw.fm_static_bitfield.Vbx_cf_xxx ECU_ADDRESS 0xc0000440 BIT_MASK 0x1 /end MEASUREMENT
/begin MEASUREMENT Vbx_clf_igc_4_scw "" UBYTE _CNV_A_R_A_165_CM 1 0. 0. 255. DISPLAY_IDENTIFIER fm_sta_igc_4_scw.fm_static_bitfield.Vbx_clf_xxx ECU_ADDRESS 0xc0000440 BIT_MASK 0x2 /end MEASUREMENT
/begin MEASUREMENT Vbx_df_old_igc_4_scw "" UBYTE _CNV_A_R_A_165_CM 1 0. 0. 255. DISPLAY_IDENTIFIER fm_sta_igc_4_scw.fm_static_bitfield.Vbx_df_old_xxx ECU_ADDRESS 0xc0000440 BIT_MASK 0x4 /end MEASUREMENT
/begin MEASUREMENT Vbx_dfctr_sat_igc_4_scw "" UBYTE _CNV_A_R_A_165_CM 1 0. 0. 255. DISPLAY_IDENTIFIER fm_sta_igc_4_scw.fm_static_bitfield.Vbx_dfctr_sat_xxx ECU_ADDRESS 0xc0000440 BIT_MASK 0x8 /end MEASUREMENT
/begin MEASUREMENT Vbx_rdn_igc_4_scw "" UBYTE _CNV_A_R_A_165_CM 1 0. 0. 255. DISPLAY_IDENTIFIER fm_sta_igc_4_scw.fm_static_bitfield.Vbx_rdn_xxx ECU_ADDRESS 0xc0000440 BIT_MASK 0x40 /end MEASUREMENT
/begin MEASUREMENT Vxx_dtc_stt_igc_4_scw "" UBYTE _CNV_A_R_A_165_CM 1 0. 0. 255. DISPLAY_IDENTIFIER fm_sta_igc_4_scw.Vxx_dtc_stt_xxx ECU_ADDRESS 0xc0000441 /end MEASUREMENT
/begin MEASUREMENT Vxx_dfctr_in_cam_chr "" UWORD _CNV_A_R_A_165_CM 1 0. 0. 65535. DISPLAY_IDENTIFIER fm_sta_in_cam_chr.Vxx_dfctr_xxx ECU_ADDRESS 0xc000034c /end MEASUREMENT
/begin MEASUREMENT Vxx_rdn_in_cam_chr "" UWORD _CNV_A_R_A_165_CM 1 0. 0. 65535. DISPLAY_IDENTIFIER fm_sta_in_cam_chr.Vxx_rdn_xxx ECU_ADDRESS 0xc000034e /end MEASUREMENT
/begin MEASUREMENT Vbx_cf_in_cam_chr "" UBYTE _CNV_A_R_A_165_CM 1 0. 0. 255. DISPLAY_IDENTIFIER fm_sta_in_cam_chr.fm_static_bitfield.Vbx_cf_xxx ECU_ADDRESS 0xc0000350 BIT_MASK 0x1 /end MEASUREMENT
/begin MEASUREMENT Vbx_clf_in_cam_chr "" UBYTE _CNV_A_R_A_165_CM 1 0. 0. 255. DISPLAY_IDENTIFIER fm_sta_in_cam_chr.fm_static_bitfield.Vbx_clf_xxx ECU_ADDRESS 0xc0000350 BIT_MASK 0x2 /end MEASUREMENT
/begin MEASUREMENT Vbx_df_old_in_cam_chr "" UBYTE _CNV_A_R_A_165_CM 1 0. 0. 255. DISPLAY_IDENTIFIER fm_sta_in_cam_chr.fm_static_bitfield.Vbx_df_old_xxx ECU_ADDRESS 0xc0000350 BIT_MASK 0x4 /end MEASUREMENT
/begin MEASUREMENT Vbx_dfctr_sat_in_cam_chr "" UBYTE _CNV_A_R_A_165_CM 1 0. 0. 255. DISPLAY_IDENTIFIER fm_sta_in_cam_chr.fm_static_bitfield.Vbx_dfctr_sat_xxx ECU_ADDRESS 0xc0000350 BIT_MASK 0x8 /end MEASUREMENT
/begin MEASUREMENT Vbx_rdn_in_cam_chr "" UBYTE _CNV_A_R_A_165_CM 1 0. 0. 255. DISPLAY_IDENTIFIER fm_sta_in_cam_chr.fm_static_bitfield.Vbx_rdn_xxx ECU_ADDRESS 0xc0000350 BIT_MASK 0x40 /end MEASUREMENT
/begin MEASUREMENT Vxx_dtc_stt_in_cam_chr "" UBYTE _CNV_A_R_A_165_CM 1 0. 0. 255. DISPLAY_IDENTIFIER fm_sta_in_cam_chr.Vxx_dtc_stt_xxx ECU_ADDRESS 0xc0000351 /end MEASUREMENT
/begin MEASUREMENT Vxx_dfctr_in_cam_crk_cmp "" UWORD _CNV_A_R_A_165_CM 1 0. 0. 65535. DISPLAY_IDENTIFIER fm_sta_in_cam_crk_cmp.Vxx_dfctr_xxx ECU_ADDRESS 0xc0000352 /end MEASUREMENT
/begin MEASUREMENT Vxx_rdn_in_cam_crk_cmp "" UWORD _CNV_A_R_A_165_CM 1 0. 0. 65535. DISPLAY_IDENTIFIER fm_sta_in_cam_crk_cmp.Vxx_rdn_xxx ECU_ADDRESS 0xc0000354 /end MEASUREMENT
/begin MEASUREMENT Vbx_cf_in_cam_crk_cmp "" UBYTE _CNV_A_R_A_165_CM 1 0. 0. 255. DISPLAY_IDENTIFIER fm_sta_in_cam_crk_cmp.fm_static_bitfield.Vbx_cf_xxx ECU_ADDRESS 0xc0000356 BIT_MASK 0x1 /end MEASUREMENT
/begin MEASUREMENT Vbx_clf_in_cam_crk_cmp "" UBYTE _CNV_A_R_A_165_CM 1 0. 0. 255. DISPLAY_IDENTIFIER fm_sta_in_cam_crk_cmp.fm_static_bitfield.Vbx_clf_xxx ECU_ADDRESS 0xc0000356 BIT_MASK 0x2 /end MEASUREMENT
/begin MEASUREMENT Vbx_df_old_in_cam_crk_cmp "" UBYTE _CNV_A_R_A_165_CM 1 0. 0. 255. DISPLAY_IDENTIFIER fm_sta_in_cam_crk_cmp.fm_static_bitfield.Vbx_df_old_xxx ECU_ADDRESS 0xc0000356 BIT_MASK 0x4 /end MEASUREMENT
/begin MEASUREMENT Vbx_dfctr_sat_in_cam_crk_cmp "" UBYTE _CNV_A_R_A_165_CM 1 0. 0. 255. DISPLAY_IDENTIFIER fm_sta_in_cam_crk_cmp.fm_static_bitfield.Vbx_dfctr_sat_xxx ECU_ADDRESS 0xc0000356 BIT_MASK 0x8 /end MEASUREMENT
/begin MEASUREMENT Vbx_rdn_in_cam_crk_cmp "" UBYTE _CNV_A_R_A_165_CM 1 0. 0. 255. DISPLAY_IDENTIFIER fm_sta_in_cam_crk_cmp.fm_static_bitfield.Vbx_rdn_xxx ECU_ADDRESS 0xc0000356 BIT_MASK 0x40 /end MEASUREMENT
/begin MEASUREMENT Vxx_dtc_stt_in_cam_crk_cmp "" UBYTE _CNV_A_R_A_165_CM 1 0. 0. 255. DISPLAY_IDENTIFIER fm_sta_in_cam_crk_cmp.Vxx_dtc_stt_xxx ECU_ADDRESS 0xc0000357 /end MEASUREMENT
/begin MEASUREMENT Vxx_dfctr_in_cam_cyc "" UWORD _CNV_A_R_A_165_CM 1 0. 0. 65535. DISPLAY_IDENTIFIER fm_sta_in_cam_cyc.Vxx_dfctr_xxx ECU_ADDRESS 0xc00003b2 /end MEASUREMENT
/begin MEASUREMENT Vxx_rdn_in_cam_cyc "" UWORD _CNV_A_R_A_165_CM 1 0. 0. 65535. DISPLAY_IDENTIFIER fm_sta_in_cam_cyc.Vxx_rdn_xxx ECU_ADDRESS 0xc00003b4 /end MEASUREMENT
/begin MEASUREMENT Vbx_cf_in_cam_cyc "" UBYTE _CNV_A_R_A_165_CM 1 0. 0. 255. DISPLAY_IDENTIFIER fm_sta_in_cam_cyc.fm_static_bitfield.Vbx_cf_xxx ECU_ADDRESS 0xc00003b6 BIT_MASK 0x1 /end MEASUREMENT
/begin MEASUREMENT Vbx_clf_in_cam_cyc "" UBYTE _CNV_A_R_A_165_CM 1 0. 0. 255. DISPLAY_IDENTIFIER fm_sta_in_cam_cyc.fm_static_bitfield.Vbx_clf_xxx ECU_ADDRESS 0xc00003b6 BIT_MASK 0x2 /end MEASUREMENT
/begin MEASUREMENT Vbx_df_old_in_cam_cyc "" UBYTE _CNV_A_R_A_165_CM 1 0. 0. 255. DISPLAY_IDENTIFIER fm_sta_in_cam_cyc.fm_static_bitfield.Vbx_df_old_xxx ECU_ADDRESS 0xc00003b6 BIT_MASK 0x4 /end MEASUREMENT
/begin MEASUREMENT Vbx_dfctr_sat_in_cam_cyc "" UBYTE _CNV_A_R_A_165_CM 1 0. 0. 255. DISPLAY_IDENTIFIER fm_sta_in_cam_cyc.fm_static_bitfield.Vbx_dfctr_sat_xxx ECU_ADDRESS 0xc00003b6 BIT_MASK 0x8 /end MEASUREMENT
/begin MEASUREMENT Vbx_rdn_in_cam_cyc "" UBYTE _CNV_A_R_A_165_CM 1 0. 0. 255. DISPLAY_IDENTIFIER fm_sta_in_cam_cyc.fm_static_bitfield.Vbx_rdn_xxx ECU_ADDRESS 0xc00003b6 BIT_MASK 0x40 /end MEASUREMENT
/begin MEASUREMENT Vxx_dtc_stt_in_cam_cyc "" UBYTE _CNV_A_R_A_165_CM 1 0. 0. 255. DISPLAY_IDENTIFIER fm_sta_in_cam_cyc.Vxx_dtc_stt_xxx ECU_ADDRESS 0xc00003b7 /end MEASUREMENT
/begin MEASUREMENT Vxx_dfctr_in_cam_no_sig "" UWORD _CNV_A_R_A_165_CM 1 0. 0. 65535. DISPLAY_IDENTIFIER fm_sta_in_cam_no_sig.Vxx_dfctr_xxx ECU_ADDRESS 0xc0000358 /end MEASUREMENT
/begin MEASUREMENT Vxx_rdn_in_cam_no_sig "" UWORD _CNV_A_R_A_165_CM 1 0. 0. 65535. DISPLAY_IDENTIFIER fm_sta_in_cam_no_sig.Vxx_rdn_xxx ECU_ADDRESS 0xc000035a /end MEASUREMENT
/begin MEASUREMENT Vbx_cf_in_cam_no_sig "" UBYTE _CNV_A_R_A_165_CM 1 0. 0. 255. DISPLAY_IDENTIFIER fm_sta_in_cam_no_sig.fm_static_bitfield.Vbx_cf_xxx ECU_ADDRESS 0xc000035c BIT_MASK 0x1 /end MEASUREMENT
/begin MEASUREMENT Vbx_clf_in_cam_no_sig "" UBYTE _CNV_A_R_A_165_CM 1 0. 0. 255. DISPLAY_IDENTIFIER fm_sta_in_cam_no_sig.fm_static_bitfield.Vbx_clf_xxx ECU_ADDRESS 0xc000035c BIT_MASK 0x2 /end MEASUREMENT
/begin MEASUREMENT Vbx_df_old_in_cam_no_sig "" UBYTE _CNV_A_R_A_165_CM 1 0. 0. 255. DISPLAY_IDENTIFIER fm_sta_in_cam_no_sig.fm_static_bitfield.Vbx_df_old_xxx ECU_ADDRESS 0xc000035c BIT_MASK 0x4 /end MEASUREMENT
/begin MEASUREMENT Vbx_dfctr_sat_in_cam_no_sig "" UBYTE _CNV_A_R_A_165_CM 1 0. 0. 255. DISPLAY_IDENTIFIER fm_sta_in_cam_no_sig.fm_static_bitfield.Vbx_dfctr_sat_xxx ECU_ADDRESS 0xc000035c BIT_MASK 0x8 /end MEASUREMENT
/begin MEASUREMENT Vbx_rdn_in_cam_no_sig "" UBYTE _CNV_A_R_A_165_CM 1 0. 0. 255. DISPLAY_IDENTIFIER fm_sta_in_cam_no_sig.fm_static_bitfield.Vbx_rdn_xxx ECU_ADDRESS 0xc000035c BIT_MASK 0x40 /end MEASUREMENT
/begin MEASUREMENT Vxx_dtc_stt_in_cam_no_sig "" UBYTE _CNV_A_R_A_165_CM 1 0. 0. 255. DISPLAY_IDENTIFIER fm_sta_in_cam_no_sig.Vxx_dtc_stt_xxx ECU_ADDRESS 0xc000035d /end MEASUREMENT
/begin MEASUREMENT Vxx_dfctr_in_cam_nok "" UWORD _CNV_A_R_A_165_CM 1 0. 0. 65535. DISPLAY_IDENTIFIER fm_sta_in_cam_nok.Vxx_dfctr_xxx ECU_ADDRESS 0xc00003ac /end MEASUREMENT
/begin MEASUREMENT Vxx_rdn_in_cam_nok "" UWORD _CNV_A_R_A_165_CM 1 0. 0. 65535. DISPLAY_IDENTIFIER fm_sta_in_cam_nok.Vxx_rdn_xxx ECU_ADDRESS 0xc00003ae /end MEASUREMENT
/begin MEASUREMENT Vbx_cf_in_cam_nok "" UBYTE _CNV_A_R_A_165_CM 1 0. 0. 255. DISPLAY_IDENTIFIER fm_sta_in_cam_nok.fm_static_bitfield.Vbx_cf_xxx ECU_ADDRESS 0xc00003b0 BIT_MASK 0x1 /end MEASUREMENT
/begin MEASUREMENT Vbx_clf_in_cam_nok "" UBYTE _CNV_A_R_A_165_CM 1 0. 0. 255. DISPLAY_IDENTIFIER fm_sta_in_cam_nok.fm_static_bitfield.Vbx_clf_xxx ECU_ADDRESS 0xc00003b0 BIT_MASK 0x2 /end MEASUREMENT
/begin MEASUREMENT Vbx_df_old_in_cam_nok "" UBYTE _CNV_A_R_A_165_CM 1 0. 0. 255. DISPLAY_IDENTIFIER fm_sta_in_cam_nok.fm_static_bitfield.Vbx_df_old_xxx ECU_ADDRESS 0xc00003b0 BIT_MASK 0x4 /end MEASUREMENT
/begin MEASUREMENT Vbx_dfctr_sat_in_cam_nok "" UBYTE _CNV_A_R_A_165_CM 1 0. 0. 255. DISPLAY_IDENTIFIER fm_sta_in_cam_nok.fm_static_bitfield.Vbx_dfctr_sat_xxx ECU_ADDRESS 0xc00003b0 BIT_MASK 0x8 /end MEASUREMENT
/begin MEASUREMENT Vbx_rdn_in_cam_nok "" UBYTE _CNV_A_R_A_165_CM 1 0. 0. 255. DISPLAY_IDENTIFIER fm_sta_in_cam_nok.fm_static_bitfield.Vbx_rdn_xxx ECU_ADDRESS 0xc00003b0 BIT_MASK 0x40 /end MEASUREMENT
/begin MEASUREMENT Vxx_dtc_stt_in_cam_nok "" UBYTE _CNV_A_R_A_165_CM 1 0. 0. 255. DISPLAY_IDENTIFIER fm_sta_in_cam_nok.Vxx_dtc_stt_xxx ECU_ADDRESS 0xc00003b1 /end MEASUREMENT
/begin MEASUREMENT Vxx_dfctr_in_vvtc_ad "" UWORD _CNV_A_R_A_165_CM 1 0. 0. 65535. DISPLAY_IDENTIFIER fm_sta_in_vvtc_ad.Vxx_dfctr_xxx ECU_ADDRESS 0xc000035e /end MEASUREMENT
/begin MEASUREMENT Vxx_rdn_in_vvtc_ad "" UWORD _CNV_A_R_A_165_CM 1 0. 0. 65535. DISPLAY_IDENTIFIER fm_sta_in_vvtc_ad.Vxx_rdn_xxx ECU_ADDRESS 0xc0000360 /end MEASUREMENT
/begin MEASUREMENT Vbx_cf_in_vvtc_ad "" UBYTE _CNV_A_R_A_165_CM 1 0. 0. 255. DISPLAY_IDENTIFIER fm_sta_in_vvtc_ad.fm_static_bitfield.Vbx_cf_xxx ECU_ADDRESS 0xc0000362 BIT_MASK 0x1 /end MEASUREMENT
/begin MEASUREMENT Vbx_clf_in_vvtc_ad "" UBYTE _CNV_A_R_A_165_CM 1 0. 0. 255. DISPLAY_IDENTIFIER fm_sta_in_vvtc_ad.fm_static_bitfield.Vbx_clf_xxx ECU_ADDRESS 0xc0000362 BIT_MASK 0x2 /end MEASUREMENT
/begin MEASUREMENT Vbx_df_old_in_vvtc_ad "" UBYTE _CNV_A_R_A_165_CM 1 0. 0. 255. DISPLAY_IDENTIFIER fm_sta_in_vvtc_ad.fm_static_bitfield.Vbx_df_old_xxx ECU_ADDRESS 0xc0000362 BIT_MASK 0x4 /end MEASUREMENT
/begin MEASUREMENT Vbx_dfctr_sat_in_vvtc_ad "" UBYTE _CNV_A_R_A_165_CM 1 0. 0. 255. DISPLAY_IDENTIFIER fm_sta_in_vvtc_ad.fm_static_bitfield.Vbx_dfctr_sat_xxx ECU_ADDRESS 0xc0000362 BIT_MASK 0x8 /end MEASUREMENT
/begin MEASUREMENT Vbx_rdn_in_vvtc_ad "" UBYTE _CNV_A_R_A_165_CM 1 0. 0. 255. DISPLAY_IDENTIFIER fm_sta_in_vvtc_ad.fm_static_bitfield.Vbx_rdn_xxx ECU_ADDRESS 0xc0000362 BIT_MASK 0x40 /end MEASUREMENT
/begin MEASUREMENT Vxx_dtc_stt_in_vvtc_ad "" UBYTE _CNV_A_R_A_165_CM 1 0. 0. 255. DISPLAY_IDENTIFIER fm_sta_in_vvtc_ad.Vxx_dtc_stt_xxx ECU_ADDRESS 0xc0000363 /end MEASUREMENT
/begin MEASUREMENT Vxx_dfctr_in_vvtc_blk "" UWORD _CNV_A_R_A_165_CM 1 0. 0. 65535. DISPLAY_IDENTIFIER fm_sta_in_vvtc_blk.Vxx_dfctr_xxx ECU_ADDRESS 0xc0000094 /end MEASUREMENT
/begin MEASUREMENT Vxx_rdn_in_vvtc_blk "" UWORD _CNV_A_R_A_165_CM 1 0. 0. 65535. DISPLAY_IDENTIFIER fm_sta_in_vvtc_blk.Vxx_rdn_xxx ECU_ADDRESS 0xc0000096 /end MEASUREMENT
/begin MEASUREMENT Vbx_cf_in_vvtc_blk "" UBYTE _CNV_A_R_A_165_CM 1 0. 0. 255. DISPLAY_IDENTIFIER fm_sta_in_vvtc_blk.fm_static_bitfield.Vbx_cf_xxx ECU_ADDRESS 0xc0000098 BIT_MASK 0x1 /end MEASUREMENT
/begin MEASUREMENT Vbx_clf_in_vvtc_blk "" UBYTE _CNV_A_R_A_165_CM 1 0. 0. 255. DISPLAY_IDENTIFIER fm_sta_in_vvtc_blk.fm_static_bitfield.Vbx_clf_xxx ECU_ADDRESS 0xc0000098 BIT_MASK 0x2 /end MEASUREMENT
/begin MEASUREMENT Vbx_df_old_in_vvtc_blk "" UBYTE _CNV_A_R_A_165_CM 1 0. 0. 255. DISPLAY_IDENTIFIER fm_sta_in_vvtc_blk.fm_static_bitfield.Vbx_df_old_xxx ECU_ADDRESS 0xc0000098 BIT_MASK 0x4 /end MEASUREMENT
/begin MEASUREMENT Vbx_dfctr_sat_in_vvtc_blk "" UBYTE _CNV_A_R_A_165_CM 1 0. 0. 255. DISPLAY_IDENTIFIER fm_sta_in_vvtc_blk.fm_static_bitfield.Vbx_dfctr_sat_xxx ECU_ADDRESS 0xc0000098 BIT_MASK 0x8 /end MEASUREMENT
/begin MEASUREMENT Vbx_rdn_in_vvtc_blk "" UBYTE _CNV_A_R_A_165_CM 1 0. 0. 255. DISPLAY_IDENTIFIER fm_sta_in_vvtc_blk.fm_static_bitfield.Vbx_rdn_xxx ECU_ADDRESS 0xc0000098 BIT_MASK 0x40 /end MEASUREMENT
/begin MEASUREMENT Vxx_dtc_stt_in_vvtc_blk "" UBYTE _CNV_A_R_A_165_CM 1 0. 0. 255. DISPLAY_IDENTIFIER fm_sta_in_vvtc_blk.Vxx_dtc_stt_xxx ECU_ADDRESS 0xc0000099 /end MEASUREMENT
/begin MEASUREMENT Vxx_dfctr_in_vvtc_dirt_lkg "" UWORD _CNV_A_R_A_165_CM 1 0. 0. 65535. DISPLAY_IDENTIFIER fm_sta_in_vvtc_dirt_lkg.Vxx_dfctr_xxx ECU_ADDRESS 0xc000009a /end MEASUREMENT
/begin MEASUREMENT Vxx_rdn_in_vvtc_dirt_lkg "" UWORD _CNV_A_R_A_165_CM 1 0. 0. 65535. DISPLAY_IDENTIFIER fm_sta_in_vvtc_dirt_lkg.Vxx_rdn_xxx ECU_ADDRESS 0xc000009c /end MEASUREMENT
/begin MEASUREMENT Vbx_cf_in_vvtc_dirt_lkg "" UBYTE _CNV_A_R_A_165_CM 1 0. 0. 255. DISPLAY_IDENTIFIER fm_sta_in_vvtc_dirt_lkg.fm_static_bitfield.Vbx_cf_xxx ECU_ADDRESS 0xc000009e BIT_MASK 0x1 /end MEASUREMENT
/begin MEASUREMENT Vbx_clf_in_vvtc_dirt_lkg "" UBYTE _CNV_A_R_A_165_CM 1 0. 0. 255. DISPLAY_IDENTIFIER fm_sta_in_vvtc_dirt_lkg.fm_static_bitfield.Vbx_clf_xxx ECU_ADDRESS 0xc000009e BIT_MASK 0x2 /end MEASUREMENT
/begin MEASUREMENT Vbx_df_old_in_vvtc_dirt_lkg "" UBYTE _CNV_A_R_A_165_CM 1 0. 0. 255. DISPLAY_IDENTIFIER fm_sta_in_vvtc_dirt_lkg.fm_static_bitfield.Vbx_df_old_xxx ECU_ADDRESS 0xc000009e BIT_MASK 0x4 /end MEASUREMENT
/begin MEASUREMENT Vbx_dfctr_sat_in_vvtc_dirt_lkg "" UBYTE _CNV_A_R_A_165_CM 1 0. 0. 255. DISPLAY_IDENTIFIER fm_sta_in_vvtc_dirt_lkg.fm_static_bitfield.Vbx_dfctr_sat_xxx ECU_ADDRESS 0xc000009e BIT_MASK 0x8 /end MEASUREMENT
/begin MEASUREMENT Vbx_rdn_in_vvtc_dirt_lkg "" UBYTE _CNV_A_R_A_165_CM 1 0. 0. 255. DISPLAY_IDENTIFIER fm_sta_in_vvtc_dirt_lkg.fm_static_bitfield.Vbx_rdn_xxx ECU_ADDRESS 0xc000009e BIT_MASK 0x40 /end MEASUREMENT
/begin MEASUREMENT Vxx_dtc_stt_in_vvtc_dirt_lkg "" UBYTE _CNV_A_R_A_165_CM 1 0. 0. 255. DISPLAY_IDENTIFIER fm_sta_in_vvtc_dirt_lkg.Vxx_dtc_stt_xxx ECU_ADDRESS 0xc000009f /end MEASUREMENT
/begin MEASUREMENT Vxx_dfctr_in_vvtc_sldv_oc "" UWORD _CNV_A_R_A_165_CM 1 0. 0. 65535. DISPLAY_IDENTIFIER fm_sta_in_vvtc_sldv_oc.Vxx_dfctr_xxx ECU_ADDRESS 0xc00000a0 /end MEASUREMENT
/begin MEASUREMENT Vxx_rdn_in_vvtc_sldv_oc "" UWORD _CNV_A_R_A_165_CM 1 0. 0. 65535. DISPLAY_IDENTIFIER fm_sta_in_vvtc_sldv_oc.Vxx_rdn_xxx ECU_ADDRESS 0xc00000a2 /end MEASUREMENT
/begin MEASUREMENT Vbx_cf_in_vvtc_sldv_oc "" UBYTE _CNV_A_R_A_165_CM 1 0. 0. 255. DISPLAY_IDENTIFIER fm_sta_in_vvtc_sldv_oc.fm_static_bitfield.Vbx_cf_xxx ECU_ADDRESS 0xc00000a4 BIT_MASK 0x1 /end MEASUREMENT
/begin MEASUREMENT Vbx_clf_in_vvtc_sldv_oc "" UBYTE _CNV_A_R_A_165_CM 1 0. 0. 255. DISPLAY_IDENTIFIER fm_sta_in_vvtc_sldv_oc.fm_static_bitfield.Vbx_clf_xxx ECU_ADDRESS 0xc00000a4 BIT_MASK 0x2 /end MEASUREMENT
/begin MEASUREMENT Vbx_df_old_in_vvtc_sldv_oc "" UBYTE _CNV_A_R_A_165_CM 1 0. 0. 255. DISPLAY_IDENTIFIER fm_sta_in_vvtc_sldv_oc.fm_static_bitfield.Vbx_df_old_xxx ECU_ADDRESS 0xc00000a4 BIT_MASK 0x4 /end MEASUREMENT
/begin MEASUREMENT Vbx_dfctr_sat_in_vvtc_sldv_oc "" UBYTE _CNV_A_R_A_165_CM 1 0. 0. 255. DISPLAY_IDENTIFIER fm_sta_in_vvtc_sldv_oc.fm_static_bitfield.Vbx_dfctr_sat_xxx ECU_ADDRESS 0xc00000a4 BIT_MASK 0x8 /end MEASUREMENT
/begin MEASUREMENT Vbx_rdn_in_vvtc_sldv_oc "" UBYTE _CNV_A_R_A_165_CM 1 0. 0. 255. DISPLAY_IDENTIFIER fm_sta_in_vvtc_sldv_oc.fm_static_bitfield.Vbx_rdn_xxx ECU_ADDRESS 0xc00000a4 BIT_MASK 0x40 /end MEASUREMENT
/begin MEASUREMENT Vxx_dtc_stt_in_vvtc_sldv_oc "" UBYTE _CNV_A_R_A_165_CM 1 0. 0. 255. DISPLAY_IDENTIFIER fm_sta_in_vvtc_sldv_oc.Vxx_dtc_stt_xxx ECU_ADDRESS 0xc00000a5 /end MEASUREMENT
/begin MEASUREMENT Vxx_dfctr_in_vvtc_sldv_scg "" UWORD _CNV_A_R_A_165_CM 1 0. 0. 65535. DISPLAY_IDENTIFIER fm_sta_in_vvtc_sldv_scg.Vxx_dfctr_xxx ECU_ADDRESS 0xc00000a6 /end MEASUREMENT
/begin MEASUREMENT Vxx_rdn_in_vvtc_sldv_scg "" UWORD _CNV_A_R_A_165_CM 1 0. 0. 65535. DISPLAY_IDENTIFIER fm_sta_in_vvtc_sldv_scg.Vxx_rdn_xxx ECU_ADDRESS 0xc00000a8 /end MEASUREMENT
/begin MEASUREMENT Vbx_cf_in_vvtc_sldv_scg "" UBYTE _CNV_A_R_A_165_CM 1 0. 0. 255. DISPLAY_IDENTIFIER fm_sta_in_vvtc_sldv_scg.fm_static_bitfield.Vbx_cf_xxx ECU_ADDRESS 0xc00000aa BIT_MASK 0x1 /end MEASUREMENT
/begin MEASUREMENT Vbx_clf_in_vvtc_sldv_scg "" UBYTE _CNV_A_R_A_165_CM 1 0. 0. 255. DISPLAY_IDENTIFIER fm_sta_in_vvtc_sldv_scg.fm_static_bitfield.Vbx_clf_xxx ECU_ADDRESS 0xc00000aa BIT_MASK 0x2 /end MEASUREMENT
/begin MEASUREMENT Vbx_df_old_in_vvtc_sldv_scg "" UBYTE _CNV_A_R_A_165_CM 1 0. 0. 255. DISPLAY_IDENTIFIER fm_sta_in_vvtc_sldv_scg.fm_static_bitfield.Vbx_df_old_xxx ECU_ADDRESS 0xc00000aa BIT_MASK 0x4 /end MEASUREMENT
/begin MEASUREMENT Vbx_dfctr_sat_in_vvtc_sldv_scg "" UBYTE _CNV_A_R_A_165_CM 1 0. 0. 255. DISPLAY_IDENTIFIER fm_sta_in_vvtc_sldv_scg.fm_static_bitfield.Vbx_dfctr_sat_xxx ECU_ADDRESS 0xc00000aa BIT_MASK 0x8 /end MEASUREMENT
/begin MEASUREMENT Vbx_rdn_in_vvtc_sldv_scg "" UBYTE _CNV_A_R_A_165_CM 1 0. 0. 255. DISPLAY_IDENTIFIER fm_sta_in_vvtc_sldv_scg.fm_static_bitfield.Vbx_rdn_xxx ECU_ADDRESS 0xc00000aa BIT_MASK 0x40 /end MEASUREMENT
/begin MEASUREMENT Vxx_dtc_stt_in_vvtc_sldv_scg "" UBYTE _CNV_A_R_A_165_CM 1 0. 0. 255. DISPLAY_IDENTIFIER fm_sta_in_vvtc_sldv_scg.Vxx_dtc_stt_xxx ECU_ADDRESS 0xc00000ab /end MEASUREMENT
/begin MEASUREMENT Vxx_dfctr_in_vvtc_sldv_scw "" UWORD _CNV_A_R_A_165_CM 1 0. 0. 65535. DISPLAY_IDENTIFIER fm_sta_in_vvtc_sldv_scw.Vxx_dfctr_xxx ECU_ADDRESS 0xc00000ac /end MEASUREMENT
/begin MEASUREMENT Vxx_rdn_in_vvtc_sldv_scw "" UWORD _CNV_A_R_A_165_CM 1 0. 0. 65535. DISPLAY_IDENTIFIER fm_sta_in_vvtc_sldv_scw.Vxx_rdn_xxx ECU_ADDRESS 0xc00000ae /end MEASUREMENT
/begin MEASUREMENT Vbx_cf_in_vvtc_sldv_scw "" UBYTE _CNV_A_R_A_165_CM 1 0. 0. 255. DISPLAY_IDENTIFIER fm_sta_in_vvtc_sldv_scw.fm_static_bitfield.Vbx_cf_xxx ECU_ADDRESS 0xc00000b0 BIT_MASK 0x1 /end MEASUREMENT
/begin MEASUREMENT Vbx_clf_in_vvtc_sldv_scw "" UBYTE _CNV_A_R_A_165_CM 1 0. 0. 255. DISPLAY_IDENTIFIER fm_sta_in_vvtc_sldv_scw.fm_static_bitfield.Vbx_clf_xxx ECU_ADDRESS 0xc00000b0 BIT_MASK 0x2 /end MEASUREMENT
/begin MEASUREMENT Vbx_df_old_in_vvtc_sldv_scw "" UBYTE _CNV_A_R_A_165_CM 1 0. 0. 255. DISPLAY_IDENTIFIER fm_sta_in_vvtc_sldv_scw.fm_static_bitfield.Vbx_df_old_xxx ECU_ADDRESS 0xc00000b0 BIT_MASK 0x4 /end MEASUREMENT
/begin MEASUREMENT Vbx_dfctr_sat_in_vvtc_sldv_scw "" UBYTE _CNV_A_R_A_165_CM 1 0. 0. 255. DISPLAY_IDENTIFIER fm_sta_in_vvtc_sldv_scw.fm_static_bitfield.Vbx_dfctr_sat_xxx ECU_ADDRESS 0xc00000b0 BIT_MASK 0x8 /end MEASUREMENT
/begin MEASUREMENT Vbx_rdn_in_vvtc_sldv_scw "" UBYTE _CNV_A_R_A_165_CM 1 0. 0. 255. DISPLAY_IDENTIFIER fm_sta_in_vvtc_sldv_scw.fm_static_bitfield.Vbx_rdn_xxx ECU_ADDRESS 0xc00000b0 BIT_MASK 0x40 /end MEASUREMENT
/begin MEASUREMENT Vxx_dtc_stt_in_vvtc_sldv_scw "" UBYTE _CNV_A_R_A_165_CM 1 0. 0. 255. DISPLAY_IDENTIFIER fm_sta_in_vvtc_sldv_scw.Vxx_dtc_stt_xxx ECU_ADDRESS 0xc00000b1 /end MEASUREMENT
/begin MEASUREMENT Vxx_dfctr_inj1_oc "" UWORD _CNV_A_R_A_165_CM 1 0. 0. 65535. DISPLAY_IDENTIFIER fm_sta_inj1_oc.Vxx_dfctr_xxx ECU_ADDRESS 0xc00000be /end MEASUREMENT
/begin MEASUREMENT Vxx_rdn_inj1_oc "" UWORD _CNV_A_R_A_165_CM 1 0. 0. 65535. DISPLAY_IDENTIFIER fm_sta_inj1_oc.Vxx_rdn_xxx ECU_ADDRESS 0xc00000c0 /end MEASUREMENT
/begin MEASUREMENT Vbx_cf_inj1_oc "" UBYTE _CNV_A_R_A_165_CM 1 0. 0. 255. DISPLAY_IDENTIFIER fm_sta_inj1_oc.fm_static_bitfield.Vbx_cf_xxx ECU_ADDRESS 0xc00000c2 BIT_MASK 0x1 /end MEASUREMENT
/begin MEASUREMENT Vbx_clf_inj1_oc "" UBYTE _CNV_A_R_A_165_CM 1 0. 0. 255. DISPLAY_IDENTIFIER fm_sta_inj1_oc.fm_static_bitfield.Vbx_clf_xxx ECU_ADDRESS 0xc00000c2 BIT_MASK 0x2 /end MEASUREMENT
/begin MEASUREMENT Vbx_df_old_inj1_oc "" UBYTE _CNV_A_R_A_165_CM 1 0. 0. 255. DISPLAY_IDENTIFIER fm_sta_inj1_oc.fm_static_bitfield.Vbx_df_old_xxx ECU_ADDRESS 0xc00000c2 BIT_MASK 0x4 /end MEASUREMENT
/begin MEASUREMENT Vbx_dfctr_sat_inj1_oc "" UBYTE _CNV_A_R_A_165_CM 1 0. 0. 255. DISPLAY_IDENTIFIER fm_sta_inj1_oc.fm_static_bitfield.Vbx_dfctr_sat_xxx ECU_ADDRESS 0xc00000c2 BIT_MASK 0x8 /end MEASUREMENT
/begin MEASUREMENT Vbx_rdn_inj1_oc "" UBYTE _CNV_A_R_A_165_CM 1 0. 0. 255. DISPLAY_IDENTIFIER fm_sta_inj1_oc.fm_static_bitfield.Vbx_rdn_xxx ECU_ADDRESS 0xc00000c2 BIT_MASK 0x40 /end MEASUREMENT
/begin MEASUREMENT Vxx_dtc_stt_inj1_oc "" UBYTE _CNV_A_R_A_165_CM 1 0. 0. 255. DISPLAY_IDENTIFIER fm_sta_inj1_oc.Vxx_dtc_stt_xxx ECU_ADDRESS 0xc00000c3 /end MEASUREMENT
/begin MEASUREMENT Vxx_dfctr_inj1_scg "" UWORD _CNV_A_R_A_165_CM 1 0. 0. 65535. DISPLAY_IDENTIFIER fm_sta_inj1_scg.Vxx_dfctr_xxx ECU_ADDRESS 0xc00000c4 /end MEASUREMENT
/begin MEASUREMENT Vxx_rdn_inj1_scg "" UWORD _CNV_A_R_A_165_CM 1 0. 0. 65535. DISPLAY_IDENTIFIER fm_sta_inj1_scg.Vxx_rdn_xxx ECU_ADDRESS 0xc00000c6 /end MEASUREMENT
/begin MEASUREMENT Vbx_cf_inj1_scg "" UBYTE _CNV_A_R_A_165_CM 1 0. 0. 255. DISPLAY_IDENTIFIER fm_sta_inj1_scg.fm_static_bitfield.Vbx_cf_xxx ECU_ADDRESS 0xc00000c8 BIT_MASK 0x1 /end MEASUREMENT
/begin MEASUREMENT Vbx_clf_inj1_scg "" UBYTE _CNV_A_R_A_165_CM 1 0. 0. 255. DISPLAY_IDENTIFIER fm_sta_inj1_scg.fm_static_bitfield.Vbx_clf_xxx ECU_ADDRESS 0xc00000c8 BIT_MASK 0x2 /end MEASUREMENT
/begin MEASUREMENT Vbx_df_old_inj1_scg "" UBYTE _CNV_A_R_A_165_CM 1 0. 0. 255. DISPLAY_IDENTIFIER fm_sta_inj1_scg.fm_static_bitfield.Vbx_df_old_xxx ECU_ADDRESS 0xc00000c8 BIT_MASK 0x4 /end MEASUREMENT
/begin MEASUREMENT Vbx_dfctr_sat_inj1_scg "" UBYTE _CNV_A_R_A_165_CM 1 0. 0. 255. DISPLAY_IDENTIFIER fm_sta_inj1_scg.fm_static_bitfield.Vbx_dfctr_sat_xxx ECU_ADDRESS 0xc00000c8 BIT_MASK 0x8 /end MEASUREMENT
/begin MEASUREMENT Vbx_rdn_inj1_scg "" UBYTE _CNV_A_R_A_165_CM 1 0. 0. 255. DISPLAY_IDENTIFIER fm_sta_inj1_scg.fm_static_bitfield.Vbx_rdn_xxx ECU_ADDRESS 0xc00000c8 BIT_MASK 0x40 /end MEASUREMENT
/begin MEASUREMENT Vxx_dtc_stt_inj1_scg "" UBYTE _CNV_A_R_A_165_CM 1 0. 0. 255. DISPLAY_IDENTIFIER fm_sta_inj1_scg.Vxx_dtc_stt_xxx ECU_ADDRESS 0xc00000c9 /end MEASUREMENT
/begin MEASUREMENT Vxx_dfctr_inj1_scw "" UWORD _CNV_A_R_A_165_CM 1 0. 0. 65535. DISPLAY_IDENTIFIER fm_sta_inj1_scw.Vxx_dfctr_xxx ECU_ADDRESS 0xc00000ca /end MEASUREMENT
/begin MEASUREMENT Vxx_rdn_inj1_scw "" UWORD _CNV_A_R_A_165_CM 1 0. 0. 65535. DISPLAY_IDENTIFIER fm_sta_inj1_scw.Vxx_rdn_xxx ECU_ADDRESS 0xc00000cc /end MEASUREMENT
/begin MEASUREMENT Vbx_cf_inj1_scw "" UBYTE _CNV_A_R_A_165_CM 1 0. 0. 255. DISPLAY_IDENTIFIER fm_sta_inj1_scw.fm_static_bitfield.Vbx_cf_xxx ECU_ADDRESS 0xc00000ce BIT_MASK 0x1 /end MEASUREMENT
/begin MEASUREMENT Vbx_clf_inj1_scw "" UBYTE _CNV_A_R_A_165_CM 1 0. 0. 255. DISPLAY_IDENTIFIER fm_sta_inj1_scw.fm_static_bitfield.Vbx_clf_xxx ECU_ADDRESS 0xc00000ce BIT_MASK 0x2 /end MEASUREMENT
/begin MEASUREMENT Vbx_df_old_inj1_scw "" UBYTE _CNV_A_R_A_165_CM 1 0. 0. 255. DISPLAY_IDENTIFIER fm_sta_inj1_scw.fm_static_bitfield.Vbx_df_old_xxx ECU_ADDRESS 0xc00000ce BIT_MASK 0x4 /end MEASUREMENT
/begin COMPU_METHOD _CNV_A_R_A_165_CM "" RAT_FUNC "%6.3" "" COEFFS 0 1. 0. 0 0 1 /end COMPU_METHOD
/begin FUNCTION DgDftMng ""
 /begin OUT_MEASUREMENT Sbx_cf_cru_whl_cmd_oc_scw Sbx_dyn_cru_whl_cmd_oor Sbx_rdn_cru_whl_cmd_oor Sbx_mf_cru_whl_cmd_oor Sbx_cf_cru_whl_cmd_oor Sbx_dyn_ecm_adc_tron Sbx_rdn_ecm_adc_tron Sbx_mf_ecm_adc_tron Sbx_cf_ecm_adc_tron Sbx_dyn_ecm_err_itl Sbx_rdn_ecm_err_itl Sbx_mf_ecm_err_itl Sbx_cf_ecm_err_itl Sbx_dyn_ecm_mon_secu_1 Sbx_rdn_ecm_mon_secu_1 Sbx_mf_ecm_mon_secu_1 Sbx_cf_ecm_mon_secu_1 Sbx_dyn_ecm_mon_secu_2 Sbx_rdn_ecm_mon_secu_2 Sbx_mf_ecm_mon_secu_2 Sbx_cf_ecm_mon_secu_2 Sbx_dyn_ecm_mon_tron Sbx_rdn_ecm_mon_tron Sbx_mf_ecm_mon_tron Sbx_cf_ecm_mon_tron Sbx_dyn_esp_data_chr Sbx_rdn_esp_data_chr Sbx_mf_esp_data_chr Sbx_cf_esp_data_chr Sbx_dyn_esp_data_seq_ctr Sbx_rdn_esp_data_seq_ctr Sbx_mf_esp_data_seq_ctr Sbx_cf_esp_data_seq_ctr Sbx_dyn_esp_no_frm Sbx_rdn_esp_no_frm Sbx_mf_esp_no_frm Sbx_cf_esp_no_frm Sbx_dyn_fsys_cpt Sbx_rdn_fsys_cpt Sbx_mf_fsys_cpt Sbx_cf_fsys_cpt Sbx_dyn_gas_pump_oc Sbx_rdn_gas_pump_oc Sbx_mf_gas_pump_oc Sbx_cf_gas_pump_oc Sbx_dyn_gas_pump_scg Sbx_rdn_gas_pump_scg Sbx_mf_gas_pump_scg Sbx_cf_gas_pump_scg Sbx_dyn_gas_pump_scw Sbx_rdn_gas_pump_scw Sbx_mf_gas_pump_scw Sbx_cf_gas_pump_scw Sbx_dyn_igc_1_oc Sbx_rdn_igc_1_oc Sbx_mf_igc_1_oc Sbx_cf_igc_1_oc Sbx_dyn_igc_1_scg Sbx_rdn_igc_1_scg Sbx_mf_igc_1_scg Sbx_cf_igc_1_scg Sbx_dyn_igc_1_scw Sbx_rdn_igc_1_scw Sbx_mf_igc_1_scw Sbx_cf_igc_1_scw Sbx_dyn_igc_2_oc Sbx_rdn_igc_2_oc Sbx_mf_igc_2_oc Sbx_cf_igc_2_oc Sbx_dyn_igc_2_scg Sbx_rdn_igc_2_scg Sbx_mf_igc_2_scg Sbx_cf_igc_2_scg Sbx_dyn_igc_2_scw Sbx_rdn_igc_2_scw Sbx_mf_igc_2_scw Sbx_cf_igc_2_scw Sbx_dyn_igc_3_oc Sbx_rdn_igc_3_oc Sbx_mf_igc_3_oc Sbx_cf_igc_3_oc Sbx_dyn_igc_3_scg Sbx_rdn_igc_3_scg Sbx_mf_igc_3_scg Sbx_cf_igc_3_scg Sbx_dyn_igc_3_scw Sbx_rdn_igc_3_scw Sbx_mf_igc_3_scw Sbx_cf_igc_3_scw Sbx_dyn_igc_4_oc Sbx_rdn_igc_4_oc Sbx_mf_igc_4_oc Sbx_cf_igc_4_oc Sbx_dyn_igc_4_scg Sbx_rdn_igc_4_scg Sbx_mf_igc_4_scg Sbx_cf_igc_4_scg Sbx_dyn_igc_4_scw Sbx_rdn_igc_4_scw Sbx_mf_igc_4_scw Sbx_cf_igc_4_scw Sbx_dyn_in_cam_chr Sbx_rdn_in_cam_chr Sbx_mf_in_cam_chr Sbx_cf_in_cam_chr Sbx_dyn_in_cam_crk_cmp Sbx_rdn_in_cam_crk_cmp Sbx_mf_in_cam_crk_cmp Sbx_cf_in_cam_crk_cmp Sbx_dyn_in_cam_cyc Sbx_rdn_in_cam_cyc Sbx_mf_in_cam_cyc Sbx_cf_in_cam_cyc Sbx_dyn_in_cam_no_sig Sbx_rdn_in_cam_no_sig Sbx_mf_in_cam_no_sig Sbx_cf_in_cam_no_sig Sbx_dyn_in_cam_nok Sbx_rdn_in_cam_nok Sbx_mf_in_cam_nok Sbx_cf_in_cam_nok Sbx_dyn_in_vvtc_ad Sbx_rdn_in_vvtc_ad Sbx_mf_in_vvtc_ad Sbx_cf_in_vvtc_ad Sbx_dyn_in_vvtc_blk Sbx_rdn_in_vvtc_blk Sbx_mf_in_vvtc_blk Sbx_cf_in_vvtc_blk Sbx_dyn_in_vvtc_dirt_lkg Sbx_rdn_in_vvtc_dirt_lkg Sbx_mf_in_vvtc_dirt_lkg Sbx_cf_in_vvtc_dirt_lkg Sbx_dyn_in_vvtc_sldv_oc Sbx_rdn_in_vvtc_sldv_oc Sbx_mf_in_vvtc_sldv_oc Sbx_cf_in_vvtc_sldv_oc Sbx_dyn_in_vvtc_sldv_scg Sbx_rdn_in_vvtc_sldv_scg Sbx_mf_in_vvtc_sldv_scg Sbx_cf_in_vvtc_sldv_scg Sbx_dyn_in_vvtc_sldv_scw Sbx_rdn_in_vvtc_sldv_scw Sbx_mf_in_vvtc_sldv_scw Sbx_cf_in_vvtc_sldv_scw Sbx_dyn_inj1_oc Sbx_rdn_inj1_oc Sbx_mf_inj1_oc Sbx_cf_inj1_oc Sbx_dyn_inj1_scg Sbx_rdn_inj1_scg Sbx_mf_inj1_scg Sbx_cf_inj1_scg Sbx_dyn_inj1_scw Sbx_rdn_inj1_scw Sbx_mf_inj1_scw Sbx_cf_inj1_scw Sbx_dyn_inj2_oc Sbx_rdn_inj2_oc Sbx_mf_inj2_oc Sbx_cf_inj2_oc Sbx_dyn_inj2_scg Sbx_rdn_inj2_scg Sbx_mf_inj2_scg Sbx_cf_inj2_scg Sbx_dyn_inj2_scw Sbx_rdn_inj2_scw Sbx_mf_inj2_scw Sbx_cf_inj2_scw Sbx_dyn_inj3_oc Sbx_rdn_inj3_oc Sbx_mf_inj3_oc Sbx_cf_inj3_oc Sbx_dyn_inj3_scg Sbx_rdn_inj3_scg Sbx_mf_inj3_scg Sbx_cf_inj3_scg Sbx_dyn_inj3_scw Sbx_rdn_inj3_scw Sbx_mf_inj3_scw Sbx_cf_inj3_scw Sbx_dyn_inj4_oc Sbx_rdn_inj4_oc Sbx_mf_inj4_oc Sbx_cf_inj4_oc Sbx_dyn_inj4_scg Sbx_rdn_inj4_scg Sbx_mf_inj4_scg Sbx_cf_inj4_scg Sbx_dyn_inj4_scw Sbx_rdn_inj4_scw Sbx_mf_inj4_scw Sbx_cf_inj4_scw Sbx_dyn_inj_ecu_itl Sbx_rdn_inj_ecu_itl Sbx_mf_inj_ecu_itl Sbx_cf_inj_ecu_itl Sbx_dyn_inj_ecu_lbdw_icp Sbx_rdn_inj_ecu_lbdw_icp Sbx_mf_inj_ecu_lbdw_icp Sbx_cf_inj_ecu_lbdw_icp Sbx_dyn_inj_ecu_lbup_icp Sbx_rdn_inj_ecu_lbup_icp Sbx_mf_inj_ecu_lbup_icp Sbx_cf_inj_ecu_lbup_icp Sbx_dyn_ip_lght_tco_ovh Sbx_rdn_ip_lght_tco_ovh Sbx_mf_ip_lght_tco_ovh Sbx_cf_ip_lght_tco_ovh Sbx_dyn_it_cmd_el Sbx_rdn_it_cmd_el Sbx_mf_it_cmd_el Sbx_cf_it_cmd_el Sbx_dyn_it_ofs_meca Sbx_rdn_it_ofs_meca Sbx_mf_it_ofs_meca Sbx_cf_it_ofs_meca Sbx_dyn_it_ofs_no_norm Sbx_rdn_it_ofs_no_norm Sbx_mf_it_ofs_no_norm Sbx_cf_it_ofs_no_norm Sbx_dyn_it_ofs_secu_nok Sbx_rdn_it_ofs_secu_nok Sbx_mf_it_ofs_secu_nok Sbx_cf_it_ofs_secu_nok Sbx_dyn_it_reg_blk Sbx_rdn_it_reg_blk Sbx_mf_it_reg_blk Sbx_cf_it_reg_blk Sbx_dyn_knk_oor Sbx_rdn_knk_oor Sbx_mf_knk_oor Sbx_cf_knk_oor Sbx_dyn_knk_shp Sbx_rdn_knk_shp Sbx_mf_knk_shp Sbx_cf_knk_shp Sbx_dyn_lbdw_hot_oc Sbx_rdn_lbdw_hot_oc Sbx_mf_lbdw_hot_oc Sbx_cf_lbdw_hot_oc Sbx_dyn_lbdw_hot_scg Sbx_rdn_lbdw_hot_scg Sbx_mf_lbdw_hot_scg Sbx_cf_lbdw_hot_scg Sbx_dyn_lbdw_hot_scw Sbx_rdn_lbdw_hot_scw Sbx_mf_lbdw_hot_scw Sbx_cf_lbdw_hot_scw Sbx_dyn_lbdw_oc Sbx_rdn_lbdw_oc Sbx_mf_lbdw_oc Sbx_cf_lbdw_oc Sbx_dyn_lbdw_scg Sbx_rdn_lbdw_scg Sbx_mf_lbdw_scg Sbx_cf_lbdw_scg Sbx_dyn_lbdw_scw Sbx_rdn_lbdw_scw Sbx_mf_lbdw_scw Sbx_cf_lbdw_scw Sbx_dyn_lbup_cpt Sbx_rdn_lbup_cpt Sbx_mf_lbup_cpt Sbx_cf_lbup_cpt Sbx_dyn_lbup_hot_apl_down Sbx_rdn_lbup_hot_apl_down Sbx_mf_lbup_hot_apl_down Sbx_cf_lbup_hot_apl_down Sbx_dyn_lbup_hot_oc Sbx_rdn_lbup_hot_oc Sbx_mf_lbup_hot_oc Sbx_cf_lbup_hot_oc Sbx_dyn_lbup_hot_scg Sbx_rdn_lbup_hot_scg Sbx_mf_lbup_hot_scg Sbx_cf_lbup_hot_scg Sbx_dyn_lbup_hot_scw Sbx_rdn_lbup_hot_scw Sbx_mf_lbup_hot_scw Sbx_cf_lbup_hot_scw Sbx_dyn_lbup_nok Sbx_rdn_lbup_nok Sbx_mf_lbup_nok Sbx_cf_lbup_nok Sbx_dyn_lbup_oc Sbx_rdn_lbup_oc Sbx_mf_lbup_oc Sbx_cf_lbup_oc Sbx_dyn_lbup_scg Sbx_rdn_lbup_scg Sbx_mf_lbup_scg Sbx_cf_lbup_scg Sbx_dyn_lbup_scw Sbx_rdn_lbup_scw Sbx_mf_lbup_scw Sbx_cf_lbup_scw Sbx_dyn_map_chr Sbx_rdn_map_chr Sbx_mf_map_chr Sbx_cf_map_chr Sbx_dyn_map_oor Sbx_rdn_map_oor Sbx_mf_map_oor Sbx_cf_map_oor Sbx_dyn_mis_1_cata Sbx_rdn_mis_1_cata Sbx_mf_mis_1_cata Sbx_cf_mis_1_cata Sbx_dyn_mis_1_lpg_cata Sbx_rdn_mis_1_lpg_cata Sbx_mf_mis_1_lpg_cata Sbx_cf_mis_1_lpg_cata Sbx_dyn_mis_1_lpg_trs_h Sbx_rdn_mis_1_lpg_trs_h Sbx_mf_mis_1_lpg_trs_h Sbx_cf_mis_1_lpg_trs_h Sbx_dyn_mis_1_trs_h Sbx_rdn_mis_1_trs_h Sbx_mf_mis_1_trs_h Sbx_cf_mis_1_trs_h Sbx_dyn_mis_2_cata Sbx_rdn_mis_2_cata Sbx_mf_mis_2_cata Sbx_cf_mis_2_cata Sbx_dyn_mis_2_lpg_cata Sbx_rdn_mis_2_lpg_cata Sbx_mf_mis_2_lpg_cata Sbx_cf_mis_2_lpg_cata Sbx_dyn_mis_2_lpg_trs_h Sbx_rdn_mis_2_lpg_trs_h Sbx_mf_mis_2_lpg_trs_h Sbx_cf_mis_2_lpg_trs_h Sbx_dyn_mis_2_trs_h Sbx_rdn_mis_2_trs_h Sbx_mf_mis_2_trs_h Sbx_cf_mis_2_trs_h Sbx_dyn_mis_3_cata Sbx_rdn_mis_3_cata Sbx_mf_mis_3_cata Sbx_cf_mis_3_cata Sbx_dyn_mis_3_lpg_cata Sbx_rdn_mis_3_lpg_cata Sbx_mf_mis_3_lpg_cata Sbx_cf_mis_3_lpg_cata Sbx_dyn_mis_3_lpg_trs_h Sbx_rdn_mis_3_lpg_trs_h Sbx_mf_mis_3_lpg_trs_h Sbx_cf_mis_3_lpg_trs_h Sbx_dyn_mis_3_trs_h Sbx_rdn_mis_3_trs_h Sbx_mf_mis_3_trs_h Sbx_cf_mis_3_trs_h Sbx_dyn_mis_4_cata Sbx_rdn_mis_4_cata Sbx_mf_mis_4_cata Sbx_cf_mis_4_cata Sbx_dyn_mis_4_lpg_cata Sbx_rdn_mis_4_lpg_cata Sbx_mf_mis_4_lpg_cata Sbx_cf_mis_4_lpg_cata Sbx_dyn_mis_4_lpg_trs_h Sbx_rdn_mis_4_lpg_trs_h Sbx_mf_mis_4_lpg_trs_h Sbx_cf_mis_4_lpg_trs_h Sbx_dyn_mis_4_trs_h Sbx_rdn_mis_4_trs_h Sbx_mf_mis_4_trs_h Sbx_cf_mis_4_trs_h Sbx_dyn_mis_cata Sbx_rdn_mis_cata Sbx_mf_mis_cata Sbx_cf_mis_cata Sbx_dyn_mis_lpg_cata Sbx_rdn_mis_lpg_cata Sbx_mf_mis_lpg_cata Sbx_cf_mis_lpg_cata Sbx_dyn_mis_lpg_trs_h Sbx_rdn_mis_lpg_trs_h Sbx_mf_mis_lpg_trs_h Sbx_cf_mis_lpg_trs_h Sbx_dyn_mis_min_fuel_cata Sbx_rdn_mis_min_fuel_cata Sbx_mf_mis_min_fuel_cata Sbx_cf_mis_min_fuel_cata Sbx_dyn_mis_min_fuel_trs_h Sbx_rdn_mis_min_fuel_trs_h Sbx_mf_mis_min_fuel_trs_h Sbx_cf_mis_min_fuel_trs_h Sbx_dyn_mis_trs_h Sbx_rdn_mis_trs_h Sbx_mf_mis_trs_h Sbx_cf_mis_trs_h Sbx_dyn_mis_unk_cata Sbx_rdn_mis_unk_cata Sbx_mf_mis_unk_cata Sbx_cf_mis_unk_cata Sbx_dyn_mis_unk_lpg_cata Sbx_rdn_mis_unk_lpg_cata Sbx_mf_mis_unk_lpg_cata Sbx_cf_mis_unk_lpg_cata Sbx_dyn_mis_unk_lpg_trs_h Sbx_rdn_mis_unk_lpg_trs_h Sbx_mf_mis_unk_lpg_trs_h Sbx_cf_mis_unk_lpg_trs_h Sbx_dyn_mis_unk_trs_h Sbx_rdn_mis_unk_trs_h Sbx_mf_mis_unk_trs_h Sbx_cf_mis_unk_trs_h Sbx_dyn_ptc_rov_oc Sbx_rdn_ptc_rov_oc Sbx_mf_ptc_rov_oc Sbx_cf_ptc_rov_oc Sbx_dyn_ptc_rov_scg Sbx_rdn_ptc_rov_scg Sbx_mf_ptc_rov_scg Sbx_cf_ptc_rov_scg Sbx_dyn_ptc_rov_scw Sbx_rdn_ptc_rov_scw Sbx_mf_ptc_rov_scw Sbx_cf_ptc_rov_scw Sbx_dyn_pws_1_h Sbx_rdn_pws_1_h Sbx_mf_pws_1_h Sbx_cf_pws_1_h Sbx_dyn_pws_1_l Sbx_rdn_pws_1_l Sbx_mf_pws_1_l Sbx_cf_pws_1_l Sbx_dyn_pws_2_h Sbx_rdn_pws_2_h Sbx_mf_pws_2_h Sbx_cf_pws_2_h Sbx_dyn_pws_2_l Sbx_rdn_pws_2_l Sbx_mf_pws_2_l Sbx_cf_pws_2_l Sbx_dyn_pws_3_h Sbx_rdn_pws_3_h Sbx_mf_pws_3_h Sbx_cf_pws_3_h Sbx_dyn_pws_3_l Sbx_rdn_pws_3_l Sbx_mf_pws_3_l Sbx_cf_pws_3_l Sbx_dyn_sens_it_1_nok Sbx_rdn_sens_it_1_nok Sbx_mf_sens_it_1_nok Sbx_cf_sens_it_1_nok Sbx_dyn_sens_it_2_nok Sbx_rdn_sens_it_2_nok Sbx_mf_sens_it_2_nok Sbx_cf_sens_it_2_nok Sbx_dyn_sens_it_chr Sbx_rdn_sens_it_chr Sbx_mf_sens_it_chr Sbx_cf_sens_it_chr Sbx_dyn_sens_it_sig_mcut Sbx_rdn_sens_it_sig_mcut Sbx_mf_sens_it_sig_mcut Sbx_cf_sens_it_sig_mcut Sbx_dyn_sens_map_h Sbx_rdn_sens_map_h Sbx_mf_sens_map_h Sbx_cf_sens_map_h Sbx_dyn_sens_map_l Sbx_rdn_sens_map_l Sbx_mf_sens_map_l Sbx_cf_sens_map_l Sbx_dyn_sens_mat_h Sbx_rdn_sens_mat_h Sbx_mf_sens_mat_h Sbx_cf_sens_mat_h Sbx_dyn_sens_mat_l Sbx_rdn_sens_mat_l Sbx_mf_sens_mat_l Sbx_cf_sens_mat_l Sbx_dyn_sens_spg_h Sbx_rdn_sens_spg_h Sbx_mf_sens_spg_h Sbx_cf_sens_spg_h Sbx_dyn_sens_spg_l Sbx_rdn_sens_spg_l Sbx_mf_sens_spg_l Sbx_cf_sens_spg_l Sbx_dyn_sens_tco_h Sbx_rdn_sens_tco_h Sbx_mf_sens_tco_h Sbx_cf_sens_tco_h Sbx_dyn_sens_tco_l Sbx_rdn_sens_tco_l Sbx_mf_sens_tco_l Sbx_cf_sens_tco_l Sbx_dyn_sens_tco_sig_mcut Sbx_rdn_sens_tco_sig_mcut Sbx_mf_sens_tco_sig_mcut Sbx_cf_sens_tco_sig_mcut Sbx_dyn_sfty_tq_chr Sbx_rdn_sfty_tq_chr Sbx_mf_sfty_tq_chr Sbx_cf_sfty_tq_chr Sbx_dyn_sfty_tq_clc_chr Sbx_rdn_sfty_tq_clc_chr Sbx_mf_sfty_tq_clc_chr Sbx_cf_sfty_tq_clc_chr Sbx_dyn_sfty_tq_lih_chr Sbx_rdn_sfty_tq_lih_chr Sbx_mf_sfty_tq_lih_chr Sbx_cf_sfty_tq_lih_chr Sbx_dyn_spg_chr Sbx_rdn_spg_chr Sbx_mf_spg_chr Sbx_cf_spg_chr Sbx_dyn_spg_oor Sbx_rdn_spg_oor Sbx_mf_spg_oor Sbx_cf_spg_oor Sbx_dyn_spg_reg_apl_down Sbx_rdn_spg_reg_apl_down Sbx_mf_spg_reg_apl_down Sbx_cf_spg_reg_apl_down Sbx_dyn_spg_reg_apl_up Sbx_rdn_spg_reg_apl_up Sbx_mf_spg_reg_apl_up Sbx_cf_spg_reg_apl_up Sbx_dyn_tlz_ad_b_cpt Sbx_rdn_tlz_ad_b_cpt Sbx_mf_tlz_ad_b_cpt Sbx_cf_tlz_ad_b_cpt Sbx_dyn_vb_clc_chr Sbx_rdn_vb_clc_chr Sbx_mf_vb_clc_chr Sbx_cf_vb_clc_chr Sbx_dyn_vb_h Sbx_rdn_vb_h Sbx_mf_vb_h Sbx_cf_vb_h Sbx_dyn_vb_l Sbx_rdn_vb_l Sbx_mf_vb_l Sbx_cf_vb_l Sbx_dyn_vb_rly_oc_scg Sbx_rdn_vb_rly_oc_scg Sbx_mf_vb_rly_oc_scg Sbx_cf_vb_rly_oc_scg Sbx_dyn_vb_rly_scw Sbx_rdn_vb_rly_scw Sbx_mf_vb_rly_scw Sbx_cf_vb_rly_scw Sbx_dyn_wgc_oc Sbx_rdn_wgc_oc Sbx_mf_wgc_oc Sbx_cf_wgc_oc Sbx_dyn_wgc_scg Sbx_rdn_wgc_scg Sbx_mf_wgc_scg Sbx_cf_wgc_scg Sbx_dyn_wgc_scw Sbx_rdn_wgc_scw Sbx_mf_wgc_scw Sbx_cf_wgc_scw Sbx_dyn_wpmp_tcr_blk Sbx_rdn_wpmp_tcr_blk Sbx_mf_wpmp_tcr_blk Sbx_cf_wpmp_tcr_blk Sbx_dyn_wpmp_tcr_oc Sbx_rdn_wpmp_tcr_oc Sbx_mf_wpmp_tcr_oc Sbx_cf_wpmp_tcr_oc Sbx_dyn_wpmp_tcr_scg Sbx_rdn_wpmp_tcr_scg Sbx_mf_wpmp_tcr_scg Sbx_cf_wpmp_tcr_scg Sbx_dyn_wpmp_tcr_scw Sbx_rdn_wpmp_tcr_scw Sbx_mf_wpmp_tcr_scw Sbx_cf_wpmp_tcr_scw Vxx_dfctr_esp_data_chr Vxx_rdn_esp_data_chr Vbx_cf_esp_data_chr Vbx_clf_esp_data_chr Vbx_df_old_esp_data_chr Vbx_dfctr_sat_esp_data_chr Vbx_rdn_esp_data_chr Vxx_dtc_stt_esp_data_chr Vxx_dfctr_esp_data_seq_ctr Vxx_rdn_esp_data_seq_ctr Vbx_cf_esp_data_seq_ctr Vbx_clf_esp_data_seq_ctr Vbx_df_old_esp_data_seq_ctr Vbx_dfctr_sat_esp_data_seq_ctr Vbx_rdn_esp_data_seq_ctr Vxx_dtc_stt_esp_data_seq_ctr Vxx_dfctr_esp_no_frm Vxx_rdn_esp_no_frm Vbx_cf_esp_no_frm Vbx_clf_esp_no_frm Vbx_df_old_esp_no_frm Vbx_dfctr_sat_esp_no_frm Vbx_rdn_esp_no_frm Vxx_dtc_stt_esp_no_frm Vxx_dfctr_fsys_cpt Vxx_rdn_fsys_cpt Vbx_cf_fsys_cpt Vbx_clf_fsys_cpt Vbx_df_old_fsys_cpt Vbx_dfctr_sat_fsys_cpt Vbx_rdn_fsys_cpt Vxx_dtc_stt_fsys_cpt Vxx_dfctr_gas_pump_oc Vxx_rdn_gas_pump_oc Vbx_cf_gas_pump_oc Vbx_clf_gas_pump_oc Vbx_df_old_gas_pump_oc Vbx_dfctr_sat_gas_pump_oc Vbx_rdn_gas_pump_oc Vxx_dtc_stt_gas_pump_oc Vxx_dfctr_gas_pump_scg Vxx_rdn_gas_pump_scg Vbx_cf_gas_pump_scg Vbx_clf_gas_pump_scg Vbx_df_old_gas_pump_scg Vbx_dfctr_sat_gas_pump_scg Vbx_rdn_gas_pump_scg Vxx_dtc_stt_gas_pump_scg Vxx_dfctr_gas_pump_scw Vxx_rdn_gas_pump_scw Vbx_cf_gas_pump_scw Vbx_clf_gas_pump_scw Vbx_df_old_gas_pump_scw Vbx_dfctr_sat_gas_pump_scw Vbx_rdn_gas_pump_scw Vxx_dtc_stt_gas_pump_scw Vxx_dfctr_igc_1_oc Vxx_rdn_igc_1_oc Vbx_cf_igc_1_oc Vbx_clf_igc_1_oc Vbx_df_old_igc_1_oc Vbx_dfctr_sat_igc_1_oc Vbx_rdn_igc_1_oc Vxx_dtc_stt_igc_1_oc Vxx_dfctr_igc_1_scg Vxx_rdn_igc_1_scg Vbx_cf_igc_1_scg Vbx_clf_igc_1_scg Vbx_df_old_igc_1_scg Vbx_dfctr_sat_igc_1_scg Vbx_rdn_igc_1_scg Vxx_dtc_stt_igc_1_scg Vxx_dfctr_igc_1_scw Vxx_rdn_igc_1_scw Vbx_cf_igc_1_scw Vbx_clf_igc_1_scw Vbx_df_old_igc_1_scw Vbx_dfctr_sat_igc_1_scw Vbx_rdn_igc_1_scw Vxx_dtc_stt_igc_1_scw Vxx_dfctr_igc_2_oc Vxx_rdn_igc_2_oc Vbx_cf_igc_2_oc Vbx_clf_igc_2_oc Vbx_df_old_igc_2_oc Vbx_dfctr_sat_igc_2_oc Vbx_rdn_igc_2_oc Vxx_dtc_stt_igc_2_oc Vxx_dfctr_igc_2_scg Vxx_rdn_igc_2_scg Vbx_cf_igc_2_scg Vbx_clf_igc_2_scg Vbx_df_old_igc_2_scg Vbx_dfctr_sat_igc_2_scg Vbx_rdn_igc_2_scg Vxx_dtc_stt_igc_2_scg Vxx_dfctr_igc_2_scw Vxx_rdn_igc_2_scw Vbx_cf_igc_2_scw Vbx_clf_igc_2_scw Vbx_df_old_igc_2_scw Vbx_dfctr_sat_igc_2_scw Vbx_rdn_igc_2_scw Vxx_dtc_stt_igc_2_scw Vxx_dfctr_igc_3_oc Vxx_rdn_igc_3_oc Vbx_cf_igc_3_oc Vbx_clf_igc_3_oc Vbx_df_old_igc_3_oc Vbx_dfctr_sat_igc_3_oc Vbx_rdn_igc_3_oc Vxx_dtc_stt_igc_3_oc Vxx_dfctr_igc_3_scg Vxx_rdn_igc_3_scg Vbx_cf_igc_3_scg Vbx_clf_igc_3_scg Vbx_df_old_igc_3_scg Vbx_dfctr_sat_igc_3_scg Vbx_rdn_igc_3_scg Vxx_dtc_stt_igc_3_scg Vxx_dfctr_igc_3_scw Vxx_rdn_igc_3_scw Vbx_cf_igc_3_scw Vbx_clf_igc_3_scw Vbx_df_old_igc_3_scw Vbx_dfctr_sat_igc_3_scw Vbx_rdn_igc_3_scw Vxx_dtc_stt_igc_3_scw Vxx_dfctr_igc_4_oc Vxx_rdn_igc_4_oc Vbx_cf_igc_4_oc Vbx_clf_igc_4_oc Vbx_df_old_igc_4_oc Vbx_dfctr_sat_igc_4_oc Vbx_rdn_igc_4_oc Vxx_dtc_stt_igc_4_oc Vxx_dfctr_igc_4_scg Vxx_rdn_igc_4_scg Vbx_cf_igc_4_scg Vbx_clf_igc_4_scg Vbx_df_old_igc_4_scg Vbx_dfctr_sat_igc_4_scg Vbx_rdn_igc_4_scg Vxx_dtc_stt_igc_4_scg Vxx_dfctr_igc_4_scw Vxx_rdn_igc_4_scw Vbx_cf_igc_4_scw Vbx_clf_igc_4_scw Vbx_df_old_igc_4_scw Vbx_dfctr_sat_igc_4_scw Vbx_rdn_igc_4_scw Vxx_dtc_stt_igc_4_scw Vxx_dfctr_in_cam_chr Vxx_rdn_in_cam_chr Vbx_cf_in_cam_chr Vbx_clf_in_cam_chr Vbx_df_old_in_cam_chr Vbx_dfctr_sat_in_cam_chr Vbx_rdn_in_cam_chr Vxx_dtc_stt_in_cam_chr Vxx_dfctr_in_cam_crk_cmp Vxx_rdn_in_cam_crk_cmp Vbx_cf_in_cam_crk_cmp Vbx_clf_in_cam_crk_cmp Vbx_df_old_in_cam_crk_cmp Vbx_dfctr_sat_in_cam_crk_cmp Vbx_rdn_in_cam_crk_cmp Vxx_dtc_stt_in_cam_crk_cmp Vxx_dfctr_in_cam_cyc Vxx_rdn_in_cam_cyc Vbx_cf_in_cam_cyc Vbx_clf_in_cam_cyc Vbx_df_old_in_cam_cyc Vbx_dfctr_sat_in_cam_cyc Vbx_rdn_in_cam_cyc Vxx_dtc_stt_in_cam_cyc Vxx_dfctr_in_cam_no_sig Vxx_rdn_in_cam_no_sig Vbx_cf_in_cam_no_sig Vbx_clf_in_cam_no_sig Vbx_df_old_in_cam_no_sig Vbx_dfctr_sat_in_cam_no_sig Vbx_rdn_in_cam_no_sig Vxx_dtc_stt_in_cam_no_sig Vxx_dfctr_in_cam_nok Vxx_rdn_in_cam_nok Vbx_cf_in_cam_nok Vbx_clf_in_cam_nok Vbx_df_old_in_cam_nok Vbx_dfctr_sat_in_cam_nok Vbx_rdn_in_cam_nok Vxx_dtc_stt_in_cam_nok Vxx_dfctr_in_vvtc_ad Vxx_rdn_in_vvtc_ad Vbx_cf_in_vvtc_ad Vbx_clf_in_vvtc_ad Vbx_df_old_in_vvtc_ad Vbx_dfctr_sat_in_vvtc_ad Vbx_rdn_in_vvtc_ad Vxx_dtc_stt_in_vvtc_ad Vxx_dfctr_in_vvtc_blk Vxx_rdn_in_vvtc_blk Vbx_cf_in_vvtc_blk Vbx_clf_in_vvtc_blk Vbx_df_old_in_vvtc_blk Vbx_dfctr_sat_in_vvtc_blk Vbx_rdn_in_vvtc_blk Vxx_dtc_stt_in_vvtc_blk Vxx_dfctr_in_vvtc_dirt_lkg Vxx_rdn_in_vvtc_dirt_lkg Vbx_cf_in_vvtc_dirt_lkg Vbx_clf_in_vvtc_dirt_lkg Vbx_df_old_in_vvtc_dirt_lkg Vbx_dfctr_sat_in_vvtc_dirt_lkg Vbx_rdn_in_vvtc_dirt_lkg Vxx_dtc_stt_in_vvtc_dirt_lkg Vxx_dfctr_in_vvtc_sldv_oc Vxx_rdn_in_vvtc_sldv_oc Vbx_cf_in_vvtc_sldv_oc Vbx_clf_in_vvtc_sldv_oc Vbx_df_old_in_vvtc_sldv_oc Vbx_dfctr_sat_in_vvtc_sldv_oc Vbx_rdn_in_vvtc_sldv_oc Vxx_dtc_stt_in_vvtc_sldv_oc Vxx_dfctr_in_vvtc_sldv_scg Vxx_rdn_in_vvtc_sldv_scg Vbx_cf_in_vvtc_sldv_scg Vbx_clf_in_vvtc_sldv_scg Vbx_df_old_in_vvtc_sldv_scg Vbx_dfctr_sat_in_vvtc_sldv_scg Vbx_rdn_in_vvtc_sldv_scg Vxx_dtc_stt_in_vvtc_sldv_scg Vxx_dfctr_in_vvtc_sldv_scw Vxx_rdn_in_vvtc_sldv_scw Vbx_cf_in_vvtc_sldv_scw Vbx_clf_in_vvtc_sldv_scw Vbx_df_old_in_vvtc_sldv_scw Vbx_dfctr_sat_in_vvtc_sldv_scw Vbx_rdn_in_vvtc_sldv_scw Vxx_dtc_stt_in_vvtc_sldv_scw Vxx_dfctr_inj1_oc Vxx_rdn_inj1_oc Vbx_cf_inj1_oc Vbx_clf_inj1_oc Vbx_df_old_inj1_oc Vbx_dfctr_sat_inj1_oc Vbx_rdn_inj1_oc Vxx_dtc_stt_inj1_oc Vxx_dfctr_inj1_scg Vxx_rdn_inj1_scg Vbx_cf_inj1_scg Vbx_clf_inj1_scg Vbx_df_old_inj1_scg Vbx_dfctr_sat_inj1_scg Vbx_rdn_inj1_scg Vxx_dtc_stt_inj1_scg Vxx_dfctr_inj1_scw Vxx_rdn_inj1_scw Vbx_cf_inj1_scw Vbx_clf_inj1_scw Vbx_df_old_inj1_scw /end OUT_MEASUREMENT
/end FUNCTION
/end MODULE
/end PROJECT
