/begin PROJECT X12C_KH3DT_DI_NAM_R/C ""
/begin HEADER "" /* key HEADER ++ "comment" に Par.scomment */ PROJECT_NO X12C_KH3DT_DI_NAM_R/C /* key PROJECT_NO ++ project number に car_eng_desti_lot */ VERSION "0KHDCFDZ7" /* key VERSION ++ version number に mProgver */ /end HEADER
/begin MODULE DIM ""
/begin MOD_COMMON "" ALIGNMENT_BYTE 1 ALIGNMENT_WORD 2 ALIGNMENT_LONG 4 ALIGNMENT_FLOAT32_IEEE 4 ALIGNMENT_FLOAT64_IEEE 4 DEPOSIT ABSOLUTE BYTE_ORDER MSB_FIRST /* ﾊﾞｲﾄｵｰﾀﾞｰがﾘﾌﾟﾚｰｽされる */ /end MOD_COMMON
/begin CHARACTERISTIC mDSSISC "ROM Const mDSSISC" VALUE 0x000084A5 REC_UBYTE_C 0 COMP_0101_S 0 1.9921875 /end CHARACTERISTIC
/begin CHARACTERISTIC mDSTLFC "ROM Const mDSTLFC" VALUE 0x000084A6 REC_UBYTE_C 0 COMP_0000 0 6375 /end CHARACTERISTIC
/begin CHARACTERISTIC mDSTLNH "ROM Const mDSTLNH" VALUE 0x000084A7 REC_UBYTE_C 0 COMP_0000 0 6375 /end CHARACTERISTIC
/begin CHARACTERISTIC mDSTLNL "ROM Const mDSTLNL" VALUE 0x000084A8 REC_UBYTE_C 0 COMP_0000 0 6375 /end CHARACTERISTIC
/begin CHARACTERISTIC mDSTLRC "ROM Const mDSTLRC" VALUE 0x000084A9 REC_UBYTE_C 0 COMP_0000 0 6375 /end CHARACTERISTIC
/begin CHARACTERISTIC mDSTLTM "ROM Const mDSTLTM" VALUE 0x000090EC REC_UWORD_C 0 COMP_0014 0 655350 /end CHARACTERISTIC
/begin CHARACTERISTIC mDSTLUP "ROM Const mDSTLUP" VALUE 0x000084AA REC_UBYTE_C 0 COMP_0120 0 255 /end CHARACTERISTIC
/begin CHARACTERISTIC mDSUMPL "ROM Const mDSUMPL" VALUE 0x000084AB REC_UBYTE_C 0 COMP_0014 0 2550 /end CHARACTERISTIC
/begin CHARACTERISTIC mDTDTMR "ROM Const mDTDTMR" VALUE 0x000084AC REC_UBYTE_C 0 COMP_0014 0 2550 /end CHARACTERISTIC
/begin CHARACTERISTIC mDTDTMRU "ROM Const mDTDTMRU" VALUE 0x000084AD REC_UBYTE_C 0 COMP_0014 0 2550 /end CHARACTERISTIC
/begin CHARACTERISTIC mDTETC "ROM Const mDTETC" VALUE 0x000084AE REC_UBYTE_C 0 COMP_0014 0 2550 /end CHARACTERISTIC
/begin CHARACTERISTIC mDTFCAP "ROM Const mDTFCAP" VALUE 0x000090EE REC_UWORD_C 0 COMP_0005 0 7208.85 /end CHARACTERISTIC
/begin CHARACTERISTIC mDTFCDN "ROM Const mDTFCDN" VALUE 0x000084AF REC_UBYTE_C 0 COMP_0000 0 6375 /end CHARACTERISTIC
/begin CHARACTERISTIC mDTFCN "ROM Const mDTFCN" VALUE 0x000084B0 REC_UBYTE_C 0 COMP_0020 0 12750 /end CHARACTERISTIC
/begin CHARACTERISTIC mDTFCND "ROM Const mDTFCND" VALUE 0x00008E2E REC_SWORD_C 0 COMP_0003_S -6553.6 6553.4 /end CHARACTERISTIC
/begin CHARACTERISTIC mDTFCTW "ROM Const mDTFCTW" VALUE 0x000084B1 REC_UBYTE_C 0 COMP_0035 -50 205 /end CHARACTERISTIC
/begin CHARACTERISTIC mDTFNG1 "ROM Const mDTFNG1" VALUE 0x000084B2 REC_UBYTE_C 0 COMP_0013 0 255 /end CHARACTERISTIC
/begin CHARACTERISTIC mDTFNG2 "ROM Const mDTFNG2" VALUE 0x000084B3 REC_UBYTE_C 0 COMP_0013 0 255 /end CHARACTERISTIC
/begin CHARACTERISTIC mDTLOAD "ROM Const mDTLOAD" VALUE 0x000084B4 REC_UBYTE_C 0 COMP_0014 0 2550 /end CHARACTERISTIC
/begin CHARACTERISTIC mDTLVSP "ROM Const mDTLVSP" VALUE 0x000084B5 REC_UBYTE_C 0 COMP_0007 0 510 /end CHARACTERISTIC
/begin CHARACTERISTIC mDTMR1 "ROM Const mDTMR1" VALUE 0x000084B6 REC_UBYTE_C 0 COMP_0008 0 25500 /end CHARACTERISTIC
/begin CHARACTERISTIC mDTNSTD "ROM Const mDTNSTD" VALUE 0x000084B7 REC_UBYTE_C 0 COMP_0006 0 3187.5 /end CHARACTERISTIC
/begin CHARACTERISTIC mDTNSTN "ROM Const mDTNSTN" VALUE 0x000084B8 REC_UBYTE_C 0 COMP_0006 0 3187.5 /end CHARACTERISTIC
/begin CHARACTERISTIC mDTOTE1 "ROM Const mDTOTE1" VALUE 0x000084B9 REC_UBYTE_C 0 COMP_0003 0 255 /end CHARACTERISTIC
/begin CHARACTERISTIC mDTOTE2 "ROM Const mDTOTE2" VALUE 0x000084BA REC_UBYTE_C 0 COMP_0003 0 255 /end CHARACTERISTIC
/begin CHARACTERISTIC mDTPCAT "ROM Const mDTPCAT" VALUE 0x000084BB REC_UBYTE_C 0 COMP_0124 0 31.875 /end CHARACTERISTIC
/begin CHARACTERISTIC mDTPOSL "ROM Const mDTPOSL" VALUE 0x000084BC REC_UBYTE_C 0 COMP_0005 0 28.05 /end CHARACTERISTIC
/begin CHARACTERISTIC mDTPOSLK "ROM Const mDTPOSLK" VALUE 0x000084BD REC_UBYTE_C 0 COMP_0005 0 28.05 /end CHARACTERISTIC
/begin CHARACTERISTIC mDTQD "ROM Const mDTQD" VALUE 0x000090F0 REC_UWORD_C 0 COMP_0083 0 255.99609375 /end CHARACTERISTIC
/begin CHARACTERISTIC mDTRTMS "ROM Const mDTRTMS" VALUE 0x000090F2 REC_UWORD_C 0 COMP_0057 0 3.999941832 /end CHARACTERISTIC
/begin CHARACTERISTIC mDTVCTH "ROM Const mDTVCTH" VALUE 0x000084BF REC_UBYTE_C 0 COMP_0002 0 89.25 /end CHARACTERISTIC
/begin CHARACTERISTIC mDTVHOS "ROM Const mDTVHOS" VALUE 0x000084C0 REC_UBYTE_C 0 COMP_0002 0 89.25 /end CHARACTERISTIC
/begin CHARACTERISTIC mDTVHOST "ROM Const mDTVHOST" VALUE 0x000084C1 REC_UBYTE_C 0 COMP_0008 0 25500 /end CHARACTERISTIC
/begin CHARACTERISTIC mDTVNGC "ROM Const mDTVNGC" VALUE 0x000084C2 REC_UBYTE_C 0 COMP_0016 0 255 /end CHARACTERISTIC
/begin CHARACTERISTIC mDTVODA "ROM Const mDTVODA" VALUE 0x000084C3 REC_UBYTE_C 0 COMP_0077 0 28.05 /end CHARACTERISTIC
/begin CHARACTERISTIC mDTVOGH "ROM Const mDTVOGH" VALUE 0x000084C4 REC_UBYTE_C 0 COMP_0129 -44.8 44.45 /end CHARACTERISTIC
/begin CHARACTERISTIC mDTVOGL "ROM Const mDTVOGL" VALUE 0x000084C5 REC_UBYTE_C 0 COMP_0129 -44.8 44.45 /end CHARACTERISTIC
/begin CHARACTERISTIC mDTVOGN "ROM Const mDTVOGN" VALUE 0x000084C6 REC_UBYTE_C 0 COMP_0016 0 255 /end CHARACTERISTIC
/begin CHARACTERISTIC mDTVOGT "ROM Const mDTVOGT" VALUE 0x000084C7 REC_UBYTE_C 0 COMP_0014 0 2550 /end CHARACTERISTIC
/begin CHARACTERISTIC mDTVOMJ "ROM Const mDTVOMJ" VALUE 0x000084C8 REC_UBYTE_C 0 COMP_0026_S 0 89.25 /end CHARACTERISTIC
/begin CHARACTERISTIC mDTVOPJ "ROM Const mDTVOPJ" VALUE 0x000084C9 REC_UBYTE_C 0 COMP_0026_S 0 89.25 /end CHARACTERISTIC
/begin CHARACTERISTIC mDTVOSC "ROM Const mDTVOSC" VALUE 0x000084CA REC_UBYTE_C 0 COMP_0002 0 89.25 /end CHARACTERISTIC
/begin CHARACTERISTIC mDTVOSCT "ROM Const mDTVOSCT" VALUE 0x000084CB REC_UBYTE_C 0 COMP_0008 0 25500 /end CHARACTERISTIC
/begin CHARACTERISTIC mDTVQLSA "ROM Const mDTVQLSA" VALUE 0x000084CC REC_UBYTE_C 0 COMP_0041 0 0.204 /end CHARACTERISTIC
/begin CHARACTERISTIC mDTVRVH "ROM Const mDTVRVH" VALUE 0x000084CD REC_UBYTE_C 0 COMP_0054 0 5100 /end CHARACTERISTIC
/begin CHARACTERISTIC mDTVRVL "ROM Const mDTVRVL" VALUE 0x000084CE REC_UBYTE_C 0 COMP_0054 0 5100 /end CHARACTERISTIC
/begin CHARACTERISTIC mDTWLUI "ROM Const mDTWLUI" VALUE 0x000084CF REC_UBYTE_C 0 COMP_0035 -50 205 /end CHARACTERISTIC
/begin CHARACTERISTIC mDTWLUI2 "ROM Const mDTWLUI2" VALUE 0x000084D0 REC_UBYTE_C 0 COMP_0035 -50 205 /end CHARACTERISTIC
/begin CHARACTERISTIC mDTXTQD "ROM Const mDTXTQD" VALUE 0x000090F4 REC_UWORD_C 0 COMP_0083 0 255.99609375 /end CHARACTERISTIC
/begin CHARACTERISTIC mDUBUVB "ROM Const mDUBUVB" VALUE 0x000084D2 REC_UBYTE_C 0 COMP_0033 0 20400 /end CHARACTERISTIC
/begin CHARACTERISTIC mDUMPNG2 "ROM Const mDUMPNG2" VALUE 0x000090F6 REC_UWORD_C 0 COMP_0456 0 1.999970916 /end CHARACTERISTIC
/begin CHARACTERISTIC mDUTYOFS "ROM Const mDUTYOFS" VALUE 0x000084D3 REC_UBYTE_C 0 COMP_0027 0 255 /end CHARACTERISTIC
/begin CHARACTERISTIC mDUTYOFS2 "ROM Const mDUTYOFS2" VALUE 0x000090F8 REC_UWORD_C 0 COMP_0047 0 32767.5 /end CHARACTERISTIC
/begin CHARACTERISTIC mDUTYSLP "ROM Const mDUTYSLP" VALUE 0x000084D4 REC_UBYTE_C 0 COMP_0102_S 0 2.55 /end CHARACTERISTIC
/begin CHARACTERISTIC mDUTYSLP2 "ROM Const mDUTYSLP2" VALUE 0x000084D5 REC_UBYTE_C 0 COMP_0103_S 0 0.255 /end CHARACTERISTIC
/begin CHARACTERISTIC mDUVBDLY "ROM Const mDUVBDLY" VALUE 0x000084D6 REC_UBYTE_C 0 COMP_0014 0 2550 /end CHARACTERISTIC
/begin CHARACTERISTIC mDVADV "ROM Const mDVADV" VALUE 0x0000822C REC_SBYTE_C 0 COMP_0018 -128 127 /end CHARACTERISTIC
/begin CHARACTERISTIC mDVBBL "ROM Const mDVBBL" VALUE 0x000084D7 REC_UBYTE_C 0 COMP_0104_S 0 51 /end CHARACTERISTIC
/begin CHARACTERISTIC mDVBCS "ROM Const mDVBCS" VALUE 0x000084D8 REC_UBYTE_C 0 COMP_0033 0 20400 /end CHARACTERISTIC
/begin CHARACTERISTIC mDVBDWN "ROM Const mDVBDWN" VALUE 0x000084D9 REC_UBYTE_C 0 COMP_0105_S 0 20400 /end CHARACTERISTIC
/begin CHARACTERISTIC mDVBFUELH "ROM Const mDVBFUELH" VALUE 0x000084DA REC_UBYTE_C 0 COMP_0104_S 0 51 /end CHARACTERISTIC
/begin CHARACTERISTIC mDVBHLH "ROM Const mDVBHLH" VALUE 0x000084DB REC_UBYTE_C 0 COMP_0104_S 0 51 /end CHARACTERISTIC
/begin CHARACTERISTIC mDVBHLL "ROM Const mDVBHLL" VALUE 0x000084DC REC_UBYTE_C 0 COMP_0104_S 0 51 /end CHARACTERISTIC
/begin CHARACTERISTIC mDVBLOW "ROM Const mDVBLOW" VALUE 0x000084DD REC_UBYTE_C 0 COMP_0104_S 0 51 /end CHARACTERISTIC
/begin CHARACTERISTIC mDVBM4WD "ROM Const mDVBM4WD" VALUE 0x000084DE REC_UBYTE_C 0 COMP_0104_S 0 51 /end CHARACTERISTIC
/begin CHARACTERISTIC mDVBMID "ROM Const mDVBMID" VALUE 0x000084DF REC_UBYTE_C 0 COMP_0104_S 0 51 /end CHARACTERISTIC
/begin CHARACTERISTIC mDVBMID2 "ROM Const mDVBMID2" VALUE 0x000084E0 REC_UBYTE_C 0 COMP_0104_S 0 51 /end CHARACTERISTIC
/begin CHARACTERISTIC mDVBOVC "ROM Const mDVBOVC" VALUE 0x000084E1 REC_UBYTE_C 0 COMP_0104_S 0 51 /end CHARACTERISTIC
/begin CHARACTERISTIC mDVBREV "ROM Const mDVBREV" VALUE 0x000084E2 REC_UBYTE_C 0 COMP_0105_S 0 20400 /end CHARACTERISTIC
/begin CHARACTERISTIC mDVBTAS "ROM Const mDVBTAS" VALUE 0x000084E3 REC_UBYTE_C 0 COMP_0104_S 0 51 /end CHARACTERISTIC
/begin CHARACTERISTIC mDVBUPP "ROM Const mDVBUPP" VALUE 0x000084E4 REC_UBYTE_C 0 COMP_0105_S 0 20400 /end CHARACTERISTIC
/begin CHARACTERISTIC mDVBWIP "ROM Const mDVBWIP" VALUE 0x000084E5 REC_UBYTE_C 0 COMP_0104_S 0 51 /end CHARACTERISTIC
/begin CHARACTERISTIC mDVFBYA "ROM Const mDVFBYA" VALUE 0x000090FA REC_UWORD_C 0 COMP_0106_S 0 3.997635 /end CHARACTERISTIC
/begin CHARACTERISTIC mDVFUELTM "ROM Const mDVFUELTM" VALUE 0x000084E6 REC_UBYTE_C 0 COMP_0014 0 2550 /end CHARACTERISTIC
/begin CHARACTERISTIC mDVKADV "ROM Const mDVKADV" VALUE 0x0000822D REC_SBYTE_C 0 COMP_0018 -128 127 /end CHARACTERISTIC
/begin CHARACTERISTIC mDVKTRM "ROM Const mDVKTRM" VALUE 0x000084E7 REC_UBYTE_C 0 COMP_0044 0 1.9921875 /end CHARACTERISTIC
/begin CHARACTERISTIC mDVOMSK "ROM Const mDVOMSK" VALUE 0x000084E8 REC_UBYTE_C 0 COMP_0015_S 0 25.5 /end CHARACTERISTIC
/begin CHARACTERISTIC mDVRONG "ROM Const mDVRONG" VALUE 0x000084E9 REC_UBYTE_C 0 COMP_0104 0 2550 /end CHARACTERISTIC
/begin CHARACTERISTIC mDVSPASC2 "ROM Const mDVSPASC2" VALUE 0x000096C4 REC_SLONG_C 0 COMP_0107_S -1843.20024746394 1843.20024660563 /end CHARACTERISTIC
/begin CHARACTERISTIC mDVSPASCD "ROM Const mDVSPASCD" VALUE 0x000096C8 REC_SLONG_C 0 COMP_0107_S -1843.20024746394 1843.20024660563 /end CHARACTERISTIC
/begin CHARACTERISTIC mDVTIMH "ROM Const mDVTIMH" VALUE 0x000084EA REC_UBYTE_C 0 COMP_0190 0 510 /end CHARACTERISTIC
/begin CHARACTERISTIC mDVTIMS "ROM Const mDVTIMS" VALUE 0x000084EB REC_UBYTE_C 0 COMP_0190 0 510 /end CHARACTERISTIC
/begin CHARACTERISTIC mDVVTC "ROM Const mDVVTC" VALUE 0x000084EC REC_UBYTE_C 0 COMP_0256 -64 63.5 /end CHARACTERISTIC
/begin CHARACTERISTIC mDVVTCEN "ROM Const mDVVTCEN" VALUE 0x000090FC REC_UWORD_C 0 COMP_0108_S -16384 16383.5 /end CHARACTERISTIC
/begin CHARACTERISTIC mDWLDEGup "ROM Const mDWLDEGup" VALUE 0x000084ED REC_UBYTE_C 0 COMP_0109_S 0 2.988294 /end CHARACTERISTIC
/begin CHARACTERISTIC mDWLDEGus "ROM Const mDWLDEGus" VALUE 0x000084EE REC_UBYTE_C 0 COMP_0110_S 0 7.96875 /end CHARACTERISTIC
/begin CHARACTERISTIC mDWLHOS "ROM Const mDWLHOS" VALUE 0x000084EF REC_UBYTE_C 0 COMP_0111_S 0 9.9609375 /end CHARACTERISTIC
/begin CHARACTERISTIC mDWLNEMAX "ROM Const mDWLNEMAX" VALUE 0x000084F0 REC_UBYTE_C 0 COMP_0020 0 12750 /end CHARACTERISTIC
/begin CHARACTERISTIC mDWLNEMIN "ROM Const mDWLNEMIN" VALUE 0x000084F1 REC_UBYTE_C 0 COMP_0020 0 12750 /end CHARACTERISTIC
/begin CHARACTERISTIC mDWLPNG1 "ROM Const mDWLPNG1" VALUE 0x00008E30 REC_SWORD_C 0 COMP_0002_S -32768 32767 /end CHARACTERISTIC
/begin CHARACTERISTIC mDWLPNN2 "ROM Const mDWLPNN2" VALUE 0x00008E32 REC_SWORD_C 0 COMP_0002_S -32768 32767 /end CHARACTERISTIC
/begin CHARACTERISTIC mDWLPNP2 "ROM Const mDWLPNP2" VALUE 0x00008E34 REC_SWORD_C 0 COMP_0002_S -32768 32767 /end CHARACTERISTIC
/begin CHARACTERISTIC mDWLTIM "ROM Const mDWLTIM" VALUE 0x000084F2 REC_UBYTE_C 0 COMP_0136 0 5.1 /end CHARACTERISTIC
/begin CHARACTERISTIC mDWLVBMIN "ROM Const mDWLVBMIN" VALUE 0x000084F3 REC_UBYTE_C 0 COMP_0026 0 20400 /end CHARACTERISTIC
/begin CHARACTERISTIC mDWNSP "ROM Const mDWNSP" VALUE 0x000084F4 REC_UBYTE_C 0 COMP_0137 0 255 /end CHARACTERISTIC
/begin CHARACTERISTIC mDWPTM1 "ROM Const mDWPTM1" VALUE 0x000084F5 REC_UBYTE_C 0 COMP_0008 0 25500 /end CHARACTERISTIC
/begin CHARACTERISTIC mDWPTMN2 "ROM Const mDWPTMN2" VALUE 0x000084F6 REC_UBYTE_C 0 COMP_0008 0 25500 /end CHARACTERISTIC
/begin CHARACTERISTIC mDWPTMP2 "ROM Const mDWPTMP2" VALUE 0x000084F7 REC_UBYTE_C 0 COMP_0008 0 25500 /end CHARACTERISTIC
/begin CHARACTERISTIC mDYCKLU "ROM Const mDYCKLU" VALUE 0x000084F8 REC_UBYTE_C 0 COMP_0014 0 2550 /end CHARACTERISTIC
/begin CHARACTERISTIC mDYHTMP "ROM Const mDYHTMP" VALUE 0x000084F9 REC_UBYTE_C 0 COMP_0049 0 255 /end CHARACTERISTIC
/begin CHARACTERISTIC mEBATOK "ROM Const mEBATOK" VALUE 0x000090FE REC_UWORD_C 0 COMP_0015_S 0 6553.5 /end CHARACTERISTIC
/begin CHARACTERISTIC mECOIAHYS "ROM Const mECOIAHYS" VALUE 0x000084FA REC_UBYTE_C 0 COMP_0005 0 28.05 /end CHARACTERISTIC
/begin CHARACTERISTIC mECOICKTM "ROM Const mECOICKTM" VALUE 0x000084FB REC_UBYTE_C 0 COMP_0008 0 25500 /end CHARACTERISTIC
/begin CHARACTERISTIC mECOITIM "ROM Const mECOITIM" VALUE 0x000084FC REC_UBYTE_C 0 COMP_0008 0 25500 /end CHARACTERISTIC
/begin CHARACTERISTIC mECOIVHYS "ROM Const mECOIVHYS" VALUE 0x000084FD REC_UBYTE_C 0 COMP_0436 0 25.5 /end CHARACTERISTIC
/begin CHARACTERISTIC mECOLDLY "ROM Const mECOLDLY" VALUE 0x000084FE REC_UBYTE_C 0 COMP_0049 0 255 /end CHARACTERISTIC
/begin CHARACTERISTIC mECOLTWL "ROM Const mECOLTWL" VALUE 0x000084FF REC_UBYTE_C 0 COMP_0035 -50 205 /end CHARACTERISTIC
/begin CHARACTERISTIC mECOLVSHA "ROM Const mECOLVSHA" VALUE 0x00009100 REC_UWORD_C 0 COMP_0436 0 6553.5 /end CHARACTERISTIC
/begin CHARACTERISTIC mECOLVSPH "ROM Const mECOLVSPH" VALUE 0x00009102 REC_UWORD_C 0 COMP_0436 0 6553.5 /end CHARACTERISTIC
/begin CHARACTERISTIC mECOLVSPL "ROM Const mECOLVSPL" VALUE 0x00009104 REC_UWORD_C 0 COMP_0436 0 6553.5 /end CHARACTERISTIC
/begin CHARACTERISTIC mECOMBADS "ROM Const mECOMBADS" VALUE 0x00008500 REC_UBYTE_C 0 COMP_0068 0 255 /end CHARACTERISTIC
/begin CHARACTERISTIC mECOMFLT "ROM Const mECOMFLT" VALUE 0x00008501 REC_UBYTE_C 0 COMP_0045 0 1.9921875 /end CHARACTERISTIC
/begin CHARACTERISTIC mECOMHYS "ROM Const mECOMHYS" VALUE 0x00008502 REC_UBYTE_C 0 COMP_0388 0 25.5 /end CHARACTERISTIC
/begin CHARACTERISTIC mECOMMRGA "ROM Const mECOMMRGA" VALUE 0x00008503 REC_UBYTE_C 0 COMP_0005 0 28.05 /end CHARACTERISTIC
/begin CHARACTERISTIC mECOMMRGS "ROM Const mECOMMRGS" VALUE 0x00008504 REC_UBYTE_C 0 COMP_0068 0 255 /end CHARACTERISTIC
/begin CHARACTERISTIC mECOMOFSP "ROM Const mECOMOFSP" VALUE 0x00009106 REC_UWORD_C 0 COMP_0112_S 0 6553.5 /end CHARACTERISTIC
/begin CHARACTERISTIC mECOMVHYS "ROM Const mECOMVHYS" VALUE 0x00008505 REC_UBYTE_C 0 COMP_0436 0 25.5 /end CHARACTERISTIC
/begin CHARACTERISTIC mECOMVSPH "ROM Const mECOMVSPH" VALUE 0x00009108 REC_UWORD_C 0 COMP_0436 0 6553.5 /end CHARACTERISTIC
/begin CHARACTERISTIC mECOMVSPL "ROM Const mECOMVSPL" VALUE 0x0000910A REC_UWORD_C 0 COMP_0436 0 6553.5 /end CHARACTERISTIC
/begin CHARACTERISTIC mEDEONV "ROM Const mEDEONV" VALUE 0x000096CC REC_SLONG_C 0 COMP_0002_S -2147483648 2147483647 /end CHARACTERISTIC
/begin CHARACTERISTIC mEECDDCTC "ROM Const mEECDDCTC" VALUE 0x00008506 REC_UBYTE_C 0 COMP_0066_S 0 25.5 /end CHARACTERISTIC
/begin CHARACTERISTIC mEGPFLS "ROM Const mEGPFLS" VALUE 0x0000910C REC_UWORD_C 0 COMP_0140 0 32767.5 /end CHARACTERISTIC
/begin CHARACTERISTIC mEGRLMH "ROM Const mEGRLMH" VALUE 0x0000910E REC_UWORD_C 0 COMP_0144 0 31.999495335 /end CHARACTERISTIC
/begin CHARACTERISTIC mEGRLMH_S "ROM Const mEGRLMH_S" VALUE 0x00015A0A REC_UWORD_C 0 COMP_0144 0 31.999495335 /end CHARACTERISTIC
/begin CHARACTERISTIC mEGROPD "ROM Const mEGROPD" VALUE 0x00008508 REC_UBYTE_C 0 COMP_0013 0 255 /end CHARACTERISTIC
/begin CHARACTERISTIC mEGRS "ROM Const mEGRS" VALUE 0x00008509 REC_UBYTE_C 0 COMP_0095 0 398.4375 /end CHARACTERISTIC
/begin CHARACTERISTIC mEGRSG "ROM Const mEGRSG" VALUE 0x0000850A REC_UBYTE_C 0 COMP_0009 0 199.21875 /end CHARACTERISTIC
/begin CHARACTERISTIC mEGRSGOV "ROM Const mEGRSGOV" VALUE 0x0000850B REC_UBYTE_C 0 COMP_0141 0 49.8046875 /end CHARACTERISTIC
/begin CHARACTERISTIC mENGTMR "ROM Const mENGTMR" VALUE 0x0000850C REC_UBYTE_C 0 COMP_0013 0 255 /end CHARACTERISTIC
/begin CHARACTERISTIC mENGTYPE "ROM Const mENGTYPE" VALUE 0x0000850D REC_UBYTE_C 0 COMP_0068 0 255 /end CHARACTERISTIC
/begin CHARACTERISTIC mENLCNT "ROM Const mENLCNT" VALUE 0x00009110 REC_UWORD_C 0 COMP_0016 0 65535 /end CHARACTERISTIC
/begin CHARACTERISTIC mENSTDLYT "ROM Const mENSTDLYT" VALUE 0x0000850E REC_UBYTE_C 0 COMP_0008 0 25500 /end CHARACTERISTIC
/begin CHARACTERISTIC mENSTSP "ROM Const mENSTSP" VALUE 0x0000850F REC_UBYTE_C 0 COMP_0149 0 0.12451191 /end CHARACTERISTIC
/begin CHARACTERISTIC mEONVTFOK "ROM Const mEONVTFOK" VALUE 0x00008510 REC_UBYTE_C 0 COMP_0113_S 0 51 /end CHARACTERISTIC
/begin CHARACTERISTIC mEPBPCRH "ROM Const mEPBPCRH" VALUE 0x000096D0 REC_SLONG_C 0 COMP_0114_S -4194304 4194303.99804688 /end CHARACTERISTIC
/begin CHARACTERISTIC mEPBPCRL "ROM Const mEPBPCRL" VALUE 0x000096D4 REC_SLONG_C 0 COMP_0114_S -4194304 4194303.99804688 /end CHARACTERISTIC
/begin CHARACTERISTIC mEPBPCRTM "ROM Const mEPBPCRTM" VALUE 0x00008511 REC_UBYTE_C 0 COMP_0049 0 255 /end CHARACTERISTIC
/begin CHARACTERISTIC mEPLEKSL "ROM Const mEPLEKSL" VALUE 0x000096D8 REC_SLONG_C 0 COMP_0002_S -2147483648 2147483647 /end CHARACTERISTIC
/begin CHARACTERISTIC mEPLNTF "ROM Const mEPLNTF" VALUE 0x00008512 REC_UBYTE_C 0 COMP_0035 -50 205 /end CHARACTERISTIC
/begin CHARACTERISTIC mEPMWA "ROM Const mEPMWA" VALUE 0x00008513 REC_UBYTE_C 0 COMP_0019_S 0 1.000000095 /end CHARACTERISTIC
/begin CHARACTERISTIC mEPNGH1 "ROM Const mEPNGH1" VALUE 0x00008514 REC_UBYTE_C 0 COMP_0054 0 5100 /end CHARACTERISTIC
/begin CHARACTERISTIC mEPNGL1 "ROM Const mEPNGL1" VALUE 0x00008515 REC_UBYTE_C 0 COMP_0054 0 5100 /end CHARACTERISTIC
/begin CHARACTERISTIC mEPRISSL "ROM Const mEPRISSL" VALUE 0x000096DC REC_SLONG_C 0 COMP_0002_S -2147483648 2147483647 /end CHARACTERISTIC
/begin CHARACTERISTIC mEPSDCV "ROM Const mEPSDCV" VALUE 0x00008516 REC_UBYTE_C 0 COMP_0047 0 127.5 /end CHARACTERISTIC
/begin CHARACTERISTIC mEPSHYS "ROM Const mEPSHYS" VALUE 0x00008517 REC_UBYTE_C 0 COMP_0045_S 0 255 /end CHARACTERISTIC
/begin CHARACTERISTIC mEPSSW "ROM Const mEPSSW" VALUE 0x00008518 REC_UBYTE_C 0 COMP_0045_S 0 255 /end CHARACTERISTIC
/begin CHARACTERISTIC mERRTIM "ROM Const mERRTIM" VALUE 0x00008519 REC_UBYTE_C 0 COMP_0008 0 25500 /end CHARACTERISTIC
/begin CHARACTERISTIC mESPACKNG "ROM Const mESPACKNG" VALUE 0x0000851A REC_UBYTE_C 0 COMP_0014 0 2550 /end CHARACTERISTIC
/begin CHARACTERISTIC mESPLNKNG "ROM Const mESPLNKNG" VALUE 0x0000851B REC_UBYTE_C 0 COMP_0014 0 2550 /end CHARACTERISTIC
/begin CHARACTERISTIC mESRPML "ROM Const mESRPML" VALUE 0x0000851C REC_UBYTE_C 0 COMP_0006 0 3187.5 /end CHARACTERISTIC
/begin CHARACTERISTIC mESTCTDC "ROM Const mESTCTDC" VALUE 0x000096E0 REC_SLONG_C 0 COMP_0115_S -214748.3648 214748.3647 /end CHARACTERISTIC
/begin CHARACTERISTIC mETHSJDE "ROM Const mETHSJDE" VALUE 0x0000851E REC_UBYTE_C 0 COMP_0013 0 255 /end CHARACTERISTIC
/begin CHARACTERISTIC mETNLCD "ROM Const mETNLCD" VALUE 0x0000851F REC_UBYTE_C 0 COMP_0047 0 127.5 /end CHARACTERISTIC
/begin CHARACTERISTIC mETWIHF "ROM Const mETWIHF" VALUE 0x00008520 REC_UBYTE_C 0 COMP_0035 -50 205 /end CHARACTERISTIC
/begin CHARACTERISTIC mETWJD "ROM Const mETWJD" VALUE 0x00008521 REC_UBYTE_C 0 COMP_0013 0 255 /end CHARACTERISTIC
/begin CHARACTERISTIC mEVCLD1 "ROM Const mEVCLD1" VALUE 0x00008522 REC_UBYTE_C 0 COMP_0013 0 255 /end CHARACTERISTIC
/begin CHARACTERISTIC mEVCLD2 "ROM Const mEVCLD2" VALUE 0x00008523 REC_UBYTE_C 0 COMP_0013 0 255 /end CHARACTERISTIC
/begin CHARACTERISTIC mEVCLDY "ROM Const mEVCLDY" VALUE 0x00008524 REC_UBYTE_C 0 COMP_0049 0 255 /end CHARACTERISTIC
/begin CHARACTERISTIC mEVCLDY2 "ROM Const mEVCLDY2" VALUE 0x00008525 REC_UBYTE_C 0 COMP_0049 0 255 /end CHARACTERISTIC
/begin CHARACTERISTIC mEVCLDY3 "ROM Const mEVCLDY3" VALUE 0x00008526 REC_UBYTE_C 0 COMP_0049 0 255 /end CHARACTERISTIC
/begin CHARACTERISTIC mEVCLNG "ROM Const mEVCLNG" VALUE 0x00008527 REC_UBYTE_C 0 COMP_0047 0 127.5 /end CHARACTERISTIC
/begin CHARACTERISTIC mEVCNG1 "ROM Const mEVCNG1" VALUE 0x00008528 REC_UBYTE_C 0 COMP_0054 0 5100 /end CHARACTERISTIC
/begin CHARACTERISTIC mEVFTSL "ROM Const mEVFTSL" VALUE 0x00008529 REC_UBYTE_C 0 COMP_0035 -50 205 /end CHARACTERISTIC
/begin CHARACTERISTIC mEVKBLH "ROM Const mEVKBLH" VALUE 0x0000852A REC_UBYTE_C 0 COMP_0027 0 255 /end CHARACTERISTIC
/begin CHARACTERISTIC mEVKBLL "ROM Const mEVKBLL" VALUE 0x0000852B REC_UBYTE_C 0 COMP_0027 0 255 /end CHARACTERISTIC
/begin CHARACTERISTIC mEVLTAL "ROM Const mEVLTAL" VALUE 0x0000852C REC_UBYTE_C 0 COMP_0035 -50 205 /end CHARACTERISTIC
/begin CHARACTERISTIC mEVP3DY "ROM Const mEVP3DY" VALUE 0x0000852D REC_UBYTE_C 0 COMP_0295 0 25500 /end CHARACTERISTIC
/begin CHARACTERISTIC mEVP4DYA "ROM Const mEVP4DYA" VALUE 0x0000852E REC_UBYTE_C 0 COMP_0049 0 255 /end CHARACTERISTIC
/begin CHARACTERISTIC mEVPAL3 "ROM Const mEVPAL3" VALUE 0x0000852F REC_UBYTE_C 0 COMP_0054 0 5100 /end CHARACTERISTIC
/begin CHARACTERISTIC mEVPCTT "ROM Const mEVPCTT" VALUE 0x00008530 REC_UBYTE_C 0 COMP_0008 0 25500 /end CHARACTERISTIC
/begin CHARACTERISTIC mEVPKJU "ROM Const mEVPKJU" VALUE 0x00008531 REC_UBYTE_C 0 COMP_0004 0 255 /end CHARACTERISTIC
/begin CHARACTERISTIC mEVPNML "ROM Const mEVPNML" VALUE 0x00008532 REC_UBYTE_C 0 COMP_0000 0 6375 /end CHARACTERISTIC
/begin CHARACTERISTIC mEVPSLM2 "ROM Const mEVPSLM2" VALUE 0x00009112 REC_UWORD_C 0 COMP_0116_S 0 1.999931595 /end CHARACTERISTIC
/begin CHARACTERISTIC mEVPTAL "ROM Const mEVPTAL" VALUE 0x00008533 REC_UBYTE_C 0 COMP_0035 -50 205 /end CHARACTERISTIC
/begin CHARACTERISTIC mEVPTFL "ROM Const mEVPTFL" VALUE 0x00008534 REC_UBYTE_C 0 COMP_0035 -50 205 /end CHARACTERISTIC
/begin CHARACTERISTIC mEVPTPH "ROM Const mEVPTPH" VALUE 0x00008535 REC_UBYTE_C 0 COMP_0001 0 31.875 /end CHARACTERISTIC
/begin CHARACTERISTIC mEVPTPL "ROM Const mEVPTPL" VALUE 0x00008536 REC_UBYTE_C 0 COMP_0001 0 31.875 /end CHARACTERISTIC
/begin CHARACTERISTIC mEVPTWH "ROM Const mEVPTWH" VALUE 0x00008537 REC_UBYTE_C 0 COMP_0035 -50 205 /end CHARACTERISTIC
/begin CHARACTERISTIC mEVPTWL "ROM Const mEVPTWL" VALUE 0x00008538 REC_UBYTE_C 0 COMP_0035 -50 205 /end CHARACTERISTIC
/begin CHARACTERISTIC mEVPVSH "ROM Const mEVPVSH" VALUE 0x00008539 REC_UBYTE_C 0 COMP_0007 0 510 /end CHARACTERISTIC
/begin CHARACTERISTIC mEVPVSL "ROM Const mEVPVSL" VALUE 0x0000853A REC_UBYTE_C 0 COMP_0007 0 510 /end CHARACTERISTIC
/begin CHARACTERISTIC mEVSDLY2 "ROM Const mEVSDLY2" VALUE 0x0000853B REC_UBYTE_C 0 COMP_0013 0 255 /end CHARACTERISTIC
/begin CHARACTERISTIC mEVTNHF "ROM Const mEVTNHF" VALUE 0x0000853C REC_UBYTE_C 0 COMP_0035 -50 205 /end CHARACTERISTIC
/begin CHARACTERISTIC mEXCNTANG "ROM Const mEXCNTANG" VALUE 0x00009114 REC_UWORD_C 0 COMP_0117_S 0 127.99837455 /end CHARACTERISTIC
/begin CHARACTERISTIC mEXEVENT "ROM Const mEXEVENT" VALUE 0x00009116 REC_UWORD_C 0 COMP_0117_S 0 127.99837455 /end CHARACTERISTIC
/begin CHARACTERISTIC mEXNFC "ROM Const mEXNFC" VALUE 0x0000853D REC_UBYTE_C 0 COMP_0020 0 12750 /end CHARACTERISTIC
/begin CHARACTERISTIC mEXNRC "ROM Const mEXNRC" VALUE 0x0000853E REC_UBYTE_C 0 COMP_0020 0 12750 /end CHARACTERISTIC
/begin CHARACTERISTIC mEXRAMP "ROM Const mEXRAMP" VALUE 0x00009118 REC_UWORD_C 0 COMP_0118_S 0 31.999495335 /end CHARACTERISTIC
/begin CHARACTERISTIC mFA5LTW "ROM Const mFA5LTW" VALUE 0x0000853F REC_UBYTE_C 0 COMP_0035 -50 205 /end CHARACTERISTIC
/begin CHARACTERISTIC mFACNG1 "ROM Const mFACNG1" VALUE 0x00008540 REC_UBYTE_C 0 COMP_0108 0 0.99609375 /end CHARACTERISTIC
/begin CHARACTERISTIC mFACNG1K "ROM Const mFACNG1K" VALUE 0x00008541 REC_UBYTE_C 0 COMP_0119_S 0 0.99609375 /end CHARACTERISTIC
/begin CHARACTERISTIC mFACNG2 "ROM Const mFACNG2" VALUE 0x00008542 REC_UBYTE_C 0 COMP_0108 0 0.99609375 /end CHARACTERISTIC
/begin CHARACTERISTIC mFACNG2K "ROM Const mFACNG2K" VALUE 0x00008543 REC_UBYTE_C 0 COMP_0119_S 0 0.99609375 /end CHARACTERISTIC
/begin CHARACTERISTIC mFATVO "ROM Const mFATVO" VALUE 0x00008546 REC_UBYTE_C 0 COMP_0026_S 0 89.25 /end CHARACTERISTIC
/begin CHARACTERISTIC mFBDLY "ROM Const mFBDLY" VALUE 0x00008547 REC_UBYTE_C 0 COMP_0136 0 5.1 /end CHARACTERISTIC
/begin CHARACTERISTIC mFBIKPPH "ROM Const mFBIKPPH" VALUE 0x00008548 REC_UBYTE_C 0 COMP_0120_S 0 63.75 /end CHARACTERISTIC
/begin CHARACTERISTIC mFBIKPPL "ROM Const mFBIKPPL" VALUE 0x00008549 REC_UBYTE_C 0 COMP_0120_S 0 63.75 /end CHARACTERISTIC
/begin CHARACTERISTIC mFBILMT "ROM Const mFBILMT" VALUE 0x0000822E REC_SBYTE_C 0 COMP_0277 -128 127 /end CHARACTERISTIC
/begin CHARACTERISTIC mFBINTN "ROM Const mFBINTN" VALUE 0x0000911A REC_UWORD_C 0 COMP_0049 0 65535 /end CHARACTERISTIC
/begin CHARACTERISTIC mFBLMP "ROM Const mFBLMP" VALUE 0x0000854A REC_UBYTE_C 0 COMP_0120_S 0 63.75 /end CHARACTERISTIC
/begin CHARACTERISTIC mFBNGT "ROM Const mFBNGT" VALUE 0x0000854B REC_UBYTE_C 0 COMP_0015_S 0 25.5 /end CHARACTERISTIC
/begin CHARACTERISTIC mFBSTALPL "ROM Const mFBSTALPL" VALUE 0x0000911C REC_UWORD_C 0 COMP_0031 0 255.99609375 /end CHARACTERISTIC
/begin CHARACTERISTIC mFBSTALPR "ROM Const mFBSTALPR" VALUE 0x0000911E REC_UWORD_C 0 COMP_0031 0 255.99609375 /end CHARACTERISTIC
/begin CHARACTERISTIC mFCADV1 "ROM Const mFCADV1" VALUE 0x0000854C REC_UBYTE_C 0 COMP_0017 0 255 /end CHARACTERISTIC
/begin CHARACTERISTIC mFCADV2 "ROM Const mFCADV2" VALUE 0x0000854D REC_UBYTE_C 0 COMP_0017 0 255 /end CHARACTERISTIC
/begin CHARACTERISTIC mFCADV3 "ROM Const mFCADV3" VALUE 0x0000854E REC_UBYTE_C 0 COMP_0017 0 255 /end CHARACTERISTIC
/begin CHARACTERISTIC mFCAFCAN "ROM Const mFCAFCAN" VALUE 0x0000854F REC_UBYTE_C 0 COMP_0105 0 25.5 /end CHARACTERISTIC
/begin CHARACTERISTIC mFCAFHZ "ROM Const mFCAFHZ" VALUE 0x00008550 REC_UBYTE_C 0 COMP_0105 0 25.5 /end CHARACTERISTIC
/begin CHARACTERISTIC mFCAFHZF "ROM Const mFCAFHZF" VALUE 0x00008551 REC_UBYTE_C 0 COMP_0105 0 25.5 /end CHARACTERISTIC
/begin CHARACTERISTIC mFCAFHZF2 "ROM Const mFCAFHZF2" VALUE 0x00008552 REC_UBYTE_C 0 COMP_0008 0 25500 /end CHARACTERISTIC
/begin CHARACTERISTIC mFCAFHZF3 "ROM Const mFCAFHZF3" VALUE 0x00008553 REC_UBYTE_C 0 COMP_0121_S 0 25.5 /end CHARACTERISTIC
/begin CHARACTERISTIC mFCCTLVMK "ROM Const mFCCTLVMK" VALUE 0x00009120 REC_UWORD_C 0 COMP_0005 0 7208.85 /end CHARACTERISTIC
/begin CHARACTERISTIC mFCCTRLAP "ROM Const mFCCTRLAP" VALUE 0x00009122 REC_UWORD_C 0 COMP_0005 0 7208.85 /end CHARACTERISTIC
/begin CHARACTERISTIC mFCDLY "ROM Const mFCDLY" VALUE 0x00008554 REC_UBYTE_C 0 COMP_0008 0 25500 /end CHARACTERISTIC
/begin CHARACTERISTIC mFCDTCT "ROM Const mFCDTCT" VALUE 0x00008555 REC_UBYTE_C 0 COMP_0045 0 1.9921875 /end CHARACTERISTIC
/begin CHARACTERISTIC mFCDTCTH "ROM Const mFCDTCTH" VALUE 0x00008556 REC_UBYTE_C 0 COMP_0045 0 1.9921875 /end CHARACTERISTIC
/begin CHARACTERISTIC mFCDVSPH "ROM Const mFCDVSPH" VALUE 0x00008557 REC_UBYTE_C 0 COMP_0007 0 510 /end CHARACTERISTIC
/begin CHARACTERISTIC mFCDVSPL "ROM Const mFCDVSPL" VALUE 0x00008558 REC_UBYTE_C 0 COMP_0007 0 510 /end CHARACTERISTIC
/begin CHARACTERISTIC mFCLKIN "ROM Const mFCLKIN" VALUE 0x00008559 REC_UBYTE_C 0 COMP_0122_S 35 1310 /end CHARACTERISTIC
/begin CHARACTERISTIC mFCNASCD "ROM Const mFCNASCD" VALUE 0x0000855A REC_UBYTE_C 0 COMP_0000 0 6375 /end CHARACTERISTIC
/begin CHARACTERISTIC mFCPRDT "ROM Const mFCPRDT" VALUE 0x0000855B REC_UBYTE_C 0 COMP_0014 0 2550 /end CHARACTERISTIC
/begin CHARACTERISTIC mFCSPDLY "ROM Const mFCSPDLY" VALUE 0x0000855C REC_UBYTE_C 0 COMP_0015_S 0 25.5 /end CHARACTERISTIC
/begin CHARACTERISTIC mFCSPED "ROM Const mFCSPED" VALUE 0x00008E36 REC_SWORD_C 0 COMP_0002_S -32768 32767 /end CHARACTERISTIC
/begin CHARACTERISTIC mFCTC "ROM Const mFCTC" VALUE 0x0000855D REC_UBYTE_C 0 COMP_0004_S -50 205 /end CHARACTERISTIC
/begin CHARACTERISTIC mFCTIM1 "ROM Const mFCTIM1" VALUE 0x0000855E REC_UBYTE_C 0 COMP_0008 0 25500 /end CHARACTERISTIC
/begin CHARACTERISTIC mFCTSP "ROM Const mFCTSP" VALUE 0x0000855F REC_UBYTE_C 0 COMP_0149 0 0.12451191 /end CHARACTERISTIC
/begin CHARACTERISTIC mFCTTMLM "ROM Const mFCTTMLM" VALUE 0x00008560 REC_UBYTE_C 0 COMP_0015_S 0 25.5 /end CHARACTERISTIC
/begin CHARACTERISTIC mFCVSP "ROM Const mFCVSP" VALUE 0x00008561 REC_UBYTE_C 0 COMP_0007 0 510 /end CHARACTERISTIC
/begin CHARACTERISTIC mFCVSP2 "ROM Const mFCVSP2" VALUE 0x00008562 REC_UBYTE_C 0 COMP_0007 0 510 /end CHARACTERISTIC
/begin CHARACTERISTIC mFD3VSP "ROM Const mFD3VSP" VALUE 0x00008563 REC_UBYTE_C 0 COMP_0007 0 510 /end CHARACTERISTIC
/begin CHARACTERISTIC mFDCTC "ROM Const mFDCTC" VALUE 0x00009124 REC_UWORD_C 0 COMP_0066_S 0 6553.5 /end CHARACTERISTIC
/begin CHARACTERISTIC mFDTYUP0 "ROM Const mFDTYUP0" VALUE 0x00008564 REC_UBYTE_C 0 COMP_0027 0 255 /end CHARACTERISTIC
/begin CHARACTERISTIC mFDTYUP1 "ROM Const mFDTYUP1" VALUE 0x00008565 REC_UBYTE_C 0 COMP_0027 0 255 /end CHARACTERISTIC
/begin CHARACTERISTIC mFDTYUP2 "ROM Const mFDTYUP2" VALUE 0x00008566 REC_UBYTE_C 0 COMP_0027 0 255 /end CHARACTERISTIC
/begin CHARACTERISTIC mFDTYUP3 "ROM Const mFDTYUP3" VALUE 0x00008567 REC_UBYTE_C 0 COMP_0027 0 255 /end CHARACTERISTIC
/begin CHARACTERISTIC mFEMP "ROM Const mFEMP" VALUE 0x00009126 REC_UWORD_C 0 COMP_0050 0 5119.921875 /end CHARACTERISTIC
/begin CHARACTERISTIC mFFDENST "ROM Const mFFDENST" VALUE 0x00008568 REC_UBYTE_C 0 COMP_0068 0 255 /end CHARACTERISTIC
/begin CHARACTERISTIC mFFDSRM "ROM Const mFFDSRM" VALUE 0x00008569 REC_UBYTE_C 0 COMP_0014 0 2550 /end CHARACTERISTIC
/begin CHARACTERISTIC mFFNENST "ROM Const mFFNENST" VALUE 0x0000856A REC_UBYTE_C 0 COMP_0006 0 3187.5 /end CHARACTERISTIC
/begin CHARACTERISTIC mFFNHYS "ROM Const mFFNHYS" VALUE 0x0000856B REC_UBYTE_C 0 COMP_0006 0 3187.5 /end CHARACTERISTIC
/begin CHARACTERISTIC mFFULL "ROM Const mFFULL" VALUE 0x00009128 REC_UWORD_C 0 COMP_0050 0 5119.921875 /end CHARACTERISTIC
/begin CHARACTERISTIC mFG2SUB "ROM Const mFG2SUB" VALUE 0x0000912A REC_UWORD_C 0 COMP_0050 0 5119.921875 /end CHARACTERISTIC
/begin CHARACTERISTIC mFGAGEH "ROM Const mFGAGEH" VALUE 0x0000912C REC_UWORD_C 0 COMP_0050 0 5119.921875 /end CHARACTERISTIC
/begin CHARACTERISTIC mFGAGEL "ROM Const mFGAGEL" VALUE 0x0000912E REC_UWORD_C 0 COMP_0050 0 5119.921875 /end CHARACTERISTIC
/begin CHARACTERISTIC mFGNDUMP "ROM Const mFGNDUMP" VALUE 0x00009130 REC_UWORD_C 0 COMP_0290 0 0.999985458 /end CHARACTERISTIC
/begin CHARACTERISTIC mFGNIN "ROM Const mFGNIN" VALUE 0x00009132 REC_UWORD_C 0 COMP_0050 0 5119.921875 /end CHARACTERISTIC
/begin CHARACTERISTIC mFGNLM "ROM Const mFGNLM" VALUE 0x00009134 REC_UWORD_C 0 COMP_0050 0 5119.921875 /end CHARACTERISTIC
/begin CHARACTERISTIC mFGTP1 "ROM Const mFGTP1" VALUE 0x0000856D REC_UBYTE_C 0 COMP_0008 0 25500 /end CHARACTERISTIC
/begin CHARACTERISTIC mFGTP2 "ROM Const mFGTP2" VALUE 0x00009136 REC_UWORD_C 0 COMP_0008 0 6553500 /end CHARACTERISTIC
/begin CHARACTERISTIC mFHOSCON "ROM Const mFHOSCON" VALUE 0x0000856E REC_UBYTE_C 0 COMP_0063 0 0.99609375 /end CHARACTERISTIC
/begin CHARACTERISTIC mFINANG "ROM Const mFINANG" VALUE 0x0000856F REC_UBYTE_C 0 COMP_0166 0 510 /end CHARACTERISTIC
/begin CHARACTERISTIC mFINANG2 "ROM Const mFINANG2" VALUE 0x00008570 REC_UBYTE_C 0 COMP_0190 0 510 /end CHARACTERISTIC
/begin CHARACTERISTIC mFIRCFEQ "ROM Const mFIRCFEQ" VALUE 0x00008571 REC_UBYTE_C 0 COMP_0373 0 2.55 /end CHARACTERISTIC
/begin CHARACTERISTIC mFIRRPM "ROM Const mFIRRPM" VALUE 0x00008572 REC_UBYTE_C 0 COMP_0006 0 3187.5 /end CHARACTERISTIC
/begin CHARACTERISTIC mFJCLLVSP "ROM Const mFJCLLVSP" VALUE 0x00008573 REC_UBYTE_C 0 COMP_0007 0 510 /end CHARACTERISTIC
/begin CHARACTERISTIC mFKTAAVH "ROM Const mFKTAAVH" VALUE 0x00008574 REC_UBYTE_C 0 COMP_0064 0 398.4375 /end CHARACTERISTIC
/begin CHARACTERISTIC mFKTAAVL "ROM Const mFKTAAVL" VALUE 0x00008575 REC_UBYTE_C 0 COMP_0064 0 398.4375 /end CHARACTERISTIC
/begin CHARACTERISTIC mFKTAIH "ROM Const mFKTAIH" VALUE 0x00008576 REC_UBYTE_C 0 COMP_0064 0 398.4375 /end CHARACTERISTIC
/begin CHARACTERISTIC mFKTAIL "ROM Const mFKTAIL" VALUE 0x00008577 REC_UBYTE_C 0 COMP_0064 0 398.4375 /end CHARACTERISTIC
/begin CHARACTERISTIC mFLOAD3 "ROM Const mFLOAD3" VALUE 0x00008581 REC_UBYTE_C 0 COMP_0044 0 1.9921875 /end CHARACTERISTIC
/begin CHARACTERISTIC mFMADH "ROM Const mFMADH" VALUE 0x00009138 REC_UWORD_C 0 COMP_0023 0 327675 /end CHARACTERISTIC
/begin CHARACTERISTIC mFNRMIN "ROM Const mFNRMIN" VALUE 0x0000913A REC_UWORD_C 0 COMP_0006 0 819187.5 /end CHARACTERISTIC
/begin CHARACTERISTIC mFO2HDD "ROM Const mFO2HDD" VALUE 0x00008583 REC_UBYTE_C 0 COMP_0049 0 255 /end CHARACTERISTIC
/begin CHARACTERISTIC mFPCFL1H "ROM Const mFPCFL1H" VALUE 0x0000913C REC_UWORD_C 0 COMP_0029_S 0 262140 /end CHARACTERISTIC
/begin CHARACTERISTIC mFPCFL2H "ROM Const mFPCFL2H" VALUE 0x0000913E REC_UWORD_C 0 COMP_0029_S 0 262140 /end CHARACTERISTIC
/begin CHARACTERISTIC mFPCOFDI "ROM Const mFPCOFDI" VALUE 0x00009140 REC_UWORD_C 0 COMP_0168 0 83884.8 /end CHARACTERISTIC
/begin CHARACTERISTIC mFPCPS1H "ROM Const mFPCPS1H" VALUE 0x00009142 REC_UWORD_C 0 COMP_0029_S 0 262140 /end CHARACTERISTIC
/begin CHARACTERISTIC mFPCPS2H "ROM Const mFPCPS2H" VALUE 0x00009144 REC_UWORD_C 0 COMP_0029_S 0 262140 /end CHARACTERISTIC
/begin CHARACTERISTIC mFPCUT "ROM Const mFPCUT" VALUE 0x00008584 REC_UBYTE_C 0 COMP_0068 0 255 /end CHARACTERISTIC
/begin CHARACTERISTIC mFPCVBH "ROM Const mFPCVBH" VALUE 0x00008585 REC_UBYTE_C 0 COMP_0033 0 20400 /end CHARACTERISTIC
/begin CHARACTERISTIC mFPCVBL "ROM Const mFPCVBL" VALUE 0x00008586 REC_UBYTE_C 0 COMP_0033 0 20400 /end CHARACTERISTIC
/begin CHARACTERISTIC mFPDGFGN "ROM Const mFPDGFGN" VALUE 0x00009146 REC_UWORD_C 0 COMP_0050 0 5119.921875 /end CHARACTERISTIC
/begin CHARACTERISTIC mFPDGVB "ROM Const mFPDGVB" VALUE 0x00008587 REC_UBYTE_C 0 COMP_0033 0 20400 /end CHARACTERISTIC
/begin CHARACTERISTIC mFPHHRPM "ROM Const mFPHHRPM" VALUE 0x00008588 REC_UBYTE_C 0 COMP_0020 0 12750 /end CHARACTERISTIC
/begin CHARACTERISTIC mFPHIRPM "ROM Const mFPHIRPM" VALUE 0x00008589 REC_UBYTE_C 0 COMP_0020 0 12750 /end CHARACTERISTIC
/begin CHARACTERISTIC mFPHNGT "ROM Const mFPHNGT" VALUE 0x0000858A REC_UBYTE_C 0 COMP_0008 0 25500 /end CHARACTERISTIC
/begin CHARACTERISTIC mFPLNGT "ROM Const mFPLNGT" VALUE 0x0000858B REC_UBYTE_C 0 COMP_0008 0 25500 /end CHARACTERISTIC
/begin CHARACTERISTIC mFPNRPH "ROM Const mFPNRPH" VALUE 0x0000858C REC_UBYTE_C 0 COMP_0000 0 6375 /end CHARACTERISTIC
/begin CHARACTERISTIC mFPNRPL "ROM Const mFPNRPL" VALUE 0x0000858D REC_UBYTE_C 0 COMP_0000 0 6375 /end CHARACTERISTIC
/begin CHARACTERISTIC mFPOFDLY "ROM Const mFPOFDLY" VALUE 0x0000858E REC_UBYTE_C 0 COMP_0014 0 2550 /end CHARACTERISTIC
/begin CHARACTERISTIC mFPOFDY "ROM Const mFPOFDY" VALUE 0x0000858F REC_UBYTE_C 0 COMP_0008 0 25500 /end CHARACTERISTIC
/begin CHARACTERISTIC mFPOFFD "ROM Const mFPOFFD" VALUE 0x00008590 REC_UBYTE_C 0 COMP_0008 0 25500 /end CHARACTERISTIC
/begin CHARACTERISTIC mFPONDHI "ROM Const mFPONDHI" VALUE 0x00008591 REC_UBYTE_C 0 COMP_0027 0 255 /end CHARACTERISTIC
/begin CHARACTERISTIC mFPONDLO "ROM Const mFPONDLO" VALUE 0x00008592 REC_UBYTE_C 0 COMP_0027 0 255 /end CHARACTERISTIC
/begin CHARACTERISTIC mFPONDLY "ROM Const mFPONDLY" VALUE 0x00008593 REC_UBYTE_C 0 COMP_0014 0 2550 /end CHARACTERISTIC
/begin CHARACTERISTIC mFPONDMID "ROM Const mFPONDMID" VALUE 0x00008594 REC_UBYTE_C 0 COMP_0027 0 255 /end CHARACTERISTIC
/begin CHARACTERISTIC mFPSTDLY "ROM Const mFPSTDLY" VALUE 0x00008597 REC_UBYTE_C 0 COMP_0008 0 25500 /end CHARACTERISTIC
/begin CHARACTERISTIC mFPSTHYS1 "ROM Const mFPSTHYS1" VALUE 0x00009148 REC_UWORD_C 0 COMP_0164 0 19.988175 /end CHARACTERISTIC
/begin CHARACTERISTIC mFPSTM "ROM Const mFPSTM" VALUE 0x00008598 REC_UBYTE_C 0 COMP_0049 0 255 /end CHARACTERISTIC
/begin CHARACTERISTIC mFPSTTW "ROM Const mFPSTTW" VALUE 0x00008599 REC_UBYTE_C 0 COMP_0035 -50 205 /end CHARACTERISTIC
/begin CHARACTERISTIC mFPTFL1 "ROM Const mFPTFL1" VALUE 0x0000859A REC_UBYTE_C 0 COMP_0001 0 31.875 /end CHARACTERISTIC
/begin CHARACTERISTIC mFPTFL2 "ROM Const mFPTFL2" VALUE 0x0000859B REC_UBYTE_C 0 COMP_0001 0 31.875 /end CHARACTERISTIC
/begin CHARACTERISTIC mFPTPHL "ROM Const mFPTPHL" VALUE 0x0000914A REC_UWORD_C 0 COMP_0001 0 8191.875 /end CHARACTERISTIC
/begin CHARACTERISTIC mFPTPLL "ROM Const mFPTPLL" VALUE 0x0000914C REC_UWORD_C 0 COMP_0001 0 8191.875 /end CHARACTERISTIC
/begin CHARACTERISTIC mFPTPS1 "ROM Const mFPTPS1" VALUE 0x0000859C REC_UBYTE_C 0 COMP_0001 0 31.875 /end CHARACTERISTIC
/begin CHARACTERISTIC mFPTPS2 "ROM Const mFPTPS2" VALUE 0x0000859D REC_UBYTE_C 0 COMP_0001 0 31.875 /end CHARACTERISTIC
/begin CHARACTERISTIC mFPTWL "ROM Const mFPTWL" VALUE 0x0000859E REC_UBYTE_C 0 COMP_0035 -50 205 /end CHARACTERISTIC
/begin CHARACTERISTIC mFPTWS "ROM Const mFPTWS" VALUE 0x0000859F REC_UBYTE_C 0 COMP_0035 -50 205 /end CHARACTERISTIC
/begin CHARACTERISTIC mFPVSPH "ROM Const mFPVSPH" VALUE 0x000085A0 REC_UBYTE_C 0 COMP_0007 0 510 /end CHARACTERISTIC
/begin CHARACTERISTIC mFPVSPL "ROM Const mFPVSPL" VALUE 0x000085A1 REC_UBYTE_C 0 COMP_0007 0 510 /end CHARACTERISTIC
/begin CHARACTERISTIC mFRA5TW "ROM Const mFRA5TW" VALUE 0x000085A2 REC_UBYTE_C 0 COMP_0035 -50 205 /end CHARACTERISTIC
/begin CHARACTERISTIC mFRCAP2 "ROM Const mFRCAP2" VALUE 0x000085A3 REC_UBYTE_C 0 COMP_0054 0 5100 /end CHARACTERISTIC
/begin CHARACTERISTIC mFREDQEXD "ROM Const mFREDQEXD" VALUE 0x000097B8 REC_ULONG_C 0 COMP_0019_S 0 16843010.6000859 /end CHARACTERISTIC
/begin CHARACTERISTIC mFREDQEXS "ROM Const mFREDQEXS" VALUE 0x000097BC REC_ULONG_C 0 COMP_0096_S 0 16843014.8950532 /end CHARACTERISTIC
/begin CHARACTERISTIC mFRICTWNC "ROM Const mFRICTWNC" VALUE 0x000085A4 REC_UBYTE_C 0 COMP_0063 0 0.99609375 /end CHARACTERISTIC
/begin CHARACTERISTIC mFRMKN "ROM Const mFRMKN" VALUE 0x000085A5 REC_UBYTE_C 0 COMP_0000 0 6375 /end CHARACTERISTIC
/begin CHARACTERISTIC mFRPPAMB "ROM Const mFRPPAMB" VALUE 0x0000914E REC_UWORD_C 0 COMP_0123_S 0 127.998046875 /end CHARACTERISTIC
/begin CHARACTERISTIC mFRTANMN "ROM Const mFRTANMN" VALUE 0x000085A6 REC_UBYTE_C 0 COMP_0035 -50 205 /end CHARACTERISTIC
/begin CHARACTERISTIC mFRTANMX "ROM Const mFRTANMX" VALUE 0x000085A7 REC_UBYTE_C 0 COMP_0035 -50 205 /end CHARACTERISTIC
/begin CHARACTERISTIC mFRTM "ROM Const mFRTM" VALUE 0x000085A8 REC_UBYTE_C 0 COMP_0008 0 25500 /end CHARACTERISTIC
/begin CHARACTERISTIC mFRTM2 "ROM Const mFRTM2" VALUE 0x000085A9 REC_UBYTE_C 0 COMP_0049 0 255 /end CHARACTERISTIC
/begin CHARACTERISTIC mFRTWD "ROM Const mFRTWD" VALUE 0x000085AA REC_UBYTE_C 0 COMP_0003 0 255 /end CHARACTERISTIC
/begin CHARACTERISTIC mFRTWH "ROM Const mFRTWH" VALUE 0x000085AB REC_UBYTE_C 0 COMP_0035 -50 205 /end CHARACTERISTIC
/begin CHARACTERISTIC mFRVSP1 "ROM Const mFRVSP1" VALUE 0x000085AC REC_UBYTE_C 0 COMP_0007 0 510 /end CHARACTERISTIC
/begin CHARACTERISTIC mFRVSP2 "ROM Const mFRVSP2" VALUE 0x000085AD REC_UBYTE_C 0 COMP_0007 0 510 /end CHARACTERISTIC
/begin CHARACTERISTIC mFSAA "ROM Const mFSAA" VALUE 0x00009150 REC_UWORD_C 0 COMP_0041 0 52.428 /end CHARACTERISTIC
/begin CHARACTERISTIC mFSADC "ROM Const mFSADC" VALUE 0x000085AE REC_UBYTE_C 0 COMP_0058_S 0 25500 /end CHARACTERISTIC
/begin CHARACTERISTIC mFSADC2 "ROM Const mFSADC2" VALUE 0x00009152 REC_UWORD_C 0 COMP_0058_S 0 6553500 /end CHARACTERISTIC
/begin CHARACTERISTIC mFSAFDP "ROM Const mFSAFDP" VALUE 0x00009154 REC_UWORD_C 0 COMP_0061_S 0 6.5535 /end CHARACTERISTIC
/begin CHARACTERISTIC mFSBATSH "ROM Const mFSBATSH" VALUE 0x000085AF REC_UBYTE_C 0 COMP_0054 0 5100 /end CHARACTERISTIC
/begin CHARACTERISTIC mFSBATSL "ROM Const mFSBATSL" VALUE 0x000085B0 REC_UBYTE_C 0 COMP_0054 0 5100 /end CHARACTERISTIC
/begin CHARACTERISTIC mFSBTSH "ROM Const mFSBTSH" VALUE 0x000085B1 REC_UBYTE_C 0 COMP_0054 0 5100 /end CHARACTERISTIC
/begin CHARACTERISTIC mFSBTSL "ROM Const mFSBTSL" VALUE 0x000085B2 REC_UBYTE_C 0 COMP_0054 0 5100 /end CHARACTERISTIC
/begin CHARACTERISTIC mFSDWLL "ROM Const mFSDWLL" VALUE 0x000085B3 REC_UBYTE_C 0 COMP_0017 0 255 /end CHARACTERISTIC
/begin CHARACTERISTIC mFSFADV "ROM Const mFSFADV" VALUE 0x000085B4 REC_UBYTE_C 0 COMP_0017 0 255 /end CHARACTERISTIC
/begin CHARACTERISTIC mFSLOPE "ROM Const mFSLOPE" VALUE 0x00009156 REC_UWORD_C 0 COMP_0050 0 5119.921875 /end CHARACTERISTIC
/begin CHARACTERISTIC mFSLOSH "ROM Const mFSLOSH" VALUE 0x00009158 REC_UWORD_C 0 COMP_0050 0 5119.921875 /end CHARACTERISTIC
/begin CHARACTERISTIC mFSPF "ROM Const mFSPF" VALUE 0x0000915A REC_UWORD_C 0 COMP_0164 0 19.988175 /end CHARACTERISTIC
/begin CHARACTERISTIC mFSRQF "ROM Const mFSRQF" VALUE 0x0000915C REC_UWORD_C 0 COMP_0010_S 0 6.5535 /end CHARACTERISTIC
/begin CHARACTERISTIC mFSRTEND2 "ROM Const mFSRTEND2" VALUE 0x000085B5 REC_UBYTE_C 0 COMP_0068 0 255 /end CHARACTERISTIC
/begin CHARACTERISTIC mFSRTRSL2 "ROM Const mFSRTRSL2" VALUE 0x000085B6 REC_UBYTE_C 0 COMP_0068 0 255 /end CHARACTERISTIC
/begin CHARACTERISTIC mFSRTTST2 "ROM Const mFSRTTST2" VALUE 0x000085B7 REC_UBYTE_C 0 COMP_0068 0 255 /end CHARACTERISTIC
/begin CHARACTERISTIC mFSTCAM "ROM Const mFSTCAM" VALUE 0x000085B8 REC_UBYTE_C 0 COMP_0095 0 398.4375 /end CHARACTERISTIC
/begin CHARACTERISTIC mFSTRDL "ROM Const mFSTRDL" VALUE 0x000085B9 REC_UBYTE_C 0 COMP_0014 0 2550 /end CHARACTERISTIC
/begin CHARACTERISTIC mFSTRKIND "ROM Const mFSTRKIND" VALUE 0x000085BA REC_UBYTE_C 0 COMP_0068 0 255 /end CHARACTERISTIC
/begin CHARACTERISTIC mFSTVO "ROM Const mFSTVO" VALUE 0x000085BB REC_UBYTE_C 0 COMP_0002 0 89.25 /end CHARACTERISTIC
/begin CHARACTERISTIC mFSVBMAX "ROM Const mFSVBMAX" VALUE 0x000085BC REC_UBYTE_C 0 COMP_0033 0 20400 /end CHARACTERISTIC
/begin CHARACTERISTIC mFTANG "ROM Const mFTANG" VALUE 0x000085BD REC_UBYTE_C 0 COMP_0003 0 255 /end CHARACTERISTIC
/begin CHARACTERISTIC mFTANHOS "ROM Const mFTANHOS" VALUE 0x000085BE REC_UBYTE_C 0 COMP_0124_S -48 15.75 /end CHARACTERISTIC
/begin CHARACTERISTIC mFTANKV "ROM Const mFTANKV" VALUE 0x0000915E REC_UWORD_C 0 COMP_0312 0 127.998046875 /end CHARACTERISTIC
/begin CHARACTERISTIC mFTANKVB "ROM Const mFTANKVB" VALUE 0x00009160 REC_UWORD_C 0 COMP_0078_S 0 255.99609375 /end CHARACTERISTIC
/begin CHARACTERISTIC mFTIME1 "ROM Const mFTIME1" VALUE 0x000085BF REC_UBYTE_C 0 COMP_0008 0 25500 /end CHARACTERISTIC
/begin CHARACTERISTIC mFTIME2 "ROM Const mFTIME2" VALUE 0x000085C0 REC_UBYTE_C 0 COMP_0008 0 25500 /end CHARACTERISTIC
/begin CHARACTERISTIC mFTIME3 "ROM Const mFTIME3" VALUE 0x000085C1 REC_UBYTE_C 0 COMP_0008 0 25500 /end CHARACTERISTIC
/begin CHARACTERISTIC mFTSNGDLY "ROM Const mFTSNGDLY" VALUE 0x000085C2 REC_UBYTE_C 0 COMP_0013 0 255 /end CHARACTERISTIC
/begin CHARACTERISTIC mFTWNG "ROM Const mFTWNG" VALUE 0x000085C3 REC_UBYTE_C 0 COMP_0003 0 255 /end CHARACTERISTIC
/begin CHARACTERISTIC mFUKBAI "ROM Const mFUKBAI" VALUE 0x000085C5 REC_UBYTE_C 0 COMP_0016 0 255 /end CHARACTERISTIC
/begin CHARACTERISTIC mFUKECDLY "ROM Const mFUKECDLY" VALUE 0x000085C6 REC_UBYTE_C 0 COMP_0014 0 2550 /end CHARACTERISTIC
/begin CHARACTERISTIC mFUKENEL "ROM Const mFUKENEL" VALUE 0x00009162 REC_UWORD_C 0 COMP_0065 0 204796.875 /end CHARACTERISTIC
/begin CHARACTERISTIC mFUKENEM "ROM Const mFUKENEM" VALUE 0x000085C7 REC_UBYTE_C 0 COMP_0065 0 796.875 /end CHARACTERISTIC
/begin CHARACTERISTIC mFUKENPCH "ROM Const mFUKENPCH" VALUE 0x000085C8 REC_UBYTE_C 0 COMP_0065 0 796.875 /end CHARACTERISTIC
/begin CHARACTERISTIC mFUKETW "ROM Const mFUKETW" VALUE 0x000085C9 REC_UBYTE_C 0 COMP_0035 -50 205 /end CHARACTERISTIC
/begin CHARACTERISTIC mFUKEVSP "ROM Const mFUKEVSP" VALUE 0x000085CA REC_UBYTE_C 0 COMP_0007 0 510 /end CHARACTERISTIC
/begin CHARACTERISTIC mFULLSWON "ROM Const mFULLSWON" VALUE 0x00009164 REC_UWORD_C 0 COMP_0005 0 7208.85 /end CHARACTERISTIC
/begin CHARACTERISTIC mFULSWHYS "ROM Const mFULSWHYS" VALUE 0x00009166 REC_UWORD_C 0 COMP_0005 0 7208.85 /end CHARACTERISTIC
/begin CHARACTERISTIC mFVCYLS "ROM Const mFVCYLS" VALUE 0x000085CB REC_UBYTE_C 0 COMP_0004 0 255 /end CHARACTERISTIC
/begin CHARACTERISTIC mGADVFBAV "ROM Const mGADVFBAV" VALUE 0x000085CC REC_UBYTE_C 0 COMP_0125_S 0 2.55 /end CHARACTERISTIC
/begin CHARACTERISTIC mGADVTP2 "ROM Const mGADVTP2" VALUE 0x000085CD REC_UBYTE_C 0 COMP_0186 0 3.984375 /end CHARACTERISTIC
/begin CHARACTERISTIC mGAFBI "ROM Const mGAFBI" VALUE 0x000085CE REC_UBYTE_C 0 COMP_0126_S 0 1.275 /end CHARACTERISTIC
/begin CHARACTERISTIC mGAFBPH "ROM Const mGAFBPH" VALUE 0x000085CF REC_UBYTE_C 0 COMP_0126_S 0 1.275 /end CHARACTERISTIC
/begin CHARACTERISTIC mGAFBPI "ROM Const mGAFBPI" VALUE 0x000085D0 REC_UBYTE_C 0 COMP_0126_S 0 1.275 /end CHARACTERISTIC
/begin CHARACTERISTIC mGAFBPL "ROM Const mGAFBPL" VALUE 0x000085D1 REC_UBYTE_C 0 COMP_0126_S 0 1.275 /end CHARACTERISTIC
/begin CHARACTERISTIC mGAGEPL "ROM Const mGAGEPL" VALUE 0x00009168 REC_UWORD_C 0 COMP_0050 0 5119.921875 /end CHARACTERISTIC
/begin CHARACTERISTIC mGAKADRID "ROM Const mGAKADRID" VALUE 0x000085D2 REC_UBYTE_C 0 COMP_0017 0 255 /end CHARACTERISTIC
/begin CHARACTERISTIC mGAKADVAD "ROM Const mGAKADVAD" VALUE 0x000085D3 REC_UBYTE_C 0 COMP_0017 0 255 /end CHARACTERISTIC
/begin CHARACTERISTIC mGAKADVRD "ROM Const mGAKADVRD" VALUE 0x000085D4 REC_UBYTE_C 0 COMP_0017 0 255 /end CHARACTERISTIC
/begin CHARACTERISTIC mGAKADVTM "ROM Const mGAKADVTM" VALUE 0x000085D5 REC_UBYTE_C 0 COMP_0008 0 25500 /end CHARACTERISTIC
/begin CHARACTERISTIC mGAKRH "ROM Const mGAKRH" VALUE 0x000085D6 REC_UBYTE_C 0 COMP_0017 0 255 /end CHARACTERISTIC
/begin CHARACTERISTIC mGAKRH0 "ROM Const mGAKRH0" VALUE 0x000085D7 REC_UBYTE_C 0 COMP_0017 0 255 /end CHARACTERISTIC
/begin CHARACTERISTIC mGAKRIH "ROM Const mGAKRIH" VALUE 0x000085D8 REC_UBYTE_C 0 COMP_0017 0 255 /end CHARACTERISTIC
/begin CHARACTERISTIC mGAKRIH0 "ROM Const mGAKRIH0" VALUE 0x000085D9 REC_UBYTE_C 0 COMP_0017 0 255 /end CHARACTERISTIC
/begin CHARACTERISTIC mGAKRIL "ROM Const mGAKRIL" VALUE 0x000085DA REC_UBYTE_C 0 COMP_0017 0 255 /end CHARACTERISTIC
/begin CHARACTERISTIC mGAKRIL0 "ROM Const mGAKRIL0" VALUE 0x000085DB REC_UBYTE_C 0 COMP_0017 0 255 /end CHARACTERISTIC
/begin CHARACTERISTIC mGAKRIMH "ROM Const mGAKRIMH" VALUE 0x000085DC REC_UBYTE_C 0 COMP_0017 0 255 /end CHARACTERISTIC
/begin CHARACTERISTIC mGAKRIMH0 "ROM Const mGAKRIMH0" VALUE 0x000085DD REC_UBYTE_C 0 COMP_0017 0 255 /end CHARACTERISTIC
/begin CHARACTERISTIC mGAKRIML "ROM Const mGAKRIML" VALUE 0x000085DE REC_UBYTE_C 0 COMP_0017 0 255 /end CHARACTERISTIC
/begin CHARACTERISTIC mGAKRIML0 "ROM Const mGAKRIML0" VALUE 0x000085DF REC_UBYTE_C 0 COMP_0017 0 255 /end CHARACTERISTIC
/begin CHARACTERISTIC mGAKRL "ROM Const mGAKRL" VALUE 0x000085E0 REC_UBYTE_C 0 COMP_0017 0 255 /end CHARACTERISTIC
/begin CHARACTERISTIC mGAKRL0 "ROM Const mGAKRL0" VALUE 0x000085E1 REC_UBYTE_C 0 COMP_0017 0 255 /end CHARACTERISTIC
/begin CHARACTERISTIC mGAKRMH "ROM Const mGAKRMH" VALUE 0x000085E2 REC_UBYTE_C 0 COMP_0017 0 255 /end CHARACTERISTIC
/begin CHARACTERISTIC mGAKRMH0 "ROM Const mGAKRMH0" VALUE 0x000085E3 REC_UBYTE_C 0 COMP_0017 0 255 /end CHARACTERISTIC
/begin CHARACTERISTIC mGAKRML "ROM Const mGAKRML" VALUE 0x000085E4 REC_UBYTE_C 0 COMP_0017 0 255 /end CHARACTERISTIC
/begin CHARACTERISTIC mGAKRML0 "ROM Const mGAKRML0" VALUE 0x000085E5 REC_UBYTE_C 0 COMP_0017 0 255 /end CHARACTERISTIC
/begin CHARACTERISTIC mGAKRTOH "ROM Const mGAKRTOH" VALUE 0x0000916A REC_UWORD_C 0 COMP_0450 0 63.999056205 /end CHARACTERISTIC
/begin CHARACTERISTIC mGAKRTOL "ROM Const mGAKRTOL" VALUE 0x0000916C REC_UWORD_C 0 COMP_0450 0 63.999056205 /end CHARACTERISTIC
/begin CHARACTERISTIC mGAKRTOM "ROM Const mGAKRTOM" VALUE 0x0000916E REC_UWORD_C 0 COMP_0450 0 63.999056205 /end CHARACTERISTIC
/begin CHARACTERISTIC mGAKTVOH "ROM Const mGAKTVOH" VALUE 0x000085E6 REC_UBYTE_C 0 COMP_0002 0 89.25 /end CHARACTERISTIC
/begin CHARACTERISTIC mGAKTVOL "ROM Const mGAKTVOL" VALUE 0x000085E7 REC_UBYTE_C 0 COMP_0002 0 89.25 /end CHARACTERISTIC
/begin CHARACTERISTIC mGAKTVOM "ROM Const mGAKTVOM" VALUE 0x000085E8 REC_UBYTE_C 0 COMP_0002 0 89.25 /end CHARACTERISTIC
/begin CHARACTERISTIC mGAKUADVA "ROM Const mGAKUADVA" VALUE 0x000085E9 REC_UBYTE_C 0 COMP_0017 0 255 /end CHARACTERISTIC
/begin CHARACTERISTIC mGAKUDNEM "ROM Const mGAKUDNEM" VALUE 0x000085EA REC_UBYTE_C 0 COMP_0065 0 796.875 /end CHARACTERISTIC
/begin CHARACTERISTIC mGAKUDNEP "ROM Const mGAKUDNEP" VALUE 0x000085EB REC_UBYTE_C 0 COMP_0065 0 796.875 /end CHARACTERISTIC
/begin CHARACTERISTIC mGAKURITM "ROM Const mGAKURITM" VALUE 0x000085EC REC_UBYTE_C 0 COMP_0014 0 2550 /end CHARACTERISTIC
/begin CHARACTERISTIC mGASCDNG "ROM Const mGASCDNG" VALUE 0x00009170 REC_UWORD_C 0 COMP_0127_S -4.079616 4.0794915 /end CHARACTERISTIC
/begin CHARACTERISTIC mGASCDNG2 "ROM Const mGASCDNG2" VALUE 0x00009172 REC_UWORD_C 0 COMP_0127_S -4.079616 4.0794915 /end CHARACTERISTIC
/begin CHARACTERISTIC mGASNGDEC "ROM Const mGASNGDEC" VALUE 0x00009174 REC_UWORD_C 0 COMP_0127_S -4.079616 4.0794915 /end CHARACTERISTIC
/begin CHARACTERISTIC mGATVQLH "ROM Const mGATVQLH" VALUE 0x000085ED REC_UBYTE_C 0 COMP_0063 0 0.99609375 /end CHARACTERISTIC
/begin CHARACTERISTIC mGATVQLL "ROM Const mGATVQLL" VALUE 0x000085EE REC_UBYTE_C 0 COMP_0063 0 0.99609375 /end CHARACTERISTIC
/begin CHARACTERISTIC mGATZNETM "ROM Const mGATZNETM" VALUE 0x000085EF REC_UBYTE_C 0 COMP_0014 0 2550 /end CHARACTERISTIC
/begin CHARACTERISTIC mGATZNH "ROM Const mGATZNH" VALUE 0x000085F0 REC_UBYTE_C 0 COMP_0065 0 796.875 /end CHARACTERISTIC
/begin CHARACTERISTIC mGATZNH0 "ROM Const mGATZNH0" VALUE 0x000085F1 REC_UBYTE_C 0 COMP_0065 0 796.875 /end CHARACTERISTIC
/begin CHARACTERISTIC mGATZNL "ROM Const mGATZNL" VALUE 0x000085F2 REC_UBYTE_C 0 COMP_0065 0 796.875 /end CHARACTERISTIC
/begin CHARACTERISTIC mGATZNL0 "ROM Const mGATZNL0" VALUE 0x000085F3 REC_UBYTE_C 0 COMP_0065 0 796.875 /end CHARACTERISTIC
/begin CHARACTERISTIC mGATZNMH "ROM Const mGATZNMH" VALUE 0x000085F4 REC_UBYTE_C 0 COMP_0065 0 796.875 /end CHARACTERISTIC
/begin CHARACTERISTIC mGATZNMH0 "ROM Const mGATZNMH0" VALUE 0x000085F5 REC_UBYTE_C 0 COMP_0065 0 796.875 /end CHARACTERISTIC
/begin CHARACTERISTIC mGATZNML "ROM Const mGATZNML" VALUE 0x000085F6 REC_UBYTE_C 0 COMP_0065 0 796.875 /end CHARACTERISTIC
/begin CHARACTERISTIC mGATZNML0 "ROM Const mGATZNML0" VALUE 0x000085F7 REC_UBYTE_C 0 COMP_0065 0 796.875 /end CHARACTERISTIC
/begin CHARACTERISTIC mGAVFBPS "ROM Const mGAVFBPS" VALUE 0x000085F8 REC_UBYTE_C 0 COMP_0128_S 0 1.9921875 /end CHARACTERISTIC
/begin CHARACTERISTIC mGCALTIM "ROM Const mGCALTIM" VALUE 0x000085F9 REC_UBYTE_C 0 COMP_0014 0 2550 /end CHARACTERISTIC
/begin CHARACTERISTIC mGCONVGT "ROM Const mGCONVGT" VALUE 0x000085FA REC_UBYTE_C 0 COMP_0014 0 2550 /end CHARACTERISTIC
/begin CHARACTERISTIC mGDELAY "ROM Const mGDELAY" VALUE 0x00009176 REC_UWORD_C 0 COMP_0146 0 99.998480265 /end CHARACTERISTIC
/begin CHARACTERISTIC mGDELAY2 "ROM Const mGDELAY2" VALUE 0x00009178 REC_UWORD_C 0 COMP_0146 0 99.998480265 /end CHARACTERISTIC
/begin CHARACTERISTIC mGDPPSV0 "ROM Const mGDPPSV0" VALUE 0x000085FB REC_UBYTE_C 0 COMP_0129_S 0 7.96875 /end CHARACTERISTIC
/begin CHARACTERISTIC mGDPPSV1 "ROM Const mGDPPSV1" VALUE 0x000085FC REC_UBYTE_C 0 COMP_0129_S 0 7.96875 /end CHARACTERISTIC
/begin CHARACTERISTIC mGDPPSV2 "ROM Const mGDPPSV2" VALUE 0x000085FD REC_UBYTE_C 0 COMP_0129_S 0 7.96875 /end CHARACTERISTIC
/begin CHARACTERISTIC mGDPPSV3 "ROM Const mGDPPSV3" VALUE 0x000085FE REC_UBYTE_C 0 COMP_0129_S 0 7.96875 /end CHARACTERISTIC
/begin CHARACTERISTIC mGFBHYSH "ROM Const mGFBHYSH" VALUE 0x000085FF REC_UBYTE_C 0 COMP_0130_S 0 0.255 /end CHARACTERISTIC
/begin CHARACTERISTIC mGFBHYSL "ROM Const mGFBHYSL" VALUE 0x00008600 REC_UBYTE_C 0 COMP_0130_S 0 0.255 /end CHARACTERISTIC
/begin CHARACTERISTIC mGFBRKD "ROM Const mGFBRKD" VALUE 0x00008601 REC_UBYTE_C 0 COMP_0008 0 25500 /end CHARACTERISTIC
/begin CHARACTERISTIC mGFBSD "ROM Const mGFBSD" VALUE 0x00008602 REC_UBYTE_C 0 COMP_0008 0 25500 /end CHARACTERISTIC
/begin CHARACTERISTIC mGFBSFD "ROM Const mGFBSFD" VALUE 0x00008603 REC_UBYTE_C 0 COMP_0008 0 25500 /end CHARACTERISTIC
/begin CHARACTERISTIC mGFBTM "ROM Const mGFBTM" VALUE 0x00008604 REC_UBYTE_C 0 COMP_0202 0 2550 /end CHARACTERISTIC
/begin CHARACTERISTIC mGFBTRQI "ROM Const mGFBTRQI" VALUE 0x00008605 REC_UBYTE_C 0 COMP_0131_S 0 127.5 /end CHARACTERISTIC
/begin CHARACTERISTIC mGHFSCV "ROM Const mGHFSCV" VALUE 0x00008606 REC_UBYTE_C 0 COMP_0044 0 1.9921875 /end CHARACTERISTIC
/begin CHARACTERISTIC mGKGZ1MR "ROM Const mGKGZ1MR" VALUE 0x00008607 REC_UBYTE_C 0 COMP_0021 0 99.609375 /end CHARACTERISTIC
/begin CHARACTERISTIC mGKTVMN "ROM Const mGKTVMN" VALUE 0x00008608 REC_UBYTE_C 0 COMP_0061 0 1275 /end CHARACTERISTIC
/begin CHARACTERISTIC mGKTVMX "ROM Const mGKTVMX" VALUE 0x00008609 REC_UBYTE_C 0 COMP_0061 0 1275 /end CHARACTERISTIC
/begin CHARACTERISTIC mGLHRN "ROM Const mGLHRN" VALUE 0x0000860A REC_UBYTE_C 0 COMP_0009 0 199.21875 /end CHARACTERISTIC
/begin CHARACTERISTIC mGLMT "ROM Const mGLMT" VALUE 0x0000860B REC_UBYTE_C 0 COMP_0186 0 3.984375 /end CHARACTERISTIC
/begin CHARACTERISTIC mGLNDGTM "ROM Const mGLNDGTM" VALUE 0x0000860C REC_UBYTE_C 0 COMP_0014 0 2550 /end CHARACTERISTIC
/begin CHARACTERISTIC mGM1 "ROM Const mGM1" VALUE 0x0000917A REC_UWORD_C 0 COMP_0132_S 0 0.1999970916 /end CHARACTERISTIC
/begin CHARACTERISTIC mGM1P1C "ROM Const mGM1P1C" VALUE 0x0000860D REC_UBYTE_C 0 COMP_0068 0 255 /end CHARACTERISTIC
/begin CHARACTERISTIC mGM2 "ROM Const mGM2" VALUE 0x0000917C REC_UWORD_C 0 COMP_0132_S 0 0.1999970916 /end CHARACTERISTIC
/begin CHARACTERISTIC mGM3 "ROM Const mGM3" VALUE 0x0000917E REC_UWORD_C 0 COMP_0132_S 0 0.1999970916 /end CHARACTERISTIC
/begin CHARACTERISTIC mGM4 "ROM Const mGM4" VALUE 0x00009180 REC_UWORD_C 0 COMP_0132_S 0 0.1999970916 /end CHARACTERISTIC
/begin CHARACTERISTIC mGM5 "ROM Const mGM5" VALUE 0x00009182 REC_UWORD_C 0 COMP_0132_S 0 0.1999970916 /end CHARACTERISTIC
/begin CHARACTERISTIC mGM8EPH "ROM Const mGM8EPH" VALUE 0x0000860E REC_UBYTE_C 0 COMP_0054 0 5100 /end CHARACTERISTIC
/begin CHARACTERISTIC mGM8EPL "ROM Const mGM8EPL" VALUE 0x0000860F REC_UBYTE_C 0 COMP_0054 0 5100 /end CHARACTERISTIC
/begin CHARACTERISTIC mGM8ETA "ROM Const mGM8ETA" VALUE 0x00008610 REC_UBYTE_C 0 COMP_0035 -50 205 /end CHARACTERISTIC
/begin CHARACTERISTIC mGM8ETF "ROM Const mGM8ETF" VALUE 0x00008611 REC_UBYTE_C 0 COMP_0035 -50 205 /end CHARACTERISTIC
/begin CHARACTERISTIC mGM8EVB "ROM Const mGM8EVB" VALUE 0x00008612 REC_UBYTE_C 0 COMP_0033 0 20400 /end CHARACTERISTIC
/begin CHARACTERISTIC mGMDLT1 "ROM Const mGMDLT1" VALUE 0x00009184 REC_UWORD_C 0 COMP_0133_S 0 0.1999970916 /end CHARACTERISTIC
/begin CHARACTERISTIC mGMDLT2 "ROM Const mGMDLT2" VALUE 0x00009186 REC_UWORD_C 0 COMP_0133_S 0 0.1999970916 /end CHARACTERISTIC
/begin CHARACTERISTIC mGNDLY "ROM Const mGNDLY" VALUE 0x00008613 REC_UBYTE_C 0 COMP_0014 0 2550 /end CHARACTERISTIC
/begin CHARACTERISTIC mGNDSTNG "ROM Const mGNDSTNG" VALUE 0x00008614 REC_UBYTE_C 0 COMP_0030 0 255 /end CHARACTERISTIC
/begin CHARACTERISTIC mGNSETTM "ROM Const mGNSETTM" VALUE 0x00008615 REC_UBYTE_C 0 COMP_0008 0 25500 /end CHARACTERISTIC
/begin CHARACTERISTIC mGNSETUP "ROM Const mGNSETUP" VALUE 0x00008616 REC_UBYTE_C 0 COMP_0009 0 199.21875 /end CHARACTERISTIC
/begin CHARACTERISTIC mGOVDLY "ROM Const mGOVDLY" VALUE 0x00008617 REC_UBYTE_C 0 COMP_0014 0 2550 /end CHARACTERISTIC
/begin CHARACTERISTIC mGOVDLYE "ROM Const mGOVDLYE" VALUE 0x00008618 REC_UBYTE_C 0 COMP_0014 0 2550 /end CHARACTERISTIC
/begin CHARACTERISTIC mGOVTW "ROM Const mGOVTW" VALUE 0x00008619 REC_UBYTE_C 0 COMP_0035 -50 205 /end CHARACTERISTIC
/begin CHARACTERISTIC mGOVTW2 "ROM Const mGOVTW2" VALUE 0x0000861A REC_UBYTE_C 0 COMP_0035 -50 205 /end CHARACTERISTIC
/begin CHARACTERISTIC mGPIDGTR "ROM Const mGPIDGTR" VALUE 0x0000861B REC_UBYTE_C 0 COMP_0044 0 1.9921875 /end CHARACTERISTIC
/begin CHARACTERISTIC mGQFBIH "ROM Const mGQFBIH" VALUE 0x00009188 REC_UWORD_C 0 COMP_0134_S 0 65535 /end CHARACTERISTIC
/begin CHARACTERISTIC mGQFBIHS "ROM Const mGQFBIHS" VALUE 0x0000918A REC_UWORD_C 0 COMP_0004 0 65535 /end CHARACTERISTIC
/begin CHARACTERISTIC mGQFBIL "ROM Const mGQFBIL" VALUE 0x0000918C REC_UWORD_C 0 COMP_0134_S 0 65535 /end CHARACTERISTIC
/begin CHARACTERISTIC mGQFBITAS "ROM Const mGQFBITAS" VALUE 0x0000918E REC_UWORD_C 0 COMP_0134_S 0 65535 /end CHARACTERISTIC
/begin CHARACTERISTIC mGRPMCRT "ROM Const mGRPMCRT" VALUE 0x00009190 REC_UWORD_C 0 COMP_0006 0 819187.5 /end CHARACTERISTIC
/begin CHARACTERISTIC mGRVACTTM "ROM Const mGRVACTTM" VALUE 0x0000861C REC_UBYTE_C 0 COMP_0049 0 255 /end CHARACTERISTIC
/begin CHARACTERISTIC mGRVAPO "ROM Const mGRVAPO" VALUE 0x00009192 REC_UWORD_C 0 COMP_0005 0 7208.85 /end CHARACTERISTIC
/begin CHARACTERISTIC mGRVFL "ROM Const mGRVFL" VALUE 0x0000861D REC_UBYTE_C 0 COMP_0135_S 0 0.99999984 /end CHARACTERISTIC
/begin CHARACTERISTIC mGRVOONGH "ROM Const mGRVOONGH" VALUE 0x00009194 REC_UWORD_C 0 COMP_0136_S -1.8907 240.5888 /end CHARACTERISTIC
/begin CHARACTERISTIC mGRVOONGL "ROM Const mGRVOONGL" VALUE 0x00009196 REC_UWORD_C 0 COMP_0136_S -1.8907 240.5888 /end CHARACTERISTIC
/begin CHARACTERISTIC mGRVOONGT "ROM Const mGRVOONGT" VALUE 0x0000861E REC_UBYTE_C 0 COMP_0049 0 255 /end CHARACTERISTIC
/begin CHARACTERISTIC mGRVRANGH "ROM Const mGRVRANGH" VALUE 0x00009198 REC_UWORD_C 0 COMP_0136_S -1.8907 240.5888 /end CHARACTERISTIC
/begin CHARACTERISTIC mGRVRANGL "ROM Const mGRVRANGL" VALUE 0x0000919A REC_UWORD_C 0 COMP_0136_S -1.8907 240.5888 /end CHARACTERISTIC
/begin CHARACTERISTIC mGRVRANGT "ROM Const mGRVRANGT" VALUE 0x0000861F REC_UBYTE_C 0 COMP_0016 0 255 /end CHARACTERISTIC
/begin CHARACTERISTIC mGRVSTTM "ROM Const mGRVSTTM" VALUE 0x00008620 REC_UBYTE_C 0 COMP_0049 0 255 /end CHARACTERISTIC
/begin CHARACTERISTIC mGRVVSP "ROM Const mGRVVSP" VALUE 0x00008621 REC_UBYTE_C 0 COMP_0007 0 510 /end CHARACTERISTIC
/begin CHARACTERISTIC mGRVVSTM "ROM Const mGRVVSTM" VALUE 0x00008622 REC_UBYTE_C 0 COMP_0049 0 255 /end CHARACTERISTIC
/begin CHARACTERISTIC mGSAVECR "ROM Const mGSAVECR" VALUE 0x0000919C REC_UWORD_C 0 COMP_0137_S 0 242.4795 /end CHARACTERISTIC
/begin CHARACTERISTIC mGSCALOK "ROM Const mGSCALOK" VALUE 0x00008623 REC_UBYTE_C 0 COMP_0137_S 0 0.9435 /end CHARACTERISTIC
/begin CHARACTERISTIC mGSGIN "ROM Const mGSGIN" VALUE 0x00008624 REC_UBYTE_C 0 COMP_0138_S 0 0.00255 /end CHARACTERISTIC
/begin CHARACTERISTIC mGSIDAPO "ROM Const mGSIDAPO" VALUE 0x0000919E REC_UWORD_C 0 COMP_0038 0 7208.85 /end CHARACTERISTIC
/begin CHARACTERISTIC mGSIDFD "ROM Const mGSIDFD" VALUE 0x000091A0 REC_UWORD_C 0 COMP_0064_S 0 65535 /end CHARACTERISTIC
/begin CHARACTERISTIC mGSIDFDHS "ROM Const mGSIDFDHS" VALUE 0x000091A2 REC_UWORD_C 0 COMP_0064_S 0 65535 /end CHARACTERISTIC
/begin CHARACTERISTIC mGSIGHLDT "ROM Const mGSIGHLDT" VALUE 0x00008625 REC_UBYTE_C 0 COMP_0105 0 25.5 /end CHARACTERISTIC
/begin CHARACTERISTIC mGSIMNONT "ROM Const mGSIMNONT" VALUE 0x00008626 REC_UBYTE_C 0 COMP_0105 0 25.5 /end CHARACTERISTIC
/begin CHARACTERISTIC mGSINXOKT "ROM Const mGSINXOKT" VALUE 0x00008627 REC_UBYTE_C 0 COMP_0105 0 25.5 /end CHARACTERISTIC
/begin CHARACTERISTIC mGSIOFFTM "ROM Const mGSIOFFTM" VALUE 0x00008628 REC_UBYTE_C 0 COMP_0105 0 25.5 /end CHARACTERISTIC
/begin CHARACTERISTIC mGSIUHDAP "ROM Const mGSIUHDAP" VALUE 0x000091A4 REC_UWORD_C 0 COMP_0038 0 7208.85 /end CHARACTERISTIC
/begin CHARACTERISTIC mGSIUPHLT "ROM Const mGSIUPHLT" VALUE 0x00008629 REC_UBYTE_C 0 COMP_0105 0 25.5 /end CHARACTERISTIC
/begin CHARACTERISTIC mGSIVCTM "ROM Const mGSIVCTM" VALUE 0x0000862A REC_UBYTE_C 0 COMP_0105 0 25.5 /end CHARACTERISTIC
/begin CHARACTERISTIC mGSOFST "ROM Const mGSOFST" VALUE 0x000091A6 REC_UWORD_C 0 COMP_0023 0 327675 /end CHARACTERISTIC
/begin CHARACTERISTIC mGTENG "ROM Const mGTENG" VALUE 0x0000862B REC_UBYTE_C 0 COMP_0009 0 199.21875 /end CHARACTERISTIC
/begin CHARACTERISTIC mGTVQLSR "ROM Const mGTVQLSR" VALUE 0x0000862C REC_UBYTE_C 0 COMP_0063 0 0.99609375 /end CHARACTERISTIC
/begin CHARACTERISTIC mGUARDRAC "ROM Const mGUARDRAC" VALUE 0x000091A8 REC_UWORD_C 0 COMP_0139_S 0 4095.9375 /end CHARACTERISTIC
/begin CHARACTERISTIC mGUARDW "ROM Const mGUARDW" VALUE 0x0000862D REC_UBYTE_C 0 COMP_0140_S 0 127.5 /end CHARACTERISTIC
/begin CHARACTERISTIC mGVCC "ROM Const mGVCC" VALUE 0x0000862E REC_UBYTE_C 0 COMP_0009 0 199.21875 /end CHARACTERISTIC
/begin CHARACTERISTIC mGVSPCRT "ROM Const mGVSPCRT" VALUE 0x0000862F REC_UBYTE_C 0 COMP_0007 0 510 /end CHARACTERISTIC
/begin CHARACTERISTIC mGVSPMSK "ROM Const mGVSPMSK" VALUE 0x00008630 REC_UBYTE_C 0 COMP_0007 0 510 /end CHARACTERISTIC
/begin CHARACTERISTIC mGVWKG "ROM Const mGVWKG" VALUE 0x00008631 REC_UBYTE_C 0 COMP_0141_S 0 5100 /end CHARACTERISTIC
/begin CHARACTERISTIC mGYAKUCNT "ROM Const mGYAKUCNT" VALUE 0x000091AA REC_UWORD_C 0 COMP_0142_S 0 0.065535 /end CHARACTERISTIC
/begin CHARACTERISTIC mH1D "ROM Const mH1D" VALUE 0x00008E38 REC_SWORD_C 0 COMP_0005_S -3.2768 3.2767 /end CHARACTERISTIC
/begin CHARACTERISTIC mH1N_1 "ROM Const mH1N_1" VALUE 0x00008E3A REC_SWORD_C 0 COMP_0005_S -3.2768 3.2767 /end CHARACTERISTIC
/begin CHARACTERISTIC mH1N_2 "ROM Const mH1N_2" VALUE 0x00008E3C REC_SWORD_C 0 COMP_0005_S -3.2768 3.2767 /end CHARACTERISTIC
/begin CHARACTERISTIC mH2D "ROM Const mH2D" VALUE 0x00008E3E REC_SWORD_C 0 COMP_0005_S -3.2768 3.2767 /end CHARACTERISTIC
/begin CHARACTERISTIC mH2N_1 "ROM Const mH2N_1" VALUE 0x00008E40 REC_SWORD_C 0 COMP_0005_S -3.2768 3.2767 /end CHARACTERISTIC
/begin CHARACTERISTIC mH2N_2 "ROM Const mH2N_2" VALUE 0x00008E42 REC_SWORD_C 0 COMP_0005_S -3.2768 3.2767 /end CHARACTERISTIC
/begin CHARACTERISTIC mHCRMCMTA "ROM Const mHCRMCMTA" VALUE 0x0000822F REC_SBYTE_C 0 COMP_0143_S -128 127 /end CHARACTERISTIC
/begin CHARACTERISTIC mHCRMCMTF "ROM Const mHCRMCMTF" VALUE 0x00008230 REC_SBYTE_C 0 COMP_0143_S -128 127 /end CHARACTERISTIC
/begin CHARACTERISTIC mHCRMCMTH "ROM Const mHCRMCMTH" VALUE 0x00008231 REC_SBYTE_C 0 COMP_0143_S -128 127 /end CHARACTERISTIC
/begin CHARACTERISTIC mHCRMCMTO "ROM Const mHCRMCMTO" VALUE 0x00008232 REC_SBYTE_C 0 COMP_0143_S -128 127 /end CHARACTERISTIC
/begin CHARACTERISTIC mHCRMCMTW "ROM Const mHCRMCMTW" VALUE 0x00008233 REC_SBYTE_C 0 COMP_0143_S -128 127 /end CHARACTERISTIC
/begin CHARACTERISTIC mHCSDLY "ROM Const mHCSDLY" VALUE 0x00008632 REC_UBYTE_C 0 COMP_0013 0 255 /end CHARACTERISTIC
/begin CHARACTERISTIC mHCUTVSP "ROM Const mHCUTVSP" VALUE 0x000096E4 REC_SLONG_C 0 COMP_0144_S -1843.20024746394 1843.20024660563 /end CHARACTERISTIC
/begin CHARACTERISTIC mHDTYMX1 "ROM Const mHDTYMX1" VALUE 0x00008633 REC_UBYTE_C 0 COMP_0047 0 127.5 /end CHARACTERISTIC
/begin CHARACTERISTIC mHEVID "ROM Const mHEVID" VALUE 0x00008634 REC_UBYTE_C 0 COMP_0068 0 255 /end CHARACTERISTIC
/begin CHARACTERISTIC mHFPCOF "ROM Const mHFPCOF" VALUE 0x000091AC REC_UWORD_C 0 COMP_0168 0 83884.8 /end CHARACTERISTIC
/begin CHARACTERISTIC mHGP1D "ROM Const mHGP1D" VALUE 0x00008E44 REC_SWORD_C 0 COMP_0005_S -3.2768 3.2767 /end CHARACTERISTIC
/begin CHARACTERISTIC mHGP1N_1 "ROM Const mHGP1N_1" VALUE 0x000096E8 REC_SLONG_C 0 COMP_0005_S -214748.3648 214748.3647 /end CHARACTERISTIC
/begin CHARACTERISTIC mHGP1N_2 "ROM Const mHGP1N_2" VALUE 0x000096EC REC_SLONG_C 0 COMP_0005_S -214748.3648 214748.3647 /end CHARACTERISTIC
/begin CHARACTERISTIC mHGP1N_3 "ROM Const mHGP1N_3" VALUE 0x000096F0 REC_SLONG_C 0 COMP_0005_S -214748.3648 214748.3647 /end CHARACTERISTIC
/begin CHARACTERISTIC mHGP2D "ROM Const mHGP2D" VALUE 0x00008E46 REC_SWORD_C 0 COMP_0005_S -3.2768 3.2767 /end CHARACTERISTIC
/begin CHARACTERISTIC mHGP2N_1 "ROM Const mHGP2N_1" VALUE 0x000096F4 REC_SLONG_C 0 COMP_0005_S -214748.3648 214748.3647 /end CHARACTERISTIC
/begin CHARACTERISTIC mHGP2N_2 "ROM Const mHGP2N_2" VALUE 0x000096F8 REC_SLONG_C 0 COMP_0005_S -214748.3648 214748.3647 /end CHARACTERISTIC
/begin CHARACTERISTIC mHGP2N_3 "ROM Const mHGP2N_3" VALUE 0x000096FC REC_SLONG_C 0 COMP_0005_S -214748.3648 214748.3647 /end CHARACTERISTIC
/begin CHARACTERISTIC mHIERAPDF "ROM Const mHIERAPDF" VALUE 0x000091AE REC_UWORD_C 0 COMP_0005 0 7208.85 /end CHARACTERISTIC
/begin CHARACTERISTIC mHIERATQ "ROM Const mHIERATQ" VALUE 0x00008E48 REC_SWORD_C 0 COMP_0228 -3276.8 3276.7 /end CHARACTERISTIC
/begin CHARACTERISTIC mHIERTEDF "ROM Const mHIERTEDF" VALUE 0x000091B0 REC_UWORD_C 0 COMP_0328 0 399.99392106 /end CHARACTERISTIC
/begin CHARACTERISTIC mHIERTEGA "ROM Const mHIERTEGA" VALUE 0x000091B2 REC_UWORD_C 0 COMP_0328 0 399.99392106 /end CHARACTERISTIC
/begin CHARACTERISTIC mHIERTEOT "ROM Const mHIERTEOT" VALUE 0x00008E4A REC_SWORD_C 0 COMP_0228 -3276.8 3276.7 /end CHARACTERISTIC
/begin CHARACTERISTIC mHITAR "ROM Const mHITAR" VALUE 0x00008636 REC_UBYTE_C 0 COMP_0048 0 127.5 /end CHARACTERISTIC
/begin CHARACTERISTIC mHITARE "ROM Const mHITARE" VALUE 0x00008637 REC_UBYTE_C 0 COMP_0048 0 127.5 /end CHARACTERISTIC
/begin CHARACTERISTIC mHITFNG "ROM Const mHITFNG" VALUE 0x00008638 REC_UBYTE_C 0 COMP_0054 0 5100 /end CHARACTERISTIC
/begin CHARACTERISTIC mHLCVTFD "ROM Const mHLCVTFD" VALUE 0x000091B4 REC_UWORD_C 0 COMP_0064_S 0 65535 /end CHARACTERISTIC
/begin CHARACTERISTIC mHLCVTHYS "ROM Const mHLCVTHYS" VALUE 0x000091B6 REC_UWORD_C 0 COMP_0064_S 0 65535 /end CHARACTERISTIC
/begin CHARACTERISTIC mHLDELTA "ROM Const mHLDELTA" VALUE 0x00008639 REC_UBYTE_C 0 COMP_0004_S -50 205 /end CHARACTERISTIC
/begin CHARACTERISTIC mHLDELTO "ROM Const mHLDELTO" VALUE 0x0000863A REC_UBYTE_C 0 COMP_0004_S -50 205 /end CHARACTERISTIC
/begin CHARACTERISTIC mHLDELTW "ROM Const mHLDELTW" VALUE 0x0000863B REC_UBYTE_C 0 COMP_0004_S -50 205 /end CHARACTERISTIC
/begin CHARACTERISTIC mHLDPR_FA "ROM Const mHLDPR_FA" VALUE 0x0000863C REC_UBYTE_C 0 COMP_0373 0 2.55 /end CHARACTERISTIC
/begin CHARACTERISTIC mHLDPR_FO "ROM Const mHLDPR_FO" VALUE 0x0000863D REC_UBYTE_C 0 COMP_0373 0 2.55 /end CHARACTERISTIC
/begin CHARACTERISTIC mHLDPR_FW "ROM Const mHLDPR_FW" VALUE 0x0000863E REC_UBYTE_C 0 COMP_0373 0 2.55 /end CHARACTERISTIC
/begin CHARACTERISTIC mHLFGAGE2 "ROM Const mHLFGAGE2" VALUE 0x000091B8 REC_UWORD_C 0 COMP_0145_S 0 5.119921875 /end CHARACTERISTIC
/begin CHARACTERISTIC mHLMINTMP "ROM Const mHLMINTMP" VALUE 0x0000863F REC_UBYTE_C 0 COMP_0004_S -50 205 /end CHARACTERISTIC
/begin CHARACTERISTIC mHLRMAX "ROM Const mHLRMAX" VALUE 0x00008640 REC_UBYTE_C 0 COMP_0027 0 255 /end CHARACTERISTIC
/begin CHARACTERISTIC mHLRMIN "ROM Const mHLRMIN" VALUE 0x00008641 REC_UBYTE_C 0 COMP_0027 0 255 /end CHARACTERISTIC
/begin CHARACTERISTIC mHLSTNG "ROM Const mHLSTNG" VALUE 0x00008642 REC_UBYTE_C 0 COMP_0030 0 255 /end CHARACTERISTIC
/begin CHARACTERISTIC mHLTOEND "ROM Const mHLTOEND" VALUE 0x00008643 REC_UBYTE_C 0 COMP_0004_S -50 205 /end CHARACTERISTIC
/begin CHARACTERISTIC mHLTWEND "ROM Const mHLTWEND" VALUE 0x00008644 REC_UBYTE_C 0 COMP_0004_S -50 205 /end CHARACTERISTIC
/begin CHARACTERISTIC mHNKBDH "ROM Const mHNKBDH" VALUE 0x00008645 REC_UBYTE_C 0 COMP_0020 0 12750 /end CHARACTERISTIC
/begin CHARACTERISTIC mHNKBDL "ROM Const mHNKBDL" VALUE 0x00008646 REC_UBYTE_C 0 COMP_0020 0 12750 /end CHARACTERISTIC
/begin CHARACTERISTIC mHNKBH "ROM Const mHNKBH" VALUE 0x00008647 REC_UBYTE_C 0 COMP_0020 0 12750 /end CHARACTERISTIC
/begin CHARACTERISTIC mHNKBL "ROM Const mHNKBL" VALUE 0x00008648 REC_UBYTE_C 0 COMP_0020 0 12750 /end CHARACTERISTIC
/begin CHARACTERISTIC mHNTN "ROM Const mHNTN" VALUE 0x00008649 REC_UBYTE_C 0 COMP_0016 0 255 /end CHARACTERISTIC
/begin CHARACTERISTIC mHNTPS "ROM Const mHNTPS" VALUE 0x000091BA REC_UWORD_C 0 COMP_0006 0 819187.5 /end CHARACTERISTIC
/begin CHARACTERISTIC mHOSA1 "ROM Const mHOSA1" VALUE 0x000091BC REC_UWORD_C 0 COMP_0146_S 0 3.999928725 /end CHARACTERISTIC
/begin CHARACTERISTIC mHOSA2 "ROM Const mHOSA2" VALUE 0x000091BE REC_UWORD_C 0 COMP_0146_S 0 3.999928725 /end CHARACTERISTIC
/begin CHARACTERISTIC mHOSAFSH "ROM Const mHOSAFSH" VALUE 0x00008E4C REC_SWORD_C 0 COMP_0020_S -65.536 65.534 /end CHARACTERISTIC
/begin CHARACTERISTIC mHOSAFSL "ROM Const mHOSAFSL" VALUE 0x00008E4E REC_SWORD_C 0 COMP_0020_S -65.536 65.534 /end CHARACTERISTIC
/begin CHARACTERISTIC mHOSB1 "ROM Const mHOSB1" VALUE 0x000091C0 REC_UWORD_C 0 COMP_0147_S 0 3999.93894846 /end CHARACTERISTIC
/begin CHARACTERISTIC mHOSB2 "ROM Const mHOSB2" VALUE 0x000091C2 REC_UWORD_C 0 COMP_0147_S 0 3999.93894846 /end CHARACTERISTIC
/begin CHARACTERISTIC mHOSCINT "ROM Const mHOSCINT" VALUE 0x00009700 REC_SLONG_C 0 COMP_0148_S -21474836.48 21474836.47 /end CHARACTERISTIC
/begin CHARACTERISTIC mHOSHONT "ROM Const mHOSHONT" VALUE 0x0000864A REC_UBYTE_C 0 COMP_0008 0 25500 /end CHARACTERISTIC
/begin CHARACTERISTIC mHOSLTM "ROM Const mHOSLTM" VALUE 0x0000864B REC_UBYTE_C 0 COMP_0008 0 25500 /end CHARACTERISTIC
/begin CHARACTERISTIC mHOSNH "ROM Const mHOSNH" VALUE 0x0000864C REC_UBYTE_C 0 COMP_0000 0 6375 /end CHARACTERISTIC
/begin CHARACTERISTIC mHOSNL "ROM Const mHOSNL" VALUE 0x0000864D REC_UBYTE_C 0 COMP_0000 0 6375 /end CHARACTERISTIC
/begin CHARACTERISTIC mHOSTPH "ROM Const mHOSTPH" VALUE 0x0000864E REC_UBYTE_C 0 COMP_0001 0 31.875 /end CHARACTERISTIC
/begin CHARACTERISTIC mHOSTPL "ROM Const mHOSTPL" VALUE 0x0000864F REC_UBYTE_C 0 COMP_0001 0 31.875 /end CHARACTERISTIC
/begin CHARACTERISTIC mHOSWLRC "ROM Const mHOSWLRC" VALUE 0x00008650 REC_UBYTE_C 0 COMP_0035 -50 205 /end CHARACTERISTIC
/begin CHARACTERISTIC mHOSWLRH "ROM Const mHOSWLRH" VALUE 0x00008651 REC_UBYTE_C 0 COMP_0035 -50 205 /end CHARACTERISTIC
/begin CHARACTERISTIC mHOTIDLMX "ROM Const mHOTIDLMX" VALUE 0x00008652 REC_UBYTE_C 0 COMP_0419 0 25.5 /end CHARACTERISTIC
/begin CHARACTERISTIC mHPBSTAN "ROM Const mHPBSTAN" VALUE 0x00008653 REC_UBYTE_C 0 COMP_0016 0 255 /end CHARACTERISTIC
/begin CHARACTERISTIC mHPFJDG "ROM Const mHPFJDG" VALUE 0x000091C4 REC_UWORD_C 0 COMP_0031_S 0 39.97635 /end CHARACTERISTIC
/begin CHARACTERISTIC mHPGNDTNG "ROM Const mHPGNDTNG" VALUE 0x00008654 REC_UBYTE_C 0 COMP_0030 0 255 /end CHARACTERISTIC
/begin CHARACTERISTIC mHPHDIN "ROM Const mHPHDIN" VALUE 0x00008655 REC_UBYTE_C 0 COMP_0149_S 0 51 /end CHARACTERISTIC
/begin CHARACTERISTIC mHPHDIN2 "ROM Const mHPHDIN2" VALUE 0x00008656 REC_UBYTE_C 0 COMP_0149_S 0 51 /end CHARACTERISTIC
/begin CHARACTERISTIC mHPHDINE "ROM Const mHPHDINE" VALUE 0x00008657 REC_UBYTE_C 0 COMP_0020 0 12750 /end CHARACTERISTIC
/begin CHARACTERISTIC mHPHDINHY "ROM Const mHPHDINHY" VALUE 0x00008658 REC_UBYTE_C 0 COMP_0020 0 12750 /end CHARACTERISTIC
/begin CHARACTERISTIC mHPHYSIN "ROM Const mHPHYSIN" VALUE 0x00008659 REC_UBYTE_C 0 COMP_0150_S 0.4 51.4 /end CHARACTERISTIC
/begin CHARACTERISTIC mHPPHTIN "ROM Const mHPPHTIN" VALUE 0x0000865A REC_UBYTE_C 0 COMP_0151_S 0 102000 /end CHARACTERISTIC
/begin CHARACTERISTIC mHPPHTIN2 "ROM Const mHPPHTIN2" VALUE 0x0000865B REC_UBYTE_C 0 COMP_0151_S 0 102000 /end CHARACTERISTIC
/begin CHARACTERISTIC mHPPHTIN3 "ROM Const mHPPHTIN3" VALUE 0x0000865C REC_UBYTE_C 0 COMP_0151_S 0 102000 /end CHARACTERISTIC
/begin CHARACTERISTIC mHPPHTIN4 "ROM Const mHPPHTIN4" VALUE 0x0000865D REC_UBYTE_C 0 COMP_0151_S 0 102000 /end CHARACTERISTIC
/begin CHARACTERISTIC mHPPHTVB1 "ROM Const mHPPHTVB1" VALUE 0x0000865E REC_UBYTE_C 0 COMP_0033 0 20400 /end CHARACTERISTIC
/begin CHARACTERISTIC mHPPHTVB2 "ROM Const mHPPHTVB2" VALUE 0x0000865F REC_UBYTE_C 0 COMP_0033 0 20400 /end CHARACTERISTIC
/begin CHARACTERISTIC mHPPHTVB3 "ROM Const mHPPHTVB3" VALUE 0x00008660 REC_UBYTE_C 0 COMP_0033 0 20400 /end CHARACTERISTIC
/begin CHARACTERISTIC mHPPKIN "ROM Const mHPPKIN" VALUE 0x00008661 REC_UBYTE_C 0 COMP_0149_S 0 51 /end CHARACTERISTIC
/begin CHARACTERISTIC mHPPKIN2 "ROM Const mHPPKIN2" VALUE 0x00008662 REC_UBYTE_C 0 COMP_0149_S 0 51 /end CHARACTERISTIC
/begin CHARACTERISTIC mHPPKNE "ROM Const mHPPKNE" VALUE 0x00008663 REC_UBYTE_C 0 COMP_0000 0 6375 /end CHARACTERISTIC
/begin CHARACTERISTIC mHPPKNEHY "ROM Const mHPPKNEHY" VALUE 0x00008664 REC_UBYTE_C 0 COMP_0000 0 6375 /end CHARACTERISTIC
/begin CHARACTERISTIC mHPPKTM "ROM Const mHPPKTM" VALUE 0x00008665 REC_UBYTE_C 0 COMP_0013 0 255 /end CHARACTERISTIC
/begin CHARACTERISTIC mHPVBSTNG "ROM Const mHPVBSTNG" VALUE 0x00008666 REC_UBYTE_C 0 COMP_0030 0 255 /end CHARACTERISTIC
/begin CHARACTERISTIC mHPWDLY "ROM Const mHPWDLY" VALUE 0x000091C6 REC_UWORD_C 0 COMP_0152_S 0 419424 /end CHARACTERISTIC
/begin CHARACTERISTIC mHQAC "ROM Const mHQAC" VALUE 0x00008667 REC_UBYTE_C 0 COMP_0051 0 255 /end CHARACTERISTIC
/begin CHARACTERISTIC mHRGAGEH "ROM Const mHRGAGEH" VALUE 0x000091C8 REC_UWORD_C 0 COMP_0050 0 5119.921875 /end CHARACTERISTIC
/begin CHARACTERISTIC mHRGAGEL "ROM Const mHRGAGEL" VALUE 0x000091CA REC_UWORD_C 0 COMP_0050 0 5119.921875 /end CHARACTERISTIC
/begin CHARACTERISTIC mHRVSPDGN "ROM Const mHRVSPDGN" VALUE 0x000091CC REC_UWORD_C 0 COMP_0436 0 6553.5 /end CHARACTERISTIC
/begin CHARACTERISTIC mHSOSQH "ROM Const mHSOSQH" VALUE 0x00009704 REC_SLONG_C 0 COMP_0148_S -21474836.48 21474836.47 /end CHARACTERISTIC
/begin CHARACTERISTIC mHSOSQL "ROM Const mHSOSQL" VALUE 0x00009708 REC_SLONG_C 0 COMP_0148_S -21474836.48 21474836.47 /end CHARACTERISTIC
/begin CHARACTERISTIC mHSPDLY "ROM Const mHSPDLY" VALUE 0x00008668 REC_UBYTE_C 0 COMP_0015_S 0 25.5 /end CHARACTERISTIC
/begin CHARACTERISTIC mHSTPGHT "ROM Const mHSTPGHT" VALUE 0x00008669 REC_UBYTE_C 0 COMP_0003 0 255 /end CHARACTERISTIC
/begin CHARACTERISTIC mHSTPIST "ROM Const mHSTPIST" VALUE 0x0000866A REC_UBYTE_C 0 COMP_0003 0 255 /end CHARACTERISTIC
/begin CHARACTERISTIC mHTPRDLY "ROM Const mHTPRDLY" VALUE 0x0000866B REC_UBYTE_C 0 COMP_0088_S 0 2.55 /end CHARACTERISTIC
/begin CHARACTERISTIC mHTRPMH "ROM Const mHTRPMH" VALUE 0x0000866C REC_UBYTE_C 0 COMP_0000 0 6375 /end CHARACTERISTIC
/begin CHARACTERISTIC mHTTWNH "ROM Const mHTTWNH" VALUE 0x0000866D REC_UBYTE_C 0 COMP_0035 -50 205 /end CHARACTERISTIC
/begin CHARACTERISTIC mHTVSPH "ROM Const mHTVSPH" VALUE 0x0000866E REC_UBYTE_C 0 COMP_0007 0 510 /end CHARACTERISTIC
/begin CHARACTERISTIC mHTWLMTMX "ROM Const mHTWLMTMX" VALUE 0x0000866F REC_UBYTE_C 0 COMP_0035 -50 205 /end CHARACTERISTIC
/begin CHARACTERISTIC mHTWLMTST "ROM Const mHTWLMTST" VALUE 0x00008670 REC_UBYTE_C 0 COMP_0035 -50 205 /end CHARACTERISTIC
/begin CHARACTERISTIC mHTWTEDLD "ROM Const mHTWTEDLD" VALUE 0x00008671 REC_UBYTE_C 0 COMP_0038_S 0 25.5 /end CHARACTERISTIC
/begin CHARACTERISTIC mHTWTEDLU "ROM Const mHTWTEDLU" VALUE 0x00008672 REC_UBYTE_C 0 COMP_0038_S 0 25.5 /end CHARACTERISTIC
/begin CHARACTERISTIC mHTWTWDLD "ROM Const mHTWTWDLD" VALUE 0x000091CE REC_UWORD_C 0 COMP_0153_S 0 255.99609375 /end CHARACTERISTIC
/begin CHARACTERISTIC mHTWTWDLU "ROM Const mHTWTWDLU" VALUE 0x000091D0 REC_UWORD_C 0 COMP_0153_S 0 255.99609375 /end CHARACTERISTIC
/begin CHARACTERISTIC mHTWVSP "ROM Const mHTWVSP" VALUE 0x00008673 REC_UBYTE_C 0 COMP_0007 0 510 /end CHARACTERISTIC
/begin CHARACTERISTIC mHVFUEL "ROM Const mHVFUEL" VALUE 0x000091D2 REC_UWORD_C 0 COMP_0023 0 327675 /end CHARACTERISTIC
/begin CHARACTERISTIC mHYASCD "ROM Const mHYASCD" VALUE 0x000091D4 REC_UWORD_C 0 COMP_0115 0 99.9998565 /end CHARACTERISTIC
/begin CHARACTERISTIC mHYHLPFH "ROM Const mHYHLPFH" VALUE 0x000091D6 REC_UWORD_C 0 COMP_0031_S 0 39.97635 /end CHARACTERISTIC
/begin CHARACTERISTIC mHYLFPFB "ROM Const mHYLFPFB" VALUE 0x000091D8 REC_UWORD_C 0 COMP_0031_S 0 39.97635 /end CHARACTERISTIC
/begin CHARACTERISTIC mHYSICT "ROM Const mHYSICT" VALUE 0x000091DA REC_UWORD_C 0 COMP_0154_S 0 8191.875 /end CHARACTERISTIC
/begin CHARACTERISTIC mHYSITC "ROM Const mHYSITC" VALUE 0x00008674 REC_UBYTE_C 0 COMP_0009 0 199.21875 /end CHARACTERISTIC
/begin CHARACTERISTIC mHYSKHT "ROM Const mHYSKHT" VALUE 0x00008675 REC_UBYTE_C 0 COMP_0003 0 255 /end CHARACTERISTIC
/begin CHARACTERISTIC mHYSL "ROM Const mHYSL" VALUE 0x000091DC REC_UWORD_C 0 COMP_0146 0 99.998480265 /end CHARACTERISTIC
/begin CHARACTERISTIC mHYSL2MNH "ROM Const mHYSL2MNH" VALUE 0x000091DE REC_UWORD_C 0 COMP_0031_S 0 39.97635 /end CHARACTERISTIC
/begin CHARACTERISTIC mHYSL2MXH "ROM Const mHYSL2MXH" VALUE 0x000091E0 REC_UWORD_C 0 COMP_0031_S 0 39.97635 /end CHARACTERISTIC
/begin CHARACTERISTIC mHYSPR "ROM Const mHYSPR" VALUE 0x00008676 REC_UBYTE_C 0 COMP_0011 0 5.1 /end CHARACTERISTIC
/begin CHARACTERISTIC mHYSPR1 "ROM Const mHYSPR1" VALUE 0x00008677 REC_UBYTE_C 0 COMP_0011 0 5.1 /end CHARACTERISTIC
/begin CHARACTERISTIC mHYSPR2 "ROM Const mHYSPR2" VALUE 0x00008678 REC_UBYTE_C 0 COMP_0011 0 5.1 /end CHARACTERISTIC
/begin CHARACTERISTIC mHYSPR3 "ROM Const mHYSPR3" VALUE 0x00008679 REC_UBYTE_C 0 COMP_0011 0 5.1 /end CHARACTERISTIC
/begin CHARACTERISTIC mHYSRECVO "ROM Const mHYSRECVO" VALUE 0x0000867A REC_UBYTE_C 0 COMP_0155_S 0 7.96875 /end CHARACTERISTIC
/begin CHARACTERISTIC mHYSTIST "ROM Const mHYSTIST" VALUE 0x000091E2 REC_UWORD_C 0 COMP_0125 0 255.99609375 /end CHARACTERISTIC
/begin CHARACTERISTIC mHYSTMP "ROM Const mHYSTMP" VALUE 0x0000867B REC_UBYTE_C 0 COMP_0009_S 0 84.9999915 /end CHARACTERISTIC
/begin CHARACTERISTIC mHYSTMPEI "ROM Const mHYSTMPEI" VALUE 0x0000867C REC_UBYTE_C 0 COMP_0156_S 0 84.999999915 /end CHARACTERISTIC
/begin CHARACTERISTIC mHYSTWN "ROM Const mHYSTWN" VALUE 0x0000867D REC_UBYTE_C 0 COMP_0003 0 255 /end CHARACTERISTIC
/begin CHARACTERISTIC mHYSVSP "ROM Const mHYSVSP" VALUE 0x0000867E REC_UBYTE_C 0 COMP_0007 0 510 /end CHARACTERISTIC
/begin CHARACTERISTIC mHYSVSP1 "ROM Const mHYSVSP1" VALUE 0x0000867F REC_UBYTE_C 0 COMP_0007 0 510 /end CHARACTERISTIC
/begin CHARACTERISTIC mHYSVTER "ROM Const mHYSVTER" VALUE 0x00008680 REC_UBYTE_C 0 COMP_0048 0 127.5 /end CHARACTERISTIC
/begin CHARACTERISTIC mICAT "ROM Const mICAT" VALUE 0x00008681 REC_UBYTE_C 0 COMP_0031 0 0.99609375 /end CHARACTERISTIC
/begin CHARACTERISTIC mICHGTM "ROM Const mICHGTM" VALUE 0x000091E4 REC_UWORD_C 0 COMP_0157_S 0 104856 /end CHARACTERISTIC
/begin CHARACTERISTIC mICHGTMVC "ROM Const mICHGTMVC" VALUE 0x000091E6 REC_UWORD_C 0 COMP_0157_S 0 104856 /end CHARACTERISTIC
/begin CHARACTERISTIC mICLTOP "ROM Const mICLTOP" VALUE 0x00008682 REC_UBYTE_C 0 COMP_0031 0 0.99609375 /end CHARACTERISTIC
/begin CHARACTERISTIC mICPLRTO "ROM Const mICPLRTO" VALUE 0x000091E8 REC_UWORD_C 0 COMP_0456 0 1.999970916 /end CHARACTERISTIC
/begin CHARACTERISTIC mICPLRT_S "ROM Const mICPLRT_S" VALUE 0x00015A0C REC_UWORD_C 0 COMP_0456 0 1.999970916 /end CHARACTERISTIC
/begin CHARACTERISTIC mICSPING "ROM Const mICSPING" VALUE 0x00008683 REC_UBYTE_C 0 COMP_0030 0 255 /end CHARACTERISTIC
/begin CHARACTERISTIC mICSPINGP "ROM Const mICSPINGP" VALUE 0x00008684 REC_UBYTE_C 0 COMP_0030 0 255 /end CHARACTERISTIC
/begin CHARACTERISTIC mICTDLY "ROM Const mICTDLY" VALUE 0x00008685 REC_UBYTE_C 0 COMP_0013 0 255 /end CHARACTERISTIC
/begin CHARACTERISTIC mICTMPNH "ROM Const mICTMPNH" VALUE 0x000091EA REC_UWORD_C 0 COMP_0158_S -50 8141.875 /end CHARACTERISTIC
/begin CHARACTERISTIC mICTMPNH2 "ROM Const mICTMPNH2" VALUE 0x000091EC REC_UWORD_C 0 COMP_0158_S -50 8141.875 /end CHARACTERISTIC
/begin CHARACTERISTIC mICTNGJDG "ROM Const mICTNGJDG" VALUE 0x000091EE REC_UWORD_C 0 COMP_0023 0 327675 /end CHARACTERISTIC
/begin CHARACTERISTIC mICTNGTPF "ROM Const mICTNGTPF" VALUE 0x00008686 REC_UBYTE_C 0 COMP_0087_S 0 19.9104 /end CHARACTERISTIC
/begin CHARACTERISTIC mIDAPSOFS "ROM Const mIDAPSOFS" VALUE 0x000091F0 REC_UWORD_C 0 COMP_0023 0 327675 /end CHARACTERISTIC
/begin CHARACTERISTIC mIDCFDCTC "ROM Const mIDCFDCTC" VALUE 0x000091F2 REC_UWORD_C 0 COMP_0066_S 0 6553.5 /end CHARACTERISTIC
/begin CHARACTERISTIC mIDCFECTC "ROM Const mIDCFECTC" VALUE 0x000091F4 REC_UWORD_C 0 COMP_0066_S 0 6553.5 /end CHARACTERISTIC
/begin CHARACTERISTIC mIDCVSP "ROM Const mIDCVSP" VALUE 0x00008688 REC_UBYTE_C 0 COMP_0007 0 510 /end CHARACTERISTIC
/begin CHARACTERISTIC mIDLDLY "ROM Const mIDLDLY" VALUE 0x00008689 REC_UBYTE_C 0 COMP_0013 0 255 /end CHARACTERISTIC
/begin CHARACTERISTIC mIDLDT "ROM Const mIDLDT" VALUE 0x000091F6 REC_UWORD_C 0 COMP_0016 0 65535 /end CHARACTERISTIC
/begin CHARACTERISTIC mIDLEMXPR "ROM Const mIDLEMXPR" VALUE 0x0000868A REC_UBYTE_C 0 COMP_0419 0 25.5 /end CHARACTERISTIC
/begin CHARACTERISTIC mIDLENITQ "ROM Const mIDLENITQ" VALUE 0x0000868B REC_UBYTE_C 0 COMP_0159_S -64 63.5 /end CHARACTERISTIC
/begin CHARACTERISTIC mIDLEREF "ROM Const mIDLEREF" VALUE 0x0000868C REC_UBYTE_C 0 COMP_0068 0 255 /end CHARACTERISTIC
/begin CHARACTERISTIC mIDLFBHS "ROM Const mIDLFBHS" VALUE 0x0000868D REC_UBYTE_C 0 COMP_0419 0 25.5 /end CHARACTERISTIC
/begin CHARACTERISTIC mIDLFHLM "ROM Const mIDLFHLM" VALUE 0x0000868E REC_UBYTE_C 0 COMP_0419 0 25.5 /end CHARACTERISTIC
/begin CHARACTERISTIC mIDLGIRCT "ROM Const mIDLGIRCT" VALUE 0x0000868F REC_UBYTE_C 0 COMP_0016 0 255 /end CHARACTERISTIC
/begin CHARACTERISTIC mIDLJGDLY "ROM Const mIDLJGDLY" VALUE 0x00008690 REC_UBYTE_C 0 COMP_0049 0 255 /end CHARACTERISTIC
/begin CHARACTERISTIC mIDLLDY "ROM Const mIDLLDY" VALUE 0x00008691 REC_UBYTE_C 0 COMP_0015_S 0 25.5 /end CHARACTERISTIC
/begin CHARACTERISTIC mIDLLPR "ROM Const mIDLLPR" VALUE 0x00008692 REC_UBYTE_C 0 COMP_0027 0 255 /end CHARACTERISTIC
/begin CHARACTERISTIC mIDLLVSP "ROM Const mIDLLVSP" VALUE 0x00008693 REC_UBYTE_C 0 COMP_0007 0 510 /end CHARACTERISTIC
/begin CHARACTERISTIC mIDLOKPAF "ROM Const mIDLOKPAF" VALUE 0x00008694 REC_UBYTE_C 0 COMP_0464 0 31.875 /end CHARACTERISTIC
/begin CHARACTERISTIC mIDLTM "ROM Const mIDLTM" VALUE 0x00008695 REC_UBYTE_C 0 COMP_0008 0 25500 /end CHARACTERISTIC
/begin CHARACTERISTIC mIDLTM2 "ROM Const mIDLTM2" VALUE 0x00008696 REC_UBYTE_C 0 COMP_0008 0 25500 /end CHARACTERISTIC
/begin CHARACTERISTIC mIDMP "ROM Const mIDMP" VALUE 0x00008697 REC_UBYTE_C 0 COMP_0021 0 99.609375 /end CHARACTERISTIC
/begin CHARACTERISTIC mIDUTYG "ROM Const mIDUTYG" VALUE 0x000091F8 REC_UWORD_C 0 COMP_0160_S 0 204.796875 /end CHARACTERISTIC
/begin CHARACTERISTIC mIDVDLY2 "ROM Const mIDVDLY2" VALUE 0x000086A2 REC_UBYTE_C 0 COMP_0008 0 25500 /end CHARACTERISTIC
/begin CHARACTERISTIC mIDVTDLY "ROM Const mIDVTDLY" VALUE 0x000086A3 REC_UBYTE_C 0 COMP_0008 0 25500 /end CHARACTERISTIC
/begin CHARACTERISTIC mIDVTNEL "ROM Const mIDVTNEL" VALUE 0x000086A4 REC_UBYTE_C 0 COMP_0006 0 3187.5 /end CHARACTERISTIC
/begin CHARACTERISTIC mIDVTNHS "ROM Const mIDVTNHS" VALUE 0x000086A5 REC_UBYTE_C 0 COMP_0006 0 3187.5 /end CHARACTERISTIC
/begin CHARACTERISTIC mIDVTPB "ROM Const mIDVTPB" VALUE 0x000091FA REC_UWORD_C 0 COMP_0486 0 5119.921875 /end CHARACTERISTIC
/begin CHARACTERISTIC mIDVTTAH "ROM Const mIDVTTAH" VALUE 0x000086A6 REC_UBYTE_C 0 COMP_0035 -50 205 /end CHARACTERISTIC
/begin CHARACTERISTIC mIDVTTAL "ROM Const mIDVTTAL" VALUE 0x000086A7 REC_UBYTE_C 0 COMP_0035 -50 205 /end CHARACTERISTIC
/begin CHARACTERISTIC mIDVTTOH "ROM Const mIDVTTOH" VALUE 0x000086A8 REC_UBYTE_C 0 COMP_0035 -50 205 /end CHARACTERISTIC
/begin CHARACTERISTIC mIDVTTOHE "ROM Const mIDVTTOHE" VALUE 0x000086A9 REC_UBYTE_C 0 COMP_0035 -50 205 /end CHARACTERISTIC
/begin CHARACTERISTIC mIDVTTOL "ROM Const mIDVTTOL" VALUE 0x000086AA REC_UBYTE_C 0 COMP_0035 -50 205 /end CHARACTERISTIC
/begin CHARACTERISTIC mIDVTTOLE "ROM Const mIDVTTOLE" VALUE 0x000086AB REC_UBYTE_C 0 COMP_0035 -50 205 /end CHARACTERISTIC
/begin CHARACTERISTIC mIDVTTP "ROM Const mIDVTTP" VALUE 0x000091FC REC_UWORD_C 0 COMP_0144 0 31.999495335 /end CHARACTERISTIC
/begin CHARACTERISTIC mIDVTTWH "ROM Const mIDVTTWH" VALUE 0x000086AC REC_UBYTE_C 0 COMP_0035 -50 205 /end CHARACTERISTIC
/begin CHARACTERISTIC mIDVTTWH2 "ROM Const mIDVTTWH2" VALUE 0x000086AD REC_UBYTE_C 0 COMP_0035 -50 205 /end CHARACTERISTIC
/begin CHARACTERISTIC mIDVTTWHE "ROM Const mIDVTTWHE" VALUE 0x000086AE REC_UBYTE_C 0 COMP_0035 -50 205 /end CHARACTERISTIC
/begin CHARACTERISTIC mIDVTTWL "ROM Const mIDVTTWL" VALUE 0x000086AF REC_UBYTE_C 0 COMP_0035 -50 205 /end CHARACTERISTIC
/begin CHARACTERISTIC mIDVTTWL2 "ROM Const mIDVTTWL2" VALUE 0x000086B0 REC_UBYTE_C 0 COMP_0035 -50 205 /end CHARACTERISTIC
/begin CHARACTERISTIC mIDVTTWLE "ROM Const mIDVTTWLE" VALUE 0x000086B1 REC_UBYTE_C 0 COMP_0035 -50 205 /end CHARACTERISTIC
/begin CHARACTERISTIC mIDVTVSP "ROM Const mIDVTVSP" VALUE 0x000086B2 REC_UBYTE_C 0 COMP_0007 0 510 /end CHARACTERISTIC
/begin CHARACTERISTIC mIERRTIM "ROM Const mIERRTIM" VALUE 0x000086B3 REC_UBYTE_C 0 COMP_0008 0 25500 /end CHARACTERISTIC
/begin CHARACTERISTIC mIGAD "ROM Const mIGAD" VALUE 0x000091FE REC_UWORD_C 0 COMP_0050 0 5119.921875 /end CHARACTERISTIC
/begin CHARACTERISTIC mIGBTLMT "ROM Const mIGBTLMT" VALUE 0x00009200 REC_UWORD_C 0 COMP_0161_S 0 2097120 /end CHARACTERISTIC
/begin CHARACTERISTIC mIJFSRPM "ROM Const mIJFSRPM" VALUE 0x00009202 REC_UWORD_C 0 COMP_0162_S 0 51199.21875 /end CHARACTERISTIC
/begin CHARACTERISTIC mIJLWDLY "ROM Const mIJLWDLY" VALUE 0x00009204 REC_UWORD_C 0 COMP_0157_S 0 104856 /end CHARACTERISTIC
/begin CHARACTERISTIC mIJSNEH "ROM Const mIJSNEH" VALUE 0x000086B4 REC_UBYTE_C 0 COMP_0000 0 6375 /end CHARACTERISTIC
/begin CHARACTERISTIC mIJVCNEHS "ROM Const mIJVCNEHS" VALUE 0x000086B5 REC_UBYTE_C 0 COMP_0000 0 6375 /end CHARACTERISTIC
/begin CHARACTERISTIC mIJVCPFHS "ROM Const mIJVCPFHS" VALUE 0x000086B6 REC_UBYTE_C 0 COMP_0087_S 0 19.9104 /end CHARACTERISTIC
/begin CHARACTERISTIC mIJVCTIHS "ROM Const mIJVCTIHS" VALUE 0x00009206 REC_UWORD_C 0 COMP_0152_S 0 419424 /end CHARACTERISTIC
/begin CHARACTERISTIC mILIMIT "ROM Const mILIMIT" VALUE 0x000097C0 REC_ULONG_C 0 COMP_0163_S 0 32767.9805308001 /end CHARACTERISTIC
/begin CHARACTERISTIC mINCCNT "ROM Const mINCCNT" VALUE 0x000086B8 REC_UBYTE_C 0 COMP_0063_S 0 1.00000035 /end CHARACTERISTIC
/begin CHARACTERISTIC mINCCNTHI "ROM Const mINCCNTHI" VALUE 0x000086B9 REC_UBYTE_C 0 COMP_0164_S 0 1.000000095 /end CHARACTERISTIC
/begin CHARACTERISTIC mINEGDMP "ROM Const mINEGDMP" VALUE 0x000086BA REC_UBYTE_C 0 COMP_0063 0 0.99609375 /end CHARACTERISTIC
/begin CHARACTERISTIC mINGALP "ROM Const mINGALP" VALUE 0x000086BB REC_UBYTE_C 0 COMP_0015 0 31.875 /end CHARACTERISTIC
/begin CHARACTERISTIC mINJCT1IN "ROM Const mINJCT1IN" VALUE 0x000086BC REC_UBYTE_C 0 COMP_0165_S 4 1024 /end CHARACTERISTIC
/begin CHARACTERISTIC mINJCT2IN "ROM Const mINJCT2IN" VALUE 0x000086BD REC_UBYTE_C 0 COMP_0166_S 0.5 64.25 /end CHARACTERISTIC
/begin CHARACTERISTIC mINJDLY "ROM Const mINJDLY" VALUE 0x00009208 REC_UWORD_C 0 COMP_0189 0 209712 /end CHARACTERISTIC
/begin CHARACTERISTIC mINJHD1IN "ROM Const mINJHD1IN" VALUE 0x000086BE REC_UBYTE_C 0 COMP_0149_S 0 51 /end CHARACTERISTIC
/begin CHARACTERISTIC mINJHD1VC "ROM Const mINJHD1VC" VALUE 0x000086BF REC_UBYTE_C 0 COMP_0149_S 0 51 /end CHARACTERISTIC
/begin CHARACTERISTIC mINJHD2IN "ROM Const mINJHD2IN" VALUE 0x000086C0 REC_UBYTE_C 0 COMP_0149_S 0 51 /end CHARACTERISTIC
/begin CHARACTERISTIC mINJHD2VC "ROM Const mINJHD2VC" VALUE 0x000086C1 REC_UBYTE_C 0 COMP_0149_S 0 51 /end CHARACTERISTIC
/begin CHARACTERISTIC mINJHYSIN "ROM Const mINJHYSIN" VALUE 0x000086C2 REC_UBYTE_C 0 COMP_0150_S 0.4 51.4 /end CHARACTERISTIC
/begin CHARACTERISTIC mINJHYSVC "ROM Const mINJHYSVC" VALUE 0x000086C3 REC_UBYTE_C 0 COMP_0150_S 0.4 51.4 /end CHARACTERISTIC
/begin CHARACTERISTIC mINJPFDE "ROM Const mINJPFDE" VALUE 0x0000920A REC_UWORD_C 0 COMP_0031_S 0 39.97635 /end CHARACTERISTIC
/begin CHARACTERISTIC mINJPFDEH "ROM Const mINJPFDEH" VALUE 0x0000920C REC_UWORD_C 0 COMP_0031_S 0 39.97635 /end CHARACTERISTIC
/begin CHARACTERISTIC mINJPHTIN "ROM Const mINJPHTIN" VALUE 0x000086C4 REC_UBYTE_C 0 COMP_0167_S 0 10200 /end CHARACTERISTIC
/begin CHARACTERISTIC mINJPHTVC "ROM Const mINJPHTVC" VALUE 0x000086C5 REC_UBYTE_C 0 COMP_0167_S 0 10200 /end CHARACTERISTIC
/begin CHARACTERISTIC mINJPKDEH "ROM Const mINJPKDEH" VALUE 0x000086C6 REC_UBYTE_C 0 COMP_0168_S 4.4 55.4 /end CHARACTERISTIC
/begin CHARACTERISTIC mINJPKIN "ROM Const mINJPKIN" VALUE 0x000086C7 REC_UBYTE_C 0 COMP_0168_S 4.4 55.4 /end CHARACTERISTIC
/begin CHARACTERISTIC mINJPKVC "ROM Const mINJPKVC" VALUE 0x000086C8 REC_UBYTE_C 0 COMP_0168_S 4.4 55.4 /end CHARACTERISTIC
/begin CHARACTERISTIC mINJPREIN "ROM Const mINJPREIN" VALUE 0x000086C9 REC_UBYTE_C 0 COMP_0149_S 0 51 /end CHARACTERISTIC
/begin CHARACTERISTIC mINJPREVC "ROM Const mINJPREVC" VALUE 0x000086CA REC_UBYTE_C 0 COMP_0149_S 0 51 /end CHARACTERISTIC
/begin CHARACTERISTIC mINJT2DIN "ROM Const mINJT2DIN" VALUE 0x000086CB REC_UBYTE_C 0 COMP_0169_S 0 1020 /end CHARACTERISTIC
/begin CHARACTERISTIC mINJT2DVC "ROM Const mINJT2DVC" VALUE 0x000086CC REC_UBYTE_C 0 COMP_0169_S 0 1020 /end CHARACTERISTIC
/begin CHARACTERISTIC mINJTFDIN "ROM Const mINJTFDIN" VALUE 0x000086CD REC_UBYTE_C 0 COMP_0170_S 0 5100 /end CHARACTERISTIC
/begin CHARACTERISTIC mINJTFDVC "ROM Const mINJTFDVC" VALUE 0x000086CE REC_UBYTE_C 0 COMP_0170_S 0 5100 /end CHARACTERISTIC
/begin CHARACTERISTIC mINJTSTd "ROM Const mINJTSTd" VALUE 0x000086CF REC_UBYTE_C 0 COMP_0190 0 510 /end CHARACTERISTIC
/begin CHARACTERISTIC mINJVCDLY "ROM Const mINJVCDLY" VALUE 0x000086D0 REC_UBYTE_C 0 COMP_0014 0 2550 /end CHARACTERISTIC
/begin CHARACTERISTIC mINJVCNE "ROM Const mINJVCNE" VALUE 0x000086D1 REC_UBYTE_C 0 COMP_0000 0 6375 /end CHARACTERISTIC
/begin CHARACTERISTIC mINJVCPF "ROM Const mINJVCPF" VALUE 0x000086D2 REC_UBYTE_C 0 COMP_0087_S 0 19.9104 /end CHARACTERISTIC
/begin CHARACTERISTIC mINJVCTI "ROM Const mINJVCTI" VALUE 0x0000920E REC_UWORD_C 0 COMP_0152_S 0 419424 /end CHARACTERISTIC
/begin CHARACTERISTIC mINJVCVB "ROM Const mINJVCVB" VALUE 0x000086D3 REC_UBYTE_C 0 COMP_0033 0 20400 /end CHARACTERISTIC
/begin CHARACTERISTIC mINLD "ROM Const mINLD" VALUE 0x000086D4 REC_UBYTE_C 0 COMP_0191 0 255 /end CHARACTERISTIC
/begin CHARACTERISTIC mINOFST "ROM Const mINOFST" VALUE 0x000086D5 REC_UBYTE_C 0 COMP_0061 0 1275 /end CHARACTERISTIC
/begin CHARACTERISTIC mINTWCP "ROM Const mINTWCP" VALUE 0x000086D6 REC_UBYTE_C 0 COMP_0035 -50 205 /end CHARACTERISTIC
/begin CHARACTERISTIC mINTWSCV "ROM Const mINTWSCV" VALUE 0x000086D7 REC_UBYTE_C 0 COMP_0035 -50 205 /end CHARACTERISTIC
/begin CHARACTERISTIC mINVGPH "ROM Const mINVGPH" VALUE 0x000086D8 REC_UBYTE_C 0 COMP_0068 0 255 /end CHARACTERISTIC
/begin CHARACTERISTIC mINVGPL "ROM Const mINVGPL" VALUE 0x000086D9 REC_UBYTE_C 0 COMP_0068 0 255 /end CHARACTERISTIC
/begin CHARACTERISTIC mINVGR1 "ROM Const mINVGR1" VALUE 0x00009210 REC_UWORD_C 0 COMP_0063 0 255.99609375 /end CHARACTERISTIC
/begin CHARACTERISTIC mINVGR2 "ROM Const mINVGR2" VALUE 0x00009212 REC_UWORD_C 0 COMP_0063 0 255.99609375 /end CHARACTERISTIC
/begin CHARACTERISTIC mINVGR3 "ROM Const mINVGR3" VALUE 0x00009214 REC_UWORD_C 0 COMP_0063 0 255.99609375 /end CHARACTERISTIC
/begin CHARACTERISTIC mINVGR4 "ROM Const mINVGR4" VALUE 0x00009216 REC_UWORD_C 0 COMP_0063 0 255.99609375 /end CHARACTERISTIC
/begin CHARACTERISTIC mINVGR6 "ROM Const mINVGR6" VALUE 0x00009218 REC_UWORD_C 0 COMP_0063 0 255.99609375 /end CHARACTERISTIC
/begin CHARACTERISTIC mINVGR7 "ROM Const mINVGR7" VALUE 0x0000921A REC_UWORD_C 0 COMP_0063 0 255.99609375 /end CHARACTERISTIC
/begin CHARACTERISTIC mINVGR8 "ROM Const mINVGR8" VALUE 0x0000921C REC_UWORD_C 0 COMP_0063 0 255.99609375 /end CHARACTERISTIC
/begin CHARACTERISTIC mINVGRH "ROM Const mINVGRH" VALUE 0x0000921E REC_UWORD_C 0 COMP_0063 0 255.99609375 /end CHARACTERISTIC
/begin CHARACTERISTIC mINVGRL "ROM Const mINVGRL" VALUE 0x00009220 REC_UWORD_C 0 COMP_0063 0 255.99609375 /end CHARACTERISTIC
/begin CHARACTERISTIC mINVRPM1 "ROM Const mINVRPM1" VALUE 0x000086DA REC_UBYTE_C 0 COMP_0020 0 12750 /end CHARACTERISTIC
/begin CHARACTERISTIC mINVRPM2 "ROM Const mINVRPM2" VALUE 0x000086DB REC_UBYTE_C 0 COMP_0020 0 12750 /end CHARACTERISTIC
/begin CHARACTERISTIC mINVVSP "ROM Const mINVVSP" VALUE 0x000086DC REC_UBYTE_C 0 COMP_0007 0 510 /end CHARACTERISTIC
/begin CHARACTERISTIC mIOFAGBE "ROM Const mIOFAGBE" VALUE 0x000086DD REC_UBYTE_C 0 COMP_0048 0 127.5 /end CHARACTERISTIC
/begin CHARACTERISTIC mIOFAGFE "ROM Const mIOFAGFE" VALUE 0x000086DE REC_UBYTE_C 0 COMP_0048 0 127.5 /end CHARACTERISTIC
/begin CHARACTERISTIC mIOFANGOB "ROM Const mIOFANGOB" VALUE 0x000086DF REC_UBYTE_C 0 COMP_0266 0 127.5 /end CHARACTERISTIC
/begin CHARACTERISTIC mIOFANGOF "ROM Const mIOFANGOF" VALUE 0x000086E0 REC_UBYTE_C 0 COMP_0266 0 127.5 /end CHARACTERISTIC
/begin CHARACTERISTIC mIOLVTCD1 "ROM Const mIOLVTCD1" VALUE 0x000086E1 REC_UBYTE_C 0 COMP_0048 0 127.5 /end CHARACTERISTIC
/begin CHARACTERISTIC mIOLVTCD2 "ROM Const mIOLVTCD2" VALUE 0x000086E2 REC_UBYTE_C 0 COMP_0048 0 127.5 /end CHARACTERISTIC
/begin CHARACTERISTIC mIOLVTCF1 "ROM Const mIOLVTCF1" VALUE 0x000086E3 REC_UBYTE_C 0 COMP_0019 0 255 /end CHARACTERISTIC
/begin CHARACTERISTIC mIOLVTCF2 "ROM Const mIOLVTCF2" VALUE 0x000086E4 REC_UBYTE_C 0 COMP_0019 0 255 /end CHARACTERISTIC
/begin CHARACTERISTIC mISCAUI "ROM Const mISCAUI" VALUE 0x000086E5 REC_UBYTE_C 0 COMP_0051 0 255 /end CHARACTERISTIC
/begin CHARACTERISTIC mISCAUNE "ROM Const mISCAUNE" VALUE 0x000086E6 REC_UBYTE_C 0 COMP_0006 0 3187.5 /end CHARACTERISTIC
/begin CHARACTERISTIC mISCAVR "ROM Const mISCAVR" VALUE 0x000086E7 REC_UBYTE_C 0 COMP_0063 0 0.99609375 /end CHARACTERISTIC
/begin CHARACTERISTIC mISCBFNI "ROM Const mISCBFNI" VALUE 0x000086E8 REC_UBYTE_C 0 COMP_0051 0 255 /end CHARACTERISTIC
/begin CHARACTERISTIC mISCDDLY "ROM Const mISCDDLY" VALUE 0x000086E9 REC_UBYTE_C 0 COMP_0013 0 255 /end CHARACTERISTIC
/begin CHARACTERISTIC mISCDEFI "ROM Const mISCDEFI" VALUE 0x000086EA REC_UBYTE_C 0 COMP_0051 0 255 /end CHARACTERISTIC
/begin CHARACTERISTIC mISCDLY "ROM Const mISCDLY" VALUE 0x000086EB REC_UBYTE_C 0 COMP_0008 0 25500 /end CHARACTERISTIC
/begin CHARACTERISTIC mISCDPUI "ROM Const mISCDPUI" VALUE 0x000086EC REC_UBYTE_C 0 COMP_0051 0 255 /end CHARACTERISTIC
/begin CHARACTERISTIC mISCFBTO "ROM Const mISCFBTO" VALUE 0x000086ED REC_UBYTE_C 0 COMP_0035 -50 205 /end CHARACTERISTIC
/begin CHARACTERISTIC mISCFBTW "ROM Const mISCFBTW" VALUE 0x000086EE REC_UBYTE_C 0 COMP_0035 -50 205 /end CHARACTERISTIC
/begin CHARACTERISTIC mISCHLHI "ROM Const mISCHLHI" VALUE 0x000086EF REC_UBYTE_C 0 COMP_0051 0 255 /end CHARACTERISTIC
/begin CHARACTERISTIC mISCLRD "ROM Const mISCLRD" VALUE 0x000086F0 REC_UBYTE_C 0 COMP_0008 0 25500 /end CHARACTERISTIC
/begin CHARACTERISTIC mISCLUI1 "ROM Const mISCLUI1" VALUE 0x000086F1 REC_UBYTE_C 0 COMP_0051 0 255 /end CHARACTERISTIC
/begin CHARACTERISTIC mISCLUI2 "ROM Const mISCLUI2" VALUE 0x000086F2 REC_UBYTE_C 0 COMP_0051 0 255 /end CHARACTERISTIC
/begin CHARACTERISTIC mISCNEH "ROM Const mISCNEH" VALUE 0x000086F3 REC_UBYTE_C 0 COMP_0006 0 3187.5 /end CHARACTERISTIC
/begin CHARACTERISTIC mISCNEL "ROM Const mISCNEL" VALUE 0x000086F4 REC_UBYTE_C 0 COMP_0006 0 3187.5 /end CHARACTERISTIC
/begin CHARACTERISTIC mISCPA2 "ROM Const mISCPA2" VALUE 0x00009222 REC_UWORD_C 0 COMP_0050 0 5119.921875 /end CHARACTERISTIC
/begin CHARACTERISTIC mISCPAT "ROM Const mISCPAT" VALUE 0x00009224 REC_UWORD_C 0 COMP_0050 0 5119.921875 /end CHARACTERISTIC
/begin CHARACTERISTIC mISCPSH "ROM Const mISCPSH" VALUE 0x000086F5 REC_UBYTE_C 0 COMP_0051 0 255 /end CHARACTERISTIC
/begin CHARACTERISTIC mISCPST "ROM Const mISCPST" VALUE 0x000086F6 REC_UBYTE_C 0 COMP_0014 0 2550 /end CHARACTERISTIC
/begin CHARACTERISTIC mISCRUIH "ROM Const mISCRUIH" VALUE 0x000086F7 REC_UBYTE_C 0 COMP_0051 0 255 /end CHARACTERISTIC
/begin CHARACTERISTIC mISCRUIL "ROM Const mISCRUIL" VALUE 0x000086F8 REC_UBYTE_C 0 COMP_0051 0 255 /end CHARACTERISTIC
/begin CHARACTERISTIC mISCRUIM "ROM Const mISCRUIM" VALUE 0x000086F9 REC_UBYTE_C 0 COMP_0051 0 255 /end CHARACTERISTIC
/begin CHARACTERISTIC mISCSN "ROM Const mISCSN" VALUE 0x000086FA REC_UBYTE_C 0 COMP_0016 0 255 /end CHARACTERISTIC
/begin CHARACTERISTIC mISCSTDLY "ROM Const mISCSTDLY" VALUE 0x000086FB REC_UBYTE_C 0 COMP_0008 0 25500 /end CHARACTERISTIC
/begin CHARACTERISTIC mISCTAL "ROM Const mISCTAL" VALUE 0x000086FC REC_UBYTE_C 0 COMP_0035 -50 205 /end CHARACTERISTIC
/begin CHARACTERISTIC mISCTAN "ROM Const mISCTAN" VALUE 0x000086FD REC_UBYTE_C 0 COMP_0035 -50 205 /end CHARACTERISTIC
/begin CHARACTERISTIC mISCTAT1 "ROM Const mISCTAT1" VALUE 0x000086FE REC_UBYTE_C 0 COMP_0016 0 255 /end CHARACTERISTIC
/begin CHARACTERISTIC mISCTWN "ROM Const mISCTWN" VALUE 0x000086FF REC_UBYTE_C 0 COMP_0035 -50 205 /end CHARACTERISTIC
/begin CHARACTERISTIC mISCVSP32 "ROM Const mISCVSP32" VALUE 0x00008700 REC_UBYTE_C 0 COMP_0007 0 510 /end CHARACTERISTIC
/begin CHARACTERISTIC mISCVSP8 "ROM Const mISCVSP8" VALUE 0x00008701 REC_UBYTE_C 0 COMP_0007 0 510 /end CHARACTERISTIC
/begin CHARACTERISTIC mISFLTW "ROM Const mISFLTW" VALUE 0x00008702 REC_UBYTE_C 0 COMP_0035 -50 205 /end CHARACTERISTIC
/begin CHARACTERISTIC mISLMAX1 "ROM Const mISLMAX1" VALUE 0x00009226 REC_UWORD_C 0 COMP_0051 0 65535 /end CHARACTERISTIC
/begin CHARACTERISTIC mISLMIN1 "ROM Const mISLMIN1" VALUE 0x00009228 REC_UWORD_C 0 COMP_0051 0 65535 /end CHARACTERISTIC
/begin CHARACTERISTIC mISLRDD "ROM Const mISLRDD" VALUE 0x00008703 REC_UBYTE_C 0 COMP_0013 0 255 /end CHARACTERISTIC
/begin CHARACTERISTIC mISON "ROM Const mISON" VALUE 0x00008704 REC_UBYTE_C 0 COMP_0006 0 3187.5 /end CHARACTERISTIC
/begin CHARACTERISTIC mISOVSP "ROM Const mISOVSP" VALUE 0x00008705 REC_UBYTE_C 0 COMP_0007 0 510 /end CHARACTERISTIC
/begin CHARACTERISTIC mISRESCUR "ROM Const mISRESCUR" VALUE 0x00008706 REC_UBYTE_C 0 COMP_0058_S 0 25500 /end CHARACTERISTIC
/begin CHARACTERISTIC mISSN "ROM Const mISSN" VALUE 0x00008707 REC_UBYTE_C 0 COMP_0006 0 3187.5 /end CHARACTERISTIC
/begin CHARACTERISTIC mISSNED "ROM Const mISSNED" VALUE 0x00008708 REC_UBYTE_C 0 COMP_0006 0 3187.5 /end CHARACTERISTIC
/begin CHARACTERISTIC mISSNG "ROM Const mISSNG" VALUE 0x0000922A REC_UWORD_C 0 COMP_0025 0 32767.5 /end CHARACTERISTIC
/begin CHARACTERISTIC mISSTWH "ROM Const mISSTWH" VALUE 0x00008709 REC_UBYTE_C 0 COMP_0171_S -50 205 /end CHARACTERISTIC
/begin CHARACTERISTIC mISSTWL "ROM Const mISSTWL" VALUE 0x0000870A REC_UBYTE_C 0 COMP_0171_S -50 205 /end CHARACTERISTIC
/begin CHARACTERISTIC mISSVSP "ROM Const mISSVSP" VALUE 0x0000870B REC_UBYTE_C 0 COMP_0007 0 510 /end CHARACTERISTIC
/begin CHARACTERISTIC mIT1HNG "ROM Const mIT1HNG" VALUE 0x0000870C REC_UBYTE_C 0 COMP_0190 0 510 /end CHARACTERISTIC
/begin CHARACTERISTIC mIT1LNG "ROM Const mIT1LNG" VALUE 0x0000870D REC_UBYTE_C 0 COMP_0190 0 510 /end CHARACTERISTIC
/begin CHARACTERISTIC mIT1NGT "ROM Const mIT1NGT" VALUE 0x0000870E REC_UBYTE_C 0 COMP_0008 0 25500 /end CHARACTERISTIC
/begin CHARACTERISTIC mIT2HNG "ROM Const mIT2HNG" VALUE 0x0000870F REC_UBYTE_C 0 COMP_0190 0 510 /end CHARACTERISTIC
/begin CHARACTERISTIC mIT2LNG "ROM Const mIT2LNG" VALUE 0x00008710 REC_UBYTE_C 0 COMP_0190 0 510 /end CHARACTERISTIC
/begin CHARACTERISTIC mIT2NGT "ROM Const mIT2NGT" VALUE 0x00008711 REC_UBYTE_C 0 COMP_0008 0 25500 /end CHARACTERISTIC
/begin CHARACTERISTIC mITAADJH "ROM Const mITAADJH" VALUE 0x00008712 REC_UBYTE_C 0 COMP_0009 0 199.21875 /end CHARACTERISTIC
/begin CHARACTERISTIC mITAADJL "ROM Const mITAADJL" VALUE 0x00008713 REC_UBYTE_C 0 COMP_0009 0 199.21875 /end CHARACTERISTIC
/begin CHARACTERISTIC mITACEXL "ROM Const mITACEXL" VALUE 0x00008714 REC_UBYTE_C 0 COMP_0009 0 199.21875 /end CHARACTERISTIC
/begin CHARACTERISTIC mITAFRMX "ROM Const mITAFRMX" VALUE 0x00008715 REC_UBYTE_C 0 COMP_0095 0 398.4375 /end CHARACTERISTIC
/begin CHARACTERISTIC mITAFSTM4 "ROM Const mITAFSTM4" VALUE 0x00008716 REC_UBYTE_C 0 COMP_0095 0 398.4375 /end CHARACTERISTIC
/begin CHARACTERISTIC mITCADLCC "ROM Const mITCADLCC" VALUE 0x00008717 REC_UBYTE_C 0 COMP_0009 0 199.21875 /end CHARACTERISTIC
/begin CHARACTERISTIC mITCADVL0 "ROM Const mITCADVL0" VALUE 0x00008718 REC_UBYTE_C 0 COMP_0009 0 199.21875 /end CHARACTERISTIC
/begin CHARACTERISTIC mITCADVL1 "ROM Const mITCADVL1" VALUE 0x00008719 REC_UBYTE_C 0 COMP_0009 0 199.21875 /end CHARACTERISTIC
/begin CHARACTERISTIC mITCADVL2 "ROM Const mITCADVL2" VALUE 0x0000871A REC_UBYTE_C 0 COMP_0009 0 199.21875 /end CHARACTERISTIC
/begin CHARACTERISTIC mITDADJH "ROM Const mITDADJH" VALUE 0x0000871B REC_UBYTE_C 0 COMP_0009 0 199.21875 /end CHARACTERISTIC
/begin CHARACTERISTIC mITDADJL "ROM Const mITDADJL" VALUE 0x0000871C REC_UBYTE_C 0 COMP_0009 0 199.21875 /end CHARACTERISTIC
/begin CHARACTERISTIC mITDMPNAI "ROM Const mITDMPNAI" VALUE 0x0000922C REC_UWORD_C 0 COMP_0456 0 1.999970916 /end CHARACTERISTIC
/begin CHARACTERISTIC mITFRMX_S "ROM Const mITFRMX_S" VALUE 0x000157D3 REC_UBYTE_C 0 COMP_0095 0 398.4375 /end CHARACTERISTIC
/begin CHARACTERISTIC mITLCKNHS "ROM Const mITLCKNHS" VALUE 0x0000871D REC_UBYTE_C 0 COMP_0006 0 3187.5 /end CHARACTERISTIC
/begin CHARACTERISTIC mITLOCK "ROM Const mITLOCK" VALUE 0x0000871E REC_UBYTE_C 0 COMP_0190 0 510 /end CHARACTERISTIC
/begin CHARACTERISTIC mITLOCKD "ROM Const mITLOCKD" VALUE 0x0000871F REC_UBYTE_C 0 COMP_0190 0 510 /end CHARACTERISTIC
/begin CHARACTERISTIC mITLOCKN "ROM Const mITLOCKN" VALUE 0x0000922E REC_UWORD_C 0 COMP_0006 0 819187.5 /end CHARACTERISTIC
/begin CHARACTERISTIC mITPFLNG "ROM Const mITPFLNG" VALUE 0x00008720 REC_UBYTE_C 0 COMP_0190 0 510 /end CHARACTERISTIC
/begin CHARACTERISTIC mITRTFL "ROM Const mITRTFL" VALUE 0x00008721 REC_UBYTE_C 0 COMP_0014 0 2550 /end CHARACTERISTIC
/begin CHARACTERISTIC mITRTM "ROM Const mITRTM" VALUE 0x00008722 REC_UBYTE_C 0 COMP_0049 0 255 /end CHARACTERISTIC
/begin CHARACTERISTIC mITSMDLY "ROM Const mITSMDLY" VALUE 0x00008723 REC_UBYTE_C 0 COMP_0014 0 2550 /end CHARACTERISTIC
/begin CHARACTERISTIC mIVC "ROM Const mIVC" VALUE 0x00008E50 REC_SWORD_C 0 COMP_0172_S -16384 16383.5 /end CHARACTERISTIC
/begin CHARACTERISTIC mIVGROF "ROM Const mIVGROF" VALUE 0x00008E52 REC_SWORD_C 0 COMP_0203 -128 127.99609375 /end CHARACTERISTIC
/begin CHARACTERISTIC mJDGTMC "ROM Const mJDGTMC" VALUE 0x0000970C REC_SLONG_C 0 COMP_0173_S -1073741824 1073741823.5 /end CHARACTERISTIC
/begin CHARACTERISTIC mJIZOKU "ROM Const mJIZOKU" VALUE 0x00008724 REC_UBYTE_C 0 COMP_0105 0 25.5 /end CHARACTERISTIC
/begin CHARACTERISTIC mJKADVLTM "ROM Const mJKADVLTM" VALUE 0x00008725 REC_UBYTE_C 0 COMP_0014 0 2550 /end CHARACTERISTIC
/begin CHARACTERISTIC mJKFFTQTM "ROM Const mJKFFTQTM" VALUE 0x00008726 REC_UBYTE_C 0 COMP_0014 0 2550 /end CHARACTERISTIC
/begin CHARACTERISTIC mJKFFTRQH "ROM Const mJKFFTRQH" VALUE 0x00009230 REC_UWORD_C 0 COMP_0196 0 6553.5 /end CHARACTERISTIC
/begin CHARACTERISTIC mJKFFTRQL "ROM Const mJKFFTRQL" VALUE 0x00009232 REC_UWORD_C 0 COMP_0196 0 6553.5 /end CHARACTERISTIC
/begin CHARACTERISTIC mJKGAIN "ROM Const mJKGAIN" VALUE 0x00008727 REC_UBYTE_C 0 COMP_0373 0 2.55 /end CHARACTERISTIC
/begin CHARACTERISTIC mJKGAIN_S "ROM Const mJKGAIN_S" VALUE 0x000157D4 REC_UBYTE_C 0 COMP_0373 0 2.55 /end CHARACTERISTIC
/begin CHARACTERISTIC mJKGKRTHY "ROM Const mJKGKRTHY" VALUE 0x00009234 REC_UWORD_C 0 COMP_0450 0 63.999056205 /end CHARACTERISTIC
/begin CHARACTERISTIC mJKGKRTO "ROM Const mJKGKRTO" VALUE 0x00009236 REC_UWORD_C 0 COMP_0450 0 63.999056205 /end CHARACTERISTIC
/begin CHARACTERISTIC mJKGKTQR1 "ROM Const mJKGKTQR1" VALUE 0x00009238 REC_UWORD_C 0 COMP_0193 0 6553.5 /end CHARACTERISTIC
/begin CHARACTERISTIC mJKGKTQR2 "ROM Const mJKGKTQR2" VALUE 0x0000923A REC_UWORD_C 0 COMP_0193 0 6553.5 /end CHARACTERISTIC
/begin CHARACTERISTIC mJKGKVHYH "ROM Const mJKGKVHYH" VALUE 0x0000923C REC_UWORD_C 0 COMP_0436 0 6553.5 /end CHARACTERISTIC
/begin CHARACTERISTIC mJKGKVHYL "ROM Const mJKGKVHYL" VALUE 0x0000923E REC_UWORD_C 0 COMP_0436 0 6553.5 /end CHARACTERISTIC
/begin CHARACTERISTIC mJKGKVSPH "ROM Const mJKGKVSPH" VALUE 0x00009240 REC_UWORD_C 0 COMP_0436 0 6553.5 /end CHARACTERISTIC
/begin CHARACTERISTIC mJKGKVSPL "ROM Const mJKGKVSPL" VALUE 0x00009242 REC_UWORD_C 0 COMP_0436 0 6553.5 /end CHARACTERISTIC
/begin CHARACTERISTIC mJKIGRAPH "ROM Const mJKIGRAPH" VALUE 0x00009244 REC_UWORD_C 0 COMP_0005 0 7208.85 /end CHARACTERISTIC
/begin CHARACTERISTIC mJKIGRAPL "ROM Const mJKIGRAPL" VALUE 0x00009246 REC_UWORD_C 0 COMP_0005 0 7208.85 /end CHARACTERISTIC
/begin CHARACTERISTIC mJKOFFRT0 "ROM Const mJKOFFRT0" VALUE 0x00009248 REC_UWORD_C 0 COMP_0028 0 2.5599609375 /end CHARACTERISTIC
/begin CHARACTERISTIC mJKOFFRT2 "ROM Const mJKOFFRT2" VALUE 0x0000924A REC_UWORD_C 0 COMP_0028 0 2.5599609375 /end CHARACTERISTIC
/begin CHARACTERISTIC mJKOFRT1D "ROM Const mJKOFRT1D" VALUE 0x0000924C REC_UWORD_C 0 COMP_0028 0 2.5599609375 /end CHARACTERISTIC
/begin CHARACTERISTIC mJKOFRT1U "ROM Const mJKOFRT1U" VALUE 0x0000924E REC_UWORD_C 0 COMP_0028 0 2.5599609375 /end CHARACTERISTIC
/begin CHARACTERISTIC mJKRTDSDB "ROM Const mJKRTDSDB" VALUE 0x00008728 REC_UBYTE_C 0 COMP_0068 0 255 /end CHARACTERISTIC
/begin CHARACTERISTIC mJKRTDSDH "ROM Const mJKRTDSDH" VALUE 0x00008729 REC_UBYTE_C 0 COMP_0068 0 255 /end CHARACTERISTIC
/begin CHARACTERISTIC mJKRTDSDL "ROM Const mJKRTDSDL" VALUE 0x0000872A REC_UBYTE_C 0 COMP_0068 0 255 /end CHARACTERISTIC
/begin CHARACTERISTIC mJKRTDSU "ROM Const mJKRTDSU" VALUE 0x0000872B REC_UBYTE_C 0 COMP_0068 0 255 /end CHARACTERISTIC
/begin CHARACTERISTIC mJKRTFWDB "ROM Const mJKRTFWDB" VALUE 0x0000872C REC_UBYTE_C 0 COMP_0068 0 255 /end CHARACTERISTIC
/begin CHARACTERISTIC mJKRTFWDH "ROM Const mJKRTFWDH" VALUE 0x0000872D REC_UBYTE_C 0 COMP_0068 0 255 /end CHARACTERISTIC
/begin CHARACTERISTIC mJKRTFWDL "ROM Const mJKRTFWDL" VALUE 0x0000872E REC_UBYTE_C 0 COMP_0068 0 255 /end CHARACTERISTIC
/begin CHARACTERISTIC mJKRTFWU "ROM Const mJKRTFWU" VALUE 0x0000872F REC_UBYTE_C 0 COMP_0068 0 255 /end CHARACTERISTIC
/begin CHARACTERISTIC mJKSRCGP0 "ROM Const mJKSRCGP0" VALUE 0x00008730 REC_UBYTE_C 0 COMP_0068 0 255 /end CHARACTERISTIC
/begin CHARACTERISTIC mJKTRQOFF "ROM Const mJKTRQOFF" VALUE 0x00009250 REC_UWORD_C 0 COMP_0196 0 6553.5 /end CHARACTERISTIC
/begin CHARACTERISTIC mJKTRQON "ROM Const mJKTRQON" VALUE 0x00009252 REC_UWORD_C 0 COMP_0196 0 6553.5 /end CHARACTERISTIC
/begin CHARACTERISTIC mJKULVSP "ROM Const mJKULVSP" VALUE 0x00009254 REC_UWORD_C 0 COMP_0436 0 6553.5 /end CHARACTERISTIC
/begin CHARACTERISTIC mJKUSTQRT "ROM Const mJKUSTQRT" VALUE 0x00009256 REC_UWORD_C 0 COMP_0447 0 6399.90234375 /end CHARACTERISTIC
/begin CHARACTERISTIC mJUGRAC "ROM Const mJUGRAC" VALUE 0x00009258 REC_UWORD_C 0 COMP_0139_S 0 4095.9375 /end CHARACTERISTIC
/begin CHARACTERISTIC mJUGRAC2 "ROM Const mJUGRAC2" VALUE 0x0000925A REC_UWORD_C 0 COMP_0139_S 0 4095.9375 /end CHARACTERISTIC
/begin CHARACTERISTIC mJZKRPM "ROM Const mJZKRPM" VALUE 0x00008731 REC_UBYTE_C 0 COMP_0006 0 3187.5 /end CHARACTERISTIC
/begin CHARACTERISTIC mJZKRPMHK "ROM Const mJZKRPMHK" VALUE 0x0000925C REC_UWORD_C 0 COMP_0006 0 819187.5 /end CHARACTERISTIC
/begin CHARACTERISTIC mK1G "ROM Const mK1G" VALUE 0x0000925E REC_UWORD_C 0 COMP_0388 0 6553.5 /end CHARACTERISTIC
/begin CHARACTERISTIC mK2G "ROM Const mK2G" VALUE 0x000097C4 REC_ULONG_C 0 COMP_0388 0 429496729.5 /end CHARACTERISTIC
/begin CHARACTERISTIC mK2X "ROM Const mK2X" VALUE 0x00008732 REC_UBYTE_C 0 COMP_0174_S 0 255 /end CHARACTERISTIC
/begin CHARACTERISTIC mKADVTEGF "ROM Const mKADVTEGF" VALUE 0x00008733 REC_UBYTE_C 0 COMP_0063 0 0.99609375 /end CHARACTERISTIC
/begin CHARACTERISTIC mKAFMFSH "ROM Const mKAFMFSH" VALUE 0x00009260 REC_UWORD_C 0 COMP_0063 0 255.99609375 /end CHARACTERISTIC
/begin CHARACTERISTIC mKAFMFSL "ROM Const mKAFMFSL" VALUE 0x00009262 REC_UWORD_C 0 COMP_0063 0 255.99609375 /end CHARACTERISTIC
/begin CHARACTERISTIC mKAFMMPBK "ROM Const mKAFMMPBK" VALUE 0x00009264 REC_UWORD_C 0 COMP_0456 0 1.999970916 /end CHARACTERISTIC
/begin CHARACTERISTIC mKAFMOKNE "ROM Const mKAFMOKNE" VALUE 0x00009266 REC_UWORD_C 0 COMP_0065 0 204796.875 /end CHARACTERISTIC
/begin CHARACTERISTIC mKAFMPMW "ROM Const mKAFMPMW" VALUE 0x00009268 REC_UWORD_C 0 COMP_0290 0 0.999985458 /end CHARACTERISTIC
/begin CHARACTERISTIC mKAFMTANL "ROM Const mKAFMTANL" VALUE 0x00008734 REC_UBYTE_C 0 COMP_0035 -50 205 /end CHARACTERISTIC
/begin CHARACTERISTIC mKAFPAML "ROM Const mKAFPAML" VALUE 0x0000926A REC_UWORD_C 0 COMP_0123_S 0 127.998046875 /end CHARACTERISTIC
/begin CHARACTERISTIC mKAFSMN "ROM Const mKAFSMN" VALUE 0x0000926C REC_UWORD_C 0 COMP_0453 0 131.07 /end CHARACTERISTIC
/begin CHARACTERISTIC mKAIMIN "ROM Const mKAIMIN" VALUE 0x0000926E REC_UWORD_C 0 COMP_0023 0 327675 /end CHARACTERISTIC
/begin CHARACTERISTIC mKAIVFT "ROM Const mKAIVFT" VALUE 0x00008735 REC_UBYTE_C 0 COMP_0008 0 25500 /end CHARACTERISTIC
/begin CHARACTERISTIC mKAIVRT "ROM Const mKAIVRT" VALUE 0x00008736 REC_UBYTE_C 0 COMP_0008 0 25500 /end CHARACTERISTIC
/begin CHARACTERISTIC mKAJYUU "ROM Const mKAJYUU" VALUE 0x00008737 REC_UBYTE_C 0 COMP_0004 0 255 /end CHARACTERISTIC
/begin CHARACTERISTIC mKAJYUU2 "ROM Const mKAJYUU2" VALUE 0x00008738 REC_UBYTE_C 0 COMP_0004 0 255 /end CHARACTERISTIC
/begin CHARACTERISTIC mKANKAKU1 "ROM Const mKANKAKU1" VALUE 0x00008739 REC_UBYTE_C 0 COMP_0048 0 127.5 /end CHARACTERISTIC
/begin CHARACTERISTIC mKANKAKU2 "ROM Const mKANKAKU2" VALUE 0x0000873A REC_UBYTE_C 0 COMP_0048 0 127.5 /end CHARACTERISTIC
/begin CHARACTERISTIC mKANKAKU3 "ROM Const mKANKAKU3" VALUE 0x0000873B REC_UBYTE_C 0 COMP_0048 0 127.5 /end CHARACTERISTIC
/begin CHARACTERISTIC mKANKAKU4 "ROM Const mKANKAKU4" VALUE 0x0000873C REC_UBYTE_C 0 COMP_0048 0 127.5 /end CHARACTERISTIC
/begin CHARACTERISTIC mKANKAKU5 "ROM Const mKANKAKU5" VALUE 0x0000873D REC_UBYTE_C 0 COMP_0048 0 127.5 /end CHARACTERISTIC
/begin CHARACTERISTIC mKANKAKU6 "ROM Const mKANKAKU6" VALUE 0x0000873E REC_UBYTE_C 0 COMP_0048 0 127.5 /end CHARACTERISTIC
/begin CHARACTERISTIC mKAPPA "ROM Const mKAPPA" VALUE 0x0000873F REC_UBYTE_C 0 COMP_0021 0 99.609375 /end CHARACTERISTIC
/begin CHARACTERISTIC mKAVRO2S "ROM Const mKAVRO2S" VALUE 0x00008740 REC_UBYTE_C 0 COMP_0045 0 1.9921875 /end CHARACTERISTIC
/begin CHARACTERISTIC mKAVTFDED "ROM Const mKAVTFDED" VALUE 0x00009270 REC_UWORD_C 0 COMP_0217 0 3.999941832 /end CHARACTERISTIC
/begin CHARACTERISTIC mKAVTFDMX "ROM Const mKAVTFDMX" VALUE 0x00008741 REC_UBYTE_C 0 COMP_0017 0 255 /end CHARACTERISTIC
/begin CHARACTERISTIC mKAVTFDST "ROM Const mKAVTFDST" VALUE 0x00009272 REC_UWORD_C 0 COMP_0217 0 3.999941832 /end CHARACTERISTIC
/begin CHARACTERISTIC mKAVTFNED "ROM Const mKAVTFNED" VALUE 0x00009274 REC_UWORD_C 0 COMP_0217 0 3.999941832 /end CHARACTERISTIC
/begin CHARACTERISTIC mKAVTFNMX "ROM Const mKAVTFNMX" VALUE 0x00008742 REC_UBYTE_C 0 COMP_0017 0 255 /end CHARACTERISTIC
/begin CHARACTERISTIC mKAVTFNST "ROM Const mKAVTFNST" VALUE 0x00009276 REC_UWORD_C 0 COMP_0217 0 3.999941832 /end CHARACTERISTIC
/begin CHARACTERISTIC mKBGLIN "ROM Const mKBGLIN" VALUE 0x00009278 REC_UWORD_C 0 COMP_0032 0 255.99609375 /end CHARACTERISTIC
/begin CHARACTERISTIC mKBLB "ROM Const mKBLB" VALUE 0x00008743 REC_UBYTE_C 0 COMP_0031 0 0.99609375 /end CHARACTERISTIC
/begin CHARACTERISTIC mKBLBH "ROM Const mKBLBH" VALUE 0x00008744 REC_UBYTE_C 0 COMP_0163 0 15.9375 /end CHARACTERISTIC
/begin CHARACTERISTIC mKBLCTH "ROM Const mKBLCTH" VALUE 0x00008745 REC_UBYTE_C 0 COMP_0027 0 255 /end CHARACTERISTIC
/begin CHARACTERISTIC mKBLCTL "ROM Const mKBLCTL" VALUE 0x00008746 REC_UBYTE_C 0 COMP_0027 0 255 /end CHARACTERISTIC
/begin CHARACTERISTIC mKBLGH "ROM Const mKBLGH" VALUE 0x00008747 REC_UBYTE_C 0 COMP_0027 0 255 /end CHARACTERISTIC
/begin CHARACTERISTIC mKBLGL "ROM Const mKBLGL" VALUE 0x00008748 REC_UBYTE_C 0 COMP_0027 0 255 /end CHARACTERISTIC
/begin CHARACTERISTIC mKBLHMN "ROM Const mKBLHMN" VALUE 0x00008E54 REC_SWORD_C 0 COMP_0020_S -65.536 65.534 /end CHARACTERISTIC
/begin CHARACTERISTIC mKBLHMX "ROM Const mKBLHMX" VALUE 0x00008E56 REC_SWORD_C 0 COMP_0020_S -65.536 65.534 /end CHARACTERISTIC
/begin CHARACTERISTIC mKCATTH "ROM Const mKCATTH" VALUE 0x00008749 REC_UBYTE_C 0 COMP_0035 -50 205 /end CHARACTERISTIC
/begin CHARACTERISTIC mKCATTM "ROM Const mKCATTM" VALUE 0x0000874A REC_UBYTE_C 0 COMP_0205 0 796.875 /end CHARACTERISTIC
/begin CHARACTERISTIC mKCAY "ROM Const mKCAY" VALUE 0x0000874B REC_UBYTE_C 0 COMP_0063 0 0.99609375 /end CHARACTERISTIC
/begin CHARACTERISTIC mKCONST "ROM Const mKCONST" VALUE 0x0000927A REC_UWORD_C 0 COMP_0210 0 65535 /end CHARACTERISTIC
/begin CHARACTERISTIC mKCRADVIN "ROM Const mKCRADVIN" VALUE 0x0000927C REC_UWORD_C 0 COMP_0456 0 1.999970916 /end CHARACTERISTIC
/begin CHARACTERISTIC mKCTRT "ROM Const mKCTRT" VALUE 0x0000874C REC_UBYTE_C 0 COMP_0062 0 1020 /end CHARACTERISTIC
/begin CHARACTERISTIC mKCWPMX "ROM Const mKCWPMX" VALUE 0x0000874D REC_UBYTE_C 0 COMP_0096 0 2550 /end CHARACTERISTIC
/begin CHARACTERISTIC mKCWPSL "ROM Const mKCWPSL" VALUE 0x0000874E REC_UBYTE_C 0 COMP_0096 0 2550 /end CHARACTERISTIC
/begin CHARACTERISTIC mKDATDUS "ROM Const mKDATDUS" VALUE 0x0000874F REC_UBYTE_C 0 COMP_0175_S 0 0.99609375 /end CHARACTERISTIC
/begin CHARACTERISTIC mKDELAY "ROM Const mKDELAY" VALUE 0x0000927E REC_UWORD_C 0 COMP_0146 0 99.998480265 /end CHARACTERISTIC
/begin CHARACTERISTIC mKDG "ROM Const mKDG" VALUE 0x00008750 REC_UBYTE_C 0 COMP_0061_S 0 0.0255 /end CHARACTERISTIC
/begin CHARACTERISTIC mKDISCST "ROM Const mKDISCST" VALUE 0x00009280 REC_UWORD_C 0 COMP_0436 0 6553.5 /end CHARACTERISTIC
/begin CHARACTERISTIC mKDLTGTVO "ROM Const mKDLTGTVO" VALUE 0x00009282 REC_UWORD_C 0 COMP_0130 0 1802.2125 /end CHARACTERISTIC
/begin CHARACTERISTIC mKDSPST "ROM Const mKDSPST" VALUE 0x00009284 REC_UWORD_C 0 COMP_0436 0 6553.5 /end CHARACTERISTIC
/begin CHARACTERISTIC mKDUTYDGN "ROM Const mKDUTYDGN" VALUE 0x00008751 REC_UBYTE_C 0 COMP_0063 0 0.99609375 /end CHARACTERISTIC
/begin CHARACTERISTIC mKEVREF "ROM Const mKEVREF" VALUE 0x00008752 REC_UBYTE_C 0 COMP_0004 0 255 /end CHARACTERISTIC
/begin CHARACTERISTIC mKG2FD "ROM Const mKG2FD" VALUE 0x00009286 REC_UWORD_C 0 COMP_0176_S 0 65535 /end CHARACTERISTIC
/begin CHARACTERISTIC mKGASCD "ROM Const mKGASCD" VALUE 0x00009288 REC_UWORD_C 0 COMP_0115 0 99.9998565 /end CHARACTERISTIC
/begin CHARACTERISTIC mKGFLTR "ROM Const mKGFLTR" VALUE 0x00008753 REC_UBYTE_C 0 COMP_0063 0 0.99609375 /end CHARACTERISTIC
/begin CHARACTERISTIC mKGFLTR1 "ROM Const mKGFLTR1" VALUE 0x00008754 REC_UBYTE_C 0 COMP_0063 0 0.99609375 /end CHARACTERISTIC
/begin CHARACTERISTIC mKHOTMNE "ROM Const mKHOTMNE" VALUE 0x00008755 REC_UBYTE_C 0 COMP_0000 0 6375 /end CHARACTERISTIC
/begin CHARACTERISTIC mKHOTTW "ROM Const mKHOTTW" VALUE 0x00008756 REC_UBYTE_C 0 COMP_0035 -50 205 /end CHARACTERISTIC
/begin CHARACTERISTIC mKHOTWN "ROM Const mKHOTWN" VALUE 0x00008757 REC_UBYTE_C 0 COMP_0035 -50 205 /end CHARACTERISTIC
/begin CHARACTERISTIC mKHQAC "ROM Const mKHQAC" VALUE 0x00008758 REC_UBYTE_C 0 COMP_0051 0 255 /end CHARACTERISTIC
/begin CHARACTERISTIC mKICLTOP "ROM Const mKICLTOP" VALUE 0x00008759 REC_UBYTE_C 0 COMP_0031 0 0.99609375 /end CHARACTERISTIC
/begin CHARACTERISTIC mKIFADV "ROM Const mKIFADV" VALUE 0x0000875A REC_UBYTE_C 0 COMP_0213 0 199.21875 /end CHARACTERISTIC
/begin CHARACTERISTIC mKIFFC "ROM Const mKIFFC" VALUE 0x0000875B REC_UBYTE_C 0 COMP_0213 0 199.21875 /end CHARACTERISTIC
/begin CHARACTERISTIC mKIFKMR "ROM Const mKIFKMR" VALUE 0x0000875C REC_UBYTE_C 0 COMP_0213 0 199.21875 /end CHARACTERISTIC
/begin CHARACTERISTIC mKJTRQBL "ROM Const mKJTRQBL" VALUE 0x0000875D REC_UBYTE_C 0 COMP_0045 0 1.9921875 /end CHARACTERISTIC
/begin CHARACTERISTIC mKKWCT "ROM Const mKKWCT" VALUE 0x0000875E REC_UBYTE_C 0 COMP_0205 0 796.875 /end CHARACTERISTIC
/begin CHARACTERISTIC mKLMCDL "ROM Const mKLMCDL" VALUE 0x0000928A REC_UWORD_C 0 COMP_0202 0 655350 /end CHARACTERISTIC
/begin CHARACTERISTIC mKLQAC "ROM Const mKLQAC" VALUE 0x0000875F REC_UBYTE_C 0 COMP_0051 0 255 /end CHARACTERISTIC
/begin CHARACTERISTIC mKMISA1 "ROM Const mKMISA1" VALUE 0x00008760 REC_UBYTE_C 0 COMP_0009 0 199.21875 /end CHARACTERISTIC
/begin CHARACTERISTIC mKMISA2 "ROM Const mKMISA2" VALUE 0x00008761 REC_UBYTE_C 0 COMP_0009 0 199.21875 /end CHARACTERISTIC
/begin CHARACTERISTIC mKMISA3 "ROM Const mKMISA3" VALUE 0x00008762 REC_UBYTE_C 0 COMP_0009 0 199.21875 /end CHARACTERISTIC
/begin CHARACTERISTIC mKMISA5 "ROM Const mKMISA5" VALUE 0x00008763 REC_UBYTE_C 0 COMP_0009 0 199.21875 /end CHARACTERISTIC
/begin CHARACTERISTIC mKMISA6 "ROM Const mKMISA6" VALUE 0x00008764 REC_UBYTE_C 0 COMP_0009 0 199.21875 /end CHARACTERISTIC
/begin CHARACTERISTIC mKMISAK "ROM Const mKMISAK" VALUE 0x00008765 REC_UBYTE_C 0 COMP_0009 0 199.21875 /end CHARACTERISTIC
/begin CHARACTERISTIC mKMISC1 "ROM Const mKMISC1" VALUE 0x00008766 REC_UBYTE_C 0 COMP_0009 0 199.21875 /end CHARACTERISTIC
/begin CHARACTERISTIC mKMISC2 "ROM Const mKMISC2" VALUE 0x00008767 REC_UBYTE_C 0 COMP_0009 0 199.21875 /end CHARACTERISTIC
/begin CHARACTERISTIC mKMISC3 "ROM Const mKMISC3" VALUE 0x00008768 REC_UBYTE_C 0 COMP_0009 0 199.21875 /end CHARACTERISTIC
/begin CHARACTERISTIC mKMISC5 "ROM Const mKMISC5" VALUE 0x00008769 REC_UBYTE_C 0 COMP_0009 0 199.21875 /end CHARACTERISTIC
/begin CHARACTERISTIC mKMISC6 "ROM Const mKMISC6" VALUE 0x0000876A REC_UBYTE_C 0 COMP_0009 0 199.21875 /end CHARACTERISTIC
/begin CHARACTERISTIC mKMISC7 "ROM Const mKMISC7" VALUE 0x0000876B REC_UBYTE_C 0 COMP_0009 0 199.21875 /end CHARACTERISTIC
/begin CHARACTERISTIC mKMISC8 "ROM Const mKMISC8" VALUE 0x0000876C REC_UBYTE_C 0 COMP_0009 0 199.21875 /end CHARACTERISTIC
/begin CHARACTERISTIC mKMRCOH "ROM Const mKMRCOH" VALUE 0x0000876D REC_UBYTE_C 0 COMP_0177_S 0 1.9921875 /end CHARACTERISTIC
/begin CHARACTERISTIC mKMRCOR "ROM Const mKMRCOR" VALUE 0x0000876E REC_UBYTE_C 0 COMP_0177_S 0 1.9921875 /end CHARACTERISTIC
/begin CHARACTERISTIC mKMRD1H "ROM Const mKMRD1H" VALUE 0x0000876F REC_UBYTE_C 0 COMP_0017 0 255 /end CHARACTERISTIC
/begin CHARACTERISTIC mKMRD1R "ROM Const mKMRD1R" VALUE 0x00008770 REC_UBYTE_C 0 COMP_0017 0 255 /end CHARACTERISTIC
/begin CHARACTERISTIC mKMRD2H "ROM Const mKMRD2H" VALUE 0x00008771 REC_UBYTE_C 0 COMP_0017 0 255 /end CHARACTERISTIC
/begin CHARACTERISTIC mKMRD2R "ROM Const mKMRD2R" VALUE 0x00008772 REC_UBYTE_C 0 COMP_0017 0 255 /end CHARACTERISTIC
/begin CHARACTERISTIC mKMRDNH "ROM Const mKMRDNH" VALUE 0x00008773 REC_UBYTE_C 0 COMP_0020 0 12750 /end CHARACTERISTIC
/begin CHARACTERISTIC mKMRDNL "ROM Const mKMRDNL" VALUE 0x00008774 REC_UBYTE_C 0 COMP_0020 0 12750 /end CHARACTERISTIC
/begin CHARACTERISTIC mKMRDTO "ROM Const mKMRDTO" VALUE 0x00008775 REC_UBYTE_C 0 COMP_0002 0 89.25 /end CHARACTERISTIC
/begin CHARACTERISTIC mKMRGP "ROM Const mKMRGP" VALUE 0x00008776 REC_UBYTE_C 0 COMP_0068 0 255 /end CHARACTERISTIC
/begin CHARACTERISTIC mKMRHT "ROM Const mKMRHT" VALUE 0x00008777 REC_UBYTE_C 0 COMP_0008 0 25500 /end CHARACTERISTIC
/begin CHARACTERISTIC mKMRMAX "ROM Const mKMRMAX" VALUE 0x0000928C REC_UWORD_C 0 COMP_0217 0 3.999941832 /end CHARACTERISTIC
/begin CHARACTERISTIC mKMRMUL "ROM Const mKMRMUL" VALUE 0x00008778 REC_UBYTE_C 0 COMP_0045 0 1.9921875 /end CHARACTERISTIC
/begin CHARACTERISTIC mKMRNELL "ROM Const mKMRNELL" VALUE 0x00008779 REC_UBYTE_C 0 COMP_0020 0 12750 /end CHARACTERISTIC
/begin CHARACTERISTIC mKMRNELM "ROM Const mKMRNELM" VALUE 0x0000877A REC_UBYTE_C 0 COMP_0020 0 12750 /end CHARACTERISTIC
/begin CHARACTERISTIC mKMRSTP1 "ROM Const mKMRSTP1" VALUE 0x0000928E REC_UWORD_C 0 COMP_0217 0 3.999941832 /end CHARACTERISTIC
/begin CHARACTERISTIC mKMRSTP2 "ROM Const mKMRSTP2" VALUE 0x00009290 REC_UWORD_C 0 COMP_0217 0 3.999941832 /end CHARACTERISTIC
/begin CHARACTERISTIC mKMRSTP3 "ROM Const mKMRSTP3" VALUE 0x00009292 REC_UWORD_C 0 COMP_0217 0 3.999941832 /end CHARACTERISTIC
/begin CHARACTERISTIC mKMRSTP4 "ROM Const mKMRSTP4" VALUE 0x00009294 REC_UWORD_C 0 COMP_0217 0 3.999941832 /end CHARACTERISTIC
/begin CHARACTERISTIC mKMRVSP "ROM Const mKMRVSP" VALUE 0x0000877B REC_UBYTE_C 0 COMP_0007 0 510 /end CHARACTERISTIC
/begin CHARACTERISTIC mKMSEI1 "ROM Const mKMSEI1" VALUE 0x0000877C REC_UBYTE_C 0 COMP_0009 0 199.21875 /end CHARACTERISTIC
/begin CHARACTERISTIC mKMSEO1 "ROM Const mKMSEO1" VALUE 0x0000877D REC_UBYTE_C 0 COMP_0009 0 199.21875 /end CHARACTERISTIC
/begin CHARACTERISTIC mKNKDLYCL "ROM Const mKNKDLYCL" VALUE 0x0000877E REC_UBYTE_C 0 COMP_0178_S 0 0.0051 /end CHARACTERISTIC
/begin CHARACTERISTIC mKNKDLYOL "ROM Const mKNKDLYOL" VALUE 0x0000877F REC_UBYTE_C 0 COMP_0178_S 0 0.0051 /end CHARACTERISTIC
/begin CHARACTERISTIC mKNKINC "ROM Const mKNKINC" VALUE 0x00008234 REC_SBYTE_C 0 COMP_0018 -128 127 /end CHARACTERISTIC
/begin CHARACTERISTIC mKNKINO "ROM Const mKNKINO" VALUE 0x00008235 REC_SBYTE_C 0 COMP_0018 -128 127 /end CHARACTERISTIC
/begin CHARACTERISTIC mKNKLDVTC "ROM Const mKNKLDVTC" VALUE 0x00008780 REC_UBYTE_C 0 COMP_0048 0 127.5 /end CHARACTERISTIC
/begin CHARACTERISTIC mKNKNGH "ROM Const mKNKNGH" VALUE 0x00008781 REC_UBYTE_C 0 COMP_0054 0 5100 /end CHARACTERISTIC
/begin CHARACTERISTIC mKNKNGL "ROM Const mKNKNGL" VALUE 0x00008782 REC_UBYTE_C 0 COMP_0054 0 5100 /end CHARACTERISTIC
/begin CHARACTERISTIC mKNQLHYS "ROM Const mKNQLHYS" VALUE 0x00009296 REC_UWORD_C 0 COMP_0064 0 102398.4375 /end CHARACTERISTIC
/begin CHARACTERISTIC mKNQLMT "ROM Const mKNQLMT" VALUE 0x00009298 REC_UWORD_C 0 COMP_0064 0 102398.4375 /end CHARACTERISTIC
/begin CHARACTERISTIC mKNQVTL "ROM Const mKNQVTL" VALUE 0x0000929A REC_UWORD_C 0 COMP_0064 0 102398.4375 /end CHARACTERISTIC
/begin CHARACTERISTIC mKOPRHYS "ROM Const mKOPRHYS" VALUE 0x00008783 REC_UBYTE_C 0 COMP_0179_S 0 2.55 /end CHARACTERISTIC
/begin CHARACTERISTIC mKPG "ROM Const mKPG" VALUE 0x0000929C REC_UWORD_C 0 COMP_0061_S 0 6.5535 /end CHARACTERISTIC
/begin CHARACTERISTIC mKPRTCD13 "ROM Const mKPRTCD13" VALUE 0x00008784 REC_UBYTE_C 0 COMP_0045 0 1.9921875 /end CHARACTERISTIC
/begin CHARACTERISTIC mKPRTHNG "ROM Const mKPRTHNG" VALUE 0x00008785 REC_UBYTE_C 0 COMP_0009 0 199.21875 /end CHARACTERISTIC
/begin CHARACTERISTIC mKPRTLNG "ROM Const mKPRTLNG" VALUE 0x00008786 REC_UBYTE_C 0 COMP_0009 0 199.21875 /end CHARACTERISTIC
/begin CHARACTERISTIC mKPRTNGT "ROM Const mKPRTNGT" VALUE 0x00008787 REC_UBYTE_C 0 COMP_0008 0 25500 /end CHARACTERISTIC
/begin CHARACTERISTIC mKQAC "ROM Const mKQAC" VALUE 0x00008788 REC_UBYTE_C 0 COMP_0051 0 255 /end CHARACTERISTIC
/begin CHARACTERISTIC mKQCKP "ROM Const mKQCKP" VALUE 0x00008789 REC_UBYTE_C 0 COMP_0220 0 255 /end CHARACTERISTIC
/begin CHARACTERISTIC mKREDUCT "ROM Const mKREDUCT" VALUE 0x0000878A REC_UBYTE_C 0 COMP_0180_S 0 0.99603 /end CHARACTERISTIC
/begin CHARACTERISTIC mKRET "ROM Const mKRET" VALUE 0x0000878B REC_UBYTE_C 0 COMP_0014 0 2550 /end CHARACTERISTIC
/begin CHARACTERISTIC mKRETRCT "ROM Const mKRETRCT" VALUE 0x0000929E REC_UWORD_C 0 COMP_0016 0 65535 /end CHARACTERISTIC
/begin CHARACTERISTIC mKSFTMX "ROM Const mKSFTMX" VALUE 0x000092A0 REC_UWORD_C 0 COMP_0453 0 131.07 /end CHARACTERISTIC
/begin CHARACTERISTIC mKSHO "ROM Const mKSHO" VALUE 0x000092A2 REC_UWORD_C 0 COMP_0181_S 0 0.65535 /end CHARACTERISTIC
/begin CHARACTERISTIC mKSMSA1 "ROM Const mKSMSA1" VALUE 0x0000878C REC_UBYTE_C 0 COMP_0009 0 199.21875 /end CHARACTERISTIC
/begin CHARACTERISTIC mKSTBGN "ROM Const mKSTBGN" VALUE 0x0000878D REC_UBYTE_C 0 COMP_0045 0 1.9921875 /end CHARACTERISTIC
/begin CHARACTERISTIC mKSTHOS "ROM Const mKSTHOS" VALUE 0x000092A4 REC_UWORD_C 0 COMP_0182_S 0 65.535 /end CHARACTERISTIC
/begin CHARACTERISTIC mKTCNOK "ROM Const mKTCNOK" VALUE 0x0000878E REC_UBYTE_C 0 COMP_0016 0 255 /end CHARACTERISTIC
/begin CHARACTERISTIC mKTEMPL "ROM Const mKTEMPL" VALUE 0x0000878F REC_UBYTE_C 0 COMP_0062 0 1020 /end CHARACTERISTIC
/begin CHARACTERISTIC mKTENG1 "ROM Const mKTENG1" VALUE 0x00008790 REC_UBYTE_C 0 COMP_0063 0 0.99609375 /end CHARACTERISTIC
/begin CHARACTERISTIC mKTEPUMP0 "ROM Const mKTEPUMP0" VALUE 0x000092A6 REC_UWORD_C 0 COMP_0196 0 6553.5 /end CHARACTERISTIC
/begin CHARACTERISTIC mKTFBYA "ROM Const mKTFBYA" VALUE 0x00008791 REC_UBYTE_C 0 COMP_0045 0 1.9921875 /end CHARACTERISTIC
/begin CHARACTERISTIC mKTMPSL "ROM Const mKTMPSL" VALUE 0x00008792 REC_UBYTE_C 0 COMP_0062 0 1020 /end CHARACTERISTIC
/begin CHARACTERISTIC mKTMPWT "ROM Const mKTMPWT" VALUE 0x00008793 REC_UBYTE_C 0 COMP_0096 0 2550 /end CHARACTERISTIC
/begin CHARACTERISTIC mKTNOK1 "ROM Const mKTNOK1" VALUE 0x00008794 REC_UBYTE_C 0 COMP_0016 0 255 /end CHARACTERISTIC
/begin CHARACTERISTIC mKTOK21 "ROM Const mKTOK21" VALUE 0x00008795 REC_UBYTE_C 0 COMP_0016 0 255 /end CHARACTERISTIC
/begin CHARACTERISTIC mKTPPUMP "ROM Const mKTPPUMP" VALUE 0x00008796 REC_UBYTE_C 0 COMP_0435 0 7.96875 /end CHARACTERISTIC
/begin CHARACTERISTIC mKTRTD1 "ROM Const mKTRTD1" VALUE 0x00008797 REC_UBYTE_C 0 COMP_0183_S 0 3.984375 /end CHARACTERISTIC
/begin CHARACTERISTIC mKTRTD2 "ROM Const mKTRTD2" VALUE 0x00008798 REC_UBYTE_C 0 COMP_0183_S 0 3.984375 /end CHARACTERISTIC
/begin CHARACTERISTIC mKTST1 "ROM Const mKTST1" VALUE 0x00008799 REC_UBYTE_C 0 COMP_0008 0 25500 /end CHARACTERISTIC
/begin CHARACTERISTIC mKUBZTW "ROM Const mKUBZTW" VALUE 0x0000879A REC_UBYTE_C 0 COMP_0035 -50 205 /end CHARACTERISTIC
/begin CHARACTERISTIC mKUPDTY "ROM Const mKUPDTY" VALUE 0x000092A8 REC_UWORD_C 0 COMP_0184_S 0 6553.5 /end CHARACTERISTIC
/begin CHARACTERISTIC mKV2MAX "ROM Const mKV2MAX" VALUE 0x0000879B REC_UBYTE_C 0 COMP_0044 0 1.9921875 /end CHARACTERISTIC
/begin CHARACTERISTIC mKV2MIN "ROM Const mKV2MIN" VALUE 0x0000879C REC_UBYTE_C 0 COMP_0044 0 1.9921875 /end CHARACTERISTIC
/begin CHARACTERISTIC mKVADJMN "ROM Const mKVADJMN" VALUE 0x00008E58 REC_SWORD_C 0 COMP_0353 -163840 163835 /end CHARACTERISTIC
/begin CHARACTERISTIC mKVADJMX "ROM Const mKVADJMX" VALUE 0x00008E5A REC_SWORD_C 0 COMP_0353 -163840 163835 /end CHARACTERISTIC
/begin CHARACTERISTIC mKVBYN "ROM Const mKVBYN" VALUE 0x000092AA REC_UWORD_C 0 COMP_0224 0 0.999985458 /end CHARACTERISTIC
/begin CHARACTERISTIC mKVBYN2 "ROM Const mKVBYN2" VALUE 0x000092AC REC_UWORD_C 0 COMP_0224 0 0.999985458 /end CHARACTERISTIC
/begin CHARACTERISTIC mKVCCRF "ROM Const mKVCCRF" VALUE 0x000092AE REC_UWORD_C 0 COMP_0225 0 1.9988175 /end CHARACTERISTIC
/begin CHARACTERISTIC mKVTCMAX "ROM Const mKVTCMAX" VALUE 0x000092B0 REC_UWORD_C 0 COMP_0069 0 1.999970916 /end CHARACTERISTIC
/begin CHARACTERISTIC mKVTCMEMN "ROM Const mKVTCMEMN" VALUE 0x0000879D REC_UBYTE_C 0 COMP_0045 0 1.9921875 /end CHARACTERISTIC
/begin CHARACTERISTIC mKVTCMEMX "ROM Const mKVTCMEMX" VALUE 0x0000879E REC_UBYTE_C 0 COMP_0045 0 1.9921875 /end CHARACTERISTIC
/begin CHARACTERISTIC mKVTCMIMN "ROM Const mKVTCMIMN" VALUE 0x0000879F REC_UBYTE_C 0 COMP_0044 0 1.9921875 /end CHARACTERISTIC
/begin CHARACTERISTIC mKVTCMIMX "ROM Const mKVTCMIMX" VALUE 0x000087A0 REC_UBYTE_C 0 COMP_0044 0 1.9921875 /end CHARACTERISTIC
/begin CHARACTERISTIC mKVTCMIN "ROM Const mKVTCMIN" VALUE 0x000092B2 REC_UWORD_C 0 COMP_0069 0 1.999970916 /end CHARACTERISTIC
/begin CHARACTERISTIC mKWGSPR "ROM Const mKWGSPR" VALUE 0x000087A1 REC_UBYTE_C 0 COMP_0185_S 0 15300 /end CHARACTERISTIC
/begin CHARACTERISTIC mKYUACC "ROM Const mKYUACC" VALUE 0x000087A2 REC_UBYTE_C 0 COMP_0082_S 0 255 /end CHARACTERISTIC
/begin CHARACTERISTIC mKYUYU "ROM Const mKYUYU" VALUE 0x000092B4 REC_UWORD_C 0 COMP_0050 0 5119.921875 /end CHARACTERISTIC
/begin CHARACTERISTIC mL2MNTM "ROM Const mL2MNTM" VALUE 0x000087A3 REC_UBYTE_C 0 COMP_0008 0 25500 /end CHARACTERISTIC
/begin CHARACTERISTIC mL2MXTMH "ROM Const mL2MXTMH" VALUE 0x000087A4 REC_UBYTE_C 0 COMP_0014 0 2550 /end CHARACTERISTIC
/begin CHARACTERISTIC mL2PFMAXH "ROM Const mL2PFMAXH" VALUE 0x000092B6 REC_UWORD_C 0 COMP_0031_S 0 39.97635 /end CHARACTERISTIC
/begin CHARACTERISTIC mLANGE "ROM Const mLANGE" VALUE 0x000097C8 REC_ULONG_C 0 COMP_0186_S 0 107374182.375 /end CHARACTERISTIC
/begin CHARACTERISTIC mLARNPRG "ROM Const mLARNPRG" VALUE 0x000087A6 REC_UBYTE_C 0 COMP_0187_S 0 9.9609375 /end CHARACTERISTIC
/begin CHARACTERISTIC mLASNIA "ROM Const mLASNIA" VALUE 0x000087A7 REC_UBYTE_C 0 COMP_0001 0 31.875 /end CHARACTERISTIC
/begin CHARACTERISTIC mLCHYVSP1 "ROM Const mLCHYVSP1" VALUE 0x00009710 REC_SLONG_C 0 COMP_0144_S -1843.20024746394 1843.20024660563 /end CHARACTERISTIC
/begin CHARACTERISTIC mLCHYVSP2 "ROM Const mLCHYVSP2" VALUE 0x00009714 REC_SLONG_C 0 COMP_0144_S -1843.20024746394 1843.20024660563 /end CHARACTERISTIC
/begin CHARACTERISTIC mLCLMP "ROM Const mLCLMP" VALUE 0x000087A8 REC_UBYTE_C 0 COMP_0027 0 255 /end CHARACTERISTIC
/begin CHARACTERISTIC mLCLMP2 "ROM Const mLCLMP2" VALUE 0x000087A9 REC_UBYTE_C 0 COMP_0027 0 255 /end CHARACTERISTIC
/begin CHARACTERISTIC mLCLPN1 "ROM Const mLCLPN1" VALUE 0x000087AA REC_UBYTE_C 0 COMP_0006 0 3187.5 /end CHARACTERISTIC
/begin CHARACTERISTIC mLCLPN2 "ROM Const mLCLPN2" VALUE 0x000087AB REC_UBYTE_C 0 COMP_0006 0 3187.5 /end CHARACTERISTIC
/begin CHARACTERISTIC mLCRMCMTA "ROM Const mLCRMCMTA" VALUE 0x00008236 REC_SBYTE_C 0 COMP_0143_S -128 127 /end CHARACTERISTIC
/begin CHARACTERISTIC mLCRMCMTF "ROM Const mLCRMCMTF" VALUE 0x00008237 REC_SBYTE_C 0 COMP_0143_S -128 127 /end CHARACTERISTIC
/begin CHARACTERISTIC mLCRMCMTH "ROM Const mLCRMCMTH" VALUE 0x00008238 REC_SBYTE_C 0 COMP_0143_S -128 127 /end CHARACTERISTIC
/begin CHARACTERISTIC mLCRMCMTO "ROM Const mLCRMCMTO" VALUE 0x00008239 REC_SBYTE_C 0 COMP_0143_S -128 127 /end CHARACTERISTIC
/begin CHARACTERISTIC mLCRMCMTW "ROM Const mLCRMCMTW" VALUE 0x0000823A REC_SBYTE_C 0 COMP_0143_S -128 127 /end CHARACTERISTIC
/begin CHARACTERISTIC mLCSTVB "ROM Const mLCSTVB" VALUE 0x000087AC REC_UBYTE_C 0 COMP_0033 0 20400 /end CHARACTERISTIC
/begin CHARACTERISTIC mLCUTVSP "ROM Const mLCUTVSP" VALUE 0x00009718 REC_SLONG_C 0 COMP_0144_S -1843.20024746394 1843.20024660563 /end CHARACTERISTIC
/begin CHARACTERISTIC mLDTVL "ROM Const mLDTVL" VALUE 0x000087AD REC_UBYTE_C 0 COMP_0032 0 0.99609375 /end CHARACTERISTIC
/begin CHARACTERISTIC mLEANG "ROM Const mLEANG" VALUE 0x0000823B REC_SBYTE_C 0 COMP_0472 -2 1.984375 /end CHARACTERISTIC
/begin CHARACTERISTIC mLEANLMT "ROM Const mLEANLMT" VALUE 0x000092B8 REC_UWORD_C 0 COMP_0453 0 131.07 /end CHARACTERISTIC
/begin CHARACTERISTIC mLEANLMTL "ROM Const mLEANLMTL" VALUE 0x000092BA REC_UWORD_C 0 COMP_0453 0 131.07 /end CHARACTERISTIC
/begin CHARACTERISTIC mLEK1F2 "ROM Const mLEK1F2" VALUE 0x000087AE REC_UBYTE_C 0 COMP_0232 0 1.9921875 /end CHARACTERISTIC
/begin CHARACTERISTIC mLEK1F3 "ROM Const mLEK1F3" VALUE 0x000087AF REC_UBYTE_C 0 COMP_0232 0 1.9921875 /end CHARACTERISTIC
/begin CHARACTERISTIC mLEK2F2 "ROM Const mLEK2F2" VALUE 0x000087B0 REC_UBYTE_C 0 COMP_0232 0 1.9921875 /end CHARACTERISTIC
/begin CHARACTERISTIC mLENDLY "ROM Const mLENDLY" VALUE 0x000087B1 REC_UBYTE_C 0 COMP_0234 0 2550 /end CHARACTERISTIC
/begin CHARACTERISTIC mLENLMTLC "ROM Const mLENLMTLC" VALUE 0x000092BC REC_UWORD_C 0 COMP_0453 0 131.07 /end CHARACTERISTIC
/begin CHARACTERISTIC mLFPFB "ROM Const mLFPFB" VALUE 0x000092BE REC_UWORD_C 0 COMP_0031_S 0 39.97635 /end CHARACTERISTIC
/begin CHARACTERISTIC mLGIG "ROM Const mLGIG" VALUE 0x000092C0 REC_UWORD_C 0 COMP_0016 0 65535 /end CHARACTERISTIC
/begin CHARACTERISTIC mLGPG "ROM Const mLGPG" VALUE 0x000092C2 REC_UWORD_C 0 COMP_0016 0 65535 /end CHARACTERISTIC
/begin CHARACTERISTIC mLGTIM "ROM Const mLGTIM" VALUE 0x000087B2 REC_UBYTE_C 0 COMP_0014 0 2550 /end CHARACTERISTIC
/begin CHARACTERISTIC mLHNES "ROM Const mLHNES" VALUE 0x000087B4 REC_UBYTE_C 0 COMP_0006 0 3187.5 /end CHARACTERISTIC
/begin CHARACTERISTIC mLHPDLLMT "ROM Const mLHPDLLMT" VALUE 0x000092C4 REC_UWORD_C 0 COMP_0032_S 0 8191.875 /end CHARACTERISTIC
/begin CHARACTERISTIC mLHPDLSP "ROM Const mLHPDLSP" VALUE 0x000092C6 REC_UWORD_C 0 COMP_0032_S 0 8191.875 /end CHARACTERISTIC
/begin CHARACTERISTIC mLHPDLS_S "ROM Const mLHPDLS_S" VALUE 0x00015A0E REC_UWORD_C 0 COMP_0032_S 0 8191.875 /end CHARACTERISTIC
/begin CHARACTERISTIC mLHTP "ROM Const mLHTP" VALUE 0x000087B5 REC_UBYTE_C 0 COMP_0001 0 31.875 /end CHARACTERISTIC
/begin CHARACTERISTIC mLITFNG "ROM Const mLITFNG" VALUE 0x000087B7 REC_UBYTE_C 0 COMP_0054 0 5100 /end CHARACTERISTIC
/begin CHARACTERISTIC mLKBRA "ROM Const mLKBRA" VALUE 0x000087B8 REC_UBYTE_C 0 COMP_0027 0 255 /end CHARACTERISTIC
/begin CHARACTERISTIC mLKBRBA "ROM Const mLKBRBA" VALUE 0x000087B9 REC_UBYTE_C 0 COMP_0027 0 255 /end CHARACTERISTIC
/begin CHARACTERISTIC mLLDPR_FA "ROM Const mLLDPR_FA" VALUE 0x000087BA REC_UBYTE_C 0 COMP_0373 0 2.55 /end CHARACTERISTIC
/begin CHARACTERISTIC mLLENGTM "ROM Const mLLENGTM" VALUE 0x000092C8 REC_UWORD_C 0 COMP_0015_S 0 6553.5 /end CHARACTERISTIC
/begin CHARACTERISTIC mLLFGAGE2 "ROM Const mLLFGAGE2" VALUE 0x000092CA REC_UWORD_C 0 COMP_0145_S 0 5.119921875 /end CHARACTERISTIC
/begin CHARACTERISTIC mLLMINTMP "ROM Const mLLMINTMP" VALUE 0x000087BB REC_UBYTE_C 0 COMP_0004_S -50 205 /end CHARACTERISTIC
/begin CHARACTERISTIC mLLTOEND "ROM Const mLLTOEND" VALUE 0x000087BC REC_UBYTE_C 0 COMP_0004_S -50 205 /end CHARACTERISTIC
/begin CHARACTERISTIC mLLTWEND "ROM Const mLLTWEND" VALUE 0x000087BD REC_UBYTE_C 0 COMP_0004_S -50 205 /end CHARACTERISTIC
/begin CHARACTERISTIC mLMCLLWH "ROM Const mLMCLLWH" VALUE 0x000092CC REC_UWORD_C 0 COMP_0453 0 131.07 /end CHARACTERISTIC
/begin CHARACTERISTIC mLMCLMXH "ROM Const mLMCLMXH" VALUE 0x000087BE REC_UBYTE_C 0 COMP_0071 0 255 /end CHARACTERISTIC
/begin CHARACTERISTIC mLMCLSLW "ROM Const mLMCLSLW" VALUE 0x000092CE REC_UWORD_C 0 COMP_0453 0 131.07 /end CHARACTERISTIC
/begin CHARACTERISTIC mLMCLSMX "ROM Const mLMCLSMX" VALUE 0x000087BF REC_UBYTE_C 0 COMP_0071 0 255 /end CHARACTERISTIC
/begin CHARACTERISTIC mLMCLSUP "ROM Const mLMCLSUP" VALUE 0x000092D0 REC_UWORD_C 0 COMP_0453 0 131.07 /end CHARACTERISTIC
/begin CHARACTERISTIC mLMCLUPH "ROM Const mLMCLUPH" VALUE 0x000092D2 REC_UWORD_C 0 COMP_0453 0 131.07 /end CHARACTERISTIC
/begin CHARACTERISTIC mLMDPMD "ROM Const mLMDPMD" VALUE 0x000087C0 REC_UBYTE_C 0 COMP_0008 0 25500 /end CHARACTERISTIC
/begin CHARACTERISTIC mLMDSRTTW "ROM Const mLMDSRTTW" VALUE 0x000087C1 REC_UBYTE_C 0 COMP_0035 -50 205 /end CHARACTERISTIC
/begin CHARACTERISTIC mLMISCL "ROM Const mLMISCL" VALUE 0x000087C2 REC_UBYTE_C 0 COMP_0051 0 255 /end CHARACTERISTIC
/begin CHARACTERISTIC mLMISLD "ROM Const mLMISLD" VALUE 0x000087C3 REC_UBYTE_C 0 COMP_0051 0 255 /end CHARACTERISTIC
/begin CHARACTERISTIC mLMISLG "ROM Const mLMISLG" VALUE 0x000087C4 REC_UBYTE_C 0 COMP_0051 0 255 /end CHARACTERISTIC
/begin CHARACTERISTIC mLMTDFL "ROM Const mLMTDFL" VALUE 0x000092D4 REC_UWORD_C 0 COMP_0130 0 1802.2125 /end CHARACTERISTIC
/begin CHARACTERISTIC mLMTDFL_S "ROM Const mLMTDFL_S" VALUE 0x00015A10 REC_UWORD_C 0 COMP_0130 0 1802.2125 /end CHARACTERISTIC
/begin CHARACTERISTIC mLNDLY "ROM Const mLNDLY" VALUE 0x000087C6 REC_UBYTE_C 0 COMP_0008 0 25500 /end CHARACTERISTIC
/begin CHARACTERISTIC mLNSENNG "ROM Const mLNSENNG" VALUE 0x000092D6 REC_UWORD_C 0 COMP_0050 0 5119.921875 /end CHARACTERISTIC
/begin CHARACTERISTIC mLNUM_1 "ROM Const mLNUM_1" VALUE 0x0000971C REC_SLONG_C 0 COMP_0005_S -214748.3648 214748.3647 /end CHARACTERISTIC
/begin CHARACTERISTIC mLNUM_2 "ROM Const mLNUM_2" VALUE 0x00009720 REC_SLONG_C 0 COMP_0005_S -214748.3648 214748.3647 /end CHARACTERISTIC
/begin CHARACTERISTIC mLOCKDY "ROM Const mLOCKDY" VALUE 0x000087C7 REC_UBYTE_C 0 COMP_0014 0 2550 /end CHARACTERISTIC
/begin CHARACTERISTIC mLOCKJC "ROM Const mLOCKJC" VALUE 0x000087C8 REC_UBYTE_C 0 COMP_0000 0 6375 /end CHARACTERISTIC
/begin CHARACTERISTIC mLOCKN "ROM Const mLOCKN" VALUE 0x000087C9 REC_UBYTE_C 0 COMP_0000 0 6375 /end CHARACTERISTIC
/begin CHARACTERISTIC mLODMIN "ROM Const mLODMIN" VALUE 0x000087CA REC_UBYTE_C 0 COMP_0006 0 3187.5 /end CHARACTERISTIC
/begin CHARACTERISTIC mLOLMT "ROM Const mLOLMT" VALUE 0x000092D8 REC_UWORD_C 0 COMP_0453 0 131.07 /end CHARACTERISTIC
/begin CHARACTERISTIC mLOLMT2 "ROM Const mLOLMT2" VALUE 0x000092DA REC_UWORD_C 0 COMP_0453 0 131.07 /end CHARACTERISTIC
/begin CHARACTERISTIC mLOWPICST "ROM Const mLOWPICST" VALUE 0x000087CB REC_UBYTE_C 0 COMP_0007 0 510 /end CHARACTERISTIC
/begin CHARACTERISTIC mLOWTIME "ROM Const mLOWTIME" VALUE 0x000087CC REC_UBYTE_C 0 COMP_0183 0 5100 /end CHARACTERISTIC
/begin CHARACTERISTIC mLPFJDG "ROM Const mLPFJDG" VALUE 0x000092DC REC_UWORD_C 0 COMP_0031_S 0 39.97635 /end CHARACTERISTIC
/begin CHARACTERISTIC mLPFLTSL "ROM Const mLPFLTSL" VALUE 0x00009724 REC_SLONG_C 0 COMP_0002_S -2147483648 2147483647 /end CHARACTERISTIC
/begin CHARACTERISTIC mLPMTOAA "ROM Const mLPMTOAA" VALUE 0x000092DE REC_UWORD_C 0 COMP_0188_S 0 0.0063999056205 /end CHARACTERISTIC
/begin CHARACTERISTIC mLQAC "ROM Const mLQAC" VALUE 0x000087CD REC_UBYTE_C 0 COMP_0051 0 255 /end CHARACTERISTIC
/begin CHARACTERISTIC mLRCRT "ROM Const mLRCRT" VALUE 0x000092E0 REC_UWORD_C 0 COMP_0453 0 131.07 /end CHARACTERISTIC
/begin CHARACTERISTIC mLRNANG "ROM Const mLRNANG" VALUE 0x000087CE REC_UBYTE_C 0 COMP_0048 0 127.5 /end CHARACTERISTIC
/begin CHARACTERISTIC mLRNNEH1 "ROM Const mLRNNEH1" VALUE 0x000092E2 REC_UWORD_C 0 COMP_0006 0 819187.5 /end CHARACTERISTIC
/begin CHARACTERISTIC mLRNNEH2 "ROM Const mLRNNEH2" VALUE 0x000092E4 REC_UWORD_C 0 COMP_0006 0 819187.5 /end CHARACTERISTIC
/begin CHARACTERISTIC mLRNNEL1 "ROM Const mLRNNEL1" VALUE 0x000092E6 REC_UWORD_C 0 COMP_0006 0 819187.5 /end CHARACTERISTIC
/begin CHARACTERISTIC mLRNNEL2 "ROM Const mLRNNEL2" VALUE 0x000092E8 REC_UWORD_C 0 COMP_0006 0 819187.5 /end CHARACTERISTIC
/begin CHARACTERISTIC mLRNTIM "ROM Const mLRNTIM" VALUE 0x000087CF REC_UBYTE_C 0 COMP_0008 0 25500 /end CHARACTERISTIC
/begin CHARACTERISTIC mLRPMTANH "ROM Const mLRPMTANH" VALUE 0x000087D0 REC_UBYTE_C 0 COMP_0035 -50 205 /end CHARACTERISTIC
/begin CHARACTERISTIC mLRPMTWNH "ROM Const mLRPMTWNH" VALUE 0x000087D1 REC_UBYTE_C 0 COMP_0035 -50 205 /end CHARACTERISTIC
/begin CHARACTERISTIC mLRUPLT1 "ROM Const mLRUPLT1" VALUE 0x000092EA REC_UWORD_C 0 COMP_0061 0 327675 /end CHARACTERISTIC
/begin CHARACTERISTIC mLRUPLT2 "ROM Const mLRUPLT2" VALUE 0x000092EC REC_UWORD_C 0 COMP_0061 0 327675 /end CHARACTERISTIC
/begin CHARACTERISTIC mLRUPLT4B "ROM Const mLRUPLT4B" VALUE 0x000092EE REC_UWORD_C 0 COMP_0061 0 327675 /end CHARACTERISTIC
/begin CHARACTERISTIC mLSOSQH "ROM Const mLSOSQH" VALUE 0x00009728 REC_SLONG_C 0 COMP_0148_S -21474836.48 21474836.47 /end CHARACTERISTIC
/begin CHARACTERISTIC mLSOSQL "ROM Const mLSOSQL" VALUE 0x0000972C REC_SLONG_C 0 COMP_0148_S -21474836.48 21474836.47 /end CHARACTERISTIC
/begin CHARACTERISTIC mLSPDLY "ROM Const mLSPDLY" VALUE 0x000087D2 REC_UBYTE_C 0 COMP_0015_S 0 25.5 /end CHARACTERISTIC
/begin CHARACTERISTIC mLTGABF "ROM Const mLTGABF" VALUE 0x000092F0 REC_UWORD_C 0 COMP_0453 0 131.07 /end CHARACTERISTIC
/begin CHARACTERISTIC mLTIST "ROM Const mLTIST" VALUE 0x000092F2 REC_UWORD_C 0 COMP_0125 0 255.99609375 /end CHARACTERISTIC
/begin CHARACTERISTIC mLUHTW "ROM Const mLUHTW" VALUE 0x000087D3 REC_UBYTE_C 0 COMP_0035 -50 205 /end CHARACTERISTIC
/begin CHARACTERISTIC mLUOFDY "ROM Const mLUOFDY" VALUE 0x000087D4 REC_UBYTE_C 0 COMP_0014 0 2550 /end CHARACTERISTIC
/begin CHARACTERISTIC mLUOFFN "ROM Const mLUOFFN" VALUE 0x000087D5 REC_UBYTE_C 0 COMP_0443 0 255 /end CHARACTERISTIC
/begin CHARACTERISTIC mLUOFFNG "ROM Const mLUOFFNG" VALUE 0x000087D6 REC_UBYTE_C 0 COMP_0443 0 255 /end CHARACTERISTIC
/begin CHARACTERISTIC mLUOFFNLM "ROM Const mLUOFFNLM" VALUE 0x000087D7 REC_UBYTE_C 0 COMP_0443 0 255 /end CHARACTERISTIC
/begin CHARACTERISTIC mLVAFSMN "ROM Const mLVAFSMN" VALUE 0x000092F4 REC_UWORD_C 0 COMP_0023 0 327675 /end CHARACTERISTIC
/begin CHARACTERISTIC mLVAFSMX "ROM Const mLVAFSMX" VALUE 0x000092F6 REC_UWORD_C 0 COMP_0023 0 327675 /end CHARACTERISTIC
/begin CHARACTERISTIC mLVB "ROM Const mLVB" VALUE 0x000087D8 REC_UBYTE_C 0 COMP_0033 0 20400 /end CHARACTERISTIC
/begin CHARACTERISTIC mLVFUEL "ROM Const mLVFUEL" VALUE 0x000092F8 REC_UWORD_C 0 COMP_0023 0 327675 /end CHARACTERISTIC
/begin CHARACTERISTIC mMABF "ROM Const mMABF" VALUE 0x000087D9 REC_UBYTE_C 0 COMP_0373 0 2.55 /end CHARACTERISTIC
/begin CHARACTERISTIC mMASKAIHY "ROM Const mMASKAIHY" VALUE 0x000087DA REC_UBYTE_C 0 COMP_0009 0 199.21875 /end CHARACTERISTIC
/begin CHARACTERISTIC mMASKANHY "ROM Const mMASKANHY" VALUE 0x000087DB REC_UBYTE_C 0 COMP_0000 0 6375 /end CHARACTERISTIC
/begin CHARACTERISTIC mMAXMODD "ROM Const mMAXMODD" VALUE 0x000087DC REC_UBYTE_C 0 COMP_0189_S 0 84.999999915 /end CHARACTERISTIC
/begin CHARACTERISTIC mMAXRTO "ROM Const mMAXRTO" VALUE 0x000092FA REC_UWORD_C 0 COMP_0450 0 63.999056205 /end CHARACTERISTIC
/begin CHARACTERISTIC mMAXRTO_S "ROM Const mMAXRTO_S" VALUE 0x00015A12 REC_UWORD_C 0 COMP_0450 0 63.999056205 /end CHARACTERISTIC
/begin CHARACTERISTIC mMBGLI "ROM Const mMBGLI" VALUE 0x000087DD REC_UBYTE_C 0 COMP_0021 0 99.609375 /end CHARACTERISTIC
/begin CHARACTERISTIC mMBTM "ROM Const mMBTM" VALUE 0x000087DE REC_UBYTE_C 0 COMP_0248 0 0.99609375 /end CHARACTERISTIC
/begin CHARACTERISTIC mMBTT "ROM Const mMBTT" VALUE 0x000087DF REC_UBYTE_C 0 COMP_0190_S 0 0.000031875 /end CHARACTERISTIC
/begin CHARACTERISTIC mMDFSVSP "ROM Const mMDFSVSP" VALUE 0x000092FC REC_UWORD_C 0 COMP_0436 0 6553.5 /end CHARACTERISTIC
/begin CHARACTERISTIC mMDLTIM "ROM Const mMDLTIM" VALUE 0x000087E0 REC_UBYTE_C 0 COMP_0014 0 2550 /end CHARACTERISTIC
/begin CHARACTERISTIC mMFANOST "ROM Const mMFANOST" VALUE 0x000087E2 REC_UBYTE_C 0 COMP_0051 0 255 /end CHARACTERISTIC
/begin CHARACTERISTIC mMFANSLP "ROM Const mMFANSLP" VALUE 0x000087E3 REC_UBYTE_C 0 COMP_0191_S 0 2.55 /end CHARACTERISTIC
/begin CHARACTERISTIC mMFCSPED "ROM Const mMFCSPED" VALUE 0x00008E5C REC_SWORD_C 0 COMP_0002_S -32768 32767 /end CHARACTERISTIC
/begin CHARACTERISTIC mMFDRPM "ROM Const mMFDRPM" VALUE 0x000087E4 REC_UBYTE_C 0 COMP_0006 0 3187.5 /end CHARACTERISTIC
/begin CHARACTERISTIC mMFDTV2 "ROM Const mMFDTV2" VALUE 0x000087E5 REC_UBYTE_C 0 COMP_0129 -44.8 44.45 /end CHARACTERISTIC
/begin CHARACTERISTIC mMFDTV3 "ROM Const mMFDTV3" VALUE 0x000087E6 REC_UBYTE_C 0 COMP_0129 -44.8 44.45 /end CHARACTERISTIC
/begin CHARACTERISTIC mMFHSCV "ROM Const mMFHSCV" VALUE 0x000087E7 REC_UBYTE_C 0 COMP_0044 0 1.9921875 /end CHARACTERISTIC
/begin CHARACTERISTIC mMFKTL "ROM Const mMFKTL" VALUE 0x000087E8 REC_UBYTE_C 0 COMP_0020 0 12750 /end CHARACTERISTIC
/begin CHARACTERISTIC mMFLOAD "ROM Const mMFLOAD" VALUE 0x000087E9 REC_UBYTE_C 0 COMP_0004 0 255 /end CHARACTERISTIC
/begin CHARACTERISTIC mMFNACD "ROM Const mMFNACD" VALUE 0x000087EA REC_UBYTE_C 0 COMP_0016 0 255 /end CHARACTERISTIC
/begin CHARACTERISTIC mMFNAED "ROM Const mMFNAED" VALUE 0x000087EB REC_UBYTE_C 0 COMP_0016 0 255 /end CHARACTERISTIC
/begin CHARACTERISTIC mMFNCTD "ROM Const mMFNCTD" VALUE 0x000087EC REC_UBYTE_C 0 COMP_0016 0 255 /end CHARACTERISTIC
/begin CHARACTERISTIC mMFNEMD "ROM Const mMFNEMD" VALUE 0x000087ED REC_UBYTE_C 0 COMP_0016 0 255 /end CHARACTERISTIC
/begin CHARACTERISTIC mMFNFTP "ROM Const mMFNFTP" VALUE 0x000087EE REC_UBYTE_C 0 COMP_0000 0 6375 /end CHARACTERISTIC
/begin CHARACTERISTIC mMFNID "ROM Const mMFNID" VALUE 0x000087EF REC_UBYTE_C 0 COMP_0020 0 12750 /end CHARACTERISTIC
/begin CHARACTERISTIC mMFOPS1 "ROM Const mMFOPS1" VALUE 0x000087F0 REC_UBYTE_C 0 COMP_0063 0 0.99609375 /end CHARACTERISTIC
/begin CHARACTERISTIC mMFPERRJ "ROM Const mMFPERRJ" VALUE 0x00008E5E REC_SWORD_C 0 COMP_0192_S -8192 8191.75 /end CHARACTERISTIC
/begin CHARACTERISTIC mMFPID "ROM Const mMFPID" VALUE 0x000087F1 REC_UBYTE_C 0 COMP_0001 0 31.875 /end CHARACTERISTIC
/begin CHARACTERISTIC mMFRTTBPJ "ROM Const mMFRTTBPJ" VALUE 0x000092FE REC_UWORD_C 0 COMP_0193_S 0 3.999941832 /end CHARACTERISTIC
/begin CHARACTERISTIC mMFSPC "ROM Const mMFSPC" VALUE 0x000087F3 REC_UBYTE_C 0 COMP_0016 0 255 /end CHARACTERISTIC
/begin CHARACTERISTIC mMFSPE "ROM Const mMFSPE" VALUE 0x000087F4 REC_UBYTE_C 0 COMP_0016 0 255 /end CHARACTERISTIC
/begin CHARACTERISTIC mMFTFTP "ROM Const mMFTFTP" VALUE 0x000087F5 REC_UBYTE_C 0 COMP_0001 0 31.875 /end CHARACTERISTIC
/begin CHARACTERISTIC mMILEDEP "ROM Const mMILEDEP" VALUE 0x00009300 REC_UWORD_C 0 COMP_0389 0 25.720193775 /end CHARACTERISTIC
/begin CHARACTERISTIC mMILNGCN "ROM Const mMILNGCN" VALUE 0x000087F6 REC_UBYTE_C 0 COMP_0194_S 0 255 /end CHARACTERISTIC
/begin CHARACTERISTIC mMINAVLIM "ROM Const mMINAVLIM" VALUE 0x00008E60 REC_SWORD_C 0 COMP_0228 -3276.8 3276.7 /end CHARACTERISTIC
/begin CHARACTERISTIC mMINAVTQF "ROM Const mMINAVTQF" VALUE 0x00009302 REC_UWORD_C 0 COMP_0395 0 15.999780435 /end CHARACTERISTIC
/begin CHARACTERISTIC mMINMODD "ROM Const mMINMODD" VALUE 0x000087F7 REC_UBYTE_C 0 COMP_0189_S 0 84.999999915 /end CHARACTERISTIC
/begin CHARACTERISTIC mMINRTO "ROM Const mMINRTO" VALUE 0x00009304 REC_UWORD_C 0 COMP_0450 0 63.999056205 /end CHARACTERISTIC
/begin CHARACTERISTIC mMINRTO_S "ROM Const mMINRTO_S" VALUE 0x00015A14 REC_UWORD_C 0 COMP_0450 0 63.999056205 /end CHARACTERISTIC
/begin CHARACTERISTIC mMISFTMLM "ROM Const mMISFTMLM" VALUE 0x000087F8 REC_UBYTE_C 0 COMP_0015_S 0 25.5 /end CHARACTERISTIC
/begin CHARACTERISTIC mMKADV "ROM Const mMKADV" VALUE 0x000087F9 REC_UBYTE_C 0 COMP_0254 0 15.9375 /end CHARACTERISTIC
/begin CHARACTERISTIC mMKCNG "ROM Const mMKCNG" VALUE 0x000087FA REC_UBYTE_C 0 COMP_0108 0 0.99609375 /end CHARACTERISTIC
/begin CHARACTERISTIC mMKCNG3 "ROM Const mMKCNG3" VALUE 0x000087FB REC_UBYTE_C 0 COMP_0255 0 31.875 /end CHARACTERISTIC
/begin CHARACTERISTIC mMKIDL "ROM Const mMKIDL" VALUE 0x000087FC REC_UBYTE_C 0 COMP_0032 0 0.99609375 /end CHARACTERISTIC
/begin CHARACTERISTIC mMKKAS "ROM Const mMKKAS" VALUE 0x000087FD REC_UBYTE_C 0 COMP_0066 0 3.984375 /end CHARACTERISTIC
/begin CHARACTERISTIC mMKLMAX "ROM Const mMKLMAX" VALUE 0x000087FE REC_UBYTE_C 0 COMP_0027 0 255 /end CHARACTERISTIC
/begin CHARACTERISTIC mMKLMIN "ROM Const mMKLMIN" VALUE 0x000087FF REC_UBYTE_C 0 COMP_0027 0 255 /end CHARACTERISTIC
/begin CHARACTERISTIC mMKP "ROM Const mMKP" VALUE 0x00008800 REC_UBYTE_C 0 COMP_0259 0 255 /end CHARACTERISTIC
/begin CHARACTERISTIC mMKTM "ROM Const mMKTM" VALUE 0x00008801 REC_UBYTE_C 0 COMP_0049 0 255 /end CHARACTERISTIC
/begin CHARACTERISTIC mMKVAPO "ROM Const mMKVAPO" VALUE 0x00008802 REC_UBYTE_C 0 COMP_0002 0 89.25 /end CHARACTERISTIC
/begin CHARACTERISTIC mMNIGAIN "ROM Const mMNIGAIN" VALUE 0x00008E62 REC_SWORD_C 0 COMP_0195_S -3276.8 3276.7 /end CHARACTERISTIC
/begin CHARACTERISTIC mMNREF "ROM Const mMNREF" VALUE 0x00009306 REC_UWORD_C 0 COMP_0057_S 0 6553.5 /end CHARACTERISTIC
/begin CHARACTERISTIC mMNRRO2 "ROM Const mMNRRO2" VALUE 0x00008803 REC_UBYTE_C 0 COMP_0049 0 255 /end CHARACTERISTIC
/begin CHARACTERISTIC mMNSTANG "ROM Const mMNSTANG" VALUE 0x00009308 REC_UWORD_C 0 COMP_0057_S 0 6553.5 /end CHARACTERISTIC
/begin CHARACTERISTIC mMNTTCL "ROM Const mMNTTCL" VALUE 0x00008804 REC_UBYTE_C 0 COMP_0008 0 25500 /end CHARACTERISTIC
/begin CHARACTERISTIC mMODE1V "ROM Const mMODE1V" VALUE 0x00008805 REC_UBYTE_C 0 COMP_0033 0 20400 /end CHARACTERISTIC
/begin CHARACTERISTIC mMODE2V "ROM Const mMODE2V" VALUE 0x00008806 REC_UBYTE_C 0 COMP_0033 0 20400 /end CHARACTERISTIC
/begin CHARACTERISTIC mMODE2VM4 "ROM Const mMODE2VM4" VALUE 0x00008807 REC_UBYTE_C 0 COMP_0033 0 20400 /end CHARACTERISTIC
/begin CHARACTERISTIC mMODE2WIP "ROM Const mMODE2WIP" VALUE 0x00008808 REC_UBYTE_C 0 COMP_0033 0 20400 /end CHARACTERISTIC
/begin CHARACTERISTIC mMODE4BL "ROM Const mMODE4BL" VALUE 0x00008809 REC_UBYTE_C 0 COMP_0033 0 20400 /end CHARACTERISTIC
/begin CHARACTERISTIC mMODE4LH "ROM Const mMODE4LH" VALUE 0x0000880A REC_UBYTE_C 0 COMP_0033 0 20400 /end CHARACTERISTIC
/begin CHARACTERISTIC mMODE4LL "ROM Const mMODE4LL" VALUE 0x0000880B REC_UBYTE_C 0 COMP_0033 0 20400 /end CHARACTERISTIC
/begin CHARACTERISTIC mMODE4V "ROM Const mMODE4V" VALUE 0x0000880C REC_UBYTE_C 0 COMP_0033 0 20400 /end CHARACTERISTIC
/begin CHARACTERISTIC mMODE5BL "ROM Const mMODE5BL" VALUE 0x0000880D REC_UBYTE_C 0 COMP_0033 0 20400 /end CHARACTERISTIC
/begin CHARACTERISTIC mMODE5LH "ROM Const mMODE5LH" VALUE 0x0000880E REC_UBYTE_C 0 COMP_0033 0 20400 /end CHARACTERISTIC
/begin CHARACTERISTIC mMODE5LL "ROM Const mMODE5LL" VALUE 0x0000880F REC_UBYTE_C 0 COMP_0033 0 20400 /end CHARACTERISTIC
/begin CHARACTERISTIC mMODE8V "ROM Const mMODE8V" VALUE 0x00008810 REC_UBYTE_C 0 COMP_0033 0 20400 /end CHARACTERISTIC
/begin CHARACTERISTIC mMOTMIN "ROM Const mMOTMIN" VALUE 0x00008811 REC_UBYTE_C 0 COMP_0153 -128 127 /end CHARACTERISTIC
/begin CHARACTERISTIC mMOTRES "ROM Const mMOTRES" VALUE 0x0000930A REC_UWORD_C 0 COMP_0196_S 0 655.35 /end CHARACTERISTIC
/begin CHARACTERISTIC mMOTRESR "ROM Const mMOTRESR" VALUE 0x00008812 REC_UBYTE_C 0 COMP_0197_S 0 0.00255 /end CHARACTERISTIC
/begin CHARACTERISTIC mMOVECNT "ROM Const mMOVECNT" VALUE 0x00008813 REC_UBYTE_C 0 COMP_0068 0 255 /end CHARACTERISTIC
/begin CHARACTERISTIC mMPROKTM "ROM Const mMPROKTM" VALUE 0x00008814 REC_UBYTE_C 0 COMP_0015_S 0 25.5 /end CHARACTERISTIC
/begin CHARACTERISTIC mMPRUP "ROM Const mMPRUP" VALUE 0x00008815 REC_UBYTE_C 0 COMP_0015_S 0 25.5 /end CHARACTERISTIC
/begin CHARACTERISTIC mMPRUPVOL "ROM Const mMPRUPVOL" VALUE 0x00008816 REC_UBYTE_C 0 COMP_0419 0 25.5 /end CHARACTERISTIC
/begin CHARACTERISTIC mMPRZRT "ROM Const mMPRZRT" VALUE 0x00008817 REC_UBYTE_C 0 COMP_0015_S 0 25.5 /end CHARACTERISTIC
/begin CHARACTERISTIC mMRENST "ROM Const mMRENST" VALUE 0x00008818 REC_UBYTE_C 0 COMP_0009 0 199.21875 /end CHARACTERISTIC
/begin CHARACTERISTIC mMRTH1H "ROM Const mMRTH1H" VALUE 0x00008819 REC_UBYTE_C 0 COMP_0027 0 255 /end CHARACTERISTIC
/begin CHARACTERISTIC mMRTH1L "ROM Const mMRTH1L" VALUE 0x0000881A REC_UBYTE_C 0 COMP_0027 0 255 /end CHARACTERISTIC
/begin CHARACTERISTIC mMRTH2H "ROM Const mMRTH2H" VALUE 0x0000881B REC_UBYTE_C 0 COMP_0027 0 255 /end CHARACTERISTIC
/begin CHARACTERISTIC mMRTH2L "ROM Const mMRTH2L" VALUE 0x0000881C REC_UBYTE_C 0 COMP_0027 0 255 /end CHARACTERISTIC
/begin CHARACTERISTIC mMSRACTTM "ROM Const mMSRACTTM" VALUE 0x0000881D REC_UBYTE_C 0 COMP_0008 0 25500 /end CHARACTERISTIC
/begin CHARACTERISTIC mMSRVSPLM "ROM Const mMSRVSPLM" VALUE 0x0000930C REC_UWORD_C 0 COMP_0436 0 6553.5 /end CHARACTERISTIC
/begin CHARACTERISTIC mMSTINJT3 "ROM Const mMSTINJT3" VALUE 0x0000881E REC_UBYTE_C 0 COMP_0190 0 510 /end CHARACTERISTIC
/begin CHARACTERISTIC mMSU "ROM Const mMSU" VALUE 0x0000881F REC_UBYTE_C 0 COMP_0004 0 255 /end CHARACTERISTIC
/begin CHARACTERISTIC mMXCOMT "ROM Const mMXCOMT" VALUE 0x0000930E REC_UWORD_C 0 COMP_0013 0 65535 /end CHARACTERISTIC
/begin CHARACTERISTIC mMXDLALP2 "ROM Const mMXDLALP2" VALUE 0x00008820 REC_UBYTE_C 0 COMP_0419 0 25.5 /end CHARACTERISTIC
/begin CHARACTERISTIC mMXDLTALP "ROM Const mMXDLTALP" VALUE 0x00008821 REC_UBYTE_C 0 COMP_0419 0 25.5 /end CHARACTERISTIC
/begin CHARACTERISTIC mMXEDGTM "ROM Const mMXEDGTM" VALUE 0x00009310 REC_UWORD_C 0 COMP_0049 0 65535 /end CHARACTERISTIC
/begin CHARACTERISTIC mMXIGAIN "ROM Const mMXIGAIN" VALUE 0x00008E64 REC_SWORD_C 0 COMP_0195_S -3276.8 3276.7 /end CHARACTERISTIC
/begin CHARACTERISTIC mMXMPRP "ROM Const mMXMPRP" VALUE 0x00009312 REC_UWORD_C 0 COMP_0198_S 0 63.999056205 /end CHARACTERISTIC
/begin CHARACTERISTIC mNACCUT "ROM Const mNACCUT" VALUE 0x00008822 REC_UBYTE_C 0 COMP_0020 0 12750 /end CHARACTERISTIC
/begin CHARACTERISTIC mNACREC "ROM Const mNACREC" VALUE 0x00008823 REC_UBYTE_C 0 COMP_0020 0 12750 /end CHARACTERISTIC
/begin CHARACTERISTIC mNACRECI "ROM Const mNACRECI" VALUE 0x00008824 REC_UBYTE_C 0 COMP_0020 0 12750 /end CHARACTERISTIC
/begin CHARACTERISTIC mNADVAJH "ROM Const mNADVAJH" VALUE 0x00008825 REC_UBYTE_C 0 COMP_0000 0 6375 /end CHARACTERISTIC
/begin CHARACTERISTIC mNADVAJL "ROM Const mNADVAJL" VALUE 0x00008826 REC_UBYTE_C 0 COMP_0000 0 6375 /end CHARACTERISTIC
/begin CHARACTERISTIC mNALT1 "ROM Const mNALT1" VALUE 0x00008827 REC_UBYTE_C 0 COMP_0006 0 3187.5 /end CHARACTERISTIC
/begin CHARACTERISTIC mNALTDWN "ROM Const mNALTDWN" VALUE 0x00008828 REC_UBYTE_C 0 COMP_0051 0 255 /end CHARACTERISTIC
/begin CHARACTERISTIC mNALTUP "ROM Const mNALTUP" VALUE 0x00008829 REC_UBYTE_C 0 COMP_0051 0 255 /end CHARACTERISTIC
/begin CHARACTERISTIC mNB1 "ROM Const mNB1" VALUE 0x0000882A REC_UBYTE_C 0 COMP_0006 0 3187.5 /end CHARACTERISTIC
/begin CHARACTERISTIC mNB2 "ROM Const mNB2" VALUE 0x0000882B REC_UBYTE_C 0 COMP_0006 0 3187.5 /end CHARACTERISTIC
/begin CHARACTERISTIC mNBMAX "ROM Const mNBMAX" VALUE 0x0000882C REC_UBYTE_C 0 COMP_0006 0 3187.5 /end CHARACTERISTIC
/begin CHARACTERISTIC mNCHK2 "ROM Const mNCHK2" VALUE 0x0000882D REC_UBYTE_C 0 COMP_0020 0 12750 /end CHARACTERISTIC
/begin CHARACTERISTIC mNCHKC "ROM Const mNCHKC" VALUE 0x0000882E REC_UBYTE_C 0 COMP_0020 0 12750 /end CHARACTERISTIC
/begin CHARACTERISTIC mNCLMP1 "ROM Const mNCLMP1" VALUE 0x0000882F REC_UBYTE_C 0 COMP_0000 0 6375 /end CHARACTERISTIC
/begin CHARACTERISTIC mNCLMP2 "ROM Const mNCLMP2" VALUE 0x00008830 REC_UBYTE_C 0 COMP_0000 0 6375 /end CHARACTERISTIC
/begin CHARACTERISTIC mNCONF "ROM Const mNCONF" VALUE 0x00008831 REC_UBYTE_C 0 COMP_0049 0 255 /end CHARACTERISTIC
/begin CHARACTERISTIC mNCVTBLT "ROM Const mNCVTBLT" VALUE 0x00008832 REC_UBYTE_C 0 COMP_0006 0 3187.5 /end CHARACTERISTIC
/begin CHARACTERISTIC mNDADAJH "ROM Const mNDADAJH" VALUE 0x00008833 REC_UBYTE_C 0 COMP_0000 0 6375 /end CHARACTERISTIC
/begin CHARACTERISTIC mNDADAJL "ROM Const mNDADAJL" VALUE 0x00008834 REC_UBYTE_C 0 COMP_0000 0 6375 /end CHARACTERISTIC
/begin CHARACTERISTIC mNDCTTM "ROM Const mNDCTTM" VALUE 0x00008835 REC_UBYTE_C 0 COMP_0202 0 2550 /end CHARACTERISTIC
/begin CHARACTERISTIC mNDCTTW "ROM Const mNDCTTW" VALUE 0x00008836 REC_UBYTE_C 0 COMP_0035 -50 205 /end CHARACTERISTIC
/begin CHARACTERISTIC mNDCUTN "ROM Const mNDCUTN" VALUE 0x00008837 REC_UBYTE_C 0 COMP_0000 0 6375 /end CHARACTERISTIC
/begin CHARACTERISTIC mNDCUTV "ROM Const mNDCUTV" VALUE 0x00008838 REC_UBYTE_C 0 COMP_0007 0 510 /end CHARACTERISTIC
/begin CHARACTERISTIC mNDLYTWN "ROM Const mNDLYTWN" VALUE 0x00008839 REC_UBYTE_C 0 COMP_0035 -50 205 /end CHARACTERISTIC
/begin CHARACTERISTIC mNDPS "ROM Const mNDPS" VALUE 0x0000883A REC_UBYTE_C 0 COMP_0063 0 0.99609375 /end CHARACTERISTIC
/begin CHARACTERISTIC mNDRCTM "ROM Const mNDRCTM" VALUE 0x0000883B REC_UBYTE_C 0 COMP_0202 0 2550 /end CHARACTERISTIC
/begin CHARACTERISTIC mNDRECN "ROM Const mNDRECN" VALUE 0x0000883C REC_UBYTE_C 0 COMP_0000 0 6375 /end CHARACTERISTIC
/begin CHARACTERISTIC mNDWINT "ROM Const mNDWINT" VALUE 0x0000883D REC_UBYTE_C 0 COMP_0019 0 255 /end CHARACTERISTIC
/begin CHARACTERISTIC mNEACH "ROM Const mNEACH" VALUE 0x0000883E REC_UBYTE_C 0 COMP_0020 0 12750 /end CHARACTERISTIC
/begin CHARACTERISTIC mNEACL "ROM Const mNEACL" VALUE 0x0000883F REC_UBYTE_C 0 COMP_0020 0 12750 /end CHARACTERISTIC
/begin CHARACTERISTIC mNEACM "ROM Const mNEACM" VALUE 0x00008840 REC_UBYTE_C 0 COMP_0020 0 12750 /end CHARACTERISTIC
/begin CHARACTERISTIC mNEALTMX "ROM Const mNEALTMX" VALUE 0x00008841 REC_UBYTE_C 0 COMP_0006 0 3187.5 /end CHARACTERISTIC
/begin CHARACTERISTIC mNEARL "ROM Const mNEARL" VALUE 0x00008842 REC_UBYTE_C 0 COMP_0020 0 12750 /end CHARACTERISTIC
/begin CHARACTERISTIC mNEDANKI "ROM Const mNEDANKI" VALUE 0x00008843 REC_UBYTE_C 0 COMP_0006 0 3187.5 /end CHARACTERISTIC
/begin CHARACTERISTIC mNEHENSA "ROM Const mNEHENSA" VALUE 0x00008844 REC_UBYTE_C 0 COMP_0006 0 3187.5 /end CHARACTERISTIC
/begin CHARACTERISTIC mNEINJT "ROM Const mNEINJT" VALUE 0x00008845 REC_UBYTE_C 0 COMP_0006 0 3187.5 /end CHARACTERISTIC
/begin CHARACTERISTIC mNEJIRINE "ROM Const mNEJIRINE" VALUE 0x00008846 REC_UBYTE_C 0 COMP_0065 0 796.875 /end CHARACTERISTIC
/begin CHARACTERISTIC mNEJITMH "ROM Const mNEJITMH" VALUE 0x00008847 REC_UBYTE_C 0 COMP_0014 0 2550 /end CHARACTERISTIC
/begin CHARACTERISTIC mNEJITML "ROM Const mNEJITML" VALUE 0x00008848 REC_UBYTE_C 0 COMP_0014 0 2550 /end CHARACTERISTIC
/begin CHARACTERISTIC mNEJITMMH "ROM Const mNEJITMMH" VALUE 0x00008849 REC_UBYTE_C 0 COMP_0014 0 2550 /end CHARACTERISTIC
/begin CHARACTERISTIC mNEJITMML "ROM Const mNEJITMML" VALUE 0x0000884A REC_UBYTE_C 0 COMP_0014 0 2550 /end CHARACTERISTIC
/begin CHARACTERISTIC mNEKHOT "ROM Const mNEKHOT" VALUE 0x0000884B REC_UBYTE_C 0 COMP_0000 0 6375 /end CHARACTERISTIC
/begin CHARACTERISTIC mNELMODD "ROM Const mNELMODD" VALUE 0x0000884C REC_UBYTE_C 0 COMP_0189_S 0 84.999999915 /end CHARACTERISTIC
/begin CHARACTERISTIC mNEPS "ROM Const mNEPS" VALUE 0x00009314 REC_UWORD_C 0 COMP_0006 0 819187.5 /end CHARACTERISTIC
/begin CHARACTERISTIC mNESMHYS "ROM Const mNESMHYS" VALUE 0x00008850 REC_UBYTE_C 0 COMP_0020 0 12750 /end CHARACTERISTIC
/begin CHARACTERISTIC mNESMPF "ROM Const mNESMPF" VALUE 0x00008851 REC_UBYTE_C 0 COMP_0020 0 12750 /end CHARACTERISTIC
/begin CHARACTERISTIC mNEUTVB "ROM Const mNEUTVB" VALUE 0x00008852 REC_UBYTE_C 0 COMP_0033 0 20400 /end CHARACTERISTIC
/begin CHARACTERISTIC mNGDCAM "ROM Const mNGDCAM" VALUE 0x00008853 REC_UBYTE_C 0 COMP_0014 0 2550 /end CHARACTERISTIC
/begin CHARACTERISTIC mNGDCAM2 "ROM Const mNGDCAM2" VALUE 0x00008854 REC_UBYTE_C 0 COMP_0014 0 2550 /end CHARACTERISTIC
/begin CHARACTERISTIC mNGDPOS "ROM Const mNGDPOS" VALUE 0x00008855 REC_UBYTE_C 0 COMP_0014 0 2550 /end CHARACTERISTIC
/begin CHARACTERISTIC mNGFIXTF "ROM Const mNGFIXTF" VALUE 0x00008856 REC_UBYTE_C 0 COMP_0113_S 0 51 /end CHARACTERISTIC
/begin CHARACTERISTIC mNGFIXVAC "ROM Const mNGFIXVAC" VALUE 0x00008857 REC_UBYTE_C 0 COMP_0001_S 0 255 /end CHARACTERISTIC
/begin CHARACTERISTIC mNGTIME "ROM Const mNGTIME" VALUE 0x00008858 REC_UBYTE_C 0 COMP_0016 0 255 /end CHARACTERISTIC
/begin CHARACTERISTIC mNGVAC "ROM Const mNGVAC" VALUE 0x00009316 REC_UWORD_C 0 COMP_0001_S 0 65535 /end CHARACTERISTIC
/begin CHARACTERISTIC mNHDLTD "ROM Const mNHDLTD" VALUE 0x00008859 REC_UBYTE_C 0 COMP_0020 0 12750 /end CHARACTERISTIC
/begin CHARACTERISTIC mNHLMT "ROM Const mNHLMT" VALUE 0x0000885A REC_UBYTE_C 0 COMP_0020 0 12750 /end CHARACTERISTIC
/begin CHARACTERISTIC mNHQWAG "ROM Const mNHQWAG" VALUE 0x0000885B REC_UBYTE_C 0 COMP_0388 0 25.5 /end CHARACTERISTIC
/begin CHARACTERISTIC mNIACDY "ROM Const mNIACDY" VALUE 0x0000885C REC_UBYTE_C 0 COMP_0014 0 2550 /end CHARACTERISTIC
/begin CHARACTERISTIC mNIADVDWN "ROM Const mNIADVDWN" VALUE 0x0000885D REC_UBYTE_C 0 COMP_0014 0 2550 /end CHARACTERISTIC
/begin CHARACTERISTIC mNICLOFIR "ROM Const mNICLOFIR" VALUE 0x0000885E REC_UBYTE_C 0 COMP_0000 0 6375 /end CHARACTERISTIC
/begin CHARACTERISTIC mNIDLADV1 "ROM Const mNIDLADV1" VALUE 0x0000885F REC_UBYTE_C 0 COMP_0006 0 3187.5 /end CHARACTERISTIC
/begin CHARACTERISTIC mNIDLADV2 "ROM Const mNIDLADV2" VALUE 0x00008860 REC_UBYTE_C 0 COMP_0006 0 3187.5 /end CHARACTERISTIC
/begin CHARACTERISTIC mNIDLADV3 "ROM Const mNIDLADV3" VALUE 0x00008861 REC_UBYTE_C 0 COMP_0006 0 3187.5 /end CHARACTERISTIC
/begin CHARACTERISTIC mNIDLCFEQ "ROM Const mNIDLCFEQ" VALUE 0x00008862 REC_UBYTE_C 0 COMP_0373 0 2.55 /end CHARACTERISTIC
/begin CHARACTERISTIC mNIDLENE "ROM Const mNIDLENE" VALUE 0x00008863 REC_UBYTE_C 0 COMP_0006 0 3187.5 /end CHARACTERISTIC
/begin CHARACTERISTIC mNIDLETWH "ROM Const mNIDLETWH" VALUE 0x00008864 REC_UBYTE_C 0 COMP_0035 -50 205 /end CHARACTERISTIC
/begin CHARACTERISTIC mNIDLETWL "ROM Const mNIDLETWL" VALUE 0x00008865 REC_UBYTE_C 0 COMP_0035 -50 205 /end CHARACTERISTIC
/begin CHARACTERISTIC mNIDLIHAC "ROM Const mNIDLIHAC" VALUE 0x00008866 REC_UBYTE_C 0 COMP_0014 0 2550 /end CHARACTERISTIC
/begin CHARACTERISTIC mNIDLOFAC "ROM Const mNIDLOFAC" VALUE 0x00008867 REC_UBYTE_C 0 COMP_0013 0 255 /end CHARACTERISTIC
/begin CHARACTERISTIC mNIDLSTTM "ROM Const mNIDLSTTM" VALUE 0x00008868 REC_UBYTE_C 0 COMP_0008 0 25500 /end CHARACTERISTIC
/begin CHARACTERISTIC mNIEMNEMX "ROM Const mNIEMNEMX" VALUE 0x00008869 REC_UBYTE_C 0 COMP_0006 0 3187.5 /end CHARACTERISTIC
/begin CHARACTERISTIC mNILRH "ROM Const mNILRH" VALUE 0x0000886A REC_UBYTE_C 0 COMP_0006 0 3187.5 /end CHARACTERISTIC
/begin CHARACTERISTIC mNILRL "ROM Const mNILRL" VALUE 0x0000886B REC_UBYTE_C 0 COMP_0006 0 3187.5 /end CHARACTERISTIC
/begin CHARACTERISTIC mNINJD "ROM Const mNINJD" VALUE 0x0000886C REC_UBYTE_C 0 COMP_0008 0 25500 /end CHARACTERISTIC
/begin CHARACTERISTIC mNINJH1 "ROM Const mNINJH1" VALUE 0x0000886D REC_UBYTE_C 0 COMP_0006 0 3187.5 /end CHARACTERISTIC
/begin CHARACTERISTIC mNINJH2 "ROM Const mNINJH2" VALUE 0x0000886E REC_UBYTE_C 0 COMP_0006 0 3187.5 /end CHARACTERISTIC
/begin CHARACTERISTIC mNINJH3 "ROM Const mNINJH3" VALUE 0x0000886F REC_UBYTE_C 0 COMP_0006 0 3187.5 /end CHARACTERISTIC
/begin CHARACTERISTIC mNINJHMAX "ROM Const mNINJHMAX" VALUE 0x00008870 REC_UBYTE_C 0 COMP_0006 0 3187.5 /end CHARACTERISTIC
/begin CHARACTERISTIC mNINJTW "ROM Const mNINJTW" VALUE 0x00008871 REC_UBYTE_C 0 COMP_0035 -50 205 /end CHARACTERISTIC
/begin CHARACTERISTIC mNISCST "ROM Const mNISCST" VALUE 0x00008872 REC_UBYTE_C 0 COMP_0065 0 796.875 /end CHARACTERISTIC
/begin CHARACTERISTIC mNJISOH "ROM Const mNJISOH" VALUE 0x00008873 REC_UBYTE_C 0 COMP_0006 0 3187.5 /end CHARACTERISTIC
/begin CHARACTERISTIC mNJISOL "ROM Const mNJISOL" VALUE 0x00008874 REC_UBYTE_C 0 COMP_0006 0 3187.5 /end CHARACTERISTIC
/begin CHARACTERISTIC mNLFCDTWN "ROM Const mNLFCDTWN" VALUE 0x00008875 REC_UBYTE_C 0 COMP_0035 -50 205 /end CHARACTERISTIC
/begin CHARACTERISTIC mNLFCDVSP "ROM Const mNLFCDVSP" VALUE 0x00008876 REC_UBYTE_C 0 COMP_0007 0 510 /end CHARACTERISTIC
/begin CHARACTERISTIC mNLGAIN "ROM Const mNLGAIN" VALUE 0x00008877 REC_UBYTE_C 0 COMP_0373 0 2.55 /end CHARACTERISTIC
/begin CHARACTERISTIC mNLGAIN2 "ROM Const mNLGAIN2" VALUE 0x00008878 REC_UBYTE_C 0 COMP_0373 0 2.55 /end CHARACTERISTIC
/begin CHARACTERISTIC mNLKCTN "ROM Const mNLKCTN" VALUE 0x00008879 REC_UBYTE_C 0 COMP_0000 0 6375 /end CHARACTERISTIC
/begin CHARACTERISTIC mNLLMT "ROM Const mNLLMT" VALUE 0x0000887A REC_UBYTE_C 0 COMP_0020 0 12750 /end CHARACTERISTIC
/begin CHARACTERISTIC mNLOILFC "ROM Const mNLOILFC" VALUE 0x0000887B REC_UBYTE_C 0 COMP_0000 0 6375 /end CHARACTERISTIC
/begin CHARACTERISTIC mNLUBRK "ROM Const mNLUBRK" VALUE 0x0000887C REC_UBYTE_C 0 COMP_0000 0 6375 /end CHARACTERISTIC
/begin CHARACTERISTIC mNMAX0 "ROM Const mNMAX0" VALUE 0x0000887D REC_UBYTE_C 0 COMP_0020 0 12750 /end CHARACTERISTIC
/begin CHARACTERISTIC mNMAX2 "ROM Const mNMAX2" VALUE 0x00009318 REC_UWORD_C 0 COMP_0006 0 819187.5 /end CHARACTERISTIC
/begin CHARACTERISTIC mNMAX2R "ROM Const mNMAX2R" VALUE 0x0000931A REC_UWORD_C 0 COMP_0006 0 819187.5 /end CHARACTERISTIC
/begin CHARACTERISTIC mNMAXR2 "ROM Const mNMAXR2" VALUE 0x0000931C REC_UWORD_C 0 COMP_0006 0 819187.5 /end CHARACTERISTIC
/begin CHARACTERISTIC mNMAXRR "ROM Const mNMAXRR" VALUE 0x0000931E REC_UWORD_C 0 COMP_0006 0 819187.5 /end CHARACTERISTIC
/begin CHARACTERISTIC mNMFR1 "ROM Const mNMFR1" VALUE 0x0000887E REC_UBYTE_C 0 COMP_0020 0 12750 /end CHARACTERISTIC
/begin CHARACTERISTIC mNMFR2 "ROM Const mNMFR2" VALUE 0x0000887F REC_UBYTE_C 0 COMP_0020 0 12750 /end CHARACTERISTIC
/begin CHARACTERISTIC mNMHTNT "ROM Const mNMHTNT" VALUE 0x00008880 REC_UBYTE_C 0 COMP_0020 0 12750 /end CHARACTERISTIC
/begin CHARACTERISTIC mNNGCAM "ROM Const mNNGCAM" VALUE 0x00008881 REC_UBYTE_C 0 COMP_0006 0 3187.5 /end CHARACTERISTIC
/begin CHARACTERISTIC mNNIDLD "ROM Const mNNIDLD" VALUE 0x00008882 REC_UBYTE_C 0 COMP_0006 0 3187.5 /end CHARACTERISTIC
/begin CHARACTERISTIC mNNIDLLRN "ROM Const mNNIDLLRN" VALUE 0x00008883 REC_UBYTE_C 0 COMP_0006 0 3187.5 /end CHARACTERISTIC
/begin CHARACTERISTIC mNNSH "ROM Const mNNSH" VALUE 0x00008884 REC_UBYTE_C 0 COMP_0000 0 6375 /end CHARACTERISTIC
/begin CHARACTERISTIC mNNSL "ROM Const mNNSL" VALUE 0x00008885 REC_UBYTE_C 0 COMP_0000 0 6375 /end CHARACTERISTIC
/begin CHARACTERISTIC mNOILFC "ROM Const mNOILFC" VALUE 0x00008886 REC_UBYTE_C 0 COMP_0000 0 6375 /end CHARACTERISTIC
/begin CHARACTERISTIC mNOVHFC "ROM Const mNOVHFC" VALUE 0x00008887 REC_UBYTE_C 0 COMP_0000 0 6375 /end CHARACTERISTIC
/begin CHARACTERISTIC mNPD "ROM Const mNPD" VALUE 0x00008888 REC_UBYTE_C 0 COMP_0032 0 0.99609375 /end CHARACTERISTIC
/begin CHARACTERISTIC mNPFLNG "ROM Const mNPFLNG" VALUE 0x00008889 REC_UBYTE_C 0 COMP_0020 0 12750 /end CHARACTERISTIC
/begin CHARACTERISTIC mNPOFS "ROM Const mNPOFS" VALUE 0x0000888A REC_UBYTE_C 0 COMP_0003 0 255 /end CHARACTERISTIC
/begin CHARACTERISTIC mNPS "ROM Const mNPS" VALUE 0x0000888B REC_UBYTE_C 0 COMP_0063 0 0.99609375 /end CHARACTERISTIC
/begin CHARACTERISTIC mNPSFAIL "ROM Const mNPSFAIL" VALUE 0x0000888C REC_UBYTE_C 0 COMP_0006 0 3187.5 /end CHARACTERISTIC
/begin CHARACTERISTIC mNPSMP "ROM Const mNPSMP" VALUE 0x0000888D REC_UBYTE_C 0 COMP_0004 0 255 /end CHARACTERISTIC
/begin CHARACTERISTIC mNPSMP0 "ROM Const mNPSMP0" VALUE 0x0000888E REC_UBYTE_C 0 COMP_0004 0 255 /end CHARACTERISTIC
/begin CHARACTERISTIC mNPTSOREV "ROM Const mNPTSOREV" VALUE 0x00009320 REC_UWORD_C 0 COMP_0006 0 819187.5 /end CHARACTERISTIC
/begin CHARACTERISTIC mNQCKHOJ "ROM Const mNQCKHOJ" VALUE 0x0000888F REC_UBYTE_C 0 COMP_0000 0 6375 /end CHARACTERISTIC
/begin CHARACTERISTIC mNRCTH "ROM Const mNRCTH" VALUE 0x00008890 REC_UBYTE_C 0 COMP_0000 0 6375 /end CHARACTERISTIC
/begin CHARACTERISTIC mNRCTL "ROM Const mNRCTL" VALUE 0x00008891 REC_UBYTE_C 0 COMP_0000 0 6375 /end CHARACTERISTIC
/begin CHARACTERISTIC mNREF "ROM Const mNREF" VALUE 0x00008892 REC_UBYTE_C 0 COMP_0199_S 0 255 /end CHARACTERISTIC
/begin CHARACTERISTIC mNRVCUT "ROM Const mNRVCUT" VALUE 0x00008894 REC_UBYTE_C 0 COMP_0000 0 6375 /end CHARACTERISTIC
/begin CHARACTERISTIC mNRVHYS "ROM Const mNRVHYS" VALUE 0x00008895 REC_UBYTE_C 0 COMP_0000 0 6375 /end CHARACTERISTIC
/begin CHARACTERISTIC mNSENRPM "ROM Const mNSENRPM" VALUE 0x00009322 REC_UWORD_C 0 COMP_0064 0 102398.4375 /end CHARACTERISTIC
/begin CHARACTERISTIC mNSETBNI "ROM Const mNSETBNI" VALUE 0x00008896 REC_UBYTE_C 0 COMP_0006 0 3187.5 /end CHARACTERISTIC
/begin CHARACTERISTIC mNSETBR "ROM Const mNSETBR" VALUE 0x00008897 REC_UBYTE_C 0 COMP_0006 0 3187.5 /end CHARACTERISTIC
/begin CHARACTERISTIC mNSETD "ROM Const mNSETD" VALUE 0x00008898 REC_UBYTE_C 0 COMP_0006 0 3187.5 /end CHARACTERISTIC
/begin CHARACTERISTIC mNSETDU "ROM Const mNSETDU" VALUE 0x00008899 REC_UBYTE_C 0 COMP_0006 0 3187.5 /end CHARACTERISTIC
/begin CHARACTERISTIC mNSETFS "ROM Const mNSETFS" VALUE 0x0000889A REC_UBYTE_C 0 COMP_0006 0 3187.5 /end CHARACTERISTIC
/begin CHARACTERISTIC mNSETG "ROM Const mNSETG" VALUE 0x0000889B REC_UBYTE_C 0 COMP_0006 0 3187.5 /end CHARACTERISTIC
/begin CHARACTERISTIC mNSETH "ROM Const mNSETH" VALUE 0x0000889C REC_UBYTE_C 0 COMP_0006 0 3187.5 /end CHARACTERISTIC
/begin CHARACTERISTIC mNSETHEAT "ROM Const mNSETHEAT" VALUE 0x0000889D REC_UBYTE_C 0 COMP_0006 0 3187.5 /end CHARACTERISTIC
/begin CHARACTERISTIC mNSETLM "ROM Const mNSETLM" VALUE 0x0000889E REC_UBYTE_C 0 COMP_0006 0 3187.5 /end CHARACTERISTIC
/begin CHARACTERISTIC mNSETN "ROM Const mNSETN" VALUE 0x0000889F REC_UBYTE_C 0 COMP_0006 0 3187.5 /end CHARACTERISTIC
/begin CHARACTERISTIC mNSETR "ROM Const mNSETR" VALUE 0x000088A0 REC_UBYTE_C 0 COMP_0006 0 3187.5 /end CHARACTERISTIC
/begin CHARACTERISTIC mNSETREG "ROM Const mNSETREG" VALUE 0x000088A1 REC_UBYTE_C 0 COMP_0006 0 3187.5 /end CHARACTERISTIC
/* COMPU_METHOD --------------------------------------------------------- */
/begin COMPU_METHOD COMP_0017 "1deg" RAT_FUNC "%8.2" "deg" COEFFS 0 1 0 0 0 1 /end COMPU_METHOD
/begin COMPU_METHOD COMP_0004 "1－" RAT_FUNC "%8.2" "－" COEFFS 0 1 0 0 0 1 /end COMPU_METHOD
/begin COMPU_METHOD COMP_0068 "1-" RAT_FUNC "%8.2" "-" COEFFS 0 1 0 0 0 1 /end COMPU_METHOD
/begin COMPU_METHOD COMP_0001_S "1Pa" RAT_FUNC "%8.2" "Pa" COEFFS 0 1 0 0 0 1 /end COMPU_METHOD
/begin COMPU_METHOD COMP_0002_S "1Pa" RAT_FUNC "%8.2" "Pa" COEFFS 0 1 0 0 0 1 /end COMPU_METHOD
/begin COMPU_METHOD COMP_0003_S "0.2℃" RAT_FUNC "%8.2" "℃" COEFFS 0 1 0 0 0 0.2 /end COMPU_METHOD
/begin COMPU_METHOD COMP_0013 "1s" RAT_FUNC "%8.2" "s" COEFFS 0 1 0 0 0 1 /end COMPU_METHOD
/begin COMPU_METHOD COMP_0014 "10ms" RAT_FUNC "%8.2" "ms" COEFFS 0 1 0 0 0 10 /end COMPU_METHOD
/begin COMPU_METHOD COMP_0045 "1/128-" RAT_FUNC "%8.4" "-" COEFFS 0 1 0 0 0 0.0078125 /end COMPU_METHOD
/begin COMPU_METHOD COMP_0009 "100/128%" RAT_FUNC "%8.2" "%" COEFFS 0 1 0 0 0 0.78125 /end COMPU_METHOD
/begin COMPU_METHOD COMP_0000 "25rpm" RAT_FUNC "%8.2" "rpm" COEFFS 0 1 0 0 0 25 /end COMPU_METHOD
/begin COMPU_METHOD COMP_0186 "1/64-" RAT_FUNC "%8.3" "-" COEFFS 0 1 0 0 0 0.015625 /end COMPU_METHOD
/begin COMPU_METHOD COMP_0001 "1/8ms" RAT_FUNC "%8.2" "ms" COEFFS 0 1 0 0 0 0.125 /end COMPU_METHOD
/begin COMPU_METHOD COMP_0020 "50rpm" RAT_FUNC "%8.2" "rpm" COEFFS 0 1 0 0 0 50 /end COMPU_METHOD
/begin COMPU_METHOD COMP_0004_S "X-50degC" RAT_FUNC "%8.2" "degC" COEFFS 0 1 50 0 0 1 /end COMPU_METHOD
/begin COMPU_METHOD COMP_0005_S "0.0001-" RAT_FUNC "%8.5" "-" COEFFS 0 1 0 0 0 0.0001 /end COMPU_METHOD
/begin COMPU_METHOD COMP_0388 "0.1-" RAT_FUNC "%8.2" "-" COEFFS 0 1 0 0 0 0.1 /end COMPU_METHOD
/begin COMPU_METHOD COMP_0373 "1/100-" RAT_FUNC "%8.3" "-" COEFFS 0 1 0 0 0 0.01 /end COMPU_METHOD
/begin COMPU_METHOD COMP_0002 "0.35deg" RAT_FUNC "%8.2" "deg" COEFFS 0 1 0 0 0 0.35 /end COMPU_METHOD
/begin COMPU_METHOD COMP_0003 "1℃" RAT_FUNC "%8.2" "℃" COEFFS 0 1 0 0 0 1 /end COMPU_METHOD
/begin COMPU_METHOD COMP_0035 "X-50℃" RAT_FUNC "%8.2" "℃" COEFFS 0 1 50 0 0 1 /end COMPU_METHOD
/begin COMPU_METHOD COMP_0453 "0.002-" RAT_FUNC "%8.4" "-" COEFFS 0 1 0 0 0 0.002 /end COMPU_METHOD
/begin COMPU_METHOD COMP_0005 "0.11deg" RAT_FUNC "%8.2" "deg" COEFFS 0 1 0 0 0 0.11 /end COMPU_METHOD
/begin COMPU_METHOD COMP_0006 "12.5rpm" RAT_FUNC "%8.2" "rpm" COEFFS 0 1 0 0 0 12.5 /end COMPU_METHOD
/begin COMPU_METHOD COMP_0009_S "1/3℃" RAT_FUNC "%8.2" "℃" COEFFS 0 1 0 0 0 0.3333333 /end COMPU_METHOD
/begin COMPU_METHOD COMP_0008 "100ms" RAT_FUNC "%8.2" "ms" COEFFS 0 1 0 0 0 100 /end COMPU_METHOD
/begin COMPU_METHOD COMP_0011 "0.02MPa" RAT_FUNC "%8.3" "MPa" COEFFS 0 1 0 0 0 0.02 /end COMPU_METHOD
/begin COMPU_METHOD COMP_0010_S "0.0001ｋｊ/100" RAT_FUNC "%8.5" "ｋｊ/100" COEFFS 0 1 0 0 0 0.0001 /end COMPU_METHOD
/begin COMPU_METHOD COMP_0007 "2km/h" RAT_FUNC "%8.2" "km/h" COEFFS 0 1 0 0 0 2 /end COMPU_METHOD
/begin COMPU_METHOD COMP_0047 "0.5%" RAT_FUNC "%8.2" "%" COEFFS 0 1 0 0 0 0.5 /end COMPU_METHOD
/begin COMPU_METHOD COMP_0163 "1/16%" RAT_FUNC "%8.3" "%" COEFFS 0 1 0 0 0 0.0625 /end COMPU_METHOD
/begin COMPU_METHOD COMP_0486 "20/256mv" RAT_FUNC "%8.3" "mv" COEFFS 0 1 0 0 0 0.078125 /end COMPU_METHOD
/begin COMPU_METHOD COMP_0353 "5mV" RAT_FUNC "%8.2" "mV" COEFFS 0 1 0 0 0 5 /end COMPU_METHOD
/begin COMPU_METHOD COMP_0018 "1deg" RAT_FUNC "%8.2" "deg" COEFFS 0 1 0 0 0 1 /end COMPU_METHOD
/begin COMPU_METHOD COMP_0019 "1degCA" RAT_FUNC "%8.2" "degCA" COEFFS 0 1 0 0 0 1 /end COMPU_METHOD
/begin COMPU_METHOD COMP_0217 "1/16384-" RAT_FUNC "%8.6" "-" COEFFS 0 1 0 0 0 0.0000610352 /end COMPU_METHOD
/begin COMPU_METHOD COMP_0023 "5mV" RAT_FUNC "%8.2" "mV" COEFFS 0 1 0 0 0 5 /end COMPU_METHOD
/begin COMPU_METHOD COMP_0033 "80mV" RAT_FUNC "%8.2" "mV" COEFFS 0 1 0 0 0 80 /end COMPU_METHOD
/begin COMPU_METHOD COMP_0027 "1%" RAT_FUNC "%8.2" "%" COEFFS 0 1 0 0 0 1 /end COMPU_METHOD
/begin COMPU_METHOD COMP_0266 "64/128deg" RAT_FUNC "%8.2" "deg" COEFFS 0 1 0 0 0 0.5 /end COMPU_METHOD
/begin COMPU_METHOD COMP_0015_S "0.1sec" RAT_FUNC "%8.2" "sec" COEFFS 0 1 0 0 0 0.1 /end COMPU_METHOD
/begin COMPU_METHOD COMP_0061 "5mv" RAT_FUNC "%8.2" "mv" COEFFS 0 1 0 0 0 5 /end COMPU_METHOD
/begin COMPU_METHOD COMP_0049 "1sec" RAT_FUNC "%8.2" "sec" COEFFS 0 1 0 0 0 1 /end COMPU_METHOD
/begin COMPU_METHOD COMP_0032 "1/256－" RAT_FUNC "%8.4" "－" COEFFS 0 1 0 0 0 0.00390625 /end COMPU_METHOD
/begin COMPU_METHOD COMP_0066 "1/64－" RAT_FUNC "%8.3" "－" COEFFS 0 1 0 0 0 0.015625 /end COMPU_METHOD
/begin COMPU_METHOD COMP_0063 "1/256-" RAT_FUNC "%8.4" "-" COEFFS 0 1 0 0 0 0.00390625 /end COMPU_METHOD
/begin COMPU_METHOD COMP_0015 "0.125－" RAT_FUNC "%8.2" "－" COEFFS 0 1 0 0 0 0.125 /end COMPU_METHOD
/begin COMPU_METHOD COMP_0464 "1/8-" RAT_FUNC "%8.2" "-" COEFFS 0 1 0 0 0 0.125 /end COMPU_METHOD
/begin COMPU_METHOD COMP_0019_S "1/255-" RAT_FUNC "%8.4" "-" COEFFS 0 1 0 0 0 0.003921569 /end COMPU_METHOD
/begin COMPU_METHOD COMP_0030 "1回" RAT_FUNC "%8.2" "回" COEFFS 0 1 0 0 0 1 /end COMPU_METHOD
/begin COMPU_METHOD COMP_0020_S "0.002-" RAT_FUNC "%8.4" "-" COEFFS 0 1 0 0 0 0.002 /end COMPU_METHOD
/begin COMPU_METHOD COMP_0016 "1count" RAT_FUNC "%8.2" "count" COEFFS 0 1 0 0 0 1 /end COMPU_METHOD
/begin COMPU_METHOD COMP_0202 "10msec" RAT_FUNC "%8.2" "msec" COEFFS 0 1 0 0 0 10 /end COMPU_METHOD
/begin COMPU_METHOD COMP_0443 "1rpm" RAT_FUNC "%8.2" "rpm" COEFFS 0 1 0 0 0 1 /end COMPU_METHOD
/begin COMPU_METHOD COMP_0228 "0.1Nm" RAT_FUNC "%8.2" "Nm" COEFFS 0 1 0 0 0 0.1 /end COMPU_METHOD
/begin COMPU_METHOD COMP_0436 "0.1km/h" RAT_FUNC "%8.2" "km/h" COEFFS 0 1 0 0 0 0.1 /end COMPU_METHOD
/begin COMPU_METHOD COMP_0256 "64/128degCA" RAT_FUNC "%8.2" "degCA" COEFFS 0 1 64 0 0 0.5 /end COMPU_METHOD
/begin COMPU_METHOD COMP_0031 "1/256%" RAT_FUNC "%8.4" "%" COEFFS 0 1 0 0 0 0.00390625 /end COMPU_METHOD
/begin COMPU_METHOD COMP_0026_S "0.35deg/150m" RAT_FUNC "%8.2" "deg/150m" COEFFS 0 1 0 0 0 0.35 /end COMPU_METHOD
/begin COMPU_METHOD COMP_0065 "3.125rpm" RAT_FUNC "%8.2" "rpm" COEFFS 0 1 0 0 0 3.125 /end COMPU_METHOD
/begin COMPU_METHOD COMP_0048 "64/128degCA" RAT_FUNC "%8.2" "degCA" COEFFS 0 1 0 0 0 0.5 /end COMPU_METHOD
/begin COMPU_METHOD COMP_0029_S "4ms・rpm" RAT_FUNC "%8.2" "ms・rpm" COEFFS 0 1 0 0 0 4 /end COMPU_METHOD
/begin COMPU_METHOD COMP_0031_S "0.00061MPa" RAT_FUNC "%8.5" "MPa" COEFFS 0 1 0 0 0 0.00061 /end COMPU_METHOD
/begin COMPU_METHOD COMP_0032_S "0.125%" RAT_FUNC "%8.2" "%" COEFFS 0 1 0 0 0 0.125 /end COMPU_METHOD
/begin COMPU_METHOD COMP_0220 "1l/min" RAT_FUNC "%8.2" "l/min" COEFFS 0 1 0 0 0 1 /end COMPU_METHOD
/begin COMPU_METHOD COMP_0038_S "0.1Nm/100ms" RAT_FUNC "%8.2" "Nm/100ms" COEFFS 0 1 0 0 0 0.1 /end COMPU_METHOD
/begin COMPU_METHOD COMP_0041 "0.0008cm^2" RAT_FUNC "%8.5" "cm^2" COEFFS 0 1 0 0 0 0.0008 /end COMPU_METHOD
/begin COMPU_METHOD COMP_0044 "1/128－" RAT_FUNC "%8.4" "－" COEFFS 0 1 0 0 0 0.0078125 /end COMPU_METHOD
/begin COMPU_METHOD COMP_0045_S "1A" RAT_FUNC "%8.2" "A" COEFFS 0 1 0 0 0 1 /end COMPU_METHOD
/begin COMPU_METHOD COMP_0054 "20mV" RAT_FUNC "%8.2" "mV" COEFFS 0 1 0 0 0 20 /end COMPU_METHOD
/begin COMPU_METHOD COMP_0450 "1/1024-" RAT_FUNC "%8.5" "-" COEFFS 0 1 0 0 0 0.000976563 /end COMPU_METHOD
/begin COMPU_METHOD COMP_0419 "0.1%" RAT_FUNC "%8.2" "%" COEFFS 0 1 0 0 0 0.1 /end COMPU_METHOD
/begin COMPU_METHOD COMP_0057_S "0.1deg" RAT_FUNC "%8.2" "deg" COEFFS 0 1 0 0 0 0.1 /end COMPU_METHOD
/begin COMPU_METHOD COMP_0058_S "100A100ms" RAT_FUNC "%8.2" "A100ms" COEFFS 0 1 0 0 0 100 /end COMPU_METHOD
/begin COMPU_METHOD COMP_0105 "0.1s" RAT_FUNC "%8.2" "s" COEFFS 0 1 0 0 0 0.1 /end COMPU_METHOD
/begin COMPU_METHOD COMP_0290 "1/65536-" RAT_FUNC "%8.6" "-" COEFFS 0 1 0 0 0 0.0000152588 /end COMPU_METHOD
/begin COMPU_METHOD COMP_0071 "1rev" RAT_FUNC "%8.2" "rev" COEFFS 0 1 0 0 0 1 /end COMPU_METHOD
/begin COMPU_METHOD COMP_0144 "1/2048ms" RAT_FUNC "%8.5" "ms" COEFFS 0 1 0 0 0 0.000488281 /end COMPU_METHOD
/begin COMPU_METHOD COMP_0026 "80mv" RAT_FUNC "%8.2" "mv" COEFFS 0 1 0 0 0 80 /end COMPU_METHOD
/begin COMPU_METHOD COMP_0061_S "0.0001-" RAT_FUNC "%8.5" "-" COEFFS 0 1 0 0 0 0.0001 /end COMPU_METHOD
/begin COMPU_METHOD COMP_0063_S "1/255count" RAT_FUNC "%8.4" "count" COEFFS 0 1 0 0 0 0.00392157 /end COMPU_METHOD
/begin COMPU_METHOD COMP_0064_S "1N" RAT_FUNC "%8.2" "N" COEFFS 0 1 0 0 0 1 /end COMPU_METHOD
/begin COMPU_METHOD COMP_0066_S "0.1degC" RAT_FUNC "%8.2" "degC" COEFFS 0 1 0 0 0 0.1 /end COMPU_METHOD
/begin COMPU_METHOD COMP_0021 "100/256%" RAT_FUNC "%8.2" "%" COEFFS 0 1 0 0 0 0.390625 /end COMPU_METHOD
/begin COMPU_METHOD COMP_0038 "0.11deg/10ms" RAT_FUNC "%8.2" "deg/10ms" COEFFS 0 1 0 0 0 0.11 /end COMPU_METHOD
/begin COMPU_METHOD COMP_0078_S "1/256L" RAT_FUNC "%8.4" "L" COEFFS 0 1 0 0 0 0.00390625 /end COMPU_METHOD
/begin COMPU_METHOD COMP_0095 "400/256%" RAT_FUNC "%8.2" "%" COEFFS 0 1 0 0 0 1.5625 /end COMPU_METHOD
/begin COMPU_METHOD COMP_0082_S "1rpm/50ms" RAT_FUNC "%8.2" "rpm/50ms" COEFFS 0 1 0 0 0 1 /end COMPU_METHOD
/begin COMPU_METHOD COMP_0096 "10s" RAT_FUNC "%8.2" "s" COEFFS 0 1 0 0 0 10 /end COMPU_METHOD
/begin COMPU_METHOD COMP_0051 "1L/min" RAT_FUNC "%8.2" "L/min" COEFFS 0 1 0 0 0 1 /end COMPU_METHOD
/begin COMPU_METHOD COMP_0456 "1/(256×128)-" RAT_FUNC "%8.6" "-" COEFFS 0 1 0 0 0 0.0000305176 /end COMPU_METHOD
/begin COMPU_METHOD COMP_0087_S "0.07808MPa" RAT_FUNC "%8.3" "MPa" COEFFS 0 1 0 0 0 0.07808 /end COMPU_METHOD
/begin COMPU_METHOD COMP_0088_S "0.01%/sec" RAT_FUNC "%8.3" "%/sec" COEFFS 0 1 0 0 0 0.01 /end COMPU_METHOD
/begin COMPU_METHOD COMP_0096_S "1/255-" RAT_FUNC "%8.4" "-" COEFFS 0 1 0 0 0 0.00392157 /end COMPU_METHOD
/begin COMPU_METHOD COMP_0234 "10sec" RAT_FUNC "%8.2" "sec" COEFFS 0 1 0 0 0 10 /end COMPU_METHOD
/begin COMPU_METHOD COMP_0115 "100/65536%" RAT_FUNC "%8.4" "%" COEFFS 0 1 0 0 0 0.0015259 /end COMPU_METHOD
/begin COMPU_METHOD COMP_0050 "5/64mV" RAT_FUNC "%8.3" "mV" COEFFS 0 1 0 0 0 0.078125 /end COMPU_METHOD
/begin COMPU_METHOD COMP_0069 "1/(128*256)－" RAT_FUNC "%8.6" "－" COEFFS 0 1 0 0 0 0.0000305176 /end COMPU_METHOD
/begin COMPU_METHOD COMP_0196 "0.1Nm" RAT_FUNC "%8.2" "Nm" COEFFS 0 1 0 0 0 0.1 /end COMPU_METHOD
/begin COMPU_METHOD COMP_0101_S "2/256l/min/10" RAT_FUNC "%8.4" "l/min/10" COEFFS 0 1 0 0 0 0.0078125 /end COMPU_METHOD
/begin COMPU_METHOD COMP_0120 "1倍" RAT_FUNC "%8.2" "倍" COEFFS 0 1 0 0 0 1 /end COMPU_METHOD
/begin COMPU_METHOD COMP_0124 "0.125ms/100ms" RAT_FUNC "%8.2" "ms/100ms" COEFFS 0 1 0 0 0 0.125 /end COMPU_METHOD
/begin COMPU_METHOD COMP_0083 "1/256deg/10ms" RAT_FUNC "%8.4" "deg/10ms" COEFFS 0 1 0 0 0 0.00390625 /end COMPU_METHOD
/begin COMPU_METHOD COMP_0057 "1/16384－" RAT_FUNC "%8.6" "－" COEFFS 0 1 0 0 0 0.0000610352 /end COMPU_METHOD
/begin COMPU_METHOD COMP_0077 "0.11deg/40ms" RAT_FUNC "%8.2" "deg/40ms" COEFFS 0 1 0 0 0 0.11 /end COMPU_METHOD
/begin COMPU_METHOD COMP_0129 "0.35deg" RAT_FUNC "%8.2" "deg" COEFFS 0 1 44.8 0 0 0.35 /end COMPU_METHOD
/begin COMPU_METHOD COMP_0102_S "0.01%/mV" RAT_FUNC "%8.3" "%/mV" COEFFS 0 1 0 0 0 0.01 /end COMPU_METHOD
/begin COMPU_METHOD COMP_0103_S "0.001%/mV" RAT_FUNC "%8.4" "%/mV" COEFFS 0 1 0 0 0 0.001 /end COMPU_METHOD
/begin COMPU_METHOD COMP_0104_S "0.2mV/10ms" RAT_FUNC "%8.2" "mV/10ms" COEFFS 0 1 0 0 0 0.2 /end COMPU_METHOD
/begin COMPU_METHOD COMP_0105_S "80mV/s" RAT_FUNC "%8.2" "mV/s" COEFFS 0 1 0 0 0 80 /end COMPU_METHOD
/begin COMPU_METHOD COMP_0106_S "1/16384－" RAT_FUNC "%8.6" "－" COEFFS 0 1 0 0 0 0.000061 /end COMPU_METHOD
/begin COMPU_METHOD COMP_0104 "10mV" RAT_FUNC "%8.2" "mV" COEFFS 0 1 0 0 0 10 /end COMPU_METHOD
/begin COMPU_METHOD COMP_0107_S "3.6*2^-22km/h/10m" RAT_FUNC "%8.6" "km/h/10m" COEFFS 0 1 0 0 0 0.000000858307 /end COMPU_METHOD
/begin COMPU_METHOD COMP_0190 "2deg" RAT_FUNC "%8.2" "deg" COEFFS 0 1 0 0 0 2 /end COMPU_METHOD
/begin COMPU_METHOD COMP_0108_S "64/128degCA" RAT_FUNC "%8.2" "degCA" COEFFS 0 1 16384 0 0 0.5 /end COMPU_METHOD
/begin COMPU_METHOD COMP_0109_S "3/256deg(V/rp" RAT_FUNC "%8.3" "deg(V/rp" COEFFS 0 1 0 0 0 0.0117188 /end COMPU_METHOD
/begin COMPU_METHOD COMP_0110_S "8/256deg(V/rp" RAT_FUNC "%8.3" "deg(V/rp" COEFFS 0 1 0 0 0 0.03125 /end COMPU_METHOD
/begin COMPU_METHOD COMP_0111_S "10/256-" RAT_FUNC "%8.3" "-" COEFFS 0 1 0 0 0 0.0390625 /end COMPU_METHOD
/begin COMPU_METHOD COMP_0136 "0.02sec" RAT_FUNC "%8.3" "sec" COEFFS 0 1 0 0 0 0.02 /end COMPU_METHOD
/begin COMPU_METHOD COMP_0137 "1sec/℃" RAT_FUNC "%8.2" "sec/℃" COEFFS 0 1 0 0 0 1 /end COMPU_METHOD
/begin COMPU_METHOD COMP_0112_S "0.11/10ms" RAT_FUNC "%8.2" "1/10ms" COEFFS 0 1 0 0 0 0.1 /end COMPU_METHOD
/begin COMPU_METHOD COMP_0140 "0.5STEP" RAT_FUNC "%8.2" "STEP" COEFFS 0 1 0 0 0 0.5 /end COMPU_METHOD
/begin COMPU_METHOD COMP_0141 "50/256%" RAT_FUNC "%8.2" "%" COEFFS 0 1 0 0 0 0.1953125 /end COMPU_METHOD
/begin COMPU_METHOD COMP_0149 "1/2048－" RAT_FUNC "%8.5" "－" COEFFS 0 1 0 0 0 0.000488282 /end COMPU_METHOD
/begin COMPU_METHOD COMP_0113_S "0.2℃" RAT_FUNC "%8.2" "℃" COEFFS 0 1 0 0 0 0.2 /end COMPU_METHOD
/begin COMPU_METHOD COMP_0114_S "2^-9kPa" RAT_FUNC "%8.4" "kPa" COEFFS 0 1 0 0 0 0.001953125 /end COMPU_METHOD
/begin COMPU_METHOD COMP_0115_S "0.0001degC" RAT_FUNC "%8.5" "degC" COEFFS 0 1 0 0 0 0.0001 /end COMPU_METHOD
/begin COMPU_METHOD COMP_0295 "100msec" RAT_FUNC "%8.2" "msec" COEFFS 0 1 0 0 0 100 /end COMPU_METHOD
/begin COMPU_METHOD COMP_0116_S "1/128*256-" RAT_FUNC "%8.6" "-" COEFFS 0 1 0 0 0 0.000030517 /end COMPU_METHOD
/begin COMPU_METHOD COMP_0117_S "2^-9degCA" RAT_FUNC "%8.4" "degCA" COEFFS 0 1 0 0 0 0.00195313 /end COMPU_METHOD
/begin COMPU_METHOD COMP_0118_S "2^-11degCA" RAT_FUNC "%8.5" "degCA" COEFFS 0 1 0 0 0 0.000488281 /end COMPU_METHOD
/begin COMPU_METHOD COMP_0108 "1/256/10ms" RAT_FUNC "%8.4" "/10ms" COEFFS 0 1 0 0 0 0.00390625 /end COMPU_METHOD
/begin COMPU_METHOD COMP_0119_S "1/256/100ms" RAT_FUNC "%8.4" "/100ms" COEFFS 0 1 0 0 0 0.00390625 /end COMPU_METHOD
/begin COMPU_METHOD COMP_0120_S "0.25kPa" RAT_FUNC "%8.2" "kPa" COEFFS 0 1 0 0 0 0.25 /end COMPU_METHOD
/begin COMPU_METHOD COMP_0277 "1L/min" RAT_FUNC "%8.2" "L/min" COEFFS 0 1 0 0 0 1 /end COMPU_METHOD
/begin COMPU_METHOD COMP_0121_S "0.1S" RAT_FUNC "%8.2" "S" COEFFS 0 1 0 0 0 0.1 /end COMPU_METHOD
/begin COMPU_METHOD COMP_0122_S "5μs" RAT_FUNC "%8.2" "μs" COEFFS 0 1 -35 0 0 5 /end COMPU_METHOD
/begin COMPU_METHOD COMP_0166 "2degCA" RAT_FUNC "%8.2" "degCA" COEFFS 0 1 0 0 0 2 /end COMPU_METHOD
/begin COMPU_METHOD COMP_0064 "1.5625rpm" RAT_FUNC "%8.2" "rpm" COEFFS 0 1 0 0 0 1.5625 /end COMPU_METHOD
/begin COMPU_METHOD COMP_0168 "1.28ms･rpm" RAT_FUNC "%8.2" "ms･rpm" COEFFS 0 1 0 0 0 1.28 /end COMPU_METHOD
/begin COMPU_METHOD COMP_0164 "0.000305MPa" RAT_FUNC "%8.5" "MPa" COEFFS 0 1 0 0 0 0.000305 /end COMPU_METHOD
/begin COMPU_METHOD COMP_0123_S "1/512kPa" RAT_FUNC "%8.4" "kPa" COEFFS 0 1 0 0 0 0.001953125 /end COMPU_METHOD
/begin COMPU_METHOD COMP_0124_S "0.25X-48deg" RAT_FUNC "%8.2" "deg" COEFFS 0 1 48 0 0 0.25 /end COMPU_METHOD
/begin COMPU_METHOD COMP_0312 "0.5/256L" RAT_FUNC "%8.4" "L" COEFFS 0 1 0 0 0 0.001953125 /end COMPU_METHOD
/begin COMPU_METHOD COMP_0125_S "0.01deg" RAT_FUNC "%8.3" "deg" COEFFS 0 1 0 0 0 0.01 /end COMPU_METHOD
/begin COMPU_METHOD COMP_0126_S "1/200L/min/rp" RAT_FUNC "%8.4" "L/min/rp" COEFFS 0 1 0 0 0 0.005 /end COMPU_METHOD
/begin COMPU_METHOD COMP_0127_S "0.0001245G" RAT_FUNC "%8.5" "G" COEFFS 0 1 4.079616 0 0 0.0001245 /end COMPU_METHOD
/begin COMPU_METHOD COMP_0128_S "1/128L/min/rp" RAT_FUNC "%8.4" "L/min/rp" COEFFS 0 1 0 0 0 0.0078125 /end COMPU_METHOD
/begin COMPU_METHOD COMP_0146 "100/256/256%" RAT_FUNC "%8.4" "%" COEFFS 0 1 0 0 0 0.001525879 /end COMPU_METHOD
/begin COMPU_METHOD COMP_0129_S "1/32L/min" RAT_FUNC "%8.3" "L/min" COEFFS 0 1 0 0 0 0.03125 /end COMPU_METHOD
/begin COMPU_METHOD COMP_0130_S "0.001G" RAT_FUNC "%8.4" "G" COEFFS 0 1 0 0 0 0.001 /end COMPU_METHOD
/begin COMPU_METHOD COMP_0131_S "0.5Nm" RAT_FUNC "%8.2" "Nm" COEFFS 0 1 0 0 0 0.5 /end COMPU_METHOD
/begin COMPU_METHOD COMP_0132_S "1/327680m" RAT_FUNC "%8.6" "m" COEFFS 0 1 0 0 0 0.00000305176 /end COMPU_METHOD
/begin COMPU_METHOD COMP_0133_S "1/327680m/10ms" RAT_FUNC "%8.6" "m/10ms" COEFFS 0 1 0 0 0 0.00000305176 /end COMPU_METHOD
/begin COMPU_METHOD COMP_0134_S "11/(L/min" RAT_FUNC "%8.2" "1/(L/min" COEFFS 0 1 0 0 0 1 /end COMPU_METHOD
/begin COMPU_METHOD COMP_0135_S "1/255-" RAT_FUNC "%8.4" "-" COEFFS 0 1 0 0 0 0.003921568 /end COMPU_METHOD
/begin COMPU_METHOD COMP_0136_S "0.0037(X-511)G" RAT_FUNC "%8.4" "G" COEFFS 0 1 1.8907 0 0 0.0037 /end COMPU_METHOD
/begin COMPU_METHOD COMP_0137_S "0.0037G" RAT_FUNC "%8.4" "G" COEFFS 0 1 0 0 0 0.0037 /end COMPU_METHOD
/begin COMPU_METHOD COMP_0138_S "0.00001G/mV" RAT_FUNC "%8.6" "G/mV" COEFFS 0 1 0 0 0 0.00001 /end COMPU_METHOD
/begin COMPU_METHOD COMP_0139_S "1/16Ω" RAT_FUNC "%8.3" "Ω" COEFFS 0 1 0 0 0 0.0625 /end COMPU_METHOD
/begin COMPU_METHOD COMP_0140_S "0.5W" RAT_FUNC "%8.2" "W" COEFFS 0 1 0 0 0 0.5 /end COMPU_METHOD
/begin COMPU_METHOD COMP_0141_S "20kg" RAT_FUNC "%8.2" "kg" COEFFS 0 1 0 0 0 20 /end COMPU_METHOD
/begin COMPU_METHOD COMP_0142_S "0.000001V・s/deg" RAT_FUNC "%8.6" "V・s/deg" COEFFS 0 1 0 0 0 0.000001 /end COMPU_METHOD
/begin COMPU_METHOD COMP_0143_S "2^0degC" RAT_FUNC "%8.2" "degC" COEFFS 0 1 0 0 0 1 /end COMPU_METHOD
/begin COMPU_METHOD COMP_0144_S "3.6_*_2^-22km/h" RAT_FUNC "%8.6" "km/h" COEFFS 0 1 0 0 0 0.000000858307 /end COMPU_METHOD
/begin COMPU_METHOD COMP_0328 "100/(64*256)%" RAT_FUNC "%8.4" "%" COEFFS 0 1 0 0 0 0.006103516 /end COMPU_METHOD
/begin COMPU_METHOD COMP_0145_S "0.000078125V" RAT_FUNC "%8.6" "V" COEFFS 0 1 0 0 0 0.000078125 /end COMPU_METHOD
/begin COMPU_METHOD COMP_0146_S "1/16384-" RAT_FUNC "%8.6" "-" COEFFS 0 1 0 0 0 0.000061035 /end COMPU_METHOD
/begin COMPU_METHOD COMP_0147_S "1000/16384μs" RAT_FUNC "%8.3" "μs" COEFFS 0 1 0 0 0 0.061035156 /end COMPU_METHOD
/begin COMPU_METHOD COMP_0148_S "0.01mg" RAT_FUNC "%8.3" "mg" COEFFS 0 1 0 0 0 0.01 /end COMPU_METHOD
/begin COMPU_METHOD COMP_0149_S "0.2A" RAT_FUNC "%8.2" "A" COEFFS 0 1 0 0 0 0.2 /end COMPU_METHOD
/begin COMPU_METHOD COMP_0150_S "0.2A" RAT_FUNC "%8.2" "A" COEFFS 0 1 -0.4 0 0 0.2 /end COMPU_METHOD
/begin COMPU_METHOD COMP_0151_S "400μs" RAT_FUNC "%8.2" "μs" COEFFS 0 1 0 0 0 400 /end COMPU_METHOD
/begin COMPU_METHOD COMP_0152_S "6.4μs" RAT_FUNC "%8.2" "μs" COEFFS 0 1 0 0 0 6.4 /end COMPU_METHOD
/begin COMPU_METHOD COMP_0153_S "1/256℃/100ms" RAT_FUNC "%8.4" "℃/100ms" COEFFS 0 1 0 0 0 0.00390625 /end COMPU_METHOD
/begin COMPU_METHOD COMP_0154_S "0.125℃" RAT_FUNC "%8.2" "℃" COEFFS 0 1 0 0 0 0.125 /end COMPU_METHOD
/begin COMPU_METHOD COMP_0155_S "1/32mm" RAT_FUNC "%8.3" "mm" COEFFS 0 1 0 0 0 0.03125 /end COMPU_METHOD
/begin COMPU_METHOD COMP_0125 "1/256ms" RAT_FUNC "%8.4" "ms" COEFFS 0 1 0 0 0 0.00390625 /end COMPU_METHOD
/begin COMPU_METHOD COMP_0156_S "1/3℃" RAT_FUNC "%8.2" "℃" COEFFS 0 1 0 0 0 0.333333333 /end COMPU_METHOD
/begin COMPU_METHOD COMP_0157_S "1.6μs" RAT_FUNC "%8.2" "μs" COEFFS 0 1 0 0 0 1.6 /end COMPU_METHOD
/begin COMPU_METHOD COMP_0158_S "0.125X-50℃" RAT_FUNC "%8.2" "℃" COEFFS 0 1 50 0 0 0.125 /end COMPU_METHOD
/begin COMPU_METHOD COMP_0159_S "0.5Nm" RAT_FUNC "%8.2" "Nm" COEFFS 0 1 64 0 0 0.5 /end COMPU_METHOD
/begin COMPU_METHOD COMP_0160_S "0.1/32%" RAT_FUNC "%8.4" "%" COEFFS 0 1 0 0 0 0.003125 /end COMPU_METHOD
/begin COMPU_METHOD COMP_0161_S "32μs" RAT_FUNC "%8.2" "μs" COEFFS 0 1 0 0 0 32 /end COMPU_METHOD
/begin COMPU_METHOD COMP_0162_S "0.78125rpm" RAT_FUNC "%8.2" "rpm" COEFFS 0 1 0 0 0 0.78125 /end COMPU_METHOD
/begin COMPU_METHOD COMP_0163_S "2^-17A" RAT_FUNC "%8.6" "A" COEFFS 0 1 0 0 0 0.00000762939 /end COMPU_METHOD
/begin COMPU_METHOD COMP_0164_S "1/255count" RAT_FUNC "%8.4" "count" COEFFS 0 1 0 0 0 0.003921569 /end COMPU_METHOD
/begin COMPU_METHOD COMP_0165_S "4μs" RAT_FUNC "%8.2" "μs" COEFFS 0 1 -4 0 0 4 /end COMPU_METHOD
/begin COMPU_METHOD COMP_0166_S "0.25μs" RAT_FUNC "%8.2" "μs" COEFFS 0 1 -0.5 0 0 0.25 /end COMPU_METHOD
/begin COMPU_METHOD COMP_0189 "3.2μS" RAT_FUNC "%8.2" "μS" COEFFS 0 1 0 0 0 3.2 /end COMPU_METHOD
/begin COMPU_METHOD COMP_0167_S "40μs" RAT_FUNC "%8.2" "μs" COEFFS 0 1 0 0 0 40 /end COMPU_METHOD
/begin COMPU_METHOD COMP_0168_S "0.2A" RAT_FUNC "%8.2" "A" COEFFS 0 1 -4.4 0 0 0.2 /end COMPU_METHOD
/begin COMPU_METHOD COMP_0169_S "4μs" RAT_FUNC "%8.2" "μs" COEFFS 0 1 0 0 0 4 /end COMPU_METHOD
/begin COMPU_METHOD COMP_0170_S "20μs" RAT_FUNC "%8.2" "μs" COEFFS 0 1 0 0 0 20 /end COMPU_METHOD
/begin COMPU_METHOD COMP_0191 "1REV" RAT_FUNC "%8.2" "REV" COEFFS 0 1 0 0 0 1 /end COMPU_METHOD
/begin COMPU_METHOD COMP_0025 "0.5step" RAT_FUNC "%8.2" "step" COEFFS 0 1 0 0 0 0.5 /end COMPU_METHOD
/begin COMPU_METHOD COMP_0171_S "X-50℃_" RAT_FUNC "%8.2" "℃_" COEFFS 0 1 50 0 0 1 /end COMPU_METHOD
/begin COMPU_METHOD COMP_0172_S "2^-1degCA" RAT_FUNC "%8.2" "degCA" COEFFS 0 1 0 0 0 0.5 /end COMPU_METHOD
/begin COMPU_METHOD COMP_0203 "1/256-" RAT_FUNC "%8.4" "-" COEFFS 0 1 0 0 0 0.00390625 /end COMPU_METHOD
/begin COMPU_METHOD COMP_0173_S "0.5sec" RAT_FUNC "%8.2" "sec" COEFFS 0 1 0 0 0 0.5 /end COMPU_METHOD
/begin COMPU_METHOD COMP_0193 "0.1Nm/10ms" RAT_FUNC "%8.2" "Nm/10ms" COEFFS 0 1 0 0 0 0.1 /end COMPU_METHOD
/begin COMPU_METHOD COMP_0028 "1/(100*256)-" RAT_FUNC "%8.6" "-" COEFFS 0 1 0 0 0 0.0000390625 /end COMPU_METHOD
/begin COMPU_METHOD COMP_0447 "100/1024%" RAT_FUNC "%8.3" "%" COEFFS 0 1 0 0 0 0.09765625 /end COMPU_METHOD
/begin COMPU_METHOD COMP_0174_S "1deg/50rp" RAT_FUNC "%8.2" "deg/50rp" COEFFS 0 1 0 0 0 1 /end COMPU_METHOD
/begin COMPU_METHOD COMP_0205 "100/32%" RAT_FUNC "%8.2" "%" COEFFS 0 1 0 0 0 3.125 /end COMPU_METHOD
/begin COMPU_METHOD COMP_0210 "1msec/kg" RAT_FUNC "%8.2" "msec/kg" COEFFS 0 1 0 0 0 1 /end COMPU_METHOD
/begin COMPU_METHOD COMP_0062 "4℃" RAT_FUNC "%8.2" "℃" COEFFS 0 1 0 0 0 4 /end COMPU_METHOD
/begin COMPU_METHOD COMP_0175_S "1/2561/10ms" RAT_FUNC "%8.4" "1/10ms" COEFFS 0 1 0 0 0 0.00390625 /end COMPU_METHOD
/begin COMPU_METHOD COMP_0130 "0.0275deg" RAT_FUNC "%8.3" "deg" COEFFS 0 1 0 0 0 0.0275 /end COMPU_METHOD
/begin COMPU_METHOD COMP_0176_S "1N/G" RAT_FUNC "%8.2" "N/G" COEFFS 0 1 0 0 0 1 /end COMPU_METHOD
/begin COMPU_METHOD COMP_0213 "100/128rpm/km/h" RAT_FUNC "%8.2" "rpm/km/h" COEFFS 0 1 0 0 0 0.78125 /end COMPU_METHOD
/begin COMPU_METHOD COMP_0177_S "1/128NULL" RAT_FUNC "%8.4" "NULL" COEFFS 0 1 0 0 0 0.0078125 /end COMPU_METHOD
/begin COMPU_METHOD COMP_0178_S "2*10^-5sec" RAT_FUNC "%8.6" "sec" COEFFS 0 1 0 0 0 0.00002 /end COMPU_METHOD
/begin COMPU_METHOD COMP_0179_S "0.01%" RAT_FUNC "%8.3" "%" COEFFS 0 1 0 0 0 0.01 /end COMPU_METHOD
/begin COMPU_METHOD COMP_0180_S "1/256-" RAT_FUNC "%8.4" "-" COEFFS 0 1 0 0 0 0.003906 /end COMPU_METHOD
/begin COMPU_METHOD COMP_0181_S "1×10^-5mm^3/us" RAT_FUNC "%8.6" "mm^3/us" COEFFS 0 1 0 0 0 0.00001 /end COMPU_METHOD
/begin COMPU_METHOD COMP_0182_S "0.001-" RAT_FUNC "%8.4" "-" COEFFS 0 1 0 0 0 0.001 /end COMPU_METHOD
/begin COMPU_METHOD COMP_0435 "1/32-" RAT_FUNC "%8.3" "-" COEFFS 0 1 0 0 0 0.03125 /end COMPU_METHOD
/begin COMPU_METHOD COMP_0183_S "1/64deg/10℃" RAT_FUNC "%8.3" "deg/10℃" COEFFS 0 1 0 0 0 0.015625 /end COMPU_METHOD
/begin COMPU_METHOD COMP_0184_S "0.1%/100ms" RAT_FUNC "%8.2" "%/100ms" COEFFS 0 1 0 0 0 0.1 /end COMPU_METHOD
/begin COMPU_METHOD COMP_0224 "1/65536km/h/rpm" RAT_FUNC "%8.6" "km/h/rpm" COEFFS 0 1 0 0 0 0.0000152588 /end COMPU_METHOD
/begin COMPU_METHOD COMP_0225 "1/(128*256)－" RAT_FUNC "%8.6" "－" COEFFS 0 1 0 0 0 0.0000305 /end COMPU_METHOD
/begin COMPU_METHOD COMP_0185_S "60N/m" RAT_FUNC "%8.2" "N/m" COEFFS 0 1 0 0 0 60 /end COMPU_METHOD
/begin COMPU_METHOD COMP_0186_S "0.025μs" RAT_FUNC "%8.3" "μs" COEFFS 0 1 0 0 0 0.025 /end COMPU_METHOD
/begin COMPU_METHOD COMP_0187_S "10/256%" RAT_FUNC "%8.3" "%" COEFFS 0 1 0 0 0 0.0390625 /end COMPU_METHOD
/begin COMPU_METHOD COMP_0472 "1/64-" RAT_FUNC "%8.3" "-" COEFFS 0 1 0 0 0 0.015625 /end COMPU_METHOD
/begin COMPU_METHOD COMP_0232 "1/128mm^2" RAT_FUNC "%8.4" "mm^2" COEFFS 0 1 0 0 0 0.0078125 /end COMPU_METHOD
/begin COMPU_METHOD COMP_0183 "20ms" RAT_FUNC "%8.2" "ms" COEFFS 0 1 0 0 0 20 /end COMPU_METHOD
/begin COMPU_METHOD COMP_0188_S "9.76563E-08cm**2/L/" RAT_FUNC "%8.6" "cm**2/L/" COEFFS 0 1 0 0 0 0.0000000976563 /end COMPU_METHOD
/begin COMPU_METHOD COMP_0189_S "1/3cyl" RAT_FUNC "%8.2" "cyl" COEFFS 0 1 0 0 0 0.333333333 /end COMPU_METHOD
/begin COMPU_METHOD COMP_0248 "1/256g" RAT_FUNC "%8.4" "g" COEFFS 0 1 0 0 0 0.00390625 /end COMPU_METHOD
/begin COMPU_METHOD COMP_0190_S "32/256X10^-6m^3/sec/" RAT_FUNC "%8.6" "m^3/sec/" COEFFS 0 1 0 0 0 0.000000125 /end COMPU_METHOD
/begin COMPU_METHOD COMP_0191_S "0.01L/min/%" RAT_FUNC "%8.3" "L/min/%" COEFFS 0 1 0 0 0 0.01 /end COMPU_METHOD
/begin COMPU_METHOD COMP_0192_S "0.25-" RAT_FUNC "%8.2" "-" COEFFS 0 1 0 0 0 0.25 /end COMPU_METHOD
/begin COMPU_METHOD COMP_0193_S "2^-14kPa" RAT_FUNC "%8.6" "kPa" COEFFS 0 1 0 0 0 0.0000610352 /end COMPU_METHOD
/begin COMPU_METHOD COMP_0389 "1/2548km" RAT_FUNC "%8.5" "km" COEFFS 0 1 0 0 0 0.000392465 /end COMPU_METHOD
/begin COMPU_METHOD COMP_0194_S "1TRIP" RAT_FUNC "%8.2" "TRIP" COEFFS 0 1 0 0 0 1 /end COMPU_METHOD
/begin COMPU_METHOD COMP_0395 "1/4096-" RAT_FUNC "%8.5" "-" COEFFS 0 1 0 0 0 0.000244141 /end COMPU_METHOD
/begin COMPU_METHOD COMP_0254 "1/16deg/%" RAT_FUNC "%8.3" "deg/%" COEFFS 0 1 0 0 0 0.0625 /end COMPU_METHOD
/begin COMPU_METHOD COMP_0255 "1/8deg/10ms" RAT_FUNC "%8.2" "deg/10ms" COEFFS 0 1 0 0 0 0.125 /end COMPU_METHOD
/begin COMPU_METHOD COMP_0259 "1個" RAT_FUNC "%8.2" "個" COEFFS 0 1 0 0 0 1 /end COMPU_METHOD
/begin COMPU_METHOD COMP_0195_S "0.1deg" RAT_FUNC "%8.2" "deg" COEFFS 0 1 0 0 0 0.1 /end COMPU_METHOD
/begin COMPU_METHOD COMP_0153 "X-128%" RAT_FUNC "%8.2" "%" COEFFS 0 1 128 0 0 1 /end COMPU_METHOD
/begin COMPU_METHOD COMP_0196_S "0.01ｵｰﾑ" RAT_FUNC "%8.3" "ｵｰﾑ" COEFFS 0 1 0 0 0 0.01 /end COMPU_METHOD
/begin COMPU_METHOD COMP_0197_S "0.000011/mΩ" RAT_FUNC "%8.6" "1/mΩ" COEFFS 0 1 0 0 0 0.00001 /end COMPU_METHOD
/begin COMPU_METHOD COMP_0198_S "2^-10%" RAT_FUNC "%8.5" "%" COEFFS 0 1 0 0 0 0.000976563 /end COMPU_METHOD
/begin COMPU_METHOD COMP_0199_S "1サイクル" RAT_FUNC "%8.2" "サイクル" COEFFS 0 1 0 0 0 1 /end COMPU_METHOD
/* RECORD_LAYOUT ------------------------------------------------------ */
/begin RECORD_LAYOUT REC_UBYTE_C FNC_VALUES 1 UBYTE COLUMN_DIR DIRECT /end RECORD_LAYOUT
/begin RECORD_LAYOUT REC_SWORD_C FNC_VALUES 1 SWORD COLUMN_DIR DIRECT /end RECORD_LAYOUT
/begin RECORD_LAYOUT REC_UWORD_C FNC_VALUES 1 UWORD COLUMN_DIR DIRECT /end RECORD_LAYOUT
/begin RECORD_LAYOUT REC_SBYTE_C FNC_VALUES 1 SBYTE COLUMN_DIR DIRECT /end RECORD_LAYOUT
/begin RECORD_LAYOUT REC_SLONG_C FNC_VALUES 1 SLONG COLUMN_DIR DIRECT /end RECORD_LAYOUT
/begin RECORD_LAYOUT REC_ULONG_C FNC_VALUES 1 ULONG COLUMN_DIR DIRECT /end RECORD_LAYOUT
/end MODULE
/end PROJECT
