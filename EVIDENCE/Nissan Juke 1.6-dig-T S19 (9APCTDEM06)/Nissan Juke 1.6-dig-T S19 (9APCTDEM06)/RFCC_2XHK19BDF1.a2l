/begin PROJECT X12C_KH3DT_DI_NAM_R/C ""
/begin HEADER "" /* key HEADER ++ "comment" に Par.scomment */ PROJECT_NO X12C_KH3DT_DI_NAM_R/C /* key PROJECT_NO ++ project number に car_eng_desti_lot */ VERSION "0KHDCFDZ7" /* key VERSION ++ version number に mProgver */ /end HEADER
/begin MODULE DIM ""
/begin MOD_COMMON "" ALIGNMENT_BYTE 1 ALIGNMENT_WORD 2 ALIGNMENT_LONG 4 ALIGNMENT_FLOAT32_IEEE 4 ALIGNMENT_FLOAT64_IEEE 4 DEPOSIT ABSOLUTE BYTE_ORDER MSB_FIRST /* ﾊﾞｲﾄｵｰﾀﾞｰがﾘﾌﾟﾚｰｽされる */ /end MOD_COMMON
/begin CHARACTERISTIC mTAFCLPRT "Coldｽﾀｰﾄ時ﾘｰﾝ化走行時目標空燃比ﾃｰﾌﾞﾙ(Cold_srart_lean_target_A/F_table(RUNNING))" CURVE 0x00013CCA REC_UWORD_C 0 COMP_0453 0 131.07
 /begin AXIS_DESCR COM_AXIS NO_INPUT_QUANTITY COMP_0035 16 -50 65485 AXIS_PTS_REF mTXAFSFT /end AXIS_DESCR
/end CHARACTERISTIC
/begin CHARACTERISTIC mTAISMX "ISC開口面積上限値テーブル" CURVE 0x00013D4A REC_UWORD_C 0 COMP_0042 0 52.428
 /begin AXIS_DESCR FIX_AXIS NO_INPUT_QUANTITY COMP_0348_S 16 -40 110 FIX_AXIS_PAR_DIST 0 1 16 /end AXIS_DESCR
/end CHARACTERISTIC
/begin CHARACTERISTIC mTAISMX_S "ISC開口面積上限値ﾃｰﾌﾞﾙ" CURVE 0x00016414 REC_UWORD_C 0 COMP_0042 0 52.428
 /begin AXIS_DESCR FIX_AXIS NO_INPUT_QUANTITY COMP_0348_S 16 -40 110 FIX_AXIS_PAR_DIST 0 1 16 /end AXIS_DESCR
/end CHARACTERISTIC
/begin CHARACTERISTIC mTAISNH "ISC開口面積上限エンジン回転数補正テーブル" CURVE 0x00013D6A REC_UWORD_C 0 COMP_0042 0 52.428
 /begin AXIS_DESCR FIX_AXIS NO_INPUT_QUANTITY COMP_0347_S 16 0 6000 FIX_AXIS_PAR_DIST 0 1 16 /end AXIS_DESCR
/end CHARACTERISTIC
/begin CHARACTERISTIC mTAISNH_S "ISC開口面積上限エンジン回転数補正ﾃｰﾌﾞﾙ" CURVE 0x00016434 REC_UWORD_C 0 COMP_0042 0 52.428
 /begin AXIS_DESCR FIX_AXIS NO_INPUT_QUANTITY COMP_0347_S 16 0 6000 FIX_AXIS_PAR_DIST 0 1 16 /end AXIS_DESCR
/end CHARACTERISTIC
/begin CHARACTERISTIC mTAPSCV1 "SCV制御用APOﾃｰﾌﾞﾙ" CURVE 0x00013DAA REC_UWORD_C 0 COMP_0005 0 7208.85
 /begin AXIS_DESCR FIX_AXIS NO_INPUT_QUANTITY COMP_0347_S 16 0 6000 FIX_AXIS_PAR_DIST 0 1 16 /end AXIS_DESCR
/end CHARACTERISTIC
/begin CHARACTERISTIC mTBASP1_S "ベースペダル特性テーブル1（副演算部）" CURVE 0x00016454 REC_UWORD_C 0 COMP_0032_S 0 8191.875
 /begin AXIS_DESCR COM_AXIS NO_INPUT_QUANTITY COMP_0032_S 16 0 8191.875 AXIS_PTS_REF mTPDLAP_S /end AXIS_DESCR
/end CHARACTERISTIC
/begin CHARACTERISTIC mTBASP2_S "ベースペダル特性テーブル2（副演算部）" CURVE 0x00016474 REC_UWORD_C 0 COMP_0032_S 0 8191.875
 /begin AXIS_DESCR COM_AXIS NO_INPUT_QUANTITY COMP_0032_S 16 0 8191.875 AXIS_PTS_REF mTPDLAP_S /end AXIS_DESCR
/end CHARACTERISTIC
/begin CHARACTERISTIC mTBASPDL1 "ベースペダル特性テーブル1" CURVE 0x00013DDA REC_UWORD_C 0 COMP_0032_S 0 8191.875
 /begin AXIS_DESCR COM_AXIS NO_INPUT_QUANTITY COMP_0032_S 16 0 8191.875 AXIS_PTS_REF mTPDLAPBP /end AXIS_DESCR
/end CHARACTERISTIC
/begin CHARACTERISTIC mTBASPDL2 "ベースペダル特性テーブル2" CURVE 0x00013DFA REC_UWORD_C 0 COMP_0032_S 0 8191.875
 /begin AXIS_DESCR COM_AXIS NO_INPUT_QUANTITY COMP_0032_S 16 0 8191.875 AXIS_PTS_REF mTPDLAPBP /end AXIS_DESCR
/end CHARACTERISTIC
/begin CHARACTERISTIC mTBASREV "リバースペダル特性ゲインテーブル" CURVE 0x00013E1A REC_UWORD_C 0 COMP_0209_S 0 199.996894995
 /begin AXIS_DESCR COM_AXIS NO_INPUT_QUANTITY COMP_0032_S 16 0 8191.875 AXIS_PTS_REF mTPDLAPBP /end AXIS_DESCR
/end CHARACTERISTIC
/begin CHARACTERISTIC mTBASRE_S "リバースペダル特性ゲインテーブル（副演算部）" CURVE 0x00016494 REC_UWORD_C 0 COMP_0209_S 0 199.996894995
 /begin AXIS_DESCR COM_AXIS NO_INPUT_QUANTITY COMP_0032_S 16 0 8191.875 AXIS_PTS_REF mTPDLAP_S /end AXIS_DESCR
/end CHARACTERISTIC
/begin CHARACTERISTIC mTBASV "マップ移行率テーブル" CURVE 0x00013E3A REC_UWORD_C 0 COMP_0410 0 99.9985458
 /begin AXIS_DESCR COM_AXIS NO_INPUT_QUANTITY COMP_0436 16 0 6553.5 AXIS_PTS_REF mTGVSP0 /end AXIS_DESCR
/end CHARACTERISTIC
/begin CHARACTERISTIC mTBLATM2 "大気圧補正係数テーブル" CURVE 0x00011BCC REC_UBYTE_C 0 COMP_0044 0 1.9921875
 /begin AXIS_DESCR FIX_AXIS NO_INPUT_QUANTITY COMP_0349_S 16 0 4800 FIX_AXIS_PAR_DIST 0 1 16 /end AXIS_DESCR
/end CHARACTERISTIC
/begin CHARACTERISTIC mTBRKOFVB "ブレーキOFF回生時オフセット電圧テーブル" CURVE 0x00011BE4 REC_UBYTE_C 0 COMP_0033 0 20400
 /begin AXIS_DESCR FIX_AXIS NO_INPUT_QUANTITY COMP_0350_S 16 8 68 FIX_AXIS_PAR_DIST 0 1 16 /end AXIS_DESCR
/end CHARACTERISTIC
/begin CHARACTERISTIC mTCALA12 "A/F変換ﾃｰﾌﾞﾙ" CURVE 0x00013E7A REC_UWORD_C 0 COMP_0351_S 0 131.07
 /begin AXIS_DESCR COM_AXIS NO_INPUT_QUANTITY COMP_0352_S 16 0 81918.75 AXIS_PTS_REF mTXCLA12 /end AXIS_DESCR
/end CHARACTERISTIC
/begin CHARACTERISTIC mTCAR "ｷｬﾘﾌﾞﾚｰｼｮﾝﾃｰﾌﾞﾙ" CURVE 0x00013E9A REC_UWORD_C 0 COMP_0290 0 0.999985458
 /begin AXIS_DESCR COM_AXIS NO_INPUT_QUANTITY COMP_0290 16 0 0.999985458 AXIS_PTS_REF mJKCAR /end AXIS_DESCR
/end CHARACTERISTIC
/begin CHARACTERISTIC mTCCLV "演算負荷値算出用TP最大値参照ﾃｰﾌﾞﾙ" CURVE 0x00013EBA REC_UWORD_C 0 COMP_0052 0 31.99956087
 /begin AXIS_DESCR FIX_AXIS NO_INPUT_QUANTITY COMP_0347_S 16 0 6000 FIX_AXIS_PAR_DIST 0 1 16 /end AXIS_DESCR
/end CHARACTERISTIC
/begin CHARACTERISTIC mTCKDWA "吸気温補正係数テーブル" CURVE 0x00011C38 REC_UBYTE_C 0 COMP_0045 0 1.9921875
 /begin AXIS_DESCR FIX_AXIS NO_INPUT_QUANTITY COMP_0348_S 16 -40 110 FIX_AXIS_PAR_DIST 0 1 16 /end AXIS_DESCR
/end CHARACTERISTIC
/begin CHARACTERISTIC mTCKDWI "基本点火時期ﾘﾀｰﾄﾞ量ﾃｰﾌﾞﾙ" CURVE 0x00011C48 REC_UBYTE_C 0 COMP_0017 0 255
 /begin AXIS_DESCR FIX_AXIS NO_INPUT_QUANTITY COMP_0353_S 16 6.25 100 FIX_AXIS_PAR_DIST 0 1 16 /end AXIS_DESCR
/end CHARACTERISTIC
/begin CHARACTERISTIC mTCKDWIR "後進時基本点火時期ﾘﾀｰﾄﾞ量ﾃｰﾌﾞﾙ" CURVE 0x00011C58 REC_UBYTE_C 0 COMP_0017 0 255
 /begin AXIS_DESCR FIX_AXIS NO_INPUT_QUANTITY COMP_0353_S 16 6.25 100 FIX_AXIS_PAR_DIST 0 1 16 /end AXIS_DESCR
/end CHARACTERISTIC
/begin CHARACTERISTIC mTCKDWN "回転補正係数テーブル" CURVE 0x00011C68 REC_UBYTE_C 0 COMP_0045 0 1.9921875
 /begin AXIS_DESCR FIX_AXIS NO_INPUT_QUANTITY COMP_0354_S 16 0 3000 FIX_AXIS_PAR_DIST 0 1 16 /end AXIS_DESCR
/end CHARACTERISTIC
/begin CHARACTERISTIC mTCLDTRG1 "成層F/B用空燃比-等量比変換テーブル(bank1)" CURVE 0x00013EDA REC_UWORD_C 0 COMP_0453 0 131.07
 /begin AXIS_DESCR COM_AXIS NO_INPUT_QUANTITY COMP_0217 16 0 3.999941832 AXIS_PTS_REF mLCLDTRG /end AXIS_DESCR
/end CHARACTERISTIC
/begin CHARACTERISTIC mTCLDTRG2 "成層F/B用空燃比-等量比変換テーブル(bank2)" CURVE 0x00013EFA REC_UWORD_C 0 COMP_0453 0 131.07
 /begin AXIS_DESCR COM_AXIS NO_INPUT_QUANTITY COMP_0217 16 0 3.999941832 AXIS_PTS_REF mLCLDTRG /end AXIS_DESCR
/end CHARACTERISTIC
/begin CHARACTERISTIC mTCLRGIN "Coldｽﾀｰﾄ時ﾘｰﾝ化走行時目標NOx補正ﾃｰﾌﾞﾙ(Cold_srart_lean_target_NOx_correction_table(RUNNING))" CURVE 0x00013F1A REC_UWORD_C 0 COMP_0285_S 0 1.3107
 /begin AXIS_DESCR COM_AXIS NO_INPUT_QUANTITY COMP_0019_S 16 0 257.000024415 AXIS_PTS_REF mLCLRGIN /end AXIS_DESCR
/end CHARACTERISTIC
/begin CHARACTERISTIC mTCLRGINE "E85用Coldｽﾀｰﾄ時ﾘｰﾝ化走行時目標Nox補正ﾃｰﾌﾞﾙ(Cold_start_lean_target_NOx_correction_table(RUNNING)_for_E85)" CURVE 0x00013F3A REC_UWORD_C 0 COMP_0285_S 0 1.3107
 /begin AXIS_DESCR COM_AXIS NO_INPUT_QUANTITY COMP_0019_S 16 0 257.000024415 AXIS_PTS_REF mLCLRGIN /end AXIS_DESCR
/end CHARACTERISTIC
/begin CHARACTERISTIC mTDECMX "DECISC基本値ﾃｰﾌﾞﾙ" CURVE 0x00011CF0 REC_UBYTE_C 0 COMP_0220 0 255
 /begin AXIS_DESCR FIX_AXIS NO_INPUT_QUANTITY COMP_0355_S 16 0 120 FIX_AXIS_PAR_DIST 0 1 16 /end AXIS_DESCR
/end CHARACTERISTIC
/begin CHARACTERISTIC mTDKAS10 "始動後減少割合ﾃｰﾌﾞﾙ" CURVE 0x00011D10 REC_UBYTE_C 0 COMP_0304 1.00392156862745 256
 /begin AXIS_DESCR FIX_AXIS NO_INPUT_QUANTITY COMP_0348_S 16 -40 110 FIX_AXIS_PAR_DIST 0 1 16 /end AXIS_DESCR
/end CHARACTERISTIC
/begin CHARACTERISTIC mTDKAST10 "成層始動用始動後減少割合テーブル" CURVE 0x00011D20 REC_UBYTE_C 0 COMP_0356_S 1.00392156862745 256
 /begin AXIS_DESCR FIX_AXIS NO_INPUT_QUANTITY COMP_0348_S 16 -40 110 FIX_AXIS_PAR_DIST 0 1 16 /end AXIS_DESCR
/end CHARACTERISTIC
/begin CHARACTERISTIC mTDSHPT "QDSPT基本値テーブル" CURVE 0x00011D84 REC_UBYTE_C 0 COMP_0293 0 510
 /begin AXIS_DESCR FIX_AXIS NO_INPUT_QUANTITY COMP_0347_S 16 0 6000 FIX_AXIS_PAR_DIST 0 1 16 /end AXIS_DESCR
/end CHARACTERISTIC
/begin CHARACTERISTIC mTDSHPT0 "QDSPT基本値テーブル" CURVE 0x00011D94 REC_UBYTE_C 0 COMP_0293 0 510
 /begin AXIS_DESCR FIX_AXIS NO_INPUT_QUANTITY COMP_0347_S 16 0 6000 FIX_AXIS_PAR_DIST 0 1 16 /end AXIS_DESCR
/end CHARACTERISTIC
/begin CHARACTERISTIC mTDTLTW "油水温差変換テーブル" CURVE 0x00011DA4 REC_UBYTE_C 0 COMP_0003 0 255
 /begin AXIS_DESCR FIX_AXIS NO_INPUT_QUANTITY COMP_0357_S 16 400 6400 FIX_AXIS_PAR_DIST 0 1 16 /end AXIS_DESCR
/end CHARACTERISTIC
/begin CHARACTERISTIC mTDTOTE3 "油温センサバラツキテーブル" CURVE 0x00011DB4 REC_UBYTE_C 0 COMP_0003 0 255
 /begin AXIS_DESCR FIX_AXIS NO_INPUT_QUANTITY COMP_0358_S 16 10 160 FIX_AXIS_PAR_DIST 0 1 16 /end AXIS_DESCR
/end CHARACTERISTIC
/begin CHARACTERISTIC mTETFNL "燃温条件下限テーブル" CURVE 0x00011DDC REC_UBYTE_C 0 COMP_0035 -50 205
 /begin AXIS_DESCR FIX_AXIS NO_INPUT_QUANTITY COMP_0348_S 16 -40 110 FIX_AXIS_PAR_DIST 0 1 16 /end AXIS_DESCR
/end CHARACTERISTIC
/begin CHARACTERISTIC mTFDMAX_S "MAX駆動力テーブル（副演算部）" CURVE 0x000164C4 REC_UWORD_C 0 COMP_0315_S -32768 32767
 /begin AXIS_DESCR COM_AXIS NO_INPUT_QUANTITY COMP_0436 16 0 6553.5 AXIS_PTS_REF mTFDVSB_S /end AXIS_DESCR
/end CHARACTERISTIC
/begin CHARACTERISTIC mTFDMIN_S "MIN駆動力テーブル（副演算部）" CURVE 0x000164E4 REC_UWORD_C 0 COMP_0315_S -32768 32767
 /begin AXIS_DESCR COM_AXIS NO_INPUT_QUANTITY COMP_0436 16 0 6553.5 AXIS_PTS_REF mTFDVSB_S /end AXIS_DESCR
/end CHARACTERISTIC
/begin CHARACTERISTIC mTFGAGE "空間容積変換テーブル" CURVE 0x000141BA REC_UWORD_C 0 COMP_0312 0 127.998046875
 /begin AXIS_DESCR COM_AXIS NO_INPUT_QUANTITY COMP_0050 16 0 5119.921875 AXIS_PTS_REF mLFGAGE /end AXIS_DESCR
/end CHARACTERISTIC
/begin CHARACTERISTIC mTFHOS "脱離量演算ﾃｰﾌﾞﾙ" CURVE 0x000141DA REC_UWORD_C 0 COMP_0290 0 0.999985458
 /begin AXIS_DESCR COM_AXIS NO_INPUT_QUANTITY COMP_0290 16 0 0.999985458 AXIS_PTS_REF mJKFHOS /end AXIS_DESCR
/end CHARACTERISTIC
/begin CHARACTERISTIC mTFNCRADV "始動時点火時期回転補正値ﾃｰﾌﾞﾙ" CURVE 0x0001420A REC_UWORD_C 0 COMP_0063 0 255.99609375
 /begin AXIS_DESCR FIX_AXIS NO_INPUT_QUANTITY COMP_0354_S 16 0 3000 FIX_AXIS_PAR_DIST 0 1 16 /end AXIS_DESCR
/end CHARACTERISTIC
/begin CHARACTERISTIC mTFUKENEP "クラッチ切り判定閾値テーブル" CURVE 0x00011E5C REC_UBYTE_C 0 COMP_0065 0 796.875
 /begin AXIS_DESCR FIX_AXIS NO_INPUT_QUANTITY COMP_0355_S 16 0 120 FIX_AXIS_PAR_DIST 0 1 16 /end AXIS_DESCR
/end CHARACTERISTIC
/begin CHARACTERISTIC mTFVAPO "ﾌﾙ増量判定VAPOﾃｰﾌﾞﾙ" CURVE 0x00011E6C REC_UBYTE_C 0 COMP_0002 0 89.25
 /begin AXIS_DESCR FIX_AXIS NO_INPUT_QUANTITY COMP_0347_S 16 0 6000 FIX_AXIS_PAR_DIST 0 1 16 /end AXIS_DESCR
/end CHARACTERISTIC
/begin CHARACTERISTIC mTGNSETST "アイドルエンジン回転数アップ率テーブル(Idle_speed_up_rate_table)" CURVE 0x00011E94 REC_UBYTE_C 0 COMP_0021 0 99.609375
 /begin AXIS_DESCR COM_AXIS NO_INPUT_QUANTITY COMP_0356 16 -40 119.375 AXIS_PTS_REF mLTISUT /end AXIS_DESCR
/end CHARACTERISTIC
/begin CHARACTERISTIC mTGSI12U "車速閾値参照テーブル（1→2UP）" CURVE 0x0001427A REC_UWORD_C 0 COMP_0436 0 6553.5
 /begin AXIS_DESCR COM_AXIS NO_INPUT_QUANTITY COMP_0005 16 0 7208.85 AXIS_PTS_REF mGSIAPO /end AXIS_DESCR
/end CHARACTERISTIC
/begin CHARACTERISTIC mTGSI12UH "車速閾値参照テーブル（1→2UP）（アップヒル用）" CURVE 0x000142AA REC_UWORD_C 0 COMP_0436 0 6553.5
 /begin AXIS_DESCR COM_AXIS NO_INPUT_QUANTITY COMP_0005 16 0 7208.85 AXIS_PTS_REF mGSIAPO /end AXIS_DESCR
/end CHARACTERISTIC
/begin CHARACTERISTIC mTGSI21D "車速閾値参照テーブル（2→1DOWN）" CURVE 0x000142CA REC_UWORD_C 0 COMP_0436 0 6553.5
 /begin AXIS_DESCR COM_AXIS NO_INPUT_QUANTITY COMP_0005 16 0 7208.85 AXIS_PTS_REF mGSIAPO /end AXIS_DESCR
/end CHARACTERISTIC
/begin CHARACTERISTIC mTGSI21DH "車速閾値参照テーブル（2→1DOWN）（アップヒル用）" CURVE 0x000142EA REC_UWORD_C 0 COMP_0436 0 6553.5
 /begin AXIS_DESCR COM_AXIS NO_INPUT_QUANTITY COMP_0005 16 0 7208.85 AXIS_PTS_REF mGSIAPO /end AXIS_DESCR
/end CHARACTERISTIC
/begin CHARACTERISTIC mTGSI23U "車速閾値参照テーブル（2→3UP）" CURVE 0x0001430A REC_UWORD_C 0 COMP_0436 0 6553.5
 /begin AXIS_DESCR COM_AXIS NO_INPUT_QUANTITY COMP_0005 16 0 7208.85 AXIS_PTS_REF mGSIAPO /end AXIS_DESCR
/end CHARACTERISTIC
/begin CHARACTERISTIC mTGSI23UH "車速閾値参照テーブル（2→3UP）（アップヒル用）" CURVE 0x0001432A REC_UWORD_C 0 COMP_0436 0 6553.5
 /begin AXIS_DESCR COM_AXIS NO_INPUT_QUANTITY COMP_0005 16 0 7208.85 AXIS_PTS_REF mGSIAPO /end AXIS_DESCR
/end CHARACTERISTIC
/begin CHARACTERISTIC mTGSI32D "車速閾値参照テーブル（3→2DOWN）" CURVE 0x0001435A REC_UWORD_C 0 COMP_0436 0 6553.5
 /begin AXIS_DESCR COM_AXIS NO_INPUT_QUANTITY COMP_0005 16 0 7208.85 AXIS_PTS_REF mGSIAPO /end AXIS_DESCR
/end CHARACTERISTIC
/begin CHARACTERISTIC mTGSI32DH "車速閾値参照テーブル（3→2DOWN）（アップヒル用）" CURVE 0x0001437A REC_UWORD_C 0 COMP_0436 0 6553.5
 /begin AXIS_DESCR COM_AXIS NO_INPUT_QUANTITY COMP_0005 16 0 7208.85 AXIS_PTS_REF mGSIAPO /end AXIS_DESCR
/end CHARACTERISTIC
/begin CHARACTERISTIC mTGSI34U "車速閾値参照テーブル（3→4UP）" CURVE 0x0001439A REC_UWORD_C 0 COMP_0436 0 6553.5
 /begin AXIS_DESCR COM_AXIS NO_INPUT_QUANTITY COMP_0005 16 0 7208.85 AXIS_PTS_REF mGSIAPO /end AXIS_DESCR
/end CHARACTERISTIC
/begin CHARACTERISTIC mTGSI34UH "車速閾値参照テーブル（3→4UP）（アップヒル用）" CURVE 0x000143BA REC_UWORD_C 0 COMP_0436 0 6553.5
 /begin AXIS_DESCR COM_AXIS NO_INPUT_QUANTITY COMP_0005 16 0 7208.85 AXIS_PTS_REF mGSIAPO /end AXIS_DESCR
/end CHARACTERISTIC
/begin CHARACTERISTIC mTGSI43D "車速閾値参照テーブル（4→3DOWN）" CURVE 0x000143DA REC_UWORD_C 0 COMP_0436 0 6553.5
 /begin AXIS_DESCR COM_AXIS NO_INPUT_QUANTITY COMP_0005 16 0 7208.85 AXIS_PTS_REF mGSIAPO /end AXIS_DESCR
/end CHARACTERISTIC
/begin CHARACTERISTIC mTGSI43DH "車速閾値参照テーブル（4→3DOWN）（アップヒル用）" CURVE 0x000143FA REC_UWORD_C 0 COMP_0436 0 6553.5
 /begin AXIS_DESCR COM_AXIS NO_INPUT_QUANTITY COMP_0005 16 0 7208.85 AXIS_PTS_REF mGSIAPO /end AXIS_DESCR
/end CHARACTERISTIC
/begin CHARACTERISTIC mTGSI45U "車速閾値参照テーブル（4→5UP）" CURVE 0x0001441A REC_UWORD_C 0 COMP_0436 0 6553.5
 /begin AXIS_DESCR COM_AXIS NO_INPUT_QUANTITY COMP_0005 16 0 7208.85 AXIS_PTS_REF mGSIAPO /end AXIS_DESCR
/end CHARACTERISTIC
/begin CHARACTERISTIC mTGSI45UH "車速閾値参照テーブル（4→5UP）（アップヒル用）" CURVE 0x0001443A REC_UWORD_C 0 COMP_0436 0 6553.5
 /begin AXIS_DESCR COM_AXIS NO_INPUT_QUANTITY COMP_0005 16 0 7208.85 AXIS_PTS_REF mGSIAPO /end AXIS_DESCR
/end CHARACTERISTIC
/begin CHARACTERISTIC mTGSI54D "車速閾値参照テーブル（5→4DOWN）" CURVE 0x0001445A REC_UWORD_C 0 COMP_0436 0 6553.5
 /begin AXIS_DESCR COM_AXIS NO_INPUT_QUANTITY COMP_0005 16 0 7208.85 AXIS_PTS_REF mGSIAPO /end AXIS_DESCR
/end CHARACTERISTIC
/begin CHARACTERISTIC mTGSI54DH "車速閾値参照テーブル（5→4DOWN）（アップヒル用）" CURVE 0x0001447A REC_UWORD_C 0 COMP_0436 0 6553.5
 /begin AXIS_DESCR COM_AXIS NO_INPUT_QUANTITY COMP_0005 16 0 7208.85 AXIS_PTS_REF mGSIAPO /end AXIS_DESCR
/end CHARACTERISTIC
/begin CHARACTERISTIC mTGSI56U "車速閾値参照テーブル（5→6UP）" CURVE 0x0001449A REC_UWORD_C 0 COMP_0436 0 6553.5
 /begin AXIS_DESCR COM_AXIS NO_INPUT_QUANTITY COMP_0005 16 0 7208.85 AXIS_PTS_REF mGSIAPO /end AXIS_DESCR
/end CHARACTERISTIC
/begin CHARACTERISTIC mTGSI56UH "車速閾値参照テーブル（5→6UP）（アップヒル用）" CURVE 0x000144BA REC_UWORD_C 0 COMP_0436 0 6553.5
 /begin AXIS_DESCR COM_AXIS NO_INPUT_QUANTITY COMP_0005 16 0 7208.85 AXIS_PTS_REF mGSIAPO /end AXIS_DESCR
/end CHARACTERISTIC
/begin CHARACTERISTIC mTGSI65D "車速閾値参照テーブル（6→5DOWN）" CURVE 0x000144DA REC_UWORD_C 0 COMP_0436 0 6553.5
 /begin AXIS_DESCR COM_AXIS NO_INPUT_QUANTITY COMP_0005 16 0 7208.85 AXIS_PTS_REF mGSIAPO /end AXIS_DESCR
/end CHARACTERISTIC
/begin CHARACTERISTIC mTGSI65DH "車速閾値参照テーブル（6→5DOWN）（アップヒル用）" CURVE 0x000144FA REC_UWORD_C 0 COMP_0436 0 6553.5
 /begin AXIS_DESCR COM_AXIS NO_INPUT_QUANTITY COMP_0005 16 0 7208.85 AXIS_PTS_REF mGSIAPO /end AXIS_DESCR
/end CHARACTERISTIC
/begin CHARACTERISTIC mTGTVGALL "高地判定用TGTVGテーブル" CURVE 0x00011EDC REC_UBYTE_C 0 COMP_0315 0 24.90075
 /begin AXIS_DESCR FIX_AXIS NO_INPUT_QUANTITY COMP_0347_S 16 0 6000 FIX_AXIS_PAR_DIST 0 1 16 /end AXIS_DESCR
/end CHARACTERISTIC
/begin CHARACTERISTIC mTHPPAMB "圧力補正係数" CURVE 0x0001455A REC_UWORD_C 0 COMP_0217 0 3.999941832
 /begin AXIS_DESCR COM_AXIS NO_INPUT_QUANTITY COMP_0034_S 16 0 255.99609375 AXIS_PTS_REF mLHPPAMB /end AXIS_DESCR
/end CHARACTERISTIC
/begin CHARACTERISTIC mTHTWLMT "高水温リミットトルクテーブル" CURVE 0x0001458A REC_UWORD_C 0 COMP_0226 -3276.8 3276.7
 /begin AXIS_DESCR FIX_AXIS NO_INPUT_QUANTITY COMP_0357_S 16 400 6400 FIX_AXIS_PAR_DIST 0 1 16 /end AXIS_DESCR
/end CHARACTERISTIC
/begin CHARACTERISTIC mTICTMPN "インジェクタ駆動回路温度正規化テーブル(Injector_drive_circuit_temperature_table)" CURVE 0x000145EA REC_UWORD_C 0 COMP_0158_S -50 8141.875
 /begin AXIS_DESCR COM_AXIS NO_INPUT_QUANTITY COMP_0023 16 0 327675 AXIS_PTS_REF mTICTMPV /end AXIS_DESCR
/end CHARACTERISTIC
/begin CHARACTERISTIC mTIDELAY "CLOSE制御移行テーブル" CURVE 0x00011F34 REC_UBYTE_C 0 COMP_0008 0 25500
 /begin AXIS_DESCR FIX_AXIS NO_INPUT_QUANTITY COMP_0347_S 16 0 6000 FIX_AXIS_PAR_DIST 0 1 16 /end AXIS_DESCR
/end CHARACTERISTIC
/begin CHARACTERISTIC mTIDVTTW "低水温ｱｲﾄﾞﾙ時VTC目標作動角水温補正テーブル" CURVE 0x00011F6C REC_UBYTE_C 0 COMP_0009 0 199.21875
 /begin AXIS_DESCR FIX_AXIS NO_INPUT_QUANTITY COMP_0348_S 16 -40 110 FIX_AXIS_PAR_DIST 0 1 16 /end AXIS_DESCR
/end CHARACTERISTIC
/begin CHARACTERISTIC mTIDVTTWE "低水温アイドル時排気VTC目標作動角水温補正テーブル" CURVE 0x00011F7C REC_UBYTE_C 0 COMP_0009 0 199.21875
 /begin AXIS_DESCR FIX_AXIS NO_INPUT_QUANTITY COMP_0348_S 16 -40 110 FIX_AXIS_PAR_DIST 0 1 16 /end AXIS_DESCR
/end CHARACTERISTIC
/begin CHARACTERISTIC mTIDVTTWS "低水温アイドル時VTC目標作動角水温補正テーブル(成層始動用)" CURVE 0x00011F8C REC_UBYTE_C 0 COMP_0009 0 199.21875
 /begin AXIS_DESCR FIX_AXIS NO_INPUT_QUANTITY COMP_0348_S 16 -40 110 FIX_AXIS_PAR_DIST 0 1 16 /end AXIS_DESCR
/end CHARACTERISTIC
/begin CHARACTERISTIC mTINLDTE "始動時CLOSE制御禁止時間ﾃｰﾌﾞﾙ" CURVE 0x00011FEC REC_UBYTE_C 0 COMP_0049 0 255
 /begin AXIS_DESCR COM_AXIS NO_INPUT_QUANTITY COMP_0035 16 -50 205 AXIS_PTS_REF mTWKINT /end AXIS_DESCR
/end CHARACTERISTIC
/begin CHARACTERISTIC mTINLDTE2 "始動時CLOSE制御禁止時間ﾃｰﾌﾞﾙ早期化版" CURVE 0x00011FFC REC_UBYTE_C 0 COMP_0049 0 255
 /begin AXIS_DESCR COM_AXIS NO_INPUT_QUANTITY COMP_0035 16 -50 205 AXIS_PTS_REF mTWKINT /end AXIS_DESCR
/end CHARACTERISTIC
/begin CHARACTERISTIC mTISUT "アイドルエンジン回転数アップ時間テーブル(Idle_speed_up_time_table)" CURVE 0x00012054 REC_UBYTE_C 0 COMP_0049 0 255
 /begin AXIS_DESCR COM_AXIS NO_INPUT_QUANTITY COMP_0356 16 -40 119.375 AXIS_PTS_REF mLTISUT /end AXIS_DESCR
/end CHARACTERISTIC
/begin CHARACTERISTIC mTITAC0WH "高回転車種用WOT時標準状態充填効率回転数テーブル" CURVE 0x00012064 REC_UBYTE_C 0 COMP_0009 0 199.21875
 /begin AXIS_DESCR COM_AXIS NO_INPUT_QUANTITY COMP_0020 16 0 12750 AXIS_PTS_REF mTITACNE /end AXIS_DESCR
/end CHARACTERISTIC
/begin CHARACTERISTIC mTKAS "始動後増量ﾃｰﾌﾞﾙ" CURVE 0x0001209C REC_UBYTE_C 0 COMP_0066 0 3.984375
 /begin AXIS_DESCR FIX_AXIS NO_INPUT_QUANTITY COMP_0348_S 16 -40 110 FIX_AXIS_PAR_DIST 0 1 16 /end AXIS_DESCR
/end CHARACTERISTIC
/begin CHARACTERISTIC mTKASS "始動後増量水温補正" CURVE 0x000120AC REC_UBYTE_C 0 COMP_0066 0 3.984375
 /begin AXIS_DESCR FIX_AXIS NO_INPUT_QUANTITY COMP_0348_S 16 -40 110 FIX_AXIS_PAR_DIST 0 1 16 /end AXIS_DESCR
/end CHARACTERISTIC
/begin CHARACTERISTIC mTKASSST "成層始動用始動後増量水温補正" CURVE 0x000120BC REC_UBYTE_C 0 COMP_0186 0 3.984375
 /begin AXIS_DESCR FIX_AXIS NO_INPUT_QUANTITY COMP_0348_S 16 -40 110 FIX_AXIS_PAR_DIST 0 1 16 /end AXIS_DESCR
/end CHARACTERISTIC
/begin CHARACTERISTIC mTKASST "成層始動用始動後増量テーブル" CURVE 0x000120CC REC_UBYTE_C 0 COMP_0186 0 3.984375
 /begin AXIS_DESCR FIX_AXIS NO_INPUT_QUANTITY COMP_0348_S 16 -40 110 FIX_AXIS_PAR_DIST 0 1 16 /end AXIS_DESCR
/end CHARACTERISTIC
/begin CHARACTERISTIC mTKFP "燃圧変換係数テーブル" CURVE 0x000120E4 REC_UBYTE_C 0 COMP_0341 0 0.99705
 /begin AXIS_DESCR FIX_AXIS NO_INPUT_QUANTITY COMP_0347_S 16 0 6000 FIX_AXIS_PAR_DIST 0 1 16 /end AXIS_DESCR
/end CHARACTERISTIC
/begin CHARACTERISTIC mTKINJ "インジェクタ倍率補正テーブル" CURVE 0x000146F2 REC_UWORD_C 0 COMP_0328 0 399.99392106
 /begin AXIS_DESCR COM_AXIS NO_INPUT_QUANTITY COMP_0268 16 0 19.988175 AXIS_PTS_REF mPKINJ /end AXIS_DESCR
/end CHARACTERISTIC
/begin CHARACTERISTIC mTKINJ2 "インジェクタ倍率補正テーブル2" CURVE 0x00014712 REC_UWORD_C 0 COMP_0328 0 399.99392106
 /begin AXIS_DESCR COM_AXIS NO_INPUT_QUANTITY COMP_0268 16 0 19.988175 AXIS_PTS_REF mPKINJ /end AXIS_DESCR
/end CHARACTERISTIC
/begin CHARACTERISTIC mTKMRTPH "トルクダウン域判定ITACテーブルハイオク" CURVE 0x00012114 REC_UBYTE_C 0 COMP_0009 0 199.21875
 /begin AXIS_DESCR FIX_AXIS NO_INPUT_QUANTITY COMP_0347_S 16 0 6000 FIX_AXIS_PAR_DIST 0 1 16 /end AXIS_DESCR
/end CHARACTERISTIC
/begin CHARACTERISTIC mTKMRTPR "トルクダウン域判定ITACテーブルレギュラー" CURVE 0x00012124 REC_UBYTE_C 0 COMP_0009 0 199.21875
 /begin AXIS_DESCR FIX_AXIS NO_INPUT_QUANTITY COMP_0347_S 16 0 6000 FIX_AXIS_PAR_DIST 0 1 16 /end AXIS_DESCR
/end CHARACTERISTIC
/begin CHARACTERISTIC mTKMRTRG1 "空燃比-等量比変換ﾃｰﾌﾞﾙ" CURVE 0x00014742 REC_UWORD_C 0 COMP_0453 0 131.07
 /begin AXIS_DESCR COM_AXIS NO_INPUT_QUANTITY COMP_0217 16 0 3.999941832 AXIS_PTS_REF mLKMRTRG /end AXIS_DESCR
/end CHARACTERISTIC
/begin CHARACTERISTIC mTKMRTRG2 "空燃比-等量比変換ﾃｰﾌﾞﾙ(bank2)" CURVE 0x00014762 REC_UWORD_C 0 COMP_0453 0 131.07
 /begin AXIS_DESCR COM_AXIS NO_INPUT_QUANTITY COMP_0217 16 0 3.999941832 AXIS_PTS_REF mLKMRTRG /end AXIS_DESCR
/end CHARACTERISTIC
/begin CHARACTERISTIC mTKMRTRQH "トルクダウン域リタード量テーブルハイオク" CURVE 0x0001213C REC_UBYTE_C 0 COMP_0017 0 255
 /begin AXIS_DESCR FIX_AXIS NO_INPUT_QUANTITY COMP_0347_S 16 0 6000 FIX_AXIS_PAR_DIST 0 1 16 /end AXIS_DESCR
/end CHARACTERISTIC
/begin CHARACTERISTIC mTKMRTRQR "トルクダウン域リタード量テーブルレギュラー" CURVE 0x0001214C REC_UBYTE_C 0 COMP_0017 0 255
 /begin AXIS_DESCR FIX_AXIS NO_INPUT_QUANTITY COMP_0347_S 16 0 6000 FIX_AXIS_PAR_DIST 0 1 16 /end AXIS_DESCR
/end CHARACTERISTIC
/begin CHARACTERISTIC mTKNKITAC "ノック領域判定テーブル(ITAC_threshold_table_for_knock_occurred_running_condition)" CURVE 0x0001217C REC_UBYTE_C 0 COMP_0009 0 199.21875
 /begin AXIS_DESCR COM_AXIS NO_INPUT_QUANTITY COMP_0020 16 0 12750 AXIS_PTS_REF mTKNKNE /end AXIS_DESCR
/end CHARACTERISTIC
/begin CHARACTERISTIC mTKNL1200 "連続No_Load_KMLﾃｰﾌﾞﾙ(軸1200rpm化)" CURVE 0x0001219C REC_UBYTE_C 0 COMP_0330 -128 127
 /begin AXIS_DESCR FIX_AXIS NO_INPUT_QUANTITY COMP_0359_S 16 1200 7200 FIX_AXIS_PAR_DIST 0 1 16 /end AXIS_DESCR
/end CHARACTERISTIC
/begin CHARACTERISTIC mTKNLRNGN "進遅角学習量算出用重み係数テーブル" CURVE 0x00014782 REC_UWORD_C 0 COMP_0360_S 0 1.999970916
 /begin AXIS_DESCR COM_AXIS NO_INPUT_QUANTITY COMP_0006 16 0 819187.5 AXIS_PTS_REF mTRLTRRNE /end AXIS_DESCR
/end CHARACTERISTIC
/begin CHARACTERISTIC mTKNST "回転補正ﾃｰﾌﾞﾙ" CURVE 0x000121AC REC_UBYTE_C 0 COMP_0032 0 0.99609375
 /begin AXIS_DESCR FIX_AXIS NO_INPUT_QUANTITY COMP_0361_S 16 0 1500 FIX_AXIS_PAR_DIST 0 1 16 /end AXIS_DESCR
/end CHARACTERISTIC
/begin CHARACTERISTIC mTKNSTS "成層始動用回転補正ﾃｰﾌﾞﾙ" CURVE 0x000121BC REC_UBYTE_C 0 COMP_0032 0 0.99609375
 /begin AXIS_DESCR FIX_AXIS NO_INPUT_QUANTITY COMP_0361_S 16 0 1500 FIX_AXIS_PAR_DIST 0 1 16 /end AXIS_DESCR
/end CHARACTERISTIC
/begin CHARACTERISTIC mTKPB "差圧補正係数テーブル" CURVE 0x000121CC REC_UBYTE_C 0 COMP_0246 0 1593.75
 /begin AXIS_DESCR FIX_AXIS NO_INPUT_QUANTITY COMP_0246 16 0 93.75 FIX_AXIS_PAR_DIST 0 1 16 /end AXIS_DESCR
/end CHARACTERISTIC
/begin CHARACTERISTIC mTKPBMR "VEL用差圧補正係数ﾃｰﾌﾞﾙ" CURVE 0x000147A2 REC_UWORD_C 0 COMP_0362_S 0 409593.75
 /begin AXIS_DESCR COM_AXIS NO_INPUT_QUANTITY COMP_0363_S 16 0 327.675 AXIS_PTS_REF mJKKPBMR /end AXIS_DESCR
/end CHARACTERISTIC
/begin CHARACTERISTIC mTKPBQH "QH0過給圧補正ﾃｰﾌﾞﾙ" CURVE 0x000121DC REC_UBYTE_C 0 COMP_0044 0 1.9921875
 /begin AXIS_DESCR FIX_AXIS NO_INPUT_QUANTITY COMP_0349_S 16 0 4800 FIX_AXIS_PAR_DIST 0 1 16 /end AXIS_DESCR
/end CHARACTERISTIC
/begin CHARACTERISTIC mTKTETX "一次遅れ重みテーブル" CURVE 0x000147D2 REC_UWORD_C 0 COMP_0364_S 0 0.999985458
 /begin AXIS_DESCR FIX_AXIS NO_INPUT_QUANTITY COMP_0347_S 16 0 6000 FIX_AXIS_PAR_DIST 0 1 16 /end AXIS_DESCR
/end CHARACTERISTIC
/begin CHARACTERISTIC mTLAMHOS "トレース点火時期当量比補正量基本値テーブル" CURVE 0x0001222C REC_UBYTE_C 0 COMP_0365_S 0 63.75
 /begin AXIS_DESCR COM_AXIS NO_INPUT_QUANTITY COMP_0020 16 0 12750 AXIS_PTS_REF mLAMHOSNT /end AXIS_DESCR
/end CHARACTERISTIC
/begin CHARACTERISTIC mTMAXPTQ "エンジン出力可能トルク基本値MAP" CURVE 0x00014852 REC_UWORD_C 0 COMP_0226 -3276.8 3276.7
 /begin AXIS_DESCR COM_AXIS NO_INPUT_QUANTITY COMP_0065 16 0 204796.875 AXIS_PTS_REF mDRTQSPNE /end AXIS_DESCR
/end CHARACTERISTIC
/begin CHARACTERISTIC mTMBTCP "MBT補正量テーブル(Basic_MBT_compensate_value_table_for_intake_and_exhaust_VTC_condition)" CURVE 0x00012284 REC_UBYTE_C 0 COMP_0365_S 0 63.75
 /begin AXIS_DESCR COM_AXIS NO_INPUT_QUANTITY COMP_0266 16 0 127.5 AXIS_PTS_REF mTMBTCA /end AXIS_DESCR
/end CHARACTERISTIC
/begin CHARACTERISTIC mTMFDGTH "AFM機能診断上限故障クライテリアテーブル" CURVE 0x00014872 REC_UWORD_C 0 COMP_0063 0 255.99609375
 /begin AXIS_DESCR COM_AXIS NO_INPUT_QUANTITY COMP_0065 16 0 204796.875 AXIS_PTS_REF mLMFDGNE /end AXIS_DESCR
/end CHARACTERISTIC
/begin CHARACTERISTIC mTMFDGTL "AFM機能診断下限故障クライテリアテーブル" CURVE 0x00014892 REC_UWORD_C 0 COMP_0063 0 255.99609375
 /begin AXIS_DESCR COM_AXIS NO_INPUT_QUANTITY COMP_0065 16 0 204796.875 AXIS_PTS_REF mLMFDGNE /end AXIS_DESCR
/end CHARACTERISTIC
/begin CHARACTERISTIC mTMFPA1 "MFTPA1参照ﾃｰﾌﾞﾙ" CURVE 0x000122D4 REC_UBYTE_C 0 COMP_0001 0 31.875
 /begin AXIS_DESCR FIX_AXIS NO_INPUT_QUANTITY COMP_0357_S 16 400 6400 FIX_AXIS_PAR_DIST 0 1 16 /end AXIS_DESCR
/end CHARACTERISTIC
/begin CHARACTERISTIC mTMFPA3 "MFTPA3参照ﾃｰﾌﾞﾙ" CURVE 0x000122E4 REC_UBYTE_C 0 COMP_0001 0 31.875
 /begin AXIS_DESCR FIX_AXIS NO_INPUT_QUANTITY COMP_0357_S 16 400 6400 FIX_AXIS_PAR_DIST 0 1 16 /end AXIS_DESCR
/end CHARACTERISTIC
/begin CHARACTERISTIC mTMFPC1 "MFPCA1参照用ﾃｰﾌﾞﾙ" CURVE 0x000122F4 REC_UBYTE_C 0 COMP_0001 0 31.875
 /begin AXIS_DESCR FIX_AXIS NO_INPUT_QUANTITY COMP_0357_S 16 400 6400 FIX_AXIS_PAR_DIST 0 1 16 /end AXIS_DESCR
/end CHARACTERISTIC
/begin CHARACTERISTIC mTMFPC2 "MFPCA2参照用ﾃｰﾌﾞﾙ" CURVE 0x00012304 REC_UBYTE_C 0 COMP_0001 0 31.875
 /begin AXIS_DESCR FIX_AXIS NO_INPUT_QUANTITY COMP_0357_S 16 400 6400 FIX_AXIS_PAR_DIST 0 1 16 /end AXIS_DESCR
/end CHARACTERISTIC
/begin CHARACTERISTIC mTMFPC3 "MFPCA3参照用ﾃｰﾌﾞﾙ" CURVE 0x00012314 REC_UBYTE_C 0 COMP_0001 0 31.875
 /begin AXIS_DESCR FIX_AXIS NO_INPUT_QUANTITY COMP_0357_S 16 400 6400 FIX_AXIS_PAR_DIST 0 1 16 /end AXIS_DESCR
/end CHARACTERISTIC
/begin CHARACTERISTIC mTMFPC4 "MFPCA4参照用ﾃｰﾌﾞﾙ" CURVE 0x00012324 REC_UBYTE_C 0 COMP_0001 0 31.875
 /begin AXIS_DESCR FIX_AXIS NO_INPUT_QUANTITY COMP_0357_S 16 400 6400 FIX_AXIS_PAR_DIST 0 1 16 /end AXIS_DESCR
/end CHARACTERISTIC
/begin CHARACTERISTIC mTMFTVLTH "AFM機能診断スロットル下限条件テーブル" CURVE 0x000148B2 REC_UWORD_C 0 COMP_0130 0 1802.2125
 /begin AXIS_DESCR COM_AXIS NO_INPUT_QUANTITY COMP_0065 16 0 204796.875 AXIS_PTS_REF mLMFDGNE /end AXIS_DESCR
/end CHARACTERISTIC
/begin CHARACTERISTIC mTMKTW "ﾏｲﾅｽKTW_基本値テーブル" CURVE 0x00011546 REC_SBYTE_C 0 COMP_0338 -2 1.984375
 /begin AXIS_DESCR FIX_AXIS NO_INPUT_QUANTITY COMP_0348_S 16 -40 110 FIX_AXIS_PAR_DIST 0 1 16 /end AXIS_DESCR
/end CHARACTERISTIC
/begin CHARACTERISTIC mTNC "BOSCHｶｯﾄ回転数ﾃｰﾌﾞﾙ" CURVE 0x0001238C REC_UBYTE_C 0 COMP_0000 0 6375
 /begin AXIS_DESCR FIX_AXIS NO_INPUT_QUANTITY COMP_0348_S 16 -40 110 FIX_AXIS_PAR_DIST 0 1 16 /end AXIS_DESCR
/end CHARACTERISTIC
/begin CHARACTERISTIC mTNGRATIO "ISC_F/B_開始切替許可変速比テーブル(Gear_ratio_table_for_ISC_F/B_starting_speed_change_permission)" CURVE 0x00014912 REC_UWORD_C 0 COMP_0450 0 63.999056205
 /begin AXIS_DESCR FIX_AXIS NO_INPUT_QUANTITY COMP_0007 16 0 30 FIX_AXIS_PAR_DIST 0 1 16 /end AXIS_DESCR
/end CHARACTERISTIC
/begin CHARACTERISTIC mTNJC "JECSｶｯﾄ回転数ﾃｰﾌﾞﾙ" CURVE 0x000123DC REC_UBYTE_C 0 COMP_0000 0 6375
 /begin AXIS_DESCR FIX_AXIS NO_INPUT_QUANTITY COMP_0348_S 16 -40 110 FIX_AXIS_PAR_DIST 0 1 16 /end AXIS_DESCR
/end CHARACTERISTIC
/begin CHARACTERISTIC mTNMEMDH "Dレンジアイドル回転数高目設定値テーブル" CURVE 0x000123EC REC_UBYTE_C 0 COMP_0006 0 3187.5
 /begin AXIS_DESCR FIX_AXIS NO_INPUT_QUANTITY COMP_0348_S 16 -40 110 FIX_AXIS_PAR_DIST 0 1 16 /end AXIS_DESCR
/end CHARACTERISTIC
/begin CHARACTERISTIC mTNMEMDL "Dレンジアイドル回転数低目設定値テーブル" CURVE 0x000123FC REC_UBYTE_C 0 COMP_0006 0 3187.5
 /begin AXIS_DESCR FIX_AXIS NO_INPUT_QUANTITY COMP_0348_S 16 -40 110 FIX_AXIS_PAR_DIST 0 1 16 /end AXIS_DESCR
/end CHARACTERISTIC
/begin CHARACTERISTIC mTNMEMN "Nレンジアイドル回転数設定値テーブル" CURVE 0x00012414 REC_UBYTE_C 0 COMP_0006 0 3187.5
 /begin AXIS_DESCR FIX_AXIS NO_INPUT_QUANTITY COMP_0348_S 16 -40 110 FIX_AXIS_PAR_DIST 0 1 16 /end AXIS_DESCR
/end CHARACTERISTIC
/begin CHARACTERISTIC mTNMEMNH "Nレンジアイドル回転数高目設定値テーブル(N_range_idle_speed_high_side_setting_value_table)" CURVE 0x00012424 REC_UBYTE_C 0 COMP_0006 0 3187.5
 /begin AXIS_DESCR FIX_AXIS NO_INPUT_QUANTITY COMP_0348_S 16 -40 110 FIX_AXIS_PAR_DIST 0 1 16 /end AXIS_DESCR
/end CHARACTERISTIC
/begin CHARACTERISTIC mTNQD "DレンジNSET0保持空気量テーブル" CURVE 0x00012444 REC_UBYTE_C 0 COMP_0340 0 510
 /begin AXIS_DESCR FIX_AXIS NO_INPUT_QUANTITY COMP_0361_S 16 0 1500 FIX_AXIS_PAR_DIST 0 1 16 /end AXIS_DESCR
/end CHARACTERISTIC
/begin CHARACTERISTIC mTNQDB "NﾚﾝｼﾞNSET0保持空気量ﾃｰﾌﾞﾙ(4気筒、格子拡大)" CURVE 0x00012454 REC_UBYTE_C 0 COMP_0293 0 510
 /begin AXIS_DESCR COM_AXIS NO_INPUT_QUANTITY COMP_0006 16 0 3187.5 AXIS_PTS_REF mTNQAX /end AXIS_DESCR
/end CHARACTERISTIC
/begin CHARACTERISTIC mTNQN "NレンジNSET0保持空気量テーブル" CURVE 0x00012464 REC_UBYTE_C 0 COMP_0340 0 510
 /begin AXIS_DESCR FIX_AXIS NO_INPUT_QUANTITY COMP_0361_S 16 0 1500 FIX_AXIS_PAR_DIST 0 1 16 /end AXIS_DESCR
/end CHARACTERISTIC
/begin CHARACTERISTIC mTNQNB "NﾚﾝｼﾞNSET0保持空気量ﾃｰﾌﾞﾙ(4気筒、格子拡大)" CURVE 0x00012474 REC_UBYTE_C 0 COMP_0293 0 510
 /begin AXIS_DESCR COM_AXIS NO_INPUT_QUANTITY COMP_0006 16 0 3187.5 AXIS_PTS_REF mTNQAX /end AXIS_DESCR
/end CHARACTERISTIC
/begin CHARACTERISTIC mTNQNCN "非クリアニュートラル_Nアイドル時NSET0保持空気量テーブル" CURVE 0x00012484 REC_UBYTE_C 0 COMP_0276 0 1020
 /begin AXIS_DESCR FIX_AXIS NO_INPUT_QUANTITY COMP_0361_S 16 0 1500 FIX_AXIS_PAR_DIST 0 1 16 /end AXIS_DESCR
/end CHARACTERISTIC
/begin CHARACTERISTIC mTNQND "減量補正基準値ﾃｰﾌﾞﾙ" CURVE 0x00012494 REC_UBYTE_C 0 COMP_0293 0 510
 /begin AXIS_DESCR FIX_AXIS NO_INPUT_QUANTITY COMP_0361_S 16 0 1500 FIX_AXIS_PAR_DIST 0 1 16 /end AXIS_DESCR
/end CHARACTERISTIC
/begin CHARACTERISTIC mTNR "JECSｶｯﾄﾘｶﾊﾞｰ回転数ﾃｰﾌﾞﾙ" CURVE 0x000124A4 REC_UBYTE_C 0 COMP_0000 0 6375
 /begin AXIS_DESCR FIX_AXIS NO_INPUT_QUANTITY COMP_0348_S 16 -40 110 FIX_AXIS_PAR_DIST 0 1 16 /end AXIS_DESCR
/end CHARACTERISTIC
/begin CHARACTERISTIC mTNSETB "ブレーキ_OFF_時_NSET00_下限値テーブル" CURVE 0x000124B4 REC_UBYTE_C 0 COMP_0006 0 3187.5
 /begin AXIS_DESCR FIX_AXIS NO_INPUT_QUANTITY COMP_0007 16 0 30 FIX_AXIS_PAR_DIST 0 1 16 /end AXIS_DESCR
/end CHARACTERISTIC
/begin CHARACTERISTIC mTOCTINC "進角側ｵｸﾀﾝ価増加量ﾃｰﾌﾞﾙ" CURVE 0x000124C4 REC_UBYTE_C 0 COMP_0366_S 0 0.124511655
 /begin AXIS_DESCR COM_AXIS NO_INPUT_QUANTITY COMP_0020 16 0 12750 AXIS_PTS_REF mTADVTRSN /end AXIS_DESCR
/end CHARACTERISTIC
/begin CHARACTERISTIC mTPASNOK "PASNOK参照ﾃｰﾌﾞﾙ" CURVE 0x000124EC REC_UBYTE_C 0 COMP_0054 0 5100
 /begin AXIS_DESCR COM_AXIS NO_INPUT_QUANTITY COMP_0047 16 0 127.5 AXIS_PTS_REF mTPASOK /end AXIS_DESCR
/end CHARACTERISTIC
/begin CHARACTERISTIC mTPBFC "PB燃料ｶｯﾄ判定PBﾃｰﾌﾞﾙ" CURVE 0x0001250C REC_UBYTE_C 0 COMP_0054 0 5100
 /begin AXIS_DESCR FIX_AXIS NO_INPUT_QUANTITY COMP_0347_S 16 0 6000 FIX_AXIS_PAR_DIST 0 1 16 /end AXIS_DESCR
/end CHARACTERISTIC
/begin CHARACTERISTIC mTPBREC "PB燃料ｶｯﾄﾘｶﾊﾞｰ判定PBﾃｰﾌﾞﾙ" CURVE 0x0001251C REC_UBYTE_C 0 COMP_0054 0 5100
 /begin AXIS_DESCR FIX_AXIS NO_INPUT_QUANTITY COMP_0347_S 16 0 6000 FIX_AXIS_PAR_DIST 0 1 16 /end AXIS_DESCR
/end CHARACTERISTIC
/begin CHARACTERISTIC mTPDLE1_S "エコモードペダル特性テーブル1(副演算部)(Eco_mode_pedal_curve_table1_(sub_calculation_part))" CURVE 0x000165C4 REC_UWORD_C 0 COMP_0032_S 0 8191.875
 /begin AXIS_DESCR COM_AXIS NO_INPUT_QUANTITY COMP_0032_S 16 0 8191.875 AXIS_PTS_REF mTPDLAP_S /end AXIS_DESCR
/end CHARACTERISTIC
/begin CHARACTERISTIC mTPDLE2_S "エコモードペダル特性テーブル2(副演算部)(_Eco_mode_pedal_curve_table_2_(sub_calculation_part))" CURVE 0x000165E4 REC_UWORD_C 0 COMP_0032_S 0 8191.875
 /begin AXIS_DESCR COM_AXIS NO_INPUT_QUANTITY COMP_0032_S 16 0 8191.875 AXIS_PTS_REF mTPDLAP_S /end AXIS_DESCR
/end CHARACTERISTIC
/begin CHARACTERISTIC mTPDLECO1 "エコモード（ｵﾌﾛｰﾄﾞSW：岩）ペダル特性テーブル1(Not_Defined)" CURVE 0x000149E2 REC_UWORD_C 0 COMP_0032_S 0 8191.875
 /begin AXIS_DESCR COM_AXIS NO_INPUT_QUANTITY COMP_0032_S 16 0 8191.875 AXIS_PTS_REF mTPDLAPBP /end AXIS_DESCR
/end CHARACTERISTIC
/begin CHARACTERISTIC mTPDLECO2 "エコモード（ｵﾌﾛｰﾄﾞSW：岩）ペダル特性テーブル2(Not_Defined)" CURVE 0x00014A02 REC_UWORD_C 0 COMP_0032_S 0 8191.875
 /begin AXIS_DESCR COM_AXIS NO_INPUT_QUANTITY COMP_0032_S 16 0 8191.875 AXIS_PTS_REF mTPDLAPBP /end AXIS_DESCR
/end CHARACTERISTIC
/begin CHARACTERISTIC mTPDLLMT1 "アクセル開度変化量リミッタテーブル1(Not_Defined)" CURVE 0x00014A22 REC_UWORD_C 0 COMP_0100_S 0 511.9921875
 /begin AXIS_DESCR COM_AXIS NO_INPUT_QUANTITY COMP_0032_S 16 0 8191.875 AXIS_PTS_REF mTPDLAPBP /end AXIS_DESCR
/end CHARACTERISTIC
/begin CHARACTERISTIC mTPDLLMT2 "アクセル開度変化量リミッタテーブル2(Not_Defined)" CURVE 0x00014A42 REC_UWORD_C 0 COMP_0100_S 0 511.9921875
 /begin AXIS_DESCR COM_AXIS NO_INPUT_QUANTITY COMP_0032_S 16 0 8191.875 AXIS_PTS_REF mTPDLAPBP /end AXIS_DESCR
/end CHARACTERISTIC
/begin CHARACTERISTIC mTPDLS1_S "スポーツモードペダル特性テーブル1(副演算部)(Sports_mode_pedal_curve_1_(sub_calculation_part))" CURVE 0x00016604 REC_UWORD_C 0 COMP_0032_S 0 8191.875
 /begin AXIS_DESCR COM_AXIS NO_INPUT_QUANTITY COMP_0032_S 16 0 8191.875 AXIS_PTS_REF mTPDLAP_S /end AXIS_DESCR
/end CHARACTERISTIC
/begin CHARACTERISTIC mTPDLS2_S "スポーツモードペダル特性テーブル2(副演算部)(Sports_mode_pedal_curve_1_(sub_calculation_part))" CURVE 0x00016624 REC_UWORD_C 0 COMP_0032_S 0 8191.875
 /begin AXIS_DESCR COM_AXIS NO_INPUT_QUANTITY COMP_0032_S 16 0 8191.875 AXIS_PTS_REF mTPDLAP_S /end AXIS_DESCR
/end CHARACTERISTIC
/begin CHARACTERISTIC mTPDLSPT1 "スポーツモード（ｵﾌﾛｰﾄﾞSW：砂）ペダル特性テーブル1(Not_Defined)" CURVE 0x00014A62 REC_UWORD_C 0 COMP_0032_S 0 8191.875
 /begin AXIS_DESCR COM_AXIS NO_INPUT_QUANTITY COMP_0032_S 16 0 8191.875 AXIS_PTS_REF mTPDLAPBP /end AXIS_DESCR
/end CHARACTERISTIC
/begin CHARACTERISTIC mTPDLSPT2 "スポーツモード（ｵﾌﾛｰﾄﾞSW：砂）ペダル特性テーブル2(Not_Defined)" CURVE 0x00014A82 REC_UWORD_C 0 COMP_0032_S 0 8191.875
 /begin AXIS_DESCR COM_AXIS NO_INPUT_QUANTITY COMP_0032_S 16 0 8191.875 AXIS_PTS_REF mTPDLAPBP /end AXIS_DESCR
/end CHARACTERISTIC
/begin CHARACTERISTIC mTPIADST0 "成層始動時当量比操作量補正ﾃｰﾌﾞﾙ<ｵﾌｱｲﾄﾞﾙ>" CURVE 0x00014AA2 REC_UWORD_C 0 COMP_0009 0 51199.21875
 /begin AXIS_DESCR COM_AXIS NO_INPUT_QUANTITY COMP_0217 16 0 3.999941832 AXIS_PTS_REF mTPIADSTG /end AXIS_DESCR
/end CHARACTERISTIC
/begin CHARACTERISTIC mTPIADST1 "成層始動時当量比操作量補正ﾃｰﾌﾞﾙ<ｱｲﾄﾞﾙ>" CURVE 0x00014AC2 REC_UWORD_C 0 COMP_0009 0 51199.21875
 /begin AXIS_DESCR COM_AXIS NO_INPUT_QUANTITY COMP_0217 16 0 3.999941832 AXIS_PTS_REF mTPIADSTG /end AXIS_DESCR
/end CHARACTERISTIC
/begin CHARACTERISTIC mTPIPHI "当量比操作量演算テーブル" CURVE 0x00014B22 REC_UWORD_C 0 COMP_0043 0 63.999056205
 /begin AXIS_DESCR COM_AXIS NO_INPUT_QUANTITY COMP_0009 16 0 51199.21875 AXIS_PTS_REF mTISCPI /end AXIS_DESCR
/end CHARACTERISTIC
/begin CHARACTERISTIC mTPMNOF "AFM機能診断用診断パラメータオフセットテーブル" CURVE 0x00014B62 REC_UWORD_C 0 COMP_0367_S -128 127.99609375
 /begin AXIS_DESCR COM_AXIS NO_INPUT_QUANTITY COMP_0065 16 0 204796.875 AXIS_PTS_REF mLMFDGNE /end AXIS_DESCR
/end CHARACTERISTIC
/begin CHARACTERISTIC mTPOIN1 "軽負荷高回転域燃料ｶｯﾄ領域1判定用ﾃｰﾌﾞﾙ(The_table_for_low_load_quantity_rotation_region_fuel_cut_domain_1_judgment)" CURVE 0x00012554 REC_UBYTE_C 0 COMP_0001 0 31.875
 /begin AXIS_DESCR FIX_AXIS NO_INPUT_QUANTITY COMP_0368_S 16 2000 8000 FIX_AXIS_PAR_DIST 0 1 16 /end AXIS_DESCR
/end CHARACTERISTIC
/begin CHARACTERISTIC mTPOIN2 "軽負荷高回転域燃料ｶｯﾄ領域2判定用ﾃｰﾌﾞﾙ(The_table_for_low_load_quantity_rotation_region_fuel_cut_domain_2_judgment)" CURVE 0x00012564 REC_UBYTE_C 0 COMP_0001 0 31.875
 /begin AXIS_DESCR FIX_AXIS NO_INPUT_QUANTITY COMP_0368_S 16 2000 8000 FIX_AXIS_PAR_DIST 0 1 16 /end AXIS_DESCR
/end CHARACTERISTIC
/begin CHARACTERISTIC mTPOLOU "軽負荷高回転域燃料ｶｯﾄﾘｶﾊﾞｰ判定用ﾃｰﾌﾞﾙ(The_table_for_a_low_load_quantity_rotation_region_fuel_cut_recovery_judging)" CURVE 0x00012574 REC_UBYTE_C 0 COMP_0001 0 31.875
 /begin AXIS_DESCR FIX_AXIS NO_INPUT_QUANTITY COMP_0368_S 16 2000 8000 FIX_AXIS_PAR_DIST 0 1 16 /end AXIS_DESCR
/end CHARACTERISTIC
/begin CHARACTERISTIC mTPSCV1 "SCVTP条件ﾃｰﾌﾞﾙ１" CURVE 0x00012584 REC_UBYTE_C 0 COMP_0001 0 31.875
 /begin AXIS_DESCR FIX_AXIS NO_INPUT_QUANTITY COMP_0347_S 16 0 6000 FIX_AXIS_PAR_DIST 0 1 16 /end AXIS_DESCR
/end CHARACTERISTIC
/begin CHARACTERISTIC mTPSCV2 "SCVTP条件ﾃｰﾌﾞﾙ２" CURVE 0x00012594 REC_UBYTE_C 0 COMP_0001 0 31.875
 /begin AXIS_DESCR FIX_AXIS NO_INPUT_QUANTITY COMP_0347_S 16 0 6000 FIX_AXIS_PAR_DIST 0 1 16 /end AXIS_DESCR
/end CHARACTERISTIC
/begin CHARACTERISTIC mTQBCV "負圧制御空気流量テーブル" CURVE 0x000125C4 REC_UBYTE_C 0 COMP_0276 0 1020
 /begin AXIS_DESCR FIX_AXIS NO_INPUT_QUANTITY COMP_0347_S 16 0 6000 FIX_AXIS_PAR_DIST 0 1 16 /end AXIS_DESCR
/end CHARACTERISTIC
/begin CHARACTERISTIC mTQCINDHL "中水温時アイドル回転低下時補填空気流量テーブル" CURVE 0x000125D8 REC_UBYTE_C 0 COMP_0051 0 255
 /begin AXIS_DESCR FIX_AXIS NO_INPUT_QUANTITY COMP_0348_S 16 -40 110 FIX_AXIS_PAR_DIST 0 1 16 /end AXIS_DESCR
/end CHARACTERISTIC
/begin CHARACTERISTIC mTQH0H "TVO_N流量テーブル高流量" CURVE 0x00014BF2 REC_UWORD_C 0 COMP_0290 0 0.999985458
 /begin AXIS_DESCR FIX_AXIS NO_INPUT_QUANTITY COMP_0369_S 16 0.000001394 0.0000069725 FIX_AXIS_PAR_DIST 0 1 16 /end AXIS_DESCR
/end CHARACTERISTIC
/begin CHARACTERISTIC mTQH0L "TVO_N流量テーブル低流量" CURVE 0x00014C12 REC_UWORD_C 0 COMP_0290 0 0.999985458
 /begin AXIS_DESCR FIX_AXIS NO_INPUT_QUANTITY COMP_0370_S 16 0 0.00000139455 FIX_AXIS_PAR_DIST 0 1 16 /end AXIS_DESCR
/end CHARACTERISTIC
/begin CHARACTERISTIC mTQH0LMT "QH0上限テーブル" CURVE 0x00014C32 REC_UWORD_C 0 COMP_0146 0 99.998480265
 /begin AXIS_DESCR FIX_AXIS NO_INPUT_QUANTITY COMP_0347_S 16 0 6000 FIX_AXIS_PAR_DIST 0 1 16 /end AXIS_DESCR
/end CHARACTERISTIC
/begin CHARACTERISTIC mTQH0WOT "高回転車種用WOT時標準状態QH0回転数テーブル" CURVE 0x0001262C REC_UBYTE_C 0 COMP_0063 0 0.99609375
 /begin AXIS_DESCR COM_AXIS NO_INPUT_QUANTITY COMP_0020 16 0 12750 AXIS_PTS_REF mTITACNE /end AXIS_DESCR
/end CHARACTERISTIC
/begin CHARACTERISTIC mTQHOS "空気量補正係数(ﾊﾞﾝｸ1)" CURVE 0x00014C62 REC_UWORD_C 0 COMP_0045 0 511.9921875
 /begin AXIS_DESCR COM_AXIS NO_INPUT_QUANTITY COMP_0068 16 0 65535 AXIS_PTS_REF mLTQHOS /end AXIS_DESCR
/end CHARACTERISTIC
/begin CHARACTERISTIC mTQHOS2 "空気量補正係数(ﾊﾞﾝｸ2)" CURVE 0x00014C82 REC_UWORD_C 0 COMP_0045 0 511.9921875
 /begin AXIS_DESCR COM_AXIS NO_INPUT_QUANTITY COMP_0068 16 0 65535 AXIS_PTS_REF mLTQHOS /end AXIS_DESCR
/end CHARACTERISTIC
/begin CHARACTERISTIC mTQZIKI "QZIKKIテーブル" CURVE 0x00014D12 REC_UWORD_C 0 COMP_0004 0 65535
 /begin AXIS_DESCR FIX_AXIS NO_INPUT_QUANTITY COMP_0348_S 16 -40 110 FIX_AXIS_PAR_DIST 0 1 16 /end AXIS_DESCR
/end CHARACTERISTIC
/begin CHARACTERISTIC mTREC "BOSCHｶｯﾄﾘｶﾊﾞｰ回転ﾃｰﾌﾞﾙ" CURVE 0x0001267C REC_UBYTE_C 0 COMP_0000 0 6375
 /begin AXIS_DESCR FIX_AXIS NO_INPUT_QUANTITY COMP_0348_S 16 -40 110 FIX_AXIS_PAR_DIST 0 1 16 /end AXIS_DESCR
/end CHARACTERISTIC
/begin CHARACTERISTIC mTRLTRR "トレース点－オクタン価感度テーブル" CURVE 0x00014E56 REC_UWORD_C 0 COMP_0371_S 0 3.999928725
 /begin AXIS_DESCR COM_AXIS NO_INPUT_QUANTITY COMP_0006 16 0 819187.5 AXIS_PTS_REF mTRLTRRNE /end AXIS_DESCR
/end CHARACTERISTIC
/begin CHARACTERISTIC mTRONDEC "遅角側オクタン価減少量テーブル" CURVE 0x000126CA REC_UBYTE_C 0 COMP_0372_S 0 24.9023565
 /begin AXIS_DESCR COM_AXIS NO_INPUT_QUANTITY COMP_0020 16 0 12750 AXIS_PTS_REF mTADVTRSN /end AXIS_DESCR
/end CHARACTERISTIC
/begin CHARACTERISTIC mTRONHYS "燃料判定用ヒステリシステーブル" CURVE 0x000126DA REC_UBYTE_C 0 COMP_0235_S 0 31.875
 /begin AXIS_DESCR COM_AXIS NO_INPUT_QUANTITY COMP_0020 16 0 12750 AXIS_PTS_REF mTRONNE /end AXIS_DESCR
/end CHARACTERISTIC
/begin CHARACTERISTIC mTRONJH "ハイオク判定用オクタン価テーブル" CURVE 0x000126EA REC_UBYTE_C 0 COMP_0201_S 75 106.875
 /begin AXIS_DESCR COM_AXIS NO_INPUT_QUANTITY COMP_0020 16 0 12750 AXIS_PTS_REF mTRONNE /end AXIS_DESCR
/end CHARACTERISTIC
/begin CHARACTERISTIC mTRONLML "低オクタン価リミッタテーブル" CURVE 0x00014EA6 REC_UWORD_C 0 COMP_0235_S 0 8191.875
 /begin AXIS_DESCR COM_AXIS NO_INPUT_QUANTITY COMP_0020 16 0 3276750 AXIS_PTS_REF mRONLMSN /end AXIS_DESCR
/end CHARACTERISTIC
/begin CHARACTERISTIC mTRPAMB "RPAMB参照テーブル" CURVE 0x0001270A REC_UBYTE_C 0 COMP_0044 0 1.9921875
 /begin AXIS_DESCR COM_AXIS NO_INPUT_QUANTITY COMP_0054 16 0 5100 AXIS_PTS_REF mLPAMB /end AXIS_DESCR
/end CHARACTERISTIC
/begin CHARACTERISTIC mTRTT "TDMテーブル" CURVE 0x00012722 REC_UBYTE_C 0 COMP_0017 0 255
 /begin AXIS_DESCR FIX_AXIS NO_INPUT_QUANTITY COMP_0246 16 0 93.75 FIX_AXIS_PAR_DIST 0 1 16 /end AXIS_DESCR
/end CHARACTERISTIC
/begin CHARACTERISTIC mTSNWP1_S "スノーモードペダル特性テーブル1（副演算部）" CURVE 0x000166CE REC_UWORD_C 0 COMP_0032_S 0 8191.875
 /begin AXIS_DESCR COM_AXIS NO_INPUT_QUANTITY COMP_0032_S 16 0 8191.875 AXIS_PTS_REF mTPDLAP_S /end AXIS_DESCR
/end CHARACTERISTIC
/begin CHARACTERISTIC mTSNWP2_S "スノーモードペダル特性テーブル2（副演算部）" CURVE 0x000166EE REC_UWORD_C 0 COMP_0032_S 0 8191.875
 /begin AXIS_DESCR COM_AXIS NO_INPUT_QUANTITY COMP_0032_S 16 0 8191.875 AXIS_PTS_REF mTPDLAP_S /end AXIS_DESCR
/end CHARACTERISTIC
/begin CHARACTERISTIC mTSNWPDL1 "スノーモードペダル特性テーブル1" CURVE 0x00014F30 REC_UWORD_C 0 COMP_0032_S 0 8191.875
 /begin AXIS_DESCR COM_AXIS NO_INPUT_QUANTITY COMP_0032_S 16 0 8191.875 AXIS_PTS_REF mTPDLAPBP /end AXIS_DESCR
/end CHARACTERISTIC
/begin CHARACTERISTIC mTSNWPDL2 "スノーモードペダル特性テーブル2" CURVE 0x00014F50 REC_UWORD_C 0 COMP_0032_S 0 8191.875
 /begin AXIS_DESCR COM_AXIS NO_INPUT_QUANTITY COMP_0032_S 16 0 8191.875 AXIS_PTS_REF mTPDLAPBP /end AXIS_DESCR
/end CHARACTERISTIC
/begin CHARACTERISTIC mTSQRTTAN "ｽﾛｯﾄﾙ上流温度ﾙｰﾄﾃｰﾌﾞﾙ" CURVE 0x00014F70 REC_UWORD_C 0 COMP_0466 0 31.999495335
 /begin AXIS_DESCR COM_AXIS NO_INPUT_QUANTITY COMP_0373_S 16 -50 65485 AXIS_PTS_REF mSQRTTAN /end AXIS_DESCR
/end CHARACTERISTIC
/begin CHARACTERISTIC mTSTKIVCN "IVC時ストローク量テーブル" CURVE 0x00014FA0 REC_UWORD_C 0 COMP_0374_S 0 655.35
 /begin AXIS_DESCR COM_AXIS NO_INPUT_QUANTITY COMP_0108_S 16 -16384 16383.5 AXIS_PTS_REF mVTCSTRKN /end AXIS_DESCR
/end CHARACTERISTIC
/begin CHARACTERISTIC mTSTNGTM "エンジン停止気筒判別失敗判定しきい値" CURVE 0x000127A2 REC_UBYTE_C 0 COMP_0008 0 25500
 /begin AXIS_DESCR FIX_AXIS NO_INPUT_QUANTITY COMP_0348_S 16 -40 110 FIX_AXIS_PAR_DIST 0 1 16 /end AXIS_DESCR
/end CHARACTERISTIC
/begin CHARACTERISTIC mTSTTMINSN "水温格子細分化＿始動時水温参照＿始動判定時間テーブル（Segmentalized_grid_starting_judgment_time_table_(refer_to_coolant_" CURVE 0x000127B2 REC_UBYTE_C 0 COMP_0008 0 25500
 /begin AXIS_DESCR COM_AXIS NO_INPUT_QUANTITY COMP_0356 16 -40 119.375 AXIS_PTS_REF mTWKINT16 /end AXIS_DESCR
/end CHARACTERISTIC
/begin CHARACTERISTIC mTSWSTADV "状態切り替え用進角量テーブル" CURVE 0x00014FC0 REC_UWORD_C 0 COMP_0375_S -30 33.99899067
 /begin AXIS_DESCR COM_AXIS NO_INPUT_QUANTITY COMP_0006 16 0 819187.5 AXIS_PTS_REF mTSWSTNE /end AXIS_DESCR
/end CHARACTERISTIC
/begin CHARACTERISTIC mTSWSTRET "状態切り替え用遅角量テーブル" CURVE 0x00015000 REC_UWORD_C 0 COMP_0375_S -30 33.99899067
 /begin AXIS_DESCR COM_AXIS NO_INPUT_QUANTITY COMP_0006 16 0 819187.5 AXIS_PTS_REF mTSWSTNE /end AXIS_DESCR
/end CHARACTERISTIC
/begin CHARACTERISTIC mTTANFAC "エンジン出力可能トルク吸気温補正係数マップ" CURVE 0x00015020 REC_UWORD_C 0 COMP_0334_S 0 1599.9780435
 /begin AXIS_DESCR COM_AXIS NO_INPUT_QUANTITY COMP_0069_S 16 -50 65485 AXIS_PTS_REF mTAFCTABP /end AXIS_DESCR
/end CHARACTERISTIC
/begin CHARACTERISTIC mTTFBYAMK "TFBYAMK選択用テーブル（TFBYAMK_selectin_table）" CURVE 0x000128C6 REC_UBYTE_C 0 COMP_0068 0 255
 /begin AXIS_DESCR COM_AXIS NO_INPUT_QUANTITY COMP_0020 16 0 12750 AXIS_PTS_REF mTFBYAMKN /end AXIS_DESCR
/end CHARACTERISTIC
/begin CHARACTERISTIC mTTFDMAX "MAX駆動力テーブル" CURVE 0x00015070 REC_UWORD_C 0 COMP_0315_S -32768 32767
 /begin AXIS_DESCR COM_AXIS NO_INPUT_QUANTITY COMP_0436 16 0 6553.5 AXIS_PTS_REF mTFDVSPBP /end AXIS_DESCR
/end CHARACTERISTIC
/begin CHARACTERISTIC mTTFDMIN "MIN駆動力テーブル" CURVE 0x00015090 REC_UWORD_C 0 COMP_0315_S -32768 32767
 /begin AXIS_DESCR COM_AXIS NO_INPUT_QUANTITY COMP_0436 16 0 6553.5 AXIS_PTS_REF mTFDVSPBP /end AXIS_DESCR
/end CHARACTERISTIC
/begin CHARACTERISTIC mTTMEVP "始動後診断禁止時間" CURVE 0x00012912 REC_UBYTE_C 0 COMP_0096 0 2550
 /begin AXIS_DESCR FIX_AXIS NO_INPUT_QUANTITY COMP_0348_S 16 -40 110 FIX_AXIS_PAR_DIST 0 1 16 /end AXIS_DESCR
/end CHARACTERISTIC
/begin CHARACTERISTIC mTTNKAS "始動後回転補正ﾃｰﾌﾞﾙ" CURVE 0x0001292E REC_UBYTE_C 0 COMP_0066 0 3.984375
 /begin AXIS_DESCR FIX_AXIS NO_INPUT_QUANTITY COMP_0354_S 16 0 3000 FIX_AXIS_PAR_DIST 0 1 16 /end AXIS_DESCR
/end CHARACTERISTIC
/begin CHARACTERISTIC mTTPFC "TP燃料ｶｯﾄ判定TPﾃｰﾌﾞﾙ" CURVE 0x0001295E REC_UBYTE_C 0 COMP_0001 0 31.875
 /begin AXIS_DESCR FIX_AXIS NO_INPUT_QUANTITY COMP_0347_S 16 0 6000 FIX_AXIS_PAR_DIST 0 1 16 /end AXIS_DESCR
/end CHARACTERISTIC
/begin CHARACTERISTIC mTTPMAX4N "TP4最大値" CURVE 0x000152D0 REC_UWORD_C 0 COMP_0001 0 8191.875
 /begin AXIS_DESCR COM_AXIS NO_INPUT_QUANTITY COMP_0000 16 0 1638375 AXIS_PTS_REF mMNRPM /end AXIS_DESCR
/end CHARACTERISTIC
/begin CHARACTERISTIC mTTPMF1 "TPMFR参照用ﾃｰﾌﾞﾙ" CURVE 0x0001297E REC_UBYTE_C 0 COMP_0001 0 31.875
 /begin AXIS_DESCR FIX_AXIS NO_INPUT_QUANTITY COMP_0357_S 16 400 6400 FIX_AXIS_PAR_DIST 0 1 16 /end AXIS_DESCR
/end CHARACTERISTIC
/begin CHARACTERISTIC mTTPREC "TP燃料ｶｯﾄﾘｶﾊﾞｰ判定TPﾃｰﾌﾞﾙ" CURVE 0x0001298E REC_UBYTE_C 0 COMP_0001 0 31.875
 /begin AXIS_DESCR FIX_AXIS NO_INPUT_QUANTITY COMP_0347_S 16 0 6000 FIX_AXIS_PAR_DIST 0 1 16 /end AXIS_DESCR
/end CHARACTERISTIC
/begin CHARACTERISTIC mTTPUREB "P/Reg応答時間ﾃｰﾌﾞﾙ" CURVE 0x00015310 REC_UWORD_C 0 COMP_0152_S 0 419424
 /begin AXIS_DESCR COM_AXIS NO_INPUT_QUANTITY COMP_0314_S 16 0 20479.6875 AXIS_PTS_REF mLTPV /end AXIS_DESCR
/end CHARACTERISTIC
/begin CHARACTERISTIC mTTRQRTO "ﾄﾙｺﾝﾄﾙｸ比ﾃｰﾌﾞﾙ" CURVE 0x00015420 REC_UWORD_C 0 COMP_0450 0 63.999056205
 /begin AXIS_DESCR FIX_AXIS NO_INPUT_QUANTITY COMP_0376_S 16 0 0.9 FIX_AXIS_PAR_DIST 0 1 16 /end AXIS_DESCR
/end CHARACTERISTIC
/begin CHARACTERISTIC mTTRQRT_S "ﾄﾙｺﾝﾄﾙｸ比ﾃｰﾌﾞﾙ" CURVE 0x0001675E REC_UWORD_C 0 COMP_0450 0 63.999056205
 /begin AXIS_DESCR FIX_AXIS NO_INPUT_QUANTITY COMP_0376_S 16 0 0.9 FIX_AXIS_PAR_DIST 0 1 16 /end AXIS_DESCR
/end CHARACTERISTIC
/begin CHARACTERISTIC mTTST "始動時噴射パルス幅ﾃｰﾌﾞﾙ" CURVE 0x000129C2 REC_UBYTE_C 0 COMP_0053 0 255
 /begin AXIS_DESCR FIX_AXIS NO_INPUT_QUANTITY COMP_0348_S 16 -40 110 FIX_AXIS_PAR_DIST 0 1 16 /end AXIS_DESCR
/end CHARACTERISTIC
/begin CHARACTERISTIC mTTSTSTR "成層始動時噴射パルス幅ﾃｰﾌﾞﾙ" CURVE 0x000129D2 REC_UBYTE_C 0 COMP_0053 0 255
 /begin AXIS_DESCR FIX_AXIS NO_INPUT_QUANTITY COMP_0348_S 16 -40 110 FIX_AXIS_PAR_DIST 0 1 16 /end AXIS_DESCR
/end CHARACTERISTIC
/begin CHARACTERISTIC mTTTR "ベーストルクテーブル" CURVE 0x000129E2 REC_UBYTE_C 0 COMP_0009 0 199.21875
 /begin AXIS_DESCR FIX_AXIS NO_INPUT_QUANTITY COMP_0055 16 0 60 FIX_AXIS_PAR_DIST 0 1 16 /end AXIS_DESCR
/end CHARACTERISTIC
/begin CHARACTERISTIC mTTVOFI "全閉位置水温補正テーブル" CURVE 0x00012A02 REC_UBYTE_C 0 COMP_0023 0 1275
 /begin AXIS_DESCR FIX_AXIS NO_INPUT_QUANTITY COMP_0348_S 16 -40 110 FIX_AXIS_PAR_DIST 0 1 16 /end AXIS_DESCR
/end CHARACTERISTIC
/begin CHARACTERISTIC mTTWGLST "WG開口面積→ロッドストローク換算テーブル" CURVE 0x00015440 REC_UWORD_C 0 COMP_0377_S 0 0.0204796875
 /begin AXIS_DESCR COM_AXIS NO_INPUT_QUANTITY COMP_0378_S 16 0 0.0013107 AXIS_PTS_REF mLTWGA /end AXIS_DESCR
/end CHARACTERISTIC
/begin CHARACTERISTIC mTTWISC "水温補正テーブル" CURVE 0x00012A3A REC_UBYTE_C 0 COMP_0009 0 199.21875
 /begin AXIS_DESCR FIX_AXIS NO_INPUT_QUANTITY COMP_0348_S 16 -40 110 FIX_AXIS_PAR_DIST 0 1 16 /end AXIS_DESCR
/end CHARACTERISTIC
/begin CHARACTERISTIC mTTXNEL "燃料カット禁止回転数ﾃｰﾌﾞﾙ" CURVE 0x00012A8A REC_UBYTE_C 0 COMP_0006 0 3187.5
 /begin AXIS_DESCR FIX_AXIS NO_INPUT_QUANTITY COMP_0348_S 16 -40 110 FIX_AXIS_PAR_DIST 0 1 16 /end AXIS_DESCR
/end CHARACTERISTIC
/begin CHARACTERISTIC mTUETBL "タービン効率テーブル" CURVE 0x00012AAA REC_UBYTE_C 0 COMP_0063 0 0.99609375
 /begin AXIS_DESCR COM_AXIS NO_INPUT_QUANTITY COMP_0020 16 0 12750 AXIS_PTS_REF mTUEAX /end AXIS_DESCR
/end CHARACTERISTIC
/begin CHARACTERISTIC mTVSTHH "車速センサ診断判定用噴射量上限テーブル" CURVE 0x00012ACA REC_UBYTE_C 0 COMP_0001 0 31.875
 /begin AXIS_DESCR FIX_AXIS NO_INPUT_QUANTITY COMP_0347_S 16 0 6000 FIX_AXIS_PAR_DIST 0 1 16 /end AXIS_DESCR
/end CHARACTERISTIC
/begin CHARACTERISTIC mTVSTLL "車速センサ診断判定用噴射量下限テーブル" CURVE 0x00012ADA REC_UBYTE_C 0 COMP_0001 0 31.875
 /begin AXIS_DESCR FIX_AXIS NO_INPUT_QUANTITY COMP_0347_S 16 0 6000 FIX_AXIS_PAR_DIST 0 1 16 /end AXIS_DESCR
/end CHARACTERISTIC
/begin CHARACTERISTIC mTVTCRTE "始動後増量VTC補正ﾃｰﾌﾞﾙ" CURVE 0x00012B12 REC_UBYTE_C 0 COMP_0186 0 3.984375
 /begin AXIS_DESCR COM_AXIS NO_INPUT_QUANTITY COMP_0256 16 -64 63.5 AXIS_PTS_REF mLVTCRTE /end AXIS_DESCR
/end CHARACTERISTIC
/begin CHARACTERISTIC mTMFRCNT "TMFRｶｯﾄ気筒数" CURVE 0x00012334 REC_UBYTE_C 0 COMP_0030 0 255
 /begin AXIS_DESCR FIX_AXIS NO_INPUT_QUANTITY COMP_0068 3 0 2 FIX_AXIS_PAR_DIST 0 1 3 /end AXIS_DESCR
/end CHARACTERISTIC
/begin CHARACTERISTIC mTMFRCNTS "TMFR成層ｶｯﾄ気筒数" CURVE 0x00012337 REC_UBYTE_C 0 COMP_0030 0 255
 /begin AXIS_DESCR FIX_AXIS NO_INPUT_QUANTITY COMP_0068 3 0 2 FIX_AXIS_PAR_DIST 0 1 3 /end AXIS_DESCR
/end CHARACTERISTIC
/begin CHARACTERISTIC mTMFRTM "TMFRｶｯﾄ開始時間" CURVE 0x0001233A REC_UBYTE_C 0 COMP_0014 0 2550
 /begin AXIS_DESCR FIX_AXIS NO_INPUT_QUANTITY COMP_0068 3 0 2 FIX_AXIS_PAR_DIST 0 1 3 /end AXIS_DESCR
/end CHARACTERISTIC
/begin CHARACTERISTIC mTMFRTMS "TMFR成層ｶｯﾄ開始時間" CURVE 0x0001233D REC_UBYTE_C 0 COMP_0014 0 2550
 /begin AXIS_DESCR FIX_AXIS NO_INPUT_QUANTITY COMP_0068 3 0 2 FIX_AXIS_PAR_DIST 0 1 3 /end AXIS_DESCR
/end CHARACTERISTIC
/begin CHARACTERISTIC mTBTSEN "バッテリ雰囲気温度正規化テーブル" CURVE 0x00011BF4 REC_UBYTE_C 0 COMP_0035 -50 205
 /begin AXIS_DESCR FIX_AXIS NO_INPUT_QUANTITY COMP_0379_S 32 0 4960 FIX_AXIS_PAR_DIST 0 1 32 /end AXIS_DESCR
/end CHARACTERISTIC
/begin CHARACTERISTIC mTEGT "排気温度ノーマライズ" CURVE 0x000140CA REC_UWORD_C 0 COMP_0035 -50 65485
 /begin AXIS_DESCR COM_AXIS NO_INPUT_QUANTITY COMP_0023 32 0 327675 AXIS_PTS_REF mLEGT /end AXIS_DESCR
/end CHARACTERISTIC
/begin CHARACTERISTIC mTGADNH_S "正規化開口面積基本値ﾃｰﾌﾞﾙ2" CURVE 0x00016524 REC_UWORD_C 0 COMP_0380_S 0 0.000040959375
 /begin AXIS_DESCR COM_AXIS NO_INPUT_QUANTITY COMP_0146 32 0 99.998480265 AXIS_PTS_REF mTQH0SH_S /end AXIS_DESCR
/end CHARACTERISTIC
/begin CHARACTERISTIC mTGADNV_S "正規化開口面積基本値ﾃｰﾌﾞﾙ1" CURVE 0x00016564 REC_UWORD_C 0 COMP_0381_S 0 0.000002559993705
 /begin AXIS_DESCR COM_AXIS NO_INPUT_QUANTITY COMP_0146 32 0 99.998480265 AXIS_PTS_REF mTQH0ST_S /end AXIS_DESCR
/end CHARACTERISTIC
/begin CHARACTERISTIC mTNETAGT1 "NSET0加算テーブル(NSET0_addition_table)" CURVE 0x000123A4 REC_UBYTE_C 0 COMP_0065 0 796.875
 /begin AXIS_DESCR FIX_AXIS NO_INPUT_QUANTITY COMP_0429 32 0 31 FIX_AXIS_PAR_DIST 0 1 32 /end AXIS_DESCR
/end CHARACTERISTIC
/begin CHARACTERISTIC mTTGTVO "開口面積ー目標ｽﾛｯﾄﾙ開度変換ﾃｰﾌﾞﾙ" CURVE 0x000151E0 REC_UWORD_C 0 COMP_0130 0 1802.2125
 /begin AXIS_DESCR COM_AXIS NO_INPUT_QUANTITY COMP_0041 32 0 52.428 AXIS_PTS_REF mATGTVO /end AXIS_DESCR
/end CHARACTERISTIC
/begin CHARACTERISTIC mTTGTVO_S "開口面積ｰ目標ｽﾛｯﾄﾙ開度変換ﾃｰﾌﾞﾙ" CURVE 0x0001671E REC_UWORD_C 0 COMP_0130 0 1802.2125
 /begin AXIS_DESCR COM_AXIS NO_INPUT_QUANTITY COMP_0041 32 0 52.428 AXIS_PTS_REF mATGTVO_S /end AXIS_DESCR
/end CHARACTERISTIC
/begin CHARACTERISTIC mTTOIL "油温正規化テーブル" CURVE 0x0001293E REC_UBYTE_C 0 COMP_0035 -50 205
 /begin AXIS_DESCR FIX_AXIS NO_INPUT_QUANTITY COMP_0379_S 32 0 4960 FIX_AXIS_PAR_DIST 0 1 32 /end AXIS_DESCR
/end CHARACTERISTIC
/begin CHARACTERISTIC mTTQH0ST "目標基本QH0" CURVE 0x00015330 REC_UWORD_C 0 COMP_0146 0 99.998480265
 /begin AXIS_DESCR COM_AXIS NO_INPUT_QUANTITY COMP_0028_S 32 0 2.5599609375E-06 AXIS_PTS_REF mTTGADNV /end AXIS_DESCR
/end CHARACTERISTIC
/begin CHARACTERISTIC mTTQH0STH "目標基本QH0" CURVE 0x00015370 REC_UWORD_C 0 COMP_0146 0 99.998480265
 /begin AXIS_DESCR COM_AXIS NO_INPUT_QUANTITY COMP_0382_S 32 0 0.000040959375 AXIS_PTS_REF mTTGADNVH /end AXIS_DESCR
/end CHARACTERISTIC
/begin CHARACTERISTIC mTTWN "水温正規化テーブル" CURVE 0x00012A52 REC_UBYTE_C 0 COMP_0035 -50 205
 /begin AXIS_DESCR FIX_AXIS NO_INPUT_QUANTITY COMP_0379_S 32 0 4960 FIX_AXIS_PAR_DIST 0 1 32 /end AXIS_DESCR
/end CHARACTERISTIC
/begin CHARACTERISTIC mSPDTQDCF "回転同期FASTﾄﾙｸ減少率" CURVE 0x00013BF2 REC_UWORD_C 0 COMP_0193 0 6553.5
 /begin AXIS_DESCR FIX_AXIS NO_INPUT_QUANTITY COMP_0068 4 0 3 FIX_AXIS_PAR_DIST 0 1 4 /end AXIS_DESCR
/end CHARACTERISTIC
/begin CHARACTERISTIC mTCHGOKV "充電完了判定式ｹﾞｲﾝﾃｰﾌﾞﾙ" CURVE 0x00011C34 REC_UBYTE_C 0 COMP_0373 0 2.55
 /begin AXIS_DESCR FIX_AXIS NO_INPUT_QUANTITY COMP_0383_S 4 13520 14480 FIX_AXIS_PAR_DIST 0 1 4 /end AXIS_DESCR
/end CHARACTERISTIC
/begin CHARACTERISTIC mTCREM "CRTEM参照用ﾃｰﾌﾞﾙ" CURVE 0x00013F5A REC_UWORD_C 0 COMP_0016 0 65535
 /begin AXIS_DESCR FIX_AXIS NO_INPUT_QUANTITY COMP_0384_S 4 -20 40 FIX_AXIS_PAR_DIST 0 1 4 /end AXIS_DESCR
/end CHARACTERISTIC
/begin CHARACTERISTIC mTCRTIA "CRTIA参照用ﾃｰﾌﾞﾙ" CURVE 0x00013F62 REC_UWORD_C 0 COMP_0016 0 65535
 /begin AXIS_DESCR FIX_AXIS NO_INPUT_QUANTITY COMP_0384_S 4 -20 40 FIX_AXIS_PAR_DIST 0 1 4 /end AXIS_DESCR
/end CHARACTERISTIC
/begin CHARACTERISTIC mTDATRETP "変速前ﾄﾙｸﾀﾞｳﾝ時ﾄﾙｸﾀﾞｳﾝ率増加率係数ﾃｰﾌﾞﾙ" CURVE 0x00011CC8 REC_UBYTE_C 0 COMP_0175_S 0 0.99609375
 /begin AXIS_DESCR FIX_AXIS NO_INPUT_QUANTITY COMP_0324_S 4 1 4 FIX_AXIS_PAR_DIST 0 1 4 /end AXIS_DESCR
/end CHARACTERISTIC
/begin CHARACTERISTIC mTDATRETU "ﾄﾙｸﾀﾞｳﾝ率増加率係数ﾃｰﾌﾞﾙ" CURVE 0x00011CCC REC_UBYTE_C 0 COMP_0175_S 0 0.99609375
 /begin AXIS_DESCR FIX_AXIS NO_INPUT_QUANTITY COMP_0324_S 4 1 4 FIX_AXIS_PAR_DIST 0 1 4 /end AXIS_DESCR
/end CHARACTERISTIC
/begin CHARACTERISTIC mTDLNEMSK "DLTNE非演算時間テーブル" CURVE 0x00011D40 REC_UBYTE_C 0 COMP_0014 0 2550
 /begin AXIS_DESCR FIX_AXIS NO_INPUT_QUANTITY COMP_0385_S 4 1200 3600 FIX_AXIS_PAR_DIST 0 1 4 /end AXIS_DESCR
/end CHARACTERISTIC
/begin CHARACTERISTIC mTKPIPL "大気圧補正係数＿VIP>=0ﾃｰﾌﾞﾙ" CURVE 0x000121FC REC_UBYTE_C 0 COMP_0027 0 255
 /begin AXIS_DESCR FIX_AXIS NO_INPUT_QUANTITY COMP_0386_S 4 2.08 4 FIX_AXIS_PAR_DIST 0 1 4 /end AXIS_DESCR
/end CHARACTERISTIC
/begin CHARACTERISTIC mTKPIPR "大気圧補正係数＿VIP<0ﾃｰﾌﾞﾙ" CURVE 0x00012200 REC_UBYTE_C 0 COMP_0027 0 255
 /begin AXIS_DESCR FIX_AXIS NO_INPUT_QUANTITY COMP_0386_S 4 2.08 4 FIX_AXIS_PAR_DIST 0 1 4 /end AXIS_DESCR
/end CHARACTERISTIC
/begin CHARACTERISTIC mTNACDMN "Dﾚﾝｼﾞｴｱｺﾝ要求最低回転数ﾃｰﾌﾞﾙ" CURVE 0x00012370 REC_UBYTE_C 0 COMP_0006 0 3187.5
 /begin AXIS_DESCR FIX_AXIS NO_INPUT_QUANTITY COMP_0324_S 4 1 4 FIX_AXIS_PAR_DIST 0 1 4 /end AXIS_DESCR
/end CHARACTERISTIC
/begin CHARACTERISTIC mTNACDMX "Dﾚﾝｼﾞｴｱｺﾝ要求最大回転数ﾃｰﾌﾞﾙ" CURVE 0x00012374 REC_UBYTE_C 0 COMP_0006 0 3187.5
 /begin AXIS_DESCR FIX_AXIS NO_INPUT_QUANTITY COMP_0324_S 4 1 4 FIX_AXIS_PAR_DIST 0 1 4 /end AXIS_DESCR
/end CHARACTERISTIC
/begin CHARACTERISTIC mTNACNMN "Nﾚﾝｼﾞｴｱｺﾝ要求最低回転数ﾃｰﾌﾞﾙ" CURVE 0x00012378 REC_UBYTE_C 0 COMP_0006 0 3187.5
 /begin AXIS_DESCR FIX_AXIS NO_INPUT_QUANTITY COMP_0324_S 4 1 4 FIX_AXIS_PAR_DIST 0 1 4 /end AXIS_DESCR
/end CHARACTERISTIC
/begin CHARACTERISTIC mTNACNMX "Nﾚﾝｼﾞｴｱｺﾝ要求最大回転数ﾃｰﾌﾞﾙ" CURVE 0x0001237C REC_UBYTE_C 0 COMP_0006 0 3187.5
 /begin AXIS_DESCR FIX_AXIS NO_INPUT_QUANTITY COMP_0324_S 4 1 4 FIX_AXIS_PAR_DIST 0 1 4 /end AXIS_DESCR
/end CHARACTERISTIC
/begin CHARACTERISTIC mTNACUP "ｴｱｺﾝ要求回転数UPﾃｰﾌﾞﾙ" CURVE 0x00012380 REC_UBYTE_C 0 COMP_0006 0 3187.5
 /begin AXIS_DESCR FIX_AXIS NO_INPUT_QUANTITY COMP_0324_S 4 1 4 FIX_AXIS_PAR_DIST 0 1 4 /end AXIS_DESCR
/end CHARACTERISTIC
/begin CHARACTERISTIC mTQCIMAX "OPEN時F/B_I分上限値テーブル" CURVE 0x000125D4 REC_UBYTE_C 0 COMP_0051 0 255
 /begin AXIS_DESCR FIX_AXIS NO_INPUT_QUANTITY COMP_0387_S 4 -40 80 FIX_AXIS_PAR_DIST 0 1 4 /end AXIS_DESCR
/end CHARACTERISTIC
/begin CHARACTERISTIC mTQCK0 "(CK)負荷変動分補正補空気流量基本ﾃｰﾌﾞﾙ" CURVE 0x000125E8 REC_UBYTE_C 0 COMP_0220 0 255
 /begin AXIS_DESCR FIX_AXIS NO_INPUT_QUANTITY COMP_0324_S 4 1 4 FIX_AXIS_PAR_DIST 0 1 4 /end AXIS_DESCR
/end CHARACTERISTIC
/begin CHARACTERISTIC mTSMDLY "ｽﾓｰｸ対策制御移行許可ﾃﾞｨﾚｲﾃｰﾌﾞﾙ" CURVE 0x0001275A REC_UBYTE_C 0 COMP_0008 0 25500
 /begin AXIS_DESCR FIX_AXIS NO_INPUT_QUANTITY COMP_0388_S 4 0 60 FIX_AXIS_PAR_DIST 0 1 4 /end AXIS_DESCR
/end CHARACTERISTIC
/begin CHARACTERISTIC mTTDRONC "即ﾄﾙｸﾀﾞｳﾝ率係数ﾃｰﾌﾞﾙ" CURVE 0x0001285A REC_UBYTE_C 0 COMP_0032 0 0.99609375
 /begin AXIS_DESCR FIX_AXIS NO_INPUT_QUANTITY COMP_0324_S 4 1 4 FIX_AXIS_PAR_DIST 0 1 4 /end AXIS_DESCR
/end CHARACTERISTIC
/begin CHARACTERISTIC mTTEGOK "TEGROK検索テーブル" CURVE 0x000128AE REC_UBYTE_C 0 COMP_0035 -50 205
 /begin AXIS_DESCR FIX_AXIS NO_INPUT_QUANTITY COMP_0333_S 4 -40 20 FIX_AXIS_PAR_DIST 0 1 4 /end AXIS_DESCR
/end CHARACTERISTIC
/begin CHARACTERISTIC mTTIMES "通常制御移行時間ﾃｰﾌﾞﾙ" CURVE 0x000128DE REC_UBYTE_C 0 COMP_0096 0 2550
 /begin AXIS_DESCR FIX_AXIS NO_INPUT_QUANTITY COMP_0388_S 4 0 60 FIX_AXIS_PAR_DIST 0 1 4 /end AXIS_DESCR
/end CHARACTERISTIC
/begin CHARACTERISTIC mTTRADV1 "初期リタード量テーブル1" CURVE 0x0001299E REC_UBYTE_C 0 COMP_0017 0 255
 /begin AXIS_DESCR FIX_AXIS NO_INPUT_QUANTITY COMP_0389_S 4 0 4.2 FIX_AXIS_PAR_DIST 0 1 4 /end AXIS_DESCR
/end CHARACTERISTIC
/begin CHARACTERISTIC mTTRADV2 "初期リタード量テーブル2" CURVE 0x000129A2 REC_UBYTE_C 0 COMP_0017 0 255
 /begin AXIS_DESCR FIX_AXIS NO_INPUT_QUANTITY COMP_0389_S 4 0 4.2 FIX_AXIS_PAR_DIST 0 1 4 /end AXIS_DESCR
/end CHARACTERISTIC
/begin CHARACTERISTIC mTTRADV22 "初期リタード量テーブル22(ｱｲﾄﾞﾙからの踏み込み時)" CURVE 0x000129A6 REC_UBYTE_C 0 COMP_0017 0 255
 /begin AXIS_DESCR FIX_AXIS NO_INPUT_QUANTITY COMP_0389_S 4 0 4.2 FIX_AXIS_PAR_DIST 0 1 4 /end AXIS_DESCR
/end CHARACTERISTIC
/begin CHARACTERISTIC mTTRADV3 "初期リタード量テーブル3" CURVE 0x000129AA REC_UBYTE_C 0 COMP_0017 0 255
 /begin AXIS_DESCR FIX_AXIS NO_INPUT_QUANTITY COMP_0389_S 4 0 4.2 FIX_AXIS_PAR_DIST 0 1 4 /end AXIS_DESCR
/end CHARACTERISTIC
/begin CHARACTERISTIC mTTRADV4 "初期リタード量テーブル4" CURVE 0x000129AE REC_UBYTE_C 0 COMP_0017 0 255
 /begin AXIS_DESCR FIX_AXIS NO_INPUT_QUANTITY COMP_0389_S 4 0 4.2 FIX_AXIS_PAR_DIST 0 1 4 /end AXIS_DESCR
/end CHARACTERISTIC
/begin CHARACTERISTIC mMDFSTRQ "回転同期制御トルクアップリミット" CURVE 0x0001372A REC_UWORD_C 0 COMP_0196 0 6553.5
 /begin AXIS_DESCR FIX_AXIS NO_INPUT_QUANTITY COMP_0068 5 0 4 FIX_AXIS_PAR_DIST 0 1 5 /end AXIS_DESCR
/end CHARACTERISTIC
/begin CHARACTERISTIC mRLTENG2 "リミッタ中アップシフト用TENG2" CURVE 0x00013A34 REC_UWORD_C 0 COMP_0226 -3276.8 3276.7
 /begin AXIS_DESCR FIX_AXIS NO_INPUT_QUANTITY COMP_0068 5 0 4 FIX_AXIS_PAR_DIST 0 1 5 /end AXIS_DESCR
/end CHARACTERISTIC
/begin CHARACTERISTIC mTRATIO "変速比テーブル" CURVE 0x00014D32 REC_UWORD_C 0 COMP_0450 0 63.999056205
 /begin AXIS_DESCR FIX_AXIS NO_INPUT_QUANTITY COMP_0068 5 0 4 FIX_AXIS_PAR_DIST 0 1 5 /end AXIS_DESCR
/end CHARACTERISTIC
/begin CHARACTERISTIC mTRATIOAT "ＡＴギア比" CURVE 0x00014D4C REC_UWORD_C 0 COMP_0390_S 0 6.249902559
 /begin AXIS_DESCR FIX_AXIS NO_INPUT_QUANTITY COMP_0068 5 0 4 FIX_AXIS_PAR_DIST 0 1 5 /end AXIS_DESCR
/end CHARACTERISTIC
/begin CHARACTERISTIC mTRATIO_S "変速比テーブル" CURVE 0x000166C4 REC_UWORD_C 0 COMP_0450 0 63.999056205
 /begin AXIS_DESCR FIX_AXIS NO_INPUT_QUANTITY COMP_0068 5 0 4 FIX_AXIS_PAR_DIST 0 1 5 /end AXIS_DESCR
/end CHARACTERISTIC
/begin CHARACTERISTIC mTSCKDRET "SCKDRET減少率ﾃｰﾌﾞﾙ" CURVE 0x00014ED6 REC_UWORD_C 0 COMP_0083 0 255.99609375
 /begin AXIS_DESCR FIX_AXIS NO_INPUT_QUANTITY COMP_0068 5 0 4 FIX_AXIS_PAR_DIST 0 1 5 /end AXIS_DESCR
/end CHARACTERISTIC
/begin CHARACTERISTIC mQTBL "吸入空気量変換テーブル" CURVE 0x00013984 REC_UWORD_C 0 COMP_0004 0 65535
 /begin AXIS_DESCR FIX_AXIS NO_INPUT_QUANTITY COMP_0391_S 64 0 5.04 FIX_AXIS_PAR_DIST 0 1 64 /end AXIS_DESCR
/end CHARACTERISTIC
/begin CHARACTERISTIC mTTFKK "高精度燃温ﾉｰﾏﾗｲｽﾞﾃｰﾌﾞﾙ" CURVE 0x000150B0 REC_UWORD_C 0 COMP_0259_S -50 13057
 /begin AXIS_DESCR FIX_AXIS NO_INPUT_QUANTITY COMP_0391_S 64 0 5.04 FIX_AXIS_PAR_DIST 0 1 64 /end AXIS_DESCR
/end CHARACTERISTIC
/begin CHARACTERISTIC mAJRMPGPH "ｱﾝﾁｼﾞｬｰｸﾘﾐｯﾄﾄﾙｸ変化率ｷﾞｱ位置" CURVE 0x00011589 REC_UBYTE_C 0 COMP_0045 0 1.9921875
 /begin AXIS_DESCR FIX_AXIS NO_INPUT_QUANTITY COMP_0068 8 0 7 FIX_AXIS_PAR_DIST 0 1 8 /end AXIS_DESCR
/end CHARACTERISTIC
/begin CHARACTERISTIC mAJT0CLAP "ｱﾝﾁｼﾞｬｰｸ初期ﾘﾐｯﾄﾄﾙｸｱｸｾﾙ開度補正ｹﾞｲﾝﾃｰﾌﾞﾙ(L/U時)" CURVE 0x00011591 REC_UBYTE_C 0 COMP_0045 0 1.9921875
 /begin AXIS_DESCR FIX_AXIS NO_INPUT_QUANTITY COMP_0325_S 8 0 73.92 FIX_AXIS_PAR_DIST 0 1 8 /end AXIS_DESCR
/end CHARACTERISTIC
/begin CHARACTERISTIC mAJT0CLNE "ｱﾝﾁｼﾞｬｰｸ初期ﾘﾐｯﾄﾄﾙｸｴﾝｼﾞﾝ回転補正ｹﾞｲﾝﾃｰﾌﾞﾙ（L/U時）_" CURVE 0x00011599 REC_UBYTE_C 0 COMP_0045 0 1.9921875
 /begin AXIS_DESCR FIX_AXIS NO_INPUT_QUANTITY COMP_0326_S 8 0 7000 FIX_AXIS_PAR_DIST 0 1 8 /end AXIS_DESCR
/end CHARACTERISTIC
/begin CHARACTERISTIC mAJT0OWAP "ｱﾝﾁｼﾞｬｰｸ初期ﾘﾐｯﾄﾄﾙｸｱｸｾﾙ開度補正ｹﾞｲﾝﾃｰﾌﾞﾙ(非L/U時)(Anti_jerk_initial_limit_torque_correction_gain_table(not_L/U))" CURVE 0x000115A1 REC_UBYTE_C 0 COMP_0045 0 1.9921875
 /begin AXIS_DESCR FIX_AXIS NO_INPUT_QUANTITY COMP_0325_S 8 0 73.92 FIX_AXIS_PAR_DIST 0 1 8 /end AXIS_DESCR
/end CHARACTERISTIC
/begin CHARACTERISTIC mAJT0OWNE "ｱﾝﾁｼﾞｬｰｸ初期ﾘﾐｯﾄﾄﾙｸｴﾝｼﾞﾝ回転補正ｹﾞｲﾝﾃｰﾌﾞﾙ(非L/U時)" CURVE 0x000115A9 REC_UBYTE_C 0 COMP_0045 0 1.9921875
 /begin AXIS_DESCR FIX_AXIS NO_INPUT_QUANTITY COMP_0326_S 8 0 7000 FIX_AXIS_PAR_DIST 0 1 8 /end AXIS_DESCR
/end CHARACTERISTIC
/begin CHARACTERISTIC mAJTQ0CLU "ｱﾝﾁｼﾞｬｰｸ初期ﾘﾐｯﾄﾄﾙｸﾃｰﾌﾞﾙ(L/U時)" CURVE 0x00012D32 REC_UWORD_C 0 COMP_0226 -3276.8 3276.7
 /begin AXIS_DESCR FIX_AXIS NO_INPUT_QUANTITY COMP_0068 8 0 7 FIX_AXIS_PAR_DIST 0 1 8 /end AXIS_DESCR
/end CHARACTERISTIC
/begin CHARACTERISTIC mAJTQ0OWC "ｱﾝﾁｼﾞｬｰｸ初期ﾘﾐｯﾄﾄﾙｸﾃｰﾌﾞﾙ(非L/U時)" CURVE 0x00012D42 REC_UWORD_C 0 COMP_0226 -3276.8 3276.7
 /begin AXIS_DESCR FIX_AXIS NO_INPUT_QUANTITY COMP_0068 8 0 7 FIX_AXIS_PAR_DIST 0 1 8 /end AXIS_DESCR
/end CHARACTERISTIC
/begin CHARACTERISTIC mAJTQT0TM "ｱﾝﾁｼﾞｬｰｸ初期ﾘﾐｯﾄﾄﾙｸ保持時間ﾃｰﾌﾞﾙ" CURVE 0x000115B1 REC_UBYTE_C 0 COMP_0014 0 2550
 /begin AXIS_DESCR FIX_AXIS NO_INPUT_QUANTITY COMP_0068 8 0 7 FIX_AXIS_PAR_DIST 0 1 8 /end AXIS_DESCR
/end CHARACTERISTIC
/begin CHARACTERISTIC mAJTQTMNH "ｱﾝﾁｼﾞｬｰｸ初期ﾘﾐｯﾄﾄﾙｸ保持時間ｴﾝｼﾞﾝ回転補正ｹﾞｲﾝﾃｰﾌﾞﾙ" CURVE 0x000115B9 REC_UBYTE_C 0 COMP_0045 0 1.9921875
 /begin AXIS_DESCR FIX_AXIS NO_INPUT_QUANTITY COMP_0326_S 8 0 7000 FIX_AXIS_PAR_DIST 0 1 8 /end AXIS_DESCR
/end CHARACTERISTIC
/begin CHARACTERISTIC mALPTBSDL "ALPHA戻しディレイテーブル" CURVE 0x00012D52 REC_UWORD_C 0 COMP_0017_S 0 655.35
 /begin AXIS_DESCR COM_AXIS NO_INPUT_QUANTITY COMP_0068 8 0 65535 AXIS_PTS_REF mALPTBSQM /end AXIS_DESCR
/end CHARACTERISTIC
/begin CHARACTERISTIC mBSTCORT "過給圧補正テーブル" CURVE 0x00012DD2 REC_UWORD_C 0 COMP_0217 0 3.999941832
 /begin AXIS_DESCR COM_AXIS NO_INPUT_QUANTITY COMP_0217 8 0 3.999941832 AXIS_PTS_REF mBSTRATK /end AXIS_DESCR
/end CHARACTERISTIC
/begin CHARACTERISTIC mBSTCOTBL "過給圧補正テーブル" CURVE 0x00012DE2 REC_UWORD_C 0 COMP_0217 0 3.999941832
 /begin AXIS_DESCR COM_AXIS NO_INPUT_QUANTITY COMP_0392_S 8 0 16383.75 AXIS_PTS_REF mTTBPAX /end AXIS_DESCR
/end CHARACTERISTIC
/begin CHARACTERISTIC mCATGTGIN "触媒診断中目標A/F_P分テーブル" CURVE 0x00012E02 REC_UWORD_C 0 COMP_0217 0 3.999941832
 /begin AXIS_DESCR COM_AXIS NO_INPUT_QUANTITY COMP_0068 8 0 65535 AXIS_PTS_REF mTXGTGIN /end AXIS_DESCR
/end CHARACTERISTIC
/begin CHARACTERISTIC mCATGTGIN2 "触媒診断中目標A/F_P分テーブル_bank2" CURVE 0x00012E12 REC_UWORD_C 0 COMP_0217 0 3.999941832
 /begin AXIS_DESCR COM_AXIS NO_INPUT_QUANTITY COMP_0068 8 0 65535 AXIS_PTS_REF mTXGTGIN /end AXIS_DESCR
/end CHARACTERISTIC
/begin CHARACTERISTIC mDMDPRG "要求ﾊﾟｰｼﾞ処理量ﾃｰﾌﾞﾙ" CURVE 0x00012EA2 REC_UWORD_C 0 COMP_0156 0 65535
 /begin AXIS_DESCR COM_AXIS NO_INPUT_QUANTITY COMP_0018_S 8 0 127.998046875 AXIS_PTS_REF mJKPABF /end AXIS_DESCR
/end CHARACTERISTIC
/begin CHARACTERISTIC mFCPTN1 "ﾄﾙｸ補正要求合成燃料ｶｯﾄﾊﾟﾀｰﾝ" CURVE 0x0001162F REC_UBYTE_C 0 COMP_0068 0 255
 /begin AXIS_DESCR FIX_AXIS NO_INPUT_QUANTITY COMP_0393_S 8 1 8 FIX_AXIS_PAR_DIST 0 1 8 /end AXIS_DESCR
/end CHARACTERISTIC
/begin CHARACTERISTIC mGUIEND "ｷﾞﾛﾁﾝ判定最大時間水温ﾃｰﾌﾞﾙ_" CURVE 0x00011679 REC_UBYTE_C 0 COMP_0008 0 25500
 /begin AXIS_DESCR COM_AXIS NO_INPUT_QUANTITY COMP_0356 8 -40 119.375 AXIS_PTS_REF mGUILDLY3 /end AXIS_DESCR
/end CHARACTERISTIC
/begin CHARACTERISTIC mGUIENDE "ｷﾞﾛﾁﾝ判定最大時間水温ﾃｰﾌﾞﾙ_（排気側）" CURVE 0x00011681 REC_UBYTE_C 0 COMP_0008 0 25500
 /begin AXIS_DESCR COM_AXIS NO_INPUT_QUANTITY COMP_0356 8 -40 119.375 AXIS_PTS_REF mGUILDLY3 /end AXIS_DESCR
/end CHARACTERISTIC
/begin CHARACTERISTIC mGUIENDO "ｷﾞﾛﾁﾝ判定最大時間油温ﾃｰﾌﾞﾙ_" CURVE 0x00011689 REC_UBYTE_C 0 COMP_0008 0 25500
 /begin AXIS_DESCR COM_AXIS NO_INPUT_QUANTITY COMP_0035 8 -50 205 AXIS_PTS_REF mGUILDLY2 /end AXIS_DESCR
/end CHARACTERISTIC
/begin CHARACTERISTIC mGUIENDOE "ｷﾞﾛﾁﾝ判定最大時間油温ﾃｰﾌﾞﾙ_（排気側）" CURVE 0x00011691 REC_UBYTE_C 0 COMP_0008 0 25500
 /begin AXIS_DESCR COM_AXIS NO_INPUT_QUANTITY COMP_0035 8 -50 205 AXIS_PTS_REF mGUILDLY2 /end AXIS_DESCR
/end CHARACTERISTIC
/begin CHARACTERISTIC mITSMOKE "ｽﾓｰｸ対策噴射ﾀｲﾐﾝｸﾞ" CURVE 0x000116F3 REC_UBYTE_C 0 COMP_0190 0 510
 /begin AXIS_DESCR FIX_AXIS NO_INPUT_QUANTITY COMP_0329_S 8 0 5600 FIX_AXIS_PAR_DIST 0 1 8 /end AXIS_DESCR
/end CHARACTERISTIC
/begin CHARACTERISTIC mMISBSESO "DIG機種用成層燃焼時TP補正値テーブル（Table_for_TP_correction_value_for_tha_vehicle_with_SCV）" CURVE 0x0001192F REC_UBYTE_C 0 COMP_0373 0 2.55
 /begin AXIS_DESCR COM_AXIS NO_INPUT_QUANTITY COMP_0314 8 -128 127 AXIS_PTS_REF mLADV /end AXIS_DESCR
/end CHARACTERISTIC
/begin CHARACTERISTIC mMMFEXHS "排気ガス流量進み補正比率テーブル" CURVE 0x00013734 REC_UWORD_C 0 COMP_0394_S 0 1.04856
 /begin AXIS_DESCR COM_AXIS NO_INPUT_QUANTITY COMP_0395_S 8 0 5.2428 AXIS_PTS_REF mLICPT /end AXIS_DESCR
/end CHARACTERISTIC
/begin CHARACTERISTIC mMMFEXSS "排気ガス流量進み補正テーブル" CURVE 0x00013744 REC_UWORD_C 0 COMP_0304_S 0 1.04856
 /begin AXIS_DESCR COM_AXIS NO_INPUT_QUANTITY COMP_0396_S 8 0 16383.75 AXIS_PTS_REF mLDTBPERR /end AXIS_DESCR
/end CHARACTERISTIC
/begin CHARACTERISTIC mMMTQUPTM "Mﾓｰﾄﾞ回転同期制御作動ﾀｲﾏ" CURVE 0x00011949 REC_UBYTE_C 0 COMP_0014 0 2550
 /begin AXIS_DESCR FIX_AXIS NO_INPUT_QUANTITY COMP_0397_S 8 100 816.8 FIX_AXIS_PAR_DIST 0 1 8 /end AXIS_DESCR
/end CHARACTERISTIC
/begin CHARACTERISTIC mOPABLMX "機能要求油圧低下判定閾値" CURVE 0x00013894 REC_UWORD_C 0 COMP_0065_S 0 1023.984375
 /begin AXIS_DESCR COM_AXIS NO_INPUT_QUANTITY COMP_0065 8 0 204796.875 AXIS_PTS_REF mOPABMXA /end AXIS_DESCR
/end CHARACTERISTIC
/begin CHARACTERISTIC mOPABMX "メタル保障油圧低下判定閾値" CURVE 0x000138A4 REC_UWORD_C 0 COMP_0065_S 0 1023.984375
 /begin AXIS_DESCR COM_AXIS NO_INPUT_QUANTITY COMP_0065 8 0 204796.875 AXIS_PTS_REF mOPABMXA /end AXIS_DESCR
/end CHARACTERISTIC
/begin CHARACTERISTIC mOVBLMTBL "過過給時トルク制限値テーブル" CURVE 0x000138D4 REC_UWORD_C 0 COMP_0226 -3276.8 3276.7
 /begin AXIS_DESCR COM_AXIS NO_INPUT_QUANTITY COMP_0065 8 0 204796.875 AXIS_PTS_REF mOVBLMNE /end AXIS_DESCR
/end CHARACTERISTIC
/begin CHARACTERISTIC mRATIOD1 "実変速中RATIO移行速度" CURVE 0x00013A04 REC_UWORD_C 0 COMP_0398_S 0 7.99985745
 /begin AXIS_DESCR FIX_AXIS NO_INPUT_QUANTITY COMP_0399_S 8 0 49.28 FIX_AXIS_PAR_DIST 0 1 8 /end AXIS_DESCR
/end CHARACTERISTIC
/begin CHARACTERISTIC mRATIOD2 "実変速終了後RATIO移行速度" CURVE 0x00013A14 REC_UWORD_C 0 COMP_0398_S 0 7.99985745
 /begin AXIS_DESCR FIX_AXIS NO_INPUT_QUANTITY COMP_0399_S 8 0 49.28 FIX_AXIS_PAR_DIST 0 1 8 /end AXIS_DESCR
/end CHARACTERISTIC
/begin CHARACTERISTIC mSGADVTBH "SGADV制御リタード量テーブル（ハイオク）" CURVE 0x00011A10 REC_UBYTE_C 0 COMP_0017 0 255
 /begin AXIS_DESCR FIX_AXIS NO_INPUT_QUANTITY COMP_0330_S 8 0 87.5 FIX_AXIS_PAR_DIST 0 1 8 /end AXIS_DESCR
/end CHARACTERISTIC
/begin CHARACTERISTIC mSGADVTBR "SGADV制御リタード量テーブル（レギュラー）" CURVE 0x00011A18 REC_UBYTE_C 0 COMP_0017 0 255
 /begin AXIS_DESCR FIX_AXIS NO_INPUT_QUANTITY COMP_0330_S 8 0 87.5 FIX_AXIS_PAR_DIST 0 1 8 /end AXIS_DESCR
/end CHARACTERISTIC
/begin CHARACTERISTIC mSHAGAILM "リミッタトルク参照テーブル" CURVE 0x00013A92 REC_UWORD_C 0 COMP_0226 -3276.8 3276.7
 /begin AXIS_DESCR COM_AXIS NO_INPUT_QUANTITY COMP_0065 8 0 204796.875 AXIS_PTS_REF mSHAGAIBP /end AXIS_DESCR
/end CHARACTERISTIC
/begin CHARACTERISTIC mSLAJFLTB "ガクガク防止フィルタ係数テーブル(Gakugaku_prevention_filter_value_table)" CURVE 0x00013AA2 REC_UWORD_C 0 COMP_0447 0 6399.90234375
 /begin AXIS_DESCR COM_AXIS NO_INPUT_QUANTITY COMP_0238_S 8 0 655.35 AXIS_PTS_REF mSLAJTQBP /end AXIS_DESCR
/end CHARACTERISTIC
/begin CHARACTERISTIC mSLAJRMTB "ガクガク防止トルクランプテーブル(Gakugaku_prevention_torque_ramp_table)" CURVE 0x00013AB2 REC_UWORD_C 0 COMP_0193 0 6553.5
 /begin AXIS_DESCR COM_AXIS NO_INPUT_QUANTITY COMP_0238_S 8 0 655.35 AXIS_PTS_REF mSLAJTQBP /end AXIS_DESCR
/end CHARACTERISTIC
/begin CHARACTERISTIC mSLDGLMT "スピードリミッタDゲイン上限テーブル_（Speed_Limiter_D_Gain_max＿value_Table）" CURVE 0x00013AE2 REC_UWORD_C 0 COMP_0450 0 63.999056205
 /begin AXIS_DESCR COM_AXIS NO_INPUT_QUANTITY COMP_0238_S 8 0 655.35 AXIS_PTS_REF mSLDGLMBP /end AXIS_DESCR
/end CHARACTERISTIC
/begin CHARACTERISTIC mSLDGTBL "スピードリミッタDゲインテーブル（Speed_Limiter_D_Gain_Table）" CURVE 0x00013AF2 REC_UWORD_C 0 COMP_0450 0 63.999056205
 /begin AXIS_DESCR COM_AXIS NO_INPUT_QUANTITY COMP_0238_S 8 0 655.35 AXIS_PTS_REF mSLDGVER /end AXIS_DESCR
/end CHARACTERISTIC
/begin CHARACTERISTIC mSLMTOILT "MT高油温時リミット車速テーブル（Limit_vehicle_speed_when_MT_oil_high_temp_）" CURVE 0x00013B12 REC_UWORD_C 0 COMP_0238_S 0 655.35
 /begin AXIS_DESCR COM_AXIS NO_INPUT_QUANTITY COMP_0035 8 -50 65485 AXIS_PTS_REF mSLMTOTAN /end AXIS_DESCR
/end CHARACTERISTIC
/begin CHARACTERISTIC mSLPGRTLM "スピードリミッタPゲイン上限変速比制限テーブル（Speed_Limiter_P_Gain_Maximum＿Limit＿_for_RATIO_Table" CURVE 0x00013B52 REC_UWORD_C 0 COMP_0400_S 0 65535
 /begin AXIS_DESCR COM_AXIS NO_INPUT_QUANTITY COMP_0450 8 0 63.999056205 AXIS_PTS_REF mSLPGRTBP /end AXIS_DESCR
/end CHARACTERISTIC
/begin CHARACTERISTIC mSLPGTBL "スピードリミッタPゲインテーブル（Speed_Limiter_P_Gain_Table）" CURVE 0x00013B62 REC_UWORD_C 0 COMP_0400_S 0 65535
 /begin AXIS_DESCR COM_AXIS NO_INPUT_QUANTITY COMP_0238_S 8 0 655.35 AXIS_PTS_REF mSLPGVER /end AXIS_DESCR
/end CHARACTERISTIC
/begin CHARACTERISTIC mSLVAPGTB "スピードリミッタトルク-開度換算範囲係数テーブル(Speed_limiter_torque_-_pedal_opening_transform_coefficient_table)" CURVE 0x00013B92 REC_UWORD_C 0 COMP_0032_S 0 8191.875
 /begin AXIS_DESCR COM_AXIS NO_INPUT_QUANTITY COMP_0238_S 8 0 655.35 AXIS_PTS_REF mSLVAPGBP /end AXIS_DESCR
/end CHARACTERISTIC
/begin CHARACTERISTIC mSLVPLMTB "スピードリミッタ開度上限テーブル_(Speed_Limiter_APO_limit_table)" CURVE 0x00013BB2 REC_UWORD_C 0 COMP_0032_S 0 8191.875
 /begin AXIS_DESCR COM_AXIS NO_INPUT_QUANTITY COMP_0238_S 8 0 655.35 AXIS_PTS_REF mSLVPLMBP /end AXIS_DESCR
/end CHARACTERISTIC
/begin CHARACTERISTIC mTA5TP "中水温リタード基本値テーブル" CURVE 0x00011AC0 REC_UBYTE_C 0 COMP_0017 0 255
 /begin AXIS_DESCR FIX_AXIS NO_INPUT_QUANTITY COMP_0401_S 8 0 14 FIX_AXIS_PAR_DIST 0 1 8 /end AXIS_DESCR
/end CHARACTERISTIC
/begin CHARACTERISTIC mTADMBM "ﾏﾆ触媒ADV補正項" CURVE 0x00013C1A REC_UWORD_C 0 COMP_0019_S 0 257.000024415
 /begin AXIS_DESCR COM_AXIS NO_INPUT_QUANTITY COMP_0017 8 0 65535 AXIS_PTS_REF mLTADMB /end AXIS_DESCR
/end CHARACTERISTIC
/begin CHARACTERISTIC mTADMBU "床下触媒ADV補正項" CURVE 0x00013C2A REC_UWORD_C 0 COMP_0019_S 0 257.000024415
 /begin AXIS_DESCR COM_AXIS NO_INPUT_QUANTITY COMP_0017 8 0 65535 AXIS_PTS_REF mLTADMB /end AXIS_DESCR
/end CHARACTERISTIC
/begin CHARACTERISTIC mTADNSTY "空気密度吸気温ﾃｰﾌﾞﾙ" CURVE 0x00011AD8 REC_UBYTE_C 0 COMP_0402_S 0 2040
 /begin AXIS_DESCR FIX_AXIS NO_INPUT_QUANTITY COMP_0333_S 8 -40 100 FIX_AXIS_PAR_DIST 0 1 8 /end AXIS_DESCR
/end CHARACTERISTIC
/begin CHARACTERISTIC mTADVPG "低回転ﾌﾟﾚｲｸﾞ回避時点火進角量ﾃｰﾌﾞﾙ" CURVE 0x00011B34 REC_UBYTE_C 0 COMP_0017 0 255
 /begin AXIS_DESCR COM_AXIS NO_INPUT_QUANTITY COMP_0190 8 0 510 AXIS_PTS_REF mLTADVPG /end AXIS_DESCR
/end CHARACTERISTIC
/begin CHARACTERISTIC mTADVSL "個別診断点火側クライテリア" CURVE 0x00013C3A REC_UWORD_C 0 COMP_0403_S 0 3276750
 /begin AXIS_DESCR COM_AXIS NO_INPUT_QUANTITY COMP_0035 8 -50 65485 AXIS_PTS_REF mLTADVSL /end AXIS_DESCR
/end CHARACTERISTIC
/begin CHARACTERISTIC mTADVSLB "個別診断点火側クライテリア（DIG/エリアB）" CURVE 0x00013C4A REC_UWORD_C 0 COMP_0403_S 0 3276750
 /begin AXIS_DESCR COM_AXIS NO_INPUT_QUANTITY COMP_0035 8 -50 65485 AXIS_PTS_REF mLTADVSLB /end AXIS_DESCR
/end CHARACTERISTIC
/begin CHARACTERISTIC mTADVSLC "個別診断点火側クライテリア（DIG/エリアC）" CURVE 0x00013C5A REC_UWORD_C 0 COMP_0403_S 0 3276750
 /begin AXIS_DESCR COM_AXIS NO_INPUT_QUANTITY COMP_0035 8 -50 65485 AXIS_PTS_REF mLTADVSLC /end AXIS_DESCR
/end CHARACTERISTIC
/begin CHARACTERISTIC mTADVSLD "個別診断点火時期側NG判定クライテリア" CURVE 0x00011B3C REC_UBYTE_C 0 COMP_0250_S -128 127
 /begin AXIS_DESCR COM_AXIS NO_INPUT_QUANTITY COMP_0035 8 -50 205 AXIS_PTS_REF mLTADVSLD /end AXIS_DESCR
/end CHARACTERISTIC
/begin CHARACTERISTIC mTADVTEGF "一次遅れ重みテーブル(GAKUADV作動時)(1st_order_filter_weighting_table)" CURVE 0x00011B44 REC_UBYTE_C 0 COMP_0063 0 0.99609375
 /begin AXIS_DESCR FIX_AXIS NO_INPUT_QUANTITY COMP_0404_S 8 800 6400 FIX_AXIS_PAR_DIST 0 1 8 /end AXIS_DESCR
/end CHARACTERISTIC
/begin CHARACTERISTIC mTAFEXT2P "AFSAF算出用_排温圧力換算テーブル" CURVE 0x00013D0A REC_UWORD_C 0 COMP_0034_S 0 255.99609375
 /begin AXIS_DESCR COM_AXIS NO_INPUT_QUANTITY COMP_0405_S 8 0 1310.7 AXIS_PTS_REF mLAFEXT2P /end AXIS_DESCR
/end CHARACTERISTIC
/begin CHARACTERISTIC mTAFKMRH "部品保護境界負荷テーブル" CURVE 0x00011B7C REC_UBYTE_C 0 COMP_0009 0 199.21875
 /begin AXIS_DESCR FIX_AXIS NO_INPUT_QUANTITY COMP_0329_S 8 0 5600 FIX_AXIS_PAR_DIST 0 1 8 /end AXIS_DESCR
/end CHARACTERISTIC
/begin CHARACTERISTIC mTAFSFTL "ﾘｰﾝ時ｼﾌﾄ学習量RrO2ｾﾝｻ電圧割り付けﾃｰﾌﾞﾙ" CURVE 0x00013D1A REC_UWORD_C 0 COMP_0453 0 131.07
 /begin AXIS_DESCR COM_AXIS NO_INPUT_QUANTITY COMP_0023 8 0 327675 AXIS_PTS_REF mTXAFSFTL /end AXIS_DESCR
/end CHARACTERISTIC
/begin CHARACTERISTIC mTAFSFTR "ﾘｯﾁ時ｼﾌﾄ学習量RrO2ｾﾝｻ電圧割り付けﾃｰﾌﾞﾙ" CURVE 0x00013D2A REC_UWORD_C 0 COMP_0453 0 131.07
 /begin AXIS_DESCR COM_AXIS NO_INPUT_QUANTITY COMP_0023 8 0 327675 AXIS_PTS_REF mTXAFSFTR /end AXIS_DESCR
/end CHARACTERISTIC
/begin CHARACTERISTIC mTAFSO2H "O2濃度補正ﾃｰﾌﾞﾙ" CURVE 0x00013D3A REC_UWORD_C 0 COMP_0217 0 3.999941832
 /begin AXIS_DESCR COM_AXIS NO_INPUT_QUANTITY COMP_0156 8 0 65535 AXIS_PTS_REF mLAFSO2H /end AXIS_DESCR
/end CHARACTERISTIC
/begin CHARACTERISTIC mTAMADRET "GOV3進遅角許可量算出テーブル（VEL非採用車種用）" CURVE 0x00011B9C REC_UBYTE_C 0 COMP_0314 -128 127
 /begin AXIS_DESCR COM_AXIS NO_INPUT_QUANTITY COMP_0000 8 0 6375 AXIS_PTS_REF mTNEAMAD /end AXIS_DESCR
/end CHARACTERISTIC
/begin CHARACTERISTIC mTANHTI "異常高圧故障時噴射パルス幅テーブル" CURVE 0x00013D8A REC_UWORD_C 0 COMP_0157_S 0 104856
 /begin AXIS_DESCR FIX_AXIS NO_INPUT_QUANTITY COMP_0329_S 8 0 5600 FIX_AXIS_PAR_DIST 0 1 8 /end AXIS_DESCR
/end CHARACTERISTIC
/begin CHARACTERISTIC mTAPOAC "加速時A/Cｶｯﾄ判定VAPOﾃｰﾌﾞﾙ" CURVE 0x00013D9A REC_UWORD_C 0 COMP_0005 0 7208.85
 /begin AXIS_DESCR FIX_AXIS NO_INPUT_QUANTITY COMP_0355_S 8 0 56 FIX_AXIS_PAR_DIST 0 1 8 /end AXIS_DESCR
/end CHARACTERISTIC
/begin CHARACTERISTIC mTAVCD1 "ADVCD1テーブル(Dレンジ)" CURVE 0x00011BAC REC_UBYTE_C 0 COMP_0017 0 255
 /begin AXIS_DESCR FIX_AXIS NO_INPUT_QUANTITY COMP_0333_S 8 -40 100 FIX_AXIS_PAR_DIST 0 1 8 /end AXIS_DESCR
/end CHARACTERISTIC
/begin CHARACTERISTIC mTAVCN1 "ADVCD1テーブル(Nレンジ)" CURVE 0x00011BB4 REC_UBYTE_C 0 COMP_0017 0 255
 /begin AXIS_DESCR FIX_AXIS NO_INPUT_QUANTITY COMP_0333_S 8 -40 100 FIX_AXIS_PAR_DIST 0 1 8 /end AXIS_DESCR
/end CHARACTERISTIC
/begin CHARACTERISTIC mTAVCNL "λコン時補正値テーブル" CURVE 0x00011BBC REC_UBYTE_C 0 COMP_0017 0 255
 /begin AXIS_DESCR FIX_AXIS NO_INPUT_QUANTITY COMP_0333_S 8 -40 100 FIX_AXIS_PAR_DIST 0 1 8 /end AXIS_DESCR
/end CHARACTERISTIC
/begin CHARACTERISTIC mTAVCNS "PI制御時補正値テーブル" CURVE 0x00011BC4 REC_UBYTE_C 0 COMP_0017 0 255
 /begin AXIS_DESCR FIX_AXIS NO_INPUT_QUANTITY COMP_0333_S 8 -40 100 FIX_AXIS_PAR_DIST 0 1 8 /end AXIS_DESCR
/end CHARACTERISTIC
/begin CHARACTERISTIC mTAVEMH "目標当量比排気補正率対応ﾄﾙｸ補正ﾘﾀｰﾄﾞﾃｰﾌﾞﾙ" CURVE 0x00013DCA REC_UWORD_C 0 COMP_0017 0 65535
 /begin AXIS_DESCR COM_AXIS NO_INPUT_QUANTITY COMP_0217 8 0 3.999941832 AXIS_PTS_REF mLTEMHOS /end AXIS_DESCR
/end CHARACTERISTIC
/begin CHARACTERISTIC mTBLTSPH "トルクステア/パワーホップ上限テーブル" CURVE 0x00013E5A REC_UWORD_C 0 COMP_0226 -3276.8 3276.7
 /begin AXIS_DESCR FIX_AXIS NO_INPUT_QUANTITY COMP_0357_S 8 400 3200 FIX_AXIS_PAR_DIST 0 1 8 /end AXIS_DESCR
/end CHARACTERISTIC
/begin CHARACTERISTIC mTBPATMLM "目標圧力比大気圧リミットテーブル" CURVE 0x00011BDC REC_UBYTE_C 0 COMP_0406_S 1 4.984375
 /begin AXIS_DESCR COM_AXIS NO_INPUT_QUANTITY COMP_0407_S 8 40 103.75 AXIS_PTS_REF mLBPATMLM /end AXIS_DESCR
/end CHARACTERISTIC
/begin CHARACTERISTIC mTBPRGLM "レギュラ判定時目標過給圧上限テーブル" CURVE 0x00013E6A REC_UWORD_C 0 COMP_0120_S 0 16383.75
 /begin AXIS_DESCR COM_AXIS NO_INPUT_QUANTITY COMP_0065 8 0 204796.875 AXIS_PTS_REF mLBPRGLM /end AXIS_DESCR
/end CHARACTERISTIC
/begin CHARACTERISTIC mTBTUPMPR "ブートアップパージ率付加量算出テーブル" CURVE 0x00011C14 REC_UBYTE_C 0 COMP_0408_S -6.4 6.35
 /begin AXIS_DESCR COM_AXIS NO_INPUT_QUANTITY COMP_0027 8 0 255 AXIS_PTS_REF mJKDALP /end AXIS_DESCR
/end CHARACTERISTIC
/begin CHARACTERISTIC mTCALTMX "バッテリ電流センサ機能診断用オルタネータMAX発電電流値テーブル" CURVE 0x00011C1C REC_UBYTE_C 0 COMP_0045_S 0 255
 /begin AXIS_DESCR FIX_AXIS NO_INPUT_QUANTITY COMP_0409_S 8 500 1900 FIX_AXIS_PAR_DIST 0 1 8 /end AXIS_DESCR
/end CHARACTERISTIC
/begin CHARACTERISTIC mTCKDWV "車速補正係数テーブル" CURVE 0x00011C78 REC_UBYTE_C 0 COMP_0045 0 1.9921875
 /begin AXIS_DESCR FIX_AXIS NO_INPUT_QUANTITY COMP_0007 8 0 14 FIX_AXIS_PAR_DIST 0 1 8 /end AXIS_DESCR
/end CHARACTERISTIC
/begin CHARACTERISTIC mTCNGM "CNGMS参照用テーブル" CURVE 0x00011C80 REC_UBYTE_C 0 COMP_0410_S 0 255
 /begin AXIS_DESCR FIX_AXIS NO_INPUT_QUANTITY COMP_0347_S 8 0 2800 FIX_AXIS_PAR_DIST 0 1 8 /end AXIS_DESCR
/end CHARACTERISTIC
/begin CHARACTERISTIC mTCOSTG "車両ｺｰｽﾄGﾃｰﾌﾞﾙ(CVT用)(Vehicle_Coast_G_table_(forCVT))" CURVE 0x00011C88 REC_UBYTE_C 0 COMP_0130_S 0 0.255
 /begin AXIS_DESCR COM_AXIS NO_INPUT_QUANTITY COMP_0429 8 0 255 AXIS_PTS_REF mTTCOSTG /end AXIS_DESCR
/end CHARACTERISTIC
/begin CHARACTERISTIC mTCRADV "CRADVテーブル" CURVE 0x00011C90 REC_UBYTE_C 0 COMP_0017 0 255
 /begin AXIS_DESCR FIX_AXIS NO_INPUT_QUANTITY COMP_0333_S 8 -40 100 FIX_AXIS_PAR_DIST 0 1 8 /end AXIS_DESCR
/end CHARACTERISTIC
/begin CHARACTERISTIC mTCSTACT "ｺｰｽﾄA/Cｶｯﾄ可能時間ﾃｰﾌﾞﾙ（ECOモード設定無し又はECOモード非選択時）" CURVE 0x00011C98 REC_UBYTE_C 0 COMP_0105 0 25.5
 /begin AXIS_DESCR COM_AXIS NO_INPUT_QUANTITY COMP_0011 8 0 5.1 AXIS_PTS_REF mCSTACPD /end AXIS_DESCR
/end CHARACTERISTIC
/begin CHARACTERISTIC mTCSTACTE "ｺｰｽﾄA/Cｶｯﾄ可能時間ﾃｰﾌﾞﾙ（ECOモード選択時）" CURVE 0x00011CA0 REC_UBYTE_C 0 COMP_0105 0 25.5
 /begin AXIS_DESCR COM_AXIS NO_INPUT_QUANTITY COMP_0011 8 0 5.1 AXIS_PTS_REF mCSTACPD /end AXIS_DESCR
/end CHARACTERISTIC
/begin CHARACTERISTIC mTDATDPRE "変速前ﾄﾙｸﾀﾞｳﾝ時ﾄﾙｸﾀﾞｳﾝ率減少率係数ﾃｰﾌﾞﾙ" CURVE 0x00011CC0 REC_UBYTE_C 0 COMP_0175_S 0 0.99609375
 /begin AXIS_DESCR FIX_AXIS NO_INPUT_QUANTITY COMP_0411_S 8 10 80 FIX_AXIS_PAR_DIST 0 1 8 /end AXIS_DESCR
/end CHARACTERISTIC
/begin CHARACTERISTIC mTDDQNEDN "D→N時DQNE増加値ﾃｰﾌﾞﾙ" CURVE 0x00011CD0 REC_UBYTE_C 0 COMP_0412_S 0 15.9375
 /begin AXIS_DESCR COM_AXIS NO_INPUT_QUANTITY COMP_0293 8 0 510 AXIS_PTS_REF mTDQNEQAX /end AXIS_DESCR
/end CHARACTERISTIC
/begin CHARACTERISTIC mTDDQNEND "N→D時DQNE減少値ﾃｰﾌﾞﾙ" CURVE 0x00011CD8 REC_UBYTE_C 0 COMP_0412_S 0 15.9375
 /begin AXIS_DESCR COM_AXIS NO_INPUT_QUANTITY COMP_0293 8 0 510 AXIS_PTS_REF mTDQNEQAX /end AXIS_DESCR
/end CHARACTERISTIC
/begin CHARACTERISTIC mTDEADTME "排気VTCプラントモデルデッドタイムテーブル" CURVE 0x00011CE0 REC_UBYTE_C 0 COMP_0008 0 25500
 /begin AXIS_DESCR COM_AXIS NO_INPUT_QUANTITY COMP_0035 8 -50 205 AXIS_PTS_REF mVCTBOTDE /end AXIS_DESCR
/end CHARACTERISTIC
/begin CHARACTERISTIC mTDEADTMI "VTCプラントモデルデッドタイムテーブル" CURVE 0x00011CE8 REC_UBYTE_C 0 COMP_0008 0 25500
 /begin AXIS_DESCR COM_AXIS NO_INPUT_QUANTITY COMP_0035 8 -50 205 AXIS_PTS_REF mVCTABOTD /end AXIS_DESCR
/end CHARACTERISTIC
/begin CHARACTERISTIC mTDENS "未燃ガス密度テーブル" CURVE 0x00011D00 REC_UBYTE_C 0 COMP_0303 0 31875
 /begin AXIS_DESCR FIX_AXIS NO_INPUT_QUANTITY COMP_0413_S 8 0 175 FIX_AXIS_PAR_DIST 0 1 8 /end AXIS_DESCR
/end CHARACTERISTIC
/begin CHARACTERISTIC mTDGNST "始動後ｱｲﾄﾞﾙｱｯﾌﾟ量減衰率ﾃｰﾌﾞﾙ" CURVE 0x00011D08 REC_UBYTE_C 0 COMP_0081_S 0 99.609375
 /begin AXIS_DESCR COM_AXIS NO_INPUT_QUANTITY COMP_0006 8 0 3187.5 AXIS_PTS_REF mTGNSTAX /end AXIS_DESCR
/end CHARACTERISTIC
/begin CHARACTERISTIC mTDKASINS "成層始動用始動後減少割合テーブル(始動時水温参照)" CURVE 0x00013F6A REC_UWORD_C 0 COMP_0217 0 3.999941832
 /begin AXIS_DESCR FIX_AXIS NO_INPUT_QUANTITY COMP_0333_S 8 -40 100 FIX_AXIS_PAR_DIST 0 1 8 /end AXIS_DESCR
/end CHARACTERISTIC
/begin CHARACTERISTIC mTDKASSIN "始動後減少割合テーブル(始動時水温参照)" CURVE 0x00013F7A REC_UWORD_C 0 COMP_0099 0 3.999941832
 /begin AXIS_DESCR FIX_AXIS NO_INPUT_QUANTITY COMP_0333_S 8 -40 100 FIX_AXIS_PAR_DIST 0 1 8 /end AXIS_DESCR
/end CHARACTERISTIC
/begin CHARACTERISTIC mTDLMFD "DLYMFD参照ﾃｰﾌﾞﾙ" CURVE 0x00011D38 REC_UBYTE_C 0 COMP_0049 0 255
 /begin AXIS_DESCR FIX_AXIS NO_INPUT_QUANTITY COMP_0333_S 8 -40 100 FIX_AXIS_PAR_DIST 0 1 8 /end AXIS_DESCR
/end CHARACTERISTIC
/begin CHARACTERISTIC mTDLNRH "非直線補正テーブル(高圧側)" CURVE 0x00013F8A REC_UWORD_C 0 COMP_0414_S -52428.8 52427.2
 /begin AXIS_DESCR COM_AXIS NO_INPUT_QUANTITY COMP_0157_S 8 0 104856 AXIS_PTS_REF mDLNRHTI /end AXIS_DESCR
/end CHARACTERISTIC
/begin CHARACTERISTIC mTDLNRL "非直線補正テーブル(低圧側)" CURVE 0x00013F9A REC_UWORD_C 0 COMP_0414_S -52428.8 52427.2
 /begin AXIS_DESCR COM_AXIS NO_INPUT_QUANTITY COMP_0157_S 8 0 104856 AXIS_PTS_REF mDLNRLTI /end AXIS_DESCR
/end CHARACTERISTIC
/begin CHARACTERISTIC mTDLNRL2 "INJ電流可変制御作動時非直線補正テーブル(低圧側)（Table＿of＿injection＿pulse＿width＿to＿linearize＿injection＿quantity" CURVE 0x00013FAA REC_UWORD_C 0 COMP_0414_S -52428.8 52427.2
 /begin AXIS_DESCR COM_AXIS NO_INPUT_QUANTITY COMP_0157_S 8 0 104856 AXIS_PTS_REF mDLNL2TI /end AXIS_DESCR
/end CHARACTERISTIC
/begin CHARACTERISTIC mTDLNRLL "非直線補正テーブル(極低圧側)" CURVE 0x00013FBA REC_UWORD_C 0 COMP_0414_S -52428.8 52427.2
 /begin AXIS_DESCR COM_AXIS NO_INPUT_QUANTITY COMP_0157_S 8 0 104856 AXIS_PTS_REF mDLNRLLTI /end AXIS_DESCR
/end CHARACTERISTIC
/begin CHARACTERISTIC mTDLNRLL2 "INJ電流可変制御作動時非直線補正テーブル(極低圧側)（Table＿of＿injection＿pulse＿width＿to＿linearize＿injection＿quantit" CURVE 0x00013FCA REC_UWORD_C 0 COMP_0414_S -52428.8 52427.2
 /begin AXIS_DESCR COM_AXIS NO_INPUT_QUANTITY COMP_0157_S 8 0 104856 AXIS_PTS_REF mDLNLL2TI /end AXIS_DESCR
/end CHARACTERISTIC
/begin CHARACTERISTIC mTDLQH0ST "ﾀｰﾎﾞSOFIS過渡判定ｸﾗｲﾃﾘｱﾃｰﾌﾞﾙ" CURVE 0x00013FDA REC_UWORD_C 0 COMP_0290 0 0.999985458
 /begin AXIS_DESCR COM_AXIS NO_INPUT_QUANTITY COMP_0064 8 0 102398.4375 AXIS_PTS_REF mQH0STRPM /end AXIS_DESCR
/end CHARACTERISTIC
/begin CHARACTERISTIC mTDLVSP2 "A/C_SW_ON時L/U禁止車速テーブル" CURVE 0x00011D44 REC_UBYTE_C 0 COMP_0007 0 510
 /begin AXIS_DESCR FIX_AXIS NO_INPUT_QUANTITY COMP_0415_S 8 0 2.8 FIX_AXIS_PAR_DIST 0 1 8 /end AXIS_DESCR
/end CHARACTERISTIC
/begin CHARACTERISTIC mTDLVSP2B "A/C_SW_ON_＆_ﾌﾞﾚｰｷ_SW_ON時L/U禁止車速テーブル(Lock_up_prohibition_vehicle-speed_table_at_air_conditioner-swich_on_&_brak" CURVE 0x00011D4C REC_UBYTE_C 0 COMP_0007 0 510
 /begin AXIS_DESCR FIX_AXIS NO_INPUT_QUANTITY COMP_0415_S 8 0 2.8 FIX_AXIS_PAR_DIST 0 1 8 /end AXIS_DESCR
/end CHARACTERISTIC
/begin CHARACTERISTIC mTDLYFUL "VTCフル判定ディレイ時間テーブル                                                                                         brak" CURVE 0x00011D54 REC_UBYTE_C 0 COMP_0014 0 2550
 /begin AXIS_DESCR COM_AXIS NO_INPUT_QUANTITY COMP_0020 8 0 12750 AXIS_PTS_REF mTDLFLNE /end AXIS_DESCR
/end CHARACTERISTIC
/begin CHARACTERISTIC mTDNSCK "濃度ﾁｪｯｸ要求時間ﾃｰﾌﾞﾙ" CURVE 0x00011D5C REC_UBYTE_C 0 COMP_0416_S 0 765
 /begin AXIS_DESCR COM_AXIS NO_INPUT_QUANTITY COMP_0035 8 -50 205 AXIS_PTS_REF mJKDNSCK /end AXIS_DESCR
/end CHARACTERISTIC
/begin CHARACTERISTIC mTDPEXH "タービン出入口排圧差推定テーブル（高流量時）" CURVE 0x00013FEA REC_UWORD_C 0 COMP_0215_S 0 127.99837455
 /begin AXIS_DESCR COM_AXIS NO_INPUT_QUANTITY COMP_0304_S 8 0 1.04856 AXIS_PTS_REF mEXGDP /end AXIS_DESCR
/end CHARACTERISTIC
/begin CHARACTERISTIC mTDPEXL "タービン出入口排圧差推定テーブル（低流量時）" CURVE 0x00013FFA REC_UWORD_C 0 COMP_0215_S 0 127.99837455
 /begin AXIS_DESCR COM_AXIS NO_INPUT_QUANTITY COMP_0304_S 8 0 1.04856 AXIS_PTS_REF mEXGDP /end AXIS_DESCR
/end CHARACTERISTIC
/begin CHARACTERISTIC mTDQNEDN "D→N時DQNE初期値ﾃｰﾌﾞﾙ" CURVE 0x00011D64 REC_UBYTE_C 0 COMP_0051 0 255
 /begin AXIS_DESCR COM_AXIS NO_INPUT_QUANTITY COMP_0293 8 0 510 AXIS_PTS_REF mTDQNEQAX /end AXIS_DESCR
/end CHARACTERISTIC
/begin CHARACTERISTIC mTDQNEND "N→D時DQNE初期値ﾃｰﾌﾞﾙ" CURVE 0x00011D6C REC_UBYTE_C 0 COMP_0051 0 255
 /begin AXIS_DESCR COM_AXIS NO_INPUT_QUANTITY COMP_0293 8 0 510 AXIS_PTS_REF mTDQNEQAX /end AXIS_DESCR
/end CHARACTERISTIC
/begin CHARACTERISTIC mTDVDG "車速ｾﾝｻ故障判定ｴﾝｼﾞﾝ回転数ﾃｰﾌﾞﾙ" CURVE 0x00011DC4 REC_UBYTE_C 0 COMP_0000 0 6375
 /begin AXIS_DESCR FIX_AXIS NO_INPUT_QUANTITY COMP_0401_S 8 0 14 FIX_AXIS_PAR_DIST 0 1 8 /end AXIS_DESCR
/end CHARACTERISTIC
/begin CHARACTERISTIC mTDWLNE "ドゥエル回転数2/3乗テーブル" CURVE 0x00011DCC REC_UBYTE_C 0 COMP_0417_S 0 510
 /begin AXIS_DESCR FIX_AXIS NO_INPUT_QUANTITY COMP_0418_S 8 0 11200 FIX_AXIS_PAR_DIST 0 1 8 /end AXIS_DESCR
/end CHARACTERISTIC
/begin CHARACTERISTIC mTDWLVB "ドゥエルバッテリ(-2/3)乗テーブル" CURVE 0x00011DD4 REC_UBYTE_C 0 COMP_0419_S 0 0.3984375
 /begin AXIS_DESCR FIX_AXIS NO_INPUT_QUANTITY COMP_0420_S 8 0 17920 FIX_AXIS_PAR_DIST 0 1 8 /end AXIS_DESCR
/end CHARACTERISTIC
/begin CHARACTERISTIC mTEBRTH_S "エンブレ領域アクセルレシオ閾値テーブル（副演算部）" CURVE 0x000164B4 REC_UWORD_C 0 COMP_0032_S 0 8191.875
 /begin AXIS_DESCR COM_AXIS NO_INPUT_QUANTITY COMP_0436 8 0 6553.5 AXIS_PTS_REF mEBRTHV_S /end AXIS_DESCR
/end CHARACTERISTIC
/begin CHARACTERISTIC mTECODWN8 "ダウンシフト閾値テーブル(8格子)" CURVE 0x0001400A REC_UWORD_C 0 COMP_0005 0 7208.85
 /begin AXIS_DESCR COM_AXIS NO_INPUT_QUANTITY COMP_0436 8 0 6553.5 AXIS_PTS_REF mTECOVSP /end AXIS_DESCR
/end CHARACTERISTIC
/begin CHARACTERISTIC mTECOFNW8 "発進反力閾値テーブル（8格子）" CURVE 0x0001401A REC_UWORD_C 0 COMP_0005 0 7208.85
 /begin AXIS_DESCR COM_AXIS NO_INPUT_QUANTITY COMP_0436 8 0 6553.5 AXIS_PTS_REF mTECOVSP /end AXIS_DESCR
/end CHARACTERISTIC
/begin CHARACTERISTIC mTECOFWM8 "Mﾚﾝｼﾞ発進反力閾値ﾃｰﾌﾞﾙ（8格子）" CURVE 0x0001402A REC_UWORD_C 0 COMP_0005 0 7208.85
 /begin AXIS_DESCR COM_AXIS NO_INPUT_QUANTITY COMP_0436 8 0 6553.5 AXIS_PTS_REF mTECOVSP /end AXIS_DESCR
/end CHARACTERISTIC
/begin CHARACTERISTIC mTECOMST8 "Mレンジ高負荷閾値テーブル（8格子）" CURVE 0x0001403A REC_UWORD_C 0 COMP_0005 0 7208.85
 /begin AXIS_DESCR COM_AXIS NO_INPUT_QUANTITY COMP_0436 8 0 6553.5 AXIS_PTS_REF mTECOVSP /end AXIS_DESCR
/end CHARACTERISTIC
/begin CHARACTERISTIC mTECOMT1 "MT1速ダウンシフト閾値テーブル" CURVE 0x0001404A REC_UWORD_C 0 COMP_0005 0 7208.85
 /begin AXIS_DESCR COM_AXIS NO_INPUT_QUANTITY COMP_0436 8 0 6553.5 AXIS_PTS_REF mTECOVSP /end AXIS_DESCR
/end CHARACTERISTIC
/begin CHARACTERISTIC mTECOMT2 "MT2速ダウンシフト閾値テーブル" CURVE 0x0001405A REC_UWORD_C 0 COMP_0005 0 7208.85
 /begin AXIS_DESCR COM_AXIS NO_INPUT_QUANTITY COMP_0436 8 0 6553.5 AXIS_PTS_REF mTECOVSP /end AXIS_DESCR
/end CHARACTERISTIC
/begin CHARACTERISTIC mTECOMT3 "MT3速ダウンシフト閾値テーブル" CURVE 0x0001406A REC_UWORD_C 0 COMP_0005 0 7208.85
 /begin AXIS_DESCR COM_AXIS NO_INPUT_QUANTITY COMP_0436 8 0 6553.5 AXIS_PTS_REF mTECOVSP /end AXIS_DESCR
/end CHARACTERISTIC
/begin CHARACTERISTIC mTECOMT4 "MT4速ダウンシフト閾値テーブル" CURVE 0x0001407A REC_UWORD_C 0 COMP_0005 0 7208.85
 /begin AXIS_DESCR COM_AXIS NO_INPUT_QUANTITY COMP_0436 8 0 6553.5 AXIS_PTS_REF mTECOVSP /end AXIS_DESCR
/end CHARACTERISTIC
/begin CHARACTERISTIC mTECOMT5 "MT5速ダウンシフト閾値テーブル" CURVE 0x0001408A REC_UWORD_C 0 COMP_0005 0 7208.85
 /begin AXIS_DESCR COM_AXIS NO_INPUT_QUANTITY COMP_0436 8 0 6553.5 AXIS_PTS_REF mTECOVSP /end AXIS_DESCR
/end CHARACTERISTIC
/begin CHARACTERISTIC mTECOMT6 "MT6速ダウンシフト閾値テーブル" CURVE 0x0001409A REC_UWORD_C 0 COMP_0005 0 7208.85
 /begin AXIS_DESCR COM_AXIS NO_INPUT_QUANTITY COMP_0436 8 0 6553.5 AXIS_PTS_REF mTECOVSP /end AXIS_DESCR
/end CHARACTERISTIC
/begin CHARACTERISTIC mTEHTTRQ "ECM高温時上限テーブル(Limit_torque_table_at_ECM_high_temp)" CURVE 0x0001412A REC_UWORD_C 0 COMP_0196 0 6553.5
 /begin AXIS_DESCR COM_AXIS NO_INPUT_QUANTITY COMP_0065 8 0 204796.875 AXIS_PTS_REF mLEHTTRQ /end AXIS_DESCR
/end CHARACTERISTIC
/begin CHARACTERISTIC mTENBRTH "エンブレ領域アクセルレシオ閾値テーブル" CURVE 0x0001413A REC_UWORD_C 0 COMP_0032_S 0 8191.875
 /begin AXIS_DESCR COM_AXIS NO_INPUT_QUANTITY COMP_0436 8 0 6553.5 AXIS_PTS_REF mENBRTHVS /end AXIS_DESCR
/end CHARACTERISTIC
/begin CHARACTERISTIC mTETCDLYG "減速時ｽﾛｯﾄﾙ遅れ時間ﾃｰﾌﾞﾙ" CURVE 0x0001416A REC_UWORD_C 0 COMP_0421_S 0 0.65535
 /begin AXIS_DESCR COM_AXIS NO_INPUT_QUANTITY COMP_0006 8 0 819187.5 AXIS_PTS_REF mETCDLYN /end AXIS_DESCR
/end CHARACTERISTIC
/begin CHARACTERISTIC mTETCDLYK "加速時ｽﾛｯﾄﾙ遅れ時間ﾃｰﾌﾞﾙ" CURVE 0x0001417A REC_UWORD_C 0 COMP_0421_S 0 0.65535
 /begin AXIS_DESCR COM_AXIS NO_INPUT_QUANTITY COMP_0006 8 0 819187.5 AXIS_PTS_REF mETCDLYN /end AXIS_DESCR
/end CHARACTERISTIC
/begin CHARACTERISTIC mTEVOPB "基本パ-ジ無効パルス幅テーブル" CURVE 0x00011DEC REC_UBYTE_C 0 COMP_0311 0 16320
 /begin AXIS_DESCR FIX_AXIS NO_INPUT_QUANTITY COMP_0401_S 8 0 14 FIX_AXIS_PAR_DIST 0 1 8 /end AXIS_DESCR
/end CHARACTERISTIC
/begin CHARACTERISTIC mTFANITC1 "運転領域1-2境界ITACテーブル" CURVE 0x00011DF4 REC_UBYTE_C 0 COMP_0009 0 199.21875
 /begin AXIS_DESCR FIX_AXIS NO_INPUT_QUANTITY COMP_0329_S 8 0 5600 FIX_AXIS_PAR_DIST 0 1 8 /end AXIS_DESCR
/end CHARACTERISTIC
/begin CHARACTERISTIC mTFANITC2 "運転領域2-3境界ITACテーブル" CURVE 0x00011DFC REC_UBYTE_C 0 COMP_0009 0 199.21875
 /begin AXIS_DESCR FIX_AXIS NO_INPUT_QUANTITY COMP_0329_S 8 0 5600 FIX_AXIS_PAR_DIST 0 1 8 /end AXIS_DESCR
/end CHARACTERISTIC
/begin CHARACTERISTIC mTFANITC3 "運転領域3-4境界ITACテーブル＿(Operation_domain_3-4_boundary_ITAC_table)" CURVE 0x00011E04 REC_UBYTE_C 0 COMP_0009 0 199.21875
 /begin AXIS_DESCR FIX_AXIS NO_INPUT_QUANTITY COMP_0329_S 8 0 5600 FIX_AXIS_PAR_DIST 0 1 8 /end AXIS_DESCR
/end CHARACTERISTIC
/begin CHARACTERISTIC mTFCD2TBL "半気筒F/Cﾃﾞｨﾚｲﾃｰﾌﾞﾙ" CURVE 0x00011E1C REC_UBYTE_C 0 COMP_0014 0 2550
 /begin AXIS_DESCR FIX_AXIS NO_INPUT_QUANTITY COMP_0329_S 8 0 5600 FIX_AXIS_PAR_DIST 0 1 8 /end AXIS_DESCR
/end CHARACTERISTIC
/begin CHARACTERISTIC mTFCDRTO "全気筒F/Cﾃﾞｨﾚｲ＿RATIOﾃｰﾌﾞﾙ(All_cylinders_F/C_delay_RATIO_table)" CURVE 0x0001418A REC_UWORD_C 0 COMP_0014 0 655350
 /begin AXIS_DESCR COM_AXIS NO_INPUT_QUANTITY COMP_0450 8 0 63.999056205 AXIS_PTS_REF mFCDRATO /end AXIS_DESCR
/end CHARACTERISTIC
/begin CHARACTERISTIC mTFCDTMP "全気筒F/Cﾃﾞｨﾚｲ＿AT油温ﾃｰﾌﾞﾙ(All_cylinders_F/C_delay_AT_temperature_of_oil_table)" CURVE 0x00011E24 REC_UBYTE_C 0 COMP_0014 0 2550
 /begin AXIS_DESCR FIX_AXIS NO_INPUT_QUANTITY COMP_0422_S 8 50 225 FIX_AXIS_PAR_DIST 0 1 8 /end AXIS_DESCR
/end CHARACTERISTIC
/begin CHARACTERISTIC mTFCSOKTP "触媒保護燃料ｶｯﾄ領域判定用ﾃｰﾌﾞﾙ" CURVE 0x00011E2C REC_UBYTE_C 0 COMP_0001 0 31.875
 /begin AXIS_DESCR COM_AXIS NO_INPUT_QUANTITY COMP_0000 8 0 6375 AXIS_PTS_REF mNFSOKI /end AXIS_DESCR
/end CHARACTERISTIC
/begin CHARACTERISTIC mTFLFA "当量比補正テーブル" CURVE 0x00011E34 REC_UBYTE_C 0 COMP_0009 0 199.21875
 /begin AXIS_DESCR FIX_AXIS NO_INPUT_QUANTITY COMP_0423_S 8 0.5 1.375 FIX_AXIS_PAR_DIST 0 1 8 /end AXIS_DESCR
/end CHARACTERISTIC
/begin CHARACTERISTIC mTFLTSP "TWF変化時定数テーブル" CURVE 0x00011E3C REC_UBYTE_C 0 COMP_0149 0 0.12451191
 /begin AXIS_DESCR FIX_AXIS NO_INPUT_QUANTITY COMP_0424_S 8 0 0.875 FIX_AXIS_PAR_DIST 0 1 8 /end AXIS_DESCR
/end CHARACTERISTIC
/begin CHARACTERISTIC mTFLTW "水温補正テーブル" CURVE 0x00011E44 REC_UBYTE_C 0 COMP_0009 0 199.21875
 /begin AXIS_DESCR FIX_AXIS NO_INPUT_QUANTITY COMP_0333_S 8 -40 100 FIX_AXIS_PAR_DIST 0 1 8 /end AXIS_DESCR
/end CHARACTERISTIC
/begin CHARACTERISTIC mTFNALMT "回転補正値上限ﾃｰﾌﾞﾙ" CURVE 0x000141FA REC_UWORD_C 0 COMP_0063 0 255.99609375
 /begin AXIS_DESCR FIX_AXIS NO_INPUT_QUANTITY COMP_0333_S 8 -40 100 FIX_AXIS_PAR_DIST 0 1 8 /end AXIS_DESCR
/end CHARACTERISTIC
/begin CHARACTERISTIC mTFRICSEN "フリクション水温感度テーブル" CURVE 0x0001422A REC_UWORD_C 0 COMP_0425_S 0 25.599609375
 /begin AXIS_DESCR COM_AXIS NO_INPUT_QUANTITY COMP_0006 8 0 819187.5 AXIS_PTS_REF mTEFRICN /end AXIS_DESCR
/end CHARACTERISTIC
/begin CHARACTERISTIC mTFSPFD "FPRPSFS成立中ﾊﾞｯｸｱｯﾌﾟ燃圧遷移時増分ﾃｰﾌﾞﾙ" CURVE 0x00011E4C REC_UBYTE_C 0 COMP_0426_S 0 2.4888
 /begin AXIS_DESCR FIX_AXIS NO_INPUT_QUANTITY COMP_0329_S 8 0 5600 FIX_AXIS_PAR_DIST 0 1 8 /end AXIS_DESCR
/end CHARACTERISTIC
/begin CHARACTERISTIC mTFSPFST "スタータスイッチON中バックアップ燃圧テーブル" CURVE 0x00011E54 REC_UBYTE_C 0 COMP_0087_S 0 19.9104
 /begin AXIS_DESCR FIX_AXIS NO_INPUT_QUANTITY COMP_0354_S 8 0 1400 FIX_AXIS_PAR_DIST 0 1 8 /end AXIS_DESCR
/end CHARACTERISTIC
/begin CHARACTERISTIC mTFVCC "クーラント流速補正係数(Fluid_Velocity_Correction_of_Coolant)" CURVE 0x0001423A REC_UWORD_C 0 COMP_0061_S 0 6.5535
 /begin AXIS_DESCR COM_AXIS NO_INPUT_QUANTITY COMP_0006 8 0 819187.5 AXIS_PTS_REF mLFVCC /end AXIS_DESCR
/end CHARACTERISTIC
/begin CHARACTERISTIC mTGAP1ST "F/B初回Pゲインテーブル（ﾘﾀｰﾄﾞ有り時）" CURVE 0x0001424A REC_UWORD_C 0 COMP_0427_S -163.84 163.835
 /begin AXIS_DESCR COM_AXIS NO_INPUT_QUANTITY COMP_0006 8 0 819187.5 AXIS_PTS_REF mTX1STNE /end AXIS_DESCR
/end CHARACTERISTIC
/begin CHARACTERISTIC mTGHFN "減速減量補正率回転項" CURVE 0x00011E7C REC_UBYTE_C 0 COMP_0044 0 1.9921875
 /begin AXIS_DESCR FIX_AXIS NO_INPUT_QUANTITY COMP_0347_S 8 0 2800 FIX_AXIS_PAR_DIST 0 1 8 /end AXIS_DESCR
/end CHARACTERISTIC
/begin CHARACTERISTIC mTGHFQC "減速減量補正率負荷項" CURVE 0x00011E84 REC_UBYTE_C 0 COMP_0044 0 1.9921875
 /begin AXIS_DESCR FIX_AXIS NO_INPUT_QUANTITY COMP_0330_S 8 0 87.5 FIX_AXIS_PAR_DIST 0 1 8 /end AXIS_DESCR
/end CHARACTERISTIC
/begin CHARACTERISTIC mTGHSCV "SCV閉時減速補正ITAC条件テーブル" CURVE 0x00011E8C REC_UBYTE_C 0 COMP_0044 0 1.9921875
 /begin AXIS_DESCR FIX_AXIS NO_INPUT_QUANTITY COMP_0357_S 8 400 3200 FIX_AXIS_PAR_DIST 0 1 8 /end AXIS_DESCR
/end CHARACTERISTIC
/begin CHARACTERISTIC mTGNSTST2 "始動直後アイドルアップ率テーブル" CURVE 0x00011EAC REC_UBYTE_C 0 COMP_0021 0 99.609375
 /begin AXIS_DESCR FIX_AXIS NO_INPUT_QUANTITY COMP_0333_S 8 -40 100 FIX_AXIS_PAR_DIST 0 1 8 /end AXIS_DESCR
/end CHARACTERISTIC
/begin CHARACTERISTIC mTGOV3FM "GOV3テーブル(GOV3_table)" CURVE 0x00011EB4 REC_UBYTE_C 0 COMP_0250_S -128 127
 /begin AXIS_DESCR COM_AXIS NO_INPUT_QUANTITY COMP_0000 8 0 6375 AXIS_PTS_REF mLAMNRM3 /end AXIS_DESCR
/end CHARACTERISTIC
/begin CHARACTERISTIC mTGOVCLCH "MT車ｸﾗｯﾁ切り時GOVﾃｰﾌﾞﾙ" CURVE 0x00011EBC REC_UBYTE_C 0 COMP_0250_S -128 127
 /begin AXIS_DESCR FIX_AXIS NO_INPUT_QUANTITY COMP_0329_S 8 0 5600 FIX_AXIS_PAR_DIST 0 1 8 /end AXIS_DESCR
/end CHARACTERISTIC
/begin CHARACTERISTIC mTGOVFM "GOVテーブル(GOV_table)" CURVE 0x00011EC4 REC_UBYTE_C 0 COMP_0250_S -128 127
 /begin AXIS_DESCR COM_AXIS NO_INPUT_QUANTITY COMP_0000 8 0 6375 AXIS_PTS_REF mLAMNRM /end AXIS_DESCR
/end CHARACTERISTIC
/begin CHARACTERISTIC mTGOVL "GOVテーブル(リーン時)" CURVE 0x00011ECC REC_UBYTE_C 0 COMP_0314 -128 127
 /begin AXIS_DESCR FIX_AXIS NO_INPUT_QUANTITY COMP_0347_S 8 0 2800 FIX_AXIS_PAR_DIST 0 1 8 /end AXIS_DESCR
/end CHARACTERISTIC
/begin CHARACTERISTIC mTGRADE "勾配度変換テーブル(slope_table)" CURVE 0x0001425A REC_UWORD_C 0 COMP_0428_S -327.68 327.67
 /begin AXIS_DESCR COM_AXIS NO_INPUT_QUANTITY COMP_0136_S 8 -1.8907 240.5888 AXIS_PTS_REF mTGSENVAL /end AXIS_DESCR
/end CHARACTERISTIC
/begin CHARACTERISTIC mTGSI12UC "冷機時補正用アドオン車速閾値参照テーブル（1→2UP）" CURVE 0x0001429A REC_UWORD_C 0 COMP_0436 0 6553.5
 /begin AXIS_DESCR COM_AXIS NO_INPUT_QUANTITY COMP_0035 8 -50 65485 AXIS_PTS_REF mGSITWN /end AXIS_DESCR
/end CHARACTERISTIC
/begin CHARACTERISTIC mTGSI26UC "冷機時補正用アドオン車速閾値参照テーブル（2→6UP以上）" CURVE 0x0001434A REC_UWORD_C 0 COMP_0436 0 6553.5
 /begin AXIS_DESCR COM_AXIS NO_INPUT_QUANTITY COMP_0035 8 -50 65485 AXIS_PTS_REF mGSITWN /end AXIS_DESCR
/end CHARACTERISTIC
/begin CHARACTERISTIC mTGSLADV "NDｾﾚｸﾄ時ﾘﾀｰﾄﾞ許可点火時期ﾃｰﾌﾞﾙ" CURVE 0x00011ED4 REC_UBYTE_C 0 COMP_0314 -128 127
 /begin AXIS_DESCR COM_AXIS NO_INPUT_QUANTITY COMP_0000 8 0 6375 AXIS_PTS_REF mLGSLADV /end AXIS_DESCR
/end CHARACTERISTIC
/begin CHARACTERISTIC mTGZAS "CHOSn温度非平衡時補正率" CURVE 0x00011EEC REC_UBYTE_C 0 COMP_0066 0 3.984375
 /begin AXIS_DESCR FIX_AXIS NO_INPUT_QUANTITY COMP_0333_S 8 -40 100 FIX_AXIS_PAR_DIST 0 1 8 /end AXIS_DESCR
/end CHARACTERISTIC
/begin CHARACTERISTIC mTGZTWDI "DIG割り込み噴射補正倍率テーブル" CURVE 0x00011EFC REC_UBYTE_C 0 COMP_0429_S 0 5.1
 /begin AXIS_DESCR FIX_AXIS NO_INPUT_QUANTITY COMP_0333_S 8 -40 100 FIX_AXIS_PAR_DIST 0 1 8 /end AXIS_DESCR
/end CHARACTERISTIC
/begin CHARACTERISTIC mTHAOSC "O2吸着率ﾃｰﾌﾞﾙ" CURVE 0x0001453A REC_UWORD_C 0 COMP_0456 0 1.999970916
 /begin AXIS_DESCR COM_AXIS NO_INPUT_QUANTITY COMP_0430_S 8 -83886.08 83883.52 AXIS_PTS_REF mTXHAOSC /end AXIS_DESCR
/end CHARACTERISTIC
/begin CHARACTERISTIC mTHATMP "触媒温度O2吸着率ﾃｰﾌﾞﾙ" CURVE 0x00011F04 REC_UBYTE_C 0 COMP_0045 0 1.9921875
 /begin AXIS_DESCR COM_AXIS NO_INPUT_QUANTITY COMP_0062 8 0 1020 AXIS_PTS_REF mTXHATMP /end AXIS_DESCR
/end CHARACTERISTIC
/begin CHARACTERISTIC mTHIFBP "F/Bｹﾞｲﾝ上限値ﾃｰﾌﾞﾙ" CURVE 0x0001454A REC_UWORD_C 0 COMP_0336_S -32768 32767
 /begin AXIS_DESCR COM_AXIS NO_INPUT_QUANTITY COMP_0006 8 0 819187.5 AXIS_PTS_REF mTXNEFBP /end AXIS_DESCR
/end CHARACTERISTIC
/begin CHARACTERISTIC mTHROSC "O2放出率ﾃｰﾌﾞﾙ" CURVE 0x0001457A REC_UWORD_C 0 COMP_0456 0 1.999970916
 /begin AXIS_DESCR COM_AXIS NO_INPUT_QUANTITY COMP_0430_S 8 -83886.08 83883.52 AXIS_PTS_REF mTXHROSC /end AXIS_DESCR
/end CHARACTERISTIC
/begin CHARACTERISTIC mTHRTMP "触媒温度O2放出率ﾃｰﾌﾞﾙ" CURVE 0x00011F14 REC_UBYTE_C 0 COMP_0045 0 1.9921875
 /begin AXIS_DESCR COM_AXIS NO_INPUT_QUANTITY COMP_0062 8 0 1020 AXIS_PTS_REF mTXHRTMP /end AXIS_DESCR
/end CHARACTERISTIC
/begin CHARACTERISTIC mTHSNOKJD "診断カウンタクリア判定テーブル" CURVE 0x00011F1C REC_UBYTE_C 0 COMP_0030 0 255
 /begin AXIS_DESCR FIX_AXIS NO_INPUT_QUANTITY COMP_0329_S 8 0 5600 FIX_AXIS_PAR_DIST 0 1 8 /end AXIS_DESCR
/end CHARACTERISTIC
/begin CHARACTERISTIC mTICATL "後O2ｾﾝｻ_F/B_ALPCAT_LEAN_I分ﾃｰﾌﾞﾙ" CURVE 0x000145AA REC_UWORD_C 0 COMP_0031 0 255.99609375
 /begin AXIS_DESCR COM_AXIS NO_INPUT_QUANTITY COMP_0068 8 0 65535 AXIS_PTS_REF mTPIQM /end AXIS_DESCR
/end CHARACTERISTIC
/begin CHARACTERISTIC mTICATR "後O2ｾﾝｻ_F/B_ALPCAT_RICH_I分ﾃｰﾌﾞﾙ" CURVE 0x000145BA REC_UWORD_C 0 COMP_0031 0 255.99609375
 /begin AXIS_DESCR COM_AXIS NO_INPUT_QUANTITY COMP_0068 8 0 65535 AXIS_PTS_REF mTPIQM /end AXIS_DESCR
/end CHARACTERISTIC
/begin CHARACTERISTIC mTICFULM "VTCフル判定ITAC変化率制限値テーブル（フル判定ディレイ後）" CURVE 0x000145DA REC_UWORD_C 0 COMP_0431_S 0 199.99696053
 /begin AXIS_DESCR COM_AXIS NO_INPUT_QUANTITY COMP_0020 8 0 3276750 AXIS_PTS_REF mTICFLMN /end AXIS_DESCR
/end CHARACTERISTIC
/begin CHARACTERISTIC mTICHFUL "VTCフル判定時目標ITAC（フル判定ディレイ後）テーブル" CURVE 0x00011F2C REC_UBYTE_C 0 COMP_0009 0 199.21875
 /begin AXIS_DESCR COM_AXIS NO_INPUT_QUANTITY COMP_0020 8 0 12750 AXIS_PTS_REF mTICFLNE /end AXIS_DESCR
/end CHARACTERISTIC
/begin CHARACTERISTIC mTIDUTY "QFBI初期値" CURVE 0x00011F44 REC_UBYTE_C 0 COMP_0051 0 255
 /begin AXIS_DESCR FIX_AXIS NO_INPUT_QUANTITY COMP_0333_S 8 -40 100 FIX_AXIS_PAR_DIST 0 1 8 /end AXIS_DESCR
/end CHARACTERISTIC
/begin CHARACTERISTIC mTIDUTYRS "Dレンジ再始動用QFBI初期値" CURVE 0x00011F4C REC_UBYTE_C 0 COMP_0051 0 255
 /begin AXIS_DESCR FIX_AXIS NO_INPUT_QUANTITY COMP_0333_S 8 -40 100 FIX_AXIS_PAR_DIST 0 1 8 /end AXIS_DESCR
/end CHARACTERISTIC
/begin CHARACTERISTIC mTIDUTYST "QFBI初期値(成層始動時)" CURVE 0x00011F54 REC_UBYTE_C 0 COMP_0051 0 255
 /begin AXIS_DESCR FIX_AXIS NO_INPUT_QUANTITY COMP_0333_S 8 -40 100 FIX_AXIS_PAR_DIST 0 1 8 /end AXIS_DESCR
/end CHARACTERISTIC
/begin CHARACTERISTIC mTIDVTNE "低水温ｱｲﾄﾞﾙ時VTC目標作動角テーブル" CURVE 0x00011F5C REC_UBYTE_C 0 COMP_0256 -64 63.5
 /begin AXIS_DESCR COM_AXIS NO_INPUT_QUANTITY COMP_0020 8 0 12750 AXIS_PTS_REF mTVTIDNE /end AXIS_DESCR
/end CHARACTERISTIC
/begin CHARACTERISTIC mTIDVTNEE "低水温アイドル時排気VTC目標作動角テーブル" CURVE 0x00011F64 REC_UBYTE_C 0 COMP_0256 -64 63.5
 /begin AXIS_DESCR COM_AXIS NO_INPUT_QUANTITY COMP_0020 8 0 12750 AXIS_PTS_REF mTVTIDNEE /end AXIS_DESCR
/end CHARACTERISTIC
/begin CHARACTERISTIC mTIH12CHG "保持電流切替えタイミングテーブル" CURVE 0x0001463A REC_UWORD_C 0 COMP_0157_S 0 104856
 /begin AXIS_DESCR FIX_AXIS NO_INPUT_QUANTITY COMP_0420_S 8 0 17920 FIX_AXIS_PAR_DIST 0 1 8 /end AXIS_DESCR
/end CHARACTERISTIC
/begin CHARACTERISTIC mTIJTRQ "インジェクタ故障時上限リミットテーブル(Injector_failure_torque_limit_table)" CURVE 0x0001464A REC_UWORD_C 0 COMP_0196 0 6553.5
 /begin AXIS_DESCR COM_AXIS NO_INPUT_QUANTITY COMP_0065 8 0 204796.875 AXIS_PTS_REF mLTIJTRQ /end AXIS_DESCR
/end CHARACTERISTIC
/begin CHARACTERISTIC mTINAFUL "VTCフル判定時目標ITAC（フル判定ディレイ前）テーブル" CURVE 0x00011F9C REC_UBYTE_C 0 COMP_0009 0 199.21875
 /begin AXIS_DESCR COM_AXIS NO_INPUT_QUANTITY COMP_0020 8 0 12750 AXIS_PTS_REF mTINFLNE /end AXIS_DESCR
/end CHARACTERISTIC
/begin CHARACTERISTIC mTINFULM "VTCフル判定ITAC変化率制限処理値テーブル（フル判定ディレイ前）" CURVE 0x0001465A REC_UWORD_C 0 COMP_0431_S 0 199.99696053
 /begin AXIS_DESCR COM_AXIS NO_INPUT_QUANTITY COMP_0020 8 0 3276750 AXIS_PTS_REF mTIFLMNE /end AXIS_DESCR
/end CHARACTERISTIC
/begin CHARACTERISTIC mTINWFT "TWF初期値テーブル" CURVE 0x0001200C REC_UBYTE_C 0 COMP_0323 -200 118.75
 /begin AXIS_DESCR FIX_AXIS NO_INPUT_QUANTITY COMP_0333_S 8 -40 100 FIX_AXIS_PAR_DIST 0 1 8 /end AXIS_DESCR
/end CHARACTERISTIC
/begin CHARACTERISTIC mTISCPAMB "大気圧補正テーブル" CURVE 0x00012014 REC_UBYTE_C 0 COMP_0009 0 199.21875
 /begin AXIS_DESCR COM_AXIS NO_INPUT_QUANTITY COMP_0054 8 0 5100 AXIS_PTS_REF mTHIPAMB /end AXIS_DESCR
/end CHARACTERISTIC
/begin CHARACTERISTIC mTISCSS "始動時ISC補正値2テーブル" CURVE 0x0001201C REC_UBYTE_C 0 COMP_0293 0 510
 /begin AXIS_DESCR FIX_AXIS NO_INPUT_QUANTITY COMP_0333_S 8 -40 100 FIX_AXIS_PAR_DIST 0 1 8 /end AXIS_DESCR
/end CHARACTERISTIC
/begin CHARACTERISTIC mTISCSSST "始動時ISC補正値2ﾃｰﾌﾞﾙ(ISC_compensation_value_2_table_at_the_time_of_starting)" CURVE 0x00012024 REC_UBYTE_C 0 COMP_0293 0 510
 /begin AXIS_DESCR FIX_AXIS NO_INPUT_QUANTITY COMP_0333_S 8 -40 100 FIX_AXIS_PAR_DIST 0 1 8 /end AXIS_DESCR
/end CHARACTERISTIC
/begin CHARACTERISTIC mTISCST "始動時ISC補正値1テーブル" CURVE 0x0001202C REC_UBYTE_C 0 COMP_0293 0 510
 /begin AXIS_DESCR FIX_AXIS NO_INPUT_QUANTITY COMP_0333_S 8 -40 100 FIX_AXIS_PAR_DIST 0 1 8 /end AXIS_DESCR
/end CHARACTERISTIC
/begin CHARACTERISTIC mTISCSTST "始動時ISC補正値1ﾃｰﾌﾞﾙ(ISC_compensation_value_1_table_at_the_time_of_starting)" CURVE 0x00012034 REC_UBYTE_C 0 COMP_0293 0 510
 /begin AXIS_DESCR FIX_AXIS NO_INPUT_QUANTITY COMP_0333_S 8 -40 100 FIX_AXIS_PAR_DIST 0 1 8 /end AXIS_DESCR
/end CHARACTERISTIC
/begin CHARACTERISTIC mTISCTA "吸気温補正テーブル" CURVE 0x0001203C REC_UBYTE_C 0 COMP_0009 0 199.21875
 /begin AXIS_DESCR FIX_AXIS NO_INPUT_QUANTITY COMP_0333_S 8 -40 100 FIX_AXIS_PAR_DIST 0 1 8 /end AXIS_DESCR
/end CHARACTERISTIC
/begin CHARACTERISTIC mTISPF "ＴＳ燃圧補正テーブル" CURVE 0x00014692 REC_UWORD_C 0 COMP_0325 -52428.8 52427.2
 /begin AXIS_DESCR FIX_AXIS NO_INPUT_QUANTITY COMP_0432_S 8 0 17.486 FIX_AXIS_PAR_DIST 0 1 8 /end AXIS_DESCR
/end CHARACTERISTIC
/begin CHARACTERISTIC mTISPFVC "INJ電流可変制御作動時ＴＳ燃圧補正ﾃｰﾌﾞﾙ（TS_fuel-pressure_compensation_table_at_variable_injector_driving_current_control" CURVE 0x000146A2 REC_UWORD_C 0 COMP_0325 -52428.8 52427.2
 /begin AXIS_DESCR FIX_AXIS NO_INPUT_QUANTITY COMP_0432_S 8 0 17.486 FIX_AXIS_PAR_DIST 0 1 8 /end AXIS_DESCR
/end CHARACTERISTIC
/begin CHARACTERISTIC mTISRCS "I/Sリカバー判定時間テーブル" CURVE 0x00012044 REC_UBYTE_C 0 COMP_0105 0 25.5
 /begin AXIS_DESCR COM_AXIS NO_INPUT_QUANTITY COMP_0035 8 -50 205 AXIS_PTS_REF mTXISRCV /end AXIS_DESCR
/end CHARACTERISTIC
/begin CHARACTERISTIC mTISTGTM "再始動ﾘｯﾁｽﾊﾟｲｸ後目標A/F設定時間(HEV以外のI/S採用車）" CURVE 0x0001204C REC_UBYTE_C 0 COMP_0049 0 255
 /begin AXIS_DESCR COM_AXIS NO_INPUT_QUANTITY COMP_0004_S 8 -50 205 AXIS_PTS_REF mLTISTGTM /end AXIS_DESCR
/end CHARACTERISTIC
/begin CHARACTERISTIC mTKADVA "K2Yテーブル" CURVE 0x00012084 REC_UBYTE_C 0 COMP_0174_S 0 255
 /begin AXIS_DESCR FIX_AXIS NO_INPUT_QUANTITY COMP_0433_S 8 0 56 FIX_AXIS_PAR_DIST 0 1 8 /end AXIS_DESCR
/end CHARACTERISTIC
/begin CHARACTERISTIC mTKADVR "K1テーブル" CURVE 0x0001208C REC_UBYTE_C 0 COMP_0174_S 0 255
 /begin AXIS_DESCR FIX_AXIS NO_INPUT_QUANTITY COMP_0433_S 8 0 56 FIX_AXIS_PAR_DIST 0 1 8 /end AXIS_DESCR
/end CHARACTERISTIC
/begin CHARACTERISTIC mTKANBAKU "完爆判定用エンジン回転数テーブル" CURVE 0x00012094 REC_UBYTE_C 0 COMP_0006 0 3187.5
 /begin AXIS_DESCR FIX_AXIS NO_INPUT_QUANTITY COMP_0333_S 8 -40 100 FIX_AXIS_PAR_DIST 0 1 8 /end AXIS_DESCR
/end CHARACTERISTIC
/begin CHARACTERISTIC mTKCVSP "車速補正係数テーブル" CURVE 0x000120DC REC_UBYTE_C 0 COMP_0009 0 199.21875
 /begin AXIS_DESCR FIX_AXIS NO_INPUT_QUANTITY COMP_0434_S 8 0 112 FIX_AXIS_PAR_DIST 0 1 8 /end AXIS_DESCR
/end CHARACTERISTIC
/begin CHARACTERISTIC mTKHTTW1 "高水温増量補正ﾃｰﾌﾞﾙ" CURVE 0x000120F4 REC_UBYTE_C 0 COMP_0045 0 1.9921875
 /begin AXIS_DESCR FIX_AXIS NO_INPUT_QUANTITY COMP_0435_S 8 80 115 FIX_AXIS_PAR_DIST 0 1 8 /end AXIS_DESCR
/end CHARACTERISTIC
/begin CHARACTERISTIC mTKIGAIN2 "I分ｹﾞｲﾝﾃｰﾌﾞﾙ" CURVE 0x000146E2 REC_UWORD_C 0 COMP_0081 0 255.99609375
 /begin AXIS_DESCR FIX_AXIS NO_INPUT_QUANTITY COMP_0436_S 8 400 6000 FIX_AXIS_PAR_DIST 0 1 8 /end AXIS_DESCR
/end CHARACTERISTIC
/begin CHARACTERISTIC mTKLMCDL "KMR領域F/Bﾃﾞｨﾚｲ" CURVE 0x00014732 REC_UWORD_C 0 COMP_0105 0 6553.5
 /begin AXIS_DESCR COM_AXIS NO_INPUT_QUANTITY COMP_0217 8 0 3.999941832 AXIS_PTS_REF mDABFKMTM /end AXIS_DESCR
/end CHARACTERISTIC
/begin CHARACTERISTIC mTKMFAS "温度非平衡時分量割合補正率" CURVE 0x000120FC REC_UBYTE_C 0 COMP_0066 0 3.984375
 /begin AXIS_DESCR FIX_AXIS NO_INPUT_QUANTITY COMP_0333_S 8 -40 100 FIX_AXIS_PAR_DIST 0 1 8 /end AXIS_DESCR
/end CHARACTERISTIC
/begin CHARACTERISTIC mTKMFN "分量割合回転補正率" CURVE 0x00012104 REC_UBYTE_C 0 COMP_0044 0 1.9921875
 /begin AXIS_DESCR FIX_AXIS NO_INPUT_QUANTITY COMP_0329_S 8 0 5600 FIX_AXIS_PAR_DIST 0 1 8 /end AXIS_DESCR
/end CHARACTERISTIC
/begin CHARACTERISTIC mTKMRMLBL "LBT相当_当量比テーブル(Target_equivalence_ratio_table_for_LBT)" CURVE 0x0001210C REC_UBYTE_C 0 COMP_0045 0 1.9921875
 /begin AXIS_DESCR COM_AXIS NO_INPUT_QUANTITY COMP_0020 8 0 12750 AXIS_PTS_REF mNETFA /end AXIS_DESCR
/end CHARACTERISTIC
/begin CHARACTERISTIC mTKMRTQ "KMRﾃﾞｨﾚｲ中ﾄﾙｸ補正ﾃｰﾌﾞﾙ" CURVE 0x00012134 REC_UBYTE_C 0 COMP_0063 0 0.99609375
 /begin AXIS_DESCR COM_AXIS NO_INPUT_QUANTITY COMP_0045 8 0 1.9921875 AXIS_PTS_REF mDTFBYA /end AXIS_DESCR
/end CHARACTERISTIC
/begin CHARACTERISTIC mTKPCDN "分割比回転補正ﾃｰﾌﾞﾙ2" CURVE 0x000121EC REC_UBYTE_C 0 COMP_0045 0 1.9921875
 /begin AXIS_DESCR FIX_AXIS NO_INPUT_QUANTITY COMP_0357_S 8 400 3200 FIX_AXIS_PAR_DIST 0 1 8 /end AXIS_DESCR
/end CHARACTERISTIC
/begin CHARACTERISTIC mTKPCDTP "分割比TP補正ﾃｰﾌﾞﾙ2" CURVE 0x000121F4 REC_UBYTE_C 0 COMP_0045 0 1.9921875
 /begin AXIS_DESCR FIX_AXIS NO_INPUT_QUANTITY COMP_0437_S 8 2 16 FIX_AXIS_PAR_DIST 0 1 8 /end AXIS_DESCR
/end CHARACTERISTIC
/begin CHARACTERISTIC mTKPGAIN2 "Ｐ分ｹﾞｲﾝﾃｰﾌﾞﾙ" CURVE 0x000147C2 REC_UWORD_C 0 COMP_0438_S 0 255.99609375
 /begin AXIS_DESCR FIX_AXIS NO_INPUT_QUANTITY COMP_0436_S 8 400 6000 FIX_AXIS_PAR_DIST 0 1 8 /end AXIS_DESCR
/end CHARACTERISTIC
/begin CHARACTERISTIC mTKPWTN "分割比回転補正2ﾃｰﾌﾞﾙ（Division_ratio_rotation_compensation2_table）" CURVE 0x00012204 REC_UBYTE_C 0 COMP_0045 0 1.9921875
 /begin AXIS_DESCR FIX_AXIS NO_INPUT_QUANTITY COMP_0357_S 8 400 3200 FIX_AXIS_PAR_DIST 0 1 8 /end AXIS_DESCR
/end CHARACTERISTIC
/begin CHARACTERISTIC mTKPWTTP "分割比TP補正2ﾃｰﾌﾞﾙ（Division_ratio_TP_compensation_table）" CURVE 0x0001220C REC_UBYTE_C 0 COMP_0045 0 1.9921875
 /begin AXIS_DESCR FIX_AXIS NO_INPUT_QUANTITY COMP_0437_S 8 2 16 FIX_AXIS_PAR_DIST 0 1 8 /end AXIS_DESCR
/end CHARACTERISTIC
/begin CHARACTERISTIC mTKUBAS "温度非平衡基本テーブル" CURVE 0x00012214 REC_UBYTE_C 0 COMP_0044 0 1.9921875
 /begin AXIS_DESCR FIX_AXIS NO_INPUT_QUANTITY COMP_0333_S 8 -40 100 FIX_AXIS_PAR_DIST 0 1 8 /end AXIS_DESCR
/end CHARACTERISTIC
/begin CHARACTERISTIC mTKUBIC2 "温度非平衡負荷テーブル" CURVE 0x0001221C REC_UBYTE_C 0 COMP_0066 0 3.984375
 /begin AXIS_DESCR COM_AXIS NO_INPUT_QUANTITY COMP_0009 8 0 199.21875 AXIS_PTS_REF mLKUBIC /end AXIS_DESCR
/end CHARACTERISTIC
/begin CHARACTERISTIC mTKUBN2 "温度非平衡回転テーブル" CURVE 0x00012224 REC_UBYTE_C 0 COMP_0066 0 3.984375
 /begin AXIS_DESCR COM_AXIS NO_INPUT_QUANTITY COMP_0000 8 0 6375 AXIS_PTS_REF mLKUBN /end AXIS_DESCR
/end CHARACTERISTIC
/begin CHARACTERISTIC mTKWCT1 "フィルタ時定数テーブル" CURVE 0x000147F2 REC_UWORD_C 0 COMP_0146 0 99.998480265
 /begin AXIS_DESCR COM_AXIS NO_INPUT_QUANTITY COMP_0004 8 0 65535 AXIS_PTS_REF mTTKWCT /end AXIS_DESCR
/end CHARACTERISTIC
/begin CHARACTERISTIC mTL2MINH "低燃圧判定値テーブル" CURVE 0x00014802 REC_UWORD_C 0 COMP_0031_S 0 39.97635
 /begin AXIS_DESCR FIX_AXIS NO_INPUT_QUANTITY COMP_0329_S 8 0 5600 FIX_AXIS_PAR_DIST 0 1 8 /end AXIS_DESCR
/end CHARACTERISTIC
/begin CHARACTERISTIC mTLABFLL "LSOSQ放出用目標A/F設定テーブル" CURVE 0x00014812 REC_UWORD_C 0 COMP_0453 0 131.07
 /begin AXIS_DESCR COM_AXIS NO_INPUT_QUANTITY COMP_0430_S 8 -83886.08 83883.52 AXIS_PTS_REF mLABFLL /end AXIS_DESCR
/end CHARACTERISTIC
/begin CHARACTERISTIC mTLMANG "噴射許容最大ｸﾗﾝｸ角ﾃｰﾌﾞﾙ" CURVE 0x00012244 REC_UBYTE_C 0 COMP_0019 0 255
 /begin AXIS_DESCR FIX_AXIS NO_INPUT_QUANTITY COMP_0439_S 8 0 17.5 FIX_AXIS_PAR_DIST 0 1 8 /end AXIS_DESCR
/end CHARACTERISTIC
/begin CHARACTERISTIC mTLMDPMD "CLOSE制御強制開始ﾃﾞｨﾚｲﾃｰﾌﾞﾙ(Closed_loop_control_start_delay_table)" CURVE 0x0001224C REC_UBYTE_C 0 COMP_0015_S 0 25.5
 /begin AXIS_DESCR COM_AXIS NO_INPUT_QUANTITY COMP_0440_S 8 -40 119.375 AXIS_PTS_REF mTWLMDPMD /end AXIS_DESCR
/end CHARACTERISTIC
/begin CHARACTERISTIC mTLOFBP "F/Bｹﾞｲﾝ下限値ﾃｰﾌﾞﾙ" CURVE 0x00014822 REC_UWORD_C 0 COMP_0336_S -32768 32767
 /begin AXIS_DESCR COM_AXIS NO_INPUT_QUANTITY COMP_0006 8 0 819187.5 AXIS_PTS_REF mTXNEFBP /end AXIS_DESCR
/end CHARACTERISTIC
/begin CHARACTERISTIC mTLPTRQ "低圧故障時上限リミットテーブル(Low_pressure_failure_torque_limit_table)" CURVE 0x00014832 REC_UWORD_C 0 COMP_0196 0 6553.5
 /begin AXIS_DESCR COM_AXIS NO_INPUT_QUANTITY COMP_0065 8 0 204796.875 AXIS_PTS_REF mLTLPTRQ /end AXIS_DESCR
/end CHARACTERISTIC
/begin CHARACTERISTIC mTLSNOKHP "ﾎﾟﾝﾌﾟ判定ｶｳﾝﾀｸﾘｱ判定ﾃｰﾌﾞﾙ" CURVE 0x0001225C REC_UBYTE_C 0 COMP_0030 0 255
 /begin AXIS_DESCR FIX_AXIS NO_INPUT_QUANTITY COMP_0329_S 8 0 5600 FIX_AXIS_PAR_DIST 0 1 8 /end AXIS_DESCR
/end CHARACTERISTIC
/begin CHARACTERISTIC mTLSNOKJD "診断カウンタクリア判定テーブル" CURVE 0x00012264 REC_UBYTE_C 0 COMP_0030 0 255
 /begin AXIS_DESCR FIX_AXIS NO_INPUT_QUANTITY COMP_0329_S 8 0 5600 FIX_AXIS_PAR_DIST 0 1 8 /end AXIS_DESCR
/end CHARACTERISTIC
/begin CHARACTERISTIC mTLTRPSL "ﾘﾀｰﾄﾞ作動下限回転ﾃｰﾌﾞﾙ" CURVE 0x0001226C REC_UBYTE_C 0 COMP_0006 0 3187.5
 /begin AXIS_DESCR COM_AXIS NO_INPUT_QUANTITY COMP_0006 8 0 3187.5 AXIS_PTS_REF mTXRMSL /end AXIS_DESCR
/end CHARACTERISTIC
/begin CHARACTERISTIC mTMFHN "付着倍率回転補正率" CURVE 0x000122CC REC_UBYTE_C 0 COMP_0044 0 1.9921875
 /begin AXIS_DESCR FIX_AXIS NO_INPUT_QUANTITY COMP_0329_S 8 0 5600 FIX_AXIS_PAR_DIST 0 1 8 /end AXIS_DESCR
/end CHARACTERISTIC
/begin CHARACTERISTIC mTMKAVN "マイナスKTW補正進角率テーブル(回転)" CURVE 0x00012340 REC_UBYTE_C 0 COMP_0044 0 1.9921875
 /begin AXIS_DESCR FIX_AXIS NO_INPUT_QUANTITY COMP_0357_S 8 400 3200 FIX_AXIS_PAR_DIST 0 1 8 /end AXIS_DESCR
/end CHARACTERISTIC
/begin CHARACTERISTIC mTMKAVP "マイナスKTW補正進角率テーブル(TP)" CURVE 0x00012348 REC_UBYTE_C 0 COMP_0254 0 15.9375
 /begin AXIS_DESCR FIX_AXIS NO_INPUT_QUANTITY COMP_0401_S 8 0 14 FIX_AXIS_PAR_DIST 0 1 8 /end AXIS_DESCR
/end CHARACTERISTIC
/begin CHARACTERISTIC mTMKN "ﾏｲﾅｽKTW_回転補正値テーブル" CURVE 0x00012350 REC_UBYTE_C 0 COMP_0032 0 0.99609375
 /begin AXIS_DESCR FIX_AXIS NO_INPUT_QUANTITY COMP_0347_S 8 0 2800 FIX_AXIS_PAR_DIST 0 1 8 /end AXIS_DESCR
/end CHARACTERISTIC
/begin CHARACTERISTIC mTMKTP "ﾏｲﾅｽKTW_TP補正値テーブル" CURVE 0x00012358 REC_UBYTE_C 0 COMP_0032 0 0.99609375
 /begin AXIS_DESCR FIX_AXIS NO_INPUT_QUANTITY COMP_0401_S 8 0 14 FIX_AXIS_PAR_DIST 0 1 8 /end AXIS_DESCR
/end CHARACTERISTIC
/begin CHARACTERISTIC mTMODE5V "回生モード目標発電電圧テーブル" CURVE 0x00012368 REC_UBYTE_C 0 COMP_0033 0 20400
 /begin AXIS_DESCR FIX_AXIS NO_INPUT_QUANTITY COMP_0441_S 8 0 70 FIX_AXIS_PAR_DIST 0 1 8 /end AXIS_DESCR
/end CHARACTERISTIC
/begin CHARACTERISTIC mTNCTCFEQ "吸熱量_CT絶対値補正係数(nature-CT_correction_factor_for_endothermic_quantity)" CURVE 0x000148D2 REC_UWORD_C 0 COMP_0182_S 0 65.535
 /begin AXIS_DESCR COM_AXIS NO_INPUT_QUANTITY COMP_0442_S 8 -50 205.99609375 AXIS_PTS_REF mLNCTCFEQ /end AXIS_DESCR
/end CHARACTERISTIC
/begin CHARACTERISTIC mTNEUPM "ﾏﾆ触媒NE補正項" CURVE 0x000148F2 REC_UWORD_C 0 COMP_0019_S 0 257.000024415
 /begin AXIS_DESCR COM_AXIS NO_INPUT_QUANTITY COMP_0006 8 0 819187.5 AXIS_PTS_REF mLTNEUP /end AXIS_DESCR
/end CHARACTERISTIC
/begin CHARACTERISTIC mTNEUPU "床下触媒NE補正項" CURVE 0x00014902 REC_UWORD_C 0 COMP_0019_S 0 257.000024415
 /begin AXIS_DESCR COM_AXIS NO_INPUT_QUANTITY COMP_0006 8 0 819187.5 AXIS_PTS_REF mLTNEUP /end AXIS_DESCR
/end CHARACTERISTIC
/begin CHARACTERISTIC mTNIEMNE "排気要求冷機Nアイドル目標回転数（The_Emission_request_N_idle_target_number_of_rotations）" CURVE 0x000123C8 REC_UBYTE_C 0 COMP_0006 0 3187.5
 /begin AXIS_DESCR COM_AXIS NO_INPUT_QUANTITY COMP_0443_S 8 0 127500 AXIS_PTS_REF mTNIEMQE /end AXIS_DESCR
/end CHARACTERISTIC
/begin CHARACTERISTIC mTNMEMH "NMEMH参照ﾃｰﾌﾞﾙ" CURVE 0x0001240C REC_UBYTE_C 0 COMP_0006 0 3187.5
 /begin AXIS_DESCR FIX_AXIS NO_INPUT_QUANTITY COMP_0358_S 8 10 80 FIX_AXIS_PAR_DIST 0 1 8 /end AXIS_DESCR
/end CHARACTERISTIC
/begin CHARACTERISTIC mTOWINGSL "トーイング判定スレッショルド" CURVE 0x00014972 REC_UWORD_C 0 COMP_0444_S -32768 32767
 /begin AXIS_DESCR COM_AXIS NO_INPUT_QUANTITY COMP_0248_S 8 0 127.99837455 AXIS_PTS_REF mSPCVVL /end AXIS_DESCR
/end CHARACTERISTIC
/begin CHARACTERISTIC mTPAMBHK "WOT時充填効率大気圧補正係数テーブル値" CURVE 0x000124E4 REC_UBYTE_C 0 COMP_0045 0 1.9921875
 /begin AXIS_DESCR FIX_AXIS NO_INPUT_QUANTITY COMP_0445_S 8 0 112 FIX_AXIS_PAR_DIST 0 1 8 /end AXIS_DESCR
/end CHARACTERISTIC
/begin CHARACTERISTIC mTPBTANMN "コレクタorスロットル上流吸気温センサ目標過給圧補正値テーブル" CURVE 0x00014982 REC_UWORD_C 0 COMP_0446_S -100 16283.75
 /begin AXIS_DESCR COM_AXIS NO_INPUT_QUANTITY COMP_0383 8 -50 205.99609375 AXIS_PTS_REF mLPBTANMN /end AXIS_DESCR
/end CHARACTERISTIC
/begin CHARACTERISTIC mTPBTWN "水温目標過給圧補正値テーブル" CURVE 0x00014992 REC_UWORD_C 0 COMP_0446_S -100 16283.75
 /begin AXIS_DESCR COM_AXIS NO_INPUT_QUANTITY COMP_0035 8 -50 65485 AXIS_PTS_REF mLPBTWN /end AXIS_DESCR
/end CHARACTERISTIC
/begin CHARACTERISTIC mTPCTLR "後O2ｾﾝｻ_F/B_ALPCAT_LEAN_P分ﾃｰﾌﾞﾙ" CURVE 0x000149A2 REC_UWORD_C 0 COMP_0163 0 4095.9375
 /begin AXIS_DESCR COM_AXIS NO_INPUT_QUANTITY COMP_0068 8 0 65535 AXIS_PTS_REF mTPIQM /end AXIS_DESCR
/end CHARACTERISTIC
/begin CHARACTERISTIC mTPCTRL "後O2ｾﾝｻ_F/B_ALPCAT_RICH_P分ﾃｰﾌﾞﾙ" CURVE 0x000149B2 REC_UWORD_C 0 COMP_0163 0 4095.9375
 /begin AXIS_DESCR COM_AXIS NO_INPUT_QUANTITY COMP_0068 8 0 65535 AXIS_PTS_REF mTPIQM /end AXIS_DESCR
/end CHARACTERISTIC
/begin CHARACTERISTIC mTPDNSLIM "最大ﾊﾟｰｼﾞ率ﾊﾟｰｼﾞ濃度制限ﾃｰﾌﾞﾙ" CURVE 0x0001252C REC_UBYTE_C 0 COMP_0034 0 63.75
 /begin AXIS_DESCR COM_AXIS NO_INPUT_QUANTITY COMP_0447_S 8 0 63.75 AXIS_PTS_REF mJKPDNSLM /end AXIS_DESCR
/end CHARACTERISTIC
/begin CHARACTERISTIC mTPGBKOFF "ﾌﾞﾚｰｷOFF時車両許容減速Gﾃｰﾌﾞﾙ（Brake_off_permissible_deceleration_G_table）" CURVE 0x00012534 REC_UBYTE_C 0 COMP_0130_S 0 0.255
 /begin AXIS_DESCR COM_AXIS NO_INPUT_QUANTITY COMP_0429 8 0 255 AXIS_PTS_REF mTTPGVSP /end AXIS_DESCR
/end CHARACTERISTIC
/begin CHARACTERISTIC mTPGBKON "ﾌﾞﾚｰｷON時車両許容減速Gﾃｰﾌﾞﾙ（Brake_on_permissible_deceleration_G_table）" CURVE 0x0001253C REC_UBYTE_C 0 COMP_0130_S 0 0.255
 /begin AXIS_DESCR COM_AXIS NO_INPUT_QUANTITY COMP_0429 8 0 255 AXIS_PTS_REF mTTPGVSP /end AXIS_DESCR
/end CHARACTERISTIC
/begin CHARACTERISTIC mTPIGLMTR "低回転ﾌﾟﾚｲｸﾞ回避QH0ｶｯﾄ量(ﾚｷﾞｭﾗｰ時)(Pre-ignition_evasion_control_amount_of_QH0_cutting(regular_gasoline))" CURVE 0x00014B02 REC_UWORD_C 0 COMP_0146 0 99.998480265
 /begin AXIS_DESCR FIX_AXIS NO_INPUT_QUANTITY COMP_0354_S 8 0 1400 FIX_AXIS_PAR_DIST 0 1 8 /end AXIS_DESCR
/end CHARACTERISTIC
/begin CHARACTERISTIC mTPLINJTI "低回転時ﾌﾟﾚｲｸﾞ回避IT許可ﾊﾟﾙｽ幅下限" CURVE 0x00012544 REC_UBYTE_C 0 COMP_0213_S 0 20400
 /begin AXIS_DESCR COM_AXIS NO_INPUT_QUANTITY COMP_0006 8 0 3187.5 AXIS_PTS_REF mNLINJTI /end AXIS_DESCR
/end CHARACTERISTIC
/begin CHARACTERISTIC mTPVJDGTM "ﾊﾟｰｼﾞｺﾝﾄﾛｰﾙﾊﾞﾙﾌﾞﾘｰｸ診断判定時間ﾃｰﾌﾞﾙ" CURVE 0x000125A4 REC_UBYTE_C 0 COMP_0013 0 255
 /begin AXIS_DESCR COM_AXIS NO_INPUT_QUANTITY COMP_0156 8 0 255 AXIS_PTS_REF mSPCVLL /end AXIS_DESCR
/end CHARACTERISTIC
/begin CHARACTERISTIC mTQACROFF "A/C起動時補正空気量ﾃｰﾌﾞﾙ" CURVE 0x000125AC REC_UBYTE_C 0 COMP_0051 0 255
 /begin AXIS_DESCR FIX_AXIS NO_INPUT_QUANTITY COMP_0415_S 8 0 2.8 FIX_AXIS_PAR_DIST 0 1 8 /end AXIS_DESCR
/end CHARACTERISTIC
/begin CHARACTERISTIC mTQACRON "A/C駆動時補正空気量ﾃｰﾌﾞﾙ" CURVE 0x000125B4 REC_UBYTE_C 0 COMP_0051 0 255
 /begin AXIS_DESCR FIX_AXIS NO_INPUT_QUANTITY COMP_0415_S 8 0 2.8 FIX_AXIS_PAR_DIST 0 1 8 /end AXIS_DESCR
/end CHARACTERISTIC
/begin CHARACTERISTIC mTQADLY "リアO2スライスよぎり後リッチ化要求時間テーブル" CURVE 0x00014B82 REC_UWORD_C 0 COMP_0040_S 0 655.35
 /begin AXIS_DESCR COM_AXIS NO_INPUT_QUANTITY COMP_0040_S 8 0 655.35 AXIS_PTS_REF mLFCCNT /end AXIS_DESCR
/end CHARACTERISTIC
/begin CHARACTERISTIC mTQAIGN "積分ｹﾞｲﾝQA補正ﾃｰﾌﾞﾙ" CURVE 0x00014B92 REC_UWORD_C 0 COMP_0388 0 6553.5
 /begin AXIS_DESCR COM_AXIS NO_INPUT_QUANTITY COMP_0220 8 0 65535 AXIS_PTS_REF mLQARANGE /end AXIS_DESCR
/end CHARACTERISTIC
/begin CHARACTERISTIC mTQAIGN2 "積分ｹﾞｲﾝQA補正ﾃｰﾌﾞﾙ(ﾊﾞﾝｸ2)" CURVE 0x00014BA2 REC_UWORD_C 0 COMP_0388 0 6553.5
 /begin AXIS_DESCR COM_AXIS NO_INPUT_QUANTITY COMP_0220 8 0 65535 AXIS_PTS_REF mLQARANGE /end AXIS_DESCR
/end CHARACTERISTIC
/begin CHARACTERISTIC mTQALTMXK "電気負荷補正ﾘﾐｯﾀﾃｰﾌﾞﾙ改(Electric_load_compensation_limiter_table)" CURVE 0x000125BC REC_UBYTE_C 0 COMP_0051 0 255
 /begin AXIS_DESCR FIX_AXIS NO_INPUT_QUANTITY COMP_0448_S 8 500 1200 FIX_AXIS_PAR_DIST 0 1 8 /end AXIS_DESCR
/end CHARACTERISTIC
/begin CHARACTERISTIC mTQDMPTSF "TS用流量ﾌｨﾙﾀ係数ﾃｰﾌﾞﾙ" CURVE 0x00014BB2 REC_UWORD_C 0 COMP_0290 0 0.999985458
 /begin AXIS_DESCR COM_AXIS NO_INPUT_QUANTITY COMP_0063 8 0 255.99609375 AXIS_PTS_REF mQDMPQH0 /end AXIS_DESCR
/end CHARACTERISTIC
/begin CHARACTERISTIC mTQENST20 "エンジン回転低下時空気補正量テーブル20(Air_correction_amount_table_when_engine_rotation_decreases_20)" CURVE 0x000125EC REC_UBYTE_C 0 COMP_0051 0 255
 /begin AXIS_DESCR COM_AXIS NO_INPUT_QUANTITY COMP_0006 8 0 3187.5 AXIS_PTS_REF mTQENSTNE /end AXIS_DESCR
/end CHARACTERISTIC
/begin CHARACTERISTIC mTQEPINIM "ﾏﾆ触媒熱量初期値" CURVE 0x00014BC2 REC_UWORD_C 0 COMP_0068 0 65535
 /begin AXIS_DESCR COM_AXIS NO_INPUT_QUANTITY COMP_0035 8 -50 65485 AXIS_PTS_REF mLQEPINI /end AXIS_DESCR
/end CHARACTERISTIC
/begin CHARACTERISTIC mTQEPINIU "床下触媒熱量初期値" CURVE 0x00014BD2 REC_UWORD_C 0 COMP_0068 0 65535
 /begin AXIS_DESCR COM_AXIS NO_INPUT_QUANTITY COMP_0035 8 -50 65485 AXIS_PTS_REF mLQEPINIU /end AXIS_DESCR
/end CHARACTERISTIC
/begin CHARACTERISTIC mTQFBIMAX "F/B_I分上限値テーブル" CURVE 0x000125FC REC_UBYTE_C 0 COMP_0051 0 255
 /begin AXIS_DESCR FIX_AXIS NO_INPUT_QUANTITY COMP_0333_S 8 -40 100 FIX_AXIS_PAR_DIST 0 1 8 /end AXIS_DESCR
/end CHARACTERISTIC
/begin CHARACTERISTIC mTQFBIMIN "F/B_I分下限値テーブル" CURVE 0x00012604 REC_SBYTE_C 0 COMP_0277 -128 127
 /begin AXIS_DESCR FIX_AXIS NO_INPUT_QUANTITY COMP_0333_S 8 -40 100 FIX_AXIS_PAR_DIST 0 1 8 /end AXIS_DESCR
/end CHARACTERISTIC
/begin CHARACTERISTIC mTQFBIMNH "均質時F/B_I分下限値テーブル" CURVE 0x0001260C REC_SBYTE_C 0 COMP_0277 -128 127
 /begin AXIS_DESCR FIX_AXIS NO_INPUT_QUANTITY COMP_0333_S 8 -40 100 FIX_AXIS_PAR_DIST 0 1 8 /end AXIS_DESCR
/end CHARACTERISTIC
/begin CHARACTERISTIC mTQFBIMNS "成層時F/B_I分下限値テーブル" CURVE 0x00012614 REC_SBYTE_C 0 COMP_0277 -128 127
 /begin AXIS_DESCR FIX_AXIS NO_INPUT_QUANTITY COMP_0333_S 8 -40 100 FIX_AXIS_PAR_DIST 0 1 8 /end AXIS_DESCR
/end CHARACTERISTIC
/begin CHARACTERISTIC mTQFBIMXH "均質時F/B_I分上限値テーブル" CURVE 0x0001261C REC_UBYTE_C 0 COMP_0051 0 255
 /begin AXIS_DESCR FIX_AXIS NO_INPUT_QUANTITY COMP_0333_S 8 -40 100 FIX_AXIS_PAR_DIST 0 1 8 /end AXIS_DESCR
/end CHARACTERISTIC
/begin CHARACTERISTIC mTQFBIMXS "成層時F/B_I分上限値テーブル" CURVE 0x00012624 REC_UBYTE_C 0 COMP_0051 0 255
 /begin AXIS_DESCR FIX_AXIS NO_INPUT_QUANTITY COMP_0333_S 8 -40 100 FIX_AXIS_PAR_DIST 0 1 8 /end AXIS_DESCR
/end CHARACTERISTIC
/begin CHARACTERISTIC mTQFUSOKU "低圧燃料系流量不足時上限リミットテーブル(Shortage_fuel_quantity_torque_limit_table)" CURVE 0x00014BE2 REC_UWORD_C 0 COMP_0196 0 6553.5
 /begin AXIS_DESCR COM_AXIS NO_INPUT_QUANTITY COMP_0065 8 0 204796.875 AXIS_PTS_REF mLTQFSK /end AXIS_DESCR
/end CHARACTERISTIC
/begin CHARACTERISTIC mTQH0VSP "QH0上限車速テーブル" CURVE 0x00014C52 REC_UWORD_C 0 COMP_0115 0 99.9998565
 /begin AXIS_DESCR FIX_AXIS NO_INPUT_QUANTITY COMP_0449_S 8 0 44.8 FIX_AXIS_PAR_DIST 0 1 8 /end AXIS_DESCR
/end CHARACTERISTIC
/begin CHARACTERISTIC mTQLETW "ﾘｰﾝ化時空気量補正水温ﾃｰﾌﾞﾙ" CURVE 0x0001263C REC_UBYTE_C 0 COMP_0027 0 255
 /begin AXIS_DESCR COM_AXIS NO_INPUT_QUANTITY COMP_0356 8 -40 119.375 AXIS_PTS_REF mTXTWC /end AXIS_DESCR
/end CHARACTERISTIC
/begin CHARACTERISTIC mTQO2S "診断ﾘｯﾁ時O2不足量" CURVE 0x00014CA2 REC_UWORD_C 0 COMP_0068 0 65535
 /begin AXIS_DESCR COM_AXIS NO_INPUT_QUANTITY COMP_0068 8 0 65535 AXIS_PTS_REF mLTQO2S /end AXIS_DESCR
/end CHARACTERISTIC
/begin CHARACTERISTIC mTQO2S2 "診断ﾘｯﾁ時O2不足量(Bank2)" CURVE 0x00014CB2 REC_UWORD_C 0 COMP_0068 0 65535
 /begin AXIS_DESCR COM_AXIS NO_INPUT_QUANTITY COMP_0068 8 0 65535 AXIS_PTS_REF mLTQO2S /end AXIS_DESCR
/end CHARACTERISTIC
/begin CHARACTERISTIC mTQTO "エンジン油温補正空気量テーブル" CURVE 0x0001264C REC_UBYTE_C 0 COMP_0051 0 255
 /begin AXIS_DESCR FIX_AXIS NO_INPUT_QUANTITY COMP_0333_S 8 -40 100 FIX_AXIS_PAR_DIST 0 1 8 /end AXIS_DESCR
/end CHARACTERISTIC
/begin CHARACTERISTIC mTQTOAT1 "TM油温補正空気量テーブル" CURVE 0x00012654 REC_UBYTE_C 0 COMP_0051 0 255
 /begin AXIS_DESCR COM_AXIS NO_INPUT_QUANTITY COMP_0016 8 0 255 AXIS_PTS_REF mTATTEMP /end AXIS_DESCR
/end CHARACTERISTIC
/begin CHARACTERISTIC mTQTRQINI "触媒熱量初期値" CURVE 0x00014CC2 REC_UWORD_C 0 COMP_0068 0 65535
 /begin AXIS_DESCR COM_AXIS NO_INPUT_QUANTITY COMP_0035 8 -50 65485 AXIS_PTS_REF mLQTRQINI /end AXIS_DESCR
/end CHARACTERISTIC
/begin CHARACTERISTIC mTQTRQSLB "熱量診断クライテリア(Nﾚﾝｼﾞ)（DIG/エリアB）" CURVE 0x00014CD2 REC_UWORD_C 0 COMP_0068 0 65535
 /begin AXIS_DESCR COM_AXIS NO_INPUT_QUANTITY COMP_0035 8 -50 65485 AXIS_PTS_REF mLQTRQSLB /end AXIS_DESCR
/end CHARACTERISTIC
/begin CHARACTERISTIC mTQTRQSLC "熱量診断クライテリア(Nﾚﾝｼﾞ)（DIG/エリアC）" CURVE 0x00014CE2 REC_UWORD_C 0 COMP_0068 0 65535
 /begin AXIS_DESCR COM_AXIS NO_INPUT_QUANTITY COMP_0035 8 -50 65485 AXIS_PTS_REF mLQTRQSLC /end AXIS_DESCR
/end CHARACTERISTIC
/begin CHARACTERISTIC mTQTRQSLD "熱量診断クライテリア(Dﾚﾝｼﾞ)" CURVE 0x00014CF2 REC_UWORD_C 0 COMP_0068 0 65535
 /begin AXIS_DESCR COM_AXIS NO_INPUT_QUANTITY COMP_0035 8 -50 65485 AXIS_PTS_REF mLQTRQSLD /end AXIS_DESCR
/end CHARACTERISTIC
/begin CHARACTERISTIC mTQTRQSLN "熱量診断クライテリア(Nﾚﾝｼﾞ)" CURVE 0x00014D02 REC_UWORD_C 0 COMP_0068 0 65535
 /begin AXIS_DESCR COM_AXIS NO_INPUT_QUANTITY COMP_0035 8 -50 65485 AXIS_PTS_REF mLQTRQSLN /end AXIS_DESCR
/end CHARACTERISTIC
/begin CHARACTERISTIC mTQTW "水温補正空気流量テーブル" CURVE 0x0001265C REC_UBYTE_C 0 COMP_0276 0 1020
 /begin AXIS_DESCR FIX_AXIS NO_INPUT_QUANTITY COMP_0333_S 8 -40 100 FIX_AXIS_PAR_DIST 0 1 8 /end AXIS_DESCR
/end CHARACTERISTIC
/begin CHARACTERISTIC mTRAPDLT "急減速ｴｱｺﾝｶｯﾄ判定ﾃｰﾌﾞﾙ" CURVE 0x00012664 REC_UBYTE_C 0 COMP_0082_S 0 255
 /begin AXIS_DESCR COM_AXIS NO_INPUT_QUANTITY COMP_0006 8 0 3187.5 AXIS_PTS_REF mTRAPNE /end AXIS_DESCR
/end CHARACTERISTIC
/begin CHARACTERISTIC mTRATIO8 "変速比テーブル" CURVE 0x00014D3C REC_UWORD_C 0 COMP_0450 0 63.999056205
 /begin AXIS_DESCR FIX_AXIS NO_INPUT_QUANTITY COMP_0068 8 0 7 FIX_AXIS_PAR_DIST 0 1 8 /end AXIS_DESCR
/end CHARACTERISTIC
/begin CHARACTERISTIC mTRATIRON "TCV補正量係数テーブル" CURVE 0x00014D56 REC_UWORD_C 0 COMP_0045 0 511.9921875
 /begin AXIS_DESCR COM_AXIS NO_INPUT_QUANTITY COMP_0235_S 8 0 8191.875 AXIS_PTS_REF mRATIRONT /end AXIS_DESCR
/end CHARACTERISTIC
/begin CHARACTERISTIC mTRCSOKTP "触媒保護燃料ｶｯﾄﾘｶﾊﾞ領域判定用ﾃｰﾌﾞﾙ" CURVE 0x00012674 REC_UBYTE_C 0 COMP_0001 0 31.875
 /begin AXIS_DESCR COM_AXIS NO_INPUT_QUANTITY COMP_0000 8 0 6375 AXIS_PTS_REF mNFSOKO /end AXIS_DESCR
/end CHARACTERISTIC
/begin CHARACTERISTIC mTRECVOPN "ﾘｻｰｷｭﾚｰｼｮﾝﾊﾞﾙﾌﾞ開閉ｸﾗｲﾃﾘｱﾃｰﾌﾞﾙ" CURVE 0x00014D66 REC_UWORD_C 0 COMP_0450_S -1023.96875 1024
 /begin AXIS_DESCR COM_AXIS NO_INPUT_QUANTITY COMP_0000 8 0 1638375 AXIS_PTS_REF mTRECVRPM /end AXIS_DESCR
/end CHARACTERISTIC
/begin CHARACTERISTIC mTREGEND "A/CON時ブレーキOFF時回生禁止車速_PD圧テーブル" CURVE 0x00012690 REC_UBYTE_C 0 COMP_0007 0 510
 /begin AXIS_DESCR FIX_AXIS NO_INPUT_QUANTITY COMP_0415_S 8 0 2.8 FIX_AXIS_PAR_DIST 0 1 8 /end AXIS_DESCR
/end CHARACTERISTIC
/begin CHARACTERISTIC mTRESADV "スタータモータ駆動制御作動時点火時期テーブル(Ignition_timing_tabel_of＿_Starter_Motor_Relay_Control))" CURVE 0x00012698 REC_UBYTE_C 0 COMP_0314 -128 127
 /begin AXIS_DESCR FIX_AXIS NO_INPUT_QUANTITY COMP_0333_S 8 -40 100 FIX_AXIS_PAR_DIST 0 1 8 /end AXIS_DESCR
/end CHARACTERISTIC
/begin CHARACTERISTIC mTRETLIM "アイドル時相対値要求リタード側リミッタテーブル(Relative_value_demand_Ritard_side_limiter_table_at_idol)" CURVE 0x000126A0 REC_UBYTE_C 0 COMP_0314 -128 127
 /begin AXIS_DESCR COM_AXIS NO_INPUT_QUANTITY COMP_0356 8 -40 119.375 AXIS_PTS_REF mGRETLM /end AXIS_DESCR
/end CHARACTERISTIC
/begin CHARACTERISTIC mTRETLML "アイドル時相対値要求リタード側リミッタテーブル(PI制御時)(Relative_value_demand_Ritard_side_limiter_table_at_idol_for_PI)" CURVE 0x000126A8 REC_UBYTE_C 0 COMP_0314 -128 127
 /begin AXIS_DESCR COM_AXIS NO_INPUT_QUANTITY COMP_0356 8 -40 119.375 AXIS_PTS_REF mGRETLM /end AXIS_DESCR
/end CHARACTERISTIC
/begin CHARACTERISTIC mTRETLMSL "アイドル時相対値要求リタード側リミッタテーブル(高回転セレクト時)(Relative_value_demand_Ritard_side_limiter_table_at_idolr_PI)" CURVE 0x000126B0 REC_UBYTE_C 0 COMP_0314 -128 127
 /begin AXIS_DESCR COM_AXIS NO_INPUT_QUANTITY COMP_0356 8 -40 119.375 AXIS_PTS_REF mGRETLM /end AXIS_DESCR
/end CHARACTERISTIC
/begin CHARACTERISTIC mTREVH "個別診断回転補正項" CURVE 0x00014D96 REC_UWORD_C 0 COMP_0019_S 0 257.000024415
 /begin AXIS_DESCR COM_AXIS NO_INPUT_QUANTITY COMP_0006 8 0 819187.5 AXIS_PTS_REF mLTREVH /end AXIS_DESCR
/end CHARACTERISTIC
/begin CHARACTERISTIC mTREVHB "個別診断回転補正項（DIG/エリアB）" CURVE 0x00014DA6 REC_UWORD_C 0 COMP_0019_S 0 257.000024415
 /begin AXIS_DESCR COM_AXIS NO_INPUT_QUANTITY COMP_0006 8 0 819187.5 AXIS_PTS_REF mLTREVHB /end AXIS_DESCR
/end CHARACTERISTIC
/begin CHARACTERISTIC mTREVHC "個別診断回転補正項（DIG/エリアC）" CURVE 0x00014DB6 REC_UWORD_C 0 COMP_0019_S 0 257.000024415
 /begin AXIS_DESCR COM_AXIS NO_INPUT_QUANTITY COMP_0006 8 0 819187.5 AXIS_PTS_REF mLTREVHC /end AXIS_DESCR
/end CHARACTERISTIC
/begin CHARACTERISTIC mTREVHD "熱量診断回転補正項(Dﾚﾝｼﾞ)" CURVE 0x00014DC6 REC_UWORD_C 0 COMP_0019_S 0 257.000024415
 /begin AXIS_DESCR COM_AXIS NO_INPUT_QUANTITY COMP_0006 8 0 819187.5 AXIS_PTS_REF mLTREVHD /end AXIS_DESCR
/end CHARACTERISTIC
/begin CHARACTERISTIC mTREVHN "熱量診断回転補正項(Nﾚﾝｼﾞ)" CURVE 0x00014DD6 REC_UWORD_C 0 COMP_0019_S 0 257.000024415
 /begin AXIS_DESCR COM_AXIS NO_INPUT_QUANTITY COMP_0006 8 0 819187.5 AXIS_PTS_REF mLTREVHN /end AXIS_DESCR
/end CHARACTERISTIC
/begin CHARACTERISTIC mTREVHNB "熱量診断回転補正項(Nﾚﾝｼﾞ)（DIG/エリアB）" CURVE 0x00014DE6 REC_UWORD_C 0 COMP_0019_S 0 257.000024415
 /begin AXIS_DESCR COM_AXIS NO_INPUT_QUANTITY COMP_0006 8 0 819187.5 AXIS_PTS_REF mLTREVHNB /end AXIS_DESCR
/end CHARACTERISTIC
/begin CHARACTERISTIC mTREVHNC "熱量診断回転補正項(Nﾚﾝｼﾞ)（DIG/エリアC）" CURVE 0x00014DF6 REC_UWORD_C 0 COMP_0019_S 0 257.000024415
 /begin AXIS_DESCR COM_AXIS NO_INPUT_QUANTITY COMP_0006 8 0 819187.5 AXIS_PTS_REF mLTREVHNC /end AXIS_DESCR
/end CHARACTERISTIC
/begin CHARACTERISTIC mTREVSL "個別診断回転側クライテリア" CURVE 0x00014E06 REC_UWORD_C 0 COMP_0403_S 0 3276750
 /begin AXIS_DESCR COM_AXIS NO_INPUT_QUANTITY COMP_0035 8 -50 65485 AXIS_PTS_REF mLTREVSL /end AXIS_DESCR
/end CHARACTERISTIC
/begin CHARACTERISTIC mTREVSLB "個別診断回転側クライテリア（DIG/エリアB）" CURVE 0x00014E16 REC_UWORD_C 0 COMP_0403_S 0 3276750
 /begin AXIS_DESCR COM_AXIS NO_INPUT_QUANTITY COMP_0035 8 -50 65485 AXIS_PTS_REF mLTREVSLB /end AXIS_DESCR
/end CHARACTERISTIC
/begin CHARACTERISTIC mTREVSLC "個別診断回転側クライテリア（DIG/エリアC）" CURVE 0x00014E26 REC_UWORD_C 0 COMP_0403_S 0 3276750
 /begin AXIS_DESCR COM_AXIS NO_INPUT_QUANTITY COMP_0035 8 -50 65485 AXIS_PTS_REF mLTREVSLC /end AXIS_DESCR
/end CHARACTERISTIC
/begin CHARACTERISTIC mTREVSLD "個別診断エンジン回転数側NG判定クライテリア" CURVE 0x00014E36 REC_UWORD_C 0 COMP_0006 0 819187.5
 /begin AXIS_DESCR COM_AXIS NO_INPUT_QUANTITY COMP_0035 8 -50 65485 AXIS_PTS_REF mLTREVSLD /end AXIS_DESCR
/end CHARACTERISTIC
/begin CHARACTERISTIC mTRLDFD "平坦路走行抵抗ﾃｰﾌﾞﾙ" CURVE 0x00014E46 REC_UWORD_C 0 COMP_0315_S -32768 32767
 /begin AXIS_DESCR COM_AXIS NO_INPUT_QUANTITY COMP_0436 8 0 6553.5 AXIS_PTS_REF mTRLVSP /end AXIS_DESCR
/end CHARACTERISTIC
/begin CHARACTERISTIC mTRMDHOS "当量比補正テーブル" CURVE 0x000126C2 REC_UBYTE_C 0 COMP_0009 0 199.21875
 /begin AXIS_DESCR FIX_AXIS NO_INPUT_QUANTITY COMP_0423_S 8 0.5 1.375 FIX_AXIS_PAR_DIST 0 1 8 /end AXIS_DESCR
/end CHARACTERISTIC
/begin CHARACTERISTIC mTSAOSC "LSOSQ_O2吸着率ﾃｰﾌﾞﾙ" CURVE 0x00014EC6 REC_UWORD_C 0 COMP_0456 0 1.999970916
 /begin AXIS_DESCR COM_AXIS NO_INPUT_QUANTITY COMP_0430_S 8 -83886.08 83883.52 AXIS_PTS_REF mTXSAOSC /end AXIS_DESCR
/end CHARACTERISTIC
/begin CHARACTERISTIC mTSATMP "LSOSQ触媒温度O2吸着率ﾃｰﾌﾞﾙ" CURVE 0x00012732 REC_UBYTE_C 0 COMP_0045 0 1.9921875
 /begin AXIS_DESCR COM_AXIS NO_INPUT_QUANTITY COMP_0062 8 0 1020 AXIS_PTS_REF mTXSATMP /end AXIS_DESCR
/end CHARACTERISTIC
/begin CHARACTERISTIC mTSCKRET "再加速ショックリタードテーブル" CURVE 0x00014EE0 REC_UWORD_C 0 COMP_0017 0 65535
 /begin AXIS_DESCR FIX_AXIS NO_INPUT_QUANTITY COMP_0399_S 8 0 49.28 FIX_AXIS_PAR_DIST 0 1 8 /end AXIS_DESCR
/end CHARACTERISTIC
/begin CHARACTERISTIC mTSCKRTRT "再加速ショックリタードテーブル(RATIO参照)_" CURVE 0x00014EF0 REC_UWORD_C 0 COMP_0017 0 65535
 /begin AXIS_DESCR FIX_AXIS NO_INPUT_QUANTITY COMP_0451_S 8 0.5 2.25 FIX_AXIS_PAR_DIST 0 1 8 /end AXIS_DESCR
/end CHARACTERISTIC
/begin CHARACTERISTIC mTSENNRPM "エンジン回転数リミッタテーブル" CURVE 0x0001273A REC_UBYTE_C 0 COMP_0000 0 6375
 /begin AXIS_DESCR FIX_AXIS NO_INPUT_QUANTITY COMP_0434_S 8 0 112 FIX_AXIS_PAR_DIST 0 1 8 /end AXIS_DESCR
/end CHARACTERISTIC
/begin CHARACTERISTIC mTSFSTT "始動後気筒別制御禁止ディレイ" CURVE 0x0001274A REC_UBYTE_C 0 COMP_0008 0 25500
 /begin AXIS_DESCR FIX_AXIS NO_INPUT_QUANTITY COMP_0333_S 8 -40 100 FIX_AXIS_PAR_DIST 0 1 8 /end AXIS_DESCR
/end CHARACTERISTIC
/begin CHARACTERISTIC mTSLCFBP "F/BPゲイン（ﾘﾀｰﾄﾞ有り時）ﾃｰﾌﾞﾙ" CURVE 0x00014F00 REC_UWORD_C 0 COMP_0427_S -163.84 163.835
 /begin AXIS_DESCR COM_AXIS NO_INPUT_QUANTITY COMP_0006 8 0 819187.5 AXIS_PTS_REF mLSLCFBP /end AXIS_DESCR
/end CHARACTERISTIC
/begin CHARACTERISTIC mTSLOPOKH "成層燃焼可能勾配領域ﾃｰﾌﾞﾙHIGH" CURVE 0x00014F10 REC_UWORD_C 0 COMP_0452_S -327.68 327.67
 /begin AXIS_DESCR COM_AXIS NO_INPUT_QUANTITY COMP_0123_S 8 0 127.998046875 AXIS_PTS_REF mTLSLOPOK /end AXIS_DESCR
/end CHARACTERISTIC
/begin CHARACTERISTIC mTSLOPOKL "成層燃焼可能勾配領域ﾃｰﾌﾞﾙLOW" CURVE 0x00014F20 REC_UWORD_C 0 COMP_0452_S -327.68 327.67
 /begin AXIS_DESCR COM_AXIS NO_INPUT_QUANTITY COMP_0123_S 8 0 127.998046875 AXIS_PTS_REF mTLSLOPOK /end AXIS_DESCR
/end CHARACTERISTIC
/begin CHARACTERISTIC mTSLPISC "トルコン負荷補正係数ﾃｰﾌﾞﾙ" CURVE 0x00012752 REC_UBYTE_C 0 COMP_0453_S -2 1.984375
 /begin AXIS_DESCR COM_AXIS NO_INPUT_QUANTITY COMP_0186 8 0 3.984375 AXIS_PTS_REF mSLPRT /end AXIS_DESCR
/end CHARACTERISTIC
/begin CHARACTERISTIC mTSQASL "SQASLテーブル" CURVE 0x0001275E REC_UBYTE_C 0 COMP_0291 0 2611.2
 /begin AXIS_DESCR FIX_AXIS NO_INPUT_QUANTITY COMP_0333_S 8 -40 100 FIX_AXIS_PAR_DIST 0 1 8 /end AXIS_DESCR
/end CHARACTERISTIC
/begin CHARACTERISTIC mTSROSC "LSOSQ_O2放出率ﾃｰﾌﾞﾙ" CURVE 0x00014F90 REC_UWORD_C 0 COMP_0456 0 1.999970916
 /begin AXIS_DESCR COM_AXIS NO_INPUT_QUANTITY COMP_0430_S 8 -83886.08 83883.52 AXIS_PTS_REF mTXSROSC /end AXIS_DESCR
/end CHARACTERISTIC
/begin CHARACTERISTIC mTSRTMP "LSOSQ触媒温度O2放出率ﾃｰﾌﾞﾙ" CURVE 0x0001276E REC_UBYTE_C 0 COMP_0045 0 1.9921875
 /begin AXIS_DESCR COM_AXIS NO_INPUT_QUANTITY COMP_0062 8 0 1020 AXIS_PTS_REF mTXSRTMP /end AXIS_DESCR
/end CHARACTERISTIC
/begin CHARACTERISTIC mTSTBTW "安定性補正率基本ﾃｰﾌﾞﾙ" CURVE 0x00012776 REC_UBYTE_C 0 COMP_0044 0 1.9921875
 /begin AXIS_DESCR FIX_AXIS NO_INPUT_QUANTITY COMP_0333_S 8 -40 100 FIX_AXIS_PAR_DIST 0 1 8 /end AXIS_DESCR
/end CHARACTERISTIC
/begin CHARACTERISTIC mTSTBTWST "成層始動用安定性補正率基本テーブル" CURVE 0x0001277E REC_UBYTE_C 0 COMP_0045 0 1.9921875
 /begin AXIS_DESCR FIX_AXIS NO_INPUT_QUANTITY COMP_0333_S 8 -40 100 FIX_AXIS_PAR_DIST 0 1 8 /end AXIS_DESCR
/end CHARACTERISTIC
/begin CHARACTERISTIC mTSTDVTO "VTC始動後ﾃﾞｨﾚｲ油温ﾃｰﾌﾞﾙ" CURVE 0x00012786 REC_UBYTE_C 0 COMP_0008 0 25500
 /begin AXIS_DESCR COM_AXIS NO_INPUT_QUANTITY COMP_0035 8 -50 205 AXIS_PTS_REF mLSTDVTO /end AXIS_DESCR
/end CHARACTERISTIC
/begin CHARACTERISTIC mTSTDVTW "VTC始動後ﾃﾞｨﾚｲ水温ﾃｰﾌﾞﾙ" CURVE 0x0001278E REC_UBYTE_C 0 COMP_0008 0 25500
 /begin AXIS_DESCR COM_AXIS NO_INPUT_QUANTITY COMP_0356 8 -40 119.375 AXIS_PTS_REF mLSTDVTW /end AXIS_DESCR
/end CHARACTERISTIC
/begin CHARACTERISTIC mTSTLIMIT "スタータモーターON継続時間上限テーブル" CURVE 0x0001279A REC_UBYTE_C 0 COMP_0013 0 255
 /begin AXIS_DESCR FIX_AXIS NO_INPUT_QUANTITY COMP_0333_S 8 -40 100 FIX_AXIS_PAR_DIST 0 1 8 /end AXIS_DESCR
/end CHARACTERISTIC
/begin CHARACTERISTIC mTTAMBHK "WOT時充填効率吸気温補正係数テーブル値" CURVE 0x000127C2 REC_UBYTE_C 0 COMP_0045 0 1.9921875
 /begin AXIS_DESCR FIX_AXIS NO_INPUT_QUANTITY COMP_0333_S 8 -40 100 FIX_AXIS_PAR_DIST 0 1 8 /end AXIS_DESCR
/end CHARACTERISTIC
/begin CHARACTERISTIC mTTANPGHT "ハイオクプレイグ回避用下限吸気温テーブル(Minimum_intake_air_temperature_table_high-octane_gasloine_pre-ignition_evasion)" CURVE 0x000127CA REC_UBYTE_C 0 COMP_0035 -50 205
 /begin AXIS_DESCR COM_AXIS NO_INPUT_QUANTITY COMP_0035 8 -50 205 AXIS_PTS_REF mTTWNPILN /end AXIS_DESCR
/end CHARACTERISTIC
/begin CHARACTERISTIC mTTANPGRG "レギュラープレイグ回避用下限吸気温テーブル                                                                              )" CURVE 0x000127D2 REC_UBYTE_C 0 COMP_0035 -50 205
 /begin AXIS_DESCR COM_AXIS NO_INPUT_QUANTITY COMP_0035 8 -50 205 AXIS_PTS_REF mTTWNPILN /end AXIS_DESCR
/end CHARACTERISTIC
/begin CHARACTERISTIC mTTANPIS2 "完爆ﾌﾟﾚｲｸﾞ下限吸気温ﾃｰﾌﾞﾙ2" CURVE 0x000127E2 REC_UBYTE_C 0 COMP_0035 -50 205
 /begin AXIS_DESCR COM_AXIS NO_INPUT_QUANTITY COMP_0035 8 -50 205 AXIS_PTS_REF mTTWNPIS2 /end AXIS_DESCR
/end CHARACTERISTIC
/begin CHARACTERISTIC mTTAPGHSR "低回転ﾌﾟﾚｲｸﾞ回避QH0ｶｯﾄ量吸気温補正(ﾚｷﾞｭﾗｰ時)(Pre-ignition_evasion_control_QH0_cutting_amount_intake_air_temperature_corr" CURVE 0x000127EA REC_UBYTE_C 0 COMP_0019_S 0 1.000000095
 /begin AXIS_DESCR COM_AXIS NO_INPUT_QUANTITY COMP_0035 8 -50 205 AXIS_PTS_REF mTTANPIGL /end AXIS_DESCR
/end CHARACTERISTIC
/begin CHARACTERISTIC mTTATDN1 "D->N切り換えディレイテーブル" CURVE 0x000127F2 REC_UBYTE_C 0 COMP_0014 0 2550
 /begin AXIS_DESCR COM_AXIS NO_INPUT_QUANTITY COMP_0016 8 0 255 AXIS_PTS_REF mTTATTMP /end AXIS_DESCR
/end CHARACTERISTIC
/begin CHARACTERISTIC mTTATND1 "N->D切り換えディレイテーブル" CURVE 0x000127FA REC_UBYTE_C 0 COMP_0014 0 2550
 /begin AXIS_DESCR COM_AXIS NO_INPUT_QUANTITY COMP_0016 8 0 255 AXIS_PTS_REF mTTATTMP /end AXIS_DESCR
/end CHARACTERISTIC
/begin CHARACTERISTIC mTTATRD "[R]->[D]切換ディレイタイムテーブル" CURVE 0x00012802 REC_UBYTE_C 0 COMP_0008 0 25500
 /begin AXIS_DESCR FIX_AXIS NO_INPUT_QUANTITY COMP_0333_S 8 -40 100 FIX_AXIS_PAR_DIST 0 1 8 /end AXIS_DESCR
/end CHARACTERISTIC
/begin CHARACTERISTIC mTTCVOEG "TCV開許可EGR率テーブル" CURVE 0x0001281A REC_UBYTE_C 0 COMP_0141 0 49.8046875
 /begin AXIS_DESCR COM_AXIS NO_INPUT_QUANTITY COMP_0009 8 0 199.21875 AXIS_PTS_REF mMEGITAC /end AXIS_DESCR
/end CHARACTERISTIC
/begin CHARACTERISTIC mTTDRDSH0 "ﾀﾞｳﾝｼﾌﾄ時目標ﾄﾙｸﾀﾞｳﾝ率(ﾊｲｵｸ,NEXTGP=0)" CURVE 0x00012822 REC_UBYTE_C 0 COMP_0063 0 0.99609375
 /begin AXIS_DESCR COM_AXIS NO_INPUT_QUANTITY COMP_0020 8 0 12750 AXIS_PTS_REF mTTDRDSN /end AXIS_DESCR
/end CHARACTERISTIC
/begin CHARACTERISTIC mTTDRDSH1 "ﾀﾞｳﾝｼﾌﾄ時目標ﾄﾙｸﾀﾞｳﾝ率(ﾊｲｵｸ,NEXTGP=1)" CURVE 0x0001282A REC_UBYTE_C 0 COMP_0063 0 0.99609375
 /begin AXIS_DESCR COM_AXIS NO_INPUT_QUANTITY COMP_0020 8 0 12750 AXIS_PTS_REF mTTDRDSN /end AXIS_DESCR
/end CHARACTERISTIC
/begin CHARACTERISTIC mTTDRDSH2 "ﾀﾞｳﾝｼﾌﾄ時目標ﾄﾙｸﾀﾞｳﾝ率(ﾊｲｵｸ,NEXTGP=2)" CURVE 0x00012832 REC_UBYTE_C 0 COMP_0063 0 0.99609375
 /begin AXIS_DESCR COM_AXIS NO_INPUT_QUANTITY COMP_0020 8 0 12750 AXIS_PTS_REF mTTDRDSN /end AXIS_DESCR
/end CHARACTERISTIC
/begin CHARACTERISTIC mTTDRDSR0 "ﾀﾞｳﾝｼﾌﾄ時目標ﾄﾙｸﾀﾞｳﾝ率(ﾊｲｵｸ,NEXTGP=0)" CURVE 0x00012842 REC_UBYTE_C 0 COMP_0063 0 0.99609375
 /begin AXIS_DESCR COM_AXIS NO_INPUT_QUANTITY COMP_0020 8 0 12750 AXIS_PTS_REF mTTDRDSN /end AXIS_DESCR
/end CHARACTERISTIC
/begin CHARACTERISTIC mTTDRDSR1 "ﾀﾞｳﾝｼﾌﾄ時目標ﾄﾙｸﾀﾞｳﾝ率(ﾊｲｵｸ,NEXTGP=1)" CURVE 0x0001284A REC_UBYTE_C 0 COMP_0063 0 0.99609375
 /begin AXIS_DESCR COM_AXIS NO_INPUT_QUANTITY COMP_0020 8 0 12750 AXIS_PTS_REF mTTDRDSN /end AXIS_DESCR
/end CHARACTERISTIC
/begin CHARACTERISTIC mTTDRDSR2 "ﾀﾞｳﾝｼﾌﾄ時目標ﾄﾙｸﾀﾞｳﾝ率(ﾊｲｵｸ,NEXTGP=2)" CURVE 0x00012852 REC_UBYTE_C 0 COMP_0063 0 0.99609375
 /begin AXIS_DESCR COM_AXIS NO_INPUT_QUANTITY COMP_0020 8 0 12750 AXIS_PTS_REF mTTDRDSN /end AXIS_DESCR
/end CHARACTERISTIC
/begin CHARACTERISTIC mTTDRPRH1 "変速前目標ﾄﾙｸﾀﾞｳﾝ率(ﾊｲｵｸ,NEXTGP=1)" CURVE 0x0001285E REC_UBYTE_C 0 COMP_0063 0 0.99609375
 /begin AXIS_DESCR FIX_AXIS NO_INPUT_QUANTITY COMP_0411_S 8 10 80 FIX_AXIS_PAR_DIST 0 1 8 /end AXIS_DESCR
/end CHARACTERISTIC
/begin CHARACTERISTIC mTTDRPRH2 "変速前目標ﾄﾙｸﾀﾞｳﾝ率(ﾊｲｵｸ,NEXTGP=2,3)" CURVE 0x00012866 REC_UBYTE_C 0 COMP_0063 0 0.99609375
 /begin AXIS_DESCR FIX_AXIS NO_INPUT_QUANTITY COMP_0411_S 8 10 80 FIX_AXIS_PAR_DIST 0 1 8 /end AXIS_DESCR
/end CHARACTERISTIC
/begin CHARACTERISTIC mTTDRPRR1 "変速前目標ﾄﾙｸﾀﾞｳﾝ率(ﾚｷﾞｭﾗｰ,NEXTGP=1)" CURVE 0x0001286E REC_UBYTE_C 0 COMP_0063 0 0.99609375
 /begin AXIS_DESCR FIX_AXIS NO_INPUT_QUANTITY COMP_0411_S 8 10 80 FIX_AXIS_PAR_DIST 0 1 8 /end AXIS_DESCR
/end CHARACTERISTIC
/begin CHARACTERISTIC mTTDRPRR2 "変速前目標ﾄﾙｸﾀﾞｳﾝ率(ﾚｷﾞｭﾗｰ,NEXTGP=2,3)" CURVE 0x00012876 REC_UBYTE_C 0 COMP_0063 0 0.99609375
 /begin AXIS_DESCR FIX_AXIS NO_INPUT_QUANTITY COMP_0411_S 8 10 80 FIX_AXIS_PAR_DIST 0 1 8 /end AXIS_DESCR
/end CHARACTERISTIC
/begin CHARACTERISTIC mTTDRUSH1 "ｱｯﾌﾟｼﾌﾄ時目標ﾄﾙｸﾀﾞｳﾝ率(ﾊｲｵｸ,NEXTGP=1)" CURVE 0x0001287E REC_UBYTE_C 0 COMP_0063 0 0.99609375
 /begin AXIS_DESCR FIX_AXIS NO_INPUT_QUANTITY COMP_0411_S 8 10 80 FIX_AXIS_PAR_DIST 0 1 8 /end AXIS_DESCR
/end CHARACTERISTIC
/begin CHARACTERISTIC mTTDRUSH2 "ｱｯﾌﾟｼﾌﾄ時目標ﾄﾙｸﾀﾞｳﾝ率(ﾊｲｵｸ,NEXTGP=2)" CURVE 0x00012886 REC_UBYTE_C 0 COMP_0063 0 0.99609375
 /begin AXIS_DESCR FIX_AXIS NO_INPUT_QUANTITY COMP_0411_S 8 10 80 FIX_AXIS_PAR_DIST 0 1 8 /end AXIS_DESCR
/end CHARACTERISTIC
/begin CHARACTERISTIC mTTDRUSH3 "ｱｯﾌﾟｼﾌﾄ時目標ﾄﾙｸﾀﾞｳﾝ率(ﾊｲｵｸ,NEXTGP=3)" CURVE 0x0001288E REC_UBYTE_C 0 COMP_0063 0 0.99609375
 /begin AXIS_DESCR FIX_AXIS NO_INPUT_QUANTITY COMP_0411_S 8 10 80 FIX_AXIS_PAR_DIST 0 1 8 /end AXIS_DESCR
/end CHARACTERISTIC
/begin CHARACTERISTIC mTTDRUSR1 "ｱｯﾌﾟｼﾌﾄ時目標ﾄﾙｸﾀﾞｳﾝ率(ﾚｷﾞｭﾗｰ,NEXTGP=1)" CURVE 0x00012896 REC_UBYTE_C 0 COMP_0063 0 0.99609375
 /begin AXIS_DESCR FIX_AXIS NO_INPUT_QUANTITY COMP_0411_S 8 10 80 FIX_AXIS_PAR_DIST 0 1 8 /end AXIS_DESCR
/end CHARACTERISTIC
/begin CHARACTERISTIC mTTDRUSR2 "ｱｯﾌﾟｼﾌﾄ時目標ﾄﾙｸﾀﾞｳﾝ率(ﾚｷﾞｭﾗｰ,NEXTGP=2)" CURVE 0x0001289E REC_UBYTE_C 0 COMP_0063 0 0.99609375
 /begin AXIS_DESCR FIX_AXIS NO_INPUT_QUANTITY COMP_0411_S 8 10 80 FIX_AXIS_PAR_DIST 0 1 8 /end AXIS_DESCR
/end CHARACTERISTIC
/begin CHARACTERISTIC mTTDRUSR3 "ｱｯﾌﾟｼﾌﾄ時目標ﾄﾙｸﾀﾞｳﾝ率(ﾚｷﾞｭﾗｰ,NEXTGP=3)" CURVE 0x000128A6 REC_UBYTE_C 0 COMP_0063 0 0.99609375
 /begin AXIS_DESCR FIX_AXIS NO_INPUT_QUANTITY COMP_0411_S 8 10 80 FIX_AXIS_PAR_DIST 0 1 8 /end AXIS_DESCR
/end CHARACTERISTIC
/begin CHARACTERISTIC mTTEFRIC "ﾌﾘｸｼｮﾝﾄﾙｸﾃｰﾌﾞﾙ" CURVE 0x00015050 REC_UWORD_C 0 COMP_0196 0 6553.5
 /begin AXIS_DESCR FIX_AXIS NO_INPUT_QUANTITY COMP_0404_S 8 800 6400 FIX_AXIS_PAR_DIST 0 1 8 /end AXIS_DESCR
/end CHARACTERISTIC
/begin CHARACTERISTIC mTTEMHOS "F/C後EM補正ﾃｰﾌﾞﾙ" CURVE 0x00015060 REC_UWORD_C 0 COMP_0217 0 3.999941832
 /begin AXIS_DESCR COM_AXIS NO_INPUT_QUANTITY COMP_0430_S 8 -83886.08 83883.52 AXIS_PTS_REF mLHSOSQ /end AXIS_DESCR
/end CHARACTERISTIC
/begin CHARACTERISTIC mTTGKUBTW "温度平衡時未燃分補正基本テーブル(The_basic_table_of_the_rate_of_Non-combustion_part_compensation)" CURVE 0x000128D6 REC_UBYTE_C 0 COMP_0045 0 1.9921875
 /begin AXIS_DESCR COM_AXIS NO_INPUT_QUANTITY COMP_0440_S 8 -40 119.375 AXIS_PTS_REF mTWLMDPMD /end AXIS_DESCR
/end CHARACTERISTIC
/begin CHARACTERISTIC mTTGQL "成層始動時目標体積流量比上限値テーブル" CURVE 0x000151B0 REC_UWORD_C 0 COMP_0410 0 99.9985458
 /begin AXIS_DESCR FIX_AXIS NO_INPUT_QUANTITY COMP_0454_S 8 1400 4200 FIX_AXIS_PAR_DIST 0 1 8 /end AXIS_DESCR
/end CHARACTERISTIC
/begin CHARACTERISTIC mTTGQL_S "成層始動時目標体積流量比上限値テーブル" CURVE 0x0001670E REC_UWORD_C 0 COMP_0146 0 99.998480265
 /begin AXIS_DESCR FIX_AXIS NO_INPUT_QUANTITY COMP_0454_S 8 1400 4200 FIX_AXIS_PAR_DIST 0 1 8 /end AXIS_DESCR
/end CHARACTERISTIC
/begin CHARACTERISTIC mTTGTGIN "目標A/F_P分ﾃｰﾌﾞﾙ" CURVE 0x000151C0 REC_UWORD_C 0 COMP_0217 0 3.999941832
 /begin AXIS_DESCR COM_AXIS NO_INPUT_QUANTITY COMP_0068 8 0 65535 AXIS_PTS_REF mTXGTGIN /end AXIS_DESCR
/end CHARACTERISTIC
/begin CHARACTERISTIC mTTGTGIN2 "目標A/F_P分ﾃｰﾌﾞﾙ(bank2)" CURVE 0x000151D0 REC_UWORD_C 0 COMP_0217 0 3.999941832
 /begin AXIS_DESCR COM_AXIS NO_INPUT_QUANTITY COMP_0068 8 0 65535 AXIS_PTS_REF mTXGTGIN /end AXIS_DESCR
/end CHARACTERISTIC
/begin CHARACTERISTIC mTTISSL "過渡補正時間ﾃｰﾌﾞﾙ" CURVE 0x000128E2 REC_UBYTE_C 0 COMP_0014 0 2550
 /begin AXIS_DESCR COM_AXIS NO_INPUT_QUANTITY COMP_0006 8 0 3187.5 AXIS_PTS_REF mNSLP /end AXIS_DESCR
/end CHARACTERISTIC
/begin CHARACTERISTIC mTTITMHPH "低回転時ﾌﾟﾚｲｸﾞ回避ITﾃｰﾌﾞﾙ(ﾊｲｵｸ時)" CURVE 0x000128EA REC_UBYTE_C 0 COMP_0190 0 510
 /begin AXIS_DESCR COM_AXIS NO_INPUT_QUANTITY COMP_0000 8 0 6375 AXIS_PTS_REF mLITMHPHN /end AXIS_DESCR
/end CHARACTERISTIC
/begin CHARACTERISTIC mTTITMHPR "低回転時ﾌﾟﾚｲｸﾞ回避ITﾃｰﾌﾞﾙ(ﾚｷﾞｭﾗｰ時)" CURVE 0x000128F2 REC_UBYTE_C 0 COMP_0190 0 510
 /begin AXIS_DESCR COM_AXIS NO_INPUT_QUANTITY COMP_0000 8 0 6375 AXIS_PTS_REF mLITMHPRN /end AXIS_DESCR
/end CHARACTERISTIC
/* AXIS -------------------------------------------------------------------- */
/begin AXIS_PTS mTADVTRSN "50rpm" 0x00011B6C NO_INPUT_QUANTITY REC_AXIS_UBYTE 0 COMP_0020 16 0 12750 /end AXIS_PTS
/begin AXIS_PTS mDRTQSPNE "3.125rpm" 0x00012ED2 NO_INPUT_QUANTITY REC_AXIS_UWORD 0 COMP_0065 16 0 204796.875 /end AXIS_PTS
/begin AXIS_PTS mLTPV "80/256mV" 0x0001355A NO_INPUT_QUANTITY REC_AXIS_UWORD 0 COMP_0314_S 16 0 20479.6875 /end AXIS_PTS
/begin AXIS_PTS mTTCOSTG "1km/h" 0x00012812 NO_INPUT_QUANTITY REC_AXIS_UBYTE 0 COMP_0429 8 0 255 /end AXIS_PTS
/begin AXIS_PTS mSLMTOTAN "X-50℃" 0x00013B32 NO_INPUT_QUANTITY REC_AXIS_UWORD 0 COMP_0035 8 -50 65485 /end AXIS_PTS
/begin AXIS_PTS mTXAFSFT "x-50℃" 0x00015640 NO_INPUT_QUANTITY REC_AXIS_UWORD 0 COMP_0035 16 -50 65485 /end AXIS_PTS
/begin AXIS_PTS mTPDLAP_S "0.125%" 0x000165A4 NO_INPUT_QUANTITY REC_AXIS_UWORD 0 COMP_0032_S 16 0 8191.875 /end AXIS_PTS
/begin AXIS_PTS mTPDLAPBP "0.125%" 0x000149C2 NO_INPUT_QUANTITY REC_AXIS_UWORD 0 COMP_0032_S 16 0 8191.875 /end AXIS_PTS
/begin AXIS_PTS mTGVSP0 "0.1km/h" 0x0001451A NO_INPUT_QUANTITY REC_AXIS_UWORD 0 COMP_0436 16 0 6553.5 /end AXIS_PTS
/begin AXIS_PTS mTXCLA12 "1.25mv" 0x00015680 NO_INPUT_QUANTITY REC_AXIS_UWORD 0 COMP_0352_S 16 0 81918.75 /end AXIS_PTS
/begin AXIS_PTS mJKCAR "2^-16-" 0x00012FEA NO_INPUT_QUANTITY REC_AXIS_UWORD 0 COMP_0290 16 0 0.999985458 /end AXIS_PTS
/begin AXIS_PTS mLCLDTRG "1/16384-" 0x0001311A NO_INPUT_QUANTITY REC_AXIS_UWORD 0 COMP_0217 16 0 3.999941832 /end AXIS_PTS
/begin AXIS_PTS mLCLRGIN "1/255-" 0x0001313A NO_INPUT_QUANTITY REC_AXIS_UWORD 0 COMP_0019_S 16 0 257.000024415 /end AXIS_PTS
/begin AXIS_PTS mTFDVSB_S "0.1km/h" 0x00016504 NO_INPUT_QUANTITY REC_AXIS_UWORD 0 COMP_0436 16 0 6553.5 /end AXIS_PTS
/begin AXIS_PTS mLFGAGE "20/256mV" 0x000131EA NO_INPUT_QUANTITY REC_AXIS_UWORD 0 COMP_0050 16 0 5119.921875 /end AXIS_PTS
/begin AXIS_PTS mJKFHOS "2^-16-" 0x0001300A NO_INPUT_QUANTITY REC_AXIS_UWORD 0 COMP_0290 16 0 0.999985458 /end AXIS_PTS
/begin AXIS_PTS mLTISUT "0.625X-40℃" 0x0001185F NO_INPUT_QUANTITY REC_AXIS_UBYTE 0 COMP_0356 16 -40 119.375 /end AXIS_PTS
/begin AXIS_PTS mGSIAPO "0.11deg" 0x00012F9A NO_INPUT_QUANTITY REC_AXIS_UWORD 0 COMP_0005 16 0 7208.85 /end AXIS_PTS
/begin AXIS_PTS mLHPPAMB "1/256kPa" 0x0001321A NO_INPUT_QUANTITY REC_AXIS_UWORD 0 COMP_0034_S 16 0 255.99609375 /end AXIS_PTS
/begin AXIS_PTS mTICTMPV "5mV" 0x0001460A NO_INPUT_QUANTITY REC_AXIS_UWORD 0 COMP_0023 16 0 327675 /end AXIS_PTS
/begin AXIS_PTS mTWKINT "X-50℃" 0x00012B9E NO_INPUT_QUANTITY REC_AXIS_UBYTE 0 COMP_0035 16 -50 205 /end AXIS_PTS
/begin AXIS_PTS mTITACNE "50rpm" 0x00012074 NO_INPUT_QUANTITY REC_AXIS_UBYTE 0 COMP_0020 16 0 12750 /end AXIS_PTS
/begin AXIS_PTS mPKINJ "0.000305Mpa" 0x00013924 NO_INPUT_QUANTITY REC_AXIS_UWORD 0 COMP_0268 16 0 19.988175 /end AXIS_PTS
/begin AXIS_PTS mLKMRTRG "1/16384-" 0x0001325A NO_INPUT_QUANTITY REC_AXIS_UWORD 0 COMP_0217 16 0 3.999941832 /end AXIS_PTS
/begin AXIS_PTS mTKNKNE "50rpm" 0x0001218C NO_INPUT_QUANTITY REC_AXIS_UBYTE 0 COMP_0020 16 0 12750 /end AXIS_PTS
/begin AXIS_PTS mTRLTRRNE "12.5rpm" 0x00014E76 NO_INPUT_QUANTITY REC_AXIS_UWORD 0 COMP_0006 16 0 819187.5 /end AXIS_PTS
/begin AXIS_PTS mJKKPBMR "0.005kPa" 0x0001302A NO_INPUT_QUANTITY REC_AXIS_UWORD 0 COMP_0363_S 16 0 327.675 /end AXIS_PTS
/begin AXIS_PTS mLAMHOSNT "50rpm" 0x00011723 NO_INPUT_QUANTITY REC_AXIS_UBYTE 0 COMP_0020 16 0 12750 /end AXIS_PTS
/begin AXIS_PTS mTMBTCA "0.5deg" 0x00012274 NO_INPUT_QUANTITY REC_AXIS_UBYTE 0 COMP_0266 16 0 127.5 /end AXIS_PTS
/begin AXIS_PTS mLMFDGNE "3.125rpm" 0x0001327A NO_INPUT_QUANTITY REC_AXIS_UWORD 0 COMP_0065 16 0 204796.875 /end AXIS_PTS
/begin AXIS_PTS mTNQAX "12.5rpm" 0x00012434 NO_INPUT_QUANTITY REC_AXIS_UBYTE 0 COMP_0006 16 0 3187.5 /end AXIS_PTS
/begin AXIS_PTS mTPASOK "0.5%" 0x000124FC NO_INPUT_QUANTITY REC_AXIS_UBYTE 0 COMP_0047 16 0 127.5 /end AXIS_PTS
/begin AXIS_PTS mTPIADSTG "1/16384-" 0x00014AE2 NO_INPUT_QUANTITY REC_AXIS_UWORD 0 COMP_0217 16 0 3.999941832 /end AXIS_PTS
/begin AXIS_PTS mTISCPI "100/128%" 0x00014672 NO_INPUT_QUANTITY REC_AXIS_UWORD 0 COMP_0009 16 0 51199.21875 /end AXIS_PTS
/begin AXIS_PTS mLTQHOS "1-" 0x0001358A NO_INPUT_QUANTITY REC_AXIS_UWORD 0 COMP_0068 16 0 65535 /end AXIS_PTS
/begin AXIS_PTS mTRONNE "50rpm" 0x000126FA NO_INPUT_QUANTITY REC_AXIS_UBYTE 0 COMP_0020 16 0 12750 /end AXIS_PTS
/begin AXIS_PTS mRONLMSN "50rpm" 0x00013A62 NO_INPUT_QUANTITY REC_AXIS_UWORD 0 COMP_0020 16 0 3276750 /end AXIS_PTS
/begin AXIS_PTS mLPAMB "20mV" 0x000117B7 NO_INPUT_QUANTITY REC_AXIS_UBYTE 0 COMP_0054 16 0 5100 /end AXIS_PTS
/begin AXIS_PTS mSQRTTAN "X-50-" 0x00013BFA NO_INPUT_QUANTITY REC_AXIS_UWORD 0 COMP_0373_S 16 -50 65485 /end AXIS_PTS
/begin AXIS_PTS mVTCSTRKN "0.5degCA" 0x000157A0 NO_INPUT_QUANTITY REC_AXIS_UWORD 0 COMP_0108_S 16 -16384 16383.5 /end AXIS_PTS
/begin AXIS_PTS mTWKINT16 "0.625X-40℃" 0x00012BAE NO_INPUT_QUANTITY REC_AXIS_UBYTE 0 COMP_0356 16 -40 119.375 /end AXIS_PTS
/begin AXIS_PTS mTSWSTNE "12.5rpm" 0x00014FE0 NO_INPUT_QUANTITY REC_AXIS_UWORD 0 COMP_0006 16 0 819187.5 /end AXIS_PTS
/begin AXIS_PTS mTAFCTABP "1℃" 0x00013CEA NO_INPUT_QUANTITY REC_AXIS_UWORD 0 COMP_0069_S 16 -50 65485 /end AXIS_PTS
/begin AXIS_PTS mTFBYAMKN "50rpm" 0x00011E0C NO_INPUT_QUANTITY REC_AXIS_UBYTE 0 COMP_0020 16 0 12750 /end AXIS_PTS
/begin AXIS_PTS mTFDVSPBP "0.1km/h" 0x0001419A NO_INPUT_QUANTITY REC_AXIS_UWORD 0 COMP_0436 16 0 6553.5 /end AXIS_PTS
/begin AXIS_PTS mMNRPM "25rpm" 0x00013754 NO_INPUT_QUANTITY REC_AXIS_UWORD 0 COMP_0000 16 0 1638375 /end AXIS_PTS
/begin AXIS_PTS mLTWGA "0.00000002m**2" 0x0001369A NO_INPUT_QUANTITY REC_AXIS_UWORD 0 COMP_0378_S 16 0 0.0013107 /end AXIS_PTS
/begin AXIS_PTS mTUEAX "50rpm" 0x00012A9A NO_INPUT_QUANTITY REC_AXIS_UBYTE 0 COMP_0020 16 0 12750 /end AXIS_PTS
/begin AXIS_PTS mLVTCRTE "64/128degCA" 0x000118C7 NO_INPUT_QUANTITY REC_AXIS_UBYTE 0 COMP_0256 16 -64 63.5 /end AXIS_PTS
/begin AXIS_PTS mLEGT "5mV" 0x0001318A NO_INPUT_QUANTITY REC_AXIS_UWORD 0 COMP_0023 32 0 327675 /end AXIS_PTS
/begin AXIS_PTS mTQH0SH_S "100/65536%" 0x00016644 NO_INPUT_QUANTITY REC_AXIS_UWORD 0 COMP_0146 32 0 99.998480265 /end AXIS_PTS
/begin AXIS_PTS mTQH0ST_S "100/65536%" 0x00016684 NO_INPUT_QUANTITY REC_AXIS_UWORD 0 COMP_0146 32 0 99.998480265 /end AXIS_PTS
/begin AXIS_PTS mATGTVO "0.0008cm^2" 0x00012D92 NO_INPUT_QUANTITY REC_AXIS_UWORD 0 COMP_0041 32 0 52.428 /end AXIS_PTS
/begin AXIS_PTS mATGTVO_S "0.0008cm^2" 0x00016344 NO_INPUT_QUANTITY REC_AXIS_UWORD 0 COMP_0041 32 0 52.428 /end AXIS_PTS
/begin AXIS_PTS mTTGADNV "3.90625E-11cm**2/rp" 0x00015130 NO_INPUT_QUANTITY REC_AXIS_UWORD 0 COMP_0028_S 32 0 2.5599609375E-06 /end AXIS_PTS
/begin AXIS_PTS mTTGADNVH "6.25E-10cm**2/rp" 0x00015170 NO_INPUT_QUANTITY REC_AXIS_UWORD 0 COMP_0382_S 32 0 0.000040959375 /end AXIS_PTS
/begin AXIS_PTS mALPTBSQM "2^0-" 0x00012D62 NO_INPUT_QUANTITY REC_AXIS_UWORD 0 COMP_0068 8 0 65535 /end AXIS_PTS
/begin AXIS_PTS mBSTRATK "4/65536-" 0x00012DF2 NO_INPUT_QUANTITY REC_AXIS_UWORD 0 COMP_0217 8 0 3.999941832 /end AXIS_PTS
/begin AXIS_PTS mTTBPAX "1/4ｋPa" 0x00015040 NO_INPUT_QUANTITY REC_AXIS_UWORD 0 COMP_0392_S 8 0 16383.75 /end AXIS_PTS
/begin AXIS_PTS mTXGTGIN "1-" 0x000156B0 NO_INPUT_QUANTITY REC_AXIS_UWORD 0 COMP_0068 8 0 65535 /end AXIS_PTS
/begin AXIS_PTS mJKPABF "0.5/256-" 0x0001304A NO_INPUT_QUANTITY REC_AXIS_UWORD 0 COMP_0018_S 8 0 127.998046875 /end AXIS_PTS
/begin AXIS_PTS mGUILDLY3 "0.625X-40℃" 0x000116A1 NO_INPUT_QUANTITY REC_AXIS_UBYTE 0 COMP_0356 8 -40 119.375 /end AXIS_PTS
/begin AXIS_PTS mGUILDLY2 "X-50℃" 0x00011699 NO_INPUT_QUANTITY REC_AXIS_UBYTE 0 COMP_0035 8 -50 205 /end AXIS_PTS
/begin AXIS_PTS mLADV "1deg" 0x0001171B NO_INPUT_QUANTITY REC_AXIS_UBYTE 0 COMP_0314 8 -128 127 /end AXIS_PTS
/begin AXIS_PTS mLICPT "0.00008s" 0x0001324A NO_INPUT_QUANTITY REC_AXIS_UWORD 0 COMP_0395_S 8 0 5.2428 /end AXIS_PTS
/begin AXIS_PTS mLDTBPERR "0.25kPa/s" 0x0001317A NO_INPUT_QUANTITY REC_AXIS_UWORD 0 COMP_0396_S 8 0 16383.75 /end AXIS_PTS
/begin AXIS_PTS mOPABMXA "3.125rpm" 0x000138B4 NO_INPUT_QUANTITY REC_AXIS_UWORD 0 COMP_0065 8 0 204796.875 /end AXIS_PTS
/begin AXIS_PTS mOVBLMNE "3.125rpm" 0x000138C4 NO_INPUT_QUANTITY REC_AXIS_UWORD 0 COMP_0065 8 0 204796.875 /end AXIS_PTS
/begin AXIS_PTS mSHAGAIBP "3.125rpm" 0x00013A82 NO_INPUT_QUANTITY REC_AXIS_UWORD 0 COMP_0065 8 0 204796.875 /end AXIS_PTS
/begin AXIS_PTS mSLAJTQBP "0.01km/h" 0x00013AC2 NO_INPUT_QUANTITY REC_AXIS_UWORD 0 COMP_0238_S 8 0 655.35 /end AXIS_PTS
/begin AXIS_PTS mSLDGLMBP "0.01km/h" 0x00013AD2 NO_INPUT_QUANTITY REC_AXIS_UWORD 0 COMP_0238_S 8 0 655.35 /end AXIS_PTS
/begin AXIS_PTS mSLDGVER "0.01km/h" 0x00013B02 NO_INPUT_QUANTITY REC_AXIS_UWORD 0 COMP_0238_S 8 0 655.35 /end AXIS_PTS
/begin AXIS_PTS mSLPGRTBP "1/1024-" 0x00013B42 NO_INPUT_QUANTITY REC_AXIS_UWORD 0 COMP_0450 8 0 63.999056205 /end AXIS_PTS
/begin AXIS_PTS mSLPGVER "0.01km/h" 0x00013B72 NO_INPUT_QUANTITY REC_AXIS_UWORD 0 COMP_0238_S 8 0 655.35 /end AXIS_PTS
/begin AXIS_PTS mSLVAPGBP "0.01km/h" 0x00013B82 NO_INPUT_QUANTITY REC_AXIS_UWORD 0 COMP_0238_S 8 0 655.35 /end AXIS_PTS
/begin AXIS_PTS mSLVPLMBP "0.01km/h" 0x00013BA2 NO_INPUT_QUANTITY REC_AXIS_UWORD 0 COMP_0238_S 8 0 655.35 /end AXIS_PTS
/begin AXIS_PTS mLTADMB "1deg" 0x0001345A NO_INPUT_QUANTITY REC_AXIS_UWORD 0 COMP_0017 8 0 65535 /end AXIS_PTS
/begin AXIS_PTS mLTADVPG "2deg" 0x00011837 NO_INPUT_QUANTITY REC_AXIS_UBYTE 0 COMP_0190 8 0 510 /end AXIS_PTS
/begin AXIS_PTS mLTADVSL "X-50℃" 0x0001346A NO_INPUT_QUANTITY REC_AXIS_UWORD 0 COMP_0035 8 -50 65485 /end AXIS_PTS
/begin AXIS_PTS mLTADVSLB "X-50℃" 0x0001347A NO_INPUT_QUANTITY REC_AXIS_UWORD 0 COMP_0035 8 -50 65485 /end AXIS_PTS
/begin AXIS_PTS mLTADVSLC "X-50℃" 0x0001348A NO_INPUT_QUANTITY REC_AXIS_UWORD 0 COMP_0035 8 -50 65485 /end AXIS_PTS
/begin AXIS_PTS mLTADVSLD "X-50℃" 0x0001183F NO_INPUT_QUANTITY REC_AXIS_UBYTE 0 COMP_0035 8 -50 205 /end AXIS_PTS
/begin AXIS_PTS mLAFEXT2P "0.02degC" 0x0001306A NO_INPUT_QUANTITY REC_AXIS_UWORD 0 COMP_0405_S 8 0 1310.7 /end AXIS_PTS
/begin AXIS_PTS mTXAFSFTL "5mV" 0x00015660 NO_INPUT_QUANTITY REC_AXIS_UWORD 0 COMP_0023 8 0 327675 /end AXIS_PTS
/begin AXIS_PTS mTXAFSFTR "5mV" 0x00015670 NO_INPUT_QUANTITY REC_AXIS_UWORD 0 COMP_0023 8 0 327675 /end AXIS_PTS
/begin AXIS_PTS mLAFSO2H "1L" 0x0001307A NO_INPUT_QUANTITY REC_AXIS_UWORD 0 COMP_0156 8 0 65535 /end AXIS_PTS
/begin AXIS_PTS mTNEAMAD "25rpm" 0x0001239C NO_INPUT_QUANTITY REC_AXIS_UBYTE 0 COMP_0000 8 0 6375 /end AXIS_PTS
/begin AXIS_PTS mLTEMHOS "1/16384-" 0x000134BA NO_INPUT_QUANTITY REC_AXIS_UWORD 0 COMP_0217 8 0 3.999941832 /end AXIS_PTS
/begin AXIS_PTS mLBPATMLM "0.25X+40kPa" 0x00011743 NO_INPUT_QUANTITY REC_AXIS_UBYTE 0 COMP_0407_S 8 40 103.75 /end AXIS_PTS
/begin AXIS_PTS mLBPRGLM "3.125rpm" 0x0001310A NO_INPUT_QUANTITY REC_AXIS_UWORD 0 COMP_0065 8 0 204796.875 /end AXIS_PTS
/begin AXIS_PTS mJKDALP "1%" 0x000116FB NO_INPUT_QUANTITY REC_AXIS_UBYTE 0 COMP_0027 8 0 255 /end AXIS_PTS
/begin AXIS_PTS mCSTACPD "0.02MPa" 0x00011604 NO_INPUT_QUANTITY REC_AXIS_UBYTE 0 COMP_0011 8 0 5.1 /end AXIS_PTS
/begin AXIS_PTS mTDQNEQAX "2L/min" 0x00011D74 NO_INPUT_QUANTITY REC_AXIS_UBYTE 0 COMP_0293 8 0 510 /end AXIS_PTS
/begin AXIS_PTS mVCTBOTDE "X-50℃" 0x00012C36 NO_INPUT_QUANTITY REC_AXIS_UBYTE 0 COMP_0035 8 -50 205 /end AXIS_PTS
/begin AXIS_PTS mVCTABOTD "X-50℃" 0x00012C2E NO_INPUT_QUANTITY REC_AXIS_UBYTE 0 COMP_0035 8 -50 205 /end AXIS_PTS
/begin AXIS_PTS mTGNSTAX "12.5rpm" 0x00011EA4 NO_INPUT_QUANTITY REC_AXIS_UBYTE 0 COMP_0006 8 0 3187.5 /end AXIS_PTS
/begin AXIS_PTS mDLNRHTI "1.6μs" 0x00012E72 NO_INPUT_QUANTITY REC_AXIS_UWORD 0 COMP_0157_S 8 0 104856 /end AXIS_PTS
/begin AXIS_PTS mDLNRLTI "1.6μs" 0x00012E92 NO_INPUT_QUANTITY REC_AXIS_UWORD 0 COMP_0157_S 8 0 104856 /end AXIS_PTS
/begin AXIS_PTS mDLNL2TI "1.6μs" 0x00012E52 NO_INPUT_QUANTITY REC_AXIS_UWORD 0 COMP_0157_S 8 0 104856 /end AXIS_PTS
/begin AXIS_PTS mDLNRLLTI "1.6μs" 0x00012E82 NO_INPUT_QUANTITY REC_AXIS_UWORD 0 COMP_0157_S 8 0 104856 /end AXIS_PTS
/begin AXIS_PTS mDLNLL2TI "1.6μs" 0x00012E62 NO_INPUT_QUANTITY REC_AXIS_UWORD 0 COMP_0157_S 8 0 104856 /end AXIS_PTS
/begin AXIS_PTS mQH0STRPM "1.5625rpm" 0x00013954 NO_INPUT_QUANTITY REC_AXIS_UWORD 0 COMP_0064 8 0 102398.4375 /end AXIS_PTS
/begin AXIS_PTS mTDLFLNE "50rpm" 0x00011D30 NO_INPUT_QUANTITY REC_AXIS_UBYTE 0 COMP_0020 8 0 12750 /end AXIS_PTS
/begin AXIS_PTS mJKDNSCK "X-50℃" 0x00011703 NO_INPUT_QUANTITY REC_AXIS_UBYTE 0 COMP_0035 8 -50 205 /end AXIS_PTS
/begin AXIS_PTS mEXGDP "1.6E-5kg/s" 0x00012F7A NO_INPUT_QUANTITY REC_AXIS_UWORD 0 COMP_0304_S 8 0 1.04856 /end AXIS_PTS
/begin AXIS_PTS mEBRTHV_S "0.1km/h" 0x000163C4 NO_INPUT_QUANTITY REC_AXIS_UWORD 0 COMP_0436 8 0 6553.5 /end AXIS_PTS
/begin AXIS_PTS mTECOVSP "0.1km/h" 0x000140AA NO_INPUT_QUANTITY REC_AXIS_UWORD 0 COMP_0436 8 0 6553.5 /end AXIS_PTS
/begin AXIS_PTS mLEHTTRQ "3.125rpm" 0x000131CA NO_INPUT_QUANTITY REC_AXIS_UWORD 0 COMP_0065 8 0 204796.875 /end AXIS_PTS
/begin AXIS_PTS mENBRTHVS "0.1km/h" 0x00012F52 NO_INPUT_QUANTITY REC_AXIS_UWORD 0 COMP_0436 8 0 6553.5 /end AXIS_PTS
/begin AXIS_PTS mETCDLYN "12.5rpm" 0x00012F62 NO_INPUT_QUANTITY REC_AXIS_UWORD 0 COMP_0006 8 0 819187.5 /end AXIS_PTS
/begin AXIS_PTS mFCDRATO "1/1024-" 0x00012F8A NO_INPUT_QUANTITY REC_AXIS_UWORD 0 COMP_0450 8 0 63.999056205 /end AXIS_PTS
/begin AXIS_PTS mNFSOKI "25rpm" 0x00011974 NO_INPUT_QUANTITY REC_AXIS_UBYTE 0 COMP_0000 8 0 6375 /end AXIS_PTS
/begin AXIS_PTS mTEFRICN "12.5rpm" 0x000140BA NO_INPUT_QUANTITY REC_AXIS_UWORD 0 COMP_0006 8 0 819187.5 /end AXIS_PTS
/begin AXIS_PTS mLFVCC "12.5rpm" 0x0001320A NO_INPUT_QUANTITY REC_AXIS_UWORD 0 COMP_0006 8 0 819187.5 /end AXIS_PTS
/begin AXIS_PTS mTX1STNE "12.5rpm" 0x00015630 NO_INPUT_QUANTITY REC_AXIS_UWORD 0 COMP_0006 8 0 819187.5 /end AXIS_PTS
/begin AXIS_PTS mLAMNRM3 "25rpm" 0x0001173B NO_INPUT_QUANTITY REC_AXIS_UBYTE 0 COMP_0000 8 0 6375 /end AXIS_PTS
/begin AXIS_PTS mLAMNRM "25rpm" 0x00011733 NO_INPUT_QUANTITY REC_AXIS_UBYTE 0 COMP_0000 8 0 6375 /end AXIS_PTS
/begin AXIS_PTS mTGSENVAL "0.0037G" 0x0001426A NO_INPUT_QUANTITY REC_AXIS_UWORD 0 COMP_0136_S 8 -1.8907 240.5888 /end AXIS_PTS
/begin AXIS_PTS mGSITWN "X-50℃" 0x00012FBA NO_INPUT_QUANTITY REC_AXIS_UWORD 0 COMP_0035 8 -50 65485 /end AXIS_PTS
/begin AXIS_PTS mLGSLADV "25rpm" 0x0001175B NO_INPUT_QUANTITY REC_AXIS_UBYTE 0 COMP_0000 8 0 6375 /end AXIS_PTS
/begin AXIS_PTS mTXHAOSC "2.56mg" 0x000156C0 NO_INPUT_QUANTITY REC_AXIS_UWORD 0 COMP_0430_S 8 -83886.08 83883.52 /end AXIS_PTS
/begin AXIS_PTS mTXHATMP "4℃" 0x00012BE6 NO_INPUT_QUANTITY REC_AXIS_UBYTE 0 COMP_0062 8 0 1020 /end AXIS_PTS
/begin AXIS_PTS mTXNEFBP "12.5rpm" 0x000156F0 NO_INPUT_QUANTITY REC_AXIS_UWORD 0 COMP_0006 8 0 819187.5 /end AXIS_PTS
/begin AXIS_PTS mTXHROSC "2.56mg" 0x000156D0 NO_INPUT_QUANTITY REC_AXIS_UWORD 0 COMP_0430_S 8 -83886.08 83883.52 /end AXIS_PTS
/begin AXIS_PTS mTXHRTMP "4℃" 0x00012BEE NO_INPUT_QUANTITY REC_AXIS_UBYTE 0 COMP_0062 8 0 1020 /end AXIS_PTS
/begin AXIS_PTS mTPIQM "1-" 0x00014B42 NO_INPUT_QUANTITY REC_AXIS_UWORD 0 COMP_0068 8 0 65535 /end AXIS_PTS
/begin AXIS_PTS mTICFLMN "50rpm" 0x000145CA NO_INPUT_QUANTITY REC_AXIS_UWORD 0 COMP_0020 8 0 3276750 /end AXIS_PTS
/begin AXIS_PTS mTICFLNE "50rpm" 0x00011F24 NO_INPUT_QUANTITY REC_AXIS_UBYTE 0 COMP_0020 8 0 12750 /end AXIS_PTS
/begin AXIS_PTS mTVTIDNE "50rpm" 0x00012B4A NO_INPUT_QUANTITY REC_AXIS_UBYTE 0 COMP_0020 8 0 12750 /end AXIS_PTS
/begin AXIS_PTS mTVTIDNEE "50rpm" 0x00012B52 NO_INPUT_QUANTITY REC_AXIS_UBYTE 0 COMP_0020 8 0 12750 /end AXIS_PTS
/begin AXIS_PTS mLTIJTRQ "3.125rpm" 0x000134CA NO_INPUT_QUANTITY REC_AXIS_UWORD 0 COMP_0065 8 0 204796.875 /end AXIS_PTS
/begin AXIS_PTS mTINFLNE "50rpm" 0x00011FA4 NO_INPUT_QUANTITY REC_AXIS_UBYTE 0 COMP_0020 8 0 12750 /end AXIS_PTS
/begin AXIS_PTS mTIFLMNE "50rpm" 0x0001462A NO_INPUT_QUANTITY REC_AXIS_UWORD 0 COMP_0020 8 0 3276750 /end AXIS_PTS
/begin AXIS_PTS mTHIPAMB "20mV" 0x00011F0C NO_INPUT_QUANTITY REC_AXIS_UBYTE 0 COMP_0054 8 0 5100 /end AXIS_PTS
/begin AXIS_PTS mTXISRCV "X-50℃" 0x00012BF6 NO_INPUT_QUANTITY REC_AXIS_UBYTE 0 COMP_0035 8 -50 205 /end AXIS_PTS
/begin AXIS_PTS mLTISTGTM "X-50degC" 0x00011857 NO_INPUT_QUANTITY REC_AXIS_UBYTE 0 COMP_0004_S 8 -50 205 /end AXIS_PTS
/begin AXIS_PTS mDABFKMTM "0.00006103515625-" 0x00012E22 NO_INPUT_QUANTITY REC_AXIS_UWORD 0 COMP_0217 8 0 3.999941832 /end AXIS_PTS
/begin AXIS_PTS mNETFA "50rpm" 0x00011954 NO_INPUT_QUANTITY REC_AXIS_UBYTE 0 COMP_0020 8 0 12750 /end AXIS_PTS
/begin AXIS_PTS mDTFBYA "1/128-" 0x00011621 NO_INPUT_QUANTITY REC_AXIS_UBYTE 0 COMP_0045 8 0 1.9921875 /end AXIS_PTS
/begin AXIS_PTS mLKUBIC "100/128%" 0x00011773 NO_INPUT_QUANTITY REC_AXIS_UBYTE 0 COMP_0009 8 0 199.21875 /end AXIS_PTS
/begin AXIS_PTS mLKUBN "25rpm" 0x0001177B NO_INPUT_QUANTITY REC_AXIS_UBYTE 0 COMP_0000 8 0 6375 /end AXIS_PTS
/begin AXIS_PTS mTTKWCT "1－" 0x00015220 NO_INPUT_QUANTITY REC_AXIS_UWORD 0 COMP_0004 8 0 65535 /end AXIS_PTS
/begin AXIS_PTS mLABFLL "2.56mg" 0x0001305A NO_INPUT_QUANTITY REC_AXIS_UWORD 0 COMP_0430_S 8 -83886.08 83883.52 /end AXIS_PTS
/begin AXIS_PTS mTWLMDPMD "0.625X-40degC" 0x00012BBE NO_INPUT_QUANTITY REC_AXIS_UBYTE 0 COMP_0440_S 8 -40 119.375 /end AXIS_PTS
/begin AXIS_PTS mLTLPTRQ "3.125rpm" 0x000134DA NO_INPUT_QUANTITY REC_AXIS_UWORD 0 COMP_0065 8 0 204796.875 /end AXIS_PTS
/begin AXIS_PTS mTXRMSL "12.5rpm" 0x00012BFE NO_INPUT_QUANTITY REC_AXIS_UBYTE 0 COMP_0006 8 0 3187.5 /end AXIS_PTS
/begin AXIS_PTS mLNCTCFEQ "2^-8degC" 0x0001335A NO_INPUT_QUANTITY REC_AXIS_UWORD 0 COMP_0442_S 8 -50 205.99609375 /end AXIS_PTS
/begin AXIS_PTS mLTNEUP "12.5rpm" 0x000134EA NO_INPUT_QUANTITY REC_AXIS_UWORD 0 COMP_0006 8 0 819187.5 /end AXIS_PTS
/begin AXIS_PTS mTNIEMQE "500-" 0x000123D0 NO_INPUT_QUANTITY REC_AXIS_UBYTE 0 COMP_0443_S 8 0 127500 /end AXIS_PTS
/begin AXIS_PTS mSPCVVL "2^-9L" 0x00013BC2 NO_INPUT_QUANTITY REC_AXIS_UWORD 0 COMP_0248_S 8 0 127.99837455 /end AXIS_PTS
/begin AXIS_PTS mLPBTANMN "2^-8℃" 0x0001336A NO_INPUT_QUANTITY REC_AXIS_UWORD 0 COMP_0383 8 -50 205.99609375 /end AXIS_PTS
/begin AXIS_PTS mLPBTWN "2^0℃" 0x0001337A NO_INPUT_QUANTITY REC_AXIS_UWORD 0 COMP_0035 8 -50 65485 /end AXIS_PTS
/begin AXIS_PTS mJKPDNSLM "0.25-" 0x0001170B NO_INPUT_QUANTITY REC_AXIS_UBYTE 0 COMP_0447_S 8 0 63.75 /end AXIS_PTS
/begin AXIS_PTS mTTPGVSP "1km/h" 0x00012976 NO_INPUT_QUANTITY REC_AXIS_UBYTE 0 COMP_0429 8 0 255 /end AXIS_PTS
/begin AXIS_PTS mNLINJTI "12.5rpm" 0x00011998 NO_INPUT_QUANTITY REC_AXIS_UBYTE 0 COMP_0006 8 0 3187.5 /end AXIS_PTS
/begin AXIS_PTS mSPCVLL "1L" 0x00011A58 NO_INPUT_QUANTITY REC_AXIS_UBYTE 0 COMP_0156 8 0 255 /end AXIS_PTS
/begin AXIS_PTS mLFCCNT "0.01s" 0x000131DA NO_INPUT_QUANTITY REC_AXIS_UWORD 0 COMP_0040_S 8 0 655.35 /end AXIS_PTS
/begin AXIS_PTS mLQARANGE "1l/min" 0x000133CA NO_INPUT_QUANTITY REC_AXIS_UWORD 0 COMP_0220 8 0 65535 /end AXIS_PTS
/begin AXIS_PTS mQDMPQH0 "2^-8-" 0x00013944 NO_INPUT_QUANTITY REC_AXIS_UWORD 0 COMP_0063 8 0 255.99609375 /end AXIS_PTS
/begin AXIS_PTS mTQENSTNE "12.5rpm" 0x000125F4 NO_INPUT_QUANTITY REC_AXIS_UBYTE 0 COMP_0006 8 0 3187.5 /end AXIS_PTS
/begin AXIS_PTS mLQEPINI "X-50℃" 0x000133DA NO_INPUT_QUANTITY REC_AXIS_UWORD 0 COMP_0035 8 -50 65485 /end AXIS_PTS
/begin AXIS_PTS mLQEPINIU "X-50℃" 0x000133EA NO_INPUT_QUANTITY REC_AXIS_UWORD 0 COMP_0035 8 -50 65485 /end AXIS_PTS
/begin AXIS_PTS mLTQFSK "3.125rpm" 0x0001357A NO_INPUT_QUANTITY REC_AXIS_UWORD 0 COMP_0065 8 0 204796.875 /end AXIS_PTS
/begin AXIS_PTS mTXTWC "0.625X-40℃" 0x00012C1E NO_INPUT_QUANTITY REC_AXIS_UBYTE 0 COMP_0356 8 -40 119.375 /end AXIS_PTS
/begin AXIS_PTS mLTQO2S "1-" 0x000135AA NO_INPUT_QUANTITY REC_AXIS_UWORD 0 COMP_0068 8 0 65535 /end AXIS_PTS
/begin AXIS_PTS mTATTEMP "1count" 0x00011BA4 NO_INPUT_QUANTITY REC_AXIS_UBYTE 0 COMP_0016 8 0 255 /end AXIS_PTS
/begin AXIS_PTS mLQTRQINI "X-50℃" 0x000133FA NO_INPUT_QUANTITY REC_AXIS_UWORD 0 COMP_0035 8 -50 65485 /end AXIS_PTS
/begin AXIS_PTS mLQTRQSLB "X-50℃" 0x0001340A NO_INPUT_QUANTITY REC_AXIS_UWORD 0 COMP_0035 8 -50 65485 /end AXIS_PTS
/begin AXIS_PTS mLQTRQSLC "X-50℃" 0x0001341A NO_INPUT_QUANTITY REC_AXIS_UWORD 0 COMP_0035 8 -50 65485 /end AXIS_PTS
/begin AXIS_PTS mLQTRQSLD "X-50℃" 0x0001342A NO_INPUT_QUANTITY REC_AXIS_UWORD 0 COMP_0035 8 -50 65485 /end AXIS_PTS
/begin AXIS_PTS mLQTRQSLN "X-50℃" 0x0001343A NO_INPUT_QUANTITY REC_AXIS_UWORD 0 COMP_0035 8 -50 65485 /end AXIS_PTS
/begin AXIS_PTS mTRAPNE "12.5rpm" 0x0001266C NO_INPUT_QUANTITY REC_AXIS_UBYTE 0 COMP_0006 8 0 3187.5 /end AXIS_PTS
/begin AXIS_PTS mRATIRONT "0.125oct" 0x00013A24 NO_INPUT_QUANTITY REC_AXIS_UWORD 0 COMP_0235_S 8 0 8191.875 /end AXIS_PTS
/begin AXIS_PTS mNFSOKO "25rpm" 0x0001197C NO_INPUT_QUANTITY REC_AXIS_UBYTE 0 COMP_0000 8 0 6375 /end AXIS_PTS
/begin AXIS_PTS mTRECVRPM "25rpm" 0x00014D76 NO_INPUT_QUANTITY REC_AXIS_UWORD 0 COMP_0000 8 0 1638375 /end AXIS_PTS
/begin AXIS_PTS mGRETLM "0.625X-40℃" 0x00011649 NO_INPUT_QUANTITY REC_AXIS_UBYTE 0 COMP_0356 8 -40 119.375 /end AXIS_PTS
/begin AXIS_PTS mLTREVH "12.5rpm" 0x000135BA NO_INPUT_QUANTITY REC_AXIS_UWORD 0 COMP_0006 8 0 819187.5 /end AXIS_PTS
/begin AXIS_PTS mLTREVHB "12.5rpm" 0x000135CA NO_INPUT_QUANTITY REC_AXIS_UWORD 0 COMP_0006 8 0 819187.5 /end AXIS_PTS
/begin AXIS_PTS mLTREVHC "12.5rpm" 0x000135DA NO_INPUT_QUANTITY REC_AXIS_UWORD 0 COMP_0006 8 0 819187.5 /end AXIS_PTS
/begin AXIS_PTS mLTREVHD "12.5rpm" 0x000135EA NO_INPUT_QUANTITY REC_AXIS_UWORD 0 COMP_0006 8 0 819187.5 /end AXIS_PTS
/begin AXIS_PTS mLTREVHN "12.5rpm" 0x000135FA NO_INPUT_QUANTITY REC_AXIS_UWORD 0 COMP_0006 8 0 819187.5 /end AXIS_PTS
/begin AXIS_PTS mLTREVHNB "12.5rpm" 0x0001360A NO_INPUT_QUANTITY REC_AXIS_UWORD 0 COMP_0006 8 0 819187.5 /end AXIS_PTS
/begin AXIS_PTS mLTREVHNC "12.5rpm" 0x0001361A NO_INPUT_QUANTITY REC_AXIS_UWORD 0 COMP_0006 8 0 819187.5 /end AXIS_PTS
/begin AXIS_PTS mLTREVSL "X-50℃" 0x0001362A NO_INPUT_QUANTITY REC_AXIS_UWORD 0 COMP_0035 8 -50 65485 /end AXIS_PTS
/begin AXIS_PTS mLTREVSLB "X-50℃" 0x0001363A NO_INPUT_QUANTITY REC_AXIS_UWORD 0 COMP_0035 8 -50 65485 /end AXIS_PTS
/begin AXIS_PTS mLTREVSLC "X-50℃" 0x0001364A NO_INPUT_QUANTITY REC_AXIS_UWORD 0 COMP_0035 8 -50 65485 /end AXIS_PTS
/begin AXIS_PTS mLTREVSLD "X-50℃" 0x0001365A NO_INPUT_QUANTITY REC_AXIS_UWORD 0 COMP_0035 8 -50 65485 /end AXIS_PTS
/begin AXIS_PTS mTRLVSP "0.1km/h" 0x00014E96 NO_INPUT_QUANTITY REC_AXIS_UWORD 0 COMP_0436 8 0 6553.5 /end AXIS_PTS
/begin AXIS_PTS mTXSAOSC "2.56mg" 0x00015700 NO_INPUT_QUANTITY REC_AXIS_UWORD 0 COMP_0430_S 8 -83886.08 83883.52 /end AXIS_PTS
/begin AXIS_PTS mTXSATMP "4℃" 0x00012C0E NO_INPUT_QUANTITY REC_AXIS_UBYTE 0 COMP_0062 8 0 1020 /end AXIS_PTS
/begin AXIS_PTS mLSLCFBP "12.5rpm" 0x0001344A NO_INPUT_QUANTITY REC_AXIS_UWORD 0 COMP_0006 8 0 819187.5 /end AXIS_PTS
/begin AXIS_PTS mTLSLOPOK "1/512kPa" 0x00014842 NO_INPUT_QUANTITY REC_AXIS_UWORD 0 COMP_0123_S 8 0 127.998046875 /end AXIS_PTS
/begin AXIS_PTS mSLPRT "1/64-" 0x00011A20 NO_INPUT_QUANTITY REC_AXIS_UBYTE 0 COMP_0186 8 0 3.984375 /end AXIS_PTS
/begin AXIS_PTS mTXSROSC "2.56mg" 0x00015710 NO_INPUT_QUANTITY REC_AXIS_UWORD 0 COMP_0430_S 8 -83886.08 83883.52 /end AXIS_PTS
/begin AXIS_PTS mTXSRTMP "4℃" 0x00012C16 NO_INPUT_QUANTITY REC_AXIS_UBYTE 0 COMP_0062 8 0 1020 /end AXIS_PTS
/begin AXIS_PTS mLSTDVTO "X-50℃" 0x00011817 NO_INPUT_QUANTITY REC_AXIS_UBYTE 0 COMP_0035 8 -50 205 /end AXIS_PTS
/begin AXIS_PTS mLSTDVTW "0.625X-40℃" 0x0001181F NO_INPUT_QUANTITY REC_AXIS_UBYTE 0 COMP_0356 8 -40 119.375 /end AXIS_PTS
/begin AXIS_PTS mTTWNPILN "X-50℃" 0x00012A72 NO_INPUT_QUANTITY REC_AXIS_UBYTE 0 COMP_0035 8 -50 205 /end AXIS_PTS
/begin AXIS_PTS mTTWNPIS2 "X-50℃" 0x00012A7A NO_INPUT_QUANTITY REC_AXIS_UBYTE 0 COMP_0035 8 -50 205 /end AXIS_PTS
/begin AXIS_PTS mTTANPIGL "X-50℃" 0x000127DA NO_INPUT_QUANTITY REC_AXIS_UBYTE 0 COMP_0035 8 -50 205 /end AXIS_PTS
/begin AXIS_PTS mTTATTMP "1count" 0x0001280A NO_INPUT_QUANTITY REC_AXIS_UBYTE 0 COMP_0016 8 0 255 /end AXIS_PTS
/begin AXIS_PTS mMEGITAC "100/128%" 0x00011927 NO_INPUT_QUANTITY REC_AXIS_UBYTE 0 COMP_0009 8 0 199.21875 /end AXIS_PTS
/begin AXIS_PTS mTTDRDSN "50rpm" 0x0001283A NO_INPUT_QUANTITY REC_AXIS_UBYTE 0 COMP_0020 8 0 12750 /end AXIS_PTS
/begin AXIS_PTS mLHSOSQ "2.56mg" 0x0001323A NO_INPUT_QUANTITY REC_AXIS_UWORD 0 COMP_0430_S 8 -83886.08 83883.52 /end AXIS_PTS
/begin AXIS_PTS mNSLP "12.5rpm" 0x000119B0 NO_INPUT_QUANTITY REC_AXIS_UBYTE 0 COMP_0006 8 0 3187.5 /end AXIS_PTS
/begin AXIS_PTS mLITMHPHN "25rpm" 0x00011763 NO_INPUT_QUANTITY REC_AXIS_UBYTE 0 COMP_0000 8 0 6375 /end AXIS_PTS
/begin AXIS_PTS mLITMHPRN "25rpm" 0x0001176B NO_INPUT_QUANTITY REC_AXIS_UBYTE 0 COMP_0000 8 0 6375 /end AXIS_PTS
/* COMPU_METHOD --------------------------------------------------------- */
/begin COMPU_METHOD COMP_0017 "1deg" RAT_FUNC "%8.2" "deg" COEFFS 0 1 0 0 0 1 /end COMPU_METHOD
/begin COMPU_METHOD COMP_0004 "1－" RAT_FUNC "%8.2" "－" COEFFS 0 1 0 0 0 1 /end COMPU_METHOD
/begin COMPU_METHOD COMP_0068 "1-" RAT_FUNC "%8.2" "-" COEFFS 0 1 0 0 0 1 /end COMPU_METHOD
/begin COMPU_METHOD COMP_0013 "1s" RAT_FUNC "%8.2" "s" COEFFS 0 1 0 0 0 1 /end COMPU_METHOD
/begin COMPU_METHOD COMP_0014 "10ms" RAT_FUNC "%8.2" "ms" COEFFS 0 1 0 0 0 10 /end COMPU_METHOD
/begin COMPU_METHOD COMP_0045 "1/128-" RAT_FUNC "%8.4" "-" COEFFS 0 1 0 0 0 0.0078125 /end COMPU_METHOD
/begin COMPU_METHOD COMP_0009 "100/128%" RAT_FUNC "%8.2" "%" COEFFS 0 1 0 0 0 0.78125 /end COMPU_METHOD
/begin COMPU_METHOD COMP_0000 "25rpm" RAT_FUNC "%8.2" "rpm" COEFFS 0 1 0 0 0 25 /end COMPU_METHOD
/begin COMPU_METHOD COMP_0186 "1/64-" RAT_FUNC "%8.3" "-" COEFFS 0 1 0 0 0 0.015625 /end COMPU_METHOD
/begin COMPU_METHOD COMP_0001 "1/8ms" RAT_FUNC "%8.2" "ms" COEFFS 0 1 0 0 0 0.125 /end COMPU_METHOD
/begin COMPU_METHOD COMP_0020 "50rpm" RAT_FUNC "%8.2" "rpm" COEFFS 0 1 0 0 0 50 /end COMPU_METHOD
/begin COMPU_METHOD COMP_0004_S "X-50degC" RAT_FUNC "%8.2" "degC" COEFFS 0 1 50 0 0 1 /end COMPU_METHOD
/begin COMPU_METHOD COMP_0388 "0.1-" RAT_FUNC "%8.2" "-" COEFFS 0 1 0 0 0 0.1 /end COMPU_METHOD
/begin COMPU_METHOD COMP_0373 "1/100-" RAT_FUNC "%8.3" "-" COEFFS 0 1 0 0 0 0.01 /end COMPU_METHOD
/begin COMPU_METHOD COMP_0002 "0.35deg" RAT_FUNC "%8.2" "deg" COEFFS 0 1 0 0 0 0.35 /end COMPU_METHOD
/begin COMPU_METHOD COMP_0003 "1℃" RAT_FUNC "%8.2" "℃" COEFFS 0 1 0 0 0 1 /end COMPU_METHOD
/begin COMPU_METHOD COMP_0035 "X-50℃" RAT_FUNC "%8.2" "℃" COEFFS 0 1 50 0 0 1 /end COMPU_METHOD
/begin COMPU_METHOD COMP_0453 "0.002-" RAT_FUNC "%8.4" "-" COEFFS 0 1 0 0 0 0.002 /end COMPU_METHOD
/begin COMPU_METHOD COMP_0005 "0.11deg" RAT_FUNC "%8.2" "deg" COEFFS 0 1 0 0 0 0.11 /end COMPU_METHOD
/begin COMPU_METHOD COMP_0006 "12.5rpm" RAT_FUNC "%8.2" "rpm" COEFFS 0 1 0 0 0 12.5 /end COMPU_METHOD
/begin COMPU_METHOD COMP_0008 "100ms" RAT_FUNC "%8.2" "ms" COEFFS 0 1 0 0 0 100 /end COMPU_METHOD
/begin COMPU_METHOD COMP_0011 "0.02MPa" RAT_FUNC "%8.3" "MPa" COEFFS 0 1 0 0 0 0.02 /end COMPU_METHOD
/begin COMPU_METHOD COMP_0007 "2km/h" RAT_FUNC "%8.2" "km/h" COEFFS 0 1 0 0 0 2 /end COMPU_METHOD
/begin COMPU_METHOD COMP_0047 "0.5%" RAT_FUNC "%8.2" "%" COEFFS 0 1 0 0 0 0.5 /end COMPU_METHOD
/begin COMPU_METHOD COMP_0163 "1/16%" RAT_FUNC "%8.3" "%" COEFFS 0 1 0 0 0 0.0625 /end COMPU_METHOD
/begin COMPU_METHOD COMP_0019 "1degCA" RAT_FUNC "%8.2" "degCA" COEFFS 0 1 0 0 0 1 /end COMPU_METHOD
/begin COMPU_METHOD COMP_0081 "1/256deg" RAT_FUNC "%8.4" "deg" COEFFS 0 1 0 0 0 0.00390625 /end COMPU_METHOD
/begin COMPU_METHOD COMP_0217 "1/16384-" RAT_FUNC "%8.6" "-" COEFFS 0 1 0 0 0 0.0000610352 /end COMPU_METHOD
/begin COMPU_METHOD COMP_0023 "5mV" RAT_FUNC "%8.2" "mV" COEFFS 0 1 0 0 0 5 /end COMPU_METHOD
/begin COMPU_METHOD COMP_0033 "80mV" RAT_FUNC "%8.2" "mV" COEFFS 0 1 0 0 0 80 /end COMPU_METHOD
/begin COMPU_METHOD COMP_0027 "1%" RAT_FUNC "%8.2" "%" COEFFS 0 1 0 0 0 1 /end COMPU_METHOD
/begin COMPU_METHOD COMP_0266 "64/128deg" RAT_FUNC "%8.2" "deg" COEFFS 0 1 0 0 0 0.5 /end COMPU_METHOD
/begin COMPU_METHOD COMP_0015_S "0.1sec" RAT_FUNC "%8.2" "sec" COEFFS 0 1 0 0 0 0.1 /end COMPU_METHOD
/begin COMPU_METHOD COMP_0017_S "0.01sec" RAT_FUNC "%8.3" "sec" COEFFS 0 1 0 0 0 0.01 /end COMPU_METHOD
/begin COMPU_METHOD COMP_0049 "1sec" RAT_FUNC "%8.2" "sec" COEFFS 0 1 0 0 0 1 /end COMPU_METHOD
/begin COMPU_METHOD COMP_0032 "1/256－" RAT_FUNC "%8.4" "－" COEFFS 0 1 0 0 0 0.00390625 /end COMPU_METHOD
/begin COMPU_METHOD COMP_0066 "1/64－" RAT_FUNC "%8.3" "－" COEFFS 0 1 0 0 0 0.015625 /end COMPU_METHOD
/begin COMPU_METHOD COMP_0018_S "0.5/256-" RAT_FUNC "%8.4" "-" COEFFS 0 1 0 0 0 0.001953125 /end COMPU_METHOD
/begin COMPU_METHOD COMP_0063 "1/256-" RAT_FUNC "%8.4" "-" COEFFS 0 1 0 0 0 0.00390625 /end COMPU_METHOD
/begin COMPU_METHOD COMP_0019_S "1/255-" RAT_FUNC "%8.4" "-" COEFFS 0 1 0 0 0 0.003921569 /end COMPU_METHOD
/begin COMPU_METHOD COMP_0030 "1回" RAT_FUNC "%8.2" "回" COEFFS 0 1 0 0 0 1 /end COMPU_METHOD
/begin COMPU_METHOD COMP_0016 "1count" RAT_FUNC "%8.2" "count" COEFFS 0 1 0 0 0 1 /end COMPU_METHOD
/begin COMPU_METHOD COMP_0436 "0.1km/h" RAT_FUNC "%8.2" "km/h" COEFFS 0 1 0 0 0 0.1 /end COMPU_METHOD
/begin COMPU_METHOD COMP_0256 "64/128degCA" RAT_FUNC "%8.2" "degCA" COEFFS 0 1 64 0 0 0.5 /end COMPU_METHOD
/begin COMPU_METHOD COMP_0031 "1/256%" RAT_FUNC "%8.4" "%" COEFFS 0 1 0 0 0 0.00390625 /end COMPU_METHOD
/begin COMPU_METHOD COMP_0028_S "3.90625E-11cm**2/rp" RAT_FUNC "%8.6" "cm**2/rp" COEFFS 0 1 0 0 0 3.90625E-11 /end COMPU_METHOD
/begin COMPU_METHOD COMP_0065 "3.125rpm" RAT_FUNC "%8.2" "rpm" COEFFS 0 1 0 0 0 3.125 /end COMPU_METHOD
/begin COMPU_METHOD COMP_0031_S "0.00061MPa" RAT_FUNC "%8.5" "MPa" COEFFS 0 1 0 0 0 0.00061 /end COMPU_METHOD
/begin COMPU_METHOD COMP_0032_S "0.125%" RAT_FUNC "%8.2" "%" COEFFS 0 1 0 0 0 0.125 /end COMPU_METHOD
/begin COMPU_METHOD COMP_0034_S "2^-8kPa" RAT_FUNC "%8.4" "kPa" COEFFS 0 1 0 0 0 0.00390625 /end COMPU_METHOD
/begin COMPU_METHOD COMP_0220 "1l/min" RAT_FUNC "%8.2" "l/min" COEFFS 0 1 0 0 0 1 /end COMPU_METHOD
/begin COMPU_METHOD COMP_0040_S "0.01s" RAT_FUNC "%8.3" "s" COEFFS 0 1 0 0 0 0.01 /end COMPU_METHOD
/begin COMPU_METHOD COMP_0041 "0.0008cm^2" RAT_FUNC "%8.5" "cm^2" COEFFS 0 1 0 0 0 0.0008 /end COMPU_METHOD
/begin COMPU_METHOD COMP_0042 "0.0008cm**2" RAT_FUNC "%8.5" "cm**2" COEFFS 0 1 0 0 0 0.0008 /end COMPU_METHOD
/begin COMPU_METHOD COMP_0043 "1/(256*4)－" RAT_FUNC "%8.5" "－" COEFFS 0 1 0 0 0 0.000976563 /end COMPU_METHOD
/begin COMPU_METHOD COMP_0044 "1/128－" RAT_FUNC "%8.4" "－" COEFFS 0 1 0 0 0 0.0078125 /end COMPU_METHOD
/begin COMPU_METHOD COMP_0045_S "1A" RAT_FUNC "%8.2" "A" COEFFS 0 1 0 0 0 1 /end COMPU_METHOD
/begin COMPU_METHOD COMP_0054 "20mV" RAT_FUNC "%8.2" "mV" COEFFS 0 1 0 0 0 20 /end COMPU_METHOD
/begin COMPU_METHOD COMP_0450 "1/1024-" RAT_FUNC "%8.5" "-" COEFFS 0 1 0 0 0 0.000976563 /end COMPU_METHOD
/begin COMPU_METHOD COMP_0055 "4deg" RAT_FUNC "%8.2" "deg" COEFFS 0 1 0 0 0 4 /end COMPU_METHOD
/begin COMPU_METHOD COMP_0105 "0.1s" RAT_FUNC "%8.2" "s" COEFFS 0 1 0 0 0 0.1 /end COMPU_METHOD
/begin COMPU_METHOD COMP_0290 "1/65536-" RAT_FUNC "%8.6" "-" COEFFS 0 1 0 0 0 0.0000152588 /end COMPU_METHOD
/begin COMPU_METHOD COMP_0061_S "0.0001-" RAT_FUNC "%8.5" "-" COEFFS 0 1 0 0 0 0.0001 /end COMPU_METHOD
/begin COMPU_METHOD COMP_0065_S "1/64kPa" RAT_FUNC "%8.3" "kPa" COEFFS 0 1 0 0 0 0.015625 /end COMPU_METHOD
/begin COMPU_METHOD COMP_0069_S "1℃" RAT_FUNC "%8.2" "℃" COEFFS 0 1 50 0 0 1 /end COMPU_METHOD
/begin COMPU_METHOD COMP_0021 "100/256%" RAT_FUNC "%8.2" "%" COEFFS 0 1 0 0 0 0.390625 /end COMPU_METHOD
/begin COMPU_METHOD COMP_0081_S "100/256%/100ms" RAT_FUNC "%8.2" "%/100ms" COEFFS 0 1 0 0 0 0.390625 /end COMPU_METHOD
/begin COMPU_METHOD COMP_0082_S "1rpm/50ms" RAT_FUNC "%8.2" "rpm/50ms" COEFFS 0 1 0 0 0 1 /end COMPU_METHOD
/begin COMPU_METHOD COMP_0096 "10s" RAT_FUNC "%8.2" "s" COEFFS 0 1 0 0 0 10 /end COMPU_METHOD
/begin COMPU_METHOD COMP_0051 "1L/min" RAT_FUNC "%8.2" "L/min" COEFFS 0 1 0 0 0 1 /end COMPU_METHOD
/begin COMPU_METHOD COMP_0456 "1/(256×128)-" RAT_FUNC "%8.6" "-" COEFFS 0 1 0 0 0 0.0000305176 /end COMPU_METHOD
/begin COMPU_METHOD COMP_0087_S "0.07808MPa" RAT_FUNC "%8.3" "MPa" COEFFS 0 1 0 0 0 0.07808 /end COMPU_METHOD
/begin COMPU_METHOD COMP_0156 "1L" RAT_FUNC "%8.2" "L" COEFFS 0 1 0 0 0 1 /end COMPU_METHOD
/begin COMPU_METHOD COMP_0115 "100/65536%" RAT_FUNC "%8.4" "%" COEFFS 0 1 0 0 0 0.0015259 /end COMPU_METHOD
/begin COMPU_METHOD COMP_0050 "5/64mV" RAT_FUNC "%8.3" "mV" COEFFS 0 1 0 0 0 0.078125 /end COMPU_METHOD
/begin COMPU_METHOD COMP_0100_S "0.0078125%/10ms" RAT_FUNC "%8.4" "%/10ms" COEFFS 0 1 0 0 0 0.0078125 /end COMPU_METHOD
/begin COMPU_METHOD COMP_0196 "0.1Nm" RAT_FUNC "%8.2" "Nm" COEFFS 0 1 0 0 0 0.1 /end COMPU_METHOD
/begin COMPU_METHOD COMP_0083 "1/256deg/10ms" RAT_FUNC "%8.4" "deg/10ms" COEFFS 0 1 0 0 0 0.00390625 /end COMPU_METHOD
/begin COMPU_METHOD COMP_0190 "2deg" RAT_FUNC "%8.2" "deg" COEFFS 0 1 0 0 0 2 /end COMPU_METHOD
/begin COMPU_METHOD COMP_0108_S "64/128degCA" RAT_FUNC "%8.2" "degCA" COEFFS 0 1 16384 0 0 0.5 /end COMPU_METHOD
/begin COMPU_METHOD COMP_0141 "50/256%" RAT_FUNC "%8.2" "%" COEFFS 0 1 0 0 0 0.1953125 /end COMPU_METHOD
/begin COMPU_METHOD COMP_0149 "1/2048－" RAT_FUNC "%8.5" "－" COEFFS 0 1 0 0 0 0.000488282 /end COMPU_METHOD
/begin COMPU_METHOD COMP_0120_S "0.25kPa" RAT_FUNC "%8.2" "kPa" COEFFS 0 1 0 0 0 0.25 /end COMPU_METHOD
/begin COMPU_METHOD COMP_0277 "1L/min" RAT_FUNC "%8.2" "L/min" COEFFS 0 1 0 0 0 1 /end COMPU_METHOD
/begin COMPU_METHOD COMP_0064 "1.5625rpm" RAT_FUNC "%8.2" "rpm" COEFFS 0 1 0 0 0 1.5625 /end COMPU_METHOD
/begin COMPU_METHOD COMP_0123_S "1/512kPa" RAT_FUNC "%8.4" "kPa" COEFFS 0 1 0 0 0 0.001953125 /end COMPU_METHOD
/begin COMPU_METHOD COMP_0312 "0.5/256L" RAT_FUNC "%8.4" "L" COEFFS 0 1 0 0 0 0.001953125 /end COMPU_METHOD
/begin COMPU_METHOD COMP_0146 "100/256/256%" RAT_FUNC "%8.4" "%" COEFFS 0 1 0 0 0 0.001525879 /end COMPU_METHOD
/begin COMPU_METHOD COMP_0130_S "0.001G" RAT_FUNC "%8.4" "G" COEFFS 0 1 0 0 0 0.001 /end COMPU_METHOD
/begin COMPU_METHOD COMP_0136_S "0.0037(X-511)G" RAT_FUNC "%8.4" "G" COEFFS 0 1 1.8907 0 0 0.0037 /end COMPU_METHOD
/begin COMPU_METHOD COMP_0328 "100/(64*256)%" RAT_FUNC "%8.4" "%" COEFFS 0 1 0 0 0 0.006103516 /end COMPU_METHOD
/begin COMPU_METHOD COMP_0152_S "6.4μs" RAT_FUNC "%8.2" "μs" COEFFS 0 1 0 0 0 6.4 /end COMPU_METHOD
/begin COMPU_METHOD COMP_0157_S "1.6μs" RAT_FUNC "%8.2" "μs" COEFFS 0 1 0 0 0 1.6 /end COMPU_METHOD
/begin COMPU_METHOD COMP_0158_S "0.125X-50℃" RAT_FUNC "%8.2" "℃" COEFFS 0 1 50 0 0 0.125 /end COMPU_METHOD
/begin COMPU_METHOD COMP_0193 "0.1Nm/10ms" RAT_FUNC "%8.2" "Nm/10ms" COEFFS 0 1 0 0 0 0.1 /end COMPU_METHOD
/begin COMPU_METHOD COMP_0447 "100/1024%" RAT_FUNC "%8.3" "%" COEFFS 0 1 0 0 0 0.09765625 /end COMPU_METHOD
/begin COMPU_METHOD COMP_0174_S "1deg/50rp" RAT_FUNC "%8.2" "deg/50rp" COEFFS 0 1 0 0 0 1 /end COMPU_METHOD
/begin COMPU_METHOD COMP_0062 "4℃" RAT_FUNC "%8.2" "℃" COEFFS 0 1 0 0 0 4 /end COMPU_METHOD
/begin COMPU_METHOD COMP_0175_S "1/2561/10ms" RAT_FUNC "%8.4" "1/10ms" COEFFS 0 1 0 0 0 0.00390625 /end COMPU_METHOD
/begin COMPU_METHOD COMP_0130 "0.0275deg" RAT_FUNC "%8.3" "deg" COEFFS 0 1 0 0 0 0.0275 /end COMPU_METHOD
/begin COMPU_METHOD COMP_0182_S "0.001-" RAT_FUNC "%8.4" "-" COEFFS 0 1 0 0 0 0.001 /end COMPU_METHOD
/begin COMPU_METHOD COMP_0254 "1/16deg/%" RAT_FUNC "%8.3" "deg/%" COEFFS 0 1 0 0 0 0.0625 /end COMPU_METHOD
/begin COMPU_METHOD COMP_0201_S "0.125oct" RAT_FUNC "%8.2" "oct" COEFFS 0 1 -75 0 0 0.125 /end COMPU_METHOD
/begin COMPU_METHOD COMP_0209_S "100/32768%" RAT_FUNC "%8.4" "%" COEFFS 0 1 0 0 0 0.003051757 /end COMPU_METHOD
/begin COMPU_METHOD COMP_0213_S "80μs" RAT_FUNC "%8.2" "μs" COEFFS 0 1 0 0 0 80 /end COMPU_METHOD
/begin COMPU_METHOD COMP_0215_S "1/512kPa" RAT_FUNC "%8.4" "kPa" COEFFS 0 1 0 0 0 0.00195313 /end COMPU_METHOD
/begin COMPU_METHOD COMP_0052 "1/2048ms" RAT_FUNC "%8.5" "ms" COEFFS 0 1 0 0 0 0.000488282 /end COMPU_METHOD
/begin COMPU_METHOD COMP_0276 "4L/min" RAT_FUNC "%8.2" "L/min" COEFFS 0 1 0 0 0 4 /end COMPU_METHOD
/begin COMPU_METHOD COMP_0293 "2L/min" RAT_FUNC "%8.2" "L/min" COEFFS 0 1 0 0 0 2 /end COMPU_METHOD
/begin COMPU_METHOD COMP_0235_S "32/256oct" RAT_FUNC "%8.2" "oct" COEFFS 0 1 0 0 0 0.125 /end COMPU_METHOD
/begin COMPU_METHOD COMP_0238_S "0.01km/h" RAT_FUNC "%8.3" "km/h" COEFFS 0 1 0 0 0 0.01 /end COMPU_METHOD
/begin COMPU_METHOD COMP_0248_S "2^-9L" RAT_FUNC "%8.4" "L" COEFFS 0 1 0 0 0 0.00195313 /end COMPU_METHOD
/begin COMPU_METHOD COMP_0291 "0.04*256g℃" RAT_FUNC "%8.2" "g℃" COEFFS 0 1 0 0 0 10.24 /end COMPU_METHOD
/begin COMPU_METHOD COMP_0314 "X-128deg" RAT_FUNC "%8.2" "deg" COEFFS 0 1 128 0 0 1 /end COMPU_METHOD
/begin COMPU_METHOD COMP_0250_S "X-128deg" RAT_FUNC "%8.2" "deg" COEFFS 0 1 128 0 0 1 /end COMPU_METHOD
/begin COMPU_METHOD COMP_0429 "1km/h" RAT_FUNC "%8.2" "km/h" COEFFS 0 1 0 0 0 1 /end COMPU_METHOD
/begin COMPU_METHOD COMP_0259_S "0.2℃" RAT_FUNC "%8.2" "℃" COEFFS 0 1 50 0 0 0.2 /end COMPU_METHOD
/begin COMPU_METHOD COMP_0315 "0.09765%/ms" RAT_FUNC "%8.3" "%/ms" COEFFS 0 1 0 0 0 0.09765 /end COMPU_METHOD
/begin COMPU_METHOD COMP_0356 "0.625X-40℃" RAT_FUNC "%8.2" "℃" COEFFS 0 1 40 0 0 0.625 /end COMPU_METHOD
/begin COMPU_METHOD COMP_0410 "100/256/256%" RAT_FUNC "%8.4" "%" COEFFS 0 1 0 0 0 0.00152588 /end COMPU_METHOD
/begin COMPU_METHOD COMP_0285_S "0.00002-" RAT_FUNC "%8.6" "-" COEFFS 0 1 0 0 0 0.00002 /end COMPU_METHOD
/begin COMPU_METHOD COMP_0053 "1ms" RAT_FUNC "%8.2" "ms" COEFFS 0 1 0 0 0 1 /end COMPU_METHOD
/begin COMPU_METHOD COMP_0304_S "0.000016kg/s" RAT_FUNC "%8.6" "kg/s" COEFFS 0 1 0 0 0 0.000016 /end COMPU_METHOD
/begin COMPU_METHOD COMP_0226 "0.1Nm" RAT_FUNC "%8.2" "Nm" COEFFS 0 1 3276.8 0 0 0.1 /end COMPU_METHOD
/begin COMPU_METHOD COMP_0246 "100/16%" RAT_FUNC "%8.2" "%" COEFFS 0 1 0 0 0 6.25 /end COMPU_METHOD
/begin COMPU_METHOD COMP_0314_S "80/256mV" RAT_FUNC "%8.2" "mV" COEFFS 0 1 0 0 0 0.3125 /end COMPU_METHOD
/begin COMPU_METHOD COMP_0315_S "1N" RAT_FUNC "%8.2" "N" COEFFS 0 1 32768 0 0 1 /end COMPU_METHOD
/begin COMPU_METHOD COMP_0324_S "fixed axis -" RAT_FUNC "%8.2" "-" COEFFS 0 1 -1 0 0 1 /end COMPU_METHOD
/begin COMPU_METHOD COMP_0325_S "fixed axis deg" RAT_FUNC "%8.2" "deg" COEFFS 0 1 0 0 0 10.56 /end COMPU_METHOD
/begin COMPU_METHOD COMP_0326_S "fixed axis rpm" RAT_FUNC "%8.2" "rpm" COEFFS 0 1 0 0 0 1000 /end COMPU_METHOD
/begin COMPU_METHOD COMP_0329_S "fixed axis rpm" RAT_FUNC "%8.2" "rpm" COEFFS 0 1 0 0 0 800 /end COMPU_METHOD
/begin COMPU_METHOD COMP_0330_S "fixed axis %" RAT_FUNC "%8.2" "%" COEFFS 0 1 0 0 0 12.5 /end COMPU_METHOD
/begin COMPU_METHOD COMP_0333_S "fixed axis ℃" RAT_FUNC "%8.2" "℃" COEFFS 0 1 40 0 0 20 /end COMPU_METHOD
/begin COMPU_METHOD COMP_0334_S "100/4096%" RAT_FUNC "%8.3" "%" COEFFS 0 1 0 0 0 0.0244141 /end COMPU_METHOD
/begin COMPU_METHOD COMP_0336_S "1L/min" RAT_FUNC "%8.2" "L/min" COEFFS 0 1 32768 0 0 1 /end COMPU_METHOD
/begin COMPU_METHOD COMP_0347_S "fixed axis rpm" RAT_FUNC "%8.2" "rpm" COEFFS 0 1 0 0 0 400 /end COMPU_METHOD
/begin COMPU_METHOD COMP_0348_S "fixed axis ℃" RAT_FUNC "%8.2" "℃" COEFFS 0 1 40 0 0 10 /end COMPU_METHOD
/begin COMPU_METHOD COMP_0349_S "fixed axis mV" RAT_FUNC "%8.2" "mV" COEFFS 0 1 0 0 0 320 /end COMPU_METHOD
/begin COMPU_METHOD COMP_0350_S "fixed axis km/h" RAT_FUNC "%8.2" "km/h" COEFFS 0 1 -8 0 0 4 /end COMPU_METHOD
/begin COMPU_METHOD COMP_0351_S "0.002ー" RAT_FUNC "%8.4" "ー" COEFFS 0 1 0 0 0 0.002 /end COMPU_METHOD
/begin COMPU_METHOD COMP_0352_S "1.25mv" RAT_FUNC "%8.2" "mv" COEFFS 0 1 0 0 0 1.25 /end COMPU_METHOD
/begin COMPU_METHOD COMP_0353_S "fixed axis %" RAT_FUNC "%8.2" "%" COEFFS 0 1 -6.25 0 0 6.25 /end COMPU_METHOD
/begin COMPU_METHOD COMP_0354_S "fixed axis rpm" RAT_FUNC "%8.2" "rpm" COEFFS 0 1 0 0 0 200 /end COMPU_METHOD
/begin COMPU_METHOD COMP_0355_S "fixed axis km/h" RAT_FUNC "%8.2" "km/h" COEFFS 0 1 0 0 0 8 /end COMPU_METHOD
/begin COMPU_METHOD COMP_0304 "256/xsec" RAT_FUNC "%8.2" "sec" COEFFS 0 0 256 0 1 0 /end COMPU_METHOD
/begin COMPU_METHOD COMP_0356_S "256/xs" RAT_FUNC "%8.2" "s" COEFFS 0 0 256 0 1 0 /end COMPU_METHOD
/begin COMPU_METHOD COMP_0357_S "fixed axis rpm" RAT_FUNC "%8.2" "rpm" COEFFS 0 1 -400 0 0 400 /end COMPU_METHOD
/begin COMPU_METHOD COMP_0358_S "fixed axis ℃" RAT_FUNC "%8.2" "℃" COEFFS 0 1 -10 0 0 10 /end COMPU_METHOD
/begin COMPU_METHOD COMP_0341 "1/256-" RAT_FUNC "%8.4" "-" COEFFS 0 1 0 0 0 0.00391 /end COMPU_METHOD
/begin COMPU_METHOD COMP_0268 "0.000305Mpa" RAT_FUNC "%8.5" "Mpa" COEFFS 0 1 0 0 0 0.000305 /end COMPU_METHOD
/begin COMPU_METHOD COMP_0330 "1count" RAT_FUNC "%8.2" "count" COEFFS 0 1 128 0 0 1 /end COMPU_METHOD
/begin COMPU_METHOD COMP_0359_S "fixed axis rpm" RAT_FUNC "%8.2" "rpm" COEFFS 0 1 -1200 0 0 400 /end COMPU_METHOD
/begin COMPU_METHOD COMP_0360_S "2^-15deg/10ms" RAT_FUNC "%8.6" "deg/10ms" COEFFS 0 1 0 0 0 0.0000305176 /end COMPU_METHOD
/begin COMPU_METHOD COMP_0361_S "fixed axis rpm" RAT_FUNC "%8.2" "rpm" COEFFS 0 1 0 0 0 100 /end COMPU_METHOD
/begin COMPU_METHOD COMP_0362_S "6.25-" RAT_FUNC "%8.2" "-" COEFFS 0 1 0 0 0 6.25 /end COMPU_METHOD
/begin COMPU_METHOD COMP_0363_S "0.005kPa" RAT_FUNC "%8.4" "kPa" COEFFS 0 1 0 0 0 0.005 /end COMPU_METHOD
/begin COMPU_METHOD COMP_0364_S "1/65536NULL" RAT_FUNC "%8.6" "NULL" COEFFS 0 1 0 0 0 0.0000152588 /end COMPU_METHOD
/begin COMPU_METHOD COMP_0365_S "64/256deg" RAT_FUNC "%8.2" "deg" COEFFS 0 1 0 0 0 0.25 /end COMPU_METHOD
/begin COMPU_METHOD COMP_0338 "1/64－" RAT_FUNC "%8.3" "－" COEFFS 0 1 0 0 0 0.015625 /end COMPU_METHOD
/begin COMPU_METHOD COMP_0340 "2l/min" RAT_FUNC "%8.2" "l/min" COEFFS 0 1 0 0 0 2 /end COMPU_METHOD
/begin COMPU_METHOD COMP_0366_S "1/2048oct" RAT_FUNC "%8.5" "oct" COEFFS 0 1 0 0 0 0.000488281 /end COMPU_METHOD
/begin COMPU_METHOD COMP_0367_S "0.00390625-" RAT_FUNC "%8.4" "-" COEFFS 0 1 128 0 0 0.00390625 /end COMPU_METHOD
/begin COMPU_METHOD COMP_0368_S "fixed axis rpm" RAT_FUNC "%8.2" "rpm" COEFFS 0 1 -2000 0 0 400 /end COMPU_METHOD
/begin COMPU_METHOD COMP_0369_S "fixed axis cm^2/(rp" RAT_FUNC "%8.6" "cm^2/(rp" COEFFS 0 1 -0.000001394 0 0 0.0000003719 /end COMPU_METHOD
/begin COMPU_METHOD COMP_0370_S "fixed axis cm^2/(rp" RAT_FUNC "%8.6" "cm^2/(rp" COEFFS 0 1 0 0 0 0.00000009297 /end COMPU_METHOD
/begin COMPU_METHOD COMP_0371_S "2^-14deg/oct" RAT_FUNC "%8.6" "deg/oct" COEFFS 0 1 0 0 0 0.000061035 /end COMPU_METHOD
/begin COMPU_METHOD COMP_0372_S "200/2048oct" RAT_FUNC "%8.3" "oct" COEFFS 0 1 0 0 0 0.0976563 /end COMPU_METHOD
/begin COMPU_METHOD COMP_0466 "1/2048-" RAT_FUNC "%8.5" "-" COEFFS 0 1 0 0 0 0.000488281 /end COMPU_METHOD
/begin COMPU_METHOD COMP_0373_S "X-50-" RAT_FUNC "%8.2" "-" COEFFS 0 1 50 0 0 1 /end COMPU_METHOD
/begin COMPU_METHOD COMP_0374_S "0.01mm" RAT_FUNC "%8.3" "mm" COEFFS 0 1 0 0 0 0.01 /end COMPU_METHOD
/begin COMPU_METHOD COMP_0375_S "2^-10deg" RAT_FUNC "%8.5" "deg" COEFFS 0 1 30 0 0 0.000976562 /end COMPU_METHOD
/begin COMPU_METHOD COMP_0376_S "fixed axis -" RAT_FUNC "%8.3" "-" COEFFS 0 1 0 0 0 0.06 /end COMPU_METHOD
/begin COMPU_METHOD COMP_0377_S "0.0000003125m" RAT_FUNC "%8.6" "m" COEFFS 0 1 0 0 0 0.0000003125 /end COMPU_METHOD
/begin COMPU_METHOD COMP_0378_S "0.00000002m**2" RAT_FUNC "%8.6" "m**2" COEFFS 0 1 0 0 0 0.00000002 /end COMPU_METHOD
/begin COMPU_METHOD COMP_0379_S "fixed axis mV" RAT_FUNC "%8.2" "mV" COEFFS 0 1 0 0 0 160 /end COMPU_METHOD
/begin COMPU_METHOD COMP_0380_S "6.25E-10cm^2/rpm" RAT_FUNC "%8.6" "cm^2/rpm" COEFFS 0 1 0 0 0 0.000000000625 /end COMPU_METHOD
/begin COMPU_METHOD COMP_0381_S "3.9063E-11cm^2/rpm" RAT_FUNC "%8.6" "cm^2/rpm" COEFFS 0 1 0 0 0 0.000000000039063 /end COMPU_METHOD
/begin COMPU_METHOD COMP_0382_S "6.25E-10cm**2/rp" RAT_FUNC "%8.6" "cm**2/rp" COEFFS 0 1 0 0 0 0.000000000625 /end COMPU_METHOD
/begin COMPU_METHOD COMP_0383_S "fixed axis mV" RAT_FUNC "%8.2" "mV" COEFFS 0 1 -13520 0 0 320 /end COMPU_METHOD
/begin COMPU_METHOD COMP_0384_S "fixed axis ℃" RAT_FUNC "%8.2" "℃" COEFFS 0 1 20 0 0 20 /end COMPU_METHOD
/begin COMPU_METHOD COMP_0385_S "fixed axis rpm" RAT_FUNC "%8.2" "rpm" COEFFS 0 1 -1200 0 0 800 /end COMPU_METHOD
/begin COMPU_METHOD COMP_0386_S "fixed axis V" RAT_FUNC "%8.2" "V" COEFFS 0 1 -2.08 0 0 0.64 /end COMPU_METHOD
/begin COMPU_METHOD COMP_0387_S "fixed axis ℃" RAT_FUNC "%8.2" "℃" COEFFS 0 1 40 0 0 40 /end COMPU_METHOD
/begin COMPU_METHOD COMP_0388_S "fixed axis ℃" RAT_FUNC "%8.2" "℃" COEFFS 0 1 0 0 0 20 /end COMPU_METHOD
/begin COMPU_METHOD COMP_0389_S "fixed axis deg" RAT_FUNC "%8.2" "deg" COEFFS 0 1 0 0 0 1.4 /end COMPU_METHOD
/begin COMPU_METHOD COMP_0390_S "25/262144－" RAT_FUNC "%8.6" "－" COEFFS 0 1 0 0 0 0.0000953674 /end COMPU_METHOD
/begin COMPU_METHOD COMP_0391_S "fixed axis V" RAT_FUNC "%8.3" "V" COEFFS 0 1 0 0 0 0.08 /end COMPU_METHOD
/begin COMPU_METHOD COMP_0392_S "1/4ｋPa" RAT_FUNC "%8.2" "ｋPa" COEFFS 0 1 0 0 0 0.25 /end COMPU_METHOD
/begin COMPU_METHOD COMP_0393_S "fixed axis CYL" RAT_FUNC "%8.2" "CYL" COEFFS 0 1 -1 0 0 1 /end COMPU_METHOD
/begin COMPU_METHOD COMP_0394_S "0.000016-" RAT_FUNC "%8.6" "-" COEFFS 0 1 0 0 0 0.000016 /end COMPU_METHOD
/begin COMPU_METHOD COMP_0395_S "0.00008s" RAT_FUNC "%8.6" "s" COEFFS 0 1 0 0 0 0.00008 /end COMPU_METHOD
/begin COMPU_METHOD COMP_0396_S "0.25kPa/s" RAT_FUNC "%8.2" "kPa/s" COEFFS 0 1 0 0 0 0.25 /end COMPU_METHOD
/begin COMPU_METHOD COMP_0397_S "fixed axis Nm" RAT_FUNC "%8.2" "Nm" COEFFS 0 1 -100 0 0 102.4 /end COMPU_METHOD
/begin COMPU_METHOD COMP_0398_S "1/81921/10ms" RAT_FUNC "%8.5" "1/10ms" COEFFS 0 1 0 0 0 0.00012207 /end COMPU_METHOD
/begin COMPU_METHOD COMP_0399_S "fixed axis deg" RAT_FUNC "%8.2" "deg" COEFFS 0 1 0 0 0 7.04 /end COMPU_METHOD
/begin COMPU_METHOD COMP_0400_S "1Nm/km_h" RAT_FUNC "%8.2" "Nm/km_h" COEFFS 0 1 0 0 0 1 /end COMPU_METHOD
/begin COMPU_METHOD COMP_0401_S "fixed axis ms" RAT_FUNC "%8.2" "ms" COEFFS 0 1 0 0 0 2 /end COMPU_METHOD
/begin COMPU_METHOD COMP_0402_S "8g/m^3" RAT_FUNC "%8.2" "g/m^3" COEFFS 0 1 0 0 0 8 /end COMPU_METHOD
/begin COMPU_METHOD COMP_0403_S "50-" RAT_FUNC "%8.2" "-" COEFFS 0 1 0 0 0 50 /end COMPU_METHOD
/begin COMPU_METHOD COMP_0404_S "fixed axis rpm" RAT_FUNC "%8.2" "rpm" COEFFS 0 1 -800 0 0 800 /end COMPU_METHOD
/begin COMPU_METHOD COMP_0405_S "0.02degC" RAT_FUNC "%8.3" "degC" COEFFS 0 1 0 0 0 0.02 /end COMPU_METHOD
/begin COMPU_METHOD COMP_0406_S "0.015625X+1-" RAT_FUNC "%8.3" "-" COEFFS 0 1 -1 0 0 0.015625 /end COMPU_METHOD
/begin COMPU_METHOD COMP_0407_S "0.25X+40kPa" RAT_FUNC "%8.2" "kPa" COEFFS 0 1 -40 0 0 0.25 /end COMPU_METHOD
/begin COMPU_METHOD COMP_0408_S "0.05%/sec" RAT_FUNC "%8.3" "%/sec" COEFFS 0 1 6.4 0 0 0.05 /end COMPU_METHOD
/begin COMPU_METHOD COMP_0409_S "fixed axis rpm" RAT_FUNC "%8.2" "rpm" COEFFS 0 1 -500 0 0 200 /end COMPU_METHOD
/begin COMPU_METHOD COMP_0410_S "1ms/2'(ST" RAT_FUNC "%8.2" "ms/2'(ST" COEFFS 0 1 0 0 0 1 /end COMPU_METHOD
/begin COMPU_METHOD COMP_0411_S "fixed axis deg" RAT_FUNC "%8.2" "deg" COEFFS 0 1 -10 0 0 10 /end COMPU_METHOD
/begin COMPU_METHOD COMP_0412_S "0.0625L/min/10" RAT_FUNC "%8.3" "L/min/10" COEFFS 0 1 0 0 0 0.0625 /end COMPU_METHOD
/begin COMPU_METHOD COMP_0303 "32/256X10^3g/m^3" RAT_FUNC "%8.2" "g/m^3" COEFFS 0 1 0 0 0 125 /end COMPU_METHOD
/begin COMPU_METHOD COMP_0413_S "fixed axis %" RAT_FUNC "%8.2" "%" COEFFS 0 1 0 0 0 25 /end COMPU_METHOD
/begin COMPU_METHOD COMP_0099 "1/16384/10ms" RAT_FUNC "%8.6" "/10ms" COEFFS 0 1 0 0 0 0.0000610352 /end COMPU_METHOD
/begin COMPU_METHOD COMP_0414_S "1.6μs" RAT_FUNC "%8.2" "μs" COEFFS 0 1 52428.8 0 0 1.6 /end COMPU_METHOD
/begin COMPU_METHOD COMP_0415_S "fixed axis MPa" RAT_FUNC "%8.2" "MPa" COEFFS 0 1 0 0 0 0.4 /end COMPU_METHOD
/begin COMPU_METHOD COMP_0416_S "3s" RAT_FUNC "%8.2" "s" COEFFS 0 1 0 0 0 3 /end COMPU_METHOD
/begin COMPU_METHOD COMP_0417_S "2rpm^(2/3" RAT_FUNC "%8.2" "rpm^(2/3" COEFFS 0 1 0 0 0 2 /end COMPU_METHOD
/begin COMPU_METHOD COMP_0418_S "fixed axis rpm" RAT_FUNC "%8.2" "rpm" COEFFS 0 1 0 0 0 1600 /end COMPU_METHOD
/begin COMPU_METHOD COMP_0419_S "0.4/2561/V^(2/3" RAT_FUNC "%8.4" "1/V^(2/3" COEFFS 0 1 0 0 0 0.0015625 /end COMPU_METHOD
/begin COMPU_METHOD COMP_0420_S "fixed axis mV" RAT_FUNC "%8.2" "mV" COEFFS 0 1 0 0 0 2560 /end COMPU_METHOD
/begin COMPU_METHOD COMP_0421_S "0.00001s" RAT_FUNC "%8.6" "s" COEFFS 0 1 0 0 0 0.00001 /end COMPU_METHOD
/begin COMPU_METHOD COMP_0311 "64us" RAT_FUNC "%8.2" "us" COEFFS 0 1 0 0 0 64 /end COMPU_METHOD
/begin COMPU_METHOD COMP_0422_S "fixed axis ｶｳﾝﾄ" RAT_FUNC "%8.2" "ｶｳﾝﾄ" COEFFS 0 1 -50 0 0 25 /end COMPU_METHOD
/begin COMPU_METHOD COMP_0423_S "fixed axis " RAT_FUNC "%8.2" "" COEFFS 0 1 -0.5 0 0 0.125 /end COMPU_METHOD
/begin COMPU_METHOD COMP_0424_S "fixed axis 1" RAT_FUNC "%8.2" "1" COEFFS 0 1 0 0 0 0.125 /end COMPU_METHOD
/begin COMPU_METHOD COMP_0425_S "0.1/256Nm/℃" RAT_FUNC "%8.5" "Nm/℃" COEFFS 0 1 0 0 0 0.000390625 /end COMPU_METHOD
/begin COMPU_METHOD COMP_0426_S "0.00976MPa/2ms" RAT_FUNC "%8.4" "MPa/2ms" COEFFS 0 1 0 0 0 0.00976 /end COMPU_METHOD
/begin COMPU_METHOD COMP_0427_S "1/200L/min/rp" RAT_FUNC "%8.4" "L/min/rp" COEFFS 0 1 163.84 0 0 0.005 /end COMPU_METHOD
/begin COMPU_METHOD COMP_0428_S "0.01%" RAT_FUNC "%8.3" "%" COEFFS 0 1 327.68 0 0 0.01 /end COMPU_METHOD
/begin COMPU_METHOD COMP_0429_S "1/50-" RAT_FUNC "%8.3" "-" COEFFS 0 1 0 0 0 0.02 /end COMPU_METHOD
/begin COMPU_METHOD COMP_0430_S "2.56mg" RAT_FUNC "%8.2" "mg" COEFFS 0 1 83886.08 0 0 2.56 /end COMPU_METHOD
/begin COMPU_METHOD COMP_0431_S "100/128/256%/10ms" RAT_FUNC "%8.4" "%/10ms" COEFFS 0 1 0 0 0 0.003051758 /end COMPU_METHOD
/begin COMPU_METHOD COMP_0323 "1.25X-200℃" RAT_FUNC "%8.2" "℃" COEFFS 0 1 200 0 0 1.25 /end COMPU_METHOD
/begin COMPU_METHOD COMP_0325 "1.6μS" RAT_FUNC "%8.2" "μS" COEFFS 0 1 52428.8 0 0 1.6 /end COMPU_METHOD
/begin COMPU_METHOD COMP_0432_S "fixed axis Mpa" RAT_FUNC "%8.2" "Mpa" COEFFS 0 1 0 0 0 2.498 /end COMPU_METHOD
/begin COMPU_METHOD COMP_0433_S "fixed axis deg" RAT_FUNC "%8.2" "deg" COEFFS 0 1 0 0 0 8 /end COMPU_METHOD
/begin COMPU_METHOD COMP_0434_S "fixed axis km/h" RAT_FUNC "%8.2" "km/h" COEFFS 0 1 0 0 0 16 /end COMPU_METHOD
/begin COMPU_METHOD COMP_0435_S "fixed axis ℃" RAT_FUNC "%8.2" "℃" COEFFS 0 1 -80 0 0 5 /end COMPU_METHOD
/begin COMPU_METHOD COMP_0436_S "fixed axis rpm" RAT_FUNC "%8.2" "rpm" COEFFS 0 1 -400 0 0 800 /end COMPU_METHOD
/begin COMPU_METHOD COMP_0437_S "fixed axis ms" RAT_FUNC "%8.2" "ms" COEFFS 0 1 -2 0 0 2 /end COMPU_METHOD
/begin COMPU_METHOD COMP_0438_S "1/256deg/MPa" RAT_FUNC "%8.4" "deg/MPa" COEFFS 0 1 0 0 0 0.00390625 /end COMPU_METHOD
/begin COMPU_METHOD COMP_0439_S "fixed axis Mpa" RAT_FUNC "%8.2" "Mpa" COEFFS 0 1 0 0 0 2.5 /end COMPU_METHOD
/begin COMPU_METHOD COMP_0440_S "0.625X-40degC" RAT_FUNC "%8.2" "degC" COEFFS 0 1 40 0 0 0.625 /end COMPU_METHOD
/begin COMPU_METHOD COMP_0441_S "fixed axis ℃" RAT_FUNC "%8.2" "℃" COEFFS 0 1 0 0 0 10 /end COMPU_METHOD
/begin COMPU_METHOD COMP_0442_S "2^-8degC" RAT_FUNC "%8.4" "degC" COEFFS 0 1 50 0 0 0.00390625 /end COMPU_METHOD
/begin COMPU_METHOD COMP_0443_S "500-" RAT_FUNC "%8.2" "-" COEFFS 0 1 0 0 0 500 /end COMPU_METHOD
/begin COMPU_METHOD COMP_0444_S "1Pa" RAT_FUNC "%8.2" "Pa" COEFFS 0 1 32768 0 0 1 /end COMPU_METHOD
/begin COMPU_METHOD COMP_0445_S "fixed axis kPa" RAT_FUNC "%8.2" "kPa" COEFFS 0 1 0 0 0 16 /end COMPU_METHOD
/begin COMPU_METHOD COMP_0446_S "2^-2kPa" RAT_FUNC "%8.2" "kPa" COEFFS 0 1 100 0 0 0.25 /end COMPU_METHOD
/begin COMPU_METHOD COMP_0383 "X/256-50℃" RAT_FUNC "%8.4" "℃" COEFFS 0 1 50 0 0 0.00390625 /end COMPU_METHOD
/begin COMPU_METHOD COMP_0034 "64/256%" RAT_FUNC "%8.2" "%" COEFFS 0 1 0 0 0 0.25 /end COMPU_METHOD
/begin COMPU_METHOD COMP_0447_S "0.25-" RAT_FUNC "%8.2" "-" COEFFS 0 1 0 0 0 0.25 /end COMPU_METHOD
/begin COMPU_METHOD COMP_0448_S "fixed axis rpm" RAT_FUNC "%8.2" "rpm" COEFFS 0 1 -500 0 0 100 /end COMPU_METHOD
/begin COMPU_METHOD COMP_0449_S "fixed axis km/h" RAT_FUNC "%8.2" "km/h" COEFFS 0 1 0 0 0 6.4 /end COMPU_METHOD
/begin COMPU_METHOD COMP_0450_S "1/32mm" RAT_FUNC "%8.3" "mm" COEFFS 0 1 1023.96875 0 0 0.03125 /end COMPU_METHOD
/begin COMPU_METHOD COMP_0451_S "fixed axis -" RAT_FUNC "%8.2" "-" COEFFS 0 1 -0.5 0 0 0.25 /end COMPU_METHOD
/begin COMPU_METHOD COMP_0452_S "0.01X-327.68%" RAT_FUNC "%8.3" "%" COEFFS 0 1 327.68 0 0 0.01 /end COMPU_METHOD
/begin COMPU_METHOD COMP_0453_S "1/64-" RAT_FUNC "%8.3" "-" COEFFS 0 1 2 0 0 0.015625 /end COMPU_METHOD
/begin COMPU_METHOD COMP_0454_S "fixed axis mV" RAT_FUNC "%8.2" "mV" COEFFS 0 1 -1400 0 0 400 /end COMPU_METHOD
/* RECORD_LAYOUT ------------------------------------------------------ */
/begin RECORD_LAYOUT REC_UBYTE_C FNC_VALUES 1 UBYTE COLUMN_DIR DIRECT /end RECORD_LAYOUT
/begin RECORD_LAYOUT REC_UWORD_C FNC_VALUES 1 UWORD COLUMN_DIR DIRECT /end RECORD_LAYOUT
/begin RECORD_LAYOUT REC_SBYTE_C FNC_VALUES 1 SBYTE COLUMN_DIR DIRECT /end RECORD_LAYOUT
/begin RECORD_LAYOUT REC_AXIS_UBYTE AXIS_PTS_X 1 UBYTE INDEX_INCR DIRECT /end RECORD_LAYOUT
/begin RECORD_LAYOUT REC_AXIS_UWORD AXIS_PTS_X 1 UWORD INDEX_INCR DIRECT /end RECORD_LAYOUT
/end MODULE
/end PROJECT
