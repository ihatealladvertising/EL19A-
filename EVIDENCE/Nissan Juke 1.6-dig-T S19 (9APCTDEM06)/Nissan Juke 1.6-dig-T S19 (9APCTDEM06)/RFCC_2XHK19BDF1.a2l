/begin PROJECT X12C_KH3DT_DI_NAM_R/C ""
/begin HEADER "" /* key HEADER ++ "comment" に Par.scomment */ PROJECT_NO X12C_KH3DT_DI_NAM_R/C /* key PROJECT_NO ++ project number に car_eng_desti_lot */ VERSION "0KHDCFDZ7" /* key VERSION ++ version number に mProgver */ /end HEADER
/begin MODULE DIM ""
/begin MOD_COMMON "" ALIGNMENT_BYTE 1 ALIGNMENT_WORD 2 ALIGNMENT_LONG 4 ALIGNMENT_FLOAT32_IEEE 4 ALIGNMENT_FLOAT64_IEEE 4 DEPOSIT ABSOLUTE BYTE_ORDER MSB_FIRST /* ﾊﾞｲﾄｵｰﾀﾞｰがﾘﾌﾟﾚｰｽされる */ /end MOD_COMMON
/begin MEASUREMENT avAFCLTMST "RAM value avAFCLTMST" UBYTE COMP_0068 1 100 0 255 ECU_ADDRESS 0xFFFF3A98 READ_WRITE /end MEASUREMENT
/begin MEASUREMENT avAFSAF "RAM value avAFSAF" UWORD COMP_0453 1 100 0 131.07 ECU_ADDRESS 0xFFFF3A9A READ_WRITE /end MEASUREMENT
/begin MEASUREMENT avALTDUTY "RAM value avALTDUTY" UBYTE COMP_0047 1 100 0 127.5 ECU_ADDRESS 0xFFFF3A9E READ_WRITE /end MEASUREMENT
/begin MEASUREMENT avANGTM "RAM value avANGTM" UBYTE COMP_0055 1 100 0 1020 ECU_ADDRESS 0xFFFF1A83 READ_WRITE /end MEASUREMENT
/begin MEASUREMENT avANGTMH "RAM value avANGTMH" UBYTE COMP_0190 1 100 0 510 ECU_ADDRESS 0xFFFF1A84 READ_WRITE /end MEASUREMENT
/begin MEASUREMENT avAPASCDAD "RAM value avAPASCDAD" UWORD COMP_0005 1 100 0 7208.85 ECU_ADDRESS 0xFFFF3AA0 READ_WRITE /end MEASUREMENT
/begin MEASUREMENT avATRET "RAM value avATRET" UWORD COMP_0081 1 100 0 255.99609375 ECU_ADDRESS 0xFFFF1A86 READ_WRITE /end MEASUREMENT
/begin MEASUREMENT avAVJPD "RAM value avAVJPD" UWORD COMP_0081 1 100 0 255.99609375 ECU_ADDRESS 0xFFFF1A88 READ_WRITE /end MEASUREMENT
/begin MEASUREMENT avBATTMPN "RAM value avBATTMPN" UBYTE COMP_0035 1 100 -50 205 ECU_ADDRESS 0xFFFF3AA2 READ_WRITE /end MEASUREMENT
/begin MEASUREMENT avBTRACE "RAM value avBTRACE" UBYTE COMP_0245 1 100 -64 191 ECU_ADDRESS 0xFFFF1A8A READ_WRITE /end MEASUREMENT
/begin MEASUREMENT avBTRORMBT "RAM value avBTRORMBT" SBYTE COMP_0018 1 100 -128 127 ECU_ADDRESS 0xFFFF1A8B READ_WRITE /end MEASUREMENT
/begin MEASUREMENT avCATCNT1 "RAM value avCATCNT1" UWORD COMP_0016 1 100 0 65535 ECU_ADDRESS 0xFFFF4F7E READ_WRITE /end MEASUREMENT
/begin MEASUREMENT avCATDAN "RAM value avCATDAN" UBYTE COMP_0017 1 100 0 255 ECU_ADDRESS 0xFFFF1A8C READ_WRITE /end MEASUREMENT
/begin MEASUREMENT avCATTRP "RAM value avCATTRP" UWORD COMP_0016 1 100 0 65535 ECU_ADDRESS 0xFFFF4F80 READ_WRITE /end MEASUREMENT
/begin MEASUREMENT avCCDISPFS "RAM value avCCDISPFS" UBYTE COMP_0068 1 100 0 255 ECU_ADDRESS 0xFFFF3AA3 READ_WRITE /end MEASUREMENT
/begin MEASUREMENT avCCHGADHR "RAM value avCCHGADHR" SWORD COMP_0204_S 1 100 -3276800 3276700 ECU_ADDRESS 0xFFFF3AA4 READ_WRITE /end MEASUREMENT
/begin MEASUREMENT avCLRTIME "RAM value avCLRTIME" UWORD COMP_0467_S 1 100 0 65535 ECU_ADDRESS 0xFFFF4F82 READ_WRITE /end MEASUREMENT
/begin MEASUREMENT avCNGOSC "RAM value avCNGOSC" UBYTE COMP_0068 1 100 0 255 ECU_ADDRESS 0xFFFF4F84 READ_WRITE /end MEASUREMENT
/begin MEASUREMENT avCNSMCNT "RAM value avCNSMCNT" UBYTE COMP_0068 1 100 0 255 ECU_ADDRESS 0xFFFF1A8D READ_WRITE /end MEASUREMENT
/begin MEASUREMENT avCONQA "RAM value avCONQA" SBYTE COMP_0468_S 1 100 -128 127 ECU_ADDRESS 0xFFFF4F86 READ_WRITE /end MEASUREMENT
/begin MEASUREMENT avCSMACCM "RAM value avCSMACCM" UBYTE COMP_0016 1 100 0 255 ECU_ADDRESS 0xFFFF4F87 READ_WRITE /end MEASUREMENT
/begin MEASUREMENT avCSMATM "RAM value avCSMATM" UBYTE COMP_0016 1 100 0 255 ECU_ADDRESS 0xFFFF4F88 READ_WRITE /end MEASUREMENT
/begin MEASUREMENT avCSMBCMM "RAM value avCSMBCMM" UBYTE COMP_0016 1 100 0 255 ECU_ADDRESS 0xFFFF4F89 READ_WRITE /end MEASUREMENT
/begin MEASUREMENT avCSMEPSM "RAM value avCSMEPSM" UBYTE COMP_0016 1 100 0 255 ECU_ADDRESS 0xFFFF4F8A READ_WRITE /end MEASUREMENT
/begin MEASUREMENT avCSMETSM "RAM value avCSMETSM" UBYTE COMP_0016 1 100 0 255 ECU_ADDRESS 0xFFFF4F8B READ_WRITE /end MEASUREMENT
/begin MEASUREMENT avCSMHVACM "RAM value avCSMHVACM" UBYTE COMP_0016 1 100 0 255 ECU_ADDRESS 0xFFFF4F8C READ_WRITE /end MEASUREMENT
/begin MEASUREMENT avCSMICONM "RAM value avCSMICONM" UBYTE COMP_0016 1 100 0 255 ECU_ADDRESS 0xFFFF4F8D READ_WRITE /end MEASUREMENT
/begin MEASUREMENT avCSMITMM "RAM value avCSMITMM" UBYTE COMP_0016 1 100 0 255 ECU_ADDRESS 0xFFFF4F8E READ_WRITE /end MEASUREMENT
/begin MEASUREMENT avCSMM4WDM "RAM value avCSMM4WDM" UBYTE COMP_0016 1 100 0 255 ECU_ADDRESS 0xFFFF4F8F READ_WRITE /end MEASUREMENT
/begin MEASUREMENT avCSMMETM "RAM value avCSMMETM" UBYTE COMP_0016 1 100 0 255 ECU_ADDRESS 0xFFFF4F90 READ_WRITE /end MEASUREMENT
/begin MEASUREMENT avCSMMUTEM "RAM value avCSMMUTEM" UBYTE COMP_0016 1 100 0 255 ECU_ADDRESS 0xFFFF4F91 READ_WRITE /end MEASUREMENT
/begin MEASUREMENT avCSMUSMM "RAM value avCSMUSMM" UBYTE COMP_0016 1 100 0 255 ECU_ADDRESS 0xFFFF4F92 READ_WRITE /end MEASUREMENT
/begin MEASUREMENT avCSMVDCM "RAM value avCSMVDCM" UBYTE COMP_0016 1 100 0 255 ECU_ADDRESS 0xFFFF4F93 READ_WRITE /end MEASUREMENT
/begin MEASUREMENT avCTI "RAM value avCTI" UWORD COMP_0231 1 100 0 655350 ECU_ADDRESS 0xFFFF1A8E READ_WRITE /end MEASUREMENT
/begin MEASUREMENT avCTIH "RAM value avCTIH" ULONG COMP_0320 1 100 0 6871947672 ECU_ADDRESS 0xFFFF1A98 READ_WRITE /end MEASUREMENT
/begin MEASUREMENT avCUMCONSY "RAM value avCUMCONSY" UWORD COMP_0469_S 1 100 0 20479.6875 ECU_ADDRESS 0xFFFF1AA0 READ_WRITE /end MEASUREMENT
/begin MEASUREMENT avCVTCDTYE "RAM value avCVTCDTYE" UBYTE COMP_0021 1 100 0 99.609375 ECU_ADDRESS 0xFFFF1AA2 READ_WRITE /end MEASUREMENT
/begin MEASUREMENT avDCTCNT1 "RAM value avDCTCNT1" UWORD COMP_0016 1 100 0 65535 ECU_ADDRESS 0xFFFF4F94 READ_WRITE /end MEASUREMENT
/begin MEASUREMENT avDCTCNT2 "RAM value avDCTCNT2" UWORD COMP_0016 1 100 0 65535 ECU_ADDRESS 0xFFFF4F96 READ_WRITE /end MEASUREMENT
/begin MEASUREMENT avDCTTRP "RAM value avDCTTRP" UWORD COMP_0016 1 100 0 65535 ECU_ADDRESS 0xFFFF4F98 READ_WRITE /end MEASUREMENT
/begin MEASUREMENT avDISADIAG "RAM value avDISADIAG" UBYTE COMP_0004 1 100 0 255 ECU_ADDRESS 0xFFFF3AA6 READ_WRITE /end MEASUREMENT
/begin MEASUREMENT avDLTADV "RAM value avDLTADV" SBYTE COMP_0018 1 100 -128 127 ECU_ADDRESS 0xFFFF1AA4 READ_WRITE /end MEASUREMENT
/begin MEASUREMENT avDRIVMSW "RAM value avDRIVMSW" UBYTE COMP_0068 1 100 0 255 ECU_ADDRESS 0xFFFF3AA7 READ_WRITE /end MEASUREMENT
/begin MEASUREMENT avDRPWTSP "RAM value avDRPWTSP" UWORD COMP_0032_S 1 100 0 8191.875 ECU_ADDRESS 0xFFFF3AA8 READ_WRITE /end MEASUREMENT
/begin MEASUREMENT avDSADV "RAM value avDSADV" UBYTE COMP_0017 1 100 0 255 ECU_ADDRESS 0xFFFF1AA5 READ_WRITE /end MEASUREMENT
/begin MEASUREMENT avDUMADDFD "RAM value avDUMADDFD" UWORD COMP_0064_S 1 100 0 65535 ECU_ADDRESS 0xFFFF1AA6 READ_WRITE /end MEASUREMENT
/begin MEASUREMENT avECOIND "RAM value avECOIND" UBYTE COMP_0068 1 100 0 255 ECU_ADDRESS 0xFFFF3AAA READ_WRITE /end MEASUREMENT
/begin MEASUREMENT avECOMLEV "RAM value avECOMLEV" UWORD COMP_0388 1 100 0 6553.5 ECU_ADDRESS 0xFFFF3AAC READ_WRITE /end MEASUREMENT
/begin MEASUREMENT avEGRACNT "RAM value avEGRACNT" UWORD COMP_0016 1 100 0 65535 ECU_ADDRESS 0xFFFF4F9A READ_WRITE /end MEASUREMENT
/begin MEASUREMENT avEGRATRP "RAM value avEGRATRP" UWORD COMP_0016 1 100 0 65535 ECU_ADDRESS 0xFFFF4F9C READ_WRITE /end MEASUREMENT
/begin MEASUREMENT avEGRBCNT "RAM value avEGRBCNT" UWORD COMP_0016 1 100 0 65535 ECU_ADDRESS 0xFFFF4F9E READ_WRITE /end MEASUREMENT
/begin MEASUREMENT avEGRBTRP "RAM value avEGRBTRP" UWORD COMP_0016 1 100 0 65535 ECU_ADDRESS 0xFFFF4FA0 READ_WRITE /end MEASUREMENT
/begin MEASUREMENT avEGRCCNT "RAM value avEGRCCNT" UWORD COMP_0016 1 100 0 65535 ECU_ADDRESS 0xFFFF4FA2 READ_WRITE /end MEASUREMENT
/begin MEASUREMENT avEGRCLRT "RAM value avEGRCLRT" UBYTE COMP_0018_S 1 100 0 0.498046875 ECU_ADDRESS 0xFFFF3AAE READ_WRITE /end MEASUREMENT
/begin MEASUREMENT avEGRTRP "RAM value avEGRTRP" UWORD COMP_0016 1 100 0 65535 ECU_ADDRESS 0xFFFF4FA4 READ_WRITE /end MEASUREMENT
/begin MEASUREMENT avEGSTPD "RAM value avEGSTPD" UWORD COMP_0140 1 100 0 32767.5 ECU_ADDRESS 0xFFFF3AB0 READ_WRITE /end MEASUREMENT
/begin MEASUREMENT avETLDIAG "RAM value avETLDIAG" UBYTE COMP_0004 1 100 0 255 ECU_ADDRESS 0xFFFF3AB2 READ_WRITE /end MEASUREMENT
/begin MEASUREMENT avETNL "RAM value avETNL" UBYTE COMP_0047 1 100 0 127.5 ECU_ADDRESS 0xFFFF4FA6 READ_WRITE /end MEASUREMENT
/begin MEASUREMENT avETRFUEL "RAM value avETRFUEL" UBYTE COMP_0016 1 100 0 255 ECU_ADDRESS 0xFFFF4FA7 READ_WRITE /end MEASUREMENT
/begin MEASUREMENT avEVPS "RAM value avEVPS" UBYTE COMP_0047 1 100 0 127.5 ECU_ADDRESS 0xFFFF3AB3 READ_WRITE /end MEASUREMENT
/begin MEASUREMENT avEVPSM "RAM value avEVPSM" UWORD COMP_0470_S 1 100 0 1638.375 ECU_ADDRESS 0xFFFF1AA8 READ_WRITE /end MEASUREMENT
/begin MEASUREMENT avFCADV "RAM value avFCADV" UWORD COMP_0081 1 100 0 255.99609375 ECU_ADDRESS 0xFFFF1AAA READ_WRITE /end MEASUREMENT
/begin MEASUREMENT avFCUTRCVf "RAM value avFCUTRCVf" UBYTE COMP_0004 1 100 0 255 ECU_ADDRESS 0xFFFF3AB4 READ_WRITE /end MEASUREMENT
/begin MEASUREMENT avFFADAFSF "RAM value avFFADAFSF" UWORD COMP_0471_S 1 100 0 7.99527 ECU_ADDRESS 0xFFFF4FA8 READ_WRITE /end MEASUREMENT
/begin MEASUREMENT avFFADVC "RAM value avFFADVC" UBYTE COMP_0472_S 1 100 -64 63.5 ECU_ADDRESS 0xFFFF4FAC READ_WRITE /end MEASUREMENT
/begin MEASUREMENT avFFAFSAF "RAM value avFFAFSAF" UWORD COMP_0327 1 100 0 1.9988175 ECU_ADDRESS 0xFFFF4FAE READ_WRITE /end MEASUREMENT
/begin MEASUREMENT avFFALP "RAM value avFFALP" UBYTE COMP_0117 1 100 -100 99.21875 ECU_ADDRESS 0xFFFF4FB2 READ_WRITE /end MEASUREMENT
/begin MEASUREMENT avFFALPC "RAM value avFFALPC" UBYTE COMP_0117 1 100 -100 99.21875 ECU_ADDRESS 0xFFFF4FB4 READ_WRITE /end MEASUREMENT
/begin MEASUREMENT avFFAPS1OF "RAM value avFFAPS1OF" UBYTE COMP_0378 1 100 0 100.000000065 ECU_ADDRESS 0xFFFF4FB6 READ_WRITE /end MEASUREMENT
/begin MEASUREMENT avFFAPS2OF "RAM value avFFAPS2OF" UBYTE COMP_0378 1 100 0 100.000000065 ECU_ADDRESS 0xFFFF4FB7 READ_WRITE /end MEASUREMENT
/begin MEASUREMENT avFFAVEPF "RAM value avFFAVEPF" UWORD COMP_0473_S 1 100 0 655350 ECU_ADDRESS 0xFFFF4FB8 READ_WRITE /end MEASUREMENT
/begin MEASUREMENT avFFBST "RAM value avFFBST" UBYTE COMP_0474_S 1 100 0 255 ECU_ADDRESS 0xFFFF4FBA READ_WRITE /end MEASUREMENT
/begin MEASUREMENT avFFCLRDST "RAM value avFFCLRDST" UWORD COMP_0470 1 100 0 65535 ECU_ADDRESS 0xFFFF4FBC READ_WRITE /end MEASUREMENT
/begin MEASUREMENT avFFCLTIME "RAM value avFFCLTIME" UWORD COMP_0467_S 1 100 0 65535 ECU_ADDRESS 0xFFFF4FBE READ_WRITE /end MEASUREMENT
/begin MEASUREMENT avFFCLV "RAM value avFFCLV" UBYTE COMP_0425 1 100 0 99.99999981 ECU_ADDRESS 0xFFFF4FC0 READ_WRITE /end MEASUREMENT
/begin MEASUREMENT avFFCODE "RAM value avFFCODE" UWORD COMP_0426 1 100 0 65535 ECU_ADDRESS 0xFFFF4FC2 READ_WRITE /end MEASUREMENT
/begin MEASUREMENT avFFDGN "RAM value avFFDGN" UBYTE COMP_0068 1 100 0 255 ECU_ADDRESS 0xFFFF4FC4 READ_WRITE /end MEASUREMENT
/begin MEASUREMENT avFFDGND "RAM value avFFDGND" UBYTE COMP_0068 1 100 0 255 ECU_ADDRESS 0xFFFF4FC5 READ_WRITE /end MEASUREMENT
/begin MEASUREMENT avFFEGR "RAM value avFFEGR" UBYTE COMP_0378 1 100 0 100.000000065 ECU_ADDRESS 0xFFFF4FC6 READ_WRITE /end MEASUREMENT
/begin MEASUREMENT avFFEGRER "RAM value avFFEGRER" UBYTE COMP_0117 1 100 -100 99.21875 ECU_ADDRESS 0xFFFF4FC7 READ_WRITE /end MEASUREMENT
/begin MEASUREMENT avFFEVPRES "RAM value avFFEVPRES" UWORD COMP_0475_S 1 100 0 16383.75 ECU_ADDRESS 0xFFFF4FC8 READ_WRITE /end MEASUREMENT
/begin MEASUREMENT avFFEVPS "RAM value avFFEVPS" UBYTE COMP_0378 1 100 0 100.000000065 ECU_ADDRESS 0xFFFF4FCA READ_WRITE /end MEASUREMENT
/begin MEASUREMENT avFFFLI "RAM value avFFFLI" UBYTE COMP_0378 1 100 0 100.000000065 ECU_ADDRESS 0xFFFF4FCB READ_WRITE /end MEASUREMENT
/begin MEASUREMENT avFFFSS "RAM value avFFFSS" UBYTE COMP_0091 1 100 0 255 ECU_ADDRESS 0xFFFF4FCC READ_WRITE /end MEASUREMENT
/begin MEASUREMENT avFFIMR "RAM value avFFIMR" UBYTE COMP_0068 1 100 0 255 ECU_ADDRESS 0xFFFF4FCE READ_WRITE /end MEASUREMENT
/begin MEASUREMENT avFFIMR2 "RAM value avFFIMR2" UBYTE COMP_0068 1 100 0 255 ECU_ADDRESS 0xFFFF4FCF READ_WRITE /end MEASUREMENT
/begin MEASUREMENT avFFIMRD "RAM value avFFIMRD" UBYTE COMP_0068 1 100 0 255 ECU_ADDRESS 0xFFFF4FD0 READ_WRITE /end MEASUREMENT
/begin MEASUREMENT avFFIMRD2 "RAM value avFFIMRD2" UBYTE COMP_0068 1 100 0 255 ECU_ADDRESS 0xFFFF4FD1 READ_WRITE /end MEASUREMENT
/begin MEASUREMENT avFFITAC "RAM value avFFITAC" UWORD COMP_0378 1 100 0 25700.000016705 ECU_ADDRESS 0xFFFF4FD2 READ_WRITE /end MEASUREMENT
/begin MEASUREMENT avFFKBL "RAM value avFFKBL" UBYTE COMP_0117 1 100 -100 99.21875 ECU_ADDRESS 0xFFFF4FD4 READ_WRITE /end MEASUREMENT
/begin MEASUREMENT avFFKBLC "RAM value avFFKBLC" UBYTE COMP_0117 1 100 -100 99.21875 ECU_ADDRESS 0xFFFF4FD6 READ_WRITE /end MEASUREMENT
/begin MEASUREMENT avFFMLTIME "RAM value avFFMLTIME" UWORD COMP_0467_S 1 100 0 65535 ECU_ADDRESS 0xFFFF4FD8 READ_WRITE /end MEASUREMENT
/begin MEASUREMENT avFFNGC "RAM value avFFNGC" UWORD COMP_0426 1 100 0 65535 ECU_ADDRESS 0xFFFF4FDA READ_WRITE /end MEASUREMENT
/begin MEASUREMENT avFFPPAMB "RAM value avFFPPAMB" UBYTE COMP_0474_S 1 100 0 255 ECU_ADDRESS 0xFFFF4FDC READ_WRITE /end MEASUREMENT
/begin MEASUREMENT avFFQM "RAM value avFFQM" UWORD COMP_0476_S 1 100 0 655.35 ECU_ADDRESS 0xFFFF4FDE READ_WRITE /end MEASUREMENT
/begin MEASUREMENT avFFRPM "RAM value avFFRPM" UWORD COMP_0427 1 100 0 16383.75 ECU_ADDRESS 0xFFFF4FE0 READ_WRITE /end MEASUREMENT
/begin MEASUREMENT avFFRUNTM "RAM value avFFRUNTM" UWORD COMP_0049 1 100 0 65535 ECU_ADDRESS 0xFFFF4FE2 READ_WRITE /end MEASUREMENT
/begin MEASUREMENT avFFSUMVSP "RAM value avFFSUMVSP" UWORD COMP_0470 1 100 0 65535 ECU_ADDRESS 0xFFFF4FE4 READ_WRITE /end MEASUREMENT
/begin MEASUREMENT avFFTAG "RAM value avFFTAG" UBYTE COMP_0428 1 100 -40 215 ECU_ADDRESS 0xFFFF4FE6 READ_WRITE /end MEASUREMENT
/begin MEASUREMENT avFFTAN "RAM value avFFTAN" UBYTE COMP_0035 1 100 -50 205 ECU_ADDRESS 0xFFFF4FE7 READ_WRITE /end MEASUREMENT
/begin MEASUREMENT avFFTANTHG "RAM value avFFTANTHG" UBYTE COMP_0428 1 100 -40 215 ECU_ADDRESS 0xFFFF4FE8 READ_WRITE /end MEASUREMENT
/begin MEASUREMENT avFFTFM "RAM value avFFTFM" UBYTE COMP_0068 1 100 0 255 ECU_ADDRESS 0xFFFF4FE9 READ_WRITE /end MEASUREMENT
/begin MEASUREMENT avFFTGABFE "RAM value avFFTGABFE" UWORD COMP_0327 1 100 0 1.9988175 ECU_ADDRESS 0xFFFF4FEA READ_WRITE /end MEASUREMENT
/begin MEASUREMENT avFFTGTVO "RAM value avFFTGTVO" UBYTE COMP_0378 1 100 0 100.000000065 ECU_ADDRESS 0xFFFF4FEC READ_WRITE /end MEASUREMENT
/begin MEASUREMENT avFFTMPCAT "RAM value avFFTMPCAT" UWORD COMP_0477_S 1 100 -40 6513.5 ECU_ADDRESS 0xFFFF4FEE READ_WRITE /end MEASUREMENT
/begin MEASUREMENT avFFTPFCAL "RAM value avFFTPFCAL" UWORD COMP_0473_S 1 100 0 655350 ECU_ADDRESS 0xFFFF4FF2 READ_WRITE /end MEASUREMENT
/begin MEASUREMENT avFFTPH "RAM value avFFTPH" UBYTE COMP_0001 1 100 0 31.875 ECU_ADDRESS 0xFFFF4FF4 READ_WRITE /end MEASUREMENT
/begin MEASUREMENT avFFTPS1OF "RAM value avFFTPS1OF" UBYTE COMP_0378 1 100 0 100.000000065 ECU_ADDRESS 0xFFFF4FF5 READ_WRITE /end MEASUREMENT
/begin MEASUREMENT avFFTPS2OF "RAM value avFFTPS2OF" UBYTE COMP_0378 1 100 0 100.000000065 ECU_ADDRESS 0xFFFF4FF6 READ_WRITE /end MEASUREMENT
/begin MEASUREMENT avFFTRC "RAM value avFFTRC" UBYTE COMP_0068 1 100 0 255 ECU_ADDRESS 0xFFFF4FF7 READ_WRITE /end MEASUREMENT
/begin MEASUREMENT avFFTVO "RAM value avFFTVO" UBYTE COMP_0002 1 100 0 89.25 ECU_ADDRESS 0xFFFF4FF8 READ_WRITE /end MEASUREMENT
/begin MEASUREMENT avFFTWN "RAM value avFFTWN" UBYTE COMP_0428 1 100 -40 215 ECU_ADDRESS 0xFFFF4FF9 READ_WRITE /end MEASUREMENT
/begin MEASUREMENT avFFVB "RAM value avFFVB" UWORD COMP_0478_S 1 100 0 65.535 ECU_ADDRESS 0xFFFF4FFA READ_WRITE /end MEASUREMENT
/begin MEASUREMENT avFFVO2 "RAM value avFFVO2" UBYTE COMP_0203_S 1 100 0 1.275 ECU_ADDRESS 0xFFFF4FFC READ_WRITE /end MEASUREMENT
/begin MEASUREMENT avFFVRO2 "RAM value avFFVRO2" UBYTE COMP_0203_S 1 100 0 1.275 ECU_ADDRESS 0xFFFF4FFE READ_WRITE /end MEASUREMENT
/begin MEASUREMENT avFFVRO2T "RAM value avFFVRO2T" UBYTE COMP_0203_S 1 100 0 1.275 ECU_ADDRESS 0xFFFF5000 READ_WRITE /end MEASUREMENT
/begin MEASUREMENT avFFVSP "RAM value avFFVSP" UBYTE COMP_0429 1 100 0 255 ECU_ADDRESS 0xFFFF5002 READ_WRITE /end MEASUREMENT
/begin MEASUREMENT avFFWARMUP "RAM value avFFWARMUP" UBYTE COMP_0016 1 100 0 255 ECU_ADDRESS 0xFFFF5003 READ_WRITE /end MEASUREMENT
/begin MEASUREMENT avFMILONW "RAM value avFMILONW" UBYTE COMP_0004 1 100 0 255 ECU_ADDRESS 0xFFFF5004 READ_WRITE /end MEASUREMENT
/begin MEASUREMENT avFO2HONf "RAM value avFO2HONf" UBYTE COMP_0004 1 100 0 255 ECU_ADDRESS 0xFFFF1AAC READ_WRITE /end MEASUREMENT
/begin MEASUREMENT avFPCMODE "RAM value avFPCMODE" UBYTE COMP_0068 1 100 0 255 ECU_ADDRESS 0xFFFF3AB7 READ_WRITE /end MEASUREMENT
/begin MEASUREMENT avFPONDTY "RAM value avFPONDTY" UBYTE COMP_0027 1 100 0 255 ECU_ADDRESS 0xFFFF3AB8 READ_WRITE /end MEASUREMENT
/begin MEASUREMENT avFSEST1_0 "RAM value avFSEST1_0" UBYTE COMP_0004 1 100 0 255 ECU_ADDRESS 0xFFFF5005 READ_WRITE /end MEASUREMENT
/begin MEASUREMENT avFSMODENO "RAM value avFSMODENO" UBYTE COMP_0068 1 100 0 255 ECU_ADDRESS 0xFFFF3ABB READ_WRITE /end MEASUREMENT
/begin MEASUREMENT avFSPFD "RAM value avFSPFD" UBYTE COMP_0426_S 1 100 0 2.4888 ECU_ADDRESS 0xFFFF3ABC READ_WRITE /end MEASUREMENT
/begin MEASUREMENT avFWT2IJZ1 "RAM value avFWT2IJZ1" UBYTE COMP_0068 1 100 0 255 ECU_ADDRESS 0xFFFF1AAD READ_WRITE /end MEASUREMENT
/begin MEASUREMENT avGAFDLR "RAM value avGAFDLR" UWORD COMP_0453 1 100 0 131.07 ECU_ADDRESS 0xFFFF5006 READ_WRITE /end MEASUREMENT
/begin MEASUREMENT avGAFDRL "RAM value avGAFDRL" UWORD COMP_0453 1 100 0 131.07 ECU_ADDRESS 0xFFFF5008 READ_WRITE /end MEASUREMENT
/begin MEASUREMENT avGAFSMN "RAM value avGAFSMN" UWORD COMP_0023 1 100 0 327675 ECU_ADDRESS 0xFFFF500A READ_WRITE /end MEASUREMENT
/begin MEASUREMENT avGAFSMX "RAM value avGAFSMX" UWORD COMP_0023 1 100 0 327675 ECU_ADDRESS 0xFFFF500C READ_WRITE /end MEASUREMENT
/begin MEASUREMENT avGAFSTD "RAM value avGAFSTD" UWORD COMP_0023 1 100 0 327675 ECU_ADDRESS 0xFFFF500E READ_WRITE /end MEASUREMENT
/begin MEASUREMENT avGAHOSL "RAM value avGAHOSL" SWORD COMP_0020_S 1 100 -65.536 65.534 ECU_ADDRESS 0xFFFF5010 READ_WRITE /end MEASUREMENT
/begin MEASUREMENT avGAHOSR "RAM value avGAHOSR" SWORD COMP_0020_S 1 100 -65.536 65.534 ECU_ADDRESS 0xFFFF5012 READ_WRITE /end MEASUREMENT
/begin MEASUREMENT avGAVGAFH "RAM value avGAVGAFH" UWORD COMP_0023 1 100 0 327675 ECU_ADDRESS 0xFFFF5014 READ_WRITE /end MEASUREMENT
/begin MEASUREMENT avGCRTCAT "RAM value avGCRTCAT" ULONG COMP_0074 1 100 0 16777215.9960938 ECU_ADDRESS 0xFFFF5018 READ_WRITE /end MEASUREMENT
/begin MEASUREMENT avGCRTEM "RAM value avGCRTEM" UWORD COMP_0016 1 100 0 65535 ECU_ADDRESS 0xFFFF501C READ_WRITE /end MEASUREMENT
/begin MEASUREMENT avGCRTFUK "RAM value avGCRTFUK" ULONG COMP_0074 1 100 0 16777215.9960938 ECU_ADDRESS 0xFFFF5020 READ_WRITE /end MEASUREMENT
/begin MEASUREMENT avGCRTIA "RAM value avGCRTIA" UWORD COMP_0016 1 100 0 65535 ECU_ADDRESS 0xFFFF5024 READ_WRITE /end MEASUREMENT
/begin MEASUREMENT avGCVN "RAM value avGCVN" UBYTE COMP_0068 1 100 0 255 ECU_ADDRESS 0xFFFF5026 READ_WRITE /end MEASUREMENT
/begin MEASUREMENT avGERROR "RAM value avGERROR" SBYTE COMP_0172_S 1 100 -64 63.5 ECU_ADDRESS 0xFFFF502A READ_WRITE /end MEASUREMENT
/begin MEASUREMENT avGERRORE "RAM value avGERRORE" SBYTE COMP_0172_S 1 100 -64 63.5 ECU_ADDRESS 0xFFFF502C READ_WRITE /end MEASUREMENT
/begin MEASUREMENT avGFAFS "RAM value avGFAFS" UWORD COMP_0023 1 100 0 327675 ECU_ADDRESS 0xFFFF502E READ_WRITE /end MEASUREMENT
/begin MEASUREMENT avGFAFSHM "RAM value avGFAFSHM" UWORD COMP_0023 1 100 0 327675 ECU_ADDRESS 0xFFFF5030 READ_WRITE /end MEASUREMENT
/begin MEASUREMENT avGFAFSLM "RAM value avGFAFSLM" UWORD COMP_0023 1 100 0 327675 ECU_ADDRESS 0xFFFF5032 READ_WRITE /end MEASUREMENT
/begin MEASUREMENT avGFCAT1 "RAM value avGFCAT1" UBYTE COMP_0068 1 100 0 255 ECU_ADDRESS 0xFFFF5034 READ_WRITE /end MEASUREMENT
/begin MEASUREMENT avGFCAT2 "RAM value avGFCAT2" UBYTE COMP_0062_S 1 100 0 255 ECU_ADDRESS 0xFFFF5036 READ_WRITE /end MEASUREMENT
/begin MEASUREMENT avGLEKAL3 "RAM value avGLEKAL3" UWORD COMP_0479_S 1 100 0 1.999970916 ECU_ADDRESS 0xFFFF5038 READ_WRITE /end MEASUREMENT
/begin MEASUREMENT avGLEKF3 "RAM value avGLEKF3" UWORD COMP_0479_S 1 100 0 1.999970916 ECU_ADDRESS 0xFFFF503A READ_WRITE /end MEASUREMENT
/begin MEASUREMENT avGMFAIA "RAM value avGMFAIA" UWORD COMP_0016 1 100 0 65535 ECU_ADDRESS 0xFFFF503C READ_WRITE /end MEASUREMENT
/begin MEASUREMENT avGMFCAT "RAM value avGMFCAT" UWORD COMP_0016 1 100 0 65535 ECU_ADDRESS 0xFFFF503E READ_WRITE /end MEASUREMENT
/begin MEASUREMENT avGMFCEM "RAM value avGMFCEM" UWORD COMP_0016 1 100 0 65535 ECU_ADDRESS 0xFFFF5048 READ_WRITE /end MEASUREMENT
/begin MEASUREMENT avGNGMS "RAM value avGNGMS" UBYTE COMP_0062_S 1 100 0 255 ECU_ADDRESS 0xFFFF5052 READ_WRITE /end MEASUREMENT
/begin MEASUREMENT avGNRTRP "RAM value avGNRTRP" UWORD COMP_0016 1 100 0 65535 ECU_ADDRESS 0xFFFF5054 READ_WRITE /end MEASUREMENT
/begin MEASUREMENT avGNSETST2 "RAM value avGNSETST2" UBYTE COMP_0021 1 100 0 99.609375 ECU_ADDRESS 0xFFFF1AAE READ_WRITE /end MEASUREMENT
/begin MEASUREMENT avGOERROR "RAM value avGOERROR" SBYTE COMP_0172_S 1 100 -64 63.5 ECU_ADDRESS 0xFFFF5056 READ_WRITE /end MEASUREMENT
/begin MEASUREMENT avGOERRORE "RAM value avGOERRORE" SBYTE COMP_0172_S 1 100 -64 63.5 ECU_ADDRESS 0xFFFF5058 READ_WRITE /end MEASUREMENT
/begin MEASUREMENT avGOFAGEN "RAM value avGOFAGEN" SBYTE COMP_0172_S 1 100 -64 63.5 ECU_ADDRESS 0xFFFF505A READ_WRITE /end MEASUREMENT
/begin MEASUREMENT avGOFAGEX "RAM value avGOFAGEX" SBYTE COMP_0172_S 1 100 -64 63.5 ECU_ADDRESS 0xFFFF505C READ_WRITE /end MEASUREMENT
/begin MEASUREMENT avGOFAGIN "RAM value avGOFAGIN" SBYTE COMP_0172_S 1 100 -64 63.5 ECU_ADDRESS 0xFFFF505E READ_WRITE /end MEASUREMENT
/begin MEASUREMENT avGOFAGIX "RAM value avGOFAGIX" SBYTE COMP_0172_S 1 100 -64 63.5 ECU_ADDRESS 0xFFFF5060 READ_WRITE /end MEASUREMENT
/begin MEASUREMENT avGOFAGVEN "RAM value avGOFAGVEN" SBYTE COMP_0172_S 1 100 -64 63.5 ECU_ADDRESS 0xFFFF5062 READ_WRITE /end MEASUREMENT
/begin MEASUREMENT avGOFAGVEX "RAM value avGOFAGVEX" SBYTE COMP_0172_S 1 100 -64 63.5 ECU_ADDRESS 0xFFFF5064 READ_WRITE /end MEASUREMENT
/begin MEASUREMENT avGOFAGVIN "RAM value avGOFAGVIN" SBYTE COMP_0172_S 1 100 -64 63.5 ECU_ADDRESS 0xFFFF5066 READ_WRITE /end MEASUREMENT
/begin MEASUREMENT avGOFAGVIX "RAM value avGOFAGVIX" SBYTE COMP_0172_S 1 100 -64 63.5 ECU_ADDRESS 0xFFFF5068 READ_WRITE /end MEASUREMENT
/begin MEASUREMENT avGOVIDL "RAM value avGOVIDL" SBYTE COMP_0018 1 100 -128 127 ECU_ADDRESS 0xFFFF1AAF READ_WRITE /end MEASUREMENT
/begin MEASUREMENT avGPSEV2 "RAM value avGPSEV2" UWORD COMP_0104 1 100 0 655350 ECU_ADDRESS 0xFFFF506A READ_WRITE /end MEASUREMENT
/begin MEASUREMENT avGPSYSP2 "RAM value avGPSYSP2" UWORD COMP_0104 1 100 0 655350 ECU_ADDRESS 0xFFFF506C READ_WRITE /end MEASUREMENT
/begin MEASUREMENT avGRO2 "RAM value avGRO2" UBYTE COMP_0104 1 100 0 2550 ECU_ADDRESS 0xFFFF506E READ_WRITE /end MEASUREMENT
/begin MEASUREMENT avGRO2D "RAM value avGRO2D" UBYTE COMP_0295 1 100 0 25500 ECU_ADDRESS 0xFFFF506F READ_WRITE /end MEASUREMENT
/begin MEASUREMENT avGRO2N "RAM value avGRO2N" UBYTE COMP_0104 1 100 0 2550 ECU_ADDRESS 0xFFFF5070 READ_WRITE /end MEASUREMENT
/begin MEASUREMENT avGRO2R "RAM value avGRO2R" UBYTE COMP_0104 1 100 0 2550 ECU_ADDRESS 0xFFFF5071 READ_WRITE /end MEASUREMENT
/begin MEASUREMENT avGRO2X "RAM value avGRO2X" UBYTE COMP_0104 1 100 0 2550 ECU_ADDRESS 0xFFFF5072 READ_WRITE /end MEASUREMENT
/begin MEASUREMENT avGSINXTGP "RAM value avGSINXTGP" UBYTE COMP_0068 1 100 0 255 ECU_ADDRESS 0xFFFF3ABD READ_WRITE /end MEASUREMENT
/begin MEASUREMENT avGSTDBC "RAM value avGSTDBC" UBYTE COMP_0480_S 1 100 0 255 ECU_ADDRESS 0xFFFF3ABE READ_WRITE /end MEASUREMENT
/begin MEASUREMENT avGSTDVP4 "RAM value avGSTDVP4" UWORD COMP_0050 1 100 0 5119.921875 ECU_ADDRESS 0xFFFF5074 READ_WRITE /end MEASUREMENT
/begin MEASUREMENT avGSTIMR "RAM value avGSTIMR" UBYTE COMP_0068 1 100 0 255 ECU_ADDRESS 0xFFFF5076 READ_WRITE /end MEASUREMENT
/begin MEASUREMENT avGSTIMRT "RAM value avGSTIMRT" UBYTE COMP_0068 1 100 0 255 ECU_ADDRESS 0xFFFF5078 READ_WRITE /end MEASUREMENT
/begin MEASUREMENT avGSTIMRT2 "RAM value avGSTIMRT2" UBYTE COMP_0068 1 100 0 255 ECU_ADDRESS 0xFFFF507A READ_WRITE /end MEASUREMENT
/begin MEASUREMENT avGSTPMT2 "RAM value avGSTPMT2" UBYTE COMP_0068 1 100 0 255 ECU_ADDRESS 0xFFFF3ABF READ_WRITE /end MEASUREMENT
/begin MEASUREMENT avHOSTR "RAM value avHOSTR" UBYTE COMP_0245 1 100 -64 191 ECU_ADDRESS 0xFFFF1AB0 READ_WRITE /end MEASUREMENT
/begin MEASUREMENT avHTARTD "RAM value avHTARTD" UBYTE COMP_0017 1 100 0 255 ECU_ADDRESS 0xFFFF1AB1 READ_WRITE /end MEASUREMENT
/begin MEASUREMENT avINJOFH "RAM value avINJOFH" UBYTE COMP_0068 1 100 0 255 ECU_ADDRESS 0xFFFF1AB2 READ_WRITE /end MEASUREMENT
/begin MEASUREMENT avINJOFS "RAM value avINJOFS" UBYTE COMP_0068 1 100 0 255 ECU_ADDRESS 0xFFFF1AB3 READ_WRITE /end MEASUREMENT
/begin MEASUREMENT avITDAMP "RAM value avITDAMP" UWORD COMP_0456 1 100 0 1.999970916 ECU_ADDRESS 0xFFFF3AC0 READ_WRITE /end MEASUREMENT
/begin MEASUREMENT avIVSPCOMN "RAM value avIVSPCOMN" SLONG COMP_0481_S 1 100 -1842.540969984 1842.540969126 ECU_ADDRESS 0xFFFF3AC4 READ_WRITE /end MEASUREMENT
/begin MEASUREMENT avKNKFB "RAM value avKNKFB" SWORD COMP_0078 1 100 -128 127.99609375 ECU_ADDRESS 0xFFFF3AC8 READ_WRITE /end MEASUREMENT
/begin MEASUREMENT avLEAKCNT "RAM value avLEAKCNT" UWORD COMP_0016 1 100 0 65535 ECU_ADDRESS 0xFFFF507C READ_WRITE /end MEASUREMENT
/begin MEASUREMENT avLEAKTRP "RAM value avLEAKTRP" UWORD COMP_0016 1 100 0 65535 ECU_ADDRESS 0xFFFF507E READ_WRITE /end MEASUREMENT
/begin MEASUREMENT avMBT "RAM value avMBT" SBYTE COMP_0018 1 100 -128 127 ECU_ADDRESS 0xFFFF1AB4 READ_WRITE /end MEASUREMENT
/begin MEASUREMENT avMBTCAL "RAM value avMBTCAL" SBYTE COMP_0018 1 100 -128 127 ECU_ADDRESS 0xFFFF1AB5 READ_WRITE /end MEASUREMENT
/begin MEASUREMENT avMFACC "RAM value avMFACC" UWORD COMP_0016 1 100 0 65535 ECU_ADDRESS 0xFFFF5080 READ_WRITE /end MEASUREMENT
/begin MEASUREMENT avMFCAV "RAM value avMFCAV" UWORD COMP_0016 1 100 0 65535 ECU_ADDRESS 0xFFFF508A READ_WRITE /end MEASUREMENT
/begin MEASUREMENT avMFDTY "RAM value avMFDTY" UBYTE COMP_0027 1 100 0 255 ECU_ADDRESS 0xFFFF3ACA READ_WRITE /end MEASUREMENT
/begin MEASUREMENT avMILTIME "RAM value avMILTIME" UWORD COMP_0467_S 1 100 0 65535 ECU_ADDRESS 0xFFFF5094 READ_WRITE /end MEASUREMENT
/begin MEASUREMENT avMISBHOS "RAM value avMISBHOS" UBYTE COMP_0373 1 100 0 2.55 ECU_ADDRESS 0xFFFF3ACB READ_WRITE /end MEASUREMENT
/begin MEASUREMENT avNSET4 "RAM value avNSET4" UBYTE COMP_0006 1 100 0 3187.5 ECU_ADDRESS 0xFFFF5096 READ_WRITE /end MEASUREMENT
/begin MEASUREMENT avOPDADV "RAM value avOPDADV" SBYTE COMP_0018 1 100 -128 127 ECU_ADDRESS 0xFFFF3ACC READ_WRITE /end MEASUREMENT
/begin MEASUREMENT avOPSM "RAM value avOPSM" UBYTE COMP_0482_S 1 100 -0.098 0.882985 ECU_ADDRESS 0xFFFF3ACD READ_WRITE /end MEASUREMENT
/begin MEASUREMENT avPARGEQA "RAM value avPARGEQA" UWORD COMP_0068 1 100 0 65535 ECU_ADDRESS 0xFFFF3ACE READ_WRITE /end MEASUREMENT
/begin MEASUREMENT avPDTCST "RAM value avPDTCST" UBYTE COMP_0068 1 100 0 255 ECU_ADDRESS 0xFFFF5097 READ_WRITE /end MEASUREMENT
/begin MEASUREMENT avPENDPR9 "RAM value avPENDPR9" UBYTE COMP_0068 1 100 0 255 ECU_ADDRESS 0xFFFF3AD0 READ_WRITE /end MEASUREMENT
/begin MEASUREMENT avPIADV "RAM value avPIADV" UBYTE COMP_0009 1 100 0 199.21875 ECU_ADDRESS 0xFFFF1AB6 READ_WRITE /end MEASUREMENT
/begin MEASUREMENT avPIISCMR "RAM value avPIISCMR" UBYTE COMP_0009 1 100 0 199.21875 ECU_ADDRESS 0xFFFF1AB7 READ_WRITE /end MEASUREMENT
/begin MEASUREMENT avPILOCK "RAM value avPILOCK" UBYTE COMP_0009 1 100 0 199.21875 ECU_ADDRESS 0xFFFF1AB8 READ_WRITE /end MEASUREMENT
/begin MEASUREMENT avPPAMB "RAM value avPPAMB" UWORD COMP_0215_S 1 100 0 127.99837455 ECU_ADDRESS 0xFFFF50A0 READ_WRITE /end MEASUREMENT
/begin MEASUREMENT avPUMDTY "RAM value avPUMDTY" UWORD COMP_0483_S 1 100 0 199.9970916 ECU_ADDRESS 0xFFFF1ABA READ_WRITE /end MEASUREMENT
/begin MEASUREMENT avQAACV "RAM value avQAACV" UWORD COMP_0051 1 100 0 65535 ECU_ADDRESS 0xFFFF1A68 READ_WRITE /end MEASUREMENT
/begin MEASUREMENT avQAPHYS "RAM value avQAPHYS" UWORD COMP_0051 1 100 0 65535 ECU_ADDRESS 0xFFFF1ABC READ_WRITE /end MEASUREMENT
/begin MEASUREMENT avQEGRVA "RAM value avQEGRVA" UWORD COMP_0092_S 1 100 0 1638.375 ECU_ADDRESS 0xFFFF3AD2 READ_WRITE /end MEASUREMENT
/begin MEASUREMENT avQEGRVE "RAM value avQEGRVE" UWORD COMP_0092_S 1 100 0 1638.375 ECU_ADDRESS 0xFFFF3AD4 READ_WRITE /end MEASUREMENT
/begin MEASUREMENT avQSISAV "RAM value avQSISAV" SWORD COMP_0277 1 100 -32768 32767 ECU_ADDRESS 0xFFFF1ABE READ_WRITE /end MEASUREMENT
/begin MEASUREMENT avQSISC "RAM value avQSISC" UWORD COMP_0051 1 100 0 65535 ECU_ADDRESS 0xFFFF1AC0 READ_WRITE /end MEASUREMENT
/begin MEASUREMENT avQTASEEP1 "RAM value avQTASEEP1" SWORD COMP_0277 1 100 -32768 32767 ECU_ADDRESS 0xFFFF50A2 READ_WRITE /end MEASUREMENT
/begin MEASUREMENT avRATECNT1 "RAM value avRATECNT1" UWORD COMP_0016 1 100 0 65535 ECU_ADDRESS 0xFFFF50A4 READ_WRITE /end MEASUREMENT
/begin MEASUREMENT avRATECNT2 "RAM value avRATECNT2" UWORD COMP_0016 1 100 0 65535 ECU_ADDRESS 0xFFFF50A6 READ_WRITE /end MEASUREMENT
/begin MEASUREMENT avRATIO "RAM value avRATIO" UWORD COMP_0450 1 100 0 63.999056205 ECU_ADDRESS 0xFFFF1A6A READ_WRITE /end MEASUREMENT
/begin MEASUREMENT avRESCNT1 "RAM value avRESCNT1" UWORD COMP_0016 1 100 0 65535 ECU_ADDRESS 0xFFFF50A8 READ_WRITE /end MEASUREMENT
/begin MEASUREMENT avRESCNT2 "RAM value avRESCNT2" UWORD COMP_0016 1 100 0 65535 ECU_ADDRESS 0xFFFF50AA READ_WRITE /end MEASUREMENT
/begin MEASUREMENT avRESTRP "RAM value avRESTRP" UWORD COMP_0016 1 100 0 65535 ECU_ADDRESS 0xFFFF50AC READ_WRITE /end MEASUREMENT
/begin MEASUREMENT avRESTRP2 "RAM value avRESTRP2" UWORD COMP_0016 1 100 0 65535 ECU_ADDRESS 0xFFFF50AE READ_WRITE /end MEASUREMENT
/begin MEASUREMENT avRFNOUT "RAM value avRFNOUT" UBYTE COMP_0004 1 100 0 255 ECU_ADDRESS 0xFFFF3AD6 READ_WRITE /end MEASUREMENT
/begin MEASUREMENT avRLTENG2 "RAM value avRLTENG2" SWORD COMP_0228 1 100 -3276.8 3276.7 ECU_ADDRESS 0xFFFF1AC2 READ_WRITE /end MEASUREMENT
/begin MEASUREMENT avRLVAPO "RAM value avRLVAPO" UWORD COMP_0005 1 100 0 7208.85 ECU_ADDRESS 0xFFFF3AD8 READ_WRITE /end MEASUREMENT
/begin MEASUREMENT avRO2DCNT1 "RAM value avRO2DCNT1" UWORD COMP_0016 1 100 0 65535 ECU_ADDRESS 0xFFFF50B0 READ_WRITE /end MEASUREMENT
/begin MEASUREMENT avRO2DTRP1 "RAM value avRO2DTRP1" UWORD COMP_0016 1 100 0 65535 ECU_ADDRESS 0xFFFF50B2 READ_WRITE /end MEASUREMENT
/begin MEASUREMENT avRO2DTRP2 "RAM value avRO2DTRP2" UWORD COMP_0016 1 100 0 65535 ECU_ADDRESS 0xFFFF50B4 READ_WRITE /end MEASUREMENT
/begin MEASUREMENT avRO2HONf "RAM value avRO2HONf" UBYTE COMP_0004 1 100 0 255 ECU_ADDRESS 0xFFFF3ADA READ_WRITE /end MEASUREMENT
/begin MEASUREMENT avRO2HPREN "RAM value avRO2HPREN" UBYTE COMP_0004 1 100 0 255 ECU_ADDRESS 0xFFFF3ADB READ_WRITE /end MEASUREMENT
/begin MEASUREMENT avRODRCNT1 "RAM value avRODRCNT1" UWORD COMP_0016 1 100 0 65535 ECU_ADDRESS 0xFFFF50B6 READ_WRITE /end MEASUREMENT
/begin MEASUREMENT avRODRCNT2 "RAM value avRODRCNT2" UWORD COMP_0016 1 100 0 65535 ECU_ADDRESS 0xFFFF50B8 READ_WRITE /end MEASUREMENT
/begin MEASUREMENT avRODRTRP1 "RAM value avRODRTRP1" UWORD COMP_0016 1 100 0 65535 ECU_ADDRESS 0xFFFF50BA READ_WRITE /end MEASUREMENT
/begin MEASUREMENT avRODRTRP2 "RAM value avRODRTRP2" UWORD COMP_0016 1 100 0 65535 ECU_ADDRESS 0xFFFF50BC READ_WRITE /end MEASUREMENT
/begin MEASUREMENT avRTCLV "RAM value avRTCLV" UBYTE COMP_0425 1 100 0 99.99999981 ECU_ADDRESS 0xFFFF3ADC READ_WRITE /end MEASUREMENT
/begin MEASUREMENT avRTFSS "RAM value avRTFSS" UBYTE COMP_0091 1 100 0 255 ECU_ADDRESS 0xFFFF3ADD READ_WRITE /end MEASUREMENT
/begin MEASUREMENT avRUNTM "RAM value avRUNTM" UWORD COMP_0013 1 100 0 65535 ECU_ADDRESS 0xFFFF3AE0 READ_WRITE /end MEASUREMENT
/begin MEASUREMENT avSCKRET "RAM value avSCKRET" UBYTE COMP_0017 1 100 0 255 ECU_ADDRESS 0xFFFF3AE2 READ_WRITE /end MEASUREMENT
/begin MEASUREMENT avSFTREQHT "RAM value avSFTREQHT" UBYTE COMP_0068 1 100 0 255 ECU_ADDRESS 0xFFFF1AC4 READ_WRITE /end MEASUREMENT
/begin MEASUREMENT avSLHIGRIH "RAM value avSLHIGRIH" UBYTE COMP_0068 1 100 0 255 ECU_ADDRESS 0xFFFF3AE3 READ_WRITE /end MEASUREMENT
/begin MEASUREMENT avSLPWTSP "RAM value avSLPWTSP" UWORD COMP_0032_S 1 100 0 8191.875 ECU_ADDRESS 0xFFFF3AE4 READ_WRITE /end MEASUREMENT
/begin MEASUREMENT avSRTEND "RAM value avSRTEND" UBYTE COMP_0004 1 100 0 255 ECU_ADDRESS 0xFFFF3AE6 READ_WRITE /end MEASUREMENT
/begin MEASUREMENT avSRTRSL "RAM value avSRTRSL" UBYTE COMP_0004 1 100 0 255 ECU_ADDRESS 0xFFFF3AEC READ_WRITE /end MEASUREMENT
/begin MEASUREMENT avSRTTST "RAM value avSRTTST" UBYTE COMP_0004 1 100 0 255 ECU_ADDRESS 0xFFFF3AF2 READ_WRITE /end MEASUREMENT
/begin MEASUREMENT avSSTMD "RAM value avSSTMD" UBYTE COMP_0068 1 100 0 255 ECU_ADDRESS 0xFFFF1A6C READ_WRITE /end MEASUREMENT
/begin MEASUREMENT avSTTCNT "RAM value avSTTCNT" UWORD COMP_0016 1 100 0 65535 ECU_ADDRESS 0xFFFF50BE READ_WRITE /end MEASUREMENT
/begin MEASUREMENT avT1STPDTC "RAM value avT1STPDTC" UWORD COMP_0068 1 100 0 65535 ECU_ADDRESS 0xFFFF50C0 READ_WRITE /end MEASUREMENT
/begin MEASUREMENT avT2NDPDTC "RAM value avT2NDPDTC" UWORD COMP_0068 1 100 0 65535 ECU_ADDRESS 0xFFFF50C2 READ_WRITE /end MEASUREMENT
/begin MEASUREMENT avT3RDPDTC "RAM value avT3RDPDTC" UWORD COMP_0068 1 100 0 65535 ECU_ADDRESS 0xFFFF50C4 READ_WRITE /end MEASUREMENT
/begin MEASUREMENT avT4THPDTC "RAM value avT4THPDTC" UWORD COMP_0068 1 100 0 65535 ECU_ADDRESS 0xFFFF50C6 READ_WRITE /end MEASUREMENT
/begin MEASUREMENT avT5THPDTC "RAM value avT5THPDTC" UWORD COMP_0068 1 100 0 65535 ECU_ADDRESS 0xFFFF50C8 READ_WRITE /end MEASUREMENT
/begin MEASUREMENT avT6THPDTC "RAM value avT6THPDTC" UWORD COMP_0068 1 100 0 65535 ECU_ADDRESS 0xFFFF50CA READ_WRITE /end MEASUREMENT
/begin MEASUREMENT avT7THPDTC "RAM value avT7THPDTC" UWORD COMP_0068 1 100 0 65535 ECU_ADDRESS 0xFFFF50CC READ_WRITE /end MEASUREMENT
/begin MEASUREMENT avT8THPDTC "RAM value avT8THPDTC" UWORD COMP_0068 1 100 0 65535 ECU_ADDRESS 0xFFFF50CE READ_WRITE /end MEASUREMENT
/begin MEASUREMENT avTAAIR "RAM value avTAAIR" UWORD COMP_0041 1 100 0 52.428 ECU_ADDRESS 0xFFFF1AC6 READ_WRITE /end MEASUREMENT
/begin MEASUREMENT avTADVM "RAM value avTADVM" SBYTE COMP_0018 1 100 -128 127 ECU_ADDRESS 0xFFFF1AC8 READ_WRITE /end MEASUREMENT
/begin MEASUREMENT avTADVMTQ "RAM value avTADVMTQ" SBYTE COMP_0018 1 100 -128 127 ECU_ADDRESS 0xFFFF1ACA READ_WRITE /end MEASUREMENT
/begin MEASUREMENT avTADVMst "RAM value avTADVMst" SBYTE COMP_0018 1 100 -128 127 ECU_ADDRESS 0xFFFF1AC9 READ_WRITE /end MEASUREMENT
/begin MEASUREMENT avTDWLL "RAM value avTDWLL" UBYTE COMP_0017 1 100 0 255 ECU_ADDRESS 0xFFFF1ACB READ_WRITE /end MEASUREMENT
/begin MEASUREMENT avTECOM "RAM value avTECOM" SWORD COMP_0228 1 100 -3276.8 3276.7 ECU_ADDRESS 0xFFFF3AF8 READ_WRITE /end MEASUREMENT
/begin MEASUREMENT avTEFRIC "RAM value avTEFRIC" UWORD COMP_0196 1 100 0 6553.5 ECU_ADDRESS 0xFFFF1ACC READ_WRITE /end MEASUREMENT
/begin MEASUREMENT avTEMHOS "RAM value avTEMHOS" UWORD COMP_0217 1 100 0 3.999941832 ECU_ADDRESS 0xFFFF1ACE READ_WRITE /end MEASUREMENT
/begin MEASUREMENT avTENG "RAM value avTENG" SWORD COMP_0228 1 100 -3276.8 3276.7 ECU_ADDRESS 0xFFFF1AD0 READ_WRITE /end MEASUREMENT
/begin MEASUREMENT avTENG2 "RAM value avTENG2" SWORD COMP_0228 1 100 -3276.8 3276.7 ECU_ADDRESS 0xFFFF1AD2 READ_WRITE /end MEASUREMENT
/begin MEASUREMENT avTGABFE "RAM value avTGABFE" UWORD COMP_0453 1 100 0 131.07 ECU_ADDRESS 0xFFFF3AFA READ_WRITE /end MEASUREMENT
/begin MEASUREMENT avTGTVO "RAM value avTGTVO" UWORD COMP_0130 1 100 0 1802.2125 ECU_ADDRESS 0xFFFF3A80 READ_WRITE /end MEASUREMENT
/begin MEASUREMENT avTHOKI "RAM value avTHOKI" UWORD COMP_0196 1 100 0 6553.5 ECU_ADDRESS 0xFFFF1AD4 READ_WRITE /end MEASUREMENT
/begin MEASUREMENT avTHOKIS "RAM value avTHOKIS" SWORD COMP_0228 1 100 -3276.8 3276.7 ECU_ADDRESS 0xFFFF1AD6 READ_WRITE /end MEASUREMENT
/begin MEASUREMENT avTISTd "RAM value avTISTd" ULONG COMP_0320 1 100 0 6871947672 ECU_ADDRESS 0xFFFF1AD8 READ_WRITE /end MEASUREMENT
/begin MEASUREMENT avTISTdS "RAM value avTISTdS" ULONG COMP_0320 1 100 0 6871947672 ECU_ADDRESS 0xFFFF1ADC READ_WRITE /end MEASUREMENT
/begin MEASUREMENT avTMPCAT "RAM value avTMPCAT" UBYTE COMP_0062 1 100 0 1020 ECU_ADDRESS 0xFFFF3AFE READ_WRITE /end MEASUREMENT
/begin MEASUREMENT avTPFCAL "RAM value avTPFCAL" UWORD COMP_0164 1 100 0 19.988175 ECU_ADDRESS 0xFFFF1AE0 READ_WRITE /end MEASUREMENT
/begin MEASUREMENT avTPFUELN "RAM value avTPFUELN" UBYTE COMP_0087_S 1 100 0 19.9104 ECU_ADDRESS 0xFFFF1A6D READ_WRITE /end MEASUREMENT
/begin MEASUREMENT avTPSKAPR "RAM value avTPSKAPR" UBYTE COMP_0068 1 100 0 255 ECU_ADDRESS 0xFFFF3AFF READ_WRITE /end MEASUREMENT
/begin MEASUREMENT avTPSKVCL "RAM value avTPSKVCL" SWORD COMP_0515 1 100 -15.999991808 15.999503527 ECU_ADDRESS 0xFFFF1AE2 READ_WRITE /end MEASUREMENT
/begin MEASUREMENT avTPVEF "RAM value avTPVEF" UWORD COMP_0146 1 100 0 99.998480265 ECU_ADDRESS 0xFFFF3B00 READ_WRITE /end MEASUREMENT
/begin MEASUREMENT avTQREQSF "RAM value avTQREQSF" UBYTE COMP_0068 1 100 0 255 ECU_ADDRESS 0xFFFF3B02 READ_WRITE /end MEASUREMENT
/begin MEASUREMENT avTQWOAGB "RAM value avTQWOAGB" SWORD COMP_0228 1 100 -3276.8 3276.7 ECU_ADDRESS 0xFFFF3B04 READ_WRITE /end MEASUREMENT
/begin MEASUREMENT avTQWOAGBF "RAM value avTQWOAGBF" SWORD COMP_0228 1 100 -3276.8 3276.7 ECU_ADDRESS 0xFFFF1AE4 READ_WRITE /end MEASUREMENT
/begin MEASUREMENT avTQWOARBT "RAM value avTQWOARBT" SWORD COMP_0228 1 100 -3276.8 3276.7 ECU_ADDRESS 0xFFFF3B06 READ_WRITE /end MEASUREMENT
/begin MEASUREMENT avTRACE "RAM value avTRACE" SBYTE COMP_0018 1 100 -128 127 ECU_ADDRESS 0xFFFF1AE6 READ_WRITE /end MEASUREMENT
/begin MEASUREMENT avTRARET "RAM value avTRARET" SWORD COMP_0484_S 1 100 -32768 32767 ECU_ADDRESS 0xFFFF3B08 READ_WRITE /end MEASUREMENT
/begin MEASUREMENT avTRQRTO "RAM value avTRQRTO" UWORD COMP_0450 1 100 0 63.999056205 ECU_ADDRESS 0xFFFF1AE8 READ_WRITE /end MEASUREMENT
/begin MEASUREMENT avTRQSPDCT "RAM value avTRQSPDCT" SWORD COMP_0228 1 100 -3276.8 3276.7 ECU_ADDRESS 0xFFFF3B0A READ_WRITE /end MEASUREMENT
/begin MEASUREMENT avTTEIF "RAM value avTTEIF" SWORD COMP_0228 1 100 -3276.8 3276.7 ECU_ADDRESS 0xFFFF1AEA READ_WRITE /end MEASUREMENT
/begin MEASUREMENT avTTEPTD "RAM value avTTEPTD" SWORD COMP_0228 1 100 -3276.8 3276.7 ECU_ADDRESS 0xFFFF1AEC READ_WRITE /end MEASUREMENT
/begin MEASUREMENT avTTERG3 "RAM value avTTERG3" SWORD COMP_0228 1 100 -3276.8 3276.7 ECU_ADDRESS 0xFFFF1AEE READ_WRITE /end MEASUREMENT
/begin MEASUREMENT avTTESL "RAM value avTTESL" SWORD COMP_0228 1 100 -3276.8 3276.7 ECU_ADDRESS 0xFFFF1AF0 READ_WRITE /end MEASUREMENT
/begin MEASUREMENT avTTESLPR "RAM value avTTESLPR" SWORD COMP_0228 1 100 -3276.8 3276.7 ECU_ADDRESS 0xFFFF1AF2 READ_WRITE /end MEASUREMENT
/begin MEASUREMENT avTTPST "RAM value avTTPST" UWORD COMP_0052 1 100 0 31.99956087 ECU_ADDRESS 0xFFFF3B0C READ_WRITE /end MEASUREMENT
/begin MEASUREMENT avTVOADJ "RAM value avTVOADJ" SWORD COMP_0379 1 100 -26.2144 26.2136 ECU_ADDRESS 0xFFFF50D0 READ_WRITE /end MEASUREMENT
/begin MEASUREMENT avTVOADJ_B "RAM value avTVOADJ_B" SWORD COMP_0379 1 100 -26.2144 26.2136 ECU_ADDRESS 0xFFFF50D2 READ_WRITE /end MEASUREMENT
/begin MEASUREMENT avTVOUPLM "RAM value avTVOUPLM" UWORD COMP_0130 1 100 0 1802.2125 ECU_ADDRESS 0xFFFF3B0E READ_WRITE /end MEASUREMENT
/begin MEASUREMENT avTWG "RAM value avTWG" UBYTE COMP_0428 1 100 -40 215 ECU_ADDRESS 0xFFFF3B10 READ_WRITE /end MEASUREMENT
/begin MEASUREMENT avTXFCAD "RAM value avTXFCAD" UWORD COMP_0081 1 100 0 255.99609375 ECU_ADDRESS 0xFFFF3B12 READ_WRITE /end MEASUREMENT
/begin MEASUREMENT avUBNCNT1 "RAM value avUBNCNT1" UWORD COMP_0016 1 100 0 65535 ECU_ADDRESS 0xFFFF50D6 READ_WRITE /end MEASUREMENT
/begin MEASUREMENT avUBNCNT2 "RAM value avUBNCNT2" UWORD COMP_0016 1 100 0 65535 ECU_ADDRESS 0xFFFF50D8 READ_WRITE /end MEASUREMENT
/begin MEASUREMENT avUBNTRP "RAM value avUBNTRP" UWORD COMP_0016 1 100 0 65535 ECU_ADDRESS 0xFFFF50DA READ_WRITE /end MEASUREMENT
/begin MEASUREMENT avVAPO "RAM value avVAPO" UWORD COMP_0005 1 100 0 7208.85 ECU_ADDRESS 0xFFFF3A82 READ_WRITE /end MEASUREMENT
/begin MEASUREMENT avVCTRGE "RAM value avVCTRGE" UWORD COMP_0293_S 1 100 0 0.999985458 ECU_ADDRESS 0xFFFF3B14 READ_WRITE /end MEASUREMENT
/begin MEASUREMENT avVCTRGI "RAM value avVCTRGI" UWORD COMP_0293_S 1 100 0 0.999985458 ECU_ADDRESS 0xFFFF3B18 READ_WRITE /end MEASUREMENT
/begin MEASUREMENT avVCYL "RAM value avVCYL" UWORD COMP_0270_S 1 100 0 0.065535 ECU_ADDRESS 0xFFFF3B1C READ_WRITE /end MEASUREMENT
/begin MEASUREMENT avVINDDL "RAM value avVINDDL" UBYTE COMP_0004 1 100 0 255 ECU_ADDRESS 0xFFFF3B1E READ_WRITE /end MEASUREMENT
/begin MEASUREMENT avVINDIAG "RAM value avVINDIAG" UBYTE COMP_0004 1 100 0 255 ECU_ADDRESS 0xFFFF3B1F READ_WRITE /end MEASUREMENT
/begin MEASUREMENT avVINNUM "RAM value avVINNUM" UBYTE COMP_0068 1 100 0 255 ECU_ADDRESS 0xFFFF50DC READ_WRITE /end MEASUREMENT
/begin MEASUREMENT avVSPASCD "RAM value avVSPASCD" SLONG COMP_0144_S 1 100 -1843.20024746394 1843.20024660563 ECU_ADDRESS 0xFFFF3B20 READ_WRITE /end MEASUREMENT
/begin MEASUREMENT avVSPASCD2 "RAM value avVSPASCD2" SLONG COMP_0481_S 1 100 -1842.540969984 1842.540969126 ECU_ADDRESS 0xFFFF3B24 READ_WRITE /end MEASUREMENT
/begin MEASUREMENT avVSPCOMN "RAM value avVSPCOMN" SLONG COMP_0481_S 1 100 -1842.540969984 1842.540969126 ECU_ADDRESS 0xFFFF3B28 READ_WRITE /end MEASUREMENT
/begin MEASUREMENT avVSPTGTC "RAM value avVSPTGTC" UBYTE COMP_0068 1 100 0 255 ECU_ADDRESS 0xFFFF3B2C READ_WRITE /end MEASUREMENT
/begin MEASUREMENT avVTCADV "RAM value avVTCADV" UBYTE COMP_0245 1 100 -64 191 ECU_ADDRESS 0xFFFF1AF4 READ_WRITE /end MEASUREMENT
/begin MEASUREMENT avVTCDGN3S "RAM value avVTCDGN3S" UBYTE COMP_0004 1 100 0 255 ECU_ADDRESS 0xFFFF3B2D READ_WRITE /end MEASUREMENT
/begin MEASUREMENT avVTCDUTY "RAM value avVTCDUTY" UBYTE COMP_0021 1 100 0 99.609375 ECU_ADDRESS 0xFFFF1AF5 READ_WRITE /end MEASUREMENT
/begin MEASUREMENT avVTCICLRE "RAM value avVTCICLRE" UBYTE COMP_0004 1 100 0 255 ECU_ADDRESS 0xFFFF3B2E READ_WRITE /end MEASUREMENT
/begin MEASUREMENT avVTCICLRf "RAM value avVTCICLRf" UBYTE COMP_0004 1 100 0 255 ECU_ADDRESS 0xFFFF3B2F READ_WRITE /end MEASUREMENT
/begin MEASUREMENT avVTCNOW "RAM value avVTCNOW" UBYTE COMP_0256 1 100 -64 63.5 ECU_ADDRESS 0xFFFF1AF7 READ_WRITE /end MEASUREMENT
/begin MEASUREMENT avVTCNOWE "RAM value avVTCNOWE" UBYTE COMP_0256 1 100 -64 63.5 ECU_ADDRESS 0xFFFF1AF9 READ_WRITE /end MEASUREMENT
/begin MEASUREMENT avVTCNOWKN "RAM value avVTCNOWKN" UWORD COMP_0529 1 100 -128 127.99609375 ECU_ADDRESS 0xFFFF1AFC READ_WRITE /end MEASUREMENT
/begin MEASUREMENT avVTCTRG "RAM value avVTCTRG" UBYTE COMP_0256 1 100 -64 63.5 ECU_ADDRESS 0xFFFF1A6E READ_WRITE /end MEASUREMENT
/begin MEASUREMENT avVTCTRGE "RAM value avVTCTRGE" UBYTE COMP_0256 1 100 -64 63.5 ECU_ADDRESS 0xFFFF1A6F READ_WRITE /end MEASUREMENT
/begin MEASUREMENT avVTDGN3SE "RAM value avVTDGN3SE" UBYTE COMP_0004 1 100 0 255 ECU_ADDRESS 0xFFFF3B30 READ_WRITE /end MEASUREMENT
/begin MEASUREMENT avVTEACNT1 "RAM value avVTEACNT1" UWORD COMP_0016 1 100 0 65535 ECU_ADDRESS 0xFFFF50EE READ_WRITE /end MEASUREMENT
/begin MEASUREMENT avVTEATRP1 "RAM value avVTEATRP1" UWORD COMP_0016 1 100 0 65535 ECU_ADDRESS 0xFFFF50F0 READ_WRITE /end MEASUREMENT
/begin MEASUREMENT avVTEBCNT1 "RAM value avVTEBCNT1" UWORD COMP_0016 1 100 0 65535 ECU_ADDRESS 0xFFFF50F2 READ_WRITE /end MEASUREMENT
/begin MEASUREMENT avVTEBTRP1 "RAM value avVTEBTRP1" UWORD COMP_0016 1 100 0 65535 ECU_ADDRESS 0xFFFF50F4 READ_WRITE /end MEASUREMENT
/begin MEASUREMENT avVTIACNT1 "RAM value avVTIACNT1" UWORD COMP_0016 1 100 0 65535 ECU_ADDRESS 0xFFFF50F6 READ_WRITE /end MEASUREMENT
/begin MEASUREMENT avVTIATRP1 "RAM value avVTIATRP1" UWORD COMP_0016 1 100 0 65535 ECU_ADDRESS 0xFFFF50F8 READ_WRITE /end MEASUREMENT
/begin MEASUREMENT avVTIBCNT1 "RAM value avVTIBCNT1" UWORD COMP_0016 1 100 0 65535 ECU_ADDRESS 0xFFFF50FA READ_WRITE /end MEASUREMENT
/begin MEASUREMENT avVTIBTRP1 "RAM value avVTIBTRP1" UWORD COMP_0016 1 100 0 65535 ECU_ADDRESS 0xFFFF50FC READ_WRITE /end MEASUREMENT
/begin MEASUREMENT avWARMUPS "RAM value avWARMUPS" UBYTE COMP_0016 1 100 0 255 ECU_ADDRESS 0xFFFF50FE READ_WRITE /end MEASUREMENT
/begin MEASUREMENT avWGDUTY "RAM value avWGDUTY" UWORD COMP_0316_S 1 100 0 127.99837455 ECU_ADDRESS 0xFFFF3B32 READ_WRITE /end MEASUREMENT
/begin MEASUREMENT avfLJUDGEE "RAM value avfLJUDGEE" UBYTE COMP_0283 1 100 0 255 ECU_ADDRESS 0xFFFF3AB5 READ_WRITE /end MEASUREMENT
/begin MEASUREMENT avfRJUDGEE "RAM value avfRJUDGEE" UBYTE COMP_0283 1 100 0 255 ECU_ADDRESS 0xFFFF3AB9 READ_WRITE /end MEASUREMENT
/begin MEASUREMENT bvADVCD5 "RAM value bvADVCD5" UBYTE COMP_0017 1 100 0 255 ECU_ADDRESS 0xFFFF1A40 READ_WRITE /end MEASUREMENT
/begin MEASUREMENT bvALPHA "RAM value bvALPHA" UWORD COMP_0031 1 100 0 255.99609375 ECU_ADDRESS 0xFFFF1A2C READ_WRITE /end MEASUREMENT
/begin MEASUREMENT bvALPHAE "RAM value bvALPHAE" UWORD COMP_0031 1 100 0 255.99609375 ECU_ADDRESS 0xFFFF3A68 READ_WRITE /end MEASUREMENT
/begin MEASUREMENT bvBETA "RAM value bvBETA" SBYTE COMP_0018 1 100 -128 127 ECU_ADDRESS 0xFFFF1A41 READ_WRITE /end MEASUREMENT
/begin MEASUREMENT bvEGSTPM "RAM value bvEGSTPM" UWORD COMP_0140 1 100 0 32767.5 ECU_ADDRESS 0xFFFF4F6C READ_WRITE /end MEASUREMENT
/begin MEASUREMENT bvFCAT "RAM value bvFCAT" UBYTE COMP_0251 1 100 0 255 ECU_ADDRESS 0xFFFF1A42 READ_WRITE /end MEASUREMENT
/begin MEASUREMENT bvFCCYL "RAM value bvFCCYL" UBYTE COMP_0421 1 100 0 255 ECU_ADDRESS 0xFFFF3A6C READ_WRITE /end MEASUREMENT
/begin MEASUREMENT bvFHOS "RAM value bvFHOS" UWORD COMP_0031 1 100 0 255.99609375 ECU_ADDRESS 0xFFFF3A74 READ_WRITE /end MEASUREMENT
/begin MEASUREMENT bvFHOSB "RAM value bvFHOSB" UWORD COMP_0031 1 100 0 255.99609375 ECU_ADDRESS 0xFFFF3A76 READ_WRITE /end MEASUREMENT
/begin MEASUREMENT bvFHOSBI "RAM value bvFHOSBI" UWORD COMP_0031 1 100 0 255.99609375 ECU_ADDRESS 0xFFFF3A7A READ_WRITE /end MEASUREMENT
/begin MEASUREMENT bvFIRTD "RAM value bvFIRTD" UBYTE COMP_0017 1 100 0 255 ECU_ADDRESS 0xFFFF1A43 READ_WRITE /end MEASUREMENT
/begin MEASUREMENT bvGEAR "RAM value bvGEAR" UBYTE COMP_0068 1 100 0 255 ECU_ADDRESS 0xFFFF1A44 READ_WRITE /end MEASUREMENT
/begin MEASUREMENT bvISSTPM "RAM value bvISSTPM" UWORD COMP_0025 1 100 0 32767.5 ECU_ADDRESS 0xFFFF4F6E READ_WRITE /end MEASUREMENT
/begin MEASUREMENT bvKATHOS "RAM value bvKATHOS" SWORD COMP_0449 1 100 -128 127.99609375 ECU_ADDRESS 0xFFFF1A46 READ_WRITE /end MEASUREMENT
/begin MEASUREMENT bvKBLRC "RAM value bvKBLRC" UWORD COMP_0031 1 100 0 255.99609375 ECU_ADDRESS 0xFFFF1A48 READ_WRITE /end MEASUREMENT
/begin MEASUREMENT bvKBLRCA "RAM value bvKBLRCA" UWORD COMP_0031 1 100 0 255.99609375 ECU_ADDRESS 0xFFFF1A4C READ_WRITE /end MEASUREMENT
/begin MEASUREMENT bvKBLRCB "RAM value bvKBLRCB" UWORD COMP_0031 1 100 0 255.99609375 ECU_ADDRESS 0xFFFF4F70 READ_WRITE /end MEASUREMENT
/begin MEASUREMENT bvKLMRT "RAM value bvKLMRT" UBYTE COMP_0017 1 100 0 255 ECU_ADDRESS 0xFFFF1A50 READ_WRITE /end MEASUREMENT
/begin MEASUREMENT bvKUB "RAM value bvKUB" UWORD COMP_0057 1 100 0 3.999941832 ECU_ADDRESS 0xFFFF1A52 READ_WRITE /end MEASUREMENT
/begin MEASUREMENT bvLMCLSTf "RAM value bvLMCLSTf" UBYTE COMP_0004 1 100 0 255 ECU_ADDRESS 0xFFFF1A54 READ_WRITE /end MEASUREMENT
/begin MEASUREMENT bvLMDCLSf "RAM value bvLMDCLSf" UBYTE COMP_0004 1 100 0 255 ECU_ADDRESS 0xFFFF1A30 READ_WRITE /end MEASUREMENT
/begin MEASUREMENT bvLMDRCHf "RAM value bvLMDRCHf" UBYTE COMP_0004 1 100 0 255 ECU_ADDRESS 0xFFFF1A31 READ_WRITE /end MEASUREMENT
/begin MEASUREMENT bvLTSBU "RAM value bvLTSBU" UWORD COMP_0458 1 100 -1280 1279.9609375 ECU_ADDRESS 0xFFFF1A56 READ_WRITE /end MEASUREMENT
/begin MEASUREMENT bvMCCDM "RAM value bvMCCDM" UBYTE COMP_0004 1 100 0 255 ECU_ADDRESS 0xFFFF3A7E READ_WRITE /end MEASUREMENT
/begin MEASUREMENT bvMOPENf "RAM value bvMOPENf" UBYTE COMP_0004 1 100 0 255 ECU_ADDRESS 0xFFFF1A32 READ_WRITE /end MEASUREMENT
/begin MEASUREMENT bvNSET0 "RAM value bvNSET0" UBYTE COMP_0006 1 100 0 3187.5 ECU_ADDRESS 0xFFFF1A33 READ_WRITE /end MEASUREMENT
/begin MEASUREMENT bvNSET00 "RAM value bvNSET00" UBYTE COMP_0006 1 100 0 3187.5 ECU_ADDRESS 0xFFFF1A34 READ_WRITE /end MEASUREMENT
/begin MEASUREMENT bvPIISC "RAM value bvPIISC" UBYTE COMP_0009 1 100 0 199.21875 ECU_ADDRESS 0xFFFF1A5A READ_WRITE /end MEASUREMENT
/begin MEASUREMENT bvRATEGR "RAM value bvRATEGR" UBYTE COMP_0141 1 100 0 49.8046875 ECU_ADDRESS 0xFFFF1A5B READ_WRITE /end MEASUREMENT
/begin MEASUREMENT bvSCADMP "RAM value bvSCADMP" UBYTE COMP_0021 1 100 0 99.609375 ECU_ADDRESS 0xFFFF1A35 READ_WRITE /end MEASUREMENT
/begin MEASUREMENT bvSTFBYA "RAM value bvSTFBYA" UWORD COMP_0328 1 100 0 399.99392106 ECU_ADDRESS 0xFFFF1A5C READ_WRITE /end MEASUREMENT
/begin MEASUREMENT bvTFBYA "RAM value bvTFBYA" UWORD COMP_0217 1 100 0 3.999941832 ECU_ADDRESS 0xFFFF1A5E READ_WRITE /end MEASUREMENT
/begin MEASUREMENT bvTFBYA0 "RAM value bvTFBYA0" UWORD COMP_0217 1 100 0 3.999941832 ECU_ADDRESS 0xFFFF1A60 READ_WRITE /end MEASUREMENT
/begin MEASUREMENT bvTHOS "RAM value bvTHOS" UWORD COMP_0057 1 100 0 3.999941832 ECU_ADDRESS 0xFFFF1A62 READ_WRITE /end MEASUREMENT
/begin MEASUREMENT bvTMONT "RAM value bvTMONT" UBYTE COMP_0008 1 100 0 25500 ECU_ADDRESS 0xFFFF1A64 READ_WRITE /end MEASUREMENT
/begin MEASUREMENT bvTPVFBYA "RAM value bvTPVFBYA" UBYTE COMP_0001 1 100 0 31.875 ECU_ADDRESS 0xFFFF1A66 READ_WRITE /end MEASUREMENT
/begin MEASUREMENT vA "RAM value vA" UBYTE COMP_0267 1 100 0 65280 ECU_ADDRESS 0xFFFF16F8 READ_WRITE /end MEASUREMENT
/begin MEASUREMENT vA0MODEL "RAM value vA0MODEL" SWORD COMP_0005_S 1 100 -3.2768 3.2767 ECU_ADDRESS 0xFFFF09E0 READ_WRITE /end MEASUREMENT
/begin MEASUREMENT vA1MODEL "RAM value vA1MODEL" SWORD COMP_0005_S 1 100 -3.2768 3.2767 ECU_ADDRESS 0xFFFF09E4 READ_WRITE /end MEASUREMENT
/begin MEASUREMENT vA5CNG "RAM value vA5CNG" UBYTE COMP_0108 1 100 0 0.99609375 ECU_ADDRESS 0xFFFF09E8 READ_WRITE /end MEASUREMENT
/begin MEASUREMENT vA5N "RAM value vA5N" UBYTE COMP_0032 1 100 0 0.99609375 ECU_ADDRESS 0xFFFF09E9 READ_WRITE /end MEASUREMENT
/begin MEASUREMENT vA5TP "RAM value vA5TP" UBYTE COMP_0017 1 100 0 255 ECU_ADDRESS 0xFFFF09EA READ_WRITE /end MEASUREMENT
/begin MEASUREMENT vA5TW "RAM value vA5TW" UBYTE COMP_0032 1 100 0 0.99609375 ECU_ADDRESS 0xFFFF09EB READ_WRITE /end MEASUREMENT
/begin MEASUREMENT vAA "RAM value vAA" UWORD COMP_0042 1 100 0 52.428 ECU_ADDRESS 0xFFFF15B0 READ_WRITE /end MEASUREMENT
/begin MEASUREMENT vAACTVO "RAM value vAACTVO" UWORD COMP_0005 1 100 0 7208.85 ECU_ADDRESS 0xFFFF2168 READ_WRITE /end MEASUREMENT
/begin MEASUREMENT vAACTVO_S "RAM value vAACTVO_S" UWORD COMP_0005 1 100 0 7208.85 ECU_ADDRESS 0xFFFF3038 READ_WRITE /end MEASUREMENT
/begin MEASUREMENT vAADNV2 "RAM value vAADNV2" UWORD COMP_0485_S 1 100 0 0.000005950578 ECU_ADDRESS 0xFFFF08B8 READ_WRITE /end MEASUREMENT
/begin MEASUREMENT vAAPO "RAM value vAAPO" UWORD COMP_0042 1 100 0 52.428 ECU_ADDRESS 0xFFFF09EC READ_WRITE /end MEASUREMENT
/begin MEASUREMENT vAAPO0_S "RAM value vAAPO0_S" UWORD COMP_0042 1 100 0 52.428 ECU_ADDRESS 0xFFFF149A READ_WRITE /end MEASUREMENT
/begin MEASUREMENT vAAPOCK "RAM value vAAPOCK" UWORD COMP_0042 1 100 0 52.428 ECU_ADDRESS 0xFFFF09EE READ_WRITE /end MEASUREMENT
/begin MEASUREMENT vAAPON "RAM value vAAPON" UWORD COMP_0486_S 1 100 0 104.856 ECU_ADDRESS 0xFFFF09F0 READ_WRITE /end MEASUREMENT
/begin MEASUREMENT vAAPO_S "RAM value vAAPO_S" UWORD COMP_0042 1 100 0 52.428 ECU_ADDRESS 0xFFFF1498 READ_WRITE /end MEASUREMENT
/begin MEASUREMENT vABFADJf "RAM value vABFADJf" UBYTE COMP_0004 1 100 0 255 ECU_ADDRESS 0xFFFF338C READ_WRITE /end MEASUREMENT
/begin MEASUREMENT vABFBFR "RAM value vABFBFR" UWORD COMP_0453 1 100 0 131.07 ECU_ADDRESS 0xFFFF09F2 READ_WRITE /end MEASUREMENT
/begin MEASUREMENT vABFCMPV "RAM value vABFCMPV" UWORD COMP_0453 1 100 0 131.07 ECU_ADDRESS 0xFFFF09FE READ_WRITE /end MEASUREMENT
/begin MEASUREMENT vABFCMPf "RAM value vABFCMPf" UBYTE COMP_0004 1 100 0 255 ECU_ADDRESS 0xFFFF09FC READ_WRITE /end MEASUREMENT
/begin MEASUREMENT vABFER "RAM value vABFER" SWORD COMP_0020_S 1 100 -65.536 65.534 ECU_ADDRESS 0xFFFF216A READ_WRITE /end MEASUREMENT
/begin MEASUREMENT vABFFCZ "RAM value vABFFCZ" UBYTE COMP_0421 1 100 0 255 ECU_ADDRESS 0xFFFF216E READ_WRITE /end MEASUREMENT
/begin MEASUREMENT vACCATMP "RAM value vACCATMP" ULONG COMP_0039_S 1 100 60000 4295027295 ECU_ADDRESS 0xFFFF3390 READ_WRITE /end MEASUREMENT
/begin MEASUREMENT vACCCLT "RAM value vACCCLT" SLONG COMP_0006_S 1 100 -512.000903872512 512.000903634093 ECU_ADDRESS 0xFFFF2170 READ_WRITE /end MEASUREMENT
/begin MEASUREMENT vACCCOM "RAM value vACCCOM" SLONG COMP_0006_S 1 100 -512.000903872512 512.000903634093 ECU_ADDRESS 0xFFFF2178 READ_WRITE /end MEASUREMENT
/begin MEASUREMENT vACCFBK "RAM value vACCFBK" SLONG COMP_0006_S 1 100 -512.000903872512 512.000903634093 ECU_ADDRESS 0xFFFF2180 READ_WRITE /end MEASUREMENT
/begin MEASUREMENT vACCFKF "RAM value vACCFKF" SLONG COMP_0006_S 1 100 -512.000903872512 512.000903634093 ECU_ADDRESS 0xFFFF2188 READ_WRITE /end MEASUREMENT
/begin MEASUREMENT vACCHILMT "RAM value vACCHILMT" SLONG COMP_0006_S 1 100 -512.000903872512 512.000903634093 ECU_ADDRESS 0xFFFF218C READ_WRITE /end MEASUREMENT
/begin MEASUREMENT vACCLIM "RAM value vACCLIM" UWORD COMP_0487_S 1 100 0 63.999056205 ECU_ADDRESS 0xFFFF2190 READ_WRITE /end MEASUREMENT
/begin MEASUREMENT vACCLOLMT "RAM value vACCLOLMT" SLONG COMP_0006_S 1 100 -512.000903872512 512.000903634093 ECU_ADDRESS 0xFFFF2194 READ_WRITE /end MEASUREMENT
/begin MEASUREMENT vACCMDL "RAM value vACCMDL" SLONG COMP_0006_S 1 100 -512.000903872512 512.000903634093 ECU_ADDRESS 0xFFFF2198 READ_WRITE /end MEASUREMENT
/begin MEASUREMENT vACCME1 "RAM value vACCME1" SLONG COMP_0006_S 1 100 -512.000903872512 512.000903634093 ECU_ADDRESS 0xFFFF219C READ_WRITE /end MEASUREMENT
/begin MEASUREMENT vACCME2 "RAM value vACCME2" SLONG COMP_0006_S 1 100 -512.000903872512 512.000903634093 ECU_ADDRESS 0xFFFF21A0 READ_WRITE /end MEASUREMENT
/begin MEASUREMENT vACCREF "RAM value vACCREF" SLONG COMP_0006_S 1 100 -512.000903872512 512.000903634093 ECU_ADDRESS 0xFFFF21A4 READ_WRITE /end MEASUREMENT
/begin MEASUREMENT vACCRTF "RAM value vACCRTF" SLONG COMP_0006_S 1 100 -512.000903872512 512.000903634093 ECU_ADDRESS 0xFFFF21D0 READ_WRITE /end MEASUREMENT
/begin MEASUREMENT vACCRTM "RAM value vACCRTM" SLONG COMP_0006_S 1 100 -512.000903872512 512.000903634093 ECU_ADDRESS 0xFFFF21D4 READ_WRITE /end MEASUREMENT
/begin MEASUREMENT vACCSB2 "RAM value vACCSB2" SLONG COMP_0006_S 1 100 -512.000903872512 512.000903634093 ECU_ADDRESS 0xFFFF21D8 READ_WRITE /end MEASUREMENT
/begin MEASUREMENT vACCSB2CN "RAM value vACCSB2CN" SWORD COMP_0488_S 1 100 -7.99997952 7.99973538 ECU_ADDRESS 0xFFFF21DC READ_WRITE /end MEASUREMENT
/begin MEASUREMENT vACCSUB "RAM value vACCSUB" SLONG COMP_0006_S 1 100 -512.000903872512 512.000903634093 ECU_ADDRESS 0xFFFF21E4 READ_WRITE /end MEASUREMENT
/begin MEASUREMENT vACCWLNP "RAM value vACCWLNP" ULONG COMP_0039_S 1 100 60000 4295027295 ECU_ADDRESS 0xFFFF3394 READ_WRITE /end MEASUREMENT
/begin MEASUREMENT vACD3LU "RAM value vACD3LU" UBYTE COMP_0008 1 100 0 25500 ECU_ADDRESS 0xFFFF21EC READ_WRITE /end MEASUREMENT
/begin MEASUREMENT vACPDNE "RAM value vACPDNE" UBYTE COMP_0068 1 100 0 255 ECU_ADDRESS 0xFFFF21ED READ_WRITE /end MEASUREMENT
/begin MEASUREMENT vACRECN "RAM value vACRECN" UBYTE COMP_0000 1 100 0 6375 ECU_ADDRESS 0xFFFF0A02 READ_WRITE /end MEASUREMENT
/begin MEASUREMENT vACRQ "RAM value vACRQ" ULONG COMP_0489_S 1 100 0 429496.7295 ECU_ADDRESS 0xFFFF21F0 READ_WRITE /end MEASUREMENT
/begin MEASUREMENT vACTGTHC "RAM value vACTGTHC" UWORD COMP_0453 1 100 0 131.07 ECU_ADDRESS 0xFFFF21F4 READ_WRITE /end MEASUREMENT
/begin MEASUREMENT vACTTGT "RAM value vACTTGT" UWORD COMP_0453 1 100 0 131.07 ECU_ADDRESS 0xFFFF21F6 READ_WRITE /end MEASUREMENT
/begin MEASUREMENT vACVSPNE "RAM value vACVSPNE" UBYTE COMP_0068 1 100 0 255 ECU_ADDRESS 0xFFFF21FA READ_WRITE /end MEASUREMENT
/begin MEASUREMENT vADAFHF "RAM value vADAFHF" UWORD COMP_0023 1 100 0 327675 ECU_ADDRESS 0xFFFF1510 READ_WRITE /end MEASUREMENT
/begin MEASUREMENT vADAFHFOF "RAM value vADAFHFOF" UWORD COMP_0023 1 100 0 327675 ECU_ADDRESS 0xFFFF1512 READ_WRITE /end MEASUREMENT
/begin MEASUREMENT vADAFHFON "RAM value vADAFHFON" UWORD COMP_0023 1 100 0 327675 ECU_ADDRESS 0xFFFF1514 READ_WRITE /end MEASUREMENT
/begin MEASUREMENT vADAFIOUT "RAM value vADAFIOUT" UWORD COMP_0023 1 100 0 327675 ECU_ADDRESS 0xFFFF1516 READ_WRITE /end MEASUREMENT
/begin MEASUREMENT vADAFSF "RAM value vADAFSF" UWORD COMP_0023 1 100 0 327675 ECU_ADDRESS 0xFFFF0802 READ_WRITE /end MEASUREMENT
/begin MEASUREMENT vADAFSFL "RAM value vADAFSFL" UWORD COMP_0023 1 100 0 327675 ECU_ADDRESS 0xFFFF1518 READ_WRITE /end MEASUREMENT
/begin MEASUREMENT vADALP "RAM value vADALP" UWORD COMP_0031 1 100 0 255.99609375 ECU_ADDRESS 0xFFFF21FC READ_WRITE /end MEASUREMENT
/begin MEASUREMENT vADAPS1V "RAM value vADAPS1V" UWORD COMP_0023 1 100 0 327675 ECU_ADDRESS 0xFFFF3080 READ_WRITE /end MEASUREMENT
/begin MEASUREMENT vADAPS2V "RAM value vADAPS2V" UWORD COMP_0023 1 100 0 327675 ECU_ADDRESS 0xFFFF3082 READ_WRITE /end MEASUREMENT
/begin MEASUREMENT vADASCDSW "RAM value vADASCDSW" UWORD COMP_0023 1 100 0 327675 ECU_ADDRESS 0xFFFF3084 READ_WRITE /end MEASUREMENT
/begin MEASUREMENT vADAVCC "RAM value vADAVCC" UWORD COMP_0023 1 100 0 327675 ECU_ADDRESS 0xFFFF3086 READ_WRITE /end MEASUREMENT
/begin MEASUREMENT vADBATSEN "RAM value vADBATSEN" UWORD COMP_0023 1 100 0 327675 ECU_ADDRESS 0xFFFF151A READ_WRITE /end MEASUREMENT
/begin MEASUREMENT vADBNCSW "RAM value vADBNCSW" UWORD COMP_0023 1 100 0 327675 ECU_ADDRESS 0xFFFF3088 READ_WRITE /end MEASUREMENT
/begin MEASUREMENT vADCG "RAM value vADCG" UBYTE COMP_0004 1 100 0 255 ECU_ADDRESS 0xFFFF3B34 READ_WRITE /end MEASUREMENT
/begin MEASUREMENT vADCVO2 "RAM value vADCVO2" UWORD COMP_0023 1 100 0 327675 ECU_ADDRESS 0xFFFF15B2 READ_WRITE /end MEASUREMENT
/begin MEASUREMENT vADCVRO2 "RAM value vADCVRO2" UWORD COMP_0023 1 100 0 327675 ECU_ADDRESS 0xFFFF3398 READ_WRITE /end MEASUREMENT
/begin MEASUREMENT vADDADIN "RAM value vADDADIN" UWORD COMP_0023 1 100 0 327675 ECU_ADDRESS 0xFFFF308A READ_WRITE /end MEASUREMENT
/begin MEASUREMENT vADDCUR "RAM value vADDCUR" UWORD COMP_0012_S 1 100 -32768 32767 ECU_ADDRESS 0xFFFF21FE READ_WRITE /end MEASUREMENT
/begin MEASUREMENT vADDCUR2 "RAM value vADDCUR2" ULONG COMP_0013_S 1 100 -8388608 8388607.99609375 ECU_ADDRESS 0xFFFF3B38 READ_WRITE /end MEASUREMENT
/begin MEASUREMENT vADDCUR2D "RAM value vADDCUR2D" ULONG COMP_0490_S 1 100 -4194314.73741824 4194314.73546511 ECU_ADDRESS 0xFFFF2200 READ_WRITE /end MEASUREMENT
/begin MEASUREMENT vADDCURZ "RAM value vADDCURZ" UWORD COMP_0012_S 1 100 -32768 32767 ECU_ADDRESS 0xFFFF2204 READ_WRITE /end MEASUREMENT
/begin MEASUREMENT vADDNE "RAM value vADDNE" UWORD COMP_0000 1 100 0 1638375 ECU_ADDRESS 0xFFFF4424 READ_WRITE /end MEASUREMENT
/begin MEASUREMENT vADDOXY "RAM value vADDOXY" UWORD COMP_0068 1 100 0 65535 ECU_ADDRESS 0xFFFF2206 READ_WRITE /end MEASUREMENT
/begin MEASUREMENT vADDQFBI "RAM value vADDQFBI" SLONG COMP_0277 1 100 -2147483648 2147483647 ECU_ADDRESS 0xFFFF0A04 READ_WRITE /end MEASUREMENT
/begin MEASUREMENT vADDRV "RAM value vADDRV" UWORD COMP_0104 1 100 0 655350 ECU_ADDRESS 0xFFFF151C READ_WRITE /end MEASUREMENT
/begin MEASUREMENT vADEGT1 "RAM value vADEGT1" UWORD COMP_0023 1 100 0 327675 ECU_ADDRESS 0xFFFF308C READ_WRITE /end MEASUREMENT
/begin MEASUREMENT vADFHS1 "RAM value vADFHS1" UWORD COMP_0023 1 100 0 327675 ECU_ADDRESS 0xFFFF339C READ_WRITE /end MEASUREMENT
/begin MEASUREMENT vADFHS1ON "RAM value vADFHS1ON" UWORD COMP_0023 1 100 0 327675 ECU_ADDRESS 0xFFFF339E READ_WRITE /end MEASUREMENT
/begin MEASUREMENT vADFPPSH "RAM value vADFPPSH" UWORD COMP_0061 1 100 0 327675 ECU_ADDRESS 0xFFFF308E READ_WRITE /end MEASUREMENT
/begin MEASUREMENT vADFTPRS "RAM value vADFTPRS" UWORD COMP_0061 1 100 0 327675 ECU_ADDRESS 0xFFFF151E READ_WRITE /end MEASUREMENT
/begin MEASUREMENT vADGSEN "RAM value vADGSEN" UWORD COMP_0023 1 100 0 327675 ECU_ADDRESS 0xFFFF1520 READ_WRITE /end MEASUREMENT
/begin MEASUREMENT vADICTMP1 "RAM value vADICTMP1" UWORD COMP_0023 1 100 0 327675 ECU_ADDRESS 0xFFFF3090 READ_WRITE /end MEASUREMENT
/begin MEASUREMENT vADICTMP2 "RAM value vADICTMP2" UWORD COMP_0023 1 100 0 327675 ECU_ADDRESS 0xFFFF3092 READ_WRITE /end MEASUREMENT
/begin MEASUREMENT vADJCNT "RAM value vADJCNT" UBYTE COMP_0030 1 100 0 255 ECU_ADDRESS 0xFFFF220A READ_WRITE /end MEASUREMENT
/begin MEASUREMENT vADJDDL "RAM value vADJDDL" UBYTE COMP_0004 1 100 0 255 ECU_ADDRESS 0xFFFF3B3C READ_WRITE /end MEASUREMENT
/begin MEASUREMENT vADJDIAG "RAM value vADJDIAG" UBYTE COMP_0004 1 100 0 255 ECU_ADDRESS 0xFFFF3B3D READ_WRITE /end MEASUREMENT
/begin MEASUREMENT vADJSTG "RAM value vADJSTG" UBYTE COMP_0004 1 100 0 255 ECU_ADDRESS 0xFFFF220B READ_WRITE /end MEASUREMENT
/begin MEASUREMENT vADKNFIL1 "RAM value vADKNFIL1" UWORD COMP_0023 1 100 0 327675 ECU_ADDRESS 0xFFFF3A04 READ_WRITE /end MEASUREMENT
/begin MEASUREMENT vADMPX1 "RAM value vADMPX1" UWORD COMP_0023 1 100 0 327675 ECU_ADDRESS 0xFFFF220C READ_WRITE /end MEASUREMENT
/begin MEASUREMENT vADMPX2 "RAM value vADMPX2" UWORD COMP_0023 1 100 0 327675 ECU_ADDRESS 0xFFFF221C READ_WRITE /end MEASUREMENT
/begin MEASUREMENT vADMPX3 "RAM value vADMPX3" UWORD COMP_0023 1 100 0 327675 ECU_ADDRESS 0xFFFF222C READ_WRITE /end MEASUREMENT
/begin MEASUREMENT vADMPX4 "RAM value vADMPX4" UWORD COMP_0023 1 100 0 327675 ECU_ADDRESS 0xFFFF223C READ_WRITE /end MEASUREMENT
/begin MEASUREMENT vADMPX5 "RAM value vADMPX5" UWORD COMP_0023 1 100 0 327675 ECU_ADDRESS 0xFFFF224C READ_WRITE /end MEASUREMENT
/begin MEASUREMENT vADNSTY "RAM value vADNSTY" UBYTE COMP_0402_S 1 100 0 2040 ECU_ADDRESS 0xFFFF30F8 READ_WRITE /end MEASUREMENT
/begin MEASUREMENT vADNVQL "RAM value vADNVQL" UWORD COMP_0028_S 1 100 0 2.5599609375E-06 ECU_ADDRESS 0xFFFF1FAC READ_WRITE /end MEASUREMENT
/begin MEASUREMENT vADNVQL1 "RAM value vADNVQL1" UWORD COMP_0028_S 1 100 0 2.5599609375E-06 ECU_ADDRESS 0xFFFF33A0 READ_WRITE /end MEASUREMENT
/begin MEASUREMENT vADO2R "RAM value vADO2R" UWORD COMP_0023 1 100 0 327675 ECU_ADDRESS 0xFFFF1FAE READ_WRITE /end MEASUREMENT
/begin MEASUREMENT vADOPS "RAM value vADOPS" UWORD COMP_0023 1 100 0 327675 ECU_ADDRESS 0xFFFF1DB8 READ_WRITE /end MEASUREMENT
/begin MEASUREMENT vADPDPRES "RAM value vADPDPRES" UWORD COMP_0023 1 100 0 327675 ECU_ADDRESS 0xFFFF1DBA READ_WRITE /end MEASUREMENT
/begin MEASUREMENT vADPMB "RAM value vADPMB" UWORD COMP_0023 1 100 0 327675 ECU_ADDRESS 0xFFFF3094 READ_WRITE /end MEASUREMENT
/begin MEASUREMENT vADPRES "RAM value vADPRES" UWORD COMP_0023 1 100 0 327675 ECU_ADDRESS 0xFFFF1522 READ_WRITE /end MEASUREMENT
/begin MEASUREMENT vADPSPRES "RAM value vADPSPRES" UWORD COMP_0023 1 100 0 327675 ECU_ADDRESS 0xFFFF1524 READ_WRITE /end MEASUREMENT
/begin MEASUREMENT vADTA "RAM value vADTA" UWORD COMP_0023 1 100 0 327675 ECU_ADDRESS 0xFFFF1526 READ_WRITE /end MEASUREMENT
/begin MEASUREMENT vADTATH "RAM value vADTATH" UWORD COMP_0023 1 100 0 327675 ECU_ADDRESS 0xFFFF1528 READ_WRITE /end MEASUREMENT
/begin MEASUREMENT vADTBATT "RAM value vADTBATT" UWORD COMP_0023 1 100 0 327675 ECU_ADDRESS 0xFFFF152A READ_WRITE /end MEASUREMENT
/begin MEASUREMENT vADTCVV "RAM value vADTCVV" UWORD COMP_0023 1 100 0 327675 ECU_ADDRESS 0xFFFF33A2 READ_WRITE /end MEASUREMENT
/begin MEASUREMENT vADTF "RAM value vADTF" UWORD COMP_0023 1 100 0 327675 ECU_ADDRESS 0xFFFF1DBC READ_WRITE /end MEASUREMENT
/begin MEASUREMENT vADTO "RAM value vADTO" UWORD COMP_0023 1 100 0 327675 ECU_ADDRESS 0xFFFF152C READ_WRITE /end MEASUREMENT
/begin MEASUREMENT vADTPREST "RAM value vADTPREST" UWORD COMP_0061 1 100 0 327675 ECU_ADDRESS 0xFFFF3096 READ_WRITE /end MEASUREMENT
/begin MEASUREMENT vADTPS2V "RAM value vADTPS2V" UWORD COMP_0023 1 100 0 327675 ECU_ADDRESS 0xFFFF3098 READ_WRITE /end MEASUREMENT
/begin MEASUREMENT vADTRSTFB "RAM value vADTRSTFB" UWORD COMP_0491_S 1 100 -64 191.99609375 ECU_ADDRESS 0xFFFF0A08 READ_WRITE /end MEASUREMENT
/begin MEASUREMENT vADTW "RAM value vADTW" UWORD COMP_0023 1 100 0 327675 ECU_ADDRESS 0xFFFF309A READ_WRITE /end MEASUREMENT
/begin MEASUREMENT vADTW_S "RAM value vADTW_S" UWORD COMP_0023 1 100 0 327675 ECU_ADDRESS 0xFFFF153E READ_WRITE /end MEASUREMENT
/begin MEASUREMENT vADUS "RAM value vADUS" UWORD COMP_0023 1 100 0 327675 ECU_ADDRESS 0xFFFF309C READ_WRITE /end MEASUREMENT
/begin MEASUREMENT vADV "RAM value vADV" SBYTE COMP_0018 1 100 -128 127 ECU_ADDRESS 0xFFFF0944 READ_WRITE /end MEASUREMENT
/begin MEASUREMENT vADVADJ "RAM value vADVADJ" SBYTE COMP_0018 1 100 -128 127 ECU_ADDRESS 0xFFFF5100 READ_WRITE /end MEASUREMENT
/begin MEASUREMENT vADVADJR "RAM value vADVADJR" SBYTE COMP_0018 1 100 -128 127 ECU_ADDRESS 0xFFFF4426 READ_WRITE /end MEASUREMENT
/begin MEASUREMENT vADVADJS "RAM value vADVADJS" SBYTE COMP_0018 1 100 -128 127 ECU_ADDRESS 0xFFFF4427 READ_WRITE /end MEASUREMENT
/begin MEASUREMENT vADVAFADJ "RAM value vADVAFADJ" UWORD COMP_0023 1 100 0 327675 ECU_ADDRESS 0xFFFF152E READ_WRITE /end MEASUREMENT
/begin MEASUREMENT vADVAFI "RAM value vADVAFI" UBYTE COMP_0017 1 100 0 255 ECU_ADDRESS 0xFFFF0A0A READ_WRITE /end MEASUREMENT
/begin MEASUREMENT vADVAVE "RAM value vADVAVE" SBYTE COMP_0018 1 100 -128 127 ECU_ADDRESS 0xFFFF4428 READ_WRITE /end MEASUREMENT
/begin MEASUREMENT vADVB "RAM value vADVB" UWORD COMP_0054 1 100 0 1310700 ECU_ADDRESS 0xFFFF309E READ_WRITE /end MEASUREMENT
/begin MEASUREMENT vADVBL1 "RAM value vADVBL1" SBYTE COMP_0018 1 100 -128 127 ECU_ADDRESS 0xFFFF0A0B READ_WRITE /end MEASUREMENT
/begin MEASUREMENT vADVBL3 "RAM value vADVBL3" SBYTE COMP_0018 1 100 -128 127 ECU_ADDRESS 0xFFFF0A0C READ_WRITE /end MEASUREMENT
/begin MEASUREMENT vADVC1 "RAM value vADVC1" UBYTE COMP_0017 1 100 0 255 ECU_ADDRESS 0xFFFF0A0D READ_WRITE /end MEASUREMENT
/begin MEASUREMENT vADVC2 "RAM value vADVC2" UBYTE COMP_0017 1 100 0 255 ECU_ADDRESS 0xFFFF0A0E READ_WRITE /end MEASUREMENT
/begin MEASUREMENT vADVCD1 "RAM value vADVCD1" UBYTE COMP_0017 1 100 0 255 ECU_ADDRESS 0xFFFF0A0F READ_WRITE /end MEASUREMENT
/begin MEASUREMENT vADVCFEQ "RAM value vADVCFEQ" UBYTE COMP_0373 1 100 0 2.55 ECU_ADDRESS 0xFFFF225C READ_WRITE /end MEASUREMENT
/begin MEASUREMENT vADVCNT1 "RAM value vADVCNT1" UBYTE COMP_0016 1 100 0 255 ECU_ADDRESS 0xFFFF4429 READ_WRITE /end MEASUREMENT
/begin MEASUREMENT vADVCNT2 "RAM value vADVCNT2" UBYTE COMP_0016 1 100 0 255 ECU_ADDRESS 0xFFFF442A READ_WRITE /end MEASUREMENT
/begin MEASUREMENT vADVCNT3 "RAM value vADVCNT3" UBYTE COMP_0016 1 100 0 255 ECU_ADDRESS 0xFFFF442B READ_WRITE /end MEASUREMENT
/begin MEASUREMENT vADVCNT4 "RAM value vADVCNT4" UBYTE COMP_0016 1 100 0 255 ECU_ADDRESS 0xFFFF442C READ_WRITE /end MEASUREMENT
/begin MEASUREMENT vADVCNT5 "RAM value vADVCNT5" UBYTE COMP_0016 1 100 0 255 ECU_ADDRESS 0xFFFF442D READ_WRITE /end MEASUREMENT
/begin MEASUREMENT vADVCNT6 "RAM value vADVCNT6" UBYTE COMP_0016 1 100 0 255 ECU_ADDRESS 0xFFFF442E READ_WRITE /end MEASUREMENT
/begin MEASUREMENT vADVCOWPA "RAM value vADVCOWPA" SWORD COMP_0078 1 100 -128 127.99609375 ECU_ADDRESS 0xFFFF16FA READ_WRITE /end MEASUREMENT
/begin MEASUREMENT vADVEGR "RAM value vADVEGR" UWORD COMP_0023 1 100 0 327675 ECU_ADDRESS 0xFFFF1530 READ_WRITE /end MEASUREMENT
/begin MEASUREMENT vADVEND "RAM value vADVEND" SBYTE COMP_0018 1 100 -128 127 ECU_ADDRESS 0xFFFF442F READ_WRITE /end MEASUREMENT
/begin MEASUREMENT vADVEPN "RAM value vADVEPN" SBYTE COMP_0018 1 100 -128 127 ECU_ADDRESS 0xFFFF225D READ_WRITE /end MEASUREMENT
/begin MEASUREMENT vADVFBAV "RAM value vADVFBAV" SWORD COMP_0078 1 100 -128 127.99609375 ECU_ADDRESS 0xFFFF225E READ_WRITE /end MEASUREMENT
/begin MEASUREMENT vADVHDI "RAM value vADVHDI" SBYTE COMP_0018 1 100 -128 127 ECU_ADDRESS 0xFFFF16FC READ_WRITE /end MEASUREMENT
/begin MEASUREMENT vADVHDI1 "RAM value vADVHDI1" SBYTE COMP_0018 1 100 -128 127 ECU_ADDRESS 0xFFFF16FD READ_WRITE /end MEASUREMENT
/begin MEASUREMENT vADVHOS "RAM value vADVHOS" SWORD COMP_0018 1 100 -32768 32767 ECU_ADDRESS 0xFFFF0946 READ_WRITE /end MEASUREMENT
/begin MEASUREMENT vADVHOSAT "RAM value vADVHOSAT" SWORD COMP_0018 1 100 -32768 32767 ECU_ADDRESS 0xFFFF0948 READ_WRITE /end MEASUREMENT
/begin MEASUREMENT vADVIT1 "RAM value vADVIT1" UBYTE COMP_0017 1 100 0 255 ECU_ADDRESS 0xFFFF3A06 READ_WRITE /end MEASUREMENT
/begin MEASUREMENT vADVIT1AP "RAM value vADVIT1AP" UBYTE COMP_0017 1 100 0 255 ECU_ADDRESS 0xFFFF3B3E READ_WRITE /end MEASUREMENT
/begin MEASUREMENT vADVIT2 "RAM value vADVIT2" UBYTE COMP_0017 1 100 0 255 ECU_ADDRESS 0xFFFF3A07 READ_WRITE /end MEASUREMENT
/begin MEASUREMENT vADVIT2AP "RAM value vADVIT2AP" UBYTE COMP_0017 1 100 0 255 ECU_ADDRESS 0xFFFF3B3F READ_WRITE /end MEASUREMENT
/begin MEASUREMENT vADVJAR "RAM value vADVJAR" UBYTE COMP_0017 1 100 0 255 ECU_ADDRESS 0xFFFF0A10 READ_WRITE /end MEASUREMENT
/begin MEASUREMENT vADVJMP "RAM value vADVJMP" UBYTE COMP_0245 1 100 -64 191 ECU_ADDRESS 0xFFFF1B00 READ_WRITE /end MEASUREMENT
/begin MEASUREMENT vADVJMPF "RAM value vADVJMPF" UWORD COMP_0491_S 1 100 -64 191.99609375 ECU_ADDRESS 0xFFFF0A12 READ_WRITE /end MEASUREMENT
/begin MEASUREMENT vADVJMPFA "RAM value vADVJMPFA" UWORD COMP_0491_S 1 100 -64 191.99609375 ECU_ADDRESS 0xFFFF0A14 READ_WRITE /end MEASUREMENT
/begin MEASUREMENT vADVKIR "RAM value vADVKIR" UBYTE COMP_0245 1 100 -64 191 ECU_ADDRESS 0xFFFF20F0 READ_WRITE /end MEASUREMENT
/begin MEASUREMENT vADVKIRI "RAM value vADVKIRI" SBYTE COMP_0018 1 100 -128 127 ECU_ADDRESS 0xFFFF16FE READ_WRITE /end MEASUREMENT
/begin MEASUREMENT vADVKIRIN "RAM value vADVKIRIN" UBYTE COMP_0245 1 100 -64 191 ECU_ADDRESS 0xFFFF16FF READ_WRITE /end MEASUREMENT
/begin MEASUREMENT vADVKIRTW "RAM value vADVKIRTW" UBYTE COMP_0245 1 100 -64 191 ECU_ADDRESS 0xFFFF1700 READ_WRITE /end MEASUREMENT
/begin MEASUREMENT vADVMAX "RAM value vADVMAX" SBYTE COMP_0018 1 100 -128 127 ECU_ADDRESS 0xFFFF4430 READ_WRITE /end MEASUREMENT
/begin MEASUREMENT vADVMB1_S "RAM value vADVMB1_S" UWORD COMP_0023 1 100 0 327675 ECU_ADDRESS 0xFFFF30D2 READ_WRITE /end MEASUREMENT
/begin MEASUREMENT vADVMIN "RAM value vADVMIN" SBYTE COMP_0018 1 100 -128 127 ECU_ADDRESS 0xFFFF4431 READ_WRITE /end MEASUREMENT
/begin MEASUREMENT vADVMOT "RAM value vADVMOT" UWORD COMP_0023 1 100 0 327675 ECU_ADDRESS 0xFFFF30A0 READ_WRITE /end MEASUREMENT
/begin MEASUREMENT vADVMV2 "RAM value vADVMV2" UWORD COMP_0023 1 100 0 327675 ECU_ADDRESS 0xFFFF30A2 READ_WRITE /end MEASUREMENT
/begin MEASUREMENT vADVMVAB1 "RAM value vADVMVAB1" UWORD COMP_0023 1 100 0 327675 ECU_ADDRESS 0xFFFF30A4 READ_WRITE /end MEASUREMENT
/begin MEASUREMENT vADVNLIM "RAM value vADVNLIM" UBYTE COMP_0250_S 1 100 -128 127 ECU_ADDRESS 0xFFFF1701 READ_WRITE /end MEASUREMENT
/begin MEASUREMENT vADVO2F "RAM value vADVO2F" UWORD COMP_0023 1 100 0 327675 ECU_ADDRESS 0xFFFF1532 READ_WRITE /end MEASUREMENT
/begin MEASUREMENT vADVO2HR "RAM value vADVO2HR" UWORD COMP_0023 1 100 0 327675 ECU_ADDRESS 0xFFFF1534 READ_WRITE /end MEASUREMENT
/begin MEASUREMENT vADVO2HTR "RAM value vADVO2HTR" UWORD COMP_0023 1 100 0 327675 ECU_ADDRESS 0xFFFF15B6 READ_WRITE /end MEASUREMENT
/begin MEASUREMENT vADVO2R "RAM value vADVO2R" UWORD COMP_0023 1 100 0 327675 ECU_ADDRESS 0xFFFF1DBE READ_WRITE /end MEASUREMENT
/begin MEASUREMENT vADVO2TR "RAM value vADVO2TR" UWORD COMP_0023 1 100 0 327675 ECU_ADDRESS 0xFFFF33A4 READ_WRITE /end MEASUREMENT
/begin MEASUREMENT vADVOCT "RAM value vADVOCT" UBYTE COMP_0366_S 1 100 0 0.124511655 ECU_ADDRESS 0xFFFF0A16 READ_WRITE /end MEASUREMENT
/begin MEASUREMENT vADVSDI "RAM value vADVSDI" SBYTE COMP_0018 1 100 -128 127 ECU_ADDRESS 0xFFFF1702 READ_WRITE /end MEASUREMENT
/begin MEASUREMENT vADVSHOF "RAM value vADVSHOF" SWORD COMP_0078 1 100 -128 127.99609375 ECU_ADDRESS 0xFFFF1704 READ_WRITE /end MEASUREMENT
/begin MEASUREMENT vADVSL "RAM value vADVSL" UWORD COMP_0403_S 1 100 0 3276750 ECU_ADDRESS 0xFFFF2260 READ_WRITE /end MEASUREMENT
/begin MEASUREMENT vADVTCME1 "RAM value vADVTCME1" UWORD COMP_0023 1 100 0 327675 ECU_ADDRESS 0xFFFF1DFC READ_WRITE /end MEASUREMENT
/begin MEASUREMENT vADVTCMI1 "RAM value vADVTCMI1" UWORD COMP_0023 1 100 0 327675 ECU_ADDRESS 0xFFFF1DFE READ_WRITE /end MEASUREMENT
/begin MEASUREMENT vADVTEGF0 "RAM value vADVTEGF0" SWORD COMP_0078 1 100 -128 127.99609375 ECU_ADDRESS 0xFFFF0A18 READ_WRITE /end MEASUREMENT
/begin MEASUREMENT vADVTEMH "RAM value vADVTEMH" UWORD COMP_0017 1 100 0 65535 ECU_ADDRESS 0xFFFF1706 READ_WRITE /end MEASUREMENT
/begin MEASUREMENT vADVTENG "RAM value vADVTENG" SBYTE COMP_0018 1 100 -128 127 ECU_ADDRESS 0xFFFF094A READ_WRITE /end MEASUREMENT
/begin MEASUREMENT vADVTENGF "RAM value vADVTENGF" SBYTE COMP_0018 1 100 -128 127 ECU_ADDRESS 0xFFFF0A1A READ_WRITE /end MEASUREMENT
/begin MEASUREMENT vADVTMP "RAM value vADVTMP" SLONG COMP_0018 1 100 -2147483648 2147483647 ECU_ADDRESS 0xFFFF1708 READ_WRITE /end MEASUREMENT
/begin MEASUREMENT vADVTRM "RAM value vADVTRM" UBYTE COMP_0245 1 100 -64 191 ECU_ADDRESS 0xFFFF1B01 READ_WRITE /end MEASUREMENT
/begin MEASUREMENT vADVTRMHR "RAM value vADVTRMHR" UBYTE COMP_0017 1 100 0 255 ECU_ADDRESS 0xFFFF0A1B READ_WRITE /end MEASUREMENT
/begin MEASUREMENT vADVTRST "RAM value vADVTRST" UBYTE COMP_0245 1 100 -64 191 ECU_ADDRESS 0xFFFF1B02 READ_WRITE /end MEASUREMENT
/begin MEASUREMENT vADVTRSTF "RAM value vADVTRSTF" UWORD COMP_0516 1 100 -64 191.99609375 ECU_ADDRESS 0xFFFF0A1C READ_WRITE /end MEASUREMENT
/begin MEASUREMENT vAFASCNT1 "RAM value vAFASCNT1" UWORD COMP_0016 1 100 0 65535 ECU_ADDRESS 0xFFFF5102 READ_WRITE /end MEASUREMENT
/begin MEASUREMENT vAFASCNT2 "RAM value vAFASCNT2" UWORD COMP_0016 1 100 0 65535 ECU_ADDRESS 0xFFFF5104 READ_WRITE /end MEASUREMENT
/begin MEASUREMENT vAFASTRP1 "RAM value vAFASTRP1" UWORD COMP_0016 1 100 0 65535 ECU_ADDRESS 0xFFFF5106 READ_WRITE /end MEASUREMENT
/begin MEASUREMENT vAFASTRP2 "RAM value vAFASTRP2" UWORD COMP_0016 1 100 0 65535 ECU_ADDRESS 0xFFFF5108 READ_WRITE /end MEASUREMENT
/begin MEASUREMENT vAFAVCALf "RAM value vAFAVCALf" UBYTE COMP_0004 1 100 0 255 ECU_ADDRESS 0xFFFF0A1E READ_WRITE /end MEASUREMENT
/begin MEASUREMENT vAFAVf "RAM value vAFAVf" UBYTE COMP_0004 1 100 0 255 ECU_ADDRESS 0xFFFF0A1F READ_WRITE /end MEASUREMENT
/begin MEASUREMENT vAFBINTf "RAM value vAFBINTf" UBYTE COMP_0004 1 100 0 255 ECU_ADDRESS 0xFFFF0A20 READ_WRITE /end MEASUREMENT
/begin MEASUREMENT vAFC "RAM value vAFC" UWORD COMP_0023 1 100 0 327675 ECU_ADDRESS 0xFFFF33A6 READ_WRITE /end MEASUREMENT
/begin MEASUREMENT vAFC10 "RAM value vAFC10" UWORD COMP_0023 1 100 0 327675 ECU_ADDRESS 0xFFFF33AA READ_WRITE /end MEASUREMENT
/begin MEASUREMENT vAFC10CNT "RAM value vAFC10CNT" UBYTE COMP_0014 1 100 0 2550 ECU_ADDRESS 0xFFFF33D2 READ_WRITE /end MEASUREMENT
/begin MEASUREMENT vAFCLIDL "RAM value vAFCLIDL" UWORD COMP_0453 1 100 0 131.07 ECU_ADDRESS 0xFFFF2262 READ_WRITE /end MEASUREMENT
/begin MEASUREMENT vAFCLPRT "RAM value vAFCLPRT" UWORD COMP_0453 1 100 0 131.07 ECU_ADDRESS 0xFFFF2264 READ_WRITE /end MEASUREMENT
/begin MEASUREMENT vAFCLT1A "RAM value vAFCLT1A" UBYTE COMP_0250 1 100 0 1020 ECU_ADDRESS 0xFFFF32F8 READ_WRITE /end MEASUREMENT
/begin MEASUREMENT vAFCLT1B "RAM value vAFCLT1B" UBYTE COMP_0250 1 100 0 1020 ECU_ADDRESS 0xFFFF32F9 READ_WRITE /end MEASUREMENT
/begin MEASUREMENT vAFCLT2 "RAM value vAFCLT2" UBYTE COMP_0014 1 100 0 2550 ECU_ADDRESS 0xFFFF33D3 READ_WRITE /end MEASUREMENT
/begin MEASUREMENT vAFCLTMST "RAM value vAFCLTMST" UBYTE COMP_0068 1 100 0 255 ECU_ADDRESS 0xFFFF3B40 READ_WRITE /end MEASUREMENT
/begin MEASUREMENT vAFDALPf "RAM value vAFDALPf" UBYTE COMP_0004 1 100 0 255 ECU_ADDRESS 0xFFFF2266 READ_WRITE /end MEASUREMENT
/begin MEASUREMENT vAFDLTG_B "RAM value vAFDLTG_B" UWORD COMP_0130 1 100 0 1802.2125 ECU_ADDRESS 0xFFFF2268 READ_WRITE /end MEASUREMENT
/begin MEASUREMENT vAFDLTTVO "RAM value vAFDLTTVO" UWORD COMP_0130 1 100 0 1802.2125 ECU_ADDRESS 0xFFFF226C READ_WRITE /end MEASUREMENT
/begin MEASUREMENT vAFDRGf "RAM value vAFDRGf" UBYTE COMP_0004 1 100 0 255 ECU_ADDRESS 0xFFFF226E READ_WRITE /end MEASUREMENT
/begin MEASUREMENT vAFDTGTf "RAM value vAFDTGTf" UBYTE COMP_0004 1 100 0 255 ECU_ADDRESS 0xFFFF226F READ_WRITE /end MEASUREMENT
/begin MEASUREMENT vAFHCAL10 "RAM value vAFHCAL10" UBYTE COMP_0014 1 100 0 2550 ECU_ADDRESS 0xFFFF33D4 READ_WRITE /end MEASUREMENT
/begin MEASUREMENT vAFHCONTf "RAM value vAFHCONTf" UBYTE COMP_0004 1 100 0 255 ECU_ADDRESS 0xFFFF33D5 READ_WRITE /end MEASUREMENT
/begin MEASUREMENT vAFHDTY "RAM value vAFHDTY" UBYTE COMP_0027 1 100 0 255 ECU_ADDRESS 0xFFFF30A6 READ_WRITE /end MEASUREMENT
/begin MEASUREMENT vAFHDTYS "RAM value vAFHDTYS" UBYTE COMP_0027 1 100 0 255 ECU_ADDRESS 0xFFFF30A7 READ_WRITE /end MEASUREMENT
/begin MEASUREMENT vAFHDTYTMS "RAM value vAFHDTYTMS" UBYTE COMP_0053 1 100 0 255 ECU_ADDRESS 0xFFFF30A8 READ_WRITE /end MEASUREMENT
/begin MEASUREMENT vAFHDWNTMS "RAM value vAFHDWNTMS" UBYTE COMP_0053 1 100 0 255 ECU_ADDRESS 0xFFFF30A9 READ_WRITE /end MEASUREMENT
/begin MEASUREMENT vAFHKANSHO "RAM value vAFHKANSHO" UBYTE COMP_0068 1 100 0 255 ECU_ADDRESS 0xFFFF30AA READ_WRITE /end MEASUREMENT
/begin MEASUREMENT vAFHMOD1Af "RAM value vAFHMOD1Af" UBYTE COMP_0004 1 100 0 255 ECU_ADDRESS 0xFFFF33D6 READ_WRITE /end MEASUREMENT
/begin MEASUREMENT vAFHMODEf "RAM value vAFHMODEf" UBYTE COMP_0068 1 100 0 255 ECU_ADDRESS 0xFFFF1FB2 READ_WRITE /end MEASUREMENT
/begin MEASUREMENT vAFHONf "RAM value vAFHONf" UBYTE COMP_0068 1 100 0 255 ECU_ADDRESS 0xFFFF1FB3 READ_WRITE /end MEASUREMENT
/begin MEASUREMENT vAFHZCALf "RAM value vAFHZCALf" UBYTE COMP_0004 1 100 0 255 ECU_ADDRESS 0xFFFF0A21 READ_WRITE /end MEASUREMENT
/begin MEASUREMENT vAFHZGOf "RAM value vAFHZGOf" UBYTE COMP_0004 1 100 0 255 ECU_ADDRESS 0xFFFF2270 READ_WRITE /end MEASUREMENT
/begin MEASUREMENT vAFHZLROKf "RAM value vAFHZLROKf" UBYTE COMP_0004 1 100 0 255 ECU_ADDRESS 0xFFFF2271 READ_WRITE /end MEASUREMENT
/begin MEASUREMENT vAFHZRCVf "RAM value vAFHZRCVf" UBYTE COMP_0004 1 100 0 255 ECU_ADDRESS 0xFFFF0A23 READ_WRITE /end MEASUREMENT
/begin MEASUREMENT vAFHZRLOKf "RAM value vAFHZRLOKf" UBYTE COMP_0004 1 100 0 255 ECU_ADDRESS 0xFFFF2272 READ_WRITE /end MEASUREMENT
/begin MEASUREMENT vAFHZf "RAM value vAFHZf" UBYTE COMP_0004 1 100 0 255 ECU_ADDRESS 0xFFFF0A22 READ_WRITE /end MEASUREMENT
/begin MEASUREMENT vAFIOUT "RAM value vAFIOUT" UWORD COMP_0023 1 100 0 327675 ECU_ADDRESS 0xFFFF30AC READ_WRITE /end MEASUREMENT
/begin MEASUREMENT vAFKDENDf "RAM value vAFKDENDf" UBYTE COMP_0004 1 100 0 255 ECU_ADDRESS 0xFFFF2273 READ_WRITE /end MEASUREMENT
/begin MEASUREMENT vAFKDSTf "RAM value vAFKDSTf" UBYTE COMP_0004 1 100 0 255 ECU_ADDRESS 0xFFFF2274 READ_WRITE /end MEASUREMENT
/begin MEASUREMENT vAFKMRH "RAM value vAFKMRH" UBYTE COMP_0009 1 100 0 199.21875 ECU_ADDRESS 0xFFFF0A24 READ_WRITE /end MEASUREMENT
/begin MEASUREMENT vAFLE "RAM value vAFLE" SWORD COMP_0264 1 100 -32768 32767 ECU_ADDRESS 0xFFFF32FA READ_WRITE /end MEASUREMENT
/begin MEASUREMENT vAFLE_2 "RAM value vAFLE_2" SWORD COMP_0263 1 100 -32768 32767 ECU_ADDRESS 0xFFFF30FA READ_WRITE /end MEASUREMENT
/begin MEASUREMENT vAFLRACEND "RAM value vAFLRACEND" UBYTE COMP_0004 1 100 0 255 ECU_ADDRESS 0xFFFF2275 READ_WRITE /end MEASUREMENT
/begin MEASUREMENT vAFLRENDf "RAM value vAFLRENDf" UBYTE COMP_0004 1 100 0 255 ECU_ADDRESS 0xFFFF2276 READ_WRITE /end MEASUREMENT
/begin MEASUREMENT vAFLSTRPf "RAM value vAFLSTRPf" UBYTE COMP_0004 1 100 0 255 ECU_ADDRESS 0xFFFF2277 READ_WRITE /end MEASUREMENT
/begin MEASUREMENT vAFM "RAM value vAFM" UWORD COMP_0370 1 100 0 163837.5 ECU_ADDRESS 0xFFFF3A08 READ_WRITE /end MEASUREMENT
/begin MEASUREMENT vAFMDG "RAM value vAFMDG" UWORD COMP_0063 1 100 0 255.99609375 ECU_ADDRESS 0xFFFF2278 READ_WRITE /end MEASUREMENT
/begin MEASUREMENT vAFMDGAV "RAM value vAFMDGAV" UWORD COMP_0063 1 100 0 255.99609375 ECU_ADDRESS 0xFFFF4432 READ_WRITE /end MEASUREMENT
/begin MEASUREMENT vAFMDGB "RAM value vAFMDGB" UWORD COMP_0063 1 100 0 255.99609375 ECU_ADDRESS 0xFFFF227A READ_WRITE /end MEASUREMENT
/begin MEASUREMENT vAFMDGBKf "RAM value vAFMDGBKf" UBYTE COMP_0068 1 100 0 255 ECU_ADDRESS 0xFFFF227C READ_WRITE /end MEASUREMENT
/begin MEASUREMENT vAFMDGMN "RAM value vAFMDGMN" UWORD COMP_0063 1 100 0 255.99609375 ECU_ADDRESS 0xFFFF4434 READ_WRITE /end MEASUREMENT
/begin MEASUREMENT vAFMDGMON "RAM value vAFMDGMON" UWORD COMP_0063 1 100 0 255.99609375 ECU_ADDRESS 0xFFFF20F8 READ_WRITE /end MEASUREMENT
/begin MEASUREMENT vAFMDGMX "RAM value vAFMDGMX" UWORD COMP_0063 1 100 0 255.99609375 ECU_ADDRESS 0xFFFF4436 READ_WRITE /end MEASUREMENT
/begin MEASUREMENT vAFMDTVCBf "RAM value vAFMDTVCBf" UBYTE COMP_0068 1 100 0 255 ECU_ADDRESS 0xFFFF227D READ_WRITE /end MEASUREMENT
/begin MEASUREMENT vAFMIMIN "RAM value vAFMIMIN" UBYTE COMP_0014 1 100 0 2550 ECU_ADDRESS 0xFFFF4438 READ_WRITE /end MEASUREMENT
/begin MEASUREMENT vAFMLMTTM "RAM value vAFMLMTTM" UBYTE COMP_0014 1 100 0 2550 ECU_ADDRESS 0xFFFF33D7 READ_WRITE /end MEASUREMENT
/begin MEASUREMENT vAFMNCNT "RAM value vAFMNCNT" UBYTE COMP_0030 1 100 0 255 ECU_ADDRESS 0xFFFF4439 READ_WRITE /end MEASUREMENT
/begin MEASUREMENT vAFMNEMN "RAM value vAFMNEMN" UWORD COMP_0492_S 1 100 0 204796.875 ECU_ADDRESS 0xFFFF443A READ_WRITE /end MEASUREMENT
/begin MEASUREMENT vAFMNEMX "RAM value vAFMNEMX" UWORD COMP_0492_S 1 100 0 204796.875 ECU_ADDRESS 0xFFFF443C READ_WRITE /end MEASUREMENT
/begin MEASUREMENT vAFMNGOF "RAM value vAFMNGOF" UWORD COMP_0367_S 1 100 -128 127.99609375 ECU_ADDRESS 0xFFFF227E READ_WRITE /end MEASUREMENT
/begin MEASUREMENT vAFMODE "RAM value vAFMODE" UBYTE COMP_0068 1 100 0 255 ECU_ADDRESS 0xFFFF33D8 READ_WRITE /end MEASUREMENT
/begin MEASUREMENT vAFMODE1Cf "RAM value vAFMODE1Cf" UBYTE COMP_0004 1 100 0 255 ECU_ADDRESS 0xFFFF33D9 READ_WRITE /end MEASUREMENT
/begin MEASUREMENT vAFMTVLBf "RAM value vAFMTVLBf" UBYTE COMP_0068 1 100 0 255 ECU_ADDRESS 0xFFFF2280 READ_WRITE /end MEASUREMENT
/begin MEASUREMENT vAFO "RAM value vAFO" UWORD COMP_0023 1 100 0 327675 ECU_ADDRESS 0xFFFF33DA READ_WRITE /end MEASUREMENT
/begin MEASUREMENT vAFOFLGf "RAM value vAFOFLGf" UBYTE COMP_0004 1 100 0 255 ECU_ADDRESS 0xFFFF2281 READ_WRITE /end MEASUREMENT
/begin MEASUREMENT vAFOHONOf "RAM value vAFOHONOf" UBYTE COMP_0004 1 100 0 255 ECU_ADDRESS 0xFFFF2282 READ_WRITE /end MEASUREMENT
/begin MEASUREMENT vAFOINH "RAM value vAFOINH" UBYTE COMP_0068 1 100 0 255 ECU_ADDRESS 0xFFFF30B0 READ_WRITE /end MEASUREMENT
/begin MEASUREMENT vAFOKf "RAM value vAFOKf" UBYTE COMP_0004 1 100 0 255 ECU_ADDRESS 0xFFFF2283 READ_WRITE /end MEASUREMENT
/begin MEASUREMENT vAFOPMINW "RAM value vAFOPMINW" UWORD COMP_0014 1 100 0 655350 ECU_ADDRESS 0xFFFF443E READ_WRITE /end MEASUREMENT
/begin MEASUREMENT vAFP "RAM value vAFP" UWORD COMP_0370 1 100 0 163837.5 ECU_ADDRESS 0xFFFF3A0A READ_WRITE /end MEASUREMENT
/begin MEASUREMENT vAFRLACEND "RAM value vAFRLACEND" UBYTE COMP_0004 1 100 0 255 ECU_ADDRESS 0xFFFF2284 READ_WRITE /end MEASUREMENT
/begin MEASUREMENT vAFRLENDf "RAM value vAFRLENDf" UBYTE COMP_0004 1 100 0 255 ECU_ADDRESS 0xFFFF2285 READ_WRITE /end MEASUREMENT
/begin MEASUREMENT vAFRSTRPf "RAM value vAFRSTRPf" UBYTE COMP_0004 1 100 0 255 ECU_ADDRESS 0xFFFF2286 READ_WRITE /end MEASUREMENT
/begin MEASUREMENT vAFS "RAM value vAFS" UWORD COMP_0023 1 100 0 327675 ECU_ADDRESS 0xFFFF1FB4 READ_WRITE /end MEASUREMENT
/begin MEASUREMENT vAFSACTMf "RAM value vAFSACTMf" UBYTE COMP_0004 1 100 0 255 ECU_ADDRESS 0xFFFF2287 READ_WRITE /end MEASUREMENT
/begin MEASUREMENT vAFSAF "RAM value vAFSAF" UWORD COMP_0453 1 100 0 131.07 ECU_ADDRESS 0xFFFF3B42 READ_WRITE /end MEASUREMENT
/begin MEASUREMENT vAFSAFDT "RAM value vAFSAFDT" UBYTE COMP_0429_S 1 100 0 5.1 ECU_ADDRESS 0xFFFF2288 READ_WRITE /end MEASUREMENT
/begin MEASUREMENT vAFSAFJG "RAM value vAFSAFJG" UWORD COMP_0453 1 100 0 131.07 ECU_ADDRESS 0xFFFF228A READ_WRITE /end MEASUREMENT
/begin MEASUREMENT vAFSAVENDf "RAM value vAFSAVENDf" UBYTE COMP_0004 1 100 0 255 ECU_ADDRESS 0xFFFF228C READ_WRITE /end MEASUREMENT
/begin MEASUREMENT vAFSCLPf "RAM value vAFSCLPf" UBYTE COMP_0004 1 100 0 255 ECU_ADDRESS 0xFFFF0A25 READ_WRITE /end MEASUREMENT
/begin MEASUREMENT vAFSCNL2 "RAM value vAFSCNL2" UBYTE COMP_0030 1 100 0 255 ECU_ADDRESS 0xFFFF228D READ_WRITE /end MEASUREMENT
/begin MEASUREMENT vAFSCNL3 "RAM value vAFSCNL3" UBYTE COMP_0030 1 100 0 255 ECU_ADDRESS 0xFFFF228F READ_WRITE /end MEASUREMENT
/begin MEASUREMENT vAFSCNR2 "RAM value vAFSCNR2" UBYTE COMP_0030 1 100 0 255 ECU_ADDRESS 0xFFFF2291 READ_WRITE /end MEASUREMENT
/begin MEASUREMENT vAFSCNR3 "RAM value vAFSCNR3" UBYTE COMP_0030 1 100 0 255 ECU_ADDRESS 0xFFFF2293 READ_WRITE /end MEASUREMENT
/begin MEASUREMENT vAFSFTC "RAM value vAFSFTC" UBYTE COMP_0016 1 100 0 255 ECU_ADDRESS 0xFFFF0A26 READ_WRITE /end MEASUREMENT
/begin MEASUREMENT vAFSGAIN "RAM value vAFSGAIN" UWORD COMP_0217 1 100 0 3.999941832 ECU_ADDRESS 0xFFFF4440 READ_WRITE /end MEASUREMENT
/begin MEASUREMENT vAFSGAVE "RAM value vAFSGAVE" UWORD COMP_0217 1 100 0 3.999941832 ECU_ADDRESS 0xFFFF2296 READ_WRITE /end MEASUREMENT
/begin MEASUREMENT vAFSGCNT "RAM value vAFSGCNT" UWORD COMP_0016 1 100 0 65535 ECU_ADDRESS 0xFFFF229A READ_WRITE /end MEASUREMENT
/begin MEASUREMENT vAFSHDM "RAM value vAFSHDM" SWORD COMP_0020_S 1 100 -65.536 65.534 ECU_ADDRESS 0xFFFF0A28 READ_WRITE /end MEASUREMENT
/begin MEASUREMENT vAFSHDTY "RAM value vAFSHDTY" UWORD COMP_0419 1 100 0 6553.5 ECU_ADDRESS 0xFFFF1FB8 READ_WRITE /end MEASUREMENT
/begin MEASUREMENT vAFSHDTY1 "RAM value vAFSHDTY1" UBYTE COMP_0493_S 1 100 0 102 ECU_ADDRESS 0xFFFF33DE READ_WRITE /end MEASUREMENT
/begin MEASUREMENT vAFSHMINW "RAM value vAFSHMINW" UWORD COMP_0014 1 100 0 655350 ECU_ADDRESS 0xFFFF4444 READ_WRITE /end MEASUREMENT
/begin MEASUREMENT vAFSHOS "RAM value vAFSHOS" SWORD COMP_0020_S 1 100 -65.536 65.534 ECU_ADDRESS 0xFFFF4446 READ_WRITE /end MEASUREMENT
/begin MEASUREMENT vAFSHOSC "RAM value vAFSHOSC" UBYTE COMP_0030 1 100 0 255 ECU_ADDRESS 0xFFFF229E READ_WRITE /end MEASUREMENT
/begin MEASUREMENT vAFSMAX "RAM value vAFSMAX" UWORD COMP_0023 1 100 0 327675 ECU_ADDRESS 0xFFFF22A0 READ_WRITE /end MEASUREMENT
/begin MEASUREMENT vAFSMIN "RAM value vAFSMIN" UWORD COMP_0023 1 100 0 327675 ECU_ADDRESS 0xFFFF22A2 READ_WRITE /end MEASUREMENT
/begin MEASUREMENT vAFSMN "RAM value vAFSMN" UWORD COMP_0023 1 100 0 327675 ECU_ADDRESS 0xFFFF22A4 READ_WRITE /end MEASUREMENT
/begin MEASUREMENT vAFSMX "RAM value vAFSMX" UWORD COMP_0023 1 100 0 327675 ECU_ADDRESS 0xFFFF22A6 READ_WRITE /end MEASUREMENT
/begin MEASUREMENT vAFSNG "RAM value vAFSNG" UWORD COMP_0023 1 100 0 327675 ECU_ADDRESS 0xFFFF22A8 READ_WRITE /end MEASUREMENT
/begin MEASUREMENT vAFSTARf "RAM value vAFSTARf" UBYTE COMP_0004 1 100 0 255 ECU_ADDRESS 0xFFFF22AC READ_WRITE /end MEASUREMENT
/begin MEASUREMENT vAFSTKJGf "RAM value vAFSTKJGf" UBYTE COMP_0004 1 100 0 255 ECU_ADDRESS 0xFFFF20FA READ_WRITE /end MEASUREMENT
/begin MEASUREMENT vAFSTKNGEf "RAM value vAFSTKNGEf" UBYTE COMP_0004 1 100 0 255 ECU_ADDRESS 0xFFFF22AD READ_WRITE /end MEASUREMENT
/begin MEASUREMENT vAFTMONCLf "RAM value vAFTMONCLf" UBYTE COMP_0004 1 100 0 255 ECU_ADDRESS 0xFFFF22AE READ_WRITE /end MEASUREMENT
/begin MEASUREMENT vAFVDRGf "RAM value vAFVDRGf" UBYTE COMP_0004 1 100 0 255 ECU_ADDRESS 0xFFFF22AF READ_WRITE /end MEASUREMENT
/begin MEASUREMENT vAFVNGBK "RAM value vAFVNGBK" UBYTE COMP_0016 1 100 0 255 ECU_ADDRESS 0xFFFF0A2C READ_WRITE /end MEASUREMENT
/begin MEASUREMENT vAFVNGBKC "RAM value vAFVNGBKC" UBYTE COMP_0016 1 100 0 255 ECU_ADDRESS 0xFFFF0A2D READ_WRITE /end MEASUREMENT
/begin MEASUREMENT vAFZ100 "RAM value vAFZ100" UBYTE COMP_0068 1 100 0 255 ECU_ADDRESS 0xFFFF30B1 READ_WRITE /end MEASUREMENT
/begin MEASUREMENT vAFZDWN "RAM value vAFZDWN" UBYTE COMP_0068 1 100 0 255 ECU_ADDRESS 0xFFFF30B2 READ_WRITE /end MEASUREMENT
/begin MEASUREMENT vAFZIOUT "RAM value vAFZIOUT" UBYTE COMP_0068 1 100 0 255 ECU_ADDRESS 0xFFFF30B3 READ_WRITE /end MEASUREMENT
/begin MEASUREMENT vAGBCKCNT "RAM value vAGBCKCNT" UBYTE COMP_0014 1 100 0 2550 ECU_ADDRESS 0xFFFF22B0 READ_WRITE /end MEASUREMENT
/begin MEASUREMENT vAGBCLCO2 "RAM value vAGBCLCO2" UBYTE COMP_0014 1 100 0 2550 ECU_ADDRESS 0xFFFF33DF READ_WRITE /end MEASUREMENT
/begin MEASUREMENT vAGBCLK2 "RAM value vAGBCLK2" UBYTE COMP_0068 1 100 0 255 ECU_ADDRESS 0xFFFF334C READ_WRITE /end MEASUREMENT
/begin MEASUREMENT vAGBCLOCK "RAM value vAGBCLOCK" UBYTE COMP_0068 1 100 0 255 ECU_ADDRESS 0xFFFF334D READ_WRITE /end MEASUREMENT
/begin MEASUREMENT vAGBDCLK2 "RAM value vAGBDCLK2" UBYTE COMP_0068 1 100 0 255 ECU_ADDRESS 0xFFFF33E0 READ_WRITE /end MEASUREMENT
/begin MEASUREMENT vAGBDLCLK "RAM value vAGBDLCLK" UBYTE COMP_0068 1 100 0 255 ECU_ADDRESS 0xFFFF1FBC READ_WRITE /end MEASUREMENT
/begin MEASUREMENT vAGBTQTYP "RAM value vAGBTQTYP" UBYTE COMP_0068 1 100 0 255 ECU_ADDRESS 0xFFFF33E1 READ_WRITE /end MEASUREMENT
/begin MEASUREMENT vAGBTUPNG "RAM value vAGBTUPNG" ULONG COMP_0196 1 100 0 429496729.5 ECU_ADDRESS 0xFFFF22B4 READ_WRITE /end MEASUREMENT
/begin MEASUREMENT vAHBAH1 "RAM value vAHBAH1" UWORD COMP_0023 1 100 0 327675 ECU_ADDRESS 0xFFFF444A READ_WRITE /end MEASUREMENT
/begin MEASUREMENT vAHBCNT1 "RAM value vAHBCNT1" UBYTE COMP_0016 1 100 0 255 ECU_ADDRESS 0xFFFF4460 READ_WRITE /end MEASUREMENT
/begin MEASUREMENT vAHBDY1 "RAM value vAHBDY1" UWORD COMP_0419 1 100 0 6553.5 ECU_ADDRESS 0xFFFF4462 READ_WRITE /end MEASUREMENT
/begin MEASUREMENT vAHBMN "RAM value vAHBMN" UBYTE COMP_0000 1 100 0 6375 ECU_ADDRESS 0xFFFF4478 READ_WRITE /end MEASUREMENT
/begin MEASUREMENT vAHBTP "RAM value vAHBTP" UWORD COMP_0144 1 100 0 31.999495335 ECU_ADDRESS 0xFFFF4484 READ_WRITE /end MEASUREMENT
/begin MEASUREMENT vAHBVB "RAM value vAHBVB" UBYTE COMP_0033 1 100 0 20400 ECU_ADDRESS 0xFFFF449A READ_WRITE /end MEASUREMENT
/begin MEASUREMENT vAHBVSP "RAM value vAHBVSP" UBYTE COMP_0007 1 100 0 510 ECU_ADDRESS 0xFFFF44A5 READ_WRITE /end MEASUREMENT
/begin MEASUREMENT vAHOSAV "RAM value vAHOSAV" SWORD COMP_0020_S 1 100 -65.536 65.534 ECU_ADDRESS 0xFFFF22B8 READ_WRITE /end MEASUREMENT
/begin MEASUREMENT vAHOSCT "RAM value vAHOSCT" UBYTE COMP_0030 1 100 0 255 ECU_ADDRESS 0xFFFF22BA READ_WRITE /end MEASUREMENT
/begin MEASUREMENT vAHOSINBLf "RAM value vAHOSINBLf" UBYTE COMP_0004 1 100 0 255 ECU_ADDRESS 0xFFFF22BB READ_WRITE /end MEASUREMENT
/begin MEASUREMENT vAHOSSM "RAM value vAHOSSM" SWORD COMP_0020_S 1 100 -65.536 65.534 ECU_ADDRESS 0xFFFF22BC READ_WRITE /end MEASUREMENT
/begin MEASUREMENT vAHOSTM "RAM value vAHOSTM" UBYTE COMP_0013 1 100 0 255 ECU_ADDRESS 0xFFFF22BE READ_WRITE /end MEASUREMENT
/begin MEASUREMENT vAHSMN1 "RAM value vAHSMN1" SWORD COMP_0020_S 1 100 -65.536 65.534 ECU_ADDRESS 0xFFFF44B0 READ_WRITE /end MEASUREMENT
/begin MEASUREMENT vAHSMN2 "RAM value vAHSMN2" UWORD COMP_0494_S 1 100 0 1685560.2 ECU_ADDRESS 0xFFFF44B2 READ_WRITE /end MEASUREMENT
/begin MEASUREMENT vAHSMX1 "RAM value vAHSMX1" SWORD COMP_0020_S 1 100 -65.536 65.534 ECU_ADDRESS 0xFFFF44B4 READ_WRITE /end MEASUREMENT
/begin MEASUREMENT vAHSMX2 "RAM value vAHSMX2" UWORD COMP_0494_S 1 100 0 1685560.2 ECU_ADDRESS 0xFFFF44B6 READ_WRITE /end MEASUREMENT
/begin MEASUREMENT vAHTMRCNT1 "RAM value vAHTMRCNT1" UBYTE COMP_0030 1 100 0 255 ECU_ADDRESS 0xFFFF22BF READ_WRITE /end MEASUREMENT
/begin MEASUREMENT vAIRDCV "RAM value vAIRDCV" UBYTE COMP_0045 1 100 0 1.9921875 ECU_ADDRESS 0xFFFF0A2E READ_WRITE /end MEASUREMENT
/begin MEASUREMENT vAISCMX "RAM value vAISCMX" UWORD COMP_0042 1 100 0 52.428 ECU_ADDRESS 0xFFFF15B8 READ_WRITE /end MEASUREMENT
/begin MEASUREMENT vAISCMX1 "RAM value vAISCMX1" UWORD COMP_0042 1 100 0 52.428 ECU_ADDRESS 0xFFFF0A30 READ_WRITE /end MEASUREMENT
/begin MEASUREMENT vAISCMX_S "RAM value vAISCMX_S" UWORD COMP_0042 1 100 0 52.428 ECU_ADDRESS 0xFFFF149C READ_WRITE /end MEASUREMENT
/begin MEASUREMENT vAISCNEH "RAM value vAISCNEH" UWORD COMP_0042 1 100 0 52.428 ECU_ADDRESS 0xFFFF0A32 READ_WRITE /end MEASUREMENT
/begin MEASUREMENT vAISCNH_S "RAM value vAISCNH_S" UWORD COMP_0042 1 100 0 52.428 ECU_ADDRESS 0xFFFF149E READ_WRITE /end MEASUREMENT
/begin MEASUREMENT vAISCTTC "RAM value vAISCTTC" UWORD COMP_0042 1 100 0 52.428 ECU_ADDRESS 0xFFFF22C0 READ_WRITE /end MEASUREMENT
/begin MEASUREMENT vAISMX1_S "RAM value vAISMX1_S" UWORD COMP_0042 1 100 0 52.428 ECU_ADDRESS 0xFFFF14A0 READ_WRITE /end MEASUREMENT
/begin MEASUREMENT vAJCURGP "RAM value vAJCURGP" UBYTE COMP_0068 1 100 0 255 ECU_ADDRESS 0xFFFF0A34 READ_WRITE /end MEASUREMENT
/begin MEASUREMENT vAJT0TQOW "RAM value vAJT0TQOW" SWORD COMP_0228 1 100 -3276.8 3276.7 ECU_ADDRESS 0xFFFF0A36 READ_WRITE /end MEASUREMENT
/begin MEASUREMENT vAJTGREV "RAM value vAJTGREV" UWORD COMP_0443 1 100 0 65535 ECU_ADDRESS 0xFFFF0A38 READ_WRITE /end MEASUREMENT
/begin MEASUREMENT vAJTQRMP "RAM value vAJTQRMP" UWORD COMP_0193 1 100 0 6553.5 ECU_ADDRESS 0xFFFF0A3A READ_WRITE /end MEASUREMENT
/begin MEASUREMENT vAJTQTRQ0 "RAM value vAJTQTRQ0" SWORD COMP_0228 1 100 -3276.8 3276.7 ECU_ADDRESS 0xFFFF0A3C READ_WRITE /end MEASUREMENT
/begin MEASUREMENT vAJTRQ "RAM value vAJTRQ" SWORD COMP_0228 1 100 -3276.8 3276.7 ECU_ADDRESS 0xFFFF0A3E READ_WRITE /end MEASUREMENT
/begin MEASUREMENT vAL1MN "RAM value vAL1MN" UBYTE COMP_0232 1 100 0 1.9921875 ECU_ADDRESS 0xFFFF44B8 READ_WRITE /end MEASUREMENT
/begin MEASUREMENT vAL2MN "RAM value vAL2MN" UBYTE COMP_0232 1 100 0 1.9921875 ECU_ADDRESS 0xFFFF44B9 READ_WRITE /end MEASUREMENT
/begin MEASUREMENT vAL3MN "RAM value vAL3MN" UBYTE COMP_0232 1 100 0 1.9921875 ECU_ADDRESS 0xFFFF44BA READ_WRITE /end MEASUREMENT
/begin MEASUREMENT vAL3MN0 "RAM value vAL3MN0" UBYTE COMP_0232 1 100 0 1.9921875 ECU_ADDRESS 0xFFFF44BB READ_WRITE /end MEASUREMENT
/begin MEASUREMENT vAL3MN2 "RAM value vAL3MN2" UBYTE COMP_0232 1 100 0 1.9921875 ECU_ADDRESS 0xFFFF44C3 READ_WRITE /end MEASUREMENT
/begin MEASUREMENT vALACT "RAM value vALACT" UWORD COMP_0063 1 100 0 255.99609375 ECU_ADDRESS 0xFFFF22C2 READ_WRITE /end MEASUREMENT
/begin MEASUREMENT vALACTAS "RAM value vALACTAS" UWORD COMP_0031 1 100 0 255.99609375 ECU_ADDRESS 0xFFFF22C6 READ_WRITE /end MEASUREMENT
/begin MEASUREMENT vALLATNO "RAM value vALLATNO" UBYTE COMP_0068 1 100 0 255 ECU_ADDRESS 0xFFFF4E54 READ_WRITE /end MEASUREMENT
/begin MEASUREMENT vALLATSUM "RAM value vALLATSUM" UBYTE COMP_0068 1 100 0 255 ECU_ADDRESS 0xFFFF4E55 READ_WRITE /end MEASUREMENT
/begin MEASUREMENT vALLGJDGIf "RAM value vALLGJDGIf" UBYTE COMP_0004 1 100 0 255 ECU_ADDRESS 0xFFFF22CA READ_WRITE /end MEASUREMENT
/begin MEASUREMENT vALLGJDGPf "RAM value vALLGJDGPf" UBYTE COMP_0004 1 100 0 255 ECU_ADDRESS 0xFFFF22CB READ_WRITE /end MEASUREMENT
/begin MEASUREMENT vALNENDf "RAM value vALNENDf" UBYTE COMP_0004 1 100 0 255 ECU_ADDRESS 0xFFFF22CC READ_WRITE /end MEASUREMENT
/begin MEASUREMENT vALNJDGf "RAM value vALNJDGf" UBYTE COMP_0004 1 100 0 255 ECU_ADDRESS 0xFFFF0A40 READ_WRITE /end MEASUREMENT
/begin MEASUREMENT vALOADCK "RAM value vALOADCK" UWORD COMP_0372 1 100 0 52.428 ECU_ADDRESS 0xFFFF0A42 READ_WRITE /end MEASUREMENT
/begin MEASUREMENT vALP1 "RAM value vALP1" UWORD COMP_0031 1 100 0 255.99609375 ECU_ADDRESS 0xFFFF0A44 READ_WRITE /end MEASUREMENT
/begin MEASUREMENT vALP2 "RAM value vALP2" UWORD COMP_0031 1 100 0 255.99609375 ECU_ADDRESS 0xFFFF0A48 READ_WRITE /end MEASUREMENT
/begin MEASUREMENT vALPC1 "RAM value vALPC1" UBYTE COMP_0068 1 100 0 255 ECU_ADDRESS 0xFFFF0A4C READ_WRITE /end MEASUREMENT
/begin MEASUREMENT vALPCAT "RAM value vALPCAT" UWORD COMP_0031 1 100 0 255.99609375 ECU_ADDRESS 0xFFFF22CE READ_WRITE /end MEASUREMENT
/begin MEASUREMENT vALPEVP "RAM value vALPEVP" UWORD COMP_0031 1 100 0 255.99609375 ECU_ADDRESS 0xFFFF0A4E READ_WRITE /end MEASUREMENT
/begin MEASUREMENT vALPEVP16 "RAM value vALPEVP16" UWORD COMP_0031 1 100 0 255.99609375 ECU_ADDRESS 0xFFFF0A52 READ_WRITE /end MEASUREMENT
/begin MEASUREMENT vALPHA0 "RAM value vALPHA0" UWORD COMP_0031 1 100 0 255.99609375 ECU_ADDRESS 0xFFFF20FC READ_WRITE /end MEASUREMENT
/begin MEASUREMENT vALPHAA "RAM value vALPHAA" UWORD COMP_0031 1 100 0 255.99609375 ECU_ADDRESS 0xFFFF3A54 READ_WRITE /end MEASUREMENT
/begin MEASUREMENT vALPHAAD "RAM value vALPHAAD" UWORD COMP_0031 1 100 0 255.99609375 ECU_ADDRESS 0xFFFF0A56 READ_WRITE /end MEASUREMENT
/begin MEASUREMENT vALPHAAV "RAM value vALPHAAV" UWORD COMP_0031 1 100 0 255.99609375 ECU_ADDRESS 0xFFFF0A58 READ_WRITE /end MEASUREMENT
/begin MEASUREMENT vALPHADT "RAM value vALPHADT" UBYTE COMP_0419 1 100 0 25.5 ECU_ADDRESS 0xFFFF0A5A READ_WRITE /end MEASUREMENT
/begin MEASUREMENT vALPHAMN "RAM value vALPHAMN" UWORD COMP_0031 1 100 0 255.99609375 ECU_ADDRESS 0xFFFF0A5C READ_WRITE /end MEASUREMENT
/begin MEASUREMENT vALPJDGEf "RAM value vALPJDGEf" UBYTE COMP_0004 1 100 0 255 ECU_ADDRESS 0xFFFF0A5E READ_WRITE /end MEASUREMENT
/begin MEASUREMENT vALPTBSDL "RAM value vALPTBSDL" UWORD COMP_0017_S 1 100 0 655.35 ECU_ADDRESS 0xFFFF22D2 READ_WRITE /end MEASUREMENT
/begin MEASUREMENT vALRNOKLf "RAM value vALRNOKLf" UBYTE COMP_0004 1 100 0 255 ECU_ADDRESS 0xFFFF0A5F READ_WRITE /end MEASUREMENT
/begin MEASUREMENT vALRNOKRf "RAM value vALRNOKRf" UBYTE COMP_0004 1 100 0 255 ECU_ADDRESS 0xFFFF0A60 READ_WRITE /end MEASUREMENT
/begin MEASUREMENT vALTCUR "RAM value vALTCUR" UWORD COMP_0495_S 1 100 -327.68 327.67 ECU_ADDRESS 0xFFFF22D4 READ_WRITE /end MEASUREMENT
/begin MEASUREMENT vALTDUTY "RAM value vALTDUTY" UBYTE COMP_0047 1 100 0 127.5 ECU_ADDRESS 0xFFFF3B46 READ_WRITE /end MEASUREMENT
/begin MEASUREMENT vALTDUTY0 "RAM value vALTDUTY0" UBYTE COMP_0047 1 100 0 127.5 ECU_ADDRESS 0xFFFF22D6 READ_WRITE /end MEASUREMENT
/begin MEASUREMENT vALTDUTYK "RAM value vALTDUTYK" UBYTE COMP_0047 1 100 0 127.5 ECU_ADDRESS 0xFFFF22D7 READ_WRITE /end MEASUREMENT
/begin MEASUREMENT vALTES "RAM value vALTES" ULONG COMP_0063 1 100 0 16777215.9960938 ECU_ADDRESS 0xFFFF22D8 READ_WRITE /end MEASUREMENT
/begin MEASUREMENT vALTES0 "RAM value vALTES0" UBYTE COMP_0063 1 100 0 0.99609375 ECU_ADDRESS 0xFFFF22DC READ_WRITE /end MEASUREMENT
/begin MEASUREMENT vALTESAVE "RAM value vALTESAVE" UBYTE COMP_0063 1 100 0 0.99609375 ECU_ADDRESS 0xFFFF44C4 READ_WRITE /end MEASUREMENT
/begin MEASUREMENT vALTESCNT "RAM value vALTESCNT" UWORD COMP_0016 1 100 0 65535 ECU_ADDRESS 0xFFFF22DE READ_WRITE /end MEASUREMENT
/begin MEASUREMENT vALTHOS "RAM value vALTHOS" UBYTE COMP_0009 1 100 0 199.21875 ECU_ADDRESS 0xFFFF22E0 READ_WRITE /end MEASUREMENT
/begin MEASUREMENT vALTMAX "RAM value vALTMAX" UBYTE COMP_0045_S 1 100 0 255 ECU_ADDRESS 0xFFFF22E1 READ_WRITE /end MEASUREMENT
/begin MEASUREMENT vALTTGTVG "RAM value vALTTGTVG" UBYTE COMP_0315 1 100 0 24.90075 ECU_ADDRESS 0xFFFF0A61 READ_WRITE /end MEASUREMENT
/begin MEASUREMENT vALTTPQLR "RAM value vALTTPQLR" UWORD COMP_0144 1 100 0 31.999495335 ECU_ADDRESS 0xFFFF22E2 READ_WRITE /end MEASUREMENT
/begin MEASUREMENT vALTTPTAN "RAM value vALTTPTAN" UWORD COMP_0144 1 100 0 31.999495335 ECU_ADDRESS 0xFFFF0A62 READ_WRITE /end MEASUREMENT
/begin MEASUREMENT vALTTRQ "RAM value vALTTRQ" UBYTE COMP_0131_S 1 100 0 127.5 ECU_ADDRESS 0xFFFF22E4 READ_WRITE /end MEASUREMENT
/begin MEASUREMENT vALTTRQ0 "RAM value vALTTRQ0" UBYTE COMP_0131_S 1 100 0 127.5 ECU_ADDRESS 0xFFFF22E5 READ_WRITE /end MEASUREMENT
/begin MEASUREMENT vALTVBH "RAM value vALTVBH" UBYTE COMP_0359 1 100 -64 63.5 ECU_ADDRESS 0xFFFF22E6 READ_WRITE /end MEASUREMENT
/begin MEASUREMENT vAM1DATA20 "RAM value vAM1DATA20" UBYTE COMP_0068 1 100 0 255 ECU_ADDRESS 0xFFFF1FBD READ_WRITE /end MEASUREMENT
/begin MEASUREMENT vAM1DATA21 "RAM value vAM1DATA21" UBYTE COMP_0068 1 100 0 255 ECU_ADDRESS 0xFFFF1FBE READ_WRITE /end MEASUREMENT
/begin MEASUREMENT vAM1DATA30 "RAM value vAM1DATA30" UBYTE COMP_0068 1 100 0 255 ECU_ADDRESS 0xFFFF1FBF READ_WRITE /end MEASUREMENT
/begin MEASUREMENT vAM1DATA31 "RAM value vAM1DATA31" UBYTE COMP_0068 1 100 0 255 ECU_ADDRESS 0xFFFF1FC0 READ_WRITE /end MEASUREMENT
/begin MEASUREMENT vAM1DATA32 "RAM value vAM1DATA32" UBYTE COMP_0068 1 100 0 255 ECU_ADDRESS 0xFFFF1FC1 READ_WRITE /end MEASUREMENT
/begin MEASUREMENT vAM1DATA40 "RAM value vAM1DATA40" UBYTE COMP_0068 1 100 0 255 ECU_ADDRESS 0xFFFF1FC2 READ_WRITE /end MEASUREMENT
/begin MEASUREMENT vAM1DATA41 "RAM value vAM1DATA41" UBYTE COMP_0068 1 100 0 255 ECU_ADDRESS 0xFFFF1FC3 READ_WRITE /end MEASUREMENT
/begin MEASUREMENT vAM1DATA42 "RAM value vAM1DATA42" UBYTE COMP_0068 1 100 0 255 ECU_ADDRESS 0xFFFF1FC4 READ_WRITE /end MEASUREMENT
/begin MEASUREMENT vAM1DATA43 "RAM value vAM1DATA43" UBYTE COMP_0068 1 100 0 255 ECU_ADDRESS 0xFFFF33E2 READ_WRITE /end MEASUREMENT
/begin MEASUREMENT vAM1DT6 "RAM value vAM1DT6" UBYTE COMP_0068 1 100 0 255 ECU_ADDRESS 0xFFFF33E3 READ_WRITE /end MEASUREMENT
/begin MEASUREMENT vAM1DT7 "RAM value vAM1DT7" UBYTE COMP_0068 1 100 0 255 ECU_ADDRESS 0xFFFF33E4 READ_WRITE /end MEASUREMENT
/begin MEASUREMENT vAMIADRET "RAM value vAMIADRET" SBYTE COMP_0018 1 100 -128 127 ECU_ADDRESS 0xFFFF22E7 READ_WRITE /end MEASUREMENT
/begin MEASUREMENT vAN "RAM value vAN" UWORD COMP_0023 1 100 0 327675 ECU_ADDRESS 0xFFFF22E8 READ_WRITE /end MEASUREMENT
/begin MEASUREMENT vANGOCT1 "RAM value vANGOCT1" UWORD COMP_0496_S 1 100 0 13743685632 ECU_ADDRESS 0xFFFF0A64 READ_WRITE /end MEASUREMENT
/begin MEASUREMENT vANGOCT2 "RAM value vANGOCT2" UWORD COMP_0496_S 1 100 0 13743685632 ECU_ADDRESS 0xFFFF0A66 READ_WRITE /end MEASUREMENT
/begin MEASUREMENT vANGOV "RAM value vANGOV" UBYTE COMP_0017 1 100 0 255 ECU_ADDRESS 0xFFFF0A68 READ_WRITE /end MEASUREMENT
/begin MEASUREMENT vANGTM "RAM value vANGTM" UBYTE COMP_0055 1 100 0 1020 ECU_ADDRESS 0xFFFF1B03 READ_WRITE /end MEASUREMENT
/begin MEASUREMENT vANGTMH "RAM value vANGTMH" UBYTE COMP_0190 1 100 0 510 ECU_ADDRESS 0xFFFF1B04 READ_WRITE /end MEASUREMENT
/begin MEASUREMENT vANGTMHRF "RAM value vANGTMHRF" UBYTE COMP_0190 1 100 0 510 ECU_ADDRESS 0xFFFF3A0E READ_WRITE /end MEASUREMENT
/begin MEASUREMENT vANGTMS "RAM value vANGTMS" UBYTE COMP_0190 1 100 0 510 ECU_ADDRESS 0xFFFF0A69 READ_WRITE /end MEASUREMENT
/begin MEASUREMENT vANGTMSZ "RAM value vANGTMSZ" UBYTE COMP_0190 1 100 0 510 ECU_ADDRESS 0xFFFF170C READ_WRITE /end MEASUREMENT
/begin MEASUREMENT vANHTI "RAM value vANHTI" ULONG COMP_0157_S 1 100 0 6871947672 ECU_ADDRESS 0xFFFF2328 READ_WRITE /end MEASUREMENT
/begin MEASUREMENT vANRPM "RAM value vANRPM" UWORD COMP_0064 1 100 0 102398.4375 ECU_ADDRESS 0xFFFF170E READ_WRITE /end MEASUREMENT
/begin MEASUREMENT vANSR8 "RAM value vANSR8" UBYTE COMP_0068 1 100 0 255 ECU_ADDRESS 0xFFFF232C READ_WRITE /end MEASUREMENT
/begin MEASUREMENT vAPADJK "RAM value vAPADJK" UWORD COMP_0005 1 100 0 7208.85 ECU_ADDRESS 0xFFFF0A6A READ_WRITE /end MEASUREMENT
/begin MEASUREMENT vAPADJK_S "RAM value vAPADJK_S" UWORD COMP_0005 1 100 0 7208.85 ECU_ADDRESS 0xFFFF14A2 READ_WRITE /end MEASUREMENT
/begin MEASUREMENT vAPAGED "RAM value vAPAGED" UWORD COMP_0374 1 100 0 13.107 ECU_ADDRESS 0xFFFF232E READ_WRITE /end MEASUREMENT
/begin MEASUREMENT vAPASCDAD "RAM value vAPASCDAD" UWORD COMP_0005 1 100 0 7208.85 ECU_ADDRESS 0xFFFF3B48 READ_WRITE /end MEASUREMENT
/begin MEASUREMENT vAPHYASCD "RAM value vAPHYASCD" UWORD COMP_0005 1 100 0 7208.85 ECU_ADDRESS 0xFFFF15BA READ_WRITE /end MEASUREMENT
/begin MEASUREMENT vAPHYSL "RAM value vAPHYSL" UWORD COMP_0032_S 1 100 0 8191.875 ECU_ADDRESS 0xFFFF2330 READ_WRITE /end MEASUREMENT
/begin MEASUREMENT vAPICDATA "RAM value vAPICDATA" UBYTE COMP_0068 1 100 0 255 ECU_ADDRESS 0xFFFF33E5 READ_WRITE /end MEASUREMENT
/begin MEASUREMENT vAPICDATAZ "RAM value vAPICDATAZ" UBYTE COMP_0068 1 100 0 255 ECU_ADDRESS 0xFFFF33E6 READ_WRITE /end MEASUREMENT
/begin MEASUREMENT vAPICDBF "RAM value vAPICDBF" UBYTE COMP_0068 1 100 0 255 ECU_ADDRESS 0xFFFF33E7 READ_WRITE /end MEASUREMENT
/begin MEASUREMENT vAPICIN "RAM value vAPICIN" UBYTE COMP_0068 1 100 0 255 ECU_ADDRESS 0xFFFF33E8 READ_WRITE /end MEASUREMENT
/begin MEASUREMENT vAPO "RAM value vAPO" UWORD COMP_0005 1 100 0 7208.85 ECU_ADDRESS 0xFFFF1E64 READ_WRITE /end MEASUREMENT
/begin MEASUREMENT vAPO1 "RAM value vAPO1" UWORD COMP_0005 1 100 0 7208.85 ECU_ADDRESS 0xFFFF1FC6 READ_WRITE /end MEASUREMENT
/begin MEASUREMENT vAPO2 "RAM value vAPO2" UWORD COMP_0005 1 100 0 7208.85 ECU_ADDRESS 0xFFFF1FC8 READ_WRITE /end MEASUREMENT
/begin MEASUREMENT vAPOFMAX "RAM value vAPOFMAX" UWORD COMP_0005 1 100 0 7208.85 ECU_ADDRESS 0xFFFF2332 READ_WRITE /end MEASUREMENT
/begin MEASUREMENT vAPOFR2_S "RAM value vAPOFR2_S" UWORD COMP_0032_S 1 100 0 8191.875 ECU_ADDRESS 0xFFFF303A READ_WRITE /end MEASUREMENT
/begin MEASUREMENT vAPOFS "RAM value vAPOFS" UWORD COMP_0005 1 100 0 7208.85 ECU_ADDRESS 0xFFFF1FCA READ_WRITE /end MEASUREMENT
/begin MEASUREMENT vAPOFS1Z "RAM value vAPOFS1Z" UWORD COMP_0005 1 100 0 7208.85 ECU_ADDRESS 0xFFFF15BC READ_WRITE /end MEASUREMENT
/begin MEASUREMENT vAPOFS2Z "RAM value vAPOFS2Z" UWORD COMP_0005 1 100 0 7208.85 ECU_ADDRESS 0xFFFF15BE READ_WRITE /end MEASUREMENT
/begin MEASUREMENT vAPOFS3Z "RAM value vAPOFS3Z" UWORD COMP_0005 1 100 0 7208.85 ECU_ADDRESS 0xFFFF15C0 READ_WRITE /end MEASUREMENT
/begin MEASUREMENT vAPOFS4Z "RAM value vAPOFS4Z" UWORD COMP_0005 1 100 0 7208.85 ECU_ADDRESS 0xFFFF15C2 READ_WRITE /end MEASUREMENT
/begin MEASUREMENT vAPOFS5Z "RAM value vAPOFS5Z" UWORD COMP_0005 1 100 0 7208.85 ECU_ADDRESS 0xFFFF15C4 READ_WRITE /end MEASUREMENT
/begin MEASUREMENT vAPOFS6Z "RAM value vAPOFS6Z" UWORD COMP_0005 1 100 0 7208.85 ECU_ADDRESS 0xFFFF15C6 READ_WRITE /end MEASUREMENT
/begin MEASUREMENT vAPOFS7Z "RAM value vAPOFS7Z" UWORD COMP_0005 1 100 0 7208.85 ECU_ADDRESS 0xFFFF15C8 READ_WRITE /end MEASUREMENT
/begin MEASUREMENT vAPOFS8Z "RAM value vAPOFS8Z" UWORD COMP_0005 1 100 0 7208.85 ECU_ADDRESS 0xFFFF15CA READ_WRITE /end MEASUREMENT
/begin MEASUREMENT vAPOFSR "RAM value vAPOFSR" UWORD COMP_0032_S 1 100 0 8191.875 ECU_ADDRESS 0xFFFF1FCC READ_WRITE /end MEASUREMENT
/begin MEASUREMENT vAPOFSR2 "RAM value vAPOFSR2" UWORD COMP_0032_S 1 100 0 8191.875 ECU_ADDRESS 0xFFFF2334 READ_WRITE /end MEASUREMENT
/begin MEASUREMENT vAPOFSRC "RAM value vAPOFSRC" UWORD COMP_0032_S 1 100 0 8191.875 ECU_ADDRESS 0xFFFF33EA READ_WRITE /end MEASUREMENT
/begin MEASUREMENT vAPOFSR_S "RAM value vAPOFSR_S" UWORD COMP_0032_S 1 100 0 8191.875 ECU_ADDRESS 0xFFFF20DE READ_WRITE /end MEASUREMENT
/begin MEASUREMENT vAPOFS_S "RAM value vAPOFS_S" UWORD COMP_0005 1 100 0 7208.85 ECU_ADDRESS 0xFFFF39FE READ_WRITE /end MEASUREMENT
/begin MEASUREMENT vAPOJK "RAM value vAPOJK" UWORD COMP_0005 1 100 0 7208.85 ECU_ADDRESS 0xFFFF0A6C READ_WRITE /end MEASUREMENT
/begin MEASUREMENT vAPOJK_S "RAM value vAPOJK_S" UWORD COMP_0005 1 100 0 7208.85 ECU_ADDRESS 0xFFFF14A4 READ_WRITE /end MEASUREMENT
/begin MEASUREMENT vAPOK "RAM value vAPOK" UBYTE COMP_0002 1 100 0 89.25 ECU_ADDRESS 0xFFFF1FCE READ_WRITE /end MEASUREMENT
/begin MEASUREMENT vAPOK30 "RAM value vAPOK30" UBYTE COMP_0127 1 100 -44.8 44.45 ECU_ADDRESS 0xFFFF1FCF READ_WRITE /end MEASUREMENT
/begin MEASUREMENT vAPOKz0 "RAM value vAPOKz0" UBYTE COMP_0002 1 100 0 89.25 ECU_ADDRESS 0xFFFF33EC READ_WRITE /end MEASUREMENT
/begin MEASUREMENT vAPOKz1 "RAM value vAPOKz1" UBYTE COMP_0002 1 100 0 89.25 ECU_ADDRESS 0xFFFF33ED READ_WRITE /end MEASUREMENT
/begin MEASUREMENT vAPOKz2 "RAM value vAPOKz2" UBYTE COMP_0002 1 100 0 89.25 ECU_ADDRESS 0xFFFF33EE READ_WRITE /end MEASUREMENT
/begin MEASUREMENT vAPOKz3 "RAM value vAPOKz3" UBYTE COMP_0002 1 100 0 89.25 ECU_ADDRESS 0xFFFF33EF READ_WRITE /end MEASUREMENT
/begin MEASUREMENT vAPOLN "RAM value vAPOLN" UWORD COMP_0005 1 100 0 7208.85 ECU_ADDRESS 0xFFFF0A6E READ_WRITE /end MEASUREMENT
/begin MEASUREMENT vAPOLN_S "RAM value vAPOLN_S" UWORD COMP_0005 1 100 0 7208.85 ECU_ADDRESS 0xFFFF14A6 READ_WRITE /end MEASUREMENT
/begin MEASUREMENT vAPOSR0_S "RAM value vAPOSR0_S" UWORD COMP_0032_S 1 100 0 8191.875 ECU_ADDRESS 0xFFFF303C READ_WRITE /end MEASUREMENT
/begin MEASUREMENT vAPOST "RAM value vAPOST" UWORD COMP_0005 1 100 0 7208.85 ECU_ADDRESS 0xFFFF0974 READ_WRITE /end MEASUREMENT
/begin MEASUREMENT vAPOSTR "RAM value vAPOSTR" UWORD COMP_0032_S 1 100 0 8191.875 ECU_ADDRESS 0xFFFF2336 READ_WRITE /end MEASUREMENT
/begin MEASUREMENT vAPOSTR0 "RAM value vAPOSTR0" UWORD COMP_0032_S 1 100 0 8191.875 ECU_ADDRESS 0xFFFF2338 READ_WRITE /end MEASUREMENT
/begin MEASUREMENT vAPOSTR00 "RAM value vAPOSTR00" UWORD COMP_0032_S 1 100 0 8191.875 ECU_ADDRESS 0xFFFF233A READ_WRITE /end MEASUREMENT
/begin MEASUREMENT vAPOSTR_S "RAM value vAPOSTR_S" UWORD COMP_0032_S 1 100 0 8191.875 ECU_ADDRESS 0xFFFF303E READ_WRITE /end MEASUREMENT
/begin MEASUREMENT vAPOSTZ1 "RAM value vAPOSTZ1" UWORD COMP_0005 1 100 0 7208.85 ECU_ADDRESS 0xFFFF233C READ_WRITE /end MEASUREMENT
/begin MEASUREMENT vAPOSTZ10 "RAM value vAPOSTZ10" UWORD COMP_0005 1 100 0 7208.85 ECU_ADDRESS 0xFFFF233E READ_WRITE /end MEASUREMENT
/begin MEASUREMENT vAPOSTZ2 "RAM value vAPOSTZ2" UWORD COMP_0005 1 100 0 7208.85 ECU_ADDRESS 0xFFFF2340 READ_WRITE /end MEASUREMENT
/begin MEASUREMENT vAPOSTZ3 "RAM value vAPOSTZ3" UWORD COMP_0005 1 100 0 7208.85 ECU_ADDRESS 0xFFFF2342 READ_WRITE /end MEASUREMENT
/begin MEASUREMENT vAPOSTZ4 "RAM value vAPOSTZ4" UWORD COMP_0005 1 100 0 7208.85 ECU_ADDRESS 0xFFFF2344 READ_WRITE /end MEASUREMENT
/begin MEASUREMENT vAPOSTZ5 "RAM value vAPOSTZ5" UWORD COMP_0005 1 100 0 7208.85 ECU_ADDRESS 0xFFFF2346 READ_WRITE /end MEASUREMENT
/begin MEASUREMENT vAPOSTZ6 "RAM value vAPOSTZ6" UWORD COMP_0005 1 100 0 7208.85 ECU_ADDRESS 0xFFFF2348 READ_WRITE /end MEASUREMENT
/begin MEASUREMENT vAPOSTZ7 "RAM value vAPOSTZ7" UWORD COMP_0005 1 100 0 7208.85 ECU_ADDRESS 0xFFFF234A READ_WRITE /end MEASUREMENT
/begin MEASUREMENT vAPOSTZ8 "RAM value vAPOSTZ8" UWORD COMP_0005 1 100 0 7208.85 ECU_ADDRESS 0xFFFF234C READ_WRITE /end MEASUREMENT
/begin MEASUREMENT vAPOSTZ9 "RAM value vAPOSTZ9" UWORD COMP_0005 1 100 0 7208.85 ECU_ADDRESS 0xFFFF234E READ_WRITE /end MEASUREMENT
/begin MEASUREMENT vAPOST_S "RAM value vAPOST_S" UWORD COMP_0005 1 100 0 7208.85 ECU_ADDRESS 0xFFFF09A6 READ_WRITE /end MEASUREMENT
/begin MEASUREMENT vAPOTR "RAM value vAPOTR" UWORD COMP_0005 1 100 0 7208.85 ECU_ADDRESS 0xFFFF0976 READ_WRITE /end MEASUREMENT
/begin MEASUREMENT vAPOTR1 "RAM value vAPOTR1" UWORD COMP_0005 1 100 0 7208.85 ECU_ADDRESS 0xFFFF0A70 READ_WRITE /end MEASUREMENT
/begin MEASUREMENT vAPOTR1_S "RAM value vAPOTR1_S" UWORD COMP_0005 1 100 0 7208.85 ECU_ADDRESS 0xFFFF14A8 READ_WRITE /end MEASUREMENT
/begin MEASUREMENT vAPOTR2 "RAM value vAPOTR2" UWORD COMP_0005 1 100 0 7208.85 ECU_ADDRESS 0xFFFF0A72 READ_WRITE /end MEASUREMENT
/begin MEASUREMENT vAPOTR2_S "RAM value vAPOTR2_S" UWORD COMP_0005 1 100 0 7208.85 ECU_ADDRESS 0xFFFF14AA READ_WRITE /end MEASUREMENT
/begin MEASUREMENT vAPOTR_S "RAM value vAPOTR_S" UWORD COMP_0005 1 100 0 7208.85 ECU_ADDRESS 0xFFFF09A8 READ_WRITE /end MEASUREMENT
/begin MEASUREMENT vAPO_S "RAM value vAPO_S" UWORD COMP_0005 1 100 0 7208.85 ECU_ADDRESS 0xFFFF39FC READ_WRITE /end MEASUREMENT
/begin MEASUREMENT vAPOz1 "RAM value vAPOz1" UWORD COMP_0005 1 100 0 7208.85 ECU_ADDRESS 0xFFFF33F0 READ_WRITE /end MEASUREMENT
/begin MEASUREMENT vAPOz10 "RAM value vAPOz10" UWORD COMP_0005 1 100 0 7208.85 ECU_ADDRESS 0xFFFF33F2 READ_WRITE /end MEASUREMENT
/begin MEASUREMENT vAPOz2 "RAM value vAPOz2" UWORD COMP_0005 1 100 0 7208.85 ECU_ADDRESS 0xFFFF33F4 READ_WRITE /end MEASUREMENT
/begin MEASUREMENT vAPOz3 "RAM value vAPOz3" UWORD COMP_0005 1 100 0 7208.85 ECU_ADDRESS 0xFFFF33F6 READ_WRITE /end MEASUREMENT
/begin MEASUREMENT vAPOz4 "RAM value vAPOz4" UWORD COMP_0005 1 100 0 7208.85 ECU_ADDRESS 0xFFFF33F8 READ_WRITE /end MEASUREMENT
/begin MEASUREMENT vAPOz5 "RAM value vAPOz5" UWORD COMP_0005 1 100 0 7208.85 ECU_ADDRESS 0xFFFF1FD0 READ_WRITE /end MEASUREMENT
/begin MEASUREMENT vAPOz6 "RAM value vAPOz6" UWORD COMP_0005 1 100 0 7208.85 ECU_ADDRESS 0xFFFF33FA READ_WRITE /end MEASUREMENT
/begin MEASUREMENT vAPOz7 "RAM value vAPOz7" UWORD COMP_0005 1 100 0 7208.85 ECU_ADDRESS 0xFFFF33FC READ_WRITE /end MEASUREMENT
/begin MEASUREMENT vAPOz8 "RAM value vAPOz8" UWORD COMP_0005 1 100 0 7208.85 ECU_ADDRESS 0xFFFF33FE READ_WRITE /end MEASUREMENT
/begin MEASUREMENT vAPOz9 "RAM value vAPOz9" UWORD COMP_0005 1 100 0 7208.85 ECU_ADDRESS 0xFFFF3400 READ_WRITE /end MEASUREMENT
/begin MEASUREMENT vAPPTIM "RAM value vAPPTIM" ULONG COMP_0376 1 100 0 429496729.5 ECU_ADDRESS 0xFFFF1710 READ_WRITE /end MEASUREMENT
/begin MEASUREMENT vAPS1AV "RAM value vAPS1AV" UWORD COMP_0023 1 100 0 327675 ECU_ADDRESS 0xFFFF3402 READ_WRITE /end MEASUREMENT
/begin MEASUREMENT vAPS1CL "RAM value vAPS1CL" UWORD COMP_0023 1 100 0 327675 ECU_ADDRESS 0xFFFF4E56 READ_WRITE /end MEASUREMENT
/begin MEASUREMENT vAPS1CNT "RAM value vAPS1CNT" UWORD COMP_0004 1 100 0 65535 ECU_ADDRESS 0xFFFF3404 READ_WRITE /end MEASUREMENT
/begin MEASUREMENT vAPS1OF "RAM value vAPS1OF" SWORD COMP_0377 1 100 -3604.48 3604.37 ECU_ADDRESS 0xFFFF1FD2 READ_WRITE /end MEASUREMENT
/begin MEASUREMENT vAPS1SUM "RAM value vAPS1SUM" ULONG COMP_0023 1 100 0 21474836475 ECU_ADDRESS 0xFFFF3408 READ_WRITE /end MEASUREMENT
/begin MEASUREMENT vAPS1V "RAM value vAPS1V" UWORD COMP_0023 1 100 0 327675 ECU_ADDRESS 0xFFFF1FD4 READ_WRITE /end MEASUREMENT
/begin MEASUREMENT vAPS1VOD "RAM value vAPS1VOD" UWORD COMP_0023 1 100 0 327675 ECU_ADDRESS 0xFFFF340C READ_WRITE /end MEASUREMENT
/begin MEASUREMENT vAPS2AV "RAM value vAPS2AV" UWORD COMP_0023 1 100 0 327675 ECU_ADDRESS 0xFFFF340E READ_WRITE /end MEASUREMENT
/begin MEASUREMENT vAPS2CL "RAM value vAPS2CL" UWORD COMP_0023 1 100 0 327675 ECU_ADDRESS 0xFFFF4E58 READ_WRITE /end MEASUREMENT
/begin MEASUREMENT vAPS2CNT "RAM value vAPS2CNT" UWORD COMP_0004 1 100 0 65535 ECU_ADDRESS 0xFFFF3410 READ_WRITE /end MEASUREMENT
/begin MEASUREMENT vAPS2OF "RAM value vAPS2OF" SWORD COMP_0377 1 100 -3604.48 3604.37 ECU_ADDRESS 0xFFFF1FD6 READ_WRITE /end MEASUREMENT
/begin MEASUREMENT vAPS2SUM "RAM value vAPS2SUM" ULONG COMP_0023 1 100 0 21474836475 ECU_ADDRESS 0xFFFF3414 READ_WRITE /end MEASUREMENT
/begin MEASUREMENT vAPS2V "RAM value vAPS2V" UWORD COMP_0023 1 100 0 327675 ECU_ADDRESS 0xFFFF1FD8 READ_WRITE /end MEASUREMENT
/begin MEASUREMENT vAPS2VOD "RAM value vAPS2VOD" UWORD COMP_0023 1 100 0 327675 ECU_ADDRESS 0xFFFF3418 READ_WRITE /end MEASUREMENT
/begin MEASUREMENT vAPSTS "RAM value vAPSTS" UBYTE COMP_0068 1 100 0 255 ECU_ADDRESS 0xFFFF341A READ_WRITE /end MEASUREMENT
/begin MEASUREMENT vAPSTSBF "RAM value vAPSTSBF" UBYTE COMP_0068 1 100 0 255 ECU_ADDRESS 0xFFFF341B READ_WRITE /end MEASUREMENT
/begin MEASUREMENT vAQISC0 "RAM value vAQISC0" UWORD COMP_0042 1 100 0 52.428 ECU_ADDRESS 0xFFFF0A74 READ_WRITE /end MEASUREMENT
/begin MEASUREMENT vAQSISC "RAM value vAQSISC" UWORD COMP_0042 1 100 0 52.428 ECU_ADDRESS 0xFFFF0A76 READ_WRITE /end MEASUREMENT
/begin MEASUREMENT vAQSISC_S "RAM value vAQSISC_S" UWORD COMP_0042 1 100 0 52.428 ECU_ADDRESS 0xFFFF14AC READ_WRITE /end MEASUREMENT
/begin MEASUREMENT vARABF "RAM value vARABF" UWORD COMP_0453 1 100 0 131.07 ECU_ADDRESS 0xFFFF2350 READ_WRITE /end MEASUREMENT
/begin MEASUREMENT vARACNT "RAM value vARACNT" UWORD COMP_0016 1 100 0 65535 ECU_ADDRESS 0xFFFF44C6 READ_WRITE /end MEASUREMENT
/begin MEASUREMENT vARAFS "RAM value vARAFS" UWORD COMP_0093 1 100 0 163837.5 ECU_ADDRESS 0xFFFF2354 READ_WRITE /end MEASUREMENT
/begin MEASUREMENT vARAJBFf "RAM value vARAJBFf" UBYTE COMP_0004 1 100 0 255 ECU_ADDRESS 0xFFFF2358 READ_WRITE /end MEASUREMENT
/begin MEASUREMENT vARAJUGf "RAM value vARAJUGf" UBYTE COMP_0004 1 100 0 255 ECU_ADDRESS 0xFFFF2359 READ_WRITE /end MEASUREMENT
/begin MEASUREMENT vARATIO "RAM value vARATIO" UWORD COMP_0395 1 100 0 15.999780435 ECU_ADDRESS 0xFFFF32FC READ_WRITE /end MEASUREMENT
/begin MEASUREMENT vARATIO0 "RAM value vARATIO0" UWORD COMP_0395 1 100 0 15.999780435 ECU_ADDRESS 0xFFFF235A READ_WRITE /end MEASUREMENT
/begin MEASUREMENT vARQ "RAM value vARQ" ULONG COMP_0489_S 1 100 0 429496.7295 ECU_ADDRESS 0xFFFF235C READ_WRITE /end MEASUREMENT
/begin MEASUREMENT vASCD2SW "RAM value vASCD2SW" UBYTE COMP_0068 1 100 0 255 ECU_ADDRESS 0xFFFF30FC READ_WRITE /end MEASUREMENT
/begin MEASUREMENT vASCD50MS "RAM value vASCD50MS" UBYTE COMP_0068 1 100 0 255 ECU_ADDRESS 0xFFFF2360 READ_WRITE /end MEASUREMENT
/begin MEASUREMENT vASCD5SW "RAM value vASCD5SW" UBYTE COMP_0068 1 100 0 255 ECU_ADDRESS 0xFFFF341C READ_WRITE /end MEASUREMENT
/begin MEASUREMENT vASCDID1 "RAM value vASCDID1" UBYTE COMP_0283 1 100 0 255 ECU_ADDRESS 0xFFFF2361 READ_WRITE /end MEASUREMENT
/begin MEASUREMENT vASCDID2 "RAM value vASCDID2" UBYTE COMP_0283 1 100 0 255 ECU_ADDRESS 0xFFFF2362 READ_WRITE /end MEASUREMENT
/begin MEASUREMENT vASCDMON1 "RAM value vASCDMON1" UBYTE COMP_0283 1 100 0 255 ECU_ADDRESS 0xFFFF2363 READ_WRITE /end MEASUREMENT
/begin MEASUREMENT vASCDMON2 "RAM value vASCDMON2" UBYTE COMP_0283 1 100 0 255 ECU_ADDRESS 0xFFFF2364 READ_WRITE /end MEASUREMENT
/begin MEASUREMENT vASCDSW "RAM value vASCDSW" UBYTE COMP_0068 1 100 0 255 ECU_ADDRESS 0xFFFF2365 READ_WRITE /end MEASUREMENT
/begin MEASUREMENT vASCDSWAC "RAM value vASCDSWAC" UBYTE COMP_0068 1 100 0 255 ECU_ADDRESS 0xFFFF30FD READ_WRITE /end MEASUREMENT
/begin MEASUREMENT vASCDSWPR "RAM value vASCDSWPR" UBYTE COMP_0068 1 100 0 255 ECU_ADDRESS 0xFFFF30FE READ_WRITE /end MEASUREMENT
/begin MEASUREMENT vASCDSWPRZ "RAM value vASCDSWPRZ" UBYTE COMP_0068 1 100 0 255 ECU_ADDRESS 0xFFFF30FF READ_WRITE /end MEASUREMENT
/begin MEASUREMENT vASCMODE "RAM value vASCMODE" UBYTE COMP_0068 1 100 0 255 ECU_ADDRESS 0xFFFF1FDA READ_WRITE /end MEASUREMENT
/begin MEASUREMENT vASCRX "RAM value vASCRX" UBYTE COMP_0004 1 100 0 255 ECU_ADDRESS 0xFFFF2367 READ_WRITE /end MEASUREMENT
/begin MEASUREMENT vASCTX "RAM value vASCTX" UBYTE COMP_0004 1 100 0 255 ECU_ADDRESS 0xFFFF2368 READ_WRITE /end MEASUREMENT
/begin MEASUREMENT vASHLGOf "RAM value vASHLGOf" UBYTE COMP_0004 1 100 0 255 ECU_ADDRESS 0xFFFF2369 READ_WRITE /end MEASUREMENT
/begin MEASUREMENT vASHLRCVf "RAM value vASHLRCVf" UBYTE COMP_0004 1 100 0 255 ECU_ADDRESS 0xFFFF236A READ_WRITE /end MEASUREMENT
/begin MEASUREMENT vASHTENDf "RAM value vASHTENDf" UBYTE COMP_0004 1 100 0 255 ECU_ADDRESS 0xFFFF236B READ_WRITE /end MEASUREMENT
/begin MEASUREMENT vASOVCHGR "RAM value vASOVCHGR" SWORD COMP_0204_S 1 100 -3276800 3276700 ECU_ADDRESS 0xFFFF236C READ_WRITE /end MEASUREMENT
/begin MEASUREMENT vASRDTQRQ "RAM value vASRDTQRQ" UBYTE COMP_0497_S 1 100 -100 410 ECU_ADDRESS 0xFFFF3421 READ_WRITE /end MEASUREMENT
/begin MEASUREMENT vASRSTQRQ "RAM value vASRSTQRQ" UBYTE COMP_0497_S 1 100 -100 410 ECU_ADDRESS 0xFFFF3422 READ_WRITE /end MEASUREMENT
/begin MEASUREMENT vATCUNO "RAM value vATCUNO" UBYTE COMP_0004 1 100 0 255 ECU_ADDRESS 0xFFFF44CA READ_WRITE /end MEASUREMENT
/begin MEASUREMENT vATGNSTNT "RAM value vATGNSTNT" UBYTE COMP_0014 1 100 0 2550 ECU_ADDRESS 0xFFFF3423 READ_WRITE /end MEASUREMENT
/begin MEASUREMENT vATIOF "RAM value vATIOF" SWORD COMP_0277 1 100 -32768 32767 ECU_ADDRESS 0xFFFF0A78 READ_WRITE /end MEASUREMENT
/begin MEASUREMENT vATION "RAM value vATION" SWORD COMP_0277 1 100 -32768 32767 ECU_ADDRESS 0xFFFF0A7A READ_WRITE /end MEASUREMENT
/begin MEASUREMENT vATMPRS "RAM value vATMPRS" UWORD COMP_0039_S 1 100 60000 125535 ECU_ADDRESS 0xFFFF1FDC READ_WRITE /end MEASUREMENT
/begin MEASUREMENT vATMPRSZ "RAM value vATMPRSZ" UWORD COMP_0039_S 1 100 60000 125535 ECU_ADDRESS 0xFFFF3424 READ_WRITE /end MEASUREMENT
/begin MEASUREMENT vATMSG1T "RAM value vATMSG1T" UBYTE COMP_0014 1 100 0 2550 ECU_ADDRESS 0xFFFF1FDE READ_WRITE /end MEASUREMENT
/begin MEASUREMENT vATMSG2T "RAM value vATMSG2T" UBYTE COMP_0014 1 100 0 2550 ECU_ADDRESS 0xFFFF1FDF READ_WRITE /end MEASUREMENT
/begin MEASUREMENT vATMST2 "RAM value vATMST2" UWORD COMP_0039_S 1 100 60000 125535 ECU_ADDRESS 0xFFFF3426 READ_WRITE /end MEASUREMENT
/begin MEASUREMENT vATPO "RAM value vATPO" UWORD COMP_0042 1 100 0 52.428 ECU_ADDRESS 0xFFFF1FE0 READ_WRITE /end MEASUREMENT
/begin MEASUREMENT vATPO1 "RAM value vATPO1" UWORD COMP_0042 1 100 0 52.428 ECU_ADDRESS 0xFFFF3428 READ_WRITE /end MEASUREMENT
/begin MEASUREMENT vATPO1A "RAM value vATPO1A" UWORD COMP_0042 1 100 0 52.428 ECU_ADDRESS 0xFFFF342A READ_WRITE /end MEASUREMENT
/begin MEASUREMENT vATRET "RAM value vATRET" UWORD COMP_0081 1 100 0 255.99609375 ECU_ADDRESS 0xFFFF1B06 READ_WRITE /end MEASUREMENT
/begin MEASUREMENT vATRETLIM "RAM value vATRETLIM" SBYTE COMP_0018 1 100 -128 127 ECU_ADDRESS 0xFFFF0A7C READ_WRITE /end MEASUREMENT
/begin MEASUREMENT vATRNG "RAM value vATRNG" UBYTE COMP_0068 1 100 0 255 ECU_ADDRESS 0xFFFF1E53 READ_WRITE /end MEASUREMENT
/begin MEASUREMENT vATRNGZ "RAM value vATRNGZ" UBYTE COMP_0068 1 100 0 255 ECU_ADDRESS 0xFFFF236E READ_WRITE /end MEASUREMENT
/begin MEASUREMENT vATSUM "RAM value vATSUM" UBYTE COMP_0004 1 100 0 255 ECU_ADDRESS 0xFFFF44D0 READ_WRITE /end MEASUREMENT
/begin MEASUREMENT vATTEMP "RAM value vATTEMP" UBYTE COMP_0041_S 1 100 0 255 ECU_ADDRESS 0xFFFF1FE2 READ_WRITE /end MEASUREMENT
/begin MEASUREMENT vATTQCT1T "RAM value vATTQCT1T" UBYTE COMP_0014 1 100 0 2550 ECU_ADDRESS 0xFFFF1FE3 READ_WRITE /end MEASUREMENT
/begin MEASUREMENT vATTQCT2T "RAM value vATTQCT2T" UBYTE COMP_0014 1 100 0 2550 ECU_ADDRESS 0xFFFF1FE4 READ_WRITE /end MEASUREMENT
/begin MEASUREMENT vATTQN1T "RAM value vATTQN1T" UBYTE COMP_0014 1 100 0 2550 ECU_ADDRESS 0xFFFF1FE5 READ_WRITE /end MEASUREMENT
/begin MEASUREMENT vAUHCDCV1 "RAM value vAUHCDCV1" UBYTE COMP_0068 1 100 0 255 ECU_ADDRESS 0xFFFF08BA READ_WRITE /end MEASUREMENT
/begin MEASUREMENT vAUHCDCV2 "RAM value vAUHCDCV2" UBYTE COMP_0068 1 100 0 255 ECU_ADDRESS 0xFFFF08BB READ_WRITE /end MEASUREMENT
/begin MEASUREMENT vAUHDMY "RAM value vAUHDMY" UWORD COMP_0068 1 100 0 65535 ECU_ADDRESS 0xFFFF15CC READ_WRITE /end MEASUREMENT
/begin MEASUREMENT vAUHI39DY "RAM value vAUHI39DY" UBYTE COMP_0068 1 100 0 255 ECU_ADDRESS 0xFFFF15CE READ_WRITE /end MEASUREMENT
/begin MEASUREMENT vAUHIGN1 "RAM value vAUHIGN1" UBYTE COMP_0068 1 100 0 255 ECU_ADDRESS 0xFFFF15CF READ_WRITE /end MEASUREMENT
/begin MEASUREMENT vAUHIGN2 "RAM value vAUHIGN2" UBYTE COMP_0068 1 100 0 255 ECU_ADDRESS 0xFFFF15D0 READ_WRITE /end MEASUREMENT
/begin MEASUREMENT vAUHIGN3 "RAM value vAUHIGN3" UBYTE COMP_0068 1 100 0 255 ECU_ADDRESS 0xFFFF15D1 READ_WRITE /end MEASUREMENT
/begin MEASUREMENT vAUHIGN39 "RAM value vAUHIGN39" UWORD COMP_0068 1 100 0 65535 ECU_ADDRESS 0xFFFF15D2 READ_WRITE /end MEASUREMENT
/begin MEASUREMENT vAUHIGN4 "RAM value vAUHIGN4" UBYTE COMP_0068 1 100 0 255 ECU_ADDRESS 0xFFFF15D4 READ_WRITE /end MEASUREMENT
/begin MEASUREMENT vAUHINJ39 "RAM value vAUHINJ39" UWORD COMP_0068 1 100 0 65535 ECU_ADDRESS 0xFFFF15D6 READ_WRITE /end MEASUREMENT
/begin MEASUREMENT vAUHS39DY "RAM value vAUHS39DY" UBYTE COMP_0068 1 100 0 255 ECU_ADDRESS 0xFFFF15D8 READ_WRITE /end MEASUREMENT
/begin MEASUREMENT vAUHSOL39 "RAM value vAUHSOL39" UWORD COMP_0068 1 100 0 65535 ECU_ADDRESS 0xFFFF15DA READ_WRITE /end MEASUREMENT
/begin MEASUREMENT vAUHSTRLY "RAM value vAUHSTRLY" UBYTE COMP_0068 1 100 0 255 ECU_ADDRESS 0xFFFF08BC READ_WRITE /end MEASUREMENT
/begin MEASUREMENT vAUHWGC1 "RAM value vAUHWGC1" UBYTE COMP_0068 1 100 0 255 ECU_ADDRESS 0xFFFF08BD READ_WRITE /end MEASUREMENT
/begin MEASUREMENT vAUHWGC2 "RAM value vAUHWGC2" UBYTE COMP_0068 1 100 0 255 ECU_ADDRESS 0xFFFF08BE READ_WRITE /end MEASUREMENT
/begin MEASUREMENT vAUREG28 "RAM value vAUREG28" UWORD COMP_0068 1 100 0 65535 ECU_ADDRESS 0xFFFF15DC READ_WRITE /end MEASUREMENT
/begin MEASUREMENT vAUREG391 "RAM value vAUREG391" UWORD COMP_0068 1 100 0 65535 ECU_ADDRESS 0xFFFF15DE READ_WRITE /end MEASUREMENT
/begin MEASUREMENT vAUREG392 "RAM value vAUREG392" UWORD COMP_0068 1 100 0 65535 ECU_ADDRESS 0xFFFF15E0 READ_WRITE /end MEASUREMENT
/begin MEASUREMENT vAUREG393 "RAM value vAUREG393" UWORD COMP_0068 1 100 0 65535 ECU_ADDRESS 0xFFFF15E2 READ_WRITE /end MEASUREMENT
/begin MEASUREMENT vAUREG394 "RAM value vAUREG394" UWORD COMP_0068 1 100 0 65535 ECU_ADDRESS 0xFFFF15E4 READ_WRITE /end MEASUREMENT
/begin MEASUREMENT vAUREG395 "RAM value vAUREG395" UWORD COMP_0068 1 100 0 65535 ECU_ADDRESS 0xFFFF15E6 READ_WRITE /end MEASUREMENT
/begin MEASUREMENT vAUREG396 "RAM value vAUREG396" UWORD COMP_0068 1 100 0 65535 ECU_ADDRESS 0xFFFF15E8 READ_WRITE /end MEASUREMENT
/begin MEASUREMENT vAVADO2R "RAM value vAVADO2R" UWORD COMP_0061 1 100 0 327675 ECU_ADDRESS 0xFFFF2370 READ_WRITE /end MEASUREMENT
/begin MEASUREMENT vAVAFC "RAM value vAVAFC" UWORD COMP_0023 1 100 0 327675 ECU_ADDRESS 0xFFFF342C READ_WRITE /end MEASUREMENT
/begin MEASUREMENT vAVAFSAF "RAM value vAVAFSAF" UWORD COMP_0453 1 100 0 131.07 ECU_ADDRESS 0xFFFF2374 READ_WRITE /end MEASUREMENT
/begin MEASUREMENT vAVALP "RAM value vAVALP" UWORD COMP_0031 1 100 0 255.99609375 ECU_ADDRESS 0xFFFF0A7E READ_WRITE /end MEASUREMENT
/begin MEASUREMENT vAVCC "RAM value vAVCC" UBYTE COMP_0118 1 100 0 10200 ECU_ADDRESS 0xFFFF1FE6 READ_WRITE /end MEASUREMENT
/begin MEASUREMENT vAVEMHTR "RAM value vAVEMHTR" UWORD COMP_0017 1 100 0 65535 ECU_ADDRESS 0xFFFF1714 READ_WRITE /end MEASUREMENT
/begin MEASUREMENT vAVEOSC "RAM value vAVEOSC" ULONG COMP_0498_S 1 100 0 42949672.95 ECU_ADDRESS 0xFFFF2378 READ_WRITE /end MEASUREMENT
/begin MEASUREMENT vAVEPF "RAM value vAVEPF" UWORD COMP_0164 1 100 0 19.988175 ECU_ADDRESS 0xFFFF1E00 READ_WRITE /end MEASUREMENT
/begin MEASUREMENT vAVEPFBF "RAM value vAVEPFBF" UWORD COMP_0164 1 100 0 19.988175 ECU_ADDRESS 0xFFFF0A82 READ_WRITE /end MEASUREMENT
/begin MEASUREMENT vAVEPPSV "RAM value vAVEPPSV" UBYTE COMP_0054 1 100 0 5100 ECU_ADDRESS 0xFFFF0A84 READ_WRITE /end MEASUREMENT
/begin MEASUREMENT vAVEPSA "RAM value vAVEPSA" UBYTE COMP_0045_S 1 100 0 255 ECU_ADDRESS 0xFFFF3430 READ_WRITE /end MEASUREMENT
/begin MEASUREMENT vAVEPSA2 "RAM value vAVEPSA2" UWORD COMP_0046_S 1 100 0 255.99609375 ECU_ADDRESS 0xFFFF3432 READ_WRITE /end MEASUREMENT
/begin MEASUREMENT vAVEPSV40 "RAM value vAVEPSV40" UBYTE COMP_0054 1 100 0 5100 ECU_ADDRESS 0xFFFF0A85 READ_WRITE /end MEASUREMENT
/begin MEASUREMENT vAVEPSVz1 "RAM value vAVEPSVz1" UBYTE COMP_0054 1 100 0 5100 ECU_ADDRESS 0xFFFF0A86 READ_WRITE /end MEASUREMENT
/begin MEASUREMENT vAVEPSVz2 "RAM value vAVEPSVz2" UBYTE COMP_0054 1 100 0 5100 ECU_ADDRESS 0xFFFF0A87 READ_WRITE /end MEASUREMENT
/begin MEASUREMENT vAVEPSVz3 "RAM value vAVEPSVz3" UBYTE COMP_0054 1 100 0 5100 ECU_ADDRESS 0xFFFF0A88 READ_WRITE /end MEASUREMENT
/begin MEASUREMENT vAVEPSVz4 "RAM value vAVEPSVz4" UBYTE COMP_0054 1 100 0 5100 ECU_ADDRESS 0xFFFF0A89 READ_WRITE /end MEASUREMENT
/begin MEASUREMENT vAVEQ "RAM value vAVEQ" ULONG COMP_0068 1 100 0 4294967295 ECU_ADDRESS 0xFFFF3434 READ_WRITE /end MEASUREMENT
/begin MEASUREMENT vAVEQ10OLD "RAM value vAVEQ10OLD" ULONG COMP_0068 1 100 0 4294967295 ECU_ADDRESS 0xFFFF3438 READ_WRITE /end MEASUREMENT
/begin MEASUREMENT vAVEQ20OLD "RAM value vAVEQ20OLD" ULONG COMP_0068 1 100 0 4294967295 ECU_ADDRESS 0xFFFF343C READ_WRITE /end MEASUREMENT
/begin MEASUREMENT vAVEQ30OLD "RAM value vAVEQ30OLD" ULONG COMP_0068 1 100 0 4294967295 ECU_ADDRESS 0xFFFF3440 READ_WRITE /end MEASUREMENT
/begin MEASUREMENT vAVEQ40OLD "RAM value vAVEQ40OLD" ULONG COMP_0068 1 100 0 4294967295 ECU_ADDRESS 0xFFFF3444 READ_WRITE /end MEASUREMENT
/begin MEASUREMENT vAVEQ50OLD "RAM value vAVEQ50OLD" ULONG COMP_0068 1 100 0 4294967295 ECU_ADDRESS 0xFFFF3448 READ_WRITE /end MEASUREMENT
/begin MEASUREMENT vAVEQA "RAM value vAVEQA" UBYTE COMP_0004 1 100 0 255 ECU_ADDRESS 0xFFFF2380 READ_WRITE /end MEASUREMENT
/begin MEASUREMENT vAVETF "RAM value vAVETF" UWORD COMP_0023 1 100 0 327675 ECU_ADDRESS 0xFFFF15EA READ_WRITE /end MEASUREMENT
/begin MEASUREMENT vAVEVPS "RAM value vAVEVPS" UWORD COMP_0269 1 100 0 127.998046875 ECU_ADDRESS 0xFFFF2382 READ_WRITE /end MEASUREMENT
/begin MEASUREMENT vAVEWLNP "RAM value vAVEWLNP" UWORD COMP_0039_S 1 100 60000 125535 ECU_ADDRESS 0xFFFF344C READ_WRITE /end MEASUREMENT
/begin MEASUREMENT vAVGAFH "RAM value vAVGAFH" UWORD COMP_0023 1 100 0 327675 ECU_ADDRESS 0xFFFF1FE8 READ_WRITE /end MEASUREMENT
/begin MEASUREMENT vAVGAFH1f "RAM value vAVGAFH1f" UBYTE COMP_0004 1 100 0 255 ECU_ADDRESS 0xFFFF344E READ_WRITE /end MEASUREMENT
/begin MEASUREMENT vAVILI2 "RAM value vAVILI2" UWORD COMP_0050 1 100 0 5119.921875 ECU_ADDRESS 0xFFFF44D2 READ_WRITE /end MEASUREMENT
/begin MEASUREMENT vAVINEGR "RAM value vAVINEGR" SWORD COMP_0499_S 1 100 -100.00007168 99.99701992 ECU_ADDRESS 0xFFFF2384 READ_WRITE /end MEASUREMENT
/begin MEASUREMENT vAVJPD "RAM value vAVJPD" UWORD COMP_0081 1 100 0 255.99609375 ECU_ADDRESS 0xFFFF1B08 READ_WRITE /end MEASUREMENT
/begin MEASUREMENT vAVJPHOS "RAM value vAVJPHOS" SWORD COMP_0500_S 1 100 -256 255.9921875 ECU_ADDRESS 0xFFFF1716 READ_WRITE /end MEASUREMENT
/begin MEASUREMENT vAVJPHOSR "RAM value vAVJPHOSR" SBYTE COMP_0018 1 100 -128 127 ECU_ADDRESS 0xFFFF094B READ_WRITE /end MEASUREMENT
/begin MEASUREMENT vAVOSQ1 "RAM value vAVOSQ1" UBYTE COMP_0068 1 100 0 255 ECU_ADDRESS 0xFFFF2386 READ_WRITE /end MEASUREMENT
/begin MEASUREMENT vAVPDACON "RAM value vAVPDACON" UWORD COMP_0010 1 100 0 196.605 ECU_ADDRESS 0xFFFF08C0 READ_WRITE /end MEASUREMENT
/begin MEASUREMENT vAVQAEL "RAM value vAVQAEL" UWORD COMP_0068 1 100 0 65535 ECU_ADDRESS 0xFFFF2388 READ_WRITE /end MEASUREMENT
/begin MEASUREMENT vAVQAER "RAM value vAVQAER" UWORD COMP_0068 1 100 0 65535 ECU_ADDRESS 0xFFFF238C READ_WRITE /end MEASUREMENT
/begin MEASUREMENT vAVRPML "RAM value vAVRPML" UWORD COMP_0006 1 100 0 819187.5 ECU_ADDRESS 0xFFFF2390 READ_WRITE /end MEASUREMENT
/begin MEASUREMENT vAVRPMR "RAM value vAVRPMR" UWORD COMP_0006 1 100 0 819187.5 ECU_ADDRESS 0xFFFF2394 READ_WRITE /end MEASUREMENT
/begin MEASUREMENT vAVTO "RAM value vAVTO" UWORD COMP_0250 1 100 0 262140 ECU_ADDRESS 0xFFFF32FE READ_WRITE /end MEASUREMENT
/begin MEASUREMENT vAVTOS "RAM value vAVTOS" UWORD COMP_0250 1 100 0 262140 ECU_ADDRESS 0xFFFF3300 READ_WRITE /end MEASUREMENT
/begin MEASUREMENT vAVTPDL "RAM value vAVTPDL" ULONG COMP_0144 1 100 0 2097150.9257699 ECU_ADDRESS 0xFFFF3100 READ_WRITE /end MEASUREMENT
/begin MEASUREMENT vAVTPRAPL "RAM value vAVTPRAPL" ULONG COMP_0144 1 100 0 2097150.9257699 ECU_ADDRESS 0xFFFF3104 READ_WRITE /end MEASUREMENT
/begin MEASUREMENT vAVTVO "RAM value vAVTVO" UWORD COMP_0372 1 100 0 52.428 ECU_ADDRESS 0xFFFF0A8A READ_WRITE /end MEASUREMENT
/begin MEASUREMENT vB0MODEL "RAM value vB0MODEL" SWORD COMP_0005_S 1 100 -3.2768 3.2767 ECU_ADDRESS 0xFFFF0A8C READ_WRITE /end MEASUREMENT
/begin MEASUREMENT vB1MODEL "RAM value vB1MODEL" SWORD COMP_0005_S 1 100 -3.2768 3.2767 ECU_ADDRESS 0xFFFF0A90 READ_WRITE /end MEASUREMENT
/begin MEASUREMENT vBASANG "RAM value vBASANG" UWORD COMP_0057_S 1 100 0 6553.5 ECU_ADDRESS 0xFFFF0A94 READ_WRITE /end MEASUREMENT
/begin MEASUREMENT vBASEALP "RAM value vBASEALP" UWORD COMP_0501_S 1 100 0 5119.921875 ECU_ADDRESS 0xFFFF2398 READ_WRITE /end MEASUREMENT
/begin MEASUREMENT vBASEEQ "RAM value vBASEEQ" UWORD COMP_0502_S 1 100 0 65.535 ECU_ADDRESS 0xFFFF239A READ_WRITE /end MEASUREMENT
/begin MEASUREMENT vBASEPRS "RAM value vBASEPRS" UWORD COMP_0503_S 1 100 0 5119.921875 ECU_ADDRESS 0xFFFF239C READ_WRITE /end MEASUREMENT
/begin MEASUREMENT vBASLN30K "RAM value vBASLN30K" UWORD COMP_0504_S 1 100 0 127.998046875 ECU_ADDRESS 0xFFFF44D4 READ_WRITE /end MEASUREMENT
/begin MEASUREMENT vBASLRN "RAM value vBASLRN" UBYTE COMP_0048 1 100 0 127.5 ECU_ADDRESS 0xFFFF44D8 READ_WRITE /end MEASUREMENT
/begin MEASUREMENT vBASLRN3E "RAM value vBASLRN3E" UBYTE COMP_0048 1 100 0 127.5 ECU_ADDRESS 0xFFFF44D9 READ_WRITE /end MEASUREMENT
/begin MEASUREMENT vBASLRNEX "RAM value vBASLRNEX" UWORD COMP_0504_S 1 100 0 127.998046875 ECU_ADDRESS 0xFFFF44DC READ_WRITE /end MEASUREMENT
/begin MEASUREMENT vBASLRNK "RAM value vBASLRNK" UWORD COMP_0504_S 1 100 0 127.998046875 ECU_ADDRESS 0xFFFF44E0 READ_WRITE /end MEASUREMENT
/begin MEASUREMENT vBASLRNKEf "RAM value vBASLRNKEf" UBYTE COMP_0004 1 100 0 255 ECU_ADDRESS 0xFFFF0A96 READ_WRITE /end MEASUREMENT
/begin MEASUREMENT vBASLRNKf "RAM value vBASLRNKf" UBYTE COMP_0004 1 100 0 255 ECU_ADDRESS 0xFFFF0A97 READ_WRITE /end MEASUREMENT
/begin MEASUREMENT vBASOFAV "RAM value vBASOFAV" UWORD COMP_0528 1 100 -64 63.998046875 ECU_ADDRESS 0xFFFF0A98 READ_WRITE /end MEASUREMENT
/begin MEASUREMENT vBASOFAVE "RAM value vBASOFAVE" UWORD COMP_0528 1 100 -64 63.998046875 ECU_ADDRESS 0xFFFF0A9C READ_WRITE /end MEASUREMENT
/begin MEASUREMENT vBASOFS "RAM value vBASOFS" UBYTE COMP_0256 1 100 -64 63.5 ECU_ADDRESS 0xFFFF0AA0 READ_WRITE /end MEASUREMENT
/begin MEASUREMENT vBASOFS3E "RAM value vBASOFS3E" UBYTE COMP_0256 1 100 -64 63.5 ECU_ADDRESS 0xFFFF0AA1 READ_WRITE /end MEASUREMENT
/begin MEASUREMENT vBASOFSK "RAM value vBASOFSK" UWORD COMP_0528 1 100 -64 63.998046875 ECU_ADDRESS 0xFFFF0AA4 READ_WRITE /end MEASUREMENT
/begin MEASUREMENT vBASOFSKE "RAM value vBASOFSKE" UWORD COMP_0528 1 100 -64 63.998046875 ECU_ADDRESS 0xFFFF0AA8 READ_WRITE /end MEASUREMENT
/begin MEASUREMENT vBASPCV "RAM value vBASPCV" UBYTE COMP_0054 1 100 0 5100 ECU_ADDRESS 0xFFFF44E4 READ_WRITE /end MEASUREMENT
/begin MEASUREMENT vBASVP1 "RAM value vBASVP1" UWORD COMP_0050 1 100 0 5119.921875 ECU_ADDRESS 0xFFFF239E READ_WRITE /end MEASUREMENT
/begin MEASUREMENT vBATATMN "RAM value vBATATMN" UBYTE COMP_0035 1 100 -50 205 ECU_ADDRESS 0xFFFF23A0 READ_WRITE /end MEASUREMENT
/begin MEASUREMENT vBATATMP "RAM value vBATATMP" UBYTE COMP_0035 1 100 -50 205 ECU_ADDRESS 0xFFFF23A1 READ_WRITE /end MEASUREMENT
/begin MEASUREMENT vBATATMS "RAM value vBATATMS" UBYTE COMP_0035 1 100 -50 205 ECU_ADDRESS 0xFFFF1FEA READ_WRITE /end MEASUREMENT
/begin MEASUREMENT vBATCURK "RAM value vBATCURK" UWORD COMP_0505_S 1 100 -128 127.99609375 ECU_ADDRESS 0xFFFF1FEC READ_WRITE /end MEASUREMENT
/begin MEASUREMENT vBATCURK2 "RAM value vBATCURK2" UWORD COMP_0495_S 1 100 -327.68 327.67 ECU_ADDRESS 0xFFFF1FEE READ_WRITE /end MEASUREMENT
/begin MEASUREMENT vBATSC "RAM value vBATSC" UWORD COMP_0023 1 100 0 327675 ECU_ADDRESS 0xFFFF23A2 READ_WRITE /end MEASUREMENT
/begin MEASUREMENT vBATSEN "RAM value vBATSEN" UWORD COMP_0023 1 100 0 327675 ECU_ADDRESS 0xFFFF1FF0 READ_WRITE /end MEASUREMENT
/begin MEASUREMENT vBATSENK "RAM value vBATSENK" UWORD COMP_0023 1 100 0 327675 ECU_ADDRESS 0xFFFF1FF2 READ_WRITE /end MEASUREMENT
/begin MEASUREMENT vBATSENKS "RAM value vBATSENKS" UWORD COMP_0506_S 1 100 0 32767.5 ECU_ADDRESS 0xFFFF3450 READ_WRITE /end MEASUREMENT
/begin MEASUREMENT vBATSENKS2 "RAM value vBATSENKS2" ULONG COMP_0507_S 1 100 0 1073741823.75 ECU_ADDRESS 0xFFFF15EC READ_WRITE /end MEASUREMENT
/begin MEASUREMENT vBATSTS "RAM value vBATSTS" UBYTE COMP_0068 1 100 0 255 ECU_ADDRESS 0xFFFF23A4 READ_WRITE /end MEASUREMENT
/begin MEASUREMENT vBATSTSZ "RAM value vBATSTSZ" UBYTE COMP_0068 1 100 0 255 ECU_ADDRESS 0xFFFF23A5 READ_WRITE /end MEASUREMENT
/begin MEASUREMENT vBATTMP "RAM value vBATTMP" UBYTE COMP_0035 1 100 -50 205 ECU_ADDRESS 0xFFFF44E5 READ_WRITE /end MEASUREMENT
/begin MEASUREMENT vBATTMPN "RAM value vBATTMPN" UBYTE COMP_0035 1 100 -50 205 ECU_ADDRESS 0xFFFF3B4A READ_WRITE /end MEASUREMENT
/begin MEASUREMENT vBATTMPN4 "RAM value vBATTMPN4" ULONG COMP_0508_S 1 100 -50 379.4967295 ECU_ADDRESS 0xFFFF44E8 READ_WRITE /end MEASUREMENT
/begin MEASUREMENT vBATTMPP "RAM value vBATTMPP" UBYTE COMP_0035 1 100 -50 205 ECU_ADDRESS 0xFFFF23A6 READ_WRITE /end MEASUREMENT
/begin MEASUREMENT vBATTMPP4 "RAM value vBATTMPP4" ULONG COMP_0508_S 1 100 -50 379.4967295 ECU_ADDRESS 0xFFFF44EC READ_WRITE /end MEASUREMENT
/begin MEASUREMENT vBCAMIN "RAM value vBCAMIN" ULONG COMP_0189 1 100 0 13743895344 ECU_ADDRESS 0xFFFF1718 READ_WRITE /end MEASUREMENT
/begin MEASUREMENT vBCMMSG1T "RAM value vBCMMSG1T" UBYTE COMP_0014 1 100 0 2550 ECU_ADDRESS 0xFFFF3452 READ_WRITE /end MEASUREMENT
/begin MEASUREMENT vBCMSCT "RAM value vBCMSCT" UBYTE COMP_0014 1 100 0 2550 ECU_ADDRESS 0xFFFF1FF4 READ_WRITE /end MEASUREMENT
/begin MEASUREMENT vBCUR "RAM value vBCUR" UBYTE COMP_0045_S 1 100 0 255 ECU_ADDRESS 0xFFFF23A7 READ_WRITE /end MEASUREMENT
/begin MEASUREMENT vBCUTRQ "RAM value vBCUTRQ" UBYTE COMP_0131_S 1 100 0 127.5 ECU_ADDRESS 0xFFFF23A8 READ_WRITE /end MEASUREMENT
/begin MEASUREMENT vBCUTRQ0 "RAM value vBCUTRQ0" UBYTE COMP_0131_S 1 100 0 127.5 ECU_ADDRESS 0xFFFF23A9 READ_WRITE /end MEASUREMENT
/begin MEASUREMENT vBDLR1 "RAM value vBDLR1" UBYTE COMP_0382 1 100 0 2550 ECU_ADDRESS 0xFFFF4E5A READ_WRITE /end MEASUREMENT
/begin MEASUREMENT vBDLR2 "RAM value vBDLR2" UBYTE COMP_0382 1 100 0 2550 ECU_ADDRESS 0xFFFF44F0 READ_WRITE /end MEASUREMENT
/begin MEASUREMENT vBDRL1 "RAM value vBDRL1" UBYTE COMP_0382 1 100 0 2550 ECU_ADDRESS 0xFFFF4E5B READ_WRITE /end MEASUREMENT
/begin MEASUREMENT vBDRL2 "RAM value vBDRL2" UBYTE COMP_0382 1 100 0 2550 ECU_ADDRESS 0xFFFF44F1 READ_WRITE /end MEASUREMENT
/begin MEASUREMENT vBEESTAT1 "RAM value vBEESTAT1" UBYTE COMP_0004_S 1 100 -50 205 ECU_ADDRESS 0xFFFF44F2 READ_WRITE /end MEASUREMENT
/begin MEASUREMENT vBEESTAT2 "RAM value vBEESTAT2" UBYTE COMP_0004_S 1 100 -50 205 ECU_ADDRESS 0xFFFF44F3 READ_WRITE /end MEASUREMENT
/begin MEASUREMENT vBEESTAT3 "RAM value vBEESTAT3" UBYTE COMP_0004_S 1 100 -50 205 ECU_ADDRESS 0xFFFF44F4 READ_WRITE /end MEASUREMENT
/begin MEASUREMENT vBEESTCT1 "RAM value vBEESTCT1" SLONG COMP_0115_S 1 100 -214748.3648 214748.3647 ECU_ADDRESS 0xFFFF44F8 READ_WRITE /end MEASUREMENT
/begin MEASUREMENT vBEESTCT2 "RAM value vBEESTCT2" SLONG COMP_0115_S 1 100 -214748.3648 214748.3647 ECU_ADDRESS 0xFFFF44FC READ_WRITE /end MEASUREMENT
/begin MEASUREMENT vBEESTCT3 "RAM value vBEESTCT3" SLONG COMP_0115_S 1 100 -214748.3648 214748.3647 ECU_ADDRESS 0xFFFF4500 READ_WRITE /end MEASUREMENT
/begin MEASUREMENT vBEFGN1 "RAM value vBEFGN1" UWORD COMP_0050 1 100 0 5119.921875 ECU_ADDRESS 0xFFFF4504 READ_WRITE /end MEASUREMENT
/begin MEASUREMENT vBEFGN2 "RAM value vBEFGN2" UWORD COMP_0050 1 100 0 5119.921875 ECU_ADDRESS 0xFFFF4506 READ_WRITE /end MEASUREMENT
/begin MEASUREMENT vBEFGN3 "RAM value vBEFGN3" UWORD COMP_0050 1 100 0 5119.921875 ECU_ADDRESS 0xFFFF4508 READ_WRITE /end MEASUREMENT
/begin MEASUREMENT vBEIT1CL "RAM value vBEIT1CL" UWORD COMP_0061 1 100 0 327675 ECU_ADDRESS 0xFFFF23AA READ_WRITE /end MEASUREMENT
/begin MEASUREMENT vBEIT2CL "RAM value vBEIT2CL" UWORD COMP_0061 1 100 0 327675 ECU_ADDRESS 0xFFFF23AC READ_WRITE /end MEASUREMENT
/begin MEASUREMENT vBEIT4BCL "RAM value vBEIT4BCL" UWORD COMP_0061 1 100 0 327675 ECU_ADDRESS 0xFFFF23AE READ_WRITE /end MEASUREMENT
/begin MEASUREMENT vBET1CL "RAM value vBET1CL" UWORD COMP_0061 1 100 0 327675 ECU_ADDRESS 0xFFFF23B0 READ_WRITE /end MEASUREMENT
/begin MEASUREMENT vBET2CL "RAM value vBET2CL" UWORD COMP_0061 1 100 0 327675 ECU_ADDRESS 0xFFFF23B2 READ_WRITE /end MEASUREMENT
/begin MEASUREMENT vBET4BCL "RAM value vBET4BCL" UWORD COMP_0061 1 100 0 327675 ECU_ADDRESS 0xFFFF23B4 READ_WRITE /end MEASUREMENT
/begin MEASUREMENT vBETAD "RAM value vBETAD" SWORD COMP_0078 1 100 -128 127.99609375 ECU_ADDRESS 0xFFFF0AAC READ_WRITE /end MEASUREMENT
/begin MEASUREMENT vBETADRLM "RAM value vBETADRLM" UWORD COMP_0081 1 100 0 255.99609375 ECU_ADDRESS 0xFFFF23B6 READ_WRITE /end MEASUREMENT
/begin MEASUREMENT vBETWN1 "RAM value vBETWN1" UBYTE COMP_0004_S 1 100 -50 205 ECU_ADDRESS 0xFFFF450A READ_WRITE /end MEASUREMENT
/begin MEASUREMENT vBETWN2 "RAM value vBETWN2" UBYTE COMP_0004_S 1 100 -50 205 ECU_ADDRESS 0xFFFF450B READ_WRITE /end MEASUREMENT
/begin MEASUREMENT vBETWN3 "RAM value vBETWN3" UBYTE COMP_0004_S 1 100 -50 205 ECU_ADDRESS 0xFFFF450C READ_WRITE /end MEASUREMENT
/begin MEASUREMENT vBFAPO "RAM value vBFAPO" UWORD COMP_0005 1 100 0 7208.85 ECU_ADDRESS 0xFFFF0AAE READ_WRITE /end MEASUREMENT
/begin MEASUREMENT vBFAPO_S "RAM value vBFAPO_S" UWORD COMP_0005 1 100 0 7208.85 ECU_ADDRESS 0xFFFF3A00 READ_WRITE /end MEASUREMENT
/begin MEASUREMENT vBFCNL2 "RAM value vBFCNL2" UBYTE COMP_0030 1 100 0 255 ECU_ADDRESS 0xFFFF23B8 READ_WRITE /end MEASUREMENT
/begin MEASUREMENT vBFCNL3 "RAM value vBFCNL3" UBYTE COMP_0030 1 100 0 255 ECU_ADDRESS 0xFFFF23B9 READ_WRITE /end MEASUREMENT
/begin MEASUREMENT vBFCNR2 "RAM value vBFCNR2" UBYTE COMP_0030 1 100 0 255 ECU_ADDRESS 0xFFFF23BA READ_WRITE /end MEASUREMENT
/begin MEASUREMENT vBFCNR3 "RAM value vBFCNR3" UBYTE COMP_0030 1 100 0 255 ECU_ADDRESS 0xFFFF23BB READ_WRITE /end MEASUREMENT
/begin MEASUREMENT vBFCYLER "RAM value vBFCYLER" UBYTE COMP_0092 1 100 0 255 ECU_ADDRESS 0xFFFF0AB0 READ_WRITE /end MEASUREMENT
/begin MEASUREMENT vBFHOSNC "RAM value vBFHOSNC" UBYTE COMP_0030 1 100 0 255 ECU_ADDRESS 0xFFFF23BC READ_WRITE /end MEASUREMENT
/begin MEASUREMENT vBHOS "RAM value vBHOS" UBYTE COMP_0245 1 100 -64 191 ECU_ADDRESS 0xFFFF0AB1 READ_WRITE /end MEASUREMENT
/begin MEASUREMENT vBHRAM "RAM value vBHRAM" UBYTE COMP_0365_S 1 100 0 63.75 ECU_ADDRESS 0xFFFF0AB2 READ_WRITE /end MEASUREMENT
/begin MEASUREMENT vBIADVLTR "RAM value vBIADVLTR" SBYTE COMP_0018 1 100 -128 127 ECU_ADDRESS 0xFFFF23BD READ_WRITE /end MEASUREMENT
/begin MEASUREMENT vBIASHOS "RAM value vBIASHOS" SBYTE COMP_0509_S 1 100 -32 31.75 ECU_ADDRESS 0xFFFF23BE READ_WRITE /end MEASUREMENT
/begin MEASUREMENT vBIT1CL "RAM value vBIT1CL" UWORD COMP_0061 1 100 0 327675 ECU_ADDRESS 0xFFFF23C0 READ_WRITE /end MEASUREMENT
/begin MEASUREMENT vBIT2CL "RAM value vBIT2CL" UWORD COMP_0061 1 100 0 327675 ECU_ADDRESS 0xFFFF23C2 READ_WRITE /end MEASUREMENT
/begin MEASUREMENT vBIT4BCL "RAM value vBIT4BCL" UWORD COMP_0061 1 100 0 327675 ECU_ADDRESS 0xFFFF23C4 READ_WRITE /end MEASUREMENT
/begin MEASUREMENT vBITCNT "RAM value vBITCNT" UWORD COMP_0068 1 100 0 65535 ECU_ADDRESS 0xFFFF23C6 READ_WRITE /end MEASUREMENT
/begin MEASUREMENT vBITCNTB "RAM value vBITCNTB" UWORD COMP_0068 1 100 0 65535 ECU_ADDRESS 0xFFFF23C8 READ_WRITE /end MEASUREMENT
/begin MEASUREMENT vBKKPTY "RAM value vBKKPTY" ULONG COMP_0068 1 100 0 4294967295 ECU_ADDRESS 0xFFFF23CC READ_WRITE /end MEASUREMENT
/begin MEASUREMENT vBKKSUM "RAM value vBKKSUM" ULONG COMP_0068 1 100 0 4294967295 ECU_ADDRESS 0xFFFF23D0 READ_WRITE /end MEASUREMENT
/begin MEASUREMENT vBKNKFB "RAM value vBKNKFB" SWORD COMP_0078 1 100 -128 127.99609375 ECU_ADDRESS 0xFFFF23D4 READ_WRITE /end MEASUREMENT
/begin MEASUREMENT vBKPTY "RAM value vBKPTY" ULONG COMP_0068 1 100 0 4294967295 ECU_ADDRESS 0xFFFF23D8 READ_WRITE /end MEASUREMENT
/begin MEASUREMENT vBKSUM "RAM value vBKSUM" ULONG COMP_0068 1 100 0 4294967295 ECU_ADDRESS 0xFFFF23DC READ_WRITE /end MEASUREMENT
/begin MEASUREMENT vBKSWTM "RAM value vBKSWTM" UWORD COMP_0013 1 100 0 65535 ECU_ADDRESS 0xFFFF4E5C READ_WRITE /end MEASUREMENT
/begin MEASUREMENT vBLBST "RAM value vBLBST" UBYTE COMP_0016 1 100 0 255 ECU_ADDRESS 0xFFFF0AB3 READ_WRITE /end MEASUREMENT
/begin MEASUREMENT vBLBYC "RAM value vBLBYC" UBYTE COMP_0016 1 100 0 255 ECU_ADDRESS 0xFFFF450D READ_WRITE /end MEASUREMENT
/begin MEASUREMENT vBLFANVLT "RAM value vBLFANVLT" UBYTE COMP_0050_S 1 100 0 127.5 ECU_ADDRESS 0xFFFF1FF5 READ_WRITE /end MEASUREMENT
/begin MEASUREMENT vBNCADV "RAM value vBNCADV" UBYTE COMP_0054 1 100 0 5100 ECU_ADDRESS 0xFFFF3108 READ_WRITE /end MEASUREMENT
/begin MEASUREMENT vBNCSWTM "RAM value vBNCSWTM" UWORD COMP_0013 1 100 0 65535 ECU_ADDRESS 0xFFFF450E READ_WRITE /end MEASUREMENT
/begin MEASUREMENT vBNGTIME1 "RAM value vBNGTIME1" ULONG COMP_0015_S 1 100 0 429496729.5 ECU_ADDRESS 0xFFFF4510 READ_WRITE /end MEASUREMENT
/begin MEASUREMENT vBNGTIME2 "RAM value vBNGTIME2" ULONG COMP_0015_S 1 100 0 429496729.5 ECU_ADDRESS 0xFFFF4514 READ_WRITE /end MEASUREMENT
/begin MEASUREMENT vBNGTIME3 "RAM value vBNGTIME3" ULONG COMP_0015_S 1 100 0 429496729.5 ECU_ADDRESS 0xFFFF4518 READ_WRITE /end MEASUREMENT
/begin MEASUREMENT vBOSACTTM "RAM value vBOSACTTM" UWORD COMP_0014 1 100 0 655350 ECU_ADDRESS 0xFFFF23E0 READ_WRITE /end MEASUREMENT
/begin MEASUREMENT vBOSAPOLM "RAM value vBOSAPOLM" UWORD COMP_0032_S 1 100 0 8191.875 ECU_ADDRESS 0xFFFF23E2 READ_WRITE /end MEASUREMENT
/begin MEASUREMENT vBOSDAPO "RAM value vBOSDAPO" SWORD COMP_0510_S 1 100 -3604.48 3604.37 ECU_ADDRESS 0xFFFF23E4 READ_WRITE /end MEASUREMENT
/begin MEASUREMENT vBOSLMTUP "RAM value vBOSLMTUP" UWORD COMP_0052_S 1 100 0 8191.875 ECU_ADDRESS 0xFFFF23E6 READ_WRITE /end MEASUREMENT
/begin MEASUREMENT vBPRAM1f "RAM value vBPRAM1f" UBYTE COMP_0004 1 100 0 255 ECU_ADDRESS 0xFFFF3453 READ_WRITE /end MEASUREMENT
/begin MEASUREMENT vBPS8M "RAM value vBPS8M" UBYTE COMP_0047 1 100 0 127.5 ECU_ADDRESS 0xFFFF0AB4 READ_WRITE /end MEASUREMENT
/begin MEASUREMENT vBPSBUF "RAM value vBPSBUF" UBYTE COMP_0068 1 100 0 255 ECU_ADDRESS 0xFFFF23E8 READ_WRITE /end MEASUREMENT
/begin MEASUREMENT vBREFIN "RAM value vBREFIN" ULONG COMP_0189 1 100 0 13743895344 ECU_ADDRESS 0xFFFF171C READ_WRITE /end MEASUREMENT
/begin MEASUREMENT vBRKCNT "RAM value vBRKCNT" UBYTE COMP_0068 1 100 0 255 ECU_ADDRESS 0xFFFF23E9 READ_WRITE /end MEASUREMENT
/begin MEASUREMENT vBRKGNLDT "RAM value vBRKGNLDT" UBYTE COMP_0014 1 100 0 2550 ECU_ADDRESS 0xFFFF1FF6 READ_WRITE /end MEASUREMENT
/begin MEASUREMENT vBRKOFVB "RAM value vBRKOFVB" UBYTE COMP_0033 1 100 0 20400 ECU_ADDRESS 0xFFFF0AB5 READ_WRITE /end MEASUREMENT
/begin MEASUREMENT vBRMN1 "RAM value vBRMN1" UBYTE COMP_0104 1 100 0 2550 ECU_ADDRESS 0xFFFF4E5E READ_WRITE /end MEASUREMENT
/begin MEASUREMENT vBRMN2 "RAM value vBRMN2" UBYTE COMP_0104 1 100 0 2550 ECU_ADDRESS 0xFFFF451C READ_WRITE /end MEASUREMENT
/begin MEASUREMENT vBRMX1 "RAM value vBRMX1" UBYTE COMP_0104 1 100 0 2550 ECU_ADDRESS 0xFFFF4E5F READ_WRITE /end MEASUREMENT
/begin MEASUREMENT vBRMX2 "RAM value vBRMX2" UBYTE COMP_0104 1 100 0 2550 ECU_ADDRESS 0xFFFF451D READ_WRITE /end MEASUREMENT
/begin MEASUREMENT vBRRbuf "RAM value vBRRbuf" UWORD COMP_0004 1 100 0 65535 ECU_ADDRESS 0xFFFF3454 READ_WRITE /end MEASUREMENT
/begin MEASUREMENT vBRSTBCTT "RAM value vBRSTBCTT" UBYTE COMP_0014 1 100 0 2550 ECU_ADDRESS 0xFFFF1FF7 READ_WRITE /end MEASUREMENT
/begin MEASUREMENT vBSCHKTM "RAM value vBSCHKTM" UWORD COMP_0040_S 1 100 0 655.35 ECU_ADDRESS 0xFFFF23EA READ_WRITE /end MEASUREMENT
/begin MEASUREMENT vBSCHKTM2 "RAM value vBSCHKTM2" UWORD COMP_0040_S 1 100 0 655.35 ECU_ADDRESS 0xFFFF23EC READ_WRITE /end MEASUREMENT
/begin MEASUREMENT vBSESTAT1 "RAM value vBSESTAT1" UBYTE COMP_0004_S 1 100 -50 205 ECU_ADDRESS 0xFFFF451E READ_WRITE /end MEASUREMENT
/begin MEASUREMENT vBSESTAT2 "RAM value vBSESTAT2" UBYTE COMP_0004_S 1 100 -50 205 ECU_ADDRESS 0xFFFF451F READ_WRITE /end MEASUREMENT
/begin MEASUREMENT vBSESTAT3 "RAM value vBSESTAT3" UBYTE COMP_0004_S 1 100 -50 205 ECU_ADDRESS 0xFFFF4520 READ_WRITE /end MEASUREMENT
/begin MEASUREMENT vBSESTCT1 "RAM value vBSESTCT1" SLONG COMP_0115_S 1 100 -214748.3648 214748.3647 ECU_ADDRESS 0xFFFF4524 READ_WRITE /end MEASUREMENT
/begin MEASUREMENT vBSESTCT2 "RAM value vBSESTCT2" SLONG COMP_0115_S 1 100 -214748.3648 214748.3647 ECU_ADDRESS 0xFFFF4528 READ_WRITE /end MEASUREMENT
/begin MEASUREMENT vBSESTCT3 "RAM value vBSESTCT3" SLONG COMP_0115_S 1 100 -214748.3648 214748.3647 ECU_ADDRESS 0xFFFF452C READ_WRITE /end MEASUREMENT
/begin MEASUREMENT vBSFGN1 "RAM value vBSFGN1" UWORD COMP_0050 1 100 0 5119.921875 ECU_ADDRESS 0xFFFF4530 READ_WRITE /end MEASUREMENT
/begin MEASUREMENT vBSFGN2 "RAM value vBSFGN2" UWORD COMP_0050 1 100 0 5119.921875 ECU_ADDRESS 0xFFFF4532 READ_WRITE /end MEASUREMENT
/begin MEASUREMENT vBSFGN3 "RAM value vBSFGN3" UWORD COMP_0050 1 100 0 5119.921875 ECU_ADDRESS 0xFFFF4534 READ_WRITE /end MEASUREMENT
/begin MEASUREMENT vBSTCOQH "RAM value vBSTCOQH" UWORD COMP_0217 1 100 0 3.999941832 ECU_ADDRESS 0xFFFF0AB6 READ_WRITE /end MEASUREMENT
/begin MEASUREMENT vBSTTIME1 "RAM value vBSTTIME1" ULONG COMP_0015_S 1 100 0 429496729.5 ECU_ADDRESS 0xFFFF4538 READ_WRITE /end MEASUREMENT
/begin MEASUREMENT vBSTTIME2 "RAM value vBSTTIME2" ULONG COMP_0015_S 1 100 0 429496729.5 ECU_ADDRESS 0xFFFF453C READ_WRITE /end MEASUREMENT
/begin MEASUREMENT vBSTTIME3 "RAM value vBSTTIME3" ULONG COMP_0015_S 1 100 0 429496729.5 ECU_ADDRESS 0xFFFF4540 READ_WRITE /end MEASUREMENT
/begin MEASUREMENT vBSTWN1 "RAM value vBSTWN1" UBYTE COMP_0004_S 1 100 -50 205 ECU_ADDRESS 0xFFFF4544 READ_WRITE /end MEASUREMENT
/begin MEASUREMENT vBSTWN2 "RAM value vBSTWN2" UBYTE COMP_0004_S 1 100 -50 205 ECU_ADDRESS 0xFFFF4545 READ_WRITE /end MEASUREMENT
/begin MEASUREMENT vBSTWN3 "RAM value vBSTWN3" UBYTE COMP_0004_S 1 100 -50 205 ECU_ADDRESS 0xFFFF4546 READ_WRITE /end MEASUREMENT
/begin MEASUREMENT vBSVP12 "RAM value vBSVP12" UWORD COMP_0050 1 100 0 5119.921875 ECU_ADDRESS 0xFFFF23EE READ_WRITE /end MEASUREMENT
/begin MEASUREMENT vBTAINT1 "RAM value vBTAINT1" UBYTE COMP_0004_S 1 100 -50 205 ECU_ADDRESS 0xFFFF4547 READ_WRITE /end MEASUREMENT
/begin MEASUREMENT vBTAINT2 "RAM value vBTAINT2" UBYTE COMP_0004_S 1 100 -50 205 ECU_ADDRESS 0xFFFF4548 READ_WRITE /end MEASUREMENT
/begin MEASUREMENT vBTAINT3 "RAM value vBTAINT3" UBYTE COMP_0004_S 1 100 -50 205 ECU_ADDRESS 0xFFFF4549 READ_WRITE /end MEASUREMENT
/begin MEASUREMENT vBTCVHOS "RAM value vBTCVHOS" UBYTE COMP_0017 1 100 0 255 ECU_ADDRESS 0xFFFF0AB8 READ_WRITE /end MEASUREMENT
/begin MEASUREMENT vBTFINT1 "RAM value vBTFINT1" UBYTE COMP_0004_S 1 100 -50 205 ECU_ADDRESS 0xFFFF454A READ_WRITE /end MEASUREMENT
/begin MEASUREMENT vBTFINT2 "RAM value vBTFINT2" UBYTE COMP_0004_S 1 100 -50 205 ECU_ADDRESS 0xFFFF454B READ_WRITE /end MEASUREMENT
/begin MEASUREMENT vBTFINT3 "RAM value vBTFINT3" UBYTE COMP_0004_S 1 100 -50 205 ECU_ADDRESS 0xFFFF454C READ_WRITE /end MEASUREMENT
/begin MEASUREMENT vBTPS1CL "RAM value vBTPS1CL" UWORD COMP_0061 1 100 0 327675 ECU_ADDRESS 0xFFFF23F0 READ_WRITE /end MEASUREMENT
/begin MEASUREMENT vBTPS2CL "RAM value vBTPS2CL" UWORD COMP_0061 1 100 0 327675 ECU_ADDRESS 0xFFFF23F2 READ_WRITE /end MEASUREMENT
/begin MEASUREMENT vBTPS4BCL "RAM value vBTPS4BCL" UWORD COMP_0061 1 100 0 327675 ECU_ADDRESS 0xFFFF23F4 READ_WRITE /end MEASUREMENT
/begin MEASUREMENT vBTRACE "RAM value vBTRACE" UBYTE COMP_0245 1 100 -64 191 ECU_ADDRESS 0xFFFF1B0A READ_WRITE /end MEASUREMENT
/begin MEASUREMENT vBTRHOS "RAM value vBTRHOS" UBYTE COMP_0054_S 1 100 0 3.984375 ECU_ADDRESS 0xFFFF0AB9 READ_WRITE /end MEASUREMENT
/begin MEASUREMENT vBTRORMBT "RAM value vBTRORMBT" SBYTE COMP_0018 1 100 -128 127 ECU_ADDRESS 0xFFFF1B0B READ_WRITE /end MEASUREMENT
/begin MEASUREMENT vBTSEN "RAM value vBTSEN" UBYTE COMP_0054 1 100 0 5100 ECU_ADDRESS 0xFFFF1FF8 READ_WRITE /end MEASUREMENT
/begin MEASUREMENT vBTWINT1 "RAM value vBTWINT1" UBYTE COMP_0004_S 1 100 -50 205 ECU_ADDRESS 0xFFFF454D READ_WRITE /end MEASUREMENT
/begin MEASUREMENT vBTWINT2 "RAM value vBTWINT2" UBYTE COMP_0004_S 1 100 -50 205 ECU_ADDRESS 0xFFFF454E READ_WRITE /end MEASUREMENT
/begin MEASUREMENT vBTWINT3 "RAM value vBTWINT3" UBYTE COMP_0004_S 1 100 -50 205 ECU_ADDRESS 0xFFFF454F READ_WRITE /end MEASUREMENT
/begin MEASUREMENT vBTXGST "RAM value vBTXGST" UBYTE COMP_0068 1 100 0 255 ECU_ADDRESS 0xFFFF3456 READ_WRITE /end MEASUREMENT
/begin MEASUREMENT vBURCNT "RAM value vBURCNT" UBYTE COMP_0016 1 100 0 255 ECU_ADDRESS 0xFFFF23F6 READ_WRITE /end MEASUREMENT
/begin MEASUREMENT vBURMAX "RAM value vBURMAX" UBYTE COMP_0016 1 100 0 255 ECU_ADDRESS 0xFFFF4550 READ_WRITE /end MEASUREMENT
/begin MEASUREMENT vBVTCHOS "RAM value vBVTCHOS" UBYTE COMP_0307_S 1 100 -1 0.9921875 ECU_ADDRESS 0xFFFF0ABA READ_WRITE /end MEASUREMENT
/begin MEASUREMENT vCA10MS "RAM value vCA10MS" UBYTE COMP_0017 1 100 0 255 ECU_ADDRESS 0xFFFF08C2 READ_WRITE /end MEASUREMENT
/begin MEASUREMENT vCALPHA "RAM value vCALPHA" UWORD COMP_0031 1 100 0 255.99609375 ECU_ADDRESS 0xFFFF23F8 READ_WRITE /end MEASUREMENT
/begin MEASUREMENT vCALPSETf "RAM value vCALPSETf" UBYTE COMP_0004 1 100 0 255 ECU_ADDRESS 0xFFFF23FC READ_WRITE /end MEASUREMENT
/begin MEASUREMENT vCALTMX "RAM value vCALTMX" UBYTE COMP_0045_S 1 100 0 255 ECU_ADDRESS 0xFFFF23FD READ_WRITE /end MEASUREMENT
/begin MEASUREMENT vCAMCNT "RAM value vCAMCNT" UBYTE COMP_0068 1 100 0 255 ECU_ADDRESS 0xFFFF0ABB READ_WRITE /end MEASUREMENT
/begin MEASUREMENT vCAMIN "RAM value vCAMIN" UBYTE COMP_0068 1 100 0 255 ECU_ADDRESS 0xFFFF3A0F READ_WRITE /end MEASUREMENT
/begin MEASUREMENT vCAMINST "RAM value vCAMINST" UBYTE COMP_0068 1 100 0 255 ECU_ADDRESS 0xFFFF1720 READ_WRITE /end MEASUREMENT
/begin MEASUREMENT vCAN10MS "RAM value vCAN10MS" UBYTE COMP_0030 1 100 0 255 ECU_ADDRESS 0xFFFF3461 READ_WRITE /end MEASUREMENT
/begin MEASUREMENT vCAN244 "RAM value vCAN244" UBYTE COMP_0068 1 100 0 255 ECU_ADDRESS 0xFFFF3462 READ_WRITE /end MEASUREMENT
/begin MEASUREMENT vCAN251 "RAM value vCAN251" UBYTE COMP_0068 1 100 0 255 ECU_ADDRESS 0xFFFF3463 READ_WRITE /end MEASUREMENT
/begin MEASUREMENT vCAN253 "RAM value vCAN253" UBYTE COMP_0068 1 100 0 255 ECU_ADDRESS 0xFFFF3464 READ_WRITE /end MEASUREMENT
/begin MEASUREMENT vCAN254 "RAM value vCAN254" UBYTE COMP_0068 1 100 0 255 ECU_ADDRESS 0xFFFF3465 READ_WRITE /end MEASUREMENT
/begin MEASUREMENT vCAN255 "RAM value vCAN255" UBYTE COMP_0068 1 100 0 255 ECU_ADDRESS 0xFFFF3466 READ_WRITE /end MEASUREMENT
/begin MEASUREMENT vCAN256 "RAM value vCAN256" UBYTE COMP_0068 1 100 0 255 ECU_ADDRESS 0xFFFF3467 READ_WRITE /end MEASUREMENT
/begin MEASUREMENT vCAN280 "RAM value vCAN280" UBYTE COMP_0068 1 100 0 255 ECU_ADDRESS 0xFFFF3468 READ_WRITE /end MEASUREMENT
/begin MEASUREMENT vCAN284 "RAM value vCAN284" UBYTE COMP_0068 1 100 0 255 ECU_ADDRESS 0xFFFF3469 READ_WRITE /end MEASUREMENT
/begin MEASUREMENT vCAN29E "RAM value vCAN29E" UBYTE COMP_0068 1 100 0 255 ECU_ADDRESS 0xFFFF346A READ_WRITE /end MEASUREMENT
/begin MEASUREMENT vCAN2A5 "RAM value vCAN2A5" UBYTE COMP_0068 1 100 0 255 ECU_ADDRESS 0xFFFF346B READ_WRITE /end MEASUREMENT
/begin MEASUREMENT vCAN2A6 "RAM value vCAN2A6" UBYTE COMP_0068 1 100 0 255 ECU_ADDRESS 0xFFFF346C READ_WRITE /end MEASUREMENT
/begin MEASUREMENT vCAN2A8 "RAM value vCAN2A8" UBYTE COMP_0068 1 100 0 255 ECU_ADDRESS 0xFFFF346D READ_WRITE /end MEASUREMENT
/begin MEASUREMENT vCAN2D1 "RAM value vCAN2D1" UBYTE COMP_0068 1 100 0 255 ECU_ADDRESS 0xFFFF346E READ_WRITE /end MEASUREMENT
/begin MEASUREMENT vCAN2D2 "RAM value vCAN2D2" UBYTE COMP_0068 1 100 0 255 ECU_ADDRESS 0xFFFF346F READ_WRITE /end MEASUREMENT
/begin MEASUREMENT vCAN2DE "RAM value vCAN2DE" UBYTE COMP_0068 1 100 0 255 ECU_ADDRESS 0xFFFF3470 READ_WRITE /end MEASUREMENT
/begin MEASUREMENT vCAN300 "RAM value vCAN300" UBYTE COMP_0068 1 100 0 255 ECU_ADDRESS 0xFFFF3471 READ_WRITE /end MEASUREMENT
/begin MEASUREMENT vCAN341 "RAM value vCAN341" UBYTE COMP_0068 1 100 0 255 ECU_ADDRESS 0xFFFF3472 READ_WRITE /end MEASUREMENT
/begin MEASUREMENT vCAN358 "RAM value vCAN358" UBYTE COMP_0068 1 100 0 255 ECU_ADDRESS 0xFFFF3473 READ_WRITE /end MEASUREMENT
/begin MEASUREMENT vCAN35D "RAM value vCAN35D" UBYTE COMP_0068 1 100 0 255 ECU_ADDRESS 0xFFFF3474 READ_WRITE /end MEASUREMENT
/begin MEASUREMENT vCAN5C5 "RAM value vCAN5C5" UBYTE COMP_0068 1 100 0 255 ECU_ADDRESS 0xFFFF3475 READ_WRITE /end MEASUREMENT
/begin MEASUREMENT vCAN611 "RAM value vCAN611" UBYTE COMP_0068 1 100 0 255 ECU_ADDRESS 0xFFFF3476 READ_WRITE /end MEASUREMENT
/begin MEASUREMENT vCAN625 "RAM value vCAN625" UBYTE COMP_0068 1 100 0 255 ECU_ADDRESS 0xFFFF3477 READ_WRITE /end MEASUREMENT
/begin MEASUREMENT vCANDLM "RAM value vCANDLM" UBYTE COMP_0068 1 100 0 255 ECU_ADDRESS 0xFFFF35E0 READ_WRITE /end MEASUREMENT
/begin MEASUREMENT vCANICFZL "RAM value vCANICFZL" ULONG COMP_0068 1 100 0 4294967295 ECU_ADDRESS 0xFFFF35E4 READ_WRITE /end MEASUREMENT
/begin MEASUREMENT vCANPRNTX "RAM value vCANPRNTX" UBYTE COMP_0014 1 100 0 2550 ECU_ADDRESS 0xFFFF35E8 READ_WRITE /end MEASUREMENT
/begin MEASUREMENT vCANPRT10 "RAM value vCANPRT10" UBYTE COMP_0008 1 100 0 25500 ECU_ADDRESS 0xFFFF35E9 READ_WRITE /end MEASUREMENT
/begin MEASUREMENT vCANPRTX2 "RAM value vCANPRTX2" UBYTE COMP_0183 1 100 0 5100 ECU_ADDRESS 0xFFFF35EA READ_WRITE /end MEASUREMENT
/begin MEASUREMENT vCANTXCT2 "RAM value vCANTXCT2" UBYTE COMP_0068 1 100 0 255 ECU_ADDRESS 0xFFFF35EB READ_WRITE /end MEASUREMENT
/begin MEASUREMENT vCAPGENZ "RAM value vCAPGENZ" UBYTE COMP_0068 1 100 0 255 ECU_ADDRESS 0xFFFF0ABC READ_WRITE /end MEASUREMENT
/begin MEASUREMENT vCARSTOP "RAM value vCARSTOP" UWORD COMP_0105 1 100 0 6553.5 ECU_ADDRESS 0xFFFF23FE READ_WRITE /end MEASUREMENT
/begin MEASUREMENT vCATAR2f "RAM value vCATAR2f" UBYTE COMP_0004 1 100 0 255 ECU_ADDRESS 0xFFFF2400 READ_WRITE /end MEASUREMENT
/begin MEASUREMENT vCATARA "RAM value vCATARA" UBYTE COMP_0068 1 100 0 255 ECU_ADDRESS 0xFFFF2401 READ_WRITE /end MEASUREMENT
/begin MEASUREMENT vCATARAf "RAM value vCATARAf" UBYTE COMP_0004 1 100 0 255 ECU_ADDRESS 0xFFFF2402 READ_WRITE /end MEASUREMENT
/begin MEASUREMENT vCATCNGf "RAM value vCATCNGf" UBYTE COMP_0004 1 100 0 255 ECU_ADDRESS 0xFFFF2403 READ_WRITE /end MEASUREMENT
/begin MEASUREMENT vCATCNT1 "RAM value vCATCNT1" UWORD COMP_0016 1 100 0 65535 ECU_ADDRESS 0xFFFF510A READ_WRITE /end MEASUREMENT
/begin MEASUREMENT vCATCNT2 "RAM value vCATCNT2" UWORD COMP_0016 1 100 0 65535 ECU_ADDRESS 0xFFFF4552 READ_WRITE /end MEASUREMENT
/begin MEASUREMENT vCATDAN "RAM value vCATDAN" UBYTE COMP_0017 1 100 0 255 ECU_ADDRESS 0xFFFF1B0C READ_WRITE /end MEASUREMENT
/begin MEASUREMENT vCATDGNSTf "RAM value vCATDGNSTf" UBYTE COMP_0004 1 100 0 255 ECU_ADDRESS 0xFFFF2404 READ_WRITE /end MEASUREMENT
/begin MEASUREMENT vCATENDVf "RAM value vCATENDVf" UBYTE COMP_0004 1 100 0 255 ECU_ADDRESS 0xFFFF2406 READ_WRITE /end MEASUREMENT
/begin MEASUREMENT vCATENDf "RAM value vCATENDf" UBYTE COMP_0004 1 100 0 255 ECU_ADDRESS 0xFFFF2405 READ_WRITE /end MEASUREMENT
/begin MEASUREMENT vCATEVPf "RAM value vCATEVPf" UBYTE COMP_0004 1 100 0 255 ECU_ADDRESS 0xFFFF2407 READ_WRITE /end MEASUREMENT
/begin MEASUREMENT vCATIMR "RAM value vCATIMR" UBYTE COMP_0004 1 100 0 255 ECU_ADDRESS 0xFFFF4554 READ_WRITE /end MEASUREMENT
/begin MEASUREMENT vCATJUGf "RAM value vCATJUGf" UBYTE COMP_0004 1 100 0 255 ECU_ADDRESS 0xFFFF2408 READ_WRITE /end MEASUREMENT
/begin MEASUREMENT vCATRECL "RAM value vCATRECL" UBYTE COMP_0019_S 1 100 0 1.000000095 ECU_ADDRESS 0xFFFF2409 READ_WRITE /end MEASUREMENT
/begin MEASUREMENT vCATRESIM "RAM value vCATRESIM" UBYTE COMP_0019_S 1 100 0 1.000000095 ECU_ADDRESS 0xFFFF20F1 READ_WRITE /end MEASUREMENT
/begin MEASUREMENT vCATRESIU "RAM value vCATRESIU" UBYTE COMP_0019_S 1 100 0 1.000000095 ECU_ADDRESS 0xFFFF20F2 READ_WRITE /end MEASUREMENT
/begin MEASUREMENT vCATSLSFT "RAM value vCATSLSFT" SWORD COMP_0020_S 1 100 -65.536 65.534 ECU_ADDRESS 0xFFFF240A READ_WRITE /end MEASUREMENT
/begin MEASUREMENT vCATST1B1 "RAM value vCATST1B1" UWORD COMP_0016 1 100 0 65535 ECU_ADDRESS 0xFFFF4556 READ_WRITE /end MEASUREMENT
/begin MEASUREMENT vCATST1B2 "RAM value vCATST1B2" UWORD COMP_0016 1 100 0 65535 ECU_ADDRESS 0xFFFF4558 READ_WRITE /end MEASUREMENT
/begin MEASUREMENT vCATST2f "RAM value vCATST2f" UBYTE COMP_0004 1 100 0 255 ECU_ADDRESS 0xFFFF240E READ_WRITE /end MEASUREMENT
/begin MEASUREMENT vCATTRP "RAM value vCATTRP" UWORD COMP_0016 1 100 0 65535 ECU_ADDRESS 0xFFFF510C READ_WRITE /end MEASUREMENT
/begin MEASUREMENT vCATTS "RAM value vCATTS" UBYTE COMP_0054 1 100 0 5100 ECU_ADDRESS 0xFFFF15F0 READ_WRITE /end MEASUREMENT
/begin MEASUREMENT vCATWAMTM "RAM value vCATWAMTM" UBYTE COMP_0013 1 100 0 255 ECU_ADDRESS 0xFFFF240F READ_WRITE /end MEASUREMENT
/begin MEASUREMENT vCAWA "RAM value vCAWA" UBYTE COMP_0395 1 100 0 0.062255955 ECU_ADDRESS 0xFFFF2410 READ_WRITE /end MEASUREMENT
/begin MEASUREMENT vCAWP "RAM value vCAWP" UBYTE COMP_0395 1 100 0 0.062255955 ECU_ADDRESS 0xFFFF2411 READ_WRITE /end MEASUREMENT
/begin MEASUREMENT vCAY "RAM value vCAY" UWORD COMP_0248 1 100 0 255.99609375 ECU_ADDRESS 0xFFFF2412 READ_WRITE /end MEASUREMENT
/begin MEASUREMENT vCAYA "RAM value vCAYA" UWORD COMP_0248 1 100 0 255.99609375 ECU_ADDRESS 0xFFFF2414 READ_WRITE /end MEASUREMENT
/begin MEASUREMENT vCAYK "RAM value vCAYK" UWORD COMP_0248 1 100 0 255.99609375 ECU_ADDRESS 0xFFFF2416 READ_WRITE /end MEASUREMENT
/begin MEASUREMENT vCAYP "RAM value vCAYP" UWORD COMP_0248 1 100 0 255.99609375 ECU_ADDRESS 0xFFFF2418 READ_WRITE /end MEASUREMENT
/begin MEASUREMENT vCBADVLIM "RAM value vCBADVLIM" UBYTE COMP_0245 1 100 -64 191 ECU_ADDRESS 0xFFFF241A READ_WRITE /end MEASUREMENT
/begin MEASUREMENT vCBSTAN "RAM value vCBSTAN" UBYTE COMP_0016 1 100 0 255 ECU_ADDRESS 0xFFFF1721 READ_WRITE /end MEASUREMENT
/begin MEASUREMENT vCBTECNT "RAM value vCBTECNT" UBYTE COMP_0068 1 100 0 255 ECU_ADDRESS 0xFFFF455A READ_WRITE /end MEASUREMENT
/begin MEASUREMENT vCCATWP "RAM value vCCATWP" UBYTE COMP_0096 1 100 0 2550 ECU_ADDRESS 0xFFFF241B READ_WRITE /end MEASUREMENT
/begin MEASUREMENT vCCDISPFS "RAM value vCCDISPFS" UBYTE COMP_0068 1 100 0 255 ECU_ADDRESS 0xFFFF3B4B READ_WRITE /end MEASUREMENT
/begin MEASUREMENT vCCHGADHR "RAM value vCCHGADHR" SWORD COMP_0204_S 1 100 -3276800 3276700 ECU_ADDRESS 0xFFFF3B4C READ_WRITE /end MEASUREMENT
/begin MEASUREMENT vCCHGADLR "RAM value vCCHGADLR" SWORD COMP_0204_S 1 100 -3276800 3276700 ECU_ADDRESS 0xFFFF241C READ_WRITE /end MEASUREMENT
/begin MEASUREMENT vCCHGADMR "RAM value vCCHGADMR" SWORD COMP_0204_S 1 100 -3276800 3276700 ECU_ADDRESS 0xFFFF241E READ_WRITE /end MEASUREMENT
/begin MEASUREMENT vCCHIGRIH "RAM value vCCHIGRIH" UBYTE COMP_0068 1 100 0 255 ECU_ADDRESS 0xFFFF35EC READ_WRITE /end MEASUREMENT
/begin MEASUREMENT vCCPWTSP "RAM value vCCPWTSP" UWORD COMP_0032_S 1 100 0 8191.875 ECU_ADDRESS 0xFFFF08C4 READ_WRITE /end MEASUREMENT
/begin MEASUREMENT vCCSTATUS "RAM value vCCSTATUS" UBYTE COMP_0068 1 100 0 255 ECU_ADDRESS 0xFFFF35ED READ_WRITE /end MEASUREMENT
/begin MEASUREMENT vCCYCLCNT "RAM value vCCYCLCNT" UBYTE COMP_0068 1 100 0 255 ECU_ADDRESS 0xFFFF1722 READ_WRITE /end MEASUREMENT
/begin MEASUREMENT vCDADIEMX "RAM value vCDADIEMX" UBYTE COMP_0030 1 100 0 255 ECU_ADDRESS 0xFFFF4E60 READ_WRITE /end MEASUREMENT
/begin MEASUREMENT vCDADIFMX "RAM value vCDADIFMX" UBYTE COMP_0030 1 100 0 255 ECU_ADDRESS 0xFFFF4E61 READ_WRITE /end MEASUREMENT
/begin MEASUREMENT vCDADINE "RAM value vCDADINE" UBYTE COMP_0030 1 100 0 255 ECU_ADDRESS 0xFFFF15F2 READ_WRITE /end MEASUREMENT
/begin MEASUREMENT vCDADINF "RAM value vCDADINF" UBYTE COMP_0030 1 100 0 255 ECU_ADDRESS 0xFFFF15F3 READ_WRITE /end MEASUREMENT
/begin MEASUREMENT vCEEPRNG "RAM value vCEEPRNG" UBYTE COMP_0030 1 100 0 255 ECU_ADDRESS 0xFFFF2420 READ_WRITE /end MEASUREMENT
/begin MEASUREMENT vCEEPWNG "RAM value vCEEPWNG" UBYTE COMP_0030 1 100 0 255 ECU_ADDRESS 0xFFFF2421 READ_WRITE /end MEASUREMENT
/begin MEASUREMENT vCEONV "RAM value vCEONV" UBYTE COMP_0016 1 100 0 255 ECU_ADDRESS 0xFFFF4E62 READ_WRITE /end MEASUREMENT
/begin MEASUREMENT vCERCN1 "RAM value vCERCN1" UBYTE COMP_0068 1 100 0 255 ECU_ADDRESS 0xFFFF35EE READ_WRITE /end MEASUREMENT
/begin MEASUREMENT vCERCN2 "RAM value vCERCN2" UBYTE COMP_0068 1 100 0 255 ECU_ADDRESS 0xFFFF35EF READ_WRITE /end MEASUREMENT
/begin MEASUREMENT vCEXNGMX "RAM value vCEXNGMX" UBYTE COMP_0030 1 100 0 255 ECU_ADDRESS 0xFFFF455B READ_WRITE /end MEASUREMENT
/begin MEASUREMENT vCFCADV "RAM value vCFCADV" UBYTE COMP_0004 1 100 0 255 ECU_ADDRESS 0xFFFF0ABD READ_WRITE /end MEASUREMENT
/begin MEASUREMENT vCFEQ "RAM value vCFEQ" ULONG COMP_0511_S 1 100 0 429.4967295 ECU_ADDRESS 0xFFFF2424 READ_WRITE /end MEASUREMENT
/begin MEASUREMENT vCFL "RAM value vCFL" UWORD COMP_0069 1 100 0 1.999970916 ECU_ADDRESS 0xFFFF15F4 READ_WRITE /end MEASUREMENT
/begin MEASUREMENT vCHETCON "RAM value vCHETCON" UBYTE COMP_0016 1 100 0 255 ECU_ADDRESS 0xFFFF4E63 READ_WRITE /end MEASUREMENT
/begin MEASUREMENT vCHGNGCU "RAM value vCHGNGCU" UBYTE COMP_0045_S 1 100 0 255 ECU_ADDRESS 0xFFFF2428 READ_WRITE /end MEASUREMENT
/begin MEASUREMENT vCHGNGSTS "RAM value vCHGNGSTS" UBYTE COMP_0016 1 100 0 255 ECU_ADDRESS 0xFFFF2100 READ_WRITE /end MEASUREMENT
/begin MEASUREMENT vCHGOK "RAM value vCHGOK" UBYTE COMP_0059_S 1 100 0 31.875 ECU_ADDRESS 0xFFFF2429 READ_WRITE /end MEASUREMENT
/begin MEASUREMENT vCHGOK2 "RAM value vCHGOK2" UBYTE COMP_0320_S 1 100 0 63.75 ECU_ADDRESS 0xFFFF242A READ_WRITE /end MEASUREMENT
/begin MEASUREMENT vCHGOK3 "RAM value vCHGOK3" UBYTE COMP_0067_S 1 100 0 127.5 ECU_ADDRESS 0xFFFF242B READ_WRITE /end MEASUREMENT
/begin MEASUREMENT vCHGOKVG "RAM value vCHGOKVG" UBYTE COMP_0373 1 100 0 2.55 ECU_ADDRESS 0xFFFF242C READ_WRITE /end MEASUREMENT
/begin MEASUREMENT vCHMODE "RAM value vCHMODE" UBYTE COMP_0068 1 100 0 255 ECU_ADDRESS 0xFFFF242D READ_WRITE /end MEASUREMENT
/begin MEASUREMENT vCHOVCLC "RAM value vCHOVCLC" UBYTE COMP_0068 1 100 0 255 ECU_ADDRESS 0xFFFF35F0 READ_WRITE /end MEASUREMENT
/begin MEASUREMENT vCHTR "RAM value vCHTR" UBYTE COMP_0512_S 1 100 0 0.00255 ECU_ADDRESS 0xFFFF242E READ_WRITE /end MEASUREMENT
/begin MEASUREMENT vCKDWITP "RAM value vCKDWITP" UBYTE COMP_0017 1 100 0 255 ECU_ADDRESS 0xFFFF0ABE READ_WRITE /end MEASUREMENT
/begin MEASUREMENT vCKDWKA "RAM value vCKDWKA" UBYTE COMP_0384 1 100 0 1.992315 ECU_ADDRESS 0xFFFF0ABF READ_WRITE /end MEASUREMENT
/begin MEASUREMENT vCKDWKN "RAM value vCKDWKN" UBYTE COMP_0384 1 100 0 1.992315 ECU_ADDRESS 0xFFFF0AC0 READ_WRITE /end MEASUREMENT
/begin MEASUREMENT vCKDWKV "RAM value vCKDWKV" UBYTE COMP_0384 1 100 0 1.992315 ECU_ADDRESS 0xFFFF0AC1 READ_WRITE /end MEASUREMENT
/begin MEASUREMENT vCKDWRE "RAM value vCKDWRE" UBYTE COMP_0017 1 100 0 255 ECU_ADDRESS 0xFFFF0AC2 READ_WRITE /end MEASUREMENT
/begin MEASUREMENT vCKHMIL "RAM value vCKHMIL" UBYTE COMP_0016 1 100 0 255 ECU_ADDRESS 0xFFFF455C READ_WRITE /end MEASUREMENT
/begin MEASUREMENT vCLBUF "RAM value vCLBUF" UWORD COMP_0061 1 100 0 327675 ECU_ADDRESS 0xFFFF2430 READ_WRITE /end MEASUREMENT
/begin MEASUREMENT vCLCNTDT "RAM value vCLCNTDT" UBYTE COMP_0014 1 100 0 2550 ECU_ADDRESS 0xFFFF35F1 READ_WRITE /end MEASUREMENT
/begin MEASUREMENT vCLDTGAF "RAM value vCLDTGAF" UWORD COMP_0453 1 100 0 131.07 ECU_ADDRESS 0xFFFF2432 READ_WRITE /end MEASUREMENT
/begin MEASUREMENT vCLKMNEN "RAM value vCLKMNEN" UBYTE COMP_0068 1 100 0 255 ECU_ADDRESS 0xFFFF2436 READ_WRITE /end MEASUREMENT
/begin MEASUREMENT vCLKMONI "RAM value vCLKMONI" UWORD COMP_0513_S 1 100 0 209712 ECU_ADDRESS 0xFFFF2438 READ_WRITE /end MEASUREMENT
/begin MEASUREMENT vCLKMONI1 "RAM value vCLKMONI1" UBYTE COMP_0068 1 100 0 255 ECU_ADDRESS 0xFFFF35F2 READ_WRITE /end MEASUREMENT
/begin MEASUREMENT vCLKNG "RAM value vCLKNG" UBYTE COMP_0016 1 100 0 255 ECU_ADDRESS 0xFFFF455D READ_WRITE /end MEASUREMENT
/begin MEASUREMENT vCLMPT0f "RAM value vCLMPT0f" UBYTE COMP_0004 1 100 0 255 ECU_ADDRESS 0xFFFF243B READ_WRITE /end MEASUREMENT
/begin MEASUREMENT vCLMPf "RAM value vCLMPf" UBYTE COMP_0004 1 100 0 255 ECU_ADDRESS 0xFFFF243A READ_WRITE /end MEASUREMENT
/begin MEASUREMENT vCLRDIST "RAM value vCLRDIST" ULONG COMP_0389 1 100 0 1685624.33943218 ECU_ADDRESS 0xFFFF43F4 READ_WRITE /end MEASUREMENT
/begin MEASUREMENT vCLRGIN "RAM value vCLRGIN" UWORD COMP_0285_S 1 100 0 1.3107 ECU_ADDRESS 0xFFFF243C READ_WRITE /end MEASUREMENT
/begin MEASUREMENT vCLRTIME "RAM value vCLRTIME" UWORD COMP_0467_S 1 100 0 65535 ECU_ADDRESS 0xFFFF510E READ_WRITE /end MEASUREMENT
/begin MEASUREMENT vCLSBA1T "RAM value vCLSBA1T" UBYTE COMP_0014 1 100 0 2550 ECU_ADDRESS 0xFFFF1FF9 READ_WRITE /end MEASUREMENT
/begin MEASUREMENT vCLSBA2T "RAM value vCLSBA2T" UBYTE COMP_0014 1 100 0 2550 ECU_ADDRESS 0xFFFF1FFA READ_WRITE /end MEASUREMENT
/begin MEASUREMENT vCLTPH "RAM value vCLTPH" UWORD COMP_0144 1 100 0 31.999495335 ECU_ADDRESS 0xFFFF0AC4 READ_WRITE /end MEASUREMENT
/begin MEASUREMENT vCLTPL "RAM value vCLTPL" UWORD COMP_0144 1 100 0 31.999495335 ECU_ADDRESS 0xFFFF0AC6 READ_WRITE /end MEASUREMENT
/begin MEASUREMENT vCMOIM1 "RAM value vCMOIM1" UBYTE COMP_0030 1 100 0 255 ECU_ADDRESS 0xFFFF35F3 READ_WRITE /end MEASUREMENT
/begin MEASUREMENT vCMOIM2 "RAM value vCMOIM2" UBYTE COMP_0030 1 100 0 255 ECU_ADDRESS 0xFFFF243E READ_WRITE /end MEASUREMENT
/begin MEASUREMENT vCMOIM34 "RAM value vCMOIM34" UBYTE COMP_0030 1 100 0 255 ECU_ADDRESS 0xFFFF243F READ_WRITE /end MEASUREMENT
/begin MEASUREMENT vCMTMP "RAM value vCMTMP" UBYTE COMP_0068 1 100 0 255 ECU_ADDRESS 0xFFFF0AC8 READ_WRITE /end MEASUREMENT
/begin MEASUREMENT vCNASNG "RAM value vCNASNG" UBYTE COMP_0016 1 100 0 255 ECU_ADDRESS 0xFFFF2440 READ_WRITE /end MEASUREMENT
/begin MEASUREMENT vCNGDLY "RAM value vCNGDLY" UBYTE COMP_0008 1 100 0 25500 ECU_ADDRESS 0xFFFF0ACC READ_WRITE /end MEASUREMENT
/begin MEASUREMENT vCNGDLYE "RAM value vCNGDLYE" UBYTE COMP_0008 1 100 0 25500 ECU_ADDRESS 0xFFFF0ACD READ_WRITE /end MEASUREMENT
/begin MEASUREMENT vCNGMS "RAM value vCNGMS" UBYTE COMP_0062_S 1 100 0 255 ECU_ADDRESS 0xFFFF2441 READ_WRITE /end MEASUREMENT
/begin MEASUREMENT vCNGOSC "RAM value vCNGOSC" UBYTE COMP_0068 1 100 0 255 ECU_ADDRESS 0xFFFF5110 READ_WRITE /end MEASUREMENT
/begin MEASUREMENT vCNNGKO "RAM value vCNNGKO" UBYTE COMP_0016 1 100 0 255 ECU_ADDRESS 0xFFFF455E READ_WRITE /end MEASUREMENT
/begin MEASUREMENT vCNROL "RAM value vCNROL" UBYTE COMP_0071 1 100 0 255 ECU_ADDRESS 0xFFFF3A56 READ_WRITE /end MEASUREMENT
/begin MEASUREMENT vCNSMCNT "RAM value vCNSMCNT" UBYTE COMP_0068 1 100 0 255 ECU_ADDRESS 0xFFFF1B0D READ_WRITE /end MEASUREMENT
/begin MEASUREMENT vCNT "RAM value vCNT" UBYTE COMP_0030 1 100 0 255 ECU_ADDRESS 0xFFFF2443 READ_WRITE /end MEASUREMENT
/begin MEASUREMENT vCNT10 "RAM value vCNT10" UBYTE COMP_0030 1 100 0 255 ECU_ADDRESS 0xFFFF35F5 READ_WRITE /end MEASUREMENT
/begin MEASUREMENT vCNTDI "RAM value vCNTDI" UBYTE COMP_0016 1 100 0 255 ECU_ADDRESS 0xFFFF2444 READ_WRITE /end MEASUREMENT
/begin MEASUREMENT vCNTDTV "RAM value vCNTDTV" UBYTE COMP_0016 1 100 0 255 ECU_ADDRESS 0xFFFF2445 READ_WRITE /end MEASUREMENT
/begin MEASUREMENT vCNTECMNG "RAM value vCNTECMNG" UWORD COMP_0068 1 100 0 65535 ECU_ADDRESS 0xFFFF35F6 READ_WRITE /end MEASUREMENT
/begin MEASUREMENT vCNTIDLN1 "RAM value vCNTIDLN1" UBYTE COMP_0016 1 100 0 255 ECU_ADDRESS 0xFFFF0ACE READ_WRITE /end MEASUREMENT
/begin MEASUREMENT vCNTIDLN2 "RAM value vCNTIDLN2" UBYTE COMP_0016 1 100 0 255 ECU_ADDRESS 0xFFFF0ACF READ_WRITE /end MEASUREMENT
/begin MEASUREMENT vCNTKMR1 "RAM value vCNTKMR1" UWORD COMP_0452 1 100 0 51.19921875 ECU_ADDRESS 0xFFFF0AD0 READ_WRITE /end MEASUREMENT
/begin MEASUREMENT vCNTKMR2 "RAM value vCNTKMR2" UWORD COMP_0452 1 100 0 51.19921875 ECU_ADDRESS 0xFFFF0AD2 READ_WRITE /end MEASUREMENT
/* COMPU_METHOD --------------------------------------------------------- */
/begin COMPU_METHOD COMP_0017 "1deg" RAT_FUNC "%8.2" "deg" COEFFS 0 1 0 0 0 1 /end COMPU_METHOD
/begin COMPU_METHOD COMP_0004 "1－" RAT_FUNC "%8.2" "－" COEFFS 0 1 0 0 0 1 /end COMPU_METHOD
/begin COMPU_METHOD COMP_0068 "1-" RAT_FUNC "%8.2" "-" COEFFS 0 1 0 0 0 1 /end COMPU_METHOD
/begin COMPU_METHOD COMP_0013 "1s" RAT_FUNC "%8.2" "s" COEFFS 0 1 0 0 0 1 /end COMPU_METHOD
/begin COMPU_METHOD COMP_0014 "10ms" RAT_FUNC "%8.2" "ms" COEFFS 0 1 0 0 0 10 /end COMPU_METHOD
/begin COMPU_METHOD COMP_0074 "1/256count" RAT_FUNC "%8.4" "count" COEFFS 0 1 0 0 0 0.00390625 /end COMPU_METHOD
/begin COMPU_METHOD COMP_0045 "1/128-" RAT_FUNC "%8.4" "-" COEFFS 0 1 0 0 0 0.0078125 /end COMPU_METHOD
/begin COMPU_METHOD COMP_0009 "100/128%" RAT_FUNC "%8.2" "%" COEFFS 0 1 0 0 0 0.78125 /end COMPU_METHOD
/begin COMPU_METHOD COMP_0000 "25rpm" RAT_FUNC "%8.2" "rpm" COEFFS 0 1 0 0 0 25 /end COMPU_METHOD
/begin COMPU_METHOD COMP_0001 "1/8ms" RAT_FUNC "%8.2" "ms" COEFFS 0 1 0 0 0 0.125 /end COMPU_METHOD
/begin COMPU_METHOD COMP_0004_S "X-50degC" RAT_FUNC "%8.2" "degC" COEFFS 0 1 50 0 0 1 /end COMPU_METHOD
/begin COMPU_METHOD COMP_0005_S "0.0001-" RAT_FUNC "%8.5" "-" COEFFS 0 1 0 0 0 0.0001 /end COMPU_METHOD
/begin COMPU_METHOD COMP_0388 "0.1-" RAT_FUNC "%8.2" "-" COEFFS 0 1 0 0 0 0.1 /end COMPU_METHOD
/begin COMPU_METHOD COMP_0373 "1/100-" RAT_FUNC "%8.3" "-" COEFFS 0 1 0 0 0 0.01 /end COMPU_METHOD
/begin COMPU_METHOD COMP_0002 "0.35deg" RAT_FUNC "%8.2" "deg" COEFFS 0 1 0 0 0 0.35 /end COMPU_METHOD
/begin COMPU_METHOD COMP_0035 "X-50℃" RAT_FUNC "%8.2" "℃" COEFFS 0 1 50 0 0 1 /end COMPU_METHOD
/begin COMPU_METHOD COMP_0453 "0.002-" RAT_FUNC "%8.4" "-" COEFFS 0 1 0 0 0 0.002 /end COMPU_METHOD
/begin COMPU_METHOD COMP_0006_S "2^-22m/ss" RAT_FUNC "%8.6" "m/ss" COEFFS 0 1 0 0 0 0.000000238419 /end COMPU_METHOD
/begin COMPU_METHOD COMP_0005 "0.11deg" RAT_FUNC "%8.2" "deg" COEFFS 0 1 0 0 0 0.11 /end COMPU_METHOD
/begin COMPU_METHOD COMP_0006 "12.5rpm" RAT_FUNC "%8.2" "rpm" COEFFS 0 1 0 0 0 12.5 /end COMPU_METHOD
/begin COMPU_METHOD COMP_0008 "100ms" RAT_FUNC "%8.2" "ms" COEFFS 0 1 0 0 0 100 /end COMPU_METHOD
/begin COMPU_METHOD COMP_0010 "0.003MPa" RAT_FUNC "%8.4" "MPa" COEFFS 0 1 0 0 0 0.003 /end COMPU_METHOD
/begin COMPU_METHOD COMP_0007 "2km/h" RAT_FUNC "%8.2" "km/h" COEFFS 0 1 0 0 0 2 /end COMPU_METHOD
/begin COMPU_METHOD COMP_0047 "0.5%" RAT_FUNC "%8.2" "%" COEFFS 0 1 0 0 0 0.5 /end COMPU_METHOD
/begin COMPU_METHOD COMP_0012_S "1A100ms" RAT_FUNC "%8.2" "A100ms" COEFFS 0 1 32768 0 0 1 /end COMPU_METHOD
/begin COMPU_METHOD COMP_0013_S "1/256A100ms" RAT_FUNC "%8.4" "A100ms" COEFFS 0 1 8388608 0 0 0.00390625 /end COMPU_METHOD
/begin COMPU_METHOD COMP_0018 "1deg" RAT_FUNC "%8.2" "deg" COEFFS 0 1 0 0 0 1 /end COMPU_METHOD
/begin COMPU_METHOD COMP_0081 "1/256deg" RAT_FUNC "%8.4" "deg" COEFFS 0 1 0 0 0 0.00390625 /end COMPU_METHOD
/begin COMPU_METHOD COMP_0217 "1/16384-" RAT_FUNC "%8.6" "-" COEFFS 0 1 0 0 0 0.0000610352 /end COMPU_METHOD
/begin COMPU_METHOD COMP_0023 "5mV" RAT_FUNC "%8.2" "mV" COEFFS 0 1 0 0 0 5 /end COMPU_METHOD
/begin COMPU_METHOD COMP_0250 "4ms" RAT_FUNC "%8.2" "ms" COEFFS 0 1 0 0 0 4 /end COMPU_METHOD
/begin COMPU_METHOD COMP_0033 "80mV" RAT_FUNC "%8.2" "mV" COEFFS 0 1 0 0 0 80 /end COMPU_METHOD
/begin COMPU_METHOD COMP_0027 "1%" RAT_FUNC "%8.2" "%" COEFFS 0 1 0 0 0 1 /end COMPU_METHOD
/begin COMPU_METHOD COMP_0015_S "0.1sec" RAT_FUNC "%8.2" "sec" COEFFS 0 1 0 0 0 0.1 /end COMPU_METHOD
/begin COMPU_METHOD COMP_0017_S "0.01sec" RAT_FUNC "%8.3" "sec" COEFFS 0 1 0 0 0 0.01 /end COMPU_METHOD
/begin COMPU_METHOD COMP_0061 "5mv" RAT_FUNC "%8.2" "mv" COEFFS 0 1 0 0 0 5 /end COMPU_METHOD
/begin COMPU_METHOD COMP_0049 "1sec" RAT_FUNC "%8.2" "sec" COEFFS 0 1 0 0 0 1 /end COMPU_METHOD
/begin COMPU_METHOD COMP_0032 "1/256－" RAT_FUNC "%8.4" "－" COEFFS 0 1 0 0 0 0.00390625 /end COMPU_METHOD
/begin COMPU_METHOD COMP_0018_S "0.5/256-" RAT_FUNC "%8.4" "-" COEFFS 0 1 0 0 0 0.001953125 /end COMPU_METHOD
/begin COMPU_METHOD COMP_0063 "1/256-" RAT_FUNC "%8.4" "-" COEFFS 0 1 0 0 0 0.00390625 /end COMPU_METHOD
/begin COMPU_METHOD COMP_0370 "2.5mv" RAT_FUNC "%8.2" "mv" COEFFS 0 1 0 0 0 2.5 /end COMPU_METHOD
/begin COMPU_METHOD COMP_0093 "2.5mV" RAT_FUNC "%8.2" "mV" COEFFS 0 1 0 0 0 2.5 /end COMPU_METHOD
/begin COMPU_METHOD COMP_0019_S "1/255-" RAT_FUNC "%8.4" "-" COEFFS 0 1 0 0 0 0.003921569 /end COMPU_METHOD
/begin COMPU_METHOD COMP_0030 "1回" RAT_FUNC "%8.2" "回" COEFFS 0 1 0 0 0 1 /end COMPU_METHOD
/begin COMPU_METHOD COMP_0020_S "0.002-" RAT_FUNC "%8.4" "-" COEFFS 0 1 0 0 0 0.002 /end COMPU_METHOD
/begin COMPU_METHOD COMP_0016 "1count" RAT_FUNC "%8.2" "count" COEFFS 0 1 0 0 0 1 /end COMPU_METHOD
/begin COMPU_METHOD COMP_0443 "1rpm" RAT_FUNC "%8.2" "rpm" COEFFS 0 1 0 0 0 1 /end COMPU_METHOD
/begin COMPU_METHOD COMP_0228 "0.1Nm" RAT_FUNC "%8.2" "Nm" COEFFS 0 1 0 0 0 0.1 /end COMPU_METHOD
/begin COMPU_METHOD COMP_0263 "1-" RAT_FUNC "%8.2" "-" COEFFS 0 1 0 0 0 1 /end COMPU_METHOD
/begin COMPU_METHOD COMP_0256 "64/128degCA" RAT_FUNC "%8.2" "degCA" COEFFS 0 1 64 0 0 0.5 /end COMPU_METHOD
/begin COMPU_METHOD COMP_0031 "1/256%" RAT_FUNC "%8.4" "%" COEFFS 0 1 0 0 0 0.00390625 /end COMPU_METHOD
/begin COMPU_METHOD COMP_0028_S "3.90625E-11cm**2/rp" RAT_FUNC "%8.6" "cm**2/rp" COEFFS 0 1 0 0 0 3.90625E-11 /end COMPU_METHOD
/begin COMPU_METHOD COMP_0048 "64/128degCA" RAT_FUNC "%8.2" "degCA" COEFFS 0 1 0 0 0 0.5 /end COMPU_METHOD
/begin COMPU_METHOD COMP_0032_S "0.125%" RAT_FUNC "%8.2" "%" COEFFS 0 1 0 0 0 0.125 /end COMPU_METHOD
/begin COMPU_METHOD COMP_0039_S "1Pa" RAT_FUNC "%8.2" "Pa" COEFFS 0 1 -60000 0 0 1 /end COMPU_METHOD
/begin COMPU_METHOD COMP_0040_S "0.01s" RAT_FUNC "%8.3" "s" COEFFS 0 1 0 0 0 0.01 /end COMPU_METHOD
/begin COMPU_METHOD COMP_0041_S "1ｶｳﾝﾄ" RAT_FUNC "%8.2" "ｶｳﾝﾄ" COEFFS 0 1 0 0 0 1 /end COMPU_METHOD
/begin COMPU_METHOD COMP_0041 "0.0008cm^2" RAT_FUNC "%8.5" "cm^2" COEFFS 0 1 0 0 0 0.0008 /end COMPU_METHOD
/begin COMPU_METHOD COMP_0042 "0.0008cm**2" RAT_FUNC "%8.5" "cm**2" COEFFS 0 1 0 0 0 0.0008 /end COMPU_METHOD
/begin COMPU_METHOD COMP_0045_S "1A" RAT_FUNC "%8.2" "A" COEFFS 0 1 0 0 0 1 /end COMPU_METHOD
/begin COMPU_METHOD COMP_0046_S "1/256A" RAT_FUNC "%8.4" "A" COEFFS 0 1 0 0 0 0.00390625 /end COMPU_METHOD
/begin COMPU_METHOD COMP_0050_S "0.5V" RAT_FUNC "%8.2" "V" COEFFS 0 1 0 0 0 0.5 /end COMPU_METHOD
/begin COMPU_METHOD COMP_0054 "20mV" RAT_FUNC "%8.2" "mV" COEFFS 0 1 0 0 0 20 /end COMPU_METHOD
/begin COMPU_METHOD COMP_0052_S "0.125%/10ms" RAT_FUNC "%8.2" "%/10ms" COEFFS 0 1 0 0 0 0.125 /end COMPU_METHOD
/begin COMPU_METHOD COMP_0450 "1/1024-" RAT_FUNC "%8.5" "-" COEFFS 0 1 0 0 0 0.000976563 /end COMPU_METHOD
/begin COMPU_METHOD COMP_0054_S "4/256deg/oct" RAT_FUNC "%8.3" "deg/oct" COEFFS 0 1 0 0 0 0.015625 /end COMPU_METHOD
/begin COMPU_METHOD COMP_0419 "0.1%" RAT_FUNC "%8.2" "%" COEFFS 0 1 0 0 0 0.1 /end COMPU_METHOD
/begin COMPU_METHOD COMP_0057_S "0.1deg" RAT_FUNC "%8.2" "deg" COEFFS 0 1 0 0 0 0.1 /end COMPU_METHOD
/begin COMPU_METHOD COMP_0055 "4deg" RAT_FUNC "%8.2" "deg" COEFFS 0 1 0 0 0 4 /end COMPU_METHOD
/begin COMPU_METHOD COMP_0059_S "0.125A" RAT_FUNC "%8.2" "A" COEFFS 0 1 0 0 0 0.125 /end COMPU_METHOD
/begin COMPU_METHOD COMP_0105 "0.1s" RAT_FUNC "%8.2" "s" COEFFS 0 1 0 0 0 0.1 /end COMPU_METHOD
/begin COMPU_METHOD COMP_0071 "1rev" RAT_FUNC "%8.2" "rev" COEFFS 0 1 0 0 0 1 /end COMPU_METHOD
/begin COMPU_METHOD COMP_0144 "1/2048ms" RAT_FUNC "%8.5" "ms" COEFFS 0 1 0 0 0 0.000488281 /end COMPU_METHOD
/begin COMPU_METHOD COMP_0062_S "1ms/2^(ST" RAT_FUNC "%8.2" "ms/2^(ST" COEFFS 0 1 0 0 0 1 /end COMPU_METHOD
/begin COMPU_METHOD COMP_0064_S "1N" RAT_FUNC "%8.2" "N" COEFFS 0 1 0 0 0 1 /end COMPU_METHOD
/begin COMPU_METHOD COMP_0067_S "0.5A" RAT_FUNC "%8.2" "A" COEFFS 0 1 0 0 0 0.5 /end COMPU_METHOD
/begin COMPU_METHOD COMP_0021 "100/256%" RAT_FUNC "%8.2" "%" COEFFS 0 1 0 0 0 0.390625 /end COMPU_METHOD
/begin COMPU_METHOD COMP_0078 "1/256deg" RAT_FUNC "%8.4" "deg" COEFFS 0 1 0 0 0 0.00390625 /end COMPU_METHOD
/begin COMPU_METHOD COMP_0091 "ﾌﾗｸﾞﾌﾗｸﾞ" RAT_FUNC "%8.2" "ﾌﾗｸﾞ" COEFFS 0 1 0 0 0 1 /end COMPU_METHOD
/begin COMPU_METHOD COMP_0096 "10s" RAT_FUNC "%8.2" "s" COEFFS 0 1 0 0 0 10 /end COMPU_METHOD
/begin COMPU_METHOD COMP_0051 "1L/min" RAT_FUNC "%8.2" "L/min" COEFFS 0 1 0 0 0 1 /end COMPU_METHOD
/begin COMPU_METHOD COMP_0456 "1/(256×128)-" RAT_FUNC "%8.6" "-" COEFFS 0 1 0 0 0 0.0000305176 /end COMPU_METHOD
/begin COMPU_METHOD COMP_0087_S "0.07808MPa" RAT_FUNC "%8.3" "MPa" COEFFS 0 1 0 0 0 0.07808 /end COMPU_METHOD
/begin COMPU_METHOD COMP_0092_S "0.025kg/h" RAT_FUNC "%8.3" "kg/h" COEFFS 0 1 0 0 0 0.025 /end COMPU_METHOD
/begin COMPU_METHOD COMP_0050 "5/64mV" RAT_FUNC "%8.3" "mV" COEFFS 0 1 0 0 0 0.078125 /end COMPU_METHOD
/begin COMPU_METHOD COMP_0069 "1/(128*256)－" RAT_FUNC "%8.6" "－" COEFFS 0 1 0 0 0 0.0000305176 /end COMPU_METHOD
/begin COMPU_METHOD COMP_0283 "1flag" RAT_FUNC "%8.2" "flag" COEFFS 0 1 0 0 0 1 /end COMPU_METHOD
/begin COMPU_METHOD COMP_0196 "0.1Nm" RAT_FUNC "%8.2" "Nm" COEFFS 0 1 0 0 0 0.1 /end COMPU_METHOD
/begin COMPU_METHOD COMP_0057 "1/16384－" RAT_FUNC "%8.6" "－" COEFFS 0 1 0 0 0 0.0000610352 /end COMPU_METHOD
/begin COMPU_METHOD COMP_0104 "10mV" RAT_FUNC "%8.2" "mV" COEFFS 0 1 0 0 0 10 /end COMPU_METHOD
/begin COMPU_METHOD COMP_0190 "2deg" RAT_FUNC "%8.2" "deg" COEFFS 0 1 0 0 0 2 /end COMPU_METHOD
/begin COMPU_METHOD COMP_0140 "0.5STEP" RAT_FUNC "%8.2" "STEP" COEFFS 0 1 0 0 0 0.5 /end COMPU_METHOD
/begin COMPU_METHOD COMP_0141 "50/256%" RAT_FUNC "%8.2" "%" COEFFS 0 1 0 0 0 0.1953125 /end COMPU_METHOD
/begin COMPU_METHOD COMP_0115_S "0.0001degC" RAT_FUNC "%8.5" "degC" COEFFS 0 1 0 0 0 0.0001 /end COMPU_METHOD
/begin COMPU_METHOD COMP_0295 "100msec" RAT_FUNC "%8.2" "msec" COEFFS 0 1 0 0 0 100 /end COMPU_METHOD
/begin COMPU_METHOD COMP_0108 "1/256/10ms" RAT_FUNC "%8.4" "/10ms" COEFFS 0 1 0 0 0 0.00390625 /end COMPU_METHOD
/begin COMPU_METHOD COMP_0277 "1L/min" RAT_FUNC "%8.2" "L/min" COEFFS 0 1 0 0 0 1 /end COMPU_METHOD
/begin COMPU_METHOD COMP_0064 "1.5625rpm" RAT_FUNC "%8.2" "rpm" COEFFS 0 1 0 0 0 1.5625 /end COMPU_METHOD
/begin COMPU_METHOD COMP_0164 "0.000305MPa" RAT_FUNC "%8.5" "MPa" COEFFS 0 1 0 0 0 0.000305 /end COMPU_METHOD
/begin COMPU_METHOD COMP_0146 "100/256/256%" RAT_FUNC "%8.4" "%" COEFFS 0 1 0 0 0 0.001525879 /end COMPU_METHOD
/begin COMPU_METHOD COMP_0131_S "0.5Nm" RAT_FUNC "%8.2" "Nm" COEFFS 0 1 0 0 0 0.5 /end COMPU_METHOD
/begin COMPU_METHOD COMP_0144_S "3.6_*_2^-22km/h" RAT_FUNC "%8.6" "km/h" COEFFS 0 1 0 0 0 0.000000858307 /end COMPU_METHOD
/begin COMPU_METHOD COMP_0328 "100/(64*256)%" RAT_FUNC "%8.4" "%" COEFFS 0 1 0 0 0 0.006103516 /end COMPU_METHOD
/begin COMPU_METHOD COMP_0157_S "1.6μs" RAT_FUNC "%8.2" "μs" COEFFS 0 1 0 0 0 1.6 /end COMPU_METHOD
/begin COMPU_METHOD COMP_0189 "3.2μS" RAT_FUNC "%8.2" "μS" COEFFS 0 1 0 0 0 3.2 /end COMPU_METHOD
/begin COMPU_METHOD COMP_0025 "0.5step" RAT_FUNC "%8.2" "step" COEFFS 0 1 0 0 0 0.5 /end COMPU_METHOD
/begin COMPU_METHOD COMP_0172_S "2^-1degCA" RAT_FUNC "%8.2" "degCA" COEFFS 0 1 0 0 0 0.5 /end COMPU_METHOD
/begin COMPU_METHOD COMP_0193 "0.1Nm/10ms" RAT_FUNC "%8.2" "Nm/10ms" COEFFS 0 1 0 0 0 0.1 /end COMPU_METHOD
/begin COMPU_METHOD COMP_0062 "4℃" RAT_FUNC "%8.2" "℃" COEFFS 0 1 0 0 0 4 /end COMPU_METHOD
/begin COMPU_METHOD COMP_0130 "0.0275deg" RAT_FUNC "%8.3" "deg" COEFFS 0 1 0 0 0 0.0275 /end COMPU_METHOD
/begin COMPU_METHOD COMP_0232 "1/128mm^2" RAT_FUNC "%8.4" "mm^2" COEFFS 0 1 0 0 0 0.0078125 /end COMPU_METHOD
/begin COMPU_METHOD COMP_0183 "20ms" RAT_FUNC "%8.2" "ms" COEFFS 0 1 0 0 0 20 /end COMPU_METHOD
/begin COMPU_METHOD COMP_0248 "1/256g" RAT_FUNC "%8.4" "g" COEFFS 0 1 0 0 0 0.00390625 /end COMPU_METHOD
/begin COMPU_METHOD COMP_0389 "1/2548km" RAT_FUNC "%8.5" "km" COEFFS 0 1 0 0 0 0.000392465 /end COMPU_METHOD
/begin COMPU_METHOD COMP_0395 "1/4096-" RAT_FUNC "%8.5" "-" COEFFS 0 1 0 0 0 0.000244141 /end COMPU_METHOD
/begin COMPU_METHOD COMP_0251 "1cyl" RAT_FUNC "%8.2" "cyl" COEFFS 0 1 0 0 0 1 /end COMPU_METHOD
/begin COMPU_METHOD COMP_0267 "256us" RAT_FUNC "%8.2" "us" COEFFS 0 1 0 0 0 256 /end COMPU_METHOD
/begin COMPU_METHOD COMP_0203_S "0.005V" RAT_FUNC "%8.4" "V" COEFFS 0 1 0 0 0 0.005 /end COMPU_METHOD
/begin COMPU_METHOD COMP_0204_S "100A100ms" RAT_FUNC "%8.2" "A100ms" COEFFS 0 1 0 0 0 100 /end COMPU_METHOD
/begin COMPU_METHOD COMP_0215_S "1/512kPa" RAT_FUNC "%8.4" "kPa" COEFFS 0 1 0 0 0 0.00195313 /end COMPU_METHOD
/begin COMPU_METHOD COMP_0052 "1/2048ms" RAT_FUNC "%8.5" "ms" COEFFS 0 1 0 0 0 0.000488282 /end COMPU_METHOD
/begin COMPU_METHOD COMP_0092 "1bit" RAT_FUNC "%8.2" "bit" COEFFS 0 1 0 0 0 1 /end COMPU_METHOD
/begin COMPU_METHOD COMP_0425 "100/255%" RAT_FUNC "%8.2" "%" COEFFS 0 1 0 0 0 0.392156862 /end COMPU_METHOD
/begin COMPU_METHOD COMP_0470 "1km" RAT_FUNC "%8.2" "km" COEFFS 0 1 0 0 0 1 /end COMPU_METHOD
/begin COMPU_METHOD COMP_0250_S "X-128deg" RAT_FUNC "%8.2" "deg" COEFFS 0 1 128 0 0 1 /end COMPU_METHOD
/begin COMPU_METHOD COMP_0429 "1km/h" RAT_FUNC "%8.2" "km/h" COEFFS 0 1 0 0 0 1 /end COMPU_METHOD
/begin COMPU_METHOD COMP_0315 "0.09765%/ms" RAT_FUNC "%8.3" "%/ms" COEFFS 0 1 0 0 0 0.09765 /end COMPU_METHOD
/begin COMPU_METHOD COMP_0320 "1.6μS" RAT_FUNC "%8.2" "μS" COEFFS 0 1 0 0 0 1.6 /end COMPU_METHOD
/begin COMPU_METHOD COMP_0270_S "1E-6m**3" RAT_FUNC "%8.6" "m**3" COEFFS 0 1 0 0 0 0.000001 /end COMPU_METHOD
/begin COMPU_METHOD COMP_0285_S "0.00002-" RAT_FUNC "%8.6" "-" COEFFS 0 1 0 0 0 0.00002 /end COMPU_METHOD
/begin COMPU_METHOD COMP_0293_S "1/65536A" RAT_FUNC "%8.6" "A" COEFFS 0 1 0 0 0 0.0000152588 /end COMPU_METHOD
/begin COMPU_METHOD COMP_0245 "X-64deg" RAT_FUNC "%8.2" "deg" COEFFS 0 1 64 0 0 1 /end COMPU_METHOD
/begin COMPU_METHOD COMP_0053 "1ms" RAT_FUNC "%8.2" "ms" COEFFS 0 1 0 0 0 1 /end COMPU_METHOD
/begin COMPU_METHOD COMP_0307_S "2/256degADV/d" RAT_FUNC "%8.4" "degADV/d" COEFFS 0 1 1 0 0 0.0078125 /end COMPU_METHOD
/begin COMPU_METHOD COMP_0316_S "2^-9%" RAT_FUNC "%8.4" "%" COEFFS 0 1 0 0 0 0.00195313 /end COMPU_METHOD
/begin COMPU_METHOD COMP_0320_S "0.25A" RAT_FUNC "%8.2" "A" COEFFS 0 1 0 0 0 0.25 /end COMPU_METHOD
/begin COMPU_METHOD COMP_0365_S "64/256deg" RAT_FUNC "%8.2" "deg" COEFFS 0 1 0 0 0 0.25 /end COMPU_METHOD
/begin COMPU_METHOD COMP_0366_S "1/2048oct" RAT_FUNC "%8.5" "oct" COEFFS 0 1 0 0 0 0.000488281 /end COMPU_METHOD
/begin COMPU_METHOD COMP_0367_S "0.00390625-" RAT_FUNC "%8.4" "-" COEFFS 0 1 128 0 0 0.00390625 /end COMPU_METHOD
/begin COMPU_METHOD COMP_0402_S "8g/m^3" RAT_FUNC "%8.2" "g/m^3" COEFFS 0 1 0 0 0 8 /end COMPU_METHOD
/begin COMPU_METHOD COMP_0403_S "50-" RAT_FUNC "%8.2" "-" COEFFS 0 1 0 0 0 50 /end COMPU_METHOD
/begin COMPU_METHOD COMP_0426_S "0.00976MPa/2ms" RAT_FUNC "%8.4" "MPa/2ms" COEFFS 0 1 0 0 0 0.00976 /end COMPU_METHOD
/begin COMPU_METHOD COMP_0429_S "1/50-" RAT_FUNC "%8.3" "-" COEFFS 0 1 0 0 0 0.02 /end COMPU_METHOD
/begin COMPU_METHOD COMP_0467_S "minmin" RAT_FUNC "%8.2" "min" COEFFS 0 1 0 0 0 1 /end COMPU_METHOD
/begin COMPU_METHOD COMP_0468_S "%%" RAT_FUNC "%8.2" "%" COEFFS 0 1 0 0 0 1 /end COMPU_METHOD
/begin COMPU_METHOD COMP_0231 "10μS" RAT_FUNC "%8.2" "μS" COEFFS 0 1 0 0 0 10 /end COMPU_METHOD
/begin COMPU_METHOD COMP_0469_S "mm^3mm^3" RAT_FUNC "%8.2" "mm^3" COEFFS 0 1 0 0 0 0.3125 /end COMPU_METHOD
/begin COMPU_METHOD COMP_0470_S "%%" RAT_FUNC "%8.3" "%" COEFFS 0 1 0 0 0 0.025 /end COMPU_METHOD
/begin COMPU_METHOD COMP_0471_S "VV" RAT_FUNC "%8.5" "V" COEFFS 0 1 0 0 0 0.000122 /end COMPU_METHOD
/begin COMPU_METHOD COMP_0472_S "°°" RAT_FUNC "%8.2" "°" COEFFS 0 1 64 0 0 0.5 /end COMPU_METHOD
/begin COMPU_METHOD COMP_0327 "1/32768-" RAT_FUNC "%8.6" "-" COEFFS 0 1 0 0 0 0.0000305 /end COMPU_METHOD
/begin COMPU_METHOD COMP_0117 "100/128%" RAT_FUNC "%8.2" "%" COEFFS 0 1 100 0 0 0.78125 /end COMPU_METHOD
/begin COMPU_METHOD COMP_0378 "100/255%" RAT_FUNC "%8.2" "%" COEFFS 0 1 0 0 0 0.392156863 /end COMPU_METHOD
/begin COMPU_METHOD COMP_0473_S "kPakPa" RAT_FUNC "%8.2" "kPa" COEFFS 0 1 0 0 0 10 /end COMPU_METHOD
/begin COMPU_METHOD COMP_0474_S "kPakPa" RAT_FUNC "%8.2" "kPa" COEFFS 0 1 0 0 0 1 /end COMPU_METHOD
/begin COMPU_METHOD COMP_0426 "－code" RAT_FUNC "%8.2" "code" COEFFS 0 1 0 0 0 1 /end COMPU_METHOD
/begin COMPU_METHOD COMP_0475_S "PaPa" RAT_FUNC "%8.2" "Pa" COEFFS 0 1 0 0 0 0.25 /end COMPU_METHOD
/begin COMPU_METHOD COMP_0476_S "g/sg/s" RAT_FUNC "%8.3" "g/s" COEFFS 0 1 0 0 0 0.01 /end COMPU_METHOD
/begin COMPU_METHOD COMP_0427 "0.25rpm" RAT_FUNC "%8.2" "rpm" COEFFS 0 1 0 0 0 0.25 /end COMPU_METHOD
/begin COMPU_METHOD COMP_0428 "X-40℃" RAT_FUNC "%8.2" "℃" COEFFS 0 1 40 0 0 1 /end COMPU_METHOD
/begin COMPU_METHOD COMP_0477_S "℃℃" RAT_FUNC "%8.2" "℃" COEFFS 0 1 40 0 0 0.1 /end COMPU_METHOD
/begin COMPU_METHOD COMP_0478_S "VV" RAT_FUNC "%8.4" "V" COEFFS 0 1 0 0 0 0.001 /end COMPU_METHOD
/begin COMPU_METHOD COMP_0479_S "mm^2mm^2" RAT_FUNC "%8.6" "mm^2" COEFFS 0 1 0 0 0 0.0000305176 /end COMPU_METHOD
/begin COMPU_METHOD COMP_0480_S "11" RAT_FUNC "%8.2" "1" COEFFS 0 1 0 0 0 1 /end COMPU_METHOD
/begin COMPU_METHOD COMP_0481_S "km/hkm/h" RAT_FUNC "%8.6" "km/h" COEFFS 0 1 0 0 0 0.000000858 /end COMPU_METHOD
/begin COMPU_METHOD COMP_0482_S "MPaMPa" RAT_FUNC "%8.4" "MPa" COEFFS 0 1 0.098 0 0 0.003847 /end COMPU_METHOD
/begin COMPU_METHOD COMP_0483_S "%%" RAT_FUNC "%8.4" "%" COEFFS 0 1 0 0 0 0.00305176 /end COMPU_METHOD
/begin COMPU_METHOD COMP_0515 "1/2048ms" RAT_FUNC "%8.5" "ms" COEFFS 0 1 0 0 0 0.000488281 /end COMPU_METHOD
/begin COMPU_METHOD COMP_0484_S "degCAdegCA" RAT_FUNC "%8.2" "degCA" COEFFS 0 1 0 0 0 1 /end COMPU_METHOD
/begin COMPU_METHOD COMP_0379 "8/10000cm**2" RAT_FUNC "%8.5" "cm**2" COEFFS 0 1 0 0 0 0.0008 /end COMPU_METHOD
/begin COMPU_METHOD COMP_0529 "128/(128*256)degCA" RAT_FUNC "%8.4" "degCA" COEFFS 0 1 128 0 0 0.00390625 /end COMPU_METHOD
/begin COMPU_METHOD COMP_0421 "1気筒" RAT_FUNC "%8.2" "気筒" COEFFS 0 1 0 0 0 1 /end COMPU_METHOD
/begin COMPU_METHOD COMP_0449 "1/256ms" RAT_FUNC "%8.4" "ms" COEFFS 0 1 0 0 0 0.00390625 /end COMPU_METHOD
/begin COMPU_METHOD COMP_0458 "10/256μS" RAT_FUNC "%8.3" "μS" COEFFS 0 1 1280 0 0 0.0390625 /end COMPU_METHOD
/begin COMPU_METHOD COMP_0485_S "cm^2/(rpm*cc)cm^2/(rp" RAT_FUNC "%8.6" "cm^2/(rp" COEFFS 0 1 0 0 0 0.0000000000908 /end COMPU_METHOD
/begin COMPU_METHOD COMP_0486_S "cm**2cm**2" RAT_FUNC "%8.4" "cm**2" COEFFS 0 1 0 0 0 0.0016 /end COMPU_METHOD
/begin COMPU_METHOD COMP_0487_S "_%/s_%/s" RAT_FUNC "%8.5" "_%/s" COEFFS 0 1 0 0 0 0.000976563 /end COMPU_METHOD
/begin COMPU_METHOD COMP_0488_S "m/ssm/ss" RAT_FUNC "%8.5" "m/ss" COEFFS 0 1 0 0 0 0.00024414 /end COMPU_METHOD
/begin COMPU_METHOD COMP_0489_S "kjkj" RAT_FUNC "%8.5" "kj" COEFFS 0 1 0 0 0 0.0001 /end COMPU_METHOD
/begin COMPU_METHOD COMP_0490_S "A100msA100ms" RAT_FUNC "%8.4" "A100ms" COEFFS 0 1 4194314.73741824 0 0 0.00195313 /end COMPU_METHOD
/begin COMPU_METHOD COMP_0491_S "degdeg" RAT_FUNC "%8.4" "deg" COEFFS 0 1 64 0 0 0.00390625 /end COMPU_METHOD
/begin COMPU_METHOD COMP_0516 "(X-16384)/256deg" RAT_FUNC "%8.4" "deg" COEFFS 0 1 64 0 0 0.00390625 /end COMPU_METHOD
/begin COMPU_METHOD COMP_0264 "1－" RAT_FUNC "%8.2" "－" COEFFS 0 1 0 0 0 1 /end COMPU_METHOD
/begin COMPU_METHOD COMP_0492_S "--" RAT_FUNC "%8.2" "-" COEFFS 0 1 0 0 0 3.125 /end COMPU_METHOD
/begin COMPU_METHOD COMP_0493_S "%%" RAT_FUNC "%8.2" "%" COEFFS 0 1 0 0 0 0.4 /end COMPU_METHOD
/begin COMPU_METHOD COMP_0494_S "kmkm" RAT_FUNC "%8.2" "km" COEFFS 0 1 0 0 0 25.72 /end COMPU_METHOD
/begin COMPU_METHOD COMP_0372 "0.0008cm2" RAT_FUNC "%8.5" "cm2" COEFFS 0 1 0 0 0 0.0008 /end COMPU_METHOD
/begin COMPU_METHOD COMP_0495_S "AA" RAT_FUNC "%8.3" "A" COEFFS 0 1 327.68 0 0 0.01 /end COMPU_METHOD
/begin COMPU_METHOD COMP_0359 "0.5%" RAT_FUNC "%8.2" "%" COEFFS 0 1 64 0 0 0.5 /end COMPU_METHOD
/begin COMPU_METHOD COMP_0496_S "μSμS" RAT_FUNC "%8.2" "μS" COEFFS 0 1 0 0 0 209715.2 /end COMPU_METHOD
/begin COMPU_METHOD COMP_0374 "0.0002cm**2" RAT_FUNC "%8.5" "cm**2" COEFFS 0 1 0 0 0 0.0002 /end COMPU_METHOD
/begin COMPU_METHOD COMP_0127 "0.35X-0x80deg/30ms" RAT_FUNC "%8.2" "deg/30ms" COEFFS 0 1 44.8 0 0 0.35 /end COMPU_METHOD
/begin COMPU_METHOD COMP_0376 "0.1μS" RAT_FUNC "%8.2" "μS" COEFFS 0 1 0 0 0 0.1 /end COMPU_METHOD
/begin COMPU_METHOD COMP_0377 "0.11deg" RAT_FUNC "%8.2" "deg" COEFFS 0 1 0 0 0 0.11 /end COMPU_METHOD
/begin COMPU_METHOD COMP_0497_S "NmNm" RAT_FUNC "%8.2" "Nm" COEFFS 0 1 100 0 0 2 /end COMPU_METHOD
/begin COMPU_METHOD COMP_0118 "40mV" RAT_FUNC "%8.2" "mV" COEFFS 0 1 0 0 0 40 /end COMPU_METHOD
/begin COMPU_METHOD COMP_0498_S "mgmg" RAT_FUNC "%8.3" "mg" COEFFS 0 1 0 0 0 0.01 /end COMPU_METHOD
/begin COMPU_METHOD COMP_0269 "0.5/256%" RAT_FUNC "%8.4" "%" COEFFS 0 1 0 0 0 0.001953125 /end COMPU_METHOD
/begin COMPU_METHOD COMP_0499_S "%%" RAT_FUNC "%8.4" "%" COEFFS 0 1 0 0 0 0.00305176 /end COMPU_METHOD
/begin COMPU_METHOD COMP_0500_S "degdeg" RAT_FUNC "%8.4" "deg" COEFFS 0 1 0 0 0 0.0078125 /end COMPU_METHOD
/begin COMPU_METHOD COMP_0501_S "%%" RAT_FUNC "%8.3" "%" COEFFS 0 1 0 0 0 0.078125 /end COMPU_METHOD
/begin COMPU_METHOD COMP_0502_S "kjkj" RAT_FUNC "%8.4" "kj" COEFFS 0 1 0 0 0 0.001 /end COMPU_METHOD
/begin COMPU_METHOD COMP_0503_S "ｍｖｍｖ" RAT_FUNC "%8.3" "ｍｖ" COEFFS 0 1 0 0 0 0.078125 /end COMPU_METHOD
/begin COMPU_METHOD COMP_0504_S "degCAdegCA" RAT_FUNC "%8.4" "degCA" COEFFS 0 1 0 0 0 0.001953125 /end COMPU_METHOD
/begin COMPU_METHOD COMP_0528 "64/(128*256)degCA" RAT_FUNC "%8.4" "degCA" COEFFS 0 1 64 0 0 0.001953125 /end COMPU_METHOD
/begin COMPU_METHOD COMP_0505_S "AA" RAT_FUNC "%8.4" "A" COEFFS 0 1 128 0 0 0.00390625 /end COMPU_METHOD
/begin COMPU_METHOD COMP_0506_S "mVmV" RAT_FUNC "%8.2" "mV" COEFFS 0 1 0 0 0 0.5 /end COMPU_METHOD
/begin COMPU_METHOD COMP_0507_S "mVmV" RAT_FUNC "%8.2" "mV" COEFFS 0 1 0 0 0 0.25 /end COMPU_METHOD
/begin COMPU_METHOD COMP_0508_S "℃℃" RAT_FUNC "%8.6" "℃" COEFFS 0 1 50 0 0 0.0000001 /end COMPU_METHOD
/begin COMPU_METHOD COMP_0382 "10mV/500mV" RAT_FUNC "%8.2" "mV/500mV" COEFFS 0 1 0 0 0 10 /end COMPU_METHOD
/begin COMPU_METHOD COMP_0509_S "degdeg" RAT_FUNC "%8.2" "deg" COEFFS 0 1 0 0 0 0.25 /end COMPU_METHOD
/begin COMPU_METHOD COMP_0510_S "deg/50msdeg/50ms" RAT_FUNC "%8.2" "deg/50ms" COEFFS 0 1 0 0 0 0.11 /end COMPU_METHOD
/begin COMPU_METHOD COMP_0511_S "--" RAT_FUNC "%8.6" "-" COEFFS 0 1 0 0 0 0.0000001 /end COMPU_METHOD
/begin COMPU_METHOD COMP_0512_S "1/sec1/sec" RAT_FUNC "%8.6" "1/sec" COEFFS 0 1 0 0 0 0.00001 /end COMPU_METHOD
/begin COMPU_METHOD COMP_0384 "1/128-" RAT_FUNC "%8.4" "-" COEFFS 0 1 0 0 0 0.007813 /end COMPU_METHOD
/begin COMPU_METHOD COMP_0513_S "μｓμｓ" RAT_FUNC "%8.2" "μｓ" COEFFS 0 1 0 0 0 3.2 /end COMPU_METHOD
/begin COMPU_METHOD COMP_0452 "0.2/256/100ms" RAT_FUNC "%8.5" "/100ms" COEFFS 0 1 0 0 0 0.00078125 /end COMPU_METHOD
/end MODULE
/end PROJECT
