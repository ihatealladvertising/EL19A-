/begin PROJECT X12C_KH3DT_DI_NAM_R/C ""
/begin HEADER "" /* key HEADER ++ "comment" に Par.scomment */ PROJECT_NO X12C_KH3DT_DI_NAM_R/C /* key PROJECT_NO ++ project number に car_eng_desti_lot */ VERSION "0KHDCFDZ7" /* key VERSION ++ version number に mProgver */ /end HEADER
/begin MODULE DIM ""
/begin MOD_COMMON "" ALIGNMENT_BYTE 1 ALIGNMENT_WORD 2 ALIGNMENT_LONG 4 ALIGNMENT_FLOAT32_IEEE 4 ALIGNMENT_FLOAT64_IEEE 4 DEPOSIT ABSOLUTE BYTE_ORDER MSB_FIRST /* ﾊﾞｲﾄｵｰﾀﾞｰがﾘﾌﾟﾚｰｽされる */ /end MOD_COMMON
/begin MEASUREMENT fFPRI2MIL "0:第二水準診断F.F.記憶(NG確定)時MI  1:第二水準診断F.F.記憶(NG確定)時MI" UBYTE COMP_0283 1 100 0 1 BIT_MASK 0x0020 ECU_ADDRESS 0xFFFF5623 READ_WRITE /end MEASUREMENT
/begin MEASUREMENT fFPRINJ "0:始動時燃料予備噴射実行前  1:始動時燃料予備噴射終了" UBYTE COMP_0283 1 100 0 1 BIT_MASK 0x0010 ECU_ADDRESS 0xFFFF5623 READ_WRITE /end MEASUREMENT
/begin MEASUREMENT fFTFNGO "0:診断OK  1:診断NG" UBYTE COMP_0283 1 100 0 1 BIT_MASK 0x0008 ECU_ADDRESS 0xFFFF5623 READ_WRITE /end MEASUREMENT
/begin MEASUREMENT fFTFNGR "0:診断OK  1:診断NG" UBYTE COMP_0283 1 100 0 1 BIT_MASK 0x0004 ECU_ADDRESS 0xFFFF5623 READ_WRITE /end MEASUREMENT
/begin MEASUREMENT fFTFNGS "0:診断OK  1:診断NG" UBYTE COMP_0283 1 100 0 1 BIT_MASK 0x0002 ECU_ADDRESS 0xFFFF5623 READ_WRITE /end MEASUREMENT
/begin MEASUREMENT fFTVOLNEX "0:なし  1:あり" UBYTE COMP_0283 1 100 0 1 BIT_MASK 0x0001 ECU_ADDRESS 0xFFFF5623 READ_WRITE /end MEASUREMENT
/begin MEASUREMENT fFVTCE "0:経験未  1:経験済" UBYTE COMP_0283 1 100 0 1 BIT_MASK 0x0080 ECU_ADDRESS 0xFFFF5624 READ_WRITE /end MEASUREMENT
/begin MEASUREMENT fFVTTWN "0:水温15℃未満  1:水温75℃以上" UBYTE COMP_0283 1 100 0 1 BIT_MASK 0x0040 ECU_ADDRESS 0xFFFF5624 READ_WRITE /end MEASUREMENT
/begin MEASUREMENT fLRNANG "0:ﾘﾐｯﾀ値OK  1:ﾘﾐｯﾀ値NG" UBYTE COMP_0283 1 100 0 1 BIT_MASK 0x0020 ECU_ADDRESS 0xFFFF5624 READ_WRITE /end MEASUREMENT
/begin MEASUREMENT fMAENG "0:前回NG判定なし  1:前回NG判定あり" UBYTE COMP_0283 1 100 0 1 BIT_MASK 0x0010 ECU_ADDRESS 0xFFFF5624 READ_WRITE /end MEASUREMENT
/begin MEASUREMENT fMFMLON "0:なし  1:あり" UBYTE COMP_0283 1 100 0 1 BIT_MASK 0x0008 ECU_ADDRESS 0xFFFF5624 READ_WRITE /end MEASUREMENT
/begin MEASUREMENT fMILWRM "0:故障ｺｰﾄﾞｸﾘｱ条件成立  1:故障ｺｰﾄﾞｸﾘｱ条件不成立" UBYTE COMP_0283 1 100 0 1 BIT_MASK 0x0004 ECU_ADDRESS 0xFFFF5624 READ_WRITE /end MEASUREMENT
/begin MEASUREMENT fMILWRMZ "0:故障ｺｰﾄﾞｸﾘｱ条件成立  1:故障ｺｰﾄﾞｸﾘｱ条件不成立" UBYTE COMP_0283 1 100 0 1 BIT_MASK 0x0002 ECU_ADDRESS 0xFFFF5624 READ_WRITE /end MEASUREMENT
/begin MEASUREMENT fO2SEND "0:後O2/S診断未終了  1:後O2/S診断終了" UBYTE COMP_0283 1 100 0 1 BIT_MASK 0x0001 ECU_ADDRESS 0xFFFF5624 READ_WRITE /end MEASUREMENT
/begin MEASUREMENT fRFLCAPW "0:CAP警告灯制御用給油判定不成立  1:CAP警告灯制御用給油判定成立" UBYTE COMP_0283 1 100 0 1 BIT_MASK 0x0080 ECU_ADDRESS 0xFFFF5625 READ_WRITE /end MEASUREMENT
/begin MEASUREMENT fRODRNG "0:未判定  1:NG判定" UBYTE COMP_0283 1 100 0 1 BIT_MASK 0x0040 ECU_ADDRESS 0xFFFF5625 READ_WRITE /end MEASUREMENT
/begin MEASUREMENT fRODRNG2 "0:未判定  1:NG判定" UBYTE COMP_0283 1 100 0 1 BIT_MASK 0x0020 ECU_ADDRESS 0xFFFF5625 READ_WRITE /end MEASUREMENT
/begin MEASUREMENT fTSTAFH "0:グループ内の診断でNG判定していな  1:グループ内の診断のどれかがNG判定" UBYTE COMP_0283 1 100 0 1 BIT_MASK 0x0010 ECU_ADDRESS 0xFFFF5625 READ_WRITE /end MEASUREMENT
/begin MEASUREMENT fTSTAFH1 "0:グループ内の診断でNG判定していな  1:グループ内の診断のどれかがNG判定" UBYTE COMP_0283 1 100 0 1 BIT_MASK 0x0008 ECU_ADDRESS 0xFFFF5625 READ_WRITE /end MEASUREMENT
/begin MEASUREMENT fTSTAFH2 "0:グループ内の診断でNG判定していな  1:グループ内の診断のどれかがNG判定" UBYTE COMP_0283 1 100 0 1 BIT_MASK 0x0004 ECU_ADDRESS 0xFFFF5625 READ_WRITE /end MEASUREMENT
/begin MEASUREMENT fTSTAFM "0:グループ内の診断でNG判定していな  1:グループ内の診断のどれかがNG判定" UBYTE COMP_0283 1 100 0 1 BIT_MASK 0x0002 ECU_ADDRESS 0xFFFF5625 READ_WRITE /end MEASUREMENT
/begin MEASUREMENT fTSTAFM1 "0:グループ内の診断でNG判定していな  1:グループ内の診断のどれかがNG判定" UBYTE COMP_0283 1 100 0 1 BIT_MASK 0x0001 ECU_ADDRESS 0xFFFF5625 READ_WRITE /end MEASUREMENT
/begin MEASUREMENT fTSTAFM2 "0:グループ内の診断でNG判定していな  1:グループ内の診断のどれかがNG判定" UBYTE COMP_0283 1 100 0 1 BIT_MASK 0x0080 ECU_ADDRESS 0xFFFF5626 READ_WRITE /end MEASUREMENT
/begin MEASUREMENT fTSTAFS "0:グループ内の診断でNG判定していな  1:グループ内の診断のどれかがNG判定" UBYTE COMP_0283 1 100 0 1 BIT_MASK 0x0040 ECU_ADDRESS 0xFFFF5626 READ_WRITE /end MEASUREMENT
/begin MEASUREMENT fTSTAFS1 "0:グループ内の診断でNG判定していな  1:グループ内の診断のどれかがNG判定" UBYTE COMP_0283 1 100 0 1 BIT_MASK 0x0020 ECU_ADDRESS 0xFFFF5626 READ_WRITE /end MEASUREMENT
/begin MEASUREMENT fTSTAFS2 "0:グループ内の診断でNG判定していな  1:グループ内の診断のどれかがNG判定" UBYTE COMP_0283 1 100 0 1 BIT_MASK 0x0010 ECU_ADDRESS 0xFFFF5626 READ_WRITE /end MEASUREMENT
/begin MEASUREMENT fTSTAPS "0:グループ内の診断でNG判定していな  1:グループ内の診断のどれかがNG判定" UBYTE COMP_0283 1 100 0 1 BIT_MASK 0x0008 ECU_ADDRESS 0xFFFF5626 READ_WRITE /end MEASUREMENT
/begin MEASUREMENT fTSTCAN "0:グループ内の診断でNG判定していな  1:グループ内の診断のどれかがNG判定" UBYTE COMP_0283 1 100 0 1 BIT_MASK 0x0004 ECU_ADDRESS 0xFFFF5626 READ_WRITE /end MEASUREMENT
/begin MEASUREMENT fTSTCS "0:グループ内の診断でNG判定していな  1:グループ内の診断のどれかがNG判定" UBYTE COMP_0283 1 100 0 1 BIT_MASK 0x0002 ECU_ADDRESS 0xFFFF5626 READ_WRITE /end MEASUREMENT
/begin MEASUREMENT fTSTCS1 "0:グループ内の診断でNG判定していな  1:グループ内の診断のどれかがNG判定" UBYTE COMP_0283 1 100 0 1 BIT_MASK 0x0001 ECU_ADDRESS 0xFFFF5626 READ_WRITE /end MEASUREMENT
/begin MEASUREMENT fTSTCS2 "0:グループ内の診断でNG判定していな  1:グループ内の診断のどれかがNG判定" UBYTE COMP_0283 1 100 0 1 BIT_MASK 0x0080 ECU_ADDRESS 0xFFFF5627 READ_WRITE /end MEASUREMENT
/begin MEASUREMENT fTSTEGR "0:グループ内の診断でNG判定していな  1:グループ内の診断のどれかがNG判定" UBYTE COMP_0283 1 100 0 1 BIT_MASK 0x0040 ECU_ADDRESS 0xFFFF5627 READ_WRITE /end MEASUREMENT
/begin MEASUREMENT fTSTERPS "0:グループ内の診断でNG判定していな  1:グループ内の診断のどれかがNG判定" UBYTE COMP_0283 1 100 0 1 BIT_MASK 0x0020 ECU_ADDRESS 0xFFFF5627 READ_WRITE /end MEASUREMENT
/begin MEASUREMENT fTSTEVTC "0:グループ内の診断でNG判定していな  1:グループ内の診断のどれかがNG判定" UBYTE COMP_0283 1 100 0 1 BIT_MASK 0x0010 ECU_ADDRESS 0xFFFF5627 READ_WRITE /end MEASUREMENT
/begin MEASUREMENT fTSTEVTC1 "0:グループ内の診断でNG判定していな  1:グループ内の診断のどれかがNG判定" UBYTE COMP_0283 1 100 0 1 BIT_MASK 0x0008 ECU_ADDRESS 0xFFFF5627 READ_WRITE /end MEASUREMENT
/begin MEASUREMENT fTSTEVTC2 "0:グループ内の診断でNG判定していな  1:グループ内の診断のどれかがNG判定" UBYTE COMP_0283 1 100 0 1 BIT_MASK 0x0004 ECU_ADDRESS 0xFFFF5627 READ_WRITE /end MEASUREMENT
/begin MEASUREMENT fTSTFLGS "0:グループ内の診断でNG判定していな  1:グループ内の診断のどれかがNG判定" UBYTE COMP_0283 1 100 0 1 BIT_MASK 0x0002 ECU_ADDRESS 0xFFFF5627 READ_WRITE /end MEASUREMENT
/begin MEASUREMENT fTSTIVTC "0:グループ内の診断でNG判定していな  1:グループ内の診断のどれかがNG判定" UBYTE COMP_0283 1 100 0 1 BIT_MASK 0x0001 ECU_ADDRESS 0xFFFF5627 READ_WRITE /end MEASUREMENT
/begin MEASUREMENT fTSTIVTC1 "0:グループ内の診断でNG判定していな  1:グループ内の診断のどれかがNG判定" UBYTE COMP_0283 1 100 0 1 BIT_MASK 0x0080 ECU_ADDRESS 0xFFFF5628 READ_WRITE /end MEASUREMENT
/begin MEASUREMENT fTSTIVTC2 "0:グループ内の診断でNG判定していな  1:グループ内の診断のどれかがNG判定" UBYTE COMP_0283 1 100 0 1 BIT_MASK 0x0040 ECU_ADDRESS 0xFFFF5628 READ_WRITE /end MEASUREMENT
/begin MEASUREMENT fTSTMF "0:グループ内の診断でNG判定していな  1:グループ内の診断のどれかがNG判定" UBYTE COMP_0283 1 100 0 1 BIT_MASK 0x0020 ECU_ADDRESS 0xFFFF5628 READ_WRITE /end MEASUREMENT
/begin MEASUREMENT fTSTMR "0:グループ内の診断でNG判定していな  1:グループ内の診断のどれかがNG判定" UBYTE COMP_0283 1 100 0 1 BIT_MASK 0x0010 ECU_ADDRESS 0xFFFF5628 READ_WRITE /end MEASUREMENT
/begin MEASUREMENT fTSTMR1 "0:グループ内の診断でNG判定していな  1:グループ内の診断のどれかがNG判定" UBYTE COMP_0283 1 100 0 1 BIT_MASK 0x0008 ECU_ADDRESS 0xFFFF5628 READ_WRITE /end MEASUREMENT
/begin MEASUREMENT fTSTMR2 "0:グループ内の診断でNG判定していな  1:グループ内の診断のどれかがNG判定" UBYTE COMP_0283 1 100 0 1 BIT_MASK 0x0004 ECU_ADDRESS 0xFFFF5628 READ_WRITE /end MEASUREMENT
/begin MEASUREMENT fTSTPCV "0:グループ内の診断でNG判定していな  1:グループ内の診断のどれかがNG判定" UBYTE COMP_0283 1 100 0 1 BIT_MASK 0x0002 ECU_ADDRESS 0xFFFF5628 READ_WRITE /end MEASUREMENT
/begin MEASUREMENT fTSTPURGE "0:グループ内の診断でNG判定していな  1:グループ内の診断のどれかがNG判定" UBYTE COMP_0283 1 100 0 1 BIT_MASK 0x0001 ECU_ADDRESS 0xFFFF5628 READ_WRITE /end MEASUREMENT
/begin MEASUREMENT fTSTSAIS1 "0:グループ内の診断でNG判定していな  1:グループ内の診断のどれかがNG判定" UBYTE COMP_0283 1 100 0 1 BIT_MASK 0x0080 ECU_ADDRESS 0xFFFF5629 READ_WRITE /end MEASUREMENT
/begin MEASUREMENT fTSTSAIS2 "0:グループ内の診断でNG判定していな  1:グループ内の診断のどれかがNG判定" UBYTE COMP_0283 1 100 0 1 BIT_MASK 0x0040 ECU_ADDRESS 0xFFFF5629 READ_WRITE /end MEASUREMENT
/begin MEASUREMENT fTSTSCV "0:グループ内の診断でNG判定していな  1:グループ内の診断のどれかがNG判定" UBYTE COMP_0283 1 100 0 1 BIT_MASK 0x0020 ECU_ADDRESS 0xFFFF5629 READ_WRITE /end MEASUREMENT
/begin MEASUREMENT fTSTSCV1 "0:グループ内の診断でNG判定していな  1:グループ内の診断のどれかがNG判定" UBYTE COMP_0283 1 100 0 1 BIT_MASK 0x0010 ECU_ADDRESS 0xFFFF5629 READ_WRITE /end MEASUREMENT
/begin MEASUREMENT fTSTSCV2 "0:グループ内の診断でNG判定していな  1:グループ内の診断のどれかがNG判定" UBYTE COMP_0283 1 100 0 1 BIT_MASK 0x0008 ECU_ADDRESS 0xFFFF5629 READ_WRITE /end MEASUREMENT
/begin MEASUREMENT fTSTTA "0:グループ内の診断でNG判定していな  1:グループ内の診断のどれかがNG判定" UBYTE COMP_0283 1 100 0 1 BIT_MASK 0x0004 ECU_ADDRESS 0xFFFF5629 READ_WRITE /end MEASUREMENT
/begin MEASUREMENT fTSTTATH "0:グループ内の診断でNG判定していな  1:グループ内の診断のどれかがNG判定" UBYTE COMP_0283 1 100 0 1 BIT_MASK 0x0002 ECU_ADDRESS 0xFFFF5629 READ_WRITE /end MEASUREMENT
/begin MEASUREMENT fTSTTF "0:グループ内の診断でNG判定していな  1:グループ内の診断のどれかがNG判定" UBYTE COMP_0283 1 100 0 1 BIT_MASK 0x0001 ECU_ADDRESS 0xFFFF5629 READ_WRITE /end MEASUREMENT
/begin MEASUREMENT fTSTTHMO "0:グループ内の診断でNG判定していな  1:グループ内の診断のどれかがNG判定" UBYTE COMP_0283 1 100 0 1 BIT_MASK 0x0080 ECU_ADDRESS 0xFFFF562A READ_WRITE /end MEASUREMENT
/begin MEASUREMENT fTSTTHMO1 "0:グループ内の診断でNG判定していな  1:グループ内の診断のどれかがNG判定" UBYTE COMP_0283 1 100 0 1 BIT_MASK 0x0040 ECU_ADDRESS 0xFFFF562A READ_WRITE /end MEASUREMENT
/begin MEASUREMENT fTSTTHMO2 "0:グループ内の診断でNG判定していな  1:グループ内の診断のどれかがNG判定" UBYTE COMP_0283 1 100 0 1 BIT_MASK 0x0020 ECU_ADDRESS 0xFFFF562A READ_WRITE /end MEASUREMENT
/begin MEASUREMENT fTSTTO "0:グループ内の診断でNG判定していな  1:グループ内の診断のどれかがNG判定" UBYTE COMP_0283 1 100 0 1 BIT_MASK 0x0010 ECU_ADDRESS 0xFFFF562A READ_WRITE /end MEASUREMENT
/begin MEASUREMENT fTSTTPS "0:グループ内の診断でNG判定していな  1:グループ内の診断のどれかがNG判定" UBYTE COMP_0283 1 100 0 1 BIT_MASK 0x0008 ECU_ADDRESS 0xFFFF562A READ_WRITE /end MEASUREMENT
/begin MEASUREMENT fTSTTPS1 "0:グループ内の診断でNG判定していな  1:グループ内の診断のどれかがNG判定" UBYTE COMP_0283 1 100 0 1 BIT_MASK 0x0004 ECU_ADDRESS 0xFFFF562A READ_WRITE /end MEASUREMENT
/begin MEASUREMENT fTSTTPS2 "0:グループ内の診断でNG判定していな  1:グループ内の診断のどれかがNG判定" UBYTE COMP_0283 1 100 0 1 BIT_MASK 0x0002 ECU_ADDRESS 0xFFFF562A READ_WRITE /end MEASUREMENT
/begin MEASUREMENT fTSTTW "0:グループ内の診断でNG判定していな  1:グループ内の診断のどれかがNG判定" UBYTE COMP_0283 1 100 0 1 BIT_MASK 0x0001 ECU_ADDRESS 0xFFFF562A READ_WRITE /end MEASUREMENT
/begin MEASUREMENT fTSTVCN "0:グループ内の診断でNG判定していな  1:グループ内の診断のどれかがNG判定" UBYTE COMP_0283 1 100 0 1 BIT_MASK 0x0080 ECU_ADDRESS 0xFFFF562B READ_WRITE /end MEASUREMENT
/begin MEASUREMENT fTSTVEL "0:グループ内の診断でNG判定していな  1:グループ内の診断のどれかがNG判定" UBYTE COMP_0283 1 100 0 1 BIT_MASK 0x0040 ECU_ADDRESS 0xFFFF562B READ_WRITE /end MEASUREMENT
/begin MEASUREMENT fTSTVEL1 "0:グループ内の診断でNG判定していな  1:グループ内の診断のどれかがNG判定" UBYTE COMP_0283 1 100 0 1 BIT_MASK 0x0020 ECU_ADDRESS 0xFFFF562B READ_WRITE /end MEASUREMENT
/begin MEASUREMENT fTSTVEL2 "0:グループ内の診断でNG判定していな  1:グループ内の診断のどれかがNG判定" UBYTE COMP_0283 1 100 0 1 BIT_MASK 0x0010 ECU_ADDRESS 0xFFFF562B READ_WRITE /end MEASUREMENT
/begin MEASUREMENT fTSTVSPS "0:グループ内の診断でNG判定していな  1:グループ内の診断のどれかがNG判定" UBYTE COMP_0283 1 100 0 1 BIT_MASK 0x0008 ECU_ADDRESS 0xFFFF562B READ_WRITE /end MEASUREMENT
/begin MEASUREMENT fVFYDGN "0:SYNC監視部診断実行  1:演算結果照合機能診断実行" UBYTE COMP_0283 1 100 0 1 BIT_MASK 0x0004 ECU_ADDRESS 0xFFFF562B READ_WRITE /end MEASUREMENT
/begin MEASUREMENT fVTLNINI "0:学習未経験  1:学習経験済" UBYTE COMP_0283 1 100 0 1 BIT_MASK 0x0002 ECU_ADDRESS 0xFFFF562B READ_WRITE /end MEASUREMENT
/begin MEASUREMENT fEEPWRT_S "0:学習処理実行中でない  1:学習処理実行中" UBYTE COMP_0283 1 100 0 1 BIT_MASK 0x0001 ECU_ADDRESS 0xFFFF562B READ_WRITE /end MEASUREMENT
/begin MEASUREMENT fFACTTW "0:水温暖機未経験  1:水温暖機経験" UBYTE COMP_0283 1 100 0 1 BIT_MASK 0x0080 ECU_ADDRESS 0xFFFF561E READ_WRITE /end MEASUREMENT
/begin MEASUREMENT fGLRNOK "0:未完了  1:完了" UBYTE COMP_0283 1 100 0 1 BIT_MASK 0x0040 ECU_ADDRESS 0xFFFF561E READ_WRITE /end MEASUREMENT
/begin MEASUREMENT fNGCOMP "0:不成立  1:成立" UBYTE COMP_0283 1 100 0 1 BIT_MASK 0x0020 ECU_ADDRESS 0xFFFF561E READ_WRITE /end MEASUREMENT
/begin MEASUREMENT fNGDECMP "0:不成立  1:成立" UBYTE COMP_0283 1 100 0 1 BIT_MASK 0x0010 ECU_ADDRESS 0xFFFF561E READ_WRITE /end MEASUREMENT
/begin MEASUREMENT fOKCOMP "0:不成立  1:成立" UBYTE COMP_0283 1 100 0 1 BIT_MASK 0x0008 ECU_ADDRESS 0xFFFF561E READ_WRITE /end MEASUREMENT
/begin MEASUREMENT fOKDECMP "0:不成立  1:成立" UBYTE COMP_0283 1 100 0 1 BIT_MASK 0x0004 ECU_ADDRESS 0xFFFF561E READ_WRITE /end MEASUREMENT
/begin MEASUREMENT fSIDONG "0:不成立  1:成立" UBYTE COMP_0283 1 100 0 1 BIT_MASK 0x0002 ECU_ADDRESS 0xFFFF561E READ_WRITE /end MEASUREMENT
/begin MEASUREMENT fSLOPE "0:坂道判定不成立  1:成立" UBYTE COMP_0283 1 100 0 1 BIT_MASK 0x0001 ECU_ADDRESS 0xFFFF561E READ_WRITE /end MEASUREMENT
/begin MEASUREMENT fSLOSH "0:スロッシュ判定不成立  1:成立" UBYTE COMP_0283 1 100 0 1 BIT_MASK 0x0080 ECU_ADDRESS 0xFFFF561F READ_WRITE /end MEASUREMENT
/begin MEASUREMENT fSTSYSTYP "0:Push始動ｼｽﾃﾑ  1:Key始動ｼｽﾃﾑ" UBYTE COMP_0283 1 100 0 1 BIT_MASK 0x0040 ECU_ADDRESS 0xFFFF561F READ_WRITE /end MEASUREMENT
/begin MEASUREMENT fABACKCLR "0:CAN送信取り消し(ABACK)発生しない  1:CAN送信取り消し(ABACK)発生" UBYTE COMP_0283 1 100 0 1 BIT_MASK 0x0080 ECU_ADDRESS 0xFFFF3CCC READ_WRITE /end MEASUREMENT
/begin MEASUREMENT fACCCCMSK "0:右記以外  1:送信ｷｬﾝｾﾙ" UBYTE COMP_0283 1 100 0 1 BIT_MASK 0x0040 ECU_ADDRESS 0xFFFF3CCC READ_WRITE /end MEASUREMENT
/begin MEASUREMENT fACCRESSW "0:OFF  1:ON" UBYTE COMP_0283 1 100 0 1 BIT_MASK 0x0020 ECU_ADDRESS 0xFFFF3CCC READ_WRITE /end MEASUREMENT
/begin MEASUREMENT fACCSETSW "0:OFF  1:ON" UBYTE COMP_0283 1 100 0 1 BIT_MASK 0x0010 ECU_ADDRESS 0xFFFF3CCC READ_WRITE /end MEASUREMENT
/begin MEASUREMENT fACCSLOUT "0:右記以外  1:送信要求" UBYTE COMP_0283 1 100 0 1 BIT_MASK 0x0008 ECU_ADDRESS 0xFFFF3CCC READ_WRITE /end MEASUREMENT
/begin MEASUREMENT fACTPJUG "0:不成立  1:成立" UBYTE COMP_0283 1 100 0 1 BIT_MASK 0x0001 ECU_ADDRESS 0xFFFF3CCC READ_WRITE /end MEASUREMENT
/begin MEASUREMENT fADDGN "0:実行不許可  1:実行許可" UBYTE COMP_0283 1 100 0 1 BIT_MASK 0x0080 ECU_ADDRESS 0xFFFF3CCD READ_WRITE /end MEASUREMENT
/begin MEASUREMENT fADDGNJDG "0:診断許可条件不成立  1:診断許可条件成立" UBYTE COMP_0283 1 100 0 1 BIT_MASK 0x0040 ECU_ADDRESS 0xFFFF3CCD READ_WRITE /end MEASUREMENT
/begin MEASUREMENT fAFHVB16 "0:右記以外  1:VB＜16.08[V]:ヒス-1.04[V]" UBYTE COMP_0283 1 100 0 1 BIT_MASK 0x0020 ECU_ADDRESS 0xFFFF3CCD READ_WRITE /end MEASUREMENT
/begin MEASUREMENT fAFMTMTRG "0:AFM_timer停止中  1:AFM_timer動作中" UBYTE COMP_0283 1 100 0 1 BIT_MASK 0x0010 ECU_ADDRESS 0xFFFF3CCD READ_WRITE /end MEASUREMENT
/begin MEASUREMENT fAPOZ1ST "0:初回  1:2回目以降" UBYTE COMP_0283 1 100 0 1 BIT_MASK 0x0008 ECU_ADDRESS 0xFFFF3CCD READ_WRITE /end MEASUREMENT
/begin MEASUREMENT fAPS1END "0:移動平均演算中  1:移動平均演算終了" UBYTE COMP_0283 1 100 0 1 BIT_MASK 0x0004 ECU_ADDRESS 0xFFFF3CCD READ_WRITE /end MEASUREMENT
/begin MEASUREMENT fAPS2END "0:移動平均演算中  1:移動平均演算終了" UBYTE COMP_0283 1 100 0 1 BIT_MASK 0x0002 ECU_ADDRESS 0xFFFF3CCD READ_WRITE /end MEASUREMENT
/begin MEASUREMENT fAPSFST "0:初回  1:初回以外" UBYTE COMP_0283 1 100 0 1 BIT_MASK 0x0001 ECU_ADDRESS 0xFFFF3CCD READ_WRITE /end MEASUREMENT
/begin MEASUREMENT fAPSFULL "0:右記以外  1:ｱｸｾﾙ全開判定中" UBYTE COMP_0283 1 100 0 1 BIT_MASK 0x0080 ECU_ADDRESS 0xFFFF3CCE READ_WRITE /end MEASUREMENT
/begin MEASUREMENT fAPSFULL0 "0:右記以外  1:ｱｸｾﾙ全開判定条件成立中" UBYTE COMP_0283 1 100 0 1 BIT_MASK 0x0040 ECU_ADDRESS 0xFFFF3CCE READ_WRITE /end MEASUREMENT
/begin MEASUREMENT fAPSKD0 "0:右記以外  1:ｷｯｸﾀﾞｳﾝ判定条件成立中" UBYTE COMP_0283 1 100 0 1 BIT_MASK 0x0020 ECU_ADDRESS 0xFFFF3CCE READ_WRITE /end MEASUREMENT
/begin MEASUREMENT fAPSKDCAN "0:右記以外  1:ｷｯｸﾀﾞｳﾝ判定中" UBYTE COMP_0283 1 100 0 1 BIT_MASK 0x0010 ECU_ADDRESS 0xFFFF3CCE READ_WRITE /end MEASUREMENT
/begin MEASUREMENT fAPSKDSL "0:右記以外  1:ｷｯｸﾀﾞｳﾝ判定中" UBYTE COMP_0283 1 100 0 1 BIT_MASK 0x0008 ECU_ADDRESS 0xFFFF3CCE READ_WRITE /end MEASUREMENT
/begin MEASUREMENT fAPSXCA "0:正常  1:警戒(過渡NG)" UBYTE COMP_0283 1 100 0 1 BIT_MASK 0x0004 ECU_ADDRESS 0xFFFF3CCE READ_WRITE /end MEASUREMENT
/begin MEASUREMENT fASCDACT "0:ASCD不許可  1:ASCD許可" UBYTE COMP_0283 1 100 0 1 BIT_MASK 0x0002 ECU_ADDRESS 0xFFFF3CCE READ_WRITE /end MEASUREMENT
/begin MEASUREMENT fASCDACTP "0:不許可  1:許可" UBYTE COMP_0283 1 100 0 1 BIT_MASK 0x0001 ECU_ADDRESS 0xFFFF3CCE READ_WRITE /end MEASUREMENT
/begin MEASUREMENT fASCDGNm "0:  1:" UBYTE COMP_0283 1 100 0 1 BIT_MASK 0x0080 ECU_ADDRESS 0xFFFF3CCF READ_WRITE /end MEASUREMENT
/begin MEASUREMENT fASRINREG "0:ASR電圧変動範囲外  1:ASR電圧変動範囲内" UBYTE COMP_0283 1 100 0 1 BIT_MASK 0x0040 ECU_ADDRESS 0xFFFF3CCF READ_WRITE /end MEASUREMENT
/begin MEASUREMENT fATCHNOK "0:不成立  1:成立" UBYTE COMP_0283 1 100 0 1 BIT_MASK 0x0020 ECU_ADDRESS 0xFFFF3CCF READ_WRITE /end MEASUREMENT
/begin MEASUREMENT fATCOLD "0:低油温以外  1:低油温" UBYTE COMP_0283 1 100 0 1 BIT_MASK 0x0010 ECU_ADDRESS 0xFFFF3CCF READ_WRITE /end MEASUREMENT
/begin MEASUREMENT fATGNSTNA "0:受信未経験  1:受信経験" UBYTE COMP_0283 1 100 0 1 BIT_MASK 0x0008 ECU_ADDRESS 0xFFFF3CCF READ_WRITE /end MEASUREMENT
/begin MEASUREMENT fATMPOK "0:不許可  1:許可" UBYTE COMP_0283 1 100 0 1 BIT_MASK 0x0004 ECU_ADDRESS 0xFFFF3CCF READ_WRITE /end MEASUREMENT
/begin MEASUREMENT fATMPRSOK "0:未  1:済み" UBYTE COMP_0283 1 100 0 1 BIT_MASK 0x0002 ECU_ADDRESS 0xFFFF3CCF READ_WRITE /end MEASUREMENT
/begin MEASUREMENT fATMPRSOKZ "0:未  1:済み" UBYTE COMP_0283 1 100 0 1 BIT_MASK 0x0001 ECU_ADDRESS 0xFFFF3CCF READ_WRITE /end MEASUREMENT
/begin MEASUREMENT fATTQCT1A "0:受信未経験  1:受信経験" UBYTE COMP_0283 1 100 0 1 BIT_MASK 0x0080 ECU_ADDRESS 0xFFFF3CD0 READ_WRITE /end MEASUREMENT
/begin MEASUREMENT fATTQCT2A "0:受信未経験  1:受信経験" UBYTE COMP_0283 1 100 0 1 BIT_MASK 0x0040 ECU_ADDRESS 0xFFFF3CD0 READ_WRITE /end MEASUREMENT
/begin MEASUREMENT fATTQN1A "0:受信未経験  1:受信経験" UBYTE COMP_0283 1 100 0 1 BIT_MASK 0x0020 ECU_ADDRESS 0xFFFF3CD0 READ_WRITE /end MEASUREMENT
/begin MEASUREMENT fAVEWLNPE "0:未終了  1:終了" UBYTE COMP_0283 1 100 0 1 BIT_MASK 0x0010 ECU_ADDRESS 0xFFFF3CD0 READ_WRITE /end MEASUREMENT
/begin MEASUREMENT fBATPRO "0:正常  1:電圧低下" UBYTE COMP_0283 1 100 0 1 BIT_MASK 0x0008 ECU_ADDRESS 0xFFFF3CD0 READ_WRITE /end MEASUREMENT
/begin MEASUREMENT fBCDCVZ "0:CDCV開  1:CDCV閉" UBYTE COMP_0283 1 100 0 1 BIT_MASK 0x0004 ECU_ADDRESS 0xFFFF3CD0 READ_WRITE /end MEASUREMENT
/begin MEASUREMENT fBCMMSG1A "0:受信未経験  1:受信経験" UBYTE COMP_0283 1 100 0 1 BIT_MASK 0x0002 ECU_ADDRESS 0xFFFF3CD0 READ_WRITE /end MEASUREMENT
/begin MEASUREMENT fBCMSCA "0:受信未経験  1:受信経験" UBYTE COMP_0283 1 100 0 1 BIT_MASK 0x0001 ECU_ADDRESS 0xFFFF3CD0 READ_WRITE /end MEASUREMENT
/begin MEASUREMENT fBRKGNLDA "0:受信未経験  1:受信経験" UBYTE COMP_0283 1 100 0 1 BIT_MASK 0x0080 ECU_ADDRESS 0xFFFF3CD1 READ_WRITE /end MEASUREMENT
/begin MEASUREMENT fBRKOFEX "0:ｴﾝｼﾞﾝ回転時ﾌﾞﾚｰｷOFF非経験  1:ｴﾝｼﾞﾝ回転時ﾌﾞﾚｰｷOFF経験" UBYTE COMP_0283 1 100 0 1 BIT_MASK 0x0040 ECU_ADDRESS 0xFFFF3CD1 READ_WRITE /end MEASUREMENT
/begin MEASUREMENT fBRSTBCTA "0:受信未経験  1:受信経験" UBYTE COMP_0283 1 100 0 1 BIT_MASK 0x0020 ECU_ADDRESS 0xFFFF3CD1 READ_WRITE /end MEASUREMENT
/begin MEASUREMENT fCACSW "0:OFF  1:ON" UBYTE COMP_0283 1 100 0 1 BIT_MASK 0x0010 ECU_ADDRESS 0xFFFF3CD1 READ_WRITE /end MEASUREMENT
/begin MEASUREMENT fCANADBUS "0:未完了  1:完了" UBYTE COMP_0283 1 100 0 1 BIT_MASK 0x0008 ECU_ADDRESS 0xFFFF3CD1 READ_WRITE /end MEASUREMENT
/begin MEASUREMENT fCANBUSOF "0:バスオフ未発生  1:バスオフ発生中" UBYTE COMP_0283 1 100 0 1 BIT_MASK 0x0004 ECU_ADDRESS 0xFFFF3CD1 READ_WRITE /end MEASUREMENT
/begin MEASUREMENT fCANHNG "0:CANｺﾝﾄﾛｰﾗIC初期設定OK  1:CANｺﾝﾄﾛｰﾗIC初期設定NG" UBYTE COMP_0283 1 100 0 1 BIT_MASK 0x0002 ECU_ADDRESS 0xFFFF3CD1 READ_WRITE /end MEASUREMENT
/begin MEASUREMENT fCANMNG "0:ICメモリ正常  1:ICメモリ異常" UBYTE COMP_0283 1 100 0 1 BIT_MASK 0x0001 ECU_ADDRESS 0xFFFF3CD1 READ_WRITE /end MEASUREMENT
/begin MEASUREMENT fCANREG "0:未完了  1:完了" UBYTE COMP_0283 1 100 0 1 BIT_MASK 0x0080 ECU_ADDRESS 0xFFFF3CD2 READ_WRITE /end MEASUREMENT
/begin MEASUREMENT fCANRNG "0:受信正常  1:受信異常" UBYTE COMP_0283 1 100 0 1 BIT_MASK 0x0040 ECU_ADDRESS 0xFFFF3CD2 READ_WRITE /end MEASUREMENT
/begin MEASUREMENT fCANSETV "0:未完了  1:完了" UBYTE COMP_0283 1 100 0 1 BIT_MASK 0x0020 ECU_ADDRESS 0xFFFF3CD2 READ_WRITE /end MEASUREMENT
/begin MEASUREMENT fCANTNG "0:送信正常  1:送信異常" UBYTE COMP_0283 1 100 0 1 BIT_MASK 0x0010 ECU_ADDRESS 0xFFFF3CD2 READ_WRITE /end MEASUREMENT
/begin MEASUREMENT fCCSW "0:CCSW_OFF  1:CCSW_ON" UBYTE COMP_0283 1 100 0 1 BIT_MASK 0x0008 ECU_ADDRESS 0xFFFF3CD2 READ_WRITE /end MEASUREMENT
/begin MEASUREMENT fCCSWPORT "0:CCSW_OFF  1:CCSW_ON" UBYTE COMP_0283 1 100 0 1 BIT_MASK 0x0004 ECU_ADDRESS 0xFFFF3CD2 READ_WRITE /end MEASUREMENT
/begin MEASUREMENT fCDSFST "0:初回DiagSession取得未完了  1:初回DiagSession取得終了" UBYTE COMP_0283 1 100 0 1 BIT_MASK 0x0002 ECU_ADDRESS 0xFFFF3CD2 READ_WRITE /end MEASUREMENT
/begin MEASUREMENT fCLCNTDA "0:送信未経験  1:送信経験" UBYTE COMP_0283 1 100 0 1 BIT_MASK 0x0001 ECU_ADDRESS 0xFFFF3CD2 READ_WRITE /end MEASUREMENT
/begin MEASUREMENT fCLDHTCD "0:不成立  1:条件成立" UBYTE COMP_0283 1 100 0 1 BIT_MASK 0x0080 ECU_ADDRESS 0xFFFF3CD3 READ_WRITE /end MEASUREMENT
/begin MEASUREMENT fCLSBA1A "0:受信未経験  1:受信経験" UBYTE COMP_0283 1 100 0 1 BIT_MASK 0x0040 ECU_ADDRESS 0xFFFF3CD3 READ_WRITE /end MEASUREMENT
/begin MEASUREMENT fCLSBA2A "0:受信未経験  1:受信経験" UBYTE COMP_0283 1 100 0 1 BIT_MASK 0x0020 ECU_ADDRESS 0xFFFF3CD3 READ_WRITE /end MEASUREMENT
/begin MEASUREMENT fCNJEND "0:判定未成立でない  1:判定未成立" UBYTE COMP_0283 1 100 0 1 BIT_MASK 0x0010 ECU_ADDRESS 0xFFFF3CD3 READ_WRITE /end MEASUREMENT
/begin MEASUREMENT fCOLDCND "0:不成立  1:コールド判定成立" UBYTE COMP_0283 1 100 0 1 BIT_MASK 0x0008 ECU_ADDRESS 0xFFFF3CD3 READ_WRITE /end MEASUREMENT
/begin MEASUREMENT fCOMTOUT "0:積算未終了  1:積算終了" UBYTE COMP_0283 1 100 0 1 BIT_MASK 0x0004 ECU_ADDRESS 0xFFFF3CD3 READ_WRITE /end MEASUREMENT
/begin MEASUREMENT fCRUISE2Z "0:ASCD許可後クルーズ中でない  1:ASCD許可後クルーズ中" UBYTE COMP_0283 1 100 0 1 BIT_MASK 0x0002 ECU_ADDRESS 0xFFFF3CD3 READ_WRITE /end MEASUREMENT
/begin MEASUREMENT fCRUWOSET "0:操作なし  1:操作有り" UBYTE COMP_0283 1 100 0 1 BIT_MASK 0x0001 ECU_ADDRESS 0xFFFF3CD3 READ_WRITE /end MEASUREMENT
/begin MEASUREMENT fDADIND "0:vDADIN<1V(ﾋｽ‐3V)  1:vDADIN≧4V(ﾋｽ‐3V)" UBYTE COMP_0283 1 100 0 1 BIT_MASK 0x0080 ECU_ADDRESS 0xFFFF3CD4 READ_WRITE /end MEASUREMENT
/begin MEASUREMENT fDADINDZ "0:vDADIN<1V(ﾋｽ‐3V)  1:vDADIN≧4V(ﾋｽ‐3V)" UBYTE COMP_0283 1 100 0 1 BIT_MASK 0x0040 ECU_ADDRESS 0xFFFF3CD4 READ_WRITE /end MEASUREMENT
/begin MEASUREMENT fDCVPRO "0:要求なし  1:診断終了" UBYTE COMP_0283 1 100 0 1 BIT_MASK 0x0020 ECU_ADDRESS 0xFFFF3CD4 READ_WRITE /end MEASUREMENT
/begin MEASUREMENT fDECEND "0:判定未成立でない  1:判定未成立" UBYTE COMP_0283 1 100 0 1 BIT_MASK 0x0010 ECU_ADDRESS 0xFFFF3CD4 READ_WRITE /end MEASUREMENT
/begin MEASUREMENT fDEFDEM "0:not  1:starter_fault" UBYTE COMP_0283 1 100 0 1 BIT_MASK 0x0008 ECU_ADDRESS 0xFFFF3CD4 READ_WRITE /end MEASUREMENT
/begin MEASUREMENT fDEFODGN "0:-  1:-" UBYTE COMP_0283 1 100 0 1 BIT_MASK 0x0004 ECU_ADDRESS 0xFFFF3CD4 READ_WRITE /end MEASUREMENT
/begin MEASUREMENT fDEFOST "0:-  1:-" UBYTE COMP_0283 1 100 0 1 BIT_MASK 0x0002 ECU_ADDRESS 0xFFFF3CD4 READ_WRITE /end MEASUREMENT
/begin MEASUREMENT fDELPCAN "0:不成立  1:成立" UBYTE COMP_0283 1 100 0 1 BIT_MASK 0x0001 ECU_ADDRESS 0xFFFF3CD4 READ_WRITE /end MEASUREMENT
/begin MEASUREMENT fDELTAN "0:vDELTAN初回  1:2回目以降" UBYTE COMP_0283 1 100 0 1 BIT_MASK 0x0080 ECU_ADDRESS 0xFFFF3CD5 READ_WRITE /end MEASUREMENT
/begin MEASUREMENT fDENSTCK "0:エンスト判定禁止  1:エンスト判定許可" UBYTE COMP_0283 1 100 0 1 BIT_MASK 0x0040 ECU_ADDRESS 0xFFFF3CD5 READ_WRITE /end MEASUREMENT
/begin MEASUREMENT fDENSTF "0:非エンスト  1:エンスト" UBYTE COMP_0283 1 100 0 1 BIT_MASK 0x0020 ECU_ADDRESS 0xFFFF3CD5 READ_WRITE /end MEASUREMENT
/begin MEASUREMENT fDGNAVCC "0:不成立  1:成立" UBYTE COMP_0283 1 100 0 1 BIT_MASK 0x0010 ECU_ADDRESS 0xFFFF3CD5 READ_WRITE /end MEASUREMENT
/begin MEASUREMENT fDLTN1 "0:右記以外  1:DLTN1算出2回目以降" UBYTE COMP_0283 1 100 0 1 BIT_MASK 0x0008 ECU_ADDRESS 0xFFFF3CD5 READ_WRITE /end MEASUREMENT
/begin MEASUREMENT fDLTPMINI "0:vPMANIAVのold値初回演算経験しな  1:vPMANIAVのold値初回演算経験した" UBYTE COMP_0283 1 100 0 1 BIT_MASK 0x0004 ECU_ADDRESS 0xFFFF3CD5 READ_WRITE /end MEASUREMENT
/begin MEASUREMENT fDLTTP "0:右記以外  1:DLTTP2回目以降" UBYTE COMP_0283 1 100 0 1 BIT_MASK 0x0002 ECU_ADDRESS 0xFFFF3CD5 READ_WRITE /end MEASUREMENT
/begin MEASUREMENT fDLTV100 "0:右記以外  1:DLTV1002回目以降" UBYTE COMP_0283 1 100 0 1 BIT_MASK 0x0001 ECU_ADDRESS 0xFFFF3CD5 READ_WRITE /end MEASUREMENT
/begin MEASUREMENT fDSRVSTP "0:DiagOnCan_Service停止不成立  1:DiagOnCan_Service停止成立" UBYTE COMP_0283 1 100 0 1 BIT_MASK 0x0080 ECU_ADDRESS 0xFFFF3CD6 READ_WRITE /end MEASUREMENT
/begin MEASUREMENT fDSTOP "0:禁止でない  1:禁止" UBYTE COMP_0283 1 100 0 1 BIT_MASK 0x0040 ECU_ADDRESS 0xFFFF3CD6 READ_WRITE /end MEASUREMENT
/begin MEASUREMENT fECMGSA "0:送信未経験  1:送信経験" UBYTE COMP_0283 1 100 0 1 BIT_MASK 0x0020 ECU_ADDRESS 0xFFFF3CD6 READ_WRITE /end MEASUREMENT
/begin MEASUREMENT fECMITM1A "0:受信未経験  1:受信経験" UBYTE COMP_0283 1 100 0 1 BIT_MASK 0x0010 ECU_ADDRESS 0xFFFF3CD6 READ_WRITE /end MEASUREMENT
/begin MEASUREMENT fECMSCA "0:送信未経験  1:送信経験" UBYTE COMP_0283 1 100 0 1 BIT_MASK 0x0008 ECU_ADDRESS 0xFFFF3CD6 READ_WRITE /end MEASUREMENT
/begin MEASUREMENT fECMSCA2 "0:送信未経験  1:送信経験" UBYTE COMP_0283 1 100 0 1 BIT_MASK 0x0004 ECU_ADDRESS 0xFFFF3CD6 READ_WRITE /end MEASUREMENT
/begin MEASUREMENT fECSMSG8A "0:送信未経験  1:送信経験" UBYTE COMP_0283 1 100 0 1 BIT_MASK 0x0002 ECU_ADDRESS 0xFFFF3CD6 READ_WRITE /end MEASUREMENT
/begin MEASUREMENT fECTQCT1A "0:送信未経験  1:送信経験" UBYTE COMP_0283 1 100 0 1 BIT_MASK 0x0001 ECU_ADDRESS 0xFFFF3CD6 READ_WRITE /end MEASUREMENT
/begin MEASUREMENT fECTQCT2A "0:送信未経験  1:送信経験" UBYTE COMP_0283 1 100 0 1 BIT_MASK 0x0080 ECU_ADDRESS 0xFFFF3CD7 READ_WRITE /end MEASUREMENT
/begin MEASUREMENT fECTQN1A "0:送信未経験  1:送信経験" UBYTE COMP_0283 1 100 0 1 BIT_MASK 0x0040 ECU_ADDRESS 0xFFFF3CD7 READ_WRITE /end MEASUREMENT
/begin MEASUREMENT fENABLE "0:不許可  1:許可" UBYTE COMP_0283 1 100 0 1 BIT_MASK 0x0020 ECU_ADDRESS 0xFFFF3CD7 READ_WRITE /end MEASUREMENT
/begin MEASUREMENT fENABLEZ "0:不許可  1:許可" UBYTE COMP_0283 1 100 0 1 BIT_MASK 0x0010 ECU_ADDRESS 0xFFFF3CD7 READ_WRITE /end MEASUREMENT
/begin MEASUREMENT fENBATOK "0:非許可  1:許可" UBYTE COMP_0283 1 100 0 1 BIT_MASK 0x0008 ECU_ADDRESS 0xFFFF3CD7 READ_WRITE /end MEASUREMENT
/begin MEASUREMENT fENVRMNT "0:不許可  1:許可" UBYTE COMP_0283 1 100 0 1 BIT_MASK 0x0004 ECU_ADDRESS 0xFFFF3CD7 READ_WRITE /end MEASUREMENT
/begin MEASUREMENT fEOBATPR "0:非許可  1:許可" UBYTE COMP_0283 1 100 0 1 BIT_MASK 0x0002 ECU_ADDRESS 0xFFFF3CD7 READ_WRITE /end MEASUREMENT
/begin MEASUREMENT fEONVEND "0:要求なし  1:終了要求" UBYTE COMP_0283 1 100 0 1 BIT_MASK 0x0001 ECU_ADDRESS 0xFFFF3CD7 READ_WRITE /end MEASUREMENT
/begin MEASUREMENT fEONVENDZ "0:要求なし  1:終了要求" UBYTE COMP_0283 1 100 0 1 BIT_MASK 0x0080 ECU_ADDRESS 0xFFFF3CD8 READ_WRITE /end MEASUREMENT
/begin MEASUREMENT fEONVFST "0:未実行  1:実行" UBYTE COMP_0283 1 100 0 1 BIT_MASK 0x0040 ECU_ADDRESS 0xFFFF3CD8 READ_WRITE /end MEASUREMENT
/begin MEASUREMENT fEONVJDG "0:未  1:済み" UBYTE COMP_0283 1 100 0 1 BIT_MASK 0x0020 ECU_ADDRESS 0xFFFF3CD8 READ_WRITE /end MEASUREMENT
/begin MEASUREMENT fEONVMSTS "0:非書き込み中  1:書込み開始" UBYTE COMP_0283 1 100 0 1 BIT_MASK 0x0010 ECU_ADDRESS 0xFFFF3CD8 READ_WRITE /end MEASUREMENT
/begin MEASUREMENT fEONVMWE "0:書込み未終了  1:書込み終了" UBYTE COMP_0283 1 100 0 1 BIT_MASK 0x0008 ECU_ADDRESS 0xFFFF3CD8 READ_WRITE /end MEASUREMENT
/begin MEASUREMENT fEONVMWQ "0:書き込み条件不成立  1:書き込み条件成立" UBYTE COMP_0283 1 100 0 1 BIT_MASK 0x0004 ECU_ADDRESS 0xFFFF3CD8 READ_WRITE /end MEASUREMENT
/begin MEASUREMENT fEONVSTOK "0:EONV燃温上昇条件未達成  1:EONV燃温上昇条件達成" UBYTE COMP_0283 1 100 0 1 BIT_MASK 0x0002 ECU_ADDRESS 0xFFFF3CD8 READ_WRITE /end MEASUREMENT
/begin MEASUREMENT fEPDTCW1 "0:PDTCST[0]～[4]の  Store_command  1:PDTCST[0]～[4]の  Store_command" UBYTE COMP_0283 1 100 0 1 BIT_MASK 0x0001 ECU_ADDRESS 0xFFFF3CD8 READ_WRITE /end MEASUREMENT
/begin MEASUREMENT fEPDTCW2 "0:PDTC_EEPROM_＝_ﾃﾝﾎﾟﾗﾘRAM  1:PDTC_EEPROM_≠_ﾃﾝﾎﾟﾗﾘRAM" UBYTE COMP_0283 1 100 0 1 BIT_MASK 0x0080 ECU_ADDRESS 0xFFFF3CD9 READ_WRITE /end MEASUREMENT
/begin MEASUREMENT fEPDTCW3 "0:EPDTCFLG_＝_0x5555  1:EPDTCFLG_≠_0x5555" UBYTE COMP_0283 1 100 0 1 BIT_MASK 0x0040 ECU_ADDRESS 0xFFFF3CD9 READ_WRITE /end MEASUREMENT
/begin MEASUREMENT fEPDTCWRT "0:それ以外  1:書込み終了" UBYTE COMP_0283 1 100 0 1 BIT_MASK 0x0020 ECU_ADDRESS 0xFFFF3CD9 READ_WRITE /end MEASUREMENT
/begin MEASUREMENT fEPSGS2A "0:受信未経験  1:受信経験" UBYTE COMP_0283 1 100 0 1 BIT_MASK 0x0010 ECU_ADDRESS 0xFFFF3CD9 READ_WRITE /end MEASUREMENT
/begin MEASUREMENT fEPTMED "0:右記以外  1:ﾀｲﾏ書き込み終了" UBYTE COMP_0283 1 100 0 1 BIT_MASK 0x0008 ECU_ADDRESS 0xFFFF3CD9 READ_WRITE /end MEASUREMENT
/begin MEASUREMENT fESPCLKNG "0:OK  1:NG" UBYTE COMP_0283 1 100 0 1 BIT_MASK 0x0004 ECU_ADDRESS 0xFFFF3CD9 READ_WRITE /end MEASUREMENT
/begin MEASUREMENT fETCVHI "0:VBAVE2>mETCVHI(ﾋｽ-mETCVHYS)  1:VBAVE2≦mETCVHI(ﾋｽ-mETCVHYS)" UBYTE COMP_0283 1 100 0 1 BIT_MASK 0x0002 ECU_ADDRESS 0xFFFF3CD9 READ_WRITE /end MEASUREMENT
/begin MEASUREMENT fETCVLO "0:VBAVE2>mETCVLO(ﾋｽ-mETCVHYS)  1:VBAVE2≦mETCVLO(ﾋｽ-mETCVHYS)" UBYTE COMP_0283 1 100 0 1 BIT_MASK 0x0001 ECU_ADDRESS 0xFFFF3CD9 READ_WRITE /end MEASUREMENT
/begin MEASUREMENT fETSTQCTA "0:受信未経験  1:受信経験" UBYTE COMP_0283 1 100 0 1 BIT_MASK 0x0080 ECU_ADDRESS 0xFFFF3CDA READ_WRITE /end MEASUREMENT
/begin MEASUREMENT fEVPGNRT "0:圧力急上昇でない  1:圧力急上昇の為不許可" UBYTE COMP_0283 1 100 0 1 BIT_MASK 0x0040 ECU_ADDRESS 0xFFFF3CDA READ_WRITE /end MEASUREMENT
/begin MEASUREMENT fEVSPSTS "0:非書込み中  1:書込み開始" UBYTE COMP_0283 1 100 0 1 BIT_MASK 0x0020 ECU_ADDRESS 0xFFFF3CDA READ_WRITE /end MEASUREMENT
/begin MEASUREMENT fEVSPWE "0:書込み未終了  1:書込み終了" UBYTE COMP_0283 1 100 0 1 BIT_MASK 0x0010 ECU_ADDRESS 0xFFFF3CDA READ_WRITE /end MEASUREMENT
/begin MEASUREMENT fEVSPWQ "0:書込み条件不成立  1:書込み条件成立" UBYTE COMP_0283 1 100 0 1 BIT_MASK 0x0008 ECU_ADDRESS 0xFFFF3CDA READ_WRITE /end MEASUREMENT
/begin MEASUREMENT fFACRING "0:正常  1:故障" UBYTE COMP_0283 1 100 0 1 BIT_MASK 0x0004 ECU_ADDRESS 0xFFFF3CDA READ_WRITE /end MEASUREMENT
/begin MEASUREMENT fFAPOINCH "0:不許可  1:許可" UBYTE COMP_0283 1 100 0 1 BIT_MASK 0x0002 ECU_ADDRESS 0xFFFF3CDA READ_WRITE /end MEASUREMENT
/begin MEASUREMENT fFAPSNG "0:正常  1:故障" UBYTE COMP_0283 1 100 0 1 BIT_MASK 0x0001 ECU_ADDRESS 0xFFFF3CDA READ_WRITE /end MEASUREMENT
/begin MEASUREMENT fFATRING "0:正常  1:故障" UBYTE COMP_0283 1 100 0 1 BIT_MASK 0x0080 ECU_ADDRESS 0xFFFF3CDB READ_WRITE /end MEASUREMENT
/begin MEASUREMENT fFBCRING "0:正常  1:故障" UBYTE COMP_0283 1 100 0 1 BIT_MASK 0x0040 ECU_ADDRESS 0xFFFF3CDB READ_WRITE /end MEASUREMENT
/begin MEASUREMENT fFCANFNG "0:正常  1:故障" UBYTE COMP_0283 1 100 0 1 BIT_MASK 0x0020 ECU_ADDRESS 0xFFFF3CDB READ_WRITE /end MEASUREMENT
/begin MEASUREMENT fFCANNG "0:正常  1:故障" UBYTE COMP_0283 1 100 0 1 BIT_MASK 0x0010 ECU_ADDRESS 0xFFFF3CDB READ_WRITE /end MEASUREMENT
/begin MEASUREMENT fFCANNGNE "0:正常  1:故障" UBYTE COMP_0283 1 100 0 1 BIT_MASK 0x0008 ECU_ADDRESS 0xFFFF3CDB READ_WRITE /end MEASUREMENT
/begin MEASUREMENT fFCLOS "0:燃料制御状態CLOSE移行した  1:燃料制御状態CLOSE移行せず" UBYTE COMP_0283 1 100 0 1 BIT_MASK 0x0004 ECU_ADDRESS 0xFFFF3CDB READ_WRITE /end MEASUREMENT
/begin MEASUREMENT fFCOPEN "0:未  1:判定" UBYTE COMP_0283 1 100 0 1 BIT_MASK 0x0002 ECU_ADDRESS 0xFFFF3CDB READ_WRITE /end MEASUREMENT
/begin MEASUREMENT fFDGNCLR "0:APPﾃﾞｰﾀｸﾘｱ非要求  1:APPﾃﾞｰﾀｸﾘｱ要求" UBYTE COMP_0283 1 100 0 1 BIT_MASK 0x0001 ECU_ADDRESS 0xFFFF3CDB READ_WRITE /end MEASUREMENT
/begin MEASUREMENT fFFDDNEW "0:DDLOCIDセットされていない  1:DDLOCIDセット" UBYTE COMP_0283 1 100 0 1 BIT_MASK 0x0080 ECU_ADDRESS 0xFFFF3CDC READ_WRITE /end MEASUREMENT
/begin MEASUREMENT fFGCHG "0:燃料ﾚﾍﾞﾙｹﾞｰｼﾞ初期化またはﾎｰﾙﾄﾞ状  1:燃料ﾚﾍﾞﾙｹﾞｰｼﾞ更新状態" UBYTE COMP_0283 1 100 0 1 BIT_MASK 0x0040 ECU_ADDRESS 0xFFFF3CDC READ_WRITE /end MEASUREMENT
/begin MEASUREMENT fFGCHG2 "0:燃料ﾚﾍﾞﾙｹﾞｰｼﾞ初期化またはﾎｰﾙﾄﾞ状  1:燃料ﾚﾍﾞﾙｹﾞｰｼﾞ更新状態" UBYTE COMP_0283 1 100 0 1 BIT_MASK 0x0020 ECU_ADDRESS 0xFFFF3CDC READ_WRITE /end MEASUREMENT
/begin MEASUREMENT fFHLCVT "0:fHLCVTFD=0の時  1:fHLCVTFD=1の時" UBYTE COMP_0283 1 100 0 1 BIT_MASK 0x0010 ECU_ADDRESS 0xFFFF3CDC READ_WRITE /end MEASUREMENT
/begin MEASUREMENT fFHPEDC "0:禁止  1:許可" UBYTE COMP_0283 1 100 0 1 BIT_MASK 0x0008 ECU_ADDRESS 0xFFFF3CDC READ_WRITE /end MEASUREMENT
/begin MEASUREMENT fFINJCMD1 "0:normal  1:fast" UBYTE COMP_0283 1 100 0 1 BIT_MASK 0x0004 ECU_ADDRESS 0xFFFF3CDC READ_WRITE /end MEASUREMENT
/begin MEASUREMENT fFINJCMD2 "0:normal  1:fast" UBYTE COMP_0283 1 100 0 1 BIT_MASK 0x0002 ECU_ADDRESS 0xFFFF3CDC READ_WRITE /end MEASUREMENT
/begin MEASUREMENT fFINJVC "0:高圧INJ駆動電流可変制御中でない  1:高圧INJ駆動電流可変制御中" UBYTE COMP_0283 1 100 0 1 BIT_MASK 0x0001 ECU_ADDRESS 0xFFFF3CDC READ_WRITE /end MEASUREMENT
/begin MEASUREMENT fFINJVCZ "0:前回高圧INJ駆動電流可変制御中で  1:前回高圧INJ駆動電流可変制御中" UBYTE COMP_0283 1 100 0 1 BIT_MASK 0x0080 ECU_ADDRESS 0xFFFF3CDD READ_WRITE /end MEASUREMENT
/begin MEASUREMENT fFISCV "0:ISCV<4.48v  1:ISCV≧4.48v" UBYTE COMP_0283 1 100 0 1 BIT_MASK 0x0040 ECU_ADDRESS 0xFFFF3CDD READ_WRITE /end MEASUREMENT
/begin MEASUREMENT fFLMLR "0:左ﾊﾞﾝｸ  1:右ﾊﾞﾝｸ" UBYTE COMP_0283 1 100 0 1 BIT_MASK 0x0020 ECU_ADDRESS 0xFFFF3CDD READ_WRITE /end MEASUREMENT
/begin MEASUREMENT fFMLSCR "0:自己診断消去要求無し  1:自己診断消去要求有り" UBYTE COMP_0283 1 100 0 1 BIT_MASK 0x0010 ECU_ADDRESS 0xFFFF3CDD READ_WRITE /end MEASUREMENT
/begin MEASUREMENT fFMREND "0:燃料ｼｽﾃﾑ診断未了  1:燃料ｼｽﾃﾑ診断終了" UBYTE COMP_0283 1 100 0 1 BIT_MASK 0x0008 ECU_ADDRESS 0xFFFF3CDD READ_WRITE /end MEASUREMENT
/begin MEASUREMENT fFMRJGD "0:診断領域条件不成立  1:診断領域条件成立" UBYTE COMP_0283 1 100 0 1 BIT_MASK 0x0004 ECU_ADDRESS 0xFFFF3CDD READ_WRITE /end MEASUREMENT
/begin MEASUREMENT fFNIDLTWH "0:0  1:1" UBYTE COMP_0283 1 100 0 1 BIT_MASK 0x0002 ECU_ADDRESS 0xFFFF3CDD READ_WRITE /end MEASUREMENT
/begin MEASUREMENT fFNIDLTWL "0:0  1:1" UBYTE COMP_0283 1 100 0 1 BIT_MASK 0x0001 ECU_ADDRESS 0xFFFF3CDD READ_WRITE /end MEASUREMENT
/begin MEASUREMENT fFNOBST "0:ピーク有り  1:ピーク無し" UBYTE COMP_0283 1 100 0 1 BIT_MASK 0x0080 ECU_ADDRESS 0xFFFF3CDE READ_WRITE /end MEASUREMENT
/begin MEASUREMENT fFNVPM "0:未  1:成立" UBYTE COMP_0283 1 100 0 1 BIT_MASK 0x0040 ECU_ADDRESS 0xFFFF3CDE READ_WRITE /end MEASUREMENT
/begin MEASUREMENT fFO2CNG "0:ﾊﾞﾝｸ切り替え識別表示要求無し  1:ﾊﾞﾝｸ切り替え識別表示要求有り" UBYTE COMP_0283 1 100 0 1 BIT_MASK 0x0020 ECU_ADDRESS 0xFFFF3CDE READ_WRITE /end MEASUREMENT
/begin MEASUREMENT fFQ0LIMHI "0:不成立  1:成立" UBYTE COMP_0283 1 100 0 1 BIT_MASK 0x0010 ECU_ADDRESS 0xFFFF3CDE READ_WRITE /end MEASUREMENT
/begin MEASUREMENT fFQ0LIMLO "0:不成立  1:成立" UBYTE COMP_0283 1 100 0 1 BIT_MASK 0x0008 ECU_ADDRESS 0xFFFF3CDE READ_WRITE /end MEASUREMENT
/begin MEASUREMENT fFRW "0:EEPROMライト  1:EEPROMリード" UBYTE COMP_0283 1 100 0 1 BIT_MASK 0x0004 ECU_ADDRESS 0xFFFF3CDE READ_WRITE /end MEASUREMENT
/begin MEASUREMENT fFSTFGN "0:FGN演算初回  1:2回目以降" UBYTE COMP_0283 1 100 0 1 BIT_MASK 0x0002 ECU_ADDRESS 0xFFFF3CDE READ_WRITE /end MEASUREMENT
/begin MEASUREMENT fFTANOK0 "0:未成立  1:成立" UBYTE COMP_0283 1 100 0 1 BIT_MASK 0x0001 ECU_ADDRESS 0xFFFF3CDE READ_WRITE /end MEASUREMENT
/begin MEASUREMENT fFTRIS "0:燃温急上昇でない  1:燃温急上昇の為不許可" UBYTE COMP_0283 1 100 0 1 BIT_MASK 0x0080 ECU_ADDRESS 0xFFFF3CDF READ_WRITE /end MEASUREMENT
/begin MEASUREMENT fFVDRING "0:正常  1:故障" UBYTE COMP_0283 1 100 0 1 BIT_MASK 0x0040 ECU_ADDRESS 0xFFFF3CDF READ_WRITE /end MEASUREMENT
/begin MEASUREMENT fGMREND "0:未更新  1:更新済" UBYTE COMP_0283 1 100 0 1 BIT_MASK 0x0020 ECU_ADDRESS 0xFFFF3CDF READ_WRITE /end MEASUREMENT
/begin MEASUREMENT fGSE1ST "0:未経験  1:経験済み" UBYTE COMP_0283 1 100 0 1 BIT_MASK 0x0010 ECU_ADDRESS 0xFFFF3CDF READ_WRITE /end MEASUREMENT
/begin MEASUREMENT fHETCOND "0:不成立  1:条件成立" UBYTE COMP_0283 1 100 0 1 BIT_MASK 0x0008 ECU_ADDRESS 0xFFFF3CDF READ_WRITE /end MEASUREMENT
/begin MEASUREMENT fHLCVTFD "0:DUMADDFD<mHLCVTFD(ヒス-mHLCVTHYS  1:DUMADDFD≧mHLCVTFD(ヒス-mHLCVTHY" UBYTE COMP_0283 1 100 0 1 BIT_MASK 0x0004 ECU_ADDRESS 0xFFFF3CDF READ_WRITE /end MEASUREMENT
/begin MEASUREMENT fHOTRHTCD "0:不成立  1:条件成立" UBYTE COMP_0283 1 100 0 1 BIT_MASK 0x0002 ECU_ADDRESS 0xFFFF3CDF READ_WRITE /end MEASUREMENT
/begin MEASUREMENT fHPCHRQ "0:ポンプ波形変更要求無し  1:ポンプ波形変更要求有り" UBYTE COMP_0283 1 100 0 1 BIT_MASK 0x0001 ECU_ADDRESS 0xFFFF3CDF READ_WRITE /end MEASUREMENT
/begin MEASUREMENT fHYSICT "0:Max(ICTMPN1、ICTMPN2)<ICTMPNH#  1:Max(ICTMPN1、ICTMPN2)≧ICTMPNH#" UBYTE COMP_0283 1 100 0 1 BIT_MASK 0x0080 ECU_ADDRESS 0xFFFF3CE0 READ_WRITE /end MEASUREMENT
/begin MEASUREMENT fICMAVF "0:初回  1:2回以降" UBYTE COMP_0283 1 100 0 1 BIT_MASK 0x0040 ECU_ADDRESS 0xFFFF3CE0 READ_WRITE /end MEASUREMENT
/begin MEASUREMENT fICT1EX "0:正常  1:異常" UBYTE COMP_0283 1 100 0 1 BIT_MASK 0x0020 ECU_ADDRESS 0xFFFF3CE0 READ_WRITE /end MEASUREMENT
/begin MEASUREMENT fICT2EX "0:正常  1:異常" UBYTE COMP_0283 1 100 0 1 BIT_MASK 0x0010 ECU_ADDRESS 0xFFFF3CE0 READ_WRITE /end MEASUREMENT
/begin MEASUREMENT fIDLEASCD "0:ASCD指令値IDLE非判定中  1:ASCD指令値IDLE判定中" UBYTE COMP_0283 1 100 0 1 BIT_MASK 0x0008 ECU_ADDRESS 0xFFFF3CE0 READ_WRITE /end MEASUREMENT
/begin MEASUREMENT fIDLEKC "0:ソフトアイドルスイッチON  1:ソフトアイドルスイッチOFF" UBYTE COMP_0283 1 100 0 1 BIT_MASK 0x0004 ECU_ADDRESS 0xFFFF3CE0 READ_WRITE /end MEASUREMENT
/begin MEASUREMENT fIDLEVAPO "0:右記以外  1:VAPO_IDLE判定中" UBYTE COMP_0283 1 100 0 1 BIT_MASK 0x0002 ECU_ADDRESS 0xFFFF3CE0 READ_WRITE /end MEASUREMENT
/begin MEASUREMENT fIDONCHPR "0:ｿﾌﾄｱｲﾄﾞﾙｽｲｯﾁOFF  1:ｿﾌﾄｱｲﾄﾞﾙｽｲｯﾁON" UBYTE COMP_0283 1 100 0 1 BIT_MASK 0x0001 ECU_ADDRESS 0xFFFF3CE0 READ_WRITE /end MEASUREMENT
/begin MEASUREMENT fIGNSWSEN "0:IGNSW_OFF  1:IGNSW_初回ON" UBYTE COMP_0283 1 100 0 1 BIT_MASK 0x0080 ECU_ADDRESS 0xFFFF3CE1 READ_WRITE /end MEASUREMENT
/begin MEASUREMENT fIGNSWZ "0:IGSW_OFF(100ms_JOB用前回値)  1:IGSW_ON(100ms_JOB用前回値)" UBYTE COMP_0283 1 100 0 1 BIT_MASK 0x0040 ECU_ADDRESS 0xFFFF3CE1 READ_WRITE /end MEASUREMENT
/begin MEASUREMENT fIMM1ST "0:右記以外  1:判定済み" UBYTE COMP_0283 1 100 0 1 BIT_MASK 0x0020 ECU_ADDRESS 0xFFFF3CE1 READ_WRITE /end MEASUREMENT
/begin MEASUREMENT fIMMINIT "0:未要求  1:要求" UBYTE COMP_0283 1 100 0 1 BIT_MASK 0x0010 ECU_ADDRESS 0xFFFF3CE1 READ_WRITE /end MEASUREMENT
/begin MEASUREMENT fIMMINITE "0:失敗  1:成功" UBYTE COMP_0283 1 100 0 1 BIT_MASK 0x0008 ECU_ADDRESS 0xFFFF3CE1 READ_WRITE /end MEASUREMENT
/begin MEASUREMENT fIMMINITF "0:初回以外  1:初回" UBYTE COMP_0283 1 100 0 1 BIT_MASK 0x0004 ECU_ADDRESS 0xFFFF3CE1 READ_WRITE /end MEASUREMENT
/begin MEASUREMENT fIMMINTOK "0:失敗  1:成功" UBYTE COMP_0283 1 100 0 1 BIT_MASK 0x0002 ECU_ADDRESS 0xFFFF3CE1 READ_WRITE /end MEASUREMENT
/begin MEASUREMENT fIMMJUG "0:非判定中  1:判定中" UBYTE COMP_0283 1 100 0 1 BIT_MASK 0x0001 ECU_ADDRESS 0xFFFF3CE1 READ_WRITE /end MEASUREMENT
/begin MEASUREMENT fIMMJUG2 "0:非判定中  1:判定中" UBYTE COMP_0283 1 100 0 1 BIT_MASK 0x0080 ECU_ADDRESS 0xFFFF3CE2 READ_WRITE /end MEASUREMENT
/begin MEASUREMENT fIMMMDOK "0:不許可  1:許可" UBYTE COMP_0283 1 100 0 1 BIT_MASK 0x0040 ECU_ADDRESS 0xFFFF3CE2 READ_WRITE /end MEASUREMENT
/begin MEASUREMENT fIMMMDOK2 "0:不許可  1:許可" UBYTE COMP_0283 1 100 0 1 BIT_MASK 0x0020 ECU_ADDRESS 0xFFFF3CE2 READ_WRITE /end MEASUREMENT
/begin MEASUREMENT fIMMRXNG "0:OK  1:NG" UBYTE COMP_0283 1 100 0 1 BIT_MASK 0x0010 ECU_ADDRESS 0xFFFF3CE2 READ_WRITE /end MEASUREMENT
/begin MEASUREMENT fIMMRXRQ "0:無し  1:有り" UBYTE COMP_0283 1 100 0 1 BIT_MASK 0x0008 ECU_ADDRESS 0xFFFF3CE2 READ_WRITE /end MEASUREMENT
/begin MEASUREMENT fIMMTXRQ "0:無し  1:有り" UBYTE COMP_0283 1 100 0 1 BIT_MASK 0x0004 ECU_ADDRESS 0xFFFF3CE2 READ_WRITE /end MEASUREMENT
/begin MEASUREMENT fIMMTXWT "0:未送信  1:送信" UBYTE COMP_0283 1 100 0 1 BIT_MASK 0x0002 ECU_ADDRESS 0xFFFF3CE2 READ_WRITE /end MEASUREMENT
/begin MEASUREMENT fINHCT20 "0:右記以外  1:継続後" UBYTE COMP_0283 1 100 0 1 BIT_MASK 0x0001 ECU_ADDRESS 0xFFFF3CE2 READ_WRITE /end MEASUREMENT
/begin MEASUREMENT fINJCHFS "0:DUFLBのFLGFS=0  1:DUFLBのFLGFS=1" UBYTE COMP_0283 1 100 0 1 BIT_MASK 0x0080 ECU_ADDRESS 0xFFFF3CE3 READ_WRITE /end MEASUREMENT
/begin MEASUREMENT fINJCHRQ "0:インジェクタ波形変更要求無し  1:インジェクタ波形変更要求有り" UBYTE COMP_0283 1 100 0 1 BIT_MASK 0x0040 ECU_ADDRESS 0xFFFF3CE3 READ_WRITE /end MEASUREMENT
/begin MEASUREMENT fINJPFDE "0:右記以外  1:vPFUELH_>_mINJPFDE(ヒス:-_mINJPF" UBYTE COMP_0283 1 100 0 1 BIT_MASK 0x0020 ECU_ADDRESS 0xFFFF3CE3 READ_WRITE /end MEASUREMENT
/begin MEASUREMENT fINTDATA "0:不可  1:可" UBYTE COMP_0283 1 100 0 1 BIT_MASK 0x0010 ECU_ADDRESS 0xFFFF3CE3 READ_WRITE /end MEASUREMENT
/begin MEASUREMENT fIOCLSTP "0:経験無し  1:経験有り" UBYTE COMP_0283 1 100 0 1 BIT_MASK 0x0008 ECU_ADDRESS 0xFFFF3CE3 READ_WRITE /end MEASUREMENT
/begin MEASUREMENT fJKSRCOK "0:回転数制御非実行  1:回転数制御実行" UBYTE COMP_0283 1 100 0 1 BIT_MASK 0x0004 ECU_ADDRESS 0xFFFF3CE3 READ_WRITE /end MEASUREMENT
/begin MEASUREMENT fKNRPMQST "0:経験済み  1:未経験" UBYTE COMP_0283 1 100 0 1 BIT_MASK 0x0002 ECU_ADDRESS 0xFFFF3CE3 READ_WRITE /end MEASUREMENT
/begin MEASUREMENT fKNRZERO "0:ソフトスタータOFF条件(6)不成立  1:ソフトスタータOFF条件(6)成立" UBYTE COMP_0283 1 100 0 1 BIT_MASK 0x0001 ECU_ADDRESS 0xFFFF3CE3 READ_WRITE /end MEASUREMENT
/begin MEASUREMENT fLINFAIL "0:No_failure  1:Detected_failure" UBYTE COMP_0283 1 100 0 1 BIT_MASK 0x0080 ECU_ADDRESS 0xFFFF3CE4 READ_WRITE /end MEASUREMENT
/begin MEASUREMENT fLINFIRST "0:始動後LIN送信開始後  1:始動後LIN送信開始前" UBYTE COMP_0283 1 100 0 1 BIT_MASK 0x0040 ECU_ADDRESS 0xFFFF3CE4 READ_WRITE /end MEASUREMENT
/begin MEASUREMENT fLRNCLNG "0:正常  1:NG" UBYTE COMP_0283 1 100 0 1 BIT_MASK 0x0020 ECU_ADDRESS 0xFFFF3CE4 READ_WRITE /end MEASUREMENT
/begin MEASUREMENT fLRNST "0:学習許可  1:学習禁止" UBYTE COMP_0283 1 100 0 1 BIT_MASK 0x0010 ECU_ADDRESS 0xFFFF3CE4 READ_WRITE /end MEASUREMENT
/begin MEASUREMENT fMCLPCNTL "0:MIL消灯(b)条件成立継続(LEAN用)未  1:MIL消灯(b)条件成立継続(LEAN用)確" UBYTE COMP_0283 1 100 0 1 BIT_MASK 0x0008 ECU_ADDRESS 0xFFFF3CE4 READ_WRITE /end MEASUREMENT
/begin MEASUREMENT fMCLPCNTR "0:MIL消灯(b)条件成立継続(RICH用)未  1:MIL消灯(b)条件成立継続(RICH用)確" UBYTE COMP_0283 1 100 0 1 BIT_MASK 0x0004 ECU_ADDRESS 0xFFFF3CE4 READ_WRITE /end MEASUREMENT
/begin MEASUREMENT fMECAST1 "0:-  1:-" UBYTE COMP_0283 1 100 0 1 BIT_MASK 0x0002 ECU_ADDRESS 0xFFFF3CE4 READ_WRITE /end MEASUREMENT
/begin MEASUREMENT fMECHAED1 "0:-  1:-" UBYTE COMP_0283 1 100 0 1 BIT_MASK 0x0001 ECU_ADDRESS 0xFFFF3CE4 READ_WRITE /end MEASUREMENT
/begin MEASUREMENT fMECHAED2 "0:-  1:-" UBYTE COMP_0283 1 100 0 1 BIT_MASK 0x0080 ECU_ADDRESS 0xFFFF3CE5 READ_WRITE /end MEASUREMENT
/begin MEASUREMENT fMECHAED3 "0:-  1:-" UBYTE COMP_0283 1 100 0 1 BIT_MASK 0x0040 ECU_ADDRESS 0xFFFF3CE5 READ_WRITE /end MEASUREMENT
/begin MEASUREMENT fMECHAED4 "0:-  1:-" UBYTE COMP_0283 1 100 0 1 BIT_MASK 0x0020 ECU_ADDRESS 0xFFFF3CE5 READ_WRITE /end MEASUREMENT
/begin MEASUREMENT fMECHAEND "0:-  1:-" UBYTE COMP_0283 1 100 0 1 BIT_MASK 0x0010 ECU_ADDRESS 0xFFFF3CE5 READ_WRITE /end MEASUREMENT
/begin MEASUREMENT fMISJDPR "0:禁止でない  1:禁止" UBYTE COMP_0283 1 100 0 1 BIT_MASK 0x0008 ECU_ADDRESS 0xFFFF3CE5 READ_WRITE /end MEASUREMENT
/begin MEASUREMENT fMSRINREG "0:MSR電圧変動範囲外  1:MSR電圧変動範囲内" UBYTE COMP_0283 1 100 0 1 BIT_MASK 0x0004 ECU_ADDRESS 0xFFFF3CE5 READ_WRITE /end MEASUREMENT
/begin MEASUREMENT fMXTMEO "0:未  1:成立" UBYTE COMP_0283 1 100 0 1 BIT_MASK 0x0002 ECU_ADDRESS 0xFFFF3CE5 READ_WRITE /end MEASUREMENT
/begin MEASUREMENT fNGCOMPCK "0:未  1:要求" UBYTE COMP_0283 1 100 0 1 BIT_MASK 0x0001 ECU_ADDRESS 0xFFFF3CE5 READ_WRITE /end MEASUREMENT
/begin MEASUREMENT fNGEOMILE "0:禁止でない  1:禁止" UBYTE COMP_0283 1 100 0 1 BIT_MASK 0x0080 ECU_ADDRESS 0xFFFF3CE6 READ_WRITE /end MEASUREMENT
/begin MEASUREMENT fNGREF "0:NG未発見  1:NG発見" UBYTE COMP_0283 1 100 0 1 BIT_MASK 0x0040 ECU_ADDRESS 0xFFFF3CE6 READ_WRITE /end MEASUREMENT
/begin MEASUREMENT fNIDLEOK "0:Nｱｲﾄﾞﾙ許可ではない  1:Nｱｲﾄﾞﾙ許可" UBYTE COMP_0283 1 100 0 1 BIT_MASK 0x0020 ECU_ADDRESS 0xFFFF3CE6 READ_WRITE /end MEASUREMENT
/begin MEASUREMENT fPMANINI "0:vPMANIAVの初回演算経験しない  1:vPMANIAVの初回演算経験した" UBYTE COMP_0283 1 100 0 1 BIT_MASK 0x0010 ECU_ADDRESS 0xFFFF3CE6 READ_WRITE /end MEASUREMENT
/begin MEASUREMENT fPSNDN "0:正常  1:異常" UBYTE COMP_0283 1 100 0 1 BIT_MASK 0x0008 ECU_ADDRESS 0xFFFF3CE6 READ_WRITE /end MEASUREMENT
/begin MEASUREMENT fQ0_LLIM "0:不成立  1:成立" UBYTE COMP_0283 1 100 0 1 BIT_MASK 0x0004 ECU_ADDRESS 0xFFFF3CE6 READ_WRITE /end MEASUREMENT
/begin MEASUREMENT fQ0_LLIML "0:不成立  1:成立" UBYTE COMP_0283 1 100 0 1 BIT_MASK 0x0002 ECU_ADDRESS 0xFFFF3CE6 READ_WRITE /end MEASUREMENT
/begin MEASUREMENT fQTHLNOK "0:TS学習不許可  1:TS学習許可" UBYTE COMP_0283 1 100 0 1 BIT_MASK 0x0001 ECU_ADDRESS 0xFFFF3CE6 READ_WRITE /end MEASUREMENT
/begin MEASUREMENT fRECVIN "0:未受信  1:VIN受信有り" UBYTE COMP_0283 1 100 0 1 BIT_MASK 0x0080 ECU_ADDRESS 0xFFFF3CE7 READ_WRITE /end MEASUREMENT
/begin MEASUREMENT fRESPAKAN "0:非成立  1:成立" UBYTE COMP_0283 1 100 0 1 BIT_MASK 0x0040 ECU_ADDRESS 0xFFFF3CE7 READ_WRITE /end MEASUREMENT
/begin MEASUREMENT fRESTCHON "0:非成立  1:成立" UBYTE COMP_0283 1 100 0 1 BIT_MASK 0x0020 ECU_ADDRESS 0xFFFF3CE7 READ_WRITE /end MEASUREMENT
/begin MEASUREMENT fRESTENST "0:非成立  1:成立" UBYTE COMP_0283 1 100 0 1 BIT_MASK 0x0010 ECU_ADDRESS 0xFFFF3CE7 READ_WRITE /end MEASUREMENT
/begin MEASUREMENT fRFLJDG "0:禁止でない  1:禁止" UBYTE COMP_0283 1 100 0 1 BIT_MASK 0x0008 ECU_ADDRESS 0xFFFF3CE7 READ_WRITE /end MEASUREMENT
/begin MEASUREMENT fRFUEL "0:未  1:判定" UBYTE COMP_0283 1 100 0 1 BIT_MASK 0x0004 ECU_ADDRESS 0xFFFF3CE7 READ_WRITE /end MEASUREMENT
/begin MEASUREMENT fRLJUGE4 "0:SWMONT[1]のbit5=0  1:SWMONT[1]のbit5=1" UBYTE COMP_0283 1 100 0 1 BIT_MASK 0x0002 ECU_ADDRESS 0xFFFF3CE7 READ_WRITE /end MEASUREMENT
/begin MEASUREMENT fRLJUGE5 "0:SWMONT[1]のbit5=0  1:SWMONT[1]のbit5=1" UBYTE COMP_0283 1 100 0 1 BIT_MASK 0x0001 ECU_ADDRESS 0xFFFF3CE7 READ_WRITE /end MEASUREMENT
/begin MEASUREMENT fRLYCKEND "0:診断未終了  1:診断終了" UBYTE COMP_0283 1 100 0 1 BIT_MASK 0x0080 ECU_ADDRESS 0xFFFF3CE8 READ_WRITE /end MEASUREMENT
/begin MEASUREMENT fRLYOFFRQ "0:ＯＦＦ要求有り  1:ＯＦＦ要求無し" UBYTE COMP_0283 1 100 0 1 BIT_MASK 0x0040 ECU_ADDRESS 0xFFFF3CE8 READ_WRITE /end MEASUREMENT
/begin MEASUREMENT fRQ3RDACC "0:ACCMSG1のDT0のbit2が0  1:ACCMSG1のDT0のbit2が1" UBYTE COMP_0283 1 100 0 1 BIT_MASK 0x0020 ECU_ADDRESS 0xFFFF3CE8 READ_WRITE /end MEASUREMENT
/begin MEASUREMENT fRQ3RDASC "0:要求無し  1:要求有り" UBYTE COMP_0283 1 100 0 1 BIT_MASK 0x0010 ECU_ADDRESS 0xFFFF3CE8 READ_WRITE /end MEASUREMENT
/begin MEASUREMENT fRQECOMOD "0:要求無し  1:要求有り" UBYTE COMP_0283 1 100 0 1 BIT_MASK 0x0008 ECU_ADDRESS 0xFFFF3CE8 READ_WRITE /end MEASUREMENT
/begin MEASUREMENT fRQNAVSFT "0:要求無し  1:要求有り" UBYTE COMP_0283 1 100 0 1 BIT_MASK 0x0004 ECU_ADDRESS 0xFFFF3CE8 READ_WRITE /end MEASUREMENT
/begin MEASUREMENT fRSTBKUP "0:スタータモータ駆動制御パラメータ  1:スタータモータ駆動制御パラメータ" UBYTE COMP_0283 1 100 0 1 BIT_MASK 0x0002 ECU_ADDRESS 0xFFFF3CE8 READ_WRITE /end MEASUREMENT
/begin MEASUREMENT fRSTREQEX "0:未経験  1:経験" UBYTE COMP_0283 1 100 0 1 BIT_MASK 0x0001 ECU_ADDRESS 0xFFFF3CE8 READ_WRITE /end MEASUREMENT
/begin MEASUREMENT fRSTREQZ "0:ｽﾀｰﾀﾓｰﾀ駆動要求しない  1:ｽﾀｰﾀﾓｰﾀ駆動要求する" UBYTE COMP_0283 1 100 0 1 BIT_MASK 0x0080 ECU_ADDRESS 0xFFFF3CE9 READ_WRITE /end MEASUREMENT
/begin MEASUREMENT fRTSPRGST "0:-  1:-" UBYTE COMP_0283 1 100 0 1 BIT_MASK 0x0040 ECU_ADDRESS 0xFFFF3CE9 READ_WRITE /end MEASUREMENT
/begin MEASUREMENT fRXBPFSNC "0:ﾌﾞﾚｰｷﾍﾟﾀﾞﾙON  1:ﾌﾞﾚｰｷﾍﾟﾀﾞﾙOFF" UBYTE COMP_0283 1 100 0 1 BIT_MASK 0x0020 ECU_ADDRESS 0xFFFF3CE9 READ_WRITE /end MEASUREMENT
/begin MEASUREMENT fRXBPFSNO "0:ﾌﾞﾚｰｷﾍﾟﾀﾞﾙOFF  1:ﾌﾞﾚｰｷﾍﾟﾀﾞﾙON" UBYTE COMP_0283 1 100 0 1 BIT_MASK 0x0010 ECU_ADDRESS 0xFFFF3CE9 READ_WRITE /end MEASUREMENT
/begin MEASUREMENT fSAINARA "0:未  1:要求" UBYTE COMP_0283 1 100 0 1 BIT_MASK 0x0008 ECU_ADDRESS 0xFFFF3CE9 READ_WRITE /end MEASUREMENT
/begin MEASUREMENT fSENSNG "0:正常  1:異常" UBYTE COMP_0283 1 100 0 1 BIT_MASK 0x0004 ECU_ADDRESS 0xFFFF3CE9 READ_WRITE /end MEASUREMENT
/begin MEASUREMENT fSHTMOUT "0:No_failure  1:Detected_failure" UBYTE COMP_0283 1 100 0 1 BIT_MASK 0x0002 ECU_ADDRESS 0xFFFF3CE9 READ_WRITE /end MEASUREMENT
/begin MEASUREMENT fSLOSHZ "0:スロッシュ判定不成立  1:成立" UBYTE COMP_0283 1 100 0 1 BIT_MASK 0x0001 ECU_ADDRESS 0xFFFF3CE9 READ_WRITE /end MEASUREMENT
/begin MEASUREMENT fSLSW "0:SLSW_OFF  1:SLSW_ON" UBYTE COMP_0283 1 100 0 1 BIT_MASK 0x0080 ECU_ADDRESS 0xFFFF3CEA READ_WRITE /end MEASUREMENT
/begin MEASUREMENT fSLSWPORT "0:SLSW_OFF  1:SLSW_ON" UBYTE COMP_0283 1 100 0 1 BIT_MASK 0x0040 ECU_ADDRESS 0xFFFF3CEA READ_WRITE /end MEASUREMENT
/begin MEASUREMENT fSOFTSTSW1 "0:ソフトスタータスイッチON条件不成  1:ソフトスタータスイッチON条件成立" UBYTE COMP_0283 1 100 0 1 BIT_MASK 0x0020 ECU_ADDRESS 0xFFFF3CEA READ_WRITE /end MEASUREMENT
/begin MEASUREMENT fSPCVOK "0:不成立  1:成立" UBYTE COMP_0283 1 100 0 1 BIT_MASK 0x0010 ECU_ADDRESS 0xFFFF3CEA READ_WRITE /end MEASUREMENT
/begin MEASUREMENT fSSGBFAIL "0:No_failure  1:Detected_failure" UBYTE COMP_0283 1 100 0 1 BIT_MASK 0x0008 ECU_ADDRESS 0xFFFF3CEA READ_WRITE /end MEASUREMENT
/begin MEASUREMENT fSSGCRKNG "0:No_failure  1:Detected_failure" UBYTE COMP_0283 1 100 0 1 BIT_MASK 0x0004 ECU_ADDRESS 0xFFFF3CEA READ_WRITE /end MEASUREMENT
/begin MEASUREMENT fSSGCRKST "0:Inactive_level  1:Active_level" UBYTE COMP_0283 1 100 0 1 BIT_MASK 0x0002 ECU_ADDRESS 0xFFFF3CEA READ_WRITE /end MEASUREMENT
/begin MEASUREMENT fSSGDMAG "0:No_failure  1:Detected_failure_/_Dmag_Mosfet_S" UBYTE COMP_0283 1 100 0 1 BIT_MASK 0x0001 ECU_ADDRESS 0xFFFF3CEA READ_WRITE /end MEASUREMENT
/begin MEASUREMENT fSSGEFAIL "0:No_failure  1:Detected_failure_/_Rotor_excitat" UBYTE COMP_0283 1 100 0 1 BIT_MASK 0x0080 ECU_ADDRESS 0xFFFF3CEB READ_WRITE /end MEASUREMENT
/begin MEASUREMENT fSSGICRKST "0:Inactive_level  1:Active_level" UBYTE COMP_0283 1 100 0 1 BIT_MASK 0x0040 ECU_ADDRESS 0xFFFF3CEB READ_WRITE /end MEASUREMENT
/begin MEASUREMENT fSSGMFAIL "0:No_failure  1:Detected_failure_/_MS_profreadin" UBYTE COMP_0283 1 100 0 1 BIT_MASK 0x0020 ECU_ADDRESS 0xFFFF3CEB READ_WRITE /end MEASUREMENT
/begin MEASUREMENT fSSGSTALL "0:No_failure  1:Detected_failure_/_Stalled_rotor" UBYTE COMP_0283 1 100 0 1 BIT_MASK 0x0010 ECU_ADDRESS 0xFFFF3CEB READ_WRITE /end MEASUREMENT
/begin MEASUREMENT fSSGVLOW "0:No_failure  1:Detected_failure_/_Network_volta" UBYTE COMP_0283 1 100 0 1 BIT_MASK 0x0008 ECU_ADDRESS 0xFFFF3CEB READ_WRITE /end MEASUREMENT
/begin MEASUREMENT fST2STOK "0:不成立  1:条件成立" UBYTE COMP_0283 1 100 0 1 BIT_MASK 0x0004 ECU_ADDRESS 0xFFFF3CEB READ_WRITE /end MEASUREMENT
/begin MEASUREMENT fST2TMOUT "0:条件成立  1:条件不成立" UBYTE COMP_0283 1 100 0 1 BIT_MASK 0x0002 ECU_ADDRESS 0xFFFF3CEB READ_WRITE /end MEASUREMENT
/begin MEASUREMENT fSTHIST2 "0:fSTMST=0且つfIHRST非経験  1:fSTMST=0且つfIHRST経験" UBYTE COMP_0283 1 100 0 1 BIT_MASK 0x0001 ECU_ADDRESS 0xFFFF3CEB READ_WRITE /end MEASUREMENT
/begin MEASUREMENT fSTHIST3 "0:ｽﾀｰﾀﾓｰﾀ上限時間連続駆動非経験  1:ｽﾀｰﾀﾓｰﾀ上限時間連続駆動経験" UBYTE COMP_0283 1 100 0 1 BIT_MASK 0x0080 ECU_ADDRESS 0xFFFF3CEC READ_WRITE /end MEASUREMENT
/begin MEASUREMENT fSTHIST4 "0:fRSTREQ_0→1からfSTSW_1→0非経験  1:fRSTREQ_0→1からfSTSW_1→0経験" UBYTE COMP_0283 1 100 0 1 BIT_MASK 0x0040 ECU_ADDRESS 0xFFFF3CEC READ_WRITE /end MEASUREMENT
/begin MEASUREMENT fSTONOF "0:右記以外  1:START_SW_ON->OFFとなった" UBYTE COMP_0283 1 100 0 1 BIT_MASK 0x0020 ECU_ADDRESS 0xFFFF3CEC READ_WRITE /end MEASUREMENT
/begin MEASUREMENT fSTPNR23 "0:未実行  1:実行中" UBYTE COMP_0283 1 100 0 1 BIT_MASK 0x0010 ECU_ADDRESS 0xFFFF3CEC READ_WRITE /end MEASUREMENT
/begin MEASUREMENT fSTSWRSTZ "0:STSW前回値_OFF  1:STSW前回値_ON" UBYTE COMP_0283 1 100 0 1 BIT_MASK 0x0008 ECU_ADDRESS 0xFFFF3CEC READ_WRITE /end MEASUREMENT
/begin MEASUREMENT fSTSWZHPP "0:STSW_OFF  1:STSW_ON" UBYTE COMP_0283 1 100 0 1 BIT_MASK 0x0004 ECU_ADDRESS 0xFFFF3CEC READ_WRITE /end MEASUREMENT
/begin MEASUREMENT fSTSYS10 "0:Push始動ｼｽﾃﾑ  1:Key始動ｼｽﾃﾑ" UBYTE COMP_0283 1 100 0 1 BIT_MASK 0x0002 ECU_ADDRESS 0xFFFF3CEC READ_WRITE /end MEASUREMENT
/begin MEASUREMENT fSTSYSI1 "0:INITﾌﾗｸﾞ非成立  1:INITﾌﾗｸﾞ非成立" UBYTE COMP_0283 1 100 0 1 BIT_MASK 0x0001 ECU_ADDRESS 0xFFFF3CEC READ_WRITE /end MEASUREMENT
/begin MEASUREMENT fSTSYSI2 "0:INITﾌﾗｸﾞ非成立  1:INITﾌﾗｸﾞ非成立" UBYTE COMP_0283 1 100 0 1 BIT_MASK 0x0080 ECU_ADDRESS 0xFFFF3CED READ_WRITE /end MEASUREMENT
/begin MEASUREMENT fSTSYSOK "0:ｽﾀｰﾀﾓｰﾀ駆動ｼｽﾃﾑﾁｪｯｸNG  1:ｽﾀｰﾀﾓｰﾀ駆動ｼｽﾃﾑﾁｪｯｸOK" UBYTE COMP_0283 1 100 0 1 BIT_MASK 0x0040 ECU_ADDRESS 0xFFFF3CED READ_WRITE /end MEASUREMENT
/begin MEASUREMENT fSUBEND "0:未終了  1:終了" UBYTE COMP_0283 1 100 0 1 BIT_MASK 0x0020 ECU_ADDRESS 0xFFFF3CED READ_WRITE /end MEASUREMENT
/begin MEASUREMENT fTA20 "0:偶数回  1:奇数回" UBYTE COMP_0283 1 100 0 1 BIT_MASK 0x0010 ECU_ADDRESS 0xFFFF3CED READ_WRITE /end MEASUREMENT
/begin MEASUREMENT fTAIN "0:TA初回  1:2回目以降" UBYTE COMP_0283 1 100 0 1 BIT_MASK 0x0008 ECU_ADDRESS 0xFFFF3CED READ_WRITE /end MEASUREMENT
/begin MEASUREMENT fTAINTEO "0:右記以外  1:TAINTEOｲﾆｼｬﾗｲｽﾞ終了" UBYTE COMP_0283 1 100 0 1 BIT_MASK 0x0004 ECU_ADDRESS 0xFFFF3CED READ_WRITE /end MEASUREMENT
/begin MEASUREMENT fTAMNBU "0:TANBMN初回  1:2回目以降" UBYTE COMP_0283 1 100 0 1 BIT_MASK 0x0002 ECU_ADDRESS 0xFFFF3CED READ_WRITE /end MEASUREMENT
/begin MEASUREMENT fTAMNOK "0:不成立  1:成立" UBYTE COMP_0283 1 100 0 1 BIT_MASK 0x0001 ECU_ADDRESS 0xFFFF3CED READ_WRITE /end MEASUREMENT
/begin MEASUREMENT fTANBMN "0:TANBMN初回  1:2回目以降" UBYTE COMP_0283 1 100 0 1 BIT_MASK 0x0080 ECU_ADDRESS 0xFFFF3CEE READ_WRITE /end MEASUREMENT
/begin MEASUREMENT fTAOUTST "0:初回  1:初回以降" UBYTE COMP_0283 1 100 0 1 BIT_MASK 0x0040 ECU_ADDRESS 0xFFFF3CEE READ_WRITE /end MEASUREMENT
/begin MEASUREMENT fTATH20 "0:偶数回  1:奇数回" UBYTE COMP_0283 1 100 0 1 BIT_MASK 0x0020 ECU_ADDRESS 0xFFFF3CEE READ_WRITE /end MEASUREMENT
/begin MEASUREMENT fTATHIN "0:TA初回  1:2回目以降" UBYTE COMP_0283 1 100 0 1 BIT_MASK 0x0010 ECU_ADDRESS 0xFFFF3CEE READ_WRITE /end MEASUREMENT
/begin MEASUREMENT fTFCHNOK "0:不成立  1:成立" UBYTE COMP_0283 1 100 0 1 BIT_MASK 0x0008 ECU_ADDRESS 0xFFFF3CEE READ_WRITE /end MEASUREMENT
/begin MEASUREMENT fTFEX "0:正常  1:異常" UBYTE COMP_0283 1 100 0 1 BIT_MASK 0x0004 ECU_ADDRESS 0xFFFF3CEE READ_WRITE /end MEASUREMENT
/begin MEASUREMENT fTFHREX "0:正常  1:異常" UBYTE COMP_0283 1 100 0 1 BIT_MASK 0x0002 ECU_ADDRESS 0xFFFF3CEE READ_WRITE /end MEASUREMENT
/begin MEASUREMENT fTFINTHREO "0:始動時_&_VB<8V  1:左記以外" UBYTE COMP_0283 1 100 0 1 BIT_MASK 0x0001 ECU_ADDRESS 0xFFFF3CEE READ_WRITE /end MEASUREMENT
/begin MEASUREMENT fTFKOK "0:不成立  1:成立" UBYTE COMP_0283 1 100 0 1 BIT_MASK 0x0080 ECU_ADDRESS 0xFFFF3CEF READ_WRITE /end MEASUREMENT
/begin MEASUREMENT fTFSNDN "0:正常  1:異常" UBYTE COMP_0283 1 100 0 1 BIT_MASK 0x0040 ECU_ADDRESS 0xFFFF3CEF READ_WRITE /end MEASUREMENT
/begin MEASUREMENT fTHOPENST "0:不成立  1:成立" UBYTE COMP_0283 1 100 0 1 BIT_MASK 0x0020 ECU_ADDRESS 0xFFFF3CEF READ_WRITE /end MEASUREMENT
/begin MEASUREMENT fTHOPNST1 "0:不成立  1:成立" UBYTE COMP_0283 1 100 0 1 BIT_MASK 0x0010 ECU_ADDRESS 0xFFFF3CEF READ_WRITE /end MEASUREMENT
/begin MEASUREMENT fTHOPNST2 "0:不成立  1:成立" UBYTE COMP_0283 1 100 0 1 BIT_MASK 0x0008 ECU_ADDRESS 0xFFFF3CEF READ_WRITE /end MEASUREMENT
/begin MEASUREMENT fTHOPNST3 "0:不成立  1:成立" UBYTE COMP_0283 1 100 0 1 BIT_MASK 0x0004 ECU_ADDRESS 0xFFFF3CEF READ_WRITE /end MEASUREMENT
/begin MEASUREMENT fTMTAN2 "0:右記以外  1:START_SW_ON->OFF後TMTAN2#以上経" UBYTE COMP_0283 1 100 0 1 BIT_MASK 0x0002 ECU_ADDRESS 0xFFFF3CEF READ_WRITE /end MEASUREMENT
/begin MEASUREMENT fTNKPRO "0:通常  1:検知" UBYTE COMP_0283 1 100 0 1 BIT_MASK 0x0001 ECU_ADDRESS 0xFFFF3CEF READ_WRITE /end MEASUREMENT
/begin MEASUREMENT fTOWING "0:ﾄｰｲﾝｸﾞ中でない  1:ﾄｰｲﾝｸﾞ中の為不許可" UBYTE COMP_0283 1 100 0 1 BIT_MASK 0x0080 ECU_ADDRESS 0xFFFF3CF0 READ_WRITE /end MEASUREMENT
/begin MEASUREMENT fTPOAVF "0:初回  1:2回以降" UBYTE COMP_0283 1 100 0 1 BIT_MASK 0x0040 ECU_ADDRESS 0xFFFF3CF0 READ_WRITE /end MEASUREMENT
/begin MEASUREMENT fTPOOLD "0:初回  1:2回目以降" UBYTE COMP_0283 1 100 0 1 BIT_MASK 0x0020 ECU_ADDRESS 0xFFFF3CF0 READ_WRITE /end MEASUREMENT
/begin MEASUREMENT fTPS1CA "0:正常  1:警戒(過渡NG)" UBYTE COMP_0283 1 100 0 1 BIT_MASK 0x0010 ECU_ADDRESS 0xFFFF3CF0 READ_WRITE /end MEASUREMENT
/begin MEASUREMENT fTPS2CA "0:正常  1:警戒(過渡NG)" UBYTE COMP_0283 1 100 0 1 BIT_MASK 0x0008 ECU_ADDRESS 0xFFFF3CF0 READ_WRITE /end MEASUREMENT
/begin MEASUREMENT fTPSLRNC "0:全閉位置状態以外  1:全閉位置状態" UBYTE COMP_0283 1 100 0 1 BIT_MASK 0x0004 ECU_ADDRESS 0xFFFF3CF0 READ_WRITE /end MEASUREMENT
/begin MEASUREMENT fTPSXCA "0:正常  1:警戒(過渡NG)" UBYTE COMP_0283 1 100 0 1 BIT_MASK 0x0002 ECU_ADDRESS 0xFFFF3CF0 READ_WRITE /end MEASUREMENT
/begin MEASUREMENT fTRLYCQ "0:非要求  1:要求" UBYTE COMP_0283 1 100 0 1 BIT_MASK 0x0001 ECU_ADDRESS 0xFFFF3CF0 READ_WRITE /end MEASUREMENT
/begin MEASUREMENT fTTPSNG "0:NG条件不成立  1:NG条件成立" UBYTE COMP_0283 1 100 0 1 BIT_MASK 0x0080 ECU_ADDRESS 0xFFFF3CF1 READ_WRITE /end MEASUREMENT
/begin MEASUREMENT fTXDATASET "0:セット未完  1:セット完了" UBYTE COMP_0283 1 100 0 1 BIT_MASK 0x0040 ECU_ADDRESS 0xFFFF3CF1 READ_WRITE /end MEASUREMENT
/begin MEASUREMENT fUNCSCAN "0:非実行  1:実行" UBYTE COMP_0283 1 100 0 1 BIT_MASK 0x0020 ECU_ADDRESS 0xFFFF3CF1 READ_WRITE /end MEASUREMENT
/begin MEASUREMENT fUSMFTFMA "0:受信未経験  1:受信経験" UBYTE COMP_0283 1 100 0 1 BIT_MASK 0x0010 ECU_ADDRESS 0xFFFF3CF1 READ_WRITE /end MEASUREMENT
/begin MEASUREMENT fUSMGSA "0:受信未経験  1:受信経験" UBYTE COMP_0283 1 100 0 1 BIT_MASK 0x0008 ECU_ADDRESS 0xFFFF3CF1 READ_WRITE /end MEASUREMENT
/begin MEASUREMENT fVADJOK "0:VB_＜_VADJOK#（ヒス-1.04V）  1:VB_≧_VADJOK#（ヒス-1.04V）" UBYTE COMP_0283 1 100 0 1 BIT_MASK 0x0004 ECU_ADDRESS 0xFFFF3CF1 READ_WRITE /end MEASUREMENT
/begin MEASUREMENT fVAPOR "0:大量発生でない  1:ﾍﾞｰﾊﾟ大量発生の為不許可" UBYTE COMP_0283 1 100 0 1 BIT_MASK 0x0002 ECU_ADDRESS 0xFFFF3CF1 READ_WRITE /end MEASUREMENT
/begin MEASUREMENT fVASCD27 "0:条件不成立  1:条件成立" UBYTE COMP_0283 1 100 0 1 BIT_MASK 0x0001 ECU_ADDRESS 0xFFFF3CF1 READ_WRITE /end MEASUREMENT
/begin MEASUREMENT fVBRLYOK "0:診断不成立  1:診断成立" UBYTE COMP_0283 1 100 0 1 BIT_MASK 0x0080 ECU_ADDRESS 0xFFFF3CF2 READ_WRITE /end MEASUREMENT
/begin MEASUREMENT fVCLPRO "0:禁止でない  1:禁止" UBYTE COMP_0283 1 100 0 1 BIT_MASK 0x0040 ECU_ADDRESS 0xFFFF3CF2 READ_WRITE /end MEASUREMENT
/begin MEASUREMENT fVFPCM1ST "0:FPCM自己診断回路出力電圧の初回算  1:左記以外" UBYTE COMP_0283 1 100 0 1 BIT_MASK 0x0020 ECU_ADDRESS 0xFFFF3CF2 READ_WRITE /end MEASUREMENT
/begin MEASUREMENT fVMDGSTA "0:受信未経験  1:受信経験" UBYTE COMP_0283 1 100 0 1 BIT_MASK 0x0010 ECU_ADDRESS 0xFFFF3CF2 READ_WRITE /end MEASUREMENT
/begin MEASUREMENT fVMVABAV1 "0:初期値経験無し  1:初期値経験有り" UBYTE COMP_0283 1 100 0 1 BIT_MASK 0x0008 ECU_ADDRESS 0xFFFF3CF2 READ_WRITE /end MEASUREMENT
/begin MEASUREMENT fVPCHKOK "0:不許可  1:許可" UBYTE COMP_0283 1 100 0 1 BIT_MASK 0x0004 ECU_ADDRESS 0xFFFF3CF2 READ_WRITE /end MEASUREMENT
/begin MEASUREMENT fVPRSEOEX "0:正常  1:異常" UBYTE COMP_0283 1 100 0 1 BIT_MASK 0x0002 ECU_ADDRESS 0xFFFF3CF2 READ_WRITE /end MEASUREMENT
/begin MEASUREMENT fVSLINRNG "0:No_error  1:Error/LIN_receive_error" UBYTE COMP_0283 1 100 0 1 BIT_MASK 0x0001 ECU_ADDRESS 0xFFFF3CF2 READ_WRITE /end MEASUREMENT
/begin MEASUREMENT fVSLINTNG "0:No_error  1:Error/LIN_transmit_error" UBYTE COMP_0283 1 100 0 1 BIT_MASK 0x0080 ECU_ADDRESS 0xFFFF3CF3 READ_WRITE /end MEASUREMENT
/begin MEASUREMENT fVSOPMODE "0:Normal_mode  1:Factory_inspection_mode" UBYTE COMP_0283 1 100 0 1 BIT_MASK 0x0040 ECU_ADDRESS 0xFFFF3CF3 READ_WRITE /end MEASUREMENT
/begin MEASUREMENT fVSPGATE3 "0:706ms経過  1:706ms経過せず" UBYTE COMP_0283 1 100 0 1 BIT_MASK 0x0020 ECU_ADDRESS 0xFFFF3CF3 READ_WRITE /end MEASUREMENT
/begin MEASUREMENT fVSPTAN "0:右記以外  1:車速条件成立後かつディレイ時間経" UBYTE COMP_0283 1 100 0 1 BIT_MASK 0x0010 ECU_ADDRESS 0xFFFF3CF3 READ_WRITE /end MEASUREMENT
/begin MEASUREMENT fWPRSEOIN "0:初回  1:初回以降" UBYTE COMP_0283 1 100 0 1 BIT_MASK 0x0008 ECU_ADDRESS 0xFFFF3CF3 READ_WRITE /end MEASUREMENT
/begin MEASUREMENT fWSPULSEA "0:受信未経験  1:受信経験" UBYTE COMP_0283 1 100 0 1 BIT_MASK 0x0004 ECU_ADDRESS 0xFFFF3CF3 READ_WRITE /end MEASUREMENT
/begin MEASUREMENT fAPOKN_S "0:未処理  1:処理済み" UBYTE COMP_0283 1 100 0 1 BIT_MASK 0x0002 ECU_ADDRESS 0xFFFF3CF3 READ_WRITE /end MEASUREMENT
/begin MEASUREMENT fETCCHK1_S "0:許可状態  1:禁止状態" UBYTE COMP_0283 1 100 0 1 BIT_MASK 0x0001 ECU_ADDRESS 0xFFFF3CF3 READ_WRITE /end MEASUREMENT
/begin MEASUREMENT fETCCHK2_S "0:許可状態  1:禁止状態" UBYTE COMP_0283 1 100 0 1 BIT_MASK 0x0080 ECU_ADDRESS 0xFFFF3CF4 READ_WRITE /end MEASUREMENT
/begin MEASUREMENT fRLYON_S "0:リレーOFF要求  1:リレーＯＮ要求" UBYTE COMP_0283 1 100 0 1 BIT_MASK 0x0040 ECU_ADDRESS 0xFFFF3CF4 READ_WRITE /end MEASUREMENT
/begin MEASUREMENT fRLYON_SQ "0:要求無し  1:要求有り" UBYTE COMP_0283 1 100 0 1 BIT_MASK 0x0020 ECU_ADDRESS 0xFFFF3CF4 READ_WRITE /end MEASUREMENT
/begin MEASUREMENT wfVCLNDT "0:クリーニング非実行  1:クリーニング実行" UBYTE COMP_0283 1 100 0 1 BIT_MASK 0x0080 ECU_ADDRESS 0xFFFF1B80 READ_WRITE /end MEASUREMENT
/begin MEASUREMENT wfVCLNDTE "0:クリーニング非実行  1:クリーニング実行" UBYTE COMP_0283 1 100 0 1 BIT_MASK 0x0040 ECU_ADDRESS 0xFFFF1B80 READ_WRITE /end MEASUREMENT
/begin MEASUREMENT fVCLNDT "0:クリーニング非実行  1:クリーニング実行" UBYTE COMP_0283 1 100 0 1 BIT_MASK 0x0080 ECU_ADDRESS 0xFFFF1B81 READ_WRITE /end MEASUREMENT
/begin MEASUREMENT fVCLNDTE "0:クリーニング非実行  1:クリーニング実行" UBYTE COMP_0283 1 100 0 1 BIT_MASK 0x0040 ECU_ADDRESS 0xFFFF1B81 READ_WRITE /end MEASUREMENT
/begin MEASUREMENT wfF706MS "0:706msタイミング以外  1:706msタイミング" UBYTE COMP_0283 1 100 0 1 BIT_MASK 0x0080 ECU_ADDRESS 0xFFFF1B82 READ_WRITE /end MEASUREMENT
/begin MEASUREMENT wfFADVVSP "0:車速条件非成立  1:車速条件成立" UBYTE COMP_0283 1 100 0 1 BIT_MASK 0x0040 ECU_ADDRESS 0xFFFF1B82 READ_WRITE /end MEASUREMENT
/begin MEASUREMENT wfFISCVSP "0:車速条件非成立  1:車速条件成立" UBYTE COMP_0283 1 100 0 1 BIT_MASK 0x0020 ECU_ADDRESS 0xFFFF1B82 READ_WRITE /end MEASUREMENT
/begin MEASUREMENT wfMFCSTSW "0:演算未  1:演算済" UBYTE COMP_0283 1 100 0 1 BIT_MASK 0x0010 ECU_ADDRESS 0xFFFF1B82 READ_WRITE /end MEASUREMENT
/begin MEASUREMENT fF706MS "0:706msタイミング以外  1:706msタイミング" UBYTE COMP_0283 1 100 0 1 BIT_MASK 0x0080 ECU_ADDRESS 0xFFFF1B83 READ_WRITE /end MEASUREMENT
/begin MEASUREMENT fFADVVSP "0:車速条件非成立  1:車速条件成立" UBYTE COMP_0283 1 100 0 1 BIT_MASK 0x0040 ECU_ADDRESS 0xFFFF1B83 READ_WRITE /end MEASUREMENT
/begin MEASUREMENT fFISCVSP "0:車速条件非成立  1:車速条件成立" UBYTE COMP_0283 1 100 0 1 BIT_MASK 0x0020 ECU_ADDRESS 0xFFFF1B83 READ_WRITE /end MEASUREMENT
/begin MEASUREMENT fMFCSTSW "0:演算未  1:演算済" UBYTE COMP_0283 1 100 0 1 BIT_MASK 0x0010 ECU_ADDRESS 0xFFFF1B83 READ_WRITE /end MEASUREMENT
/begin MEASUREMENT wfBNC2SW "0:2連照合結果Low  1:2連照合結果High" UBYTE COMP_0283 1 100 0 1 BIT_MASK 0x0080 ECU_ADDRESS 0xFFFF3BDC READ_WRITE /end MEASUREMENT
/begin MEASUREMENT wfFSAFM "0:AFM_正常  1:AFM_OPEN/SHORT" UBYTE COMP_0283 1 100 0 1 BIT_MASK 0x0040 ECU_ADDRESS 0xFFFF3BDC READ_WRITE /end MEASUREMENT
/begin MEASUREMENT fBNC2SW "0:2連照合結果Low  1:2連照合結果High" UBYTE COMP_0283 1 100 0 1 BIT_MASK 0x0080 ECU_ADDRESS 0xFFFF3BDD READ_WRITE /end MEASUREMENT
/begin MEASUREMENT fFSAFM "0:AFM_正常  1:AFM_OPEN/SHORT" UBYTE COMP_0283 1 100 0 1 BIT_MASK 0x0040 ECU_ADDRESS 0xFFFF3BDD READ_WRITE /end MEASUREMENT
/begin MEASUREMENT wfTPSLRN "0:全閉学習中以外  1:全閉学習中" UBYTE COMP_0283 1 100 0 1 BIT_MASK 0x0080 ECU_ADDRESS 0xFFFF3BDF READ_WRITE /end MEASUREMENT
/begin MEASUREMENT fTPSLRN "0:全閉学習中以外  1:全閉学習中" UBYTE COMP_0283 1 100 0 1 BIT_MASK 0x0080 ECU_ADDRESS 0xFFFF3BE0 READ_WRITE /end MEASUREMENT
/begin MEASUREMENT wfBATDEG2 "0:不成立  1:成立" UBYTE COMP_0283 1 100 0 1 BIT_MASK 0x0080 ECU_ADDRESS 0xFFFF3BE2 READ_WRITE /end MEASUREMENT
/begin MEASUREMENT wfBNCAD "0:BNC_SWｱﾅﾛｸﾞ入力低電圧側  1:BNC_SWｱﾅﾛｸﾞ入力高電圧側" UBYTE COMP_0283 1 100 0 1 BIT_MASK 0x0040 ECU_ADDRESS 0xFFFF3BE2 READ_WRITE /end MEASUREMENT
/begin MEASUREMENT wfDNEUT "0:サンプリング値LO  1:サンプリング値HI" UBYTE COMP_0283 1 100 0 1 BIT_MASK 0x0020 ECU_ADDRESS 0xFFFF3BE2 READ_WRITE /end MEASUREMENT
/begin MEASUREMENT wfFTPCHTYU "0:Not＿permission  1:Permission" UBYTE COMP_0283 1 100 0 1 BIT_MASK 0x0010 ECU_ADDRESS 0xFFFF3BE2 READ_WRITE /end MEASUREMENT
/begin MEASUREMENT wfLRNCNG "0:正常  1:異常" UBYTE COMP_0283 1 100 0 1 BIT_MASK 0x0008 ECU_ADDRESS 0xFFFF3BE2 READ_WRITE /end MEASUREMENT
/begin MEASUREMENT wfPRGBAT "0:ノーマルバッテリ  1:回生用バッテリ" UBYTE COMP_0283 1 100 0 1 BIT_MASK 0x0004 ECU_ADDRESS 0xFFFF3BE2 READ_WRITE /end MEASUREMENT
/begin MEASUREMENT wfQSELGO "0:QSEL=Q  1:QSEL=0" UBYTE COMP_0283 1 100 0 1 BIT_MASK 0x0002 ECU_ADDRESS 0xFFFF3BE2 READ_WRITE /end MEASUREMENT
/begin MEASUREMENT fBATDEG2 "0:不成立  1:成立" UBYTE COMP_0283 1 100 0 1 BIT_MASK 0x0080 ECU_ADDRESS 0xFFFF3BE3 READ_WRITE /end MEASUREMENT
/begin MEASUREMENT fBNCAD "0:BNC_SWｱﾅﾛｸﾞ入力低電圧側  1:BNC_SWｱﾅﾛｸﾞ入力高電圧側" UBYTE COMP_0283 1 100 0 1 BIT_MASK 0x0040 ECU_ADDRESS 0xFFFF3BE3 READ_WRITE /end MEASUREMENT
/begin MEASUREMENT fDNEUT "0:サンプリング値LO  1:サンプリング値HI" UBYTE COMP_0283 1 100 0 1 BIT_MASK 0x0020 ECU_ADDRESS 0xFFFF3BE3 READ_WRITE /end MEASUREMENT
/begin MEASUREMENT fFTPCHTYU "0:Not＿permission  1:Permission" UBYTE COMP_0283 1 100 0 1 BIT_MASK 0x0010 ECU_ADDRESS 0xFFFF3BE3 READ_WRITE /end MEASUREMENT
/begin MEASUREMENT fLRNCNG "0:正常  1:異常" UBYTE COMP_0283 1 100 0 1 BIT_MASK 0x0008 ECU_ADDRESS 0xFFFF3BE3 READ_WRITE /end MEASUREMENT
/begin MEASUREMENT fPRGBAT "0:ノーマルバッテリ  1:回生用バッテリ" UBYTE COMP_0283 1 100 0 1 BIT_MASK 0x0004 ECU_ADDRESS 0xFFFF3BE3 READ_WRITE /end MEASUREMENT
/begin MEASUREMENT fQSELGO "0:QSEL=Q  1:QSEL=0" UBYTE COMP_0283 1 100 0 1 BIT_MASK 0x0002 ECU_ADDRESS 0xFFFF3BE3 READ_WRITE /end MEASUREMENT
/begin MEASUREMENT wfITANDM "0:vTPTRM-vAVTPR>=0  1:左記以外" UBYTE COMP_0283 1 100 0 1 BIT_MASK 0x0080 ECU_ADDRESS 0xFFFF1B84 READ_WRITE /end MEASUREMENT
/begin MEASUREMENT fITANDM "0:vTPTRM-vAVTPR>=0  1:左記以外" UBYTE COMP_0283 1 100 0 1 BIT_MASK 0x0080 ECU_ADDRESS 0xFFFF1B85 READ_WRITE /end MEASUREMENT
/begin MEASUREMENT wfDWNSFTTD "0:要求無し  1:要求有り" UBYTE COMP_0283 1 100 0 1 BIT_MASK 0x0080 ECU_ADDRESS 0xFFFF1B88 READ_WRITE /end MEASUREMENT
/begin MEASUREMENT wfLOAD2 "0:LOAD2_SW_OFF  1:LOAD2_SW_ON" UBYTE COMP_0283 1 100 0 1 BIT_MASK 0x0040 ECU_ADDRESS 0xFFFF1B88 READ_WRITE /end MEASUREMENT
/begin MEASUREMENT wfLOADSW "0:LOAD_SW_OFF  1:LOAD_SW_ON" UBYTE COMP_0283 1 100 0 1 BIT_MASK 0x0020 ECU_ADDRESS 0xFFFF1B88 READ_WRITE /end MEASUREMENT
/begin MEASUREMENT wfNEUTD "0:NEUTDSW_OFF  1:NEUTDSW_ON" UBYTE COMP_0283 1 100 0 1 BIT_MASK 0x0010 ECU_ADDRESS 0xFFFF1B88 READ_WRITE /end MEASUREMENT
/begin MEASUREMENT wfONLUFLG "0:LU中以外  1:LU中" UBYTE COMP_0283 1 100 0 1 BIT_MASK 0x0008 ECU_ADDRESS 0xFFFF1B88 READ_WRITE /end MEASUREMENT
/begin MEASUREMENT wfPRIRTD "0:要求無し  1:要求有り" UBYTE COMP_0283 1 100 0 1 BIT_MASK 0x0004 ECU_ADDRESS 0xFFFF1B88 READ_WRITE /end MEASUREMENT
/begin MEASUREMENT wfTASW "0:TASW_OFF  1:TASW_ON" UBYTE COMP_0283 1 100 0 1 BIT_MASK 0x0002 ECU_ADDRESS 0xFFFF1B88 READ_WRITE /end MEASUREMENT
/begin MEASUREMENT wfTOP "0:TOP以外  1:TOP" UBYTE COMP_0283 1 100 0 1 BIT_MASK 0x0001 ECU_ADDRESS 0xFFFF1B88 READ_WRITE /end MEASUREMENT
/begin MEASUREMENT wfUPSFTTDS "0:要求無し  1:要求有り" UBYTE COMP_0283 1 100 0 1 BIT_MASK 0x0080 ECU_ADDRESS 0xFFFF1B89 READ_WRITE /end MEASUREMENT
/begin MEASUREMENT fDWNSFTTD "0:要求無し  1:要求有り" UBYTE COMP_0283 1 100 0 1 BIT_MASK 0x0080 ECU_ADDRESS 0xFFFF1B8A READ_WRITE /end MEASUREMENT
/begin MEASUREMENT fLOAD2 "0:LOAD2_SW_OFF  1:LOAD2_SW_ON" UBYTE COMP_0283 1 100 0 1 BIT_MASK 0x0040 ECU_ADDRESS 0xFFFF1B8A READ_WRITE /end MEASUREMENT
/begin MEASUREMENT fLOADSW "0:LOAD_SW_OFF  1:LOAD_SW_ON" UBYTE COMP_0283 1 100 0 1 BIT_MASK 0x0020 ECU_ADDRESS 0xFFFF1B8A READ_WRITE /end MEASUREMENT
/begin MEASUREMENT fNEUTD "0:NEUTDSW_OFF  1:NEUTDSW_ON" UBYTE COMP_0283 1 100 0 1 BIT_MASK 0x0010 ECU_ADDRESS 0xFFFF1B8A READ_WRITE /end MEASUREMENT
/begin MEASUREMENT fONLUFLG "0:LU中以外  1:LU中" UBYTE COMP_0283 1 100 0 1 BIT_MASK 0x0008 ECU_ADDRESS 0xFFFF1B8A READ_WRITE /end MEASUREMENT
/begin MEASUREMENT fPRIRTD "0:要求無し  1:要求有り" UBYTE COMP_0283 1 100 0 1 BIT_MASK 0x0004 ECU_ADDRESS 0xFFFF1B8A READ_WRITE /end MEASUREMENT
/begin MEASUREMENT fTASW "0:TASW_OFF  1:TASW_ON" UBYTE COMP_0283 1 100 0 1 BIT_MASK 0x0002 ECU_ADDRESS 0xFFFF1B8A READ_WRITE /end MEASUREMENT
/begin MEASUREMENT fTOP "0:TOP以外  1:TOP" UBYTE COMP_0283 1 100 0 1 BIT_MASK 0x0001 ECU_ADDRESS 0xFFFF1B8A READ_WRITE /end MEASUREMENT
/begin MEASUREMENT fUPSFTTDS "0:要求無し  1:要求有り" UBYTE COMP_0283 1 100 0 1 BIT_MASK 0x0080 ECU_ADDRESS 0xFFFF1B8B READ_WRITE /end MEASUREMENT
/begin MEASUREMENT wfACCACT "0:非作動中  1:ACC作動中" UBYTE COMP_0283 1 100 0 1 BIT_MASK 0x0080 ECU_ADDRESS 0xFFFF1B8E READ_WRITE /end MEASUREMENT
/begin MEASUREMENT fACCACT "0:非作動中  1:ACC作動中" UBYTE COMP_0283 1 100 0 1 BIT_MASK 0x0080 ECU_ADDRESS 0xFFFF1B8F READ_WRITE /end MEASUREMENT
/begin MEASUREMENT wfATOP "0:TOP以外  1:TOP" UBYTE COMP_0283 1 100 0 1 BIT_MASK 0x0080 ECU_ADDRESS 0xFFFF1B95 READ_WRITE /end MEASUREMENT
/begin MEASUREMENT wfATRNG1 "0:－  1:－" UBYTE COMP_0283 1 100 0 1 BIT_MASK 0x0040 ECU_ADDRESS 0xFFFF1B95 READ_WRITE /end MEASUREMENT
/begin MEASUREMENT wfCVTFAIL "0:正常  1:異常" UBYTE COMP_0283 1 100 0 1 BIT_MASK 0x0020 ECU_ADDRESS 0xFFFF1B95 READ_WRITE /end MEASUREMENT
/begin MEASUREMENT wfDTVOM "0:減速中ではない  1:減速中" UBYTE COMP_0283 1 100 0 1 BIT_MASK 0x0010 ECU_ADDRESS 0xFFFF1B95 READ_WRITE /end MEASUREMENT
/begin MEASUREMENT wfDTVOP "0:加速中ではない  1:加速中" UBYTE COMP_0283 1 100 0 1 BIT_MASK 0x0008 ECU_ADDRESS 0xFFFF1B95 READ_WRITE /end MEASUREMENT
/begin MEASUREMENT wfECHOK "0:条件不成立  1:条件成立" UBYTE COMP_0283 1 100 0 1 BIT_MASK 0x0004 ECU_ADDRESS 0xFFFF1B95 READ_WRITE /end MEASUREMENT
/begin MEASUREMENT wfEXCALCHK "0:異常  1:正常" UBYTE COMP_0283 1 100 0 1 BIT_MASK 0x0002 ECU_ADDRESS 0xFFFF1B95 READ_WRITE /end MEASUREMENT
/begin MEASUREMENT wfFMAPSEL "0:Dﾚﾝｼﾞ選択  1:Dsﾚﾝｼﾞ選択" UBYTE COMP_0283 1 100 0 1 BIT_MASK 0x0001 ECU_ADDRESS 0xFFFF1B95 READ_WRITE /end MEASUREMENT
/begin MEASUREMENT wfFOILSWON "0:右記以外  1:油圧低下" UBYTE COMP_0283 1 100 0 1 BIT_MASK 0x0080 ECU_ADDRESS 0xFFFF1B96 READ_WRITE /end MEASUREMENT
/begin MEASUREMENT wfFSCKATIH "0:許可  1:禁止" UBYTE COMP_0283 1 100 0 1 BIT_MASK 0x0040 ECU_ADDRESS 0xFFFF1B96 READ_WRITE /end MEASUREMENT
/begin MEASUREMENT wfFSTVO "0:TH/S_正常  1:TH/S_OPEN/SHORT" UBYTE COMP_0283 1 100 0 1 BIT_MASK 0x0020 ECU_ADDRESS 0xFFFF1B96 READ_WRITE /end MEASUREMENT
/begin MEASUREMENT wfFSTWN "0:TW/S_正常  1:TW/S_OPEN/SHORT" UBYTE COMP_0283 1 100 0 1 BIT_MASK 0x0010 ECU_ADDRESS 0xFFFF1B96 READ_WRITE /end MEASUREMENT
/begin MEASUREMENT wfHRATIO "0:変速比状態が厳しい  1:変速比状態が厳しくない" UBYTE COMP_0283 1 100 0 1 BIT_MASK 0x0008 ECU_ADDRESS 0xFFFF1B96 READ_WRITE /end MEASUREMENT
/begin MEASUREMENT wfIDLEUP "0:要求無し  1:要求有り" UBYTE COMP_0283 1 100 0 1 BIT_MASK 0x0004 ECU_ADDRESS 0xFFFF1B96 READ_WRITE /end MEASUREMENT
/begin MEASUREMENT wfIDLSOFIS "0:IDLE時SOFIS制御許可  1:IDLE時SOFIS制御禁止" UBYTE COMP_0283 1 100 0 1 BIT_MASK 0x0002 ECU_ADDRESS 0xFFFF1B96 READ_WRITE /end MEASUREMENT
/begin MEASUREMENT wfISCFBHI "0:ISC_F/B_早期化不許可  1:ISC_F/B_早期化許可" UBYTE COMP_0283 1 100 0 1 BIT_MASK 0x0001 ECU_ADDRESS 0xFFFF1B96 READ_WRITE /end MEASUREMENT
/begin MEASUREMENT wfKENST "0:簡易エンスト状態以外  1:簡易エンスト状態" UBYTE COMP_0283 1 100 0 1 BIT_MASK 0x0080 ECU_ADDRESS 0xFFFF1B97 READ_WRITE /end MEASUREMENT
/begin MEASUREMENT wfKTOP "0:TOP以外  1:TOP" UBYTE COMP_0283 1 100 0 1 BIT_MASK 0x0040 ECU_ADDRESS 0xFFFF1B97 READ_WRITE /end MEASUREMENT
/begin MEASUREMENT wfLOAD "0:OFF  1:ON" UBYTE COMP_0283 1 100 0 1 BIT_MASK 0x0020 ECU_ADDRESS 0xFFFF1B97 READ_WRITE /end MEASUREMENT
/begin MEASUREMENT wfM4WDSW "0:M4WD_sw_OFF  1:M4WD_sw_ON" UBYTE COMP_0283 1 100 0 1 BIT_MASK 0x0010 ECU_ADDRESS 0xFFFF1B97 READ_WRITE /end MEASUREMENT
/begin MEASUREMENT wfMIDLE "0:メカアイドル_SW_OFF  1:メカアイドル_SW_ON" UBYTE COMP_0283 1 100 0 1 BIT_MASK 0x0008 ECU_ADDRESS 0xFFFF1B97 READ_WRITE /end MEASUREMENT
/begin MEASUREMENT wfMSFT "0:Mﾓｰﾄﾞ以外  1:Mﾓｰﾄﾞ時" UBYTE COMP_0283 1 100 0 1 BIT_MASK 0x0004 ECU_ADDRESS 0xFFFF1B97 READ_WRITE /end MEASUREMENT
/begin MEASUREMENT wfNIDLELRN "0:Clutch_learning_not_demand  1:Clutch_learning_demand" UBYTE COMP_0283 1 100 0 1 BIT_MASK 0x0002 ECU_ADDRESS 0xFFFF1B97 READ_WRITE /end MEASUREMENT
/begin MEASUREMENT wfNIDLESTB "0:N_Idle_Standby_NG  1:N_Idle_Standby_OK" UBYTE COMP_0283 1 100 0 1 BIT_MASK 0x0001 ECU_ADDRESS 0xFFFF1B97 READ_WRITE /end MEASUREMENT
/begin MEASUREMENT wfNIEMREQ "0:非許可  1:許可" UBYTE COMP_0283 1 100 0 1 BIT_MASK 0x0080 ECU_ADDRESS 0xFFFF1B98 READ_WRITE /end MEASUREMENT
/begin MEASUREMENT wfOILPNG "0:アイドルUP要求無し  1:アイドルUP要求有り" UBYTE COMP_0283 1 100 0 1 BIT_MASK 0x0040 ECU_ADDRESS 0xFFFF1B98 READ_WRITE /end MEASUREMENT
/begin MEASUREMENT wfONSHIFT "0:変速中でない  1:変速中" UBYTE COMP_0283 1 100 0 1 BIT_MASK 0x0020 ECU_ADDRESS 0xFFFF1B98 READ_WRITE /end MEASUREMENT
/begin MEASUREMENT wfPDSW "0:P/D_SW_OFF  1:P/D_SW_ON" UBYTE COMP_0283 1 100 0 1 BIT_MASK 0x0010 ECU_ADDRESS 0xFFFF1B98 READ_WRITE /end MEASUREMENT
/begin MEASUREMENT wfSLFCHK "0:異常  1:正常" UBYTE COMP_0283 1 100 0 1 BIT_MASK 0x0008 ECU_ADDRESS 0xFFFF1B98 READ_WRITE /end MEASUREMENT
/begin MEASUREMENT wfSYNCCHK "0:異常  1:正常" UBYTE COMP_0283 1 100 0 1 BIT_MASK 0x0004 ECU_ADDRESS 0xFFFF1B98 READ_WRITE /end MEASUREMENT
/begin MEASUREMENT wfTAINT "0:右記以外  1:TAINT_イニシャライズ終了" UBYTE COMP_0283 1 100 0 1 BIT_MASK 0x0002 ECU_ADDRESS 0xFFFF1B98 READ_WRITE /end MEASUREMENT
/begin MEASUREMENT wfTIPDOF "0:条件不成立  1:条件成立" UBYTE COMP_0283 1 100 0 1 BIT_MASK 0x0001 ECU_ADDRESS 0xFFFF1B98 READ_WRITE /end MEASUREMENT
/begin MEASUREMENT wfTPSTEND "0:TP始動時制御終了前  1:TP始動時制御終了" UBYTE COMP_0283 1 100 0 1 BIT_MASK 0x0080 ECU_ADDRESS 0xFFFF1B99 READ_WRITE /end MEASUREMENT
/begin MEASUREMENT wfTRANS "0:定常  1:過渡" UBYTE COMP_0283 1 100 0 1 BIT_MASK 0x0040 ECU_ADDRESS 0xFFFF1B99 READ_WRITE /end MEASUREMENT
/begin MEASUREMENT wfTVST "0:1以外  1:OFF後初回" UBYTE COMP_0283 1 100 0 1 BIT_MASK 0x0020 ECU_ADDRESS 0xFFFF1B99 READ_WRITE /end MEASUREMENT
/begin MEASUREMENT wfIDLEPR_S "0:OFF  1:ON" UBYTE COMP_0283 1 100 0 1 BIT_MASK 0x0010 ECU_ADDRESS 0xFFFF1B99 READ_WRITE /end MEASUREMENT
/begin MEASUREMENT wfFSTO "0:正常  1:異常" UBYTE COMP_0283 1 100 0 1 BIT_MASK 0x0080 ECU_ADDRESS 0xFFFF3BEA READ_WRITE /end MEASUREMENT
/begin MEASUREMENT fFSTO "0:正常  1:異常" UBYTE COMP_0283 1 100 0 1 BIT_MASK 0x0080 ECU_ADDRESS 0xFFFF3BEB READ_WRITE /end MEASUREMENT
/begin MEASUREMENT wfFACTTW "0:水温暖機未経験  1:水温暖機経験" UBYTE COMP_0283 1 100 0 1 BIT_MASK 0x0080 ECU_ADDRESS 0xFFFF561C READ_WRITE /end MEASUREMENT
/begin MEASUREMENT wfGLRNOK "0:未完了  1:完了" UBYTE COMP_0283 1 100 0 1 BIT_MASK 0x0040 ECU_ADDRESS 0xFFFF561C READ_WRITE /end MEASUREMENT
/begin MEASUREMENT wfNGCOMP "0:不成立  1:成立" UBYTE COMP_0283 1 100 0 1 BIT_MASK 0x0020 ECU_ADDRESS 0xFFFF561C READ_WRITE /end MEASUREMENT
/begin MEASUREMENT wfNGDECMP "0:不成立  1:成立" UBYTE COMP_0283 1 100 0 1 BIT_MASK 0x0010 ECU_ADDRESS 0xFFFF561C READ_WRITE /end MEASUREMENT
/begin MEASUREMENT wfOKCOMP "0:不成立  1:成立" UBYTE COMP_0283 1 100 0 1 BIT_MASK 0x0008 ECU_ADDRESS 0xFFFF561C READ_WRITE /end MEASUREMENT
/begin MEASUREMENT wfOKDECMP "0:不成立  1:成立" UBYTE COMP_0283 1 100 0 1 BIT_MASK 0x0004 ECU_ADDRESS 0xFFFF561C READ_WRITE /end MEASUREMENT
/begin MEASUREMENT wfSIDONG "0:不成立  1:成立" UBYTE COMP_0283 1 100 0 1 BIT_MASK 0x0002 ECU_ADDRESS 0xFFFF561C READ_WRITE /end MEASUREMENT
/begin MEASUREMENT wfSLOPE "0:坂道判定不成立  1:成立" UBYTE COMP_0283 1 100 0 1 BIT_MASK 0x0001 ECU_ADDRESS 0xFFFF561C READ_WRITE /end MEASUREMENT
/begin MEASUREMENT wfSLOSH "0:スロッシュ判定不成立  1:成立" UBYTE COMP_0283 1 100 0 1 BIT_MASK 0x0080 ECU_ADDRESS 0xFFFF561D READ_WRITE /end MEASUREMENT
/begin MEASUREMENT wfSTSYSTYP "0:Push始動ｼｽﾃﾑ  1:Key始動ｼｽﾃﾑ" UBYTE COMP_0283 1 100 0 1 BIT_MASK 0x0040 ECU_ADDRESS 0xFFFF561D READ_WRITE /end MEASUREMENT
/begin MEASUREMENT wfFHORS "0:成層  1:均質" UBYTE COMP_0283 1 100 0 1 BIT_MASK 0x0080 ECU_ADDRESS 0xFFFF1B9F READ_WRITE /end MEASUREMENT
/begin MEASUREMENT fFHORS "0:成層  1:均質" UBYTE COMP_0283 1 100 0 1 BIT_MASK 0x0080 ECU_ADDRESS 0xFFFF1BA0 READ_WRITE /end MEASUREMENT
/begin MEASUREMENT wfFEARLYIN "0:始動早期化噴射不成立  1:始動早期化噴射成立" UBYTE COMP_0283 1 100 0 1 BIT_MASK 0x0080 ECU_ADDRESS 0xFFFF1BA2 READ_WRITE /end MEASUREMENT
/begin MEASUREMENT wfFPLINJZ2 "0:不成立  1:成立" UBYTE COMP_0283 1 100 0 1 BIT_MASK 0x0040 ECU_ADDRESS 0xFFFF1BA2 READ_WRITE /end MEASUREMENT
/begin MEASUREMENT wfFPLINJZ6 "0:不成立  1:成立" UBYTE COMP_0283 1 100 0 1 BIT_MASK 0x0020 ECU_ADDRESS 0xFFFF1BA2 READ_WRITE /end MEASUREMENT
/begin MEASUREMENT wfFPLINJZ7 "0:不成立  1:成立" UBYTE COMP_0283 1 100 0 1 BIT_MASK 0x0010 ECU_ADDRESS 0xFFFF1BA2 READ_WRITE /end MEASUREMENT
/begin MEASUREMENT wfGOSLCT "0:無し  1:有り" UBYTE COMP_0283 1 100 0 1 BIT_MASK 0x0008 ECU_ADDRESS 0xFFFF1BA2 READ_WRITE /end MEASUREMENT
/begin MEASUREMENT wfISCFB "0:ISC_OPEN  1:ISC_CLOSED" UBYTE COMP_0283 1 100 0 1 BIT_MASK 0x0004 ECU_ADDRESS 0xFFFF1BA2 READ_WRITE /end MEASUREMENT
/begin MEASUREMENT wfPODLST "0:許可  1:禁止" UBYTE COMP_0283 1 100 0 1 BIT_MASK 0x0002 ECU_ADDRESS 0xFFFF1BA2 READ_WRITE /end MEASUREMENT
/begin MEASUREMENT wfPOSNOISE "0:検出なし  1:検出あり" UBYTE COMP_0283 1 100 0 1 BIT_MASK 0x0001 ECU_ADDRESS 0xFFFF1BA2 READ_WRITE /end MEASUREMENT
/begin MEASUREMENT wfREFJUDGE "0:右記以外  1:燃圧判定許可中" UBYTE COMP_0283 1 100 0 1 BIT_MASK 0x0080 ECU_ADDRESS 0xFFFF1BA3 READ_WRITE /end MEASUREMENT
/begin MEASUREMENT wfTREF1ST "0:周期計測未実行  1:周期計測開始" UBYTE COMP_0283 1 100 0 1 BIT_MASK 0x0040 ECU_ADDRESS 0xFFFF1BA3 READ_WRITE /end MEASUREMENT
/begin MEASUREMENT fFEARLYIN "0:始動早期化噴射不成立  1:始動早期化噴射成立" UBYTE COMP_0283 1 100 0 1 BIT_MASK 0x0080 ECU_ADDRESS 0xFFFF1BA4 READ_WRITE /end MEASUREMENT
/begin MEASUREMENT fFPLINJZ2 "0:不成立  1:成立" UBYTE COMP_0283 1 100 0 1 BIT_MASK 0x0040 ECU_ADDRESS 0xFFFF1BA4 READ_WRITE /end MEASUREMENT
/begin MEASUREMENT fFPLINJZ6 "0:不成立  1:成立" UBYTE COMP_0283 1 100 0 1 BIT_MASK 0x0020 ECU_ADDRESS 0xFFFF1BA4 READ_WRITE /end MEASUREMENT
/begin MEASUREMENT fFPLINJZ7 "0:不成立  1:成立" UBYTE COMP_0283 1 100 0 1 BIT_MASK 0x0010 ECU_ADDRESS 0xFFFF1BA4 READ_WRITE /end MEASUREMENT
/begin MEASUREMENT fGOSLCT "0:無し  1:有り" UBYTE COMP_0283 1 100 0 1 BIT_MASK 0x0008 ECU_ADDRESS 0xFFFF1BA4 READ_WRITE /end MEASUREMENT
/begin MEASUREMENT fISCFB "0:ISC_OPEN  1:ISC_CLOSED" UBYTE COMP_0283 1 100 0 1 BIT_MASK 0x0004 ECU_ADDRESS 0xFFFF1BA4 READ_WRITE /end MEASUREMENT
/begin MEASUREMENT fPODLST "0:許可  1:禁止" UBYTE COMP_0283 1 100 0 1 BIT_MASK 0x0002 ECU_ADDRESS 0xFFFF1BA4 READ_WRITE /end MEASUREMENT
/begin MEASUREMENT fPOSNOISE "0:検出なし  1:検出あり" UBYTE COMP_0283 1 100 0 1 BIT_MASK 0x0001 ECU_ADDRESS 0xFFFF1BA4 READ_WRITE /end MEASUREMENT
/begin MEASUREMENT fREFJUDGE "0:右記以外  1:燃圧判定許可中" UBYTE COMP_0283 1 100 0 1 BIT_MASK 0x0080 ECU_ADDRESS 0xFFFF1BA5 READ_WRITE /end MEASUREMENT
/begin MEASUREMENT fTREF1ST "0:周期計測未実行  1:周期計測開始" UBYTE COMP_0283 1 100 0 1 BIT_MASK 0x0040 ECU_ADDRESS 0xFFFF1BA5 READ_WRITE /end MEASUREMENT
/begin MEASUREMENT wfCATACTU "0:未活性  1:活性" UBYTE COMP_0283 1 100 0 1 BIT_MASK 0x0080 ECU_ADDRESS 0xFFFF3C0D READ_WRITE /end MEASUREMENT
/begin MEASUREMENT wfREFJDGE2 "0:成層始動用燃圧判定不許可  1:成層始動用燃圧判定許可" UBYTE COMP_0283 1 100 0 1 BIT_MASK 0x0040 ECU_ADDRESS 0xFFFF3C0D READ_WRITE /end MEASUREMENT
/begin MEASUREMENT fCATACTU "0:未活性  1:活性" UBYTE COMP_0283 1 100 0 1 BIT_MASK 0x0080 ECU_ADDRESS 0xFFFF3C0E READ_WRITE /end MEASUREMENT
/begin MEASUREMENT fREFJDGE2 "0:成層始動用燃圧判定不許可  1:成層始動用燃圧判定許可" UBYTE COMP_0283 1 100 0 1 BIT_MASK 0x0040 ECU_ADDRESS 0xFFFF3C0E READ_WRITE /end MEASUREMENT
/begin MEASUREMENT bfFLUP "0:ロックアップ中制御許可  1:ロックアップ中制御禁止" UBYTE COMP_0283 1 100 0 1 BIT_MASK 0x0080 ECU_ADDRESS 0xFFFF1BA6 READ_WRITE /end MEASUREMENT
/begin MEASUREMENT bfFREVRS "0:右記以外  1:リバ-ス判定フラグON" UBYTE COMP_0283 1 100 0 1 BIT_MASK 0x0040 ECU_ADDRESS 0xFFFF1BA6 READ_WRITE /end MEASUREMENT
/begin MEASUREMENT bfISCFF "0:実行判定不成立  1:実行判定成立" UBYTE COMP_0283 1 100 0 1 BIT_MASK 0x0020 ECU_ADDRESS 0xFFFF1BA6 READ_WRITE /end MEASUREMENT
/begin MEASUREMENT bfREGGAS "0:ハイオク  1:レギュラー" UBYTE COMP_0283 1 100 0 1 BIT_MASK 0x0010 ECU_ADDRESS 0xFFFF1BA6 READ_WRITE /end MEASUREMENT
/begin MEASUREMENT bfSCV "0:ｿﾚﾉｲﾄﾞOFF  1:ｿﾚﾉｲﾄﾞON" UBYTE COMP_0283 1 100 0 1 BIT_MASK 0x0008 ECU_ADDRESS 0xFFFF1BA6 READ_WRITE /end MEASUREMENT
/begin MEASUREMENT bfCSTLU "0:不成立  1:減速時制御成立" UBYTE COMP_0283 1 100 0 1 BIT_MASK 0x0080 ECU_ADDRESS 0xFFFF1BA8 READ_WRITE /end MEASUREMENT
/begin MEASUREMENT bfFULTVO "0:ﾌﾙ増量未  1:ﾌﾙ増量" UBYTE COMP_0283 1 100 0 1 BIT_MASK 0x0040 ECU_ADDRESS 0xFFFF1BA8 READ_WRITE /end MEASUREMENT
/begin MEASUREMENT bfPIMAX "0:最大以外  1:最大PI" UBYTE COMP_0283 1 100 0 1 BIT_MASK 0x0020 ECU_ADDRESS 0xFFFF1BA8 READ_WRITE /end MEASUREMENT
/begin MEASUREMENT bfRACLU "0:不成立  1:再加速時制御成立" UBYTE COMP_0283 1 100 0 1 BIT_MASK 0x0010 ECU_ADDRESS 0xFFFF1BA8 READ_WRITE /end MEASUREMENT
/begin MEASUREMENT bfFQLRN "0:実行中でない  1:実行中" UBYTE COMP_0283 1 100 0 1 BIT_MASK 0x0080 ECU_ADDRESS 0xFFFF3C0F READ_WRITE /end MEASUREMENT
/begin MEASUREMENT bfFLOCK "0:不成立  1:急減速信号制御成立" UBYTE COMP_0283 1 100 0 1 BIT_MASK 0x0080 ECU_ADDRESS 0xFFFF3C11 READ_WRITE /end MEASUREMENT
/begin MEASUREMENT bfFPGINH "0:右記以外  1:fPGINHAC=1_or_fPGINHE=1_or_fPGIN" UBYTE COMP_0283 1 100 0 1 BIT_MASK 0x0040 ECU_ADDRESS 0xFFFF3C11 READ_WRITE /end MEASUREMENT
/begin MEASUREMENT bfFSKNK "0:OK  1:NG" UBYTE COMP_0283 1 100 0 1 BIT_MASK 0x0020 ECU_ADDRESS 0xFFFF3C11 READ_WRITE /end MEASUREMENT
/begin MEASUREMENT bfNG "0:OK判定  1:NG判定" UBYTE COMP_0283 1 100 0 1 BIT_MASK 0x0010 ECU_ADDRESS 0xFFFF3C11 READ_WRITE /end MEASUREMENT
/begin MEASUREMENT bfNMIREF "0:MCコマンド処理中  1:MCコマンド処理終了" UBYTE COMP_0283 1 100 0 1 BIT_MASK 0x0008 ECU_ADDRESS 0xFFFF3C11 READ_WRITE /end MEASUREMENT
/begin MEASUREMENT fACADV "0:ACリレーＯＦＦ  1:ACリレーＯＮ" UBYTE COMP_0283 1 100 0 1 BIT_MASK 0x0080 ECU_ADDRESS 0xFFFF1BA9 READ_WRITE /end MEASUREMENT
/begin MEASUREMENT fACCTVO "0:TVO条件不成立  1:TVO条件成立" UBYTE COMP_0283 1 100 0 1 BIT_MASK 0x0040 ECU_ADDRESS 0xFFFF1BA9 READ_WRITE /end MEASUREMENT
/begin MEASUREMENT fACCUT5 "0:カット以外  1:エアコンカット状態" UBYTE COMP_0283 1 100 0 1 BIT_MASK 0x0020 ECU_ADDRESS 0xFFFF1BA9 READ_WRITE /end MEASUREMENT
/begin MEASUREMENT fACDMD "0:リレーOFF要求  1:リレーＯＮ要求" UBYTE COMP_0283 1 100 0 1 BIT_MASK 0x0010 ECU_ADDRESS 0xFFFF1BA9 READ_WRITE /end MEASUREMENT
/begin MEASUREMENT fACOUT0 "0:リレーOFF要求  1:リレーＯＮ要求" UBYTE COMP_0283 1 100 0 1 BIT_MASK 0x0008 ECU_ADDRESS 0xFFFF1BA9 READ_WRITE /end MEASUREMENT
/begin MEASUREMENT fACRLY "0:リレーOFF要求  1:リレーＯＮ要求" UBYTE COMP_0283 1 100 0 1 BIT_MASK 0x0004 ECU_ADDRESS 0xFFFF1BA9 READ_WRITE /end MEASUREMENT
/begin MEASUREMENT fFDTTDST "0:ﾄﾙｸﾀﾞｳﾝ制御中でない  1:ﾄﾙｸﾀﾞｳﾝ制御中" UBYTE COMP_0283 1 100 0 1 BIT_MASK 0x0002 ECU_ADDRESS 0xFFFF1BA9 READ_WRITE /end MEASUREMENT
/begin MEASUREMENT fFITLOCK "0:減速燃料カット中ITリタード制御外  1:減速燃料カット中ITリタード制御中" UBYTE COMP_0283 1 100 0 1 BIT_MASK 0x0001 ECU_ADDRESS 0xFFFF1BA9 READ_WRITE /end MEASUREMENT
/begin MEASUREMENT fFLUOFFN "0:不成立  1:成立" UBYTE COMP_0283 1 100 0 1 BIT_MASK 0x0080 ECU_ADDRESS 0xFFFF1BAA READ_WRITE /end MEASUREMENT
/begin MEASUREMENT fFOVRCHG "0:非過充電  1:過充電" UBYTE COMP_0283 1 100 0 1 BIT_MASK 0x0040 ECU_ADDRESS 0xFFFF1BAA READ_WRITE /end MEASUREMENT
/begin MEASUREMENT fFSTR1 "0:均質  1:成層" UBYTE COMP_0283 1 100 0 1 BIT_MASK 0x0020 ECU_ADDRESS 0xFFFF1BAA READ_WRITE /end MEASUREMENT
/begin MEASUREMENT fFTCVTAD "0:不許可  1:許可" UBYTE COMP_0283 1 100 0 1 BIT_MASK 0x0010 ECU_ADDRESS 0xFFFF1BAA READ_WRITE /end MEASUREMENT
/begin MEASUREMENT fFTITMHL "0:低回転時プレイグ回避制御外  1:低回転時プレイグ回避制御中" UBYTE COMP_0283 1 100 0 1 BIT_MASK 0x0008 ECU_ADDRESS 0xFFFF1BAA READ_WRITE /end MEASUREMENT
/begin MEASUREMENT fFVTCKT "0:VTC最遅角固定判定成立  1:VTC最遅角固定判定不成立" UBYTE COMP_0283 1 100 0 1 BIT_MASK 0x0004 ECU_ADDRESS 0xFFFF1BAA READ_WRITE /end MEASUREMENT
/begin MEASUREMENT fFVTCKTE "0:固定  1:可変" UBYTE COMP_0283 1 100 0 1 BIT_MASK 0x0002 ECU_ADDRESS 0xFFFF1BAA READ_WRITE /end MEASUREMENT
/begin MEASUREMENT fFVTCLRN "0:学習不許可  1:学習許可" UBYTE COMP_0283 1 100 0 1 BIT_MASK 0x0001 ECU_ADDRESS 0xFFFF1BAA READ_WRITE /end MEASUREMENT
/begin MEASUREMENT fFVTCLRNE "0:学習禁止  1:学習許可" UBYTE COMP_0283 1 100 0 1 BIT_MASK 0x0080 ECU_ADDRESS 0xFFFF1BAB READ_WRITE /end MEASUREMENT
/begin MEASUREMENT fHTWLMT "0:条件未成立  1:条件成立" UBYTE COMP_0283 1 100 0 1 BIT_MASK 0x0040 ECU_ADDRESS 0xFFFF1BAB READ_WRITE /end MEASUREMENT
/begin MEASUREMENT fNIEMNUP "0:下限条件非成立  1:下限条件成立" UBYTE COMP_0283 1 100 0 1 BIT_MASK 0x0020 ECU_ADDRESS 0xFFFF1BAB READ_WRITE /end MEASUREMENT
/begin MEASUREMENT fOUTPUT "0:NSET00下限値設定  1:NSET00値_保持" UBYTE COMP_0283 1 100 0 1 BIT_MASK 0x0010 ECU_ADDRESS 0xFFFF1BAB READ_WRITE /end MEASUREMENT
/begin MEASUREMENT fQCK0CP "0:QCK0更新許可  1:QCK0更新不許可" UBYTE COMP_0283 1 100 0 1 BIT_MASK 0x0008 ECU_ADDRESS 0xFFFF1BAB READ_WRITE /end MEASUREMENT
/begin MEASUREMENT fQHOSVTC "0:減速時残留ガス補正有り  1:減速時残留ガス補正無し" UBYTE COMP_0283 1 100 0 1 BIT_MASK 0x0004 ECU_ADDRESS 0xFFFF1BAB READ_WRITE /end MEASUREMENT
/begin MEASUREMENT fRAPACC "0:カット以外  1:エアコンカット状態" UBYTE COMP_0283 1 100 0 1 BIT_MASK 0x0002 ECU_ADDRESS 0xFFFF1BAB READ_WRITE /end MEASUREMENT
/begin MEASUREMENT fREGN "0:回生発電不許可  1:回生発電許可" UBYTE COMP_0283 1 100 0 1 BIT_MASK 0x0001 ECU_ADDRESS 0xFFFF1BAB READ_WRITE /end MEASUREMENT
/begin MEASUREMENT fREVSD "0:右記以外  1:リバース中" UBYTE COMP_0283 1 100 0 1 BIT_MASK 0x0080 ECU_ADDRESS 0xFFFF1BAC READ_WRITE /end MEASUREMENT
/begin MEASUREMENT fVTCIDL "0:低水温ｱｲﾄﾞﾙVTC最遅角固定判定成立  1:低水温ｱｲﾄﾞﾙVTC最遅角固定判定不成" UBYTE COMP_0283 1 100 0 1 BIT_MASK 0x0040 ECU_ADDRESS 0xFFFF1BAC READ_WRITE /end MEASUREMENT
/begin MEASUREMENT fVTCIDLE "0:低水温ｱｲﾄﾞﾙVTC最遅角固定判定成立  1:低水温ｱｲﾄﾞﾙVTC最遅角固定判定不成" UBYTE COMP_0283 1 100 0 1 BIT_MASK 0x0020 ECU_ADDRESS 0xFFFF1BAC READ_WRITE /end MEASUREMENT
/begin MEASUREMENT fFPDONR_S "0:非制御中  1:制御中" UBYTE COMP_0283 1 100 0 1 BIT_MASK 0x0010 ECU_ADDRESS 0xFFFF1BAC READ_WRITE /end MEASUREMENT
/begin MEASUREMENT fA5TP1 "0:tp<mA5TP1(ヒス-1ms)  1:tp≧mA5TP1(ヒス-1ms)" UBYTE COMP_0283 1 100 0 1 BIT_MASK 0x0080 ECU_ADDRESS 0xFFFF1BB1 READ_WRITE /end MEASUREMENT
/begin MEASUREMENT fA5TVO "0:wvTVO<mA5TVO(ヒス-2.8deg)  1:wvTVO≧mA5TVO(ヒス-2.8deg)" UBYTE COMP_0283 1 100 0 1 BIT_MASK 0x0040 ECU_ADDRESS 0xFFFF1BB1 READ_WRITE /end MEASUREMENT
/begin MEASUREMENT fA5TWH "0:wvTWN＜mA5TWH(ヒス-3℃)  1:wvTWN≧mA5TWH(ヒス-3℃)" UBYTE COMP_0283 1 100 0 1 BIT_MASK 0x0020 ECU_ADDRESS 0xFFFF1BB1 READ_WRITE /end MEASUREMENT
/begin MEASUREMENT fACCDMAPO "0:APOST＜ACCDMAPO#(ﾋｽ-2.75deg)  1:APOST≧ACCDMAPO#(ﾋｽ-2.75deg)" UBYTE COMP_0283 1 100 0 1 BIT_MASK 0x0010 ECU_ADDRESS 0xFFFF1BB1 READ_WRITE /end MEASUREMENT
/begin MEASUREMENT fACCUT1 "0:カット以外  1:エアコンカット状態1" UBYTE COMP_0283 1 100 0 1 BIT_MASK 0x0008 ECU_ADDRESS 0xFFFF1BB1 READ_WRITE /end MEASUREMENT
/begin MEASUREMENT fACCUT12 "0:Airconditioner_cut_control_execu  1:エアコンカット状態" UBYTE COMP_0283 1 100 0 1 BIT_MASK 0x0004 ECU_ADDRESS 0xFFFF1BB1 READ_WRITE /end MEASUREMENT
/begin MEASUREMENT fACCUT3 "0:カット以外  1:エアコンカット状態3" UBYTE COMP_0283 1 100 0 1 BIT_MASK 0x0002 ECU_ADDRESS 0xFFFF1BB1 READ_WRITE /end MEASUREMENT
/begin MEASUREMENT fACCUT31 "0:ｶｯﾄ以外  1:ｴｱｺﾝｶｯﾄ状態3" UBYTE COMP_0283 1 100 0 1 BIT_MASK 0x0001 ECU_ADDRESS 0xFFFF1BB1 READ_WRITE /end MEASUREMENT
/begin MEASUREMENT fACCUT32 "0:ｶｯﾄ以外  1:ｴｱｺﾝｶｯﾄ状態3" UBYTE COMP_0283 1 100 0 1 BIT_MASK 0x0080 ECU_ADDRESS 0xFFFF1BB2 READ_WRITE /end MEASUREMENT
/begin MEASUREMENT fACCUT4 "0:カット以外  1:エアコンカット状態4" UBYTE COMP_0283 1 100 0 1 BIT_MASK 0x0040 ECU_ADDRESS 0xFFFF1BB2 READ_WRITE /end MEASUREMENT
/begin MEASUREMENT fACCUT6 "0:カット以外  1:エアコンカット状態" UBYTE COMP_0283 1 100 0 1 BIT_MASK 0x0020 ECU_ADDRESS 0xFFFF1BB2 READ_WRITE /end MEASUREMENT
/begin MEASUREMENT fACCUT9 "0:ｴｱｺﾝｶｯﾄ状態以外  1:ｴｱｺﾝｶｯﾄ状態" UBYTE COMP_0283 1 100 0 1 BIT_MASK 0x0010 ECU_ADDRESS 0xFFFF1BB2 READ_WRITE /end MEASUREMENT
/begin MEASUREMENT fACDTMPH "0:ｴｱｺﾝ要求判定ｴﾊﾞ直温度偏差(High)  1:ｴｱｺﾝ要求判定ｴﾊﾞ直温度偏差(High)" UBYTE COMP_0283 1 100 0 1 BIT_MASK 0x0008 ECU_ADDRESS 0xFFFF1BB2 READ_WRITE /end MEASUREMENT
/begin MEASUREMENT fACDTMPL "0:ｴｱｺﾝ要求判定ｴﾊﾞ直温度偏差(Low)非  1:ｴｱｺﾝ要求判定ｴﾊﾞ直温度偏差(Low)成" UBYTE COMP_0283 1 100 0 1 BIT_MASK 0x0004 ECU_ADDRESS 0xFFFF1BB2 READ_WRITE /end MEASUREMENT
/begin MEASUREMENT fACDTMPM "0:ｴｱｺﾝ要求判定ｴﾊﾞ直温度偏差(Mid)非  1:ｴｱｺﾝ要求判定ｴﾊﾞ直温度偏差(Mid)成" UBYTE COMP_0283 1 100 0 1 BIT_MASK 0x0002 ECU_ADDRESS 0xFFFF1BB2 READ_WRITE /end MEASUREMENT
/begin MEASUREMENT fACLNC "0:解除条件成立  1:制御条件成立" UBYTE COMP_0283 1 100 0 1 BIT_MASK 0x0001 ECU_ADDRESS 0xFFFF1BB2 READ_WRITE /end MEASUREMENT
/begin MEASUREMENT fACLNCS "0:未経験  1:経験" UBYTE COMP_0283 1 100 0 1 BIT_MASK 0x0080 ECU_ADDRESS 0xFFFF1BB3 READ_WRITE /end MEASUREMENT
/begin MEASUREMENT fACNIDY "0:fACSW_Off_->_ON_rest_delay_flag  1:ON" UBYTE COMP_0283 1 100 0 1 BIT_MASK 0x0040 ECU_ADDRESS 0xFFFF1BB3 READ_WRITE /end MEASUREMENT
/begin MEASUREMENT fACSTDY "0:OFF  1:ON" UBYTE COMP_0283 1 100 0 1 BIT_MASK 0x0020 ECU_ADDRESS 0xFFFF1BB3 READ_WRITE /end MEASUREMENT
/begin MEASUREMENT fADD "0:非増加制御  1:増加制御中" UBYTE COMP_0283 1 100 0 1 BIT_MASK 0x0010 ECU_ADDRESS 0xFFFF1BB3 READ_WRITE /end MEASUREMENT
/begin MEASUREMENT fADDCURHS1 "0:ADDCUR2_>_-FSADC2#(+CHGHYS)  1:ADDCUR2_<=_-FSADC2#(+CHGHYS)" UBYTE COMP_0283 1 100 0 1 BIT_MASK 0x0008 ECU_ADDRESS 0xFFFF1BB3 READ_WRITE /end MEASUREMENT
/begin MEASUREMENT fADDCURHS2 "0:ADDCUR2_<=_-FSADC2#(+CHGHYS)__AD  1:-FSADC2#(+CHGHYS)_<_ADDCUR2_<=_-" UBYTE COMP_0283 1 100 0 1 BIT_MASK 0x0004 ECU_ADDRESS 0xFFFF1BB3 READ_WRITE /end MEASUREMENT
/begin MEASUREMENT fADDCURHS3 "0:ADDCUR2_<=_-CCHGADH2#(+CHGHYS)__  1:ADDCUR2_>_-CCHGADL2#(+CHGHYS)" UBYTE COMP_0283 1 100 0 1 BIT_MASK 0x0002 ECU_ADDRESS 0xFFFF1BB3 READ_WRITE /end MEASUREMENT
/begin MEASUREMENT fADTGFAV "0:初回  1:初回以降" UBYTE COMP_0283 1 100 0 1 BIT_MASK 0x0001 ECU_ADDRESS 0xFFFF1BB3 READ_WRITE /end MEASUREMENT
/begin MEASUREMENT fADVALW "0:進角を許可しない  1:進角を許可する" UBYTE COMP_0283 1 100 0 1 BIT_MASK 0x0080 ECU_ADDRESS 0xFFFF1BB4 READ_WRITE /end MEASUREMENT
/begin MEASUREMENT fADVCD5 "0:中水温ﾘﾀｰﾄﾞ未実施  1:中水温ﾘﾀｰﾄﾞ中" UBYTE COMP_0283 1 100 0 1 BIT_MASK 0x0040 ECU_ADDRESS 0xFFFF1BB4 READ_WRITE /end MEASUREMENT
/begin MEASUREMENT fAFKMRH "0:不成立  1:成立" UBYTE COMP_0283 1 100 0 1 BIT_MASK 0x0020 ECU_ADDRESS 0xFFFF1BB4 READ_WRITE /end MEASUREMENT
/begin MEASUREMENT fAFKMRON "0:増量条件不成立  1:増量条件成立" UBYTE COMP_0283 1 100 0 1 BIT_MASK 0x0010 ECU_ADDRESS 0xFFFF1BB4 READ_WRITE /end MEASUREMENT
/begin MEASUREMENT fAFMCANG "0:-  1:-" UBYTE COMP_0283 1 100 0 1 BIT_MASK 0x0008 ECU_ADDRESS 0xFFFF1BB4 READ_WRITE /end MEASUREMENT
/begin MEASUREMENT fAFTMPFS "0:正常  1:故障中" UBYTE COMP_0283 1 100 0 1 BIT_MASK 0x0004 ECU_ADDRESS 0xFFFF1BB4 READ_WRITE /end MEASUREMENT
/begin MEASUREMENT fAJCLUON "0:締結しない  1:締結した" UBYTE COMP_0283 1 100 0 1 BIT_MASK 0x0002 ECU_ADDRESS 0xFFFF1BB4 READ_WRITE /end MEASUREMENT
/begin MEASUREMENT fAJDSFTDT "0:ﾀﾞｳﾝｼﾌﾄしない  1:ﾀﾞｳﾝｼﾌﾄする" UBYTE COMP_0283 1 100 0 1 BIT_MASK 0x0001 ECU_ADDRESS 0xFFFF1BB4 READ_WRITE /end MEASUREMENT
/begin MEASUREMENT fAJOWCOFF "0:OWC開放しない  1:OWC開放した" UBYTE COMP_0283 1 100 0 1 BIT_MASK 0x0080 ECU_ADDRESS 0xFFFF1BB5 READ_WRITE /end MEASUREMENT
/begin MEASUREMENT fAJOWNXGP "0:OWC_NEXT_GPでない  1:OWC_NEXT_GP" UBYTE COMP_0283 1 100 0 1 BIT_MASK 0x0040 ECU_ADDRESS 0xFFFF1BB5 READ_WRITE /end MEASUREMENT
/begin MEASUREMENT fAJTQT0TM "0:保持しない  1:保持した" UBYTE COMP_0283 1 100 0 1 BIT_MASK 0x0020 ECU_ADDRESS 0xFFFF1BB5 READ_WRITE /end MEASUREMENT
/begin MEASUREMENT fALPLMAX "0:非到達  1:到達" UBYTE COMP_0283 1 100 0 1 BIT_MASK 0x0010 ECU_ADDRESS 0xFFFF1BB5 READ_WRITE /end MEASUREMENT
/begin MEASUREMENT fALPLMIN "0:非到達  1:到達" UBYTE COMP_0283 1 100 0 1 BIT_MASK 0x0004 ECU_ADDRESS 0xFFFF1BB5 READ_WRITE /end MEASUREMENT
/begin MEASUREMENT fALTCHK13 "0:オルタネータ発電電圧可変制御条件  1:オルタネータ発電電圧可変制御条件" UBYTE COMP_0283 1 100 0 1 BIT_MASK 0x0001 ECU_ADDRESS 0xFFFF1BB5 READ_WRITE /end MEASUREMENT
/begin MEASUREMENT fALTCHK5 "0:オルタネータ発電可変制御条件5不  1:オルタネータ発電可変制御条件5成" UBYTE COMP_0283 1 100 0 1 BIT_MASK 0x0080 ECU_ADDRESS 0xFFFF1BB6 READ_WRITE /end MEASUREMENT
/begin MEASUREMENT fALTCNTNG "0:オルタネータ発電電圧可変制御許可  1:オルタネータ発電電圧可変制御許可" UBYTE COMP_0283 1 100 0 1 BIT_MASK 0x0040 ECU_ADDRESS 0xFFFF1BB6 READ_WRITE /end MEASUREMENT
/begin MEASUREMENT fALTENGRN "0:不成立  1:高地判定条件(15)成立" UBYTE COMP_0283 1 100 0 1 BIT_MASK 0x0020 ECU_ADDRESS 0xFFFF1BB6 READ_WRITE /end MEASUREMENT
/begin MEASUREMENT fAPSMSF "0:制御条件不成立  1:制御条件成立" UBYTE COMP_0283 1 100 0 1 BIT_MASK 0x0010 ECU_ADDRESS 0xFFFF1BB6 READ_WRITE /end MEASUREMENT
/begin MEASUREMENT fAPSSNG1 "0:不成立  1:成立" UBYTE COMP_0283 1 100 0 1 BIT_MASK 0x0008 ECU_ADDRESS 0xFFFF1BB6 READ_WRITE /end MEASUREMENT
/begin MEASUREMENT fAPSXNG1 "0:不成立  1:成立" UBYTE COMP_0283 1 100 0 1 BIT_MASK 0x0004 ECU_ADDRESS 0xFFFF1BB6 READ_WRITE /end MEASUREMENT
/begin MEASUREMENT fATFULLSW "0:フルスイッチOFF  1:フルスイッチON" UBYTE COMP_0283 1 100 0 1 BIT_MASK 0x0002 ECU_ADDRESS 0xFFFF1BB6 READ_WRITE /end MEASUREMENT
/begin MEASUREMENT fATTRQNG "0:出力トルク正常  1:_出力トルク異常" UBYTE COMP_0283 1 100 0 1 BIT_MASK 0x0001 ECU_ADDRESS 0xFFFF1BB6 READ_WRITE /end MEASUREMENT
/begin MEASUREMENT fBANKAD "0:－  1:－" UBYTE COMP_0283 1 100 0 1 BIT_MASK 0x0080 ECU_ADDRESS 0xFFFF1BB7 READ_WRITE /end MEASUREMENT
/begin MEASUREMENT fBASLRNK0 "0:右記以外  1:更新経験" UBYTE COMP_0283 1 100 0 1 BIT_MASK 0x0040 ECU_ADDRESS 0xFFFF1BB7 READ_WRITE /end MEASUREMENT
/begin MEASUREMENT fBASLRNK0E "0:右記以外  1:更新経験" UBYTE COMP_0283 1 100 0 1 BIT_MASK 0x0020 ECU_ADDRESS 0xFFFF1BB7 READ_WRITE /end MEASUREMENT
/begin MEASUREMENT fBATATMP "0:VSP<=4  1:VSP>4(Hys_+4)" UBYTE COMP_0283 1 100 0 1 BIT_MASK 0x0010 ECU_ADDRESS 0xFFFF1BB7 READ_WRITE /end MEASUREMENT
/begin MEASUREMENT fBATCURK "0:BATCURK<-2(ヒス：-2[A])  1:BATCURK≧-2(ヒス：-2[A])" UBYTE COMP_0283 1 100 0 1 BIT_MASK 0x0008 ECU_ADDRESS 0xFFFF1BB7 READ_WRITE /end MEASUREMENT
/begin MEASUREMENT fBBGJUG "0:条件不成立  1:条件成立" UBYTE COMP_0283 1 100 0 1 BIT_MASK 0x0004 ECU_ADDRESS 0xFFFF1BB7 READ_WRITE /end MEASUREMENT
/begin MEASUREMENT fBLBDEC "0:条件不成立  1:条件成立" UBYTE COMP_0283 1 100 0 1 BIT_MASK 0x0002 ECU_ADDRESS 0xFFFF1BB7 READ_WRITE /end MEASUREMENT
/begin MEASUREMENT fBLBST "0:条件不成立  1:条件成立" UBYTE COMP_0283 1 100 0 1 BIT_MASK 0x0001 ECU_ADDRESS 0xFFFF1BB7 READ_WRITE /end MEASUREMENT
/begin MEASUREMENT fBPCANNG "0:正常  1:故障中" UBYTE COMP_0283 1 100 0 1 BIT_MASK 0x0080 ECU_ADDRESS 0xFFFF1BB8 READ_WRITE /end MEASUREMENT
/begin MEASUREMENT fBRKLUOF "0:急ブレーキ減速判定なし  1:急ブレーキ減速判定あり" UBYTE COMP_0283 1 100 0 1 BIT_MASK 0x0040 ECU_ADDRESS 0xFFFF1BB8 READ_WRITE /end MEASUREMENT
/begin MEASUREMENT fCDCCKOK3 "0:ﾄﾞﾚﾝｶｯﾄ判定条件未成立  1:ﾄﾞﾚﾝｶｯﾄ判定条件成立" UBYTE COMP_0283 1 100 0 1 BIT_MASK 0x0020 ECU_ADDRESS 0xFFFF1BB8 READ_WRITE /end MEASUREMENT
/begin MEASUREMENT fCDCKYOK1 "0:ﾄﾞﾚﾝｶｯﾄ診断(3)許可条件未成立  1:ﾄﾞﾚﾝｶｯﾄ診断(3)許可条件成立" UBYTE COMP_0283 1 100 0 1 BIT_MASK 0x0010 ECU_ADDRESS 0xFFFF1BB8 READ_WRITE /end MEASUREMENT
/begin MEASUREMENT fCDCKYOK2 "0:ﾊﾟｰｼﾞ制御状態未成立  1:ﾊﾟｰｼﾞ制御状態成立" UBYTE COMP_0283 1 100 0 1 BIT_MASK 0x0008 ECU_ADDRESS 0xFFFF1BB8 READ_WRITE /end MEASUREMENT
/begin MEASUREMENT fCDCKYOK3 "0:ﾄﾞﾚﾝｶｯﾄ判定条件未成立  1:ﾄﾞﾚﾝｶｯﾄ判定条件成立" UBYTE COMP_0283 1 100 0 1 BIT_MASK 0x0004 ECU_ADDRESS 0xFFFF1BB8 READ_WRITE /end MEASUREMENT
/begin MEASUREMENT fCHGNGREN "0:ASOVCHGR、OVCHGCUR更新条件不成立  1:ASOVCHGR、OVCHGCUR更新条件成立" UBYTE COMP_0283 1 100 0 1 BIT_MASK 0x0002 ECU_ADDRESS 0xFFFF1BB8 READ_WRITE /end MEASUREMENT
/begin MEASUREMENT fCHGOKHS "0:右記以外  1:バッテリ電流値_BATCURK_≦_CHGOK_" UBYTE COMP_0283 1 100 0 1 BIT_MASK 0x0001 ECU_ADDRESS 0xFFFF1BB8 READ_WRITE /end MEASUREMENT
/begin MEASUREMENT fCHK1ST "0:1回目  1:2回目以降" UBYTE COMP_0283 1 100 0 1 BIT_MASK 0x0080 ECU_ADDRESS 0xFFFF1BB9 READ_WRITE /end MEASUREMENT
/begin MEASUREMENT fCJCYLAZ "0:前回値=0  1:前回値=1" UBYTE COMP_0283 1 100 0 1 BIT_MASK 0x0040 ECU_ADDRESS 0xFFFF1BB9 READ_WRITE /end MEASUREMENT
/begin MEASUREMENT fCKDWTW "0:wvTWN<=mCKDWTW  1:wvTWN>mCKDWTW" UBYTE COMP_0283 1 100 0 1 BIT_MASK 0x0020 ECU_ADDRESS 0xFFFF1BB9 READ_WRITE /end MEASUREMENT
/begin MEASUREMENT fCKLU "0:右記以外  1:L/U判定" UBYTE COMP_0283 1 100 0 1 BIT_MASK 0x0010 ECU_ADDRESS 0xFFFF1BB9 READ_WRITE /end MEASUREMENT
/begin MEASUREMENT fCLTFB0 "0:不成立  1:成立" UBYTE COMP_0283 1 100 0 1 BIT_MASK 0x0008 ECU_ADDRESS 0xFFFF1BB9 READ_WRITE /end MEASUREMENT
/begin MEASUREMENT fCNACNT "0:ｶｳﾝﾄｱｯﾌﾟする  1:ｶｳﾝﾄｱｯﾌﾟしない" UBYTE COMP_0283 1 100 0 1 BIT_MASK 0x0004 ECU_ADDRESS 0xFFFF1BB9 READ_WRITE /end MEASUREMENT
/begin MEASUREMENT fCSSTCAN "0:許可  1:不許可" UBYTE COMP_0283 1 100 0 1 BIT_MASK 0x0002 ECU_ADDRESS 0xFFFF1BB9 READ_WRITE /end MEASUREMENT
/begin MEASUREMENT fCSSTON "0:START_SW_ON経験なし  1:START_SW_ON経験あり" UBYTE COMP_0283 1 100 0 1 BIT_MASK 0x0001 ECU_ADDRESS 0xFFFF1BB9 READ_WRITE /end MEASUREMENT
/begin MEASUREMENT fDACOFL "0:VAPO変化量条件不成立  1:VAPO変化量条件成立" UBYTE COMP_0283 1 100 0 1 BIT_MASK 0x0080 ECU_ADDRESS 0xFFFF1BBA READ_WRITE /end MEASUREMENT
/begin MEASUREMENT fDACONL "0:VAPO変化量条件不成立  1:VAPO変化量条件成立" UBYTE COMP_0283 1 100 0 1 BIT_MASK 0x0040 ECU_ADDRESS 0xFFFF1BBA READ_WRITE /end MEASUREMENT
/begin MEASUREMENT fDADVIDL "0:条件不成立  1:条件成立" UBYTE COMP_0283 1 100 0 1 BIT_MASK 0x0020 ECU_ADDRESS 0xFFFF1BBA READ_WRITE /end MEASUREMENT
/begin MEASUREMENT fDCVNGCD "0:ドレンカット/V機能診断未NG  1:ドレンカット/V機能診断NG" UBYTE COMP_0283 1 100 0 1 BIT_MASK 0x0010 ECU_ADDRESS 0xFFFF1BBA READ_WRITE /end MEASUREMENT
/begin MEASUREMENT fDCVNGD "0:ドレンカット/V機能診断1ステージ2  1:ドレンカット/V機能診断1ステージ2" UBYTE COMP_0283 1 100 0 1 BIT_MASK 0x0008 ECU_ADDRESS 0xFFFF1BBA READ_WRITE /end MEASUREMENT
/begin MEASUREMENT fDEMDOUT "0:不成立  1:成立" UBYTE COMP_0283 1 100 0 1 BIT_MASK 0x0004 ECU_ADDRESS 0xFFFF1BBA READ_WRITE /end MEASUREMENT
/begin MEASUREMENT fDIGNENG "0:不成立  1:成立" UBYTE COMP_0283 1 100 0 1 BIT_MASK 0x0002 ECU_ADDRESS 0xFFFF1BBA READ_WRITE /end MEASUREMENT
/begin MEASUREMENT fDLFLUP1 "0:(_#IDLE==0_)&&ロックアップ制御中  1:左記以外" UBYTE COMP_0283 1 100 0 1 BIT_MASK 0x0001 ECU_ADDRESS 0xFFFF1BBA READ_WRITE /end MEASUREMENT
/begin MEASUREMENT fDLTADV "0:条件不成立  1:条件成立" UBYTE COMP_0283 1 100 0 1 BIT_MASK 0x0080 ECU_ADDRESS 0xFFFF1BBB READ_WRITE /end MEASUREMENT
/begin MEASUREMENT fDLURPM "0:MNRPM<=DLURPM#(ヒス:+50[rpm])  1:左記以外" UBYTE COMP_0283 1 100 0 1 BIT_MASK 0x0040 ECU_ADDRESS 0xFFFF1BBB READ_WRITE /end MEASUREMENT
/begin MEASUREMENT fDLV2BON "0:不成立  1:成立" UBYTE COMP_0283 1 100 0 1 BIT_MASK 0x0020 ECU_ADDRESS 0xFFFF1BBB READ_WRITE /end MEASUREMENT
/begin MEASUREMENT fDLV2SON "0:不成立  1:成立" UBYTE COMP_0283 1 100 0 1 BIT_MASK 0x0010 ECU_ADDRESS 0xFFFF1BBB READ_WRITE /end MEASUREMENT
/begin MEASUREMENT fDLVSP "0:ロックアップ許可信号車速条件不成  1:ロックアップ許可信号車速条件成立" UBYTE COMP_0283 1 100 0 1 BIT_MASK 0x0008 ECU_ADDRESS 0xFFFF1BBB READ_WRITE /end MEASUREMENT
/begin MEASUREMENT fDLVSP1 "0:VSP<=DLVSP1#(ヒス:+4[km/h])  1:左記以外" UBYTE COMP_0283 1 100 0 1 BIT_MASK 0x0004 ECU_ADDRESS 0xFFFF1BBB READ_WRITE /end MEASUREMENT
/begin MEASUREMENT fDLVSP2 "0:VSP<=DLVSP2#(ヒス:+4[km/h])  1:左記以外" UBYTE COMP_0283 1 100 0 1 BIT_MASK 0x0002 ECU_ADDRESS 0xFFFF1BBB READ_WRITE /end MEASUREMENT
/begin MEASUREMENT fDLVSP2B "0:CVT車種以外の場合VSP<=DLVSP2B(ヒ  1:左記以外" UBYTE COMP_0283 1 100 0 1 BIT_MASK 0x0001 ECU_ADDRESS 0xFFFF1BBB READ_WRITE /end MEASUREMENT
/begin MEASUREMENT fDLVSPB "0:VSP<=DLVSPB#(ヒス:+4[km/h])  1:左記以外" UBYTE COMP_0283 1 100 0 1 BIT_MASK 0x0080 ECU_ADDRESS 0xFFFF1BBC READ_WRITE /end MEASUREMENT
/begin MEASUREMENT fDMPOK "0:使用不許可  1:使用許可" UBYTE COMP_0283 1 100 0 1 BIT_MASK 0x0040 ECU_ADDRESS 0xFFFF1BBC READ_WRITE /end MEASUREMENT
/begin MEASUREMENT fDMPOKE "0:使用不許可  1:使用許可" UBYTE COMP_0283 1 100 0 1 BIT_MASK 0x0020 ECU_ADDRESS 0xFFFF1BBC READ_WRITE /end MEASUREMENT
/begin MEASUREMENT fDSHCUT "0:水温条件不成立  1:水温条件成立" UBYTE COMP_0283 1 100 0 1 BIT_MASK 0x0010 ECU_ADDRESS 0xFFFF1BBC READ_WRITE /end MEASUREMENT
/begin MEASUREMENT fDSHVSP "0:ダッシュポッド切替判定不成立  1:ダッシュポッド切替判定成立" UBYTE COMP_0283 1 100 0 1 BIT_MASK 0x0008 ECU_ADDRESS 0xFFFF1BBC READ_WRITE /end MEASUREMENT
/begin MEASUREMENT fDTEVPS "0:右記以外  1:DUTYUPプルダウン制御要求によるEV" UBYTE COMP_0283 1 100 0 1 BIT_MASK 0x0004 ECU_ADDRESS 0xFFFF1BBC READ_WRITE /end MEASUREMENT
/begin MEASUREMENT fDTFCN "0:HNRPM≧mDTFCN(Hys_+300rpm)  1:HNRPM<mDTFCN(Hys_+300rpm)" UBYTE COMP_0283 1 100 0 1 BIT_MASK 0x0002 ECU_ADDRESS 0xFFFF1BBC READ_WRITE /end MEASUREMENT
/begin MEASUREMENT fDTFCTV "0:TVO≧mDTFCTV(Hys_+4.2deg)  1:TVO<mDTFCTV(Hys_+4.2deg)" UBYTE COMP_0283 1 100 0 1 BIT_MASK 0x0001 ECU_ADDRESS 0xFFFF1BBC READ_WRITE /end MEASUREMENT
/begin MEASUREMENT fDTFCTW "0:TWN≧mDTFCTW(Hys_+2)  1:TWN<mDTFCTW(Hys_+2)" UBYTE COMP_0283 1 100 0 1 BIT_MASK 0x0080 ECU_ADDRESS 0xFFFF1BBD READ_WRITE /end MEASUREMENT
/begin MEASUREMENT fDTWLUI "0:TWN<DTWLUI#:ヒス+4[℃]  1:左記以外" UBYTE COMP_0283 1 100 0 1 BIT_MASK 0x0040 ECU_ADDRESS 0xFFFF1BBD READ_WRITE /end MEASUREMENT
/begin MEASUREMENT fDTWLUI2 "0:未成立  1:成立" UBYTE COMP_0283 1 100 0 1 BIT_MASK 0x0020 ECU_ADDRESS 0xFFFF1BBD READ_WRITE /end MEASUREMENT
/begin MEASUREMENT fDUETTE "0:DUETTE制御不許可  1:DUETTE制御許可" UBYTE COMP_0283 1 100 0 1 BIT_MASK 0x0010 ECU_ADDRESS 0xFFFF1BBD READ_WRITE /end MEASUREMENT
/begin MEASUREMENT fDUTRTD "0:-  1:-" UBYTE COMP_0283 1 100 0 1 BIT_MASK 0x0008 ECU_ADDRESS 0xFFFF1BBD READ_WRITE /end MEASUREMENT
/begin MEASUREMENT fDVAPO40 "0:右記以外  1:VAPO変化量条件成立" UBYTE COMP_0283 1 100 0 1 BIT_MASK 0x0004 ECU_ADDRESS 0xFFFF1BBD READ_WRITE /end MEASUREMENT
/begin MEASUREMENT fDVF1ST "0:DVFUEL初回算出未実施  1:DVFUEL初回算出実施" UBYTE COMP_0283 1 100 0 1 BIT_MASK 0x0001 ECU_ADDRESS 0xFFFF1BBD READ_WRITE /end MEASUREMENT
/begin MEASUREMENT fDYNDOWN "0:急減速判定不成立  1:急減速判定成立" UBYTE COMP_0283 1 100 0 1 BIT_MASK 0x0080 ECU_ADDRESS 0xFFFF1BBE READ_WRITE /end MEASUREMENT
/begin MEASUREMENT fENSTST "0:始動時補正制御未許可  1:始動時補正制御許可" UBYTE COMP_0283 1 100 0 1 BIT_MASK 0x0040 ECU_ADDRESS 0xFFFF1BBE READ_WRITE /end MEASUREMENT
/begin MEASUREMENT fENSTST1 "0:始動時補正制御未許可判定  1:始動時補正制御許可判定" UBYTE COMP_0283 1 100 0 1 BIT_MASK 0x0020 ECU_ADDRESS 0xFFFF1BBE READ_WRITE /end MEASUREMENT
/begin MEASUREMENT fENSTST2 "0:始動時補正制御未許可判定  1:始動時補正制御許可判定" UBYTE COMP_0283 1 100 0 1 BIT_MASK 0x0010 ECU_ADDRESS 0xFFFF1BBE READ_WRITE /end MEASUREMENT
/begin MEASUREMENT fERROROPE "0:正常  1:異常" UBYTE COMP_0283 1 100 0 1 BIT_MASK 0x0008 ECU_ADDRESS 0xFFFF1BBE READ_WRITE /end MEASUREMENT
/begin MEASUREMENT fEXNFC "0:全気筒ｶｯﾄせず  1:全気筒ｶｯﾄ" UBYTE COMP_0283 1 100 0 1 BIT_MASK 0x0004 ECU_ADDRESS 0xFFFF1BBE READ_WRITE /end MEASUREMENT
/begin MEASUREMENT fEXNFCJG "0:不成立  1:成立" UBYTE COMP_0283 1 100 0 1 BIT_MASK 0x0002 ECU_ADDRESS 0xFFFF1BBE READ_WRITE /end MEASUREMENT
/begin MEASUREMENT fEXNFCTM "0:不成立  1:成立" UBYTE COMP_0283 1 100 0 1 BIT_MASK 0x0001 ECU_ADDRESS 0xFFFF1BBE READ_WRITE /end MEASUREMENT
/begin MEASUREMENT fF10MSBGJ "0:非実行中  1:実行中" UBYTE COMP_0283 1 100 0 1 BIT_MASK 0x0080 ECU_ADDRESS 0xFFFF1BBF READ_WRITE /end MEASUREMENT
/begin MEASUREMENT fF2INJGO "0:不成立  1:成立" UBYTE COMP_0283 1 100 0 1 BIT_MASK 0x0040 ECU_ADDRESS 0xFFFF1BBF READ_WRITE /end MEASUREMENT
/begin MEASUREMENT fFA5 "0:mA5CNGをプラス  1:mA5CNGをマイナス" UBYTE COMP_0283 1 100 0 1 BIT_MASK 0x0020 ECU_ADDRESS 0xFFFF1BBF READ_WRITE /end MEASUREMENT
/begin MEASUREMENT fFAACOF "0:(発注ﾅｼ)  1:(発注ﾅｼ)" UBYTE COMP_0283 1 100 0 1 BIT_MASK 0x0010 ECU_ADDRESS 0xFFFF1BBF READ_WRITE /end MEASUREMENT
/begin MEASUREMENT fFANHPF "0:不成立  1:成立" UBYTE COMP_0283 1 100 0 1 BIT_MASK 0x0008 ECU_ADDRESS 0xFFFF1BBF READ_WRITE /end MEASUREMENT
/begin MEASUREMENT fFAPLT1 "0:制御条件不成立  1:制御条件成立" UBYTE COMP_0283 1 100 0 1 BIT_MASK 0x0004 ECU_ADDRESS 0xFFFF1BBF READ_WRITE /end MEASUREMENT
/begin MEASUREMENT fFAPLT2 "0:制御条件不成立  1:制御条件成立" UBYTE COMP_0283 1 100 0 1 BIT_MASK 0x0002 ECU_ADDRESS 0xFFFF1BBF READ_WRITE /end MEASUREMENT
/begin MEASUREMENT fFAPLT3 "0:制御条件不成立  1:制御条件成立" UBYTE COMP_0283 1 100 0 1 BIT_MASK 0x0001 ECU_ADDRESS 0xFFFF1BBF READ_WRITE /end MEASUREMENT
/begin MEASUREMENT fFAPLT4 "0:制御条件不成立  1:制御条件成立" UBYTE COMP_0283 1 100 0 1 BIT_MASK 0x0080 ECU_ADDRESS 0xFFFF1BC0 READ_WRITE /end MEASUREMENT
/begin MEASUREMENT fFAPLTA "0:制御条件不成立  1:制御条件成立" UBYTE COMP_0283 1 100 0 1 BIT_MASK 0x0040 ECU_ADDRESS 0xFFFF1BC0 READ_WRITE /end MEASUREMENT
/begin MEASUREMENT fFATVAS "0:右記以外  1:VAPO変化量異常" UBYTE COMP_0283 1 100 0 1 BIT_MASK 0x0020 ECU_ADDRESS 0xFFFF1BC0 READ_WRITE /end MEASUREMENT
/begin MEASUREMENT fFATVO "0:wvDTVOP<mFATVO(ヒス-2.8deg)  1:wvDTVOP≧mFATVO(ヒス-2.8deg)" UBYTE COMP_0283 1 100 0 1 BIT_MASK 0x0010 ECU_ADDRESS 0xFFFF1BC0 READ_WRITE /end MEASUREMENT
/begin MEASUREMENT fFAVEPPSV "0:右記以外  1:初回処理実行" UBYTE COMP_0283 1 100 0 1 BIT_MASK 0x0008 ECU_ADDRESS 0xFFFF1BC0 READ_WRITE /end MEASUREMENT
/begin MEASUREMENT fFCD "0:右記以外  1:燃料カット条件成立後初回" UBYTE COMP_0283 1 100 0 1 BIT_MASK 0x0004 ECU_ADDRESS 0xFFFF1BC0 READ_WRITE /end MEASUREMENT
/begin MEASUREMENT fFCUTFG "0:ﾛｯｸｱｯﾌﾟ時でのﾃﾞｨﾚｲ時間設定  1:非ﾛｯｸｱｯﾌﾟ時でのﾃﾞｨﾚｲ時間設定" UBYTE COMP_0283 1 100 0 1 BIT_MASK 0x0002 ECU_ADDRESS 0xFFFF1BC0 READ_WRITE /end MEASUREMENT
/begin MEASUREMENT fFCUTPHB "0:不成立  1:成立" UBYTE COMP_0283 1 100 0 1 BIT_MASK 0x0001 ECU_ADDRESS 0xFFFF1BC0 READ_WRITE /end MEASUREMENT
/begin MEASUREMENT fFDCRKSTB "0:経験なし  1:経験あり" UBYTE COMP_0283 1 100 0 1 BIT_MASK 0x0080 ECU_ADDRESS 0xFFFF1BC1 READ_WRITE /end MEASUREMENT
/begin MEASUREMENT fFDCV3HNT "0:しない  1:する" UBYTE COMP_0283 1 100 0 1 BIT_MASK 0x0040 ECU_ADDRESS 0xFFFF1BC1 READ_WRITE /end MEASUREMENT
/begin MEASUREMENT fFDIRE8 "0:右記以外  1:判定後制御DIREI8使用" UBYTE COMP_0283 1 100 0 1 BIT_MASK 0x0020 ECU_ADDRESS 0xFFFF1BC1 READ_WRITE /end MEASUREMENT
/begin MEASUREMENT fFDTFCSEL "0:ﾘﾀｰﾄﾞ制御  1:燃料ｶｯﾄ" UBYTE COMP_0283 1 100 0 1 BIT_MASK 0x0010 ECU_ADDRESS 0xFFFF1BC1 READ_WRITE /end MEASUREMENT
/begin MEASUREMENT fFDTTD "0:トルクダウン制御許可  1:トルクダウン制御禁止" UBYTE COMP_0283 1 100 0 1 BIT_MASK 0x0008 ECU_ADDRESS 0xFFFF1BC1 READ_WRITE /end MEASUREMENT
/begin MEASUREMENT fFESYSCON "0:PCVST5開度未終了  1:PCVST5開度終了" UBYTE COMP_0283 1 100 0 1 BIT_MASK 0x0004 ECU_ADDRESS 0xFFFF1BC1 READ_WRITE /end MEASUREMENT
/begin MEASUREMENT fFESYSDP "0:診断許可条件未成立  1:診断許可条件成立" UBYTE COMP_0283 1 100 0 1 BIT_MASK 0x0002 ECU_ADDRESS 0xFFFF1BC1 READ_WRITE /end MEASUREMENT
/begin MEASUREMENT fFEVCMON1 "0:初回  1:２回目以降" UBYTE COMP_0283 1 100 0 1 BIT_MASK 0x0001 ECU_ADDRESS 0xFFFF1BC1 READ_WRITE /end MEASUREMENT
/begin MEASUREMENT fFEVMON1 "0:EPRS11モニタ不成立  1:EPRS11モニタ成立" UBYTE COMP_0283 1 100 0 1 BIT_MASK 0x0080 ECU_ADDRESS 0xFFFF1BC2 READ_WRITE /end MEASUREMENT
/begin MEASUREMENT fFEVMON2 "0:EPRS12モニタ不成立  1:EPRS12モニタ成立" UBYTE COMP_0283 1 100 0 1 BIT_MASK 0x0040 ECU_ADDRESS 0xFFFF1BC2 READ_WRITE /end MEASUREMENT
/begin MEASUREMENT fFEVSST2 "0:EPRS21モニタ不成立  1:EPRS21モニタ成立" UBYTE COMP_0283 1 100 0 1 BIT_MASK 0x0020 ECU_ADDRESS 0xFFFF1BC2 READ_WRITE /end MEASUREMENT
/begin MEASUREMENT fFEVSTG12 "0:ステージ1→2未開始  1:ステージ1→2開始" UBYTE COMP_0283 1 100 0 1 BIT_MASK 0x0010 ECU_ADDRESS 0xFFFF1BC2 READ_WRITE /end MEASUREMENT
/begin MEASUREMENT fFFIR1 "0:FIR制御非実行  1:FIR制御実行" UBYTE COMP_0283 1 100 0 1 BIT_MASK 0x0008 ECU_ADDRESS 0xFFFF1BC2 READ_WRITE /end MEASUREMENT
/begin MEASUREMENT fFFR "0:mFRCNGをプラス  1:mFRCNGをマイナス" UBYTE COMP_0283 1 100 0 1 BIT_MASK 0x0004 ECU_ADDRESS 0xFFFF1BC2 READ_WRITE /end MEASUREMENT
/begin MEASUREMENT fFHINJL "0:NO  1:YES" UBYTE COMP_0283 1 100 0 1 BIT_MASK 0x0002 ECU_ADDRESS 0xFFFF1BC2 READ_WRITE /end MEASUREMENT
/begin MEASUREMENT fFHINJR "0:NO  1:YES" UBYTE COMP_0283 1 100 0 1 BIT_MASK 0x0001 ECU_ADDRESS 0xFFFF1BC2 READ_WRITE /end MEASUREMENT
/begin MEASUREMENT fFIUP "0:DUETTEアイドルアップ要求なし  1:DUEETEアイドルアップ要求あり" UBYTE COMP_0283 1 100 0 1 BIT_MASK 0x0080 ECU_ADDRESS 0xFFFF1BC3 READ_WRITE /end MEASUREMENT
/begin MEASUREMENT fFIUP1 "0:DUETTEアイドルアップ要求なし  1:DUEETEアイドルアップ要求あり" UBYTE COMP_0283 1 100 0 1 BIT_MASK 0x0040 ECU_ADDRESS 0xFFFF1BC3 READ_WRITE /end MEASUREMENT
/begin MEASUREMENT fFIUPHNT "0:終了  1:開始" UBYTE COMP_0283 1 100 0 1 BIT_MASK 0x0020 ECU_ADDRESS 0xFFFF1BC3 READ_WRITE /end MEASUREMENT
/begin MEASUREMENT fFKHABS "0:KHOT変化幅負  1:KHOT変化幅正" UBYTE COMP_0283 1 100 0 1 BIT_MASK 0x0010 ECU_ADDRESS 0xFFFF1BC3 READ_WRITE /end MEASUREMENT
/begin MEASUREMENT fFKMRDTO "0:ΔTVO大による増量時以外  1:ΔTVO大による増量時" UBYTE COMP_0283 1 100 0 1 BIT_MASK 0x0008 ECU_ADDRESS 0xFFFF1BC3 READ_WRITE /end MEASUREMENT
/begin MEASUREMENT fFKMRLM "0:KMRマップ値使用時以外  1:KMRマップ値使用" UBYTE COMP_0283 1 100 0 1 BIT_MASK 0x0004 ECU_ADDRESS 0xFFFF1BC3 READ_WRITE /end MEASUREMENT
/begin MEASUREMENT fFKMRLM1 "0:TFBYA0≠KMRM  1:TFBYA0＝KMRM" UBYTE COMP_0283 1 100 0 1 BIT_MASK 0x0002 ECU_ADDRESS 0xFFFF1BC3 READ_WRITE /end MEASUREMENT
/begin MEASUREMENT fFKSTBLMD "0:経験なし  1:経験あり" UBYTE COMP_0283 1 100 0 1 BIT_MASK 0x0001 ECU_ADDRESS 0xFFFF1BC3 READ_WRITE /end MEASUREMENT
/begin MEASUREMENT fFLG20MS "0:20ms未経過  1:20ms経過" UBYTE COMP_0283 1 100 0 1 BIT_MASK 0x0080 ECU_ADDRESS 0xFFFF1BC4 READ_WRITE /end MEASUREMENT
/begin MEASUREMENT fFLMCSTTW "0:経験なし  1:経験あり" UBYTE COMP_0283 1 100 0 1 BIT_MASK 0x0040 ECU_ADDRESS 0xFFFF1BC4 READ_WRITE /end MEASUREMENT
/begin MEASUREMENT fFLNEFST "0:未設定  1:設定" UBYTE COMP_0283 1 100 0 1 BIT_MASK 0x0020 ECU_ADDRESS 0xFFFF1BC4 READ_WRITE /end MEASUREMENT
/begin MEASUREMENT fFLOWOILP "0:右記以外  1:油圧低下状態成立" UBYTE COMP_0283 1 100 0 1 BIT_MASK 0x0010 ECU_ADDRESS 0xFFFF1BC4 READ_WRITE /end MEASUREMENT
/begin MEASUREMENT fFLOWOPKY "0:右記以外  1:許可条件成立" UBYTE COMP_0283 1 100 0 1 BIT_MASK 0x0008 ECU_ADDRESS 0xFFFF1BC4 READ_WRITE /end MEASUREMENT
/begin MEASUREMENT fFLRNACT "0:学習実行不許可  1:学習実行許可" UBYTE COMP_0283 1 100 0 1 BIT_MASK 0x0004 ECU_ADDRESS 0xFFFF1BC4 READ_WRITE /end MEASUREMENT
/begin MEASUREMENT fFLU "0:ﾛｯｸｱｯﾌﾟ判定不成立  1:ﾛｯｸｱｯﾌﾟ判定成立" UBYTE COMP_0283 1 100 0 1 BIT_MASK 0x0002 ECU_ADDRESS 0xFFFF1BC4 READ_WRITE /end MEASUREMENT
/begin MEASUREMENT fFLUON "0:ﾛｯｸｱｯﾌﾟ判定不成立  1:ﾛｯｸｱｯﾌﾟ判定成立" UBYTE COMP_0283 1 100 0 1 BIT_MASK 0x0001 ECU_ADDRESS 0xFFFF1BC4 READ_WRITE /end MEASUREMENT
/begin MEASUREMENT fFLUPGAKU "0:REF_間⊿N_点火時期制御用ﾛｯｸｱｯﾌﾟ  1:REF_間⊿N_点火時期制御用ﾛｯｸｱｯﾌﾟ" UBYTE COMP_0283 1 100 0 1 BIT_MASK 0x0080 ECU_ADDRESS 0xFFFF1BC5 READ_WRITE /end MEASUREMENT
/begin MEASUREMENT fFLUPHIS "0:未経験  1:経験" UBYTE COMP_0283 1 100 0 1 BIT_MASK 0x0040 ECU_ADDRESS 0xFFFF1BC5 READ_WRITE /end MEASUREMENT
/begin MEASUREMENT fFMSTINJK "0:未経験  1:経験" UBYTE COMP_0283 1 100 0 1 BIT_MASK 0x0020 ECU_ADDRESS 0xFFFF1BC5 READ_WRITE /end MEASUREMENT
/begin MEASUREMENT fFPCTHS "0:FPCM水温条件成立  1:FPCM水温条件不成立" UBYTE COMP_0283 1 100 0 1 BIT_MASK 0x0010 ECU_ADDRESS 0xFFFF1BC5 READ_WRITE /end MEASUREMENT
/begin MEASUREMENT fFPHTOS "0:_アイドル安定判定条件不成立  1:_アイドル安定判定条件成立" UBYTE COMP_0283 1 100 0 1 BIT_MASK 0x0008 ECU_ADDRESS 0xFFFF1BC5 READ_WRITE /end MEASUREMENT
/begin MEASUREMENT fFPRESM "0:EVPRES非モニタ  1:EVPRESモニタ" UBYTE COMP_0283 1 100 0 1 BIT_MASK 0x0004 ECU_ADDRESS 0xFFFF1BC5 READ_WRITE /end MEASUREMENT
/begin MEASUREMENT fFPRSMON1 "0:初回でない  1:初回である" UBYTE COMP_0283 1 100 0 1 BIT_MASK 0x0002 ECU_ADDRESS 0xFFFF1BC5 READ_WRITE /end MEASUREMENT
/begin MEASUREMENT fFPTDONR "0:非制御中  1:制御中" UBYTE COMP_0283 1 100 0 1 BIT_MASK 0x0001 ECU_ADDRESS 0xFFFF1BC5 READ_WRITE /end MEASUREMENT
/begin MEASUREMENT fFPTNHI "0:条件不成立  1:条件成立" UBYTE COMP_0283 1 100 0 1 BIT_MASK 0x0080 ECU_ADDRESS 0xFFFF1BC6 READ_WRITE /end MEASUREMENT
/begin MEASUREMENT fFQBLRN "0:不成立  1:成立" UBYTE COMP_0283 1 100 0 1 BIT_MASK 0x0040 ECU_ADDRESS 0xFFFF1BC6 READ_WRITE /end MEASUREMENT
/begin MEASUREMENT fFQCAL "0:不成立  1:成立" UBYTE COMP_0283 1 100 0 1 BIT_MASK 0x0020 ECU_ADDRESS 0xFFFF1BC6 READ_WRITE /end MEASUREMENT
/begin MEASUREMENT fFQH0LMT "0:vTQH0TE＜vQH0LMT(ﾋｽ-mDQH0LMT)  1:vTQH0TE≧vQH0LMT(ﾋｽ-mDQH0LMT)" UBYTE COMP_0283 1 100 0 1 BIT_MASK 0x0010 ECU_ADDRESS 0xFFFF1BC6 READ_WRITE /end MEASUREMENT
/begin MEASUREMENT fFRMKN "0:wvMNRPM<mFRMNK(ヒス-200rpm)  1:wvMNRPM≧mFRMNK(ヒス-200rpm)" UBYTE COMP_0283 1 100 0 1 BIT_MASK 0x0008 ECU_ADDRESS 0xFFFF1BC6 READ_WRITE /end MEASUREMENT
/begin MEASUREMENT fFRMKS "0:未満  1:以上" UBYTE COMP_0283 1 100 0 1 BIT_MASK 0x0004 ECU_ADDRESS 0xFFFF1BC6 READ_WRITE /end MEASUREMENT
/begin MEASUREMENT fFRTM1 "0:SW切切り替えなし  1:SW切切り替えあり" UBYTE COMP_0283 1 100 0 1 BIT_MASK 0x0002 ECU_ADDRESS 0xFFFF1BC6 READ_WRITE /end MEASUREMENT
/begin MEASUREMENT fFRTM2 "0:経過前  1:ディレイ経過後" UBYTE COMP_0283 1 100 0 1 BIT_MASK 0x0001 ECU_ADDRESS 0xFFFF1BC6 READ_WRITE /end MEASUREMENT
/begin MEASUREMENT fFRVSP "0:wvVSP<4km/h(ヒス+4km/h)  1:wvVSP≧4km/h(ヒス+4km/h)" UBYTE COMP_0283 1 100 0 1 BIT_MASK 0x0080 ECU_ADDRESS 0xFFFF1BC7 READ_WRITE /end MEASUREMENT
/begin MEASUREMENT fFRVSP1 "0:VSP<FRVSP1#(ヒス:+4[km/h])  1:左記以外" UBYTE COMP_0283 1 100 0 1 BIT_MASK 0x0040 ECU_ADDRESS 0xFFFF1BC7 READ_WRITE /end MEASUREMENT
/begin MEASUREMENT fFSAFMNG "0:AFM_正常  1:AFM_異常" UBYTE COMP_0283 1 100 0 1 BIT_MASK 0x0020 ECU_ADDRESS 0xFFFF1BC7 READ_WRITE /end MEASUREMENT
/begin MEASUREMENT fFSAFMNGZ "0:AFMﾌｪｰﾙｾｰﾌ検出なし  1:AFMﾌｪｰﾙｾｰﾌ検出あり" UBYTE COMP_0283 1 100 0 1 BIT_MASK 0x0010 ECU_ADDRESS 0xFFFF1BC7 READ_WRITE /end MEASUREMENT
/begin MEASUREMENT fFSCVD "0:SCV_OFF(ﾃﾞｨﾚｲ付)  1:SCV_ON(ﾃﾞｨﾚｲ付)" UBYTE COMP_0283 1 100 0 1 BIT_MASK 0x0008 ECU_ADDRESS 0xFFFF1BC7 READ_WRITE /end MEASUREMENT
/begin MEASUREMENT fFSCVID "0:IDLE/SW_ON→OFF判定前  1:IDLE/SW_ON→OFF判定済" UBYTE COMP_0283 1 100 0 1 BIT_MASK 0x0004 ECU_ADDRESS 0xFFFF1BC7 READ_WRITE /end MEASUREMENT
/begin MEASUREMENT fFSCVITR "0:SCV閉時ITリタード要求無し  1:SCV閉時ITリタード要求有り" UBYTE COMP_0283 1 100 0 1 BIT_MASK 0x0002 ECU_ADDRESS 0xFFFF1BC7 READ_WRITE /end MEASUREMENT
/begin MEASUREMENT fFSHYSTW "0:条件不成立  1:条件成立" UBYTE COMP_0283 1 100 0 1 BIT_MASK 0x0001 ECU_ADDRESS 0xFFFF1BC7 READ_WRITE /end MEASUREMENT
/begin MEASUREMENT fFSLPDEC0 "0:SLPDEC0演算条件成立未経験  1:SLPDEC0演算条件成立経験済" UBYTE COMP_0283 1 100 0 1 BIT_MASK 0x0080 ECU_ADDRESS 0xFFFF1BC8 READ_WRITE /end MEASUREMENT
/begin MEASUREMENT fFSTRDL "0:ディレイ時間外  1:ディレイ時間中" UBYTE COMP_0283 1 100 0 1 BIT_MASK 0x0040 ECU_ADDRESS 0xFFFF1BC8 READ_WRITE /end MEASUREMENT
/begin MEASUREMENT fFSTRETYUZ "0:右記以外  1:切り替え中" UBYTE COMP_0283 1 100 0 1 BIT_MASK 0x0020 ECU_ADDRESS 0xFFFF1BC8 READ_WRITE /end MEASUREMENT
/begin MEASUREMENT fFSTRKIN "0:右記以外  1:均質始動要求成立" UBYTE COMP_0283 1 100 0 1 BIT_MASK 0x0010 ECU_ADDRESS 0xFFFF1BC8 READ_WRITE /end MEASUREMENT
/begin MEASUREMENT fFSTTI "0:始動初期噴射条件不成立  1:始動初期噴射条件成立" UBYTE COMP_0283 1 100 0 1 BIT_MASK 0x0008 ECU_ADDRESS 0xFFFF1BC8 READ_WRITE /end MEASUREMENT
/begin MEASUREMENT fFTCVDTTM "0:ﾃﾞﾊﾞｲｽﾃｽﾄ時間を経過中  1:ﾃﾞﾊﾞｲｽﾃｽﾄ時間を経過後" UBYTE COMP_0283 1 100 0 1 BIT_MASK 0x0004 ECU_ADDRESS 0xFFFF1BC8 READ_WRITE /end MEASUREMENT
/begin MEASUREMENT fFTCVNLR "0:N/Lレーシング条件不成立  1:N/Lレーシング条件成立" UBYTE COMP_0283 1 100 0 1 BIT_MASK 0x0002 ECU_ADDRESS 0xFFFF1BC8 READ_WRITE /end MEASUREMENT
/begin MEASUREMENT fFTCVQLN "0:学習不許可  1:学習許可" UBYTE COMP_0283 1 100 0 1 BIT_MASK 0x0001 ECU_ADDRESS 0xFFFF1BC8 READ_WRITE /end MEASUREMENT
/begin MEASUREMENT fFTCVTBF "0:開状態  1:閉状態" UBYTE COMP_0283 1 100 0 1 BIT_MASK 0x0080 ECU_ADDRESS 0xFFFF1BC9 READ_WRITE /end MEASUREMENT
/begin MEASUREMENT fFTMISSL "0:過渡補正時間ﾀｲﾏｽﾀｰﾄ未経験  1:過渡補正時間ﾀｲﾏｽﾀｰﾄ経験済" UBYTE COMP_0283 1 100 0 1 BIT_MASK 0x0040 ECU_ADDRESS 0xFFFF1BC9 READ_WRITE /end MEASUREMENT
/begin MEASUREMENT fFTQH0IF "0:vTQH0IF＜vQH0LMT(ﾋｽ-mDQH0LMT)  1:vTQH0IF≧vQH0LMT(ﾋｽ-mDQH0LMT)" UBYTE COMP_0283 1 100 0 1 BIT_MASK 0x0020 ECU_ADDRESS 0xFFFF1BC9 READ_WRITE /end MEASUREMENT
/begin MEASUREMENT fFTQTNDYN "0:不成立  1:成立" UBYTE COMP_0283 1 100 0 1 BIT_MASK 0x0010 ECU_ADDRESS 0xFFFF1BC9 READ_WRITE /end MEASUREMENT
/begin MEASUREMENT fFTSPH "0:制御条件不成立  1:制御条件成立" UBYTE COMP_0283 1 100 0 1 BIT_MASK 0x0008 ECU_ADDRESS 0xFFFF1BC9 READ_WRITE /end MEASUREMENT
/begin MEASUREMENT fFUKEBK "0:FUKE=0  1:FUKE=1" UBYTE COMP_0283 1 100 0 1 BIT_MASK 0x0004 ECU_ADDRESS 0xFFFF1BC9 READ_WRITE /end MEASUREMENT
/begin MEASUREMENT fFUKEBNC "0:未経験  1:経験" UBYTE COMP_0283 1 100 0 1 BIT_MASK 0x0002 ECU_ADDRESS 0xFFFF1BC9 READ_WRITE /end MEASUREMENT
/begin MEASUREMENT fFUKEBRK "0:未経験  1:経験" UBYTE COMP_0283 1 100 0 1 BIT_MASK 0x0001 ECU_ADDRESS 0xFFFF1BC9 READ_WRITE /end MEASUREMENT
/begin MEASUREMENT fFUKECH "0:不成立  1:成立" UBYTE COMP_0283 1 100 0 1 BIT_MASK 0x0080 ECU_ADDRESS 0xFFFF1BCA READ_WRITE /end MEASUREMENT
/begin MEASUREMENT fFUKEIDLE "0:右記以外  1:IDLE_0→1切り換え" UBYTE COMP_0283 1 100 0 1 BIT_MASK 0x0040 ECU_ADDRESS 0xFFFF1BCA READ_WRITE /end MEASUREMENT
/begin MEASUREMENT fFUKEST "0:不成立  1:成立" UBYTE COMP_0283 1 100 0 1 BIT_MASK 0x0020 ECU_ADDRESS 0xFFFF1BCA READ_WRITE /end MEASUREMENT
/begin MEASUREMENT fFUNLOCKT "0:計測中止  1:計測中" UBYTE COMP_0283 1 100 0 1 BIT_MASK 0x0010 ECU_ADDRESS 0xFFFF1BCA READ_WRITE /end MEASUREMENT
/begin MEASUREMENT fFVTCOK "0:VTC作動不可能  1:VTC作動可能" UBYTE COMP_0283 1 100 0 1 BIT_MASK 0x0008 ECU_ADDRESS 0xFFFF1BCA READ_WRITE /end MEASUREMENT
/begin MEASUREMENT fFVTCOKE "0:駆動禁止  1:駆動許可" UBYTE COMP_0283 1 100 0 1 BIT_MASK 0x0004 ECU_ADDRESS 0xFFFF1BCA READ_WRITE /end MEASUREMENT
/begin MEASUREMENT fGAKADVA "0:GAKUADVA初期値演算経験なし  1:GAKUADVA初期値演算経験あり" UBYTE COMP_0283 1 100 0 1 BIT_MASK 0x0002 ECU_ADDRESS 0xFFFF1BCA READ_WRITE /end MEASUREMENT
/begin MEASUREMENT fGAKADVR "0:GAKUADVR初期値演算経験なし  1:GAKUADVR初期値演算経験あり" UBYTE COMP_0283 1 100 0 1 BIT_MASK 0x0001 ECU_ADDRESS 0xFFFF1BCA READ_WRITE /end MEASUREMENT
/begin MEASUREMENT fGAKU "0:加速時ADV位相制御＜DLTNAV版＞  1:REF間⊿N点火時期ﾌｨｰﾄﾞﾊﾞｯｸ制御" UBYTE COMP_0283 1 100 0 1 BIT_MASK 0x0080 ECU_ADDRESS 0xFFFF1BCB READ_WRITE /end MEASUREMENT
/begin MEASUREMENT fGAKUFC "0:加速前非燃料カット  1:加速前燃料カット" UBYTE COMP_0283 1 100 0 1 BIT_MASK 0x0040 ECU_ADDRESS 0xFFFF1BCB READ_WRITE /end MEASUREMENT
/begin MEASUREMENT fGAKUON0 "0:条件不成立  1:条件成立" UBYTE COMP_0283 1 100 0 1 BIT_MASK 0x0020 ECU_ADDRESS 0xFFFF1BCB READ_WRITE /end MEASUREMENT
/begin MEASUREMENT fGAKUON1 "0:条件不成立  1:条件成立" UBYTE COMP_0283 1 100 0 1 BIT_MASK 0x0010 ECU_ADDRESS 0xFFFF1BCB READ_WRITE /end MEASUREMENT
/begin MEASUREMENT fGAKURIE "0:初期リタード量算出期間未終了  1:初期リタード量算出期間終了" UBYTE COMP_0283 1 100 0 1 BIT_MASK 0x0008 ECU_ADDRESS 0xFFFF1BCB READ_WRITE /end MEASUREMENT
/begin MEASUREMENT fGENTRA "0:GENMODE＿_2_->_5_遷移なし  1:GENMODE＿_2_->_5_遷移あり" UBYTE COMP_0283 1 100 0 1 BIT_MASK 0x0004 ECU_ADDRESS 0xFFFF1BCB READ_WRITE /end MEASUREMENT
/begin MEASUREMENT fGHFSCV "0:GHFSCV=0  1:GHFSCV演算可" UBYTE COMP_0283 1 100 0 1 BIT_MASK 0x0002 ECU_ADDRESS 0xFFFF1BCB READ_WRITE /end MEASUREMENT
/begin MEASUREMENT fGNDSLCTW "0:始動後ﾘｰﾝ限界拡大制中N-Dｾﾚｸﾄ以外  1:始動後ﾘｰﾝ限界拡大制中N-Dｾﾚｸﾄ中" UBYTE COMP_0283 1 100 0 1 BIT_MASK 0x0001 ECU_ADDRESS 0xFFFF1BCB READ_WRITE /end MEASUREMENT
/begin MEASUREMENT fGOVFLAG "0:GOVDMPﾃﾞｨｸﾘﾒﾝﾄ処理実行しない  1:GOVDMPﾃﾞｨｸﾘﾒﾝﾄ処理実行する" UBYTE COMP_0283 1 100 0 1 BIT_MASK 0x0080 ECU_ADDRESS 0xFFFF1BCC READ_WRITE /end MEASUREMENT
/begin MEASUREMENT fGSCVZ "0:GHF用SCVz=0  1:GHF用SCVz=1" UBYTE COMP_0283 1 100 0 1 BIT_MASK 0x0040 ECU_ADDRESS 0xFFFF1BCC READ_WRITE /end MEASUREMENT
/begin MEASUREMENT fGUILLO "0:ｷﾞﾛﾁﾝ解除  1:ｷﾞﾛﾁﾝ発生" UBYTE COMP_0283 1 100 0 1 BIT_MASK 0x0020 ECU_ADDRESS 0xFFFF1BCC READ_WRITE /end MEASUREMENT
/begin MEASUREMENT fGUILLOE "0:ｷﾞﾛﾁﾝ解除  1:ｷﾞﾛﾁﾝ発生" UBYTE COMP_0283 1 100 0 1 BIT_MASK 0x0010 ECU_ADDRESS 0xFFFF1BCC READ_WRITE /end MEASUREMENT
/begin MEASUREMENT fHACONPH "0:wvPDPREN<=mACONPH  1:wvPDPREN>mACONPH" UBYTE COMP_0283 1 100 0 1 BIT_MASK 0x0008 ECU_ADDRESS 0xFFFF1BCC READ_WRITE /end MEASUREMENT
/begin MEASUREMENT fHACONPL "0:wvPDPREN>=mACONPL  1:wvPDPREN<mACONPL" UBYTE COMP_0283 1 100 0 1 BIT_MASK 0x0004 ECU_ADDRESS 0xFFFF1BCC READ_WRITE /end MEASUREMENT
/begin MEASUREMENT fHNDLYTWN "0:右記以外  1:TWN≧NDLYTWN#_(ﾋｽ：-3)" UBYTE COMP_0283 1 100 0 1 BIT_MASK 0x0002 ECU_ADDRESS 0xFFFF1BCC READ_WRITE /end MEASUREMENT
/begin MEASUREMENT fHPDGNPR "0:不成立  1:成立" UBYTE COMP_0283 1 100 0 1 BIT_MASK 0x0001 ECU_ADDRESS 0xFFFF1BCC READ_WRITE /end MEASUREMENT
/begin MEASUREMENT fHPFJDG "0:不成立  1:成立" UBYTE COMP_0283 1 100 0 1 BIT_MASK 0x0080 ECU_ADDRESS 0xFFFF1BCD READ_WRITE /end MEASUREMENT
/begin MEASUREMENT fIBPFS "0:正常  1:故障中" UBYTE COMP_0283 1 100 0 1 BIT_MASK 0x0040 ECU_ADDRESS 0xFFFF1BCD READ_WRITE /end MEASUREMENT
/begin MEASUREMENT fIDELAYC "0:ディレイ経過前  1:ディレイ経過後" UBYTE COMP_0283 1 100 0 1 BIT_MASK 0x0020 ECU_ADDRESS 0xFFFF1BCD READ_WRITE /end MEASUREMENT
/begin MEASUREMENT fIDELAYCZ "0:ディレイ経過前  1:ディレイ経過後" UBYTE COMP_0283 1 100 0 1 BIT_MASK 0x0010 ECU_ADDRESS 0xFFFF1BCD READ_WRITE /end MEASUREMENT
/begin MEASUREMENT fIDLOFK "0:SLPDEC0演算条件IDLE_OFF未経験  1:SLPDEC0演算条件IDLE_OFF経験" UBYTE COMP_0283 1 100 0 1 BIT_MASK 0x0008 ECU_ADDRESS 0xFFFF1BCD READ_WRITE /end MEASUREMENT
/begin MEASUREMENT fIDVDLY2 "0:使用不許可  1:使用許可" UBYTE COMP_0283 1 100 0 1 BIT_MASK 0x0004 ECU_ADDRESS 0xFFFF1BCD READ_WRITE /end MEASUREMENT
/begin MEASUREMENT fIDVDLYE "0:使用不許可  1:使用許可" UBYTE COMP_0283 1 100 0 1 BIT_MASK 0x0002 ECU_ADDRESS 0xFFFF1BCD READ_WRITE /end MEASUREMENT
/begin MEASUREMENT fIDVSTSW "0:ｽﾀｰﾀSW経験未  1:ｽﾀｰﾀSW経験済" UBYTE COMP_0283 1 100 0 1 BIT_MASK 0x0001 ECU_ADDRESS 0xFFFF1BCD READ_WRITE /end MEASUREMENT
/begin MEASUREMENT fIDVTNEL "0:mIDVTNEL>wvLNRPM(ﾋｽ-200rpm)  1:mIDVTNEL≦wvLNRPM(ﾋｽ-200rpm)" UBYTE COMP_0283 1 100 0 1 BIT_MASK 0x0080 ECU_ADDRESS 0xFFFF1BCE READ_WRITE /end MEASUREMENT
/begin MEASUREMENT fIDVTTAH "0:mIDVTTAH≦wvTAN(ﾋｽ-3℃)  1:mIDVTTAH＞wvTAN(ﾋｽ-3℃)" UBYTE COMP_0283 1 100 0 1 BIT_MASK 0x0040 ECU_ADDRESS 0xFFFF1BCE READ_WRITE /end MEASUREMENT
/begin MEASUREMENT fIDVTTAL "0:mIDVTTAL＞wvTAN(ﾋｽ-3℃)  1:mIDVTTAL≦wvTAN(ﾋｽ-3℃)" UBYTE COMP_0283 1 100 0 1 BIT_MASK 0x0020 ECU_ADDRESS 0xFFFF1BCE READ_WRITE /end MEASUREMENT
/begin MEASUREMENT fIDVTTOH "0:mIDVTTOH＞wvTVTOIL(ﾋｽ+3℃)  1:mIDVTTOH≦wvTVTOIL(ﾋｽ+3℃)" UBYTE COMP_0283 1 100 0 1 BIT_MASK 0x0010 ECU_ADDRESS 0xFFFF1BCE READ_WRITE /end MEASUREMENT
/begin MEASUREMENT fIDVTTOHE "0:mIDVTTOHE＞wvTVTOIL(ﾋｽ+3℃)  1:mIDVTTOHE≦wvTVTOIL(ﾋｽ+3℃)" UBYTE COMP_0283 1 100 0 1 BIT_MASK 0x0008 ECU_ADDRESS 0xFFFF1BCE READ_WRITE /end MEASUREMENT
/begin MEASUREMENT fIDVTTOL "0:mIDVTTOL≧wvTVTOIL(ﾋｽ-3℃)  1:mIDVTTOL＜wvTVTOIL(ﾋｽ-3℃)" UBYTE COMP_0283 1 100 0 1 BIT_MASK 0x0004 ECU_ADDRESS 0xFFFF1BCE READ_WRITE /end MEASUREMENT
/begin MEASUREMENT fIDVTTOLE "0:mIDVTTOLE≧wvTVTOIL(ﾋｽ-3℃)  1:mIDVTTOLE＜wvTVTOIL(ﾋｽ-3℃)" UBYTE COMP_0283 1 100 0 1 BIT_MASK 0x0002 ECU_ADDRESS 0xFFFF1BCE READ_WRITE /end MEASUREMENT
/begin MEASUREMENT fIDVTTP "0:mIDVTTP＞wvTP  1:mIDVTTP≦wvTP" UBYTE COMP_0283 1 100 0 1 BIT_MASK 0x0001 ECU_ADDRESS 0xFFFF1BCE READ_WRITE /end MEASUREMENT
/begin MEASUREMENT fIDVTTWH "0:mIDVTTWL≧wvTWN(ﾋｽ-3℃)  1:mIDVTTWL<wvTWN(ﾋｽ-3℃)" UBYTE COMP_0283 1 100 0 1 BIT_MASK 0x0080 ECU_ADDRESS 0xFFFF1BCF READ_WRITE /end MEASUREMENT
/begin MEASUREMENT fIDVTTWH2 "0:wvTWN>mIDVTTWH2(ﾋｽ+3℃)  1:wvTWN≦mIDVTTWH2(ﾋｽ+3℃)" UBYTE COMP_0283 1 100 0 1 BIT_MASK 0x0040 ECU_ADDRESS 0xFFFF1BCF READ_WRITE /end MEASUREMENT
/begin MEASUREMENT fIDVTTWHE "0:wvTWN>mIDVTTWHE(ﾋｽ+3℃)  1:wvTWN≦mIDVTTWHE(ﾋｽ+3℃)" UBYTE COMP_0283 1 100 0 1 BIT_MASK 0x0020 ECU_ADDRESS 0xFFFF1BCF READ_WRITE /end MEASUREMENT
/begin MEASUREMENT fIDVTTWL "0:wvTWN>mIDVTTWH(ﾋｽ+3℃)  1:wvTWN≦mIDVTTWH(ﾋｽ+3℃)" UBYTE COMP_0283 1 100 0 1 BIT_MASK 0x0010 ECU_ADDRESS 0xFFFF1BCF READ_WRITE /end MEASUREMENT
/begin MEASUREMENT fIDVTTWL2 "0:mIDVTTWL2≧wvTWN(ﾋｽ-3℃)  1:mIDVTTWL2<wvTWN(ﾋｽ-3℃)" UBYTE COMP_0283 1 100 0 1 BIT_MASK 0x0008 ECU_ADDRESS 0xFFFF1BCF READ_WRITE /end MEASUREMENT
/begin MEASUREMENT fIDVTTWLE "0:mIDVTTWLE≧wvTWN(ﾋｽ-3℃)  1:mIDVTTWLE<wvTWN(ﾋｽ-3℃)" UBYTE COMP_0283 1 100 0 1 BIT_MASK 0x0004 ECU_ADDRESS 0xFFFF1BCF READ_WRITE /end MEASUREMENT
/begin MEASUREMENT fIGKEEP "0:IGAIN保持しない  1:IGAIN保持する" UBYTE COMP_0283 1 100 0 1 BIT_MASK 0x0002 ECU_ADDRESS 0xFFFF1BCF READ_WRITE /end MEASUREMENT
/begin MEASUREMENT fINJDPRB "0:許可  1:禁止" UBYTE COMP_0283 1 100 0 1 BIT_MASK 0x0001 ECU_ADDRESS 0xFFFF1BCF READ_WRITE /end MEASUREMENT
/begin MEASUREMENT fINV "0:インバースフィルタ制御無効  1:インバースフィルタ制御有効" UBYTE COMP_0283 1 100 0 1 BIT_MASK 0x0080 ECU_ADDRESS 0xFFFF1BD0 READ_WRITE /end MEASUREMENT
/begin MEASUREMENT fISCACRD "0:状態変化有り  1:状態変化無し" UBYTE COMP_0283 1 100 0 1 BIT_MASK 0x0040 ECU_ADDRESS 0xFFFF1BD0 READ_WRITE /end MEASUREMENT
/begin MEASUREMENT fISCFBZ2 "0:ISC_OPEN(前回値)  1:ISC_CLOSE(前回値)" UBYTE COMP_0283 1 100 0 1 BIT_MASK 0x0020 ECU_ADDRESS 0xFFFF1BD0 READ_WRITE /end MEASUREMENT
/begin MEASUREMENT fISCID "0:開始ディレイ経過前  1:開始ディレイ経過後" UBYTE COMP_0283 1 100 0 1 BIT_MASK 0x0010 ECU_ADDRESS 0xFFFF1BD0 READ_WRITE /end MEASUREMENT
/begin MEASUREMENT fISCLRC "0:学習条件不成立  1:学習条件成立" UBYTE COMP_0283 1 100 0 1 BIT_MASK 0x0008 ECU_ADDRESS 0xFFFF1BD0 READ_WRITE /end MEASUREMENT
/begin MEASUREMENT fISCPA2 "0:vPAMB＜mISCPA2(ﾋｽ+25mV)  1:vPAMB≧mISCPA2(ﾋｽ+25mV)" UBYTE COMP_0283 1 100 0 1 BIT_MASK 0x0004 ECU_ADDRESS 0xFFFF1BD0 READ_WRITE /end MEASUREMENT
/begin MEASUREMENT fISCPAT "0:vPAMB＜mISCPAT(ﾋｽ+25mV)  1:vPAMB≧mISCPAT(ﾋｽ+25mV)" UBYTE COMP_0283 1 100 0 1 BIT_MASK 0x0002 ECU_ADDRESS 0xFFFF1BD0 READ_WRITE /end MEASUREMENT
/begin MEASUREMENT fISCPSH "0:許可  1:不許可" UBYTE COMP_0283 1 100 0 1 BIT_MASK 0x0001 ECU_ADDRESS 0xFFFF1BD0 READ_WRITE /end MEASUREMENT
/begin MEASUREMENT fISR1ST "0:初回  1:初回以外" UBYTE COMP_0283 1 100 0 1 BIT_MASK 0x0080 ECU_ADDRESS 0xFFFF1BD1 READ_WRITE /end MEASUREMENT
/begin MEASUREMENT fISRBUF "0:学習演算開始ディレイ前  1:ディレイ後" UBYTE COMP_0283 1 100 0 1 BIT_MASK 0x0040 ECU_ADDRESS 0xFFFF1BD1 READ_WRITE /end MEASUREMENT
/begin MEASUREMENT fISRTM "0:学習演算開始ディレイ前  1:ディレイ後" UBYTE COMP_0283 1 100 0 1 BIT_MASK 0x0020 ECU_ADDRESS 0xFFFF1BD1 READ_WRITE /end MEASUREMENT
/begin MEASUREMENT fITLOCKN "0:不成立  1:成立" UBYTE COMP_0283 1 100 0 1 BIT_MASK 0x0010 ECU_ADDRESS 0xFFFF1BD1 READ_WRITE /end MEASUREMENT
/begin MEASUREMENT fITVSHYS "0:不成立  1:成立" UBYTE COMP_0283 1 100 0 1 BIT_MASK 0x0008 ECU_ADDRESS 0xFFFF1BD1 READ_WRITE /end MEASUREMENT
/begin MEASUREMENT fJKGKRTO "0:ｖRATIO_<=_mJKGKRTO(ﾋｽ+mJKGKRTHY  1:ｖRATIO_<=_mJKGKRTO(ﾋｽ+mJKGKRTHY" UBYTE COMP_0283 1 100 0 1 BIT_MASK 0x0004 ECU_ADDRESS 0xFFFF1BD1 READ_WRITE /end MEASUREMENT
/begin MEASUREMENT fJKGKVSPH "0:ｖHRVSP_<=_mJKGKVSPH(ﾋｽ+mJKGKVHY  1:ｖHRVSP_<=_mJKGKVSPH(ﾋｽ+mJKGKVHY" UBYTE COMP_0283 1 100 0 1 BIT_MASK 0x0002 ECU_ADDRESS 0xFFFF1BD1 READ_WRITE /end MEASUREMENT
/begin MEASUREMENT fJKGKVSPL "0:ｖHRVSP_>=_mJKGKVSPL(ﾋｽ-mJKGKVHY  1:ｖHRVSP_>=_mJKGKVSPL(ﾋｽ-mJKGKVHY" UBYTE COMP_0283 1 100 0 1 BIT_MASK 0x0001 ECU_ADDRESS 0xFFFF1BD1 READ_WRITE /end MEASUREMENT
/begin MEASUREMENT fKCADV1ST "0:KCRADV初期化していない  1:KCRADV初期化済み" UBYTE COMP_0283 1 100 0 1 BIT_MASK 0x0080 ECU_ADDRESS 0xFFFF1BD2 READ_WRITE /end MEASUREMENT
/begin MEASUREMENT fKCRADVON "0:KCRADV未演算  1:KCRADV演算" UBYTE COMP_0283 1 100 0 1 BIT_MASK 0x0040 ECU_ADDRESS 0xFFFF1BD2 READ_WRITE /end MEASUREMENT
/begin MEASUREMENT fKHRPHYS "0:MNRPM<KHOTMNE  1:MNRPM>=KHOTMNE" UBYTE COMP_0283 1 100 0 1 BIT_MASK 0x0020 ECU_ADDRESS 0xFFFF1BD2 READ_WRITE /end MEASUREMENT
/begin MEASUREMENT fKHTRPTW "0:KHOT演算条件不成立  1:KHOT演算条件成立" UBYTE COMP_0283 1 100 0 1 BIT_MASK 0x0010 ECU_ADDRESS 0xFFFF1BD2 READ_WRITE /end MEASUREMENT
/begin MEASUREMENT fKHTTHYS "0:水温条件2不成立  1:水温条件2成立" UBYTE COMP_0283 1 100 0 1 BIT_MASK 0x0008 ECU_ADDRESS 0xFFFF1BD2 READ_WRITE /end MEASUREMENT
/begin MEASUREMENT fKHTTRG "0:KHOT初回演算未  1:KHOT初回演算済み" UBYTE COMP_0283 1 100 0 1 BIT_MASK 0x0004 ECU_ADDRESS 0xFFFF1BD2 READ_WRITE /end MEASUREMENT
/begin MEASUREMENT fKHTWHYS "0:水温条件1不成立  1:水温条件1成立" UBYTE COMP_0283 1 100 0 1 BIT_MASK 0x0002 ECU_ADDRESS 0xFFFF1BD2 READ_WRITE /end MEASUREMENT
/begin MEASUREMENT fKMRGP "0:不成立  1:成立" UBYTE COMP_0283 1 100 0 1 BIT_MASK 0x0001 ECU_ADDRESS 0xFFFF1BD2 READ_WRITE /end MEASUREMENT
/begin MEASUREMENT fKMRNE1 "0:不成立  1:成立" UBYTE COMP_0283 1 100 0 1 BIT_MASK 0x0080 ECU_ADDRESS 0xFFFF1BD3 READ_WRITE /end MEASUREMENT
/begin MEASUREMENT fKMRNE2 "0:不成立  1:成立" UBYTE COMP_0283 1 100 0 1 BIT_MASK 0x0040 ECU_ADDRESS 0xFFFF1BD3 READ_WRITE /end MEASUREMENT
/begin MEASUREMENT fKMRNE3 "0:不成立  1:成立" UBYTE COMP_0283 1 100 0 1 BIT_MASK 0x0020 ECU_ADDRESS 0xFFFF1BD3 READ_WRITE /end MEASUREMENT
/begin MEASUREMENT fKMRNE4 "0:KMRディレイ制御禁止  1:KMRディレイ制御許可" UBYTE COMP_0283 1 100 0 1 BIT_MASK 0x0010 ECU_ADDRESS 0xFFFF1BD3 READ_WRITE /end MEASUREMENT
/begin MEASUREMENT fKMRVSP "0:不成立  1:成立" UBYTE COMP_0283 1 100 0 1 BIT_MASK 0x0008 ECU_ADDRESS 0xFFFF1BD3 READ_WRITE /end MEASUREMENT
/begin MEASUREMENT fKNSTRT "0:ﾉｯｸ制御開始条件不成立  1:ﾉｯｸ制御開始条件成立" UBYTE COMP_0283 1 100 0 1 BIT_MASK 0x0004 ECU_ADDRESS 0xFFFF1BD3 READ_WRITE /end MEASUREMENT
/begin MEASUREMENT fKNTBL "0:ノック領域以外  1:ノック領域" UBYTE COMP_0283 1 100 0 1 BIT_MASK 0x0002 ECU_ADDRESS 0xFFFF1BD3 READ_WRITE /end MEASUREMENT
/begin MEASUREMENT fL2PFMAXH "0:不成立  1:成立" UBYTE COMP_0283 1 100 0 1 BIT_MASK 0x0001 ECU_ADDRESS 0xFFFF1BD3 READ_WRITE /end MEASUREMENT
/begin MEASUREMENT fL2PFMINH "0:不成立  1:成立" UBYTE COMP_0283 1 100 0 1 BIT_MASK 0x0080 ECU_ADDRESS 0xFFFF1BD4 READ_WRITE /end MEASUREMENT
/begin MEASUREMENT fL2PFMINH2 "0:不成立  1:成立" UBYTE COMP_0283 1 100 0 1 BIT_MASK 0x0040 ECU_ADDRESS 0xFFFF1BD4 READ_WRITE /end MEASUREMENT
/begin MEASUREMENT fLCSTVB "0:不成立  1:VB条件成立" UBYTE COMP_0283 1 100 0 1 BIT_MASK 0x0020 ECU_ADDRESS 0xFFFF1BD4 READ_WRITE /end MEASUREMENT
/begin MEASUREMENT fLFPFB "0:不成立  1:成立" UBYTE COMP_0283 1 100 0 1 BIT_MASK 0x0010 ECU_ADDRESS 0xFFFF1BD4 READ_WRITE /end MEASUREMENT
/begin MEASUREMENT fLMDCLSAD "0:－  1:－" UBYTE COMP_0283 1 100 0 1 BIT_MASK 0x0008 ECU_ADDRESS 0xFFFF1BD4 READ_WRITE /end MEASUREMENT
/begin MEASUREMENT fLMDCLSPK "0:－  1:－" UBYTE COMP_0283 1 100 0 1 BIT_MASK 0x0004 ECU_ADDRESS 0xFFFF1BD4 READ_WRITE /end MEASUREMENT
/begin MEASUREMENT fLPFJDG "0:不成立  1:成立" UBYTE COMP_0283 1 100 0 1 BIT_MASK 0x0002 ECU_ADDRESS 0xFFFF1BD4 READ_WRITE /end MEASUREMENT
/begin MEASUREMENT fLRCSET "0:不成立  1:学習条件成立" UBYTE COMP_0283 1 100 0 1 BIT_MASK 0x0001 ECU_ADDRESS 0xFFFF1BD4 READ_WRITE /end MEASUREMENT
/begin MEASUREMENT fLRCSET2 "0:減算以外  1:減算側" UBYTE COMP_0283 1 100 0 1 BIT_MASK 0x0080 ECU_ADDRESS 0xFFFF1BD5 READ_WRITE /end MEASUREMENT
/begin MEASUREMENT fLRNADP "0:禁止以外  1:禁止" UBYTE COMP_0283 1 100 0 1 BIT_MASK 0x0040 ECU_ADDRESS 0xFFFF1BD5 READ_WRITE /end MEASUREMENT
/begin MEASUREMENT fLRNANGE "0:ﾘﾐｯﾀ値OK  1:ﾘﾐｯﾀ値NG" UBYTE COMP_0283 1 100 0 1 BIT_MASK 0x0020 ECU_ADDRESS 0xFFFF1BD5 READ_WRITE /end MEASUREMENT
/begin MEASUREMENT fLTIST "0:不成立  1:成立" UBYTE COMP_0283 1 100 0 1 BIT_MASK 0x0010 ECU_ADDRESS 0xFFFF1BD5 READ_WRITE /end MEASUREMENT
/begin MEASUREMENT fLTIST0 "0:初回  1:初回以外" UBYTE COMP_0283 1 100 0 1 BIT_MASK 0x0008 ECU_ADDRESS 0xFFFF1BD5 READ_WRITE /end MEASUREMENT
/begin MEASUREMENT fMKSTSW "0:ST/SW_ON_未経験  1:ST/SW_ON_経験" UBYTE COMP_0283 1 100 0 1 BIT_MASK 0x0004 ECU_ADDRESS 0xFFFF1BD5 READ_WRITE /end MEASUREMENT
/begin MEASUREMENT fMKTVO "0:未満  1:以上" UBYTE COMP_0283 1 100 0 1 BIT_MASK 0x0002 ECU_ADDRESS 0xFFFF1BD5 READ_WRITE /end MEASUREMENT
/begin MEASUREMENT fMKVSP "0:未満  1:以上" UBYTE COMP_0283 1 100 0 1 BIT_MASK 0x0001 ECU_ADDRESS 0xFFFF1BD5 READ_WRITE /end MEASUREMENT
/begin MEASUREMENT fMODE4JUG "0:不成立  1:成立" UBYTE COMP_0283 1 100 0 1 BIT_MASK 0x0080 ECU_ADDRESS 0xFFFF1BD6 READ_WRITE /end MEASUREMENT
/begin MEASUREMENT fN1000 "0:N<1000  1:N>=1000" UBYTE COMP_0283 1 100 0 1 BIT_MASK 0x0040 ECU_ADDRESS 0xFFFF1BD6 READ_WRITE /end MEASUREMENT
/begin MEASUREMENT fNALTDWN "0:電気負荷小補正空気量条件非成立  1:電気負荷小補正空気量成立" UBYTE COMP_0283 1 100 0 1 BIT_MASK 0x0020 ECU_ADDRESS 0xFFFF1BD6 READ_WRITE /end MEASUREMENT
/begin MEASUREMENT fNALTUP "0:電気負荷大補正量非成立  1:電気負荷大補正量成立" UBYTE COMP_0283 1 100 0 1 BIT_MASK 0x0010 ECU_ADDRESS 0xFFFF1BD6 READ_WRITE /end MEASUREMENT
/begin MEASUREMENT fNCHKC "0:不成立  1:回転数条件成立" UBYTE COMP_0283 1 100 0 1 BIT_MASK 0x0008 ECU_ADDRESS 0xFFFF1BD6 READ_WRITE /end MEASUREMENT
/begin MEASUREMENT fNDCUT "0:N->Dｾﾚｸﾄ全気筒ﾘｶﾊﾞ  1:N->Dｾﾚｸﾄ全気筒ｶｯﾄ" UBYTE COMP_0283 1 100 0 1 BIT_MASK 0x0004 ECU_ADDRESS 0xFFFF1BD6 READ_WRITE /end MEASUREMENT
/begin MEASUREMENT fNEJIRITM "0:不成立  1:成立" UBYTE COMP_0283 1 100 0 1 BIT_MASK 0x0002 ECU_ADDRESS 0xFFFF1BD6 READ_WRITE /end MEASUREMENT
/begin MEASUREMENT fNESMPF "0:HNRPM_＞_NESMPF#(ﾋｽ;-NESMHYS#)  1:HNRPM_≦_NESMPF#(ﾋｽ;-NESMHYS#)" UBYTE COMP_0283 1 100 0 1 BIT_MASK 0x0001 ECU_ADDRESS 0xFFFF1BD6 READ_WRITE /end MEASUREMENT
/begin MEASUREMENT fNEUPOK "0:不許可  1:許可" UBYTE COMP_0283 1 100 0 1 BIT_MASK 0x0080 ECU_ADDRESS 0xFFFF1BD7 READ_WRITE /end MEASUREMENT
/begin MEASUREMENT fNEUPOKST "0:未経験  1:経験" UBYTE COMP_0283 1 100 0 1 BIT_MASK 0x0040 ECU_ADDRESS 0xFFFF1BD7 READ_WRITE /end MEASUREMENT
/begin MEASUREMENT fNEUTDCHG "0:右記以外  1:#NEUTD_1->0_切り換りのﾃﾞｨﾚｲ中" UBYTE COMP_0283 1 100 0 1 BIT_MASK 0x0020 ECU_ADDRESS 0xFFFF1BD7 READ_WRITE /end MEASUREMENT
/begin MEASUREMENT fNIACDY "0:fNIDLE_Off_->_ON_or_ON_->_Off_re  1:ON" UBYTE COMP_0283 1 100 0 1 BIT_MASK 0x0010 ECU_ADDRESS 0xFFFF1BD7 READ_WRITE /end MEASUREMENT
/begin MEASUREMENT fNICLOFIR "0:vINPREV_≦_mNICLOFIR  1:vINPREV_>_mNICLOFIR" UBYTE COMP_0283 1 100 0 1 BIT_MASK 0x0008 ECU_ADDRESS 0xFFFF1BD7 READ_WRITE /end MEASUREMENT
/begin MEASUREMENT fNISETND "0:NSET0_computed_delay_flag  1:NSET00≠NSET0" UBYTE COMP_0283 1 100 0 1 BIT_MASK 0x0004 ECU_ADDRESS 0xFFFF1BD7 READ_WRITE /end MEASUREMENT
/begin MEASUREMENT fNMAX2 "0:全気筒ｶｯﾄせず  1:全気筒ｶｯﾄ" UBYTE COMP_0283 1 100 0 1 BIT_MASK 0x0002 ECU_ADDRESS 0xFFFF1BD7 READ_WRITE /end MEASUREMENT
/begin MEASUREMENT fNMAX2TM "0:不成立  1:成立" UBYTE COMP_0283 1 100 0 1 BIT_MASK 0x0001 ECU_ADDRESS 0xFFFF1BD7 READ_WRITE /end MEASUREMENT
/begin MEASUREMENT fNOILFC "0:MNRPM-OFCHYS#＜NOILFC#  1:MNRPM≧NOILFC#" UBYTE COMP_0283 1 100 0 1 BIT_MASK 0x0080 ECU_ADDRESS 0xFFFF1BD8 READ_WRITE /end MEASUREMENT
/begin MEASUREMENT fNSETBRK "0:右記以外  1:0,1反転" UBYTE COMP_0283 1 100 0 1 BIT_MASK 0x0040 ECU_ADDRESS 0xFFFF1BD8 READ_WRITE /end MEASUREMENT
/begin MEASUREMENT fNSETDLY "0:右記以外  1:下限制約ディレイ制御後" UBYTE COMP_0283 1 100 0 1 BIT_MASK 0x0020 ECU_ADDRESS 0xFFFF1BD8 READ_WRITE /end MEASUREMENT
/begin MEASUREMENT fNSETND "0:NSET00=NSET0  1:NSET00≠NSET0" UBYTE COMP_0283 1 100 0 1 BIT_MASK 0x0010 ECU_ADDRESS 0xFFFF1BD8 READ_WRITE /end MEASUREMENT
/begin MEASUREMENT fNSETPWST "0:右記以外  1:0,1反転" UBYTE COMP_0283 1 100 0 1 BIT_MASK 0x0008 ECU_ADDRESS 0xFFFF1BD8 READ_WRITE /end MEASUREMENT
/begin MEASUREMENT fNSETRV "0:右記以外  1:0，1反転" UBYTE COMP_0283 1 100 0 1 BIT_MASK 0x0004 ECU_ADDRESS 0xFFFF1BD8 READ_WRITE /end MEASUREMENT
/begin MEASUREMENT fNSETSLOP "0:右記以外  1:mDNSET0SL時間毎にNSET0を変化" UBYTE COMP_0283 1 100 0 1 BIT_MASK 0x0002 ECU_ADDRESS 0xFFFF1BD8 READ_WRITE /end MEASUREMENT
/begin MEASUREMENT fO2DTYCH "0:切換要求無し  1:切換要求有り" UBYTE COMP_0283 1 100 0 1 BIT_MASK 0x0001 ECU_ADDRESS 0xFFFF1BD8 READ_WRITE /end MEASUREMENT
/begin MEASUREMENT fO2HN "0:不成立  1:成立" UBYTE COMP_0283 1 100 0 1 BIT_MASK 0x0080 ECU_ADDRESS 0xFFFF1BD9 READ_WRITE /end MEASUREMENT
/begin MEASUREMENT fO2HTP "0:不成立  1:成立" UBYTE COMP_0283 1 100 0 1 BIT_MASK 0x0040 ECU_ADDRESS 0xFFFF1BD9 READ_WRITE /end MEASUREMENT
/begin MEASUREMENT fO2HVB "0:不成立  1:成立" UBYTE COMP_0283 1 100 0 1 BIT_MASK 0x0020 ECU_ADDRESS 0xFFFF1BD9 READ_WRITE /end MEASUREMENT
/begin MEASUREMENT fOFAVST "0:演算未  1:演算済" UBYTE COMP_0283 1 100 0 1 BIT_MASK 0x0010 ECU_ADDRESS 0xFFFF1BD9 READ_WRITE /end MEASUREMENT
/begin MEASUREMENT fOFAVSTE "0:演算未  1:演算済" UBYTE COMP_0283 1 100 0 1 BIT_MASK 0x0008 ECU_ADDRESS 0xFFFF1BD9 READ_WRITE /end MEASUREMENT
/begin MEASUREMENT fPBCUT "0:ｶｯﾄせず  1:ｶｯﾄ" UBYTE COMP_0283 1 100 0 1 BIT_MASK 0x0004 ECU_ADDRESS 0xFFFF1BD9 READ_WRITE /end MEASUREMENT
/begin MEASUREMENT fPBCUT2 "0:不成立  1:成立" UBYTE COMP_0283 1 100 0 1 BIT_MASK 0x0002 ECU_ADDRESS 0xFFFF1BD9 READ_WRITE /end MEASUREMENT
/begin MEASUREMENT fPDAVOK "0:条件不成立  1:条件成立" UBYTE COMP_0283 1 100 0 1 BIT_MASK 0x0001 ECU_ADDRESS 0xFFFF1BD9 READ_WRITE /end MEASUREMENT
/begin MEASUREMENT fPDPRH "0:ｴｱｺﾝ要求判定Pd圧(High)非成立  1:ｴｱｺﾝ要求判定Pd圧(High)成立" UBYTE COMP_0283 1 100 0 1 BIT_MASK 0x0080 ECU_ADDRESS 0xFFFF1BDA READ_WRITE /end MEASUREMENT
/begin MEASUREMENT fPDPRL "0:ｴｱｺﾝ要求判定Pd圧(Low)非成立  1:ｴｱｺﾝ要求判定Pd圧(Low)成立" UBYTE COMP_0283 1 100 0 1 BIT_MASK 0x0040 ECU_ADDRESS 0xFFFF1BDA READ_WRITE /end MEASUREMENT
/begin MEASUREMENT fPDPRM "0:ｴｱｺﾝ要求判定Pd圧(Mid)非成立  1:ｴｱｺﾝ要求判定Pd圧(Mid)成立" UBYTE COMP_0283 1 100 0 1 BIT_MASK 0x0020 ECU_ADDRESS 0xFFFF1BDA READ_WRITE /end MEASUREMENT
/begin MEASUREMENT fPDRFH "0:wvPDPREN<=mPDRFH(ヒス-mPDHIS)  1:左記以外" UBYTE COMP_0283 1 100 0 1 BIT_MASK 0x0010 ECU_ADDRESS 0xFFFF1BDA READ_WRITE /end MEASUREMENT
/begin MEASUREMENT fPDRFL "0:wvPDPREN<mPDRFL(ヒス-mPDHIS)  1:左記以外" UBYTE COMP_0283 1 100 0 1 BIT_MASK 0x0008 ECU_ADDRESS 0xFFFF1BDA READ_WRITE /end MEASUREMENT
/begin MEASUREMENT fPFDGJG1 "0:不成立  1:成立" UBYTE COMP_0283 1 100 0 1 BIT_MASK 0x0004 ECU_ADDRESS 0xFFFF1BDA READ_WRITE /end MEASUREMENT
/begin MEASUREMENT fPFDGJG2 "0:不成立  1:成立" UBYTE COMP_0283 1 100 0 1 BIT_MASK 0x0002 ECU_ADDRESS 0xFFFF1BDA READ_WRITE /end MEASUREMENT
/begin MEASUREMENT fPFDGJG4 "0:不成立  1:成立" UBYTE COMP_0283 1 100 0 1 BIT_MASK 0x0001 ECU_ADDRESS 0xFFFF1BDA READ_WRITE /end MEASUREMENT
/begin MEASUREMENT fPFJUDGE "0:右記以外  1:燃圧判定成立" UBYTE COMP_0283 1 100 0 1 BIT_MASK 0x0080 ECU_ADDRESS 0xFFFF1BDB READ_WRITE /end MEASUREMENT
/begin MEASUREMENT fPFLNG "0:正常  1:異常" UBYTE COMP_0283 1 100 0 1 BIT_MASK 0x0040 ECU_ADDRESS 0xFFFF1BDB READ_WRITE /end MEASUREMENT
/begin MEASUREMENT fPIGTH "0:制御条件不成立  1:制御条件成立" UBYTE COMP_0283 1 100 0 1 BIT_MASK 0x0020 ECU_ADDRESS 0xFFFF1BDB READ_WRITE /end MEASUREMENT
/begin MEASUREMENT fPLINJN "0:不成立  1:成立" UBYTE COMP_0283 1 100 0 1 BIT_MASK 0x0010 ECU_ADDRESS 0xFFFF1BDB READ_WRITE /end MEASUREMENT
/begin MEASUREMENT fPRGDSLCT "0:非成立  1:成立" UBYTE COMP_0283 1 100 0 1 BIT_MASK 0x0008 ECU_ADDRESS 0xFFFF1BDB READ_WRITE /end MEASUREMENT
/begin MEASUREMENT fPRGSTON "0:START_SW_ON経験なし  1:START_SW_ON経験あり" UBYTE COMP_0283 1 100 0 1 BIT_MASK 0x0004 ECU_ADDRESS 0xFFFF1BDB READ_WRITE /end MEASUREMENT
/begin MEASUREMENT fPRSNGDO "0:絶対圧センサ診断未NG  1:絶対圧センサ診断NG" UBYTE COMP_0283 1 100 0 1 BIT_MASK 0x0002 ECU_ADDRESS 0xFFFF1BDB READ_WRITE /end MEASUREMENT
/begin MEASUREMENT fPRSNGDR "0:絶対圧センサ診断未NG  1:絶対圧センサ診断NG" UBYTE COMP_0283 1 100 0 1 BIT_MASK 0x0001 ECU_ADDRESS 0xFFFF1BDB READ_WRITE /end MEASUREMENT
/begin MEASUREMENT fPRSNGDS "0:絶対圧センサ診断未NG  1:絶対圧センサ診断NG" UBYTE COMP_0283 1 100 0 1 BIT_MASK 0x0080 ECU_ADDRESS 0xFFFF1BDC READ_WRITE /end MEASUREMENT
/begin MEASUREMENT fPSSTDY "0:OFF  1:ON" UBYTE COMP_0283 1 100 0 1 BIT_MASK 0x0040 ECU_ADDRESS 0xFFFF1BDC READ_WRITE /end MEASUREMENT
/begin MEASUREMENT fPTDARBON "0:TFDPTD＝(TFDPTDR+tmp3)  1:TFDPTD≠(TFDPTDR+tmp3)" UBYTE COMP_0283 1 100 0 1 BIT_MASK 0x0020 ECU_ADDRESS 0xFFFF1BDC READ_WRITE /end MEASUREMENT
/begin MEASUREMENT fPTNCUT "0:燃料カット制御しない  1:燃料カット制御" UBYTE COMP_0283 1 100 0 1 BIT_MASK 0x0010 ECU_ADDRESS 0xFFFF1BDC READ_WRITE /end MEASUREMENT
/begin MEASUREMENT fPUMUPNE "0:不成立  1:成立" UBYTE COMP_0283 1 100 0 1 BIT_MASK 0x0008 ECU_ADDRESS 0xFFFF1BDC READ_WRITE /end MEASUREMENT
/begin MEASUREMENT fPVTCTRGE "0:不成立  1:成立" UBYTE COMP_0283 1 100 0 1 BIT_MASK 0x0004 ECU_ADDRESS 0xFFFF1BDC READ_WRITE /end MEASUREMENT
/begin MEASUREMENT fQBCCON "0:QBC制御中でない  1:QBC制御中" UBYTE COMP_0283 1 100 0 1 BIT_MASK 0x0002 ECU_ADDRESS 0xFFFF1BDC READ_WRITE /end MEASUREMENT
/begin MEASUREMENT fQBCOFF "0:QBC制御中でない  1:QBC制御中" UBYTE COMP_0283 1 100 0 1 BIT_MASK 0x0001 ECU_ADDRESS 0xFFFF1BDC READ_WRITE /end MEASUREMENT
/begin MEASUREMENT fQENSTSTY "0:不成立  1:成立" UBYTE COMP_0283 1 100 0 1 BIT_MASK 0x0080 ECU_ADDRESS 0xFFFF1BDD READ_WRITE /end MEASUREMENT
/begin MEASUREMENT fQFBIHOJI "0:条件不成立  1:条件成立" UBYTE COMP_0283 1 100 0 1 BIT_MASK 0x0040 ECU_ADDRESS 0xFFFF1BDD READ_WRITE /end MEASUREMENT
/begin MEASUREMENT fQFBIMAXH "0:条件不成立  1:条件成立" UBYTE COMP_0283 1 100 0 1 BIT_MASK 0x0020 ECU_ADDRESS 0xFFFF1BDD READ_WRITE /end MEASUREMENT
/begin MEASUREMENT fQFBIMAXS "0:条件不成立  1:条件成立" UBYTE COMP_0283 1 100 0 1 BIT_MASK 0x0010 ECU_ADDRESS 0xFFFF1BDD READ_WRITE /end MEASUREMENT
/begin MEASUREMENT fQFBIMINH "0:条件不成立  1:条件成立" UBYTE COMP_0283 1 100 0 1 BIT_MASK 0x0008 ECU_ADDRESS 0xFFFF1BDD READ_WRITE /end MEASUREMENT
/begin MEASUREMENT fQFBIMINS "0:条件不成立  1:条件成立" UBYTE COMP_0283 1 100 0 1 BIT_MASK 0x0004 ECU_ADDRESS 0xFFFF1BDD READ_WRITE /end MEASUREMENT
/begin MEASUREMENT fQTASED "0:不成立  1:成立" UBYTE COMP_0283 1 100 0 1 BIT_MASK 0x0002 ECU_ADDRESS 0xFFFF1BDD READ_WRITE /end MEASUREMENT
/begin MEASUREMENT fQTASST "0:不成立  1:成立" UBYTE COMP_0283 1 100 0 1 BIT_MASK 0x0001 ECU_ADDRESS 0xFFFF1BDD READ_WRITE /end MEASUREMENT
/begin MEASUREMENT fREGNCNT "0:回生発電制御不許可  1:回生発電制御許可" UBYTE COMP_0283 1 100 0 1 BIT_MASK 0x0080 ECU_ADDRESS 0xFFFF1BDE READ_WRITE /end MEASUREMENT
/begin MEASUREMENT fREQIUP "0:アイドルアップ要求でない  1:アイドルアップ要求" UBYTE COMP_0283 1 100 0 1 BIT_MASK 0x0040 ECU_ADDRESS 0xFFFF1BDE READ_WRITE /end MEASUREMENT
/begin MEASUREMENT fREQLUP "0:ロックアップ要求でない  1:ロックアップ要求" UBYTE COMP_0283 1 100 0 1 BIT_MASK 0x0020 ECU_ADDRESS 0xFFFF1BDE READ_WRITE /end MEASUREMENT
/begin MEASUREMENT fRETALW "0:遅角を許可しない  1:遅角を許可する" UBYTE COMP_0283 1 100 0 1 BIT_MASK 0x0010 ECU_ADDRESS 0xFFFF1BDE READ_WRITE /end MEASUREMENT
/begin MEASUREMENT fREV16CHK "0:-  1:-" UBYTE COMP_0283 1 100 0 1 BIT_MASK 0x0008 ECU_ADDRESS 0xFFFF1BDE READ_WRITE /end MEASUREMENT
/begin MEASUREMENT fRFPDHI "0:PD圧_<_ﾗｼﾞﾌｧﾝHigh要求PD圧  1:PD圧_≧_ﾗｼﾞﾌｧﾝHigh要求PD圧" UBYTE COMP_0283 1 100 0 1 BIT_MASK 0x0004 ECU_ADDRESS 0xFFFF1BDE READ_WRITE /end MEASUREMENT
/begin MEASUREMENT fRFTWH "0:水温条件H未成立  1:H水温以上" UBYTE COMP_0283 1 100 0 1 BIT_MASK 0x0002 ECU_ADDRESS 0xFFFF1BDE READ_WRITE /end MEASUREMENT
/begin MEASUREMENT fRFTWHI "0:水温_<_ﾗｼﾞﾌｧﾝHigh要求水温  1:水温_≧_ﾗｼﾞﾌｧﾝHigh要求水温" UBYTE COMP_0283 1 100 0 1 BIT_MASK 0x0001 ECU_ADDRESS 0xFFFF1BDE READ_WRITE /end MEASUREMENT
/begin MEASUREMENT fRFTWL "0:水温条件Ｌ未成立  1:L水温以上" UBYTE COMP_0283 1 100 0 1 BIT_MASK 0x0080 ECU_ADDRESS 0xFFFF1BDF READ_WRITE /end MEASUREMENT
/begin MEASUREMENT fRLHTW "0:wvTWN<mRLHTW(ヒス-mRLHTWHYS)  1:wvTWN≧mRLHTW(ヒス-mRLHTWHYS)" UBYTE COMP_0283 1 100 0 1 BIT_MASK 0x0040 ECU_ADDRESS 0xFFFF1BDF READ_WRITE /end MEASUREMENT
/begin MEASUREMENT fRODRDT "0:vRO2HDTY>=mRODRDT_未経験  1:vRO2HDTY>=mRODRDT_経験" UBYTE COMP_0283 1 100 0 1 BIT_MASK 0x0020 ECU_ADDRESS 0xFFFF1BDF READ_WRITE /end MEASUREMENT
/begin MEASUREMENT fRODRDTM "0:不成立  1:成立" UBYTE COMP_0283 1 100 0 1 BIT_MASK 0x0010 ECU_ADDRESS 0xFFFF1BDF READ_WRITE /end MEASUREMENT
/begin MEASUREMENT fRODRFCT "0:燃料ｶｯﾄ終了時にﾃﾞｨﾚｲ_未経過  1:燃料ｶｯﾄ終了時にﾃﾞｨﾚｲRODRFCT#経過" UBYTE COMP_0283 1 100 0 1 BIT_MASK 0x0008 ECU_ADDRESS 0xFFFF1BDF READ_WRITE /end MEASUREMENT
/begin MEASUREMENT fRODRJDL "0:燃料ｶｯﾄ開始時にﾃﾞｨﾚｲ_未経過  1:燃料ｶｯﾄ開始時にﾃﾞｨﾚｲRODRJDL#経過" UBYTE COMP_0283 1 100 0 1 BIT_MASK 0x0004 ECU_ADDRESS 0xFFFF1BDF READ_WRITE /end MEASUREMENT
/begin MEASUREMENT fROND "0:初回  1:初回以外" UBYTE COMP_0283 1 100 0 1 BIT_MASK 0x0002 ECU_ADDRESS 0xFFFF1BDF READ_WRITE /end MEASUREMENT
/begin MEASUREMENT fRONJH "0:vROND>vRONJH  1:vROND<=vRONDJH-vRONDHYS" UBYTE COMP_0283 1 100 0 1 BIT_MASK 0x0001 ECU_ADDRESS 0xFFFF1BDF READ_WRITE /end MEASUREMENT
/begin MEASUREMENT fRTOHAPO "0:不成立  1:成立" UBYTE COMP_0283 1 100 0 1 BIT_MASK 0x0080 ECU_ADDRESS 0xFFFF1BE0 READ_WRITE /end MEASUREMENT
/begin MEASUREMENT fRTOHOLD1 "0:不成立  1:成立" UBYTE COMP_0283 1 100 0 1 BIT_MASK 0x0040 ECU_ADDRESS 0xFFFF1BE0 READ_WRITE /end MEASUREMENT
/begin MEASUREMENT fSENNRPM "0:不成立  1:成立" UBYTE COMP_0283 1 100 0 1 BIT_MASK 0x0020 ECU_ADDRESS 0xFFFF1BE0 READ_WRITE /end MEASUREMENT
/begin MEASUREMENT fSFTREQJD "0:冷機変速線切り替え経験無し  1:冷機変速線切り替え経験有り" UBYTE COMP_0283 1 100 0 1 BIT_MASK 0x0010 ECU_ADDRESS 0xFFFF1BE0 READ_WRITE /end MEASUREMENT
/begin MEASUREMENT fSOKTPFC "0:燃料ｶｯﾄ無  1:燃料ｶｯﾄ有" UBYTE COMP_0283 1 100 0 1 BIT_MASK 0x0008 ECU_ADDRESS 0xFFFF1BE0 READ_WRITE /end MEASUREMENT
/begin MEASUREMENT fSONITC "0:SONITC算出未  1:SONITC算出済" UBYTE COMP_0283 1 100 0 1 BIT_MASK 0x0004 ECU_ADDRESS 0xFFFF1BE0 READ_WRITE /end MEASUREMENT
/begin MEASUREMENT fST2NTP "0:条件不成立  1:条件成立" UBYTE COMP_0283 1 100 0 1 BIT_MASK 0x0002 ECU_ADDRESS 0xFFFF1BE0 READ_WRITE /end MEASUREMENT
/begin MEASUREMENT fSTEPFK "0:ｽﾃｯﾌﾟ負荷条件成立フラグ  1:走行中条件成立" UBYTE COMP_0283 1 100 0 1 BIT_MASK 0x0001 ECU_ADDRESS 0xFFFF1BE0 READ_WRITE /end MEASUREMENT
/begin MEASUREMENT fSTGPED "0:未終了  1:終了" UBYTE COMP_0283 1 100 0 1 BIT_MASK 0x0080 ECU_ADDRESS 0xFFFF1BE1 READ_WRITE /end MEASUREMENT
/begin MEASUREMENT fSTPIG2 "0:不成立  1:成立" UBYTE COMP_0283 1 100 0 1 BIT_MASK 0x0040 ECU_ADDRESS 0xFFFF1BE1 READ_WRITE /end MEASUREMENT
/begin MEASUREMENT fSTSTATOF "0:経験無  1:経験有" UBYTE COMP_0283 1 100 0 1 BIT_MASK 0x0020 ECU_ADDRESS 0xFFFF1BE1 READ_WRITE /end MEASUREMENT
/begin MEASUREMENT fSTSWEX "0:ST_SWが一度もONしていない  1:ST_SWがONしたことがある" UBYTE COMP_0283 1 100 0 1 BIT_MASK 0x0010 ECU_ADDRESS 0xFFFF1BE1 READ_WRITE /end MEASUREMENT
/begin MEASUREMENT fSTTFCHYS "0:mSTFSNE>wvLNRPM(ﾋｽ-200rpm)  1:mSTFSNE≦wvLNRPM" UBYTE COMP_0283 1 100 0 1 BIT_MASK 0x0008 ECU_ADDRESS 0xFFFF1BE1 READ_WRITE /end MEASUREMENT
/begin MEASUREMENT fSTTGPF "0:なし  1:あり" UBYTE COMP_0283 1 100 0 1 BIT_MASK 0x0004 ECU_ADDRESS 0xFFFF1BE1 READ_WRITE /end MEASUREMENT
/begin MEASUREMENT fSUB "0:非減少制御  1:減少制御中" UBYTE COMP_0283 1 100 0 1 BIT_MASK 0x0002 ECU_ADDRESS 0xFFFF1BE1 READ_WRITE /end MEASUREMENT
/begin MEASUREMENT fTANPIST2 "0:完爆プレイグ下限吸気温判定2（ヒ  1:完爆プレイグ下限吸気温判定2（ヒ" UBYTE COMP_0283 1 100 0 1 BIT_MASK 0x0001 ECU_ADDRESS 0xFFFF1BE1 READ_WRITE /end MEASUREMENT
/begin MEASUREMENT fTASKDGNST "0:不成立  1:成立" UBYTE COMP_0283 1 100 0 1 BIT_MASK 0x0080 ECU_ADDRESS 0xFFFF1BE2 READ_WRITE /end MEASUREMENT
/begin MEASUREMENT fTCANDCNT "0:非成立  1:成立" UBYTE COMP_0283 1 100 0 1 BIT_MASK 0x0040 ECU_ADDRESS 0xFFFF1BE2 READ_WRITE /end MEASUREMENT
/begin MEASUREMENT fTCVCLJG "0:不成立  1:成立" UBYTE COMP_0283 1 100 0 1 BIT_MASK 0x0020 ECU_ADDRESS 0xFFFF1BE2 READ_WRITE /end MEASUREMENT
/begin MEASUREMENT fTCVDICSF "0:TCV-MOTOR-SF_Low  1:TCV-MOTOR-SF_High" UBYTE COMP_0283 1 100 0 1 BIT_MASK 0x0010 ECU_ADDRESS 0xFFFF1BE2 READ_WRITE /end MEASUREMENT
/begin MEASUREMENT fTDWRL "0:NO  1:YES" UBYTE COMP_0283 1 100 0 1 BIT_MASK 0x0008 ECU_ADDRESS 0xFFFF1BE2 READ_WRITE /end MEASUREMENT
/begin MEASUREMENT fTEMIN "0:不成立  1:成立" UBYTE COMP_0283 1 100 0 1 BIT_MASK 0x0004 ECU_ADDRESS 0xFFFF1BE2 READ_WRITE /end MEASUREMENT
/begin MEASUREMENT fTFAHYS "0:OUT  1:IN" UBYTE COMP_0283 1 100 0 1 BIT_MASK 0x0002 ECU_ADDRESS 0xFFFF1BE2 READ_WRITE /end MEASUREMENT
/begin MEASUREMENT fTFBYAKIR "0:右記以外  1:同調中" UBYTE COMP_0283 1 100 0 1 BIT_MASK 0x0001 ECU_ADDRESS 0xFFFF1BE2 READ_WRITE /end MEASUREMENT
/begin MEASUREMENT fTFDTWIN "0:未終了  1:終了" UBYTE COMP_0283 1 100 0 1 BIT_MASK 0x0080 ECU_ADDRESS 0xFFFF1BE3 READ_WRITE /end MEASUREMENT
/begin MEASUREMENT fTMCHOI "0:不成立  1:成立" UBYTE COMP_0283 1 100 0 1 BIT_MASK 0x0040 ECU_ADDRESS 0xFFFF1BE3 READ_WRITE /end MEASUREMENT
/begin MEASUREMENT fTPCHK "0:不成立  1:TP条件成立" UBYTE COMP_0283 1 100 0 1 BIT_MASK 0x0020 ECU_ADDRESS 0xFFFF1BE3 READ_WRITE /end MEASUREMENT
/begin MEASUREMENT fTPCUT "0:ｶｯﾄせず  1:ｶｯﾄ" UBYTE COMP_0283 1 100 0 1 BIT_MASK 0x0010 ECU_ADDRESS 0xFFFF1BE3 READ_WRITE /end MEASUREMENT
/begin MEASUREMENT fTPCUT2 "0:不成立  1:成立" UBYTE COMP_0283 1 100 0 1 BIT_MASK 0x0008 ECU_ADDRESS 0xFFFF1BE3 READ_WRITE /end MEASUREMENT
/begin MEASUREMENT fTPLINJTI "0:不成立  1:成立" UBYTE COMP_0283 1 100 0 1 BIT_MASK 0x0004 ECU_ADDRESS 0xFFFF1BE3 READ_WRITE /end MEASUREMENT
/begin MEASUREMENT fTPOIN "0:ｶｯﾄせず  1:ｶｯﾄ" UBYTE COMP_0283 1 100 0 1 BIT_MASK 0x0002 ECU_ADDRESS 0xFFFF1BE3 READ_WRITE /end MEASUREMENT
/begin MEASUREMENT fTPOIN1 "0:不成立  1:成立" UBYTE COMP_0283 1 100 0 1 BIT_MASK 0x0001 ECU_ADDRESS 0xFFFF1BE3 READ_WRITE /end MEASUREMENT
/begin MEASUREMENT fTPOIN2 "0:不成立  1:成立" UBYTE COMP_0283 1 100 0 1 BIT_MASK 0x0080 ECU_ADDRESS 0xFFFF1BE4 READ_WRITE /end MEASUREMENT
/begin MEASUREMENT fTPSCV1 "0:不成立  1:成立" UBYTE COMP_0283 1 100 0 1 BIT_MASK 0x0040 ECU_ADDRESS 0xFFFF1BE4 READ_WRITE /end MEASUREMENT
/begin MEASUREMENT fTPSCV2 "0:不成立  1:成立" UBYTE COMP_0283 1 100 0 1 BIT_MASK 0x0020 ECU_ADDRESS 0xFFFF1BE4 READ_WRITE /end MEASUREMENT
/begin MEASUREMENT fTPSSNG1 "0:不成立  1:成立" UBYTE COMP_0283 1 100 0 1 BIT_MASK 0x0010 ECU_ADDRESS 0xFFFF1BE4 READ_WRITE /end MEASUREMENT
/begin MEASUREMENT fTPSXNG1 "0:不成立  1:成立" UBYTE COMP_0283 1 100 0 1 BIT_MASK 0x0008 ECU_ADDRESS 0xFFFF1BE4 READ_WRITE /end MEASUREMENT
/begin MEASUREMENT fTPVFST "0:初期化未  1:初期化済" UBYTE COMP_0283 1 100 0 1 BIT_MASK 0x0004 ECU_ADDRESS 0xFFFF1BE4 READ_WRITE /end MEASUREMENT
/begin MEASUREMENT fTQDNEDCK "0:トルクダウン制御条件終了処理2  1:トルクダウン制御条件終了処理1" UBYTE COMP_0283 1 100 0 1 BIT_MASK 0x0002 ECU_ADDRESS 0xFFFF1BE4 READ_WRITE /end MEASUREMENT
/begin MEASUREMENT fTRAD2VSP "0:VSPS＞TRAD2VSP  1:VSPS≦TRAD2VSP-4" UBYTE COMP_0283 1 100 0 1 BIT_MASK 0x0001 ECU_ADDRESS 0xFFFF1BE4 READ_WRITE /end MEASUREMENT
/begin MEASUREMENT fTREF0ST "0:初回演算  1:初回以外" UBYTE COMP_0283 1 100 0 1 BIT_MASK 0x0080 ECU_ADDRESS 0xFFFF1BE5 READ_WRITE /end MEASUREMENT
/begin MEASUREMENT fTRFCD "0:tTRFCD経過  1:tTRFCD未経過" UBYTE COMP_0283 1 100 0 1 BIT_MASK 0x0040 ECU_ADDRESS 0xFFFF1BE5 READ_WRITE /end MEASUREMENT
/begin MEASUREMENT fTTEFST "0:初回  1:初回以降" UBYTE COMP_0283 1 100 0 1 BIT_MASK 0x0020 ECU_ADDRESS 0xFFFF1BE5 READ_WRITE /end MEASUREMENT
/begin MEASUREMENT fTTERL0L "0:未経験  1:経験" UBYTE COMP_0283 1 100 0 1 BIT_MASK 0x0010 ECU_ADDRESS 0xFFFF1BE5 READ_WRITE /end MEASUREMENT
/begin MEASUREMENT fTUDGNQH0 "0:TVOTQH0_<=TUDGNQH0#__(－ヒス:TVO  1:TVOTQH0_>TUDGNQH0#__(－ヒス:TVOQ" UBYTE COMP_0283 1 100 0 1 BIT_MASK 0x0008 ECU_ADDRESS 0xFFFF1BE5 READ_WRITE /end MEASUREMENT
/begin MEASUREMENT fTVSCV1 "0:成立  1:不成立" UBYTE COMP_0283 1 100 0 1 BIT_MASK 0x0004 ECU_ADDRESS 0xFFFF1BE5 READ_WRITE /end MEASUREMENT
/begin MEASUREMENT fTWCMPA "0:wvTWNーwvTWINT<mA5TWD  1:wvTWNーwvTWINT≧mA5TWD" UBYTE COMP_0283 1 100 0 1 BIT_MASK 0x0002 ECU_ADDRESS 0xFFFF1BE5 READ_WRITE /end MEASUREMENT
/begin MEASUREMENT fTWCMPF "0:wvTWNーwvTWINT<mFRTWD  1:wvTWNーwvTWINT≧mFRTWD" UBYTE COMP_0283 1 100 0 1 BIT_MASK 0x0001 ECU_ADDRESS 0xFFFF1BE5 READ_WRITE /end MEASUREMENT
/begin MEASUREMENT fTWISLH "0:水温条件上限値未満  1:以上" UBYTE COMP_0283 1 100 0 1 BIT_MASK 0x0080 ECU_ADDRESS 0xFFFF1BE6 READ_WRITE /end MEASUREMENT
/begin MEASUREMENT fTWISLL "0:未満  1:水温条件下限値以上" UBYTE COMP_0283 1 100 0 1 BIT_MASK 0x0040 ECU_ADDRESS 0xFFFF1BE6 READ_WRITE /end MEASUREMENT
/begin MEASUREMENT fTWKMR "0:不成立  1:成立" UBYTE COMP_0283 1 100 0 1 BIT_MASK 0x0020 ECU_ADDRESS 0xFFFF1BE6 READ_WRITE /end MEASUREMENT
/begin MEASUREMENT fTWKS "0:不成立  1:水温条件成立" UBYTE COMP_0283 1 100 0 1 BIT_MASK 0x0010 ECU_ADDRESS 0xFFFF1BE6 READ_WRITE /end MEASUREMENT
/begin MEASUREMENT fTWNFC "0:条件不成立  1:条件成立" UBYTE COMP_0283 1 100 0 1 BIT_MASK 0x0008 ECU_ADDRESS 0xFFFF1BE6 READ_WRITE /end MEASUREMENT
/begin MEASUREMENT fTWPMITH "0:wvTWN<mTWPMITH(ﾋｽ:-5℃)  1:wvTWN≧mTWPMITH(ﾋｽ:-5℃)" UBYTE COMP_0283 1 100 0 1 BIT_MASK 0x0004 ECU_ADDRESS 0xFFFF1BE6 READ_WRITE /end MEASUREMENT
/begin MEASUREMENT fTWPMITL "0:wvTWN<mTWPMITL(ﾋｽ:-5℃)  1:wvTWN≧mTWPMITL(ﾋｽ:-5℃)" UBYTE COMP_0283 1 100 0 1 BIT_MASK 0x0002 ECU_ADDRESS 0xFFFF1BE6 READ_WRITE /end MEASUREMENT
/begin MEASUREMENT fTWRMN "0:wvTWN<=mTWRMN  1:wvTWN>mTWRMN" UBYTE COMP_0283 1 100 0 1 BIT_MASK 0x0001 ECU_ADDRESS 0xFFFF1BE6 READ_WRITE /end MEASUREMENT
/begin MEASUREMENT fTWSCV1 "0:不成立  1:成立" UBYTE COMP_0283 1 100 0 1 BIT_MASK 0x0080 ECU_ADDRESS 0xFFFF1BE7 READ_WRITE /end MEASUREMENT
/begin MEASUREMENT fTWSCV2H "0:不成立  1:成立" UBYTE COMP_0283 1 100 0 1 BIT_MASK 0x0040 ECU_ADDRESS 0xFFFF1BE7 READ_WRITE /end MEASUREMENT
/begin MEASUREMENT fTWSCV2L "0:不成立  1:成立" UBYTE COMP_0283 1 100 0 1 BIT_MASK 0x0020 ECU_ADDRESS 0xFFFF1BE7 READ_WRITE /end MEASUREMENT
/begin MEASUREMENT fTWSCV3 "0:不成立  1:成立" UBYTE COMP_0283 1 100 0 1 BIT_MASK 0x0010 ECU_ADDRESS 0xFFFF1BE7 READ_WRITE /end MEASUREMENT
/begin MEASUREMENT fTWSCV4 "0:成立  1:不成立" UBYTE COMP_0283 1 100 0 1 BIT_MASK 0x0008 ECU_ADDRESS 0xFFFF1BE7 READ_WRITE /end MEASUREMENT
/begin MEASUREMENT fTWSMPF "0:TWN_＞_TWSMPF#（ﾋｽ：-5℃）  1:TWN_≦_TWSMPF#（ﾋｽ：-5℃）" UBYTE COMP_0283 1 100 0 1 BIT_MASK 0x0004 ECU_ADDRESS 0xFFFF1BE7 READ_WRITE /end MEASUREMENT
/begin MEASUREMENT fVBALTFST "0:VBALTCK初回値未設定  1:VBALTCK初回値設定済" UBYTE COMP_0283 1 100 0 1 BIT_MASK 0x0002 ECU_ADDRESS 0xFFFF1BE7 READ_WRITE /end MEASUREMENT
/begin MEASUREMENT fVCLNE "0:クリーニングモード不許可回転数  1:クリーニングモード許可回転数" UBYTE COMP_0283 1 100 0 1 BIT_MASK 0x0001 ECU_ADDRESS 0xFFFF1BE7 READ_WRITE /end MEASUREMENT
/begin MEASUREMENT fVCSHOTOE "0:VCSHOTE未セット  1:VCSHOTEセット済み" UBYTE COMP_0283 1 100 0 1 BIT_MASK 0x0080 ECU_ADDRESS 0xFFFF1BE8 READ_WRITE /end MEASUREMENT
/begin MEASUREMENT fVCSHOTON "0:VCSHOT未セット  1:VCSHOTセット済み" UBYTE COMP_0283 1 100 0 1 BIT_MASK 0x0040 ECU_ADDRESS 0xFFFF1BE8 READ_WRITE /end MEASUREMENT
/begin MEASUREMENT fVSP20 "0:未満  1:20km/h以上" UBYTE COMP_0283 1 100 0 1 BIT_MASK 0x0020 ECU_ADDRESS 0xFFFF1BE8 READ_WRITE /end MEASUREMENT
/begin MEASUREMENT fVSP80 "0:未満  1:80km/h以上" UBYTE COMP_0283 1 100 0 1 BIT_MASK 0x0010 ECU_ADDRESS 0xFFFF1BE8 READ_WRITE /end MEASUREMENT
/begin MEASUREMENT fVSPCT2 "0:全気筒ｶｯﾄせず  1:全気筒ｶｯﾄ" UBYTE COMP_0283 1 100 0 1 BIT_MASK 0x0008 ECU_ADDRESS 0xFFFF1BE8 READ_WRITE /end MEASUREMENT
/begin MEASUREMENT fVSPCT2TM "0:VSP条件不成立  1:ﾃﾞｨﾚｲ中" UBYTE COMP_0283 1 100 0 1 BIT_MASK 0x0004 ECU_ADDRESS 0xFFFF1BE8 READ_WRITE /end MEASUREMENT
/begin MEASUREMENT fVSPFC "0:条件不成立  1:条件成立" UBYTE COMP_0283 1 100 0 1 BIT_MASK 0x0002 ECU_ADDRESS 0xFFFF1BE8 READ_WRITE /end MEASUREMENT
/begin MEASUREMENT fVSPREC "0:ﾘｶﾊﾞｰせず_  1:全気筒ﾘｶﾊﾞｰ" UBYTE COMP_0283 1 100 0 1 BIT_MASK 0x0001 ECU_ADDRESS 0xFFFF1BE8 READ_WRITE /end MEASUREMENT
/begin MEASUREMENT fVSPWIPHY "0:VSP_<_(VSPWIP#_-_VSPWIPHY#)  1:VSP_>=_VSPWIP#" UBYTE COMP_0283 1 100 0 1 BIT_MASK 0x0080 ECU_ADDRESS 0xFFFF1BE9 READ_WRITE /end MEASUREMENT
/begin MEASUREMENT fVTCBRK "0:不許可  1:許可" UBYTE COMP_0283 1 100 0 1 BIT_MASK 0x0040 ECU_ADDRESS 0xFFFF1BE9 READ_WRITE /end MEASUREMENT
/begin MEASUREMENT fVTCCNEH "0:条件不成立  1:条件成立" UBYTE COMP_0283 1 100 0 1 BIT_MASK 0x0020 ECU_ADDRESS 0xFFFF1BE9 READ_WRITE /end MEASUREMENT
/begin MEASUREMENT fVTCGKNE "0:mVTCGKNE＞wvLNRPM(ﾋｽ-mVTNEHYS)  1:mVTCGKNE≦wvLNRPM(ﾋｽ-mVTNEHYS)" UBYTE COMP_0283 1 100 0 1 BIT_MASK 0x0010 ECU_ADDRESS 0xFFFF1BE9 READ_WRITE /end MEASUREMENT
/begin MEASUREMENT fVTCGKNEE "0:mVTCGKNEE＞wvLNRPM(ﾋｽ-mVTNEHYS)  1:mVTCGKNEE≦wvLNRPM(ﾋｽ-mVTNEHYS)" UBYTE COMP_0283 1 100 0 1 BIT_MASK 0x0008 ECU_ADDRESS 0xFFFF1BE9 READ_WRITE /end MEASUREMENT
/begin MEASUREMENT fVTCHYSL "0:VTCNOW(iLEFT)-VTCTRG<VTCOLLIM#(  1:VTCNOW(iLEFT)-VTCTRG≧VTCOLLIM#(" UBYTE COMP_0283 1 100 0 1 BIT_MASK 0x0004 ECU_ADDRESS 0xFFFF1BE9 READ_WRITE /end MEASUREMENT
/begin MEASUREMENT fVTCHYSR "0:VTCNOW(iRIGHT)-VTCTRG<VTCOLLIM#(  1:VTCNOW(iRIGHT)-VTCTRG≧VTCOLLIM#" UBYTE COMP_0283 1 100 0 1 BIT_MASK 0x0002 ECU_ADDRESS 0xFFFF1BE9 READ_WRITE /end MEASUREMENT
/begin MEASUREMENT fVTCLRNJE "0:不成立  1:成立" UBYTE COMP_0283 1 100 0 1 BIT_MASK 0x0001 ECU_ADDRESS 0xFFFF1BE9 READ_WRITE /end MEASUREMENT
/begin MEASUREMENT fVTCLRNJG "0:不成立  1:成立" UBYTE COMP_0283 1 100 0 1 BIT_MASK 0x0080 ECU_ADDRESS 0xFFFF1BEA READ_WRITE /end MEASUREMENT
/begin MEASUREMENT fVTCNEL "0:mVTCNEL>wvLNRPM(ﾋｽ-200rpm)  1:mVTCNEL≦wvLNRPM(ﾋｽ-200rpm)" UBYTE COMP_0283 1 100 0 1 BIT_MASK 0x0040 ECU_ADDRESS 0xFFFF1BEA READ_WRITE /end MEASUREMENT
/begin MEASUREMENT fVTCNELE "0:条件不成立  1:条件成立" UBYTE COMP_0283 1 100 0 1 BIT_MASK 0x0020 ECU_ADDRESS 0xFFFF1BEA READ_WRITE /end MEASUREMENT
/begin MEASUREMENT fVTCONEH "0:条件不成立  1:条件成立" UBYTE COMP_0283 1 100 0 1 BIT_MASK 0x0010 ECU_ADDRESS 0xFFFF1BEA READ_WRITE /end MEASUREMENT
/begin MEASUREMENT fVTCOPNH "0:条件不成立  1:条件成立" UBYTE COMP_0283 1 100 0 1 BIT_MASK 0x0008 ECU_ADDRESS 0xFFFF1BEA READ_WRITE /end MEASUREMENT
/begin MEASUREMENT fVTCTWH "0:wvTWN>mVTCTWH(ﾋｽ+3℃)  1:wvTWN≦mVTCTWH(ﾋｽ+3℃)" UBYTE COMP_0283 1 100 0 1 BIT_MASK 0x0004 ECU_ADDRESS 0xFFFF1BEA READ_WRITE /end MEASUREMENT
/begin MEASUREMENT fVTCTWHE "0:条件不成立  1:条件成立" UBYTE COMP_0283 1 100 0 1 BIT_MASK 0x0002 ECU_ADDRESS 0xFFFF1BEA READ_WRITE /end MEASUREMENT
/begin MEASUREMENT fVTCTWL "0:mVTCTWL≧wvTWN(ﾋｽ-3℃)  1:mVTCTWL<wvTWN(ﾋｽ-3℃)" UBYTE COMP_0283 1 100 0 1 BIT_MASK 0x0001 ECU_ADDRESS 0xFFFF1BEA READ_WRITE /end MEASUREMENT
/begin MEASUREMENT fVTCTWL2 "0:mVTCTWL2≧wvTWN(ﾋｽ-3℃)  1:mVTCTWL2<wvTWN(ﾋｽ-3℃)" UBYTE COMP_0283 1 100 0 1 BIT_MASK 0x0080 ECU_ADDRESS 0xFFFF1BEB READ_WRITE /end MEASUREMENT
/begin MEASUREMENT fVTCTWL2E "0:mVTCTWL2E≧wvTWN(ﾋｽ-3℃)  1:mVTCTWL2E<wvTWN(ﾋｽ-3℃)" UBYTE COMP_0283 1 100 0 1 BIT_MASK 0x0040 ECU_ADDRESS 0xFFFF1BEB READ_WRITE /end MEASUREMENT
/begin MEASUREMENT fVTCTWLE "0:条件不成立  1:条件成立" UBYTE COMP_0283 1 100 0 1 BIT_MASK 0x0020 ECU_ADDRESS 0xFFFF1BEB READ_WRITE /end MEASUREMENT
/begin MEASUREMENT fVTCTWLL "0:mVTCTWLL≧wvTWN(ﾋｽ-3℃)  1:mVTCTWLL<wvTWN(ﾋｽ-3℃)" UBYTE COMP_0283 1 100 0 1 BIT_MASK 0x0010 ECU_ADDRESS 0xFFFF1BEB READ_WRITE /end MEASUREMENT
/begin MEASUREMENT fVTCTWLLE "0:mVTCTWLL≧wvTWN(ﾋｽ-3℃)  1:mVTCTWLL<wvTWN(ﾋｽ-3℃)" UBYTE COMP_0283 1 100 0 1 BIT_MASK 0x0008 ECU_ADDRESS 0xFFFF1BEB READ_WRITE /end MEASUREMENT
/begin MEASUREMENT fVTCVSP "0:mVTCVSP＞wvVSP(ﾋｽｰ2km/h)  1:mVTCVSP≦wvVSP(ﾋｽｰ2km/h)" UBYTE COMP_0283 1 100 0 1 BIT_MASK 0x0004 ECU_ADDRESS 0xFFFF1BEB READ_WRITE /end MEASUREMENT
/begin MEASUREMENT fVTLRNTWH "0:条件不成立  1:条件成立" UBYTE COMP_0283 1 100 0 1 BIT_MASK 0x0002 ECU_ADDRESS 0xFFFF1BEB READ_WRITE /end MEASUREMENT
/begin MEASUREMENT fVTLRNTWL "0:条件不成立  1:条件成立" UBYTE COMP_0283 1 100 0 1 BIT_MASK 0x0001 ECU_ADDRESS 0xFFFF1BEB READ_WRITE /end MEASUREMENT
/begin MEASUREMENT fVTNDIF "0:右記以外  1:ｷﾞﾛﾁﾝ状態" UBYTE COMP_0283 1 100 0 1 BIT_MASK 0x0080 ECU_ADDRESS 0xFFFF1BEC READ_WRITE /end MEASUREMENT
/begin MEASUREMENT fVTNDIFE "0:右記以外  1:ｷﾞﾛﾁﾝ状態" UBYTE COMP_0283 1 100 0 1 BIT_MASK 0x0040 ECU_ADDRESS 0xFFFF1BEC READ_WRITE /end MEASUREMENT
/begin MEASUREMENT fWOT2NEH "0:不成立  1:成立" UBYTE COMP_0283 1 100 0 1 BIT_MASK 0x0020 ECU_ADDRESS 0xFFFF1BEC READ_WRITE /end MEASUREMENT
/begin MEASUREMENT fWOT2NEL "0:不成立  1:成立" UBYTE COMP_0283 1 100 0 1 BIT_MASK 0x0010 ECU_ADDRESS 0xFFFF1BEC READ_WRITE /end MEASUREMENT
/begin MEASUREMENT fWOT2TWH "0:不成立  1:成立" UBYTE COMP_0283 1 100 0 1 BIT_MASK 0x0008 ECU_ADDRESS 0xFFFF1BEC READ_WRITE /end MEASUREMENT
/begin MEASUREMENT fWOT2TWL "0:不成立  1:成立" UBYTE COMP_0283 1 100 0 1 BIT_MASK 0x0004 ECU_ADDRESS 0xFFFF1BEC READ_WRITE /end MEASUREMENT
/begin MEASUREMENT fWT2ITCH "0:不成立  1:成立" UBYTE COMP_0283 1 100 0 1 BIT_MASK 0x0002 ECU_ADDRESS 0xFFFF1BEC READ_WRITE /end MEASUREMENT
/begin MEASUREMENT fWT2ITCL "0:不成立  1:成立" UBYTE COMP_0283 1 100 0 1 BIT_MASK 0x0001 ECU_ADDRESS 0xFFFF1BEC READ_WRITE /end MEASUREMENT
/begin MEASUREMENT fAAPO0_S "0:未処理  1:処理済み" UBYTE COMP_0283 1 100 0 1 BIT_MASK 0x0080 ECU_ADDRESS 0xFFFF1BED READ_WRITE /end MEASUREMENT
/begin MEASUREMENT fFTPSST_S "0:不成立  1:成立" UBYTE COMP_0283 1 100 0 1 BIT_MASK 0x0040 ECU_ADDRESS 0xFFFF1BED READ_WRITE /end MEASUREMENT
/begin MEASUREMENT fPDARON_S "0:vTFDPTD_S_=_vTFDPDR_S_+_tmp3  1:vTFDPTD_S_≠_vTFDPDR_S_+_tmp3" UBYTE COMP_0283 1 100 0 1 BIT_MASK 0x0020 ECU_ADDRESS 0xFFFF1BED READ_WRITE /end MEASUREMENT
/begin MEASUREMENT fACCUT2 "0:カット以外  1:エアコンカット状態2" UBYTE COMP_0283 1 100 0 1 BIT_MASK 0x0080 ECU_ADDRESS 0xFFFF3C12 READ_WRITE /end MEASUREMENT
/begin MEASUREMENT fATGP "0:M1ﾚﾝｼﾞ,1ﾚﾝｼﾞ以外  1:M1ﾚﾝｼﾞ,1ﾚﾝｼﾞ判定時" UBYTE COMP_0283 1 100 0 1 BIT_MASK 0x0040 ECU_ADDRESS 0xFFFF3C12 READ_WRITE /end MEASUREMENT
/begin MEASUREMENT fBOSCHCUT "0:未経験又はBOSCHｶｯﾄ空気量強制減算  1:経験" UBYTE COMP_0283 1 100 0 1 BIT_MASK 0x0020 ECU_ADDRESS 0xFFFF3C12 READ_WRITE /end MEASUREMENT
/begin MEASUREMENT fCGPLDFL "0:SPCV条件プルダウン流量切替条件不  1:SPCV条件プルダウン流量切替条件成" UBYTE COMP_0283 1 100 0 1 BIT_MASK 0x0010 ECU_ADDRESS 0xFFFF3C12 READ_WRITE /end MEASUREMENT
/begin MEASUREMENT fFEDTAS1 "0:条件非成立  1:条件成立" UBYTE COMP_0283 1 100 0 1 BIT_MASK 0x0008 ECU_ADDRESS 0xFFFF3C12 READ_WRITE /end MEASUREMENT
/begin MEASUREMENT fFEVINI "0:右記以外  1:判定後制御要求" UBYTE COMP_0283 1 100 0 1 BIT_MASK 0x0004 ECU_ADDRESS 0xFFFF3C12 READ_WRITE /end MEASUREMENT
/begin MEASUREMENT fFFCOK "0:燃料カット不可  1:燃料カット許可" UBYTE COMP_0283 1 100 0 1 BIT_MASK 0x0002 ECU_ADDRESS 0xFFFF3C12 READ_WRITE /end MEASUREMENT
/begin MEASUREMENT fFFDWR_M "0:右記以外  1:EEPROM読み込み" UBYTE COMP_0283 1 100 0 1 BIT_MASK 0x0001 ECU_ADDRESS 0xFFFF3C12 READ_WRITE /end MEASUREMENT
/begin MEASUREMENT fFITADCH "0:右記以外  1:燃料カット時無効成層始動用IT/ADV" UBYTE COMP_0283 1 100 0 1 BIT_MASK 0x0080 ECU_ADDRESS 0xFFFF3C13 READ_WRITE /end MEASUREMENT
/begin MEASUREMENT fFITADCHS "0:右記以外  1:成層始動用IT/ADV選択" UBYTE COMP_0283 1 100 0 1 BIT_MASK 0x0040 ECU_ADDRESS 0xFFFF3C13 READ_WRITE /end MEASUREMENT
/begin MEASUREMENT fFLEANP "0:禁止  1:許可" UBYTE COMP_0283 1 100 0 1 BIT_MASK 0x0020 ECU_ADDRESS 0xFFFF3C13 READ_WRITE /end MEASUREMENT
/begin MEASUREMENT fFOWCOFF "0:右記以外  1:ワンウェイクラッチ非締結" UBYTE COMP_0283 1 100 0 1 BIT_MASK 0x0010 ECU_ADDRESS 0xFFFF3C13 READ_WRITE /end MEASUREMENT
/begin MEASUREMENT fFSLCK "0:ﾓｰﾄﾞ1  1:ﾓｰﾄﾞ2" UBYTE COMP_0283 1 100 0 1 BIT_MASK 0x0008 ECU_ADDRESS 0xFFFF3C13 READ_WRITE /end MEASUREMENT
/begin MEASUREMENT fFTCVACT "0:非実行中  1:実行中" UBYTE COMP_0283 1 100 0 1 BIT_MASK 0x0004 ECU_ADDRESS 0xFFFF3C13 READ_WRITE /end MEASUREMENT
/begin MEASUREMENT fKYUGEN "0:急減速時処理フラグ0  1:急減速時処理フラグ1" UBYTE COMP_0283 1 100 0 1 BIT_MASK 0x0002 ECU_ADDRESS 0xFFFF3C13 READ_WRITE /end MEASUREMENT
/begin MEASUREMENT fMECHADGN "0:ｷｰOFF時メカ故障非診断  1:ｷｰOFF時メカ故障診断中" UBYTE COMP_0283 1 100 0 1 BIT_MASK 0x0001 ECU_ADDRESS 0xFFFF3C13 READ_WRITE /end MEASUREMENT
/begin MEASUREMENT fMFNWAREA "0:右記以外  1:新領域" UBYTE COMP_0283 1 100 0 1 BIT_MASK 0x0080 ECU_ADDRESS 0xFFFF3C14 READ_WRITE /end MEASUREMENT
/begin MEASUREMENT fNIEMNSET "0:排気Nｱｲﾄﾞﾙ検知条件不成立  1:排気Nｱｲﾄﾞﾙ検知条件成立" UBYTE COMP_0283 1 100 0 1 BIT_MASK 0x0040 ECU_ADDRESS 0xFFFF3C14 READ_WRITE /end MEASUREMENT
/begin MEASUREMENT fRAMNGF1 "0:1回目NG判定なし  1:１回目NG判定あり" UBYTE COMP_0283 1 100 0 1 BIT_MASK 0x0020 ECU_ADDRESS 0xFFFF3C14 READ_WRITE /end MEASUREMENT
/begin MEASUREMENT fRAMNGF2 "0:1回目NG判定なし  1:1回目NG判定あり" UBYTE COMP_0283 1 100 0 1 BIT_MASK 0x0010 ECU_ADDRESS 0xFFFF3C14 READ_WRITE /end MEASUREMENT
/begin MEASUREMENT fRFNCUT "0:カット以外  1:カット状態" UBYTE COMP_0283 1 100 0 1 BIT_MASK 0x0008 ECU_ADDRESS 0xFFFF3C14 READ_WRITE /end MEASUREMENT
/begin MEASUREMENT fRFNDLY1 "0:ﾗｼﾞﾌｧﾝﾃﾞｨﾚｲ1ｶｳﾝﾄ中以外  1:ﾗｼﾞﾌｧﾝﾃﾞｨﾚｲ1ｶｳﾝﾄ中" UBYTE COMP_0283 1 100 0 1 BIT_MASK 0x0004 ECU_ADDRESS 0xFFFF3C14 READ_WRITE /end MEASUREMENT
/begin MEASUREMENT fRFQDLY1 "0:ISC負荷補正ﾃﾞｨﾚｲ1ｶｳﾝﾄ中以外  1:ISC負荷補正ﾃﾞｨﾚｲ1ｶｳﾝﾄ中" UBYTE COMP_0283 1 100 0 1 BIT_MASK 0x0002 ECU_ADDRESS 0xFFFF3C14 READ_WRITE /end MEASUREMENT
/begin MEASUREMENT fSLIG0OVR "0:ｽﾋﾟｰﾄﾞﾘﾐｯﾀﾘﾐｯﾄ車速ｵｰﾊﾞｰ判定でな  1:ｽﾋﾟｰﾄﾞﾘﾐｯﾀﾘﾐｯﾄ車速ｵｰﾊﾞｰ判定" UBYTE COMP_0283 1 100 0 1 BIT_MASK 0x0001 ECU_ADDRESS 0xFFFF3C14 READ_WRITE /end MEASUREMENT
/begin MEASUREMENT fSLVSPCA "0:ｽﾋﾟｰﾄﾞﾘﾐｯﾀ車速ﾌｪｰﾙｾｰﾌ非作動中  1:ｽﾋﾟｰﾄﾞﾘﾐｯﾀ車速ﾌｪｰﾙｾｰﾌ作動中" UBYTE COMP_0283 1 100 0 1 BIT_MASK 0x0080 ECU_ADDRESS 0xFFFF3C15 READ_WRITE /end MEASUREMENT
/begin MEASUREMENT fSTPTNEX "0:経験前  1:経験後" UBYTE COMP_0283 1 100 0 1 BIT_MASK 0x0040 ECU_ADDRESS 0xFFFF3C15 READ_WRITE /end MEASUREMENT
/begin MEASUREMENT fSTRDGN "0:診断条件不成立  1:診断条件成立" UBYTE COMP_0283 1 100 0 1 BIT_MASK 0x0020 ECU_ADDRESS 0xFFFF3C15 READ_WRITE /end MEASUREMENT
/begin MEASUREMENT fTKNG "0:突き上げ制御許可  1:突き上げ制御禁止" UBYTE COMP_0283 1 100 0 1 BIT_MASK 0x0010 ECU_ADDRESS 0xFFFF3C15 READ_WRITE /end MEASUREMENT
/begin MEASUREMENT fTQTYPMSR "0:無し  1:有り" UBYTE COMP_0283 1 100 0 1 BIT_MASK 0x0008 ECU_ADDRESS 0xFFFF3C15 READ_WRITE /end MEASUREMENT
/begin MEASUREMENT fTWADJ "0:調整制御許可水温条件不成立  1:調整制御許可水温条件成立" UBYTE COMP_0283 1 100 0 1 BIT_MASK 0x0004 ECU_ADDRESS 0xFFFF3C15 READ_WRITE /end MEASUREMENT
/begin MEASUREMENT fVTCDGN6E "0:不成立  1:成立" UBYTE COMP_0283 1 100 0 1 BIT_MASK 0x0002 ECU_ADDRESS 0xFFFF3C15 READ_WRITE /end MEASUREMENT
/begin MEASUREMENT fVTCSCLD "0:駆動不許可  1:駆動許可" UBYTE COMP_0283 1 100 0 1 BIT_MASK 0x0001 ECU_ADDRESS 0xFFFF3C15 READ_WRITE /end MEASUREMENT
/begin MEASUREMENT fVTCSCLDE "0:駆動不許可  1:駆動許可" UBYTE COMP_0283 1 100 0 1 BIT_MASK 0x0080 ECU_ADDRESS 0xFFFF3C16 READ_WRITE /end MEASUREMENT
/begin MEASUREMENT fVCSHOTEZ "0:クリーニングモード要求不許可(前  1:クリーニングモード要求許可（前回" UBYTE COMP_0283 1 100 0 1 BIT_MASK 0x0080 ECU_ADDRESS 0xFFFF1BEE READ_WRITE /end MEASUREMENT
/begin MEASUREMENT fVCSHOTZ "0:クリーニングモード要求不許可(前  1:クリーニングモード要求許可（前回" UBYTE COMP_0283 1 100 0 1 BIT_MASK 0x0040 ECU_ADDRESS 0xFFFF1BEE READ_WRITE /end MEASUREMENT
/begin MEASUREMENT fDCLR1MS "0:OBDonCAN用診断データクリア非要求  1:OBDonCAN用診断データクリア要求" UBYTE COMP_0283 1 100 0 1 BIT_MASK 0x0080 ECU_ADDRESS 0xFFFF3CBE READ_WRITE /end MEASUREMENT
/begin MEASUREMENT fAVEPFST "0:燃圧加重平均算出初回処理未処理  1:燃圧加重平均算出初回処理済み" UBYTE COMP_0283 1 100 0 1 BIT_MASK 0x0080 ECU_ADDRESS 0xFFFF1BEF READ_WRITE /end MEASUREMENT
/begin MEASUREMENT fDSTART "0:サンプリング値LO  1:サンプリング値HI" UBYTE COMP_0283 1 100 0 1 BIT_MASK 0x0040 ECU_ADDRESS 0xFFFF1BEF READ_WRITE /end MEASUREMENT
/begin MEASUREMENT fF2MSJOB "0:非実行中  1:実行中" UBYTE COMP_0283 1 100 0 1 BIT_MASK 0x0020 ECU_ADDRESS 0xFFFF1BEF READ_WRITE /end MEASUREMENT
/begin MEASUREMENT fIPDDI1 "0:MOTOR-DI1_Low  1:MOTOR-DI1_High" UBYTE COMP_0283 1 100 0 1 BIT_MASK 0x0010 ECU_ADDRESS 0xFFFF1BEF READ_WRITE /end MEASUREMENT
/begin MEASUREMENT fIPDSF "0:MOTOR-SF_Low  1:MOTOR-SF_High" UBYTE COMP_0283 1 100 0 1 BIT_MASK 0x0008 ECU_ADDRESS 0xFFFF1BEF READ_WRITE /end MEASUREMENT
/begin MEASUREMENT fMFTLINT "0:演算未  1:演算済" UBYTE COMP_0283 1 100 0 1 BIT_MASK 0x0004 ECU_ADDRESS 0xFFFF1BEF READ_WRITE /end MEASUREMENT
/begin MEASUREMENT fVSP1ST "0:初期値未セット  1:初期値セット" UBYTE COMP_0283 1 100 0 1 BIT_MASK 0x0002 ECU_ADDRESS 0xFFFF1BEF READ_WRITE /end MEASUREMENT
/begin MEASUREMENT fVSPGATE "0:706ms経過  1:706ms経過せず" UBYTE COMP_0283 1 100 0 1 BIT_MASK 0x0001 ECU_ADDRESS 0xFFFF1BEF READ_WRITE /end MEASUREMENT
/begin MEASUREMENT fBNCPULSE "0:BNC_SWﾊﾟﾙｽ入力Low  1:BNC_SWﾊﾟﾙｽ入力High" UBYTE COMP_0283 1 100 0 1 BIT_MASK 0x0080 ECU_ADDRESS 0xFFFF3CBF READ_WRITE /end MEASUREMENT
/begin MEASUREMENT fIDUTY "0:(i)の状態  1:(ii)の状態" UBYTE COMP_0283 1 100 0 1 BIT_MASK 0x0040 ECU_ADDRESS 0xFFFF3CBF READ_WRITE /end MEASUREMENT
/begin MEASUREMENT fAFMLMSTA "0:始動時上限ﾘﾐｯﾀ非反映(not_to_use_  1:始動時上限ﾘﾐｯﾀ反映(use_upper_lim" UBYTE COMP_0283 1 100 0 1 BIT_MASK 0x0080 ECU_ADDRESS 0xFFFF3CC1 READ_WRITE /end MEASUREMENT
/begin MEASUREMENT fBNCADZ "0:BNC_SWｱﾅﾛｸﾞ入力低電圧側  1:BNC_SWｱﾅﾛｸﾞ入力高電圧側" UBYTE COMP_0283 1 100 0 1 BIT_MASK 0x0040 ECU_ADDRESS 0xFFFF3CC1 READ_WRITE /end MEASUREMENT
/begin MEASUREMENT fCCW "0:ｽﾛｯﾄﾙﾓｰﾀ正転信号OFF  1:ｽﾛｯﾄﾙﾓｰﾀ正転信号ＯＮ" UBYTE COMP_0283 1 100 0 1 BIT_MASK 0x0020 ECU_ADDRESS 0xFFFF3CC1 READ_WRITE /end MEASUREMENT
/begin MEASUREMENT fDI_first "0:ディジタル入力初回値  1:ディジタル入力初回以外" UBYTE COMP_0283 1 100 0 1 BIT_MASK 0x0010 ECU_ADDRESS 0xFFFF3CC1 READ_WRITE /end MEASUREMENT
/begin MEASUREMENT fFHSTOK "0:禁止  1:許可" UBYTE COMP_0283 1 100 0 1 BIT_MASK 0x0008 ECU_ADDRESS 0xFFFF3CC1 READ_WRITE /end MEASUREMENT
/begin MEASUREMENT fFMCTH3 "0:3点火より下  1:3点火以上" UBYTE COMP_0283 1 100 0 1 BIT_MASK 0x0004 ECU_ADDRESS 0xFFFF3CC1 READ_WRITE /end MEASUREMENT
/begin MEASUREMENT fFMGTH3 "0:不成立  1:成立" UBYTE COMP_0283 1 100 0 1 BIT_MASK 0x0002 ECU_ADDRESS 0xFFFF3CC1 READ_WRITE /end MEASUREMENT
/begin MEASUREMENT fFMKTCL "0:算出未経験  1:算出経験した" UBYTE COMP_0283 1 100 0 1 BIT_MASK 0x0001 ECU_ADDRESS 0xFFFF3CC1 READ_WRITE /end MEASUREMENT
/begin MEASUREMENT fFPCDON "0:FPCMデューティOFF  1:FPCMデューティON" UBYTE COMP_0283 1 100 0 1 BIT_MASK 0x0080 ECU_ADDRESS 0xFFFF3CC2 READ_WRITE /end MEASUREMENT
/begin MEASUREMENT fFSMATH1 "0:不成立  1:成立" UBYTE COMP_0283 1 100 0 1 BIT_MASK 0x0040 ECU_ADDRESS 0xFFFF3CC2 READ_WRITE /end MEASUREMENT
/begin MEASUREMENT fFTPCHCNT "0:Not＿permission  1:Permission" UBYTE COMP_0283 1 100 0 1 BIT_MASK 0x0020 ECU_ADDRESS 0xFFFF3CC2 READ_WRITE /end MEASUREMENT
/begin MEASUREMENT fLRNSET "0:未終了  1:終了" UBYTE COMP_0283 1 100 0 1 BIT_MASK 0x0010 ECU_ADDRESS 0xFFFF3CC2 READ_WRITE /end MEASUREMENT
/begin MEASUREMENT fMAMANIF "0:未実行  1:実行済" UBYTE COMP_0283 1 100 0 1 BIT_MASK 0x0008 ECU_ADDRESS 0xFFFF3CC2 READ_WRITE /end MEASUREMENT
/begin MEASUREMENT fMFALL "0:ｶｳﾝﾄｱｯﾌﾟ未  1:ｶｳﾝﾄｱｯﾌﾟ済" UBYTE COMP_0283 1 100 0 1 BIT_MASK 0x0004 ECU_ADDRESS 0xFFFF3CC2 READ_WRITE /end MEASUREMENT
/begin MEASUREMENT fMFCNTJ "0:判定なし  1:判定あり" UBYTE COMP_0283 1 100 0 1 BIT_MASK 0x0002 ECU_ADDRESS 0xFFFF3CC2 READ_WRITE /end MEASUREMENT
/begin MEASUREMENT fMINUS "0:MISx分子正  1:MISx分子負" UBYTE COMP_0283 1 100 0 1 BIT_MASK 0x0001 ECU_ADDRESS 0xFFFF3CC2 READ_WRITE /end MEASUREMENT
/begin MEASUREMENT fPFUELINT "0:始動時_&_VB<8V  1:左記以外" UBYTE COMP_0283 1 100 0 1 BIT_MASK 0x0080 ECU_ADDRESS 0xFFFF3CC3 READ_WRITE /end MEASUREMENT
/begin MEASUREMENT fQA4SET "0:QA4を算出しない  1:QA4を算出する" UBYTE COMP_0283 1 100 0 1 BIT_MASK 0x0040 ECU_ADDRESS 0xFFFF3CC3 READ_WRITE /end MEASUREMENT
/begin MEASUREMENT fQAA2SET "0:QAA2を算出しない  1:QAA2を算出する" UBYTE COMP_0283 1 100 0 1 BIT_MASK 0x0020 ECU_ADDRESS 0xFFFF3CC3 READ_WRITE /end MEASUREMENT
/begin MEASUREMENT fQAASET "0:QAAを算出しない  1:QAAを算出する" UBYTE COMP_0283 1 100 0 1 BIT_MASK 0x0010 ECU_ADDRESS 0xFFFF3CC3 READ_WRITE /end MEASUREMENT
/begin MEASUREMENT fQMINI "0:未実行  1:実行済" UBYTE COMP_0283 1 100 0 1 BIT_MASK 0x0008 ECU_ADDRESS 0xFFFF3CC3 READ_WRITE /end MEASUREMENT
/begin MEASUREMENT fQSSET "0:QSを算出しない  1:QSを算出する" UBYTE COMP_0283 1 100 0 1 BIT_MASK 0x0004 ECU_ADDRESS 0xFFFF3CC3 READ_WRITE /end MEASUREMENT
/begin MEASUREMENT fRCW "0:ｽﾛｯﾄﾙﾓｰﾀ逆転信号OFF  1:ｽﾛｯﾄﾙﾓｰﾀ逆転信号ＯＮ" UBYTE COMP_0283 1 100 0 1 BIT_MASK 0x0002 ECU_ADDRESS 0xFFFF3CC3 READ_WRITE /end MEASUREMENT
/begin MEASUREMENT fSTSW2Z "0:VBF_set  1:VBF_set" UBYTE COMP_0283 1 100 0 1 BIT_MASK 0x0001 ECU_ADDRESS 0xFFFF3CC3 READ_WRITE /end MEASUREMENT
/begin MEASUREMENT fSTSWZAFM "0:STSW_OFF  1:STSW_ON" UBYTE COMP_0283 1 100 0 1 BIT_MASK 0x0080 ECU_ADDRESS 0xFFFF3CC4 READ_WRITE /end MEASUREMENT
/begin MEASUREMENT fTPSAVSET "0:未終了  1:終了" UBYTE COMP_0283 1 100 0 1 BIT_MASK 0x0040 ECU_ADDRESS 0xFFFF3CC4 READ_WRITE /end MEASUREMENT
/begin MEASUREMENT fTPSCLD "0:未設定  1:設定" UBYTE COMP_0283 1 100 0 1 BIT_MASK 0x0020 ECU_ADDRESS 0xFFFF3CC4 READ_WRITE /end MEASUREMENT
/begin MEASUREMENT fTPSCLD1 "0:不成立  1:成立" UBYTE COMP_0283 1 100 0 1 BIT_MASK 0x0010 ECU_ADDRESS 0xFFFF3CC4 READ_WRITE /end MEASUREMENT
/begin MEASUREMENT fTVOGK "0:  1:" UBYTE COMP_0283 1 100 0 1 BIT_MASK 0x0008 ECU_ADDRESS 0xFFFF3CC4 READ_WRITE /end MEASUREMENT
/begin MEASUREMENT fVBFEND "0:不成立  1:成立" UBYTE COMP_0283 1 100 0 1 BIT_MASK 0x0004 ECU_ADDRESS 0xFFFF3CC4 READ_WRITE /end MEASUREMENT
/begin MEASUREMENT fVBLRN "0:VB_S＜mVBRLN(ﾋｽ-800mV)  1:VB_S≧mVBRLN(ﾋｽ-800mV)" UBYTE COMP_0283 1 100 0 1 BIT_MASK 0x0002 ECU_ADDRESS 0xFFFF3CC4 READ_WRITE /end MEASUREMENT
/begin MEASUREMENT fVTMNAEF1 "0:VTC駆動電流モニタ加重平均算出初  1:VTC駆動電流モニタ加重平均算出初" UBYTE COMP_0283 1 100 0 1 BIT_MASK 0x0001 ECU_ADDRESS 0xFFFF3CC4 READ_WRITE /end MEASUREMENT
/begin MEASUREMENT fVTMNAIF1 "0:VTC駆動電流モニタ加重平均算出初  1:VTC駆動電流モニタ加重平均算出初" UBYTE COMP_0283 1 100 0 1 BIT_MASK 0x0080 ECU_ADDRESS 0xFFFF3CC5 READ_WRITE /end MEASUREMENT
/begin MEASUREMENT fAVTQH "0:vQH0<mAVTQHL  1:vQH0>=mAVTQHH且つvAVTPRz>=vTPTRM" UBYTE COMP_0283 1 100 0 1 BIT_MASK 0x0080 ECU_ADDRESS 0xFFFF1BF0 READ_WRITE /end MEASUREMENT
/begin MEASUREMENT fF4MSJOB "0:非実行中  1:実行中" UBYTE COMP_0283 1 100 0 1 BIT_MASK 0x0040 ECU_ADDRESS 0xFFFF1BF0 READ_WRITE /end MEASUREMENT
/begin MEASUREMENT fGENSOKU "0:不成立  1:成立" UBYTE COMP_0283 1 100 0 1 BIT_MASK 0x0020 ECU_ADDRESS 0xFFFF1BF0 READ_WRITE /end MEASUREMENT
/begin MEASUREMENT fITANDMCH "0:fITANDM=fITANDMz  1:fITANDM≠fITANDMz" UBYTE COMP_0283 1 100 0 1 BIT_MASK 0x0010 ECU_ADDRESS 0xFFFF1BF0 READ_WRITE /end MEASUREMENT
/begin MEASUREMENT fKASOKU "0:不成立  1:成立" UBYTE COMP_0283 1 100 0 1 BIT_MASK 0x0008 ECU_ADDRESS 0xFFFF1BF0 READ_WRITE /end MEASUREMENT
/begin MEASUREMENT fQSIGN "0:vQAA-mQAOFST>=0  1:vQAA-mQAOFST<0" UBYTE COMP_0283 1 100 0 1 BIT_MASK 0x0004 ECU_ADDRESS 0xFFFF1BF0 READ_WRITE /end MEASUREMENT
/begin MEASUREMENT fCYLCHGE "0:CYLCNT変化無し  1:CYLCNT変化有り" UBYTE COMP_0283 1 100 0 1 BIT_MASK 0x0080 ECU_ADDRESS 0xFFFF3CC6 READ_WRITE /end MEASUREMENT
/begin MEASUREMENT fF1USB "0:USB初回演算未完了  1:USB初回演算完了" UBYTE COMP_0283 1 100 0 1 BIT_MASK 0x0040 ECU_ADDRESS 0xFFFF3CC6 READ_WRITE /end MEASUREMENT
/begin MEASUREMENT fFRECVOPN "0:REC/V閉  1:REC/V開" UBYTE COMP_0283 1 100 0 1 BIT_MASK 0x0020 ECU_ADDRESS 0xFFFF3CC6 READ_WRITE /end MEASUREMENT
/begin MEASUREMENT fHAFMA0 "0:条件A成立しない  1:条件A成立" UBYTE COMP_0283 1 100 0 1 BIT_MASK 0x0010 ECU_ADDRESS 0xFFFF3CC6 READ_WRITE /end MEASUREMENT
/begin MEASUREMENT fHAFMA1 "0:条件A成立しない  1:条件A成立" UBYTE COMP_0283 1 100 0 1 BIT_MASK 0x0008 ECU_ADDRESS 0xFFFF3CC6 READ_WRITE /end MEASUREMENT
/begin MEASUREMENT fHAFMB0 "0:条件B成立しない  1:条件B成立" UBYTE COMP_0283 1 100 0 1 BIT_MASK 0x0004 ECU_ADDRESS 0xFFFF3CC6 READ_WRITE /end MEASUREMENT
/begin MEASUREMENT fHAFMB1 "0:条件B成立しない  1:条件B成立" UBYTE COMP_0283 1 100 0 1 BIT_MASK 0x0002 ECU_ADDRESS 0xFFFF3CC6 READ_WRITE /end MEASUREMENT
/begin MEASUREMENT fOKURI "0:vOKURI負  1:vOKURI正" UBYTE COMP_0283 1 100 0 1 BIT_MASK 0x0001 ECU_ADDRESS 0xFFFF3CC6 READ_WRITE /end MEASUREMENT
/begin MEASUREMENT fRECVSTR "0:右記以外  1:RECVSTR_>=_RECVOPN_(_ﾋｽﾃﾘｼｽ_-HYS" UBYTE COMP_0283 1 100 0 1 BIT_MASK 0x0080 ECU_ADDRESS 0xFFFF3CC7 READ_WRITE /end MEASUREMENT
/begin MEASUREMENT fSSOFT1E "0:SSOFT1演算完了しない  1:SSOFT1演算完了" UBYTE COMP_0283 1 100 0 1 BIT_MASK 0x0040 ECU_ADDRESS 0xFFFF3CC7 READ_WRITE /end MEASUREMENT
/begin MEASUREMENT fSSOFTME "0:SSOFTM演算完了しない  1:SSOFTM演算完了" UBYTE COMP_0283 1 100 0 1 BIT_MASK 0x0020 ECU_ADDRESS 0xFFFF3CC7 READ_WRITE /end MEASUREMENT
/begin MEASUREMENT fVBHOS1 "0:VBHOS初回演算しない  1:VBHOS初回演算" UBYTE COMP_0283 1 100 0 1 BIT_MASK 0x0010 ECU_ADDRESS 0xFFFF3CC7 READ_WRITE /end MEASUREMENT
/begin MEASUREMENT fVERR1 "0:VERR初回演算フラグしない  1:VERR初回演算フラグ" UBYTE COMP_0283 1 100 0 1 BIT_MASK 0x0008 ECU_ADDRESS 0xFFFF3CC7 READ_WRITE /end MEASUREMENT
/begin MEASUREMENT fVERR2 "0:VERR演算経験しない  1:VERR演算経験" UBYTE COMP_0283 1 100 0 1 BIT_MASK 0x0004 ECU_ADDRESS 0xFFFF3CC7 READ_WRITE /end MEASUREMENT
/begin MEASUREMENT fMTPFIRST "0:初回  1:2回目以降" UBYTE COMP_0283 1 100 0 1 BIT_MASK 0x0080 ECU_ADDRESS 0xFFFF562C READ_WRITE /end MEASUREMENT
/begin MEASUREMENT fTWINT "0:始動時_&_VB<8V  1:左記以外" UBYTE COMP_0283 1 100 0 1 BIT_MASK 0x0080 ECU_ADDRESS 0xFFFF1BF1 READ_WRITE /end MEASUREMENT
/begin MEASUREMENT fAACOUTZ "0:OFF  1:ON" UBYTE COMP_0283 1 100 0 1 BIT_MASK 0x0080 ECU_ADDRESS 0xFFFF1BF3 READ_WRITE /end MEASUREMENT
/begin MEASUREMENT fACCAPO "0:ｶｯﾄ以外  1:ｴｱｺﾝｶｯﾄ状態１" UBYTE COMP_0283 1 100 0 1 BIT_MASK 0x0040 ECU_ADDRESS 0xFFFF1BF3 READ_WRITE /end MEASUREMENT
/begin MEASUREMENT fAPOFSINI "0:初回  1:初回以降" UBYTE COMP_0283 1 100 0 1 BIT_MASK 0x0020 ECU_ADDRESS 0xFFFF1BF3 READ_WRITE /end MEASUREMENT
/begin MEASUREMENT fBATSKINI "0:BATSENKの未初期化  1:BATSENKの初期化済" UBYTE COMP_0283 1 100 0 1 BIT_MASK 0x0010 ECU_ADDRESS 0xFFFF1BF3 READ_WRITE /end MEASUREMENT
/begin MEASUREMENT fCLOAD2 "0:OFF  1:ON" UBYTE COMP_0283 1 100 0 1 BIT_MASK 0x0008 ECU_ADDRESS 0xFFFF1BF3 READ_WRITE /end MEASUREMENT
/begin MEASUREMENT fDADOUT "0:OFF  1:ON" UBYTE COMP_0283 1 100 0 1 BIT_MASK 0x0004 ECU_ADDRESS 0xFFFF1BF3 READ_WRITE /end MEASUREMENT
/begin MEASUREMENT fEXADC "0:A/Dカット不実行  1:A/Dカット中" UBYTE COMP_0283 1 100 0 1 BIT_MASK 0x0002 ECU_ADDRESS 0xFFFF1BF3 READ_WRITE /end MEASUREMENT
/begin MEASUREMENT fF10MSJOB "0:非実行中  1:実行中" UBYTE COMP_0283 1 100 0 1 BIT_MASK 0x0001 ECU_ADDRESS 0xFFFF1BF3 READ_WRITE /end MEASUREMENT
/begin MEASUREMENT fF1PRESN "0:PRESN_set初回でない  1:PRESN_set初回" UBYTE COMP_0283 1 100 0 1 BIT_MASK 0x0080 ECU_ADDRESS 0xFFFF1BF4 READ_WRITE /end MEASUREMENT
/begin MEASUREMENT fFACCUT1 "0:ACUUT1ｸﾘｱﾋﾞｯﾄ  1:ACUUT1ｾｯﾄﾋﾞｯﾄ" UBYTE COMP_0283 1 100 0 1 BIT_MASK 0x0040 ECU_ADDRESS 0xFFFF1BF4 READ_WRITE /end MEASUREMENT
/begin MEASUREMENT fFLAG_FC "0:非カット中  1:カット中" UBYTE COMP_0283 1 100 0 1 BIT_MASK 0x0020 ECU_ADDRESS 0xFFFF1BF4 READ_WRITE /end MEASUREMENT
/begin MEASUREMENT fFLUZ "0:ﾛｯｸｱｯﾌﾟ判定不成立  1:ﾛｯｸｱｯﾌﾟ判定成立" UBYTE COMP_0283 1 100 0 1 BIT_MASK 0x0010 ECU_ADDRESS 0xFFFF1BF4 READ_WRITE /end MEASUREMENT
/begin MEASUREMENT fFPEVPIN "0:初回  1:初回以降" UBYTE COMP_0283 1 100 0 1 BIT_MASK 0x0008 ECU_ADDRESS 0xFFFF1BF4 READ_WRITE /end MEASUREMENT
/begin MEASUREMENT fFPEVPIN2 "0:初回  1:初回以降" UBYTE COMP_0283 1 100 0 1 BIT_MASK 0x0004 ECU_ADDRESS 0xFFFF1BF4 READ_WRITE /end MEASUREMENT
/begin MEASUREMENT fFPRESIN "0:PRESS_set初回でない  1:PRESS_set初回" UBYTE COMP_0283 1 100 0 1 BIT_MASK 0x0002 ECU_ADDRESS 0xFFFF1BF4 READ_WRITE /end MEASUREMENT
/begin MEASUREMENT fFPTDINH "0:PTD許可  1:PTD禁止" UBYTE COMP_0283 1 100 0 1 BIT_MASK 0x0001 ECU_ADDRESS 0xFFFF1BF4 READ_WRITE /end MEASUREMENT
/begin MEASUREMENT fFST10MS "0:エンスト後初回10msJob  1:エンスト後初回以外10msJob" UBYTE COMP_0283 1 100 0 1 BIT_MASK 0x0080 ECU_ADDRESS 0xFFFF1BF5 READ_WRITE /end MEASUREMENT
/begin MEASUREMENT fFSTF "0:OK  1:NG" UBYTE COMP_0283 1 100 0 1 BIT_MASK 0x0040 ECU_ADDRESS 0xFFFF1BF5 READ_WRITE /end MEASUREMENT
/begin MEASUREMENT fFTFKITS "0:初回  1:初回以降" UBYTE COMP_0283 1 100 0 1 BIT_MASK 0x0020 ECU_ADDRESS 0xFFFF1BF5 READ_WRITE /end MEASUREMENT
/begin MEASUREMENT fHIDN1 "0:ｿﾌﾄｱｲﾄﾞﾙｽｲｯﾁOFF->ON  1:ｿﾌﾄｱｲﾄﾞﾙｽｲｯﾁOFF" UBYTE COMP_0283 1 100 0 1 BIT_MASK 0x0010 ECU_ADDRESS 0xFFFF1BF5 READ_WRITE /end MEASUREMENT
/begin MEASUREMENT fHIDN2 "0:ｿﾌﾄｱｲﾄﾞﾙｽｲｯﾁOFF->ON  1:ｿﾌﾄｱｲﾄﾞﾙｽｲｯﾁOFF" UBYTE COMP_0283 1 100 0 1 BIT_MASK 0x0008 ECU_ADDRESS 0xFFFF1BF5 READ_WRITE /end MEASUREMENT
/begin MEASUREMENT fHPPKNE "0:不成立  1:成立" UBYTE COMP_0283 1 100 0 1 BIT_MASK 0x0004 ECU_ADDRESS 0xFFFF1BF5 READ_WRITE /end MEASUREMENT
/begin MEASUREMENT fIDLEA1 "0:ｿﾌﾄｱｲﾄﾞﾙｽｲｯﾁON  1:ｿﾌﾄｱｲﾄﾞﾙｽｲｯﾁOFF" UBYTE COMP_0283 1 100 0 1 BIT_MASK 0x0002 ECU_ADDRESS 0xFFFF1BF5 READ_WRITE /end MEASUREMENT
/begin MEASUREMENT fIDLEA2 "0:ｿﾌﾄｱｲﾄﾞﾙｽｲｯﾁON  1:ｿﾌﾄｱｲﾄﾞﾙｽｲｯﾁOFF" UBYTE COMP_0283 1 100 0 1 BIT_MASK 0x0001 ECU_ADDRESS 0xFFFF1BF5 READ_WRITE /end MEASUREMENT
/begin MEASUREMENT fINHBOFFBK "0:条件成立非経験  1:条件成立経験" UBYTE COMP_0283 1 100 0 1 BIT_MASK 0x0080 ECU_ADDRESS 0xFFFF1BF6 READ_WRITE /end MEASUREMENT
/begin MEASUREMENT fIREVFLI "0:CVT入力回転数ﾌｨﾙﾀﾘﾝｸﾞ初回未実行  1:CVT入力回転数ﾌｨﾙﾀﾘﾝｸﾞ初回実行済" UBYTE COMP_0283 1 100 0 1 BIT_MASK 0x0040 ECU_ADDRESS 0xFFFF1BF6 READ_WRITE /end MEASUREMENT
/begin MEASUREMENT fISCFBTO "0:ISC_F/B_早期化不許可  1:ISC_F/B_早期化許可" UBYTE COMP_0283 1 100 0 1 BIT_MASK 0x0020 ECU_ADDRESS 0xFFFF1BF6 READ_WRITE /end MEASUREMENT
/begin MEASUREMENT fISCFBTW "0:ISC_F/B_早期化不許可  1:ISC_F/B_早期化許可" UBYTE COMP_0283 1 100 0 1 BIT_MASK 0x0010 ECU_ADDRESS 0xFFFF1BF6 READ_WRITE /end MEASUREMENT
/begin MEASUREMENT fISCTAT "0:ISC_F/B_早期化不許可  1:ISC_F/B_早期化許可" UBYTE COMP_0283 1 100 0 1 BIT_MASK 0x0008 ECU_ADDRESS 0xFFFF1BF6 READ_WRITE /end MEASUREMENT
/begin MEASUREMENT fISFLTW "0:high  1:low" UBYTE COMP_0283 1 100 0 1 BIT_MASK 0x0004 ECU_ADDRESS 0xFFFF1BF6 READ_WRITE /end MEASUREMENT
/begin MEASUREMENT fLNSTSW "0:ソフトスタータスイッチON条件不成  1:ソフトスタータスイッチON条件成立" UBYTE COMP_0283 1 100 0 1 BIT_MASK 0x0002 ECU_ADDRESS 0xFFFF1BF6 READ_WRITE /end MEASUREMENT
/begin MEASUREMENT fNIDLNEUT "0:非遷移時  1:遷移時" UBYTE COMP_0283 1 100 0 1 BIT_MASK 0x0001 ECU_ADDRESS 0xFFFF1BF6 READ_WRITE /end MEASUREMENT
/begin MEASUREMENT fNTPSEL "0:NRPM<NTPSEL(ヒス_-HNTPS_)  1:NRPM>=NTPSEL(ヒス_-HNTPS_)" UBYTE COMP_0283 1 100 0 1 BIT_MASK 0x0080 ECU_ADDRESS 0xFFFF1BF7 READ_WRITE /end MEASUREMENT
/begin MEASUREMENT fOREVFLI "0:CVT出力回転数ﾌｨﾙﾀﾘﾝｸﾞ初回未実行  1:CVT出力回転数ﾌｨﾙﾀﾘﾝｸﾞ初回実行済" UBYTE COMP_0283 1 100 0 1 BIT_MASK 0x0040 ECU_ADDRESS 0xFFFF1BF7 READ_WRITE /end MEASUREMENT
/begin MEASUREMENT fOUTRVINI "0:初回時  1:初回以外" UBYTE COMP_0283 1 100 0 1 BIT_MASK 0x0020 ECU_ADDRESS 0xFFFF1BF7 READ_WRITE /end MEASUREMENT
/begin MEASUREMENT fPPSVHYS "0:右記以外  1:vPPSV≧mPPSVSW(ﾋｽ-mPPSVHYS)" UBYTE COMP_0283 1 100 0 1 BIT_MASK 0x0010 ECU_ADDRESS 0xFFFF1BF7 READ_WRITE /end MEASUREMENT
/begin MEASUREMENT fPWSTHYS "0:PWST/SW_OFF  1:PWST/SW_ON" UBYTE COMP_0283 1 100 0 1 BIT_MASK 0x0008 ECU_ADDRESS 0xFFFF1BF7 READ_WRITE /end MEASUREMENT
/begin MEASUREMENT fQCK1 "0:未収束  1:収束" UBYTE COMP_0283 1 100 0 1 BIT_MASK 0x0004 ECU_ADDRESS 0xFFFF1BF7 READ_WRITE /end MEASUREMENT
/begin MEASUREMENT fQCKINIT "0:未実行  1:実行済" UBYTE COMP_0283 1 100 0 1 BIT_MASK 0x0002 ECU_ADDRESS 0xFFFF1BF7 READ_WRITE /end MEASUREMENT
/begin MEASUREMENT fREVCOAST "0:ドライブ状態  1:コースト状態" UBYTE COMP_0283 1 100 0 1 BIT_MASK 0x0001 ECU_ADDRESS 0xFFFF1BF7 READ_WRITE /end MEASUREMENT
/begin MEASUREMENT fRUNOK2 "0:ｴﾝｼﾞﾝ回転時間経過非経験  1:ｴﾝｼﾞﾝ回転時間経過経験" UBYTE COMP_0283 1 100 0 1 BIT_MASK 0x0080 ECU_ADDRESS 0xFFFF1BF8 READ_WRITE /end MEASUREMENT
/begin MEASUREMENT fSMLUFLG "0:ｽﾑｰｽLU中以外  1:ｽﾑｰｽLU中" UBYTE COMP_0283 1 100 0 1 BIT_MASK 0x0040 ECU_ADDRESS 0xFFFF1BF8 READ_WRITE /end MEASUREMENT
/begin MEASUREMENT fSSTSWOFF "0:ソフトスタータスイッチOFF条件不  1:ソフトスタータスイッチOFF条件成" UBYTE COMP_0283 1 100 0 1 BIT_MASK 0x0020 ECU_ADDRESS 0xFFFF1BF8 READ_WRITE /end MEASUREMENT
/begin MEASUREMENT fSSTSWON "0:ソフトスタータスイッチON条件不成  1:ソフトスタータスイッチON条件成立" UBYTE COMP_0283 1 100 0 1 BIT_MASK 0x0010 ECU_ADDRESS 0xFFFF1BF8 READ_WRITE /end MEASUREMENT
/begin MEASUREMENT fst_one "0:VO2初回処理未  1:VO2初回処理済み" UBYTE COMP_0283 1 100 0 1 BIT_MASK 0x0008 ECU_ADDRESS 0xFFFF1BF8 READ_WRITE /end MEASUREMENT
/begin MEASUREMENT fSTONOFEX "0:未経験  1:経験" UBYTE COMP_0283 1 100 0 1 BIT_MASK 0x0004 ECU_ADDRESS 0xFFFF1BF8 READ_WRITE /end MEASUREMENT
/begin MEASUREMENT fTFINT "0:始動時_&_VB<8V  1:左記以外" UBYTE COMP_0283 1 100 0 1 BIT_MASK 0x0002 ECU_ADDRESS 0xFFFF1BF8 READ_WRITE /end MEASUREMENT
/begin MEASUREMENT fTFKINT "0:電源ON後_or_ｴﾝｽﾄ判定後_初回  1:左記以外" UBYTE COMP_0283 1 100 0 1 BIT_MASK 0x0001 ECU_ADDRESS 0xFFFF1BF8 READ_WRITE /end MEASUREMENT
/begin MEASUREMENT fTNGRATIO "0:ISC_F/B_開始切替不許可  1:ISC_F/B_開始切替許可" UBYTE COMP_0283 1 100 0 1 BIT_MASK 0x0080 ECU_ADDRESS 0xFFFF1BF9 READ_WRITE /end MEASUREMENT
/begin MEASUREMENT fTOEX "0:正常  1:異常" UBYTE COMP_0283 1 100 0 1 BIT_MASK 0x0040 ECU_ADDRESS 0xFFFF1BF9 READ_WRITE /end MEASUREMENT
/begin MEASUREMENT fTOINT "0:始動時_&_VB<8V  1:左記以外" UBYTE COMP_0283 1 100 0 1 BIT_MASK 0x0020 ECU_ADDRESS 0xFFFF1BF9 READ_WRITE /end MEASUREMENT
/begin MEASUREMENT fTVINC "0:未更新  1:更新時" UBYTE COMP_0283 1 100 0 1 BIT_MASK 0x0010 ECU_ADDRESS 0xFFFF1BF9 READ_WRITE /end MEASUREMENT
/begin MEASUREMENT fTVUP "0:未更新  1:更新時" UBYTE COMP_0283 1 100 0 1 BIT_MASK 0x0008 ECU_ADDRESS 0xFFFF1BF9 READ_WRITE /end MEASUREMENT
/begin MEASUREMENT fUHFIRST "0:ＵＨデータ送受信初回  1:ＵＨデータ送受信通常" UBYTE COMP_0283 1 100 0 1 BIT_MASK 0x0004 ECU_ADDRESS 0xFFFF1BF9 READ_WRITE /end MEASUREMENT
/begin MEASUREMENT fUHREGNG "0:ＵＨレジスタ設定ＯＫ  1:ＵＨレジスタ設定ＮＧ" UBYTE COMP_0283 1 100 0 1 BIT_MASK 0x0002 ECU_ADDRESS 0xFFFF1BF9 READ_WRITE /end MEASUREMENT
/begin MEASUREMENT fVBINT "0:VBINT更新しない  1:VBINT更新する" UBYTE COMP_0283 1 100 0 1 BIT_MASK 0x0001 ECU_ADDRESS 0xFFFF1BF9 READ_WRITE /end MEASUREMENT
/begin MEASUREMENT fVPRESEX "0:正常  1:異常" UBYTE COMP_0283 1 100 0 1 BIT_MASK 0x0080 ECU_ADDRESS 0xFFFF1BFA READ_WRITE /end MEASUREMENT
/begin MEASUREMENT fVSPGATE2 "0:706ms経過  1:706ms経過せず" UBYTE COMP_0283 1 100 0 1 BIT_MASK 0x0040 ECU_ADDRESS 0xFFFF1BFA READ_WRITE /end MEASUREMENT
/begin MEASUREMENT fIDLEA1_S "0:ｿﾌﾄｱｲﾄﾞﾙｽｲｯﾁON  1:ｿﾌﾄｱｲﾄﾞﾙｽｲｯﾁOFF" UBYTE COMP_0283 1 100 0 1 BIT_MASK 0x0020 ECU_ADDRESS 0xFFFF1BFA READ_WRITE /end MEASUREMENT
/begin MEASUREMENT fMAIN_SWA "0:ACCメインSW_OFF  1:ACCメインSW_ON" UBYTE COMP_0283 1 100 0 1 BIT_MASK 0x0010 ECU_ADDRESS 0xFFFF1BFA READ_WRITE /end MEASUREMENT
/begin MEASUREMENT fASCDCRU "0:ｲﾝﾁﾝｸﾞACCｸﾙｰｽﾞﾌﾗｸﾞOFF  1:ｲﾝﾁﾝｸﾞACCｸﾙｰｽﾞﾌﾗｸﾞON" UBYTE COMP_0283 1 100 0 1 BIT_MASK 0x0080 ECU_ADDRESS 0xFFFF3CC8 READ_WRITE /end MEASUREMENT
/begin MEASUREMENT fENGEXP "0:ｴﾝｼﾞﾝ始動時下限回転数非経験  1:ｴﾝｼﾞﾝ始動時下限回転数経験" UBYTE COMP_0283 1 100 0 1 BIT_MASK 0x0040 ECU_ADDRESS 0xFFFF3CC8 READ_WRITE /end MEASUREMENT
/begin MEASUREMENT fGLRNST "0:未許可  1:許可" UBYTE COMP_0283 1 100 0 1 BIT_MASK 0x0020 ECU_ADDRESS 0xFFFF3CC8 READ_WRITE /end MEASUREMENT
/begin MEASUREMENT fGLRNTIM "0:ゼロ点補正未実施  1:ゼロ点補正実施" UBYTE COMP_0283 1 100 0 1 BIT_MASK 0x0010 ECU_ADDRESS 0xFFFF3CC8 READ_WRITE /end MEASUREMENT
/begin MEASUREMENT fGSENLRN "0:要求有り  1:要求無し" UBYTE COMP_0283 1 100 0 1 BIT_MASK 0x0008 ECU_ADDRESS 0xFFFF3CC8 READ_WRITE /end MEASUREMENT
/begin MEASUREMENT fHPHDINE "0:不成立  1:成立" UBYTE COMP_0283 1 100 0 1 BIT_MASK 0x0004 ECU_ADDRESS 0xFFFF3CC8 READ_WRITE /end MEASUREMENT
/begin MEASUREMENT fHPPLCUR "0:-  1:-" UBYTE COMP_0283 1 100 0 1 BIT_MASK 0x0002 ECU_ADDRESS 0xFFFF3CC8 READ_WRITE /end MEASUREMENT
/begin MEASUREMENT fINJPKCR "0:Ipeak_current設定(ⅱ)条件成立  1:Ipeak_current設定(ⅰ)条件成立" UBYTE COMP_0283 1 100 0 1 BIT_MASK 0x0001 ECU_ADDRESS 0xFFFF3CC8 READ_WRITE /end MEASUREMENT
/begin MEASUREMENT fISSTONOK "0:クランキング禁止  1:クランキング許可" UBYTE COMP_0283 1 100 0 1 BIT_MASK 0x0080 ECU_ADDRESS 0xFFFF3CC9 READ_WRITE /end MEASUREMENT
/begin MEASUREMENT fTWINTR "0:始動時_&_VB<8V  1:左記以外" UBYTE COMP_0283 1 100 0 1 BIT_MASK 0x0040 ECU_ADDRESS 0xFFFF3CC9 READ_WRITE /end MEASUREMENT
/begin MEASUREMENT fFSTRTDTU "0:不成立  1:成立" UBYTE COMP_0283 1 100 0 1 BIT_MASK 0x0080 ECU_ADDRESS 0xFFFF1BFB READ_WRITE /end MEASUREMENT
/begin MEASUREMENT fADV1ST "0:初回ADV演算未了  1:初回ADV演算終了" UBYTE COMP_0283 1 100 0 1 BIT_MASK 0x0080 ECU_ADDRESS 0xFFFF1BFD READ_WRITE /end MEASUREMENT
/begin MEASUREMENT fADVBLP "0:切換外  1:PI制御からP制御への切換中" UBYTE COMP_0283 1 100 0 1 BIT_MASK 0x0040 ECU_ADDRESS 0xFFFF1BFD READ_WRITE /end MEASUREMENT
/begin MEASUREMENT fADVFB "0:ADV_OPEN  1:ADV_CLOSED" UBYTE COMP_0283 1 100 0 1 BIT_MASK 0x0020 ECU_ADDRESS 0xFFFF1BFD READ_WRITE /end MEASUREMENT
/begin MEASUREMENT fADVL1ST "0:ADVL初期値設定  1:ADVL=vADVz" UBYTE COMP_0283 1 100 0 1 BIT_MASK 0x0010 ECU_ADDRESS 0xFFFF1BFD READ_WRITE /end MEASUREMENT
/begin MEASUREMENT fADVSTRT "0:条件不成立  1:条件成立" UBYTE COMP_0283 1 100 0 1 BIT_MASK 0x0008 ECU_ADDRESS 0xFFFF1BFD READ_WRITE /end MEASUREMENT
/begin MEASUREMENT fCAMNOISE "0:検出なし  1:検出あり" UBYTE COMP_0283 1 100 0 1 BIT_MASK 0x0004 ECU_ADDRESS 0xFFFF1BFD READ_WRITE /end MEASUREMENT
/begin MEASUREMENT fCLCHGOVT "0:不成立  1:成立" UBYTE COMP_0283 1 100 0 1 BIT_MASK 0x0002 ECU_ADDRESS 0xFFFF1BFD READ_WRITE /end MEASUREMENT
/begin MEASUREMENT fCSBUFST "0:クラセン故障時制御初回CYLGATE,C  1:クラセン故障時制御初回CYLGATE,C" UBYTE COMP_0283 1 100 0 1 BIT_MASK 0x0001 ECU_ADDRESS 0xFFFF1BFD READ_WRITE /end MEASUREMENT
/begin MEASUREMENT fDNEREFFL "0:DNEREFFL初回演算経験なし  1:DNEREFFL初回演算経験あり" UBYTE COMP_0283 1 100 0 1 BIT_MASK 0x0080 ECU_ADDRESS 0xFFFF1BFE READ_WRITE /end MEASUREMENT
/begin MEASUREMENT fEVAPGO "0:タイミングOFF  1:タイミングON" UBYTE COMP_0283 1 100 0 1 BIT_MASK 0x0040 ECU_ADDRESS 0xFFFF1BFE READ_WRITE /end MEASUREMENT
/begin MEASUREMENT fEVAPST "0:右記以外  1:初回" UBYTE COMP_0283 1 100 0 1 BIT_MASK 0x0020 ECU_ADDRESS 0xFFFF1BFE READ_WRITE /end MEASUREMENT
/begin MEASUREMENT fFADVVSPZ "0:車速条件非成立  1:車速条件非成立" UBYTE COMP_0283 1 100 0 1 BIT_MASK 0x0010 ECU_ADDRESS 0xFFFF1BFE READ_WRITE /end MEASUREMENT
/begin MEASUREMENT fFISCVSPZ "0:車速条件非成立  1:車速条件非成立" UBYTE COMP_0283 1 100 0 1 BIT_MASK 0x0008 ECU_ADDRESS 0xFFFF1BFE READ_WRITE /end MEASUREMENT
/begin MEASUREMENT fFITLAV "0:低回転時プレイグ回避点火時期切換  1:低回転時プレイグ回避点火時期切換" UBYTE COMP_0283 1 100 0 1 BIT_MASK 0x0004 ECU_ADDRESS 0xFFFF1BFE READ_WRITE /end MEASUREMENT
/begin MEASUREMENT fFPLINJZ2Z "0:不成立  1:成立" UBYTE COMP_0283 1 100 0 1 BIT_MASK 0x0002 ECU_ADDRESS 0xFFFF1BFE READ_WRITE /end MEASUREMENT
/begin MEASUREMENT fFSEINJ "0:均質ｼｰｹﾝｼｬﾙ噴射中  1:成層ｼｰｹﾝｼｬﾙ噴射中" UBYTE COMP_0283 1 100 0 1 BIT_MASK 0x0001 ECU_ADDRESS 0xFFFF1BFE READ_WRITE /end MEASUREMENT
/begin MEASUREMENT fFSTPOS "0:POS入力無し  1:POS入力在り" UBYTE COMP_0283 1 100 0 1 BIT_MASK 0x0080 ECU_ADDRESS 0xFFFF1BFF READ_WRITE /end MEASUREMENT
/begin MEASUREMENT fFSTRTDTV "0:不成立  1:成立" UBYTE COMP_0283 1 100 0 1 BIT_MASK 0x0040 ECU_ADDRESS 0xFFFF1BFF READ_WRITE /end MEASUREMENT
/begin MEASUREMENT fFSTRTDTW "0:不成立  1:成立" UBYTE COMP_0283 1 100 0 1 BIT_MASK 0x0020 ECU_ADDRESS 0xFFFF1BFF READ_WRITE /end MEASUREMENT
/begin MEASUREMENT fFWT2IJAV "0:不成立  1:成立" UBYTE COMP_0283 1 100 0 1 BIT_MASK 0x0010 ECU_ADDRESS 0xFFFF1BFF READ_WRITE /end MEASUREMENT
/begin MEASUREMENT fFWT2IJZ2 "0:不成立  1:成立" UBYTE COMP_0283 1 100 0 1 BIT_MASK 0x0008 ECU_ADDRESS 0xFFFF1BFF READ_WRITE /end MEASUREMENT
/begin MEASUREMENT fFWT2IJZ3 "0:不成立  1:成立" UBYTE COMP_0283 1 100 0 1 BIT_MASK 0x0004 ECU_ADDRESS 0xFFFF1BFF READ_WRITE /end MEASUREMENT
/begin MEASUREMENT fFWT2IJZB "0:不成立  1:成立" UBYTE COMP_0283 1 100 0 1 BIT_MASK 0x0002 ECU_ADDRESS 0xFFFF1BFF READ_WRITE /end MEASUREMENT
/begin MEASUREMENT fGAP1ST "0:右記以外  1:初回演算" UBYTE COMP_0283 1 100 0 1 BIT_MASK 0x0001 ECU_ADDRESS 0xFFFF1BFF READ_WRITE /end MEASUREMENT
/begin MEASUREMENT fGSLADLM "0:点火時期F/BADV条件不成立  1:点火時期F/BADV条件成立" UBYTE COMP_0283 1 100 0 1 BIT_MASK 0x0080 ECU_ADDRESS 0xFFFF1C00 READ_WRITE /end MEASUREMENT
/begin MEASUREMENT fIDELAY "0:ディレイ経過前  1:ディレイ経過後" UBYTE COMP_0283 1 100 0 1 BIT_MASK 0x0040 ECU_ADDRESS 0xFFFF1C00 READ_WRITE /end MEASUREMENT
/begin MEASUREMENT fIDELAY1 "0:ディレイ経過前  1:ディレイ経過後" UBYTE COMP_0283 1 100 0 1 BIT_MASK 0x0020 ECU_ADDRESS 0xFFFF1C00 READ_WRITE /end MEASUREMENT
/begin MEASUREMENT fIDELAYZ "0:ディレイ経過前  1:ディレイ経過後" UBYTE COMP_0283 1 100 0 1 BIT_MASK 0x0010 ECU_ADDRESS 0xFFFF1C00 READ_WRITE /end MEASUREMENT
/begin MEASUREMENT fIDELAYZ1 "0:ディレイ経過前  1:ディレイ経過後" UBYTE COMP_0283 1 100 0 1 BIT_MASK 0x0008 ECU_ADDRESS 0xFFFF1C00 READ_WRITE /end MEASUREMENT
/begin MEASUREMENT fIDLERZ "0:IDLE_SW_OFF  1:IDLE_SW_ON" UBYTE COMP_0283 1 100 0 1 BIT_MASK 0x0004 ECU_ADDRESS 0xFFFF1C00 READ_WRITE /end MEASUREMENT
/begin MEASUREMENT fISCFBZ "0:ISC_OPEN  1:ISC_CLOSED" UBYTE COMP_0283 1 100 0 1 BIT_MASK 0x0002 ECU_ADDRESS 0xFFFF1C00 READ_WRITE /end MEASUREMENT
/begin MEASUREMENT fKNOCK "0:ノックなし  1:ノックあり" UBYTE COMP_0283 1 100 0 1 BIT_MASK 0x0001 ECU_ADDRESS 0xFFFF1C00 READ_WRITE /end MEASUREMENT
/begin MEASUREMENT fNEUTQZ "0:NEUTSW_OFF  1:NEUTSW_ON" UBYTE COMP_0283 1 100 0 1 BIT_MASK 0x0080 ECU_ADDRESS 0xFFFF1C01 READ_WRITE /end MEASUREMENT
/begin MEASUREMENT fONOFCR "0:右記以外  1:vA_>=_mONOFCR" UBYTE COMP_0283 1 100 0 1 BIT_MASK 0x0040 ECU_ADDRESS 0xFFFF1C01 READ_WRITE /end MEASUREMENT
/begin MEASUREMENT fQADVFBPI "0:P制御  1:PI制御" UBYTE COMP_0283 1 100 0 1 BIT_MASK 0x0020 ECU_ADDRESS 0xFFFF1C01 READ_WRITE /end MEASUREMENT
/begin MEASUREMENT fQADVFBPIZ "0:P制御  1:PI制御" UBYTE COMP_0283 1 100 0 1 BIT_MASK 0x0010 ECU_ADDRESS 0xFFFF1C01 READ_WRITE /end MEASUREMENT
/begin MEASUREMENT fREFFST "0:エンスト後初回REFJOB  1:エンスト後初回以外REFJOB" UBYTE COMP_0283 1 100 0 1 BIT_MASK 0x0008 ECU_ADDRESS 0xFFFF1C01 READ_WRITE /end MEASUREMENT
/begin MEASUREMENT fFSFUELCT "0:右記以外  1:成層始動用フューエルカット" UBYTE COMP_0283 1 100 0 1 BIT_MASK 0x0080 ECU_ADDRESS 0xFFFF3CF5 READ_WRITE /end MEASUREMENT
/begin MEASUREMENT fCATACTM "0:未活性  1:活性" UBYTE COMP_0283 1 100 0 1 BIT_MASK 0x0080 ECU_ADDRESS 0xFFFF3CF7 READ_WRITE /end MEASUREMENT
/begin MEASUREMENT fCTRSIST "0:演算停止  1:演算開始" UBYTE COMP_0283 1 100 0 1 BIT_MASK 0x0040 ECU_ADDRESS 0xFFFF3CF7 READ_WRITE /end MEASUREMENT
/begin MEASUREMENT fDNE019FL "0:DNE019FL未初期化  1:DNE019FL初期化済" UBYTE COMP_0283 1 100 0 1 BIT_MASK 0x0020 ECU_ADDRESS 0xFFFF3CF7 READ_WRITE /end MEASUREMENT
/begin MEASUREMENT fEVCNNGWO "0:NGでない  1:NG" UBYTE COMP_0283 1 100 0 1 BIT_MASK 0x0010 ECU_ADDRESS 0xFFFF3CF7 READ_WRITE /end MEASUREMENT
/begin MEASUREMENT fEVCNNGWS "0:NGでない  1:NG" UBYTE COMP_0283 1 100 0 1 BIT_MASK 0x0008 ECU_ADDRESS 0xFFFF3CF7 READ_WRITE /end MEASUREMENT
/begin MEASUREMENT fFEVCWENDO "0:未終了  1:終了" UBYTE COMP_0283 1 100 0 1 BIT_MASK 0x0004 ECU_ADDRESS 0xFFFF3CF7 READ_WRITE /end MEASUREMENT
/begin MEASUREMENT fFEVCWENDS "0:未終了  1:終了" UBYTE COMP_0283 1 100 0 1 BIT_MASK 0x0002 ECU_ADDRESS 0xFFFF3CF7 READ_WRITE /end MEASUREMENT
/begin MEASUREMENT fFINCAE "0:INCA対応制御なし  1:INCA対応制御あり" UBYTE COMP_0283 1 100 0 1 BIT_MASK 0x0001 ECU_ADDRESS 0xFFFF3CF7 READ_WRITE /end MEASUREMENT
/begin MEASUREMENT fFRG121 "0:未確定  1:確定" UBYTE COMP_0283 1 100 0 1 BIT_MASK 0x0080 ECU_ADDRESS 0xFFFF3CF8 READ_WRITE /end MEASUREMENT
/begin MEASUREMENT fMFAYNG "0:判定未  1:判定中" UBYTE COMP_0283 1 100 0 1 BIT_MASK 0x0040 ECU_ADDRESS 0xFFFF3CF8 READ_WRITE /end MEASUREMENT
/begin MEASUREMENT fRKTCLR "0:クリア要求なし  1:クリア要求あり" UBYTE COMP_0283 1 100 0 1 BIT_MASK 0x0020 ECU_ADDRESS 0xFFFF3CF8 READ_WRITE /end MEASUREMENT
/begin MEASUREMENT fSGADVFLG "0:SGADV制御リタード停止  1:SGADV制御リタード" UBYTE COMP_0283 1 100 0 1 BIT_MASK 0x0010 ECU_ADDRESS 0xFFFF3CF8 READ_WRITE /end MEASUREMENT
/begin MEASUREMENT fSGADVOK "0:SGADV制御再リタード禁止  1:SGADV制御再リタード許可" UBYTE COMP_0283 1 100 0 1 BIT_MASK 0x0008 ECU_ADDRESS 0xFFFF3CF8 READ_WRITE /end MEASUREMENT
/begin MEASUREMENT fFRGST1 "0:未確定  1:確定" UBYTE COMP_0283 1 100 0 1 BIT_MASK 0x0080 ECU_ADDRESS 0xFFFF562F READ_WRITE /end MEASUREMENT
/begin MEASUREMENT fFRGST2 "0:未確定  1:確定" UBYTE COMP_0283 1 100 0 1 BIT_MASK 0x0040 ECU_ADDRESS 0xFFFF562F READ_WRITE /end MEASUREMENT
/begin MEASUREMENT fITAADJH "0:条件成立  1:条件非成立" UBYTE COMP_0283 1 100 0 1 BIT_MASK 0x0020 ECU_ADDRESS 0xFFFF562F READ_WRITE /end MEASUREMENT
/begin MEASUREMENT fITAADJL "0:条件成立  1:条件非成立" UBYTE COMP_0283 1 100 0 1 BIT_MASK 0x0010 ECU_ADDRESS 0xFFFF562F READ_WRITE /end MEASUREMENT
/begin MEASUREMENT fITDADJH "0:条件成立  1:条件非成立" UBYTE COMP_0283 1 100 0 1 BIT_MASK 0x0008 ECU_ADDRESS 0xFFFF562F READ_WRITE /end MEASUREMENT
/begin MEASUREMENT fITDADJL "0:条件成立  1:条件非成立" UBYTE COMP_0283 1 100 0 1 BIT_MASK 0x0004 ECU_ADDRESS 0xFFFF562F READ_WRITE /end MEASUREMENT
/begin MEASUREMENT fNADVAJH "0:条件成立  1:条件非成立" UBYTE COMP_0283 1 100 0 1 BIT_MASK 0x0002 ECU_ADDRESS 0xFFFF562F READ_WRITE /end MEASUREMENT
/begin MEASUREMENT fNADVAJL "0:条件成立  1:条件非成立" UBYTE COMP_0283 1 100 0 1 BIT_MASK 0x0001 ECU_ADDRESS 0xFFFF562F READ_WRITE /end MEASUREMENT
/begin MEASUREMENT fNDADAJH "0:条件成立  1:条件非成立" UBYTE COMP_0283 1 100 0 1 BIT_MASK 0x0080 ECU_ADDRESS 0xFFFF5630 READ_WRITE /end MEASUREMENT
/begin MEASUREMENT fNDADAJL "0:条件成立  1:条件非成立" UBYTE COMP_0283 1 100 0 1 BIT_MASK 0x0040 ECU_ADDRESS 0xFFFF5630 READ_WRITE /end MEASUREMENT
/begin MEASUREMENT fTWNADJL "0:条件成立  1:条件非成立" UBYTE COMP_0283 1 100 0 1 BIT_MASK 0x0020 ECU_ADDRESS 0xFFFF5630 READ_WRITE /end MEASUREMENT
/begin MEASUREMENT fFCNROL "0:500rpm以下  1:500rpm以上" UBYTE COMP_0283 1 100 0 1 BIT_MASK 0x0080 ECU_ADDRESS 0xFFFF1C02 READ_WRITE /end MEASUREMENT
/begin MEASUREMENT fFTWCP1 "0:CLOSE制御許可水温条件不成立  1:CLOSE制御許可水温条件成立" UBYTE COMP_0283 1 100 0 1 BIT_MASK 0x0040 ECU_ADDRESS 0xFFFF1C02 READ_WRITE /end MEASUREMENT
/begin MEASUREMENT fFEMAR "0:ﾀｲﾐﾝｸﾞ未  1:ﾀｲﾐﾝｸﾞ" UBYTE COMP_0283 1 100 0 1 BIT_MASK 0x0080 ECU_ADDRESS 0xFFFF3CF9 READ_WRITE /end MEASUREMENT
/begin MEASUREMENT fFIDMSA "0:ﾀｲﾐﾝｸﾞ未  1:ﾀｲﾐﾝｸﾞ" UBYTE COMP_0283 1 100 0 1 BIT_MASK 0x0040 ECU_ADDRESS 0xFFFF3CF9 READ_WRITE /end MEASUREMENT
/begin MEASUREMENT fFRGJDG "0:ﾀｲﾐﾝｸﾞ未  1:ﾀｲﾐﾝｸﾞ" UBYTE COMP_0283 1 100 0 1 BIT_MASK 0x0020 ECU_ADDRESS 0xFFFF3CF9 READ_WRITE /end MEASUREMENT
/begin MEASUREMENT afACOUT "0:リレーOFF要求  1:リレーＯＮ要求" UBYTE COMP_0283 1 100 0 1 BIT_MASK 0x0080 ECU_ADDRESS 0xFFFF1C03 READ_WRITE /end MEASUREMENT
/begin MEASUREMENT afFSTR0 "0:均質  1:成層" UBYTE COMP_0283 1 100 0 1 BIT_MASK 0x0040 ECU_ADDRESS 0xFFFF1C03 READ_WRITE /end MEASUREMENT
/begin MEASUREMENT afFSTRR "0:均質  1:成層" UBYTE COMP_0283 1 100 0 1 BIT_MASK 0x0020 ECU_ADDRESS 0xFFFF1C03 READ_WRITE /end MEASUREMENT
/begin MEASUREMENT afFTITMHS "0:始動時プレイグ回避制御外  1:始動時プレイグ回避制御中" UBYTE COMP_0283 1 100 0 1 BIT_MASK 0x0010 ECU_ADDRESS 0xFFFF1C03 READ_WRITE /end MEASUREMENT
/begin MEASUREMENT afFWT2IJ "0:不成立  1:成立" UBYTE COMP_0283 1 100 0 1 BIT_MASK 0x0008 ECU_ADDRESS 0xFFFF1C03 READ_WRITE /end MEASUREMENT
/begin MEASUREMENT fACOUT "0:リレーOFF  1:リレーＯＮ" UBYTE COMP_0283 1 100 0 1 BIT_MASK 0x0080 ECU_ADDRESS 0xFFFF1C04 READ_WRITE /end MEASUREMENT
/begin COMPU_METHOD COMP_0283 "1flag" RAT_FUNC "%8.2" "flag" COEFFS 0 1 0 0 0 1 /end COMPU_METHOD
/end MODULE
/end PROJECT
