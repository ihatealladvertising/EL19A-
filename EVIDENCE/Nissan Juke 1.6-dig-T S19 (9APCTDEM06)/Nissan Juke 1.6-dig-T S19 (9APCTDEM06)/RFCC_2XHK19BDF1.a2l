/begin PROJECT X12C_KH3DT_DI_NAM_R/C ""
/begin HEADER "" /* key HEADER ++ "comment" に Par.scomment */ PROJECT_NO X12C_KH3DT_DI_NAM_R/C /* key PROJECT_NO ++ project number に car_eng_desti_lot */ VERSION "0KHDCFDZ7" /* key VERSION ++ version number に mProgver */ /end HEADER
/begin MODULE DIM ""
/begin MOD_COMMON "" ALIGNMENT_BYTE 1 ALIGNMENT_WORD 2 ALIGNMENT_LONG 4 ALIGNMENT_FLOAT32_IEEE 4 ALIGNMENT_FLOAT64_IEEE 4 DEPOSIT ABSOLUTE BYTE_ORDER MSB_FIRST /* ﾊﾞｲﾄｵｰﾀﾞｰがﾘﾌﾟﾚｰｽされる */ /end MOD_COMMON
/begin MEASUREMENT vTMADJM1f "RAM value vTMADJM1f" UBYTE COMP_0004 1 100 0 255 ECU_ADDRESS 0xFFFF38D4 READ_WRITE /end MEASUREMENT
/begin MEASUREMENT vTMBUTW "RAM value vTMBUTW" UBYTE COMP_0511 1 100 0 1530 ECU_ADDRESS 0xFFFF38D5 READ_WRITE /end MEASUREMENT
/begin MEASUREMENT vTMCDC2NG "RAM value vTMCDC2NG" UBYTE COMP_0008 1 100 0 25500 ECU_ADDRESS 0xFFFF2D68 READ_WRITE /end MEASUREMENT
/begin MEASUREMENT vTMCDLS2 "RAM value vTMCDLS2" UBYTE COMP_0008 1 100 0 25500 ECU_ADDRESS 0xFFFF2D69 READ_WRITE /end MEASUREMENT
/begin MEASUREMENT vTMCMON "RAM value vTMCMON" UBYTE COMP_0096 1 100 0 2550 ECU_ADDRESS 0xFFFF38D6 READ_WRITE /end MEASUREMENT
/begin MEASUREMENT vTMDECH "RAM value vTMDECH" UWORD COMP_0008 1 100 0 6553500 ECU_ADDRESS 0xFFFF1694 READ_WRITE /end MEASUREMENT
/begin MEASUREMENT vTMDECL "RAM value vTMDECL" UWORD COMP_0008 1 100 0 6553500 ECU_ADDRESS 0xFFFF1696 READ_WRITE /end MEASUREMENT
/begin MEASUREMENT vTMDIREI "RAM value vTMDIREI" UBYTE COMP_0008 1 100 0 25500 ECU_ADDRESS 0xFFFF2D6A READ_WRITE /end MEASUREMENT
/begin MEASUREMENT vTMDIREI8 "RAM value vTMDIREI8" UBYTE COMP_0013 1 100 0 255 ECU_ADDRESS 0xFFFF2D6B READ_WRITE /end MEASUREMENT
/begin MEASUREMENT vTMDSTL "RAM value vTMDSTL" UWORD COMP_0202 1 100 0 655350 ECU_ADDRESS 0xFFFF10B0 READ_WRITE /end MEASUREMENT
/begin MEASUREMENT vTMECN2 "RAM value vTMECN2" UBYTE COMP_0013 1 100 0 255 ECU_ADDRESS 0xFFFF2D6C READ_WRITE /end MEASUREMENT
/begin MEASUREMENT vTMEONV "RAM value vTMEONV" ULONG COMP_0017_S 1 100 0 42949672.95 ECU_ADDRESS 0xFFFF38D8 READ_WRITE /end MEASUREMENT
/begin MEASUREMENT vTMEVCN "RAM value vTMEVCN" UWORD COMP_0013 1 100 0 65535 ECU_ADDRESS 0xFFFF2D6E READ_WRITE /end MEASUREMENT
/begin MEASUREMENT vTMEVP1 "RAM value vTMEVP1" UBYTE COMP_0096 1 100 0 2550 ECU_ADDRESS 0xFFFF10B2 READ_WRITE /end MEASUREMENT
/begin MEASUREMENT vTMFCUT "RAM value vTMFCUT" UBYTE COMP_0091 1 100 0 255 ECU_ADDRESS 0xFFFF10B3 READ_WRITE /end MEASUREMENT
/begin MEASUREMENT vTMFIMN "RAM value vTMFIMN" UBYTE COMP_0091 1 100 0 255 ECU_ADDRESS 0xFFFF10B4 READ_WRITE /end MEASUREMENT
/begin MEASUREMENT vTMFMIL "RAM value vTMFMIL" UBYTE COMP_0014 1 100 0 2550 ECU_ADDRESS 0xFFFF38DC READ_WRITE /end MEASUREMENT
/begin MEASUREMENT vTMFPON "RAM value vTMFPON" UBYTE COMP_0014 1 100 0 2550 ECU_ADDRESS 0xFFFF4DB2 READ_WRITE /end MEASUREMENT
/begin MEASUREMENT vTMFRCNT "RAM value vTMFRCNT" UBYTE COMP_0030 1 100 0 255 ECU_ADDRESS 0xFFFF10B5 READ_WRITE /end MEASUREMENT
/begin MEASUREMENT vTMFRCNTB "RAM value vTMFRCNTB" UBYTE COMP_0030 1 100 0 255 ECU_ADDRESS 0xFFFF10B6 READ_WRITE /end MEASUREMENT
/begin MEASUREMENT vTMFRM "RAM value vTMFRM" UBYTE COMP_0068 1 100 0 255 ECU_ADDRESS 0xFFFF10B7 READ_WRITE /end MEASUREMENT
/begin MEASUREMENT vTMFRTM "RAM value vTMFRTM" UBYTE COMP_0014 1 100 0 2550 ECU_ADDRESS 0xFFFF10B8 READ_WRITE /end MEASUREMENT
/begin MEASUREMENT vTMHOS "RAM value vTMHOS" UBYTE COMP_0021 1 100 0 99.609375 ECU_ADDRESS 0xFFFF3326 READ_WRITE /end MEASUREMENT
/begin MEASUREMENT vTMINHT "RAM value vTMINHT" UBYTE COMP_0234 1 100 0 2550 ECU_ADDRESS 0xFFFF2D70 READ_WRITE /end MEASUREMENT
/begin MEASUREMENT vTMINHT2 "RAM value vTMINHT2" UBYTE COMP_0096 1 100 0 2550 ECU_ADDRESS 0xFFFF2D71 READ_WRITE /end MEASUREMENT
/begin MEASUREMENT vTMINJ "RAM value vTMINJ" UBYTE COMP_0017 1 100 0 255 ECU_ADDRESS 0xFFFF10B9 READ_WRITE /end MEASUREMENT
/begin MEASUREMENT vTMINJS "RAM value vTMINJS" UBYTE COMP_0017 1 100 0 255 ECU_ADDRESS 0xFFFF19E8 READ_WRITE /end MEASUREMENT
/begin MEASUREMENT vTMISSL "RAM value vTMISSL" UBYTE COMP_0014 1 100 0 2550 ECU_ADDRESS 0xFFFF10BA READ_WRITE /end MEASUREMENT
/begin MEASUREMENT vTMKAS "RAM value vTMKAS" UBYTE COMP_0063 1 100 0 0.99609375 ECU_ADDRESS 0xFFFF10BB READ_WRITE /end MEASUREMENT
/begin MEASUREMENT vTMKAS10 "RAM value vTMKAS10" UWORD COMP_0028 1 100 0 2.5599609375 ECU_ADDRESS 0xFFFF10BC READ_WRITE /end MEASUREMENT
/begin MEASUREMENT vTMKASST "RAM value vTMKASST" UBYTE COMP_0063 1 100 0 0.99609375 ECU_ADDRESS 0xFFFF10BE READ_WRITE /end MEASUREMENT
/begin MEASUREMENT vTMKAST10 "RAM value vTMKAST10" UWORD COMP_0028 1 100 0 2.5599609375 ECU_ADDRESS 0xFFFF2D72 READ_WRITE /end MEASUREMENT
/begin MEASUREMENT vTMKRET "RAM value vTMKRET" UBYTE COMP_0004 1 100 0 255 ECU_ADDRESS 0xFFFF10BF READ_WRITE /end MEASUREMENT
/begin MEASUREMENT vTMLOILP "RAM value vTMLOILP" UBYTE COMP_0049 1 100 0 255 ECU_ADDRESS 0xFFFF10C0 READ_WRITE /end MEASUREMENT
/begin MEASUREMENT vTMPADAFSF "RAM value vTMPADAFSF" UWORD COMP_0471_S 1 100 0 7.99527 ECU_ADDRESS 0xFFFF2D74 READ_WRITE /end MEASUREMENT
/begin MEASUREMENT vTMPADV "RAM value vTMPADV" UBYTE COMP_0472_S 1 100 -64 63.5 ECU_ADDRESS 0xFFFF2D78 READ_WRITE /end MEASUREMENT
/begin MEASUREMENT vTMPADVC "RAM value vTMPADVC" UBYTE COMP_0472_S 1 100 -64 63.5 ECU_ADDRESS 0xFFFF2D79 READ_WRITE /end MEASUREMENT
/begin MEASUREMENT vTMPAFSAF "RAM value vTMPAFSAF" UWORD COMP_0327 1 100 0 1.9988175 ECU_ADDRESS 0xFFFF2D7A READ_WRITE /end MEASUREMENT
/begin MEASUREMENT vTMPALP "RAM value vTMPALP" UBYTE COMP_0117 1 100 -100 99.21875 ECU_ADDRESS 0xFFFF2D7E READ_WRITE /end MEASUREMENT
/begin MEASUREMENT vTMPALPC "RAM value vTMPALPC" UBYTE COMP_0117 1 100 -100 99.21875 ECU_ADDRESS 0xFFFF2D80 READ_WRITE /end MEASUREMENT
/begin MEASUREMENT vTMPAPS1OF "RAM value vTMPAPS1OF" UBYTE COMP_0378 1 100 0 100.000000065 ECU_ADDRESS 0xFFFF2D82 READ_WRITE /end MEASUREMENT
/begin MEASUREMENT vTMPAPS2OF "RAM value vTMPAPS2OF" UBYTE COMP_0378 1 100 0 100.000000065 ECU_ADDRESS 0xFFFF2D83 READ_WRITE /end MEASUREMENT
/begin MEASUREMENT vTMPAVEPF "RAM value vTMPAVEPF" UWORD COMP_0473_S 1 100 0 655350 ECU_ADDRESS 0xFFFF2D84 READ_WRITE /end MEASUREMENT
/begin MEASUREMENT vTMPBST "RAM value vTMPBST" UBYTE COMP_0424 1 100 0 255 ECU_ADDRESS 0xFFFF2D86 READ_WRITE /end MEASUREMENT
/begin MEASUREMENT vTMPBUP1 "RAM value vTMPBUP1" UBYTE COMP_0522_S 1 100 0 255 ECU_ADDRESS 0xFFFF4DB3 READ_WRITE /end MEASUREMENT
/begin MEASUREMENT vTMPBUP2 "RAM value vTMPBUP2" UBYTE COMP_0522_S 1 100 0 255 ECU_ADDRESS 0xFFFF4DB4 READ_WRITE /end MEASUREMENT
/begin MEASUREMENT vTMPBUP3 "RAM value vTMPBUP3" UBYTE COMP_0522_S 1 100 0 255 ECU_ADDRESS 0xFFFF4DB5 READ_WRITE /end MEASUREMENT
/begin MEASUREMENT vTMPBUP4 "RAM value vTMPBUP4" UBYTE COMP_0522_S 1 100 0 255 ECU_ADDRESS 0xFFFF4DB6 READ_WRITE /end MEASUREMENT
/begin MEASUREMENT vTMPBUP5 "RAM value vTMPBUP5" UBYTE COMP_0522_S 1 100 0 255 ECU_ADDRESS 0xFFFF4DB7 READ_WRITE /end MEASUREMENT
/begin MEASUREMENT vTMPBUP6 "RAM value vTMPBUP6" UBYTE COMP_0522_S 1 100 0 255 ECU_ADDRESS 0xFFFF4DB8 READ_WRITE /end MEASUREMENT
/begin MEASUREMENT vTMPCAT "RAM value vTMPCAT" UBYTE COMP_0062 1 100 0 1020 ECU_ADDRESS 0xFFFF3BA6 READ_WRITE /end MEASUREMENT
/begin MEASUREMENT vTMPCLRDST "RAM value vTMPCLRDST" UWORD COMP_0470 1 100 0 65535 ECU_ADDRESS 0xFFFF2D88 READ_WRITE /end MEASUREMENT
/begin MEASUREMENT vTMPCLTIME "RAM value vTMPCLTIME" UWORD COMP_0467_S 1 100 0 65535 ECU_ADDRESS 0xFFFF2D8A READ_WRITE /end MEASUREMENT
/begin MEASUREMENT vTMPCLV "RAM value vTMPCLV" UBYTE COMP_0425 1 100 0 99.99999981 ECU_ADDRESS 0xFFFF2D8C READ_WRITE /end MEASUREMENT
/begin MEASUREMENT vTMPCODE "RAM value vTMPCODE" UWORD COMP_0426 1 100 0 65535 ECU_ADDRESS 0xFFFF2D8E READ_WRITE /end MEASUREMENT
/begin MEASUREMENT vTMPCS "RAM value vTMPCS" UBYTE COMP_0522_S 1 100 0 255 ECU_ADDRESS 0xFFFF4DB9 READ_WRITE /end MEASUREMENT
/begin MEASUREMENT vTMPDGN "RAM value vTMPDGN" UBYTE COMP_0068 1 100 0 255 ECU_ADDRESS 0xFFFF2D90 READ_WRITE /end MEASUREMENT
/begin MEASUREMENT vTMPDGND "RAM value vTMPDGND" UBYTE COMP_0068 1 100 0 255 ECU_ADDRESS 0xFFFF2D91 READ_WRITE /end MEASUREMENT
/begin MEASUREMENT vTMPDTY "RAM value vTMPDTY" UBYTE COMP_0027 1 100 0 255 ECU_ADDRESS 0xFFFF2D92 READ_WRITE /end MEASUREMENT
/begin MEASUREMENT vTMPEGR "RAM value vTMPEGR" UBYTE COMP_0378 1 100 0 100.000000065 ECU_ADDRESS 0xFFFF2D93 READ_WRITE /end MEASUREMENT
/begin MEASUREMENT vTMPEVPRES "RAM value vTMPEVPRES" UWORD COMP_0475_S 1 100 0 16383.75 ECU_ADDRESS 0xFFFF2D94 READ_WRITE /end MEASUREMENT
/begin MEASUREMENT vTMPEVPS "RAM value vTMPEVPS" UBYTE COMP_0378 1 100 0 100.000000065 ECU_ADDRESS 0xFFFF2D96 READ_WRITE /end MEASUREMENT
/begin MEASUREMENT vTMPFLI "RAM value vTMPFLI" UBYTE COMP_0378 1 100 0 100.000000065 ECU_ADDRESS 0xFFFF2D97 READ_WRITE /end MEASUREMENT
/begin MEASUREMENT vTMPFSS "RAM value vTMPFSS" UBYTE COMP_0091 1 100 0 255 ECU_ADDRESS 0xFFFF2D98 READ_WRITE /end MEASUREMENT
/begin MEASUREMENT vTMPIMR "RAM value vTMPIMR" UBYTE COMP_0068 1 100 0 255 ECU_ADDRESS 0xFFFF2D9A READ_WRITE /end MEASUREMENT
/begin MEASUREMENT vTMPIMR2 "RAM value vTMPIMR2" UBYTE COMP_0068 1 100 0 255 ECU_ADDRESS 0xFFFF2D9B READ_WRITE /end MEASUREMENT
/begin MEASUREMENT vTMPIMRD "RAM value vTMPIMRD" UBYTE COMP_0068 1 100 0 255 ECU_ADDRESS 0xFFFF2D9C READ_WRITE /end MEASUREMENT
/begin MEASUREMENT vTMPIMRD2 "RAM value vTMPIMRD2" UBYTE COMP_0068 1 100 0 255 ECU_ADDRESS 0xFFFF2D9D READ_WRITE /end MEASUREMENT
/begin MEASUREMENT vTMPITAC "RAM value vTMPITAC" UWORD COMP_0378 1 100 0 25700.000016705 ECU_ADDRESS 0xFFFF2D9E READ_WRITE /end MEASUREMENT
/begin MEASUREMENT vTMPKBL "RAM value vTMPKBL" UBYTE COMP_0117 1 100 -100 99.21875 ECU_ADDRESS 0xFFFF2DA0 READ_WRITE /end MEASUREMENT
/begin MEASUREMENT vTMPKBLC "RAM value vTMPKBLC" UBYTE COMP_0117 1 100 -100 99.21875 ECU_ADDRESS 0xFFFF2DA2 READ_WRITE /end MEASUREMENT
/begin MEASUREMENT vTMPMLTIME "RAM value vTMPMLTIME" UWORD COMP_0467_S 1 100 0 65535 ECU_ADDRESS 0xFFFF2DA4 READ_WRITE /end MEASUREMENT
/begin MEASUREMENT vTMPNGC "RAM value vTMPNGC" UWORD COMP_0426 1 100 0 65535 ECU_ADDRESS 0xFFFF2DA6 READ_WRITE /end MEASUREMENT
/begin MEASUREMENT vTMPNGCT "RAM value vTMPNGCT" UBYTE COMP_0068 1 100 0 255 ECU_ADDRESS 0xFFFF4DBA READ_WRITE /end MEASUREMENT
/begin MEASUREMENT vTMPOPFD "RAM value vTMPOPFD" UBYTE COMP_0068 1 100 0 255 ECU_ADDRESS 0xFFFF2DA8 READ_WRITE /end MEASUREMENT
/begin MEASUREMENT vTMPPDL "RAM value vTMPPDL" UWORD COMP_0329 1 100 0 511.9921875 ECU_ADDRESS 0xFFFF2DB2 READ_WRITE /end MEASUREMENT
/begin MEASUREMENT vTMPPPAMB "RAM value vTMPPPAMB" UBYTE COMP_0474_S 1 100 0 255 ECU_ADDRESS 0xFFFF2DB4 READ_WRITE /end MEASUREMENT
/begin MEASUREMENT vTMPQM "RAM value vTMPQM" UWORD COMP_0476_S 1 100 0 655.35 ECU_ADDRESS 0xFFFF2DB6 READ_WRITE /end MEASUREMENT
/begin MEASUREMENT vTMPRPM "RAM value vTMPRPM" UWORD COMP_0427 1 100 0 16383.75 ECU_ADDRESS 0xFFFF2DB8 READ_WRITE /end MEASUREMENT
/begin MEASUREMENT vTMPRPM1 "RAM value vTMPRPM1" UBYTE COMP_0006 1 100 0 3187.5 ECU_ADDRESS 0xFFFF4DBB READ_WRITE /end MEASUREMENT
/begin MEASUREMENT vTMPRPM2 "RAM value vTMPRPM2" UBYTE COMP_0006 1 100 0 3187.5 ECU_ADDRESS 0xFFFF4DBC READ_WRITE /end MEASUREMENT
/begin MEASUREMENT vTMPRPM3 "RAM value vTMPRPM3" UBYTE COMP_0006 1 100 0 3187.5 ECU_ADDRESS 0xFFFF4DBD READ_WRITE /end MEASUREMENT
/begin MEASUREMENT vTMPRPM4 "RAM value vTMPRPM4" UBYTE COMP_0006 1 100 0 3187.5 ECU_ADDRESS 0xFFFF4DBE READ_WRITE /end MEASUREMENT
/begin MEASUREMENT vTMPRPM5 "RAM value vTMPRPM5" UBYTE COMP_0006 1 100 0 3187.5 ECU_ADDRESS 0xFFFF4DBF READ_WRITE /end MEASUREMENT
/begin MEASUREMENT vTMPRPM6 "RAM value vTMPRPM6" UBYTE COMP_0006 1 100 0 3187.5 ECU_ADDRESS 0xFFFF4DC0 READ_WRITE /end MEASUREMENT
/begin MEASUREMENT vTMPRUNTM "RAM value vTMPRUNTM" UWORD COMP_0049 1 100 0 65535 ECU_ADDRESS 0xFFFF2DBA READ_WRITE /end MEASUREMENT
/begin MEASUREMENT vTMPSUMVSP "RAM value vTMPSUMVSP" UWORD COMP_0470 1 100 0 65535 ECU_ADDRESS 0xFFFF2DBC READ_WRITE /end MEASUREMENT
/begin MEASUREMENT vTMPTAG "RAM value vTMPTAG" UBYTE COMP_0428 1 100 -40 215 ECU_ADDRESS 0xFFFF2DBE READ_WRITE /end MEASUREMENT
/begin MEASUREMENT vTMPTAN "RAM value vTMPTAN" UBYTE COMP_0035 1 100 -50 205 ECU_ADDRESS 0xFFFF2DBF READ_WRITE /end MEASUREMENT
/begin MEASUREMENT vTMPTATHG "RAM value vTMPTATHG" UBYTE COMP_0428 1 100 -40 215 ECU_ADDRESS 0xFFFF2DC0 READ_WRITE /end MEASUREMENT
/begin MEASUREMENT vTMPTFM "RAM value vTMPTFM" UBYTE COMP_0068 1 100 0 255 ECU_ADDRESS 0xFFFF2DC1 READ_WRITE /end MEASUREMENT
/begin MEASUREMENT vTMPTGABFE "RAM value vTMPTGABFE" UWORD COMP_0327 1 100 0 1.9988175 ECU_ADDRESS 0xFFFF2DC2 READ_WRITE /end MEASUREMENT
/begin MEASUREMENT vTMPTGTVO "RAM value vTMPTGTVO" UBYTE COMP_0378 1 100 0 100.000000065 ECU_ADDRESS 0xFFFF2DC4 READ_WRITE /end MEASUREMENT
/begin MEASUREMENT vTMPTMPCAT "RAM value vTMPTMPCAT" UWORD COMP_0477_S 1 100 -40 6513.5 ECU_ADDRESS 0xFFFF2DC6 READ_WRITE /end MEASUREMENT
/begin MEASUREMENT vTMPTPFCA "RAM value vTMPTPFCA" UWORD COMP_0473_S 1 100 0 655350 ECU_ADDRESS 0xFFFF2DCA READ_WRITE /end MEASUREMENT
/begin MEASUREMENT vTMPTPH "RAM value vTMPTPH" UBYTE COMP_0001 1 100 0 31.875 ECU_ADDRESS 0xFFFF2DCC READ_WRITE /end MEASUREMENT
/begin MEASUREMENT vTMPTPS1OF "RAM value vTMPTPS1OF" UBYTE COMP_0378 1 100 0 100.000000065 ECU_ADDRESS 0xFFFF2DCD READ_WRITE /end MEASUREMENT
/begin MEASUREMENT vTMPTPS2OF "RAM value vTMPTPS2OF" UBYTE COMP_0378 1 100 0 100.000000065 ECU_ADDRESS 0xFFFF2DCE READ_WRITE /end MEASUREMENT
/begin MEASUREMENT vTMPTRC "RAM value vTMPTRC" UBYTE COMP_0068 1 100 0 255 ECU_ADDRESS 0xFFFF2DCF READ_WRITE /end MEASUREMENT
/begin MEASUREMENT vTMPTVO "RAM value vTMPTVO" UBYTE COMP_0002 1 100 0 89.25 ECU_ADDRESS 0xFFFF2DD0 READ_WRITE /end MEASUREMENT
/begin MEASUREMENT vTMPTWN "RAM value vTMPTWN" UBYTE COMP_0428 1 100 -40 215 ECU_ADDRESS 0xFFFF2DD1 READ_WRITE /end MEASUREMENT
/begin MEASUREMENT vTMPVB "RAM value vTMPVB" UWORD COMP_0478_S 1 100 0 65.535 ECU_ADDRESS 0xFFFF2DD2 READ_WRITE /end MEASUREMENT
/begin MEASUREMENT vTMPVO2 "RAM value vTMPVO2" UBYTE COMP_0203_S 1 100 0 1.275 ECU_ADDRESS 0xFFFF2DD4 READ_WRITE /end MEASUREMENT
/begin MEASUREMENT vTMPVRO2 "RAM value vTMPVRO2" UBYTE COMP_0203_S 1 100 0 1.275 ECU_ADDRESS 0xFFFF2DD6 READ_WRITE /end MEASUREMENT
/begin MEASUREMENT vTMPVRO2T "RAM value vTMPVRO2T" UBYTE COMP_0203_S 1 100 0 1.275 ECU_ADDRESS 0xFFFF2DD8 READ_WRITE /end MEASUREMENT
/begin MEASUREMENT vTMPVSP "RAM value vTMPVSP" UBYTE COMP_0429 1 100 0 255 ECU_ADDRESS 0xFFFF2DDA READ_WRITE /end MEASUREMENT
/begin MEASUREMENT vTMPWARMUP "RAM value vTMPWARMUP" UBYTE COMP_0016 1 100 0 255 ECU_ADDRESS 0xFFFF2DDB READ_WRITE /end MEASUREMENT
/begin MEASUREMENT vTMPYRI1 "RAM value vTMPYRI1" UBYTE COMP_0283 1 100 0 255 ECU_ADDRESS 0xFFFF4DC1 READ_WRITE /end MEASUREMENT
/begin MEASUREMENT vTMPYRI2 "RAM value vTMPYRI2" UBYTE COMP_0283 1 100 0 255 ECU_ADDRESS 0xFFFF4DC2 READ_WRITE /end MEASUREMENT
/begin MEASUREMENT vTMPYRI3 "RAM value vTMPYRI3" UBYTE COMP_0283 1 100 0 255 ECU_ADDRESS 0xFFFF4DC3 READ_WRITE /end MEASUREMENT
/begin MEASUREMENT vTMPYRI4 "RAM value vTMPYRI4" UBYTE COMP_0283 1 100 0 255 ECU_ADDRESS 0xFFFF4DC4 READ_WRITE /end MEASUREMENT
/begin MEASUREMENT vTMPYRI5 "RAM value vTMPYRI5" UBYTE COMP_0283 1 100 0 255 ECU_ADDRESS 0xFFFF4DC5 READ_WRITE /end MEASUREMENT
/begin MEASUREMENT vTMPYRI6 "RAM value vTMPYRI6" UBYTE COMP_0283 1 100 0 255 ECU_ADDRESS 0xFFFF4DC6 READ_WRITE /end MEASUREMENT
/begin MEASUREMENT vTMQBC "RAM value vTMQBC" UBYTE COMP_0014 1 100 0 2550 ECU_ADDRESS 0xFFFF10C1 READ_WRITE /end MEASUREMENT
/begin MEASUREMENT vTMQBCT "RAM value vTMQBCT" UBYTE COMP_0014 1 100 0 2550 ECU_ADDRESS 0xFFFF10C2 READ_WRITE /end MEASUREMENT
/begin MEASUREMENT vTMQFBI "RAM value vTMQFBI" UBYTE COMP_0030 1 100 0 255 ECU_ADDRESS 0xFFFF10C3 READ_WRITE /end MEASUREMENT
/begin MEASUREMENT vTMREQREV "RAM value vTMREQREV" UBYTE COMP_0014 1 100 0 2550 ECU_ADDRESS 0xFFFF2DDC READ_WRITE /end MEASUREMENT
/begin MEASUREMENT vTMRLED "RAM value vTMRLED" UBYTE COMP_0014 1 100 0 2550 ECU_ADDRESS 0xFFFF38DD READ_WRITE /end MEASUREMENT
/begin MEASUREMENT vTMSMOK "RAM value vTMSMOK" UWORD COMP_0013 1 100 0 65535 ECU_ADDRESS 0xFFFF2DDE READ_WRITE /end MEASUREMENT
/begin MEASUREMENT vTMSRVNG1 "RAM value vTMSRVNG1" UWORD COMP_0014 1 100 0 655350 ECU_ADDRESS 0xFFFF2DE0 READ_WRITE /end MEASUREMENT
/begin MEASUREMENT vTMSRVNG2 "RAM value vTMSRVNG2" UWORD COMP_0014 1 100 0 655350 ECU_ADDRESS 0xFFFF2DE2 READ_WRITE /end MEASUREMENT
/begin MEASUREMENT vTMSTPINJ "RAM value vTMSTPINJ" UBYTE COMP_0017 1 100 0 255 ECU_ADDRESS 0xFFFF19E9 READ_WRITE /end MEASUREMENT
/begin MEASUREMENT vTMTRP11 "RAM value vTMTRP11" UWORD COMP_0049 1 100 0 65535 ECU_ADDRESS 0xFFFF2DE4 READ_WRITE /end MEASUREMENT
/begin MEASUREMENT vTMTRP6 "RAM value vTMTRP6" ULONG COMP_0008 1 100 0 429496729500 ECU_ADDRESS 0xFFFF10C4 READ_WRITE /end MEASUREMENT
/begin MEASUREMENT vTMTRP6A "RAM value vTMTRP6A" UBYTE COMP_0030 1 100 0 255 ECU_ADDRESS 0xFFFF10C8 READ_WRITE /end MEASUREMENT
/begin MEASUREMENT vTMTSVR "RAM value vTMTSVR" UBYTE COMP_0234 1 100 0 2550 ECU_ADDRESS 0xFFFF2DE6 READ_WRITE /end MEASUREMENT
/begin MEASUREMENT vTMTXOF "RAM value vTMTXOF" UWORD COMP_0014 1 100 0 655350 ECU_ADDRESS 0xFFFF2DE8 READ_WRITE /end MEASUREMENT
/begin MEASUREMENT vTMTXON "RAM value vTMTXON" UBYTE COMP_0014 1 100 0 2550 ECU_ADDRESS 0xFFFF2DEA READ_WRITE /end MEASUREMENT
/begin MEASUREMENT vTNETAGT1 "RAM value vTNETAGT1" UBYTE COMP_0065 1 100 0 796.875 ECU_ADDRESS 0xFFFF19EA READ_WRITE /end MEASUREMENT
/begin MEASUREMENT vTNGRATIO "RAM value vTNGRATIO" UWORD COMP_0450 1 100 0 63.999056205 ECU_ADDRESS 0xFFFF1698 READ_WRITE /end MEASUREMENT
/begin MEASUREMENT vTNINIR "RAM value vTNINIR" ULONG COMP_0186_S 1 100 0 107374182.375 ECU_ADDRESS 0xFFFF19EC READ_WRITE /end MEASUREMENT
/begin MEASUREMENT vTNIRCNT "RAM value vTNIRCNT" UBYTE COMP_0016 1 100 0 255 ECU_ADDRESS 0xFFFF19F0 READ_WRITE /end MEASUREMENT
/begin MEASUREMENT vTNKAS "RAM value vTNKAS" UBYTE COMP_0186 1 100 0 3.984375 ECU_ADDRESS 0xFFFF10C9 READ_WRITE /end MEASUREMENT
/begin MEASUREMENT vTO "RAM value vTO" UBYTE COMP_0054 1 100 0 5100 ECU_ADDRESS 0xFFFF08FB READ_WRITE /end MEASUREMENT
/begin MEASUREMENT vTO2CNG "RAM value vTO2CNG" UBYTE COMP_0014 1 100 0 2550 ECU_ADDRESS 0xFFFF38DE READ_WRITE /end MEASUREMENT
/begin MEASUREMENT vTO2DCNT1 "RAM value vTO2DCNT1" UWORD COMP_0016 1 100 0 65535 ECU_ADDRESS 0xFFFF4DC8 READ_WRITE /end MEASUREMENT
/begin MEASUREMENT vTO2DCNT2 "RAM value vTO2DCNT2" UWORD COMP_0016 1 100 0 65535 ECU_ADDRESS 0xFFFF4DCA READ_WRITE /end MEASUREMENT
/begin MEASUREMENT vTO2DSP "RAM value vTO2DSP" UBYTE COMP_0014 1 100 0 2550 ECU_ADDRESS 0xFFFF38DF READ_WRITE /end MEASUREMENT
/begin MEASUREMENT vTO2DTRP1 "RAM value vTO2DTRP1" UWORD COMP_0016 1 100 0 65535 ECU_ADDRESS 0xFFFF4DCC READ_WRITE /end MEASUREMENT
/begin MEASUREMENT vTO2DTRP2 "RAM value vTO2DTRP2" UWORD COMP_0016 1 100 0 65535 ECU_ADDRESS 0xFFFF4DCE READ_WRITE /end MEASUREMENT
/begin MEASUREMENT vTOCLCNT "RAM value vTOCLCNT" UWORD COMP_0016 1 100 0 65535 ECU_ADDRESS 0xFFFF4DD0 READ_WRITE /end MEASUREMENT
/begin MEASUREMENT vTOCLCNT2 "RAM value vTOCLCNT2" UWORD COMP_0016 1 100 0 65535 ECU_ADDRESS 0xFFFF4DD2 READ_WRITE /end MEASUREMENT
/begin MEASUREMENT vTOCNST "RAM value vTOCNST" UBYTE COMP_0261_S 1 100 0 510 ECU_ADDRESS 0xFFFF2DEB READ_WRITE /end MEASUREMENT
/begin MEASUREMENT vTOEND "RAM value vTOEND" UBYTE COMP_0035 1 100 -50 205 ECU_ADDRESS 0xFFFF441F READ_WRITE /end MEASUREMENT
/begin MEASUREMENT vTOEQL "RAM value vTOEQL" UBYTE COMP_0035 1 100 -50 205 ECU_ADDRESS 0xFFFF2DEC READ_WRITE /end MEASUREMENT
/begin MEASUREMENT vTOESD1 "RAM value vTOESD1" UWORD COMP_0013 1 100 0 65535 ECU_ADDRESS 0xFFFF2DEE READ_WRITE /end MEASUREMENT
/begin MEASUREMENT vTOEST "RAM value vTOEST" UWORD COMP_0383 1 100 -50 205.99609375 ECU_ADDRESS 0xFFFF4DD4 READ_WRITE /end MEASUREMENT
/begin MEASUREMENT vTOESTZ "RAM value vTOESTZ" SLONG COMP_0628_S 1 100 -32768.0234881024 32768.0234728436 ECU_ADDRESS 0xFFFF4DD8 READ_WRITE /end MEASUREMENT
/begin MEASUREMENT vTOEX "RAM value vTOEX" UBYTE COMP_0004 1 100 0 255 ECU_ADDRESS 0xFFFF169A READ_WRITE /end MEASUREMENT
/begin MEASUREMENT vTOF "RAM value vTOF" UWORD COMP_0023 1 100 0 327675 ECU_ADDRESS 0xFFFF169C READ_WRITE /end MEASUREMENT
/begin MEASUREMENT vTOFMIN "RAM value vTOFMIN" UBYTE COMP_0014 1 100 0 2550 ECU_ADDRESS 0xFFFF2DF0 READ_WRITE /end MEASUREMENT
/begin MEASUREMENT vTOICTNG "RAM value vTOICTNG" UBYTE COMP_0035 1 100 -50 205 ECU_ADDRESS 0xFFFF4DDC READ_WRITE /end MEASUREMENT
/begin MEASUREMENT vTOICTNG2 "RAM value vTOICTNG2" UBYTE COMP_0035 1 100 -50 205 ECU_ADDRESS 0xFFFF4DDD READ_WRITE /end MEASUREMENT
/begin MEASUREMENT vTOILNEW "RAM value vTOILNEW" UBYTE COMP_0035 1 100 -50 205 ECU_ADDRESS 0xFFFF169E READ_WRITE /end MEASUREMENT
/begin MEASUREMENT vTOINT "RAM value vTOINT" UBYTE COMP_0035 1 100 -50 205 ECU_ADDRESS 0xFFFF08FC READ_WRITE /end MEASUREMENT
/begin MEASUREMENT vTOKMAX "RAM value vTOKMAX" UBYTE COMP_0035 1 100 -50 205 ECU_ADDRESS 0xFFFF2DF1 READ_WRITE /end MEASUREMENT
/begin MEASUREMENT vTOKMIN "RAM value vTOKMIN" UBYTE COMP_0035 1 100 -50 205 ECU_ADDRESS 0xFFFF2DF2 READ_WRITE /end MEASUREMENT
/begin MEASUREMENT vTOLDQH "RAM value vTOLDQH" UBYTE COMP_0032 1 100 0 0.99609375 ECU_ADDRESS 0xFFFF169F READ_WRITE /end MEASUREMENT
/begin MEASUREMENT vTP "RAM value vTP" UWORD COMP_0144 1 100 0 31.999495335 ECU_ADDRESS 0xFFFF1E42 READ_WRITE /end MEASUREMENT
/begin MEASUREMENT vTP100 "RAM value vTP100" UWORD COMP_0001 1 100 0 8191.875 ECU_ADDRESS 0xFFFF38E0 READ_WRITE /end MEASUREMENT
/begin MEASUREMENT vTP2SCAN "RAM value vTP2SCAN" UWORD COMP_0016 1 100 0 65535 ECU_ADDRESS 0xFFFF30D0 READ_WRITE /end MEASUREMENT
/begin MEASUREMENT vTP4 "RAM value vTP4" ULONG COMP_0144 1 100 0 2097150.9257699 ECU_ADDRESS 0xFFFF1E44 READ_WRITE /end MEASUREMENT
/begin MEASUREMENT vTPAA "RAM value vTPAA" UWORD COMP_0042 1 100 0 52.428 ECU_ADDRESS 0xFFFF20AC READ_WRITE /end MEASUREMENT
/begin MEASUREMENT vTPAVE "RAM value vTPAVE" UWORD COMP_0144 1 100 0 31.999495335 ECU_ADDRESS 0xFFFF4DDE READ_WRITE /end MEASUREMENT
/begin MEASUREMENT vTPBGH "RAM value vTPBGH" UBYTE COMP_0009 1 100 0 199.21875 ECU_ADDRESS 0xFFFF16AA READ_WRITE /end MEASUREMENT
/begin MEASUREMENT vTPBPR "RAM value vTPBPR" UWORD COMP_0144 1 100 0 31.999495335 ECU_ADDRESS 0xFFFF1578 READ_WRITE /end MEASUREMENT
/begin MEASUREMENT vTPDLYT1 "RAM value vTPDLYT1" UBYTE COMP_0629_S 1 100 0 0.255 ECU_ADDRESS 0xFFFF3250 READ_WRITE /end MEASUREMENT
/begin MEASUREMENT vTPEND "RAM value vTPEND" UWORD COMP_0144 1 100 0 31.999495335 ECU_ADDRESS 0xFFFF4DE0 READ_WRITE /end MEASUREMENT
/begin MEASUREMENT vTPFBAN "RAM value vTPFBAN" UWORD COMP_0630_S 1 100 0 63.999056205 ECU_ADDRESS 0xFFFF10CA READ_WRITE /end MEASUREMENT
/begin MEASUREMENT vTPFBAN2 "RAM value vTPFBAN2" UWORD COMP_0630_S 1 100 0 63.999056205 ECU_ADDRESS 0xFFFF10D2 READ_WRITE /end MEASUREMENT
/begin MEASUREMENT vTPFBAO "RAM value vTPFBAO" UWORD COMP_0630_S 1 100 0 63.999056205 ECU_ADDRESS 0xFFFF10DA READ_WRITE /end MEASUREMENT
/begin MEASUREMENT vTPFCAL "RAM value vTPFCAL" UWORD COMP_0164 1 100 0 19.988175 ECU_ADDRESS 0xFFFF1B60 READ_WRITE /end MEASUREMENT
/begin MEASUREMENT vTPFS "RAM value vTPFS" UWORD COMP_0144 1 100 0 31.999495335 ECU_ADDRESS 0xFFFF3252 READ_WRITE /end MEASUREMENT
/begin MEASUREMENT vTPFUELN "RAM value vTPFUELN" UBYTE COMP_0087_S 1 100 0 19.9104 ECU_ADDRESS 0xFFFF1A75 READ_WRITE /end MEASUREMENT
/begin MEASUREMENT vTPINT "RAM value vTPINT" UWORD COMP_0631_S 1 100 0 31.9994298 ECU_ADDRESS 0xFFFF3328 READ_WRITE /end MEASUREMENT
/begin MEASUREMENT vTPISC "RAM value vTPISC" UWORD COMP_0144 1 100 0 31.999495335 ECU_ADDRESS 0xFFFF159C READ_WRITE /end MEASUREMENT
/begin MEASUREMENT vTPISFS "RAM value vTPISFS" UWORD COMP_0052 1 100 0 31.99956087 ECU_ADDRESS 0xFFFF10E2 READ_WRITE /end MEASUREMENT
/begin MEASUREMENT vTPLINJTI "RAM value vTPLINJTI" UBYTE COMP_0213_S 1 100 0 20400 ECU_ADDRESS 0xFFFF10E4 READ_WRITE /end MEASUREMENT
/begin MEASUREMENT vTPLMIN "RAM value vTPLMIN" UWORD COMP_0008 1 100 0 6553500 ECU_ADDRESS 0xFFFF4DE2 READ_WRITE /end MEASUREMENT
/begin MEASUREMENT vTPLOW "RAM value vTPLOW" UWORD COMP_0514 1 100 0 32.0007405 ECU_ADDRESS 0xFFFF10E6 READ_WRITE /end MEASUREMENT
/begin MEASUREMENT vTPMAXBU "RAM value vTPMAXBU" UWORD COMP_0144 1 100 0 31.999495335 ECU_ADDRESS 0xFFFF4DE4 READ_WRITE /end MEASUREMENT
/begin MEASUREMENT vTPMAXL "RAM value vTPMAXL" UWORD COMP_0001 1 100 0 8191.875 ECU_ADDRESS 0xFFFF332A READ_WRITE /end MEASUREMENT
/begin MEASUREMENT vTPMIN "RAM value vTPMIN" UWORD COMP_0144 1 100 0 31.999495335 ECU_ADDRESS 0xFFFF4DE6 READ_WRITE /end MEASUREMENT
/begin MEASUREMENT vTPO "RAM value vTPO" UWORD COMP_0005 1 100 0 7208.85 ECU_ADDRESS 0xFFFF20AE READ_WRITE /end MEASUREMENT
/begin MEASUREMENT vTPO1 "RAM value vTPO1" UWORD COMP_0005 1 100 0 7208.85 ECU_ADDRESS 0xFFFF20B0 READ_WRITE /end MEASUREMENT
/begin MEASUREMENT vTPO1OV "RAM value vTPO1OV" UWORD COMP_0625_S 1 100 -14.08205 98.55623125 ECU_ADDRESS 0xFFFF1E20 READ_WRITE /end MEASUREMENT
/begin MEASUREMENT vTPO1Z1 "RAM value vTPO1Z1" UWORD COMP_0005 1 100 0 7208.85 ECU_ADDRESS 0xFFFF2DF8 READ_WRITE /end MEASUREMENT
/begin MEASUREMENT vTPO1Z2 "RAM value vTPO1Z2" UWORD COMP_0005 1 100 0 7208.85 ECU_ADDRESS 0xFFFF2DFA READ_WRITE /end MEASUREMENT
/begin MEASUREMENT vTPO1Z3 "RAM value vTPO1Z3" UWORD COMP_0005 1 100 0 7208.85 ECU_ADDRESS 0xFFFF2DFC READ_WRITE /end MEASUREMENT
/begin MEASUREMENT vTPO1Z4 "RAM value vTPO1Z4" UWORD COMP_0005 1 100 0 7208.85 ECU_ADDRESS 0xFFFF2DFE READ_WRITE /end MEASUREMENT
/begin MEASUREMENT vTPO2 "RAM value vTPO2" UWORD COMP_0005 1 100 0 7208.85 ECU_ADDRESS 0xFFFF20B2 READ_WRITE /end MEASUREMENT
/begin MEASUREMENT vTPO4OV "RAM value vTPO4OV" UWORD COMP_0625_S 1 100 -14.08205 98.55623125 ECU_ADDRESS 0xFFFF1E22 READ_WRITE /end MEASUREMENT
/begin MEASUREMENT vTPOAVE "RAM value vTPOAVE" UWORD COMP_0625_S 1 100 -14.08205 98.55623125 ECU_ADDRESS 0xFFFF38E2 READ_WRITE /end MEASUREMENT
/begin MEASUREMENT vTPOAVEold "RAM value vTPOAVEold" UWORD COMP_0632_S 1 100 0 112.63828125 ECU_ADDRESS 0xFFFF38E4 READ_WRITE /end MEASUREMENT
/begin MEASUREMENT vTPOK "RAM value vTPOK" UBYTE COMP_0002 1 100 0 89.25 ECU_ADDRESS 0xFFFF20B4 READ_WRITE /end MEASUREMENT
/begin MEASUREMENT vTPOLH "RAM value vTPOLH" UWORD COMP_0625_S 1 100 -14.08205 98.55623125 ECU_ADDRESS 0xFFFF3254 READ_WRITE /end MEASUREMENT
/begin MEASUREMENT vTPOLPF "RAM value vTPOLPF" SLONG COMP_0633_S 1 100 -2047.99932052275 2047.99931956908 ECU_ADDRESS 0xFFFF3258 READ_WRITE /end MEASUREMENT
/begin MEASUREMENT vTPOS10 "RAM value vTPOS10" UWORD COMP_0189 1 100 0 209712 ECU_ADDRESS 0xFFFF19F2 READ_WRITE /end MEASUREMENT
/begin MEASUREMENT vTPOS10Q "RAM value vTPOS10Q" ULONG COMP_0369 1 100 0 13743895344 ECU_ADDRESS 0xFFFF16AC READ_WRITE /end MEASUREMENT
/begin MEASUREMENT vTPOSCP "RAM value vTPOSCP" UBYTE COMP_0186 1 100 0 3.984375 ECU_ADDRESS 0xFFFF10E8 READ_WRITE /end MEASUREMENT
/begin MEASUREMENT vTPOSCPHH "RAM value vTPOSCPHH" UBYTE COMP_0186 1 100 0 3.984375 ECU_ADDRESS 0xFFFF4DE8 READ_WRITE /end MEASUREMENT
/begin MEASUREMENT vTPOSCPHL "RAM value vTPOSCPHL" UBYTE COMP_0186 1 100 0 3.984375 ECU_ADDRESS 0xFFFF4DE9 READ_WRITE /end MEASUREMENT
/begin MEASUREMENT vTPOSCPLH "RAM value vTPOSCPLH" UBYTE COMP_0186 1 100 0 3.984375 ECU_ADDRESS 0xFFFF4DEA READ_WRITE /end MEASUREMENT
/begin MEASUREMENT vTPOSCPLL "RAM value vTPOSCPLL" UBYTE COMP_0186 1 100 0 3.984375 ECU_ADDRESS 0xFFFF4DEB READ_WRITE /end MEASUREMENT
/begin MEASUREMENT vTPOSELHI "RAM value vTPOSELHI" UWORD COMP_0625_S 1 100 -14.08205 98.55623125 ECU_ADDRESS 0xFFFF325C READ_WRITE /end MEASUREMENT
/begin MEASUREMENT vTPOz1 "RAM value vTPOz1" UWORD COMP_0005 1 100 0 7208.85 ECU_ADDRESS 0xFFFF38E6 READ_WRITE /end MEASUREMENT
/begin MEASUREMENT vTPOz10 "RAM value vTPOz10" UWORD COMP_0005 1 100 0 7208.85 ECU_ADDRESS 0xFFFF38E8 READ_WRITE /end MEASUREMENT
/begin MEASUREMENT vTPOz2 "RAM value vTPOz2" UWORD COMP_0005 1 100 0 7208.85 ECU_ADDRESS 0xFFFF38EA READ_WRITE /end MEASUREMENT
/begin MEASUREMENT vTPOz3 "RAM value vTPOz3" UWORD COMP_0005 1 100 0 7208.85 ECU_ADDRESS 0xFFFF38EC READ_WRITE /end MEASUREMENT
/begin MEASUREMENT vTPOz4 "RAM value vTPOz4" UWORD COMP_0005 1 100 0 7208.85 ECU_ADDRESS 0xFFFF38EE READ_WRITE /end MEASUREMENT
/begin MEASUREMENT vTPOz5 "RAM value vTPOz5" UWORD COMP_0005 1 100 0 7208.85 ECU_ADDRESS 0xFFFF38F0 READ_WRITE /end MEASUREMENT
/begin MEASUREMENT vTPOz6 "RAM value vTPOz6" UWORD COMP_0005 1 100 0 7208.85 ECU_ADDRESS 0xFFFF38F2 READ_WRITE /end MEASUREMENT
/begin MEASUREMENT vTPOz7 "RAM value vTPOz7" UWORD COMP_0005 1 100 0 7208.85 ECU_ADDRESS 0xFFFF38F4 READ_WRITE /end MEASUREMENT
/begin MEASUREMENT vTPOz8 "RAM value vTPOz8" UWORD COMP_0005 1 100 0 7208.85 ECU_ADDRESS 0xFFFF38F6 READ_WRITE /end MEASUREMENT
/begin MEASUREMENT vTPOz9 "RAM value vTPOz9" UWORD COMP_0005 1 100 0 7208.85 ECU_ADDRESS 0xFFFF38F8 READ_WRITE /end MEASUREMENT
/begin MEASUREMENT vTPQA "RAM value vTPQA" UWORD COMP_0304_S 1 100 0 1.04856 ECU_ADDRESS 0xFFFF2E00 READ_WRITE /end MEASUREMENT
/begin MEASUREMENT vTPRESNGH "RAM value vTPRESNGH" UBYTE COMP_0008 1 100 0 25500 ECU_ADDRESS 0xFFFF2E02 READ_WRITE /end MEASUREMENT
/begin MEASUREMENT vTPRESNGL "RAM value vTPRESNGL" UBYTE COMP_0008 1 100 0 25500 ECU_ADDRESS 0xFFFF2E03 READ_WRITE /end MEASUREMENT
/begin MEASUREMENT vTPRTCOM "RAM value vTPRTCOM" ULONG COMP_0040_S 1 100 0 42949672.95 ECU_ADDRESS 0xFFFF38FC READ_WRITE /end MEASUREMENT
/begin MEASUREMENT vTPS1AV "RAM value vTPS1AV" UWORD COMP_0061 1 100 0 327675 ECU_ADDRESS 0xFFFF325E READ_WRITE /end MEASUREMENT
/begin MEASUREMENT vTPS1AVBUF "RAM value vTPS1AVBUF" ULONG COMP_0061 1 100 0 21474836475 ECU_ADDRESS 0xFFFF3260 READ_WRITE /end MEASUREMENT
/begin MEASUREMENT vTPS1CL "RAM value vTPS1CL" UWORD COMP_0061 1 100 0 327675 ECU_ADDRESS 0xFFFF4F52 READ_WRITE /end MEASUREMENT
/begin MEASUREMENT vTPS1CLJD "RAM value vTPS1CLJD" UWORD COMP_0061 1 100 0 327675 ECU_ADDRESS 0xFFFF3266 READ_WRITE /end MEASUREMENT
/begin MEASUREMENT vTPS1MAX "RAM value vTPS1MAX" UWORD COMP_0023 1 100 0 327675 ECU_ADDRESS 0xFFFF3268 READ_WRITE /end MEASUREMENT
/begin MEASUREMENT vTPS1MIN "RAM value vTPS1MIN" UWORD COMP_0023 1 100 0 327675 ECU_ADDRESS 0xFFFF326A READ_WRITE /end MEASUREMENT
/begin MEASUREMENT vTPS1OF "RAM value vTPS1OF" SWORD COMP_0377 1 100 -3604.48 3604.37 ECU_ADDRESS 0xFFFF20B6 READ_WRITE /end MEASUREMENT
/begin MEASUREMENT vTPS1OV "RAM value vTPS1OV" UWORD COMP_0050 1 100 0 5119.921875 ECU_ADDRESS 0xFFFF326C READ_WRITE /end MEASUREMENT
/begin MEASUREMENT vTPS1SUM "RAM value vTPS1SUM" ULONG COMP_0023 1 100 0 21474836475 ECU_ADDRESS 0xFFFF3270 READ_WRITE /end MEASUREMENT
/begin MEASUREMENT vTPS1V "RAM value vTPS1V" UWORD COMP_0023 1 100 0 327675 ECU_ADDRESS 0xFFFF20B8 READ_WRITE /end MEASUREMENT
/begin MEASUREMENT vTPS1VZ1 "RAM value vTPS1VZ1" UWORD COMP_0023 1 100 0 327675 ECU_ADDRESS 0xFFFF2E04 READ_WRITE /end MEASUREMENT
/begin MEASUREMENT vTPS1VZ2 "RAM value vTPS1VZ2" UWORD COMP_0023 1 100 0 327675 ECU_ADDRESS 0xFFFF2E06 READ_WRITE /end MEASUREMENT
/begin MEASUREMENT vTPS1VZ3 "RAM value vTPS1VZ3" UWORD COMP_0023 1 100 0 327675 ECU_ADDRESS 0xFFFF2E08 READ_WRITE /end MEASUREMENT
/begin MEASUREMENT vTPS1VZ4 "RAM value vTPS1VZ4" UWORD COMP_0023 1 100 0 327675 ECU_ADDRESS 0xFFFF2E0A READ_WRITE /end MEASUREMENT
/begin MEASUREMENT vTPS1V_S "RAM value vTPS1V_S" UWORD COMP_0061 1 100 0 327675 ECU_ADDRESS 0xFFFF32DE READ_WRITE /end MEASUREMENT
/begin MEASUREMENT vTPS2AV "RAM value vTPS2AV" UWORD COMP_0061 1 100 0 327675 ECU_ADDRESS 0xFFFF3274 READ_WRITE /end MEASUREMENT
/begin MEASUREMENT vTPS2AVBUF "RAM value vTPS2AVBUF" ULONG COMP_0061 1 100 0 21474836475 ECU_ADDRESS 0xFFFF3278 READ_WRITE /end MEASUREMENT
/begin MEASUREMENT vTPS2CL "RAM value vTPS2CL" UWORD COMP_0061 1 100 0 327675 ECU_ADDRESS 0xFFFF4F54 READ_WRITE /end MEASUREMENT
/begin MEASUREMENT vTPS2CLJD "RAM value vTPS2CLJD" UWORD COMP_0061 1 100 0 327675 ECU_ADDRESS 0xFFFF327E READ_WRITE /end MEASUREMENT
/begin MEASUREMENT vTPS2OF "RAM value vTPS2OF" SWORD COMP_0377 1 100 -3604.48 3604.37 ECU_ADDRESS 0xFFFF20BA READ_WRITE /end MEASUREMENT
/begin MEASUREMENT vTPS2V "RAM value vTPS2V" UWORD COMP_0023 1 100 0 327675 ECU_ADDRESS 0xFFFF20BC READ_WRITE /end MEASUREMENT
/begin MEASUREMENT vTPS4BAV "RAM value vTPS4BAV" UWORD COMP_0061 1 100 0 327675 ECU_ADDRESS 0xFFFF3280 READ_WRITE /end MEASUREMENT
/begin MEASUREMENT vTPS4BAVBU "RAM value vTPS4BAVBU" ULONG COMP_0061 1 100 0 21474836475 ECU_ADDRESS 0xFFFF3284 READ_WRITE /end MEASUREMENT
/begin MEASUREMENT vTPS4BCJD "RAM value vTPS4BCJD" UWORD COMP_0061 1 100 0 327675 ECU_ADDRESS 0xFFFF328A READ_WRITE /end MEASUREMENT
/begin MEASUREMENT vTPS4BCL "RAM value vTPS4BCL" UWORD COMP_0023 1 100 0 327675 ECU_ADDRESS 0xFFFF4E4C READ_WRITE /end MEASUREMENT
/begin MEASUREMENT vTPS4BOV "RAM value vTPS4BOV" UWORD COMP_0050 1 100 0 5119.921875 ECU_ADDRESS 0xFFFF328C READ_WRITE /end MEASUREMENT
/begin MEASUREMENT vTPS4BV "RAM value vTPS4BV" UWORD COMP_0023 1 100 0 327675 ECU_ADDRESS 0xFFFF328E READ_WRITE /end MEASUREMENT
/begin MEASUREMENT vTPS4MAX "RAM value vTPS4MAX" UWORD COMP_0023 1 100 0 327675 ECU_ADDRESS 0xFFFF3290 READ_WRITE /end MEASUREMENT
/begin MEASUREMENT vTPS4MIN "RAM value vTPS4MIN" UWORD COMP_0023 1 100 0 327675 ECU_ADDRESS 0xFFFF3292 READ_WRITE /end MEASUREMENT
/begin MEASUREMENT vTPS4SUM "RAM value vTPS4SUM" ULONG COMP_0023 1 100 0 21474836475 ECU_ADDRESS 0xFFFF3294 READ_WRITE /end MEASUREMENT
/begin MEASUREMENT vTPSAVCNT "RAM value vTPSAVCNT" UBYTE COMP_0030 1 100 0 255 ECU_ADDRESS 0xFFFF3298 READ_WRITE /end MEASUREMENT
/begin MEASUREMENT vTPSDEFCH "RAM value vTPSDEFCH" UWORD COMP_0023 1 100 0 327675 ECU_ADDRESS 0xFFFF329A READ_WRITE /end MEASUREMENT
/begin MEASUREMENT vTPSK "RAM value vTPSK" SWORD COMP_0515 1 100 -15.999991808 15.999503527 ECU_ADDRESS 0xFFFF1E48 READ_WRITE /end MEASUREMENT
/begin MEASUREMENT vTPSKAPR "RAM value vTPSKAPR" UBYTE COMP_0068 1 100 0 255 ECU_ADDRESS 0xFFFF3BA7 READ_WRITE /end MEASUREMENT
/begin MEASUREMENT vTPSKQH "RAM value vTPSKQH" SWORD COMP_0515 1 100 -15.999991808 15.999503527 ECU_ADDRESS 0xFFFF16B0 READ_WRITE /end MEASUREMENT
/begin MEASUREMENT vTPSKVCL "RAM value vTPSKVCL" SWORD COMP_0515 1 100 -15.999991808 15.999503527 ECU_ADDRESS 0xFFFF1B62 READ_WRITE /end MEASUREMENT
/begin MEASUREMENT vTPSTRQ "RAM value vTPSTRQ" UWORD COMP_0196 1 100 0 6553.5 ECU_ADDRESS 0xFFFF10EA READ_WRITE /end MEASUREMENT
/begin MEASUREMENT vTPSYDG1 "RAM value vTPSYDG1" UBYTE COMP_0008 1 100 0 25500 ECU_ADDRESS 0xFFFF10EC READ_WRITE /end MEASUREMENT
/begin MEASUREMENT vTPSYDG1V "RAM value vTPSYDG1V" UBYTE COMP_0008 1 100 0 25500 ECU_ADDRESS 0xFFFF10ED READ_WRITE /end MEASUREMENT
/begin MEASUREMENT vTPSYDG2 "RAM value vTPSYDG2" UBYTE COMP_0008 1 100 0 25500 ECU_ADDRESS 0xFFFF10EE READ_WRITE /end MEASUREMENT
/begin MEASUREMENT vTPSYDG2V "RAM value vTPSYDG2V" UBYTE COMP_0008 1 100 0 25500 ECU_ADDRESS 0xFFFF10EF READ_WRITE /end MEASUREMENT
/begin MEASUREMENT vTPSYDG3 "RAM value vTPSYDG3" UBYTE COMP_0008 1 100 0 25500 ECU_ADDRESS 0xFFFF2E0C READ_WRITE /end MEASUREMENT
/begin MEASUREMENT vTPSYDG3V "RAM value vTPSYDG3V" UBYTE COMP_0008 1 100 0 25500 ECU_ADDRESS 0xFFFF2E0D READ_WRITE /end MEASUREMENT
/begin MEASUREMENT vTPSYDG4 "RAM value vTPSYDG4" UBYTE COMP_0008 1 100 0 25500 ECU_ADDRESS 0xFFFF10F0 READ_WRITE /end MEASUREMENT
/begin MEASUREMENT vTPTRM "RAM value vTPTRM" UWORD COMP_0512 1 100 0 127.998046875 ECU_ADDRESS 0xFFFF332C READ_WRITE /end MEASUREMENT
/begin MEASUREMENT vTPTRMISC "RAM value vTPTRMISC" UWORD COMP_0512 1 100 0 127.998046875 ECU_ADDRESS 0xFFFF159E READ_WRITE /end MEASUREMENT
/begin MEASUREMENT vTPTRMN "RAM value vTPTRMN" UWORD COMP_0144 1 100 0 31.999495335 ECU_ADDRESS 0xFFFF329C READ_WRITE /end MEASUREMENT
/begin MEASUREMENT vTPTRMNL "RAM value vTPTRMNL" ULONG COMP_0144 1 100 0 2097150.9257699 ECU_ADDRESS 0xFFFF32A0 READ_WRITE /end MEASUREMENT
/begin MEASUREMENT vTPUMKEB "RAM value vTPUMKEB" UWORD COMP_0152_S 1 100 0 419424 ECU_ADDRESS 0xFFFF19F4 READ_WRITE /end MEASUREMENT
/begin MEASUREMENT vTPUMKEBB "RAM value vTPUMKEBB" UWORD COMP_0634_S 1 100 0 419424 ECU_ADDRESS 0xFFFF10F2 READ_WRITE /end MEASUREMENT
/begin MEASUREMENT vTPUREB "RAM value vTPUREB" UWORD COMP_0152_S 1 100 0 419424 ECU_ADDRESS 0xFFFF10F4 READ_WRITE /end MEASUREMENT
/begin MEASUREMENT vTPV "RAM value vTPV" UWORD COMP_0144 1 100 0 31.999495335 ECU_ADDRESS 0xFFFF10F6 READ_WRITE /end MEASUREMENT
/begin MEASUREMENT vTPVEF "RAM value vTPVEF" UWORD COMP_0146 1 100 0 99.998480265 ECU_ADDRESS 0xFFFF3BA8 READ_WRITE /end MEASUREMENT
/begin MEASUREMENT vTPWACC "RAM value vTPWACC" UWORD COMP_0032_S 1 100 0 8191.875 ECU_ADDRESS 0xFFFF2E0E READ_WRITE /end MEASUREMENT
/begin MEASUREMENT vTPWACC_S "RAM value vTPWACC_S" UWORD COMP_0032_S 1 100 0 8191.875 ECU_ADDRESS 0xFFFF3064 READ_WRITE /end MEASUREMENT
/begin MEASUREMENT vTPWCC "RAM value vTPWCC" UWORD COMP_0032_S 1 100 0 8191.875 ECU_ADDRESS 0xFFFF2E10 READ_WRITE /end MEASUREMENT
/begin MEASUREMENT vTPWCC_S "RAM value vTPWCC_S" UWORD COMP_0032_S 1 100 0 8191.875 ECU_ADDRESS 0xFFFF3066 READ_WRITE /end MEASUREMENT
/begin MEASUREMENT vTPWSL "RAM value vTPWSL" UWORD COMP_0032_S 1 100 0 8191.875 ECU_ADDRESS 0xFFFF2E12 READ_WRITE /end MEASUREMENT
/begin MEASUREMENT vTPWSL_S "RAM value vTPWSL_S" UWORD COMP_0032_S 1 100 0 8191.875 ECU_ADDRESS 0xFFFF3068 READ_WRITE /end MEASUREMENT
/begin MEASUREMENT vTPZ1 "RAM value vTPZ1" UWORD COMP_0144 1 100 0 31.999495335 ECU_ADDRESS 0xFFFF10F8 READ_WRITE /end MEASUREMENT
/begin MEASUREMENT vTPZ10MS "RAM value vTPZ10MS" UWORD COMP_0144 1 100 0 31.999495335 ECU_ADDRESS 0xFFFF16B2 READ_WRITE /end MEASUREMENT
/begin MEASUREMENT vTPZ2 "RAM value vTPZ2" UWORD COMP_0144 1 100 0 31.999495335 ECU_ADDRESS 0xFFFF10FA READ_WRITE /end MEASUREMENT
/begin MEASUREMENT vTPZ3 "RAM value vTPZ3" UWORD COMP_0144 1 100 0 31.999495335 ECU_ADDRESS 0xFFFF10FC READ_WRITE /end MEASUREMENT
/begin MEASUREMENT vTPZ4 "RAM value vTPZ4" UWORD COMP_0144 1 100 0 31.999495335 ECU_ADDRESS 0xFFFF10FE READ_WRITE /end MEASUREMENT
/begin MEASUREMENT vTP_F "RAM value vTP_F" ULONG COMP_0144 1 100 0 2097150.9257699 ECU_ADDRESS 0xFFFF1E1C READ_WRITE /end MEASUREMENT
/begin MEASUREMENT vTP_F0 "RAM value vTP_F0" ULONG COMP_0144 1 100 0 2097150.9257699 ECU_ADDRESS 0xFFFF3248 READ_WRITE /end MEASUREMENT
/begin MEASUREMENT vTP_FBF "RAM value vTP_FBF" ULONG COMP_0144 1 100 0 2097150.9257699 ECU_ADDRESS 0xFFFF324C READ_WRITE /end MEASUREMENT
/begin MEASUREMENT vTP_FBUF "RAM value vTP_FBUF" ULONG COMP_0144 1 100 0 2097150.9257699 ECU_ADDRESS 0xFFFF2DF4 READ_WRITE /end MEASUREMENT
/begin MEASUREMENT vTQ12AGBF "RAM value vTQ12AGBF" UWORD COMP_0635_S 1 100 -400 32367.5 ECU_ADDRESS 0xFFFF3900 READ_WRITE /end MEASUREMENT
/begin MEASUREMENT vTQ12AGBS "RAM value vTQ12AGBS" UWORD COMP_0635_S 1 100 -400 32367.5 ECU_ADDRESS 0xFFFF3902 READ_WRITE /end MEASUREMENT
/begin MEASUREMENT vTQ12ARBT "RAM value vTQ12ARBT" UWORD COMP_0636_S 1 100 -400 32367.5 ECU_ADDRESS 0xFFFF3904 READ_WRITE /end MEASUREMENT
/begin MEASUREMENT vTQ12ASRF "RAM value vTQ12ASRF" UWORD COMP_0635_S 1 100 -400 32367.5 ECU_ADDRESS 0xFFFF3906 READ_WRITE /end MEASUREMENT
/begin MEASUREMENT vTQ12ASRS "RAM value vTQ12ASRS" UWORD COMP_0635_S 1 100 -400 32367.5 ECU_ADDRESS 0xFFFF3908 READ_WRITE /end MEASUREMENT
/begin MEASUREMENT vTQ12ENG "RAM value vTQ12ENG" UWORD COMP_0636_S 1 100 -400 32367.5 ECU_ADDRESS 0xFFFF390A READ_WRITE /end MEASUREMENT
/begin MEASUREMENT vTQ12ENG2 "RAM value vTQ12ENG2" UWORD COMP_0636_S 1 100 -400 32367.5 ECU_ADDRESS 0xFFFF390C READ_WRITE /end MEASUREMENT
/begin MEASUREMENT vTQ12ETS "RAM value vTQ12ETS" UWORD COMP_0635_S 1 100 -400 32367.5 ECU_ADDRESS 0xFFFF390E READ_WRITE /end MEASUREMENT
/begin MEASUREMENT vTQ12FRIC "RAM value vTQ12FRIC" UWORD COMP_0636_S 1 100 -400 32367.5 ECU_ADDRESS 0xFFFF3910 READ_WRITE /end MEASUREMENT
/begin MEASUREMENT vTQ12MSR "RAM value vTQ12MSR" UWORD COMP_0635_S 1 100 -400 32367.5 ECU_ADDRESS 0xFFFF3912 READ_WRITE /end MEASUREMENT
/begin MEASUREMENT vTQ12WOGB "RAM value vTQ12WOGB" UWORD COMP_0636_S 1 100 -400 32367.5 ECU_ADDRESS 0xFFFF3914 READ_WRITE /end MEASUREMENT
/begin MEASUREMENT vTQAGBMNF "RAM value vTQAGBMNF" SWORD COMP_0228 1 100 -3276.8 3276.7 ECU_ADDRESS 0xFFFF2E14 READ_WRITE /end MEASUREMENT
/begin MEASUREMENT vTQAGBMNS "RAM value vTQAGBMNS" SWORD COMP_0228 1 100 -3276.8 3276.7 ECU_ADDRESS 0xFFFF2E16 READ_WRITE /end MEASUREMENT
/begin MEASUREMENT vTQAGBMXF "RAM value vTQAGBMXF" SWORD COMP_0228 1 100 -3276.8 3276.7 ECU_ADDRESS 0xFFFF2E18 READ_WRITE /end MEASUREMENT
/begin MEASUREMENT vTQAGBMXS "RAM value vTQAGBMXS" SWORD COMP_0228 1 100 -3276.8 3276.7 ECU_ADDRESS 0xFFFF2E1A READ_WRITE /end MEASUREMENT
/begin MEASUREMENT vTQAGMNF0 "RAM value vTQAGMNF0" SWORD COMP_0228 1 100 -3276.8 3276.7 ECU_ADDRESS 0xFFFF2E1C READ_WRITE /end MEASUREMENT
/begin MEASUREMENT vTQAGMNS0 "RAM value vTQAGMNS0" SWORD COMP_0228 1 100 -3276.8 3276.7 ECU_ADDRESS 0xFFFF2E1E READ_WRITE /end MEASUREMENT
/begin MEASUREMENT vTQAGMXF0 "RAM value vTQAGMXF0" SWORD COMP_0228 1 100 -3276.8 3276.7 ECU_ADDRESS 0xFFFF2E20 READ_WRITE /end MEASUREMENT
/begin MEASUREMENT vTQAGMXS0 "RAM value vTQAGMXS0" SWORD COMP_0228 1 100 -3276.8 3276.7 ECU_ADDRESS 0xFFFF2E22 READ_WRITE /end MEASUREMENT
/begin MEASUREMENT vTQASROUT "RAM value vTQASROUT" SWORD COMP_0228 1 100 -3276.8 3276.7 ECU_ADDRESS 0xFFFF2E24 READ_WRITE /end MEASUREMENT
/begin MEASUREMENT vTQCTLTYP "RAM value vTQCTLTYP" UBYTE COMP_0068 1 100 0 255 ECU_ADDRESS 0xFFFF20BE READ_WRITE /end MEASUREMENT
/begin MEASUREMENT vTQENGLOS "RAM value vTQENGLOS" SWORD COMP_0228 1 100 -3276.8 3276.7 ECU_ADDRESS 0xFFFF2E26 READ_WRITE /end MEASUREMENT
/begin MEASUREMENT vTQH0AP "RAM value vTQH0AP" UWORD COMP_0146 1 100 0 99.998480265 ECU_ADDRESS 0xFFFF1100 READ_WRITE /end MEASUREMENT
/begin MEASUREMENT vTQH0AP_S "RAM value vTQH0AP_S" UWORD COMP_0146 1 100 0 99.998480265 ECU_ADDRESS 0xFFFF14F0 READ_WRITE /end MEASUREMENT
/begin MEASUREMENT vTQH0CKLT "RAM value vTQH0CKLT" UWORD COMP_0146 1 100 0 99.998480265 ECU_ADDRESS 0xFFFF1102 READ_WRITE /end MEASUREMENT
/begin MEASUREMENT vTQH0IF "RAM value vTQH0IF" UWORD COMP_0146 1 100 0 99.998480265 ECU_ADDRESS 0xFFFF1104 READ_WRITE /end MEASUREMENT
/begin MEASUREMENT vTQH0PD_S "RAM value vTQH0PD_S" UWORD COMP_0146 1 100 0 99.998480265 ECU_ADDRESS 0xFFFF14F2 READ_WRITE /end MEASUREMENT
/begin MEASUREMENT vTQH0PTD "RAM value vTQH0PTD" UWORD COMP_0146 1 100 0 99.998480265 ECU_ADDRESS 0xFFFF1106 READ_WRITE /end MEASUREMENT
/begin MEASUREMENT vTQH0SL "RAM value vTQH0SL" UWORD COMP_0146 1 100 0 99.998480265 ECU_ADDRESS 0xFFFF1108 READ_WRITE /end MEASUREMENT
/begin MEASUREMENT vTQH0ST "RAM value vTQH0ST" UWORD COMP_0146 1 100 0 99.998480265 ECU_ADDRESS 0xFFFF110A READ_WRITE /end MEASUREMENT
/begin MEASUREMENT vTQH0STCM "RAM value vTQH0STCM" UWORD COMP_0146 1 100 0 99.998480265 ECU_ADDRESS 0xFFFF2E28 READ_WRITE /end MEASUREMENT
/begin MEASUREMENT vTQH0ST_S "RAM value vTQH0ST_S" UWORD COMP_0410 1 100 0 99.9985458 ECU_ADDRESS 0xFFFF14F4 READ_WRITE /end MEASUREMENT
/begin MEASUREMENT vTQH0TE "RAM value vTQH0TE" UWORD COMP_0146 1 100 0 99.998480265 ECU_ADDRESS 0xFFFF110C READ_WRITE /end MEASUREMENT
/begin MEASUREMENT vTQH0TESL "RAM value vTQH0TESL" UWORD COMP_0146 1 100 0 99.998480265 ECU_ADDRESS 0xFFFF110E READ_WRITE /end MEASUREMENT
/begin MEASUREMENT vTQH0TE_S "RAM value vTQH0TE_S" UWORD COMP_0146 1 100 0 99.998480265 ECU_ADDRESS 0xFFFF14F6 READ_WRITE /end MEASUREMENT
/begin MEASUREMENT vTQHIERA "RAM value vTQHIERA" SWORD COMP_0228 1 100 -3276.8 3276.7 ECU_ADDRESS 0xFFFF2E2A READ_WRITE /end MEASUREMENT
/begin MEASUREMENT vTQLIMFST "RAM value vTQLIMFST" SWORD COMP_0228 1 100 -3276.8 3276.7 ECU_ADDRESS 0xFFFF2E2C READ_WRITE /end MEASUREMENT
/begin MEASUREMENT vTQLIMSLW "RAM value vTQLIMSLW" SWORD COMP_0228 1 100 -3276.8 3276.7 ECU_ADDRESS 0xFFFF2E2E READ_WRITE /end MEASUREMENT
/begin MEASUREMENT vTQREQSF "RAM value vTQREQSF" UBYTE COMP_0068 1 100 0 255 ECU_ADDRESS 0xFFFF3BAA READ_WRITE /end MEASUREMENT
/begin MEASUREMENT vTQRET "RAM value vTQRET" SBYTE COMP_0018 1 100 -128 127 ECU_ADDRESS 0xFFFF0969 READ_WRITE /end MEASUREMENT
/begin MEASUREMENT vTQRETAT "RAM value vTQRETAT" SBYTE COMP_0018 1 100 -128 127 ECU_ADDRESS 0xFFFF096A READ_WRITE /end MEASUREMENT
/begin MEASUREMENT vTQRQASRF "RAM value vTQRQASRF" SWORD COMP_0228 1 100 -3276.8 3276.7 ECU_ADDRESS 0xFFFF20C0 READ_WRITE /end MEASUREMENT
/begin MEASUREMENT vTQRQASRS "RAM value vTQRQASRS" SWORD COMP_0228 1 100 -3276.8 3276.7 ECU_ADDRESS 0xFFFF20C2 READ_WRITE /end MEASUREMENT
/begin MEASUREMENT vTQRQMSR "RAM value vTQRQMSR" SWORD COMP_0228 1 100 -3276.8 3276.7 ECU_ADDRESS 0xFFFF20C4 READ_WRITE /end MEASUREMENT
/begin MEASUREMENT vTQSPDCTF "RAM value vTQSPDCTF" SWORD COMP_0228 1 100 -3276.8 3276.7 ECU_ADDRESS 0xFFFF2E30 READ_WRITE /end MEASUREMENT
/begin MEASUREMENT vTQSPDLMP "RAM value vTQSPDLMP" SWORD COMP_0228 1 100 -3276.8 3276.7 ECU_ADDRESS 0xFFFF2E32 READ_WRITE /end MEASUREMENT
/begin MEASUREMENT vTQTMDYNC "RAM value vTQTMDYNC" UBYTE COMP_0497_S 1 100 -100 410 ECU_ADDRESS 0xFFFF20C6 READ_WRITE /end MEASUREMENT
/begin MEASUREMENT vTQTMLMTN "RAM value vTQTMLMTN" SWORD COMP_0228 1 100 -3276.8 3276.7 ECU_ADDRESS 0xFFFF2E34 READ_WRITE /end MEASUREMENT
/begin MEASUREMENT vTQTMSTA "RAM value vTQTMSTA" SWORD COMP_0228 1 100 -3276.8 3276.7 ECU_ADDRESS 0xFFFF2E36 READ_WRITE /end MEASUREMENT
/begin MEASUREMENT vTQTMSTAC "RAM value vTQTMSTAC" UBYTE COMP_0497_S 1 100 -100 410 ECU_ADDRESS 0xFFFF20C7 READ_WRITE /end MEASUREMENT
/begin MEASUREMENT vTQUPFSTM "RAM value vTQUPFSTM" UBYTE COMP_0014 1 100 0 2550 ECU_ADDRESS 0xFFFF2E38 READ_WRITE /end MEASUREMENT
/begin MEASUREMENT vTQUPONTM "RAM value vTQUPONTM" UBYTE COMP_0014 1 100 0 2550 ECU_ADDRESS 0xFFFF2E39 READ_WRITE /end MEASUREMENT
/begin MEASUREMENT vTQWOAGB "RAM value vTQWOAGB" SWORD COMP_0228 1 100 -3276.8 3276.7 ECU_ADDRESS 0xFFFF3BAC READ_WRITE /end MEASUREMENT
/begin MEASUREMENT vTQWOAGB0 "RAM value vTQWOAGB0" SWORD COMP_0228 1 100 -3276.8 3276.7 ECU_ADDRESS 0xFFFF2E3A READ_WRITE /end MEASUREMENT
/begin MEASUREMENT vTQWOAGBF "RAM value vTQWOAGBF" SWORD COMP_0228 1 100 -3276.8 3276.7 ECU_ADDRESS 0xFFFF1B64 READ_WRITE /end MEASUREMENT
/begin MEASUREMENT vTQWOAG_S "RAM value vTQWOAG_S" SWORD COMP_0228 1 100 -3276.8 3276.7 ECU_ADDRESS 0xFFFF212E READ_WRITE /end MEASUREMENT
/begin MEASUREMENT vTQWOARBT "RAM value vTQWOARBT" SWORD COMP_0228 1 100 -3276.8 3276.7 ECU_ADDRESS 0xFFFF3BAE READ_WRITE /end MEASUREMENT
/begin MEASUREMENT vTRACE "RAM value vTRACE" SBYTE COMP_0018 1 100 -128 127 ECU_ADDRESS 0xFFFF1B66 READ_WRITE /end MEASUREMENT
/begin MEASUREMENT vTRADV "RAM value vTRADV" UBYTE COMP_0017 1 100 0 255 ECU_ADDRESS 0xFFFF1110 READ_WRITE /end MEASUREMENT
/begin MEASUREMENT vTRADVnew "RAM value vTRADVnew" UBYTE COMP_0017 1 100 0 255 ECU_ADDRESS 0xFFFF1111 READ_WRITE /end MEASUREMENT
/begin MEASUREMENT vTRAIDXF "RAM value vTRAIDXF" UWORD COMP_0182_S 1 100 0 65.535 ECU_ADDRESS 0xFFFF2E3C READ_WRITE /end MEASUREMENT
/begin MEASUREMENT vTRAIDXST "RAM value vTRAIDXST" UWORD COMP_0182_S 1 100 0 65.535 ECU_ADDRESS 0xFFFF2E3E READ_WRITE /end MEASUREMENT
/begin MEASUREMENT vTRAINDEX "RAM value vTRAINDEX" SWORD COMP_0297_S 1 100 -32.768 32.767 ECU_ADDRESS 0xFFFF2E40 READ_WRITE /end MEASUREMENT
/begin MEASUREMENT vTRAITAC "RAM value vTRAITAC" UBYTE COMP_0009 1 100 0 199.21875 ECU_ADDRESS 0xFFFF1E4A READ_WRITE /end MEASUREMENT
/begin MEASUREMENT vTRAITAC1 "RAM value vTRAITAC1" UBYTE COMP_0009 1 100 0 199.21875 ECU_ADDRESS 0xFFFF332E READ_WRITE /end MEASUREMENT
/begin MEASUREMENT vTRAITAC2 "RAM value vTRAITAC2" UBYTE COMP_0009 1 100 0 199.21875 ECU_ADDRESS 0xFFFF332F READ_WRITE /end MEASUREMENT
/begin MEASUREMENT vTRAITAC3 "RAM value vTRAITAC3" UBYTE COMP_0009 1 100 0 199.21875 ECU_ADDRESS 0xFFFF3330 READ_WRITE /end MEASUREMENT
/begin MEASUREMENT vTRAITAC4 "RAM value vTRAITAC4" UBYTE COMP_0009 1 100 0 199.21875 ECU_ADDRESS 0xFFFF3331 READ_WRITE /end MEASUREMENT
/begin MEASUREMENT vTRAMRESR "RAM value vTRAMRESR" UWORD COMP_0214_S 1 100 0 0.65535 ECU_ADDRESS 0xFFFF2E42 READ_WRITE /end MEASUREMENT
/begin MEASUREMENT vTRANRPM "RAM value vTRANRPM" UWORD COMP_0006 1 100 0 819187.5 ECU_ADDRESS 0xFFFF1E4C READ_WRITE /end MEASUREMENT
/begin MEASUREMENT vTRANRPM1 "RAM value vTRANRPM1" UWORD COMP_0006 1 100 0 819187.5 ECU_ADDRESS 0xFFFF3332 READ_WRITE /end MEASUREMENT
/begin MEASUREMENT vTRANRPM2 "RAM value vTRANRPM2" UWORD COMP_0006 1 100 0 819187.5 ECU_ADDRESS 0xFFFF3334 READ_WRITE /end MEASUREMENT
/begin MEASUREMENT vTRANRPM3 "RAM value vTRANRPM3" UWORD COMP_0006 1 100 0 819187.5 ECU_ADDRESS 0xFFFF3336 READ_WRITE /end MEASUREMENT
/begin MEASUREMENT vTRANRPM4 "RAM value vTRANRPM4" UWORD COMP_0006 1 100 0 819187.5 ECU_ADDRESS 0xFFFF3338 READ_WRITE /end MEASUREMENT
/begin MEASUREMENT vTRARET "RAM value vTRARET" SWORD COMP_0484_S 1 100 -32768 32767 ECU_ADDRESS 0xFFFF3BB0 READ_WRITE /end MEASUREMENT
/begin MEASUREMENT vTRARETBF "RAM value vTRARETBF" SWORD COMP_0484_S 1 100 -32768 32767 ECU_ADDRESS 0xFFFF2E44 READ_WRITE /end MEASUREMENT
/begin MEASUREMENT vTRARETD "RAM value vTRARETD" SWORD COMP_0484_S 1 100 -32768 32767 ECU_ADDRESS 0xFFFF2E46 READ_WRITE /end MEASUREMENT
/begin MEASUREMENT vTRARETF "RAM value vTRARETF" SWORD COMP_0484_S 1 100 -32768 32767 ECU_ADDRESS 0xFFFF2E48 READ_WRITE /end MEASUREMENT
/begin MEASUREMENT vTRCCNT "RAM value vTRCCNT" UBYTE COMP_0068 1 100 0 255 ECU_ADDRESS 0xFFFF3916 READ_WRITE /end MEASUREMENT
/begin MEASUREMENT vTRDLITC "RAM value vTRDLITC" SBYTE COMP_0238 1 100 -100 99.21875 ECU_ADDRESS 0xFFFF1E4E READ_WRITE /end MEASUREMENT
/begin MEASUREMENT vTRDLITC1 "RAM value vTRDLITC1" SBYTE COMP_0238 1 100 -100 99.21875 ECU_ADDRESS 0xFFFF333A READ_WRITE /end MEASUREMENT
/begin MEASUREMENT vTRDLITC2 "RAM value vTRDLITC2" SBYTE COMP_0238 1 100 -100 99.21875 ECU_ADDRESS 0xFFFF333B READ_WRITE /end MEASUREMENT
/begin MEASUREMENT vTRDLITC3 "RAM value vTRDLITC3" SBYTE COMP_0238 1 100 -100 99.21875 ECU_ADDRESS 0xFFFF333C READ_WRITE /end MEASUREMENT
/begin MEASUREMENT vTRDLITC4 "RAM value vTRDLITC4" SBYTE COMP_0238 1 100 -100 99.21875 ECU_ADDRESS 0xFFFF333D READ_WRITE /end MEASUREMENT
/begin MEASUREMENT vTREF "RAM value vTREF" ULONG COMP_0073 1 100 0 13743895344 ECU_ADDRESS 0xFFFF096C READ_WRITE /end MEASUREMENT
/begin MEASUREMENT vTREF10 "RAM value vTREF10" UWORD COMP_0189 1 100 0 209712 ECU_ADDRESS 0xFFFF19F6 READ_WRITE /end MEASUREMENT
/begin MEASUREMENT vTREF4BE "RAM value vTREF4BE" ULONG COMP_0369 1 100 0 13743895344 ECU_ADDRESS 0xFFFF19F8 READ_WRITE /end MEASUREMENT
/begin MEASUREMENT vTREF_S "RAM value vTREF_S" ULONG COMP_0369 1 100 0 13743895344 ECU_ADDRESS 0xFFFF1A24 READ_WRITE /end MEASUREMENT
/begin MEASUREMENT vTRGCHG "RAM value vTRGCHG" UBYTE COMP_0048 1 100 0 127.5 ECU_ADDRESS 0xFFFF1112 READ_WRITE /end MEASUREMENT
/begin MEASUREMENT vTRGCHGE "RAM value vTRGCHGE" UBYTE COMP_0048 1 100 0 127.5 ECU_ADDRESS 0xFFFF1113 READ_WRITE /end MEASUREMENT
/begin MEASUREMENT vTRGEVA "RAM value vTRGEVA" UBYTE COMP_0548_S 1 100 -30 54.9999915 ECU_ADDRESS 0xFFFF16B4 READ_WRITE /end MEASUREMENT
/begin MEASUREMENT vTRGLVL "RAM value vTRGLVL" UBYTE COMP_0004 1 100 0 255 ECU_ADDRESS 0xFFFF4F56 READ_WRITE /end MEASUREMENT
/begin MEASUREMENT vTRGTIM "RAM value vTRGTIM" UBYTE COMP_0008 1 100 0 25500 ECU_ADDRESS 0xFFFF1114 READ_WRITE /end MEASUREMENT
/begin MEASUREMENT vTRGTIMEX "RAM value vTRGTIMEX" UBYTE COMP_0008 1 100 0 25500 ECU_ADDRESS 0xFFFF1116 READ_WRITE /end MEASUREMENT
/begin MEASUREMENT vTRGTIOPE "RAM value vTRGTIOPE" UBYTE COMP_0008 1 100 0 25500 ECU_ADDRESS 0xFFFF1118 READ_WRITE /end MEASUREMENT
/begin MEASUREMENT vTRITCLMT "RAM value vTRITCLMT" UWORD COMP_0009 1 100 0 51199.21875 ECU_ADDRESS 0xFFFF2E4A READ_WRITE /end MEASUREMENT
/begin MEASUREMENT vTRLCNT "RAM value vTRLCNT" UBYTE COMP_0016 1 100 0 255 ECU_ADDRESS 0xFFFF2E4C READ_WRITE /end MEASUREMENT
/begin MEASUREMENT vTRMTLRQ "RAM value vTRMTLRQ" UBYTE COMP_0283 1 100 0 255 ECU_ADDRESS 0xFFFF2E4E READ_WRITE /end MEASUREMENT
/begin MEASUREMENT vTROFMTf "RAM value vTROFMTf" UBYTE COMP_0004 1 100 0 255 ECU_ADDRESS 0xFFFF2E4F READ_WRITE /end MEASUREMENT
/begin MEASUREMENT vTRORMBT "RAM value vTRORMBT" SBYTE COMP_0018 1 100 -128 127 ECU_ADDRESS 0xFFFF111A READ_WRITE /end MEASUREMENT
/begin MEASUREMENT vTROXM "RAM value vTROXM" UWORD COMP_0049 1 100 0 65535 ECU_ADDRESS 0xFFFF2E50 READ_WRITE /end MEASUREMENT
/begin MEASUREMENT vTRQ "RAM value vTRQ" ULONG COMP_0489_S 1 100 0 429496.7295 ECU_ADDRESS 0xFFFF2E54 READ_WRITE /end MEASUREMENT
/begin MEASUREMENT vTRQ1SD "RAM value vTRQ1SD" SWORD COMP_0228 1 100 -3276.8 3276.7 ECU_ADDRESS 0xFFFF2E58 READ_WRITE /end MEASUREMENT
/begin MEASUREMENT vTRQ1TD "RAM value vTRQ1TD" SWORD COMP_0228 1 100 -3276.8 3276.7 ECU_ADDRESS 0xFFFF2E5A READ_WRITE /end MEASUREMENT
/begin MEASUREMENT vTRQ2SD "RAM value vTRQ2SD" SWORD COMP_0228 1 100 -3276.8 3276.7 ECU_ADDRESS 0xFFFF2E5C READ_WRITE /end MEASUREMENT
/begin MEASUREMENT vTRQ4WD "RAM value vTRQ4WD" SWORD COMP_0228 1 100 -3276.8 3276.7 ECU_ADDRESS 0xFFFF2E5E READ_WRITE /end MEASUREMENT
/begin MEASUREMENT vTRQ4WD0 "RAM value vTRQ4WD0" SWORD COMP_0228 1 100 -3276.8 3276.7 ECU_ADDRESS 0xFFFF2E60 READ_WRITE /end MEASUREMENT
/begin MEASUREMENT vTRQAGBF "RAM value vTRQAGBF" SWORD COMP_0228 1 100 -3276.8 3276.7 ECU_ADDRESS 0xFFFF20C8 READ_WRITE /end MEASUREMENT
/begin MEASUREMENT vTRQAGBS "RAM value vTRQAGBS" SWORD COMP_0228 1 100 -3276.8 3276.7 ECU_ADDRESS 0xFFFF20CA READ_WRITE /end MEASUREMENT
/begin MEASUREMENT vTRQASRF "RAM value vTRQASRF" SWORD COMP_0228 1 100 -3276.8 3276.7 ECU_ADDRESS 0xFFFF2E62 READ_WRITE /end MEASUREMENT
/begin MEASUREMENT vTRQASRS "RAM value vTRQASRS" SWORD COMP_0228 1 100 -3276.8 3276.7 ECU_ADDRESS 0xFFFF2E64 READ_WRITE /end MEASUREMENT
/begin MEASUREMENT vTRQAST "RAM value vTRQAST" UWORD COMP_0217 1 100 0 3.999941832 ECU_ADDRESS 0xFFFF111C READ_WRITE /end MEASUREMENT
/begin MEASUREMENT vTRQAST2 "RAM value vTRQAST2" UWORD COMP_0217 1 100 0 3.999941832 ECU_ADDRESS 0xFFFF111E READ_WRITE /end MEASUREMENT
/begin MEASUREMENT vTRQAST3 "RAM value vTRQAST3" UWORD COMP_0217 1 100 0 3.999941832 ECU_ADDRESS 0xFFFF1120 READ_WRITE /end MEASUREMENT
/begin MEASUREMENT vTRQAST4 "RAM value vTRQAST4" UWORD COMP_0217 1 100 0 3.999941832 ECU_ADDRESS 0xFFFF09A0 READ_WRITE /end MEASUREMENT
/begin MEASUREMENT vTRQATD "RAM value vTRQATD" SWORD COMP_0228 1 100 -3276.8 3276.7 ECU_ADDRESS 0xFFFF2E66 READ_WRITE /end MEASUREMENT
/begin MEASUREMENT vTRQBAL "RAM value vTRQBAL" UWORD COMP_0637_S 1 100 0 255586.5 ECU_ADDRESS 0xFFFF2E68 READ_WRITE /end MEASUREMENT
/begin MEASUREMENT vTRQBALKJ "RAM value vTRQBALKJ" UWORD COMP_0637_S 1 100 0 255586.5 ECU_ADDRESS 0xFFFF2E6A READ_WRITE /end MEASUREMENT
/begin MEASUREMENT vTRQBALKP "RAM value vTRQBALKP" ULONG COMP_0637_S 1 100 0 16750372450.5 ECU_ADDRESS 0xFFFF2E6C READ_WRITE /end MEASUREMENT
/begin MEASUREMENT vTRQBLAVE "RAM value vTRQBLAVE" ULONG COMP_0637_S 1 100 0 16750372450.5 ECU_ADDRESS 0xFFFF4DEC READ_WRITE /end MEASUREMENT
/begin MEASUREMENT vTRQBLEND "RAM value vTRQBLEND" ULONG COMP_0637_S 1 100 0 16750372450.5 ECU_ADDRESS 0xFFFF4DF0 READ_WRITE /end MEASUREMENT
/begin MEASUREMENT vTRQBLMAX "RAM value vTRQBLMAX" ULONG COMP_0637_S 1 100 0 16750372450.5 ECU_ADDRESS 0xFFFF4DF4 READ_WRITE /end MEASUREMENT
/begin MEASUREMENT vTRQBLMIN "RAM value vTRQBLMIN" ULONG COMP_0637_S 1 100 0 16750372450.5 ECU_ADDRESS 0xFFFF4DF8 READ_WRITE /end MEASUREMENT
/begin MEASUREMENT vTRQDIG "RAM value vTRQDIG" SWORD COMP_0228 1 100 -3276.8 3276.7 ECU_ADDRESS 0xFFFF2E70 READ_WRITE /end MEASUREMENT
/begin MEASUREMENT vTRQDIG1 "RAM value vTRQDIG1" SWORD COMP_0228 1 100 -3276.8 3276.7 ECU_ADDRESS 0xFFFF2E72 READ_WRITE /end MEASUREMENT
/begin MEASUREMENT vTRQDIG2 "RAM value vTRQDIG2" SWORD COMP_0228 1 100 -3276.8 3276.7 ECU_ADDRESS 0xFFFF2E74 READ_WRITE /end MEASUREMENT
/begin MEASUREMENT vTRQDIG3 "RAM value vTRQDIG3" SWORD COMP_0228 1 100 -3276.8 3276.7 ECU_ADDRESS 0xFFFF2E76 READ_WRITE /end MEASUREMENT
/begin MEASUREMENT vTRQDIG4 "RAM value vTRQDIG4" SWORD COMP_0228 1 100 -3276.8 3276.7 ECU_ADDRESS 0xFFFF2E78 READ_WRITE /end MEASUREMENT
/begin MEASUREMENT vTRQKT0 "RAM value vTRQKT0" SWORD COMP_0228 1 100 -3276.8 3276.7 ECU_ADDRESS 0xFFFF2E7A READ_WRITE /end MEASUREMENT
/begin MEASUREMENT vTRQKT1 "RAM value vTRQKT1" SWORD COMP_0228 1 100 -3276.8 3276.7 ECU_ADDRESS 0xFFFF2E7C READ_WRITE /end MEASUREMENT
/begin MEASUREMENT vTRQKT2 "RAM value vTRQKT2" SWORD COMP_0228 1 100 -3276.8 3276.7 ECU_ADDRESS 0xFFFF2E7E READ_WRITE /end MEASUREMENT
/begin MEASUREMENT vTRQKTD "RAM value vTRQKTD" SWORD COMP_0228 1 100 -3276.8 3276.7 ECU_ADDRESS 0xFFFF2E80 READ_WRITE /end MEASUREMENT
/begin MEASUREMENT vTRQLMOVB "RAM value vTRQLMOVB" SWORD COMP_0228 1 100 -3276.8 3276.7 ECU_ADDRESS 0xFFFF2E82 READ_WRITE /end MEASUREMENT
/begin MEASUREMENT vTRQLSD "RAM value vTRQLSD" SWORD COMP_0228 1 100 -3276.8 3276.7 ECU_ADDRESS 0xFFFF2E84 READ_WRITE /end MEASUREMENT
/begin MEASUREMENT vTRQMDLT "RAM value vTRQMDLT" SWORD COMP_0228 1 100 -3276.8 3276.7 ECU_ADDRESS 0xFFFF2E86 READ_WRITE /end MEASUREMENT
/begin MEASUREMENT vTRQMSR "RAM value vTRQMSR" SWORD COMP_0228 1 100 -3276.8 3276.7 ECU_ADDRESS 0xFFFF2E88 READ_WRITE /end MEASUREMENT
/begin MEASUREMENT vTRQND "RAM value vTRQND" SWORD COMP_0228 1 100 -3276.8 3276.7 ECU_ADDRESS 0xFFFF2E8A READ_WRITE /end MEASUREMENT
/begin MEASUREMENT vTRQNTU "RAM value vTRQNTU" SWORD COMP_0228 1 100 -3276.8 3276.7 ECU_ADDRESS 0xFFFF2E8C READ_WRITE /end MEASUREMENT
/begin MEASUREMENT vTRQPIG "RAM value vTRQPIG" SWORD COMP_0228 1 100 -3276.8 3276.7 ECU_ADDRESS 0xFFFF2E8E READ_WRITE /end MEASUREMENT
/begin MEASUREMENT vTRQREF "RAM value vTRQREF" SWORD COMP_0228 1 100 -3276.8 3276.7 ECU_ADDRESS 0xFFFF2E90 READ_WRITE /end MEASUREMENT
/begin MEASUREMENT vTRQREF0 "RAM value vTRQREF0" SWORD COMP_0228 1 100 -3276.8 3276.7 ECU_ADDRESS 0xFFFF1122 READ_WRITE /end MEASUREMENT
/begin MEASUREMENT vTRQREF1 "RAM value vTRQREF1" SWORD COMP_0228 1 100 -3276.8 3276.7 ECU_ADDRESS 0xFFFF1124 READ_WRITE /end MEASUREMENT
/begin MEASUREMENT vTRQRSD "RAM value vTRQRSD" SWORD COMP_0228 1 100 -3276.8 3276.7 ECU_ADDRESS 0xFFFF2E92 READ_WRITE /end MEASUREMENT
/begin MEASUREMENT vTRQRTO "RAM value vTRQRTO" UWORD COMP_0450 1 100 0 63.999056205 ECU_ADDRESS 0xFFFF1B68 READ_WRITE /end MEASUREMENT
/begin MEASUREMENT vTRQRTO_S "RAM value vTRQRTO_S" UWORD COMP_0450 1 100 0 63.999056205 ECU_ADDRESS 0xFFFF14F8 READ_WRITE /end MEASUREMENT
/begin MEASUREMENT vTRQSPDC0 "RAM value vTRQSPDC0" SWORD COMP_0228 1 100 -3276.8 3276.7 ECU_ADDRESS 0xFFFF2E94 READ_WRITE /end MEASUREMENT
/begin MEASUREMENT vTRQSPDCT "RAM value vTRQSPDCT" SWORD COMP_0228 1 100 -3276.8 3276.7 ECU_ADDRESS 0xFFFF3BB2 READ_WRITE /end MEASUREMENT
/begin MEASUREMENT vTRQUPGB0 "RAM value vTRQUPGB0" SWORD COMP_0228 1 100 -3276.8 3276.7 ECU_ADDRESS 0xFFFF2E96 READ_WRITE /end MEASUREMENT
/begin MEASUREMENT vTRQUPGB1 "RAM value vTRQUPGB1" SWORD COMP_0228 1 100 -3276.8 3276.7 ECU_ADDRESS 0xFFFF2E98 READ_WRITE /end MEASUREMENT
/begin MEASUREMENT vTRQUPGB2 "RAM value vTRQUPGB2" SWORD COMP_0228 1 100 -3276.8 3276.7 ECU_ADDRESS 0xFFFF2E9A READ_WRITE /end MEASUREMENT
/begin MEASUREMENT vTRSLP "RAM value vTRSLP" UWORD COMP_0051 1 100 0 65535 ECU_ADDRESS 0xFFFF1126 READ_WRITE /end MEASUREMENT
/begin MEASUREMENT vTRTPIf "RAM value vTRTPIf" UBYTE COMP_0004 1 100 0 255 ECU_ADDRESS 0xFFFF2E9C READ_WRITE /end MEASUREMENT
/begin MEASUREMENT vTSDIG "RAM value vTSDIG" SWORD COMP_0517 1 100 -52428.8 52427.2 ECU_ADDRESS 0xFFFF112A READ_WRITE /end MEASUREMENT
/begin MEASUREMENT vTSF "RAM value vTSF" UWORD COMP_0023 1 100 0 327675 ECU_ADDRESS 0xFFFF3918 READ_WRITE /end MEASUREMENT
/begin MEASUREMENT vTSFHR "RAM value vTSFHR" UWORD COMP_0023 1 100 0 327675 ECU_ADDRESS 0xFFFF391A READ_WRITE /end MEASUREMENT
/begin MEASUREMENT vTSQH0 "RAM value vTSQH0" UBYTE COMP_0045 1 100 0 1.9921875 ECU_ADDRESS 0xFFFF08FD READ_WRITE /end MEASUREMENT
/begin MEASUREMENT vTSTDVTC "RAM value vTSTDVTC" UBYTE COMP_0008 1 100 0 25500 ECU_ADDRESS 0xFFFF1132 READ_WRITE /end MEASUREMENT
/begin MEASUREMENT vTSTLMT "RAM value vTSTLMT" UBYTE COMP_0013 1 100 0 255 ECU_ADDRESS 0xFFFF16B5 READ_WRITE /end MEASUREMENT
/begin MEASUREMENT vTSVR "RAM value vTSVR" UBYTE COMP_0234 1 100 0 2550 ECU_ADDRESS 0xFFFF2E9D READ_WRITE /end MEASUREMENT
/begin MEASUREMENT vTSYSD1 "RAM value vTSYSD1" UBYTE COMP_0096 1 100 0 2550 ECU_ADDRESS 0xFFFF2E9E READ_WRITE /end MEASUREMENT
/begin MEASUREMENT vTSYSD1V "RAM value vTSYSD1V" UBYTE COMP_0096 1 100 0 2550 ECU_ADDRESS 0xFFFF2E9F READ_WRITE /end MEASUREMENT
/begin MEASUREMENT vTSYSD2 "RAM value vTSYSD2" UBYTE COMP_0096 1 100 0 2550 ECU_ADDRESS 0xFFFF2EA0 READ_WRITE /end MEASUREMENT
/begin MEASUREMENT vTSYSD2V "RAM value vTSYSD2V" UBYTE COMP_0096 1 100 0 2550 ECU_ADDRESS 0xFFFF2EA1 READ_WRITE /end MEASUREMENT
/begin MEASUREMENT vTSYSDL34 "RAM value vTSYSDL34" UBYTE COMP_0008 1 100 0 25500 ECU_ADDRESS 0xFFFF1133 READ_WRITE /end MEASUREMENT
/begin MEASUREMENT vTSYSDL4V "RAM value vTSYSDL4V" UWORD COMP_0008 1 100 0 6553500 ECU_ADDRESS 0xFFFF2EA2 READ_WRITE /end MEASUREMENT
/begin MEASUREMENT vTSd "RAM value vTSd" UWORD COMP_0325 1 100 -52428.8 52427.2 ECU_ADDRESS 0xFFFF1128 READ_WRITE /end MEASUREMENT
/begin MEASUREMENT vTTAAPO "RAM value vTTAAPO" UWORD COMP_0042 1 100 0 52.428 ECU_ADDRESS 0xFFFF1134 READ_WRITE /end MEASUREMENT
/begin MEASUREMENT vTTAAPO_S "RAM value vTTAAPO_S" UWORD COMP_0042 1 100 0 52.428 ECU_ADDRESS 0xFFFF14FA READ_WRITE /end MEASUREMENT
/begin MEASUREMENT vTTBP "RAM value vTTBP" UWORD COMP_0120_S 1 100 0 16383.75 ECU_ADDRESS 0xFFFF2EA4 READ_WRITE /end MEASUREMENT
/begin MEASUREMENT vTTBP0 "RAM value vTTBP0" UWORD COMP_0120_S 1 100 0 16383.75 ECU_ADDRESS 0xFFFF2EA6 READ_WRITE /end MEASUREMENT
/begin MEASUREMENT vTTBPATM "RAM value vTTBPATM" UWORD COMP_0120_S 1 100 0 16383.75 ECU_ADDRESS 0xFFFF2EA8 READ_WRITE /end MEASUREMENT
/begin MEASUREMENT vTTBPCLDA "RAM value vTTBPCLDA" UWORD COMP_0120_S 1 100 0 16383.75 ECU_ADDRESS 0xFFFF2EAA READ_WRITE /end MEASUREMENT
/begin MEASUREMENT vTTBPF "RAM value vTTBPF" UWORD COMP_0034_S 1 100 0 255.99609375 ECU_ADDRESS 0xFFFF2EAC READ_WRITE /end MEASUREMENT
/begin MEASUREMENT vTTBPHOS "RAM value vTTBPHOS" UWORD COMP_0446_S 1 100 -100 16283.75 ECU_ADDRESS 0xFFFF2EAE READ_WRITE /end MEASUREMENT
/begin MEASUREMENT vTTBPNK "RAM value vTTBPNK" UWORD COMP_0034_S 1 100 0 255.99609375 ECU_ADDRESS 0xFFFF2EB0 READ_WRITE /end MEASUREMENT
/begin MEASUREMENT vTTBPREG "RAM value vTTBPREG" UWORD COMP_0120_S 1 100 0 16383.75 ECU_ADDRESS 0xFFFF2EB2 READ_WRITE /end MEASUREMENT
/begin MEASUREMENT vTTBPTWNK "RAM value vTTBPTWNK" UWORD COMP_0120_S 1 100 0 16383.75 ECU_ADDRESS 0xFFFF2EB4 READ_WRITE /end MEASUREMENT
/begin MEASUREMENT vTTCAAPO "RAM value vTTCAAPO" UWORD COMP_0042 1 100 0 52.428 ECU_ADDRESS 0xFFFF1136 READ_WRITE /end MEASUREMENT
/begin MEASUREMENT vTTEACC "RAM value vTTEACC" SWORD COMP_0228 1 100 -3276.8 3276.7 ECU_ADDRESS 0xFFFF08FE READ_WRITE /end MEASUREMENT
/begin MEASUREMENT vTTEACC_S "RAM value vTTEACC_S" SWORD COMP_0228 1 100 -3276.8 3276.7 ECU_ADDRESS 0xFFFF0908 READ_WRITE /end MEASUREMENT
/begin MEASUREMENT vTTEAPO "RAM value vTTEAPO" SWORD COMP_0228 1 100 -3276.8 3276.7 ECU_ADDRESS 0xFFFF1138 READ_WRITE /end MEASUREMENT
/begin MEASUREMENT vTTEAPO_S "RAM value vTTEAPO_S" SWORD COMP_0228 1 100 -3276.8 3276.7 ECU_ADDRESS 0xFFFF14FC READ_WRITE /end MEASUREMENT
/begin MEASUREMENT vTTEDRVL1 "RAM value vTTEDRVL1" SWORD COMP_0228 1 100 -3276.8 3276.7 ECU_ADDRESS 0xFFFF2EB6 READ_WRITE /end MEASUREMENT
/begin MEASUREMENT vTTEDRVL2 "RAM value vTTEDRVL2" SWORD COMP_0228 1 100 -3276.8 3276.7 ECU_ADDRESS 0xFFFF2EB8 READ_WRITE /end MEASUREMENT
/begin MEASUREMENT vTTEHOS1 "RAM value vTTEHOS1" UWORD COMP_0271 1 100 0 199.99696053 ECU_ADDRESS 0xFFFF113A READ_WRITE /end MEASUREMENT
/begin MEASUREMENT vTTEIF "RAM value vTTEIF" SWORD COMP_0228 1 100 -3276.8 3276.7 ECU_ADDRESS 0xFFFF1B6A READ_WRITE /end MEASUREMENT
/begin MEASUREMENT vTTEIF0 "RAM value vTTEIF0" SWORD COMP_0228 1 100 -3276.8 3276.7 ECU_ADDRESS 0xFFFF113C READ_WRITE /end MEASUREMENT
/begin MEASUREMENT vTTEIFD "RAM value vTTEIFD" SWORD COMP_0228 1 100 -3276.8 3276.7 ECU_ADDRESS 0xFFFF113E READ_WRITE /end MEASUREMENT
/begin MEASUREMENT vTTEIF_S "RAM value vTTEIF_S" SWORD COMP_0228 1 100 -3276.8 3276.7 ECU_ADDRESS 0xFFFF14FE READ_WRITE /end MEASUREMENT
/begin MEASUREMENT vTTEMAX "RAM value vTTEMAX" UWORD COMP_0196 1 100 0 6553.5 ECU_ADDRESS 0xFFFF1140 READ_WRITE /end MEASUREMENT
/begin MEASUREMENT vTTEP "RAM value vTTEP" SWORD COMP_0228 1 100 -3276.8 3276.7 ECU_ADDRESS 0xFFFF1142 READ_WRITE /end MEASUREMENT
/begin MEASUREMENT vTTEPD0_S "RAM value vTTEPD0_S" SWORD COMP_0228 1 100 -3276.8 3276.7 ECU_ADDRESS 0xFFFF306A READ_WRITE /end MEASUREMENT
/begin MEASUREMENT vTTEPD1_S "RAM value vTTEPD1_S" SWORD COMP_0228 1 100 -3276.8 3276.7 ECU_ADDRESS 0xFFFF306C READ_WRITE /end MEASUREMENT
/begin MEASUREMENT vTTEPDIF "RAM value vTTEPDIF" SWORD COMP_0228 1 100 -3276.8 3276.7 ECU_ADDRESS 0xFFFF1144 READ_WRITE /end MEASUREMENT
/begin MEASUREMENT vTTEPDIFD "RAM value vTTEPDIFD" SWORD COMP_0228 1 100 -3276.8 3276.7 ECU_ADDRESS 0xFFFF1146 READ_WRITE /end MEASUREMENT
/begin MEASUREMENT vTTEPDI_S "RAM value vTTEPDI_S" SWORD COMP_0228 1 100 -3276.8 3276.7 ECU_ADDRESS 0xFFFF1502 READ_WRITE /end MEASUREMENT
/begin MEASUREMENT vTTEPFAST "RAM value vTTEPFAST" SWORD COMP_0228 1 100 -3276.8 3276.7 ECU_ADDRESS 0xFFFF1148 READ_WRITE /end MEASUREMENT
/begin MEASUREMENT vTTEPTD "RAM value vTTEPTD" SWORD COMP_0228 1 100 -3276.8 3276.7 ECU_ADDRESS 0xFFFF1B6C READ_WRITE /end MEASUREMENT
/begin MEASUREMENT vTTEPTD0 "RAM value vTTEPTD0" SWORD COMP_0228 1 100 -3276.8 3276.7 ECU_ADDRESS 0xFFFF114A READ_WRITE /end MEASUREMENT
/begin MEASUREMENT vTTEPTD1 "RAM value vTTEPTD1" SWORD COMP_0228 1 100 -3276.8 3276.7 ECU_ADDRESS 0xFFFF114C READ_WRITE /end MEASUREMENT
/begin MEASUREMENT vTTEPTD11 "RAM value vTTEPTD11" SWORD COMP_0228 1 100 -3276.8 3276.7 ECU_ADDRESS 0xFFFF2EBA READ_WRITE /end MEASUREMENT
/begin MEASUREMENT vTTEPTD12 "RAM value vTTEPTD12" SWORD COMP_0228 1 100 -3276.8 3276.7 ECU_ADDRESS 0xFFFF2EBC READ_WRITE /end MEASUREMENT
/begin MEASUREMENT vTTEPTD_S "RAM value vTTEPTD_S" SWORD COMP_0228 1 100 -3276.8 3276.7 ECU_ADDRESS 0xFFFF1504 READ_WRITE /end MEASUREMENT
/begin MEASUREMENT vTTEP_S "RAM value vTTEP_S" SWORD COMP_0228 1 100 -3276.8 3276.7 ECU_ADDRESS 0xFFFF1500 READ_WRITE /end MEASUREMENT
/begin MEASUREMENT vTTERG3 "RAM value vTTERG3" SWORD COMP_0228 1 100 -3276.8 3276.7 ECU_ADDRESS 0xFFFF1B6E READ_WRITE /end MEASUREMENT
/begin MEASUREMENT vTTERL "RAM value vTTERL" SWORD COMP_0228 1 100 -3276.8 3276.7 ECU_ADDRESS 0xFFFF114E READ_WRITE /end MEASUREMENT
/begin MEASUREMENT vTTERL0 "RAM value vTTERL0" SWORD COMP_0228 1 100 -3276.8 3276.7 ECU_ADDRESS 0xFFFF1150 READ_WRITE /end MEASUREMENT
/begin MEASUREMENT vTTERLUPS "RAM value vTTERLUPS" SWORD COMP_0228 1 100 -3276.8 3276.7 ECU_ADDRESS 0xFFFF1152 READ_WRITE /end MEASUREMENT
/begin MEASUREMENT vTTESL "RAM value vTTESL" SWORD COMP_0228 1 100 -3276.8 3276.7 ECU_ADDRESS 0xFFFF1B70 READ_WRITE /end MEASUREMENT
/begin MEASUREMENT vTTESL5TH "RAM value vTTESL5TH" SWORD COMP_0228 1 100 -3276.8 3276.7 ECU_ADDRESS 0xFFFF2EBE READ_WRITE /end MEASUREMENT
/begin MEASUREMENT vTTESLC "RAM value vTTESLC" SWORD COMP_0228 1 100 -3276.8 3276.7 ECU_ADDRESS 0xFFFF1154 READ_WRITE /end MEASUREMENT
/begin MEASUREMENT vTTESLPR "RAM value vTTESLPR" SWORD COMP_0228 1 100 -3276.8 3276.7 ECU_ADDRESS 0xFFFF1B72 READ_WRITE /end MEASUREMENT
/begin MEASUREMENT vTTESLRMP "RAM value vTTESLRMP" SWORD COMP_0228 1 100 -3276.8 3276.7 ECU_ADDRESS 0xFFFF1156 READ_WRITE /end MEASUREMENT
/begin MEASUREMENT vTTESLV0 "RAM value vTTESLV0" SWORD COMP_0240_S 1 100 -655.36 655.34 ECU_ADDRESS 0xFFFF1158 READ_WRITE /end MEASUREMENT
/begin MEASUREMENT vTTETBL2 "RAM value vTTETBL2" SWORD COMP_0228 1 100 -3276.8 3276.7 ECU_ADDRESS 0xFFFF115A READ_WRITE /end MEASUREMENT
/begin MEASUREMENT vTTEVCN1 "RAM value vTTEVCN1" UBYTE COMP_0008 1 100 0 25500 ECU_ADDRESS 0xFFFF2EC0 READ_WRITE /end MEASUREMENT
/begin MEASUREMENT vTTEVCN2 "RAM value vTTEVCN2" UBYTE COMP_0008 1 100 0 25500 ECU_ADDRESS 0xFFFF2EC1 READ_WRITE /end MEASUREMENT
/begin MEASUREMENT vTTEVPNG "RAM value vTTEVPNG" UBYTE COMP_0008 1 100 0 25500 ECU_ADDRESS 0xFFFF2EC2 READ_WRITE /end MEASUREMENT
/begin MEASUREMENT vTTMPST1 "RAM value vTTMPST1" UBYTE COMP_0008 1 100 0 25500 ECU_ADDRESS 0xFFFF2EC8 READ_WRITE /end MEASUREMENT
/begin MEASUREMENT vTTMTRP "RAM value vTTMTRP" UBYTE COMP_0234 1 100 0 2550 ECU_ADDRESS 0xFFFF391C READ_WRITE /end MEASUREMENT
/begin MEASUREMENT vTTP "RAM value vTTP" UWORD COMP_0052 1 100 0 31.99956087 ECU_ADDRESS 0xFFFF2ECA READ_WRITE /end MEASUREMENT
/begin MEASUREMENT vTTPE "RAM value vTTPE" UWORD COMP_0052 1 100 0 31.99956087 ECU_ADDRESS 0xFFFF2ECC READ_WRITE /end MEASUREMENT
/begin MEASUREMENT vTTPEGA "RAM value vTTPEGA" UWORD COMP_0144 1 100 0 31.999495335 ECU_ADDRESS 0xFFFF116E READ_WRITE /end MEASUREMENT
/begin MEASUREMENT vTTPEGA0 "RAM value vTTPEGA0" UWORD COMP_0144 1 100 0 31.999495335 ECU_ADDRESS 0xFFFF1170 READ_WRITE /end MEASUREMENT
/begin MEASUREMENT vTTPEGA_S "RAM value vTTPEGA_S" UWORD COMP_0144 1 100 0 31.999495335 ECU_ADDRESS 0xFFFF150A READ_WRITE /end MEASUREMENT
/begin MEASUREMENT vTTPEGR "RAM value vTTPEGR" UWORD COMP_0144 1 100 0 31.999495335 ECU_ADDRESS 0xFFFF1172 READ_WRITE /end MEASUREMENT
/begin MEASUREMENT vTTPE_S "RAM value vTTPE_S" UWORD COMP_0144 1 100 0 31.999495335 ECU_ADDRESS 0xFFFF1508 READ_WRITE /end MEASUREMENT
/begin MEASUREMENT vTTPGAS "RAM value vTTPGAS" UWORD COMP_0144 1 100 0 31.999495335 ECU_ADDRESS 0xFFFF1174 READ_WRITE /end MEASUREMENT
/begin MEASUREMENT vTTPGAS_S "RAM value vTTPGAS_S" UWORD COMP_0144 1 100 0 31.999495335 ECU_ADDRESS 0xFFFF150C READ_WRITE /end MEASUREMENT
/begin MEASUREMENT vTTPST "RAM value vTTPST" UWORD COMP_0052 1 100 0 31.99956087 ECU_ADDRESS 0xFFFF3BB4 READ_WRITE /end MEASUREMENT
/begin MEASUREMENT vTTPSTNG "RAM value vTTPSTNG" UWORD COMP_0144 1 100 0 31.999495335 ECU_ADDRESS 0xFFFF2ECE READ_WRITE /end MEASUREMENT
/begin MEASUREMENT vTTPST_S "RAM value vTTPST_S" UWORD COMP_0144 1 100 0 31.999495335 ECU_ADDRESS 0xFFFF306E READ_WRITE /end MEASUREMENT
/begin MEASUREMENT vTTP_S "RAM value vTTP_S" UWORD COMP_0144 1 100 0 31.999495335 ECU_ADDRESS 0xFFFF1506 READ_WRITE /end MEASUREMENT
/begin MEASUREMENT vTTQFR "RAM value vTTQFR" SWORD COMP_0228 1 100 -3276.8 3276.7 ECU_ADDRESS 0xFFFF3A4A READ_WRITE /end MEASUREMENT
/begin MEASUREMENT vTTVOMIN "RAM value vTTVOMIN" UBYTE COMP_0014 1 100 0 2550 ECU_ADDRESS 0xFFFF4DFC READ_WRITE /end MEASUREMENT
/begin MEASUREMENT vTUDGNJMX "RAM value vTUDGNJMX" UWORD COMP_0217 1 100 0 3.999941832 ECU_ADDRESS 0xFFFF4DFE READ_WRITE /end MEASUREMENT
/begin MEASUREMENT vTUDGNVJ "RAM value vTUDGNVJ" UWORD COMP_0217 1 100 0 3.999941832 ECU_ADDRESS 0xFFFF1176 READ_WRITE /end MEASUREMENT
/begin MEASUREMENT vTUECV "RAM value vTUECV" UBYTE COMP_0063 1 100 0 0.99609375 ECU_ADDRESS 0xFFFF1178 READ_WRITE /end MEASUREMENT
/begin MEASUREMENT vTVAD_S "RAM value vTVAD_S" SWORD COMP_0266_S 1 100 -26.2144 26.2136 ECU_ADDRESS 0xFFFF4E32 READ_WRITE /end MEASUREMENT
/begin MEASUREMENT vTVAPMIN "RAM value vTVAPMIN" UBYTE COMP_0014 1 100 0 2550 ECU_ADDRESS 0xFFFF4E00 READ_WRITE /end MEASUREMENT
/begin MEASUREMENT vTVIRCNT "RAM value vTVIRCNT" UBYTE COMP_0016 1 100 0 255 ECU_ADDRESS 0xFFFF19FC READ_WRITE /end MEASUREMENT
/begin MEASUREMENT vTVLRNA "RAM value vTVLRNA" SWORD COMP_0379 1 100 -26.2144 26.2136 ECU_ADDRESS 0xFFFF4E02 READ_WRITE /end MEASUREMENT
/begin MEASUREMENT vTVO "RAM value vTVO" UBYTE COMP_0002 1 100 0 89.25 ECU_ADDRESS 0xFFFF0859 READ_WRITE /end MEASUREMENT
/begin MEASUREMENT vTVO100 "RAM value vTVO100" UBYTE COMP_0002 1 100 0 89.25 ECU_ADDRESS 0xFFFF391D READ_WRITE /end MEASUREMENT
/begin MEASUREMENT vTVOAD1 "RAM value vTVOAD1" SWORD COMP_0379 1 100 -26.2144 26.2136 ECU_ADDRESS 0xFFFF117A READ_WRITE /end MEASUREMENT
/begin MEASUREMENT vTVOADJ "RAM value vTVOADJ" SWORD COMP_0379 1 100 -26.2144 26.2136 ECU_ADDRESS 0xFFFF525C READ_WRITE /end MEASUREMENT
/begin MEASUREMENT vTVOADJ_B "RAM value vTVOADJ_B" SWORD COMP_0379 1 100 -26.2144 26.2136 ECU_ADDRESS 0xFFFF525E READ_WRITE /end MEASUREMENT
/begin MEASUREMENT vTVOCMPS "RAM value vTVOCMPS" UBYTE COMP_0068 1 100 0 255 ECU_ADDRESS 0xFFFF32A4 READ_WRITE /end MEASUREMENT
/begin MEASUREMENT vTVOCMPS_1 "RAM value vTVOCMPS_1" UBYTE COMP_0004 1 100 0 255 ECU_ADDRESS 0xFFFF32A5 READ_WRITE /end MEASUREMENT
/begin MEASUREMENT vTVOCOM0 "RAM value vTVOCOM0" UWORD COMP_0625_S 1 100 -14.08205 98.55623125 ECU_ADDRESS 0xFFFF32A6 READ_WRITE /end MEASUREMENT
/begin MEASUREMENT vTVOCOM0H "RAM value vTVOCOM0H" UWORD COMP_0638_S 1 100 -14.08 7194.77 ECU_ADDRESS 0xFFFF32A8 READ_WRITE /end MEASUREMENT
/begin MEASUREMENT vTVOCOM0L "RAM value vTVOCOM0L" UWORD COMP_0639_S 1 100 -14.08 1788.1325 ECU_ADDRESS 0xFFFF32AA READ_WRITE /end MEASUREMENT
/begin MEASUREMENT vTVOCOM0S "RAM value vTVOCOM0S" UBYTE COMP_0068 1 100 0 255 ECU_ADDRESS 0xFFFF32AC READ_WRITE /end MEASUREMENT
/begin MEASUREMENT vTVOCOM1S "RAM value vTVOCOM1S" UBYTE COMP_0068 1 100 0 255 ECU_ADDRESS 0xFFFF32AD READ_WRITE /end MEASUREMENT
/begin MEASUREMENT vTVOCOMD "RAM value vTVOCOMD" SLONG COMP_0633_S 1 100 -2047.99932052275 2047.99931956908 ECU_ADDRESS 0xFFFF32B0 READ_WRITE /end MEASUREMENT
/begin MEASUREMENT vTVOCOMH "RAM value vTVOCOMH" SLONG COMP_0640_S 1 100 -3690987.52 3690987.51828125 ECU_ADDRESS 0xFFFF32B4 READ_WRITE /end MEASUREMENT
/begin MEASUREMENT vTVOCOMRS "RAM value vTVOCOMRS" UBYTE COMP_0068 1 100 0 255 ECU_ADDRESS 0xFFFF32B8 READ_WRITE /end MEASUREMENT
/begin MEASUREMENT vTVODSP "RAM value vTVODSP" UBYTE COMP_0021 1 100 0 99.609375 ECU_ADDRESS 0xFFFF117C READ_WRITE /end MEASUREMENT
/begin MEASUREMENT vTVOFBKS "RAM value vTVOFBKS" UBYTE COMP_0068 1 100 0 255 ECU_ADDRESS 0xFFFF32B9 READ_WRITE /end MEASUREMENT
/begin MEASUREMENT vTVOFBKS_1 "RAM value vTVOFBKS_1" UBYTE COMP_0004 1 100 0 255 ECU_ADDRESS 0xFFFF32BA READ_WRITE /end MEASUREMENT
/begin MEASUREMENT vTVOFBKS_2 "RAM value vTVOFBKS_2" UBYTE COMP_0004 1 100 0 255 ECU_ADDRESS 0xFFFF32BB READ_WRITE /end MEASUREMENT
/begin MEASUREMENT vTVOIMN "RAM value vTVOIMN" UWORD COMP_0023 1 100 0 327675 ECU_ADDRESS 0xFFFF2ED8 READ_WRITE /end MEASUREMENT
/begin MEASUREMENT vTVOINT "RAM value vTVOINT" UWORD COMP_0023 1 100 0 327675 ECU_ADDRESS 0xFFFF4F58 READ_WRITE /end MEASUREMENT
/begin MEASUREMENT vTVOINTO "RAM value vTVOINTO" UWORD COMP_0023 1 100 0 327675 ECU_ADDRESS 0xFFFF16B6 READ_WRITE /end MEASUREMENT
/begin MEASUREMENT vTVOLNS "RAM value vTVOLNS" SWORD COMP_0379 1 100 -26.2144 26.2136 ECU_ADDRESS 0xFFFF4E04 READ_WRITE /end MEASUREMENT
/begin MEASUREMENT vTVOLPFS "RAM value vTVOLPFS" UBYTE COMP_0068 1 100 0 255 ECU_ADDRESS 0xFFFF30E6 READ_WRITE /end MEASUREMENT
/begin MEASUREMENT vTVOLPFSz2 "RAM value vTVOLPFSz2" UBYTE COMP_0004 1 100 0 255 ECU_ADDRESS 0xFFFF32BC READ_WRITE /end MEASUREMENT
/begin MEASUREMENT vTVOLRN "RAM value vTVOLRN" SWORD COMP_0379 1 100 -26.2144 26.2136 ECU_ADDRESS 0xFFFF2EDA READ_WRITE /end MEASUREMENT
/begin MEASUREMENT vTVOLRN0 "RAM value vTVOLRN0" SWORD COMP_0641_S 1 100 -1.6384 1.63835 ECU_ADDRESS 0xFFFF2EDC READ_WRITE /end MEASUREMENT
/begin MEASUREMENT vTVOMIN "RAM value vTVOMIN" UWORD COMP_0061 1 100 0 327675 ECU_ADDRESS 0xFFFF16B8 READ_WRITE /end MEASUREMENT
/begin MEASUREMENT vTVOREFLM "RAM value vTVOREFLM" SLONG COMP_0642_S 1 100 -4096.0029360128 4096.00293410545 ECU_ADDRESS 0xFFFF32C0 READ_WRITE /end MEASUREMENT
/begin MEASUREMENT vTVOTQH0 "RAM value vTVOTQH0" UWORD COMP_0448 1 100 0 399.9941832 ECU_ADDRESS 0xFFFF117E READ_WRITE /end MEASUREMENT
/begin MEASUREMENT vTVOTQHMX "RAM value vTVOTQHMX" UWORD COMP_0448 1 100 0 399.9941832 ECU_ADDRESS 0xFFFF4E06 READ_WRITE /end MEASUREMENT
/begin MEASUREMENT vTVOUPLM "RAM value vTVOUPLM" UWORD COMP_0130 1 100 0 1802.2125 ECU_ADDRESS 0xFFFF3BB6 READ_WRITE /end MEASUREMENT
/begin MEASUREMENT vTVOUPLMS "RAM value vTVOUPLMS" UWORD COMP_0130 1 100 0 1802.2125 ECU_ADDRESS 0xFFFF2EDE READ_WRITE /end MEASUREMENT
/begin MEASUREMENT vTVOV "RAM value vTVOV" UWORD COMP_0061 1 100 0 327675 ECU_ADDRESS 0xFFFF0900 READ_WRITE /end MEASUREMENT
/begin MEASUREMENT vTVOV20M "RAM value vTVOV20M" UBYTE COMP_0054 1 100 0 5100 ECU_ADDRESS 0xFFFF16BA READ_WRITE /end MEASUREMENT
/begin MEASUREMENT vTVOz1 "RAM value vTVOz1" UBYTE COMP_0002 1 100 0 89.25 ECU_ADDRESS 0xFFFF16BB READ_WRITE /end MEASUREMENT
/begin MEASUREMENT vTVOz10 "RAM value vTVOz10" UBYTE COMP_0002 1 100 0 89.25 ECU_ADDRESS 0xFFFF084E READ_WRITE /end MEASUREMENT
/begin MEASUREMENT vTVOz15 "RAM value vTVOz15" UBYTE COMP_0002 1 100 0 89.25 ECU_ADDRESS 0xFFFF0902 READ_WRITE /end MEASUREMENT
/begin MEASUREMENT vTVOz2 "RAM value vTVOz2" UBYTE COMP_0002 1 100 0 89.25 ECU_ADDRESS 0xFFFF16BC READ_WRITE /end MEASUREMENT
/begin MEASUREMENT vTVOz3 "RAM value vTVOz3" UBYTE COMP_0002 1 100 0 89.25 ECU_ADDRESS 0xFFFF0903 READ_WRITE /end MEASUREMENT
/begin MEASUREMENT vTVOz4 "RAM value vTVOz4" UBYTE COMP_0002 1 100 0 89.25 ECU_ADDRESS 0xFFFF16BD READ_WRITE /end MEASUREMENT
/begin MEASUREMENT vTVOz5 "RAM value vTVOz5" UBYTE COMP_0002 1 100 0 89.25 ECU_ADDRESS 0xFFFF16BE READ_WRITE /end MEASUREMENT
/begin MEASUREMENT vTVOz6 "RAM value vTVOz6" UBYTE COMP_0002 1 100 0 89.25 ECU_ADDRESS 0xFFFF16BF READ_WRITE /end MEASUREMENT
/begin MEASUREMENT vTVOz7 "RAM value vTVOz7" UBYTE COMP_0002 1 100 0 89.25 ECU_ADDRESS 0xFFFF16C0 READ_WRITE /end MEASUREMENT
/begin MEASUREMENT vTVOz8 "RAM value vTVOz8" UBYTE COMP_0002 1 100 0 89.25 ECU_ADDRESS 0xFFFF16C1 READ_WRITE /end MEASUREMENT
/begin MEASUREMENT vTVOz9 "RAM value vTVOz9" UBYTE COMP_0002 1 100 0 89.25 ECU_ADDRESS 0xFFFF16C2 READ_WRITE /end MEASUREMENT
/begin MEASUREMENT vTVSPCNT2 "RAM value vTVSPCNT2" UBYTE COMP_0013 1 100 0 255 ECU_ADDRESS 0xFFFF2EE0 READ_WRITE /end MEASUREMENT
/begin MEASUREMENT vTVSPIR "RAM value vTVSPIR" ULONG COMP_0186_S 1 100 0 107374182.375 ECU_ADDRESS 0xFFFF1A00 READ_WRITE /end MEASUREMENT
/begin MEASUREMENT vTVSPNG2 "RAM value vTVSPNG2" UBYTE COMP_0013 1 100 0 255 ECU_ADDRESS 0xFFFF2EE1 READ_WRITE /end MEASUREMENT
/begin MEASUREMENT vTVTCDMP "RAM value vTVTCDMP" UBYTE COMP_0014 1 100 0 2550 ECU_ADDRESS 0xFFFF1180 READ_WRITE /end MEASUREMENT
/begin MEASUREMENT vTVTCDMPE "RAM value vTVTCDMPE" UBYTE COMP_0014 1 100 0 2550 ECU_ADDRESS 0xFFFF1181 READ_WRITE /end MEASUREMENT
/begin MEASUREMENT vTVTOIL "RAM value vTVTOIL" UBYTE COMP_0035 1 100 -50 205 ECU_ADDRESS 0xFFFF0904 READ_WRITE /end MEASUREMENT
/begin MEASUREMENT vTW "RAM value vTW" UBYTE COMP_0054 1 100 0 5100 ECU_ADDRESS 0xFFFF20CC READ_WRITE /end MEASUREMENT
/begin MEASUREMENT vTWCLCNT "RAM value vTWCLCNT" UWORD COMP_0016 1 100 0 65535 ECU_ADDRESS 0xFFFF4E08 READ_WRITE /end MEASUREMENT
/begin MEASUREMENT vTWDT "RAM value vTWDT" UBYTE COMP_0035 1 100 -50 205 ECU_ADDRESS 0xFFFF4E0A READ_WRITE /end MEASUREMENT
/begin MEASUREMENT vTWETTIME "RAM value vTWETTIME" UBYTE COMP_0049 1 100 0 255 ECU_ADDRESS 0xFFFF391E READ_WRITE /end MEASUREMENT
/begin MEASUREMENT vTWETTIMEf "RAM value vTWETTIMEf" UBYTE COMP_0004 1 100 0 255 ECU_ADDRESS 0xFFFF391F READ_WRITE /end MEASUREMENT
/begin MEASUREMENT vTWF "RAM value vTWF" UWORD COMP_0520 1 100 -200 119.995149955 ECU_ADDRESS 0xFFFF15A8 READ_WRITE /end MEASUREMENT
/begin MEASUREMENT vTWG "RAM value vTWG" UBYTE COMP_0428 1 100 -40 215 ECU_ADDRESS 0xFFFF3BB8 READ_WRITE /end MEASUREMENT
/begin MEASUREMENT vTWHOS "RAM value vTWHOS" UBYTE COMP_0009 1 100 0 199.21875 ECU_ADDRESS 0xFFFF1182 READ_WRITE /end MEASUREMENT
/begin MEASUREMENT vTWICTNG "RAM value vTWICTNG" UBYTE COMP_0035 1 100 -50 205 ECU_ADDRESS 0xFFFF4E0B READ_WRITE /end MEASUREMENT
/begin MEASUREMENT vTWICTNG2 "RAM value vTWICTNG2" UBYTE COMP_0035 1 100 -50 205 ECU_ADDRESS 0xFFFF4E0C READ_WRITE /end MEASUREMENT
/begin MEASUREMENT vTWINGSL "RAM value vTWINGSL" SWORD COMP_0002_S 1 100 -32768 32767 ECU_ADDRESS 0xFFFF3920 READ_WRITE /end MEASUREMENT
/begin MEASUREMENT vTWINT "RAM value vTWINT" UBYTE COMP_0035 1 100 -50 205 ECU_ADDRESS 0xFFFF1E68 READ_WRITE /end MEASUREMENT
/begin MEASUREMENT vTWINTEND "RAM value vTWINTEND" UBYTE COMP_0035 1 100 -50 205 ECU_ADDRESS 0xFFFF4E0D READ_WRITE /end MEASUREMENT
/begin MEASUREMENT vTWINTES "RAM value vTWINTES" UBYTE COMP_0035 1 100 -50 205 ECU_ADDRESS 0xFFFF20CD READ_WRITE /end MEASUREMENT
/begin MEASUREMENT vTWINTF "RAM value vTWINTF" UBYTE COMP_0035 1 100 -50 205 ECU_ADDRESS 0xFFFF2EE2 READ_WRITE /end MEASUREMENT
/begin MEASUREMENT vTWINTR "RAM value vTWINTR" UBYTE COMP_0035 1 100 -50 205 ECU_ADDRESS 0xFFFF1E69 READ_WRITE /end MEASUREMENT
/begin MEASUREMENT vTWISC0 "RAM value vTWISC0" UBYTE COMP_0009 1 100 0 199.21875 ECU_ADDRESS 0xFFFF1183 READ_WRITE /end MEASUREMENT
/begin MEASUREMENT vTWK "RAM value vTWK" UBYTE COMP_0356 1 100 -40 119.375 ECU_ADDRESS 0xFFFF20CE READ_WRITE /end MEASUREMENT
/begin MEASUREMENT vTWKINT "RAM value vTWKINT" UBYTE COMP_0356 1 100 -40 119.375 ECU_ADDRESS 0xFFFF1E6A READ_WRITE /end MEASUREMENT
/begin MEASUREMENT vTWKMIN "RAM value vTWKMIN" UBYTE COMP_0356 1 100 -40 119.375 ECU_ADDRESS 0xFFFF2EE3 READ_WRITE /end MEASUREMENT
/begin MEASUREMENT vTWKZ "RAM value vTWKZ" UBYTE COMP_0356 1 100 -40 119.375 ECU_ADDRESS 0xFFFF2EE4 READ_WRITE /end MEASUREMENT
/begin MEASUREMENT vTWN "RAM value vTWN" UBYTE COMP_0035 1 100 -50 205 ECU_ADDRESS 0xFFFF1E6B READ_WRITE /end MEASUREMENT
/begin MEASUREMENT vTWNEND "RAM value vTWNEND" UBYTE COMP_0035 1 100 -50 205 ECU_ADDRESS 0xFFFF4E0E READ_WRITE /end MEASUREMENT
/begin MEASUREMENT vTWNFAN "RAM value vTWNFAN" UBYTE COMP_0068 1 100 0 255 ECU_ADDRESS 0xFFFF2EE5 READ_WRITE /end MEASUREMENT
/begin MEASUREMENT vTWNHOS "RAM value vTWNHOS" UBYTE COMP_0124_S 1 100 -48 15.75 ECU_ADDRESS 0xFFFF1184 READ_WRITE /end MEASUREMENT
/begin MEASUREMENT vTWNKO "RAM value vTWNKO" UBYTE COMP_0035 1 100 -50 205 ECU_ADDRESS 0xFFFF4E0F READ_WRITE /end MEASUREMENT
/begin MEASUREMENT vTWNMAX "RAM value vTWNMAX" UBYTE COMP_0035 1 100 -50 205 ECU_ADDRESS 0xFFFF4E10 READ_WRITE /end MEASUREMENT
/begin MEASUREMENT vTWNMIN "RAM value vTWNMIN" UBYTE COMP_0035 1 100 -50 205 ECU_ADDRESS 0xFFFF4E11 READ_WRITE /end MEASUREMENT
/begin MEASUREMENT vTWNNEW "RAM value vTWNNEW" UBYTE COMP_0035 1 100 -50 205 ECU_ADDRESS 0xFFFF20CF READ_WRITE /end MEASUREMENT
/begin MEASUREMENT vTWNTMX "RAM value vTWNTMX" UBYTE COMP_0035 1 100 -50 205 ECU_ADDRESS 0xFFFF1185 READ_WRITE /end MEASUREMENT
/begin MEASUREMENT vTWNZBU "RAM value vTWNZBU" UBYTE COMP_0035 1 100 -50 205 ECU_ADDRESS 0xFFFF4F5A READ_WRITE /end MEASUREMENT
/begin MEASUREMENT vTWPGHOS "RAM value vTWPGHOS" UBYTE COMP_0019_S 1 100 0 1.000000095 ECU_ADDRESS 0xFFFF2EE6 READ_WRITE /end MEASUREMENT
/begin MEASUREMENT vTWSCV "RAM value vTWSCV" UBYTE COMP_0035 1 100 -50 205 ECU_ADDRESS 0xFFFF1186 READ_WRITE /end MEASUREMENT
/begin MEASUREMENT vTWSTCNT "RAM value vTWSTCNT" UWORD COMP_0016 1 100 0 65535 ECU_ADDRESS 0xFFFF4E12 READ_WRITE /end MEASUREMENT
/begin MEASUREMENT vTWSTCTR "RAM value vTWSTCTR" ULONG COMP_0355 1 100 0 16777215.9960938 ECU_ADDRESS 0xFFFF2EE8 READ_WRITE /end MEASUREMENT
/begin MEASUREMENT vTWSTMN "RAM value vTWSTMN" UBYTE COMP_0035 1 100 -50 205 ECU_ADDRESS 0xFFFF2EEC READ_WRITE /end MEASUREMENT
/begin MEASUREMENT vTWSTMX "RAM value vTWSTMX" UBYTE COMP_0035 1 100 -50 205 ECU_ADDRESS 0xFFFF2EED READ_WRITE /end MEASUREMENT
/begin MEASUREMENT vTWSTQZKI "RAM value vTWSTQZKI" UWORD COMP_0068 1 100 0 65535 ECU_ADDRESS 0xFFFF2EEE READ_WRITE /end MEASUREMENT
/begin MEASUREMENT vTWTMR "RAM value vTWTMR" UBYTE COMP_0096 1 100 0 2550 ECU_ADDRESS 0xFFFF2EF0 READ_WRITE /end MEASUREMENT
/begin MEASUREMENT vTXBYTGST "RAM value vTXBYTGST" UBYTE COMP_0016 1 100 0 255 ECU_ADDRESS 0xFFFF3922 READ_WRITE /end MEASUREMENT
/begin MEASUREMENT vTXFCAD "RAM value vTXFCAD" UWORD COMP_0081 1 100 0 255.99609375 ECU_ADDRESS 0xFFFF3BBA READ_WRITE /end MEASUREMENT
/begin MEASUREMENT vTXNEL3 "RAM value vTXNEL3" UBYTE COMP_0006 1 100 0 3187.5 ECU_ADDRESS 0xFFFF2EF1 READ_WRITE /end MEASUREMENT
/begin MEASUREMENT vTXRATE "RAM value vTXRATE" UBYTE COMP_0388 1 100 0 25.5 ECU_ADDRESS 0xFFFF2EF2 READ_WRITE /end MEASUREMENT
/begin MEASUREMENT vTXREQL "RAM value vTXREQL" ULONG COMP_0092 1 100 0 4294967295 ECU_ADDRESS 0xFFFF3924 READ_WRITE /end MEASUREMENT
/begin MEASUREMENT vUAT "RAM value vUAT" SWORD COMP_0255_S 1 100 -3276.8 3276.7 ECU_ADDRESS 0xFFFF2EF4 READ_WRITE /end MEASUREMENT
/begin MEASUREMENT vUBNCNT1 "RAM value vUBNCNT1" UWORD COMP_0016 1 100 0 65535 ECU_ADDRESS 0xFFFF5262 READ_WRITE /end MEASUREMENT
/begin MEASUREMENT vUBNCNT2 "RAM value vUBNCNT2" UWORD COMP_0016 1 100 0 65535 ECU_ADDRESS 0xFFFF5264 READ_WRITE /end MEASUREMENT
/begin MEASUREMENT vUBNCNTEND "RAM value vUBNCNTEND" UBYTE COMP_0004 1 100 0 255 ECU_ADDRESS 0xFFFF2EF6 READ_WRITE /end MEASUREMENT
/begin MEASUREMENT vUBNCNTOKf "RAM value vUBNCNTOKf" UBYTE COMP_0004 1 100 0 255 ECU_ADDRESS 0xFFFF2EF7 READ_WRITE /end MEASUREMENT
/begin MEASUREMENT vUBNTRP "RAM value vUBNTRP" UWORD COMP_0016 1 100 0 65535 ECU_ADDRESS 0xFFFF5266 READ_WRITE /end MEASUREMENT
/begin MEASUREMENT vUDRESET1f "RAM value vUDRESET1f" UBYTE COMP_0004 1 100 0 255 ECU_ADDRESS 0xFFFF2EF8 READ_WRITE /end MEASUREMENT
/begin MEASUREMENT vUDRESET2f "RAM value vUDRESET2f" UBYTE COMP_0004 1 100 0 255 ECU_ADDRESS 0xFFFF2EF9 READ_WRITE /end MEASUREMENT
/begin MEASUREMENT vUEQ "RAM value vUEQ" SWORD COMP_0643_S 1 100 -26.2144 26.2136 ECU_ADDRESS 0xFFFF1188 READ_WRITE /end MEASUREMENT
/begin MEASUREMENT vUH28REG1 "RAM value vUH28REG1" UWORD COMP_0068 1 100 0 65535 ECU_ADDRESS 0xFFFF3928 READ_WRITE /end MEASUREMENT
/begin MEASUREMENT vUH39DGN1 "RAM value vUH39DGN1" UWORD COMP_0068 1 100 0 65535 ECU_ADDRESS 0xFFFF392A READ_WRITE /end MEASUREMENT
/begin MEASUREMENT vUH39DGN2 "RAM value vUH39DGN2" UWORD COMP_0068 1 100 0 65535 ECU_ADDRESS 0xFFFF392C READ_WRITE /end MEASUREMENT
/begin MEASUREMENT vUH39DGN3 "RAM value vUH39DGN3" UWORD COMP_0068 1 100 0 65535 ECU_ADDRESS 0xFFFF392E READ_WRITE /end MEASUREMENT
/begin MEASUREMENT vUH39REG1 "RAM value vUH39REG1" UWORD COMP_0068 1 100 0 65535 ECU_ADDRESS 0xFFFF3930 READ_WRITE /end MEASUREMENT
/begin MEASUREMENT vUH39REG2 "RAM value vUH39REG2" UWORD COMP_0068 1 100 0 65535 ECU_ADDRESS 0xFFFF3932 READ_WRITE /end MEASUREMENT
/begin MEASUREMENT vUH39REG3 "RAM value vUH39REG3" UWORD COMP_0068 1 100 0 65535 ECU_ADDRESS 0xFFFF3934 READ_WRITE /end MEASUREMENT
/begin MEASUREMENT vUH39REG4 "RAM value vUH39REG4" UWORD COMP_0068 1 100 0 65535 ECU_ADDRESS 0xFFFF3936 READ_WRITE /end MEASUREMENT
/begin MEASUREMENT vUH39REG5 "RAM value vUH39REG5" UWORD COMP_0068 1 100 0 65535 ECU_ADDRESS 0xFFFF3938 READ_WRITE /end MEASUREMENT
/begin MEASUREMENT vUH39REG6 "RAM value vUH39REG6" UWORD COMP_0068 1 100 0 65535 ECU_ADDRESS 0xFFFF393A READ_WRITE /end MEASUREMENT
/begin MEASUREMENT vUHREGNG "RAM value vUHREGNG" UBYTE COMP_0068 1 100 0 255 ECU_ADDRESS 0xFFFF4F5B READ_WRITE /end MEASUREMENT
/begin MEASUREMENT vUHRXCT "RAM value vUHRXCT" UBYTE COMP_0068 1 100 0 255 ECU_ADDRESS 0xFFFF16C3 READ_WRITE /end MEASUREMENT
/begin MEASUREMENT vUHRXWK "RAM value vUHRXWK" UWORD COMP_0068 1 100 0 65535 ECU_ADDRESS 0xFFFF16C4 READ_WRITE /end MEASUREMENT
/begin MEASUREMENT vUID "RAM value vUID" UWORD COMP_0068 1 100 0 65535 ECU_ADDRESS 0xFFFF393C READ_WRITE /end MEASUREMENT
/begin MEASUREMENT vULINEAR "RAM value vULINEAR" SLONG COMP_0644_S 1 100 -21474.83648 21474.83647 ECU_ADDRESS 0xFFFF118C READ_WRITE /end MEASUREMENT
/begin MEASUREMENT vUNLOCKT "RAM value vUNLOCKT" UBYTE COMP_0014 1 100 0 2550 ECU_ADDRESS 0xFFFF1194 READ_WRITE /end MEASUREMENT
/begin MEASUREMENT vUNONLIN "RAM value vUNONLIN" SWORD COMP_0020_S 1 100 -65.536 65.534 ECU_ADDRESS 0xFFFF1196 READ_WRITE /end MEASUREMENT
/begin MEASUREMENT vUS "RAM value vUS" UWORD COMP_0023 1 100 0 327675 ECU_ADDRESS 0xFFFF1E24 READ_WRITE /end MEASUREMENT
/begin MEASUREMENT vUSB "RAM value vUSB" UWORD COMP_0023 1 100 0 327675 ECU_ADDRESS 0xFFFF333E READ_WRITE /end MEASUREMENT
/begin MEASUREMENT vUSB_2 "RAM value vUSB_2" UWORD COMP_0023 1 100 0 327675 ECU_ADDRESS 0xFFFF32C4 READ_WRITE /end MEASUREMENT
/begin MEASUREMENT vUSL "RAM value vUSL" SWORD COMP_0020_S 1 100 -65.536 65.534 ECU_ADDRESS 0xFFFF119A READ_WRITE /end MEASUREMENT
/begin MEASUREMENT vUSMAX "RAM value vUSMAX" UWORD COMP_0023 1 100 0 327675 ECU_ADDRESS 0xFFFF4E14 READ_WRITE /end MEASUREMENT
/begin MEASUREMENT vUSMFTFMT "RAM value vUSMFTFMT" UBYTE COMP_0014 1 100 0 2550 ECU_ADDRESS 0xFFFF393E READ_WRITE /end MEASUREMENT
/begin MEASUREMENT vUSMGST "RAM value vUSMGST" UBYTE COMP_0014 1 100 0 2550 ECU_ADDRESS 0xFFFF393F READ_WRITE /end MEASUREMENT
/begin MEASUREMENT vUSMIN "RAM value vUSMIN" UWORD COMP_0023 1 100 0 327675 ECU_ADDRESS 0xFFFF4E16 READ_WRITE /end MEASUREMENT
/begin MEASUREMENT vUSR "RAM value vUSR" UWORD COMP_0023 1 100 0 327675 ECU_ADDRESS 0xFFFF119E READ_WRITE /end MEASUREMENT
/begin MEASUREMENT vUSSM "RAM value vUSSM" UWORD COMP_0023 1 100 0 327675 ECU_ADDRESS 0xFFFF2EFA READ_WRITE /end MEASUREMENT
/begin MEASUREMENT vVAERREf "RAM value vVAERREf" UBYTE COMP_0004 1 100 0 255 ECU_ADDRESS 0xFFFF2EFC READ_WRITE /end MEASUREMENT
/begin MEASUREMENT vVAERRIf "RAM value vVAERRIf" UBYTE COMP_0004 1 100 0 255 ECU_ADDRESS 0xFFFF2EFD READ_WRITE /end MEASUREMENT
/begin MEASUREMENT vVAFSCNT "RAM value vVAFSCNT" UBYTE COMP_0030 1 100 0 255 ECU_ADDRESS 0xFFFF3941 READ_WRITE /end MEASUREMENT
/begin MEASUREMENT vVAFSSUM "RAM value vVAFSSUM" UWORD COMP_0023 1 100 0 327675 ECU_ADDRESS 0xFFFF3942 READ_WRITE /end MEASUREMENT
/begin MEASUREMENT vVAFSTIK "RAM value vVAFSTIK" UWORD COMP_0023 1 100 0 327675 ECU_ADDRESS 0xFFFF3944 READ_WRITE /end MEASUREMENT
/begin MEASUREMENT vVAPMAX "RAM value vVAPMAX" UWORD COMP_0005 1 100 0 7208.85 ECU_ADDRESS 0xFFFF4E18 READ_WRITE /end MEASUREMENT
/begin MEASUREMENT vVAPO "RAM value vVAPO" UWORD COMP_0005 1 100 0 7208.85 ECU_ADDRESS 0xFFFF3A86 READ_WRITE /end MEASUREMENT
/begin MEASUREMENT vVAPO35 "RAM value vVAPO35" UBYTE COMP_0002 1 100 0 89.25 ECU_ADDRESS 0xFFFF2EFE READ_WRITE /end MEASUREMENT
/begin MEASUREMENT vVAPOAC "RAM value vVAPOAC" UWORD COMP_0005 1 100 0 7208.85 ECU_ADDRESS 0xFFFF11A0 READ_WRITE /end MEASUREMENT
/begin MEASUREMENT vVAPOSL "RAM value vVAPOSL" UWORD COMP_0032_S 1 100 0 8191.875 ECU_ADDRESS 0xFFFF2F00 READ_WRITE /end MEASUREMENT
/begin MEASUREMENT vVAPOSL0 "RAM value vVAPOSL0" UWORD COMP_0032_S 1 100 0 8191.875 ECU_ADDRESS 0xFFFF2F02 READ_WRITE /end MEASUREMENT
/begin MEASUREMENT vVAPOSL00 "RAM value vVAPOSL00" UWORD COMP_0032_S 1 100 0 8191.875 ECU_ADDRESS 0xFFFF2F04 READ_WRITE /end MEASUREMENT
/begin MEASUREMENT vVAPOz1 "RAM value vVAPOz1" UWORD COMP_0005 1 100 0 7208.85 ECU_ADDRESS 0xFFFF11A2 READ_WRITE /end MEASUREMENT
/begin MEASUREMENT vVAPOz10 "RAM value vVAPOz10" UWORD COMP_0005 1 100 0 7208.85 ECU_ADDRESS 0xFFFF11A4 READ_WRITE /end MEASUREMENT
/begin MEASUREMENT vVAPOz2 "RAM value vVAPOz2" UWORD COMP_0005 1 100 0 7208.85 ECU_ADDRESS 0xFFFF11A6 READ_WRITE /end MEASUREMENT
/begin MEASUREMENT vVAPOz3 "RAM value vVAPOz3" UWORD COMP_0005 1 100 0 7208.85 ECU_ADDRESS 0xFFFF11A8 READ_WRITE /end MEASUREMENT
/begin MEASUREMENT vVAPOz4 "RAM value vVAPOz4" UWORD COMP_0005 1 100 0 7208.85 ECU_ADDRESS 0xFFFF11AA READ_WRITE /end MEASUREMENT
/begin MEASUREMENT vVAPOz5 "RAM value vVAPOz5" UWORD COMP_0005 1 100 0 7208.85 ECU_ADDRESS 0xFFFF11AC READ_WRITE /end MEASUREMENT
/begin MEASUREMENT vVAPOz6 "RAM value vVAPOz6" UWORD COMP_0005 1 100 0 7208.85 ECU_ADDRESS 0xFFFF11AE READ_WRITE /end MEASUREMENT
/begin MEASUREMENT vVAPOz7 "RAM value vVAPOz7" UWORD COMP_0005 1 100 0 7208.85 ECU_ADDRESS 0xFFFF11B0 READ_WRITE /end MEASUREMENT
/begin MEASUREMENT vVAPOz8 "RAM value vVAPOz8" UWORD COMP_0005 1 100 0 7208.85 ECU_ADDRESS 0xFFFF11B2 READ_WRITE /end MEASUREMENT
/begin MEASUREMENT vVAPOz9 "RAM value vVAPOz9" UWORD COMP_0005 1 100 0 7208.85 ECU_ADDRESS 0xFFFF11B4 READ_WRITE /end MEASUREMENT
/begin MEASUREMENT vVASCDDIF "RAM value vVASCDDIF" UWORD COMP_0436 1 100 0 6553.5 ECU_ADDRESS 0xFFFF3946 READ_WRITE /end MEASUREMENT
/begin MEASUREMENT vVASCDDTM "RAM value vVASCDDTM" UBYTE COMP_0024 1 100 0 12750 ECU_ADDRESS 0xFFFF20D0 READ_WRITE /end MEASUREMENT
/begin MEASUREMENT vVASNGMON "RAM value vVASNGMON" UWORD COMP_0645_S 1 100 0 3686.34375 ECU_ADDRESS 0xFFFF4F5C READ_WRITE /end MEASUREMENT
/begin MEASUREMENT vVATM "RAM value vVATM" UBYTE COMP_0022 1 100 0 5100 ECU_ADDRESS 0xFFFF2F06 READ_WRITE /end MEASUREMENT
/begin MEASUREMENT vVATT "RAM value vVATT" UWORD COMP_0054 1 100 0 1310700 ECU_ADDRESS 0xFFFF3948 READ_WRITE /end MEASUREMENT
/begin MEASUREMENT vVB "RAM value vVB" UBYTE COMP_0033 1 100 0 20400 ECU_ADDRESS 0xFFFF20D1 READ_WRITE /end MEASUREMENT
/begin MEASUREMENT vVBALTC "RAM value vVBALTC" UBYTE COMP_0033 1 100 0 20400 ECU_ADDRESS 0xFFFF2F07 READ_WRITE /end MEASUREMENT
/begin MEASUREMENT vVBALTCK "RAM value vVBALTCK" UBYTE COMP_0033 1 100 0 20400 ECU_ADDRESS 0xFFFF2F08 READ_WRITE /end MEASUREMENT
/begin MEASUREMENT vVBALTCK4 "RAM value vVBALTCK4" ULONG COMP_0646_S 1 100 0 5242879.46190839 ECU_ADDRESS 0xFFFF11B8 READ_WRITE /end MEASUREMENT
/begin MEASUREMENT vVBAVE "RAM value vVBAVE" UWORD COMP_0054 1 100 0 1310700 ECU_ADDRESS 0xFFFF335A READ_WRITE /end MEASUREMENT
/begin MEASUREMENT vVBAVE2 "RAM value vVBAVE2" UBYTE COMP_0033 1 100 0 20400 ECU_ADDRESS 0xFFFF1E6C READ_WRITE /end MEASUREMENT
/begin MEASUREMENT vVBEO "RAM value vVBEO" UBYTE COMP_0033 1 100 0 20400 ECU_ADDRESS 0xFFFF394A READ_WRITE /end MEASUREMENT
/begin MEASUREMENT vVBF "RAM value vVBF" UBYTE COMP_0033 1 100 0 20400 ECU_ADDRESS 0xFFFF32C6 READ_WRITE /end MEASUREMENT
/begin MEASUREMENT vVBHOS "RAM value vVBHOS" UBYTE COMP_0021 1 100 0 99.609375 ECU_ADDRESS 0xFFFF3340 READ_WRITE /end MEASUREMENT
/begin MEASUREMENT vVBICTNG "RAM value vVBICTNG" UBYTE COMP_0033 1 100 0 20400 ECU_ADDRESS 0xFFFF4E1A READ_WRITE /end MEASUREMENT
/begin MEASUREMENT vVBICTNG2 "RAM value vVBICTNG2" UBYTE COMP_0033 1 100 0 20400 ECU_ADDRESS 0xFFFF4E1B READ_WRITE /end MEASUREMENT
/begin MEASUREMENT vVBINT "RAM value vVBINT" UBYTE COMP_0033 1 100 0 20400 ECU_ADDRESS 0xFFFF335C READ_WRITE /end MEASUREMENT
/begin MEASUREMENT vVBKC "RAM value vVBKC" UBYTE COMP_0033 1 100 0 20400 ECU_ADDRESS 0xFFFF394B READ_WRITE /end MEASUREMENT
/begin MEASUREMENT vVBNIGN "RAM value vVBNIGN" UBYTE COMP_0033 1 100 0 20400 ECU_ADDRESS 0xFFFF2F09 READ_WRITE /end MEASUREMENT
/begin MEASUREMENT vVBR "RAM value vVBR" UBYTE COMP_0033 1 100 0 20400 ECU_ADDRESS 0xFFFF394C READ_WRITE /end MEASUREMENT
/begin MEASUREMENT vVBRCHK "RAM value vVBRCHK" UBYTE COMP_0033 1 100 0 20400 ECU_ADDRESS 0xFFFF394D READ_WRITE /end MEASUREMENT
/begin MEASUREMENT vVBREO "RAM value vVBREO" UBYTE COMP_0033 1 100 0 20400 ECU_ADDRESS 0xFFFF394E READ_WRITE /end MEASUREMENT
/begin MEASUREMENT vVC "RAM value vVC" UWORD COMP_0270_S 1 100 0 0.065535 ECU_ADDRESS 0xFFFF2F0A READ_WRITE /end MEASUREMENT
/begin MEASUREMENT vVCDTMDEK "RAM value vVCDTMDEK" UWORD COMP_0017_S 1 100 0 655.35 ECU_ADDRESS 0xFFFF2F0C READ_WRITE /end MEASUREMENT
/begin MEASUREMENT vVCDTMDIK "RAM value vVCDTMDIK" UWORD COMP_0017_S 1 100 0 655.35 ECU_ADDRESS 0xFFFF2F0E READ_WRITE /end MEASUREMENT
/begin MEASUREMENT vVCDTMDYE "RAM value vVCDTMDYE" UWORD COMP_0017_S 1 100 0 655.35 ECU_ADDRESS 0xFFFF2F10 READ_WRITE /end MEASUREMENT
/begin MEASUREMENT vVCDTMDYI "RAM value vVCDTMDYI" UWORD COMP_0017_S 1 100 0 655.35 ECU_ADDRESS 0xFFFF2F12 READ_WRITE /end MEASUREMENT
/begin MEASUREMENT vVCFBIFRZf "RAM value vVCFBIFRZf" UBYTE COMP_0004 1 100 0 255 ECU_ADDRESS 0xFFFF2F14 READ_WRITE /end MEASUREMENT
/begin MEASUREMENT vVCFBIFZEf "RAM value vVCFBIFZEf" UBYTE COMP_0004 1 100 0 255 ECU_ADDRESS 0xFFFF2F15 READ_WRITE /end MEASUREMENT
/begin MEASUREMENT vVCFBIHDEf "RAM value vVCFBIHDEf" UBYTE COMP_0004 1 100 0 255 ECU_ADDRESS 0xFFFF2F16 READ_WRITE /end MEASUREMENT
/begin MEASUREMENT vVCFBIHDIf "RAM value vVCFBIHDIf" UBYTE COMP_0004 1 100 0 255 ECU_ADDRESS 0xFFFF2F17 READ_WRITE /end MEASUREMENT
/begin MEASUREMENT vVCTRGE "RAM value vVCTRGE" UWORD COMP_0293_S 1 100 0 0.999985458 ECU_ADDRESS 0xFFFF3BBC READ_WRITE /end MEASUREMENT
/begin MEASUREMENT vVCTRGI "RAM value vVCTRGI" UWORD COMP_0293_S 1 100 0 0.999985458 ECU_ADDRESS 0xFFFF3BC0 READ_WRITE /end MEASUREMENT
/begin MEASUREMENT vVCYL "RAM value vVCYL" UWORD COMP_0270_S 1 100 0 0.065535 ECU_ADDRESS 0xFFFF3BC4 READ_WRITE /end MEASUREMENT
/begin MEASUREMENT vVEGR "RAM value vVEGR" UBYTE COMP_0054 1 100 0 5100 ECU_ADDRESS 0xFFFF394F READ_WRITE /end MEASUREMENT
/begin MEASUREMENT vVEGTS1 "RAM value vVEGTS1" UWORD COMP_0023 1 100 0 327675 ECU_ADDRESS 0xFFFF3950 READ_WRITE /end MEASUREMENT
/begin MEASUREMENT vVELHOS "RAM value vVELHOS" UBYTE COMP_0250_S 1 100 -128 127 ECU_ADDRESS 0xFFFF11BC READ_WRITE /end MEASUREMENT
/begin MEASUREMENT vVERR "RAM value vVERR" ULONG COMP_0647_S 1 100 0 327679.805308001 ECU_ADDRESS 0xFFFF3344 READ_WRITE /end MEASUREMENT
/begin MEASUREMENT vVEVP "RAM value vVEVP" UWORD COMP_0023 1 100 0 327675 ECU_ADDRESS 0xFFFF3A4C READ_WRITE /end MEASUREMENT
/begin MEASUREMENT vVEVPR "RAM value vVEVPR" UWORD COMP_0023 1 100 0 327675 ECU_ADDRESS 0xFFFF3A4E READ_WRITE /end MEASUREMENT
/begin MEASUREMENT vVFPCM "RAM value vVFPCM" UBYTE COMP_0118 1 100 0 10200 ECU_ADDRESS 0xFFFF3952 READ_WRITE /end MEASUREMENT
/begin MEASUREMENT vVFPCMCV "RAM value vVFPCMCV" UBYTE COMP_0033 1 100 0 20400 ECU_ADDRESS 0xFFFF3953 READ_WRITE /end MEASUREMENT
/begin MEASUREMENT vVFPCMCVR "RAM value vVFPCMCVR" UBYTE COMP_0033 1 100 0 20400 ECU_ADDRESS 0xFFFF3954 READ_WRITE /end MEASUREMENT
/begin MEASUREMENT vVFPCMR "RAM value vVFPCMR" UBYTE COMP_0118 1 100 0 10200 ECU_ADDRESS 0xFFFF3955 READ_WRITE /end MEASUREMENT
/begin MEASUREMENT vVFPCMSD "RAM value vVFPCMSD" UBYTE COMP_0033 1 100 0 20400 ECU_ADDRESS 0xFFFF20D2 READ_WRITE /end MEASUREMENT
/begin MEASUREMENT vVFPCVZ1 "RAM value vVFPCVZ1" UBYTE COMP_0033 1 100 0 20400 ECU_ADDRESS 0xFFFF3956 READ_WRITE /end MEASUREMENT
/begin MEASUREMENT vVFPCVZ2 "RAM value vVFPCVZ2" UBYTE COMP_0033 1 100 0 20400 ECU_ADDRESS 0xFFFF3957 READ_WRITE /end MEASUREMENT
/begin MEASUREMENT vVFPCVZ3 "RAM value vVFPCVZ3" UBYTE COMP_0033 1 100 0 20400 ECU_ADDRESS 0xFFFF3958 READ_WRITE /end MEASUREMENT
/begin MEASUREMENT vVFPCVZ4 "RAM value vVFPCVZ4" UBYTE COMP_0033 1 100 0 20400 ECU_ADDRESS 0xFFFF3959 READ_WRITE /end MEASUREMENT
/begin MEASUREMENT vVFPCVZ5 "RAM value vVFPCVZ5" UBYTE COMP_0033 1 100 0 20400 ECU_ADDRESS 0xFFFF395A READ_WRITE /end MEASUREMENT
/begin MEASUREMENT vVFPCVZ6 "RAM value vVFPCVZ6" UBYTE COMP_0033 1 100 0 20400 ECU_ADDRESS 0xFFFF395B READ_WRITE /end MEASUREMENT
/begin MEASUREMENT vVFPCVZ7 "RAM value vVFPCVZ7" UBYTE COMP_0033 1 100 0 20400 ECU_ADDRESS 0xFFFF395C READ_WRITE /end MEASUREMENT
/begin MEASUREMENT vVFTM "RAM value vVFTM" UWORD COMP_0049 1 100 0 65535 ECU_ADDRESS 0xFFFF395E READ_WRITE /end MEASUREMENT
/begin MEASUREMENT vVFUEL "RAM value vVFUEL" UWORD COMP_0023 1 100 0 327675 ECU_ADDRESS 0xFFFF1DC2 READ_WRITE /end MEASUREMENT
/begin MEASUREMENT vVFUELPS1 "RAM value vVFUELPS1" UWORD COMP_0023 1 100 0 327675 ECU_ADDRESS 0xFFFF2F18 READ_WRITE /end MEASUREMENT
/begin MEASUREMENT vVFUELPS2 "RAM value vVFUELPS2" UWORD COMP_0023 1 100 0 327675 ECU_ADDRESS 0xFFFF2F1A READ_WRITE /end MEASUREMENT
/begin MEASUREMENT vVFUELPS3 "RAM value vVFUELPS3" UWORD COMP_0023 1 100 0 327675 ECU_ADDRESS 0xFFFF2F1C READ_WRITE /end MEASUREMENT
/begin MEASUREMENT vVFUELPS4 "RAM value vVFUELPS4" UWORD COMP_0023 1 100 0 327675 ECU_ADDRESS 0xFFFF2F1E READ_WRITE /end MEASUREMENT
/begin MEASUREMENT vVFUELPS5 "RAM value vVFUELPS5" UWORD COMP_0023 1 100 0 327675 ECU_ADDRESS 0xFFFF2F20 READ_WRITE /end MEASUREMENT
/begin MEASUREMENT vVGEAR "RAM value vVGEAR" UWORD COMP_0063 1 100 0 255.99609375 ECU_ADDRESS 0xFFFF11BE READ_WRITE /end MEASUREMENT
/begin MEASUREMENT vVICTNG "RAM value vVICTNG" UBYTE COMP_0007 1 100 0 510 ECU_ADDRESS 0xFFFF4E1C READ_WRITE /end MEASUREMENT
/begin MEASUREMENT vVICTNG2 "RAM value vVICTNG2" UBYTE COMP_0007 1 100 0 510 ECU_ADDRESS 0xFFFF4E1D READ_WRITE /end MEASUREMENT
/begin MEASUREMENT vVINDDL "RAM value vVINDDL" UBYTE COMP_0004 1 100 0 255 ECU_ADDRESS 0xFFFF3BC6 READ_WRITE /end MEASUREMENT
/begin MEASUREMENT vVINDIAG "RAM value vVINDIAG" UBYTE COMP_0004 1 100 0 255 ECU_ADDRESS 0xFFFF3BC7 READ_WRITE /end MEASUREMENT
/begin MEASUREMENT vVINNUM "RAM value vVINNUM" UBYTE COMP_0068 1 100 0 255 ECU_ADDRESS 0xFFFF5268 READ_WRITE /end MEASUREMENT
/begin MEASUREMENT vVINRX "RAM value vVINRX" UBYTE COMP_0068 1 100 0 255 ECU_ADDRESS 0xFFFF3960 READ_WRITE /end MEASUREMENT
/begin MEASUREMENT vVIP "RAM value vVIP" UWORD COMP_0370 1 100 0 163837.5 ECU_ADDRESS 0xFFFF3A64 READ_WRITE /end MEASUREMENT
/begin MEASUREMENT vVIP0 "RAM value vVIP0" SWORD COMP_0648_S 1 100 -81920 81917.5 ECU_ADDRESS 0xFFFF3A66 READ_WRITE /end MEASUREMENT
/begin MEASUREMENT vVLIMASCD "RAM value vVLIMASCD" SLONG COMP_0144_S 1 100 -1843.20024746394 1843.20024660563 ECU_ADDRESS 0xFFFF2F24 READ_WRITE /end MEASUREMENT
/begin MEASUREMENT vVMAVE "RAM value vVMAVE" UWORD COMP_0054 1 100 0 1310700 ECU_ADDRESS 0xFFFF3974 READ_WRITE /end MEASUREMENT
/begin MEASUREMENT vVMDGSTT "RAM value vVMDGSTT" UBYTE COMP_0014 1 100 0 2550 ECU_ADDRESS 0xFFFF3976 READ_WRITE /end MEASUREMENT
/begin MEASUREMENT vVMF "RAM value vVMF" SWORD COMP_0523 1 100 -32.000016384 31.999039821 ECU_ADDRESS 0xFFFF11C0 READ_WRITE /end MEASUREMENT
/begin MEASUREMENT vVMK "RAM value vVMK" SWORD COMP_0263 1 100 -32768 32767 ECU_ADDRESS 0xFFFF2F28 READ_WRITE /end MEASUREMENT
/begin MEASUREMENT vVMODE5 "RAM value vVMODE5" UBYTE COMP_0033 1 100 0 20400 ECU_ADDRESS 0xFFFF11C2 READ_WRITE /end MEASUREMENT
/begin MEASUREMENT vVMOT "RAM value vVMOT" UBYTE COMP_0033 1 100 0 20400 ECU_ADDRESS 0xFFFF20D3 READ_WRITE /end MEASUREMENT
/begin MEASUREMENT vVMOTR "RAM value vVMOTR" UBYTE COMP_0033 1 100 0 20400 ECU_ADDRESS 0xFFFF3977 READ_WRITE /end MEASUREMENT
/begin MEASUREMENT vVMVAB1 "RAM value vVMVAB1" UWORD COMP_0023 1 100 0 327675 ECU_ADDRESS 0xFFFF3978 READ_WRITE /end MEASUREMENT
/begin MEASUREMENT vVMVABAV1 "RAM value vVMVABAV1" UWORD COMP_0050 1 100 0 5119.921875 ECU_ADDRESS 0xFFFF20D4 READ_WRITE /end MEASUREMENT
/begin MEASUREMENT vVO2 "RAM value vVO2" UBYTE COMP_0104 1 100 0 2550 ECU_ADDRESS 0xFFFF0970 READ_WRITE /end MEASUREMENT
/begin MEASUREMENT vVO24M "RAM value vVO24M" UBYTE COMP_0104 1 100 0 2550 ECU_ADDRESS 0xFFFF3348 READ_WRITE /end MEASUREMENT
/begin MEASUREMENT vVO2MIN "RAM value vVO2MIN" UBYTE COMP_0104 1 100 0 2550 ECU_ADDRESS 0xFFFF11C3 READ_WRITE /end MEASUREMENT
/begin MEASUREMENT vVO2R "RAM value vVO2R" UBYTE COMP_0104 1 100 0 2550 ECU_ADDRESS 0xFFFF1A04 READ_WRITE /end MEASUREMENT
/begin MEASUREMENT vVOPS "RAM value vVOPS" UWORD COMP_0023 1 100 0 327675 ECU_ADDRESS 0xFFFF2F2A READ_WRITE /end MEASUREMENT
/begin MEASUREMENT vVOTRVMON "RAM value vVOTRVMON" UWORD COMP_0443 1 100 0 65535 ECU_ADDRESS 0xFFFF4F5E READ_WRITE /end MEASUREMENT
/begin MEASUREMENT vVPFCON "RAM value vVPFCON" UWORD COMP_0164 1 100 0 19.988175 ECU_ADDRESS 0xFFFF11C6 READ_WRITE /end MEASUREMENT
/begin MEASUREMENT vVPRCHK "RAM value vVPRCHK" UBYTE COMP_0033 1 100 0 20400 ECU_ADDRESS 0xFFFF397A READ_WRITE /end MEASUREMENT
/begin MEASUREMENT vVPRES "RAM value vVPRES" UWORD COMP_0050 1 100 0 5119.921875 ECU_ADDRESS 0xFFFF0906 READ_WRITE /end MEASUREMENT
/begin MEASUREMENT vVPRESCUT "RAM value vVPRESCUT" UWORD COMP_0050 1 100 0 5119.921875 ECU_ADDRESS 0xFFFF16C8 READ_WRITE /end MEASUREMENT
/begin MEASUREMENT vVPRESEX "RAM value vVPRESEX" UWORD COMP_0050 1 100 0 5119.921875 ECU_ADDRESS 0xFFFF16CA READ_WRITE /end MEASUREMENT
/begin MEASUREMENT vVPRSEO "RAM value vVPRSEO" UWORD COMP_0050 1 100 0 5119.921875 ECU_ADDRESS 0xFFFF397C READ_WRITE /end MEASUREMENT
/begin MEASUREMENT vVPRSEOCT "RAM value vVPRSEOCT" UWORD COMP_0023 1 100 0 327675 ECU_ADDRESS 0xFFFF397E READ_WRITE /end MEASUREMENT
/begin MEASUREMENT vVPRSEOEX "RAM value vVPRSEOEX" UBYTE COMP_0068 1 100 0 255 ECU_ADDRESS 0xFFFF3980 READ_WRITE /end MEASUREMENT
/begin MEASUREMENT vVRATIO "RAM value vVRATIO" UWORD COMP_0395 1 100 0 15.999780435 ECU_ADDRESS 0xFFFF334A READ_WRITE /end MEASUREMENT
/begin MEASUREMENT vVRATIO0 "RAM value vVRATIO0" UWORD COMP_0395 1 100 0 15.999780435 ECU_ADDRESS 0xFFFF2F2C READ_WRITE /end MEASUREMENT
/begin MEASUREMENT vVRO2 "RAM value vVRO2" UBYTE COMP_0104 1 100 0 2550 ECU_ADDRESS 0xFFFF20D6 READ_WRITE /end MEASUREMENT
/begin MEASUREMENT vVRO2AD "RAM value vVRO2AD" UBYTE COMP_0104 1 100 0 2550 ECU_ADDRESS 0xFFFF3981 READ_WRITE /end MEASUREMENT
/begin MEASUREMENT vVRO2If "RAM value vVRO2If" UBYTE COMP_0004 1 100 0 255 ECU_ADDRESS 0xFFFF3983 READ_WRITE /end MEASUREMENT
/begin MEASUREMENT vVRO2T "RAM value vVRO2T" UBYTE COMP_0104 1 100 0 2550 ECU_ADDRESS 0xFFFF20D8 READ_WRITE /end MEASUREMENT
/begin MEASUREMENT vVRO2Z "RAM value vVRO2Z" UBYTE COMP_0104 1 100 0 2550 ECU_ADDRESS 0xFFFF3984 READ_WRITE /end MEASUREMENT
/begin MEASUREMENT vVRO2z5 "RAM value vVRO2z5" UBYTE COMP_0104 1 100 0 2550 ECU_ADDRESS 0xFFFF398E READ_WRITE /end MEASUREMENT
/begin MEASUREMENT vVS2NGD1 "RAM value vVS2NGD1" UBYTE COMP_0013 1 100 0 255 ECU_ADDRESS 0xFFFF2F2E READ_WRITE /end MEASUREMENT
/begin MEASUREMENT vVS2NGD2 "RAM value vVS2NGD2" UBYTE COMP_0013 1 100 0 255 ECU_ADDRESS 0xFFFF2F2F READ_WRITE /end MEASUREMENT
/begin MEASUREMENT vVSCFBIFEf "RAM value vVSCFBIFEf" UBYTE COMP_0004 1 100 0 255 ECU_ADDRESS 0xFFFF32C7 READ_WRITE /end MEASUREMENT
/begin MEASUREMENT vVSCFBIFIf "RAM value vVSCFBIFIf" UBYTE COMP_0004 1 100 0 255 ECU_ADDRESS 0xFFFF32C8 READ_WRITE /end MEASUREMENT
/begin MEASUREMENT vVSCMAXEf "RAM value vVSCMAXEf" UBYTE COMP_0004 1 100 0 255 ECU_ADDRESS 0xFFFF32C9 READ_WRITE /end MEASUREMENT
/begin MEASUREMENT vVSCMAXIf "RAM value vVSCMAXIf" UBYTE COMP_0004 1 100 0 255 ECU_ADDRESS 0xFFFF32CA READ_WRITE /end MEASUREMENT
/begin MEASUREMENT vVSCMINEf "RAM value vVSCMINEf" UBYTE COMP_0004 1 100 0 255 ECU_ADDRESS 0xFFFF32CB READ_WRITE /end MEASUREMENT
/begin MEASUREMENT vVSCMINIf "RAM value vVSCMINIf" UBYTE COMP_0004 1 100 0 255 ECU_ADDRESS 0xFFFF32CC READ_WRITE /end MEASUREMENT
/begin MEASUREMENT vVSDLIMEf "RAM value vVSDLIMEf" UBYTE COMP_0004 1 100 0 255 ECU_ADDRESS 0xFFFF32CD READ_WRITE /end MEASUREMENT
/begin MEASUREMENT vVSDLIMIf "RAM value vVSDLIMIf" UBYTE COMP_0004 1 100 0 255 ECU_ADDRESS 0xFFFF32CE READ_WRITE /end MEASUREMENT
/begin MEASUREMENT vVSLDTERR "RAM value vVSLDTERR" SWORD COMP_0600_S 1 100 -327.68 327.67 ECU_ADDRESS 0xFFFF2F30 READ_WRITE /end MEASUREMENT
/begin MEASUREMENT vVSLDTRTO "RAM value vVSLDTRTO" SWORD COMP_0297_S 1 100 -32.768 32.767 ECU_ADDRESS 0xFFFF2F32 READ_WRITE /end MEASUREMENT
/begin MEASUREMENT vVSNGD1 "RAM value vVSNGD1" UBYTE COMP_0013 1 100 0 255 ECU_ADDRESS 0xFFFF2F34 READ_WRITE /end MEASUREMENT
/begin MEASUREMENT vVSNGD2 "RAM value vVSNGD2" UBYTE COMP_0013 1 100 0 255 ECU_ADDRESS 0xFFFF2F35 READ_WRITE /end MEASUREMENT
/begin MEASUREMENT vVSP "RAM value vVSP" UBYTE COMP_0007 1 100 0 510 ECU_ADDRESS 0xFFFF20D9 READ_WRITE /end MEASUREMENT
/begin MEASUREMENT vVSP0 "RAM value vVSP0" UWORD COMP_0436 1 100 0 6553.5 ECU_ADDRESS 0xFFFF11C8 READ_WRITE /end MEASUREMENT
/begin MEASUREMENT vVSP014 "RAM value vVSP014" UBYTE COMP_0068 1 100 0 255 ECU_ADDRESS 0xFFFF1A06 READ_WRITE /end MEASUREMENT
/begin MEASUREMENT vVSP1 "RAM value vVSP1" UBYTE COMP_0007 1 100 0 510 ECU_ADDRESS 0xFFFF157A READ_WRITE /end MEASUREMENT
/begin MEASUREMENT vVSP1Z "RAM value vVSP1Z" UBYTE COMP_0007 1 100 0 510 ECU_ADDRESS 0xFFFF2F36 READ_WRITE /end MEASUREMENT
/begin MEASUREMENT vVSP2 "RAM value vVSP2" UBYTE COMP_0007 1 100 0 510 ECU_ADDRESS 0xFFFF157B READ_WRITE /end MEASUREMENT
/begin MEASUREMENT vVSP2Z "RAM value vVSP2Z" UBYTE COMP_0007 1 100 0 510 ECU_ADDRESS 0xFFFF2F37 READ_WRITE /end MEASUREMENT
/begin MEASUREMENT vVSP2ZCNT "RAM value vVSP2ZCNT" UBYTE COMP_0016 1 100 0 255 ECU_ADDRESS 0xFFFF2F38 READ_WRITE /end MEASUREMENT
/begin MEASUREMENT vVSPASCCN "RAM value vVSPASCCN" SWORD COMP_0649_S 1 100 -1843.2 1843.14375 ECU_ADDRESS 0xFFFF2F3A READ_WRITE /end MEASUREMENT
/begin MEASUREMENT vVSPASCD "RAM value vVSPASCD" SLONG COMP_0144_S 1 100 -1843.20024746394 1843.20024660563 ECU_ADDRESS 0xFFFF3BC8 READ_WRITE /end MEASUREMENT
/begin MEASUREMENT vVSPASCD2 "RAM value vVSPASCD2" SLONG COMP_0144_S 1 100 -1843.20024746394 1843.20024660563 ECU_ADDRESS 0xFFFF3BCC READ_WRITE /end MEASUREMENT
/begin MEASUREMENT vVSPASCDK "RAM value vVSPASCDK" SLONG COMP_0481_S 1 100 -1842.540969984 1842.540969126 ECU_ADDRESS 0xFFFF2F3C READ_WRITE /end MEASUREMENT
/begin MEASUREMENT vVSPASCDP "RAM value vVSPASCDP" SLONG COMP_0144_S 1 100 -1843.20024746394 1843.20024660563 ECU_ADDRESS 0xFFFF2F40 READ_WRITE /end MEASUREMENT
/begin MEASUREMENT vVSPAVE "RAM value vVSPAVE" UBYTE COMP_0007 1 100 0 510 ECU_ADDRESS 0xFFFF4E1E READ_WRITE /end MEASUREMENT
/begin MEASUREMENT vVSPCMNCN "RAM value vVSPCMNCN" SWORD COMP_0649_S 1 100 -1843.2 1843.14375 ECU_ADDRESS 0xFFFF2F48 READ_WRITE /end MEASUREMENT
/begin MEASUREMENT vVSPCMP "RAM value vVSPCMP" SLONG COMP_0650_S 1 100 -3686.39190499328 3686.39190327667 ECU_ADDRESS 0xFFFF2F4C READ_WRITE /end MEASUREMENT
/begin MEASUREMENT vVSPCOLD "RAM value vVSPCOLD" SLONG COMP_0144_S 1 100 -1843.20024746394 1843.20024660563 ECU_ADDRESS 0xFFFF2F54 READ_WRITE /end MEASUREMENT
/begin MEASUREMENT vVSPCOM "RAM value vVSPCOM" SLONG COMP_0144_S 1 100 -1843.20024746394 1843.20024660563 ECU_ADDRESS 0xFFFF2F58 READ_WRITE /end MEASUREMENT
/begin MEASUREMENT vVSPCOMB "RAM value vVSPCOMB" SLONG COMP_0144_S 1 100 -1843.20024746394 1843.20024660563 ECU_ADDRESS 0xFFFF2F5C READ_WRITE /end MEASUREMENT
/begin MEASUREMENT vVSPCOMN "RAM value vVSPCOMN" SLONG COMP_0144_S 1 100 -1843.20024746394 1843.20024660563 ECU_ADDRESS 0xFFFF3BD0 READ_WRITE /end MEASUREMENT
/begin MEASUREMENT vVSPCOMO "RAM value vVSPCOMO" SLONG COMP_0144_S 1 100 -1843.20024746394 1843.20024660563 ECU_ADDRESS 0xFFFF2F60 READ_WRITE /end MEASUREMENT
/begin MEASUREMENT vVSPDEC "RAM value vVSPDEC" UBYTE COMP_0007 1 100 0 510 ECU_ADDRESS 0xFFFF11CA READ_WRITE /end MEASUREMENT
/begin MEASUREMENT vVSPEND "RAM value vVSPEND" UBYTE COMP_0007 1 100 0 510 ECU_ADDRESS 0xFFFF4E1F READ_WRITE /end MEASUREMENT
/begin MEASUREMENT vVSPGAPM "RAM value vVSPGAPM" UWORD COMP_0436 1 100 0 6553.5 ECU_ADDRESS 0xFFFF4E20 READ_WRITE /end MEASUREMENT
/begin MEASUREMENT vVSPLCNMX "RAM value vVSPLCNMX" UBYTE COMP_0016 1 100 0 255 ECU_ADDRESS 0xFFFF4E22 READ_WRITE /end MEASUREMENT
/begin MEASUREMENT vVSPMAX "RAM value vVSPMAX" UBYTE COMP_0007 1 100 0 510 ECU_ADDRESS 0xFFFF4E24 READ_WRITE /end MEASUREMENT
/begin MEASUREMENT vVSPMIN "RAM value vVSPMIN" UBYTE COMP_0007 1 100 0 510 ECU_ADDRESS 0xFFFF4E25 READ_WRITE /end MEASUREMENT
/begin MEASUREMENT vVSPNET1 "RAM value vVSPNET1" UBYTE COMP_0651_S 1 100 0 31.875 ECU_ADDRESS 0xFFFF1A07 READ_WRITE /end MEASUREMENT
/begin MEASUREMENT vVSPNOW "RAM value vVSPNOW" SLONG COMP_0144_S 1 100 -1843.20024746394 1843.20024660563 ECU_ADDRESS 0xFFFF2F68 READ_WRITE /end MEASUREMENT
/begin MEASUREMENT vVSPOLD "RAM value vVSPOLD" UBYTE COMP_0007 1 100 0 510 ECU_ADDRESS 0xFFFF398F READ_WRITE /end MEASUREMENT
/begin MEASUREMENT vVSPREVFL "RAM value vVSPREVFL" UWORD COMP_0443 1 100 0 65535 ECU_ADDRESS 0xFFFF16CC READ_WRITE /end MEASUREMENT
/begin MEASUREMENT vVSPRTO "RAM value vVSPRTO" ULONG COMP_0298_S 1 100 0 36864.0049406957 ECU_ADDRESS 0xFFFF3990 READ_WRITE /end MEASUREMENT
/begin MEASUREMENT vVSPRTO0 "RAM value vVSPRTO0" ULONG COMP_0298_S 1 100 0 36864.0049406957 ECU_ADDRESS 0xFFFF3994 READ_WRITE /end MEASUREMENT
/begin MEASUREMENT vVSPRTOER "RAM value vVSPRTOER" UWORD COMP_0298_S 1 100 0 0.56249149245 ECU_ADDRESS 0xFFFF3998 READ_WRITE /end MEASUREMENT
/begin MEASUREMENT vVSPRTOZ "RAM value vVSPRTOZ" ULONG COMP_0298_S 1 100 0 36864.0049406957 ECU_ADDRESS 0xFFFF399C READ_WRITE /end MEASUREMENT
/begin MEASUREMENT vVSPS "RAM value vVSPS" UBYTE COMP_0007 1 100 0 510 ECU_ADDRESS 0xFFFF1E26 READ_WRITE /end MEASUREMENT
/begin MEASUREMENT vVSPSBF "RAM value vVSPSBF" SLONG COMP_0144_S 1 100 -1843.20024746394 1843.20024660563 ECU_ADDRESS 0xFFFF2F6C READ_WRITE /end MEASUREMENT
/begin MEASUREMENT vVSPTGT "RAM value vVSPTGT" SLONG COMP_0144_S 1 100 -1843.20024746394 1843.20024660563 ECU_ADDRESS 0xFFFF2F70 READ_WRITE /end MEASUREMENT
/begin MEASUREMENT vVSPTGT0 "RAM value vVSPTGT0" SLONG COMP_0144_S 1 100 -1843.20024746394 1843.20024660563 ECU_ADDRESS 0xFFFF2F74 READ_WRITE /end MEASUREMENT
/begin MEASUREMENT vVSPTGTC "RAM value vVSPTGTC" UBYTE COMP_0068 1 100 0 255 ECU_ADDRESS 0xFFFF3BD4 READ_WRITE /end MEASUREMENT
/begin MEASUREMENT vVSPTGTT "RAM value vVSPTGTT" UWORD COMP_0238_S 1 100 0 655.35 ECU_ADDRESS 0xFFFF2F78 READ_WRITE /end MEASUREMENT
/begin MEASUREMENT vVSPTH "RAM value vVSPTH" UBYTE COMP_0001 1 100 0 31.875 ECU_ADDRESS 0xFFFF2F7A READ_WRITE /end MEASUREMENT
/begin MEASUREMENT vVSPTL "RAM value vVSPTL" UBYTE COMP_0001 1 100 0 31.875 ECU_ADDRESS 0xFFFF2F7B READ_WRITE /end MEASUREMENT
/begin MEASUREMENT vVSPTMP "RAM value vVSPTMP" UBYTE COMP_0007 1 100 0 510 ECU_ADDRESS 0xFFFF2F7C READ_WRITE /end MEASUREMENT
/begin MEASUREMENT vVSPTRP "RAM value vVSPTRP" UWORD COMP_0049 1 100 0 65535 ECU_ADDRESS 0xFFFF2F7E READ_WRITE /end MEASUREMENT
/begin MEASUREMENT vVSPX "RAM value vVSPX" UWORD COMP_0236 1 100 0 16383.75 ECU_ADDRESS 0xFFFF080A READ_WRITE /end MEASUREMENT
/begin MEASUREMENT vVSPX2 "RAM value vVSPX2" UWORD COMP_0236 1 100 0 16383.75 ECU_ADDRESS 0xFFFF157C READ_WRITE /end MEASUREMENT
/begin MEASUREMENT vVSRTHMON "RAM value vVSRTHMON" UWORD COMP_0652_S 1 100 0 35.99942406 ECU_ADDRESS 0xFFFF4F60 READ_WRITE /end MEASUREMENT
/begin MEASUREMENT vVSRTLMON "RAM value vVSRTLMON" UWORD COMP_0652_S 1 100 0 35.99942406 ECU_ADDRESS 0xFFFF4F62 READ_WRITE /end MEASUREMENT
/begin MEASUREMENT vVSSTATE "RAM value vVSSTATE" UBYTE COMP_0068 1 100 0 255 ECU_ADDRESS 0xFFFF20DA READ_WRITE /end MEASUREMENT
/begin MEASUREMENT vVTC4TE0 "RAM value vVTC4TE0" UBYTE COMP_0256 1 100 -64 63.5 ECU_ADDRESS 0xFFFF2F80 READ_WRITE /end MEASUREMENT
/begin MEASUREMENT vVTC4TP "RAM value vVTC4TP" UBYTE COMP_0256 1 100 -64 63.5 ECU_ADDRESS 0xFFFF2F81 READ_WRITE /end MEASUREMENT
/begin MEASUREMENT vVTC4TP0 "RAM value vVTC4TP0" UBYTE COMP_0256 1 100 -64 63.5 ECU_ADDRESS 0xFFFF2F82 READ_WRITE /end MEASUREMENT
/begin MEASUREMENT vVTC4TPE "RAM value vVTC4TPE" UBYTE COMP_0256 1 100 -64 63.5 ECU_ADDRESS 0xFFFF2F83 READ_WRITE /end MEASUREMENT
/begin MEASUREMENT vVTC4TPEN "RAM value vVTC4TPEN" UWORD COMP_0108_S 1 100 -16384 16383.5 ECU_ADDRESS 0xFFFF2F84 READ_WRITE /end MEASUREMENT
/begin MEASUREMENT vVTC4TPN "RAM value vVTC4TPN" UWORD COMP_0108_S 1 100 -16384 16383.5 ECU_ADDRESS 0xFFFF2F86 READ_WRITE /end MEASUREMENT
/begin MEASUREMENT vVTCADV "RAM value vVTCADV" UBYTE COMP_0245 1 100 -64 191 ECU_ADDRESS 0xFFFF1B74 READ_WRITE /end MEASUREMENT
/begin MEASUREMENT vVTCB "RAM value vVTCB" UBYTE COMP_0256 1 100 -64 63.5 ECU_ADDRESS 0xFFFF11CB READ_WRITE /end MEASUREMENT
/begin MEASUREMENT vVTCB3 "RAM value vVTCB3" UBYTE COMP_0256 1 100 -64 63.5 ECU_ADDRESS 0xFFFF11CC READ_WRITE /end MEASUREMENT
/begin MEASUREMENT vVTCB3E "RAM value vVTCB3E" UBYTE COMP_0256 1 100 -64 63.5 ECU_ADDRESS 0xFFFF11CE READ_WRITE /end MEASUREMENT
/begin MEASUREMENT vVTCCLK "RAM value vVTCCLK" UWORD COMP_0369 1 100 0 209712 ECU_ADDRESS 0xFFFF1A08 READ_WRITE /end MEASUREMENT
/begin MEASUREMENT vVTCCLKE "RAM value vVTCCLKE" UWORD COMP_0189 1 100 0 209712 ECU_ADDRESS 0xFFFF11D0 READ_WRITE /end MEASUREMENT
/begin MEASUREMENT vVTCCLKEB "RAM value vVTCCLKEB" UWORD COMP_0189 1 100 0 209712 ECU_ADDRESS 0xFFFF1A0A READ_WRITE /end MEASUREMENT
/begin MEASUREMENT vVTCD "RAM value vVTCD" UBYTE COMP_0256 1 100 -64 63.5 ECU_ADDRESS 0xFFFF11D4 READ_WRITE /end MEASUREMENT
/begin MEASUREMENT vVTCD3 "RAM value vVTCD3" UBYTE COMP_0256 1 100 -64 63.5 ECU_ADDRESS 0xFFFF11D5 READ_WRITE /end MEASUREMENT
/begin MEASUREMENT vVTCD3E "RAM value vVTCD3E" UBYTE COMP_0256 1 100 -64 63.5 ECU_ADDRESS 0xFFFF11D7 READ_WRITE /end MEASUREMENT
/begin MEASUREMENT vVTCDEG "RAM value vVTCDEG" UWORD COMP_0108_S 1 100 -16384 16383.5 ECU_ADDRESS 0xFFFF2F88 READ_WRITE /end MEASUREMENT
/begin MEASUREMENT vVTCDEV "RAM value vVTCDEV" UBYTE COMP_0256 1 100 -64 63.5 ECU_ADDRESS 0xFFFF11D9 READ_WRITE /end MEASUREMENT
/begin MEASUREMENT vVTCDG1_Sf "RAM value vVTCDG1_Sf" UBYTE COMP_0004 1 100 0 255 ECU_ADDRESS 0xFFFF3070 READ_WRITE /end MEASUREMENT
/begin MEASUREMENT vVTCDG2_Sf "RAM value vVTCDG2_Sf" UBYTE COMP_0004 1 100 0 255 ECU_ADDRESS 0xFFFF3071 READ_WRITE /end MEASUREMENT
/begin MEASUREMENT vVTCDG3_Sf "RAM value vVTCDG3_Sf" UBYTE COMP_0004 1 100 0 255 ECU_ADDRESS 0xFFFF3072 READ_WRITE /end MEASUREMENT
/begin MEASUREMENT vVTCDG4_Sf "RAM value vVTCDG4_Sf" UBYTE COMP_0004 1 100 0 255 ECU_ADDRESS 0xFFFF3073 READ_WRITE /end MEASUREMENT
/begin MEASUREMENT vVTCDG5_Sf "RAM value vVTCDG5_Sf" UBYTE COMP_0004 1 100 0 255 ECU_ADDRESS 0xFFFF3074 READ_WRITE /end MEASUREMENT
/begin MEASUREMENT vVTCDGE1f "RAM value vVTCDGE1f" UBYTE COMP_0004 1 100 0 255 ECU_ADDRESS 0xFFFF2F8A READ_WRITE /end MEASUREMENT
/begin MEASUREMENT vVTCDGE2f "RAM value vVTCDGE2f" UBYTE COMP_0004 1 100 0 255 ECU_ADDRESS 0xFFFF2F8B READ_WRITE /end MEASUREMENT
/begin MEASUREMENT vVTCDGE3f "RAM value vVTCDGE3f" UBYTE COMP_0004 1 100 0 255 ECU_ADDRESS 0xFFFF2F8C READ_WRITE /end MEASUREMENT
/begin MEASUREMENT vVTCDGE4f "RAM value vVTCDGE4f" UBYTE COMP_0004 1 100 0 255 ECU_ADDRESS 0xFFFF2F8D READ_WRITE /end MEASUREMENT
/begin MEASUREMENT vVTCDGE5f "RAM value vVTCDGE5f" UBYTE COMP_0004 1 100 0 255 ECU_ADDRESS 0xFFFF2F8E READ_WRITE /end MEASUREMENT
/begin MEASUREMENT vVTCDGN1Sf "RAM value vVTCDGN1Sf" UBYTE COMP_0004 1 100 0 255 ECU_ADDRESS 0xFFFF2F8F READ_WRITE /end MEASUREMENT
/begin MEASUREMENT vVTCDGN2Sf "RAM value vVTCDGN2Sf" UBYTE COMP_0004 1 100 0 255 ECU_ADDRESS 0xFFFF2F91 READ_WRITE /end MEASUREMENT
/begin MEASUREMENT vVTCDGN2f "RAM value vVTCDGN2f" UBYTE COMP_0004 1 100 0 255 ECU_ADDRESS 0xFFFF2F90 READ_WRITE /end MEASUREMENT
/begin MEASUREMENT vVTCDGN3Sf "RAM value vVTCDGN3Sf" UBYTE COMP_0004 1 100 0 255 ECU_ADDRESS 0xFFFF3BD5 READ_WRITE /end MEASUREMENT
/begin MEASUREMENT vVTCDGN4Sf "RAM value vVTCDGN4Sf" UBYTE COMP_0004 1 100 0 255 ECU_ADDRESS 0xFFFF2F92 READ_WRITE /end MEASUREMENT
/begin MEASUREMENT vVTCDGN5Ef "RAM value vVTCDGN5Ef" UBYTE COMP_0004 1 100 0 255 ECU_ADDRESS 0xFFFF212A READ_WRITE /end MEASUREMENT
/begin MEASUREMENT vVTCDGN5f "RAM value vVTCDGN5f" UBYTE COMP_0004 1 100 0 255 ECU_ADDRESS 0xFFFF212B READ_WRITE /end MEASUREMENT
/begin MEASUREMENT vVTCDGN6f "RAM value vVTCDGN6f" UBYTE COMP_0004 1 100 0 255 ECU_ADDRESS 0xFFFF212C READ_WRITE /end MEASUREMENT
/begin MEASUREMENT vVTCDGNf "RAM value vVTCDGNf" UBYTE COMP_0004 1 100 0 255 ECU_ADDRESS 0xFFFF2F93 READ_WRITE /end MEASUREMENT
/begin MEASUREMENT vVTCDTY1E "RAM value vVTCDTY1E" UWORD COMP_0146 1 100 0 99.998480265 ECU_ADDRESS 0xFFFF1E28 READ_WRITE /end MEASUREMENT
/begin MEASUREMENT vVTCDUTY "RAM value vVTCDUTY" UBYTE COMP_0021 1 100 0 99.609375 ECU_ADDRESS 0xFFFF1B75 READ_WRITE /end MEASUREMENT
/begin MEASUREMENT vVTCDUTY1 "RAM value vVTCDUTY1" UWORD COMP_0146 1 100 0 99.998480265 ECU_ADDRESS 0xFFFF1E2C READ_WRITE /end MEASUREMENT
/begin MEASUREMENT vVTCDUTYE "RAM value vVTCDUTYE" UWORD COMP_0447 1 100 0 6399.90234375 ECU_ADDRESS 0xFFFF11DA READ_WRITE /end MEASUREMENT
/begin MEASUREMENT vVTCDUTYI "RAM value vVTCDUTYI" UWORD COMP_0447 1 100 0 6399.90234375 ECU_ADDRESS 0xFFFF11DE READ_WRITE /end MEASUREMENT
/begin MEASUREMENT vVTCFS3_Sf "RAM value vVTCFS3_Sf" UBYTE COMP_0004 1 100 0 255 ECU_ADDRESS 0xFFFF3075 READ_WRITE /end MEASUREMENT
/begin MEASUREMENT vVTCFS4_Sf "RAM value vVTCFS4_Sf" UBYTE COMP_0004 1 100 0 255 ECU_ADDRESS 0xFFFF3076 READ_WRITE /end MEASUREMENT
/begin MEASUREMENT vVTCFS5_Sf "RAM value vVTCFS5_Sf" UBYTE COMP_0004 1 100 0 255 ECU_ADDRESS 0xFFFF3077 READ_WRITE /end MEASUREMENT
/begin MEASUREMENT vVTCFSE3f "RAM value vVTCFSE3f" UBYTE COMP_0004 1 100 0 255 ECU_ADDRESS 0xFFFF2F94 READ_WRITE /end MEASUREMENT
/begin MEASUREMENT vVTCFSE4f "RAM value vVTCFSE4f" UBYTE COMP_0004 1 100 0 255 ECU_ADDRESS 0xFFFF2F95 READ_WRITE /end MEASUREMENT
/begin MEASUREMENT vVTCFSE5f "RAM value vVTCFSE5f" UBYTE COMP_0004 1 100 0 255 ECU_ADDRESS 0xFFFF2F96 READ_WRITE /end MEASUREMENT
/begin MEASUREMENT vVTCHOS "RAM value vVTCHOS" UBYTE COMP_0653_S 1 100 -32 31.75 ECU_ADDRESS 0xFFFF11E2 READ_WRITE /end MEASUREMENT
/begin MEASUREMENT vVTCI "RAM value vVTCI" ULONG COMP_0526 1 100 -63.99996198912 32703.9805688109 ECU_ADDRESS 0xFFFF11E4 READ_WRITE /end MEASUREMENT
/begin MEASUREMENT vVTCI3 "RAM value vVTCI3" ULONG COMP_0526 1 100 -63.99996198912 32703.9805688109 ECU_ADDRESS 0xFFFF11E8 READ_WRITE /end MEASUREMENT
/begin MEASUREMENT vVTCI3E "RAM value vVTCI3E" ULONG COMP_0526 1 100 -63.99996198912 32703.9805688109 ECU_ADDRESS 0xFFFF11F0 READ_WRITE /end MEASUREMENT
/begin MEASUREMENT vVTCI3EN "RAM value vVTCI3EN" ULONG COMP_0654_S 1 100 -16383.9902692147 16383.9902615853 ECU_ADDRESS 0xFFFF11F8 READ_WRITE /end MEASUREMENT
/begin MEASUREMENT vVTCICLRAf "RAM value vVTCICLRAf" UBYTE COMP_0004 1 100 0 255 ECU_ADDRESS 0xFFFF2F97 READ_WRITE /end MEASUREMENT
/begin MEASUREMENT vVTCICLREf "RAM value vVTCICLREf" UBYTE COMP_0004 1 100 0 255 ECU_ADDRESS 0xFFFF3BD6 READ_WRITE /end MEASUREMENT
/begin MEASUREMENT vVTCICLRf "RAM value vVTCICLRf" UBYTE COMP_0004 1 100 0 255 ECU_ADDRESS 0xFFFF3BD7 READ_WRITE /end MEASUREMENT
/begin MEASUREMENT vVTCIN "RAM value vVTCIN" UBYTE COMP_0068 1 100 0 255 ECU_ADDRESS 0xFFFF11FC READ_WRITE /end MEASUREMENT
/begin MEASUREMENT vVTCKAN "RAM value vVTCKAN" UBYTE COMP_0048 1 100 0 127.5 ECU_ADDRESS 0xFFFF2F98 READ_WRITE /end MEASUREMENT
/begin MEASUREMENT vVTCLCNT "RAM value vVTCLCNT" UBYTE COMP_0016 1 100 0 255 ECU_ADDRESS 0xFFFF4E26 READ_WRITE /end MEASUREMENT
/begin MEASUREMENT vVTCLCNTE "RAM value vVTCLCNTE" UBYTE COMP_0016 1 100 0 255 ECU_ADDRESS 0xFFFF4E27 READ_WRITE /end MEASUREMENT
/begin MEASUREMENT vVTCLHTC "RAM value vVTCLHTC" UBYTE COMP_0014 1 100 0 2550 ECU_ADDRESS 0xFFFF153C READ_WRITE /end MEASUREMENT
/begin MEASUREMENT vVTCLHTCE "RAM value vVTCLHTCE" UBYTE COMP_0014 1 100 0 2550 ECU_ADDRESS 0xFFFF153D READ_WRITE /end MEASUREMENT
/begin MEASUREMENT vVTCLNJD "RAM value vVTCLNJD" UWORD COMP_0018_S 1 100 0 127.998046875 ECU_ADDRESS 0xFFFF11FE READ_WRITE /end MEASUREMENT
/begin MEASUREMENT vVTCLNJDE "RAM value vVTCLNJDE" UWORD COMP_0018_S 1 100 0 127.998046875 ECU_ADDRESS 0xFFFF1200 READ_WRITE /end MEASUREMENT
/begin MEASUREMENT vVTCLRL "RAM value vVTCLRL" UWORD COMP_0108_S 1 100 -16384 16383.5 ECU_ADDRESS 0xFFFF2F9A READ_WRITE /end MEASUREMENT
/begin MEASUREMENT vVTCMECNT "RAM value vVTCMECNT" UBYTE COMP_0030 1 100 0 255 ECU_ADDRESS 0xFFFF2F9C READ_WRITE /end MEASUREMENT
/begin MEASUREMENT vVTCMESM1 "RAM value vVTCMESM1" UWORD COMP_0023 1 100 0 327675 ECU_ADDRESS 0xFFFF2F9E READ_WRITE /end MEASUREMENT
/begin MEASUREMENT vVTCMESTG "RAM value vVTCMESTG" UBYTE COMP_0068 1 100 0 255 ECU_ADDRESS 0xFFFF2FA0 READ_WRITE /end MEASUREMENT
/begin MEASUREMENT vVTCMICNT "RAM value vVTCMICNT" UBYTE COMP_0030 1 100 0 255 ECU_ADDRESS 0xFFFF2FA1 READ_WRITE /end MEASUREMENT
/begin MEASUREMENT vVTCMISM1 "RAM value vVTCMISM1" UWORD COMP_0023 1 100 0 327675 ECU_ADDRESS 0xFFFF2FA2 READ_WRITE /end MEASUREMENT
/begin MEASUREMENT vVTCMISTG "RAM value vVTCMISTG" UBYTE COMP_0068 1 100 0 255 ECU_ADDRESS 0xFFFF2FA4 READ_WRITE /end MEASUREMENT
/begin MEASUREMENT vVTCMITC "RAM value vVTCMITC" UBYTE COMP_0009 1 100 0 199.21875 ECU_ADDRESS 0xFFFF2FA5 READ_WRITE /end MEASUREMENT
/begin MEASUREMENT vVTCMNAE1 "RAM value vVTCMNAE1" UWORD COMP_0293_S 1 100 0 0.999985458 ECU_ADDRESS 0xFFFF32D0 READ_WRITE /end MEASUREMENT
/begin MEASUREMENT vVTCMNAI1 "RAM value vVTCMNAI1" UWORD COMP_0293_S 1 100 0 0.999985458 ECU_ADDRESS 0xFFFF32D2 READ_WRITE /end MEASUREMENT
/begin MEASUREMENT vVTCMNIE1 "RAM value vVTCMNIE1" UBYTE COMP_0046_S 1 100 0 0.99609375 ECU_ADDRESS 0xFFFF32D4 READ_WRITE /end MEASUREMENT
/begin MEASUREMENT vVTCMNII1 "RAM value vVTCMNII1" UBYTE COMP_0046_S 1 100 0 0.99609375 ECU_ADDRESS 0xFFFF32D5 READ_WRITE /end MEASUREMENT
/begin MEASUREMENT vVTCMON "RAM value vVTCMON" UBYTE COMP_0257 1 100 -128 127 ECU_ADDRESS 0xFFFF1202 READ_WRITE /end MEASUREMENT
/begin MEASUREMENT vVTCNAV "RAM value vVTCNAV" UBYTE COMP_0256 1 100 -64 63.5 ECU_ADDRESS 0xFFFF2FA6 READ_WRITE /end MEASUREMENT
/begin MEASUREMENT vVTCNAVN "RAM value vVTCNAVN" UWORD COMP_0108_S 1 100 -16384 16383.5 ECU_ADDRESS 0xFFFF2FA8 READ_WRITE /end MEASUREMENT
/begin MEASUREMENT vVTCNE "RAM value vVTCNE" UBYTE COMP_0006 1 100 0 3187.5 ECU_ADDRESS 0xFFFF2FAA READ_WRITE /end MEASUREMENT
/begin MEASUREMENT vVTCNEAV "RAM value vVTCNEAV" UBYTE COMP_0256 1 100 -64 63.5 ECU_ADDRESS 0xFFFF2FAB READ_WRITE /end MEASUREMENT
/begin MEASUREMENT vVTCNEAVN "RAM value vVTCNEAVN" UWORD COMP_0108_S 1 100 -16384 16383.5 ECU_ADDRESS 0xFFFF2FAC READ_WRITE /end MEASUREMENT
/begin MEASUREMENT vVTCNEE "RAM value vVTCNEE" UBYTE COMP_0006 1 100 0 3187.5 ECU_ADDRESS 0xFFFF2FAE READ_WRITE /end MEASUREMENT
/begin MEASUREMENT vVTCNK "RAM value vVTCNK" UBYTE COMP_0245 1 100 -64 191 ECU_ADDRESS 0xFFFF1203 READ_WRITE /end MEASUREMENT
/begin MEASUREMENT vVTCNOW "RAM value vVTCNOW" UBYTE COMP_0256 1 100 -64 63.5 ECU_ADDRESS 0xFFFF1B77 READ_WRITE /end MEASUREMENT
/begin MEASUREMENT vVTCNOW2 "RAM value vVTCNOW2" UBYTE COMP_0257 1 100 -128 127 ECU_ADDRESS 0xFFFF1204 READ_WRITE /end MEASUREMENT
/begin MEASUREMENT vVTCNOWE "RAM value vVTCNOWE" UBYTE COMP_0256 1 100 -64 63.5 ECU_ADDRESS 0xFFFF1B79 READ_WRITE /end MEASUREMENT
/begin MEASUREMENT vVTCNOWEN "RAM value vVTCNOWEN" UWORD COMP_0108_S 1 100 -16384 16383.5 ECU_ADDRESS 0xFFFF1206 READ_WRITE /end MEASUREMENT
/begin MEASUREMENT vVTCNOWEX "RAM value vVTCNOWEX" UWORD COMP_0529 1 100 -128 127.99609375 ECU_ADDRESS 0xFFFF120A READ_WRITE /end MEASUREMENT
/begin MEASUREMENT vVTCNOWKN "RAM value vVTCNOWKN" UWORD COMP_0529 1 100 -128 127.99609375 ECU_ADDRESS 0xFFFF1B7C READ_WRITE /end MEASUREMENT
/begin MEASUREMENT vVTCNOWN "RAM value vVTCNOWN" UWORD COMP_0108_S 1 100 -16384 16383.5 ECU_ADDRESS 0xFFFF120E READ_WRITE /end MEASUREMENT
/begin MEASUREMENT vVTCNOWW "RAM value vVTCNOWW" UBYTE COMP_0256 1 100 -64 63.5 ECU_ADDRESS 0xFFFF1212 READ_WRITE /end MEASUREMENT
/begin MEASUREMENT vVTCNOWWE "RAM value vVTCNOWWE" UWORD COMP_0108_S 1 100 -16384 16383.5 ECU_ADDRESS 0xFFFF1214 READ_WRITE /end MEASUREMENT
/begin MEASUREMENT vVTCNOWWN "RAM value vVTCNOWWN" UWORD COMP_0108_S 1 100 -16384 16383.5 ECU_ADDRESS 0xFFFF1218 READ_WRITE /end MEASUREMENT
/begin MEASUREMENT vVTCNOWZ1 "RAM value vVTCNOWZ1" UBYTE COMP_0256 1 100 -64 63.5 ECU_ADDRESS 0xFFFF121C READ_WRITE /end MEASUREMENT
/begin MEASUREMENT vVTCNOWZ2 "RAM value vVTCNOWZ2" UBYTE COMP_0256 1 100 -64 63.5 ECU_ADDRESS 0xFFFF121D READ_WRITE /end MEASUREMENT
/begin MEASUREMENT vVTCNOWZ3 "RAM value vVTCNOWZ3" UBYTE COMP_0256 1 100 -64 63.5 ECU_ADDRESS 0xFFFF121E READ_WRITE /end MEASUREMENT
/begin MEASUREMENT vVTCNOWZ4 "RAM value vVTCNOWZ4" UBYTE COMP_0256 1 100 -64 63.5 ECU_ADDRESS 0xFFFF121F READ_WRITE /end MEASUREMENT
/begin MEASUREMENT vVTCNTRG "RAM value vVTCNTRG" UWORD COMP_0108_S 1 100 -16384 16383.5 ECU_ADDRESS 0xFFFF2FB0 READ_WRITE /end MEASUREMENT
/begin MEASUREMENT vVTCNTRGE "RAM value vVTCNTRGE" UWORD COMP_0108_S 1 100 -16384 16383.5 ECU_ADDRESS 0xFFFF2FB2 READ_WRITE /end MEASUREMENT
/begin MEASUREMENT vVTCOL4TP "RAM value vVTCOL4TP" UWORD COMP_0108_S 1 100 -16384 16383.5 ECU_ADDRESS 0xFFFF2FB4 READ_WRITE /end MEASUREMENT
/begin MEASUREMENT vVTCONT2E "RAM value vVTCONT2E" UBYTE COMP_0016 1 100 0 255 ECU_ADDRESS 0xFFFF3A50 READ_WRITE /end MEASUREMENT
/begin MEASUREMENT vVTCONTE "RAM value vVTCONTE" UBYTE COMP_0016 1 100 0 255 ECU_ADDRESS 0xFFFF3A52 READ_WRITE /end MEASUREMENT
/begin MEASUREMENT vVTCP "RAM value vVTCP" UWORD COMP_0655_S 1 100 -64.00016384 63.99821071 ECU_ADDRESS 0xFFFF1220 READ_WRITE /end MEASUREMENT
/begin MEASUREMENT vVTCP3N "RAM value vVTCP3N" ULONG COMP_0654_S 1 100 -16383.9902692147 16383.9902615853 ECU_ADDRESS 0xFFFF1224 READ_WRITE /end MEASUREMENT
/begin MEASUREMENT vVTCP3NE "RAM value vVTCP3NE" ULONG COMP_0654_S 1 100 -16383.9902692147 16383.9902615853 ECU_ADDRESS 0xFFFF122C READ_WRITE /end MEASUREMENT
/begin MEASUREMENT vVTCPAUSEf "RAM value vVTCPAUSEf" UBYTE COMP_0004 1 100 0 255 ECU_ADDRESS 0xFFFF2FB6 READ_WRITE /end MEASUREMENT
/begin MEASUREMENT vVTCPID "RAM value vVTCPID" ULONG COMP_0530 1 100 -64.0000458752 32704.0234345978 ECU_ADDRESS 0xFFFF1234 READ_WRITE /end MEASUREMENT
/begin MEASUREMENT vVTCPID3E "RAM value vVTCPID3E" ULONG COMP_0654_S 1 100 -16383.9902692147 16383.9902615853 ECU_ADDRESS 0xFFFF1238 READ_WRITE /end MEASUREMENT
/begin MEASUREMENT vVTCPID3N "RAM value vVTCPID3N" ULONG COMP_0654_S 1 100 -16383.9902692147 16383.9902615853 ECU_ADDRESS 0xFFFF1240 READ_WRITE /end MEASUREMENT
/begin MEASUREMENT vVTCPOS4 "RAM value vVTCPOS4" UBYTE COMP_0048 1 100 0 127.5 ECU_ADDRESS 0xFFFF1248 READ_WRITE /end MEASUREMENT
/begin MEASUREMENT vVTCPOSE "RAM value vVTCPOSE" UBYTE COMP_0048 1 100 0 127.5 ECU_ADDRESS 0xFFFF1A0E READ_WRITE /end MEASUREMENT
/begin MEASUREMENT vVTCPOSEB "RAM value vVTCPOSEB" UBYTE COMP_0048 1 100 0 127.5 ECU_ADDRESS 0xFFFF1A10 READ_WRITE /end MEASUREMENT
/begin MEASUREMENT vVTCPOSEX "RAM value vVTCPOSEX" UWORD COMP_0656_S 1 100 0 127.998046875 ECU_ADDRESS 0xFFFF1A12 READ_WRITE /end MEASUREMENT
/begin MEASUREMENT vVTCPOSEXB "RAM value vVTCPOSEXB" UWORD COMP_0656_S 1 100 0 127.998046875 ECU_ADDRESS 0xFFFF1A16 READ_WRITE /end MEASUREMENT
/begin MEASUREMENT vVTCPOSIN "RAM value vVTCPOSIN" UWORD COMP_0656_S 1 100 0 127.998046875 ECU_ADDRESS 0xFFFF1A1A READ_WRITE /end MEASUREMENT
/begin MEASUREMENT vVTCPS4 "RAM value vVTCPS4" UWORD COMP_0504_S 1 100 0 127.998046875 ECU_ADDRESS 0xFFFF1A1E READ_WRITE /end MEASUREMENT
/begin MEASUREMENT vVTCRTE "RAM value vVTCRTE" UBYTE COMP_0186 1 100 0 3.984375 ECU_ADDRESS 0xFFFF1249 READ_WRITE /end MEASUREMENT
/begin MEASUREMENT vVTCSOL "RAM value vVTCSOL" UBYTE COMP_0030 1 100 0 255 ECU_ADDRESS 0xFFFF2FB7 READ_WRITE /end MEASUREMENT
/begin MEASUREMENT vVTCSOLE "RAM value vVTCSOLE" UBYTE COMP_0030 1 100 0 255 ECU_ADDRESS 0xFFFF2FB9 READ_WRITE /end MEASUREMENT
/begin MEASUREMENT vVTCSTCT "RAM value vVTCSTCT" UBYTE COMP_0030 1 100 0 255 ECU_ADDRESS 0xFFFF1A20 READ_WRITE /end MEASUREMENT
/begin MEASUREMENT vVTCTGWEB "RAM value vVTCTGWEB" UWORD COMP_0108_S 1 100 -16384 16383.5 ECU_ADDRESS 0xFFFF124A READ_WRITE /end MEASUREMENT
/begin MEASUREMENT vVTCTGWNB "RAM value vVTCTGWNB" UWORD COMP_0108_S 1 100 -16384 16383.5 ECU_ADDRESS 0xFFFF1312 READ_WRITE /end MEASUREMENT
/begin MEASUREMENT vVTCTREF "RAM value vVTCTREF" ULONG COMP_0657_S 1 100 0 13743.895344 ECU_ADDRESS 0xFFFF13DC READ_WRITE /end MEASUREMENT
/begin MEASUREMENT vVTCTREFE "RAM value vVTCTREFE" ULONG COMP_0657_S 1 100 0 13743.895344 ECU_ADDRESS 0xFFFF13E4 READ_WRITE /end MEASUREMENT
/begin MEASUREMENT vVTCTRG "RAM value vVTCTRG" UBYTE COMP_0256 1 100 -64 63.5 ECU_ADDRESS 0xFFFF1A76 READ_WRITE /end MEASUREMENT
/begin MEASUREMENT vVTCTRG10 "RAM value vVTCTRG10" UBYTE COMP_0256 1 100 -64 63.5 ECU_ADDRESS 0xFFFF13EC READ_WRITE /end MEASUREMENT
/begin MEASUREMENT vVTCTRG2 "RAM value vVTCTRG2" UBYTE COMP_0257 1 100 -128 127 ECU_ADDRESS 0xFFFF13ED READ_WRITE /end MEASUREMENT
/begin MEASUREMENT vVTCTRGE "RAM value vVTCTRGE" UBYTE COMP_0256 1 100 -64 63.5 ECU_ADDRESS 0xFFFF1A77 READ_WRITE /end MEASUREMENT
/begin MEASUREMENT vVTCTRGE2 "RAM value vVTCTRGE2" UWORD COMP_0108_S 1 100 -16384 16383.5 ECU_ADDRESS 0xFFFF13EE READ_WRITE /end MEASUREMENT
/begin MEASUREMENT vVTCTRGEN "RAM value vVTCTRGEN" UWORD COMP_0108_S 1 100 -16384 16383.5 ECU_ADDRESS 0xFFFF09A2 READ_WRITE /end MEASUREMENT
/begin MEASUREMENT vVTCTRGN "RAM value vVTCTRGN" UWORD COMP_0108_S 1 100 -16384 16383.5 ECU_ADDRESS 0xFFFF09A4 READ_WRITE /end MEASUREMENT
/begin MEASUREMENT vVTCTRGN2 "RAM value vVTCTRGN2" UWORD COMP_0108_S 1 100 -16384 16383.5 ECU_ADDRESS 0xFFFF13F0 READ_WRITE /end MEASUREMENT
/begin MEASUREMENT vVTCTRGS "RAM value vVTCTRGS" UBYTE COMP_0256 1 100 -64 63.5 ECU_ADDRESS 0xFFFF13F2 READ_WRITE /end MEASUREMENT
/begin MEASUREMENT vVTCTRGSE "RAM value vVTCTRGSE" UWORD COMP_0108_S 1 100 -16384 16383.5 ECU_ADDRESS 0xFFFF13F4 READ_WRITE /end MEASUREMENT
/begin MEASUREMENT vVTCTRGSN "RAM value vVTCTRGSN" UWORD COMP_0108_S 1 100 -16384 16383.5 ECU_ADDRESS 0xFFFF13F6 READ_WRITE /end MEASUREMENT
/begin MEASUREMENT vVTCTRGT "RAM value vVTCTRGT" UBYTE COMP_0256 1 100 -64 63.5 ECU_ADDRESS 0xFFFF13F8 READ_WRITE /end MEASUREMENT
/begin MEASUREMENT vVTCTRGW "RAM value vVTCTRGW" UWORD COMP_0528 1 100 -64 63.998046875 ECU_ADDRESS 0xFFFF13FA READ_WRITE /end MEASUREMENT
/begin MEASUREMENT vVTCTRGWB "RAM value vVTCTRGWB" UBYTE COMP_0256 1 100 -64 63.5 ECU_ADDRESS 0xFFFF13FC READ_WRITE /end MEASUREMENT
/begin MEASUREMENT vVTCTRGWE "RAM value vVTCTRGWE" ULONG COMP_0654_S 1 100 -16383.9902692147 16383.9902615853 ECU_ADDRESS 0xFFFF1460 READ_WRITE /end MEASUREMENT
/begin MEASUREMENT vVTCTRGWN "RAM value vVTCTRGWN" ULONG COMP_0654_S 1 100 -16383.9902692147 16383.9902615853 ECU_ADDRESS 0xFFFF1464 READ_WRITE /end MEASUREMENT
/begin MEASUREMENT vVTCTRH "RAM value vVTCTRH" UBYTE COMP_0256 1 100 -64 63.5 ECU_ADDRESS 0xFFFF1468 READ_WRITE /end MEASUREMENT
/begin MEASUREMENT vVTCTRHE "RAM value vVTCTRHE" UBYTE COMP_0256 1 100 -64 63.5 ECU_ADDRESS 0xFFFF1469 READ_WRITE /end MEASUREMENT
/begin MEASUREMENT vVTCTRHEN "RAM value vVTCTRHEN" UWORD COMP_0108_S 1 100 -16384 16383.5 ECU_ADDRESS 0xFFFF146A READ_WRITE /end MEASUREMENT
/begin MEASUREMENT vVTCTRHIN "RAM value vVTCTRHIN" UWORD COMP_0108_S 1 100 -16384 16383.5 ECU_ADDRESS 0xFFFF146C READ_WRITE /end MEASUREMENT
/begin MEASUREMENT vVTCTRL "RAM value vVTCTRL" UBYTE COMP_0256 1 100 -64 63.5 ECU_ADDRESS 0xFFFF146E READ_WRITE /end MEASUREMENT
/begin MEASUREMENT vVTCTRLE "RAM value vVTCTRLE" UBYTE COMP_0256 1 100 -64 63.5 ECU_ADDRESS 0xFFFF146F READ_WRITE /end MEASUREMENT
/begin MEASUREMENT vVTCTRLEN "RAM value vVTCTRLEN" UWORD COMP_0108_S 1 100 -16384 16383.5 ECU_ADDRESS 0xFFFF1470 READ_WRITE /end MEASUREMENT
/begin MEASUREMENT vVTCTRLIN "RAM value vVTCTRLIN" UWORD COMP_0108_S 1 100 -16384 16383.5 ECU_ADDRESS 0xFFFF1472 READ_WRITE /end MEASUREMENT
/begin MEASUREMENT vVTCTRM "RAM value vVTCTRM" UBYTE COMP_0245 1 100 -64 191 ECU_ADDRESS 0xFFFF1474 READ_WRITE /end MEASUREMENT
/begin MEASUREMENT vVTDGN3SEf "RAM value vVTDGN3SEf" UBYTE COMP_0004 1 100 0 255 ECU_ADDRESS 0xFFFF3BD8 READ_WRITE /end MEASUREMENT
/begin MEASUREMENT vVTDGN4OKf "RAM value vVTDGN4OKf" UBYTE COMP_0004 1 100 0 255 ECU_ADDRESS 0xFFFF2FBB READ_WRITE /end MEASUREMENT
/begin MEASUREMENT vVTDLYTM "RAM value vVTDLYTM" UWORD COMP_0017_S 1 100 0 655.35 ECU_ADDRESS 0xFFFF2FBC READ_WRITE /end MEASUREMENT
/begin MEASUREMENT vVTDLYTME "RAM value vVTDLYTME" UWORD COMP_0017_S 1 100 0 655.35 ECU_ADDRESS 0xFFFF2FBE READ_WRITE /end MEASUREMENT
/begin MEASUREMENT vVTEACNT1 "RAM value vVTEACNT1" UWORD COMP_0016 1 100 0 65535 ECU_ADDRESS 0xFFFF527A READ_WRITE /end MEASUREMENT
/begin MEASUREMENT vVTEATRP1 "RAM value vVTEATRP1" UWORD COMP_0016 1 100 0 65535 ECU_ADDRESS 0xFFFF527C READ_WRITE /end MEASUREMENT
/begin MEASUREMENT vVTEBCNT1 "RAM value vVTEBCNT1" UWORD COMP_0016 1 100 0 65535 ECU_ADDRESS 0xFFFF527E READ_WRITE /end MEASUREMENT
/begin MEASUREMENT vVTEBTRP1 "RAM value vVTEBTRP1" UWORD COMP_0016 1 100 0 65535 ECU_ADDRESS 0xFFFF5280 READ_WRITE /end MEASUREMENT
/begin MEASUREMENT vVTIACNT1 "RAM value vVTIACNT1" UWORD COMP_0016 1 100 0 65535 ECU_ADDRESS 0xFFFF5282 READ_WRITE /end MEASUREMENT
/begin MEASUREMENT vVTIATRP1 "RAM value vVTIATRP1" UWORD COMP_0016 1 100 0 65535 ECU_ADDRESS 0xFFFF5284 READ_WRITE /end MEASUREMENT
/begin MEASUREMENT vVTIBCNT1 "RAM value vVTIBCNT1" UWORD COMP_0016 1 100 0 65535 ECU_ADDRESS 0xFFFF5286 READ_WRITE /end MEASUREMENT
/begin MEASUREMENT vVTIBTRP1 "RAM value vVTIBTRP1" UWORD COMP_0016 1 100 0 65535 ECU_ADDRESS 0xFFFF5288 READ_WRITE /end MEASUREMENT
/begin MEASUREMENT vVTICLRAEf "RAM value vVTICLRAEf" UBYTE COMP_0004 1 100 0 255 ECU_ADDRESS 0xFFFF2FC0 READ_WRITE /end MEASUREMENT
/begin MEASUREMENT vVTIDMP1 "RAM value vVTIDMP1" UBYTE COMP_0045 1 100 0 1.9921875 ECU_ADDRESS 0xFFFF2FC1 READ_WRITE /end MEASUREMENT
/begin MEASUREMENT vVTIDMP1N "RAM value vVTIDMP1N" UWORD COMP_0456 1 100 0 1.999970916 ECU_ADDRESS 0xFFFF2FC2 READ_WRITE /end MEASUREMENT
/begin MEASUREMENT vVTIDMPE2 "RAM value vVTIDMPE2" UBYTE COMP_0045 1 100 0 1.9921875 ECU_ADDRESS 0xFFFF2FC4 READ_WRITE /end MEASUREMENT
/begin MEASUREMENT vVTIDMPI2 "RAM value vVTIDMPI2" UBYTE COMP_0045 1 100 0 1.9921875 ECU_ADDRESS 0xFFFF2FC5 READ_WRITE /end MEASUREMENT
/begin MEASUREMENT vVTINAN "RAM value vVTINAN" UWORD COMP_0048 1 100 0 32767.5 ECU_ADDRESS 0xFFFF2FC6 READ_WRITE /end MEASUREMENT
/begin MEASUREMENT vVTISTNO "RAM value vVTISTNO" UBYTE COMP_0068 1 100 0 255 ECU_ADDRESS 0xFFFF212D READ_WRITE /end MEASUREMENT
/begin MEASUREMENT vVTISTNOB "RAM value vVTISTNOB" UBYTE COMP_0068 1 100 0 255 ECU_ADDRESS 0xFFFF2FC8 READ_WRITE /end MEASUREMENT
/begin MEASUREMENT vVTMNAVE1 "RAM value vVTMNAVE1" UBYTE COMP_0046_S 1 100 0 0.99609375 ECU_ADDRESS 0xFFFF32D6 READ_WRITE /end MEASUREMENT
/begin MEASUREMENT vVTMNAVI1 "RAM value vVTMNAVI1" UBYTE COMP_0046_S 1 100 0 0.99609375 ECU_ADDRESS 0xFFFF32D7 READ_WRITE /end MEASUREMENT
/begin MEASUREMENT vVTNINT "RAM value vVTNINT" UBYTE COMP_0256 1 100 -64 63.5 ECU_ADDRESS 0xFFFF1475 READ_WRITE /end MEASUREMENT
/begin MEASUREMENT vVTNINTN "RAM value vVTNINTN" UWORD COMP_0108_S 1 100 -16384 16383.5 ECU_ADDRESS 0xFFFF1478 READ_WRITE /end MEASUREMENT
/begin MEASUREMENT vVTNINTNE "RAM value vVTNINTNE" UWORD COMP_0108_S 1 100 -16384 16383.5 ECU_ADDRESS 0xFFFF147C READ_WRITE /end MEASUREMENT
/begin MEASUREMENT vVTNWIE "RAM value vVTNWIE" UBYTE COMP_0658_S 1 100 -32 95.5 ECU_ADDRESS 0xFFFF2FC9 READ_WRITE /end MEASUREMENT
/begin MEASUREMENT vVTPAUSEEf "RAM value vVTPAUSEEf" UBYTE COMP_0004 1 100 0 255 ECU_ADDRESS 0xFFFF2FCA READ_WRITE /end MEASUREMENT
/begin MEASUREMENT vVTRDEC2 "RAM value vVTRDEC2" UBYTE COMP_0300_S 1 100 0 127.5 ECU_ADDRESS 0xFFFF2FCB READ_WRITE /end MEASUREMENT
/begin MEASUREMENT vVTRDEC2W "RAM value vVTRDEC2W" UBYTE COMP_0300_S 1 100 0 127.5 ECU_ADDRESS 0xFFFF2FCC READ_WRITE /end MEASUREMENT
/begin MEASUREMENT vVTRDECE2 "RAM value vVTRDECE2" UBYTE COMP_0300_S 1 100 0 127.5 ECU_ADDRESS 0xFFFF2FCD READ_WRITE /end MEASUREMENT
/begin MEASUREMENT vVTRGRF "RAM value vVTRGRF" UWORD COMP_0108_S 1 100 -16384 16383.5 ECU_ADDRESS 0xFFFF1480 READ_WRITE /end MEASUREMENT
/begin MEASUREMENT vVTRGRFB "RAM value vVTRGRFB" UWORD COMP_0108_S 1 100 -16384 16383.5 ECU_ADDRESS 0xFFFF1482 READ_WRITE /end MEASUREMENT
/begin MEASUREMENT vVTRGRFBE "RAM value vVTRGRFBE" UWORD COMP_0108_S 1 100 -16384 16383.5 ECU_ADDRESS 0xFFFF1484 READ_WRITE /end MEASUREMENT
/begin MEASUREMENT vVTRGRFE "RAM value vVTRGRFE" UWORD COMP_0108_S 1 100 -16384 16383.5 ECU_ADDRESS 0xFFFF1486 READ_WRITE /end MEASUREMENT
/begin MEASUREMENT vVTRINC2 "RAM value vVTRINC2" UBYTE COMP_0300_S 1 100 0 127.5 ECU_ADDRESS 0xFFFF2FCE READ_WRITE /end MEASUREMENT
/begin MEASUREMENT vVTRINC2W "RAM value vVTRINC2W" UBYTE COMP_0300_S 1 100 0 127.5 ECU_ADDRESS 0xFFFF2FCF READ_WRITE /end MEASUREMENT
/begin MEASUREMENT vVTRINCE2 "RAM value vVTRINCE2" UBYTE COMP_0300_S 1 100 0 127.5 ECU_ADDRESS 0xFFFF2FD0 READ_WRITE /end MEASUREMENT
/begin MEASUREMENT vVTTGIE "RAM value vVTTGIE" UBYTE COMP_0658_S 1 100 -32 95.5 ECU_ADDRESS 0xFFFF1488 READ_WRITE /end MEASUREMENT
/begin MEASUREMENT vVTTRDECE "RAM value vVTTRDECE" UBYTE COMP_0300_S 1 100 0 127.5 ECU_ADDRESS 0xFFFF2FD1 READ_WRITE /end MEASUREMENT
/begin MEASUREMENT vVTTRGDEC "RAM value vVTTRGDEC" UBYTE COMP_0300_S 1 100 0 127.5 ECU_ADDRESS 0xFFFF2FD2 READ_WRITE /end MEASUREMENT
/begin MEASUREMENT vVTTRGINC "RAM value vVTTRGINC" UBYTE COMP_0300_S 1 100 0 127.5 ECU_ADDRESS 0xFFFF2FD3 READ_WRITE /end MEASUREMENT
/begin MEASUREMENT vVTTRINCE "RAM value vVTTRINCE" UBYTE COMP_0300_S 1 100 0 127.5 ECU_ADDRESS 0xFFFF2FD4 READ_WRITE /end MEASUREMENT
/begin MEASUREMENT vVTVO "RAM value vVTVO" UBYTE COMP_0531 1 100 0 100.000035 ECU_ADDRESS 0xFFFF1489 READ_WRITE /end MEASUREMENT
/begin MEASUREMENT vVVTVO "RAM value vVVTVO" UWORD COMP_0130 1 100 0 1802.2125 ECU_ADDRESS 0xFFFF148A READ_WRITE /end MEASUREMENT
/begin MEASUREMENT vV_APO "RAM value vV_APO" UBYTE COMP_0425 1 100 0 99.99999981 ECU_ADDRESS 0xFFFF3940 READ_WRITE /end MEASUREMENT
/begin MEASUREMENT vV_APS_F "RAM value vV_APS_F" UBYTE COMP_0425 1 100 0 99.99999981 ECU_ADDRESS 0xFFFF16C6 READ_WRITE /end MEASUREMENT
/begin MEASUREMENT vW "RAM value vW" UBYTE COMP_0659_S 1 100 0 0.06222 ECU_ADDRESS 0xFFFF2FD5 READ_WRITE /end MEASUREMENT
/begin MEASUREMENT vWAEHB "RAM value vWAEHB" UBYTE COMP_0388 1 100 0 25.5 ECU_ADDRESS 0xFFFF2FD6 READ_WRITE /end MEASUREMENT
/begin MEASUREMENT vWALPH2 "RAM value vWALPH2" UWORD COMP_0027 1 100 0 65535 ECU_ADDRESS 0xFFFF39E2 READ_WRITE /end MEASUREMENT
/begin MEASUREMENT vWALPH3 "RAM value vWALPH3" UWORD COMP_0027 1 100 0 65535 ECU_ADDRESS 0xFFFF39E4 READ_WRITE /end MEASUREMENT
/begin MEASUREMENT vWALPH4 "RAM value vWALPH4" UWORD COMP_0027 1 100 0 65535 ECU_ADDRESS 0xFFFF39E6 READ_WRITE /end MEASUREMENT
/begin MEASUREMENT vWARMUPS "RAM value vWARMUPS" UBYTE COMP_0016 1 100 0 255 ECU_ADDRESS 0xFFFF528A READ_WRITE /end MEASUREMENT
/begin MEASUREMENT vWATEQ "RAM value vWATEQ" ULONG COMP_0489_S 1 100 0 429496.7295 ECU_ADDRESS 0xFFFF2FDC READ_WRITE /end MEASUREMENT
/begin MEASUREMENT vWDTMAX "RAM value vWDTMAX" UBYTE COMP_0030 1 100 0 255 ECU_ADDRESS 0xFFFF4E28 READ_WRITE /end MEASUREMENT
/begin MEASUREMENT vWDTNGC "RAM value vWDTNGC" UBYTE COMP_0030 1 100 0 255 ECU_ADDRESS 0xFFFF4F64 READ_WRITE /end MEASUREMENT
/begin MEASUREMENT vWDTNGCM "RAM value vWDTNGCM" UBYTE COMP_0030 1 100 0 255 ECU_ADDRESS 0xFFFF39E8 READ_WRITE /end MEASUREMENT
/begin MEASUREMENT vWETDRYJGf "RAM value vWETDRYJGf" UBYTE COMP_0004 1 100 0 255 ECU_ADDRESS 0xFFFF16CE READ_WRITE /end MEASUREMENT
/begin MEASUREMENT vWFMFCA "RAM value vWFMFCA" UBYTE COMP_0016 1 100 0 255 ECU_ADDRESS 0xFFFF32D8 READ_WRITE /end MEASUREMENT
/begin MEASUREMENT vWFMFCB "RAM value vWFMFCB" UBYTE COMP_0016 1 100 0 255 ECU_ADDRESS 0xFFFF32D9 READ_WRITE /end MEASUREMENT
/begin MEASUREMENT vWFMFCC "RAM value vWFMFCC" UBYTE COMP_0016 1 100 0 255 ECU_ADDRESS 0xFFFF32DA READ_WRITE /end MEASUREMENT
/begin MEASUREMENT vWFMFCD "RAM value vWFMFCD" UBYTE COMP_0016 1 100 0 255 ECU_ADDRESS 0xFFFF32DB READ_WRITE /end MEASUREMENT
/begin MEASUREMENT vWFMFCE "RAM value vWFMFCE" UBYTE COMP_0016 1 100 0 255 ECU_ADDRESS 0xFFFF32DC READ_WRITE /end MEASUREMENT
/begin MEASUREMENT vWFMFCF "RAM value vWFMFCF" UBYTE COMP_0016 1 100 0 255 ECU_ADDRESS 0xFFFF32DD READ_WRITE /end MEASUREMENT
/begin MEASUREMENT vWGCHI1 "RAM value vWGCHI1" UWORD COMP_0189 1 100 0 209712 ECU_ADDRESS 0xFFFF2FE0 READ_WRITE /end MEASUREMENT
/begin MEASUREMENT vWGCLO1 "RAM value vWGCLO1" UWORD COMP_0189 1 100 0 209712 ECU_ADDRESS 0xFFFF2FE2 READ_WRITE /end MEASUREMENT
/begin MEASUREMENT vWGDUTY "RAM value vWGDUTY" UWORD COMP_0316_S 1 100 0 127.99837455 ECU_ADDRESS 0xFFFF3BDA READ_WRITE /end MEASUREMENT
/begin MEASUREMENT vWGDUTY0 "RAM value vWGDUTY0" UWORD COMP_0316_S 1 100 0 127.99837455 ECU_ADDRESS 0xFFFF2FE4 READ_WRITE /end MEASUREMENT
/begin MEASUREMENT vWGROUU "RAM value vWGROUU" UWORD COMP_0338_S 1 100 0 0.007812361815 ECU_ADDRESS 0xFFFF2FE6 READ_WRITE /end MEASUREMENT
/begin MEASUREMENT vWKSTRG "RAM value vWKSTRG" ULONG COMP_0068 1 100 0 4294967295 ECU_ADDRESS 0xFFFF39EC READ_WRITE /end MEASUREMENT
/begin MEASUREMENT vWKSTRGRV "RAM value vWKSTRGRV" ULONG COMP_0068 1 100 0 4294967295 ECU_ADDRESS 0xFFFF2FE8 READ_WRITE /end MEASUREMENT
/begin MEASUREMENT vWKSTRGV "RAM value vWKSTRGV" ULONG COMP_0068 1 100 0 4294967295 ECU_ADDRESS 0xFFFF2FF0 READ_WRITE /end MEASUREMENT
/begin MEASUREMENT vWLNPMX "RAM value vWLNPMX" UWORD COMP_0039_S 1 100 60000 125535 ECU_ADDRESS 0xFFFF39F4 READ_WRITE /end MEASUREMENT
/begin MEASUREMENT vWLNPRES "RAM value vWLNPRES" UWORD COMP_0039_S 1 100 60000 125535 ECU_ADDRESS 0xFFFF39F6 READ_WRITE /end MEASUREMENT
/begin MEASUREMENT vWLNPRSR "RAM value vWLNPRSR" UWORD COMP_0039_S 1 100 60000 125535 ECU_ADDRESS 0xFFFF2FF8 READ_WRITE /end MEASUREMENT
/begin MEASUREMENT vWLNPRZ1 "RAM value vWLNPRZ1" UWORD COMP_0039_S 1 100 60000 125535 ECU_ADDRESS 0xFFFF2FFA READ_WRITE /end MEASUREMENT
/begin MEASUREMENT vWLNPRZ1W "RAM value vWLNPRZ1W" UWORD COMP_0039_S 1 100 60000 125535 ECU_ADDRESS 0xFFFF2FFC READ_WRITE /end MEASUREMENT
/begin MEASUREMENT vWLNPRZ2 "RAM value vWLNPRZ2" UWORD COMP_0039_S 1 100 60000 125535 ECU_ADDRESS 0xFFFF300A READ_WRITE /end MEASUREMENT
/begin MEASUREMENT vWLNPRZ2W "RAM value vWLNPRZ2W" UWORD COMP_0039_S 1 100 60000 125535 ECU_ADDRESS 0xFFFF300C READ_WRITE /end MEASUREMENT
/begin MEASUREMENT vWLNPTMP "RAM value vWLNPTMP" UWORD COMP_0039_S 1 100 60000 125535 ECU_ADDRESS 0xFFFF3022 READ_WRITE /end MEASUREMENT
/begin MEASUREMENT vWRCKCT1_M "RAM value vWRCKCT1_M" UBYTE COMP_0016 1 100 0 255 ECU_ADDRESS 0xFFFF3024 READ_WRITE /end MEASUREMENT
/begin MEASUREMENT vWRCKCT2_M "RAM value vWRCKCT2_M" UBYTE COMP_0016 1 100 0 255 ECU_ADDRESS 0xFFFF3025 READ_WRITE /end MEASUREMENT
/begin MEASUREMENT vWREFCNT "RAM value vWREFCNT" UBYTE COMP_0068 1 100 0 255 ECU_ADDRESS 0xFFFF1A21 READ_WRITE /end MEASUREMENT
/begin MEASUREMENT vWSPCNTAD "RAM value vWSPCNTAD" UBYTE COMP_0016 1 100 0 255 ECU_ADDRESS 0xFFFF3026 READ_WRITE /end MEASUREMENT
/begin MEASUREMENT vWSPLCNT "RAM value vWSPLCNT" UBYTE COMP_0016 1 100 0 255 ECU_ADDRESS 0xFFFF3028 READ_WRITE /end MEASUREMENT
/begin MEASUREMENT vWSPRCNT "RAM value vWSPRCNT" UBYTE COMP_0016 1 100 0 255 ECU_ADDRESS 0xFFFF3029 READ_WRITE /end MEASUREMENT
/begin MEASUREMENT vWSPRL "RAM value vWSPRL" UBYTE COMP_0016 1 100 0 255 ECU_ADDRESS 0xFFFF20DB READ_WRITE /end MEASUREMENT
/begin MEASUREMENT vWSPRR "RAM value vWSPRR" UBYTE COMP_0016 1 100 0 255 ECU_ADDRESS 0xFFFF20DC READ_WRITE /end MEASUREMENT
/begin MEASUREMENT vWSPULSET "RAM value vWSPULSET" UBYTE COMP_0014 1 100 0 2550 ECU_ADDRESS 0xFFFF39F8 READ_WRITE /end MEASUREMENT
/begin MEASUREMENT vWT2ITCH "RAM value vWT2ITCH" UBYTE COMP_0009 1 100 0 199.21875 ECU_ADDRESS 0xFFFF148C READ_WRITE /end MEASUREMENT
/begin MEASUREMENT vWT2ITCL "RAM value vWT2ITCL" UBYTE COMP_0009 1 100 0 199.21875 ECU_ADDRESS 0xFFFF148D READ_WRITE /end MEASUREMENT
/begin MEASUREMENT vWVPRSEO "RAM value vWVPRSEO" UWORD COMP_0050 1 100 0 5119.921875 ECU_ADDRESS 0xFFFF39FA READ_WRITE /end MEASUREMENT
/begin MEASUREMENT vWVPRSER "RAM value vWVPRSER" UWORD COMP_0050 1 100 0 5119.921875 ECU_ADDRESS 0xFFFF302A READ_WRITE /end MEASUREMENT
/begin MEASUREMENT vW_COM1 "RAM value vW_COM1" UWORD COMP_0068 1 100 0 65535 ECU_ADDRESS 0xFFFF39A0 READ_WRITE /end MEASUREMENT
/begin MEASUREMENT vW_COM10 "RAM value vW_COM10" UWORD COMP_0068 1 100 0 65535 ECU_ADDRESS 0xFFFF39A2 READ_WRITE /end MEASUREMENT
/begin MEASUREMENT vW_COM10BF "RAM value vW_COM10BF" UWORD COMP_0068 1 100 0 65535 ECU_ADDRESS 0xFFFF39A4 READ_WRITE /end MEASUREMENT
/begin MEASUREMENT vW_COM10EB "RAM value vW_COM10EB" UWORD COMP_0068 1 100 0 65535 ECU_ADDRESS 0xFFFF39A6 READ_WRITE /end MEASUREMENT
/begin MEASUREMENT vW_COM11 "RAM value vW_COM11" UWORD COMP_0068 1 100 0 65535 ECU_ADDRESS 0xFFFF39A8 READ_WRITE /end MEASUREMENT
/begin MEASUREMENT vW_COM11BF "RAM value vW_COM11BF" UWORD COMP_0068 1 100 0 65535 ECU_ADDRESS 0xFFFF39AA READ_WRITE /end MEASUREMENT
/begin MEASUREMENT vW_COM11EB "RAM value vW_COM11EB" UWORD COMP_0068 1 100 0 65535 ECU_ADDRESS 0xFFFF39AC READ_WRITE /end MEASUREMENT
/begin MEASUREMENT vW_COM1BF "RAM value vW_COM1BF" UWORD COMP_0068 1 100 0 65535 ECU_ADDRESS 0xFFFF39AE READ_WRITE /end MEASUREMENT
/begin MEASUREMENT vW_COM1EB "RAM value vW_COM1EB" UWORD COMP_0068 1 100 0 65535 ECU_ADDRESS 0xFFFF39B0 READ_WRITE /end MEASUREMENT
/begin MEASUREMENT vW_COM2 "RAM value vW_COM2" UWORD COMP_0068 1 100 0 65535 ECU_ADDRESS 0xFFFF39B2 READ_WRITE /end MEASUREMENT
/begin MEASUREMENT vW_COM2BF "RAM value vW_COM2BF" UWORD COMP_0068 1 100 0 65535 ECU_ADDRESS 0xFFFF39B4 READ_WRITE /end MEASUREMENT
/begin MEASUREMENT vW_COM2EB "RAM value vW_COM2EB" UWORD COMP_0068 1 100 0 65535 ECU_ADDRESS 0xFFFF39B6 READ_WRITE /end MEASUREMENT
/begin MEASUREMENT vW_COM3 "RAM value vW_COM3" UWORD COMP_0068 1 100 0 65535 ECU_ADDRESS 0xFFFF39B8 READ_WRITE /end MEASUREMENT
/begin MEASUREMENT vW_COM3BF "RAM value vW_COM3BF" UWORD COMP_0068 1 100 0 65535 ECU_ADDRESS 0xFFFF39BA READ_WRITE /end MEASUREMENT
/begin MEASUREMENT vW_COM3EB "RAM value vW_COM3EB" UWORD COMP_0068 1 100 0 65535 ECU_ADDRESS 0xFFFF39BC READ_WRITE /end MEASUREMENT
/begin MEASUREMENT vW_COM4 "RAM value vW_COM4" UWORD COMP_0068 1 100 0 65535 ECU_ADDRESS 0xFFFF39BE READ_WRITE /end MEASUREMENT
/begin MEASUREMENT vW_COM4BF "RAM value vW_COM4BF" UWORD COMP_0068 1 100 0 65535 ECU_ADDRESS 0xFFFF39C0 READ_WRITE /end MEASUREMENT
/begin MEASUREMENT vW_COM4EB "RAM value vW_COM4EB" UWORD COMP_0068 1 100 0 65535 ECU_ADDRESS 0xFFFF39C2 READ_WRITE /end MEASUREMENT
/begin MEASUREMENT vW_COM5 "RAM value vW_COM5" UWORD COMP_0068 1 100 0 65535 ECU_ADDRESS 0xFFFF39C4 READ_WRITE /end MEASUREMENT
/begin MEASUREMENT vW_COM5BF "RAM value vW_COM5BF" UWORD COMP_0068 1 100 0 65535 ECU_ADDRESS 0xFFFF39C6 READ_WRITE /end MEASUREMENT
/begin MEASUREMENT vW_COM5EB "RAM value vW_COM5EB" UWORD COMP_0068 1 100 0 65535 ECU_ADDRESS 0xFFFF39C8 READ_WRITE /end MEASUREMENT
/begin MEASUREMENT vW_COM6 "RAM value vW_COM6" UWORD COMP_0068 1 100 0 65535 ECU_ADDRESS 0xFFFF39CA READ_WRITE /end MEASUREMENT
/begin MEASUREMENT vW_COM6BF "RAM value vW_COM6BF" UWORD COMP_0068 1 100 0 65535 ECU_ADDRESS 0xFFFF39CC READ_WRITE /end MEASUREMENT
/begin MEASUREMENT vW_COM6EB "RAM value vW_COM6EB" UWORD COMP_0068 1 100 0 65535 ECU_ADDRESS 0xFFFF39CE READ_WRITE /end MEASUREMENT
/begin MEASUREMENT vW_COM7 "RAM value vW_COM7" UWORD COMP_0068 1 100 0 65535 ECU_ADDRESS 0xFFFF39D0 READ_WRITE /end MEASUREMENT
/begin MEASUREMENT vW_COM7BF "RAM value vW_COM7BF" UWORD COMP_0068 1 100 0 65535 ECU_ADDRESS 0xFFFF39D2 READ_WRITE /end MEASUREMENT
/begin MEASUREMENT vW_COM7EB "RAM value vW_COM7EB" UWORD COMP_0068 1 100 0 65535 ECU_ADDRESS 0xFFFF39D4 READ_WRITE /end MEASUREMENT
/begin MEASUREMENT vW_COM8 "RAM value vW_COM8" UWORD COMP_0068 1 100 0 65535 ECU_ADDRESS 0xFFFF39D6 READ_WRITE /end MEASUREMENT
/begin MEASUREMENT vW_COM8BF "RAM value vW_COM8BF" UWORD COMP_0068 1 100 0 65535 ECU_ADDRESS 0xFFFF39D8 READ_WRITE /end MEASUREMENT
/begin MEASUREMENT vW_COM8EB "RAM value vW_COM8EB" UWORD COMP_0068 1 100 0 65535 ECU_ADDRESS 0xFFFF39DA READ_WRITE /end MEASUREMENT
/begin MEASUREMENT vW_COM9 "RAM value vW_COM9" UWORD COMP_0068 1 100 0 65535 ECU_ADDRESS 0xFFFF39DC READ_WRITE /end MEASUREMENT
/begin MEASUREMENT vW_COM9BF "RAM value vW_COM9BF" UWORD COMP_0068 1 100 0 65535 ECU_ADDRESS 0xFFFF39DE READ_WRITE /end MEASUREMENT
/begin MEASUREMENT vW_COM9EB "RAM value vW_COM9EB" UWORD COMP_0068 1 100 0 65535 ECU_ADDRESS 0xFFFF39E0 READ_WRITE /end MEASUREMENT
/begin MEASUREMENT vX1HAT "RAM value vX1HAT" SWORD COMP_0626_S 1 100 -1966.08 1966.02 ECU_ADDRESS 0xFFFF148E READ_WRITE /end MEASUREMENT
/begin MEASUREMENT vX2HAT "RAM value vX2HAT" SWORD COMP_0626_S 1 100 -1966.08 1966.02 ECU_ADDRESS 0xFFFF1492 READ_WRITE /end MEASUREMENT
/begin MEASUREMENT vXDVADV "RAM value vXDVADV" SBYTE COMP_0018 1 100 -128 127 ECU_ADDRESS 0xFFFF4F6A READ_WRITE /end MEASUREMENT
/begin MEASUREMENT vXDVFBYA "RAM value vXDVFBYA" UWORD COMP_0217 1 100 0 3.999941832 ECU_ADDRESS 0xFFFF4E2A READ_WRITE /end MEASUREMENT
/begin MEASUREMENT vXDVKADV "RAM value vXDVKADV" SBYTE COMP_0018 1 100 -128 127 ECU_ADDRESS 0xFFFF4F6B READ_WRITE /end MEASUREMENT
/begin MEASUREMENT vXDVKTRM "RAM value vXDVKTRM" UBYTE COMP_0045 1 100 0 1.9921875 ECU_ADDRESS 0xFFFF4F65 READ_WRITE /end MEASUREMENT
/begin MEASUREMENT vXDVTIMH "RAM value vXDVTIMH" UBYTE COMP_0190 1 100 0 510 ECU_ADDRESS 0xFFFF4E2C READ_WRITE /end MEASUREMENT
/begin MEASUREMENT vXDVTIMS "RAM value vXDVTIMS" UBYTE COMP_0190 1 100 0 510 ECU_ADDRESS 0xFFFF4E2D READ_WRITE /end MEASUREMENT
/begin MEASUREMENT vXDVVTC "RAM value vXDVVTC" UBYTE COMP_0256 1 100 -64 63.5 ECU_ADDRESS 0xFFFF4E2E READ_WRITE /end MEASUREMENT
/begin MEASUREMENT vXDVVTCEN "RAM value vXDVVTCEN" UWORD COMP_0108_S 1 100 -16384 16383.5 ECU_ADDRESS 0xFFFF4E30 READ_WRITE /end MEASUREMENT
/begin MEASUREMENT vXPBAV "RAM value vXPBAV" UBYTE COMP_0068 1 100 0 255 ECU_ADDRESS 0xFFFF15A0 READ_WRITE /end MEASUREMENT
/begin MEASUREMENT vY "RAM value vY" UWORD COMP_0660_S 1 100 0 255.97971 ECU_ADDRESS 0xFFFF302C READ_WRITE /end MEASUREMENT
/begin MEASUREMENT vYKLOKf "RAM value vYKLOKf" UBYTE COMP_0004 1 100 0 255 ECU_ADDRESS 0xFFFF302E READ_WRITE /end MEASUREMENT
/begin MEASUREMENT vYUKAO2 "RAM value vYUKAO2" SLONG COMP_0263 1 100 -2147483648 2147483647 ECU_ADDRESS 0xFFFF3030 READ_WRITE /end MEASUREMENT
/begin MEASUREMENT vZIDLTW "RAM value vZIDLTW" UBYTE COMP_0186 1 100 0 3.984375 ECU_ADDRESS 0xFFFF1496 READ_WRITE /end MEASUREMENT
/begin MEASUREMENT vfAFDCST "RAM value vfAFDCST" UBYTE COMP_0068 1 100 0 255 ECU_ADDRESS 0xFFFF26E3 READ_WRITE /end MEASUREMENT
/begin MEASUREMENT vfAFDEND "RAM value vfAFDEND" UBYTE COMP_0068 1 100 0 255 ECU_ADDRESS 0xFFFF26E5 READ_WRITE /end MEASUREMENT
/begin MEASUREMENT vfAFDGNSTP "RAM value vfAFDGNSTP" UBYTE COMP_0068 1 100 0 255 ECU_ADDRESS 0xFFFF26E7 READ_WRITE /end MEASUREMENT
/begin MEASUREMENT vfCOMPFLT "RAM value vfCOMPFLT" UBYTE COMP_0068 1 100 0 255 ECU_ADDRESS 0xFFFF370B READ_WRITE /end MEASUREMENT
/begin MEASUREMENT vfDDMXPVTM "RAM value vfDDMXPVTM" UBYTE COMP_0068 1 100 0 255 ECU_ADDRESS 0xFFFF4EAF READ_WRITE /end MEASUREMENT
/begin MEASUREMENT vfFNVPG "RAM value vfFNVPG" UBYTE COMP_0068 1 100 0 255 ECU_ADDRESS 0xFFFF370D READ_WRITE /end MEASUREMENT
/begin MEASUREMENT vfHSREFUEL "RAM value vfHSREFUEL" UBYTE COMP_0068 1 100 0 255 ECU_ADDRESS 0xFFFF3715 READ_WRITE /end MEASUREMENT
/begin MEASUREMENT vfLJUDGEE "RAM value vfLJUDGEE" UBYTE COMP_0283 1 100 0 255 ECU_ADDRESS 0xFFFF3B5D READ_WRITE /end MEASUREMENT
/begin MEASUREMENT vfLJUGEZ "RAM value vfLJUGEZ" UBYTE COMP_0283 1 100 0 255 ECU_ADDRESS 0xFFFF3718 READ_WRITE /end MEASUREMENT
/begin MEASUREMENT vfLRDNG "RAM value vfLRDNG" UBYTE COMP_0068 1 100 0 255 ECU_ADDRESS 0xFFFF274C READ_WRITE /end MEASUREMENT
/begin MEASUREMENT vfLRDOK "RAM value vfLRDOK" UBYTE COMP_0068 1 100 0 255 ECU_ADDRESS 0xFFFF274E READ_WRITE /end MEASUREMENT
/begin MEASUREMENT vfLSREFUEL "RAM value vfLSREFUEL" UBYTE COMP_0068 1 100 0 255 ECU_ADDRESS 0xFFFF371A READ_WRITE /end MEASUREMENT
/begin MEASUREMENT vfRFLJOK "RAM value vfRFLJOK" UBYTE COMP_0068 1 100 0 255 ECU_ADDRESS 0xFFFF3733 READ_WRITE /end MEASUREMENT
/begin MEASUREMENT vfRJUDGEE "RAM value vfRJUDGEE" UBYTE COMP_0283 1 100 0 255 ECU_ADDRESS 0xFFFF3B61 READ_WRITE /end MEASUREMENT
/begin MEASUREMENT vfRJUGEZ "RAM value vfRJUGEZ" UBYTE COMP_0283 1 100 0 255 ECU_ADDRESS 0xFFFF3734 READ_WRITE /end MEASUREMENT
/begin MEASUREMENT vfRLDNG "RAM value vfRLDNG" UBYTE COMP_0068 1 100 0 255 ECU_ADDRESS 0xFFFF2755 READ_WRITE /end MEASUREMENT
/begin MEASUREMENT vfRLDOK "RAM value vfRLDOK" UBYTE COMP_0068 1 100 0 255 ECU_ADDRESS 0xFFFF2757 READ_WRITE /end MEASUREMENT
/begin MEASUREMENT vfTIMING "RAM value vfTIMING" UBYTE COMP_0068 1 100 0 255 ECU_ADDRESS 0xFFFF3736 READ_WRITE /end MEASUREMENT
/begin MEASUREMENT vfVPGS "RAM value vfVPGS" UBYTE COMP_0068 1 100 0 255 ECU_ADDRESS 0xFFFF3737 READ_WRITE /end MEASUREMENT
/begin MEASUREMENT vmessage_p "RAM value vmessage_p" UBYTE COMP_0004 1 100 0 255 ECU_ADDRESS 0xFFFF2972 READ_WRITE /end MEASUREMENT
/begin MEASUREMENT vtCLPTMR "RAM value vtCLPTMR" UWORD COMP_0014 1 100 0 655350 ECU_ADDRESS 0xFFFF2CB0 READ_WRITE /end MEASUREMENT
/begin MEASUREMENT vtCLPTMR2 "RAM value vtCLPTMR2" UWORD COMP_0014 1 100 0 655350 ECU_ADDRESS 0xFFFF2CB2 READ_WRITE /end MEASUREMENT
/begin MEASUREMENT vtJISOTMR "RAM value vtJISOTMR" UWORD COMP_0014 1 100 0 655350 ECU_ADDRESS 0xFFFF2D60 READ_WRITE /end MEASUREMENT
/begin MEASUREMENT vtTGTIME "RAM value vtTGTIME" UWORD COMP_0017_S 1 100 0 655.35 ECU_ADDRESS 0xFFFF2EC4 READ_WRITE /end MEASUREMENT
/begin MEASUREMENT vtTROINTL "RAM value vtTROINTL" UWORD COMP_0014 1 100 0 655350 ECU_ADDRESS 0xFFFF2ED0 READ_WRITE /end MEASUREMENT
/begin MEASUREMENT vtTROINTR "RAM value vtTROINTR" UWORD COMP_0014 1 100 0 655350 ECU_ADDRESS 0xFFFF2ED4 READ_WRITE /end MEASUREMENT
/begin MEASUREMENT vtfbya0 "RAM value vtfbya0" UWORD COMP_0217 1 100 0 3.999941832 ECU_ADDRESS 0xFFFF0FA8 READ_WRITE /end MEASUREMENT
/begin MEASUREMENT wvAADNV2 "RAM value wvAADNV2" UWORD COMP_0661_S 1 100 0 0.000005950578 ECU_ADDRESS 0xFFFF0864 READ_WRITE /end MEASUREMENT
/begin MEASUREMENT wvADAFSF "RAM value wvADAFSF" UWORD COMP_0023 1 100 0 327675 ECU_ADDRESS 0xFFFF0800 READ_WRITE /end MEASUREMENT
/begin MEASUREMENT wvADNVQL "RAM value wvADNVQL" UWORD COMP_0028_S 1 100 0 2.5599609375E-06 ECU_ADDRESS 0xFFFF1E78 READ_WRITE /end MEASUREMENT
/begin MEASUREMENT wvADO2R "RAM value wvADO2R" UWORD COMP_0023 1 100 0 327675 ECU_ADDRESS 0xFFFF1E7A READ_WRITE /end MEASUREMENT
/begin MEASUREMENT wvADOPS "RAM value wvADOPS" UWORD COMP_0023 1 100 0 327675 ECU_ADDRESS 0xFFFF1DB0 READ_WRITE /end MEASUREMENT
/begin MEASUREMENT wvADPDPRES "RAM value wvADPDPRES" UWORD COMP_0023 1 100 0 327675 ECU_ADDRESS 0xFFFF1DB2 READ_WRITE /end MEASUREMENT
/begin MEASUREMENT wvADTF "RAM value wvADTF" UWORD COMP_0023 1 100 0 327675 ECU_ADDRESS 0xFFFF1DB4 READ_WRITE /end MEASUREMENT
/begin MEASUREMENT wvADV "RAM value wvADV" SBYTE COMP_0018 1 100 -128 127 ECU_ADDRESS 0xFFFF0914 READ_WRITE /end MEASUREMENT
/begin MEASUREMENT wvADVHOS "RAM value wvADVHOS" SWORD COMP_0018 1 100 -32768 32767 ECU_ADDRESS 0xFFFF0916 READ_WRITE /end MEASUREMENT
/begin MEASUREMENT wvADVHOSAT "RAM value wvADVHOSAT" SWORD COMP_0018 1 100 -32768 32767 ECU_ADDRESS 0xFFFF0918 READ_WRITE /end MEASUREMENT
/begin MEASUREMENT wvADVKIR "RAM value wvADVKIR" UBYTE COMP_0245 1 100 -64 191 ECU_ADDRESS 0xFFFF20E8 READ_WRITE /end MEASUREMENT
/begin MEASUREMENT wvADVO2R "RAM value wvADVO2R" UWORD COMP_0023 1 100 0 327675 ECU_ADDRESS 0xFFFF1DB6 READ_WRITE /end MEASUREMENT
/begin MEASUREMENT wvADVTCME1 "RAM value wvADVTCME1" UWORD COMP_0023 1 100 0 327675 ECU_ADDRESS 0xFFFF1DC8 READ_WRITE /end MEASUREMENT
/begin MEASUREMENT wvADVTCMI1 "RAM value wvADVTCMI1" UWORD COMP_0023 1 100 0 327675 ECU_ADDRESS 0xFFFF1DCA READ_WRITE /end MEASUREMENT
/begin MEASUREMENT wvADVTENG "RAM value wvADVTENG" SBYTE COMP_0018 1 100 -128 127 ECU_ADDRESS 0xFFFF091A READ_WRITE /end MEASUREMENT
/begin MEASUREMENT wvAFHMODEf "RAM value wvAFHMODEf" UBYTE COMP_0068 1 100 0 255 ECU_ADDRESS 0xFFFF1E7E READ_WRITE /end MEASUREMENT
/begin MEASUREMENT wvAFHONf "RAM value wvAFHONf" UBYTE COMP_0068 1 100 0 255 ECU_ADDRESS 0xFFFF1E7F READ_WRITE /end MEASUREMENT
/begin MEASUREMENT wvAFS "RAM value wvAFS" UWORD COMP_0023 1 100 0 327675 ECU_ADDRESS 0xFFFF1E80 READ_WRITE /end MEASUREMENT
/begin MEASUREMENT wvAFSHDTY "RAM value wvAFSHDTY" UWORD COMP_0419 1 100 0 6553.5 ECU_ADDRESS 0xFFFF1E84 READ_WRITE /end MEASUREMENT
/begin MEASUREMENT wvAGBDLCLK "RAM value wvAGBDLCLK" UBYTE COMP_0068 1 100 0 255 ECU_ADDRESS 0xFFFF1E88 READ_WRITE /end MEASUREMENT
/begin MEASUREMENT wvAM1DATA2 "RAM value wvAM1DATA2" UBYTE COMP_0068 1 100 0 255 ECU_ADDRESS 0xFFFF1E89 READ_WRITE /end MEASUREMENT
/begin MEASUREMENT wvAM1DATA2_1 "RAM value wvAM1DATA2" UBYTE COMP_0068 1 100 0 255 ECU_ADDRESS 0xFFFF1E8A READ_WRITE /end MEASUREMENT
/begin MEASUREMENT wvAM1DATA3_2 "RAM value wvAM1DATA3" UBYTE COMP_0068 1 100 0 255 ECU_ADDRESS 0xFFFF1E8B READ_WRITE /end MEASUREMENT
/begin MEASUREMENT wvAM1DATA3_1 "RAM value wvAM1DATA3" UBYTE COMP_0068 1 100 0 255 ECU_ADDRESS 0xFFFF1E8C READ_WRITE /end MEASUREMENT
/begin MEASUREMENT wvAM1DATA3 "RAM value wvAM1DATA3" UBYTE COMP_0068 1 100 0 255 ECU_ADDRESS 0xFFFF1E8D READ_WRITE /end MEASUREMENT
/begin MEASUREMENT wvAM1DATA4_2 "RAM value wvAM1DATA4" UBYTE COMP_0068 1 100 0 255 ECU_ADDRESS 0xFFFF1E8E READ_WRITE /end MEASUREMENT
/begin MEASUREMENT wvAM1DATA4_1 "RAM value wvAM1DATA4" UBYTE COMP_0068 1 100 0 255 ECU_ADDRESS 0xFFFF1E8F READ_WRITE /end MEASUREMENT
/begin MEASUREMENT wvAM1DATA4 "RAM value wvAM1DATA4" UBYTE COMP_0068 1 100 0 255 ECU_ADDRESS 0xFFFF1E90 READ_WRITE /end MEASUREMENT
/begin MEASUREMENT wvAPO "RAM value wvAPO" UWORD COMP_0005 1 100 0 7208.85 ECU_ADDRESS 0xFFFF1E5A READ_WRITE /end MEASUREMENT
/begin MEASUREMENT wvAPO1 "RAM value wvAPO1" UWORD COMP_0005 1 100 0 7208.85 ECU_ADDRESS 0xFFFF1E92 READ_WRITE /end MEASUREMENT
/begin MEASUREMENT wvAPO2 "RAM value wvAPO2" UWORD COMP_0005 1 100 0 7208.85 ECU_ADDRESS 0xFFFF1E94 READ_WRITE /end MEASUREMENT
/begin MEASUREMENT wvAPOFS "RAM value wvAPOFS" UWORD COMP_0005 1 100 0 7208.85 ECU_ADDRESS 0xFFFF1E96 READ_WRITE /end MEASUREMENT
/begin MEASUREMENT wvAPOFSR "RAM value wvAPOFSR" UWORD COMP_0032_S 1 100 0 8191.875 ECU_ADDRESS 0xFFFF1E98 READ_WRITE /end MEASUREMENT
/begin MEASUREMENT wvAPOFSR_S "RAM value wvAPOFSR_S" UWORD COMP_0032_S 1 100 0 8191.875 ECU_ADDRESS 0xFFFF1FAA READ_WRITE /end MEASUREMENT
/begin MEASUREMENT wvAPOK "RAM value wvAPOK" UBYTE COMP_0002 1 100 0 89.25 ECU_ADDRESS 0xFFFF1E9A READ_WRITE /end MEASUREMENT
/begin MEASUREMENT wvAPOK30 "RAM value wvAPOK30" UBYTE COMP_0127 1 100 -44.8 44.45 ECU_ADDRESS 0xFFFF1E9B READ_WRITE /end MEASUREMENT
/begin MEASUREMENT wvAPOz5 "RAM value wvAPOz5" UWORD COMP_0005 1 100 0 7208.85 ECU_ADDRESS 0xFFFF1E9C READ_WRITE /end MEASUREMENT
/begin MEASUREMENT wvAPS1OF "RAM value wvAPS1OF" SWORD COMP_0377 1 100 -3604.48 3604.37 ECU_ADDRESS 0xFFFF1E9E READ_WRITE /end MEASUREMENT
/begin MEASUREMENT wvAPS1V "RAM value wvAPS1V" UWORD COMP_0061 1 100 0 327675 ECU_ADDRESS 0xFFFF1EA0 READ_WRITE /end MEASUREMENT
/begin MEASUREMENT wvAPS2OF "RAM value wvAPS2OF" SWORD COMP_0377 1 100 -3604.48 3604.37 ECU_ADDRESS 0xFFFF1EA2 READ_WRITE /end MEASUREMENT
/begin MEASUREMENT wvAPS2V "RAM value wvAPS2V" UWORD COMP_0061 1 100 0 327675 ECU_ADDRESS 0xFFFF1EA4 READ_WRITE /end MEASUREMENT
/begin MEASUREMENT wvASCMODE "RAM value wvASCMODE" UBYTE COMP_0068 1 100 0 255 ECU_ADDRESS 0xFFFF1EA6 READ_WRITE /end MEASUREMENT
/begin MEASUREMENT wvATMPRS "RAM value wvATMPRS" UWORD COMP_0039_S 1 100 60000 125535 ECU_ADDRESS 0xFFFF1EA8 READ_WRITE /end MEASUREMENT
/begin MEASUREMENT wvATMSG1T "RAM value wvATMSG1T" UBYTE COMP_0014 1 100 0 2550 ECU_ADDRESS 0xFFFF1EAA READ_WRITE /end MEASUREMENT
/begin MEASUREMENT wvATMSG2T "RAM value wvATMSG2T" UBYTE COMP_0014 1 100 0 2550 ECU_ADDRESS 0xFFFF1EAB READ_WRITE /end MEASUREMENT
/begin MEASUREMENT wvATPO "RAM value wvATPO" UWORD COMP_0042 1 100 0 52.428 ECU_ADDRESS 0xFFFF1EAC READ_WRITE /end MEASUREMENT
/begin MEASUREMENT wvATRNG "RAM value wvATRNG" UBYTE COMP_0068 1 100 0 255 ECU_ADDRESS 0xFFFF1E50 READ_WRITE /end MEASUREMENT
/begin MEASUREMENT wvATTEMP "RAM value wvATTEMP" UBYTE COMP_0041_S 1 100 0 255 ECU_ADDRESS 0xFFFF1EAE READ_WRITE /end MEASUREMENT
/begin MEASUREMENT wvATTQCT1T "RAM value wvATTQCT1T" UBYTE COMP_0014 1 100 0 2550 ECU_ADDRESS 0xFFFF1EAF READ_WRITE /end MEASUREMENT
/begin MEASUREMENT wvATTQCT2T "RAM value wvATTQCT2T" UBYTE COMP_0014 1 100 0 2550 ECU_ADDRESS 0xFFFF1EB0 READ_WRITE /end MEASUREMENT
/begin MEASUREMENT wvATTQN1T "RAM value wvATTQN1T" UBYTE COMP_0014 1 100 0 2550 ECU_ADDRESS 0xFFFF1EB1 READ_WRITE /end MEASUREMENT
/begin MEASUREMENT wvAUHCDCV1 "RAM value wvAUHCDCV1" UBYTE COMP_0068 1 100 0 255 ECU_ADDRESS 0xFFFF0866 READ_WRITE /end MEASUREMENT
/begin MEASUREMENT wvAUHCDCV2 "RAM value wvAUHCDCV2" UBYTE COMP_0068 1 100 0 255 ECU_ADDRESS 0xFFFF0867 READ_WRITE /end MEASUREMENT
/begin MEASUREMENT wvAUHSTRLY "RAM value wvAUHSTRLY" UBYTE COMP_0068 1 100 0 255 ECU_ADDRESS 0xFFFF0868 READ_WRITE /end MEASUREMENT
/begin MEASUREMENT wvAUHWGC1 "RAM value wvAUHWGC1" UBYTE COMP_0068 1 100 0 255 ECU_ADDRESS 0xFFFF0869 READ_WRITE /end MEASUREMENT
/begin MEASUREMENT wvAUHWGC2 "RAM value wvAUHWGC2" UBYTE COMP_0068 1 100 0 255 ECU_ADDRESS 0xFFFF086A READ_WRITE /end MEASUREMENT
/begin MEASUREMENT wvAVCC "RAM value wvAVCC" UBYTE COMP_0118 1 100 0 10200 ECU_ADDRESS 0xFFFF1EB2 READ_WRITE /end MEASUREMENT
/begin MEASUREMENT wvAVEPF "RAM value wvAVEPF" UWORD COMP_0164 1 100 0 19.988175 ECU_ADDRESS 0xFFFF1DCC READ_WRITE /end MEASUREMENT
/begin MEASUREMENT wvAVGAFH "RAM value wvAVGAFH" UWORD COMP_0023 1 100 0 327675 ECU_ADDRESS 0xFFFF1EB4 READ_WRITE /end MEASUREMENT
/begin MEASUREMENT wvAVJPHOSR "RAM value wvAVJPHOSR" SBYTE COMP_0018 1 100 -128 127 ECU_ADDRESS 0xFFFF091B READ_WRITE /end MEASUREMENT
/begin MEASUREMENT wvAVPDACON "RAM value wvAVPDACON" UWORD COMP_0010 1 100 0 196.605 ECU_ADDRESS 0xFFFF086C READ_WRITE /end MEASUREMENT
/begin MEASUREMENT wvBATATMS "RAM value wvBATATMS" UBYTE COMP_0035 1 100 -50 205 ECU_ADDRESS 0xFFFF1EB6 READ_WRITE /end MEASUREMENT
/begin MEASUREMENT wvBATCURK "RAM value wvBATCURK" UWORD COMP_0505_S 1 100 -128 127.99609375 ECU_ADDRESS 0xFFFF1EB8 READ_WRITE /end MEASUREMENT
/begin MEASUREMENT wvBATCURK2 "RAM value wvBATCURK2" UWORD COMP_0495_S 1 100 -327.68 327.67 ECU_ADDRESS 0xFFFF1EBA READ_WRITE /end MEASUREMENT
/begin MEASUREMENT wvBATSEN "RAM value wvBATSEN" UWORD COMP_0023 1 100 0 327675 ECU_ADDRESS 0xFFFF1EBC READ_WRITE /end MEASUREMENT
/begin MEASUREMENT wvBATSENK "RAM value wvBATSENK" UWORD COMP_0023 1 100 0 327675 ECU_ADDRESS 0xFFFF1EBE READ_WRITE /end MEASUREMENT
/begin MEASUREMENT wvBCMSCT "RAM value wvBCMSCT" UBYTE COMP_0014 1 100 0 2550 ECU_ADDRESS 0xFFFF1EC0 READ_WRITE /end MEASUREMENT
/begin MEASUREMENT wvBLFANVLT "RAM value wvBLFANVLT" UBYTE COMP_0050_S 1 100 0 127.5 ECU_ADDRESS 0xFFFF1EC1 READ_WRITE /end MEASUREMENT
/begin MEASUREMENT wvBRKGNLDT "RAM value wvBRKGNLDT" UBYTE COMP_0014 1 100 0 2550 ECU_ADDRESS 0xFFFF1EC2 READ_WRITE /end MEASUREMENT
/begin MEASUREMENT wvBRSTBCTT "RAM value wvBRSTBCTT" UBYTE COMP_0014 1 100 0 2550 ECU_ADDRESS 0xFFFF1EC3 READ_WRITE /end MEASUREMENT
/begin MEASUREMENT wvBTSEN "RAM value wvBTSEN" UBYTE COMP_0054 1 100 0 5100 ECU_ADDRESS 0xFFFF1EC4 READ_WRITE /end MEASUREMENT
/begin MEASUREMENT wvCA10MS "RAM value wvCA10MS" UBYTE COMP_0017 1 100 0 255 ECU_ADDRESS 0xFFFF086E READ_WRITE /end MEASUREMENT
/begin MEASUREMENT wvCATRESIM "RAM value wvCATRESIM" UBYTE COMP_0019_S 1 100 0 1.000000095 ECU_ADDRESS 0xFFFF20E9 READ_WRITE /end MEASUREMENT
/begin MEASUREMENT wvCATRESIU "RAM value wvCATRESIU" UBYTE COMP_0019_S 1 100 0 1.000000095 ECU_ADDRESS 0xFFFF20EA READ_WRITE /end MEASUREMENT
/begin MEASUREMENT wvCCPWTSP "RAM value wvCCPWTSP" UWORD COMP_0032_S 1 100 0 8191.875 ECU_ADDRESS 0xFFFF0870 READ_WRITE /end MEASUREMENT
/begin MEASUREMENT wvCLRDIST "RAM value wvCLRDIST" ULONG COMP_0389 1 100 0 1685624.33943218 ECU_ADDRESS 0xFFFF43C8 READ_WRITE /end MEASUREMENT
/begin MEASUREMENT wvCLSBA1T "RAM value wvCLSBA1T" UBYTE COMP_0014 1 100 0 2550 ECU_ADDRESS 0xFFFF1EC5 READ_WRITE /end MEASUREMENT
/begin MEASUREMENT wvCLSBA2T "RAM value wvCLSBA2T" UBYTE COMP_0014 1 100 0 2550 ECU_ADDRESS 0xFFFF1EC6 READ_WRITE /end MEASUREMENT
/begin MEASUREMENT wvCNTRIP "RAM value wvCNTRIP" ULONG COMP_0389 1 100 0 1685624.33943218 ECU_ADDRESS 0xFFFF43CC READ_WRITE /end MEASUREMENT
/begin MEASUREMENT wvCONTCSM "RAM value wvCONTCSM" UBYTE COMP_0014 1 100 0 2550 ECU_ADDRESS 0xFFFF1EC7 READ_WRITE /end MEASUREMENT
/begin MEASUREMENT wvCURGP "RAM value wvCURGP" UBYTE COMP_0068 1 100 0 255 ECU_ADDRESS 0xFFFF085C READ_WRITE /end MEASUREMENT
/begin MEASUREMENT wvCURGP0 "RAM value wvCURGP0" UBYTE COMP_0068 1 100 0 255 ECU_ADDRESS 0xFFFF1EEB READ_WRITE /end MEASUREMENT
/begin MEASUREMENT wvCURGPV "RAM value wvCURGPV" UBYTE COMP_0068 1 100 0 255 ECU_ADDRESS 0xFFFF0844 READ_WRITE /end MEASUREMENT
/begin MEASUREMENT wvCVTCCHKf "RAM value wvCVTCCHKf" UBYTE COMP_0004 1 100 0 255 ECU_ADDRESS 0xFFFF1EEC READ_WRITE /end MEASUREMENT
/begin MEASUREMENT wvCVTCECHK "RAM value wvCVTCECHK" UBYTE COMP_0068 1 100 0 255 ECU_ADDRESS 0xFFFF1EED READ_WRITE /end MEASUREMENT
/begin MEASUREMENT wvCVTFLEVL "RAM value wvCVTFLEVL" UBYTE COMP_0068 1 100 0 255 ECU_ADDRESS 0xFFFF1EEE READ_WRITE /end MEASUREMENT
/begin MEASUREMENT wvCVTIUPRQ "RAM value wvCVTIUPRQ" UBYTE COMP_0006 1 100 0 3187.5 ECU_ADDRESS 0xFFFF0872 READ_WRITE /end MEASUREMENT
/begin MEASUREMENT wvCVTMSG1T "RAM value wvCVTMSG1T" UBYTE COMP_0014 1 100 0 2550 ECU_ADDRESS 0xFFFF1EEF READ_WRITE /end MEASUREMENT
/begin MEASUREMENT wvCVTMSG2T "RAM value wvCVTMSG2T" UBYTE COMP_0014 1 100 0 2550 ECU_ADDRESS 0xFFFF1EF0 READ_WRITE /end MEASUREMENT
/begin MEASUREMENT wvCVTMSG3T "RAM value wvCVTMSG3T" UBYTE COMP_0014 1 100 0 2550 ECU_ADDRESS 0xFFFF1EF1 READ_WRITE /end MEASUREMENT
/begin MEASUREMENT wvCVTRNG "RAM value wvCVTRNG" UBYTE COMP_0068 1 100 0 255 ECU_ADDRESS 0xFFFF1EF2 READ_WRITE /end MEASUREMENT
/begin MEASUREMENT wvCYLCNT "RAM value wvCYLCNT" UBYTE COMP_0068 1 100 0 255 ECU_ADDRESS 0xFFFF091C READ_WRITE /end MEASUREMENT
/begin MEASUREMENT wvDELTF "RAM value wvDELTF" UBYTE COMP_0035 1 100 -50 205 ECU_ADDRESS 0xFFFF43D0 READ_WRITE /end MEASUREMENT
/begin MEASUREMENT wvDEVATMP "RAM value wvDEVATMP" UBYTE COMP_0156_S 1 100 0 84.999999915 ECU_ADDRESS 0xFFFF1EF3 READ_WRITE /end MEASUREMENT
/begin MEASUREMENT wvDLTAPOFS "RAM value wvDLTAPOFS" UWORD COMP_0529_S 1 100 0 7208.85 ECU_ADDRESS 0xFFFF0874 READ_WRITE /end MEASUREMENT
/begin MEASUREMENT wvDLTMN "RAM value wvDLTMN" UBYTE COMP_0000 1 100 0 6375 ECU_ADDRESS 0xFFFF091D READ_WRITE /end MEASUREMENT
/begin MEASUREMENT wvDLTN1 "RAM value wvDLTN1" UBYTE COMP_0070 1 100 0 3187.5 ECU_ADDRESS 0xFFFF1EF4 READ_WRITE /end MEASUREMENT
/begin MEASUREMENT wvDLTNE "RAM value wvDLTNE" UBYTE COMP_0006 1 100 0 3187.5 ECU_ADDRESS 0xFFFF0876 READ_WRITE /end MEASUREMENT
/begin MEASUREMENT wvDLTOUTR "RAM value wvDLTOUTR" UWORD COMP_0082_S 1 100 0 65535 ECU_ADDRESS 0xFFFF0878 READ_WRITE /end MEASUREMENT
/begin MEASUREMENT wvDLTTP "RAM value wvDLTTP" UBYTE COMP_0124 1 100 0 31.875 ECU_ADDRESS 0xFFFF1EF5 READ_WRITE /end MEASUREMENT
/begin MEASUREMENT wvDLTV100 "RAM value wvDLTV100" UBYTE COMP_0532_S 1 100 0 89.25 ECU_ADDRESS 0xFFFF1EF6 READ_WRITE /end MEASUREMENT
/begin MEASUREMENT wvDLTVS2 "RAM value wvDLTVS2" UBYTE COMP_0229 1 100 -256 254 ECU_ADDRESS 0xFFFF1EF7 READ_WRITE /end MEASUREMENT
/begin MEASUREMENT wvDLTVSP "RAM value wvDLTVSP" UBYTE COMP_0007 1 100 0 510 ECU_ADDRESS 0xFFFF1EF8 READ_WRITE /end MEASUREMENT
/begin MEASUREMENT wvDNE019 "RAM value wvDNE019" SBYTE COMP_0533_S 1 100 -25 24.8046875 ECU_ADDRESS 0xFFFF20E3 READ_WRITE /end MEASUREMENT
/* COMPU_METHOD --------------------------------------------------------- */
/begin COMPU_METHOD COMP_0017 "1deg" RAT_FUNC "%8.2" "deg" COEFFS 0 1 0 0 0 1 /end COMPU_METHOD
/begin COMPU_METHOD COMP_0004 "1－" RAT_FUNC "%8.2" "－" COEFFS 0 1 0 0 0 1 /end COMPU_METHOD
/begin COMPU_METHOD COMP_0068 "1-" RAT_FUNC "%8.2" "-" COEFFS 0 1 0 0 0 1 /end COMPU_METHOD
/begin COMPU_METHOD COMP_0002_S "1Pa" RAT_FUNC "%8.2" "Pa" COEFFS 0 1 0 0 0 1 /end COMPU_METHOD
/begin COMPU_METHOD COMP_0013 "1s" RAT_FUNC "%8.2" "s" COEFFS 0 1 0 0 0 1 /end COMPU_METHOD
/begin COMPU_METHOD COMP_0238 "100/128%" RAT_FUNC "%8.2" "%" COEFFS 0 1 0 0 0 0.78125 /end COMPU_METHOD
/begin COMPU_METHOD COMP_0014 "10ms" RAT_FUNC "%8.2" "ms" COEFFS 0 1 0 0 0 10 /end COMPU_METHOD
/begin COMPU_METHOD COMP_0045 "1/128-" RAT_FUNC "%8.4" "-" COEFFS 0 1 0 0 0 0.0078125 /end COMPU_METHOD
/begin COMPU_METHOD COMP_0009 "100/128%" RAT_FUNC "%8.2" "%" COEFFS 0 1 0 0 0 0.78125 /end COMPU_METHOD
/begin COMPU_METHOD COMP_0000 "25rpm" RAT_FUNC "%8.2" "rpm" COEFFS 0 1 0 0 0 25 /end COMPU_METHOD
/begin COMPU_METHOD COMP_0186 "1/64-" RAT_FUNC "%8.3" "-" COEFFS 0 1 0 0 0 0.015625 /end COMPU_METHOD
/begin COMPU_METHOD COMP_0001 "1/8ms" RAT_FUNC "%8.2" "ms" COEFFS 0 1 0 0 0 0.125 /end COMPU_METHOD
/begin COMPU_METHOD COMP_0388 "0.1-" RAT_FUNC "%8.2" "-" COEFFS 0 1 0 0 0 0.1 /end COMPU_METHOD
/begin COMPU_METHOD COMP_0002 "0.35deg" RAT_FUNC "%8.2" "deg" COEFFS 0 1 0 0 0 0.35 /end COMPU_METHOD
/begin COMPU_METHOD COMP_0035 "X-50℃" RAT_FUNC "%8.2" "℃" COEFFS 0 1 50 0 0 1 /end COMPU_METHOD
/begin COMPU_METHOD COMP_0005 "0.11deg" RAT_FUNC "%8.2" "deg" COEFFS 0 1 0 0 0 0.11 /end COMPU_METHOD
/begin COMPU_METHOD COMP_0006 "12.5rpm" RAT_FUNC "%8.2" "rpm" COEFFS 0 1 0 0 0 12.5 /end COMPU_METHOD
/begin COMPU_METHOD COMP_0008 "100ms" RAT_FUNC "%8.2" "ms" COEFFS 0 1 0 0 0 100 /end COMPU_METHOD
/begin COMPU_METHOD COMP_0010 "0.003MPa" RAT_FUNC "%8.4" "MPa" COEFFS 0 1 0 0 0 0.003 /end COMPU_METHOD
/begin COMPU_METHOD COMP_0007 "2km/h" RAT_FUNC "%8.2" "km/h" COEFFS 0 1 0 0 0 2 /end COMPU_METHOD
/begin COMPU_METHOD COMP_0018 "1deg" RAT_FUNC "%8.2" "deg" COEFFS 0 1 0 0 0 1 /end COMPU_METHOD
/begin COMPU_METHOD COMP_0081 "1/256deg" RAT_FUNC "%8.4" "deg" COEFFS 0 1 0 0 0 0.00390625 /end COMPU_METHOD
/begin COMPU_METHOD COMP_0217 "1/16384-" RAT_FUNC "%8.6" "-" COEFFS 0 1 0 0 0 0.0000610352 /end COMPU_METHOD
/begin COMPU_METHOD COMP_0023 "5mV" RAT_FUNC "%8.2" "mV" COEFFS 0 1 0 0 0 5 /end COMPU_METHOD
/begin COMPU_METHOD COMP_0033 "80mV" RAT_FUNC "%8.2" "mV" COEFFS 0 1 0 0 0 80 /end COMPU_METHOD
/begin COMPU_METHOD COMP_0027 "1%" RAT_FUNC "%8.2" "%" COEFFS 0 1 0 0 0 1 /end COMPU_METHOD
/begin COMPU_METHOD COMP_0017_S "0.01sec" RAT_FUNC "%8.3" "sec" COEFFS 0 1 0 0 0 0.01 /end COMPU_METHOD
/begin COMPU_METHOD COMP_0061 "5mv" RAT_FUNC "%8.2" "mv" COEFFS 0 1 0 0 0 5 /end COMPU_METHOD
/begin COMPU_METHOD COMP_0049 "1sec" RAT_FUNC "%8.2" "sec" COEFFS 0 1 0 0 0 1 /end COMPU_METHOD
/begin COMPU_METHOD COMP_0032 "1/256－" RAT_FUNC "%8.4" "－" COEFFS 0 1 0 0 0 0.00390625 /end COMPU_METHOD
/begin COMPU_METHOD COMP_0018_S "0.5/256-" RAT_FUNC "%8.4" "-" COEFFS 0 1 0 0 0 0.001953125 /end COMPU_METHOD
/begin COMPU_METHOD COMP_0063 "1/256-" RAT_FUNC "%8.4" "-" COEFFS 0 1 0 0 0 0.00390625 /end COMPU_METHOD
/begin COMPU_METHOD COMP_0370 "2.5mv" RAT_FUNC "%8.2" "mv" COEFFS 0 1 0 0 0 2.5 /end COMPU_METHOD
/begin COMPU_METHOD COMP_0019_S "1/255-" RAT_FUNC "%8.4" "-" COEFFS 0 1 0 0 0 0.003921569 /end COMPU_METHOD
/begin COMPU_METHOD COMP_0030 "1回" RAT_FUNC "%8.2" "回" COEFFS 0 1 0 0 0 1 /end COMPU_METHOD
/begin COMPU_METHOD COMP_0020_S "0.002-" RAT_FUNC "%8.4" "-" COEFFS 0 1 0 0 0 0.002 /end COMPU_METHOD
/begin COMPU_METHOD COMP_0016 "1count" RAT_FUNC "%8.2" "count" COEFFS 0 1 0 0 0 1 /end COMPU_METHOD
/begin COMPU_METHOD COMP_0202 "10msec" RAT_FUNC "%8.2" "msec" COEFFS 0 1 0 0 0 10 /end COMPU_METHOD
/begin COMPU_METHOD COMP_0443 "1rpm" RAT_FUNC "%8.2" "rpm" COEFFS 0 1 0 0 0 1 /end COMPU_METHOD
/begin COMPU_METHOD COMP_0228 "0.1Nm" RAT_FUNC "%8.2" "Nm" COEFFS 0 1 0 0 0 0.1 /end COMPU_METHOD
/begin COMPU_METHOD COMP_0436 "0.1km/h" RAT_FUNC "%8.2" "km/h" COEFFS 0 1 0 0 0 0.1 /end COMPU_METHOD
/begin COMPU_METHOD COMP_0263 "1-" RAT_FUNC "%8.2" "-" COEFFS 0 1 0 0 0 1 /end COMPU_METHOD
/begin COMPU_METHOD COMP_0256 "64/128degCA" RAT_FUNC "%8.2" "degCA" COEFFS 0 1 64 0 0 0.5 /end COMPU_METHOD
/begin COMPU_METHOD COMP_0028_S "3.90625E-11cm**2/rp" RAT_FUNC "%8.6" "cm**2/rp" COEFFS 0 1 0 0 0 3.90625E-11 /end COMPU_METHOD
/begin COMPU_METHOD COMP_0065 "3.125rpm" RAT_FUNC "%8.2" "rpm" COEFFS 0 1 0 0 0 3.125 /end COMPU_METHOD
/begin COMPU_METHOD COMP_0048 "64/128degCA" RAT_FUNC "%8.2" "degCA" COEFFS 0 1 0 0 0 0.5 /end COMPU_METHOD
/begin COMPU_METHOD COMP_0032_S "0.125%" RAT_FUNC "%8.2" "%" COEFFS 0 1 0 0 0 0.125 /end COMPU_METHOD
/begin COMPU_METHOD COMP_0034_S "2^-8kPa" RAT_FUNC "%8.4" "kPa" COEFFS 0 1 0 0 0 0.00390625 /end COMPU_METHOD
/begin COMPU_METHOD COMP_0039_S "1Pa" RAT_FUNC "%8.2" "Pa" COEFFS 0 1 -60000 0 0 1 /end COMPU_METHOD
/begin COMPU_METHOD COMP_0040_S "0.01s" RAT_FUNC "%8.3" "s" COEFFS 0 1 0 0 0 0.01 /end COMPU_METHOD
/begin COMPU_METHOD COMP_0041_S "1ｶｳﾝﾄ" RAT_FUNC "%8.2" "ｶｳﾝﾄ" COEFFS 0 1 0 0 0 1 /end COMPU_METHOD
/begin COMPU_METHOD COMP_0042 "0.0008cm**2" RAT_FUNC "%8.5" "cm**2" COEFFS 0 1 0 0 0 0.0008 /end COMPU_METHOD
/begin COMPU_METHOD COMP_0046_S "1/256A" RAT_FUNC "%8.4" "A" COEFFS 0 1 0 0 0 0.00390625 /end COMPU_METHOD
/begin COMPU_METHOD COMP_0050_S "0.5V" RAT_FUNC "%8.2" "V" COEFFS 0 1 0 0 0 0.5 /end COMPU_METHOD
/begin COMPU_METHOD COMP_0054 "20mV" RAT_FUNC "%8.2" "mV" COEFFS 0 1 0 0 0 20 /end COMPU_METHOD
/begin COMPU_METHOD COMP_0450 "1/1024-" RAT_FUNC "%8.5" "-" COEFFS 0 1 0 0 0 0.000976563 /end COMPU_METHOD
/begin COMPU_METHOD COMP_0419 "0.1%" RAT_FUNC "%8.2" "%" COEFFS 0 1 0 0 0 0.1 /end COMPU_METHOD
/begin COMPU_METHOD COMP_0070 "12.5rpm/s" RAT_FUNC "%8.2" "rpm/s" COEFFS 0 1 0 0 0 12.5 /end COMPU_METHOD
/begin COMPU_METHOD COMP_0144 "1/2048ms" RAT_FUNC "%8.5" "ms" COEFFS 0 1 0 0 0 0.000488281 /end COMPU_METHOD
/begin COMPU_METHOD COMP_0021 "100/256%" RAT_FUNC "%8.2" "%" COEFFS 0 1 0 0 0 0.390625 /end COMPU_METHOD
/begin COMPU_METHOD COMP_0091 "ﾌﾗｸﾞﾌﾗｸﾞ" RAT_FUNC "%8.2" "ﾌﾗｸﾞ" COEFFS 0 1 0 0 0 1 /end COMPU_METHOD
/begin COMPU_METHOD COMP_0082_S "1rpm/50ms" RAT_FUNC "%8.2" "rpm/50ms" COEFFS 0 1 0 0 0 1 /end COMPU_METHOD
/begin COMPU_METHOD COMP_0096 "10s" RAT_FUNC "%8.2" "s" COEFFS 0 1 0 0 0 10 /end COMPU_METHOD
/begin COMPU_METHOD COMP_0051 "1L/min" RAT_FUNC "%8.2" "L/min" COEFFS 0 1 0 0 0 1 /end COMPU_METHOD
/begin COMPU_METHOD COMP_0456 "1/(256×128)-" RAT_FUNC "%8.6" "-" COEFFS 0 1 0 0 0 0.0000305176 /end COMPU_METHOD
/begin COMPU_METHOD COMP_0087_S "0.07808MPa" RAT_FUNC "%8.3" "MPa" COEFFS 0 1 0 0 0 0.07808 /end COMPU_METHOD
/begin COMPU_METHOD COMP_0234 "10sec" RAT_FUNC "%8.2" "sec" COEFFS 0 1 0 0 0 10 /end COMPU_METHOD
/begin COMPU_METHOD COMP_0050 "5/64mV" RAT_FUNC "%8.3" "mV" COEFFS 0 1 0 0 0 0.078125 /end COMPU_METHOD
/begin COMPU_METHOD COMP_0283 "1flag" RAT_FUNC "%8.2" "flag" COEFFS 0 1 0 0 0 1 /end COMPU_METHOD
/begin COMPU_METHOD COMP_0196 "0.1Nm" RAT_FUNC "%8.2" "Nm" COEFFS 0 1 0 0 0 0.1 /end COMPU_METHOD
/begin COMPU_METHOD COMP_0124 "0.125ms/100ms" RAT_FUNC "%8.2" "ms/100ms" COEFFS 0 1 0 0 0 0.125 /end COMPU_METHOD
/begin COMPU_METHOD COMP_0104 "10mV" RAT_FUNC "%8.2" "mV" COEFFS 0 1 0 0 0 10 /end COMPU_METHOD
/begin COMPU_METHOD COMP_0190 "2deg" RAT_FUNC "%8.2" "deg" COEFFS 0 1 0 0 0 2 /end COMPU_METHOD
/begin COMPU_METHOD COMP_0108_S "64/128degCA" RAT_FUNC "%8.2" "degCA" COEFFS 0 1 16384 0 0 0.5 /end COMPU_METHOD
/begin COMPU_METHOD COMP_0120_S "0.25kPa" RAT_FUNC "%8.2" "kPa" COEFFS 0 1 0 0 0 0.25 /end COMPU_METHOD
/begin COMPU_METHOD COMP_0164 "0.000305MPa" RAT_FUNC "%8.5" "MPa" COEFFS 0 1 0 0 0 0.000305 /end COMPU_METHOD
/begin COMPU_METHOD COMP_0124_S "0.25X-48deg" RAT_FUNC "%8.2" "deg" COEFFS 0 1 48 0 0 0.25 /end COMPU_METHOD
/begin COMPU_METHOD COMP_0146 "100/256/256%" RAT_FUNC "%8.4" "%" COEFFS 0 1 0 0 0 0.001525879 /end COMPU_METHOD
/begin COMPU_METHOD COMP_0144_S "3.6_*_2^-22km/h" RAT_FUNC "%8.6" "km/h" COEFFS 0 1 0 0 0 0.000000858307 /end COMPU_METHOD
/begin COMPU_METHOD COMP_0152_S "6.4μs" RAT_FUNC "%8.2" "μs" COEFFS 0 1 0 0 0 6.4 /end COMPU_METHOD
/begin COMPU_METHOD COMP_0156_S "1/3℃" RAT_FUNC "%8.2" "℃" COEFFS 0 1 0 0 0 0.333333333 /end COMPU_METHOD
/begin COMPU_METHOD COMP_0189 "3.2μS" RAT_FUNC "%8.2" "μS" COEFFS 0 1 0 0 0 3.2 /end COMPU_METHOD
/begin COMPU_METHOD COMP_0028 "1/(100*256)-" RAT_FUNC "%8.6" "-" COEFFS 0 1 0 0 0 0.0000390625 /end COMPU_METHOD
/begin COMPU_METHOD COMP_0447 "100/1024%" RAT_FUNC "%8.3" "%" COEFFS 0 1 0 0 0 0.09765625 /end COMPU_METHOD
/begin COMPU_METHOD COMP_0062 "4℃" RAT_FUNC "%8.2" "℃" COEFFS 0 1 0 0 0 4 /end COMPU_METHOD
/begin COMPU_METHOD COMP_0130 "0.0275deg" RAT_FUNC "%8.3" "deg" COEFFS 0 1 0 0 0 0.0275 /end COMPU_METHOD
/begin COMPU_METHOD COMP_0182_S "0.001-" RAT_FUNC "%8.4" "-" COEFFS 0 1 0 0 0 0.001 /end COMPU_METHOD
/begin COMPU_METHOD COMP_0186_S "0.025μs" RAT_FUNC "%8.3" "μs" COEFFS 0 1 0 0 0 0.025 /end COMPU_METHOD
/begin COMPU_METHOD COMP_0389 "1/2548km" RAT_FUNC "%8.5" "km" COEFFS 0 1 0 0 0 0.000392465 /end COMPU_METHOD
/begin COMPU_METHOD COMP_0395 "1/4096-" RAT_FUNC "%8.5" "-" COEFFS 0 1 0 0 0 0.000244141 /end COMPU_METHOD
/begin COMPU_METHOD COMP_0022 "20mv" RAT_FUNC "%8.2" "mv" COEFFS 0 1 0 0 0 20 /end COMPU_METHOD
/begin COMPU_METHOD COMP_0024 "50ms" RAT_FUNC "%8.2" "ms" COEFFS 0 1 0 0 0 50 /end COMPU_METHOD
/begin COMPU_METHOD COMP_0203_S "0.005V" RAT_FUNC "%8.4" "V" COEFFS 0 1 0 0 0 0.005 /end COMPU_METHOD
/begin COMPU_METHOD COMP_0213_S "80μs" RAT_FUNC "%8.2" "μs" COEFFS 0 1 0 0 0 80 /end COMPU_METHOD
/begin COMPU_METHOD COMP_0214_S "1E-05-" RAT_FUNC "%8.6" "-" COEFFS 0 1 0 0 0 0.00001 /end COMPU_METHOD
/begin COMPU_METHOD COMP_0052 "1/2048ms" RAT_FUNC "%8.5" "ms" COEFFS 0 1 0 0 0 0.000488282 /end COMPU_METHOD
/begin COMPU_METHOD COMP_0092 "1bit" RAT_FUNC "%8.2" "bit" COEFFS 0 1 0 0 0 1 /end COMPU_METHOD
/begin COMPU_METHOD COMP_0425 "100/255%" RAT_FUNC "%8.2" "%" COEFFS 0 1 0 0 0 0.392156862 /end COMPU_METHOD
/begin COMPU_METHOD COMP_0470 "1km" RAT_FUNC "%8.2" "km" COEFFS 0 1 0 0 0 1 /end COMPU_METHOD
/begin COMPU_METHOD COMP_0238_S "0.01km/h" RAT_FUNC "%8.3" "km/h" COEFFS 0 1 0 0 0 0.01 /end COMPU_METHOD
/begin COMPU_METHOD COMP_0240_S "0.02Nm" RAT_FUNC "%8.3" "Nm" COEFFS 0 1 0 0 0 0.02 /end COMPU_METHOD
/begin COMPU_METHOD COMP_0250_S "X-128deg" RAT_FUNC "%8.2" "deg" COEFFS 0 1 128 0 0 1 /end COMPU_METHOD
/begin COMPU_METHOD COMP_0255_S "0.1degC" RAT_FUNC "%8.2" "degC" COEFFS 0 1 0 0 0 0.1 /end COMPU_METHOD
/begin COMPU_METHOD COMP_0429 "1km/h" RAT_FUNC "%8.2" "km/h" COEFFS 0 1 0 0 0 1 /end COMPU_METHOD
/begin COMPU_METHOD COMP_0261_S "2s" RAT_FUNC "%8.2" "s" COEFFS 0 1 0 0 0 2 /end COMPU_METHOD
/begin COMPU_METHOD COMP_0356 "0.625X-40℃" RAT_FUNC "%8.2" "℃" COEFFS 0 1 40 0 0 0.625 /end COMPU_METHOD
/begin COMPU_METHOD COMP_0073 "3.2us" RAT_FUNC "%8.2" "us" COEFFS 0 1 0 0 0 3.2 /end COMPU_METHOD
/begin COMPU_METHOD COMP_0448 "100/16384%" RAT_FUNC "%8.4" "%" COEFFS 0 1 0 0 0 0.00610352 /end COMPU_METHOD
/begin COMPU_METHOD COMP_0266_S "0.0008cm^2" RAT_FUNC "%8.5" "cm^2" COEFFS 0 1 0 0 0 0.0008 /end COMPU_METHOD
/begin COMPU_METHOD COMP_0410 "100/256/256%" RAT_FUNC "%8.4" "%" COEFFS 0 1 0 0 0 0.00152588 /end COMPU_METHOD
/begin COMPU_METHOD COMP_0355 "1/256s" RAT_FUNC "%8.4" "s" COEFFS 0 1 0 0 0 0.00390625 /end COMPU_METHOD
/begin COMPU_METHOD COMP_0270_S "1E-6m**3" RAT_FUNC "%8.6" "m**3" COEFFS 0 1 0 0 0 0.000001 /end COMPU_METHOD
/begin COMPU_METHOD COMP_0293_S "1/65536A" RAT_FUNC "%8.6" "A" COEFFS 0 1 0 0 0 0.0000152588 /end COMPU_METHOD
/begin COMPU_METHOD COMP_0297_S "0.001-" RAT_FUNC "%8.4" "-" COEFFS 0 1 0 0 0 0.001 /end COMPU_METHOD
/begin COMPU_METHOD COMP_0298_S "36*2^-22-" RAT_FUNC "%8.6" "-" COEFFS 0 1 0 0 0 0.00000858307 /end COMPU_METHOD
/begin COMPU_METHOD COMP_0245 "X-64deg" RAT_FUNC "%8.2" "deg" COEFFS 0 1 64 0 0 1 /end COMPU_METHOD
/begin COMPU_METHOD COMP_0300_S "0.5degCA/se" RAT_FUNC "%8.2" "degCA/se" COEFFS 0 1 0 0 0 0.5 /end COMPU_METHOD
/begin COMPU_METHOD COMP_0304_S "0.000016kg/s" RAT_FUNC "%8.6" "kg/s" COEFFS 0 1 0 0 0 0.000016 /end COMPU_METHOD
/begin COMPU_METHOD COMP_0316_S "2^-9%" RAT_FUNC "%8.4" "%" COEFFS 0 1 0 0 0 0.00195313 /end COMPU_METHOD
/begin COMPU_METHOD COMP_0338_S "2^-231/((kg/m" RAT_FUNC "%8.6" "1/((kg/m" COEFFS 0 1 0 0 0 0.000000119209 /end COMPU_METHOD
/begin COMPU_METHOD COMP_0329 "2/256%" RAT_FUNC "%8.4" "%" COEFFS 0 1 0 0 0 0.0078125 /end COMPU_METHOD
/begin COMPU_METHOD COMP_0271 "100/128/256%" RAT_FUNC "%8.4" "%" COEFFS 0 1 0 0 0 0.003051758 /end COMPU_METHOD
/begin COMPU_METHOD COMP_0325 "1.6μS" RAT_FUNC "%8.2" "μS" COEFFS 0 1 52428.8 0 0 1.6 /end COMPU_METHOD
/begin COMPU_METHOD COMP_0446_S "2^-2kPa" RAT_FUNC "%8.2" "kPa" COEFFS 0 1 100 0 0 0.25 /end COMPU_METHOD
/begin COMPU_METHOD COMP_0383 "X/256-50℃" RAT_FUNC "%8.4" "℃" COEFFS 0 1 50 0 0 0.00390625 /end COMPU_METHOD
/begin COMPU_METHOD COMP_0467_S "minmin" RAT_FUNC "%8.2" "min" COEFFS 0 1 0 0 0 1 /end COMPU_METHOD
/begin COMPU_METHOD COMP_0471_S "VV" RAT_FUNC "%8.5" "V" COEFFS 0 1 0 0 0 0.000122 /end COMPU_METHOD
/begin COMPU_METHOD COMP_0472_S "°°" RAT_FUNC "%8.2" "°" COEFFS 0 1 64 0 0 0.5 /end COMPU_METHOD
/begin COMPU_METHOD COMP_0327 "1/32768-" RAT_FUNC "%8.6" "-" COEFFS 0 1 0 0 0 0.0000305 /end COMPU_METHOD
/begin COMPU_METHOD COMP_0117 "100/128%" RAT_FUNC "%8.2" "%" COEFFS 0 1 100 0 0 0.78125 /end COMPU_METHOD
/begin COMPU_METHOD COMP_0378 "100/255%" RAT_FUNC "%8.2" "%" COEFFS 0 1 0 0 0 0.392156863 /end COMPU_METHOD
/begin COMPU_METHOD COMP_0473_S "kPakPa" RAT_FUNC "%8.2" "kPa" COEFFS 0 1 0 0 0 10 /end COMPU_METHOD
/begin COMPU_METHOD COMP_0474_S "kPakPa" RAT_FUNC "%8.2" "kPa" COEFFS 0 1 0 0 0 1 /end COMPU_METHOD
/begin COMPU_METHOD COMP_0426 "－code" RAT_FUNC "%8.2" "code" COEFFS 0 1 0 0 0 1 /end COMPU_METHOD
/begin COMPU_METHOD COMP_0475_S "PaPa" RAT_FUNC "%8.2" "Pa" COEFFS 0 1 0 0 0 0.25 /end COMPU_METHOD
/begin COMPU_METHOD COMP_0476_S "g/sg/s" RAT_FUNC "%8.3" "g/s" COEFFS 0 1 0 0 0 0.01 /end COMPU_METHOD
/begin COMPU_METHOD COMP_0427 "0.25rpm" RAT_FUNC "%8.2" "rpm" COEFFS 0 1 0 0 0 0.25 /end COMPU_METHOD
/begin COMPU_METHOD COMP_0428 "X-40℃" RAT_FUNC "%8.2" "℃" COEFFS 0 1 40 0 0 1 /end COMPU_METHOD
/begin COMPU_METHOD COMP_0477_S "℃℃" RAT_FUNC "%8.2" "℃" COEFFS 0 1 40 0 0 0.1 /end COMPU_METHOD
/begin COMPU_METHOD COMP_0478_S "VV" RAT_FUNC "%8.4" "V" COEFFS 0 1 0 0 0 0.001 /end COMPU_METHOD
/begin COMPU_METHOD COMP_0481_S "km/hkm/h" RAT_FUNC "%8.6" "km/h" COEFFS 0 1 0 0 0 0.000000858 /end COMPU_METHOD
/begin COMPU_METHOD COMP_0515 "1/2048ms" RAT_FUNC "%8.5" "ms" COEFFS 0 1 0 0 0 0.000488281 /end COMPU_METHOD
/begin COMPU_METHOD COMP_0484_S "degCAdegCA" RAT_FUNC "%8.2" "degCA" COEFFS 0 1 0 0 0 1 /end COMPU_METHOD
/begin COMPU_METHOD COMP_0379 "8/10000cm**2" RAT_FUNC "%8.5" "cm**2" COEFFS 0 1 0 0 0 0.0008 /end COMPU_METHOD
/begin COMPU_METHOD COMP_0529 "128/(128*256)degCA" RAT_FUNC "%8.4" "degCA" COEFFS 0 1 128 0 0 0.00390625 /end COMPU_METHOD
/begin COMPU_METHOD COMP_0489_S "kjkj" RAT_FUNC "%8.5" "kj" COEFFS 0 1 0 0 0 0.0001 /end COMPU_METHOD
/begin COMPU_METHOD COMP_0495_S "AA" RAT_FUNC "%8.3" "A" COEFFS 0 1 327.68 0 0 0.01 /end COMPU_METHOD
/begin COMPU_METHOD COMP_0127 "0.35X-0x80deg/30ms" RAT_FUNC "%8.2" "deg/30ms" COEFFS 0 1 44.8 0 0 0.35 /end COMPU_METHOD
/begin COMPU_METHOD COMP_0377 "0.11deg" RAT_FUNC "%8.2" "deg" COEFFS 0 1 0 0 0 0.11 /end COMPU_METHOD
/begin COMPU_METHOD COMP_0497_S "NmNm" RAT_FUNC "%8.2" "Nm" COEFFS 0 1 100 0 0 2 /end COMPU_METHOD
/begin COMPU_METHOD COMP_0118 "40mV" RAT_FUNC "%8.2" "mV" COEFFS 0 1 0 0 0 40 /end COMPU_METHOD
/begin COMPU_METHOD COMP_0504_S "degCAdegCA" RAT_FUNC "%8.4" "degCA" COEFFS 0 1 0 0 0 0.001953125 /end COMPU_METHOD
/begin COMPU_METHOD COMP_0528 "64/(128*256)degCA" RAT_FUNC "%8.4" "degCA" COEFFS 0 1 64 0 0 0.001953125 /end COMPU_METHOD
/begin COMPU_METHOD COMP_0505_S "AA" RAT_FUNC "%8.4" "A" COEFFS 0 1 128 0 0 0.00390625 /end COMPU_METHOD
/begin COMPU_METHOD COMP_0522_S "cyl(BIT位置)cyl(BIT" RAT_FUNC "%8.2" "cyl(BIT" COEFFS 0 1 0 0 0 1 /end COMPU_METHOD
/begin COMPU_METHOD COMP_0517 "1.6μS" RAT_FUNC "%8.2" "μS" COEFFS 0 1 0 0 0 1.6 /end COMPU_METHOD
/begin COMPU_METHOD COMP_0529_S "deg/80msdeg/80ms" RAT_FUNC "%8.2" "deg/80ms" COEFFS 0 1 0 0 0 0.11 /end COMPU_METHOD
/begin COMPU_METHOD COMP_0532_S "deg/100msdeg/100m" RAT_FUNC "%8.2" "deg/100m" COEFFS 0 1 0 0 0 0.35 /end COMPU_METHOD
/begin COMPU_METHOD COMP_0229 "2km/h" RAT_FUNC "%8.2" "km/h" COEFFS 0 1 256 0 0 2 /end COMPU_METHOD
/begin COMPU_METHOD COMP_0533_S "rpmrpm" RAT_FUNC "%8.2" "rpm" COEFFS 0 1 0 0 0 0.1953125 /end COMPU_METHOD
/begin COMPU_METHOD COMP_0523 "1/1024ms" RAT_FUNC "%8.5" "ms" COEFFS 0 1 0 0 0 0.000976563 /end COMPU_METHOD
/begin COMPU_METHOD COMP_0236 "0.25km/h" RAT_FUNC "%8.2" "km/h" COEFFS 0 1 0 0 0 0.25 /end COMPU_METHOD
/begin COMPU_METHOD COMP_0548_S "℃℃" RAT_FUNC "%8.2" "℃" COEFFS 0 1 30 0 0 0.3333333 /end COMPU_METHOD
/begin COMPU_METHOD COMP_0424 "1kpa" RAT_FUNC "%8.2" "kpa" COEFFS 0 1 0 0 0 1 /end COMPU_METHOD
/begin COMPU_METHOD COMP_0600_S "Km/h/sKm/h/s" RAT_FUNC "%8.3" "Km/h/s" COEFFS 0 1 0 0 0 0.01 /end COMPU_METHOD
/begin COMPU_METHOD COMP_0625_S "degdeg" RAT_FUNC "%8.4" "deg" COEFFS 0 1 14.08205 0 0 0.00171875 /end COMPU_METHOD
/begin COMPU_METHOD COMP_0626_S "--" RAT_FUNC "%8.3" "-" COEFFS 0 1 0 0 0 0.06 /end COMPU_METHOD
/begin COMPU_METHOD COMP_0511 "6s" RAT_FUNC "%8.2" "s" COEFFS 0 1 0 0 0 6 /end COMPU_METHOD
/begin COMPU_METHOD COMP_0628_S "℃℃" RAT_FUNC "%8.6" "℃" COEFFS 0 1 0 0 0 0.0000152588 /end COMPU_METHOD
/begin COMPU_METHOD COMP_0629_S "secsec" RAT_FUNC "%8.4" "sec" COEFFS 0 1 0 0 0 0.001 /end COMPU_METHOD
/begin COMPU_METHOD COMP_0630_S "msms" RAT_FUNC "%8.5" "ms" COEFFS 0 1 0 0 0 0.000976563 /end COMPU_METHOD
/begin COMPU_METHOD COMP_0631_S "msms" RAT_FUNC "%8.5" "ms" COEFFS 0 1 0 0 0 0.00048828 /end COMPU_METHOD
/begin COMPU_METHOD COMP_0514 "1/2048ms" RAT_FUNC "%8.5" "ms" COEFFS 0 1 0 0 0 0.0004883 /end COMPU_METHOD
/begin COMPU_METHOD COMP_0632_S "degdeg" RAT_FUNC "%8.4" "deg" COEFFS 0 1 0 0 0 0.00171875 /end COMPU_METHOD
/begin COMPU_METHOD COMP_0633_S "degdeg" RAT_FUNC "%8.6" "deg" COEFFS 0 1 0 0 0 0.000000953674 /end COMPU_METHOD
/begin COMPU_METHOD COMP_0369 "3.2μs" RAT_FUNC "%8.2" "μs" COEFFS 0 1 0 0 0 3.2 /end COMPU_METHOD
/begin COMPU_METHOD COMP_0512 "1/512ms" RAT_FUNC "%8.4" "ms" COEFFS 0 1 0 0 0 0.001953125 /end COMPU_METHOD
/begin COMPU_METHOD COMP_0634_S "usus" RAT_FUNC "%8.2" "us" COEFFS 0 1 0 0 0 6.4 /end COMPU_METHOD
/begin COMPU_METHOD COMP_0635_S "NmNm" RAT_FUNC "%8.2" "Nm" COEFFS 0 1 400 0 0 0.5 /end COMPU_METHOD
/begin COMPU_METHOD COMP_0636_S "NmNm" RAT_FUNC "%8.2" "Nm" COEFFS 0 1 400 0 0 0.5 /end COMPU_METHOD
/begin COMPU_METHOD COMP_0637_S "--" RAT_FUNC "%8.2" "-" COEFFS 0 1 0 0 0 3.9 /end COMPU_METHOD
/begin COMPU_METHOD COMP_0638_S "degdeg" RAT_FUNC "%8.2" "deg" COEFFS 0 1 14.08 0 0 0.11 /end COMPU_METHOD
/begin COMPU_METHOD COMP_0639_S "degdeg" RAT_FUNC "%8.3" "deg" COEFFS 0 1 14.08 0 0 0.0275 /end COMPU_METHOD
/begin COMPU_METHOD COMP_0640_S "degdeg" RAT_FUNC "%8.4" "deg" COEFFS 0 1 0 0 0 0.00171875 /end COMPU_METHOD
/begin COMPU_METHOD COMP_0641_S "cm**2cm**2" RAT_FUNC "%8.6" "cm**2" COEFFS 0 1 0 0 0 0.00005 /end COMPU_METHOD
/begin COMPU_METHOD COMP_0642_S "degdeg" RAT_FUNC "%8.6" "deg" COEFFS 0 1 0 0 0 0.00000190735 /end COMPU_METHOD
/begin COMPU_METHOD COMP_0520 "1.25/256X-200℃" RAT_FUNC "%8.4" "℃" COEFFS 0 1 200 0 0 0.004882813 /end COMPU_METHOD
/begin COMPU_METHOD COMP_0643_S "--" RAT_FUNC "%8.5" "-" COEFFS 0 1 0 0 0 0.0008 /end COMPU_METHOD
/begin COMPU_METHOD COMP_0644_S "--" RAT_FUNC "%8.6" "-" COEFFS 0 1 0 0 0 0.00001 /end COMPU_METHOD
/begin COMPU_METHOD COMP_0645_S "km/hkm/h" RAT_FUNC "%8.3" "km/h" COEFFS 0 1 0 0 0 0.05625 /end COMPU_METHOD
/begin COMPU_METHOD COMP_0646_S "mVmV" RAT_FUNC "%8.4" "mV" COEFFS 0 1 0 0 0 0.001220703 /end COMPU_METHOD
/begin COMPU_METHOD COMP_0647_S "mVmV" RAT_FUNC "%8.6" "mV" COEFFS 0 1 0 0 0 0.0000762939 /end COMPU_METHOD
/begin COMPU_METHOD COMP_0648_S "mvmv" RAT_FUNC "%8.2" "mv" COEFFS 0 1 0 0 0 2.5 /end COMPU_METHOD
/begin COMPU_METHOD COMP_0649_S "km/hkm/h" RAT_FUNC "%8.3" "km/h" COEFFS 0 1 0 0 0 0.05625 /end COMPU_METHOD
/begin COMPU_METHOD COMP_0650_S "km/hkm/h" RAT_FUNC "%8.6" "km/h" COEFFS 0 1 0 0 0 0.00000171661 /end COMPU_METHOD
/begin COMPU_METHOD COMP_0651_S "km/hkm/h" RAT_FUNC "%8.2" "km/h" COEFFS 0 1 0 0 0 0.125 /end COMPU_METHOD
/begin COMPU_METHOD COMP_0652_S "--" RAT_FUNC "%8.5" "-" COEFFS 0 1 0 0 0 0.000549316 /end COMPU_METHOD
/begin COMPU_METHOD COMP_0653_S "degdeg" RAT_FUNC "%8.2" "deg" COEFFS 0 1 32 0 0 0.25 /end COMPU_METHOD
/begin COMPU_METHOD COMP_0526 "64/(128×256×256)degCA" RAT_FUNC "%8.6" "degCA" COEFFS 0 1 63.99996198912 0 0 0.00000762939 /end COMPU_METHOD
/begin COMPU_METHOD COMP_0654_S "degCAdegCA" RAT_FUNC "%8.6" "degCA" COEFFS 0 1 16383.9902692147 0 0 0.00000762939 /end COMPU_METHOD
/begin COMPU_METHOD COMP_0257 "128/128degCA" RAT_FUNC "%8.2" "degCA" COEFFS 0 1 128 0 0 1 /end COMPU_METHOD
/begin COMPU_METHOD COMP_0655_S "degCAdegCA" RAT_FUNC "%8.4" "degCA" COEFFS 0 1 64.00016384 0 0 0.00195313 /end COMPU_METHOD
/begin COMPU_METHOD COMP_0530 "64/(128*256*256)degCA" RAT_FUNC "%8.6" "degCA" COEFFS 0 1 64.0000458752 0 0 0.0000076294 /end COMPU_METHOD
/begin COMPU_METHOD COMP_0656_S "degdeg" RAT_FUNC "%8.4" "deg" COEFFS 0 1 0 0 0 0.001953125 /end COMPU_METHOD
/begin COMPU_METHOD COMP_0657_S "ss" RAT_FUNC "%8.6" "s" COEFFS 0 1 0 0 0 0.0000032 /end COMPU_METHOD
/begin COMPU_METHOD COMP_0658_S "degdeg" RAT_FUNC "%8.2" "deg" COEFFS 0 1 32 0 0 0.5 /end COMPU_METHOD
/begin COMPU_METHOD COMP_0531 "100/255%" RAT_FUNC "%8.2" "%" COEFFS 0 1 0 0 0 0.392157 /end COMPU_METHOD
/begin COMPU_METHOD COMP_0659_S "--" RAT_FUNC "%8.5" "-" COEFFS 0 1 0 0 0 0.000244 /end COMPU_METHOD
/begin COMPU_METHOD COMP_0660_S "gg" RAT_FUNC "%8.4" "g" COEFFS 0 1 0 0 0 0.003906 /end COMPU_METHOD
/begin COMPU_METHOD COMP_0661_S "cm^2/rpm/cccm^2/rpm" RAT_FUNC "%8.6" "cm^2/rpm" COEFFS 0 1 0 0 0 0.0000000000908 /end COMPU_METHOD
/end MODULE
/end PROJECT
