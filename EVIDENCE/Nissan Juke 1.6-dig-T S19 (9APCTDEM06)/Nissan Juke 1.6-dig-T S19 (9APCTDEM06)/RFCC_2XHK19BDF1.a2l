/* NISSAN ASAP2 definition file generated by RB4-ASAP2 GENERATOR */
/* Generated date and time 2012/06/21 14:29:33 */
/* このASAP2ファイルは、SH7058RFCC用です。 SH7058FCCのECMには使えません。*/
/* ASAP2_VERSION 1 3_BETA */
/begin PROJECT X12C_KH3DT_DI_NAM_R/C ""
/* project ID に car_eng_desti_lot */
/* comment に Par.scomment */
/begin HEADER "" /* key HEADER ++ "comment" に Par.scomment */ PROJECT_NO X12C_KH3DT_DI_NAM_R/C /* key PROJECT_NO ++ project number に car_eng_desti_lot */ VERSION "0KHDCFDZ7" /* key VERSION ++ version number に mProgver */ /end HEADER
/begin MODULE DIM ""
/* key MODULE ++ ASAP device ID ++ "comment" */
/begin MOD_PAR "" VERSION "0KHDCFDZ7" /* ADDR_EPK 0xFFFF */ EPK "" CUSTOMER_NO "" USER "" PHONE_NO "" ECU "VP3K or COMMON" CPU_TYPE "SH7058RFCC NO EXTERNAL ROM" NO_OF_INTERFACES 2
 /begin MEMORY_SEGMENT /* Internal Vector start_address area_size */ code1 "Vector" CODE FLASH INTERN 0x00000000 0x00008200 -1 -1 -1 -1 -1 /end MEMORY_SEGMENT
 /begin MEMORY_SEGMENT /* Internal Data start_address area_size */ data1 "Data" DATA FLASH EXTERN 0x00008200 0x000F7E00 -1 -1 -1 -1 -1
  /begin IF_DATA XCP
   /begin SEGMENT 0x00 /* Segment logical number */ 0x01 /* Number of pages (WP/RP) キャリブ対応時は0x02 */ 0x00 /* Address extension */ 0x00 /* Compression method */ 0x00 /* Encryption method */ /begin CHECKSUM XCP_ADD_22 MAX_BLOCK_SIZE 0x500 /end CHECKSUM
    /begin PAGE /* Reference page */ 0x00 /* Page ID */ ECU_ACCESS_DONT_CARE /* ECU access */ XCP_READ_ACCESS_DONT_CARE /* XCP read access */ XCP_WRITE_ACCESS_NOT_ALLOWED /* XCP write access */ /end PAGE
    /* キャリブ対応時は以下を有効にする */ /* /begin PAGE Working page */ /* 0x01 Page ID */ /* ECU_ACCESS_DONT_CARE ECU access */ /* XCP_READ_ACCESS_DONT_CARE XCP read access */ /* XCP_WRITE_ACCESS_DONT_CARE XCP write access */ /* /end PAGE */ /end SEGMENT
  /end IF_DATA
 /end MEMORY_SEGMENT
 /begin MEMORY_SEGMENT /* Internal DISTAB13 Address Table start_address area_size */ var1 "DISTAB Address Table" VARIABLES RAM INTERN 0xFFFF0000 0x000001F4 -1 -1 -1 -1 -1 /end MEMORY_SEGMENT
 /begin MEMORY_SEGMENT /* Internal DISTAB13 Data Buffer Table start_address area_size */ var2 "DISTAB Output Buffer" VARIABLES RAM INTERN 0xFFFF0000 0x0000BFFF -1 -1 -1 -1 -1 /end MEMORY_SEGMENT
 /begin CALIBRATION_METHOD "FixedSizeMoveableEmuRAM" /* Method name */ 1 /* Method version */ /begin CALIBRATION_HANDLE 0 0xFFFB0000 0x4000 /end CALIBRATION_HANDLE /begin CALIBRATION_HANDLE 1 0xFFFB4000 0x4000 /end CALIBRATION_HANDLE /begin CALIBRATION_HANDLE 2 0xFFFB8000 0x4000 /end CALIBRATION_HANDLE /begin CALIBRATION_HANDLE 3 0xFFFBC000 0x4000 /end CALIBRATION_HANDLE /begin CALIBRATION_HANDLE 4 0xFFFC0000 0x4000 /end CALIBRATION_HANDLE /begin CALIBRATION_HANDLE 5 0xFFFC4000 0x4000 /end CALIBRATION_HANDLE /begin CALIBRATION_HANDLE 6 0xFFFC8000 0x4000 /end CALIBRATION_HANDLE /begin CALIBRATION_HANDLE 7 0xFFFCC000 0x4000 /end CALIBRATION_HANDLE /begin CALIBRATION_HANDLE 8 0xFFFD0000 0x4000 /end CALIBRATION_HANDLE /begin CALIBRATION_HANDLE 9 0xFFFD4000 0x4000 /end CALIBRATION_HANDLE /begin CALIBRATION_HANDLE 10 0xFFFD8000 0x4000 /end CALIBRATION_HANDLE /begin CALIBRATION_HANDLE 11 0xFFFDC000 0x4000 /end CALIBRATION_HANDLE /begin CALIBRATION_HANDLE 12 0xFFFE0000 0x4000 /end CALIBRATION_HANDLE /begin CALIBRATION_HANDLE 13 0xFFFE4000 0x4000 /end CALIBRATION_HANDLE /begin CALIBRATION_HANDLE 14 0xFFFE8000 0x4000 /end CALIBRATION_HANDLE /begin CALIBRATION_HANDLE 15 0xFFFEC000 0x4000 /end CALIBRATION_HANDLE /end CALIBRATION_METHOD
/end MOD_PAR
/begin IF_DATA ETK
 /begin TP_BLOB 0x1000001 /* Version Number */ 0x0 /* Project base address (offset) */ 0x0 /* ETKP: RESET_CFG parameter, don't care */
  /begin DISTAB_CFG 0xD /* Type of display table (display table 13) */ 0x0122 /* Data type of display table, 1 = Byte 2 = Word 2 = Word */ 0x1 /* Byte order 1 = high first, 2 = low first */ 0xFFFF0000 /* Trigger segment address, don't care */ 0x1020100 /* Trigger configuration */ TRG_MOD /*Id:*/ 0x0 /*trg_mod:*/ 0x27 0x0 0x0 0x0 /end DISTAB_CFG
  RESERVED_DISTAB_MEMORY /*start address*/ 0xFFFF0000 /*size*/ 0x01F4 INTERN -1 -1 -1 -1 -1 ETK_CFG 0x84 /* 0x84: subtype = "D" Don't change */ 0x04 0x10 0xFF 0xFF /* Pattern adress = 0xFFFF1004 Don't change */ 0x46 0x4C 0x53 0x48 /* Flash require ID = "FLSH" Don't change*/ 0x04 /* 0x04: uC = SH7058RFCC Don't change*/ 0xFF 0xFF 0xFF 0xFF 0xFF 0xFF 0xFF 0xFF 0xFF 0xFF 0xFF 0xFF 0xFF 0xFF 0xFF 0xFF 0xFF 0xFF 0xFF 0xFF 0xFF 0xFF 0xFF 0xFF 0xFF 0xFF 0xFF /end TP_BLOB
 /begin SOURCE /* Description of first display table */ "Ref" 103 1 QP_BLOB 0x101 15 INDIRECT 32 MEASUREMENT 0xFFFF062C 0xE8 0xFFFF0000 0xFFFF01F4 0x0 0x0 0x0 1000 0x1D /* Max number of measurement variables */ 0x0 /end SOURCE
 /begin SOURCE /* Description of second display table */ "4ms" 3 4 QP_BLOB 0x101 16 INDIRECT 31 MEASUREMENT 0xFFFF0630 0x168 0xFFFF007C 0xFFFF02DC 0x0 0x0 0x0 4000 0x2D /* Max number of measured variables */ 0x0 /end SOURCE
 /begin SOURCE /* Description of third display table */ "10ms" 3 10 QP_BLOB 0x101 16 INDIRECT 30 MEASUREMENT 0xFFFF0634 0x168 0xFFFF0138 0xFFFF0444 0x0 0x0 0x0 10000 0x2D /* Max number of measured variables */ 0x0 /end SOURCE
/end IF_DATA
/begin IF_DATA XCP
 /begin PROTOCOL_LAYER 0x0100 /* Driver version */ 100 /* Timeout1 */ 200 /* Timeout2 */ 30 /* Timeout3 */ 30 /* Timeout4 */ 30 /* Timeout5 */ 30 /* Timeout6 */ 30 /* Timeout7 */ 8 /* XCP_MAX_CTO */ 8 /* XCP_MAX_DTO */ BYTE_ORDER_MSB_FIRST /* XCP byte order */ ADDRESS_GRANULARITY_BYTE /* Address granularity */ OPTIONAL_CMD GET_COMM_MODE_INFO OPTIONAL_CMD GET_ID OPTIONAL_CMD SET_REQUEST OPTIONAL_CMD GET_SEED OPTIONAL_CMD UNLOCK OPTIONAL_CMD SET_MTA OPTIONAL_CMD UPLOAD OPTIONAL_CMD SHORT_UPLOAD OPTIONAL_CMD BUILD_CHECKSUM OPTIONAL_CMD TRANSPORT_LAYER_CMD OPTIONAL_CMD USER_CMD OPTIONAL_CMD DOWNLOAD OPTIONAL_CMD DOWNLOAD_NEXT OPTIONAL_CMD DOWNLOAD_MAX OPTIONAL_CMD SHORT_DOWNLOAD OPTIONAL_CMD MODIFY_BITS OPTIONAL_CMD SET_CAL_PAGE OPTIONAL_CMD GET_CAL_PAGE OPTIONAL_CMD GET_PAG_PROCESSOR_INFO OPTIONAL_CMD COPY_CAL_PAGE OPTIONAL_CMD CLEAR_DAQ_LIST OPTIONAL_CMD SET_DAQ_PTR OPTIONAL_CMD WRITE_DAQ OPTIONAL_CMD SET_DAQ_LIST_MODE OPTIONAL_CMD GET_DAQ_LIST_MODE OPTIONAL_CMD START_STOP_DAQ_LIST OPTIONAL_CMD START_STOP_SYNCH OPTIONAL_CMD GET_DAQ_CLOCK OPTIONAL_CMD READ_DAQ OPTIONAL_CMD GET_DAQ_PROCESSOR_INFO OPTIONAL_CMD GET_DAQ_RESOLUTION_INFO OPTIONAL_CMD GET_DAQ_LIST_INFO OPTIONAL_CMD FREE_DAQ OPTIONAL_CMD ALLOC_DAQ OPTIONAL_CMD ALLOC_ODT OPTIONAL_CMD ALLOC_ODT_ENTRY OPTIONAL_CMD PROGRAM_START OPTIONAL_CMD PROGRAM_CLEAR OPTIONAL_CMD PROGRAM OPTIONAL_CMD PROGRAM_RESET OPTIONAL_CMD GET_PGM_PROCESSOR_INFO OPTIONAL_CMD GET_SECTOR_INFO OPTIONAL_CMD PROGRAM_PREPARE OPTIONAL_CMD PROGRAM_NEXT OPTIONAL_CMD PROGRAM_MAX OPTIONAL_CMD PROGRAM_VERIFY OPTIONAL_CMD GET_SEGMENT_INFO OPTIONAL_CMD GET_PAGE_INFO OPTIONAL_CMD SET_SEGMENT_MODE OPTIONAL_CMD GET_SEGMENT_MODE COMMUNICATION_MODE_SUPPORTED BLOCK SLAVE /* Optional command COMMUNICATION_MS */ MASTER 20 5 /* Optional command COMMUNICATION_MM */ /* SEED_AND_KEY_EXTERNAL_FUNCTION "" */ /end PROTOCOL_LAYER
 /begin DAQ DYNAMIC /* DAQ_MODE */ 0xFF 0x0A /* MAX_EVENT_CHANNEL */ 0x00 /* MIN_DAQ */ OPTIMISATION_TYPE_DEFAULT /* OPTIMISATION_TYPE */ ADDRESS_EXTENSION_FREE /* ADDRESS_EXTENSION_DAQ */ IDENTIFICATION_FIELD_TYPE_ABSOLUTE /* IDENTIFICATON_FIELD_ABSOLUT */ GRANULARITY_ODT_ENTRY_SIZE_DAQ_BYTE /* GRANULARITY_ODT_DAQ */ 0x04 /* MAX_ODT_ENTRY_SIZE_DAQ */ OVERLOAD_INDICATION_EVENT /* OVERLOAD_INDICATION_DAQ */
  /begin TIMESTAMP_SUPPORTED 1 /* TIMESTAMP_TICKS */ SIZE_WORD /* TIMESTAMP_SIZE */ UNIT_1MS /* RESOLUTION OF TIMESTAMP */ TIMESTAMP_FIXED /end TIMESTAMP_SUPPORTED
  /begin EVENT "100ms" "100ms" 0x06 DAQ_STIM 0xFF 0x01 0x08 0x00 /end EVENT
  /begin EVENT "1ms" "1ms" 0x00 DAQ_STIM 0xFF 0x01 0x06 0x00 /end EVENT
  /begin EVENT "2ms" "2ms" 0x01 DAQ_STIM 0xFF 0x02 0x06 0x00 /end EVENT
  /begin EVENT "4ms" "4ms" 0x02 DAQ_STIM 0xFF 0x04 0x06 0x00 /end EVENT
  /begin EVENT "10ms" "10ms" 0x03 DAQ_STIM 0xFF 0x01 0x07 0x00 /end EVENT
  /begin EVENT "20ms" "20ms" 0x04 DAQ_STIM 0xFF 0x02 0x07 0x00 /end EVENT
  /begin EVENT "50ms" "50ms" 0x05 DAQ_STIM 0xFF 0x05 0x07 0x00 /end EVENT
  /begin EVENT "200ms" "200ms" 0x07 DAQ_STIM 0xFF 0x02 0x08 0x00 /end EVENT
  /begin EVENT "500ms" "500ms" 0x08 DAQ_STIM 0xFF 0x05 0x08 0x00 /end EVENT
  /begin EVENT "1s" "1s" 0x09 DAQ_STIM 0xFF 0x01 0x09 0x00 /end EVENT
 /end DAQ
 /begin PAG 1 /* MAX_SEGMENTS */ /* FREEZE_SUPPORTED */ /end PAG
 /begin XCP_ON_CAN 0x0100 /* XCP_DRIVER_VERSION */ CAN_ID_MASTER 0x620 /* CAN_ID_MASTER */ CAN_ID_SLAVE 0x621 /* CAN_ID_SLAVE */ BAUDRATE 500000 /* BAUDRATE */ /end XCP_ON_CAN
/end IF_DATA
/begin MOD_COMMON "" ALIGNMENT_BYTE 1 ALIGNMENT_WORD 2 ALIGNMENT_LONG 4 ALIGNMENT_FLOAT32_IEEE 4 ALIGNMENT_FLOAT64_IEEE 4 DEPOSIT ABSOLUTE BYTE_ORDER MSB_FIRST /* ﾊﾞｲﾄｵｰﾀﾞｰがﾘﾌﾟﾚｰｽされる */ /end MOD_COMMON
/* ここに、生成されたﾜｰｸﾌｧｲﾙ情報を挿入。*/ /* CHARACTERISTIC ------------------------------------------------------- */
/begin CHARACTERISTIC mMKLMRTH "KLMRTマップハイオク [軸最終値無効]  X-[mADVTP1] [mADVTP2]   Y-[mADVN1] [mADVN2] " MAP 0x00011937 REC_UBYTE_C 0 COMP_0017 0 255
 /begin AXIS_DESCR FIX_AXIS NO_INPUT_QUANTITY COMP_0000_S 3 0 2 FIX_AXIS_PAR_DIST 0 1 3 /end AXIS_DESCR
 /begin AXIS_DESCR FIX_AXIS NO_INPUT_QUANTITY COMP_0000_S 3 0 2 FIX_AXIS_PAR_DIST 0 1 3 /end AXIS_DESCR
/end CHARACTERISTIC
/begin CHARACTERISTIC mMKLMRTR "KLMRTマップレギュラ [軸最終値無効]  X-[mADVTP1] [mADVTP2]   Y-[mADVN1] [mADVN2] " MAP 0x00011940 REC_UBYTE_C 0 COMP_0017 0 255
 /begin AXIS_DESCR FIX_AXIS NO_INPUT_QUANTITY COMP_0000_S 3 0 2 FIX_AXIS_PAR_DIST 0 1 3 /end AXIS_DESCR
 /begin AXIS_DESCR FIX_AXIS NO_INPUT_QUANTITY COMP_0000_S 3 0 2 FIX_AXIS_PAR_DIST 0 1 3 /end AXIS_DESCR
/end CHARACTERISTIC
/begin CHARACTERISTIC mECUHWNO "部品番号" CURVE 0x00008204 REC_UBYTE_C 0 COMP_0004 0 255
 /begin AXIS_DESCR FIX_AXIS NO_INPUT_QUANTITY COMP_0000_S 11 0 10 FIX_AXIS_PAR_DIST 0 1 11 /end AXIS_DESCR
/end CHARACTERISTIC
/begin CHARACTERISTIC mECUHWNO2 "部品番号2" CURVE 0x0000820F REC_UBYTE_C 0 COMP_0004 0 255
 /begin AXIS_DESCR FIX_AXIS NO_INPUT_QUANTITY COMP_0000_S 11 0 10 FIX_AXIS_PAR_DIST 0 1 11 /end AXIS_DESCR
/end CHARACTERISTIC
/begin CHARACTERISTIC mGSTPID1 "モード1返答可能PID" CURVE 0x00011659 REC_UBYTE_C 0 COMP_0068 0 255
 /begin AXIS_DESCR FIX_AXIS NO_INPUT_QUANTITY COMP_0000_S 16 0 15 FIX_AXIS_PAR_DIST 0 1 16 /end AXIS_DESCR
/end CHARACTERISTIC
/begin CHARACTERISTIC mGSTPID2 "モード2返答可能PID" CURVE 0x00011669 REC_UBYTE_C 0 COMP_0068 0 255
 /begin AXIS_DESCR FIX_AXIS NO_INPUT_QUANTITY COMP_0000_S 16 0 15 FIX_AXIS_PAR_DIST 0 1 16 /end AXIS_DESCR
/end CHARACTERISTIC
/begin CHARACTERISTIC mCANDLMID "DDLﾃﾞｰﾀﾓﾆﾀ許可ﾌﾗｸﾞ" CURVE 0x000115D9 REC_UBYTE_C 0 COMP_0068 0 255
 /begin AXIS_DESCR FIX_AXIS NO_INPUT_QUANTITY COMP_0000_S 2 0 1 FIX_AXIS_PAR_DIST 0 1 2 /end AXIS_DESCR
/end CHARACTERISTIC
/begin CHARACTERISTIC mIMRID "IMR識別フラグ" CURVE 0x000116B9 REC_UBYTE_C 0 COMP_0004 0 255
 /begin AXIS_DESCR FIX_AXIS NO_INPUT_QUANTITY COMP_0000_S 2 0 1 FIX_AXIS_PAR_DIST 0 1 2 /end AXIS_DESCR
/end CHARACTERISTIC
/begin CHARACTERISTIC mCCCUID "Diag_On_CAN_CUID" CURVE 0x000115DB REC_UBYTE_C 0 COMP_0004 0 255
 /begin AXIS_DESCR FIX_AXIS NO_INPUT_QUANTITY COMP_0000_S 20 0 19 FIX_AXIS_PAR_DIST 0 1 20 /end AXIS_DESCR
/end CHARACTERISTIC
/begin CHARACTERISTIC mAPPID "SystemIdentification" CURVE 0x000115C1 REC_UBYTE_C 0 COMP_0004 0 255
 /begin AXIS_DESCR FIX_AXIS NO_INPUT_QUANTITY COMP_0000_S 24 0 23 FIX_AXIS_PAR_DIST 0 1 24 /end AXIS_DESCR
/end CHARACTERISTIC
/begin CHARACTERISTIC mM6OBDMID "ﾓｰﾄﾞ6返答可能OBDMID" CURVE 0x000118D7 REC_UBYTE_C 0 COMP_0068 0 255
 /begin AXIS_DESCR FIX_AXIS NO_INPUT_QUANTITY COMP_0000_S 24 0 23 FIX_AXIS_PAR_DIST 0 1 24 /end AXIS_DESCR
/end CHARACTERISTIC
/begin CHARACTERISTIC mDELPRS "負圧ｽﾃｰﾄ判定用ﾊﾟﾗﾒｰﾀ腑分けﾃｰﾌﾞﾙ" CURVE 0x0001160C REC_UBYTE_C 0 COMP_0001_S 0 255
 /begin AXIS_DESCR FIX_AXIS NO_INPUT_QUANTITY COMP_0000_S 4 0 3 FIX_AXIS_PAR_DIST 0 1 4 /end AXIS_DESCR
/end CHARACTERISTIC
/begin CHARACTERISTIC mDEPRE "正圧診断時圧力上昇代" CURVE 0x00012CA6 REC_SWORD_C 0 COMP_0002_S -32768 32767
 /begin AXIS_DESCR FIX_AXIS NO_INPUT_QUANTITY COMP_0000_S 4 0 3 FIX_AXIS_PAR_DIST 0 1 4 /end AXIS_DESCR
/end CHARACTERISTIC
/begin CHARACTERISTIC mDPTFD "正圧診断中断時点燃温変化代" CURVE 0x00012CAE REC_SWORD_C 0 COMP_0003_S -6553.6 6553.4
 /begin AXIS_DESCR FIX_AXIS NO_INPUT_QUANTITY COMP_0000_S 4 0 3 FIX_AXIS_PAR_DIST 0 1 4 /end AXIS_DESCR
/end CHARACTERISTIC
/begin CHARACTERISTIC mDVTFD "負圧診断中断時点燃温変化代" CURVE 0x00012CB6 REC_SWORD_C 0 COMP_0003_S -6553.6 6553.4
 /begin AXIS_DESCR FIX_AXIS NO_INPUT_QUANTITY COMP_0000_S 4 0 3 FIX_AXIS_PAR_DIST 0 1 4 /end AXIS_DESCR
/end CHARACTERISTIC
/begin CHARACTERISTIC mETIMERS1 "正圧診断所要時間" CURVE 0x00012F72 REC_UWORD_C 0 COMP_0013 0 65535
 /begin AXIS_DESCR FIX_AXIS NO_INPUT_QUANTITY COMP_0000_S 4 0 3 FIX_AXIS_PAR_DIST 0 1 4 /end AXIS_DESCR
/end CHARACTERISTIC
/begin CHARACTERISTIC mGSM8ID "OBD関連制御" CURVE 0x00011651 REC_UBYTE_C 0 COMP_0068 0 255
 /begin AXIS_DESCR FIX_AXIS NO_INPUT_QUANTITY COMP_0000_S 4 0 3 FIX_AXIS_PAR_DIST 0 1 4 /end AXIS_DESCR
/end CHARACTERISTIC
/begin CHARACTERISTIC mGSTPI9 "返答可能車両情報タイプ" CURVE 0x00011655 REC_UBYTE_C 0 COMP_0068 0 255
 /begin AXIS_DESCR FIX_AXIS NO_INPUT_QUANTITY COMP_0000_S 4 0 3 FIX_AXIS_PAR_DIST 0 1 4 /end AXIS_DESCR
/end CHARACTERISTIC
/begin CHARACTERISTIC mSPCID10 "Diag_On_CAN_CID識別フラグ1100H－111FH" CURVE 0x00011A28 REC_UBYTE_C 0 COMP_0004 0 255
 /begin AXIS_DESCR FIX_AXIS NO_INPUT_QUANTITY COMP_0000_S 4 0 3 FIX_AXIS_PAR_DIST 0 1 4 /end AXIS_DESCR
/end CHARACTERISTIC
/begin CHARACTERISTIC mSPCID12 "CIDTABLE識別フラグ1120H－113FH" CURVE 0x00011A2C REC_UBYTE_C 0 COMP_0004 0 255
 /begin AXIS_DESCR FIX_AXIS NO_INPUT_QUANTITY COMP_0000_S 4 0 3 FIX_AXIS_PAR_DIST 0 1 4 /end AXIS_DESCR
/end CHARACTERISTIC
/begin CHARACTERISTIC mSPCID14 "CIDTABLE識別フラグ1140H－115FH" CURVE 0x00011A30 REC_UBYTE_C 0 COMP_0004 0 255
 /begin AXIS_DESCR FIX_AXIS NO_INPUT_QUANTITY COMP_0000_S 4 0 3 FIX_AXIS_PAR_DIST 0 1 4 /end AXIS_DESCR
/end CHARACTERISTIC
/begin CHARACTERISTIC mSPCID16 "CIDTABLE識別フラグ1160H－117FH" CURVE 0x00011A34 REC_UBYTE_C 0 COMP_0004 0 255
 /begin AXIS_DESCR FIX_AXIS NO_INPUT_QUANTITY COMP_0000_S 4 0 3 FIX_AXIS_PAR_DIST 0 1 4 /end AXIS_DESCR
/end CHARACTERISTIC
/begin CHARACTERISTIC mSPCID18 "CIDTABLE識別フラグ1180H－119FH(CID_identification_flag_1180H--119FH)" CURVE 0x00011A38 REC_UBYTE_C 0 COMP_0004 0 255
 /begin AXIS_DESCR FIX_AXIS NO_INPUT_QUANTITY COMP_0000_S 4 0 3 FIX_AXIS_PAR_DIST 0 1 4 /end AXIS_DESCR
/end CHARACTERISTIC
/begin CHARACTERISTIC mSPCID20 "CIDTBL識別フラグ1200H－121FH" CURVE 0x00011A3C REC_UBYTE_C 0 COMP_0004 0 255
 /begin AXIS_DESCR FIX_AXIS NO_INPUT_QUANTITY COMP_0000_S 4 0 3 FIX_AXIS_PAR_DIST 0 1 4 /end AXIS_DESCR
/end CHARACTERISTIC
/begin CHARACTERISTIC mSPCID22 "CIDTBL識別フラグ1220H－123FH" CURVE 0x00011A40 REC_UBYTE_C 0 COMP_0004 0 255
 /begin AXIS_DESCR FIX_AXIS NO_INPUT_QUANTITY COMP_0000_S 4 0 3 FIX_AXIS_PAR_DIST 0 1 4 /end AXIS_DESCR
/end CHARACTERISTIC
/begin CHARACTERISTIC mSPCID24 "CIDTBL識別フラグ1241H－1260H" CURVE 0x00011A44 REC_UBYTE_C 0 COMP_0004 0 255
 /begin AXIS_DESCR FIX_AXIS NO_INPUT_QUANTITY COMP_0000_S 4 0 3 FIX_AXIS_PAR_DIST 0 1 4 /end AXIS_DESCR
/end CHARACTERISTIC
/begin CHARACTERISTIC mSPCID26 "CIDTBL識別フラグ1261H－1280H" CURVE 0x00011A48 REC_UBYTE_C 0 COMP_0004 0 255
 /begin AXIS_DESCR FIX_AXIS NO_INPUT_QUANTITY COMP_0000_S 4 0 3 FIX_AXIS_PAR_DIST 0 1 4 /end AXIS_DESCR
/end CHARACTERISTIC
/begin CHARACTERISTIC mSPCID28 "CIDTBL識別フラグ1281H－12A0H" CURVE 0x00011A4C REC_UBYTE_C 0 COMP_0004 0 255
 /begin AXIS_DESCR FIX_AXIS NO_INPUT_QUANTITY COMP_0000_S 4 0 3 FIX_AXIS_PAR_DIST 0 1 4 /end AXIS_DESCR
/end CHARACTERISTIC
/begin CHARACTERISTIC mSPCID30 "CIDTBL識別フラグ1300H－131FH" CURVE 0x00011A50 REC_UBYTE_C 0 COMP_0004 0 255
 /begin AXIS_DESCR FIX_AXIS NO_INPUT_QUANTITY COMP_0000_S 4 0 3 FIX_AXIS_PAR_DIST 0 1 4 /end AXIS_DESCR
/end CHARACTERISTIC
/begin CHARACTERISTIC mSPCID50 "CIDTBL識別フラグ1500H－151FH" CURVE 0x00011A54 REC_UBYTE_C 0 COMP_0004 0 255
 /begin AXIS_DESCR FIX_AXIS NO_INPUT_QUANTITY COMP_0000_S 4 0 3 FIX_AXIS_PAR_DIST 0 1 4 /end AXIS_DESCR
/end CHARACTERISTIC
/begin CHARACTERISTIC mSPIOLID0 "DiagOnCAN__IOLID識別フラグ(01H－20H)" CURVE 0x00011A80 REC_UBYTE_C 0 COMP_0004 0 255
 /begin AXIS_DESCR FIX_AXIS NO_INPUT_QUANTITY COMP_0000_S 4 0 3 FIX_AXIS_PAR_DIST 0 1 4 /end AXIS_DESCR
/end CHARACTERISTIC
/begin CHARACTERISTIC mSPIOLID2 "DiagOnCAN__IOLID識別フラグ(21H－40H)" CURVE 0x00011A84 REC_UBYTE_C 0 COMP_0004 0 255
 /begin AXIS_DESCR FIX_AXIS NO_INPUT_QUANTITY COMP_0000_S 4 0 3 FIX_AXIS_PAR_DIST 0 1 4 /end AXIS_DESCR
/end CHARACTERISTIC
/begin CHARACTERISTIC mSPIOLID4 "DiagOnCAN__IOLID識別フラグ(41H－60H)" CURVE 0x00011A88 REC_UBYTE_C 0 COMP_0004 0 255
 /begin AXIS_DESCR FIX_AXIS NO_INPUT_QUANTITY COMP_0000_S 4 0 3 FIX_AXIS_PAR_DIST 0 1 4 /end AXIS_DESCR
/end CHARACTERISTIC
/begin CHARACTERISTIC mSPIOLID6 "DiagOnCAN__IOLID識別フラグ(61H－80H)" CURVE 0x00011A8C REC_UBYTE_C 0 COMP_0004 0 255
 /begin AXIS_DESCR FIX_AXIS NO_INPUT_QUANTITY COMP_0000_S 4 0 3 FIX_AXIS_PAR_DIST 0 1 4 /end AXIS_DESCR
/end CHARACTERISTIC
/begin CHARACTERISTIC mSPOLID0 "LID識別フラグ" CURVE 0x00011A90 REC_UBYTE_C 0 COMP_0004 0 255
 /begin AXIS_DESCR FIX_AXIS NO_INPUT_QUANTITY COMP_0000_S 4 0 3 FIX_AXIS_PAR_DIST 0 1 4 /end AXIS_DESCR
/end CHARACTERISTIC
/begin CHARACTERISTIC mSPSRLID0 "DiagOnCan_SRLID_identification_flag_(01H-20H)" CURVE 0x00011A94 REC_UBYTE_C 0 COMP_0068 0 255
 /begin AXIS_DESCR FIX_AXIS NO_INPUT_QUANTITY COMP_0000_S 4 0 3 FIX_AXIS_PAR_DIST 0 1 4 /end AXIS_DESCR
/end CHARACTERISTIC
/begin CHARACTERISTIC mSPWDLID0 "DiagOnCAN_WDBLID識別フラグ01H－20H" CURVE 0x00011A98 REC_UBYTE_C 0 COMP_0004 0 255
 /begin AXIS_DESCR FIX_AXIS NO_INPUT_QUANTITY COMP_0000_S 4 0 3 FIX_AXIS_PAR_DIST 0 1 4 /end AXIS_DESCR
/end CHARACTERISTIC
/begin CHARACTERISTIC mSPWDLID2 "DiagOnCAN_WDBLID識別フラグ21H－40H" CURVE 0x00011A9C REC_UBYTE_C 0 COMP_0004 0 255
 /begin AXIS_DESCR FIX_AXIS NO_INPUT_QUANTITY COMP_0000_S 4 0 3 FIX_AXIS_PAR_DIST 0 1 4 /end AXIS_DESCR
/end CHARACTERISTIC
/begin CHARACTERISTIC mSPWDLID4 "DiagOnCAN_WDBLID識別フラグ41H－60H" CURVE 0x00011AA0 REC_UBYTE_C 0 COMP_0004 0 255
 /begin AXIS_DESCR FIX_AXIS NO_INPUT_QUANTITY COMP_0000_S 4 0 3 FIX_AXIS_PAR_DIST 0 1 4 /end AXIS_DESCR
/end CHARACTERISTIC
/begin CHARACTERISTIC mSPWDLID6 "DiagOnCAN_WDBLID識別フラグ61H－7FH" CURVE 0x00011AA4 REC_UBYTE_C 0 COMP_0004 0 255
 /begin AXIS_DESCR FIX_AXIS NO_INPUT_QUANTITY COMP_0000_S 4 0 3 FIX_AXIS_PAR_DIST 0 1 4 /end AXIS_DESCR
/end CHARACTERISTIC
/begin CHARACTERISTIC mTKGZ1MR "PIKGZ1テーブル" CURVE 0x00011542 REC_SBYTE_C 0 COMP_0238 -100 99.21875
 /begin AXIS_DESCR FIX_AXIS NO_INPUT_QUANTITY COMP_0000_S 4 0 3 FIX_AXIS_PAR_DIST 0 1 4 /end AXIS_DESCR
/end CHARACTERISTIC
/begin CHARACTERISTIC mTNIDLADV "N_アイドル_500rpm_化対応点火時期リタード補正量テーブル" CURVE 0x000123C4 REC_UBYTE_C 0 COMP_0017 0 255
 /begin AXIS_DESCR FIX_AXIS NO_INPUT_QUANTITY COMP_0000_S 4 0 3 FIX_AXIS_PAR_DIST 0 1 4 /end AXIS_DESCR
/end CHARACTERISTIC
/begin CHARACTERISTIC mTQRDDN "空気応答遅れD->NIDLE切換えﾃﾞｨﾚｲﾃｰﾌﾞﾙ" CURVE 0x00012644 REC_UBYTE_C 0 COMP_0014 0 2550
 /begin AXIS_DESCR FIX_AXIS NO_INPUT_QUANTITY COMP_0000_S 4 0 3 FIX_AXIS_PAR_DIST 0 1 4 /end AXIS_DESCR
/end CHARACTERISTIC
/begin CHARACTERISTIC mTQRDND "空気応答遅れNIDLE->D切換えﾃﾞｨﾚｲﾃｰﾌﾞﾙ" CURVE 0x00012648 REC_UBYTE_C 0 COMP_0014 0 2550
 /begin AXIS_DESCR FIX_AXIS NO_INPUT_QUANTITY COMP_0000_S 4 0 3 FIX_AXIS_PAR_DIST 0 1 4 /end AXIS_DESCR
/end CHARACTERISTIC
/begin CHARACTERISTIC mCRCAT "失火判定触媒ｸﾗｲﾃﾘｱ" CURVE 0x000115FF REC_UBYTE_C 0 COMP_0074 0 0.99609375
 /begin AXIS_DESCR FIX_AXIS NO_INPUT_QUANTITY COMP_0000_S 5 0 4 FIX_AXIS_PAR_DIST 0 1 5 /end AXIS_DESCR
/end CHARACTERISTIC
/begin CHARACTERISTIC mSWID "SWMONT識別フラグ" CURVE 0x00011AAB REC_UBYTE_C 0 COMP_0004 0 255
 /begin AXIS_DESCR FIX_AXIS NO_INPUT_QUANTITY COMP_0000_S 5 0 4 FIX_AXIS_PAR_DIST 0 1 5 /end AXIS_DESCR
/end CHARACTERISTIC
/begin CHARACTERISTIC mECUNO "部品番号" CURVE 0x00011629 REC_UBYTE_C 0 COMP_0004 0 255
 /begin AXIS_DESCR FIX_AXIS NO_INPUT_QUANTITY COMP_0000_S 6 0 5 FIX_AXIS_PAR_DIST 0 1 6 /end AXIS_DESCR
/end CHARACTERISTIC
/begin CHARACTERISTIC mFSRTEND "SRTEND識別フラグ" CURVE 0x00011637 REC_UBYTE_C 0 COMP_0004 0 255
 /begin AXIS_DESCR FIX_AXIS NO_INPUT_QUANTITY COMP_0000_S 6 0 5 FIX_AXIS_PAR_DIST 0 1 6 /end AXIS_DESCR
/end CHARACTERISTIC
/begin CHARACTERISTIC mFSRTRSL "SRTRSL識別フラグ" CURVE 0x0001163D REC_UBYTE_C 0 COMP_0004 0 255
 /begin AXIS_DESCR FIX_AXIS NO_INPUT_QUANTITY COMP_0000_S 6 0 5 FIX_AXIS_PAR_DIST 0 1 6 /end AXIS_DESCR
/end CHARACTERISTIC
/begin CHARACTERISTIC mFSRTTST "SRTTST識別フラグ" CURVE 0x00011643 REC_UBYTE_C 0 COMP_0004 0 255
 /begin AXIS_DESCR FIX_AXIS NO_INPUT_QUANTITY COMP_0000_S 6 0 5 FIX_AXIS_PAR_DIST 0 1 6 /end AXIS_DESCR
/end CHARACTERISTIC
/begin CHARACTERISTIC mTRLCY2 "気筒別補正値ﾃｰﾌﾞﾙ" CURVE 0x000126B8 REC_UBYTE_C 0 COMP_0045 0 1.9921875
 /begin AXIS_DESCR FIX_AXIS NO_INPUT_QUANTITY COMP_0000_S 6 0 5 FIX_AXIS_PAR_DIST 0 1 6 /end AXIS_DESCR
/end CHARACTERISTIC
/begin CHARACTERISTIC mMASKAIH "周波数マスク上限ITAC(Frequency_mask_upper_limit_ITAC)" CURVE 0x000118FF REC_UBYTE_C 0 COMP_0009 0 199.21875
 /begin AXIS_DESCR FIX_AXIS NO_INPUT_QUANTITY COMP_0000_S 8 0 7 FIX_AXIS_PAR_DIST 0 1 8 /end AXIS_DESCR
/end CHARACTERISTIC
/begin CHARACTERISTIC mMASKAIL "周波数マスク下限ITAC(Frequency_mask_lower_limit_ITAC)" CURVE 0x00011907 REC_UBYTE_C 0 COMP_0009 0 199.21875
 /begin AXIS_DESCR FIX_AXIS NO_INPUT_QUANTITY COMP_0000_S 8 0 7 FIX_AXIS_PAR_DIST 0 1 8 /end AXIS_DESCR
/end CHARACTERISTIC
/begin CHARACTERISTIC mMASKANH "周波数マスク上限回転数(Frequency_mask_upper_limit_engine_speed)" CURVE 0x0001190F REC_UBYTE_C 0 COMP_0000 0 6375
 /begin AXIS_DESCR FIX_AXIS NO_INPUT_QUANTITY COMP_0000_S 8 0 7 FIX_AXIS_PAR_DIST 0 1 8 /end AXIS_DESCR
/end CHARACTERISTIC
/begin CHARACTERISTIC mMASKANL "周波数マスク下限回転数(Frequency_mask_lower_limit_engine_speed)" CURVE 0x00011917 REC_UBYTE_C 0 COMP_0000 0 6375
 /begin AXIS_DESCR FIX_AXIS NO_INPUT_QUANTITY COMP_0000_S 8 0 7 FIX_AXIS_PAR_DIST 0 1 8 /end AXIS_DESCR
/end CHARACTERISTIC
/begin CHARACTERISTIC mTGZCYLI "気筒別割込噴射噴射時期補正率" CURVE 0x00011EF4 REC_UBYTE_C 0 COMP_0186 0 3.984375
 /begin AXIS_DESCR FIX_AXIS NO_INPUT_QUANTITY COMP_0000_S 8 0 7 FIX_AXIS_PAR_DIST 0 1 8 /end AXIS_DESCR
/end CHARACTERISTIC
/begin CHARACTERISTIC mTLBLRC "学習ﾏｯﾌﾟTP軸格子点ﾃｰﾌﾞﾙ" CURVE 0x0001223C REC_UBYTE_C 0 COMP_0001 0 31.875
 /begin AXIS_DESCR FIX_AXIS NO_INPUT_QUANTITY COMP_0000_S 8 0 7 FIX_AXIS_PAR_DIST 0 1 8 /end AXIS_DESCR
/end CHARACTERISTIC
/begin CHARACTERISTIC mTNBLRC "学習ﾏｯﾌﾟN軸格子点ﾃｰﾌﾞﾙ" CURVE 0x00012384 REC_UBYTE_C 0 COMP_0020 0 12750
 /begin AXIS_DESCR FIX_AXIS NO_INPUT_QUANTITY COMP_0000_S 8 0 7 FIX_AXIS_PAR_DIST 0 1 8 /end AXIS_DESCR
/end CHARACTERISTIC
/begin CHARACTERISTIC mTSFRQHT "ヒータ変速線要求値配列テーブル(Heater_shift_map_demand_value_table)" CURVE 0x00012742 REC_UBYTE_C 0 COMP_0004_S -50 205
 /begin AXIS_DESCR FIX_AXIS NO_INPUT_QUANTITY COMP_0000_S 8 0 7 FIX_AXIS_PAR_DIST 0 1 8 /end AXIS_DESCR
/end CHARACTERISTIC
/begin CHARACTERISTIC mDOID "DOMON識別フラグ" CURVE 0x00011618 REC_UBYTE_C 0 COMP_0004 0 255
 /begin AXIS_DESCR FIX_AXIS NO_INPUT_QUANTITY COMP_0000_S 9 0 8 FIX_AXIS_PAR_DIST 0 1 9 /end AXIS_DESCR
/end CHARACTERISTIC
/begin CHARACTERISTIC mAFBTP "AFMﾊﾞｯｸｱｯﾌﾟTP" CURVE 0x00009862 REC_UBYTE_C 0 COMP_0001 0 31.875
 /begin AXIS_DESCR FIX_AXIS NO_INPUT_QUANTITY COMP_0000_S 12 0 11 FIX_AXIS_PAR_DIST 0 1 12 /end AXIS_DESCR
/end CHARACTERISTIC
/begin CHARACTERISTIC mA0QA1 "ROM Const mA0QA1" VALUE 0x00008DD6 REC_SWORD_C 0 COMP_0005_S -3.2768 3.2767 /end CHARACTERISTIC
/begin CHARACTERISTIC mA0QA12 "ROM Const mA0QA12" VALUE 0x00008DD8 REC_SWORD_C 0 COMP_0005_S -3.2768 3.2767 /end CHARACTERISTIC
/begin CHARACTERISTIC mA0QA2 "ROM Const mA0QA2" VALUE 0x00008DDA REC_SWORD_C 0 COMP_0005_S -3.2768 3.2767 /end CHARACTERISTIC
/begin CHARACTERISTIC mA0QA22 "ROM Const mA0QA22" VALUE 0x00008DDC REC_SWORD_C 0 COMP_0005_S -3.2768 3.2767 /end CHARACTERISTIC
/begin CHARACTERISTIC mA0QA3 "ROM Const mA0QA3" VALUE 0x00008DDE REC_SWORD_C 0 COMP_0005_S -3.2768 3.2767 /end CHARACTERISTIC
/begin CHARACTERISTIC mA0QA32 "ROM Const mA0QA32" VALUE 0x00008DE0 REC_SWORD_C 0 COMP_0005_S -3.2768 3.2767 /end CHARACTERISTIC
/begin CHARACTERISTIC mA1QA1 "ROM Const mA1QA1" VALUE 0x00008DE2 REC_SWORD_C 0 COMP_0005_S -3.2768 3.2767 /end CHARACTERISTIC
/begin CHARACTERISTIC mA1QA12 "ROM Const mA1QA12" VALUE 0x00008DE4 REC_SWORD_C 0 COMP_0005_S -3.2768 3.2767 /end CHARACTERISTIC
/begin CHARACTERISTIC mA1QA2 "ROM Const mA1QA2" VALUE 0x00008DE6 REC_SWORD_C 0 COMP_0005_S -3.2768 3.2767 /end CHARACTERISTIC
/begin CHARACTERISTIC mA1QA22 "ROM Const mA1QA22" VALUE 0x00008DE8 REC_SWORD_C 0 COMP_0005_S -3.2768 3.2767 /end CHARACTERISTIC
/begin CHARACTERISTIC mA1QA3 "ROM Const mA1QA3" VALUE 0x00008DEA REC_SWORD_C 0 COMP_0005_S -3.2768 3.2767 /end CHARACTERISTIC
/begin CHARACTERISTIC mA1QA32 "ROM Const mA1QA32" VALUE 0x00008DEC REC_SWORD_C 0 COMP_0005_S -3.2768 3.2767 /end CHARACTERISTIC
/begin CHARACTERISTIC mA21 "ROM Const mA21" VALUE 0x00008EEE REC_UWORD_C 0 COMP_0388 0 6553.5 /end CHARACTERISTIC
/begin CHARACTERISTIC mA22 "ROM Const mA22" VALUE 0x00008EF0 REC_UWORD_C 0 COMP_0373 0 655.35 /end CHARACTERISTIC
/begin CHARACTERISTIC mA5TP1 "ROM Const mA5TP1" VALUE 0x00008250 REC_UBYTE_C 0 COMP_0001 0 31.875 /end CHARACTERISTIC
/begin CHARACTERISTIC mA5TVO "ROM Const mA5TVO" VALUE 0x00008251 REC_UBYTE_C 0 COMP_0002 0 89.25 /end CHARACTERISTIC
/begin CHARACTERISTIC mA5TWD "ROM Const mA5TWD" VALUE 0x00008252 REC_UBYTE_C 0 COMP_0003 0 255 /end CHARACTERISTIC
/begin CHARACTERISTIC mA5TWH "ROM Const mA5TWH" VALUE 0x00008253 REC_UBYTE_C 0 COMP_0035 -50 205 /end CHARACTERISTIC
/begin CHARACTERISTIC mABFAV "ROM Const mABFAV" VALUE 0x00008254 REC_UBYTE_C 0 COMP_0045 0 1.9921875 /end CHARACTERISTIC
/begin CHARACTERISTIC mABFCMPV "ROM Const mABFCMPV" VALUE 0x00008EF2 REC_UWORD_C 0 COMP_0453 0 131.07 /end CHARACTERISTIC
/begin CHARACTERISTIC mABFESL "ROM Const mABFESL" VALUE 0x00008EF4 REC_UWORD_C 0 COMP_0453 0 131.07 /end CHARACTERISTIC
/begin CHARACTERISTIC mABFHT "ROM Const mABFHT" VALUE 0x00008EF6 REC_UWORD_C 0 COMP_0453 0 131.07 /end CHARACTERISTIC
/begin CHARACTERISTIC mACADLY "ROM Const mACADLY" VALUE 0x00008255 REC_UBYTE_C 0 COMP_0004 0 255 /end CHARACTERISTIC
/begin CHARACTERISTIC mACCCOMH "ROM Const mACCCOMH" VALUE 0x00009690 REC_SLONG_C 0 COMP_0006_S -512.000903872512 512.000903634093 /end CHARACTERISTIC
/begin CHARACTERISTIC mACCDAPOS "ROM Const mACCDAPOS" VALUE 0x00008EF8 REC_UWORD_C 0 COMP_0007_S 0 7208.85 /end CHARACTERISTIC
/begin CHARACTERISTIC mACCDMAPO "ROM Const mACCDMAPO" VALUE 0x00008EFA REC_UWORD_C 0 COMP_0005 0 7208.85 /end CHARACTERISTIC
/begin CHARACTERISTIC mACCDMPR "ROM Const mACCDMPR" VALUE 0x00008257 REC_UBYTE_C 0 COMP_0008_S 0 7.96875 /end CHARACTERISTIC
/begin CHARACTERISTIC mACCHYS "ROM Const mACCHYS" VALUE 0x00009694 REC_SLONG_C 0 COMP_0006_S -512.000903872512 512.000903634093 /end CHARACTERISTIC
/begin CHARACTERISTIC mACCMAX "ROM Const mACCMAX" VALUE 0x00009698 REC_SLONG_C 0 COMP_0006_S -512.000903872512 512.000903634093 /end CHARACTERISTIC
/begin CHARACTERISTIC mACCMDLH "ROM Const mACCMDLH" VALUE 0x0000969C REC_SLONG_C 0 COMP_0006_S -512.000903872512 512.000903634093 /end CHARACTERISTIC
/begin CHARACTERISTIC mACCMIN "ROM Const mACCMIN" VALUE 0x000096A0 REC_SLONG_C 0 COMP_0006_S -512.000903872512 512.000903634093 /end CHARACTERISTIC
/begin CHARACTERISTIC mACCMPRH "ROM Const mACCMPRH" VALUE 0x00008EFC REC_UWORD_C 0 COMP_0068 0 65535 /end CHARACTERISTIC
/begin CHARACTERISTIC mACCMPRL "ROM Const mACCMPRL" VALUE 0x00008EFE REC_UWORD_C 0 COMP_0068 0 65535 /end CHARACTERISTIC
/begin CHARACTERISTIC mACCUTN "ROM Const mACCUTN" VALUE 0x00008258 REC_UBYTE_C 0 COMP_0006 0 3187.5 /end CHARACTERISTIC
/begin CHARACTERISTIC mACCUTN2 "ROM Const mACCUTN2" VALUE 0x00008259 REC_UBYTE_C 0 COMP_0006 0 3187.5 /end CHARACTERISTIC
/begin CHARACTERISTIC mACDH "ROM Const mACDH" VALUE 0x0000825A REC_UBYTE_C 0 COMP_0006 0 3187.5 /end CHARACTERISTIC
/begin CHARACTERISTIC mACDL "ROM Const mACDL" VALUE 0x0000825B REC_UBYTE_C 0 COMP_0006 0 3187.5 /end CHARACTERISTIC
/begin CHARACTERISTIC mACDM "ROM Const mACDM" VALUE 0x0000825C REC_UBYTE_C 0 COMP_0006 0 3187.5 /end CHARACTERISTIC
/begin CHARACTERISTIC mACDTMPH "ROM Const mACDTMPH" VALUE 0x0000825D REC_UBYTE_C 0 COMP_0009_S 0 84.9999915 /end CHARACTERISTIC
/begin CHARACTERISTIC mACDTMPL "ROM Const mACDTMPL" VALUE 0x0000825E REC_UBYTE_C 0 COMP_0009_S 0 84.9999915 /end CHARACTERISTIC
/begin CHARACTERISTIC mACDTMPM "ROM Const mACDTMPM" VALUE 0x0000825F REC_UBYTE_C 0 COMP_0009_S 0 84.9999915 /end CHARACTERISTIC
/begin CHARACTERISTIC mACDYFF "ROM Const mACDYFF" VALUE 0x00008260 REC_UBYTE_C 0 COMP_0008 0 25500 /end CHARACTERISTIC
/begin CHARACTERISTIC mACNH "ROM Const mACNH" VALUE 0x00008261 REC_UBYTE_C 0 COMP_0006 0 3187.5 /end CHARACTERISTIC
/begin CHARACTERISTIC mACNIDY "ROM Const mACNIDY" VALUE 0x00008262 REC_UBYTE_C 0 COMP_0014 0 2550 /end CHARACTERISTIC
/begin CHARACTERISTIC mACNL "ROM Const mACNL" VALUE 0x00008263 REC_UBYTE_C 0 COMP_0006 0 3187.5 /end CHARACTERISTIC
/begin CHARACTERISTIC mACNM "ROM Const mACNM" VALUE 0x00008264 REC_UBYTE_C 0 COMP_0006 0 3187.5 /end CHARACTERISTIC
/begin CHARACTERISTIC mACOFDY "ROM Const mACOFDY" VALUE 0x00008265 REC_UBYTE_C 0 COMP_0008 0 25500 /end CHARACTERISTIC
/begin CHARACTERISTIC mACOFHS "ROM Const mACOFHS" VALUE 0x00008266 REC_UBYTE_C 0 COMP_0009 0 199.21875 /end CHARACTERISTIC
/begin CHARACTERISTIC mACOKPD "ROM Const mACOKPD" VALUE 0x00008267 REC_UBYTE_C 0 COMP_0010 0 0.765 /end CHARACTERISTIC
/begin CHARACTERISTIC mACONDY "ROM Const mACONDY" VALUE 0x00008268 REC_UBYTE_C 0 COMP_0008 0 25500 /end CHARACTERISTIC
/begin CHARACTERISTIC mACONPH "ROM Const mACONPH" VALUE 0x00008269 REC_UBYTE_C 0 COMP_0012 0 5.1 /end CHARACTERISTIC
/begin CHARACTERISTIC mACONPL "ROM Const mACONPL" VALUE 0x0000826A REC_UBYTE_C 0 COMP_0011 0 5.1 /end CHARACTERISTIC
/begin CHARACTERISTIC mACONRD "ROM Const mACONRD" VALUE 0x0000826B REC_UBYTE_C 0 COMP_0013 0 255 /end CHARACTERISTIC
/begin CHARACTERISTIC mACPDPRS1 "ROM Const mACPDPRS1" VALUE 0x0000826C REC_UBYTE_C 0 COMP_0011 0 5.1 /end CHARACTERISTIC
/begin CHARACTERISTIC mACPDPRS2 "ROM Const mACPDPRS2" VALUE 0x0000826D REC_UBYTE_C 0 COMP_0011 0 5.1 /end CHARACTERISTIC
/begin CHARACTERISTIC mACPDPRS3 "ROM Const mACPDPRS3" VALUE 0x0000826E REC_UBYTE_C 0 COMP_0011 0 5.1 /end CHARACTERISTIC
/begin CHARACTERISTIC mACRECN "ROM Const mACRECN" VALUE 0x0000826F REC_UBYTE_C 0 COMP_0006 0 3187.5 /end CHARACTERISTIC
/begin CHARACTERISTIC mACRECN2 "ROM Const mACRECN2" VALUE 0x00008270 REC_UBYTE_C 0 COMP_0006 0 3187.5 /end CHARACTERISTIC
/begin CHARACTERISTIC mACREDY "ROM Const mACREDY" VALUE 0x00008271 REC_UBYTE_C 0 COMP_0008 0 25500 /end CHARACTERISTIC
/begin CHARACTERISTIC mACRQF "ROM Const mACRQF" VALUE 0x00008F00 REC_UWORD_C 0 COMP_0010_S 0 6.5535 /end CHARACTERISTIC
/begin CHARACTERISTIC mACSTDY "ROM Const mACSTDY" VALUE 0x00008272 REC_UBYTE_C 0 COMP_0008 0 25500 /end CHARACTERISTIC
/begin CHARACTERISTIC mACTMIN "ROM Const mACTMIN" VALUE 0x00008273 REC_UBYTE_C 0 COMP_0000 0 6375 /end CHARACTERISTIC
/begin CHARACTERISTIC mACTTW "ROM Const mACTTW" VALUE 0x00008274 REC_UBYTE_C 0 COMP_0035 -50 205 /end CHARACTERISTIC
/begin CHARACTERISTIC mACVSP1 "ROM Const mACVSP1" VALUE 0x00008275 REC_UBYTE_C 0 COMP_0007 0 510 /end CHARACTERISTIC
/begin CHARACTERISTIC mACVSP2 "ROM Const mACVSP2" VALUE 0x00008276 REC_UBYTE_C 0 COMP_0007 0 510 /end CHARACTERISTIC
/begin CHARACTERISTIC mACVSP3 "ROM Const mACVSP3" VALUE 0x00008277 REC_UBYTE_C 0 COMP_0007 0 510 /end CHARACTERISTIC
/begin CHARACTERISTIC mADCGDALP "ROM Const mADCGDALP" VALUE 0x00008278 REC_UBYTE_C 0 COMP_0047 0 127.5 /end CHARACTERISTIC
/begin CHARACTERISTIC mADCGOKPR "ROM Const mADCGOKPR" VALUE 0x00008279 REC_UBYTE_C 0 COMP_0163 0 15.9375 /end CHARACTERISTIC
/begin CHARACTERISTIC mADCGOKTM "ROM Const mADCGOKTM" VALUE 0x0000827A REC_UBYTE_C 0 COMP_0011_S 0 510 /end CHARACTERISTIC
/begin CHARACTERISTIC mADCGPMPR "ROM Const mADCGPMPR" VALUE 0x0000827B REC_UBYTE_C 0 COMP_0163 0 15.9375 /end CHARACTERISTIC
/begin CHARACTERISTIC mADCGPRS "ROM Const mADCGPRS" VALUE 0x00008F02 REC_UWORD_C 0 COMP_0486 0 5119.921875 /end CHARACTERISTIC
/begin CHARACTERISTIC mADDLIM "ROM Const mADDLIM" VALUE 0x00008F04 REC_UWORD_C 0 COMP_0012_S -32768 32767 /end CHARACTERISTIC
/begin CHARACTERISTIC mADDLIM2 "ROM Const mADDLIM2" VALUE 0x000097B0 REC_ULONG_C 0 COMP_0013_S -8388608 8388607.99609375 /end CHARACTERISTIC
/begin CHARACTERISTIC mADJDLY "ROM Const mADJDLY" VALUE 0x0000827C REC_UBYTE_C 0 COMP_0008 0 25500 /end CHARACTERISTIC
/begin CHARACTERISTIC mADJINI "ROM Const mADJINI" VALUE 0x00008DEE REC_SWORD_C 0 COMP_0353 -163840 163835 /end CHARACTERISTIC
/begin CHARACTERISTIC mADLOCK "ROM Const mADLOCK" VALUE 0x0000827D REC_UBYTE_C 0 COMP_0009 0 199.21875 /end CHARACTERISTIC
/begin CHARACTERISTIC mADTYDWN "ROM Const mADTYDWN" VALUE 0x0000827E REC_UBYTE_C 0 COMP_0047 0 127.5 /end CHARACTERISTIC
/begin CHARACTERISTIC mADTYUP "ROM Const mADTYUP" VALUE 0x0000827F REC_UBYTE_C 0 COMP_0047 0 127.5 /end CHARACTERISTIC
/begin CHARACTERISTIC mADVADH "ROM Const mADVADH" VALUE 0x0000821C REC_SBYTE_C 0 COMP_0018 -128 127 /end CHARACTERISTIC
/begin CHARACTERISTIC mADVADL "ROM Const mADVADL" VALUE 0x0000821D REC_SBYTE_C 0 COMP_0018 -128 127 /end CHARACTERISTIC
/begin CHARACTERISTIC mADVAMX "ROM Const mADVAMX" VALUE 0x0000821E REC_SBYTE_C 0 COMP_0018 -128 127 /end CHARACTERISTIC
/begin CHARACTERISTIC mADVCH "ROM Const mADVCH" VALUE 0x0000821F REC_SBYTE_C 0 COMP_0018 -128 127 /end CHARACTERISTIC
/begin CHARACTERISTIC mADVCH2 "ROM Const mADVCH2" VALUE 0x00008220 REC_SBYTE_C 0 COMP_0018 -128 127 /end CHARACTERISTIC
/begin CHARACTERISTIC mADVCHS "ROM Const mADVCHS" VALUE 0x00008221 REC_SBYTE_C 0 COMP_0018 -128 127 /end CHARACTERISTIC
/begin CHARACTERISTIC mADVDLY2 "ROM Const mADVDLY2" VALUE 0x00008280 REC_UBYTE_C 0 COMP_0008 0 25500 /end CHARACTERISTIC
/begin CHARACTERISTIC mADVDN "ROM Const mADVDN" VALUE 0x00008281 REC_UBYTE_C 0 COMP_0000 0 6375 /end CHARACTERISTIC
/begin CHARACTERISTIC mADVFAL "ROM Const mADVFAL" VALUE 0x00008222 REC_SBYTE_C 0 COMP_0018 -128 127 /end CHARACTERISTIC
/begin CHARACTERISTIC mADVINT "ROM Const mADVINT" VALUE 0x00008282 REC_UBYTE_C 0 COMP_0019 0 255 /end CHARACTERISTIC
/begin CHARACTERISTIC mADVLMT "ROM Const mADVLMT" VALUE 0x00008283 REC_UBYTE_C 0 COMP_0017 0 255 /end CHARACTERISTIC
/begin CHARACTERISTIC mADVLMT0 "ROM Const mADVLMT0" VALUE 0x00008284 REC_UBYTE_C 0 COMP_0017 0 255 /end CHARACTERISTIC
/begin CHARACTERISTIC mADVLMT1 "ROM Const mADVLMT1" VALUE 0x00008285 REC_UBYTE_C 0 COMP_0017 0 255 /end CHARACTERISTIC
/begin CHARACTERISTIC mADVLMT2 "ROM Const mADVLMT2" VALUE 0x00008286 REC_UBYTE_C 0 COMP_0017 0 255 /end CHARACTERISTIC
/begin CHARACTERISTIC mADVLMT3 "ROM Const mADVLMT3" VALUE 0x00008287 REC_UBYTE_C 0 COMP_0017 0 255 /end CHARACTERISTIC
/begin CHARACTERISTIC mADVLMTCC "ROM Const mADVLMTCC" VALUE 0x00008288 REC_UBYTE_C 0 COMP_0017 0 255 /end CHARACTERISTIC
/begin CHARACTERISTIC mADVLMTG "ROM Const mADVLMTG" VALUE 0x00008289 REC_UBYTE_C 0 COMP_0017 0 255 /end CHARACTERISTIC
/begin CHARACTERISTIC mADVLMTIT "ROM Const mADVLMTIT" VALUE 0x0000828A REC_UBYTE_C 0 COMP_0017 0 255 /end CHARACTERISTIC
/begin CHARACTERISTIC mADVLMTPI "ROM Const mADVLMTPI" VALUE 0x0000828B REC_UBYTE_C 0 COMP_0014_S 0 255 /end CHARACTERISTIC
/begin CHARACTERISTIC mADVLMTS "ROM Const mADVLMTS" VALUE 0x0000828C REC_UBYTE_C 0 COMP_0017 0 255 /end CHARACTERISTIC
/begin CHARACTERISTIC mADVLMTSH "ROM Const mADVLMTSH" VALUE 0x0000828D REC_UBYTE_C 0 COMP_0017 0 255 /end CHARACTERISTIC
/begin CHARACTERISTIC mADVN1 "ROM Const mADVN1" VALUE 0x0000828E REC_UBYTE_C 0 COMP_0020 0 12750 /end CHARACTERISTIC
/begin CHARACTERISTIC mADVN2 "ROM Const mADVN2" VALUE 0x0000828F REC_UBYTE_C 0 COMP_0020 0 12750 /end CHARACTERISTIC
/begin CHARACTERISTIC mADVNEH "ROM Const mADVNEH" VALUE 0x00008290 REC_UBYTE_C 0 COMP_0006 0 3187.5 /end CHARACTERISTIC
/begin CHARACTERISTIC mADVNEL "ROM Const mADVNEL" VALUE 0x00008291 REC_UBYTE_C 0 COMP_0006 0 3187.5 /end CHARACTERISTIC
/begin CHARACTERISTIC mADVOFS "ROM Const mADVOFS" VALUE 0x00008223 REC_SBYTE_C 0 COMP_0018 -128 127 /end CHARACTERISTIC
/begin CHARACTERISTIC mADVRMX "ROM Const mADVRMX" VALUE 0x00008224 REC_SBYTE_C 0 COMP_0018 -128 127 /end CHARACTERISTIC
/begin CHARACTERISTIC mADVRMX2 "ROM Const mADVRMX2" VALUE 0x00008225 REC_SBYTE_C 0 COMP_0018 -128 127 /end CHARACTERISTIC
/begin CHARACTERISTIC mADVSPRG "ROM Const mADVSPRG" VALUE 0x00008F06 REC_UWORD_C 0 COMP_0081 0 255.99609375 /end CHARACTERISTIC
/begin CHARACTERISTIC mADVSPRT "ROM Const mADVSPRT" VALUE 0x00008F08 REC_UWORD_C 0 COMP_0081 0 255.99609375 /end CHARACTERISTIC
/begin CHARACTERISTIC mADVSTDLY "ROM Const mADVSTDLY" VALUE 0x00008292 REC_UBYTE_C 0 COMP_0008 0 25500 /end CHARACTERISTIC
/begin CHARACTERISTIC mADVSTRG0 "ROM Const mADVSTRG0" VALUE 0x00008F0A REC_UWORD_C 0 COMP_0081 0 255.99609375 /end CHARACTERISTIC
/begin CHARACTERISTIC mADVSTRG1 "ROM Const mADVSTRG1" VALUE 0x00008F0C REC_UWORD_C 0 COMP_0081 0 255.99609375 /end CHARACTERISTIC
/begin CHARACTERISTIC mADVSTRT0 "ROM Const mADVSTRT0" VALUE 0x00008F0E REC_UWORD_C 0 COMP_0081 0 255.99609375 /end CHARACTERISTIC
/begin CHARACTERISTIC mADVSTRT1 "ROM Const mADVSTRT1" VALUE 0x00008F10 REC_UWORD_C 0 COMP_0081 0 255.99609375 /end CHARACTERISTIC
/begin CHARACTERISTIC mADVTP1 "ROM Const mADVTP1" VALUE 0x00008293 REC_UBYTE_C 0 COMP_0001 0 31.875 /end CHARACTERISTIC
/begin CHARACTERISTIC mADVTP2 "ROM Const mADVTP2" VALUE 0x00008294 REC_UBYTE_C 0 COMP_0001 0 31.875 /end CHARACTERISTIC
/begin CHARACTERISTIC mADVVSPH "ROM Const mADVVSPH" VALUE 0x00008295 REC_UBYTE_C 0 COMP_0007 0 510 /end CHARACTERISTIC
/begin CHARACTERISTIC mADVVSPL "ROM Const mADVVSPL" VALUE 0x00008296 REC_UBYTE_C 0 COMP_0007 0 510 /end CHARACTERISTIC
/begin CHARACTERISTIC mAFACTH "ROM Const mAFACTH" VALUE 0x00008F12 REC_UWORD_C 0 COMP_0217 0 3.999941832 /end CHARACTERISTIC
/begin CHARACTERISTIC mAFACTL "ROM Const mAFACTL" VALUE 0x00008F14 REC_UWORD_C 0 COMP_0217 0 3.999941832 /end CHARACTERISTIC
/begin CHARACTERISTIC mAFCH "ROM Const mAFCH" VALUE 0x00008F16 REC_UWORD_C 0 COMP_0023 0 327675 /end CHARACTERISTIC
/begin CHARACTERISTIC mAFCL "ROM Const mAFCL" VALUE 0x00008F18 REC_UWORD_C 0 COMP_0023 0 327675 /end CHARACTERISTIC
/begin CHARACTERISTIC mAFCLFNVS "ROM Const mAFCLFNVS" VALUE 0x00008297 REC_UBYTE_C 0 COMP_0068 0 255 /end CHARACTERISTIC
/begin CHARACTERISTIC mAFCLT1 "ROM Const mAFCLT1" VALUE 0x00008298 REC_UBYTE_C 0 COMP_0250 0 1020 /end CHARACTERISTIC
/begin CHARACTERISTIC mAFCLT2 "ROM Const mAFCLT2" VALUE 0x00008299 REC_UBYTE_C 0 COMP_0014 0 2550 /end CHARACTERISTIC
/begin CHARACTERISTIC mAFCLTAO1 "ROM Const mAFCLTAO1" VALUE 0x0000829A REC_UBYTE_C 0 COMP_0035 -50 205 /end CHARACTERISTIC
/begin CHARACTERISTIC mAFCLTAO2 "ROM Const mAFCLTAO2" VALUE 0x0000829B REC_UBYTE_C 0 COMP_0035 -50 205 /end CHARACTERISTIC
/begin CHARACTERISTIC mAFCLTAO3 "ROM Const mAFCLTAO3" VALUE 0x0000829C REC_UBYTE_C 0 COMP_0035 -50 205 /end CHARACTERISTIC
/begin CHARACTERISTIC mAFCLTMS1 "ROM Const mAFCLTMS1" VALUE 0x0000829D REC_UBYTE_C 0 COMP_0068 0 255 /end CHARACTERISTIC
/begin CHARACTERISTIC mAFCLTMS2 "ROM Const mAFCLTMS2" VALUE 0x0000829E REC_UBYTE_C 0 COMP_0068 0 255 /end CHARACTERISTIC
/begin CHARACTERISTIC mAFCLTMS3 "ROM Const mAFCLTMS3" VALUE 0x0000829F REC_UBYTE_C 0 COMP_0068 0 255 /end CHARACTERISTIC
/begin CHARACTERISTIC mAFCLTMS4 "ROM Const mAFCLTMS4" VALUE 0x000082A0 REC_UBYTE_C 0 COMP_0068 0 255 /end CHARACTERISTIC
/begin CHARACTERISTIC mAFCLTMS5 "ROM Const mAFCLTMS5" VALUE 0x000082A1 REC_UBYTE_C 0 COMP_0068 0 255 /end CHARACTERISTIC
/begin CHARACTERISTIC mAFCLTMS6 "ROM Const mAFCLTMS6" VALUE 0x000082A2 REC_UBYTE_C 0 COMP_0068 0 255 /end CHARACTERISTIC
/begin CHARACTERISTIC mAFCLTV "ROM Const mAFCLTV" VALUE 0x000082A3 REC_UBYTE_C 0 COMP_0002 0 89.25 /end CHARACTERISTIC
/begin CHARACTERISTIC mAFCLVB "ROM Const mAFCLVB" VALUE 0x000082A4 REC_UBYTE_C 0 COMP_0033 0 20400 /end CHARACTERISTIC
/begin CHARACTERISTIC mAFCRCD "ROM Const mAFCRCD" VALUE 0x00008F1A REC_UWORD_C 0 COMP_0014 0 655350 /end CHARACTERISTIC
/begin CHARACTERISTIC mAFDAFH "ROM Const mAFDAFH" VALUE 0x00008F1C REC_UWORD_C 0 COMP_0453 0 131.07 /end CHARACTERISTIC
/begin CHARACTERISTIC mAFDAFL "ROM Const mAFDAFL" VALUE 0x00008F1E REC_UWORD_C 0 COMP_0453 0 131.07 /end CHARACTERISTIC
/begin CHARACTERISTIC mAFDALPH "ROM Const mAFDALPH" VALUE 0x000082A5 REC_UBYTE_C 0 COMP_0027 0 255 /end CHARACTERISTIC
/begin CHARACTERISTIC mAFDALPL "ROM Const mAFDALPL" VALUE 0x000082A6 REC_UBYTE_C 0 COMP_0027 0 255 /end CHARACTERISTIC
/begin CHARACTERISTIC mAFDDVTC "ROM Const mAFDDVTC" VALUE 0x000082A7 REC_UBYTE_C 0 COMP_0266 0 127.5 /end CHARACTERISTIC
/begin CHARACTERISTIC mAFDHDLY "ROM Const mAFDHDLY" VALUE 0x000082A8 REC_UBYTE_C 0 COMP_0015_S 0 25.5 /end CHARACTERISTIC
/begin CHARACTERISTIC mAFDIFAF "ROM Const mAFDIFAF" VALUE 0x00008F20 REC_UWORD_C 0 COMP_0453 0 131.07 /end CHARACTERISTIC
/begin CHARACTERISTIC mAFDQAD "ROM Const mAFDQAD" VALUE 0x00008F22 REC_UWORD_C 0 COMP_0068 0 65535 /end CHARACTERISTIC
/begin CHARACTERISTIC mAFDQAH "ROM Const mAFDQAH" VALUE 0x00008F24 REC_UWORD_C 0 COMP_0068 0 65535 /end CHARACTERISTIC
/begin CHARACTERISTIC mAFDQAL "ROM Const mAFDQAL" VALUE 0x00008F26 REC_UWORD_C 0 COMP_0068 0 65535 /end CHARACTERISTIC
/begin CHARACTERISTIC mAFDRPMD "ROM Const mAFDRPMD" VALUE 0x000082A9 REC_UBYTE_C 0 COMP_0000 0 6375 /end CHARACTERISTIC
/begin CHARACTERISTIC mAFDRPMH "ROM Const mAFDRPMH" VALUE 0x000082AA REC_UBYTE_C 0 COMP_0000 0 6375 /end CHARACTERISTIC
/begin CHARACTERISTIC mAFDRPML "ROM Const mAFDRPML" VALUE 0x000082AB REC_UBYTE_C 0 COMP_0000 0 6375 /end CHARACTERISTIC
/begin CHARACTERISTIC mAFDTWHYS "ROM Const mAFDTWHYS" VALUE 0x000082AC REC_UBYTE_C 0 COMP_0004_S -50 205 /end CHARACTERISTIC
/begin CHARACTERISTIC mAFDTWN "ROM Const mAFDTWN" VALUE 0x000082AD REC_UBYTE_C 0 COMP_0004_S -50 205 /end CHARACTERISTIC
/begin CHARACTERISTIC mAFDVSP "ROM Const mAFDVSP" VALUE 0x000082AE REC_UBYTE_C 0 COMP_0007 0 510 /end CHARACTERISTIC
/begin CHARACTERISTIC mAFDVTCH "ROM Const mAFDVTCH" VALUE 0x00008226 REC_SBYTE_C 0 COMP_0016_S -64 63.5 /end CHARACTERISTIC
/begin CHARACTERISTIC mAFDVTCL "ROM Const mAFDVTCL" VALUE 0x00008227 REC_SBYTE_C 0 COMP_0016_S -64 63.5 /end CHARACTERISTIC
/begin CHARACTERISTIC mAFEDLY "ROM Const mAFEDLY" VALUE 0x00008F28 REC_UWORD_C 0 COMP_0017_S 0 655.35 /end CHARACTERISTIC
/begin CHARACTERISTIC mAFHCTDD "ROM Const mAFHCTDD" VALUE 0x000082AF REC_UBYTE_C 0 COMP_0013 0 255 /end CHARACTERISTIC
/begin CHARACTERISTIC mAFHCUR "ROM Const mAFHCUR" VALUE 0x00008F2A REC_UWORD_C 0 COMP_0061 0 327675 /end CHARACTERISTIC
/begin CHARACTERISTIC mAFHDLY "ROM Const mAFHDLY" VALUE 0x000082B0 REC_UBYTE_C 0 COMP_0049 0 255 /end CHARACTERISTIC
/begin CHARACTERISTIC mAFHID "ROM Const mAFHID" VALUE 0x00008F2C REC_UWORD_C 0 COMP_0023 0 327675 /end CHARACTERISTIC
/begin CHARACTERISTIC mAFHKJYU "ROM Const mAFHKJYU" VALUE 0x000082B1 REC_UBYTE_C 0 COMP_0032 0 0.99609375 /end CHARACTERISTIC
/begin CHARACTERISTIC mAFHMAX "ROM Const mAFHMAX" VALUE 0x00008F2E REC_UWORD_C 0 COMP_0023 0 327675 /end CHARACTERISTIC
/begin CHARACTERISTIC mAFHMIN "ROM Const mAFHMIN" VALUE 0x00008F30 REC_UWORD_C 0 COMP_0023 0 327675 /end CHARACTERISTIC
/begin CHARACTERISTIC mAFHNGT "ROM Const mAFHNGT" VALUE 0x000082B2 REC_UBYTE_C 0 COMP_0049 0 255 /end CHARACTERISTIC
/begin CHARACTERISTIC mAFHVBL "ROM Const mAFHVBL" VALUE 0x000082B3 REC_UBYTE_C 0 COMP_0033 0 20400 /end CHARACTERISTIC
/begin CHARACTERISTIC mAFKMR "ROM Const mAFKMR" VALUE 0x00008F32 REC_UWORD_C 0 COMP_0217 0 3.999941832 /end CHARACTERISTIC
/begin CHARACTERISTIC mAFLEA "ROM Const mAFLEA" VALUE 0x000082B4 REC_UBYTE_C 0 COMP_0066 0 3.984375 /end CHARACTERISTIC
/begin CHARACTERISTIC mAFLEA2 "ROM Const mAFLEA2" VALUE 0x000082B5 REC_UBYTE_C 0 COMP_0186 0 3.984375 /end CHARACTERISTIC
/begin CHARACTERISTIC mAFLEG "ROM Const mAFLEG" VALUE 0x000082B6 REC_UBYTE_C 0 COMP_0132 0 0.498046875 /end CHARACTERISTIC
/begin CHARACTERISTIC mAFLEG2 "ROM Const mAFLEG2" VALUE 0x000082B7 REC_UBYTE_C 0 COMP_0018_S 0 0.498046875 /end CHARACTERISTIC
/begin CHARACTERISTIC mAFLETC "ROM Const mAFLETC" VALUE 0x000082B8 REC_UBYTE_C 0 COMP_0032 0 0.99609375 /end CHARACTERISTIC
/begin CHARACTERISTIC mAFLETC2 "ROM Const mAFLETC2" VALUE 0x000082B9 REC_UBYTE_C 0 COMP_0063 0 0.99609375 /end CHARACTERISTIC
/begin CHARACTERISTIC mAFLOD "ROM Const mAFLOD" VALUE 0x00008F34 REC_UWORD_C 0 COMP_0023 0 327675 /end CHARACTERISTIC
/begin CHARACTERISTIC mAFMCL1 "ROM Const mAFMCL1" VALUE 0x00008F36 REC_UWORD_C 0 COMP_0023 0 327675 /end CHARACTERISTIC
/begin CHARACTERISTIC mAFMCL2 "ROM Const mAFMCL2" VALUE 0x00008F38 REC_UWORD_C 0 COMP_0023 0 327675 /end CHARACTERISTIC
/begin CHARACTERISTIC mAFMLMEND "ROM Const mAFMLMEND" VALUE 0x000082BA REC_UBYTE_C 0 COMP_0014 0 2550 /end CHARACTERISTIC
/begin CHARACTERISTIC mAFMNGV "ROM Const mAFMNGV" VALUE 0x00008F3A REC_UWORD_C 0 COMP_0023 0 327675 /end CHARACTERISTIC
/begin CHARACTERISTIC mAFMTC "ROM Const mAFMTC" VALUE 0x000082BB REC_UBYTE_C 0 COMP_0015 0 31.875 /end CHARACTERISTIC
/begin CHARACTERISTIC mAFMTC2 "ROM Const mAFMTC2" VALUE 0x000082BC REC_UBYTE_C 0 COMP_0464 0 31.875 /end CHARACTERISTIC
/begin CHARACTERISTIC mAFOHONT "ROM Const mAFOHONT" VALUE 0x000082BD REC_UBYTE_C 0 COMP_0008 0 25500 /end CHARACTERISTIC
/begin CHARACTERISTIC mAFONNG "ROM Const mAFONNG" VALUE 0x00008F3C REC_UWORD_C 0 COMP_0023 0 327675 /end CHARACTERISTIC
/begin CHARACTERISTIC mAFONNG2 "ROM Const mAFONNG2" VALUE 0x00008F3E REC_UWORD_C 0 COMP_0023 0 327675 /end CHARACTERISTIC
/begin CHARACTERISTIC mAFPC "ROM Const mAFPC" VALUE 0x00008F40 REC_UWORD_C 0 COMP_0370 0 163837.5 /end CHARACTERISTIC
/begin CHARACTERISTIC mAFPSL "ROM Const mAFPSL" VALUE 0x00008F42 REC_UWORD_C 0 COMP_0093 0 163837.5 /end CHARACTERISTIC
/begin CHARACTERISTIC mAFSAFHI "ROM Const mAFSAFHI" VALUE 0x00008F44 REC_UWORD_C 0 COMP_0453 0 131.07 /end CHARACTERISTIC
/begin CHARACTERISTIC mAFSAFLO "ROM Const mAFSAFLO" VALUE 0x00008F46 REC_UWORD_C 0 COMP_0453 0 131.07 /end CHARACTERISTIC
/begin CHARACTERISTIC mAFSBASA "ROM Const mAFSBASA" VALUE 0x00008F48 REC_UWORD_C 0 COMP_0023 0 327675 /end CHARACTERISTIC
/begin CHARACTERISTIC mAFSDLY "ROM Const mAFSDLY" VALUE 0x000082BE REC_UBYTE_C 0 COMP_0049 0 255 /end CHARACTERISTIC
/begin CHARACTERISTIC mAFSDLY1 "ROM Const mAFSDLY1" VALUE 0x000082BF REC_UBYTE_C 0 COMP_0013 0 255 /end CHARACTERISTIC
/begin CHARACTERISTIC mAFSDLY2 "ROM Const mAFSDLY2" VALUE 0x000082C0 REC_UBYTE_C 0 COMP_0013 0 255 /end CHARACTERISTIC
/begin CHARACTERISTIC mAFSDWA "ROM Const mAFSDWA" VALUE 0x000082C1 REC_UBYTE_C 0 COMP_0019_S 0 1.000000095 /end CHARACTERISTIC
/begin CHARACTERISTIC mAFSGDMN "ROM Const mAFSGDMN" VALUE 0x00008F4A REC_UWORD_C 0 COMP_0217 0 3.999941832 /end CHARACTERISTIC
/begin CHARACTERISTIC mAFSGDMX "ROM Const mAFSGDMX" VALUE 0x00008F4C REC_UWORD_C 0 COMP_0217 0 3.999941832 /end CHARACTERISTIC
/begin CHARACTERISTIC mAFSGMN "ROM Const mAFSGMN" VALUE 0x00008F4E REC_UWORD_C 0 COMP_0217 0 3.999941832 /end CHARACTERISTIC
/begin CHARACTERISTIC mAFSGMX "ROM Const mAFSGMX" VALUE 0x00008F50 REC_UWORD_C 0 COMP_0217 0 3.999941832 /end CHARACTERISTIC
/begin CHARACTERISTIC mAFSGWA "ROM Const mAFSGWA" VALUE 0x000082C2 REC_UBYTE_C 0 COMP_0019_S 0 1.000000095 /end CHARACTERISTIC
/begin CHARACTERISTIC mAFSHCT "ROM Const mAFSHCT" VALUE 0x000082C3 REC_UBYTE_C 0 COMP_0030 0 255 /end CHARACTERISTIC
/begin CHARACTERISTIC mAFSHDEC "ROM Const mAFSHDEC" VALUE 0x00008DF0 REC_SWORD_C 0 COMP_0020_S -65.536 65.534 /end CHARACTERISTIC
/begin CHARACTERISTIC mAFSHDEC2 "ROM Const mAFSHDEC2" VALUE 0x00008F52 REC_UWORD_C 0 COMP_0453 0 131.07 /end CHARACTERISTIC
/begin CHARACTERISTIC mAFSHDTYL "ROM Const mAFSHDTYL" VALUE 0x000082C4 REC_UBYTE_C 0 COMP_0047 0 127.5 /end CHARACTERISTIC
/begin CHARACTERISTIC mAFSHINC "ROM Const mAFSHINC" VALUE 0x00008DF2 REC_SWORD_C 0 COMP_0020_S -65.536 65.534 /end CHARACTERISTIC
/begin CHARACTERISTIC mAFSHINC2 "ROM Const mAFSHINC2" VALUE 0x00008F54 REC_UWORD_C 0 COMP_0453 0 131.07 /end CHARACTERISTIC
/begin CHARACTERISTIC mAFSHSL "ROM Const mAFSHSL" VALUE 0x00008F56 REC_UWORD_C 0 COMP_0453 0 131.07 /end CHARACTERISTIC
/begin CHARACTERISTIC mAFSHSMN "ROM Const mAFSHSMN" VALUE 0x00008DF4 REC_SWORD_C 0 COMP_0020_S -65.536 65.534 /end CHARACTERISTIC
/begin CHARACTERISTIC mAFSHSMX "ROM Const mAFSHSMX" VALUE 0x00008DF6 REC_SWORD_C 0 COMP_0020_S -65.536 65.534 /end CHARACTERISTIC
/begin CHARACTERISTIC mAFSLRBL "ROM Const mAFSLRBL" VALUE 0x00008F58 REC_UWORD_C 0 COMP_0453 0 131.07 /end CHARACTERISTIC
/begin CHARACTERISTIC mAFSLRBR "ROM Const mAFSLRBR" VALUE 0x00008F5A REC_UWORD_C 0 COMP_0453 0 131.07 /end CHARACTERISTIC
/begin CHARACTERISTIC mAFSMNV "ROM Const mAFSMNV" VALUE 0x000082C5 REC_UBYTE_C 0 COMP_0015_S 0 25.5 /end CHARACTERISTIC
/begin CHARACTERISTIC mAFSNEH "ROM Const mAFSNEH" VALUE 0x000082C6 REC_UBYTE_C 0 COMP_0000 0 6375 /end CHARACTERISTIC
/begin CHARACTERISTIC mAFSNEH1 "ROM Const mAFSNEH1" VALUE 0x000082C7 REC_UBYTE_C 0 COMP_0000 0 6375 /end CHARACTERISTIC
/begin CHARACTERISTIC mAFSNEH2 "ROM Const mAFSNEH2" VALUE 0x000082C8 REC_UBYTE_C 0 COMP_0000 0 6375 /end CHARACTERISTIC
/begin CHARACTERISTIC mAFSNEL "ROM Const mAFSNEL" VALUE 0x000082C9 REC_UBYTE_C 0 COMP_0000 0 6375 /end CHARACTERISTIC
/begin CHARACTERISTIC mAFSNEL1 "ROM Const mAFSNEL1" VALUE 0x000082CA REC_UBYTE_C 0 COMP_0000 0 6375 /end CHARACTERISTIC
/begin CHARACTERISTIC mAFSNEL2 "ROM Const mAFSNEL2" VALUE 0x000082CB REC_UBYTE_C 0 COMP_0000 0 6375 /end CHARACTERISTIC
/begin CHARACTERISTIC mAFSNTPH "ROM Const mAFSNTPH" VALUE 0x00008F5C REC_UWORD_C 0 COMP_0021_S 0 204796.875 /end CHARACTERISTIC
/begin CHARACTERISTIC mAFSNTPL "ROM Const mAFSNTPL" VALUE 0x00008F5E REC_UWORD_C 0 COMP_0021_S 0 204796.875 /end CHARACTERISTIC
/begin CHARACTERISTIC mAFSOK "ROM Const mAFSOK" VALUE 0x000082CC REC_UBYTE_C 0 COMP_0022_S 0 5.1 /end CHARACTERISTIC
/begin CHARACTERISTIC mAFSOKTM "ROM Const mAFSOKTM" VALUE 0x000082CD REC_UBYTE_C 0 COMP_0015_S 0 25.5 /end CHARACTERISTIC
/begin CHARACTERISTIC mAFSSTK "ROM Const mAFSSTK" VALUE 0x00008F60 REC_UWORD_C 0 COMP_0023 0 327675 /end CHARACTERISTIC
/begin CHARACTERISTIC mAFSTCT "ROM Const mAFSTCT" VALUE 0x000082CE REC_UBYTE_C 0 COMP_0030 0 255 /end CHARACTERISTIC
/begin CHARACTERISTIC mAFSTPH "ROM Const mAFSTPH" VALUE 0x000082CF REC_UBYTE_C 0 COMP_0001 0 31.875 /end CHARACTERISTIC
/begin CHARACTERISTIC mAFSTPH1 "ROM Const mAFSTPH1" VALUE 0x000082D0 REC_UBYTE_C 0 COMP_0001 0 31.875 /end CHARACTERISTIC
/begin CHARACTERISTIC mAFSTPL "ROM Const mAFSTPL" VALUE 0x000082D1 REC_UBYTE_C 0 COMP_0001 0 31.875 /end CHARACTERISTIC
/begin CHARACTERISTIC mAFSTPL1 "ROM Const mAFSTPL1" VALUE 0x000082D2 REC_UBYTE_C 0 COMP_0001 0 31.875 /end CHARACTERISTIC
/begin CHARACTERISTIC mAFSVBH "ROM Const mAFSVBH" VALUE 0x000082D3 REC_UBYTE_C 0 COMP_0033 0 20400 /end CHARACTERISTIC
/begin CHARACTERISTIC mAFSVBL "ROM Const mAFSVBL" VALUE 0x000082D4 REC_UBYTE_C 0 COMP_0033 0 20400 /end CHARACTERISTIC
/begin CHARACTERISTIC mAFTCLON "ROM Const mAFTCLON" VALUE 0x000082D5 REC_UBYTE_C 0 COMP_0016 0 255 /end CHARACTERISTIC
/begin CHARACTERISTIC mAFTCLONH "ROM Const mAFTCLONH" VALUE 0x000082D6 REC_UBYTE_C 0 COMP_0016 0 255 /end CHARACTERISTIC
/begin CHARACTERISTIC mAFVDLY "ROM Const mAFVDLY" VALUE 0x00008F62 REC_UWORD_C 0 COMP_0202 0 655350 /end CHARACTERISTIC
/begin CHARACTERISTIC mAFVNGH1 "ROM Const mAFVNGH1" VALUE 0x00008F64 REC_UWORD_C 0 COMP_0023 0 327675 /end CHARACTERISTIC
/begin CHARACTERISTIC mAFVNGH2 "ROM Const mAFVNGH2" VALUE 0x00008F66 REC_UWORD_C 0 COMP_0023 0 327675 /end CHARACTERISTIC
/begin CHARACTERISTIC mAFVNGL1 "ROM Const mAFVNGL1" VALUE 0x00008F68 REC_UWORD_C 0 COMP_0023 0 327675 /end CHARACTERISTIC
/begin CHARACTERISTIC mAFVNGL2 "ROM Const mAFVNGL2" VALUE 0x00008F6A REC_UWORD_C 0 COMP_0023 0 327675 /end CHARACTERISTIC
/begin CHARACTERISTIC mAFVNGT1 "ROM Const mAFVNGT1" VALUE 0x000082D7 REC_UBYTE_C 0 COMP_0049 0 255 /end CHARACTERISTIC
/begin CHARACTERISTIC mAFVSPH "ROM Const mAFVSPH" VALUE 0x000082D8 REC_UBYTE_C 0 COMP_0007 0 510 /end CHARACTERISTIC
/begin CHARACTERISTIC mAFVSPH1 "ROM Const mAFVSPH1" VALUE 0x000082D9 REC_UBYTE_C 0 COMP_0007 0 510 /end CHARACTERISTIC
/begin CHARACTERISTIC mAFVSPL "ROM Const mAFVSPL" VALUE 0x000082DA REC_UBYTE_C 0 COMP_0007 0 510 /end CHARACTERISTIC
/begin CHARACTERISTIC mAFVSPL1 "ROM Const mAFVSPL1" VALUE 0x000082DB REC_UBYTE_C 0 COMP_0007 0 510 /end CHARACTERISTIC
/begin CHARACTERISTIC mAGBCLKNG "ROM Const mAGBCLKNG" VALUE 0x000082DC REC_UBYTE_C 0 COMP_0014 0 2550 /end CHARACTERISTIC
/begin CHARACTERISTIC mAGBCLNG2 "ROM Const mAGBCLNG2" VALUE 0x000082DD REC_UBYTE_C 0 COMP_0014 0 2550 /end CHARACTERISTIC
/begin CHARACTERISTIC mAGBLNKNG "ROM Const mAGBLNKNG" VALUE 0x000082DE REC_UBYTE_C 0 COMP_0014 0 2550 /end CHARACTERISTIC
/begin CHARACTERISTIC mAGBSIPNG "ROM Const mAGBSIPNG" VALUE 0x000082DF REC_UBYTE_C 0 COMP_0008 0 25500 /end CHARACTERISTIC
/begin CHARACTERISTIC mAGBTUPDC "ROM Const mAGBTUPDC" VALUE 0x000082E0 REC_UBYTE_C 0 COMP_0023_S 0 255 /end CHARACTERISTIC
/begin CHARACTERISTIC mAGBTUPDL "ROM Const mAGBTUPDL" VALUE 0x000082E1 REC_UBYTE_C 0 COMP_0008 0 25500 /end CHARACTERISTIC
/begin CHARACTERISTIC mAGBTUPNG "ROM Const mAGBTUPNG" VALUE 0x00008F6C REC_UWORD_C 0 COMP_0023_S 0 65535 /end CHARACTERISTIC
/begin CHARACTERISTIC mAHOSNGH "ROM Const mAHOSNGH" VALUE 0x00008DF8 REC_SWORD_C 0 COMP_0020_S -65.536 65.534 /end CHARACTERISTIC
/begin CHARACTERISTIC mAHOSNGL "ROM Const mAHOSNGL" VALUE 0x00008DFA REC_SWORD_C 0 COMP_0020_S -65.536 65.534 /end CHARACTERISTIC
/begin CHARACTERISTIC mAHOSNMX "ROM Const mAHOSNMX" VALUE 0x000082E2 REC_UBYTE_C 0 COMP_0030 0 255 /end CHARACTERISTIC
/begin CHARACTERISTIC mAHOSTMH "ROM Const mAHOSTMH" VALUE 0x000082E3 REC_UBYTE_C 0 COMP_0013 0 255 /end CHARACTERISTIC
/begin CHARACTERISTIC mAIST "ROM Const mAIST" VALUE 0x00008F6E REC_UWORD_C 0 COMP_0015_S 0 6553.5 /end CHARACTERISTIC
/begin CHARACTERISTIC mAJCLUDEF "ROM Const mAJCLUDEF" VALUE 0x00008F70 REC_UWORD_C 0 COMP_0443 0 65535 /end CHARACTERISTIC
/begin CHARACTERISTIC mAJCLUON "ROM Const mAJCLUON" VALUE 0x000082E4 REC_UBYTE_C 0 COMP_0014 0 2550 /end CHARACTERISTIC
/begin CHARACTERISTIC mAJDSFDEF "ROM Const mAJDSFDEF" VALUE 0x00008F72 REC_UWORD_C 0 COMP_0443 0 65535 /end CHARACTERISTIC
/begin CHARACTERISTIC mAJINVSW "ROM Const mAJINVSW" VALUE 0x000082E5 REC_UBYTE_C 0 COMP_0068 0 255 /end CHARACTERISTIC
/begin CHARACTERISTIC mAJOWCOFF "ROM Const mAJOWCOFF" VALUE 0x00008DFC REC_SWORD_C 0 COMP_0024_S -32768 32767 /end CHARACTERISTIC
/begin CHARACTERISTIC mAJOWCON "ROM Const mAJOWCON" VALUE 0x00008DFE REC_SWORD_C 0 COMP_0024_S -32768 32767 /end CHARACTERISTIC
/begin CHARACTERISTIC mAJRMPLUH "ROM Const mAJRMPLUH" VALUE 0x000082E6 REC_UBYTE_C 0 COMP_0045 0 1.9921875 /end CHARACTERISTIC
/begin CHARACTERISTIC mAJRMPNXH "ROM Const mAJRMPNXH" VALUE 0x000082E7 REC_UBYTE_C 0 COMP_0045 0 1.9921875 /end CHARACTERISTIC
/begin CHARACTERISTIC mAJT0ONSW "ROM Const mAJT0ONSW" VALUE 0x000082E8 REC_UBYTE_C 0 COMP_0068 0 255 /end CHARACTERISTIC
/begin CHARACTERISTIC mAJT0THSW "ROM Const mAJT0THSW" VALUE 0x000082E9 REC_UBYTE_C 0 COMP_0068 0 255 /end CHARACTERISTIC
/begin CHARACTERISTIC mAJTQOFT2 "ROM Const mAJTQOFT2" VALUE 0x00008E00 REC_SWORD_C 0 COMP_0228 -3276.8 3276.7 /end CHARACTERISTIC
/begin CHARACTERISTIC mAJTQOFTQ "ROM Const mAJTQOFTQ" VALUE 0x00008E02 REC_SWORD_C 0 COMP_0228 -3276.8 3276.7 /end CHARACTERISTIC
/begin CHARACTERISTIC mAJTQTMOF "ROM Const mAJTQTMOF" VALUE 0x000082EA REC_UBYTE_C 0 COMP_0014 0 2550 /end CHARACTERISTIC
/begin CHARACTERISTIC mAJTRQVSP "ROM Const mAJTRQVSP" VALUE 0x00008F74 REC_UWORD_C 0 COMP_0436 0 6553.5 /end CHARACTERISTIC
/begin CHARACTERISTIC mALCTMN "ROM Const mALCTMN" VALUE 0x000082EB REC_UBYTE_C 0 COMP_0027 0 255 /end CHARACTERISTIC
/begin CHARACTERISTIC mALCTMX "ROM Const mALCTMX" VALUE 0x000082EC REC_UBYTE_C 0 COMP_0027 0 255 /end CHARACTERISTIC
/begin CHARACTERISTIC mALD0 "ROM Const mALD0" VALUE 0x00008E04 REC_SWORD_C 0 COMP_0263 -32768 32767 /end CHARACTERISTIC
/begin CHARACTERISTIC mALD0_SFT "ROM Const mALD0_SFT" VALUE 0x000157C0 REC_SBYTE_C 0 COMP_0025_S -128 127 /end CHARACTERISTIC
/begin CHARACTERISTIC mALINTDLY "ROM Const mALINTDLY" VALUE 0x000082EE REC_UBYTE_C 0 COMP_0017_S 0 2.55 /end CHARACTERISTIC
/begin CHARACTERISTIC mALMT "ROM Const mALMT" VALUE 0x000082EF REC_UBYTE_C 0 COMP_0017 0 255 /end CHARACTERISTIC
/begin CHARACTERISTIC mALMTOFS "ROM Const mALMTOFS" VALUE 0x000082F0 REC_UBYTE_C 0 COMP_0256 -64 63.5 /end CHARACTERISTIC
/begin CHARACTERISTIC mALN0 "ROM Const mALN0" VALUE 0x00008E06 REC_SWORD_C 0 COMP_0263 -32768 32767 /end CHARACTERISTIC
/begin CHARACTERISTIC mALN0_SFT "ROM Const mALN0_SFT" VALUE 0x000157C1 REC_SBYTE_C 0 COMP_0025_S -128 127 /end CHARACTERISTIC
/begin CHARACTERISTIC mALP21 "ROM Const mALP21" VALUE 0x000082F1 REC_UBYTE_C 0 COMP_0027 0 255 /end CHARACTERISTIC
/begin CHARACTERISTIC mALPAMP "ROM Const mALPAMP" VALUE 0x00008F76 REC_UWORD_C 0 COMP_0031 0 255.99609375 /end CHARACTERISTIC
/begin CHARACTERISTIC mALPCTH "ROM Const mALPCTH" VALUE 0x000082F2 REC_UBYTE_C 0 COMP_0027 0 255 /end CHARACTERISTIC
/begin CHARACTERISTIC mALPCTL "ROM Const mALPCTL" VALUE 0x000082F3 REC_UBYTE_C 0 COMP_0027 0 255 /end CHARACTERISTIC
/begin CHARACTERISTIC mALPLMT "ROM Const mALPLMT" VALUE 0x000082F4 REC_UBYTE_C 0 COMP_0026_S 0 89.25 /end CHARACTERISTIC
/begin CHARACTERISTIC mALPMAXA "ROM Const mALPMAXA" VALUE 0x00008F78 REC_UWORD_C 0 COMP_0031 0 255.99609375 /end CHARACTERISTIC
/begin CHARACTERISTIC mALPMAXK "ROM Const mALPMAXK" VALUE 0x00008F7A REC_UWORD_C 0 COMP_0063 0 255.99609375 /end CHARACTERISTIC
/begin CHARACTERISTIC mALPMINA "ROM Const mALPMINA" VALUE 0x00008F7C REC_UWORD_C 0 COMP_0031 0 255.99609375 /end CHARACTERISTIC
/begin CHARACTERISTIC mALPMINK "ROM Const mALPMINK" VALUE 0x00008F7E REC_UWORD_C 0 COMP_0063 0 255.99609375 /end CHARACTERISTIC
/begin CHARACTERISTIC mALPMND "ROM Const mALPMND" VALUE 0x000082F5 REC_UBYTE_C 0 COMP_0027 0 255 /end CHARACTERISTIC
/begin CHARACTERISTIC mALPMNSM "ROM Const mALPMNSM" VALUE 0x00008F80 REC_UWORD_C 0 COMP_0031 0 255.99609375 /end CHARACTERISTIC
/begin CHARACTERISTIC mALPMXD "ROM Const mALPMXD" VALUE 0x000082F6 REC_UBYTE_C 0 COMP_0027 0 255 /end CHARACTERISTIC
/begin CHARACTERISTIC mALPMXSM "ROM Const mALPMXSM" VALUE 0x00008F82 REC_UWORD_C 0 COMP_0031 0 255.99609375 /end CHARACTERISTIC
/begin CHARACTERISTIC mALT5PLMT "ROM Const mALT5PLMT" VALUE 0x00008F84 REC_UWORD_C 0 COMP_0027_S 0 327675000 /end CHARACTERISTIC
/begin CHARACTERISTIC mALTADMN "ROM Const mALTADMN" VALUE 0x00008F86 REC_UWORD_C 0 COMP_0028_S 0 2.5599609375E-06 /end CHARACTERISTIC
/begin CHARACTERISTIC mALTDLIMH "ROM Const mALTDLIMH" VALUE 0x000082F7 REC_UBYTE_C 0 COMP_0047 0 127.5 /end CHARACTERISTIC
/begin CHARACTERISTIC mALTDLIML "ROM Const mALTDLIML" VALUE 0x000082F8 REC_UBYTE_C 0 COMP_0047 0 127.5 /end CHARACTERISTIC
/begin CHARACTERISTIC mALTDLY "ROM Const mALTDLY" VALUE 0x000082F9 REC_UBYTE_C 0 COMP_0008 0 25500 /end CHARACTERISTIC
/begin CHARACTERISTIC mALTDMDNH "ROM Const mALTDMDNH" VALUE 0x000082FA REC_UBYTE_C 0 COMP_0006 0 3187.5 /end CHARACTERISTIC
/begin CHARACTERISTIC mALTDMDNL "ROM Const mALTDMDNL" VALUE 0x000082FB REC_UBYTE_C 0 COMP_0006 0 3187.5 /end CHARACTERISTIC
/begin CHARACTERISTIC mALTDNE "ROM Const mALTDNE" VALUE 0x00008F88 REC_UWORD_C 0 COMP_0065 0 204796.875 /end CHARACTERISTIC
/begin CHARACTERISTIC mALTDTPO "ROM Const mALTDTPO" VALUE 0x00008F8A REC_UWORD_C 0 COMP_0005 0 7208.85 /end CHARACTERISTIC
/begin CHARACTERISTIC mALTDVTC "ROM Const mALTDVTC" VALUE 0x000082FC REC_UBYTE_C 0 COMP_0048 0 127.5 /end CHARACTERISTIC
/begin CHARACTERISTIC mALTENDTM "ROM Const mALTENDTM" VALUE 0x00008F8C REC_UWORD_C 0 COMP_0013 0 65535 /end CHARACTERISTIC
/begin CHARACTERISTIC mALTENGRN "ROM Const mALTENGRN" VALUE 0x000082FE REC_UBYTE_C 0 COMP_0013 0 255 /end CHARACTERISTIC
/begin CHARACTERISTIC mALTFUELH "ROM Const mALTFUELH" VALUE 0x00008F8E REC_UWORD_C 0 COMP_0029_S 0 262140 /end CHARACTERISTIC
/begin CHARACTERISTIC mALTJGN "ROM Const mALTJGN" VALUE 0x000082FF REC_UBYTE_C 0 COMP_0068 0 255 /end CHARACTERISTIC
/begin CHARACTERISTIC mALTNEMX "ROM Const mALTNEMX" VALUE 0x00008300 REC_UBYTE_C 0 COMP_0000 0 6375 /end CHARACTERISTIC
/begin CHARACTERISTIC mALTPULY "ROM Const mALTPULY" VALUE 0x00008301 REC_UBYTE_C 0 COMP_0030_S 1 3.55 /end CHARACTERISTIC
/begin CHARACTERISTIC mALTTAN "ROM Const mALTTAN" VALUE 0x00008302 REC_UBYTE_C 0 COMP_0035 -50 205 /end CHARACTERISTIC
/begin CHARACTERISTIC mALTTPOMN "ROM Const mALTTPOMN" VALUE 0x00008F90 REC_UWORD_C 0 COMP_0005 0 7208.85 /end CHARACTERISTIC
/begin CHARACTERISTIC mALTTPOMX "ROM Const mALTTPOMX" VALUE 0x00008F92 REC_UWORD_C 0 COMP_0005 0 7208.85 /end CHARACTERISTIC
/begin CHARACTERISTIC mALTTWMN "ROM Const mALTTWMN" VALUE 0x00008303 REC_UBYTE_C 0 COMP_0035 -50 205 /end CHARACTERISTIC
/begin CHARACTERISTIC mALTTWMX "ROM Const mALTTWMX" VALUE 0x00008304 REC_UBYTE_C 0 COMP_0035 -50 205 /end CHARACTERISTIC
/begin CHARACTERISTIC mALTVTCMX "ROM Const mALTVTCMX" VALUE 0x00008305 REC_UBYTE_C 0 COMP_0256 -64 63.5 /end CHARACTERISTIC
/begin CHARACTERISTIC mANFSDH "ROM Const mANFSDH" VALUE 0x00008306 REC_UBYTE_C 0 COMP_0027 0 255 /end CHARACTERISTIC
/begin CHARACTERISTIC mANFSDL "ROM Const mANFSDL" VALUE 0x00008307 REC_UBYTE_C 0 COMP_0027 0 255 /end CHARACTERISTIC
/begin CHARACTERISTIC mANHPF "ROM Const mANHPF" VALUE 0x00008F94 REC_UWORD_C 0 COMP_0031_S 0 39.97635 /end CHARACTERISTIC
/begin CHARACTERISTIC mANHPFRC "ROM Const mANHPFRC" VALUE 0x00008F96 REC_UWORD_C 0 COMP_0031_S 0 39.97635 /end CHARACTERISTIC
/begin CHARACTERISTIC mAPASCDMX "ROM Const mAPASCDMX" VALUE 0x00008F98 REC_UWORD_C 0 COMP_0005 0 7208.85 /end CHARACTERISTIC
/begin CHARACTERISTIC mAPASCMX2 "ROM Const mAPASCMX2" VALUE 0x00008F9A REC_UWORD_C 0 COMP_0005 0 7208.85 /end CHARACTERISTIC
/begin CHARACTERISTIC mAPASDEC "ROM Const mAPASDEC" VALUE 0x00008F9C REC_UWORD_C 0 COMP_0005 0 7208.85 /end CHARACTERISTIC
/begin CHARACTERISTIC mAPASINC "ROM Const mAPASINC" VALUE 0x00008F9E REC_UWORD_C 0 COMP_0005 0 7208.85 /end CHARACTERISTIC
/begin CHARACTERISTIC mAPBYDT2 "ROM Const mAPBYDT2" VALUE 0x00008FA0 REC_UWORD_C 0 COMP_0037 0 0.204796875 /end CHARACTERISTIC
/begin CHARACTERISTIC mAPFLOUT "ROM Const mAPFLOUT" VALUE 0x00008FA2 REC_UWORD_C 0 COMP_0032_S 0 8191.875 /end CHARACTERISTIC
/begin CHARACTERISTIC mAPINTS "ROM Const mAPINTS" VALUE 0x00008FA4 REC_UWORD_C 0 COMP_0023 0 327675 /end CHARACTERISTIC
/begin CHARACTERISTIC mAPINVDEH "ROM Const mAPINVDEH" VALUE 0x00008FA6 REC_UWORD_C 0 COMP_0005 0 7208.85 /end CHARACTERISTIC
/begin CHARACTERISTIC mAPINVDEL "ROM Const mAPINVDEL" VALUE 0x00008FA8 REC_UWORD_C 0 COMP_0005 0 7208.85 /end CHARACTERISTIC
/begin CHARACTERISTIC mAPKDIN "ROM Const mAPKDIN" VALUE 0x00008FAA REC_UWORD_C 0 COMP_0032_S 0 8191.875 /end CHARACTERISTIC
/begin CHARACTERISTIC mAPKDOUT "ROM Const mAPKDOUT" VALUE 0x00008FAC REC_UWORD_C 0 COMP_0032_S 0 8191.875 /end CHARACTERISTIC
/begin CHARACTERISTIC mAPOAC "ROM Const mAPOAC" VALUE 0x00008FAE REC_UWORD_C 0 COMP_0005 0 7208.85 /end CHARACTERISTIC
/begin CHARACTERISTIC mAPOACR "ROM Const mAPOACR" VALUE 0x00008FB0 REC_UWORD_C 0 COMP_0005 0 7208.85 /end CHARACTERISTIC
/begin CHARACTERISTIC mAPOFSRMX "ROM Const mAPOFSRMX" VALUE 0x00008FB2 REC_UWORD_C 0 COMP_0032_S 0 8191.875 /end CHARACTERISTIC
/begin CHARACTERISTIC mAPOFULL "ROM Const mAPOFULL" VALUE 0x00008FB4 REC_UWORD_C 0 COMP_0005 0 7208.85 /end CHARACTERISTIC
/begin CHARACTERISTIC mAPOHYS "ROM Const mAPOHYS" VALUE 0x00008308 REC_UBYTE_C 0 COMP_0005 0 28.05 /end CHARACTERISTIC
/begin CHARACTERISTIC mAPOINCH "ROM Const mAPOINCH" VALUE 0x00008FB6 REC_UWORD_C 0 COMP_0005 0 7208.85 /end CHARACTERISTIC
/begin CHARACTERISTIC mAPOLCA_S "ROM Const mAPOLCA_S" VALUE 0x000157DE REC_UWORD_C 0 COMP_0005 0 7208.85 /end CHARACTERISTIC
/begin CHARACTERISTIC mAPOLMT "ROM Const mAPOLMT" VALUE 0x00008FB8 REC_UWORD_C 0 COMP_0005 0 7208.85 /end CHARACTERISTIC
/begin CHARACTERISTIC mAPOLMTCA "ROM Const mAPOLMTCA" VALUE 0x00008FBA REC_UWORD_C 0 COMP_0005 0 7208.85 /end CHARACTERISTIC
/begin CHARACTERISTIC mAPOLMT_S "ROM Const mAPOLMT_S" VALUE 0x000157E0 REC_UWORD_C 0 COMP_0005 0 7208.85 /end CHARACTERISTIC
/begin CHARACTERISTIC mAPORAC "ROM Const mAPORAC" VALUE 0x00008FBC REC_UWORD_C 0 COMP_0005 0 7208.85 /end CHARACTERISTIC
/begin CHARACTERISTIC mAPOSPN "ROM Const mAPOSPN" VALUE 0x00008FBE REC_UWORD_C 0 COMP_0005 0 7208.85 /end CHARACTERISTIC
/begin CHARACTERISTIC mAPOSSTF "ROM Const mAPOSSTF" VALUE 0x00008FC0 REC_UWORD_C 0 COMP_0005 0 7208.85 /end CHARACTERISTIC
/begin CHARACTERISTIC mAPSTN "ROM Const mAPSTN" VALUE 0x00008FC2 REC_UWORD_C 0 COMP_0033_S 0 65535 /end CHARACTERISTIC
/begin CHARACTERISTIC mAPSVH "ROM Const mAPSVH" VALUE 0x00008FC4 REC_UWORD_C 0 COMP_0023 0 327675 /end CHARACTERISTIC
/begin CHARACTERISTIC mAPSVH2 "ROM Const mAPSVH2" VALUE 0x00008FC6 REC_UWORD_C 0 COMP_0023 0 327675 /end CHARACTERISTIC
/begin CHARACTERISTIC mAPSVL "ROM Const mAPSVL" VALUE 0x00008FC8 REC_UWORD_C 0 COMP_0023 0 327675 /end CHARACTERISTIC
/begin CHARACTERISTIC mARABNH "ROM Const mARABNH" VALUE 0x00008309 REC_UBYTE_C 0 COMP_0373 0 2.55 /end CHARACTERISTIC
/begin CHARACTERISTIC mARABNL "ROM Const mARABNL" VALUE 0x0000830A REC_UBYTE_C 0 COMP_0373 0 2.55 /end CHARACTERISTIC
/begin CHARACTERISTIC mARGCNT "ROM Const mARGCNT" VALUE 0x00008FCA REC_UWORD_C 0 COMP_0016 0 65535 /end CHARACTERISTIC
/begin CHARACTERISTIC mARLPAMH "ROM Const mARLPAMH" VALUE 0x00008FCC REC_UWORD_C 0 COMP_0034_S 0 255.99609375 /end CHARACTERISTIC
/begin CHARACTERISTIC mARLPAML "ROM Const mARLPAML" VALUE 0x00008FCE REC_UWORD_C 0 COMP_0034_S 0 255.99609375 /end CHARACTERISTIC
/begin CHARACTERISTIC mARLPNE "ROM Const mARLPNE" VALUE 0x00008FD0 REC_UWORD_C 0 COMP_0006 0 819187.5 /end CHARACTERISTIC
/begin CHARACTERISTIC mARLPQA "ROM Const mARLPQA" VALUE 0x00008FD2 REC_UWORD_C 0 COMP_0220 0 65535 /end CHARACTERISTIC
/begin CHARACTERISTIC mARLPQD "ROM Const mARLPQD" VALUE 0x00008FD4 REC_UWORD_C 0 COMP_0035_S 0 65535 /end CHARACTERISTIC
/begin CHARACTERISTIC mARLPQT "ROM Const mARLPQT" VALUE 0x00008FD6 REC_UWORD_C 0 COMP_0017_S 0 655.35 /end CHARACTERISTIC
/begin CHARACTERISTIC mARLPQWA "ROM Const mARLPQWA" VALUE 0x0000830B REC_UBYTE_C 0 COMP_0019_S 0 1.000000095 /end CHARACTERISTIC
/begin CHARACTERISTIC mARLPTWL "ROM Const mARLPTWL" VALUE 0x0000830C REC_UBYTE_C 0 COMP_0035 -50 205 /end CHARACTERISTIC
/begin CHARACTERISTIC mARMTHI "ROM Const mARMTHI" VALUE 0x00008228 REC_SBYTE_C 0 COMP_0018 -128 127 /end CHARACTERISTIC
/begin CHARACTERISTIC mARMTLO "ROM Const mARMTLO" VALUE 0x00008229 REC_SBYTE_C 0 COMP_0018 -128 127 /end CHARACTERISTIC
/begin CHARACTERISTIC mARPMCNT "ROM Const mARPMCNT" VALUE 0x00008FD8 REC_UWORD_C 0 COMP_0017_S 0 655.35 /end CHARACTERISTIC
/begin CHARACTERISTIC mARRATE "ROM Const mARRATE" VALUE 0x00008FDA REC_UWORD_C 0 COMP_0173 0 4095.9375 /end CHARACTERISTIC
/begin CHARACTERISTIC mAS1PEC "ROM Const mAS1PEC" VALUE 0x00008FDC REC_UWORD_C 0 COMP_0036_S 0 65535 /end CHARACTERISTIC
/begin CHARACTERISTIC mASCDOVRV "ROM Const mASCDOVRV" VALUE 0x00008FDE REC_UWORD_C 0 COMP_0443 0 65535 /end CHARACTERISTIC
/begin CHARACTERISTIC mASC_PNUM "ROM Const mASC_PNUM" VALUE 0x0000830D REC_UBYTE_C 0 COMP_0068 0 255 /end CHARACTERISTIC
/begin CHARACTERISTIC mASHLTM "ROM Const mASHLTM" VALUE 0x0000830E REC_UBYTE_C 0 COMP_0008 0 25500 /end CHARACTERISTIC
/begin CHARACTERISTIC mASOVCHG "ROM Const mASOVCHG" VALUE 0x00008FE0 REC_UWORD_C 0 COMP_0037_S 0 16776960 /end CHARACTERISTIC
/begin CHARACTERISTIC mASRFSRCV "ROM Const mASRFSRCV" VALUE 0x00008FE2 REC_UWORD_C 0 COMP_0038_S 0 6553.5 /end CHARACTERISTIC
/begin CHARACTERISTIC mATCNTHYS "ROM Const mATCNTHYS" VALUE 0x0000830F REC_UBYTE_C 0 COMP_0016 0 255 /end CHARACTERISTIC
/begin CHARACTERISTIC mATGDLY "ROM Const mATGDLY" VALUE 0x00008310 REC_UBYTE_C 0 COMP_0008 0 25500 /end CHARACTERISTIC
/begin CHARACTERISTIC mATMODNE "ROM Const mATMODNE" VALUE 0x00008311 REC_UBYTE_C 0 COMP_0000 0 6375 /end CHARACTERISTIC
/begin CHARACTERISTIC mATMODVAP "ROM Const mATMODVAP" VALUE 0x00008FE4 REC_UWORD_C 0 COMP_0005 0 7208.85 /end CHARACTERISTIC
/begin CHARACTERISTIC mATMPRSH "ROM Const mATMPRSH" VALUE 0x00008FE6 REC_UWORD_C 0 COMP_0039_S 60000 125535 /end CHARACTERISTIC
/begin CHARACTERISTIC mATMPRSL "ROM Const mATMPRSL" VALUE 0x00008FE8 REC_UWORD_C 0 COMP_0039_S 60000 125535 /end CHARACTERISTIC
/begin CHARACTERISTIC mATSMPT "ROM Const mATSMPT" VALUE 0x00008312 REC_UBYTE_C 0 COMP_0040_S 0 2.55 /end CHARACTERISTIC
/begin CHARACTERISTIC mATTEMPH "ROM Const mATTEMPH" VALUE 0x00008313 REC_UBYTE_C 0 COMP_0041_S 0 255 /end CHARACTERISTIC
/begin CHARACTERISTIC mATTEMPL "ROM Const mATTEMPL" VALUE 0x00008314 REC_UBYTE_C 0 COMP_0041_S 0 255 /end CHARACTERISTIC
/begin CHARACTERISTIC mATVMANI "ROM Const mATVMANI" VALUE 0x00008FEA REC_UWORD_C 0 COMP_0041 0 52.428 /end CHARACTERISTIC
/begin CHARACTERISTIC mATVMAN_S "ROM Const mATVMAN_S" VALUE 0x000157E2 REC_UWORD_C 0 COMP_0042 0 52.428 /end CHARACTERISTIC
/begin CHARACTERISTIC mAVEALP "ROM Const mAVEALP" VALUE 0x00008315 REC_UBYTE_C 0 COMP_0032 0 0.99609375 /end CHARACTERISTIC
/begin CHARACTERISTIC mAVEQDB "ROM Const mAVEQDB" VALUE 0x00008FEC REC_UWORD_C 0 COMP_0068 0 65535 /end CHARACTERISTIC
/begin CHARACTERISTIC mAVETP "ROM Const mAVETP" VALUE 0x00008316 REC_UBYTE_C 0 COMP_0043 0 0.249023565 /end CHARACTERISTIC
/begin CHARACTERISTIC mAVEVAP "ROM Const mAVEVAP" VALUE 0x00008317 REC_UBYTE_C 0 COMP_0044 0 1.9921875 /end CHARACTERISTIC
/begin CHARACTERISTIC mAVEVAP2 "ROM Const mAVEVAP2" VALUE 0x00008318 REC_UBYTE_C 0 COMP_0044 0 1.9921875 /end CHARACTERISTIC
/begin CHARACTERISTIC mAVFLN1 "ROM Const mAVFLN1" VALUE 0x00008319 REC_UBYTE_C 0 COMP_0032 0 0.99609375 /end CHARACTERISTIC
/begin CHARACTERISTIC mAVFLN2 "ROM Const mAVFLN2" VALUE 0x0000831A REC_UBYTE_C 0 COMP_0032 0 0.99609375 /end CHARACTERISTIC
/begin CHARACTERISTIC mAVFLN3 "ROM Const mAVFLN3" VALUE 0x0000831B REC_UBYTE_C 0 COMP_0032 0 0.99609375 /end CHARACTERISTIC
/begin CHARACTERISTIC mAVJPD0 "ROM Const mAVJPD0" VALUE 0x00008FEE REC_UWORD_C 0 COMP_0081 0 255.99609375 /end CHARACTERISTIC
/begin CHARACTERISTIC mAVJPD1 "ROM Const mAVJPD1" VALUE 0x00008FF0 REC_UWORD_C 0 COMP_0081 0 255.99609375 /end CHARACTERISTIC
/begin CHARACTERISTIC mAVJPDD0 "ROM Const mAVJPDD0" VALUE 0x00008FF2 REC_UWORD_C 0 COMP_0081 0 255.99609375 /end CHARACTERISTIC
/begin CHARACTERISTIC mAVJPDD1 "ROM Const mAVJPDD1" VALUE 0x00008FF4 REC_UWORD_C 0 COMP_0081 0 255.99609375 /end CHARACTERISTIC
/begin CHARACTERISTIC mAVJPDHS "ROM Const mAVJPDHS" VALUE 0x00008FF6 REC_UWORD_C 0 COMP_0081 0 255.99609375 /end CHARACTERISTIC
/begin CHARACTERISTIC mAVPRR "ROM Const mAVPRR" VALUE 0x0000831C REC_UBYTE_C 0 COMP_0044 0 1.9921875 /end CHARACTERISTIC
/begin CHARACTERISTIC mAVQDMP "ROM Const mAVQDMP" VALUE 0x0000831D REC_UBYTE_C 0 COMP_0063 0 0.99609375 /end CHARACTERISTIC
/begin CHARACTERISTIC mAVTFA "ROM Const mAVTFA" VALUE 0x0000831E REC_UBYTE_C 0 COMP_0044 0 1.9921875 /end CHARACTERISTIC
/begin CHARACTERISTIC mAVTQHH "ROM Const mAVTQHH" VALUE 0x0000831F REC_UBYTE_C 0 COMP_0032 0 0.99609375 /end CHARACTERISTIC
/begin CHARACTERISTIC mAVTQHL "ROM Const mAVTQHL" VALUE 0x00008320 REC_UBYTE_C 0 COMP_0032 0 0.99609375 /end CHARACTERISTIC
/begin CHARACTERISTIC mAVV8 "ROM Const mAVV8" VALUE 0x00008321 REC_UBYTE_C 0 COMP_0004 0 255 /end CHARACTERISTIC
/begin CHARACTERISTIC mAWGACT "ROM Const mAWGACT" VALUE 0x00008322 REC_UBYTE_C 0 COMP_0042_S 0 2.04 /end CHARACTERISTIC
/begin CHARACTERISTIC mAWGVALVE "ROM Const mAWGVALVE" VALUE 0x00008FF8 REC_UWORD_C 0 COMP_0043_S 0 1.999970916 /end CHARACTERISTIC
/begin CHARACTERISTIC mB0QA1 "ROM Const mB0QA1" VALUE 0x00008E08 REC_SWORD_C 0 COMP_0005_S -3.2768 3.2767 /end CHARACTERISTIC
/begin CHARACTERISTIC mB0QA12 "ROM Const mB0QA12" VALUE 0x00008E0A REC_SWORD_C 0 COMP_0005_S -3.2768 3.2767 /end CHARACTERISTIC
/begin CHARACTERISTIC mB0QA2 "ROM Const mB0QA2" VALUE 0x00008E0C REC_SWORD_C 0 COMP_0005_S -3.2768 3.2767 /end CHARACTERISTIC
/begin CHARACTERISTIC mB0QA22 "ROM Const mB0QA22" VALUE 0x00008E0E REC_SWORD_C 0 COMP_0005_S -3.2768 3.2767 /end CHARACTERISTIC
/begin CHARACTERISTIC mB0QA3 "ROM Const mB0QA3" VALUE 0x00008E10 REC_SWORD_C 0 COMP_0005_S -3.2768 3.2767 /end CHARACTERISTIC
/begin CHARACTERISTIC mB0QA32 "ROM Const mB0QA32" VALUE 0x00008E12 REC_SWORD_C 0 COMP_0005_S -3.2768 3.2767 /end CHARACTERISTIC
/begin CHARACTERISTIC mB1QA1 "ROM Const mB1QA1" VALUE 0x00008E14 REC_SWORD_C 0 COMP_0005_S -3.2768 3.2767 /end CHARACTERISTIC
/begin CHARACTERISTIC mB1QA12 "ROM Const mB1QA12" VALUE 0x00008E16 REC_SWORD_C 0 COMP_0005_S -3.2768 3.2767 /end CHARACTERISTIC
/begin CHARACTERISTIC mB1QA2 "ROM Const mB1QA2" VALUE 0x00008E18 REC_SWORD_C 0 COMP_0005_S -3.2768 3.2767 /end CHARACTERISTIC
/begin CHARACTERISTIC mB1QA22 "ROM Const mB1QA22" VALUE 0x00008E1A REC_SWORD_C 0 COMP_0005_S -3.2768 3.2767 /end CHARACTERISTIC
/begin CHARACTERISTIC mB1QA3 "ROM Const mB1QA3" VALUE 0x00008E1C REC_SWORD_C 0 COMP_0005_S -3.2768 3.2767 /end CHARACTERISTIC
/begin CHARACTERISTIC mB1QA32 "ROM Const mB1QA32" VALUE 0x00008E1E REC_SWORD_C 0 COMP_0005_S -3.2768 3.2767 /end CHARACTERISTIC
/begin CHARACTERISTIC mB2G "ROM Const mB2G" VALUE 0x000097B4 REC_ULONG_C 0 COMP_0068 0 4294967295 /end CHARACTERISTIC
/begin CHARACTERISTIC mBASANG "ROM Const mBASANG" VALUE 0x00008323 REC_UBYTE_C 0 COMP_0048 0 127.5 /end CHARACTERISTIC
/begin CHARACTERISTIC mBASANGE "ROM Const mBASANGE" VALUE 0x00008324 REC_UBYTE_C 0 COMP_0048 0 127.5 /end CHARACTERISTIC
/begin CHARACTERISTIC mBATDEG "ROM Const mBATDEG" VALUE 0x00008325 REC_UBYTE_C 0 COMP_0033 0 20400 /end CHARACTERISTIC
/begin CHARACTERISTIC mBATHOT "ROM Const mBATHOT" VALUE 0x00008326 REC_UBYTE_C 0 COMP_0035 -50 205 /end CHARACTERISTIC
/begin CHARACTERISTIC mBATSCD "ROM Const mBATSCD" VALUE 0x00008327 REC_UBYTE_C 0 COMP_0023 0 1275 /end CHARACTERISTIC
/begin CHARACTERISTIC mBATSCLH "ROM Const mBATSCLH" VALUE 0x00008FFA REC_UWORD_C 0 COMP_0023 0 327675 /end CHARACTERISTIC
/begin CHARACTERISTIC mBATSCLL "ROM Const mBATSCLL" VALUE 0x00008FFC REC_UWORD_C 0 COMP_0023 0 327675 /end CHARACTERISTIC
/begin CHARACTERISTIC mBATSG150 "ROM Const mBATSG150" VALUE 0x00008328 REC_UBYTE_C 0 COMP_0044_S 0 0.124511655 /end CHARACTERISTIC
/begin CHARACTERISTIC mBATSOFS "ROM Const mBATSOFS" VALUE 0x00008329 REC_UBYTE_C 0 COMP_0045_S 0 255 /end CHARACTERISTIC
/begin CHARACTERISTIC mBATSOFS2 "ROM Const mBATSOFS2" VALUE 0x00008FFE REC_UWORD_C 0 COMP_0046_S 0 255.99609375 /end CHARACTERISTIC
/begin CHARACTERISTIC mBATSSLP2 "ROM Const mBATSSLP2" VALUE 0x0000832A REC_UBYTE_C 0 COMP_0047_S 0 0.0622557 /end CHARACTERISTIC
/begin CHARACTERISTIC mBATTMPD "ROM Const mBATTMPD" VALUE 0x0000832B REC_UBYTE_C 0 COMP_0003 0 255 /end CHARACTERISTIC
/begin CHARACTERISTIC mBATTMPH "ROM Const mBATTMPH" VALUE 0x0000832C REC_UBYTE_C 0 COMP_0035 -50 205 /end CHARACTERISTIC
/begin CHARACTERISTIC mBATTOK "ROM Const mBATTOK" VALUE 0x0000832D REC_UBYTE_C 0 COMP_0033 0 20400 /end CHARACTERISTIC
/begin CHARACTERISTIC mBCONTOVN "ROM Const mBCONTOVN" VALUE 0x0000832E REC_UBYTE_C 0 COMP_0008 0 25500 /end CHARACTERISTIC
/begin CHARACTERISTIC mBELT4WD "ROM Const mBELT4WD" VALUE 0x0000832F REC_UBYTE_C 0 COMP_0006 0 3187.5 /end CHARACTERISTIC
/begin CHARACTERISTIC mBIASALMT "ROM Const mBIASALMT" VALUE 0x00008330 REC_UBYTE_C 0 COMP_0048_S 0 31.875 /end CHARACTERISTIC
/begin CHARACTERISTIC mBIASRLMT "ROM Const mBIASRLMT" VALUE 0x00008331 REC_UBYTE_C 0 COMP_0049_S -31.875 0 /end CHARACTERISTIC
/begin CHARACTERISTIC mBKKD "ROM Const mBKKD" VALUE 0x00008332 REC_UBYTE_C 0 COMP_0014 0 2550 /end CHARACTERISTIC
/begin CHARACTERISTIC mBLBDEC "ROM Const mBLBDEC" VALUE 0x00008333 REC_UBYTE_C 0 COMP_0044 0 1.9921875 /end CHARACTERISTIC
/begin CHARACTERISTIC mBLBHOT "ROM Const mBLBHOT" VALUE 0x00008334 REC_UBYTE_C 0 COMP_0016 0 255 /end CHARACTERISTIC
/begin CHARACTERISTIC mBLBKMR "ROM Const mBLBKMR" VALUE 0x00008335 REC_UBYTE_C 0 COMP_0016 0 255 /end CHARACTERISTIC
/begin CHARACTERISTIC mBLBSTC "ROM Const mBLBSTC" VALUE 0x00008336 REC_UBYTE_C 0 COMP_0016 0 255 /end CHARACTERISTIC
/begin CHARACTERISTIC mBLFANMXV "ROM Const mBLFANMXV" VALUE 0x00008337 REC_UBYTE_C 0 COMP_0050_S 0 127.5 /end CHARACTERISTIC
/begin CHARACTERISTIC mBNCSWON "ROM Const mBNCSWON" VALUE 0x00008338 REC_UBYTE_C 0 COMP_0054 0 5100 /end CHARACTERISTIC
/begin CHARACTERISTIC mBOSACTT1 "ROM Const mBOSACTT1" VALUE 0x00009000 REC_UWORD_C 0 COMP_0014 0 655350 /end CHARACTERISTIC
/begin CHARACTERISTIC mBOSACTT2 "ROM Const mBOSACTT2" VALUE 0x00009002 REC_UWORD_C 0 COMP_0014 0 655350 /end CHARACTERISTIC
/begin CHARACTERISTIC mBOSDAPOH "ROM Const mBOSDAPOH" VALUE 0x00009004 REC_UWORD_C 0 COMP_0051_S 0 7208.85 /end CHARACTERISTIC
/begin CHARACTERISTIC mBOSDAPOL "ROM Const mBOSDAPOL" VALUE 0x00009006 REC_UWORD_C 0 COMP_0051_S 0 7208.85 /end CHARACTERISTIC
/begin CHARACTERISTIC mBOSDAPVS "ROM Const mBOSDAPVS" VALUE 0x00009008 REC_UWORD_C 0 COMP_0436 0 6553.5 /end CHARACTERISTIC
/begin CHARACTERISTIC mBOSINTVL "ROM Const mBOSINTVL" VALUE 0x00008339 REC_UBYTE_C 0 COMP_0014 0 2550 /end CHARACTERISTIC
/begin CHARACTERISTIC mBOSLMDW1 "ROM Const mBOSLMDW1" VALUE 0x0000900A REC_UWORD_C 0 COMP_0052_S 0 8191.875 /end CHARACTERISTIC
/begin CHARACTERISTIC mBOSLMDW2 "ROM Const mBOSLMDW2" VALUE 0x0000900C REC_UWORD_C 0 COMP_0052_S 0 8191.875 /end CHARACTERISTIC
/begin CHARACTERISTIC mBOSLMT1 "ROM Const mBOSLMT1" VALUE 0x0000900E REC_UWORD_C 0 COMP_0032_S 0 8191.875 /end CHARACTERISTIC
/begin CHARACTERISTIC mBOSLMT2 "ROM Const mBOSLMT2" VALUE 0x00009010 REC_UWORD_C 0 COMP_0032_S 0 8191.875 /end CHARACTERISTIC
/begin CHARACTERISTIC mBOSLMUP1 "ROM Const mBOSLMUP1" VALUE 0x00009012 REC_UWORD_C 0 COMP_0052_S 0 8191.875 /end CHARACTERISTIC
/begin CHARACTERISTIC mBOSLMUP2 "ROM Const mBOSLMUP2" VALUE 0x00009014 REC_UWORD_C 0 COMP_0052_S 0 8191.875 /end CHARACTERISTIC
/begin CHARACTERISTIC mBOSSWDLY "ROM Const mBOSSWDLY" VALUE 0x0000833A REC_UBYTE_C 0 COMP_0014 0 2550 /end CHARACTERISTIC
/begin CHARACTERISTIC mBOSVSP1 "ROM Const mBOSVSP1" VALUE 0x00009016 REC_UWORD_C 0 COMP_0436 0 6553.5 /end CHARACTERISTIC
/begin CHARACTERISTIC mBOSVSP2 "ROM Const mBOSVSP2" VALUE 0x00009018 REC_UWORD_C 0 COMP_0436 0 6553.5 /end CHARACTERISTIC
/begin CHARACTERISTIC mBPDLY "ROM Const mBPDLY" VALUE 0x0000833B REC_UBYTE_C 0 COMP_0049 0 255 /end CHARACTERISTIC
/begin CHARACTERISTIC mBPNELMT "ROM Const mBPNELMT" VALUE 0x0000833C REC_UBYTE_C 0 COMP_0006 0 3187.5 /end CHARACTERISTIC
/begin CHARACTERISTIC mBPSON "ROM Const mBPSON" VALUE 0x0000822A REC_SBYTE_C 0 COMP_0046 -128 127 /end CHARACTERISTIC
/begin CHARACTERISTIC mBPTHLMT "ROM Const mBPTHLMT" VALUE 0x0000833D REC_UBYTE_C 0 COMP_0005 0 28.05 /end CHARACTERISTIC
/begin CHARACTERISTIC mBPVSLMT "ROM Const mBPVSLMT" VALUE 0x0000833E REC_UBYTE_C 0 COMP_0007 0 510 /end CHARACTERISTIC
/begin CHARACTERISTIC mBPVTLMT "ROM Const mBPVTLMT" VALUE 0x0000833F REC_UBYTE_C 0 COMP_0053_S -64 63.5 /end CHARACTERISTIC
/begin CHARACTERISTIC mBRQF "ROM Const mBRQF" VALUE 0x0000901A REC_UWORD_C 0 COMP_0010_S 0 6.5535 /end CHARACTERISTIC
/begin CHARACTERISTIC mBSERCL "ROM Const mBSERCL" VALUE 0x0000901C REC_UWORD_C 0 COMP_0049 0 65535 /end CHARACTERISTIC
/begin CHARACTERISTIC mBSERTM "ROM Const mBSERTM" VALUE 0x0000901E REC_UWORD_C 0 COMP_0015_S 0 6553.5 /end CHARACTERISTIC
/begin CHARACTERISTIC mBSOFVS "ROM Const mBSOFVS" VALUE 0x00009020 REC_UWORD_C 0 COMP_0436 0 6553.5 /end CHARACTERISTIC
/begin CHARACTERISTIC mBSOFVS_S "ROM Const mBSOFVS_S" VALUE 0x000157E4 REC_UWORD_C 0 COMP_0436 0 6553.5 /end CHARACTERISTIC
/begin CHARACTERISTIC mBSONAP "ROM Const mBSONAP" VALUE 0x00009022 REC_UWORD_C 0 COMP_0005 0 7208.85 /end CHARACTERISTIC
/begin CHARACTERISTIC mBSONAP_S "ROM Const mBSONAP_S" VALUE 0x000157E6 REC_UWORD_C 0 COMP_0005 0 7208.85 /end CHARACTERISTIC
/begin CHARACTERISTIC mBSRATIO "ROM Const mBSRATIO" VALUE 0x00009024 REC_UWORD_C 0 COMP_0450 0 63.999056205 /end CHARACTERISTIC
/begin CHARACTERISTIC mBSTAN "ROM Const mBSTAN" VALUE 0x00008340 REC_UBYTE_C 0 COMP_0035 -50 205 /end CHARACTERISTIC
/begin CHARACTERISTIC mBSTANJDG "ROM Const mBSTANJDG" VALUE 0x00008341 REC_UBYTE_C 0 COMP_0035 -50 205 /end CHARACTERISTIC
/begin CHARACTERISTIC mBSTANTH "ROM Const mBSTANTH" VALUE 0x00008342 REC_UBYTE_C 0 COMP_0035 -50 205 /end CHARACTERISTIC
/begin CHARACTERISTIC mBSTW "ROM Const mBSTW" VALUE 0x00008343 REC_UBYTE_C 0 COMP_0035 -50 205 /end CHARACTERISTIC
/begin CHARACTERISTIC mBTRHOS "ROM Const mBTRHOS" VALUE 0x00008344 REC_UBYTE_C 0 COMP_0054_S 0 3.984375 /end CHARACTERISTIC
/begin CHARACTERISTIC mBYITACHL "ROM Const mBYITACHL" VALUE 0x00008345 REC_UBYTE_C 0 COMP_0055_S 0 0.99609375 /end CHARACTERISTIC
/begin CHARACTERISTIC mCADSCNDA "ROM Const mCADSCNDA" VALUE 0x00008353 REC_UBYTE_C 0 COMP_0056_S 0 12.75 /end CHARACTERISTIC
/begin CHARACTERISTIC mCADSCNDB "ROM Const mCADSCNDB" VALUE 0x00008354 REC_UBYTE_C 0 COMP_0419 0 25.5 /end CHARACTERISTIC
/begin CHARACTERISTIC mCADTYCND "ROM Const mCADTYCND" VALUE 0x00008355 REC_UBYTE_C 0 COMP_0047 0 127.5 /end CHARACTERISTIC
/begin CHARACTERISTIC mCALPCNT "ROM Const mCALPCNT" VALUE 0x00009026 REC_UWORD_C 0 COMP_0016 0 65535 /end CHARACTERISTIC
/begin CHARACTERISTIC mCALPDLY "ROM Const mCALPDLY" VALUE 0x00009028 REC_UWORD_C 0 COMP_0017_S 0 655.35 /end CHARACTERISTIC
/begin CHARACTERISTIC mCALPTGT "ROM Const mCALPTGT" VALUE 0x0000902A REC_UWORD_C 0 COMP_0453 0 131.07 /end CHARACTERISTIC
/begin CHARACTERISTIC mCAMTDC "ROM Const mCAMTDC" VALUE 0x0000902C REC_UWORD_C 0 COMP_0057_S 0 6553.5 /end CHARACTERISTIC
/begin CHARACTERISTIC mCANALM "ROM Const mCANALM" VALUE 0x00008356 REC_UBYTE_C 0 COMP_0054 0 5100 /end CHARACTERISTIC
/begin CHARACTERISTIC mCANING "ROM Const mCANING" VALUE 0x00008358 REC_UBYTE_C 0 COMP_0016 0 255 /end CHARACTERISTIC
/begin CHARACTERISTIC mCANRXCNG "ROM Const mCANRXCNG" VALUE 0x00008359 REC_UBYTE_C 0 COMP_0068 0 255 /end CHARACTERISTIC
/begin CHARACTERISTIC mCANTXCNG "ROM Const mCANTXCNG" VALUE 0x0000835A REC_UBYTE_C 0 COMP_0068 0 255 /end CHARACTERISTIC
/begin CHARACTERISTIC mCANVSP "ROM Const mCANVSP" VALUE 0x0000835B REC_UBYTE_C 0 COMP_0004 0 255 /end CHARACTERISTIC
/begin CHARACTERISTIC mCAQEND "ROM Const mCAQEND" VALUE 0x0000835C REC_UBYTE_C 0 COMP_0055 0 1020 /end CHARACTERISTIC
/begin CHARACTERISTIC mCAQH0CND "ROM Const mCAQH0CND" VALUE 0x0000835D REC_UBYTE_C 0 COMP_0453 0 0.51 /end CHARACTERISTIC
/begin CHARACTERISTIC mCARSTOPU "ROM Const mCARSTOPU" VALUE 0x0000835E REC_UBYTE_C 0 COMP_0013 0 255 /end CHARACTERISTIC
/begin CHARACTERISTIC mCATBAI "ROM Const mCATBAI" VALUE 0x0000835F REC_UBYTE_C 0 COMP_0016 0 255 /end CHARACTERISTIC
/begin CHARACTERISTIC mCATDY1 "ROM Const mCATDY1" VALUE 0x00008360 REC_UBYTE_C 0 COMP_0008 0 25500 /end CHARACTERISTIC
/begin CHARACTERISTIC mCATEVP "ROM Const mCATEVP" VALUE 0x00008361 REC_UBYTE_C 0 COMP_0013 0 255 /end CHARACTERISTIC
/begin CHARACTERISTIC mCATGND "ROM Const mCATGND" VALUE 0x00008362 REC_UBYTE_C 0 COMP_0373 0 2.55 /end CHARACTERISTIC
/begin CHARACTERISTIC mCATJD2 "ROM Const mCATJD2" VALUE 0x00008363 REC_UBYTE_C 0 COMP_0013 0 255 /end CHARACTERISTIC
/begin CHARACTERISTIC mCATJDLY "ROM Const mCATJDLY" VALUE 0x00008364 REC_UBYTE_C 0 COMP_0008 0 25500 /end CHARACTERISTIC
/begin CHARACTERISTIC mCATMAH "ROM Const mCATMAH" VALUE 0x00008365 REC_UBYTE_C 0 COMP_0027 0 255 /end CHARACTERISTIC
/begin CHARACTERISTIC mCATMAL "ROM Const mCATMAL" VALUE 0x00008366 REC_UBYTE_C 0 COMP_0027 0 255 /end CHARACTERISTIC
/begin CHARACTERISTIC mCATNAH "ROM Const mCATNAH" VALUE 0x00008367 REC_UBYTE_C 0 COMP_0056 0 6375 /end CHARACTERISTIC
/begin CHARACTERISTIC mCATNAL "ROM Const mCATNAL" VALUE 0x00008368 REC_UBYTE_C 0 COMP_0000 0 6375 /end CHARACTERISTIC
/begin CHARACTERISTIC mCATNBH "ROM Const mCATNBH" VALUE 0x00008369 REC_UBYTE_C 0 COMP_0056 0 6375 /end CHARACTERISTIC
/begin CHARACTERISTIC mCATNBL "ROM Const mCATNBL" VALUE 0x0000836A REC_UBYTE_C 0 COMP_0000 0 6375 /end CHARACTERISTIC
/begin CHARACTERISTIC mCATNNH "ROM Const mCATNNH" VALUE 0x0000836B REC_UBYTE_C 0 COMP_0000 0 6375 /end CHARACTERISTIC
/begin CHARACTERISTIC mCATNNL "ROM Const mCATNNL" VALUE 0x0000836C REC_UBYTE_C 0 COMP_0000 0 6375 /end CHARACTERISTIC
/begin CHARACTERISTIC mCATPAH "ROM Const mCATPAH" VALUE 0x0000836D REC_UBYTE_C 0 COMP_0001 0 31.875 /end CHARACTERISTIC
/begin CHARACTERISTIC mCATPAL "ROM Const mCATPAL" VALUE 0x0000836E REC_UBYTE_C 0 COMP_0001 0 31.875 /end CHARACTERISTIC
/begin CHARACTERISTIC mCATPBH "ROM Const mCATPBH" VALUE 0x0000836F REC_UBYTE_C 0 COMP_0001 0 31.875 /end CHARACTERISTIC
/begin CHARACTERISTIC mCATPBL "ROM Const mCATPBL" VALUE 0x00008370 REC_UBYTE_C 0 COMP_0001 0 31.875 /end CHARACTERISTIC
/begin CHARACTERISTIC mCATQMA "ROM Const mCATQMA" VALUE 0x0000902E REC_UWORD_C 0 COMP_0004 0 65535 /end CHARACTERISTIC
/begin CHARACTERISTIC mCATQMB "ROM Const mCATQMB" VALUE 0x00009030 REC_UWORD_C 0 COMP_0004 0 65535 /end CHARACTERISTIC
/begin CHARACTERISTIC mCATRECL "ROM Const mCATRECL" VALUE 0x00008371 REC_UBYTE_C 0 COMP_0169 0 1.000000095 /end CHARACTERISTIC
/begin CHARACTERISTIC mCATRECLE "ROM Const mCATRECLE" VALUE 0x00008372 REC_UBYTE_C 0 COMP_0019_S 0 1.000000095 /end CHARACTERISTIC
/begin CHARACTERISTIC mCATSLSFT "ROM Const mCATSLSFT" VALUE 0x00008E20 REC_SWORD_C 0 COMP_0020_S -65.536 65.534 /end CHARACTERISTIC
/begin CHARACTERISTIC mCCHGADH "ROM Const mCCHGADH" VALUE 0x00008373 REC_UBYTE_C 0 COMP_0058_S 0 25500 /end CHARACTERISTIC
/begin CHARACTERISTIC mCCHGADH2 "ROM Const mCCHGADH2" VALUE 0x00009032 REC_UWORD_C 0 COMP_0058_S 0 6553500 /end CHARACTERISTIC
/begin CHARACTERISTIC mCCHGADL "ROM Const mCCHGADL" VALUE 0x00008374 REC_UBYTE_C 0 COMP_0058_S 0 25500 /end CHARACTERISTIC
/begin CHARACTERISTIC mCCHGADL2 "ROM Const mCCHGADL2" VALUE 0x00009034 REC_UWORD_C 0 COMP_0058_S 0 6553500 /end CHARACTERISTIC
/begin CHARACTERISTIC mCCHGADM2 "ROM Const mCCHGADM2" VALUE 0x00009036 REC_UWORD_C 0 COMP_0058_S 0 6553500 /end CHARACTERISTIC
/begin CHARACTERISTIC mCCONST "ROM Const mCCONST" VALUE 0x00009038 REC_UWORD_C 0 COMP_0057_S 0 6553.5 /end CHARACTERISTIC
/begin CHARACTERISTIC mCDC2NG "ROM Const mCDC2NG" VALUE 0x00008375 REC_UBYTE_C 0 COMP_0008 0 25500 /end CHARACTERISTIC
/begin CHARACTERISTIC mCDCEV2 "ROM Const mCDCEV2" VALUE 0x00008376 REC_UBYTE_C 0 COMP_0054 0 5100 /end CHARACTERISTIC
/begin CHARACTERISTIC mCDCLVS "ROM Const mCDCLVS" VALUE 0x00008377 REC_UBYTE_C 0 COMP_0007 0 510 /end CHARACTERISTIC
/begin CHARACTERISTIC mCDCTAL "ROM Const mCDCTAL" VALUE 0x00008378 REC_UBYTE_C 0 COMP_0035 -50 205 /end CHARACTERISTIC
/begin CHARACTERISTIC mCDCVODLY "ROM Const mCDCVODLY" VALUE 0x00008379 REC_UBYTE_C 0 COMP_0049 0 255 /end CHARACTERISTIC
/begin CHARACTERISTIC mCETPCT2 "ROM Const mCETPCT2" VALUE 0x0000837A REC_UBYTE_C 0 COMP_0047 0 127.5 /end CHARACTERISTIC
/begin CHARACTERISTIC mCFCD2MMD "ROM Const mCFCD2MMD" VALUE 0x0000837B REC_UBYTE_C 0 COMP_0014 0 2550 /end CHARACTERISTIC
/begin CHARACTERISTIC mCFCD2MML "ROM Const mCFCD2MML" VALUE 0x0000837C REC_UBYTE_C 0 COMP_0014 0 2550 /end CHARACTERISTIC
/begin CHARACTERISTIC mCFCD2NL "ROM Const mCFCD2NL" VALUE 0x0000837D REC_UBYTE_C 0 COMP_0014 0 2550 /end CHARACTERISTIC
/begin CHARACTERISTIC mCFCDMMD "ROM Const mCFCDMMD" VALUE 0x0000837E REC_UBYTE_C 0 COMP_0014 0 2550 /end CHARACTERISTIC
/begin CHARACTERISTIC mCFCDMMDL "ROM Const mCFCDMMDL" VALUE 0x0000837F REC_UBYTE_C 0 COMP_0014 0 2550 /end CHARACTERISTIC
/begin CHARACTERISTIC mCFCDNL "ROM Const mCFCDNL" VALUE 0x00008380 REC_UBYTE_C 0 COMP_0014 0 2550 /end CHARACTERISTIC
/begin CHARACTERISTIC mCFCMAX "ROM Const mCFCMAX" VALUE 0x0000903A REC_UWORD_C 0 COMP_0061 0 327675 /end CHARACTERISTIC
/begin CHARACTERISTIC mCFCMIN "ROM Const mCFCMIN" VALUE 0x0000903C REC_UWORD_C 0 COMP_0061 0 327675 /end CHARACTERISTIC
/begin CHARACTERISTIC mCHGEFC "ROM Const mCHGEFC" VALUE 0x00008381 REC_UBYTE_C 0 COMP_0373 0 2.55 /end CHARACTERISTIC
/begin CHARACTERISTIC mCHGHYS "ROM Const mCHGHYS" VALUE 0x0000903E REC_UWORD_C 0 COMP_0058_S 0 6553500 /end CHARACTERISTIC
/begin CHARACTERISTIC mCHGNGCUR "ROM Const mCHGNGCUR" VALUE 0x00008382 REC_UBYTE_C 0 COMP_0045_S 0 255 /end CHARACTERISTIC
/begin CHARACTERISTIC mCHGNGMX "ROM Const mCHGNGMX" VALUE 0x00008383 REC_UBYTE_C 0 COMP_0016 0 255 /end CHARACTERISTIC
/begin CHARACTERISTIC mCHGNGNE "ROM Const mCHGNGNE" VALUE 0x00008384 REC_UBYTE_C 0 COMP_0006 0 3187.5 /end CHARACTERISTIC
/begin CHARACTERISTIC mCHGOKHS "ROM Const mCHGOKHS" VALUE 0x00008385 REC_UBYTE_C 0 COMP_0059_S 0 31.875 /end CHARACTERISTIC
/begin CHARACTERISTIC mCHGOKTM "ROM Const mCHGOKTM" VALUE 0x00008386 REC_UBYTE_C 0 COMP_0008 0 25500 /end CHARACTERISTIC
/begin CHARACTERISTIC mCHGOKVO "ROM Const mCHGOKVO" VALUE 0x00008387 REC_UBYTE_C 0 COMP_0373 0 2.55 /end CHARACTERISTIC
/begin CHARACTERISTIC mCHGTSTMP "ROM Const mCHGTSTMP" VALUE 0x00008388 REC_UBYTE_C 0 COMP_0035 -50 205 /end CHARACTERISTIC
/begin CHARACTERISTIC mCHGTSTTM "ROM Const mCHGTSTTM" VALUE 0x00008389 REC_UBYTE_C 0 COMP_0105 0 25.5 /end CHARACTERISTIC
/begin CHARACTERISTIC mCHNMODE1 "ROM Const mCHNMODE1" VALUE 0x0000838A REC_UBYTE_C 0 COMP_0013 0 255 /end CHARACTERISTIC
/begin CHARACTERISTIC mCHOVCLC "ROM Const mCHOVCLC" VALUE 0x0000838B REC_UBYTE_C 0 COMP_0068 0 255 /end CHARACTERISTIC
/begin CHARACTERISTIC mCHTRH "ROM Const mCHTRH" VALUE 0x0000838C REC_UBYTE_C 0 COMP_0060_S 0 0.00255 /end CHARACTERISTIC
/begin CHARACTERISTIC mCHTRL "ROM Const mCHTRL" VALUE 0x0000838D REC_UBYTE_C 0 COMP_0060_S 0 0.00255 /end CHARACTERISTIC
/begin CHARACTERISTIC mCHTRLRF "ROM Const mCHTRLRF" VALUE 0x0000838E REC_UBYTE_C 0 COMP_0060_S 0 0.00255 /end CHARACTERISTIC
/begin CHARACTERISTIC mCHTRVSP "ROM Const mCHTRVSP" VALUE 0x0000838F REC_UBYTE_C 0 COMP_0007 0 510 /end CHARACTERISTIC
/begin CHARACTERISTIC mCIRCANTU "ROM Const mCIRCANTU" VALUE 0x00008390 REC_UBYTE_C 0 COMP_0040_S 0 2.55 /end CHARACTERISTIC
/begin CHARACTERISTIC mCJVSP1 "ROM Const mCJVSP1" VALUE 0x00008391 REC_UBYTE_C 0 COMP_0007 0 510 /end CHARACTERISTIC
/begin CHARACTERISTIC mCJVSP3 "ROM Const mCJVSP3" VALUE 0x00008392 REC_UBYTE_C 0 COMP_0007 0 510 /end CHARACTERISTIC
/begin CHARACTERISTIC mCKDWTM "ROM Const mCKDWTM" VALUE 0x00008393 REC_UBYTE_C 0 COMP_0049 0 255 /end CHARACTERISTIC
/begin CHARACTERISTIC mCKDWTW "ROM Const mCKDWTW" VALUE 0x00008394 REC_UBYTE_C 0 COMP_0035 -50 205 /end CHARACTERISTIC
/begin CHARACTERISTIC mCKDWVAPO "ROM Const mCKDWVAPO" VALUE 0x00009040 REC_UWORD_C 0 COMP_0005 0 7208.85 /end CHARACTERISTIC
/begin CHARACTERISTIC mCKDWVS "ROM Const mCKDWVS" VALUE 0x00008395 REC_UBYTE_C 0 COMP_0007 0 510 /end CHARACTERISTIC
/begin CHARACTERISTIC mCKST "ROM Const mCKST" VALUE 0x00008396 REC_UBYTE_C 0 COMP_0066 0 3.984375 /end CHARACTERISTIC
/begin CHARACTERISTIC mCKSTTM "ROM Const mCKSTTM" VALUE 0x00008397 REC_UBYTE_C 0 COMP_0013 0 255 /end CHARACTERISTIC
/begin CHARACTERISTIC mCKTDTM "ROM Const mCKTDTM" VALUE 0x00008398 REC_UBYTE_C 0 COMP_0008 0 25500 /end CHARACTERISTIC
/begin CHARACTERISTIC mCLAFSH "ROM Const mCLAFSH" VALUE 0x00009042 REC_UWORD_C 0 COMP_0453 0 131.07 /end CHARACTERISTIC
/begin CHARACTERISTIC mCLAFSL "ROM Const mCLAFSL" VALUE 0x00009044 REC_UWORD_C 0 COMP_0453 0 131.07 /end CHARACTERISTIC
/begin CHARACTERISTIC mCLCHGOVT "ROM Const mCLCHGOVT" VALUE 0x00008399 REC_UBYTE_C 0 COMP_0035 -50 205 /end CHARACTERISTIC
/begin CHARACTERISTIC mCLCLMP "ROM Const mCLCLMP" VALUE 0x0000839A REC_UBYTE_C 0 COMP_0035 -50 205 /end CHARACTERISTIC
/begin CHARACTERISTIC mCLD0 "ROM Const mCLD0" VALUE 0x00009046 REC_UWORD_C 0 COMP_0290 0 0.999985458 /end CHARACTERISTIC
/begin CHARACTERISTIC mCLDFBDLY "ROM Const mCLDFBDLY" VALUE 0x0000839B REC_UBYTE_C 0 COMP_0017_S 0 2.55 /end CHARACTERISTIC
/begin CHARACTERISTIC mCLDLY1 "ROM Const mCLDLY1" VALUE 0x0000839C REC_UBYTE_C 0 COMP_0049 0 255 /end CHARACTERISTIC
/begin CHARACTERISTIC mCLDLY2 "ROM Const mCLDLY2" VALUE 0x0000839D REC_UBYTE_C 0 COMP_0049 0 255 /end CHARACTERISTIC
/begin CHARACTERISTIC mCLDVDLY "ROM Const mCLDVDLY" VALUE 0x0000839E REC_UBYTE_C 0 COMP_0008 0 25500 /end CHARACTERISTIC
/begin CHARACTERISTIC mCLDVTNEL "ROM Const mCLDVTNEL" VALUE 0x0000839F REC_UBYTE_C 0 COMP_0006 0 3187.5 /end CHARACTERISTIC
/begin CHARACTERISTIC mCLDVTNHS "ROM Const mCLDVTNHS" VALUE 0x000083A0 REC_UBYTE_C 0 COMP_0006 0 3187.5 /end CHARACTERISTIC
/begin CHARACTERISTIC mCLERRTIM "ROM Const mCLERRTIM" VALUE 0x000083A1 REC_UBYTE_C 0 COMP_0008 0 25500 /end CHARACTERISTIC
/begin CHARACTERISTIC mCLORPM "ROM Const mCLORPM" VALUE 0x000083A2 REC_UBYTE_C 0 COMP_0070 0 3187.5 /end CHARACTERISTIC
/begin CHARACTERISTIC mCLPABH "ROM Const mCLPABH" VALUE 0x00009048 REC_UWORD_C 0 COMP_0486 0 5119.921875 /end CHARACTERISTIC
/begin CHARACTERISTIC mCLPABL "ROM Const mCLPABL" VALUE 0x0000904A REC_UWORD_C 0 COMP_0486 0 5119.921875 /end CHARACTERISTIC
/begin CHARACTERISTIC mCLPAHYS "ROM Const mCLPAHYS" VALUE 0x0000904C REC_UWORD_C 0 COMP_0486 0 5119.921875 /end CHARACTERISTIC
/begin CHARACTERISTIC mCLPCD "ROM Const mCLPCD" VALUE 0x000083A3 REC_UBYTE_C 0 COMP_0071 0 255 /end CHARACTERISTIC
/begin CHARACTERISTIC mCLPD "ROM Const mCLPD" VALUE 0x000083A4 REC_UBYTE_C 0 COMP_0071 0 255 /end CHARACTERISTIC
/begin CHARACTERISTIC mCLPVSP "ROM Const mCLPVSP" VALUE 0x000083A5 REC_UBYTE_C 0 COMP_0007 0 510 /end CHARACTERISTIC
/begin CHARACTERISTIC mCLRMAX "ROM Const mCLRMAX" VALUE 0x000083A6 REC_UBYTE_C 0 COMP_0027 0 255 /end CHARACTERISTIC
/begin CHARACTERISTIC mCLRMIN "ROM Const mCLRMIN" VALUE 0x000083A7 REC_UBYTE_C 0 COMP_0027 0 255 /end CHARACTERISTIC
/begin CHARACTERISTIC mCLRPMH "ROM Const mCLRPMH" VALUE 0x0000904E REC_UWORD_C 0 COMP_0006 0 819187.5 /end CHARACTERISTIC
/begin CHARACTERISTIC mCLRPML "ROM Const mCLRPML" VALUE 0x00009050 REC_UWORD_C 0 COMP_0006 0 819187.5 /end CHARACTERISTIC
/begin CHARACTERISTIC mCLSDLY "ROM Const mCLSDLY" VALUE 0x000083A8 REC_UBYTE_C 0 COMP_0049 0 255 /end CHARACTERISTIC
/begin CHARACTERISTIC mCLSDTY "ROM Const mCLSDTY" VALUE 0x000083A9 REC_UBYTE_C 0 COMP_0027 0 255 /end CHARACTERISTIC
/begin CHARACTERISTIC mCLTAMN "ROM Const mCLTAMN" VALUE 0x000083AA REC_UBYTE_C 0 COMP_0035 -50 205 /end CHARACTERISTIC
/begin CHARACTERISTIC mCLTANH "ROM Const mCLTANH" VALUE 0x000083AB REC_UBYTE_C 0 COMP_0035 -50 205 /end CHARACTERISTIC
/begin CHARACTERISTIC mCLTANL "ROM Const mCLTANL" VALUE 0x000083AC REC_UBYTE_C 0 COMP_0035 -50 205 /end CHARACTERISTIC
/begin CHARACTERISTIC mCLTPH "ROM Const mCLTPH" VALUE 0x00009052 REC_UWORD_C 0 COMP_0144 0 31.999495335 /end CHARACTERISTIC
/begin CHARACTERISTIC mCLTPHE "ROM Const mCLTPHE" VALUE 0x00009054 REC_UWORD_C 0 COMP_0144 0 31.999495335 /end CHARACTERISTIC
/begin CHARACTERISTIC mCLTPHYS "ROM Const mCLTPHYS" VALUE 0x00009056 REC_UWORD_C 0 COMP_0144 0 31.999495335 /end CHARACTERISTIC
/begin CHARACTERISTIC mCLTPL "ROM Const mCLTPL" VALUE 0x00009058 REC_UWORD_C 0 COMP_0144 0 31.999495335 /end CHARACTERISTIC
/begin CHARACTERISTIC mCLTPLE "ROM Const mCLTPLE" VALUE 0x0000905A REC_UWORD_C 0 COMP_0144 0 31.999495335 /end CHARACTERISTIC
/begin CHARACTERISTIC mCLTWNL "ROM Const mCLTWNL" VALUE 0x000083AD REC_UBYTE_C 0 COMP_0035 -50 205 /end CHARACTERISTIC
/begin CHARACTERISTIC mCLVBHI "ROM Const mCLVBHI" VALUE 0x000083AE REC_UBYTE_C 0 COMP_0033 0 20400 /end CHARACTERISTIC
/begin CHARACTERISTIC mCLVBL "ROM Const mCLVBL" VALUE 0x000083AF REC_UBYTE_C 0 COMP_0026 0 20400 /end CHARACTERISTIC
/begin CHARACTERISTIC mCLVSPH "ROM Const mCLVSPH" VALUE 0x000083B0 REC_UBYTE_C 0 COMP_0007 0 510 /end CHARACTERISTIC
/begin CHARACTERISTIC mCLVSPL "ROM Const mCLVSPL" VALUE 0x000083B1 REC_UBYTE_C 0 COMP_0007 0 510 /end CHARACTERISTIC
/begin CHARACTERISTIC mCMM "ROM Const mCMM" VALUE 0x0000905C REC_UWORD_C 0 COMP_0061_S 0 6.5535 /end CHARACTERISTIC
/begin CHARACTERISTIC mCMOIM1 "ROM Const mCMOIM1" VALUE 0x000083B2 REC_UBYTE_C 0 COMP_0016 0 255 /end CHARACTERISTIC
/begin CHARACTERISTIC mCMOIM2 "ROM Const mCMOIM2" VALUE 0x000083B3 REC_UBYTE_C 0 COMP_0016 0 255 /end CHARACTERISTIC
/begin CHARACTERISTIC mCMOIM3 "ROM Const mCMOIM3" VALUE 0x000083B4 REC_UBYTE_C 0 COMP_0016 0 255 /end CHARACTERISTIC
/begin CHARACTERISTIC mCMOIM4 "ROM Const mCMOIM4" VALUE 0x000083B5 REC_UBYTE_C 0 COMP_0016 0 255 /end CHARACTERISTIC
/begin CHARACTERISTIC mCMPTIME "ROM Const mCMPTIME" VALUE 0x000083B6 REC_UBYTE_C 0 COMP_0008 0 25500 /end CHARACTERISTIC
/begin CHARACTERISTIC mCNGDLY2E "ROM Const mCNGDLY2E" VALUE 0x000083B7 REC_UBYTE_C 0 COMP_0008 0 25500 /end CHARACTERISTIC
/begin CHARACTERISTIC mCNGMOK "ROM Const mCNGMOK" VALUE 0x000083B8 REC_UBYTE_C 0 COMP_0062_S 0 255 /end CHARACTERISTIC
/begin CHARACTERISTIC mCNMNT "ROM Const mCNMNT" VALUE 0x000083B9 REC_UBYTE_C 0 COMP_0016 0 255 /end CHARACTERISTIC
/begin CHARACTERISTIC mCNNGML "ROM Const mCNNGML" VALUE 0x000083BA REC_UBYTE_C 0 COMP_0016 0 255 /end CHARACTERISTIC
/begin CHARACTERISTIC mCNQ "ROM Const mCNQ" VALUE 0x000083BB REC_UBYTE_C 0 COMP_0032 0 0.99609375 /end CHARACTERISTIC
/begin CHARACTERISTIC mCNROL "ROM Const mCNROL" VALUE 0x000083BC REC_UBYTE_C 0 COMP_0071 0 255 /end CHARACTERISTIC
/begin CHARACTERISTIC mCNTIDLN "ROM Const mCNTIDLN" VALUE 0x000083BD REC_UBYTE_C 0 COMP_0016 0 255 /end CHARACTERISTIC
/begin CHARACTERISTIC mCNTLMTM "ROM Const mCNTLMTM" VALUE 0x000083BE REC_UBYTE_C 0 COMP_0016 0 255 /end CHARACTERISTIC
/begin CHARACTERISTIC mCNTMAX "ROM Const mCNTMAX" VALUE 0x0000905E REC_UWORD_C 0 COMP_0063_S 0 257.00008995 /end CHARACTERISTIC
/begin CHARACTERISTIC mCNVDLY "ROM Const mCNVDLY" VALUE 0x000083BF REC_UBYTE_C 0 COMP_0008 0 25500 /end CHARACTERISTIC
/begin CHARACTERISTIC mCOMBRMP "ROM Const mCOMBRMP" VALUE 0x00009060 REC_UWORD_C 0 COMP_0064_S 0 65535 /end CHARACTERISTIC
/begin CHARACTERISTIC mCOMDTF "ROM Const mCOMDTF" VALUE 0x000096A4 REC_SLONG_C 0 COMP_0003_S -429496729.6 429496729.4 /end CHARACTERISTIC
/begin CHARACTERISTIC mCOMGOS "ROM Const mCOMGOS" VALUE 0x000096A8 REC_SLONG_C 0 COMP_0003_S -429496729.6 429496729.4 /end CHARACTERISTIC
/begin CHARACTERISTIC mCOMPRCV "ROM Const mCOMPRCV" VALUE 0x000083C1 REC_UBYTE_C 0 COMP_0063 0 0.99609375 /end CHARACTERISTIC
/begin CHARACTERISTIC mCPFLTTM "ROM Const mCPFLTTM" VALUE 0x000083C2 REC_UBYTE_C 0 COMP_0049 0 255 /end CHARACTERISTIC
/begin CHARACTERISTIC mCPFUEL "ROM Const mCPFUEL" VALUE 0x000083C3 REC_UBYTE_C 0 COMP_0004 0 255 /end CHARACTERISTIC
/begin CHARACTERISTIC mCPOILA "ROM Const mCPOILA" VALUE 0x00009062 REC_UWORD_C 0 COMP_0068 0 65535 /end CHARACTERISTIC
/begin CHARACTERISTIC mCPOILB "ROM Const mCPOILB" VALUE 0x00009064 REC_UWORD_C 0 COMP_0065_S 0 1023.984375 /end CHARACTERISTIC
/begin CHARACTERISTIC mCRADVRPM "ROM Const mCRADVRPM" VALUE 0x000083C4 REC_UBYTE_C 0 COMP_0006 0 3187.5 /end CHARACTERISTIC
/begin CHARACTERISTIC mCRAHIE "ROM Const mCRAHIE" VALUE 0x000083C5 REC_UBYTE_C 0 COMP_0016 0 255 /end CHARACTERISTIC
/begin CHARACTERISTIC mCRALOWE "ROM Const mCRALOWE" VALUE 0x000083C6 REC_UBYTE_C 0 COMP_0016 0 255 /end CHARACTERISTIC
/begin CHARACTERISTIC mCRANGCT "ROM Const mCRANGCT" VALUE 0x000083C7 REC_UBYTE_C 0 COMP_0068 0 255 /end CHARACTERISTIC
/begin CHARACTERISTIC mCRIKIN1 "ROM Const mCRIKIN1" VALUE 0x000083C8 REC_UBYTE_C 0 COMP_0015_S 0 25.5 /end CHARACTERISTIC
/begin CHARACTERISTIC mCRIKIN2 "ROM Const mCRIKIN2" VALUE 0x00009066 REC_UWORD_C 0 COMP_0015_S 0 6553.5 /end CHARACTERISTIC
/begin CHARACTERISTIC mCRKINQ "ROM Const mCRKINQ" VALUE 0x000083C9 REC_UBYTE_C 0 COMP_0063 0 0.99609375 /end CHARACTERISTIC
/begin CHARACTERISTIC mCRKINQH "ROM Const mCRKINQH" VALUE 0x000083CA REC_UBYTE_C 0 COMP_0063 0 0.99609375 /end CHARACTERISTIC
/begin CHARACTERISTIC mCRMODLY "ROM Const mCRMODLY" VALUE 0x000083CB REC_UBYTE_C 0 COMP_0008 0 25500 /end CHARACTERISTIC
/begin CHARACTERISTIC mCRMONEL "ROM Const mCRMONEL" VALUE 0x000083CC REC_UBYTE_C 0 COMP_0006 0 3187.5 /end CHARACTERISTIC
/begin CHARACTERISTIC mCRSET "ROM Const mCRSET" VALUE 0x000083CD REC_UBYTE_C 0 COMP_0017 0 255 /end CHARACTERISTIC
/begin CHARACTERISTIC mCRTEM2 "ROM Const mCRTEM2" VALUE 0x00009068 REC_UWORD_C 0 COMP_0016 0 65535 /end CHARACTERISTIC
/begin CHARACTERISTIC mCSDLTTP "ROM Const mCSDLTTP" VALUE 0x0000906A REC_UWORD_C 0 COMP_0144 0 31.999495335 /end CHARACTERISTIC
/begin CHARACTERISTIC mCSISCDLY "ROM Const mCSISCDLY" VALUE 0x0000906C REC_UWORD_C 0 COMP_0015_S 0 6553.5 /end CHARACTERISTIC
/begin CHARACTERISTIC mCSKANBAK "ROM Const mCSKANBAK" VALUE 0x0000906E REC_UWORD_C 0 COMP_0006 0 819187.5 /end CHARACTERISTIC
/begin CHARACTERISTIC mCSMNDDLY "ROM Const mCSMNDDLY" VALUE 0x000083D1 REC_UBYTE_C 0 COMP_0015_S 0 25.5 /end CHARACTERISTIC
/begin CHARACTERISTIC mCSMPAMB "ROM Const mCSMPAMB" VALUE 0x00009070 REC_UWORD_C 0 COMP_0486 0 5119.921875 /end CHARACTERISTIC
/begin CHARACTERISTIC mCSMTAN "ROM Const mCSMTAN" VALUE 0x000083D2 REC_UBYTE_C 0 COMP_0035 -50 205 /end CHARACTERISTIC
/begin CHARACTERISTIC mCSMVSP "ROM Const mCSMVSP" VALUE 0x000083D3 REC_UBYTE_C 0 COMP_0007 0 510 /end CHARACTERISTIC
/begin CHARACTERISTIC mCSNGDC "ROM Const mCSNGDC" VALUE 0x000083D4 REC_UBYTE_C 0 COMP_0014 0 2550 /end CHARACTERISTIC
/begin CHARACTERISTIC mCSNGDP "ROM Const mCSNGDP" VALUE 0x000083D5 REC_UBYTE_C 0 COMP_0014 0 2550 /end CHARACTERISTIC
/begin CHARACTERISTIC mCSNGRC "ROM Const mCSNGRC" VALUE 0x000083D6 REC_UBYTE_C 0 COMP_0016 0 255 /end CHARACTERISTIC
/begin CHARACTERISTIC mCSNGRP "ROM Const mCSNGRP" VALUE 0x000083D7 REC_UBYTE_C 0 COMP_0016 0 255 /end CHARACTERISTIC
/begin CHARACTERISTIC mCSNGSTC "ROM Const mCSNGSTC" VALUE 0x000083D8 REC_UBYTE_C 0 COMP_0014 0 2550 /end CHARACTERISTIC
/begin CHARACTERISTIC mCSNGSTP "ROM Const mCSNGSTP" VALUE 0x000083D9 REC_UBYTE_C 0 COMP_0014 0 2550 /end CHARACTERISTIC
/begin CHARACTERISTIC mCSOFS "ROM Const mCSOFS" VALUE 0x000083DA REC_UBYTE_C 0 COMP_0017 0 255 /end CHARACTERISTIC
/begin CHARACTERISTIC mCSOFSE "ROM Const mCSOFSE" VALUE 0x000083DB REC_UBYTE_C 0 COMP_0017 0 255 /end CHARACTERISTIC
/begin CHARACTERISTIC mCSSACTTM "ROM Const mCSSACTTM" VALUE 0x000083DC REC_UBYTE_C 0 COMP_0015_S 0 25.5 /end CHARACTERISTIC
/begin CHARACTERISTIC mCSSDLY "ROM Const mCSSDLY" VALUE 0x000083DD REC_UBYTE_C 0 COMP_0015_S 0 25.5 /end CHARACTERISTIC
/begin CHARACTERISTIC mCSSTWH "ROM Const mCSSTWH" VALUE 0x000083DE REC_UBYTE_C 0 COMP_0035 -50 205 /end CHARACTERISTIC
/begin CHARACTERISTIC mCSSTWL "ROM Const mCSSTWL" VALUE 0x000083DF REC_UBYTE_C 0 COMP_0035 -50 205 /end CHARACTERISTIC
/begin CHARACTERISTIC mCSTACONT "ROM Const mCSTACONT" VALUE 0x000083E0 REC_UBYTE_C 0 COMP_0105 0 25.5 /end CHARACTERISTIC
/begin CHARACTERISTIC mCSTACTMN "ROM Const mCSTACTMN" VALUE 0x000083E1 REC_UBYTE_C 0 COMP_0105 0 25.5 /end CHARACTERISTIC
/begin CHARACTERISTIC mCSTPPLS "ROM Const mCSTPPLS" VALUE 0x000083E2 REC_UBYTE_C 0 COMP_0016 0 255 /end CHARACTERISTIC
/begin CHARACTERISTIC mCSTQA "ROM Const mCSTQA" VALUE 0x000083E3 REC_UBYTE_C 0 COMP_0004 0 255 /end CHARACTERISTIC
/begin CHARACTERISTIC mCSTWINTH "ROM Const mCSTWINTH" VALUE 0x000083E4 REC_UBYTE_C 0 COMP_0035 -50 205 /end CHARACTERISTIC
/begin CHARACTERISTIC mCSTWINTL "ROM Const mCSTWINTL" VALUE 0x000083E5 REC_UBYTE_C 0 COMP_0035 -50 205 /end CHARACTERISTIC
/begin CHARACTERISTIC mCSWLRLGH "ROM Const mCSWLRLGH" VALUE 0x00009072 REC_UWORD_C 0 COMP_0040_S 0 655.35 /end CHARACTERISTIC
/begin CHARACTERISTIC mCSWLRLGL "ROM Const mCSWLRLGL" VALUE 0x00009074 REC_UWORD_C 0 COMP_0040_S 0 655.35 /end CHARACTERISTIC
/begin CHARACTERISTIC mCTKMR1 "ROM Const mCTKMR1" VALUE 0x000083E6 REC_UBYTE_C 0 COMP_0215 0 51 /end CHARACTERISTIC
/begin CHARACTERISTIC mCTKMR21 "ROM Const mCTKMR21" VALUE 0x000083E7 REC_UBYTE_C 0 COMP_0215 0 51 /end CHARACTERISTIC
/begin CHARACTERISTIC mCTKMR22 "ROM Const mCTKMR22" VALUE 0x000083E8 REC_UBYTE_C 0 COMP_0215 0 51 /end CHARACTERISTIC
/begin CHARACTERISTIC mCTKMR3 "ROM Const mCTKMR3" VALUE 0x000083E9 REC_UBYTE_C 0 COMP_0215 0 51 /end CHARACTERISTIC
/begin CHARACTERISTIC mCTKMR4 "ROM Const mCTKMR4" VALUE 0x000083EA REC_UBYTE_C 0 COMP_0215 0 51 /end CHARACTERISTIC
/begin CHARACTERISTIC mCTKMR5 "ROM Const mCTKMR5" VALUE 0x000083EB REC_UBYTE_C 0 COMP_0215 0 51 /end CHARACTERISTIC
/begin CHARACTERISTIC mCTKMR6 "ROM Const mCTKMR6" VALUE 0x000083EC REC_UBYTE_C 0 COMP_0215 0 51 /end CHARACTERISTIC
/begin CHARACTERISTIC mCTKMRS3 "ROM Const mCTKMRS3" VALUE 0x000083ED REC_UBYTE_C 0 COMP_0215 0 51 /end CHARACTERISTIC
/begin CHARACTERISTIC mCTKMRS5 "ROM Const mCTKMRS5" VALUE 0x000083EE REC_UBYTE_C 0 COMP_0215 0 51 /end CHARACTERISTIC
/begin CHARACTERISTIC mCTRCNT "ROM Const mCTRCNT" VALUE 0x00009076 REC_UWORD_C 0 COMP_0287 0 65535 /end CHARACTERISTIC
/begin CHARACTERISTIC mCTRQQ "ROM Const mCTRQQ" VALUE 0x000083EF REC_UBYTE_C 0 COMP_0032 0 0.99609375 /end CHARACTERISTIC
/begin CHARACTERISTIC mCTSQCDCT "ROM Const mCTSQCDCT" VALUE 0x000083F0 REC_UBYTE_C 0 COMP_0066_S 0 25.5 /end CHARACTERISTIC
/begin CHARACTERISTIC mCTTAN1 "ROM Const mCTTAN1" VALUE 0x000083F1 REC_UBYTE_C 0 COMP_0016 0 255 /end CHARACTERISTIC
/begin CHARACTERISTIC mCURDBH "ROM Const mCURDBH" VALUE 0x000083F2 REC_UBYTE_C 0 COMP_0067_S 0 127.5 /end CHARACTERISTIC
/begin CHARACTERISTIC mCURDBL "ROM Const mCURDBL" VALUE 0x000083F3 REC_UBYTE_C 0 COMP_0067_S 0 127.5 /end CHARACTERISTIC
/begin CHARACTERISTIC mCURGPTM "ROM Const mCURGPTM" VALUE 0x000083F4 REC_UBYTE_C 0 COMP_0105 0 25.5 /end CHARACTERISTIC
/begin CHARACTERISTIC mCURKJU "ROM Const mCURKJU" VALUE 0x000083F5 REC_UBYTE_C 0 COMP_0068 0 255 /end CHARACTERISTIC
/begin CHARACTERISTIC mCURSLP "ROM Const mCURSLP" VALUE 0x000083F6 REC_UBYTE_C 0 COMP_0068_S 0 2.55 /end CHARACTERISTIC
/begin CHARACTERISTIC mCUTMSK "ROM Const mCUTMSK" VALUE 0x000083F7 REC_UBYTE_C 0 COMP_0013 0 255 /end CHARACTERISTIC
/begin CHARACTERISTIC mCVPSMX "ROM Const mCVPSMX" VALUE 0x000083F8 REC_UBYTE_C 0 COMP_0016 0 255 /end CHARACTERISTIC
/begin CHARACTERISTIC mCVTCNH "ROM Const mCVTCNH" VALUE 0x000083F9 REC_UBYTE_C 0 COMP_0006 0 3187.5 /end CHARACTERISTIC
/begin CHARACTERISTIC mCVTCTW "ROM Const mCVTCTW" VALUE 0x000083FA REC_UBYTE_C 0 COMP_0069_S -50 205 /end CHARACTERISTIC
/begin CHARACTERISTIC mCVTIUPDT "ROM Const mCVTIUPDT" VALUE 0x000083FB REC_UBYTE_C 0 COMP_0014 0 2550 /end CHARACTERISTIC
/begin CHARACTERISTIC mCVTIUPMN "ROM Const mCVTIUPMN" VALUE 0x000083FC REC_UBYTE_C 0 COMP_0006 0 3187.5 /end CHARACTERISTIC
/begin CHARACTERISTIC mCVTIUPMX "ROM Const mCVTIUPMX" VALUE 0x000083FD REC_UBYTE_C 0 COMP_0006 0 3187.5 /end CHARACTERISTIC
/begin CHARACTERISTIC mCVTIUPVS "ROM Const mCVTIUPVS" VALUE 0x00009078 REC_UWORD_C 0 COMP_0436 0 6553.5 /end CHARACTERISTIC
/begin CHARACTERISTIC mCVTTDUS "ROM Const mCVTTDUS" VALUE 0x0000907A REC_UWORD_C 0 COMP_0070_S 0 0.999985458 /end CHARACTERISTIC
/begin CHARACTERISTIC mCVTTLMT "ROM Const mCVTTLMT" VALUE 0x00008E22 REC_SWORD_C 0 COMP_0228 -3276.8 3276.7 /end CHARACTERISTIC
/begin CHARACTERISTIC mCWGSPR "ROM Const mCWGSPR" VALUE 0x0000907C REC_UWORD_C 0 COMP_0071_S 0 0.040959375 /end CHARACTERISTIC
/begin CHARACTERISTIC mCYLNGSL "ROM Const mCYLNGSL" VALUE 0x000083FE REC_UBYTE_C 0 COMP_0068 0 255 /end CHARACTERISTIC
/begin CHARACTERISTIC mDABFHIS "ROM Const mDABFHIS" VALUE 0x00008E24 REC_SWORD_C 0 COMP_0072_S -131.072 131.068 /end CHARACTERISTIC
/begin CHARACTERISTIC mDACLLQM "ROM Const mDACLLQM" VALUE 0x0000907E REC_UWORD_C 0 COMP_0068 0 65535 /end CHARACTERISTIC
/begin CHARACTERISTIC mDACLLREV "ROM Const mDACLLREV" VALUE 0x00009080 REC_UWORD_C 0 COMP_0006 0 819187.5 /end CHARACTERISTIC
/begin CHARACTERISTIC mDACOFL "ROM Const mDACOFL" VALUE 0x000083FF REC_UBYTE_C 0 COMP_0014 0 2550 /end CHARACTERISTIC
/begin CHARACTERISTIC mDACONL "ROM Const mDACONL" VALUE 0x00008400 REC_UBYTE_C 0 COMP_0014 0 2550 /end CHARACTERISTIC
/begin CHARACTERISTIC mDACULREV "ROM Const mDACULREV" VALUE 0x00009082 REC_UWORD_C 0 COMP_0006 0 819187.5 /end CHARACTERISTIC
/begin CHARACTERISTIC mDADSCC "ROM Const mDADSCC" VALUE 0x00008401 REC_UBYTE_C 0 COMP_0021 0 99.609375 /end CHARACTERISTIC
/begin CHARACTERISTIC mDADSCO "ROM Const mDADSCO" VALUE 0x00008402 REC_UBYTE_C 0 COMP_0021 0 99.609375 /end CHARACTERISTIC
/begin CHARACTERISTIC mDADV "ROM Const mDADV" VALUE 0x00008E26 REC_SWORD_C 0 COMP_0078 -128 127.99609375 /end CHARACTERISTIC
/begin CHARACTERISTIC mDADVAJR "ROM Const mDADVAJR" VALUE 0x00008403 REC_UBYTE_C 0 COMP_0073_S 0 255 /end CHARACTERISTIC
/begin CHARACTERISTIC mDAFSDLY "ROM Const mDAFSDLY" VALUE 0x00009084 REC_UWORD_C 0 COMP_0017_S 0 655.35 /end CHARACTERISTIC
/begin CHARACTERISTIC mDAFSLMT "ROM Const mDAFSLMT" VALUE 0x00009086 REC_UWORD_C 0 COMP_0074_S 0 327675 /end CHARACTERISTIC
/begin CHARACTERISTIC mDAPINVDE "ROM Const mDAPINVDE" VALUE 0x00009088 REC_UWORD_C 0 COMP_0038 0 7208.85 /end CHARACTERISTIC
/begin CHARACTERISTIC mDAPOFULL "ROM Const mDAPOFULL" VALUE 0x0000908A REC_UWORD_C 0 COMP_0005 0 7208.85 /end CHARACTERISTIC
/begin CHARACTERISTIC mDAPOJK "ROM Const mDAPOJK" VALUE 0x00008404 REC_UBYTE_C 0 COMP_0005 0 28.05 /end CHARACTERISTIC
/begin CHARACTERISTIC mDAPOJK_S "ROM Const mDAPOJK_S" VALUE 0x000157CD REC_UBYTE_C 0 COMP_0005 0 28.05 /end CHARACTERISTIC
/begin CHARACTERISTIC mDAPOL2_S "ROM Const mDAPOL2_S" VALUE 0x000157CE REC_UBYTE_C 0 COMP_0005 0 28.05 /end CHARACTERISTIC
/begin CHARACTERISTIC mDAPOLMT "ROM Const mDAPOLMT" VALUE 0x00008405 REC_UBYTE_C 0 COMP_0005 0 28.05 /end CHARACTERISTIC
/begin CHARACTERISTIC mDAPOLT2 "ROM Const mDAPOLT2" VALUE 0x00008406 REC_UBYTE_C 0 COMP_0005 0 28.05 /end CHARACTERISTIC
/begin CHARACTERISTIC mDAPOLT_S "ROM Const mDAPOLT_S" VALUE 0x000157CF REC_UBYTE_C 0 COMP_0005 0 28.05 /end CHARACTERISTIC
/begin CHARACTERISTIC mDAPXLH "ROM Const mDAPXLH" VALUE 0x0000908C REC_UWORD_C 0 COMP_0014 0 655350 /end CHARACTERISTIC
/begin CHARACTERISTIC mDATRD "ROM Const mDATRD" VALUE 0x00008407 REC_UBYTE_C 0 COMP_0075_S 0 127.5 /end CHARACTERISTIC
/begin CHARACTERISTIC mDBBNMH "ROM Const mDBBNMH" VALUE 0x00008408 REC_UBYTE_C 0 COMP_0020 0 12750 /end CHARACTERISTIC
/begin CHARACTERISTIC mDBBNML "ROM Const mDBBNML" VALUE 0x00008409 REC_UBYTE_C 0 COMP_0020 0 12750 /end CHARACTERISTIC
/begin CHARACTERISTIC mDBBTPH "ROM Const mDBBTPH" VALUE 0x0000840A REC_UBYTE_C 0 COMP_0001 0 31.875 /end CHARACTERISTIC
/begin CHARACTERISTIC mDBBTPL "ROM Const mDBBTPL" VALUE 0x0000840B REC_UBYTE_C 0 COMP_0001 0 31.875 /end CHARACTERISTIC
/begin CHARACTERISTIC mDBBTW "ROM Const mDBBTW" VALUE 0x0000840C REC_UBYTE_C 0 COMP_0035 -50 205 /end CHARACTERISTIC
/begin CHARACTERISTIC mDBLBST "ROM Const mDBLBST" VALUE 0x0000840D REC_UBYTE_C 0 COMP_0016 0 255 /end CHARACTERISTIC
/begin CHARACTERISTIC mDCLLAT "ROM Const mDCLLAT" VALUE 0x0000840E REC_UBYTE_C 0 COMP_0004_S -50 205 /end CHARACTERISTIC
/begin CHARACTERISTIC mDCLLTWN "ROM Const mDCLLTWN" VALUE 0x0000840F REC_UBYTE_C 0 COMP_0004_S -50 205 /end CHARACTERISTIC
/begin CHARACTERISTIC mDCLLVSP "ROM Const mDCLLVSP" VALUE 0x00008410 REC_UBYTE_C 0 COMP_0007 0 510 /end CHARACTERISTIC
/begin CHARACTERISTIC mDCMULTWN "ROM Const mDCMULTWN" VALUE 0x00008411 REC_UBYTE_C 0 COMP_0004_S -50 205 /end CHARACTERISTIC
/begin CHARACTERISTIC mDCPGTM "ROM Const mDCPGTM" VALUE 0x00008412 REC_UBYTE_C 0 COMP_0008 0 25500 /end CHARACTERISTIC
/begin CHARACTERISTIC mDCULTWN "ROM Const mDCULTWN" VALUE 0x00008413 REC_UBYTE_C 0 COMP_0004_S -50 205 /end CHARACTERISTIC
/begin CHARACTERISTIC mDCVOPN "ROM Const mDCVOPN" VALUE 0x00008414 REC_UBYTE_C 0 COMP_0054 0 5100 /end CHARACTERISTIC
/begin CHARACTERISTIC mDCVOPTM "ROM Const mDCVOPTM" VALUE 0x00008415 REC_UBYTE_C 0 COMP_0013 0 255 /end CHARACTERISTIC
/begin CHARACTERISTIC mDCVOTM "ROM Const mDCVOTM" VALUE 0x00008416 REC_UBYTE_C 0 COMP_0013 0 255 /end CHARACTERISTIC
/begin CHARACTERISTIC mDCVOTME "ROM Const mDCVOTME" VALUE 0x00008417 REC_UBYTE_C 0 COMP_0013 0 255 /end CHARACTERISTIC
/begin CHARACTERISTIC mDCVTFL "ROM Const mDCVTFL" VALUE 0x00008418 REC_UBYTE_C 0 COMP_0035 -50 205 /end CHARACTERISTIC
/begin CHARACTERISTIC mDDGNTC "ROM Const mDDGNTC" VALUE 0x00008419 REC_UBYTE_C 0 COMP_0014 0 2550 /end CHARACTERISTIC
/begin CHARACTERISTIC mDDLTAN "ROM Const mDDLTAN" VALUE 0x0000841A REC_UBYTE_C 0 COMP_0003 0 255 /end CHARACTERISTIC
/begin CHARACTERISTIC mDDPAPO "ROM Const mDDPAPO" VALUE 0x0000908E REC_UWORD_C 0 COMP_0085 0 25599.609375 /end CHARACTERISTIC
/begin CHARACTERISTIC mDDSHPT "ROM Const mDDSHPT" VALUE 0x0000841B REC_UBYTE_C 0 COMP_0076_S 0 1.9921875 /end CHARACTERISTIC
/begin CHARACTERISTIC mDDSHPT0 "ROM Const mDDSHPT0" VALUE 0x0000841C REC_UBYTE_C 0 COMP_0076_S 0 1.9921875 /end CHARACTERISTIC
/begin CHARACTERISTIC mDEADTM1 "ROM Const mDEADTM1" VALUE 0x0000841D REC_UBYTE_C 0 COMP_0077_S 0 255 /end CHARACTERISTIC
/begin CHARACTERISTIC mDEADTM12 "ROM Const mDEADTM12" VALUE 0x0000841E REC_UBYTE_C 0 COMP_0077_S 0 255 /end CHARACTERISTIC
/begin CHARACTERISTIC mDEADTM2 "ROM Const mDEADTM2" VALUE 0x0000841F REC_UBYTE_C 0 COMP_0077_S 0 255 /end CHARACTERISTIC
/begin CHARACTERISTIC mDEADTM22 "ROM Const mDEADTM22" VALUE 0x00008420 REC_UBYTE_C 0 COMP_0077_S 0 255 /end CHARACTERISTIC
/begin CHARACTERISTIC mDEADTM3 "ROM Const mDEADTM3" VALUE 0x00008421 REC_UBYTE_C 0 COMP_0077_S 0 255 /end CHARACTERISTIC
/begin CHARACTERISTIC mDEADTM32 "ROM Const mDEADTM32" VALUE 0x00008422 REC_UBYTE_C 0 COMP_0077_S 0 255 /end CHARACTERISTIC
/begin CHARACTERISTIC mDECCNT "ROM Const mDECCNT" VALUE 0x00008423 REC_UBYTE_C 0 COMP_0063_S 0 1.00000035 /end CHARACTERISTIC
/begin CHARACTERISTIC mDEFC "ROM Const mDEFC" VALUE 0x00008424 REC_UBYTE_C 0 COMP_0066_S 0 25.5 /end CHARACTERISTIC
/begin CHARACTERISTIC mDELSPLMT "ROM Const mDELSPLMT" VALUE 0x00009090 REC_UWORD_C 0 COMP_0078_S 0 255.99609375 /end CHARACTERISTIC
/begin CHARACTERISTIC mDERATSFT "ROM Const mDERATSFT" VALUE 0x00008425 REC_UBYTE_C 0 COMP_0079_S -20 1000 /end CHARACTERISTIC
/begin CHARACTERISTIC mDEVTMP0 "ROM Const mDEVTMP0" VALUE 0x00008426 REC_UBYTE_C 0 COMP_0009_S 0 84.9999915 /end CHARACTERISTIC
/begin CHARACTERISTIC mDEVTMP1 "ROM Const mDEVTMP1" VALUE 0x00008427 REC_UBYTE_C 0 COMP_0009_S 0 84.9999915 /end CHARACTERISTIC
/begin CHARACTERISTIC mDEVTMP2 "ROM Const mDEVTMP2" VALUE 0x00008428 REC_UBYTE_C 0 COMP_0009_S 0 84.9999915 /end CHARACTERISTIC
/begin CHARACTERISTIC mDGINGOV "ROM Const mDGINGOV" VALUE 0x00008429 REC_UBYTE_C 0 COMP_0014_S 0 255 /end CHARACTERISTIC
/begin CHARACTERISTIC mDGNACRING "ROM Const mDGNACRING" VALUE 0x000157E8 REC_UWORD_C 0 COMP_0091 0 65535 /end CHARACTERISTIC
/begin CHARACTERISTIC mDGNADNG "ROM Const mDGNADNG" VALUE 0x000157EA REC_UWORD_C 0 COMP_0091 0 65535 /end CHARACTERISTIC
/begin CHARACTERISTIC mDGNAFHF1H "ROM Const mDGNAFHF1H" VALUE 0x000157EC REC_UWORD_C 0 COMP_0091 0 65535 /end CHARACTERISTIC
/begin CHARACTERISTIC mDGNAFHF1L "ROM Const mDGNAFHF1L" VALUE 0x000157EE REC_UWORD_C 0 COMP_0091 0 65535 /end CHARACTERISTIC
/begin CHARACTERISTIC mDGNAFLAV "ROM Const mDGNAFLAV" VALUE 0x000157F0 REC_UWORD_C 0 COMP_0091 0 65535 /end CHARACTERISTIC
/begin CHARACTERISTIC mDGNAFLHZL "ROM Const mDGNAFLHZL" VALUE 0x000157F2 REC_UWORD_C 0 COMP_0091 0 65535 /end CHARACTERISTIC
/begin CHARACTERISTIC mDGNAFLHZR "ROM Const mDGNAFLHZR" VALUE 0x000157F4 REC_UWORD_C 0 COMP_0091 0 65535 /end CHARACTERISTIC
/begin CHARACTERISTIC mDGNAFLLS "ROM Const mDGNAFLLS" VALUE 0x000157F6 REC_UWORD_C 0 COMP_0091 0 65535 /end CHARACTERISTIC
/begin CHARACTERISTIC mDGNAFLNG1 "ROM Const mDGNAFLNG1" VALUE 0x000157F8 REC_UWORD_C 0 COMP_0091 0 65535 /end CHARACTERISTIC
/begin CHARACTERISTIC mDGNAFLNG2 "ROM Const mDGNAFLNG2" VALUE 0x000157FA REC_UWORD_C 0 COMP_0091 0 65535 /end CHARACTERISTIC
/begin CHARACTERISTIC mDGNAFLRD1 "ROM Const mDGNAFLRD1" VALUE 0x000157FC REC_UWORD_C 0 COMP_0080_S 0 65535 /end CHARACTERISTIC
/begin CHARACTERISTIC mDGNAFLRS "ROM Const mDGNAFLRS" VALUE 0x000157FE REC_UWORD_C 0 COMP_0091 0 65535 /end CHARACTERISTIC
/begin CHARACTERISTIC mDGNAFMFS1 "ROM Const mDGNAFMFS1" VALUE 0x00015800 REC_UWORD_C 0 COMP_0091 0 65535 /end CHARACTERISTIC
/begin CHARACTERISTIC mDGNAFMNGH "ROM Const mDGNAFMNGH" VALUE 0x00015802 REC_UWORD_C 0 COMP_0091 0 65535 /end CHARACTERISTIC
/begin CHARACTERISTIC mDGNAFMNGL "ROM Const mDGNAFMNGL" VALUE 0x00015804 REC_UWORD_C 0 COMP_0091 0 65535 /end CHARACTERISTIC
/begin CHARACTERISTIC mDGNAFMRM1 "ROM Const mDGNAFMRM1" VALUE 0x00015806 REC_UWORD_C 0 COMP_0091 0 65535 /end CHARACTERISTIC
/begin CHARACTERISTIC mDGNAFRLD1 "ROM Const mDGNAFRLD1" VALUE 0x00015808 REC_UWORD_C 0 COMP_0080_S 0 65535 /end CHARACTERISTIC
/begin CHARACTERISTIC mDGNAFSNG1 "ROM Const mDGNAFSNG1" VALUE 0x0001580A REC_UWORD_C 0 COMP_0091 0 65535 /end CHARACTERISTIC
/begin CHARACTERISTIC mDGNALUNG "ROM Const mDGNALUNG" VALUE 0x0001580C REC_UWORD_C 0 COMP_0091 0 65535 /end CHARACTERISTIC
/begin CHARACTERISTIC mDGNAP12NG "ROM Const mDGNAP12NG" VALUE 0x0001580E REC_UWORD_C 0 COMP_0091 0 65535 /end CHARACTERISTIC
/begin CHARACTERISTIC mDGNAP1NGH "ROM Const mDGNAP1NGH" VALUE 0x00015810 REC_UWORD_C 0 COMP_0091 0 65535 /end CHARACTERISTIC
/begin CHARACTERISTIC mDGNAP1NGL "ROM Const mDGNAP1NGL" VALUE 0x00015812 REC_UWORD_C 0 COMP_0091 0 65535 /end CHARACTERISTIC
/begin CHARACTERISTIC mDGNAP2NGH "ROM Const mDGNAP2NGH" VALUE 0x00015814 REC_UWORD_C 0 COMP_0091 0 65535 /end CHARACTERISTIC
/begin CHARACTERISTIC mDGNAP2NGL "ROM Const mDGNAP2NGL" VALUE 0x00015816 REC_UWORD_C 0 COMP_0091 0 65535 /end CHARACTERISTIC
/begin CHARACTERISTIC mDGNAPOXNG "ROM Const mDGNAPOXNG" VALUE 0x00015818 REC_UWORD_C 0 COMP_0091 0 65535 /end CHARACTERISTIC
/begin CHARACTERISTIC mDGNASBSNG "ROM Const mDGNASBSNG" VALUE 0x0001581A REC_UWORD_C 0 COMP_0091 0 65535 /end CHARACTERISTIC
/begin CHARACTERISTIC mDGNASFXNG "ROM Const mDGNASFXNG" VALUE 0x0001581C REC_UWORD_C 0 COMP_0091 0 65535 /end CHARACTERISTIC
/begin CHARACTERISTIC mDGNASJBNG "ROM Const mDGNASJBNG" VALUE 0x0001581E REC_UWORD_C 0 COMP_0091 0 65535 /end CHARACTERISTIC
/begin CHARACTERISTIC mDGNASSWNG "ROM Const mDGNASSWNG" VALUE 0x00015820 REC_UWORD_C 0 COMP_0091 0 65535 /end CHARACTERISTIC
/begin CHARACTERISTIC mDGNASTRNG "ROM Const mDGNASTRNG" VALUE 0x00015822 REC_UWORD_C 0 COMP_0091 0 65535 /end CHARACTERISTIC
/begin CHARACTERISTIC mDGNASVSNG "ROM Const mDGNASVSNG" VALUE 0x00015824 REC_UWORD_C 0 COMP_0091 0 65535 /end CHARACTERISTIC
/begin CHARACTERISTIC mDGNATRING "ROM Const mDGNATRING" VALUE 0x00015826 REC_UWORD_C 0 COMP_0091 0 65535 /end CHARACTERISTIC
/begin CHARACTERISTIC mDGNATTHNG "ROM Const mDGNATTHNG" VALUE 0x00015828 REC_UWORD_C 0 COMP_0091 0 65535 /end CHARACTERISTIC
/begin CHARACTERISTIC mDGNAVCCNG "ROM Const mDGNAVCCNG" VALUE 0x0001582A REC_UWORD_C 0 COMP_0091 0 65535 /end CHARACTERISTIC
/begin CHARACTERISTIC mDGNAVCCSH "ROM Const mDGNAVCCSH" VALUE 0x0001582C REC_UWORD_C 0 COMP_0091 0 65535 /end CHARACTERISTIC
/begin CHARACTERISTIC mDGNBCGNG1 "ROM Const mDGNBCGNG1" VALUE 0x0001582E REC_UWORD_C 0 COMP_0091 0 65535 /end CHARACTERISTIC
/begin CHARACTERISTIC mDGNBCONG1 "ROM Const mDGNBCONG1" VALUE 0x00015830 REC_UWORD_C 0 COMP_0091 0 65535 /end CHARACTERISTIC
/begin CHARACTERISTIC mDGNBCRING "ROM Const mDGNBCRING" VALUE 0x00015832 REC_UWORD_C 0 COMP_0091 0 65535 /end CHARACTERISTIC
/begin CHARACTERISTIC mDGNBCSNG1 "ROM Const mDGNBCSNG1" VALUE 0x00015834 REC_UWORD_C 0 COMP_0091 0 65535 /end CHARACTERISTIC
/begin CHARACTERISTIC mDGNBCSNG2 "ROM Const mDGNBCSNG2" VALUE 0x00015836 REC_UWORD_C 0 COMP_0091 0 65535 /end CHARACTERISTIC
/begin CHARACTERISTIC mDGNBCSNGC "ROM Const mDGNBCSNGC" VALUE 0x00015838 REC_UWORD_C 0 COMP_0091 0 65535 /end CHARACTERISTIC
/begin CHARACTERISTIC mDGNBCSNGH "ROM Const mDGNBCSNGH" VALUE 0x0001583A REC_UWORD_C 0 COMP_0091 0 65535 /end CHARACTERISTIC
/begin CHARACTERISTIC mDGNBCSNGL "ROM Const mDGNBCSNGL" VALUE 0x0001583C REC_UWORD_C 0 COMP_0091 0 65535 /end CHARACTERISTIC
/begin CHARACTERISTIC mDGNBNCPNG "ROM Const mDGNBNCPNG" VALUE 0x0001583E REC_UWORD_C 0 COMP_0091 0 65535 /end CHARACTERISTIC
/begin CHARACTERISTIC mDGNBSOFNG "ROM Const mDGNBSOFNG" VALUE 0x00015840 REC_UWORD_C 0 COMP_0091 0 65535 /end CHARACTERISTIC
/begin CHARACTERISTIC mDGNBTSNGH "ROM Const mDGNBTSNGH" VALUE 0x00015842 REC_UWORD_C 0 COMP_0091 0 65535 /end CHARACTERISTIC
/begin CHARACTERISTIC mDGNBTSNGL "ROM Const mDGNBTSNGL" VALUE 0x00015844 REC_UWORD_C 0 COMP_0091 0 65535 /end CHARACTERISTIC
/begin CHARACTERISTIC mDGNBURNG "ROM Const mDGNBURNG" VALUE 0x00015846 REC_UWORD_C 0 COMP_0091 0 65535 /end CHARACTERISTIC
/begin CHARACTERISTIC mDGNCALCNG "ROM Const mDGNCALCNG" VALUE 0x00015848 REC_UWORD_C 0 COMP_0091 0 65535 /end CHARACTERISTIC
/begin CHARACTERISTIC mDGNCANFNG "ROM Const mDGNCANFNG" VALUE 0x0001584A REC_UWORD_C 0 COMP_0091 0 65535 /end CHARACTERISTIC
/begin CHARACTERISTIC mDGNCANGNE "ROM Const mDGNCANGNE" VALUE 0x0001584C REC_UWORD_C 0 COMP_0091 0 65535 /end CHARACTERISTIC
/begin CHARACTERISTIC mDGNCANNG "ROM Const mDGNCANNG" VALUE 0x0001584E REC_UWORD_C 0 COMP_0091 0 65535 /end CHARACTERISTIC
/begin CHARACTERISTIC mDGNCAT1NG "ROM Const mDGNCAT1NG" VALUE 0x00015850 REC_UWORD_C 0 COMP_0091 0 65535 /end CHARACTERISTIC
/begin CHARACTERISTIC mDGNCDCNG2 "ROM Const mDGNCDCNG2" VALUE 0x00015852 REC_UWORD_C 0 COMP_0091 0 65535 /end CHARACTERISTIC
/begin CHARACTERISTIC mDGNCDCNG3 "ROM Const mDGNCDCNG3" VALUE 0x00015854 REC_UWORD_C 0 COMP_0091 0 65535 /end CHARACTERISTIC
/begin CHARACTERISTIC mDGNCDCNGC "ROM Const mDGNCDCNGC" VALUE 0x00015856 REC_UWORD_C 0 COMP_0091 0 65535 /end CHARACTERISTIC
/begin CHARACTERISTIC mDGNCLUDNG "ROM Const mDGNCLUDNG" VALUE 0x00015858 REC_UWORD_C 0 COMP_0091 0 65535 /end CHARACTERISTIC
/begin CHARACTERISTIC mDGNCLUFNG "ROM Const mDGNCLUFNG" VALUE 0x0001585A REC_UWORD_C 0 COMP_0091 0 65535 /end CHARACTERISTIC
/begin CHARACTERISTIC mDGNCOMNG "ROM Const mDGNCOMNG" VALUE 0x0001585C REC_UWORD_C 0 COMP_0091 0 65535 /end CHARACTERISTIC
/begin CHARACTERISTIC mDGNCPLDNG "ROM Const mDGNCPLDNG" VALUE 0x0001585E REC_UWORD_C 0 COMP_0091 0 65535 /end CHARACTERISTIC
/begin CHARACTERISTIC mDGNCPLFNG "ROM Const mDGNCPLFNG" VALUE 0x00015860 REC_UWORD_C 0 COMP_0091 0 65535 /end CHARACTERISTIC
/begin CHARACTERISTIC mDGNCSSADV "ROM Const mDGNCSSADV" VALUE 0x00015862 REC_UWORD_C 0 COMP_0091 0 65535 /end CHARACTERISTIC
/begin CHARACTERISTIC mDGNCSSDIG "ROM Const mDGNCSSDIG" VALUE 0x00015864 REC_UWORD_C 0 COMP_0091 0 65535 /end CHARACTERISTIC
/begin CHARACTERISTIC mDGNCSSIT "ROM Const mDGNCSSIT" VALUE 0x00015866 REC_UWORD_C 0 COMP_0091 0 65535 /end CHARACTERISTIC
/begin CHARACTERISTIC mDGNCSSKRT "ROM Const mDGNCSSKRT" VALUE 0x00015868 REC_UWORD_C 0 COMP_0091 0 65535 /end CHARACTERISTIC
/begin CHARACTERISTIC mDGNCSSRPM "ROM Const mDGNCSSRPM" VALUE 0x0001586A REC_UWORD_C 0 COMP_0091 0 65535 /end CHARACTERISTIC
/begin CHARACTERISTIC mDGNCSSTNG "ROM Const mDGNCSSTNG" VALUE 0x0001586C REC_UWORD_C 0 COMP_0091 0 65535 /end CHARACTERISTIC
/begin CHARACTERISTIC mDGNCUTLN "ROM Const mDGNCUTLN" VALUE 0x0001586E REC_UWORD_C 0 COMP_0091 0 65535 /end CHARACTERISTIC
/begin CHARACTERISTIC mDGNCVCUNG "ROM Const mDGNCVCUNG" VALUE 0x00015870 REC_UWORD_C 0 COMP_0091 0 65535 /end CHARACTERISTIC
/begin CHARACTERISTIC mDGNDCMTDG "ROM Const mDGNDCMTDG" VALUE 0x00015872 REC_UWORD_C 0 COMP_0091 0 65535 /end CHARACTERISTIC
/begin CHARACTERISTIC mDGNDCS1NG "ROM Const mDGNDCS1NG" VALUE 0x00015874 REC_UWORD_C 0 COMP_0091 0 65535 /end CHARACTERISTIC
/begin CHARACTERISTIC mDGNDCS2NG "ROM Const mDGNDCS2NG" VALUE 0x00015876 REC_UWORD_C 0 COMP_0091 0 65535 /end CHARACTERISTIC
/begin CHARACTERISTIC mDGNDCS3NG "ROM Const mDGNDCS3NG" VALUE 0x00015878 REC_UWORD_C 0 COMP_0091 0 65535 /end CHARACTERISTIC
/begin CHARACTERISTIC mDGNDFLTNG "ROM Const mDGNDFLTNG" VALUE 0x0001587A REC_UWORD_C 0 COMP_0091 0 65535 /end CHARACTERISTIC
/begin CHARACTERISTIC mDGNDPS1NG "ROM Const mDGNDPS1NG" VALUE 0x0001587C REC_UWORD_C 0 COMP_0091 0 65535 /end CHARACTERISTIC
/begin CHARACTERISTIC mDGNDPS2NG "ROM Const mDGNDPS2NG" VALUE 0x0001587E REC_UWORD_C 0 COMP_0091 0 65535 /end CHARACTERISTIC
/begin CHARACTERISTIC mDGNDPS3NG "ROM Const mDGNDPS3NG" VALUE 0x00015880 REC_UWORD_C 0 COMP_0091 0 65535 /end CHARACTERISTIC
/begin CHARACTERISTIC mDGNDTSPNG "ROM Const mDGNDTSPNG" VALUE 0x00015882 REC_UWORD_C 0 COMP_0091 0 65535 /end CHARACTERISTIC
/begin CHARACTERISTIC mDGNDUCMB "ROM Const mDGNDUCMB" VALUE 0x00015884 REC_UWORD_C 0 COMP_0091 0 65535 /end CHARACTERISTIC
/begin CHARACTERISTIC mDGNDUFLB "ROM Const mDGNDUFLB" VALUE 0x00015886 REC_UWORD_C 0 COMP_0091 0 65535 /end CHARACTERISTIC
/begin CHARACTERISTIC mDGNECMTMH "ROM Const mDGNECMTMH" VALUE 0x00015888 REC_UWORD_C 0 COMP_0068 0 65535 /end CHARACTERISTIC
/begin CHARACTERISTIC mDGNENINNG "ROM Const mDGNENINNG" VALUE 0x0001588A REC_UWORD_C 0 COMP_0091 0 65535 /end CHARACTERISTIC
/begin CHARACTERISTIC mDGNEONVNG "ROM Const mDGNEONVNG" VALUE 0x0001588C REC_UWORD_C 0 COMP_0091 0 65535 /end CHARACTERISTIC
/begin CHARACTERISTIC mDGNEPBPCR "ROM Const mDGNEPBPCR" VALUE 0x0001588E REC_UWORD_C 0 COMP_0091 0 65535 /end CHARACTERISTIC
/begin CHARACTERISTIC mDGNEPRNGM "ROM Const mDGNEPRNGM" VALUE 0x00015890 REC_UWORD_C 0 COMP_0091 0 65535 /end CHARACTERISTIC
/begin CHARACTERISTIC mDGNEPSNGH "ROM Const mDGNEPSNGH" VALUE 0x00015892 REC_UWORD_C 0 COMP_0091 0 65535 /end CHARACTERISTIC
/begin CHARACTERISTIC mDGNEPSNGL "ROM Const mDGNEPSNGL" VALUE 0x00015894 REC_UWORD_C 0 COMP_0091 0 65535 /end CHARACTERISTIC
/begin CHARACTERISTIC mDGNEPWNGM "ROM Const mDGNEPWNGM" VALUE 0x00015896 REC_UWORD_C 0 COMP_0091 0 65535 /end CHARACTERISTIC
/begin CHARACTERISTIC mDGNEVCN2 "ROM Const mDGNEVCN2" VALUE 0x00015898 REC_UWORD_C 0 COMP_0091 0 65535 /end CHARACTERISTIC
/begin CHARACTERISTIC mDGNEVCN3 "ROM Const mDGNEVCN3" VALUE 0x0001589A REC_UWORD_C 0 COMP_0091 0 65535 /end CHARACTERISTIC
/begin CHARACTERISTIC mDGNEVCNGO "ROM Const mDGNEVCNGO" VALUE 0x0001589C REC_UWORD_C 0 COMP_0091 0 65535 /end CHARACTERISTIC
/begin CHARACTERISTIC mDGNEVCNGS "ROM Const mDGNEVCNGS" VALUE 0x0001589E REC_UWORD_C 0 COMP_0091 0 65535 /end CHARACTERISTIC
/begin CHARACTERISTIC mDGNEVPFLW "ROM Const mDGNEVPFLW" VALUE 0x000158A0 REC_UWORD_C 0 COMP_0091 0 65535 /end CHARACTERISTIC
/begin CHARACTERISTIC mDGNEVPSL "ROM Const mDGNEVPSL" VALUE 0x000158A2 REC_UWORD_C 0 COMP_0091 0 65535 /end CHARACTERISTIC
/begin CHARACTERISTIC mDGNEVPSLP "ROM Const mDGNEVPSLP" VALUE 0x000158A4 REC_UWORD_C 0 COMP_0091 0 65535 /end CHARACTERISTIC
/begin CHARACTERISTIC mDGNEVPVSL "ROM Const mDGNEVPVSL" VALUE 0x000158A6 REC_UWORD_C 0 COMP_0091 0 65535 /end CHARACTERISTIC
/begin CHARACTERISTIC mDGNEVSNGE "ROM Const mDGNEVSNGE" VALUE 0x000158A8 REC_UWORD_C 0 COMP_0091 0 65535 /end CHARACTERISTIC
/begin CHARACTERISTIC mDGNEVSNGR "ROM Const mDGNEVSNGR" VALUE 0x000158AA REC_UWORD_C 0 COMP_0091 0 65535 /end CHARACTERISTIC
/begin CHARACTERISTIC mDGNEVVSLP "ROM Const mDGNEVVSLP" VALUE 0x000158AC REC_UWORD_C 0 COMP_0091 0 65535 /end CHARACTERISTIC
/begin CHARACTERISTIC mDGNFABRS "ROM Const mDGNFABRS" VALUE 0x000158AE REC_UWORD_C 0 COMP_0091 0 65535 /end CHARACTERISTIC
/begin CHARACTERISTIC mDGNFGPNG2 "ROM Const mDGNFGPNG2" VALUE 0x000158B0 REC_UWORD_C 0 COMP_0091 0 65535 /end CHARACTERISTIC
/begin CHARACTERISTIC mDGNFGPNG3 "ROM Const mDGNFGPNG3" VALUE 0x000158B2 REC_UWORD_C 0 COMP_0091 0 65535 /end CHARACTERISTIC
/begin CHARACTERISTIC mDGNFGPNGH "ROM Const mDGNFGPNGH" VALUE 0x000158B4 REC_UWORD_C 0 COMP_0091 0 65535 /end CHARACTERISTIC
/begin CHARACTERISTIC mDGNFGPNGL "ROM Const mDGNFGPNGL" VALUE 0x000158B6 REC_UWORD_C 0 COMP_0091 0 65535 /end CHARACTERISTIC
/begin CHARACTERISTIC mDGNFLRNG "ROM Const mDGNFLRNG" VALUE 0x000158B8 REC_UWORD_C 0 COMP_0091 0 65535 /end CHARACTERISTIC
/begin CHARACTERISTIC mDGNFPCMNG "ROM Const mDGNFPCMNG" VALUE 0x000158BA REC_UWORD_C 0 COMP_0091 0 65535 /end CHARACTERISTIC
/begin CHARACTERISTIC mDGNFPHNG "ROM Const mDGNFPHNG" VALUE 0x000158BC REC_UWORD_C 0 COMP_0091 0 65535 /end CHARACTERISTIC
/begin CHARACTERISTIC mDGNFPLNG "ROM Const mDGNFPLNG" VALUE 0x000158BE REC_UWORD_C 0 COMP_0091 0 65535 /end CHARACTERISTIC
/begin CHARACTERISTIC mDGNFPSNG "ROM Const mDGNFPSNG" VALUE 0x000158C0 REC_UWORD_C 0 COMP_0091 0 65535 /end CHARACTERISTIC
/begin CHARACTERISTIC mDGNGCALNG "ROM Const mDGNGCALNG" VALUE 0x000158C2 REC_UWORD_C 0 COMP_0091 0 65535 /end CHARACTERISTIC
/begin CHARACTERISTIC mDGNGMOOPN "ROM Const mDGNGMOOPN" VALUE 0x000158C4 REC_UWORD_C 0 COMP_0091 0 65535 /end CHARACTERISTIC
/begin CHARACTERISTIC mDGNGRVNGH "ROM Const mDGNGRVNGH" VALUE 0x000158C6 REC_UWORD_C 0 COMP_0091 0 65535 /end CHARACTERISTIC
/begin CHARACTERISTIC mDGNGRVNGL "ROM Const mDGNGRVNGL" VALUE 0x000158C8 REC_UWORD_C 0 COMP_0091 0 65535 /end CHARACTERISTIC
/begin CHARACTERISTIC mDGNGRVOOR "ROM Const mDGNGRVOOR" VALUE 0x000158CA REC_UWORD_C 0 COMP_0091 0 65535 /end CHARACTERISTIC
/begin CHARACTERISTIC mDGNGRVRAT "ROM Const mDGNGRVRAT" VALUE 0x000158CC REC_UWORD_C 0 COMP_0091 0 65535 /end CHARACTERISTIC
/begin CHARACTERISTIC mDGNIC3NG "ROM Const mDGNIC3NG" VALUE 0x000158CE REC_UWORD_C 0 COMP_0091 0 65535 /end CHARACTERISTIC
/begin CHARACTERISTIC mDGNIMLCK "ROM Const mDGNIMLCK" VALUE 0x000158D0 REC_UWORD_C 0 COMP_0091 0 65535 /end CHARACTERISTIC
/begin CHARACTERISTIC mDGNINHBON "ROM Const mDGNINHBON" VALUE 0x000158D2 REC_UWORD_C 0 COMP_0091 0 65535 /end CHARACTERISTIC
/begin CHARACTERISTIC mDGNINHSW "ROM Const mDGNINHSW" VALUE 0x000158D4 REC_UWORD_C 0 COMP_0091 0 65535 /end CHARACTERISTIC
/begin CHARACTERISTIC mDGNINONG1 "ROM Const mDGNINONG1" VALUE 0x000158D6 REC_UWORD_C 0 COMP_0091 0 65535 /end CHARACTERISTIC
/begin CHARACTERISTIC mDGNINONG2 "ROM Const mDGNINONG2" VALUE 0x000158D8 REC_UWORD_C 0 COMP_0091 0 65535 /end CHARACTERISTIC
/begin CHARACTERISTIC mDGNINONG3 "ROM Const mDGNINONG3" VALUE 0x000158DA REC_UWORD_C 0 COMP_0091 0 65535 /end CHARACTERISTIC
/begin CHARACTERISTIC mDGNINONG4 "ROM Const mDGNINONG4" VALUE 0x000158DC REC_UWORD_C 0 COMP_0091 0 65535 /end CHARACTERISTIC
/begin CHARACTERISTIC mDGNIREVNG "ROM Const mDGNIREVNG" VALUE 0x000158DE REC_UWORD_C 0 COMP_0091 0 65535 /end CHARACTERISTIC
/begin CHARACTERISTIC mDGNISCNGH "ROM Const mDGNISCNGH" VALUE 0x000158E0 REC_UWORD_C 0 COMP_0091 0 65535 /end CHARACTERISTIC
/begin CHARACTERISTIC mDGNISCNGL "ROM Const mDGNISCNGL" VALUE 0x000158E2 REC_UWORD_C 0 COMP_0091 0 65535 /end CHARACTERISTIC
/begin CHARACTERISTIC mDGNKEYER "ROM Const mDGNKEYER" VALUE 0x000158E4 REC_UWORD_C 0 COMP_0091 0 65535 /end CHARACTERISTIC
/begin CHARACTERISTIC mDGNKEYNG "ROM Const mDGNKEYNG" VALUE 0x000158E6 REC_UWORD_C 0 COMP_0091 0 65535 /end CHARACTERISTIC
/begin CHARACTERISTIC mDGNKHTDGN "ROM Const mDGNKHTDGN" VALUE 0x000158E8 REC_UWORD_C 0 COMP_0091 0 65535 /end CHARACTERISTIC
/begin CHARACTERISTIC mDGNKN1NGH "ROM Const mDGNKN1NGH" VALUE 0x000158EA REC_UWORD_C 0 COMP_0091 0 65535 /end CHARACTERISTIC
/begin CHARACTERISTIC mDGNKN1NGL "ROM Const mDGNKN1NGL" VALUE 0x000158EC REC_UWORD_C 0 COMP_0091 0 65535 /end CHARACTERISTIC
/begin CHARACTERISTIC mDGNLCMNG "ROM Const mDGNLCMNG" VALUE 0x000158EE REC_UWORD_C 0 COMP_0091 0 65535 /end CHARACTERISTIC
/begin CHARACTERISTIC mDGNLSSDNG "ROM Const mDGNLSSDNG" VALUE 0x000158F0 REC_UWORD_C 0 COMP_0091 0 65535 /end CHARACTERISTIC
/begin CHARACTERISTIC mDGNLUFNG "ROM Const mDGNLUFNG" VALUE 0x000158F2 REC_UWORD_C 0 COMP_0091 0 65535 /end CHARACTERISTIC
/begin CHARACTERISTIC mDGNLUSNG "ROM Const mDGNLUSNG" VALUE 0x000158F4 REC_UWORD_C 0 COMP_0091 0 65535 /end CHARACTERISTIC
/begin CHARACTERISTIC mDGNMCTANG "ROM Const mDGNMCTANG" VALUE 0x000158F6 REC_UWORD_C 0 COMP_0091 0 65535 /end CHARACTERISTIC
/begin CHARACTERISTIC mDGNMCTFNG "ROM Const mDGNMCTFNG" VALUE 0x000158F8 REC_UWORD_C 0 COMP_0091 0 65535 /end CHARACTERISTIC
/begin CHARACTERISTIC mDGNMCTHNG "ROM Const mDGNMCTHNG" VALUE 0x000158FA REC_UWORD_C 0 COMP_0091 0 65535 /end CHARACTERISTIC
/begin CHARACTERISTIC mDGNMCTONG "ROM Const mDGNMCTONG" VALUE 0x000158FC REC_UWORD_C 0 COMP_0091 0 65535 /end CHARACTERISTIC
/begin CHARACTERISTIC mDGNMCTWNG "ROM Const mDGNMCTWNG" VALUE 0x000158FE REC_UWORD_C 0 COMP_0091 0 65535 /end CHARACTERISTIC
/begin CHARACTERISTIC mDGNMF1NG "ROM Const mDGNMF1NG" VALUE 0x00015900 REC_UWORD_C 0 COMP_0091 0 65535 /end CHARACTERISTIC
/begin CHARACTERISTIC mDGNMF2NG "ROM Const mDGNMF2NG" VALUE 0x00015902 REC_UWORD_C 0 COMP_0091 0 65535 /end CHARACTERISTIC
/begin CHARACTERISTIC mDGNMF3NG "ROM Const mDGNMF3NG" VALUE 0x00015904 REC_UWORD_C 0 COMP_0091 0 65535 /end CHARACTERISTIC
/begin CHARACTERISTIC mDGNMF4NG "ROM Const mDGNMF4NG" VALUE 0x00015906 REC_UWORD_C 0 COMP_0091 0 65535 /end CHARACTERISTIC
/begin CHARACTERISTIC mDGNMFMCNG "ROM Const mDGNMFMCNG" VALUE 0x00015908 REC_UWORD_C 0 COMP_0091 0 65535 /end CHARACTERISTIC
/begin CHARACTERISTIC mDGNMOTOPN "ROM Const mDGNMOTOPN" VALUE 0x0001590A REC_UWORD_C 0 COMP_0091 0 65535 /end CHARACTERISTIC
/begin CHARACTERISTIC mDGNMOTSHT "ROM Const mDGNMOTSHT" VALUE 0x0001590C REC_UWORD_C 0 COMP_0091 0 65535 /end CHARACTERISTIC
/begin CHARACTERISTIC mDGNMRNG "ROM Const mDGNMRNG" VALUE 0x0001590E REC_UWORD_C 0 COMP_0091 0 65535 /end CHARACTERISTIC
/begin CHARACTERISTIC mDGNMRNL "ROM Const mDGNMRNL" VALUE 0x00015910 REC_UWORD_C 0 COMP_0091 0 65535 /end CHARACTERISTIC
/begin CHARACTERISTIC mDGNMRNR "ROM Const mDGNMRNR" VALUE 0x00015912 REC_UWORD_C 0 COMP_0091 0 65535 /end CHARACTERISTIC
/begin CHARACTERISTIC mDGNNSNG "ROM Const mDGNNSNG" VALUE 0x00015914 REC_UWORD_C 0 COMP_0091 0 65535 /end CHARACTERISTIC
/begin CHARACTERISTIC mDGNO2CLB1 "ROM Const mDGNO2CLB1" VALUE 0x00015916 REC_UWORD_C 0 COMP_0091 0 65535 /end CHARACTERISTIC
/begin CHARACTERISTIC mDGNO2R1H "ROM Const mDGNO2R1H" VALUE 0x00015918 REC_UWORD_C 0 COMP_0091 0 65535 /end CHARACTERISTIC
/begin CHARACTERISTIC mDGNO2R1L "ROM Const mDGNO2R1L" VALUE 0x0001591A REC_UWORD_C 0 COMP_0091 0 65535 /end CHARACTERISTIC
/begin CHARACTERISTIC mDGNO2R1O "ROM Const mDGNO2R1O" VALUE 0x0001591C REC_UWORD_C 0 COMP_0091 0 65535 /end CHARACTERISTIC
/begin CHARACTERISTIC mDGNO2R1R "ROM Const mDGNO2R1R" VALUE 0x0001591E REC_UWORD_C 0 COMP_0091 0 65535 /end CHARACTERISTIC
/begin CHARACTERISTIC mDGNOPSNG "ROM Const mDGNOPSNG" VALUE 0x00015920 REC_UWORD_C 0 COMP_0091 0 65535 /end CHARACTERISTIC
/begin CHARACTERISTIC mDGNOPSNNG "ROM Const mDGNOPSNNG" VALUE 0x00015922 REC_UWORD_C 0 COMP_0091 0 65535 /end CHARACTERISTIC
/begin CHARACTERISTIC mDGNOUTSNG "ROM Const mDGNOUTSNG" VALUE 0x00015924 REC_UWORD_C 0 COMP_0091 0 65535 /end CHARACTERISTIC
/begin CHARACTERISTIC mDGNOVBST1 "ROM Const mDGNOVBST1" VALUE 0x00015926 REC_UWORD_C 0 COMP_0091 0 65535 /end CHARACTERISTIC
/begin CHARACTERISTIC mDGNOVHEAT "ROM Const mDGNOVHEAT" VALUE 0x00015928 REC_UWORD_C 0 COMP_0091 0 65535 /end CHARACTERISTIC
/begin CHARACTERISTIC mDGNOVRSNG "ROM Const mDGNOVRSNG" VALUE 0x0001592A REC_UWORD_C 0 COMP_0091 0 65535 /end CHARACTERISTIC
/begin CHARACTERISTIC mDGNPLGSNG "ROM Const mDGNPLGSNG" VALUE 0x0001592C REC_UWORD_C 0 COMP_0091 0 65535 /end CHARACTERISTIC
/begin CHARACTERISTIC mDGNPLSNG "ROM Const mDGNPLSNG" VALUE 0x0001592E REC_UWORD_C 0 COMP_0091 0 65535 /end CHARACTERISTIC
/begin CHARACTERISTIC mDGNPREGNG "ROM Const mDGNPREGNG" VALUE 0x00015930 REC_UWORD_C 0 COMP_0091 0 65535 /end CHARACTERISTIC
/begin CHARACTERISTIC mDGNPRGSNG "ROM Const mDGNPRGSNG" VALUE 0x00015932 REC_UWORD_C 0 COMP_0091 0 65535 /end CHARACTERISTIC
/begin CHARACTERISTIC mDGNPRINNG "ROM Const mDGNPRINNG" VALUE 0x00015934 REC_UWORD_C 0 COMP_0091 0 65535 /end CHARACTERISTIC
/begin CHARACTERISTIC mDGNPRIPNG "ROM Const mDGNPRIPNG" VALUE 0x00015936 REC_UWORD_C 0 COMP_0091 0 65535 /end CHARACTERISTIC
/begin CHARACTERISTIC mDGNPRSNGH "ROM Const mDGNPRSNGH" VALUE 0x00015938 REC_UWORD_C 0 COMP_0091 0 65535 /end CHARACTERISTIC
/begin CHARACTERISTIC mDGNPRSNGL "ROM Const mDGNPRSNGL" VALUE 0x0001593A REC_UWORD_C 0 COMP_0091 0 65535 /end CHARACTERISTIC
/begin CHARACTERISTIC mDGNPRSNGR "ROM Const mDGNPRSNGR" VALUE 0x0001593C REC_UWORD_C 0 COMP_0091 0 65535 /end CHARACTERISTIC
/begin CHARACTERISTIC mDGNPSFNG "ROM Const mDGNPSFNG" VALUE 0x0001593E REC_UWORD_C 0 COMP_0091 0 65535 /end CHARACTERISTIC
/begin CHARACTERISTIC mDGNPSHNG "ROM Const mDGNPSHNG" VALUE 0x00015940 REC_UWORD_C 0 COMP_0091 0 65535 /end CHARACTERISTIC
/begin CHARACTERISTIC mDGNPSLNG "ROM Const mDGNPSLNG" VALUE 0x00015942 REC_UWORD_C 0 COMP_0091 0 65535 /end CHARACTERISTIC
/begin CHARACTERISTIC mDGNPSRANG "ROM Const mDGNPSRANG" VALUE 0x00015944 REC_UWORD_C 0 COMP_0091 0 65535 /end CHARACTERISTIC
/begin CHARACTERISTIC mDGNPSTNG1 "ROM Const mDGNPSTNG1" VALUE 0x00015946 REC_UWORD_C 0 COMP_0091 0 65535 /end CHARACTERISTIC
/begin CHARACTERISTIC mDGNPSTNG2 "ROM Const mDGNPSTNG2" VALUE 0x00015948 REC_UWORD_C 0 COMP_0091 0 65535 /end CHARACTERISTIC
/begin CHARACTERISTIC mDGNPSTNG3 "ROM Const mDGNPSTNG3" VALUE 0x0001594A REC_UWORD_C 0 COMP_0091 0 65535 /end CHARACTERISTIC
/begin CHARACTERISTIC mDGNQCKNG "ROM Const mDGNQCKNG" VALUE 0x0001594C REC_UWORD_C 0 COMP_0091 0 65535 /end CHARACTERISTIC
/begin CHARACTERISTIC mDGNQHAPNG "ROM Const mDGNQHAPNG" VALUE 0x0001594E REC_UWORD_C 0 COMP_0091 0 65535 /end CHARACTERISTIC
/begin CHARACTERISTIC mDGNRAMNGM "ROM Const mDGNRAMNGM" VALUE 0x00015950 REC_UWORD_C 0 COMP_0091 0 65535 /end CHARACTERISTIC
/begin CHARACTERISTIC mDGNRANGM2 "ROM Const mDGNRANGM2" VALUE 0x00015952 REC_UWORD_C 0 COMP_0091 0 65535 /end CHARACTERISTIC
/begin CHARACTERISTIC mDGNRLOFNG "ROM Const mDGNRLOFNG" VALUE 0x00015954 REC_UWORD_C 0 COMP_0091 0 65535 /end CHARACTERISTIC
/begin CHARACTERISTIC mDGNRLONNG "ROM Const mDGNRLONNG" VALUE 0x00015956 REC_UWORD_C 0 COMP_0091 0 65535 /end CHARACTERISTIC
/begin CHARACTERISTIC mDGNRO2HH1 "ROM Const mDGNRO2HH1" VALUE 0x00015958 REC_UWORD_C 0 COMP_0091 0 65535 /end CHARACTERISTIC
/begin CHARACTERISTIC mDGNRO2HL1 "ROM Const mDGNRO2HL1" VALUE 0x0001595A REC_UWORD_C 0 COMP_0091 0 65535 /end CHARACTERISTIC
/begin CHARACTERISTIC mDGNRODRD1 "ROM Const mDGNRODRD1" VALUE 0x0001595C REC_UWORD_C 0 COMP_0091 0 65535 /end CHARACTERISTIC
/begin CHARACTERISTIC mDGNROMNGM "ROM Const mDGNROMNGM" VALUE 0x0001595E REC_UWORD_C 0 COMP_0091 0 65535 /end CHARACTERISTIC
/begin CHARACTERISTIC mDGNRTSPNG "ROM Const mDGNRTSPNG" VALUE 0x00015960 REC_UWORD_C 0 COMP_0091 0 65535 /end CHARACTERISTIC
/begin CHARACTERISTIC mDGNSECPNG "ROM Const mDGNSECPNG" VALUE 0x00015962 REC_UWORD_C 0 COMP_0091 0 65535 /end CHARACTERISTIC
/begin CHARACTERISTIC mDGNSERVNG "ROM Const mDGNSERVNG" VALUE 0x00015964 REC_UWORD_C 0 COMP_0091 0 65535 /end CHARACTERISTIC
/begin CHARACTERISTIC mDGNSHANG "ROM Const mDGNSHANG" VALUE 0x00015966 REC_UWORD_C 0 COMP_0091 0 65535 /end CHARACTERISTIC
/begin CHARACTERISTIC mDGNSHBNG "ROM Const mDGNSHBNG" VALUE 0x00015968 REC_UWORD_C 0 COMP_0091 0 65535 /end CHARACTERISTIC
/begin CHARACTERISTIC mDGNSOTMP "ROM Const mDGNSOTMP" VALUE 0x0001596A REC_UWORD_C 0 COMP_0091 0 65535 /end CHARACTERISTIC
/begin CHARACTERISTIC mDGNSP1NG "ROM Const mDGNSP1NG" VALUE 0x0001596C REC_UWORD_C 0 COMP_0091 0 65535 /end CHARACTERISTIC
/begin CHARACTERISTIC mDGNSP2NG "ROM Const mDGNSP2NG" VALUE 0x0001596E REC_UWORD_C 0 COMP_0091 0 65535 /end CHARACTERISTIC
/begin CHARACTERISTIC mDGNSP3NG "ROM Const mDGNSP3NG" VALUE 0x00015970 REC_UWORD_C 0 COMP_0091 0 65535 /end CHARACTERISTIC
/begin CHARACTERISTIC mDGNSP4NG "ROM Const mDGNSP4NG" VALUE 0x00015972 REC_UWORD_C 0 COMP_0091 0 65535 /end CHARACTERISTIC
/begin CHARACTERISTIC mDGNSSDNG "ROM Const mDGNSSDNG" VALUE 0x00015974 REC_UWORD_C 0 COMP_0091 0 65535 /end CHARACTERISTIC
/begin CHARACTERISTIC mDGNSSFNG "ROM Const mDGNSSFNG" VALUE 0x00015976 REC_UWORD_C 0 COMP_0091 0 65535 /end CHARACTERISTIC
/begin CHARACTERISTIC mDGNSSOFNG "ROM Const mDGNSSOFNG" VALUE 0x00015978 REC_UWORD_C 0 COMP_0091 0 65535 /end CHARACTERISTIC
/begin CHARACTERISTIC mDGNSTMDNG "ROM Const mDGNSTMDNG" VALUE 0x0001597A REC_UWORD_C 0 COMP_0091 0 65535 /end CHARACTERISTIC
/begin CHARACTERISTIC mDGNSTMFNG "ROM Const mDGNSTMFNG" VALUE 0x0001597C REC_UWORD_C 0 COMP_0091 0 65535 /end CHARACTERISTIC
/begin CHARACTERISTIC mDGNSTRLOF "ROM Const mDGNSTRLOF" VALUE 0x0001597E REC_UWORD_C 0 COMP_0091 0 65535 /end CHARACTERISTIC
/begin CHARACTERISTIC mDGNSTRLON "ROM Const mDGNSTRLON" VALUE 0x00015980 REC_UWORD_C 0 COMP_0091 0 65535 /end CHARACTERISTIC
/begin CHARACTERISTIC mDGNSTROPN "ROM Const mDGNSTROPN" VALUE 0x00015982 REC_UWORD_C 0 COMP_0091 0 65535 /end CHARACTERISTIC
/begin CHARACTERISTIC mDGNSTST2 "ROM Const mDGNSTST2" VALUE 0x000157D0 REC_UBYTE_C 0 COMP_0081_S 0 99.609375 /end CHARACTERISTIC
/begin CHARACTERISTIC mDGNSTSYS "ROM Const mDGNSTSYS" VALUE 0x00015984 REC_UWORD_C 0 COMP_0091 0 65535 /end CHARACTERISTIC
/begin CHARACTERISTIC mDGNSYNCNG "ROM Const mDGNSYNCNG" VALUE 0x00015986 REC_UWORD_C 0 COMP_0091 0 65535 /end CHARACTERISTIC
/begin CHARACTERISTIC mDGNTANGH "ROM Const mDGNTANGH" VALUE 0x00015988 REC_UWORD_C 0 COMP_0091 0 65535 /end CHARACTERISTIC
/begin CHARACTERISTIC mDGNTANGL "ROM Const mDGNTANGL" VALUE 0x0001598A REC_UWORD_C 0 COMP_0091 0 65535 /end CHARACTERISTIC
/begin CHARACTERISTIC mDGNTANGR "ROM Const mDGNTANGR" VALUE 0x0001598C REC_UWORD_C 0 COMP_0091 0 65535 /end CHARACTERISTIC
/begin CHARACTERISTIC mDGNTANTRH "ROM Const mDGNTANTRH" VALUE 0x0001598E REC_UWORD_C 0 COMP_0091 0 65535 /end CHARACTERISTIC
/begin CHARACTERISTIC mDGNTANTRL "ROM Const mDGNTANTRL" VALUE 0x00015990 REC_UWORD_C 0 COMP_0091 0 65535 /end CHARACTERISTIC
/begin CHARACTERISTIC mDGNTATENG "ROM Const mDGNTATENG" VALUE 0x00015992 REC_UWORD_C 0 COMP_0091 0 65535 /end CHARACTERISTIC
/begin CHARACTERISTIC mDGNTATHH "ROM Const mDGNTATHH" VALUE 0x00015994 REC_UWORD_C 0 COMP_0091 0 65535 /end CHARACTERISTIC
/begin CHARACTERISTIC mDGNTATHL "ROM Const mDGNTATHL" VALUE 0x00015996 REC_UWORD_C 0 COMP_0091 0 65535 /end CHARACTERISTIC
/begin CHARACTERISTIC mDGNTBSNG1 "ROM Const mDGNTBSNG1" VALUE 0x00015998 REC_UWORD_C 0 COMP_0091 0 65535 /end CHARACTERISTIC
/begin CHARACTERISTIC mDGNTCNTNG "ROM Const mDGNTCNTNG" VALUE 0x0001599A REC_UWORD_C 0 COMP_0091 0 65535 /end CHARACTERISTIC
/begin CHARACTERISTIC mDGNTEPDNG "ROM Const mDGNTEPDNG" VALUE 0x0001599C REC_UWORD_C 0 COMP_0091 0 65535 /end CHARACTERISTIC
/begin CHARACTERISTIC mDGNTFNGH "ROM Const mDGNTFNGH" VALUE 0x0001599E REC_UWORD_C 0 COMP_0091 0 65535 /end CHARACTERISTIC
/begin CHARACTERISTIC mDGNTFNGL "ROM Const mDGNTFNGL" VALUE 0x000159A0 REC_UWORD_C 0 COMP_0091 0 65535 /end CHARACTERISTIC
/begin CHARACTERISTIC mDGNTFNGR "ROM Const mDGNTFNGR" VALUE 0x000159A2 REC_UWORD_C 0 COMP_0091 0 65535 /end CHARACTERISTIC
/begin CHARACTERISTIC mDGNTGTXNG "ROM Const mDGNTGTXNG" VALUE 0x000159A4 REC_UWORD_C 0 COMP_0091 0 65535 /end CHARACTERISTIC
/begin CHARACTERISTIC mDGNTHCLNG "ROM Const mDGNTHCLNG" VALUE 0x000159A6 REC_UWORD_C 0 COMP_0091 0 65535 /end CHARACTERISTIC
/begin CHARACTERISTIC mDGNTHFBNG "ROM Const mDGNTHFBNG" VALUE 0x000159A8 REC_UWORD_C 0 COMP_0091 0 65535 /end CHARACTERISTIC
/begin CHARACTERISTIC mDGNTHNGH "ROM Const mDGNTHNGH" VALUE 0x000159AA REC_UWORD_C 0 COMP_0091 0 65535 /end CHARACTERISTIC
/begin CHARACTERISTIC mDGNTHNGL "ROM Const mDGNTHNGL" VALUE 0x000159AC REC_UWORD_C 0 COMP_0091 0 65535 /end CHARACTERISTIC
/begin CHARACTERISTIC mDGNTHOPNG "ROM Const mDGNTHOPNG" VALUE 0x000159AE REC_UWORD_C 0 COMP_0091 0 65535 /end CHARACTERISTIC
/begin CHARACTERISTIC mDGNTIMNGM "ROM Const mDGNTIMNGM" VALUE 0x000159B0 REC_UWORD_C 0 COMP_0091 0 65535 /end CHARACTERISTIC
/begin CHARACTERISTIC mDGNTONGH "ROM Const mDGNTONGH" VALUE 0x000159B2 REC_UWORD_C 0 COMP_0091 0 65535 /end CHARACTERISTIC
/begin CHARACTERISTIC mDGNTONGL "ROM Const mDGNTONGL" VALUE 0x000159B4 REC_UWORD_C 0 COMP_0091 0 65535 /end CHARACTERISTIC
/begin CHARACTERISTIC mDGNTORPNG "ROM Const mDGNTORPNG" VALUE 0x000159B6 REC_UWORD_C 0 COMP_0091 0 65535 /end CHARACTERISTIC
/begin CHARACTERISTIC mDGNTP12NG "ROM Const mDGNTP12NG" VALUE 0x000159B8 REC_UWORD_C 0 COMP_0091 0 65535 /end CHARACTERISTIC
/begin CHARACTERISTIC mDGNTP1NGH "ROM Const mDGNTP1NGH" VALUE 0x000159BA REC_UWORD_C 0 COMP_0091 0 65535 /end CHARACTERISTIC
/begin CHARACTERISTIC mDGNTP1NGL "ROM Const mDGNTP1NGL" VALUE 0x000159BC REC_UWORD_C 0 COMP_0091 0 65535 /end CHARACTERISTIC
/begin CHARACTERISTIC mDGNTP2NGH "ROM Const mDGNTP2NGH" VALUE 0x000159BE REC_UWORD_C 0 COMP_0091 0 65535 /end CHARACTERISTIC
/begin CHARACTERISTIC mDGNTP2NGL "ROM Const mDGNTP2NGL" VALUE 0x000159C0 REC_UWORD_C 0 COMP_0091 0 65535 /end CHARACTERISTIC
/begin CHARACTERISTIC mDGNTPCLNG "ROM Const mDGNTPCLNG" VALUE 0x000159C2 REC_UWORD_C 0 COMP_0091 0 65535 /end CHARACTERISTIC
/begin CHARACTERISTIC mDGNTPLRLO "ROM Const mDGNTPLRLO" VALUE 0x000159C4 REC_UWORD_C 0 COMP_0091 0 65535 /end CHARACTERISTIC
/begin CHARACTERISTIC mDGNTPLRNG "ROM Const mDGNTPLRNG" VALUE 0x000159C6 REC_UWORD_C 0 COMP_0091 0 65535 /end CHARACTERISTIC
/begin CHARACTERISTIC mDGNTPLRNO "ROM Const mDGNTPLRNO" VALUE 0x000159C8 REC_UWORD_C 0 COMP_0091 0 65535 /end CHARACTERISTIC
/begin CHARACTERISTIC mDGNTPS4NG "ROM Const mDGNTPS4NG" VALUE 0x000159CA REC_UWORD_C 0 COMP_0091 0 65535 /end CHARACTERISTIC
/begin CHARACTERISTIC mDGNTSKNGM "ROM Const mDGNTSKNGM" VALUE 0x000159CC REC_UWORD_C 0 COMP_0091 0 65535 /end CHARACTERISTIC
/begin CHARACTERISTIC mDGNTTEPNG "ROM Const mDGNTTEPNG" VALUE 0x000159CE REC_UWORD_C 0 COMP_0091 0 65535 /end CHARACTERISTIC
/begin CHARACTERISTIC mDGNTUBNG "ROM Const mDGNTUBNG" VALUE 0x000159D0 REC_UWORD_C 0 COMP_0091 0 65535 /end CHARACTERISTIC
/begin CHARACTERISTIC mDGNTWCLNG "ROM Const mDGNTWCLNG" VALUE 0x000159D2 REC_UWORD_C 0 COMP_0091 0 65535 /end CHARACTERISTIC
/begin CHARACTERISTIC mDGNTWNGH "ROM Const mDGNTWNGH" VALUE 0x000159D4 REC_UWORD_C 0 COMP_0091 0 65535 /end CHARACTERISTIC
/begin CHARACTERISTIC mDGNTWNGL "ROM Const mDGNTWNGL" VALUE 0x000159D6 REC_UWORD_C 0 COMP_0091 0 65535 /end CHARACTERISTIC
/begin CHARACTERISTIC mDGNTWSTNG "ROM Const mDGNTWSTNG" VALUE 0x000159D8 REC_UWORD_C 0 COMP_0091 0 65535 /end CHARACTERISTIC
/begin CHARACTERISTIC mDGNTXLNNG "ROM Const mDGNTXLNNG" VALUE 0x000159DA REC_UWORD_C 0 COMP_0091 0 65535 /end CHARACTERISTIC
/begin CHARACTERISTIC mDGNVAPXNG "ROM Const mDGNVAPXNG" VALUE 0x000159DC REC_UWORD_C 0 COMP_0091 0 65535 /end CHARACTERISTIC
/begin CHARACTERISTIC mDGNVBONG1 "ROM Const mDGNVBONG1" VALUE 0x000159DE REC_UWORD_C 0 COMP_0091 0 65535 /end CHARACTERISTIC
/begin CHARACTERISTIC mDGNVDRING "ROM Const mDGNVDRING" VALUE 0x000159E0 REC_UWORD_C 0 COMP_0091 0 65535 /end CHARACTERISTIC
/begin CHARACTERISTIC mDGNVIDNG "ROM Const mDGNVIDNG" VALUE 0x000159E2 REC_UWORD_C 0 COMP_0091 0 65535 /end CHARACTERISTIC
/begin CHARACTERISTIC mDGNVMOOPN "ROM Const mDGNVMOOPN" VALUE 0x000159E4 REC_UWORD_C 0 COMP_0091 0 65535 /end CHARACTERISTIC
/begin CHARACTERISTIC mDGNVMOSHT "ROM Const mDGNVMOSHT" VALUE 0x000159E6 REC_UWORD_C 0 COMP_0091 0 65535 /end CHARACTERISTIC
/begin CHARACTERISTIC mDGNVPBNGH "ROM Const mDGNVPBNGH" VALUE 0x000159E8 REC_UWORD_C 0 COMP_0091 0 65535 /end CHARACTERISTIC
/begin CHARACTERISTIC mDGNVPBNGL "ROM Const mDGNVPBNGL" VALUE 0x000159EA REC_UWORD_C 0 COMP_0091 0 65535 /end CHARACTERISTIC
/begin CHARACTERISTIC mDGNVSPD "ROM Const mDGNVSPD" VALUE 0x000159EC REC_UWORD_C 0 COMP_0436 0 6553.5 /end CHARACTERISTIC
/begin CHARACTERISTIC mDGNVSPH "ROM Const mDGNVSPH" VALUE 0x000159EE REC_UWORD_C 0 COMP_0436 0 6553.5 /end CHARACTERISTIC
/begin CHARACTERISTIC mDGNVSPL "ROM Const mDGNVSPL" VALUE 0x000159F0 REC_UWORD_C 0 COMP_0436 0 6553.5 /end CHARACTERISTIC
/begin CHARACTERISTIC mDGNVSPLDL "ROM Const mDGNVSPLDL" VALUE 0x000159F2 REC_UWORD_C 0 COMP_0091 0 65535 /end CHARACTERISTIC
/begin CHARACTERISTIC mDGNVSPLDR "ROM Const mDGNVSPLDR" VALUE 0x000159F4 REC_UWORD_C 0 COMP_0091 0 65535 /end CHARACTERISTIC
/begin CHARACTERISTIC mDGNVSPLRA "ROM Const mDGNVSPLRA" VALUE 0x000159F6 REC_UWORD_C 0 COMP_0091 0 65535 /end CHARACTERISTIC
/begin CHARACTERISTIC mDGNVSPNG "ROM Const mDGNVSPNG" VALUE 0x000159F8 REC_UWORD_C 0 COMP_0091 0 65535 /end CHARACTERISTIC
/begin CHARACTERISTIC mDGNVSPRNG "ROM Const mDGNVSPRNG" VALUE 0x000159FA REC_UWORD_C 0 COMP_0091 0 65535 /end CHARACTERISTIC
/begin CHARACTERISTIC mDGNVTCE1R "ROM Const mDGNVTCE1R" VALUE 0x000159FC REC_UWORD_C 0 COMP_0091 0 65535 /end CHARACTERISTIC
/begin CHARACTERISTIC mDGNVTCI1R "ROM Const mDGNVTCI1R" VALUE 0x000159FE REC_UWORD_C 0 COMP_0091 0 65535 /end CHARACTERISTIC
/begin CHARACTERISTIC mDGNVTCSV1 "ROM Const mDGNVTCSV1" VALUE 0x00015A00 REC_UWORD_C 0 COMP_0091 0 65535 /end CHARACTERISTIC
/begin CHARACTERISTIC mDGNVTSBE1 "ROM Const mDGNVTSBE1" VALUE 0x00015A02 REC_UWORD_C 0 COMP_0091 0 65535 /end CHARACTERISTIC
/begin CHARACTERISTIC mDGNVTSNE1 "ROM Const mDGNVTSNE1" VALUE 0x00015A04 REC_UWORD_C 0 COMP_0091 0 65535 /end CHARACTERISTIC
/begin CHARACTERISTIC mDGNVTSVE1 "ROM Const mDGNVTSVE1" VALUE 0x00015A06 REC_UWORD_C 0 COMP_0091 0 65535 /end CHARACTERISTIC
/begin CHARACTERISTIC mDGNWDTNGM "ROM Const mDGNWDTNGM" VALUE 0x00015A08 REC_UWORD_C 0 COMP_0091 0 65535 /end CHARACTERISTIC
/begin CHARACTERISTIC mDHOSTR "ROM Const mDHOSTR" VALUE 0x0000842A REC_UBYTE_C 0 COMP_0017 0 255 /end CHARACTERISTIC
/begin CHARACTERISTIC mDHVFUEL "ROM Const mDHVFUEL" VALUE 0x00009092 REC_UWORD_C 0 COMP_0023 0 327675 /end CHARACTERISTIC
/begin CHARACTERISTIC mDIDLCFEQ "ROM Const mDIDLCFEQ" VALUE 0x0000842B REC_UBYTE_C 0 COMP_0373 0 2.55 /end CHARACTERISTIC
/begin CHARACTERISTIC mDIFD "ROM Const mDIFD" VALUE 0x00008E28 REC_SWORD_C 0 COMP_0005_S -3.2768 3.2767 /end CHARACTERISTIC
/begin CHARACTERISTIC mDIFN_1 "ROM Const mDIFN_1" VALUE 0x000096AC REC_SLONG_C 0 COMP_0005_S -214748.3648 214748.3647 /end CHARACTERISTIC
/begin CHARACTERISTIC mDIFN_2 "ROM Const mDIFN_2" VALUE 0x000096B0 REC_SLONG_C 0 COMP_0005_S -214748.3648 214748.3647 /end CHARACTERISTIC
/begin CHARACTERISTIC mDIGNENG "ROM Const mDIGNENG" VALUE 0x0000842D REC_UBYTE_C 0 COMP_0006 0 3187.5 /end CHARACTERISTIC
/begin CHARACTERISTIC mDIGNENGT "ROM Const mDIGNENGT" VALUE 0x0000842E REC_UBYTE_C 0 COMP_0008 0 25500 /end CHARACTERISTIC
/begin CHARACTERISTIC mDIGTPNGT "ROM Const mDIGTPNGT" VALUE 0x0000842F REC_UBYTE_C 0 COMP_0008 0 25500 /end CHARACTERISTIC
/begin CHARACTERISTIC mDILU "ROM Const mDILU" VALUE 0x00008430 REC_UBYTE_C 0 COMP_0095 0 398.4375 /end CHARACTERISTIC
/begin CHARACTERISTIC mDINPNE1 "ROM Const mDINPNE1" VALUE 0x00008431 REC_UBYTE_C 0 COMP_0082_S 0 255 /end CHARACTERISTIC
/begin CHARACTERISTIC mDIRE11 "ROM Const mDIRE11" VALUE 0x00008432 REC_UBYTE_C 0 COMP_0008 0 25500 /end CHARACTERISTIC
/begin CHARACTERISTIC mDIRE12 "ROM Const mDIRE12" VALUE 0x00009094 REC_UWORD_C 0 COMP_0008 0 6553500 /end CHARACTERISTIC
/begin CHARACTERISTIC mDIRE13 "ROM Const mDIRE13" VALUE 0x00009096 REC_UWORD_C 0 COMP_0008 0 6553500 /end CHARACTERISTIC
/begin CHARACTERISTIC mDIRE14 "ROM Const mDIRE14" VALUE 0x00008433 REC_UBYTE_C 0 COMP_0008 0 25500 /end CHARACTERISTIC
/begin CHARACTERISTIC mDIRE15 "ROM Const mDIRE15" VALUE 0x00008434 REC_UBYTE_C 0 COMP_0008 0 25500 /end CHARACTERISTIC
/begin CHARACTERISTIC mDIRE15B "ROM Const mDIRE15B" VALUE 0x00008435 REC_UBYTE_C 0 COMP_0008 0 25500 /end CHARACTERISTIC
/begin CHARACTERISTIC mDIRE16 "ROM Const mDIRE16" VALUE 0x00008436 REC_UBYTE_C 0 COMP_0008 0 25500 /end CHARACTERISTIC
/begin CHARACTERISTIC mDIRE17 "ROM Const mDIRE17" VALUE 0x00008437 REC_UBYTE_C 0 COMP_0096 0 2550 /end CHARACTERISTIC
/begin CHARACTERISTIC mDIREI1 "ROM Const mDIREI1" VALUE 0x00008438 REC_UBYTE_C 0 COMP_0008 0 25500 /end CHARACTERISTIC
/begin CHARACTERISTIC mDIREI6 "ROM Const mDIREI6" VALUE 0x00008439 REC_UBYTE_C 0 COMP_0008 0 25500 /end CHARACTERISTIC
/begin CHARACTERISTIC mDIREI8 "ROM Const mDIREI8" VALUE 0x0000843A REC_UBYTE_C 0 COMP_0013 0 255 /end CHARACTERISTIC
/begin CHARACTERISTIC mDIREI9 "ROM Const mDIREI9" VALUE 0x00009098 REC_UWORD_C 0 COMP_0008 0 6553500 /end CHARACTERISTIC
/begin CHARACTERISTIC mDISCAU "ROM Const mDISCAU" VALUE 0x0000843B REC_UBYTE_C 0 COMP_0083_S 0 3.984375 /end CHARACTERISTIC
/begin CHARACTERISTIC mDISCBFN "ROM Const mDISCBFN" VALUE 0x0000843C REC_UBYTE_C 0 COMP_0083_S 0 3.984375 /end CHARACTERISTIC
/begin CHARACTERISTIC mDISCDEF "ROM Const mDISCDEF" VALUE 0x0000843D REC_UBYTE_C 0 COMP_0083_S 0 3.984375 /end CHARACTERISTIC
/begin CHARACTERISTIC mDISCDPU "ROM Const mDISCDPU" VALUE 0x0000843E REC_UBYTE_C 0 COMP_0083_S 0 3.984375 /end CHARACTERISTIC
/begin CHARACTERISTIC mDISCHLH "ROM Const mDISCHLH" VALUE 0x0000843F REC_UBYTE_C 0 COMP_0083_S 0 3.984375 /end CHARACTERISTIC
/begin CHARACTERISTIC mDISCID "ROM Const mDISCID" VALUE 0x00008440 REC_UBYTE_C 0 COMP_0051 0 255 /end CHARACTERISTIC
/begin CHARACTERISTIC mDISCLU1 "ROM Const mDISCLU1" VALUE 0x00008441 REC_UBYTE_C 0 COMP_0097 0 3.984375 /end CHARACTERISTIC
/begin CHARACTERISTIC mDISCLU2 "ROM Const mDISCLU2" VALUE 0x00008442 REC_UBYTE_C 0 COMP_0097 0 3.984375 /end CHARACTERISTIC
/begin CHARACTERISTIC mDISCRU "ROM Const mDISCRU" VALUE 0x00008443 REC_UBYTE_C 0 COMP_0083_S 0 3.984375 /end CHARACTERISTIC
/begin CHARACTERISTIC mDISCSS "ROM Const mDISCSS" VALUE 0x00008444 REC_UBYTE_C 0 COMP_0084_S 0 1.9921875 /end CHARACTERISTIC
/begin CHARACTERISTIC mDISCST "ROM Const mDISCST" VALUE 0x00008445 REC_UBYTE_C 0 COMP_0008 0 25500 /end CHARACTERISTIC
/begin CHARACTERISTIC mDKCRADV "ROM Const mDKCRADV" VALUE 0x0000909A REC_UWORD_C 0 COMP_0456 0 1.999970916 /end CHARACTERISTIC
/begin CHARACTERISTIC mDKEISUU "ROM Const mDKEISUU" VALUE 0x0000909C REC_UWORD_C 0 COMP_0085_S 0 3276.75 /end CHARACTERISTIC
/begin CHARACTERISTIC mDKHOT "ROM Const mDKHOT" VALUE 0x0000909E REC_UWORD_C 0 COMP_0100 0 3.999941832 /end CHARACTERISTIC
/begin CHARACTERISTIC mDKTARTDR "ROM Const mDKTARTDR" VALUE 0x00008446 REC_UBYTE_C 0 COMP_0073_S 0 255 /end CHARACTERISTIC
/begin CHARACTERISTIC mDKTST "ROM Const mDKTST" VALUE 0x000090A0 REC_UWORD_C 0 COMP_0101 0 0.999985458 /end CHARACTERISTIC
/begin CHARACTERISTIC mDLECNJ "ROM Const mDLECNJ" VALUE 0x00008447 REC_UBYTE_C 0 COMP_0102 0 5100 /end CHARACTERISTIC
/begin CHARACTERISTIC mDLEVPJ "ROM Const mDLEVPJ" VALUE 0x00008448 REC_UBYTE_C 0 COMP_0102 0 5100 /end CHARACTERISTIC
/begin CHARACTERISTIC mDLINPNG "ROM Const mDLINPNG" VALUE 0x000090A2 REC_UWORD_C 0 COMP_0014 0 655350 /end CHARACTERISTIC
/begin CHARACTERISTIC mDLINVDEC "ROM Const mDLINVDEC" VALUE 0x00008449 REC_UBYTE_C 0 COMP_0014 0 2550 /end CHARACTERISTIC
/begin CHARACTERISTIC mDLMD1 "ROM Const mDLMD1" VALUE 0x0000844A REC_UBYTE_C 0 COMP_0027 0 255 /end CHARACTERISTIC
/begin CHARACTERISTIC mDLMD2 "ROM Const mDLMD2" VALUE 0x0000844B REC_UBYTE_C 0 COMP_0027 0 255 /end CHARACTERISTIC
/begin CHARACTERISTIC mDLMD3 "ROM Const mDLMD3" VALUE 0x0000844C REC_UBYTE_C 0 COMP_0027 0 255 /end CHARACTERISTIC
/begin CHARACTERISTIC mDLMFDT "ROM Const mDLMFDT" VALUE 0x0000844D REC_UBYTE_C 0 COMP_0049 0 255 /end CHARACTERISTIC
/begin CHARACTERISTIC mDLOPEN "ROM Const mDLOPEN" VALUE 0x0000844E REC_UBYTE_C 0 COMP_0049 0 255 /end CHARACTERISTIC
/begin CHARACTERISTIC mDLPFHI "ROM Const mDLPFHI" VALUE 0x0000844F REC_UBYTE_C 0 COMP_0086_S 0 19.9104 /end CHARACTERISTIC
/begin CHARACTERISTIC mDLPFLO "ROM Const mDLPFLO" VALUE 0x00008450 REC_UBYTE_C 0 COMP_0086_S 0 19.9104 /end CHARACTERISTIC
/begin CHARACTERISTIC mDLPFLO2 "ROM Const mDLPFLO2" VALUE 0x00008451 REC_UBYTE_C 0 COMP_0087_S 0 19.9104 /end CHARACTERISTIC
/begin CHARACTERISTIC mDLPFLOL "ROM Const mDLPFLOL" VALUE 0x00008452 REC_UBYTE_C 0 COMP_0087_S 0 19.9104 /end CHARACTERISTIC
/begin CHARACTERISTIC mDLPFLOL2 "ROM Const mDLPFLOL2" VALUE 0x00008453 REC_UBYTE_C 0 COMP_0087_S 0 19.9104 /end CHARACTERISTIC
/begin CHARACTERISTIC mDLPRHTID "ROM Const mDLPRHTID" VALUE 0x00008454 REC_UBYTE_C 0 COMP_0088_S 0 2.55 /end CHARACTERISTIC
/begin CHARACTERISTIC mDLRSEL "ROM Const mDLRSEL" VALUE 0x00008455 REC_UBYTE_C 0 COMP_0008 0 25500 /end CHARACTERISTIC
/begin CHARACTERISTIC mDLTAAQL "ROM Const mDLTAAQL" VALUE 0x00008456 REC_UBYTE_C 0 COMP_0041 0 0.204 /end CHARACTERISTIC
/begin CHARACTERISTIC mDLTACC1 "ROM Const mDLTACC1" VALUE 0x000096B4 REC_SLONG_C 0 COMP_0089_S -1843.20024746394 1843.20024660563 /end CHARACTERISTIC
/begin CHARACTERISTIC mDLTACC2 "ROM Const mDLTACC2" VALUE 0x000096B8 REC_SLONG_C 0 COMP_0089_S -1843.20024746394 1843.20024660563 /end CHARACTERISTIC
/begin CHARACTERISTIC mDLTACC3 "ROM Const mDLTACC3" VALUE 0x000096BC REC_SLONG_C 0 COMP_0089_S -1843.20024746394 1843.20024660563 /end CHARACTERISTIC
/begin CHARACTERISTIC mDLTALPDY "ROM Const mDLTALPDY" VALUE 0x00008457 REC_UBYTE_C 0 COMP_0049 0 255 /end CHARACTERISTIC
/begin CHARACTERISTIC mDLTALPHT "ROM Const mDLTALPHT" VALUE 0x00008458 REC_UBYTE_C 0 COMP_0090_S 0 51 /end CHARACTERISTIC
/begin CHARACTERISTIC mDLTDEC1 "ROM Const mDLTDEC1" VALUE 0x000096C0 REC_SLONG_C 0 COMP_0089_S -1843.20024746394 1843.20024660563 /end CHARACTERISTIC
/begin CHARACTERISTIC mDLTDLL "ROM Const mDLTDLL" VALUE 0x00008459 REC_UBYTE_C 0 COMP_0014 0 2550 /end CHARACTERISTIC
/begin CHARACTERISTIC mDLTDLS "ROM Const mDLTDLS" VALUE 0x0000845A REC_UBYTE_C 0 COMP_0014 0 2550 /end CHARACTERISTIC
/begin CHARACTERISTIC mDLTDLSS "ROM Const mDLTDLSS" VALUE 0x0000845B REC_UBYTE_C 0 COMP_0014 0 2550 /end CHARACTERISTIC
/begin CHARACTERISTIC mDLTMPR "ROM Const mDLTMPR" VALUE 0x0000845C REC_UBYTE_C 0 COMP_0091_S 0 25.5 /end CHARACTERISTIC
/begin CHARACTERISTIC mDLTNIN2 "ROM Const mDLTNIN2" VALUE 0x000090A4 REC_UWORD_C 0 COMP_0443 0 65535 /end CHARACTERISTIC
/begin CHARACTERISTIC mDLTNMSK "ROM Const mDLTNMSK" VALUE 0x0000845D REC_UBYTE_C 0 COMP_0014 0 2550 /end CHARACTERISTIC
/begin CHARACTERISTIC mDLTPBAV "ROM Const mDLTPBAV" VALUE 0x000090A6 REC_UWORD_C 0 COMP_0034_S 0 255.99609375 /end CHARACTERISTIC
/begin CHARACTERISTIC mDLTQ0TRM "ROM Const mDLTQ0TRM" VALUE 0x000090A8 REC_UWORD_C 0 COMP_0092_S 0 1638.375 /end CHARACTERISTIC
/begin CHARACTERISTIC mDLTQSL "ROM Const mDLTQSL" VALUE 0x0000845E REC_UBYTE_C 0 COMP_0032 0 0.99609375 /end CHARACTERISTIC
/begin CHARACTERISTIC mDLTRTOH "ROM Const mDLTRTOH" VALUE 0x000090AA REC_UWORD_C 0 COMP_0093_S 0 63.999056205 /end CHARACTERISTIC
/begin CHARACTERISTIC mDLTRTOL "ROM Const mDLTRTOL" VALUE 0x000090AC REC_UWORD_C 0 COMP_0093_S 0 63.999056205 /end CHARACTERISTIC
/begin CHARACTERISTIC mDLTTIM "ROM Const mDLTTIM" VALUE 0x0000845F REC_UBYTE_C 0 COMP_0014 0 2550 /end CHARACTERISTIC
/begin CHARACTERISTIC mDLUN "ROM Const mDLUN" VALUE 0x00008460 REC_UBYTE_C 0 COMP_0000 0 6375 /end CHARACTERISTIC
/begin CHARACTERISTIC mDLUN1 "ROM Const mDLUN1" VALUE 0x00008461 REC_UBYTE_C 0 COMP_0000 0 6375 /end CHARACTERISTIC
/begin CHARACTERISTIC mDLUNAC "ROM Const mDLUNAC" VALUE 0x00008462 REC_UBYTE_C 0 COMP_0000 0 6375 /end CHARACTERISTIC
/begin CHARACTERISTIC mDLVSP1 "ROM Const mDLVSP1" VALUE 0x00008463 REC_UBYTE_C 0 COMP_0007 0 510 /end CHARACTERISTIC
/begin CHARACTERISTIC mDLVSP1K "ROM Const mDLVSP1K" VALUE 0x000090AE REC_UWORD_C 0 COMP_0436 0 6553.5 /end CHARACTERISTIC
/begin CHARACTERISTIC mDLVSP2DS "ROM Const mDLVSP2DS" VALUE 0x00008464 REC_UBYTE_C 0 COMP_0007 0 510 /end CHARACTERISTIC
/begin CHARACTERISTIC mDLVSPB "ROM Const mDLVSPB" VALUE 0x00008465 REC_UBYTE_C 0 COMP_0007 0 510 /end CHARACTERISTIC
/begin CHARACTERISTIC mDLVSPBK "ROM Const mDLVSPBK" VALUE 0x000090B0 REC_UWORD_C 0 COMP_0436 0 6553.5 /end CHARACTERISTIC
/begin CHARACTERISTIC mDLYATMP "ROM Const mDLYATMP" VALUE 0x000090B2 REC_UWORD_C 0 COMP_0075_S 0 32767.5 /end CHARACTERISTIC
/begin CHARACTERISTIC mDLYCD3 "ROM Const mDLYCD3" VALUE 0x00008466 REC_UBYTE_C 0 COMP_0013 0 255 /end CHARACTERISTIC
/begin CHARACTERISTIC mDLYLON "ROM Const mDLYLON" VALUE 0x00008467 REC_UBYTE_C 0 COMP_0008 0 25500 /end CHARACTERISTIC
/begin CHARACTERISTIC mDLYMNS "ROM Const mDLYMNS" VALUE 0x00008468 REC_UBYTE_C 0 COMP_0008 0 25500 /end CHARACTERISTIC
/begin CHARACTERISTIC mDLYPA "ROM Const mDLYPA" VALUE 0x00008469 REC_UBYTE_C 0 COMP_0008 0 25500 /end CHARACTERISTIC
/begin CHARACTERISTIC mDLYTFRC "ROM Const mDLYTFRC" VALUE 0x0000846A REC_UBYTE_C 0 COMP_0013 0 255 /end CHARACTERISTIC
/begin CHARACTERISTIC mDLYVP "ROM Const mDLYVP" VALUE 0x0000846B REC_UBYTE_C 0 COMP_0015_S 0 25.5 /end CHARACTERISTIC
/begin CHARACTERISTIC mDMFISC "ROM Const mDMFISC" VALUE 0x0000846C REC_UBYTE_C 0 COMP_0049 0 255 /end CHARACTERISTIC
/begin CHARACTERISTIC mDMKMR1 "ROM Const mDMKMR1" VALUE 0x0000846D REC_UBYTE_C 0 COMP_0106 0 0.12444 /end CHARACTERISTIC
/begin CHARACTERISTIC mDMKMR2 "ROM Const mDMKMR2" VALUE 0x0000846E REC_UBYTE_C 0 COMP_0106 0 0.12444 /end CHARACTERISTIC
/begin CHARACTERISTIC mDMNRGG "ROM Const mDMNRGG" VALUE 0x0000846F REC_UBYTE_C 0 COMP_0000 0 6375 /end CHARACTERISTIC
/begin CHARACTERISTIC mDMPRGMX "ROM Const mDMPRGMX" VALUE 0x000090B4 REC_UWORD_C 0 COMP_0156 0 65535 /end CHARACTERISTIC
/begin CHARACTERISTIC mDMPRT23N "ROM Const mDMPRT23N" VALUE 0x000090B6 REC_UWORD_C 0 COMP_0456 0 1.999970916 /end CHARACTERISTIC
/begin CHARACTERISTIC mDMPRT24N "ROM Const mDMPRT24N" VALUE 0x000090B8 REC_UWORD_C 0 COMP_0456 0 1.999970916 /end CHARACTERISTIC
/begin CHARACTERISTIC mDMPRT25N "ROM Const mDMPRT25N" VALUE 0x000090BA REC_UWORD_C 0 COMP_0456 0 1.999970916 /end CHARACTERISTIC
/begin CHARACTERISTIC mDMPRT26N "ROM Const mDMPRT26N" VALUE 0x000090BC REC_UWORD_C 0 COMP_0456 0 1.999970916 /end CHARACTERISTIC
/begin CHARACTERISTIC mDMPRT27N "ROM Const mDMPRT27N" VALUE 0x000090BE REC_UWORD_C 0 COMP_0456 0 1.999970916 /end CHARACTERISTIC
/begin CHARACTERISTIC mDMPRT34N "ROM Const mDMPRT34N" VALUE 0x000090C0 REC_UWORD_C 0 COMP_0456 0 1.999970916 /end CHARACTERISTIC
/begin CHARACTERISTIC mDMPRT35N "ROM Const mDMPRT35N" VALUE 0x000090C2 REC_UWORD_C 0 COMP_0456 0 1.999970916 /end CHARACTERISTIC
/begin CHARACTERISTIC mDMPRT36N "ROM Const mDMPRT36N" VALUE 0x000090C4 REC_UWORD_C 0 COMP_0456 0 1.999970916 /end CHARACTERISTIC
/begin CHARACTERISTIC mDMPRT37N "ROM Const mDMPRT37N" VALUE 0x000090C6 REC_UWORD_C 0 COMP_0456 0 1.999970916 /end CHARACTERISTIC
/begin CHARACTERISTIC mDMPRT45N "ROM Const mDMPRT45N" VALUE 0x000090C8 REC_UWORD_C 0 COMP_0456 0 1.999970916 /end CHARACTERISTIC
/begin CHARACTERISTIC mDMPRT46N "ROM Const mDMPRT46N" VALUE 0x000090CA REC_UWORD_C 0 COMP_0456 0 1.999970916 /end CHARACTERISTIC
/begin CHARACTERISTIC mDMPRT47N "ROM Const mDMPRT47N" VALUE 0x000090CC REC_UWORD_C 0 COMP_0456 0 1.999970916 /end CHARACTERISTIC
/begin CHARACTERISTIC mDMPRT57N "ROM Const mDMPRT57N" VALUE 0x000090CE REC_UWORD_C 0 COMP_0456 0 1.999970916 /end CHARACTERISTIC
/begin CHARACTERISTIC mDMPRT67N "ROM Const mDMPRT67N" VALUE 0x000090D0 REC_UWORD_C 0 COMP_0456 0 1.999970916 /end CHARACTERISTIC
/begin CHARACTERISTIC mDMPTPG "ROM Const mDMPTPG" VALUE 0x00008470 REC_UBYTE_C 0 COMP_0094_S 0 0.00124491 /end CHARACTERISTIC
/begin CHARACTERISTIC mDNCAT "ROM Const mDNCAT" VALUE 0x00008471 REC_UBYTE_C 0 COMP_0070 0 3187.5 /end CHARACTERISTIC
/begin CHARACTERISTIC mDNDHL "ROM Const mDNDHL" VALUE 0x00008472 REC_UBYTE_C 0 COMP_0095_S 0 199.21875 /end CHARACTERISTIC
/begin CHARACTERISTIC mDNE019FL "ROM Const mDNE019FL" VALUE 0x00008473 REC_UBYTE_C 0 COMP_0019_S 0 1.000000095 /end CHARACTERISTIC
/begin CHARACTERISTIC mDNEC "ROM Const mDNEC" VALUE 0x00008474 REC_UBYTE_C 0 COMP_0075_S 0 127.5 /end CHARACTERISTIC
/begin CHARACTERISTIC mDNEFL "ROM Const mDNEFL" VALUE 0x00008475 REC_UBYTE_C 0 COMP_0096_S 0 1.00000035 /end CHARACTERISTIC
/begin CHARACTERISTIC mDNFCS "ROM Const mDNFCS" VALUE 0x00008476 REC_UBYTE_C 0 COMP_0006 0 3187.5 /end CHARACTERISTIC
/begin CHARACTERISTIC mDNKJU "ROM Const mDNKJU" VALUE 0x00008477 REC_UBYTE_C 0 COMP_0111 1.00392156862745 256 /end CHARACTERISTIC
/begin CHARACTERISTIC mDNSET0BF "ROM Const mDNSET0BF" VALUE 0x00008478 REC_UBYTE_C 0 COMP_0014 0 2550 /end CHARACTERISTIC
/begin CHARACTERISTIC mDNSET0BS "ROM Const mDNSET0BS" VALUE 0x00008479 REC_UBYTE_C 0 COMP_0014 0 2550 /end CHARACTERISTIC
/begin CHARACTERISTIC mDNSET0F "ROM Const mDNSET0F" VALUE 0x0000847A REC_UBYTE_C 0 COMP_0014 0 2550 /end CHARACTERISTIC
/begin CHARACTERISTIC mDNSET0GN "ROM Const mDNSET0GN" VALUE 0x0000847B REC_UBYTE_C 0 COMP_0014 0 2550 /end CHARACTERISTIC
/begin CHARACTERISTIC mDNSET0PS "ROM Const mDNSET0PS" VALUE 0x0000847C REC_UBYTE_C 0 COMP_0014 0 2550 /end CHARACTERISTIC
/begin CHARACTERISTIC mDNSET0S "ROM Const mDNSET0S" VALUE 0x0000847D REC_UBYTE_C 0 COMP_0014 0 2550 /end CHARACTERISTIC
/begin CHARACTERISTIC mDNSET0SL "ROM Const mDNSET0SL" VALUE 0x0000847E REC_UBYTE_C 0 COMP_0014 0 2550 /end CHARACTERISTIC
/begin CHARACTERISTIC mDNSET0SS "ROM Const mDNSET0SS" VALUE 0x0000847F REC_UBYTE_C 0 COMP_0008 0 25500 /end CHARACTERISTIC
/begin CHARACTERISTIC mDNSETDNI "ROM Const mDNSETDNI" VALUE 0x00008480 REC_UBYTE_C 0 COMP_0014 0 2550 /end CHARACTERISTIC
/begin CHARACTERISTIC mDNSETNID "ROM Const mDNSETNID" VALUE 0x00008481 REC_UBYTE_C 0 COMP_0014 0 2550 /end CHARACTERISTIC
/begin CHARACTERISTIC mDNSETNNI "ROM Const mDNSETNNI" VALUE 0x00008482 REC_UBYTE_C 0 COMP_0014 0 2550 /end CHARACTERISTIC
/begin CHARACTERISTIC mDOFST1 "ROM Const mDOFST1" VALUE 0x00008483 REC_UBYTE_C 0 COMP_0061 0 1275 /end CHARACTERISTIC
/begin CHARACTERISTIC mDOFST2 "ROM Const mDOFST2" VALUE 0x00008484 REC_UBYTE_C 0 COMP_0061 0 1275 /end CHARACTERISTIC
/begin CHARACTERISTIC mDOFST3 "ROM Const mDOFST3" VALUE 0x00008485 REC_UBYTE_C 0 COMP_0061 0 1275 /end CHARACTERISTIC
/begin CHARACTERISTIC mDOFST4 "ROM Const mDOFST4" VALUE 0x00008486 REC_UBYTE_C 0 COMP_0061 0 1275 /end CHARACTERISTIC
/begin CHARACTERISTIC mDOPNDLY "ROM Const mDOPNDLY" VALUE 0x00008487 REC_UBYTE_C 0 COMP_0234 0 2550 /end CHARACTERISTIC
/begin CHARACTERISTIC mDOTKJU "ROM Const mDOTKJU" VALUE 0x00008488 REC_UBYTE_C 0 COMP_0097_S 1.00392156862745 256 /end CHARACTERISTIC
/begin CHARACTERISTIC mDPPSV0 "ROM Const mDPPSV0" VALUE 0x00008489 REC_UBYTE_C 0 COMP_0054 0 5100 /end CHARACTERISTIC
/begin CHARACTERISTIC mDPPSV1 "ROM Const mDPPSV1" VALUE 0x0000848A REC_UBYTE_C 0 COMP_0054 0 5100 /end CHARACTERISTIC
/begin CHARACTERISTIC mDPPSV2 "ROM Const mDPPSV2" VALUE 0x0000848B REC_UBYTE_C 0 COMP_0054 0 5100 /end CHARACTERISTIC
/begin CHARACTERISTIC mDPPSV3 "ROM Const mDPPSV3" VALUE 0x0000848C REC_UBYTE_C 0 COMP_0054 0 5100 /end CHARACTERISTIC
/begin CHARACTERISTIC mDPSNGNE "ROM Const mDPSNGNE" VALUE 0x0000848D REC_UBYTE_C 0 COMP_0020 0 12750 /end CHARACTERISTIC
/begin CHARACTERISTIC mDPVTF "ROM Const mDPVTF" VALUE 0x0000822B REC_SBYTE_C 0 COMP_0308 -128 127 /end CHARACTERISTIC
/begin CHARACTERISTIC mDQAACV "ROM Const mDQAACV" VALUE 0x0000848E REC_UBYTE_C 0 COMP_0051 0 255 /end CHARACTERISTIC
/begin CHARACTERISTIC mDQCI "ROM Const mDQCI" VALUE 0x0000848F REC_UBYTE_C 0 COMP_0014 0 2550 /end CHARACTERISTIC
/begin CHARACTERISTIC mDQCIH "ROM Const mDQCIH" VALUE 0x00008490 REC_UBYTE_C 0 COMP_0014 0 2550 /end CHARACTERISTIC
/begin CHARACTERISTIC mDQCIS "ROM Const mDQCIS" VALUE 0x00008491 REC_UBYTE_C 0 COMP_0014 0 2550 /end CHARACTERISTIC
/begin CHARACTERISTIC mDQCK "ROM Const mDQCK" VALUE 0x00008492 REC_UBYTE_C 0 COMP_0014 0 2550 /end CHARACTERISTIC
/begin CHARACTERISTIC mDQCK0 "ROM Const mDQCK0" VALUE 0x00008493 REC_UBYTE_C 0 COMP_0014 0 2550 /end CHARACTERISTIC
/begin CHARACTERISTIC mDQFICD "ROM Const mDQFICD" VALUE 0x00008494 REC_UBYTE_C 0 COMP_0051 0 255 /end CHARACTERISTIC
/begin CHARACTERISTIC mDQH0HS40 "ROM Const mDQH0HS40" VALUE 0x000090D2 REC_UWORD_C 0 COMP_0098_S 0 99.9985458 /end CHARACTERISTIC
/begin CHARACTERISTIC mDQH0LMT "ROM Const mDQH0LMT" VALUE 0x000090D4 REC_UWORD_C 0 COMP_0115 0 99.9998565 /end CHARACTERISTIC
/begin CHARACTERISTIC mDQH0SL "ROM Const mDQH0SL" VALUE 0x00008495 REC_UBYTE_C 0 COMP_0032 0 0.99609375 /end CHARACTERISTIC
/begin CHARACTERISTIC mDQLEN "ROM Const mDQLEN" VALUE 0x00008496 REC_UBYTE_C 0 COMP_0008 0 25500 /end CHARACTERISTIC
/begin CHARACTERISTIC mDQPSON "ROM Const mDQPSON" VALUE 0x00008497 REC_UBYTE_C 0 COMP_0099_S 0 0.049725 /end CHARACTERISTIC
/begin CHARACTERISTIC mDRET "ROM Const mDRET" VALUE 0x00008E2A REC_SWORD_C 0 COMP_0078 -128 127.99609375 /end CHARACTERISTIC
/begin CHARACTERISTIC mDRFGAGE "ROM Const mDRFGAGE" VALUE 0x000090D6 REC_UWORD_C 0 COMP_0050 0 5119.921875 /end CHARACTERISTIC
/begin CHARACTERISTIC mDRKTCN "ROM Const mDRKTCN" VALUE 0x000090D8 REC_UWORD_C 0 COMP_0069 0 1.999970916 /end CHARACTERISTIC
/begin CHARACTERISTIC mDRMDID "ROM Const mDRMDID" VALUE 0x0000849A REC_UBYTE_C 0 COMP_0283 0 255 /end CHARACTERISTIC
/begin CHARACTERISTIC mDRMDLAP1 "ROM Const mDRMDLAP1" VALUE 0x000090DA REC_UWORD_C 0 COMP_0100_S 0 511.9921875 /end CHARACTERISTIC
/begin CHARACTERISTIC mDRMDLAP2 "ROM Const mDRMDLAP2" VALUE 0x000090DC REC_UWORD_C 0 COMP_0100_S 0 511.9921875 /end CHARACTERISTIC
/begin CHARACTERISTIC mDRNCTDLY "ROM Const mDRNCTDLY" VALUE 0x0000849B REC_UBYTE_C 0 COMP_0049 0 255 /end CHARACTERISTIC
/begin CHARACTERISTIC mDRNCTDY2 "ROM Const mDRNCTDY2" VALUE 0x0000849C REC_UBYTE_C 0 COMP_0015_S 0 25.5 /end CHARACTERISTIC
/begin CHARACTERISTIC mDRNCTPAF "ROM Const mDRNCTPAF" VALUE 0x0000849D REC_UBYTE_C 0 COMP_0015 0 31.875 /end CHARACTERISTIC
/begin CHARACTERISTIC mDRNJGTM "ROM Const mDRNJGTM" VALUE 0x0000849E REC_UBYTE_C 0 COMP_0049 0 255 /end CHARACTERISTIC
/begin CHARACTERISTIC mDRNPSL "ROM Const mDRNPSL" VALUE 0x00008E2C REC_SWORD_C 0 COMP_0002_S -32768 32767 /end CHARACTERISTIC
/begin CHARACTERISTIC mDRVTQAHY "ROM Const mDRVTQAHY" VALUE 0x000090DE REC_UWORD_C 0 COMP_0032_S 0 8191.875 /end CHARACTERISTIC
/begin CHARACTERISTIC mDRVTQDEC "ROM Const mDRVTQDEC" VALUE 0x000090E0 REC_UWORD_C 0 COMP_0196 0 6553.5 /end CHARACTERISTIC
/begin CHARACTERISTIC mDRVTQIN1 "ROM Const mDRVTQIN1" VALUE 0x000090E2 REC_UWORD_C 0 COMP_0196 0 6553.5 /end CHARACTERISTIC
/begin CHARACTERISTIC mDRVTQIN2 "ROM Const mDRVTQIN2" VALUE 0x000090E4 REC_UWORD_C 0 COMP_0196 0 6553.5 /end CHARACTERISTIC
/begin CHARACTERISTIC mDRVTQLA2 "ROM Const mDRVTQLA2" VALUE 0x000090E6 REC_UWORD_C 0 COMP_0032_S 0 8191.875 /end CHARACTERISTIC
/begin CHARACTERISTIC mDRVTQLAP "ROM Const mDRVTQLAP" VALUE 0x000090E8 REC_UWORD_C 0 COMP_0032_S 0 8191.875 /end CHARACTERISTIC
/begin CHARACTERISTIC mDSHCUT "ROM Const mDSHCUT" VALUE 0x0000849F REC_UBYTE_C 0 COMP_0035 -50 205 /end CHARACTERISTIC
/begin CHARACTERISTIC mDSHVSP "ROM Const mDSHVSP" VALUE 0x000084A0 REC_UBYTE_C 0 COMP_0007 0 510 /end CHARACTERISTIC
/begin CHARACTERISTIC mDSLVSP "ROM Const mDSLVSP" VALUE 0x000084A1 REC_UBYTE_C 0 COMP_0007 0 510 /end CHARACTERISTIC
/begin CHARACTERISTIC mDSOISC "ROM Const mDSOISC" VALUE 0x000084A2 REC_UBYTE_C 0 COMP_0101_S 0 1.9921875 /end CHARACTERISTIC
/begin CHARACTERISTIC mDSPAPO "ROM Const mDSPAPO" VALUE 0x000090EA REC_UWORD_C 0 COMP_0005 0 7208.85 /end CHARACTERISTIC
/begin CHARACTERISTIC mDSPNOIS "ROM Const mDSPNOIS" VALUE 0x000084A3 REC_UBYTE_C 0 COMP_0063 0 0.99609375 /end CHARACTERISTIC
/begin CHARACTERISTIC mDSPNOIS2 "ROM Const mDSPNOIS2" VALUE 0x000084A4 REC_UBYTE_C 0 COMP_0063 0 0.99609375 /end CHARACTERISTIC
/* COMPU_METHOD --------------------------------------------------------- */
/begin COMPU_METHOD COMP_0017 "1deg" RAT_FUNC "%8.2" "deg" COEFFS 0 1 0 0 0 1 /end COMPU_METHOD
/begin COMPU_METHOD COMP_0000_S "fixed axis Long" RAT_FUNC "%8.2" "Long" COEFFS 0 1 0 0 0 1 /end COMPU_METHOD
/begin COMPU_METHOD COMP_0004 "1－" RAT_FUNC "%8.2" "－" COEFFS 0 1 0 0 0 1 /end COMPU_METHOD
/begin COMPU_METHOD COMP_0068 "1-" RAT_FUNC "%8.2" "-" COEFFS 0 1 0 0 0 1 /end COMPU_METHOD
/begin COMPU_METHOD COMP_0001_S "1Pa" RAT_FUNC "%8.2" "Pa" COEFFS 0 1 0 0 0 1 /end COMPU_METHOD
/begin COMPU_METHOD COMP_0002_S "1Pa" RAT_FUNC "%8.2" "Pa" COEFFS 0 1 0 0 0 1 /end COMPU_METHOD
/begin COMPU_METHOD COMP_0003_S "0.2℃" RAT_FUNC "%8.2" "℃" COEFFS 0 1 0 0 0 0.2 /end COMPU_METHOD
/begin COMPU_METHOD COMP_0013 "1s" RAT_FUNC "%8.2" "s" COEFFS 0 1 0 0 0 1 /end COMPU_METHOD
/begin COMPU_METHOD COMP_0238 "100/128%" RAT_FUNC "%8.2" "%" COEFFS 0 1 0 0 0 0.78125 /end COMPU_METHOD
/begin COMPU_METHOD COMP_0014 "10ms" RAT_FUNC "%8.2" "ms" COEFFS 0 1 0 0 0 10 /end COMPU_METHOD
/begin COMPU_METHOD COMP_0074 "1/256count" RAT_FUNC "%8.4" "count" COEFFS 0 1 0 0 0 0.00390625 /end COMPU_METHOD
/begin COMPU_METHOD COMP_0045 "1/128-" RAT_FUNC "%8.4" "-" COEFFS 0 1 0 0 0 0.0078125 /end COMPU_METHOD
/begin COMPU_METHOD COMP_0009 "100/128%" RAT_FUNC "%8.2" "%" COEFFS 0 1 0 0 0 0.78125 /end COMPU_METHOD
/begin COMPU_METHOD COMP_0000 "25rpm" RAT_FUNC "%8.2" "rpm" COEFFS 0 1 0 0 0 25 /end COMPU_METHOD
/begin COMPU_METHOD COMP_0186 "1/64-" RAT_FUNC "%8.3" "-" COEFFS 0 1 0 0 0 0.015625 /end COMPU_METHOD
/begin COMPU_METHOD COMP_0001 "1/8ms" RAT_FUNC "%8.2" "ms" COEFFS 0 1 0 0 0 0.125 /end COMPU_METHOD
/begin COMPU_METHOD COMP_0020 "50rpm" RAT_FUNC "%8.2" "rpm" COEFFS 0 1 0 0 0 50 /end COMPU_METHOD
/begin COMPU_METHOD COMP_0004_S "X-50degC" RAT_FUNC "%8.2" "degC" COEFFS 0 1 50 0 0 1 /end COMPU_METHOD
/begin COMPU_METHOD COMP_0005_S "0.0001-" RAT_FUNC "%8.5" "-" COEFFS 0 1 0 0 0 0.0001 /end COMPU_METHOD
/begin COMPU_METHOD COMP_0388 "0.1-" RAT_FUNC "%8.2" "-" COEFFS 0 1 0 0 0 0.1 /end COMPU_METHOD
/begin COMPU_METHOD COMP_0373 "1/100-" RAT_FUNC "%8.3" "-" COEFFS 0 1 0 0 0 0.01 /end COMPU_METHOD
/begin COMPU_METHOD COMP_0002 "0.35deg" RAT_FUNC "%8.2" "deg" COEFFS 0 1 0 0 0 0.35 /end COMPU_METHOD
/begin COMPU_METHOD COMP_0003 "1℃" RAT_FUNC "%8.2" "℃" COEFFS 0 1 0 0 0 1 /end COMPU_METHOD
/begin COMPU_METHOD COMP_0035 "X-50℃" RAT_FUNC "%8.2" "℃" COEFFS 0 1 50 0 0 1 /end COMPU_METHOD
/begin COMPU_METHOD COMP_0453 "0.002-" RAT_FUNC "%8.4" "-" COEFFS 0 1 0 0 0 0.002 /end COMPU_METHOD
/begin COMPU_METHOD COMP_0006_S "2^-22m/ss" RAT_FUNC "%8.6" "m/ss" COEFFS 0 1 0 0 0 0.000000238419 /end COMPU_METHOD
/begin COMPU_METHOD COMP_0007_S "0.11deg/100m" RAT_FUNC "%8.2" "deg/100m" COEFFS 0 1 0 0 0 0.11 /end COMPU_METHOD
/begin COMPU_METHOD COMP_0005 "0.11deg" RAT_FUNC "%8.2" "deg" COEFFS 0 1 0 0 0 0.11 /end COMPU_METHOD
/begin COMPU_METHOD COMP_0008_S "1/32%/s" RAT_FUNC "%8.3" "%/s" COEFFS 0 1 0 0 0 0.03125 /end COMPU_METHOD
/begin COMPU_METHOD COMP_0006 "12.5rpm" RAT_FUNC "%8.2" "rpm" COEFFS 0 1 0 0 0 12.5 /end COMPU_METHOD
/begin COMPU_METHOD COMP_0009_S "1/3℃" RAT_FUNC "%8.2" "℃" COEFFS 0 1 0 0 0 0.3333333 /end COMPU_METHOD
/begin COMPU_METHOD COMP_0008 "100ms" RAT_FUNC "%8.2" "ms" COEFFS 0 1 0 0 0 100 /end COMPU_METHOD
/begin COMPU_METHOD COMP_0010 "0.003MPa" RAT_FUNC "%8.4" "MPa" COEFFS 0 1 0 0 0 0.003 /end COMPU_METHOD
/begin COMPU_METHOD COMP_0012 "0.02Mpa" RAT_FUNC "%8.3" "Mpa" COEFFS 0 1 0 0 0 0.02 /end COMPU_METHOD
/begin COMPU_METHOD COMP_0011 "0.02MPa" RAT_FUNC "%8.3" "MPa" COEFFS 0 1 0 0 0 0.02 /end COMPU_METHOD
/begin COMPU_METHOD COMP_0010_S "0.0001ｋｊ/100" RAT_FUNC "%8.5" "ｋｊ/100" COEFFS 0 1 0 0 0 0.0001 /end COMPU_METHOD
/begin COMPU_METHOD COMP_0007 "2km/h" RAT_FUNC "%8.2" "km/h" COEFFS 0 1 0 0 0 2 /end COMPU_METHOD
/begin COMPU_METHOD COMP_0047 "0.5%" RAT_FUNC "%8.2" "%" COEFFS 0 1 0 0 0 0.5 /end COMPU_METHOD
/begin COMPU_METHOD COMP_0163 "1/16%" RAT_FUNC "%8.3" "%" COEFFS 0 1 0 0 0 0.0625 /end COMPU_METHOD
/begin COMPU_METHOD COMP_0011_S "2sec" RAT_FUNC "%8.2" "sec" COEFFS 0 1 0 0 0 2 /end COMPU_METHOD
/begin COMPU_METHOD COMP_0486 "20/256mv" RAT_FUNC "%8.3" "mv" COEFFS 0 1 0 0 0 0.078125 /end COMPU_METHOD
/begin COMPU_METHOD COMP_0012_S "1A100ms" RAT_FUNC "%8.2" "A100ms" COEFFS 0 1 32768 0 0 1 /end COMPU_METHOD
/begin COMPU_METHOD COMP_0013_S "1/256A100ms" RAT_FUNC "%8.4" "A100ms" COEFFS 0 1 8388608 0 0 0.00390625 /end COMPU_METHOD
/begin COMPU_METHOD COMP_0353 "5mV" RAT_FUNC "%8.2" "mV" COEFFS 0 1 0 0 0 5 /end COMPU_METHOD
/begin COMPU_METHOD COMP_0018 "1deg" RAT_FUNC "%8.2" "deg" COEFFS 0 1 0 0 0 1 /end COMPU_METHOD
/begin COMPU_METHOD COMP_0019 "1degCA" RAT_FUNC "%8.2" "degCA" COEFFS 0 1 0 0 0 1 /end COMPU_METHOD
/begin COMPU_METHOD COMP_0014_S "1REF/deg" RAT_FUNC "%8.2" "REF/deg" COEFFS 0 1 0 0 0 1 /end COMPU_METHOD
/begin COMPU_METHOD COMP_0081 "1/256deg" RAT_FUNC "%8.4" "deg" COEFFS 0 1 0 0 0 0.00390625 /end COMPU_METHOD
/begin COMPU_METHOD COMP_0217 "1/16384-" RAT_FUNC "%8.6" "-" COEFFS 0 1 0 0 0 0.0000610352 /end COMPU_METHOD
/begin COMPU_METHOD COMP_0023 "5mV" RAT_FUNC "%8.2" "mV" COEFFS 0 1 0 0 0 5 /end COMPU_METHOD
/begin COMPU_METHOD COMP_0250 "4ms" RAT_FUNC "%8.2" "ms" COEFFS 0 1 0 0 0 4 /end COMPU_METHOD
/begin COMPU_METHOD COMP_0033 "80mV" RAT_FUNC "%8.2" "mV" COEFFS 0 1 0 0 0 80 /end COMPU_METHOD
/begin COMPU_METHOD COMP_0027 "1%" RAT_FUNC "%8.2" "%" COEFFS 0 1 0 0 0 1 /end COMPU_METHOD
/begin COMPU_METHOD COMP_0266 "64/128deg" RAT_FUNC "%8.2" "deg" COEFFS 0 1 0 0 0 0.5 /end COMPU_METHOD
/begin COMPU_METHOD COMP_0015_S "0.1sec" RAT_FUNC "%8.2" "sec" COEFFS 0 1 0 0 0 0.1 /end COMPU_METHOD
/begin COMPU_METHOD COMP_0016_S "0.5deg" RAT_FUNC "%8.2" "deg" COEFFS 0 1 0 0 0 0.5 /end COMPU_METHOD
/begin COMPU_METHOD COMP_0017_S "0.01sec" RAT_FUNC "%8.3" "sec" COEFFS 0 1 0 0 0 0.01 /end COMPU_METHOD
/begin COMPU_METHOD COMP_0061 "5mv" RAT_FUNC "%8.2" "mv" COEFFS 0 1 0 0 0 5 /end COMPU_METHOD
/begin COMPU_METHOD COMP_0049 "1sec" RAT_FUNC "%8.2" "sec" COEFFS 0 1 0 0 0 1 /end COMPU_METHOD
/begin COMPU_METHOD COMP_0032 "1/256－" RAT_FUNC "%8.4" "－" COEFFS 0 1 0 0 0 0.00390625 /end COMPU_METHOD
/begin COMPU_METHOD COMP_0066 "1/64－" RAT_FUNC "%8.3" "－" COEFFS 0 1 0 0 0 0.015625 /end COMPU_METHOD
/begin COMPU_METHOD COMP_0132 "1/512－" RAT_FUNC "%8.4" "－" COEFFS 0 1 0 0 0 0.001953125 /end COMPU_METHOD
/begin COMPU_METHOD COMP_0018_S "0.5/256-" RAT_FUNC "%8.4" "-" COEFFS 0 1 0 0 0 0.001953125 /end COMPU_METHOD
/begin COMPU_METHOD COMP_0063 "1/256-" RAT_FUNC "%8.4" "-" COEFFS 0 1 0 0 0 0.00390625 /end COMPU_METHOD
/begin COMPU_METHOD COMP_0015 "0.125－" RAT_FUNC "%8.2" "－" COEFFS 0 1 0 0 0 0.125 /end COMPU_METHOD
/begin COMPU_METHOD COMP_0464 "1/8-" RAT_FUNC "%8.2" "-" COEFFS 0 1 0 0 0 0.125 /end COMPU_METHOD
/begin COMPU_METHOD COMP_0370 "2.5mv" RAT_FUNC "%8.2" "mv" COEFFS 0 1 0 0 0 2.5 /end COMPU_METHOD
/begin COMPU_METHOD COMP_0093 "2.5mV" RAT_FUNC "%8.2" "mV" COEFFS 0 1 0 0 0 2.5 /end COMPU_METHOD
/begin COMPU_METHOD COMP_0019_S "1/255-" RAT_FUNC "%8.4" "-" COEFFS 0 1 0 0 0 0.003921569 /end COMPU_METHOD
/begin COMPU_METHOD COMP_0030 "1回" RAT_FUNC "%8.2" "回" COEFFS 0 1 0 0 0 1 /end COMPU_METHOD
/begin COMPU_METHOD COMP_0020_S "0.002-" RAT_FUNC "%8.4" "-" COEFFS 0 1 0 0 0 0.002 /end COMPU_METHOD
/begin COMPU_METHOD COMP_0021_S "1/8*25ms*rpm" RAT_FUNC "%8.2" "ms*rpm" COEFFS 0 1 0 0 0 3.125 /end COMPU_METHOD
/begin COMPU_METHOD COMP_0022_S "0.02－" RAT_FUNC "%8.3" "－" COEFFS 0 1 0 0 0 0.02 /end COMPU_METHOD
/begin COMPU_METHOD COMP_0016 "1count" RAT_FUNC "%8.2" "count" COEFFS 0 1 0 0 0 1 /end COMPU_METHOD
/begin COMPU_METHOD COMP_0202 "10msec" RAT_FUNC "%8.2" "msec" COEFFS 0 1 0 0 0 10 /end COMPU_METHOD
/begin COMPU_METHOD COMP_0023_S "1Nm/10ms" RAT_FUNC "%8.2" "Nm/10ms" COEFFS 0 1 0 0 0 1 /end COMPU_METHOD
/begin COMPU_METHOD COMP_0443 "1rpm" RAT_FUNC "%8.2" "rpm" COEFFS 0 1 0 0 0 1 /end COMPU_METHOD
/begin COMPU_METHOD COMP_0024_S "1rpm" RAT_FUNC "%8.2" "rpm" COEFFS 0 1 0 0 0 1 /end COMPU_METHOD
/begin COMPU_METHOD COMP_0228 "0.1Nm" RAT_FUNC "%8.2" "Nm" COEFFS 0 1 0 0 0 0.1 /end COMPU_METHOD
/begin COMPU_METHOD COMP_0436 "0.1km/h" RAT_FUNC "%8.2" "km/h" COEFFS 0 1 0 0 0 0.1 /end COMPU_METHOD
/begin COMPU_METHOD COMP_0263 "1-" RAT_FUNC "%8.2" "-" COEFFS 0 1 0 0 0 1 /end COMPU_METHOD
/begin COMPU_METHOD COMP_0025_S "1回" RAT_FUNC "%8.2" "回" COEFFS 0 1 0 0 0 1 /end COMPU_METHOD
/begin COMPU_METHOD COMP_0256 "64/128degCA" RAT_FUNC "%8.2" "degCA" COEFFS 0 1 64 0 0 0.5 /end COMPU_METHOD
/begin COMPU_METHOD COMP_0031 "1/256%" RAT_FUNC "%8.4" "%" COEFFS 0 1 0 0 0 0.00390625 /end COMPU_METHOD
/begin COMPU_METHOD COMP_0026_S "0.35deg/150m" RAT_FUNC "%8.2" "deg/150m" COEFFS 0 1 0 0 0 0.35 /end COMPU_METHOD
/begin COMPU_METHOD COMP_0027_S "5000Asec" RAT_FUNC "%8.2" "Asec" COEFFS 0 1 0 0 0 5000 /end COMPU_METHOD
/begin COMPU_METHOD COMP_0028_S "3.90625E-11cm**2/rp" RAT_FUNC "%8.6" "cm**2/rp" COEFFS 0 1 0 0 0 3.90625E-11 /end COMPU_METHOD
/begin COMPU_METHOD COMP_0065 "3.125rpm" RAT_FUNC "%8.2" "rpm" COEFFS 0 1 0 0 0 3.125 /end COMPU_METHOD
/begin COMPU_METHOD COMP_0048 "64/128degCA" RAT_FUNC "%8.2" "degCA" COEFFS 0 1 0 0 0 0.5 /end COMPU_METHOD
/begin COMPU_METHOD COMP_0029_S "4ms・rpm" RAT_FUNC "%8.2" "ms・rpm" COEFFS 0 1 0 0 0 4 /end COMPU_METHOD
/begin COMPU_METHOD COMP_0030_S "0.01X+1-" RAT_FUNC "%8.3" "-" COEFFS 0 1 -1 0 0 0.01 /end COMPU_METHOD
/begin COMPU_METHOD COMP_0031_S "0.00061MPa" RAT_FUNC "%8.5" "MPa" COEFFS 0 1 0 0 0 0.00061 /end COMPU_METHOD
/begin COMPU_METHOD COMP_0037 "3.125*10＾-6cm^2/%" RAT_FUNC "%8.6" "cm^2/%" COEFFS 0 1 0 0 0 0.000003125 /end COMPU_METHOD
/begin COMPU_METHOD COMP_0032_S "0.125%" RAT_FUNC "%8.2" "%" COEFFS 0 1 0 0 0 0.125 /end COMPU_METHOD
/begin COMPU_METHOD COMP_0033_S "1mm^2" RAT_FUNC "%8.2" "mm^2" COEFFS 0 1 0 0 0 1 /end COMPU_METHOD
/begin COMPU_METHOD COMP_0034_S "2^-8kPa" RAT_FUNC "%8.4" "kPa" COEFFS 0 1 0 0 0 0.00390625 /end COMPU_METHOD
/begin COMPU_METHOD COMP_0220 "1l/min" RAT_FUNC "%8.2" "l/min" COEFFS 0 1 0 0 0 1 /end COMPU_METHOD
/begin COMPU_METHOD COMP_0035_S "1l/min/se" RAT_FUNC "%8.2" "l/min/se" COEFFS 0 1 0 0 0 1 /end COMPU_METHOD
/begin COMPU_METHOD COMP_0173 "1/16-" RAT_FUNC "%8.3" "-" COEFFS 0 1 0 0 0 0.0625 /end COMPU_METHOD
/begin COMPU_METHOD COMP_0036_S "1A100ms" RAT_FUNC "%8.2" "A100ms" COEFFS 0 1 0 0 0 1 /end COMPU_METHOD
/begin COMPU_METHOD COMP_0037_S "256A･100ms" RAT_FUNC "%8.2" "A･100ms" COEFFS 0 1 0 0 0 256 /end COMPU_METHOD
/begin COMPU_METHOD COMP_0038_S "0.1Nm/100ms" RAT_FUNC "%8.2" "Nm/100ms" COEFFS 0 1 0 0 0 0.1 /end COMPU_METHOD
/begin COMPU_METHOD COMP_0039_S "1Pa" RAT_FUNC "%8.2" "Pa" COEFFS 0 1 -60000 0 0 1 /end COMPU_METHOD
/begin COMPU_METHOD COMP_0040_S "0.01s" RAT_FUNC "%8.3" "s" COEFFS 0 1 0 0 0 0.01 /end COMPU_METHOD
/begin COMPU_METHOD COMP_0041_S "1ｶｳﾝﾄ" RAT_FUNC "%8.2" "ｶｳﾝﾄ" COEFFS 0 1 0 0 0 1 /end COMPU_METHOD
/begin COMPU_METHOD COMP_0041 "0.0008cm^2" RAT_FUNC "%8.5" "cm^2" COEFFS 0 1 0 0 0 0.0008 /end COMPU_METHOD
/begin COMPU_METHOD COMP_0042 "0.0008cm**2" RAT_FUNC "%8.5" "cm**2" COEFFS 0 1 0 0 0 0.0008 /end COMPU_METHOD
/begin COMPU_METHOD COMP_0043 "1/(256*4)－" RAT_FUNC "%8.5" "－" COEFFS 0 1 0 0 0 0.000976563 /end COMPU_METHOD
/begin COMPU_METHOD COMP_0044 "1/128－" RAT_FUNC "%8.4" "－" COEFFS 0 1 0 0 0 0.0078125 /end COMPU_METHOD
/begin COMPU_METHOD COMP_0042_S "0.0081/10^3/m" RAT_FUNC "%8.4" "1/10^3/m" COEFFS 0 1 0 0 0 0.008 /end COMPU_METHOD
/begin COMPU_METHOD COMP_0043_S "2^-15m^2*10^3" RAT_FUNC "%8.6" "m^2*10^3" COEFFS 0 1 0 0 0 0.0000305176 /end COMPU_METHOD
/begin COMPU_METHOD COMP_0044_S "1/(256*8)A/mV" RAT_FUNC "%8.5" "A/mV" COEFFS 0 1 0 0 0 0.000488281 /end COMPU_METHOD
/begin COMPU_METHOD COMP_0045_S "1A" RAT_FUNC "%8.2" "A" COEFFS 0 1 0 0 0 1 /end COMPU_METHOD
/begin COMPU_METHOD COMP_0046_S "1/256A" RAT_FUNC "%8.4" "A" COEFFS 0 1 0 0 0 0.00390625 /end COMPU_METHOD
/begin COMPU_METHOD COMP_0047_S "1/(256*16)A/mV" RAT_FUNC "%8.5" "A/mV" COEFFS 0 1 0 0 0 0.00024414 /end COMPU_METHOD
/begin COMPU_METHOD COMP_0048_S "2^-3deg" RAT_FUNC "%8.2" "deg" COEFFS 0 1 0 0 0 0.125 /end COMPU_METHOD
/begin COMPU_METHOD COMP_0049_S "2^-3deg" RAT_FUNC "%8.2" "deg" COEFFS 0 1 31.875 0 0 0.125 /end COMPU_METHOD
/begin COMPU_METHOD COMP_0050_S "0.5V" RAT_FUNC "%8.2" "V" COEFFS 0 1 0 0 0 0.5 /end COMPU_METHOD
/begin COMPU_METHOD COMP_0054 "20mV" RAT_FUNC "%8.2" "mV" COEFFS 0 1 0 0 0 20 /end COMPU_METHOD
/begin COMPU_METHOD COMP_0051_S "0.11deg/50ms" RAT_FUNC "%8.2" "deg/50ms" COEFFS 0 1 0 0 0 0.11 /end COMPU_METHOD
/begin COMPU_METHOD COMP_0052_S "0.125%/10ms" RAT_FUNC "%8.2" "%/10ms" COEFFS 0 1 0 0 0 0.125 /end COMPU_METHOD
/begin COMPU_METHOD COMP_0046 "1l/min" RAT_FUNC "%8.2" "l/min" COEFFS 0 1 0 0 0 1 /end COMPU_METHOD
/begin COMPU_METHOD COMP_0053_S "2^-1deg" RAT_FUNC "%8.2" "deg" COEFFS 0 1 64 0 0 0.5 /end COMPU_METHOD
/begin COMPU_METHOD COMP_0450 "1/1024-" RAT_FUNC "%8.5" "-" COEFFS 0 1 0 0 0 0.000976563 /end COMPU_METHOD
/begin COMPU_METHOD COMP_0054_S "4/256deg/oct" RAT_FUNC "%8.3" "deg/oct" COEFFS 0 1 0 0 0 0.015625 /end COMPU_METHOD
/begin COMPU_METHOD COMP_0055_S "2^-81/%" RAT_FUNC "%8.4" "1/%" COEFFS 0 1 0 0 0 0.00390625 /end COMPU_METHOD
/begin COMPU_METHOD COMP_0056_S "0.05%" RAT_FUNC "%8.3" "%" COEFFS 0 1 0 0 0 0.05 /end COMPU_METHOD
/begin COMPU_METHOD COMP_0419 "0.1%" RAT_FUNC "%8.2" "%" COEFFS 0 1 0 0 0 0.1 /end COMPU_METHOD
/begin COMPU_METHOD COMP_0057_S "0.1deg" RAT_FUNC "%8.2" "deg" COEFFS 0 1 0 0 0 0.1 /end COMPU_METHOD
/begin COMPU_METHOD COMP_0055 "4deg" RAT_FUNC "%8.2" "deg" COEFFS 0 1 0 0 0 4 /end COMPU_METHOD
/begin COMPU_METHOD COMP_0056 "25rmp" RAT_FUNC "%8.2" "rmp" COEFFS 0 1 0 0 0 25 /end COMPU_METHOD
/begin COMPU_METHOD COMP_0169 "1/255－" RAT_FUNC "%8.4" "－" COEFFS 0 1 0 0 0 0.003921569 /end COMPU_METHOD
/begin COMPU_METHOD COMP_0058_S "100A100ms" RAT_FUNC "%8.2" "A100ms" COEFFS 0 1 0 0 0 100 /end COMPU_METHOD
/begin COMPU_METHOD COMP_0059_S "0.125A" RAT_FUNC "%8.2" "A" COEFFS 0 1 0 0 0 0.125 /end COMPU_METHOD
/begin COMPU_METHOD COMP_0105 "0.1s" RAT_FUNC "%8.2" "s" COEFFS 0 1 0 0 0 0.1 /end COMPU_METHOD
/begin COMPU_METHOD COMP_0060_S "0.00001℃/℃/se" RAT_FUNC "%8.6" "℃/℃/se" COEFFS 0 1 0 0 0 0.00001 /end COMPU_METHOD
/begin COMPU_METHOD COMP_0290 "1/65536-" RAT_FUNC "%8.6" "-" COEFFS 0 1 0 0 0 0.0000152588 /end COMPU_METHOD
/begin COMPU_METHOD COMP_0070 "12.5rpm/s" RAT_FUNC "%8.2" "rpm/s" COEFFS 0 1 0 0 0 12.5 /end COMPU_METHOD
/begin COMPU_METHOD COMP_0071 "1rev" RAT_FUNC "%8.2" "rev" COEFFS 0 1 0 0 0 1 /end COMPU_METHOD
/begin COMPU_METHOD COMP_0144 "1/2048ms" RAT_FUNC "%8.5" "ms" COEFFS 0 1 0 0 0 0.000488281 /end COMPU_METHOD
/begin COMPU_METHOD COMP_0026 "80mv" RAT_FUNC "%8.2" "mv" COEFFS 0 1 0 0 0 80 /end COMPU_METHOD
/begin COMPU_METHOD COMP_0061_S "0.0001-" RAT_FUNC "%8.5" "-" COEFFS 0 1 0 0 0 0.0001 /end COMPU_METHOD
/begin COMPU_METHOD COMP_0062_S "1ms/2^(ST" RAT_FUNC "%8.2" "ms/2^(ST" COEFFS 0 1 0 0 0 1 /end COMPU_METHOD
/begin COMPU_METHOD COMP_0063_S "1/255count" RAT_FUNC "%8.4" "count" COEFFS 0 1 0 0 0 0.00392157 /end COMPU_METHOD
/begin COMPU_METHOD COMP_0064_S "1N" RAT_FUNC "%8.2" "N" COEFFS 0 1 0 0 0 1 /end COMPU_METHOD
/begin COMPU_METHOD COMP_0065_S "1/64kPa" RAT_FUNC "%8.3" "kPa" COEFFS 0 1 0 0 0 0.015625 /end COMPU_METHOD
/begin COMPU_METHOD COMP_0215 "0.2sec" RAT_FUNC "%8.2" "sec" COEFFS 0 1 0 0 0 0.2 /end COMPU_METHOD
/begin COMPU_METHOD COMP_0287 "1REF" RAT_FUNC "%8.2" "REF" COEFFS 0 1 0 0 0 1 /end COMPU_METHOD
/begin COMPU_METHOD COMP_0066_S "0.1degC" RAT_FUNC "%8.2" "degC" COEFFS 0 1 0 0 0 0.1 /end COMPU_METHOD
/begin COMPU_METHOD COMP_0067_S "0.5A" RAT_FUNC "%8.2" "A" COEFFS 0 1 0 0 0 0.5 /end COMPU_METHOD
/begin COMPU_METHOD COMP_0068_S "0.01L/min/A" RAT_FUNC "%8.3" "L/min/A" COEFFS 0 1 0 0 0 0.01 /end COMPU_METHOD
/begin COMPU_METHOD COMP_0069_S "1℃" RAT_FUNC "%8.2" "℃" COEFFS 0 1 50 0 0 1 /end COMPU_METHOD
/begin COMPU_METHOD COMP_0070_S "1/655361/10ms" RAT_FUNC "%8.6" "1/10ms" COEFFS 0 1 0 0 0 0.0000152588 /end COMPU_METHOD
/begin COMPU_METHOD COMP_0071_S "0.000000625m" RAT_FUNC "%8.6" "m" COEFFS 0 1 0 0 0 0.000000625 /end COMPU_METHOD
/begin COMPU_METHOD COMP_0072_S "0.004-" RAT_FUNC "%8.4" "-" COEFFS 0 1 0 0 0 0.004 /end COMPU_METHOD
/begin COMPU_METHOD COMP_0021 "100/256%" RAT_FUNC "%8.2" "%" COEFFS 0 1 0 0 0 0.390625 /end COMPU_METHOD
/begin COMPU_METHOD COMP_0078 "1/256deg" RAT_FUNC "%8.4" "deg" COEFFS 0 1 0 0 0 0.00390625 /end COMPU_METHOD
/begin COMPU_METHOD COMP_0073_S "1deg/ref" RAT_FUNC "%8.2" "deg/ref" COEFFS 0 1 0 0 0 1 /end COMPU_METHOD
/begin COMPU_METHOD COMP_0074_S "5mV/sec" RAT_FUNC "%8.2" "mV/sec" COEFFS 0 1 0 0 0 5 /end COMPU_METHOD
/begin COMPU_METHOD COMP_0038 "0.11deg/10ms" RAT_FUNC "%8.2" "deg/10ms" COEFFS 0 1 0 0 0 0.11 /end COMPU_METHOD
/begin COMPU_METHOD COMP_0075_S "0.5sec" RAT_FUNC "%8.2" "sec" COEFFS 0 1 0 0 0 0.5 /end COMPU_METHOD
/begin COMPU_METHOD COMP_0085 "100/256/0.11deg" RAT_FUNC "%8.2" "/0.11deg" COEFFS 0 1 0 0 0 0.390625 /end COMPU_METHOD
/begin COMPU_METHOD COMP_0076_S "2/2561/min/10" RAT_FUNC "%8.4" "1/min/10" COEFFS 0 1 0 0 0 0.0078125 /end COMPU_METHOD
/begin COMPU_METHOD COMP_0077_S "1x10ms" RAT_FUNC "%8.2" "x10ms" COEFFS 0 1 0 0 0 1 /end COMPU_METHOD
/begin COMPU_METHOD COMP_0078_S "1/256L" RAT_FUNC "%8.4" "L" COEFFS 0 1 0 0 0 0.00390625 /end COMPU_METHOD
/begin COMPU_METHOD COMP_0079_S "4X-20℃" RAT_FUNC "%8.2" "℃" COEFFS 0 1 20 0 0 4 /end COMPU_METHOD
/begin COMPU_METHOD COMP_0091 "ﾌﾗｸﾞﾌﾗｸﾞ" RAT_FUNC "%8.2" "ﾌﾗｸﾞ" COEFFS 0 1 0 0 0 1 /end COMPU_METHOD
/begin COMPU_METHOD COMP_0080_S "フラグフラグ" RAT_FUNC "%8.2" "フラグ" COEFFS 0 1 0 0 0 1 /end COMPU_METHOD
/begin COMPU_METHOD COMP_0081_S "100/256%/100ms" RAT_FUNC "%8.2" "%/100ms" COEFFS 0 1 0 0 0 0.390625 /end COMPU_METHOD
/begin COMPU_METHOD COMP_0095 "400/256%" RAT_FUNC "%8.2" "%" COEFFS 0 1 0 0 0 1.5625 /end COMPU_METHOD
/begin COMPU_METHOD COMP_0082_S "1rpm/50ms" RAT_FUNC "%8.2" "rpm/50ms" COEFFS 0 1 0 0 0 1 /end COMPU_METHOD
/begin COMPU_METHOD COMP_0096 "10s" RAT_FUNC "%8.2" "s" COEFFS 0 1 0 0 0 10 /end COMPU_METHOD
/begin COMPU_METHOD COMP_0083_S "1/64L/min/10" RAT_FUNC "%8.3" "L/min/10" COEFFS 0 1 0 0 0 0.015625 /end COMPU_METHOD
/begin COMPU_METHOD COMP_0051 "1L/min" RAT_FUNC "%8.2" "L/min" COEFFS 0 1 0 0 0 1 /end COMPU_METHOD
/begin COMPU_METHOD COMP_0097 "1/64L/min" RAT_FUNC "%8.3" "L/min" COEFFS 0 1 0 0 0 0.015625 /end COMPU_METHOD
/begin COMPU_METHOD COMP_0084_S "2/256L/min/10" RAT_FUNC "%8.4" "L/min/10" COEFFS 0 1 0 0 0 0.0078125 /end COMPU_METHOD
/begin COMPU_METHOD COMP_0456 "1/(256×128)-" RAT_FUNC "%8.6" "-" COEFFS 0 1 0 0 0 0.0000305176 /end COMPU_METHOD
/begin COMPU_METHOD COMP_0085_S "0.05-" RAT_FUNC "%8.3" "-" COEFFS 0 1 0 0 0 0.05 /end COMPU_METHOD
/begin COMPU_METHOD COMP_0100 "1/163841/10ms" RAT_FUNC "%8.6" "1/10ms" COEFFS 0 1 0 0 0 0.0000610352 /end COMPU_METHOD
/begin COMPU_METHOD COMP_0101 "1/65536－" RAT_FUNC "%8.6" "－" COEFFS 0 1 0 0 0 0.0000152588 /end COMPU_METHOD
/begin COMPU_METHOD COMP_0102 "20mV/s" RAT_FUNC "%8.2" "mV/s" COEFFS 0 1 0 0 0 20 /end COMPU_METHOD
/begin COMPU_METHOD COMP_0086_S "0.07808Mpa" RAT_FUNC "%8.3" "Mpa" COEFFS 0 1 0 0 0 0.07808 /end COMPU_METHOD
/begin COMPU_METHOD COMP_0087_S "0.07808MPa" RAT_FUNC "%8.3" "MPa" COEFFS 0 1 0 0 0 0.07808 /end COMPU_METHOD
/begin COMPU_METHOD COMP_0088_S "0.01%/sec" RAT_FUNC "%8.3" "%/sec" COEFFS 0 1 0 0 0 0.01 /end COMPU_METHOD
/begin COMPU_METHOD COMP_0089_S "3.6_*_2^-22km/h/50m" RAT_FUNC "%8.6" "km/h/50m" COEFFS 0 1 0 0 0 0.000000858307 /end COMPU_METHOD
/begin COMPU_METHOD COMP_0090_S "0.2%" RAT_FUNC "%8.2" "%" COEFFS 0 1 0 0 0 0.2 /end COMPU_METHOD
/begin COMPU_METHOD COMP_0091_S "0.1%/sec" RAT_FUNC "%8.2" "%/sec" COEFFS 0 1 0 0 0 0.1 /end COMPU_METHOD
/begin COMPU_METHOD COMP_0092_S "0.025kg/h" RAT_FUNC "%8.3" "kg/h" COEFFS 0 1 0 0 0 0.025 /end COMPU_METHOD
/begin COMPU_METHOD COMP_0093_S "1/10241/10ms" RAT_FUNC "%8.5" "1/10ms" COEFFS 0 1 0 0 0 0.000976563 /end COMPU_METHOD
/begin COMPU_METHOD COMP_0106 "1/(8*256)－" RAT_FUNC "%8.5" "－" COEFFS 0 1 0 0 0 0.000488 /end COMPU_METHOD
/begin COMPU_METHOD COMP_0156 "1L" RAT_FUNC "%8.2" "L" COEFFS 0 1 0 0 0 1 /end COMPU_METHOD
/begin COMPU_METHOD COMP_0094_S "4.882*10＾-61/rpm" RAT_FUNC "%8.6" "1/rpm" COEFFS 0 1 0 0 0 0.000004882 /end COMPU_METHOD
/begin COMPU_METHOD COMP_0095_S "0.78125rpm/(0.6" RAT_FUNC "%8.2" "rpm/(0.6" COEFFS 0 1 0 0 0 0.78125 /end COMPU_METHOD
/begin COMPU_METHOD COMP_0096_S "1/255-" RAT_FUNC "%8.4" "-" COEFFS 0 1 0 0 0 0.00392157 /end COMPU_METHOD
/begin COMPU_METHOD COMP_0111 "256/x－" RAT_FUNC "%8.2" "－" COEFFS 0 0 256 0 1 0 /end COMPU_METHOD
/begin COMPU_METHOD COMP_0234 "10sec" RAT_FUNC "%8.2" "sec" COEFFS 0 1 0 0 0 10 /end COMPU_METHOD
/begin COMPU_METHOD COMP_0097_S "256/x-" RAT_FUNC "%8.2" "-" COEFFS 0 0 256 0 1 0 /end COMPU_METHOD
/begin COMPU_METHOD COMP_0308 "1℃" RAT_FUNC "%8.2" "℃" COEFFS 0 1 0 0 0 1 /end COMPU_METHOD
/begin COMPU_METHOD COMP_0098_S "100/65536%/40ms" RAT_FUNC "%8.4" "%/40ms" COEFFS 0 1 0 0 0 0.00152588 /end COMPU_METHOD
/begin COMPU_METHOD COMP_0115 "100/65536%" RAT_FUNC "%8.4" "%" COEFFS 0 1 0 0 0 0.0015259 /end COMPU_METHOD
/begin COMPU_METHOD COMP_0099_S "1/256/20l/min/mV" RAT_FUNC "%8.5" "l/min/mV" COEFFS 0 1 0 0 0 0.000195 /end COMPU_METHOD
/begin COMPU_METHOD COMP_0050 "5/64mV" RAT_FUNC "%8.3" "mV" COEFFS 0 1 0 0 0 0.078125 /end COMPU_METHOD
/begin COMPU_METHOD COMP_0069 "1/(128*256)－" RAT_FUNC "%8.6" "－" COEFFS 0 1 0 0 0 0.0000305176 /end COMPU_METHOD
/begin COMPU_METHOD COMP_0283 "1flag" RAT_FUNC "%8.2" "flag" COEFFS 0 1 0 0 0 1 /end COMPU_METHOD
/begin COMPU_METHOD COMP_0100_S "0.0078125%/10ms" RAT_FUNC "%8.4" "%/10ms" COEFFS 0 1 0 0 0 0.0078125 /end COMPU_METHOD
/begin COMPU_METHOD COMP_0196 "0.1Nm" RAT_FUNC "%8.2" "Nm" COEFFS 0 1 0 0 0 0.1 /end COMPU_METHOD
/begin COMPU_METHOD COMP_0101_S "2/256l/min/10" RAT_FUNC "%8.4" "l/min/10" COEFFS 0 1 0 0 0 0.0078125 /end COMPU_METHOD
/* RECORD_LAYOUT ------------------------------------------------------ */
/begin RECORD_LAYOUT REC_UBYTE_C FNC_VALUES 1 UBYTE COLUMN_DIR DIRECT /end RECORD_LAYOUT
/begin RECORD_LAYOUT REC_SWORD_C FNC_VALUES 1 SWORD COLUMN_DIR DIRECT /end RECORD_LAYOUT
/begin RECORD_LAYOUT REC_UWORD_C FNC_VALUES 1 UWORD COLUMN_DIR DIRECT /end RECORD_LAYOUT
/begin RECORD_LAYOUT REC_SBYTE_C FNC_VALUES 1 SBYTE COLUMN_DIR DIRECT /end RECORD_LAYOUT
/begin RECORD_LAYOUT REC_SLONG_C FNC_VALUES 1 SLONG COLUMN_DIR DIRECT /end RECORD_LAYOUT
/begin RECORD_LAYOUT REC_ULONG_C FNC_VALUES 1 ULONG COLUMN_DIR DIRECT /end RECORD_LAYOUT
/end MODULE
/end PROJECT
