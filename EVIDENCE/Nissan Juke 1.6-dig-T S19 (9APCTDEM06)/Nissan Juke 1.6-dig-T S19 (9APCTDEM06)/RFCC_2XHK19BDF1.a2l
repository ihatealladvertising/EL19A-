/begin PROJECT X12C_KH3DT_DI_NAM_R/C ""
/begin HEADER "" /* key HEADER ++ "comment" に Par.scomment */ PROJECT_NO X12C_KH3DT_DI_NAM_R/C /* key PROJECT_NO ++ project number に car_eng_desti_lot */ VERSION "0KHDCFDZ7" /* key VERSION ++ version number に mProgver */ /end HEADER
/begin MODULE DIM ""
/begin MOD_COMMON "" ALIGNMENT_BYTE 1 ALIGNMENT_WORD 2 ALIGNMENT_LONG 4 ALIGNMENT_FLOAT32_IEEE 4 ALIGNMENT_FLOAT64_IEEE 4 DEPOSIT ABSOLUTE BYTE_ORDER MSB_FIRST /* ﾊﾞｲﾄｵｰﾀﾞｰがﾘﾌﾟﾚｰｽされる */ /end MOD_COMMON
/begin CHARACTERISTIC mNSETRMIN "ROM Const mNSETRMIN" VALUE 0x000088A2 REC_UBYTE_C 0 COMP_0006 0 3187.5 /end CHARACTERISTIC
/begin CHARACTERISTIC mNSETST "ROM Const mNSETST" VALUE 0x0000823C REC_SBYTE_C 0 COMP_0262 -1600 1587.5 /end CHARACTERISTIC
/begin CHARACTERISTIC mNSETWIP "ROM Const mNSETWIP" VALUE 0x000088A3 REC_UBYTE_C 0 COMP_0006 0 3187.5 /end CHARACTERISTIC
/begin CHARACTERISTIC mNSISCI1 "ROM Const mNSISCI1" VALUE 0x000088A4 REC_UBYTE_C 0 COMP_0004 0 255 /end CHARACTERISTIC
/begin CHARACTERISTIC mNSISCI2 "ROM Const mNSISCI2" VALUE 0x000088A5 REC_UBYTE_C 0 COMP_0004 0 255 /end CHARACTERISTIC
/begin CHARACTERISTIC mNSTOFFA "ROM Const mNSTOFFA" VALUE 0x000088A6 REC_UBYTE_C 0 COMP_0006 0 3187.5 /end CHARACTERISTIC
/begin CHARACTERISTIC mNSTON2 "ROM Const mNSTON2" VALUE 0x000088A7 REC_UBYTE_C 0 COMP_0006 0 3187.5 /end CHARACTERISTIC
/begin CHARACTERISTIC mNTARTD "ROM Const mNTARTD" VALUE 0x000088A8 REC_UBYTE_C 0 COMP_0020 0 12750 /end CHARACTERISTIC
/begin CHARACTERISTIC mNTPSEL "ROM Const mNTPSEL" VALUE 0x00009324 REC_UWORD_C 0 COMP_0006 0 819187.5 /end CHARACTERISTIC
/begin CHARACTERISTIC mNTURBO "ROM Const mNTURBO" VALUE 0x000088A9 REC_UBYTE_C 0 COMP_0068 0 255 /end CHARACTERISTIC
/begin CHARACTERISTIC mNTVQL "ROM Const mNTVQL" VALUE 0x00009326 REC_UWORD_C 0 COMP_0068 0 65535 /end CHARACTERISTIC
/begin CHARACTERISTIC mNTVQLS "ROM Const mNTVQLS" VALUE 0x000088AA REC_UBYTE_C 0 COMP_0068 0 255 /end CHARACTERISTIC
/begin CHARACTERISTIC mNTVQLSR "ROM Const mNTVQLSR" VALUE 0x00009328 REC_UWORD_C 0 COMP_0068 0 65535 /end CHARACTERISTIC
/begin CHARACTERISTIC mNUPINJT2 "ROM Const mNUPINJT2" VALUE 0x000088AB REC_UBYTE_C 0 COMP_0035 -50 205 /end CHARACTERISTIC
/begin CHARACTERISTIC mNUPINJTA "ROM Const mNUPINJTA" VALUE 0x000088AC REC_UBYTE_C 0 COMP_0035 -50 205 /end CHARACTERISTIC
/begin CHARACTERISTIC mNWTOFI "ROM Const mNWTOFI" VALUE 0x000088AD REC_UBYTE_C 0 COMP_0051 0 255 /end CHARACTERISTIC
/begin CHARACTERISTIC mO2CYL "ROM Const mO2CYL" VALUE 0x000088AE REC_UBYTE_C 0 COMP_0251 0 255 /end CHARACTERISTIC
/begin CHARACTERISTIC mO2DTYMX1 "ROM Const mO2DTYMX1" VALUE 0x000088AF REC_UBYTE_C 0 COMP_0200_S 0 2550 /end CHARACTERISTIC
/begin CHARACTERISTIC mO2DTYMX2 "ROM Const mO2DTYMX2" VALUE 0x000088B0 REC_UBYTE_C 0 COMP_0200_S 0 2550 /end CHARACTERISTIC
/begin CHARACTERISTIC mO2HCMNA "ROM Const mO2HCMNA" VALUE 0x000088B1 REC_UBYTE_C 0 COMP_0022 0 5100 /end CHARACTERISTIC
/begin CHARACTERISTIC mO2HCMXA "ROM Const mO2HCMXA" VALUE 0x000088B2 REC_UBYTE_C 0 COMP_0022 0 5100 /end CHARACTERISTIC
/begin CHARACTERISTIC mO2HCTD "ROM Const mO2HCTD" VALUE 0x000088B3 REC_UBYTE_C 0 COMP_0008 0 25500 /end CHARACTERISTIC
/begin CHARACTERISTIC mO2HN "ROM Const mO2HN" VALUE 0x000088B4 REC_UBYTE_C 0 COMP_0000 0 6375 /end CHARACTERISTIC
/begin CHARACTERISTIC mO2HRDY "ROM Const mO2HRDY" VALUE 0x000088B5 REC_UBYTE_C 0 COMP_0049 0 255 /end CHARACTERISTIC
/begin CHARACTERISTIC mO2HRN "ROM Const mO2HRN" VALUE 0x000088B6 REC_UBYTE_C 0 COMP_0000 0 6375 /end CHARACTERISTIC
/begin CHARACTERISTIC mO2HROD "ROM Const mO2HROD" VALUE 0x000088B7 REC_UBYTE_C 0 COMP_0049 0 255 /end CHARACTERISTIC
/begin CHARACTERISTIC mO2HRTP "ROM Const mO2HRTP" VALUE 0x000088B8 REC_UBYTE_C 0 COMP_0001 0 31.875 /end CHARACTERISTIC
/begin CHARACTERISTIC mO2HSUMQM "ROM Const mO2HSUMQM" VALUE 0x000097CC REC_ULONG_C 0 COMP_0068 0 4294967295 /end CHARACTERISTIC
/begin CHARACTERISTIC mO2HTCR "ROM Const mO2HTCR" VALUE 0x000088B9 REC_UBYTE_C 0 COMP_0062 0 1020 /end CHARACTERISTIC
/begin CHARACTERISTIC mO2HTP "ROM Const mO2HTP" VALUE 0x000088BA REC_UBYTE_C 0 COMP_0001 0 31.875 /end CHARACTERISTIC
/begin CHARACTERISTIC mO2HTWN1 "ROM Const mO2HTWN1" VALUE 0x000088BB REC_UBYTE_C 0 COMP_0035 -50 205 /end CHARACTERISTIC
/begin CHARACTERISTIC mO2HTWN2 "ROM Const mO2HTWN2" VALUE 0x000088BC REC_UBYTE_C 0 COMP_0035 -50 205 /end CHARACTERISTIC
/begin CHARACTERISTIC mO2HTWN3 "ROM Const mO2HTWN3" VALUE 0x000088BD REC_UBYTE_C 0 COMP_0035 -50 205 /end CHARACTERISTIC
/begin CHARACTERISTIC mO2NGTMA "ROM Const mO2NGTMA" VALUE 0x000088BE REC_UBYTE_C 0 COMP_0014 0 2550 /end CHARACTERISTIC
/begin CHARACTERISTIC mO2REF "ROM Const mO2REF" VALUE 0x000088BF REC_UBYTE_C 0 COMP_0251 0 255 /end CHARACTERISTIC
/begin CHARACTERISTIC mO2STINI1 "ROM Const mO2STINI1" VALUE 0x000088C1 REC_UBYTE_C 0 COMP_0200_S 0 2550 /end CHARACTERISTIC
/begin CHARACTERISTIC mO2STINI2 "ROM Const mO2STINI2" VALUE 0x000088C2 REC_UBYTE_C 0 COMP_0200_S 0 2550 /end CHARACTERISTIC
/begin CHARACTERISTIC mO2STINI3 "ROM Const mO2STINI3" VALUE 0x000088C3 REC_UBYTE_C 0 COMP_0200_S 0 2550 /end CHARACTERISTIC
/begin CHARACTERISTIC mO2STINI4 "ROM Const mO2STINI4" VALUE 0x000088C4 REC_UBYTE_C 0 COMP_0200_S 0 2550 /end CHARACTERISTIC
/begin CHARACTERISTIC mO2TMHMX1 "ROM Const mO2TMHMX1" VALUE 0x000088C5 REC_UBYTE_C 0 COMP_0008 0 25500 /end CHARACTERISTIC
/begin CHARACTERISTIC mO2UPDTY "ROM Const mO2UPDTY" VALUE 0x000088C6 REC_UBYTE_C 0 COMP_0187_S 0 9.9609375 /end CHARACTERISTIC
/begin CHARACTERISTIC mOBSTNG "ROM Const mOBSTNG" VALUE 0x000088D3 REC_UBYTE_C 0 COMP_0030 0 255 /end CHARACTERISTIC
/begin CHARACTERISTIC mOCTH "ROM Const mOCTH" VALUE 0x000088D4 REC_UBYTE_C 0 COMP_0201_S 75 106.875 /end CHARACTERISTIC
/begin CHARACTERISTIC mOCTR "ROM Const mOCTR" VALUE 0x000088D5 REC_UBYTE_C 0 COMP_0201_S 75 106.875 /end CHARACTERISTIC
/begin CHARACTERISTIC mODACCT "ROM Const mODACCT" VALUE 0x000088D6 REC_UBYTE_C 0 COMP_0008 0 25500 /end CHARACTERISTIC
/begin CHARACTERISTIC mODBNRN "ROM Const mODBNRN" VALUE 0x000088D7 REC_UBYTE_C 0 COMP_0008 0 25500 /end CHARACTERISTIC
/begin CHARACTERISTIC mODBNRS "ROM Const mODBNRS" VALUE 0x000088D8 REC_UBYTE_C 0 COMP_0008 0 25500 /end CHARACTERISTIC
/begin CHARACTERISTIC mODBNTP "ROM Const mODBNTP" VALUE 0x000088D9 REC_UBYTE_C 0 COMP_0008 0 25500 /end CHARACTERISTIC
/begin CHARACTERISTIC mODBNVP "ROM Const mODBNVP" VALUE 0x00009730 REC_SLONG_C 0 COMP_0144_S -1843.20024746394 1843.20024660563 /end CHARACTERISTIC
/begin CHARACTERISTIC mODCANDLY "ROM Const mODCANDLY" VALUE 0x000088DA REC_UBYTE_C 0 COMP_0024 0 12750 /end CHARACTERISTIC
/begin CHARACTERISTIC mODCANTFW "ROM Const mODCANTFW" VALUE 0x000088DB REC_UBYTE_C 0 COMP_0009 0 199.21875 /end CHARACTERISTIC
/begin CHARACTERISTIC mODCNAC "ROM Const mODCNAC" VALUE 0x00009734 REC_SLONG_C 0 COMP_0006_S -512.000903872512 512.000903634093 /end CHARACTERISTIC
/begin CHARACTERISTIC mODCNNR "ROM Const mODCNNR" VALUE 0x00009738 REC_SLONG_C 0 COMP_0144_S -1843.20024746394 1843.20024660563 /end CHARACTERISTIC
/begin CHARACTERISTIC mODCNRN "ROM Const mODCNRN" VALUE 0x000088DC REC_UBYTE_C 0 COMP_0008 0 25500 /end CHARACTERISTIC
/begin CHARACTERISTIC mODCNVP "ROM Const mODCNVP" VALUE 0x0000973C REC_SLONG_C 0 COMP_0144_S -1843.20024746394 1843.20024660563 /end CHARACTERISTIC
/begin CHARACTERISTIC mODGP "ROM Const mODGP" VALUE 0x000088DD REC_UBYTE_C 0 COMP_0068 0 255 /end CHARACTERISTIC
/begin CHARACTERISTIC mODLNAC "ROM Const mODLNAC" VALUE 0x00009740 REC_SLONG_C 0 COMP_0006_S -512.000903872512 512.000903634093 /end CHARACTERISTIC
/begin CHARACTERISTIC mODLNNR "ROM Const mODLNNR" VALUE 0x00009744 REC_SLONG_C 0 COMP_0144_S -1843.20024746394 1843.20024660563 /end CHARACTERISTIC
/begin CHARACTERISTIC mODOFTM "ROM Const mODOFTM" VALUE 0x000088DE REC_UBYTE_C 0 COMP_0013 0 255 /end CHARACTERISTIC
/begin CHARACTERISTIC mODRNVP "ROM Const mODRNVP" VALUE 0x00009748 REC_SLONG_C 0 COMP_0144_S -1843.20024746394 1843.20024660563 /end CHARACTERISTIC
/begin CHARACTERISTIC mOFAGCBE "ROM Const mOFAGCBE" VALUE 0x000088DF REC_UBYTE_C 0 COMP_0048 0 127.5 /end CHARACTERISTIC
/begin CHARACTERISTIC mOFAGCFE "ROM Const mOFAGCFE" VALUE 0x000088E0 REC_UBYTE_C 0 COMP_0048 0 127.5 /end CHARACTERISTIC
/begin CHARACTERISTIC mOFAGOBE "ROM Const mOFAGOBE" VALUE 0x000088E1 REC_UBYTE_C 0 COMP_0048 0 127.5 /end CHARACTERISTIC
/begin CHARACTERISTIC mOFAGOFE "ROM Const mOFAGOFE" VALUE 0x000088E2 REC_UBYTE_C 0 COMP_0048 0 127.5 /end CHARACTERISTIC
/begin CHARACTERISTIC mOFAGOPAE "ROM Const mOFAGOPAE" VALUE 0x000088E3 REC_UBYTE_C 0 COMP_0048 0 127.5 /end CHARACTERISTIC
/begin CHARACTERISTIC mOFAGOPRE "ROM Const mOFAGOPRE" VALUE 0x000088E4 REC_UBYTE_C 0 COMP_0048 0 127.5 /end CHARACTERISTIC
/begin CHARACTERISTIC mOFANGCB "ROM Const mOFANGCB" VALUE 0x000088E5 REC_UBYTE_C 0 COMP_0048 0 127.5 /end CHARACTERISTIC
/begin CHARACTERISTIC mOFANGCF "ROM Const mOFANGCF" VALUE 0x000088E6 REC_UBYTE_C 0 COMP_0048 0 127.5 /end CHARACTERISTIC
/begin CHARACTERISTIC mOFANGOB "ROM Const mOFANGOB" VALUE 0x000088E7 REC_UBYTE_C 0 COMP_0048 0 127.5 /end CHARACTERISTIC
/begin CHARACTERISTIC mOFANGOF "ROM Const mOFANGOF" VALUE 0x000088E8 REC_UBYTE_C 0 COMP_0048 0 127.5 /end CHARACTERISTIC
/begin CHARACTERISTIC mOFCHYS "ROM Const mOFCHYS" VALUE 0x000088E9 REC_UBYTE_C 0 COMP_0000 0 6375 /end CHARACTERISTIC
/begin CHARACTERISTIC mOFEMP "ROM Const mOFEMP" VALUE 0x0000932A REC_UWORD_C 0 COMP_0050 0 5119.921875 /end CHARACTERISTIC
/begin CHARACTERISTIC mOFSREF "ROM Const mOFSREF" VALUE 0x000088EA REC_UBYTE_C 0 COMP_0017 0 255 /end CHARACTERISTIC
/begin CHARACTERISTIC mOIHPSFC "ROM Const mOIHPSFC" VALUE 0x0000932C REC_UWORD_C 0 COMP_0064 0 102398.4375 /end CHARACTERISTIC
/begin CHARACTERISTIC mOILDT1 "ROM Const mOILDT1" VALUE 0x000088EB REC_UBYTE_C 0 COMP_0035 -50 205 /end CHARACTERISTIC
/begin CHARACTERISTIC mOILDT2 "ROM Const mOILDT2" VALUE 0x000088EC REC_UBYTE_C 0 COMP_0003 0 255 /end CHARACTERISTIC
/begin CHARACTERISTIC mOILDT3 "ROM Const mOILDT3" VALUE 0x000088ED REC_UBYTE_C 0 COMP_0035 -50 205 /end CHARACTERISTIC
/begin CHARACTERISTIC mOILDT4 "ROM Const mOILDT4" VALUE 0x000088EE REC_UBYTE_C 0 COMP_0035 -50 205 /end CHARACTERISTIC
/begin CHARACTERISTIC mOILJDG1 "ROM Const mOILJDG1" VALUE 0x0000932E REC_UWORD_C 0 COMP_0013 0 65535 /end CHARACTERISTIC
/begin CHARACTERISTIC mOILJDG2 "ROM Const mOILJDG2" VALUE 0x00009330 REC_UWORD_C 0 COMP_0013 0 65535 /end CHARACTERISTIC
/begin CHARACTERISTIC mOILJDG3 "ROM Const mOILJDG3" VALUE 0x00009332 REC_UWORD_C 0 COMP_0013 0 65535 /end CHARACTERISTIC
/begin CHARACTERISTIC mOILJDG4 "ROM Const mOILJDG4" VALUE 0x00009334 REC_UWORD_C 0 COMP_0013 0 65535 /end CHARACTERISTIC
/begin CHARACTERISTIC mOILJDG5 "ROM Const mOILJDG5" VALUE 0x00009336 REC_UWORD_C 0 COMP_0013 0 65535 /end CHARACTERISTIC
/begin CHARACTERISTIC mOKLRCRT "ROM Const mOKLRCRT" VALUE 0x00009338 REC_UWORD_C 0 COMP_0453 0 131.07 /end CHARACTERISTIC
/begin CHARACTERISTIC mOKNGVAC "ROM Const mOKNGVAC" VALUE 0x000097D0 REC_ULONG_C 0 COMP_0202_S 0 4294967295 /end CHARACTERISTIC
/begin CHARACTERISTIC mOKRLCRT "ROM Const mOKRLCRT" VALUE 0x0000933A REC_UWORD_C 0 COMP_0453 0 131.07 /end CHARACTERISTIC
/begin CHARACTERISTIC mOKTIMES "ROM Const mOKTIMES" VALUE 0x000088EF REC_UBYTE_C 0 COMP_0016 0 255 /end CHARACTERISTIC
/begin CHARACTERISTIC mOKVAC "ROM Const mOKVAC" VALUE 0x0000933C REC_UWORD_C 0 COMP_0001_S 0 65535 /end CHARACTERISTIC
/begin CHARACTERISTIC mONOFCR "ROM Const mONOFCR" VALUE 0x000088F0 REC_UBYTE_C 0 COMP_0267 0 65280 /end CHARACTERISTIC
/begin CHARACTERISTIC mOPABDLY "ROM Const mOPABDLY" VALUE 0x000088F1 REC_UBYTE_C 0 COMP_0013 0 255 /end CHARACTERISTIC
/begin CHARACTERISTIC mOPCRDLY "ROM Const mOPCRDLY" VALUE 0x000088F2 REC_UBYTE_C 0 COMP_0013 0 255 /end CHARACTERISTIC
/begin CHARACTERISTIC mOPDRTSLH "ROM Const mOPDRTSLH" VALUE 0x000088F3 REC_UBYTE_C 0 COMP_0035 -50 205 /end CHARACTERISTIC
/begin CHARACTERISTIC mOPDRTSLL "ROM Const mOPDRTSLL" VALUE 0x000088F4 REC_UBYTE_C 0 COMP_0035 -50 205 /end CHARACTERISTIC
/begin CHARACTERISTIC mOPENNG "ROM Const mOPENNG" VALUE 0x000088F5 REC_UBYTE_C 0 COMP_0030 0 255 /end CHARACTERISTIC
/begin CHARACTERISTIC mOPESFLL "ROM Const mOPESFLL" VALUE 0x0000933E REC_UWORD_C 0 COMP_0065 0 204796.875 /end CHARACTERISTIC
/begin CHARACTERISTIC mOPESMLL "ROM Const mOPESMLL" VALUE 0x00009340 REC_UWORD_C 0 COMP_0065 0 204796.875 /end CHARACTERISTIC
/begin CHARACTERISTIC mOPKHYS "ROM Const mOPKHYS" VALUE 0x00009342 REC_UWORD_C 0 COMP_0061 0 327675 /end CHARACTERISTIC
/begin CHARACTERISTIC mOPOTHL "ROM Const mOPOTHL" VALUE 0x000088F6 REC_UBYTE_C 0 COMP_0035 -50 205 /end CHARACTERISTIC
/begin CHARACTERISTIC mOPRAC "ROM Const mOPRAC" VALUE 0x00009344 REC_UWORD_C 0 COMP_0139_S 0 4095.9375 /end CHARACTERISTIC
/begin CHARACTERISTIC mOPSDLY "ROM Const mOPSDLY" VALUE 0x000088F7 REC_UBYTE_C 0 COMP_0013 0 255 /end CHARACTERISTIC
/begin CHARACTERISTIC mOPSFAILH "ROM Const mOPSFAILH" VALUE 0x00009346 REC_UWORD_C 0 COMP_0203_S 0 327.675 /end CHARACTERISTIC
/begin CHARACTERISTIC mOPSFAILL "ROM Const mOPSFAILL" VALUE 0x00009348 REC_UWORD_C 0 COMP_0203_S 0 327.675 /end CHARACTERISTIC
/begin CHARACTERISTIC mOPSOFF "ROM Const mOPSOFF" VALUE 0x0000934A REC_UWORD_C 0 COMP_0065_S 0 1023.984375 /end CHARACTERISTIC
/begin CHARACTERISTIC mOPSTDY2 "ROM Const mOPSTDY2" VALUE 0x000088F8 REC_UBYTE_C 0 COMP_0013 0 255 /end CHARACTERISTIC
/begin CHARACTERISTIC mORSTINT2 "ROM Const mORSTINT2" VALUE 0x0000934C REC_UWORD_C 0 COMP_0202 0 655350 /end CHARACTERISTIC
/begin CHARACTERISTIC mOSCDL1 "ROM Const mOSCDL1" VALUE 0x000088F9 REC_UBYTE_C 0 COMP_0008 0 25500 /end CHARACTERISTIC
/begin CHARACTERISTIC mOSCDL2 "ROM Const mOSCDL2" VALUE 0x000088FA REC_UBYTE_C 0 COMP_0008 0 25500 /end CHARACTERISTIC
/begin CHARACTERISTIC mOSCDL3 "ROM Const mOSCDL3" VALUE 0x000088FB REC_UBYTE_C 0 COMP_0008 0 25500 /end CHARACTERISTIC
/begin CHARACTERISTIC mOSCDL4 "ROM Const mOSCDL4" VALUE 0x000088FC REC_UBYTE_C 0 COMP_0008 0 25500 /end CHARACTERISTIC
/begin CHARACTERISTIC mOSCIDLTH "ROM Const mOSCIDLTH" VALUE 0x000088FD REC_UBYTE_C 0 COMP_0049 0 255 /end CHARACTERISTIC
/begin CHARACTERISTIC mOSCLIM "ROM Const mOSCLIM" VALUE 0x000088FE REC_UBYTE_C 0 COMP_0068 0 255 /end CHARACTERISTIC
/begin CHARACTERISTIC mOSCNH "ROM Const mOSCNH" VALUE 0x000088FF REC_UBYTE_C 0 COMP_0000 0 6375 /end CHARACTERISTIC
/begin CHARACTERISTIC mOSCNH2 "ROM Const mOSCNH2" VALUE 0x00008900 REC_UBYTE_C 0 COMP_0000 0 6375 /end CHARACTERISTIC
/begin CHARACTERISTIC mOSCNL "ROM Const mOSCNL" VALUE 0x00008901 REC_UBYTE_C 0 COMP_0000 0 6375 /end CHARACTERISTIC
/begin CHARACTERISTIC mOSCNL2 "ROM Const mOSCNL2" VALUE 0x00008902 REC_UBYTE_C 0 COMP_0000 0 6375 /end CHARACTERISTIC
/begin CHARACTERISTIC mOSCNOM1 "ROM Const mOSCNOM1" VALUE 0x00008903 REC_UBYTE_C 0 COMP_0045 0 1.9921875 /end CHARACTERISTIC
/begin CHARACTERISTIC mOSCTIM "ROM Const mOSCTIM" VALUE 0x00008906 REC_UBYTE_C 0 COMP_0014 0 2550 /end CHARACTERISTIC
/begin CHARACTERISTIC mOSCTPH "ROM Const mOSCTPH" VALUE 0x00008907 REC_UBYTE_C 0 COMP_0001 0 31.875 /end CHARACTERISTIC
/begin CHARACTERISTIC mOSCTPL "ROM Const mOSCTPL" VALUE 0x00008908 REC_UBYTE_C 0 COMP_0001 0 31.875 /end CHARACTERISTIC
/begin CHARACTERISTIC mOSCWLRC "ROM Const mOSCWLRC" VALUE 0x00008909 REC_UBYTE_C 0 COMP_0035 -50 205 /end CHARACTERISTIC
/begin CHARACTERISTIC mOSCWLRH "ROM Const mOSCWLRH" VALUE 0x0000890A REC_UBYTE_C 0 COMP_0035 -50 205 /end CHARACTERISTIC
/begin CHARACTERISTIC mOVADCGAF "ROM Const mOVADCGAF" VALUE 0x0000890B REC_UBYTE_C 0 COMP_0022_S 0 5.1 /end CHARACTERISTIC
/begin CHARACTERISTIC mOVCFABFT "ROM Const mOVCFABFT" VALUE 0x0000890C REC_UBYTE_C 0 COMP_0015_S 0 25.5 /end CHARACTERISTIC
/begin CHARACTERISTIC mOVCGALPT "ROM Const mOVCGALPT" VALUE 0x0000890D REC_UBYTE_C 0 COMP_0015_S 0 25.5 /end CHARACTERISTIC
/begin CHARACTERISTIC mOVCGPMPR "ROM Const mOVCGPMPR" VALUE 0x0000890E REC_UBYTE_C 0 COMP_0163 0 15.9375 /end CHARACTERISTIC
/begin CHARACTERISTIC mOVCHGCU "ROM Const mOVCHGCU" VALUE 0x00008E66 REC_SWORD_C 0 COMP_0204_S -3276800 3276700 /end CHARACTERISTIC
/begin CHARACTERISTIC mOVCKPNE "ROM Const mOVCKPNE" VALUE 0x0000934E REC_UWORD_C 0 COMP_0205_S 0 0.013107 /end CHARACTERISTIC
/begin CHARACTERISTIC mOVCKPNI "ROM Const mOVCKPNI" VALUE 0x00009350 REC_UWORD_C 0 COMP_0205_S 0 0.013107 /end CHARACTERISTIC
/begin CHARACTERISTIC mOVERADV "ROM Const mOVERADV" VALUE 0x0000890F REC_UBYTE_C 0 COMP_0030 0 255 /end CHARACTERISTIC
/begin CHARACTERISTIC mOVFUEL "ROM Const mOVFUEL" VALUE 0x00009352 REC_UWORD_C 0 COMP_0061 0 327675 /end CHARACTERISTIC
/begin CHARACTERISTIC mOVLMFD "ROM Const mOVLMFD" VALUE 0x00008910 REC_UBYTE_C 0 COMP_0027 0 255 /end CHARACTERISTIC
/begin CHARACTERISTIC mOVLNE "ROM Const mOVLNE" VALUE 0x00008911 REC_UBYTE_C 0 COMP_0006 0 3187.5 /end CHARACTERISTIC
/begin CHARACTERISTIC mOVLRFN "ROM Const mOVLRFN" VALUE 0x00008912 REC_UBYTE_C 0 COMP_0068 0 255 /end CHARACTERISTIC
/begin CHARACTERISTIC mOVOFSET "ROM Const mOVOFSET" VALUE 0x00008913 REC_UBYTE_C 0 COMP_0017 0 255 /end CHARACTERISTIC
/begin CHARACTERISTIC mOVSTNG "ROM Const mOVSTNG" VALUE 0x00008914 REC_UBYTE_C 0 COMP_0030 0 255 /end CHARACTERISTIC
/begin CHARACTERISTIC mPABFDLY "ROM Const mPABFDLY" VALUE 0x00009354 REC_UWORD_C 0 COMP_0015_S 0 6553.5 /end CHARACTERISTIC
/begin CHARACTERISTIC mPAKANJI "ROM Const mPAKANJI" VALUE 0x00008915 REC_UBYTE_C 0 COMP_0014 0 2550 /end CHARACTERISTIC
/begin CHARACTERISTIC mPAMB0 "ROM Const mPAMB0" VALUE 0x00009356 REC_UWORD_C 0 COMP_0050 0 5119.921875 /end CHARACTERISTIC
/begin CHARACTERISTIC mPAMBHZH "ROM Const mPAMBHZH" VALUE 0x00008916 REC_UBYTE_C 0 COMP_0054 0 5100 /end CHARACTERISTIC
/begin CHARACTERISTIC mPAMBHZL "ROM Const mPAMBHZL" VALUE 0x00008917 REC_UBYTE_C 0 COMP_0054 0 5100 /end CHARACTERISTIC
/begin CHARACTERISTIC mPAMBI "ROM Const mPAMBI" VALUE 0x00009358 REC_UWORD_C 0 COMP_0050 0 5119.921875 /end CHARACTERISTIC
/begin CHARACTERISTIC mPAMBIS "ROM Const mPAMBIS" VALUE 0x00008918 REC_UBYTE_C 0 COMP_0054 0 5100 /end CHARACTERISTIC
/begin CHARACTERISTIC mPAMBRT "ROM Const mPAMBRT" VALUE 0x00008919 REC_UBYTE_C 0 COMP_0054 0 5100 /end CHARACTERISTIC
/begin CHARACTERISTIC mPAMBSL "ROM Const mPAMBSL" VALUE 0x0000974C REC_SLONG_C 0 COMP_0002_S -2147483648 2147483647 /end CHARACTERISTIC
/begin CHARACTERISTIC mPANTEI "ROM Const mPANTEI" VALUE 0x0000891A REC_UBYTE_C 0 COMP_0087_S 0 19.9104 /end CHARACTERISTIC
/begin CHARACTERISTIC mPBAVATM "ROM Const mPBAVATM" VALUE 0x0000935A REC_UWORD_C 0 COMP_0023 0 327675 /end CHARACTERISTIC
/begin CHARACTERISTIC mPBFCD "ROM Const mPBFCD" VALUE 0x0000891B REC_UBYTE_C 0 COMP_0008 0 25500 /end CHARACTERISTIC
/begin CHARACTERISTIC mPBNGHO "ROM Const mPBNGHO" VALUE 0x0000891C REC_UBYTE_C 0 COMP_0009 0 199.21875 /end CHARACTERISTIC
/begin CHARACTERISTIC mPCAMV "ROM Const mPCAMV" VALUE 0x0000891D REC_UBYTE_C 0 COMP_0206_S 0 25.5 /end CHARACTERISTIC
/begin CHARACTERISTIC mPCRSTC "ROM Const mPCRSTC" VALUE 0x0000891E REC_UBYTE_C 0 COMP_0207_S 0 7.96875 /end CHARACTERISTIC
/begin CHARACTERISTIC mPCUTTM "ROM Const mPCUTTM" VALUE 0x0000891F REC_UBYTE_C 0 COMP_0013 0 255 /end CHARACTERISTIC
/begin CHARACTERISTIC mPCVOLM "ROM Const mPCVOLM" VALUE 0x00008920 REC_UBYTE_C 0 COMP_0295 0 25500 /end CHARACTERISTIC
/begin CHARACTERISTIC mPCVST1 "ROM Const mPCVST1" VALUE 0x00008921 REC_UBYTE_C 0 COMP_0047 0 127.5 /end CHARACTERISTIC
/begin CHARACTERISTIC mPCVST1H "ROM Const mPCVST1H" VALUE 0x00008922 REC_UBYTE_C 0 COMP_0047 0 127.5 /end CHARACTERISTIC
/begin CHARACTERISTIC mPCVST2 "ROM Const mPCVST2" VALUE 0x00008923 REC_UBYTE_C 0 COMP_0047 0 127.5 /end CHARACTERISTIC
/begin CHARACTERISTIC mPCVST3 "ROM Const mPCVST3" VALUE 0x00008924 REC_UBYTE_C 0 COMP_0047 0 127.5 /end CHARACTERISTIC
/begin CHARACTERISTIC mPCVST4 "ROM Const mPCVST4" VALUE 0x00008925 REC_UBYTE_C 0 COMP_0047 0 127.5 /end CHARACTERISTIC
/begin CHARACTERISTIC mPCVST5 "ROM Const mPCVST5" VALUE 0x00008926 REC_UBYTE_C 0 COMP_0047 0 127.5 /end CHARACTERISTIC
/begin CHARACTERISTIC mPCVST6 "ROM Const mPCVST6" VALUE 0x00008927 REC_UBYTE_C 0 COMP_0047 0 127.5 /end CHARACTERISTIC
/begin CHARACTERISTIC mPCVST6H "ROM Const mPCVST6H" VALUE 0x00008928 REC_UBYTE_C 0 COMP_0047 0 127.5 /end CHARACTERISTIC
/begin CHARACTERISTIC mPCWMV "ROM Const mPCWMV" VALUE 0x00008929 REC_UBYTE_C 0 COMP_0208_S 0 1020 /end CHARACTERISTIC
/begin CHARACTERISTIC mPDACH "ROM Const mPDACH" VALUE 0x0000892A REC_UBYTE_C 0 COMP_0011 0 5.1 /end CHARACTERISTIC
/begin CHARACTERISTIC mPDACM "ROM Const mPDACM" VALUE 0x0000892B REC_UBYTE_C 0 COMP_0011 0 5.1 /end CHARACTERISTIC
/begin CHARACTERISTIC mPDEGAIN "ROM Const mPDEGAIN" VALUE 0x0000892C REC_UBYTE_C 0 COMP_0179_S 0 2.55 /end CHARACTERISTIC
/begin CHARACTERISTIC mPDEOFSET "ROM Const mPDEOFSET" VALUE 0x0000892D REC_UBYTE_C 0 COMP_0419 0 25.5 /end CHARACTERISTIC
/begin CHARACTERISTIC mPDFMMN_S "ROM Const mPDFMMN_S" VALUE 0x00015A16 REC_UWORD_C 0 COMP_0209_S 0 199.996894995 /end CHARACTERISTIC
/begin CHARACTERISTIC mPDHIS "ROM Const mPDHIS" VALUE 0x0000892E REC_UBYTE_C 0 COMP_0011 0 5.1 /end CHARACTERISTIC
/begin CHARACTERISTIC mPDHIS1 "ROM Const mPDHIS1" VALUE 0x0000892F REC_UBYTE_C 0 COMP_0011 0 5.1 /end CHARACTERISTIC
/begin CHARACTERISTIC mPDHYSH "ROM Const mPDHYSH" VALUE 0x00008930 REC_UBYTE_C 0 COMP_0011 0 5.1 /end CHARACTERISTIC
/begin CHARACTERISTIC mPDHYSL "ROM Const mPDHYSL" VALUE 0x00008931 REC_UBYTE_C 0 COMP_0011 0 5.1 /end CHARACTERISTIC
/begin CHARACTERISTIC mPDLFMMNL "ROM Const mPDLFMMNL" VALUE 0x0000935C REC_UWORD_C 0 COMP_0209_S 0 199.996894995 /end CHARACTERISTIC
/begin CHARACTERISTIC mPDLSPN "ROM Const mPDLSPN" VALUE 0x0000935E REC_UWORD_C 0 COMP_0005 0 7208.85 /end CHARACTERISTIC
/begin CHARACTERISTIC mPDLSPNCN "ROM Const mPDLSPNCN" VALUE 0x00009360 REC_UWORD_C 0 COMP_0032_S 0 8191.875 /end CHARACTERISTIC
/begin CHARACTERISTIC mPDLSPNKD "ROM Const mPDLSPNKD" VALUE 0x00009362 REC_UWORD_C 0 COMP_0032_S 0 8191.875 /end CHARACTERISTIC
/begin CHARACTERISTIC mPDLSPN_S "ROM Const mPDLSPN_S" VALUE 0x00015A18 REC_UWORD_C 0 COMP_0005 0 7208.85 /end CHARACTERISTIC
/begin CHARACTERISTIC mPDOFST "ROM Const mPDOFST" VALUE 0x00009364 REC_UWORD_C 0 COMP_0023 0 327675 /end CHARACTERISTIC
/begin CHARACTERISTIC mPDOKTIM "ROM Const mPDOKTIM" VALUE 0x00008932 REC_UBYTE_C 0 COMP_0008 0 25500 /end CHARACTERISTIC
/begin CHARACTERISTIC mPDPRH "ROM Const mPDPRH" VALUE 0x00008933 REC_UBYTE_C 0 COMP_0011 0 5.1 /end CHARACTERISTIC
/begin CHARACTERISTIC mPDPRL "ROM Const mPDPRL" VALUE 0x00008934 REC_UBYTE_C 0 COMP_0011 0 5.1 /end CHARACTERISTIC
/begin CHARACTERISTIC mPDPRM "ROM Const mPDPRM" VALUE 0x00008935 REC_UBYTE_C 0 COMP_0011 0 5.1 /end CHARACTERISTIC
/begin CHARACTERISTIC mPDRFH "ROM Const mPDRFH" VALUE 0x00008936 REC_UBYTE_C 0 COMP_0011 0 5.1 /end CHARACTERISTIC
/begin CHARACTERISTIC mPDRFL "ROM Const mPDRFL" VALUE 0x00008937 REC_UBYTE_C 0 COMP_0011 0 5.1 /end CHARACTERISTIC
/begin CHARACTERISTIC mPDUTYG "ROM Const mPDUTYG" VALUE 0x00009366 REC_UWORD_C 0 COMP_0160_S 0 204.796875 /end CHARACTERISTIC
/begin CHARACTERISTIC mPERFBMAX "ROM Const mPERFBMAX" VALUE 0x00008938 REC_UBYTE_C 0 COMP_0210_S -64 63.5 /end CHARACTERISTIC
/begin CHARACTERISTIC mPERFBMIN "ROM Const mPERFBMIN" VALUE 0x00008939 REC_UBYTE_C 0 COMP_0210_S -64 63.5 /end CHARACTERISTIC
/begin CHARACTERISTIC mPERGOFST "ROM Const mPERGOFST" VALUE 0x0000893A REC_UBYTE_C 0 COMP_0130_S 0 0.255 /end CHARACTERISTIC
/begin CHARACTERISTIC mPERTRQMX "ROM Const mPERTRQMX" VALUE 0x0000893B REC_UBYTE_C 0 COMP_0131_S 0 127.5 /end CHARACTERISTIC
/begin CHARACTERISTIC mPEVCCL "ROM Const mPEVCCL" VALUE 0x0000893C REC_UBYTE_C 0 COMP_0008 0 25500 /end CHARACTERISTIC
/begin CHARACTERISTIC mPEVSTD "ROM Const mPEVSTD" VALUE 0x0000893D REC_UBYTE_C 0 COMP_0008 0 25500 /end CHARACTERISTIC
/begin CHARACTERISTIC mPFLOTVSP "ROM Const mPFLOTVSP" VALUE 0x0000893F REC_UBYTE_C 0 COMP_0004 0 255 /end CHARACTERISTIC
/begin CHARACTERISTIC mPFPER "ROM Const mPFPER" VALUE 0x00009368 REC_UWORD_C 0 COMP_0211_S 0 12.807177375 /end CHARACTERISTIC
/begin CHARACTERISTIC mPFPERL "ROM Const mPFPERL" VALUE 0x0000936A REC_UWORD_C 0 COMP_0211_S 0 12.807177375 /end CHARACTERISTIC
/begin CHARACTERISTIC mPFPERL2 "ROM Const mPFPERL2" VALUE 0x0000936C REC_UWORD_C 0 COMP_0212_S 0 12.807177375 /end CHARACTERISTIC
/begin CHARACTERISTIC mPFRVL "ROM Const mPFRVL" VALUE 0x0000936E REC_UWORD_C 0 COMP_0164 0 19.988175 /end CHARACTERISTIC
/begin CHARACTERISTIC mPFRVU "ROM Const mPFRVU" VALUE 0x00009370 REC_UWORD_C 0 COMP_0164 0 19.988175 /end CHARACTERISTIC
/begin CHARACTERISTIC mPFSSTH "ROM Const mPFSSTH" VALUE 0x000097D4 REC_ULONG_C 0 COMP_0164 0 1309965.024975 /end CHARACTERISTIC
/begin CHARACTERISTIC mPFSSTL "ROM Const mPFSSTL" VALUE 0x000097D8 REC_ULONG_C 0 COMP_0164 0 1309965.024975 /end CHARACTERISTIC
/begin CHARACTERISTIC mPFSSTLB "ROM Const mPFSSTLB" VALUE 0x000097E0 REC_ULONG_C 0 COMP_0164 0 1309965.024975 /end CHARACTERISTIC
/begin CHARACTERISTIC mPGUPSTAF "ROM Const mPGUPSTAF" VALUE 0x00008940 REC_UBYTE_C 0 COMP_0022_S 0 5.1 /end CHARACTERISTIC
/begin CHARACTERISTIC mPHDF "ROM Const mPHDF" VALUE 0x00009372 REC_UWORD_C 0 COMP_0031_S 0 39.97635 /end CHARACTERISTIC
/begin CHARACTERISTIC mPHQWAG "ROM Const mPHQWAG" VALUE 0x00008941 REC_UBYTE_C 0 COMP_0388 0 25.5 /end CHARACTERISTIC
/begin CHARACTERISTIC mPIADVG "ROM Const mPIADVG" VALUE 0x00008942 REC_UBYTE_C 0 COMP_0045 0 1.9921875 /end CHARACTERISTIC
/begin CHARACTERISTIC mPIADVGV "ROM Const mPIADVGV" VALUE 0x00008943 REC_UBYTE_C 0 COMP_0045 0 1.9921875 /end CHARACTERISTIC
/begin CHARACTERISTIC mPILMTAT "ROM Const mPILMTAT" VALUE 0x0000823D REC_SBYTE_C 0 COMP_0018 -128 127 /end CHARACTERISTIC
/begin CHARACTERISTIC mPINJDYA "ROM Const mPINJDYA" VALUE 0x00008944 REC_UBYTE_C 0 COMP_0040_S 0 2.55 /end CHARACTERISTIC
/begin CHARACTERISTIC mPINJDYB "ROM Const mPINJDYB" VALUE 0x00008945 REC_UBYTE_C 0 COMP_0040_S 0 2.55 /end CHARACTERISTIC
/begin CHARACTERISTIC mPINJDYE "ROM Const mPINJDYE" VALUE 0x00008946 REC_UBYTE_C 0 COMP_0040_S 0 2.55 /end CHARACTERISTIC
/begin CHARACTERISTIC mPINJDYF "ROM Const mPINJDYF" VALUE 0x00008947 REC_UBYTE_C 0 COMP_0040_S 0 2.55 /end CHARACTERISTIC
/begin CHARACTERISTIC mPLDEN_1 "ROM Const mPLDEN_1" VALUE 0x00009750 REC_SLONG_C 0 COMP_0005_S -214748.3648 214748.3647 /end CHARACTERISTIC
/begin CHARACTERISTIC mPLDEN_2 "ROM Const mPLDEN_2" VALUE 0x00009754 REC_SLONG_C 0 COMP_0005_S -214748.3648 214748.3647 /end CHARACTERISTIC
/begin CHARACTERISTIC mPLDF "ROM Const mPLDF" VALUE 0x00009374 REC_UWORD_C 0 COMP_0031_S 0 39.97635 /end CHARACTERISTIC
/begin CHARACTERISTIC mPLDFH "ROM Const mPLDFH" VALUE 0x00009376 REC_UWORD_C 0 COMP_0031_S 0 39.97635 /end CHARACTERISTIC
/begin CHARACTERISTIC mPLINJFN "ROM Const mPLINJFN" VALUE 0x00009378 REC_UWORD_C 0 COMP_0017_S 0 655.35 /end CHARACTERISTIC
/begin CHARACTERISTIC mPLINJN "ROM Const mPLINJN" VALUE 0x00008948 REC_UBYTE_C 0 COMP_0006 0 3187.5 /end CHARACTERISTIC
/begin CHARACTERISTIC mPLINJNH "ROM Const mPLINJNH" VALUE 0x00008949 REC_UBYTE_C 0 COMP_0006 0 3187.5 /end CHARACTERISTIC
/begin CHARACTERISTIC mPLINJTIH "ROM Const mPLINJTIH" VALUE 0x0000894A REC_UBYTE_C 0 COMP_0213_S 0 20400 /end CHARACTERISTIC
/begin CHARACTERISTIC mPLNUM_1 "ROM Const mPLNUM_1" VALUE 0x00008E68 REC_SWORD_C 0 COMP_0005_S -3.2768 3.2767 /end CHARACTERISTIC
/begin CHARACTERISTIC mPLNUM_2 "ROM Const mPLNUM_2" VALUE 0x00008E6A REC_SWORD_C 0 COMP_0005_S -3.2768 3.2767 /end CHARACTERISTIC
/begin CHARACTERISTIC mPLTDCT "ROM Const mPLTDCT" VALUE 0x0000894B REC_UBYTE_C 0 COMP_0016 0 255 /end CHARACTERISTIC
/begin CHARACTERISTIC mPMITDLY "ROM Const mPMITDLY" VALUE 0x0000894D REC_UBYTE_C 0 COMP_0013 0 255 /end CHARACTERISTIC
/begin CHARACTERISTIC mPMITLMT "ROM Const mPMITLMT" VALUE 0x0000894E REC_UBYTE_C 0 COMP_0190 0 510 /end CHARACTERISTIC
/begin CHARACTERISTIC mPMNAVDMP "ROM Const mPMNAVDMP" VALUE 0x0000894F REC_UBYTE_C 0 COMP_0045 0 1.9921875 /end CHARACTERISTIC
/begin CHARACTERISTIC mPMRPM "ROM Const mPMRPM" VALUE 0x00008950 REC_UBYTE_C 0 COMP_0000 0 6375 /end CHARACTERISTIC
/begin CHARACTERISTIC mPMSKHYS "ROM Const mPMSKHYS" VALUE 0x0000937A REC_UWORD_C 0 COMP_0214_S 0 0.65535 /end CHARACTERISTIC
/begin CHARACTERISTIC mPMSKQH0 "ROM Const mPMSKQH0" VALUE 0x00008951 REC_UBYTE_C 0 COMP_0063 0 0.99609375 /end CHARACTERISTIC
/begin CHARACTERISTIC mPPAMBAFH "ROM Const mPPAMBAFH" VALUE 0x0000937C REC_UWORD_C 0 COMP_0123_S 0 127.998046875 /end CHARACTERISTIC
/begin CHARACTERISTIC mPPAMBAFL "ROM Const mPPAMBAFL" VALUE 0x0000937E REC_UWORD_C 0 COMP_0123_S 0 127.998046875 /end CHARACTERISTIC
/begin CHARACTERISTIC mPPAMBHI "ROM Const mPPAMBHI" VALUE 0x00009380 REC_UWORD_C 0 COMP_0123_S 0 127.998046875 /end CHARACTERISTIC
/begin CHARACTERISTIC mPPAMBLO "ROM Const mPPAMBLO" VALUE 0x00009382 REC_UWORD_C 0 COMP_0123_S 0 127.998046875 /end CHARACTERISTIC
/begin CHARACTERISTIC mPPAMBSTL "ROM Const mPPAMBSTL" VALUE 0x00009384 REC_UWORD_C 0 COMP_0215_S 0 127.99837455 /end CHARACTERISTIC
/begin CHARACTERISTIC mPPSFAIL "ROM Const mPPSFAIL" VALUE 0x00008952 REC_UBYTE_C 0 COMP_0014 0 2550 /end CHARACTERISTIC
/begin CHARACTERISTIC mPPSVHYS "ROM Const mPPSVHYS" VALUE 0x00008953 REC_UBYTE_C 0 COMP_0054 0 5100 /end CHARACTERISTIC
/begin CHARACTERISTIC mPPSVSW "ROM Const mPPSVSW" VALUE 0x00008954 REC_UBYTE_C 0 COMP_0054 0 5100 /end CHARACTERISTIC
/begin CHARACTERISTIC mPRATE "ROM Const mPRATE" VALUE 0x00008955 REC_UBYTE_C 0 COMP_0272 0 0.03112785 /end CHARACTERISTIC
/begin CHARACTERISTIC mPRATEMSK "ROM Const mPRATEMSK" VALUE 0x00009386 REC_UWORD_C 0 COMP_0216_S 0.5 1.15535 /end CHARACTERISTIC
/begin CHARACTERISTIC mPRCLCT "ROM Const mPRCLCT" VALUE 0x00008956 REC_UBYTE_C 0 COMP_0016 0 255 /end CHARACTERISTIC
/begin CHARACTERISTIC mPRDRAT "ROM Const mPRDRAT" VALUE 0x00009388 REC_UWORD_C 0 COMP_0081 0 255.99609375 /end CHARACTERISTIC
/begin CHARACTERISTIC mPRDTME "ROM Const mPRDTME" VALUE 0x00008957 REC_UBYTE_C 0 COMP_0014 0 2550 /end CHARACTERISTIC
/begin CHARACTERISTIC mPREDLY "ROM Const mPREDLY" VALUE 0x00008958 REC_UBYTE_C 0 COMP_0008 0 25500 /end CHARACTERISTIC
/begin CHARACTERISTIC mPREHTWN1 "ROM Const mPREHTWN1" VALUE 0x00008959 REC_UBYTE_C 0 COMP_0035 -50 205 /end CHARACTERISTIC
/begin CHARACTERISTIC mPREHTWN2 "ROM Const mPREHTWN2" VALUE 0x0000895A REC_UBYTE_C 0 COMP_0035 -50 205 /end CHARACTERISTIC
/begin CHARACTERISTIC mPREHTWN3 "ROM Const mPREHTWN3" VALUE 0x0000895B REC_UBYTE_C 0 COMP_0035 -50 205 /end CHARACTERISTIC
/begin CHARACTERISTIC mPREOK "ROM Const mPREOK" VALUE 0x0000938A REC_UWORD_C 0 COMP_0006 0 819187.5 /end CHARACTERISTIC
/begin CHARACTERISTIC mPRESVM "ROM Const mPRESVM" VALUE 0x0000895C REC_UBYTE_C 0 COMP_0104 0 2550 /end CHARACTERISTIC
/begin CHARACTERISTIC mPRGCTM "ROM Const mPRGCTM" VALUE 0x0000895D REC_UBYTE_C 0 COMP_0013 0 255 /end CHARACTERISTIC
/begin CHARACTERISTIC mPRGCTME "ROM Const mPRGCTME" VALUE 0x0000895E REC_UBYTE_C 0 COMP_0013 0 255 /end CHARACTERISTIC
/begin CHARACTERISTIC mPRGTWH "ROM Const mPRGTWH" VALUE 0x0000895F REC_UBYTE_C 0 COMP_0035 -50 205 /end CHARACTERISTIC
/begin CHARACTERISTIC mPRGTWL "ROM Const mPRGTWL" VALUE 0x00008960 REC_UBYTE_C 0 COMP_0035 -50 205 /end CHARACTERISTIC
/begin CHARACTERISTIC mPRHWTWN1 "ROM Const mPRHWTWN1" VALUE 0x00008961 REC_UBYTE_C 0 COMP_0035 -50 205 /end CHARACTERISTIC
/begin CHARACTERISTIC mPRHWTWN2 "ROM Const mPRHWTWN2" VALUE 0x00008962 REC_UBYTE_C 0 COMP_0035 -50 205 /end CHARACTERISTIC
/begin CHARACTERISTIC mPRHWTWN3 "ROM Const mPRHWTWN3" VALUE 0x00008963 REC_UBYTE_C 0 COMP_0035 -50 205 /end CHARACTERISTIC
/begin CHARACTERISTIC mPRSNDH "ROM Const mPRSNDH" VALUE 0x0000938C REC_UWORD_C 0 COMP_0050 0 5119.921875 /end CHARACTERISTIC
/begin CHARACTERISTIC mPRSNDL "ROM Const mPRSNDL" VALUE 0x0000938E REC_UWORD_C 0 COMP_0050 0 5119.921875 /end CHARACTERISTIC
/begin CHARACTERISTIC mPSDGVB "ROM Const mPSDGVB" VALUE 0x00008965 REC_UBYTE_C 0 COMP_0033 0 20400 /end CHARACTERISTIC
/begin CHARACTERISTIC mPSDMIN "ROM Const mPSDMIN" VALUE 0x00008966 REC_UBYTE_C 0 COMP_0006 0 3187.5 /end CHARACTERISTIC
/begin CHARACTERISTIC mPSEVCN "ROM Const mPSEVCN" VALUE 0x00008967 REC_UBYTE_C 0 COMP_0152 0 510 /end CHARACTERISTIC
/begin CHARACTERISTIC mPSEVPH "ROM Const mPSEVPH" VALUE 0x00008968 REC_UBYTE_C 0 COMP_0047 0 127.5 /end CHARACTERISTIC
/begin CHARACTERISTIC mPSEVPL "ROM Const mPSEVPL" VALUE 0x00008969 REC_UBYTE_C 0 COMP_0047 0 127.5 /end CHARACTERISTIC
/begin CHARACTERISTIC mPSFNGT "ROM Const mPSFNGT" VALUE 0x0000896A REC_UBYTE_C 0 COMP_0008 0 25500 /end CHARACTERISTIC
/begin CHARACTERISTIC mPSHAV "ROM Const mPSHAV" VALUE 0x00009390 REC_UWORD_C 0 COMP_0217_S 0 6553.5 /end CHARACTERISTIC
/begin CHARACTERISTIC mPSITM "ROM Const mPSITM" VALUE 0x0000896B REC_UBYTE_C 0 COMP_0008 0 25500 /end CHARACTERISTIC
/begin CHARACTERISTIC mPSNDTM "ROM Const mPSNDTM" VALUE 0x0000896C REC_UBYTE_C 0 COMP_0015_S 0 25.5 /end CHARACTERISTIC
/begin CHARACTERISTIC mPSNGT "ROM Const mPSNGT" VALUE 0x0000896D REC_UBYTE_C 0 COMP_0008 0 25500 /end CHARACTERISTIC
/begin CHARACTERISTIC mPSNGT2 "ROM Const mPSNGT2" VALUE 0x0000896E REC_UBYTE_C 0 COMP_0008 0 25500 /end CHARACTERISTIC
/begin CHARACTERISTIC mPSNGT3 "ROM Const mPSNGT3" VALUE 0x0000896F REC_UBYTE_C 0 COMP_0014 0 2550 /end CHARACTERISTIC
/begin CHARACTERISTIC mPSNGT4 "ROM Const mPSNGT4" VALUE 0x00008970 REC_UBYTE_C 0 COMP_0008 0 25500 /end CHARACTERISTIC
/begin CHARACTERISTIC mPSNGT5 "ROM Const mPSNGT5" VALUE 0x00008971 REC_UBYTE_C 0 COMP_0014 0 2550 /end CHARACTERISTIC
/begin CHARACTERISTIC mPSNMH1 "ROM Const mPSNMH1" VALUE 0x00008972 REC_UBYTE_C 0 COMP_0000 0 6375 /end CHARACTERISTIC
/begin CHARACTERISTIC mPSNMH2 "ROM Const mPSNMH2" VALUE 0x00008973 REC_UBYTE_C 0 COMP_0000 0 6375 /end CHARACTERISTIC
/begin CHARACTERISTIC mPSNMIN "ROM Const mPSNMIN" VALUE 0x00008974 REC_UBYTE_C 0 COMP_0006 0 3187.5 /end CHARACTERISTIC
/begin CHARACTERISTIC mPSNML1 "ROM Const mPSNML1" VALUE 0x00008975 REC_UBYTE_C 0 COMP_0000 0 6375 /end CHARACTERISTIC
/begin CHARACTERISTIC mPSNML2 "ROM Const mPSNML2" VALUE 0x00008976 REC_UBYTE_C 0 COMP_0000 0 6375 /end CHARACTERISTIC
/begin CHARACTERISTIC mPSRDLYT "ROM Const mPSRDLYT" VALUE 0x00008977 REC_UBYTE_C 0 COMP_0014 0 2550 /end CHARACTERISTIC
/begin CHARACTERISTIC mPSRHNGT "ROM Const mPSRHNGT" VALUE 0x00008978 REC_UBYTE_C 0 COMP_0014 0 2550 /end CHARACTERISTIC
/begin CHARACTERISTIC mPSRLNGT "ROM Const mPSRLNGT" VALUE 0x00008979 REC_UBYTE_C 0 COMP_0008 0 25500 /end CHARACTERISTIC
/begin CHARACTERISTIC mPSRNGPH "ROM Const mPSRNGPH" VALUE 0x00009392 REC_UWORD_C 0 COMP_0164 0 19.988175 /end CHARACTERISTIC
/begin CHARACTERISTIC mPSRNGPL "ROM Const mPSRNGPL" VALUE 0x00009394 REC_UWORD_C 0 COMP_0164 0 19.988175 /end CHARACTERISTIC
/begin CHARACTERISTIC mPSRTW1 "ROM Const mPSRTW1" VALUE 0x0000897A REC_UBYTE_C 0 COMP_0035 -50 205 /end CHARACTERISTIC
/begin CHARACTERISTIC mPSRTW2 "ROM Const mPSRTW2" VALUE 0x0000897B REC_UBYTE_C 0 COMP_0035 -50 205 /end CHARACTERISTIC
/begin CHARACTERISTIC mPSRTW3 "ROM Const mPSRTW3" VALUE 0x0000897C REC_UBYTE_C 0 COMP_0003 0 255 /end CHARACTERISTIC
/begin CHARACTERISTIC mPSSTDY "ROM Const mPSSTDY" VALUE 0x0000897D REC_UBYTE_C 0 COMP_0008 0 25500 /end CHARACTERISTIC
/begin CHARACTERISTIC mPSTPH1 "ROM Const mPSTPH1" VALUE 0x0000897E REC_UBYTE_C 0 COMP_0001 0 31.875 /end CHARACTERISTIC
/begin CHARACTERISTIC mPSTPH2 "ROM Const mPSTPH2" VALUE 0x0000897F REC_UBYTE_C 0 COMP_0001 0 31.875 /end CHARACTERISTIC
/begin CHARACTERISTIC mPSTPL1 "ROM Const mPSTPL1" VALUE 0x00008980 REC_UBYTE_C 0 COMP_0001 0 31.875 /end CHARACTERISTIC
/begin CHARACTERISTIC mPSTPL2 "ROM Const mPSTPL2" VALUE 0x00008981 REC_UBYTE_C 0 COMP_0001 0 31.875 /end CHARACTERISTIC
/begin CHARACTERISTIC mPSVSH1 "ROM Const mPSVSH1" VALUE 0x00008982 REC_UBYTE_C 0 COMP_0007 0 510 /end CHARACTERISTIC
/begin CHARACTERISTIC mPSVSH2 "ROM Const mPSVSH2" VALUE 0x00008983 REC_UBYTE_C 0 COMP_0007 0 510 /end CHARACTERISTIC
/begin CHARACTERISTIC mPSVSL1 "ROM Const mPSVSL1" VALUE 0x00008984 REC_UBYTE_C 0 COMP_0007 0 510 /end CHARACTERISTIC
/begin CHARACTERISTIC mPSVSL2 "ROM Const mPSVSL2" VALUE 0x00008985 REC_UBYTE_C 0 COMP_0007 0 510 /end CHARACTERISTIC
/begin CHARACTERISTIC mPSVSPSLB "ROM Const mPSVSPSLB" VALUE 0x00008986 REC_UBYTE_C 0 COMP_0007 0 510 /end CHARACTERISTIC
/begin CHARACTERISTIC mPSVTCTWH "ROM Const mPSVTCTWH" VALUE 0x00008987 REC_UBYTE_C 0 COMP_0035 -50 205 /end CHARACTERISTIC
/begin CHARACTERISTIC mPSVTCTWL "ROM Const mPSVTCTWL" VALUE 0x00008988 REC_UBYTE_C 0 COMP_0035 -50 205 /end CHARACTERISTIC
/begin CHARACTERISTIC mPSYDG1 "ROM Const mPSYDG1" VALUE 0x00008989 REC_UBYTE_C 0 COMP_0008 0 25500 /end CHARACTERISTIC
/begin CHARACTERISTIC mPSYDG2 "ROM Const mPSYDG2" VALUE 0x0000898A REC_UBYTE_C 0 COMP_0008 0 25500 /end CHARACTERISTIC
/begin CHARACTERISTIC mPSYDG3 "ROM Const mPSYDG3" VALUE 0x0000898B REC_UBYTE_C 0 COMP_0008 0 25500 /end CHARACTERISTIC
/begin CHARACTERISTIC mPSYDG4 "ROM Const mPSYDG4" VALUE 0x0000898C REC_UBYTE_C 0 COMP_0008 0 25500 /end CHARACTERISTIC
/begin CHARACTERISTIC mPSYEV1R "ROM Const mPSYEV1R" VALUE 0x00009396 REC_UWORD_C 0 COMP_0050 0 5119.921875 /end CHARACTERISTIC
/begin CHARACTERISTIC mPSYEV2 "ROM Const mPSYEV2" VALUE 0x0000898D REC_UBYTE_C 0 COMP_0054 0 5100 /end CHARACTERISTIC
/begin CHARACTERISTIC mPSYSNG "ROM Const mPSYSNG" VALUE 0x0000898E REC_UBYTE_C 0 COMP_0016 0 255 /end CHARACTERISTIC
/begin CHARACTERISTIC mPTNHYS "ROM Const mPTNHYS" VALUE 0x00008991 REC_UBYTE_C 0 COMP_0020 0 12750 /end CHARACTERISTIC
/begin CHARACTERISTIC mPTNMIN "ROM Const mPTNMIN" VALUE 0x00008992 REC_UBYTE_C 0 COMP_0020 0 12750 /end CHARACTERISTIC
/begin CHARACTERISTIC mPTYCHK "ROM Const mPTYCHK" VALUE 0x000097E4 REC_ULONG_C 0 COMP_0068 0 4294967295 /end CHARACTERISTIC
/begin CHARACTERISTIC mPUMBUVB "ROM Const mPUMBUVB" VALUE 0x00008993 REC_UBYTE_C 0 COMP_0033 0 20400 /end CHARACTERISTIC
/begin CHARACTERISTIC mPUMUPNE "ROM Const mPUMUPNE" VALUE 0x00008994 REC_UBYTE_C 0 COMP_0000 0 6375 /end CHARACTERISTIC
/begin CHARACTERISTIC mPUMVBDLY "ROM Const mPUMVBDLY" VALUE 0x00008995 REC_UBYTE_C 0 COMP_0014 0 2550 /end CHARACTERISTIC
/begin CHARACTERISTIC mPUOFFSET "ROM Const mPUOFFSET" VALUE 0x00009398 REC_UWORD_C 0 COMP_0057_S 0 6553.5 /end CHARACTERISTIC
/begin CHARACTERISTIC mPVNG "ROM Const mPVNG" VALUE 0x00008E6C REC_SWORD_C 0 COMP_0002_S -32768 32767 /end CHARACTERISTIC
/begin CHARACTERISTIC mPVRPML "ROM Const mPVRPML" VALUE 0x00008996 REC_UBYTE_C 0 COMP_0000 0 6375 /end CHARACTERISTIC
/begin CHARACTERISTIC mPVSPCVH "ROM Const mPVSPCVH" VALUE 0x00008997 REC_UBYTE_C 0 COMP_0156 0 255 /end CHARACTERISTIC
/begin CHARACTERISTIC mPVSPCVL "ROM Const mPVSPCVL" VALUE 0x00008998 REC_UBYTE_C 0 COMP_0156 0 255 /end CHARACTERISTIC
/begin CHARACTERISTIC mPVTANH "ROM Const mPVTANH" VALUE 0x00008999 REC_UBYTE_C 0 COMP_0035 -50 205 /end CHARACTERISTIC
/begin CHARACTERISTIC mPVTANL "ROM Const mPVTANL" VALUE 0x0000899A REC_UBYTE_C 0 COMP_0035 -50 205 /end CHARACTERISTIC
/begin CHARACTERISTIC mPVTFH "ROM Const mPVTFH" VALUE 0x0000899B REC_UBYTE_C 0 COMP_0035 -50 205 /end CHARACTERISTIC
/begin CHARACTERISTIC mPVTFL "ROM Const mPVTFL" VALUE 0x0000899C REC_UBYTE_C 0 COMP_0035 -50 205 /end CHARACTERISTIC
/begin CHARACTERISTIC mPVTPH "ROM Const mPVTPH" VALUE 0x0000899D REC_UBYTE_C 0 COMP_0001 0 31.875 /end CHARACTERISTIC
/begin CHARACTERISTIC mPVTRANA "ROM Const mPVTRANA" VALUE 0x0000899E REC_UBYTE_C 0 COMP_0218_S 0 0.049804815 /end CHARACTERISTIC
/begin CHARACTERISTIC mPVTRANB "ROM Const mPVTRANB" VALUE 0x0000939A REC_UWORD_C 0 COMP_0123_S 0 127.998046875 /end CHARACTERISTIC
/begin CHARACTERISTIC mQ0LIMGAL "ROM Const mQ0LIMGAL" VALUE 0x0000899F REC_UBYTE_C 0 COMP_0045 0 1.9921875 /end CHARACTERISTIC
/begin CHARACTERISTIC mQ0LIMGAN "ROM Const mQ0LIMGAN" VALUE 0x000089A0 REC_UBYTE_C 0 COMP_0045 0 1.9921875 /end CHARACTERISTIC
/begin CHARACTERISTIC mQ0TRMTLM "ROM Const mQ0TRMTLM" VALUE 0x0000939C REC_UWORD_C 0 COMP_0092_S 0 1638.375 /end CHARACTERISTIC
/begin CHARACTERISTIC mQACFHN "ROM Const mQACFHN" VALUE 0x000089A1 REC_UBYTE_C 0 COMP_0051 0 255 /end CHARACTERISTIC
/begin CHARACTERISTIC mQACHG "ROM Const mQACHG" VALUE 0x0000939E REC_UWORD_C 0 COMP_0219_S 0 0.999985458 /end CHARACTERISTIC
/begin CHARACTERISTIC mQACTH "ROM Const mQACTH" VALUE 0x000093A0 REC_UWORD_C 0 COMP_0004 0 65535 /end CHARACTERISTIC
/begin CHARACTERISTIC mQACTL "ROM Const mQACTL" VALUE 0x000093A2 REC_UWORD_C 0 COMP_0068 0 65535 /end CHARACTERISTIC
/begin CHARACTERISTIC mQAHYS "ROM Const mQAHYS" VALUE 0x000093A4 REC_UWORD_C 0 COMP_0220 0 65535 /end CHARACTERISTIC
/begin CHARACTERISTIC mQALT1 "ROM Const mQALT1" VALUE 0x000089A2 REC_UBYTE_C 0 COMP_0051 0 255 /end CHARACTERISTIC
/begin CHARACTERISTIC mQALT2 "ROM Const mQALT2" VALUE 0x000089A3 REC_UBYTE_C 0 COMP_0051 0 255 /end CHARACTERISTIC
/begin CHARACTERISTIC mQAPSUM "ROM Const mQAPSUM" VALUE 0x000093A6 REC_UWORD_C 0 COMP_0156 0 65535 /end CHARACTERISTIC
/begin CHARACTERISTIC mQASMC1 "ROM Const mQASMC1" VALUE 0x000093A8 REC_UWORD_C 0 COMP_0220 0 65535 /end CHARACTERISTIC
/begin CHARACTERISTIC mQASMC2 "ROM Const mQASMC2" VALUE 0x000093AA REC_UWORD_C 0 COMP_0220 0 65535 /end CHARACTERISTIC
/begin CHARACTERISTIC mQCIAC "ROM Const mQCIAC" VALUE 0x000089A4 REC_UBYTE_C 0 COMP_0051 0 255 /end CHARACTERISTIC
/begin CHARACTERISTIC mQCIAT "ROM Const mQCIAT" VALUE 0x000089A5 REC_UBYTE_C 0 COMP_0051 0 255 /end CHARACTERISTIC
/begin CHARACTERISTIC mQCIM "ROM Const mQCIM" VALUE 0x000089A6 REC_UBYTE_C 0 COMP_0051 0 255 /end CHARACTERISTIC
/begin CHARACTERISTIC mQCKND "ROM Const mQCKND" VALUE 0x000089A7 REC_UBYTE_C 0 COMP_0220 0 255 /end CHARACTERISTIC
/begin CHARACTERISTIC mQDMP "ROM Const mQDMP" VALUE 0x000089A8 REC_UBYTE_C 0 COMP_0030 0 255 /end CHARACTERISTIC
/begin CHARACTERISTIC mQFSKN "ROM Const mQFSKN" VALUE 0x000089A9 REC_UBYTE_C 0 COMP_0000 0 6375 /end CHARACTERISTIC
/begin CHARACTERISTIC mQFSKP "ROM Const mQFSKP" VALUE 0x000089AA REC_UBYTE_C 0 COMP_0010 0 0.765 /end CHARACTERISTIC
/begin CHARACTERISTIC mQFSKPHY "ROM Const mQFSKPHY" VALUE 0x000089AB REC_UBYTE_C 0 COMP_0010 0 0.765 /end CHARACTERISTIC
/begin CHARACTERISTIC mQFSKT "ROM Const mQFSKT" VALUE 0x000089AC REC_UBYTE_C 0 COMP_0008 0 25500 /end CHARACTERISTIC
/begin CHARACTERISTIC mQGLPM2 "ROM Const mQGLPM2" VALUE 0x000093AC REC_UWORD_C 0 COMP_0220_S 0 65.535 /end CHARACTERISTIC
/begin CHARACTERISTIC mQH0LASCD "ROM Const mQH0LASCD" VALUE 0x000093AE REC_UWORD_C 0 COMP_0115 0 99.9998565 /end CHARACTERISTIC
/begin CHARACTERISTIC mQH0TMLM "ROM Const mQH0TMLM" VALUE 0x000089AD REC_UBYTE_C 0 COMP_0015_S 0 25.5 /end CHARACTERISTIC
/begin CHARACTERISTIC mQH0TRSET "ROM Const mQH0TRSET" VALUE 0x000093B0 REC_UWORD_C 0 COMP_0063 0 255.99609375 /end CHARACTERISTIC
/begin CHARACTERISTIC mQH0TWDT "ROM Const mQH0TWDT" VALUE 0x000089AE REC_UBYTE_C 0 COMP_0202 0 2550 /end CHARACTERISTIC
/begin CHARACTERISTIC mQHLMMTUP "ROM Const mQHLMMTUP" VALUE 0x000093B2 REC_UWORD_C 0 COMP_0146 0 99.998480265 /end CHARACTERISTIC
/begin CHARACTERISTIC mQHTMP "ROM Const mQHTMP" VALUE 0x000089AF REC_UBYTE_C 0 COMP_0159 0 65280 /end CHARACTERISTIC
/begin CHARACTERISTIC mQISCMX "ROM Const mQISCMX" VALUE 0x000093B4 REC_UWORD_C 0 COMP_0051 0 65535 /end CHARACTERISTIC
/begin CHARACTERISTIC mQIU "ROM Const mQIU" VALUE 0x000089B0 REC_UBYTE_C 0 COMP_0004 0 255 /end CHARACTERISTIC
/begin CHARACTERISTIC mQLD0 "ROM Const mQLD0" VALUE 0x00008E6E REC_SWORD_C 0 COMP_0263 -32768 32767 /end CHARACTERISTIC
/begin CHARACTERISTIC mQLD0ST "ROM Const mQLD0ST" VALUE 0x000089B1 REC_UBYTE_C 0 COMP_0030 0 255 /end CHARACTERISTIC
/begin CHARACTERISTIC mQLDAA "ROM Const mQLDAA" VALUE 0x000089B2 REC_UBYTE_C 0 COMP_0041 0 0.204 /end CHARACTERISTIC
/begin CHARACTERISTIC mQLDALTLM "ROM Const mQLDALTLM" VALUE 0x0000823E REC_SBYTE_C 0 COMP_0277 -128 127 /end CHARACTERISTIC
/begin CHARACTERISTIC mQLDBATF "ROM Const mQLDBATF" VALUE 0x000089B3 REC_UBYTE_C 0 COMP_0051 0 255 /end CHARACTERISTIC
/begin CHARACTERISTIC mQLDBFN "ROM Const mQLDBFN" VALUE 0x000089B4 REC_UBYTE_C 0 COMP_0051 0 255 /end CHARACTERISTIC
/begin CHARACTERISTIC mQLDFOG "ROM Const mQLDFOG" VALUE 0x000089B5 REC_UBYTE_C 0 COMP_0051 0 255 /end CHARACTERISTIC
/begin CHARACTERISTIC mQLDHLH "ROM Const mQLDHLH" VALUE 0x000089B6 REC_UBYTE_C 0 COMP_0051 0 255 /end CHARACTERISTIC
/begin CHARACTERISTIC mQLDHLL "ROM Const mQLDHLL" VALUE 0x000089B7 REC_UBYTE_C 0 COMP_0051 0 255 /end CHARACTERISTIC
/begin CHARACTERISTIC mQLDNE "ROM Const mQLDNE" VALUE 0x000089B8 REC_UBYTE_C 0 COMP_0065 0 796.875 /end CHARACTERISTIC
/begin CHARACTERISTIC mQLDPOS "ROM Const mQLDPOS" VALUE 0x000089B9 REC_UBYTE_C 0 COMP_0051 0 255 /end CHARACTERISTIC
/begin CHARACTERISTIC mQLDPSD "ROM Const mQLDPSD" VALUE 0x000089BA REC_UBYTE_C 0 COMP_0051 0 255 /end CHARACTERISTIC
/begin CHARACTERISTIC mQLDRED "ROM Const mQLDRED" VALUE 0x000089BB REC_UBYTE_C 0 COMP_0051 0 255 /end CHARACTERISTIC
/begin CHARACTERISTIC mQLDTP "ROM Const mQLDTP" VALUE 0x000093B6 REC_UWORD_C 0 COMP_0052 0 31.99956087 /end CHARACTERISTIC
/begin CHARACTERISTIC mQLDTV "ROM Const mQLDTV" VALUE 0x000089BC REC_UBYTE_C 0 COMP_0023 0 1275 /end CHARACTERISTIC
/begin CHARACTERISTIC mQLEAK "ROM Const mQLEAK" VALUE 0x000089BD REC_UBYTE_C 0 COMP_0276 0 1020 /end CHARACTERISTIC
/begin CHARACTERISTIC mQLIMN1 "ROM Const mQLIMN1" VALUE 0x00008E70 REC_SWORD_C 0 COMP_0278 -65536 65534 /end CHARACTERISTIC
/begin CHARACTERISTIC mQLIMX1 "ROM Const mQLIMX1" VALUE 0x00008E72 REC_SWORD_C 0 COMP_0278 -65536 65534 /end CHARACTERISTIC
/begin CHARACTERISTIC mQLMAFI "ROM Const mQLMAFI" VALUE 0x000093B8 REC_UWORD_C 0 COMP_0453 0 131.07 /end CHARACTERISTIC
/begin CHARACTERISTIC mQLN0 "ROM Const mQLN0" VALUE 0x00008E74 REC_SWORD_C 0 COMP_0263 -32768 32767 /end CHARACTERISTIC
/begin CHARACTERISTIC mQLN0ST "ROM Const mQLN0ST" VALUE 0x000089BE REC_UBYTE_C 0 COMP_0030 0 255 /end CHARACTERISTIC
/begin CHARACTERISTIC mQLOFENA "ROM Const mQLOFENA" VALUE 0x000089BF REC_UBYTE_C 0 COMP_0041 0 0.204 /end CHARACTERISTIC
/begin CHARACTERISTIC mQLQMAX "ROM Const mQLQMAX" VALUE 0x000089C0 REC_UBYTE_C 0 COMP_0276 0 1020 /end CHARACTERISTIC
/begin CHARACTERISTIC mQMAX "ROM Const mQMAX" VALUE 0x000089C1 REC_UBYTE_C 0 COMP_0276 0 1020 /end CHARACTERISTIC
/begin CHARACTERISTIC mQMREST "ROM Const mQMREST" VALUE 0x000089C2 REC_UBYTE_C 0 COMP_0051 0 255 /end CHARACTERISTIC
/begin CHARACTERISTIC mQPSDRPML "ROM Const mQPSDRPML" VALUE 0x000089C3 REC_UBYTE_C 0 COMP_0000 0 6375 /end CHARACTERISTIC
/begin CHARACTERISTIC mQPSNF "ROM Const mQPSNF" VALUE 0x000089C4 REC_UBYTE_C 0 COMP_0220 0 255 /end CHARACTERISTIC
/begin CHARACTERISTIC mQRDDN1 "ROM Const mQRDDN1" VALUE 0x000089C5 REC_UBYTE_C 0 COMP_0293 0 510 /end CHARACTERISTIC
/begin CHARACTERISTIC mQRDDN2 "ROM Const mQRDDN2" VALUE 0x000089C6 REC_UBYTE_C 0 COMP_0293 0 510 /end CHARACTERISTIC
/begin CHARACTERISTIC mQRDDN3 "ROM Const mQRDDN3" VALUE 0x000089C7 REC_UBYTE_C 0 COMP_0293 0 510 /end CHARACTERISTIC
/begin CHARACTERISTIC mQRDND1 "ROM Const mQRDND1" VALUE 0x000089C8 REC_UBYTE_C 0 COMP_0293 0 510 /end CHARACTERISTIC
/begin CHARACTERISTIC mQRDND2 "ROM Const mQRDND2" VALUE 0x000089C9 REC_UBYTE_C 0 COMP_0293 0 510 /end CHARACTERISTIC
/begin CHARACTERISTIC mQRDND3 "ROM Const mQRDND3" VALUE 0x000089CA REC_UBYTE_C 0 COMP_0293 0 510 /end CHARACTERISTIC
/begin CHARACTERISTIC mQRFNH "ROM Const mQRFNH" VALUE 0x000089CB REC_UBYTE_C 0 COMP_0051 0 255 /end CHARACTERISTIC
/begin CHARACTERISTIC mQRFNL "ROM Const mQRFNL" VALUE 0x000089CC REC_UBYTE_C 0 COMP_0051 0 255 /end CHARACTERISTIC
/begin CHARACTERISTIC mQRFNM "ROM Const mQRFNM" VALUE 0x000089CD REC_UBYTE_C 0 COMP_0051 0 255 /end CHARACTERISTIC
/begin CHARACTERISTIC mQT100M "ROM Const mQT100M" VALUE 0x000093BA REC_UWORD_C 0 COMP_0068 0 65535 /end CHARACTERISTIC
/begin CHARACTERISTIC mQT100U2 "ROM Const mQT100U2" VALUE 0x000093BC REC_UWORD_C 0 COMP_0221_S 0 1048560 /end CHARACTERISTIC
/begin CHARACTERISTIC mQTASINT1 "ROM Const mQTASINT1" VALUE 0x000093BE REC_UWORD_C 0 COMP_0051 0 65535 /end CHARACTERISTIC
/begin CHARACTERISTIC mQTASMN1 "ROM Const mQTASMN1" VALUE 0x00008E76 REC_SWORD_C 0 COMP_0277 -32768 32767 /end CHARACTERISTIC
/begin CHARACTERISTIC mQTASMX1 "ROM Const mQTASMX1" VALUE 0x00008E78 REC_SWORD_C 0 COMP_0277 -32768 32767 /end CHARACTERISTIC
/begin CHARACTERISTIC mQTOAV "ROM Const mQTOAV" VALUE 0x000089CE REC_UBYTE_C 0 COMP_0222_S 0 0.498046875 /end CHARACTERISTIC
/begin CHARACTERISTIC mQTRMDMP "ROM Const mQTRMDMP" VALUE 0x000093C0 REC_UWORD_C 0 COMP_0290 0 0.999985458 /end CHARACTERISTIC
/begin CHARACTERISTIC mQTRMHYS1 "ROM Const mQTRMHYS1" VALUE 0x000093C2 REC_UWORD_C 0 COMP_0092_S 0 1638.375 /end CHARACTERISTIC
/begin CHARACTERISTIC mQTRMHYS2 "ROM Const mQTRMHYS2" VALUE 0x000093C4 REC_UWORD_C 0 COMP_0092_S 0 1638.375 /end CHARACTERISTIC
/begin CHARACTERISTIC mQTRMMD1 "ROM Const mQTRMMD1" VALUE 0x000093C6 REC_UWORD_C 0 COMP_0092_S 0 1638.375 /end CHARACTERISTIC
/begin CHARACTERISTIC mQTRMMD2 "ROM Const mQTRMMD2" VALUE 0x000093C8 REC_UWORD_C 0 COMP_0092_S 0 1638.375 /end CHARACTERISTIC
/begin CHARACTERISTIC mQUNIT "ROM Const mQUNIT" VALUE 0x000089CF REC_UBYTE_C 0 COMP_0282 0 0.0255 /end CHARACTERISTIC
/begin CHARACTERISTIC mQVTC "ROM Const mQVTC" VALUE 0x000089D0 REC_UBYTE_C 0 COMP_0051 0 255 /end CHARACTERISTIC
/begin CHARACTERISTIC mQVTCOL "ROM Const mQVTCOL" VALUE 0x000089D1 REC_UBYTE_C 0 COMP_0051 0 255 /end CHARACTERISTIC
/begin CHARACTERISTIC mQZDLY "ROM Const mQZDLY" VALUE 0x000089D2 REC_UBYTE_C 0 COMP_0014 0 2550 /end CHARACTERISTIC
/begin CHARACTERISTIC mQZMIN "ROM Const mQZMIN" VALUE 0x000093CA REC_UWORD_C 0 COMP_0068 0 65535 /end CHARACTERISTIC
/begin CHARACTERISTIC mRAC2 "ROM Const mRAC2" VALUE 0x000089D3 REC_UBYTE_C 0 COMP_0008 0 25500 /end CHARACTERISTIC
/begin CHARACTERISTIC mRACACT "ROM Const mRACACT" VALUE 0x000093CC REC_UWORD_C 0 COMP_0139_S 0 4095.9375 /end CHARACTERISTIC
/begin CHARACTERISTIC mRACAL "ROM Const mRACAL" VALUE 0x000093CE REC_UWORD_C 0 COMP_0223_S 0 4095.9375 /end CHARACTERISTIC
/begin CHARACTERISTIC mRACBL "ROM Const mRACBL" VALUE 0x000093D0 REC_UWORD_C 0 COMP_0223_S 0 4095.9375 /end CHARACTERISTIC
/begin CHARACTERISTIC mRACH "ROM Const mRACH" VALUE 0x000093D2 REC_UWORD_C 0 COMP_0139_S 0 4095.9375 /end CHARACTERISTIC
/begin CHARACTERISTIC mRACL "ROM Const mRACL" VALUE 0x000093D4 REC_UWORD_C 0 COMP_0139_S 0 4095.9375 /end CHARACTERISTIC
/begin CHARACTERISTIC mRAFPMN "ROM Const mRAFPMN" VALUE 0x000093D6 REC_UWORD_C 0 COMP_0224_S 0 163837.5 /end CHARACTERISTIC
/begin CHARACTERISTIC mRAFPMN2 "ROM Const mRAFPMN2" VALUE 0x000093D8 REC_UWORD_C 0 COMP_0224_S 0 163837.5 /end CHARACTERISTIC
/begin CHARACTERISTIC mRAFPMX "ROM Const mRAFPMX" VALUE 0x000093DA REC_UWORD_C 0 COMP_0224_S 0 163837.5 /end CHARACTERISTIC
/begin CHARACTERISTIC mRAFPMX2 "ROM Const mRAFPMX2" VALUE 0x000093DC REC_UWORD_C 0 COMP_0224_S 0 163837.5 /end CHARACTERISTIC
/begin CHARACTERISTIC mRAPDLTO "ROM Const mRAPDLTO" VALUE 0x000093DE REC_UWORD_C 0 COMP_0082_S 0 65535 /end CHARACTERISTIC
/begin CHARACTERISTIC mRATIO1ST "ROM Const mRATIO1ST" VALUE 0x000093E0 REC_UWORD_C 0 COMP_0450 0 63.999056205 /end CHARACTERISTIC
/begin CHARACTERISTIC mRCDALLM2 "ROM Const mRCDALLM2" VALUE 0x000089D4 REC_UBYTE_C 0 COMP_0419 0 25.5 /end CHARACTERISTIC
/begin CHARACTERISTIC mRCDLALLM "ROM Const mRCDLALLM" VALUE 0x000089D5 REC_UBYTE_C 0 COMP_0419 0 25.5 /end CHARACTERISTIC
/begin CHARACTERISTIC mRCLDLY "ROM Const mRCLDLY" VALUE 0x000089D6 REC_UBYTE_C 0 COMP_0015_S 0 25.5 /end CHARACTERISTIC
/begin CHARACTERISTIC mRCLSLE "ROM Const mRCLSLE" VALUE 0x000093E2 REC_UWORD_C 0 COMP_0023 0 327675 /end CHARACTERISTIC
/begin CHARACTERISTIC mRCLSRE "ROM Const mRCLSRE" VALUE 0x000093E4 REC_UWORD_C 0 COMP_0023 0 327675 /end CHARACTERISTIC
/begin CHARACTERISTIC mRCVLMT "ROM Const mRCVLMT" VALUE 0x000093E6 REC_UWORD_C 0 COMP_0017_S 0 655.35 /end CHARACTERISTIC
/begin CHARACTERISTIC mRDMX "ROM Const mRDMX" VALUE 0x000089D7 REC_UBYTE_C 0 COMP_0030 0 255 /end CHARACTERISTIC
/begin CHARACTERISTIC mRDUTYMN "ROM Const mRDUTYMN" VALUE 0x000089D8 REC_UBYTE_C 0 COMP_0200_S 0 2550 /end CHARACTERISTIC
/begin CHARACTERISTIC mRDVSPL "ROM Const mRDVSPL" VALUE 0x000089D9 REC_UBYTE_C 0 COMP_0007 0 510 /end CHARACTERISTIC
/begin CHARACTERISTIC mRECAC "ROM Const mRECAC" VALUE 0x000089DA REC_UBYTE_C 0 COMP_0000 0 6375 /end CHARACTERISTIC
/begin CHARACTERISTIC mRECAC2 "ROM Const mRECAC2" VALUE 0x000089DB REC_UBYTE_C 0 COMP_0000 0 6375 /end CHARACTERISTIC
/begin CHARACTERISTIC mRECDRID "ROM Const mRECDRID" VALUE 0x000089DC REC_UBYTE_C 0 COMP_0373 0 2.55 /end CHARACTERISTIC
/begin CHARACTERISTIC mRECDRPT "ROM Const mRECDRPT" VALUE 0x000089DD REC_UBYTE_C 0 COMP_0373 0 2.55 /end CHARACTERISTIC
/begin CHARACTERISTIC mRECFN "ROM Const mRECFN" VALUE 0x000089DE REC_UBYTE_C 0 COMP_0000 0 6375 /end CHARACTERISTIC
/begin CHARACTERISTIC mRECLAC "ROM Const mRECLAC" VALUE 0x000089DF REC_UBYTE_C 0 COMP_0000 0 6375 /end CHARACTERISTIC
/begin CHARACTERISTIC mRECLOF "ROM Const mRECLOF" VALUE 0x000089E0 REC_UBYTE_C 0 COMP_0000 0 6375 /end CHARACTERISTIC
/begin CHARACTERISTIC mRECLOK "ROM Const mRECLOK" VALUE 0x000089E1 REC_UBYTE_C 0 COMP_0000 0 6375 /end CHARACTERISTIC
/begin CHARACTERISTIC mRECONDLY "ROM Const mRECONDLY" VALUE 0x000093E8 REC_UWORD_C 0 COMP_0015_S 0 6553.5 /end CHARACTERISTIC
/begin CHARACTERISTIC mRECSHK "ROM Const mRECSHK" VALUE 0x000089E2 REC_UBYTE_C 0 COMP_0006 0 3187.5 /end CHARACTERISTIC
/begin CHARACTERISTIC mRECVCUPA "ROM Const mRECVCUPA" VALUE 0x000089E3 REC_UBYTE_C 0 COMP_0225_S 0 0.00796875 /end CHARACTERISTIC
/begin CHARACTERISTIC mRECVKCST "ROM Const mRECVKCST" VALUE 0x000093EA REC_UWORD_C 0 COMP_0226_S 0 2047968.75 /end CHARACTERISTIC
/begin CHARACTERISTIC mRECVOPNF "ROM Const mRECVOPNF" VALUE 0x000093EC REC_UWORD_C 0 COMP_0227_S 0 2047.96875 /end CHARACTERISTIC
/begin CHARACTERISTIC mRECVVALA "ROM Const mRECVVALA" VALUE 0x000089E4 REC_UBYTE_C 0 COMP_0225_S 0 0.00796875 /end CHARACTERISTIC
/begin CHARACTERISTIC mREFBF "ROM Const mREFBF" VALUE 0x000089E5 REC_UBYTE_C 0 COMP_0030 0 255 /end CHARACTERISTIC
/begin CHARACTERISTIC mREFMSG "ROM Const mREFMSG" VALUE 0x000093EE REC_UWORD_C 0 COMP_0068 0 65535 /end CHARACTERISTIC
/begin CHARACTERISTIC mREFUELUP "ROM Const mREFUELUP" VALUE 0x000089E6 REC_UBYTE_C 0 COMP_0228_S 0 1992.1875 /end CHARACTERISTIC
/begin CHARACTERISTIC mREFUELUS "ROM Const mREFUELUS" VALUE 0x000089E7 REC_UBYTE_C 0 COMP_0228_S 0 1992.1875 /end CHARACTERISTIC
/begin CHARACTERISTIC mREGACCDY "ROM Const mREGACCDY" VALUE 0x000089E8 REC_UBYTE_C 0 COMP_0105 0 25.5 /end CHARACTERISTIC
/begin CHARACTERISTIC mREGBRK "ROM Const mREGBRK" VALUE 0x000089E9 REC_UBYTE_C 0 COMP_0007 0 510 /end CHARACTERISTIC
/begin CHARACTERISTIC mREGBRKTM "ROM Const mREGBRKTM" VALUE 0x000089EA REC_UBYTE_C 0 COMP_0105 0 25.5 /end CHARACTERISTIC
/begin CHARACTERISTIC mREGCGOFS "ROM Const mREGCGOFS" VALUE 0x000089EB REC_UBYTE_C 0 COMP_0130_S 0 0.255 /end CHARACTERISTIC
/begin CHARACTERISTIC mREGENDLY "ROM Const mREGENDLY" VALUE 0x000089EC REC_UBYTE_C 0 COMP_0014 0 2550 /end CHARACTERISTIC
/begin CHARACTERISTIC mREGENDNE "ROM Const mREGENDNE" VALUE 0x000089ED REC_UBYTE_C 0 COMP_0006 0 3187.5 /end CHARACTERISTIC
/begin CHARACTERISTIC mREGENDVB "ROM Const mREGENDVB" VALUE 0x000089EE REC_UBYTE_C 0 COMP_0007 0 510 /end CHARACTERISTIC
/begin CHARACTERISTIC mREGENDVN "ROM Const mREGENDVN" VALUE 0x000089EF REC_UBYTE_C 0 COMP_0007 0 510 /end CHARACTERISTIC
/begin CHARACTERISTIC mREGGCNTD "ROM Const mREGGCNTD" VALUE 0x000089F0 REC_UBYTE_C 0 COMP_0229_S 0 255 /end CHARACTERISTIC
/begin CHARACTERISTIC mREGGCNTH "ROM Const mREGGCNTH" VALUE 0x000089F1 REC_UBYTE_C 0 COMP_0229_S 0 255 /end CHARACTERISTIC
/begin CHARACTERISTIC mREGGCNTU "ROM Const mREGGCNTU" VALUE 0x000089F2 REC_UBYTE_C 0 COMP_0229_S 0 255 /end CHARACTERISTIC
/begin CHARACTERISTIC mREGJHYS "ROM Const mREGJHYS" VALUE 0x00008E7A REC_SWORD_C 0 COMP_0078 -128 127.99609375 /end CHARACTERISTIC
/begin CHARACTERISTIC mREGJL "ROM Const mREGJL" VALUE 0x00008E7C REC_SWORD_C 0 COMP_0078 -128 127.99609375 /end CHARACTERISTIC
/begin CHARACTERISTIC mREGNDLY "ROM Const mREGNDLY" VALUE 0x000089F3 REC_UBYTE_C 0 COMP_0014 0 2550 /end CHARACTERISTIC
/begin CHARACTERISTIC mREGNNE "ROM Const mREGNNE" VALUE 0x000089F4 REC_UBYTE_C 0 COMP_0006 0 3187.5 /end CHARACTERISTIC
/begin CHARACTERISTIC mREGSTOFS "ROM Const mREGSTOFS" VALUE 0x000089F6 REC_UBYTE_C 0 COMP_0007 0 510 /end CHARACTERISTIC
/begin CHARACTERISTIC mREGUPDLY "ROM Const mREGUPDLY" VALUE 0x000089F7 REC_UBYTE_C 0 COMP_0105 0 25.5 /end CHARACTERISTIC
/begin CHARACTERISTIC mRELR "ROM Const mRELR" VALUE 0x000093F0 REC_UWORD_C 0 COMP_0146 0 99.998480265 /end CHARACTERISTIC
/begin CHARACTERISTIC mRESCHOTM "ROM Const mRESCHOTM" VALUE 0x000089F8 REC_UBYTE_C 0 COMP_0015_S 0 25.5 /end CHARACTERISTIC
/begin CHARACTERISTIC mRESCHOTW "ROM Const mRESCHOTW" VALUE 0x000089F9 REC_UBYTE_C 0 COMP_0004_S -50 205 /end CHARACTERISTIC
/begin CHARACTERISTIC mRESISCMX "ROM Const mRESISCMX" VALUE 0x000093F2 REC_UWORD_C 0 COMP_0041 0 52.428 /end CHARACTERISTIC
/begin CHARACTERISTIC mRESNECUT "ROM Const mRESNECUT" VALUE 0x000089FA REC_UBYTE_C 0 COMP_0006 0 3187.5 /end CHARACTERISTIC
/begin CHARACTERISTIC mRESPAKTM "ROM Const mRESPAKTM" VALUE 0x000089FB REC_UBYTE_C 0 COMP_0015_S 0 25.5 /end CHARACTERISTIC
/begin CHARACTERISTIC mRESPAKTW "ROM Const mRESPAKTW" VALUE 0x000089FC REC_UBYTE_C 0 COMP_0004_S -50 205 /end CHARACTERISTIC
/begin CHARACTERISTIC mRESTDLY "ROM Const mRESTDLY" VALUE 0x000089FD REC_UBYTE_C 0 COMP_0014 0 2550 /end CHARACTERISTIC
/begin CHARACTERISTIC mRESTDLY2 "ROM Const mRESTDLY2" VALUE 0x000089FE REC_UBYTE_C 0 COMP_0008 0 25500 /end CHARACTERISTIC
/begin CHARACTERISTIC mRESTIHS2 "ROM Const mRESTIHS2" VALUE 0x000089FF REC_UBYTE_C 0 COMP_0009 0 199.21875 /end CHARACTERISTIC
/begin CHARACTERISTIC mRESTIHS3 "ROM Const mRESTIHS3" VALUE 0x00008A00 REC_UBYTE_C 0 COMP_0009 0 199.21875 /end CHARACTERISTIC
/begin CHARACTERISTIC mRESTIHS4 "ROM Const mRESTIHS4" VALUE 0x00008A01 REC_UBYTE_C 0 COMP_0009 0 199.21875 /end CHARACTERISTIC
/begin CHARACTERISTIC mRESTM "ROM Const mRESTM" VALUE 0x00008A02 REC_UBYTE_C 0 COMP_0250 0 1020 /end CHARACTERISTIC
/begin CHARACTERISTIC mRESTNE "ROM Const mRESTNE" VALUE 0x00008A03 REC_UBYTE_C 0 COMP_0006 0 3187.5 /end CHARACTERISTIC
/begin CHARACTERISTIC mRESTNE2 "ROM Const mRESTNE2" VALUE 0x00008A04 REC_UBYTE_C 0 COMP_0006 0 3187.5 /end CHARACTERISTIC
/begin CHARACTERISTIC mRESTOS "ROM Const mRESTOS" VALUE 0x00008A05 REC_UBYTE_C 0 COMP_0014 0 2550 /end CHARACTERISTIC
/begin CHARACTERISTIC mRESTRHYS "ROM Const mRESTRHYS" VALUE 0x000093F4 REC_UWORD_C 0 COMP_0164 0 19.988175 /end CHARACTERISTIC
/begin CHARACTERISTIC mRESTRUN "ROM Const mRESTRUN" VALUE 0x00008A06 REC_UBYTE_C 0 COMP_0013 0 255 /end CHARACTERISTIC
/begin CHARACTERISTIC mRESTSHTM "ROM Const mRESTSHTM" VALUE 0x00008A07 REC_UBYTE_C 0 COMP_0015_S 0 25.5 /end CHARACTERISTIC
/begin CHARACTERISTIC mRESTTW "ROM Const mRESTTW" VALUE 0x00008A08 REC_UBYTE_C 0 COMP_0035 -50 205 /end CHARACTERISTIC
/begin CHARACTERISTIC mRESUP "ROM Const mRESUP" VALUE 0x00009758 REC_SLONG_C 0 COMP_0144_S -1843.20024746394 1843.20024660563 /end CHARACTERISTIC
/begin CHARACTERISTIC mRESUP2 "ROM Const mRESUP2" VALUE 0x0000975C REC_SLONG_C 0 COMP_0144_S -1843.20024746394 1843.20024660563 /end CHARACTERISTIC
/begin CHARACTERISTIC mRESVB "ROM Const mRESVB" VALUE 0x00008A09 REC_UBYTE_C 0 COMP_0033 0 20400 /end CHARACTERISTIC
/begin CHARACTERISTIC mRETLMST "ROM Const mRETLMST" VALUE 0x0000823F REC_SBYTE_C 0 COMP_0018 -128 127 /end CHARACTERISTIC
/begin CHARACTERISTIC mRETLMT "ROM Const mRETLMT" VALUE 0x00008A0A REC_UBYTE_C 0 COMP_0017 0 255 /end CHARACTERISTIC
/begin CHARACTERISTIC mRETVBMN "ROM Const mRETVBMN" VALUE 0x00008A0B REC_UBYTE_C 0 COMP_0033 0 20400 /end CHARACTERISTIC
/begin CHARACTERISTIC mREVGAP "ROM Const mREVGAP" VALUE 0x000093F6 REC_UWORD_C 0 COMP_0443 0 65535 /end CHARACTERISTIC
/begin CHARACTERISTIC mREVJDG1 "ROM Const mREVJDG1" VALUE 0x00008A0C REC_UBYTE_C 0 COMP_0000 0 6375 /end CHARACTERISTIC
/begin CHARACTERISTIC mREVJIS "ROM Const mREVJIS" VALUE 0x00008A0D REC_UBYTE_C 0 COMP_0071 0 255 /end CHARACTERISTIC
/begin CHARACTERISTIC mRFBALH "ROM Const mRFBALH" VALUE 0x00008A0E REC_UBYTE_C 0 COMP_0027 0 255 /end CHARACTERISTIC
/begin CHARACTERISTIC mRFBALL "ROM Const mRFBALL" VALUE 0x00008A0F REC_UBYTE_C 0 COMP_0027 0 255 /end CHARACTERISTIC
/begin CHARACTERISTIC mRFBALT "ROM Const mRFBALT" VALUE 0x00008A10 REC_UBYTE_C 0 COMP_0049 0 255 /end CHARACTERISTIC
/begin CHARACTERISTIC mRFBDMN "ROM Const mRFBDMN" VALUE 0x00008A11 REC_UBYTE_C 0 COMP_0000 0 6375 /end CHARACTERISTIC
/begin CHARACTERISTIC mRFBDTP "ROM Const mRFBDTP" VALUE 0x00008A12 REC_UBYTE_C 0 COMP_0001 0 31.875 /end CHARACTERISTIC
/begin CHARACTERISTIC mRFBDTV "ROM Const mRFBDTV" VALUE 0x00008A13 REC_UBYTE_C 0 COMP_0002 0 89.25 /end CHARACTERISTIC
/begin CHARACTERISTIC mRFBFCT "ROM Const mRFBFCT" VALUE 0x00008A14 REC_UBYTE_C 0 COMP_0049 0 255 /end CHARACTERISTIC
/begin CHARACTERISTIC mRFBIDT "ROM Const mRFBIDT" VALUE 0x00008A15 REC_UBYTE_C 0 COMP_0049 0 255 /end CHARACTERISTIC
/begin CHARACTERISTIC mRFBKBH "ROM Const mRFBKBH" VALUE 0x00008A16 REC_UBYTE_C 0 COMP_0027 0 255 /end CHARACTERISTIC
/begin CHARACTERISTIC mRFBKBL "ROM Const mRFBKBL" VALUE 0x00008A17 REC_UBYTE_C 0 COMP_0027 0 255 /end CHARACTERISTIC
/begin CHARACTERISTIC mRFBKMT "ROM Const mRFBKMT" VALUE 0x00008A18 REC_UBYTE_C 0 COMP_0049 0 255 /end CHARACTERISTIC
/begin CHARACTERISTIC mRFBKRO "ROM Const mRFBKRO" VALUE 0x00008A19 REC_UBYTE_C 0 COMP_0044 0 1.9921875 /end CHARACTERISTIC
/begin CHARACTERISTIC mRFBMNH "ROM Const mRFBMNH" VALUE 0x00008A1A REC_UBYTE_C 0 COMP_0000 0 6375 /end CHARACTERISTIC
/begin CHARACTERISTIC mRFBMNL "ROM Const mRFBMNL" VALUE 0x00008A1B REC_UBYTE_C 0 COMP_0000 0 6375 /end CHARACTERISTIC
/begin CHARACTERISTIC mRFBSLH "ROM Const mRFBSLH" VALUE 0x00008A1C REC_UBYTE_C 0 COMP_0104 0 2550 /end CHARACTERISTIC
/begin CHARACTERISTIC mRFBSLL "ROM Const mRFBSLL" VALUE 0x00008A1D REC_UBYTE_C 0 COMP_0104 0 2550 /end CHARACTERISTIC
/begin CHARACTERISTIC mRFBTPH "ROM Const mRFBTPH" VALUE 0x00008A1E REC_UBYTE_C 0 COMP_0001 0 31.875 /end CHARACTERISTIC
/begin CHARACTERISTIC mRFBTPL "ROM Const mRFBTPL" VALUE 0x00008A1F REC_UBYTE_C 0 COMP_0001 0 31.875 /end CHARACTERISTIC
/begin CHARACTERISTIC mRFBVSL "ROM Const mRFBVSL" VALUE 0x00008A20 REC_UBYTE_C 0 COMP_0007 0 510 /end CHARACTERISTIC
/begin CHARACTERISTIC mRFCFMTM "ROM Const mRFCFMTM" VALUE 0x00008A21 REC_UBYTE_C 0 COMP_0013 0 255 /end CHARACTERISTIC
/begin CHARACTERISTIC mRFHSPEDC "ROM Const mRFHSPEDC" VALUE 0x00008E7E REC_SWORD_C 0 COMP_0002_S -32768 32767 /end CHARACTERISTIC
/begin CHARACTERISTIC mRFHSPEDO "ROM Const mRFHSPEDO" VALUE 0x00008E80 REC_SWORD_C 0 COMP_0002_S -32768 32767 /end CHARACTERISTIC
/begin CHARACTERISTIC mRFLSPEDC "ROM Const mRFLSPEDC" VALUE 0x00008E82 REC_SWORD_C 0 COMP_0002_S -32768 32767 /end CHARACTERISTIC
/begin CHARACTERISTIC mRFLSPEDO "ROM Const mRFLSPEDO" VALUE 0x00008E84 REC_SWORD_C 0 COMP_0002_S -32768 32767 /end CHARACTERISTIC
/begin CHARACTERISTIC mRFMSKTM "ROM Const mRFMSKTM" VALUE 0x000093F8 REC_UWORD_C 0 COMP_0013 0 65535 /end CHARACTERISTIC
/begin CHARACTERISTIC mRFNDLY1 "ROM Const mRFNDLY1" VALUE 0x00008A22 REC_UBYTE_C 0 COMP_0014 0 2550 /end CHARACTERISTIC
/begin CHARACTERISTIC mRFNDLY2 "ROM Const mRFNDLY2" VALUE 0x00008A23 REC_UBYTE_C 0 COMP_0014 0 2550 /end CHARACTERISTIC
/begin CHARACTERISTIC mRFO2GO "ROM Const mRFO2GO" VALUE 0x00008A24 REC_UBYTE_C 0 COMP_0013 0 255 /end CHARACTERISTIC
/begin CHARACTERISTIC mRFO2SH "ROM Const mRFO2SH" VALUE 0x00008A25 REC_UBYTE_C 0 COMP_0104 0 2550 /end CHARACTERISTIC
/begin CHARACTERISTIC mRFO2SL "ROM Const mRFO2SL" VALUE 0x00008A26 REC_UBYTE_C 0 COMP_0104 0 2550 /end CHARACTERISTIC
/begin CHARACTERISTIC mRFOEVP "ROM Const mRFOEVP" VALUE 0x00008A27 REC_UBYTE_C 0 COMP_0013 0 255 /end CHARACTERISTIC
/begin CHARACTERISTIC mRFPDHI "ROM Const mRFPDHI" VALUE 0x00008A28 REC_UBYTE_C 0 COMP_0011 0 5.1 /end CHARACTERISTIC
/begin CHARACTERISTIC mRFQDLY1 "ROM Const mRFQDLY1" VALUE 0x00008A29 REC_UBYTE_C 0 COMP_0014 0 2550 /end CHARACTERISTIC
/begin CHARACTERISTIC mRFQDLY2 "ROM Const mRFQDLY2" VALUE 0x00008A2A REC_UBYTE_C 0 COMP_0014 0 2550 /end CHARACTERISTIC
/begin CHARACTERISTIC mRFTW1 "ROM Const mRFTW1" VALUE 0x00008A2B REC_UBYTE_C 0 COMP_0035 -50 205 /end CHARACTERISTIC
/begin CHARACTERISTIC mRFTW10 "ROM Const mRFTW10" VALUE 0x00008A2C REC_UBYTE_C 0 COMP_0035 -50 205 /end CHARACTERISTIC
/begin CHARACTERISTIC mRFTW11 "ROM Const mRFTW11" VALUE 0x00008A2D REC_UBYTE_C 0 COMP_0035 -50 205 /end CHARACTERISTIC
/begin CHARACTERISTIC mRFTW12 "ROM Const mRFTW12" VALUE 0x00008A2E REC_UBYTE_C 0 COMP_0035 -50 205 /end CHARACTERISTIC
/begin CHARACTERISTIC mRFTW13 "ROM Const mRFTW13" VALUE 0x00008A2F REC_UBYTE_C 0 COMP_0035 -50 205 /end CHARACTERISTIC
/begin CHARACTERISTIC mRFTW14 "ROM Const mRFTW14" VALUE 0x00008A30 REC_UBYTE_C 0 COMP_0035 -50 205 /end CHARACTERISTIC
/begin CHARACTERISTIC mRFTW15 "ROM Const mRFTW15" VALUE 0x00008A31 REC_UBYTE_C 0 COMP_0035 -50 205 /end CHARACTERISTIC
/begin CHARACTERISTIC mRFTW16 "ROM Const mRFTW16" VALUE 0x00008A32 REC_UBYTE_C 0 COMP_0035 -50 205 /end CHARACTERISTIC
/begin CHARACTERISTIC mRFTW17 "ROM Const mRFTW17" VALUE 0x00008A33 REC_UBYTE_C 0 COMP_0035 -50 205 /end CHARACTERISTIC
/begin CHARACTERISTIC mRFTW18 "ROM Const mRFTW18" VALUE 0x00008A34 REC_UBYTE_C 0 COMP_0035 -50 205 /end CHARACTERISTIC
/begin CHARACTERISTIC mRFTW19 "ROM Const mRFTW19" VALUE 0x00008A35 REC_UBYTE_C 0 COMP_0035 -50 205 /end CHARACTERISTIC
/begin CHARACTERISTIC mRFTW2 "ROM Const mRFTW2" VALUE 0x00008A36 REC_UBYTE_C 0 COMP_0035 -50 205 /end CHARACTERISTIC
/begin CHARACTERISTIC mRFTW20 "ROM Const mRFTW20" VALUE 0x00008A37 REC_UBYTE_C 0 COMP_0035 -50 205 /end CHARACTERISTIC
/begin CHARACTERISTIC mRFTW21 "ROM Const mRFTW21" VALUE 0x00008A38 REC_UBYTE_C 0 COMP_0035 -50 205 /end CHARACTERISTIC
/begin CHARACTERISTIC mRFTW22 "ROM Const mRFTW22" VALUE 0x00008A39 REC_UBYTE_C 0 COMP_0035 -50 205 /end CHARACTERISTIC
/begin CHARACTERISTIC mRFTW23 "ROM Const mRFTW23" VALUE 0x00008A3A REC_UBYTE_C 0 COMP_0035 -50 205 /end CHARACTERISTIC
/begin CHARACTERISTIC mRFTW24 "ROM Const mRFTW24" VALUE 0x00008A3B REC_UBYTE_C 0 COMP_0035 -50 205 /end CHARACTERISTIC
/begin CHARACTERISTIC mRFTW3 "ROM Const mRFTW3" VALUE 0x00008A3C REC_UBYTE_C 0 COMP_0035 -50 205 /end CHARACTERISTIC
/begin CHARACTERISTIC mRFTW4 "ROM Const mRFTW4" VALUE 0x00008A3D REC_UBYTE_C 0 COMP_0035 -50 205 /end CHARACTERISTIC
/begin CHARACTERISTIC mRFTW5 "ROM Const mRFTW5" VALUE 0x00008A3E REC_UBYTE_C 0 COMP_0035 -50 205 /end CHARACTERISTIC
/begin CHARACTERISTIC mRFTW6 "ROM Const mRFTW6" VALUE 0x00008A3F REC_UBYTE_C 0 COMP_0035 -50 205 /end CHARACTERISTIC
/begin CHARACTERISTIC mRFTW7 "ROM Const mRFTW7" VALUE 0x00008A40 REC_UBYTE_C 0 COMP_0035 -50 205 /end CHARACTERISTIC
/begin CHARACTERISTIC mRFTW8 "ROM Const mRFTW8" VALUE 0x00008A41 REC_UBYTE_C 0 COMP_0035 -50 205 /end CHARACTERISTIC
/begin CHARACTERISTIC mRFTW9 "ROM Const mRFTW9" VALUE 0x00008A42 REC_UBYTE_C 0 COMP_0035 -50 205 /end CHARACTERISTIC
/begin CHARACTERISTIC mRFTWHI "ROM Const mRFTWHI" VALUE 0x00008A43 REC_UBYTE_C 0 COMP_0035 -50 205 /end CHARACTERISTIC
/begin CHARACTERISTIC mRFTWHYS "ROM Const mRFTWHYS" VALUE 0x00008A44 REC_UBYTE_C 0 COMP_0003 0 255 /end CHARACTERISTIC
/begin CHARACTERISTIC mRFUELCR "ROM Const mRFUELCR" VALUE 0x00008E86 REC_SWORD_C 0 COMP_0002_S -32768 32767 /end CHARACTERISTIC
/begin CHARACTERISTIC mRFUELDLY "ROM Const mRFUELDLY" VALUE 0x00008A45 REC_UBYTE_C 0 COMP_0105 0 25.5 /end CHARACTERISTIC
/begin CHARACTERISTIC mRICHG "ROM Const mRICHG" VALUE 0x00008240 REC_SBYTE_C 0 COMP_0472 -2 1.984375 /end CHARACTERISTIC
/begin CHARACTERISTIC mRICHLMT "ROM Const mRICHLMT" VALUE 0x000093FA REC_UWORD_C 0 COMP_0453 0 131.07 /end CHARACTERISTIC
/begin CHARACTERISTIC mRICHLMTL "ROM Const mRICHLMTL" VALUE 0x000093FC REC_UWORD_C 0 COMP_0453 0 131.07 /end CHARACTERISTIC
/begin CHARACTERISTIC mRICLMTLC "ROM Const mRICLMTLC" VALUE 0x000093FE REC_UWORD_C 0 COMP_0453 0 131.07 /end CHARACTERISTIC
/begin CHARACTERISTIC mRID "ROM Const mRID" VALUE 0x00008E88 REC_SWORD_C 0 COMP_0005_S -3.2768 3.2767 /end CHARACTERISTIC
/begin CHARACTERISTIC mRINLDT "ROM Const mRINLDT" VALUE 0x00009400 REC_UWORD_C 0 COMP_0202 0 655350 /end CHARACTERISTIC
/begin CHARACTERISTIC mRKBRA "ROM Const mRKBRA" VALUE 0x00008A47 REC_UBYTE_C 0 COMP_0027 0 255 /end CHARACTERISTIC
/begin CHARACTERISTIC mRKBRBA "ROM Const mRKBRBA" VALUE 0x00008A48 REC_UBYTE_C 0 COMP_0027 0 255 /end CHARACTERISTIC
/begin CHARACTERISTIC mRLCRT "ROM Const mRLCRT" VALUE 0x00009402 REC_UWORD_C 0 COMP_0453 0 131.07 /end CHARACTERISTIC
/begin CHARACTERISTIC mRLDTGAIN "ROM Const mRLDTGAIN" VALUE 0x00009404 REC_UWORD_C 0 COMP_0450 0 63.999056205 /end CHARACTERISTIC
/begin CHARACTERISTIC mRLEVERWG "ROM Const mRLEVERWG" VALUE 0x00008A49 REC_UBYTE_C 0 COMP_0045 0 1.9921875 /end CHARACTERISTIC
/begin CHARACTERISTIC mRLHTW "ROM Const mRLHTW" VALUE 0x00008A4A REC_UBYTE_C 0 COMP_0035 -50 205 /end CHARACTERISTIC
/begin CHARACTERISTIC mRLHTWHYS "ROM Const mRLHTWHYS" VALUE 0x00008A4B REC_UBYTE_C 0 COMP_0003 0 255 /end CHARACTERISTIC
/begin CHARACTERISTIC mRLIGAIN "ROM Const mRLIGAIN" VALUE 0x00009406 REC_UWORD_C 0 COMP_0230_S 0 65.535 /end CHARACTERISTIC
/begin CHARACTERISTIC mRLIGAIN0 "ROM Const mRLIGAIN0" VALUE 0x00009408 REC_UWORD_C 0 COMP_0230_S 0 65.535 /end CHARACTERISTIC
/begin CHARACTERISTIC mRLIGDLY "ROM Const mRLIGDLY" VALUE 0x00008A4C REC_UBYTE_C 0 COMP_0014 0 2550 /end CHARACTERISTIC
/begin CHARACTERISTIC mRLMT "ROM Const mRLMT" VALUE 0x00008A4D REC_UBYTE_C 0 COMP_0017 0 255 /end CHARACTERISTIC
/begin CHARACTERISTIC mRLPGAIN "ROM Const mRLPGAIN" VALUE 0x0000940A REC_UWORD_C 0 COMP_0231_S 0 65.535 /end CHARACTERISTIC
/begin CHARACTERISTIC mRLRC0 "ROM Const mRLRC0" VALUE 0x00008A4E REC_UBYTE_C 0 COMP_0021 0 99.609375 /end CHARACTERISTIC
/begin CHARACTERISTIC mRLRMNS "ROM Const mRLRMNS" VALUE 0x00008A4F REC_UBYTE_C 0 COMP_0027 0 255 /end CHARACTERISTIC
/begin CHARACTERISTIC mRLRMXS "ROM Const mRLRMXS" VALUE 0x00008A50 REC_UBYTE_C 0 COMP_0027 0 255 /end CHARACTERISTIC
/begin CHARACTERISTIC mRLRPM "ROM Const mRLRPM" VALUE 0x0000940C REC_UWORD_C 0 COMP_0162_S 0 51199.21875 /end CHARACTERISTIC
/begin CHARACTERISTIC mRLRPMDCL "ROM Const mRLRPMDCL" VALUE 0x0000940E REC_UWORD_C 0 COMP_0232_S 0 51199.21875 /end CHARACTERISTIC
/begin CHARACTERISTIC mRLRPMHTW "ROM Const mRLRPMHTW" VALUE 0x00009410 REC_UWORD_C 0 COMP_0162_S 0 51199.21875 /end CHARACTERISTIC
/begin CHARACTERISTIC mRLRPMICL "ROM Const mRLRPMICL" VALUE 0x00009412 REC_UWORD_C 0 COMP_0232_S 0 51199.21875 /end CHARACTERISTIC
/begin CHARACTERISTIC mRLTEREC1 "ROM Const mRLTEREC1" VALUE 0x00009414 REC_UWORD_C 0 COMP_0193 0 6553.5 /end CHARACTERISTIC
/begin CHARACTERISTIC mRLTEREC2 "ROM Const mRLTEREC2" VALUE 0x00009416 REC_UWORD_C 0 COMP_0193 0 6553.5 /end CHARACTERISTIC
/begin CHARACTERISTIC mRLTRRNEH "ROM Const mRLTRRNEH" VALUE 0x00008A51 REC_UBYTE_C 0 COMP_0054_S 0 3.984375 /end CHARACTERISTIC
/begin CHARACTERISTIC mRLTRRNEL "ROM Const mRLTRRNEL" VALUE 0x00008A52 REC_UBYTE_C 0 COMP_0054_S 0 3.984375 /end CHARACTERISTIC
/begin CHARACTERISTIC mRLVAPO "ROM Const mRLVAPO" VALUE 0x00009418 REC_UWORD_C 0 COMP_0005 0 7208.85 /end CHARACTERISTIC
/begin CHARACTERISTIC mRMINHR "ROM Const mRMINHR" VALUE 0x00008A53 REC_UBYTE_C 0 COMP_0233_S 0 1020 /end CHARACTERISTIC
/begin CHARACTERISTIC mRMINHR_S "ROM Const mRMINHR_S" VALUE 0x000157D6 REC_UBYTE_C 0 COMP_0233_S 0 1020 /end CHARACTERISTIC
/begin CHARACTERISTIC mRMINHV "ROM Const mRMINHV" VALUE 0x00008A54 REC_UBYTE_C 0 COMP_0436 0 25.5 /end CHARACTERISTIC
/begin CHARACTERISTIC mRMINHV_S "ROM Const mRMINHV_S" VALUE 0x000157D7 REC_UBYTE_C 0 COMP_0436 0 25.5 /end CHARACTERISTIC
/begin CHARACTERISTIC mRO2DMXF1 "ROM Const mRO2DMXF1" VALUE 0x0000941A REC_UWORD_C 0 COMP_0187_S 0 2559.9609375 /end CHARACTERISTIC
/begin CHARACTERISTIC mRO2DMXF2 "ROM Const mRO2DMXF2" VALUE 0x0000941C REC_UWORD_C 0 COMP_0187_S 0 2559.9609375 /end CHARACTERISTIC
/begin CHARACTERISTIC mRO2HCTD "ROM Const mRO2HCTD" VALUE 0x00008A55 REC_UBYTE_C 0 COMP_0008 0 25500 /end CHARACTERISTIC
/begin CHARACTERISTIC mRO2HTWN "ROM Const mRO2HTWN" VALUE 0x00008A56 REC_UBYTE_C 0 COMP_0035 -50 205 /end CHARACTERISTIC
/begin CHARACTERISTIC mRO2REV1 "ROM Const mRO2REV1" VALUE 0x00008A57 REC_UBYTE_C 0 COMP_0062_S 0 255 /end CHARACTERISTIC
/begin CHARACTERISTIC mRO2REV2 "ROM Const mRO2REV2" VALUE 0x00008A58 REC_UBYTE_C 0 COMP_0062_S 0 255 /end CHARACTERISTIC
/begin CHARACTERISTIC mRO2STINF "ROM Const mRO2STINF" VALUE 0x0000941E REC_UWORD_C 0 COMP_0187_S 0 2559.9609375 /end CHARACTERISTIC
/begin CHARACTERISTIC mRO2TMHMX "ROM Const mRO2TMHMX" VALUE 0x00008A59 REC_UBYTE_C 0 COMP_0008 0 25500 /end CHARACTERISTIC
/begin CHARACTERISTIC mRO2UPDTY "ROM Const mRO2UPDTY" VALUE 0x00008A5A REC_UBYTE_C 0 COMP_0234_S 0 9.9609375 /end CHARACTERISTIC
/begin CHARACTERISTIC mRO2V5S "ROM Const mRO2V5S" VALUE 0x00008A5B REC_UBYTE_C 0 COMP_0104 0 2550 /end CHARACTERISTIC
/begin CHARACTERISTIC mRO2VDEF "ROM Const mRO2VDEF" VALUE 0x00009420 REC_UWORD_C 0 COMP_0061 0 327675 /end CHARACTERISTIC
/begin CHARACTERISTIC mRODRDN "ROM Const mRODRDN" VALUE 0x00008A5C REC_UBYTE_C 0 COMP_0030 0 255 /end CHARACTERISTIC
/begin CHARACTERISTIC mRODRDT "ROM Const mRODRDT" VALUE 0x00009422 REC_UWORD_C 0 COMP_0187_S 0 2559.9609375 /end CHARACTERISTIC
/begin CHARACTERISTIC mRODRDTM "ROM Const mRODRDTM" VALUE 0x00008A5D REC_UBYTE_C 0 COMP_0008 0 25500 /end CHARACTERISTIC
/begin CHARACTERISTIC mRODRFCD "ROM Const mRODRFCD" VALUE 0x00008A5E REC_UBYTE_C 0 COMP_0008 0 25500 /end CHARACTERISTIC
/begin CHARACTERISTIC mRODRFCT "ROM Const mRODRFCT" VALUE 0x00008A5F REC_UBYTE_C 0 COMP_0008 0 25500 /end CHARACTERISTIC
/begin CHARACTERISTIC mRODRJDL "ROM Const mRODRJDL" VALUE 0x00008A60 REC_UBYTE_C 0 COMP_0008 0 25500 /end CHARACTERISTIC
/begin CHARACTERISTIC mRODRMNG "ROM Const mRODRMNG" VALUE 0x00008A61 REC_UBYTE_C 0 COMP_0008 0 25500 /end CHARACTERISTIC
/begin CHARACTERISTIC mRODRVH "ROM Const mRODRVH" VALUE 0x00008A62 REC_UBYTE_C 0 COMP_0104 0 2550 /end CHARACTERISTIC
/begin CHARACTERISTIC mRODRVL "ROM Const mRODRVL" VALUE 0x00008A63 REC_UBYTE_C 0 COMP_0104 0 2550 /end CHARACTERISTIC
/begin CHARACTERISTIC mROHCMN "ROM Const mROHCMN" VALUE 0x00008A64 REC_UBYTE_C 0 COMP_0054 0 5100 /end CHARACTERISTIC
/begin CHARACTERISTIC mROHCMX "ROM Const mROHCMX" VALUE 0x00008A65 REC_UBYTE_C 0 COMP_0054 0 5100 /end CHARACTERISTIC
/begin CHARACTERISTIC mROHONT "ROM Const mROHONT" VALUE 0x00008A66 REC_UBYTE_C 0 COMP_0049 0 255 /end CHARACTERISTIC
/begin CHARACTERISTIC mROHTM "ROM Const mROHTM" VALUE 0x00008A67 REC_UBYTE_C 0 COMP_0049 0 255 /end CHARACTERISTIC
/begin CHARACTERISTIC mROHVBL "ROM Const mROHVBL" VALUE 0x00008A68 REC_UBYTE_C 0 COMP_0033 0 20400 /end CHARACTERISTIC
/begin CHARACTERISTIC mROIZS2 "ROM Const mROIZS2" VALUE 0x000097E8 REC_ULONG_C 0 COMP_0092 0 4294967295 /end CHARACTERISTIC
/begin CHARACTERISTIC mROJDLY "ROM Const mROJDLY" VALUE 0x00008A69 REC_UBYTE_C 0 COMP_0049 0 255 /end CHARACTERISTIC
/begin CHARACTERISTIC mROJFCC "ROM Const mROJFCC" VALUE 0x00008A6A REC_UBYTE_C 0 COMP_0030 0 255 /end CHARACTERISTIC
/begin CHARACTERISTIC mROJFCD "ROM Const mROJFCD" VALUE 0x00008A6B REC_UBYTE_C 0 COMP_0049 0 255 /end CHARACTERISTIC
/begin CHARACTERISTIC mROJFCT "ROM Const mROJFCT" VALUE 0x00008A6C REC_UBYTE_C 0 COMP_0008 0 25500 /end CHARACTERISTIC
/begin CHARACTERISTIC mROMNG_S "ROM Const mROMNG_S" VALUE 0x000157D8 REC_UBYTE_C 0 COMP_0068 0 255 /end CHARACTERISTIC
/begin CHARACTERISTIC mRONKAJYU "ROM Const mRONKAJYU" VALUE 0x00008A6D REC_UBYTE_C 0 COMP_0063 0 0.99609375 /end CHARACTERISTIC
/begin CHARACTERISTIC mRONLMHH "ROM Const mRONLMHH" VALUE 0x00009424 REC_UWORD_C 0 COMP_0235_S 0 8191.875 /end CHARACTERISTIC
/begin CHARACTERISTIC mRONLMTH "ROM Const mRONLMTH" VALUE 0x00008A6E REC_UBYTE_C 0 COMP_0201_S 75 106.875 /end CHARACTERISTIC
/begin CHARACTERISTIC mRONLMTL "ROM Const mRONLMTL" VALUE 0x00008A6F REC_UBYTE_C 0 COMP_0201_S 75 106.875 /end CHARACTERISTIC
/begin CHARACTERISTIC mROOUS2 "ROM Const mROOUS2" VALUE 0x00008A70 REC_UBYTE_C 0 COMP_0016 0 255 /end CHARACTERISTIC
/begin CHARACTERISTIC mROXJSD "ROM Const mROXJSD" VALUE 0x00008A71 REC_UBYTE_C 0 COMP_0049 0 255 /end CHARACTERISTIC
/begin CHARACTERISTIC mROXJT1 "ROM Const mROXJT1" VALUE 0x00009426 REC_UWORD_C 0 COMP_0049 0 65535 /end CHARACTERISTIC
/begin CHARACTERISTIC mROXLNG "ROM Const mROXLNG" VALUE 0x00008A72 REC_UBYTE_C 0 COMP_0104 0 2550 /end CHARACTERISTIC
/begin CHARACTERISTIC mROXRNG "ROM Const mROXRNG" VALUE 0x00008A73 REC_UBYTE_C 0 COMP_0104 0 2550 /end CHARACTERISTIC
/begin CHARACTERISTIC mRPDGIN "ROM Const mRPDGIN" VALUE 0x00008A74 REC_UBYTE_C 0 COMP_0285 0 0.00255 /end CHARACTERISTIC
/begin CHARACTERISTIC mRPMMNC "ROM Const mRPMMNC" VALUE 0x00008A75 REC_UBYTE_C 0 COMP_0006 0 3187.5 /end CHARACTERISTIC
/begin CHARACTERISTIC mRPMMVL "ROM Const mRPMMVL" VALUE 0x00008A76 REC_UBYTE_C 0 COMP_0006 0 3187.5 /end CHARACTERISTIC
/begin CHARACTERISTIC mRPMSSTH "ROM Const mRPMSSTH" VALUE 0x00008A77 REC_UBYTE_C 0 COMP_0006 0 3187.5 /end CHARACTERISTIC
/begin CHARACTERISTIC mRPMSSTL "ROM Const mRPMSSTL" VALUE 0x00008A78 REC_UBYTE_C 0 COMP_0006 0 3187.5 /end CHARACTERISTIC
/begin CHARACTERISTIC mRPMVHYS "ROM Const mRPMVHYS" VALUE 0x00008A79 REC_UBYTE_C 0 COMP_0006 0 3187.5 /end CHARACTERISTIC
/begin CHARACTERISTIC mRQASFTN "ROM Const mRQASFTN" VALUE 0x00009428 REC_UWORD_C 0 COMP_0217 0 3.999941832 /end CHARACTERISTIC
/begin CHARACTERISTIC mRQASTKIR "ROM Const mRQASTKIR" VALUE 0x0000942A REC_UWORD_C 0 COMP_0217 0 3.999941832 /end CHARACTERISTIC
/begin CHARACTERISTIC mRQAVR "ROM Const mRQAVR" VALUE 0x00008A7A REC_UBYTE_C 0 COMP_0032 0 0.99609375 /end CHARACTERISTIC
/begin CHARACTERISTIC mRQAVR2 "ROM Const mRQAVR2" VALUE 0x00008A7B REC_UBYTE_C 0 COMP_0063 0 0.99609375 /end CHARACTERISTIC
/begin CHARACTERISTIC mRRATIO "ROM Const mRRATIO" VALUE 0x0000942C REC_UWORD_C 0 COMP_0236_S 0 63.99899067 /end CHARACTERISTIC
/begin CHARACTERISTIC mRRATIO_S "ROM Const mRRATIO_S" VALUE 0x00015A1A REC_UWORD_C 0 COMP_0450 0 63.999056205 /end CHARACTERISTIC
/begin CHARACTERISTIC mRSADVRMX "ROM Const mRSADVRMX" VALUE 0x00008241 REC_SBYTE_C 0 COMP_0018 -128 127 /end CHARACTERISTIC
/begin CHARACTERISTIC mRSISMX_S "ROM Const mRSISMX_S" VALUE 0x00015A1C REC_UWORD_C 0 COMP_0041 0 52.428 /end CHARACTERISTIC
/begin CHARACTERISTIC mRSREFJD1 "ROM Const mRSREFJD1" VALUE 0x00008A7E REC_UBYTE_C 0 COMP_0068 0 255 /end CHARACTERISTIC
/begin CHARACTERISTIC mRSREFJDG "ROM Const mRSREFJDG" VALUE 0x00008A7F REC_UBYTE_C 0 COMP_0068 0 255 /end CHARACTERISTIC
/begin CHARACTERISTIC mRSTNGCNT "ROM Const mRSTNGCNT" VALUE 0x00008A80 REC_UBYTE_C 0 COMP_0016 0 255 /end CHARACTERISTIC
/begin CHARACTERISTIC mRSVSP "ROM Const mRSVSP" VALUE 0x00008A81 REC_UBYTE_C 0 COMP_0007 0 510 /end CHARACTERISTIC
/begin CHARACTERISTIC mRTBYGF "ROM Const mRTBYGF" VALUE 0x0000942E REC_UWORD_C 0 COMP_0237_S 0 0.3999941832 /end CHARACTERISTIC
/begin CHARACTERISTIC mRTGABF "ROM Const mRTGABF" VALUE 0x00009430 REC_UWORD_C 0 COMP_0453 0 131.07 /end CHARACTERISTIC
/begin CHARACTERISTIC mRTMLNG "ROM Const mRTMLNG" VALUE 0x00008A82 REC_UBYTE_C 0 COMP_0021 0 99.609375 /end CHARACTERISTIC
/begin CHARACTERISTIC mRTMLOK "ROM Const mRTMLOK" VALUE 0x00008A83 REC_UBYTE_C 0 COMP_0021 0 99.609375 /end CHARACTERISTIC
/begin CHARACTERISTIC mRTNTMN "ROM Const mRTNTMN" VALUE 0x00009432 REC_UWORD_C 0 COMP_0069 0 1.999970916 /end CHARACTERISTIC
/begin CHARACTERISTIC mRTNTMX "ROM Const mRTNTMX" VALUE 0x00009434 REC_UWORD_C 0 COMP_0069 0 1.999970916 /end CHARACTERISTIC
/begin CHARACTERISTIC mRTOENDOF "ROM Const mRTOENDOF" VALUE 0x00009436 REC_UWORD_C 0 COMP_0236_S 0 63.99899067 /end CHARACTERISTIC
/begin CHARACTERISTIC mRTOHAPO "ROM Const mRTOHAPO" VALUE 0x00008A84 REC_UBYTE_C 0 COMP_0002 0 89.25 /end CHARACTERISTIC
/begin CHARACTERISTIC mRTOHDLY "ROM Const mRTOHDLY" VALUE 0x00008A85 REC_UBYTE_C 0 COMP_0014 0 2550 /end CHARACTERISTIC
/begin CHARACTERISTIC mRTOHLDTM "ROM Const mRTOHLDTM" VALUE 0x00008A86 REC_UBYTE_C 0 COMP_0014 0 2550 /end CHARACTERISTIC
/begin CHARACTERISTIC mRTOTREND "ROM Const mRTOTREND" VALUE 0x00008A87 REC_UBYTE_C 0 COMP_0425 0 99.99999981 /end CHARACTERISTIC
/begin CHARACTERISTIC mRTOTRST "ROM Const mRTOTRST" VALUE 0x00008A88 REC_UBYTE_C 0 COMP_0425 0 99.99999981 /end CHARACTERISTIC
/begin CHARACTERISTIC mRVMALPL "ROM Const mRVMALPL" VALUE 0x00008A89 REC_UBYTE_C 0 COMP_0027 0 255 /end CHARACTERISTIC
/begin CHARACTERISTIC mRVMALPU "ROM Const mRVMALPU" VALUE 0x00008A8A REC_UBYTE_C 0 COMP_0027 0 255 /end CHARACTERISTIC
/begin CHARACTERISTIC mSCASTP "ROM Const mSCASTP" VALUE 0x00008A8C REC_UBYTE_C 0 COMP_0289 0 99.609375 /end CHARACTERISTIC
/begin CHARACTERISTIC mSCCFEQ "ROM Const mSCCFEQ" VALUE 0x00008A8D REC_UBYTE_C 0 COMP_0373 0 2.55 /end CHARACTERISTIC
/begin CHARACTERISTIC mSCKDLY "ROM Const mSCKDLY" VALUE 0x00008A8E REC_UBYTE_C 0 COMP_0014 0 2550 /end CHARACTERISTIC
/begin CHARACTERISTIC mSCKLUDLY "ROM Const mSCKLUDLY" VALUE 0x00008A8F REC_UBYTE_C 0 COMP_0014 0 2550 /end CHARACTERISTIC
/begin CHARACTERISTIC mSCKOWCN2 "ROM Const mSCKOWCN2" VALUE 0x00009438 REC_UWORD_C 0 COMP_0065 0 204796.875 /end CHARACTERISTIC
/begin CHARACTERISTIC mSCKOWCNE "ROM Const mSCKOWCNE" VALUE 0x0000943A REC_UWORD_C 0 COMP_0065 0 204796.875 /end CHARACTERISTIC
/begin CHARACTERISTIC mSCKRETTM "ROM Const mSCKRETTM" VALUE 0x00008A90 REC_UBYTE_C 0 COMP_0014 0 2550 /end CHARACTERISTIC
/begin CHARACTERISTIC mSCKVAPO "ROM Const mSCKVAPO" VALUE 0x0000943C REC_UWORD_C 0 COMP_0005 0 7208.85 /end CHARACTERISTIC
/begin CHARACTERISTIC mSCKVSP "ROM Const mSCKVSP" VALUE 0x00008A91 REC_UBYTE_C 0 COMP_0007 0 510 /end CHARACTERISTIC
/begin CHARACTERISTIC mSCNGTP "ROM Const mSCNGTP" VALUE 0x00008A92 REC_UBYTE_C 0 COMP_0001 0 31.875 /end CHARACTERISTIC
/begin CHARACTERISTIC mSCVDL2 "ROM Const mSCVDL2" VALUE 0x00008A94 REC_UBYTE_C 0 COMP_0014 0 2550 /end CHARACTERISTIC
/begin CHARACTERISTIC mSCVDLY "ROM Const mSCVDLY" VALUE 0x00008A95 REC_UBYTE_C 0 COMP_0014 0 2550 /end CHARACTERISTIC
/begin CHARACTERISTIC mSCVDTM "ROM Const mSCVDTM" VALUE 0x00008A96 REC_UBYTE_C 0 COMP_0008 0 25500 /end CHARACTERISTIC
/begin CHARACTERISTIC mSCVDVSTP "ROM Const mSCVDVSTP" VALUE 0x00008A97 REC_UBYTE_C 0 COMP_0021 0 99.609375 /end CHARACTERISTIC
/begin CHARACTERISTIC mSCVK "ROM Const mSCVK" VALUE 0x00008A98 REC_UBYTE_C 0 COMP_0095 0 398.4375 /end CHARACTERISTIC
/begin CHARACTERISTIC mSENRPMH "ROM Const mSENRPMH" VALUE 0x0000943E REC_UWORD_C 0 COMP_0006 0 819187.5 /end CHARACTERISTIC
/begin CHARACTERISTIC mSESSTL "ROM Const mSESSTL" VALUE 0x00009440 REC_UWORD_C 0 COMP_0061 0 327675 /end CHARACTERISTIC
/begin CHARACTERISTIC mSESSTR "ROM Const mSESSTR" VALUE 0x00009442 REC_UWORD_C 0 COMP_0061 0 327675 /end CHARACTERISTIC
/begin CHARACTERISTIC mSETAGT "ROM Const mSETAGT" VALUE 0x00008A99 REC_UBYTE_C 0 COMP_0006 0 3187.5 /end CHARACTERISTIC
/begin CHARACTERISTIC mSFRQLUHT "ROM Const mSFRQLUHT" VALUE 0x00008A9A REC_UBYTE_C 0 COMP_0068 0 255 /end CHARACTERISTIC
/begin CHARACTERISTIC mSGADVDNE "ROM Const mSGADVDNE" VALUE 0x00008A9B REC_UBYTE_C 0 COMP_0476 0 49.8046875 /end CHARACTERISTIC
/begin CHARACTERISTIC mSGCHKDLY "ROM Const mSGCHKDLY" VALUE 0x00008A9C REC_UBYTE_C 0 COMP_0008 0 25500 /end CHARACTERISTIC
/begin CHARACTERISTIC mSGFRENUM "ROM Const mSGFRENUM" VALUE 0x00008A9D REC_UBYTE_C 0 COMP_0030 0 255 /end CHARACTERISTIC
/begin CHARACTERISTIC mSGFRETMH "ROM Const mSGFRETMH" VALUE 0x00008A9E REC_UBYTE_C 0 COMP_0014 0 2550 /end CHARACTERISTIC
/begin CHARACTERISTIC mSGFRETML "ROM Const mSGFRETML" VALUE 0x00008A9F REC_UBYTE_C 0 COMP_0014 0 2550 /end CHARACTERISTIC
/begin CHARACTERISTIC mSGIGNNUM "ROM Const mSGIGNNUM" VALUE 0x00008AA0 REC_UBYTE_C 0 COMP_0030 0 255 /end CHARACTERISTIC
/begin CHARACTERISTIC mSGLUNE "ROM Const mSGLUNE" VALUE 0x00008AA1 REC_UBYTE_C 0 COMP_0065 0 796.875 /end CHARACTERISTIC
/begin CHARACTERISTIC mSGOFFDNE "ROM Const mSGOFFDNE" VALUE 0x00008AA2 REC_UBYTE_C 0 COMP_0476 0 49.8046875 /end CHARACTERISTIC
/begin CHARACTERISTIC mSGONDNE "ROM Const mSGONDNE" VALUE 0x00008AA3 REC_UBYTE_C 0 COMP_0476 0 49.8046875 /end CHARACTERISTIC
/begin CHARACTERISTIC mSGONITAH "ROM Const mSGONITAH" VALUE 0x00008AA4 REC_UBYTE_C 0 COMP_0009 0 199.21875 /end CHARACTERISTIC
/begin CHARACTERISTIC mSGONITAL "ROM Const mSGONITAL" VALUE 0x00008AA5 REC_UBYTE_C 0 COMP_0009 0 199.21875 /end CHARACTERISTIC
/begin CHARACTERISTIC mSGONNEH1 "ROM Const mSGONNEH1" VALUE 0x00009444 REC_UWORD_C 0 COMP_0065 0 204796.875 /end CHARACTERISTIC
/begin CHARACTERISTIC mSGONNEL1 "ROM Const mSGONNEL1" VALUE 0x00009446 REC_UWORD_C 0 COMP_0065 0 204796.875 /end CHARACTERISTIC
/begin CHARACTERISTIC mSGONTM "ROM Const mSGONTM" VALUE 0x00008AA6 REC_UBYTE_C 0 COMP_0013 0 255 /end CHARACTERISTIC
/begin CHARACTERISTIC mSGONTW "ROM Const mSGONTW" VALUE 0x00008AA7 REC_UBYTE_C 0 COMP_0035 -50 205 /end CHARACTERISTIC
/begin CHARACTERISTIC mSGONVSPH "ROM Const mSGONVSPH" VALUE 0x00008AA8 REC_UBYTE_C 0 COMP_0007 0 510 /end CHARACTERISTIC
/begin CHARACTERISTIC mSGONVSPL "ROM Const mSGONVSPL" VALUE 0x00008AA9 REC_UBYTE_C 0 COMP_0007 0 510 /end CHARACTERISTIC
/begin CHARACTERISTIC mSHAGAIAH "ROM Const mSHAGAIAH" VALUE 0x00009448 REC_UWORD_C 0 COMP_0005 0 7208.85 /end CHARACTERISTIC
/begin CHARACTERISTIC mSHAGAIAL "ROM Const mSHAGAIAL" VALUE 0x0000944A REC_UWORD_C 0 COMP_0005 0 7208.85 /end CHARACTERISTIC
/begin CHARACTERISTIC mSHAGAIGP "ROM Const mSHAGAIGP" VALUE 0x00008AAA REC_UBYTE_C 0 COMP_0068 0 255 /end CHARACTERISTIC
/begin CHARACTERISTIC mSHAGAIR2 "ROM Const mSHAGAIR2" VALUE 0x0000944C REC_UWORD_C 0 COMP_0193 0 6553.5 /end CHARACTERISTIC
/begin CHARACTERISTIC mSHAGAIRC "ROM Const mSHAGAIRC" VALUE 0x0000944E REC_UWORD_C 0 COMP_0193 0 6553.5 /end CHARACTERISTIC
/begin CHARACTERISTIC mSHAGAIT1 "ROM Const mSHAGAIT1" VALUE 0x00008AAB REC_UBYTE_C 0 COMP_0014 0 2550 /end CHARACTERISTIC
/begin CHARACTERISTIC mSHAGAIT2 "ROM Const mSHAGAIT2" VALUE 0x00008AAC REC_UBYTE_C 0 COMP_0014 0 2550 /end CHARACTERISTIC
/begin CHARACTERISTIC mSHAGAIT3 "ROM Const mSHAGAIT3" VALUE 0x00008AAD REC_UBYTE_C 0 COMP_0014 0 2550 /end CHARACTERISTIC
/begin CHARACTERISTIC mSHAGAIT4 "ROM Const mSHAGAIT4" VALUE 0x00008AAE REC_UBYTE_C 0 COMP_0014 0 2550 /end CHARACTERISTIC
/begin CHARACTERISTIC mSHAGAIV2 "ROM Const mSHAGAIV2" VALUE 0x00009450 REC_UWORD_C 0 COMP_0195 0 6553.5 /end CHARACTERISTIC
/begin CHARACTERISTIC mSHAGAIVH "ROM Const mSHAGAIVH" VALUE 0x00009452 REC_UWORD_C 0 COMP_0195 0 6553.5 /end CHARACTERISTIC
/begin CHARACTERISTIC mSHAGAIVL "ROM Const mSHAGAIVL" VALUE 0x00009454 REC_UWORD_C 0 COMP_0195 0 6553.5 /end CHARACTERISTIC
/begin CHARACTERISTIC mSHIPPING "ROM Const mSHIPPING" VALUE 0x00008AAF REC_UBYTE_C 0 COMP_0470 0 255 /end CHARACTERISTIC
/begin CHARACTERISTIC mSHOKTP "ROM Const mSHOKTP" VALUE 0x00008AB0 REC_UBYTE_C 0 COMP_0014 0 2550 /end CHARACTERISTIC
/begin CHARACTERISTIC mSINTVL "ROM Const mSINTVL" VALUE 0x00008AB1 REC_UBYTE_C 0 COMP_0015_S 0 25.5 /end CHARACTERISTIC
/begin CHARACTERISTIC mSLAC "ROM Const mSLAC" VALUE 0x00008AB2 REC_UBYTE_C 0 COMP_0002 0 89.25 /end CHARACTERISTIC
/begin CHARACTERISTIC mSLAJTTE0 "ROM Const mSLAJTTE0" VALUE 0x00008E8A REC_SWORD_C 0 COMP_0228 -3276.8 3276.7 /end CHARACTERISTIC
/begin CHARACTERISTIC mSLAJVSPL "ROM Const mSLAJVSPL" VALUE 0x00009456 REC_UWORD_C 0 COMP_0238_S 0 655.35 /end CHARACTERISTIC
/begin CHARACTERISTIC mSLARBTHY "ROM Const mSLARBTHY" VALUE 0x00009458 REC_UWORD_C 0 COMP_0196 0 6553.5 /end CHARACTERISTIC
/begin CHARACTERISTIC mSLATAPRD "ROM Const mSLATAPRD" VALUE 0x0000945A REC_UWORD_C 0 COMP_0052_S 0 8191.875 /end CHARACTERISTIC
/begin CHARACTERISTIC mSLATAPRM "ROM Const mSLATAPRM" VALUE 0x0000945C REC_UWORD_C 0 COMP_0052_S 0 8191.875 /end CHARACTERISTIC
/begin CHARACTERISTIC mSLCLOFS "ROM Const mSLCLOFS" VALUE 0x00008E8C REC_SWORD_C 0 COMP_0228 -3276.8 3276.7 /end CHARACTERISTIC
/begin CHARACTERISTIC mSLCLRMP "ROM Const mSLCLRMP" VALUE 0x0000945E REC_UWORD_C 0 COMP_0193 0 6553.5 /end CHARACTERISTIC
/begin CHARACTERISTIC mSLCLWRNT "ROM Const mSLCLWRNT" VALUE 0x00008AB3 REC_UBYTE_C 0 COMP_0008 0 25500 /end CHARACTERISTIC
/begin CHARACTERISTIC mSLCLWRNV "ROM Const mSLCLWRNV" VALUE 0x00009460 REC_UWORD_C 0 COMP_0238_S 0 655.35 /end CHARACTERISTIC
/begin CHARACTERISTIC mSLCTWH "ROM Const mSLCTWH" VALUE 0x00008AB4 REC_UBYTE_C 0 COMP_0035 -50 205 /end CHARACTERISTIC
/begin CHARACTERISTIC mSLCTWL "ROM Const mSLCTWL" VALUE 0x00008AB5 REC_UBYTE_C 0 COMP_0035 -50 205 /end CHARACTERISTIC
/begin CHARACTERISTIC mSLDMP "ROM Const mSLDMP" VALUE 0x00008AB6 REC_UBYTE_C 0 COMP_0021 0 99.609375 /end CHARACTERISTIC
/begin CHARACTERISTIC mSLDSPDCL "ROM Const mSLDSPDCL" VALUE 0x00008E8E REC_SWORD_C 0 COMP_0228 -3276.8 3276.7 /end CHARACTERISTIC
/begin CHARACTERISTIC mSLDSPDRM "ROM Const mSLDSPDRM" VALUE 0x00009462 REC_UWORD_C 0 COMP_0193 0 6553.5 /end CHARACTERISTIC
/begin CHARACTERISTIC mSLDSPDST "ROM Const mSLDSPDST" VALUE 0x00008E90 REC_SWORD_C 0 COMP_0228 -3276.8 3276.7 /end CHARACTERISTIC
/begin CHARACTERISTIC mSLFSRMP "ROM Const mSLFSRMP" VALUE 0x00009464 REC_UWORD_C 0 COMP_0193 0 6553.5 /end CHARACTERISTIC
/begin CHARACTERISTIC mSLFVAPHY "ROM Const mSLFVAPHY" VALUE 0x00008AB7 REC_UBYTE_C 0 COMP_0002 0 89.25 /end CHARACTERISTIC
/begin CHARACTERISTIC mSLGAKRMP "ROM Const mSLGAKRMP" VALUE 0x00009466 REC_UWORD_C 0 COMP_0193 0 6553.5 /end CHARACTERISTIC
/begin CHARACTERISTIC mSLHGIDF1 "ROM Const mSLHGIDF1" VALUE 0x00008E92 REC_SWORD_C 0 COMP_0239_S -327.68 327.67 /end CHARACTERISTIC
/begin CHARACTERISTIC mSLHGIDF2 "ROM Const mSLHGIDF2" VALUE 0x00008E94 REC_SWORD_C 0 COMP_0239_S -327.68 327.67 /end CHARACTERISTIC
/begin CHARACTERISTIC mSLHGIST "ROM Const mSLHGIST" VALUE 0x00008AB8 REC_UBYTE_C 0 COMP_0068 0 255 /end CHARACTERISTIC
/begin CHARACTERISTIC mSLIG0D00 "ROM Const mSLIG0D00" VALUE 0x00008AB9 REC_UBYTE_C 0 COMP_0014 0 2550 /end CHARACTERISTIC
/begin CHARACTERISTIC mSLIG0DLY "ROM Const mSLIG0DLY" VALUE 0x00008ABA REC_UBYTE_C 0 COMP_0014 0 2550 /end CHARACTERISTIC
/begin CHARACTERISTIC mSLIG0DOV "ROM Const mSLIG0DOV" VALUE 0x00008ABB REC_UBYTE_C 0 COMP_0014 0 2550 /end CHARACTERISTIC
/begin CHARACTERISTIC mSLIG0DUD "ROM Const mSLIG0DUD" VALUE 0x00008ABC REC_UBYTE_C 0 COMP_0014 0 2550 /end CHARACTERISTIC
/begin CHARACTERISTIC mSLIG0TEH "ROM Const mSLIG0TEH" VALUE 0x00008E96 REC_SWORD_C 0 COMP_0240_S -655.36 655.34 /end CHARACTERISTIC
/begin CHARACTERISTIC mSLIGAIN "ROM Const mSLIGAIN" VALUE 0x00009468 REC_UWORD_C 0 COMP_0241_S 0 65535 /end CHARACTERISTIC
/begin CHARACTERISTIC mSLIGAIN0 "ROM Const mSLIGAIN0" VALUE 0x0000946A REC_UWORD_C 0 COMP_0241_S 0 65535 /end CHARACTERISTIC
/begin CHARACTERISTIC mSLIGGACC "ROM Const mSLIGGACC" VALUE 0x00008E98 REC_SWORD_C 0 COMP_0242_S -32.768 32.767 /end CHARACTERISTIC
/begin CHARACTERISTIC mSLIGGADF "ROM Const mSLIGGADF" VALUE 0x0000946C REC_UWORD_C 0 COMP_0238_S 0 655.35 /end CHARACTERISTIC
/begin CHARACTERISTIC mSLMTCTUP "ROM Const mSLMTCTUP" VALUE 0x0000946E REC_UWORD_C 0 COMP_0008 0 6553500 /end CHARACTERISTIC
/begin CHARACTERISTIC mSLMTOIFS "ROM Const mSLMTOIFS" VALUE 0x00009470 REC_UWORD_C 0 COMP_0238_S 0 655.35 /end CHARACTERISTIC
/begin CHARACTERISTIC mSLMTOKTM "ROM Const mSLMTOKTM" VALUE 0x00009472 REC_UWORD_C 0 COMP_0008 0 6553500 /end CHARACTERISTIC
/begin CHARACTERISTIC mSLMTOKVS "ROM Const mSLMTOKVS" VALUE 0x00009474 REC_UWORD_C 0 COMP_0436 0 6553.5 /end CHARACTERISTIC
/begin CHARACTERISTIC mSLMTRMP1 "ROM Const mSLMTRMP1" VALUE 0x00009476 REC_UWORD_C 0 COMP_0243_S 0 655.35 /end CHARACTERISTIC
/begin CHARACTERISTIC mSLMTRMP2 "ROM Const mSLMTRMP2" VALUE 0x00009478 REC_UWORD_C 0 COMP_0243_S 0 655.35 /end CHARACTERISTIC
/begin CHARACTERISTIC mSLNTGN "ROM Const mSLNTGN" VALUE 0x00008ABD REC_UBYTE_C 0 COMP_0373 0 2.55 /end CHARACTERISTIC
/begin CHARACTERISTIC mSLNTGNC "ROM Const mSLNTGNC" VALUE 0x00008ABE REC_UBYTE_C 0 COMP_0373 0 2.55 /end CHARACTERISTIC
/begin CHARACTERISTIC mSLNTGNK "ROM Const mSLNTGNK" VALUE 0x00008ABF REC_UBYTE_C 0 COMP_0373 0 2.55 /end CHARACTERISTIC
/begin CHARACTERISTIC mSLNTGNL "ROM Const mSLNTGNL" VALUE 0x00008AC0 REC_UBYTE_C 0 COMP_0373 0 2.55 /end CHARACTERISTIC
/begin CHARACTERISTIC mSLNTHP "ROM Const mSLNTHP" VALUE 0x00008AC1 REC_UBYTE_C 0 COMP_0373 0 2.55 /end CHARACTERISTIC
/begin CHARACTERISTIC mSLNTHP2 "ROM Const mSLNTHP2" VALUE 0x00008AC2 REC_UBYTE_C 0 COMP_0373 0 2.55 /end CHARACTERISTIC
/begin CHARACTERISTIC mSLODOFDF "ROM Const mSLODOFDF" VALUE 0x00008E9A REC_SWORD_C 0 COMP_0239_S -327.68 327.67 /end CHARACTERISTIC
/begin CHARACTERISTIC mSLODOFF "ROM Const mSLODOFF" VALUE 0x0000947A REC_UWORD_C 0 COMP_0450 0 63.999056205 /end CHARACTERISTIC
/begin CHARACTERISTIC mSLODON "ROM Const mSLODON" VALUE 0x0000947C REC_UWORD_C 0 COMP_0450 0 63.999056205 /end CHARACTERISTIC
/begin CHARACTERISTIC mSLOFFOFS "ROM Const mSLOFFOFS" VALUE 0x00008E9C REC_SWORD_C 0 COMP_0228 -3276.8 3276.7 /end CHARACTERISTIC
/begin CHARACTERISTIC mSLOFFRMP "ROM Const mSLOFFRMP" VALUE 0x0000947E REC_UWORD_C 0 COMP_0244_S 0 655.35 /end CHARACTERISTIC
/begin CHARACTERISTIC mSLOPETM "ROM Const mSLOPETM" VALUE 0x00008AC3 REC_UBYTE_C 0 COMP_0030 0 255 /end CHARACTERISTIC
/begin CHARACTERISTIC mSLOPMX "ROM Const mSLOPMX" VALUE 0x00008AC4 REC_UBYTE_C 0 COMP_0006 0 3187.5 /end CHARACTERISTIC
/begin CHARACTERISTIC mSLOWWT "ROM Const mSLOWWT" VALUE 0x00009480 REC_UWORD_C 0 COMP_0197 0 0.999998565 /end CHARACTERISTIC
/begin CHARACTERISTIC mSLPGDEF "ROM Const mSLPGDEF" VALUE 0x00008E9E REC_SWORD_C 0 COMP_0239_S -327.68 327.67 /end CHARACTERISTIC
/begin CHARACTERISTIC mSLPGFCAP "ROM Const mSLPGFCAP" VALUE 0x00009482 REC_UWORD_C 0 COMP_0005 0 7208.85 /end CHARACTERISTIC
/begin CHARACTERISTIC mSLPGFCDF "ROM Const mSLPGFCDF" VALUE 0x00009484 REC_UWORD_C 0 COMP_0238_S 0 655.35 /end CHARACTERISTIC
/begin CHARACTERISTIC mSLPGFCDL "ROM Const mSLPGFCDL" VALUE 0x00009486 REC_UWORD_C 0 COMP_0238_S 0 655.35 /end CHARACTERISTIC
/begin CHARACTERISTIC mSLPGFCRM "ROM Const mSLPGFCRM" VALUE 0x00009488 REC_UWORD_C 0 COMP_0245_S 0 6399.90234375 /end CHARACTERISTIC
/begin CHARACTERISTIC mSLPGFCTL "ROM Const mSLPGFCTL" VALUE 0x0000948A REC_UWORD_C 0 COMP_0447 0 6399.90234375 /end CHARACTERISTIC
/begin CHARACTERISTIC mSLPGFCTM "ROM Const mSLPGFCTM" VALUE 0x0000948C REC_UWORD_C 0 COMP_0447 0 6399.90234375 /end CHARACTERISTIC
/begin CHARACTERISTIC mSLPGRMP "ROM Const mSLPGRMP" VALUE 0x0000948E REC_UWORD_C 0 COMP_0241_S 0 65535 /end CHARACTERISTIC
/begin CHARACTERISTIC mSLPINNE "ROM Const mSLPINNE" VALUE 0x00008AC5 REC_UBYTE_C 0 COMP_0006 0 3187.5 /end CHARACTERISTIC
/begin CHARACTERISTIC mSLPMAX "ROM Const mSLPMAX" VALUE 0x00008AC6 REC_UBYTE_C 0 COMP_0186 0 3.984375 /end CHARACTERISTIC
/begin CHARACTERISTIC mSLPNOUT "ROM Const mSLPNOUT" VALUE 0x00009490 REC_UWORD_C 0 COMP_0443 0 65535 /end CHARACTERISTIC
/begin CHARACTERISTIC mSLPOUTN "ROM Const mSLPOUTN" VALUE 0x00008AC7 REC_UBYTE_C 0 COMP_0006 0 3187.5 /end CHARACTERISTIC
/begin CHARACTERISTIC mSLPRTOH "ROM Const mSLPRTOH" VALUE 0x00009492 REC_UWORD_C 0 COMP_0450 0 63.999056205 /end CHARACTERISTIC
/begin CHARACTERISTIC mSLPVSP "ROM Const mSLPVSP" VALUE 0x00008AC8 REC_UBYTE_C 0 COMP_0007 0 510 /end CHARACTERISTIC
/begin CHARACTERISTIC mSLQH0LMT "ROM Const mSLQH0LMT" VALUE 0x00009494 REC_UWORD_C 0 COMP_0146 0 99.998480265 /end CHARACTERISTIC
/begin CHARACTERISTIC mSLQH0RTN "ROM Const mSLQH0RTN" VALUE 0x00009496 REC_UWORD_C 0 COMP_0146 0 99.998480265 /end CHARACTERISTIC
/begin CHARACTERISTIC mSLQHFLOF "ROM Const mSLQHFLOF" VALUE 0x00009498 REC_UWORD_C 0 COMP_0238_S 0 655.35 /end CHARACTERISTIC
/begin CHARACTERISTIC mSLQHFLON "ROM Const mSLQHFLON" VALUE 0x0000949A REC_UWORD_C 0 COMP_0238_S 0 655.35 /end CHARACTERISTIC
/begin CHARACTERISTIC mSLRESNOT "ROM Const mSLRESNOT" VALUE 0x00008AC9 REC_UBYTE_C 0 COMP_0014 0 2550 /end CHARACTERISTIC
/begin CHARACTERISTIC mSLRESVOF "ROM Const mSLRESVOF" VALUE 0x0000949C REC_UWORD_C 0 COMP_0238_S 0 655.35 /end CHARACTERISTIC
/begin CHARACTERISTIC mSLSHMX "ROM Const mSLSHMX" VALUE 0x00008ACA REC_UBYTE_C 0 COMP_0016 0 255 /end CHARACTERISTIC
/begin CHARACTERISTIC mSLTAP1K "ROM Const mSLTAP1K" VALUE 0x0000949E REC_UWORD_C 0 COMP_0238_S 0 655.35 /end CHARACTERISTIC
/begin CHARACTERISTIC mSLTAP1M "ROM Const mSLTAP1M" VALUE 0x000094A0 REC_UWORD_C 0 COMP_0238_S 0 655.35 /end CHARACTERISTIC
/begin CHARACTERISTIC mSLTAP2K "ROM Const mSLTAP2K" VALUE 0x000094A2 REC_UWORD_C 0 COMP_0238_S 0 655.35 /end CHARACTERISTIC
/begin CHARACTERISTIC mSLTAP2M "ROM Const mSLTAP2M" VALUE 0x000094A4 REC_UWORD_C 0 COMP_0238_S 0 655.35 /end CHARACTERISTIC
/begin CHARACTERISTIC mSLTAPTM1 "ROM Const mSLTAPTM1" VALUE 0x00008ACB REC_UBYTE_C 0 COMP_0014 0 2550 /end CHARACTERISTIC
/begin CHARACTERISTIC mSLTAPTMK "ROM Const mSLTAPTMK" VALUE 0x00008ACC REC_UBYTE_C 0 COMP_0014 0 2550 /end CHARACTERISTIC
/begin CHARACTERISTIC mSLTAPTMM "ROM Const mSLTAPTMM" VALUE 0x00008ACD REC_UBYTE_C 0 COMP_0014 0 2550 /end CHARACTERISTIC
/begin CHARACTERISTIC mSLTERMHG "ROM Const mSLTERMHG" VALUE 0x000094A6 REC_UWORD_C 0 COMP_0193 0 6553.5 /end CHARACTERISTIC
/begin CHARACTERISTIC mSLTERMKD "ROM Const mSLTERMKD" VALUE 0x000094A8 REC_UWORD_C 0 COMP_0193 0 6553.5 /end CHARACTERISTIC
/begin CHARACTERISTIC mSLTGTVMN "ROM Const mSLTGTVMN" VALUE 0x000094AA REC_UWORD_C 0 COMP_0238_S 0 655.35 /end CHARACTERISTIC
/begin CHARACTERISTIC mSLTQGATU "ROM Const mSLTQGATU" VALUE 0x00008EA0 REC_SWORD_C 0 COMP_0242_S -32.768 32.767 /end CHARACTERISTIC
/begin CHARACTERISTIC mSLTTE0 "ROM Const mSLTTE0" VALUE 0x000094AC REC_UWORD_C 0 COMP_0246_S 0 655.35 /end CHARACTERISTIC
/begin CHARACTERISTIC mSLTTERMP "ROM Const mSLTTERMP" VALUE 0x000094AE REC_UWORD_C 0 COMP_0193 0 6553.5 /end CHARACTERISTIC
/begin CHARACTERISTIC mSLTTERTO "ROM Const mSLTTERTO" VALUE 0x000094B0 REC_UWORD_C 0 COMP_0450 0 63.999056205 /end CHARACTERISTIC
/begin CHARACTERISTIC mSLVAMXDL "ROM Const mSLVAMXDL" VALUE 0x00008ACE REC_UBYTE_C 0 COMP_0014 0 2550 /end CHARACTERISTIC
/begin CHARACTERISTIC mSLVAPADD "ROM Const mSLVAPADD" VALUE 0x000094B2 REC_UWORD_C 0 COMP_0052_S 0 8191.875 /end CHARACTERISTIC
/begin CHARACTERISTIC mSLVAPDF1 "ROM Const mSLVAPDF1" VALUE 0x000094B4 REC_UWORD_C 0 COMP_0238_S 0 655.35 /end CHARACTERISTIC
/begin CHARACTERISTIC mSLVAPDF2 "ROM Const mSLVAPDF2" VALUE 0x000094B6 REC_UWORD_C 0 COMP_0238_S 0 655.35 /end CHARACTERISTIC
/begin CHARACTERISTIC mSLVAPGAC "ROM Const mSLVAPGAC" VALUE 0x00008EA2 REC_SWORD_C 0 COMP_0242_S -32.768 32.767 /end CHARACTERISTIC
/begin CHARACTERISTIC mSLVAPGDW "ROM Const mSLVAPGDW" VALUE 0x000094B8 REC_UWORD_C 0 COMP_0247_S 0 399.99392106 /end CHARACTERISTIC
/begin CHARACTERISTIC mSLVAPGUP "ROM Const mSLVAPGUP" VALUE 0x000094BA REC_UWORD_C 0 COMP_0247_S 0 399.99392106 /end CHARACTERISTIC
/begin CHARACTERISTIC mSLVAPOMX "ROM Const mSLVAPOMX" VALUE 0x000094BC REC_UWORD_C 0 COMP_0032_S 0 8191.875 /end CHARACTERISTIC
/begin CHARACTERISTIC mSLVAPTMX "ROM Const mSLVAPTMX" VALUE 0x000094BE REC_UWORD_C 0 COMP_0447 0 6399.90234375 /end CHARACTERISTIC
/begin CHARACTERISTIC mSLVPLMRT "ROM Const mSLVPLMRT" VALUE 0x000094C0 REC_UWORD_C 0 COMP_0032_S 0 8191.875 /end CHARACTERISTIC
/begin CHARACTERISTIC mSLVPLMV1 "ROM Const mSLVPLMV1" VALUE 0x000094C2 REC_UWORD_C 0 COMP_0238_S 0 655.35 /end CHARACTERISTIC
/begin CHARACTERISTIC mSLVPLMV2 "ROM Const mSLVPLMV2" VALUE 0x000094C4 REC_UWORD_C 0 COMP_0238_S 0 655.35 /end CHARACTERISTIC
/begin CHARACTERISTIC mSLVPSATU "ROM Const mSLVPSATU" VALUE 0x00008ACF REC_UBYTE_C 0 COMP_0014 0 2550 /end CHARACTERISTIC
/begin CHARACTERISTIC mSLVSOV1 "ROM Const mSLVSOV1" VALUE 0x000094C6 REC_UWORD_C 0 COMP_0238_S 0 655.35 /end CHARACTERISTIC
/begin CHARACTERISTIC mSLVSOV2 "ROM Const mSLVSOV2" VALUE 0x000094C8 REC_UWORD_C 0 COMP_0238_S 0 655.35 /end CHARACTERISTIC
/begin CHARACTERISTIC mSLVSP "ROM Const mSLVSP" VALUE 0x000094CA REC_UWORD_C 0 COMP_0436 0 6553.5 /end CHARACTERISTIC
/begin CHARACTERISTIC mSLVSP2 "ROM Const mSLVSP2" VALUE 0x000094CC REC_UWORD_C 0 COMP_0436 0 6553.5 /end CHARACTERISTIC
/begin CHARACTERISTIC mSLVSPHK "ROM Const mSLVSPHK" VALUE 0x000094CE REC_UWORD_C 0 COMP_0238_S 0 655.35 /end CHARACTERISTIC
/begin CHARACTERISTIC mSLVSPHM "ROM Const mSLVSPHM" VALUE 0x000094D0 REC_UWORD_C 0 COMP_0238_S 0 655.35 /end CHARACTERISTIC
/begin CHARACTERISTIC mSLVSPLK "ROM Const mSLVSPLK" VALUE 0x000094D2 REC_UWORD_C 0 COMP_0238_S 0 655.35 /end CHARACTERISTIC
/begin CHARACTERISTIC mSLVSPLM "ROM Const mSLVSPLM" VALUE 0x000094D4 REC_UWORD_C 0 COMP_0238_S 0 655.35 /end CHARACTERISTIC
/begin CHARACTERISTIC mSLVSPOV1 "ROM Const mSLVSPOV1" VALUE 0x000094D6 REC_UWORD_C 0 COMP_0238_S 0 655.35 /end CHARACTERISTIC
/begin CHARACTERISTIC mSLVSPOV2 "ROM Const mSLVSPOV2" VALUE 0x000094D8 REC_UWORD_C 0 COMP_0238_S 0 655.35 /end CHARACTERISTIC
/begin CHARACTERISTIC mSLVSPRD1 "ROM Const mSLVSPRD1" VALUE 0x000094DA REC_UWORD_C 0 COMP_0238_S 0 655.35 /end CHARACTERISTIC
/begin CHARACTERISTIC mSLVSPRD2 "ROM Const mSLVSPRD2" VALUE 0x000094DC REC_UWORD_C 0 COMP_0238_S 0 655.35 /end CHARACTERISTIC
/begin CHARACTERISTIC mSLVSPRD3 "ROM Const mSLVSPRD3" VALUE 0x000094DE REC_UWORD_C 0 COMP_0238_S 0 655.35 /end CHARACTERISTIC
/begin CHARACTERISTIC mSLVSPRM2 "ROM Const mSLVSPRM2" VALUE 0x000094E0 REC_UWORD_C 0 COMP_0244_S 0 655.35 /end CHARACTERISTIC
/begin CHARACTERISTIC mSLVSPRM3 "ROM Const mSLVSPRM3" VALUE 0x000094E2 REC_UWORD_C 0 COMP_0244_S 0 655.35 /end CHARACTERISTIC
/begin CHARACTERISTIC mSLVSPRMP "ROM Const mSLVSPRMP" VALUE 0x000094E4 REC_UWORD_C 0 COMP_0244_S 0 655.35 /end CHARACTERISTIC
/begin CHARACTERISTIC mSMOKDLY "ROM Const mSMOKDLY" VALUE 0x000094E6 REC_UWORD_C 0 COMP_0049 0 65535 /end CHARACTERISTIC
/begin CHARACTERISTIC mSMOOTH "ROM Const mSMOOTH" VALUE 0x00008AD0 REC_UBYTE_C 0 COMP_0388 0 25.5 /end CHARACTERISTIC
/begin CHARACTERISTIC mSOAKCR "ROM Const mSOAKCR" VALUE 0x00008AD1 REC_UBYTE_C 0 COMP_0004_S -50 205 /end CHARACTERISTIC
/begin CHARACTERISTIC mSOFDLY "ROM Const mSOFDLY" VALUE 0x00008AD4 REC_UBYTE_C 0 COMP_0014 0 2550 /end CHARACTERISTIC
/begin CHARACTERISTIC mSOFITC "ROM Const mSOFITC" VALUE 0x00008AD5 REC_UBYTE_C 0 COMP_0032 0 0.99609375 /end CHARACTERISTIC
/begin CHARACTERISTIC mSOLFSDLY "ROM Const mSOLFSDLY" VALUE 0x00008AD6 REC_UBYTE_C 0 COMP_0030 0 255 /end CHARACTERISTIC
/begin CHARACTERISTIC mSOLMLDLY "ROM Const mSOLMLDLY" VALUE 0x00008AD7 REC_UBYTE_C 0 COMP_0030 0 255 /end CHARACTERISTIC
/begin CHARACTERISTIC mSONDLY "ROM Const mSONDLY" VALUE 0x00008AD8 REC_UBYTE_C 0 COMP_0014 0 2550 /end CHARACTERISTIC
/begin CHARACTERISTIC mSPCVA "ROM Const mSPCVA" VALUE 0x000094E8 REC_UWORD_C 0 COMP_0312 0 127.998046875 /end CHARACTERISTIC
/begin CHARACTERISTIC mSPCVAB "ROM Const mSPCVAB" VALUE 0x000094EA REC_UWORD_C 0 COMP_0078_S 0 255.99609375 /end CHARACTERISTIC
/begin CHARACTERISTIC mSPCVH "ROM Const mSPCVH" VALUE 0x000094EC REC_UWORD_C 0 COMP_0248_S 0 127.99837455 /end CHARACTERISTIC
/begin CHARACTERISTIC mSPCVL "ROM Const mSPCVL" VALUE 0x000094EE REC_UWORD_C 0 COMP_0248_S 0 127.99837455 /end CHARACTERISTIC
/begin CHARACTERISTIC mSPDCTTWN "ROM Const mSPDCTTWN" VALUE 0x00008AD9 REC_UBYTE_C 0 COMP_0035 -50 205 /end CHARACTERISTIC
/begin CHARACTERISTIC mSPDCTVSP "ROM Const mSPDCTVSP" VALUE 0x000094F0 REC_UWORD_C 0 COMP_0436 0 6553.5 /end CHARACTERISTIC
/begin CHARACTERISTIC mSPDDGAIN "ROM Const mSPDDGAIN" VALUE 0x000094F2 REC_UWORD_C 0 COMP_0231_S 0 65.535 /end CHARACTERISTIC
/begin CHARACTERISTIC mSPDDONDF "ROM Const mSPDDONDF" VALUE 0x000094F4 REC_UWORD_C 0 COMP_0162_S 0 51199.21875 /end CHARACTERISTIC
/begin CHARACTERISTIC mSPDIDLTM "ROM Const mSPDIDLTM" VALUE 0x00008ADA REC_UBYTE_C 0 COMP_0014 0 2550 /end CHARACTERISTIC
/begin CHARACTERISTIC mSPDIDLVS "ROM Const mSPDIDLVS" VALUE 0x000094F6 REC_UWORD_C 0 COMP_0436 0 6553.5 /end CHARACTERISTIC
/begin CHARACTERISTIC mSPDMINTG "ROM Const mSPDMINTG" VALUE 0x000094F8 REC_UWORD_C 0 COMP_0162_S 0 51199.21875 /end CHARACTERISTIC
/begin CHARACTERISTIC mSPDPGAPL "ROM Const mSPDPGAPL" VALUE 0x000094FA REC_UWORD_C 0 COMP_0005 0 7208.85 /end CHARACTERISTIC
/begin CHARACTERISTIC mSPDRETTM "ROM Const mSPDRETTM" VALUE 0x00008ADB REC_UBYTE_C 0 COMP_0014 0 2550 /end CHARACTERISTIC
/begin CHARACTERISTIC mSPDTQOFS "ROM Const mSPDTQOFS" VALUE 0x00008EA4 REC_SWORD_C 0 COMP_0228 -3276.8 3276.7 /end CHARACTERISTIC
/begin CHARACTERISTIC mSQASL0 "ROM Const mSQASL0" VALUE 0x00008ADD REC_UBYTE_C 0 COMP_0291 0 2611.2 /end CHARACTERISTIC
/begin CHARACTERISTIC mSRFCCLY "ROM Const mSRFCCLY" VALUE 0x00008ADE REC_UBYTE_C 0 COMP_0030 0 255 /end CHARACTERISTIC
/begin CHARACTERISTIC mSRNOM1 "ROM Const mSRNOM1" VALUE 0x00008ADF REC_UBYTE_C 0 COMP_0044 0 1.9921875 /end CHARACTERISTIC
/begin CHARACTERISTIC mSROKADV "ROM Const mSROKADV" VALUE 0x00008242 REC_SBYTE_C 0 COMP_0018 -128 127 /end CHARACTERISTIC
/begin CHARACTERISTIC mSROKADVH "ROM Const mSROKADVH" VALUE 0x00008243 REC_SBYTE_C 0 COMP_0018 -128 127 /end CHARACTERISTIC
/begin CHARACTERISTIC mSROKPFL "ROM Const mSROKPFL" VALUE 0x000097EC REC_ULONG_C 0 COMP_0164 0 1309965.024975 /end CHARACTERISTIC
/begin CHARACTERISTIC mSROKRPM "ROM Const mSROKRPM" VALUE 0x00008AE0 REC_UBYTE_C 0 COMP_0006 0 3187.5 /end CHARACTERISTIC
/begin CHARACTERISTIC mSRSTDLY "ROM Const mSRSTDLY" VALUE 0x00008AE1 REC_UBYTE_C 0 COMP_0014 0 2550 /end CHARACTERISTIC
/begin CHARACTERISTIC mSRTMOV "ROM Const mSRTMOV" VALUE 0x000094FC REC_UWORD_C 0 COMP_0040_S 0 655.35 /end CHARACTERISTIC
/begin CHARACTERISTIC mSSGEXCMX "ROM Const mSSGEXCMX" VALUE 0x00008AE2 REC_UBYTE_C 0 COMP_0249_S 0 25.5 /end CHARACTERISTIC
/begin CHARACTERISTIC mSSGLRCOF "ROM Const mSSGLRCOF" VALUE 0x00008AE3 REC_UBYTE_C 0 COMP_0443 0 255 /end CHARACTERISTIC
/begin CHARACTERISTIC mSSGRAMPT "ROM Const mSSGRAMPT" VALUE 0x00008AE4 REC_UBYTE_C 0 COMP_0049 0 255 /end CHARACTERISTIC
/begin CHARACTERISTIC mSSTADV4 "ROM Const mSSTADV4" VALUE 0x00008AE5 REC_UBYTE_C 0 COMP_0314 -128 127 /end CHARACTERISTIC
/begin CHARACTERISTIC mSSTADV5 "ROM Const mSSTADV5" VALUE 0x00008AE6 REC_UBYTE_C 0 COMP_0250_S -128 127 /end CHARACTERISTIC
/begin CHARACTERISTIC mST1VPOT "ROM Const mST1VPOT" VALUE 0x00008EA6 REC_SWORD_C 0 COMP_0002_S -32768 32767 /end CHARACTERISTIC
/begin CHARACTERISTIC mST2JDG "ROM Const mST2JDG" VALUE 0x00008AE7 REC_UBYTE_C 0 COMP_0016 0 255 /end CHARACTERISTIC
/begin CHARACTERISTIC mST2JDGOK "ROM Const mST2JDGOK" VALUE 0x00008AE8 REC_UBYTE_C 0 COMP_0016 0 255 /end CHARACTERISTIC
/begin CHARACTERISTIC mSTABRTO "ROM Const mSTABRTO" VALUE 0x000094FE REC_UWORD_C 0 COMP_0251_S 0 63.999056205 /end CHARACTERISTIC
/begin CHARACTERISTIC mSTALLDLY "ROM Const mSTALLDLY" VALUE 0x00008AE9 REC_UBYTE_C 0 COMP_0014 0 2550 /end CHARACTERISTIC
/begin CHARACTERISTIC mSTALLRPM "ROM Const mSTALLRPM" VALUE 0x00009500 REC_UWORD_C 0 COMP_0064 0 102398.4375 /end CHARACTERISTIC
/begin CHARACTERISTIC mSTFSNE "ROM Const mSTFSNE" VALUE 0x00008AEA REC_UBYTE_C 0 COMP_0006 0 3187.5 /end CHARACTERISTIC
/begin CHARACTERISTIC mSTHOSLIM "ROM Const mSTHOSLIM" VALUE 0x00009502 REC_UWORD_C 0 COMP_0182_S 0 65.535 /end CHARACTERISTIC
/begin CHARACTERISTIC mSTOFFT "ROM Const mSTOFFT" VALUE 0x00008AEB REC_UBYTE_C 0 COMP_0014 0 2550 /end CHARACTERISTIC
/begin CHARACTERISTIC mSTOFFTSF "ROM Const mSTOFFTSF" VALUE 0x00008AEC REC_UBYTE_C 0 COMP_0008 0 25500 /end CHARACTERISTIC
/begin CHARACTERISTIC mSTOFFVBL "ROM Const mSTOFFVBL" VALUE 0x00008AED REC_UBYTE_C 0 COMP_0033 0 20400 /end CHARACTERISTIC
/begin CHARACTERISTIC mSTOKTM "ROM Const mSTOKTM" VALUE 0x00008AEE REC_UBYTE_C 0 COMP_0008 0 25500 /end CHARACTERISTIC
/begin CHARACTERISTIC mSTONVBL "ROM Const mSTONVBL" VALUE 0x00008AEF REC_UBYTE_C 0 COMP_0033 0 20400 /end CHARACTERISTIC
/begin CHARACTERISTIC mSTPPNTQ "ROM Const mSTPPNTQ" VALUE 0x00008AF0 REC_UBYTE_C 0 COMP_0293 0 510 /end CHARACTERISTIC
/begin CHARACTERISTIC mSTPRTO "ROM Const mSTPRTO" VALUE 0x00009504 REC_UWORD_C 0 COMP_0290 0 0.999985458 /end CHARACTERISTIC
/begin CHARACTERISTIC mSTPRTO_S "ROM Const mSTPRTO_S" VALUE 0x00015A1E REC_UWORD_C 0 COMP_0290 0 0.999985458 /end CHARACTERISTIC
/begin CHARACTERISTIC mSTPSLP1 "ROM Const mSTPSLP1" VALUE 0x00008AF1 REC_UBYTE_C 0 COMP_0252_S 0 0.498046875 /end CHARACTERISTIC
/begin CHARACTERISTIC mSTPSLP2 "ROM Const mSTPSLP2" VALUE 0x00008AF2 REC_UBYTE_C 0 COMP_0252_S 0 0.498046875 /end CHARACTERISTIC
/begin CHARACTERISTIC mSTRSTFN "ROM Const mSTRSTFN" VALUE 0x00009506 REC_UWORD_C 0 COMP_0040_S 0 655.35 /end CHARACTERISTIC
/begin CHARACTERISTIC mSTRSTFNE "ROM Const mSTRSTFNE" VALUE 0x00009508 REC_UWORD_C 0 COMP_0040_S 0 655.35 /end CHARACTERISTIC
/begin CHARACTERISTIC mSTRSTLMN "ROM Const mSTRSTLMN" VALUE 0x00008AF3 REC_UBYTE_C 0 COMP_0006 0 3187.5 /end CHARACTERISTIC
/begin CHARACTERISTIC mSTRTVB "ROM Const mSTRTVB" VALUE 0x00008AF4 REC_UBYTE_C 0 COMP_0033 0 20400 /end CHARACTERISTIC
/begin CHARACTERISTIC mSTSTAT0 "ROM Const mSTSTAT0" VALUE 0x00008AF5 REC_UBYTE_C 0 COMP_0008 0 25500 /end CHARACTERISTIC
/begin CHARACTERISTIC mSTSTAT1 "ROM Const mSTSTAT1" VALUE 0x00008AF6 REC_UBYTE_C 0 COMP_0008 0 25500 /end CHARACTERISTIC
/begin CHARACTERISTIC mSTTMOK "ROM Const mSTTMOK" VALUE 0x00008AF7 REC_UBYTE_C 0 COMP_0014 0 2550 /end CHARACTERISTIC
/begin CHARACTERISTIC mSTTPFN "ROM Const mSTTPFN" VALUE 0x0000950A REC_UWORD_C 0 COMP_0164 0 19.988175 /end CHARACTERISTIC
/begin CHARACTERISTIC mSTTPFNL "ROM Const mSTTPFNL" VALUE 0x0000950C REC_UWORD_C 0 COMP_0164 0 19.988175 /end CHARACTERISTIC
/begin CHARACTERISTIC mSTUG "ROM Const mSTUG" VALUE 0x00008AF8 REC_UBYTE_C 0 COMP_0092 0 255 /end CHARACTERISTIC
/begin CHARACTERISTIC mSTUG2 "ROM Const mSTUG2" VALUE 0x00008AF9 REC_UBYTE_C 0 COMP_0092 0 255 /end CHARACTERISTIC
/begin CHARACTERISTIC mSUMCHK "ROM Const mSUMCHK" VALUE 0x000097F0 REC_ULONG_C 0 COMP_0068 0 4294967295 /end CHARACTERISTIC
/begin CHARACTERISTIC mSUMOSCDL "ROM Const mSUMOSCDL" VALUE 0x00008AFA REC_UBYTE_C 0 COMP_0008 0 25500 /end CHARACTERISTIC
/begin CHARACTERISTIC mSUOSLIM "ROM Const mSUOSLIM" VALUE 0x0000950E REC_UWORD_C 0 COMP_0068 0 65535 /end CHARACTERISTIC
/begin CHARACTERISTIC mSVFUEL "ROM Const mSVFUEL" VALUE 0x00009510 REC_UWORD_C 0 COMP_0061 0 327675 /end CHARACTERISTIC
/begin CHARACTERISTIC mSVSTOPV1 "ROM Const mSVSTOPV1" VALUE 0x00009760 REC_SLONG_C 0 COMP_0144_S -1843.20024746394 1843.20024660563 /end CHARACTERISTIC
/begin CHARACTERISTIC mSVSTOPV2 "ROM Const mSVSTOPV2" VALUE 0x00009764 REC_SLONG_C 0 COMP_0144_S -1843.20024746394 1843.20024660563 /end CHARACTERISTIC
/begin CHARACTERISTIC mSYOGEN "ROM Const mSYOGEN" VALUE 0x00009512 REC_UWORD_C 0 COMP_0253_S 0 10239.84375 /end CHARACTERISTIC
/begin CHARACTERISTIC mSYSDL1 "ROM Const mSYSDL1" VALUE 0x00008B10 REC_UBYTE_C 0 COMP_0096 0 2550 /end CHARACTERISTIC
/begin CHARACTERISTIC mSYSDL2 "ROM Const mSYSDL2" VALUE 0x00008B11 REC_UBYTE_C 0 COMP_0096 0 2550 /end CHARACTERISTIC
/begin CHARACTERISTIC mSYSDL3 "ROM Const mSYSDL3" VALUE 0x00008B12 REC_UBYTE_C 0 COMP_0008 0 25500 /end CHARACTERISTIC
/begin CHARACTERISTIC mSYSDL4 "ROM Const mSYSDL4" VALUE 0x00008B13 REC_UBYTE_C 0 COMP_0008 0 25500 /end CHARACTERISTIC
/begin CHARACTERISTIC mTAFMDLY "ROM Const mTAFMDLY" VALUE 0x00009514 REC_UWORD_C 0 COMP_0017_S 0 655.35 /end CHARACTERISTIC
/begin CHARACTERISTIC mTAFMMPD "ROM Const mTAFMMPD" VALUE 0x00009516 REC_UWORD_C 0 COMP_0017_S 0 655.35 /end CHARACTERISTIC
/begin CHARACTERISTIC mTAFSSW "ROM Const mTAFSSW" VALUE 0x00009518 REC_UWORD_C 0 COMP_0008 0 6553500 /end CHARACTERISTIC
/begin CHARACTERISTIC mTAIKNG "ROM Const mTAIKNG" VALUE 0x00008B1C REC_UBYTE_C 0 COMP_0021 0 99.609375 /end CHARACTERISTIC
/begin CHARACTERISTIC mTAIKOK "ROM Const mTAIKOK" VALUE 0x00008B1D REC_UBYTE_C 0 COMP_0021 0 99.609375 /end CHARACTERISTIC
/begin CHARACTERISTIC mTALPEST "ROM Const mTALPEST" VALUE 0x00008B1E REC_UBYTE_C 0 COMP_0008 0 25500 /end CHARACTERISTIC
/begin CHARACTERISTIC mTALTVBH "ROM Const mTALTVBH" VALUE 0x00008B1F REC_UBYTE_C 0 COMP_0008 0 25500 /end CHARACTERISTIC
/begin CHARACTERISTIC mTAMFMN "ROM Const mTAMFMN" VALUE 0x00008B20 REC_UBYTE_C 0 COMP_0035 -50 205 /end CHARACTERISTIC
/begin CHARACTERISTIC mTAMNERR "ROM Const mTAMNERR" VALUE 0x00008EA8 REC_SWORD_C 0 COMP_0003_S -6553.6 6553.4 /end CHARACTERISTIC
/begin CHARACTERISTIC mTAMNHS "ROM Const mTAMNHS" VALUE 0x00008B21 REC_UBYTE_C 0 COMP_0035 -50 205 /end CHARACTERISTIC
/begin CHARACTERISTIC mTAMNLS "ROM Const mTAMNLS" VALUE 0x00008B22 REC_UBYTE_C 0 COMP_0035 -50 205 /end CHARACTERISTIC
/begin CHARACTERISTIC mTAN0 "ROM Const mTAN0" VALUE 0x00008B23 REC_UBYTE_C 0 COMP_0035 -50 205 /end CHARACTERISTIC
/begin CHARACTERISTIC mTANAIRVS "ROM Const mTANAIRVS" VALUE 0x00008B24 REC_UBYTE_C 0 COMP_0007 0 510 /end CHARACTERISTIC
/begin CHARACTERISTIC mTANDH "ROM Const mTANDH" VALUE 0x00008B25 REC_UBYTE_C 0 COMP_0035 -50 205 /end CHARACTERISTIC
/begin CHARACTERISTIC mTANDL "ROM Const mTANDL" VALUE 0x00008B26 REC_UBYTE_C 0 COMP_0035 -50 205 /end CHARACTERISTIC
/begin CHARACTERISTIC mTANDROP "ROM Const mTANDROP" VALUE 0x00008B27 REC_UBYTE_C 0 COMP_0004_S -50 205 /end CHARACTERISTIC
/begin CHARACTERISTIC mTANGHO "ROM Const mTANGHO" VALUE 0x00008B28 REC_UBYTE_C 0 COMP_0009 0 199.21875 /end CHARACTERISTIC
/begin CHARACTERISTIC mTANGL "ROM Const mTANGL" VALUE 0x00008B29 REC_UBYTE_C 0 COMP_0035 -50 205 /end CHARACTERISTIC
/begin CHARACTERISTIC mTANGLL "ROM Const mTANGLL" VALUE 0x00008B2A REC_UBYTE_C 0 COMP_0023 0 1275 /end CHARACTERISTIC
/begin CHARACTERISTIC mTANMN0 "ROM Const mTANMN0" VALUE 0x00008B2B REC_UBYTE_C 0 COMP_0004_S -50 205 /end CHARACTERISTIC
/begin CHARACTERISTIC mTANNMLOW "ROM Const mTANNMLOW" VALUE 0x0000951A REC_UWORD_C 0 COMP_0290 0 0.999985458 /end CHARACTERISTIC
/begin CHARACTERISTIC mTANNMUP "ROM Const mTANNMUP" VALUE 0x0000951C REC_UWORD_C 0 COMP_0290 0 0.999985458 /end CHARACTERISTIC
/begin CHARACTERISTIC mTANOFL "ROM Const mTANOFL" VALUE 0x00008B2C REC_UBYTE_C 0 COMP_0003 0 255 /end CHARACTERISTIC
/begin CHARACTERISTIC mTANOFS "ROM Const mTANOFS" VALUE 0x00008B2D REC_UBYTE_C 0 COMP_0003 0 255 /end CHARACTERISTIC
/begin CHARACTERISTIC mTANPTP "ROM Const mTANPTP" VALUE 0x00008B2E REC_UBYTE_C 0 COMP_0001 0 31.875 /end CHARACTERISTIC
/begin CHARACTERISTIC mTANSSTH "ROM Const mTANSSTH" VALUE 0x00008B2F REC_UBYTE_C 0 COMP_0254_S -50 205 /end CHARACTERISTIC
/begin CHARACTERISTIC mTANSSTL "ROM Const mTANSSTL" VALUE 0x00008B30 REC_UBYTE_C 0 COMP_0254_S -50 205 /end CHARACTERISTIC
/begin CHARACTERISTIC mTANSTDHL "ROM Const mTANSTDHL" VALUE 0x00008B31 REC_UBYTE_C 0 COMP_0035 -50 205 /end CHARACTERISTIC
/begin CHARACTERISTIC mTANTEI "ROM Const mTANTEI" VALUE 0x00008B32 REC_UBYTE_C 0 COMP_0014 0 2550 /end CHARACTERISTIC
/begin CHARACTERISTIC mTANTHHC "ROM Const mTANTHHC" VALUE 0x00008B33 REC_UBYTE_C 0 COMP_0003 0 255 /end CHARACTERISTIC
/begin CHARACTERISTIC mTANTHLC "ROM Const mTANTHLC" VALUE 0x00008B34 REC_UBYTE_C 0 COMP_0003 0 255 /end CHARACTERISTIC
/begin CHARACTERISTIC mTANTLRPM "ROM Const mTANTLRPM" VALUE 0x00008B35 REC_UBYTE_C 0 COMP_0006 0 3187.5 /end CHARACTERISTIC
/begin CHARACTERISTIC mTANTRIM "ROM Const mTANTRIM" VALUE 0x00008244 REC_SBYTE_C 0 COMP_0255_S -12.8 12.7 /end CHARACTERISTIC
/begin CHARACTERISTIC mTANTRIMS "ROM Const mTANTRIMS" VALUE 0x00008245 REC_SBYTE_C 0 COMP_0255_S -12.8 12.7 /end CHARACTERISTIC
/begin CHARACTERISTIC mTANVDY "ROM Const mTANVDY" VALUE 0x00008B36 REC_UBYTE_C 0 COMP_0013 0 255 /end CHARACTERISTIC
/begin CHARACTERISTIC mTANVSP "ROM Const mTANVSP" VALUE 0x00008B37 REC_UBYTE_C 0 COMP_0007 0 510 /end CHARACTERISTIC
/begin CHARACTERISTIC mTAOFST "ROM Const mTAOFST" VALUE 0x00008B38 REC_UBYTE_C 0 COMP_0035 -50 205 /end CHARACTERISTIC
/begin CHARACTERISTIC mTAOUTKDW "ROM Const mTAOUTKDW" VALUE 0x00008B39 REC_UBYTE_C 0 COMP_0256_S 0 0.51 /end CHARACTERISTIC
/begin CHARACTERISTIC mTAOUTKUP "ROM Const mTAOUTKUP" VALUE 0x00008B3A REC_UBYTE_C 0 COMP_0256_S 0 0.51 /end CHARACTERISTIC
/begin CHARACTERISTIC mTAOUTOFS "ROM Const mTAOUTOFS" VALUE 0x00008B3B REC_UBYTE_C 0 COMP_0035 -50 205 /end CHARACTERISTIC
/begin CHARACTERISTIC mTAOUTVSP "ROM Const mTAOUTVSP" VALUE 0x00008B3C REC_UBYTE_C 0 COMP_0429 0 255 /end CHARACTERISTIC
/begin CHARACTERISTIC mTAPDATA "ROM Const mTAPDATA" VALUE 0x00009768 REC_SLONG_C 0 COMP_0144_S -1843.20024746394 1843.20024660563 /end CHARACTERISTIC
/begin CHARACTERISTIC mTAPDATAM "ROM Const mTAPDATAM" VALUE 0x0000976C REC_SLONG_C 0 COMP_0144_S -1843.20024746394 1843.20024660563 /end CHARACTERISTIC
/begin CHARACTERISTIC mTARTDMX "ROM Const mTARTDMX" VALUE 0x00008B3D REC_UBYTE_C 0 COMP_0017 0 255 /end CHARACTERISTIC
/begin CHARACTERISTIC mTARTTAL "ROM Const mTARTTAL" VALUE 0x00008B3E REC_UBYTE_C 0 COMP_0035 -50 205 /end CHARACTERISTIC
/begin CHARACTERISTIC mTASLRD2 "ROM Const mTASLRD2" VALUE 0x00008B3F REC_UBYTE_C 0 COMP_0008 0 25500 /end CHARACTERISTIC
/begin CHARACTERISTIC mTASOF2 "ROM Const mTASOF2" VALUE 0x00008B40 REC_UBYTE_C 0 COMP_0051 0 255 /end CHARACTERISTIC
/begin CHARACTERISTIC mTATHFH "ROM Const mTATHFH" VALUE 0x0000951E REC_UWORD_C 0 COMP_0203_S 0 327.675 /end CHARACTERISTIC
/begin CHARACTERISTIC mTATHFL "ROM Const mTATHFL" VALUE 0x00009520 REC_UWORD_C 0 COMP_0203_S 0 327.675 /end CHARACTERISTIC
/begin CHARACTERISTIC mTATWH "ROM Const mTATWH" VALUE 0x00008B41 REC_UBYTE_C 0 COMP_0035 -50 205 /end CHARACTERISTIC
/begin CHARACTERISTIC mTAU0 "ROM Const mTAU0" VALUE 0x00008B42 REC_UBYTE_C 0 COMP_0298 0 4.98046875 /end CHARACTERISTIC
/begin CHARACTERISTIC mTBATSC "ROM Const mTBATSC" VALUE 0x00008B43 REC_UBYTE_C 0 COMP_0013 0 255 /end CHARACTERISTIC
/begin CHARACTERISTIC mTBATSCC "ROM Const mTBATSCC" VALUE 0x00009522 REC_UWORD_C 0 COMP_0013 0 65535 /end CHARACTERISTIC
/begin CHARACTERISTIC mTBATSH "ROM Const mTBATSH" VALUE 0x00008B44 REC_UBYTE_C 0 COMP_0013 0 255 /end CHARACTERISTIC
/begin CHARACTERISTIC mTBATSL "ROM Const mTBATSL" VALUE 0x00008B45 REC_UBYTE_C 0 COMP_0013 0 255 /end CHARACTERISTIC
/begin CHARACTERISTIC mTBATSR "ROM Const mTBATSR" VALUE 0x00008B46 REC_UBYTE_C 0 COMP_0013 0 255 /end CHARACTERISTIC
/begin CHARACTERISTIC mTBCGSFS "ROM Const mTBCGSFS" VALUE 0x00008B47 REC_UBYTE_C 0 COMP_0030 0 255 /end CHARACTERISTIC
/begin CHARACTERISTIC mTBCGSML "ROM Const mTBCGSML" VALUE 0x00008B48 REC_UBYTE_C 0 COMP_0030 0 255 /end CHARACTERISTIC
/begin CHARACTERISTIC mTBCOPFS "ROM Const mTBCOPFS" VALUE 0x00008B49 REC_UBYTE_C 0 COMP_0030 0 255 /end CHARACTERISTIC
/begin CHARACTERISTIC mTBCOPML "ROM Const mTBCOPML" VALUE 0x00008B4A REC_UBYTE_C 0 COMP_0030 0 255 /end CHARACTERISTIC
/begin CHARACTERISTIC mTBCVSFS "ROM Const mTBCVSFS" VALUE 0x00008B4B REC_UBYTE_C 0 COMP_0030 0 255 /end CHARACTERISTIC
/begin CHARACTERISTIC mTBCVSML "ROM Const mTBCVSML" VALUE 0x00008B4C REC_UBYTE_C 0 COMP_0030 0 255 /end CHARACTERISTIC
/begin CHARACTERISTIC mTBNLMT "ROM Const mTBNLMT" VALUE 0x00009524 REC_UWORD_C 0 COMP_0443 0 65535 /end CHARACTERISTIC
/begin CHARACTERISTIC mTBTSH "ROM Const mTBTSH" VALUE 0x00008B4D REC_UBYTE_C 0 COMP_0013 0 255 /end CHARACTERISTIC
/begin CHARACTERISTIC mTBTSL "ROM Const mTBTSL" VALUE 0x00008B4E REC_UBYTE_C 0 COMP_0013 0 255 /end CHARACTERISTIC
/begin CHARACTERISTIC mTCANDY "ROM Const mTCANDY" VALUE 0x00008B4F REC_UBYTE_C 0 COMP_0049 0 255 /end CHARACTERISTIC
/begin CHARACTERISTIC mTCATK1 "ROM Const mTCATK1" VALUE 0x00008B50 REC_UBYTE_C 0 COMP_0062 0 1020 /end CHARACTERISTIC
/begin CHARACTERISTIC mTCATK1H "ROM Const mTCATK1H" VALUE 0x00008B51 REC_UBYTE_C 0 COMP_0062 0 1020 /end CHARACTERISTIC
/begin CHARACTERISTIC mTCDQFRQ "ROM Const mTCDQFRQ" VALUE 0x00009526 REC_UWORD_C 0 COMP_0010_S 0 6.5535 /end CHARACTERISTIC
/begin CHARACTERISTIC mTCDTOTWN "ROM Const mTCDTOTWN" VALUE 0x00008B52 REC_UBYTE_C 0 COMP_0004_S -50 205 /end CHARACTERISTIC
/begin CHARACTERISTIC mTCVBHYSH "ROM Const mTCVBHYSH" VALUE 0x00008B53 REC_UBYTE_C 0 COMP_0033 0 20400 /end CHARACTERISTIC
/begin CHARACTERISTIC mTCVBHYSL "ROM Const mTCVBHYSL" VALUE 0x00008B54 REC_UBYTE_C 0 COMP_0033 0 20400 /end CHARACTERISTIC
/begin CHARACTERISTIC mTCVBTOKH "ROM Const mTCVBTOKH" VALUE 0x00008B55 REC_UBYTE_C 0 COMP_0033 0 20400 /end CHARACTERISTIC
/begin CHARACTERISTIC mTCVBTOKL "ROM Const mTCVBTOKL" VALUE 0x00008B56 REC_UBYTE_C 0 COMP_0033 0 20400 /end CHARACTERISTIC
/begin CHARACTERISTIC mTCVDTM "ROM Const mTCVDTM" VALUE 0x00008B57 REC_UBYTE_C 0 COMP_0008 0 25500 /end CHARACTERISTIC
/begin CHARACTERISTIC mTCVHDCLN "ROM Const mTCVHDCLN" VALUE 0x00008B58 REC_UBYTE_C 0 COMP_0000 0 6375 /end CHARACTERISTIC
/begin CHARACTERISTIC mTCVHDOPN "ROM Const mTCVHDOPN" VALUE 0x00008B59 REC_UBYTE_C 0 COMP_0000 0 6375 /end CHARACTERISTIC
/begin CHARACTERISTIC mTCVHLINV "ROM Const mTCVHLINV" VALUE 0x00008B5A REC_UBYTE_C 0 COMP_0027 0 255 /end CHARACTERISTIC
/begin CHARACTERISTIC mTCVIGOF1 "ROM Const mTCVIGOF1" VALUE 0x00008B5B REC_UBYTE_C 0 COMP_0027 0 255 /end CHARACTERISTIC
/begin CHARACTERISTIC mTCVIGON1 "ROM Const mTCVIGON1" VALUE 0x00008B5C REC_UBYTE_C 0 COMP_0257_S 0 255 /end CHARACTERISTIC
/begin CHARACTERISTIC mTCVIGON2 "ROM Const mTCVIGON2" VALUE 0x00008B5D REC_UBYTE_C 0 COMP_0027 0 255 /end CHARACTERISTIC
/begin CHARACTERISTIC mTCVIGONL "ROM Const mTCVIGONL" VALUE 0x00008B5E REC_UBYTE_C 0 COMP_0013 0 255 /end CHARACTERISTIC
/begin CHARACTERISTIC mTCVINVPR "ROM Const mTCVINVPR" VALUE 0x00008B5F REC_UBYTE_C 0 COMP_0257_S 0 255 /end CHARACTERISTIC
/begin CHARACTERISTIC mTCVNLR "ROM Const mTCVNLR" VALUE 0x00008B60 REC_UBYTE_C 0 COMP_0014 0 2550 /end CHARACTERISTIC
/begin CHARACTERISTIC mTCVNRMV "ROM Const mTCVNRMV" VALUE 0x00008B61 REC_UBYTE_C 0 COMP_0257_S 0 255 /end CHARACTERISTIC
/begin CHARACTERISTIC mTCVSTDLY "ROM Const mTCVSTDLY" VALUE 0x00008B62 REC_UBYTE_C 0 COMP_0008 0 25500 /end CHARACTERISTIC
/begin CHARACTERISTIC mTCVTTM "ROM Const mTCVTTM" VALUE 0x00008B63 REC_UBYTE_C 0 COMP_0008 0 25500 /end CHARACTERISTIC
/begin CHARACTERISTIC mTDABF "ROM Const mTDABF" VALUE 0x00008B64 REC_UBYTE_C 0 COMP_0105 0 25.5 /end CHARACTERISTIC
/begin CHARACTERISTIC mTDBHQC "ROM Const mTDBHQC" VALUE 0x000097F4 REC_ULONG_C 0 COMP_0258_S 0 429496.7295 /end CHARACTERISTIC
/begin CHARACTERISTIC mTDGKTVO "ROM Const mTDGKTVO" VALUE 0x00008B65 REC_UBYTE_C 0 COMP_0014 0 2550 /end CHARACTERISTIC
/begin CHARACTERISTIC mTDLTVTM "ROM Const mTDLTVTM" VALUE 0x00008B66 REC_UBYTE_C 0 COMP_0014 0 2550 /end CHARACTERISTIC
/begin CHARACTERISTIC mTDMNCL "ROM Const mTDMNCL" VALUE 0x00008B67 REC_UBYTE_C 0 COMP_0008 0 25500 /end CHARACTERISTIC
/begin CHARACTERISTIC mTDMPSST "ROM Const mTDMPSST" VALUE 0x00009528 REC_UWORD_C 0 COMP_0017_S 0 655.35 /end CHARACTERISTIC
/begin CHARACTERISTIC mTDPHYS "ROM Const mTDPHYS" VALUE 0x0000952A REC_UWORD_C 0 COMP_0164 0 19.988175 /end CHARACTERISTIC
/begin CHARACTERISTIC mTDRQARI2 "ROM Const mTDRQARI2" VALUE 0x00008B68 REC_UBYTE_C 0 COMP_0068 0 255 /end CHARACTERISTIC
/begin CHARACTERISTIC mTDSTAF1 "ROM Const mTDSTAF1" VALUE 0x00008B69 REC_UBYTE_C 0 COMP_0014 0 2550 /end CHARACTERISTIC
/begin CHARACTERISTIC mTDSTAF2 "ROM Const mTDSTAF2" VALUE 0x00008B6A REC_UBYTE_C 0 COMP_0013 0 255 /end CHARACTERISTIC
/begin CHARACTERISTIC mTDWLMAX "ROM Const mTDWLMAX" VALUE 0x00008B6B REC_UBYTE_C 0 COMP_0017 0 255 /end CHARACTERISTIC
/begin CHARACTERISTIC mTDWLMIN "ROM Const mTDWLMIN" VALUE 0x00008B6C REC_UBYTE_C 0 COMP_0017 0 255 /end CHARACTERISTIC
/begin CHARACTERISTIC mTEGRA "ROM Const mTEGRA" VALUE 0x00008B6D REC_UBYTE_C 0 COMP_0008 0 25500 /end CHARACTERISTIC
/begin CHARACTERISTIC mTEHOSAP1 "ROM Const mTEHOSAP1" VALUE 0x0000952C REC_UWORD_C 0 COMP_0005 0 7208.85 /end CHARACTERISTIC
/begin CHARACTERISTIC mTEHOSAP2 "ROM Const mTEHOSAP2" VALUE 0x0000952E REC_UWORD_C 0 COMP_0005 0 7208.85 /end CHARACTERISTIC
/begin CHARACTERISTIC mTEMHDLY "ROM Const mTEMHDLY" VALUE 0x00008B6E REC_UBYTE_C 0 COMP_0287 0 255 /end CHARACTERISTIC
/begin CHARACTERISTIC mTEMIN "ROM Const mTEMIN" VALUE 0x00009530 REC_UWORD_C 0 COMP_0125 0 255.99609375 /end CHARACTERISTIC
/begin CHARACTERISTIC mTETCCLR "ROM Const mTETCCLR" VALUE 0x00008B70 REC_UBYTE_C 0 COMP_0008 0 25500 /end CHARACTERISTIC
/begin CHARACTERISTIC mTEVCN2 "ROM Const mTEVCN2" VALUE 0x00008B71 REC_UBYTE_C 0 COMP_0008 0 25500 /end CHARACTERISTIC
/begin CHARACTERISTIC mTEVDY4 "ROM Const mTEVDY4" VALUE 0x00008B72 REC_UBYTE_C 0 COMP_0008 0 25500 /end CHARACTERISTIC
/begin CHARACTERISTIC mTEVPNG "ROM Const mTEVPNG" VALUE 0x00008B73 REC_UBYTE_C 0 COMP_0008 0 25500 /end CHARACTERISTIC
/begin CHARACTERISTIC mTEWCOFF "ROM Const mTEWCOFF" VALUE 0x00008EAA REC_SWORD_C 0 COMP_0228 -3276.8 3276.7 /end CHARACTERISTIC
/begin CHARACTERISTIC mTFA1 "ROM Const mTFA1" VALUE 0x00008B74 REC_UBYTE_C 0 COMP_0035 -50 205 /end CHARACTERISTIC
/begin CHARACTERISTIC mTFA2 "ROM Const mTFA2" VALUE 0x00008B75 REC_UBYTE_C 0 COMP_0035 -50 205 /end CHARACTERISTIC
/begin CHARACTERISTIC mTFAIN "ROM Const mTFAIN" VALUE 0x00008B76 REC_UBYTE_C 0 COMP_0044 0 1.9921875 /end CHARACTERISTIC
/begin CHARACTERISTIC mTFAIN2 "ROM Const mTFAIN2" VALUE 0x00008B77 REC_UBYTE_C 0 COMP_0044 0 1.9921875 /end CHARACTERISTIC
/begin CHARACTERISTIC mTFALMT "ROM Const mTFALMT" VALUE 0x00008B78 REC_UBYTE_C 0 COMP_0066 0 3.984375 /end CHARACTERISTIC
/begin CHARACTERISTIC mTFAOUT "ROM Const mTFAOUT" VALUE 0x00008B79 REC_UBYTE_C 0 COMP_0044 0 1.9921875 /end CHARACTERISTIC
/begin CHARACTERISTIC mTFBA0SPD "ROM Const mTFBA0SPD" VALUE 0x00009532 REC_UWORD_C 0 COMP_0057 0 3.999941832 /end CHARACTERISTIC
/begin CHARACTERISTIC mTFBLMT "ROM Const mTFBLMT" VALUE 0x00009534 REC_UWORD_C 0 COMP_0217 0 3.999941832 /end CHARACTERISTIC
/begin CHARACTERISTIC mTFBYAKIR "ROM Const mTFBYAKIR" VALUE 0x00009536 REC_UWORD_C 0 COMP_0217 0 3.999941832 /end CHARACTERISTIC
/begin CHARACTERISTIC mTFBYASST "ROM Const mTFBYASST" VALUE 0x00009538 REC_UWORD_C 0 COMP_0217 0 3.999941832 /end CHARACTERISTIC
/begin CHARACTERISTIC mTFBYASST1 "ROM Const mTFBYASST1" VALUE 0x0000953A REC_UWORD_C 0 COMP_0217 0 3.999941832 /end CHARACTERISTIC
/begin CHARACTERISTIC mTFBYASST2 "ROM Const mTFBYASST2" VALUE 0x0000953C REC_UWORD_C 0 COMP_0217 0 3.999941832 /end CHARACTERISTIC
/begin CHARACTERISTIC mTFBYASST3 "ROM Const mTFBYASST3" VALUE 0x0000953E REC_UWORD_C 0 COMP_0217 0 3.999941832 /end CHARACTERISTIC
/begin CHARACTERISTIC mTFCDL "ROM Const mTFCDL" VALUE 0x00008B7A REC_UBYTE_C 0 COMP_0014 0 2550 /end CHARACTERISTIC
/begin CHARACTERISTIC mTFCDL2 "ROM Const mTFCDL2" VALUE 0x00008B7B REC_UBYTE_C 0 COMP_0014 0 2550 /end CHARACTERISTIC
/begin CHARACTERISTIC mTFCRD1 "ROM Const mTFCRD1" VALUE 0x00008B7C REC_UBYTE_C 0 COMP_0014 0 2550 /end CHARACTERISTIC
/begin CHARACTERISTIC mTFCRD2 "ROM Const mTFCRD2" VALUE 0x00008B7D REC_UBYTE_C 0 COMP_0014 0 2550 /end CHARACTERISTIC
/begin CHARACTERISTIC mTFCRD3 "ROM Const mTFCRD3" VALUE 0x00008B7E REC_UBYTE_C 0 COMP_0014 0 2550 /end CHARACTERISTIC
/begin CHARACTERISTIC mTFDCMFW1 "ROM Const mTFDCMFW1" VALUE 0x00009540 REC_UWORD_C 0 COMP_0146 0 99.998480265 /end CHARACTERISTIC
/begin CHARACTERISTIC mTFDCMFW2 "ROM Const mTFDCMFW2" VALUE 0x00009542 REC_UWORD_C 0 COMP_0146 0 99.998480265 /end CHARACTERISTIC
/begin CHARACTERISTIC mTFINTVL "ROM Const mTFINTVL" VALUE 0x00008B7F REC_UBYTE_C 0 COMP_0049 0 255 /end CHARACTERISTIC
/begin CHARACTERISTIC mTFKSLH "ROM Const mTFKSLH" VALUE 0x00009544 REC_UWORD_C 0 COMP_0259_S -50 13057 /end CHARACTERISTIC
/begin CHARACTERISTIC mTFKSLL "ROM Const mTFKSLL" VALUE 0x00009546 REC_UWORD_C 0 COMP_0259_S -50 13057 /end CHARACTERISTIC
/begin CHARACTERISTIC mTFNGH "ROM Const mTFNGH" VALUE 0x00008B80 REC_UBYTE_C 0 COMP_0035 -50 205 /end CHARACTERISTIC
/begin CHARACTERISTIC mTFNGL "ROM Const mTFNGL" VALUE 0x00008B81 REC_UBYTE_C 0 COMP_0035 -50 205 /end CHARACTERISTIC
/begin CHARACTERISTIC mTFNTRIM "ROM Const mTFNTRIM" VALUE 0x00008246 REC_SBYTE_C 0 COMP_0255_S -12.8 12.7 /end CHARACTERISTIC
/begin CHARACTERISTIC mTFPDCK "ROM Const mTFPDCK" VALUE 0x00008B82 REC_UBYTE_C 0 COMP_0008 0 25500 /end CHARACTERISTIC
/begin CHARACTERISTIC mTFPSTNG1 "ROM Const mTFPSTNG1" VALUE 0x00009548 REC_UWORD_C 0 COMP_0014 0 655350 /end CHARACTERISTIC
/begin CHARACTERISTIC mTFPSTNG2 "ROM Const mTFPSTNG2" VALUE 0x0000954A REC_UWORD_C 0 COMP_0014 0 655350 /end CHARACTERISTIC
/begin CHARACTERISTIC mTFPSTNG3 "ROM Const mTFPSTNG3" VALUE 0x0000954C REC_UWORD_C 0 COMP_0014 0 655350 /end CHARACTERISTIC
/begin CHARACTERISTIC mTFRISE "ROM Const mTFRISE" VALUE 0x00008EAC REC_SWORD_C 0 COMP_0003_S -6553.6 6553.4 /end CHARACTERISTIC
/begin CHARACTERISTIC mTFRNL2 "ROM Const mTFRNL2" VALUE 0x00008B83 REC_UBYTE_C 0 COMP_0035 -50 205 /end CHARACTERISTIC
/begin CHARACTERISTIC mTFSETKIR "ROM Const mTFSETKIR" VALUE 0x0000954E REC_UWORD_C 0 COMP_0152_S 0 419424 /end CHARACTERISTIC
/begin CHARACTERISTIC mTFSNDH "ROM Const mTFSNDH" VALUE 0x00008B84 REC_UBYTE_C 0 COMP_0054 0 5100 /end CHARACTERISTIC
/begin CHARACTERISTIC mTFSNDL "ROM Const mTFSNDL" VALUE 0x00008B85 REC_UBYTE_C 0 COMP_0054 0 5100 /end CHARACTERISTIC
/begin CHARACTERISTIC mTFSOAK "ROM Const mTFSOAK" VALUE 0x00008B86 REC_UBYTE_C 0 COMP_0035 -50 205 /end CHARACTERISTIC
/begin CHARACTERISTIC mTFSOAK2 "ROM Const mTFSOAK2" VALUE 0x00008B87 REC_UBYTE_C 0 COMP_0035 -50 205 /end CHARACTERISTIC
/begin CHARACTERISTIC mTFUPDLY "ROM Const mTFUPDLY" VALUE 0x00008B88 REC_UBYTE_C 0 COMP_0105 0 25.5 /end CHARACTERISTIC
/begin CHARACTERISTIC mTFUPKIN "ROM Const mTFUPKIN" VALUE 0x00008B89 REC_UBYTE_C 0 COMP_0113_S 0 51 /end CHARACTERISTIC
/begin CHARACTERISTIC mTFW1 "ROM Const mTFW1" VALUE 0x00008B8A REC_UBYTE_C 0 COMP_0035 -50 205 /end CHARACTERISTIC
/begin CHARACTERISTIC mTFW2 "ROM Const mTFW2" VALUE 0x00008B8B REC_UBYTE_C 0 COMP_0035 -50 205 /end CHARACTERISTIC
/begin CHARACTERISTIC mTGAFIMB "ROM Const mTGAFIMB" VALUE 0x00009550 REC_UWORD_C 0 COMP_0453 0 131.07 /end CHARACTERISTIC
/begin CHARACTERISTIC mTGAFIS "ROM Const mTGAFIS" VALUE 0x00009552 REC_UWORD_C 0 COMP_0453 0 131.07 /end CHARACTERISTIC
/begin CHARACTERISTIC mTGCTMP "ROM Const mTGCTMP" VALUE 0x00008B8C REC_UBYTE_C 0 COMP_0062 0 1020 /end CHARACTERISTIC
/begin CHARACTERISTIC mTGEROFS "ROM Const mTGEROFS" VALUE 0x00008B8D REC_UBYTE_C 0 COMP_0256 -64 63.5 /end CHARACTERISTIC
/begin CHARACTERISTIC mTGFCUT "ROM Const mTGFCUT" VALUE 0x00009554 REC_UWORD_C 0 COMP_0453 0 131.07 /end CHARACTERISTIC
/begin CHARACTERISTIC mTGIGN "ROM Const mTGIGN" VALUE 0x00008B8E REC_UBYTE_C 0 COMP_0182_S 0 0.255 /end CHARACTERISTIC
/begin CHARACTERISTIC mTGIGN2 "ROM Const mTGIGN2" VALUE 0x00008B8F REC_UBYTE_C 0 COMP_0182_S 0 0.255 /end CHARACTERISTIC
/begin CHARACTERISTIC mTGM8ET "ROM Const mTGM8ET" VALUE 0x00008B90 REC_UBYTE_C 0 COMP_0096 0 2550 /end CHARACTERISTIC
/begin CHARACTERISTIC mTGRAC "ROM Const mTGRAC" VALUE 0x00009556 REC_UWORD_C 0 COMP_0139_S 0 4095.9375 /end CHARACTERISTIC
/begin CHARACTERISTIC mTGTACC "ROM Const mTGTACC" VALUE 0x00009770 REC_SLONG_C 0 COMP_0006_S -512.000903872512 512.000903634093 /end CHARACTERISTIC
/begin CHARACTERISTIC mTGTIME "ROM Const mTGTIME" VALUE 0x00009558 REC_UWORD_C 0 COMP_0017_S 0 655.35 /end CHARACTERISTIC
/begin CHARACTERISTIC mTGTMLM "ROM Const mTGTMLM" VALUE 0x00008B91 REC_UBYTE_C 0 COMP_0015_S 0 25.5 /end CHARACTERISTIC
/begin CHARACTERISTIC mTGTVG "ROM Const mTGTVG" VALUE 0x00008B92 REC_UBYTE_C 0 COMP_0315 0 24.90075 /end CHARACTERISTIC
/begin CHARACTERISTIC mTHBLBY "ROM Const mTHBLBY" VALUE 0x00008B93 REC_UBYTE_C 0 COMP_0016 0 255 /end CHARACTERISTIC
/begin CHARACTERISTIC mTHBLTW "ROM Const mTHBLTW" VALUE 0x00008B94 REC_UBYTE_C 0 COMP_0035 -50 205 /end CHARACTERISTIC
/begin CHARACTERISTIC mTHCHG "ROM Const mTHCHG" VALUE 0x00008B95 REC_UBYTE_C 0 COMP_0016 0 255 /end CHARACTERISTIC
/begin CHARACTERISTIC mTHCNT1 "ROM Const mTHCNT1" VALUE 0x00008B96 REC_UBYTE_C 0 COMP_0016 0 255 /end CHARACTERISTIC
/begin CHARACTERISTIC mTHCNT2 "ROM Const mTHCNT2" VALUE 0x00008B97 REC_UBYTE_C 0 COMP_0016 0 255 /end CHARACTERISTIC
/begin CHARACTERISTIC mTHDALP "ROM Const mTHDALP" VALUE 0x00008B98 REC_UBYTE_C 0 COMP_0419 0 25.5 /end CHARACTERISTIC
/begin CHARACTERISTIC mTHONDY "ROM Const mTHONDY" VALUE 0x00008B99 REC_UBYTE_C 0 COMP_0014 0 2550 /end CHARACTERISTIC
/begin CHARACTERISTIC mTHOTWIR "ROM Const mTHOTWIR" VALUE 0x0000955A REC_UWORD_C 0 COMP_0017_S 0 655.35 /end CHARACTERISTIC
/begin CHARACTERISTIC mTHRO2 "ROM Const mTHRO2" VALUE 0x00008B9A REC_UBYTE_C 0 COMP_0049 0 255 /end CHARACTERISTIC
/begin CHARACTERISTIC mTHTM1 "ROM Const mTHTM1" VALUE 0x00008B9B REC_UBYTE_C 0 COMP_0013 0 255 /end CHARACTERISTIC
/begin CHARACTERISTIC mTHTM2 "ROM Const mTHTM2" VALUE 0x00008B9C REC_UBYTE_C 0 COMP_0013 0 255 /end CHARACTERISTIC
/begin CHARACTERISTIC mTHTM3 "ROM Const mTHTM3" VALUE 0x00008B9D REC_UBYTE_C 0 COMP_0105 0 25.5 /end CHARACTERISTIC
/begin CHARACTERISTIC mTHTM4 "ROM Const mTHTM4" VALUE 0x00008B9E REC_UBYTE_C 0 COMP_0105 0 25.5 /end CHARACTERISTIC
/begin CHARACTERISTIC mTIDLENI "ROM Const mTIDLENI" VALUE 0x00008B9F REC_UBYTE_C 0 COMP_0014 0 2550 /end CHARACTERISTIC
/begin CHARACTERISTIC mTIDPRFB "ROM Const mTIDPRFB" VALUE 0x00008BA0 REC_UBYTE_C 0 COMP_0047 0 127.5 /end CHARACTERISTIC
/begin CHARACTERISTIC mTIMIN "ROM Const mTIMIN" VALUE 0x0000955C REC_UWORD_C 0 COMP_0189 0 209712 /end CHARACTERISTIC
/begin CHARACTERISTIC mTIMISC "ROM Const mTIMISC" VALUE 0x00008BA1 REC_UBYTE_C 0 COMP_0013 0 255 /end CHARACTERISTIC
/begin CHARACTERISTIC mTIMNDB "ROM Const mTIMNDB" VALUE 0x0000955E REC_UWORD_C 0 COMP_0189 0 209712 /end CHARACTERISTIC
/begin CHARACTERISTIC mTINADA "ROM Const mTINADA" VALUE 0x00008BA2 REC_UBYTE_C 0 COMP_0006 0 3187.5 /end CHARACTERISTIC
/begin CHARACTERISTIC mTINTED "ROM Const mTINTED" VALUE 0x00008BA3 REC_UBYTE_C 0 COMP_0016 0 255 /end CHARACTERISTIC
/begin CHARACTERISTIC mTINTSMP "ROM Const mTINTSMP" VALUE 0x00008BA4 REC_UBYTE_C 0 COMP_0040_S 0 2.55 /end CHARACTERISTIC
/begin CHARACTERISTIC mTINTST "ROM Const mTINTST" VALUE 0x00008BA5 REC_UBYTE_C 0 COMP_0016 0 255 /end CHARACTERISTIC
/begin CHARACTERISTIC mTINVGP "ROM Const mTINVGP" VALUE 0x00008BA6 REC_UBYTE_C 0 COMP_0014 0 2550 /end CHARACTERISTIC
/begin CHARACTERISTIC mTIPDOF "ROM Const mTIPDOF" VALUE 0x00008BA7 REC_UBYTE_C 0 COMP_0008 0 25500 /end CHARACTERISTIC
/begin CHARACTERISTIC mTIPRQA "ROM Const mTIPRQA" VALUE 0x00008BA8 REC_UBYTE_C 0 COMP_0008 0 25500 /end CHARACTERISTIC
/begin CHARACTERISTIC mTISMIN "ROM Const mTISMIN" VALUE 0x00009560 REC_UWORD_C 0 COMP_0189 0 209712 /end CHARACTERISTIC
/begin CHARACTERISTIC mTISMINCD "ROM Const mTISMINCD" VALUE 0x00009562 REC_UWORD_C 0 COMP_0189 0 209712 /end CHARACTERISTIC
/begin CHARACTERISTIC mTISMINHP "ROM Const mTISMINHP" VALUE 0x00009564 REC_UWORD_C 0 COMP_0189 0 209712 /end CHARACTERISTIC
/begin CHARACTERISTIC mTISMINVC "ROM Const mTISMINVC" VALUE 0x00009566 REC_UWORD_C 0 COMP_0189 0 209712 /end CHARACTERISTIC
/begin CHARACTERISTIC mTITMHADG "ROM Const mTITMHADG" VALUE 0x00009568 REC_UWORD_C 0 COMP_0260_S 0 511.9921875 /end CHARACTERISTIC
/begin CHARACTERISTIC mTITMHADV "ROM Const mTITMHADV" VALUE 0x0000956A REC_UWORD_C 0 COMP_0260_S 0 511.9921875 /end CHARACTERISTIC
/begin CHARACTERISTIC mTITMHPH "ROM Const mTITMHPH" VALUE 0x00008BA9 REC_UBYTE_C 0 COMP_0190 0 510 /end CHARACTERISTIC
/begin CHARACTERISTIC mTITMHPLD "ROM Const mTITMHPLD" VALUE 0x00008BAA REC_UBYTE_C 0 COMP_0190 0 510 /end CHARACTERISTIC
/begin CHARACTERISTIC mTITMHPR "ROM Const mTITMHPR" VALUE 0x00008BAB REC_UBYTE_C 0 COMP_0190 0 510 /end CHARACTERISTIC
/begin CHARACTERISTIC mTITMHPSD "ROM Const mTITMHPSD" VALUE 0x00008BAC REC_UBYTE_C 0 COMP_0190 0 510 /end CHARACTERISTIC
/begin CHARACTERISTIC mTITMHPST "ROM Const mTITMHPST" VALUE 0x00008BAD REC_UBYTE_C 0 COMP_0190 0 510 /end CHARACTERISTIC
/begin CHARACTERISTIC mTITMSADG "ROM Const mTITMSADG" VALUE 0x0000956C REC_UWORD_C 0 COMP_0260_S 0 511.9921875 /end CHARACTERISTIC
/begin CHARACTERISTIC mTITMSADV "ROM Const mTITMSADV" VALUE 0x0000956E REC_UWORD_C 0 COMP_0260_S 0 511.9921875 /end CHARACTERISTIC
/begin CHARACTERISTIC mTITMSRET "ROM Const mTITMSRET" VALUE 0x00009570 REC_UWORD_C 0 COMP_0260_S 0 511.9921875 /end CHARACTERISTIC
/begin CHARACTERISTIC mTITMSRTG "ROM Const mTITMSRTG" VALUE 0x00009572 REC_UWORD_C 0 COMP_0260_S 0 511.9921875 /end CHARACTERISTIC
/begin CHARACTERISTIC mTKFBALMT "ROM Const mTKFBALMT" VALUE 0x00008BAE REC_UBYTE_C 0 COMP_0048_S 0 31.875 /end CHARACTERISTIC
/begin CHARACTERISTIC mTLGPIT "ROM Const mTLGPIT" VALUE 0x00008BAF REC_UBYTE_C 0 COMP_0049 0 255 /end CHARACTERISTIC
/begin CHARACTERISTIC mTLKBRA "ROM Const mTLKBRA" VALUE 0x00008BB0 REC_UBYTE_C 0 COMP_0049 0 255 /end CHARACTERISTIC
/begin CHARACTERISTIC mTMACLT "ROM Const mTMACLT" VALUE 0x00008BB1 REC_UBYTE_C 0 COMP_0013 0 255 /end CHARACTERISTIC
/begin CHARACTERISTIC mTMACON "ROM Const mTMACON" VALUE 0x00008BB2 REC_UBYTE_C 0 COMP_0014 0 2550 /end CHARACTERISTIC
/begin CHARACTERISTIC mTMACST "ROM Const mTMACST" VALUE 0x00008BB3 REC_UBYTE_C 0 COMP_0008 0 25500 /end CHARACTERISTIC
/begin CHARACTERISTIC mTMADJM1 "ROM Const mTMADJM1" VALUE 0x00008BB4 REC_UBYTE_C 0 COMP_0014 0 2550 /end CHARACTERISTIC
/begin CHARACTERISTIC mTMAFKMR "ROM Const mTMAFKMR" VALUE 0x00008BB5 REC_UBYTE_C 0 COMP_0049 0 255 /end CHARACTERISTIC
/begin CHARACTERISTIC mTMALTLD "ROM Const mTMALTLD" VALUE 0x00008BB6 REC_UBYTE_C 0 COMP_0008 0 25500 /end CHARACTERISTIC
/begin CHARACTERISTIC mTMANSTP "ROM Const mTMANSTP" VALUE 0x00008BB7 REC_UBYTE_C 0 COMP_0014 0 2550 /end CHARACTERISTIC
/begin CHARACTERISTIC mTMBRKOF "ROM Const mTMBRKOF" VALUE 0x00008BB8 REC_UBYTE_C 0 COMP_0014 0 2550 /end CHARACTERISTIC
/begin CHARACTERISTIC mTMCGDST "ROM Const mTMCGDST" VALUE 0x00008BB9 REC_UBYTE_C 0 COMP_0049 0 255 /end CHARACTERISTIC
/begin CHARACTERISTIC mTMCHASCD "ROM Const mTMCHASCD" VALUE 0x00008BBA REC_UBYTE_C 0 COMP_0014 0 2550 /end CHARACTERISTIC
/begin CHARACTERISTIC mTMCLSTK2 "ROM Const mTMCLSTK2" VALUE 0x00008BBB REC_UBYTE_C 0 COMP_0040_S 0 2.55 /end CHARACTERISTIC
/begin CHARACTERISTIC mTMCMON "ROM Const mTMCMON" VALUE 0x00008BBC REC_UBYTE_C 0 COMP_0234 0 2550 /end CHARACTERISTIC
/begin CHARACTERISTIC mTMCRK "ROM Const mTMCRK" VALUE 0x00008BBD REC_UBYTE_C 0 COMP_0008 0 25500 /end CHARACTERISTIC
/begin CHARACTERISTIC mTMDOS "ROM Const mTMDOS" VALUE 0x00008BBE REC_UBYTE_C 0 COMP_0049 0 255 /end CHARACTERISTIC
/begin CHARACTERISTIC mTMDTIV "ROM Const mTMDTIV" VALUE 0x00008BBF REC_UBYTE_C 0 COMP_0049 0 255 /end CHARACTERISTIC
/begin CHARACTERISTIC mTMDTMP "ROM Const mTMDTMP" VALUE 0x00008BC0 REC_UBYTE_C 0 COMP_0035 -50 205 /end CHARACTERISTIC
/begin CHARACTERISTIC mTMDTWU "ROM Const mTMDTWU" VALUE 0x00009574 REC_UWORD_C 0 COMP_0013 0 65535 /end CHARACTERISTIC
/begin CHARACTERISTIC mTMDVDG "ROM Const mTMDVDG" VALUE 0x00008BC1 REC_UBYTE_C 0 COMP_0008 0 25500 /end CHARACTERISTIC
/begin CHARACTERISTIC mTMENST "ROM Const mTMENST" VALUE 0x00008BC2 REC_UBYTE_C 0 COMP_0008 0 25500 /end CHARACTERISTIC
/begin CHARACTERISTIC mTMEVC3 "ROM Const mTMEVC3" VALUE 0x00008BC3 REC_UBYTE_C 0 COMP_0013 0 255 /end CHARACTERISTIC
/begin CHARACTERISTIC mTMEVC4 "ROM Const mTMEVC4" VALUE 0x00008BC4 REC_UBYTE_C 0 COMP_0008 0 25500 /end CHARACTERISTIC
/begin CHARACTERISTIC mTMEVLNS "ROM Const mTMEVLNS" VALUE 0x00008BC5 REC_UBYTE_C 0 COMP_0013 0 255 /end CHARACTERISTIC
/begin CHARACTERISTIC mTMEVPC "ROM Const mTMEVPC" VALUE 0x00008BC6 REC_UBYTE_C 0 COMP_0013 0 255 /end CHARACTERISTIC
/begin CHARACTERISTIC mTMFD2 "ROM Const mTMFD2" VALUE 0x00008BC7 REC_UBYTE_C 0 COMP_0014 0 2550 /end CHARACTERISTIC
/begin CHARACTERISTIC mTMFD3 "ROM Const mTMFD3" VALUE 0x00008BC8 REC_UBYTE_C 0 COMP_0014 0 2550 /end CHARACTERISTIC
/begin CHARACTERISTIC mTMFPON "ROM Const mTMFPON" VALUE 0x00008BC9 REC_UBYTE_C 0 COMP_0008 0 25500 /end CHARACTERISTIC
/begin CHARACTERISTIC mTMFRGPH "ROM Const mTMFRGPH" VALUE 0x00008BCA REC_UBYTE_C 0 COMP_0068 0 255 /end CHARACTERISTIC
/begin CHARACTERISTIC mTMFRGPL "ROM Const mTMFRGPL" VALUE 0x00008BCB REC_UBYTE_C 0 COMP_0068 0 255 /end CHARACTERISTIC
/begin CHARACTERISTIC mTMFRKI1 "ROM Const mTMFRKI1" VALUE 0x00008BCC REC_UBYTE_C 0 COMP_0171 0 398.4375 /end CHARACTERISTIC
/begin CHARACTERISTIC mTMFRKI2 "ROM Const mTMFRKI2" VALUE 0x00008BCD REC_UBYTE_C 0 COMP_0171 0 398.4375 /end CHARACTERISTIC
/begin CHARACTERISTIC mTMFRNEH "ROM Const mTMFRNEH" VALUE 0x00008BCE REC_UBYTE_C 0 COMP_0000 0 6375 /end CHARACTERISTIC
/begin CHARACTERISTIC mTMGASCD "ROM Const mTMGASCD" VALUE 0x00008BCF REC_UBYTE_C 0 COMP_0014 0 2550 /end CHARACTERISTIC
/begin CHARACTERISTIC mTMGNSK "ROM Const mTMGNSK" VALUE 0x00008BD0 REC_UBYTE_C 0 COMP_0014 0 2550 /end CHARACTERISTIC
/begin CHARACTERISTIC mTMGSTVAC "ROM Const mTMGSTVAC" VALUE 0x00008BD1 REC_UBYTE_C 0 COMP_0261_S 0 510 /end CHARACTERISTIC
/begin CHARACTERISTIC mTMHADI "ROM Const mTMHADI" VALUE 0x00008BD2 REC_UBYTE_C 0 COMP_0014 0 2550 /end CHARACTERISTIC
/begin CHARACTERISTIC mTMHEAT "ROM Const mTMHEAT" VALUE 0x00008BD3 REC_UBYTE_C 0 COMP_0013 0 255 /end CHARACTERISTIC
/begin CHARACTERISTIC mTMHMX1 "ROM Const mTMHMX1" VALUE 0x00008BD4 REC_UBYTE_C 0 COMP_0008 0 25500 /end CHARACTERISTIC
/begin CHARACTERISTIC mTMHNT "ROM Const mTMHNT" VALUE 0x00008BD5 REC_UBYTE_C 0 COMP_0008 0 25500 /end CHARACTERISTIC
/begin CHARACTERISTIC mTMIHRLY1 "ROM Const mTMIHRLY1" VALUE 0x00008BD6 REC_UBYTE_C 0 COMP_0015_S 0 25.5 /end CHARACTERISTIC
/begin CHARACTERISTIC mTMIHRLY2 "ROM Const mTMIHRLY2" VALUE 0x00008BD7 REC_UBYTE_C 0 COMP_0015_S 0 25.5 /end CHARACTERISTIC
/begin CHARACTERISTIC mTMINH1 "ROM Const mTMINH1" VALUE 0x00008BD8 REC_UBYTE_C 0 COMP_0015_S 0 25.5 /end CHARACTERISTIC
/begin CHARACTERISTIC mTMINH2 "ROM Const mTMINH2" VALUE 0x00008BD9 REC_UBYTE_C 0 COMP_0015_S 0 25.5 /end CHARACTERISTIC
/begin CHARACTERISTIC mTMINH3 "ROM Const mTMINH3" VALUE 0x00008BDA REC_UBYTE_C 0 COMP_0015_S 0 25.5 /end CHARACTERISTIC
/begin CHARACTERISTIC mTMINH4 "ROM Const mTMINH4" VALUE 0x00008BDB REC_UBYTE_C 0 COMP_0015_S 0 25.5 /end CHARACTERISTIC
/begin CHARACTERISTIC mTMINHT "ROM Const mTMINHT" VALUE 0x00008BDC REC_UBYTE_C 0 COMP_0234 0 2550 /end CHARACTERISTIC
/begin CHARACTERISTIC mTMISTY "ROM Const mTMISTY" VALUE 0x00008BDD REC_UBYTE_C 0 COMP_0014 0 2550 /end CHARACTERISTIC
/begin CHARACTERISTIC mTMLOF "ROM Const mTMLOF" VALUE 0x00008BDE REC_UBYTE_C 0 COMP_0014 0 2550 /end CHARACTERISTIC
/begin CHARACTERISTIC mTMLUBRK "ROM Const mTMLUBRK" VALUE 0x00008BDF REC_UBYTE_C 0 COMP_0014 0 2550 /end CHARACTERISTIC
/begin CHARACTERISTIC mTMLUOF "ROM Const mTMLUOF" VALUE 0x00008BE0 REC_UBYTE_C 0 COMP_0040_S 0 2.55 /end CHARACTERISTIC
/begin CHARACTERISTIC mTMMFD "ROM Const mTMMFD" VALUE 0x00008BE1 REC_UBYTE_C 0 COMP_0008 0 25500 /end CHARACTERISTIC
/begin CHARACTERISTIC mTMNDDLY "ROM Const mTMNDDLY" VALUE 0x00008BE2 REC_UBYTE_C 0 COMP_0008 0 25500 /end CHARACTERISTIC
/begin CHARACTERISTIC mTMNGCP "ROM Const mTMNGCP" VALUE 0x00008BE3 REC_UBYTE_C 0 COMP_0049 0 255 /end CHARACTERISTIC
/begin CHARACTERISTIC mTMNGSET "ROM Const mTMNGSET" VALUE 0x00008BE4 REC_UBYTE_C 0 COMP_0234 0 2550 /end CHARACTERISTIC
/begin CHARACTERISTIC mTMNOACT "ROM Const mTMNOACT" VALUE 0x00008BE5 REC_UBYTE_C 0 COMP_0013 0 255 /end CHARACTERISTIC
/begin CHARACTERISTIC mTMNRDLY "ROM Const mTMNRDLY" VALUE 0x00008BE6 REC_UBYTE_C 0 COMP_0008 0 25500 /end CHARACTERISTIC
/begin CHARACTERISTIC mTMNSD "ROM Const mTMNSD" VALUE 0x00008BE7 REC_UBYTE_C 0 COMP_0049 0 255 /end CHARACTERISTIC
/begin CHARACTERISTIC mTMNSETS2 "ROM Const mTMNSETS2" VALUE 0x00008BE8 REC_UBYTE_C 0 COMP_0008 0 25500 /end CHARACTERISTIC
/begin CHARACTERISTIC mTMO2H "ROM Const mTMO2H" VALUE 0x00008BE9 REC_UBYTE_C 0 COMP_0008 0 25500 /end CHARACTERISTIC
/begin CHARACTERISTIC mTMOKCP "ROM Const mTMOKCP" VALUE 0x00008BEA REC_UBYTE_C 0 COMP_0049 0 255 /end CHARACTERISTIC
/begin CHARACTERISTIC mTMPIST "ROM Const mTMPIST" VALUE 0x00008BEB REC_UBYTE_C 0 COMP_0013 0 255 /end CHARACTERISTIC
/begin CHARACTERISTIC mTMPSOF "ROM Const mTMPSOF" VALUE 0x00008BEC REC_UBYTE_C 0 COMP_0014 0 2550 /end CHARACTERISTIC
/begin CHARACTERISTIC mTMPSON "ROM Const mTMPSON" VALUE 0x00008BED REC_UBYTE_C 0 COMP_0008 0 25500 /end CHARACTERISTIC
/begin CHARACTERISTIC mTMPST1 "ROM Const mTMPST1" VALUE 0x00008BEE REC_UBYTE_C 0 COMP_0008 0 25500 /end CHARACTERISTIC
/begin CHARACTERISTIC mTMQMASK "ROM Const mTMQMASK" VALUE 0x00008BEF REC_UBYTE_C 0 COMP_0008 0 25500 /end CHARACTERISTIC
/begin CHARACTERISTIC mTMR123 "ROM Const mTMR123" VALUE 0x00008BF0 REC_UBYTE_C 0 COMP_0014 0 2550 /end CHARACTERISTIC
/begin CHARACTERISTIC mTMR123D "ROM Const mTMR123D" VALUE 0x00008BF1 REC_UBYTE_C 0 COMP_0014 0 2550 /end CHARACTERISTIC
/begin CHARACTERISTIC mTMRND "ROM Const mTMRND" VALUE 0x00008BF2 REC_UBYTE_C 0 COMP_0014 0 2550 /end CHARACTERISTIC
/begin CHARACTERISTIC mTMRND2 "ROM Const mTMRND2" VALUE 0x00008BF3 REC_UBYTE_C 0 COMP_0049 0 255 /end CHARACTERISTIC
/begin CHARACTERISTIC mTMRNGD "ROM Const mTMRNGD" VALUE 0x00008BF4 REC_UBYTE_C 0 COMP_0049 0 255 /end CHARACTERISTIC
/begin CHARACTERISTIC mTMRNGF "ROM Const mTMRNGF" VALUE 0x00008BF5 REC_UBYTE_C 0 COMP_0049 0 255 /end CHARACTERISTIC
/begin CHARACTERISTIC mTMRNR "ROM Const mTMRNR" VALUE 0x00008BF6 REC_UBYTE_C 0 COMP_0014 0 2550 /end CHARACTERISTIC
/begin CHARACTERISTIC mTMRO2H "ROM Const mTMRO2H" VALUE 0x00008BF7 REC_UBYTE_C 0 COMP_0049 0 255 /end CHARACTERISTIC
/begin CHARACTERISTIC mTMROFF "ROM Const mTMROFF" VALUE 0x00008BF8 REC_UBYTE_C 0 COMP_0014 0 2550 /end CHARACTERISTIC
/begin CHARACTERISTIC mTMRTOP "ROM Const mTMRTOP" VALUE 0x00008BF9 REC_UBYTE_C 0 COMP_0014 0 2550 /end CHARACTERISTIC
/begin CHARACTERISTIC mTMRTOPD "ROM Const mTMRTOPD" VALUE 0x00008BFA REC_UBYTE_C 0 COMP_0014 0 2550 /end CHARACTERISTIC
/begin CHARACTERISTIC mTMSFT "ROM Const mTMSFT" VALUE 0x00008BFB REC_UBYTE_C 0 COMP_0014 0 2550 /end CHARACTERISTIC
/begin CHARACTERISTIC mTMSLSH02 "ROM Const mTMSLSH02" VALUE 0x00008BFC REC_UBYTE_C 0 COMP_0008 0 25500 /end CHARACTERISTIC
/begin CHARACTERISTIC mTMSLSH04 "ROM Const mTMSLSH04" VALUE 0x00008BFD REC_UBYTE_C 0 COMP_0008 0 25500 /end CHARACTERISTIC
/begin CHARACTERISTIC mTMSTRLY1 "ROM Const mTMSTRLY1" VALUE 0x00008BFE REC_UBYTE_C 0 COMP_0015_S 0 25.5 /end CHARACTERISTIC
/begin CHARACTERISTIC mTMSTRLY2 "ROM Const mTMSTRLY2" VALUE 0x00008BFF REC_UBYTE_C 0 COMP_0015_S 0 25.5 /end CHARACTERISTIC
/begin CHARACTERISTIC mTMSTRLY3 "ROM Const mTMSTRLY3" VALUE 0x00008C00 REC_UBYTE_C 0 COMP_0015_S 0 25.5 /end CHARACTERISTIC
/begin CHARACTERISTIC mTMSTRLY4 "ROM Const mTMSTRLY4" VALUE 0x00008C01 REC_UBYTE_C 0 COMP_0015_S 0 25.5 /end CHARACTERISTIC
/begin CHARACTERISTIC mTMSTRW "ROM Const mTMSTRW" VALUE 0x00008C02 REC_UBYTE_C 0 COMP_0015_S 0 25.5 /end CHARACTERISTIC
/begin CHARACTERISTIC mTMTAN1 "ROM Const mTMTAN1" VALUE 0x00008C03 REC_UBYTE_C 0 COMP_0013 0 255 /end CHARACTERISTIC
/begin CHARACTERISTIC mTMTAN2 "ROM Const mTMTAN2" VALUE 0x00008C04 REC_UBYTE_C 0 COMP_0013 0 255 /end CHARACTERISTIC
/begin CHARACTERISTIC mTMTRIP "ROM Const mTMTRIP" VALUE 0x00008C05 REC_UBYTE_C 0 COMP_0234 0 2550 /end CHARACTERISTIC
/begin CHARACTERISTIC mTMTXD "ROM Const mTMTXD" VALUE 0x00008C06 REC_UBYTE_C 0 COMP_0014 0 2550 /end CHARACTERISTIC
/begin CHARACTERISTIC mTMVASCD "ROM Const mTMVASCD" VALUE 0x00008C07 REC_UBYTE_C 0 COMP_0008 0 25500 /end CHARACTERISTIC
/begin CHARACTERISTIC mTMVBCON "ROM Const mTMVBCON" VALUE 0x00008C08 REC_UBYTE_C 0 COMP_0040_S 0 2.55 /end CHARACTERISTIC
/begin CHARACTERISTIC mTMVPB100 "ROM Const mTMVPB100" VALUE 0x00008C09 REC_UBYTE_C 0 COMP_0008 0 25500 /end CHARACTERISTIC
/begin CHARACTERISTIC mTMVSNG "ROM Const mTMVSNG" VALUE 0x00008C0A REC_UBYTE_C 0 COMP_0013 0 255 /end CHARACTERISTIC
/begin CHARACTERISTIC mTMVTCOL "ROM Const mTMVTCOL" VALUE 0x00008C0B REC_UBYTE_C 0 COMP_0014 0 2550 /end CHARACTERISTIC
/begin CHARACTERISTIC mTNCUTD "ROM Const mTNCUTD" VALUE 0x00008C0C REC_UBYTE_C 0 COMP_0049 0 255 /end CHARACTERISTIC
/begin CHARACTERISTIC mTNICHTM "ROM Const mTNICHTM" VALUE 0x00008C0D REC_UBYTE_C 0 COMP_0014 0 2550 /end CHARACTERISTIC
/begin CHARACTERISTIC mTNKPSL "ROM Const mTNKPSL" VALUE 0x00008EAE REC_SWORD_C 0 COMP_0002_S -32768 32767 /end CHARACTERISTIC
/begin CHARACTERISTIC mTNOIS "ROM Const mTNOIS" VALUE 0x00008C0E REC_UBYTE_C 0 COMP_0063 0 0.99609375 /end CHARACTERISTIC
/begin CHARACTERISTIC mTNPRD "ROM Const mTNPRD" VALUE 0x00008C0F REC_UBYTE_C 0 COMP_0020 0 12750 /end CHARACTERISTIC
/begin CHARACTERISTIC mTNRACING "ROM Const mTNRACING" VALUE 0x00008C10 REC_UBYTE_C 0 COMP_0008 0 25500 /end CHARACTERISTIC
/begin CHARACTERISTIC mTNSETDHL "ROM Const mTNSETDHL" VALUE 0x00008C11 REC_UBYTE_C 0 COMP_0013 0 255 /end CHARACTERISTIC
/begin CHARACTERISTIC mTNTWKST "ROM Const mTNTWKST" VALUE 0x00008C12 REC_UBYTE_C 0 COMP_0356 -40 119.375 /end CHARACTERISTIC
/begin CHARACTERISTIC mTNZERO "ROM Const mTNZERO" VALUE 0x00008C13 REC_UBYTE_C 0 COMP_0014 0 2550 /end CHARACTERISTIC
/begin CHARACTERISTIC mTO2HYS "ROM Const mTO2HYS" VALUE 0x00008C14 REC_UBYTE_C 0 COMP_0061 0 1275 /end CHARACTERISTIC
/begin CHARACTERISTIC mTO2THD "ROM Const mTO2THD" VALUE 0x00009576 REC_UWORD_C 0 COMP_0061 0 327675 /end CHARACTERISTIC
/begin CHARACTERISTIC mTOCNSH "ROM Const mTOCNSH" VALUE 0x00008C15 REC_UBYTE_C 0 COMP_0261_S 0 510 /end CHARACTERISTIC
/begin CHARACTERISTIC mTOCNSL "ROM Const mTOCNSL" VALUE 0x00008C16 REC_UBYTE_C 0 COMP_0261_S 0 510 /end CHARACTERISTIC
/begin CHARACTERISTIC mTOESD1 "ROM Const mTOESD1" VALUE 0x00008C17 REC_UBYTE_C 0 COMP_0261_S 0 510 /end CHARACTERISTIC
/begin CHARACTERISTIC mTOPMITH "ROM Const mTOPMITH" VALUE 0x00008C18 REC_UBYTE_C 0 COMP_0035 -50 205 /end CHARACTERISTIC
/begin CHARACTERISTIC mTOPSNG1 "ROM Const mTOPSNG1" VALUE 0x00009578 REC_UWORD_C 0 COMP_0015_S 0 6553.5 /end CHARACTERISTIC
/begin CHARACTERISTIC mTOPSOK1 "ROM Const mTOPSOK1" VALUE 0x0000957A REC_UWORD_C 0 COMP_0015_S 0 6553.5 /end CHARACTERISTIC
/begin CHARACTERISTIC mTOSNGD "ROM Const mTOSNGD" VALUE 0x00008C19 REC_UBYTE_C 0 COMP_0013 0 255 /end CHARACTERISTIC
/begin CHARACTERISTIC mTOUTRVNG "ROM Const mTOUTRVNG" VALUE 0x00008C1A REC_UBYTE_C 0 COMP_0024 0 12750 /end CHARACTERISTIC
/begin CHARACTERISTIC mTP100 "ROM Const mTP100" VALUE 0x0000957C REC_UWORD_C 0 COMP_0052 0 31.99956087 /end CHARACTERISTIC
/begin CHARACTERISTIC mTP10YR4 "ROM Const mTP10YR4" VALUE 0x0000957E REC_UWORD_C 0 COMP_0073 0 209712 /end CHARACTERISTIC
/begin CHARACTERISTIC mTP10YR5 "ROM Const mTP10YR5" VALUE 0x00009580 REC_UWORD_C 0 COMP_0073 0 209712 /end CHARACTERISTIC
/begin CHARACTERISTIC mTP10YR6 "ROM Const mTP10YR6" VALUE 0x00009582 REC_UWORD_C 0 COMP_0073 0 209712 /end CHARACTERISTIC
/begin CHARACTERISTIC mTPCHCRG "ROM Const mTPCHCRG" VALUE 0x00008C1B REC_UBYTE_C 0 COMP_0005 0 28.05 /end CHARACTERISTIC
/begin CHARACTERISTIC mTPCHCRK "ROM Const mTPCHCRK" VALUE 0x00008C1C REC_UBYTE_C 0 COMP_0005 0 28.05 /end CHARACTERISTIC
/begin CHARACTERISTIC mTPCHK "ROM Const mTPCHK" VALUE 0x00008C1D REC_UBYTE_C 0 COMP_0001 0 31.875 /end CHARACTERISTIC
/begin CHARACTERISTIC mTPCLP1 "ROM Const mTPCLP1" VALUE 0x00008C1E REC_UBYTE_C 0 COMP_0001 0 31.875 /end CHARACTERISTIC
/begin CHARACTERISTIC mTPCLP2 "ROM Const mTPCLP2" VALUE 0x00008C1F REC_UBYTE_C 0 COMP_0001 0 31.875 /end CHARACTERISTIC
/begin CHARACTERISTIC mTPCPYR "ROM Const mTPCPYR" VALUE 0x00008C20 REC_UBYTE_C 0 COMP_0186 0 3.984375 /end CHARACTERISTIC
/begin CHARACTERISTIC mTPCPYR1 "ROM Const mTPCPYR1" VALUE 0x00008C21 REC_UBYTE_C 0 COMP_0186 0 3.984375 /end CHARACTERISTIC
/begin CHARACTERISTIC mTPCPYR2 "ROM Const mTPCPYR2" VALUE 0x00008C22 REC_UBYTE_C 0 COMP_0186 0 3.984375 /end CHARACTERISTIC
/begin CHARACTERISTIC mTPCPYR3 "ROM Const mTPCPYR3" VALUE 0x00008C23 REC_UBYTE_C 0 COMP_0186 0 3.984375 /end CHARACTERISTIC
/begin CHARACTERISTIC mTPCST "ROM Const mTPCST" VALUE 0x00008C24 REC_UBYTE_C 0 COMP_0001 0 31.875 /end CHARACTERISTIC
/begin CHARACTERISTIC mTPCTH "ROM Const mTPCTH" VALUE 0x00008C25 REC_UBYTE_C 0 COMP_0001 0 31.875 /end CHARACTERISTIC
/begin CHARACTERISTIC mTPCTL "ROM Const mTPCTL" VALUE 0x00008C26 REC_UBYTE_C 0 COMP_0001 0 31.875 /end CHARACTERISTIC
/begin CHARACTERISTIC mTPCTYCRI "ROM Const mTPCTYCRI" VALUE 0x00009584 REC_UWORD_C 0 COMP_0144 0 31.999495335 /end CHARACTERISTIC
/begin CHARACTERISTIC mTPCTYSTP "ROM Const mTPCTYSTP" VALUE 0x00009586 REC_UWORD_C 0 COMP_0262_S 0 131.07 /end CHARACTERISTIC
/begin CHARACTERISTIC mTPDEFO "ROM Const mTPDEFO" VALUE 0x000097F8 REC_ULONG_C 0 COMP_0343 0 26214401.6045092 /end CHARACTERISTIC
/begin CHARACTERISTIC mTPFCD "ROM Const mTPFCD" VALUE 0x00008C27 REC_UBYTE_C 0 COMP_0008 0 25500 /end CHARACTERISTIC
/begin CHARACTERISTIC mTPFLDU "ROM Const mTPFLDU" VALUE 0x00009588 REC_UWORD_C 0 COMP_0164 0 19.988175 /end CHARACTERISTIC
/begin CHARACTERISTIC mTPGCK "ROM Const mTPGCK" VALUE 0x00008C28 REC_UBYTE_C 0 COMP_0013 0 255 /end CHARACTERISTIC
/begin CHARACTERISTIC mTPGCK3 "ROM Const mTPGCK3" VALUE 0x00008C29 REC_UBYTE_C 0 COMP_0013 0 255 /end CHARACTERISTIC
/begin CHARACTERISTIC mTPIHT "ROM Const mTPIHT" VALUE 0x00008C2A REC_UBYTE_C 0 COMP_0008 0 25500 /end CHARACTERISTIC
/begin CHARACTERISTIC mTPJDGSL1 "ROM Const mTPJDGSL1" VALUE 0x00008C2B REC_UBYTE_C 0 COMP_0068 0 255 /end CHARACTERISTIC
/begin CHARACTERISTIC mTPJDGSL2 "ROM Const mTPJDGSL2" VALUE 0x00008C2C REC_UBYTE_C 0 COMP_0068 0 255 /end CHARACTERISTIC
/begin CHARACTERISTIC mTPKBDH "ROM Const mTPKBDH" VALUE 0x00008C2D REC_UBYTE_C 0 COMP_0001 0 31.875 /end CHARACTERISTIC
/begin CHARACTERISTIC mTPKBDL "ROM Const mTPKBDL" VALUE 0x00008C2E REC_UBYTE_C 0 COMP_0001 0 31.875 /end CHARACTERISTIC
/begin CHARACTERISTIC mTPKBH "ROM Const mTPKBH" VALUE 0x00008C2F REC_UBYTE_C 0 COMP_0001 0 31.875 /end CHARACTERISTIC
/begin CHARACTERISTIC mTPKBL "ROM Const mTPKBL" VALUE 0x00008C30 REC_UBYTE_C 0 COMP_0001 0 31.875 /end CHARACTERISTIC
/begin CHARACTERISTIC mTPMFR2 "ROM Const mTPMFR2" VALUE 0x00008C31 REC_UBYTE_C 0 COMP_0001 0 31.875 /end CHARACTERISTIC
/begin CHARACTERISTIC mTPNSH "ROM Const mTPNSH" VALUE 0x00008C32 REC_UBYTE_C 0 COMP_0001 0 31.875 /end CHARACTERISTIC
/begin CHARACTERISTIC mTPNSL "ROM Const mTPNSL" VALUE 0x00008C33 REC_UBYTE_C 0 COMP_0001 0 31.875 /end CHARACTERISTIC
/begin CHARACTERISTIC mTPOFFON "ROM Const mTPOFFON" VALUE 0x00008C34 REC_UBYTE_C 0 COMP_0014 0 2550 /end CHARACTERISTIC
/begin CHARACTERISTIC mTPOSCPSL "ROM Const mTPOSCPSL" VALUE 0x00008C35 REC_UBYTE_C 0 COMP_0186 0 3.984375 /end CHARACTERISTIC
/begin CHARACTERISTIC mTPOTM1 "ROM Const mTPOTM1" VALUE 0x00008C36 REC_UBYTE_C 0 COMP_0049 0 255 /end CHARACTERISTIC
/begin CHARACTERISTIC mTPOTM2 "ROM Const mTPOTM2" VALUE 0x00008C37 REC_UBYTE_C 0 COMP_0049 0 255 /end CHARACTERISTIC
/begin CHARACTERISTIC mTPPFLNG "ROM Const mTPPFLNG" VALUE 0x0000958A REC_UWORD_C 0 COMP_0144 0 31.999495335 /end CHARACTERISTIC
/begin CHARACTERISTIC mTPRVL "ROM Const mTPRVL" VALUE 0x0000958C REC_UWORD_C 0 COMP_0144 0 31.999495335 /end CHARACTERISTIC
/begin CHARACTERISTIC mTPRVU "ROM Const mTPRVU" VALUE 0x0000958E REC_UWORD_C 0 COMP_0144 0 31.999495335 /end CHARACTERISTIC
/begin CHARACTERISTIC mTPSLMT "ROM Const mTPSLMT" VALUE 0x00009590 REC_UWORD_C 0 COMP_0144 0 31.999495335 /end CHARACTERISTIC
/begin CHARACTERISTIC mTPSVH "ROM Const mTPSVH" VALUE 0x00009592 REC_UWORD_C 0 COMP_0023 0 327675 /end CHARACTERISTIC
/begin CHARACTERISTIC mTPSVL "ROM Const mTPSVL" VALUE 0x00009594 REC_UWORD_C 0 COMP_0023 0 327675 /end CHARACTERISTIC
/begin CHARACTERISTIC mTPUMKEMN "ROM Const mTPUMKEMN" VALUE 0x00009596 REC_UWORD_C 0 COMP_0152_S 0 419424 /end CHARACTERISTIC
/begin CHARACTERISTIC mTPVHYS "ROM Const mTPVHYS" VALUE 0x00008C38 REC_UBYTE_C 0 COMP_0001 0 31.875 /end CHARACTERISTIC
/begin CHARACTERISTIC mTQDH "ROM Const mTQDH" VALUE 0x00008C39 REC_UBYTE_C 0 COMP_0017 0 255 /end CHARACTERISTIC
/begin CHARACTERISTIC mTQDYNH "ROM Const mTQDYNH" VALUE 0x00008C3A REC_UBYTE_C 0 COMP_0014 0 2550 /end CHARACTERISTIC
/begin CHARACTERISTIC mTQMDLT0 "ROM Const mTQMDLT0" VALUE 0x00008EB0 REC_SWORD_C 0 COMP_0228 -3276.8 3276.7 /end CHARACTERISTIC
/begin CHARACTERISTIC mTQTMLMRC "ROM Const mTQTMLMRC" VALUE 0x00009598 REC_UWORD_C 0 COMP_0193 0 6553.5 /end CHARACTERISTIC
/begin CHARACTERISTIC mTQTMLMT "ROM Const mTQTMLMT" VALUE 0x00008EB2 REC_SWORD_C 0 COMP_0228 -3276.8 3276.7 /end CHARACTERISTIC
/begin CHARACTERISTIC mTQTMLMTN "ROM Const mTQTMLMTN" VALUE 0x00008EB4 REC_SWORD_C 0 COMP_0228 -3276.8 3276.7 /end CHARACTERISTIC
/begin CHARACTERISTIC mTRAD2VSP "ROM Const mTRAD2VSP" VALUE 0x00008C3B REC_UBYTE_C 0 COMP_0007 0 510 /end CHARACTERISTIC
/begin CHARACTERISTIC mTRADIDTM "ROM Const mTRADIDTM" VALUE 0x00008C3C REC_UBYTE_C 0 COMP_0014 0 2550 /end CHARACTERISTIC
/begin CHARACTERISTIC mTRASTDLY "ROM Const mTRASTDLY" VALUE 0x00008C3D REC_UBYTE_C 0 COMP_0017_S 0 2.55 /end CHARACTERISTIC
/begin CHARACTERISTIC mTRCADV "ROM Const mTRCADV" VALUE 0x00008C3E REC_UBYTE_C 0 COMP_0017 0 255 /end CHARACTERISTIC
/begin CHARACTERISTIC mTRFCD "ROM Const mTRFCD" VALUE 0x00008C3F REC_UBYTE_C 0 COMP_0014 0 2550 /end CHARACTERISTIC
/begin CHARACTERISTIC mTRGENZAN "ROM Const mTRGENZAN" VALUE 0x00008C40 REC_UBYTE_C 0 COMP_0019 0 255 /end CHARACTERISTIC
/begin CHARACTERISTIC mTRIPH1 "ROM Const mTRIPH1" VALUE 0x0000959A REC_UWORD_C 0 COMP_0346 0 6584.364166995 /end CHARACTERISTIC
/begin CHARACTERISTIC mTRIPH2 "ROM Const mTRIPH2" VALUE 0x0000959C REC_UWORD_C 0 COMP_0346 0 6584.364166995 /end CHARACTERISTIC
/begin CHARACTERISTIC mTRKBRA "ROM Const mTRKBRA" VALUE 0x00008C42 REC_UBYTE_C 0 COMP_0049 0 255 /end CHARACTERISTIC
/begin CHARACTERISTIC mTRQ4LMT "ROM Const mTRQ4LMT" VALUE 0x00008EB6 REC_SWORD_C 0 COMP_0228 -3276.8 3276.7 /end CHARACTERISTIC
/begin CHARACTERISTIC mTRQ4REC "ROM Const mTRQ4REC" VALUE 0x0000959E REC_UWORD_C 0 COMP_0038_S 0 6553.5 /end CHARACTERISTIC
/begin CHARACTERISTIC mTRQ4RECF "ROM Const mTRQ4RECF" VALUE 0x000095A0 REC_UWORD_C 0 COMP_0038_S 0 6553.5 /end CHARACTERISTIC
/begin CHARACTERISTIC mTRQDIGRC "ROM Const mTRQDIGRC" VALUE 0x000095A2 REC_UWORD_C 0 COMP_0038_S 0 6553.5 /end CHARACTERISTIC
/begin CHARACTERISTIC mTRQFUL "ROM Const mTRQFUL" VALUE 0x00008EB8 REC_SWORD_C 0 COMP_0228 -3276.8 3276.7 /end CHARACTERISTIC
/begin CHARACTERISTIC mTRQLT1 "ROM Const mTRQLT1" VALUE 0x00008EBA REC_SWORD_C 0 COMP_0228 -3276.8 3276.7 /end CHARACTERISTIC
/begin CHARACTERISTIC mTRQLT2 "ROM Const mTRQLT2" VALUE 0x00008EBC REC_SWORD_C 0 COMP_0228 -3276.8 3276.7 /end CHARACTERISTIC
/begin CHARACTERISTIC mTRQLT3 "ROM Const mTRQLT3" VALUE 0x00008EBE REC_SWORD_C 0 COMP_0228 -3276.8 3276.7 /end CHARACTERISTIC
/begin CHARACTERISTIC mTRQLT4 "ROM Const mTRQLT4" VALUE 0x00008EC0 REC_SWORD_C 0 COMP_0228 -3276.8 3276.7 /end CHARACTERISTIC
/begin CHARACTERISTIC mTRQLTA "ROM Const mTRQLTA" VALUE 0x00008EC2 REC_SWORD_C 0 COMP_0228 -3276.8 3276.7 /end CHARACTERISTIC
/begin CHARACTERISTIC mTRQLTND "ROM Const mTRQLTND" VALUE 0x00008EC4 REC_SWORD_C 0 COMP_0228 -3276.8 3276.7 /end CHARACTERISTIC
/begin CHARACTERISTIC mTRQVBI1 "ROM Const mTRQVBI1" VALUE 0x00008C43 REC_UBYTE_C 0 COMP_0263_S 0 102 /end CHARACTERISTIC
/begin CHARACTERISTIC mTRQVBI2 "ROM Const mTRQVBI2" VALUE 0x00008C44 REC_UBYTE_C 0 COMP_0263_S 0 102 /end CHARACTERISTIC
/begin CHARACTERISTIC mTRQVBLLM "ROM Const mTRQVBLLM" VALUE 0x00008C45 REC_UBYTE_C 0 COMP_0033 0 20400 /end CHARACTERISTIC
/begin CHARACTERISTIC mTRREC1 "ROM Const mTRREC1" VALUE 0x000095A4 REC_UWORD_C 0 COMP_0038_S 0 6553.5 /end CHARACTERISTIC
/begin CHARACTERISTIC mTRREC2 "ROM Const mTRREC2" VALUE 0x000095A6 REC_UWORD_C 0 COMP_0038_S 0 6553.5 /end CHARACTERISTIC
/begin CHARACTERISTIC mTRRECND "ROM Const mTRRECND" VALUE 0x000095A8 REC_UWORD_C 0 COMP_0193 0 6553.5 /end CHARACTERISTIC
/begin CHARACTERISTIC mTRSDLY "ROM Const mTRSDLY" VALUE 0x00008C46 REC_UBYTE_C 0 COMP_0295 0 25500 /end CHARACTERISTIC
/begin CHARACTERISTIC mTRTBPA "ROM Const mTRTBPA" VALUE 0x00008C47 REC_UBYTE_C 0 COMP_0264_S 0 0.099609375 /end CHARACTERISTIC
/begin CHARACTERISTIC mTRTBPB "ROM Const mTRTBPB" VALUE 0x000095AA REC_UWORD_C 0 COMP_0120_S 0 16383.75 /end CHARACTERISTIC
/begin CHARACTERISTIC mTSHOS "ROM Const mTSHOS" VALUE 0x000095AC REC_UWORD_C 0 COMP_0320 0 104856 /end CHARACTERISTIC
/begin CHARACTERISTIC mTSLEARGN "ROM Const mTSLEARGN" VALUE 0x00008C48 REC_UBYTE_C 0 COMP_0265_S 0 1.275 /end CHARACTERISTIC
/begin CHARACTERISTIC mTSNDTM "ROM Const mTSNDTM" VALUE 0x00008C49 REC_UBYTE_C 0 COMP_0015_S 0 25.5 /end CHARACTERISTIC
/begin CHARACTERISTIC mTSOFTG "ROM Const mTSOFTG" VALUE 0x00008C4A REC_UBYTE_C 0 COMP_0040_S 0 2.55 /end CHARACTERISTIC
/begin CHARACTERISTIC mTSOFTK "ROM Const mTSOFTK" VALUE 0x00008C4B REC_UBYTE_C 0 COMP_0040_S 0 2.55 /end CHARACTERISTIC
/begin CHARACTERISTIC mTSPCNSTI "ROM Const mTSPCNSTI" VALUE 0x00008C4C REC_UBYTE_C 0 COMP_0040_S 0 2.55 /end CHARACTERISTIC
/begin CHARACTERISTIC mTSQCNSTI "ROM Const mTSQCNSTI" VALUE 0x00008C4D REC_UBYTE_C 0 COMP_0040_S 0 2.55 /end CHARACTERISTIC
/begin CHARACTERISTIC mTSTOP "ROM Const mTSTOP" VALUE 0x00008C4E REC_UBYTE_C 0 COMP_0008 0 25500 /end CHARACTERISTIC
/begin CHARACTERISTIC mTSYSCHK "ROM Const mTSYSCHK" VALUE 0x00008C4F REC_UBYTE_C 0 COMP_0013 0 255 /end CHARACTERISTIC
/begin CHARACTERISTIC mTTCVCRI "ROM Const mTTCVCRI" VALUE 0x00008C50 REC_UBYTE_C 0 COMP_0014 0 2550 /end CHARACTERISTIC
/begin CHARACTERISTIC mTTERL0L "ROM Const mTTERL0L" VALUE 0x00008EC6 REC_SWORD_C 0 COMP_0228 -3276.8 3276.7 /end CHARACTERISTIC
/begin CHARACTERISTIC mTTPSSTHY "ROM Const mTTPSSTHY" VALUE 0x000095AE REC_UWORD_C 0 COMP_0144 0 31.999495335 /end CHARACTERISTIC
/begin CHARACTERISTIC mTTRIP1 "ROM Const mTTRIP1" VALUE 0x00008C51 REC_UBYTE_C 0 COMP_0049 0 255 /end CHARACTERISTIC
/begin CHARACTERISTIC mTTRIP2 "ROM Const mTTRIP2" VALUE 0x00008C52 REC_UBYTE_C 0 COMP_0049 0 255 /end CHARACTERISTIC
/begin CHARACTERISTIC mTTRIP3 "ROM Const mTTRIP3" VALUE 0x00008C53 REC_UBYTE_C 0 COMP_0049 0 255 /end CHARACTERISTIC
/begin CHARACTERISTIC mTTWINTF "ROM Const mTTWINTF" VALUE 0x00008C54 REC_UBYTE_C 0 COMP_0013 0 255 /end CHARACTERISTIC
/begin CHARACTERISTIC mTTXMAX "ROM Const mTTXMAX" VALUE 0x00008C55 REC_UBYTE_C 0 COMP_0014 0 2550 /end CHARACTERISTIC
/begin CHARACTERISTIC mTUDGNQH0 "ROM Const mTUDGNQH0" VALUE 0x000095B0 REC_UWORD_C 0 COMP_0448 0 399.9941832 /end CHARACTERISTIC
/begin CHARACTERISTIC mTUDGNT "ROM Const mTUDGNT" VALUE 0x00008C56 REC_UBYTE_C 0 COMP_0008 0 25500 /end CHARACTERISTIC
/begin CHARACTERISTIC mTURPMLIM "ROM Const mTURPMLIM" VALUE 0x00008C57 REC_UBYTE_C 0 COMP_0000 0 6375 /end CHARACTERISTIC
/begin CHARACTERISTIC mTVADMX_S "ROM Const mTVADMX_S" VALUE 0x000157DC REC_SWORD_C 0 COMP_0266_S -26.2144 26.2136 /end CHARACTERISTIC
/begin CHARACTERISTIC mTVBMAX "ROM Const mTVBMAX" VALUE 0x00008C58 REC_UBYTE_C 0 COMP_0008 0 25500 /end CHARACTERISTIC
/begin CHARACTERISTIC mTVCUTD "ROM Const mTVCUTD" VALUE 0x00008C59 REC_UBYTE_C 0 COMP_0049 0 255 /end CHARACTERISTIC
/begin CHARACTERISTIC mTVFQBMN "ROM Const mTVFQBMN" VALUE 0x00008247 REC_SBYTE_C 0 COMP_0266_S -0.1024 0.1016 /end CHARACTERISTIC
/begin CHARACTERISTIC mTVFQDTQ "ROM Const mTVFQDTQ" VALUE 0x00008C5A REC_UBYTE_C 0 COMP_0008 0 25500 /end CHARACTERISTIC
/begin CHARACTERISTIC mTVFQDVB "ROM Const mTVFQDVB" VALUE 0x00008C5B REC_UBYTE_C 0 COMP_0041 0 0.204 /end CHARACTERISTIC
/begin CHARACTERISTIC mTVFQDVQ "ROM Const mTVFQDVQ" VALUE 0x00008C5C REC_UBYTE_C 0 COMP_0041 0 0.204 /end CHARACTERISTIC
/begin CHARACTERISTIC mTVFQQMN "ROM Const mTVFQQMN" VALUE 0x00008248 REC_SBYTE_C 0 COMP_0266_S -0.1024 0.1016 /end CHARACTERISTIC
/begin CHARACTERISTIC mTVFUEL "ROM Const mTVFUEL" VALUE 0x00008C5D REC_UBYTE_C 0 COMP_0014 0 2550 /end CHARACTERISTIC
/begin CHARACTERISTIC mTVGUSED "ROM Const mTVGUSED" VALUE 0x00008C5E REC_UBYTE_C 0 COMP_0008 0 25500 /end CHARACTERISTIC
/begin CHARACTERISTIC mTVHADS "ROM Const mTVHADS" VALUE 0x00008C5F REC_UBYTE_C 0 COMP_0002 0 89.25 /end CHARACTERISTIC
/begin CHARACTERISTIC mTVINTS "ROM Const mTVINTS" VALUE 0x000095B2 REC_UWORD_C 0 COMP_0061 0 327675 /end CHARACTERISTIC
/begin CHARACTERISTIC mTVLLMT "ROM Const mTVLLMT" VALUE 0x000095B4 REC_UWORD_C 0 COMP_0130 0 1802.2125 /end CHARACTERISTIC
/begin CHARACTERISTIC mTVLLMT_S "ROM Const mTVLLMT_S" VALUE 0x00015A20 REC_UWORD_C 0 COMP_0130 0 1802.2125 /end CHARACTERISTIC
/begin CHARACTERISTIC mTVOADJMX "ROM Const mTVOADJMX" VALUE 0x00008EC8 REC_SWORD_C 0 COMP_0266_S -26.2144 26.2136 /end CHARACTERISTIC
/begin CHARACTERISTIC mTVOADV "ROM Const mTVOADV" VALUE 0x00008C60 REC_UBYTE_C 0 COMP_0002 0 89.25 /end CHARACTERISTIC
/begin CHARACTERISTIC mTVODEFO "ROM Const mTVODEFO" VALUE 0x00008C61 REC_UBYTE_C 0 COMP_0005 0 28.05 /end CHARACTERISTIC
/begin CHARACTERISTIC mTVODENST "ROM Const mTVODENST" VALUE 0x00008C62 REC_UBYTE_C 0 COMP_0005 0 28.05 /end CHARACTERISTIC
/begin CHARACTERISTIC mTVOFT "ROM Const mTVOFT" VALUE 0x00008C63 REC_UBYTE_C 0 COMP_0023 0 1275 /end CHARACTERISTIC
/begin CHARACTERISTIC mTVOLMN "ROM Const mTVOLMN" VALUE 0x000095B6 REC_UWORD_C 0 COMP_0005 0 7208.85 /end CHARACTERISTIC
/begin CHARACTERISTIC mTVOLMN_S "ROM Const mTVOLMN_S" VALUE 0x00015A22 REC_UWORD_C 0 COMP_0005 0 7208.85 /end CHARACTERISTIC
/begin CHARACTERISTIC mTVOLMX "ROM Const mTVOLMX" VALUE 0x000095B8 REC_UWORD_C 0 COMP_0005 0 7208.85 /end CHARACTERISTIC
/begin CHARACTERISTIC mTVOLMX_S "ROM Const mTVOLMX_S" VALUE 0x00015A24 REC_UWORD_C 0 COMP_0005 0 7208.85 /end CHARACTERISTIC
/begin CHARACTERISTIC mTVOLRNMN "ROM Const mTVOLRNMN" VALUE 0x00008249 REC_SBYTE_C 0 COMP_0267_S -1.6384 1.6256 /end CHARACTERISTIC
/begin CHARACTERISTIC mTVOLRNMX "ROM Const mTVOLRNMX" VALUE 0x0000824A REC_SBYTE_C 0 COMP_0267_S -1.6384 1.6256 /end CHARACTERISTIC
/begin CHARACTERISTIC mTVOQHYS "ROM Const mTVOQHYS" VALUE 0x000095BA REC_UWORD_C 0 COMP_0410 0 99.9985458 /end CHARACTERISTIC
/begin CHARACTERISTIC mTVOQLSMN "ROM Const mTVOQLSMN" VALUE 0x0000824B REC_SBYTE_C 0 COMP_0267_S -1.6384 1.6256 /end CHARACTERISTIC
/begin CHARACTERISTIC mTVOQLSMX "ROM Const mTVOQLSMX" VALUE 0x0000824C REC_SBYTE_C 0 COMP_0267_S -1.6384 1.6256 /end CHARACTERISTIC
/begin CHARACTERISTIC mTVPCHK "ROM Const mTVPCHK" VALUE 0x00008C64 REC_UBYTE_C 0 COMP_0013 0 255 /end CHARACTERISTIC
/begin CHARACTERISTIC mTVPRZ "ROM Const mTVPRZ" VALUE 0x00008C65 REC_UBYTE_C 0 COMP_0062 0 1020 /end CHARACTERISTIC
/begin CHARACTERISTIC mTVSPNG "ROM Const mTVSPNG" VALUE 0x00008C66 REC_UBYTE_C 0 COMP_0008 0 25500 /end CHARACTERISTIC
/begin CHARACTERISTIC mTVTBROF "ROM Const mTVTBROF" VALUE 0x00008C67 REC_UBYTE_C 0 COMP_0015_S 0 25.5 /end CHARACTERISTIC
/begin CHARACTERISTIC mTVTERDB "ROM Const mTVTERDB" VALUE 0x00008C68 REC_UBYTE_C 0 COMP_0014 0 2550 /end CHARACTERISTIC
/begin CHARACTERISTIC mTWACH "ROM Const mTWACH" VALUE 0x00008C69 REC_UBYTE_C 0 COMP_0035 -50 205 /end CHARACTERISTIC
/begin CHARACTERISTIC mTWACL "ROM Const mTWACL" VALUE 0x00008C6A REC_UBYTE_C 0 COMP_0035 -50 205 /end CHARACTERISTIC
/begin CHARACTERISTIC mTWACPS "ROM Const mTWACPS" VALUE 0x00008C6B REC_UBYTE_C 0 COMP_0035 -50 205 /end CHARACTERISTIC
/begin CHARACTERISTIC mTWACRH "ROM Const mTWACRH" VALUE 0x00008C6C REC_UBYTE_C 0 COMP_0035 -50 205 /end CHARACTERISTIC
/begin CHARACTERISTIC mTWACRL "ROM Const mTWACRL" VALUE 0x00008C6D REC_UBYTE_C 0 COMP_0035 -50 205 /end CHARACTERISTIC
/begin CHARACTERISTIC mTWADJH "ROM Const mTWADJH" VALUE 0x00008C6E REC_UBYTE_C 0 COMP_0035 -50 205 /end CHARACTERISTIC
/begin CHARACTERISTIC mTWADJL "ROM Const mTWADJL" VALUE 0x00008C6F REC_UBYTE_C 0 COMP_0035 -50 205 /end CHARACTERISTIC
/begin CHARACTERISTIC mTWADT1 "ROM Const mTWADT1" VALUE 0x00008C70 REC_UBYTE_C 0 COMP_0003 0 255 /end CHARACTERISTIC
/begin CHARACTERISTIC mTWAFH "ROM Const mTWAFH" VALUE 0x00008C71 REC_UBYTE_C 0 COMP_0035 -50 205 /end CHARACTERISTIC
/begin CHARACTERISTIC mTWAFHZH "ROM Const mTWAFHZH" VALUE 0x00008C72 REC_UBYTE_C 0 COMP_0035 -50 205 /end CHARACTERISTIC
/begin CHARACTERISTIC mTWAFHZL "ROM Const mTWAFHZL" VALUE 0x00008C73 REC_UBYTE_C 0 COMP_0035 -50 205 /end CHARACTERISTIC
/begin CHARACTERISTIC mTWAFL "ROM Const mTWAFL" VALUE 0x00008C74 REC_UBYTE_C 0 COMP_0035 -50 205 /end CHARACTERISTIC
/begin CHARACTERISTIC mTWAOFS "ROM Const mTWAOFS" VALUE 0x00008C75 REC_UBYTE_C 0 COMP_0003 0 255 /end CHARACTERISTIC
/begin CHARACTERISTIC mTWASCHYS "ROM Const mTWASCHYS" VALUE 0x00008C76 REC_UBYTE_C 0 COMP_0003 0 255 /end CHARACTERISTIC
/begin CHARACTERISTIC mTWASCOFF "ROM Const mTWASCOFF" VALUE 0x00008C77 REC_UBYTE_C 0 COMP_0035 -50 205 /end CHARACTERISTIC
/begin CHARACTERISTIC mTWAVTF "ROM Const mTWAVTF" VALUE 0x00008C78 REC_UBYTE_C 0 COMP_0035 -50 205 /end CHARACTERISTIC
/begin CHARACTERISTIC mTWCJ2 "ROM Const mTWCJ2" VALUE 0x00008C79 REC_UBYTE_C 0 COMP_0035 -50 205 /end CHARACTERISTIC
/begin CHARACTERISTIC mTWCJ4 "ROM Const mTWCJ4" VALUE 0x00008C7A REC_UBYTE_C 0 COMP_0035 -50 205 /end CHARACTERISTIC
/begin CHARACTERISTIC mTWCLMP "ROM Const mTWCLMP" VALUE 0x00008C7B REC_UBYTE_C 0 COMP_0035 -50 205 /end CHARACTERISTIC
/begin CHARACTERISTIC mTWCMTI "ROM Const mTWCMTI" VALUE 0x00008C7C REC_UBYTE_C 0 COMP_0035 -50 205 /end CHARACTERISTIC
/* COMPU_METHOD --------------------------------------------------------- */
/begin COMPU_METHOD COMP_0017 "1deg" RAT_FUNC "%8.2" "deg" COEFFS 0 1 0 0 0 1 /end COMPU_METHOD
/begin COMPU_METHOD COMP_0004 "1－" RAT_FUNC "%8.2" "－" COEFFS 0 1 0 0 0 1 /end COMPU_METHOD
/begin COMPU_METHOD COMP_0068 "1-" RAT_FUNC "%8.2" "-" COEFFS 0 1 0 0 0 1 /end COMPU_METHOD
/begin COMPU_METHOD COMP_0001_S "1Pa" RAT_FUNC "%8.2" "Pa" COEFFS 0 1 0 0 0 1 /end COMPU_METHOD
/begin COMPU_METHOD COMP_0002_S "1Pa" RAT_FUNC "%8.2" "Pa" COEFFS 0 1 0 0 0 1 /end COMPU_METHOD
/begin COMPU_METHOD COMP_0003_S "0.2℃" RAT_FUNC "%8.2" "℃" COEFFS 0 1 0 0 0 0.2 /end COMPU_METHOD
/begin COMPU_METHOD COMP_0013 "1s" RAT_FUNC "%8.2" "s" COEFFS 0 1 0 0 0 1 /end COMPU_METHOD
/begin COMPU_METHOD COMP_0014 "10ms" RAT_FUNC "%8.2" "ms" COEFFS 0 1 0 0 0 10 /end COMPU_METHOD
/begin COMPU_METHOD COMP_0045 "1/128-" RAT_FUNC "%8.4" "-" COEFFS 0 1 0 0 0 0.0078125 /end COMPU_METHOD
/begin COMPU_METHOD COMP_0009 "100/128%" RAT_FUNC "%8.2" "%" COEFFS 0 1 0 0 0 0.78125 /end COMPU_METHOD
/begin COMPU_METHOD COMP_0000 "25rpm" RAT_FUNC "%8.2" "rpm" COEFFS 0 1 0 0 0 25 /end COMPU_METHOD
/begin COMPU_METHOD COMP_0186 "1/64-" RAT_FUNC "%8.3" "-" COEFFS 0 1 0 0 0 0.015625 /end COMPU_METHOD
/begin COMPU_METHOD COMP_0001 "1/8ms" RAT_FUNC "%8.2" "ms" COEFFS 0 1 0 0 0 0.125 /end COMPU_METHOD
/begin COMPU_METHOD COMP_0020 "50rpm" RAT_FUNC "%8.2" "rpm" COEFFS 0 1 0 0 0 50 /end COMPU_METHOD
/begin COMPU_METHOD COMP_0004_S "X-50degC" RAT_FUNC "%8.2" "degC" COEFFS 0 1 50 0 0 1 /end COMPU_METHOD
/begin COMPU_METHOD COMP_0005_S "0.0001-" RAT_FUNC "%8.5" "-" COEFFS 0 1 0 0 0 0.0001 /end COMPU_METHOD
/begin COMPU_METHOD COMP_0388 "0.1-" RAT_FUNC "%8.2" "-" COEFFS 0 1 0 0 0 0.1 /end COMPU_METHOD
/begin COMPU_METHOD COMP_0373 "1/100-" RAT_FUNC "%8.3" "-" COEFFS 0 1 0 0 0 0.01 /end COMPU_METHOD
/begin COMPU_METHOD COMP_0002 "0.35deg" RAT_FUNC "%8.2" "deg" COEFFS 0 1 0 0 0 0.35 /end COMPU_METHOD
/begin COMPU_METHOD COMP_0003 "1℃" RAT_FUNC "%8.2" "℃" COEFFS 0 1 0 0 0 1 /end COMPU_METHOD
/begin COMPU_METHOD COMP_0035 "X-50℃" RAT_FUNC "%8.2" "℃" COEFFS 0 1 50 0 0 1 /end COMPU_METHOD
/begin COMPU_METHOD COMP_0453 "0.002-" RAT_FUNC "%8.4" "-" COEFFS 0 1 0 0 0 0.002 /end COMPU_METHOD
/begin COMPU_METHOD COMP_0006_S "2^-22m/ss" RAT_FUNC "%8.6" "m/ss" COEFFS 0 1 0 0 0 0.000000238419 /end COMPU_METHOD
/begin COMPU_METHOD COMP_0005 "0.11deg" RAT_FUNC "%8.2" "deg" COEFFS 0 1 0 0 0 0.11 /end COMPU_METHOD
/begin COMPU_METHOD COMP_0006 "12.5rpm" RAT_FUNC "%8.2" "rpm" COEFFS 0 1 0 0 0 12.5 /end COMPU_METHOD
/begin COMPU_METHOD COMP_0008 "100ms" RAT_FUNC "%8.2" "ms" COEFFS 0 1 0 0 0 100 /end COMPU_METHOD
/begin COMPU_METHOD COMP_0010 "0.003MPa" RAT_FUNC "%8.4" "MPa" COEFFS 0 1 0 0 0 0.003 /end COMPU_METHOD
/begin COMPU_METHOD COMP_0011 "0.02MPa" RAT_FUNC "%8.3" "MPa" COEFFS 0 1 0 0 0 0.02 /end COMPU_METHOD
/begin COMPU_METHOD COMP_0010_S "0.0001ｋｊ/100" RAT_FUNC "%8.5" "ｋｊ/100" COEFFS 0 1 0 0 0 0.0001 /end COMPU_METHOD
/begin COMPU_METHOD COMP_0007 "2km/h" RAT_FUNC "%8.2" "km/h" COEFFS 0 1 0 0 0 2 /end COMPU_METHOD
/begin COMPU_METHOD COMP_0047 "0.5%" RAT_FUNC "%8.2" "%" COEFFS 0 1 0 0 0 0.5 /end COMPU_METHOD
/begin COMPU_METHOD COMP_0163 "1/16%" RAT_FUNC "%8.3" "%" COEFFS 0 1 0 0 0 0.0625 /end COMPU_METHOD
/begin COMPU_METHOD COMP_0018 "1deg" RAT_FUNC "%8.2" "deg" COEFFS 0 1 0 0 0 1 /end COMPU_METHOD
/begin COMPU_METHOD COMP_0019 "1degCA" RAT_FUNC "%8.2" "degCA" COEFFS 0 1 0 0 0 1 /end COMPU_METHOD
/begin COMPU_METHOD COMP_0081 "1/256deg" RAT_FUNC "%8.4" "deg" COEFFS 0 1 0 0 0 0.00390625 /end COMPU_METHOD
/begin COMPU_METHOD COMP_0217 "1/16384-" RAT_FUNC "%8.6" "-" COEFFS 0 1 0 0 0 0.0000610352 /end COMPU_METHOD
/begin COMPU_METHOD COMP_0023 "5mV" RAT_FUNC "%8.2" "mV" COEFFS 0 1 0 0 0 5 /end COMPU_METHOD
/begin COMPU_METHOD COMP_0250 "4ms" RAT_FUNC "%8.2" "ms" COEFFS 0 1 0 0 0 4 /end COMPU_METHOD
/begin COMPU_METHOD COMP_0033 "80mV" RAT_FUNC "%8.2" "mV" COEFFS 0 1 0 0 0 80 /end COMPU_METHOD
/begin COMPU_METHOD COMP_0027 "1%" RAT_FUNC "%8.2" "%" COEFFS 0 1 0 0 0 1 /end COMPU_METHOD
/begin COMPU_METHOD COMP_0015_S "0.1sec" RAT_FUNC "%8.2" "sec" COEFFS 0 1 0 0 0 0.1 /end COMPU_METHOD
/begin COMPU_METHOD COMP_0017_S "0.01sec" RAT_FUNC "%8.3" "sec" COEFFS 0 1 0 0 0 0.01 /end COMPU_METHOD
/begin COMPU_METHOD COMP_0061 "5mv" RAT_FUNC "%8.2" "mv" COEFFS 0 1 0 0 0 5 /end COMPU_METHOD
/begin COMPU_METHOD COMP_0049 "1sec" RAT_FUNC "%8.2" "sec" COEFFS 0 1 0 0 0 1 /end COMPU_METHOD
/begin COMPU_METHOD COMP_0032 "1/256－" RAT_FUNC "%8.4" "－" COEFFS 0 1 0 0 0 0.00390625 /end COMPU_METHOD
/begin COMPU_METHOD COMP_0066 "1/64－" RAT_FUNC "%8.3" "－" COEFFS 0 1 0 0 0 0.015625 /end COMPU_METHOD
/begin COMPU_METHOD COMP_0063 "1/256-" RAT_FUNC "%8.4" "-" COEFFS 0 1 0 0 0 0.00390625 /end COMPU_METHOD
/begin COMPU_METHOD COMP_0030 "1回" RAT_FUNC "%8.2" "回" COEFFS 0 1 0 0 0 1 /end COMPU_METHOD
/begin COMPU_METHOD COMP_0022_S "0.02－" RAT_FUNC "%8.3" "－" COEFFS 0 1 0 0 0 0.02 /end COMPU_METHOD
/begin COMPU_METHOD COMP_0016 "1count" RAT_FUNC "%8.2" "count" COEFFS 0 1 0 0 0 1 /end COMPU_METHOD
/begin COMPU_METHOD COMP_0202 "10msec" RAT_FUNC "%8.2" "msec" COEFFS 0 1 0 0 0 10 /end COMPU_METHOD
/begin COMPU_METHOD COMP_0443 "1rpm" RAT_FUNC "%8.2" "rpm" COEFFS 0 1 0 0 0 1 /end COMPU_METHOD
/begin COMPU_METHOD COMP_0228 "0.1Nm" RAT_FUNC "%8.2" "Nm" COEFFS 0 1 0 0 0 0.1 /end COMPU_METHOD
/begin COMPU_METHOD COMP_0436 "0.1km/h" RAT_FUNC "%8.2" "km/h" COEFFS 0 1 0 0 0 0.1 /end COMPU_METHOD
/begin COMPU_METHOD COMP_0263 "1-" RAT_FUNC "%8.2" "-" COEFFS 0 1 0 0 0 1 /end COMPU_METHOD
/begin COMPU_METHOD COMP_0256 "64/128degCA" RAT_FUNC "%8.2" "degCA" COEFFS 0 1 64 0 0 0.5 /end COMPU_METHOD
/begin COMPU_METHOD COMP_0065 "3.125rpm" RAT_FUNC "%8.2" "rpm" COEFFS 0 1 0 0 0 3.125 /end COMPU_METHOD
/begin COMPU_METHOD COMP_0048 "64/128degCA" RAT_FUNC "%8.2" "degCA" COEFFS 0 1 0 0 0 0.5 /end COMPU_METHOD
/begin COMPU_METHOD COMP_0031_S "0.00061MPa" RAT_FUNC "%8.5" "MPa" COEFFS 0 1 0 0 0 0.00061 /end COMPU_METHOD
/begin COMPU_METHOD COMP_0032_S "0.125%" RAT_FUNC "%8.2" "%" COEFFS 0 1 0 0 0 0.125 /end COMPU_METHOD
/begin COMPU_METHOD COMP_0220 "1l/min" RAT_FUNC "%8.2" "l/min" COEFFS 0 1 0 0 0 1 /end COMPU_METHOD
/begin COMPU_METHOD COMP_0038_S "0.1Nm/100ms" RAT_FUNC "%8.2" "Nm/100ms" COEFFS 0 1 0 0 0 0.1 /end COMPU_METHOD
/begin COMPU_METHOD COMP_0040_S "0.01s" RAT_FUNC "%8.3" "s" COEFFS 0 1 0 0 0 0.01 /end COMPU_METHOD
/begin COMPU_METHOD COMP_0041 "0.0008cm^2" RAT_FUNC "%8.5" "cm^2" COEFFS 0 1 0 0 0 0.0008 /end COMPU_METHOD
/begin COMPU_METHOD COMP_0044 "1/128－" RAT_FUNC "%8.4" "－" COEFFS 0 1 0 0 0 0.0078125 /end COMPU_METHOD
/begin COMPU_METHOD COMP_0048_S "2^-3deg" RAT_FUNC "%8.2" "deg" COEFFS 0 1 0 0 0 0.125 /end COMPU_METHOD
/begin COMPU_METHOD COMP_0054 "20mV" RAT_FUNC "%8.2" "mV" COEFFS 0 1 0 0 0 20 /end COMPU_METHOD
/begin COMPU_METHOD COMP_0052_S "0.125%/10ms" RAT_FUNC "%8.2" "%/10ms" COEFFS 0 1 0 0 0 0.125 /end COMPU_METHOD
/begin COMPU_METHOD COMP_0450 "1/1024-" RAT_FUNC "%8.5" "-" COEFFS 0 1 0 0 0 0.000976563 /end COMPU_METHOD
/begin COMPU_METHOD COMP_0054_S "4/256deg/oct" RAT_FUNC "%8.3" "deg/oct" COEFFS 0 1 0 0 0 0.015625 /end COMPU_METHOD
/begin COMPU_METHOD COMP_0419 "0.1%" RAT_FUNC "%8.2" "%" COEFFS 0 1 0 0 0 0.1 /end COMPU_METHOD
/begin COMPU_METHOD COMP_0057_S "0.1deg" RAT_FUNC "%8.2" "deg" COEFFS 0 1 0 0 0 0.1 /end COMPU_METHOD
/begin COMPU_METHOD COMP_0105 "0.1s" RAT_FUNC "%8.2" "s" COEFFS 0 1 0 0 0 0.1 /end COMPU_METHOD
/begin COMPU_METHOD COMP_0290 "1/65536-" RAT_FUNC "%8.6" "-" COEFFS 0 1 0 0 0 0.0000152588 /end COMPU_METHOD
/begin COMPU_METHOD COMP_0071 "1rev" RAT_FUNC "%8.2" "rev" COEFFS 0 1 0 0 0 1 /end COMPU_METHOD
/begin COMPU_METHOD COMP_0144 "1/2048ms" RAT_FUNC "%8.5" "ms" COEFFS 0 1 0 0 0 0.000488281 /end COMPU_METHOD
/begin COMPU_METHOD COMP_0062_S "1ms/2^(ST" RAT_FUNC "%8.2" "ms/2^(ST" COEFFS 0 1 0 0 0 1 /end COMPU_METHOD
/begin COMPU_METHOD COMP_0065_S "1/64kPa" RAT_FUNC "%8.3" "kPa" COEFFS 0 1 0 0 0 0.015625 /end COMPU_METHOD
/begin COMPU_METHOD COMP_0287 "1REF" RAT_FUNC "%8.2" "REF" COEFFS 0 1 0 0 0 1 /end COMPU_METHOD
/begin COMPU_METHOD COMP_0021 "100/256%" RAT_FUNC "%8.2" "%" COEFFS 0 1 0 0 0 0.390625 /end COMPU_METHOD
/begin COMPU_METHOD COMP_0078 "1/256deg" RAT_FUNC "%8.4" "deg" COEFFS 0 1 0 0 0 0.00390625 /end COMPU_METHOD
/begin COMPU_METHOD COMP_0078_S "1/256L" RAT_FUNC "%8.4" "L" COEFFS 0 1 0 0 0 0.00390625 /end COMPU_METHOD
/begin COMPU_METHOD COMP_0095 "400/256%" RAT_FUNC "%8.2" "%" COEFFS 0 1 0 0 0 1.5625 /end COMPU_METHOD
/begin COMPU_METHOD COMP_0082_S "1rpm/50ms" RAT_FUNC "%8.2" "rpm/50ms" COEFFS 0 1 0 0 0 1 /end COMPU_METHOD
/begin COMPU_METHOD COMP_0096 "10s" RAT_FUNC "%8.2" "s" COEFFS 0 1 0 0 0 10 /end COMPU_METHOD
/begin COMPU_METHOD COMP_0051 "1L/min" RAT_FUNC "%8.2" "L/min" COEFFS 0 1 0 0 0 1 /end COMPU_METHOD
/begin COMPU_METHOD COMP_0087_S "0.07808MPa" RAT_FUNC "%8.3" "MPa" COEFFS 0 1 0 0 0 0.07808 /end COMPU_METHOD
/begin COMPU_METHOD COMP_0092_S "0.025kg/h" RAT_FUNC "%8.3" "kg/h" COEFFS 0 1 0 0 0 0.025 /end COMPU_METHOD
/begin COMPU_METHOD COMP_0156 "1L" RAT_FUNC "%8.2" "L" COEFFS 0 1 0 0 0 1 /end COMPU_METHOD
/begin COMPU_METHOD COMP_0234 "10sec" RAT_FUNC "%8.2" "sec" COEFFS 0 1 0 0 0 10 /end COMPU_METHOD
/begin COMPU_METHOD COMP_0115 "100/65536%" RAT_FUNC "%8.4" "%" COEFFS 0 1 0 0 0 0.0015259 /end COMPU_METHOD
/begin COMPU_METHOD COMP_0050 "5/64mV" RAT_FUNC "%8.3" "mV" COEFFS 0 1 0 0 0 0.078125 /end COMPU_METHOD
/begin COMPU_METHOD COMP_0069 "1/(128*256)－" RAT_FUNC "%8.6" "－" COEFFS 0 1 0 0 0 0.0000305176 /end COMPU_METHOD
/begin COMPU_METHOD COMP_0196 "0.1Nm" RAT_FUNC "%8.2" "Nm" COEFFS 0 1 0 0 0 0.1 /end COMPU_METHOD
/begin COMPU_METHOD COMP_0057 "1/16384－" RAT_FUNC "%8.6" "－" COEFFS 0 1 0 0 0 0.0000610352 /end COMPU_METHOD
/begin COMPU_METHOD COMP_0104 "10mV" RAT_FUNC "%8.2" "mV" COEFFS 0 1 0 0 0 10 /end COMPU_METHOD
/begin COMPU_METHOD COMP_0190 "2deg" RAT_FUNC "%8.2" "deg" COEFFS 0 1 0 0 0 2 /end COMPU_METHOD
/begin COMPU_METHOD COMP_0113_S "0.2℃" RAT_FUNC "%8.2" "℃" COEFFS 0 1 0 0 0 0.2 /end COMPU_METHOD
/begin COMPU_METHOD COMP_0295 "100msec" RAT_FUNC "%8.2" "msec" COEFFS 0 1 0 0 0 100 /end COMPU_METHOD
/begin COMPU_METHOD COMP_0120_S "0.25kPa" RAT_FUNC "%8.2" "kPa" COEFFS 0 1 0 0 0 0.25 /end COMPU_METHOD
/begin COMPU_METHOD COMP_0277 "1L/min" RAT_FUNC "%8.2" "L/min" COEFFS 0 1 0 0 0 1 /end COMPU_METHOD
/begin COMPU_METHOD COMP_0064 "1.5625rpm" RAT_FUNC "%8.2" "rpm" COEFFS 0 1 0 0 0 1.5625 /end COMPU_METHOD
/begin COMPU_METHOD COMP_0164 "0.000305MPa" RAT_FUNC "%8.5" "MPa" COEFFS 0 1 0 0 0 0.000305 /end COMPU_METHOD
/begin COMPU_METHOD COMP_0123_S "1/512kPa" RAT_FUNC "%8.4" "kPa" COEFFS 0 1 0 0 0 0.001953125 /end COMPU_METHOD
/begin COMPU_METHOD COMP_0312 "0.5/256L" RAT_FUNC "%8.4" "L" COEFFS 0 1 0 0 0 0.001953125 /end COMPU_METHOD
/begin COMPU_METHOD COMP_0146 "100/256/256%" RAT_FUNC "%8.4" "%" COEFFS 0 1 0 0 0 0.001525879 /end COMPU_METHOD
/begin COMPU_METHOD COMP_0130_S "0.001G" RAT_FUNC "%8.4" "G" COEFFS 0 1 0 0 0 0.001 /end COMPU_METHOD
/begin COMPU_METHOD COMP_0131_S "0.5Nm" RAT_FUNC "%8.2" "Nm" COEFFS 0 1 0 0 0 0.5 /end COMPU_METHOD
/begin COMPU_METHOD COMP_0139_S "1/16Ω" RAT_FUNC "%8.3" "Ω" COEFFS 0 1 0 0 0 0.0625 /end COMPU_METHOD
/begin COMPU_METHOD COMP_0144_S "3.6_*_2^-22km/h" RAT_FUNC "%8.6" "km/h" COEFFS 0 1 0 0 0 0.000000858307 /end COMPU_METHOD
/begin COMPU_METHOD COMP_0152_S "6.4μs" RAT_FUNC "%8.2" "μs" COEFFS 0 1 0 0 0 6.4 /end COMPU_METHOD
/begin COMPU_METHOD COMP_0125 "1/256ms" RAT_FUNC "%8.4" "ms" COEFFS 0 1 0 0 0 0.00390625 /end COMPU_METHOD
/begin COMPU_METHOD COMP_0160_S "0.1/32%" RAT_FUNC "%8.4" "%" COEFFS 0 1 0 0 0 0.003125 /end COMPU_METHOD
/begin COMPU_METHOD COMP_0162_S "0.78125rpm" RAT_FUNC "%8.2" "rpm" COEFFS 0 1 0 0 0 0.78125 /end COMPU_METHOD
/begin COMPU_METHOD COMP_0189 "3.2μS" RAT_FUNC "%8.2" "μS" COEFFS 0 1 0 0 0 3.2 /end COMPU_METHOD
/begin COMPU_METHOD COMP_0193 "0.1Nm/10ms" RAT_FUNC "%8.2" "Nm/10ms" COEFFS 0 1 0 0 0 0.1 /end COMPU_METHOD
/begin COMPU_METHOD COMP_0447 "100/1024%" RAT_FUNC "%8.3" "%" COEFFS 0 1 0 0 0 0.09765625 /end COMPU_METHOD
/begin COMPU_METHOD COMP_0062 "4℃" RAT_FUNC "%8.2" "℃" COEFFS 0 1 0 0 0 4 /end COMPU_METHOD
/begin COMPU_METHOD COMP_0130 "0.0275deg" RAT_FUNC "%8.3" "deg" COEFFS 0 1 0 0 0 0.0275 /end COMPU_METHOD
/begin COMPU_METHOD COMP_0179_S "0.01%" RAT_FUNC "%8.3" "%" COEFFS 0 1 0 0 0 0.01 /end COMPU_METHOD
/begin COMPU_METHOD COMP_0182_S "0.001-" RAT_FUNC "%8.4" "-" COEFFS 0 1 0 0 0 0.001 /end COMPU_METHOD
/begin COMPU_METHOD COMP_0187_S "10/256%" RAT_FUNC "%8.3" "%" COEFFS 0 1 0 0 0 0.0390625 /end COMPU_METHOD
/begin COMPU_METHOD COMP_0472 "1/64-" RAT_FUNC "%8.3" "-" COEFFS 0 1 0 0 0 0.015625 /end COMPU_METHOD
/begin COMPU_METHOD COMP_0262 "12.5rpm" RAT_FUNC "%8.2" "rpm" COEFFS 0 1 0 0 0 12.5 /end COMPU_METHOD
/begin COMPU_METHOD COMP_0251 "1cyl" RAT_FUNC "%8.2" "cyl" COEFFS 0 1 0 0 0 1 /end COMPU_METHOD
/begin COMPU_METHOD COMP_0200_S "10%" RAT_FUNC "%8.2" "%" COEFFS 0 1 0 0 0 10 /end COMPU_METHOD
/begin COMPU_METHOD COMP_0022 "20mv" RAT_FUNC "%8.2" "mv" COEFFS 0 1 0 0 0 20 /end COMPU_METHOD
/begin COMPU_METHOD COMP_0201_S "0.125oct" RAT_FUNC "%8.2" "oct" COEFFS 0 1 -75 0 0 0.125 /end COMPU_METHOD
/begin COMPU_METHOD COMP_0024 "50ms" RAT_FUNC "%8.2" "ms" COEFFS 0 1 0 0 0 50 /end COMPU_METHOD
/begin COMPU_METHOD COMP_0202_S "1Pa*10ms" RAT_FUNC "%8.2" "Pa*10ms" COEFFS 0 1 0 0 0 1 /end COMPU_METHOD
/begin COMPU_METHOD COMP_0267 "256us" RAT_FUNC "%8.2" "us" COEFFS 0 1 0 0 0 256 /end COMPU_METHOD
/begin COMPU_METHOD COMP_0203_S "0.005V" RAT_FUNC "%8.4" "V" COEFFS 0 1 0 0 0 0.005 /end COMPU_METHOD
/begin COMPU_METHOD COMP_0204_S "100A100ms" RAT_FUNC "%8.2" "A100ms" COEFFS 0 1 0 0 0 100 /end COMPU_METHOD
/begin COMPU_METHOD COMP_0205_S "0.0000002A*sec/de" RAT_FUNC "%8.6" "A*sec/de" COEFFS 0 1 0 0 0 0.0000002 /end COMPU_METHOD
/begin COMPU_METHOD COMP_0206_S "0.1KPa" RAT_FUNC "%8.2" "KPa" COEFFS 0 1 0 0 0 0.1 /end COMPU_METHOD
/begin COMPU_METHOD COMP_0207_S "1/321" RAT_FUNC "%8.3" "1" COEFFS 0 1 0 0 0 0.03125 /end COMPU_METHOD
/begin COMPU_METHOD COMP_0208_S "4KPa" RAT_FUNC "%8.2" "KPa" COEFFS 0 1 0 0 0 4 /end COMPU_METHOD
/begin COMPU_METHOD COMP_0209_S "100/32768%" RAT_FUNC "%8.4" "%" COEFFS 0 1 0 0 0 0.003051757 /end COMPU_METHOD
/begin COMPU_METHOD COMP_0210_S "0.5Nm" RAT_FUNC "%8.2" "Nm" COEFFS 0 1 64 0 0 0.5 /end COMPU_METHOD
/begin COMPU_METHOD COMP_0211_S "1/65536/0.078081/Mpa" RAT_FUNC "%8.5" "1/Mpa" COEFFS 0 1 0 0 0 0.000195425 /end COMPU_METHOD
/begin COMPU_METHOD COMP_0212_S "1/65536/0.078081/_MPa" RAT_FUNC "%8.5" "1/_MPa" COEFFS 0 1 0 0 0 0.000195425 /end COMPU_METHOD
/begin COMPU_METHOD COMP_0213_S "80μs" RAT_FUNC "%8.2" "μs" COEFFS 0 1 0 0 0 80 /end COMPU_METHOD
/begin COMPU_METHOD COMP_0214_S "1E-05-" RAT_FUNC "%8.6" "-" COEFFS 0 1 0 0 0 0.00001 /end COMPU_METHOD
/begin COMPU_METHOD COMP_0215_S "1/512kPa" RAT_FUNC "%8.4" "kPa" COEFFS 0 1 0 0 0 0.00195313 /end COMPU_METHOD
/begin COMPU_METHOD COMP_0272 "1/256*32%" RAT_FUNC "%8.5" "%" COEFFS 0 1 0 0 0 0.00012207 /end COMPU_METHOD
/begin COMPU_METHOD COMP_0216_S "1E-05-" RAT_FUNC "%8.6" "-" COEFFS 0 1 -0.5 0 0 0.00001 /end COMPU_METHOD
/begin COMPU_METHOD COMP_0152 "2L" RAT_FUNC "%8.2" "L" COEFFS 0 1 0 0 0 2 /end COMPU_METHOD
/begin COMPU_METHOD COMP_0217_S "0.1degC/kj" RAT_FUNC "%8.2" "degC/kj" COEFFS 0 1 0 0 0 0.1 /end COMPU_METHOD
/begin COMPU_METHOD COMP_0218_S "1/5120kPa/mV" RAT_FUNC "%8.5" "kPa/mV" COEFFS 0 1 0 0 0 0.000195313 /end COMPU_METHOD
/begin COMPU_METHOD COMP_0219_S "1/65536cm**2/L/" RAT_FUNC "%8.6" "cm**2/L/" COEFFS 0 1 0 0 0 0.0000152588 /end COMPU_METHOD
/begin COMPU_METHOD COMP_0220_S "0.001l/min" RAT_FUNC "%8.4" "l/min" COEFFS 0 1 0 0 0 0.001 /end COMPU_METHOD
/begin COMPU_METHOD COMP_0159 "256－" RAT_FUNC "%8.2" "－" COEFFS 0 1 0 0 0 256 /end COMPU_METHOD
/begin COMPU_METHOD COMP_0052 "1/2048ms" RAT_FUNC "%8.5" "ms" COEFFS 0 1 0 0 0 0.000488282 /end COMPU_METHOD
/begin COMPU_METHOD COMP_0276 "4L/min" RAT_FUNC "%8.2" "L/min" COEFFS 0 1 0 0 0 4 /end COMPU_METHOD
/begin COMPU_METHOD COMP_0278 "2L/min" RAT_FUNC "%8.2" "L/min" COEFFS 0 1 0 0 0 2 /end COMPU_METHOD
/begin COMPU_METHOD COMP_0293 "2L/min" RAT_FUNC "%8.2" "L/min" COEFFS 0 1 0 0 0 2 /end COMPU_METHOD
/begin COMPU_METHOD COMP_0221_S "16-" RAT_FUNC "%8.2" "-" COEFFS 0 1 0 0 0 16 /end COMPU_METHOD
/begin COMPU_METHOD COMP_0222_S "1/512deg/L/mi" RAT_FUNC "%8.4" "deg/L/mi" COEFFS 0 1 0 0 0 0.001953125 /end COMPU_METHOD
/begin COMPU_METHOD COMP_0282 "1*10**-4kg/hr" RAT_FUNC "%8.5" "kg/hr" COEFFS 0 1 0 0 0 0.0001 /end COMPU_METHOD
/begin COMPU_METHOD COMP_0223_S "1/16Ω/100ms" RAT_FUNC "%8.3" "Ω/100ms" COEFFS 0 1 0 0 0 0.0625 /end COMPU_METHOD
/begin COMPU_METHOD COMP_0224_S "2.5sec" RAT_FUNC "%8.2" "sec" COEFFS 0 1 0 0 0 2.5 /end COMPU_METHOD
/begin COMPU_METHOD COMP_0225_S "1/32/1000m^2" RAT_FUNC "%8.6" "m^2" COEFFS 0 1 0 0 0 0.00003125 /end COMPU_METHOD
/begin COMPU_METHOD COMP_0226_S "1000/32N/m" RAT_FUNC "%8.2" "N/m" COEFFS 0 1 0 0 0 31.25 /end COMPU_METHOD
/begin COMPU_METHOD COMP_0227_S "1/32N" RAT_FUNC "%8.3" "N" COEFFS 0 1 0 0 0 0.03125 /end COMPU_METHOD
/begin COMPU_METHOD COMP_0228_S "7.8125mV" RAT_FUNC "%8.2" "mV" COEFFS 0 1 0 0 0 7.8125 /end COMPU_METHOD
/begin COMPU_METHOD COMP_0229_S "1ｶｳﾝﾀ" RAT_FUNC "%8.2" "ｶｳﾝﾀ" COEFFS 0 1 0 0 0 1 /end COMPU_METHOD
/begin COMPU_METHOD COMP_0230_S "0.001Nm/rpm/1" RAT_FUNC "%8.4" "Nm/rpm/1" COEFFS 0 1 0 0 0 0.001 /end COMPU_METHOD
/begin COMPU_METHOD COMP_0231_S "0.001Nm/rpm" RAT_FUNC "%8.4" "Nm/rpm" COEFFS 0 1 0 0 0 0.001 /end COMPU_METHOD
/begin COMPU_METHOD COMP_0232_S "0.78125rpm/100m" RAT_FUNC "%8.2" "rpm/100m" COEFFS 0 1 0 0 0 0.78125 /end COMPU_METHOD
/begin COMPU_METHOD COMP_0233_S "4rpm" RAT_FUNC "%8.2" "rpm" COEFFS 0 1 0 0 0 4 /end COMPU_METHOD
/begin COMPU_METHOD COMP_0234_S "10/256%/100ms" RAT_FUNC "%8.3" "%/100ms" COEFFS 0 1 0 0 0 0.0390625 /end COMPU_METHOD
/begin COMPU_METHOD COMP_0092 "1bit" RAT_FUNC "%8.2" "bit" COEFFS 0 1 0 0 0 1 /end COMPU_METHOD
/begin COMPU_METHOD COMP_0235_S "32/256oct" RAT_FUNC "%8.2" "oct" COEFFS 0 1 0 0 0 0.125 /end COMPU_METHOD
/begin COMPU_METHOD COMP_0285 "0.00001－" RAT_FUNC "%8.6" "－" COEFFS 0 1 0 0 0 0.00001 /end COMPU_METHOD
/begin COMPU_METHOD COMP_0236_S "1/1024-" RAT_FUNC "%8.5" "-" COEFFS 0 1 0 0 0 0.000976562 /end COMPU_METHOD
/begin COMPU_METHOD COMP_0237_S "1/163840m" RAT_FUNC "%8.6" "m" COEFFS 0 1 0 0 0 0.00000610352 /end COMPU_METHOD
/begin COMPU_METHOD COMP_0425 "100/255%" RAT_FUNC "%8.2" "%" COEFFS 0 1 0 0 0 0.392156862 /end COMPU_METHOD
/begin COMPU_METHOD COMP_0289 "100/256%/10ms" RAT_FUNC "%8.2" "%/10ms" COEFFS 0 1 0 0 0 0.390625 /end COMPU_METHOD
/begin COMPU_METHOD COMP_0476 "12.5/64rpm" RAT_FUNC "%8.2" "rpm" COEFFS 0 1 0 0 0 0.1953125 /end COMPU_METHOD
/begin COMPU_METHOD COMP_0195 "0.1Km/h" RAT_FUNC "%8.2" "Km/h" COEFFS 0 1 0 0 0 0.1 /end COMPU_METHOD
/begin COMPU_METHOD COMP_0470 "1km" RAT_FUNC "%8.2" "km" COEFFS 0 1 0 0 0 1 /end COMPU_METHOD
/begin COMPU_METHOD COMP_0238_S "0.01km/h" RAT_FUNC "%8.3" "km/h" COEFFS 0 1 0 0 0 0.01 /end COMPU_METHOD
/begin COMPU_METHOD COMP_0239_S "0.01km/h" RAT_FUNC "%8.3" "km/h" COEFFS 0 1 0 0 0 0.01 /end COMPU_METHOD
/begin COMPU_METHOD COMP_0240_S "0.02Nm" RAT_FUNC "%8.3" "Nm" COEFFS 0 1 0 0 0 0.02 /end COMPU_METHOD
/begin COMPU_METHOD COMP_0241_S "1Nm/km_h/" RAT_FUNC "%8.2" "Nm/km_h/" COEFFS 0 1 0 0 0 1 /end COMPU_METHOD
/begin COMPU_METHOD COMP_0242_S "0.001G" RAT_FUNC "%8.4" "G" COEFFS 0 1 0 0 0 0.001 /end COMPU_METHOD
/begin COMPU_METHOD COMP_0243_S "0.01Km/h/10m" RAT_FUNC "%8.3" "Km/h/10m" COEFFS 0 1 0 0 0 0.01 /end COMPU_METHOD
/begin COMPU_METHOD COMP_0244_S "0.01km/h/50m" RAT_FUNC "%8.3" "km/h/50m" COEFFS 0 1 0 0 0 0.01 /end COMPU_METHOD
/begin COMPU_METHOD COMP_0197 "1/65535－" RAT_FUNC "%8.6" "－" COEFFS 0 1 0 0 0 0.000015259 /end COMPU_METHOD
/begin COMPU_METHOD COMP_0245_S "100/1024%/10ms" RAT_FUNC "%8.3" "%/10ms" COEFFS 0 1 0 0 0 0.09765625 /end COMPU_METHOD
/begin COMPU_METHOD COMP_0246_S "0.01Nm" RAT_FUNC "%8.3" "Nm" COEFFS 0 1 0 0 0 0.01 /end COMPU_METHOD
/begin COMPU_METHOD COMP_0247_S "100/16384%/10ms" RAT_FUNC "%8.4" "%/10ms" COEFFS 0 1 0 0 0 0.006103516 /end COMPU_METHOD
/begin COMPU_METHOD COMP_0248_S "2^-9L" RAT_FUNC "%8.4" "L" COEFFS 0 1 0 0 0 0.00195313 /end COMPU_METHOD
/begin COMPU_METHOD COMP_0291 "0.04*256g℃" RAT_FUNC "%8.2" "g℃" COEFFS 0 1 0 0 0 10.24 /end COMPU_METHOD
/begin COMPU_METHOD COMP_0249_S "0.1A" RAT_FUNC "%8.2" "A" COEFFS 0 1 0 0 0 0.1 /end COMPU_METHOD
/begin COMPU_METHOD COMP_0314 "X-128deg" RAT_FUNC "%8.2" "deg" COEFFS 0 1 128 0 0 1 /end COMPU_METHOD
/begin COMPU_METHOD COMP_0250_S "X-128deg" RAT_FUNC "%8.2" "deg" COEFFS 0 1 128 0 0 1 /end COMPU_METHOD
/begin COMPU_METHOD COMP_0251_S "1/1024RATIO/50" RAT_FUNC "%8.5" "RATIO/50" COEFFS 0 1 0 0 0 0.000976563 /end COMPU_METHOD
/begin COMPU_METHOD COMP_0252_S "1/256*0.5step/(L/" RAT_FUNC "%8.4" "step/(L/" COEFFS 0 1 0 0 0 0.001953125 /end COMPU_METHOD
/begin COMPU_METHOD COMP_0253_S "10*2^-6kg" RAT_FUNC "%8.2" "kg" COEFFS 0 1 0 0 0 0.15625 /end COMPU_METHOD
/begin COMPU_METHOD COMP_0254_S "X-50deg" RAT_FUNC "%8.2" "deg" COEFFS 0 1 50 0 0 1 /end COMPU_METHOD
/begin COMPU_METHOD COMP_0255_S "0.1degC" RAT_FUNC "%8.2" "degC" COEFFS 0 1 0 0 0 0.1 /end COMPU_METHOD
/begin COMPU_METHOD COMP_0256_S "0.0021/s" RAT_FUNC "%8.4" "1/s" COEFFS 0 1 0 0 0 0.002 /end COMPU_METHOD
/begin COMPU_METHOD COMP_0429 "1km/h" RAT_FUNC "%8.2" "km/h" COEFFS 0 1 0 0 0 1 /end COMPU_METHOD
/begin COMPU_METHOD COMP_0298 "5/256ms" RAT_FUNC "%8.3" "ms" COEFFS 0 1 0 0 0 0.01953125 /end COMPU_METHOD
/begin COMPU_METHOD COMP_0257_S "1周期" RAT_FUNC "%8.2" "周期" COEFFS 0 1 0 0 0 1 /end COMPU_METHOD
/begin COMPU_METHOD COMP_0258_S "0.0001degC" RAT_FUNC "%8.5" "degC" COEFFS 0 1 0 0 0 0.0001 /end COMPU_METHOD
/begin COMPU_METHOD COMP_0259_S "0.2℃" RAT_FUNC "%8.2" "℃" COEFFS 0 1 50 0 0 0.2 /end COMPU_METHOD
/begin COMPU_METHOD COMP_0315 "0.09765%/ms" RAT_FUNC "%8.3" "%/ms" COEFFS 0 1 0 0 0 0.09765 /end COMPU_METHOD
/begin COMPU_METHOD COMP_0260_S "2/256deg/10ms" RAT_FUNC "%8.4" "deg/10ms" COEFFS 0 1 0 0 0 0.0078125 /end COMPU_METHOD
/begin COMPU_METHOD COMP_0171 "1.5625rpm/km/h" RAT_FUNC "%8.2" "rpm/km/h" COEFFS 0 1 0 0 0 1.5625 /end COMPU_METHOD
/begin COMPU_METHOD COMP_0261_S "2s" RAT_FUNC "%8.2" "s" COEFFS 0 1 0 0 0 2 /end COMPU_METHOD
/begin COMPU_METHOD COMP_0356 "0.625X-40℃" RAT_FUNC "%8.2" "℃" COEFFS 0 1 40 0 0 0.625 /end COMPU_METHOD
/begin COMPU_METHOD COMP_0073 "3.2us" RAT_FUNC "%8.2" "us" COEFFS 0 1 0 0 0 3.2 /end COMPU_METHOD
/begin COMPU_METHOD COMP_0262_S "0.002s" RAT_FUNC "%8.4" "s" COEFFS 0 1 0 0 0 0.002 /end COMPU_METHOD
/begin COMPU_METHOD COMP_0343 "12.5/2048rpm/ms" RAT_FUNC "%8.4" "rpm/ms" COEFFS 0 1 0 0 0 0.006103516 /end COMPU_METHOD
/begin COMPU_METHOD COMP_0346 "256/2548km" RAT_FUNC "%8.2" "km" COEFFS 0 1 0 0 0 0.100470957 /end COMPU_METHOD
/begin COMPU_METHOD COMP_0263_S "0.4mV/10mse" RAT_FUNC "%8.2" "mV/10mse" COEFFS 0 1 0 0 0 0.4 /end COMPU_METHOD
/begin COMPU_METHOD COMP_0264_S "1/2560kPa/mV" RAT_FUNC "%8.5" "kPa/mV" COEFFS 0 1 0 0 0 0.000390625 /end COMPU_METHOD
/begin COMPU_METHOD COMP_0320 "1.6μS" RAT_FUNC "%8.2" "μS" COEFFS 0 1 0 0 0 1.6 /end COMPU_METHOD
/begin COMPU_METHOD COMP_0265_S "0.005-" RAT_FUNC "%8.4" "-" COEFFS 0 1 0 0 0 0.005 /end COMPU_METHOD
/begin COMPU_METHOD COMP_0448 "100/16384%" RAT_FUNC "%8.4" "%" COEFFS 0 1 0 0 0 0.00610352 /end COMPU_METHOD
/begin COMPU_METHOD COMP_0266_S "0.0008cm^2" RAT_FUNC "%8.5" "cm^2" COEFFS 0 1 0 0 0 0.0008 /end COMPU_METHOD
/begin COMPU_METHOD COMP_0267_S "0.0008*16cm^2" RAT_FUNC "%8.3" "cm^2" COEFFS 0 1 0 0 0 0.0128 /end COMPU_METHOD
/begin COMPU_METHOD COMP_0410 "100/256/256%" RAT_FUNC "%8.4" "%" COEFFS 0 1 0 0 0 0.00152588 /end COMPU_METHOD
/* RECORD_LAYOUT ------------------------------------------------------ */
/begin RECORD_LAYOUT REC_UBYTE_C FNC_VALUES 1 UBYTE COLUMN_DIR DIRECT /end RECORD_LAYOUT
/begin RECORD_LAYOUT REC_SWORD_C FNC_VALUES 1 SWORD COLUMN_DIR DIRECT /end RECORD_LAYOUT
/begin RECORD_LAYOUT REC_UWORD_C FNC_VALUES 1 UWORD COLUMN_DIR DIRECT /end RECORD_LAYOUT
/begin RECORD_LAYOUT REC_SBYTE_C FNC_VALUES 1 SBYTE COLUMN_DIR DIRECT /end RECORD_LAYOUT
/begin RECORD_LAYOUT REC_SLONG_C FNC_VALUES 1 SLONG COLUMN_DIR DIRECT /end RECORD_LAYOUT
/begin RECORD_LAYOUT REC_ULONG_C FNC_VALUES 1 ULONG COLUMN_DIR DIRECT /end RECORD_LAYOUT
/end MODULE
/end PROJECT
