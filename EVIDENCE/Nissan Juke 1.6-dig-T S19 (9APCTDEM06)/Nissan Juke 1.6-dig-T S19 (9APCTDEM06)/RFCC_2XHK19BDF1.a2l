/begin PROJECT X12C_KH3DT_DI_NAM_R/C ""
/begin HEADER "" /* key HEADER ++ "comment" に Par.scomment */ PROJECT_NO X12C_KH3DT_DI_NAM_R/C /* key PROJECT_NO ++ project number に car_eng_desti_lot */ VERSION "0KHDCFDZ7" /* key VERSION ++ version number に mProgver */ /end HEADER
/begin MODULE DIM ""
/begin MOD_COMMON "" ALIGNMENT_BYTE 1 ALIGNMENT_WORD 2 ALIGNMENT_LONG 4 ALIGNMENT_FLOAT32_IEEE 4 ALIGNMENT_FLOAT64_IEEE 4 DEPOSIT ABSOLUTE BYTE_ORDER MSB_FIRST /* ﾊﾞｲﾄｵｰﾀﾞｰがﾘﾌﾟﾚｰｽされる */ /end MOD_COMMON
/begin MEASUREMENT fFSTR0 "0:均質  1:成層" UBYTE COMP_0283 1 100 0 1 BIT_MASK 0x0040 ECU_ADDRESS 0xFFFF1C04 READ_WRITE /end MEASUREMENT
/begin MEASUREMENT fFSTRR "0:均質  1:成層" UBYTE COMP_0283 1 100 0 1 BIT_MASK 0x0020 ECU_ADDRESS 0xFFFF1C04 READ_WRITE /end MEASUREMENT
/begin MEASUREMENT fFTITMHS "0:始動時プレイグ回避制御外  1:始動時プレイグ回避制御中" UBYTE COMP_0283 1 100 0 1 BIT_MASK 0x0010 ECU_ADDRESS 0xFFFF1C04 READ_WRITE /end MEASUREMENT
/begin MEASUREMENT fFWT2IJ "0:不成立  1:成立" UBYTE COMP_0283 1 100 0 1 BIT_MASK 0x0008 ECU_ADDRESS 0xFFFF1C04 READ_WRITE /end MEASUREMENT
/begin MEASUREMENT afFPRPSFS "0:FPRPSFS不成立  1:FPRPSFS成立" UBYTE COMP_0283 1 100 0 1 BIT_MASK 0x0080 ECU_ADDRESS 0xFFFF1C06 READ_WRITE /end MEASUREMENT
/begin MEASUREMENT fFPRPSFS "0:FPRPSFS不成立  1:FPRPSFS成立" UBYTE COMP_0283 1 100 0 1 BIT_MASK 0x0080 ECU_ADDRESS 0xFFFF1C07 READ_WRITE /end MEASUREMENT
/begin MEASUREMENT afFKPART1 "0:不成立  1:成立" UBYTE COMP_0283 1 100 0 1 BIT_MASK 0x0080 ECU_ADDRESS 0xFFFF1C09 READ_WRITE /end MEASUREMENT
/begin MEASUREMENT afKNAREA "0:ノックエリア以外  1:ノックエリア" UBYTE COMP_0283 1 100 0 1 BIT_MASK 0x0040 ECU_ADDRESS 0xFFFF1C09 READ_WRITE /end MEASUREMENT
/begin MEASUREMENT fFKPART1 "0:不成立  1:成立" UBYTE COMP_0283 1 100 0 1 BIT_MASK 0x0080 ECU_ADDRESS 0xFFFF1C0A READ_WRITE /end MEASUREMENT
/begin MEASUREMENT fKNAREA "0:ノックエリア以外  1:ノックエリア" UBYTE COMP_0283 1 100 0 1 BIT_MASK 0x0040 ECU_ADDRESS 0xFFFF1C0A READ_WRITE /end MEASUREMENT
/begin MEASUREMENT fACCFAIL "0:正常  1:ACCフェール" UBYTE COMP_0283 1 100 0 1 BIT_MASK 0x0080 ECU_ADDRESS 0xFFFF1C15 READ_WRITE /end MEASUREMENT
/begin MEASUREMENT fACCMDFAL "0:正常  1:ACCフェール" UBYTE COMP_0283 1 100 0 1 BIT_MASK 0x0040 ECU_ADDRESS 0xFFFF1C15 READ_WRITE /end MEASUREMENT
/begin MEASUREMENT fACOUTV "0:リレーOFF  1:リレーＯＮ" UBYTE COMP_0283 1 100 0 1 BIT_MASK 0x0020 ECU_ADDRESS 0xFFFF1C15 READ_WRITE /end MEASUREMENT
/begin MEASUREMENT fACPDCUT "0:エアコンカット信号OFF  1:エアコンカット信号ＯＮ" UBYTE COMP_0283 1 100 0 1 BIT_MASK 0x0010 ECU_ADDRESS 0xFFFF1C15 READ_WRITE /end MEASUREMENT
/begin MEASUREMENT fALTJG "0:不成立  1:高地判定パラメーター取得許可条件" UBYTE COMP_0283 1 100 0 1 BIT_MASK 0x0008 ECU_ADDRESS 0xFFFF1C15 READ_WRITE /end MEASUREMENT
/begin MEASUREMENT fAPS1SEL "0:正常  1:異常" UBYTE COMP_0283 1 100 0 1 BIT_MASK 0x0004 ECU_ADDRESS 0xFFFF1C15 READ_WRITE /end MEASUREMENT
/begin MEASUREMENT fAPS2SEL "0:正常  1:異常" UBYTE COMP_0283 1 100 0 1 BIT_MASK 0x0002 ECU_ADDRESS 0xFFFF1C15 READ_WRITE /end MEASUREMENT
/begin MEASUREMENT fAPSSNG "0:不成立  1:成立" UBYTE COMP_0283 1 100 0 1 BIT_MASK 0x0001 ECU_ADDRESS 0xFFFF1C15 READ_WRITE /end MEASUREMENT
/begin MEASUREMENT fCSBUST "0:不成立  1:成立" UBYTE COMP_0283 1 100 0 1 BIT_MASK 0x0080 ECU_ADDRESS 0xFFFF1C16 READ_WRITE /end MEASUREMENT
/begin MEASUREMENT fDSTLCUT "0:Dﾚﾝｼﾞｽﾄｰﾙ全気筒ﾘｶﾊﾞ  1:Dﾚﾝｼﾞｽﾄｰﾙ全気筒ｶｯﾄ" UBYTE COMP_0283 1 100 0 1 BIT_MASK 0x0040 ECU_ADDRESS 0xFFFF1C16 READ_WRITE /end MEASUREMENT
/begin MEASUREMENT fFABCSOL "0:SOL_OFF  1:SOL_ON" UBYTE COMP_0283 1 100 0 1 BIT_MASK 0x0020 ECU_ADDRESS 0xFFFF1C16 READ_WRITE /end MEASUREMENT
/begin MEASUREMENT fFANGIJT "0:不成立  1:成立" UBYTE COMP_0283 1 100 0 1 BIT_MASK 0x0010 ECU_ADDRESS 0xFFFF1C16 READ_WRITE /end MEASUREMENT
/begin MEASUREMENT fFCAT2INJ "0:条件不成立  1:条件成立" UBYTE COMP_0283 1 100 0 1 BIT_MASK 0x0008 ECU_ADDRESS 0xFFFF1C16 READ_WRITE /end MEASUREMENT
/begin MEASUREMENT fFCODOFF "0:ODOFF要求無し  1:ODOFF要求有り" UBYTE COMP_0283 1 100 0 1 BIT_MASK 0x0004 ECU_ADDRESS 0xFFFF1C16 READ_WRITE /end MEASUREMENT
/begin MEASUREMENT fFCON "0:ODOFF要求無し  1:ODOFF要求有り" UBYTE COMP_0283 1 100 0 1 BIT_MASK 0x0002 ECU_ADDRESS 0xFFFF1C16 READ_WRITE /end MEASUREMENT
/begin MEASUREMENT fFCRLUP "0:非ロックアップ中  1:ロックアップ中" UBYTE COMP_0283 1 100 0 1 BIT_MASK 0x0001 ECU_ADDRESS 0xFFFF1C16 READ_WRITE /end MEASUREMENT
/begin MEASUREMENT fFD3LU "0:要求有り  1:要求無し" UBYTE COMP_0283 1 100 0 1 BIT_MASK 0x0080 ECU_ADDRESS 0xFFFF1C17 READ_WRITE /end MEASUREMENT
/begin MEASUREMENT fFDTLIN "0:ロックアップ許可信号出力制御条件  1:ロックアップ許可信号出力制御条件" UBYTE COMP_0283 1 100 0 1 BIT_MASK 0x0040 ECU_ADDRESS 0xFFFF1C17 READ_WRITE /end MEASUREMENT
/begin MEASUREMENT fFDTLIN2 "0:ロックアップ許可信号出力制御条件  1:ロックアップ許可信号出力制御条件" UBYTE COMP_0283 1 100 0 1 BIT_MASK 0x0020 ECU_ADDRESS 0xFFFF1C17 READ_WRITE /end MEASUREMENT
/begin MEASUREMENT fFFCADV "0:右記以外  1:ADVLMT切り替え中" UBYTE COMP_0283 1 100 0 1 BIT_MASK 0x0010 ECU_ADDRESS 0xFFFF1C17 READ_WRITE /end MEASUREMENT
/begin MEASUREMENT fFFIR0 "0:FIR制御禁止  1:FIR制御許可" UBYTE COMP_0283 1 100 0 1 BIT_MASK 0x0008 ECU_ADDRESS 0xFFFF1C17 READ_WRITE /end MEASUREMENT
/begin MEASUREMENT fFLSWPT "0:vAPOST＜mAPOFULL(ﾋｽ-mDAPOFULL)  1:vAPOST≧mAPOFULL(ﾋｽ-mDAPOFULL)" UBYTE COMP_0283 1 100 0 1 BIT_MASK 0x0004 ECU_ADDRESS 0xFFFF1C17 READ_WRITE /end MEASUREMENT
/begin MEASUREMENT fFNEIJT "0:vTITM極低温始動時噴射ﾀｲﾐﾝｸﾞ未経  1:vTITM極低温始動時噴射ﾀｲﾐﾝｸﾞ経験" UBYTE COMP_0283 1 100 0 1 BIT_MASK 0x0002 ECU_ADDRESS 0xFFFF1C17 READ_WRITE /end MEASUREMENT
/begin MEASUREMENT fFODINH "0:OD許可  1:OD禁止" UBYTE COMP_0283 1 100 0 1 BIT_MASK 0x0001 ECU_ADDRESS 0xFFFF1C17 READ_WRITE /end MEASUREMENT
/begin MEASUREMENT fFPC "0:FPC端子Low出力  1:FPC端子High出力" UBYTE COMP_0283 1 100 0 1 BIT_MASK 0x0080 ECU_ADDRESS 0xFFFF1C18 READ_WRITE /end MEASUREMENT
/begin MEASUREMENT fFPRON "0:燃料ﾎﾟﾝﾌﾟOFF  1:燃料ﾎﾟﾝﾌﾟON" UBYTE COMP_0283 1 100 0 1 BIT_MASK 0x0040 ECU_ADDRESS 0xFFFF1C18 READ_WRITE /end MEASUREMENT
/begin MEASUREMENT fFSCCMP "0:均質噴射演算終了  1:成層噴射演算終了" UBYTE COMP_0283 1 100 0 1 BIT_MASK 0x0020 ECU_ADDRESS 0xFFFF1C18 READ_WRITE /end MEASUREMENT
/begin MEASUREMENT fFTWIJT "0:極低水温判定されていない  1:極低水温判定されている" UBYTE COMP_0283 1 100 0 1 BIT_MASK 0x0010 ECU_ADDRESS 0xFFFF1C18 READ_WRITE /end MEASUREMENT
/begin MEASUREMENT fFUKE "0:成立  1:不成立" UBYTE COMP_0283 1 100 0 1 BIT_MASK 0x0008 ECU_ADDRESS 0xFFFF1C18 READ_WRITE /end MEASUREMENT
/begin MEASUREMENT fGAKUON "0:REF間⊿N点火時期ﾌｨｰﾄﾞﾊﾞｯｸ制御終  1:REF間⊿N点火時期ﾌｨｰﾄﾞﾊﾞｯｸ制御開" UBYTE COMP_0283 1 100 0 1 BIT_MASK 0x0004 ECU_ADDRESS 0xFFFF1C18 READ_WRITE /end MEASUREMENT
/begin MEASUREMENT fGNDSLCT "0:始動後ﾘｰﾝ限界拡大制中N-Dｾﾚｸﾄ以外  1:始動後ﾘｰﾝ限界拡大制中N-Dｾﾚｸﾄ中" UBYTE COMP_0283 1 100 0 1 BIT_MASK 0x0002 ECU_ADDRESS 0xFFFF1C18 READ_WRITE /end MEASUREMENT
/begin MEASUREMENT fGOV "0:GOVIDL_未使用  1:GOVIDL_使用" UBYTE COMP_0283 1 100 0 1 BIT_MASK 0x0001 ECU_ADDRESS 0xFFFF1C18 READ_WRITE /end MEASUREMENT
/begin MEASUREMENT fINJ2ON "0:２段噴射不許可  1:2段噴射許可" UBYTE COMP_0283 1 100 0 1 BIT_MASK 0x0080 ECU_ADDRESS 0xFFFF1C19 READ_WRITE /end MEASUREMENT
/begin MEASUREMENT fISCADVH "0:なし  1:点火時期操作あり" UBYTE COMP_0283 1 100 0 1 BIT_MASK 0x0040 ECU_ADDRESS 0xFFFF1C19 READ_WRITE /end MEASUREMENT
/begin MEASUREMENT fISCADVL "0:なし  1:点火時期操作あり" UBYTE COMP_0283 1 100 0 1 BIT_MASK 0x0020 ECU_ADDRESS 0xFFFF1C19 READ_WRITE /end MEASUREMENT
/begin MEASUREMENT fKNSTDY "0:学習条件不成立  1:学習条件成立" UBYTE COMP_0283 1 100 0 1 BIT_MASK 0x0010 ECU_ADDRESS 0xFFFF1C19 READ_WRITE /end MEASUREMENT
/begin MEASUREMENT fNDSLCT "0:N-Dｾﾚｸﾄ以外  1:N-Dｾﾚｸﾄ中" UBYTE COMP_0283 1 100 0 1 BIT_MASK 0x0008 ECU_ADDRESS 0xFFFF1C19 READ_WRITE /end MEASUREMENT
/begin MEASUREMENT fOPNMOT "0:ﾓｰﾀ駆動回路ON  1:ﾓｰﾀ駆動回路OFF" UBYTE COMP_0283 1 100 0 1 BIT_MASK 0x0004 ECU_ADDRESS 0xFFFF1C19 READ_WRITE /end MEASUREMENT
/begin MEASUREMENT fPTDFAIL "0:正常  1:異常" UBYTE COMP_0283 1 100 0 1 BIT_MASK 0x0002 ECU_ADDRESS 0xFFFF1C19 READ_WRITE /end MEASUREMENT
/begin MEASUREMENT fPTDON "0:駆動力制御行わない  1:駆動力制御行う" UBYTE COMP_0283 1 100 0 1 BIT_MASK 0x0001 ECU_ADDRESS 0xFFFF1C19 READ_WRITE /end MEASUREMENT
/begin MEASUREMENT fRLYON "0:リレーOFF要求  1:リレーＯＮ要求" UBYTE COMP_0283 1 100 0 1 BIT_MASK 0x0080 ECU_ADDRESS 0xFFFF1C1A READ_WRITE /end MEASUREMENT
/begin MEASUREMENT fRQ_ENBR "0:補正非要求  1:補正要求" UBYTE COMP_0283 1 100 0 1 BIT_MASK 0x0040 ECU_ADDRESS 0xFFFF1C1A READ_WRITE /end MEASUREMENT
/begin MEASUREMENT fRTOHOLD "0:ﾚｼｵﾎｰﾙﾄﾞ制御終了  1:ﾚｼｵﾎｰﾙﾄﾞ制御開始" UBYTE COMP_0283 1 100 0 1 BIT_MASK 0x0020 ECU_ADDRESS 0xFFFF1C1A READ_WRITE /end MEASUREMENT
/begin MEASUREMENT fSFTREQEM "0:排気変速線要求無し  1:排気変速線要求有り" UBYTE COMP_0283 1 100 0 1 BIT_MASK 0x0010 ECU_ADDRESS 0xFFFF1C1A READ_WRITE /end MEASUREMENT
/begin MEASUREMENT fSNOWMODE "0:非_SNOW_MODE  1:SNOW_MODE" UBYTE COMP_0283 1 100 0 1 BIT_MASK 0x0008 ECU_ADDRESS 0xFFFF1C1A READ_WRITE /end MEASUREMENT
/begin MEASUREMENT fSTSW1 "0:スタータSW_OFF  1:スタータSW_ON" UBYTE COMP_0283 1 100 0 1 BIT_MASK 0x0004 ECU_ADDRESS 0xFFFF1C1A READ_WRITE /end MEASUREMENT
/begin MEASUREMENT fTMISTY "0:始動時ISC補正ﾃﾞｨﾚｲ経過前  1:始動時ISC補正ﾃﾞｨﾚｲ経過後" UBYTE COMP_0283 1 100 0 1 BIT_MASK 0x0002 ECU_ADDRESS 0xFFFF1C1A READ_WRITE /end MEASUREMENT
/begin MEASUREMENT fTPS1SEL "0:正常  1:異常" UBYTE COMP_0283 1 100 0 1 BIT_MASK 0x0001 ECU_ADDRESS 0xFFFF1C1A READ_WRITE /end MEASUREMENT
/begin MEASUREMENT fTPS2SEL "0:正常  1:異常" UBYTE COMP_0283 1 100 0 1 BIT_MASK 0x0080 ECU_ADDRESS 0xFFFF1C1B READ_WRITE /end MEASUREMENT
/begin MEASUREMENT fTPSSNG "0:不成立  1:成立" UBYTE COMP_0283 1 100 0 1 BIT_MASK 0x0040 ECU_ADDRESS 0xFFFF1C1B READ_WRITE /end MEASUREMENT
/begin MEASUREMENT fTRCCTRLN "0:Nレンジトルクｺﾝﾄﾛｰﾙ無し  1:Nレンジトルクｺﾝﾄﾛｰﾙ有り" UBYTE COMP_0283 1 100 0 1 BIT_MASK 0x0020 ECU_ADDRESS 0xFFFF1C1B READ_WRITE /end MEASUREMENT
/begin MEASUREMENT fVCLEAN "0:クリーニングモード制御不許可  1:クリーニングモード制御許可" UBYTE COMP_0283 1 100 0 1 BIT_MASK 0x0010 ECU_ADDRESS 0xFFFF1C1B READ_WRITE /end MEASUREMENT
/begin MEASUREMENT fVCLEANE "0:クリーニングモード制御不許可  1:クリーニングモード制御許可" UBYTE COMP_0283 1 100 0 1 BIT_MASK 0x0008 ECU_ADDRESS 0xFFFF1C1B READ_WRITE /end MEASUREMENT
/begin MEASUREMENT fVCSHOT "0:クリーニングモード要求不許可  1:クリーニングモード要求許可" UBYTE COMP_0283 1 100 0 1 BIT_MASK 0x0004 ECU_ADDRESS 0xFFFF1C1B READ_WRITE /end MEASUREMENT
/begin MEASUREMENT fVCSHOTE "0:クリーニングモード要求不許可  1:クリーニングモード要求許可" UBYTE COMP_0283 1 100 0 1 BIT_MASK 0x0002 ECU_ADDRESS 0xFFFF1C1B READ_WRITE /end MEASUREMENT
/begin MEASUREMENT fVPRFC "0:右記以外  1:成層始動用VEL待機燃料カット" UBYTE COMP_0283 1 100 0 1 BIT_MASK 0x0001 ECU_ADDRESS 0xFFFF1C1B READ_WRITE /end MEASUREMENT
/begin MEASUREMENT fWGCSOL "0:OFF  1:ON" UBYTE COMP_0283 1 100 0 1 BIT_MASK 0x0080 ECU_ADDRESS 0xFFFF1C1C READ_WRITE /end MEASUREMENT
/begin MEASUREMENT afACCUT "0:カット以外  1:エアコンカット状態" UBYTE COMP_0283 1 100 0 1 BIT_MASK 0x0080 ECU_ADDRESS 0xFFFF3CFA READ_WRITE /end MEASUREMENT
/begin MEASUREMENT afCLSTUCK "0:非固着  1:固着" UBYTE COMP_0283 1 100 0 1 BIT_MASK 0x0040 ECU_ADDRESS 0xFFFF3CFA READ_WRITE /end MEASUREMENT
/begin MEASUREMENT afCSBUPHST "0:不成立  1:成立" UBYTE COMP_0283 1 100 0 1 BIT_MASK 0x0020 ECU_ADDRESS 0xFFFF3CFA READ_WRITE /end MEASUREMENT
/begin MEASUREMENT afETCON "0:禁止状態  1:許可状態" UBYTE COMP_0283 1 100 0 1 BIT_MASK 0x0010 ECU_ADDRESS 0xFFFF3CFA READ_WRITE /end MEASUREMENT
/begin MEASUREMENT afFLEAN "0:ストイキ  1:リーン" UBYTE COMP_0283 1 100 0 1 BIT_MASK 0x0008 ECU_ADDRESS 0xFFFF3CFA READ_WRITE /end MEASUREMENT
/begin MEASUREMENT afFPLINJGO "0:未実行  1:実行" UBYTE COMP_0283 1 100 0 1 BIT_MASK 0x0004 ECU_ADDRESS 0xFFFF3CFA READ_WRITE /end MEASUREMENT
/begin MEASUREMENT afFPLINJST "0:未許可  1:許可" UBYTE COMP_0283 1 100 0 1 BIT_MASK 0x0002 ECU_ADDRESS 0xFFFF3CFA READ_WRITE /end MEASUREMENT
/begin MEASUREMENT afFSTRETYW "0:右記以外  1:切り替え中" UBYTE COMP_0283 1 100 0 1 BIT_MASK 0x0001 ECU_ADDRESS 0xFFFF3CFA READ_WRITE /end MEASUREMENT
/begin MEASUREMENT afREQREV2 "0:回転数制御非実行  1:回転数制御実行" UBYTE COMP_0283 1 100 0 1 BIT_MASK 0x0080 ECU_ADDRESS 0xFFFF3CFB READ_WRITE /end MEASUREMENT
/begin MEASUREMENT afVTCENA "0:VTC_F/B制御禁止  1:VTC_F/B制御許可" UBYTE COMP_0283 1 100 0 1 BIT_MASK 0x0040 ECU_ADDRESS 0xFFFF3CFB READ_WRITE /end MEASUREMENT
/begin MEASUREMENT afVTCENAE "0:VTC_F/B制御禁止  1:VTC_F/B制御許可" UBYTE COMP_0283 1 100 0 1 BIT_MASK 0x0020 ECU_ADDRESS 0xFFFF3CFB READ_WRITE /end MEASUREMENT
/begin MEASUREMENT fACCUT "0:カット以外  1:エアコンカット状態" UBYTE COMP_0283 1 100 0 1 BIT_MASK 0x0080 ECU_ADDRESS 0xFFFF3CFC READ_WRITE /end MEASUREMENT
/begin MEASUREMENT fCLSTUCK "0:非固着  1:固着" UBYTE COMP_0283 1 100 0 1 BIT_MASK 0x0040 ECU_ADDRESS 0xFFFF3CFC READ_WRITE /end MEASUREMENT
/begin MEASUREMENT fCSBUPHST "0:不成立  1:成立" UBYTE COMP_0283 1 100 0 1 BIT_MASK 0x0020 ECU_ADDRESS 0xFFFF3CFC READ_WRITE /end MEASUREMENT
/begin MEASUREMENT fETCON "0:禁止状態  1:許可状態" UBYTE COMP_0283 1 100 0 1 BIT_MASK 0x0010 ECU_ADDRESS 0xFFFF3CFC READ_WRITE /end MEASUREMENT
/begin MEASUREMENT fFLEAN "0:ストイキ  1:リーン" UBYTE COMP_0283 1 100 0 1 BIT_MASK 0x0008 ECU_ADDRESS 0xFFFF3CFC READ_WRITE /end MEASUREMENT
/begin MEASUREMENT fFPLINJGO "0:未実行  1:実行" UBYTE COMP_0283 1 100 0 1 BIT_MASK 0x0004 ECU_ADDRESS 0xFFFF3CFC READ_WRITE /end MEASUREMENT
/begin MEASUREMENT fFPLINJST "0:未許可  1:許可" UBYTE COMP_0283 1 100 0 1 BIT_MASK 0x0002 ECU_ADDRESS 0xFFFF3CFC READ_WRITE /end MEASUREMENT
/begin MEASUREMENT fFSTRETYW "0:右記以外  1:均質->超リタード切り替え中" UBYTE COMP_0283 1 100 0 1 BIT_MASK 0x0001 ECU_ADDRESS 0xFFFF3CFC READ_WRITE /end MEASUREMENT
/begin MEASUREMENT fREQREV2 "0:回転数制御非実行  1:回転数制御実行" UBYTE COMP_0283 1 100 0 1 BIT_MASK 0x0080 ECU_ADDRESS 0xFFFF3CFD READ_WRITE /end MEASUREMENT
/begin MEASUREMENT fVTCENA "0:VTC_F/B制御禁止  1:VTC_F/B制御許可" UBYTE COMP_0283 1 100 0 1 BIT_MASK 0x0040 ECU_ADDRESS 0xFFFF3CFD READ_WRITE /end MEASUREMENT
/begin MEASUREMENT fVTCENAE "0:VTC_F/B制御禁止  1:VTC_F/B制御許可" UBYTE COMP_0283 1 100 0 1 BIT_MASK 0x0020 ECU_ADDRESS 0xFFFF3CFD READ_WRITE /end MEASUREMENT
/begin MEASUREMENT afFLITADV "0:進角切替え外  1:進角切替え中" UBYTE COMP_0283 1 100 0 1 BIT_MASK 0x0080 ECU_ADDRESS 0xFFFF3D00 READ_WRITE /end MEASUREMENT
/begin MEASUREMENT fFLITADV "0:進角切替え外  1:進角切替え中" UBYTE COMP_0283 1 100 0 1 BIT_MASK 0x0080 ECU_ADDRESS 0xFFFF3D01 READ_WRITE /end MEASUREMENT
/begin MEASUREMENT afADJDDL "0:点火時期、エンジン回転数調整共通  1:点火時期、エンジン回転数調整共通" UBYTE COMP_0283 1 100 0 1 BIT_MASK 0x0080 ECU_ADDRESS 0xFFFF3D03 READ_WRITE /end MEASUREMENT
/begin MEASUREMENT afADVCYO "0:点火時期調整でない  1:点火時期調整である" UBYTE COMP_0283 1 100 0 1 BIT_MASK 0x0040 ECU_ADDRESS 0xFFFF3D03 READ_WRITE /end MEASUREMENT
/begin MEASUREMENT afADVDDL "0:点火時期調整でない  1:点火時期調整である" UBYTE COMP_0283 1 100 0 1 BIT_MASK 0x0020 ECU_ADDRESS 0xFFFF3D03 READ_WRITE /end MEASUREMENT
/begin MEASUREMENT afAFSDST2 "0:要求なし  1:要求あり" UBYTE COMP_0283 1 100 0 1 BIT_MASK 0x0010 ECU_ADDRESS 0xFFFF3D03 READ_WRITE /end MEASUREMENT
/begin MEASUREMENT afAGBACK "0:AGB要求不許可  1:AGB要求許可" UBYTE COMP_0283 1 100 0 1 BIT_MASK 0x0008 ECU_ADDRESS 0xFFFF3D03 READ_WRITE /end MEASUREMENT
/begin MEASUREMENT afAGBCANNG "0:OK  1:NG" UBYTE COMP_0283 1 100 0 1 BIT_MASK 0x0004 ECU_ADDRESS 0xFFFF3D03 READ_WRITE /end MEASUREMENT
/begin MEASUREMENT afAGBLNKNG "0:OK  1:NG" UBYTE COMP_0283 1 100 0 1 BIT_MASK 0x0002 ECU_ADDRESS 0xFFFF3D03 READ_WRITE /end MEASUREMENT
/begin MEASUREMENT afALTCNT "0:オルタネータ発電電圧可変制御禁止  1:オルタネータ発電電圧可変制御許可" UBYTE COMP_0283 1 100 0 1 BIT_MASK 0x0001 ECU_ADDRESS 0xFFFF3D03 READ_WRITE /end MEASUREMENT
/begin MEASUREMENT afAPLHACT "0:not_active  1:active" UBYTE COMP_0283 1 100 0 1 BIT_MASK 0x0080 ECU_ADDRESS 0xFFFF3D04 READ_WRITE /end MEASUREMENT
/begin MEASUREMENT afAPS1CA "0:正常  1:警戒(過渡NG)" UBYTE COMP_0283 1 100 0 1 BIT_MASK 0x0040 ECU_ADDRESS 0xFFFF3D04 READ_WRITE /end MEASUREMENT
/begin MEASUREMENT afAPS2CA "0:正常  1:警戒(過渡NG)" UBYTE COMP_0283 1 100 0 1 BIT_MASK 0x0020 ECU_ADDRESS 0xFFFF3D04 READ_WRITE /end MEASUREMENT
/begin MEASUREMENT afAPSDBLCA "0:APS二重目CA判定なし  1:APS二重目CA判定あり" UBYTE COMP_0283 1 100 0 1 BIT_MASK 0x0010 ECU_ADDRESS 0xFFFF3D04 READ_WRITE /end MEASUREMENT
/begin MEASUREMENT afASCDC5SW "0:5連照合結果Low  1:5連照合結果High" UBYTE COMP_0283 1 100 0 1 BIT_MASK 0x0008 ECU_ADDRESS 0xFFFF3D04 READ_WRITE /end MEASUREMENT
/begin MEASUREMENT afASCDFAIL "0:ﾌｪｲﾙ  1:未ﾌｪｲﾙ" UBYTE COMP_0283 1 100 0 1 BIT_MASK 0x0004 ECU_ADDRESS 0xFFFF3D04 READ_WRITE /end MEASUREMENT
/begin MEASUREMENT afASCDNEUT "0:5連照合結果Low  1:5連照合結果High" UBYTE COMP_0283 1 100 0 1 BIT_MASK 0x0002 ECU_ADDRESS 0xFFFF3D04 READ_WRITE /end MEASUREMENT
/begin MEASUREMENT afATTRQNG2 "0:正常  1:異常" UBYTE COMP_0283 1 100 0 1 BIT_MASK 0x0001 ECU_ADDRESS 0xFFFF3D04 READ_WRITE /end MEASUREMENT
/begin MEASUREMENT afBASERR "0:不成立  1:成立" UBYTE COMP_0283 1 100 0 1 BIT_MASK 0x0080 ECU_ADDRESS 0xFFFF3D05 READ_WRITE /end MEASUREMENT
/begin MEASUREMENT afBCDCV "0:CDCV開  1:CDCV閉" UBYTE COMP_0283 1 100 0 1 BIT_MASK 0x0040 ECU_ADDRESS 0xFFFF3D05 READ_WRITE /end MEASUREMENT
/begin MEASUREMENT afBCVBV "0:CVBV閉  1:CVBV開" UBYTE COMP_0283 1 100 0 1 BIT_MASK 0x0020 ECU_ADDRESS 0xFFFF3D05 READ_WRITE /end MEASUREMENT
/begin MEASUREMENT afBIDETCCO "0:ETC学習クリア未終了  1:ETC学習クリア終了" UBYTE COMP_0283 1 100 0 1 BIT_MASK 0x0010 ECU_ADDRESS 0xFFFF3D05 READ_WRITE /end MEASUREMENT
/begin MEASUREMENT afBIDFFDCO "0:裏FFDクリア未終了  1:裏FFDクリア終了" UBYTE COMP_0283 1 100 0 1 BIT_MASK 0x0008 ECU_ADDRESS 0xFFFF3D05 READ_WRITE /end MEASUREMENT
/begin MEASUREMENT afBIDNTASO "0:通常TAS学習クリア未終了  1:通常TAS学習クリア終了" UBYTE COMP_0283 1 100 0 1 BIT_MASK 0x0004 ECU_ADDRESS 0xFFFF3D05 READ_WRITE /end MEASUREMENT
/begin MEASUREMENT afBIDRTASO "0:急速TAS学習クリア未終了  1:急速TAS学習クリア終了" UBYTE COMP_0283 1 100 0 1 BIT_MASK 0x0002 ECU_ADDRESS 0xFFFF3D05 READ_WRITE /end MEASUREMENT
/begin MEASUREMENT afBNCSW "0:5連照合結果Low  1:5連照合結果High" UBYTE COMP_0283 1 100 0 1 BIT_MASK 0x0001 ECU_ADDRESS 0xFFFF3D05 READ_WRITE /end MEASUREMENT
/begin MEASUREMENT afBNOSW "0:5連照合結果Low  1:5連照合結果High" UBYTE COMP_0283 1 100 0 1 BIT_MASK 0x0080 ECU_ADDRESS 0xFFFF3D06 READ_WRITE /end MEASUREMENT
/begin MEASUREMENT afBPFS_NC "0:5連照合結果Low  1:5連照合結果High" UBYTE COMP_0283 1 100 0 1 BIT_MASK 0x0040 ECU_ADDRESS 0xFFFF3D06 READ_WRITE /end MEASUREMENT
/begin MEASUREMENT afBPFS_NO "0:5連照合結果Low  1:5連照合結果High" UBYTE COMP_0283 1 100 0 1 BIT_MASK 0x0020 ECU_ADDRESS 0xFFFF3D06 READ_WRITE /end MEASUREMENT
/begin MEASUREMENT afBRKSWCA1 "0:CA1判定なし  1:CA1判定あり" UBYTE COMP_0283 1 100 0 1 BIT_MASK 0x0010 ECU_ADDRESS 0xFFFF3D06 READ_WRITE /end MEASUREMENT
/begin MEASUREMENT afBRKSWCA2 "0:CA2判定なし  1:CA2判定あり" UBYTE COMP_0283 1 100 0 1 BIT_MASK 0x0008 ECU_ADDRESS 0xFFFF3D06 READ_WRITE /end MEASUREMENT
/begin MEASUREMENT afBRKSWCA3 "0:CA3判定なし  1:CA3判定あり" UBYTE COMP_0283 1 100 0 1 BIT_MASK 0x0004 ECU_ADDRESS 0xFFFF3D06 READ_WRITE /end MEASUREMENT
/begin MEASUREMENT afCRUISE "0:非ｸﾙｰｽﾞ中  1:ｸﾙｰｽﾞ中" UBYTE COMP_0283 1 100 0 1 BIT_MASK 0x0002 ECU_ADDRESS 0xFFFF3D06 READ_WRITE /end MEASUREMENT
/begin MEASUREMENT afCUTLNOP "0:正常  1:異常" UBYTE COMP_0283 1 100 0 1 BIT_MASK 0x0001 ECU_ADDRESS 0xFFFF3D06 READ_WRITE /end MEASUREMENT
/begin MEASUREMENT afCUTLNSH "0:正常  1:異常" UBYTE COMP_0283 1 100 0 1 BIT_MASK 0x0080 ECU_ADDRESS 0xFFFF3D07 READ_WRITE /end MEASUREMENT
/begin MEASUREMENT afD2ALSTPD "0:通常制御中  1:停止中" UBYTE COMP_0283 1 100 0 1 BIT_MASK 0x0040 ECU_ADDRESS 0xFFFF3D07 READ_WRITE /end MEASUREMENT
/begin MEASUREMENT afD2LNCLED "0:ｸﾘｱ未終了  1:ｸﾘｱ終了" UBYTE COMP_0283 1 100 0 1 BIT_MASK 0x0020 ECU_ADDRESS 0xFFFF3D07 READ_WRITE /end MEASUREMENT
/begin MEASUREMENT afDAPSNG "0:NG/FS非判定中  1:NG/FS判定中" UBYTE COMP_0283 1 100 0 1 BIT_MASK 0x0010 ECU_ADDRESS 0xFFFF3D07 READ_WRITE /end MEASUREMENT
/begin MEASUREMENT afDATACLR "0:診断用パラメータ消去解除  1:診断用パラメータ消去要求" UBYTE COMP_0283 1 100 0 1 BIT_MASK 0x0008 ECU_ADDRESS 0xFFFF3D07 READ_WRITE /end MEASUREMENT
/begin MEASUREMENT afDCPUNG "0:CPUNGなし  1:CPUNGあり" UBYTE COMP_0283 1 100 0 1 BIT_MASK 0x0004 ECU_ADDRESS 0xFFFF3D07 READ_WRITE /end MEASUREMENT
/begin MEASUREMENT afDRARBTON "0:バーチャルドライバ未作動  1:バーチャルドライバ作動中" UBYTE COMP_0283 1 100 0 1 BIT_MASK 0x0002 ECU_ADDRESS 0xFFFF3D07 READ_WRITE /end MEASUREMENT
/begin MEASUREMENT afDTNG "0:A/T信号線正常  1:A/T信号線異常" UBYTE COMP_0283 1 100 0 1 BIT_MASK 0x0001 ECU_ADDRESS 0xFFFF3D07 READ_WRITE /end MEASUREMENT
/begin MEASUREMENT afDTVONG "0:NG/FS非判定中  1:NG/FS判定中" UBYTE COMP_0283 1 100 0 1 BIT_MASK 0x0080 ECU_ADDRESS 0xFFFF3D08 READ_WRITE /end MEASUREMENT
/begin MEASUREMENT afDTYHOLDE "0:0%固定  1:100%固定" UBYTE COMP_0283 1 100 0 1 BIT_MASK 0x0040 ECU_ADDRESS 0xFFFF3D08 READ_WRITE /end MEASUREMENT
/begin MEASUREMENT afDUTYHOLD "0:0%固定  1:100%固定" UBYTE COMP_0283 1 100 0 1 BIT_MASK 0x0020 ECU_ADDRESS 0xFFFF3D08 READ_WRITE /end MEASUREMENT
/begin MEASUREMENT afEEPRWNG "0:EEPROM_not_NG  1:EEPROM_NG" UBYTE COMP_0283 1 100 0 1 BIT_MASK 0x0010 ECU_ADDRESS 0xFFFF3D08 READ_WRITE /end MEASUREMENT
/begin MEASUREMENT afENSTSS "0:右記以外  1:エンスト" UBYTE COMP_0283 1 100 0 1 BIT_MASK 0x0008 ECU_ADDRESS 0xFFFF3D08 READ_WRITE /end MEASUREMENT
/begin MEASUREMENT afESPACK "0:ESP不許可  1:ESP許可" UBYTE COMP_0283 1 100 0 1 BIT_MASK 0x0004 ECU_ADDRESS 0xFFFF3D08 READ_WRITE /end MEASUREMENT
/begin MEASUREMENT afETCFAIL "0:正常  1:異常" UBYTE COMP_0283 1 100 0 1 BIT_MASK 0x0002 ECU_ADDRESS 0xFFFF3D08 READ_WRITE /end MEASUREMENT
/begin MEASUREMENT afETSACK "0:ETS不許可  1:ETS許可" UBYTE COMP_0283 1 100 0 1 BIT_MASK 0x0001 ECU_ADDRESS 0xFFFF3D08 READ_WRITE /end MEASUREMENT
/begin MEASUREMENT afEVPCLS "0:不許可  1:許可" UBYTE COMP_0283 1 100 0 1 BIT_MASK 0x0080 ECU_ADDRESS 0xFFFF3D09 READ_WRITE /end MEASUREMENT
/begin MEASUREMENT afFAREAA "0:Ａ領域以外  1:Ａ領域" UBYTE COMP_0283 1 100 0 1 BIT_MASK 0x0040 ECU_ADDRESS 0xFFFF3D09 READ_WRITE /end MEASUREMENT
/begin MEASUREMENT afFAREAC "0:Ｃ領域以外  1:Ｃ領域" UBYTE COMP_0283 1 100 0 1 BIT_MASK 0x0020 ECU_ADDRESS 0xFFFF3D09 READ_WRITE /end MEASUREMENT
/begin MEASUREMENT afFCNCASCD "0:ASCD時ｶｯﾄなし  1:ASCD時ｶｯﾄあり" UBYTE COMP_0283 1 100 0 1 BIT_MASK 0x0010 ECU_ADDRESS 0xFFFF3D09 READ_WRITE /end MEASUREMENT
/begin MEASUREMENT afFEVLKR "0:右記以外  1:空然比学習禁止" UBYTE COMP_0283 1 100 0 1 BIT_MASK 0x0008 ECU_ADDRESS 0xFFFF3D09 READ_WRITE /end MEASUREMENT
/begin MEASUREMENT afFFDCLRF "0:不成立  1:成立" UBYTE COMP_0283 1 100 0 1 BIT_MASK 0x0004 ECU_ADDRESS 0xFFFF3D09 READ_WRITE /end MEASUREMENT
/begin MEASUREMENT afFGPDGN "0:燃料ﾚﾍﾞﾙｹﾞｰｼﾞ機能診断許可条件不  1:燃料ﾚﾍﾞﾙｹﾞｰｼﾞ機能診断許可条件成" UBYTE COMP_0283 1 100 0 1 BIT_MASK 0x0002 ECU_ADDRESS 0xFFFF3D09 READ_WRITE /end MEASUREMENT
/begin MEASUREMENT afFLAIR "0:要求有り  1:要求無し" UBYTE COMP_0283 1 100 0 1 BIT_MASK 0x0001 ECU_ADDRESS 0xFFFF3D09 READ_WRITE /end MEASUREMENT
/begin MEASUREMENT afFLBURN "0:要求有り  1:要求無し" UBYTE COMP_0283 1 100 0 1 BIT_MASK 0x0080 ECU_ADDRESS 0xFFFF3D0A READ_WRITE /end MEASUREMENT
/begin MEASUREMENT afFLFUEL "0:要求有り  1:要求無し" UBYTE COMP_0283 1 100 0 1 BIT_MASK 0x0040 ECU_ADDRESS 0xFFFF3D0A READ_WRITE /end MEASUREMENT
/begin MEASUREMENT afFLIGN "0:要求有り  1:要求無し" UBYTE COMP_0283 1 100 0 1 BIT_MASK 0x0020 ECU_ADDRESS 0xFFFF3D0A READ_WRITE /end MEASUREMENT
/begin MEASUREMENT afFMFJAR "0:失火診断禁止  1:失火診断許可" UBYTE COMP_0283 1 100 0 1 BIT_MASK 0x0010 ECU_ADDRESS 0xFFFF3D0A READ_WRITE /end MEASUREMENT
/begin MEASUREMENT afFMFJAR2 "0:不成立  1:成立" UBYTE COMP_0283 1 100 0 1 BIT_MASK 0x0008 ECU_ADDRESS 0xFFFF3D0A READ_WRITE /end MEASUREMENT
/begin MEASUREMENT afFMILBR "0:MIL消灯要求  1:失火MIL点滅要求有り" UBYTE COMP_0283 1 100 0 1 BIT_MASK 0x0004 ECU_ADDRESS 0xFFFF3D0A READ_WRITE /end MEASUREMENT
/begin MEASUREMENT afFMPTRN "0:許可  1:禁止" UBYTE COMP_0283 1 100 0 1 BIT_MASK 0x0002 ECU_ADDRESS 0xFFFF3D0A READ_WRITE /end MEASUREMENT
/begin MEASUREMENT afFMRCPT "0:不成立  1:成立" UBYTE COMP_0283 1 100 0 1 BIT_MASK 0x0001 ECU_ADDRESS 0xFFFF3D0A READ_WRITE /end MEASUREMENT
/begin MEASUREMENT afFOPWRN "0:右記以外  1:油圧警告灯点灯" UBYTE COMP_0283 1 100 0 1 BIT_MASK 0x0080 ECU_ADDRESS 0xFFFF3D0B READ_WRITE /end MEASUREMENT
/begin MEASUREMENT afFQCDLY "0:不成立  1:成立" UBYTE COMP_0283 1 100 0 1 BIT_MASK 0x0040 ECU_ADDRESS 0xFFFF3D0B READ_WRITE /end MEASUREMENT
/begin MEASUREMENT afFQLRNED "0:未終了  1:終了" UBYTE COMP_0283 1 100 0 1 BIT_MASK 0x0020 ECU_ADDRESS 0xFFFF3D0B READ_WRITE /end MEASUREMENT
/begin MEASUREMENT afFREV "0:ｴﾝｼﾞﾝ回転数400rpm以上  1:ｴﾝｼﾞﾝ回転数400rpm未満" UBYTE COMP_0283 1 100 0 1 BIT_MASK 0x0010 ECU_ADDRESS 0xFFFF3D0B READ_WRITE /end MEASUREMENT
/begin MEASUREMENT afFRWIPD "0:ワイパ＿off  1:ワイパ＿on" UBYTE COMP_0283 1 100 0 1 BIT_MASK 0x0008 ECU_ADDRESS 0xFFFF3D0B READ_WRITE /end MEASUREMENT
/begin MEASUREMENT afFSTR "0:均質  1:成層" UBYTE COMP_0283 1 100 0 1 BIT_MASK 0x0004 ECU_ADDRESS 0xFFFF3D0B READ_WRITE /end MEASUREMENT
/begin MEASUREMENT afFSTRETYU "0:右記以外  1:切り替え中" UBYTE COMP_0283 1 100 0 1 BIT_MASK 0x0002 ECU_ADDRESS 0xFFFF3D0B READ_WRITE /end MEASUREMENT
/begin MEASUREMENT afFSTRETYV "0:右記以外  1:切り替え中" UBYTE COMP_0283 1 100 0 1 BIT_MASK 0x0001 ECU_ADDRESS 0xFFFF3D0B READ_WRITE /end MEASUREMENT
/begin MEASUREMENT afFSTRSTEN "0:右記以外  1:成層始動中および切り替え中" UBYTE COMP_0283 1 100 0 1 BIT_MASK 0x0080 ECU_ADDRESS 0xFFFF3D0C READ_WRITE /end MEASUREMENT
/begin MEASUREMENT afFSTRSTOK "0:右記以外  1:成層始動許可" UBYTE COMP_0283 1 100 0 1 BIT_MASK 0x0040 ECU_ADDRESS 0xFFFF3D0C READ_WRITE /end MEASUREMENT
/begin MEASUREMENT afFTCVTRG "0:実行中でない  1:実行中" UBYTE COMP_0283 1 100 0 1 BIT_MASK 0x0020 ECU_ADDRESS 0xFFFF3D0C READ_WRITE /end MEASUREMENT
/begin MEASUREMENT afFTCVTRS "0:テスト保留でない  1:テスト保留" UBYTE COMP_0283 1 100 0 1 BIT_MASK 0x0010 ECU_ADDRESS 0xFFFF3D0C READ_WRITE /end MEASUREMENT
/begin MEASUREMENT afFTCVTRSS "0:故障判定中でない  1:故障判定中" UBYTE COMP_0283 1 100 0 1 BIT_MASK 0x0008 ECU_ADDRESS 0xFFFF3D0C READ_WRITE /end MEASUREMENT
/begin MEASUREMENT afFTMTRP "0:ｴﾝｼﾞﾝ回転継続時間経過  1:ｴﾝｼﾞﾝ回転継続時間未経過" UBYTE COMP_0283 1 100 0 1 BIT_MASK 0x0004 ECU_ADDRESS 0xFFFF3D0C READ_WRITE /end MEASUREMENT
/begin MEASUREMENT afFTPCHG "0:Not＿decelerating  1:decelerating" UBYTE COMP_0283 1 100 0 1 BIT_MASK 0x0002 ECU_ADDRESS 0xFFFF3D0C READ_WRITE /end MEASUREMENT
/begin MEASUREMENT afFTPCHK "0:Not＿acceleration  1:Acceleration" UBYTE COMP_0283 1 100 0 1 BIT_MASK 0x0001 ECU_ADDRESS 0xFFFF3D0C READ_WRITE /end MEASUREMENT
/begin MEASUREMENT afFTPCHOK "0:Not＿permission  1:Permission" UBYTE COMP_0283 1 100 0 1 BIT_MASK 0x0080 ECU_ADDRESS 0xFFFF3D0D READ_WRITE /end MEASUREMENT
/begin MEASUREMENT afFTRIP1 "0:ﾄﾘｯﾌﾟ1突入済み  1:ﾄﾘｯﾌﾟ1未突入" UBYTE COMP_0283 1 100 0 1 BIT_MASK 0x0040 ECU_ADDRESS 0xFFFF3D0D READ_WRITE /end MEASUREMENT
/begin MEASUREMENT afFTRIP11 "0:ﾄﾘｯﾌﾟ11未突入  1:ﾄﾘｯﾌﾟ11突入済み" UBYTE COMP_0283 1 100 0 1 BIT_MASK 0x0020 ECU_ADDRESS 0xFFFF3D0D READ_WRITE /end MEASUREMENT
/begin MEASUREMENT afFTRIP2 "0:ﾄﾘｯﾌﾟ2突入済み  1:ﾄﾘｯﾌﾟ2未突入" UBYTE COMP_0283 1 100 0 1 BIT_MASK 0x0010 ECU_ADDRESS 0xFFFF3D0D READ_WRITE /end MEASUREMENT
/begin MEASUREMENT afFTRIP3 "0:ﾄﾘｯﾌﾟ3突入済み  1:ﾄﾘｯﾌﾟ3未突入" UBYTE COMP_0283 1 100 0 1 BIT_MASK 0x0008 ECU_ADDRESS 0xFFFF3D0D READ_WRITE /end MEASUREMENT
/begin MEASUREMENT afFTSTRANS "0:上記以外  1:ﾀｰﾎﾞSOFIS用加速判定中" UBYTE COMP_0283 1 100 0 1 BIT_MASK 0x0004 ECU_ADDRESS 0xFFFF3D0D READ_WRITE /end MEASUREMENT
/begin MEASUREMENT afFTW70 "0:現在水温70℃以上  1:現在水温70℃未満" UBYTE COMP_0283 1 100 0 1 BIT_MASK 0x0002 ECU_ADDRESS 0xFFFF3D0D READ_WRITE /end MEASUREMENT
/begin MEASUREMENT afFTWI20 "0:始動時現在水温差20℃以上  1:始動時現在水温差20℃未満" UBYTE COMP_0283 1 100 0 1 BIT_MASK 0x0001 ECU_ADDRESS 0xFFFF3D0D READ_WRITE /end MEASUREMENT
/begin MEASUREMENT afGKPGOK "0:不成立  1:成立" UBYTE COMP_0283 1 100 0 1 BIT_MASK 0x0080 ECU_ADDRESS 0xFFFF3D0E READ_WRITE /end MEASUREMENT
/begin MEASUREMENT afGNTRP "0:ｴﾝｼﾞﾝ始動後GNRTRPｶｳﾝﾀｶｳﾝﾄしてい  1:ｴﾝｼﾞﾝ始動後GNRTRPｶｳﾝﾀｶｳﾝﾄした" UBYTE COMP_0283 1 100 0 1 BIT_MASK 0x0040 ECU_ADDRESS 0xFFFF3D0E READ_WRITE /end MEASUREMENT
/begin MEASUREMENT afGSIDWN "0:DOWNシフト指示なし  1:DOWNシフト指示有り" UBYTE COMP_0283 1 100 0 1 BIT_MASK 0x0020 ECU_ADDRESS 0xFFFF3D0E READ_WRITE /end MEASUREMENT
/begin MEASUREMENT afGSIUP "0:UPシフト指示なし  1:UPシフト指示有り" UBYTE COMP_0283 1 100 0 1 BIT_MASK 0x0010 ECU_ADDRESS 0xFFFF3D0E READ_WRITE /end MEASUREMENT
/begin MEASUREMENT afHOTICST "0:カウント中止  1:カウント開始" UBYTE COMP_0283 1 100 0 1 BIT_MASK 0x0008 ECU_ADDRESS 0xFFFF3D0E READ_WRITE /end MEASUREMENT
/begin MEASUREMENT afHPDGNCND "0:不成立  1:成立" UBYTE COMP_0283 1 100 0 1 BIT_MASK 0x0004 ECU_ADDRESS 0xFFFF3D0E READ_WRITE /end MEASUREMENT
/begin MEASUREMENT afICRUISE "0:CRUISE=1  1:CRUISE=0" UBYTE COMP_0283 1 100 0 1 BIT_MASK 0x0002 ECU_ADDRESS 0xFFFF3D0E READ_WRITE /end MEASUREMENT
/begin MEASUREMENT afIHTONNG "0:fIHRST=0がTMIHRLY2#以上継続  1:fIHRST=1がTMIHRLY1#以上継続" UBYTE COMP_0283 1 100 0 1 BIT_MASK 0x0001 ECU_ADDRESS 0xFFFF3D0E READ_WRITE /end MEASUREMENT
/begin MEASUREMENT afLEDONR "0:失火MIL点滅要求無し  1:MIL点灯要求" UBYTE COMP_0283 1 100 0 1 BIT_MASK 0x0080 ECU_ADDRESS 0xFFFF3D0F READ_WRITE /end MEASUREMENT
/begin MEASUREMENT afLMDINI "0:フラグ成立しない  1:フラグ成立" UBYTE COMP_0283 1 100 0 1 BIT_MASK 0x0040 ECU_ADDRESS 0xFFFF3D0F READ_WRITE /end MEASUREMENT
/begin MEASUREMENT afMAINSW "0:ﾒｲﾝSW_OFF  1:ﾒｲﾝSW_ON" UBYTE COMP_0283 1 100 0 1 BIT_MASK 0x0020 ECU_ADDRESS 0xFFFF3D0F READ_WRITE /end MEASUREMENT
/begin MEASUREMENT afMAINSWSL "0:SLﾒｲﾝSW_OFF  1:SLﾒｲﾝSW_ON" UBYTE COMP_0283 1 100 0 1 BIT_MASK 0x0010 ECU_ADDRESS 0xFFFF3D0F READ_WRITE /end MEASUREMENT
/begin MEASUREMENT afMCMOUTC "0:無し  1:有り" UBYTE COMP_0283 1 100 0 1 BIT_MASK 0x0008 ECU_ADDRESS 0xFFFF3D0F READ_WRITE /end MEASUREMENT
/begin MEASUREMENT afMFCNDC "0:条件不成立  1:条件成立" UBYTE COMP_0283 1 100 0 1 BIT_MASK 0x0004 ECU_ADDRESS 0xFFFF3D0F READ_WRITE /end MEASUREMENT
/begin MEASUREMENT afMFCNDD "0:条件不成立  1:条件成立" UBYTE COMP_0283 1 100 0 1 BIT_MASK 0x0002 ECU_ADDRESS 0xFFFF3D0F READ_WRITE /end MEASUREMENT
/begin MEASUREMENT afMFCNDE "0:条件不成立  1:条件成立" UBYTE COMP_0283 1 100 0 1 BIT_MASK 0x0001 ECU_ADDRESS 0xFFFF3D0F READ_WRITE /end MEASUREMENT
/begin MEASUREMENT afMFCNDG "0:条件不成立  1:条件成立" UBYTE COMP_0283 1 100 0 1 BIT_MASK 0x0080 ECU_ADDRESS 0xFFFF3D10 READ_WRITE /end MEASUREMENT
/begin MEASUREMENT afMSRSTINH "0:MSR開始許可  1:MSR開始禁止" UBYTE COMP_0283 1 100 0 1 BIT_MASK 0x0040 ECU_ADDRESS 0xFFFF3D10 READ_WRITE /end MEASUREMENT
/begin MEASUREMENT afNIDLEINH "0:Nｱｲﾄﾞﾙ禁止ではない  1:Nｱｲﾄﾞﾙ禁止" UBYTE COMP_0283 1 100 0 1 BIT_MASK 0x0020 ECU_ADDRESS 0xFFFF3D10 READ_WRITE /end MEASUREMENT
/begin MEASUREMENT afODCANASC "0:要求無し  1:要求有り" UBYTE COMP_0283 1 100 0 1 BIT_MASK 0x0010 ECU_ADDRESS 0xFFFF3D10 READ_WRITE /end MEASUREMENT
/begin MEASUREMENT afONEACC "0:非加速中  1:一時加速中" UBYTE COMP_0283 1 100 0 1 BIT_MASK 0x0008 ECU_ADDRESS 0xFFFF3D10 READ_WRITE /end MEASUREMENT
/begin MEASUREMENT afONEACCRT "0:通常時  1:一時加速時" UBYTE COMP_0283 1 100 0 1 BIT_MASK 0x0004 ECU_ADDRESS 0xFFFF3D10 READ_WRITE /end MEASUREMENT
/begin MEASUREMENT afONEACSBS "0:停止判定不成立  1:停止判定成立" UBYTE COMP_0283 1 100 0 1 BIT_MASK 0x0002 ECU_ADDRESS 0xFFFF3D10 READ_WRITE /end MEASUREMENT
/begin MEASUREMENT afOUTOFF "0:通常制御  1:セルフシャットオフ以外出力OFF" UBYTE COMP_0283 1 100 0 1 BIT_MASK 0x0001 ECU_ADDRESS 0xFFFF3D10 READ_WRITE /end MEASUREMENT
/begin MEASUREMENT afOVHJUG "0:ｵｰﾊﾞｰﾋｰﾄ条件不成立  1:ｵｰﾊﾞｰﾋｰﾄ条件成立" UBYTE COMP_0283 1 100 0 1 BIT_MASK 0x0080 ECU_ADDRESS 0xFFFF3D11 READ_WRITE /end MEASUREMENT
/begin MEASUREMENT afPDCUT "0:A/C_Pd圧カット信号OFF  1:A/C_Pd圧カット信号OFF" UBYTE COMP_0283 1 100 0 1 BIT_MASK 0x0040 ECU_ADDRESS 0xFFFF3D11 READ_WRITE /end MEASUREMENT
/begin MEASUREMENT afPKINSHI "0:不成立  1:成立" UBYTE COMP_0283 1 100 0 1 BIT_MASK 0x0020 ECU_ADDRESS 0xFFFF3D11 READ_WRITE /end MEASUREMENT
/begin MEASUREMENT afREQREV "0:回転数制御非実行  1:回転数制御実行" UBYTE COMP_0283 1 100 0 1 BIT_MASK 0x0010 ECU_ADDRESS 0xFFFF3D11 READ_WRITE /end MEASUREMENT
/begin MEASUREMENT afRSTNGINC "0:未経験  1:経験" UBYTE COMP_0283 1 100 0 1 BIT_MASK 0x0008 ECU_ADDRESS 0xFFFF3D11 READ_WRITE /end MEASUREMENT
/begin MEASUREMENT afRTASTCV "0:急速TAS学習値ｸﾘｱ未終了  1:急速TAS学習値ｸﾘｱ終了" UBYTE COMP_0283 1 100 0 1 BIT_MASK 0x0004 ECU_ADDRESS 0xFFFF3D11 READ_WRITE /end MEASUREMENT
/begin MEASUREMENT afRTRMISST "0:右以外  1:I/S禁止要求" UBYTE COMP_0283 1 100 0 1 BIT_MASK 0x0002 ECU_ADDRESS 0xFFFF3D11 READ_WRITE /end MEASUREMENT
/begin MEASUREMENT afSETLMP "0:ｾｯﾄﾗﾝﾌﾟ消灯  1:ｾｯﾄﾗﾝﾌﾟ点灯" UBYTE COMP_0283 1 100 0 1 BIT_MASK 0x0001 ECU_ADDRESS 0xFFFF3D11 READ_WRITE /end MEASUREMENT
/begin MEASUREMENT afSETLMPON "0:ｾｯﾄﾗﾝﾌﾟ消灯  1:ｾｯﾄﾗﾝﾌﾟ点灯" UBYTE COMP_0283 1 100 0 1 BIT_MASK 0x0080 ECU_ADDRESS 0xFFFF3D12 READ_WRITE /end MEASUREMENT
/begin MEASUREMENT afSGADVON "0:車両サージ非検出  1:車両サージ検出" UBYTE COMP_0283 1 100 0 1 BIT_MASK 0x0040 ECU_ADDRESS 0xFFFF3D12 READ_WRITE /end MEASUREMENT
/begin MEASUREMENT afSGON "0:SGADV制御停止  1:SGADV制御開始" UBYTE COMP_0283 1 100 0 1 BIT_MASK 0x0020 ECU_ADDRESS 0xFFFF3D12 READ_WRITE /end MEASUREMENT
/begin MEASUREMENT afSLARBON "0:vTTESL_≦_vTTEPTD  1:vTTESL_>_vTTEPTD" UBYTE COMP_0283 1 100 0 1 BIT_MASK 0x0010 ECU_ADDRESS 0xFFFF3D12 READ_WRITE /end MEASUREMENT
/begin MEASUREMENT afSLFCCTRL "0:ｽﾋﾟｰﾄﾞﾘﾐｯﾀ降板時でない  1:ｽﾋﾟｰﾄﾞﾘﾐｯﾀ降板時" UBYTE COMP_0283 1 100 0 1 BIT_MASK 0x0008 ECU_ADDRESS 0xFFFF3D12 READ_WRITE /end MEASUREMENT
/begin MEASUREMENT afSLON "0:制御OFF  1:制御ON" UBYTE COMP_0283 1 100 0 1 BIT_MASK 0x0004 ECU_ADDRESS 0xFFFF3D12 READ_WRITE /end MEASUREMENT
/begin MEASUREMENT afSLSTATUS "0:右記以外  1:スピードリミッタトルク制御中" UBYTE COMP_0283 1 100 0 1 BIT_MASK 0x0002 ECU_ADDRESS 0xFFFF3D12 READ_WRITE /end MEASUREMENT
/begin MEASUREMENT afSPDCTINH "0:右記以外  1:回転数制御禁止中" UBYTE COMP_0283 1 100 0 1 BIT_MASK 0x0001 ECU_ADDRESS 0xFFFF3D12 READ_WRITE /end MEASUREMENT
/begin MEASUREMENT afSRVOINI2 "0:車速ｻｰﾎﾞ初期化済み  1:車速ｻｰﾎﾞ初期化要求" UBYTE COMP_0283 1 100 0 1 BIT_MASK 0x0080 ECU_ADDRESS 0xFFFF3D13 READ_WRITE /end MEASUREMENT
/begin MEASUREMENT afSRVOINI3 "0:車速ｻｰﾎﾞ初期化済み  1:車速ｻｰﾎﾞ初期化要求" UBYTE COMP_0283 1 100 0 1 BIT_MASK 0x0040 ECU_ADDRESS 0xFFFF3D13 READ_WRITE /end MEASUREMENT
/begin MEASUREMENT afSTROFNG "0:fSTMST=1がTMSTRLY2#以上継続  1:fSTMST=0がTMSTRLY1#以上継続" UBYTE COMP_0283 1 100 0 1 BIT_MASK 0x0020 ECU_ADDRESS 0xFFFF3D13 READ_WRITE /end MEASUREMENT
/begin MEASUREMENT afSTRONNG "0:fSTMST=0がTMSTRLY4#以上継続  1:fSTMST=1がTMSTRLY3#以上継続" UBYTE COMP_0283 1 100 0 1 BIT_MASK 0x0010 ECU_ADDRESS 0xFFFF3D13 READ_WRITE /end MEASUREMENT
/begin MEASUREMENT afTHCHGST "0:カウント中止  1:カウント開始" UBYTE COMP_0283 1 100 0 1 BIT_MASK 0x0008 ECU_ADDRESS 0xFFFF3D13 READ_WRITE /end MEASUREMENT
/begin MEASUREMENT afTPOUOV "0:正常  1:ｵｰﾊﾞｰ" UBYTE COMP_0283 1 100 0 1 BIT_MASK 0x0004 ECU_ADDRESS 0xFFFF3D13 READ_WRITE /end MEASUREMENT
/begin MEASUREMENT afTQARBTON "0:トルクインターシステム作動なし  1:トルクインターシステム作動あり" UBYTE COMP_0283 1 100 0 1 BIT_MASK 0x0002 ECU_ADDRESS 0xFFFF3D13 READ_WRITE /end MEASUREMENT
/begin MEASUREMENT afTXFS1 "0:TCS/VDCｼｽﾃﾑ正常  1:TCS/VDCｼｽﾃﾑ異常" UBYTE COMP_0283 1 100 0 1 BIT_MASK 0x0001 ECU_ADDRESS 0xFFFF3D13 READ_WRITE /end MEASUREMENT
/begin MEASUREMENT afTXFS2 "0:TCS/VDCｼｽﾃﾑ正常  1:TCS/VDCｼｽﾃﾑ異常" UBYTE COMP_0283 1 100 0 1 BIT_MASK 0x0080 ECU_ADDRESS 0xFFFF3D14 READ_WRITE /end MEASUREMENT
/begin MEASUREMENT afVCLEAN2 "0:クリーニングモード非実行中  1:クリーニングモード実行中" UBYTE COMP_0283 1 100 0 1 BIT_MASK 0x0040 ECU_ADDRESS 0xFFFF3D14 READ_WRITE /end MEASUREMENT
/begin MEASUREMENT afVCLEAN2E "0:クリーニングモード非実行中  1:クリーニングモード実行中" UBYTE COMP_0283 1 100 0 1 BIT_MASK 0x0020 ECU_ADDRESS 0xFFFF3D14 READ_WRITE /end MEASUREMENT
/begin MEASUREMENT afVSPOVER "0:点滅無  1:点滅有" UBYTE COMP_0283 1 100 0 1 BIT_MASK 0x0010 ECU_ADDRESS 0xFFFF3D14 READ_WRITE /end MEASUREMENT
/begin MEASUREMENT afVSPSHL "0:PTD車速ｾﾝｻ整合  1:PTD車速ｾﾝｻ不整合" UBYTE COMP_0283 1 100 0 1 BIT_MASK 0x0008 ECU_ADDRESS 0xFFFF3D14 READ_WRITE /end MEASUREMENT
/begin MEASUREMENT afVTCMEON "0:要求なし  1:要求あり" UBYTE COMP_0283 1 100 0 1 BIT_MASK 0x0004 ECU_ADDRESS 0xFFFF3D14 READ_WRITE /end MEASUREMENT
/begin MEASUREMENT afVTCMION "0:要求なし  1:要求あり" UBYTE COMP_0283 1 100 0 1 BIT_MASK 0x0002 ECU_ADDRESS 0xFFFF3D14 READ_WRITE /end MEASUREMENT
/begin MEASUREMENT afVTDGN1SE "0:不成立  1:成立" UBYTE COMP_0283 1 100 0 1 BIT_MASK 0x0001 ECU_ADDRESS 0xFFFF3D14 READ_WRITE /end MEASUREMENT
/begin MEASUREMENT afVTDGN2SE "0:不成立  1:成立" UBYTE COMP_0283 1 100 0 1 BIT_MASK 0x0080 ECU_ADDRESS 0xFFFF3D15 READ_WRITE /end MEASUREMENT
/begin MEASUREMENT afASCACT_S "0:OFF  1:ON" UBYTE COMP_0283 1 100 0 1 BIT_MASK 0x0040 ECU_ADDRESS 0xFFFF3D15 READ_WRITE /end MEASUREMENT
/begin MEASUREMENT afCRUIS2_S "0:OFF  1:ON" UBYTE COMP_0283 1 100 0 1 BIT_MASK 0x0020 ECU_ADDRESS 0xFFFF3D15 READ_WRITE /end MEASUREMENT
/begin MEASUREMENT afDARBON_S "0:非作動中  1:作動中" UBYTE COMP_0283 1 100 0 1 BIT_MASK 0x0010 ECU_ADDRESS 0xFFFF3D15 READ_WRITE /end MEASUREMENT
/begin MEASUREMENT afETCFAL_S "0:正常  1:異常" UBYTE COMP_0283 1 100 0 1 BIT_MASK 0x0008 ECU_ADDRESS 0xFFFF3D15 READ_WRITE /end MEASUREMENT
/begin MEASUREMENT afETCOFF_S "0:非実行  1:実行" UBYTE COMP_0283 1 100 0 1 BIT_MASK 0x0004 ECU_ADDRESS 0xFFFF3D15 READ_WRITE /end MEASUREMENT
/begin MEASUREMENT afTARBON_S "0:トルクインターシステム作動なし  1:トルクインターシステム作動あり" UBYTE COMP_0283 1 100 0 1 BIT_MASK 0x0002 ECU_ADDRESS 0xFFFF3D15 READ_WRITE /end MEASUREMENT
/begin MEASUREMENT fADJDDL "0:点火時期、エンジン回転数調整共通  1:点火時期、エンジン回転数調整共通" UBYTE COMP_0283 1 100 0 1 BIT_MASK 0x0080 ECU_ADDRESS 0xFFFF3D16 READ_WRITE /end MEASUREMENT
/begin MEASUREMENT fADVCYO "0:点火時期調整でない  1:点火時期調整である" UBYTE COMP_0283 1 100 0 1 BIT_MASK 0x0040 ECU_ADDRESS 0xFFFF3D16 READ_WRITE /end MEASUREMENT
/begin MEASUREMENT fADVDDL "0:点火時期調整でない  1:点火時期調整である" UBYTE COMP_0283 1 100 0 1 BIT_MASK 0x0020 ECU_ADDRESS 0xFFFF3D16 READ_WRITE /end MEASUREMENT
/begin MEASUREMENT fAFSDST2 "0:要求なし  1:要求あり" UBYTE COMP_0283 1 100 0 1 BIT_MASK 0x0010 ECU_ADDRESS 0xFFFF3D16 READ_WRITE /end MEASUREMENT
/begin MEASUREMENT fAGBACK "0:AGB要求不許可  1:AGB要求許可" UBYTE COMP_0283 1 100 0 1 BIT_MASK 0x0008 ECU_ADDRESS 0xFFFF3D16 READ_WRITE /end MEASUREMENT
/begin MEASUREMENT fAGBCANNG "0:OK  1:NG" UBYTE COMP_0283 1 100 0 1 BIT_MASK 0x0004 ECU_ADDRESS 0xFFFF3D16 READ_WRITE /end MEASUREMENT
/begin MEASUREMENT fAGBLNKNG "0:OK  1:NG" UBYTE COMP_0283 1 100 0 1 BIT_MASK 0x0002 ECU_ADDRESS 0xFFFF3D16 READ_WRITE /end MEASUREMENT
/begin MEASUREMENT fALTCNT "0:オルタネータ発電電圧可変制御禁止  1:オルタネータ発電電圧可変制御許可" UBYTE COMP_0283 1 100 0 1 BIT_MASK 0x0001 ECU_ADDRESS 0xFFFF3D16 READ_WRITE /end MEASUREMENT
/begin MEASUREMENT fAPLHACT "0:not_active  1:active" UBYTE COMP_0283 1 100 0 1 BIT_MASK 0x0080 ECU_ADDRESS 0xFFFF3D17 READ_WRITE /end MEASUREMENT
/begin MEASUREMENT fAPS1CA "0:正常  1:警戒(過渡NG)" UBYTE COMP_0283 1 100 0 1 BIT_MASK 0x0040 ECU_ADDRESS 0xFFFF3D17 READ_WRITE /end MEASUREMENT
/begin MEASUREMENT fAPS2CA "0:正常  1:警戒(過渡NG)" UBYTE COMP_0283 1 100 0 1 BIT_MASK 0x0020 ECU_ADDRESS 0xFFFF3D17 READ_WRITE /end MEASUREMENT
/begin MEASUREMENT fAPSDBLCA "0:APS二重目CA判定なし  1:APS二重目CA判定あり" UBYTE COMP_0283 1 100 0 1 BIT_MASK 0x0010 ECU_ADDRESS 0xFFFF3D17 READ_WRITE /end MEASUREMENT
/begin MEASUREMENT fASCDC5SW "0:5連照合結果Low  1:5連照合結果High" UBYTE COMP_0283 1 100 0 1 BIT_MASK 0x0008 ECU_ADDRESS 0xFFFF3D17 READ_WRITE /end MEASUREMENT
/begin MEASUREMENT fASCDFAIL "0:ﾌｪｲﾙ  1:未ﾌｪｲﾙ" UBYTE COMP_0283 1 100 0 1 BIT_MASK 0x0004 ECU_ADDRESS 0xFFFF3D17 READ_WRITE /end MEASUREMENT
/begin MEASUREMENT fASCDNEUT "0:5連照合結果Low  1:5連照合結果High" UBYTE COMP_0283 1 100 0 1 BIT_MASK 0x0002 ECU_ADDRESS 0xFFFF3D17 READ_WRITE /end MEASUREMENT
/begin MEASUREMENT fATTRQNG2 "0:正常  1:異常" UBYTE COMP_0283 1 100 0 1 BIT_MASK 0x0001 ECU_ADDRESS 0xFFFF3D17 READ_WRITE /end MEASUREMENT
/begin MEASUREMENT fBASERR "0:不成立  1:成立" UBYTE COMP_0283 1 100 0 1 BIT_MASK 0x0080 ECU_ADDRESS 0xFFFF3D18 READ_WRITE /end MEASUREMENT
/begin MEASUREMENT fBCDCV "0:CDCV開  1:CDCV閉" UBYTE COMP_0283 1 100 0 1 BIT_MASK 0x0040 ECU_ADDRESS 0xFFFF3D18 READ_WRITE /end MEASUREMENT
/begin MEASUREMENT fBCVBV "0:CVBV閉  1:CVBV開" UBYTE COMP_0283 1 100 0 1 BIT_MASK 0x0020 ECU_ADDRESS 0xFFFF3D18 READ_WRITE /end MEASUREMENT
/begin MEASUREMENT fBIDETCCOK "0:ETC学習クリア未終了  1:ETC学習クリア終了" UBYTE COMP_0283 1 100 0 1 BIT_MASK 0x0010 ECU_ADDRESS 0xFFFF3D18 READ_WRITE /end MEASUREMENT
/begin MEASUREMENT fBIDFFDCOK "0:裏FFDクリア未終了  1:裏FFDクリア終了" UBYTE COMP_0283 1 100 0 1 BIT_MASK 0x0008 ECU_ADDRESS 0xFFFF3D18 READ_WRITE /end MEASUREMENT
/begin MEASUREMENT fBIDNTASOK "0:通常TAS学習クリア未終了  1:通常TAS学習クリア終了" UBYTE COMP_0283 1 100 0 1 BIT_MASK 0x0004 ECU_ADDRESS 0xFFFF3D18 READ_WRITE /end MEASUREMENT
/begin MEASUREMENT fBIDRTASOK "0:急速TAS学習クリア未終了  1:急速TAS学習クリア終了" UBYTE COMP_0283 1 100 0 1 BIT_MASK 0x0002 ECU_ADDRESS 0xFFFF3D18 READ_WRITE /end MEASUREMENT
/begin MEASUREMENT fBNCSW "0:5連照合結果Low  1:5連照合結果High" UBYTE COMP_0283 1 100 0 1 BIT_MASK 0x0001 ECU_ADDRESS 0xFFFF3D18 READ_WRITE /end MEASUREMENT
/begin MEASUREMENT fBNOSW "0:5連照合結果Low  1:5連照合結果High" UBYTE COMP_0283 1 100 0 1 BIT_MASK 0x0080 ECU_ADDRESS 0xFFFF3D19 READ_WRITE /end MEASUREMENT
/begin MEASUREMENT fBPFS_NC "0:5連照合結果Low  1:5連照合結果High" UBYTE COMP_0283 1 100 0 1 BIT_MASK 0x0040 ECU_ADDRESS 0xFFFF3D19 READ_WRITE /end MEASUREMENT
/begin MEASUREMENT fBPFS_NO "0:5連照合結果Low  1:5連照合結果High" UBYTE COMP_0283 1 100 0 1 BIT_MASK 0x0020 ECU_ADDRESS 0xFFFF3D19 READ_WRITE /end MEASUREMENT
/begin MEASUREMENT fBRKSWCA1 "0:CA1判定なし  1:CA1判定あり" UBYTE COMP_0283 1 100 0 1 BIT_MASK 0x0010 ECU_ADDRESS 0xFFFF3D19 READ_WRITE /end MEASUREMENT
/begin MEASUREMENT fBRKSWCA2 "0:CA2判定なし  1:CA2判定あり" UBYTE COMP_0283 1 100 0 1 BIT_MASK 0x0008 ECU_ADDRESS 0xFFFF3D19 READ_WRITE /end MEASUREMENT
/begin MEASUREMENT fBRKSWCA3 "0:CA3判定なし  1:CA3判定あり" UBYTE COMP_0283 1 100 0 1 BIT_MASK 0x0004 ECU_ADDRESS 0xFFFF3D19 READ_WRITE /end MEASUREMENT
/begin MEASUREMENT fCRUISE "0:非ｸﾙｰｽﾞ中  1:ｸﾙｰｽﾞ中" UBYTE COMP_0283 1 100 0 1 BIT_MASK 0x0002 ECU_ADDRESS 0xFFFF3D19 READ_WRITE /end MEASUREMENT
/begin MEASUREMENT fCUTLNOP "0:正常  1:異常" UBYTE COMP_0283 1 100 0 1 BIT_MASK 0x0001 ECU_ADDRESS 0xFFFF3D19 READ_WRITE /end MEASUREMENT
/begin MEASUREMENT fCUTLNSH "0:正常  1:異常" UBYTE COMP_0283 1 100 0 1 BIT_MASK 0x0080 ECU_ADDRESS 0xFFFF3D1A READ_WRITE /end MEASUREMENT
/begin MEASUREMENT fD2ALSTPD "0:通常制御中  1:停止中" UBYTE COMP_0283 1 100 0 1 BIT_MASK 0x0040 ECU_ADDRESS 0xFFFF3D1A READ_WRITE /end MEASUREMENT
/begin MEASUREMENT fD2LNCLED "0:ｸﾘｱ未終了  1:ｸﾘｱ終了" UBYTE COMP_0283 1 100 0 1 BIT_MASK 0x0020 ECU_ADDRESS 0xFFFF3D1A READ_WRITE /end MEASUREMENT
/begin MEASUREMENT fDAPSNG "0:NG/FS非判定中  1:NG/FS判定中" UBYTE COMP_0283 1 100 0 1 BIT_MASK 0x0010 ECU_ADDRESS 0xFFFF3D1A READ_WRITE /end MEASUREMENT
/begin MEASUREMENT fDATACLR "0:診断用パラメータ消去解除  1:診断用パラメータ消去要求" UBYTE COMP_0283 1 100 0 1 BIT_MASK 0x0008 ECU_ADDRESS 0xFFFF3D1A READ_WRITE /end MEASUREMENT
/begin MEASUREMENT fDCPUNG "0:CPUNGなし  1:CPUNGあり" UBYTE COMP_0283 1 100 0 1 BIT_MASK 0x0004 ECU_ADDRESS 0xFFFF3D1A READ_WRITE /end MEASUREMENT
/begin MEASUREMENT fDRARBTON "0:バーチャルドライバ未作動  1:バーチャルドライバ作動中" UBYTE COMP_0283 1 100 0 1 BIT_MASK 0x0002 ECU_ADDRESS 0xFFFF3D1A READ_WRITE /end MEASUREMENT
/begin MEASUREMENT fDTNG "0:A/T信号線正常  1:A/T信号線異常" UBYTE COMP_0283 1 100 0 1 BIT_MASK 0x0001 ECU_ADDRESS 0xFFFF3D1A READ_WRITE /end MEASUREMENT
/begin MEASUREMENT fDTVONG "0:NG/FS非判定中  1:NG/FS判定中" UBYTE COMP_0283 1 100 0 1 BIT_MASK 0x0080 ECU_ADDRESS 0xFFFF3D1B READ_WRITE /end MEASUREMENT
/begin MEASUREMENT fDTYHOLDE "0:0%固定  1:100%固定" UBYTE COMP_0283 1 100 0 1 BIT_MASK 0x0040 ECU_ADDRESS 0xFFFF3D1B READ_WRITE /end MEASUREMENT
/begin MEASUREMENT fDUTYHOLD "0:0%固定  1:100%固定" UBYTE COMP_0283 1 100 0 1 BIT_MASK 0x0020 ECU_ADDRESS 0xFFFF3D1B READ_WRITE /end MEASUREMENT
/begin MEASUREMENT fEEPRWNG "0:EEPROM_NGでない  1:EEPROM_NG" UBYTE COMP_0283 1 100 0 1 BIT_MASK 0x0010 ECU_ADDRESS 0xFFFF3D1B READ_WRITE /end MEASUREMENT
/begin MEASUREMENT fENSTSS "0:右記以外  1:エンスト" UBYTE COMP_0283 1 100 0 1 BIT_MASK 0x0008 ECU_ADDRESS 0xFFFF3D1B READ_WRITE /end MEASUREMENT
/begin MEASUREMENT fESPACK "0:ESP不許可  1:ESP許可" UBYTE COMP_0283 1 100 0 1 BIT_MASK 0x0004 ECU_ADDRESS 0xFFFF3D1B READ_WRITE /end MEASUREMENT
/begin MEASUREMENT fETCFAIL "0:正常  1:異常" UBYTE COMP_0283 1 100 0 1 BIT_MASK 0x0002 ECU_ADDRESS 0xFFFF3D1B READ_WRITE /end MEASUREMENT
/begin MEASUREMENT fETSACK "0:ETS不許可  1:ETS許可" UBYTE COMP_0283 1 100 0 1 BIT_MASK 0x0001 ECU_ADDRESS 0xFFFF3D1B READ_WRITE /end MEASUREMENT
/begin MEASUREMENT fEVPCLS "0:不許可  1:許可" UBYTE COMP_0283 1 100 0 1 BIT_MASK 0x0080 ECU_ADDRESS 0xFFFF3D1C READ_WRITE /end MEASUREMENT
/begin MEASUREMENT fFAREAA "0:Ａ領域以外  1:Ａ領域" UBYTE COMP_0283 1 100 0 1 BIT_MASK 0x0040 ECU_ADDRESS 0xFFFF3D1C READ_WRITE /end MEASUREMENT
/begin MEASUREMENT fFAREAC "0:Ｃ領域以外  1:Ｃ領域" UBYTE COMP_0283 1 100 0 1 BIT_MASK 0x0020 ECU_ADDRESS 0xFFFF3D1C READ_WRITE /end MEASUREMENT
/begin MEASUREMENT fFCNCASCD "0:ASCD時ｶｯﾄなし  1:ASCD時ｶｯﾄあり" UBYTE COMP_0283 1 100 0 1 BIT_MASK 0x0010 ECU_ADDRESS 0xFFFF3D1C READ_WRITE /end MEASUREMENT
/begin MEASUREMENT fFEVLKR "0:右記以外  1:空然比学習禁止" UBYTE COMP_0283 1 100 0 1 BIT_MASK 0x0008 ECU_ADDRESS 0xFFFF3D1C READ_WRITE /end MEASUREMENT
/begin MEASUREMENT fFFDCLRF "0:不成立  1:成立" UBYTE COMP_0283 1 100 0 1 BIT_MASK 0x0004 ECU_ADDRESS 0xFFFF3D1C READ_WRITE /end MEASUREMENT
/begin MEASUREMENT fFGPDGN "0:燃料ﾚﾍﾞﾙｹﾞｰｼﾞ機能診断許可条件不  1:燃料ﾚﾍﾞﾙｹﾞｰｼﾞ機能診断許可条件成" UBYTE COMP_0283 1 100 0 1 BIT_MASK 0x0002 ECU_ADDRESS 0xFFFF3D1C READ_WRITE /end MEASUREMENT
/begin MEASUREMENT fFLAIR "0:要求有り  1:要求無し" UBYTE COMP_0283 1 100 0 1 BIT_MASK 0x0001 ECU_ADDRESS 0xFFFF3D1C READ_WRITE /end MEASUREMENT
/begin MEASUREMENT fFLBURN "0:要求有り  1:要求無し" UBYTE COMP_0283 1 100 0 1 BIT_MASK 0x0080 ECU_ADDRESS 0xFFFF3D1D READ_WRITE /end MEASUREMENT
/begin MEASUREMENT fFLFUEL "0:要求有り  1:要求無し" UBYTE COMP_0283 1 100 0 1 BIT_MASK 0x0040 ECU_ADDRESS 0xFFFF3D1D READ_WRITE /end MEASUREMENT
/begin MEASUREMENT fFLIGN "0:要求有り  1:要求無し" UBYTE COMP_0283 1 100 0 1 BIT_MASK 0x0020 ECU_ADDRESS 0xFFFF3D1D READ_WRITE /end MEASUREMENT
/begin MEASUREMENT fFMFJAR "0:失火診断禁止  1:失火診断許可" UBYTE COMP_0283 1 100 0 1 BIT_MASK 0x0010 ECU_ADDRESS 0xFFFF3D1D READ_WRITE /end MEASUREMENT
/begin MEASUREMENT fFMFJAR2 "0:不成立  1:成立" UBYTE COMP_0283 1 100 0 1 BIT_MASK 0x0008 ECU_ADDRESS 0xFFFF3D1D READ_WRITE /end MEASUREMENT
/begin MEASUREMENT fFMILBR "0:MIL消灯要求  1:失火MIL点滅要求有り" UBYTE COMP_0283 1 100 0 1 BIT_MASK 0x0004 ECU_ADDRESS 0xFFFF3D1D READ_WRITE /end MEASUREMENT
/begin MEASUREMENT fFMPTRN "0:許可  1:禁止" UBYTE COMP_0283 1 100 0 1 BIT_MASK 0x0002 ECU_ADDRESS 0xFFFF3D1D READ_WRITE /end MEASUREMENT
/begin MEASUREMENT fFMRCPT "0:不成立  1:成立" UBYTE COMP_0283 1 100 0 1 BIT_MASK 0x0001 ECU_ADDRESS 0xFFFF3D1D READ_WRITE /end MEASUREMENT
/begin MEASUREMENT fFOPWRN "0:右記以外  1:油圧警告灯点灯" UBYTE COMP_0283 1 100 0 1 BIT_MASK 0x0080 ECU_ADDRESS 0xFFFF3D1E READ_WRITE /end MEASUREMENT
/begin MEASUREMENT fFQCDLY "0:不成立  1:成立" UBYTE COMP_0283 1 100 0 1 BIT_MASK 0x0040 ECU_ADDRESS 0xFFFF3D1E READ_WRITE /end MEASUREMENT
/begin MEASUREMENT fFQLRNED "0:未終了  1:終了" UBYTE COMP_0283 1 100 0 1 BIT_MASK 0x0020 ECU_ADDRESS 0xFFFF3D1E READ_WRITE /end MEASUREMENT
/begin MEASUREMENT fFREV "0:ｴﾝｼﾞﾝ回転数400rpm以上  1:ｴﾝｼﾞﾝ回転数400rpm未満" UBYTE COMP_0283 1 100 0 1 BIT_MASK 0x0010 ECU_ADDRESS 0xFFFF3D1E READ_WRITE /end MEASUREMENT
/begin MEASUREMENT fFRWIPD "0:ワイパ＿off  1:ワイパ＿on" UBYTE COMP_0283 1 100 0 1 BIT_MASK 0x0008 ECU_ADDRESS 0xFFFF3D1E READ_WRITE /end MEASUREMENT
/begin MEASUREMENT fFSTR "0:均質  1:成層" UBYTE COMP_0283 1 100 0 1 BIT_MASK 0x0004 ECU_ADDRESS 0xFFFF3D1E READ_WRITE /end MEASUREMENT
/begin MEASUREMENT fFSTRETYU "0:右記以外  1:切り替え中" UBYTE COMP_0283 1 100 0 1 BIT_MASK 0x0002 ECU_ADDRESS 0xFFFF3D1E READ_WRITE /end MEASUREMENT
/begin MEASUREMENT fFSTRETYV "0:右記以外  1:均質->成層始動切り替え中" UBYTE COMP_0283 1 100 0 1 BIT_MASK 0x0001 ECU_ADDRESS 0xFFFF3D1E READ_WRITE /end MEASUREMENT
/begin MEASUREMENT fFSTRSTEN "0:右記以外  1:成層始動中および切り替え中" UBYTE COMP_0283 1 100 0 1 BIT_MASK 0x0080 ECU_ADDRESS 0xFFFF3D1F READ_WRITE /end MEASUREMENT
/begin MEASUREMENT fFSTRSTOK "0:右記以外  1:成層始動許可" UBYTE COMP_0283 1 100 0 1 BIT_MASK 0x0040 ECU_ADDRESS 0xFFFF3D1F READ_WRITE /end MEASUREMENT
/begin MEASUREMENT fFTCVTRG "0:実行中でない  1:実行中" UBYTE COMP_0283 1 100 0 1 BIT_MASK 0x0020 ECU_ADDRESS 0xFFFF3D1F READ_WRITE /end MEASUREMENT
/begin MEASUREMENT fFTCVTRS "0:テスト保留でない  1:テスト保留" UBYTE COMP_0283 1 100 0 1 BIT_MASK 0x0010 ECU_ADDRESS 0xFFFF3D1F READ_WRITE /end MEASUREMENT
/begin MEASUREMENT fFTCVTRSS "0:故障判定中でない  1:故障判定中" UBYTE COMP_0283 1 100 0 1 BIT_MASK 0x0008 ECU_ADDRESS 0xFFFF3D1F READ_WRITE /end MEASUREMENT
/begin MEASUREMENT fFTMTRP "0:ｴﾝｼﾞﾝ回転継続時間経過  1:ｴﾝｼﾞﾝ回転継続時間未経過" UBYTE COMP_0283 1 100 0 1 BIT_MASK 0x0004 ECU_ADDRESS 0xFFFF3D1F READ_WRITE /end MEASUREMENT
/begin MEASUREMENT fFTPCHG "0:Not＿decelerating  1:decelerating" UBYTE COMP_0283 1 100 0 1 BIT_MASK 0x0002 ECU_ADDRESS 0xFFFF3D1F READ_WRITE /end MEASUREMENT
/begin MEASUREMENT fFTPCHK "0:Not＿acceleration  1:Acceleration" UBYTE COMP_0283 1 100 0 1 BIT_MASK 0x0001 ECU_ADDRESS 0xFFFF3D1F READ_WRITE /end MEASUREMENT
/begin MEASUREMENT fFTPCHOK "0:Not＿permission  1:Permission" UBYTE COMP_0283 1 100 0 1 BIT_MASK 0x0080 ECU_ADDRESS 0xFFFF3D20 READ_WRITE /end MEASUREMENT
/begin MEASUREMENT fFTRIP1 "0:ﾄﾘｯﾌﾟ1突入済み  1:ﾄﾘｯﾌﾟ1未突入" UBYTE COMP_0283 1 100 0 1 BIT_MASK 0x0040 ECU_ADDRESS 0xFFFF3D20 READ_WRITE /end MEASUREMENT
/begin MEASUREMENT fFTRIP11 "0:ﾄﾘｯﾌﾟ11未突入  1:ﾄﾘｯﾌﾟ11突入済み" UBYTE COMP_0283 1 100 0 1 BIT_MASK 0x0020 ECU_ADDRESS 0xFFFF3D20 READ_WRITE /end MEASUREMENT
/begin MEASUREMENT fFTRIP2 "0:ﾄﾘｯﾌﾟ2突入済み  1:ﾄﾘｯﾌﾟ2未突入" UBYTE COMP_0283 1 100 0 1 BIT_MASK 0x0010 ECU_ADDRESS 0xFFFF3D20 READ_WRITE /end MEASUREMENT
/begin MEASUREMENT fFTRIP3 "0:ﾄﾘｯﾌﾟ3突入済み  1:ﾄﾘｯﾌﾟ3未突入" UBYTE COMP_0283 1 100 0 1 BIT_MASK 0x0008 ECU_ADDRESS 0xFFFF3D20 READ_WRITE /end MEASUREMENT
/begin MEASUREMENT fFTSTRANS "0:上記以外  1:ﾀｰﾎﾞSOFIS用加速判定中" UBYTE COMP_0283 1 100 0 1 BIT_MASK 0x0004 ECU_ADDRESS 0xFFFF3D20 READ_WRITE /end MEASUREMENT
/begin MEASUREMENT fFTW70 "0:現在水温70℃以上  1:現在水温70℃未満" UBYTE COMP_0283 1 100 0 1 BIT_MASK 0x0002 ECU_ADDRESS 0xFFFF3D20 READ_WRITE /end MEASUREMENT
/begin MEASUREMENT fFTWI20 "0:始動時現在水温差20℃以上  1:始動時現在水温差20℃未満" UBYTE COMP_0283 1 100 0 1 BIT_MASK 0x0001 ECU_ADDRESS 0xFFFF3D20 READ_WRITE /end MEASUREMENT
/begin MEASUREMENT fGKPGOK "0:不成立  1:成立" UBYTE COMP_0283 1 100 0 1 BIT_MASK 0x0080 ECU_ADDRESS 0xFFFF3D21 READ_WRITE /end MEASUREMENT
/begin MEASUREMENT fGNTRP "0:ｴﾝｼﾞﾝ始動後GNRTRPｶｳﾝﾀｶｳﾝﾄしてい  1:ｴﾝｼﾞﾝ始動後GNRTRPｶｳﾝﾀｶｳﾝﾄした" UBYTE COMP_0283 1 100 0 1 BIT_MASK 0x0040 ECU_ADDRESS 0xFFFF3D21 READ_WRITE /end MEASUREMENT
/begin MEASUREMENT fGSIDWN "0:DOWNシフト指示なし  1:DOWNシフト指示有り" UBYTE COMP_0283 1 100 0 1 BIT_MASK 0x0020 ECU_ADDRESS 0xFFFF3D21 READ_WRITE /end MEASUREMENT
/begin MEASUREMENT fGSIUP "0:UPシフト指示なし  1:UPシフト指示有り" UBYTE COMP_0283 1 100 0 1 BIT_MASK 0x0010 ECU_ADDRESS 0xFFFF3D21 READ_WRITE /end MEASUREMENT
/begin MEASUREMENT fHOTICST "0:カウント中止  1:カウント開始" UBYTE COMP_0283 1 100 0 1 BIT_MASK 0x0008 ECU_ADDRESS 0xFFFF3D21 READ_WRITE /end MEASUREMENT
/begin MEASUREMENT fHPDGNCND "0:不成立  1:成立" UBYTE COMP_0283 1 100 0 1 BIT_MASK 0x0004 ECU_ADDRESS 0xFFFF3D21 READ_WRITE /end MEASUREMENT
/begin MEASUREMENT fICRUISE "0:CRUISE=1  1:CRUISE=0" UBYTE COMP_0283 1 100 0 1 BIT_MASK 0x0002 ECU_ADDRESS 0xFFFF3D21 READ_WRITE /end MEASUREMENT
/begin MEASUREMENT fIHTONNG "0:fIHRST=0がTMIHRLY2#以上継続  1:fIHRST=1がTMIHRLY1#以上継続" UBYTE COMP_0283 1 100 0 1 BIT_MASK 0x0001 ECU_ADDRESS 0xFFFF3D21 READ_WRITE /end MEASUREMENT
/begin MEASUREMENT fLEDONR "0:失火MIL点滅要求無し  1:MIL点灯要求" UBYTE COMP_0283 1 100 0 1 BIT_MASK 0x0080 ECU_ADDRESS 0xFFFF3D22 READ_WRITE /end MEASUREMENT
/begin MEASUREMENT fLMDINI "0:フラグ成立しない  1:フラグ成立" UBYTE COMP_0283 1 100 0 1 BIT_MASK 0x0040 ECU_ADDRESS 0xFFFF3D22 READ_WRITE /end MEASUREMENT
/begin MEASUREMENT fMAINSW "0:ﾒｲﾝSW_OFF  1:ﾒｲﾝSW_ON" UBYTE COMP_0283 1 100 0 1 BIT_MASK 0x0020 ECU_ADDRESS 0xFFFF3D22 READ_WRITE /end MEASUREMENT
/begin MEASUREMENT fMAINSWSL "0:SLﾒｲﾝSW_OFF  1:SLﾒｲﾝSW_ON" UBYTE COMP_0283 1 100 0 1 BIT_MASK 0x0010 ECU_ADDRESS 0xFFFF3D22 READ_WRITE /end MEASUREMENT
/begin MEASUREMENT fMCMOUTC "0:無し  1:有り" UBYTE COMP_0283 1 100 0 1 BIT_MASK 0x0008 ECU_ADDRESS 0xFFFF3D22 READ_WRITE /end MEASUREMENT
/begin MEASUREMENT fMFCNDC "0:条件不成立  1:条件成立" UBYTE COMP_0283 1 100 0 1 BIT_MASK 0x0004 ECU_ADDRESS 0xFFFF3D22 READ_WRITE /end MEASUREMENT
/begin MEASUREMENT fMFCNDD "0:条件不成立  1:条件成立" UBYTE COMP_0283 1 100 0 1 BIT_MASK 0x0002 ECU_ADDRESS 0xFFFF3D22 READ_WRITE /end MEASUREMENT
/begin MEASUREMENT fMFCNDE "0:条件不成立  1:条件成立" UBYTE COMP_0283 1 100 0 1 BIT_MASK 0x0001 ECU_ADDRESS 0xFFFF3D22 READ_WRITE /end MEASUREMENT
/begin MEASUREMENT fMFCNDG "0:条件不成立  1:条件成立" UBYTE COMP_0283 1 100 0 1 BIT_MASK 0x0080 ECU_ADDRESS 0xFFFF3D23 READ_WRITE /end MEASUREMENT
/begin MEASUREMENT fMSRSTINH "0:MSR開始許可  1:MSR開始禁止" UBYTE COMP_0283 1 100 0 1 BIT_MASK 0x0040 ECU_ADDRESS 0xFFFF3D23 READ_WRITE /end MEASUREMENT
/begin MEASUREMENT fNIDLEINH "0:Nｱｲﾄﾞﾙ禁止ではない  1:Nｱｲﾄﾞﾙ禁止" UBYTE COMP_0283 1 100 0 1 BIT_MASK 0x0020 ECU_ADDRESS 0xFFFF3D23 READ_WRITE /end MEASUREMENT
/begin MEASUREMENT fODCANASC "0:要求無し  1:要求有り" UBYTE COMP_0283 1 100 0 1 BIT_MASK 0x0010 ECU_ADDRESS 0xFFFF3D23 READ_WRITE /end MEASUREMENT
/begin MEASUREMENT fONEACC "0:通常時  1:一時加速時" UBYTE COMP_0283 1 100 0 1 BIT_MASK 0x0008 ECU_ADDRESS 0xFFFF3D23 READ_WRITE /end MEASUREMENT
/begin MEASUREMENT fONEACCRT "0:通常時  1:一時加速時" UBYTE COMP_0283 1 100 0 1 BIT_MASK 0x0004 ECU_ADDRESS 0xFFFF3D23 READ_WRITE /end MEASUREMENT
/begin MEASUREMENT fONEACSBS "0:停止判定不成立  1:停止判定成立" UBYTE COMP_0283 1 100 0 1 BIT_MASK 0x0002 ECU_ADDRESS 0xFFFF3D23 READ_WRITE /end MEASUREMENT
/begin MEASUREMENT fOUTOFF "0:通常制御  1:セルフシャットオフ以外出力OFF" UBYTE COMP_0283 1 100 0 1 BIT_MASK 0x0001 ECU_ADDRESS 0xFFFF3D23 READ_WRITE /end MEASUREMENT
/begin MEASUREMENT fOVHJUG "0:ｵｰﾊﾞｰﾋｰﾄ条件不成立  1:ｵｰﾊﾞｰﾋｰﾄ条件成立" UBYTE COMP_0283 1 100 0 1 BIT_MASK 0x0080 ECU_ADDRESS 0xFFFF3D24 READ_WRITE /end MEASUREMENT
/begin MEASUREMENT fPDCUT "0:A/C_Pd圧カット信号OFF  1:A/C_Pd圧カット信号OFF" UBYTE COMP_0283 1 100 0 1 BIT_MASK 0x0040 ECU_ADDRESS 0xFFFF3D24 READ_WRITE /end MEASUREMENT
/begin MEASUREMENT fPKINSHI "0:不成立  1:成立" UBYTE COMP_0283 1 100 0 1 BIT_MASK 0x0020 ECU_ADDRESS 0xFFFF3D24 READ_WRITE /end MEASUREMENT
/begin MEASUREMENT fREQREV "0:回転数制御非実行  1:回転数制御実行" UBYTE COMP_0283 1 100 0 1 BIT_MASK 0x0010 ECU_ADDRESS 0xFFFF3D24 READ_WRITE /end MEASUREMENT
/begin MEASUREMENT fRSTNGINC "0:未経験  1:経験" UBYTE COMP_0283 1 100 0 1 BIT_MASK 0x0008 ECU_ADDRESS 0xFFFF3D24 READ_WRITE /end MEASUREMENT
/begin MEASUREMENT fRTASTCV "0:急速TAS学習値ｸﾘｱ未終了  1:急速TAS学習値ｸﾘｱ終了" UBYTE COMP_0283 1 100 0 1 BIT_MASK 0x0004 ECU_ADDRESS 0xFFFF3D24 READ_WRITE /end MEASUREMENT
/begin MEASUREMENT fRTRMISST "0:右以外  1:I/S禁止要求" UBYTE COMP_0283 1 100 0 1 BIT_MASK 0x0002 ECU_ADDRESS 0xFFFF3D24 READ_WRITE /end MEASUREMENT
/begin MEASUREMENT fSETLMP "0:ｾｯﾄﾗﾝﾌﾟ消灯  1:ｾｯﾄﾗﾝﾌﾟ点灯" UBYTE COMP_0283 1 100 0 1 BIT_MASK 0x0001 ECU_ADDRESS 0xFFFF3D24 READ_WRITE /end MEASUREMENT
/begin MEASUREMENT fSETLMPON "0:ｾｯﾄﾗﾝﾌﾟ消灯  1:ｾｯﾄﾗﾝﾌﾟ点灯" UBYTE COMP_0283 1 100 0 1 BIT_MASK 0x0080 ECU_ADDRESS 0xFFFF3D25 READ_WRITE /end MEASUREMENT
/begin MEASUREMENT fSGADVON "0:車両サージ非検出  1:車両サージ検出" UBYTE COMP_0283 1 100 0 1 BIT_MASK 0x0040 ECU_ADDRESS 0xFFFF3D25 READ_WRITE /end MEASUREMENT
/begin MEASUREMENT fSGON "0:SGADV制御停止  1:SGADV制御開始" UBYTE COMP_0283 1 100 0 1 BIT_MASK 0x0020 ECU_ADDRESS 0xFFFF3D25 READ_WRITE /end MEASUREMENT
/begin MEASUREMENT fSLARBON "0:vTTESL_≦_vTTEPTD  1:vTTESL_>_vTTEPTD" UBYTE COMP_0283 1 100 0 1 BIT_MASK 0x0010 ECU_ADDRESS 0xFFFF3D25 READ_WRITE /end MEASUREMENT
/begin MEASUREMENT fSLFCCTRL "0:ｽﾋﾟｰﾄﾞﾘﾐｯﾀ降板時でない  1:ｽﾋﾟｰﾄﾞﾘﾐｯﾀ降板時" UBYTE COMP_0283 1 100 0 1 BIT_MASK 0x0008 ECU_ADDRESS 0xFFFF3D25 READ_WRITE /end MEASUREMENT
/begin MEASUREMENT fSLON "0:制御OFF  1:制御ON" UBYTE COMP_0283 1 100 0 1 BIT_MASK 0x0004 ECU_ADDRESS 0xFFFF3D25 READ_WRITE /end MEASUREMENT
/begin MEASUREMENT fSLSTATUS "0:右記以外  1:スピードリミッタトルク制御中" UBYTE COMP_0283 1 100 0 1 BIT_MASK 0x0002 ECU_ADDRESS 0xFFFF3D25 READ_WRITE /end MEASUREMENT
/begin MEASUREMENT fSPDCTINH "0:右記以外  1:回転数制御禁止中" UBYTE COMP_0283 1 100 0 1 BIT_MASK 0x0001 ECU_ADDRESS 0xFFFF3D25 READ_WRITE /end MEASUREMENT
/begin MEASUREMENT fSRVOINI2 "0:車速ｻｰﾎﾞ初期化済み  1:車速ｻｰﾎﾞ初期化要求" UBYTE COMP_0283 1 100 0 1 BIT_MASK 0x0080 ECU_ADDRESS 0xFFFF3D26 READ_WRITE /end MEASUREMENT
/begin MEASUREMENT fSRVOINI3 "0:車速ｻｰﾎﾞ初期化済み  1:車速ｻｰﾎﾞ初期化要求" UBYTE COMP_0283 1 100 0 1 BIT_MASK 0x0040 ECU_ADDRESS 0xFFFF3D26 READ_WRITE /end MEASUREMENT
/begin MEASUREMENT fSTROFNG "0:fSTMST=1がTMSTRLY2#以上継続  1:fSTMST=0がTMSTRLY1#以上継続" UBYTE COMP_0283 1 100 0 1 BIT_MASK 0x0020 ECU_ADDRESS 0xFFFF3D26 READ_WRITE /end MEASUREMENT
/begin MEASUREMENT fSTRONNG "0:fSTMST=0がTMSTRLY4#以上継続  1:fSTMST=1がTMSTRLY3#以上継続" UBYTE COMP_0283 1 100 0 1 BIT_MASK 0x0010 ECU_ADDRESS 0xFFFF3D26 READ_WRITE /end MEASUREMENT
/begin MEASUREMENT fTHCHGST "0:カウント中止  1:カウント開始" UBYTE COMP_0283 1 100 0 1 BIT_MASK 0x0008 ECU_ADDRESS 0xFFFF3D26 READ_WRITE /end MEASUREMENT
/begin MEASUREMENT fTPOUOV "0:正常  1:ｵｰﾊﾞｰ" UBYTE COMP_0283 1 100 0 1 BIT_MASK 0x0004 ECU_ADDRESS 0xFFFF3D26 READ_WRITE /end MEASUREMENT
/begin MEASUREMENT fTQARBTON "0:トルクインターシステム作動なし  1:トルクインターシステム作動あり" UBYTE COMP_0283 1 100 0 1 BIT_MASK 0x0002 ECU_ADDRESS 0xFFFF3D26 READ_WRITE /end MEASUREMENT
/begin MEASUREMENT fTXFS1 "0:TCS/VDCｼｽﾃﾑ正常  1:TCS/VDCｼｽﾃﾑ異常" UBYTE COMP_0283 1 100 0 1 BIT_MASK 0x0001 ECU_ADDRESS 0xFFFF3D26 READ_WRITE /end MEASUREMENT
/begin MEASUREMENT fTXFS2 "0:TCS/VDCｼｽﾃﾑ正常  1:TCS/VDCｼｽﾃﾑ異常" UBYTE COMP_0283 1 100 0 1 BIT_MASK 0x0080 ECU_ADDRESS 0xFFFF3D27 READ_WRITE /end MEASUREMENT
/begin MEASUREMENT fVCLEAN2 "0:クリーニングモード非実行中  1:クリーニングモード実行中" UBYTE COMP_0283 1 100 0 1 BIT_MASK 0x0040 ECU_ADDRESS 0xFFFF3D27 READ_WRITE /end MEASUREMENT
/begin MEASUREMENT fVCLEAN2E "0:クリーニングモード非実行中  1:クリーニングモード実行中" UBYTE COMP_0283 1 100 0 1 BIT_MASK 0x0020 ECU_ADDRESS 0xFFFF3D27 READ_WRITE /end MEASUREMENT
/begin MEASUREMENT fVSPOVER "0:点滅無  1:点滅有" UBYTE COMP_0283 1 100 0 1 BIT_MASK 0x0010 ECU_ADDRESS 0xFFFF3D27 READ_WRITE /end MEASUREMENT
/begin MEASUREMENT fVSPSHL "0:PTD車速ｾﾝｻ整合  1:PTD車速ｾﾝｻ不整合" UBYTE COMP_0283 1 100 0 1 BIT_MASK 0x0008 ECU_ADDRESS 0xFFFF3D27 READ_WRITE /end MEASUREMENT
/begin MEASUREMENT fVTCMEON "0:要求なし  1:要求あり" UBYTE COMP_0283 1 100 0 1 BIT_MASK 0x0004 ECU_ADDRESS 0xFFFF3D27 READ_WRITE /end MEASUREMENT
/begin MEASUREMENT fVTCMION "0:要求なし  1:要求あり" UBYTE COMP_0283 1 100 0 1 BIT_MASK 0x0002 ECU_ADDRESS 0xFFFF3D27 READ_WRITE /end MEASUREMENT
/begin MEASUREMENT fVTDGN1SE "0:不成立  1:成立" UBYTE COMP_0283 1 100 0 1 BIT_MASK 0x0001 ECU_ADDRESS 0xFFFF3D27 READ_WRITE /end MEASUREMENT
/begin MEASUREMENT fVTDGN2SE "0:不成立  1:成立" UBYTE COMP_0283 1 100 0 1 BIT_MASK 0x0080 ECU_ADDRESS 0xFFFF3D28 READ_WRITE /end MEASUREMENT
/begin MEASUREMENT fASCACT_S "0:OFF  1:ON" UBYTE COMP_0283 1 100 0 1 BIT_MASK 0x0040 ECU_ADDRESS 0xFFFF3D28 READ_WRITE /end MEASUREMENT
/begin MEASUREMENT fCRUIS2_S "0:OFF  1:ON" UBYTE COMP_0283 1 100 0 1 BIT_MASK 0x0020 ECU_ADDRESS 0xFFFF3D28 READ_WRITE /end MEASUREMENT
/begin MEASUREMENT fDARBON_S "0:非作動中  1:作動中" UBYTE COMP_0283 1 100 0 1 BIT_MASK 0x0010 ECU_ADDRESS 0xFFFF3D28 READ_WRITE /end MEASUREMENT
/begin MEASUREMENT fETCFAL_S "0:正常  1:異常" UBYTE COMP_0283 1 100 0 1 BIT_MASK 0x0008 ECU_ADDRESS 0xFFFF3D28 READ_WRITE /end MEASUREMENT
/begin MEASUREMENT fETCOFF_S "0:非実行  1:実行" UBYTE COMP_0283 1 100 0 1 BIT_MASK 0x0004 ECU_ADDRESS 0xFFFF3D28 READ_WRITE /end MEASUREMENT
/begin MEASUREMENT fTARBON_S "0:トルクインターシステム作動なし  1:トルクインターシステム作動あり" UBYTE COMP_0283 1 100 0 1 BIT_MASK 0x0002 ECU_ADDRESS 0xFFFF3D28 READ_WRITE /end MEASUREMENT
/begin MEASUREMENT afCAPWREQ "0:F/C警告灯点灯結果消灯  1:F/C警告灯点灯結果点灯" UBYTE COMP_0283 1 100 0 1 BIT_MASK 0x0080 ECU_ADDRESS 0xFFFF5631 READ_WRITE /end MEASUREMENT
/begin MEASUREMENT afFFPEND "0:ﾍﾟﾝﾃﾞｨﾝｸﾞF.F.記憶中/記憶なし  1:正規F.F.記憶中" UBYTE COMP_0283 1 100 0 1 BIT_MASK 0x0040 ECU_ADDRESS 0xFFFF5631 READ_WRITE /end MEASUREMENT
/begin MEASUREMENT afFFUEL "0:燃料ｼｽﾃﾑ診断F.F.記憶無し  1:燃料ｼｽﾃﾑ診断F.F.記憶中" UBYTE COMP_0283 1 100 0 1 BIT_MASK 0x0020 ECU_ADDRESS 0xFFFF5631 READ_WRITE /end MEASUREMENT
/begin MEASUREMENT afFMISF "0:失火診断F.F.記憶無し  1:失火診断F.F.記憶中" UBYTE COMP_0283 1 100 0 1 BIT_MASK 0x0010 ECU_ADDRESS 0xFFFF5631 READ_WRITE /end MEASUREMENT
/begin MEASUREMENT afFPRI2 "0:第二水準診断F.F.記憶無し  1:第二水準診断F.F.記憶中" UBYTE COMP_0283 1 100 0 1 BIT_MASK 0x0008 ECU_ADDRESS 0xFFFF5631 READ_WRITE /end MEASUREMENT
/begin MEASUREMENT afFTCVTNG "0:結果NGでない  1:結果NG" UBYTE COMP_0283 1 100 0 1 BIT_MASK 0x0004 ECU_ADDRESS 0xFFFF5631 READ_WRITE /end MEASUREMENT
/begin MEASUREMENT afFTCVTOK "0:結果OKでない  1:結果OK" UBYTE COMP_0283 1 100 0 1 BIT_MASK 0x0002 ECU_ADDRESS 0xFFFF5631 READ_WRITE /end MEASUREMENT
/begin MEASUREMENT fCAPWREQ "0:F/C警告灯点灯結果消灯  1:F/C警告灯点灯結果点灯" UBYTE COMP_0283 1 100 0 1 BIT_MASK 0x0080 ECU_ADDRESS 0xFFFF5632 READ_WRITE /end MEASUREMENT
/begin MEASUREMENT fFFPEND "0:ﾍﾟﾝﾃﾞｨﾝｸﾞF.F.記憶中/記憶なし  1:正規F.F.記憶中" UBYTE COMP_0283 1 100 0 1 BIT_MASK 0x0040 ECU_ADDRESS 0xFFFF5632 READ_WRITE /end MEASUREMENT
/begin MEASUREMENT fFFUEL "0:燃料ｼｽﾃﾑ診断F.F.記憶無し  1:燃料ｼｽﾃﾑ診断F.F.記憶中" UBYTE COMP_0283 1 100 0 1 BIT_MASK 0x0020 ECU_ADDRESS 0xFFFF5632 READ_WRITE /end MEASUREMENT
/begin MEASUREMENT fFMISF "0:失火診断F.F.記憶無し  1:失火診断F.F.記憶中" UBYTE COMP_0283 1 100 0 1 BIT_MASK 0x0010 ECU_ADDRESS 0xFFFF5632 READ_WRITE /end MEASUREMENT
/begin MEASUREMENT fFPRI2 "0:第二水準診断F.F.記憶無し  1:第二水準診断F.F.記憶中" UBYTE COMP_0283 1 100 0 1 BIT_MASK 0x0008 ECU_ADDRESS 0xFFFF5632 READ_WRITE /end MEASUREMENT
/begin MEASUREMENT fFTCVTNG "0:結果NGでない  1:結果NG" UBYTE COMP_0283 1 100 0 1 BIT_MASK 0x0004 ECU_ADDRESS 0xFFFF5632 READ_WRITE /end MEASUREMENT
/begin MEASUREMENT fFTCVTOK "0:結果OKでない  1:結果OK" UBYTE COMP_0283 1 100 0 1 BIT_MASK 0x0002 ECU_ADDRESS 0xFFFF5632 READ_WRITE /end MEASUREMENT
/begin MEASUREMENT jTVM_STS "RAM value jTVM_STS" ULONG COMP_0462_S 1 100 0 4294967295 ECU_ADDRESS 0xFFFF16D4 READ_WRITE /end MEASUREMENT
/begin MEASUREMENT jWtemp_STS "RAM value jWtemp_STS" ULONG COMP_0462_S 1 100 0 4294967295 ECU_ADDRESS 0xFFFF16D8 READ_WRITE /end MEASUREMENT
/begin MEASUREMENT jTpSt_sts "RAM value jTpSt_sts" ULONG COMP_0462_S 1 100 0 4294967295 ECU_ADDRESS 0xFFFF16DC READ_WRITE /end MEASUREMENT
/begin MEASUREMENT jTVAD_STS "RAM value jTVAD_STS" ULONG COMP_0462_S 1 100 0 4294967295 ECU_ADDRESS 0xFFFF16E0 READ_WRITE /end MEASUREMENT
/begin MEASUREMENT jFASOL_sts "RAM value jFASOL_sts" ULONG COMP_0462_S 1 100 0 4294967295 ECU_ADDRESS 0xFFFF16E8 READ_WRITE /end MEASUREMENT
/begin MEASUREMENT jAP1_STS "RAM value jAP1_STS" ULONG COMP_0462_S 1 100 0 4294967295 ECU_ADDRESS 0xFFFF16EC READ_WRITE /end MEASUREMENT
/begin MEASUREMENT jAP2_STS "RAM value jAP2_STS" ULONG COMP_0462_S 1 100 0 4294967295 ECU_ADDRESS 0xFFFF16F0 READ_WRITE /end MEASUREMENT
/begin MEASUREMENT jIGSW_STS "RAM value jIGSW_STS" ULONG COMP_0462_S 1 100 0 4294967295 ECU_ADDRESS 0xFFFF3370 READ_WRITE /end MEASUREMENT
/begin MEASUREMENT jNEUTD_STS "RAM value jNEUTD_STS" ULONG COMP_0462_S 1 100 0 4294967295 ECU_ADDRESS 0xFFFF3374 READ_WRITE /end MEASUREMENT
/begin MEASUREMENT jSTSW_STS "RAM value jSTSW_STS" ULONG COMP_0462_S 1 100 0 4294967295 ECU_ADDRESS 0xFFFF3378 READ_WRITE /end MEASUREMENT
/begin MEASUREMENT jSTEXCS_st "RAM value jSTEXCS_st" ULONG COMP_0462_S 1 100 0 4294967295 ECU_ADDRESS 0xFFFF337C READ_WRITE /end MEASUREMENT
/begin MEASUREMENT jIDLSFS_st "RAM value jIDLSFS_st" ULONG COMP_0462_S 1 100 0 4294967295 ECU_ADDRESS 0xFFFF3380 READ_WRITE /end MEASUREMENT
/begin MEASUREMENT jEnst_Sts "RAM value jEnst_Sts" ULONG COMP_0462_S 1 100 0 4294967295 ECU_ADDRESS 0xFFFF3384 READ_WRITE /end MEASUREMENT
/begin MEASUREMENT jSoff_Sts "RAM value jSoff_Sts" ULONG COMP_0462_S 1 100 0 4294967295 ECU_ADDRESS 0xFFFF3388 READ_WRITE /end MEASUREMENT
/begin MEASUREMENT jFTROF_sts "RAM value jFTROF_sts" ULONG COMP_0462_S 1 100 0 4294967295 ECU_ADDRESS 0xFFFF30D4 READ_WRITE /end MEASUREMENT
/begin MEASUREMENT tACCMSGCA "RAM value tACCMSGCA" UBYTE COMP_0463_S 1 100 0 255 ECU_ADDRESS 0xFFFF3DA0 READ_WRITE /end MEASUREMENT
/begin MEASUREMENT tADJDLY "RAM value tADJDLY" UBYTE COMP_0463_S 1 100 0 255 ECU_ADDRESS 0xFFFF3DA1 READ_WRITE /end MEASUREMENT
/begin MEASUREMENT tAFOHONT "RAM value tAFOHONT" UBYTE COMP_0463_S 1 100 0 255 ECU_ADDRESS 0xFFFF3DA2 READ_WRITE /end MEASUREMENT
/begin MEASUREMENT tAGBSIPNG "RAM value tAGBSIPNG" UBYTE COMP_0463_S 1 100 0 255 ECU_ADDRESS 0xFFFF3DA3 READ_WRITE /end MEASUREMENT
/begin MEASUREMENT tAGBTUPDL "RAM value tAGBTUPDL" UBYTE COMP_0463_S 1 100 0 255 ECU_ADDRESS 0xFFFF3DA4 READ_WRITE /end MEASUREMENT
/begin MEASUREMENT tASHLTM "RAM value tASHLTM" UBYTE COMP_0463_S 1 100 0 255 ECU_ADDRESS 0xFFFF3DA5 READ_WRITE /end MEASUREMENT
/begin MEASUREMENT tASSWNGT2 "RAM value tASSWNGT2" UBYTE COMP_0463_S 1 100 0 255 ECU_ADDRESS 0xFFFF3DA6 READ_WRITE /end MEASUREMENT
/begin MEASUREMENT tBKSWTMOK "RAM value tBKSWTMOK" UBYTE COMP_0463_S 1 100 0 255 ECU_ADDRESS 0xFFFF3DA7 READ_WRITE /end MEASUREMENT
/begin MEASUREMENT tBNCCLRTM "RAM value tBNCCLRTM" UBYTE COMP_0463_S 1 100 0 255 ECU_ADDRESS 0xFFFF3DA8 READ_WRITE /end MEASUREMENT
/begin MEASUREMENT tBNCINCTM "RAM value tBNCINCTM" UBYTE COMP_0463_S 1 100 0 255 ECU_ADDRESS 0xFFFF3DA9 READ_WRITE /end MEASUREMENT
/begin MEASUREMENT tBNCPTNG1 "RAM value tBNCPTNG1" UBYTE COMP_0463_S 1 100 0 255 ECU_ADDRESS 0xFFFF3DAA READ_WRITE /end MEASUREMENT
/begin MEASUREMENT tBNCPTNG2 "RAM value tBNCPTNG2" UBYTE COMP_0463_S 1 100 0 255 ECU_ADDRESS 0xFFFF3DAB READ_WRITE /end MEASUREMENT
/begin MEASUREMENT tBNOBNCOK "RAM value tBNOBNCOK" UBYTE COMP_0463_S 1 100 0 255 ECU_ADDRESS 0xFFFF3DAC READ_WRITE /end MEASUREMENT
/begin MEASUREMENT tBNONCNG1 "RAM value tBNONCNG1" UBYTE COMP_0463_S 1 100 0 255 ECU_ADDRESS 0xFFFF3DAD READ_WRITE /end MEASUREMENT
/begin MEASUREMENT tCANMTM1 "RAM value tCANMTM1" UBYTE COMP_0463_S 1 100 0 255 ECU_ADDRESS 0xFFFF3DAE READ_WRITE /end MEASUREMENT
/begin MEASUREMENT tCHECKTM "RAM value tCHECKTM" UBYTE COMP_0463_S 1 100 0 255 ECU_ADDRESS 0xFFFF3DAF READ_WRITE /end MEASUREMENT
/begin MEASUREMENT tCHECKTM2 "RAM value tCHECKTM2" UBYTE COMP_0463_S 1 100 0 255 ECU_ADDRESS 0xFFFF3DB0 READ_WRITE /end MEASUREMENT
/begin MEASUREMENT tCHGNGNE "RAM value tCHGNGNE" UBYTE COMP_0463_S 1 100 0 255 ECU_ADDRESS 0xFFFF3DB1 READ_WRITE /end MEASUREMENT
/begin MEASUREMENT tCHGTSTTM "RAM value tCHGTSTTM" UBYTE COMP_0463_S 1 100 0 255 ECU_ADDRESS 0xFFFF3DB2 READ_WRITE /end MEASUREMENT
/begin MEASUREMENT tCLDVDLY "RAM value tCLDVDLY" UBYTE COMP_0463_S 1 100 0 255 ECU_ADDRESS 0xFFFF3DB3 READ_WRITE /end MEASUREMENT
/begin MEASUREMENT tCLDVDLYE "RAM value tCLDVDLYE" UBYTE COMP_0463_S 1 100 0 255 ECU_ADDRESS 0xFFFF3DB4 READ_WRITE /end MEASUREMENT
/begin MEASUREMENT tCVBLNTM "RAM value tCVBLNTM" UBYTE COMP_0463_S 1 100 0 255 ECU_ADDRESS 0xFFFF3DB5 READ_WRITE /end MEASUREMENT
/begin MEASUREMENT tDIGTPNGT "RAM value tDIGTPNGT" UBYTE COMP_0463_S 1 100 0 255 ECU_ADDRESS 0xFFFF3DB6 READ_WRITE /end MEASUREMENT
/begin MEASUREMENT tDIVTM "RAM value tDIVTM" UBYTE COMP_0463_S 1 100 0 255 ECU_ADDRESS 0xFFFF3DB7 READ_WRITE /end MEASUREMENT
/begin MEASUREMENT tDLYMNS "RAM value tDLYMNS" UBYTE COMP_0463_S 1 100 0 255 ECU_ADDRESS 0xFFFF3DB8 READ_WRITE /end MEASUREMENT
/begin MEASUREMENT tDQLEN "RAM value tDQLEN" UBYTE COMP_0463_S 1 100 0 255 ECU_ADDRESS 0xFFFF3DB9 READ_WRITE /end MEASUREMENT
/begin MEASUREMENT tDRVMDTM "RAM value tDRVMDTM" UBYTE COMP_0463_S 1 100 0 255 ECU_ADDRESS 0xFFFF3DBA READ_WRITE /end MEASUREMENT
/begin MEASUREMENT tDTVHOST "RAM value tDTVHOST" UBYTE COMP_0463_S 1 100 0 255 ECU_ADDRESS 0xFFFF3DBB READ_WRITE /end MEASUREMENT
/begin MEASUREMENT tDTVOSCT "RAM value tDTVOSCT" UBYTE COMP_0463_S 1 100 0 255 ECU_ADDRESS 0xFFFF3DBC READ_WRITE /end MEASUREMENT
/begin MEASUREMENT tDWPTM1 "RAM value tDWPTM1" UBYTE COMP_0463_S 1 100 0 255 ECU_ADDRESS 0xFFFF3DBD READ_WRITE /end MEASUREMENT
/begin MEASUREMENT tDWPTMN2 "RAM value tDWPTMN2" UBYTE COMP_0463_S 1 100 0 255 ECU_ADDRESS 0xFFFF3DBE READ_WRITE /end MEASUREMENT
/begin MEASUREMENT tDWPTMP2 "RAM value tDWPTMP2" UBYTE COMP_0463_S 1 100 0 255 ECU_ADDRESS 0xFFFF3DBF READ_WRITE /end MEASUREMENT
/begin MEASUREMENT tECOITIM "RAM value tECOITIM" UBYTE COMP_0463_S 1 100 0 255 ECU_ADDRESS 0xFFFF3DC0 READ_WRITE /end MEASUREMENT
/begin MEASUREMENT tEGRSJD "RAM value tEGRSJD" UBYTE COMP_0463_S 1 100 0 255 ECU_ADDRESS 0xFFFF3DC1 READ_WRITE /end MEASUREMENT
/begin MEASUREMENT tEGRSNG2 "RAM value tEGRSNG2" UBYTE COMP_0463_S 1 100 0 255 ECU_ADDRESS 0xFFFF3DC2 READ_WRITE /end MEASUREMENT
/begin MEASUREMENT tEGRTX "RAM value tEGRTX" UBYTE COMP_0463_S 1 100 0 255 ECU_ADDRESS 0xFFFF3DC3 READ_WRITE /end MEASUREMENT
/begin MEASUREMENT tENSTDLY "RAM value tENSTDLY" UBYTE COMP_0463_S 1 100 0 255 ECU_ADDRESS 0xFFFF3DC4 READ_WRITE /end MEASUREMENT
/begin MEASUREMENT tERRTIMEX "RAM value tERRTIMEX" UBYTE COMP_0463_S 1 100 0 255 ECU_ADDRESS 0xFFFF3DC5 READ_WRITE /end MEASUREMENT
/begin MEASUREMENT tERRTIMG "RAM value tERRTIMG" UBYTE COMP_0463_S 1 100 0 255 ECU_ADDRESS 0xFFFF3DC7 READ_WRITE /end MEASUREMENT
/begin MEASUREMENT tERRTM3 "RAM value tERRTM3" UBYTE COMP_0463_S 1 100 0 255 ECU_ADDRESS 0xFFFF3DC8 READ_WRITE /end MEASUREMENT
/begin MEASUREMENT tERRTM4 "RAM value tERRTM4" UBYTE COMP_0463_S 1 100 0 255 ECU_ADDRESS 0xFFFF3DCA READ_WRITE /end MEASUREMENT
/begin MEASUREMENT tEVSDLY1S "RAM value tEVSDLY1S" UBYTE COMP_0463_S 1 100 0 255 ECU_ADDRESS 0xFFFF3DCC READ_WRITE /end MEASUREMENT
/begin MEASUREMENT tFCAFCAN "RAM value tFCAFCAN" UBYTE COMP_0463_S 1 100 0 255 ECU_ADDRESS 0xFFFF3DCD READ_WRITE /end MEASUREMENT
/begin MEASUREMENT tFPOFFD "RAM value tFPOFFD" UBYTE COMP_0463_S 1 100 0 255 ECU_ADDRESS 0xFFFF3DCE READ_WRITE /end MEASUREMENT
/begin MEASUREMENT tFPSTDLY "RAM value tFPSTDLY" UBYTE COMP_0463_S 1 100 0 255 ECU_ADDRESS 0xFFFF3DCF READ_WRITE /end MEASUREMENT
/begin MEASUREMENT tGFBRKD "RAM value tGFBRKD" UBYTE COMP_0463_S 1 100 0 255 ECU_ADDRESS 0xFFFF3DD0 READ_WRITE /end MEASUREMENT
/begin MEASUREMENT tGFBSD "RAM value tGFBSD" UBYTE COMP_0463_S 1 100 0 255 ECU_ADDRESS 0xFFFF3DD1 READ_WRITE /end MEASUREMENT
/begin MEASUREMENT tGFBSFD "RAM value tGFBSFD" UBYTE COMP_0463_S 1 100 0 255 ECU_ADDRESS 0xFFFF3DD2 READ_WRITE /end MEASUREMENT
/begin MEASUREMENT tGUILSTP "RAM value tGUILSTP" UBYTE COMP_0463_S 1 100 0 255 ECU_ADDRESS 0xFFFF3DD3 READ_WRITE /end MEASUREMENT
/begin MEASUREMENT tGUILSTPE "RAM value tGUILSTPE" UBYTE COMP_0463_S 1 100 0 255 ECU_ADDRESS 0xFFFF3DD4 READ_WRITE /end MEASUREMENT
/begin MEASUREMENT tHOSHONT "RAM value tHOSHONT" UBYTE COMP_0463_S 1 100 0 255 ECU_ADDRESS 0xFFFF3DD5 READ_WRITE /end MEASUREMENT
/begin MEASUREMENT tHOSLTM "RAM value tHOSLTM" UBYTE COMP_0463_S 1 100 0 255 ECU_ADDRESS 0xFFFF3DD6 READ_WRITE /end MEASUREMENT
/begin MEASUREMENT tIDCSNG "RAM value tIDCSNG" UBYTE COMP_0463_S 1 100 0 255 ECU_ADDRESS 0xFFFF3DD7 READ_WRITE /end MEASUREMENT
/begin MEASUREMENT tIERRTIM "RAM value tIERRTIM" UBYTE COMP_0463_S 1 100 0 255 ECU_ADDRESS 0xFFFF3DD8 READ_WRITE /end MEASUREMENT
/begin MEASUREMENT tIERRTIME "RAM value tIERRTIME" UBYTE COMP_0463_S 1 100 0 255 ECU_ADDRESS 0xFFFF3DDA READ_WRITE /end MEASUREMENT
/begin MEASUREMENT tIERRTIMG "RAM value tIERRTIMG" UBYTE COMP_0463_S 1 100 0 255 ECU_ADDRESS 0xFFFF3DDC READ_WRITE /end MEASUREMENT
/begin MEASUREMENT tIGCKTM "RAM value tIGCKTM" UBYTE COMP_0463_S 1 100 0 255 ECU_ADDRESS 0xFFFF3DDD READ_WRITE /end MEASUREMENT
/begin MEASUREMENT tIGNCHK "RAM value tIGNCHK" UBYTE COMP_0463_S 1 100 0 255 ECU_ADDRESS 0xFFFF3DDE READ_WRITE /end MEASUREMENT
/begin MEASUREMENT tIGNON "RAM value tIGNON" UBYTE COMP_0463_S 1 100 0 255 ECU_ADDRESS 0xFFFF3DDF READ_WRITE /end MEASUREMENT
/begin MEASUREMENT tIT1NGT "RAM value tIT1NGT" UBYTE COMP_0463_S 1 100 0 255 ECU_ADDRESS 0xFFFF3DE0 READ_WRITE /end MEASUREMENT
/begin MEASUREMENT tIT2NGT "RAM value tIT2NGT" UBYTE COMP_0463_S 1 100 0 255 ECU_ADDRESS 0xFFFF3DE1 READ_WRITE /end MEASUREMENT
/begin MEASUREMENT tKAIVRTAF "RAM value tKAIVRTAF" UBYTE COMP_0463_S 1 100 0 255 ECU_ADDRESS 0xFFFF3DE2 READ_WRITE /end MEASUREMENT
/begin MEASUREMENT tKEYON20 "RAM value tKEYON20" UBYTE COMP_0463_S 1 100 0 255 ECU_ADDRESS 0xFFFF3DE4 READ_WRITE /end MEASUREMENT
/begin MEASUREMENT tKPRTNGT "RAM value tKPRTNGT" UBYTE COMP_0463_S 1 100 0 255 ECU_ADDRESS 0xFFFF3DE5 READ_WRITE /end MEASUREMENT
/begin MEASUREMENT tMODE2TM "RAM value tMODE2TM" UBYTE COMP_0463_S 1 100 0 255 ECU_ADDRESS 0xFFFF3DE6 READ_WRITE /end MEASUREMENT
/begin MEASUREMENT tMSRACTTM "RAM value tMSRACTTM" UBYTE COMP_0463_S 1 100 0 255 ECU_ADDRESS 0xFFFF3DE7 READ_WRITE /end MEASUREMENT
/begin MEASUREMENT tO2100M "RAM value tO2100M" UBYTE COMP_0463_S 1 100 0 255 ECU_ADDRESS 0xFFFF3DE8 READ_WRITE /end MEASUREMENT
/begin MEASUREMENT tODACCT "RAM value tODACCT" UBYTE COMP_0463_S 1 100 0 255 ECU_ADDRESS 0xFFFF3DE9 READ_WRITE /end MEASUREMENT
/begin MEASUREMENT tODBNRN "RAM value tODBNRN" UBYTE COMP_0463_S 1 100 0 255 ECU_ADDRESS 0xFFFF3DEA READ_WRITE /end MEASUREMENT
/begin MEASUREMENT tODBNRS "RAM value tODBNRS" UBYTE COMP_0463_S 1 100 0 255 ECU_ADDRESS 0xFFFF3DEB READ_WRITE /end MEASUREMENT
/begin MEASUREMENT tODBNTP "RAM value tODBNTP" UBYTE COMP_0463_S 1 100 0 255 ECU_ADDRESS 0xFFFF3DEC READ_WRITE /end MEASUREMENT
/begin MEASUREMENT tODCNRN "RAM value tODCNRN" UBYTE COMP_0463_S 1 100 0 255 ECU_ADDRESS 0xFFFF3DED READ_WRITE /end MEASUREMENT
/begin MEASUREMENT tORCSNG "RAM value tORCSNG" UBYTE COMP_0463_S 1 100 0 255 ECU_ADDRESS 0xFFFF3DEE READ_WRITE /end MEASUREMENT
/begin MEASUREMENT tOSCDL1 "RAM value tOSCDL1" UBYTE COMP_0463_S 1 100 0 255 ECU_ADDRESS 0xFFFF3DEF READ_WRITE /end MEASUREMENT
/begin MEASUREMENT tOSCDL2 "RAM value tOSCDL2" UBYTE COMP_0463_S 1 100 0 255 ECU_ADDRESS 0xFFFF3DF0 READ_WRITE /end MEASUREMENT
/begin MEASUREMENT tOSCDL3 "RAM value tOSCDL3" UBYTE COMP_0463_S 1 100 0 255 ECU_ADDRESS 0xFFFF3DF1 READ_WRITE /end MEASUREMENT
/begin MEASUREMENT tOSCDL4 "RAM value tOSCDL4" UBYTE COMP_0463_S 1 100 0 255 ECU_ADDRESS 0xFFFF3DF2 READ_WRITE /end MEASUREMENT
/begin MEASUREMENT tPCHECK "RAM value tPCHECK" UBYTE COMP_0463_S 1 100 0 255 ECU_ADDRESS 0xFFFF3DF3 READ_WRITE /end MEASUREMENT
/begin MEASUREMENT tPHBPMST "RAM value tPHBPMST" UBYTE COMP_0463_S 1 100 0 255 ECU_ADDRESS 0xFFFF3DF4 READ_WRITE /end MEASUREMENT
/begin MEASUREMENT tPHBPMSW "RAM value tPHBPMSW" UBYTE COMP_0463_S 1 100 0 255 ECU_ADDRESS 0xFFFF3DF5 READ_WRITE /end MEASUREMENT
/begin MEASUREMENT tPSITM "RAM value tPSITM" UBYTE COMP_0463_S 1 100 0 255 ECU_ADDRESS 0xFFFF3DF6 READ_WRITE /end MEASUREMENT
/begin MEASUREMENT tPSRLNGT "RAM value tPSRLNGT" UBYTE COMP_0463_S 1 100 0 255 ECU_ADDRESS 0xFFFF3DF7 READ_WRITE /end MEASUREMENT
/begin MEASUREMENT tQFSKT "RAM value tQFSKT" UBYTE COMP_0463_S 1 100 0 255 ECU_ADDRESS 0xFFFF3DF8 READ_WRITE /end MEASUREMENT
/begin MEASUREMENT tREGACCDY "RAM value tREGACCDY" UBYTE COMP_0463_S 1 100 0 255 ECU_ADDRESS 0xFFFF3DF9 READ_WRITE /end MEASUREMENT
/begin MEASUREMENT tREGBRKTM "RAM value tREGBRKTM" UBYTE COMP_0463_S 1 100 0 255 ECU_ADDRESS 0xFFFF3DFA READ_WRITE /end MEASUREMENT
/begin MEASUREMENT tREGUPDLY "RAM value tREGUPDLY" UBYTE COMP_0463_S 1 100 0 255 ECU_ADDRESS 0xFFFF3DFB READ_WRITE /end MEASUREMENT
/begin MEASUREMENT tRESCHOTM "RAM value tRESCHOTM" UBYTE COMP_0463_S 1 100 0 255 ECU_ADDRESS 0xFFFF3DFC READ_WRITE /end MEASUREMENT
/begin MEASUREMENT tRESPAKTM "RAM value tRESPAKTM" UBYTE COMP_0463_S 1 100 0 255 ECU_ADDRESS 0xFFFF3DFD READ_WRITE /end MEASUREMENT
/begin MEASUREMENT tRESTDLY2 "RAM value tRESTDLY2" UBYTE COMP_0463_S 1 100 0 255 ECU_ADDRESS 0xFFFF3DFE READ_WRITE /end MEASUREMENT
/begin MEASUREMENT tRESTSHTM "RAM value tRESTSHTM" UBYTE COMP_0463_S 1 100 0 255 ECU_ADDRESS 0xFFFF3DFF READ_WRITE /end MEASUREMENT
/begin MEASUREMENT tRFUELDLY "RAM value tRFUELDLY" UBYTE COMP_0463_S 1 100 0 255 ECU_ADDRESS 0xFFFF3E00 READ_WRITE /end MEASUREMENT
/begin MEASUREMENT tRO2HCTD "RAM value tRO2HCTD" UBYTE COMP_0463_S 1 100 0 255 ECU_ADDRESS 0xFFFF3E01 READ_WRITE /end MEASUREMENT
/begin MEASUREMENT tROJFCT "RAM value tROJFCT" UBYTE COMP_0463_S 1 100 0 255 ECU_ADDRESS 0xFFFF3E02 READ_WRITE /end MEASUREMENT
/begin MEASUREMENT tSADT "RAM value tSADT" UBYTE COMP_0463_S 1 100 0 255 ECU_ADDRESS 0xFFFF3E03 READ_WRITE /end MEASUREMENT
/begin MEASUREMENT tSENSTDLY "RAM value tSENSTDLY" UBYTE COMP_0463_S 1 100 0 255 ECU_ADDRESS 0xFFFF3E04 READ_WRITE /end MEASUREMENT
/begin MEASUREMENT tSGCHKDY1 "RAM value tSGCHKDY1" UBYTE COMP_0463_S 1 100 0 255 ECU_ADDRESS 0xFFFF3E05 READ_WRITE /end MEASUREMENT
/begin MEASUREMENT tSGCHKDY2 "RAM value tSGCHKDY2" UBYTE COMP_0463_S 1 100 0 255 ECU_ADDRESS 0xFFFF3E06 READ_WRITE /end MEASUREMENT
/begin MEASUREMENT tSLCLWRNT "RAM value tSLCLWRNT" UBYTE COMP_0463_S 1 100 0 255 ECU_ADDRESS 0xFFFF3E07 READ_WRITE /end MEASUREMENT
/begin MEASUREMENT tSLRTOTM "RAM value tSLRTOTM" UBYTE COMP_0463_S 1 100 0 255 ECU_ADDRESS 0xFFFF3E08 READ_WRITE /end MEASUREMENT
/begin MEASUREMENT tSSOFFDLY "RAM value tSSOFFDLY" UBYTE COMP_0463_S 1 100 0 255 ECU_ADDRESS 0xFFFF3E09 READ_WRITE /end MEASUREMENT
/begin MEASUREMENT tSSOFFDLY1 "RAM value tSSOFFDLY1" UBYTE COMP_0463_S 1 100 0 255 ECU_ADDRESS 0xFFFF3E0A READ_WRITE /end MEASUREMENT
/begin MEASUREMENT tSTCHECK "RAM value tSTCHECK" UBYTE COMP_0463_S 1 100 0 255 ECU_ADDRESS 0xFFFF3E0B READ_WRITE /end MEASUREMENT
/begin MEASUREMENT tSTNGTIM "RAM value tSTNGTIM" UBYTE COMP_0463_S 1 100 0 255 ECU_ADDRESS 0xFFFF3E0C READ_WRITE /end MEASUREMENT
/begin MEASUREMENT tSTOFFTSF "RAM value tSTOFFTSF" UBYTE COMP_0463_S 1 100 0 255 ECU_ADDRESS 0xFFFF3E0D READ_WRITE /end MEASUREMENT
/begin MEASUREMENT tSUMOSCDL "RAM value tSUMOSCDL" UBYTE COMP_0463_S 1 100 0 255 ECU_ADDRESS 0xFFFF3E0E READ_WRITE /end MEASUREMENT
/begin MEASUREMENT tT2CSNG "RAM value tT2CSNG" UBYTE COMP_0463_S 1 100 0 255 ECU_ADDRESS 0xFFFF3E10 READ_WRITE /end MEASUREMENT
/begin MEASUREMENT tTAFPOD "RAM value tTAFPOD" UBYTE COMP_0463_S 1 100 0 255 ECU_ADDRESS 0xFFFF3E11 READ_WRITE /end MEASUREMENT
/begin MEASUREMENT tTASLRD1 "RAM value tTASLRD1" UBYTE COMP_0463_S 1 100 0 255 ECU_ADDRESS 0xFFFF3E12 READ_WRITE /end MEASUREMENT
/begin MEASUREMENT tTATIGN "RAM value tTATIGN" UBYTE COMP_0463_S 1 100 0 255 ECU_ADDRESS 0xFFFF3E13 READ_WRITE /end MEASUREMENT
/begin MEASUREMENT tTCDY1 "RAM value tTCDY1" UBYTE COMP_0463_S 1 100 0 255 ECU_ADDRESS 0xFFFF3E14 READ_WRITE /end MEASUREMENT
/begin MEASUREMENT tTCTD11 "RAM value tTCTD11" UBYTE COMP_0463_S 1 100 0 255 ECU_ADDRESS 0xFFFF3E16 READ_WRITE /end MEASUREMENT
/begin MEASUREMENT tTCTJDLY "RAM value tTCTJDLY" UBYTE COMP_0463_S 1 100 0 255 ECU_ADDRESS 0xFFFF3E18 READ_WRITE /end MEASUREMENT
/begin MEASUREMENT tTCVBNG "RAM value tTCVBNG" UBYTE COMP_0463_S 1 100 0 255 ECU_ADDRESS 0xFFFF3E1A READ_WRITE /end MEASUREMENT
/begin MEASUREMENT tTCVBNG2 "RAM value tTCVBNG2" UBYTE COMP_0463_S 1 100 0 255 ECU_ADDRESS 0xFFFF3E1B READ_WRITE /end MEASUREMENT
/begin MEASUREMENT tTDIRE11 "RAM value tTDIRE11" UBYTE COMP_0463_S 1 100 0 255 ECU_ADDRESS 0xFFFF3E1C READ_WRITE /end MEASUREMENT
/begin MEASUREMENT tTDIRE14 "RAM value tTDIRE14" UBYTE COMP_0463_S 1 100 0 255 ECU_ADDRESS 0xFFFF3E1D READ_WRITE /end MEASUREMENT
/begin MEASUREMENT tTDIRE15 "RAM value tTDIRE15" UBYTE COMP_0463_S 1 100 0 255 ECU_ADDRESS 0xFFFF3E1E READ_WRITE /end MEASUREMENT
/begin MEASUREMENT tTDIRE15B "RAM value tTDIRE15B" UBYTE COMP_0463_S 1 100 0 255 ECU_ADDRESS 0xFFFF3E1F READ_WRITE /end MEASUREMENT
/begin MEASUREMENT tTDIRE16 "RAM value tTDIRE16" UBYTE COMP_0463_S 1 100 0 255 ECU_ADDRESS 0xFFFF3E20 READ_WRITE /end MEASUREMENT
/begin MEASUREMENT tTDUETNG "RAM value tTDUETNG" UBYTE COMP_0463_S 1 100 0 255 ECU_ADDRESS 0xFFFF3E21 READ_WRITE /end MEASUREMENT
/begin MEASUREMENT tTECSNG "RAM value tTECSNG" UBYTE COMP_0463_S 1 100 0 255 ECU_ADDRESS 0xFFFF3E22 READ_WRITE /end MEASUREMENT
/begin MEASUREMENT tTECSNG2 "RAM value tTECSNG2" UBYTE COMP_0463_S 1 100 0 255 ECU_ADDRESS 0xFFFF3E23 READ_WRITE /end MEASUREMENT
/begin MEASUREMENT tTECSNG21 "RAM value tTECSNG21" UBYTE COMP_0463_S 1 100 0 255 ECU_ADDRESS 0xFFFF3E24 READ_WRITE /end MEASUREMENT
/begin MEASUREMENT tTECSNG22 "RAM value tTECSNG22" UBYTE COMP_0463_S 1 100 0 255 ECU_ADDRESS 0xFFFF3E25 READ_WRITE /end MEASUREMENT
/begin MEASUREMENT tTEGCNG "RAM value tTEGCNG" UBYTE COMP_0463_S 1 100 0 255 ECU_ADDRESS 0xFFFF3E26 READ_WRITE /end MEASUREMENT
/begin MEASUREMENT tTEGRA "RAM value tTEGRA" UBYTE COMP_0463_S 1 100 0 255 ECU_ADDRESS 0xFFFF3E27 READ_WRITE /end MEASUREMENT
/begin MEASUREMENT tTETCCLR "RAM value tTETCCLR" UBYTE COMP_0463_S 1 100 0 255 ECU_ADDRESS 0xFFFF3E28 READ_WRITE /end MEASUREMENT
/begin MEASUREMENT tTFGMNG "RAM value tTFGMNG" UBYTE COMP_0463_S 1 100 0 255 ECU_ADDRESS 0xFFFF3E29 READ_WRITE /end MEASUREMENT
/begin MEASUREMENT tTFGPNG1O "RAM value tTFGPNG1O" UBYTE COMP_0463_S 1 100 0 255 ECU_ADDRESS 0xFFFF3E2A READ_WRITE /end MEASUREMENT
/begin MEASUREMENT tTFGPNG1S "RAM value tTFGPNG1S" UBYTE COMP_0463_S 1 100 0 255 ECU_ADDRESS 0xFFFF3E2B READ_WRITE /end MEASUREMENT
/begin MEASUREMENT tTFGTP1 "RAM value tTFGTP1" UBYTE COMP_0463_S 1 100 0 255 ECU_ADDRESS 0xFFFF3E2C READ_WRITE /end MEASUREMENT
/begin MEASUREMENT tTFINTD "RAM value tTFINTD" UBYTE COMP_0463_S 1 100 0 255 ECU_ADDRESS 0xFFFF3E2D READ_WRITE /end MEASUREMENT
/begin MEASUREMENT tTFPDCK "RAM value tTFPDCK" UBYTE COMP_0463_S 1 100 0 255 ECU_ADDRESS 0xFFFF3E2E READ_WRITE /end MEASUREMENT
/begin MEASUREMENT tTFPSNG1 "RAM value tTFPSNG1" UBYTE COMP_0463_S 1 100 0 255 ECU_ADDRESS 0xFFFF3E2F READ_WRITE /end MEASUREMENT
/begin MEASUREMENT tTFPSNG2 "RAM value tTFPSNG2" UBYTE COMP_0463_S 1 100 0 255 ECU_ADDRESS 0xFFFF3E30 READ_WRITE /end MEASUREMENT
/begin MEASUREMENT tTFTIME1 "RAM value tTFTIME1" UBYTE COMP_0463_S 1 100 0 255 ECU_ADDRESS 0xFFFF3E31 READ_WRITE /end MEASUREMENT
/begin MEASUREMENT tTFTIME2 "RAM value tTFTIME2" UBYTE COMP_0463_S 1 100 0 255 ECU_ADDRESS 0xFFFF3E32 READ_WRITE /end MEASUREMENT
/begin MEASUREMENT tTFTIME3 "RAM value tTFTIME3" UBYTE COMP_0463_S 1 100 0 255 ECU_ADDRESS 0xFFFF3E33 READ_WRITE /end MEASUREMENT
/begin MEASUREMENT tTHNGFN "RAM value tTHNGFN" UBYTE COMP_0463_S 1 100 0 255 ECU_ADDRESS 0xFFFF3E34 READ_WRITE /end MEASUREMENT
/begin MEASUREMENT tTHNGHI "RAM value tTHNGHI" UBYTE COMP_0463_S 1 100 0 255 ECU_ADDRESS 0xFFFF3E35 READ_WRITE /end MEASUREMENT
/begin MEASUREMENT tTHNGLO "RAM value tTHNGLO" UBYTE COMP_0463_S 1 100 0 255 ECU_ADDRESS 0xFFFF3E36 READ_WRITE /end MEASUREMENT
/begin MEASUREMENT tTKNKNG "RAM value tTKNKNG" UBYTE COMP_0463_S 1 100 0 255 ECU_ADDRESS 0xFFFF3E37 READ_WRITE /end MEASUREMENT
/begin MEASUREMENT tTKNKNG1 "RAM value tTKNKNG1" UBYTE COMP_0463_S 1 100 0 255 ECU_ADDRESS 0xFFFF3E38 READ_WRITE /end MEASUREMENT
/begin MEASUREMENT tTKNKNGO "RAM value tTKNKNGO" UBYTE COMP_0463_S 1 100 0 255 ECU_ADDRESS 0xFFFF3E39 READ_WRITE /end MEASUREMENT
/begin MEASUREMENT tTKNKNGS "RAM value tTKNKNGS" UBYTE COMP_0463_S 1 100 0 255 ECU_ADDRESS 0xFFFF3E3A READ_WRITE /end MEASUREMENT
/begin MEASUREMENT tTKNKOKO "RAM value tTKNKOKO" UBYTE COMP_0463_S 1 100 0 255 ECU_ADDRESS 0xFFFF3E3B READ_WRITE /end MEASUREMENT
/begin MEASUREMENT tTKNKOKS "RAM value tTKNKOKS" UBYTE COMP_0463_S 1 100 0 255 ECU_ADDRESS 0xFFFF3E3C READ_WRITE /end MEASUREMENT
/begin MEASUREMENT tTLUPNG "RAM value tTLUPNG" UBYTE COMP_0463_S 1 100 0 255 ECU_ADDRESS 0xFFFF3E3D READ_WRITE /end MEASUREMENT
/begin MEASUREMENT tTMAFAC1 "RAM value tTMAFAC1" UBYTE COMP_0463_S 1 100 0 255 ECU_ADDRESS 0xFFFF3E3E READ_WRITE /end MEASUREMENT
/begin MEASUREMENT tTMAPS "RAM value tTMAPS" UBYTE COMP_0463_S 1 100 0 255 ECU_ADDRESS 0xFFFF3E3F READ_WRITE /end MEASUREMENT
/begin MEASUREMENT tTMAPSO "RAM value tTMAPSO" UBYTE COMP_0463_S 1 100 0 255 ECU_ADDRESS 0xFFFF3E40 READ_WRITE /end MEASUREMENT
/begin MEASUREMENT tTMCHOI "RAM value tTMCHOI" UBYTE COMP_0463_S 1 100 0 255 ECU_ADDRESS 0xFFFF3E41 READ_WRITE /end MEASUREMENT
/begin MEASUREMENT tTMCRK "RAM value tTMCRK" UBYTE COMP_0463_S 1 100 0 255 ECU_ADDRESS 0xFFFF3E42 READ_WRITE /end MEASUREMENT
/begin MEASUREMENT tTMDIREI1 "RAM value tTMDIREI1" UBYTE COMP_0463_S 1 100 0 255 ECU_ADDRESS 0xFFFF3E43 READ_WRITE /end MEASUREMENT
/begin MEASUREMENT tTMFPON "RAM value tTMFPON" UBYTE COMP_0463_S 1 100 0 255 ECU_ADDRESS 0xFFFF3E44 READ_WRITE /end MEASUREMENT
/begin MEASUREMENT tTMHMX1 "RAM value tTMHMX1" UBYTE COMP_0463_S 1 100 0 255 ECU_ADDRESS 0xFFFF3E45 READ_WRITE /end MEASUREMENT
/begin MEASUREMENT tTMIHRLY1 "RAM value tTMIHRLY1" UBYTE COMP_0463_S 1 100 0 255 ECU_ADDRESS 0xFFFF3E46 READ_WRITE /end MEASUREMENT
/begin MEASUREMENT tTMIHRLY2 "RAM value tTMIHRLY2" UBYTE COMP_0463_S 1 100 0 255 ECU_ADDRESS 0xFFFF3E47 READ_WRITE /end MEASUREMENT
/begin MEASUREMENT tTMINGE "RAM value tTMINGE" UBYTE COMP_0463_S 1 100 0 255 ECU_ADDRESS 0xFFFF3E48 READ_WRITE /end MEASUREMENT
/begin MEASUREMENT tTMINGS "RAM value tTMINGS" UBYTE COMP_0463_S 1 100 0 255 ECU_ADDRESS 0xFFFF3E49 READ_WRITE /end MEASUREMENT
/begin MEASUREMENT tTMINH1 "RAM value tTMINH1" UBYTE COMP_0463_S 1 100 0 255 ECU_ADDRESS 0xFFFF3E4A READ_WRITE /end MEASUREMENT
/begin MEASUREMENT tTMINH2 "RAM value tTMINH2" UBYTE COMP_0463_S 1 100 0 255 ECU_ADDRESS 0xFFFF3E4B READ_WRITE /end MEASUREMENT
/begin MEASUREMENT tTMINH3 "RAM value tTMINH3" UBYTE COMP_0463_S 1 100 0 255 ECU_ADDRESS 0xFFFF3E4C READ_WRITE /end MEASUREMENT
/begin MEASUREMENT tTMINH4 "RAM value tTMINH4" UBYTE COMP_0463_S 1 100 0 255 ECU_ADDRESS 0xFFFF3E4D READ_WRITE /end MEASUREMENT
/begin MEASUREMENT tTMMFD "RAM value tTMMFD" UBYTE COMP_0463_S 1 100 0 255 ECU_ADDRESS 0xFFFF3E4E READ_WRITE /end MEASUREMENT
/begin MEASUREMENT tTMOVNG "RAM value tTMOVNG" UBYTE COMP_0463_S 1 100 0 255 ECU_ADDRESS 0xFFFF3E4F READ_WRITE /end MEASUREMENT
/begin MEASUREMENT tTMSLSH02 "RAM value tTMSLSH02" UBYTE COMP_0463_S 1 100 0 255 ECU_ADDRESS 0xFFFF3E50 READ_WRITE /end MEASUREMENT
/begin MEASUREMENT tTMSLSH04 "RAM value tTMSLSH04" UBYTE COMP_0463_S 1 100 0 255 ECU_ADDRESS 0xFFFF3E51 READ_WRITE /end MEASUREMENT
/begin MEASUREMENT tTMSTRLY1 "RAM value tTMSTRLY1" UBYTE COMP_0463_S 1 100 0 255 ECU_ADDRESS 0xFFFF3E52 READ_WRITE /end MEASUREMENT
/begin MEASUREMENT tTMSTRLY2 "RAM value tTMSTRLY2" UBYTE COMP_0463_S 1 100 0 255 ECU_ADDRESS 0xFFFF3E53 READ_WRITE /end MEASUREMENT
/begin MEASUREMENT tTMSTRLY3 "RAM value tTMSTRLY3" UBYTE COMP_0463_S 1 100 0 255 ECU_ADDRESS 0xFFFF3E54 READ_WRITE /end MEASUREMENT
/begin MEASUREMENT tTMSTRLY4 "RAM value tTMSTRLY4" UBYTE COMP_0463_S 1 100 0 255 ECU_ADDRESS 0xFFFF3E55 READ_WRITE /end MEASUREMENT
/begin MEASUREMENT tTMSTRW "RAM value tTMSTRW" UBYTE COMP_0463_S 1 100 0 255 ECU_ADDRESS 0xFFFF3E56 READ_WRITE /end MEASUREMENT
/begin MEASUREMENT tTMVASCD "RAM value tTMVASCD" UBYTE COMP_0463_S 1 100 0 255 ECU_ADDRESS 0xFFFF3E57 READ_WRITE /end MEASUREMENT
/begin MEASUREMENT tTMVPBH "RAM value tTMVPBH" UBYTE COMP_0463_S 1 100 0 255 ECU_ADDRESS 0xFFFF3E58 READ_WRITE /end MEASUREMENT
/begin MEASUREMENT tTMVPBL "RAM value tTMVPBL" UBYTE COMP_0463_S 1 100 0 255 ECU_ADDRESS 0xFFFF3E5A READ_WRITE /end MEASUREMENT
/begin MEASUREMENT tTMZKFAIL "RAM value tTMZKFAIL" UBYTE COMP_0463_S 1 100 0 255 ECU_ADDRESS 0xFFFF3E5C READ_WRITE /end MEASUREMENT
/begin MEASUREMENT tTMZKFL "RAM value tTMZKFL" UBYTE COMP_0463_S 1 100 0 255 ECU_ADDRESS 0xFFFF3E5D READ_WRITE /end MEASUREMENT
/begin MEASUREMENT tTNGSLSH "RAM value tTNGSLSH" UBYTE COMP_0463_S 1 100 0 255 ECU_ADDRESS 0xFFFF3E5E READ_WRITE /end MEASUREMENT
/begin MEASUREMENT tTNHOJI "RAM value tTNHOJI" UBYTE COMP_0463_S 1 100 0 255 ECU_ADDRESS 0xFFFF3E5F READ_WRITE /end MEASUREMENT
/begin MEASUREMENT tTPEVCCL "RAM value tTPEVCCL" UBYTE COMP_0463_S 1 100 0 255 ECU_ADDRESS 0xFFFF3E60 READ_WRITE /end MEASUREMENT
/begin MEASUREMENT tTPEVSTD "RAM value tTPEVSTD" UBYTE COMP_0463_S 1 100 0 255 ECU_ADDRESS 0xFFFF3E61 READ_WRITE /end MEASUREMENT
/begin MEASUREMENT tTPIHT "RAM value tTPIHT" UBYTE COMP_0463_S 1 100 0 255 ECU_ADDRESS 0xFFFF3E62 READ_WRITE /end MEASUREMENT
/begin MEASUREMENT tTSCSNG "RAM value tTSCSNG" UBYTE COMP_0463_S 1 100 0 255 ECU_ADDRESS 0xFFFF3E63 READ_WRITE /end MEASUREMENT
/begin MEASUREMENT tTSTOP "RAM value tTSTOP" UBYTE COMP_0463_S 1 100 0 255 ECU_ADDRESS 0xFFFF3E64 READ_WRITE /end MEASUREMENT
/begin MEASUREMENT tTTANG "RAM value tTTANG" UBYTE COMP_0463_S 1 100 0 255 ECU_ADDRESS 0xFFFF3E65 READ_WRITE /end MEASUREMENT
/begin MEASUREMENT tTTANGO "RAM value tTTANGO" UBYTE COMP_0463_S 1 100 0 255 ECU_ADDRESS 0xFFFF3E66 READ_WRITE /end MEASUREMENT
/begin MEASUREMENT tTTANGR "RAM value tTTANGR" UBYTE COMP_0463_S 1 100 0 255 ECU_ADDRESS 0xFFFF3E67 READ_WRITE /end MEASUREMENT
/begin MEASUREMENT tTTANGR2 "RAM value tTTANGR2" UBYTE COMP_0463_S 1 100 0 255 ECU_ADDRESS 0xFFFF3E68 READ_WRITE /end MEASUREMENT
/begin MEASUREMENT tTTANGS "RAM value tTTANGS" UBYTE COMP_0463_S 1 100 0 255 ECU_ADDRESS 0xFFFF3E69 READ_WRITE /end MEASUREMENT
/begin MEASUREMENT tTTEVDY41 "RAM value tTTEVDY41" UBYTE COMP_0463_S 1 100 0 255 ECU_ADDRESS 0xFFFF3E6A READ_WRITE /end MEASUREMENT
/begin MEASUREMENT tTTEVDY42 "RAM value tTTEVDY42" UBYTE COMP_0463_S 1 100 0 255 ECU_ADDRESS 0xFFFF3E6B READ_WRITE /end MEASUREMENT
/begin MEASUREMENT tTTFNG "RAM value tTTFNG" UBYTE COMP_0463_S 1 100 0 255 ECU_ADDRESS 0xFFFF3E6C READ_WRITE /end MEASUREMENT
/begin MEASUREMENT tTTFNGO "RAM value tTTFNGO" UBYTE COMP_0463_S 1 100 0 255 ECU_ADDRESS 0xFFFF3E6D READ_WRITE /end MEASUREMENT
/begin MEASUREMENT tTTFNGS "RAM value tTTFNGS" UBYTE COMP_0463_S 1 100 0 255 ECU_ADDRESS 0xFFFF3E6E READ_WRITE /end MEASUREMENT
/begin MEASUREMENT tTTMEVC4 "RAM value tTTMEVC4" UBYTE COMP_0463_S 1 100 0 255 ECU_ADDRESS 0xFFFF3E6F READ_WRITE /end MEASUREMENT
/begin MEASUREMENT tTTOHI "RAM value tTTOHI" UBYTE COMP_0463_S 1 100 0 255 ECU_ADDRESS 0xFFFF3E70 READ_WRITE /end MEASUREMENT
/begin MEASUREMENT tTTOLO "RAM value tTTOLO" UBYTE COMP_0463_S 1 100 0 255 ECU_ADDRESS 0xFFFF3E71 READ_WRITE /end MEASUREMENT
/begin MEASUREMENT tTTW1 "RAM value tTTW1" UBYTE COMP_0463_S 1 100 0 255 ECU_ADDRESS 0xFFFF3E72 READ_WRITE /end MEASUREMENT
/begin MEASUREMENT tTTW1O "RAM value tTTW1O" UBYTE COMP_0463_S 1 100 0 255 ECU_ADDRESS 0xFFFF3E73 READ_WRITE /end MEASUREMENT
/begin MEASUREMENT tTTW1S "RAM value tTTW1S" UBYTE COMP_0463_S 1 100 0 255 ECU_ADDRESS 0xFFFF3E74 READ_WRITE /end MEASUREMENT
/begin MEASUREMENT tTUDGNT "RAM value tTUDGNT" UBYTE COMP_0463_S 1 100 0 255 ECU_ADDRESS 0xFFFF3E75 READ_WRITE /end MEASUREMENT
/begin MEASUREMENT tTVC1NG "RAM value tTVC1NG" UBYTE COMP_0463_S 1 100 0 255 ECU_ADDRESS 0xFFFF3E76 READ_WRITE /end MEASUREMENT
/begin MEASUREMENT tTVC2NG "RAM value tTVC2NG" UBYTE COMP_0463_S 1 100 0 255 ECU_ADDRESS 0xFFFF3E77 READ_WRITE /end MEASUREMENT
/begin MEASUREMENT tTVOFQTD "RAM value tTVOFQTD" UBYTE COMP_0463_S 1 100 0 255 ECU_ADDRESS 0xFFFF3E78 READ_WRITE /end MEASUREMENT
/begin MEASUREMENT tTVSP5S "RAM value tTVSP5S" UBYTE COMP_0463_S 1 100 0 255 ECU_ADDRESS 0xFFFF3E79 READ_WRITE /end MEASUREMENT
/begin MEASUREMENT tTVSPNG2 "RAM value tTVSPNG2" UBYTE COMP_0463_S 1 100 0 255 ECU_ADDRESS 0xFFFF3E7A READ_WRITE /end MEASUREMENT
/begin MEASUREMENT tTVTCEOK "RAM value tTVTCEOK" UBYTE COMP_0463_S 1 100 0 255 ECU_ADDRESS 0xFFFF3E7B READ_WRITE /end MEASUREMENT
/begin MEASUREMENT tTVTCIOK "RAM value tTVTCIOK" UBYTE COMP_0463_S 1 100 0 255 ECU_ADDRESS 0xFFFF3E7D READ_WRITE /end MEASUREMENT
/begin MEASUREMENT tTWNGTM "RAM value tTWNGTM" UBYTE COMP_0463_S 1 100 0 255 ECU_ADDRESS 0xFFFF3E7F READ_WRITE /end MEASUREMENT
/begin MEASUREMENT tTWOKTM "RAM value tTWOKTM" UBYTE COMP_0463_S 1 100 0 255 ECU_ADDRESS 0xFFFF3E80 READ_WRITE /end MEASUREMENT
/begin MEASUREMENT tTZKFLTIM "RAM value tTZKFLTIM" UBYTE COMP_0463_S 1 100 0 255 ECU_ADDRESS 0xFFFF3E81 READ_WRITE /end MEASUREMENT
/begin MEASUREMENT tVEREND "RAM value tVEREND" UBYTE COMP_0463_S 1 100 0 255 ECU_ADDRESS 0xFFFF3E82 READ_WRITE /end MEASUREMENT
/begin MEASUREMENT tVICSNG "RAM value tVICSNG" UBYTE COMP_0463_S 1 100 0 255 ECU_ADDRESS 0xFFFF3E83 READ_WRITE /end MEASUREMENT
/begin MEASUREMENT tVICSNG21 "RAM value tVICSNG21" UBYTE COMP_0463_S 1 100 0 255 ECU_ADDRESS 0xFFFF3E84 READ_WRITE /end MEASUREMENT
/begin MEASUREMENT tVICSNG22 "RAM value tVICSNG22" UBYTE COMP_0463_S 1 100 0 255 ECU_ADDRESS 0xFFFF3E85 READ_WRITE /end MEASUREMENT
/begin MEASUREMENT tVSLNGT "RAM value tVSLNGT" UBYTE COMP_0463_S 1 100 0 255 ECU_ADDRESS 0xFFFF3E86 READ_WRITE /end MEASUREMENT
/begin MEASUREMENT tVSPASCD2 "RAM value tVSPASCD2" UBYTE COMP_0463_S 1 100 0 255 ECU_ADDRESS 0xFFFF3E87 READ_WRITE /end MEASUREMENT
/begin MEASUREMENT tVTCADCT "RAM value tVTCADCT" UBYTE COMP_0463_S 1 100 0 255 ECU_ADDRESS 0xFFFF3E88 READ_WRITE /end MEASUREMENT
/begin MEASUREMENT tVTCADCTE "RAM value tVTCADCTE" UBYTE COMP_0463_S 1 100 0 255 ECU_ADDRESS 0xFFFF3E8A READ_WRITE /end MEASUREMENT
/begin MEASUREMENT tVTCMLDLE "RAM value tVTCMLDLE" UBYTE COMP_0463_S 1 100 0 255 ECU_ADDRESS 0xFFFF3E8C READ_WRITE /end MEASUREMENT
/begin MEASUREMENT tVTCMLDLY "RAM value tVTCMLDLY" UBYTE COMP_0463_S 1 100 0 255 ECU_ADDRESS 0xFFFF3E8E READ_WRITE /end MEASUREMENT
/begin MEASUREMENT tVTCMLDLYG "RAM value tVTCMLDLYG" UBYTE COMP_0463_S 1 100 0 255 ECU_ADDRESS 0xFFFF3E90 READ_WRITE /end MEASUREMENT
/begin MEASUREMENT tVTCNGDL3 "RAM value tVTCNGDL3" UBYTE COMP_0463_S 1 100 0 255 ECU_ADDRESS 0xFFFF3E91 READ_WRITE /end MEASUREMENT
/begin MEASUREMENT tVTCNGDLE "RAM value tVTCNGDLE" UBYTE COMP_0463_S 1 100 0 255 ECU_ADDRESS 0xFFFF3E93 READ_WRITE /end MEASUREMENT
/begin MEASUREMENT tVTCNGDLYG "RAM value tVTCNGDLYG" UBYTE COMP_0463_S 1 100 0 255 ECU_ADDRESS 0xFFFF3E95 READ_WRITE /end MEASUREMENT
/begin MEASUREMENT tVTCODLY "RAM value tVTCODLY" UBYTE COMP_0463_S 1 100 0 255 ECU_ADDRESS 0xFFFF3E96 READ_WRITE /end MEASUREMENT
/begin MEASUREMENT tVTCODLYE "RAM value tVTCODLYE" UBYTE COMP_0463_S 1 100 0 255 ECU_ADDRESS 0xFFFF3E97 READ_WRITE /end MEASUREMENT
/begin MEASUREMENT tVTCSDLY "RAM value tVTCSDLY" UBYTE COMP_0463_S 1 100 0 255 ECU_ADDRESS 0xFFFF3E98 READ_WRITE /end MEASUREMENT
/begin MEASUREMENT tVTCSDLYE "RAM value tVTCSDLYE" UBYTE COMP_0463_S 1 100 0 255 ECU_ADDRESS 0xFFFF3E99 READ_WRITE /end MEASUREMENT
/begin MEASUREMENT tVTCSDLYG "RAM value tVTCSDLYG" UBYTE COMP_0463_S 1 100 0 255 ECU_ADDRESS 0xFFFF3E9A READ_WRITE /end MEASUREMENT
/begin MEASUREMENT tVTCSDLYIG "RAM value tVTCSDLYIG" UBYTE COMP_0463_S 1 100 0 255 ECU_ADDRESS 0xFFFF3E9B READ_WRITE /end MEASUREMENT
/begin MEASUREMENT tVTCSTOF "RAM value tVTCSTOF" UBYTE COMP_0463_S 1 100 0 255 ECU_ADDRESS 0xFFFF3E9C READ_WRITE /end MEASUREMENT
/begin MEASUREMENT tVTIMLDLY "RAM value tVTIMLDLY" UBYTE COMP_0463_S 1 100 0 255 ECU_ADDRESS 0xFFFF3E9D READ_WRITE /end MEASUREMENT
/begin MEASUREMENT tVTIMLDLYE "RAM value tVTIMLDLYE" UBYTE COMP_0463_S 1 100 0 255 ECU_ADDRESS 0xFFFF3E9F READ_WRITE /end MEASUREMENT
/begin MEASUREMENT tVTINGDL3 "RAM value tVTINGDL3" UBYTE COMP_0463_S 1 100 0 255 ECU_ADDRESS 0xFFFF3EA1 READ_WRITE /end MEASUREMENT
/begin MEASUREMENT tVTINGDL3E "RAM value tVTINGDL3E" UBYTE COMP_0463_S 1 100 0 255 ECU_ADDRESS 0xFFFF3EA3 READ_WRITE /end MEASUREMENT
/begin MEASUREMENT tVTNEDML "RAM value tVTNEDML" UBYTE COMP_0463_S 1 100 0 255 ECU_ADDRESS 0xFFFF3EA5 READ_WRITE /end MEASUREMENT
/begin MEASUREMENT tVTNEDML2 "RAM value tVTNEDML2" UBYTE COMP_0463_S 1 100 0 255 ECU_ADDRESS 0xFFFF3EA7 READ_WRITE /end MEASUREMENT
/begin MEASUREMENT tVTNEDML2E "RAM value tVTNEDML2E" UBYTE COMP_0463_S 1 100 0 255 ECU_ADDRESS 0xFFFF3EA9 READ_WRITE /end MEASUREMENT
/begin MEASUREMENT tVTNEDMLE "RAM value tVTNEDMLE" UBYTE COMP_0463_S 1 100 0 255 ECU_ADDRESS 0xFFFF3EAB READ_WRITE /end MEASUREMENT
/begin MEASUREMENT tWLNPDLY "RAM value tWLNPDLY" UBYTE COMP_0463_S 1 100 0 255 ECU_ADDRESS 0xFFFF3EAD READ_WRITE /end MEASUREMENT
/begin MEASUREMENT tSADT_S "RAM value tSADT_S" UBYTE COMP_0463_S 1 100 0 255 ECU_ADDRESS 0xFFFF3EAE READ_WRITE /end MEASUREMENT
/begin MEASUREMENT tADDBTIM "RAM value tADDBTIM" UBYTE COMP_0464_S 1 100 0 255 ECU_ADDRESS 0xFFFF1CD5 READ_WRITE /end MEASUREMENT
/begin MEASUREMENT tADDBTIME "RAM value tADDBTIME" UBYTE COMP_0464_S 1 100 0 255 ECU_ADDRESS 0xFFFF1CD7 READ_WRITE /end MEASUREMENT
/begin MEASUREMENT tAJCLUON "RAM value tAJCLUON" UBYTE COMP_0464_S 1 100 0 255 ECU_ADDRESS 0xFFFF1CD9 READ_WRITE /end MEASUREMENT
/begin MEASUREMENT tAJTQT0T2 "RAM value tAJTQT0T2" UBYTE COMP_0464_S 1 100 0 255 ECU_ADDRESS 0xFFFF1CDA READ_WRITE /end MEASUREMENT
/begin MEASUREMENT tAJTQT0TM "RAM value tAJTQT0TM" UBYTE COMP_0464_S 1 100 0 255 ECU_ADDRESS 0xFFFF1CDB READ_WRITE /end MEASUREMENT
/begin MEASUREMENT tAPS1CA "RAM value tAPS1CA" UBYTE COMP_0464_S 1 100 0 255 ECU_ADDRESS 0xFFFF1CDC READ_WRITE /end MEASUREMENT
/begin MEASUREMENT tAPS2CA "RAM value tAPS2CA" UBYTE COMP_0464_S 1 100 0 255 ECU_ADDRESS 0xFFFF1CDD READ_WRITE /end MEASUREMENT
/begin MEASUREMENT tAPSXCA "RAM value tAPSXCA" UBYTE COMP_0464_S 1 100 0 255 ECU_ADDRESS 0xFFFF1CDE READ_WRITE /end MEASUREMENT
/begin MEASUREMENT tCATSTRG "RAM value tCATSTRG" UBYTE COMP_0464_S 1 100 0 255 ECU_ADDRESS 0xFFFF1CDF READ_WRITE /end MEASUREMENT
/begin MEASUREMENT tCHK80CVT "RAM value tCHK80CVT" UBYTE COMP_0464_S 1 100 0 255 ECU_ADDRESS 0xFFFF1CE0 READ_WRITE /end MEASUREMENT
/begin MEASUREMENT tCHK80VSP "RAM value tCHK80VSP" UBYTE COMP_0464_S 1 100 0 255 ECU_ADDRESS 0xFFFF1CE1 READ_WRITE /end MEASUREMENT
/begin MEASUREMENT tCSALP "RAM value tCSALP" UBYTE COMP_0464_S 1 100 0 255 ECU_ADDRESS 0xFFFF1CE2 READ_WRITE /end MEASUREMENT
/begin MEASUREMENT tDACOFL "RAM value tDACOFL" UBYTE COMP_0464_S 1 100 0 255 ECU_ADDRESS 0xFFFF1CE3 READ_WRITE /end MEASUREMENT
/begin MEASUREMENT tDACONL "RAM value tDACONL" UBYTE COMP_0464_S 1 100 0 255 ECU_ADDRESS 0xFFFF1CE4 READ_WRITE /end MEASUREMENT
/begin MEASUREMENT tDLNEMSK "RAM value tDLNEMSK" UBYTE COMP_0464_S 1 100 0 255 ECU_ADDRESS 0xFFFF1CE5 READ_WRITE /end MEASUREMENT
/begin MEASUREMENT tDLPTDLU "RAM value tDLPTDLU" UBYTE COMP_0464_S 1 100 0 255 ECU_ADDRESS 0xFFFF1CE6 READ_WRITE /end MEASUREMENT
/begin MEASUREMENT tDLTDLY "RAM value tDLTDLY" UBYTE COMP_0464_S 1 100 0 255 ECU_ADDRESS 0xFFFF1CE7 READ_WRITE /end MEASUREMENT
/begin MEASUREMENT tDLTNMSK "RAM value tDLTNMSK" UBYTE COMP_0464_S 1 100 0 255 ECU_ADDRESS 0xFFFF1CE8 READ_WRITE /end MEASUREMENT
/begin MEASUREMENT tDLTTIM "RAM value tDLTTIM" UBYTE COMP_0464_S 1 100 0 255 ECU_ADDRESS 0xFFFF1CE9 READ_WRITE /end MEASUREMENT
/begin MEASUREMENT tDNSET0BF "RAM value tDNSET0BF" UBYTE COMP_0464_S 1 100 0 255 ECU_ADDRESS 0xFFFF1CEA READ_WRITE /end MEASUREMENT
/begin MEASUREMENT tDNSET0BS "RAM value tDNSET0BS" UBYTE COMP_0464_S 1 100 0 255 ECU_ADDRESS 0xFFFF1CEB READ_WRITE /end MEASUREMENT
/begin MEASUREMENT tDNSET0F "RAM value tDNSET0F" UBYTE COMP_0464_S 1 100 0 255 ECU_ADDRESS 0xFFFF1CEC READ_WRITE /end MEASUREMENT
/begin MEASUREMENT tDNSET0GN "RAM value tDNSET0GN" UBYTE COMP_0464_S 1 100 0 255 ECU_ADDRESS 0xFFFF1CED READ_WRITE /end MEASUREMENT
/begin MEASUREMENT tDNSET0PS "RAM value tDNSET0PS" UBYTE COMP_0464_S 1 100 0 255 ECU_ADDRESS 0xFFFF1CEE READ_WRITE /end MEASUREMENT
/begin MEASUREMENT tDNSET0S "RAM value tDNSET0S" UBYTE COMP_0464_S 1 100 0 255 ECU_ADDRESS 0xFFFF1CEF READ_WRITE /end MEASUREMENT
/begin MEASUREMENT tDNSET0SL "RAM value tDNSET0SL" UBYTE COMP_0464_S 1 100 0 255 ECU_ADDRESS 0xFFFF1CF0 READ_WRITE /end MEASUREMENT
/begin MEASUREMENT tDQCI "RAM value tDQCI" UBYTE COMP_0464_S 1 100 0 255 ECU_ADDRESS 0xFFFF1CF1 READ_WRITE /end MEASUREMENT
/begin MEASUREMENT tDQCIMAXH "RAM value tDQCIMAXH" UBYTE COMP_0464_S 1 100 0 255 ECU_ADDRESS 0xFFFF1CF2 READ_WRITE /end MEASUREMENT
/begin MEASUREMENT tDQCIMAXS "RAM value tDQCIMAXS" UBYTE COMP_0464_S 1 100 0 255 ECU_ADDRESS 0xFFFF1CF3 READ_WRITE /end MEASUREMENT
/begin MEASUREMENT tDQCIMINH "RAM value tDQCIMINH" UBYTE COMP_0464_S 1 100 0 255 ECU_ADDRESS 0xFFFF1CF4 READ_WRITE /end MEASUREMENT
/begin MEASUREMENT tDQCIMINS "RAM value tDQCIMINS" UBYTE COMP_0464_S 1 100 0 255 ECU_ADDRESS 0xFFFF1CF5 READ_WRITE /end MEASUREMENT
/begin MEASUREMENT tDTDTMR "RAM value tDTDTMR" UBYTE COMP_0464_S 1 100 0 255 ECU_ADDRESS 0xFFFF1CF6 READ_WRITE /end MEASUREMENT
/begin MEASUREMENT tDTDTMRU "RAM value tDTDTMRU" UBYTE COMP_0464_S 1 100 0 255 ECU_ADDRESS 0xFFFF1CF7 READ_WRITE /end MEASUREMENT
/begin MEASUREMENT tDTLOAD "RAM value tDTLOAD" UBYTE COMP_0464_S 1 100 0 255 ECU_ADDRESS 0xFFFF1CF8 READ_WRITE /end MEASUREMENT
/begin MEASUREMENT tDTLOAD3 "RAM value tDTLOAD3" UBYTE COMP_0464_S 1 100 0 255 ECU_ADDRESS 0xFFFF1CF9 READ_WRITE /end MEASUREMENT
/begin MEASUREMENT tDUVBDLY "RAM value tDUVBDLY" UBYTE COMP_0464_S 1 100 0 255 ECU_ADDRESS 0xFFFF1CFA READ_WRITE /end MEASUREMENT
/begin MEASUREMENT tEXNFC "RAM value tEXNFC" UBYTE COMP_0464_S 1 100 0 255 ECU_ADDRESS 0xFFFF1CFB READ_WRITE /end MEASUREMENT
/begin MEASUREMENT tFSTRDL "RAM value tFSTRDL" UBYTE COMP_0464_S 1 100 0 255 ECU_ADDRESS 0xFFFF1CFC READ_WRITE /end MEASUREMENT
/begin MEASUREMENT tFUKECDLY "RAM value tFUKECDLY" UBYTE COMP_0464_S 1 100 0 255 ECU_ADDRESS 0xFFFF1CFD READ_WRITE /end MEASUREMENT
/begin MEASUREMENT tFUKETIM "RAM value tFUKETIM" UBYTE COMP_0464_S 1 100 0 255 ECU_ADDRESS 0xFFFF1CFE READ_WRITE /end MEASUREMENT
/begin MEASUREMENT tGAKURITM "RAM value tGAKURITM" UBYTE COMP_0464_S 1 100 0 255 ECU_ADDRESS 0xFFFF1CFF READ_WRITE /end MEASUREMENT
/begin MEASUREMENT tGATZNETM "RAM value tGATZNETM" UBYTE COMP_0464_S 1 100 0 255 ECU_ADDRESS 0xFFFF1D00 READ_WRITE /end MEASUREMENT
/begin MEASUREMENT tGHFSCV "RAM value tGHFSCV" UBYTE COMP_0464_S 1 100 0 255 ECU_ADDRESS 0xFFFF1D01 READ_WRITE /end MEASUREMENT
/begin MEASUREMENT tGNDLY3 "RAM value tGNDLY3" UBYTE COMP_0464_S 1 100 0 255 ECU_ADDRESS 0xFFFF1D02 READ_WRITE /end MEASUREMENT
/begin MEASUREMENT tGOVDLY "RAM value tGOVDLY" UBYTE COMP_0464_S 1 100 0 255 ECU_ADDRESS 0xFFFF1D03 READ_WRITE /end MEASUREMENT
/begin MEASUREMENT tGOVDLY2 "RAM value tGOVDLY2" UBYTE COMP_0464_S 1 100 0 255 ECU_ADDRESS 0xFFFF1D04 READ_WRITE /end MEASUREMENT
/begin MEASUREMENT tGOVDLYE2 "RAM value tGOVDLYE2" UBYTE COMP_0464_S 1 100 0 255 ECU_ADDRESS 0xFFFF1D05 READ_WRITE /end MEASUREMENT
/begin MEASUREMENT tINHBOFFB "RAM value tINHBOFFB" UBYTE COMP_0464_S 1 100 0 255 ECU_ADDRESS 0xFFFF1D06 READ_WRITE /end MEASUREMENT
/begin MEASUREMENT tISCPST "RAM value tISCPST" UBYTE COMP_0464_S 1 100 0 255 ECU_ADDRESS 0xFFFF1D07 READ_WRITE /end MEASUREMENT
/begin MEASUREMENT tITRTFL "RAM value tITRTFL" UBYTE COMP_0464_S 1 100 0 255 ECU_ADDRESS 0xFFFF1D08 READ_WRITE /end MEASUREMENT
/begin MEASUREMENT tITSMDLY2 "RAM value tITSMDLY2" UBYTE COMP_0464_S 1 100 0 255 ECU_ADDRESS 0xFFFF1D09 READ_WRITE /end MEASUREMENT
/begin MEASUREMENT tJKADVLTM "RAM value tJKADVLTM" UBYTE COMP_0464_S 1 100 0 255 ECU_ADDRESS 0xFFFF1D0A READ_WRITE /end MEASUREMENT
/begin MEASUREMENT tL2MXTMH "RAM value tL2MXTMH" UBYTE COMP_0464_S 1 100 0 255 ECU_ADDRESS 0xFFFF1D0B READ_WRITE /end MEASUREMENT
/begin MEASUREMENT tLOCKDY "RAM value tLOCKDY" UBYTE COMP_0464_S 1 100 0 255 ECU_ADDRESS 0xFFFF1D0C READ_WRITE /end MEASUREMENT
/begin MEASUREMENT tLUOFDY "RAM value tLUOFDY" UBYTE COMP_0464_S 1 100 0 255 ECU_ADDRESS 0xFFFF1D0D READ_WRITE /end MEASUREMENT
/begin MEASUREMENT tMAXKNX "RAM value tMAXKNX" UBYTE COMP_0464_S 1 100 0 255 ECU_ADDRESS 0xFFFF1D0E READ_WRITE /end MEASUREMENT
/begin MEASUREMENT tMMTQUPTM "RAM value tMMTQUPTM" UBYTE COMP_0464_S 1 100 0 255 ECU_ADDRESS 0xFFFF1D0F READ_WRITE /end MEASUREMENT
/begin MEASUREMENT tNEJIRITM "RAM value tNEJIRITM" UBYTE COMP_0464_S 1 100 0 255 ECU_ADDRESS 0xFFFF1D10 READ_WRITE /end MEASUREMENT
/begin MEASUREMENT tNGDCAM "RAM value tNGDCAM" UBYTE COMP_0464_S 1 100 0 255 ECU_ADDRESS 0xFFFF1D11 READ_WRITE /end MEASUREMENT
/begin MEASUREMENT tNGDCAM2 "RAM value tNGDCAM2" UBYTE COMP_0464_S 1 100 0 255 ECU_ADDRESS 0xFFFF1D12 READ_WRITE /end MEASUREMENT
/begin MEASUREMENT tNGDPOS "RAM value tNGDPOS" UBYTE COMP_0464_S 1 100 0 255 ECU_ADDRESS 0xFFFF1D13 READ_WRITE /end MEASUREMENT
/begin MEASUREMENT tNIADVDWN "RAM value tNIADVDWN" UBYTE COMP_0464_S 1 100 0 255 ECU_ADDRESS 0xFFFF1D14 READ_WRITE /end MEASUREMENT
/begin MEASUREMENT tNIDLIHAC "RAM value tNIDLIHAC" UBYTE COMP_0464_S 1 100 0 255 ECU_ADDRESS 0xFFFF1D15 READ_WRITE /end MEASUREMENT
/begin MEASUREMENT tNSETVB1 "RAM value tNSETVB1" UBYTE COMP_0464_S 1 100 0 255 ECU_ADDRESS 0xFFFF1D16 READ_WRITE /end MEASUREMENT
/begin MEASUREMENT tPAKANJI "RAM value tPAKANJI" UBYTE COMP_0464_S 1 100 0 255 ECU_ADDRESS 0xFFFF1D17 READ_WRITE /end MEASUREMENT
/begin MEASUREMENT tPAKANJI2 "RAM value tPAKANJI2" UBYTE COMP_0464_S 1 100 0 255 ECU_ADDRESS 0xFFFF1D18 READ_WRITE /end MEASUREMENT
/begin MEASUREMENT tPRDTME "RAM value tPRDTME" UBYTE COMP_0464_S 1 100 0 255 ECU_ADDRESS 0xFFFF1D19 READ_WRITE /end MEASUREMENT
/begin MEASUREMENT tPSNGT3H "RAM value tPSNGT3H" UBYTE COMP_0464_S 1 100 0 255 ECU_ADDRESS 0xFFFF1D1A READ_WRITE /end MEASUREMENT
/begin MEASUREMENT tPSNGT3L "RAM value tPSNGT3L" UBYTE COMP_0464_S 1 100 0 255 ECU_ADDRESS 0xFFFF1D1B READ_WRITE /end MEASUREMENT
/begin MEASUREMENT tPSNGT5 "RAM value tPSNGT5" UBYTE COMP_0464_S 1 100 0 255 ECU_ADDRESS 0xFFFF1D1C READ_WRITE /end MEASUREMENT
/begin MEASUREMENT tPUMVBDLY "RAM value tPUMVBDLY" UBYTE COMP_0464_S 1 100 0 255 ECU_ADDRESS 0xFFFF1D1D READ_WRITE /end MEASUREMENT
/begin MEASUREMENT tQCK1 "RAM value tQCK1" UBYTE COMP_0464_S 1 100 0 255 ECU_ADDRESS 0xFFFF1D1E READ_WRITE /end MEASUREMENT
/begin MEASUREMENT tQCK2 "RAM value tQCK2" UBYTE COMP_0464_S 1 100 0 255 ECU_ADDRESS 0xFFFF1D1F READ_WRITE /end MEASUREMENT
/begin MEASUREMENT tQTASINV "RAM value tQTASINV" UBYTE COMP_0464_S 1 100 0 255 ECU_ADDRESS 0xFFFF1D20 READ_WRITE /end MEASUREMENT
/begin MEASUREMENT tRLIGDLY "RAM value tRLIGDLY" UBYTE COMP_0464_S 1 100 0 255 ECU_ADDRESS 0xFFFF1D21 READ_WRITE /end MEASUREMENT
/begin MEASUREMENT tRTOHDLY "RAM value tRTOHDLY" UBYTE COMP_0464_S 1 100 0 255 ECU_ADDRESS 0xFFFF1D22 READ_WRITE /end MEASUREMENT
/begin MEASUREMENT tRTOHLDTM "RAM value tRTOHLDTM" UBYTE COMP_0464_S 1 100 0 255 ECU_ADDRESS 0xFFFF1D23 READ_WRITE /end MEASUREMENT
/begin MEASUREMENT tSCKLUDLY "RAM value tSCKLUDLY" UBYTE COMP_0464_S 1 100 0 255 ECU_ADDRESS 0xFFFF1D24 READ_WRITE /end MEASUREMENT
/begin MEASUREMENT tSCVDL2 "RAM value tSCVDL2" UBYTE COMP_0464_S 1 100 0 255 ECU_ADDRESS 0xFFFF1D25 READ_WRITE /end MEASUREMENT
/begin MEASUREMENT tSCVDLY "RAM value tSCVDLY" UBYTE COMP_0464_S 1 100 0 255 ECU_ADDRESS 0xFFFF1D26 READ_WRITE /end MEASUREMENT
/begin MEASUREMENT tSCVOFTM "RAM value tSCVOFTM" UBYTE COMP_0464_S 1 100 0 255 ECU_ADDRESS 0xFFFF1D27 READ_WRITE /end MEASUREMENT
/begin MEASUREMENT tSCVONTM "RAM value tSCVONTM" UBYTE COMP_0464_S 1 100 0 255 ECU_ADDRESS 0xFFFF1D28 READ_WRITE /end MEASUREMENT
/begin MEASUREMENT tSHAGAIT1 "RAM value tSHAGAIT1" UBYTE COMP_0464_S 1 100 0 255 ECU_ADDRESS 0xFFFF1D29 READ_WRITE /end MEASUREMENT
/begin MEASUREMENT tSHAGAIT2 "RAM value tSHAGAIT2" UBYTE COMP_0464_S 1 100 0 255 ECU_ADDRESS 0xFFFF1D2A READ_WRITE /end MEASUREMENT
/begin MEASUREMENT tSHAGAIT3 "RAM value tSHAGAIT3" UBYTE COMP_0464_S 1 100 0 255 ECU_ADDRESS 0xFFFF1D2B READ_WRITE /end MEASUREMENT
/begin MEASUREMENT tSHOKTP "RAM value tSHOKTP" UBYTE COMP_0464_S 1 100 0 255 ECU_ADDRESS 0xFFFF1D2C READ_WRITE /end MEASUREMENT
/begin MEASUREMENT tSRSTDLY "RAM value tSRSTDLY" UBYTE COMP_0464_S 1 100 0 255 ECU_ADDRESS 0xFFFF1D2D READ_WRITE /end MEASUREMENT
/begin MEASUREMENT tSTALLDLY "RAM value tSTALLDLY" UBYTE COMP_0464_S 1 100 0 255 ECU_ADDRESS 0xFFFF1D2E READ_WRITE /end MEASUREMENT
/begin MEASUREMENT tSTOFFT "RAM value tSTOFFT" UBYTE COMP_0464_S 1 100 0 255 ECU_ADDRESS 0xFFFF1D2F READ_WRITE /end MEASUREMENT
/begin MEASUREMENT tSTTMOK "RAM value tSTTMOK" UBYTE COMP_0464_S 1 100 0 255 ECU_ADDRESS 0xFFFF1D30 READ_WRITE /end MEASUREMENT
/begin MEASUREMENT tTANTEI "RAM value tTANTEI" UBYTE COMP_0464_S 1 100 0 255 ECU_ADDRESS 0xFFFF1D31 READ_WRITE /end MEASUREMENT
/begin MEASUREMENT tTATDN1 "RAM value tTATDN1" UBYTE COMP_0464_S 1 100 0 255 ECU_ADDRESS 0xFFFF1D32 READ_WRITE /end MEASUREMENT
/begin MEASUREMENT tTATND1 "RAM value tTATND1" UBYTE COMP_0464_S 1 100 0 255 ECU_ADDRESS 0xFFFF1D33 READ_WRITE /end MEASUREMENT
/begin MEASUREMENT tTBONOFF "RAM value tTBONOFF" UBYTE COMP_0464_S 1 100 0 255 ECU_ADDRESS 0xFFFF1D34 READ_WRITE /end MEASUREMENT
/begin MEASUREMENT tTCLNGA "RAM value tTCLNGA" UBYTE COMP_0464_S 1 100 0 255 ECU_ADDRESS 0xFFFF1D35 READ_WRITE /end MEASUREMENT
/begin MEASUREMENT tTCPUBKUP "RAM value tTCPUBKUP" UBYTE COMP_0464_S 1 100 0 255 ECU_ADDRESS 0xFFFF1D36 READ_WRITE /end MEASUREMENT
/begin MEASUREMENT tTCVNLR "RAM value tTCVNLR" UBYTE COMP_0464_S 1 100 0 255 ECU_ADDRESS 0xFFFF1D37 READ_WRITE /end MEASUREMENT
/begin MEASUREMENT tTFCRD1 "RAM value tTFCRD1" UBYTE COMP_0464_S 1 100 0 255 ECU_ADDRESS 0xFFFF1D38 READ_WRITE /end MEASUREMENT
/begin MEASUREMENT tTFCRD2 "RAM value tTFCRD2" UBYTE COMP_0464_S 1 100 0 255 ECU_ADDRESS 0xFFFF1D39 READ_WRITE /end MEASUREMENT
/begin MEASUREMENT tTFCRD3 "RAM value tTFCRD3" UBYTE COMP_0464_S 1 100 0 255 ECU_ADDRESS 0xFFFF1D3A READ_WRITE /end MEASUREMENT
/begin MEASUREMENT tTHONDY "RAM value tTHONDY" UBYTE COMP_0464_S 1 100 0 255 ECU_ADDRESS 0xFFFF1D3B READ_WRITE /end MEASUREMENT
/begin MEASUREMENT tTINVGP "RAM value tTINVGP" UBYTE COMP_0464_S 1 100 0 255 ECU_ADDRESS 0xFFFF1D3C READ_WRITE /end MEASUREMENT
/begin MEASUREMENT tTIOFFON "RAM value tTIOFFON" UBYTE COMP_0464_S 1 100 0 255 ECU_ADDRESS 0xFFFF1D3D READ_WRITE /end MEASUREMENT
/begin MEASUREMENT tTMBRKOF "RAM value tTMBRKOF" UBYTE COMP_0464_S 1 100 0 255 ECU_ADDRESS 0xFFFF1D3E READ_WRITE /end MEASUREMENT
/begin MEASUREMENT tTMBRKOF1 "RAM value tTMBRKOF1" UBYTE COMP_0464_S 1 100 0 255 ECU_ADDRESS 0xFFFF1D3F READ_WRITE /end MEASUREMENT
/begin MEASUREMENT tTMDLTIM "RAM value tTMDLTIM" UBYTE COMP_0464_S 1 100 0 255 ECU_ADDRESS 0xFFFF1D40 READ_WRITE /end MEASUREMENT
/begin MEASUREMENT tTMGKTVO "RAM value tTMGKTVO" UBYTE COMP_0464_S 1 100 0 255 ECU_ADDRESS 0xFFFF1D41 READ_WRITE /end MEASUREMENT
/begin MEASUREMENT tTMHADI "RAM value tTMHADI" UBYTE COMP_0464_S 1 100 0 255 ECU_ADDRESS 0xFFFF1D42 READ_WRITE /end MEASUREMENT
/begin MEASUREMENT tTMIGSW "RAM value tTMIGSW" UBYTE COMP_0464_S 1 100 0 255 ECU_ADDRESS 0xFFFF1D43 READ_WRITE /end MEASUREMENT
/begin MEASUREMENT tTMINVDEC "RAM value tTMINVDEC" UBYTE COMP_0464_S 1 100 0 255 ECU_ADDRESS 0xFFFF1D44 READ_WRITE /end MEASUREMENT
/begin MEASUREMENT tTMISSL "RAM value tTMISSL" UBYTE COMP_0464_S 1 100 0 255 ECU_ADDRESS 0xFFFF1D45 READ_WRITE /end MEASUREMENT
/begin MEASUREMENT tTMISTY "RAM value tTMISTY" UBYTE COMP_0464_S 1 100 0 255 ECU_ADDRESS 0xFFFF1D46 READ_WRITE /end MEASUREMENT
/begin MEASUREMENT tTMLOF "RAM value tTMLOF" UBYTE COMP_0464_S 1 100 0 255 ECU_ADDRESS 0xFFFF1D47 READ_WRITE /end MEASUREMENT
/begin MEASUREMENT tTMLUBRK "RAM value tTMLUBRK" UBYTE COMP_0464_S 1 100 0 255 ECU_ADDRESS 0xFFFF1D48 READ_WRITE /end MEASUREMENT
/begin MEASUREMENT tTMLUOF "RAM value tTMLUOF" UBYTE COMP_0464_S 1 100 0 255 ECU_ADDRESS 0xFFFF1D49 READ_WRITE /end MEASUREMENT
/begin MEASUREMENT tTMPSOF "RAM value tTMPSOF" UBYTE COMP_0464_S 1 100 0 255 ECU_ADDRESS 0xFFFF1D4A READ_WRITE /end MEASUREMENT
/begin MEASUREMENT tTMSFT "RAM value tTMSFT" UBYTE COMP_0464_S 1 100 0 255 ECU_ADDRESS 0xFFFF1D4B READ_WRITE /end MEASUREMENT
/begin MEASUREMENT tTMSTON "RAM value tTMSTON" UBYTE COMP_0464_S 1 100 0 255 ECU_ADDRESS 0xFFFF1D4C READ_WRITE /end MEASUREMENT
/begin MEASUREMENT tTMVTCOL "RAM value tTMVTCOL" UBYTE COMP_0464_S 1 100 0 255 ECU_ADDRESS 0xFFFF1D4D READ_WRITE /end MEASUREMENT
/begin MEASUREMENT tTNICHTM "RAM value tTNICHTM" UBYTE COMP_0464_S 1 100 0 255 ECU_ADDRESS 0xFFFF1D4E READ_WRITE /end MEASUREMENT
/begin MEASUREMENT tTNIDLDN1 "RAM value tTNIDLDN1" UBYTE COMP_0464_S 1 100 0 255 ECU_ADDRESS 0xFFFF1D4F READ_WRITE /end MEASUREMENT
/begin MEASUREMENT tTNIDLDN2 "RAM value tTNIDLDN2" UBYTE COMP_0464_S 1 100 0 255 ECU_ADDRESS 0xFFFF1D50 READ_WRITE /end MEASUREMENT
/begin MEASUREMENT tTNIDLND1 "RAM value tTNIDLND1" UBYTE COMP_0464_S 1 100 0 255 ECU_ADDRESS 0xFFFF1D51 READ_WRITE /end MEASUREMENT
/begin MEASUREMENT tTNIDLND2 "RAM value tTNIDLND2" UBYTE COMP_0464_S 1 100 0 255 ECU_ADDRESS 0xFFFF1D52 READ_WRITE /end MEASUREMENT
/begin MEASUREMENT tTNIDNIN1 "RAM value tTNIDNIN1" UBYTE COMP_0464_S 1 100 0 255 ECU_ADDRESS 0xFFFF1D53 READ_WRITE /end MEASUREMENT
/begin MEASUREMENT tTNIDNIN2 "RAM value tTNIDNIN2" UBYTE COMP_0464_S 1 100 0 255 ECU_ADDRESS 0xFFFF1D54 READ_WRITE /end MEASUREMENT
/begin MEASUREMENT tTNIDNNI1 "RAM value tTNIDNNI1" UBYTE COMP_0464_S 1 100 0 255 ECU_ADDRESS 0xFFFF1D55 READ_WRITE /end MEASUREMENT
/begin MEASUREMENT tTNIDNNI2 "RAM value tTNIDNNI2" UBYTE COMP_0464_S 1 100 0 255 ECU_ADDRESS 0xFFFF1D56 READ_WRITE /end MEASUREMENT
/begin MEASUREMENT tTPPSFNG1 "RAM value tTPPSFNG1" UBYTE COMP_0464_S 1 100 0 255 ECU_ADDRESS 0xFFFF1D57 READ_WRITE /end MEASUREMENT
/begin MEASUREMENT tTPPSFNG2 "RAM value tTPPSFNG2" UBYTE COMP_0464_S 1 100 0 255 ECU_ADDRESS 0xFFFF1D58 READ_WRITE /end MEASUREMENT
/begin MEASUREMENT tTPS1CA "RAM value tTPS1CA" UBYTE COMP_0464_S 1 100 0 255 ECU_ADDRESS 0xFFFF1D59 READ_WRITE /end MEASUREMENT
/begin MEASUREMENT tTPS2CA "RAM value tTPS2CA" UBYTE COMP_0464_S 1 100 0 255 ECU_ADDRESS 0xFFFF1D5A READ_WRITE /end MEASUREMENT
/begin MEASUREMENT tTPSXCA "RAM value tTPSXCA" UBYTE COMP_0464_S 1 100 0 255 ECU_ADDRESS 0xFFFF1D5B READ_WRITE /end MEASUREMENT
/begin MEASUREMENT tTRFCD "RAM value tTRFCD" UBYTE COMP_0464_S 1 100 0 255 ECU_ADDRESS 0xFFFF1D5C READ_WRITE /end MEASUREMENT
/begin MEASUREMENT tTTCVCRI "RAM value tTTCVCRI" UBYTE COMP_0464_S 1 100 0 255 ECU_ADDRESS 0xFFFF1D5D READ_WRITE /end MEASUREMENT
/begin MEASUREMENT tTTCVTST "RAM value tTTCVTST" UBYTE COMP_0464_S 1 100 0 255 ECU_ADDRESS 0xFFFF1D5E READ_WRITE /end MEASUREMENT
/begin MEASUREMENT tTUNLOCKT "RAM value tTUNLOCKT" UBYTE COMP_0464_S 1 100 0 255 ECU_ADDRESS 0xFFFF1D5F READ_WRITE /end MEASUREMENT
/begin MEASUREMENT tTVTERDB "RAM value tTVTERDB" UBYTE COMP_0464_S 1 100 0 255 ECU_ADDRESS 0xFFFF1D60 READ_WRITE /end MEASUREMENT
/begin MEASUREMENT tTVTERDB1 "RAM value tTVTERDB1" UBYTE COMP_0464_S 1 100 0 255 ECU_ADDRESS 0xFFFF1D61 READ_WRITE /end MEASUREMENT
/begin MEASUREMENT tUNLOCK "RAM value tUNLOCK" UBYTE COMP_0464_S 1 100 0 255 ECU_ADDRESS 0xFFFF1D62 READ_WRITE /end MEASUREMENT
/begin MEASUREMENT tVBEGOF "RAM value tVBEGOF" UBYTE COMP_0464_S 1 100 0 255 ECU_ADDRESS 0xFFFF1D63 READ_WRITE /end MEASUREMENT
/begin MEASUREMENT tVTCDLY "RAM value tVTCDLY" UBYTE COMP_0464_S 1 100 0 255 ECU_ADDRESS 0xFFFF1D64 READ_WRITE /end MEASUREMENT
/begin MEASUREMENT tVTCDMP "RAM value tVTCDMP" UBYTE COMP_0464_S 1 100 0 255 ECU_ADDRESS 0xFFFF1D65 READ_WRITE /end MEASUREMENT
/begin MEASUREMENT tVTCDMPE "RAM value tVTCDMPE" UBYTE COMP_0464_S 1 100 0 255 ECU_ADDRESS 0xFFFF1D66 READ_WRITE /end MEASUREMENT
/begin MEASUREMENT tVTCLLT "RAM value tVTCLLT" UBYTE COMP_0464_S 1 100 0 255 ECU_ADDRESS 0xFFFF1D67 READ_WRITE /end MEASUREMENT
/begin MEASUREMENT tVTCLLTE "RAM value tVTCLLTE" UBYTE COMP_0464_S 1 100 0 255 ECU_ADDRESS 0xFFFF1D68 READ_WRITE /end MEASUREMENT
/begin MEASUREMENT tWOT2DLY "RAM value tWOT2DLY" UBYTE COMP_0464_S 1 100 0 255 ECU_ADDRESS 0xFFFF1D69 READ_WRITE /end MEASUREMENT
/begin MEASUREMENT tWT2ITCDL "RAM value tWT2ITCDL" UBYTE COMP_0464_S 1 100 0 255 ECU_ADDRESS 0xFFFF1D6A READ_WRITE /end MEASUREMENT
/begin MEASUREMENT tWT2NEDL "RAM value tWT2NEDL" UBYTE COMP_0464_S 1 100 0 255 ECU_ADDRESS 0xFFFF1D6B READ_WRITE /end MEASUREMENT
/begin MEASUREMENT tASCSWNGT "RAM value tASCSWNGT" UWORD COMP_0463_S 1 100 0 65535 ECU_ADDRESS 0xFFFF3F8E READ_WRITE /end MEASUREMENT
/begin MEASUREMENT tDWPTMAX "RAM value tDWPTMAX" UWORD COMP_0463_S 1 100 0 65535 ECU_ADDRESS 0xFFFF3F90 READ_WRITE /end MEASUREMENT
/begin MEASUREMENT tMCLMOIM2 "RAM value tMCLMOIM2" UWORD COMP_0463_S 1 100 0 65535 ECU_ADDRESS 0xFFFF3F92 READ_WRITE /end MEASUREMENT
/begin MEASUREMENT tMCLMOIM3 "RAM value tMCLMOIM3" UWORD COMP_0463_S 1 100 0 65535 ECU_ADDRESS 0xFFFF3F94 READ_WRITE /end MEASUREMENT
/begin MEASUREMENT tSLMTOKTM "RAM value tSLMTOKTM" UWORD COMP_0463_S 1 100 0 65535 ECU_ADDRESS 0xFFFF3F96 READ_WRITE /end MEASUREMENT
/begin MEASUREMENT tSSOFFCUT "RAM value tSSOFFCUT" UWORD COMP_0463_S 1 100 0 65535 ECU_ADDRESS 0xFFFF3F98 READ_WRITE /end MEASUREMENT
/begin MEASUREMENT tTDIRE12 "RAM value tTDIRE12" UWORD COMP_0463_S 1 100 0 65535 ECU_ADDRESS 0xFFFF3F9A READ_WRITE /end MEASUREMENT
/begin MEASUREMENT tTDIRE13 "RAM value tTDIRE13" UWORD COMP_0463_S 1 100 0 65535 ECU_ADDRESS 0xFFFF3F9C READ_WRITE /end MEASUREMENT
/begin MEASUREMENT tTDIREI9 "RAM value tTDIREI9" UWORD COMP_0463_S 1 100 0 65535 ECU_ADDRESS 0xFFFF3F9E READ_WRITE /end MEASUREMENT
/begin MEASUREMENT tTFGTP2 "RAM value tTFGTP2" UWORD COMP_0463_S 1 100 0 65535 ECU_ADDRESS 0xFFFF3FA0 READ_WRITE /end MEASUREMENT
/begin MEASUREMENT tACONRD "RAM value tACONRD" UBYTE COMP_0465_S 1 100 0 255 ECU_ADDRESS 0xFFFF3D2C READ_WRITE /end MEASUREMENT
/begin MEASUREMENT tAFHCTDD "RAM value tAFHCTDD" UBYTE COMP_0465_S 1 100 0 255 ECU_ADDRESS 0xFFFF3D2D READ_WRITE /end MEASUREMENT
/begin MEASUREMENT tAFSDLY "RAM value tAFSDLY" UBYTE COMP_0465_S 1 100 0 255 ECU_ADDRESS 0xFFFF3D2E READ_WRITE /end MEASUREMENT
/begin MEASUREMENT tAFSDLY1 "RAM value tAFSDLY1" UBYTE COMP_0465_S 1 100 0 255 ECU_ADDRESS 0xFFFF3D2F READ_WRITE /end MEASUREMENT
/begin MEASUREMENT tAFSDLY2 "RAM value tAFSDLY2" UBYTE COMP_0465_S 1 100 0 255 ECU_ADDRESS 0xFFFF3D30 READ_WRITE /end MEASUREMENT
/begin MEASUREMENT tAFVNGT1 "RAM value tAFVNGT1" UBYTE COMP_0465_S 1 100 0 255 ECU_ADDRESS 0xFFFF3D31 READ_WRITE /end MEASUREMENT
/begin MEASUREMENT tAFVNGT1C "RAM value tAFVNGT1C" UBYTE COMP_0465_S 1 100 0 255 ECU_ADDRESS 0xFFFF3D32 READ_WRITE /end MEASUREMENT
/begin MEASUREMENT tAPSDBLT1 "RAM value tAPSDBLT1" UBYTE COMP_0465_S 1 100 0 255 ECU_ADDRESS 0xFFFF3D33 READ_WRITE /end MEASUREMENT
/begin MEASUREMENT tBRKCHKT2 "RAM value tBRKCHKT2" UBYTE COMP_0465_S 1 100 0 255 ECU_ADDRESS 0xFFFF3D34 READ_WRITE /end MEASUREMENT
/begin MEASUREMENT tCCLDL1 "RAM value tCCLDL1" UBYTE COMP_0465_S 1 100 0 255 ECU_ADDRESS 0xFFFF3D35 READ_WRITE /end MEASUREMENT
/begin MEASUREMENT tCCLDL2 "RAM value tCCLDL2" UBYTE COMP_0465_S 1 100 0 255 ECU_ADDRESS 0xFFFF3D36 READ_WRITE /end MEASUREMENT
/begin MEASUREMENT tDCVOPTM "RAM value tDCVOPTM" UBYTE COMP_0465_S 1 100 0 255 ECU_ADDRESS 0xFFFF3D37 READ_WRITE /end MEASUREMENT
/begin MEASUREMENT tDCVOTME "RAM value tDCVOTME" UBYTE COMP_0465_S 1 100 0 255 ECU_ADDRESS 0xFFFF3D38 READ_WRITE /end MEASUREMENT
/begin MEASUREMENT tDLMFDT "RAM value tDLMFDT" UBYTE COMP_0465_S 1 100 0 255 ECU_ADDRESS 0xFFFF3D39 READ_WRITE /end MEASUREMENT
/begin MEASUREMENT tDLYCD3 "RAM value tDLYCD3" UBYTE COMP_0465_S 1 100 0 255 ECU_ADDRESS 0xFFFF3D3A READ_WRITE /end MEASUREMENT
/begin MEASUREMENT tDLYCD3V "RAM value tDLYCD3V" UBYTE COMP_0465_S 1 100 0 255 ECU_ADDRESS 0xFFFF3D3C READ_WRITE /end MEASUREMENT
/begin MEASUREMENT tDTFRATE1 "RAM value tDTFRATE1" UBYTE COMP_0465_S 1 100 0 255 ECU_ADDRESS 0xFFFF3D3E READ_WRITE /end MEASUREMENT
/begin MEASUREMENT tDTFRATE2 "RAM value tDTFRATE2" UBYTE COMP_0465_S 1 100 0 255 ECU_ADDRESS 0xFFFF3D3F READ_WRITE /end MEASUREMENT
/begin MEASUREMENT tECOLDLY "RAM value tECOLDLY" UBYTE COMP_0465_S 1 100 0 255 ECU_ADDRESS 0xFFFF3D40 READ_WRITE /end MEASUREMENT
/begin MEASUREMENT tEGROPD "RAM value tEGROPD" UBYTE COMP_0465_S 1 100 0 255 ECU_ADDRESS 0xFFFF3D41 READ_WRITE /end MEASUREMENT
/begin MEASUREMENT tENGTMR "RAM value tENGTMR" UBYTE COMP_0465_S 1 100 0 255 ECU_ADDRESS 0xFFFF3D42 READ_WRITE /end MEASUREMENT
/begin MEASUREMENT tETHSJDE "RAM value tETHSJDE" UBYTE COMP_0465_S 1 100 0 255 ECU_ADDRESS 0xFFFF3D43 READ_WRITE /end MEASUREMENT
/begin MEASUREMENT tETWJD "RAM value tETWJD" UBYTE COMP_0465_S 1 100 0 255 ECU_ADDRESS 0xFFFF3D44 READ_WRITE /end MEASUREMENT
/begin MEASUREMENT tEVSDLY2 "RAM value tEVSDLY2" UBYTE COMP_0465_S 1 100 0 255 ECU_ADDRESS 0xFFFF3D45 READ_WRITE /end MEASUREMENT
/begin MEASUREMENT tFPSTM "RAM value tFPSTM" UBYTE COMP_0465_S 1 100 0 255 ECU_ADDRESS 0xFFFF3D46 READ_WRITE /end MEASUREMENT
/begin MEASUREMENT tFSTWN "RAM value tFSTWN" UBYTE COMP_0465_S 1 100 0 255 ECU_ADDRESS 0xFFFF3D47 READ_WRITE /end MEASUREMENT
/begin MEASUREMENT tFTSNGDLY "RAM value tFTSNGDLY" UBYTE COMP_0465_S 1 100 0 255 ECU_ADDRESS 0xFFFF3D48 READ_WRITE /end MEASUREMENT
/begin MEASUREMENT tGAVGAFH "RAM value tGAVGAFH" UBYTE COMP_0465_S 1 100 0 255 ECU_ADDRESS 0xFFFF3D49 READ_WRITE /end MEASUREMENT
/begin MEASUREMENT tGRO2H "RAM value tGRO2H" UBYTE COMP_0465_S 1 100 0 255 ECU_ADDRESS 0xFFFF3D4A READ_WRITE /end MEASUREMENT
/begin MEASUREMENT tHCSDLY "RAM value tHCSDLY" UBYTE COMP_0465_S 1 100 0 255 ECU_ADDRESS 0xFFFF3D4B READ_WRITE /end MEASUREMENT
/begin MEASUREMENT tICTDLY "RAM value tICTDLY" UBYTE COMP_0465_S 1 100 0 255 ECU_ADDRESS 0xFFFF3D4C READ_WRITE /end MEASUREMENT
/begin MEASUREMENT tIDLDLY "RAM value tIDLDLY" UBYTE COMP_0465_S 1 100 0 255 ECU_ADDRESS 0xFFFF3D4D READ_WRITE /end MEASUREMENT
/begin MEASUREMENT tINJFRTM2 "RAM value tINJFRTM2" UBYTE COMP_0465_S 1 100 0 255 ECU_ADDRESS 0xFFFF3D4E READ_WRITE /end MEASUREMENT
/begin MEASUREMENT tINLDST "RAM value tINLDST" UBYTE COMP_0465_S 1 100 0 255 ECU_ADDRESS 0xFFFF3D4F READ_WRITE /end MEASUREMENT
/begin MEASUREMENT tISCDDLY "RAM value tISCDDLY" UBYTE COMP_0465_S 1 100 0 255 ECU_ADDRESS 0xFFFF3D50 READ_WRITE /end MEASUREMENT
/begin MEASUREMENT tLMDRATE1 "RAM value tLMDRATE1" UBYTE COMP_0465_S 1 100 0 255 ECU_ADDRESS 0xFFFF3D51 READ_WRITE /end MEASUREMENT
/begin MEASUREMENT tNEUTCNT "RAM value tNEUTCNT" UBYTE COMP_0465_S 1 100 0 255 ECU_ADDRESS 0xFFFF3D52 READ_WRITE /end MEASUREMENT
/begin MEASUREMENT tNSETWIP "RAM value tNSETWIP" UBYTE COMP_0465_S 1 100 0 255 ECU_ADDRESS 0xFFFF3D53 READ_WRITE /end MEASUREMENT
/begin MEASUREMENT tO2HROD "RAM value tO2HROD" UBYTE COMP_0465_S 1 100 0 255 ECU_ADDRESS 0xFFFF3D54 READ_WRITE /end MEASUREMENT
/begin MEASUREMENT tPCUTTM "RAM value tPCUTTM" UBYTE COMP_0465_S 1 100 0 255 ECU_ADDRESS 0xFFFF3D56 READ_WRITE /end MEASUREMENT
/begin MEASUREMENT tPMITDLY "RAM value tPMITDLY" UBYTE COMP_0465_S 1 100 0 255 ECU_ADDRESS 0xFFFF3D57 READ_WRITE /end MEASUREMENT
/begin MEASUREMENT tPRGCTME "RAM value tPRGCTME" UBYTE COMP_0465_S 1 100 0 255 ECU_ADDRESS 0xFFFF3D58 READ_WRITE /end MEASUREMENT
/begin MEASUREMENT tRCMTIME "RAM value tRCMTIME" UBYTE COMP_0465_S 1 100 0 255 ECU_ADDRESS 0xFFFF3D59 READ_WRITE /end MEASUREMENT
/begin MEASUREMENT tRCMTIME2 "RAM value tRCMTIME2" UBYTE COMP_0465_S 1 100 0 255 ECU_ADDRESS 0xFFFF3D5A READ_WRITE /end MEASUREMENT
/begin MEASUREMENT tRESTRUN "RAM value tRESTRUN" UBYTE COMP_0465_S 1 100 0 255 ECU_ADDRESS 0xFFFF3D5B READ_WRITE /end MEASUREMENT
/begin MEASUREMENT tRFBALT "RAM value tRFBALT" UBYTE COMP_0465_S 1 100 0 255 ECU_ADDRESS 0xFFFF3D5C READ_WRITE /end MEASUREMENT
/begin MEASUREMENT tRFBALT_V "RAM value tRFBALT_V" UBYTE COMP_0465_S 1 100 0 255 ECU_ADDRESS 0xFFFF3D5D READ_WRITE /end MEASUREMENT
/begin MEASUREMENT tRFBFCT "RAM value tRFBFCT" UBYTE COMP_0465_S 1 100 0 255 ECU_ADDRESS 0xFFFF3D5E READ_WRITE /end MEASUREMENT
/begin MEASUREMENT tRFBFCT_V "RAM value tRFBFCT_V" UBYTE COMP_0465_S 1 100 0 255 ECU_ADDRESS 0xFFFF3D5F READ_WRITE /end MEASUREMENT
/begin MEASUREMENT tRFBIDT "RAM value tRFBIDT" UBYTE COMP_0465_S 1 100 0 255 ECU_ADDRESS 0xFFFF3D60 READ_WRITE /end MEASUREMENT
/begin MEASUREMENT tRFBIDT_V "RAM value tRFBIDT_V" UBYTE COMP_0465_S 1 100 0 255 ECU_ADDRESS 0xFFFF3D61 READ_WRITE /end MEASUREMENT
/begin MEASUREMENT tRFBKMT "RAM value tRFBKMT" UBYTE COMP_0465_S 1 100 0 255 ECU_ADDRESS 0xFFFF3D62 READ_WRITE /end MEASUREMENT
/begin MEASUREMENT tRFBKMT_V "RAM value tRFBKMT_V" UBYTE COMP_0465_S 1 100 0 255 ECU_ADDRESS 0xFFFF3D63 READ_WRITE /end MEASUREMENT
/begin MEASUREMENT tRFCFMT1 "RAM value tRFCFMT1" UBYTE COMP_0465_S 1 100 0 255 ECU_ADDRESS 0xFFFF3D64 READ_WRITE /end MEASUREMENT
/begin MEASUREMENT tRFCFMTM "RAM value tRFCFMTM" UBYTE COMP_0465_S 1 100 0 255 ECU_ADDRESS 0xFFFF3D65 READ_WRITE /end MEASUREMENT
/begin MEASUREMENT tROHTM "RAM value tROHTM" UBYTE COMP_0465_S 1 100 0 255 ECU_ADDRESS 0xFFFF3D66 READ_WRITE /end MEASUREMENT
/begin MEASUREMENT tROHTON "RAM value tROHTON" UBYTE COMP_0465_S 1 100 0 255 ECU_ADDRESS 0xFFFF3D67 READ_WRITE /end MEASUREMENT
/begin MEASUREMENT tROJDLY "RAM value tROJDLY" UBYTE COMP_0465_S 1 100 0 255 ECU_ADDRESS 0xFFFF3D69 READ_WRITE /end MEASUREMENT
/begin MEASUREMENT tROJFCD "RAM value tROJFCD" UBYTE COMP_0465_S 1 100 0 255 ECU_ADDRESS 0xFFFF3D6A READ_WRITE /end MEASUREMENT
/begin MEASUREMENT tROXJSD "RAM value tROXJSD" UBYTE COMP_0465_S 1 100 0 255 ECU_ADDRESS 0xFFFF3D6C READ_WRITE /end MEASUREMENT
/begin MEASUREMENT tSGONTM "RAM value tSGONTM" UBYTE COMP_0465_S 1 100 0 255 ECU_ADDRESS 0xFFFF3D6D READ_WRITE /end MEASUREMENT
/begin MEASUREMENT tTAFHDLY "RAM value tTAFHDLY" UBYTE COMP_0465_S 1 100 0 255 ECU_ADDRESS 0xFFFF3D6E READ_WRITE /end MEASUREMENT
/begin MEASUREMENT tTAFHNGT "RAM value tTAFHNGT" UBYTE COMP_0465_S 1 100 0 255 ECU_ADDRESS 0xFFFF3D6F READ_WRITE /end MEASUREMENT
/begin MEASUREMENT tTBATSC "RAM value tTBATSC" UBYTE COMP_0465_S 1 100 0 255 ECU_ADDRESS 0xFFFF3D70 READ_WRITE /end MEASUREMENT
/begin MEASUREMENT tTBATSH "RAM value tTBATSH" UBYTE COMP_0465_S 1 100 0 255 ECU_ADDRESS 0xFFFF3D71 READ_WRITE /end MEASUREMENT
/begin MEASUREMENT tTBATSL "RAM value tTBATSL" UBYTE COMP_0465_S 1 100 0 255 ECU_ADDRESS 0xFFFF3D72 READ_WRITE /end MEASUREMENT
/begin MEASUREMENT tTBATSR1 "RAM value tTBATSR1" UBYTE COMP_0465_S 1 100 0 255 ECU_ADDRESS 0xFFFF3D73 READ_WRITE /end MEASUREMENT
/begin MEASUREMENT tTBATSR2 "RAM value tTBATSR2" UBYTE COMP_0465_S 1 100 0 255 ECU_ADDRESS 0xFFFF3D74 READ_WRITE /end MEASUREMENT
/begin MEASUREMENT tTBTSH "RAM value tTBTSH" UBYTE COMP_0465_S 1 100 0 255 ECU_ADDRESS 0xFFFF3D75 READ_WRITE /end MEASUREMENT
/begin MEASUREMENT tTBTSL "RAM value tTBTSL" UBYTE COMP_0465_S 1 100 0 255 ECU_ADDRESS 0xFFFF3D76 READ_WRITE /end MEASUREMENT
/begin MEASUREMENT tTCLO2D "RAM value tTCLO2D" UBYTE COMP_0465_S 1 100 0 255 ECU_ADDRESS 0xFFFF3D77 READ_WRITE /end MEASUREMENT
/begin MEASUREMENT tTCVIGONL "RAM value tTCVIGONL" UBYTE COMP_0465_S 1 100 0 255 ECU_ADDRESS 0xFFFF3D78 READ_WRITE /end MEASUREMENT
/begin MEASUREMENT tTDCVOTM "RAM value tTDCVOTM" UBYTE COMP_0465_S 1 100 0 255 ECU_ADDRESS 0xFFFF3D79 READ_WRITE /end MEASUREMENT
/begin MEASUREMENT tTDLYMF "RAM value tTDLYMF" UBYTE COMP_0465_S 1 100 0 255 ECU_ADDRESS 0xFFFF3D7A READ_WRITE /end MEASUREMENT
/begin MEASUREMENT tTDRYTIME "RAM value tTDRYTIME" UBYTE COMP_0465_S 1 100 0 255 ECU_ADDRESS 0xFFFF3D7B READ_WRITE /end MEASUREMENT
/begin MEASUREMENT tTDSTAF2 "RAM value tTDSTAF2" UBYTE COMP_0465_S 1 100 0 255 ECU_ADDRESS 0xFFFF3D7C READ_WRITE /end MEASUREMENT
/begin MEASUREMENT tTDTFNG1 "RAM value tTDTFNG1" UBYTE COMP_0465_S 1 100 0 255 ECU_ADDRESS 0xFFFF3D7D READ_WRITE /end MEASUREMENT
/begin MEASUREMENT tTDTFNG2 "RAM value tTDTFNG2" UBYTE COMP_0465_S 1 100 0 255 ECU_ADDRESS 0xFFFF3D7E READ_WRITE /end MEASUREMENT
/begin MEASUREMENT tTHRO2 "RAM value tTHRO2" UBYTE COMP_0465_S 1 100 0 255 ECU_ADDRESS 0xFFFF3D7F READ_WRITE /end MEASUREMENT
/begin MEASUREMENT tTHRO2C "RAM value tTHRO2C" UBYTE COMP_0465_S 1 100 0 255 ECU_ADDRESS 0xFFFF3D80 READ_WRITE /end MEASUREMENT
/begin MEASUREMENT tTMATCK "RAM value tTMATCK" UBYTE COMP_0465_S 1 100 0 255 ECU_ADDRESS 0xFFFF3D81 READ_WRITE /end MEASUREMENT
/begin MEASUREMENT tTMDOS "RAM value tTMDOS" UBYTE COMP_0465_S 1 100 0 255 ECU_ADDRESS 0xFFFF3D82 READ_WRITE /end MEASUREMENT
/begin MEASUREMENT tTMEVLNS "RAM value tTMEVLNS" UBYTE COMP_0465_S 1 100 0 255 ECU_ADDRESS 0xFFFF3D83 READ_WRITE /end MEASUREMENT
/begin MEASUREMENT tTMISCCNT "RAM value tTMISCCNT" UBYTE COMP_0465_S 1 100 0 255 ECU_ADDRESS 0xFFFF3D84 READ_WRITE /end MEASUREMENT
/begin MEASUREMENT tTMNOACT "RAM value tTMNOACT" UBYTE COMP_0465_S 1 100 0 255 ECU_ADDRESS 0xFFFF3D85 READ_WRITE /end MEASUREMENT
/begin MEASUREMENT tTMPIST "RAM value tTMPIST" UBYTE COMP_0465_S 1 100 0 255 ECU_ADDRESS 0xFFFF3D86 READ_WRITE /end MEASUREMENT
/begin MEASUREMENT tTMRND2 "RAM value tTMRND2" UBYTE COMP_0465_S 1 100 0 255 ECU_ADDRESS 0xFFFF3D87 READ_WRITE /end MEASUREMENT
/begin MEASUREMENT tTMRNGD "RAM value tTMRNGD" UBYTE COMP_0465_S 1 100 0 255 ECU_ADDRESS 0xFFFF3D88 READ_WRITE /end MEASUREMENT
/begin MEASUREMENT tTMRNGF "RAM value tTMRNGF" UBYTE COMP_0465_S 1 100 0 255 ECU_ADDRESS 0xFFFF3D89 READ_WRITE /end MEASUREMENT
/begin MEASUREMENT tTMRNSD "RAM value tTMRNSD" UBYTE COMP_0465_S 1 100 0 255 ECU_ADDRESS 0xFFFF3D8A READ_WRITE /end MEASUREMENT
/begin MEASUREMENT tTMRO2H "RAM value tTMRO2H" UBYTE COMP_0465_S 1 100 0 255 ECU_ADDRESS 0xFFFF3D8B READ_WRITE /end MEASUREMENT
/begin MEASUREMENT tTMTAN1 "RAM value tTMTAN1" UBYTE COMP_0465_S 1 100 0 255 ECU_ADDRESS 0xFFFF3D8C READ_WRITE /end MEASUREMENT
/begin MEASUREMENT tTMTAN2 "RAM value tTMTAN2" UBYTE COMP_0465_S 1 100 0 255 ECU_ADDRESS 0xFFFF3D8D READ_WRITE /end MEASUREMENT
/begin MEASUREMENT tTMTRP1 "RAM value tTMTRP1" UBYTE COMP_0465_S 1 100 0 255 ECU_ADDRESS 0xFFFF3D8E READ_WRITE /end MEASUREMENT
/begin MEASUREMENT tTMTRP2 "RAM value tTMTRP2" UBYTE COMP_0465_S 1 100 0 255 ECU_ADDRESS 0xFFFF3D8F READ_WRITE /end MEASUREMENT
/begin MEASUREMENT tTMTRP3 "RAM value tTMTRP3" UBYTE COMP_0465_S 1 100 0 255 ECU_ADDRESS 0xFFFF3D90 READ_WRITE /end MEASUREMENT
/begin MEASUREMENT tTMTRP5 "RAM value tTMTRP5" UBYTE COMP_0465_S 1 100 0 255 ECU_ADDRESS 0xFFFF3D91 READ_WRITE /end MEASUREMENT
/begin MEASUREMENT tTNCONF "RAM value tTNCONF" UBYTE COMP_0465_S 1 100 0 255 ECU_ADDRESS 0xFFFF3D92 READ_WRITE /end MEASUREMENT
/begin MEASUREMENT tTOSNGD "RAM value tTOSNGD" UBYTE COMP_0465_S 1 100 0 255 ECU_ADDRESS 0xFFFF3D93 READ_WRITE /end MEASUREMENT
/begin MEASUREMENT tTPRGCTM "RAM value tTPRGCTM" UBYTE COMP_0465_S 1 100 0 255 ECU_ADDRESS 0xFFFF3D94 READ_WRITE /end MEASUREMENT
/begin MEASUREMENT tTSYSCHK "RAM value tTSYSCHK" UBYTE COMP_0465_S 1 100 0 255 ECU_ADDRESS 0xFFFF3D95 READ_WRITE /end MEASUREMENT
/begin MEASUREMENT tTTANVDY "RAM value tTTANVDY" UBYTE COMP_0465_S 1 100 0 255 ECU_ADDRESS 0xFFFF3D96 READ_WRITE /end MEASUREMENT
/begin MEASUREMENT tTTIMISC "RAM value tTTIMISC" UBYTE COMP_0465_S 1 100 0 255 ECU_ADDRESS 0xFFFF3D97 READ_WRITE /end MEASUREMENT
/begin MEASUREMENT tTTIMISCH "RAM value tTTIMISCH" UBYTE COMP_0465_S 1 100 0 255 ECU_ADDRESS 0xFFFF3D98 READ_WRITE /end MEASUREMENT
/begin MEASUREMENT tTTIMISCL "RAM value tTTIMISCL" UBYTE COMP_0465_S 1 100 0 255 ECU_ADDRESS 0xFFFF3D99 READ_WRITE /end MEASUREMENT
/begin MEASUREMENT tTTMEVC3 "RAM value tTTMEVC3" UBYTE COMP_0465_S 1 100 0 255 ECU_ADDRESS 0xFFFF3D9A READ_WRITE /end MEASUREMENT
/begin MEASUREMENT tTTWINTF "RAM value tTTWINTF" UBYTE COMP_0465_S 1 100 0 255 ECU_ADDRESS 0xFFFF3D9B READ_WRITE /end MEASUREMENT
/begin MEASUREMENT tTWETTIME "RAM value tTWETTIME" UBYTE COMP_0465_S 1 100 0 255 ECU_ADDRESS 0xFFFF3D9C READ_WRITE /end MEASUREMENT
/begin MEASUREMENT tTWPASS "RAM value tTWPASS" UBYTE COMP_0465_S 1 100 0 255 ECU_ADDRESS 0xFFFF3D9D READ_WRITE /end MEASUREMENT
/begin MEASUREMENT tVSPTM "RAM value tVSPTM" UBYTE COMP_0465_S 1 100 0 255 ECU_ADDRESS 0xFFFF3D9E READ_WRITE /end MEASUREMENT
/begin MEASUREMENT tVSPTME "RAM value tVSPTME" UBYTE COMP_0465_S 1 100 0 255 ECU_ADDRESS 0xFFFF3D9F READ_WRITE /end MEASUREMENT
/begin MEASUREMENT tACMAINGT "RAM value tACMAINGT" UBYTE COMP_0464_S 1 100 0 255 ECU_ADDRESS 0xFFFF3EAF READ_WRITE /end MEASUREMENT
/begin MEASUREMENT tACNIDY "RAM value tACNIDY" UBYTE COMP_0464_S 1 100 0 255 ECU_ADDRESS 0xFFFF3EB0 READ_WRITE /end MEASUREMENT
/begin MEASUREMENT tADJTMR "RAM value tADJTMR" UBYTE COMP_0464_S 1 100 0 255 ECU_ADDRESS 0xFFFF3EB1 READ_WRITE /end MEASUREMENT
/begin MEASUREMENT tAFDGNT "RAM value tAFDGNT" UBYTE COMP_0464_S 1 100 0 255 ECU_ADDRESS 0xFFFF3EB2 READ_WRITE /end MEASUREMENT
/begin MEASUREMENT tAFTHNG "RAM value tAFTHNG" UBYTE COMP_0464_S 1 100 0 255 ECU_ADDRESS 0xFFFF3EB3 READ_WRITE /end MEASUREMENT
/begin MEASUREMENT tAGBRTDNG "RAM value tAGBRTDNG" UBYTE COMP_0464_S 1 100 0 255 ECU_ADDRESS 0xFFFF3EB4 READ_WRITE /end MEASUREMENT
/begin MEASUREMENT tAPS1HI "RAM value tAPS1HI" UBYTE COMP_0464_S 1 100 0 255 ECU_ADDRESS 0xFFFF3EB5 READ_WRITE /end MEASUREMENT
/begin MEASUREMENT tAPS1LOW "RAM value tAPS1LOW" UBYTE COMP_0464_S 1 100 0 255 ECU_ADDRESS 0xFFFF3EB6 READ_WRITE /end MEASUREMENT
/begin MEASUREMENT tAPS2HI "RAM value tAPS2HI" UBYTE COMP_0464_S 1 100 0 255 ECU_ADDRESS 0xFFFF3EB7 READ_WRITE /end MEASUREMENT
/begin MEASUREMENT tAPS2LOW "RAM value tAPS2LOW" UBYTE COMP_0464_S 1 100 0 255 ECU_ADDRESS 0xFFFF3EB8 READ_WRITE /end MEASUREMENT
/begin MEASUREMENT tAPSDBLT2 "RAM value tAPSDBLT2" UBYTE COMP_0464_S 1 100 0 255 ECU_ADDRESS 0xFFFF3EB9 READ_WRITE /end MEASUREMENT
/begin MEASUREMENT tASCDCTNG1 "RAM value tASCDCTNG1" UBYTE COMP_0464_S 1 100 0 255 ECU_ADDRESS 0xFFFF3EBA READ_WRITE /end MEASUREMENT
/begin MEASUREMENT tASCDCTNG2 "RAM value tASCDCTNG2" UBYTE COMP_0464_S 1 100 0 255 ECU_ADDRESS 0xFFFF3EBB READ_WRITE /end MEASUREMENT
/begin MEASUREMENT tASCDCTNG3 "RAM value tASCDCTNG3" UBYTE COMP_0464_S 1 100 0 255 ECU_ADDRESS 0xFFFF3EBC READ_WRITE /end MEASUREMENT
/begin MEASUREMENT tASCDCTNG4 "RAM value tASCDCTNG4" UBYTE COMP_0464_S 1 100 0 255 ECU_ADDRESS 0xFFFF3EBD READ_WRITE /end MEASUREMENT
/begin MEASUREMENT tASCDCTNG5 "RAM value tASCDCTNG5" UBYTE COMP_0464_S 1 100 0 255 ECU_ADDRESS 0xFFFF3EBE READ_WRITE /end MEASUREMENT
/begin MEASUREMENT tASCDCTNG6 "RAM value tASCDCTNG6" UBYTE COMP_0464_S 1 100 0 255 ECU_ADDRESS 0xFFFF3EBF READ_WRITE /end MEASUREMENT
/begin MEASUREMENT tASCDDTNG "RAM value tASCDDTNG" UBYTE COMP_0464_S 1 100 0 255 ECU_ADDRESS 0xFFFF3EC0 READ_WRITE /end MEASUREMENT
/begin MEASUREMENT tASCDXNG1 "RAM value tASCDXNG1" UBYTE COMP_0464_S 1 100 0 255 ECU_ADDRESS 0xFFFF3EC1 READ_WRITE /end MEASUREMENT
/begin MEASUREMENT tASCDXNG2 "RAM value tASCDXNG2" UBYTE COMP_0464_S 1 100 0 255 ECU_ADDRESS 0xFFFF3EC2 READ_WRITE /end MEASUREMENT
/begin MEASUREMENT tBKKD "RAM value tBKKD" UBYTE COMP_0464_S 1 100 0 255 ECU_ADDRESS 0xFFFF3EC3 READ_WRITE /end MEASUREMENT
/begin MEASUREMENT tBNCPOFF "RAM value tBNCPOFF" UBYTE COMP_0464_S 1 100 0 255 ECU_ADDRESS 0xFFFF3EC4 READ_WRITE /end MEASUREMENT
/begin MEASUREMENT tBOSBRKTM "RAM value tBOSBRKTM" UBYTE COMP_0464_S 1 100 0 255 ECU_ADDRESS 0xFFFF3EC5 READ_WRITE /end MEASUREMENT
/begin MEASUREMENT tBOSINTVL "RAM value tBOSINTVL" UBYTE COMP_0464_S 1 100 0 255 ECU_ADDRESS 0xFFFF3EC6 READ_WRITE /end MEASUREMENT
/begin MEASUREMENT tBRKCHKT1 "RAM value tBRKCHKT1" UBYTE COMP_0464_S 1 100 0 255 ECU_ADDRESS 0xFFFF3EC7 READ_WRITE /end MEASUREMENT
/begin MEASUREMENT tCFCD "RAM value tCFCD" UBYTE COMP_0464_S 1 100 0 255 ECU_ADDRESS 0xFFFF3EC8 READ_WRITE /end MEASUREMENT
/begin MEASUREMENT tCFCD2 "RAM value tCFCD2" UBYTE COMP_0464_S 1 100 0 255 ECU_ADDRESS 0xFFFF3EC9 READ_WRITE /end MEASUREMENT
/begin MEASUREMENT tCFRD "RAM value tCFRD" UBYTE COMP_0464_S 1 100 0 255 ECU_ADDRESS 0xFFFF3ECA READ_WRITE /end MEASUREMENT
/begin MEASUREMENT tCRULMPTM "RAM value tCRULMPTM" UBYTE COMP_0464_S 1 100 0 255 ECU_ADDRESS 0xFFFF3ECB READ_WRITE /end MEASUREMENT
/begin MEASUREMENT tCSNGDC "RAM value tCSNGDC" UBYTE COMP_0464_S 1 100 0 255 ECU_ADDRESS 0xFFFF3ECC READ_WRITE /end MEASUREMENT
/begin MEASUREMENT tCSNGDP "RAM value tCSNGDP" UBYTE COMP_0464_S 1 100 0 255 ECU_ADDRESS 0xFFFF3ECD READ_WRITE /end MEASUREMENT
/begin MEASUREMENT tCSNGSTC "RAM value tCSNGSTC" UBYTE COMP_0464_S 1 100 0 255 ECU_ADDRESS 0xFFFF3ECE READ_WRITE /end MEASUREMENT
/begin MEASUREMENT tCSNGSTP "RAM value tCSNGSTP" UBYTE COMP_0464_S 1 100 0 255 ECU_ADDRESS 0xFFFF3ECF READ_WRITE /end MEASUREMENT
/begin MEASUREMENT tCTCNCT "RAM value tCTCNCT" UBYTE COMP_0464_S 1 100 0 255 ECU_ADDRESS 0xFFFF3ED0 READ_WRITE /end MEASUREMENT
/begin MEASUREMENT tCVCFLS "RAM value tCVCFLS" UBYTE COMP_0464_S 1 100 0 255 ECU_ADDRESS 0xFFFF3ED1 READ_WRITE /end MEASUREMENT
/begin MEASUREMENT tCVCUOK "RAM value tCVCUOK" UBYTE COMP_0464_S 1 100 0 255 ECU_ADDRESS 0xFFFF3ED2 READ_WRITE /end MEASUREMENT
/begin MEASUREMENT tCVTIUPDT "RAM value tCVTIUPDT" UBYTE COMP_0464_S 1 100 0 255 ECU_ADDRESS 0xFFFF3ED3 READ_WRITE /end MEASUREMENT
/begin MEASUREMENT tDBLDLY "RAM value tDBLDLY" UBYTE COMP_0464_S 1 100 0 255 ECU_ADDRESS 0xFFFF3ED4 READ_WRITE /end MEASUREMENT
/begin MEASUREMENT tDDGNTC "RAM value tDDGNTC" UBYTE COMP_0464_S 1 100 0 255 ECU_ADDRESS 0xFFFF3ED5 READ_WRITE /end MEASUREMENT
/begin MEASUREMENT tDLSRVONG "RAM value tDLSRVONG" UBYTE COMP_0464_S 1 100 0 255 ECU_ADDRESS 0xFFFF3ED6 READ_WRITE /end MEASUREMENT
/begin MEASUREMENT tDNSETEMN "RAM value tDNSETEMN" UBYTE COMP_0464_S 1 100 0 255 ECU_ADDRESS 0xFFFF3ED7 READ_WRITE /end MEASUREMENT
/begin MEASUREMENT tDTEPNG "RAM value tDTEPNG" UBYTE COMP_0464_S 1 100 0 255 ECU_ADDRESS 0xFFFF3ED8 READ_WRITE /end MEASUREMENT
/begin MEASUREMENT tDTVOGT "RAM value tDTVOGT" UBYTE COMP_0464_S 1 100 0 255 ECU_ADDRESS 0xFFFF3ED9 READ_WRITE /end MEASUREMENT
/begin MEASUREMENT tESPACKNG "RAM value tESPACKNG" UBYTE COMP_0464_S 1 100 0 255 ECU_ADDRESS 0xFFFF3EDA READ_WRITE /end MEASUREMENT
/begin MEASUREMENT tESPCLKNG "RAM value tESPCLKNG" UBYTE COMP_0464_S 1 100 0 255 ECU_ADDRESS 0xFFFF3EDB READ_WRITE /end MEASUREMENT
/begin MEASUREMENT tETCON "RAM value tETCON" UBYTE COMP_0464_S 1 100 0 255 ECU_ADDRESS 0xFFFF3EDC READ_WRITE /end MEASUREMENT
/begin MEASUREMENT tETSCLKNG "RAM value tETSCLKNG" UBYTE COMP_0464_S 1 100 0 255 ECU_ADDRESS 0xFFFF3EDD READ_WRITE /end MEASUREMENT
/begin MEASUREMENT tETSIVDNG "RAM value tETSIVDNG" UBYTE COMP_0464_S 1 100 0 255 ECU_ADDRESS 0xFFFF3EDE READ_WRITE /end MEASUREMENT
/begin MEASUREMENT tETSLNKNG "RAM value tETSLNKNG" UBYTE COMP_0464_S 1 100 0 255 ECU_ADDRESS 0xFFFF3EDF READ_WRITE /end MEASUREMENT
/begin MEASUREMENT tFPOFDLY "RAM value tFPOFDLY" UBYTE COMP_0464_S 1 100 0 255 ECU_ADDRESS 0xFFFF3EE0 READ_WRITE /end MEASUREMENT
/begin MEASUREMENT tFPONDLY "RAM value tFPONDLY" UBYTE COMP_0464_S 1 100 0 255 ECU_ADDRESS 0xFFFF3EE1 READ_WRITE /end MEASUREMENT
/begin MEASUREMENT tFSAFM "RAM value tFSAFM" UBYTE COMP_0464_S 1 100 0 255 ECU_ADDRESS 0xFFFF3EE2 READ_WRITE /end MEASUREMENT
/begin MEASUREMENT tGCALTIM "RAM value tGCALTIM" UBYTE COMP_0464_S 1 100 0 255 ECU_ADDRESS 0xFFFF3EE3 READ_WRITE /end MEASUREMENT
/begin MEASUREMENT tGCONVGT "RAM value tGCONVGT" UBYTE COMP_0464_S 1 100 0 255 ECU_ADDRESS 0xFFFF3EE4 READ_WRITE /end MEASUREMENT
/begin MEASUREMENT tGFBTM "RAM value tGFBTM" UBYTE COMP_0464_S 1 100 0 255 ECU_ADDRESS 0xFFFF3EE5 READ_WRITE /end MEASUREMENT
/begin MEASUREMENT tGLNDGTM "RAM value tGLNDGTM" UBYTE COMP_0464_S 1 100 0 255 ECU_ADDRESS 0xFFFF3EE6 READ_WRITE /end MEASUREMENT
/begin MEASUREMENT tIC3NGD "RAM value tIC3NGD" UBYTE COMP_0464_S 1 100 0 255 ECU_ADDRESS 0xFFFF3EE7 READ_WRITE /end MEASUREMENT
/begin MEASUREMENT tIC3TIM "RAM value tIC3TIM" UBYTE COMP_0464_S 1 100 0 255 ECU_ADDRESS 0xFFFF3EE8 READ_WRITE /end MEASUREMENT
/begin MEASUREMENT tIMMLODLY "RAM value tIMMLODLY" UBYTE COMP_0464_S 1 100 0 255 ECU_ADDRESS 0xFFFF3EE9 READ_WRITE /end MEASUREMENT
/begin MEASUREMENT tIMMMDDLY "RAM value tIMMMDDLY" UBYTE COMP_0464_S 1 100 0 255 ECU_ADDRESS 0xFFFF3EEA READ_WRITE /end MEASUREMENT
/begin MEASUREMENT tIMMRXDLY "RAM value tIMMRXDLY" UBYTE COMP_0464_S 1 100 0 255 ECU_ADDRESS 0xFFFF3EEB READ_WRITE /end MEASUREMENT
/begin MEASUREMENT tINHONTM "RAM value tINHONTM" UBYTE COMP_0464_S 1 100 0 255 ECU_ADDRESS 0xFFFF3EEC READ_WRITE /end MEASUREMENT
/begin MEASUREMENT tINJVCDLY "RAM value tINJVCDLY" UBYTE COMP_0464_S 1 100 0 255 ECU_ADDRESS 0xFFFF3EED READ_WRITE /end MEASUREMENT
/begin MEASUREMENT tJKFFTQTM "RAM value tJKFFTQTM" UBYTE COMP_0464_S 1 100 0 255 ECU_ADDRESS 0xFFFF3EEE READ_WRITE /end MEASUREMENT
/begin MEASUREMENT tJKRTTMOV "RAM value tJKRTTMOV" UBYTE COMP_0464_S 1 100 0 255 ECU_ADDRESS 0xFFFF3EEF READ_WRITE /end MEASUREMENT
/begin MEASUREMENT tMDIELCNT "RAM value tMDIELCNT" UBYTE COMP_0464_S 1 100 0 255 ECU_ADDRESS 0xFFFF3EF0 READ_WRITE /end MEASUREMENT
/begin MEASUREMENT tMFRFDLY1 "RAM value tMFRFDLY1" UBYTE COMP_0464_S 1 100 0 255 ECU_ADDRESS 0xFFFF3EF1 READ_WRITE /end MEASUREMENT
/begin MEASUREMENT tMFRFDLY2 "RAM value tMFRFDLY2" UBYTE COMP_0464_S 1 100 0 255 ECU_ADDRESS 0xFFFF3EF2 READ_WRITE /end MEASUREMENT
/begin MEASUREMENT tMSGCTACC "RAM value tMSGCTACC" UBYTE COMP_0464_S 1 100 0 255 ECU_ADDRESS 0xFFFF3EF3 READ_WRITE /end MEASUREMENT
/begin MEASUREMENT tMSRINHTM "RAM value tMSRINHTM" UBYTE COMP_0464_S 1 100 0 255 ECU_ADDRESS 0xFFFF3EF4 READ_WRITE /end MEASUREMENT
/begin MEASUREMENT tNIACDY "RAM value tNIACDY" UBYTE COMP_0464_S 1 100 0 255 ECU_ADDRESS 0xFFFF3EF5 READ_WRITE /end MEASUREMENT
/begin MEASUREMENT tPSRDLYT "RAM value tPSRDLYT" UBYTE COMP_0464_S 1 100 0 255 ECU_ADDRESS 0xFFFF3EF6 READ_WRITE /end MEASUREMENT
/begin MEASUREMENT tPSRHNGT "RAM value tPSRHNGT" UBYTE COMP_0464_S 1 100 0 255 ECU_ADDRESS 0xFFFF3EF7 READ_WRITE /end MEASUREMENT
/begin MEASUREMENT tPTIME "RAM value tPTIME" UBYTE COMP_0464_S 1 100 0 255 ECU_ADDRESS 0xFFFF3EF8 READ_WRITE /end MEASUREMENT
/begin MEASUREMENT tPWTDLY "RAM value tPWTDLY" UBYTE COMP_0464_S 1 100 0 255 ECU_ADDRESS 0xFFFF3EF9 READ_WRITE /end MEASUREMENT
/begin MEASUREMENT tQZDLY "RAM value tQZDLY" UBYTE COMP_0464_S 1 100 0 255 ECU_ADDRESS 0xFFFF3EFA READ_WRITE /end MEASUREMENT
/begin MEASUREMENT tREGENDLY "RAM value tREGENDLY" UBYTE COMP_0464_S 1 100 0 255 ECU_ADDRESS 0xFFFF3EFB READ_WRITE /end MEASUREMENT
/begin MEASUREMENT tREGNDLY "RAM value tREGNDLY" UBYTE COMP_0464_S 1 100 0 255 ECU_ADDRESS 0xFFFF3EFC READ_WRITE /end MEASUREMENT
/begin MEASUREMENT tRESTDLY "RAM value tRESTDLY" UBYTE COMP_0464_S 1 100 0 255 ECU_ADDRESS 0xFFFF3EFD READ_WRITE /end MEASUREMENT
/begin MEASUREMENT tRESTOS "RAM value tRESTOS" UBYTE COMP_0464_S 1 100 0 255 ECU_ADDRESS 0xFFFF3EFE READ_WRITE /end MEASUREMENT
/begin MEASUREMENT tRFNDLY1 "RAM value tRFNDLY1" UBYTE COMP_0464_S 1 100 0 255 ECU_ADDRESS 0xFFFF3EFF READ_WRITE /end MEASUREMENT
/begin MEASUREMENT tRFNDLY2 "RAM value tRFNDLY2" UBYTE COMP_0464_S 1 100 0 255 ECU_ADDRESS 0xFFFF3F00 READ_WRITE /end MEASUREMENT
/begin MEASUREMENT tRFQDLY1 "RAM value tRFQDLY1" UBYTE COMP_0464_S 1 100 0 255 ECU_ADDRESS 0xFFFF3F01 READ_WRITE /end MEASUREMENT
/begin MEASUREMENT tRFQDLY2 "RAM value tRFQDLY2" UBYTE COMP_0464_S 1 100 0 255 ECU_ADDRESS 0xFFFF3F02 READ_WRITE /end MEASUREMENT
/begin MEASUREMENT tRSTTRQTM "RAM value tRSTTRQTM" UBYTE COMP_0464_S 1 100 0 255 ECU_ADDRESS 0xFFFF3F03 READ_WRITE /end MEASUREMENT
/begin MEASUREMENT tSCKDLY "RAM value tSCKDLY" UBYTE COMP_0464_S 1 100 0 255 ECU_ADDRESS 0xFFFF3F04 READ_WRITE /end MEASUREMENT
/begin MEASUREMENT tSCKRETTM "RAM value tSCKRETTM" UBYTE COMP_0464_S 1 100 0 255 ECU_ADDRESS 0xFFFF3F05 READ_WRITE /end MEASUREMENT
/begin MEASUREMENT tSETLMPSL "RAM value tSETLMPSL" UBYTE COMP_0464_S 1 100 0 255 ECU_ADDRESS 0xFFFF3F06 READ_WRITE /end MEASUREMENT
/begin MEASUREMENT tSETLMPTM "RAM value tSETLMPTM" UBYTE COMP_0464_S 1 100 0 255 ECU_ADDRESS 0xFFFF3F07 READ_WRITE /end MEASUREMENT
/begin MEASUREMENT tSFTRDTNG "RAM value tSFTRDTNG" UBYTE COMP_0464_S 1 100 0 255 ECU_ADDRESS 0xFFFF3F08 READ_WRITE /end MEASUREMENT
/begin MEASUREMENT tSGFRETM "RAM value tSGFRETM" UBYTE COMP_0464_S 1 100 0 255 ECU_ADDRESS 0xFFFF3F09 READ_WRITE /end MEASUREMENT
/begin MEASUREMENT tSLIG0D00 "RAM value tSLIG0D00" UBYTE COMP_0464_S 1 100 0 255 ECU_ADDRESS 0xFFFF3F0A READ_WRITE /end MEASUREMENT
/begin MEASUREMENT tSLIG0DLY "RAM value tSLIG0DLY" UBYTE COMP_0464_S 1 100 0 255 ECU_ADDRESS 0xFFFF3F0B READ_WRITE /end MEASUREMENT
/begin MEASUREMENT tSLIG0DOV "RAM value tSLIG0DOV" UBYTE COMP_0464_S 1 100 0 255 ECU_ADDRESS 0xFFFF3F0C READ_WRITE /end MEASUREMENT
/begin MEASUREMENT tSLIG0DUD "RAM value tSLIG0DUD" UBYTE COMP_0464_S 1 100 0 255 ECU_ADDRESS 0xFFFF3F0D READ_WRITE /end MEASUREMENT
/begin MEASUREMENT tSLRESNOT "RAM value tSLRESNOT" UBYTE COMP_0464_S 1 100 0 255 ECU_ADDRESS 0xFFFF3F0E READ_WRITE /end MEASUREMENT
/begin MEASUREMENT tSLTAPDTM "RAM value tSLTAPDTM" UBYTE COMP_0464_S 1 100 0 255 ECU_ADDRESS 0xFFFF3F0F READ_WRITE /end MEASUREMENT
/begin MEASUREMENT tSLTAPUTM "RAM value tSLTAPUTM" UBYTE COMP_0464_S 1 100 0 255 ECU_ADDRESS 0xFFFF3F10 READ_WRITE /end MEASUREMENT
/begin MEASUREMENT tSLVAMXDL "RAM value tSLVAMXDL" UBYTE COMP_0464_S 1 100 0 255 ECU_ADDRESS 0xFFFF3F11 READ_WRITE /end MEASUREMENT
/begin MEASUREMENT tSPDCFCD "RAM value tSPDCFCD" UBYTE COMP_0464_S 1 100 0 255 ECU_ADDRESS 0xFFFF3F12 READ_WRITE /end MEASUREMENT
/begin MEASUREMENT tSPDRETTM "RAM value tSPDRETTM" UBYTE COMP_0464_S 1 100 0 255 ECU_ADDRESS 0xFFFF3F13 READ_WRITE /end MEASUREMENT
/begin MEASUREMENT tSTOFFTKC "RAM value tSTOFFTKC" UBYTE COMP_0464_S 1 100 0 255 ECU_ADDRESS 0xFFFF3F14 READ_WRITE /end MEASUREMENT
/begin MEASUREMENT tTACCMAIN "RAM value tTACCMAIN" UBYTE COMP_0464_S 1 100 0 255 ECU_ADDRESS 0xFFFF3F15 READ_WRITE /end MEASUREMENT
/begin MEASUREMENT tTAF12FS "RAM value tTAF12FS" UBYTE COMP_0464_S 1 100 0 255 ECU_ADDRESS 0xFFFF3F16 READ_WRITE /end MEASUREMENT
/begin MEASUREMENT tTAF1FS "RAM value tTAF1FS" UBYTE COMP_0464_S 1 100 0 255 ECU_ADDRESS 0xFFFF3F17 READ_WRITE /end MEASUREMENT
/begin MEASUREMENT tTAFSFS "RAM value tTAFSFS" UBYTE COMP_0464_S 1 100 0 255 ECU_ADDRESS 0xFFFF3F18 READ_WRITE /end MEASUREMENT
/begin MEASUREMENT tTAPOINCH "RAM value tTAPOINCH" UBYTE COMP_0464_S 1 100 0 255 ECU_ADDRESS 0xFFFF3F19 READ_WRITE /end MEASUREMENT
/begin MEASUREMENT tTAPSNG "RAM value tTAPSNG" UBYTE COMP_0464_S 1 100 0 255 ECU_ADDRESS 0xFFFF3F1A READ_WRITE /end MEASUREMENT
/begin MEASUREMENT tTASTRNG "RAM value tTASTRNG" UBYTE COMP_0464_S 1 100 0 255 ECU_ADDRESS 0xFFFF3F1B READ_WRITE /end MEASUREMENT
/begin MEASUREMENT tTCANMSK "RAM value tTCANMSK" UBYTE COMP_0464_S 1 100 0 255 ECU_ADDRESS 0xFFFF3F1C READ_WRITE /end MEASUREMENT
/begin MEASUREMENT tTCLNGT "RAM value tTCLNGT" UBYTE COMP_0464_S 1 100 0 255 ECU_ADDRESS 0xFFFF3F1D READ_WRITE /end MEASUREMENT
/begin MEASUREMENT tTDAFSES "RAM value tTDAFSES" UBYTE COMP_0464_S 1 100 0 255 ECU_ADDRESS 0xFFFF3F1E READ_WRITE /end MEASUREMENT
/begin MEASUREMENT tTDAFST "RAM value tTDAFST" UBYTE COMP_0464_S 1 100 0 255 ECU_ADDRESS 0xFFFF3F1F READ_WRITE /end MEASUREMENT
/begin MEASUREMENT tTDEVPS "RAM value tTDEVPS" UBYTE COMP_0464_S 1 100 0 255 ECU_ADDRESS 0xFFFF3F20 READ_WRITE /end MEASUREMENT
/begin MEASUREMENT tTDGNG "RAM value tTDGNG" UBYTE COMP_0464_S 1 100 0 255 ECU_ADDRESS 0xFFFF3F21 READ_WRITE /end MEASUREMENT
/begin MEASUREMENT tTDLTVTM "RAM value tTDLTVTM" UBYTE COMP_0464_S 1 100 0 255 ECU_ADDRESS 0xFFFF3F22 READ_WRITE /end MEASUREMENT
/begin MEASUREMENT tTDTSPNG "RAM value tTDTSPNG" UBYTE COMP_0464_S 1 100 0 255 ECU_ADDRESS 0xFFFF3F23 READ_WRITE /end MEASUREMENT
/begin MEASUREMENT tTFBDWNNG "RAM value tTFBDWNNG" UBYTE COMP_0464_S 1 100 0 255 ECU_ADDRESS 0xFFFF3F24 READ_WRITE /end MEASUREMENT
/begin MEASUREMENT tTFGN100 "RAM value tTFGN100" UBYTE COMP_0464_S 1 100 0 255 ECU_ADDRESS 0xFFFF3F25 READ_WRITE /end MEASUREMENT
/begin MEASUREMENT tTGM8VB "RAM value tTGM8VB" UBYTE COMP_0464_S 1 100 0 255 ECU_ADDRESS 0xFFFF3F26 READ_WRITE /end MEASUREMENT
/begin MEASUREMENT tTIDLENI "RAM value tTIDLENI" UBYTE COMP_0464_S 1 100 0 255 ECU_ADDRESS 0xFFFF3F27 READ_WRITE /end MEASUREMENT
/begin MEASUREMENT tTM100MS "RAM value tTM100MS" UBYTE COMP_0464_S 1 100 0 255 ECU_ADDRESS 0xFFFF3F28 READ_WRITE /end MEASUREMENT
/begin MEASUREMENT tTM1100MS "RAM value tTM1100MS" UBYTE COMP_0464_S 1 100 0 255 ECU_ADDRESS 0xFFFF3F29 READ_WRITE /end MEASUREMENT
/begin MEASUREMENT tTM1200MS "RAM value tTM1200MS" UBYTE COMP_0464_S 1 100 0 255 ECU_ADDRESS 0xFFFF3F2A READ_WRITE /end MEASUREMENT
/begin MEASUREMENT tTM200MS "RAM value tTM200MS" UBYTE COMP_0464_S 1 100 0 255 ECU_ADDRESS 0xFFFF3F2B READ_WRITE /end MEASUREMENT
/begin MEASUREMENT tTM83CN "RAM value tTM83CN" UBYTE COMP_0464_S 1 100 0 255 ECU_ADDRESS 0xFFFF3F2C READ_WRITE /end MEASUREMENT
/begin MEASUREMENT tTMACON "RAM value tTMACON" UBYTE COMP_0464_S 1 100 0 255 ECU_ADDRESS 0xFFFF3F2D READ_WRITE /end MEASUREMENT
/begin MEASUREMENT tTMADJ190 "RAM value tTMADJ190" UBYTE COMP_0464_S 1 100 0 255 ECU_ADDRESS 0xFFFF3F2E READ_WRITE /end MEASUREMENT
/begin MEASUREMENT tTMADJM1 "RAM value tTMADJM1" UBYTE COMP_0464_S 1 100 0 255 ECU_ADDRESS 0xFFFF3F2F READ_WRITE /end MEASUREMENT
/begin MEASUREMENT tTMANSTP "RAM value tTMANSTP" UBYTE COMP_0464_S 1 100 0 255 ECU_ADDRESS 0xFFFF3F30 READ_WRITE /end MEASUREMENT
/begin MEASUREMENT tTMAVCCNG "RAM value tTMAVCCNG" UBYTE COMP_0464_S 1 100 0 255 ECU_ADDRESS 0xFFFF3F31 READ_WRITE /end MEASUREMENT
/begin MEASUREMENT tTMCHASCD "RAM value tTMCHASCD" UBYTE COMP_0464_S 1 100 0 255 ECU_ADDRESS 0xFFFF3F32 READ_WRITE /end MEASUREMENT
/begin MEASUREMENT tTMCRNTHI "RAM value tTMCRNTHI" UBYTE COMP_0464_S 1 100 0 255 ECU_ADDRESS 0xFFFF3F33 READ_WRITE /end MEASUREMENT
/begin MEASUREMENT tTMDTOK "RAM value tTMDTOK" UBYTE COMP_0464_S 1 100 0 255 ECU_ADDRESS 0xFFFF3F34 READ_WRITE /end MEASUREMENT
/begin MEASUREMENT tTMGASCD "RAM value tTMGASCD" UBYTE COMP_0464_S 1 100 0 255 ECU_ADDRESS 0xFFFF3F35 READ_WRITE /end MEASUREMENT
/begin MEASUREMENT tTMGNSK "RAM value tTMGNSK" UBYTE COMP_0464_S 1 100 0 255 ECU_ADDRESS 0xFFFF3F36 READ_WRITE /end MEASUREMENT
/begin MEASUREMENT tTMLRN "RAM value tTMLRN" UBYTE COMP_0464_S 1 100 0 255 ECU_ADDRESS 0xFFFF3F37 READ_WRITE /end MEASUREMENT
/begin MEASUREMENT tTMLRN1 "RAM value tTMLRN1" UBYTE COMP_0464_S 1 100 0 255 ECU_ADDRESS 0xFFFF3F38 READ_WRITE /end MEASUREMENT
/begin MEASUREMENT tTMMFCN "RAM value tTMMFCN" UBYTE COMP_0464_S 1 100 0 255 ECU_ADDRESS 0xFFFF3F39 READ_WRITE /end MEASUREMENT
/begin MEASUREMENT tTMMFCNJA "RAM value tTMMFCNJA" UBYTE COMP_0464_S 1 100 0 255 ECU_ADDRESS 0xFFFF3F3A READ_WRITE /end MEASUREMENT
/begin MEASUREMENT tTMMFCNJB "RAM value tTMMFCNJB" UBYTE COMP_0464_S 1 100 0 255 ECU_ADDRESS 0xFFFF3F3B READ_WRITE /end MEASUREMENT
/begin MEASUREMENT tTMMFCNJC "RAM value tTMMFCNJC" UBYTE COMP_0464_S 1 100 0 255 ECU_ADDRESS 0xFFFF3F3C READ_WRITE /end MEASUREMENT
/begin MEASUREMENT tTMMFCNJD "RAM value tTMMFCNJD" UBYTE COMP_0464_S 1 100 0 255 ECU_ADDRESS 0xFFFF3F3D READ_WRITE /end MEASUREMENT
/begin MEASUREMENT tTMMFCNJG "RAM value tTMMFCNJG" UBYTE COMP_0464_S 1 100 0 255 ECU_ADDRESS 0xFFFF3F3E READ_WRITE /end MEASUREMENT
/begin MEASUREMENT tTMMFCNJI "RAM value tTMMFCNJI" UBYTE COMP_0464_S 1 100 0 255 ECU_ADDRESS 0xFFFF3F3F READ_WRITE /end MEASUREMENT
/begin MEASUREMENT tTMMFCNR "RAM value tTMMFCNR" UBYTE COMP_0464_S 1 100 0 255 ECU_ADDRESS 0xFFFF3F40 READ_WRITE /end MEASUREMENT
/begin MEASUREMENT tTMMFCNRA "RAM value tTMMFCNRA" UBYTE COMP_0464_S 1 100 0 255 ECU_ADDRESS 0xFFFF3F41 READ_WRITE /end MEASUREMENT
/begin MEASUREMENT tTMMFCNRB "RAM value tTMMFCNRB" UBYTE COMP_0464_S 1 100 0 255 ECU_ADDRESS 0xFFFF3F42 READ_WRITE /end MEASUREMENT
/begin MEASUREMENT tTMMFCNRC "RAM value tTMMFCNRC" UBYTE COMP_0464_S 1 100 0 255 ECU_ADDRESS 0xFFFF3F43 READ_WRITE /end MEASUREMENT
/begin MEASUREMENT tTMMFCNRD "RAM value tTMMFCNRD" UBYTE COMP_0464_S 1 100 0 255 ECU_ADDRESS 0xFFFF3F44 READ_WRITE /end MEASUREMENT
/begin MEASUREMENT tTMMFCNRE "RAM value tTMMFCNRE" UBYTE COMP_0464_S 1 100 0 255 ECU_ADDRESS 0xFFFF3F45 READ_WRITE /end MEASUREMENT
/begin MEASUREMENT tTMMFE3 "RAM value tTMMFE3" UBYTE COMP_0464_S 1 100 0 255 ECU_ADDRESS 0xFFFF3F46 READ_WRITE /end MEASUREMENT
/begin MEASUREMENT tTMMFEA "RAM value tTMMFEA" UBYTE COMP_0464_S 1 100 0 255 ECU_ADDRESS 0xFFFF3F47 READ_WRITE /end MEASUREMENT
/begin MEASUREMENT tTMMFEM "RAM value tTMMFEM" UBYTE COMP_0464_S 1 100 0 255 ECU_ADDRESS 0xFFFF3F48 READ_WRITE /end MEASUREMENT
/begin MEASUREMENT tTMMFENW "RAM value tTMMFENW" UBYTE COMP_0464_S 1 100 0 255 ECU_ADDRESS 0xFFFF3F49 READ_WRITE /end MEASUREMENT
/begin MEASUREMENT tTMNUVB "RAM value tTMNUVB" UBYTE COMP_0464_S 1 100 0 255 ECU_ADDRESS 0xFFFF3F4A READ_WRITE /end MEASUREMENT
/begin MEASUREMENT tTMOVCR1 "RAM value tTMOVCR1" UBYTE COMP_0464_S 1 100 0 255 ECU_ADDRESS 0xFFFF3F4B READ_WRITE /end MEASUREMENT
/begin MEASUREMENT tTMRND "RAM value tTMRND" UBYTE COMP_0464_S 1 100 0 255 ECU_ADDRESS 0xFFFF3F4C READ_WRITE /end MEASUREMENT
/begin MEASUREMENT tTMTATE "RAM value tTMTATE" UBYTE COMP_0464_S 1 100 0 255 ECU_ADDRESS 0xFFFF3F4D READ_WRITE /end MEASUREMENT
/begin MEASUREMENT tTMTEGR "RAM value tTMTEGR" UBYTE COMP_0464_S 1 100 0 255 ECU_ADDRESS 0xFFFF3F4E READ_WRITE /end MEASUREMENT
/begin MEASUREMENT tTMTEPTD "RAM value tTMTEPTD" UBYTE COMP_0464_S 1 100 0 255 ECU_ADDRESS 0xFFFF3F4F READ_WRITE /end MEASUREMENT
/begin MEASUREMENT tTMTHOP "RAM value tTMTHOP" UBYTE COMP_0464_S 1 100 0 255 ECU_ADDRESS 0xFFFF3F50 READ_WRITE /end MEASUREMENT
/begin MEASUREMENT tTMTLG "RAM value tTMTLG" UBYTE COMP_0464_S 1 100 0 255 ECU_ADDRESS 0xFFFF3F51 READ_WRITE /end MEASUREMENT
/begin MEASUREMENT tTMVBCON "RAM value tTMVBCON" UBYTE COMP_0464_S 1 100 0 255 ECU_ADDRESS 0xFFFF3F52 READ_WRITE /end MEASUREMENT
/begin MEASUREMENT tTNZERO "RAM value tTNZERO" UBYTE COMP_0464_S 1 100 0 255 ECU_ADDRESS 0xFFFF3F53 READ_WRITE /end MEASUREMENT
/begin MEASUREMENT tTNZERO2 "RAM value tTNZERO2" UBYTE COMP_0464_S 1 100 0 255 ECU_ADDRESS 0xFFFF3F54 READ_WRITE /end MEASUREMENT
/begin MEASUREMENT tTO2HNG "RAM value tTO2HNG" UBYTE COMP_0464_S 1 100 0 255 ECU_ADDRESS 0xFFFF3F55 READ_WRITE /end MEASUREMENT
/begin MEASUREMENT tTOCNT "RAM value tTOCNT" UBYTE COMP_0464_S 1 100 0 255 ECU_ADDRESS 0xFFFF3F56 READ_WRITE /end MEASUREMENT
/begin MEASUREMENT tTPTDCNG "RAM value tTPTDCNG" UBYTE COMP_0464_S 1 100 0 255 ECU_ADDRESS 0xFFFF3F57 READ_WRITE /end MEASUREMENT
/begin MEASUREMENT tTQAPNG "RAM value tTQAPNG" UBYTE COMP_0464_S 1 100 0 255 ECU_ADDRESS 0xFFFF3F58 READ_WRITE /end MEASUREMENT
/begin MEASUREMENT tTQDYNHTM "RAM value tTQDYNHTM" UBYTE COMP_0464_S 1 100 0 255 ECU_ADDRESS 0xFFFF3F59 READ_WRITE /end MEASUREMENT
/begin MEASUREMENT tTRADIDTM "RAM value tTRADIDTM" UBYTE COMP_0464_S 1 100 0 255 ECU_ADDRESS 0xFFFF3F5A READ_WRITE /end MEASUREMENT
/begin MEASUREMENT tTST200 "RAM value tTST200" UBYTE COMP_0464_S 1 100 0 255 ECU_ADDRESS 0xFFFF3F5B READ_WRITE /end MEASUREMENT
/begin MEASUREMENT tTSYDGNG "RAM value tTSYDGNG" UBYTE COMP_0464_S 1 100 0 255 ECU_ADDRESS 0xFFFF3F5C READ_WRITE /end MEASUREMENT
/begin MEASUREMENT tTVAPNG "RAM value tTVAPNG" UBYTE COMP_0464_S 1 100 0 255 ECU_ADDRESS 0xFFFF3F5D READ_WRITE /end MEASUREMENT
/begin MEASUREMENT tTVFLOK "RAM value tTVFLOK" UBYTE COMP_0464_S 1 100 0 255 ECU_ADDRESS 0xFFFF3F5E READ_WRITE /end MEASUREMENT
/begin MEASUREMENT tTVFNG1 "RAM value tTVFNG1" UBYTE COMP_0464_S 1 100 0 255 ECU_ADDRESS 0xFFFF3F5F READ_WRITE /end MEASUREMENT
/begin MEASUREMENT tTVFNG2 "RAM value tTVFNG2" UBYTE COMP_0464_S 1 100 0 255 ECU_ADDRESS 0xFFFF3F60 READ_WRITE /end MEASUREMENT
/begin MEASUREMENT tVTCLRNTM "RAM value tVTCLRNTM" UBYTE COMP_0464_S 1 100 0 255 ECU_ADDRESS 0xFFFF3F61 READ_WRITE /end MEASUREMENT
/begin MEASUREMENT tVTCMETM "RAM value tVTCMETM" UBYTE COMP_0464_S 1 100 0 255 ECU_ADDRESS 0xFFFF3F63 READ_WRITE /end MEASUREMENT
/begin MEASUREMENT tVTCMITM "RAM value tVTCMITM" UBYTE COMP_0464_S 1 100 0 255 ECU_ADDRESS 0xFFFF3F64 READ_WRITE /end MEASUREMENT
/begin MEASUREMENT tVTLRNTME "RAM value tVTLRNTME" UBYTE COMP_0464_S 1 100 0 255 ECU_ADDRESS 0xFFFF3F65 READ_WRITE /end MEASUREMENT
/begin MEASUREMENT tWDTDLY "RAM value tWDTDLY" UBYTE COMP_0464_S 1 100 0 255 ECU_ADDRESS 0xFFFF3F67 READ_WRITE /end MEASUREMENT
/begin MEASUREMENT tWGGDDGN "RAM value tWGGDDGN" UBYTE COMP_0464_S 1 100 0 255 ECU_ADDRESS 0xFFFF3F68 READ_WRITE /end MEASUREMENT
/begin MEASUREMENT tWGOPDGN "RAM value tWGOPDGN" UBYTE COMP_0464_S 1 100 0 255 ECU_ADDRESS 0xFFFF3F69 READ_WRITE /end MEASUREMENT
/begin MEASUREMENT tWGVBDGN2 "RAM value tWGVBDGN2" UBYTE COMP_0464_S 1 100 0 255 ECU_ADDRESS 0xFFFF3F6A READ_WRITE /end MEASUREMENT
/begin MEASUREMENT tAFHDTYTM "RAM value tAFHDTYTM" UBYTE COMP_0466_S 1 100 0 255 ECU_ADDRESS 0xFFFF3F6C READ_WRITE /end MEASUREMENT
/begin MEASUREMENT tAFHONDTM "RAM value tAFHONDTM" UBYTE COMP_0466_S 1 100 0 255 ECU_ADDRESS 0xFFFF3F6D READ_WRITE /end MEASUREMENT
/begin MEASUREMENT tP2TIME "RAM value tP2TIME" UBYTE COMP_0466_S 1 100 0 255 ECU_ADDRESS 0xFFFF3F6E READ_WRITE /end MEASUREMENT
/begin MEASUREMENT tP4TIME "RAM value tP4TIME" UBYTE COMP_0466_S 1 100 0 255 ECU_ADDRESS 0xFFFF3F6F READ_WRITE /end MEASUREMENT
/begin MEASUREMENT tTWupCON2 "RAM value tTWupCON2" UBYTE COMP_0466_S 1 100 0 255 ECU_ADDRESS 0xFFFF3F70 READ_WRITE /end MEASUREMENT
/begin MEASUREMENT tTWupDBM "RAM value tTWupDBM" UBYTE COMP_0466_S 1 100 0 255 ECU_ADDRESS 0xFFFF3F71 READ_WRITE /end MEASUREMENT
/begin MEASUREMENT tTWW2 "RAM value tTWW2" UBYTE COMP_0466_S 1 100 0 255 ECU_ADDRESS 0xFFFF3F72 READ_WRITE /end MEASUREMENT
/begin MEASUREMENT tTWW3 "RAM value tTWW3" UBYTE COMP_0466_S 1 100 0 255 ECU_ADDRESS 0xFFFF3F73 READ_WRITE /end MEASUREMENT
/begin MEASUREMENT tTWW4 "RAM value tTWW4" UBYTE COMP_0466_S 1 100 0 255 ECU_ADDRESS 0xFFFF3F74 READ_WRITE /end MEASUREMENT
/begin MEASUREMENT cCRGNG "RAM value cCRGNG" UBYTE COMP_0191 1 100 0 255 ECU_ADDRESS 0xFFFF3F75 READ_WRITE /end MEASUREMENT
/begin MEASUREMENT cELNALP "RAM value cELNALP" UBYTE COMP_0191 1 100 0 255 ECU_ADDRESS 0xFFFF3F76 READ_WRITE /end MEASUREMENT
/begin MEASUREMENT cKBLBLN "RAM value cKBLBLN" UBYTE COMP_0191 1 100 0 255 ECU_ADDRESS 0xFFFF3F77 READ_WRITE /end MEASUREMENT
/begin MEASUREMENT tALTENDTM "RAM value tALTENDTM" UWORD COMP_0465_S 1 100 0 65535 ECU_ADDRESS 0xFFFF3F78 READ_WRITE /end MEASUREMENT
/begin MEASUREMENT tLENDLY2 "RAM value tLENDLY2" UWORD COMP_0465_S 1 100 0 65535 ECU_ADDRESS 0xFFFF3F7A READ_WRITE /end MEASUREMENT
/begin MEASUREMENT tOILJDG2 "RAM value tOILJDG2" UWORD COMP_0465_S 1 100 0 65535 ECU_ADDRESS 0xFFFF3F7C READ_WRITE /end MEASUREMENT
/begin MEASUREMENT tOILJDG3 "RAM value tOILJDG3" UWORD COMP_0465_S 1 100 0 65535 ECU_ADDRESS 0xFFFF3F7E READ_WRITE /end MEASUREMENT
/begin MEASUREMENT tRFMSKTM "RAM value tRFMSKTM" UWORD COMP_0465_S 1 100 0 65535 ECU_ADDRESS 0xFFFF3F80 READ_WRITE /end MEASUREMENT
/begin MEASUREMENT tTBATSCC "RAM value tTBATSCC" UWORD COMP_0465_S 1 100 0 65535 ECU_ADDRESS 0xFFFF3F82 READ_WRITE /end MEASUREMENT
/begin MEASUREMENT tTDIRE17 "RAM value tTDIRE17" UWORD COMP_0465_S 1 100 0 65535 ECU_ADDRESS 0xFFFF3F84 READ_WRITE /end MEASUREMENT
/begin MEASUREMENT tTWINJ1T "RAM value tTWINJ1T" UWORD COMP_0465_S 1 100 0 65535 ECU_ADDRESS 0xFFFF3F86 READ_WRITE /end MEASUREMENT
/begin MEASUREMENT tTWINJ2T "RAM value tTWINJ2T" UWORD COMP_0465_S 1 100 0 65535 ECU_ADDRESS 0xFFFF3F88 READ_WRITE /end MEASUREMENT
/begin MEASUREMENT tTWINJ3T "RAM value tTWINJ3T" UWORD COMP_0465_S 1 100 0 65535 ECU_ADDRESS 0xFFFF3F8A READ_WRITE /end MEASUREMENT
/begin MEASUREMENT tTWINJ4T "RAM value tTWINJ4T" UWORD COMP_0465_S 1 100 0 65535 ECU_ADDRESS 0xFFFF3F8C READ_WRITE /end MEASUREMENT
/begin MEASUREMENT tAFCRCD1 "RAM value tAFCRCD1" UWORD COMP_0464_S 1 100 0 65535 ECU_ADDRESS 0xFFFF3FA2 READ_WRITE /end MEASUREMENT
/begin MEASUREMENT tAFCRCD3 "RAM value tAFCRCD3" UWORD COMP_0464_S 1 100 0 65535 ECU_ADDRESS 0xFFFF3FA4 READ_WRITE /end MEASUREMENT
/begin MEASUREMENT tDAPXLH "RAM value tDAPXLH" UWORD COMP_0464_S 1 100 0 65535 ECU_ADDRESS 0xFFFF3FA6 READ_WRITE /end MEASUREMENT
/begin MEASUREMENT tDLRSEL "RAM value tDLRSEL" UWORD COMP_0464_S 1 100 0 65535 ECU_ADDRESS 0xFFFF3FA8 READ_WRITE /end MEASUREMENT
/begin MEASUREMENT tDTPXLH "RAM value tDTPXLH" UWORD COMP_0464_S 1 100 0 65535 ECU_ADDRESS 0xFFFF3FAA READ_WRITE /end MEASUREMENT
/begin MEASUREMENT tFDTRGPB_M "RAM value tFDTRGPB_M" UWORD COMP_0464_S 1 100 0 65535 ECU_ADDRESS 0xFFFF3FAC READ_WRITE /end MEASUREMENT
/begin MEASUREMENT tRINLDT "RAM value tRINLDT" UWORD COMP_0464_S 1 100 0 65535 ECU_ADDRESS 0xFFFF3FAE READ_WRITE /end MEASUREMENT
/begin MEASUREMENT tTAF12NGW "RAM value tTAF12NGW" UWORD COMP_0464_S 1 100 0 65535 ECU_ADDRESS 0xFFFF3FB0 READ_WRITE /end MEASUREMENT
/begin MEASUREMENT tTAF1NGW "RAM value tTAF1NGW" UWORD COMP_0464_S 1 100 0 65535 ECU_ADDRESS 0xFFFF3FB2 READ_WRITE /end MEASUREMENT
/begin MEASUREMENT tTAFSNGW "RAM value tTAFSNGW" UWORD COMP_0464_S 1 100 0 65535 ECU_ADDRESS 0xFFFF3FB4 READ_WRITE /end MEASUREMENT
/begin MEASUREMENT tTFPSTNG1 "RAM value tTFPSTNG1" UWORD COMP_0464_S 1 100 0 65535 ECU_ADDRESS 0xFFFF3FB6 READ_WRITE /end MEASUREMENT
/begin MEASUREMENT tTFPSTNG2 "RAM value tTFPSTNG2" UWORD COMP_0464_S 1 100 0 65535 ECU_ADDRESS 0xFFFF3FB8 READ_WRITE /end MEASUREMENT
/begin MEASUREMENT tTFPSTNG3 "RAM value tTFPSTNG3" UWORD COMP_0464_S 1 100 0 65535 ECU_ADDRESS 0xFFFF3FBA READ_WRITE /end MEASUREMENT
/begin MEASUREMENT tTMDEFD1 "RAM value tTMDEFD1" UWORD COMP_0464_S 1 100 0 65535 ECU_ADDRESS 0xFFFF3FBC READ_WRITE /end MEASUREMENT
/begin MEASUREMENT tTMDEFNG1 "RAM value tTMDEFNG1" UWORD COMP_0464_S 1 100 0 65535 ECU_ADDRESS 0xFFFF3FBE READ_WRITE /end MEASUREMENT
/begin MEASUREMENT tTMSPONNG1 "RAM value tTMSPONNG1" UWORD COMP_0464_S 1 100 0 65535 ECU_ADDRESS 0xFFFF3FC0 READ_WRITE /end MEASUREMENT
/begin MEASUREMENT tTMSPRGNG1 "RAM value tTMSPRGNG1" UWORD COMP_0464_S 1 100 0 65535 ECU_ADDRESS 0xFFFF3FC2 READ_WRITE /end MEASUREMENT
/begin MEASUREMENT tTMTVOSPR1 "RAM value tTMTVOSPR1" UWORD COMP_0464_S 1 100 0 65535 ECU_ADDRESS 0xFFFF3FC4 READ_WRITE /end MEASUREMENT
/begin MEASUREMENT tTMVSNGSP "RAM value tTMVSNGSP" UWORD COMP_0464_S 1 100 0 65535 ECU_ADDRESS 0xFFFF3FC6 READ_WRITE /end MEASUREMENT
/begin MEASUREMENT tTOUTRVNG "RAM value tTOUTRVNG" UWORD COMP_0464_S 1 100 0 65535 ECU_ADDRESS 0xFFFF3FC8 READ_WRITE /end MEASUREMENT
/begin MEASUREMENT tTPSFSDL1 "RAM value tTPSFSDL1" UWORD COMP_0464_S 1 100 0 65535 ECU_ADDRESS 0xFFFF3FCA READ_WRITE /end MEASUREMENT
/begin MEASUREMENT tTPSX4BNG1 "RAM value tTPSX4BNG1" UWORD COMP_0464_S 1 100 0 65535 ECU_ADDRESS 0xFFFF3FCC READ_WRITE /end MEASUREMENT
/begin MEASUREMENT tTPSX4NG1 "RAM value tTPSX4NG1" UWORD COMP_0464_S 1 100 0 65535 ECU_ADDRESS 0xFFFF3FCE READ_WRITE /end MEASUREMENT
/begin MEASUREMENT tTTPSNG "RAM value tTTPSNG" UWORD COMP_0464_S 1 100 0 65535 ECU_ADDRESS 0xFFFF3FD0 READ_WRITE /end MEASUREMENT
/begin MEASUREMENT tTVSPNGOR "RAM value tTVSPNGOR" UWORD COMP_0464_S 1 100 0 65535 ECU_ADDRESS 0xFFFF3FD2 READ_WRITE /end MEASUREMENT
/begin MEASUREMENT tVTDLYTM "RAM value tVTDLYTM" UWORD COMP_0464_S 1 100 0 65535 ECU_ADDRESS 0xFFFF3FD4 READ_WRITE /end MEASUREMENT
/begin MEASUREMENT tVTDLYTME "RAM value tVTDLYTME" UWORD COMP_0464_S 1 100 0 65535 ECU_ADDRESS 0xFFFF3FD6 READ_WRITE /end MEASUREMENT
/begin MEASUREMENT tFDTRGPB_S "RAM value tFDTRGPB_S" UWORD COMP_0464_S 1 100 0 65535 ECU_ADDRESS 0xFFFF3FD8 READ_WRITE /end MEASUREMENT
/begin MEASUREMENT tP3TIME "RAM value tP3TIME" UWORD COMP_0466_S 1 100 0 65535 ECU_ADDRESS 0xFFFF3FDA READ_WRITE /end MEASUREMENT
/begin MEASUREMENT tTMERRTV1 "RAM value tTMERRTV1" UWORD COMP_0466_S 1 100 0 65535 ECU_ADDRESS 0xFFFF3FDC READ_WRITE /end MEASUREMENT
/begin MEASUREMENT tTMERRTV2 "RAM value tTMERRTV2" UWORD COMP_0466_S 1 100 0 65535 ECU_ADDRESS 0xFFFF3FDE READ_WRITE /end MEASUREMENT
/begin MEASUREMENT tTWW1 "RAM value tTWW1" UWORD COMP_0466_S 1 100 0 65535 ECU_ADDRESS 0xFFFF3FE0 READ_WRITE /end MEASUREMENT
/begin MEASUREMENT tVCLNDLY "RAM value tVCLNDLY" UWORD COMP_0466_S 1 100 0 65535 ECU_ADDRESS 0xFFFF3FE2 READ_WRITE /end MEASUREMENT
/begin MEASUREMENT tVCLNDLYE "RAM value tVCLNDLYE" UWORD COMP_0466_S 1 100 0 65535 ECU_ADDRESS 0xFFFF3FE4 READ_WRITE /end MEASUREMENT
/begin MEASUREMENT tALTENGRN "RAM value tALTENGRN" UBYTE COMP_0465_S 1 100 0 255 ECU_ADDRESS 0xFFFF1C20 READ_WRITE /end MEASUREMENT
/begin MEASUREMENT tCKDWTM "RAM value tCKDWTM" UBYTE COMP_0465_S 1 100 0 255 ECU_ADDRESS 0xFFFF1C21 READ_WRITE /end MEASUREMENT
/begin MEASUREMENT tCKSTTM "RAM value tCKSTTM" UBYTE COMP_0465_S 1 100 0 255 ECU_ADDRESS 0xFFFF1C22 READ_WRITE /end MEASUREMENT
/begin MEASUREMENT tCUTMSK "RAM value tCUTMSK" UBYTE COMP_0465_S 1 100 0 255 ECU_ADDRESS 0xFFFF1C23 READ_WRITE /end MEASUREMENT
/begin MEASUREMENT tDLOPEN "RAM value tDLOPEN" UBYTE COMP_0465_S 1 100 0 255 ECU_ADDRESS 0xFFFF1C24 READ_WRITE /end MEASUREMENT
/begin MEASUREMENT tHPPKTM "RAM value tHPPKTM" UBYTE COMP_0465_S 1 100 0 255 ECU_ADDRESS 0xFFFF1C25 READ_WRITE /end MEASUREMENT
/begin MEASUREMENT tIDLETRP "RAM value tIDLETRP" UBYTE COMP_0465_S 1 100 0 255 ECU_ADDRESS 0xFFFF1C26 READ_WRITE /end MEASUREMENT
/begin MEASUREMENT tISCID "RAM value tISCID" UBYTE COMP_0465_S 1 100 0 255 ECU_ADDRESS 0xFFFF1C27 READ_WRITE /end MEASUREMENT
/begin MEASUREMENT tITRTM "RAM value tITRTM" UBYTE COMP_0465_S 1 100 0 255 ECU_ADDRESS 0xFFFF1C28 READ_WRITE /end MEASUREMENT
/begin MEASUREMENT tMKTM "RAM value tMKTM" UBYTE COMP_0465_S 1 100 0 255 ECU_ADDRESS 0xFFFF1C29 READ_WRITE /end MEASUREMENT
/begin MEASUREMENT tNIDLOFAC "RAM value tNIDLOFAC" UBYTE COMP_0465_S 1 100 0 255 ECU_ADDRESS 0xFFFF1C2A READ_WRITE /end MEASUREMENT
/begin MEASUREMENT tODOFTM "RAM value tODOFTM" UBYTE COMP_0465_S 1 100 0 255 ECU_ADDRESS 0xFFFF1C2B READ_WRITE /end MEASUREMENT
/begin MEASUREMENT tPIDLETRP "RAM value tPIDLETRP" UBYTE COMP_0465_S 1 100 0 255 ECU_ADDRESS 0xFFFF1C2C READ_WRITE /end MEASUREMENT
/begin MEASUREMENT tSTONLIMT "RAM value tSTONLIMT" UBYTE COMP_0465_S 1 100 0 255 ECU_ADDRESS 0xFFFF1C2D READ_WRITE /end MEASUREMENT
/begin MEASUREMENT tTBBDEC "RAM value tTBBDEC" UBYTE COMP_0465_S 1 100 0 255 ECU_ADDRESS 0xFFFF1C2E READ_WRITE /end MEASUREMENT
/begin MEASUREMENT tTBBHOT "RAM value tTBBHOT" UBYTE COMP_0465_S 1 100 0 255 ECU_ADDRESS 0xFFFF1C2F READ_WRITE /end MEASUREMENT
/begin MEASUREMENT tTBBKMR "RAM value tTBBKMR" UBYTE COMP_0465_S 1 100 0 255 ECU_ADDRESS 0xFFFF1C30 READ_WRITE /end MEASUREMENT
/begin MEASUREMENT tTDSTCL "RAM value tTDSTCL" UBYTE COMP_0465_S 1 100 0 255 ECU_ADDRESS 0xFFFF1C31 READ_WRITE /end MEASUREMENT
/begin MEASUREMENT tTLKBRA "RAM value tTLKBRA" UBYTE COMP_0465_S 1 100 0 255 ECU_ADDRESS 0xFFFF1C32 READ_WRITE /end MEASUREMENT
/begin MEASUREMENT tTMACLT "RAM value tTMACLT" UBYTE COMP_0465_S 1 100 0 255 ECU_ADDRESS 0xFFFF1C34 READ_WRITE /end MEASUREMENT
/begin MEASUREMENT tTMAFKMR "RAM value tTMAFKMR" UBYTE COMP_0465_S 1 100 0 255 ECU_ADDRESS 0xFFFF1C35 READ_WRITE /end MEASUREMENT
/begin MEASUREMENT tTMDTIV "RAM value tTMDTIV" UBYTE COMP_0465_S 1 100 0 255 ECU_ADDRESS 0xFFFF1C36 READ_WRITE /end MEASUREMENT
/begin MEASUREMENT tTMEVPC1 "RAM value tTMEVPC1" UBYTE COMP_0465_S 1 100 0 255 ECU_ADDRESS 0xFFFF1C37 READ_WRITE /end MEASUREMENT
/begin MEASUREMENT tTMFPSTM "RAM value tTMFPSTM" UBYTE COMP_0465_S 1 100 0 255 ECU_ADDRESS 0xFFFF1C38 READ_WRITE /end MEASUREMENT
/begin MEASUREMENT tTMTRP4 "RAM value tTMTRP4" UBYTE COMP_0465_S 1 100 0 255 ECU_ADDRESS 0xFFFF1C39 READ_WRITE /end MEASUREMENT
/begin MEASUREMENT tTNCUTD "RAM value tTNCUTD" UBYTE COMP_0465_S 1 100 0 255 ECU_ADDRESS 0xFFFF1C3A READ_WRITE /end MEASUREMENT
/begin MEASUREMENT tTPGCK "RAM value tTPGCK" UBYTE COMP_0465_S 1 100 0 255 ECU_ADDRESS 0xFFFF1C3B READ_WRITE /end MEASUREMENT
/begin MEASUREMENT tTPGCK3 "RAM value tTPGCK3" UBYTE COMP_0465_S 1 100 0 255 ECU_ADDRESS 0xFFFF1C3C READ_WRITE /end MEASUREMENT
/begin MEASUREMENT tTPOTM1 "RAM value tTPOTM1" UBYTE COMP_0465_S 1 100 0 255 ECU_ADDRESS 0xFFFF1C3D READ_WRITE /end MEASUREMENT
/begin MEASUREMENT tTPOTM2 "RAM value tTPOTM2" UBYTE COMP_0465_S 1 100 0 255 ECU_ADDRESS 0xFFFF1C3E READ_WRITE /end MEASUREMENT
/begin MEASUREMENT tTRKBRA "RAM value tTRKBRA" UBYTE COMP_0465_S 1 100 0 255 ECU_ADDRESS 0xFFFF1C3F READ_WRITE /end MEASUREMENT
/begin MEASUREMENT tTVCUTD "RAM value tTVCUTD" UBYTE COMP_0465_S 1 100 0 255 ECU_ADDRESS 0xFFFF1C41 READ_WRITE /end MEASUREMENT
/begin MEASUREMENT tTWNBUK "RAM value tTWNBUK" UBYTE COMP_0465_S 1 100 0 255 ECU_ADDRESS 0xFFFF1C42 READ_WRITE /end MEASUREMENT
/begin MEASUREMENT tWIPDLY "RAM value tWIPDLY" UBYTE COMP_0465_S 1 100 0 255 ECU_ADDRESS 0xFFFF1C43 READ_WRITE /end MEASUREMENT
/begin MEASUREMENT tACOFDY "RAM value tACOFDY" UBYTE COMP_0463_S 1 100 0 255 ECU_ADDRESS 0xFFFF1C44 READ_WRITE /end MEASUREMENT
/begin MEASUREMENT tACONDY "RAM value tACONDY" UBYTE COMP_0463_S 1 100 0 255 ECU_ADDRESS 0xFFFF1C45 READ_WRITE /end MEASUREMENT
/begin MEASUREMENT tACREDY "RAM value tACREDY" UBYTE COMP_0463_S 1 100 0 255 ECU_ADDRESS 0xFFFF1C46 READ_WRITE /end MEASUREMENT
/begin MEASUREMENT tACSTDY "RAM value tACSTDY" UBYTE COMP_0463_S 1 100 0 255 ECU_ADDRESS 0xFFFF1C47 READ_WRITE /end MEASUREMENT
/begin MEASUREMENT tADLDLY "RAM value tADLDLY" UBYTE COMP_0463_S 1 100 0 255 ECU_ADDRESS 0xFFFF1C48 READ_WRITE /end MEASUREMENT
/begin MEASUREMENT tADVDLYD "RAM value tADVDLYD" UBYTE COMP_0463_S 1 100 0 255 ECU_ADDRESS 0xFFFF1C49 READ_WRITE /end MEASUREMENT
/begin MEASUREMENT tADVSTDLY "RAM value tADVSTDLY" UBYTE COMP_0463_S 1 100 0 255 ECU_ADDRESS 0xFFFF1C4A READ_WRITE /end MEASUREMENT
/begin MEASUREMENT tATGDLY "RAM value tATGDLY" UBYTE COMP_0463_S 1 100 0 255 ECU_ADDRESS 0xFFFF1C4B READ_WRITE /end MEASUREMENT
/begin MEASUREMENT tBCONTOVN "RAM value tBCONTOVN" UBYTE COMP_0463_S 1 100 0 255 ECU_ADDRESS 0xFFFF1C4C READ_WRITE /end MEASUREMENT
/begin MEASUREMENT tCHGOKTM "RAM value tCHGOKTM" UBYTE COMP_0463_S 1 100 0 255 ECU_ADDRESS 0xFFFF1C4D READ_WRITE /end MEASUREMENT
/begin MEASUREMENT tCKTDTM "RAM value tCKTDTM" UBYTE COMP_0463_S 1 100 0 255 ECU_ADDRESS 0xFFFF1C4E READ_WRITE /end MEASUREMENT
/begin MEASUREMENT tCLERRTIM "RAM value tCLERRTIM" UBYTE COMP_0463_S 1 100 0 255 ECU_ADDRESS 0xFFFF1C4F READ_WRITE /end MEASUREMENT
/begin MEASUREMENT tCLERRTIME "RAM value tCLERRTIME" UBYTE COMP_0463_S 1 100 0 255 ECU_ADDRESS 0xFFFF1C51 READ_WRITE /end MEASUREMENT
/begin MEASUREMENT tCLERTMOPE "RAM value tCLERTMOPE" UBYTE COMP_0463_S 1 100 0 255 ECU_ADDRESS 0xFFFF1C53 READ_WRITE /end MEASUREMENT
/begin MEASUREMENT tCMPTIME "RAM value tCMPTIME" UBYTE COMP_0463_S 1 100 0 255 ECU_ADDRESS 0xFFFF1C55 READ_WRITE /end MEASUREMENT
/begin MEASUREMENT tCRMODLY "RAM value tCRMODLY" UBYTE COMP_0463_S 1 100 0 255 ECU_ADDRESS 0xFFFF1C56 READ_WRITE /end MEASUREMENT
/begin MEASUREMENT tDIGNENGT "RAM value tDIGNENGT" UBYTE COMP_0463_S 1 100 0 255 ECU_ADDRESS 0xFFFF1C57 READ_WRITE /end MEASUREMENT
/begin MEASUREMENT tDLYLON "RAM value tDLYLON" UBYTE COMP_0463_S 1 100 0 255 ECU_ADDRESS 0xFFFF1C58 READ_WRITE /end MEASUREMENT
/begin MEASUREMENT tDLYLOND "RAM value tDLYLOND" UBYTE COMP_0463_S 1 100 0 255 ECU_ADDRESS 0xFFFF1C59 READ_WRITE /end MEASUREMENT
/begin MEASUREMENT tDLYPAOF "RAM value tDLYPAOF" UBYTE COMP_0463_S 1 100 0 255 ECU_ADDRESS 0xFFFF1C5A READ_WRITE /end MEASUREMENT
/begin MEASUREMENT tDLYPAON "RAM value tDLYPAON" UBYTE COMP_0463_S 1 100 0 255 ECU_ADDRESS 0xFFFF1C5B READ_WRITE /end MEASUREMENT
/begin MEASUREMENT tDNSET0SS "RAM value tDNSET0SS" UBYTE COMP_0463_S 1 100 0 255 ECU_ADDRESS 0xFFFF1C5C READ_WRITE /end MEASUREMENT
/begin MEASUREMENT tECOICTMA "RAM value tECOICTMA" UBYTE COMP_0463_S 1 100 0 255 ECU_ADDRESS 0xFFFF1C5D READ_WRITE /end MEASUREMENT
/begin MEASUREMENT tECOICTMG "RAM value tECOICTMG" UBYTE COMP_0463_S 1 100 0 255 ECU_ADDRESS 0xFFFF1C5E READ_WRITE /end MEASUREMENT
/begin MEASUREMENT tENSTDLYT "RAM value tENSTDLYT" UBYTE COMP_0463_S 1 100 0 255 ECU_ADDRESS 0xFFFF1C5F READ_WRITE /end MEASUREMENT
/begin MEASUREMENT tEVPCTT3 "RAM value tEVPCTT3" UBYTE COMP_0463_S 1 100 0 255 ECU_ADDRESS 0xFFFF1C60 READ_WRITE /end MEASUREMENT
/begin MEASUREMENT tEVPDLY "RAM value tEVPDLY" UBYTE COMP_0463_S 1 100 0 255 ECU_ADDRESS 0xFFFF1C62 READ_WRITE /end MEASUREMENT
/begin MEASUREMENT tFCAFHZ "RAM value tFCAFHZ" UBYTE COMP_0463_S 1 100 0 255 ECU_ADDRESS 0xFFFF1C63 READ_WRITE /end MEASUREMENT
/begin MEASUREMENT tFCAFHZF "RAM value tFCAFHZF" UBYTE COMP_0463_S 1 100 0 255 ECU_ADDRESS 0xFFFF1C64 READ_WRITE /end MEASUREMENT
/begin MEASUREMENT tFCAFHZF2 "RAM value tFCAFHZF2" UBYTE COMP_0463_S 1 100 0 255 ECU_ADDRESS 0xFFFF1C65 READ_WRITE /end MEASUREMENT
/begin MEASUREMENT tFCAFHZF3 "RAM value tFCAFHZF3" UBYTE COMP_0463_S 1 100 0 255 ECU_ADDRESS 0xFFFF1C66 READ_WRITE /end MEASUREMENT
/begin MEASUREMENT tFCDLY "RAM value tFCDLY" UBYTE COMP_0463_S 1 100 0 255 ECU_ADDRESS 0xFFFF1C67 READ_WRITE /end MEASUREMENT
/begin MEASUREMENT tFCDLY2 "RAM value tFCDLY2" UBYTE COMP_0463_S 1 100 0 255 ECU_ADDRESS 0xFFFF1C68 READ_WRITE /end MEASUREMENT
/begin MEASUREMENT tFCRD "RAM value tFCRD" UBYTE COMP_0463_S 1 100 0 255 ECU_ADDRESS 0xFFFF1C69 READ_WRITE /end MEASUREMENT
/begin MEASUREMENT tFCTIM1 "RAM value tFCTIM1" UBYTE COMP_0463_S 1 100 0 255 ECU_ADDRESS 0xFFFF1C6A READ_WRITE /end MEASUREMENT
/begin MEASUREMENT tFO2HCTD "RAM value tFO2HCTD" UBYTE COMP_0463_S 1 100 0 255 ECU_ADDRESS 0xFFFF1C6B READ_WRITE /end MEASUREMENT
/begin MEASUREMENT tFPHNGT "RAM value tFPHNGT" UBYTE COMP_0463_S 1 100 0 255 ECU_ADDRESS 0xFFFF1C6C READ_WRITE /end MEASUREMENT
/begin MEASUREMENT tFPLNGT "RAM value tFPLNGT" UBYTE COMP_0463_S 1 100 0 255 ECU_ADDRESS 0xFFFF1C6D READ_WRITE /end MEASUREMENT
/begin MEASUREMENT tFPLNGT2 "RAM value tFPLNGT2" UBYTE COMP_0463_S 1 100 0 255 ECU_ADDRESS 0xFFFF1C6E READ_WRITE /end MEASUREMENT
/begin MEASUREMENT tFPLNGT2B "RAM value tFPLNGT2B" UBYTE COMP_0463_S 1 100 0 255 ECU_ADDRESS 0xFFFF1C6F READ_WRITE /end MEASUREMENT
/begin MEASUREMENT tFPLNGTB "RAM value tFPLNGTB" UBYTE COMP_0463_S 1 100 0 255 ECU_ADDRESS 0xFFFF1C70 READ_WRITE /end MEASUREMENT
/begin MEASUREMENT tFRTM "RAM value tFRTM" UBYTE COMP_0463_S 1 100 0 255 ECU_ADDRESS 0xFFFF1C71 READ_WRITE /end MEASUREMENT
/begin MEASUREMENT tFSVO2NG "RAM value tFSVO2NG" UBYTE COMP_0463_S 1 100 0 255 ECU_ADDRESS 0xFFFF1C72 READ_WRITE /end MEASUREMENT
/begin MEASUREMENT tGAKADVTM "RAM value tGAKADVTM" UBYTE COMP_0463_S 1 100 0 255 ECU_ADDRESS 0xFFFF1C74 READ_WRITE /end MEASUREMENT
/begin MEASUREMENT tIDELAY "RAM value tIDELAY" UBYTE COMP_0463_S 1 100 0 255 ECU_ADDRESS 0xFFFF1C75 READ_WRITE /end MEASUREMENT
/begin MEASUREMENT tIDELAY1 "RAM value tIDELAY1" UBYTE COMP_0463_S 1 100 0 255 ECU_ADDRESS 0xFFFF1C76 READ_WRITE /end MEASUREMENT
/begin MEASUREMENT tIDELAYC "RAM value tIDELAYC" UBYTE COMP_0463_S 1 100 0 255 ECU_ADDRESS 0xFFFF1C77 READ_WRITE /end MEASUREMENT
/begin MEASUREMENT tIDLTM "RAM value tIDLTM" UBYTE COMP_0463_S 1 100 0 255 ECU_ADDRESS 0xFFFF1C78 READ_WRITE /end MEASUREMENT
/begin MEASUREMENT tIDLTM2 "RAM value tIDLTM2" UBYTE COMP_0463_S 1 100 0 255 ECU_ADDRESS 0xFFFF1C79 READ_WRITE /end MEASUREMENT
/begin MEASUREMENT tIDVDLY2 "RAM value tIDVDLY2" UBYTE COMP_0463_S 1 100 0 255 ECU_ADDRESS 0xFFFF1C7A READ_WRITE /end MEASUREMENT
/begin MEASUREMENT tIDVDLYE "RAM value tIDVDLYE" UBYTE COMP_0463_S 1 100 0 255 ECU_ADDRESS 0xFFFF1C7B READ_WRITE /end MEASUREMENT
/begin MEASUREMENT tIDVTDLY "RAM value tIDVTDLY" UBYTE COMP_0463_S 1 100 0 255 ECU_ADDRESS 0xFFFF1C7C READ_WRITE /end MEASUREMENT
/begin MEASUREMENT tISCDLY "RAM value tISCDLY" UBYTE COMP_0463_S 1 100 0 255 ECU_ADDRESS 0xFFFF1C7D READ_WRITE /end MEASUREMENT
/begin MEASUREMENT tISCLRD "RAM value tISCLRD" UBYTE COMP_0463_S 1 100 0 255 ECU_ADDRESS 0xFFFF1C7E READ_WRITE /end MEASUREMENT
/begin MEASUREMENT tISCLRDQ "RAM value tISCLRDQ" UBYTE COMP_0463_S 1 100 0 255 ECU_ADDRESS 0xFFFF1C7F READ_WRITE /end MEASUREMENT
/begin MEASUREMENT tISCSTDLY "RAM value tISCSTDLY" UBYTE COMP_0463_S 1 100 0 255 ECU_ADDRESS 0xFFFF1C80 READ_WRITE /end MEASUREMENT
/begin MEASUREMENT tKAIVFT "RAM value tKAIVFT" UBYTE COMP_0463_S 1 100 0 255 ECU_ADDRESS 0xFFFF1C81 READ_WRITE /end MEASUREMENT
/begin MEASUREMENT tKAIVRT "RAM value tKAIVRT" UBYTE COMP_0463_S 1 100 0 255 ECU_ADDRESS 0xFFFF1C83 READ_WRITE /end MEASUREMENT
/begin MEASUREMENT tKMRHT "RAM value tKMRHT" UBYTE COMP_0463_S 1 100 0 255 ECU_ADDRESS 0xFFFF1C85 READ_WRITE /end MEASUREMENT
/begin MEASUREMENT tL2MNTM "RAM value tL2MNTM" UBYTE COMP_0463_S 1 100 0 255 ECU_ADDRESS 0xFFFF1C86 READ_WRITE /end MEASUREMENT
/begin MEASUREMENT tL2MNTM2 "RAM value tL2MNTM2" UBYTE COMP_0463_S 1 100 0 255 ECU_ADDRESS 0xFFFF1C87 READ_WRITE /end MEASUREMENT
/begin MEASUREMENT tLMDPMD "RAM value tLMDPMD" UBYTE COMP_0463_S 1 100 0 255 ECU_ADDRESS 0xFFFF1C88 READ_WRITE /end MEASUREMENT
/begin MEASUREMENT tLRNTIM "RAM value tLRNTIM" UBYTE COMP_0463_S 1 100 0 255 ECU_ADDRESS 0xFFFF1C89 READ_WRITE /end MEASUREMENT
/begin MEASUREMENT tLRNTIME "RAM value tLRNTIME" UBYTE COMP_0463_S 1 100 0 255 ECU_ADDRESS 0xFFFF1C8A READ_WRITE /end MEASUREMENT
/begin MEASUREMENT tNALTDWN "RAM value tNALTDWN" UBYTE COMP_0463_S 1 100 0 255 ECU_ADDRESS 0xFFFF1C8B READ_WRITE /end MEASUREMENT
/begin MEASUREMENT tNALTUP "RAM value tNALTUP" UBYTE COMP_0463_S 1 100 0 255 ECU_ADDRESS 0xFFFF1C8C READ_WRITE /end MEASUREMENT
/begin MEASUREMENT tNMAX0 "RAM value tNMAX0" UBYTE COMP_0463_S 1 100 0 255 ECU_ADDRESS 0xFFFF1C8D READ_WRITE /end MEASUREMENT
/begin MEASUREMENT tO2TMHMX1 "RAM value tO2TMHMX1" UBYTE COMP_0463_S 1 100 0 255 ECU_ADDRESS 0xFFFF1C8E READ_WRITE /end MEASUREMENT
/begin MEASUREMENT tPBFCD "RAM value tPBFCD" UBYTE COMP_0463_S 1 100 0 255 ECU_ADDRESS 0xFFFF1C8F READ_WRITE /end MEASUREMENT
/begin MEASUREMENT tPDOKTIM "RAM value tPDOKTIM" UBYTE COMP_0463_S 1 100 0 255 ECU_ADDRESS 0xFFFF1C90 READ_WRITE /end MEASUREMENT
/begin MEASUREMENT tPREDLY "RAM value tPREDLY" UBYTE COMP_0463_S 1 100 0 255 ECU_ADDRESS 0xFFFF1C91 READ_WRITE /end MEASUREMENT
/begin MEASUREMENT tPSFNGT "RAM value tPSFNGT" UBYTE COMP_0463_S 1 100 0 255 ECU_ADDRESS 0xFFFF1C92 READ_WRITE /end MEASUREMENT
/begin MEASUREMENT tPSNGT2H "RAM value tPSNGT2H" UBYTE COMP_0463_S 1 100 0 255 ECU_ADDRESS 0xFFFF1C93 READ_WRITE /end MEASUREMENT
/begin MEASUREMENT tPSNGT2L "RAM value tPSNGT2L" UBYTE COMP_0463_S 1 100 0 255 ECU_ADDRESS 0xFFFF1C94 READ_WRITE /end MEASUREMENT
/begin MEASUREMENT tPSNGT4H "RAM value tPSNGT4H" UBYTE COMP_0463_S 1 100 0 255 ECU_ADDRESS 0xFFFF1C95 READ_WRITE /end MEASUREMENT
/begin MEASUREMENT tPSNGT4L "RAM value tPSNGT4L" UBYTE COMP_0463_S 1 100 0 255 ECU_ADDRESS 0xFFFF1C96 READ_WRITE /end MEASUREMENT
/begin MEASUREMENT tPSNGTH "RAM value tPSNGTH" UBYTE COMP_0463_S 1 100 0 255 ECU_ADDRESS 0xFFFF1C97 READ_WRITE /end MEASUREMENT
/begin MEASUREMENT tPSNGTL "RAM value tPSNGTL" UBYTE COMP_0463_S 1 100 0 255 ECU_ADDRESS 0xFFFF1C98 READ_WRITE /end MEASUREMENT
/begin MEASUREMENT tPSSTDY "RAM value tPSSTDY" UBYTE COMP_0463_S 1 100 0 255 ECU_ADDRESS 0xFFFF1C99 READ_WRITE /end MEASUREMENT
/begin MEASUREMENT tRODRDTM "RAM value tRODRDTM" UBYTE COMP_0463_S 1 100 0 255 ECU_ADDRESS 0xFFFF1C9A READ_WRITE /end MEASUREMENT
/begin MEASUREMENT tRODRFCD "RAM value tRODRFCD" UBYTE COMP_0463_S 1 100 0 255 ECU_ADDRESS 0xFFFF1C9B READ_WRITE /end MEASUREMENT
/begin MEASUREMENT tRODRFCT "RAM value tRODRFCT" UBYTE COMP_0463_S 1 100 0 255 ECU_ADDRESS 0xFFFF1C9C READ_WRITE /end MEASUREMENT
/begin MEASUREMENT tRODRJDL "RAM value tRODRJDL" UBYTE COMP_0463_S 1 100 0 255 ECU_ADDRESS 0xFFFF1C9D READ_WRITE /end MEASUREMENT
/begin MEASUREMENT tSCVDTM "RAM value tSCVDTM" UBYTE COMP_0463_S 1 100 0 255 ECU_ADDRESS 0xFFFF1C9E READ_WRITE /end MEASUREMENT
/begin MEASUREMENT tSTEXCS "RAM value tSTEXCS" UBYTE COMP_0463_S 1 100 0 255 ECU_ADDRESS 0xFFFF1C9F READ_WRITE /end MEASUREMENT
/begin MEASUREMENT tSTOKTM "RAM value tSTOKTM" UBYTE COMP_0463_S 1 100 0 255 ECU_ADDRESS 0xFFFF1CA0 READ_WRITE /end MEASUREMENT
/begin MEASUREMENT tSTSTAT0 "RAM value tSTSTAT0" UBYTE COMP_0463_S 1 100 0 255 ECU_ADDRESS 0xFFFF1CA1 READ_WRITE /end MEASUREMENT
/begin MEASUREMENT tSTSTAT1 "RAM value tSTSTAT1" UBYTE COMP_0463_S 1 100 0 255 ECU_ADDRESS 0xFFFF1CA2 READ_WRITE /end MEASUREMENT
/begin MEASUREMENT tTALPEST "RAM value tTALPEST" UBYTE COMP_0463_S 1 100 0 255 ECU_ADDRESS 0xFFFF1CA3 READ_WRITE /end MEASUREMENT
/begin MEASUREMENT tTALTVBHH "RAM value tTALTVBHH" UBYTE COMP_0463_S 1 100 0 255 ECU_ADDRESS 0xFFFF1CA4 READ_WRITE /end MEASUREMENT
/begin MEASUREMENT tTALTVBHL "RAM value tTALTVBHL" UBYTE COMP_0463_S 1 100 0 255 ECU_ADDRESS 0xFFFF1CA5 READ_WRITE /end MEASUREMENT
/begin MEASUREMENT tTASLRDQ "RAM value tTASLRDQ" UBYTE COMP_0463_S 1 100 0 255 ECU_ADDRESS 0xFFFF1CA6 READ_WRITE /end MEASUREMENT
/begin MEASUREMENT tTATRD "RAM value tTATRD" UBYTE COMP_0463_S 1 100 0 255 ECU_ADDRESS 0xFFFF1CA7 READ_WRITE /end MEASUREMENT
/begin MEASUREMENT tTCVDTM "RAM value tTCVDTM" UBYTE COMP_0463_S 1 100 0 255 ECU_ADDRESS 0xFFFF1CA8 READ_WRITE /end MEASUREMENT
/begin MEASUREMENT tTCVSTDLY "RAM value tTCVSTDLY" UBYTE COMP_0463_S 1 100 0 255 ECU_ADDRESS 0xFFFF1CA9 READ_WRITE /end MEASUREMENT
/begin MEASUREMENT tTCVTTM "RAM value tTCVTTM" UBYTE COMP_0463_S 1 100 0 255 ECU_ADDRESS 0xFFFF1CAA READ_WRITE /end MEASUREMENT
/begin MEASUREMENT tTDABF "RAM value tTDABF" UBYTE COMP_0463_S 1 100 0 255 ECU_ADDRESS 0xFFFF1CAB READ_WRITE /end MEASUREMENT
/begin MEASUREMENT tTDLYPA "RAM value tTDLYPA" UBYTE COMP_0463_S 1 100 0 255 ECU_ADDRESS 0xFFFF1CAC READ_WRITE /end MEASUREMENT
/begin MEASUREMENT tTDMNCL "RAM value tTDMNCL" UBYTE COMP_0463_S 1 100 0 255 ECU_ADDRESS 0xFFFF1CAD READ_WRITE /end MEASUREMENT
/begin MEASUREMENT tTIMERD "RAM value tTIMERD" UBYTE COMP_0463_S 1 100 0 255 ECU_ADDRESS 0xFFFF1CAF READ_WRITE /end MEASUREMENT
/begin MEASUREMENT tTIMERR "RAM value tTIMERR" UBYTE COMP_0463_S 1 100 0 255 ECU_ADDRESS 0xFFFF1CB0 READ_WRITE /end MEASUREMENT
/begin MEASUREMENT tTIPDOF "RAM value tTIPDOF" UBYTE COMP_0463_S 1 100 0 255 ECU_ADDRESS 0xFFFF1CB1 READ_WRITE /end MEASUREMENT
/begin MEASUREMENT tTIPRQA "RAM value tTIPRQA" UBYTE COMP_0463_S 1 100 0 255 ECU_ADDRESS 0xFFFF1CB2 READ_WRITE /end MEASUREMENT
/begin MEASUREMENT tTMACST "RAM value tTMACST" UBYTE COMP_0463_S 1 100 0 255 ECU_ADDRESS 0xFFFF1CB3 READ_WRITE /end MEASUREMENT
/begin MEASUREMENT tTMAS "RAM value tTMAS" UBYTE COMP_0463_S 1 100 0 255 ECU_ADDRESS 0xFFFF1CB4 READ_WRITE /end MEASUREMENT
/begin MEASUREMENT tTMDVDG "RAM value tTMDVDG" UBYTE COMP_0463_S 1 100 0 255 ECU_ADDRESS 0xFFFF1CB5 READ_WRITE /end MEASUREMENT
/begin MEASUREMENT tTMEVPN "RAM value tTMEVPN" UBYTE COMP_0463_S 1 100 0 255 ECU_ADDRESS 0xFFFF1CB6 READ_WRITE /end MEASUREMENT
/begin MEASUREMENT tTMFPOFDY "RAM value tTMFPOFDY" UBYTE COMP_0463_S 1 100 0 255 ECU_ADDRESS 0xFFFF1CB7 READ_WRITE /end MEASUREMENT
/begin MEASUREMENT tTMHNT "RAM value tTMHNT" UBYTE COMP_0463_S 1 100 0 255 ECU_ADDRESS 0xFFFF1CB8 READ_WRITE /end MEASUREMENT
/begin MEASUREMENT tTMNINJ "RAM value tTMNINJ" UBYTE COMP_0463_S 1 100 0 255 ECU_ADDRESS 0xFFFF1CB9 READ_WRITE /end MEASUREMENT
/begin MEASUREMENT tTMPRES "RAM value tTMPRES" UBYTE COMP_0463_S 1 100 0 255 ECU_ADDRESS 0xFFFF1CBA READ_WRITE /end MEASUREMENT
/begin MEASUREMENT tTMPSON "RAM value tTMPSON" UBYTE COMP_0463_S 1 100 0 255 ECU_ADDRESS 0xFFFF1CBB READ_WRITE /end MEASUREMENT
/begin MEASUREMENT tTMQMASK "RAM value tTMQMASK" UBYTE COMP_0463_S 1 100 0 255 ECU_ADDRESS 0xFFFF1CBC READ_WRITE /end MEASUREMENT
/begin MEASUREMENT tTNRACING "RAM value tTNRACING" UBYTE COMP_0463_S 1 100 0 255 ECU_ADDRESS 0xFFFF1CBD READ_WRITE /end MEASUREMENT
/begin MEASUREMENT tTPFCD "RAM value tTPFCD" UBYTE COMP_0463_S 1 100 0 255 ECU_ADDRESS 0xFFFF1CBE READ_WRITE /end MEASUREMENT
/begin MEASUREMENT tTPPSNG1 "RAM value tTPPSNG1" UBYTE COMP_0463_S 1 100 0 255 ECU_ADDRESS 0xFFFF1CBF READ_WRITE /end MEASUREMENT
/begin MEASUREMENT tTSMDLY "RAM value tTSMDLY" UBYTE COMP_0463_S 1 100 0 255 ECU_ADDRESS 0xFFFF1CC0 READ_WRITE /end MEASUREMENT
/begin MEASUREMENT tTVBMAX "RAM value tTVBMAX" UBYTE COMP_0463_S 1 100 0 255 ECU_ADDRESS 0xFFFF1CC1 READ_WRITE /end MEASUREMENT
/begin MEASUREMENT tTVTBROF "RAM value tTVTBROF" UBYTE COMP_0463_S 1 100 0 255 ECU_ADDRESS 0xFFFF1CC2 READ_WRITE /end MEASUREMENT
/begin MEASUREMENT tUTDTMR "RAM value tUTDTMR" UBYTE COMP_0463_S 1 100 0 255 ECU_ADDRESS 0xFFFF1CC3 READ_WRITE /end MEASUREMENT
/begin MEASUREMENT tVCLNJTM "RAM value tVCLNJTM" UBYTE COMP_0463_S 1 100 0 255 ECU_ADDRESS 0xFFFF1CC4 READ_WRITE /end MEASUREMENT
/begin MEASUREMENT tVCLNJTME "RAM value tVCLNJTME" UBYTE COMP_0463_S 1 100 0 255 ECU_ADDRESS 0xFFFF1CC5 READ_WRITE /end MEASUREMENT
/begin MEASUREMENT tVCLNTM "RAM value tVCLNTM" UBYTE COMP_0463_S 1 100 0 255 ECU_ADDRESS 0xFFFF1CC6 READ_WRITE /end MEASUREMENT
/begin MEASUREMENT tVCLNTME "RAM value tVCLNTME" UBYTE COMP_0463_S 1 100 0 255 ECU_ADDRESS 0xFFFF1CC7 READ_WRITE /end MEASUREMENT
/begin MEASUREMENT tVGUCLD "RAM value tVGUCLD" UBYTE COMP_0463_S 1 100 0 255 ECU_ADDRESS 0xFFFF1CC8 READ_WRITE /end MEASUREMENT
/begin MEASUREMENT tVGUCLDE "RAM value tVGUCLDE" UBYTE COMP_0463_S 1 100 0 255 ECU_ADDRESS 0xFFFF1CC9 READ_WRITE /end MEASUREMENT
/begin MEASUREMENT tVGUSED "RAM value tVGUSED" UBYTE COMP_0463_S 1 100 0 255 ECU_ADDRESS 0xFFFF1CCA READ_WRITE /end MEASUREMENT
/begin MEASUREMENT tVGUSEDE "RAM value tVGUSEDE" UBYTE COMP_0463_S 1 100 0 255 ECU_ADDRESS 0xFFFF1CCB READ_WRITE /end MEASUREMENT
/begin MEASUREMENT tVTCLNTM "RAM value tVTCLNTM" UBYTE COMP_0463_S 1 100 0 255 ECU_ADDRESS 0xFFFF1CCC READ_WRITE /end MEASUREMENT
/begin MEASUREMENT tVTCLNTME "RAM value tVTCLNTME" UBYTE COMP_0463_S 1 100 0 255 ECU_ADDRESS 0xFFFF1CCD READ_WRITE /end MEASUREMENT
/begin MEASUREMENT tYRTIME "RAM value tYRTIME" UBYTE COMP_0463_S 1 100 0 255 ECU_ADDRESS 0xFFFF1CCE READ_WRITE /end MEASUREMENT
/begin MEASUREMENT tYRTIME1 "RAM value tYRTIME1" UBYTE COMP_0463_S 1 100 0 255 ECU_ADDRESS 0xFFFF1CCF READ_WRITE /end MEASUREMENT
/begin MEASUREMENT tYRTIME2 "RAM value tYRTIME2" UBYTE COMP_0463_S 1 100 0 255 ECU_ADDRESS 0xFFFF1CD0 READ_WRITE /end MEASUREMENT
/begin MEASUREMENT tYRTIME3 "RAM value tYRTIME3" UBYTE COMP_0463_S 1 100 0 255 ECU_ADDRESS 0xFFFF1CD1 READ_WRITE /end MEASUREMENT
/begin MEASUREMENT tYRTIME4 "RAM value tYRTIME4" UBYTE COMP_0463_S 1 100 0 255 ECU_ADDRESS 0xFFFF1CD2 READ_WRITE /end MEASUREMENT
/begin MEASUREMENT tYRTIME5 "RAM value tYRTIME5" UBYTE COMP_0463_S 1 100 0 255 ECU_ADDRESS 0xFFFF1CD3 READ_WRITE /end MEASUREMENT
/begin MEASUREMENT tYRTIME6 "RAM value tYRTIME6" UBYTE COMP_0463_S 1 100 0 255 ECU_ADDRESS 0xFFFF1CD4 READ_WRITE /end MEASUREMENT
/begin MEASUREMENT tFSAF30M "RAM value tFSAF30M" UBYTE COMP_0466_S 1 100 0 255 ECU_ADDRESS 0xFFFF1D6C READ_WRITE /end MEASUREMENT
/begin MEASUREMENT tTMRMN10 "RAM value tTMRMN10" UBYTE COMP_0466_S 1 100 0 255 ECU_ADDRESS 0xFFFF1D6D READ_WRITE /end MEASUREMENT
/begin MEASUREMENT cCLPCD "RAM value cCLPCD" UBYTE COMP_0191 1 100 0 255 ECU_ADDRESS 0xFFFF1D6E READ_WRITE /end MEASUREMENT
/begin MEASUREMENT cCLPD "RAM value cCLPD" UBYTE COMP_0191 1 100 0 255 ECU_ADDRESS 0xFFFF1D70 READ_WRITE /end MEASUREMENT
/begin MEASUREMENT cCRO2H "RAM value cCRO2H" UBYTE COMP_0191 1 100 0 255 ECU_ADDRESS 0xFFFF1D72 READ_WRITE /end MEASUREMENT
/begin MEASUREMENT cCRO2L "RAM value cCRO2L" UBYTE COMP_0191 1 100 0 255 ECU_ADDRESS 0xFFFF1D74 READ_WRITE /end MEASUREMENT
/begin MEASUREMENT cECTTM "RAM value cECTTM" UBYTE COMP_0191 1 100 0 255 ECU_ADDRESS 0xFFFF1D76 READ_WRITE /end MEASUREMENT
/begin MEASUREMENT cINLDL "RAM value cINLDL" UBYTE COMP_0191 1 100 0 255 ECU_ADDRESS 0xFFFF1D77 READ_WRITE /end MEASUREMENT
/begin MEASUREMENT cINLDR "RAM value cINLDR" UBYTE COMP_0191 1 100 0 255 ECU_ADDRESS 0xFFFF1D79 READ_WRITE /end MEASUREMENT
/begin MEASUREMENT cREV16CHK "RAM value cREV16CHK" UBYTE COMP_0191 1 100 0 255 ECU_ADDRESS 0xFFFF1D7B READ_WRITE /end MEASUREMENT
/begin MEASUREMENT cACREF "RAM value cACREF" UBYTE COMP_0287 1 100 0 255 ECU_ADDRESS 0xFFFF1D7C READ_WRITE /end MEASUREMENT
/begin MEASUREMENT cADVLMTPI "RAM value cADVLMTPI" UBYTE COMP_0287 1 100 0 255 ECU_ADDRESS 0xFFFF1D7D READ_WRITE /end MEASUREMENT
/begin MEASUREMENT cAFSAMPLE "RAM value cAFSAMPLE" UBYTE COMP_0287 1 100 0 255 ECU_ADDRESS 0xFFFF1D7E READ_WRITE /end MEASUREMENT
/begin MEASUREMENT cCTSPIG "RAM value cCTSPIG" UBYTE COMP_0287 1 100 0 255 ECU_ADDRESS 0xFFFF1D7F READ_WRITE /end MEASUREMENT
/begin MEASUREMENT cDCLEGFC "RAM value cDCLEGFC" UBYTE COMP_0287 1 100 0 255 ECU_ADDRESS 0xFFFF1D80 READ_WRITE /end MEASUREMENT
/begin MEASUREMENT cDGINGOV "RAM value cDGINGOV" UBYTE COMP_0287 1 100 0 255 ECU_ADDRESS 0xFFFF1D81 READ_WRITE /end MEASUREMENT
/begin MEASUREMENT cO2SAMPLE "RAM value cO2SAMPLE" UBYTE COMP_0287 1 100 0 255 ECU_ADDRESS 0xFFFF1D82 READ_WRITE /end MEASUREMENT
/begin MEASUREMENT cQTRREF "RAM value cQTRREF" UBYTE COMP_0287 1 100 0 255 ECU_ADDRESS 0xFFFF1D83 READ_WRITE /end MEASUREMENT
/begin MEASUREMENT cRFNREF "RAM value cRFNREF" UBYTE COMP_0287 1 100 0 255 ECU_ADDRESS 0xFFFF1D84 READ_WRITE /end MEASUREMENT
/begin MEASUREMENT cRSEDRF "RAM value cRSEDRF" UBYTE COMP_0287 1 100 0 255 ECU_ADDRESS 0xFFFF1D85 READ_WRITE /end MEASUREMENT
/begin MEASUREMENT cTEGRDLY "RAM value cTEGRDLY" UBYTE COMP_0287 1 100 0 255 ECU_ADDRESS 0xFFFF1D87 READ_WRITE /end MEASUREMENT
/begin MEASUREMENT cTEMHRCN "RAM value cTEMHRCN" UBYTE COMP_0287 1 100 0 255 ECU_ADDRESS 0xFFFF1D88 READ_WRITE /end MEASUREMENT
/begin MEASUREMENT cTREFINT "RAM value cTREFINT" UBYTE COMP_0287 1 100 0 255 ECU_ADDRESS 0xFFFF1D89 READ_WRITE /end MEASUREMENT
/begin MEASUREMENT cVTCFBTME "RAM value cVTCFBTME" UBYTE COMP_0287 1 100 0 255 ECU_ADDRESS 0xFFFF1D8A READ_WRITE /end MEASUREMENT
/begin MEASUREMENT cVTCFBTMI "RAM value cVTCFBTMI" UBYTE COMP_0287 1 100 0 255 ECU_ADDRESS 0xFFFF1D8C READ_WRITE /end MEASUREMENT
/begin MEASUREMENT tTMDTWU "RAM value tTMDTWU" UWORD COMP_0465_S 1 100 0 65535 ECU_ADDRESS 0xFFFF1D8E READ_WRITE /end MEASUREMENT
/begin MEASUREMENT tTTIMES "RAM value tTTIMES" UWORD COMP_0465_S 1 100 0 65535 ECU_ADDRESS 0xFFFF1D90 READ_WRITE /end MEASUREMENT
/begin MEASUREMENT tTAFSSWB "RAM value tTAFSSWB" UWORD COMP_0463_S 1 100 0 65535 ECU_ADDRESS 0xFFFF1D92 READ_WRITE /end MEASUREMENT
/begin MEASUREMENT tTMDECH "RAM value tTMDECH" UWORD COMP_0463_S 1 100 0 65535 ECU_ADDRESS 0xFFFF1D94 READ_WRITE /end MEASUREMENT
/begin MEASUREMENT tTMDECL "RAM value tTMDECL" UWORD COMP_0463_S 1 100 0 65535 ECU_ADDRESS 0xFFFF1D96 READ_WRITE /end MEASUREMENT
/begin MEASUREMENT tVCLEXPC "RAM value tVCLEXPC" UWORD COMP_0463_S 1 100 0 65535 ECU_ADDRESS 0xFFFF1D98 READ_WRITE /end MEASUREMENT
/begin MEASUREMENT tVCLEXPCE "RAM value tVCLEXPCE" UWORD COMP_0463_S 1 100 0 65535 ECU_ADDRESS 0xFFFF1D9A READ_WRITE /end MEASUREMENT
/begin MEASUREMENT tDLINPNG "RAM value tDLINPNG" UWORD COMP_0464_S 1 100 0 65535 ECU_ADDRESS 0xFFFF1D9C READ_WRITE /end MEASUREMENT
/begin MEASUREMENT tFCD "RAM value tFCD" UWORD COMP_0464_S 1 100 0 65535 ECU_ADDRESS 0xFFFF1D9E READ_WRITE /end MEASUREMENT
/begin MEASUREMENT tHITIME "RAM value tHITIME" UWORD COMP_0464_S 1 100 0 65535 ECU_ADDRESS 0xFFFF1DA0 READ_WRITE /end MEASUREMENT
/begin MEASUREMENT tHITIMEE "RAM value tHITIMEE" UWORD COMP_0464_S 1 100 0 65535 ECU_ADDRESS 0xFFFF1DA2 READ_WRITE /end MEASUREMENT
/begin MEASUREMENT tKLMCDL "RAM value tKLMCDL" UWORD COMP_0464_S 1 100 0 65535 ECU_ADDRESS 0xFFFF1DA4 READ_WRITE /end MEASUREMENT
/begin MEASUREMENT tLOWTIME "RAM value tLOWTIME" UWORD COMP_0464_S 1 100 0 65535 ECU_ADDRESS 0xFFFF1DA6 READ_WRITE /end MEASUREMENT
/begin MEASUREMENT tLOWTIMEE "RAM value tLOWTIMEE" UWORD COMP_0464_S 1 100 0 65535 ECU_ADDRESS 0xFFFF1DA8 READ_WRITE /end MEASUREMENT
/begin MEASUREMENT tNSETVB2 "RAM value tNSETVB2" UWORD COMP_0464_S 1 100 0 65535 ECU_ADDRESS 0xFFFF1DAA READ_WRITE /end MEASUREMENT
/begin MEASUREMENT tVSPCNT "RAM value tVSPCNT" UWORD COMP_0466_S 1 100 0 65535 ECU_ADDRESS 0xFFFF1DAC READ_WRITE /end MEASUREMENT
/begin MEASUREMENT cRINT1 "RAM value cRINT1" UWORD COMP_0191 1 100 0 65535 ECU_ADDRESS 0xFFFF1DAE READ_WRITE /end MEASUREMENT
/begin MEASUREMENT avADCG "RAM value avADCG" UBYTE COMP_0004 1 100 0 255 ECU_ADDRESS 0xFFFF3A8C READ_WRITE /end MEASUREMENT
/begin MEASUREMENT avADDCUR2 "RAM value avADDCUR2" ULONG COMP_0013_S 1 100 -8388608 8388607.99609375 ECU_ADDRESS 0xFFFF3A90 READ_WRITE /end MEASUREMENT
/begin MEASUREMENT avADJDDL "RAM value avADJDDL" UBYTE COMP_0004 1 100 0 255 ECU_ADDRESS 0xFFFF3A94 READ_WRITE /end MEASUREMENT
/begin MEASUREMENT avADJDIAG "RAM value avADJDIAG" UBYTE COMP_0004 1 100 0 255 ECU_ADDRESS 0xFFFF3A95 READ_WRITE /end MEASUREMENT
/begin MEASUREMENT avADVADJ "RAM value avADVADJ" SBYTE COMP_0018 1 100 -128 127 ECU_ADDRESS 0xFFFF4F74 READ_WRITE /end MEASUREMENT
/begin MEASUREMENT avADVIT1AP "RAM value avADVIT1AP" UBYTE COMP_0017 1 100 0 255 ECU_ADDRESS 0xFFFF3A96 READ_WRITE /end MEASUREMENT
/begin MEASUREMENT avADVIT2AP "RAM value avADVIT2AP" UBYTE COMP_0017 1 100 0 255 ECU_ADDRESS 0xFFFF3A97 READ_WRITE /end MEASUREMENT
/begin MEASUREMENT avADVJMP "RAM value avADVJMP" UBYTE COMP_0245 1 100 -64 191 ECU_ADDRESS 0xFFFF1A80 READ_WRITE /end MEASUREMENT
/begin MEASUREMENT avADVTRM "RAM value avADVTRM" UBYTE COMP_0245 1 100 -64 191 ECU_ADDRESS 0xFFFF1A81 READ_WRITE /end MEASUREMENT
/begin MEASUREMENT avADVTRST "RAM value avADVTRST" UBYTE COMP_0245 1 100 -64 191 ECU_ADDRESS 0xFFFF1A82 READ_WRITE /end MEASUREMENT
/begin MEASUREMENT avAFASCNT1 "RAM value avAFASCNT1" UWORD COMP_0016 1 100 0 65535 ECU_ADDRESS 0xFFFF4F76 READ_WRITE /end MEASUREMENT
/begin MEASUREMENT avAFASCNT2 "RAM value avAFASCNT2" UWORD COMP_0016 1 100 0 65535 ECU_ADDRESS 0xFFFF4F78 READ_WRITE /end MEASUREMENT
/begin MEASUREMENT avAFASTRP1 "RAM value avAFASTRP1" UWORD COMP_0016 1 100 0 65535 ECU_ADDRESS 0xFFFF4F7A READ_WRITE /end MEASUREMENT
/begin MEASUREMENT avAFASTRP2 "RAM value avAFASTRP2" UWORD COMP_0016 1 100 0 65535 ECU_ADDRESS 0xFFFF4F7C READ_WRITE /end MEASUREMENT
/* COMPU_METHOD --------------------------------------------------------- */
/begin COMPU_METHOD COMP_0017 "1deg" RAT_FUNC "%8.2" "deg" COEFFS 0 1 0 0 0 1 /end COMPU_METHOD
/begin COMPU_METHOD COMP_0004 "1－" RAT_FUNC "%8.2" "－" COEFFS 0 1 0 0 0 1 /end COMPU_METHOD
/begin COMPU_METHOD COMP_0013_S "1/256A100ms" RAT_FUNC "%8.4" "A100ms" COEFFS 0 1 8388608 0 0 0.00390625 /end COMPU_METHOD
/begin COMPU_METHOD COMP_0018 "1deg" RAT_FUNC "%8.2" "deg" COEFFS 0 1 0 0 0 1 /end COMPU_METHOD
/begin COMPU_METHOD COMP_0016 "1count" RAT_FUNC "%8.2" "count" COEFFS 0 1 0 0 0 1 /end COMPU_METHOD
/begin COMPU_METHOD COMP_0287 "1REF" RAT_FUNC "%8.2" "REF" COEFFS 0 1 0 0 0 1 /end COMPU_METHOD
/begin COMPU_METHOD COMP_0283 "1flag" RAT_FUNC "%8.2" "flag" COEFFS 0 1 0 0 0 1 /end COMPU_METHOD
/begin COMPU_METHOD COMP_0191 "1REV" RAT_FUNC "%8.2" "REV" COEFFS 0 1 0 0 0 1 /end COMPU_METHOD
/begin COMPU_METHOD COMP_0245 "X-64deg" RAT_FUNC "%8.2" "deg" COEFFS 0 1 64 0 0 1 /end COMPU_METHOD
/begin COMPU_METHOD COMP_0462_S "Status VariableStatus" RAT_FUNC "%8.2" "Status" COEFFS 0 1 0 0 0 1 /end COMPU_METHOD
/begin COMPU_METHOD COMP_0463_S "100ms100ms" RAT_FUNC "%8.2" "100ms" COEFFS 0 1 0 0 0 1 /end COMPU_METHOD
/begin COMPU_METHOD COMP_0464_S "10ms10ms" RAT_FUNC "%8.2" "10ms" COEFFS 0 1 0 0 0 1 /end COMPU_METHOD
/begin COMPU_METHOD COMP_0465_S "1s1s" RAT_FUNC "%8.2" "1s" COEFFS 0 1 0 0 0 1 /end COMPU_METHOD
/begin COMPU_METHOD COMP_0466_S "1ms1ms" RAT_FUNC "%8.2" "1ms" COEFFS 0 1 0 0 0 1 /end COMPU_METHOD
/end MODULE
/end PROJECT
