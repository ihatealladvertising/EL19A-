/begin PROJECT X12C_KH3DT_DI_NAM_R/C ""
/begin HEADER "" /* key HEADER ++ "comment" に Par.scomment */ PROJECT_NO X12C_KH3DT_DI_NAM_R/C /* key PROJECT_NO ++ project number に car_eng_desti_lot */ VERSION "0KHDCFDZ7" /* key VERSION ++ version number に mProgver */ /end HEADER
/begin MODULE DIM ""
/begin MOD_COMMON "" ALIGNMENT_BYTE 1 ALIGNMENT_WORD 2 ALIGNMENT_LONG 4 ALIGNMENT_FLOAT32_IEEE 4 ALIGNMENT_FLOAT64_IEEE 4 DEPOSIT ABSOLUTE BYTE_ORDER MSB_FIRST /* ﾊﾞｲﾄｵｰﾀﾞｰがﾘﾌﾟﾚｰｽされる */ /end MOD_COMMON
/begin MEASUREMENT vCNTKMR3 "RAM value vCNTKMR3" UWORD COMP_0452 1 100 0 51.19921875 ECU_ADDRESS 0xFFFF0AD4 READ_WRITE /end MEASUREMENT
/begin MEASUREMENT vCNTKMR4 "RAM value vCNTKMR4" UWORD COMP_0452 1 100 0 51.19921875 ECU_ADDRESS 0xFFFF0AD6 READ_WRITE /end MEASUREMENT
/begin MEASUREMENT vCNTKMR5 "RAM value vCNTKMR5" UWORD COMP_0452 1 100 0 51.19921875 ECU_ADDRESS 0xFFFF0AD8 READ_WRITE /end MEASUREMENT
/begin MEASUREMENT vCNTKMR6 "RAM value vCNTKMR6" UWORD COMP_0452 1 100 0 51.19921875 ECU_ADDRESS 0xFFFF0ADA READ_WRITE /end MEASUREMENT
/begin MEASUREMENT vCNTLRNNG "RAM value vCNTLRNNG" UBYTE COMP_0030 1 100 0 255 ECU_ADDRESS 0xFFFF455F READ_WRITE /end MEASUREMENT
/begin MEASUREMENT vCNTRIP "RAM value vCNTRIP" ULONG COMP_0389 1 100 0 1685624.33943218 ECU_ADDRESS 0xFFFF43F8 READ_WRITE /end MEASUREMENT
/begin MEASUREMENT vCNTSTLf "RAM value vCNTSTLf" UBYTE COMP_0004 1 100 0 255 ECU_ADDRESS 0xFFFF2101 READ_WRITE /end MEASUREMENT
/begin MEASUREMENT vCNTSTRf "RAM value vCNTSTRf" UBYTE COMP_0004 1 100 0 255 ECU_ADDRESS 0xFFFF2102 READ_WRITE /end MEASUREMENT
/begin MEASUREMENT vCNTTAN "RAM value vCNTTAN" UBYTE COMP_0016 1 100 0 255 ECU_ADDRESS 0xFFFF35F8 READ_WRITE /end MEASUREMENT
/begin MEASUREMENT vCNTTW "RAM value vCNTTW" ULONG COMP_0355 1 100 0 16777215.9960938 ECU_ADDRESS 0xFFFF2448 READ_WRITE /end MEASUREMENT
/begin MEASUREMENT vCOMBLIM "RAM value vCOMBLIM" SWORD COMP_0514_S 1 100 -32768 32767 ECU_ADDRESS 0xFFFF244C READ_WRITE /end MEASUREMENT
/begin MEASUREMENT vCOMPRES "RAM value vCOMPRES" UWORD COMP_0039_S 1 100 60000 125535 ECU_ADDRESS 0xFFFF35FA READ_WRITE /end MEASUREMENT
/begin MEASUREMENT vCOMTFEND "RAM value vCOMTFEND" UWORD COMP_0259_S 1 100 -50 13057 ECU_ADDRESS 0xFFFF35FC READ_WRITE /end MEASUREMENT
/begin MEASUREMENT vCOMTFST "RAM value vCOMTFST" UWORD COMP_0259_S 1 100 -50 13057 ECU_ADDRESS 0xFFFF35FE READ_WRITE /end MEASUREMENT
/begin MEASUREMENT vCONQA "RAM value vCONQA" SBYTE COMP_0468_S 1 100 -128 127 ECU_ADDRESS 0xFFFF5112 READ_WRITE /end MEASUREMENT
/begin MEASUREMENT vCONSOMUX "RAM value vCONSOMUX" UBYTE COMP_0515_S 1 100 0 20400 ECU_ADDRESS 0xFFFF244E READ_WRITE /end MEASUREMENT
/begin MEASUREMENT vCONTCSM "RAM value vCONTCSM" UBYTE COMP_0014 1 100 0 2550 ECU_ADDRESS 0xFFFF1FFB READ_WRITE /end MEASUREMENT
/begin MEASUREMENT vCOSTG "RAM value vCOSTG" UBYTE COMP_0130_S 1 100 0 0.255 ECU_ADDRESS 0xFFFF244F READ_WRITE /end MEASUREMENT
/begin MEASUREMENT vCOUNT1 "RAM value vCOUNT1" ULONG COMP_0068 1 100 0 4294967295 ECU_ADDRESS 0xFFFF310C READ_WRITE /end MEASUREMENT
/begin MEASUREMENT vCOUNT2 "RAM value vCOUNT2" ULONG COMP_0068 1 100 0 4294967295 ECU_ADDRESS 0xFFFF3110 READ_WRITE /end MEASUREMENT
/begin MEASUREMENT vCOUNTALM "RAM value vCOUNTALM" UBYTE COMP_0024 1 100 0 12750 ECU_ADDRESS 0xFFFF2450 READ_WRITE /end MEASUREMENT
/begin MEASUREMENT vCOUNTRER "RAM value vCOUNTRER" UBYTE COMP_0024 1 100 0 12750 ECU_ADDRESS 0xFFFF2451 READ_WRITE /end MEASUREMENT
/begin MEASUREMENT vCOUNTRES "RAM value vCOUNTRES" UBYTE COMP_0024 1 100 0 12750 ECU_ADDRESS 0xFFFF2452 READ_WRITE /end MEASUREMENT
/begin MEASUREMENT vCOUNTSET "RAM value vCOUNTSET" UBYTE COMP_0024 1 100 0 12750 ECU_ADDRESS 0xFFFF2453 READ_WRITE /end MEASUREMENT
/begin MEASUREMENT vCPBKUPC1 "RAM value vCPBKUPC1" UBYTE COMP_0016 1 100 0 255 ECU_ADDRESS 0xFFFF4E64 READ_WRITE /end MEASUREMENT
/begin MEASUREMENT vCPBKUPC2 "RAM value vCPBKUPC2" UBYTE COMP_0016 1 100 0 255 ECU_ADDRESS 0xFFFF4E65 READ_WRITE /end MEASUREMENT
/begin MEASUREMENT vCPCJUGf "RAM value vCPCJUGf" UBYTE COMP_0004 1 100 0 255 ECU_ADDRESS 0xFFFF3600 READ_WRITE /end MEASUREMENT
/begin MEASUREMENT vCQFBI "RAM value vCQFBI" UWORD COMP_0134_S 1 100 0 65535 ECU_ADDRESS 0xFFFF0978 READ_WRITE /end MEASUREMENT
/begin MEASUREMENT vCRACNT "RAM value vCRACNT" UBYTE COMP_0068 1 100 0 255 ECU_ADDRESS 0xFFFF0ADC READ_WRITE /end MEASUREMENT
/begin MEASUREMENT vCRACNT0 "RAM value vCRACNT0" UBYTE COMP_0068 1 100 0 255 ECU_ADDRESS 0xFFFF0ADD READ_WRITE /end MEASUREMENT
/begin MEASUREMENT vCRACNTHH "RAM value vCRACNTHH" UBYTE COMP_0068 1 100 0 255 ECU_ADDRESS 0xFFFF4560 READ_WRITE /end MEASUREMENT
/begin MEASUREMENT vCRACNTHL "RAM value vCRACNTHL" UBYTE COMP_0068 1 100 0 255 ECU_ADDRESS 0xFFFF4561 READ_WRITE /end MEASUREMENT
/begin MEASUREMENT vCRACNTLH "RAM value vCRACNTLH" UBYTE COMP_0068 1 100 0 255 ECU_ADDRESS 0xFFFF4562 READ_WRITE /end MEASUREMENT
/begin MEASUREMENT vCRACNTLL "RAM value vCRACNTLL" UBYTE COMP_0068 1 100 0 255 ECU_ADDRESS 0xFFFF4563 READ_WRITE /end MEASUREMENT
/begin MEASUREMENT vCRACNTZ0 "RAM value vCRACNTZ0" UBYTE COMP_0068 1 100 0 255 ECU_ADDRESS 0xFFFF0ADE READ_WRITE /end MEASUREMENT
/begin MEASUREMENT vCRBGKCNT "RAM value vCRBGKCNT" UWORD COMP_0016 1 100 0 65535 ECU_ADDRESS 0xFFFF2454 READ_WRITE /end MEASUREMENT
/begin MEASUREMENT vCRCNUM "RAM value vCRCNUM" UBYTE COMP_0068 1 100 0 255 ECU_ADDRESS 0xFFFF4564 READ_WRITE /end MEASUREMENT
/begin MEASUREMENT vCRICUT "RAM value vCRICUT" UWORD COMP_0198_S 1 100 0 63.999056205 ECU_ADDRESS 0xFFFF2456 READ_WRITE /end MEASUREMENT
/begin MEASUREMENT vCRTCAT "RAM value vCRTCAT" ULONG COMP_0074 1 100 0 16777215.9960938 ECU_ADDRESS 0xFFFF3114 READ_WRITE /end MEASUREMENT
/begin MEASUREMENT vCRTEM "RAM value vCRTEM" UWORD COMP_0016 1 100 0 65535 ECU_ADDRESS 0xFFFF2458 READ_WRITE /end MEASUREMENT
/begin MEASUREMENT vCRTFUK "RAM value vCRTFUK" ULONG COMP_0074 1 100 0 16777215.9960938 ECU_ADDRESS 0xFFFF3118 READ_WRITE /end MEASUREMENT
/begin MEASUREMENT vCRTIA "RAM value vCRTIA" UWORD COMP_0016 1 100 0 65535 ECU_ADDRESS 0xFFFF245A READ_WRITE /end MEASUREMENT
/begin MEASUREMENT vCRTLOPT1 "RAM value vCRTLOPT1" UBYTE COMP_0004 1 100 0 255 ECU_ADDRESS 0xFFFF245C READ_WRITE /end MEASUREMENT
/begin MEASUREMENT vCRTLOPT2Z "RAM value vCRTLOPT2Z" UBYTE COMP_0004 1 100 0 255 ECU_ADDRESS 0xFFFF245D READ_WRITE /end MEASUREMENT
/begin MEASUREMENT vCSADVHM "RAM value vCSADVHM" UWORD COMP_0019_S 1 100 0 257.000024415 ECU_ADDRESS 0xFFFF3A10 READ_WRITE /end MEASUREMENT
/begin MEASUREMENT vCSADVHU "RAM value vCSADVHU" UWORD COMP_0019_S 1 100 0 257.000024415 ECU_ADDRESS 0xFFFF3A12 READ_WRITE /end MEASUREMENT
/begin MEASUREMENT vCSDGNDL "RAM value vCSDGNDL" UWORD COMP_0092 1 100 0 65535 ECU_ADDRESS 0xFFFF245E READ_WRITE /end MEASUREMENT
/begin MEASUREMENT vCSISCDLY "RAM value vCSISCDLY" UWORD COMP_0015_S 1 100 0 6553.5 ECU_ADDRESS 0xFFFF2460 READ_WRITE /end MEASUREMENT
/begin MEASUREMENT vCSM4WDt "RAM value vCSM4WDt" UBYTE COMP_0016 1 100 0 255 ECU_ADDRESS 0xFFFF2462 READ_WRITE /end MEASUREMENT
/begin MEASUREMENT vCSMACC "RAM value vCSMACC" UBYTE COMP_0016 1 100 0 255 ECU_ADDRESS 0xFFFF4566 READ_WRITE /end MEASUREMENT
/begin MEASUREMENT vCSMACCM "RAM value vCSMACCM" UBYTE COMP_0016 1 100 0 255 ECU_ADDRESS 0xFFFF5113 READ_WRITE /end MEASUREMENT
/begin MEASUREMENT vCSMACCt "RAM value vCSMACCt" UBYTE COMP_0016 1 100 0 255 ECU_ADDRESS 0xFFFF2463 READ_WRITE /end MEASUREMENT
/begin MEASUREMENT vCSMAT "RAM value vCSMAT" UBYTE COMP_0016 1 100 0 255 ECU_ADDRESS 0xFFFF4567 READ_WRITE /end MEASUREMENT
/begin MEASUREMENT vCSMATM "RAM value vCSMATM" UBYTE COMP_0016 1 100 0 255 ECU_ADDRESS 0xFFFF5114 READ_WRITE /end MEASUREMENT
/begin MEASUREMENT vCSMATt "RAM value vCSMATt" UBYTE COMP_0016 1 100 0 255 ECU_ADDRESS 0xFFFF2464 READ_WRITE /end MEASUREMENT
/begin MEASUREMENT vCSMBCM "RAM value vCSMBCM" UBYTE COMP_0016 1 100 0 255 ECU_ADDRESS 0xFFFF4568 READ_WRITE /end MEASUREMENT
/begin MEASUREMENT vCSMBCMM "RAM value vCSMBCMM" UBYTE COMP_0016 1 100 0 255 ECU_ADDRESS 0xFFFF5115 READ_WRITE /end MEASUREMENT
/begin MEASUREMENT vCSMBCMt "RAM value vCSMBCMt" UBYTE COMP_0016 1 100 0 255 ECU_ADDRESS 0xFFFF2465 READ_WRITE /end MEASUREMENT
/begin MEASUREMENT vCSMDLYTM "RAM value vCSMDLYTM" UBYTE COMP_0015_S 1 100 0 25.5 ECU_ADDRESS 0xFFFF2466 READ_WRITE /end MEASUREMENT
/begin MEASUREMENT vCSMEPS "RAM value vCSMEPS" UBYTE COMP_0016 1 100 0 255 ECU_ADDRESS 0xFFFF4569 READ_WRITE /end MEASUREMENT
/begin MEASUREMENT vCSMEPSM "RAM value vCSMEPSM" UBYTE COMP_0016 1 100 0 255 ECU_ADDRESS 0xFFFF5116 READ_WRITE /end MEASUREMENT
/begin MEASUREMENT vCSMEPSt "RAM value vCSMEPSt" UBYTE COMP_0016 1 100 0 255 ECU_ADDRESS 0xFFFF2467 READ_WRITE /end MEASUREMENT
/begin MEASUREMENT vCSMETS "RAM value vCSMETS" UBYTE COMP_0016 1 100 0 255 ECU_ADDRESS 0xFFFF456A READ_WRITE /end MEASUREMENT
/begin MEASUREMENT vCSMETSM "RAM value vCSMETSM" UBYTE COMP_0016 1 100 0 255 ECU_ADDRESS 0xFFFF5117 READ_WRITE /end MEASUREMENT
/begin MEASUREMENT vCSMETSt "RAM value vCSMETSt" UBYTE COMP_0016 1 100 0 255 ECU_ADDRESS 0xFFFF2468 READ_WRITE /end MEASUREMENT
/begin MEASUREMENT vCSMHVAC "RAM value vCSMHVAC" UBYTE COMP_0016 1 100 0 255 ECU_ADDRESS 0xFFFF456B READ_WRITE /end MEASUREMENT
/begin MEASUREMENT vCSMHVACM "RAM value vCSMHVACM" UBYTE COMP_0016 1 100 0 255 ECU_ADDRESS 0xFFFF5118 READ_WRITE /end MEASUREMENT
/begin MEASUREMENT vCSMICNt "RAM value vCSMICNt" UBYTE COMP_0016 1 100 0 255 ECU_ADDRESS 0xFFFF2469 READ_WRITE /end MEASUREMENT
/begin MEASUREMENT vCSMICON "RAM value vCSMICON" UBYTE COMP_0016 1 100 0 255 ECU_ADDRESS 0xFFFF456C READ_WRITE /end MEASUREMENT
/begin MEASUREMENT vCSMICONM "RAM value vCSMICONM" UBYTE COMP_0016 1 100 0 255 ECU_ADDRESS 0xFFFF5119 READ_WRITE /end MEASUREMENT
/begin MEASUREMENT vCSMITM "RAM value vCSMITM" UBYTE COMP_0016 1 100 0 255 ECU_ADDRESS 0xFFFF456D READ_WRITE /end MEASUREMENT
/begin MEASUREMENT vCSMITMM "RAM value vCSMITMM" UBYTE COMP_0016 1 100 0 255 ECU_ADDRESS 0xFFFF511A READ_WRITE /end MEASUREMENT
/begin MEASUREMENT vCSMITMt "RAM value vCSMITMt" UBYTE COMP_0016 1 100 0 255 ECU_ADDRESS 0xFFFF246A READ_WRITE /end MEASUREMENT
/begin MEASUREMENT vCSMM4WD "RAM value vCSMM4WD" UBYTE COMP_0016 1 100 0 255 ECU_ADDRESS 0xFFFF456E READ_WRITE /end MEASUREMENT
/begin MEASUREMENT vCSMM4WDM "RAM value vCSMM4WDM" UBYTE COMP_0016 1 100 0 255 ECU_ADDRESS 0xFFFF511B READ_WRITE /end MEASUREMENT
/begin MEASUREMENT vCSMMET "RAM value vCSMMET" UBYTE COMP_0016 1 100 0 255 ECU_ADDRESS 0xFFFF456F READ_WRITE /end MEASUREMENT
/begin MEASUREMENT vCSMMETM "RAM value vCSMMETM" UBYTE COMP_0016 1 100 0 255 ECU_ADDRESS 0xFFFF511C READ_WRITE /end MEASUREMENT
/begin MEASUREMENT vCSMMETt "RAM value vCSMMETt" UBYTE COMP_0016 1 100 0 255 ECU_ADDRESS 0xFFFF246B READ_WRITE /end MEASUREMENT
/begin MEASUREMENT vCSMMUTE "RAM value vCSMMUTE" UBYTE COMP_0016 1 100 0 255 ECU_ADDRESS 0xFFFF4570 READ_WRITE /end MEASUREMENT
/begin MEASUREMENT vCSMMUTEM "RAM value vCSMMUTEM" UBYTE COMP_0016 1 100 0 255 ECU_ADDRESS 0xFFFF511D READ_WRITE /end MEASUREMENT
/begin MEASUREMENT vCSMMUTt "RAM value vCSMMUTt" UBYTE COMP_0016 1 100 0 255 ECU_ADDRESS 0xFFFF246C READ_WRITE /end MEASUREMENT
/begin MEASUREMENT vCSMNDDLY "RAM value vCSMNDDLY" UBYTE COMP_0015_S 1 100 0 25.5 ECU_ADDRESS 0xFFFF246D READ_WRITE /end MEASUREMENT
/begin MEASUREMENT vCSMUSM "RAM value vCSMUSM" UBYTE COMP_0016 1 100 0 255 ECU_ADDRESS 0xFFFF4571 READ_WRITE /end MEASUREMENT
/begin MEASUREMENT vCSMUSMM "RAM value vCSMUSMM" UBYTE COMP_0016 1 100 0 255 ECU_ADDRESS 0xFFFF511E READ_WRITE /end MEASUREMENT
/begin MEASUREMENT vCSMUSMt "RAM value vCSMUSMt" UBYTE COMP_0016 1 100 0 255 ECU_ADDRESS 0xFFFF246E READ_WRITE /end MEASUREMENT
/begin MEASUREMENT vCSMVACt "RAM value vCSMVACt" UBYTE COMP_0016 1 100 0 255 ECU_ADDRESS 0xFFFF246F READ_WRITE /end MEASUREMENT
/begin MEASUREMENT vCSMVDC "RAM value vCSMVDC" UBYTE COMP_0016 1 100 0 255 ECU_ADDRESS 0xFFFF4572 READ_WRITE /end MEASUREMENT
/begin MEASUREMENT vCSMVDCM "RAM value vCSMVDCM" UBYTE COMP_0016 1 100 0 255 ECU_ADDRESS 0xFFFF511F READ_WRITE /end MEASUREMENT
/begin MEASUREMENT vCSMVDCt "RAM value vCSMVDCt" UBYTE COMP_0016 1 100 0 255 ECU_ADDRESS 0xFFFF2470 READ_WRITE /end MEASUREMENT
/begin MEASUREMENT vCSNEHM "RAM value vCSNEHM" UWORD COMP_0019_S 1 100 0 257.000024415 ECU_ADDRESS 0xFFFF3A14 READ_WRITE /end MEASUREMENT
/begin MEASUREMENT vCSNEHU "RAM value vCSNEHU" UWORD COMP_0019_S 1 100 0 257.000024415 ECU_ADDRESS 0xFFFF3A16 READ_WRITE /end MEASUREMENT
/begin MEASUREMENT vCSNGRC "RAM value vCSNGRC" UBYTE COMP_0016 1 100 0 255 ECU_ADDRESS 0xFFFF2471 READ_WRITE /end MEASUREMENT
/begin MEASUREMENT vCSNGRP "RAM value vCSNGRP" UBYTE COMP_0016 1 100 0 255 ECU_ADDRESS 0xFFFF2472 READ_WRITE /end MEASUREMENT
/begin MEASUREMENT vCSREFCNT "RAM value vCSREFCNT" UWORD COMP_0516_S 1 100 0 104.856 ECU_ADDRESS 0xFFFF2474 READ_WRITE /end MEASUREMENT
/begin MEASUREMENT vCSREVH "RAM value vCSREVH" UWORD COMP_0019_S 1 100 0 257.000024415 ECU_ADDRESS 0xFFFF2476 READ_WRITE /end MEASUREMENT
/begin MEASUREMENT vCSREVHNQ "RAM value vCSREVHNQ" UWORD COMP_0019_S 1 100 0 257.000024415 ECU_ADDRESS 0xFFFF2478 READ_WRITE /end MEASUREMENT
/begin MEASUREMENT vCSSADVAV "RAM value vCSSADVAV" SBYTE COMP_0517_S 1 100 -128 127 ECU_ADDRESS 0xFFFF247A READ_WRITE /end MEASUREMENT
/begin MEASUREMENT vCSSCNT "RAM value vCSSCNT" UWORD COMP_0016 1 100 0 65535 ECU_ADDRESS 0xFFFF4574 READ_WRITE /end MEASUREMENT
/begin MEASUREMENT vCSSCNTD "RAM value vCSSCNTD" UWORD COMP_0068 1 100 0 65535 ECU_ADDRESS 0xFFFF4576 READ_WRITE /end MEASUREMENT
/begin MEASUREMENT vCSSCNTN "RAM value vCSSCNTN" UWORD COMP_0068 1 100 0 65535 ECU_ADDRESS 0xFFFF4578 READ_WRITE /end MEASUREMENT
/begin MEASUREMENT vCSSEXETM "RAM value vCSSEXETM" UBYTE COMP_0015_S 1 100 0 25.5 ECU_ADDRESS 0xFFFF247B READ_WRITE /end MEASUREMENT
/begin MEASUREMENT vCSSPRADV "RAM value vCSSPRADV" SLONG COMP_0018 1 100 -2147483648 2147483647 ECU_ADDRESS 0xFFFF247C READ_WRITE /end MEASUREMENT
/begin MEASUREMENT vCSSPRREV "RAM value vCSSPRREV" ULONG COMP_0006 1 100 0 53687091187.5 ECU_ADDRESS 0xFFFF2480 READ_WRITE /end MEASUREMENT
/begin MEASUREMENT vCSSREVAV "RAM value vCSSREVAV" UWORD COMP_0518_S 1 100 0 819187.5 ECU_ADDRESS 0xFFFF2484 READ_WRITE /end MEASUREMENT
/begin MEASUREMENT vCSSTIM "RAM value vCSSTIM" UWORD COMP_0464_S 1 100 0 65535 ECU_ADDRESS 0xFFFF2486 READ_WRITE /end MEASUREMENT
/begin MEASUREMENT vCSSTRP "RAM value vCSSTRP" UWORD COMP_0016 1 100 0 65535 ECU_ADDRESS 0xFFFF457A READ_WRITE /end MEASUREMENT
/begin MEASUREMENT vCSSTRPD "RAM value vCSSTRPD" UWORD COMP_0068 1 100 0 65535 ECU_ADDRESS 0xFFFF457C READ_WRITE /end MEASUREMENT
/begin MEASUREMENT vCSSTRPN "RAM value vCSSTRPN" UWORD COMP_0068 1 100 0 65535 ECU_ADDRESS 0xFFFF457E READ_WRITE /end MEASUREMENT
/begin MEASUREMENT vCST1OKf "RAM value vCST1OKf" UBYTE COMP_0004 1 100 0 255 ECU_ADDRESS 0xFFFF2488 READ_WRITE /end MEASUREMENT
/begin MEASUREMENT vCST2NGf "RAM value vCST2NGf" UBYTE COMP_0004 1 100 0 255 ECU_ADDRESS 0xFFFF2489 READ_WRITE /end MEASUREMENT
/begin MEASUREMENT vCST2OKf "RAM value vCST2OKf" UBYTE COMP_0004 1 100 0 255 ECU_ADDRESS 0xFFFF248A READ_WRITE /end MEASUREMENT
/begin MEASUREMENT vCSTACTM "RAM value vCSTACTM" UBYTE COMP_0105 1 100 0 25.5 ECU_ADDRESS 0xFFFF248B READ_WRITE /end MEASUREMENT
/begin MEASUREMENT vCSTACTM0 "RAM value vCSTACTM0" UBYTE COMP_0105 1 100 0 25.5 ECU_ADDRESS 0xFFFF248C READ_WRITE /end MEASUREMENT
/begin MEASUREMENT vCSTPADVH "RAM value vCSTPADVH" UWORD COMP_0019_S 1 100 0 257.000024415 ECU_ADDRESS 0xFFFF248E READ_WRITE /end MEASUREMENT
/begin MEASUREMENT vCSTPHNQ "RAM value vCSTPHNQ" UWORD COMP_0019_S 1 100 0 257.000024415 ECU_ADDRESS 0xFFFF2490 READ_WRITE /end MEASUREMENT
/begin MEASUREMENT vCSTWNH "RAM value vCSTWNH" UWORD COMP_0019_S 1 100 0 257.000024415 ECU_ADDRESS 0xFFFF2492 READ_WRITE /end MEASUREMENT
/begin MEASUREMENT vCSTWNHNQ "RAM value vCSTWNHNQ" UWORD COMP_0019_S 1 100 0 257.000024415 ECU_ADDRESS 0xFFFF2494 READ_WRITE /end MEASUREMENT
/begin MEASUREMENT vCSYNGMIN "RAM value vCSYNGMIN" UBYTE COMP_0014 1 100 0 2550 ECU_ADDRESS 0xFFFF4580 READ_WRITE /end MEASUREMENT
/begin MEASUREMENT vCTAINT "RAM value vCTAINT" UBYTE COMP_0016 1 100 0 255 ECU_ADDRESS 0xFFFF15F6 READ_WRITE /end MEASUREMENT
/begin MEASUREMENT vCTAINTEO "RAM value vCTAINTEO" UBYTE COMP_0016 1 100 0 255 ECU_ADDRESS 0xFFFF3601 READ_WRITE /end MEASUREMENT
/begin MEASUREMENT vCTBFALT "RAM value vCTBFALT" UBYTE COMP_0016 1 100 0 255 ECU_ADDRESS 0xFFFF4581 READ_WRITE /end MEASUREMENT
/begin MEASUREMENT vCTCFEQ "RAM value vCTCFEQ" UWORD COMP_0182_S 1 100 0 65.535 ECU_ADDRESS 0xFFFF2496 READ_WRITE /end MEASUREMENT
/begin MEASUREMENT vCTCLK "RAM value vCTCLK" UBYTE COMP_0030 1 100 0 255 ECU_ADDRESS 0xFFFF3602 READ_WRITE /end MEASUREMENT
/begin MEASUREMENT vCTCMAX "RAM value vCTCMAX" UBYTE COMP_0030 1 100 0 255 ECU_ADDRESS 0xFFFF4E66 READ_WRITE /end MEASUREMENT
/begin MEASUREMENT vCTCNT "RAM value vCTCNT" UBYTE COMP_0519_S 1 100 0 255 ECU_ADDRESS 0xFFFF2498 READ_WRITE /end MEASUREMENT
/begin MEASUREMENT vCTI "RAM value vCTI" UWORD COMP_0231 1 100 0 655350 ECU_ADDRESS 0xFFFF1B0E READ_WRITE /end MEASUREMENT
/begin MEASUREMENT vCTIH "RAM value vCTIH" ULONG COMP_0320 1 100 0 6871947672 ECU_ADDRESS 0xFFFF1B18 READ_WRITE /end MEASUREMENT
/begin MEASUREMENT vCTINJ "RAM value vCTINJ" UWORD COMP_0390 1 100 0 655350 ECU_ADDRESS 0xFFFF0AE0 READ_WRITE /end MEASUREMENT
/begin MEASUREMENT vCTINJS "RAM value vCTINJS" UWORD COMP_0390 1 100 0 655350 ECU_ADDRESS 0xFFFF1724 READ_WRITE /end MEASUREMENT
/begin MEASUREMENT vCTIS "RAM value vCTIS" ULONG COMP_0320 1 100 0 6871947672 ECU_ADDRESS 0xFFFF0AE4 READ_WRITE /end MEASUREMENT
/begin MEASUREMENT vCTRLOPT1 "RAM value vCTRLOPT1" UBYTE COMP_0004 1 100 0 255 ECU_ADDRESS 0xFFFF3603 READ_WRITE /end MEASUREMENT
/begin MEASUREMENT vCTRLOPT1Z "RAM value vCTRLOPT1Z" UBYTE COMP_0068 1 100 0 255 ECU_ADDRESS 0xFFFF30B4 READ_WRITE /end MEASUREMENT
/begin MEASUREMENT vCTRLOPT2 "RAM value vCTRLOPT2" UBYTE COMP_0004 1 100 0 255 ECU_ADDRESS 0xFFFF3604 READ_WRITE /end MEASUREMENT
/begin MEASUREMENT vCTRLOPT3 "RAM value vCTRLOPT3" UBYTE COMP_0004 1 100 0 255 ECU_ADDRESS 0xFFFF3605 READ_WRITE /end MEASUREMENT
/begin MEASUREMENT vCTSTPINJ "RAM value vCTSTPINJ" UWORD COMP_0390 1 100 0 655350 ECU_ADDRESS 0xFFFF1726 READ_WRITE /end MEASUREMENT
/begin MEASUREMENT vCTVQL "RAM value vCTVQL" UWORD COMP_0004 1 100 0 65535 ECU_ADDRESS 0xFFFF249A READ_WRITE /end MEASUREMENT
/begin MEASUREMENT vCTVQLS "RAM value vCTVQLS" UBYTE COMP_0004 1 100 0 255 ECU_ADDRESS 0xFFFF249C READ_WRITE /end MEASUREMENT
/begin MEASUREMENT vCTVQLSR "RAM value vCTVQLSR" UWORD COMP_0004 1 100 0 65535 ECU_ADDRESS 0xFFFF249E READ_WRITE /end MEASUREMENT
/begin MEASUREMENT vCUMCONSO "RAM value vCUMCONSO" UWORD COMP_0469_S 1 100 0 20479.6875 ECU_ADDRESS 0xFFFF24A0 READ_WRITE /end MEASUREMENT
/begin MEASUREMENT vCUMCONSY "RAM value vCUMCONSY" UWORD COMP_0469_S 1 100 0 20479.6875 ECU_ADDRESS 0xFFFF1B20 READ_WRITE /end MEASUREMENT
/begin MEASUREMENT vCUREF "RAM value vCUREF" UBYTE COMP_0373 1 100 0 2.55 ECU_ADDRESS 0xFFFF24A2 READ_WRITE /end MEASUREMENT
/begin MEASUREMENT vCURGP "RAM value vCURGP" UBYTE COMP_0068 1 100 0 255 ECU_ADDRESS 0xFFFF085E READ_WRITE /end MEASUREMENT
/begin MEASUREMENT vCURGP0 "RAM value vCURGP0" UBYTE COMP_0068 1 100 0 255 ECU_ADDRESS 0xFFFF201F READ_WRITE /end MEASUREMENT
/begin MEASUREMENT vCURGPMT0 "RAM value vCURGPMT0" UBYTE COMP_0068 1 100 0 255 ECU_ADDRESS 0xFFFF24A3 READ_WRITE /end MEASUREMENT
/begin MEASUREMENT vCURGPV "RAM value vCURGPV" UBYTE COMP_0068 1 100 0 255 ECU_ADDRESS 0xFFFF084A READ_WRITE /end MEASUREMENT
/begin MEASUREMENT vCURMODE "RAM value vCURMODE" UBYTE COMP_0068 1 100 0 255 ECU_ADDRESS 0xFFFF24A4 READ_WRITE /end MEASUREMENT
/begin MEASUREMENT vCURPDL "RAM value vCURPDL" UWORD COMP_0032_S 1 100 0 8191.875 ECU_ADDRESS 0xFFFF24A6 READ_WRITE /end MEASUREMENT
/begin MEASUREMENT vCURPDLAD "RAM value vCURPDLAD" SWORD COMP_0520_S 1 100 -256 255.9921875 ECU_ADDRESS 0xFFFF24A8 READ_WRITE /end MEASUREMENT
/begin MEASUREMENT vCURREV "RAM value vCURREV" UWORD COMP_0443 1 100 0 65535 ECU_ADDRESS 0xFFFF0AEC READ_WRITE /end MEASUREMENT
/begin MEASUREMENT vCURTTIME "RAM value vCURTTIME" ULONG COMP_0053 1 100 0 4294967295 ECU_ADDRESS 0xFFFF15F8 READ_WRITE /end MEASUREMENT
/begin MEASUREMENT vCVBVMN "RAM value vCVBVMN" UBYTE COMP_0391 1 100 0 99.705 ECU_ADDRESS 0xFFFF4582 READ_WRITE /end MEASUREMENT
/begin MEASUREMENT vCVN "RAM value vCVN" ULONG COMP_0004 1 100 0 4294967295 ECU_ADDRESS 0xFFFF24AC READ_WRITE /end MEASUREMENT
/begin MEASUREMENT vCVN1ADR "RAM value vCVN1ADR" ULONG COMP_0068 1 100 0 4294967295 ECU_ADDRESS 0xFFFF24B0 READ_WRITE /end MEASUREMENT
/begin MEASUREMENT vCVN2ADR1 "RAM value vCVN2ADR1" ULONG COMP_0068 1 100 0 4294967295 ECU_ADDRESS 0xFFFF24B4 READ_WRITE /end MEASUREMENT
/begin MEASUREMENT vCVN2ADR2 "RAM value vCVN2ADR2" ULONG COMP_0068 1 100 0 4294967295 ECU_ADDRESS 0xFFFF24B8 READ_WRITE /end MEASUREMENT
/begin MEASUREMENT vCVN2CNT "RAM value vCVN2CNT" UWORD COMP_0068 1 100 0 65535 ECU_ADDRESS 0xFFFF24BC READ_WRITE /end MEASUREMENT
/begin MEASUREMENT vCVNROC "RAM value vCVNROC" ULONG COMP_0068 1 100 0 4294967295 ECU_ADDRESS 0xFFFF24C0 READ_WRITE /end MEASUREMENT
/begin MEASUREMENT vCVNTMP1 "RAM value vCVNTMP1" ULONG COMP_0068 1 100 0 4294967295 ECU_ADDRESS 0xFFFF24C4 READ_WRITE /end MEASUREMENT
/begin MEASUREMENT vCVNTMP2 "RAM value vCVNTMP2" ULONG COMP_0068 1 100 0 4294967295 ECU_ADDRESS 0xFFFF24C8 READ_WRITE /end MEASUREMENT
/begin MEASUREMENT vCVT014 "RAM value vCVT014" UBYTE COMP_0068 1 100 0 255 ECU_ADDRESS 0xFFFF1728 READ_WRITE /end MEASUREMENT
/begin MEASUREMENT vCVTCCHKf "RAM value vCVTCCHKf" UBYTE COMP_0004 1 100 0 255 ECU_ADDRESS 0xFFFF2020 READ_WRITE /end MEASUREMENT
/begin MEASUREMENT vCVTCDTYE "RAM value vCVTCDTYE" UBYTE COMP_0021 1 100 0 99.609375 ECU_ADDRESS 0xFFFF1B22 READ_WRITE /end MEASUREMENT
/begin MEASUREMENT vCVTCECHKf "RAM value vCVTCECHKf" UBYTE COMP_0004 1 100 0 255 ECU_ADDRESS 0xFFFF2021 READ_WRITE /end MEASUREMENT
/begin MEASUREMENT vCVTCXYMN "RAM value vCVTCXYMN" UWORD COMP_0521_S 1 100 0 6553.5 ECU_ADDRESS 0xFFFF311C READ_WRITE /end MEASUREMENT
/begin MEASUREMENT vCVTCYXMN "RAM value vCVTCYXMN" UWORD COMP_0521_S 1 100 0 6553.5 ECU_ADDRESS 0xFFFF311E READ_WRITE /end MEASUREMENT
/begin MEASUREMENT vCVTFLEVL "RAM value vCVTFLEVL" UBYTE COMP_0068 1 100 0 255 ECU_ADDRESS 0xFFFF2022 READ_WRITE /end MEASUREMENT
/begin MEASUREMENT vCVTFLEVZ "RAM value vCVTFLEVZ" UBYTE COMP_0068 1 100 0 255 ECU_ADDRESS 0xFFFF24CC READ_WRITE /end MEASUREMENT
/begin MEASUREMENT vCVTIDLUP "RAM value vCVTIDLUP" UBYTE COMP_0006 1 100 0 3187.5 ECU_ADDRESS 0xFFFF097A READ_WRITE /end MEASUREMENT
/begin MEASUREMENT vCVTIUPRQ "RAM value vCVTIUPRQ" UBYTE COMP_0006 1 100 0 3187.5 ECU_ADDRESS 0xFFFF08C6 READ_WRITE /end MEASUREMENT
/begin MEASUREMENT vCVTMSG1T "RAM value vCVTMSG1T" UBYTE COMP_0014 1 100 0 2550 ECU_ADDRESS 0xFFFF2023 READ_WRITE /end MEASUREMENT
/begin MEASUREMENT vCVTMSG2T "RAM value vCVTMSG2T" UBYTE COMP_0014 1 100 0 2550 ECU_ADDRESS 0xFFFF2024 READ_WRITE /end MEASUREMENT
/begin MEASUREMENT vCVTMSG3T "RAM value vCVTMSG3T" UBYTE COMP_0014 1 100 0 2550 ECU_ADDRESS 0xFFFF2025 READ_WRITE /end MEASUREMENT
/begin MEASUREMENT vCVTRNG "RAM value vCVTRNG" UBYTE COMP_0068 1 100 0 255 ECU_ADDRESS 0xFFFF2026 READ_WRITE /end MEASUREMENT
/begin MEASUREMENT vCVTRNGZ "RAM value vCVTRNGZ" UBYTE COMP_0068 1 100 0 255 ECU_ADDRESS 0xFFFF24CD READ_WRITE /end MEASUREMENT
/begin MEASUREMENT vCYLADV "RAM value vCYLADV" UBYTE COMP_0522_S 1 100 0 255 ECU_ADDRESS 0xFFFF0AEE READ_WRITE /end MEASUREMENT
/begin MEASUREMENT vCYLAF "RAM value vCYLAF" UWORD COMP_0453 1 100 0 131.07 ECU_ADDRESS 0xFFFF0AF0 READ_WRITE /end MEASUREMENT
/begin MEASUREMENT vCYLBUP "RAM value vCYLBUP" UBYTE COMP_0522_S 1 100 0 255 ECU_ADDRESS 0xFFFF4583 READ_WRITE /end MEASUREMENT
/begin MEASUREMENT vCYLBUP1 "RAM value vCYLBUP1" UBYTE COMP_0522_S 1 100 0 255 ECU_ADDRESS 0xFFFF4584 READ_WRITE /end MEASUREMENT
/begin MEASUREMENT vCYLBUP2 "RAM value vCYLBUP2" UBYTE COMP_0522_S 1 100 0 255 ECU_ADDRESS 0xFFFF4585 READ_WRITE /end MEASUREMENT
/begin MEASUREMENT vCYLBUP3 "RAM value vCYLBUP3" UBYTE COMP_0522_S 1 100 0 255 ECU_ADDRESS 0xFFFF4586 READ_WRITE /end MEASUREMENT
/begin MEASUREMENT vCYLBUP4 "RAM value vCYLBUP4" UBYTE COMP_0522_S 1 100 0 255 ECU_ADDRESS 0xFFFF4587 READ_WRITE /end MEASUREMENT
/begin MEASUREMENT vCYLBUP5 "RAM value vCYLBUP5" UBYTE COMP_0522_S 1 100 0 255 ECU_ADDRESS 0xFFFF4588 READ_WRITE /end MEASUREMENT
/begin MEASUREMENT vCYLBUP6 "RAM value vCYLBUP6" UBYTE COMP_0522_S 1 100 0 255 ECU_ADDRESS 0xFFFF4589 READ_WRITE /end MEASUREMENT
/begin MEASUREMENT vCYLCAM "RAM value vCYLCAM" UBYTE COMP_0068 1 100 0 255 ECU_ADDRESS 0xFFFF0AF4 READ_WRITE /end MEASUREMENT
/begin MEASUREMENT vCYLCAM1 "RAM value vCYLCAM1" UBYTE COMP_0068 1 100 0 255 ECU_ADDRESS 0xFFFF0AF5 READ_WRITE /end MEASUREMENT
/begin MEASUREMENT vCYLCNT "RAM value vCYLCNT" UBYTE COMP_0068 1 100 0 255 ECU_ADDRESS 0xFFFF094C READ_WRITE /end MEASUREMENT
/begin MEASUREMENT vCYLCS "RAM value vCYLCS" UBYTE COMP_0522_S 1 100 0 255 ECU_ADDRESS 0xFFFF0AF6 READ_WRITE /end MEASUREMENT
/begin MEASUREMENT vCYLCSF "RAM value vCYLCSF" UBYTE COMP_0522_S 1 100 0 255 ECU_ADDRESS 0xFFFF0AF7 READ_WRITE /end MEASUREMENT
/begin MEASUREMENT vCYLCTPH "RAM value vCYLCTPH" UBYTE COMP_0068 1 100 0 255 ECU_ADDRESS 0xFFFF1729 READ_WRITE /end MEASUREMENT
/begin MEASUREMENT vCYLDNOW "RAM value vCYLDNOW" UBYTE COMP_0522_S 1 100 0 255 ECU_ADDRESS 0xFFFF0AF8 READ_WRITE /end MEASUREMENT
/begin MEASUREMENT vCYLDNOW1 "RAM value vCYLDNOW1" UBYTE COMP_0522_S 1 100 0 255 ECU_ADDRESS 0xFFFF0AF9 READ_WRITE /end MEASUREMENT
/begin MEASUREMENT vCYLDNOW2 "RAM value vCYLDNOW2" UBYTE COMP_0522_S 1 100 0 255 ECU_ADDRESS 0xFFFF0AFA READ_WRITE /end MEASUREMENT
/begin MEASUREMENT vCYLDWL "RAM value vCYLDWL" UBYTE COMP_0522_S 1 100 0 255 ECU_ADDRESS 0xFFFF0AFB READ_WRITE /end MEASUREMENT
/begin MEASUREMENT vCYLDWLBF "RAM value vCYLDWLBF" UBYTE COMP_0522_S 1 100 0 255 ECU_ADDRESS 0xFFFF0AFC READ_WRITE /end MEASUREMENT
/begin MEASUREMENT vCYLERR "RAM value vCYLERR" UBYTE COMP_0068 1 100 0 255 ECU_ADDRESS 0xFFFF458A READ_WRITE /end MEASUREMENT
/begin MEASUREMENT vCYLFDW "RAM value vCYLFDW" UBYTE COMP_0522_S 1 100 0 255 ECU_ADDRESS 0xFFFF0AFD READ_WRITE /end MEASUREMENT
/begin MEASUREMENT vCYLGATE "RAM value vCYLGATE" UBYTE COMP_0522_S 1 100 0 255 ECU_ADDRESS 0xFFFF0AFE READ_WRITE /end MEASUREMENT
/begin MEASUREMENT vCYLNGCT "RAM value vCYLNGCT" UBYTE COMP_0068 1 100 0 255 ECU_ADDRESS 0xFFFF0AFF READ_WRITE /end MEASUREMENT
/begin MEASUREMENT vCYLRGD "RAM value vCYLRGD" UBYTE COMP_0016 1 100 0 255 ECU_ADDRESS 0xFFFF3A18 READ_WRITE /end MEASUREMENT
/begin MEASUREMENT vCYLSTAT1 "RAM value vCYLSTAT1" UWORD COMP_0068 1 100 0 65535 ECU_ADDRESS 0xFFFF458C READ_WRITE /end MEASUREMENT
/begin MEASUREMENT vCYLSTAT2 "RAM value vCYLSTAT2" UWORD COMP_0068 1 100 0 65535 ECU_ADDRESS 0xFFFF45AC READ_WRITE /end MEASUREMENT
/begin MEASUREMENT vCYLSTAT3 "RAM value vCYLSTAT3" UWORD COMP_0068 1 100 0 65535 ECU_ADDRESS 0xFFFF45CC READ_WRITE /end MEASUREMENT
/begin MEASUREMENT vCYLSTAT4 "RAM value vCYLSTAT4" UWORD COMP_0068 1 100 0 65535 ECU_ADDRESS 0xFFFF45EC READ_WRITE /end MEASUREMENT
/begin MEASUREMENT vCYLSTAT5 "RAM value vCYLSTAT5" UWORD COMP_0068 1 100 0 65535 ECU_ADDRESS 0xFFFF460C READ_WRITE /end MEASUREMENT
/begin MEASUREMENT vCYLSTAT6 "RAM value vCYLSTAT6" UWORD COMP_0068 1 100 0 65535 ECU_ADDRESS 0xFFFF462C READ_WRITE /end MEASUREMENT
/begin MEASUREMENT vDABF "RAM value vDABF" SWORD COMP_0072_S 1 100 -131.072 131.068 ECU_ADDRESS 0xFFFF0B00 READ_WRITE /end MEASUREMENT
/begin MEASUREMENT vDABFE "RAM value vDABFE" SWORD COMP_0020_S 1 100 -65.536 65.534 ECU_ADDRESS 0xFFFF24CE READ_WRITE /end MEASUREMENT
/begin MEASUREMENT vDABFHISf "RAM value vDABFHISf" UBYTE COMP_0004 1 100 0 255 ECU_ADDRESS 0xFFFF0B02 READ_WRITE /end MEASUREMENT
/begin MEASUREMENT vDADIN "RAM value vDADIN" UBYTE COMP_0054 1 100 0 5100 ECU_ADDRESS 0xFFFF3606 READ_WRITE /end MEASUREMENT
/begin MEASUREMENT vDADVSTS "RAM value vDADVSTS" UBYTE COMP_0004 1 100 0 255 ECU_ADDRESS 0xFFFF0B03 READ_WRITE /end MEASUREMENT
/begin MEASUREMENT vDAFMAX "RAM value vDAFMAX" SWORD COMP_0072_S 1 100 -131.072 131.068 ECU_ADDRESS 0xFFFF24D2 READ_WRITE /end MEASUREMENT
/begin MEASUREMENT vDALPLIM "RAM value vDALPLIM" UWORD COMP_0523_S 1 100 0 64.001481 ECU_ADDRESS 0xFFFF24D4 READ_WRITE /end MEASUREMENT
/begin MEASUREMENT vDAPOST "RAM value vDAPOST" UWORD COMP_0007_S 1 100 0 7208.85 ECU_ADDRESS 0xFFFF24D6 READ_WRITE /end MEASUREMENT
/begin MEASUREMENT vDAPS1V "RAM value vDAPS1V" UWORD COMP_0393 1 100 -163840 163835 ECU_ADDRESS 0xFFFF3608 READ_WRITE /end MEASUREMENT
/begin MEASUREMENT vDAPS2V "RAM value vDAPS2V" UWORD COMP_0393 1 100 -163840 163835 ECU_ADDRESS 0xFFFF360A READ_WRITE /end MEASUREMENT
/begin MEASUREMENT vDATCT "RAM value vDATCT" UWORD COMP_0524_S 1 100 -50 6503.5 ECU_ADDRESS 0xFFFF24D8 READ_WRITE /end MEASUREMENT
/begin MEASUREMENT vDATMLINE "RAM value vDATMLINE" UWORD COMP_0001_S 1 100 0 65535 ECU_ADDRESS 0xFFFF360C READ_WRITE /end MEASUREMENT
/begin MEASUREMENT vDATRETD "RAM value vDATRETD" UWORD COMP_0070_S 1 100 0 0.999985458 ECU_ADDRESS 0xFFFF0B04 READ_WRITE /end MEASUREMENT
/begin MEASUREMENT vDATRETU "RAM value vDATRETU" UWORD COMP_0070_S 1 100 0 0.999985458 ECU_ADDRESS 0xFFFF0B06 READ_WRITE /end MEASUREMENT
/begin MEASUREMENT vDCACRQ "RAM value vDCACRQ" ULONG COMP_0489_S 1 100 0 429496.7295 ECU_ADDRESS 0xFFFF24DC READ_WRITE /end MEASUREMENT
/begin MEASUREMENT vDCARQ "RAM value vDCARQ" ULONG COMP_0489_S 1 100 0 429496.7295 ECU_ADDRESS 0xFFFF24E0 READ_WRITE /end MEASUREMENT
/begin MEASUREMENT vDCCFEQ "RAM value vDCCFEQ" ULONG COMP_0511_S 1 100 0 429.4967295 ECU_ADDRESS 0xFFFF24E4 READ_WRITE /end MEASUREMENT
/begin MEASUREMENT vDCCTCFEQ "RAM value vDCCTCFEQ" UWORD COMP_0182_S 1 100 0 65.535 ECU_ADDRESS 0xFFFF24E8 READ_WRITE /end MEASUREMENT
/begin MEASUREMENT vDCCTCNT "RAM value vDCCTCNT" UBYTE COMP_0519_S 1 100 0 255 ECU_ADDRESS 0xFFFF24EA READ_WRITE /end MEASUREMENT
/begin MEASUREMENT vDCDCT "RAM value vDCDCT" SLONG COMP_0115_S 1 100 -214748.3648 214748.3647 ECU_ADDRESS 0xFFFF24EC READ_WRITE /end MEASUREMENT
/begin MEASUREMENT vDCESTCT "RAM value vDCESTCT" UBYTE COMP_0004_S 1 100 -50 205 ECU_ADDRESS 0xFFFF24F0 READ_WRITE /end MEASUREMENT
/begin MEASUREMENT vDCESTCTH "RAM value vDCESTCTH" SLONG COMP_0115_S 1 100 -214748.3648 214748.3647 ECU_ADDRESS 0xFFFF24F4 READ_WRITE /end MEASUREMENT
/begin MEASUREMENT vDCEVPS "RAM value vDCEVPS" UBYTE COMP_0047 1 100 0 127.5 ECU_ADDRESS 0xFFFF464C READ_WRITE /end MEASUREMENT
/begin MEASUREMENT vDCHBUDGE "RAM value vDCHBUDGE" SLONG COMP_0525_S 1 100 -214748.3648 214748.3647 ECU_ADDRESS 0xFFFF24F8 READ_WRITE /end MEASUREMENT
/begin MEASUREMENT vDCJOBCNT "RAM value vDCJOBCNT" UBYTE COMP_0014 1 100 0 2550 ECU_ADDRESS 0xFFFF24FC READ_WRITE /end MEASUREMENT
/begin MEASUREMENT vDCLALP "RAM value vDCLALP" UWORD COMP_0031 1 100 0 255.99609375 ECU_ADDRESS 0xFFFF24FE READ_WRITE /end MEASUREMENT
/begin MEASUREMENT vDCLESTCT "RAM value vDCLESTCT" UBYTE COMP_0004_S 1 100 -50 205 ECU_ADDRESS 0xFFFF2500 READ_WRITE /end MEASUREMENT
/begin MEASUREMENT vDCMTSCNT "RAM value vDCMTSCNT" UWORD COMP_0068 1 100 0 65535 ECU_ADDRESS 0xFFFF464E READ_WRITE /end MEASUREMENT
/begin MEASUREMENT vDCMTSTRP "RAM value vDCMTSTRP" UWORD COMP_0068 1 100 0 65535 ECU_ADDRESS 0xFFFF4650 READ_WRITE /end MEASUREMENT
/begin MEASUREMENT vDCOMTFST "RAM value vDCOMTFST" UWORD COMP_0259_S 1 100 -50 13057 ECU_ADDRESS 0xFFFF360E READ_WRITE /end MEASUREMENT
/begin MEASUREMENT vDCRKSTB "RAM value vDCRKSTB" UWORD COMP_0099 1 100 0 3.999941832 ECU_ADDRESS 0xFFFF0B08 READ_WRITE /end MEASUREMENT
/begin MEASUREMENT vDCT "RAM value vDCT" SLONG COMP_0115_S 1 100 -214748.3648 214748.3647 ECU_ADDRESS 0xFFFF2504 READ_WRITE /end MEASUREMENT
/begin MEASUREMENT vDCTAIS "RAM value vDCTAIS" SWORD COMP_0143_S 1 100 -32768 32767 ECU_ADDRESS 0xFFFF2508 READ_WRITE /end MEASUREMENT
/begin MEASUREMENT vDCTBIS "RAM value vDCTBIS" SWORD COMP_0143_S 1 100 -32768 32767 ECU_ADDRESS 0xFFFF250A READ_WRITE /end MEASUREMENT
/begin MEASUREMENT vDCTBUDGE "RAM value vDCTBUDGE" SLONG COMP_0115_S 1 100 -214748.3648 214748.3647 ECU_ADDRESS 0xFFFF250C READ_WRITE /end MEASUREMENT
/begin MEASUREMENT vDCTCNT1 "RAM value vDCTCNT1" UWORD COMP_0016 1 100 0 65535 ECU_ADDRESS 0xFFFF5120 READ_WRITE /end MEASUREMENT
/begin MEASUREMENT vDCTCNT2 "RAM value vDCTCNT2" UWORD COMP_0016 1 100 0 65535 ECU_ADDRESS 0xFFFF5122 READ_WRITE /end MEASUREMENT
/begin MEASUREMENT vDCTCNTEND "RAM value vDCTCNTEND" UBYTE COMP_0004 1 100 0 255 ECU_ADDRESS 0xFFFF2510 READ_WRITE /end MEASUREMENT
/begin MEASUREMENT vDCTCNTOKf "RAM value vDCTCNTOKf" UBYTE COMP_0004 1 100 0 255 ECU_ADDRESS 0xFFFF2511 READ_WRITE /end MEASUREMENT
/begin MEASUREMENT vDCTEQ "RAM value vDCTEQ" ULONG COMP_0489_S 1 100 0 429496.7295 ECU_ADDRESS 0xFFFF2514 READ_WRITE /end MEASUREMENT
/begin MEASUREMENT vDCTHMCT "RAM value vDCTHMCT" UBYTE COMP_0014 1 100 0 2550 ECU_ADDRESS 0xFFFF2518 READ_WRITE /end MEASUREMENT
/begin MEASUREMENT vDCTRQ "RAM value vDCTRQ" ULONG COMP_0489_S 1 100 0 429496.7295 ECU_ADDRESS 0xFFFF251C READ_WRITE /end MEASUREMENT
/begin MEASUREMENT vDCTTRP "RAM value vDCTTRP" UWORD COMP_0016 1 100 0 65535 ECU_ADDRESS 0xFFFF5124 READ_WRITE /end MEASUREMENT
/begin MEASUREMENT vDCV1MN "RAM value vDCV1MN" UBYTE COMP_0054 1 100 0 5100 ECU_ADDRESS 0xFFFF4652 READ_WRITE /end MEASUREMENT
/begin MEASUREMENT vDCV2MN "RAM value vDCV2MN" UBYTE COMP_0054 1 100 0 5100 ECU_ADDRESS 0xFFFF4653 READ_WRITE /end MEASUREMENT
/begin MEASUREMENT vDCV2MX "RAM value vDCV2MX" UBYTE COMP_0054 1 100 0 5100 ECU_ADDRESS 0xFFFF4654 READ_WRITE /end MEASUREMENT
/begin MEASUREMENT vDCV3MN "RAM value vDCV3MN" UBYTE COMP_0054 1 100 0 5100 ECU_ADDRESS 0xFFFF4655 READ_WRITE /end MEASUREMENT
/begin MEASUREMENT vDCV3MX "RAM value vDCV3MX" UBYTE COMP_0054 1 100 0 5100 ECU_ADDRESS 0xFFFF4656 READ_WRITE /end MEASUREMENT
/begin MEASUREMENT vDCWATEQ "RAM value vDCWATEQ" ULONG COMP_0489_S 1 100 0 429496.7295 ECU_ADDRESS 0xFFFF2520 READ_WRITE /end MEASUREMENT
/begin MEASUREMENT vDDCESTCT "RAM value vDDCESTCT" SWORD COMP_0255_S 1 100 -3276.8 3276.7 ECU_ADDRESS 0xFFFF2524 READ_WRITE /end MEASUREMENT
/begin MEASUREMENT vDDEVPS "RAM value vDDEVPS" SWORD COMP_0002_S 1 100 -32768 32767 ECU_ADDRESS 0xFFFF3610 READ_WRITE /end MEASUREMENT
/begin MEASUREMENT vDDLTIPSD "RAM value vDDLTIPSD" UWORD COMP_0394 1 100 0 838848 ECU_ADDRESS 0xFFFF0B0A READ_WRITE /end MEASUREMENT
/begin MEASUREMENT vDDLTISTD "RAM value vDDLTISTD" UWORD COMP_0394 1 100 0 838848 ECU_ADDRESS 0xFFFF0B0C READ_WRITE /end MEASUREMENT
/begin MEASUREMENT vDDMD2CZ "RAM value vDDMD2CZ" UBYTE COMP_0068 1 100 0 255 ECU_ADDRESS 0xFFFF30B5 READ_WRITE /end MEASUREMENT
/begin MEASUREMENT vDDSHPT "RAM value vDDSHPT" UBYTE COMP_0076_S 1 100 0 1.9921875 ECU_ADDRESS 0xFFFF2526 READ_WRITE /end MEASUREMENT
/begin MEASUREMENT vDEADTM "RAM value vDEADTM" UBYTE COMP_0526_S 1 100 0 255 ECU_ADDRESS 0xFFFF0B0E READ_WRITE /end MEASUREMENT
/begin MEASUREMENT vDECISC "RAM value vDECISC" UWORD COMP_0396 1 100 0 511.9921875 ECU_ADDRESS 0xFFFF0B10 READ_WRITE /end MEASUREMENT
/begin MEASUREMENT vDEFMODE "RAM value vDEFMODE" UBYTE COMP_0004 1 100 0 255 ECU_ADDRESS 0xFFFF2527 READ_WRITE /end MEASUREMENT
/begin MEASUREMENT vDELALP "RAM value vDELALP" SLONG COMP_0438 1 100 -8388608 8388607.99609375 ECU_ADDRESS 0xFFFF0B14 READ_WRITE /end MEASUREMENT
/begin MEASUREMENT vDELP "RAM value vDELP" UWORD COMP_0001_S 1 100 0 65535 ECU_ADDRESS 0xFFFF3612 READ_WRITE /end MEASUREMENT
/begin MEASUREMENT vDELTAN "RAM value vDELTAN" UBYTE COMP_0003 1 100 0 255 ECU_ADDRESS 0xFFFF3614 READ_WRITE /end MEASUREMENT
/begin MEASUREMENT vDELTF "RAM value vDELTF" UBYTE COMP_0035 1 100 -50 205 ECU_ADDRESS 0xFFFF43FC READ_WRITE /end MEASUREMENT
/begin MEASUREMENT vDELTMPTA "RAM value vDELTMPTA" SWORD COMP_0143_S 1 100 -32768 32767 ECU_ADDRESS 0xFFFF2528 READ_WRITE /end MEASUREMENT
/begin MEASUREMENT vDELTMPTF "RAM value vDELTMPTF" SWORD COMP_0143_S 1 100 -32768 32767 ECU_ADDRESS 0xFFFF252A READ_WRITE /end MEASUREMENT
/begin MEASUREMENT vDELTMPTH "RAM value vDELTMPTH" SWORD COMP_0143_S 1 100 -32768 32767 ECU_ADDRESS 0xFFFF252C READ_WRITE /end MEASUREMENT
/begin MEASUREMENT vDELTMPTO "RAM value vDELTMPTO" SWORD COMP_0143_S 1 100 -32768 32767 ECU_ADDRESS 0xFFFF252E READ_WRITE /end MEASUREMENT
/begin MEASUREMENT vDELTMPTW "RAM value vDELTMPTW" SWORD COMP_0143_S 1 100 -32768 32767 ECU_ADDRESS 0xFFFF2530 READ_WRITE /end MEASUREMENT
/begin MEASUREMENT vDELTPV "RAM value vDELTPV" UBYTE COMP_0023 1 100 0 1275 ECU_ADDRESS 0xFFFF3615 READ_WRITE /end MEASUREMENT
/begin MEASUREMENT vDELTWN "RAM value vDELTWN" UBYTE COMP_0003 1 100 0 255 ECU_ADDRESS 0xFFFF2532 READ_WRITE /end MEASUREMENT
/begin MEASUREMENT vDELTWST "RAM value vDELTWST" UBYTE COMP_0035 1 100 -50 205 ECU_ADDRESS 0xFFFF2533 READ_WRITE /end MEASUREMENT
/begin MEASUREMENT vDEMDFLW "RAM value vDEMDFLW" UWORD COMP_0156 1 100 0 65535 ECU_ADDRESS 0xFFFF2534 READ_WRITE /end MEASUREMENT
/begin MEASUREMENT vDENST "RAM value vDENST" UBYTE COMP_0006 1 100 0 3187.5 ECU_ADDRESS 0xFFFF0B1C READ_WRITE /end MEASUREMENT
/begin MEASUREMENT vDEPRSI2 "RAM value vDEPRSI2" UWORD COMP_0050 1 100 0 5119.921875 ECU_ADDRESS 0xFFFF2536 READ_WRITE /end MEASUREMENT
/begin MEASUREMENT vDERATSFT "RAM value vDERATSFT" UBYTE COMP_0079_S 1 100 -20 1000 ECU_ADDRESS 0xFFFF3616 READ_WRITE /end MEASUREMENT
/begin MEASUREMENT vDESTEST "RAM value vDESTEST" SWORD COMP_0255_S 1 100 -3276.8 3276.7 ECU_ADDRESS 0xFFFF2538 READ_WRITE /end MEASUREMENT
/begin MEASUREMENT vDETCODE "RAM value vDETCODE" UWORD COMP_0426 1 100 0 65535 ECU_ADDRESS 0xFFFF253A READ_WRITE /end MEASUREMENT
/begin MEASUREMENT vDETENST "RAM value vDETENST" UBYTE COMP_0051 1 100 0 255 ECU_ADDRESS 0xFFFF0B1D READ_WRITE /end MEASUREMENT
/begin MEASUREMENT vDETFK "RAM value vDETFK" UWORD COMP_0259_S 1 100 -50 13057 ECU_ADDRESS 0xFFFF3618 READ_WRITE /end MEASUREMENT
/begin MEASUREMENT vDEVATMP "RAM value vDEVATMP" UBYTE COMP_0156_S 1 100 0 84.999999915 ECU_ADDRESS 0xFFFF2027 READ_WRITE /end MEASUREMENT
/begin MEASUREMENT vDEVP "RAM value vDEVP" UWORD COMP_0039_S 1 100 60000 125535 ECU_ADDRESS 0xFFFF361A READ_WRITE /end MEASUREMENT
/begin MEASUREMENT vDEVPFC "RAM value vDEVPFC" SWORD COMP_0002_S 1 100 -32768 32767 ECU_ADDRESS 0xFFFF361C READ_WRITE /end MEASUREMENT
/begin MEASUREMENT vDEVPH "RAM value vDEVPH" SWORD COMP_0002_S 1 100 -32768 32767 ECU_ADDRESS 0xFFFF361E READ_WRITE /end MEASUREMENT
/begin MEASUREMENT vDEVPL "RAM value vDEVPL" SWORD COMP_0002_S 1 100 -32768 32767 ECU_ADDRESS 0xFFFF3620 READ_WRITE /end MEASUREMENT
/begin MEASUREMENT vDEVPS "RAM value vDEVPS" UBYTE COMP_0059 1 100 0 127.5 ECU_ADDRESS 0xFFFF253C READ_WRITE /end MEASUREMENT
/begin MEASUREMENT vDGNAFSZ "RAM value vDGNAFSZ" UWORD COMP_0453 1 100 0 131.07 ECU_ADDRESS 0xFFFF0B1E READ_WRITE /end MEASUREMENT
/begin MEASUREMENT vDGNEND "RAM value vDGNEND" UBYTE COMP_0068 1 100 0 255 ECU_ADDRESS 0xFFFF253D READ_WRITE /end MEASUREMENT
/begin MEASUREMENT vDGNGRDf "RAM value vDGNGRDf" UBYTE COMP_0004 1 100 0 255 ECU_ADDRESS 0xFFFF253E READ_WRITE /end MEASUREMENT
/begin MEASUREMENT vDGNIMDf "RAM value vDGNIMDf" UBYTE COMP_0004 1 100 0 255 ECU_ADDRESS 0xFFFF253F READ_WRITE /end MEASUREMENT
/begin MEASUREMENT vDGNSTST "RAM value vDGNSTST" UBYTE COMP_0081_S 1 100 0 99.609375 ECU_ADDRESS 0xFFFF0B20 READ_WRITE /end MEASUREMENT
/begin MEASUREMENT vDGOVADV "RAM value vDGOVADV" UBYTE COMP_0017 1 100 0 255 ECU_ADDRESS 0xFFFF0B21 READ_WRITE /end MEASUREMENT
/begin MEASUREMENT vDGOVEGR "RAM value vDGOVEGR" UBYTE COMP_0141 1 100 0 49.8046875 ECU_ADDRESS 0xFFFF0B22 READ_WRITE /end MEASUREMENT
/begin MEASUREMENT vDGRAMAD "RAM value vDGRAMAD" UWORD COMP_0068 1 100 0 65535 ECU_ADDRESS 0xFFFF2540 READ_WRITE /end MEASUREMENT
/begin MEASUREMENT vDGROMAD "RAM value vDGROMAD" ULONG COMP_0068 1 100 0 4294967295 ECU_ADDRESS 0xFFFF2544 READ_WRITE /end MEASUREMENT
/begin MEASUREMENT vDHCGPS "RAM value vDHCGPS" UBYTE COMP_0527_S 1 100 0 0.99603 ECU_ADDRESS 0xFFFF2548 READ_WRITE /end MEASUREMENT
/begin MEASUREMENT vDINPNE "RAM value vDINPNE" UWORD COMP_0082_S 1 100 0 65535 ECU_ADDRESS 0xFFFF0B24 READ_WRITE /end MEASUREMENT
/begin MEASUREMENT vDISABUF "RAM value vDISABUF" UWORD COMP_0027_S 1 100 0 327675000 ECU_ADDRESS 0xFFFF254A READ_WRITE /end MEASUREMENT
/begin MEASUREMENT vDISADC50 "RAM value vDISADC50" UWORD COMP_0036_S 1 100 0 65535 ECU_ADDRESS 0xFFFF4658 READ_WRITE /end MEASUREMENT
/begin MEASUREMENT vDISADCUR "RAM value vDISADCUR" UWORD COMP_0027_S 1 100 0 327675000 ECU_ADDRESS 0xFFFF465A READ_WRITE /end MEASUREMENT
/begin MEASUREMENT vDISADIAG "RAM value vDISADIAG" UBYTE COMP_0004 1 100 0 255 ECU_ADDRESS 0xFFFF3B4E READ_WRITE /end MEASUREMENT
/begin MEASUREMENT vDISCST2 "RAM value vDISCST2" UWORD COMP_0324 1 100 0 511.9921875 ECU_ADDRESS 0xFFFF0B26 READ_WRITE /end MEASUREMENT
/begin MEASUREMENT vDISTRQ "RAM value vDISTRQ" UBYTE COMP_0131_S 1 100 0 127.5 ECU_ADDRESS 0xFFFF254C READ_WRITE /end MEASUREMENT
/begin MEASUREMENT vDKASSIN "RAM value vDKASSIN" UWORD COMP_0099 1 100 0 3.999941832 ECU_ADDRESS 0xFFFF0B28 READ_WRITE /end MEASUREMENT
/begin MEASUREMENT vDKASSINS "RAM value vDKASSINS" UWORD COMP_0099 1 100 0 3.999941832 ECU_ADDRESS 0xFFFF0B2A READ_WRITE /end MEASUREMENT
/begin MEASUREMENT vDLAFMX "RAM value vDLAFMX" UWORD COMP_0023 1 100 0 327675 ECU_ADDRESS 0xFFFF254E READ_WRITE /end MEASUREMENT
/begin MEASUREMENT vDLAFS "RAM value vDLAFS" UWORD COMP_0023 1 100 0 327675 ECU_ADDRESS 0xFFFF2550 READ_WRITE /end MEASUREMENT
/begin MEASUREMENT vDLAFSB "RAM value vDLAFSB" UWORD COMP_0023 1 100 0 327675 ECU_ADDRESS 0xFFFF465C READ_WRITE /end MEASUREMENT
/begin MEASUREMENT vDLAPO "RAM value vDLAPO" UWORD COMP_0005 1 100 0 7208.85 ECU_ADDRESS 0xFFFF2552 READ_WRITE /end MEASUREMENT
/begin MEASUREMENT vDLAPOR "RAM value vDLAPOR" UWORD COMP_0032_S 1 100 0 8191.875 ECU_ADDRESS 0xFFFF2554 READ_WRITE /end MEASUREMENT
/begin MEASUREMENT vDLAPST "RAM value vDLAPST" UWORD COMP_0005 1 100 0 7208.85 ECU_ADDRESS 0xFFFF2556 READ_WRITE /end MEASUREMENT
/begin MEASUREMENT vDLAPSTR "RAM value vDLAPSTR" UWORD COMP_0032_S 1 100 0 8191.875 ECU_ADDRESS 0xFFFF2558 READ_WRITE /end MEASUREMENT
/begin MEASUREMENT vDLDRTQS "RAM value vDLDRTQS" UWORD COMP_0196 1 100 0 6553.5 ECU_ADDRESS 0xFFFF255A READ_WRITE /end MEASUREMENT
/begin MEASUREMENT vDLEPX1 "RAM value vDLEPX1" UBYTE COMP_0102 1 100 0 5100 ECU_ADDRESS 0xFFFF255C READ_WRITE /end MEASUREMENT
/begin MEASUREMENT vDLEPX2 "RAM value vDLEPX2" UBYTE COMP_0102 1 100 0 5100 ECU_ADDRESS 0xFFFF255D READ_WRITE /end MEASUREMENT
/begin MEASUREMENT vDLMDTBL "RAM value vDLMDTBL" UBYTE COMP_0027 1 100 0 255 ECU_ADDRESS 0xFFFF255E READ_WRITE /end MEASUREMENT
/begin MEASUREMENT vDLNEMSK "RAM value vDLNEMSK" UBYTE COMP_0014 1 100 0 2550 ECU_ADDRESS 0xFFFF15FC READ_WRITE /end MEASUREMENT
/begin MEASUREMENT vDLNLH21 "RAM value vDLNLH21" UWORD COMP_0325 1 100 -52428.8 52427.2 ECU_ADDRESS 0xFFFF2562 READ_WRITE /end MEASUREMENT
/begin MEASUREMENT vDLNLH22 "RAM value vDLNLH22" UWORD COMP_0325 1 100 -52428.8 52427.2 ECU_ADDRESS 0xFFFF2564 READ_WRITE /end MEASUREMENT
/begin MEASUREMENT vDLNLLH21 "RAM value vDLNLLH21" UWORD COMP_0325 1 100 -52428.8 52427.2 ECU_ADDRESS 0xFFFF2566 READ_WRITE /end MEASUREMENT
/begin MEASUREMENT vDLNLLH22 "RAM value vDLNLLH22" UWORD COMP_0325 1 100 -52428.8 52427.2 ECU_ADDRESS 0xFFFF2568 READ_WRITE /end MEASUREMENT
/begin MEASUREMENT vDLNR "RAM value vDLNR" SWORD COMP_0517 1 100 -52428.8 52427.2 ECU_ADDRESS 0xFFFF0B2C READ_WRITE /end MEASUREMENT
/begin MEASUREMENT vDLNR0 "RAM value vDLNR0" UWORD COMP_0325 1 100 -52428.8 52427.2 ECU_ADDRESS 0xFFFF0B2E READ_WRITE /end MEASUREMENT
/begin MEASUREMENT vDLNR2 "RAM value vDLNR2" SWORD COMP_0528_S 1 100 -52428.8 52427.2 ECU_ADDRESS 0xFFFF0B30 READ_WRITE /end MEASUREMENT
/begin MEASUREMENT vDLNRH "RAM value vDLNRH" UWORD COMP_0325 1 100 -52428.8 52427.2 ECU_ADDRESS 0xFFFF0B32 READ_WRITE /end MEASUREMENT
/begin MEASUREMENT vDLNRHH "RAM value vDLNRHH" UWORD COMP_0325 1 100 -52428.8 52427.2 ECU_ADDRESS 0xFFFF0B34 READ_WRITE /end MEASUREMENT
/begin MEASUREMENT vDLNRHH2 "RAM value vDLNRHH2" UWORD COMP_0414_S 1 100 -52428.8 52427.2 ECU_ADDRESS 0xFFFF0B36 READ_WRITE /end MEASUREMENT
/begin MEASUREMENT vDLNRL "RAM value vDLNRL" UWORD COMP_0325 1 100 -52428.8 52427.2 ECU_ADDRESS 0xFFFF0B38 READ_WRITE /end MEASUREMENT
/begin MEASUREMENT vDLNRL2 "RAM value vDLNRL2" UWORD COMP_0325 1 100 -52428.8 52427.2 ECU_ADDRESS 0xFFFF256A READ_WRITE /end MEASUREMENT
/begin MEASUREMENT vDLNRLH "RAM value vDLNRLH" UWORD COMP_0325 1 100 -52428.8 52427.2 ECU_ADDRESS 0xFFFF0B3A READ_WRITE /end MEASUREMENT
/begin MEASUREMENT vDLNRLH2 "RAM value vDLNRLH2" UWORD COMP_0414_S 1 100 -52428.8 52427.2 ECU_ADDRESS 0xFFFF0B3C READ_WRITE /end MEASUREMENT
/begin MEASUREMENT vDLNRLL "RAM value vDLNRLL" UWORD COMP_0325 1 100 -52428.8 52427.2 ECU_ADDRESS 0xFFFF0B3E READ_WRITE /end MEASUREMENT
/begin MEASUREMENT vDLNRLL2 "RAM value vDLNRLL2" UWORD COMP_0325 1 100 -52428.8 52427.2 ECU_ADDRESS 0xFFFF256C READ_WRITE /end MEASUREMENT
/begin MEASUREMENT vDLNRLLH "RAM value vDLNRLLH" UWORD COMP_0325 1 100 -52428.8 52427.2 ECU_ADDRESS 0xFFFF0B40 READ_WRITE /end MEASUREMENT
/begin MEASUREMENT vDLNRLLH2 "RAM value vDLNRLLH2" UWORD COMP_0414_S 1 100 -52428.8 52427.2 ECU_ADDRESS 0xFFFF0B42 READ_WRITE /end MEASUREMENT
/begin MEASUREMENT vDLNRS "RAM value vDLNRS" SWORD COMP_0517 1 100 -52428.8 52427.2 ECU_ADDRESS 0xFFFF0B44 READ_WRITE /end MEASUREMENT
/begin MEASUREMENT vDLQH0AP "RAM value vDLQH0AP" UWORD COMP_0146 1 100 0 99.998480265 ECU_ADDRESS 0xFFFF256E READ_WRITE /end MEASUREMENT
/begin MEASUREMENT vDLRENDf "RAM value vDLRENDf" UBYTE COMP_0004 1 100 0 255 ECU_ADDRESS 0xFFFF2570 READ_WRITE /end MEASUREMENT
/begin MEASUREMENT vDLSRVNG "RAM value vDLSRVNG" UWORD COMP_0014 1 100 0 655350 ECU_ADDRESS 0xFFFF2572 READ_WRITE /end MEASUREMENT
/begin MEASUREMENT vDLTADV "RAM value vDLTADV" SBYTE COMP_0018 1 100 -128 127 ECU_ADDRESS 0xFFFF1B24 READ_WRITE /end MEASUREMENT
/begin MEASUREMENT vDLTAPOFS "RAM value vDLTAPOFS" UWORD COMP_0529_S 1 100 0 7208.85 ECU_ADDRESS 0xFFFF08C8 READ_WRITE /end MEASUREMENT
/begin MEASUREMENT vDLTATE "RAM value vDLTATE" UWORD COMP_0042 1 100 0 52.428 ECU_ADDRESS 0xFFFF2574 READ_WRITE /end MEASUREMENT
/begin MEASUREMENT vDLTDLY "RAM value vDLTDLY" UBYTE COMP_0014 1 100 0 2550 ECU_ADDRESS 0xFFFF0B46 READ_WRITE /end MEASUREMENT
/begin MEASUREMENT vDLTEPTD "RAM value vDLTEPTD" UWORD COMP_0196 1 100 0 6553.5 ECU_ADDRESS 0xFFFF2576 READ_WRITE /end MEASUREMENT
/begin MEASUREMENT vDLTGTV "RAM value vDLTGTV" UWORD COMP_0130 1 100 0 1802.2125 ECU_ADDRESS 0xFFFF2578 READ_WRITE /end MEASUREMENT
/begin MEASUREMENT vDLTMN "RAM value vDLTMN" UBYTE COMP_0000 1 100 0 6375 ECU_ADDRESS 0xFFFF094D READ_WRITE /end MEASUREMENT
/begin MEASUREMENT vDLTMNRR "RAM value vDLTMNRR" UBYTE COMP_0000 1 100 0 6375 ECU_ADDRESS 0xFFFF257A READ_WRITE /end MEASUREMENT
/begin MEASUREMENT vDLTN1 "RAM value vDLTN1" UBYTE COMP_0070 1 100 0 3187.5 ECU_ADDRESS 0xFFFF2028 READ_WRITE /end MEASUREMENT
/begin MEASUREMENT vDLTNAV "RAM value vDLTNAV" SWORD COMP_0262 1 100 -409600 409587.5 ECU_ADDRESS 0xFFFF0B48 READ_WRITE /end MEASUREMENT
/begin MEASUREMENT vDLTNE "RAM value vDLTNE" UBYTE COMP_0006 1 100 0 3187.5 ECU_ADDRESS 0xFFFF08CA READ_WRITE /end MEASUREMENT
/begin MEASUREMENT vDLTNE0 "RAM value vDLTNE0" UWORD COMP_0530_S 1 100 0 3199.951171875 ECU_ADDRESS 0xFFFF15A4 READ_WRITE /end MEASUREMENT
/begin MEASUREMENT vDLTOUTR "RAM value vDLTOUTR" UWORD COMP_0082_S 1 100 0 65535 ECU_ADDRESS 0xFFFF08CC READ_WRITE /end MEASUREMENT
/begin MEASUREMENT vDLTPB "RAM value vDLTPB" UWORD COMP_0396_S 1 100 0 16383.75 ECU_ADDRESS 0xFFFF257C READ_WRITE /end MEASUREMENT
/begin MEASUREMENT vDLTPI2 "RAM value vDLTPI2" UWORD COMP_0050 1 100 0 5119.921875 ECU_ADDRESS 0xFFFF257E READ_WRITE /end MEASUREMENT
/begin MEASUREMENT vDLTPMN "RAM value vDLTPMN" SWORD COMP_0531_S 1 100 -128 127.99609375 ECU_ADDRESS 0xFFFF3622 READ_WRITE /end MEASUREMENT
/begin MEASUREMENT vDLTPS1V "RAM value vDLTPS1V" UWORD COMP_0023 1 100 0 327675 ECU_ADDRESS 0xFFFF3624 READ_WRITE /end MEASUREMENT
/begin MEASUREMENT vDLTQH0 "RAM value vDLTQH0" UBYTE COMP_0032 1 100 0 0.99609375 ECU_ADDRESS 0xFFFF15FD READ_WRITE /end MEASUREMENT
/begin MEASUREMENT vDLTTEP "RAM value vDLTTEP" UWORD COMP_0196 1 100 0 6553.5 ECU_ADDRESS 0xFFFF2580 READ_WRITE /end MEASUREMENT
/begin MEASUREMENT vDLTTP "RAM value vDLTTP" UBYTE COMP_0124 1 100 0 31.875 ECU_ADDRESS 0xFFFF2029 READ_WRITE /end MEASUREMENT
/begin MEASUREMENT vDLTTPO10 "RAM value vDLTTPO10" SLONG COMP_0377 1 100 -236223201.28 236223201.17 ECU_ADDRESS 0xFFFF3628 READ_WRITE /end MEASUREMENT
/begin MEASUREMENT vDLTTPO5 "RAM value vDLTTPO5" SLONG COMP_0377 1 100 -236223201.28 236223201.17 ECU_ADDRESS 0xFFFF362C READ_WRITE /end MEASUREMENT
/begin MEASUREMENT vDLTTPR "RAM value vDLTTPR" UBYTE COMP_0001 1 100 0 31.875 ECU_ADDRESS 0xFFFF2582 READ_WRITE /end MEASUREMENT
/begin MEASUREMENT vDLTTVOR "RAM value vDLTTVOR" UBYTE COMP_0002 1 100 0 89.25 ECU_ADDRESS 0xFFFF2583 READ_WRITE /end MEASUREMENT
/begin MEASUREMENT vDLTV100 "RAM value vDLTV100" UBYTE COMP_0532_S 1 100 0 89.25 ECU_ADDRESS 0xFFFF202A READ_WRITE /end MEASUREMENT
/begin MEASUREMENT vDLTVB "RAM value vDLTVB" UBYTE COMP_0104_S 1 100 0 51 ECU_ADDRESS 0xFFFF2584 READ_WRITE /end MEASUREMENT
/begin MEASUREMENT vDLTVRO2f "RAM value vDLTVRO2f" UBYTE COMP_0004 1 100 0 255 ECU_ADDRESS 0xFFFF2585 READ_WRITE /end MEASUREMENT
/begin MEASUREMENT vDLTVS2 "RAM value vDLTVS2" UBYTE COMP_0229 1 100 -256 254 ECU_ADDRESS 0xFFFF202B READ_WRITE /end MEASUREMENT
/begin MEASUREMENT vDLTVSP "RAM value vDLTVSP" UBYTE COMP_0007 1 100 0 510 ECU_ADDRESS 0xFFFF202C READ_WRITE /end MEASUREMENT
/begin MEASUREMENT vDLUNE "RAM value vDLUNE" UWORD COMP_0000 1 100 0 1638375 ECU_ADDRESS 0xFFFF0B4A READ_WRITE /end MEASUREMENT
/begin MEASUREMENT vDLURPM "RAM value vDLURPM" UBYTE COMP_0000 1 100 0 6375 ECU_ADDRESS 0xFFFF0B4C READ_WRITE /end MEASUREMENT
/begin MEASUREMENT vDLVSP2B "RAM value vDLVSP2B" UBYTE COMP_0007 1 100 0 510 ECU_ADDRESS 0xFFFF2586 READ_WRITE /end MEASUREMENT
/begin MEASUREMENT vDLVSP2S "RAM value vDLVSP2S" UBYTE COMP_0007 1 100 0 510 ECU_ADDRESS 0xFFFF0B4D READ_WRITE /end MEASUREMENT
/begin MEASUREMENT vDLYCNT1 "RAM value vDLYCNT1" UBYTE COMP_0016 1 100 0 255 ECU_ADDRESS 0xFFFF465E READ_WRITE /end MEASUREMENT
/begin MEASUREMENT vDLYCNT2 "RAM value vDLYCNT2" UBYTE COMP_0016 1 100 0 255 ECU_ADDRESS 0xFFFF465F READ_WRITE /end MEASUREMENT
/begin MEASUREMENT vDLYCNT3 "RAM value vDLYCNT3" UBYTE COMP_0016 1 100 0 255 ECU_ADDRESS 0xFFFF4660 READ_WRITE /end MEASUREMENT
/begin MEASUREMENT vDLYCNT4 "RAM value vDLYCNT4" UBYTE COMP_0016 1 100 0 255 ECU_ADDRESS 0xFFFF4661 READ_WRITE /end MEASUREMENT
/begin MEASUREMENT vDLYCNT5 "RAM value vDLYCNT5" UBYTE COMP_0016 1 100 0 255 ECU_ADDRESS 0xFFFF4662 READ_WRITE /end MEASUREMENT
/begin MEASUREMENT vDLYCNT6 "RAM value vDLYCNT6" UBYTE COMP_0016 1 100 0 255 ECU_ADDRESS 0xFFFF4663 READ_WRITE /end MEASUREMENT
/begin MEASUREMENT vDLYCOND "RAM value vDLYCOND" UBYTE COMP_0004 1 100 0 255 ECU_ADDRESS 0xFFFF0B4E READ_WRITE /end MEASUREMENT
/begin MEASUREMENT vDLYRANGE "RAM value vDLYRANGE" UBYTE COMP_0004 1 100 0 255 ECU_ADDRESS 0xFFFF0B4F READ_WRITE /end MEASUREMENT
/begin MEASUREMENT vDLYTMP "RAM value vDLYTMP" UBYTE COMP_0008 1 100 0 25500 ECU_ADDRESS 0xFFFF0B50 READ_WRITE /end MEASUREMENT
/begin MEASUREMENT vDLYTVOL "RAM value vDLYTVOL" UWORD COMP_0005 1 100 0 7208.85 ECU_ADDRESS 0xFFFF2588 READ_WRITE /end MEASUREMENT
/begin MEASUREMENT vDLYTVOU "RAM value vDLYTVOU" UWORD COMP_0005 1 100 0 7208.85 ECU_ADDRESS 0xFFFF258A READ_WRITE /end MEASUREMENT
/begin MEASUREMENT vDML "RAM value vDML" UWORD COMP_0271 1 100 0 199.99696053 ECU_ADDRESS 0xFFFF0B52 READ_WRITE /end MEASUREMENT
/begin MEASUREMENT vDMPTP "RAM value vDMPTP" UBYTE COMP_0032 1 100 0 0.99609375 ECU_ADDRESS 0xFFFF3630 READ_WRITE /end MEASUREMENT
/begin MEASUREMENT vDNACSTS "RAM value vDNACSTS" UBYTE COMP_0068 1 100 0 255 ECU_ADDRESS 0xFFFF0B54 READ_WRITE /end MEASUREMENT
/begin MEASUREMENT vDNADV "RAM value vDNADV" SBYTE COMP_0018 1 100 -128 127 ECU_ADDRESS 0xFFFF0B55 READ_WRITE /end MEASUREMENT
/begin MEASUREMENT vDNE019 "RAM value vDNE019" SBYTE COMP_0533_S 1 100 -25 24.8046875 ECU_ADDRESS 0xFFFF20E4 READ_WRITE /end MEASUREMENT
/begin MEASUREMENT vDNE019FL "RAM value vDNE019FL" SBYTE COMP_0533_S 1 100 -25 24.8046875 ECU_ADDRESS 0xFFFF20E1 READ_WRITE /end MEASUREMENT
/begin MEASUREMENT vDNEREF "RAM value vDNEREF" SWORD COMP_0534_S 1 100 -102400 102396.875 ECU_ADDRESS 0xFFFF094E READ_WRITE /end MEASUREMENT
/begin MEASUREMENT vDNEREFFL "RAM value vDNEREFFL" SWORD COMP_0534_S 1 100 -102400 102396.875 ECU_ADDRESS 0xFFFF0950 READ_WRITE /end MEASUREMENT
/begin MEASUREMENT vDNRFPOS "RAM value vDNRFPOS" SBYTE COMP_0263 1 100 -128 127 ECU_ADDRESS 0xFFFF0B56 READ_WRITE /end MEASUREMENT
/begin MEASUREMENT vDNSCKTM "RAM value vDNSCKTM" UWORD COMP_0040_S 1 100 0 655.35 ECU_ADDRESS 0xFFFF258C READ_WRITE /end MEASUREMENT
/begin MEASUREMENT vDNSETEMN "RAM value vDNSETEMN" UBYTE COMP_0014 1 100 0 2550 ECU_ADDRESS 0xFFFF258E READ_WRITE /end MEASUREMENT
/begin MEASUREMENT vDOFST "RAM value vDOFST" SWORD COMP_0353 1 100 -163840 163835 ECU_ADDRESS 0xFFFF15FE READ_WRITE /end MEASUREMENT
/begin MEASUREMENT vDOMON "RAM value vDOMON" UBYTE COMP_0004 1 100 0 255 ECU_ADDRESS 0xFFFF258F READ_WRITE /end MEASUREMENT
/begin MEASUREMENT vDPAMB "RAM value vDPAMB" UWORD COMP_0050 1 100 0 5119.921875 ECU_ADDRESS 0xFFFF202E READ_WRITE /end MEASUREMENT
/begin MEASUREMENT vDPIKGZ1 "RAM value vDPIKGZ1" SBYTE COMP_0238 1 100 -100 99.21875 ECU_ADDRESS 0xFFFF097B READ_WRITE /end MEASUREMENT
/begin MEASUREMENT vDPRES "RAM value vDPRES" UWORD COMP_0535_S 1 100 -2560 2559.921875 ECU_ADDRESS 0xFFFF2598 READ_WRITE /end MEASUREMENT
/begin MEASUREMENT vDPRSP2 "RAM value vDPRSP2" UBYTE COMP_0016 1 100 0 255 ECU_ADDRESS 0xFFFF4E67 READ_WRITE /end MEASUREMENT
/begin MEASUREMENT vDPVP "RAM value vDPVP" SWORD COMP_0002_S 1 100 -32768 32767 ECU_ADDRESS 0xFFFF3632 READ_WRITE /end MEASUREMENT
/begin MEASUREMENT vDPVT "RAM value vDPVT" SWORD COMP_0003_S 1 100 -6553.6 6553.4 ECU_ADDRESS 0xFFFF3634 READ_WRITE /end MEASUREMENT
/begin MEASUREMENT vDQCO "RAM value vDQCO" SWORD COMP_0264 1 100 -32768 32767 ECU_ADDRESS 0xFFFF3302 READ_WRITE /end MEASUREMENT
/begin MEASUREMENT vDQFBIOP "RAM value vDQFBIOP" UBYTE COMP_0051 1 100 0 255 ECU_ADDRESS 0xFFFF0B57 READ_WRITE /end MEASUREMENT
/begin MEASUREMENT vDQH010MS "RAM value vDQH010MS" SWORD COMP_0203 1 100 -128 127.99609375 ECU_ADDRESS 0xFFFF1600 READ_WRITE /end MEASUREMENT
/begin MEASUREMENT vDQMXL "RAM value vDQMXL" UWORD COMP_0068 1 100 0 65535 ECU_ADDRESS 0xFFFF259A READ_WRITE /end MEASUREMENT
/begin MEASUREMENT vDQMXR "RAM value vDQMXR" UWORD COMP_0068 1 100 0 65535 ECU_ADDRESS 0xFFFF259E READ_WRITE /end MEASUREMENT
/begin MEASUREMENT vDQNE "RAM value vDQNE" SWORD COMP_0536_S 1 100 -2048 2047.9375 ECU_ADDRESS 0xFFFF0B58 READ_WRITE /end MEASUREMENT
/begin MEASUREMENT vDREALEST "RAM value vDREALEST" SWORD COMP_0255_S 1 100 -3276.8 3276.7 ECU_ADDRESS 0xFFFF25A2 READ_WRITE /end MEASUREMENT
/begin MEASUREMENT vDRID22HZ "RAM value vDRID22HZ" UBYTE COMP_0068 1 100 0 255 ECU_ADDRESS 0xFFFF30B6 READ_WRITE /end MEASUREMENT
/begin MEASUREMENT vDRID22LZ "RAM value vDRID22LZ" UBYTE COMP_0068 1 100 0 255 ECU_ADDRESS 0xFFFF30B7 READ_WRITE /end MEASUREMENT
/begin MEASUREMENT vDRID2CHZ "RAM value vDRID2CHZ" UBYTE COMP_0068 1 100 0 255 ECU_ADDRESS 0xFFFF30B8 READ_WRITE /end MEASUREMENT
/begin MEASUREMENT vDRID2CLZ "RAM value vDRID2CLZ" UBYTE COMP_0068 1 100 0 255 ECU_ADDRESS 0xFFFF30B9 READ_WRITE /end MEASUREMENT
/begin MEASUREMENT vDRIVETD "RAM value vDRIVETD" UBYTE COMP_0068 1 100 0 255 ECU_ADDRESS 0xFFFF1602 READ_WRITE /end MEASUREMENT
/begin MEASUREMENT vDRIVMCAN "RAM value vDRIVMCAN" UBYTE COMP_0068 1 100 0 255 ECU_ADDRESS 0xFFFF2030 READ_WRITE /end MEASUREMENT
/begin MEASUREMENT vDRIVMODE "RAM value vDRIVMODE" UBYTE COMP_0068 1 100 0 255 ECU_ADDRESS 0xFFFF2103 READ_WRITE /end MEASUREMENT
/begin MEASUREMENT vDRIVMSW "RAM value vDRIVMSW" UBYTE COMP_0068 1 100 0 255 ECU_ADDRESS 0xFFFF3B4F READ_WRITE /end MEASUREMENT
/begin MEASUREMENT vDRLENDf "RAM value vDRLENDf" UBYTE COMP_0004 1 100 0 255 ECU_ADDRESS 0xFFFF25A4 READ_WRITE /end MEASUREMENT
/begin MEASUREMENT vDRMDMON "RAM value vDRMDMON" UBYTE COMP_0283 1 100 0 255 ECU_ADDRESS 0xFFFF3636 READ_WRITE /end MEASUREMENT
/begin MEASUREMENT vDRMODCLK "RAM value vDRMODCLK" UBYTE COMP_0068 1 100 0 255 ECU_ADDRESS 0xFFFF3637 READ_WRITE /end MEASUREMENT
/begin MEASUREMENT vDRMODCLZ "RAM value vDRMODCLZ" UBYTE COMP_0068 1 100 0 255 ECU_ADDRESS 0xFFFF3638 READ_WRITE /end MEASUREMENT
/begin MEASUREMENT vDRON "RAM value vDRON" ULONG COMP_0537_S 1 100 -1048575.46312909 1048575.46264081 ECU_ADDRESS 0xFFFF0B5C READ_WRITE /end MEASUREMENT
/begin MEASUREMENT vDRONHOSH "RAM value vDRONHOSH" SWORD COMP_0078 1 100 -128 127.99609375 ECU_ADDRESS 0xFFFF25A6 READ_WRITE /end MEASUREMENT
/begin MEASUREMENT vDROPR_FA "RAM value vDROPR_FA" SWORD COMP_0538_S 1 100 -327.68 327.67 ECU_ADDRESS 0xFFFF25A8 READ_WRITE /end MEASUREMENT
/begin MEASUREMENT vDROPR_FO "RAM value vDROPR_FO" SWORD COMP_0538_S 1 100 -327.68 327.67 ECU_ADDRESS 0xFFFF25AA READ_WRITE /end MEASUREMENT
/begin MEASUREMENT vDROPR_FW "RAM value vDROPR_FW" SWORD COMP_0538_S 1 100 -327.68 327.67 ECU_ADDRESS 0xFFFF25AC READ_WRITE /end MEASUREMENT
/begin MEASUREMENT vDRPMXL "RAM value vDRPMXL" UBYTE COMP_0006 1 100 0 3187.5 ECU_ADDRESS 0xFFFF25AE READ_WRITE /end MEASUREMENT
/begin MEASUREMENT vDRPMXR "RAM value vDRPMXR" UBYTE COMP_0006 1 100 0 3187.5 ECU_ADDRESS 0xFFFF25B0 READ_WRITE /end MEASUREMENT
/begin MEASUREMENT vDRPTSP_S "RAM value vDRPTSP_S" UWORD COMP_0032_S 1 100 0 8191.875 ECU_ADDRESS 0xFFFF3040 READ_WRITE /end MEASUREMENT
/begin MEASUREMENT vDRPWTSP "RAM value vDRPWTSP" UWORD COMP_0032_S 1 100 0 8191.875 ECU_ADDRESS 0xFFFF3B50 READ_WRITE /end MEASUREMENT
/begin MEASUREMENT vDRPWTSP2 "RAM value vDRPWTSP2" UWORD COMP_0032_S 1 100 0 8191.875 ECU_ADDRESS 0xFFFF363A READ_WRITE /end MEASUREMENT
/begin MEASUREMENT vDRPWTSPC "RAM value vDRPWTSPC" UWORD COMP_0032_S 1 100 0 8191.875 ECU_ADDRESS 0xFFFF363C READ_WRITE /end MEASUREMENT
/begin MEASUREMENT vDRTKSTB "RAM value vDRTKSTB" UWORD COMP_0217 1 100 0 3.999941832 ECU_ADDRESS 0xFFFF0B60 READ_WRITE /end MEASUREMENT
/begin MEASUREMENT vDRTQS0_S "RAM value vDRTQS0_S" SWORD COMP_0228 1 100 -3276.8 3276.7 ECU_ADDRESS 0xFFFF3042 READ_WRITE /end MEASUREMENT
/begin MEASUREMENT vDRTQSP "RAM value vDRTQSP" SWORD COMP_0228 1 100 -3276.8 3276.7 ECU_ADDRESS 0xFFFF25B2 READ_WRITE /end MEASUREMENT
/begin MEASUREMENT vDRTQSP0 "RAM value vDRTQSP0" SWORD COMP_0228 1 100 -3276.8 3276.7 ECU_ADDRESS 0xFFFF25B4 READ_WRITE /end MEASUREMENT
/begin MEASUREMENT vDRTQSP_S "RAM value vDRTQSP_S" SWORD COMP_0228 1 100 -3276.8 3276.7 ECU_ADDRESS 0xFFFF3044 READ_WRITE /end MEASUREMENT
/begin MEASUREMENT vDRV "RAM value vDRV" UBYTE COMP_0118 1 100 0 10200 ECU_ADDRESS 0xFFFF1603 READ_WRITE /end MEASUREMENT
/begin MEASUREMENT vDRV0MN "RAM value vDRV0MN" UBYTE COMP_0118 1 100 0 10200 ECU_ADDRESS 0xFFFF4664 READ_WRITE /end MEASUREMENT
/begin MEASUREMENT vDRV1MN "RAM value vDRV1MN" UBYTE COMP_0118 1 100 0 10200 ECU_ADDRESS 0xFFFF4665 READ_WRITE /end MEASUREMENT
/begin MEASUREMENT vDRV2MN "RAM value vDRV2MN" UBYTE COMP_0118 1 100 0 10200 ECU_ADDRESS 0xFFFF4666 READ_WRITE /end MEASUREMENT
/begin MEASUREMENT vDRVJUGf "RAM value vDRVJUGf" UBYTE COMP_0004 1 100 0 255 ECU_ADDRESS 0xFFFF25B6 READ_WRITE /end MEASUREMENT
/begin MEASUREMENT vDRVMDFAC "RAM value vDRVMDFAC" UBYTE COMP_0425 1 100 0 99.99999981 ECU_ADDRESS 0xFFFF25B7 READ_WRITE /end MEASUREMENT
/begin MEASUREMENT vDRVMRAMP "RAM value vDRVMRAMP" UWORD COMP_0329 1 100 0 511.9921875 ECU_ADDRESS 0xFFFF25B8 READ_WRITE /end MEASUREMENT
/begin MEASUREMENT vDRVSWCAN "RAM value vDRVSWCAN" UBYTE COMP_0068 1 100 0 255 ECU_ADDRESS 0xFFFF363E READ_WRITE /end MEASUREMENT
/begin MEASUREMENT vDRVSWCNZ "RAM value vDRVSWCNZ" UBYTE COMP_0068 1 100 0 255 ECU_ADDRESS 0xFFFF363F READ_WRITE /end MEASUREMENT
/begin MEASUREMENT vDRVTQLM "RAM value vDRVTQLM" SWORD COMP_0228 1 100 -3276.8 3276.7 ECU_ADDRESS 0xFFFF25BA READ_WRITE /end MEASUREMENT
/begin MEASUREMENT vDSADV "RAM value vDSADV" UBYTE COMP_0017 1 100 0 255 ECU_ADDRESS 0xFFFF1B25 READ_WRITE /end MEASUREMENT
/begin MEASUREMENT vDSP "RAM value vDSP" UWORD COMP_0436 1 100 0 6553.5 ECU_ADDRESS 0xFFFF2032 READ_WRITE /end MEASUREMENT
/begin MEASUREMENT vDSPDISP "RAM value vDSPDISP" UWORD COMP_0238_S 1 100 0 655.35 ECU_ADDRESS 0xFFFF2034 READ_WRITE /end MEASUREMENT
/begin MEASUREMENT vDSPDISP0 "RAM value vDSPDISP0" UWORD COMP_0238_S 1 100 0 655.35 ECU_ADDRESS 0xFFFF2036 READ_WRITE /end MEASUREMENT
/begin MEASUREMENT vDSPDISPF "RAM value vDSPDISPF" ULONG COMP_0539_S 1 100 0 167772.159960938 ECU_ADDRESS 0xFFFF3640 READ_WRITE /end MEASUREMENT
/begin MEASUREMENT vDSPDISPK "RAM value vDSPDISPK" UWORD COMP_0238_S 1 100 0 655.35 ECU_ADDRESS 0xFFFF2104 READ_WRITE /end MEASUREMENT
/begin MEASUREMENT vDSPDISPR "RAM value vDSPDISPR" UWORD COMP_0373 1 100 0 655.35 ECU_ADDRESS 0xFFFF3644 READ_WRITE /end MEASUREMENT
/begin MEASUREMENT vDSPDISPZ "RAM value vDSPDISPZ" UWORD COMP_0238_S 1 100 0 655.35 ECU_ADDRESS 0xFFFF25BC READ_WRITE /end MEASUREMENT
/begin MEASUREMENT vDSPDUNIT "RAM value vDSPDUNIT" UWORD COMP_0238_S 1 100 0 655.35 ECU_ADDRESS 0xFFFF25D0 READ_WRITE /end MEASUREMENT
/begin MEASUREMENT vDSRVIDZ "RAM value vDSRVIDZ" UBYTE COMP_0068 1 100 0 255 ECU_ADDRESS 0xFFFF30BA READ_WRITE /end MEASUREMENT
/begin MEASUREMENT vDTCAT "RAM value vDTCAT" UBYTE COMP_0399 1 100 -512 508 ECU_ADDRESS 0xFFFF25D2 READ_WRITE /end MEASUREMENT
/begin MEASUREMENT vDTDEC2IN "RAM value vDTDEC2IN" UBYTE COMP_0004 1 100 0 255 ECU_ADDRESS 0xFFFF0B62 READ_WRITE /end MEASUREMENT
/begin MEASUREMENT vDTE1_2 "RAM value vDTE1_2" UWORD COMP_0402 1 100 0 0.999998565 ECU_ADDRESS 0xFFFF0B64 READ_WRITE /end MEASUREMENT
/begin MEASUREMENT vDTEALP "RAM value vDTEALP" UWORD COMP_0028 1 100 0 2.5599609375 ECU_ADDRESS 0xFFFF25D4 READ_WRITE /end MEASUREMENT
/begin MEASUREMENT vDTEPRS "RAM value vDTEPRS" SWORD COMP_0002_S 1 100 -32768 32767 ECU_ADDRESS 0xFFFF3646 READ_WRITE /end MEASUREMENT
/begin MEASUREMENT vDTFK "RAM value vDTFK" SWORD COMP_0003_S 1 100 -6553.6 6553.4 ECU_ADDRESS 0xFFFF3648 READ_WRITE /end MEASUREMENT
/begin MEASUREMENT vDTFP2 "RAM value vDTFP2" UBYTE COMP_0016 1 100 0 255 ECU_ADDRESS 0xFFFF4E6B READ_WRITE /end MEASUREMENT
/begin MEASUREMENT vDTIME "RAM value vDTIME" UWORD COMP_0008 1 100 0 6553500 ECU_ADDRESS 0xFFFF25D6 READ_WRITE /end MEASUREMENT
/begin MEASUREMENT vDTLTW "RAM value vDTLTW" UBYTE COMP_0003 1 100 0 255 ECU_ADDRESS 0xFFFF25D8 READ_WRITE /end MEASUREMENT
/begin MEASUREMENT vDTOMAX "RAM value vDTOMAX" UBYTE COMP_0540_S 1 100 -128 127 ECU_ADDRESS 0xFFFF4667 READ_WRITE /end MEASUREMENT
/begin MEASUREMENT vDTOTE3 "RAM value vDTOTE3" UBYTE COMP_0003 1 100 0 255 ECU_ADDRESS 0xFFFF25D9 READ_WRITE /end MEASUREMENT
/begin MEASUREMENT vDTOTES "RAM value vDTOTES" UBYTE COMP_0003 1 100 0 255 ECU_ADDRESS 0xFFFF25DA READ_WRITE /end MEASUREMENT
/begin MEASUREMENT vDTPFBA "RAM value vDTPFBA" SWORD COMP_0523 1 100 -32.000016384 31.999039821 ECU_ADDRESS 0xFFFF0B66 READ_WRITE /end MEASUREMENT
/begin MEASUREMENT vDTTFUP "RAM value vDTTFUP" SWORD COMP_0003_S 1 100 -6553.6 6553.4 ECU_ADDRESS 0xFFFF364A READ_WRITE /end MEASUREMENT
/begin MEASUREMENT vDTVO "RAM value vDTVO" UBYTE COMP_0026_S 1 100 0 89.25 ECU_ADDRESS 0xFFFF1604 READ_WRITE /end MEASUREMENT
/begin MEASUREMENT vDTVO15 "RAM value vDTVO15" UBYTE COMP_0026_S 1 100 0 89.25 ECU_ADDRESS 0xFFFF1605 READ_WRITE /end MEASUREMENT
/begin MEASUREMENT vDTVO3 "RAM value vDTVO3" UBYTE COMP_0280 1 100 0 89.25 ECU_ADDRESS 0xFFFF1606 READ_WRITE /end MEASUREMENT
/begin MEASUREMENT vDTVO30 "RAM value vDTVO30" UBYTE COMP_0127 1 100 -44.8 44.45 ECU_ADDRESS 0xFFFF2038 READ_WRITE /end MEASUREMENT
/begin MEASUREMENT vDTVOM "RAM value vDTVOM" UBYTE COMP_0026_S 1 100 0 89.25 ECU_ADDRESS 0xFFFF1607 READ_WRITE /end MEASUREMENT
/begin MEASUREMENT vDTVOP "RAM value vDTVOP" UBYTE COMP_0026_S 1 100 0 89.25 ECU_ADDRESS 0xFFFF08CE READ_WRITE /end MEASUREMENT
/begin MEASUREMENT vDTVSL1 "RAM value vDTVSL1" UBYTE COMP_0016 1 100 0 255 ECU_ADDRESS 0xFFFF3A19 READ_WRITE /end MEASUREMENT
/begin MEASUREMENT vDTVSL2 "RAM value vDTVSL2" UBYTE COMP_0016 1 100 0 255 ECU_ADDRESS 0xFFFF3A1A READ_WRITE /end MEASUREMENT
/begin MEASUREMENT vDTWF "RAM value vDTWF" UBYTE COMP_0044 1 100 0 1.9921875 ECU_ADDRESS 0xFFFF08CF READ_WRITE /end MEASUREMENT
/begin MEASUREMENT vDUHDMY "RAM value vDUHDMY" UWORD COMP_0068 1 100 0 65535 ECU_ADDRESS 0xFFFF1608 READ_WRITE /end MEASUREMENT
/begin MEASUREMENT vDUHIGN39 "RAM value vDUHIGN39" UWORD COMP_0068 1 100 0 65535 ECU_ADDRESS 0xFFFF160A READ_WRITE /end MEASUREMENT
/begin MEASUREMENT vDUHINJ39 "RAM value vDUHINJ39" UWORD COMP_0068 1 100 0 65535 ECU_ADDRESS 0xFFFF160C READ_WRITE /end MEASUREMENT
/begin MEASUREMENT vDUHSOL39 "RAM value vDUHSOL39" UWORD COMP_0068 1 100 0 65535 ECU_ADDRESS 0xFFFF160E READ_WRITE /end MEASUREMENT
/begin MEASUREMENT vDUMADDFD "RAM value vDUMADDFD" UWORD COMP_0064_S 1 100 0 65535 ECU_ADDRESS 0xFFFF1B26 READ_WRITE /end MEASUREMENT
/begin MEASUREMENT vDUMMYSET "RAM value vDUMMYSET" UWORD COMP_0068 1 100 0 65535 ECU_ADDRESS 0xFFFF364C READ_WRITE /end MEASUREMENT
/begin MEASUREMENT vDUMP2 "RAM value vDUMP2" UWORD COMP_0456 1 100 0 1.999970916 ECU_ADDRESS 0xFFFF1610 READ_WRITE /end MEASUREMENT
/begin MEASUREMENT vDUREG28 "RAM value vDUREG28" UWORD COMP_0068 1 100 0 65535 ECU_ADDRESS 0xFFFF1612 READ_WRITE /end MEASUREMENT
/begin MEASUREMENT vDUREG391 "RAM value vDUREG391" UWORD COMP_0068 1 100 0 65535 ECU_ADDRESS 0xFFFF1614 READ_WRITE /end MEASUREMENT
/begin MEASUREMENT vDUREG392 "RAM value vDUREG392" UWORD COMP_0068 1 100 0 65535 ECU_ADDRESS 0xFFFF1616 READ_WRITE /end MEASUREMENT
/begin MEASUREMENT vDUREG393 "RAM value vDUREG393" UWORD COMP_0068 1 100 0 65535 ECU_ADDRESS 0xFFFF1618 READ_WRITE /end MEASUREMENT
/begin MEASUREMENT vDUREG394 "RAM value vDUREG394" UWORD COMP_0068 1 100 0 65535 ECU_ADDRESS 0xFFFF161A READ_WRITE /end MEASUREMENT
/begin MEASUREMENT vDUREG395 "RAM value vDUREG395" UWORD COMP_0068 1 100 0 65535 ECU_ADDRESS 0xFFFF161C READ_WRITE /end MEASUREMENT
/begin MEASUREMENT vDUREG396 "RAM value vDUREG396" UWORD COMP_0068 1 100 0 65535 ECU_ADDRESS 0xFFFF161E READ_WRITE /end MEASUREMENT
/begin MEASUREMENT vDUSMIN "RAM value vDUSMIN" UWORD COMP_0023 1 100 0 327675 ECU_ADDRESS 0xFFFF4668 READ_WRITE /end MEASUREMENT
/begin MEASUREMENT vDUTYOUT "RAM value vDUTYOUT" UBYTE COMP_0030 1 100 0 255 ECU_ADDRESS 0xFFFF0B6E READ_WRITE /end MEASUREMENT
/begin MEASUREMENT vDV1MIN "RAM value vDV1MIN" UBYTE COMP_0054 1 100 0 5100 ECU_ADDRESS 0xFFFF466A READ_WRITE /end MEASUREMENT
/begin MEASUREMENT vDVAPO40 "RAM value vDVAPO40" UWORD COMP_0077 1 100 0 7208.85 ECU_ADDRESS 0xFFFF0B70 READ_WRITE /end MEASUREMENT
/begin MEASUREMENT vDVAPOM "RAM value vDVAPOM" UWORD COMP_0005 1 100 0 7208.85 ECU_ADDRESS 0xFFFF25DC READ_WRITE /end MEASUREMENT
/begin MEASUREMENT vDVDG "RAM value vDVDG" UBYTE COMP_0000 1 100 0 6375 ECU_ADDRESS 0xFFFF0B72 READ_WRITE /end MEASUREMENT
/begin MEASUREMENT vDVFT "RAM value vDVFT" SWORD COMP_0003_S 1 100 -6553.6 6553.4 ECU_ADDRESS 0xFFFF364E READ_WRITE /end MEASUREMENT
/begin MEASUREMENT vDVFUEL "RAM value vDVFUEL" UWORD COMP_0023 1 100 0 327675 ECU_ADDRESS 0xFFFF25DE READ_WRITE /end MEASUREMENT
/begin MEASUREMENT vDVLRX "RAM value vDVLRX" UBYTE COMP_0541_S 1 100 0 2550 ECU_ADDRESS 0xFFFF2039 READ_WRITE /end MEASUREMENT
/begin MEASUREMENT vDVP1 "RAM value vDVP1" UWORD COMP_0050 1 100 0 5119.921875 ECU_ADDRESS 0xFFFF25E0 READ_WRITE /end MEASUREMENT
/begin MEASUREMENT vDVP4MN "RAM value vDVP4MN" UBYTE COMP_0054 1 100 0 5100 ECU_ADDRESS 0xFFFF466B READ_WRITE /end MEASUREMENT
/begin MEASUREMENT vDVP5 "RAM value vDVP5" UWORD COMP_0050 1 100 0 5119.921875 ECU_ADDRESS 0xFFFF25E2 READ_WRITE /end MEASUREMENT
/begin MEASUREMENT vDVP5HM "RAM value vDVP5HM" UWORD COMP_0050 1 100 0 5119.921875 ECU_ADDRESS 0xFFFF25E4 READ_WRITE /end MEASUREMENT
/begin MEASUREMENT vDVPILI2 "RAM value vDVPILI2" UWORD COMP_0050 1 100 0 5119.921875 ECU_ADDRESS 0xFFFF25E6 READ_WRITE /end MEASUREMENT
/begin MEASUREMENT vDVRLX "RAM value vDVRLX" UBYTE COMP_0541_S 1 100 0 2550 ECU_ADDRESS 0xFFFF203A READ_WRITE /end MEASUREMENT
/begin MEASUREMENT vDVSP "RAM value vDVSP" UBYTE COMP_0236 1 100 0 63.75 ECU_ADDRESS 0xFFFF1540 READ_WRITE /end MEASUREMENT
/begin MEASUREMENT vDVSPCNT "RAM value vDVSPCNT" UBYTE COMP_0014 1 100 0 2550 ECU_ADDRESS 0xFFFF1620 READ_WRITE /end MEASUREMENT
/begin MEASUREMENT vDWCNT01 "RAM value vDWCNT01" ULONG COMP_0189 1 100 0 13743895344 ECU_ADDRESS 0xFFFF0B74 READ_WRITE /end MEASUREMENT
/begin MEASUREMENT vDWCNT02 "RAM value vDWCNT02" ULONG COMP_0189 1 100 0 13743895344 ECU_ADDRESS 0xFFFF0B78 READ_WRITE /end MEASUREMENT
/begin MEASUREMENT vDWEVPRS "RAM value vDWEVPRS" SWORD COMP_0002_S 1 100 -32768 32767 ECU_ADDRESS 0xFFFF25E8 READ_WRITE /end MEASUREMENT
/begin MEASUREMENT vDWEVPTBL "RAM value vDWEVPTBL" UWORD COMP_0039_S 1 100 60000 125535 ECU_ADDRESS 0xFFFF25EA READ_WRITE /end MEASUREMENT
/begin MEASUREMENT vDWLCT1 "RAM value vDWLCT1" UWORD COMP_0390 1 100 0 655350 ECU_ADDRESS 0xFFFF0B7C READ_WRITE /end MEASUREMENT
/begin MEASUREMENT vDWLCT2 "RAM value vDWLCT2" UWORD COMP_0390 1 100 0 655350 ECU_ADDRESS 0xFFFF0B7E READ_WRITE /end MEASUREMENT
/begin MEASUREMENT vDWLNE "RAM value vDWLNE" UBYTE COMP_0020 1 100 0 12750 ECU_ADDRESS 0xFFFF0B80 READ_WRITE /end MEASUREMENT
/begin MEASUREMENT vDWLNET "RAM value vDWLNET" UBYTE COMP_0417_S 1 100 0 510 ECU_ADDRESS 0xFFFF0B81 READ_WRITE /end MEASUREMENT
/begin MEASUREMENT vDWLP1TP "RAM value vDWLP1TP" SWORD COMP_0002_S 1 100 -32768 32767 ECU_ADDRESS 0xFFFF2600 READ_WRITE /end MEASUREMENT
/begin MEASUREMENT vDWLP2TP "RAM value vDWLP2TP" SWORD COMP_0002_S 1 100 -32768 32767 ECU_ADDRESS 0xFFFF2602 READ_WRITE /end MEASUREMENT
/begin MEASUREMENT vDWLPRS1 "RAM value vDWLPRS1" SWORD COMP_0002_S 1 100 -32768 32767 ECU_ADDRESS 0xFFFF2604 READ_WRITE /end MEASUREMENT
/begin MEASUREMENT vDWLPRS2 "RAM value vDWLPRS2" SWORD COMP_0002_S 1 100 -32768 32767 ECU_ADDRESS 0xFFFF2606 READ_WRITE /end MEASUREMENT
/begin MEASUREMENT vDWLTM1 "RAM value vDWLTM1" UBYTE COMP_0073 1 100 0 816 ECU_ADDRESS 0xFFFF0B82 READ_WRITE /end MEASUREMENT
/begin MEASUREMENT vDWLTM2 "RAM value vDWLTM2" UBYTE COMP_0073 1 100 0 816 ECU_ADDRESS 0xFFFF0B83 READ_WRITE /end MEASUREMENT
/begin MEASUREMENT vDWLVB "RAM value vDWLVB" UBYTE COMP_0033 1 100 0 20400 ECU_ADDRESS 0xFFFF0B84 READ_WRITE /end MEASUREMENT
/begin MEASUREMENT vDWLVBT "RAM value vDWLVBT" UBYTE COMP_0542_S 1 100 0 0.3984375 ECU_ADDRESS 0xFFFF0B85 READ_WRITE /end MEASUREMENT
/begin MEASUREMENT vDWPTMAX "RAM value vDWPTMAX" UWORD COMP_0008 1 100 0 6553500 ECU_ADDRESS 0xFFFF2608 READ_WRITE /end MEASUREMENT
/begin MEASUREMENT vDZ1000 "RAM value vDZ1000" UBYTE COMP_0016 1 100 0 255 ECU_ADDRESS 0xFFFF3120 READ_WRITE /end MEASUREMENT
/begin MEASUREMENT vDZ10MX "RAM value vDZ10MX" UBYTE COMP_0016 1 100 0 255 ECU_ADDRESS 0xFFFF4E34 READ_WRITE /end MEASUREMENT
/begin MEASUREMENT vDZTOTA "RAM value vDZTOTA" UWORD COMP_0016 1 100 0 65535 ECU_ADDRESS 0xFFFF4E36 READ_WRITE /end MEASUREMENT
/begin MEASUREMENT vE "RAM value vE" UBYTE COMP_0009 1 100 0 199.21875 ECU_ADDRESS 0xFFFF172A READ_WRITE /end MEASUREMENT
/begin MEASUREMENT vEBWC1 "RAM value vEBWC1" UBYTE COMP_0068 1 100 0 255 ECU_ADDRESS 0xFFFF3650 READ_WRITE /end MEASUREMENT
/begin MEASUREMENT vEBWC10 "RAM value vEBWC10" UBYTE COMP_0068 1 100 0 255 ECU_ADDRESS 0xFFFF3651 READ_WRITE /end MEASUREMENT
/begin MEASUREMENT vEBWC11 "RAM value vEBWC11" UBYTE COMP_0068 1 100 0 255 ECU_ADDRESS 0xFFFF3652 READ_WRITE /end MEASUREMENT
/begin MEASUREMENT vEBWC2 "RAM value vEBWC2" UBYTE COMP_0068 1 100 0 255 ECU_ADDRESS 0xFFFF3653 READ_WRITE /end MEASUREMENT
/begin MEASUREMENT vEBWC3 "RAM value vEBWC3" UBYTE COMP_0068 1 100 0 255 ECU_ADDRESS 0xFFFF3654 READ_WRITE /end MEASUREMENT
/begin MEASUREMENT vEBWC4 "RAM value vEBWC4" UBYTE COMP_0068 1 100 0 255 ECU_ADDRESS 0xFFFF3655 READ_WRITE /end MEASUREMENT
/begin MEASUREMENT vEBWC5 "RAM value vEBWC5" UBYTE COMP_0068 1 100 0 255 ECU_ADDRESS 0xFFFF3656 READ_WRITE /end MEASUREMENT
/begin MEASUREMENT vEBWC6 "RAM value vEBWC6" UBYTE COMP_0068 1 100 0 255 ECU_ADDRESS 0xFFFF3657 READ_WRITE /end MEASUREMENT
/begin MEASUREMENT vEBWC7 "RAM value vEBWC7" UBYTE COMP_0068 1 100 0 255 ECU_ADDRESS 0xFFFF3658 READ_WRITE /end MEASUREMENT
/begin MEASUREMENT vEBWC8 "RAM value vEBWC8" UBYTE COMP_0068 1 100 0 255 ECU_ADDRESS 0xFFFF3659 READ_WRITE /end MEASUREMENT
/begin MEASUREMENT vEBWC9 "RAM value vEBWC9" UBYTE COMP_0068 1 100 0 255 ECU_ADDRESS 0xFFFF365A READ_WRITE /end MEASUREMENT
/begin MEASUREMENT vECMGST "RAM value vECMGST" UBYTE COMP_0014 1 100 0 2550 ECU_ADDRESS 0xFFFF365B READ_WRITE /end MEASUREMENT
/begin MEASUREMENT vECMITM1T "RAM value vECMITM1T" UBYTE COMP_0014 1 100 0 2550 ECU_ADDRESS 0xFFFF365C READ_WRITE /end MEASUREMENT
/begin MEASUREMENT vECMSCT "RAM value vECMSCT" UBYTE COMP_0014 1 100 0 2550 ECU_ADDRESS 0xFFFF365D READ_WRITE /end MEASUREMENT
/begin MEASUREMENT vECMSCT2T "RAM value vECMSCT2T" UBYTE COMP_0014 1 100 0 2550 ECU_ADDRESS 0xFFFF365E READ_WRITE /end MEASUREMENT
/begin MEASUREMENT vECMSUM "RAM value vECMSUM" UBYTE COMP_0068 1 100 0 255 ECU_ADDRESS 0xFFFF466C READ_WRITE /end MEASUREMENT
/begin MEASUREMENT vECODWN "RAM value vECODWN" UWORD COMP_0005 1 100 0 7208.85 ECU_ADDRESS 0xFFFF260A READ_WRITE /end MEASUREMENT
/begin MEASUREMENT vECOFNW "RAM value vECOFNW" UWORD COMP_0005 1 100 0 7208.85 ECU_ADDRESS 0xFFFF260C READ_WRITE /end MEASUREMENT
/begin MEASUREMENT vECOIND "RAM value vECOIND" UBYTE COMP_0068 1 100 0 255 ECU_ADDRESS 0xFFFF3B52 READ_WRITE /end MEASUREMENT
/begin MEASUREMENT vECOLMPST "RAM value vECOLMPST" UBYTE COMP_0068 1 100 0 255 ECU_ADDRESS 0xFFFF260E READ_WRITE /end MEASUREMENT
/begin MEASUREMENT vECOMLEV "RAM value vECOMLEV" UWORD COMP_0388 1 100 0 6553.5 ECU_ADDRESS 0xFFFF3B54 READ_WRITE /end MEASUREMENT
/begin MEASUREMENT vECOMLEV0 "RAM value vECOMLEV0" UWORD COMP_0388 1 100 0 6553.5 ECU_ADDRESS 0xFFFF2610 READ_WRITE /end MEASUREMENT
/begin MEASUREMENT vECOMLEV1 "RAM value vECOMLEV1" UWORD COMP_0388 1 100 0 6553.5 ECU_ADDRESS 0xFFFF2612 READ_WRITE /end MEASUREMENT
/begin MEASUREMENT vECOMLEV2 "RAM value vECOMLEV2" UWORD COMP_0388 1 100 0 6553.5 ECU_ADDRESS 0xFFFF2614 READ_WRITE /end MEASUREMENT
/begin MEASUREMENT vECOPAPST "RAM value vECOPAPST" UWORD COMP_0005 1 100 0 7208.85 ECU_ADDRESS 0xFFFF2616 READ_WRITE /end MEASUREMENT
/begin MEASUREMENT vECSMSG8T "RAM value vECSMSG8T" UBYTE COMP_0014 1 100 0 2550 ECU_ADDRESS 0xFFFF365F READ_WRITE /end MEASUREMENT
/begin MEASUREMENT vECTQCT1T "RAM value vECTQCT1T" UBYTE COMP_0014 1 100 0 2550 ECU_ADDRESS 0xFFFF3660 READ_WRITE /end MEASUREMENT
/begin MEASUREMENT vECTQCT2T "RAM value vECTQCT2T" UBYTE COMP_0014 1 100 0 2550 ECU_ADDRESS 0xFFFF3661 READ_WRITE /end MEASUREMENT
/begin MEASUREMENT vECTQN1T "RAM value vECTQN1T" UBYTE COMP_0014 1 100 0 2550 ECU_ADDRESS 0xFFFF3662 READ_WRITE /end MEASUREMENT
/begin MEASUREMENT vEDCESTCT "RAM value vEDCESTCT" UBYTE COMP_0004_S 1 100 -50 205 ECU_ADDRESS 0xFFFF2618 READ_WRITE /end MEASUREMENT
/begin MEASUREMENT vEEPADRCHK "RAM value vEEPADRCHK" UWORD COMP_0068 1 100 0 65535 ECU_ADDRESS 0xFFFF261A READ_WRITE /end MEASUREMENT
/begin MEASUREMENT vEEPCHKM "RAM value vEEPCHKM" UBYTE COMP_0068 1 100 0 255 ECU_ADDRESS 0xFFFF261C READ_WRITE /end MEASUREMENT
/begin MEASUREMENT vEEPJOB "RAM value vEEPJOB" UBYTE COMP_0004 1 100 0 255 ECU_ADDRESS 0xFFFF261D READ_WRITE /end MEASUREMENT
/begin MEASUREMENT vEEPMILE "RAM value vEEPMILE" ULONG COMP_0543_S 1 100 0 431654950.565737 ECU_ADDRESS 0xFFFF4E70 READ_WRITE /end MEASUREMENT
/begin MEASUREMENT vEEPRA0 "RAM value vEEPRA0" UBYTE COMP_0004 1 100 0 255 ECU_ADDRESS 0xFFFF261E READ_WRITE /end MEASUREMENT
/begin MEASUREMENT vEEPRA1 "RAM value vEEPRA1" UBYTE COMP_0004 1 100 0 255 ECU_ADDRESS 0xFFFF261F READ_WRITE /end MEASUREMENT
/begin MEASUREMENT vEEPRA2 "RAM value vEEPRA2" UBYTE COMP_0004 1 100 0 255 ECU_ADDRESS 0xFFFF2620 READ_WRITE /end MEASUREMENT
/begin MEASUREMENT vEEPRA3 "RAM value vEEPRA3" UBYTE COMP_0004 1 100 0 255 ECU_ADDRESS 0xFFFF2621 READ_WRITE /end MEASUREMENT
/begin MEASUREMENT vEEPRA4 "RAM value vEEPRA4" UBYTE COMP_0004 1 100 0 255 ECU_ADDRESS 0xFFFF2622 READ_WRITE /end MEASUREMENT
/begin MEASUREMENT vEEPRA5 "RAM value vEEPRA5" UBYTE COMP_0004 1 100 0 255 ECU_ADDRESS 0xFFFF2623 READ_WRITE /end MEASUREMENT
/begin MEASUREMENT vEEPRA6 "RAM value vEEPRA6" UBYTE COMP_0004 1 100 0 255 ECU_ADDRESS 0xFFFF2624 READ_WRITE /end MEASUREMENT
/begin MEASUREMENT vEEPRA7 "RAM value vEEPRA7" UBYTE COMP_0004 1 100 0 255 ECU_ADDRESS 0xFFFF2625 READ_WRITE /end MEASUREMENT
/begin MEASUREMENT vEEPRA8 "RAM value vEEPRA8" UBYTE COMP_0004 1 100 0 255 ECU_ADDRESS 0xFFFF2626 READ_WRITE /end MEASUREMENT
/begin MEASUREMENT vEEPRAN "RAM value vEEPRAN" UBYTE COMP_0004 1 100 0 255 ECU_ADDRESS 0xFFFF2627 READ_WRITE /end MEASUREMENT
/begin MEASUREMENT vEEPRB0 "RAM value vEEPRB0" UWORD COMP_0004 1 100 0 65535 ECU_ADDRESS 0xFFFF2628 READ_WRITE /end MEASUREMENT
/begin MEASUREMENT vEEPRB1 "RAM value vEEPRB1" UWORD COMP_0004 1 100 0 65535 ECU_ADDRESS 0xFFFF262A READ_WRITE /end MEASUREMENT
/begin MEASUREMENT vEEPRB2 "RAM value vEEPRB2" UWORD COMP_0004 1 100 0 65535 ECU_ADDRESS 0xFFFF262C READ_WRITE /end MEASUREMENT
/begin MEASUREMENT vEEPRB3 "RAM value vEEPRB3" UWORD COMP_0004 1 100 0 65535 ECU_ADDRESS 0xFFFF262E READ_WRITE /end MEASUREMENT
/begin MEASUREMENT vEEPRB4 "RAM value vEEPRB4" UWORD COMP_0004 1 100 0 65535 ECU_ADDRESS 0xFFFF2630 READ_WRITE /end MEASUREMENT
/begin MEASUREMENT vEEPRB5 "RAM value vEEPRB5" UWORD COMP_0004 1 100 0 65535 ECU_ADDRESS 0xFFFF2632 READ_WRITE /end MEASUREMENT
/begin MEASUREMENT vEEPRB6 "RAM value vEEPRB6" UWORD COMP_0004 1 100 0 65535 ECU_ADDRESS 0xFFFF2634 READ_WRITE /end MEASUREMENT
/begin MEASUREMENT vEEPRB7 "RAM value vEEPRB7" UWORD COMP_0004 1 100 0 65535 ECU_ADDRESS 0xFFFF2636 READ_WRITE /end MEASUREMENT
/begin MEASUREMENT vEEPRB8 "RAM value vEEPRB8" UWORD COMP_0004 1 100 0 65535 ECU_ADDRESS 0xFFFF2638 READ_WRITE /end MEASUREMENT
/begin MEASUREMENT vEEPRBN "RAM value vEEPRBN" UWORD COMP_0004 1 100 0 65535 ECU_ADDRESS 0xFFFF263A READ_WRITE /end MEASUREMENT
/begin MEASUREMENT vEEPRDAT_M "RAM value vEEPRDAT_M" UWORD COMP_0004 1 100 0 65535 ECU_ADDRESS 0xFFFF263C READ_WRITE /end MEASUREMENT
/begin MEASUREMENT vEEPSTG "RAM value vEEPSTG" UBYTE COMP_0004 1 100 0 255 ECU_ADDRESS 0xFFFF263E READ_WRITE /end MEASUREMENT
/begin MEASUREMENT vEEPVSP "RAM value vEEPVSP" ULONG COMP_0544_S 1 100 0 431655006.400312 ECU_ADDRESS 0xFFFF4E74 READ_WRITE /end MEASUREMENT
/begin MEASUREMENT vEEPWA0 "RAM value vEEPWA0" UBYTE COMP_0004 1 100 0 255 ECU_ADDRESS 0xFFFF263F READ_WRITE /end MEASUREMENT
/begin MEASUREMENT vEEPWA1 "RAM value vEEPWA1" UBYTE COMP_0004 1 100 0 255 ECU_ADDRESS 0xFFFF2640 READ_WRITE /end MEASUREMENT
/begin MEASUREMENT vEEPWA2 "RAM value vEEPWA2" UBYTE COMP_0004 1 100 0 255 ECU_ADDRESS 0xFFFF2641 READ_WRITE /end MEASUREMENT
/begin MEASUREMENT vEEPWA3 "RAM value vEEPWA3" UBYTE COMP_0004 1 100 0 255 ECU_ADDRESS 0xFFFF2642 READ_WRITE /end MEASUREMENT
/begin MEASUREMENT vEEPWA4 "RAM value vEEPWA4" UBYTE COMP_0004 1 100 0 255 ECU_ADDRESS 0xFFFF2643 READ_WRITE /end MEASUREMENT
/begin MEASUREMENT vEEPWA5 "RAM value vEEPWA5" UBYTE COMP_0004 1 100 0 255 ECU_ADDRESS 0xFFFF2644 READ_WRITE /end MEASUREMENT
/begin MEASUREMENT vEEPWA6 "RAM value vEEPWA6" UBYTE COMP_0004 1 100 0 255 ECU_ADDRESS 0xFFFF2645 READ_WRITE /end MEASUREMENT
/begin MEASUREMENT vEEPWA7 "RAM value vEEPWA7" UBYTE COMP_0004 1 100 0 255 ECU_ADDRESS 0xFFFF2646 READ_WRITE /end MEASUREMENT
/begin MEASUREMENT vEEPWA8 "RAM value vEEPWA8" UBYTE COMP_0004 1 100 0 255 ECU_ADDRESS 0xFFFF2647 READ_WRITE /end MEASUREMENT
/begin MEASUREMENT vEEPWAIT "RAM value vEEPWAIT" UBYTE COMP_0030 1 100 0 255 ECU_ADDRESS 0xFFFF2648 READ_WRITE /end MEASUREMENT
/begin MEASUREMENT vEEPWAN "RAM value vEEPWAN" UBYTE COMP_0004 1 100 0 255 ECU_ADDRESS 0xFFFF2649 READ_WRITE /end MEASUREMENT
/begin MEASUREMENT vEEPWB0 "RAM value vEEPWB0" UWORD COMP_0004 1 100 0 65535 ECU_ADDRESS 0xFFFF264A READ_WRITE /end MEASUREMENT
/begin MEASUREMENT vEEPWB1 "RAM value vEEPWB1" UWORD COMP_0004 1 100 0 65535 ECU_ADDRESS 0xFFFF264C READ_WRITE /end MEASUREMENT
/begin MEASUREMENT vEEPWB2 "RAM value vEEPWB2" UWORD COMP_0004 1 100 0 65535 ECU_ADDRESS 0xFFFF264E READ_WRITE /end MEASUREMENT
/begin MEASUREMENT vEEPWB3 "RAM value vEEPWB3" UWORD COMP_0004 1 100 0 65535 ECU_ADDRESS 0xFFFF2650 READ_WRITE /end MEASUREMENT
/begin MEASUREMENT vEEPWB4 "RAM value vEEPWB4" UWORD COMP_0004 1 100 0 65535 ECU_ADDRESS 0xFFFF2652 READ_WRITE /end MEASUREMENT
/begin MEASUREMENT vEEPWB5 "RAM value vEEPWB5" UWORD COMP_0004 1 100 0 65535 ECU_ADDRESS 0xFFFF2654 READ_WRITE /end MEASUREMENT
/begin MEASUREMENT vEEPWB6 "RAM value vEEPWB6" UWORD COMP_0004 1 100 0 65535 ECU_ADDRESS 0xFFFF2656 READ_WRITE /end MEASUREMENT
/begin MEASUREMENT vEEPWB7 "RAM value vEEPWB7" UWORD COMP_0004 1 100 0 65535 ECU_ADDRESS 0xFFFF2658 READ_WRITE /end MEASUREMENT
/begin MEASUREMENT vEEPWB8 "RAM value vEEPWB8" UWORD COMP_0004 1 100 0 65535 ECU_ADDRESS 0xFFFF265A READ_WRITE /end MEASUREMENT
/begin MEASUREMENT vEEPWBN "RAM value vEEPWBN" UWORD COMP_0004 1 100 0 65535 ECU_ADDRESS 0xFFFF265C READ_WRITE /end MEASUREMENT
/begin MEASUREMENT vEEPWCNT_M "RAM value vEEPWCNT_M" UBYTE COMP_0016 1 100 0 255 ECU_ADDRESS 0xFFFF265E READ_WRITE /end MEASUREMENT
/begin MEASUREMENT vEEPWRCHK "RAM value vEEPWRCHK" UBYTE COMP_0068 1 100 0 255 ECU_ADDRESS 0xFFFF265F READ_WRITE /end MEASUREMENT
/begin MEASUREMENT vEEPWST "RAM value vEEPWST" UBYTE COMP_0004 1 100 0 255 ECU_ADDRESS 0xFFFF2660 READ_WRITE /end MEASUREMENT
/begin MEASUREMENT vEGRACNT "RAM value vEGRACNT" UWORD COMP_0016 1 100 0 65535 ECU_ADDRESS 0xFFFF5126 READ_WRITE /end MEASUREMENT
/begin MEASUREMENT vEGRATRP "RAM value vEGRATRP" UWORD COMP_0016 1 100 0 65535 ECU_ADDRESS 0xFFFF5128 READ_WRITE /end MEASUREMENT
/begin MEASUREMENT vEGRBCNT "RAM value vEGRBCNT" UWORD COMP_0016 1 100 0 65535 ECU_ADDRESS 0xFFFF512A READ_WRITE /end MEASUREMENT
/begin MEASUREMENT vEGRBTRP "RAM value vEGRBTRP" UWORD COMP_0016 1 100 0 65535 ECU_ADDRESS 0xFFFF512C READ_WRITE /end MEASUREMENT
/begin MEASUREMENT vEGRC "RAM value vEGRC" UWORD COMP_0271 1 100 0 199.99696053 ECU_ADDRESS 0xFFFF0B86 READ_WRITE /end MEASUREMENT
/begin MEASUREMENT vEGRCCNT "RAM value vEGRCCNT" UWORD COMP_0016 1 100 0 65535 ECU_ADDRESS 0xFFFF512E READ_WRITE /end MEASUREMENT
/begin MEASUREMENT vEGRCLRT "RAM value vEGRCLRT" UBYTE COMP_0018_S 1 100 0 0.498046875 ECU_ADDRESS 0xFFFF3B56 READ_WRITE /end MEASUREMENT
/begin MEASUREMENT vEGRHOS "RAM value vEGRHOS" UBYTE COMP_0365_S 1 100 0 63.75 ECU_ADDRESS 0xFFFF0B88 READ_WRITE /end MEASUREMENT
/begin MEASUREMENT vEGRQ "RAM value vEGRQ" UBYTE COMP_0141 1 100 0 49.8046875 ECU_ADDRESS 0xFFFF0B89 READ_WRITE /end MEASUREMENT
/begin MEASUREMENT vEGRRCC "RAM value vEGRRCC" UBYTE COMP_0030 1 100 0 255 ECU_ADDRESS 0xFFFF4670 READ_WRITE /end MEASUREMENT
/begin MEASUREMENT vEGRT10 "RAM value vEGRT10" UBYTE COMP_0035 1 100 -50 205 ECU_ADDRESS 0xFFFF2661 READ_WRITE /end MEASUREMENT
/begin MEASUREMENT vEGRT20 "RAM value vEGRT20" UBYTE COMP_0035 1 100 -50 205 ECU_ADDRESS 0xFFFF2662 READ_WRITE /end MEASUREMENT
/begin MEASUREMENT vEGRT30 "RAM value vEGRT30" UBYTE COMP_0035 1 100 -50 205 ECU_ADDRESS 0xFFFF2663 READ_WRITE /end MEASUREMENT
/begin MEASUREMENT vEGRTRP "RAM value vEGRTRP" UWORD COMP_0016 1 100 0 65535 ECU_ADDRESS 0xFFFF5130 READ_WRITE /end MEASUREMENT
/begin MEASUREMENT vEGSTPD "RAM value vEGSTPD" UWORD COMP_0140 1 100 0 32767.5 ECU_ADDRESS 0xFFFF3B58 READ_WRITE /end MEASUREMENT
/begin MEASUREMENT vEGT1 "RAM value vEGT1" UWORD COMP_0035 1 100 -50 65485 ECU_ADDRESS 0xFFFF3664 READ_WRITE /end MEASUREMENT
/begin MEASUREMENT vEGT12 "RAM value vEGT12" UWORD COMP_0405_S 1 100 0 1310.7 ECU_ADDRESS 0xFFFF203C READ_WRITE /end MEASUREMENT
/begin MEASUREMENT vELCTRQ "RAM value vELCTRQ" UBYTE COMP_0131_S 1 100 0 127.5 ECU_ADDRESS 0xFFFF2664 READ_WRITE /end MEASUREMENT
/begin MEASUREMENT vELCTRQ0 "RAM value vELCTRQ0" UBYTE COMP_0131_S 1 100 0 127.5 ECU_ADDRESS 0xFFFF2665 READ_WRITE /end MEASUREMENT
/begin MEASUREMENT vELCUR "RAM value vELCUR" UBYTE COMP_0045_S 1 100 0 255 ECU_ADDRESS 0xFFFF2666 READ_WRITE /end MEASUREMENT
/begin MEASUREMENT vELLGREVf "RAM value vELLGREVf" UBYTE COMP_0004 1 100 0 255 ECU_ADDRESS 0xFFFF2667 READ_WRITE /end MEASUREMENT
/begin MEASUREMENT vELNREVf "RAM value vELNREVf" UBYTE COMP_0004 1 100 0 255 ECU_ADDRESS 0xFFFF0B8A READ_WRITE /end MEASUREMENT
/begin MEASUREMENT vELPLICT "RAM value vELPLICT" UWORD COMP_0545_S 1 100 0 65535 ECU_ADDRESS 0xFFFF4672 READ_WRITE /end MEASUREMENT
/begin MEASUREMENT vELPLPCT "RAM value vELPLPCT" UWORD COMP_0545_S 1 100 0 65535 ECU_ADDRESS 0xFFFF4676 READ_WRITE /end MEASUREMENT
/begin MEASUREMENT vELRLIOKf "RAM value vELRLIOKf" UBYTE COMP_0004 1 100 0 255 ECU_ADDRESS 0xFFFF2668 READ_WRITE /end MEASUREMENT
/begin MEASUREMENT vELRLPOKf "RAM value vELRLPOKf" UBYTE COMP_0004 1 100 0 255 ECU_ADDRESS 0xFFFF2669 READ_WRITE /end MEASUREMENT
/begin MEASUREMENT vELRNOKf "RAM value vELRNOKf" UBYTE COMP_0004 1 100 0 255 ECU_ADDRESS 0xFFFF0B8B READ_WRITE /end MEASUREMENT
/begin MEASUREMENT vEMCOUN "RAM value vEMCOUN" UWORD COMP_0016 1 100 0 65535 ECU_ADDRESS 0xFFFF467A READ_WRITE /end MEASUREMENT
/begin MEASUREMENT vENATCCNT "RAM value vENATCCNT" UBYTE COMP_0016 1 100 0 255 ECU_ADDRESS 0xFFFF4E78 READ_WRITE /end MEASUREMENT
/begin MEASUREMENT vENDPCCNT "RAM value vENDPCCNT" UBYTE COMP_0016 1 100 0 255 ECU_ADDRESS 0xFFFF4E79 READ_WRITE /end MEASUREMENT
/begin MEASUREMENT vENDPOCNT "RAM value vENDPOCNT" UBYTE COMP_0016 1 100 0 255 ECU_ADDRESS 0xFFFF4E7A READ_WRITE /end MEASUREMENT
/begin MEASUREMENT vENGBFAC "RAM value vENGBFAC" UBYTE COMP_0378 1 100 0 100.000000065 ECU_ADDRESS 0xFFFF266A READ_WRITE /end MEASUREMENT
/begin MEASUREMENT vENGBFA_S "RAM value vENGBFA_S" UBYTE COMP_0378 1 100 0 100.000000065 ECU_ADDRESS 0xFFFF3046 READ_WRITE /end MEASUREMENT
/begin MEASUREMENT vENGBTH "RAM value vENGBTH" UWORD COMP_0032_S 1 100 0 8191.875 ECU_ADDRESS 0xFFFF266C READ_WRITE /end MEASUREMENT
/begin MEASUREMENT vENGBTH_S "RAM value vENGBTH_S" UWORD COMP_0032_S 1 100 0 8191.875 ECU_ADDRESS 0xFFFF3048 READ_WRITE /end MEASUREMENT
/begin MEASUREMENT vENGFD "RAM value vENGFD" SWORD COMP_0514_S 1 100 -32768 32767 ECU_ADDRESS 0xFFFF0B8C READ_WRITE /end MEASUREMENT
/begin MEASUREMENT vENGLOAD "RAM value vENGLOAD" UBYTE COMP_0068 1 100 0 255 ECU_ADDRESS 0xFFFF266E READ_WRITE /end MEASUREMENT
/begin MEASUREMENT vENGSTRT "RAM value vENGSTRT" ULONG COMP_0008 1 100 0 429496729500 ECU_ADDRESS 0xFFFF08D0 READ_WRITE /end MEASUREMENT
/begin MEASUREMENT vENGTIME "RAM value vENGTIME" UBYTE COMP_0013 1 100 0 255 ECU_ADDRESS 0xFFFF4E7B READ_WRITE /end MEASUREMENT
/begin MEASUREMENT vENGTM "RAM value vENGTM" UWORD COMP_0015_S 1 100 0 6553.5 ECU_ADDRESS 0xFFFF2670 READ_WRITE /end MEASUREMENT
/begin MEASUREMENT vENGTMBU "RAM value vENGTMBU" UWORD COMP_0015_S 1 100 0 6553.5 ECU_ADDRESS 0xFFFF467C READ_WRITE /end MEASUREMENT
/begin MEASUREMENT vENPNGCNT "RAM value vENPNGCNT" UBYTE COMP_0016 1 100 0 255 ECU_ADDRESS 0xFFFF4E7C READ_WRITE /end MEASUREMENT
/begin MEASUREMENT vENPOKCNT "RAM value vENPOKCNT" UBYTE COMP_0016 1 100 0 255 ECU_ADDRESS 0xFFFF4E7D READ_WRITE /end MEASUREMENT
/begin MEASUREMENT vENTFCCNT "RAM value vENTFCCNT" UBYTE COMP_0016 1 100 0 255 ECU_ADDRESS 0xFFFF4E7E READ_WRITE /end MEASUREMENT
/begin MEASUREMENT vENVNGCNT "RAM value vENVNGCNT" UBYTE COMP_0016 1 100 0 255 ECU_ADDRESS 0xFFFF4E7F READ_WRITE /end MEASUREMENT
/begin MEASUREMENT vENVOKCNT "RAM value vENVOKCNT" UBYTE COMP_0016 1 100 0 255 ECU_ADDRESS 0xFFFF4E80 READ_WRITE /end MEASUREMENT
/begin MEASUREMENT vENZN21 "RAM value vENZN21" UBYTE COMP_0016 1 100 0 255 ECU_ADDRESS 0xFFFF4E38 READ_WRITE /end MEASUREMENT
/begin MEASUREMENT vENZNN1 "RAM value vENZNN1" UBYTE COMP_0016 1 100 0 255 ECU_ADDRESS 0xFFFF3121 READ_WRITE /end MEASUREMENT
/begin MEASUREMENT vEOENRUN "RAM value vEOENRUN" UWORD COMP_0105 1 100 0 6553.5 ECU_ADDRESS 0xFFFF3666 READ_WRITE /end MEASUREMENT
/begin MEASUREMENT vEONVMILE "RAM value vEONVMILE" ULONG COMP_0389 1 100 0 1685624.33943218 ECU_ADDRESS 0xFFFF4E84 READ_WRITE /end MEASUREMENT
/begin MEASUREMENT vEONVMLEH "RAM value vEONVMLEH" UWORD COMP_0546_S 1 100 0 431512913.775 ECU_ADDRESS 0xFFFF4E88 READ_WRITE /end MEASUREMENT
/begin MEASUREMENT vEONVMLEL "RAM value vEONVMLEL" UWORD COMP_0547_S 1 100 0 6584.366985 ECU_ADDRESS 0xFFFF4E8A READ_WRITE /end MEASUREMENT
/begin MEASUREMENT vEOPTFP "RAM value vEOPTFP" UBYTE COMP_0016 1 100 0 255 ECU_ADDRESS 0xFFFF4E8C READ_WRITE /end MEASUREMENT
/begin MEASUREMENT vEOPVFP "RAM value vEOPVFP" UBYTE COMP_0016 1 100 0 255 ECU_ADDRESS 0xFFFF4E9C READ_WRITE /end MEASUREMENT
/begin MEASUREMENT vEPBPDEF "RAM value vEPBPDEF" SLONG COMP_0114_S 1 100 -4194304 4194303.99804688 ECU_ADDRESS 0xFFFF2674 READ_WRITE /end MEASUREMENT
/begin MEASUREMENT vEPBPDFMN "RAM value vEPBPDFMN" SLONG COMP_0114_S 1 100 -4194304 4194303.99804688 ECU_ADDRESS 0xFFFF4680 READ_WRITE /end MEASUREMENT
/begin MEASUREMENT vEPBPDFMX "RAM value vEPBPDFMX" SLONG COMP_0114_S 1 100 -4194304 4194303.99804688 ECU_ADDRESS 0xFFFF4684 READ_WRITE /end MEASUREMENT
/begin MEASUREMENT vEPCACT "RAM value vEPCACT" UBYTE COMP_0068 1 100 0 255 ECU_ADDRESS 0xFFFF2678 READ_WRITE /end MEASUREMENT
/begin MEASUREMENT vEPCKNO "RAM value vEPCKNO" UBYTE COMP_0414 1 100 0 255 ECU_ADDRESS 0xFFFF2679 READ_WRITE /end MEASUREMENT
/begin MEASUREMENT vEPLACT "RAM value vEPLACT" UBYTE COMP_0068 1 100 0 255 ECU_ADDRESS 0xFFFF267A READ_WRITE /end MEASUREMENT
/begin MEASUREMENT vEPLADR2 "RAM value vEPLADR2" UWORD COMP_0068 1 100 0 65535 ECU_ADDRESS 0xFFFF267C READ_WRITE /end MEASUREMENT
/begin MEASUREMENT vEPLBUF "RAM value vEPLBUF" UWORD COMP_0068 1 100 0 65535 ECU_ADDRESS 0xFFFF267E READ_WRITE /end MEASUREMENT
/begin MEASUREMENT vEPLCLAS "RAM value vEPLCLAS" UBYTE COMP_0068 1 100 0 255 ECU_ADDRESS 0xFFFF2680 READ_WRITE /end MEASUREMENT
/begin MEASUREMENT vEPLKIND "RAM value vEPLKIND" UBYTE COMP_0068 1 100 0 255 ECU_ADDRESS 0xFFFF2681 READ_WRITE /end MEASUREMENT
/begin MEASUREMENT vEPRA2B0 "RAM value vEPRA2B0" UWORD COMP_0004 1 100 0 65535 ECU_ADDRESS 0xFFFF3668 READ_WRITE /end MEASUREMENT
/begin MEASUREMENT vEPRA2B1 "RAM value vEPRA2B1" UWORD COMP_0004 1 100 0 65535 ECU_ADDRESS 0xFFFF366A READ_WRITE /end MEASUREMENT
/begin MEASUREMENT vEPRA2BN "RAM value vEPRA2BN" UWORD COMP_0004 1 100 0 65535 ECU_ADDRESS 0xFFFF366C READ_WRITE /end MEASUREMENT
/begin MEASUREMENT vEPRAW0 "RAM value vEPRAW0" UWORD COMP_0004 1 100 0 65535 ECU_ADDRESS 0xFFFF366E READ_WRITE /end MEASUREMENT
/begin MEASUREMENT vEPRAW1 "RAM value vEPRAW1" UWORD COMP_0004 1 100 0 65535 ECU_ADDRESS 0xFFFF3670 READ_WRITE /end MEASUREMENT
/begin MEASUREMENT vEPRAW2 "RAM value vEPRAW2" UWORD COMP_0004 1 100 0 65535 ECU_ADDRESS 0xFFFF3672 READ_WRITE /end MEASUREMENT
/begin MEASUREMENT vEPRAW3 "RAM value vEPRAW3" UWORD COMP_0004 1 100 0 65535 ECU_ADDRESS 0xFFFF3674 READ_WRITE /end MEASUREMENT
/begin MEASUREMENT vEPRAW4 "RAM value vEPRAW4" UWORD COMP_0004 1 100 0 65535 ECU_ADDRESS 0xFFFF3676 READ_WRITE /end MEASUREMENT
/begin MEASUREMENT vEPRAW5 "RAM value vEPRAW5" UWORD COMP_0004 1 100 0 65535 ECU_ADDRESS 0xFFFF3678 READ_WRITE /end MEASUREMENT
/begin MEASUREMENT vEPRAW6 "RAM value vEPRAW6" UWORD COMP_0004 1 100 0 65535 ECU_ADDRESS 0xFFFF367A READ_WRITE /end MEASUREMENT
/begin MEASUREMENT vEPRAW7 "RAM value vEPRAW7" UWORD COMP_0004 1 100 0 65535 ECU_ADDRESS 0xFFFF367C READ_WRITE /end MEASUREMENT
/begin MEASUREMENT vEPRAWN "RAM value vEPRAWN" UWORD COMP_0004 1 100 0 65535 ECU_ADDRESS 0xFFFF367E READ_WRITE /end MEASUREMENT
/begin MEASUREMENT vEPRB2B0 "RAM value vEPRB2B0" UWORD COMP_0004 1 100 0 65535 ECU_ADDRESS 0xFFFF3680 READ_WRITE /end MEASUREMENT
/begin MEASUREMENT vEPRB2B1 "RAM value vEPRB2B1" UWORD COMP_0004 1 100 0 65535 ECU_ADDRESS 0xFFFF3682 READ_WRITE /end MEASUREMENT
/begin MEASUREMENT vEPRB2BN "RAM value vEPRB2BN" UWORD COMP_0004 1 100 0 65535 ECU_ADDRESS 0xFFFF3684 READ_WRITE /end MEASUREMENT
/begin MEASUREMENT vEPRBW0 "RAM value vEPRBW0" UBYTE COMP_0004 1 100 0 255 ECU_ADDRESS 0xFFFF3686 READ_WRITE /end MEASUREMENT
/begin MEASUREMENT vEPRBW1 "RAM value vEPRBW1" UBYTE COMP_0004 1 100 0 255 ECU_ADDRESS 0xFFFF3687 READ_WRITE /end MEASUREMENT
/begin MEASUREMENT vEPRBW2 "RAM value vEPRBW2" UBYTE COMP_0004 1 100 0 255 ECU_ADDRESS 0xFFFF3688 READ_WRITE /end MEASUREMENT
/begin MEASUREMENT vEPRBW3 "RAM value vEPRBW3" UBYTE COMP_0004 1 100 0 255 ECU_ADDRESS 0xFFFF3689 READ_WRITE /end MEASUREMENT
/begin MEASUREMENT vEPRBW4 "RAM value vEPRBW4" UBYTE COMP_0004 1 100 0 255 ECU_ADDRESS 0xFFFF368A READ_WRITE /end MEASUREMENT
/begin MEASUREMENT vEPRBW5 "RAM value vEPRBW5" UBYTE COMP_0004 1 100 0 255 ECU_ADDRESS 0xFFFF368B READ_WRITE /end MEASUREMENT
/begin MEASUREMENT vEPRBW6 "RAM value vEPRBW6" UBYTE COMP_0004 1 100 0 255 ECU_ADDRESS 0xFFFF368C READ_WRITE /end MEASUREMENT
/begin MEASUREMENT vEPRBW7 "RAM value vEPRBW7" UBYTE COMP_0004 1 100 0 255 ECU_ADDRESS 0xFFFF368D READ_WRITE /end MEASUREMENT
/begin MEASUREMENT vEPRBWN "RAM value vEPRBWN" UBYTE COMP_0004 1 100 0 255 ECU_ADDRESS 0xFFFF368E READ_WRITE /end MEASUREMENT
/begin MEASUREMENT vEPRS "RAM value vEPRS" UWORD COMP_0039_S 1 100 60000 125535 ECU_ADDRESS 0xFFFF3690 READ_WRITE /end MEASUREMENT
/begin MEASUREMENT vEPRS11R "RAM value vEPRS11R" UWORD COMP_0050 1 100 0 5119.921875 ECU_ADDRESS 0xFFFF2682 READ_WRITE /end MEASUREMENT
/begin MEASUREMENT vEPRS11RV "RAM value vEPRS11RV" UWORD COMP_0050 1 100 0 5119.921875 ECU_ADDRESS 0xFFFF2684 READ_WRITE /end MEASUREMENT
/begin MEASUREMENT vEPRS12R "RAM value vEPRS12R" UWORD COMP_0050 1 100 0 5119.921875 ECU_ADDRESS 0xFFFF2686 READ_WRITE /end MEASUREMENT
/begin MEASUREMENT vEPRS12RV "RAM value vEPRS12RV" UWORD COMP_0050 1 100 0 5119.921875 ECU_ADDRESS 0xFFFF2688 READ_WRITE /end MEASUREMENT
/begin MEASUREMENT vEPRS21 "RAM value vEPRS21" UBYTE COMP_0054 1 100 0 5100 ECU_ADDRESS 0xFFFF0B8E READ_WRITE /end MEASUREMENT
/begin MEASUREMENT vEPRS22 "RAM value vEPRS22" UBYTE COMP_0054 1 100 0 5100 ECU_ADDRESS 0xFFFF0B8F READ_WRITE /end MEASUREMENT
/begin MEASUREMENT vEPSA "RAM value vEPSA" UBYTE COMP_0045_S 1 100 0 255 ECU_ADDRESS 0xFFFF3692 READ_WRITE /end MEASUREMENT
/begin MEASUREMENT vEPSEQN "RAM value vEPSEQN" UBYTE COMP_0414 1 100 0 255 ECU_ADDRESS 0xFFFF268A READ_WRITE /end MEASUREMENT
/begin MEASUREMENT vEPSGS2T "RAM value vEPSGS2T" UBYTE COMP_0014 1 100 0 2550 ECU_ADDRESS 0xFFFF3693 READ_WRITE /end MEASUREMENT
/begin MEASUREMENT vEPWA2B0 "RAM value vEPWA2B0" UWORD COMP_0004 1 100 0 65535 ECU_ADDRESS 0xFFFF3694 READ_WRITE /end MEASUREMENT
/begin MEASUREMENT vEPWA2B1 "RAM value vEPWA2B1" UWORD COMP_0004 1 100 0 65535 ECU_ADDRESS 0xFFFF3696 READ_WRITE /end MEASUREMENT
/begin MEASUREMENT vEPWA2B4 "RAM value vEPWA2B4" UWORD COMP_0004 1 100 0 65535 ECU_ADDRESS 0xFFFF3698 READ_WRITE /end MEASUREMENT
/begin MEASUREMENT vEPWA2B8 "RAM value vEPWA2B8" UWORD COMP_0068 1 100 0 65535 ECU_ADDRESS 0xFFFF369A READ_WRITE /end MEASUREMENT
/begin MEASUREMENT vEPWA2BN "RAM value vEPWA2BN" UWORD COMP_0004 1 100 0 65535 ECU_ADDRESS 0xFFFF369C READ_WRITE /end MEASUREMENT
/begin MEASUREMENT vEPWAW0 "RAM value vEPWAW0" UWORD COMP_0004 1 100 0 65535 ECU_ADDRESS 0xFFFF369E READ_WRITE /end MEASUREMENT
/begin MEASUREMENT vEPWAW1 "RAM value vEPWAW1" UWORD COMP_0004 1 100 0 65535 ECU_ADDRESS 0xFFFF36A0 READ_WRITE /end MEASUREMENT
/begin MEASUREMENT vEPWAW2 "RAM value vEPWAW2" UWORD COMP_0004 1 100 0 65535 ECU_ADDRESS 0xFFFF36A2 READ_WRITE /end MEASUREMENT
/begin MEASUREMENT vEPWAW3 "RAM value vEPWAW3" UWORD COMP_0004 1 100 0 65535 ECU_ADDRESS 0xFFFF36A4 READ_WRITE /end MEASUREMENT
/begin MEASUREMENT vEPWAW4 "RAM value vEPWAW4" UWORD COMP_0004 1 100 0 65535 ECU_ADDRESS 0xFFFF36A6 READ_WRITE /end MEASUREMENT
/begin MEASUREMENT vEPWAW5 "RAM value vEPWAW5" UWORD COMP_0004 1 100 0 65535 ECU_ADDRESS 0xFFFF36A8 READ_WRITE /end MEASUREMENT
/begin MEASUREMENT vEPWAW6 "RAM value vEPWAW6" UWORD COMP_0004 1 100 0 65535 ECU_ADDRESS 0xFFFF36AA READ_WRITE /end MEASUREMENT
/begin MEASUREMENT vEPWAW7 "RAM value vEPWAW7" UWORD COMP_0004 1 100 0 65535 ECU_ADDRESS 0xFFFF36AC READ_WRITE /end MEASUREMENT
/begin MEASUREMENT vEPWAWN "RAM value vEPWAWN" UWORD COMP_0004 1 100 0 65535 ECU_ADDRESS 0xFFFF36AE READ_WRITE /end MEASUREMENT
/begin MEASUREMENT vEPWB2B0 "RAM value vEPWB2B0" UWORD COMP_0004 1 100 0 65535 ECU_ADDRESS 0xFFFF36B0 READ_WRITE /end MEASUREMENT
/begin MEASUREMENT vEPWB2B1 "RAM value vEPWB2B1" UWORD COMP_0004 1 100 0 65535 ECU_ADDRESS 0xFFFF36B2 READ_WRITE /end MEASUREMENT
/begin MEASUREMENT vEPWB2B4 "RAM value vEPWB2B4" UWORD COMP_0004 1 100 0 65535 ECU_ADDRESS 0xFFFF36B4 READ_WRITE /end MEASUREMENT
/begin MEASUREMENT vEPWB2B8 "RAM value vEPWB2B8" UWORD COMP_0068 1 100 0 65535 ECU_ADDRESS 0xFFFF36B6 READ_WRITE /end MEASUREMENT
/begin MEASUREMENT vEPWB2BN "RAM value vEPWB2BN" UWORD COMP_0004 1 100 0 65535 ECU_ADDRESS 0xFFFF36B8 READ_WRITE /end MEASUREMENT
/begin MEASUREMENT vEPWBP7 "RAM value vEPWBP7" UBYTE COMP_0004 1 100 0 255 ECU_ADDRESS 0xFFFF36BA READ_WRITE /end MEASUREMENT
/begin MEASUREMENT vEPWBPN "RAM value vEPWBPN" UBYTE COMP_0004 1 100 0 255 ECU_ADDRESS 0xFFFF36DA READ_WRITE /end MEASUREMENT
/begin MEASUREMENT vEPWBW0 "RAM value vEPWBW0" UBYTE COMP_0004 1 100 0 255 ECU_ADDRESS 0xFFFF36FA READ_WRITE /end MEASUREMENT
/begin MEASUREMENT vEPWBW1 "RAM value vEPWBW1" UBYTE COMP_0004 1 100 0 255 ECU_ADDRESS 0xFFFF36FB READ_WRITE /end MEASUREMENT
/begin MEASUREMENT vEPWBW2 "RAM value vEPWBW2" UBYTE COMP_0004 1 100 0 255 ECU_ADDRESS 0xFFFF36FC READ_WRITE /end MEASUREMENT
/begin MEASUREMENT vEPWBW3 "RAM value vEPWBW3" UBYTE COMP_0004 1 100 0 255 ECU_ADDRESS 0xFFFF36FD READ_WRITE /end MEASUREMENT
/begin MEASUREMENT vEPWBW4 "RAM value vEPWBW4" UBYTE COMP_0004 1 100 0 255 ECU_ADDRESS 0xFFFF36FE READ_WRITE /end MEASUREMENT
/begin MEASUREMENT vEPWBW5 "RAM value vEPWBW5" UBYTE COMP_0004 1 100 0 255 ECU_ADDRESS 0xFFFF36FF READ_WRITE /end MEASUREMENT
/begin MEASUREMENT vEPWBW6 "RAM value vEPWBW6" UBYTE COMP_0004 1 100 0 255 ECU_ADDRESS 0xFFFF3700 READ_WRITE /end MEASUREMENT
/begin MEASUREMENT vEPWBW7 "RAM value vEPWBW7" UBYTE COMP_0004 1 100 0 255 ECU_ADDRESS 0xFFFF3701 READ_WRITE /end MEASUREMENT
/begin MEASUREMENT vEPWBWN "RAM value vEPWBWN" UBYTE COMP_0004 1 100 0 255 ECU_ADDRESS 0xFFFF3702 READ_WRITE /end MEASUREMENT
/begin MEASUREMENT vEPWCNT7 "RAM value vEPWCNT7" UBYTE COMP_0068 1 100 0 255 ECU_ADDRESS 0xFFFF3703 READ_WRITE /end MEASUREMENT
/begin MEASUREMENT vEPWCNTN "RAM value vEPWCNTN" UBYTE COMP_0068 1 100 0 255 ECU_ADDRESS 0xFFFF3704 READ_WRITE /end MEASUREMENT
/begin MEASUREMENT vEQURT "RAM value vEQURT" UBYTE COMP_0044 1 100 0 1.9921875 ECU_ADDRESS 0xFFFF268B READ_WRITE /end MEASUREMENT
/begin MEASUREMENT vERNLGST "RAM value vERNLGST" UBYTE COMP_0283 1 100 0 255 ECU_ADDRESS 0xFFFF268D READ_WRITE /end MEASUREMENT
/begin MEASUREMENT vERQH0 "RAM value vERQH0" SLONG COMP_0415 1 100 -8388608 8388607.99609375 ECU_ADDRESS 0xFFFF1624 READ_WRITE /end MEASUREMENT
/begin MEASUREMENT vERRJOKEf "RAM value vERRJOKEf" UBYTE COMP_0004 1 100 0 255 ECU_ADDRESS 0xFFFF268E READ_WRITE /end MEASUREMENT
/begin MEASUREMENT vERRJOKf "RAM value vERRJOKf" UBYTE COMP_0004 1 100 0 255 ECU_ADDRESS 0xFFFF268F READ_WRITE /end MEASUREMENT
/begin MEASUREMENT vERROR "RAM value vERROR" UBYTE COMP_0256 1 100 -64 63.5 ECU_ADDRESS 0xFFFF0B90 READ_WRITE /end MEASUREMENT
/begin MEASUREMENT vERRORE "RAM value vERRORE" UBYTE COMP_0256 1 100 -64 63.5 ECU_ADDRESS 0xFFFF0B92 READ_WRITE /end MEASUREMENT
/begin MEASUREMENT vERROREf "RAM value vERROREf" UBYTE COMP_0004 1 100 0 255 ECU_ADDRESS 0xFFFF0B94 READ_WRITE /end MEASUREMENT
/begin MEASUREMENT vERRORf "RAM value vERRORf" UBYTE COMP_0004 1 100 0 255 ECU_ADDRESS 0xFFFF0B95 READ_WRITE /end MEASUREMENT
/begin MEASUREMENT vESPCLOCK "RAM value vESPCLOCK" UBYTE COMP_0068 1 100 0 255 ECU_ADDRESS 0xFFFF334E READ_WRITE /end MEASUREMENT
/begin MEASUREMENT vESPTQTYP "RAM value vESPTQTYP" UBYTE COMP_0068 1 100 0 255 ECU_ADDRESS 0xFFFF2040 READ_WRITE /end MEASUREMENT
/begin MEASUREMENT vESTAT "RAM value vESTAT" UBYTE COMP_0004_S 1 100 -50 205 ECU_ADDRESS 0xFFFF2690 READ_WRITE /end MEASUREMENT
/begin MEASUREMENT vESTCT "RAM value vESTCT" UBYTE COMP_0004_S 1 100 -50 205 ECU_ADDRESS 0xFFFF2691 READ_WRITE /end MEASUREMENT
/begin MEASUREMENT vESTCTHR "RAM value vESTCTHR" SLONG COMP_0115_S 1 100 -214748.3648 214748.3647 ECU_ADDRESS 0xFFFF2694 READ_WRITE /end MEASUREMENT
/begin MEASUREMENT vESTTRACE "RAM value vESTTRACE" UBYTE COMP_0245 1 100 -64 191 ECU_ADDRESS 0xFFFF0B96 READ_WRITE /end MEASUREMENT
/begin MEASUREMENT vETHCNT "RAM value vETHCNT" UWORD COMP_0016 1 100 0 65535 ECU_ADDRESS 0xFFFF4688 READ_WRITE /end MEASUREMENT
/begin MEASUREMENT vETLCNT "RAM value vETLCNT" UWORD COMP_0016 1 100 0 65535 ECU_ADDRESS 0xFFFF468A READ_WRITE /end MEASUREMENT
/begin MEASUREMENT vETLDIAG "RAM value vETLDIAG" UBYTE COMP_0004 1 100 0 255 ECU_ADDRESS 0xFFFF3B5A READ_WRITE /end MEASUREMENT
/begin MEASUREMENT vETNL "RAM value vETNL" UBYTE COMP_0047 1 100 0 127.5 ECU_ADDRESS 0xFFFF5132 READ_WRITE /end MEASUREMENT
/begin MEASUREMENT vETQETSC "RAM value vETQETSC" SWORD COMP_0228 1 100 -3276.8 3276.7 ECU_ADDRESS 0xFFFF2042 READ_WRITE /end MEASUREMENT
/begin MEASUREMENT vETRFUEL "RAM value vETRFUEL" UBYTE COMP_0016 1 100 0 255 ECU_ADDRESS 0xFFFF5133 READ_WRITE /end MEASUREMENT
/begin MEASUREMENT vETSCLOCK "RAM value vETSCLOCK" UBYTE COMP_0068 1 100 0 255 ECU_ADDRESS 0xFFFF334F READ_WRITE /end MEASUREMENT
/begin MEASUREMENT vETSTQCTT "RAM value vETSTQCTT" UBYTE COMP_0014 1 100 0 2550 ECU_ADDRESS 0xFFFF2044 READ_WRITE /end MEASUREMENT
/begin MEASUREMENT vEVALPH "RAM value vEVALPH" UWORD COMP_0031 1 100 0 255.99609375 ECU_ADDRESS 0xFFFF0B98 READ_WRITE /end MEASUREMENT
/begin MEASUREMENT vEVAPCNT "RAM value vEVAPCNT" UBYTE COMP_0016 1 100 0 255 ECU_ADDRESS 0xFFFF172B READ_WRITE /end MEASUREMENT
/begin MEASUREMENT vEVAPLO "RAM value vEVAPLO" UWORD COMP_0189 1 100 0 209712 ECU_ADDRESS 0xFFFF2698 READ_WRITE /end MEASUREMENT
/begin MEASUREMENT vEVATMP "RAM value vEVATMP" UBYTE COMP_0548_S 1 100 -30 54.9999915 ECU_ADDRESS 0xFFFF1628 READ_WRITE /end MEASUREMENT
/begin MEASUREMENT vEVCNTIN "RAM value vEVCNTIN" UWORD COMP_0156 1 100 0 65535 ECU_ADDRESS 0xFFFF269A READ_WRITE /end MEASUREMENT
/begin MEASUREMENT vEVCRAMP "RAM value vEVCRAMP" UWORD COMP_0549_S 1 100 0 511.9921875 ECU_ADDRESS 0xFFFF269C READ_WRITE /end MEASUREMENT
/begin MEASUREMENT vEVCRAMP1 "RAM value vEVCRAMP1" UWORD COMP_0549_S 1 100 0 511.9921875 ECU_ADDRESS 0xFFFF269E READ_WRITE /end MEASUREMENT
/begin MEASUREMENT vEVKPMN "RAM value vEVKPMN" UBYTE COMP_0047 1 100 0 127.5 ECU_ADDRESS 0xFFFF468C READ_WRITE /end MEASUREMENT
/begin MEASUREMENT vEVLKMI2 "RAM value vEVLKMI2" UWORD COMP_0050 1 100 0 5119.921875 ECU_ADDRESS 0xFFFF26A0 READ_WRITE /end MEASUREMENT
/begin MEASUREMENT vEVLKMN "RAM value vEVLKMN" UWORD COMP_0050 1 100 0 5119.921875 ECU_ADDRESS 0xFFFF26A2 READ_WRITE /end MEASUREMENT
/begin MEASUREMENT vEVLKMN1 "RAM value vEVLKMN1" UWORD COMP_0050 1 100 0 5119.921875 ECU_ADDRESS 0xFFFF26A4 READ_WRITE /end MEASUREMENT
/begin MEASUREMENT vEVLKMN2 "RAM value vEVLKMN2" UWORD COMP_0050 1 100 0 5119.921875 ECU_ADDRESS 0xFFFF26A6 READ_WRITE /end MEASUREMENT
/begin MEASUREMENT vEVLKMNX "RAM value vEVLKMNX" UWORD COMP_0050 1 100 0 5119.921875 ECU_ADDRESS 0xFFFF26A8 READ_WRITE /end MEASUREMENT
/begin MEASUREMENT vEVLNZ2 "RAM value vEVLNZ2" UWORD COMP_0050 1 100 0 5119.921875 ECU_ADDRESS 0xFFFF26AA READ_WRITE /end MEASUREMENT
/begin MEASUREMENT vEVMNS2 "RAM value vEVMNS2" UWORD COMP_0050 1 100 0 5119.921875 ECU_ADDRESS 0xFFFF0B9C READ_WRITE /end MEASUREMENT
/begin MEASUREMENT vEVMNS3 "RAM value vEVMNS3" UBYTE COMP_0054 1 100 0 5100 ECU_ADDRESS 0xFFFF26D2 READ_WRITE /end MEASUREMENT
/begin MEASUREMENT vEVOFST "RAM value vEVOFST" SWORD COMP_0416 1 100 -262144 262136 ECU_ADDRESS 0xFFFF172C READ_WRITE /end MEASUREMENT
/begin MEASUREMENT vEVOUTT "RAM value vEVOUTT" UWORD COMP_0417 1 100 0 524280 ECU_ADDRESS 0xFFFF172E READ_WRITE /end MEASUREMENT
/begin MEASUREMENT vEVP100MC "RAM value vEVP100MC" UBYTE COMP_0054 1 100 0 5100 ECU_ADDRESS 0xFFFF0B9E READ_WRITE /end MEASUREMENT
/begin MEASUREMENT vEVP100MP "RAM value vEVP100MP" UBYTE COMP_0054 1 100 0 5100 ECU_ADDRESS 0xFFFF0B9F READ_WRITE /end MEASUREMENT
/begin MEASUREMENT vEVP2 "RAM value vEVP2" UBYTE COMP_0054 1 100 0 5100 ECU_ADDRESS 0xFFFF26D3 READ_WRITE /end MEASUREMENT
/begin MEASUREMENT vEVP3 "RAM value vEVP3" UBYTE COMP_0054 1 100 0 5100 ECU_ADDRESS 0xFFFF26D4 READ_WRITE /end MEASUREMENT
/begin MEASUREMENT vEVP3DY "RAM value vEVP3DY" UBYTE COMP_0008 1 100 0 25500 ECU_ADDRESS 0xFFFF26D5 READ_WRITE /end MEASUREMENT
/begin MEASUREMENT vEVP4 "RAM value vEVP4" UBYTE COMP_0054 1 100 0 5100 ECU_ADDRESS 0xFFFF26D6 READ_WRITE /end MEASUREMENT
/begin MEASUREMENT vEVP4DYA "RAM value vEVP4DYA" UBYTE COMP_0049 1 100 0 255 ECU_ADDRESS 0xFFFF26D7 READ_WRITE /end MEASUREMENT
/begin MEASUREMENT vEVPCNT "RAM value vEVPCNT" ULONG COMP_0160 1 100 0 131072.093921892 ECU_ADDRESS 0xFFFF4690 READ_WRITE /end MEASUREMENT
/begin MEASUREMENT vEVPIMR "RAM value vEVPIMR" UBYTE COMP_0004 1 100 0 255 ECU_ADDRESS 0xFFFF4694 READ_WRITE /end MEASUREMENT
/begin MEASUREMENT vEVPION "RAM value vEVPION" UWORD COMP_0418 1 100 0 163837.5 ECU_ADDRESS 0xFFFF1730 READ_WRITE /end MEASUREMENT
/begin MEASUREMENT vEVPKOF "RAM value vEVPKOF" UBYTE COMP_0054 1 100 0 5100 ECU_ADDRESS 0xFFFF4695 READ_WRITE /end MEASUREMENT
/begin MEASUREMENT vEVPMON "RAM value vEVPMON" UBYTE COMP_0004 1 100 0 255 ECU_ADDRESS 0xFFFF26D8 READ_WRITE /end MEASUREMENT
/begin MEASUREMENT vEVPMON2 "RAM value vEVPMON2" UBYTE COMP_0004 1 100 0 255 ECU_ADDRESS 0xFFFF26D9 READ_WRITE /end MEASUREMENT
/begin MEASUREMENT vEVPMON3 "RAM value vEVPMON3" UBYTE COMP_0068 1 100 0 255 ECU_ADDRESS 0xFFFF26DA READ_WRITE /end MEASUREMENT
/begin MEASUREMENT vEVPOUT "RAM value vEVPOUT" UWORD COMP_0417 1 100 0 524280 ECU_ADDRESS 0xFFFF1732 READ_WRITE /end MEASUREMENT
/begin MEASUREMENT vEVPOUTM "RAM value vEVPOUTM" UWORD COMP_0004 1 100 0 65535 ECU_ADDRESS 0xFFFF0BA0 READ_WRITE /end MEASUREMENT
/begin MEASUREMENT vEVPOVF "RAM value vEVPOVF" UBYTE COMP_0004 1 100 0 255 ECU_ADDRESS 0xFFFF0BA2 READ_WRITE /end MEASUREMENT
/begin MEASUREMENT vEVPR "RAM value vEVPR" UWORD COMP_0418 1 100 0 163837.5 ECU_ADDRESS 0xFFFF1734 READ_WRITE /end MEASUREMENT
/begin MEASUREMENT vEVPRES "RAM value vEVPRES" UWORD COMP_0050 1 100 0 5119.921875 ECU_ADDRESS 0xFFFF08D4 READ_WRITE /end MEASUREMENT
/begin MEASUREMENT vEVPRES1S "RAM value vEVPRES1S" UWORD COMP_0039_S 1 100 60000 125535 ECU_ADDRESS 0xFFFF3706 READ_WRITE /end MEASUREMENT
/begin MEASUREMENT vEVPRES2 "RAM value vEVPRES2" UWORD COMP_0050 1 100 0 5119.921875 ECU_ADDRESS 0xFFFF08D6 READ_WRITE /end MEASUREMENT
/begin MEASUREMENT vEVPS "RAM value vEVPS" UBYTE COMP_0047 1 100 0 127.5 ECU_ADDRESS 0xFFFF3B5B READ_WRITE /end MEASUREMENT
/begin MEASUREMENT vEVPSM "RAM value vEVPSM" UWORD COMP_0470_S 1 100 0 1638.375 ECU_ADDRESS 0xFFFF1B28 READ_WRITE /end MEASUREMENT
/begin MEASUREMENT vEVPSMAX "RAM value vEVPSMAX" UBYTE COMP_0047 1 100 0 127.5 ECU_ADDRESS 0xFFFF0952 READ_WRITE /end MEASUREMENT
/begin MEASUREMENT vEVPSMX "RAM value vEVPSMX" UBYTE COMP_0047 1 100 0 127.5 ECU_ADDRESS 0xFFFF0BA3 READ_WRITE /end MEASUREMENT
/begin MEASUREMENT vEVPSTS "RAM value vEVPSTS" UBYTE COMP_0004 1 100 0 255 ECU_ADDRESS 0xFFFF26DB READ_WRITE /end MEASUREMENT
/begin MEASUREMENT vEVPTR "RAM value vEVPTR" UBYTE COMP_0158 1 100 0 15.9375 ECU_ADDRESS 0xFFFF26DC READ_WRITE /end MEASUREMENT
/begin MEASUREMENT vEVSCNT "RAM value vEVSCNT" UWORD COMP_0016 1 100 0 65535 ECU_ADDRESS 0xFFFF4696 READ_WRITE /end MEASUREMENT
/begin MEASUREMENT vEVTFNL "RAM value vEVTFNL" UBYTE COMP_0035 1 100 -50 205 ECU_ADDRESS 0xFFFF26DD READ_WRITE /end MEASUREMENT
/begin MEASUREMENT vEWDAT_M "RAM value vEWDAT_M" UWORD COMP_0004 1 100 0 65535 ECU_ADDRESS 0xFFFF26DE READ_WRITE /end MEASUREMENT
/begin MEASUREMENT vEXNGCT "RAM value vEXNGCT" UBYTE COMP_0030 1 100 0 255 ECU_ADDRESS 0xFFFF26E2 READ_WRITE /end MEASUREMENT
/begin MEASUREMENT vFAC "RAM value vFAC" UWORD COMP_0550_S 1 100 0 31.999495335 ECU_ADDRESS 0xFFFF0BA4 READ_WRITE /end MEASUREMENT
/begin MEASUREMENT vFACFLG "RAM value vFACFLG" UWORD COMP_0068 1 100 0 65535 ECU_ADDRESS 0xFFFF4EAC READ_WRITE /end MEASUREMENT
/begin MEASUREMENT vFACTTW "RAM value vFACTTW" UBYTE COMP_0068 1 100 0 255 ECU_ADDRESS 0xFFFF4EAE READ_WRITE /end MEASUREMENT
/begin MEASUREMENT vFACTVDGN "RAM value vFACTVDGN" UBYTE COMP_0068 1 100 0 255 ECU_ADDRESS 0xFFFF0BA8 READ_WRITE /end MEASUREMENT
/begin MEASUREMENT vFADV "RAM value vFADV" UBYTE COMP_0017 1 100 0 255 ECU_ADDRESS 0xFFFF0953 READ_WRITE /end MEASUREMENT
/begin MEASUREMENT vFADV1CYL "RAM value vFADV1CYL" UBYTE COMP_0017 1 100 0 255 ECU_ADDRESS 0xFFFF1736 READ_WRITE /end MEASUREMENT
/begin MEASUREMENT vFAFAVNG1f "RAM value vFAFAVNG1f" UBYTE COMP_0004 1 100 0 255 ECU_ADDRESS 0xFFFF4698 READ_WRITE /end MEASUREMENT
/begin MEASUREMENT vFAFAVNG2f "RAM value vFAFAVNG2f" UBYTE COMP_0004 1 100 0 255 ECU_ADDRESS 0xFFFF4699 READ_WRITE /end MEASUREMENT
/begin MEASUREMENT vFAFAVOKf "RAM value vFAFAVOKf" UBYTE COMP_0004 1 100 0 255 ECU_ADDRESS 0xFFFF469A READ_WRITE /end MEASUREMENT
/begin MEASUREMENT vFAFHCNf "RAM value vFAFHCNf" UBYTE COMP_0004 1 100 0 255 ECU_ADDRESS 0xFFFF26E9 READ_WRITE /end MEASUREMENT
/begin MEASUREMENT vFAFHFALf "RAM value vFAFHFALf" UBYTE COMP_0004 1 100 0 255 ECU_ADDRESS 0xFFFF1629 READ_WRITE /end MEASUREMENT
/begin MEASUREMENT vFAFHMAXf "RAM value vFAFHMAXf" UBYTE COMP_0004 1 100 0 255 ECU_ADDRESS 0xFFFF26EA READ_WRITE /end MEASUREMENT
/begin MEASUREMENT vFAFHMINf "RAM value vFAFHMINf" UBYTE COMP_0004 1 100 0 255 ECU_ADDRESS 0xFFFF26EB READ_WRITE /end MEASUREMENT
/begin MEASUREMENT vFAFHMLOKf "RAM value vFAFHMLOKf" UBYTE COMP_0004 1 100 0 255 ECU_ADDRESS 0xFFFF26EC READ_WRITE /end MEASUREMENT
/begin MEASUREMENT vFAFHNG1f "RAM value vFAFHNG1f" UBYTE COMP_0004 1 100 0 255 ECU_ADDRESS 0xFFFF469B READ_WRITE /end MEASUREMENT
/begin MEASUREMENT vFAFHNG2f "RAM value vFAFHNG2f" UBYTE COMP_0004 1 100 0 255 ECU_ADDRESS 0xFFFF469C READ_WRITE /end MEASUREMENT
/begin MEASUREMENT vFAFHOK2f "RAM value vFAFHOK2f" UBYTE COMP_0004 1 100 0 255 ECU_ADDRESS 0xFFFF469D READ_WRITE /end MEASUREMENT
/begin MEASUREMENT vFAFHZNG1f "RAM value vFAFHZNG1f" UBYTE COMP_0004 1 100 0 255 ECU_ADDRESS 0xFFFF469E READ_WRITE /end MEASUREMENT
/begin MEASUREMENT vFAFHZNG2f "RAM value vFAFHZNG2f" UBYTE COMP_0004 1 100 0 255 ECU_ADDRESS 0xFFFF469F READ_WRITE /end MEASUREMENT
/begin MEASUREMENT vFAFHZOKf "RAM value vFAFHZOKf" UBYTE COMP_0004 1 100 0 255 ECU_ADDRESS 0xFFFF46A0 READ_WRITE /end MEASUREMENT
/begin MEASUREMENT vFAFLMTf "RAM value vFAFLMTf" UBYTE COMP_0004 1 100 0 255 ECU_ADDRESS 0xFFFF26ED READ_WRITE /end MEASUREMENT
/begin MEASUREMENT vFAFLNG1f "RAM value vFAFLNG1f" UBYTE COMP_0004 1 100 0 255 ECU_ADDRESS 0xFFFF46A1 READ_WRITE /end MEASUREMENT
/begin MEASUREMENT vFAFLNG2f "RAM value vFAFLNG2f" UBYTE COMP_0004 1 100 0 255 ECU_ADDRESS 0xFFFF46A2 READ_WRITE /end MEASUREMENT
/begin MEASUREMENT vFAFLROKf "RAM value vFAFLROKf" UBYTE COMP_0004 1 100 0 255 ECU_ADDRESS 0xFFFF46A3 READ_WRITE /end MEASUREMENT
/begin MEASUREMENT vFAFMLOKf "RAM value vFAFMLOKf" UBYTE COMP_0004 1 100 0 255 ECU_ADDRESS 0xFFFF26EE READ_WRITE /end MEASUREMENT
/begin MEASUREMENT vFAFOK2f "RAM value vFAFOK2f" UBYTE COMP_0004 1 100 0 255 ECU_ADDRESS 0xFFFF46A4 READ_WRITE /end MEASUREMENT
/begin MEASUREMENT vFAFONG1f "RAM value vFAFONG1f" UBYTE COMP_0004 1 100 0 255 ECU_ADDRESS 0xFFFF46A5 READ_WRITE /end MEASUREMENT
/begin MEASUREMENT vFAFONG2f "RAM value vFAFONG2f" UBYTE COMP_0004 1 100 0 255 ECU_ADDRESS 0xFFFF46A6 READ_WRITE /end MEASUREMENT
/begin MEASUREMENT vFAFRLOKf "RAM value vFAFRLOKf" UBYTE COMP_0004 1 100 0 255 ECU_ADDRESS 0xFFFF46A7 READ_WRITE /end MEASUREMENT
/begin MEASUREMENT vFAFRNG1f "RAM value vFAFRNG1f" UBYTE COMP_0004 1 100 0 255 ECU_ADDRESS 0xFFFF46A8 READ_WRITE /end MEASUREMENT
/begin MEASUREMENT vFAFRNG2f "RAM value vFAFRNG2f" UBYTE COMP_0004 1 100 0 255 ECU_ADDRESS 0xFFFF46A9 READ_WRITE /end MEASUREMENT
/begin MEASUREMENT vFAFRVNG1f "RAM value vFAFRVNG1f" UBYTE COMP_0004 1 100 0 255 ECU_ADDRESS 0xFFFF46AA READ_WRITE /end MEASUREMENT
/begin MEASUREMENT vFAFRVNG2f "RAM value vFAFRVNG2f" UBYTE COMP_0004 1 100 0 255 ECU_ADDRESS 0xFFFF46AB READ_WRITE /end MEASUREMENT
/begin MEASUREMENT vFAFSACTf "RAM value vFAFSACTf" UBYTE COMP_0004 1 100 0 255 ECU_ADDRESS 0xFFFF2045 READ_WRITE /end MEASUREMENT
/begin MEASUREMENT vFANAC "RAM value vFANAC" UBYTE COMP_0027 1 100 0 255 ECU_ADDRESS 0xFFFF26EF READ_WRITE /end MEASUREMENT
/begin MEASUREMENT vFANACMAX "RAM value vFANACMAX" UBYTE COMP_0027 1 100 0 255 ECU_ADDRESS 0xFFFF26F0 READ_WRITE /end MEASUREMENT
/begin MEASUREMENT vFANBASE "RAM value vFANBASE" UBYTE COMP_0027 1 100 0 255 ECU_ADDRESS 0xFFFF26F1 READ_WRITE /end MEASUREMENT
/begin MEASUREMENT vFANITC1 "RAM value vFANITC1" UBYTE COMP_0009 1 100 0 199.21875 ECU_ADDRESS 0xFFFF0BA9 READ_WRITE /end MEASUREMENT
/begin MEASUREMENT vFANITC2 "RAM value vFANITC2" UBYTE COMP_0009 1 100 0 199.21875 ECU_ADDRESS 0xFFFF0BAA READ_WRITE /end MEASUREMENT
/begin MEASUREMENT vFANITC3 "RAM value vFANITC3" UBYTE COMP_0009 1 100 0 199.21875 ECU_ADDRESS 0xFFFF0BAB READ_WRITE /end MEASUREMENT
/begin MEASUREMENT vFANTW "RAM value vFANTW" UBYTE COMP_0027 1 100 0 255 ECU_ADDRESS 0xFFFF26F2 READ_WRITE /end MEASUREMENT
/begin MEASUREMENT vFBDUTY "RAM value vFBDUTY" UWORD COMP_0419 1 100 0 6553.5 ECU_ADDRESS 0xFFFF3708 READ_WRITE /end MEASUREMENT
/begin MEASUREMENT vFBGAIN1 "RAM value vFBGAIN1" SWORD COMP_0195_S 1 100 -3276.8 3276.7 ECU_ADDRESS 0xFFFF0BAC READ_WRITE /end MEASUREMENT
/begin MEASUREMENT vFBIMFWG "RAM value vFBIMFWG" SWORD COMP_0551_S 1 100 -0.262144 0.262136 ECU_ADDRESS 0xFFFF26F4 READ_WRITE /end MEASUREMENT
/begin MEASUREMENT vFBITLIM "RAM value vFBITLIM" UWORD COMP_0308_S 1 100 0 0.52428 ECU_ADDRESS 0xFFFF26F6 READ_WRITE /end MEASUREMENT
/begin MEASUREMENT vFBKS "RAM value vFBKS" UBYTE COMP_0044 1 100 0 1.9921875 ECU_ADDRESS 0xFFFF26F8 READ_WRITE /end MEASUREMENT
/begin MEASUREMENT vFBLMT1 "RAM value vFBLMT1" UWORD COMP_0005 1 100 0 7208.85 ECU_ADDRESS 0xFFFF26FA READ_WRITE /end MEASUREMENT
/begin MEASUREMENT vFBMFWG "RAM value vFBMFWG" SWORD COMP_0551_S 1 100 -0.262144 0.262136 ECU_ADDRESS 0xFFFF26FC READ_WRITE /end MEASUREMENT
/begin MEASUREMENT vFBNGTM "RAM value vFBNGTM" UBYTE COMP_0015_S 1 100 0 25.5 ECU_ADDRESS 0xFFFF26FE READ_WRITE /end MEASUREMENT
/begin MEASUREMENT vFBPMFWG "RAM value vFBPMFWG" SWORD COMP_0551_S 1 100 -0.262144 0.262136 ECU_ADDRESS 0xFFFF2700 READ_WRITE /end MEASUREMENT
/begin MEASUREMENT vFBSTAN "RAM value vFBSTAN" UBYTE COMP_0068 1 100 0 255 ECU_ADDRESS 0xFFFF1737 READ_WRITE /end MEASUREMENT
/begin MEASUREMENT vFCADV "RAM value vFCADV" UWORD COMP_0081 1 100 0 255.99609375 ECU_ADDRESS 0xFFFF1B2A READ_WRITE /end MEASUREMENT
/begin MEASUREMENT vFCAFHZFf "RAM value vFCAFHZFf" UBYTE COMP_0004 1 100 0 255 ECU_ADDRESS 0xFFFF0BAF READ_WRITE /end MEASUREMENT
/begin MEASUREMENT vFCAFHZf "RAM value vFCAFHZf" UBYTE COMP_0004 1 100 0 255 ECU_ADDRESS 0xFFFF0BAE READ_WRITE /end MEASUREMENT
/begin MEASUREMENT vFCAT1IMR "RAM value vFCAT1IMR" UBYTE COMP_0004 1 100 0 255 ECU_ADDRESS 0xFFFF2702 READ_WRITE /end MEASUREMENT
/begin MEASUREMENT vFCAT2IMR "RAM value vFCAT2IMR" UBYTE COMP_0004 1 100 0 255 ECU_ADDRESS 0xFFFF2703 READ_WRITE /end MEASUREMENT
/begin MEASUREMENT vFCATD "RAM value vFCATD" UBYTE COMP_0004 1 100 0 255 ECU_ADDRESS 0xFFFF2704 READ_WRITE /end MEASUREMENT
/begin MEASUREMENT vFCATDf "RAM value vFCATDf" UBYTE COMP_0004 1 100 0 255 ECU_ADDRESS 0xFFFF2706 READ_WRITE /end MEASUREMENT
/begin MEASUREMENT vFCATE "RAM value vFCATE" UBYTE COMP_0189_S 1 100 0 84.999999915 ECU_ADDRESS 0xFFFF2707 READ_WRITE /end MEASUREMENT
/begin MEASUREMENT vFCATLIM "RAM value vFCATLIM" UBYTE COMP_0189_S 1 100 0 84.999999915 ECU_ADDRESS 0xFFFF0BB0 READ_WRITE /end MEASUREMENT
/begin MEASUREMENT vFCCUPDf "RAM value vFCCUPDf" UBYTE COMP_0004 1 100 0 255 ECU_ADDRESS 0xFFFF2708 READ_WRITE /end MEASUREMENT
/begin MEASUREMENT vFCDT1 "RAM value vFCDT1" UBYTE COMP_0014 1 100 0 2550 ECU_ADDRESS 0xFFFF0BB1 READ_WRITE /end MEASUREMENT
/begin MEASUREMENT vFCDT2 "RAM value vFCDT2" UBYTE COMP_0014 1 100 0 2550 ECU_ADDRESS 0xFFFF0BB2 READ_WRITE /end MEASUREMENT
/begin MEASUREMENT vFCGEAR "RAM value vFCGEAR" UBYTE COMP_0068 1 100 0 255 ECU_ADDRESS 0xFFFF2709 READ_WRITE /end MEASUREMENT
/begin MEASUREMENT vFCLK "RAM value vFCLK" UBYTE COMP_0122_S 1 100 35 1310 ECU_ADDRESS 0xFFFF370A READ_WRITE /end MEASUREMENT
/begin MEASUREMENT vFCMOD "RAM value vFCMOD" UBYTE COMP_0251 1 100 0 255 ECU_ADDRESS 0xFFFF2106 READ_WRITE /end MEASUREMENT
/begin MEASUREMENT vFCRCLPf "RAM value vFCRCLPf" UBYTE COMP_0004 1 100 0 255 ECU_ADDRESS 0xFFFF0BB3 READ_WRITE /end MEASUREMENT
/begin MEASUREMENT vFCRETPI "RAM value vFCRETPI" UBYTE COMP_0063 1 100 0 0.99609375 ECU_ADDRESS 0xFFFF0BB4 READ_WRITE /end MEASUREMENT
/begin MEASUREMENT vFCTCS "RAM value vFCTCS" UBYTE COMP_0251 1 100 0 255 ECU_ADDRESS 0xFFFF270A READ_WRITE /end MEASUREMENT
/begin MEASUREMENT vFCUT "RAM value vFCUT" UBYTE COMP_0068 1 100 0 255 ECU_ADDRESS 0xFFFF2107 READ_WRITE /end MEASUREMENT
/begin MEASUREMENT vFCUTCNT "RAM value vFCUTCNT" UWORD COMP_0040_S 1 100 0 655.35 ECU_ADDRESS 0xFFFF270C READ_WRITE /end MEASUREMENT
/begin MEASUREMENT vFCUTRCVf "RAM value vFCUTRCVf" UBYTE COMP_0004 1 100 0 255 ECU_ADDRESS 0xFFFF3B5C READ_WRITE /end MEASUREMENT
/begin MEASUREMENT vFCYLADV "RAM value vFCYLADV" UBYTE COMP_0283 1 100 0 255 ECU_ADDRESS 0xFFFF46AC READ_WRITE /end MEASUREMENT
/begin MEASUREMENT vFCYLSTP "RAM value vFCYLSTP" UBYTE COMP_0283 1 100 0 255 ECU_ADDRESS 0xFFFF0BB5 READ_WRITE /end MEASUREMENT
/begin MEASUREMENT vFDADST "RAM value vFDADST" UBYTE COMP_0004 1 100 0 255 ECU_ADDRESS 0xFFFF270E READ_WRITE /end MEASUREMENT
/begin MEASUREMENT vFDEXP "RAM value vFDEXP" UWORD COMP_0552_S 1 100 0 1310.7 ECU_ADDRESS 0xFFFF2710 READ_WRITE /end MEASUREMENT
/begin MEASUREMENT vFDGNNG "RAM value vFDGNNG" UBYTE COMP_0068 1 100 0 255 ECU_ADDRESS 0xFFFF0BB6 READ_WRITE /end MEASUREMENT
/begin MEASUREMENT vFDITHEREf "RAM value vFDITHEREf" UBYTE COMP_0004 1 100 0 255 ECU_ADDRESS 0xFFFF0BB7 READ_WRITE /end MEASUREMENT
/begin MEASUREMENT vFDITHERf "RAM value vFDITHERf" UBYTE COMP_0004 1 100 0 255 ECU_ADDRESS 0xFFFF0BB8 READ_WRITE /end MEASUREMENT
/begin MEASUREMENT vFDMNUM "RAM value vFDMNUM" UBYTE COMP_0004 1 100 0 255 ECU_ADDRESS 0xFFFF2712 READ_WRITE /end MEASUREMENT
/begin MEASUREMENT vFDRDDT "RAM value vFDRDDT" UWORD COMP_0004 1 100 0 65535 ECU_ADDRESS 0xFFFF2714 READ_WRITE /end MEASUREMENT
/begin MEASUREMENT vFDRQBF "RAM value vFDRQBF" UBYTE COMP_0004 1 100 0 255 ECU_ADDRESS 0xFFFF2716 READ_WRITE /end MEASUREMENT
/begin MEASUREMENT vFDRWC2 "RAM value vFDRWC2" UBYTE COMP_0016 1 100 0 255 ECU_ADDRESS 0xFFFF2717 READ_WRITE /end MEASUREMENT
/begin MEASUREMENT vFDRWCNT_M "RAM value vFDRWCNT_M" UBYTE COMP_0016 1 100 0 255 ECU_ADDRESS 0xFFFF2718 READ_WRITE /end MEASUREMENT
/begin MEASUREMENT vFDRWCT "RAM value vFDRWCT" UBYTE COMP_0016 1 100 0 255 ECU_ADDRESS 0xFFFF2719 READ_WRITE /end MEASUREMENT
/begin MEASUREMENT vFDTYUP "RAM value vFDTYUP" UBYTE COMP_0027 1 100 0 255 ECU_ADDRESS 0xFFFF271A READ_WRITE /end MEASUREMENT
/begin MEASUREMENT vFDV80A "RAM value vFDV80A" UBYTE COMP_0016 1 100 0 255 ECU_ADDRESS 0xFFFF46AD READ_WRITE /end MEASUREMENT
/begin MEASUREMENT vFDV80B "RAM value vFDV80B" UBYTE COMP_0016 1 100 0 255 ECU_ADDRESS 0xFFFF46AE READ_WRITE /end MEASUREMENT
/begin MEASUREMENT vFDV80C "RAM value vFDV80C" UBYTE COMP_0016 1 100 0 255 ECU_ADDRESS 0xFFFF46AF READ_WRITE /end MEASUREMENT
/begin MEASUREMENT vFDWOFS "RAM value vFDWOFS" UBYTE COMP_0004 1 100 0 255 ECU_ADDRESS 0xFFFF271B READ_WRITE /end MEASUREMENT
/begin MEASUREMENT vFEMDNO "RAM value vFEMDNO" UBYTE COMP_0068 1 100 0 255 ECU_ADDRESS 0xFFFF271C READ_WRITE /end MEASUREMENT
/begin MEASUREMENT vFEVPIMR "RAM value vFEVPIMR" UBYTE COMP_0004 1 100 0 255 ECU_ADDRESS 0xFFFF271D READ_WRITE /end MEASUREMENT
/begin MEASUREMENT vFEVPOK "RAM value vFEVPOK" UBYTE COMP_0004 1 100 0 255 ECU_ADDRESS 0xFFFF271E READ_WRITE /end MEASUREMENT
/begin MEASUREMENT vFEVPOK2 "RAM value vFEVPOK2" UBYTE COMP_0004 1 100 0 255 ECU_ADDRESS 0xFFFF271F READ_WRITE /end MEASUREMENT
/begin MEASUREMENT vFFADAFSF "RAM value vFFADAFSF" UWORD COMP_0471_S 1 100 0 7.99527 ECU_ADDRESS 0xFFFF5134 READ_WRITE /end MEASUREMENT
/begin MEASUREMENT vFFADV "RAM value vFFADV" UBYTE COMP_0472_S 1 100 -64 63.5 ECU_ADDRESS 0xFFFF46B0 READ_WRITE /end MEASUREMENT
/begin MEASUREMENT vFFADVC "RAM value vFFADVC" UBYTE COMP_0472_S 1 100 -64 63.5 ECU_ADDRESS 0xFFFF5138 READ_WRITE /end MEASUREMENT
/begin MEASUREMENT vFFAFSAF "RAM value vFFAFSAF" UWORD COMP_0327 1 100 0 1.9988175 ECU_ADDRESS 0xFFFF513A READ_WRITE /end MEASUREMENT
/begin MEASUREMENT vFFAHOS "RAM value vFFAHOS" SWORD COMP_0020_S 1 100 -65.536 65.534 ECU_ADDRESS 0xFFFF46B2 READ_WRITE /end MEASUREMENT
/begin MEASUREMENT vFFALP "RAM value vFFALP" UBYTE COMP_0117 1 100 -100 99.21875 ECU_ADDRESS 0xFFFF513E READ_WRITE /end MEASUREMENT
/begin MEASUREMENT vFFALPC "RAM value vFFALPC" UBYTE COMP_0117 1 100 -100 99.21875 ECU_ADDRESS 0xFFFF5140 READ_WRITE /end MEASUREMENT
/begin MEASUREMENT vFFAPS1OF "RAM value vFFAPS1OF" UBYTE COMP_0378 1 100 0 100.000000065 ECU_ADDRESS 0xFFFF5142 READ_WRITE /end MEASUREMENT
/begin MEASUREMENT vFFAPS2OF "RAM value vFFAPS2OF" UBYTE COMP_0378 1 100 0 100.000000065 ECU_ADDRESS 0xFFFF5143 READ_WRITE /end MEASUREMENT
/begin MEASUREMENT vFFAVEPF "RAM value vFFAVEPF" UWORD COMP_0473_S 1 100 0 655350 ECU_ADDRESS 0xFFFF5144 READ_WRITE /end MEASUREMENT
/begin MEASUREMENT vFFBST "RAM value vFFBST" UBYTE COMP_0424 1 100 0 255 ECU_ADDRESS 0xFFFF5146 READ_WRITE /end MEASUREMENT
/begin MEASUREMENT vFFCLRDST "RAM value vFFCLRDST" UWORD COMP_0470 1 100 0 65535 ECU_ADDRESS 0xFFFF5148 READ_WRITE /end MEASUREMENT
/begin MEASUREMENT vFFCLTIME "RAM value vFFCLTIME" UWORD COMP_0467_S 1 100 0 65535 ECU_ADDRESS 0xFFFF514A READ_WRITE /end MEASUREMENT
/begin MEASUREMENT vFFCLV "RAM value vFFCLV" UBYTE COMP_0425 1 100 0 99.99999981 ECU_ADDRESS 0xFFFF514C READ_WRITE /end MEASUREMENT
/begin MEASUREMENT vFFCODE "RAM value vFFCODE" UWORD COMP_0426 1 100 0 65535 ECU_ADDRESS 0xFFFF514E READ_WRITE /end MEASUREMENT
/begin MEASUREMENT vFFDGN "RAM value vFFDGN" UBYTE COMP_0068 1 100 0 255 ECU_ADDRESS 0xFFFF5150 READ_WRITE /end MEASUREMENT
/begin MEASUREMENT vFFDGND "RAM value vFFDGND" UBYTE COMP_0068 1 100 0 255 ECU_ADDRESS 0xFFFF5151 READ_WRITE /end MEASUREMENT
/begin MEASUREMENT vFFDRD "RAM value vFFDRD" UBYTE COMP_0004 1 100 0 255 ECU_ADDRESS 0xFFFF2720 READ_WRITE /end MEASUREMENT
/begin MEASUREMENT vFFDSRM "RAM value vFFDSRM" UBYTE COMP_0053 1 100 0 255 ECU_ADDRESS 0xFFFF370C READ_WRITE /end MEASUREMENT
/begin MEASUREMENT vFFDSTON "RAM value vFFDSTON" UBYTE COMP_0016 1 100 0 255 ECU_ADDRESS 0xFFFF4EB0 READ_WRITE /end MEASUREMENT
/begin MEASUREMENT vFFDSTP "RAM value vFFDSTP" UBYTE COMP_0014 1 100 0 2550 ECU_ADDRESS 0xFFFF2721 READ_WRITE /end MEASUREMENT
/begin MEASUREMENT vFFDTRGW "RAM value vFFDTRGW" UBYTE COMP_0004 1 100 0 255 ECU_ADDRESS 0xFFFF46B4 READ_WRITE /end MEASUREMENT
/begin MEASUREMENT vFFDTRTM "RAM value vFFDTRTM" UWORD COMP_0049 1 100 0 65535 ECU_ADDRESS 0xFFFF4EB2 READ_WRITE /end MEASUREMENT
/begin MEASUREMENT vFFEGR "RAM value vFFEGR" UBYTE COMP_0378 1 100 0 100.000000065 ECU_ADDRESS 0xFFFF5152 READ_WRITE /end MEASUREMENT
/begin MEASUREMENT vFFEGRER "RAM value vFFEGRER" UBYTE COMP_0117 1 100 -100 99.21875 ECU_ADDRESS 0xFFFF5153 READ_WRITE /end MEASUREMENT
/begin MEASUREMENT vFFEVPRES "RAM value vFFEVPRES" UWORD COMP_0475_S 1 100 0 16383.75 ECU_ADDRESS 0xFFFF5154 READ_WRITE /end MEASUREMENT
/begin MEASUREMENT vFFEVPS "RAM value vFFEVPS" UBYTE COMP_0378 1 100 0 100.000000065 ECU_ADDRESS 0xFFFF5156 READ_WRITE /end MEASUREMENT
/begin MEASUREMENT vFFFLI "RAM value vFFFLI" UBYTE COMP_0378 1 100 0 100.000000065 ECU_ADDRESS 0xFFFF5157 READ_WRITE /end MEASUREMENT
/begin MEASUREMENT vFFFSS "RAM value vFFFSS" UBYTE COMP_0091 1 100 0 255 ECU_ADDRESS 0xFFFF5158 READ_WRITE /end MEASUREMENT
/begin MEASUREMENT vFFIMR "RAM value vFFIMR" UBYTE COMP_0068 1 100 0 255 ECU_ADDRESS 0xFFFF515A READ_WRITE /end MEASUREMENT
/begin MEASUREMENT vFFIMR2 "RAM value vFFIMR2" UBYTE COMP_0068 1 100 0 255 ECU_ADDRESS 0xFFFF515B READ_WRITE /end MEASUREMENT
/begin MEASUREMENT vFFIMRD "RAM value vFFIMRD" UBYTE COMP_0068 1 100 0 255 ECU_ADDRESS 0xFFFF515C READ_WRITE /end MEASUREMENT
/begin MEASUREMENT vFFIMRD2 "RAM value vFFIMRD2" UBYTE COMP_0068 1 100 0 255 ECU_ADDRESS 0xFFFF515D READ_WRITE /end MEASUREMENT
/begin MEASUREMENT vFFITAC "RAM value vFFITAC" UWORD COMP_0378 1 100 0 25700.000016705 ECU_ADDRESS 0xFFFF515E READ_WRITE /end MEASUREMENT
/begin MEASUREMENT vFFKBL "RAM value vFFKBL" UBYTE COMP_0117 1 100 -100 99.21875 ECU_ADDRESS 0xFFFF5160 READ_WRITE /end MEASUREMENT
/begin MEASUREMENT vFFKBLC "RAM value vFFKBLC" UBYTE COMP_0117 1 100 -100 99.21875 ECU_ADDRESS 0xFFFF5162 READ_WRITE /end MEASUREMENT
/begin MEASUREMENT vFFMFCA "RAM value vFFMFCA" UBYTE COMP_0016 1 100 0 255 ECU_ADDRESS 0xFFFF2722 READ_WRITE /end MEASUREMENT
/begin MEASUREMENT vFFMFCB "RAM value vFFMFCB" UBYTE COMP_0016 1 100 0 255 ECU_ADDRESS 0xFFFF2723 READ_WRITE /end MEASUREMENT
/begin MEASUREMENT vFFMFCC "RAM value vFFMFCC" UBYTE COMP_0016 1 100 0 255 ECU_ADDRESS 0xFFFF2724 READ_WRITE /end MEASUREMENT
/begin MEASUREMENT vFFMFCD "RAM value vFFMFCD" UBYTE COMP_0016 1 100 0 255 ECU_ADDRESS 0xFFFF2725 READ_WRITE /end MEASUREMENT
/begin MEASUREMENT vFFMFCE "RAM value vFFMFCE" UBYTE COMP_0016 1 100 0 255 ECU_ADDRESS 0xFFFF2726 READ_WRITE /end MEASUREMENT
/begin MEASUREMENT vFFMFCF "RAM value vFFMFCF" UBYTE COMP_0016 1 100 0 255 ECU_ADDRESS 0xFFFF2727 READ_WRITE /end MEASUREMENT
/begin MEASUREMENT vFFMFWG "RAM value vFFMFWG" UWORD COMP_0304_S 1 100 0 1.04856 ECU_ADDRESS 0xFFFF2728 READ_WRITE /end MEASUREMENT
/begin MEASUREMENT vFFMILEG "RAM value vFFMILEG" UWORD COMP_0494_S 1 100 0 1685560.2 ECU_ADDRESS 0xFFFF46B6 READ_WRITE /end MEASUREMENT
/begin MEASUREMENT vFFMLTIME "RAM value vFFMLTIME" UWORD COMP_0467_S 1 100 0 65535 ECU_ADDRESS 0xFFFF5164 READ_WRITE /end MEASUREMENT
/begin MEASUREMENT vFFNGC "RAM value vFFNGC" UWORD COMP_0426 1 100 0 65535 ECU_ADDRESS 0xFFFF5166 READ_WRITE /end MEASUREMENT
/begin MEASUREMENT vFFPPAMB "RAM value vFFPPAMB" UBYTE COMP_0474_S 1 100 0 255 ECU_ADDRESS 0xFFFF5168 READ_WRITE /end MEASUREMENT
/begin MEASUREMENT vFFQM "RAM value vFFQM" UWORD COMP_0476_S 1 100 0 655.35 ECU_ADDRESS 0xFFFF516A READ_WRITE /end MEASUREMENT
/begin MEASUREMENT vFFRPM "RAM value vFFRPM" UWORD COMP_0427 1 100 0 16383.75 ECU_ADDRESS 0xFFFF516C READ_WRITE /end MEASUREMENT
/begin MEASUREMENT vFFRUNTM "RAM value vFFRUNTM" UWORD COMP_0049 1 100 0 65535 ECU_ADDRESS 0xFFFF516E READ_WRITE /end MEASUREMENT
/begin MEASUREMENT vFFSAV "RAM value vFFSAV" SWORD COMP_0020_S 1 100 -65.536 65.534 ECU_ADDRESS 0xFFFF46B8 READ_WRITE /end MEASUREMENT
/begin MEASUREMENT vFFSUMVSP "RAM value vFFSUMVSP" UWORD COMP_0470 1 100 0 65535 ECU_ADDRESS 0xFFFF5170 READ_WRITE /end MEASUREMENT
/begin MEASUREMENT vFFTAG "RAM value vFFTAG" UBYTE COMP_0428 1 100 -40 215 ECU_ADDRESS 0xFFFF5172 READ_WRITE /end MEASUREMENT
/begin MEASUREMENT vFFTAN "RAM value vFFTAN" UBYTE COMP_0035 1 100 -50 205 ECU_ADDRESS 0xFFFF5173 READ_WRITE /end MEASUREMENT
/begin MEASUREMENT vFFTANTHG "RAM value vFFTANTHG" UBYTE COMP_0428 1 100 -40 215 ECU_ADDRESS 0xFFFF5174 READ_WRITE /end MEASUREMENT
/begin MEASUREMENT vFFTFM "RAM value vFFTFM" UBYTE COMP_0068 1 100 0 255 ECU_ADDRESS 0xFFFF5175 READ_WRITE /end MEASUREMENT
/begin MEASUREMENT vFFTGABFE "RAM value vFFTGABFE" UWORD COMP_0327 1 100 0 1.9988175 ECU_ADDRESS 0xFFFF5176 READ_WRITE /end MEASUREMENT
/begin MEASUREMENT vFFTGTVO "RAM value vFFTGTVO" UBYTE COMP_0378 1 100 0 100.000000065 ECU_ADDRESS 0xFFFF5178 READ_WRITE /end MEASUREMENT
/begin MEASUREMENT vFFTMPCAT "RAM value vFFTMPCAT" UWORD COMP_0477_S 1 100 -40 6513.5 ECU_ADDRESS 0xFFFF517A READ_WRITE /end MEASUREMENT
/begin MEASUREMENT vFFTPFCAL "RAM value vFFTPFCAL" UWORD COMP_0473_S 1 100 0 655350 ECU_ADDRESS 0xFFFF517E READ_WRITE /end MEASUREMENT
/begin MEASUREMENT vFFTPH "RAM value vFFTPH" UBYTE COMP_0001 1 100 0 31.875 ECU_ADDRESS 0xFFFF5180 READ_WRITE /end MEASUREMENT
/begin MEASUREMENT vFFTPS1OF "RAM value vFFTPS1OF" UBYTE COMP_0378 1 100 0 100.000000065 ECU_ADDRESS 0xFFFF5181 READ_WRITE /end MEASUREMENT
/begin MEASUREMENT vFFTPS2OF "RAM value vFFTPS2OF" UBYTE COMP_0378 1 100 0 100.000000065 ECU_ADDRESS 0xFFFF5182 READ_WRITE /end MEASUREMENT
/begin MEASUREMENT vFFTRACE "RAM value vFFTRACE" UBYTE COMP_0245 1 100 -64 191 ECU_ADDRESS 0xFFFF0BB9 READ_WRITE /end MEASUREMENT
/begin MEASUREMENT vFFTRC "RAM value vFFTRC" UBYTE COMP_0068 1 100 0 255 ECU_ADDRESS 0xFFFF5183 READ_WRITE /end MEASUREMENT
/begin MEASUREMENT vFFTVO "RAM value vFFTVO" UBYTE COMP_0002 1 100 0 89.25 ECU_ADDRESS 0xFFFF5184 READ_WRITE /end MEASUREMENT
/begin MEASUREMENT vFFTWN "RAM value vFFTWN" UBYTE COMP_0428 1 100 -40 215 ECU_ADDRESS 0xFFFF5185 READ_WRITE /end MEASUREMENT
/begin MEASUREMENT vFFVB "RAM value vFFVB" UWORD COMP_0478_S 1 100 0 65.535 ECU_ADDRESS 0xFFFF5186 READ_WRITE /end MEASUREMENT
/begin MEASUREMENT vFFVO2 "RAM value vFFVO2" UBYTE COMP_0203_S 1 100 0 1.275 ECU_ADDRESS 0xFFFF5188 READ_WRITE /end MEASUREMENT
/begin MEASUREMENT vFFVRO2 "RAM value vFFVRO2" UBYTE COMP_0203_S 1 100 0 1.275 ECU_ADDRESS 0xFFFF518A READ_WRITE /end MEASUREMENT
/begin MEASUREMENT vFFVRO2T "RAM value vFFVRO2T" UBYTE COMP_0203_S 1 100 0 1.275 ECU_ADDRESS 0xFFFF518C READ_WRITE /end MEASUREMENT
/begin MEASUREMENT vFFVSP "RAM value vFFVSP" UBYTE COMP_0429 1 100 0 255 ECU_ADDRESS 0xFFFF518E READ_WRITE /end MEASUREMENT
/begin MEASUREMENT vFFWARMUP "RAM value vFFWARMUP" UBYTE COMP_0016 1 100 0 255 ECU_ADDRESS 0xFFFF518F READ_WRITE /end MEASUREMENT
/begin MEASUREMENT vFG2MN "RAM value vFG2MN" UWORD COMP_0050 1 100 0 5119.921875 ECU_ADDRESS 0xFFFF46BA READ_WRITE /end MEASUREMENT
/begin MEASUREMENT vFG2MX "RAM value vFG2MX" UWORD COMP_0050 1 100 0 5119.921875 ECU_ADDRESS 0xFFFF46BC READ_WRITE /end MEASUREMENT
/begin MEASUREMENT vFG2SUB1 "RAM value vFG2SUB1" UWORD COMP_0050 1 100 0 5119.921875 ECU_ADDRESS 0xFFFF46BE READ_WRITE /end MEASUREMENT
/begin MEASUREMENT vFG2SUB2 "RAM value vFG2SUB2" UWORD COMP_0050 1 100 0 5119.921875 ECU_ADDRESS 0xFFFF46C0 READ_WRITE /end MEASUREMENT
/begin MEASUREMENT vFG2TMP "RAM value vFG2TMP" UWORD COMP_0050 1 100 0 5119.921875 ECU_ADDRESS 0xFFFF272A READ_WRITE /end MEASUREMENT
/begin MEASUREMENT vFGAGE1 "RAM value vFGAGE1" UWORD COMP_0050 1 100 0 5119.921875 ECU_ADDRESS 0xFFFF370E READ_WRITE /end MEASUREMENT
/begin MEASUREMENT vFGAGE2 "RAM value vFGAGE2" UWORD COMP_0050 1 100 0 5119.921875 ECU_ADDRESS 0xFFFF2046 READ_WRITE /end MEASUREMENT
/begin MEASUREMENT vFGAGE3 "RAM value vFGAGE3" UWORD COMP_0050 1 100 0 5119.921875 ECU_ADDRESS 0xFFFF2048 READ_WRITE /end MEASUREMENT
/begin MEASUREMENT vFGCAN "RAM value vFGCAN" UWORD COMP_0068 1 100 0 65535 ECU_ADDRESS 0xFFFF3710 READ_WRITE /end MEASUREMENT
/begin MEASUREMENT vFGEND "RAM value vFGEND" UWORD COMP_0050 1 100 0 5119.921875 ECU_ADDRESS 0xFFFF43FE READ_WRITE /end MEASUREMENT
/begin MEASUREMENT vFGINTTS "RAM value vFGINTTS" UWORD COMP_0050 1 100 0 5119.921875 ECU_ADDRESS 0xFFFF46C2 READ_WRITE /end MEASUREMENT
/begin MEASUREMENT vFGN "RAM value vFGN" UWORD COMP_0050 1 100 0 5119.921875 ECU_ADDRESS 0xFFFF204A READ_WRITE /end MEASUREMENT
/begin MEASUREMENT vFGNCUT "RAM value vFGNCUT" UWORD COMP_0050 1 100 0 5119.921875 ECU_ADDRESS 0xFFFF3712 READ_WRITE /end MEASUREMENT
/begin MEASUREMENT vFGNDUMP "RAM value vFGNDUMP" UWORD COMP_0050 1 100 0 5119.921875 ECU_ADDRESS 0xFFFF272C READ_WRITE /end MEASUREMENT
/begin MEASUREMENT vFGNLIVS "RAM value vFGNLIVS" UWORD COMP_0050 1 100 0 5119.921875 ECU_ADDRESS 0xFFFF272E READ_WRITE /end MEASUREMENT
/begin MEASUREMENT vFGNLVP "RAM value vFGNLVP" UWORD COMP_0050 1 100 0 5119.921875 ECU_ADDRESS 0xFFFF2730 READ_WRITE /end MEASUREMENT
/begin MEASUREMENT vFGNLVS "RAM value vFGNLVS" UWORD COMP_0050 1 100 0 5119.921875 ECU_ADDRESS 0xFFFF46C4 READ_WRITE /end MEASUREMENT
/begin MEASUREMENT vFGNST "RAM value vFGNST" UWORD COMP_0050 1 100 0 5119.921875 ECU_ADDRESS 0xFFFF2732 READ_WRITE /end MEASUREMENT
/begin MEASUREMENT vFGRPDGN "RAM value vFGRPDGN" UBYTE COMP_0004 1 100 0 255 ECU_ADDRESS 0xFFFF2734 READ_WRITE /end MEASUREMENT
/begin MEASUREMENT vFHEADNG "RAM value vFHEADNG" UBYTE COMP_0068 1 100 0 255 ECU_ADDRESS 0xFFFF3714 READ_WRITE /end MEASUREMENT
/begin MEASUREMENT vFHFMEM "RAM value vFHFMEM" UWORD COMP_0068 1 100 0 65535 ECU_ADDRESS 0xFFFF3122 READ_WRITE /end MEASUREMENT
/begin MEASUREMENT vFHINJEX "RAM value vFHINJEX" UBYTE COMP_0068 1 100 0 255 ECU_ADDRESS 0xFFFF1738 READ_WRITE /end MEASUREMENT
/begin MEASUREMENT vFHINJEXZ "RAM value vFHINJEXZ" UBYTE COMP_0004 1 100 0 255 ECU_ADDRESS 0xFFFF1739 READ_WRITE /end MEASUREMENT
/begin MEASUREMENT vFHOSBAD "RAM value vFHOSBAD" UWORD COMP_0031 1 100 0 255.99609375 ECU_ADDRESS 0xFFFF2736 READ_WRITE /end MEASUREMENT
/begin MEASUREMENT vFHOSBIKA "RAM value vFHOSBIKA" UWORD COMP_0031 1 100 0 255.99609375 ECU_ADDRESS 0xFFFF0BBA READ_WRITE /end MEASUREMENT
/begin MEASUREMENT vFHOSIKA "RAM value vFHOSIKA" UWORD COMP_0031 1 100 0 255.99609375 ECU_ADDRESS 0xFFFF2738 READ_WRITE /end MEASUREMENT
/begin MEASUREMENT vFHOSIKC "RAM value vFHOSIKC" UWORD COMP_0031 1 100 0 255.99609375 ECU_ADDRESS 0xFFFF273A READ_WRITE /end MEASUREMENT
/begin MEASUREMENT vFHTICHG "RAM value vFHTICHG" UBYTE COMP_0068 1 100 0 255 ECU_ADDRESS 0xFFFF173A READ_WRITE /end MEASUREMENT
/begin MEASUREMENT vFHX "RAM value vFHX" UBYTE COMP_0004 1 100 0 255 ECU_ADDRESS 0xFFFF173B READ_WRITE /end MEASUREMENT
/begin MEASUREMENT vFHXZ "RAM value vFHXZ" UBYTE COMP_0004 1 100 0 255 ECU_ADDRESS 0xFFFF173C READ_WRITE /end MEASUREMENT
/begin MEASUREMENT vFIMRDYBFf "RAM value vFIMRDYBFf" UBYTE COMP_0004 1 100 0 255 ECU_ADDRESS 0xFFFF273C READ_WRITE /end MEASUREMENT
/begin MEASUREMENT vFIRTDIG "RAM value vFIRTDIG" UBYTE COMP_0017 1 100 0 255 ECU_ADDRESS 0xFFFF273D READ_WRITE /end MEASUREMENT
/begin MEASUREMENT vFITLOCKD "RAM value vFITLOCKD" UBYTE COMP_0068 1 100 0 255 ECU_ADDRESS 0xFFFF0BBE READ_WRITE /end MEASUREMENT
/begin MEASUREMENT vFITLOCKR "RAM value vFITLOCKR" UBYTE COMP_0068 1 100 0 255 ECU_ADDRESS 0xFFFF0BBF READ_WRITE /end MEASUREMENT
/begin MEASUREMENT vFITLOCTR "RAM value vFITLOCTR" UBYTE COMP_0016 1 100 0 255 ECU_ADDRESS 0xFFFF173D READ_WRITE /end MEASUREMENT
/begin MEASUREMENT vFIVTDTW "RAM value vFIVTDTW" UBYTE COMP_0003 1 100 0 255 ECU_ADDRESS 0xFFFF273E READ_WRITE /end MEASUREMENT
/begin MEASUREMENT vFLASEED "RAM value vFLASEED" ULONG COMP_0068 1 100 0 4294967295 ECU_ADDRESS 0xFFFF4EB4 READ_WRITE /end MEASUREMENT
/begin MEASUREMENT vFLCSERR "RAM value vFLCSERR" UBYTE COMP_0068 1 100 0 255 ECU_ADDRESS 0xFFFF3716 READ_WRITE /end MEASUREMENT
/begin MEASUREMENT vFLFA "RAM value vFLFA" UBYTE COMP_0009 1 100 0 199.21875 ECU_ADDRESS 0xFFFF0BC0 READ_WRITE /end MEASUREMENT
/begin MEASUREMENT vFLGCNT "RAM value vFLGCNT" UWORD COMP_0016 1 100 0 65535 ECU_ADDRESS 0xFFFF46C6 READ_WRITE /end MEASUREMENT
/begin MEASUREMENT vFLGCRNG "RAM value vFLGCRNG" UBYTE COMP_0283 1 100 0 255 ECU_ADDRESS 0xFFFF46C8 READ_WRITE /end MEASUREMENT
/begin MEASUREMENT vFLGFCCYL "RAM value vFLGFCCYL" UBYTE COMP_0068 1 100 0 255 ECU_ADDRESS 0xFFFF273F READ_WRITE /end MEASUREMENT
/begin MEASUREMENT vFLGFPCM "RAM value vFLGFPCM" UBYTE COMP_0068 1 100 0 255 ECU_ADDRESS 0xFFFF2747 READ_WRITE /end MEASUREMENT
/begin MEASUREMENT vFLGFSW "RAM value vFLGFSW" UBYTE COMP_0004 1 100 0 255 ECU_ADDRESS 0xFFFF46C9 READ_WRITE /end MEASUREMENT
/begin MEASUREMENT vFLGFSX "RAM value vFLGFSX" UBYTE COMP_0004 1 100 0 255 ECU_ADDRESS 0xFFFF2748 READ_WRITE /end MEASUREMENT
/begin MEASUREMENT vFLGIB "RAM value vFLGIB" UBYTE COMP_0068 1 100 0 255 ECU_ADDRESS 0xFFFF3717 READ_WRITE /end MEASUREMENT
/begin MEASUREMENT vFLGWCNT "RAM value vFLGWCNT" UBYTE COMP_0068 1 100 0 255 ECU_ADDRESS 0xFFFF2749 READ_WRITE /end MEASUREMENT
/begin MEASUREMENT vFLGYRI "RAM value vFLGYRI" UBYTE COMP_0283 1 100 0 255 ECU_ADDRESS 0xFFFF0BC1 READ_WRITE /end MEASUREMENT
/begin MEASUREMENT vFLGYRI1 "RAM value vFLGYRI1" UBYTE COMP_0283 1 100 0 255 ECU_ADDRESS 0xFFFF0BC2 READ_WRITE /end MEASUREMENT
/begin MEASUREMENT vFLGYRI2 "RAM value vFLGYRI2" UBYTE COMP_0283 1 100 0 255 ECU_ADDRESS 0xFFFF0BC3 READ_WRITE /end MEASUREMENT
/begin MEASUREMENT vFLGYRI3 "RAM value vFLGYRI3" UBYTE COMP_0283 1 100 0 255 ECU_ADDRESS 0xFFFF0BC4 READ_WRITE /end MEASUREMENT
/begin MEASUREMENT vFLGYRI4 "RAM value vFLGYRI4" UBYTE COMP_0283 1 100 0 255 ECU_ADDRESS 0xFFFF0BC5 READ_WRITE /end MEASUREMENT
/begin MEASUREMENT vFLGYRI5 "RAM value vFLGYRI5" UBYTE COMP_0283 1 100 0 255 ECU_ADDRESS 0xFFFF0BC6 READ_WRITE /end MEASUREMENT
/begin MEASUREMENT vFLGYRI6 "RAM value vFLGYRI6" UBYTE COMP_0283 1 100 0 255 ECU_ADDRESS 0xFFFF0BC7 READ_WRITE /end MEASUREMENT
/begin MEASUREMENT vFLML "RAM value vFLML" UBYTE COMP_0253 1 100 0 0.0159375 ECU_ADDRESS 0xFFFF0BC8 READ_WRITE /end MEASUREMENT
/begin MEASUREMENT vFLML0 "RAM value vFLML0" UBYTE COMP_0253 1 100 0 0.0159375 ECU_ADDRESS 0xFFFF0BC9 READ_WRITE /end MEASUREMENT
/begin MEASUREMENT vFLOAD1 "RAM value vFLOAD1" UWORD COMP_0069 1 100 0 1.999970916 ECU_ADDRESS 0xFFFF162A READ_WRITE /end MEASUREMENT
/begin MEASUREMENT vFLOAD_4 "RAM value vFLOAD_4" UWORD COMP_0450 1 100 0 63.999056205 ECU_ADDRESS 0xFFFF274A READ_WRITE /end MEASUREMENT
/begin MEASUREMENT vFLSTAS "RAM value vFLSTAS" UBYTE COMP_0068 1 100 0 255 ECU_ADDRESS 0xFFFF371B READ_WRITE /end MEASUREMENT
/begin MEASUREMENT vFLSTASSV "RAM value vFLSTASSV" UBYTE COMP_0068 1 100 0 255 ECU_ADDRESS 0xFFFF371C READ_WRITE /end MEASUREMENT
/begin MEASUREMENT vFLTFIRST "RAM value vFLTFIRST" UBYTE COMP_0068 1 100 0 255 ECU_ADDRESS 0xFFFF371D READ_WRITE /end MEASUREMENT
/begin MEASUREMENT vFLTFRSTE "RAM value vFLTFRSTE" UBYTE COMP_0068 1 100 0 255 ECU_ADDRESS 0xFFFF371E READ_WRITE /end MEASUREMENT
/begin MEASUREMENT vFLTW "RAM value vFLTW" UBYTE COMP_0009 1 100 0 199.21875 ECU_ADDRESS 0xFFFF0BCA READ_WRITE /end MEASUREMENT
/begin MEASUREMENT vFLV "RAM value vFLV" UWORD COMP_0430 1 100 0 0.999985458 ECU_ADDRESS 0xFFFF0BCC READ_WRITE /end MEASUREMENT
/begin MEASUREMENT vFMAD "RAM value vFMAD" UWORD COMP_0023 1 100 0 327675 ECU_ADDRESS 0xFFFF204C READ_WRITE /end MEASUREMENT
/begin MEASUREMENT vFMADC "RAM value vFMADC" UWORD COMP_0023 1 100 0 327675 ECU_ADDRESS 0xFFFF3720 READ_WRITE /end MEASUREMENT
/begin MEASUREMENT vFMASKA "RAM value vFMASKA" UBYTE COMP_0068 1 100 0 255 ECU_ADDRESS 0xFFFF173E READ_WRITE /end MEASUREMENT
/begin MEASUREMENT vFMASKIH "RAM value vFMASKIH" UBYTE COMP_0068 1 100 0 255 ECU_ADDRESS 0xFFFF173F READ_WRITE /end MEASUREMENT
/begin MEASUREMENT vFMASKIL "RAM value vFMASKIL" UBYTE COMP_0068 1 100 0 255 ECU_ADDRESS 0xFFFF1747 READ_WRITE /end MEASUREMENT
/begin MEASUREMENT vFMASKNH "RAM value vFMASKNH" UBYTE COMP_0068 1 100 0 255 ECU_ADDRESS 0xFFFF174F READ_WRITE /end MEASUREMENT
/begin MEASUREMENT vFMASKNL "RAM value vFMASKNL" UBYTE COMP_0068 1 100 0 255 ECU_ADDRESS 0xFFFF1757 READ_WRITE /end MEASUREMENT
/begin MEASUREMENT vFMFMEA "RAM value vFMFMEA" UWORD COMP_0068 1 100 0 65535 ECU_ADDRESS 0xFFFF3124 READ_WRITE /end MEASUREMENT
/begin MEASUREMENT vFMFMEB "RAM value vFMFMEB" UWORD COMP_0068 1 100 0 65535 ECU_ADDRESS 0xFFFF3126 READ_WRITE /end MEASUREMENT
/begin MEASUREMENT vFMFMEM "RAM value vFMFMEM" UWORD COMP_0068 1 100 0 65535 ECU_ADDRESS 0xFFFF3128 READ_WRITE /end MEASUREMENT
/begin MEASUREMENT vFMFMEX "RAM value vFMFMEX" UBYTE COMP_0016 1 100 0 255 ECU_ADDRESS 0xFFFF2750 READ_WRITE /end MEASUREMENT
/begin MEASUREMENT vFMILONW "RAM value vFMILONW" UBYTE COMP_0004 1 100 0 255 ECU_ADDRESS 0xFFFF5190 READ_WRITE /end MEASUREMENT
/begin MEASUREMENT vFMRCPC1f "RAM value vFMRCPC1f" UBYTE COMP_0004 1 100 0 255 ECU_ADDRESS 0xFFFF204E READ_WRITE /end MEASUREMENT
/begin MEASUREMENT vFMRCPC2f "RAM value vFMRCPC2f" UBYTE COMP_0004 1 100 0 255 ECU_ADDRESS 0xFFFF204F READ_WRITE /end MEASUREMENT
/begin MEASUREMENT vFMRJG1f "RAM value vFMRJG1f" UBYTE COMP_0004 1 100 0 255 ECU_ADDRESS 0xFFFF3722 READ_WRITE /end MEASUREMENT
/begin MEASUREMENT vFMRJG2f "RAM value vFMRJG2f" UBYTE COMP_0004 1 100 0 255 ECU_ADDRESS 0xFFFF3723 READ_WRITE /end MEASUREMENT
/begin MEASUREMENT vFMTASK "RAM value vFMTASK" UBYTE COMP_0068 1 100 0 255 ECU_ADDRESS 0xFFFF3724 READ_WRITE /end MEASUREMENT
/begin MEASUREMENT vFNATMP1 "RAM value vFNATMP1" UWORD COMP_0039_S 1 100 60000 125535 ECU_ADDRESS 0xFFFF4EB8 READ_WRITE /end MEASUREMENT
/begin MEASUREMENT vFNATMP2 "RAM value vFNATMP2" UWORD COMP_0039_S 1 100 60000 125535 ECU_ADDRESS 0xFFFF4EBA READ_WRITE /end MEASUREMENT
/begin MEASUREMENT vFNCPRE1 "RAM value vFNCPRE1" UWORD COMP_0039_S 1 100 60000 125535 ECU_ADDRESS 0xFFFF4EBC READ_WRITE /end MEASUREMENT
/begin MEASUREMENT vFNCPRE2 "RAM value vFNCPRE2" UWORD COMP_0039_S 1 100 60000 125535 ECU_ADDRESS 0xFFFF4EBE READ_WRITE /end MEASUREMENT
/begin MEASUREMENT vFNCTFE1 "RAM value vFNCTFE1" UWORD COMP_0259_S 1 100 -50 13057 ECU_ADDRESS 0xFFFF4EC0 READ_WRITE /end MEASUREMENT
/begin MEASUREMENT vFNCTFE2 "RAM value vFNCTFE2" UWORD COMP_0259_S 1 100 -50 13057 ECU_ADDRESS 0xFFFF4EC2 READ_WRITE /end MEASUREMENT
/begin MEASUREMENT vFNCTFS1 "RAM value vFNCTFS1" UWORD COMP_0259_S 1 100 -50 13057 ECU_ADDRESS 0xFFFF4EC4 READ_WRITE /end MEASUREMENT
/begin MEASUREMENT vFNCTFS2 "RAM value vFNCTFS2" UWORD COMP_0259_S 1 100 -50 13057 ECU_ADDRESS 0xFFFF4EC6 READ_WRITE /end MEASUREMENT
/begin MEASUREMENT vFNDCTFE1 "RAM value vFNDCTFE1" UWORD COMP_0259_S 1 100 -50 13057 ECU_ADDRESS 0xFFFF4EC8 READ_WRITE /end MEASUREMENT
/begin MEASUREMENT vFNDCTFE2 "RAM value vFNDCTFE2" UWORD COMP_0259_S 1 100 -50 13057 ECU_ADDRESS 0xFFFF4ECA READ_WRITE /end MEASUREMENT
/begin MEASUREMENT vFNDCTFS1 "RAM value vFNDCTFS1" UWORD COMP_0259_S 1 100 -50 13057 ECU_ADDRESS 0xFFFF4ECC READ_WRITE /end MEASUREMENT
/begin MEASUREMENT vFNDCTFS2 "RAM value vFNDCTFS2" UWORD COMP_0259_S 1 100 -50 13057 ECU_ADDRESS 0xFFFF4ECE READ_WRITE /end MEASUREMENT
/begin MEASUREMENT vFNIATM1 "RAM value vFNIATM1" UWORD COMP_0001_S 1 100 0 65535 ECU_ADDRESS 0xFFFF4ED0 READ_WRITE /end MEASUREMENT
/begin MEASUREMENT vFNIATM2 "RAM value vFNIATM2" UWORD COMP_0001_S 1 100 0 65535 ECU_ADDRESS 0xFFFF4ED2 READ_WRITE /end MEASUREMENT
/begin MEASUREMENT vFNLOW "RAM value vFNLOW" UWORD COMP_0064 1 100 0 102398.4375 ECU_ADDRESS 0xFFFF3726 READ_WRITE /end MEASUREMENT
/begin MEASUREMENT vFNPVTM1 "RAM value vFNPVTM1" UWORD COMP_0049 1 100 0 65535 ECU_ADDRESS 0xFFFF4ED4 READ_WRITE /end MEASUREMENT
/begin MEASUREMENT vFNPVTM2 "RAM value vFNPVTM2" UWORD COMP_0049 1 100 0 65535 ECU_ADDRESS 0xFFFF4ED6 READ_WRITE /end MEASUREMENT
/begin MEASUREMENT vFNRPM "RAM value vFNRPM" UWORD COMP_0006 1 100 0 819187.5 ECU_ADDRESS 0xFFFF08D8 READ_WRITE /end MEASUREMENT
/begin MEASUREMENT vFNRPM2 "RAM value vFNRPM2" UBYTE COMP_0006 1 100 0 3187.5 ECU_ADDRESS 0xFFFF2050 READ_WRITE /end MEASUREMENT
/begin MEASUREMENT vFNRPM2Z0 "RAM value vFNRPM2Z0" UBYTE COMP_0006 1 100 0 3187.5 ECU_ADDRESS 0xFFFF3728 READ_WRITE /end MEASUREMENT
/begin MEASUREMENT vFNRPM2Z1 "RAM value vFNRPM2Z1" UBYTE COMP_0006 1 100 0 3187.5 ECU_ADDRESS 0xFFFF3729 READ_WRITE /end MEASUREMENT
/begin MEASUREMENT vFNRPM2Z2 "RAM value vFNRPM2Z2" UBYTE COMP_0006 1 100 0 3187.5 ECU_ADDRESS 0xFFFF372A READ_WRITE /end MEASUREMENT
/begin MEASUREMENT vFNRPMQ "RAM value vFNRPMQ" UWORD COMP_0064 1 100 0 102398.4375 ECU_ADDRESS 0xFFFF372C READ_WRITE /end MEASUREMENT
/begin MEASUREMENT vFNSPCV1 "RAM value vFNSPCV1" UWORD COMP_0248_S 1 100 0 127.99837455 ECU_ADDRESS 0xFFFF4ED8 READ_WRITE /end MEASUREMENT
/begin MEASUREMENT vFNSPCV2 "RAM value vFNSPCV2" UWORD COMP_0248_S 1 100 0 127.99837455 ECU_ADDRESS 0xFFFF4EDA READ_WRITE /end MEASUREMENT
/begin MEASUREMENT vFNTFINT1 "RAM value vFNTFINT1" UWORD COMP_0259_S 1 100 -50 13057 ECU_ADDRESS 0xFFFF4EDC READ_WRITE /end MEASUREMENT
/begin MEASUREMENT vFNTFINT2 "RAM value vFNTFINT2" UWORD COMP_0259_S 1 100 -50 13057 ECU_ADDRESS 0xFFFF4EDE READ_WRITE /end MEASUREMENT
/begin MEASUREMENT vFNTWINT1 "RAM value vFNTWINT1" UBYTE COMP_0035 1 100 -50 205 ECU_ADDRESS 0xFFFF4EE0 READ_WRITE /end MEASUREMENT
/begin MEASUREMENT vFNTWINT2 "RAM value vFNTWINT2" UBYTE COMP_0035 1 100 -50 205 ECU_ADDRESS 0xFFFF4EE1 READ_WRITE /end MEASUREMENT
/begin MEASUREMENT vFNVFTM1 "RAM value vFNVFTM1" UWORD COMP_0049 1 100 0 65535 ECU_ADDRESS 0xFFFF4EE2 READ_WRITE /end MEASUREMENT
/begin MEASUREMENT vFNVFTM2 "RAM value vFNVFTM2" UWORD COMP_0049 1 100 0 65535 ECU_ADDRESS 0xFFFF4EE4 READ_WRITE /end MEASUREMENT
/begin MEASUREMENT vFNVOLIMPf "RAM value vFNVOLIMPf" UBYTE COMP_0004 1 100 0 255 ECU_ADDRESS 0xFFFF372E READ_WRITE /end MEASUREMENT
/begin MEASUREMENT vFO2HDONf "RAM value vFO2HDONf" UBYTE COMP_0004 1 100 0 255 ECU_ADDRESS 0xFFFF0BCE READ_WRITE /end MEASUREMENT
/begin MEASUREMENT vFO2HNGf "RAM value vFO2HNGf" UBYTE COMP_0004 1 100 0 255 ECU_ADDRESS 0xFFFF372F READ_WRITE /end MEASUREMENT
/begin MEASUREMENT vFO2HONf "RAM value vFO2HONf" UBYTE COMP_0004 1 100 0 255 ECU_ADDRESS 0xFFFF1B2C READ_WRITE /end MEASUREMENT
/begin MEASUREMENT vFO2HTUf "RAM value vFO2HTUf" UBYTE COMP_0004 1 100 0 255 ECU_ADDRESS 0xFFFF3730 READ_WRITE /end MEASUREMENT
/begin MEASUREMENT vFOATMP1 "RAM value vFOATMP1" UWORD COMP_0039_S 1 100 60000 125535 ECU_ADDRESS 0xFFFF4EE6 READ_WRITE /end MEASUREMENT
/begin MEASUREMENT vFOCPRE1 "RAM value vFOCPRE1" UWORD COMP_0039_S 1 100 60000 125535 ECU_ADDRESS 0xFFFF4EE8 READ_WRITE /end MEASUREMENT
/begin MEASUREMENT vFOCTFE1 "RAM value vFOCTFE1" UWORD COMP_0259_S 1 100 -50 13057 ECU_ADDRESS 0xFFFF4EEA READ_WRITE /end MEASUREMENT
/begin MEASUREMENT vFOCTFS1 "RAM value vFOCTFS1" UWORD COMP_0259_S 1 100 -50 13057 ECU_ADDRESS 0xFFFF4EEC READ_WRITE /end MEASUREMENT
/begin MEASUREMENT vFODCPRE1 "RAM value vFODCPRE1" UWORD COMP_0039_S 1 100 60000 125535 ECU_ADDRESS 0xFFFF4EEE READ_WRITE /end MEASUREMENT
/begin MEASUREMENT vFODCTFE1 "RAM value vFODCTFE1" UWORD COMP_0259_S 1 100 -50 13057 ECU_ADDRESS 0xFFFF4EF0 READ_WRITE /end MEASUREMENT
/begin MEASUREMENT vFODCTFS1 "RAM value vFODCTFS1" UWORD COMP_0259_S 1 100 -50 13057 ECU_ADDRESS 0xFFFF4EF2 READ_WRITE /end MEASUREMENT
/begin MEASUREMENT vFODWN2 "RAM value vFODWN2" UBYTE COMP_0283 1 100 0 255 ECU_ADDRESS 0xFFFF2751 READ_WRITE /end MEASUREMENT
/begin MEASUREMENT vFODWN3 "RAM value vFODWN3" UBYTE COMP_0283 1 100 0 255 ECU_ADDRESS 0xFFFF2753 READ_WRITE /end MEASUREMENT
/begin MEASUREMENT vFOPVTM1 "RAM value vFOPVTM1" UWORD COMP_0049 1 100 0 65535 ECU_ADDRESS 0xFFFF4EF4 READ_WRITE /end MEASUREMENT
/begin MEASUREMENT vFOSPCV1 "RAM value vFOSPCV1" UWORD COMP_0248_S 1 100 0 127.99837455 ECU_ADDRESS 0xFFFF4EF6 READ_WRITE /end MEASUREMENT
/begin MEASUREMENT vFOTFINT1 "RAM value vFOTFINT1" UWORD COMP_0259_S 1 100 -50 13057 ECU_ADDRESS 0xFFFF4EF8 READ_WRITE /end MEASUREMENT
/begin MEASUREMENT vFOTWINT1 "RAM value vFOTWINT1" UBYTE COMP_0035 1 100 -50 205 ECU_ADDRESS 0xFFFF4EFA READ_WRITE /end MEASUREMENT
/begin MEASUREMENT vFOVFTM1 "RAM value vFOVFTM1" UWORD COMP_0049 1 100 0 65535 ECU_ADDRESS 0xFFFF4EFC READ_WRITE /end MEASUREMENT
/begin MEASUREMENT vFOXMN "RAM value vFOXMN" UBYTE COMP_0104 1 100 0 2550 ECU_ADDRESS 0xFFFF3731 READ_WRITE /end MEASUREMENT
/begin MEASUREMENT vFOXMX "RAM value vFOXMX" UBYTE COMP_0104 1 100 0 2550 ECU_ADDRESS 0xFFFF3732 READ_WRITE /end MEASUREMENT
/begin MEASUREMENT vFPCMCNT "RAM value vFPCMCNT" UBYTE COMP_0016 1 100 0 255 ECU_ADDRESS 0xFFFF312A READ_WRITE /end MEASUREMENT
/begin MEASUREMENT vFPCMODE "RAM value vFPCMODE" UBYTE COMP_0068 1 100 0 255 ECU_ADDRESS 0xFFFF3B5F READ_WRITE /end MEASUREMENT
/begin MEASUREMENT vFPCOUT "RAM value vFPCOUT" UBYTE COMP_0030 1 100 0 255 ECU_ADDRESS 0xFFFF312B READ_WRITE /end MEASUREMENT
/begin MEASUREMENT vFPLIGOCT "RAM value vFPLIGOCT" UBYTE COMP_0068 1 100 0 255 ECU_ADDRESS 0xFFFF175F READ_WRITE /end MEASUREMENT
/begin MEASUREMENT vFPLIJCT1 "RAM value vFPLIJCT1" UBYTE COMP_0016 1 100 0 255 ECU_ADDRESS 0xFFFF1760 READ_WRITE /end MEASUREMENT
/begin MEASUREMENT vFPLIJCTB "RAM value vFPLIJCTB" UBYTE COMP_0016 1 100 0 255 ECU_ADDRESS 0xFFFF1761 READ_WRITE /end MEASUREMENT
/begin MEASUREMENT vFPLIJCTC "RAM value vFPLIJCTC" UBYTE COMP_0016 1 100 0 255 ECU_ADDRESS 0xFFFF1762 READ_WRITE /end MEASUREMENT
/begin MEASUREMENT vFPLINJZ1 "RAM value vFPLINJZ1" UBYTE COMP_0068 1 100 0 255 ECU_ADDRESS 0xFFFF0BCF READ_WRITE /end MEASUREMENT
/begin MEASUREMENT vFPLINJZ8 "RAM value vFPLINJZ8" UBYTE COMP_0068 1 100 0 255 ECU_ADDRESS 0xFFFF0BD0 READ_WRITE /end MEASUREMENT
/begin MEASUREMENT vFPLINJZA "RAM value vFPLINJZA" UBYTE COMP_0068 1 100 0 255 ECU_ADDRESS 0xFFFF0BD1 READ_WRITE /end MEASUREMENT
/begin MEASUREMENT vFPLINJZB "RAM value vFPLINJZB" UBYTE COMP_0068 1 100 0 255 ECU_ADDRESS 0xFFFF0BD2 READ_WRITE /end MEASUREMENT
/begin MEASUREMENT vFPLINJZC "RAM value vFPLINJZC" UBYTE COMP_0068 1 100 0 255 ECU_ADDRESS 0xFFFF0BD3 READ_WRITE /end MEASUREMENT
/begin MEASUREMENT vFPONDTY "RAM value vFPONDTY" UBYTE COMP_0027 1 100 0 255 ECU_ADDRESS 0xFFFF3B60 READ_WRITE /end MEASUREMENT
/begin MEASUREMENT vFRBASEM "RAM value vFRBASEM" UBYTE COMP_0017 1 100 0 255 ECU_ADDRESS 0xFFFF2754 READ_WRITE /end MEASUREMENT
/begin MEASUREMENT vFRCNGK "RAM value vFRCNGK" UBYTE COMP_0119_S 1 100 0 0.99609375 ECU_ADDRESS 0xFFFF0BD4 READ_WRITE /end MEASUREMENT
/begin MEASUREMENT vFRICCOLD "RAM value vFRICCOLD" UWORD COMP_0196 1 100 0 6553.5 ECU_ADDRESS 0xFFFF0BD6 READ_WRITE /end MEASUREMENT
/begin MEASUREMENT vFRICSEN "RAM value vFRICSEN" UWORD COMP_0425_S 1 100 0 25.599609375 ECU_ADDRESS 0xFFFF0BD8 READ_WRITE /end MEASUREMENT
/begin MEASUREMENT vFRO2FCf "RAM value vFRO2FCf" UBYTE COMP_0004 1 100 0 255 ECU_ADDRESS 0xFFFF2759 READ_WRITE /end MEASUREMENT
/begin MEASUREMENT vFROHCMNf "RAM value vFROHCMNf" UBYTE COMP_0004 1 100 0 255 ECU_ADDRESS 0xFFFF275A READ_WRITE /end MEASUREMENT
/begin MEASUREMENT vFROHCMXf "RAM value vFROHCMXf" UBYTE COMP_0004 1 100 0 255 ECU_ADDRESS 0xFFFF275B READ_WRITE /end MEASUREMENT
/begin MEASUREMENT vFROUP2 "RAM value vFROUP2" UBYTE COMP_0068 1 100 0 255 ECU_ADDRESS 0xFFFF0BDA READ_WRITE /end MEASUREMENT
/begin MEASUREMENT vFROUP3 "RAM value vFROUP3" UBYTE COMP_0283 1 100 0 255 ECU_ADDRESS 0xFFFF275C READ_WRITE /end MEASUREMENT
/begin MEASUREMENT vFRVSP "RAM value vFRVSP" UBYTE COMP_0007 1 100 0 510 ECU_ADDRESS 0xFFFF0BDC READ_WRITE /end MEASUREMENT
/begin MEASUREMENT vFRWIP "RAM value vFRWIP" UBYTE COMP_0068 1 100 0 255 ECU_ADDRESS 0xFFFF1E54 READ_WRITE /end MEASUREMENT
/begin MEASUREMENT vFSADCR "RAM value vFSADCR" UWORD COMP_0058_S 1 100 0 6553500 ECU_ADDRESS 0xFFFF275E READ_WRITE /end MEASUREMENT
/begin MEASUREMENT vFSENST_0 "RAM value vFSENST_0" UBYTE COMP_0004 1 100 0 255 ECU_ADDRESS 0xFFFF46CA READ_WRITE /end MEASUREMENT
/begin MEASUREMENT vFSEST1_0 "RAM value vFSEST1_0" UBYTE COMP_0004 1 100 0 255 ECU_ADDRESS 0xFFFF5191 READ_WRITE /end MEASUREMENT
/begin MEASUREMENT vFSFLG "RAM value vFSFLG" UWORD COMP_0068 1 100 0 65535 ECU_ADDRESS 0xFFFF4EFE READ_WRITE /end MEASUREMENT
/begin MEASUREMENT vFSJBCNT "RAM value vFSJBCNT" UBYTE COMP_0068 1 100 0 255 ECU_ADDRESS 0xFFFF2760 READ_WRITE /end MEASUREMENT
/begin MEASUREMENT vFSMDNCHK "RAM value vFSMDNCHK" UBYTE COMP_0068 1 100 0 255 ECU_ADDRESS 0xFFFF2761 READ_WRITE /end MEASUREMENT
/begin MEASUREMENT vFSMIL_0 "RAM value vFSMIL_0" UBYTE COMP_0004 1 100 0 255 ECU_ADDRESS 0xFFFF46CB READ_WRITE /end MEASUREMENT
/begin MEASUREMENT vFSMODENO "RAM value vFSMODENO" UBYTE COMP_0068 1 100 0 255 ECU_ADDRESS 0xFFFF3B63 READ_WRITE /end MEASUREMENT
/begin MEASUREMENT vFSO2NGf "RAM value vFSO2NGf" UBYTE COMP_0004 1 100 0 255 ECU_ADDRESS 0xFFFF1763 READ_WRITE /end MEASUREMENT
/begin MEASUREMENT vFSO2Sf "RAM value vFSO2Sf" UBYTE COMP_0004 1 100 0 255 ECU_ADDRESS 0xFFFF0954 READ_WRITE /end MEASUREMENT
/begin MEASUREMENT vFSPFD "RAM value vFSPFD" UBYTE COMP_0426_S 1 100 0 2.4888 ECU_ADDRESS 0xFFFF3B64 READ_WRITE /end MEASUREMENT
/begin MEASUREMENT vFSPFST "RAM value vFSPFST" UBYTE COMP_0087_S 1 100 0 19.9104 ECU_ADDRESS 0xFFFF312C READ_WRITE /end MEASUREMENT
/begin MEASUREMENT vFSTDREF "RAM value vFSTDREF" UBYTE COMP_0068 1 100 0 255 ECU_ADDRESS 0xFFFF0955 READ_WRITE /end MEASUREMENT
/begin MEASUREMENT vFSTICHG "RAM value vFSTICHG" UBYTE COMP_0068 1 100 0 255 ECU_ADDRESS 0xFFFF1764 READ_WRITE /end MEASUREMENT
/begin MEASUREMENT vFSTRNO "RAM value vFSTRNO" UBYTE COMP_0068 1 100 0 255 ECU_ADDRESS 0xFFFF2762 READ_WRITE /end MEASUREMENT
/begin MEASUREMENT vFSYSIMR "RAM value vFSYSIMR" UBYTE COMP_0004 1 100 0 255 ECU_ADDRESS 0xFFFF2763 READ_WRITE /end MEASUREMENT
/begin MEASUREMENT vFTDLYFUL "RAM value vFTDLYFUL" UBYTE COMP_0014 1 100 0 2550 ECU_ADDRESS 0xFFFF2764 READ_WRITE /end MEASUREMENT
/begin MEASUREMENT vFTFMCH "RAM value vFTFMCH" UBYTE COMP_0004 1 100 0 255 ECU_ADDRESS 0xFFFF0BDD READ_WRITE /end MEASUREMENT
/begin MEASUREMENT vFTFMCHZ "RAM value vFTFMCHZ" UBYTE COMP_0004 1 100 0 255 ECU_ADDRESS 0xFFFF0BDE READ_WRITE /end MEASUREMENT
/begin MEASUREMENT vFTITMCTL "RAM value vFTITMCTL" UBYTE COMP_0016 1 100 0 255 ECU_ADDRESS 0xFFFF1765 READ_WRITE /end MEASUREMENT
/begin MEASUREMENT vFTITMHLD "RAM value vFTITMHLD" UBYTE COMP_0068 1 100 0 255 ECU_ADDRESS 0xFFFF0BDF READ_WRITE /end MEASUREMENT
/begin MEASUREMENT vFTITMHSD "RAM value vFTITMHSD" UBYTE COMP_0068 1 100 0 255 ECU_ADDRESS 0xFFFF0BE0 READ_WRITE /end MEASUREMENT
/begin MEASUREMENT vFUELG "RAM value vFUELG" UBYTE COMP_0021 1 100 0 99.609375 ECU_ADDRESS 0xFFFF0BE1 READ_WRITE /end MEASUREMENT
/begin MEASUREMENT vFUKEADV "RAM value vFUKEADV" SBYTE COMP_0018 1 100 -128 127 ECU_ADDRESS 0xFFFF1766 READ_WRITE /end MEASUREMENT
/begin MEASUREMENT vFUKENEP "RAM value vFUKENEP" UBYTE COMP_0065 1 100 0 796.875 ECU_ADDRESS 0xFFFF0BE2 READ_WRITE /end MEASUREMENT
/begin MEASUREMENT vFUKEVSP "RAM value vFUKEVSP" UBYTE COMP_0007 1 100 0 510 ECU_ADDRESS 0xFFFF0BE3 READ_WRITE /end MEASUREMENT
/begin MEASUREMENT vFVAPO "RAM value vFVAPO" UBYTE COMP_0002 1 100 0 89.25 ECU_ADDRESS 0xFFFF0BE4 READ_WRITE /end MEASUREMENT
/begin MEASUREMENT vFVTLNCIBf "RAM value vFVTLNCIBf" UBYTE COMP_0004 1 100 0 255 ECU_ADDRESS 0xFFFF2765 READ_WRITE /end MEASUREMENT
/begin MEASUREMENT vFWKSTGf "RAM value vFWKSTGf" UBYTE COMP_0004 1 100 0 255 ECU_ADDRESS 0xFFFF2766 READ_WRITE /end MEASUREMENT
/begin MEASUREMENT vFWSPFT "RAM value vFWSPFT" UBYTE COMP_0014 1 100 0 2550 ECU_ADDRESS 0xFFFF2051 READ_WRITE /end MEASUREMENT
/begin MEASUREMENT vFWT2IJZ1 "RAM value vFWT2IJZ1" UBYTE COMP_0068 1 100 0 255 ECU_ADDRESS 0xFFFF1B2D READ_WRITE /end MEASUREMENT
/begin MEASUREMENT vFWT2IJZA "RAM value vFWT2IJZA" UBYTE COMP_0068 1 100 0 255 ECU_ADDRESS 0xFFFF0BE5 READ_WRITE /end MEASUREMENT
/begin MEASUREMENT vFWT2INCT "RAM value vFWT2INCT" UBYTE COMP_0016 1 100 0 255 ECU_ADDRESS 0xFFFF1767 READ_WRITE /end MEASUREMENT
/begin MEASUREMENT vFWT2OTCT "RAM value vFWT2OTCT" UBYTE COMP_0016 1 100 0 255 ECU_ADDRESS 0xFFFF1768 READ_WRITE /end MEASUREMENT
/begin MEASUREMENT vG1STSL "RAM value vG1STSL" SWORD COMP_0553_S 1 100 -163.84 163.835 ECU_ADDRESS 0xFFFF176A READ_WRITE /end MEASUREMENT
/begin MEASUREMENT vGAC "RAM value vGAC" UWORD COMP_0550_S 1 100 0 31.999495335 ECU_ADDRESS 0xFFFF0BE6 READ_WRITE /end MEASUREMENT
/begin MEASUREMENT vGACC1 "RAM value vGACC1" UWORD COMP_0554_S 1 100 -32.768 32.767 ECU_ADDRESS 0xFFFF0BE8 READ_WRITE /end MEASUREMENT
/begin MEASUREMENT vGACC2 "RAM value vGACC2" SWORD COMP_0242_S 1 100 -32.768 32.767 ECU_ADDRESS 0xFFFF0BEA READ_WRITE /end MEASUREMENT
/begin MEASUREMENT vGACCEL "RAM value vGACCEL" UWORD COMP_0136_S 1 100 -1.8907 240.5888 ECU_ADDRESS 0xFFFF3738 READ_WRITE /end MEASUREMENT
/begin MEASUREMENT vGACCFL "RAM value vGACCFL" ULONG COMP_0555_S 1 100 -32.7680234881024 32.7680234728436 ECU_ADDRESS 0xFFFF0BEC READ_WRITE /end MEASUREMENT
/begin MEASUREMENT vGAFBI2 "RAM value vGAFBI2" UBYTE COMP_0126_S 1 100 0 1.275 ECU_ADDRESS 0xFFFF176C READ_WRITE /end MEASUREMENT
/begin MEASUREMENT vGAFBP2 "RAM value vGAFBP2" UBYTE COMP_0126_S 1 100 0 1.275 ECU_ADDRESS 0xFFFF176D READ_WRITE /end MEASUREMENT
/begin MEASUREMENT vGAFBP3 "RAM value vGAFBP3" SWORD COMP_0553_S 1 100 -163.84 163.835 ECU_ADDRESS 0xFFFF176E READ_WRITE /end MEASUREMENT
/begin MEASUREMENT vGAFDLR "RAM value vGAFDLR" UWORD COMP_0453 1 100 0 131.07 ECU_ADDRESS 0xFFFF5192 READ_WRITE /end MEASUREMENT
/begin MEASUREMENT vGAFDRL "RAM value vGAFDRL" UWORD COMP_0453 1 100 0 131.07 ECU_ADDRESS 0xFFFF5194 READ_WRITE /end MEASUREMENT
/begin MEASUREMENT vGAFSMN "RAM value vGAFSMN" UWORD COMP_0023 1 100 0 327675 ECU_ADDRESS 0xFFFF5196 READ_WRITE /end MEASUREMENT
/begin MEASUREMENT vGAFSMX "RAM value vGAFSMX" UWORD COMP_0023 1 100 0 327675 ECU_ADDRESS 0xFFFF5198 READ_WRITE /end MEASUREMENT
/begin MEASUREMENT vGAFSTD "RAM value vGAFSTD" UWORD COMP_0023 1 100 0 327675 ECU_ADDRESS 0xFFFF519A READ_WRITE /end MEASUREMENT
/begin MEASUREMENT vGAHOSL "RAM value vGAHOSL" SWORD COMP_0020_S 1 100 -65.536 65.534 ECU_ADDRESS 0xFFFF519C READ_WRITE /end MEASUREMENT
/begin MEASUREMENT vGAHOSR "RAM value vGAHOSR" SWORD COMP_0020_S 1 100 -65.536 65.534 ECU_ADDRESS 0xFFFF519E READ_WRITE /end MEASUREMENT
/begin MEASUREMENT vGAKADVA "RAM value vGAKADVA" SWORD COMP_0018 1 100 -32768 32767 ECU_ADDRESS 0xFFFF0BF0 READ_WRITE /end MEASUREMENT
/begin MEASUREMENT vGAKADVR "RAM value vGAKADVR" SWORD COMP_0018 1 100 -32768 32767 ECU_ADDRESS 0xFFFF0BF2 READ_WRITE /end MEASUREMENT
/begin MEASUREMENT vGAKADVRI "RAM value vGAKADVRI" UBYTE COMP_0017 1 100 0 255 ECU_ADDRESS 0xFFFF0BF4 READ_WRITE /end MEASUREMENT
/begin MEASUREMENT vGAKUADV "RAM value vGAKUADV" SBYTE COMP_0018 1 100 -128 127 ECU_ADDRESS 0xFFFF0BF5 READ_WRITE /end MEASUREMENT
/begin MEASUREMENT vGAKUADVR "RAM value vGAKUADVR" UBYTE COMP_0017 1 100 0 255 ECU_ADDRESS 0xFFFF0BF6 READ_WRITE /end MEASUREMENT
/begin MEASUREMENT vGASCD "RAM value vGASCD" UWORD COMP_0127_S 1 100 -4.079616 4.0794915 ECU_ADDRESS 0xFFFF373A READ_WRITE /end MEASUREMENT
/begin MEASUREMENT vGATAZNE "RAM value vGATAZNE" UBYTE COMP_0065 1 100 0 796.875 ECU_ADDRESS 0xFFFF0BF7 READ_WRITE /end MEASUREMENT
/begin MEASUREMENT vGAVGAFH "RAM value vGAVGAFH" UWORD COMP_0061 1 100 0 327675 ECU_ADDRESS 0xFFFF51A0 READ_WRITE /end MEASUREMENT
/begin MEASUREMENT vGAVGAFHf "RAM value vGAVGAFHf" UBYTE COMP_0004 1 100 0 255 ECU_ADDRESS 0xFFFF2767 READ_WRITE /end MEASUREMENT
/begin MEASUREMENT vGCALMAX "RAM value vGCALMAX" UWORD COMP_0136_S 1 100 -1.8907 240.5888 ECU_ADDRESS 0xFFFF373C READ_WRITE /end MEASUREMENT
/begin MEASUREMENT vGCALMIN "RAM value vGCALMIN" UWORD COMP_0136_S 1 100 -1.8907 240.5888 ECU_ADDRESS 0xFFFF373E READ_WRITE /end MEASUREMENT
/begin MEASUREMENT vGCATNGf "RAM value vGCATNGf" UBYTE COMP_0004 1 100 0 255 ECU_ADDRESS 0xFFFF2768 READ_WRITE /end MEASUREMENT
/begin MEASUREMENT vGCATOKf "RAM value vGCATOKf" UBYTE COMP_0004 1 100 0 255 ECU_ADDRESS 0xFFFF2769 READ_WRITE /end MEASUREMENT
/begin MEASUREMENT vGCMOIM34 "RAM value vGCMOIM34" UBYTE COMP_0030 1 100 0 255 ECU_ADDRESS 0xFFFF4F00 READ_WRITE /end MEASUREMENT
/begin MEASUREMENT vGCMOTMP "RAM value vGCMOTMP" UBYTE COMP_0030 1 100 0 255 ECU_ADDRESS 0xFFFF3740 READ_WRITE /end MEASUREMENT
/begin MEASUREMENT vGCMOTMP2 "RAM value vGCMOTMP2" UBYTE COMP_0030 1 100 0 255 ECU_ADDRESS 0xFFFF276A READ_WRITE /end MEASUREMENT
/begin MEASUREMENT vGCRTCAT "RAM value vGCRTCAT" ULONG COMP_0074 1 100 0 16777215.9960938 ECU_ADDRESS 0xFFFF51A4 READ_WRITE /end MEASUREMENT
/begin MEASUREMENT vGCRTEM "RAM value vGCRTEM" UWORD COMP_0016 1 100 0 65535 ECU_ADDRESS 0xFFFF51A8 READ_WRITE /end MEASUREMENT
/begin MEASUREMENT vGCRTFUK "RAM value vGCRTFUK" ULONG COMP_0074 1 100 0 16777215.9960938 ECU_ADDRESS 0xFFFF51AC READ_WRITE /end MEASUREMENT
/begin MEASUREMENT vGCRTIA "RAM value vGCRTIA" UWORD COMP_0016 1 100 0 65535 ECU_ADDRESS 0xFFFF51B0 READ_WRITE /end MEASUREMENT
/begin MEASUREMENT vGCVN "RAM value vGCVN" UBYTE COMP_0068 1 100 0 255 ECU_ADDRESS 0xFFFF51B2 READ_WRITE /end MEASUREMENT
/begin MEASUREMENT vGDAFMAX "RAM value vGDAFMAX" UWORD COMP_0556_S 1 100 0 262.14 ECU_ADDRESS 0xFFFF46CC READ_WRITE /end MEASUREMENT
/begin MEASUREMENT vGDAFMIN "RAM value vGDAFMIN" SWORD COMP_0072_S 1 100 -131.072 131.068 ECU_ADDRESS 0xFFFF46CE READ_WRITE /end MEASUREMENT
/begin MEASUREMENT vGDEC2 "RAM value vGDEC2" SWORD COMP_0242_S 1 100 -32.768 32.767 ECU_ADDRESS 0xFFFF276C READ_WRITE /end MEASUREMENT
/begin MEASUREMENT vGDECFL "RAM value vGDECFL" ULONG COMP_0555_S 1 100 -32.7680234881024 32.7680234728436 ECU_ADDRESS 0xFFFF2770 READ_WRITE /end MEASUREMENT
/begin MEASUREMENT vGDEGR1 "RAM value vGDEGR1" UBYTE COMP_0557_S 1 100 0 255 ECU_ADDRESS 0xFFFF46D0 READ_WRITE /end MEASUREMENT
/begin MEASUREMENT vGDEGR2 "RAM value vGDEGR2" UBYTE COMP_0557_S 1 100 0 255 ECU_ADDRESS 0xFFFF46D1 READ_WRITE /end MEASUREMENT
/begin MEASUREMENT vGDEGR3 "RAM value vGDEGR3" UBYTE COMP_0003 1 100 0 255 ECU_ADDRESS 0xFFFF46D2 READ_WRITE /end MEASUREMENT
/begin MEASUREMENT vGDPPSV "RAM value vGDPPSV" UBYTE COMP_0558_S 1 100 0 7.96875 ECU_ADDRESS 0xFFFF0BF8 READ_WRITE /end MEASUREMENT
/begin MEASUREMENT vGDTC "RAM value vGDTC" UWORD COMP_0004 1 100 0 65535 ECU_ADDRESS 0xFFFF3742 READ_WRITE /end MEASUREMENT
/begin MEASUREMENT vGDUTY "RAM value vGDUTY" UWORD COMP_0419 1 100 0 6553.5 ECU_ADDRESS 0xFFFF3744 READ_WRITE /end MEASUREMENT
/begin MEASUREMENT vGEAROLD "RAM value vGEAROLD" UBYTE COMP_0068 1 100 0 255 ECU_ADDRESS 0xFFFF2774 READ_WRITE /end MEASUREMENT
/begin MEASUREMENT vGEGRO "RAM value vGEGRO" UBYTE COMP_0003 1 100 0 255 ECU_ADDRESS 0xFFFF46D3 READ_WRITE /end MEASUREMENT
/begin MEASUREMENT vGENMODE "RAM value vGENMODE" UBYTE COMP_0068 1 100 0 255 ECU_ADDRESS 0xFFFF2775 READ_WRITE /end MEASUREMENT
/begin MEASUREMENT vGENMODEZ "RAM value vGENMODEZ" UBYTE COMP_0068 1 100 0 255 ECU_ADDRESS 0xFFFF2776 READ_WRITE /end MEASUREMENT
/begin MEASUREMENT vGEPDES "RAM value vGEPDES" SWORD COMP_0002_S 1 100 -32768 32767 ECU_ADDRESS 0xFFFF4F02 READ_WRITE /end MEASUREMENT
/begin MEASUREMENT vGEPRS "RAM value vGEPRS" SWORD COMP_0002_S 1 100 -32768 32767 ECU_ADDRESS 0xFFFF4F04 READ_WRITE /end MEASUREMENT
/begin MEASUREMENT vGERATIO "RAM value vGERATIO" UWORD COMP_0450 1 100 0 63.999056205 ECU_ADDRESS 0xFFFF1770 READ_WRITE /end MEASUREMENT
/begin MEASUREMENT vGERROR "RAM value vGERROR" SBYTE COMP_0172_S 1 100 -64 63.5 ECU_ADDRESS 0xFFFF51B6 READ_WRITE /end MEASUREMENT
/begin MEASUREMENT vGERRORE "RAM value vGERRORE" SBYTE COMP_0172_S 1 100 -64 63.5 ECU_ADDRESS 0xFFFF51B8 READ_WRITE /end MEASUREMENT
/begin MEASUREMENT vGEVAC "RAM value vGEVAC" SWORD COMP_0002_S 1 100 -32768 32767 ECU_ADDRESS 0xFFFF4F06 READ_WRITE /end MEASUREMENT
/begin MEASUREMENT vGEVPRE "RAM value vGEVPRE" SWORD COMP_0002_S 1 100 -32768 32767 ECU_ADDRESS 0xFFFF4F08 READ_WRITE /end MEASUREMENT
/begin MEASUREMENT vGFAFS "RAM value vGFAFS" UWORD COMP_0023 1 100 0 327675 ECU_ADDRESS 0xFFFF51BA READ_WRITE /end MEASUREMENT
/begin MEASUREMENT vGFAFSHM "RAM value vGFAFSHM" UWORD COMP_0023 1 100 0 327675 ECU_ADDRESS 0xFFFF51BC READ_WRITE /end MEASUREMENT
/begin MEASUREMENT vGFAFSLM "RAM value vGFAFSLM" UWORD COMP_0023 1 100 0 327675 ECU_ADDRESS 0xFFFF51BE READ_WRITE /end MEASUREMENT
/begin MEASUREMENT vGFCAT1 "RAM value vGFCAT1" UBYTE COMP_0068 1 100 0 255 ECU_ADDRESS 0xFFFF51C0 READ_WRITE /end MEASUREMENT
/begin MEASUREMENT vGFCAT2 "RAM value vGFCAT2" UBYTE COMP_0062_S 1 100 0 255 ECU_ADDRESS 0xFFFF51C2 READ_WRITE /end MEASUREMENT
/begin MEASUREMENT vGFD "RAM value vGFD" SWORD COMP_0514_S 1 100 -32768 32767 ECU_ADDRESS 0xFFFF0BFA READ_WRITE /end MEASUREMENT
/begin MEASUREMENT vGGSM8RE "RAM value vGGSM8RE" UBYTE COMP_0068 1 100 0 255 ECU_ADDRESS 0xFFFF2777 READ_WRITE /end MEASUREMENT
/begin MEASUREMENT vGHF "RAM value vGHF" UBYTE COMP_0186 1 100 0 3.984375 ECU_ADDRESS 0xFFFF0BFC READ_WRITE /end MEASUREMENT
/begin MEASUREMENT vGHFITC "RAM value vGHFITC" UBYTE COMP_0045 1 100 0 1.9921875 ECU_ADDRESS 0xFFFF0BFD READ_WRITE /end MEASUREMENT
/begin MEASUREMENT vGHFSV "RAM value vGHFSV" UBYTE COMP_0045 1 100 0 1.9921875 ECU_ADDRESS 0xFFFF0BFE READ_WRITE /end MEASUREMENT
/begin MEASUREMENT vGKBLRC "RAM value vGKBLRC" UWORD COMP_0031 1 100 0 255.99609375 ECU_ADDRESS 0xFFFF4F0A READ_WRITE /end MEASUREMENT
/begin MEASUREMENT vGKBLTMP "RAM value vGKBLTMP" UWORD COMP_0031 1 100 0 255.99609375 ECU_ADDRESS 0xFFFF162C READ_WRITE /end MEASUREMENT
/begin MEASUREMENT vGKPRG "RAM value vGKPRG" UWORD COMP_0198_S 1 100 0 63.999056205 ECU_ADDRESS 0xFFFF2778 READ_WRITE /end MEASUREMENT
/begin MEASUREMENT vGKTVOF "RAM value vGKTVOF" UBYTE COMP_0023 1 100 0 1275 ECU_ADDRESS 0xFFFF4F0E READ_WRITE /end MEASUREMENT
/begin MEASUREMENT vGLEKAL "RAM value vGLEKAL" UBYTE COMP_0232 1 100 0 1.9921875 ECU_ADDRESS 0xFFFF46D4 READ_WRITE /end MEASUREMENT
/begin MEASUREMENT vGLEKAL3 "RAM value vGLEKAL3" UWORD COMP_0479_S 1 100 0 1.999970916 ECU_ADDRESS 0xFFFF51C4 READ_WRITE /end MEASUREMENT
/begin MEASUREMENT vGLEKF3 "RAM value vGLEKF3" UWORD COMP_0479_S 1 100 0 1.999970916 ECU_ADDRESS 0xFFFF51C6 READ_WRITE /end MEASUREMENT
/begin MEASUREMENT vGLEKLM "RAM value vGLEKLM" UBYTE COMP_0232 1 100 0 1.9921875 ECU_ADDRESS 0xFFFF46D5 READ_WRITE /end MEASUREMENT
/begin MEASUREMENT vGLKAL2 "RAM value vGLKAL2" UBYTE COMP_0232 1 100 0 1.9921875 ECU_ADDRESS 0xFFFF46D6 READ_WRITE /end MEASUREMENT
/begin MEASUREMENT vGLKLM2 "RAM value vGLKLM2" UBYTE COMP_0232 1 100 0 1.9921875 ECU_ADDRESS 0xFFFF46D7 READ_WRITE /end MEASUREMENT
/begin MEASUREMENT vGLRNOK "RAM value vGLRNOK" UBYTE COMP_0068 1 100 0 255 ECU_ADDRESS 0xFFFF4400 READ_WRITE /end MEASUREMENT
/begin MEASUREMENT vGM "RAM value vGM" UWORD COMP_0132_S 1 100 0 0.1999970916 ECU_ADDRESS 0xFFFF277A READ_WRITE /end MEASUREMENT
/* COMPU_METHOD --------------------------------------------------------- */
/begin COMPU_METHOD COMP_0017 "1deg" RAT_FUNC "%8.2" "deg" COEFFS 0 1 0 0 0 1 /end COMPU_METHOD
/begin COMPU_METHOD COMP_0004 "1－" RAT_FUNC "%8.2" "－" COEFFS 0 1 0 0 0 1 /end COMPU_METHOD
/begin COMPU_METHOD COMP_0068 "1-" RAT_FUNC "%8.2" "-" COEFFS 0 1 0 0 0 1 /end COMPU_METHOD
/begin COMPU_METHOD COMP_0001_S "1Pa" RAT_FUNC "%8.2" "Pa" COEFFS 0 1 0 0 0 1 /end COMPU_METHOD
/begin COMPU_METHOD COMP_0002_S "1Pa" RAT_FUNC "%8.2" "Pa" COEFFS 0 1 0 0 0 1 /end COMPU_METHOD
/begin COMPU_METHOD COMP_0003_S "0.2℃" RAT_FUNC "%8.2" "℃" COEFFS 0 1 0 0 0 0.2 /end COMPU_METHOD
/begin COMPU_METHOD COMP_0013 "1s" RAT_FUNC "%8.2" "s" COEFFS 0 1 0 0 0 1 /end COMPU_METHOD
/begin COMPU_METHOD COMP_0238 "100/128%" RAT_FUNC "%8.2" "%" COEFFS 0 1 0 0 0 0.78125 /end COMPU_METHOD
/begin COMPU_METHOD COMP_0014 "10ms" RAT_FUNC "%8.2" "ms" COEFFS 0 1 0 0 0 10 /end COMPU_METHOD
/begin COMPU_METHOD COMP_0074 "1/256count" RAT_FUNC "%8.4" "count" COEFFS 0 1 0 0 0 0.00390625 /end COMPU_METHOD
/begin COMPU_METHOD COMP_0045 "1/128-" RAT_FUNC "%8.4" "-" COEFFS 0 1 0 0 0 0.0078125 /end COMPU_METHOD
/begin COMPU_METHOD COMP_0009 "100/128%" RAT_FUNC "%8.2" "%" COEFFS 0 1 0 0 0 0.78125 /end COMPU_METHOD
/begin COMPU_METHOD COMP_0000 "25rpm" RAT_FUNC "%8.2" "rpm" COEFFS 0 1 0 0 0 25 /end COMPU_METHOD
/begin COMPU_METHOD COMP_0186 "1/64-" RAT_FUNC "%8.3" "-" COEFFS 0 1 0 0 0 0.015625 /end COMPU_METHOD
/begin COMPU_METHOD COMP_0001 "1/8ms" RAT_FUNC "%8.2" "ms" COEFFS 0 1 0 0 0 0.125 /end COMPU_METHOD
/begin COMPU_METHOD COMP_0020 "50rpm" RAT_FUNC "%8.2" "rpm" COEFFS 0 1 0 0 0 50 /end COMPU_METHOD
/begin COMPU_METHOD COMP_0004_S "X-50degC" RAT_FUNC "%8.2" "degC" COEFFS 0 1 50 0 0 1 /end COMPU_METHOD
/begin COMPU_METHOD COMP_0388 "0.1-" RAT_FUNC "%8.2" "-" COEFFS 0 1 0 0 0 0.1 /end COMPU_METHOD
/begin COMPU_METHOD COMP_0373 "1/100-" RAT_FUNC "%8.3" "-" COEFFS 0 1 0 0 0 0.01 /end COMPU_METHOD
/begin COMPU_METHOD COMP_0002 "0.35deg" RAT_FUNC "%8.2" "deg" COEFFS 0 1 0 0 0 0.35 /end COMPU_METHOD
/begin COMPU_METHOD COMP_0003 "1℃" RAT_FUNC "%8.2" "℃" COEFFS 0 1 0 0 0 1 /end COMPU_METHOD
/begin COMPU_METHOD COMP_0035 "X-50℃" RAT_FUNC "%8.2" "℃" COEFFS 0 1 50 0 0 1 /end COMPU_METHOD
/begin COMPU_METHOD COMP_0453 "0.002-" RAT_FUNC "%8.4" "-" COEFFS 0 1 0 0 0 0.002 /end COMPU_METHOD
/begin COMPU_METHOD COMP_0007_S "0.11deg/100m" RAT_FUNC "%8.2" "deg/100m" COEFFS 0 1 0 0 0 0.11 /end COMPU_METHOD
/begin COMPU_METHOD COMP_0005 "0.11deg" RAT_FUNC "%8.2" "deg" COEFFS 0 1 0 0 0 0.11 /end COMPU_METHOD
/begin COMPU_METHOD COMP_0006 "12.5rpm" RAT_FUNC "%8.2" "rpm" COEFFS 0 1 0 0 0 12.5 /end COMPU_METHOD
/begin COMPU_METHOD COMP_0008 "100ms" RAT_FUNC "%8.2" "ms" COEFFS 0 1 0 0 0 100 /end COMPU_METHOD
/begin COMPU_METHOD COMP_0007 "2km/h" RAT_FUNC "%8.2" "km/h" COEFFS 0 1 0 0 0 2 /end COMPU_METHOD
/begin COMPU_METHOD COMP_0047 "0.5%" RAT_FUNC "%8.2" "%" COEFFS 0 1 0 0 0 0.5 /end COMPU_METHOD
/begin COMPU_METHOD COMP_0353 "5mV" RAT_FUNC "%8.2" "mV" COEFFS 0 1 0 0 0 5 /end COMPU_METHOD
/begin COMPU_METHOD COMP_0018 "1deg" RAT_FUNC "%8.2" "deg" COEFFS 0 1 0 0 0 1 /end COMPU_METHOD
/begin COMPU_METHOD COMP_0081 "1/256deg" RAT_FUNC "%8.4" "deg" COEFFS 0 1 0 0 0 0.00390625 /end COMPU_METHOD
/begin COMPU_METHOD COMP_0217 "1/16384-" RAT_FUNC "%8.6" "-" COEFFS 0 1 0 0 0 0.0000610352 /end COMPU_METHOD
/begin COMPU_METHOD COMP_0023 "5mV" RAT_FUNC "%8.2" "mV" COEFFS 0 1 0 0 0 5 /end COMPU_METHOD
/begin COMPU_METHOD COMP_0033 "80mV" RAT_FUNC "%8.2" "mV" COEFFS 0 1 0 0 0 80 /end COMPU_METHOD
/begin COMPU_METHOD COMP_0027 "1%" RAT_FUNC "%8.2" "%" COEFFS 0 1 0 0 0 1 /end COMPU_METHOD
/begin COMPU_METHOD COMP_0015_S "0.1sec" RAT_FUNC "%8.2" "sec" COEFFS 0 1 0 0 0 0.1 /end COMPU_METHOD
/begin COMPU_METHOD COMP_0061 "5mv" RAT_FUNC "%8.2" "mv" COEFFS 0 1 0 0 0 5 /end COMPU_METHOD
/begin COMPU_METHOD COMP_0049 "1sec" RAT_FUNC "%8.2" "sec" COEFFS 0 1 0 0 0 1 /end COMPU_METHOD
/begin COMPU_METHOD COMP_0032 "1/256－" RAT_FUNC "%8.4" "－" COEFFS 0 1 0 0 0 0.00390625 /end COMPU_METHOD
/begin COMPU_METHOD COMP_0018_S "0.5/256-" RAT_FUNC "%8.4" "-" COEFFS 0 1 0 0 0 0.001953125 /end COMPU_METHOD
/begin COMPU_METHOD COMP_0063 "1/256-" RAT_FUNC "%8.4" "-" COEFFS 0 1 0 0 0 0.00390625 /end COMPU_METHOD
/begin COMPU_METHOD COMP_0019_S "1/255-" RAT_FUNC "%8.4" "-" COEFFS 0 1 0 0 0 0.003921569 /end COMPU_METHOD
/begin COMPU_METHOD COMP_0030 "1回" RAT_FUNC "%8.2" "回" COEFFS 0 1 0 0 0 1 /end COMPU_METHOD
/begin COMPU_METHOD COMP_0020_S "0.002-" RAT_FUNC "%8.4" "-" COEFFS 0 1 0 0 0 0.002 /end COMPU_METHOD
/begin COMPU_METHOD COMP_0016 "1count" RAT_FUNC "%8.2" "count" COEFFS 0 1 0 0 0 1 /end COMPU_METHOD
/begin COMPU_METHOD COMP_0443 "1rpm" RAT_FUNC "%8.2" "rpm" COEFFS 0 1 0 0 0 1 /end COMPU_METHOD
/begin COMPU_METHOD COMP_0228 "0.1Nm" RAT_FUNC "%8.2" "Nm" COEFFS 0 1 0 0 0 0.1 /end COMPU_METHOD
/begin COMPU_METHOD COMP_0436 "0.1km/h" RAT_FUNC "%8.2" "km/h" COEFFS 0 1 0 0 0 0.1 /end COMPU_METHOD
/begin COMPU_METHOD COMP_0263 "1-" RAT_FUNC "%8.2" "-" COEFFS 0 1 0 0 0 1 /end COMPU_METHOD
/begin COMPU_METHOD COMP_0256 "64/128degCA" RAT_FUNC "%8.2" "degCA" COEFFS 0 1 64 0 0 0.5 /end COMPU_METHOD
/begin COMPU_METHOD COMP_0031 "1/256%" RAT_FUNC "%8.4" "%" COEFFS 0 1 0 0 0 0.00390625 /end COMPU_METHOD
/begin COMPU_METHOD COMP_0026_S "0.35deg/150m" RAT_FUNC "%8.2" "deg/150m" COEFFS 0 1 0 0 0 0.35 /end COMPU_METHOD
/begin COMPU_METHOD COMP_0027_S "5000Asec" RAT_FUNC "%8.2" "Asec" COEFFS 0 1 0 0 0 5000 /end COMPU_METHOD
/begin COMPU_METHOD COMP_0065 "3.125rpm" RAT_FUNC "%8.2" "rpm" COEFFS 0 1 0 0 0 3.125 /end COMPU_METHOD
/begin COMPU_METHOD COMP_0032_S "0.125%" RAT_FUNC "%8.2" "%" COEFFS 0 1 0 0 0 0.125 /end COMPU_METHOD
/begin COMPU_METHOD COMP_0036_S "1A100ms" RAT_FUNC "%8.2" "A100ms" COEFFS 0 1 0 0 0 1 /end COMPU_METHOD
/begin COMPU_METHOD COMP_0039_S "1Pa" RAT_FUNC "%8.2" "Pa" COEFFS 0 1 -60000 0 0 1 /end COMPU_METHOD
/begin COMPU_METHOD COMP_0040_S "0.01s" RAT_FUNC "%8.3" "s" COEFFS 0 1 0 0 0 0.01 /end COMPU_METHOD
/begin COMPU_METHOD COMP_0042 "0.0008cm**2" RAT_FUNC "%8.5" "cm**2" COEFFS 0 1 0 0 0 0.0008 /end COMPU_METHOD
/begin COMPU_METHOD COMP_0044 "1/128－" RAT_FUNC "%8.4" "－" COEFFS 0 1 0 0 0 0.0078125 /end COMPU_METHOD
/begin COMPU_METHOD COMP_0045_S "1A" RAT_FUNC "%8.2" "A" COEFFS 0 1 0 0 0 1 /end COMPU_METHOD
/begin COMPU_METHOD COMP_0054 "20mV" RAT_FUNC "%8.2" "mV" COEFFS 0 1 0 0 0 20 /end COMPU_METHOD
/begin COMPU_METHOD COMP_0450 "1/1024-" RAT_FUNC "%8.5" "-" COEFFS 0 1 0 0 0 0.000976563 /end COMPU_METHOD
/begin COMPU_METHOD COMP_0419 "0.1%" RAT_FUNC "%8.2" "%" COEFFS 0 1 0 0 0 0.1 /end COMPU_METHOD
/begin COMPU_METHOD COMP_0058_S "100A100ms" RAT_FUNC "%8.2" "A100ms" COEFFS 0 1 0 0 0 100 /end COMPU_METHOD
/begin COMPU_METHOD COMP_0105 "0.1s" RAT_FUNC "%8.2" "s" COEFFS 0 1 0 0 0 0.1 /end COMPU_METHOD
/begin COMPU_METHOD COMP_0070 "12.5rpm/s" RAT_FUNC "%8.2" "rpm/s" COEFFS 0 1 0 0 0 12.5 /end COMPU_METHOD
/begin COMPU_METHOD COMP_0062_S "1ms/2^(ST" RAT_FUNC "%8.2" "ms/2^(ST" COEFFS 0 1 0 0 0 1 /end COMPU_METHOD
/begin COMPU_METHOD COMP_0064_S "1N" RAT_FUNC "%8.2" "N" COEFFS 0 1 0 0 0 1 /end COMPU_METHOD
/begin COMPU_METHOD COMP_0070_S "1/655361/10ms" RAT_FUNC "%8.6" "1/10ms" COEFFS 0 1 0 0 0 0.0000152588 /end COMPU_METHOD
/begin COMPU_METHOD COMP_0072_S "0.004-" RAT_FUNC "%8.4" "-" COEFFS 0 1 0 0 0 0.004 /end COMPU_METHOD
/begin COMPU_METHOD COMP_0021 "100/256%" RAT_FUNC "%8.2" "%" COEFFS 0 1 0 0 0 0.390625 /end COMPU_METHOD
/begin COMPU_METHOD COMP_0078 "1/256deg" RAT_FUNC "%8.4" "deg" COEFFS 0 1 0 0 0 0.00390625 /end COMPU_METHOD
/begin COMPU_METHOD COMP_0076_S "2/2561/min/10" RAT_FUNC "%8.4" "1/min/10" COEFFS 0 1 0 0 0 0.0078125 /end COMPU_METHOD
/begin COMPU_METHOD COMP_0079_S "4X-20℃" RAT_FUNC "%8.2" "℃" COEFFS 0 1 20 0 0 4 /end COMPU_METHOD
/begin COMPU_METHOD COMP_0091 "ﾌﾗｸﾞﾌﾗｸﾞ" RAT_FUNC "%8.2" "ﾌﾗｸﾞ" COEFFS 0 1 0 0 0 1 /end COMPU_METHOD
/begin COMPU_METHOD COMP_0081_S "100/256%/100ms" RAT_FUNC "%8.2" "%/100ms" COEFFS 0 1 0 0 0 0.390625 /end COMPU_METHOD
/begin COMPU_METHOD COMP_0082_S "1rpm/50ms" RAT_FUNC "%8.2" "rpm/50ms" COEFFS 0 1 0 0 0 1 /end COMPU_METHOD
/begin COMPU_METHOD COMP_0051 "1L/min" RAT_FUNC "%8.2" "L/min" COEFFS 0 1 0 0 0 1 /end COMPU_METHOD
/begin COMPU_METHOD COMP_0456 "1/(256×128)-" RAT_FUNC "%8.6" "-" COEFFS 0 1 0 0 0 0.0000305176 /end COMPU_METHOD
/begin COMPU_METHOD COMP_0102 "20mV/s" RAT_FUNC "%8.2" "mV/s" COEFFS 0 1 0 0 0 20 /end COMPU_METHOD
/begin COMPU_METHOD COMP_0087_S "0.07808MPa" RAT_FUNC "%8.3" "MPa" COEFFS 0 1 0 0 0 0.07808 /end COMPU_METHOD
/begin COMPU_METHOD COMP_0156 "1L" RAT_FUNC "%8.2" "L" COEFFS 0 1 0 0 0 1 /end COMPU_METHOD
/begin COMPU_METHOD COMP_0050 "5/64mV" RAT_FUNC "%8.3" "mV" COEFFS 0 1 0 0 0 0.078125 /end COMPU_METHOD
/begin COMPU_METHOD COMP_0069 "1/(128*256)－" RAT_FUNC "%8.6" "－" COEFFS 0 1 0 0 0 0.0000305176 /end COMPU_METHOD
/begin COMPU_METHOD COMP_0283 "1flag" RAT_FUNC "%8.2" "flag" COEFFS 0 1 0 0 0 1 /end COMPU_METHOD
/begin COMPU_METHOD COMP_0196 "0.1Nm" RAT_FUNC "%8.2" "Nm" COEFFS 0 1 0 0 0 0.1 /end COMPU_METHOD
/begin COMPU_METHOD COMP_0124 "0.125ms/100ms" RAT_FUNC "%8.2" "ms/100ms" COEFFS 0 1 0 0 0 0.125 /end COMPU_METHOD
/begin COMPU_METHOD COMP_0077 "0.11deg/40ms" RAT_FUNC "%8.2" "deg/40ms" COEFFS 0 1 0 0 0 0.11 /end COMPU_METHOD
/begin COMPU_METHOD COMP_0104_S "0.2mV/10ms" RAT_FUNC "%8.2" "mV/10ms" COEFFS 0 1 0 0 0 0.2 /end COMPU_METHOD
/begin COMPU_METHOD COMP_0104 "10mV" RAT_FUNC "%8.2" "mV" COEFFS 0 1 0 0 0 10 /end COMPU_METHOD
/begin COMPU_METHOD COMP_0140 "0.5STEP" RAT_FUNC "%8.2" "STEP" COEFFS 0 1 0 0 0 0.5 /end COMPU_METHOD
/begin COMPU_METHOD COMP_0141 "50/256%" RAT_FUNC "%8.2" "%" COEFFS 0 1 0 0 0 0.1953125 /end COMPU_METHOD
/begin COMPU_METHOD COMP_0114_S "2^-9kPa" RAT_FUNC "%8.4" "kPa" COEFFS 0 1 0 0 0 0.001953125 /end COMPU_METHOD
/begin COMPU_METHOD COMP_0115_S "0.0001degC" RAT_FUNC "%8.5" "degC" COEFFS 0 1 0 0 0 0.0001 /end COMPU_METHOD
/begin COMPU_METHOD COMP_0119_S "1/256/100ms" RAT_FUNC "%8.4" "/100ms" COEFFS 0 1 0 0 0 0.00390625 /end COMPU_METHOD
/begin COMPU_METHOD COMP_0122_S "5μs" RAT_FUNC "%8.2" "μs" COEFFS 0 1 -35 0 0 5 /end COMPU_METHOD
/begin COMPU_METHOD COMP_0064 "1.5625rpm" RAT_FUNC "%8.2" "rpm" COEFFS 0 1 0 0 0 1.5625 /end COMPU_METHOD
/begin COMPU_METHOD COMP_0126_S "1/200L/min/rp" RAT_FUNC "%8.4" "L/min/rp" COEFFS 0 1 0 0 0 0.005 /end COMPU_METHOD
/begin COMPU_METHOD COMP_0127_S "0.0001245G" RAT_FUNC "%8.5" "G" COEFFS 0 1 4.079616 0 0 0.0001245 /end COMPU_METHOD
/begin COMPU_METHOD COMP_0146 "100/256/256%" RAT_FUNC "%8.4" "%" COEFFS 0 1 0 0 0 0.001525879 /end COMPU_METHOD
/begin COMPU_METHOD COMP_0130_S "0.001G" RAT_FUNC "%8.4" "G" COEFFS 0 1 0 0 0 0.001 /end COMPU_METHOD
/begin COMPU_METHOD COMP_0131_S "0.5Nm" RAT_FUNC "%8.2" "Nm" COEFFS 0 1 0 0 0 0.5 /end COMPU_METHOD
/begin COMPU_METHOD COMP_0132_S "1/327680m" RAT_FUNC "%8.6" "m" COEFFS 0 1 0 0 0 0.00000305176 /end COMPU_METHOD
/begin COMPU_METHOD COMP_0134_S "11/(L/min" RAT_FUNC "%8.2" "1/(L/min" COEFFS 0 1 0 0 0 1 /end COMPU_METHOD
/begin COMPU_METHOD COMP_0136_S "0.0037(X-511)G" RAT_FUNC "%8.4" "G" COEFFS 0 1 1.8907 0 0 0.0037 /end COMPU_METHOD
/begin COMPU_METHOD COMP_0143_S "2^0degC" RAT_FUNC "%8.2" "degC" COEFFS 0 1 0 0 0 1 /end COMPU_METHOD
/begin COMPU_METHOD COMP_0156_S "1/3℃" RAT_FUNC "%8.2" "℃" COEFFS 0 1 0 0 0 0.333333333 /end COMPU_METHOD
/begin COMPU_METHOD COMP_0189 "3.2μS" RAT_FUNC "%8.2" "μS" COEFFS 0 1 0 0 0 3.2 /end COMPU_METHOD
/begin COMPU_METHOD COMP_0172_S "2^-1degCA" RAT_FUNC "%8.2" "degCA" COEFFS 0 1 0 0 0 0.5 /end COMPU_METHOD
/begin COMPU_METHOD COMP_0203 "1/256-" RAT_FUNC "%8.4" "-" COEFFS 0 1 0 0 0 0.00390625 /end COMPU_METHOD
/begin COMPU_METHOD COMP_0028 "1/(100*256)-" RAT_FUNC "%8.6" "-" COEFFS 0 1 0 0 0 0.0000390625 /end COMPU_METHOD
/begin COMPU_METHOD COMP_0130 "0.0275deg" RAT_FUNC "%8.3" "deg" COEFFS 0 1 0 0 0 0.0275 /end COMPU_METHOD
/begin COMPU_METHOD COMP_0182_S "0.001-" RAT_FUNC "%8.4" "-" COEFFS 0 1 0 0 0 0.001 /end COMPU_METHOD
/begin COMPU_METHOD COMP_0232 "1/128mm^2" RAT_FUNC "%8.4" "mm^2" COEFFS 0 1 0 0 0 0.0078125 /end COMPU_METHOD
/begin COMPU_METHOD COMP_0189_S "1/3cyl" RAT_FUNC "%8.2" "cyl" COEFFS 0 1 0 0 0 0.333333333 /end COMPU_METHOD
/begin COMPU_METHOD COMP_0389 "1/2548km" RAT_FUNC "%8.5" "km" COEFFS 0 1 0 0 0 0.000392465 /end COMPU_METHOD
/begin COMPU_METHOD COMP_0195_S "0.1deg" RAT_FUNC "%8.2" "deg" COEFFS 0 1 0 0 0 0.1 /end COMPU_METHOD
/begin COMPU_METHOD COMP_0198_S "2^-10%" RAT_FUNC "%8.5" "%" COEFFS 0 1 0 0 0 0.000976563 /end COMPU_METHOD
/begin COMPU_METHOD COMP_0262 "12.5rpm" RAT_FUNC "%8.2" "rpm" COEFFS 0 1 0 0 0 12.5 /end COMPU_METHOD
/begin COMPU_METHOD COMP_0251 "1cyl" RAT_FUNC "%8.2" "cyl" COEFFS 0 1 0 0 0 1 /end COMPU_METHOD
/begin COMPU_METHOD COMP_0024 "50ms" RAT_FUNC "%8.2" "ms" COEFFS 0 1 0 0 0 50 /end COMPU_METHOD
/begin COMPU_METHOD COMP_0203_S "0.005V" RAT_FUNC "%8.4" "V" COEFFS 0 1 0 0 0 0.005 /end COMPU_METHOD
/begin COMPU_METHOD COMP_0092 "1bit" RAT_FUNC "%8.2" "bit" COEFFS 0 1 0 0 0 1 /end COMPU_METHOD
/begin COMPU_METHOD COMP_0425 "100/255%" RAT_FUNC "%8.2" "%" COEFFS 0 1 0 0 0 0.392156862 /end COMPU_METHOD
/begin COMPU_METHOD COMP_0470 "1km" RAT_FUNC "%8.2" "km" COEFFS 0 1 0 0 0 1 /end COMPU_METHOD
/begin COMPU_METHOD COMP_0238_S "0.01km/h" RAT_FUNC "%8.3" "km/h" COEFFS 0 1 0 0 0 0.01 /end COMPU_METHOD
/begin COMPU_METHOD COMP_0242_S "0.001G" RAT_FUNC "%8.4" "G" COEFFS 0 1 0 0 0 0.001 /end COMPU_METHOD
/begin COMPU_METHOD COMP_0248_S "2^-9L" RAT_FUNC "%8.4" "L" COEFFS 0 1 0 0 0 0.00195313 /end COMPU_METHOD
/begin COMPU_METHOD COMP_0255_S "0.1degC" RAT_FUNC "%8.2" "degC" COEFFS 0 1 0 0 0 0.1 /end COMPU_METHOD
/begin COMPU_METHOD COMP_0429 "1km/h" RAT_FUNC "%8.2" "km/h" COEFFS 0 1 0 0 0 1 /end COMPU_METHOD
/begin COMPU_METHOD COMP_0259_S "0.2℃" RAT_FUNC "%8.2" "℃" COEFFS 0 1 50 0 0 0.2 /end COMPU_METHOD
/begin COMPU_METHOD COMP_0073 "3.2us" RAT_FUNC "%8.2" "us" COEFFS 0 1 0 0 0 3.2 /end COMPU_METHOD
/begin COMPU_METHOD COMP_0320 "1.6μS" RAT_FUNC "%8.2" "μS" COEFFS 0 1 0 0 0 1.6 /end COMPU_METHOD
/begin COMPU_METHOD COMP_0355 "1/256s" RAT_FUNC "%8.4" "s" COEFFS 0 1 0 0 0 0.00390625 /end COMPU_METHOD
/begin COMPU_METHOD COMP_0245 "X-64deg" RAT_FUNC "%8.2" "deg" COEFFS 0 1 64 0 0 1 /end COMPU_METHOD
/begin COMPU_METHOD COMP_0053 "1ms" RAT_FUNC "%8.2" "ms" COEFFS 0 1 0 0 0 1 /end COMPU_METHOD
/begin COMPU_METHOD COMP_0304_S "0.000016kg/s" RAT_FUNC "%8.6" "kg/s" COEFFS 0 1 0 0 0 0.000016 /end COMPU_METHOD
/begin COMPU_METHOD COMP_0308_S "8E-006kg/s" RAT_FUNC "%8.6" "kg/s" COEFFS 0 1 0 0 0 0.000008 /end COMPU_METHOD
/begin COMPU_METHOD COMP_0253 "16/256X10^-3m^3/sec" RAT_FUNC "%8.6" "m^3/sec" COEFFS 0 1 0 0 0 0.0000625 /end COMPU_METHOD
/begin COMPU_METHOD COMP_0329 "2/256%" RAT_FUNC "%8.4" "%" COEFFS 0 1 0 0 0 0.0078125 /end COMPU_METHOD
/begin COMPU_METHOD COMP_0271 "100/128/256%" RAT_FUNC "%8.4" "%" COEFFS 0 1 0 0 0 0.003051758 /end COMPU_METHOD
/begin COMPU_METHOD COMP_0365_S "64/256deg" RAT_FUNC "%8.2" "deg" COEFFS 0 1 0 0 0 0.25 /end COMPU_METHOD
/begin COMPU_METHOD COMP_0396_S "0.25kPa/s" RAT_FUNC "%8.2" "kPa/s" COEFFS 0 1 0 0 0 0.25 /end COMPU_METHOD
/begin COMPU_METHOD COMP_0405_S "0.02degC" RAT_FUNC "%8.3" "degC" COEFFS 0 1 0 0 0 0.02 /end COMPU_METHOD
/begin COMPU_METHOD COMP_0099 "1/16384/10ms" RAT_FUNC "%8.6" "/10ms" COEFFS 0 1 0 0 0 0.0000610352 /end COMPU_METHOD
/begin COMPU_METHOD COMP_0414_S "1.6μs" RAT_FUNC "%8.2" "μs" COEFFS 0 1 52428.8 0 0 1.6 /end COMPU_METHOD
/begin COMPU_METHOD COMP_0417_S "2rpm^(2/3" RAT_FUNC "%8.2" "rpm^(2/3" COEFFS 0 1 0 0 0 2 /end COMPU_METHOD
/begin COMPU_METHOD COMP_0425_S "0.1/256Nm/℃" RAT_FUNC "%8.5" "Nm/℃" COEFFS 0 1 0 0 0 0.000390625 /end COMPU_METHOD
/begin COMPU_METHOD COMP_0426_S "0.00976MPa/2ms" RAT_FUNC "%8.4" "MPa/2ms" COEFFS 0 1 0 0 0 0.00976 /end COMPU_METHOD
/begin COMPU_METHOD COMP_0325 "1.6μS" RAT_FUNC "%8.2" "μS" COEFFS 0 1 52428.8 0 0 1.6 /end COMPU_METHOD
/begin COMPU_METHOD COMP_0402 "1/65535-" RAT_FUNC "%8.6" "-" COEFFS 0 1 0 0 0 0.000015259 /end COMPU_METHOD
/begin COMPU_METHOD COMP_0324 "2/256L/min" RAT_FUNC "%8.4" "L/min" COEFFS 0 1 0 0 0 0.0078125 /end COMPU_METHOD
/begin COMPU_METHOD COMP_0464_S "10ms10ms" RAT_FUNC "%8.2" "10ms" COEFFS 0 1 0 0 0 1 /end COMPU_METHOD
/begin COMPU_METHOD COMP_0467_S "minmin" RAT_FUNC "%8.2" "min" COEFFS 0 1 0 0 0 1 /end COMPU_METHOD
/begin COMPU_METHOD COMP_0468_S "%%" RAT_FUNC "%8.2" "%" COEFFS 0 1 0 0 0 1 /end COMPU_METHOD
/begin COMPU_METHOD COMP_0231 "10μS" RAT_FUNC "%8.2" "μS" COEFFS 0 1 0 0 0 10 /end COMPU_METHOD
/begin COMPU_METHOD COMP_0469_S "mm^3mm^3" RAT_FUNC "%8.2" "mm^3" COEFFS 0 1 0 0 0 0.3125 /end COMPU_METHOD
/begin COMPU_METHOD COMP_0470_S "%%" RAT_FUNC "%8.3" "%" COEFFS 0 1 0 0 0 0.025 /end COMPU_METHOD
/begin COMPU_METHOD COMP_0471_S "VV" RAT_FUNC "%8.5" "V" COEFFS 0 1 0 0 0 0.000122 /end COMPU_METHOD
/begin COMPU_METHOD COMP_0472_S "°°" RAT_FUNC "%8.2" "°" COEFFS 0 1 64 0 0 0.5 /end COMPU_METHOD
/begin COMPU_METHOD COMP_0327 "1/32768-" RAT_FUNC "%8.6" "-" COEFFS 0 1 0 0 0 0.0000305 /end COMPU_METHOD
/begin COMPU_METHOD COMP_0117 "100/128%" RAT_FUNC "%8.2" "%" COEFFS 0 1 100 0 0 0.78125 /end COMPU_METHOD
/begin COMPU_METHOD COMP_0378 "100/255%" RAT_FUNC "%8.2" "%" COEFFS 0 1 0 0 0 0.392156863 /end COMPU_METHOD
/begin COMPU_METHOD COMP_0473_S "kPakPa" RAT_FUNC "%8.2" "kPa" COEFFS 0 1 0 0 0 10 /end COMPU_METHOD
/begin COMPU_METHOD COMP_0474_S "kPakPa" RAT_FUNC "%8.2" "kPa" COEFFS 0 1 0 0 0 1 /end COMPU_METHOD
/begin COMPU_METHOD COMP_0426 "－code" RAT_FUNC "%8.2" "code" COEFFS 0 1 0 0 0 1 /end COMPU_METHOD
/begin COMPU_METHOD COMP_0475_S "PaPa" RAT_FUNC "%8.2" "Pa" COEFFS 0 1 0 0 0 0.25 /end COMPU_METHOD
/begin COMPU_METHOD COMP_0476_S "g/sg/s" RAT_FUNC "%8.3" "g/s" COEFFS 0 1 0 0 0 0.01 /end COMPU_METHOD
/begin COMPU_METHOD COMP_0427 "0.25rpm" RAT_FUNC "%8.2" "rpm" COEFFS 0 1 0 0 0 0.25 /end COMPU_METHOD
/begin COMPU_METHOD COMP_0428 "X-40℃" RAT_FUNC "%8.2" "℃" COEFFS 0 1 40 0 0 1 /end COMPU_METHOD
/begin COMPU_METHOD COMP_0477_S "℃℃" RAT_FUNC "%8.2" "℃" COEFFS 0 1 40 0 0 0.1 /end COMPU_METHOD
/begin COMPU_METHOD COMP_0478_S "VV" RAT_FUNC "%8.4" "V" COEFFS 0 1 0 0 0 0.001 /end COMPU_METHOD
/begin COMPU_METHOD COMP_0479_S "mm^2mm^2" RAT_FUNC "%8.6" "mm^2" COEFFS 0 1 0 0 0 0.0000305176 /end COMPU_METHOD
/begin COMPU_METHOD COMP_0489_S "kjkj" RAT_FUNC "%8.5" "kj" COEFFS 0 1 0 0 0 0.0001 /end COMPU_METHOD
/begin COMPU_METHOD COMP_0264 "1－" RAT_FUNC "%8.2" "－" COEFFS 0 1 0 0 0 1 /end COMPU_METHOD
/begin COMPU_METHOD COMP_0494_S "kmkm" RAT_FUNC "%8.2" "km" COEFFS 0 1 0 0 0 25.72 /end COMPU_METHOD
/begin COMPU_METHOD COMP_0127 "0.35X-0x80deg/30ms" RAT_FUNC "%8.2" "deg/30ms" COEFFS 0 1 44.8 0 0 0.35 /end COMPU_METHOD
/begin COMPU_METHOD COMP_0377 "0.11deg" RAT_FUNC "%8.2" "deg" COEFFS 0 1 0 0 0 0.11 /end COMPU_METHOD
/begin COMPU_METHOD COMP_0118 "40mV" RAT_FUNC "%8.2" "mV" COEFFS 0 1 0 0 0 40 /end COMPU_METHOD
/begin COMPU_METHOD COMP_0511_S "--" RAT_FUNC "%8.6" "-" COEFFS 0 1 0 0 0 0.0000001 /end COMPU_METHOD
/begin COMPU_METHOD COMP_0452 "0.2/256/100ms" RAT_FUNC "%8.5" "/100ms" COEFFS 0 1 0 0 0 0.00078125 /end COMPU_METHOD
/begin COMPU_METHOD COMP_0514_S "NN" RAT_FUNC "%8.2" "N" COEFFS 0 1 0 0 0 1 /end COMPU_METHOD
/begin COMPU_METHOD COMP_0515_S "mm^3mm^3" RAT_FUNC "%8.2" "mm^3" COEFFS 0 1 0 0 0 80 /end COMPU_METHOD
/begin COMPU_METHOD COMP_0516_S "回回" RAT_FUNC "%8.4" "回" COEFFS 0 1 0 0 0 0.0016 /end COMPU_METHOD
/begin COMPU_METHOD COMP_0517_S "deg/10msdeg/10ms" RAT_FUNC "%8.2" "deg/10ms" COEFFS 0 1 0 0 0 1 /end COMPU_METHOD
/begin COMPU_METHOD COMP_0518_S "rev/10msrev/10ms" RAT_FUNC "%8.2" "rev/10ms" COEFFS 0 1 0 0 0 12.5 /end COMPU_METHOD
/begin COMPU_METHOD COMP_0519_S "degCdegC" RAT_FUNC "%8.2" "degC" COEFFS 0 1 0 0 0 1 /end COMPU_METHOD
/begin COMPU_METHOD COMP_0390 "10deg" RAT_FUNC "%8.2" "deg" COEFFS 0 1 0 0 0 10 /end COMPU_METHOD
/begin COMPU_METHOD COMP_0520_S "%%" RAT_FUNC "%8.4" "%" COEFFS 0 1 0 0 0 0.0078125 /end COMPU_METHOD
/begin COMPU_METHOD COMP_0391 "100/256%" RAT_FUNC "%8.2" "%" COEFFS 0 1 0 0 0 0.391 /end COMPU_METHOD
/begin COMPU_METHOD COMP_0521_S "μsμs" RAT_FUNC "%8.2" "μs" COEFFS 0 1 0 0 0 0.1 /end COMPU_METHOD
/begin COMPU_METHOD COMP_0522_S "cyl(BIT位置)cyl(BIT" RAT_FUNC "%8.2" "cyl(BIT" COEFFS 0 1 0 0 0 1 /end COMPU_METHOD
/begin COMPU_METHOD COMP_0523_S "%%" RAT_FUNC "%8.5" "%" COEFFS 0 1 0 0 0 0.0009766 /end COMPU_METHOD
/begin COMPU_METHOD COMP_0393 "5mV" RAT_FUNC "%8.2" "mV" COEFFS 0 1 163840 0 0 5 /end COMPU_METHOD
/begin COMPU_METHOD COMP_0524_S "degCdegC" RAT_FUNC "%8.2" "degC" COEFFS 0 1 50 0 0 0.1 /end COMPU_METHOD
/begin COMPU_METHOD COMP_0525_S "kjkj" RAT_FUNC "%8.5" "kj" COEFFS 0 1 0 0 0 0.0001 /end COMPU_METHOD
/begin COMPU_METHOD COMP_0394 "12.8μS" RAT_FUNC "%8.2" "μS" COEFFS 0 1 0 0 0 12.8 /end COMPU_METHOD
/begin COMPU_METHOD COMP_0526_S "*10ms*10ms" RAT_FUNC "%8.2" "*10ms" COEFFS 0 1 0 0 0 1 /end COMPU_METHOD
/begin COMPU_METHOD COMP_0396 "2/256l/min" RAT_FUNC "%8.4" "l/min" COEFFS 0 1 0 0 0 0.0078125 /end COMPU_METHOD
/begin COMPU_METHOD COMP_0438 "1/256%" RAT_FUNC "%8.4" "%" COEFFS 0 1 0 0 0 0.00390625 /end COMPU_METHOD
/begin COMPU_METHOD COMP_0059 "0.5%/s" RAT_FUNC "%8.2" "%/s" COEFFS 0 1 0 0 0 0.5 /end COMPU_METHOD
/begin COMPU_METHOD COMP_0527_S "g/secg/sec" RAT_FUNC "%8.4" "g/sec" COEFFS 0 1 0 0 0 0.003906 /end COMPU_METHOD
/begin COMPU_METHOD COMP_0517 "1.6μS" RAT_FUNC "%8.2" "μS" COEFFS 0 1 0 0 0 1.6 /end COMPU_METHOD
/begin COMPU_METHOD COMP_0528_S "μsμs" RAT_FUNC "%8.2" "μs" COEFFS 0 1 0 0 0 1.6 /end COMPU_METHOD
/begin COMPU_METHOD COMP_0529_S "deg/80msdeg/80ms" RAT_FUNC "%8.2" "deg/80ms" COEFFS 0 1 0 0 0 0.11 /end COMPU_METHOD
/begin COMPU_METHOD COMP_0530_S "rpmrpm" RAT_FUNC "%8.3" "rpm" COEFFS 0 1 0 0 0 0.048828125 /end COMPU_METHOD
/begin COMPU_METHOD COMP_0531_S "kPakPa" RAT_FUNC "%8.4" "kPa" COEFFS 0 1 0 0 0 0.00390625 /end COMPU_METHOD
/begin COMPU_METHOD COMP_0532_S "deg/100msdeg/100m" RAT_FUNC "%8.2" "deg/100m" COEFFS 0 1 0 0 0 0.35 /end COMPU_METHOD
/begin COMPU_METHOD COMP_0229 "2km/h" RAT_FUNC "%8.2" "km/h" COEFFS 0 1 256 0 0 2 /end COMPU_METHOD
/begin COMPU_METHOD COMP_0533_S "rpmrpm" RAT_FUNC "%8.2" "rpm" COEFFS 0 1 0 0 0 0.1953125 /end COMPU_METHOD
/begin COMPU_METHOD COMP_0534_S "rpmrpm" RAT_FUNC "%8.2" "rpm" COEFFS 0 1 0 0 0 3.125 /end COMPU_METHOD
/begin COMPU_METHOD COMP_0535_S "mVmV" RAT_FUNC "%8.3" "mV" COEFFS 0 1 2560 0 0 0.078125 /end COMPU_METHOD
/begin COMPU_METHOD COMP_0536_S "L/minL/min" RAT_FUNC "%8.3" "L/min" COEFFS 0 1 0 0 0 0.0625 /end COMPU_METHOD
/begin COMPU_METHOD COMP_0537_S "octoct" RAT_FUNC "%8.5" "oct" COEFFS 0 1 1048575.46312909 0 0 0.000488281 /end COMPU_METHOD
/begin COMPU_METHOD COMP_0538_S "--" RAT_FUNC "%8.3" "-" COEFFS 0 1 0 0 0 0.01 /end COMPU_METHOD
/begin COMPU_METHOD COMP_0539_S "km/hkm/h" RAT_FUNC "%8.6" "km/h" COEFFS 0 1 0 0 0 0.0000390625 /end COMPU_METHOD
/begin COMPU_METHOD COMP_0399 "4℃" RAT_FUNC "%8.2" "℃" COEFFS 0 1 512 0 0 4 /end COMPU_METHOD
/begin COMPU_METHOD COMP_0540_S "℃℃" RAT_FUNC "%8.2" "℃" COEFFS 0 1 128 0 0 1 /end COMPU_METHOD
/begin COMPU_METHOD COMP_0523 "1/1024ms" RAT_FUNC "%8.5" "ms" COEFFS 0 1 0 0 0 0.000976563 /end COMPU_METHOD
/begin COMPU_METHOD COMP_0280 "0.35deg/30ms" RAT_FUNC "%8.2" "deg/30ms" COEFFS 0 1 0 0 0 0.35 /end COMPU_METHOD
/begin COMPU_METHOD COMP_0541_S "mV/500msmV/500ms" RAT_FUNC "%8.2" "mV/500ms" COEFFS 0 1 0 0 0 10 /end COMPU_METHOD
/begin COMPU_METHOD COMP_0236 "0.25km/h" RAT_FUNC "%8.2" "km/h" COEFFS 0 1 0 0 0 0.25 /end COMPU_METHOD
/begin COMPU_METHOD COMP_0542_S "(1/V)^(2/3)(1/V)^(2" RAT_FUNC "%8.4" "(1/V)^(2" COEFFS 0 1 0 0 0 0.0015625 /end COMPU_METHOD
/begin COMPU_METHOD COMP_0543_S "kmkm" RAT_FUNC "%8.2" "km" COEFFS 0 1 0 0 0 0.1005025 /end COMPU_METHOD
/begin COMPU_METHOD COMP_0544_S "kmkm" RAT_FUNC "%8.2" "km" COEFFS 0 1 0 0 0 0.100502513 /end COMPU_METHOD
/begin COMPU_METHOD COMP_0545_S "timestimes" RAT_FUNC "%8.2" "times" COEFFS 0 1 0 0 0 1 /end COMPU_METHOD
/begin COMPU_METHOD COMP_0546_S "kmkm" RAT_FUNC "%8.2" "km" COEFFS 0 1 0 0 0 6584.465 /end COMPU_METHOD
/begin COMPU_METHOD COMP_0547_S "kmkm" RAT_FUNC "%8.2" "km" COEFFS 0 1 0 0 0 0.100471 /end COMPU_METHOD
/begin COMPU_METHOD COMP_0414 "1NO" RAT_FUNC "%8.2" "NO" COEFFS 0 1 0 0 0 1 /end COMPU_METHOD
/begin COMPU_METHOD COMP_0415 "1/256－" RAT_FUNC "%8.4" "－" COEFFS 0 1 0 0 0 0.00390625 /end COMPU_METHOD
/begin COMPU_METHOD COMP_0548_S "℃℃" RAT_FUNC "%8.2" "℃" COEFFS 0 1 30 0 0 0.3333333 /end COMPU_METHOD
/begin COMPU_METHOD COMP_0549_S "degCAdegCA" RAT_FUNC "%8.4" "degCA" COEFFS 0 1 0 0 0 0.0078125 /end COMPU_METHOD
/begin COMPU_METHOD COMP_0416 "8us" RAT_FUNC "%8.2" "us" COEFFS 0 1 0 0 0 8 /end COMPU_METHOD
/begin COMPU_METHOD COMP_0417 "8us" RAT_FUNC "%8.2" "us" COEFFS 0 1 0 0 0 8 /end COMPU_METHOD
/begin COMPU_METHOD COMP_0160 "2/65536L" RAT_FUNC "%8.6" "L" COEFFS 0 1 0 0 0 0.0000305176 /end COMPU_METHOD
/begin COMPU_METHOD COMP_0418 "2.5mA" RAT_FUNC "%8.2" "mA" COEFFS 0 1 0 0 0 2.5 /end COMPU_METHOD
/begin COMPU_METHOD COMP_0158 "1/16－" RAT_FUNC "%8.3" "－" COEFFS 0 1 0 0 0 0.0625 /end COMPU_METHOD
/begin COMPU_METHOD COMP_0550_S "ms/cylms/cyl" RAT_FUNC "%8.5" "ms/cyl" COEFFS 0 1 0 0 0 0.000488281 /end COMPU_METHOD
/begin COMPU_METHOD COMP_0551_S "kg/skg/s" RAT_FUNC "%8.6" "kg/s" COEFFS 0 1 0 0 0 0.000008 /end COMPU_METHOD
/begin COMPU_METHOD COMP_0552_S "NN" RAT_FUNC "%8.3" "N" COEFFS 0 1 0 0 0 0.02 /end COMPU_METHOD
/begin COMPU_METHOD COMP_0424 "1kpa" RAT_FUNC "%8.2" "kpa" COEFFS 0 1 0 0 0 1 /end COMPU_METHOD
/begin COMPU_METHOD COMP_0430 "1/65536m^3/sec" RAT_FUNC "%8.6" "m^3/sec" COEFFS 0 1 0 0 0 0.0000152588 /end COMPU_METHOD
/begin COMPU_METHOD COMP_0553_S "L/min/rpmL/min/rp" RAT_FUNC "%8.4" "L/min/rp" COEFFS 0 1 0 0 0 0.005 /end COMPU_METHOD
/begin COMPU_METHOD COMP_0554_S "GG" RAT_FUNC "%8.4" "G" COEFFS 0 1 32.768 0 0 0.001 /end COMPU_METHOD
/begin COMPU_METHOD COMP_0555_S "GG" RAT_FUNC "%8.6" "G" COEFFS 0 1 32.7680234881024 0 0 0.0000000152588 /end COMPU_METHOD
/begin COMPU_METHOD COMP_0556_S "--" RAT_FUNC "%8.4" "-" COEFFS 0 1 0 0 0 0.004 /end COMPU_METHOD
/begin COMPU_METHOD COMP_0557_S "℃/mEGRTM1[sec]℃/mEGRT" RAT_FUNC "%8.2" "℃/mEGRT" COEFFS 0 1 0 0 0 1 /end COMPU_METHOD
/begin COMPU_METHOD COMP_0558_S "l/minl/min" RAT_FUNC "%8.3" "l/min" COEFFS 0 1 0 0 0 0.03125 /end COMPU_METHOD
/end MODULE
/end PROJECT
