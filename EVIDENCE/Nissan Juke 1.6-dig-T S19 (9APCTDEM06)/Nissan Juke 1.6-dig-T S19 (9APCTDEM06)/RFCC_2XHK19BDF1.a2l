/begin PROJECT X12C_KH3DT_DI_NAM_R/C ""
/begin HEADER "" /* key HEADER ++ "comment" に Par.scomment */ PROJECT_NO X12C_KH3DT_DI_NAM_R/C /* key PROJECT_NO ++ project number に car_eng_desti_lot */ VERSION "0KHDCFDZ7" /* key VERSION ++ version number に mProgver */ /end HEADER
/begin MODULE DIM ""
/begin MOD_COMMON "" ALIGNMENT_BYTE 1 ALIGNMENT_WORD 2 ALIGNMENT_LONG 4 ALIGNMENT_FLOAT32_IEEE 4 ALIGNMENT_FLOAT64_IEEE 4 DEPOSIT ABSOLUTE BYTE_ORDER MSB_FIRST /* ﾊﾞｲﾄｵｰﾀﾞｰがﾘﾌﾟﾚｰｽされる */ /end MOD_COMMON
/begin CHARACTERISTIC mTWCPC "ROM Const mTWCPC" VALUE 0x00008C7D REC_UBYTE_C 0 COMP_0035 -50 205 /end CHARACTERISTIC
/begin CHARACTERISTIC mTWCRADV "ROM Const mTWCRADV" VALUE 0x00008C7E REC_UBYTE_C 0 COMP_0035 -50 205 /end CHARACTERISTIC
/begin CHARACTERISTIC mTWDOWN "ROM Const mTWDOWN" VALUE 0x00008C7F REC_UBYTE_C 0 COMP_0355 0 0.99609375 /end CHARACTERISTIC
/begin CHARACTERISTIC mTWDT1 "ROM Const mTWDT1" VALUE 0x00008C80 REC_UBYTE_C 0 COMP_0035 -50 205 /end CHARACTERISTIC
/begin CHARACTERISTIC mTWDT2 "ROM Const mTWDT2" VALUE 0x00008C81 REC_UBYTE_C 0 COMP_0035 -50 205 /end CHARACTERISTIC
/begin CHARACTERISTIC mTWDT3 "ROM Const mTWDT3" VALUE 0x00008C82 REC_UBYTE_C 0 COMP_0035 -50 205 /end CHARACTERISTIC
/begin CHARACTERISTIC mTWEVCD "ROM Const mTWEVCD" VALUE 0x00008C83 REC_UBYTE_C 0 COMP_0035 -50 205 /end CHARACTERISTIC
/begin CHARACTERISTIC mTWFCD "ROM Const mTWFCD" VALUE 0x00008C84 REC_UBYTE_C 0 COMP_0035 -50 205 /end CHARACTERISTIC
/begin CHARACTERISTIC mTWFEDP "ROM Const mTWFEDP" VALUE 0x00008C85 REC_UBYTE_C 0 COMP_0035 -50 205 /end CHARACTERISTIC
/begin CHARACTERISTIC mTWFSH "ROM Const mTWFSH" VALUE 0x00008C86 REC_UBYTE_C 0 COMP_0054 0 5100 /end CHARACTERISTIC
/begin CHARACTERISTIC mTWFSL "ROM Const mTWFSL" VALUE 0x00008C87 REC_UBYTE_C 0 COMP_0054 0 5100 /end CHARACTERISTIC
/begin CHARACTERISTIC mTWHEAT "ROM Const mTWHEAT" VALUE 0x00008C88 REC_UBYTE_C 0 COMP_0035 -50 205 /end CHARACTERISTIC
/begin CHARACTERISTIC mTWHLMT "ROM Const mTWHLMT" VALUE 0x00008C89 REC_UBYTE_C 0 COMP_0035 -50 205 /end CHARACTERISTIC
/begin CHARACTERISTIC mTWIKB "ROM Const mTWIKB" VALUE 0x00008C8A REC_UBYTE_C 0 COMP_0035 -50 205 /end CHARACTERISTIC
/begin CHARACTERISTIC mTWIMN "ROM Const mTWIMN" VALUE 0x00008C8B REC_UBYTE_C 0 COMP_0035 -50 205 /end CHARACTERISTIC
/begin CHARACTERISTIC mTWIMX "ROM Const mTWIMX" VALUE 0x00008C8C REC_UBYTE_C 0 COMP_0035 -50 205 /end CHARACTERISTIC
/begin CHARACTERISTIC mTWINJ1 "ROM Const mTWINJ1" VALUE 0x00008C8D REC_UBYTE_C 0 COMP_0035 -50 205 /end CHARACTERISTIC
/begin CHARACTERISTIC mTWINJ1T "ROM Const mTWINJ1T" VALUE 0x000095BC REC_UWORD_C 0 COMP_0049 0 65535 /end CHARACTERISTIC
/begin CHARACTERISTIC mTWINJ2T "ROM Const mTWINJ2T" VALUE 0x000095BE REC_UWORD_C 0 COMP_0049 0 65535 /end CHARACTERISTIC
/begin CHARACTERISTIC mTWINJ3T "ROM Const mTWINJ3T" VALUE 0x000095C0 REC_UWORD_C 0 COMP_0049 0 65535 /end CHARACTERISTIC
/begin CHARACTERISTIC mTWINJ4T "ROM Const mTWINJ4T" VALUE 0x000095C2 REC_UWORD_C 0 COMP_0049 0 65535 /end CHARACTERISTIC
/begin CHARACTERISTIC mTWINJT "ROM Const mTWINJT" VALUE 0x00008C8E REC_UBYTE_C 0 COMP_0035 -50 205 /end CHARACTERISTIC
/begin CHARACTERISTIC mTWIOFS "ROM Const mTWIOFS" VALUE 0x00008C8F REC_UBYTE_C 0 COMP_0035 -50 205 /end CHARACTERISTIC
/begin CHARACTERISTIC mTWIROX "ROM Const mTWIROX" VALUE 0x00008C90 REC_UBYTE_C 0 COMP_0035 -50 205 /end CHARACTERISTIC
/begin CHARACTERISTIC mTWISCH "ROM Const mTWISCH" VALUE 0x00008C91 REC_UBYTE_C 0 COMP_0035 -50 205 /end CHARACTERISTIC
/begin CHARACTERISTIC mTWISCL "ROM Const mTWISCL" VALUE 0x00008C92 REC_UBYTE_C 0 COMP_0035 -50 205 /end CHARACTERISTIC
/begin CHARACTERISTIC mTWISLH "ROM Const mTWISLH" VALUE 0x00008C93 REC_UBYTE_C 0 COMP_0035 -50 205 /end CHARACTERISTIC
/begin CHARACTERISTIC mTWISLL "ROM Const mTWISLL" VALUE 0x00008C94 REC_UBYTE_C 0 COMP_0035 -50 205 /end CHARACTERISTIC
/begin CHARACTERISTIC mTWIT1 "ROM Const mTWIT1" VALUE 0x00008C95 REC_UBYTE_C 0 COMP_0035 -50 205 /end CHARACTERISTIC
/begin CHARACTERISTIC mTWIT2 "ROM Const mTWIT2" VALUE 0x00008C96 REC_UBYTE_C 0 COMP_0035 -50 205 /end CHARACTERISTIC
/begin CHARACTERISTIC mTWJDGH "ROM Const mTWJDGH" VALUE 0x00008C97 REC_UBYTE_C 0 COMP_0035 -50 205 /end CHARACTERISTIC
/begin CHARACTERISTIC mTWJDGL "ROM Const mTWJDGL" VALUE 0x00008C98 REC_UBYTE_C 0 COMP_0035 -50 205 /end CHARACTERISTIC
/begin CHARACTERISTIC mTWKBH "ROM Const mTWKBH" VALUE 0x00008C99 REC_UBYTE_C 0 COMP_0035 -50 205 /end CHARACTERISTIC
/begin CHARACTERISTIC mTWKBL "ROM Const mTWKBL" VALUE 0x00008C9A REC_UBYTE_C 0 COMP_0035 -50 205 /end CHARACTERISTIC
/begin CHARACTERISTIC mTWKHH "ROM Const mTWKHH" VALUE 0x00008C9B REC_UBYTE_C 0 COMP_0035 -50 205 /end CHARACTERISTIC
/begin CHARACTERISTIC mTWKMFB "ROM Const mTWKMFB" VALUE 0x00008C9C REC_UBYTE_C 0 COMP_0035 -50 205 /end CHARACTERISTIC
/begin CHARACTERISTIC mTWKMR "ROM Const mTWKMR" VALUE 0x00008C9D REC_UBYTE_C 0 COMP_0035 -50 205 /end CHARACTERISTIC
/begin CHARACTERISTIC mTWKS "ROM Const mTWKS" VALUE 0x00008C9E REC_UBYTE_C 0 COMP_0356 -40 119.375 /end CHARACTERISTIC
/begin CHARACTERISTIC mTWLCLP "ROM Const mTWLCLP" VALUE 0x00008C9F REC_UBYTE_C 0 COMP_0035 -50 205 /end CHARACTERISTIC
/begin CHARACTERISTIC mTWLLMT "ROM Const mTWLLMT" VALUE 0x00008CA0 REC_UBYTE_C 0 COMP_0035 -50 205 /end CHARACTERISTIC
/begin CHARACTERISTIC mTWLRC "ROM Const mTWLRC" VALUE 0x00008CA1 REC_UBYTE_C 0 COMP_0035 -50 205 /end CHARACTERISTIC
/begin CHARACTERISTIC mTWLUINT "ROM Const mTWLUINT" VALUE 0x00008CA2 REC_UBYTE_C 0 COMP_0035 -50 205 /end CHARACTERISTIC
/begin CHARACTERISTIC mTWMF2 "ROM Const mTWMF2" VALUE 0x00008CA3 REC_UBYTE_C 0 COMP_0035 -50 205 /end CHARACTERISTIC
/begin CHARACTERISTIC mTWMFDT "ROM Const mTWMFDT" VALUE 0x00008CA4 REC_UBYTE_C 0 COMP_0035 -50 205 /end CHARACTERISTIC
/begin CHARACTERISTIC mTWMFMN "ROM Const mTWMFMN" VALUE 0x00008CA5 REC_UBYTE_C 0 COMP_0035 -50 205 /end CHARACTERISTIC
/begin CHARACTERISTIC mTWNDH "ROM Const mTWNDH" VALUE 0x00008CA6 REC_UBYTE_C 0 COMP_0035 -50 205 /end CHARACTERISTIC
/begin CHARACTERISTIC mTWNDKO "ROM Const mTWNDKO" VALUE 0x00008CA7 REC_UBYTE_C 0 COMP_0003 0 255 /end CHARACTERISTIC
/begin CHARACTERISTIC mTWNDKOH "ROM Const mTWNDKOH" VALUE 0x00008CA8 REC_UBYTE_C 0 COMP_0003 0 255 /end CHARACTERISTIC
/begin CHARACTERISTIC mTWNDL "ROM Const mTWNDL" VALUE 0x00008CA9 REC_UBYTE_C 0 COMP_0035 -50 205 /end CHARACTERISTIC
/begin CHARACTERISTIC mTWNFAN1 "ROM Const mTWNFAN1" VALUE 0x00008CAA REC_UBYTE_C 0 COMP_0069_S -50 205 /end CHARACTERISTIC
/begin CHARACTERISTIC mTWNFAN2 "ROM Const mTWNFAN2" VALUE 0x00008CAB REC_UBYTE_C 0 COMP_0069_S -50 205 /end CHARACTERISTIC
/begin CHARACTERISTIC mTWNFAN3 "ROM Const mTWNFAN3" VALUE 0x00008CAC REC_UBYTE_C 0 COMP_0069_S -50 205 /end CHARACTERISTIC
/begin CHARACTERISTIC mTWNK1 "ROM Const mTWNK1" VALUE 0x00008CAD REC_UBYTE_C 0 COMP_0035 -50 205 /end CHARACTERISTIC
/begin CHARACTERISTIC mTWNK1H "ROM Const mTWNK1H" VALUE 0x00008CAE REC_UBYTE_C 0 COMP_0035 -50 205 /end CHARACTERISTIC
/begin CHARACTERISTIC mTWNLFC "ROM Const mTWNLFC" VALUE 0x00008CAF REC_UBYTE_C 0 COMP_0035 -50 205 /end CHARACTERISTIC
/begin CHARACTERISTIC mTWNMODE1 "ROM Const mTWNMODE1" VALUE 0x00008CB0 REC_UBYTE_C 0 COMP_0035 -50 205 /end CHARACTERISTIC
/begin CHARACTERISTIC mTWNOK "ROM Const mTWNOK" VALUE 0x00008CB1 REC_UBYTE_C 0 COMP_0035 -50 205 /end CHARACTERISTIC
/begin CHARACTERISTIC mTWNSL "ROM Const mTWNSL" VALUE 0x00008CB2 REC_UBYTE_C 0 COMP_0035 -50 205 /end CHARACTERISTIC
/begin CHARACTERISTIC mTWNSSTD "ROM Const mTWNSSTD" VALUE 0x00008CB3 REC_UBYTE_C 0 COMP_0254_S -50 205 /end CHARACTERISTIC
/begin CHARACTERISTIC mTWNSSTH "ROM Const mTWNSSTH" VALUE 0x00008CB4 REC_UBYTE_C 0 COMP_0254_S -50 205 /end CHARACTERISTIC
/begin CHARACTERISTIC mTWNSSTL "ROM Const mTWNSSTL" VALUE 0x00008CB5 REC_UBYTE_C 0 COMP_0254_S -50 205 /end CHARACTERISTIC
/begin CHARACTERISTIC mTWOD "ROM Const mTWOD" VALUE 0x00008CB6 REC_UBYTE_C 0 COMP_0035 -50 205 /end CHARACTERISTIC
/begin CHARACTERISTIC mTWODINT "ROM Const mTWODINT" VALUE 0x00008CB7 REC_UBYTE_C 0 COMP_0035 -50 205 /end CHARACTERISTIC
/begin CHARACTERISTIC mTWOPEN "ROM Const mTWOPEN" VALUE 0x00008CB8 REC_UBYTE_C 0 COMP_0035 -50 205 /end CHARACTERISTIC
/begin CHARACTERISTIC mTWOVH "ROM Const mTWOVH" VALUE 0x00008CB9 REC_UBYTE_C 0 COMP_0035 -50 205 /end CHARACTERISTIC
/begin CHARACTERISTIC mTWPASS "ROM Const mTWPASS" VALUE 0x00008CBA REC_UBYTE_C 0 COMP_0013 0 255 /end CHARACTERISTIC
/begin CHARACTERISTIC mTWPBST "ROM Const mTWPBST" VALUE 0x00008CBB REC_UBYTE_C 0 COMP_0035 -50 205 /end CHARACTERISTIC
/begin CHARACTERISTIC mTWPIG "ROM Const mTWPIG" VALUE 0x00008CBC REC_UBYTE_C 0 COMP_0035 -50 205 /end CHARACTERISTIC
/begin CHARACTERISTIC mTWPMITH "ROM Const mTWPMITH" VALUE 0x00008CBD REC_UBYTE_C 0 COMP_0035 -50 205 /end CHARACTERISTIC
/begin CHARACTERISTIC mTWPMITL "ROM Const mTWPMITL" VALUE 0x00008CBE REC_UBYTE_C 0 COMP_0035 -50 205 /end CHARACTERISTIC
/begin CHARACTERISTIC mTWPRD "ROM Const mTWPRD" VALUE 0x00008CBF REC_UBYTE_C 0 COMP_0035 -50 205 /end CHARACTERISTIC
/begin CHARACTERISTIC mTWQLH "ROM Const mTWQLH" VALUE 0x00008CC0 REC_UBYTE_C 0 COMP_0035 -50 205 /end CHARACTERISTIC
/begin CHARACTERISTIC mTWQLL "ROM Const mTWQLL" VALUE 0x00008CC1 REC_UBYTE_C 0 COMP_0035 -50 205 /end CHARACTERISTIC
/begin CHARACTERISTIC mTWRMN "ROM Const mTWRMN" VALUE 0x00008CC2 REC_UBYTE_C 0 COMP_0035 -50 205 /end CHARACTERISTIC
/begin CHARACTERISTIC mTWRO2H "ROM Const mTWRO2H" VALUE 0x00008CC3 REC_UBYTE_C 0 COMP_0035 -50 205 /end CHARACTERISTIC
/begin CHARACTERISTIC mTWRO2L "ROM Const mTWRO2L" VALUE 0x00008CC4 REC_UBYTE_C 0 COMP_0035 -50 205 /end CHARACTERISTIC
/begin CHARACTERISTIC mTWSCV1 "ROM Const mTWSCV1" VALUE 0x00008CC5 REC_UBYTE_C 0 COMP_0035 -50 205 /end CHARACTERISTIC
/begin CHARACTERISTIC mTWSCV3 "ROM Const mTWSCV3" VALUE 0x00008CC6 REC_UBYTE_C 0 COMP_0035 -50 205 /end CHARACTERISTIC
/begin CHARACTERISTIC mTWSCV4 "ROM Const mTWSCV4" VALUE 0x00008CC7 REC_UBYTE_C 0 COMP_0035 -50 205 /end CHARACTERISTIC
/begin CHARACTERISTIC mTWSCV5 "ROM Const mTWSCV5" VALUE 0x00008CC8 REC_UBYTE_C 0 COMP_0003 0 255 /end CHARACTERISTIC
/begin CHARACTERISTIC mTWSCV6 "ROM Const mTWSCV6" VALUE 0x00008CC9 REC_UBYTE_C 0 COMP_0035 -50 205 /end CHARACTERISTIC
/begin CHARACTERISTIC mTWSCV8 "ROM Const mTWSCV8" VALUE 0x00008CCA REC_UBYTE_C 0 COMP_0003 0 255 /end CHARACTERISTIC
/begin CHARACTERISTIC mTWSFREM0 "ROM Const mTWSFREM0" VALUE 0x00008CCB REC_UBYTE_C 0 COMP_0004_S -50 205 /end CHARACTERISTIC
/begin CHARACTERISTIC mTWSFREM1 "ROM Const mTWSFREM1" VALUE 0x00008CCC REC_UBYTE_C 0 COMP_0004_S -50 205 /end CHARACTERISTIC
/begin CHARACTERISTIC mTWSFRQHT "ROM Const mTWSFRQHT" VALUE 0x00008CCD REC_UBYTE_C 0 COMP_0004_S -50 205 /end CHARACTERISTIC
/begin CHARACTERISTIC mTWSKCR "ROM Const mTWSKCR" VALUE 0x00008CCE REC_UBYTE_C 0 COMP_0003 0 255 /end CHARACTERISTIC
/begin CHARACTERISTIC mTWSKCRF "ROM Const mTWSKCRF" VALUE 0x00008CCF REC_UBYTE_C 0 COMP_0003 0 255 /end CHARACTERISTIC
/begin CHARACTERISTIC mTWSMPF "ROM Const mTWSMPF" VALUE 0x00008CD0 REC_UBYTE_C 0 COMP_0035 -50 205 /end CHARACTERISTIC
/begin CHARACTERISTIC mTWSTLMT "ROM Const mTWSTLMT" VALUE 0x00008CD1 REC_UBYTE_C 0 COMP_0035 -50 205 /end CHARACTERISTIC
/begin CHARACTERISTIC mTWSTTM "ROM Const mTWSTTM" VALUE 0x000095C4 REC_UWORD_C 0 COMP_0013 0 65535 /end CHARACTERISTIC
/begin CHARACTERISTIC mTWTAH "ROM Const mTWTAH" VALUE 0x00008CD2 REC_UBYTE_C 0 COMP_0035 -50 205 /end CHARACTERISTIC
/begin CHARACTERISTIC mTWTAL "ROM Const mTWTAL" VALUE 0x00008CD3 REC_UBYTE_C 0 COMP_0035 -50 205 /end CHARACTERISTIC
/begin CHARACTERISTIC mTWTIME "ROM Const mTWTIME" VALUE 0x00008CD4 REC_UBYTE_C 0 COMP_0355 0 0.99609375 /end CHARACTERISTIC
/begin CHARACTERISTIC mTWTTYU "ROM Const mTWTTYU" VALUE 0x00008CD5 REC_UBYTE_C 0 COMP_0035 -50 205 /end CHARACTERISTIC
/begin CHARACTERISTIC mTWVTSLH "ROM Const mTWVTSLH" VALUE 0x00008CD6 REC_UBYTE_C 0 COMP_0035 -50 205 /end CHARACTERISTIC
/begin CHARACTERISTIC mTWVTSLL "ROM Const mTWVTSLL" VALUE 0x00008CD7 REC_UBYTE_C 0 COMP_0035 -50 205 /end CHARACTERISTIC
/begin CHARACTERISTIC mTXAPH2 "ROM Const mTXAPH2" VALUE 0x000095C6 REC_UWORD_C 0 COMP_0005 0 7208.85 /end CHARACTERISTIC
/begin CHARACTERISTIC mTXAPHY "ROM Const mTXAPHY" VALUE 0x00008CD8 REC_UBYTE_C 0 COMP_0005 0 28.05 /end CHARACTERISTIC
/begin CHARACTERISTIC mTXAPOH "ROM Const mTXAPOH" VALUE 0x000095C8 REC_UWORD_C 0 COMP_0005 0 7208.85 /end CHARACTERISTIC
/begin CHARACTERISTIC mTXNEH "ROM Const mTXNEH" VALUE 0x00008CD9 REC_UBYTE_C 0 COMP_0000 0 6375 /end CHARACTERISTIC
/begin CHARACTERISTIC mTXNEH2 "ROM Const mTXNEH2" VALUE 0x00008CDA REC_UBYTE_C 0 COMP_0000 0 6375 /end CHARACTERISTIC
/begin CHARACTERISTIC mTXNEHY "ROM Const mTXNEHY" VALUE 0x00008CDB REC_UBYTE_C 0 COMP_0000 0 6375 /end CHARACTERISTIC
/begin CHARACTERISTIC mTXNEL1 "ROM Const mTXNEL1" VALUE 0x00008CDC REC_UBYTE_C 0 COMP_0006 0 3187.5 /end CHARACTERISTIC
/begin CHARACTERISTIC mTXNEL2 "ROM Const mTXNEL2" VALUE 0x00008CDD REC_UBYTE_C 0 COMP_0006 0 3187.5 /end CHARACTERISTIC
/begin CHARACTERISTIC mTXTQDH "ROM Const mTXTQDH" VALUE 0x00008CDE REC_UBYTE_C 0 COMP_0017 0 255 /end CHARACTERISTIC
/begin CHARACTERISTIC mTXTQDR "ROM Const mTXTQDR" VALUE 0x00008CDF REC_UBYTE_C 0 COMP_0017 0 255 /end CHARACTERISTIC
/begin CHARACTERISTIC mTXVAPL "ROM Const mTXVAPL" VALUE 0x00008CE0 REC_UBYTE_C 0 COMP_0005 0 28.05 /end CHARACTERISTIC
/begin CHARACTERISTIC mUDCUTVSP "ROM Const mUDCUTVSP" VALUE 0x00009774 REC_SLONG_C 0 COMP_0144_S -1843.20024746394 1843.20024660563 /end CHARACTERISTIC
/begin CHARACTERISTIC mULGNLMT "ROM Const mULGNLMT" VALUE 0x00008CE1 REC_UBYTE_C 0 COMP_0373 0 2.55 /end CHARACTERISTIC
/begin CHARACTERISTIC mUNGNLMT "ROM Const mUNGNLMT" VALUE 0x00008CE2 REC_UBYTE_C 0 COMP_0373 0 2.55 /end CHARACTERISTIC
/begin CHARACTERISTIC mUNLOCK "ROM Const mUNLOCK" VALUE 0x00008CE3 REC_UBYTE_C 0 COMP_0014 0 2550 /end CHARACTERISTIC
/begin CHARACTERISTIC mUNLOCK0 "ROM Const mUNLOCK0" VALUE 0x00008CE4 REC_UBYTE_C 0 COMP_0014 0 2550 /end CHARACTERISTIC
/begin CHARACTERISTIC mUPLMT "ROM Const mUPLMT" VALUE 0x000095CA REC_UWORD_C 0 COMP_0453 0 131.07 /end CHARACTERISTIC
/begin CHARACTERISTIC mUS14V "ROM Const mUS14V" VALUE 0x000095CC REC_UWORD_C 0 COMP_0023 0 327675 /end CHARACTERISTIC
/begin CHARACTERISTIC mUSADMN "ROM Const mUSADMN" VALUE 0x00008CE5 REC_UBYTE_C 0 COMP_0054 0 5100 /end CHARACTERISTIC
/begin CHARACTERISTIC mUSADMX "ROM Const mUSADMX" VALUE 0x00008CE6 REC_UBYTE_C 0 COMP_0054 0 5100 /end CHARACTERISTIC
/begin CHARACTERISTIC mUSCNTR "ROM Const mUSCNTR" VALUE 0x00008CE7 REC_UBYTE_C 0 COMP_0054 0 5100 /end CHARACTERISTIC
/begin CHARACTERISTIC mUSOFS "ROM Const mUSOFS" VALUE 0x000095CE REC_UWORD_C 0 COMP_0023 0 327675 /end CHARACTERISTIC
/begin CHARACTERISTIC mUSRVL "ROM Const mUSRVL" VALUE 0x000095D0 REC_UWORD_C 0 COMP_0023 0 327675 /end CHARACTERISTIC
/begin CHARACTERISTIC mUSRVU "ROM Const mUSRVU" VALUE 0x000095D2 REC_UWORD_C 0 COMP_0023 0 327675 /end CHARACTERISTIC
/begin CHARACTERISTIC mV1000DLT "ROM Const mV1000DLT" VALUE 0x00008CE8 REC_UBYTE_C 0 COMP_0268_S 0 2.55 /end CHARACTERISTIC
/begin CHARACTERISTIC mV1000FLT "ROM Const mV1000FLT" VALUE 0x00008CE9 REC_UBYTE_C 0 COMP_0265_S 0 1.275 /end CHARACTERISTIC
/begin CHARACTERISTIC mV1000GP1 "ROM Const mV1000GP1" VALUE 0x000095D4 REC_UWORD_C 0 COMP_0238_S 0 655.35 /end CHARACTERISTIC
/begin CHARACTERISTIC mV1000GP2 "ROM Const mV1000GP2" VALUE 0x000095D6 REC_UWORD_C 0 COMP_0238_S 0 655.35 /end CHARACTERISTIC
/begin CHARACTERISTIC mV1000GP3 "ROM Const mV1000GP3" VALUE 0x000095D8 REC_UWORD_C 0 COMP_0238_S 0 655.35 /end CHARACTERISTIC
/begin CHARACTERISTIC mV1000GP4 "ROM Const mV1000GP4" VALUE 0x000095DA REC_UWORD_C 0 COMP_0238_S 0 655.35 /end CHARACTERISTIC
/begin CHARACTERISTIC mV1000GP5 "ROM Const mV1000GP5" VALUE 0x000095DC REC_UWORD_C 0 COMP_0238_S 0 655.35 /end CHARACTERISTIC
/begin CHARACTERISTIC mV1000GP6 "ROM Const mV1000GP6" VALUE 0x000095DE REC_UWORD_C 0 COMP_0238_S 0 655.35 /end CHARACTERISTIC
/begin CHARACTERISTIC mV1000MRG "ROM Const mV1000MRG" VALUE 0x000095E0 REC_UWORD_C 0 COMP_0238_S 0 655.35 /end CHARACTERISTIC
/begin CHARACTERISTIC mVADJOK "ROM Const mVADJOK" VALUE 0x000095E2 REC_UWORD_C 0 COMP_0033 0 5242800 /end CHARACTERISTIC
/begin CHARACTERISTIC mVAERCIMX "ROM Const mVAERCIMX" VALUE 0x00008CEA REC_UBYTE_C 0 COMP_0016 0 255 /end CHARACTERISTIC
/begin CHARACTERISTIC mVAPOKSW "ROM Const mVAPOKSW" VALUE 0x00008CEB REC_UBYTE_C 0 COMP_0068 0 255 /end CHARACTERISTIC
/begin CHARACTERISTIC mVASCCHK2 "ROM Const mVASCCHK2" VALUE 0x00009778 REC_SLONG_C 0 COMP_0144_S -1843.20024746394 1843.20024660563 /end CHARACTERISTIC
/begin CHARACTERISTIC mVASCCHK3 "ROM Const mVASCCHK3" VALUE 0x0000977C REC_SLONG_C 0 COMP_0144_S -1843.20024746394 1843.20024660563 /end CHARACTERISTIC
/begin CHARACTERISTIC mVASCDCHK "ROM Const mVASCDCHK" VALUE 0x00009780 REC_SLONG_C 0 COMP_0144_S -1843.20024746394 1843.20024660563 /end CHARACTERISTIC
/begin CHARACTERISTIC mVASCDDT1 "ROM Const mVASCDDT1" VALUE 0x00008CEC REC_UBYTE_C 0 COMP_0024 0 12750 /end CHARACTERISTIC
/begin CHARACTERISTIC mVASCDDT2 "ROM Const mVASCDDT2" VALUE 0x00008CED REC_UBYTE_C 0 COMP_0024 0 12750 /end CHARACTERISTIC
/begin CHARACTERISTIC mVASCDNG "ROM Const mVASCDNG" VALUE 0x00009784 REC_SLONG_C 0 COMP_0144_S -1843.20024746394 1843.20024660563 /end CHARACTERISTIC
/begin CHARACTERISTIC mVASCDNG2 "ROM Const mVASCDNG2" VALUE 0x00009788 REC_SLONG_C 0 COMP_0144_S -1843.20024746394 1843.20024660563 /end CHARACTERISTIC
/begin CHARACTERISTIC mVASCDNG3 "ROM Const mVASCDNG3" VALUE 0x000095E4 REC_UWORD_C 0 COMP_0436 0 6553.5 /end CHARACTERISTIC
/begin CHARACTERISTIC mVASCDOFF "ROM Const mVASCDOFF" VALUE 0x0000978C REC_SLONG_C 0 COMP_0144_S -1843.20024746394 1843.20024660563 /end CHARACTERISTIC
/begin CHARACTERISTIC mVBCHG "ROM Const mVBCHG" VALUE 0x00008CEE REC_UBYTE_C 0 COMP_0033 0 20400 /end CHARACTERISTIC
/begin CHARACTERISTIC mVBCLREF "ROM Const mVBCLREF" VALUE 0x00008CEF REC_UBYTE_C 0 COMP_0033 0 20400 /end CHARACTERISTIC
/begin CHARACTERISTIC mVBCS "ROM Const mVBCS" VALUE 0x00008CF0 REC_UBYTE_C 0 COMP_0033 0 20400 /end CHARACTERISTIC
/begin CHARACTERISTIC mVBCSMN "ROM Const mVBCSMN" VALUE 0x00008CF1 REC_UBYTE_C 0 COMP_0033 0 20400 /end CHARACTERISTIC
/begin CHARACTERISTIC mVBCSTH "ROM Const mVBCSTH" VALUE 0x00008CF2 REC_UBYTE_C 0 COMP_0033 0 20400 /end CHARACTERISTIC
/begin CHARACTERISTIC mVBDWL "ROM Const mVBDWL" VALUE 0x000095E6 REC_UWORD_C 0 COMP_0269_S 0 8388480 /end CHARACTERISTIC
/begin CHARACTERISTIC mVBFLASH "ROM Const mVBFLASH" VALUE 0x00008CF3 REC_UBYTE_C 0 COMP_0033 0 20400 /end CHARACTERISTIC
/begin CHARACTERISTIC mVBHLIMH "ROM Const mVBHLIMH" VALUE 0x00008CF4 REC_UBYTE_C 0 COMP_0047 0 127.5 /end CHARACTERISTIC
/begin CHARACTERISTIC mVBHLIML "ROM Const mVBHLIML" VALUE 0x00008CF5 REC_UBYTE_C 0 COMP_0047 0 127.5 /end CHARACTERISTIC
/begin CHARACTERISTIC mVBJDG "ROM Const mVBJDG" VALUE 0x00008CF6 REC_UBYTE_C 0 COMP_0033 0 20400 /end CHARACTERISTIC
/begin CHARACTERISTIC mVBKEEP "ROM Const mVBKEEP" VALUE 0x00008CF7 REC_UBYTE_C 0 COMP_0033 0 20400 /end CHARACTERISTIC
/begin CHARACTERISTIC mVBKJU "ROM Const mVBKJU" VALUE 0x00008CF8 REC_UBYTE_C 0 COMP_0068 0 255 /end CHARACTERISTIC
/begin CHARACTERISTIC mVBOFS "ROM Const mVBOFS" VALUE 0x00008CF9 REC_UBYTE_C 0 COMP_0033 0 20400 /end CHARACTERISTIC
/begin CHARACTERISTIC mVBOVNG "ROM Const mVBOVNG" VALUE 0x00008CFA REC_UBYTE_C 0 COMP_0030 0 255 /end CHARACTERISTIC
/begin CHARACTERISTIC mVBSLH "ROM Const mVBSLH" VALUE 0x00008CFB REC_UBYTE_C 0 COMP_0033 0 20400 /end CHARACTERISTIC
/begin CHARACTERISTIC mVBSLL "ROM Const mVBSLL" VALUE 0x00008CFC REC_UBYTE_C 0 COMP_0033 0 20400 /end CHARACTERISTIC
/begin CHARACTERISTIC mVBSTNG "ROM Const mVBSTNG" VALUE 0x00008CFD REC_UBYTE_C 0 COMP_0030 0 255 /end CHARACTERISTIC
/begin CHARACTERISTIC mVBTIMN "ROM Const mVBTIMN" VALUE 0x000097FC REC_ULONG_C 0 COMP_0157_S 0 6871947672 /end CHARACTERISTIC
/begin CHARACTERISTIC mVBWIP "ROM Const mVBWIP" VALUE 0x00008CFE REC_UBYTE_C 0 COMP_0033 0 20400 /end CHARACTERISTIC
/begin CHARACTERISTIC mVBWIP2 "ROM Const mVBWIP2" VALUE 0x00008CFF REC_UBYTE_C 0 COMP_0033 0 20400 /end CHARACTERISTIC
/begin CHARACTERISTIC mVCCHMBR "ROM Const mVCCHMBR" VALUE 0x000095E8 REC_UWORD_C 0 COMP_0270_S 0 0.065535 /end CHARACTERISTIC
/begin CHARACTERISTIC mVCCVMV "ROM Const mVCCVMV" VALUE 0x00008D00 REC_UBYTE_C 0 COMP_0054 0 5100 /end CHARACTERISTIC
/begin CHARACTERISTIC mVCERRSSE "ROM Const mVCERRSSE" VALUE 0x00008D01 REC_UBYTE_C 0 COMP_0271_S 0 0.99609375 /end CHARACTERISTIC
/begin CHARACTERISTIC mVCERRSSI "ROM Const mVCERRSSI" VALUE 0x00008D02 REC_UBYTE_C 0 COMP_0271_S 0 0.99609375 /end CHARACTERISTIC
/begin CHARACTERISTIC mVCFBKDE "ROM Const mVCFBKDE" VALUE 0x000095EA REC_UWORD_C 0 COMP_0272_S 0 0.00327675 /end CHARACTERISTIC
/begin CHARACTERISTIC mVCFBKDI "ROM Const mVCFBKDI" VALUE 0x000095EC REC_UWORD_C 0 COMP_0272_S 0 0.00327675 /end CHARACTERISTIC
/begin CHARACTERISTIC mVCFBKIE "ROM Const mVCFBKIE" VALUE 0x000095EE REC_UWORD_C 0 COMP_0273_S 0 0.52428 /end CHARACTERISTIC
/begin CHARACTERISTIC mVCFBKII "ROM Const mVCFBKII" VALUE 0x000095F0 REC_UWORD_C 0 COMP_0273_S 0 0.52428 /end CHARACTERISTIC
/begin CHARACTERISTIC mVCFBKPE "ROM Const mVCFBKPE" VALUE 0x000095F2 REC_UWORD_C 0 COMP_0274_S 0 0.13107 /end CHARACTERISTIC
/begin CHARACTERISTIC mVCFBKPI "ROM Const mVCFBKPI" VALUE 0x000095F4 REC_UWORD_C 0 COMP_0274_S 0 0.13107 /end CHARACTERISTIC
/begin CHARACTERISTIC mVCFBTPE "ROM Const mVCFBTPE" VALUE 0x000095F6 REC_UWORD_C 0 COMP_0275_S 0 0.65535 /end CHARACTERISTIC
/begin CHARACTERISTIC mVCFBTPI "ROM Const mVCFBTPI" VALUE 0x000095F8 REC_UWORD_C 0 COMP_0275_S 0 0.65535 /end CHARACTERISTIC
/begin CHARACTERISTIC mVCKPNE "ROM Const mVCKPNE" VALUE 0x000095FA REC_UWORD_C 0 COMP_0276_S 0 13107 /end CHARACTERISTIC
/begin CHARACTERISTIC mVCKPNI "ROM Const mVCKPNI" VALUE 0x000095FC REC_UWORD_C 0 COMP_0276_S 0 13107 /end CHARACTERISTIC
/begin CHARACTERISTIC mVCLDUTY "ROM Const mVCLDUTY" VALUE 0x00008D03 REC_UBYTE_C 0 COMP_0021 0 99.609375 /end CHARACTERISTIC
/begin CHARACTERISTIC mVCLNE "ROM Const mVCLNE" VALUE 0x00008D04 REC_UBYTE_C 0 COMP_0000 0 6375 /end CHARACTERISTIC
/begin CHARACTERISTIC mVCLNJTM "ROM Const mVCLNJTM" VALUE 0x00008D05 REC_UBYTE_C 0 COMP_0008 0 25500 /end CHARACTERISTIC
/begin CHARACTERISTIC mVCLNK1 "ROM Const mVCLNK1" VALUE 0x00008D06 REC_UBYTE_C 0 COMP_0048 0 127.5 /end CHARACTERISTIC
/begin CHARACTERISTIC mVCLNTM "ROM Const mVCLNTM" VALUE 0x00008D07 REC_UBYTE_C 0 COMP_0008 0 25500 /end CHARACTERISTIC
/begin CHARACTERISTIC mVCLTOH "ROM Const mVCLTOH" VALUE 0x00008D08 REC_UBYTE_C 0 COMP_0035 -50 205 /end CHARACTERISTIC
/begin CHARACTERISTIC mVCLTOL "ROM Const mVCLTOL" VALUE 0x00008D09 REC_UBYTE_C 0 COMP_0035 -50 205 /end CHARACTERISTIC
/begin CHARACTERISTIC mVCLTWH "ROM Const mVCLTWH" VALUE 0x00008D0A REC_UBYTE_C 0 COMP_0035 -50 205 /end CHARACTERISTIC
/begin CHARACTERISTIC mVCLTWL "ROM Const mVCLTWL" VALUE 0x00008D0B REC_UBYTE_C 0 COMP_0035 -50 205 /end CHARACTERISTIC
/begin CHARACTERISTIC mVCTPNE "ROM Const mVCTPNE" VALUE 0x000095FE REC_UWORD_C 0 COMP_0277_S 0 0.327675 /end CHARACTERISTIC
/begin CHARACTERISTIC mVCTPNI "ROM Const mVCTPNI" VALUE 0x00009600 REC_UWORD_C 0 COMP_0277_S 0 0.327675 /end CHARACTERISTIC
/begin CHARACTERISTIC mVCWNRE "ROM Const mVCWNRE" VALUE 0x00009602 REC_UWORD_C 0 COMP_0278_S 0 327.675 /end CHARACTERISTIC
/begin CHARACTERISTIC mVCWNRI "ROM Const mVCWNRI" VALUE 0x00009604 REC_UWORD_C 0 COMP_0278_S 0 327.675 /end CHARACTERISTIC
/begin CHARACTERISTIC mVCYL0 "ROM Const mVCYL0" VALUE 0x00009606 REC_UWORD_C 0 COMP_0270_S 0 0.065535 /end CHARACTERISTIC
/begin CHARACTERISTIC mVCZETAE "ROM Const mVCZETAE" VALUE 0x00009608 REC_UWORD_C 0 COMP_0279_S 0 13.107 /end CHARACTERISTIC
/begin CHARACTERISTIC mVCZETAI "ROM Const mVCZETAI" VALUE 0x0000960A REC_UWORD_C 0 COMP_0279_S 0 13.107 /end CHARACTERISTIC
/begin CHARACTERISTIC mVDEADTM2 "ROM Const mVDEADTM2" VALUE 0x00008D0C REC_UBYTE_C 0 COMP_0015_S 0 25.5 /end CHARACTERISTIC
/begin CHARACTERISTIC mVDEADTME "ROM Const mVDEADTME" VALUE 0x0000960C REC_UWORD_C 0 COMP_0280_S 0 655.35 /end CHARACTERISTIC
/begin CHARACTERISTIC mVDEADTMI "ROM Const mVDEADTMI" VALUE 0x0000960E REC_UWORD_C 0 COMP_0017_S 0 655.35 /end CHARACTERISTIC
/begin CHARACTERISTIC mVDEDTM2E "ROM Const mVDEDTM2E" VALUE 0x00008D0D REC_UBYTE_C 0 COMP_0015_S 0 25.5 /end CHARACTERISTIC
/begin CHARACTERISTIC mVDELAY "ROM Const mVDELAY" VALUE 0x00009610 REC_UWORD_C 0 COMP_0146 0 99.998480265 /end CHARACTERISTIC
/begin CHARACTERISTIC mVEREND "ROM Const mVEREND" VALUE 0x00008D0E REC_UBYTE_C 0 COMP_0008 0 25500 /end CHARACTERISTIC
/begin CHARACTERISTIC mVERINI "ROM Const mVERINI" VALUE 0x00009612 REC_UWORD_C 0 COMP_0023 0 327675 /end CHARACTERISTIC
/begin CHARACTERISTIC mVHNPNG "ROM Const mVHNPNG" VALUE 0x00008D0F REC_UBYTE_C 0 COMP_0030 0 255 /end CHARACTERISTIC
/begin CHARACTERISTIC mVHOSH "ROM Const mVHOSH" VALUE 0x00008D10 REC_UBYTE_C 0 COMP_0104 0 2550 /end CHARACTERISTIC
/begin CHARACTERISTIC mVHOSL "ROM Const mVHOSL" VALUE 0x00008D11 REC_UBYTE_C 0 COMP_0104 0 2550 /end CHARACTERISTIC
/begin CHARACTERISTIC mVHOVNG "ROM Const mVHOVNG" VALUE 0x00008D12 REC_UBYTE_C 0 COMP_0030 0 255 /end CHARACTERISTIC
/begin CHARACTERISTIC mVHW "ROM Const mVHW" VALUE 0x00008D13 REC_UBYTE_C 0 COMP_0033 0 20400 /end CHARACTERISTIC
/begin CHARACTERISTIC mVINTVL "ROM Const mVINTVL" VALUE 0x00008D14 REC_UBYTE_C 0 COMP_0015_S 0 25.5 /end CHARACTERISTIC
/begin CHARACTERISTIC mVJISOH "ROM Const mVJISOH" VALUE 0x00008D15 REC_UBYTE_C 0 COMP_0007 0 510 /end CHARACTERISTIC
/begin CHARACTERISTIC mVJISOL "ROM Const mVJISOL" VALUE 0x00008D16 REC_UBYTE_C 0 COMP_0007 0 510 /end CHARACTERISTIC
/begin CHARACTERISTIC mVLD0 "ROM Const mVLD0" VALUE 0x00008ECA REC_SWORD_C 0 COMP_0263 -32768 32767 /end CHARACTERISTIC
/begin CHARACTERISTIC mVLD0_SFT "ROM Const mVLD0_SFT" VALUE 0x000157C2 REC_SBYTE_C 0 COMP_0025_S -128 127 /end CHARACTERISTIC
/begin CHARACTERISTIC mVLN0 "ROM Const mVLN0" VALUE 0x00008ECC REC_SWORD_C 0 COMP_0263 -32768 32767 /end CHARACTERISTIC
/begin CHARACTERISTIC mVLN0_SFT "ROM Const mVLN0_SFT" VALUE 0x000157C3 REC_SBYTE_C 0 COMP_0025_S -128 127 /end CHARACTERISTIC
/begin CHARACTERISTIC mVMANI "ROM Const mVMANI" VALUE 0x00009614 REC_UWORD_C 0 COMP_0270_S 0 0.065535 /end CHARACTERISTIC
/begin CHARACTERISTIC mVMANIEGI "ROM Const mVMANIEGI" VALUE 0x00009616 REC_UWORD_C 0 COMP_0270_S 0 0.065535 /end CHARACTERISTIC
/begin CHARACTERISTIC mVMD0 "ROM Const mVMD0" VALUE 0x00008ECE REC_SWORD_C 0 COMP_0263 -32768 32767 /end CHARACTERISTIC
/begin CHARACTERISTIC mVMD0_SFT "ROM Const mVMD0_SFT" VALUE 0x000157C4 REC_SBYTE_C 0 COMP_0025_S -128 127 /end CHARACTERISTIC
/begin CHARACTERISTIC mVMK "ROM Const mVMK" VALUE 0x00008ED0 REC_SWORD_C 0 COMP_0263 -32768 32767 /end CHARACTERISTIC
/begin CHARACTERISTIC mVMK2 "ROM Const mVMK2" VALUE 0x00008ED2 REC_SWORD_C 0 COMP_0263 -32768 32767 /end CHARACTERISTIC
/begin CHARACTERISTIC mVMKRMP "ROM Const mVMKRMP" VALUE 0x00008ED4 REC_SWORD_C 0 COMP_0281_S -32768 32767 /end CHARACTERISTIC
/begin CHARACTERISTIC mVMKRMPH "ROM Const mVMKRMPH" VALUE 0x00008ED6 REC_SWORD_C 0 COMP_0281_S -32768 32767 /end CHARACTERISTIC
/begin CHARACTERISTIC mVMK_SFT "ROM Const mVMK_SFT" VALUE 0x000157C5 REC_SBYTE_C 0 COMP_0025_S -128 127 /end CHARACTERISTIC
/begin CHARACTERISTIC mVMN0 "ROM Const mVMN0" VALUE 0x00008ED8 REC_SWORD_C 0 COMP_0263 -32768 32767 /end CHARACTERISTIC
/begin CHARACTERISTIC mVMN0_SFT "ROM Const mVMN0_SFT" VALUE 0x000157C6 REC_SBYTE_C 0 COMP_0025_S -128 127 /end CHARACTERISTIC
/begin CHARACTERISTIC mVMN1 "ROM Const mVMN1" VALUE 0x00008EDA REC_SWORD_C 0 COMP_0263 -32768 32767 /end CHARACTERISTIC
/begin CHARACTERISTIC mVMN1_SFT "ROM Const mVMN1_SFT" VALUE 0x000157C7 REC_SBYTE_C 0 COMP_0025_S -128 127 /end CHARACTERISTIC
/begin CHARACTERISTIC mVOL "ROM Const mVOL" VALUE 0x00008D18 REC_UBYTE_C 0 COMP_0362 0 6375 /end CHARACTERISTIC
/begin CHARACTERISTIC mVOLR "ROM Const mVOLR" VALUE 0x00008D19 REC_UBYTE_C 0 COMP_0044 0 1.9921875 /end CHARACTERISTIC
/begin CHARACTERISTIC mVOL_S "ROM Const mVOL_S" VALUE 0x000157DA REC_UBYTE_C 0 COMP_0362 0 6375 /end CHARACTERISTIC
/begin CHARACTERISTIC mVOUTRVNG "ROM Const mVOUTRVNG" VALUE 0x00009618 REC_UWORD_C 0 COMP_0443 0 65535 /end CHARACTERISTIC
/begin CHARACTERISTIC mVPBH "ROM Const mVPBH" VALUE 0x00008D1D REC_UBYTE_C 0 COMP_0054 0 5100 /end CHARACTERISTIC
/begin CHARACTERISTIC mVPBL "ROM Const mVPBL" VALUE 0x00008D1E REC_UBYTE_C 0 COMP_0054 0 5100 /end CHARACTERISTIC
/begin CHARACTERISTIC mVPDACH1 "ROM Const mVPDACH1" VALUE 0x00008D1F REC_UBYTE_C 0 COMP_0011 0 5.1 /end CHARACTERISTIC
/begin CHARACTERISTIC mVPDACL "ROM Const mVPDACL" VALUE 0x00008D20 REC_UBYTE_C 0 COMP_0011 0 5.1 /end CHARACTERISTIC
/begin CHARACTERISTIC mVPDARH "ROM Const mVPDARH" VALUE 0x00008D21 REC_UBYTE_C 0 COMP_0011 0 5.1 /end CHARACTERISTIC
/begin CHARACTERISTIC mVPDARHI "ROM Const mVPDARHI" VALUE 0x00008D22 REC_UBYTE_C 0 COMP_0011 0 5.1 /end CHARACTERISTIC
/begin CHARACTERISTIC mVPDARL "ROM Const mVPDARL" VALUE 0x00008D23 REC_UBYTE_C 0 COMP_0011 0 5.1 /end CHARACTERISTIC
/begin CHARACTERISTIC mVPGSMX "ROM Const mVPGSMX" VALUE 0x00008EDC REC_SWORD_C 0 COMP_0002_S -32768 32767 /end CHARACTERISTIC
/begin CHARACTERISTIC mVPRNGL "ROM Const mVPRNGL" VALUE 0x0000961A REC_UWORD_C 0 COMP_0050 0 5119.921875 /end CHARACTERISTIC
/begin CHARACTERISTIC mVPRSMAX "ROM Const mVPRSMAX" VALUE 0x0000961C REC_UWORD_C 0 COMP_0050 0 5119.921875 /end CHARACTERISTIC
/begin CHARACTERISTIC mVPSPSL "ROM Const mVPSPSL" VALUE 0x00008EDE REC_SWORD_C 0 COMP_0002_S -32768 32767 /end CHARACTERISTIC
/begin CHARACTERISTIC mVRD0 "ROM Const mVRD0" VALUE 0x00008EE0 REC_SWORD_C 0 COMP_0263 -32768 32767 /end CHARACTERISTIC
/begin CHARACTERISTIC mVRD0_SFT "ROM Const mVRD0_SFT" VALUE 0x000157C8 REC_SBYTE_C 0 COMP_0025_S -128 127 /end CHARACTERISTIC
/begin CHARACTERISTIC mVRHOSH "ROM Const mVRHOSH" VALUE 0x00008D24 REC_UBYTE_C 0 COMP_0104 0 2550 /end CHARACTERISTIC
/begin CHARACTERISTIC mVRHOSL "ROM Const mVRHOSL" VALUE 0x00008D25 REC_UBYTE_C 0 COMP_0104 0 2550 /end CHARACTERISTIC
/begin CHARACTERISTIC mVRN0 "ROM Const mVRN0" VALUE 0x00008EE2 REC_SWORD_C 0 COMP_0263 -32768 32767 /end CHARACTERISTIC
/begin CHARACTERISTIC mVRN0_SFT "ROM Const mVRN0_SFT" VALUE 0x000157C9 REC_SBYTE_C 0 COMP_0025_S -128 127 /end CHARACTERISTIC
/begin CHARACTERISTIC mVRN1 "ROM Const mVRN1" VALUE 0x00008EE4 REC_SWORD_C 0 COMP_0263 -32768 32767 /end CHARACTERISTIC
/begin CHARACTERISTIC mVRN1_SFT "ROM Const mVRN1_SFT" VALUE 0x000157CA REC_SBYTE_C 0 COMP_0025_S -128 127 /end CHARACTERISTIC
/begin CHARACTERISTIC mVSCCGA "ROM Const mVSCCGA" VALUE 0x0000961E REC_UWORD_C 0 COMP_0282_S 0 3.27675 /end CHARACTERISTIC
/begin CHARACTERISTIC mVSCCGAE "ROM Const mVSCCGAE" VALUE 0x00009620 REC_UWORD_C 0 COMP_0282_S 0 3.27675 /end CHARACTERISTIC
/begin CHARACTERISTIC mVSCCLL "ROM Const mVSCCLL" VALUE 0x00008D26 REC_UBYTE_C 0 COMP_0019_S 0 1.000000095 /end CHARACTERISTIC
/begin CHARACTERISTIC mVSCCLLE "ROM Const mVSCCLLE" VALUE 0x00008D27 REC_UBYTE_C 0 COMP_0019_S 0 1.000000095 /end CHARACTERISTIC
/begin CHARACTERISTIC mVSCCOS "ROM Const mVSCCOS" VALUE 0x0000824D REC_SBYTE_C 0 COMP_0283_S -0.501960832 0.498039263 /end CHARACTERISTIC
/begin CHARACTERISTIC mVSCCOSE "ROM Const mVSCCOSE" VALUE 0x0000824E REC_SBYTE_C 0 COMP_0283_S -0.501960832 0.498039263 /end CHARACTERISTIC
/begin CHARACTERISTIC mVSCFBKIE "ROM Const mVSCFBKIE" VALUE 0x00009622 REC_UWORD_C 0 COMP_0284_S 0 655.35 /end CHARACTERISTIC
/begin CHARACTERISTIC mVSCFBKII "ROM Const mVSCFBKII" VALUE 0x00009624 REC_UWORD_C 0 COMP_0284_S 0 655.35 /end CHARACTERISTIC
/begin CHARACTERISTIC mVSCFBKPE "ROM Const mVSCFBKPE" VALUE 0x00009626 REC_UWORD_C 0 COMP_0182_S 0 65.535 /end CHARACTERISTIC
/begin CHARACTERISTIC mVSCFBKPI "ROM Const mVSCFBKPI" VALUE 0x00009628 REC_UWORD_C 0 COMP_0182_S 0 65.535 /end CHARACTERISTIC
/begin CHARACTERISTIC mVSCFFD0E "ROM Const mVSCFFD0E" VALUE 0x0000962A REC_UWORD_C 0 COMP_0285_S 0 1.3107 /end CHARACTERISTIC
/begin CHARACTERISTIC mVSCFFD0I "ROM Const mVSCFFD0I" VALUE 0x0000962C REC_UWORD_C 0 COMP_0285_S 0 1.3107 /end CHARACTERISTIC
/begin CHARACTERISTIC mVSCFFD1E "ROM Const mVSCFFD1E" VALUE 0x0000962E REC_UWORD_C 0 COMP_0286_S -0.99 0.3207 /end CHARACTERISTIC
/begin CHARACTERISTIC mVSCFFD1I "ROM Const mVSCFFD1I" VALUE 0x00009630 REC_UWORD_C 0 COMP_0287_S -1 0.3107 /end CHARACTERISTIC
/begin CHARACTERISTIC mVSCFFN0E "ROM Const mVSCFFN0E" VALUE 0x00009632 REC_UWORD_C 0 COMP_0288_S 0 26.214 /end CHARACTERISTIC
/begin CHARACTERISTIC mVSCFFN0I "ROM Const mVSCFFN0I" VALUE 0x00009634 REC_UWORD_C 0 COMP_0288_S 0 26.214 /end CHARACTERISTIC
/begin CHARACTERISTIC mVSCFFN1E "ROM Const mVSCFFN1E" VALUE 0x00009636 REC_UWORD_C 0 COMP_0289_S -20 6.214 /end CHARACTERISTIC
/begin CHARACTERISTIC mVSCFFN1I "ROM Const mVSCFFN1I" VALUE 0x00009638 REC_UWORD_C 0 COMP_0290_S -20 6.214 /end CHARACTERISTIC
/begin CHARACTERISTIC mVSCLPD0E "ROM Const mVSCLPD0E" VALUE 0x0000963A REC_UWORD_C 0 COMP_0285_S 0 1.3107 /end CHARACTERISTIC
/begin CHARACTERISTIC mVSCLPD0I "ROM Const mVSCLPD0I" VALUE 0x0000963C REC_UWORD_C 0 COMP_0285_S 0 1.3107 /end CHARACTERISTIC
/begin CHARACTERISTIC mVSCLPD1E "ROM Const mVSCLPD1E" VALUE 0x0000963E REC_UWORD_C 0 COMP_0291_S -0.99 5.5635 /end CHARACTERISTIC
/begin CHARACTERISTIC mVSCLPD1I "ROM Const mVSCLPD1I" VALUE 0x00009640 REC_UWORD_C 0 COMP_0292_S -6 0.5535 /end CHARACTERISTIC
/begin CHARACTERISTIC mVSCLPH "ROM Const mVSCLPH" VALUE 0x00008D28 REC_UBYTE_C 0 COMP_0007 0 510 /end CHARACTERISTIC
/begin CHARACTERISTIC mVSCLPN0E "ROM Const mVSCLPN0E" VALUE 0x00009642 REC_UWORD_C 0 COMP_0285_S 0 1.3107 /end CHARACTERISTIC
/begin CHARACTERISTIC mVSCLPN0I "ROM Const mVSCLPN0I" VALUE 0x00009644 REC_UWORD_C 0 COMP_0285_S 0 1.3107 /end CHARACTERISTIC
/begin CHARACTERISTIC mVSCLPN1E "ROM Const mVSCLPN1E" VALUE 0x00009646 REC_UWORD_C 0 COMP_0285_S 0 1.3107 /end CHARACTERISTIC
/begin CHARACTERISTIC mVSCLPN1I "ROM Const mVSCLPN1I" VALUE 0x00009648 REC_UWORD_C 0 COMP_0285_S 0 1.3107 /end CHARACTERISTIC
/begin CHARACTERISTIC mVSCMAXE "ROM Const mVSCMAXE" VALUE 0x0000964A REC_UWORD_C 0 COMP_0293_S 0 0.999985458 /end CHARACTERISTIC
/begin CHARACTERISTIC mVSCMAXI "ROM Const mVSCMAXI" VALUE 0x0000964C REC_UWORD_C 0 COMP_0293_S 0 0.999985458 /end CHARACTERISTIC
/begin CHARACTERISTIC mVSCMINE "ROM Const mVSCMINE" VALUE 0x0000964E REC_UWORD_C 0 COMP_0293_S 0 0.999985458 /end CHARACTERISTIC
/begin CHARACTERISTIC mVSCMINI "ROM Const mVSCMINI" VALUE 0x00009650 REC_UWORD_C 0 COMP_0293_S 0 0.999985458 /end CHARACTERISTIC
/begin CHARACTERISTIC mVSCRMD0E "ROM Const mVSCRMD0E" VALUE 0x00009652 REC_UWORD_C 0 COMP_0285_S 0 1.3107 /end CHARACTERISTIC
/begin CHARACTERISTIC mVSCRMD0I "ROM Const mVSCRMD0I" VALUE 0x00009654 REC_UWORD_C 0 COMP_0285_S 0 1.3107 /end CHARACTERISTIC
/begin CHARACTERISTIC mVSCRMD1E "ROM Const mVSCRMD1E" VALUE 0x00009656 REC_UWORD_C 0 COMP_0286_S -0.99 0.3207 /end CHARACTERISTIC
/begin CHARACTERISTIC mVSCRMD1I "ROM Const mVSCRMD1I" VALUE 0x00009790 REC_SLONG_C 0 COMP_0294_S -42949.67296 42949.67294 /end CHARACTERISTIC
/begin CHARACTERISTIC mVSCRMN0E "ROM Const mVSCRMN0E" VALUE 0x00009658 REC_UWORD_C 0 COMP_0285_S 0 1.3107 /end CHARACTERISTIC
/begin CHARACTERISTIC mVSCRMN0I "ROM Const mVSCRMN0I" VALUE 0x0000965A REC_UWORD_C 0 COMP_0285_S 0 1.3107 /end CHARACTERISTIC
/begin CHARACTERISTIC mVSCTL "ROM Const mVSCTL" VALUE 0x00008D29 REC_UBYTE_C 0 COMP_0007 0 510 /end CHARACTERISTIC
/begin CHARACTERISTIC mVSDLLE "ROM Const mVSDLLE" VALUE 0x0000965C REC_UWORD_C 0 COMP_0146 0 99.998480265 /end CHARACTERISTIC
/begin CHARACTERISTIC mVSDLLI "ROM Const mVSDLLI" VALUE 0x0000965E REC_UWORD_C 0 COMP_0146 0 99.998480265 /end CHARACTERISTIC
/begin CHARACTERISTIC mVSDMAXE "ROM Const mVSDMAXE" VALUE 0x00009660 REC_UWORD_C 0 COMP_0146 0 99.998480265 /end CHARACTERISTIC
/begin CHARACTERISTIC mVSDMAXI "ROM Const mVSDMAXI" VALUE 0x00009662 REC_UWORD_C 0 COMP_0146 0 99.998480265 /end CHARACTERISTIC
/begin CHARACTERISTIC mVSDULE "ROM Const mVSDULE" VALUE 0x00009664 REC_UWORD_C 0 COMP_0146 0 99.998480265 /end CHARACTERISTIC
/begin CHARACTERISTIC mVSDULI "ROM Const mVSDULI" VALUE 0x00009666 REC_UWORD_C 0 COMP_0146 0 99.998480265 /end CHARACTERISTIC
/begin CHARACTERISTIC mVSKBLB "ROM Const mVSKBLB" VALUE 0x00008D2A REC_UBYTE_C 0 COMP_0007 0 510 /end CHARACTERISTIC
/begin CHARACTERISTIC mVSKBLH "ROM Const mVSKBLH" VALUE 0x00008D2B REC_UBYTE_C 0 COMP_0007 0 510 /end CHARACTERISTIC
/begin CHARACTERISTIC mVSLDTCHG "ROM Const mVSLDTCHG" VALUE 0x00009668 REC_UWORD_C 0 COMP_0295_S 0 655.35 /end CHARACTERISTIC
/begin CHARACTERISTIC mVSLDTERH "ROM Const mVSLDTERH" VALUE 0x00008EE6 REC_SWORD_C 0 COMP_0296_S -327.68 327.67 /end CHARACTERISTIC
/begin CHARACTERISTIC mVSLDTERL "ROM Const mVSLDTERL" VALUE 0x00008EE8 REC_SWORD_C 0 COMP_0296_S -327.68 327.67 /end CHARACTERISTIC
/begin CHARACTERISTIC mVSLDTRTH "ROM Const mVSLDTRTH" VALUE 0x00008EEA REC_SWORD_C 0 COMP_0297_S -32.768 32.767 /end CHARACTERISTIC
/begin CHARACTERISTIC mVSLDTRTL "ROM Const mVSLDTRTL" VALUE 0x00008EEC REC_SWORD_C 0 COMP_0297_S -32.768 32.767 /end CHARACTERISTIC
/begin CHARACTERISTIC mVSLNGT "ROM Const mVSLNGT" VALUE 0x00008D2C REC_UBYTE_C 0 COMP_0008 0 25500 /end CHARACTERISTIC
/begin CHARACTERISTIC mVSLNGV "ROM Const mVSLNGV" VALUE 0x0000966A REC_UWORD_C 0 COMP_0436 0 6553.5 /end CHARACTERISTIC
/begin CHARACTERISTIC mVSNGD1 "ROM Const mVSNGD1" VALUE 0x00008D2D REC_UBYTE_C 0 COMP_0013 0 255 /end CHARACTERISTIC
/begin CHARACTERISTIC mVSNGD2 "ROM Const mVSNGD2" VALUE 0x00008D2E REC_UBYTE_C 0 COMP_0013 0 255 /end CHARACTERISTIC
/begin CHARACTERISTIC mVSNSL "ROM Const mVSNSL" VALUE 0x00008D2F REC_UBYTE_C 0 COMP_0007 0 510 /end CHARACTERISTIC
/begin CHARACTERISTIC mVSP1SD "ROM Const mVSP1SD" VALUE 0x00008D30 REC_UBYTE_C 0 COMP_0360 0 510 /end CHARACTERISTIC
/begin CHARACTERISTIC mVSP2SD "ROM Const mVSP2SD" VALUE 0x00008D31 REC_UBYTE_C 0 COMP_0360 0 510 /end CHARACTERISTIC
/begin CHARACTERISTIC mVSPAC "ROM Const mVSPAC" VALUE 0x00008D32 REC_UBYTE_C 0 COMP_0007 0 510 /end CHARACTERISTIC
/begin CHARACTERISTIC mVSPASCDH "ROM Const mVSPASCDH" VALUE 0x00009794 REC_SLONG_C 0 COMP_0144_S -1843.20024746394 1843.20024660563 /end CHARACTERISTIC
/begin CHARACTERISTIC mVSPASCDL "ROM Const mVSPASCDL" VALUE 0x00009798 REC_SLONG_C 0 COMP_0144_S -1843.20024746394 1843.20024660563 /end CHARACTERISTIC
/begin CHARACTERISTIC mVSPCNSRT "ROM Const mVSPCNSRT" VALUE 0x00008D33 REC_UBYTE_C 0 COMP_0007 0 510 /end CHARACTERISTIC
/begin CHARACTERISTIC mVSPCNSTP "ROM Const mVSPCNSTP" VALUE 0x00008D34 REC_UBYTE_C 0 COMP_0007 0 510 /end CHARACTERISTIC
/begin CHARACTERISTIC mVSPCST "ROM Const mVSPCST" VALUE 0x00008D35 REC_UBYTE_C 0 COMP_0007 0 510 /end CHARACTERISTIC
/begin CHARACTERISTIC mVSPCT2 "ROM Const mVSPCT2" VALUE 0x00008D36 REC_UBYTE_C 0 COMP_0007 0 510 /end CHARACTERISTIC
/begin CHARACTERISTIC mVSPDEC "ROM Const mVSPDEC" VALUE 0x0000979C REC_SLONG_C 0 COMP_0089_S -1843.20024746394 1843.20024660563 /end CHARACTERISTIC
/begin CHARACTERISTIC mVSPGAP "ROM Const mVSPGAP" VALUE 0x0000966C REC_UWORD_C 0 COMP_0436 0 6553.5 /end CHARACTERISTIC
/begin CHARACTERISTIC mVSPGAP2 "ROM Const mVSPGAP2" VALUE 0x0000966E REC_UWORD_C 0 COMP_0436 0 6553.5 /end CHARACTERISTIC
/begin CHARACTERISTIC mVSPIDL "ROM Const mVSPIDL" VALUE 0x00008D37 REC_UBYTE_C 0 COMP_0007 0 510 /end CHARACTERISTIC
/begin CHARACTERISTIC mVSPINC "ROM Const mVSPINC" VALUE 0x000097A0 REC_SLONG_C 0 COMP_0089_S -1843.20024746394 1843.20024660563 /end CHARACTERISTIC
/begin CHARACTERISTIC mVSPJK "ROM Const mVSPJK" VALUE 0x00009670 REC_UWORD_C 0 COMP_0436 0 6553.5 /end CHARACTERISTIC
/begin CHARACTERISTIC mVSPJK_S "ROM Const mVSPJK_S" VALUE 0x00015A26 REC_UWORD_C 0 COMP_0436 0 6553.5 /end CHARACTERISTIC
/begin CHARACTERISTIC mVSPJN "ROM Const mVSPJN" VALUE 0x00008D38 REC_UBYTE_C 0 COMP_0020 0 12750 /end CHARACTERISTIC
/begin CHARACTERISTIC mVSPJTW "ROM Const mVSPJTW" VALUE 0x00008D39 REC_UBYTE_C 0 COMP_0035 -50 205 /end CHARACTERISTIC
/begin CHARACTERISTIC mVSPLAPDL "ROM Const mVSPLAPDL" VALUE 0x00008D3A REC_UBYTE_C 0 COMP_0049 0 255 /end CHARACTERISTIC
/begin CHARACTERISTIC mVSPLCC "ROM Const mVSPLCC" VALUE 0x00008D3B REC_UBYTE_C 0 COMP_0007 0 510 /end CHARACTERISTIC
/begin CHARACTERISTIC mVSPLCLR "ROM Const mVSPLCLR" VALUE 0x00008D3C REC_UBYTE_C 0 COMP_0049 0 255 /end CHARACTERISTIC
/begin CHARACTERISTIC mVSPLCP "ROM Const mVSPLCP" VALUE 0x00008D3D REC_UBYTE_C 0 COMP_0007 0 510 /end CHARACTERISTIC
/begin CHARACTERISTIC mVSPLDCNG "ROM Const mVSPLDCNG" VALUE 0x00008D3E REC_UBYTE_C 0 COMP_0016 0 255 /end CHARACTERISTIC
/begin CHARACTERISTIC mVSPLDCT "ROM Const mVSPLDCT" VALUE 0x00008D3F REC_UBYTE_C 0 COMP_0049 0 255 /end CHARACTERISTIC
/begin CHARACTERISTIC mVSPLDCVB "ROM Const mVSPLDCVB" VALUE 0x00008D40 REC_UBYTE_C 0 COMP_0033 0 20400 /end CHARACTERISTIC
/begin CHARACTERISTIC mVSPLLM "ROM Const mVSPLLM" VALUE 0x00008D41 REC_UBYTE_C 0 COMP_0007 0 510 /end CHARACTERISTIC
/begin CHARACTERISTIC mVSPLMT "ROM Const mVSPLMT" VALUE 0x00008D42 REC_UBYTE_C 0 COMP_0007 0 510 /end CHARACTERISTIC
/begin CHARACTERISTIC mVSPLRANG "ROM Const mVSPLRANG" VALUE 0x00008D43 REC_UBYTE_C 0 COMP_0016 0 255 /end CHARACTERISTIC
/begin CHARACTERISTIC mVSPLRAT "ROM Const mVSPLRAT" VALUE 0x00008D44 REC_UBYTE_C 0 COMP_0049 0 255 /end CHARACTERISTIC
/begin CHARACTERISTIC mVSPLRGDL "ROM Const mVSPLRGDL" VALUE 0x00008D45 REC_UBYTE_C 0 COMP_0049 0 255 /end CHARACTERISTIC
/begin CHARACTERISTIC mVSPLSAP "ROM Const mVSPLSAP" VALUE 0x00009672 REC_UWORD_C 0 COMP_0005 0 7208.85 /end CHARACTERISTIC
/begin CHARACTERISTIC mVSPLSTDL "ROM Const mVSPLSTDL" VALUE 0x00008D46 REC_UBYTE_C 0 COMP_0049 0 255 /end CHARACTERISTIC
/begin CHARACTERISTIC mVSPLSTOP "ROM Const mVSPLSTOP" VALUE 0x00008D47 REC_UBYTE_C 0 COMP_0049 0 255 /end CHARACTERISTIC
/begin CHARACTERISTIC mVSPMNE "ROM Const mVSPMNE" VALUE 0x00008D48 REC_UBYTE_C 0 COMP_0007 0 510 /end CHARACTERISTIC
/begin CHARACTERISTIC mVSPNOIS "ROM Const mVSPNOIS" VALUE 0x00008D49 REC_UBYTE_C 0 COMP_0063 0 0.99609375 /end CHARACTERISTIC
/begin CHARACTERISTIC mVSPOFST "ROM Const mVSPOFST" VALUE 0x0000824F REC_SBYTE_C 0 COMP_0364 -256 254 /end CHARACTERISTIC
/begin CHARACTERISTIC mVSPOVR1 "ROM Const mVSPOVR1" VALUE 0x000097A4 REC_SLONG_C 0 COMP_0144_S -1843.20024746394 1843.20024660563 /end CHARACTERISTIC
/begin CHARACTERISTIC mVSPOVR2 "ROM Const mVSPOVR2" VALUE 0x000097A8 REC_SLONG_C 0 COMP_0144_S -1843.20024746394 1843.20024660563 /end CHARACTERISTIC
/begin CHARACTERISTIC mVSPPGH "ROM Const mVSPPGH" VALUE 0x00008D4A REC_UBYTE_C 0 COMP_0007 0 510 /end CHARACTERISTIC
/begin CHARACTERISTIC mVSPPGL "ROM Const mVSPPGL" VALUE 0x00008D4B REC_UBYTE_C 0 COMP_0007 0 510 /end CHARACTERISTIC
/begin CHARACTERISTIC mVSPRC2 "ROM Const mVSPRC2" VALUE 0x00008D4C REC_UBYTE_C 0 COMP_0007 0 510 /end CHARACTERISTIC
/begin CHARACTERISTIC mVSPRSD "ROM Const mVSPRSD" VALUE 0x00008D4D REC_UBYTE_C 0 COMP_0360 0 510 /end CHARACTERISTIC
/begin CHARACTERISTIC mVSPRTOMN "ROM Const mVSPRTOMN" VALUE 0x00009800 REC_ULONG_C 0 COMP_0298_S 0 36864.0049406957 /end CHARACTERISTIC
/begin CHARACTERISTIC mVSPRTOMX "ROM Const mVSPRTOMX" VALUE 0x00009804 REC_ULONG_C 0 COMP_0298_S 0 36864.0049406957 /end CHARACTERISTIC
/begin CHARACTERISTIC mVSPTAN "ROM Const mVSPTAN" VALUE 0x00008D4E REC_UBYTE_C 0 COMP_0007 0 510 /end CHARACTERISTIC
/begin CHARACTERISTIC mVSPTGTER "ROM Const mVSPTGTER" VALUE 0x000097AC REC_SLONG_C 0 COMP_0144_S -1843.20024746394 1843.20024660563 /end CHARACTERISTIC
/begin CHARACTERISTIC mVSPTM "ROM Const mVSPTM" VALUE 0x00008D4F REC_UBYTE_C 0 COMP_0013 0 255 /end CHARACTERISTIC
/begin CHARACTERISTIC mVSPTME "ROM Const mVSPTME" VALUE 0x00008D50 REC_UBYTE_C 0 COMP_0013 0 255 /end CHARACTERISTIC
/begin CHARACTERISTIC mVSPWIP "ROM Const mVSPWIP" VALUE 0x00008D51 REC_UBYTE_C 0 COMP_0007 0 510 /end CHARACTERISTIC
/begin CHARACTERISTIC mVSPWIPHY "ROM Const mVSPWIPHY" VALUE 0x00008D52 REC_UBYTE_C 0 COMP_0007 0 510 /end CHARACTERISTIC
/begin CHARACTERISTIC mVSRESE "ROM Const mVSRESE" VALUE 0x00008D53 REC_UBYTE_C 0 COMP_0299_S 6 11.9765625 /end CHARACTERISTIC
/begin CHARACTERISTIC mVSRESI "ROM Const mVSRESI" VALUE 0x00008D54 REC_UBYTE_C 0 COMP_0299_S 6 11.9765625 /end CHARACTERISTIC
/begin CHARACTERISTIC mVTCADH "ROM Const mVTCADH" VALUE 0x00008D55 REC_UBYTE_C 0 COMP_0245 -64 191 /end CHARACTERISTIC
/begin CHARACTERISTIC mVTCADL "ROM Const mVTCADL" VALUE 0x00008D56 REC_UBYTE_C 0 COMP_0245 -64 191 /end CHARACTERISTIC
/begin CHARACTERISTIC mVTCBRNE "ROM Const mVTCBRNE" VALUE 0x00008D57 REC_UBYTE_C 0 COMP_0006 0 3187.5 /end CHARACTERISTIC
/begin CHARACTERISTIC mVTCCNEH "ROM Const mVTCCNEH" VALUE 0x00008D58 REC_UBYTE_C 0 COMP_0006 0 3187.5 /end CHARACTERISTIC
/begin CHARACTERISTIC mVTCCNEL "ROM Const mVTCCNEL" VALUE 0x00008D59 REC_UBYTE_C 0 COMP_0006 0 3187.5 /end CHARACTERISTIC
/begin CHARACTERISTIC mVTCCTWH "ROM Const mVTCCTWH" VALUE 0x00008D5A REC_UBYTE_C 0 COMP_0035 -50 205 /end CHARACTERISTIC
/begin CHARACTERISTIC mVTCCTWL "ROM Const mVTCCTWL" VALUE 0x00008D5B REC_UBYTE_C 0 COMP_0035 -50 205 /end CHARACTERISTIC
/begin CHARACTERISTIC mVTCDMP "ROM Const mVTCDMP" VALUE 0x00008D5C REC_UBYTE_C 0 COMP_0063 0 0.99609375 /end CHARACTERISTIC
/begin CHARACTERISTIC mVTCDMPE "ROM Const mVTCDMPE" VALUE 0x00008D5D REC_UBYTE_C 0 COMP_0063 0 0.99609375 /end CHARACTERISTIC
/begin CHARACTERISTIC mVTCDNE "ROM Const mVTCDNE" VALUE 0x00008D5E REC_UBYTE_C 0 COMP_0006 0 3187.5 /end CHARACTERISTIC
/begin CHARACTERISTIC mVTCDTM "ROM Const mVTCDTM" VALUE 0x00008D5F REC_UBYTE_C 0 COMP_0068 0 255 /end CHARACTERISTIC
/begin CHARACTERISTIC mVTCGKDME "ROM Const mVTCGKDME" VALUE 0x00008D60 REC_UBYTE_C 0 COMP_0300_S 0 127.5 /end CHARACTERISTIC
/begin CHARACTERISTIC mVTCGKDMP "ROM Const mVTCGKDMP" VALUE 0x00008D61 REC_UBYTE_C 0 COMP_0300_S 0 127.5 /end CHARACTERISTIC
/begin CHARACTERISTIC mVTCGKNE "ROM Const mVTCGKNE" VALUE 0x00008D62 REC_UBYTE_C 0 COMP_0006 0 3187.5 /end CHARACTERISTIC
/begin CHARACTERISTIC mVTCGKNEE "ROM Const mVTCGKNEE" VALUE 0x00008D63 REC_UBYTE_C 0 COMP_0006 0 3187.5 /end CHARACTERISTIC
/begin CHARACTERISTIC mVTCGUL "ROM Const mVTCGUL" VALUE 0x00008D64 REC_UBYTE_C 0 COMP_0256 -64 63.5 /end CHARACTERISTIC
/begin CHARACTERISTIC mVTCINEL "ROM Const mVTCINEL" VALUE 0x00008D65 REC_UBYTE_C 0 COMP_0006 0 3187.5 /end CHARACTERISTIC
/begin CHARACTERISTIC mVTCITWL "ROM Const mVTCITWL" VALUE 0x00008D66 REC_UBYTE_C 0 COMP_0069_S -50 205 /end CHARACTERISTIC
/begin CHARACTERISTIC mVTCKAJYU "ROM Const mVTCKAJYU" VALUE 0x00008D67 REC_UBYTE_C 0 COMP_0063 0 0.99609375 /end CHARACTERISTIC
/begin CHARACTERISTIC mVTCKJY "ROM Const mVTCKJY" VALUE 0x00008D68 REC_UBYTE_C 0 COMP_0019_S 0 1.000000095 /end CHARACTERISTIC
/begin CHARACTERISTIC mVTCLHT "ROM Const mVTCLHT" VALUE 0x00008D69 REC_UBYTE_C 0 COMP_0053 0 255 /end CHARACTERISTIC
/begin CHARACTERISTIC mVTCLLT "ROM Const mVTCLLT" VALUE 0x00008D6A REC_UBYTE_C 0 COMP_0014 0 2550 /end CHARACTERISTIC
/begin CHARACTERISTIC mVTCLNTM "ROM Const mVTCLNTM" VALUE 0x00008D6B REC_UBYTE_C 0 COMP_0008 0 25500 /end CHARACTERISTIC
/begin CHARACTERISTIC mVTCLNWAV "ROM Const mVTCLNWAV" VALUE 0x00008D6C REC_UBYTE_C 0 COMP_0063 0 0.99609375 /end CHARACTERISTIC
/begin CHARACTERISTIC mVTCLRNCV "ROM Const mVTCLRNCV" VALUE 0x00008D6D REC_UBYTE_C 0 COMP_0271_S 0 0.99609375 /end CHARACTERISTIC
/begin CHARACTERISTIC mVTCLRNTM "ROM Const mVTCLRNTM" VALUE 0x00008D6E REC_UBYTE_C 0 COMP_0014 0 2550 /end CHARACTERISTIC
/begin CHARACTERISTIC mVTCMDFC "ROM Const mVTCMDFC" VALUE 0x00008D6F REC_UBYTE_C 0 COMP_0068 0 255 /end CHARACTERISTIC
/begin CHARACTERISTIC mVTCMDNE "ROM Const mVTCMDNE" VALUE 0x00008D70 REC_UBYTE_C 0 COMP_0006 0 3187.5 /end CHARACTERISTIC
/begin CHARACTERISTIC mVTCMDNE2 "ROM Const mVTCMDNE2" VALUE 0x00008D71 REC_UBYTE_C 0 COMP_0006 0 3187.5 /end CHARACTERISTIC
/begin CHARACTERISTIC mVTCMDVSP "ROM Const mVTCMDVSP" VALUE 0x00008D72 REC_UBYTE_C 0 COMP_0007 0 510 /end CHARACTERISTIC
/begin CHARACTERISTIC mVTCMECNTR "ROM Const mVTCMECNTR" VALUE 0x00008D73 REC_UBYTE_C 0 COMP_0054 0 5100 /end CHARACTERISTIC
/begin CHARACTERISTIC mVTCMEMN "ROM Const mVTCMEMN" VALUE 0x00008D74 REC_UBYTE_C 0 COMP_0054 0 5100 /end CHARACTERISTIC
/begin CHARACTERISTIC mVTCMEMX "ROM Const mVTCMEMX" VALUE 0x00008D75 REC_UBYTE_C 0 COMP_0054 0 5100 /end CHARACTERISTIC
/begin CHARACTERISTIC mVTCMETM "ROM Const mVTCMETM" VALUE 0x00008D76 REC_UBYTE_C 0 COMP_0014 0 2550 /end CHARACTERISTIC
/begin CHARACTERISTIC mVTCMICNTR "ROM Const mVTCMICNTR" VALUE 0x00008D77 REC_UBYTE_C 0 COMP_0054 0 5100 /end CHARACTERISTIC
/begin CHARACTERISTIC mVTCMIMN "ROM Const mVTCMIMN" VALUE 0x00008D78 REC_UBYTE_C 0 COMP_0054 0 5100 /end CHARACTERISTIC
/begin CHARACTERISTIC mVTCMIMX "ROM Const mVTCMIMX" VALUE 0x00008D79 REC_UBYTE_C 0 COMP_0054 0 5100 /end CHARACTERISTIC
/begin CHARACTERISTIC mVTCMITM "ROM Const mVTCMITM" VALUE 0x00008D7A REC_UBYTE_C 0 COMP_0014 0 2550 /end CHARACTERISTIC
/begin CHARACTERISTIC mVTCMLDLY "ROM Const mVTCMLDLY" VALUE 0x00008D7B REC_UBYTE_C 0 COMP_0295 0 25500 /end CHARACTERISTIC
/begin CHARACTERISTIC mVTCNEL "ROM Const mVTCNEL" VALUE 0x00008D7C REC_UBYTE_C 0 COMP_0006 0 3187.5 /end CHARACTERISTIC
/begin CHARACTERISTIC mVTCNELE "ROM Const mVTCNELE" VALUE 0x00008D7D REC_UBYTE_C 0 COMP_0006 0 3187.5 /end CHARACTERISTIC
/begin CHARACTERISTIC mVTCNGDLY "ROM Const mVTCNGDLY" VALUE 0x00008D7E REC_UBYTE_C 0 COMP_0008 0 25500 /end CHARACTERISTIC
/begin CHARACTERISTIC mVTCOLLIM "ROM Const mVTCOLLIM" VALUE 0x00008D7F REC_UBYTE_C 0 COMP_0048 0 127.5 /end CHARACTERISTIC
/begin CHARACTERISTIC mVTCONEH "ROM Const mVTCONEH" VALUE 0x00008D80 REC_UBYTE_C 0 COMP_0006 0 3187.5 /end CHARACTERISTIC
/begin CHARACTERISTIC mVTCONEL "ROM Const mVTCONEL" VALUE 0x00008D81 REC_UBYTE_C 0 COMP_0006 0 3187.5 /end CHARACTERISTIC
/begin CHARACTERISTIC mVTCOTWH "ROM Const mVTCOTWH" VALUE 0x00008D82 REC_UBYTE_C 0 COMP_0035 -50 205 /end CHARACTERISTIC
/begin CHARACTERISTIC mVTCOTWL "ROM Const mVTCOTWL" VALUE 0x00008D83 REC_UBYTE_C 0 COMP_0035 -50 205 /end CHARACTERISTIC
/begin CHARACTERISTIC mVTCRTEPD "ROM Const mVTCRTEPD" VALUE 0x00008D84 REC_UBYTE_C 0 COMP_0175_S 0 0.99609375 /end CHARACTERISTIC
/begin CHARACTERISTIC mVTCSDLY "ROM Const mVTCSDLY" VALUE 0x00008D85 REC_UBYTE_C 0 COMP_0008 0 25500 /end CHARACTERISTIC
/begin CHARACTERISTIC mVTCSKMH "ROM Const mVTCSKMH" VALUE 0x00009674 REC_UWORD_C 0 COMP_0456 0 1.999970916 /end CHARACTERISTIC
/begin CHARACTERISTIC mVTCSKMHE "ROM Const mVTCSKMHE" VALUE 0x00009676 REC_UWORD_C 0 COMP_0456 0 1.999970916 /end CHARACTERISTIC
/begin CHARACTERISTIC mVTCSKML "ROM Const mVTCSKML" VALUE 0x00009678 REC_UWORD_C 0 COMP_0456 0 1.999970916 /end CHARACTERISTIC
/begin CHARACTERISTIC mVTCSKMLE "ROM Const mVTCSKMLE" VALUE 0x0000967A REC_UWORD_C 0 COMP_0456 0 1.999970916 /end CHARACTERISTIC
/begin CHARACTERISTIC mVTCSKPH "ROM Const mVTCSKPH" VALUE 0x0000967C REC_UWORD_C 0 COMP_0456 0 1.999970916 /end CHARACTERISTIC
/begin CHARACTERISTIC mVTCSKPHE "ROM Const mVTCSKPHE" VALUE 0x0000967E REC_UWORD_C 0 COMP_0456 0 1.999970916 /end CHARACTERISTIC
/begin CHARACTERISTIC mVTCSKPL "ROM Const mVTCSKPL" VALUE 0x00009680 REC_UWORD_C 0 COMP_0456 0 1.999970916 /end CHARACTERISTIC
/begin CHARACTERISTIC mVTCSKPLE "ROM Const mVTCSKPLE" VALUE 0x00009682 REC_UWORD_C 0 COMP_0456 0 1.999970916 /end CHARACTERISTIC
/begin CHARACTERISTIC mVTCSOTH "ROM Const mVTCSOTH" VALUE 0x00008D86 REC_UBYTE_C 0 COMP_0035 -50 205 /end CHARACTERISTIC
/begin CHARACTERISTIC mVTCSOTL "ROM Const mVTCSOTL" VALUE 0x00008D87 REC_UBYTE_C 0 COMP_0035 -50 205 /end CHARACTERISTIC
/begin CHARACTERISTIC mVTCSTLT "ROM Const mVTCSTLT" VALUE 0x00008D88 REC_UBYTE_C 0 COMP_0256 -64 63.5 /end CHARACTERISTIC
/begin CHARACTERISTIC mVTCSTOF "ROM Const mVTCSTOF" VALUE 0x00008D89 REC_UBYTE_C 0 COMP_0295 0 25500 /end CHARACTERISTIC
/begin CHARACTERISTIC mVTCSTPDG "ROM Const mVTCSTPDG" VALUE 0x00008D8A REC_UBYTE_C 0 COMP_0256 -64 63.5 /end CHARACTERISTIC
/begin CHARACTERISTIC mVTCSTST "ROM Const mVTCSTST" VALUE 0x00008D8B REC_UBYTE_C 0 COMP_0030 0 255 /end CHARACTERISTIC
/begin CHARACTERISTIC mVTCTIM "ROM Const mVTCTIM" VALUE 0x00008D8C REC_UBYTE_C 0 COMP_0366 0 25500 /end CHARACTERISTIC
/begin CHARACTERISTIC mVTCTIME "ROM Const mVTCTIME" VALUE 0x00008D8D REC_UBYTE_C 0 COMP_0301_S 0 25500 /end CHARACTERISTIC
/begin CHARACTERISTIC mVTCTRDB "ROM Const mVTCTRDB" VALUE 0x00008D8E REC_UBYTE_C 0 COMP_0048 0 127.5 /end CHARACTERISTIC
/begin CHARACTERISTIC mVTCTRGER "ROM Const mVTCTRGER" VALUE 0x00008D8F REC_UBYTE_C 0 COMP_0256 -64 63.5 /end CHARACTERISTIC
/begin CHARACTERISTIC mVTCTWH "ROM Const mVTCTWH" VALUE 0x00008D90 REC_UBYTE_C 0 COMP_0035 -50 205 /end CHARACTERISTIC
/begin CHARACTERISTIC mVTCTWHE "ROM Const mVTCTWHE" VALUE 0x00008D91 REC_UBYTE_C 0 COMP_0035 -50 205 /end CHARACTERISTIC
/begin CHARACTERISTIC mVTCTWL "ROM Const mVTCTWL" VALUE 0x00008D92 REC_UBYTE_C 0 COMP_0035 -50 205 /end CHARACTERISTIC
/begin CHARACTERISTIC mVTCTWL2 "ROM Const mVTCTWL2" VALUE 0x00008D93 REC_UBYTE_C 0 COMP_0035 -50 205 /end CHARACTERISTIC
/begin CHARACTERISTIC mVTCTWL2E "ROM Const mVTCTWL2E" VALUE 0x00008D94 REC_UBYTE_C 0 COMP_0035 -50 205 /end CHARACTERISTIC
/begin CHARACTERISTIC mVTCTWLE "ROM Const mVTCTWLE" VALUE 0x00008D95 REC_UBYTE_C 0 COMP_0035 -50 205 /end CHARACTERISTIC
/begin CHARACTERISTIC mVTCTWLL "ROM Const mVTCTWLL" VALUE 0x00008D96 REC_UBYTE_C 0 COMP_0035 -50 205 /end CHARACTERISTIC
/begin CHARACTERISTIC mVTCTWLLE "ROM Const mVTCTWLLE" VALUE 0x00008D97 REC_UBYTE_C 0 COMP_0035 -50 205 /end CHARACTERISTIC
/begin CHARACTERISTIC mVTCVBH "ROM Const mVTCVBH" VALUE 0x00008D98 REC_UBYTE_C 0 COMP_0033 0 20400 /end CHARACTERISTIC
/begin CHARACTERISTIC mVTCVBL "ROM Const mVTCVBL" VALUE 0x00008D99 REC_UBYTE_C 0 COMP_0033 0 20400 /end CHARACTERISTIC
/begin CHARACTERISTIC mVTCVSP "ROM Const mVTCVSP" VALUE 0x00008D9A REC_UBYTE_C 0 COMP_0007 0 510 /end CHARACTERISTIC
/begin CHARACTERISTIC mVTERDB "ROM Const mVTERDB" VALUE 0x00008D9B REC_UBYTE_C 0 COMP_0048 0 127.5 /end CHARACTERISTIC
/begin CHARACTERISTIC mVTLNUPLT "ROM Const mVTLNUPLT" VALUE 0x00008D9C REC_UBYTE_C 0 COMP_0048 0 127.5 /end CHARACTERISTIC
/begin CHARACTERISTIC mVTLRNTWH "ROM Const mVTLRNTWH" VALUE 0x00008D9D REC_UBYTE_C 0 COMP_0035 -50 205 /end CHARACTERISTIC
/begin CHARACTERISTIC mVTLRNTWL "ROM Const mVTLRNTWL" VALUE 0x00008D9E REC_UBYTE_C 0 COMP_0035 -50 205 /end CHARACTERISTIC
/begin CHARACTERISTIC mVTMINTAN "ROM Const mVTMINTAN" VALUE 0x00008D9F REC_UBYTE_C 0 COMP_0035 -50 205 /end CHARACTERISTIC
/begin CHARACTERISTIC mVTNDIF "ROM Const mVTNDIF" VALUE 0x00008DA0 REC_UBYTE_C 0 COMP_0048 0 127.5 /end CHARACTERISTIC
/begin CHARACTERISTIC mVTNED "ROM Const mVTNED" VALUE 0x00008DA1 REC_UBYTE_C 0 COMP_0016 0 255 /end CHARACTERISTIC
/begin CHARACTERISTIC mVTNEDML "ROM Const mVTNEDML" VALUE 0x00008DA2 REC_UBYTE_C 0 COMP_0295 0 25500 /end CHARACTERISTIC
/begin CHARACTERISTIC mVTNEHYS "ROM Const mVTNEHYS" VALUE 0x00008DA3 REC_UBYTE_C 0 COMP_0006 0 3187.5 /end CHARACTERISTIC
/begin CHARACTERISTIC mVTOA "ROM Const mVTOA" VALUE 0x00008DA4 REC_UBYTE_C 0 COMP_0302_S 0 2.55 /end CHARACTERISTIC
/begin CHARACTERISTIC mVTRDECE3 "ROM Const mVTRDECE3" VALUE 0x00008DA5 REC_UBYTE_C 0 COMP_0300_S 0 127.5 /end CHARACTERISTIC
/begin CHARACTERISTIC mVTRDECE4 "ROM Const mVTRDECE4" VALUE 0x00008DA6 REC_UBYTE_C 0 COMP_0300_S 0 127.5 /end CHARACTERISTIC
/begin CHARACTERISTIC mVTRGDEC3 "ROM Const mVTRGDEC3" VALUE 0x00008DA7 REC_UBYTE_C 0 COMP_0300_S 0 127.5 /end CHARACTERISTIC
/begin CHARACTERISTIC mVTRGDEC4 "ROM Const mVTRGDEC4" VALUE 0x00008DA8 REC_UBYTE_C 0 COMP_0300_S 0 127.5 /end CHARACTERISTIC
/begin CHARACTERISTIC mVTRGINC3 "ROM Const mVTRGINC3" VALUE 0x00008DA9 REC_UBYTE_C 0 COMP_0300_S 0 127.5 /end CHARACTERISTIC
/begin CHARACTERISTIC mVTRGINC4 "ROM Const mVTRGINC4" VALUE 0x00008DAA REC_UBYTE_C 0 COMP_0300_S 0 127.5 /end CHARACTERISTIC
/begin CHARACTERISTIC mVTRINCE3 "ROM Const mVTRINCE3" VALUE 0x00008DAB REC_UBYTE_C 0 COMP_0300_S 0 127.5 /end CHARACTERISTIC
/begin CHARACTERISTIC mVTRINCE4 "ROM Const mVTRINCE4" VALUE 0x00008DAC REC_UBYTE_C 0 COMP_0300_S 0 127.5 /end CHARACTERISTIC
/begin CHARACTERISTIC mVTRP1H "ROM Const mVTRP1H" VALUE 0x00008DAD REC_UBYTE_C 0 COMP_0007 0 510 /end CHARACTERISTIC
/begin CHARACTERISTIC mVTRP1L "ROM Const mVTRP1L" VALUE 0x00008DAE REC_UBYTE_C 0 COMP_0007 0 510 /end CHARACTERISTIC
/begin CHARACTERISTIC mVTSTUCE1 "ROM Const mVTSTUCE1" VALUE 0x00008DAF REC_UBYTE_C 0 COMP_0303_S 0 1.99999815 /end CHARACTERISTIC
/begin CHARACTERISTIC mVTSTUCE2 "ROM Const mVTSTUCE2" VALUE 0x00008DB0 REC_UBYTE_C 0 COMP_0303_S 0 1.99999815 /end CHARACTERISTIC
/begin CHARACTERISTIC mVTSTUCK1 "ROM Const mVTSTUCK1" VALUE 0x00008DB1 REC_UBYTE_C 0 COMP_0303_S 0 1.99999815 /end CHARACTERISTIC
/begin CHARACTERISTIC mVTSTUCK2 "ROM Const mVTSTUCK2" VALUE 0x00008DB2 REC_UBYTE_C 0 COMP_0303_S 0 1.99999815 /end CHARACTERISTIC
/begin CHARACTERISTIC mVTTRLIM "ROM Const mVTTRLIM" VALUE 0x00008DB3 REC_UBYTE_C 0 COMP_0048 0 127.5 /end CHARACTERISTIC
/begin CHARACTERISTIC mWAITCLS "ROM Const mWAITCLS" VALUE 0x00008DB4 REC_UBYTE_C 0 COMP_0234 0 2550 /end CHARACTERISTIC
/begin CHARACTERISTIC mWAVVMV1 "ROM Const mWAVVMV1" VALUE 0x00008DB5 REC_UBYTE_C 0 COMP_0045 0 1.9921875 /end CHARACTERISTIC
/begin CHARACTERISTIC mWEIGHT "ROM Const mWEIGHT" VALUE 0x00008DB6 REC_UBYTE_C 0 COMP_0063 0 0.99609375 /end CHARACTERISTIC
/begin CHARACTERISTIC mWEIGHTAV "ROM Const mWEIGHTAV" VALUE 0x00009684 REC_UWORD_C 0 COMP_0290 0 0.999985458 /end CHARACTERISTIC
/begin CHARACTERISTIC mWETDUTY "ROM Const mWETDUTY" VALUE 0x00008DB7 REC_UBYTE_C 0 COMP_0047 0 127.5 /end CHARACTERISTIC
/begin CHARACTERISTIC mWGDZPR "ROM Const mWGDZPR" VALUE 0x00009686 REC_UWORD_C 0 COMP_0217 0 3.999941832 /end CHARACTERISTIC
/begin CHARACTERISTIC mWGGDDGN "ROM Const mWGGDDGN" VALUE 0x00008DB8 REC_UBYTE_C 0 COMP_0014 0 2550 /end CHARACTERISTIC
/begin CHARACTERISTIC mWGMLFB "ROM Const mWGMLFB" VALUE 0x00009688 REC_UWORD_C 0 COMP_0304_S 0 1.04856 /end CHARACTERISTIC
/begin CHARACTERISTIC mWGMLFBHY "ROM Const mWGMLFBHY" VALUE 0x0000968A REC_UWORD_C 0 COMP_0304_S 0 1.04856 /end CHARACTERISTIC
/begin CHARACTERISTIC mWGOPDGN "ROM Const mWGOPDGN" VALUE 0x00008DB9 REC_UBYTE_C 0 COMP_0014 0 2550 /end CHARACTERISTIC
/begin CHARACTERISTIC mWIPDLY "ROM Const mWIPDLY" VALUE 0x00008DBA REC_UBYTE_C 0 COMP_0013 0 255 /end CHARACTERISTIC
/begin CHARACTERISTIC mWISCLD "ROM Const mWISCLD" VALUE 0x00008DBB REC_UBYTE_C 0 COMP_0032 0 0.99609375 /end CHARACTERISTIC
/begin CHARACTERISTIC mWISCLR "ROM Const mWISCLR" VALUE 0x00008DBC REC_UBYTE_C 0 COMP_0032 0 0.99609375 /end CHARACTERISTIC
/begin CHARACTERISTIC mWOT2DLY "ROM Const mWOT2DLY" VALUE 0x00008DBD REC_UBYTE_C 0 COMP_0014 0 2550 /end CHARACTERISTIC
/begin CHARACTERISTIC mWOT2NEH "ROM Const mWOT2NEH" VALUE 0x00008DBE REC_UBYTE_C 0 COMP_0000 0 6375 /end CHARACTERISTIC
/begin CHARACTERISTIC mWOT2NEL "ROM Const mWOT2NEL" VALUE 0x00008DBF REC_UBYTE_C 0 COMP_0000 0 6375 /end CHARACTERISTIC
/begin CHARACTERISTIC mWOT2TWH "ROM Const mWOT2TWH" VALUE 0x00008DC0 REC_UBYTE_C 0 COMP_0035 -50 205 /end CHARACTERISTIC
/begin CHARACTERISTIC mWOT2TWL "ROM Const mWOT2TWL" VALUE 0x00008DC1 REC_UBYTE_C 0 COMP_0035 -50 205 /end CHARACTERISTIC
/begin CHARACTERISTIC mWSPCANJB "ROM Const mWSPCANJB" VALUE 0x00008DC2 REC_UBYTE_C 0 COMP_0068 0 255 /end CHARACTERISTIC
/begin CHARACTERISTIC mWSPCNSRT "ROM Const mWSPCNSRT" VALUE 0x00008DC3 REC_UBYTE_C 0 COMP_0016 0 255 /end CHARACTERISTIC
/begin CHARACTERISTIC mWSPCNSTP "ROM Const mWSPCNSTP" VALUE 0x00008DC4 REC_UBYTE_C 0 COMP_0016 0 255 /end CHARACTERISTIC
/begin CHARACTERISTIC mWSPCNTCL "ROM Const mWSPCNTCL" VALUE 0x00008DC5 REC_UBYTE_C 0 COMP_0040_S 0 2.55 /end CHARACTERISTIC
/begin CHARACTERISTIC mWSPISCST "ROM Const mWSPISCST" VALUE 0x00008DC6 REC_UBYTE_C 0 COMP_0016 0 255 /end CHARACTERISTIC
/begin CHARACTERISTIC mWT2ITCDL "ROM Const mWT2ITCDL" VALUE 0x00008DC7 REC_UBYTE_C 0 COMP_0014 0 2550 /end CHARACTERISTIC
/begin CHARACTERISTIC mWT2ITCHS "ROM Const mWT2ITCHS" VALUE 0x00008DC8 REC_UBYTE_C 0 COMP_0009 0 199.21875 /end CHARACTERISTIC
/begin CHARACTERISTIC mWT2NEDL "ROM Const mWT2NEDL" VALUE 0x00008DC9 REC_UBYTE_C 0 COMP_0014 0 2550 /end CHARACTERISTIC
/begin CHARACTERISTIC mWT2NEHS "ROM Const mWT2NEHS" VALUE 0x00008DCA REC_UBYTE_C 0 COMP_0000 0 6375 /end CHARACTERISTIC
/begin CHARACTERISTIC mWT2TWHS "ROM Const mWT2TWHS" VALUE 0x00008DCB REC_UBYTE_C 0 COMP_0003 0 255 /end CHARACTERISTIC
/begin CHARACTERISTIC mWTMX "ROM Const mWTMX" VALUE 0x00008DCC REC_UBYTE_C 0 COMP_0030 0 255 /end CHARACTERISTIC
/begin CHARACTERISTIC mWUPTWN "ROM Const mWUPTWN" VALUE 0x00008DCD REC_UBYTE_C 0 COMP_0035 -50 205 /end CHARACTERISTIC
/begin CHARACTERISTIC mWUTWN "ROM Const mWUTWN" VALUE 0x00008DCE REC_UBYTE_C 0 COMP_0035 -50 205 /end CHARACTERISTIC
/begin CHARACTERISTIC mXACC "ROM Const mXACC" VALUE 0x00008DCF REC_UBYTE_C 0 COMP_0004 0 255 /end CHARACTERISTIC
/begin CHARACTERISTIC mXDEC "ROM Const mXDEC" VALUE 0x00008DD0 REC_UBYTE_C 0 COMP_0004 0 255 /end CHARACTERISTIC
/begin CHARACTERISTIC mXPBAVMAX "ROM Const mXPBAVMAX" VALUE 0x0000968C REC_UWORD_C 0 COMP_0290 0 0.999985458 /end CHARACTERISTIC
/begin CHARACTERISTIC mXSTAT "ROM Const mXSTAT" VALUE 0x00008DD1 REC_UBYTE_C 0 COMP_0004 0 255 /end CHARACTERISTIC
/begin CHARACTERISTIC mYRNRPM "ROM Const mYRNRPM" VALUE 0x00008DD2 REC_UBYTE_C 0 COMP_0006 0 3187.5 /end CHARACTERISTIC
/begin CHARACTERISTIC mYRTIME "ROM Const mYRTIME" VALUE 0x00008DD3 REC_UBYTE_C 0 COMP_0008 0 25500 /end CHARACTERISTIC
/begin CHARACTERISTIC mZKFLTIM "ROM Const mZKFLTIM" VALUE 0x00008DD4 REC_UBYTE_C 0 COMP_0015_S 0 25.5 /end CHARACTERISTIC
/begin CHARACTERISTIC mZLMT "ROM Const mZLMT" VALUE 0x00008DD5 REC_UBYTE_C 0 COMP_0186 0 3.984375 /end CHARACTERISTIC
/begin CHARACTERISTIC mHOSQMAX "ROM Const mHOSQMAX" VALUE 0x00012CBE REC_SWORD_C 0 COMP_0305_S -83886.08 83883.52 /end CHARACTERISTIC
/begin CHARACTERISTIC mHOSQMIN "ROM Const mHOSQMIN" VALUE 0x00012CC2 REC_SWORD_C 0 COMP_0305_S -83886.08 83883.52 /end CHARACTERISTIC
/begin CHARACTERISTIC mRHSOSQL "ROM Const mRHSOSQL" VALUE 0x00012CC6 REC_SWORD_C 0 COMP_0305_S -83886.08 83883.52 /end CHARACTERISTIC
/begin CHARACTERISTIC mRO2DTHS1 "ROM Const mRO2DTHS1" VALUE 0x00013A3E REC_UWORD_C 0 COMP_0061 0 327675 /end CHARACTERISTIC
/begin CHARACTERISTIC mRO2DTHS2 "ROM Const mRO2DTHS2" VALUE 0x00013A42 REC_UWORD_C 0 COMP_0061 0 327675 /end CHARACTERISTIC
/begin CHARACTERISTIC mRO2DTHS3 "ROM Const mRO2DTHS3" VALUE 0x00013A46 REC_UWORD_C 0 COMP_0061 0 327675 /end CHARACTERISTIC
/begin CHARACTERISTIC mRO2L1DT "ROM Const mRO2L1DT" VALUE 0x00013A4A REC_UWORD_C 0 COMP_0061 0 327675 /end CHARACTERISTIC
/begin CHARACTERISTIC mRO2L2DT "ROM Const mRO2L2DT" VALUE 0x00013A4E REC_UWORD_C 0 COMP_0061 0 327675 /end CHARACTERISTIC
/begin CHARACTERISTIC mRO2L3DT "ROM Const mRO2L3DT" VALUE 0x00013A52 REC_UWORD_C 0 COMP_0023 0 327675 /end CHARACTERISTIC
/begin CHARACTERISTIC mRO2R1DT "ROM Const mRO2R1DT" VALUE 0x00013A56 REC_UWORD_C 0 COMP_0061 0 327675 /end CHARACTERISTIC
/begin CHARACTERISTIC mRO2R2DT "ROM Const mRO2R2DT" VALUE 0x00013A5A REC_UWORD_C 0 COMP_0061 0 327675 /end CHARACTERISTIC
/begin CHARACTERISTIC mRO2R3DT "ROM Const mRO2R3DT" VALUE 0x00013A5E REC_UWORD_C 0 COMP_0023 0 327675 /end CHARACTERISTIC
/begin CHARACTERISTIC mSOSQMAX "ROM Const mSOSQMAX" VALUE 0x00012CCA REC_SWORD_C 0 COMP_0305_S -83886.08 83883.52 /end CHARACTERISTIC
/begin CHARACTERISTIC mSOSQMIN "ROM Const mSOSQMIN" VALUE 0x00012CCE REC_SWORD_C 0 COMP_0305_S -83886.08 83883.52 /end CHARACTERISTIC
/begin CHARACTERISTIC mCANID0000 "ROM Const mCANID0000" VALUE 0x0000986E REC_UBYTE_C 0 COMP_0068 0 255 /end CHARACTERISTIC
/begin CHARACTERISTIC mCANID0001 "ROM Const mCANID0001" VALUE 0x0000986F REC_UBYTE_C 0 COMP_0068 0 255 /end CHARACTERISTIC
/begin CHARACTERISTIC mCANID0002 "ROM Const mCANID0002" VALUE 0x00009870 REC_UBYTE_C 0 COMP_0068 0 255 /end CHARACTERISTIC
/begin CHARACTERISTIC mCANID0003 "ROM Const mCANID0003" VALUE 0x00009871 REC_UBYTE_C 0 COMP_0068 0 255 /end CHARACTERISTIC
/begin CHARACTERISTIC mCANID0100 "ROM Const mCANID0100" VALUE 0x00009872 REC_UBYTE_C 0 COMP_0068 0 255 /end CHARACTERISTIC
/begin CHARACTERISTIC mCANID0101 "ROM Const mCANID0101" VALUE 0x00009873 REC_UBYTE_C 0 COMP_0068 0 255 /end CHARACTERISTIC
/begin CHARACTERISTIC mCANID0102 "ROM Const mCANID0102" VALUE 0x00009874 REC_UBYTE_C 0 COMP_0068 0 255 /end CHARACTERISTIC
/begin CHARACTERISTIC mCANID0103 "ROM Const mCANID0103" VALUE 0x00009875 REC_UBYTE_C 0 COMP_0068 0 255 /end CHARACTERISTIC
/begin CHARACTERISTIC mCANID0200 "ROM Const mCANID0200" VALUE 0x00009876 REC_UBYTE_C 0 COMP_0068 0 255 /end CHARACTERISTIC
/begin CHARACTERISTIC mCANID0201 "ROM Const mCANID0201" VALUE 0x00009877 REC_UBYTE_C 0 COMP_0068 0 255 /end CHARACTERISTIC
/begin CHARACTERISTIC mCANID0202 "ROM Const mCANID0202" VALUE 0x00009878 REC_UBYTE_C 0 COMP_0068 0 255 /end CHARACTERISTIC
/begin CHARACTERISTIC mCANID0203 "ROM Const mCANID0203" VALUE 0x00009879 REC_UBYTE_C 0 COMP_0068 0 255 /end CHARACTERISTIC
/begin CHARACTERISTIC mCANID0300 "ROM Const mCANID0300" VALUE 0x0000987A REC_UBYTE_C 0 COMP_0068 0 255 /end CHARACTERISTIC
/begin CHARACTERISTIC mCANID0301 "ROM Const mCANID0301" VALUE 0x0000987B REC_UBYTE_C 0 COMP_0068 0 255 /end CHARACTERISTIC
/begin CHARACTERISTIC mCANID0302 "ROM Const mCANID0302" VALUE 0x0000987C REC_UBYTE_C 0 COMP_0068 0 255 /end CHARACTERISTIC
/begin CHARACTERISTIC mCANID0303 "ROM Const mCANID0303" VALUE 0x0000987D REC_UBYTE_C 0 COMP_0068 0 255 /end CHARACTERISTIC
/begin CHARACTERISTIC mCANID0400 "ROM Const mCANID0400" VALUE 0x0000987E REC_UBYTE_C 0 COMP_0068 0 255 /end CHARACTERISTIC
/begin CHARACTERISTIC mCANID0401 "ROM Const mCANID0401" VALUE 0x0000987F REC_UBYTE_C 0 COMP_0068 0 255 /end CHARACTERISTIC
/begin CHARACTERISTIC mCANID0402 "ROM Const mCANID0402" VALUE 0x00009880 REC_UBYTE_C 0 COMP_0068 0 255 /end CHARACTERISTIC
/begin CHARACTERISTIC mCANID0403 "ROM Const mCANID0403" VALUE 0x00009881 REC_UBYTE_C 0 COMP_0068 0 255 /end CHARACTERISTIC
/begin CHARACTERISTIC mCANID0500 "ROM Const mCANID0500" VALUE 0x00009882 REC_UBYTE_C 0 COMP_0068 0 255 /end CHARACTERISTIC
/begin CHARACTERISTIC mCANID0501 "ROM Const mCANID0501" VALUE 0x00009883 REC_UBYTE_C 0 COMP_0068 0 255 /end CHARACTERISTIC
/begin CHARACTERISTIC mCANID0502 "ROM Const mCANID0502" VALUE 0x00009884 REC_UBYTE_C 0 COMP_0068 0 255 /end CHARACTERISTIC
/begin CHARACTERISTIC mCANID0503 "ROM Const mCANID0503" VALUE 0x00009885 REC_UBYTE_C 0 COMP_0068 0 255 /end CHARACTERISTIC
/begin CHARACTERISTIC mCANID0600 "ROM Const mCANID0600" VALUE 0x00009886 REC_UBYTE_C 0 COMP_0068 0 255 /end CHARACTERISTIC
/begin CHARACTERISTIC mCANID0601 "ROM Const mCANID0601" VALUE 0x00009887 REC_UBYTE_C 0 COMP_0068 0 255 /end CHARACTERISTIC
/begin CHARACTERISTIC mCANID0602 "ROM Const mCANID0602" VALUE 0x00009888 REC_UBYTE_C 0 COMP_0068 0 255 /end CHARACTERISTIC
/begin CHARACTERISTIC mCANID0603 "ROM Const mCANID0603" VALUE 0x00009889 REC_UBYTE_C 0 COMP_0068 0 255 /end CHARACTERISTIC
/begin CHARACTERISTIC mCANID0700 "ROM Const mCANID0700" VALUE 0x0000988A REC_UBYTE_C 0 COMP_0068 0 255 /end CHARACTERISTIC
/begin CHARACTERISTIC mCANID0701 "ROM Const mCANID0701" VALUE 0x0000988B REC_UBYTE_C 0 COMP_0068 0 255 /end CHARACTERISTIC
/begin CHARACTERISTIC mCANID0702 "ROM Const mCANID0702" VALUE 0x0000988C REC_UBYTE_C 0 COMP_0068 0 255 /end CHARACTERISTIC
/begin CHARACTERISTIC mCANID0703 "ROM Const mCANID0703" VALUE 0x0000988D REC_UBYTE_C 0 COMP_0068 0 255 /end CHARACTERISTIC
/begin CHARACTERISTIC mCANID0800 "ROM Const mCANID0800" VALUE 0x0000988E REC_UBYTE_C 0 COMP_0068 0 255 /end CHARACTERISTIC
/begin CHARACTERISTIC mCANID0801 "ROM Const mCANID0801" VALUE 0x0000988F REC_UBYTE_C 0 COMP_0068 0 255 /end CHARACTERISTIC
/begin CHARACTERISTIC mCANID0802 "ROM Const mCANID0802" VALUE 0x00009890 REC_UBYTE_C 0 COMP_0068 0 255 /end CHARACTERISTIC
/begin CHARACTERISTIC mCANID0803 "ROM Const mCANID0803" VALUE 0x00009891 REC_UBYTE_C 0 COMP_0068 0 255 /end CHARACTERISTIC
/begin CHARACTERISTIC mCANID0900 "ROM Const mCANID0900" VALUE 0x00009892 REC_UBYTE_C 0 COMP_0068 0 255 /end CHARACTERISTIC
/begin CHARACTERISTIC mCANID0901 "ROM Const mCANID0901" VALUE 0x00009893 REC_UBYTE_C 0 COMP_0068 0 255 /end CHARACTERISTIC
/begin CHARACTERISTIC mCANID0902 "ROM Const mCANID0902" VALUE 0x00009894 REC_UBYTE_C 0 COMP_0068 0 255 /end CHARACTERISTIC
/begin CHARACTERISTIC mCANID0903 "ROM Const mCANID0903" VALUE 0x00009895 REC_UBYTE_C 0 COMP_0068 0 255 /end CHARACTERISTIC
/begin CHARACTERISTIC mCANID0A00 "ROM Const mCANID0A00" VALUE 0x00009896 REC_UBYTE_C 0 COMP_0068 0 255 /end CHARACTERISTIC
/begin CHARACTERISTIC mCANID0A01 "ROM Const mCANID0A01" VALUE 0x00009897 REC_UBYTE_C 0 COMP_0068 0 255 /end CHARACTERISTIC
/begin CHARACTERISTIC mCANID0A02 "ROM Const mCANID0A02" VALUE 0x00009898 REC_UBYTE_C 0 COMP_0068 0 255 /end CHARACTERISTIC
/begin CHARACTERISTIC mCANID0A03 "ROM Const mCANID0A03" VALUE 0x00009899 REC_UBYTE_C 0 COMP_0068 0 255 /end CHARACTERISTIC
/begin CHARACTERISTIC mCANID0B00 "ROM Const mCANID0B00" VALUE 0x0000989A REC_UBYTE_C 0 COMP_0068 0 255 /end CHARACTERISTIC
/begin CHARACTERISTIC mCANID0B01 "ROM Const mCANID0B01" VALUE 0x0000989B REC_UBYTE_C 0 COMP_0068 0 255 /end CHARACTERISTIC
/begin CHARACTERISTIC mCANID0B02 "ROM Const mCANID0B02" VALUE 0x0000989C REC_UBYTE_C 0 COMP_0068 0 255 /end CHARACTERISTIC
/begin CHARACTERISTIC mCANID0B03 "ROM Const mCANID0B03" VALUE 0x0000989D REC_UBYTE_C 0 COMP_0068 0 255 /end CHARACTERISTIC
/begin CHARACTERISTIC mCANID0C00 "ROM Const mCANID0C00" VALUE 0x0000989E REC_UBYTE_C 0 COMP_0068 0 255 /end CHARACTERISTIC
/begin CHARACTERISTIC mCANID0C01 "ROM Const mCANID0C01" VALUE 0x0000989F REC_UBYTE_C 0 COMP_0068 0 255 /end CHARACTERISTIC
/begin CHARACTERISTIC mCANID0C02 "ROM Const mCANID0C02" VALUE 0x000098A0 REC_UBYTE_C 0 COMP_0068 0 255 /end CHARACTERISTIC
/begin CHARACTERISTIC mCANID0C03 "ROM Const mCANID0C03" VALUE 0x000098A1 REC_UBYTE_C 0 COMP_0068 0 255 /end CHARACTERISTIC
/begin CHARACTERISTIC mCANID0D00 "ROM Const mCANID0D00" VALUE 0x000098A2 REC_UBYTE_C 0 COMP_0068 0 255 /end CHARACTERISTIC
/begin CHARACTERISTIC mCANID0D01 "ROM Const mCANID0D01" VALUE 0x000098A3 REC_UBYTE_C 0 COMP_0068 0 255 /end CHARACTERISTIC
/begin CHARACTERISTIC mCANID0D02 "ROM Const mCANID0D02" VALUE 0x000098A4 REC_UBYTE_C 0 COMP_0068 0 255 /end CHARACTERISTIC
/begin CHARACTERISTIC mCANID0D03 "ROM Const mCANID0D03" VALUE 0x000098A5 REC_UBYTE_C 0 COMP_0068 0 255 /end CHARACTERISTIC
/begin CHARACTERISTIC mCANID0E00 "ROM Const mCANID0E00" VALUE 0x000098A6 REC_UBYTE_C 0 COMP_0068 0 255 /end CHARACTERISTIC
/begin CHARACTERISTIC mCANID0E01 "ROM Const mCANID0E01" VALUE 0x000098A7 REC_UBYTE_C 0 COMP_0068 0 255 /end CHARACTERISTIC
/begin CHARACTERISTIC mCANID0E02 "ROM Const mCANID0E02" VALUE 0x000098A8 REC_UBYTE_C 0 COMP_0068 0 255 /end CHARACTERISTIC
/begin CHARACTERISTIC mCANID0E03 "ROM Const mCANID0E03" VALUE 0x000098A9 REC_UBYTE_C 0 COMP_0068 0 255 /end CHARACTERISTIC
/begin CHARACTERISTIC mCANID0F00 "ROM Const mCANID0F00" VALUE 0x000098AA REC_UBYTE_C 0 COMP_0068 0 255 /end CHARACTERISTIC
/begin CHARACTERISTIC mCANID0F01 "ROM Const mCANID0F01" VALUE 0x000098AB REC_UBYTE_C 0 COMP_0068 0 255 /end CHARACTERISTIC
/begin CHARACTERISTIC mCANID0F02 "ROM Const mCANID0F02" VALUE 0x000098AC REC_UBYTE_C 0 COMP_0068 0 255 /end CHARACTERISTIC
/begin CHARACTERISTIC mCANID0F03 "ROM Const mCANID0F03" VALUE 0x000098AD REC_UBYTE_C 0 COMP_0068 0 255 /end CHARACTERISTIC
/begin CHARACTERISTIC mCANID1000 "ROM Const mCANID1000" VALUE 0x000098AE REC_UBYTE_C 0 COMP_0068 0 255 /end CHARACTERISTIC
/begin CHARACTERISTIC mCANID1001 "ROM Const mCANID1001" VALUE 0x000098AF REC_UBYTE_C 0 COMP_0068 0 255 /end CHARACTERISTIC
/begin CHARACTERISTIC mCANID1002 "ROM Const mCANID1002" VALUE 0x000098B0 REC_UBYTE_C 0 COMP_0068 0 255 /end CHARACTERISTIC
/begin CHARACTERISTIC mCANID1003 "ROM Const mCANID1003" VALUE 0x000098B1 REC_UBYTE_C 0 COMP_0068 0 255 /end CHARACTERISTIC
/begin CHARACTERISTIC mCANID1100 "ROM Const mCANID1100" VALUE 0x000098B2 REC_UBYTE_C 0 COMP_0068 0 255 /end CHARACTERISTIC
/begin CHARACTERISTIC mCANID1101 "ROM Const mCANID1101" VALUE 0x000098B3 REC_UBYTE_C 0 COMP_0068 0 255 /end CHARACTERISTIC
/begin CHARACTERISTIC mCANID1102 "ROM Const mCANID1102" VALUE 0x000098B4 REC_UBYTE_C 0 COMP_0068 0 255 /end CHARACTERISTIC
/begin CHARACTERISTIC mCANID1103 "ROM Const mCANID1103" VALUE 0x000098B5 REC_UBYTE_C 0 COMP_0068 0 255 /end CHARACTERISTIC
/begin CHARACTERISTIC mCANID1200 "ROM Const mCANID1200" VALUE 0x000098B6 REC_UBYTE_C 0 COMP_0068 0 255 /end CHARACTERISTIC
/begin CHARACTERISTIC mCANID1201 "ROM Const mCANID1201" VALUE 0x000098B7 REC_UBYTE_C 0 COMP_0068 0 255 /end CHARACTERISTIC
/begin CHARACTERISTIC mCANID1202 "ROM Const mCANID1202" VALUE 0x000098B8 REC_UBYTE_C 0 COMP_0068 0 255 /end CHARACTERISTIC
/begin CHARACTERISTIC mCANID1203 "ROM Const mCANID1203" VALUE 0x000098B9 REC_UBYTE_C 0 COMP_0068 0 255 /end CHARACTERISTIC
/begin CHARACTERISTIC mCANID1300 "ROM Const mCANID1300" VALUE 0x000098BA REC_UBYTE_C 0 COMP_0068 0 255 /end CHARACTERISTIC
/begin CHARACTERISTIC mCANID1301 "ROM Const mCANID1301" VALUE 0x000098BB REC_UBYTE_C 0 COMP_0068 0 255 /end CHARACTERISTIC
/begin CHARACTERISTIC mCANID1302 "ROM Const mCANID1302" VALUE 0x000098BC REC_UBYTE_C 0 COMP_0068 0 255 /end CHARACTERISTIC
/begin CHARACTERISTIC mCANID1303 "ROM Const mCANID1303" VALUE 0x000098BD REC_UBYTE_C 0 COMP_0068 0 255 /end CHARACTERISTIC
/begin CHARACTERISTIC mCANID1400 "ROM Const mCANID1400" VALUE 0x000098BE REC_UBYTE_C 0 COMP_0068 0 255 /end CHARACTERISTIC
/begin CHARACTERISTIC mCANID1401 "ROM Const mCANID1401" VALUE 0x000098BF REC_UBYTE_C 0 COMP_0068 0 255 /end CHARACTERISTIC
/begin CHARACTERISTIC mCANID1402 "ROM Const mCANID1402" VALUE 0x000098C0 REC_UBYTE_C 0 COMP_0068 0 255 /end CHARACTERISTIC
/begin CHARACTERISTIC mCANID1403 "ROM Const mCANID1403" VALUE 0x000098C1 REC_UBYTE_C 0 COMP_0068 0 255 /end CHARACTERISTIC
/begin CHARACTERISTIC mCANID1500 "ROM Const mCANID1500" VALUE 0x000098C2 REC_UBYTE_C 0 COMP_0068 0 255 /end CHARACTERISTIC
/begin CHARACTERISTIC mCANID1501 "ROM Const mCANID1501" VALUE 0x000098C3 REC_UBYTE_C 0 COMP_0068 0 255 /end CHARACTERISTIC
/begin CHARACTERISTIC mCANID1502 "ROM Const mCANID1502" VALUE 0x000098C4 REC_UBYTE_C 0 COMP_0068 0 255 /end CHARACTERISTIC
/begin CHARACTERISTIC mCANID1503 "ROM Const mCANID1503" VALUE 0x000098C5 REC_UBYTE_C 0 COMP_0068 0 255 /end CHARACTERISTIC
/begin CHARACTERISTIC mCANID1600 "ROM Const mCANID1600" VALUE 0x000098C6 REC_UBYTE_C 0 COMP_0068 0 255 /end CHARACTERISTIC
/begin CHARACTERISTIC mCANID1601 "ROM Const mCANID1601" VALUE 0x000098C7 REC_UBYTE_C 0 COMP_0068 0 255 /end CHARACTERISTIC
/begin CHARACTERISTIC mCANID1602 "ROM Const mCANID1602" VALUE 0x000098C8 REC_UBYTE_C 0 COMP_0068 0 255 /end CHARACTERISTIC
/begin CHARACTERISTIC mCANID1603 "ROM Const mCANID1603" VALUE 0x000098C9 REC_UBYTE_C 0 COMP_0068 0 255 /end CHARACTERISTIC
/begin CHARACTERISTIC mCANID1700 "ROM Const mCANID1700" VALUE 0x000098CA REC_UBYTE_C 0 COMP_0068 0 255 /end CHARACTERISTIC
/begin CHARACTERISTIC mCANID1701 "ROM Const mCANID1701" VALUE 0x000098CB REC_UBYTE_C 0 COMP_0068 0 255 /end CHARACTERISTIC
/begin CHARACTERISTIC mCANID1702 "ROM Const mCANID1702" VALUE 0x000098CC REC_UBYTE_C 0 COMP_0068 0 255 /end CHARACTERISTIC
/begin CHARACTERISTIC mCANID1703 "ROM Const mCANID1703" VALUE 0x000098CD REC_UBYTE_C 0 COMP_0068 0 255 /end CHARACTERISTIC
/begin CHARACTERISTIC mCANID1800 "ROM Const mCANID1800" VALUE 0x000098CE REC_UBYTE_C 0 COMP_0068 0 255 /end CHARACTERISTIC
/begin CHARACTERISTIC mCANID1801 "ROM Const mCANID1801" VALUE 0x000098CF REC_UBYTE_C 0 COMP_0068 0 255 /end CHARACTERISTIC
/begin CHARACTERISTIC mCANID1802 "ROM Const mCANID1802" VALUE 0x000098D0 REC_UBYTE_C 0 COMP_0068 0 255 /end CHARACTERISTIC
/begin CHARACTERISTIC mCANID1803 "ROM Const mCANID1803" VALUE 0x000098D1 REC_UBYTE_C 0 COMP_0068 0 255 /end CHARACTERISTIC
/begin CHARACTERISTIC mCANID1900 "ROM Const mCANID1900" VALUE 0x000098D2 REC_UBYTE_C 0 COMP_0068 0 255 /end CHARACTERISTIC
/begin CHARACTERISTIC mCANID1901 "ROM Const mCANID1901" VALUE 0x000098D3 REC_UBYTE_C 0 COMP_0068 0 255 /end CHARACTERISTIC
/begin CHARACTERISTIC mCANID1902 "ROM Const mCANID1902" VALUE 0x000098D4 REC_UBYTE_C 0 COMP_0068 0 255 /end CHARACTERISTIC
/begin CHARACTERISTIC mCANID1903 "ROM Const mCANID1903" VALUE 0x000098D5 REC_UBYTE_C 0 COMP_0068 0 255 /end CHARACTERISTIC
/begin CHARACTERISTIC mCANID1A00 "ROM Const mCANID1A00" VALUE 0x000098D6 REC_UBYTE_C 0 COMP_0068 0 255 /end CHARACTERISTIC
/begin CHARACTERISTIC mCANID1A01 "ROM Const mCANID1A01" VALUE 0x000098D7 REC_UBYTE_C 0 COMP_0068 0 255 /end CHARACTERISTIC
/begin CHARACTERISTIC mCANID1A02 "ROM Const mCANID1A02" VALUE 0x000098D8 REC_UBYTE_C 0 COMP_0068 0 255 /end CHARACTERISTIC
/begin CHARACTERISTIC mCANID1A03 "ROM Const mCANID1A03" VALUE 0x000098D9 REC_UBYTE_C 0 COMP_0068 0 255 /end CHARACTERISTIC
/begin CHARACTERISTIC mCANID1B00 "ROM Const mCANID1B00" VALUE 0x000098DA REC_UBYTE_C 0 COMP_0068 0 255 /end CHARACTERISTIC
/begin CHARACTERISTIC mCANID1B01 "ROM Const mCANID1B01" VALUE 0x000098DB REC_UBYTE_C 0 COMP_0068 0 255 /end CHARACTERISTIC
/begin CHARACTERISTIC mCANID1B02 "ROM Const mCANID1B02" VALUE 0x000098DC REC_UBYTE_C 0 COMP_0068 0 255 /end CHARACTERISTIC
/begin CHARACTERISTIC mCANID1B03 "ROM Const mCANID1B03" VALUE 0x000098DD REC_UBYTE_C 0 COMP_0068 0 255 /end CHARACTERISTIC
/begin CHARACTERISTIC mCANID1C00 "ROM Const mCANID1C00" VALUE 0x000098DE REC_UBYTE_C 0 COMP_0068 0 255 /end CHARACTERISTIC
/begin CHARACTERISTIC mCANID1C01 "ROM Const mCANID1C01" VALUE 0x000098DF REC_UBYTE_C 0 COMP_0068 0 255 /end CHARACTERISTIC
/begin CHARACTERISTIC mCANID1C02 "ROM Const mCANID1C02" VALUE 0x000098E0 REC_UBYTE_C 0 COMP_0068 0 255 /end CHARACTERISTIC
/begin CHARACTERISTIC mCANID1C03 "ROM Const mCANID1C03" VALUE 0x000098E1 REC_UBYTE_C 0 COMP_0068 0 255 /end CHARACTERISTIC
/begin CHARACTERISTIC mCANID1D00 "ROM Const mCANID1D00" VALUE 0x000098E2 REC_UBYTE_C 0 COMP_0068 0 255 /end CHARACTERISTIC
/begin CHARACTERISTIC mCANID1D01 "ROM Const mCANID1D01" VALUE 0x000098E3 REC_UBYTE_C 0 COMP_0068 0 255 /end CHARACTERISTIC
/begin CHARACTERISTIC mCANID1D02 "ROM Const mCANID1D02" VALUE 0x000098E4 REC_UBYTE_C 0 COMP_0068 0 255 /end CHARACTERISTIC
/begin CHARACTERISTIC mCANID1D03 "ROM Const mCANID1D03" VALUE 0x000098E5 REC_UBYTE_C 0 COMP_0068 0 255 /end CHARACTERISTIC
/begin CHARACTERISTIC mCANID1E00 "ROM Const mCANID1E00" VALUE 0x000098E6 REC_UBYTE_C 0 COMP_0068 0 255 /end CHARACTERISTIC
/begin CHARACTERISTIC mCANID1E01 "ROM Const mCANID1E01" VALUE 0x000098E7 REC_UBYTE_C 0 COMP_0068 0 255 /end CHARACTERISTIC
/begin CHARACTERISTIC mCANID1E02 "ROM Const mCANID1E02" VALUE 0x000098E8 REC_UBYTE_C 0 COMP_0068 0 255 /end CHARACTERISTIC
/begin CHARACTERISTIC mCANID1E03 "ROM Const mCANID1E03" VALUE 0x000098E9 REC_UBYTE_C 0 COMP_0068 0 255 /end CHARACTERISTIC
/begin CHARACTERISTIC mCANID1F00 "ROM Const mCANID1F00" VALUE 0x000098EA REC_UBYTE_C 0 COMP_0068 0 255 /end CHARACTERISTIC
/begin CHARACTERISTIC mCANID1F01 "ROM Const mCANID1F01" VALUE 0x000098EB REC_UBYTE_C 0 COMP_0068 0 255 /end CHARACTERISTIC
/begin CHARACTERISTIC mCANID1F02 "ROM Const mCANID1F02" VALUE 0x000098EC REC_UBYTE_C 0 COMP_0068 0 255 /end CHARACTERISTIC
/begin CHARACTERISTIC mCANID1F03 "ROM Const mCANID1F03" VALUE 0x000098ED REC_UBYTE_C 0 COMP_0068 0 255 /end CHARACTERISTIC
/begin CHARACTERISTIC mCANID2000 "ROM Const mCANID2000" VALUE 0x000098EE REC_UBYTE_C 0 COMP_0068 0 255 /end CHARACTERISTIC
/begin CHARACTERISTIC mCANID2001 "ROM Const mCANID2001" VALUE 0x000098EF REC_UBYTE_C 0 COMP_0068 0 255 /end CHARACTERISTIC
/begin CHARACTERISTIC mCANID2002 "ROM Const mCANID2002" VALUE 0x000098F0 REC_UBYTE_C 0 COMP_0068 0 255 /end CHARACTERISTIC
/begin CHARACTERISTIC mCANID2003 "ROM Const mCANID2003" VALUE 0x000098F1 REC_UBYTE_C 0 COMP_0068 0 255 /end CHARACTERISTIC
/begin CHARACTERISTIC mCANID2100 "ROM Const mCANID2100" VALUE 0x000098F2 REC_UBYTE_C 0 COMP_0068 0 255 /end CHARACTERISTIC
/begin CHARACTERISTIC mCANID2101 "ROM Const mCANID2101" VALUE 0x000098F3 REC_UBYTE_C 0 COMP_0068 0 255 /end CHARACTERISTIC
/begin CHARACTERISTIC mCANID2102 "ROM Const mCANID2102" VALUE 0x000098F4 REC_UBYTE_C 0 COMP_0068 0 255 /end CHARACTERISTIC
/begin CHARACTERISTIC mCANID2103 "ROM Const mCANID2103" VALUE 0x000098F5 REC_UBYTE_C 0 COMP_0068 0 255 /end CHARACTERISTIC
/begin CHARACTERISTIC mCANID2200 "ROM Const mCANID2200" VALUE 0x000098F6 REC_UBYTE_C 0 COMP_0068 0 255 /end CHARACTERISTIC
/begin CHARACTERISTIC mCANID2201 "ROM Const mCANID2201" VALUE 0x000098F7 REC_UBYTE_C 0 COMP_0068 0 255 /end CHARACTERISTIC
/begin CHARACTERISTIC mCANID2202 "ROM Const mCANID2202" VALUE 0x000098F8 REC_UBYTE_C 0 COMP_0068 0 255 /end CHARACTERISTIC
/begin CHARACTERISTIC mCANID2203 "ROM Const mCANID2203" VALUE 0x000098F9 REC_UBYTE_C 0 COMP_0068 0 255 /end CHARACTERISTIC
/begin CHARACTERISTIC mCANID2300 "ROM Const mCANID2300" VALUE 0x000098FA REC_UBYTE_C 0 COMP_0068 0 255 /end CHARACTERISTIC
/begin CHARACTERISTIC mCANID2301 "ROM Const mCANID2301" VALUE 0x000098FB REC_UBYTE_C 0 COMP_0068 0 255 /end CHARACTERISTIC
/begin CHARACTERISTIC mCANID2302 "ROM Const mCANID2302" VALUE 0x000098FC REC_UBYTE_C 0 COMP_0068 0 255 /end CHARACTERISTIC
/begin CHARACTERISTIC mCANID2303 "ROM Const mCANID2303" VALUE 0x000098FD REC_UBYTE_C 0 COMP_0068 0 255 /end CHARACTERISTIC
/begin CHARACTERISTIC mMMBTRMCC "冷機時且つTCV(SCV)閉時MBTトリミングマップ" MAP 0x0000ADEE REC_UBYTE_C 0 COMP_0245 -64 191
 /begin AXIS_DESCR COM_AXIS NO_INPUT_QUANTITY COMP_0020 16 0 12750 AXIS_PTS_REF mTADVTRSN /end AXIS_DESCR
 /begin AXIS_DESCR COM_AXIS NO_INPUT_QUANTITY COMP_0009 16 0 199.21875 AXIS_PTS_REF mTADVTRSI /end AXIS_DESCR
/end CHARACTERISTIC
/begin CHARACTERISTIC mMMBTRMCC_B7 "冷機時且つTCV(SCV)閉時MBTトリミングマップ [LSB 7 bit]" MAP 0x0000ADEE REC_UBYTE_C 0 COMP_0245 -64 63 BIT_MASK 0x007F
 /begin AXIS_DESCR COM_AXIS NO_INPUT_QUANTITY COMP_0020 16 0 12750 AXIS_PTS_REF mTADVTRSN /end AXIS_DESCR
 /begin AXIS_DESCR COM_AXIS NO_INPUT_QUANTITY COMP_0009 16 0 199.21875 AXIS_PTS_REF mTADVTRSI /end AXIS_DESCR
/end CHARACTERISTIC
/begin CHARACTERISTIC mMMBTRMCC_B1 "冷機時且つTCV(SCV)閉時MBTトリミングマップ [MSB 1 bit]" MAP 0x0000ADEE REC_UBYTE_C 0 COMP_0245 -64 191 BIT_MASK 0x0080
 /begin AXIS_DESCR COM_AXIS NO_INPUT_QUANTITY COMP_0020 16 0 12750 AXIS_PTS_REF mTADVTRSN /end AXIS_DESCR
 /begin AXIS_DESCR COM_AXIS NO_INPUT_QUANTITY COMP_0009 16 0 199.21875 AXIS_PTS_REF mTADVTRSI /end AXIS_DESCR
/end CHARACTERISTIC
/begin CHARACTERISTIC mMMBTRMFC "極冷機時且つTCV(SCV)閉時MBTトリミングマップ" MAP 0x0000AEEE REC_UBYTE_C 0 COMP_0245 -64 191
 /begin AXIS_DESCR COM_AXIS NO_INPUT_QUANTITY COMP_0020 16 0 12750 AXIS_PTS_REF mTADVTRSN /end AXIS_DESCR
 /begin AXIS_DESCR COM_AXIS NO_INPUT_QUANTITY COMP_0009 16 0 199.21875 AXIS_PTS_REF mTADVTRSI /end AXIS_DESCR
/end CHARACTERISTIC
/begin CHARACTERISTIC mMMBTRMFC_B7 "極冷機時且つTCV(SCV)閉時MBTトリミングマップ [LSB 7 bit]" MAP 0x0000AEEE REC_UBYTE_C 0 COMP_0245 -64 63 BIT_MASK 0x007F
 /begin AXIS_DESCR COM_AXIS NO_INPUT_QUANTITY COMP_0020 16 0 12750 AXIS_PTS_REF mTADVTRSN /end AXIS_DESCR
 /begin AXIS_DESCR COM_AXIS NO_INPUT_QUANTITY COMP_0009 16 0 199.21875 AXIS_PTS_REF mTADVTRSI /end AXIS_DESCR
/end CHARACTERISTIC
/begin CHARACTERISTIC mMMBTRMFC_B1 "極冷機時且つTCV(SCV)閉時MBTトリミングマップ [MSB 1 bit]" MAP 0x0000AEEE REC_UBYTE_C 0 COMP_0245 -64 191 BIT_MASK 0x0080
 /begin AXIS_DESCR COM_AXIS NO_INPUT_QUANTITY COMP_0020 16 0 12750 AXIS_PTS_REF mTADVTRSN /end AXIS_DESCR
 /begin AXIS_DESCR COM_AXIS NO_INPUT_QUANTITY COMP_0009 16 0 199.21875 AXIS_PTS_REF mTADVTRSI /end AXIS_DESCR
/end CHARACTERISTIC
/begin CHARACTERISTIC mMMBTRMFO "極冷機時且つ（TCV(SCV)開時またはTCV無し）MBTトリミングマップ" MAP 0x0000AFEE REC_UBYTE_C 0 COMP_0245 -64 191
 /begin AXIS_DESCR COM_AXIS NO_INPUT_QUANTITY COMP_0020 16 0 12750 AXIS_PTS_REF mTADVTRSN /end AXIS_DESCR
 /begin AXIS_DESCR COM_AXIS NO_INPUT_QUANTITY COMP_0009 16 0 199.21875 AXIS_PTS_REF mTADVTRSI /end AXIS_DESCR
/end CHARACTERISTIC
/begin CHARACTERISTIC mMMBTRMFO_B7 "極冷機時且つ（TCV(SCV)開時またはTCV無し）MBTトリミングマップ [LSB 7 bit]" MAP 0x0000AFEE REC_UBYTE_C 0 COMP_0245 -64 63 BIT_MASK 0x007F
 /begin AXIS_DESCR COM_AXIS NO_INPUT_QUANTITY COMP_0020 16 0 12750 AXIS_PTS_REF mTADVTRSN /end AXIS_DESCR
 /begin AXIS_DESCR COM_AXIS NO_INPUT_QUANTITY COMP_0009 16 0 199.21875 AXIS_PTS_REF mTADVTRSI /end AXIS_DESCR
/end CHARACTERISTIC
/begin CHARACTERISTIC mMMBTRMFO_B1 "極冷機時且つ（TCV(SCV)開時またはTCV無し）MBTトリミングマップ [MSB 1 bit]" MAP 0x0000AFEE REC_UBYTE_C 0 COMP_0245 -64 191 BIT_MASK 0x0080
 /begin AXIS_DESCR COM_AXIS NO_INPUT_QUANTITY COMP_0020 16 0 12750 AXIS_PTS_REF mTADVTRSN /end AXIS_DESCR
 /begin AXIS_DESCR COM_AXIS NO_INPUT_QUANTITY COMP_0009 16 0 199.21875 AXIS_PTS_REF mTADVTRSI /end AXIS_DESCR
/end CHARACTERISTIC
/begin CHARACTERISTIC mMMBTRVOF "VTCOFF時MBTトリミングマップ" MAP 0x0000B12E REC_UBYTE_C 0 COMP_0245 -64 191
 /begin AXIS_DESCR COM_AXIS NO_INPUT_QUANTITY COMP_0020 16 0 12750 AXIS_PTS_REF mTADVTRSN /end AXIS_DESCR
 /begin AXIS_DESCR COM_AXIS NO_INPUT_QUANTITY COMP_0009 16 0 199.21875 AXIS_PTS_REF mTADVTRSI /end AXIS_DESCR
/end CHARACTERISTIC
/begin CHARACTERISTIC mMMBTRVOF_B7 "VTCOFF時MBTトリミングマップ [LSB 7 bit]" MAP 0x0000B12E REC_UBYTE_C 0 COMP_0245 -64 63 BIT_MASK 0x007F
 /begin AXIS_DESCR COM_AXIS NO_INPUT_QUANTITY COMP_0020 16 0 12750 AXIS_PTS_REF mTADVTRSN /end AXIS_DESCR
 /begin AXIS_DESCR COM_AXIS NO_INPUT_QUANTITY COMP_0009 16 0 199.21875 AXIS_PTS_REF mTADVTRSI /end AXIS_DESCR
/end CHARACTERISTIC
/begin CHARACTERISTIC mMMBTRVOF_B1 "VTCOFF時MBTトリミングマップ [MSB 1 bit]" MAP 0x0000B12E REC_UBYTE_C 0 COMP_0245 -64 191 BIT_MASK 0x0080
 /begin AXIS_DESCR COM_AXIS NO_INPUT_QUANTITY COMP_0020 16 0 12750 AXIS_PTS_REF mTADVTRSN /end AXIS_DESCR
 /begin AXIS_DESCR COM_AXIS NO_INPUT_QUANTITY COMP_0009 16 0 199.21875 AXIS_PTS_REF mTADVTRSI /end AXIS_DESCR
/end CHARACTERISTIC
/begin CHARACTERISTIC mMMBTRCIV "低水温アイドルVTC且つTCV(SCV)閉時MBTトリミングマップ" MAP 0x0000ADAE REC_UBYTE_C 0 COMP_0245 -64 191
 /begin AXIS_DESCR COM_AXIS NO_INPUT_QUANTITY COMP_0020 8 0 12750 AXIS_PTS_REF mTMBTTRSN /end AXIS_DESCR
 /begin AXIS_DESCR COM_AXIS NO_INPUT_QUANTITY COMP_0009 8 0 199.21875 AXIS_PTS_REF mTMBTTRSI /end AXIS_DESCR
/end CHARACTERISTIC
/begin CHARACTERISTIC mMMBTRCIV_B7 "低水温アイドルVTC且つTCV(SCV)閉時MBTトリミングマップ [LSB 7 bit]" MAP 0x0000ADAE REC_UBYTE_C 0 COMP_0245 -64 63 BIT_MASK 0x007F
 /begin AXIS_DESCR COM_AXIS NO_INPUT_QUANTITY COMP_0020 8 0 12750 AXIS_PTS_REF mTMBTTRSN /end AXIS_DESCR
 /begin AXIS_DESCR COM_AXIS NO_INPUT_QUANTITY COMP_0009 8 0 199.21875 AXIS_PTS_REF mTMBTTRSI /end AXIS_DESCR
/end CHARACTERISTIC
/begin CHARACTERISTIC mMMBTRCIV_B1 "低水温アイドルVTC且つTCV(SCV)閉時MBTトリミングマップ [MSB 1 bit]" MAP 0x0000ADAE REC_UBYTE_C 0 COMP_0245 -64 191 BIT_MASK 0x0080
 /begin AXIS_DESCR COM_AXIS NO_INPUT_QUANTITY COMP_0020 8 0 12750 AXIS_PTS_REF mTMBTTRSN /end AXIS_DESCR
 /begin AXIS_DESCR COM_AXIS NO_INPUT_QUANTITY COMP_0009 8 0 199.21875 AXIS_PTS_REF mTMBTTRSI /end AXIS_DESCR
/end CHARACTERISTIC
/begin CHARACTERISTIC mMMBTROIV "低水温アイドルVTC且つ（TCV(SCV)開時またはTCV無し）MBTトリミングマップ" MAP 0x0000B0EE REC_UBYTE_C 0 COMP_0245 -64 191
 /begin AXIS_DESCR COM_AXIS NO_INPUT_QUANTITY COMP_0020 8 0 12750 AXIS_PTS_REF mTMBTTRSN /end AXIS_DESCR
 /begin AXIS_DESCR COM_AXIS NO_INPUT_QUANTITY COMP_0009 8 0 199.21875 AXIS_PTS_REF mTMBTTRSI /end AXIS_DESCR
/end CHARACTERISTIC
/begin CHARACTERISTIC mMMBTROIV_B7 "低水温アイドルVTC且つ（TCV(SCV)開時またはTCV無し）MBTトリミングマップ [LSB 7 bit]" MAP 0x0000B0EE REC_UBYTE_C 0 COMP_0245 -64 63 BIT_MASK 0x007F
 /begin AXIS_DESCR COM_AXIS NO_INPUT_QUANTITY COMP_0020 8 0 12750 AXIS_PTS_REF mTMBTTRSN /end AXIS_DESCR
 /begin AXIS_DESCR COM_AXIS NO_INPUT_QUANTITY COMP_0009 8 0 199.21875 AXIS_PTS_REF mTMBTTRSI /end AXIS_DESCR
/end CHARACTERISTIC
/begin CHARACTERISTIC mMMBTROIV_B1 "低水温アイドルVTC且つ（TCV(SCV)開時またはTCV無し）MBTトリミングマップ [MSB 1 bit]" MAP 0x0000B0EE REC_UBYTE_C 0 COMP_0245 -64 191 BIT_MASK 0x0080
 /begin AXIS_DESCR COM_AXIS NO_INPUT_QUANTITY COMP_0020 8 0 12750 AXIS_PTS_REF mTMBTTRSN /end AXIS_DESCR
 /begin AXIS_DESCR COM_AXIS NO_INPUT_QUANTITY COMP_0009 8 0 199.21875 AXIS_PTS_REF mTMBTTRSI /end AXIS_DESCR
/end CHARACTERISTIC
/begin CHARACTERISTIC mMBEQF "基本吸熱量係数マップ(basic_endotherm_quantity_factor_map)" MAP 0x0000CB42 REC_UWORD_C 0 COMP_0306_S 0 65.535
 /begin AXIS_DESCR COM_AXIS NO_INPUT_QUANTITY COMP_0006 16 0 819187.5 AXIS_PTS_REF mLBEQFREV /end AXIS_DESCR
 /begin AXIS_DESCR COM_AXIS NO_INPUT_QUANTITY COMP_0144 16 0 31.999495335 AXIS_PTS_REF mLBEQFTP /end AXIS_DESCR
/end CHARACTERISTIC
/begin CHARACTERISTIC mMBSANG "基本角度マップ" MAP 0x0000CD42 REC_UWORD_C 0 COMP_0057_S 0 6553.5
 /begin AXIS_DESCR COM_AXIS NO_INPUT_QUANTITY COMP_0065 16 0 204796.875 AXIS_PTS_REF mLBANGN /end AXIS_DESCR
 /begin AXIS_DESCR COM_AXIS NO_INPUT_QUANTITY COMP_0157_S 16 0 104856 AXIS_PTS_REF mLBANGINJ /end AXIS_DESCR
/end CHARACTERISTIC
/begin CHARACTERISTIC mMBVTCHOS "トレース点火時期VTC補正量マップ" MAP 0x00009B0E REC_UBYTE_C 0 COMP_0307_S -1 0.9921875
 /begin AXIS_DESCR COM_AXIS NO_INPUT_QUANTITY COMP_0020 16 0 12750 AXIS_PTS_REF mVTCHOSNE /end AXIS_DESCR
 /begin AXIS_DESCR COM_AXIS NO_INPUT_QUANTITY COMP_0009 16 0 199.21875 AXIS_PTS_REF mVTCHOSIC /end AXIS_DESCR
/end CHARACTERISTIC
/begin CHARACTERISTIC mMDRTQSP "ドライバ要求エンジントルクMAP" MAP 0x0000CFC2 REC_UWORD_C 0 COMP_0226 -3276.8 3276.7
 /begin AXIS_DESCR COM_AXIS NO_INPUT_QUANTITY COMP_0032_S 16 0 8191.875 AXIS_PTS_REF mDRTQSPAP /end AXIS_DESCR
 /begin AXIS_DESCR COM_AXIS NO_INPUT_QUANTITY COMP_0065 16 0 204796.875 AXIS_PTS_REF mDRTQSPNE /end AXIS_DESCR
/end CHARACTERISTIC
/begin CHARACTERISTIC mMDRTQS_S "ドライバ要求エンジントルクMAP（副演算部）" MAP 0x00015A28 REC_UWORD_C 0 COMP_0226 -3276.8 3276.7
 /begin AXIS_DESCR COM_AXIS NO_INPUT_QUANTITY COMP_0032_S 16 0 8191.875 AXIS_PTS_REF mDTQSPA_S /end AXIS_DESCR
 /begin AXIS_DESCR COM_AXIS NO_INPUT_QUANTITY COMP_0065 16 0 204796.875 AXIS_PTS_REF mDTQSPN_S /end AXIS_DESCR
/end CHARACTERISTIC
/begin CHARACTERISTIC mMFBILM "I分リミッタ値マップ" MAP 0x0000D1C2 REC_UWORD_C 0 COMP_0308_S 0 0.52428
 /begin AXIS_DESCR COM_AXIS NO_INPUT_QUANTITY COMP_0304_S 16 0 1.04856 AXIS_PTS_REF mLMXGILM /end AXIS_DESCR
 /begin AXIS_DESCR COM_AXIS NO_INPUT_QUANTITY COMP_0217 16 0 3.999941832 AXIS_PTS_REF mLMRTBILM /end AXIS_DESCR
/end CHARACTERISTIC
/begin CHARACTERISTIC mMFFTBN "排気ガスタービン通過流量FFマップ" MAP 0x0000D3C2 REC_UWORD_C 0 COMP_0308_S 0 0.52428
 /begin AXIS_DESCR COM_AXIS NO_INPUT_QUANTITY COMP_0304_S 16 0 1.04856 AXIS_PTS_REF mLMFEX /end AXIS_DESCR
 /begin AXIS_DESCR COM_AXIS NO_INPUT_QUANTITY COMP_0217 16 0 3.999941832 AXIS_PTS_REF mLMFRBP /end AXIS_DESCR
/end CHARACTERISTIC
/begin CHARACTERISTIC mMINEGSR0 "内部EGRﾏｯﾌﾟ0" MAP 0x00009DCE REC_UBYTE_C 0 COMP_0309_S -27.5 100
 /begin AXIS_DESCR COM_AXIS NO_INPUT_QUANTITY COMP_0045 16 0 1.9921875 AXIS_PTS_REF mINEGRQH /end AXIS_DESCR
 /begin AXIS_DESCR COM_AXIS NO_INPUT_QUANTITY COMP_0064 16 0 102398.4375 AXIS_PTS_REF mINEGRPM /end AXIS_DESCR
/end CHARACTERISTIC
/begin CHARACTERISTIC mMINEGSR1 "内部EGRﾏｯﾌﾟ1" MAP 0x00009ECE REC_UBYTE_C 0 COMP_0309_S -27.5 100
 /begin AXIS_DESCR COM_AXIS NO_INPUT_QUANTITY COMP_0045 16 0 1.9921875 AXIS_PTS_REF mINEGRQH /end AXIS_DESCR
 /begin AXIS_DESCR COM_AXIS NO_INPUT_QUANTITY COMP_0064 16 0 102398.4375 AXIS_PTS_REF mINEGRPM /end AXIS_DESCR
/end CHARACTERISTIC
/begin CHARACTERISTIC mMINEGSR2 "内部EGRﾏｯﾌﾟ2" MAP 0x00009FCE REC_UBYTE_C 0 COMP_0309_S -27.5 100
 /begin AXIS_DESCR COM_AXIS NO_INPUT_QUANTITY COMP_0045 16 0 1.9921875 AXIS_PTS_REF mINEGRQH /end AXIS_DESCR
 /begin AXIS_DESCR COM_AXIS NO_INPUT_QUANTITY COMP_0064 16 0 102398.4375 AXIS_PTS_REF mINEGRPM /end AXIS_DESCR
/end CHARACTERISTIC
/begin CHARACTERISTIC mMINEGSR3 "内部EGRﾏｯﾌﾟ3" MAP 0x0000A0CE REC_UBYTE_C 0 COMP_0309_S -27.5 100
 /begin AXIS_DESCR COM_AXIS NO_INPUT_QUANTITY COMP_0045 16 0 1.9921875 AXIS_PTS_REF mINEGRQH /end AXIS_DESCR
 /begin AXIS_DESCR COM_AXIS NO_INPUT_QUANTITY COMP_0064 16 0 102398.4375 AXIS_PTS_REF mINEGRPM /end AXIS_DESCR
/end CHARACTERISTIC
/begin CHARACTERISTIC mMINEGSR4 "内部EGRﾏｯﾌﾟ4" MAP 0x0000A1CE REC_UBYTE_C 0 COMP_0309_S -27.5 100
 /begin AXIS_DESCR COM_AXIS NO_INPUT_QUANTITY COMP_0045 16 0 1.9921875 AXIS_PTS_REF mINEGRQH /end AXIS_DESCR
 /begin AXIS_DESCR COM_AXIS NO_INPUT_QUANTITY COMP_0064 16 0 102398.4375 AXIS_PTS_REF mINEGRPM /end AXIS_DESCR
/end CHARACTERISTIC
/begin CHARACTERISTIC mMINEGSR5 "内部EGRﾏｯﾌﾟ5" MAP 0x0000A2CE REC_UBYTE_C 0 COMP_0309_S -27.5 100
 /begin AXIS_DESCR COM_AXIS NO_INPUT_QUANTITY COMP_0045 16 0 1.9921875 AXIS_PTS_REF mINEGRQH /end AXIS_DESCR
 /begin AXIS_DESCR COM_AXIS NO_INPUT_QUANTITY COMP_0064 16 0 102398.4375 AXIS_PTS_REF mINEGRPM /end AXIS_DESCR
/end CHARACTERISTIC
/begin CHARACTERISTIC mMINEGSR6 "内部EGRﾏｯﾌﾟ6" MAP 0x0000A3CE REC_UBYTE_C 0 COMP_0309_S -27.5 100
 /begin AXIS_DESCR COM_AXIS NO_INPUT_QUANTITY COMP_0045 16 0 1.9921875 AXIS_PTS_REF mINEGRQH /end AXIS_DESCR
 /begin AXIS_DESCR COM_AXIS NO_INPUT_QUANTITY COMP_0064 16 0 102398.4375 AXIS_PTS_REF mINEGRPM /end AXIS_DESCR
/end CHARACTERISTIC
/begin CHARACTERISTIC mMINJTH "均質噴射ﾀｲﾐﾝｸﾞﾏｯﾌﾟ(Homogeneous_injection_timing_map)" MAP 0x0000A4CE REC_UBYTE_C 0 COMP_0190 0 510
 /begin AXIS_DESCR COM_AXIS NO_INPUT_QUANTITY COMP_0000 16 0 6375 AXIS_PTS_REF mTINJHNE /end AXIS_DESCR
 /begin AXIS_DESCR COM_AXIS NO_INPUT_QUANTITY COMP_0310_S 16 0 40800 AXIS_PTS_REF mTINJHTI3 /end AXIS_DESCR
/end CHARACTERISTIC
/begin CHARACTERISTIC mMINJTH2 "SCV閉時均質噴射ﾀｲﾐﾝｸﾞﾏｯﾌﾟ（It_is_a_homogeneous_injection_timing_map_at_the_time_of_SCV_close.）" MAP 0x0000A5CE REC_UBYTE_C 0 COMP_0190 0 510
 /begin AXIS_DESCR COM_AXIS NO_INPUT_QUANTITY COMP_0000 16 0 6375 AXIS_PTS_REF mTINJHNE2 /end AXIS_DESCR
 /begin AXIS_DESCR COM_AXIS NO_INPUT_QUANTITY COMP_0310_S 16 0 40800 AXIS_PTS_REF mTINJHTI4 /end AXIS_DESCR
/end CHARACTERISTIC
/begin CHARACTERISTIC mMINJTHL "均質噴射ﾀｲﾐﾝｸﾞﾏｯﾌﾟ(極低水温域)(Homogeneous_injection_timing_map_(very_low_water_temperature_range))" MAP 0x0000A6CE REC_UBYTE_C 0 COMP_0190 0 510
 /begin AXIS_DESCR COM_AXIS NO_INPUT_QUANTITY COMP_0000 16 0 6375 AXIS_PTS_REF mTINJHNE /end AXIS_DESCR
 /begin AXIS_DESCR COM_AXIS NO_INPUT_QUANTITY COMP_0310_S 16 0 40800 AXIS_PTS_REF mTINJHTI3 /end AXIS_DESCR
/end CHARACTERISTIC
/begin CHARACTERISTIC mMINJTHM "均質噴射ﾀｲﾐﾝｸﾞﾏｯﾌﾟ(低水温域)(Homogeneous_injection_timing_map(low_water_temperature_range))" MAP 0x0000A7CE REC_UBYTE_C 0 COMP_0190 0 510
 /begin AXIS_DESCR COM_AXIS NO_INPUT_QUANTITY COMP_0000 16 0 6375 AXIS_PTS_REF mTINJHNE /end AXIS_DESCR
 /begin AXIS_DESCR COM_AXIS NO_INPUT_QUANTITY COMP_0310_S 16 0 40800 AXIS_PTS_REF mTINJHTI3 /end AXIS_DESCR
/end CHARACTERISTIC
/begin CHARACTERISTIC mMKITBP "Iゲインマップ" MAP 0x0000D642 REC_UWORD_C 0 COMP_0311_S -0.262144 0.262136
 /begin AXIS_DESCR COM_AXIS NO_INPUT_QUANTITY COMP_0304_S 16 0 1.04856 AXIS_PTS_REF mLMKTEXH /end AXIS_DESCR
 /begin AXIS_DESCR COM_AXIS NO_INPUT_QUANTITY COMP_0312_S 16 -8192 8191.75 AXIS_PTS_REF mLMKTBP /end AXIS_DESCR
/end CHARACTERISTIC
/begin CHARACTERISTIC mMKNKCPRT "トレース点火時期変化量補正マップ(Trace_advance_compensate_map)" MAP 0x0000AA9E REC_UBYTE_C 0 COMP_0045 0 1.9921875
 /begin AXIS_DESCR COM_AXIS NO_INPUT_QUANTITY COMP_0020 16 0 12750 AXIS_PTS_REF mTKNKCPN /end AXIS_DESCR
 /begin AXIS_DESCR COM_AXIS NO_INPUT_QUANTITY COMP_0246 16 0 1593.75 AXIS_PTS_REF mTKNKCPI /end AXIS_DESCR
/end CHARACTERISTIC
/begin CHARACTERISTIC mMKPTBPU "Pゲインマップ" MAP 0x0000D842 REC_UWORD_C 0 COMP_0311_S -0.262144 0.262136
 /begin AXIS_DESCR COM_AXIS NO_INPUT_QUANTITY COMP_0304_S 16 0 1.04856 AXIS_PTS_REF mLMKTEXH /end AXIS_DESCR
 /begin AXIS_DESCR COM_AXIS NO_INPUT_QUANTITY COMP_0312_S 16 -8192 8191.75 AXIS_PTS_REF mLMKTBP /end AXIS_DESCR
/end CHARACTERISTIC
/begin CHARACTERISTIC mMKTRMT "ターボ用Flat補正係数マップ" MAP 0x0000AB9E REC_UBYTE_C 0 COMP_0044 0 1.9921875
 /begin AXIS_DESCR COM_AXIS NO_INPUT_QUANTITY COMP_0020 16 0 12750 AXIS_PTS_REF mNKTRM /end AXIS_DESCR
 /begin AXIS_DESCR COM_AXIS NO_INPUT_QUANTITY COMP_0044 16 0 1.9921875 AXIS_PTS_REF mQKTRMT /end AXIS_DESCR
/end CHARACTERISTIC
/begin CHARACTERISTIC mMMBTCPRT "MBT変化量補正マップ(Running_condition_compensate_map_for_MBT_compensate_value)" MAP 0x0000ACAE REC_UBYTE_C 0 COMP_0045 0 1.9921875
 /begin AXIS_DESCR COM_AXIS NO_INPUT_QUANTITY COMP_0020 16 0 12750 AXIS_PTS_REF mTMBTCPN /end AXIS_DESCR
 /begin AXIS_DESCR COM_AXIS NO_INPUT_QUANTITY COMP_0246 16 0 1593.75 AXIS_PTS_REF mTMBTCPI /end AXIS_DESCR
/end CHARACTERISTIC
/begin CHARACTERISTIC mMMBTTRM "MBTﾄﾘﾐﾝｸﾞﾏｯﾌﾟ" MAP 0x0000B22E REC_UBYTE_C 0 COMP_0245 -64 191
 /begin AXIS_DESCR COM_AXIS NO_INPUT_QUANTITY COMP_0020 16 0 12750 AXIS_PTS_REF mTADVTRSN /end AXIS_DESCR
 /begin AXIS_DESCR COM_AXIS NO_INPUT_QUANTITY COMP_0009 16 0 199.21875 AXIS_PTS_REF mTADVTRSI /end AXIS_DESCR
/end CHARACTERISTIC
/begin CHARACTERISTIC mMMBTTRMC "低水温時MBTﾄﾘﾐﾝｸﾞﾏｯﾌﾟ" MAP 0x0000B32E REC_UBYTE_C 0 COMP_0245 -64 191
 /begin AXIS_DESCR COM_AXIS NO_INPUT_QUANTITY COMP_0020 16 0 12750 AXIS_PTS_REF mTADVTRSN /end AXIS_DESCR
 /begin AXIS_DESCR COM_AXIS NO_INPUT_QUANTITY COMP_0009 16 0 199.21875 AXIS_PTS_REF mTADVTRSI /end AXIS_DESCR
/end CHARACTERISTIC
/begin CHARACTERISTIC mMMBTTRME "MBTﾄﾘﾐﾝｸﾞﾏｯﾌﾟ(TCV閉)" MAP 0x0000B42E REC_UBYTE_C 0 COMP_0245 -64 191
 /begin AXIS_DESCR COM_AXIS NO_INPUT_QUANTITY COMP_0020 16 0 12750 AXIS_PTS_REF mTADVTRSN /end AXIS_DESCR
 /begin AXIS_DESCR COM_AXIS NO_INPUT_QUANTITY COMP_0009 16 0 199.21875 AXIS_PTS_REF mTADVTRSI /end AXIS_DESCR
/end CHARACTERISTIC
/begin CHARACTERISTIC mMNSENV "燃料先行用流速比ﾏｯﾌﾟ" MAP 0x0000DA42 REC_UWORD_C 0 COMP_0456 0 1.999970916
 /begin AXIS_DESCR COM_AXIS NO_INPUT_QUANTITY COMP_0313_S 16 0 7.99985745 AXIS_PTS_REF mNSENPP /end AXIS_DESCR
 /begin AXIS_DESCR COM_AXIS NO_INPUT_QUANTITY COMP_0006 16 0 819187.5 AXIS_PTS_REF mNSENRR /end AXIS_DESCR
/end CHARACTERISTIC
/begin CHARACTERISTIC mMOPDRET "dP/dθ制限用ﾘﾀｰﾄﾞ量ﾏｯﾌﾟ" MAP 0x0000B62E REC_UBYTE_C 0 COMP_0017 0 255
 /begin AXIS_DESCR COM_AXIS NO_INPUT_QUANTITY COMP_0020 16 0 12750 AXIS_PTS_REF mTADVTRSN /end AXIS_DESCR
 /begin AXIS_DESCR COM_AXIS NO_INPUT_QUANTITY COMP_0009 16 0 199.21875 AXIS_PTS_REF mTADVTRSI /end AXIS_DESCR
/end CHARACTERISTIC
/begin CHARACTERISTIC mMPCHS "ターボＥＴＤ及び過給圧制御目標過給圧マップ" MAP 0x0000DCC2 REC_UWORD_C 0 COMP_0034_S 0 255.99609375
 /begin AXIS_DESCR COM_AXIS NO_INPUT_QUANTITY COMP_0065 16 0 204796.875 AXIS_PTS_REF mTNPCHS /end AXIS_DESCR
 /begin AXIS_DESCR COM_AXIS NO_INPUT_QUANTITY COMP_0005 16 0 7208.85 AXIS_PTS_REF mTVAPCHS /end AXIS_DESCR
/end CHARACTERISTIC
/begin CHARACTERISTIC mMPTFA0T "ターボ用目標当量比マップ" MAP 0x0000B7EE REC_UBYTE_C 0 COMP_0045 0 1.9921875
 /begin AXIS_DESCR COM_AXIS NO_INPUT_QUANTITY COMP_0020 16 0 12750 AXIS_PTS_REF mNETFAT /end AXIS_DESCR
 /begin AXIS_DESCR COM_AXIS NO_INPUT_QUANTITY COMP_0044 16 0 1.9921875 AXIS_PTS_REF mITCTFAT /end AXIS_DESCR
/end CHARACTERISTIC
/begin CHARACTERISTIC mMPTFATR "レギュラー時ターボ用目標当量比マップ(Target_equivalence_ratio_map_for_turbo-charged_engine_at_regular_gasoline)" MAP 0x0000B8EE REC_UBYTE_C 0 COMP_0045 0 1.9921875
 /begin AXIS_DESCR COM_AXIS NO_INPUT_QUANTITY COMP_0020 16 0 12750 AXIS_PTS_REF mNETFAT /end AXIS_DESCR
 /begin AXIS_DESCR COM_AXIS NO_INPUT_QUANTITY COMP_0044 16 0 1.9921875 AXIS_PTS_REF mITCTFAT /end AXIS_DESCR
/end CHARACTERISTIC
/begin CHARACTERISTIC mMPUMSPB "P/Reg駆動パルス幅マップ" MAP 0x0000DF42 REC_UWORD_C 0 COMP_0152_S 0 419424
 /begin AXIS_DESCR COM_AXIS NO_INPUT_QUANTITY COMP_0065 16 0 204796.875 AXIS_PTS_REF mLTPNE /end AXIS_DESCR
 /begin AXIS_DESCR COM_AXIS NO_INPUT_QUANTITY COMP_0314_S 16 0 20479.6875 AXIS_PTS_REF mLTPV /end AXIS_DESCR
/end CHARACTERISTIC
/begin CHARACTERISTIC mMRHVTEHH "排気VTCレギュラー判定時目標作動角度算出マップ" MAP 0x0000E1C2 REC_UWORD_C 0 COMP_0108_S -16384 16383.5
 /begin AXIS_DESCR COM_AXIS NO_INPUT_QUANTITY COMP_0064 16 0 102398.4375 AXIS_PTS_REF mTVKNEENH /end AXIS_DESCR
 /begin AXIS_DESCR COM_AXIS NO_INPUT_QUANTITY COMP_0009 16 0 51199.21875 AXIS_PTS_REF mTVTHITEN /end AXIS_DESCR
/end CHARACTERISTIC
/begin CHARACTERISTIC mMRHVTELH "排気VTCレギュラー判定時目標作動角度算出マップ（低水温時）" MAP 0x0000E3C2 REC_UWORD_C 0 COMP_0108_S -16384 16383.5
 /begin AXIS_DESCR COM_AXIS NO_INPUT_QUANTITY COMP_0064 16 0 102398.4375 AXIS_PTS_REF mTVKNEENH /end AXIS_DESCR
 /begin AXIS_DESCR COM_AXIS NO_INPUT_QUANTITY COMP_0009 16 0 51199.21875 AXIS_PTS_REF mTVTHITEN /end AXIS_DESCR
/end CHARACTERISTIC
/begin CHARACTERISTIC mMRHVTIHH "吸気VTCレギュラー判定時目標作動角度算出マップ" MAP 0x0000E5C2 REC_UWORD_C 0 COMP_0108_S -16384 16383.5
 /begin AXIS_DESCR COM_AXIS NO_INPUT_QUANTITY COMP_0064 16 0 102398.4375 AXIS_PTS_REF mTVKNEINH /end AXIS_DESCR
 /begin AXIS_DESCR COM_AXIS NO_INPUT_QUANTITY COMP_0009 16 0 51199.21875 AXIS_PTS_REF mTVTHITIN /end AXIS_DESCR
/end CHARACTERISTIC
/begin CHARACTERISTIC mMRHVTILH "吸気VTCレギュラー判定時目標作動角度算出マップ（低水温時）" MAP 0x0000E7C2 REC_UWORD_C 0 COMP_0108_S -16384 16383.5
 /begin AXIS_DESCR COM_AXIS NO_INPUT_QUANTITY COMP_0064 16 0 102398.4375 AXIS_PTS_REF mTVKNEINH /end AXIS_DESCR
 /begin AXIS_DESCR COM_AXIS NO_INPUT_QUANTITY COMP_0009 16 0 51199.21875 AXIS_PTS_REF mTVTHITIN /end AXIS_DESCR
/end CHARACTERISTIC
/begin CHARACTERISTIC mMRONLMHR "レギュラー判定時高オクタン価リミッタマップ" MAP 0x0000BA6E REC_UBYTE_C 0 COMP_0201_S 75 106.875
 /begin AXIS_DESCR COM_AXIS NO_INPUT_QUANTITY COMP_0020 16 0 12750 AXIS_PTS_REF mRONLMSNR /end AXIS_DESCR
 /begin AXIS_DESCR COM_AXIS NO_INPUT_QUANTITY COMP_0009 16 0 199.21875 AXIS_PTS_REF mRONLMSIR /end AXIS_DESCR
/end CHARACTERISTIC
/begin CHARACTERISTIC mMTAUEXG "排気ガス流量応答時定数マップ_" MAP 0x0000E9C2 REC_UWORD_C 0 COMP_0290 0 0.999985458
 /begin AXIS_DESCR COM_AXIS NO_INPUT_QUANTITY COMP_0065 16 0 204796.875 AXIS_PTS_REF mTNTAUE /end AXIS_DESCR
 /begin AXIS_DESCR COM_AXIS NO_INPUT_QUANTITY COMP_0005 16 0 7208.85 AXIS_PTS_REF mTVATAUE /end AXIS_DESCR
/end CHARACTERISTIC
/begin CHARACTERISTIC mMTFDD "Ｄﾚﾝｼﾞ目標駆動力ﾏｯﾌﾟ" MAP 0x0000EBC2 REC_UWORD_C 0 COMP_0315_S -32768 32767
 /begin AXIS_DESCR COM_AXIS NO_INPUT_QUANTITY COMP_0005 16 0 7208.85 AXIS_PTS_REF mMTFKAPO /end AXIS_DESCR
 /begin AXIS_DESCR COM_AXIS NO_INPUT_QUANTITY COMP_0436 16 0 6553.5 AXIS_PTS_REF mMTFKVSP /end AXIS_DESCR
/end CHARACTERISTIC
/begin CHARACTERISTIC mMTPFUELN "目標燃圧マップ" MAP 0x0000BDFE REC_UBYTE_C 0 COMP_0087_S 0 19.9104
 /begin AXIS_DESCR COM_AXIS NO_INPUT_QUANTITY COMP_0020 16 0 12750 AXIS_PTS_REF mLTPFN1 /end AXIS_DESCR
 /begin AXIS_DESCR COM_AXIS NO_INPUT_QUANTITY COMP_0001 16 0 31.875 AXIS_PTS_REF mLTPFTPN /end AXIS_DESCR
/end CHARACTERISTIC
/begin CHARACTERISTIC mMTRACEMH "ﾄﾚｰｽ点火時期ﾏｯﾌﾟ（ﾊｲｵｸ）" MAP 0x0000BEFE REC_UBYTE_C 0 COMP_0245 -64 191
 /begin AXIS_DESCR COM_AXIS NO_INPUT_QUANTITY COMP_0020 16 0 12750 AXIS_PTS_REF mTADVTRSN /end AXIS_DESCR
 /begin AXIS_DESCR COM_AXIS NO_INPUT_QUANTITY COMP_0009 16 0 199.21875 AXIS_PTS_REF mTADVTRSI /end AXIS_DESCR
/end CHARACTERISTIC
/begin CHARACTERISTIC mMTRACEMR "ﾄﾚｰｽ点火時期ﾏｯﾌﾟ（ﾚｷﾞｭﾗｰ）" MAP 0x0000BFFE REC_UBYTE_C 0 COMP_0245 -64 191
 /begin AXIS_DESCR COM_AXIS NO_INPUT_QUANTITY COMP_0020 16 0 12750 AXIS_PTS_REF mTADVTRSN /end AXIS_DESCR
 /begin AXIS_DESCR COM_AXIS NO_INPUT_QUANTITY COMP_0009 16 0 199.21875 AXIS_PTS_REF mTADVTRSI /end AXIS_DESCR
/end CHARACTERISTIC
/begin CHARACTERISTIC mMTTE "QH0/ﾄﾙｸ変換ﾏｯﾌﾟ" MAP 0x0000EDC2 REC_UWORD_C 0 COMP_0226 -3276.8 3276.7
 /begin AXIS_DESCR COM_AXIS NO_INPUT_QUANTITY COMP_0020 16 0 12750 AXIS_PTS_REF mNTTE0 /end AXIS_DESCR
 /begin AXIS_DESCR COM_AXIS NO_INPUT_QUANTITY COMP_0146 16 0 99.998480265 AXIS_PTS_REF mQHTTE /end AXIS_DESCR
/end CHARACTERISTIC
/begin CHARACTERISTIC mMTTE_S "QH0→ﾄﾙｸ変換ﾏｯﾌﾟ" MAP 0x00015CA8 REC_UWORD_C 0 COMP_0226 -3276.8 3276.7
 /begin AXIS_DESCR COM_AXIS NO_INPUT_QUANTITY COMP_0020 16 0 12750 AXIS_PTS_REF mNTTE0_S /end AXIS_DESCR
 /begin AXIS_DESCR COM_AXIS NO_INPUT_QUANTITY COMP_0146 16 0 99.998480265 AXIS_PTS_REF mQHTTE_S /end AXIS_DESCR
/end CHARACTERISTIC
/begin CHARACTERISTIC mMVTGFENH "排気VTC基本目標作動角度算出マップ（極低水温時）" MAP 0x0000EFC2 REC_UWORD_C 0 COMP_0108_S -16384 16383.5
 /begin AXIS_DESCR COM_AXIS NO_INPUT_QUANTITY COMP_0064 16 0 102398.4375 AXIS_PTS_REF mTVKNEENH /end AXIS_DESCR
 /begin AXIS_DESCR COM_AXIS NO_INPUT_QUANTITY COMP_0009 16 0 51199.21875 AXIS_PTS_REF mTVTHITEN /end AXIS_DESCR
/end CHARACTERISTIC
/begin CHARACTERISTIC mMVTGFINH "吸気VTC基本目標作動角度算出マップ（極低水温時）" MAP 0x0000F1C2 REC_UWORD_C 0 COMP_0108_S -16384 16383.5
 /begin AXIS_DESCR COM_AXIS NO_INPUT_QUANTITY COMP_0064 16 0 102398.4375 AXIS_PTS_REF mTVKNEINH /end AXIS_DESCR
 /begin AXIS_DESCR COM_AXIS NO_INPUT_QUANTITY COMP_0009 16 0 51199.21875 AXIS_PTS_REF mTVTHITIN /end AXIS_DESCR
/end CHARACTERISTIC
/begin CHARACTERISTIC mMVTGHENH "排気VTC基本目標作動角度算出ﾏｯﾌﾟ" MAP 0x0000F3C2 REC_UWORD_C 0 COMP_0108_S -16384 16383.5
 /begin AXIS_DESCR COM_AXIS NO_INPUT_QUANTITY COMP_0064 16 0 102398.4375 AXIS_PTS_REF mTVKNEENH /end AXIS_DESCR
 /begin AXIS_DESCR COM_AXIS NO_INPUT_QUANTITY COMP_0009 16 0 51199.21875 AXIS_PTS_REF mTVTHITEN /end AXIS_DESCR
/end CHARACTERISTIC
/begin CHARACTERISTIC mMVTGHINH "吸気VTC基本目標作動角度算出ﾏｯﾌﾟ" MAP 0x0000F5C2 REC_UWORD_C 0 COMP_0108_S -16384 16383.5
 /begin AXIS_DESCR COM_AXIS NO_INPUT_QUANTITY COMP_0064 16 0 102398.4375 AXIS_PTS_REF mTVKNEINH /end AXIS_DESCR
 /begin AXIS_DESCR COM_AXIS NO_INPUT_QUANTITY COMP_0009 16 0 51199.21875 AXIS_PTS_REF mTVTHITIN /end AXIS_DESCR
/end CHARACTERISTIC
/begin CHARACTERISTIC mMVTGLENH "排気VTC基本目標作動角度算出マップ(低水温時)" MAP 0x0000F7C2 REC_UWORD_C 0 COMP_0108_S -16384 16383.5
 /begin AXIS_DESCR COM_AXIS NO_INPUT_QUANTITY COMP_0064 16 0 102398.4375 AXIS_PTS_REF mTVKNEENH /end AXIS_DESCR
 /begin AXIS_DESCR COM_AXIS NO_INPUT_QUANTITY COMP_0009 16 0 51199.21875 AXIS_PTS_REF mTVTHITEN /end AXIS_DESCR
/end CHARACTERISTIC
/begin CHARACTERISTIC mMVTGLINH "吸気VTC基本目標作動角度算出マップ(低水温時)" MAP 0x0000F9C2 REC_UWORD_C 0 COMP_0108_S -16384 16383.5
 /begin AXIS_DESCR COM_AXIS NO_INPUT_QUANTITY COMP_0064 16 0 102398.4375 AXIS_PTS_REF mTVKNEINH /end AXIS_DESCR
 /begin AXIS_DESCR COM_AXIS NO_INPUT_QUANTITY COMP_0009 16 0 51199.21875 AXIS_PTS_REF mTVTHITIN /end AXIS_DESCR
/end CHARACTERISTIC
/begin CHARACTERISTIC mMVTRGHEN "排気VTC基本目標作動角度算出ﾏｯﾌﾟ（Exhaust_VTC_basis_target_operation_angle_calculation_map）" MAP 0x0000FC42 REC_UWORD_C 0 COMP_0108_S -16384 16383.5
 /begin AXIS_DESCR COM_AXIS NO_INPUT_QUANTITY COMP_0020 16 0 3276750 AXIS_PTS_REF mTVTHNEE2 /end AXIS_DESCR
 /begin AXIS_DESCR COM_AXIS NO_INPUT_QUANTITY COMP_0009 16 0 51199.21875 AXIS_PTS_REF mTVTHITEN /end AXIS_DESCR
/end CHARACTERISTIC
/begin CHARACTERISTIC mMVTRGHIN "吸気VTC基本目標作動角度算出ﾏｯﾌﾟ(Suction_VTC_basic_target_operation_angle_calculation_map）" MAP 0x0000FE42 REC_UWORD_C 0 COMP_0108_S -16384 16383.5
 /begin AXIS_DESCR COM_AXIS NO_INPUT_QUANTITY COMP_0020 16 0 3276750 AXIS_PTS_REF mTVTHNEIN /end AXIS_DESCR
 /begin AXIS_DESCR COM_AXIS NO_INPUT_QUANTITY COMP_0009 16 0 51199.21875 AXIS_PTS_REF mTVTHITIN /end AXIS_DESCR
/end CHARACTERISTIC
/begin CHARACTERISTIC mMWGDUTY "3方ソレノイドバルブ特性マップ" MAP 0x000100C2 REC_UWORD_C 0 COMP_0316_S 0 127.99837455
 /begin AXIS_DESCR COM_AXIS NO_INPUT_QUANTITY COMP_0317_S 16 0 2047.96875 AXIS_PTS_REF mLPWGACT /end AXIS_DESCR
 /begin AXIS_DESCR COM_AXIS NO_INPUT_QUANTITY COMP_0120_S 16 0 16383.75 AXIS_PTS_REF mLPCOUT /end AXIS_DESCR
/end CHARACTERISTIC
/begin CHARACTERISTIC mTAPTR1 "APOST/APOTR1_変換マップ" MAP 0x000103C2 REC_UWORD_C 0 COMP_0005 0 7208.85
 /begin AXIS_DESCR COM_AXIS NO_INPUT_QUANTITY COMP_0005 16 0 7208.85 AXIS_PTS_REF mAPTR /end AXIS_DESCR
 /begin AXIS_DESCR COM_AXIS NO_INPUT_QUANTITY COMP_0436 16 0 6553.5 AXIS_PTS_REF mVSTR /end AXIS_DESCR
/end CHARACTERISTIC
/begin CHARACTERISTIC mTAPTR1_S "APOST/APOTR1_変換マップ" MAP 0x00015EA8 REC_UWORD_C 0 COMP_0005 0 7208.85
 /begin AXIS_DESCR COM_AXIS NO_INPUT_QUANTITY COMP_0005 16 0 7208.85 AXIS_PTS_REF mAPTR_S /end AXIS_DESCR
 /begin AXIS_DESCR COM_AXIS NO_INPUT_QUANTITY COMP_0436 16 0 6553.5 AXIS_PTS_REF mVSTR_S /end AXIS_DESCR
/end CHARACTERISTIC
/begin CHARACTERISTIC mTAPTR2 "APOST/APOTR2_変換マップ" MAP 0x000105C2 REC_UWORD_C 0 COMP_0005 0 7208.85
 /begin AXIS_DESCR COM_AXIS NO_INPUT_QUANTITY COMP_0005 16 0 7208.85 AXIS_PTS_REF mAPTR /end AXIS_DESCR
 /begin AXIS_DESCR COM_AXIS NO_INPUT_QUANTITY COMP_0436 16 0 6553.5 AXIS_PTS_REF mVSTR /end AXIS_DESCR
/end CHARACTERISTIC
/begin CHARACTERISTIC mTAPTR2_S "APOST/APOTR2_変換マップ" MAP 0x000160A8 REC_UWORD_C 0 COMP_0005 0 7208.85
 /begin AXIS_DESCR COM_AXIS NO_INPUT_QUANTITY COMP_0005 16 0 7208.85 AXIS_PTS_REF mAPTR_S /end AXIS_DESCR
 /begin AXIS_DESCR COM_AXIS NO_INPUT_QUANTITY COMP_0436 16 0 6553.5 AXIS_PTS_REF mVSTR_S /end AXIS_DESCR
/end CHARACTERISTIC
/begin CHARACTERISTIC mTENGMAPH "TP拡張対応用ｴﾝｼﾞﾝﾄﾙｸ値ﾏｯﾌﾟ" MAP 0x00010842 REC_UWORD_C 0 COMP_0226 -3276.8 3276.7
 /begin AXIS_DESCR COM_AXIS NO_INPUT_QUANTITY COMP_0065 16 0 204796.875 AXIS_PTS_REF mTENGHNE /end AXIS_DESCR
 /begin AXIS_DESCR COM_AXIS NO_INPUT_QUANTITY COMP_0209_S 16 0 199.996894995 AXIS_PTS_REF mLTEIT /end AXIS_DESCR
/end CHARACTERISTIC
/begin CHARACTERISTIC mTMSATA "MSATHAﾏｯﾌﾟ" MAP 0x0000C26E REC_UBYTE_C 0 COMP_0318_S 0 255
 /begin AXIS_DESCR COM_AXIS NO_INPUT_QUANTITY COMP_0020 16 0 12750 AXIS_PTS_REF mLNMIS /end AXIS_DESCR
 /begin AXIS_DESCR COM_AXIS NO_INPUT_QUANTITY COMP_0001 16 0 31.875 AXIS_PTS_REF mLPMIS /end AXIS_DESCR
/end CHARACTERISTIC
/begin CHARACTERISTIC mTMSATB "MSATHAﾏｯﾌﾟ" MAP 0x0000C36E REC_UBYTE_C 0 COMP_0318_S 0 255
 /begin AXIS_DESCR COM_AXIS NO_INPUT_QUANTITY COMP_0020 16 0 12750 AXIS_PTS_REF mLNMIS /end AXIS_DESCR
 /begin AXIS_DESCR COM_AXIS NO_INPUT_QUANTITY COMP_0001 16 0 31.875 AXIS_PTS_REF mLPMIS /end AXIS_DESCR
/end CHARACTERISTIC
/begin CHARACTERISTIC mTMSATH "MSATHﾏｯﾌﾟ" MAP 0x0000C46E REC_UBYTE_C 0 COMP_0318_S 0 255
 /begin AXIS_DESCR COM_AXIS NO_INPUT_QUANTITY COMP_0020 16 0 12750 AXIS_PTS_REF mLNMIS /end AXIS_DESCR
 /begin AXIS_DESCR COM_AXIS NO_INPUT_QUANTITY COMP_0001 16 0 31.875 AXIS_PTS_REF mLPMIS /end AXIS_DESCR
/end CHARACTERISTIC
/begin CHARACTERISTIC mTMSTHLO "低Pi領域判定用MSATHﾏｯﾌﾟ(MSATH_map_for_low_Pi)" MAP 0x0000C56E REC_UBYTE_C 0 COMP_0318_S 0 255
 /begin AXIS_DESCR COM_AXIS NO_INPUT_QUANTITY COMP_0020 16 0 12750 AXIS_PTS_REF mLNMISLO /end AXIS_DESCR
 /begin AXIS_DESCR COM_AXIS NO_INPUT_QUANTITY COMP_0001 16 0 31.875 AXIS_PTS_REF mLPMISLO /end AXIS_DESCR
/end CHARACTERISTIC
/begin CHARACTERISTIC mTMSTHTI "暖気後ｱｲﾄﾞﾙ領域判定時用MSATHﾏｯﾌﾟ(MSATH_map_for_warmed_up_idle)" MAP 0x0000C66E REC_UBYTE_C 0 COMP_0318_S 0 255
 /begin AXIS_DESCR COM_AXIS NO_INPUT_QUANTITY COMP_0020 16 0 12750 AXIS_PTS_REF mLNMISHTI /end AXIS_DESCR
 /begin AXIS_DESCR COM_AXIS NO_INPUT_QUANTITY COMP_0001 16 0 31.875 AXIS_PTS_REF mLPMISHTI /end AXIS_DESCR
/end CHARACTERISTIC
/begin CHARACTERISTIC mKHTMAP "高水温増量ﾏｯﾌﾟ" MAP 0x0000993E REC_UBYTE_C 0 COMP_0045 0 1.9921875
 /begin AXIS_DESCR COM_AXIS NO_INPUT_QUANTITY COMP_0020 4 0 12750 AXIS_PTS_REF mKHOTN /end AXIS_DESCR
 /begin AXIS_DESCR COM_AXIS NO_INPUT_QUANTITY COMP_0045 4 0 1.9921875 AXIS_PTS_REF mKHTTP /end AXIS_DESCR
/end CHARACTERISTIC
/begin CHARACTERISTIC mMCHGNG13 "充電能力判定電流値ﾏｯﾌﾟ（前条件13V時）" MAP 0x00009C4E REC_UBYTE_C 0 COMP_0045_S 0 255
 /begin AXIS_DESCR COM_AXIS NO_INPUT_QUANTITY COMP_0035 4 -50 205 AXIS_PTS_REF mMCHGKTMP /end AXIS_DESCR
 /begin AXIS_DESCR COM_AXIS NO_INPUT_QUANTITY COMP_0319_S 4 10000 15100 AXIS_PTS_REF mMCHGKVB /end AXIS_DESCR
/end CHARACTERISTIC
/begin CHARACTERISTIC mMCHGOK "充電完了電流判定電流値マップ" MAP 0x00009C5E REC_UBYTE_C 0 COMP_0320_S 0 63.75
 /begin AXIS_DESCR COM_AXIS NO_INPUT_QUANTITY COMP_0035 4 -50 205 AXIS_PTS_REF mMCHGKTMP /end AXIS_DESCR
 /begin AXIS_DESCR COM_AXIS NO_INPUT_QUANTITY COMP_0319_S 4 10000 15100 AXIS_PTS_REF mMCHGKVB /end AXIS_DESCR
/end CHARACTERISTIC
/begin CHARACTERISTIC mMCHGOK2 "充電完了判定電流値マップ2" MAP 0x00009C6E REC_UBYTE_C 0 COMP_0067_S 0 127.5
 /begin AXIS_DESCR COM_AXIS NO_INPUT_QUANTITY COMP_0035 4 -50 205 AXIS_PTS_REF mMCHGKTMP /end AXIS_DESCR
 /begin AXIS_DESCR COM_AXIS NO_INPUT_QUANTITY COMP_0319_S 4 10000 15100 AXIS_PTS_REF mMCHGKVB /end AXIS_DESCR
/end CHARACTERISTIC
/begin CHARACTERISTIC mMDUMP "定常判定時平滑化係数マップ" MAP 0x00009CBE REC_UBYTE_C 0 COMP_0132 0 0.498046875
 /begin AXIS_DESCR COM_AXIS NO_INPUT_QUANTITY COMP_0020 4 0 12750 AXIS_PTS_REF mDMPN /end AXIS_DESCR
 /begin AXIS_DESCR COM_AXIS NO_INPUT_QUANTITY COMP_0032 4 0 0.99609375 AXIS_PTS_REF mDMPQH /end AXIS_DESCR
/end CHARACTERISTIC
/begin CHARACTERISTIC mMFDTYTW "エンジン要求FAN速MAP" MAP 0x00009CCE REC_UBYTE_C 0 COMP_0027 0 255
 /begin AXIS_DESCR FIX_AXIS NO_INPUT_QUANTITY COMP_0321_S 4 0 3 FIX_AXIS_PAR_DIST 0 1 4 /end AXIS_DESCR
 /begin AXIS_DESCR FIX_AXIS NO_INPUT_QUANTITY COMP_0321_S 4 0 3 FIX_AXIS_PAR_DIST 0 1 4 /end AXIS_DESCR
/end CHARACTERISTIC
/begin CHARACTERISTIC mMFDYACMN "エアコン要求FAN速下限MAP" MAP 0x00009CDE REC_UBYTE_C 0 COMP_0027 0 255
 /begin AXIS_DESCR FIX_AXIS NO_INPUT_QUANTITY COMP_0321_S 4 0 3 FIX_AXIS_PAR_DIST 0 1 4 /end AXIS_DESCR
 /begin AXIS_DESCR FIX_AXIS NO_INPUT_QUANTITY COMP_0321_S 4 0 3 FIX_AXIS_PAR_DIST 0 1 4 /end AXIS_DESCR
/end CHARACTERISTIC
/begin CHARACTERISTIC mMFDYACMX "エアコン要求FAN速上限MAP" MAP 0x00009CEE REC_UBYTE_C 0 COMP_0027 0 255
 /begin AXIS_DESCR FIX_AXIS NO_INPUT_QUANTITY COMP_0321_S 4 0 3 FIX_AXIS_PAR_DIST 0 1 4 /end AXIS_DESCR
 /begin AXIS_DESCR FIX_AXIS NO_INPUT_QUANTITY COMP_0321_S 4 0 3 FIX_AXIS_PAR_DIST 0 1 4 /end AXIS_DESCR
/end CHARACTERISTIC
/begin CHARACTERISTIC mMFLML "層流火炎速度基本マップ" MAP 0x00009CFE REC_UBYTE_C 0 COMP_0253 0 0.0159375
 /begin AXIS_DESCR COM_AXIS NO_INPUT_QUANTITY COMP_0020 4 0 12750 AXIS_PTS_REF mITANN /end AXIS_DESCR
 /begin AXIS_DESCR COM_AXIS NO_INPUT_QUANTITY COMP_0009 4 0 199.21875 AXIS_PTS_REF mITANI /end AXIS_DESCR
/end CHARACTERISTIC
/begin CHARACTERISTIC mMITAN "新気割合マップ" MAP 0x0000A9CE REC_UBYTE_C 0 COMP_0009 0 199.21875
 /begin AXIS_DESCR COM_AXIS NO_INPUT_QUANTITY COMP_0020 4 0 12750 AXIS_PTS_REF mITANN /end AXIS_DESCR
 /begin AXIS_DESCR COM_AXIS NO_INPUT_QUANTITY COMP_0009 4 0 199.21875 AXIS_PTS_REF mITANI /end AXIS_DESCR
/end CHARACTERISTIC
/begin CHARACTERISTIC mMKUBIN "未燃分回転負荷マップ" MAP 0x0000AC9E REC_UBYTE_C 0 COMP_0181 0 7.96875
 /begin AXIS_DESCR COM_AXIS NO_INPUT_QUANTITY COMP_0020 4 0 12750 AXIS_PTS_REF mNKUBTW /end AXIS_DESCR
 /begin AXIS_DESCR COM_AXIS NO_INPUT_QUANTITY COMP_0032 4 0 0.99609375 AXIS_PTS_REF mLKUBTW /end AXIS_DESCR
/end CHARACTERISTIC
/begin CHARACTERISTIC mMPTOFM "最小休止時間ﾏｯﾌﾟ" MAP 0x0000B9EE REC_UBYTE_C 0 COMP_0014 0 2550
 /begin AXIS_DESCR COM_AXIS NO_INPUT_QUANTITY COMP_0020 4 0 12750 AXIS_PTS_REF mTXRN /end AXIS_DESCR
 /begin AXIS_DESCR COM_AXIS NO_INPUT_QUANTITY COMP_0357 4 0 112.2 AXIS_PTS_REF mTXRTV /end AXIS_DESCR
/end CHARACTERISTIC
/begin CHARACTERISTIC mMPTXRT "休止時間/作動時間比率ﾏｯﾌﾟ" MAP 0x0000B9FE REC_UBYTE_C 0 COMP_0260 0 25.5
 /begin AXIS_DESCR COM_AXIS NO_INPUT_QUANTITY COMP_0020 4 0 12750 AXIS_PTS_REF mTXRN /end AXIS_DESCR
 /begin AXIS_DESCR COM_AXIS NO_INPUT_QUANTITY COMP_0357 4 0 112.2 AXIS_PTS_REF mTXRTV /end AXIS_DESCR
/end CHARACTERISTIC
/begin CHARACTERISTIC mMRHVTE "VTC目標作動角度ﾚｷﾞｭﾗｰ補正値算出ﾏｯﾌﾟ" MAP 0x0000BA4E REC_UBYTE_C 0 COMP_0256 -64 63.5
 /begin AXIS_DESCR COM_AXIS NO_INPUT_QUANTITY COMP_0020 4 0 12750 AXIS_PTS_REF mTVTRHNE /end AXIS_DESCR
 /begin AXIS_DESCR COM_AXIS NO_INPUT_QUANTITY COMP_0009 4 0 199.21875 AXIS_PTS_REF mTVTRHITE /end AXIS_DESCR
/end CHARACTERISTIC
/begin CHARACTERISTIC mMRHVTI "VTC目標作動角度ﾚｷﾞｭﾗｰ補正値算出ﾏｯﾌﾟ" MAP 0x0000BA5E REC_UBYTE_C 0 COMP_0256 -64 63.5
 /begin AXIS_DESCR COM_AXIS NO_INPUT_QUANTITY COMP_0020 4 0 12750 AXIS_PTS_REF mTVTRHNI /end AXIS_DESCR
 /begin AXIS_DESCR COM_AXIS NO_INPUT_QUANTITY COMP_0009 4 0 199.21875 AXIS_PTS_REF mTVTRHITI /end AXIS_DESCR
/end CHARACTERISTIC
/begin CHARACTERISTIC mMSTBIN "安定性回転負荷補正マップ" MAP 0x0000BBAE REC_UBYTE_C 0 COMP_0181 0 7.96875
 /begin AXIS_DESCR COM_AXIS NO_INPUT_QUANTITY COMP_0020 4 0 12750 AXIS_PTS_REF mNKUBTW /end AXIS_DESCR
 /begin AXIS_DESCR COM_AXIS NO_INPUT_QUANTITY COMP_0032 4 0 0.99609375 AXIS_PTS_REF mLKUBTW /end AXIS_DESCR
/end CHARACTERISTIC
/begin CHARACTERISTIC mMTMRDDN "T/M応答遅れD->NIDLE切換えﾃﾞｨﾚｲMAP" MAP 0x0000BDBE REC_UBYTE_C 0 COMP_0014 0 2550
 /begin AXIS_DESCR COM_AXIS NO_INPUT_QUANTITY COMP_0006 4 0 3187.5 AXIS_PTS_REF mTMDNNE /end AXIS_DESCR
 /begin AXIS_DESCR COM_AXIS NO_INPUT_QUANTITY COMP_0016 4 0 255 AXIS_PTS_REF mTMDNT /end AXIS_DESCR
/end CHARACTERISTIC
/begin CHARACTERISTIC mMTMRDND "T/M応答遅れNIDLE->D切換えﾃﾞｨﾚｲMAP" MAP 0x0000BDCE REC_UBYTE_C 0 COMP_0014 0 2550
 /begin AXIS_DESCR COM_AXIS NO_INPUT_QUANTITY COMP_0006 4 0 3187.5 AXIS_PTS_REF mTMNDNE /end AXIS_DESCR
 /begin AXIS_DESCR COM_AXIS NO_INPUT_QUANTITY COMP_0016 4 0 255 AXIS_PTS_REF mTMNDT /end AXIS_DESCR
/end CHARACTERISTIC
/begin CHARACTERISTIC mMTMRDNIN "T/M応答遅れNIDLE->N切換えディレイMAP（NIDLE->N＿change_delay_map）" MAP 0x0000BDDE REC_UBYTE_C 0 COMP_0014 0 2550
 /begin AXIS_DESCR COM_AXIS NO_INPUT_QUANTITY COMP_0006 4 0 3187.5 AXIS_PTS_REF mTMNDNE /end AXIS_DESCR
 /begin AXIS_DESCR COM_AXIS NO_INPUT_QUANTITY COMP_0016 4 0 255 AXIS_PTS_REF mTMNDT /end AXIS_DESCR
/end CHARACTERISTIC
/begin CHARACTERISTIC mMTMRDNNI "T/M応答遅れN->NIDLE切換えディレイMAP（N->NIDLEchange_delay_map）" MAP 0x0000BDEE REC_UBYTE_C 0 COMP_0014 0 2550
 /begin AXIS_DESCR COM_AXIS NO_INPUT_QUANTITY COMP_0006 4 0 3187.5 AXIS_PTS_REF mTMDNNE /end AXIS_DESCR
 /begin AXIS_DESCR COM_AXIS NO_INPUT_QUANTITY COMP_0016 4 0 255 AXIS_PTS_REF mTMDNT /end AXIS_DESCR
/end CHARACTERISTIC
/begin CHARACTERISTIC mSPDPGDSD "DSモード回転数制御ダウンゲインマップ(DS_mode_engine_speed_control_Down-shift_gain_map)" MAP 0x0000C1BE REC_UBYTE_C 0 COMP_0322_S 0 2.55
 /begin AXIS_DESCR COM_AXIS NO_INPUT_QUANTITY COMP_0323_S 4 0 204 AXIS_PTS_REF mSPDPGVDS /end AXIS_DESCR
 /begin AXIS_DESCR COM_AXIS NO_INPUT_QUANTITY COMP_0068 4 0 255 AXIS_PTS_REF mSPDPGGDS /end AXIS_DESCR
/end CHARACTERISTIC
/begin CHARACTERISTIC mSPDPGDSU "DSモード回転数制御アップゲインマップ(DS_mode_engine_speed_control_Up-shift_gain_map)" MAP 0x0000C1CE REC_UBYTE_C 0 COMP_0322_S 0 2.55
 /begin AXIS_DESCR COM_AXIS NO_INPUT_QUANTITY COMP_0323_S 4 0 204 AXIS_PTS_REF mSPDPGVDS /end AXIS_DESCR
 /begin AXIS_DESCR COM_AXIS NO_INPUT_QUANTITY COMP_0068 4 0 255 AXIS_PTS_REF mSPDPGGDS /end AXIS_DESCR
/end CHARACTERISTIC
/begin CHARACTERISTIC mSPDPGMM2 "Mモード回転数制御P分ゲインマップ2" MAP 0x0000C1DE REC_UBYTE_C 0 COMP_0322_S 0 2.55
 /begin AXIS_DESCR COM_AXIS NO_INPUT_QUANTITY COMP_0323_S 4 0 204 AXIS_PTS_REF mSPDPGVSX /end AXIS_DESCR
 /begin AXIS_DESCR COM_AXIS NO_INPUT_QUANTITY COMP_0068 4 0 255 AXIS_PTS_REF mSPDPGGPY /end AXIS_DESCR
/end CHARACTERISTIC
/begin CHARACTERISTIC mSPDPGMPD "Dレンジ回転数制御P分ゲインマップ" MAP 0x0000C1EE REC_UBYTE_C 0 COMP_0322_S 0 2.55
 /begin AXIS_DESCR COM_AXIS NO_INPUT_QUANTITY COMP_0323_S 4 0 204 AXIS_PTS_REF mSPDPGVSX /end AXIS_DESCR
 /begin AXIS_DESCR COM_AXIS NO_INPUT_QUANTITY COMP_0068 4 0 255 AXIS_PTS_REF mSPDPGGPY /end AXIS_DESCR
/end CHARACTERISTIC
/begin CHARACTERISTIC mSPDPGMPM "Mモード回転数制御P分ゲインマップ" MAP 0x0000C1FE REC_UBYTE_C 0 COMP_0322_S 0 2.55
 /begin AXIS_DESCR COM_AXIS NO_INPUT_QUANTITY COMP_0323_S 4 0 204 AXIS_PTS_REF mSPDPGVSX /end AXIS_DESCR
 /begin AXIS_DESCR COM_AXIS NO_INPUT_QUANTITY COMP_0068 4 0 255 AXIS_PTS_REF mSPDPGGPY /end AXIS_DESCR
/end CHARACTERISTIC
/begin CHARACTERISTIC mTDATDDS "ﾀﾞｳﾝｼﾌﾄ時ﾄﾙｸﾀﾞｳﾝ率減少率係数ﾏｯﾌﾟ" MAP 0x0000C20E REC_UBYTE_C 0 COMP_0175_S 0 0.99609375
 /begin AXIS_DESCR COM_AXIS NO_INPUT_QUANTITY COMP_0020 4 0 12750 AXIS_PTS_REF mTDATDN /end AXIS_DESCR
 /begin AXIS_DESCR COM_AXIS NO_INPUT_QUANTITY COMP_0068 4 0 255 AXIS_PTS_REF mTDATDGP /end AXIS_DESCR
/end CHARACTERISTIC
/begin CHARACTERISTIC mTDATDDS0 "ﾀﾞｳﾝｼﾌﾄ時ﾄﾙｸﾀﾞｳﾝ減少率選択ﾊﾟﾗﾒｰﾀﾏｯﾌﾟ" MAP 0x0000C21E REC_UBYTE_C 0 COMP_0004 0 255
 /begin AXIS_DESCR FIX_AXIS NO_INPUT_QUANTITY COMP_0324_S 4 1 4 FIX_AXIS_PAR_DIST 0 1 4 /end AXIS_DESCR
 /begin AXIS_DESCR FIX_AXIS NO_INPUT_QUANTITY COMP_0068 4 0 3 FIX_AXIS_PAR_DIST 0 1 4 /end AXIS_DESCR
/end CHARACTERISTIC
/begin CHARACTERISTIC mAJRMPMAP "ｱﾝﾁｼﾞｬｰｸﾘﾐｯﾄﾄﾙｸ変化率ﾏｯﾌﾟ" MAP 0x0000C78E REC_UWORD_C 0 COMP_0193 0 6553.5
 /begin AXIS_DESCR FIX_AXIS NO_INPUT_QUANTITY COMP_0325_S 8 0 73.92 FIX_AXIS_PAR_DIST 0 1 8 /end AXIS_DESCR
 /begin AXIS_DESCR FIX_AXIS NO_INPUT_QUANTITY COMP_0326_S 8 0 7000 FIX_AXIS_PAR_DIST 0 1 8 /end AXIS_DESCR
/end CHARACTERISTIC
/begin CHARACTERISTIC mCNGDLY "VTC駆動異常診断判定ディレイ" MAP 0x000098FE REC_UBYTE_C 0 COMP_0008 0 25500
 /begin AXIS_DESCR COM_AXIS NO_INPUT_QUANTITY COMP_0020 8 0 12750 AXIS_PTS_REF mCDLYNEJ /end AXIS_DESCR
 /begin AXIS_DESCR COM_AXIS NO_INPUT_QUANTITY COMP_0035 8 -50 205 AXIS_PTS_REF mCDLYTWJ /end AXIS_DESCR
/end CHARACTERISTIC
/begin CHARACTERISTIC mMABFS185 "AFSAF算出用_E85濃度時_N*TPシフトマップ(bank1)" MAP 0x0000C8C2 REC_UWORD_C 0 COMP_0327_S -65.536 65.534
 /begin AXIS_DESCR COM_AXIS NO_INPUT_QUANTITY COMP_0006 8 0 819187.5 AXIS_PTS_REF mMXABFSFT /end AXIS_DESCR
 /begin AXIS_DESCR COM_AXIS NO_INPUT_QUANTITY COMP_0144 8 0 31.999495335 AXIS_PTS_REF mMYABFSFT /end AXIS_DESCR
/end CHARACTERISTIC
/begin CHARACTERISTIC mMABFS285 "E85濃度時_N*TPシフトマップ(bank2)" MAP 0x0000C942 REC_UWORD_C 0 COMP_0327_S -65.536 65.534
 /begin AXIS_DESCR COM_AXIS NO_INPUT_QUANTITY COMP_0006 8 0 819187.5 AXIS_PTS_REF mMXABFSFT /end AXIS_DESCR
 /begin AXIS_DESCR COM_AXIS NO_INPUT_QUANTITY COMP_0144 8 0 31.999495335 AXIS_PTS_REF mMYABFSFT /end AXIS_DESCR
/end CHARACTERISTIC
/begin CHARACTERISTIC mMABFSFT1 "AFSAF算出用N×TPシフトマップ(bank1)" MAP 0x0000C9C2 REC_UWORD_C 0 COMP_0327_S -65.536 65.534
 /begin AXIS_DESCR COM_AXIS NO_INPUT_QUANTITY COMP_0006 8 0 819187.5 AXIS_PTS_REF mMXABFSFT /end AXIS_DESCR
 /begin AXIS_DESCR COM_AXIS NO_INPUT_QUANTITY COMP_0144 8 0 31.999495335 AXIS_PTS_REF mMYABFSFT /end AXIS_DESCR
/end CHARACTERISTIC
/begin CHARACTERISTIC mMABFSFT2 "N_*_TPｼﾌﾄﾏｯﾌﾟ(bank2)" MAP 0x0000CA42 REC_UWORD_C 0 COMP_0327_S -65.536 65.534
 /begin AXIS_DESCR COM_AXIS NO_INPUT_QUANTITY COMP_0006 8 0 819187.5 AXIS_PTS_REF mMXABFSFT /end AXIS_DESCR
 /begin AXIS_DESCR COM_AXIS NO_INPUT_QUANTITY COMP_0144 8 0 31.999495335 AXIS_PTS_REF mMYABFSFT /end AXIS_DESCR
/end CHARACTERISTIC
/begin CHARACTERISTIC mMADTRST "成層始動用点火時期マップ" MAP 0x0000994E REC_UBYTE_C 0 COMP_0245 -64 191
 /begin AXIS_DESCR COM_AXIS NO_INPUT_QUANTITY COMP_0000 8 0 6375 AXIS_PTS_REF mLSTITMN /end AXIS_DESCR
 /begin AXIS_DESCR COM_AXIS NO_INPUT_QUANTITY COMP_0310_S 8 0 40800 AXIS_PTS_REF mLSTITMTI2 /end AXIS_DESCR
/end CHARACTERISTIC
/begin CHARACTERISTIC mMADVIT2 "ｻｰｼﾞ2度噴き時点火補正ﾏｯﾌﾟ" MAP 0x0000998E REC_UBYTE_C 0 COMP_0017 0 255
 /begin AXIS_DESCR COM_AXIS NO_INPUT_QUANTITY COMP_0006 8 0 3187.5 AXIS_PTS_REF mMADVIT2N /end AXIS_DESCR
 /begin AXIS_DESCR COM_AXIS NO_INPUT_QUANTITY COMP_0009 8 0 199.21875 AXIS_PTS_REF mMADVIT2I /end AXIS_DESCR
/end CHARACTERISTIC
/begin CHARACTERISTIC mMADVKIRI "燃焼切換え直後均質狙い点火時期マップ(アイドル)" MAP 0x000099CE REC_UBYTE_C 0 COMP_0245 -64 191
 /begin AXIS_DESCR COM_AXIS NO_INPUT_QUANTITY COMP_0006 8 0 3187.5 AXIS_PTS_REF mLPINJNE /end AXIS_DESCR
 /begin AXIS_DESCR COM_AXIS NO_INPUT_QUANTITY COMP_0001 8 0 31.875 AXIS_PTS_REF mTLPINJTI2 /end AXIS_DESCR
/end CHARACTERISTIC
/begin CHARACTERISTIC mMAFEXP "排圧補正マップ" MAP 0x0000CAC2 REC_UWORD_C 0 COMP_0328_S -256 255.9921875
 /begin AXIS_DESCR COM_AXIS NO_INPUT_QUANTITY COMP_0006 8 0 819187.5 AXIS_PTS_REF mMYAFEXP /end AXIS_DESCR
 /begin AXIS_DESCR COM_AXIS NO_INPUT_QUANTITY COMP_0009 8 0 51199.21875 AXIS_PTS_REF mMXAFEXP /end AXIS_DESCR
/end CHARACTERISTIC
/begin CHARACTERISTIC mMALTCUR "オルタネータ発電特性マップ（13.5V時）" MAP 0x00009A0E REC_UBYTE_C 0 COMP_0045_S 0 255
 /begin AXIS_DESCR COM_AXIS NO_INPUT_QUANTITY COMP_0020 8 0 12750 AXIS_PTS_REF mTALTRPM /end AXIS_DESCR
 /begin AXIS_DESCR COM_AXIS NO_INPUT_QUANTITY COMP_0131_S 8 0 127.5 AXIS_PTS_REF mTALTTRQ /end AXIS_DESCR
/end CHARACTERISTIC
/begin CHARACTERISTIC mMALTTRQ "オルタネータトルク特性マップ（13.5V時）" MAP 0x00009A4E REC_UBYTE_C 0 COMP_0131_S 0 127.5
 /begin AXIS_DESCR COM_AXIS NO_INPUT_QUANTITY COMP_0020 8 0 12750 AXIS_PTS_REF mTALTRPM /end AXIS_DESCR
 /begin AXIS_DESCR COM_AXIS NO_INPUT_QUANTITY COMP_0045_S 8 0 255 AXIS_PTS_REF mTALTCUR /end AXIS_DESCR
/end CHARACTERISTIC
/begin CHARACTERISTIC mMAPFLD4A "吸気系応答時定数参照マップ(加速時)" MAP 0x00009A8E REC_UBYTE_C 0 COMP_0032 0 0.99609375
 /begin AXIS_DESCR COM_AXIS NO_INPUT_QUANTITY COMP_0000 8 0 6375 AXIS_PTS_REF mNFLD4 /end AXIS_DESCR
 /begin AXIS_DESCR COM_AXIS NO_INPUT_QUANTITY COMP_0032 8 0 0.99609375 AXIS_PTS_REF mQFLD4 /end AXIS_DESCR
/end CHARACTERISTIC
/begin CHARACTERISTIC mMAPFLD4D "吸気系応答時定数参照マップ(減速時)" MAP 0x00009ACE REC_UBYTE_C 0 COMP_0032 0 0.99609375
 /begin AXIS_DESCR COM_AXIS NO_INPUT_QUANTITY COMP_0000 8 0 6375 AXIS_PTS_REF mNFLD4 /end AXIS_DESCR
 /begin AXIS_DESCR COM_AXIS NO_INPUT_QUANTITY COMP_0032 8 0 0.99609375 AXIS_PTS_REF mQFLD4 /end AXIS_DESCR
/end CHARACTERISTIC
/begin CHARACTERISTIC mMCBADVLM "遅角側燃焼限界点火時期マップ" MAP 0x00009C0E REC_UBYTE_C 0 COMP_0245 -64 191
 /begin AXIS_DESCR COM_AXIS NO_INPUT_QUANTITY COMP_0020 8 0 12750 AXIS_PTS_REF mTCBADVGN /end AXIS_DESCR
 /begin AXIS_DESCR COM_AXIS NO_INPUT_QUANTITY COMP_0009 8 0 199.21875 AXIS_PTS_REF mTCBADVGI /end AXIS_DESCR
/end CHARACTERISTIC
/begin CHARACTERISTIC mMCOSTG "車両ｺｰｽﾄGﾏｯﾌﾟ(有段AT用）_(Vehicle_Coast_G_table_(for_step＿AT))" MAP 0x00009C7E REC_UBYTE_C 0 COMP_0130_S 0 0.255
 /begin AXIS_DESCR COM_AXIS NO_INPUT_QUANTITY COMP_0429 8 0 255 AXIS_PTS_REF mTTCOSTG /end AXIS_DESCR
 /begin AXIS_DESCR FIX_AXIS NO_INPUT_QUANTITY COMP_0068 8 0 7 FIX_AXIS_PAR_DIST 0 1 8 /end AXIS_DESCR
/end CHARACTERISTIC
/begin CHARACTERISTIC mMDATCT "性能確保AT、ECT差診断許可クライテリアマップ_(difference_between_the_ambtemp_and_the_ct_for_performance_assurance)" MAP 0x0000CF42 REC_UWORD_C 0 COMP_0066_S 0 6553.5
 /begin AXIS_DESCR COM_AXIS NO_INPUT_QUANTITY COMP_0006 8 0 819187.5 AXIS_PTS_REF mLDATCTNE /end AXIS_DESCR
 /begin AXIS_DESCR COM_AXIS NO_INPUT_QUANTITY COMP_0144 8 0 31.999495335 AXIS_PTS_REF mLDATCTTP /end AXIS_DESCR
/end CHARACTERISTIC
/begin CHARACTERISTIC mMFRBASE "ファストアイドルリタード基本値マップ" MAP 0x00009D0E REC_UBYTE_C 0 COMP_0017 0 255
 /begin AXIS_DESCR COM_AXIS NO_INPUT_QUANTITY COMP_0006 8 0 3187.5 AXIS_PTS_REF mLFRBMN /end AXIS_DESCR
 /begin AXIS_DESCR COM_AXIS NO_INPUT_QUANTITY COMP_0356 8 -40 119.375 AXIS_PTS_REF mLFRBTW /end AXIS_DESCR
/end CHARACTERISTIC
/begin CHARACTERISTIC mMFUKEADV "FUKEADVリタード量マップ" MAP 0x00009D4E REC_UBYTE_C 0 COMP_0314 -128 127
 /begin AXIS_DESCR FIX_AXIS NO_INPUT_QUANTITY COMP_0329_S 8 0 5600 FIX_AXIS_PAR_DIST 0 1 8 /end AXIS_DESCR
 /begin AXIS_DESCR FIX_AXIS NO_INPUT_QUANTITY COMP_0330_S 8 0 87.5 FIX_AXIS_PAR_DIST 0 1 8 /end AXIS_DESCR
/end CHARACTERISTIC
/begin CHARACTERISTIC mMGOVVTC2 "ｱｲﾄﾞﾙVTC点火時期補正Map" MAP 0x00009D8E REC_UBYTE_C 0 COMP_0314 -128 127
 /begin AXIS_DESCR COM_AXIS NO_INPUT_QUANTITY COMP_0020 8 0 12750 AXIS_PTS_REF mTVTCNE3 /end AXIS_DESCR
 /begin AXIS_DESCR COM_AXIS NO_INPUT_QUANTITY COMP_0256 8 -64 63.5 AXIS_PTS_REF mTVTCAGL2 /end AXIS_DESCR
/end CHARACTERISTIC
/begin CHARACTERISTIC mMINJTMST "成層始動時噴射ﾀｲﾐﾝｸﾞﾏｯﾌﾟ" MAP 0x0000A8CE REC_UBYTE_C 0 COMP_0190 0 510
 /begin AXIS_DESCR COM_AXIS NO_INPUT_QUANTITY COMP_0000 8 0 6375 AXIS_PTS_REF mLSTITMN /end AXIS_DESCR
 /begin AXIS_DESCR COM_AXIS NO_INPUT_QUANTITY COMP_0310_S 8 0 40800 AXIS_PTS_REF mLSTITMTI2 /end AXIS_DESCR
/end CHARACTERISTIC
/begin CHARACTERISTIC mMISCRDIG "均質DIG用リタード対応補正空気量補正率マップ" MAP 0x0000A90E REC_UBYTE_C 0 COMP_0331_S 0 127.5
 /begin AXIS_DESCR COM_AXIS NO_INPUT_QUANTITY COMP_0006 8 0 3187.5 AXIS_PTS_REF mLFRBMN /end AXIS_DESCR
 /begin AXIS_DESCR COM_AXIS NO_INPUT_QUANTITY COMP_0356 8 -40 119.375 AXIS_PTS_REF mLFRBTW /end AXIS_DESCR
/end CHARACTERISTIC
/begin CHARACTERISTIC mMITAFST "燃焼効率補正率動作点補正係数マップ(成層始動)" MAP 0x0000A94E REC_UBYTE_C 0 COMP_0045 0 1.9921875
 /begin AXIS_DESCR COM_AXIS NO_INPUT_QUANTITY COMP_0006 8 0 3187.5 AXIS_PTS_REF mNMKITAST /end AXIS_DESCR
 /begin AXIS_DESCR COM_AXIS NO_INPUT_QUANTITY COMP_0001 8 0 31.875 AXIS_PTS_REF mTPMITAST /end AXIS_DESCR
/end CHARACTERISTIC
/begin CHARACTERISTIC mMITAFSTB "燃焼効率補正率動作点補正係数マップ(超リタード燃焼)" MAP 0x0000A98E REC_UBYTE_C 0 COMP_0186 0 3.984375
 /begin AXIS_DESCR COM_AXIS NO_INPUT_QUANTITY COMP_0006 8 0 3187.5 AXIS_PTS_REF mNMKITAST /end AXIS_DESCR
 /begin AXIS_DESCR COM_AXIS NO_INPUT_QUANTITY COMP_0001 8 0 31.875 AXIS_PTS_REF mTPMITAST /end AXIS_DESCR
/end CHARACTERISTIC
/begin CHARACTERISTIC mMITANDA "過渡時新気割合マップ(加速用)" MAP 0x0000A9DE REC_UBYTE_C 0 COMP_0009 0 199.21875
 /begin AXIS_DESCR COM_AXIS NO_INPUT_QUANTITY COMP_0020 8 0 12750 AXIS_PTS_REF mITANDNE /end AXIS_DESCR
 /begin AXIS_DESCR COM_AXIS NO_INPUT_QUANTITY COMP_0032 8 0 0.99609375 AXIS_PTS_REF mITANDQH /end AXIS_DESCR
/end CHARACTERISTIC
/begin CHARACTERISTIC mMITANDD "過渡時新気割合マップ(減速用)" MAP 0x0000AA1E REC_UBYTE_C 0 COMP_0009 0 199.21875
 /begin AXIS_DESCR COM_AXIS NO_INPUT_QUANTITY COMP_0020 8 0 12750 AXIS_PTS_REF mITANDNE /end AXIS_DESCR
 /begin AXIS_DESCR COM_AXIS NO_INPUT_QUANTITY COMP_0032 8 0 0.99609375 AXIS_PTS_REF mITANDQH /end AXIS_DESCR
/end CHARACTERISTIC
/begin CHARACTERISTIC mMKFBRLMT "トータルノックF/B量遅角側リミッタマップ" MAP 0x0000D5C2 REC_UWORD_C 0 COMP_0332_S -31.99951 -1.46649999992685E-05
 /begin AXIS_DESCR COM_AXIS NO_INPUT_QUANTITY COMP_0006 8 0 819187.5 AXIS_PTS_REF mTKFBLMTN /end AXIS_DESCR
 /begin AXIS_DESCR COM_AXIS NO_INPUT_QUANTITY COMP_0209_S 8 0 199.996894995 AXIS_PTS_REF mTKFBLMTI /end AXIS_DESCR
/end CHARACTERISTIC
/begin CHARACTERISTIC mMKMFATd "分量割合基本値" MAP 0x0000AA5E REC_UBYTE_C 0 COMP_0258 0 12.451171875
 /begin AXIS_DESCR FIX_AXIS NO_INPUT_QUANTITY COMP_0333_S 8 -40 100 FIX_AXIS_PAR_DIST 0 1 8 /end AXIS_DESCR
 /begin AXIS_DESCR FIX_AXIS NO_INPUT_QUANTITY COMP_0330_S 8 0 87.5 FIX_AXIS_PAR_DIST 0 1 8 /end AXIS_DESCR
/end CHARACTERISTIC
/begin CHARACTERISTIC mMMBTTRML "MBTﾄﾘﾐﾝｸﾞﾏｯﾌﾟﾘｰﾝ" MAP 0x0000B52E REC_UBYTE_C 0 COMP_0245 -64 191
 /begin AXIS_DESCR COM_AXIS NO_INPUT_QUANTITY COMP_0020 8 0 12750 AXIS_PTS_REF mTADVTRMN /end AXIS_DESCR
 /begin AXIS_DESCR COM_AXIS NO_INPUT_QUANTITY COMP_0009 8 0 199.21875 AXIS_PTS_REF mTADVTRMI /end AXIS_DESCR
/end CHARACTERISTIC
/begin CHARACTERISTIC mMMFHIVTD "付着倍率IVO補正率マップ_減速側(Adhesion_scale_intake_valve_timing__compensation_rate_map_in_decelerating)" MAP 0x0000B56E REC_UBYTE_C 0 COMP_0063 0 0.99609375
 /begin AXIS_DESCR COM_AXIS NO_INPUT_QUANTITY COMP_0256 8 -64 63.5 AXIS_PTS_REF mLTCVTCIV /end AXIS_DESCR
 /begin AXIS_DESCR COM_AXIS NO_INPUT_QUANTITY COMP_0063 8 0 0.99609375 AXIS_PTS_REF mLTCVTCQH /end AXIS_DESCR
/end CHARACTERISTIC
/begin CHARACTERISTIC mMMFHQTd "付着倍率基本値(１気筒当たり)" MAP 0x0000B5AE REC_UBYTE_C 0 COMP_0279 0 3.984375
 /begin AXIS_DESCR FIX_AXIS NO_INPUT_QUANTITY COMP_0333_S 8 -40 100 FIX_AXIS_PAR_DIST 0 1 8 /end AXIS_DESCR
 /begin AXIS_DESCR FIX_AXIS NO_INPUT_QUANTITY COMP_0330_S 8 0 87.5 FIX_AXIS_PAR_DIST 0 1 8 /end AXIS_DESCR
/end CHARACTERISTIC
/begin CHARACTERISTIC mMOPDADPM "燃焼圧制限用点火時期ﾘﾐｯﾀﾏｯﾌﾟ" MAP 0x0000B5EE REC_UBYTE_C 0 COMP_0245 -64 191
 /begin AXIS_DESCR COM_AXIS NO_INPUT_QUANTITY COMP_0020 8 0 12750 AXIS_PTS_REF mTOPDTRSN /end AXIS_DESCR
 /begin AXIS_DESCR COM_AXIS NO_INPUT_QUANTITY COMP_0009 8 0 199.21875 AXIS_PTS_REF mTOPDTRSI /end AXIS_DESCR
/end CHARACTERISTIC
/begin CHARACTERISTIC mMPAMBFAC "エンジン出力可能トルク大気圧補正係数マップ" MAP 0x0000DC42 REC_UWORD_C 0 COMP_0334_S 0 1599.9780435
 /begin AXIS_DESCR COM_AXIS NO_INPUT_QUANTITY COMP_0486 8 0 5119.921875 AXIS_PTS_REF mPFCAMBBP /end AXIS_DESCR
 /begin AXIS_DESCR COM_AXIS NO_INPUT_QUANTITY COMP_0065 8 0 204796.875 AXIS_PTS_REF mPFCNEBP /end AXIS_DESCR
/end CHARACTERISTIC
/begin CHARACTERISTIC mMPDLFMFC "ペダル特性係数MAP" MAP 0x0000DEC2 REC_UWORD_C 0 COMP_0209_S 0 199.996894995
 /begin AXIS_DESCR COM_AXIS NO_INPUT_QUANTITY COMP_0436 8 0 6553.5 AXIS_PTS_REF mPFVSPBP /end AXIS_DESCR
 /begin AXIS_DESCR COM_AXIS NO_INPUT_QUANTITY COMP_0335_S 8 0 100.39057617 AXIS_PTS_REF mPFDMFBP /end AXIS_DESCR
/end CHARACTERISTIC
/begin CHARACTERISTIC mMPDLFM_S "ペダル特性係数MAP（副演算部）" MAP 0x00015C28 REC_UWORD_C 0 COMP_0209_S 0 199.996894995
 /begin AXIS_DESCR COM_AXIS NO_INPUT_QUANTITY COMP_0436 8 0 6553.5 AXIS_PTS_REF mPFVSPB_S /end AXIS_DESCR
 /begin AXIS_DESCR COM_AXIS NO_INPUT_QUANTITY COMP_0335_S 8 0 100.39057617 AXIS_PTS_REF mPFDMFB_S /end AXIS_DESCR
/end CHARACTERISTIC
/begin CHARACTERISTIC mMPIADVGW "成層始動時燃焼切換え中_PIADV_ゲイン" MAP 0x0000B72E REC_UBYTE_C 0 COMP_0045 0 1.9921875
 /begin AXIS_DESCR COM_AXIS NO_INPUT_QUANTITY COMP_0006 8 0 3187.5 AXIS_PTS_REF mLPINJNE /end AXIS_DESCR
 /begin AXIS_DESCR COM_AXIS NO_INPUT_QUANTITY COMP_0001 8 0 31.875 AXIS_PTS_REF mTLPINJTI2 /end AXIS_DESCR
/end CHARACTERISTIC
/begin CHARACTERISTIC mMPIFLD4A "ISCｸﾛｰｽﾞ時吸気系応答時定数参照マップ(当量比増加時)" MAP 0x0000B76E REC_UBYTE_C 0 COMP_0063 0 0.99609375
 /begin AXIS_DESCR COM_AXIS NO_INPUT_QUANTITY COMP_0000 8 0 6375 AXIS_PTS_REF mNFLD4 /end AXIS_DESCR
 /begin AXIS_DESCR COM_AXIS NO_INPUT_QUANTITY COMP_0032 8 0 0.99609375 AXIS_PTS_REF mQFLD4 /end AXIS_DESCR
/end CHARACTERISTIC
/begin CHARACTERISTIC mMPIFLD4D "ISCｸﾛｰｽﾞ時吸気系応答時定数参照マップ(当量比減少時)" MAP 0x0000B7AE REC_UBYTE_C 0 COMP_0063 0 0.99609375
 /begin AXIS_DESCR COM_AXIS NO_INPUT_QUANTITY COMP_0000 8 0 6375 AXIS_PTS_REF mNFLD4 /end AXIS_DESCR
 /begin AXIS_DESCR COM_AXIS NO_INPUT_QUANTITY COMP_0032 8 0 0.99609375 AXIS_PTS_REF mQFLD4 /end AXIS_DESCR
/end CHARACTERISTIC
/begin CHARACTERISTIC mMQHITAC "Q0リミット補正ゲインマップ" MAP 0x0000BA0E REC_UBYTE_C 0 COMP_0045 0 1.9921875
 /begin AXIS_DESCR COM_AXIS NO_INPUT_QUANTITY COMP_0020 8 0 12750 AXIS_PTS_REF mNQHITAC /end AXIS_DESCR
 /begin AXIS_DESCR COM_AXIS NO_INPUT_QUANTITY COMP_0045 8 0 1.9921875 AXIS_PTS_REF mTSQHITAC /end AXIS_DESCR
/end CHARACTERISTIC
/begin CHARACTERISTIC mMQLEAN "ﾘｰﾝ化時空気量補正量ﾏｯﾌﾟ" MAP 0x0000E142 REC_UWORD_C 0 COMP_0336_S -32768 32767
 /begin AXIS_DESCR COM_AXIS NO_INPUT_QUANTITY COMP_0017 8 0 65535 AXIS_PTS_REF mTXDLAV /end AXIS_DESCR
 /begin AXIS_DESCR COM_AXIS NO_INPUT_QUANTITY COMP_0006 8 0 819187.5 AXIS_PTS_REF mTXNEC /end AXIS_DESCR
/end CHARACTERISTIC
/begin CHARACTERISTIC mMSSTADV "膨張行程噴射用点火時期マップ(Ignition_timing_map_for_cranking_at_expansion)" MAP 0x0000BB6E REC_UBYTE_C 0 COMP_0245 -64 191
 /begin AXIS_DESCR COM_AXIS NO_INPUT_QUANTITY COMP_0006 8 0 3187.5 AXIS_PTS_REF mLPINJNE /end AXIS_DESCR
 /begin AXIS_DESCR COM_AXIS NO_INPUT_QUANTITY COMP_0001 8 0 31.875 AXIS_PTS_REF mTLPINJTI2 /end AXIS_DESCR
/end CHARACTERISTIC
/begin CHARACTERISTIC mMSTINJT2 "多段噴射ﾀｲﾐﾝｸﾞﾏｯﾌﾟ(膨張行程)" MAP 0x0000BBBE REC_UBYTE_C 0 COMP_0190 0 510
 /begin AXIS_DESCR COM_AXIS NO_INPUT_QUANTITY COMP_0006 8 0 3187.5 AXIS_PTS_REF mLPINJNE /end AXIS_DESCR
 /begin AXIS_DESCR COM_AXIS NO_INPUT_QUANTITY COMP_0310_S 8 0 40800 AXIS_PTS_REF mLPINJTI2 /end AXIS_DESCR
/end CHARACTERISTIC
/begin CHARACTERISTIC mMSTINJTA "多段噴射ﾀｲﾐﾝｸﾞﾏｯﾌﾟ(圧縮行程)" MAP 0x0000BBFE REC_UBYTE_C 0 COMP_0190 0 510
 /begin AXIS_DESCR COM_AXIS NO_INPUT_QUANTITY COMP_0006 8 0 3187.5 AXIS_PTS_REF mLPINJNE /end AXIS_DESCR
 /begin AXIS_DESCR COM_AXIS NO_INPUT_QUANTITY COMP_0310_S 8 0 40800 AXIS_PTS_REF mLPINJTI2 /end AXIS_DESCR
/end CHARACTERISTIC
/begin CHARACTERISTIC mMSTINJTB "多段噴射ﾀｲﾐﾝｸﾞﾏｯﾌﾟ(膨張行程)" MAP 0x0000BC3E REC_UBYTE_C 0 COMP_0190 0 510
 /begin AXIS_DESCR COM_AXIS NO_INPUT_QUANTITY COMP_0006 8 0 3187.5 AXIS_PTS_REF mLPINJNE /end AXIS_DESCR
 /begin AXIS_DESCR COM_AXIS NO_INPUT_QUANTITY COMP_0001 8 0 31.875 AXIS_PTS_REF mTLPINJTI2 /end AXIS_DESCR
/end CHARACTERISTIC
/begin CHARACTERISTIC mMSTTPSN "成層始動時目標燃圧ﾏｯﾌﾟ" MAP 0x0000BC7E REC_UBYTE_C 0 COMP_0087_S 0 19.9104
 /begin AXIS_DESCR COM_AXIS NO_INPUT_QUANTITY COMP_0006 8 0 3187.5 AXIS_PTS_REF mLPINJNE /end AXIS_DESCR
 /begin AXIS_DESCR COM_AXIS NO_INPUT_QUANTITY COMP_0001 8 0 31.875 AXIS_PTS_REF mLPINJTTP /end AXIS_DESCR
/end CHARACTERISTIC
/begin CHARACTERISTIC mMTANHOS "トレース点火時期吸気温補正係数マップ" MAP 0x0000BCBE REC_UBYTE_C 0 COMP_0337_S 0 0.99609375
 /begin AXIS_DESCR COM_AXIS NO_INPUT_QUANTITY COMP_0020 8 0 12750 AXIS_PTS_REF mHOSGHN /end AXIS_DESCR
 /begin AXIS_DESCR COM_AXIS NO_INPUT_QUANTITY COMP_0009 8 0 199.21875 AXIS_PTS_REF mHOSGI /end AXIS_DESCR
/end CHARACTERISTIC
/begin CHARACTERISTIC mMTCVHOS "TCV補正量ﾏｯﾌﾟ" MAP 0x0000BCFE REC_UBYTE_C 0 COMP_0017 0 255
 /begin AXIS_DESCR COM_AXIS NO_INPUT_QUANTITY COMP_0020 8 0 12750 AXIS_PTS_REF mTCVHOSN /end AXIS_DESCR
 /begin AXIS_DESCR COM_AXIS NO_INPUT_QUANTITY COMP_0009 8 0 199.21875 AXIS_PTS_REF mTCVHOSI /end AXIS_DESCR
/end CHARACTERISTIC
/begin CHARACTERISTIC mMTEX1 "活性判定前触媒温度マップ" MAP 0x0000BD3E REC_UBYTE_C 0 COMP_0062 0 1020
 /begin AXIS_DESCR COM_AXIS NO_INPUT_QUANTITY COMP_0020 8 0 12750 AXIS_PTS_REF mTTEXN /end AXIS_DESCR
 /begin AXIS_DESCR COM_AXIS NO_INPUT_QUANTITY COMP_0001 8 0 31.875 AXIS_PTS_REF mTTEXTP /end AXIS_DESCR
/end CHARACTERISTIC
/begin CHARACTERISTIC mMTEX2 "活性判定後触媒温度マップ" MAP 0x0000BD7E REC_UBYTE_C 0 COMP_0062 0 1020
 /begin AXIS_DESCR COM_AXIS NO_INPUT_QUANTITY COMP_0020 8 0 12750 AXIS_PTS_REF mTTEXN /end AXIS_DESCR
 /begin AXIS_DESCR COM_AXIS NO_INPUT_QUANTITY COMP_0001 8 0 31.875 AXIS_PTS_REF mTTEXTP /end AXIS_DESCR
/end CHARACTERISTIC
/begin CHARACTERISTIC mMTWNHOS "トレース点火時期水温補正係数マップ" MAP 0x0000C0FE REC_UBYTE_C 0 COMP_0337_S 0 0.99609375
 /begin AXIS_DESCR COM_AXIS NO_INPUT_QUANTITY COMP_0020 8 0 12750 AXIS_PTS_REF mHOSGHN /end AXIS_DESCR
 /begin AXIS_DESCR COM_AXIS NO_INPUT_QUANTITY COMP_0009 8 0 199.21875 AXIS_PTS_REF mHOSGI /end AXIS_DESCR
/end CHARACTERISTIC
/begin CHARACTERISTIC mMVTRGEN "排気VTC基本目標作動角度算出ﾏｯﾌﾟ(低水温時)Exhaust_VTC_basis_target_operation_angle_calculation_map(At_a_low_water_tempera" MAP 0x0000FBC2 REC_UWORD_C 0 COMP_0108_S -16384 16383.5
 /begin AXIS_DESCR COM_AXIS NO_INPUT_QUANTITY COMP_0020 8 0 3276750 AXIS_PTS_REF mTVTCNEEN /end AXIS_DESCR
 /begin AXIS_DESCR COM_AXIS NO_INPUT_QUANTITY COMP_0009 8 0 51199.21875 AXIS_PTS_REF mTVTCITEN /end AXIS_DESCR
/end CHARACTERISTIC
/begin CHARACTERISTIC mMVTRGIN "吸気VTC基本目標作動角度算出ﾏｯﾌﾟ(低水温時)Suction_VTC_basic_target_operation_angle_calculation_map(At_a_low_water_tempera" MAP 0x00010042 REC_UWORD_C 0 COMP_0108_S -16384 16383.5
 /begin AXIS_DESCR COM_AXIS NO_INPUT_QUANTITY COMP_0020 8 0 3276750 AXIS_PTS_REF mTVTCNEIN /end AXIS_DESCR
 /begin AXIS_DESCR COM_AXIS NO_INPUT_QUANTITY COMP_0009 8 0 51199.21875 AXIS_PTS_REF mTVTCITIN /end AXIS_DESCR
/end CHARACTERISTIC
/begin CHARACTERISTIC mMWGROUU "(WGガス密度×流速)の逆数マップ" MAP 0x000102C2 REC_UWORD_C 0 COMP_0338_S 0 0.007812361815
 /begin AXIS_DESCR COM_AXIS NO_INPUT_QUANTITY COMP_0065 8 0 204796.875 AXIS_PTS_REF mTNERU /end AXIS_DESCR
 /begin AXIS_DESCR COM_AXIS NO_INPUT_QUANTITY COMP_0329 8 0 511.9921875 AXIS_PTS_REF mTITACRU /end AXIS_DESCR
/end CHARACTERISTIC
/begin CHARACTERISTIC mMWOTINJA "ｻｰｼﾞ2度噴き噴射ﾀｲﾐﾝｸﾞﾏｯﾌﾟ（1発目）（surge_multi_injection_timing_map(1st)）" MAP 0x0000C13E REC_UBYTE_C 0 COMP_0190 0 510
 /begin AXIS_DESCR COM_AXIS NO_INPUT_QUANTITY COMP_0006 8 0 3187.5 AXIS_PTS_REF mLPINJNE /end AXIS_DESCR
 /begin AXIS_DESCR COM_AXIS NO_INPUT_QUANTITY COMP_0310_S 8 0 40800 AXIS_PTS_REF mLPINJTI2 /end AXIS_DESCR
/end CHARACTERISTIC
/begin CHARACTERISTIC mMWOTINJB "ｻｰｼﾞ2度噴き噴射ﾀｲﾐﾝｸﾞﾏｯﾌﾟ（2発目）（surge_multi_injection_timing_map(2nd)）" MAP 0x0000C17E REC_UBYTE_C 0 COMP_0190 0 510
 /begin AXIS_DESCR COM_AXIS NO_INPUT_QUANTITY COMP_0006 8 0 3187.5 AXIS_PTS_REF mLPINJNE /end AXIS_DESCR
 /begin AXIS_DESCR COM_AXIS NO_INPUT_QUANTITY COMP_0310_S 8 0 40800 AXIS_PTS_REF mLPINJTI2 /end AXIS_DESCR
/end CHARACTERISTIC
/begin CHARACTERISTIC mSLMTOITM "MT高油温判定時間設定マップ（MT_oil_high_temp_judgement_time_map）" MAP 0x00010342 REC_UWORD_C 0 COMP_0008 0 6553500
 /begin AXIS_DESCR COM_AXIS NO_INPUT_QUANTITY COMP_0436 8 0 6553.5 AXIS_PTS_REF mSLMTOIVS /end AXIS_DESCR
 /begin AXIS_DESCR COM_AXIS NO_INPUT_QUANTITY COMP_0035 8 -50 65485 AXIS_PTS_REF mSLMTOTAN /end AXIS_DESCR
/end CHARACTERISTIC
/begin CHARACTERISTIC mTEHOSMAP "TTEPTDﾄﾙｸ補正ﾏｯﾌﾟ" MAP 0x000107C2 REC_UWORD_C 0 COMP_0271 0 199.99696053
 /begin AXIS_DESCR COM_AXIS NO_INPUT_QUANTITY COMP_0450 8 0 63.999056205 AXIS_PTS_REF mTEHOSRTO /end AXIS_DESCR
 /begin AXIS_DESCR COM_AXIS NO_INPUT_QUANTITY COMP_0065 8 0 204796.875 AXIS_PTS_REF mTEHOSNE /end AXIS_DESCR
/end CHARACTERISTIC
/begin CHARACTERISTIC mTFCDMAP "全気筒F/Cﾃﾞｨﾚｲﾏｯﾌﾟ" MAP 0x0000C22E REC_UBYTE_C 0 COMP_0014 0 2550
 /begin AXIS_DESCR FIX_AXIS NO_INPUT_QUANTITY COMP_0329_S 8 0 5600 FIX_AXIS_PAR_DIST 0 1 8 /end AXIS_DESCR
 /begin AXIS_DESCR FIX_AXIS NO_INPUT_QUANTITY COMP_0330_S 8 0 87.5 FIX_AXIS_PAR_DIST 0 1 8 /end AXIS_DESCR
/end CHARACTERISTIC
/begin CHARACTERISTIC mTRAMRESR "トラノック制御用残ガス率マップ" MAP 0x00010A42 REC_UWORD_C 0 COMP_0214_S 0 0.65535
 /begin AXIS_DESCR COM_AXIS NO_INPUT_QUANTITY COMP_0006 8 0 819187.5 AXIS_PTS_REF mTTMRNRPM /end AXIS_DESCR
 /begin AXIS_DESCR COM_AXIS NO_INPUT_QUANTITY COMP_0009 8 0 51199.21875 AXIS_PTS_REF mTTMRITAC /end AXIS_DESCR
/end CHARACTERISTIC
/begin CHARACTERISTIC mTTRARET "トラノックリタード量マップ" MAP 0x00010CC2 REC_UWORD_C 0 COMP_0339_S -32768 32767
 /begin AXIS_DESCR COM_AXIS NO_INPUT_QUANTITY COMP_0182_S 8 0 65.535 AXIS_PTS_REF mTTRARIDX /end AXIS_DESCR
 /begin AXIS_DESCR COM_AXIS NO_INPUT_QUANTITY COMP_0006 8 0 819187.5 AXIS_PTS_REF mTTRARNE /end AXIS_DESCR
/end CHARACTERISTIC
/begin CHARACTERISTIC mVCDZCTE "排気VTC駆動電流不感帯中央地マップ" MAP 0x00010D42 REC_UWORD_C 0 COMP_0293_S 0 0.999985458
 /begin AXIS_DESCR COM_AXIS NO_INPUT_QUANTITY COMP_0020 8 0 3276750 AXIS_PTS_REF mVCMAPNE /end AXIS_DESCR
 /begin AXIS_DESCR COM_AXIS NO_INPUT_QUANTITY COMP_0035 8 -50 65485 AXIS_PTS_REF mVCMAPOT /end AXIS_DESCR
/end CHARACTERISTIC
/begin CHARACTERISTIC mVCDZCTI "VTC駆動電流不感帯中央地マップ" MAP 0x00010DC2 REC_UWORD_C 0 COMP_0293_S 0 0.999985458
 /begin AXIS_DESCR COM_AXIS NO_INPUT_QUANTITY COMP_0020 8 0 3276750 AXIS_PTS_REF mVCMAPNE /end AXIS_DESCR
 /begin AXIS_DESCR COM_AXIS NO_INPUT_QUANTITY COMP_0035 8 -50 65485 AXIS_PTS_REF mVCMAPOT /end AXIS_DESCR
/end CHARACTERISTIC
/begin CHARACTERISTIC mVCDZWE "排気VTC駆動電流不感帯幅マップ" MAP 0x00010E42 REC_UWORD_C 0 COMP_0293_S 0 0.999985458
 /begin AXIS_DESCR COM_AXIS NO_INPUT_QUANTITY COMP_0020 8 0 3276750 AXIS_PTS_REF mVCMAPNE /end AXIS_DESCR
 /begin AXIS_DESCR COM_AXIS NO_INPUT_QUANTITY COMP_0035 8 -50 65485 AXIS_PTS_REF mVCMAPOT /end AXIS_DESCR
/end CHARACTERISTIC
/begin CHARACTERISTIC mVCDZWI "VTC駆動電流不感帯幅マップ" MAP 0x00010EC2 REC_UWORD_C 0 COMP_0293_S 0 0.999985458
 /begin AXIS_DESCR COM_AXIS NO_INPUT_QUANTITY COMP_0020 8 0 3276750 AXIS_PTS_REF mVCMAPNE /end AXIS_DESCR
 /begin AXIS_DESCR COM_AXIS NO_INPUT_QUANTITY COMP_0035 8 -50 65485 AXIS_PTS_REF mVCMAPOT /end AXIS_DESCR
/end CHARACTERISTIC
/begin CHARACTERISTIC mVCGACVE "排気VTC制御進角側ゲインマップ" MAP 0x00010F42 REC_UWORD_C 0 COMP_0340_S 0 19660.5
 /begin AXIS_DESCR COM_AXIS NO_INPUT_QUANTITY COMP_0020 8 0 3276750 AXIS_PTS_REF mVCMAPNE /end AXIS_DESCR
 /begin AXIS_DESCR COM_AXIS NO_INPUT_QUANTITY COMP_0035 8 -50 65485 AXIS_PTS_REF mVCMAPOT /end AXIS_DESCR
/end CHARACTERISTIC
/begin CHARACTERISTIC mVCGACVI "VTC制御進角側ゲインマップ" MAP 0x00010FC2 REC_UWORD_C 0 COMP_0340_S 0 19660.5
 /begin AXIS_DESCR COM_AXIS NO_INPUT_QUANTITY COMP_0020 8 0 3276750 AXIS_PTS_REF mVCMAPNE /end AXIS_DESCR
 /begin AXIS_DESCR COM_AXIS NO_INPUT_QUANTITY COMP_0035 8 -50 65485 AXIS_PTS_REF mVCMAPOT /end AXIS_DESCR
/end CHARACTERISTIC
/begin CHARACTERISTIC mVCGRCVE "排気VTC制御遅角側ゲインマップ" MAP 0x00011042 REC_UWORD_C 0 COMP_0341_S 0 6553.5
 /begin AXIS_DESCR COM_AXIS NO_INPUT_QUANTITY COMP_0020 8 0 3276750 AXIS_PTS_REF mVCMAPNE /end AXIS_DESCR
 /begin AXIS_DESCR COM_AXIS NO_INPUT_QUANTITY COMP_0035 8 -50 65485 AXIS_PTS_REF mVCMAPOT /end AXIS_DESCR
/end CHARACTERISTIC
/begin CHARACTERISTIC mVCGRCVI "VTC制御遅角側ゲインマップ" MAP 0x000110C2 REC_UWORD_C 0 COMP_0341_S 0 6553.5
 /begin AXIS_DESCR COM_AXIS NO_INPUT_QUANTITY COMP_0020 8 0 3276750 AXIS_PTS_REF mVCMAPNE /end AXIS_DESCR
 /begin AXIS_DESCR COM_AXIS NO_INPUT_QUANTITY COMP_0035 8 -50 65485 AXIS_PTS_REF mVCMAPOT /end AXIS_DESCR
/end CHARACTERISTIC
/begin CHARACTERISTIC mVCTPADE "排気側進角側時定数マップ" MAP 0x00011142 REC_UWORD_C 0 COMP_0178_S 0 1.3107
 /begin AXIS_DESCR COM_AXIS NO_INPUT_QUANTITY COMP_0020 8 0 3276750 AXIS_PTS_REF mVCMAPNE /end AXIS_DESCR
 /begin AXIS_DESCR COM_AXIS NO_INPUT_QUANTITY COMP_0035 8 -50 65485 AXIS_PTS_REF mVCMAPOT /end AXIS_DESCR
/end CHARACTERISTIC
/begin CHARACTERISTIC mVCTPADI "進角側時定数マップ" MAP 0x000111C2 REC_UWORD_C 0 COMP_0178_S 0 1.3107
 /begin AXIS_DESCR COM_AXIS NO_INPUT_QUANTITY COMP_0020 8 0 3276750 AXIS_PTS_REF mVCMAPNE /end AXIS_DESCR
 /begin AXIS_DESCR COM_AXIS NO_INPUT_QUANTITY COMP_0035 8 -50 65485 AXIS_PTS_REF mVCMAPOT /end AXIS_DESCR
/end CHARACTERISTIC
/begin CHARACTERISTIC mVCTPRTE "排気側遅角側時定数マップ" MAP 0x00011242 REC_UWORD_C 0 COMP_0342_S 0 1.96605
 /begin AXIS_DESCR COM_AXIS NO_INPUT_QUANTITY COMP_0020 8 0 3276750 AXIS_PTS_REF mVCMAPNE /end AXIS_DESCR
 /begin AXIS_DESCR COM_AXIS NO_INPUT_QUANTITY COMP_0035 8 -50 65485 AXIS_PTS_REF mVCMAPOT /end AXIS_DESCR
/end CHARACTERISTIC
/begin CHARACTERISTIC mVCTPRTI "遅角側時定数マップ" MAP 0x000112C2 REC_UWORD_C 0 COMP_0342_S 0 1.96605
 /begin AXIS_DESCR COM_AXIS NO_INPUT_QUANTITY COMP_0020 8 0 3276750 AXIS_PTS_REF mVCMAPNE /end AXIS_DESCR
 /begin AXIS_DESCR COM_AXIS NO_INPUT_QUANTITY COMP_0035 8 -50 65485 AXIS_PTS_REF mVCMAPOT /end AXIS_DESCR
/end CHARACTERISTIC
/begin CHARACTERISTIC mVTCSALE "排気VTC変換速度進角側飽和電流マップ" MAP 0x00011342 REC_UWORD_C 0 COMP_0343_S 0 0.999998565
 /begin AXIS_DESCR COM_AXIS NO_INPUT_QUANTITY COMP_0020 8 0 3276750 AXIS_PTS_REF mVCMAPNE /end AXIS_DESCR
 /begin AXIS_DESCR COM_AXIS NO_INPUT_QUANTITY COMP_0035 8 -50 65485 AXIS_PTS_REF mVCMAPOT /end AXIS_DESCR
/end CHARACTERISTIC
/begin CHARACTERISTIC mVTCSALI "VTC変換速度進角側飽和電流マップ" MAP 0x000113C2 REC_UWORD_C 0 COMP_0343_S 0 0.999998565
 /begin AXIS_DESCR COM_AXIS NO_INPUT_QUANTITY COMP_0020 8 0 3276750 AXIS_PTS_REF mVCMAPNE /end AXIS_DESCR
 /begin AXIS_DESCR COM_AXIS NO_INPUT_QUANTITY COMP_0035 8 -50 65485 AXIS_PTS_REF mVCMAPOT /end AXIS_DESCR
/end CHARACTERISTIC
/begin CHARACTERISTIC mVTCSRLE "排気VTC変換速度遅角側飽和電流マップ" MAP 0x00011442 REC_UWORD_C 0 COMP_0344_S -1 -1.43499999994887E-06
 /begin AXIS_DESCR COM_AXIS NO_INPUT_QUANTITY COMP_0020 8 0 3276750 AXIS_PTS_REF mVCMAPNE /end AXIS_DESCR
 /begin AXIS_DESCR COM_AXIS NO_INPUT_QUANTITY COMP_0035 8 -50 65485 AXIS_PTS_REF mVCMAPOT /end AXIS_DESCR
/end CHARACTERISTIC
/begin CHARACTERISTIC mVTCSRLI "VTC変換速度遅角側飽和電流マップ" MAP 0x000114C2 REC_UWORD_C 0 COMP_0344_S -1 -1.43499999994887E-06
 /begin AXIS_DESCR COM_AXIS NO_INPUT_QUANTITY COMP_0020 8 0 3276750 AXIS_PTS_REF mVCMAPNE /end AXIS_DESCR
 /begin AXIS_DESCR COM_AXIS NO_INPUT_QUANTITY COMP_0035 8 -50 65485 AXIS_PTS_REF mVCMAPOT /end AXIS_DESCR
/end CHARACTERISTIC
/begin CHARACTERISTIC mADCTBL "空気密度補正テーブル" CURVE 0x00011556 REC_UBYTE_C 0 COMP_0045 0 1.9921875
 /begin AXIS_DESCR FIX_AXIS NO_INPUT_QUANTITY COMP_0345_S 16 -50 190 FIX_AXIS_PAR_DIST 0 1 16 /end AXIS_DESCR
/end CHARACTERISTIC
/begin CHARACTERISTIC mAFSFT "RrO2ｾﾝｻ非活性時目標A/F" CURVE 0x00012CD2 REC_UWORD_C 0 COMP_0453 0 131.07
 /begin AXIS_DESCR COM_AXIS NO_INPUT_QUANTITY COMP_0035 16 -50 65485 AXIS_PTS_REF mTXAFSFT /end AXIS_DESCR
/end CHARACTERISTIC
/begin CHARACTERISTIC mAFSFT2 "RrO2ｾﾝｻ非活性時目標A/F初期値" CURVE 0x00012CF2 REC_UWORD_C 0 COMP_0453 0 131.07
 /begin AXIS_DESCR COM_AXIS NO_INPUT_QUANTITY COMP_0035 16 -50 65485 AXIS_PTS_REF mTXAFSFT /end AXIS_DESCR
/end CHARACTERISTIC
/begin CHARACTERISTIC mAFSFTIDL "RrO2ｾﾝｻ非活性時目標A/F(ｱｲﾄﾞﾙ)" CURVE 0x00012D12 REC_UWORD_C 0 COMP_0453 0 131.07
 /begin AXIS_DESCR COM_AXIS NO_INPUT_QUANTITY COMP_0035 16 -50 65485 AXIS_PTS_REF mTXAFSFT /end AXIS_DESCR
/end CHARACTERISTIC
/begin CHARACTERISTIC mDAFSFT "RrO2ｾﾝｻ非活性時目標A/F変化率" CURVE 0x00012E32 REC_UWORD_C 0 COMP_0346_S 0 0.031999495335
 /begin AXIS_DESCR COM_AXIS NO_INPUT_QUANTITY COMP_0035 16 -50 65485 AXIS_PTS_REF mTXAFSFT /end AXIS_DESCR
/end CHARACTERISTIC
/begin CHARACTERISTIC mDRVTQLMT "ﾄﾞﾗｲﾌﾞﾓｰﾄﾞ対応ﾄﾙｸﾘﾐｯﾄテーブル(Torque_limit_table_for_drive_mode)" CURVE 0x00012EF2 REC_UWORD_C 0 COMP_0196 0 6553.5
 /begin AXIS_DESCR COM_AXIS NO_INPUT_QUANTITY COMP_0065 16 0 204796.875 AXIS_PTS_REF mNTTE0WD /end AXIS_DESCR
/end CHARACTERISTIC
/begin CHARACTERISTIC mDSPOFSTB "DSPｵﾌｾｯﾄ値ﾃｰﾌﾞﾙ(DSP_Offset_Value_Table)" CURVE 0x00012F32 REC_UWORD_C 0 COMP_0238_S 0 655.35
 /begin AXIS_DESCR COM_AXIS NO_INPUT_QUANTITY COMP_0238_S 16 0 655.35 AXIS_PTS_REF mDSPOFSBP /end AXIS_DESCR
/end CHARACTERISTIC
/begin CHARACTERISTIC mMPMAXBST "最大筒内圧時過給圧ﾃｰﾌﾞﾙ(Boosting_pressure_table_of_max_cylinder_pressure)" CURVE 0x00013774 REC_UWORD_C 0 COMP_0120_S 0 16383.75
 /begin AXIS_DESCR COM_AXIS NO_INPUT_QUANTITY COMP_0065 16 0 204796.875 AXIS_PTS_REF mTNPCHS /end AXIS_DESCR
/end CHARACTERISTIC
/begin CHARACTERISTIC mPIADVAT "DUETTE用Pi%ﾃｰﾌﾞﾙ" CURVE 0x000119C8 REC_UBYTE_C 0 COMP_0032 0 0.99609375
 /begin AXIS_DESCR COM_AXIS NO_INPUT_QUANTITY COMP_0017 16 0 255 AXIS_PTS_REF mADVPIAT /end AXIS_DESCR
/end CHARACTERISTIC
/begin CHARACTERISTIC mSPDCT0TM "回転同期初期吹き制御設定タイマ" CURVE 0x00011A60 REC_UBYTE_C 0 COMP_0014 0 2550
 /begin AXIS_DESCR FIX_AXIS NO_INPUT_QUANTITY COMP_0068 16 0 15 FIX_AXIS_PAR_DIST 0 1 16 /end AXIS_DESCR
/end CHARACTERISTIC
/begin CHARACTERISTIC mSPDCT0TQ "回転同期初期吹き制御時付加トルク" CURVE 0x00013BD2 REC_UWORD_C 0 COMP_0226 -3276.8 3276.7
 /begin AXIS_DESCR FIX_AXIS NO_INPUT_QUANTITY COMP_0068 16 0 15 FIX_AXIS_PAR_DIST 0 1 16 /end AXIS_DESCR
/end CHARACTERISTIC
/begin CHARACTERISTIC mTA5N "中水温リタード回転補正テーブル" CURVE 0x00011AB0 REC_UBYTE_C 0 COMP_0032 0 0.99609375
 /begin AXIS_DESCR FIX_AXIS NO_INPUT_QUANTITY COMP_0347_S 16 0 6000 FIX_AXIS_PAR_DIST 0 1 16 /end AXIS_DESCR
/end CHARACTERISTIC
/begin CHARACTERISTIC mTA5TW "中水温リタード水温補正テーブル" CURVE 0x00011AC8 REC_UBYTE_C 0 COMP_0032 0 0.99609375
 /begin AXIS_DESCR FIX_AXIS NO_INPUT_QUANTITY COMP_0348_S 16 -40 110 FIX_AXIS_PAR_DIST 0 1 16 /end AXIS_DESCR
/end CHARACTERISTIC
/begin CHARACTERISTIC mTADSCL "SCV閉リタード量負荷依存分テーブル" CURVE 0x00011AE0 REC_UBYTE_C 0 COMP_0017 0 255
 /begin AXIS_DESCR FIX_AXIS NO_INPUT_QUANTITY COMP_0330_S 16 0 187.5 FIX_AXIS_PAR_DIST 0 1 16 /end AXIS_DESCR
/end CHARACTERISTIC
/begin CHARACTERISTIC mTADSCN "SCV閉リタード量回転補正率テーブル" CURVE 0x00011AF0 REC_UBYTE_C 0 COMP_0009 0 199.21875
 /begin AXIS_DESCR FIX_AXIS NO_INPUT_QUANTITY COMP_0347_S 16 0 6000 FIX_AXIS_PAR_DIST 0 1 16 /end AXIS_DESCR
/end CHARACTERISTIC
/begin CHARACTERISTIC mTADVC1 "ジャー音補正テーブル(水温)" CURVE 0x00011B00 REC_UBYTE_C 0 COMP_0017 0 255
 /begin AXIS_DESCR FIX_AXIS NO_INPUT_QUANTITY COMP_0348_S 16 -40 110 FIX_AXIS_PAR_DIST 0 1 16 /end AXIS_DESCR
/end CHARACTERISTIC
/begin CHARACTERISTIC mTADVC2 "ジャー音補正テーブル(エンジン回転数)" CURVE 0x00011B10 REC_UBYTE_C 0 COMP_0017 0 255
 /begin AXIS_DESCR FIX_AXIS NO_INPUT_QUANTITY COMP_0347_S 16 0 6000 FIX_AXIS_PAR_DIST 0 1 16 /end AXIS_DESCR
/end CHARACTERISTIC
/begin CHARACTERISTIC mTADVNLIM "アイドルADVリミッタテーブル（Table_of_Idle_ADV_Limiter）" CURVE 0x00011B24 REC_UBYTE_C 0 COMP_0250_S -128 127
 /begin AXIS_DESCR FIX_AXIS NO_INPUT_QUANTITY COMP_0055 16 0 60 FIX_AXIS_PAR_DIST 0 1 16 /end AXIS_DESCR
/end CHARACTERISTIC
/begin CHARACTERISTIC mTAFCLIDE "E85用Coldｽﾀｰﾄ時ﾘｰﾝ化停車時目標空燃比ﾃｰﾌﾞﾙ(Cold_start_lean_target_A/F_table(IDLE)_for_E85)" CURVE 0x00013C6A REC_UWORD_C 0 COMP_0453 0 131.07
 /begin AXIS_DESCR COM_AXIS NO_INPUT_QUANTITY COMP_0035 16 -50 65485 AXIS_PTS_REF mTXAFSFT /end AXIS_DESCR
/end CHARACTERISTIC
/begin CHARACTERISTIC mTAFCLIDL "Coldｽﾀｰﾄ時ﾘｰﾝ化停車時目標空燃比ﾃｰﾌﾞﾙ(Cold_srart_lean_target_A/F_table(IDLE))" CURVE 0x00013C8A REC_UWORD_C 0 COMP_0453 0 131.07
 /begin AXIS_DESCR COM_AXIS NO_INPUT_QUANTITY COMP_0035 16 -50 65485 AXIS_PTS_REF mTXAFSFT /end AXIS_DESCR
/end CHARACTERISTIC
/begin CHARACTERISTIC mTAFCLPRE "E85用Coldｽﾀｰﾄ時ﾘｰﾝ化走行時目標空燃比ﾃｰﾌﾞﾙ(Cold_start_lean_target_A/F_table(RUNNING)_for_E85)" CURVE 0x00013CAA REC_UWORD_C 0 COMP_0453 0 131.07
 /begin AXIS_DESCR COM_AXIS NO_INPUT_QUANTITY COMP_0035 16 -50 65485 AXIS_PTS_REF mTXAFSFT /end AXIS_DESCR
/end CHARACTERISTIC
/* AXIS -------------------------------------------------------------------- */
/begin AXIS_PTS mTADVTRSN "50rpm" 0x00011B6C NO_INPUT_QUANTITY REC_AXIS_UBYTE 0 COMP_0020 16 0 12750 /end AXIS_PTS
/begin AXIS_PTS mTADVTRSI "200/256%" 0x00011B5C NO_INPUT_QUANTITY REC_AXIS_UBYTE 0 COMP_0009 16 0 199.21875 /end AXIS_PTS
/begin AXIS_PTS mTMBTTRSN "50rpm" 0x000122BC NO_INPUT_QUANTITY REC_AXIS_UBYTE 0 COMP_0020 8 0 12750 /end AXIS_PTS
/begin AXIS_PTS mTMBTTRSI "100/128%" 0x000122B4 NO_INPUT_QUANTITY REC_AXIS_UBYTE 0 COMP_0009 8 0 199.21875 /end AXIS_PTS
/begin AXIS_PTS mLBEQFREV "12.5rpm" 0x000130CA NO_INPUT_QUANTITY REC_AXIS_UWORD 0 COMP_0006 16 0 819187.5 /end AXIS_PTS
/begin AXIS_PTS mLBEQFTP "2^-11ms" 0x000130EA NO_INPUT_QUANTITY REC_AXIS_UWORD 0 COMP_0144 16 0 31.999495335 /end AXIS_PTS
/begin AXIS_PTS mLBANGN "3.125rpm" 0x000130AA NO_INPUT_QUANTITY REC_AXIS_UWORD 0 COMP_0065 16 0 204796.875 /end AXIS_PTS
/begin AXIS_PTS mLBANGINJ "1.6μs" 0x0001308A NO_INPUT_QUANTITY REC_AXIS_UWORD 0 COMP_0157_S 16 0 104856 /end AXIS_PTS
/begin AXIS_PTS mVTCHOSNE "50rpm" 0x00012C66 NO_INPUT_QUANTITY REC_AXIS_UBYTE 0 COMP_0020 16 0 12750 /end AXIS_PTS
/begin AXIS_PTS mVTCHOSIC "100/128%" 0x00012C56 NO_INPUT_QUANTITY REC_AXIS_UBYTE 0 COMP_0009 16 0 199.21875 /end AXIS_PTS
/begin AXIS_PTS mDRTQSPAP "0.125%" 0x00012EB2 NO_INPUT_QUANTITY REC_AXIS_UWORD 0 COMP_0032_S 16 0 8191.875 /end AXIS_PTS
/begin AXIS_PTS mDRTQSPNE "3.125rpm" 0x00012ED2 NO_INPUT_QUANTITY REC_AXIS_UWORD 0 COMP_0065 16 0 204796.875 /end AXIS_PTS
/begin AXIS_PTS mDTQSPA_S "0.125%" 0x00016384 NO_INPUT_QUANTITY REC_AXIS_UWORD 0 COMP_0032_S 16 0 8191.875 /end AXIS_PTS
/begin AXIS_PTS mDTQSPN_S "3.125rpm" 0x000163A4 NO_INPUT_QUANTITY REC_AXIS_UWORD 0 COMP_0065 16 0 204796.875 /end AXIS_PTS
/begin AXIS_PTS mLMXGILM "0.000016kg/s" 0x0001333A NO_INPUT_QUANTITY REC_AXIS_UWORD 0 COMP_0304_S 16 0 1.04856 /end AXIS_PTS
/begin AXIS_PTS mLMRTBILM "2^-14-" 0x0001331A NO_INPUT_QUANTITY REC_AXIS_UWORD 0 COMP_0217 16 0 3.999941832 /end AXIS_PTS
/begin AXIS_PTS mLMFEX "0.000016kg/s" 0x0001329A NO_INPUT_QUANTITY REC_AXIS_UWORD 0 COMP_0304_S 16 0 1.04856 /end AXIS_PTS
/begin AXIS_PTS mLMFRBP "2^-14-" 0x000132BA NO_INPUT_QUANTITY REC_AXIS_UWORD 0 COMP_0217 16 0 3.999941832 /end AXIS_PTS
/begin AXIS_PTS mINEGRQH "1/128-" 0x000116BB NO_INPUT_QUANTITY REC_AXIS_UBYTE 0 COMP_0045 16 0 1.9921875 /end AXIS_PTS
/begin AXIS_PTS mINEGRPM "1.5625rpm" 0x00012FCA NO_INPUT_QUANTITY REC_AXIS_UWORD 0 COMP_0064 16 0 102398.4375 /end AXIS_PTS
/begin AXIS_PTS mTINJHNE "25rpm" 0x00011FAC NO_INPUT_QUANTITY REC_AXIS_UBYTE 0 COMP_0000 16 0 6375 /end AXIS_PTS
/begin AXIS_PTS mTINJHTI3 "160μs" 0x00011FCC NO_INPUT_QUANTITY REC_AXIS_UBYTE 0 COMP_0310_S 16 0 40800 /end AXIS_PTS
/begin AXIS_PTS mTINJHNE2 "25rpm" 0x00011FBC NO_INPUT_QUANTITY REC_AXIS_UBYTE 0 COMP_0000 16 0 6375 /end AXIS_PTS
/begin AXIS_PTS mTINJHTI4 "160μs" 0x00011FDC NO_INPUT_QUANTITY REC_AXIS_UBYTE 0 COMP_0310_S 16 0 40800 /end AXIS_PTS
/begin AXIS_PTS mLMKTEXH "1.6E-005kg/s" 0x000132FA NO_INPUT_QUANTITY REC_AXIS_UWORD 0 COMP_0304_S 16 0 1.04856 /end AXIS_PTS
/begin AXIS_PTS mLMKTBP "2^-2kPa" 0x000132DA NO_INPUT_QUANTITY REC_AXIS_UWORD 0 COMP_0312_S 16 -8192 8191.75 /end AXIS_PTS
/begin AXIS_PTS mTKNKCPN "50rpm" 0x0001216C NO_INPUT_QUANTITY REC_AXIS_UBYTE 0 COMP_0020 16 0 12750 /end AXIS_PTS
/begin AXIS_PTS mTKNKCPI "6.25%" 0x0001215C NO_INPUT_QUANTITY REC_AXIS_UBYTE 0 COMP_0246 16 0 1593.75 /end AXIS_PTS
/begin AXIS_PTS mNKTRM "50rpm" 0x00011984 NO_INPUT_QUANTITY REC_AXIS_UBYTE 0 COMP_0020 16 0 12750 /end AXIS_PTS
/begin AXIS_PTS mQKTRMT "1/128－" 0x000119E0 NO_INPUT_QUANTITY REC_AXIS_UBYTE 0 COMP_0044 16 0 1.9921875 /end AXIS_PTS
/begin AXIS_PTS mTMBTCPN "50rpm" 0x000122A4 NO_INPUT_QUANTITY REC_AXIS_UBYTE 0 COMP_0020 16 0 12750 /end AXIS_PTS
/begin AXIS_PTS mTMBTCPI "6.25%" 0x00012294 NO_INPUT_QUANTITY REC_AXIS_UBYTE 0 COMP_0246 16 0 1593.75 /end AXIS_PTS
/begin AXIS_PTS mNSENPP "2^-13-" 0x00013834 NO_INPUT_QUANTITY REC_AXIS_UWORD 0 COMP_0313_S 16 0 7.99985745 /end AXIS_PTS
/begin AXIS_PTS mNSENRR "12.5rpm" 0x00013854 NO_INPUT_QUANTITY REC_AXIS_UWORD 0 COMP_0006 16 0 819187.5 /end AXIS_PTS
/begin AXIS_PTS mTNPCHS "3.125rpm" 0x00014932 NO_INPUT_QUANTITY REC_AXIS_UWORD 0 COMP_0065 16 0 204796.875 /end AXIS_PTS
/begin AXIS_PTS mTVAPCHS "0.11deg" 0x000154D0 NO_INPUT_QUANTITY REC_AXIS_UWORD 0 COMP_0005 16 0 7208.85 /end AXIS_PTS
/begin AXIS_PTS mNETFAT "50rpm" 0x0001195C NO_INPUT_QUANTITY REC_AXIS_UBYTE 0 COMP_0020 16 0 12750 /end AXIS_PTS
/begin AXIS_PTS mITCTFAT "1/128－" 0x000116E3 NO_INPUT_QUANTITY REC_AXIS_UBYTE 0 COMP_0044 16 0 1.9921875 /end AXIS_PTS
/begin AXIS_PTS mLTPNE "3.125rpm" 0x0001353A NO_INPUT_QUANTITY REC_AXIS_UWORD 0 COMP_0065 16 0 204796.875 /end AXIS_PTS
/begin AXIS_PTS mLTPV "80/256mV" 0x0001355A NO_INPUT_QUANTITY REC_AXIS_UWORD 0 COMP_0314_S 16 0 20479.6875 /end AXIS_PTS
/begin AXIS_PTS mTVKNEENH "1.5625rpm" 0x00015510 NO_INPUT_QUANTITY REC_AXIS_UWORD 0 COMP_0064 16 0 102398.4375 /end AXIS_PTS
/begin AXIS_PTS mTVTHITEN "100/128%" 0x000155B0 NO_INPUT_QUANTITY REC_AXIS_UWORD 0 COMP_0009 16 0 51199.21875 /end AXIS_PTS
/begin AXIS_PTS mTVKNEINH "1.5625rpm" 0x00015530 NO_INPUT_QUANTITY REC_AXIS_UWORD 0 COMP_0064 16 0 102398.4375 /end AXIS_PTS
/begin AXIS_PTS mTVTHITIN "100/128%" 0x000155D0 NO_INPUT_QUANTITY REC_AXIS_UWORD 0 COMP_0009 16 0 51199.21875 /end AXIS_PTS
/begin AXIS_PTS mRONLMSNR "50rpm" 0x00011A00 NO_INPUT_QUANTITY REC_AXIS_UBYTE 0 COMP_0020 16 0 12750 /end AXIS_PTS
/begin AXIS_PTS mRONLMSIR "100/128%" 0x000119F0 NO_INPUT_QUANTITY REC_AXIS_UBYTE 0 COMP_0009 16 0 199.21875 /end AXIS_PTS
/begin AXIS_PTS mTNTAUE "3.125rpm" 0x00014952 NO_INPUT_QUANTITY REC_AXIS_UWORD 0 COMP_0065 16 0 204796.875 /end AXIS_PTS
/begin AXIS_PTS mTVATAUE "0.11deg" 0x000154F0 NO_INPUT_QUANTITY REC_AXIS_UWORD 0 COMP_0005 16 0 7208.85 /end AXIS_PTS
/begin AXIS_PTS mMTFKAPO "0.11deg" 0x00013794 NO_INPUT_QUANTITY REC_AXIS_UWORD 0 COMP_0005 16 0 7208.85 /end AXIS_PTS
/begin AXIS_PTS mMTFKVSP "0.1km/h" 0x000137B4 NO_INPUT_QUANTITY REC_AXIS_UWORD 0 COMP_0436 16 0 6553.5 /end AXIS_PTS
/begin AXIS_PTS mLTPFN1 "50rpm" 0x00011877 NO_INPUT_QUANTITY REC_AXIS_UBYTE 0 COMP_0020 16 0 12750 /end AXIS_PTS
/begin AXIS_PTS mLTPFTPN "0.125ms" 0x00011887 NO_INPUT_QUANTITY REC_AXIS_UBYTE 0 COMP_0001 16 0 31.875 /end AXIS_PTS
/begin AXIS_PTS mNTTE0 "50rpm" 0x000119B8 NO_INPUT_QUANTITY REC_AXIS_UBYTE 0 COMP_0020 16 0 12750 /end AXIS_PTS
/begin AXIS_PTS mQHTTE "100/65536%" 0x00013964 NO_INPUT_QUANTITY REC_AXIS_UWORD 0 COMP_0146 16 0 99.998480265 /end AXIS_PTS
/begin AXIS_PTS mNTTE0_S "50rpm" 0x00016313 NO_INPUT_QUANTITY REC_AXIS_UBYTE 0 COMP_0020 16 0 12750 /end AXIS_PTS
/begin AXIS_PTS mQHTTE_S "100/65536%" 0x000163F4 NO_INPUT_QUANTITY REC_AXIS_UWORD 0 COMP_0146 16 0 99.998480265 /end AXIS_PTS
/begin AXIS_PTS mTVTHNEE2 "50rpm" 0x000155F0 NO_INPUT_QUANTITY REC_AXIS_UWORD 0 COMP_0020 16 0 3276750 /end AXIS_PTS
/begin AXIS_PTS mTVTHNEIN "50rpm" 0x00015610 NO_INPUT_QUANTITY REC_AXIS_UWORD 0 COMP_0020 16 0 3276750 /end AXIS_PTS
/begin AXIS_PTS mLPWGACT "2^-5kPa" 0x000133AA NO_INPUT_QUANTITY REC_AXIS_UWORD 0 COMP_0317_S 16 0 2047.96875 /end AXIS_PTS
/begin AXIS_PTS mLPCOUT "2^-2kPa" 0x0001338A NO_INPUT_QUANTITY REC_AXIS_UWORD 0 COMP_0120_S 16 0 16383.75 /end AXIS_PTS
/begin AXIS_PTS mAPTR "0.11deg" 0x00012D72 NO_INPUT_QUANTITY REC_AXIS_UWORD 0 COMP_0005 16 0 7208.85 /end AXIS_PTS
/begin AXIS_PTS mVSTR "0.1km/h" 0x00015780 NO_INPUT_QUANTITY REC_AXIS_UWORD 0 COMP_0436 16 0 6553.5 /end AXIS_PTS
/begin AXIS_PTS mAPTR_S "0.11deg" 0x00016324 NO_INPUT_QUANTITY REC_AXIS_UWORD 0 COMP_0005 16 0 7208.85 /end AXIS_PTS
/begin AXIS_PTS mVSTR_S "0.1km/h" 0x0001677E NO_INPUT_QUANTITY REC_AXIS_UWORD 0 COMP_0436 16 0 6553.5 /end AXIS_PTS
/begin AXIS_PTS mTENGHNE "3.125rpm" 0x0001414A NO_INPUT_QUANTITY REC_AXIS_UWORD 0 COMP_0065 16 0 204796.875 /end AXIS_PTS
/begin AXIS_PTS mLTEIT "100/(128*256)%" 0x0001349A NO_INPUT_QUANTITY REC_AXIS_UWORD 0 COMP_0209_S 16 0 199.996894995 /end AXIS_PTS
/begin AXIS_PTS mLNMIS "50rpm" 0x00011787 NO_INPUT_QUANTITY REC_AXIS_UBYTE 0 COMP_0020 16 0 12750 /end AXIS_PTS
/begin AXIS_PTS mLPMIS "1/8ms" 0x000117DF NO_INPUT_QUANTITY REC_AXIS_UBYTE 0 COMP_0001 16 0 31.875 /end AXIS_PTS
/begin AXIS_PTS mLNMISLO "50rpm" 0x000117A7 NO_INPUT_QUANTITY REC_AXIS_UBYTE 0 COMP_0020 16 0 12750 /end AXIS_PTS
/begin AXIS_PTS mLPMISLO "1/8ms" 0x000117FF NO_INPUT_QUANTITY REC_AXIS_UBYTE 0 COMP_0001 16 0 31.875 /end AXIS_PTS
/begin AXIS_PTS mLNMISHTI "50rpm" 0x00011797 NO_INPUT_QUANTITY REC_AXIS_UBYTE 0 COMP_0020 16 0 12750 /end AXIS_PTS
/begin AXIS_PTS mLPMISHTI "1/8ms" 0x000117EF NO_INPUT_QUANTITY REC_AXIS_UBYTE 0 COMP_0001 16 0 31.875 /end AXIS_PTS
/begin AXIS_PTS mKHOTN "50rpm" 0x00011713 NO_INPUT_QUANTITY REC_AXIS_UBYTE 0 COMP_0020 4 0 12750 /end AXIS_PTS
/begin AXIS_PTS mKHTTP "1/128-" 0x00011717 NO_INPUT_QUANTITY REC_AXIS_UBYTE 0 COMP_0045 4 0 1.9921875 /end AXIS_PTS
/begin AXIS_PTS mMCHGKTMP "X-50℃" 0x0001191F NO_INPUT_QUANTITY REC_AXIS_UBYTE 0 COMP_0035 4 -50 205 /end AXIS_PTS
/begin AXIS_PTS mMCHGKVB "20mV" 0x00011923 NO_INPUT_QUANTITY REC_AXIS_UBYTE 0 COMP_0319_S 4 10000 15100 /end AXIS_PTS
/begin AXIS_PTS mDMPN "50rpm" 0x00011610 NO_INPUT_QUANTITY REC_AXIS_UBYTE 0 COMP_0020 4 0 12750 /end AXIS_PTS
/begin AXIS_PTS mDMPQH "1/256－" 0x00011614 NO_INPUT_QUANTITY REC_AXIS_UBYTE 0 COMP_0032 4 0 0.99609375 /end AXIS_PTS
/begin AXIS_PTS mITANN "50rpm" 0x000116DF NO_INPUT_QUANTITY REC_AXIS_UBYTE 0 COMP_0020 4 0 12750 /end AXIS_PTS
/begin AXIS_PTS mITANI "100/128%" 0x000116DB NO_INPUT_QUANTITY REC_AXIS_UBYTE 0 COMP_0009 4 0 199.21875 /end AXIS_PTS
/begin AXIS_PTS mNKUBTW "50rpm" 0x00011994 NO_INPUT_QUANTITY REC_AXIS_UBYTE 0 COMP_0020 4 0 12750 /end AXIS_PTS
/begin AXIS_PTS mLKUBTW "1/256－" 0x00011783 NO_INPUT_QUANTITY REC_AXIS_UBYTE 0 COMP_0032 4 0 0.99609375 /end AXIS_PTS
/begin AXIS_PTS mTXRN "50rpm" 0x00012C06 NO_INPUT_QUANTITY REC_AXIS_UBYTE 0 COMP_0020 4 0 12750 /end AXIS_PTS
/begin AXIS_PTS mTXRTV "0.44deg" 0x00012C0A NO_INPUT_QUANTITY REC_AXIS_UBYTE 0 COMP_0357 4 0 112.2 /end AXIS_PTS
/begin AXIS_PTS mTVTRHNE "50rpm" 0x00012B72 NO_INPUT_QUANTITY REC_AXIS_UBYTE 0 COMP_0020 4 0 12750 /end AXIS_PTS
/begin AXIS_PTS mTVTRHITE "100/128%" 0x00012B6A NO_INPUT_QUANTITY REC_AXIS_UBYTE 0 COMP_0009 4 0 199.21875 /end AXIS_PTS
/begin AXIS_PTS mTVTRHNI "50rpm" 0x00012B76 NO_INPUT_QUANTITY REC_AXIS_UBYTE 0 COMP_0020 4 0 12750 /end AXIS_PTS
/begin AXIS_PTS mTVTRHITI "100/128%" 0x00012B6E NO_INPUT_QUANTITY REC_AXIS_UBYTE 0 COMP_0009 4 0 199.21875 /end AXIS_PTS
/begin AXIS_PTS mTMDNNE "12.5rpm" 0x000122C4 NO_INPUT_QUANTITY REC_AXIS_UBYTE 0 COMP_0006 4 0 3187.5 /end AXIS_PTS
/begin AXIS_PTS mTMDNT "1count" 0x000122C8 NO_INPUT_QUANTITY REC_AXIS_UBYTE 0 COMP_0016 4 0 255 /end AXIS_PTS
/begin AXIS_PTS mTMNDNE "12.5rpm" 0x00012360 NO_INPUT_QUANTITY REC_AXIS_UBYTE 0 COMP_0006 4 0 3187.5 /end AXIS_PTS
/begin AXIS_PTS mTMNDT "1count" 0x00012364 NO_INPUT_QUANTITY REC_AXIS_UBYTE 0 COMP_0016 4 0 255 /end AXIS_PTS
/begin AXIS_PTS mSPDPGVDS "0.8km/h" 0x00011A78 NO_INPUT_QUANTITY REC_AXIS_UBYTE 0 COMP_0323_S 4 0 204 /end AXIS_PTS
/begin AXIS_PTS mSPDPGGDS "1-" 0x00011A70 NO_INPUT_QUANTITY REC_AXIS_UBYTE 0 COMP_0068 4 0 255 /end AXIS_PTS
/begin AXIS_PTS mSPDPGVSX "0.8km/h" 0x00011A7C NO_INPUT_QUANTITY REC_AXIS_UBYTE 0 COMP_0323_S 4 0 204 /end AXIS_PTS
/begin AXIS_PTS mSPDPGGPY "1-" 0x00011A74 NO_INPUT_QUANTITY REC_AXIS_UBYTE 0 COMP_0068 4 0 255 /end AXIS_PTS
/begin AXIS_PTS mTDATDN "50rpm" 0x00011CBC NO_INPUT_QUANTITY REC_AXIS_UBYTE 0 COMP_0020 4 0 12750 /end AXIS_PTS
/begin AXIS_PTS mTDATDGP "1-" 0x00011CB8 NO_INPUT_QUANTITY REC_AXIS_UBYTE 0 COMP_0068 4 0 255 /end AXIS_PTS
/begin AXIS_PTS mCDLYNEJ "50rpm" 0x000115EF NO_INPUT_QUANTITY REC_AXIS_UBYTE 0 COMP_0020 8 0 12750 /end AXIS_PTS
/begin AXIS_PTS mCDLYTWJ "1℃" 0x000115F7 NO_INPUT_QUANTITY REC_AXIS_UBYTE 0 COMP_0035 8 -50 205 /end AXIS_PTS
/begin AXIS_PTS mMXABFSFT "12.5rpm" 0x000137D4 NO_INPUT_QUANTITY REC_AXIS_UWORD 0 COMP_0006 8 0 819187.5 /end AXIS_PTS
/begin AXIS_PTS mMYABFSFT "1/2048ms" 0x000137F4 NO_INPUT_QUANTITY REC_AXIS_UWORD 0 COMP_0144 8 0 31.999495335 /end AXIS_PTS
/begin AXIS_PTS mLSTITMN "25rpm" 0x00011827 NO_INPUT_QUANTITY REC_AXIS_UBYTE 0 COMP_0000 8 0 6375 /end AXIS_PTS
/begin AXIS_PTS mLSTITMTI2 "160μs" 0x0001182F NO_INPUT_QUANTITY REC_AXIS_UBYTE 0 COMP_0310_S 8 0 40800 /end AXIS_PTS
/begin AXIS_PTS mMADVIT2N "12.5rpm" 0x000118F7 NO_INPUT_QUANTITY REC_AXIS_UBYTE 0 COMP_0006 8 0 3187.5 /end AXIS_PTS
/begin AXIS_PTS mMADVIT2I "100/128%" 0x000118EF NO_INPUT_QUANTITY REC_AXIS_UBYTE 0 COMP_0009 8 0 199.21875 /end AXIS_PTS
/begin AXIS_PTS mLPINJNE "12.5rpm" 0x000117C7 NO_INPUT_QUANTITY REC_AXIS_UBYTE 0 COMP_0006 8 0 3187.5 /end AXIS_PTS
/begin AXIS_PTS mTLPINJTI2 "1/8ms" 0x00012254 NO_INPUT_QUANTITY REC_AXIS_UBYTE 0 COMP_0001 8 0 31.875 /end AXIS_PTS
/begin AXIS_PTS mMYAFEXP "12.5rpm" 0x00013804 NO_INPUT_QUANTITY REC_AXIS_UWORD 0 COMP_0006 8 0 819187.5 /end AXIS_PTS
/begin AXIS_PTS mMXAFEXP "0.78125%" 0x000137E4 NO_INPUT_QUANTITY REC_AXIS_UWORD 0 COMP_0009 8 0 51199.21875 /end AXIS_PTS
/begin AXIS_PTS mTALTRPM "50rpm" 0x00011B8C NO_INPUT_QUANTITY REC_AXIS_UBYTE 0 COMP_0020 8 0 12750 /end AXIS_PTS
/begin AXIS_PTS mTALTTRQ "0.5Nm" 0x00011B94 NO_INPUT_QUANTITY REC_AXIS_UBYTE 0 COMP_0131_S 8 0 127.5 /end AXIS_PTS
/begin AXIS_PTS mTALTCUR "1A" 0x00011B84 NO_INPUT_QUANTITY REC_AXIS_UBYTE 0 COMP_0045_S 8 0 255 /end AXIS_PTS
/begin AXIS_PTS mNFLD4 "25rpm" 0x0001196C NO_INPUT_QUANTITY REC_AXIS_UBYTE 0 COMP_0000 8 0 6375 /end AXIS_PTS
/begin AXIS_PTS mQFLD4 "1/256－" 0x000119D8 NO_INPUT_QUANTITY REC_AXIS_UBYTE 0 COMP_0032 8 0 0.99609375 /end AXIS_PTS
/begin AXIS_PTS mTCBADVGN "50rpm" 0x00011C2C NO_INPUT_QUANTITY REC_AXIS_UBYTE 0 COMP_0020 8 0 12750 /end AXIS_PTS
/begin AXIS_PTS mTCBADVGI "100/128%" 0x00011C24 NO_INPUT_QUANTITY REC_AXIS_UBYTE 0 COMP_0009 8 0 199.21875 /end AXIS_PTS
/begin AXIS_PTS mTTCOSTG "1km/h" 0x00012812 NO_INPUT_QUANTITY REC_AXIS_UBYTE 0 COMP_0429 8 0 255 /end AXIS_PTS
/begin AXIS_PTS mLDATCTNE "12.5rpm" 0x0001315A NO_INPUT_QUANTITY REC_AXIS_UWORD 0 COMP_0006 8 0 819187.5 /end AXIS_PTS
/begin AXIS_PTS mLDATCTTP "2^-11ms" 0x0001316A NO_INPUT_QUANTITY REC_AXIS_UWORD 0 COMP_0144 8 0 31.999495335 /end AXIS_PTS
/begin AXIS_PTS mLFRBMN "12.5rpm" 0x0001174B NO_INPUT_QUANTITY REC_AXIS_UBYTE 0 COMP_0006 8 0 3187.5 /end AXIS_PTS
/begin AXIS_PTS mLFRBTW "0.625X-40℃" 0x00011753 NO_INPUT_QUANTITY REC_AXIS_UBYTE 0 COMP_0356 8 -40 119.375 /end AXIS_PTS
/begin AXIS_PTS mTVTCNE3 "50rpm" 0x00012B0A NO_INPUT_QUANTITY REC_AXIS_UBYTE 0 COMP_0020 8 0 12750 /end AXIS_PTS
/begin AXIS_PTS mTVTCAGL2 "64/128degCA" 0x00012AEA NO_INPUT_QUANTITY REC_AXIS_UBYTE 0 COMP_0256 8 -64 63.5 /end AXIS_PTS
/begin AXIS_PTS mNMKITAST "12.5rpm" 0x000119A0 NO_INPUT_QUANTITY REC_AXIS_UBYTE 0 COMP_0006 8 0 3187.5 /end AXIS_PTS
/begin AXIS_PTS mTPMITAST "1/8ms" 0x0001254C NO_INPUT_QUANTITY REC_AXIS_UBYTE 0 COMP_0001 8 0 31.875 /end AXIS_PTS
/begin AXIS_PTS mITANDNE "50rpm" 0x000116CB NO_INPUT_QUANTITY REC_AXIS_UBYTE 0 COMP_0020 8 0 12750 /end AXIS_PTS
/begin AXIS_PTS mITANDQH "1/256－" 0x000116D3 NO_INPUT_QUANTITY REC_AXIS_UBYTE 0 COMP_0032 8 0 0.99609375 /end AXIS_PTS
/begin AXIS_PTS mTKFBLMTN "12.5rpm" 0x000146D2 NO_INPUT_QUANTITY REC_AXIS_UWORD 0 COMP_0006 8 0 819187.5 /end AXIS_PTS
/begin AXIS_PTS mTKFBLMTI "0.0030517578125%" 0x000146C2 NO_INPUT_QUANTITY REC_AXIS_UWORD 0 COMP_0209_S 8 0 199.996894995 /end AXIS_PTS
/begin AXIS_PTS mTADVTRMN "50rpm" 0x00011B54 NO_INPUT_QUANTITY REC_AXIS_UBYTE 0 COMP_0020 8 0 12750 /end AXIS_PTS
/begin AXIS_PTS mTADVTRMI "100/128%" 0x00011B4C NO_INPUT_QUANTITY REC_AXIS_UBYTE 0 COMP_0009 8 0 199.21875 /end AXIS_PTS
/begin AXIS_PTS mLTCVTCIV "64/128degCA" 0x00011847 NO_INPUT_QUANTITY REC_AXIS_UBYTE 0 COMP_0256 8 -64 63.5 /end AXIS_PTS
/begin AXIS_PTS mLTCVTCQH "1/256-" 0x0001184F NO_INPUT_QUANTITY REC_AXIS_UBYTE 0 COMP_0063 8 0 0.99609375 /end AXIS_PTS
/begin AXIS_PTS mTOPDTRSN "50rpm" 0x000124DC NO_INPUT_QUANTITY REC_AXIS_UBYTE 0 COMP_0020 8 0 12750 /end AXIS_PTS
/begin AXIS_PTS mTOPDTRSI "100/128%" 0x000124D4 NO_INPUT_QUANTITY REC_AXIS_UBYTE 0 COMP_0009 8 0 199.21875 /end AXIS_PTS
/begin AXIS_PTS mPFCAMBBP "20/256mv" 0x000138E4 NO_INPUT_QUANTITY REC_AXIS_UWORD 0 COMP_0486 8 0 5119.921875 /end AXIS_PTS
/begin AXIS_PTS mPFCNEBP "3.125rpm" 0x000138F4 NO_INPUT_QUANTITY REC_AXIS_UWORD 0 COMP_0065 8 0 204796.875 /end AXIS_PTS
/begin AXIS_PTS mPFVSPBP "0.1km/h" 0x00013914 NO_INPUT_QUANTITY REC_AXIS_UWORD 0 COMP_0436 8 0 6553.5 /end AXIS_PTS
/begin AXIS_PTS mPFDMFBP "100/65280%" 0x00013904 NO_INPUT_QUANTITY REC_AXIS_UWORD 0 COMP_0335_S 8 0 100.39057617 /end AXIS_PTS
/begin AXIS_PTS mPFVSPB_S "0.1km/h" 0x000163E4 NO_INPUT_QUANTITY REC_AXIS_UWORD 0 COMP_0436 8 0 6553.5 /end AXIS_PTS
/begin AXIS_PTS mPFDMFB_S "100/65280%" 0x000163D4 NO_INPUT_QUANTITY REC_AXIS_UWORD 0 COMP_0335_S 8 0 100.39057617 /end AXIS_PTS
/begin AXIS_PTS mNQHITAC "50rpm" 0x000119A8 NO_INPUT_QUANTITY REC_AXIS_UBYTE 0 COMP_0020 8 0 12750 /end AXIS_PTS
/begin AXIS_PTS mTSQHITAC "1/128-" 0x00012766 NO_INPUT_QUANTITY REC_AXIS_UBYTE 0 COMP_0045 8 0 1.9921875 /end AXIS_PTS
/begin AXIS_PTS mTXDLAV "1deg" 0x000156A0 NO_INPUT_QUANTITY REC_AXIS_UWORD 0 COMP_0017 8 0 65535 /end AXIS_PTS
/begin AXIS_PTS mTXNEC "12.5rpm" 0x000156E0 NO_INPUT_QUANTITY REC_AXIS_UWORD 0 COMP_0006 8 0 819187.5 /end AXIS_PTS
/begin AXIS_PTS mLPINJTI2 "160μs" 0x000117CF NO_INPUT_QUANTITY REC_AXIS_UBYTE 0 COMP_0310_S 8 0 40800 /end AXIS_PTS
/begin AXIS_PTS mLPINJTTP "1/8ms" 0x000117D7 NO_INPUT_QUANTITY REC_AXIS_UBYTE 0 COMP_0001 8 0 31.875 /end AXIS_PTS
/begin AXIS_PTS mHOSGHN "50rpm" 0x000116A9 NO_INPUT_QUANTITY REC_AXIS_UBYTE 0 COMP_0020 8 0 12750 /end AXIS_PTS
/begin AXIS_PTS mHOSGI "100/128%" 0x000116B1 NO_INPUT_QUANTITY REC_AXIS_UBYTE 0 COMP_0009 8 0 199.21875 /end AXIS_PTS
/begin AXIS_PTS mTCVHOSN "50rpm" 0x00011CB0 NO_INPUT_QUANTITY REC_AXIS_UBYTE 0 COMP_0020 8 0 12750 /end AXIS_PTS
/begin AXIS_PTS mTCVHOSI "100/128%" 0x00011CA8 NO_INPUT_QUANTITY REC_AXIS_UBYTE 0 COMP_0009 8 0 199.21875 /end AXIS_PTS
/begin AXIS_PTS mTTEXN "50rpm" 0x000128B2 NO_INPUT_QUANTITY REC_AXIS_UBYTE 0 COMP_0020 8 0 12750 /end AXIS_PTS
/begin AXIS_PTS mTTEXTP "1/8ms" 0x000128BA NO_INPUT_QUANTITY REC_AXIS_UBYTE 0 COMP_0001 8 0 31.875 /end AXIS_PTS
/begin AXIS_PTS mTVTCNEEN "50rpm" 0x00015590 NO_INPUT_QUANTITY REC_AXIS_UWORD 0 COMP_0020 8 0 3276750 /end AXIS_PTS
/begin AXIS_PTS mTVTCITEN "100/128%" 0x00015570 NO_INPUT_QUANTITY REC_AXIS_UWORD 0 COMP_0009 8 0 51199.21875 /end AXIS_PTS
/begin AXIS_PTS mTVTCNEIN "50rpm" 0x000155A0 NO_INPUT_QUANTITY REC_AXIS_UWORD 0 COMP_0020 8 0 3276750 /end AXIS_PTS
/begin AXIS_PTS mTVTCITIN "100/128%" 0x00015580 NO_INPUT_QUANTITY REC_AXIS_UWORD 0 COMP_0009 8 0 51199.21875 /end AXIS_PTS
/begin AXIS_PTS mTNERU "3.125rpm" 0x000148E2 NO_INPUT_QUANTITY REC_AXIS_UWORD 0 COMP_0065 8 0 204796.875 /end AXIS_PTS
/begin AXIS_PTS mTITACRU "2^-7%" 0x000146B2 NO_INPUT_QUANTITY REC_AXIS_UWORD 0 COMP_0329 8 0 511.9921875 /end AXIS_PTS
/begin AXIS_PTS mSLMTOIVS "0.1km/h" 0x00013B22 NO_INPUT_QUANTITY REC_AXIS_UWORD 0 COMP_0436 8 0 6553.5 /end AXIS_PTS
/begin AXIS_PTS mSLMTOTAN "X-50℃" 0x00013B32 NO_INPUT_QUANTITY REC_AXIS_UWORD 0 COMP_0035 8 -50 65485 /end AXIS_PTS
/begin AXIS_PTS mTEHOSRTO "1/1024-" 0x0001411A NO_INPUT_QUANTITY REC_AXIS_UWORD 0 COMP_0450 8 0 63.999056205 /end AXIS_PTS
/begin AXIS_PTS mTEHOSNE "3.125rpm" 0x0001410A NO_INPUT_QUANTITY REC_AXIS_UWORD 0 COMP_0065 8 0 204796.875 /end AXIS_PTS
/begin AXIS_PTS mTTMRNRPM "12.5rpm" 0x00015240 NO_INPUT_QUANTITY REC_AXIS_UWORD 0 COMP_0006 8 0 819187.5 /end AXIS_PTS
/begin AXIS_PTS mTTMRITAC "0.78125%" 0x00015230 NO_INPUT_QUANTITY REC_AXIS_UWORD 0 COMP_0009 8 0 51199.21875 /end AXIS_PTS
/begin AXIS_PTS mTTRARIDX "0.001-" 0x000153C0 NO_INPUT_QUANTITY REC_AXIS_UWORD 0 COMP_0182_S 8 0 65.535 /end AXIS_PTS
/begin AXIS_PTS mTTRARNE "12.5rpm" 0x000153D0 NO_INPUT_QUANTITY REC_AXIS_UWORD 0 COMP_0006 8 0 819187.5 /end AXIS_PTS
/begin AXIS_PTS mVCMAPNE "50rpm" 0x00015760 NO_INPUT_QUANTITY REC_AXIS_UWORD 0 COMP_0020 8 0 3276750 /end AXIS_PTS
/begin AXIS_PTS mVCMAPOT "X-50℃" 0x00015770 NO_INPUT_QUANTITY REC_AXIS_UWORD 0 COMP_0035 8 -50 65485 /end AXIS_PTS
/begin AXIS_PTS mTXAFSFT "x-50℃" 0x00015640 NO_INPUT_QUANTITY REC_AXIS_UWORD 0 COMP_0035 16 -50 65485 /end AXIS_PTS
/begin AXIS_PTS mNTTE0WD "3.125rpm" 0x00013874 NO_INPUT_QUANTITY REC_AXIS_UWORD 0 COMP_0065 16 0 204796.875 /end AXIS_PTS
/begin AXIS_PTS mDSPOFSBP "0.01km/h" 0x00012F12 NO_INPUT_QUANTITY REC_AXIS_UWORD 0 COMP_0238_S 16 0 655.35 /end AXIS_PTS
/begin AXIS_PTS mADVPIAT "1deg" 0x00011569 NO_INPUT_QUANTITY REC_AXIS_UBYTE 0 COMP_0017 16 0 255 /end AXIS_PTS
/* COMPU_METHOD --------------------------------------------------------- */
/begin COMPU_METHOD COMP_0017 "1deg" RAT_FUNC "%8.2" "deg" COEFFS 0 1 0 0 0 1 /end COMPU_METHOD
/begin COMPU_METHOD COMP_0004 "1－" RAT_FUNC "%8.2" "－" COEFFS 0 1 0 0 0 1 /end COMPU_METHOD
/begin COMPU_METHOD COMP_0068 "1-" RAT_FUNC "%8.2" "-" COEFFS 0 1 0 0 0 1 /end COMPU_METHOD
/begin COMPU_METHOD COMP_0002_S "1Pa" RAT_FUNC "%8.2" "Pa" COEFFS 0 1 0 0 0 1 /end COMPU_METHOD
/begin COMPU_METHOD COMP_0013 "1s" RAT_FUNC "%8.2" "s" COEFFS 0 1 0 0 0 1 /end COMPU_METHOD
/begin COMPU_METHOD COMP_0014 "10ms" RAT_FUNC "%8.2" "ms" COEFFS 0 1 0 0 0 10 /end COMPU_METHOD
/begin COMPU_METHOD COMP_0045 "1/128-" RAT_FUNC "%8.4" "-" COEFFS 0 1 0 0 0 0.0078125 /end COMPU_METHOD
/begin COMPU_METHOD COMP_0009 "100/128%" RAT_FUNC "%8.2" "%" COEFFS 0 1 0 0 0 0.78125 /end COMPU_METHOD
/begin COMPU_METHOD COMP_0000 "25rpm" RAT_FUNC "%8.2" "rpm" COEFFS 0 1 0 0 0 25 /end COMPU_METHOD
/begin COMPU_METHOD COMP_0186 "1/64-" RAT_FUNC "%8.3" "-" COEFFS 0 1 0 0 0 0.015625 /end COMPU_METHOD
/begin COMPU_METHOD COMP_0001 "1/8ms" RAT_FUNC "%8.2" "ms" COEFFS 0 1 0 0 0 0.125 /end COMPU_METHOD
/begin COMPU_METHOD COMP_0020 "50rpm" RAT_FUNC "%8.2" "rpm" COEFFS 0 1 0 0 0 50 /end COMPU_METHOD
/begin COMPU_METHOD COMP_0004_S "X-50degC" RAT_FUNC "%8.2" "degC" COEFFS 0 1 50 0 0 1 /end COMPU_METHOD
/begin COMPU_METHOD COMP_0373 "1/100-" RAT_FUNC "%8.3" "-" COEFFS 0 1 0 0 0 0.01 /end COMPU_METHOD
/begin COMPU_METHOD COMP_0003 "1℃" RAT_FUNC "%8.2" "℃" COEFFS 0 1 0 0 0 1 /end COMPU_METHOD
/begin COMPU_METHOD COMP_0035 "X-50℃" RAT_FUNC "%8.2" "℃" COEFFS 0 1 50 0 0 1 /end COMPU_METHOD
/begin COMPU_METHOD COMP_0453 "0.002-" RAT_FUNC "%8.4" "-" COEFFS 0 1 0 0 0 0.002 /end COMPU_METHOD
/begin COMPU_METHOD COMP_0005 "0.11deg" RAT_FUNC "%8.2" "deg" COEFFS 0 1 0 0 0 0.11 /end COMPU_METHOD
/begin COMPU_METHOD COMP_0006 "12.5rpm" RAT_FUNC "%8.2" "rpm" COEFFS 0 1 0 0 0 12.5 /end COMPU_METHOD
/begin COMPU_METHOD COMP_0008 "100ms" RAT_FUNC "%8.2" "ms" COEFFS 0 1 0 0 0 100 /end COMPU_METHOD
/begin COMPU_METHOD COMP_0011 "0.02MPa" RAT_FUNC "%8.3" "MPa" COEFFS 0 1 0 0 0 0.02 /end COMPU_METHOD
/begin COMPU_METHOD COMP_0007 "2km/h" RAT_FUNC "%8.2" "km/h" COEFFS 0 1 0 0 0 2 /end COMPU_METHOD
/begin COMPU_METHOD COMP_0047 "0.5%" RAT_FUNC "%8.2" "%" COEFFS 0 1 0 0 0 0.5 /end COMPU_METHOD
/begin COMPU_METHOD COMP_0486 "20/256mv" RAT_FUNC "%8.3" "mv" COEFFS 0 1 0 0 0 0.078125 /end COMPU_METHOD
/begin COMPU_METHOD COMP_0217 "1/16384-" RAT_FUNC "%8.6" "-" COEFFS 0 1 0 0 0 0.0000610352 /end COMPU_METHOD
/begin COMPU_METHOD COMP_0023 "5mV" RAT_FUNC "%8.2" "mV" COEFFS 0 1 0 0 0 5 /end COMPU_METHOD
/begin COMPU_METHOD COMP_0033 "80mV" RAT_FUNC "%8.2" "mV" COEFFS 0 1 0 0 0 80 /end COMPU_METHOD
/begin COMPU_METHOD COMP_0027 "1%" RAT_FUNC "%8.2" "%" COEFFS 0 1 0 0 0 1 /end COMPU_METHOD
/begin COMPU_METHOD COMP_0015_S "0.1sec" RAT_FUNC "%8.2" "sec" COEFFS 0 1 0 0 0 0.1 /end COMPU_METHOD
/begin COMPU_METHOD COMP_0017_S "0.01sec" RAT_FUNC "%8.3" "sec" COEFFS 0 1 0 0 0 0.01 /end COMPU_METHOD
/begin COMPU_METHOD COMP_0061 "5mv" RAT_FUNC "%8.2" "mv" COEFFS 0 1 0 0 0 5 /end COMPU_METHOD
/begin COMPU_METHOD COMP_0049 "1sec" RAT_FUNC "%8.2" "sec" COEFFS 0 1 0 0 0 1 /end COMPU_METHOD
/begin COMPU_METHOD COMP_0032 "1/256－" RAT_FUNC "%8.4" "－" COEFFS 0 1 0 0 0 0.00390625 /end COMPU_METHOD
/begin COMPU_METHOD COMP_0132 "1/512－" RAT_FUNC "%8.4" "－" COEFFS 0 1 0 0 0 0.001953125 /end COMPU_METHOD
/begin COMPU_METHOD COMP_0063 "1/256-" RAT_FUNC "%8.4" "-" COEFFS 0 1 0 0 0 0.00390625 /end COMPU_METHOD
/begin COMPU_METHOD COMP_0019_S "1/255-" RAT_FUNC "%8.4" "-" COEFFS 0 1 0 0 0 0.003921569 /end COMPU_METHOD
/begin COMPU_METHOD COMP_0030 "1回" RAT_FUNC "%8.2" "回" COEFFS 0 1 0 0 0 1 /end COMPU_METHOD
/begin COMPU_METHOD COMP_0016 "1count" RAT_FUNC "%8.2" "count" COEFFS 0 1 0 0 0 1 /end COMPU_METHOD
/begin COMPU_METHOD COMP_0443 "1rpm" RAT_FUNC "%8.2" "rpm" COEFFS 0 1 0 0 0 1 /end COMPU_METHOD
/begin COMPU_METHOD COMP_0436 "0.1km/h" RAT_FUNC "%8.2" "km/h" COEFFS 0 1 0 0 0 0.1 /end COMPU_METHOD
/begin COMPU_METHOD COMP_0263 "1-" RAT_FUNC "%8.2" "-" COEFFS 0 1 0 0 0 1 /end COMPU_METHOD
/begin COMPU_METHOD COMP_0025_S "1回" RAT_FUNC "%8.2" "回" COEFFS 0 1 0 0 0 1 /end COMPU_METHOD
/begin COMPU_METHOD COMP_0256 "64/128degCA" RAT_FUNC "%8.2" "degCA" COEFFS 0 1 64 0 0 0.5 /end COMPU_METHOD
/begin COMPU_METHOD COMP_0065 "3.125rpm" RAT_FUNC "%8.2" "rpm" COEFFS 0 1 0 0 0 3.125 /end COMPU_METHOD
/begin COMPU_METHOD COMP_0048 "64/128degCA" RAT_FUNC "%8.2" "degCA" COEFFS 0 1 0 0 0 0.5 /end COMPU_METHOD
/begin COMPU_METHOD COMP_0032_S "0.125%" RAT_FUNC "%8.2" "%" COEFFS 0 1 0 0 0 0.125 /end COMPU_METHOD
/begin COMPU_METHOD COMP_0034_S "2^-8kPa" RAT_FUNC "%8.4" "kPa" COEFFS 0 1 0 0 0 0.00390625 /end COMPU_METHOD
/begin COMPU_METHOD COMP_0040_S "0.01s" RAT_FUNC "%8.3" "s" COEFFS 0 1 0 0 0 0.01 /end COMPU_METHOD
/begin COMPU_METHOD COMP_0044 "1/128－" RAT_FUNC "%8.4" "－" COEFFS 0 1 0 0 0 0.0078125 /end COMPU_METHOD
/begin COMPU_METHOD COMP_0045_S "1A" RAT_FUNC "%8.2" "A" COEFFS 0 1 0 0 0 1 /end COMPU_METHOD
/begin COMPU_METHOD COMP_0054 "20mV" RAT_FUNC "%8.2" "mV" COEFFS 0 1 0 0 0 20 /end COMPU_METHOD
/begin COMPU_METHOD COMP_0450 "1/1024-" RAT_FUNC "%8.5" "-" COEFFS 0 1 0 0 0 0.000976563 /end COMPU_METHOD
/begin COMPU_METHOD COMP_0057_S "0.1deg" RAT_FUNC "%8.2" "deg" COEFFS 0 1 0 0 0 0.1 /end COMPU_METHOD
/begin COMPU_METHOD COMP_0055 "4deg" RAT_FUNC "%8.2" "deg" COEFFS 0 1 0 0 0 4 /end COMPU_METHOD
/begin COMPU_METHOD COMP_0290 "1/65536-" RAT_FUNC "%8.6" "-" COEFFS 0 1 0 0 0 0.0000152588 /end COMPU_METHOD
/begin COMPU_METHOD COMP_0144 "1/2048ms" RAT_FUNC "%8.5" "ms" COEFFS 0 1 0 0 0 0.000488281 /end COMPU_METHOD
/begin COMPU_METHOD COMP_0066_S "0.1degC" RAT_FUNC "%8.2" "degC" COEFFS 0 1 0 0 0 0.1 /end COMPU_METHOD
/begin COMPU_METHOD COMP_0067_S "0.5A" RAT_FUNC "%8.2" "A" COEFFS 0 1 0 0 0 0.5 /end COMPU_METHOD
/begin COMPU_METHOD COMP_0069_S "1℃" RAT_FUNC "%8.2" "℃" COEFFS 0 1 50 0 0 1 /end COMPU_METHOD
/begin COMPU_METHOD COMP_0021 "100/256%" RAT_FUNC "%8.2" "%" COEFFS 0 1 0 0 0 0.390625 /end COMPU_METHOD
/begin COMPU_METHOD COMP_0456 "1/(256×128)-" RAT_FUNC "%8.6" "-" COEFFS 0 1 0 0 0 0.0000305176 /end COMPU_METHOD
/begin COMPU_METHOD COMP_0087_S "0.07808MPa" RAT_FUNC "%8.3" "MPa" COEFFS 0 1 0 0 0 0.07808 /end COMPU_METHOD
/begin COMPU_METHOD COMP_0089_S "3.6_*_2^-22km/h/50m" RAT_FUNC "%8.6" "km/h/50m" COEFFS 0 1 0 0 0 0.000000858307 /end COMPU_METHOD
/begin COMPU_METHOD COMP_0234 "10sec" RAT_FUNC "%8.2" "sec" COEFFS 0 1 0 0 0 10 /end COMPU_METHOD
/begin COMPU_METHOD COMP_0050 "5/64mV" RAT_FUNC "%8.3" "mV" COEFFS 0 1 0 0 0 0.078125 /end COMPU_METHOD
/begin COMPU_METHOD COMP_0196 "0.1Nm" RAT_FUNC "%8.2" "Nm" COEFFS 0 1 0 0 0 0.1 /end COMPU_METHOD
/begin COMPU_METHOD COMP_0104 "10mV" RAT_FUNC "%8.2" "mV" COEFFS 0 1 0 0 0 10 /end COMPU_METHOD
/begin COMPU_METHOD COMP_0190 "2deg" RAT_FUNC "%8.2" "deg" COEFFS 0 1 0 0 0 2 /end COMPU_METHOD
/begin COMPU_METHOD COMP_0108_S "64/128degCA" RAT_FUNC "%8.2" "degCA" COEFFS 0 1 16384 0 0 0.5 /end COMPU_METHOD
/begin COMPU_METHOD COMP_0295 "100msec" RAT_FUNC "%8.2" "msec" COEFFS 0 1 0 0 0 100 /end COMPU_METHOD
/begin COMPU_METHOD COMP_0120_S "0.25kPa" RAT_FUNC "%8.2" "kPa" COEFFS 0 1 0 0 0 0.25 /end COMPU_METHOD
/begin COMPU_METHOD COMP_0064 "1.5625rpm" RAT_FUNC "%8.2" "rpm" COEFFS 0 1 0 0 0 1.5625 /end COMPU_METHOD
/begin COMPU_METHOD COMP_0146 "100/256/256%" RAT_FUNC "%8.4" "%" COEFFS 0 1 0 0 0 0.001525879 /end COMPU_METHOD
/begin COMPU_METHOD COMP_0130_S "0.001G" RAT_FUNC "%8.4" "G" COEFFS 0 1 0 0 0 0.001 /end COMPU_METHOD
/begin COMPU_METHOD COMP_0131_S "0.5Nm" RAT_FUNC "%8.2" "Nm" COEFFS 0 1 0 0 0 0.5 /end COMPU_METHOD
/begin COMPU_METHOD COMP_0144_S "3.6_*_2^-22km/h" RAT_FUNC "%8.6" "km/h" COEFFS 0 1 0 0 0 0.000000858307 /end COMPU_METHOD
/begin COMPU_METHOD COMP_0152_S "6.4μs" RAT_FUNC "%8.2" "μs" COEFFS 0 1 0 0 0 6.4 /end COMPU_METHOD
/begin COMPU_METHOD COMP_0157_S "1.6μs" RAT_FUNC "%8.2" "μs" COEFFS 0 1 0 0 0 1.6 /end COMPU_METHOD
/begin COMPU_METHOD COMP_0193 "0.1Nm/10ms" RAT_FUNC "%8.2" "Nm/10ms" COEFFS 0 1 0 0 0 0.1 /end COMPU_METHOD
/begin COMPU_METHOD COMP_0062 "4℃" RAT_FUNC "%8.2" "℃" COEFFS 0 1 0 0 0 4 /end COMPU_METHOD
/begin COMPU_METHOD COMP_0175_S "1/2561/10ms" RAT_FUNC "%8.4" "1/10ms" COEFFS 0 1 0 0 0 0.00390625 /end COMPU_METHOD
/begin COMPU_METHOD COMP_0178_S "2*10^-5sec" RAT_FUNC "%8.6" "sec" COEFFS 0 1 0 0 0 0.00002 /end COMPU_METHOD
/begin COMPU_METHOD COMP_0182_S "0.001-" RAT_FUNC "%8.4" "-" COEFFS 0 1 0 0 0 0.001 /end COMPU_METHOD
/begin COMPU_METHOD COMP_0201_S "0.125oct" RAT_FUNC "%8.2" "oct" COEFFS 0 1 -75 0 0 0.125 /end COMPU_METHOD
/begin COMPU_METHOD COMP_0024 "50ms" RAT_FUNC "%8.2" "ms" COEFFS 0 1 0 0 0 50 /end COMPU_METHOD
/begin COMPU_METHOD COMP_0209_S "100/32768%" RAT_FUNC "%8.4" "%" COEFFS 0 1 0 0 0 0.003051757 /end COMPU_METHOD
/begin COMPU_METHOD COMP_0214_S "1E-05-" RAT_FUNC "%8.6" "-" COEFFS 0 1 0 0 0 0.00001 /end COMPU_METHOD
/begin COMPU_METHOD COMP_0238_S "0.01km/h" RAT_FUNC "%8.3" "km/h" COEFFS 0 1 0 0 0 0.01 /end COMPU_METHOD
/begin COMPU_METHOD COMP_0314 "X-128deg" RAT_FUNC "%8.2" "deg" COEFFS 0 1 128 0 0 1 /end COMPU_METHOD
/begin COMPU_METHOD COMP_0250_S "X-128deg" RAT_FUNC "%8.2" "deg" COEFFS 0 1 128 0 0 1 /end COMPU_METHOD
/begin COMPU_METHOD COMP_0254_S "X-50deg" RAT_FUNC "%8.2" "deg" COEFFS 0 1 50 0 0 1 /end COMPU_METHOD
/begin COMPU_METHOD COMP_0429 "1km/h" RAT_FUNC "%8.2" "km/h" COEFFS 0 1 0 0 0 1 /end COMPU_METHOD
/begin COMPU_METHOD COMP_0356 "0.625X-40℃" RAT_FUNC "%8.2" "℃" COEFFS 0 1 40 0 0 0.625 /end COMPU_METHOD
/begin COMPU_METHOD COMP_0265_S "0.005-" RAT_FUNC "%8.4" "-" COEFFS 0 1 0 0 0 0.005 /end COMPU_METHOD
/begin COMPU_METHOD COMP_0355 "1/256s" RAT_FUNC "%8.4" "s" COEFFS 0 1 0 0 0 0.00390625 /end COMPU_METHOD
/begin COMPU_METHOD COMP_0268_S "0.01km/h/10m" RAT_FUNC "%8.3" "km/h/10m" COEFFS 0 1 0 0 0 0.01 /end COMPU_METHOD
/begin COMPU_METHOD COMP_0269_S "128(mv^2)se" RAT_FUNC "%8.2" "(mv^2)se" COEFFS 0 1 0 0 0 128 /end COMPU_METHOD
/begin COMPU_METHOD COMP_0270_S "1E-6m**3" RAT_FUNC "%8.6" "m**3" COEFFS 0 1 0 0 0 0.000001 /end COMPU_METHOD
/begin COMPU_METHOD COMP_0271_S "1/256degCA" RAT_FUNC "%8.4" "degCA" COEFFS 0 1 0 0 0 0.00390625 /end COMPU_METHOD
/begin COMPU_METHOD COMP_0272_S "0.00000005A*sec/de" RAT_FUNC "%8.6" "A*sec/de" COEFFS 0 1 0 0 0 0.00000005 /end COMPU_METHOD
/begin COMPU_METHOD COMP_0273_S "0.000008A/degCA/" RAT_FUNC "%8.6" "A/degCA/" COEFFS 0 1 0 0 0 0.000008 /end COMPU_METHOD
/begin COMPU_METHOD COMP_0274_S "0.000002A/degCA" RAT_FUNC "%8.6" "A/degCA" COEFFS 0 1 0 0 0 0.000002 /end COMPU_METHOD
/begin COMPU_METHOD COMP_0275_S "0.00001sec" RAT_FUNC "%8.6" "sec" COEFFS 0 1 0 0 0 0.00001 /end COMPU_METHOD
/begin COMPU_METHOD COMP_0276_S "0.2degCA/se" RAT_FUNC "%8.2" "degCA/se" COEFFS 0 1 0 0 0 0.2 /end COMPU_METHOD
/begin COMPU_METHOD COMP_0277_S "0.000005sec" RAT_FUNC "%8.6" "sec" COEFFS 0 1 0 0 0 0.000005 /end COMPU_METHOD
/begin COMPU_METHOD COMP_0278_S "0.0051/sec" RAT_FUNC "%8.4" "1/sec" COEFFS 0 1 0 0 0 0.005 /end COMPU_METHOD
/begin COMPU_METHOD COMP_0279_S "0.0002-" RAT_FUNC "%8.5" "-" COEFFS 0 1 0 0 0 0.0002 /end COMPU_METHOD
/begin COMPU_METHOD COMP_0280_S "0.01Sec" RAT_FUNC "%8.3" "Sec" COEFFS 0 1 0 0 0 0.01 /end COMPU_METHOD
/begin COMPU_METHOD COMP_0281_S "--/50ms" RAT_FUNC "%8.2" "-/50ms" COEFFS 0 1 0 0 0 1 /end COMPU_METHOD
/begin COMPU_METHOD COMP_0362 "25cc" RAT_FUNC "%8.2" "cc" COEFFS 0 1 0 0 0 25 /end COMPU_METHOD
/begin COMPU_METHOD COMP_0282_S "0.00005-" RAT_FUNC "%8.6" "-" COEFFS 0 1 0 0 0 0.00005 /end COMPU_METHOD
/begin COMPU_METHOD COMP_0283_S "1/255-" RAT_FUNC "%8.4" "-" COEFFS 0 1 0 0 0 0.003921569 /end COMPU_METHOD
/begin COMPU_METHOD COMP_0284_S "0.011/sec" RAT_FUNC "%8.3" "1/sec" COEFFS 0 1 0 0 0 0.01 /end COMPU_METHOD
/begin COMPU_METHOD COMP_0285_S "0.00002-" RAT_FUNC "%8.6" "-" COEFFS 0 1 0 0 0 0.00002 /end COMPU_METHOD
/begin COMPU_METHOD COMP_0286_S "0.00002X-0.99-" RAT_FUNC "%8.6" "-" COEFFS 0 1 0.99 0 0 0.00002 /end COMPU_METHOD
/begin COMPU_METHOD COMP_0287_S "0.00002X-1NULL" RAT_FUNC "%8.6" "NULL" COEFFS 0 1 1 0 0 0.00002 /end COMPU_METHOD
/begin COMPU_METHOD COMP_0288_S "0.0004-" RAT_FUNC "%8.5" "-" COEFFS 0 1 0 0 0 0.0004 /end COMPU_METHOD
/begin COMPU_METHOD COMP_0289_S "0.0004X-20-" RAT_FUNC "%8.5" "-" COEFFS 0 1 20 0 0 0.0004 /end COMPU_METHOD
/begin COMPU_METHOD COMP_0290_S "0.0004X-20NULL" RAT_FUNC "%8.5" "NULL" COEFFS 0 1 20 0 0 0.0004 /end COMPU_METHOD
/begin COMPU_METHOD COMP_0291_S "0.0001X-0.99-" RAT_FUNC "%8.5" "-" COEFFS 0 1 0.99 0 0 0.0001 /end COMPU_METHOD
/begin COMPU_METHOD COMP_0292_S "0.0001-" RAT_FUNC "%8.5" "-" COEFFS 0 1 6 0 0 0.0001 /end COMPU_METHOD
/begin COMPU_METHOD COMP_0293_S "1/65536A" RAT_FUNC "%8.6" "A" COEFFS 0 1 0 0 0 0.0000152588 /end COMPU_METHOD
/begin COMPU_METHOD COMP_0294_S "0.00002-" RAT_FUNC "%8.6" "-" COEFFS 0 1 0 0 0 0.00002 /end COMPU_METHOD
/begin COMPU_METHOD COMP_0295_S "0.01km/h/s" RAT_FUNC "%8.3" "km/h/s" COEFFS 0 1 0 0 0 0.01 /end COMPU_METHOD
/begin COMPU_METHOD COMP_0296_S "0.01km/h/s" RAT_FUNC "%8.3" "km/h/s" COEFFS 0 1 0 0 0 0.01 /end COMPU_METHOD
/begin COMPU_METHOD COMP_0297_S "0.001-" RAT_FUNC "%8.4" "-" COEFFS 0 1 0 0 0 0.001 /end COMPU_METHOD
/begin COMPU_METHOD COMP_0360 "2Km/h" RAT_FUNC "%8.2" "Km/h" COEFFS 0 1 0 0 0 2 /end COMPU_METHOD
/begin COMPU_METHOD COMP_0364 "2km/h" RAT_FUNC "%8.2" "km/h" COEFFS 0 1 0 0 0 2 /end COMPU_METHOD
/begin COMPU_METHOD COMP_0298_S "36*2^-22-" RAT_FUNC "%8.6" "-" COEFFS 0 1 0 0 0 0.00000858307 /end COMPU_METHOD
/begin COMPU_METHOD COMP_0299_S "6/256X+6Ω" RAT_FUNC "%8.3" "Ω" COEFFS 0 1 -6 0 0 0.0234375 /end COMPU_METHOD
/begin COMPU_METHOD COMP_0245 "X-64deg" RAT_FUNC "%8.2" "deg" COEFFS 0 1 64 0 0 1 /end COMPU_METHOD
/begin COMPU_METHOD COMP_0300_S "0.5degCA/se" RAT_FUNC "%8.2" "degCA/se" COEFFS 0 1 0 0 0 0.5 /end COMPU_METHOD
/begin COMPU_METHOD COMP_0053 "1ms" RAT_FUNC "%8.2" "ms" COEFFS 0 1 0 0 0 1 /end COMPU_METHOD
/begin COMPU_METHOD COMP_0366 "100μS" RAT_FUNC "%8.2" "μS" COEFFS 0 1 0 0 0 100 /end COMPU_METHOD
/begin COMPU_METHOD COMP_0301_S "100μs" RAT_FUNC "%8.2" "μs" COEFFS 0 1 0 0 0 100 /end COMPU_METHOD
/begin COMPU_METHOD COMP_0302_S "0.01V/A" RAT_FUNC "%8.3" "V/A" COEFFS 0 1 0 0 0 0.01 /end COMPU_METHOD
/begin COMPU_METHOD COMP_0303_S "2/255-" RAT_FUNC "%8.4" "-" COEFFS 0 1 0 0 0 0.00784313 /end COMPU_METHOD
/begin COMPU_METHOD COMP_0304_S "0.000016kg/s" RAT_FUNC "%8.6" "kg/s" COEFFS 0 1 0 0 0 0.000016 /end COMPU_METHOD
/begin COMPU_METHOD COMP_0305_S "2.56mg" RAT_FUNC "%8.2" "mg" COEFFS 0 1 0 0 0 2.56 /end COMPU_METHOD
/begin COMPU_METHOD COMP_0306_S "0.001ｋｊ/100" RAT_FUNC "%8.4" "ｋｊ/100" COEFFS 0 1 0 0 0 0.001 /end COMPU_METHOD
/begin COMPU_METHOD COMP_0307_S "2/256degADV/d" RAT_FUNC "%8.4" "degADV/d" COEFFS 0 1 1 0 0 0.0078125 /end COMPU_METHOD
/begin COMPU_METHOD COMP_0226 "0.1Nm" RAT_FUNC "%8.2" "Nm" COEFFS 0 1 3276.8 0 0 0.1 /end COMPU_METHOD
/begin COMPU_METHOD COMP_0308_S "8E-006kg/s" RAT_FUNC "%8.6" "kg/s" COEFFS 0 1 0 0 0 0.000008 /end COMPU_METHOD
/begin COMPU_METHOD COMP_0309_S "0.5X-27.5%" RAT_FUNC "%8.2" "%" COEFFS 0 1 27.5 0 0 0.5 /end COMPU_METHOD
/begin COMPU_METHOD COMP_0310_S "160μs" RAT_FUNC "%8.2" "μs" COEFFS 0 1 0 0 0 160 /end COMPU_METHOD
/begin COMPU_METHOD COMP_0311_S "0.000008kg/s" RAT_FUNC "%8.6" "kg/s" COEFFS 0 1 0.262144 0 0 0.000008 /end COMPU_METHOD
/begin COMPU_METHOD COMP_0312_S "2^-2kPa" RAT_FUNC "%8.2" "kPa" COEFFS 0 1 8192 0 0 0.25 /end COMPU_METHOD
/begin COMPU_METHOD COMP_0246 "100/16%" RAT_FUNC "%8.2" "%" COEFFS 0 1 0 0 0 6.25 /end COMPU_METHOD
/begin COMPU_METHOD COMP_0313_S "2^-13-" RAT_FUNC "%8.5" "-" COEFFS 0 1 0 0 0 0.00012207 /end COMPU_METHOD
/begin COMPU_METHOD COMP_0314_S "80/256mV" RAT_FUNC "%8.2" "mV" COEFFS 0 1 0 0 0 0.3125 /end COMPU_METHOD
/begin COMPU_METHOD COMP_0315_S "1N" RAT_FUNC "%8.2" "N" COEFFS 0 1 32768 0 0 1 /end COMPU_METHOD
/begin COMPU_METHOD COMP_0316_S "2^-9%" RAT_FUNC "%8.4" "%" COEFFS 0 1 0 0 0 0.00195313 /end COMPU_METHOD
/begin COMPU_METHOD COMP_0317_S "2^-5kPa" RAT_FUNC "%8.3" "kPa" COEFFS 0 1 0 0 0 0.03125 /end COMPU_METHOD
/begin COMPU_METHOD COMP_0318_S "11/2^(32+" RAT_FUNC "%8.2" "1/2^(32+" COEFFS 0 1 0 0 0 1 /end COMPU_METHOD
/begin COMPU_METHOD COMP_0319_S "20mV" RAT_FUNC "%8.2" "mV" COEFFS 0 1 -10000 0 0 20 /end COMPU_METHOD
/begin COMPU_METHOD COMP_0320_S "0.25A" RAT_FUNC "%8.2" "A" COEFFS 0 1 0 0 0 0.25 /end COMPU_METHOD
/begin COMPU_METHOD COMP_0321_S "fixed axis ─" RAT_FUNC "%8.2" "─" COEFFS 0 1 0 0 0 1 /end COMPU_METHOD
/begin COMPU_METHOD COMP_0253 "16/256X10^-3m^3/sec" RAT_FUNC "%8.6" "m^3/sec" COEFFS 0 1 0 0 0 0.0000625 /end COMPU_METHOD
/begin COMPU_METHOD COMP_0181 "1/32－" RAT_FUNC "%8.3" "－" COEFFS 0 1 0 0 0 0.03125 /end COMPU_METHOD
/begin COMPU_METHOD COMP_0357 "0.44deg" RAT_FUNC "%8.2" "deg" COEFFS 0 1 0 0 0 0.44 /end COMPU_METHOD
/begin COMPU_METHOD COMP_0260 "0.1－" RAT_FUNC "%8.2" "－" COEFFS 0 1 0 0 0 0.1 /end COMPU_METHOD
/begin COMPU_METHOD COMP_0322_S "0.01Nm/rpm" RAT_FUNC "%8.3" "Nm/rpm" COEFFS 0 1 0 0 0 0.01 /end COMPU_METHOD
/begin COMPU_METHOD COMP_0323_S "0.8km/h" RAT_FUNC "%8.2" "km/h" COEFFS 0 1 0 0 0 0.8 /end COMPU_METHOD
/begin COMPU_METHOD COMP_0324_S "fixed axis -" RAT_FUNC "%8.2" "-" COEFFS 0 1 -1 0 0 1 /end COMPU_METHOD
/begin COMPU_METHOD COMP_0325_S "fixed axis deg" RAT_FUNC "%8.2" "deg" COEFFS 0 1 0 0 0 10.56 /end COMPU_METHOD
/begin COMPU_METHOD COMP_0326_S "fixed axis rpm" RAT_FUNC "%8.2" "rpm" COEFFS 0 1 0 0 0 1000 /end COMPU_METHOD
/begin COMPU_METHOD COMP_0327_S "0.002-" RAT_FUNC "%8.4" "-" COEFFS 0 1 65.536 0 0 0.002 /end COMPU_METHOD
/begin COMPU_METHOD COMP_0328_S "0.0078125*X-256ｋPa" RAT_FUNC "%8.4" "ｋPa" COEFFS 0 1 256 0 0 0.0078125 /end COMPU_METHOD
/begin COMPU_METHOD COMP_0329_S "fixed axis rpm" RAT_FUNC "%8.2" "rpm" COEFFS 0 1 0 0 0 800 /end COMPU_METHOD
/begin COMPU_METHOD COMP_0330_S "fixed axis %" RAT_FUNC "%8.2" "%" COEFFS 0 1 0 0 0 12.5 /end COMPU_METHOD
/begin COMPU_METHOD COMP_0331_S "0.5L/min/de" RAT_FUNC "%8.2" "L/min/de" COEFFS 0 1 0 0 0 0.5 /end COMPU_METHOD
/begin COMPU_METHOD COMP_0332_S "2^-11deg" RAT_FUNC "%8.5" "deg" COEFFS 0 1 31.99951 0 0 0.000488281 /end COMPU_METHOD
/begin COMPU_METHOD COMP_0258 "100/2048%" RAT_FUNC "%8.3" "%" COEFFS 0 1 0 0 0 0.048828125 /end COMPU_METHOD
/begin COMPU_METHOD COMP_0333_S "fixed axis ℃" RAT_FUNC "%8.2" "℃" COEFFS 0 1 40 0 0 20 /end COMPU_METHOD
/begin COMPU_METHOD COMP_0279 "100/64%" RAT_FUNC "%8.3" "%" COEFFS 0 1 0 0 0 0.015625 /end COMPU_METHOD
/begin COMPU_METHOD COMP_0334_S "100/4096%" RAT_FUNC "%8.3" "%" COEFFS 0 1 0 0 0 0.0244141 /end COMPU_METHOD
/begin COMPU_METHOD COMP_0335_S "100/65280%" RAT_FUNC "%8.4" "%" COEFFS 0 1 0 0 0 0.001531862 /end COMPU_METHOD
/begin COMPU_METHOD COMP_0336_S "1L/min" RAT_FUNC "%8.2" "L/min" COEFFS 0 1 32768 0 0 1 /end COMPU_METHOD
/begin COMPU_METHOD COMP_0337_S "1/256deg/℃" RAT_FUNC "%8.4" "deg/℃" COEFFS 0 1 0 0 0 0.00390625 /end COMPU_METHOD
/begin COMPU_METHOD COMP_0338_S "2^-231/((kg/m" RAT_FUNC "%8.6" "1/((kg/m" COEFFS 0 1 0 0 0 0.000000119209 /end COMPU_METHOD
/begin COMPU_METHOD COMP_0329 "2/256%" RAT_FUNC "%8.4" "%" COEFFS 0 1 0 0 0 0.0078125 /end COMPU_METHOD
/begin COMPU_METHOD COMP_0271 "100/128/256%" RAT_FUNC "%8.4" "%" COEFFS 0 1 0 0 0 0.003051758 /end COMPU_METHOD
/begin COMPU_METHOD COMP_0339_S "1degCA" RAT_FUNC "%8.2" "degCA" COEFFS 0 1 32768 0 0 1 /end COMPU_METHOD
/begin COMPU_METHOD COMP_0340_S "0.3degCA/se" RAT_FUNC "%8.2" "degCA/se" COEFFS 0 1 0 0 0 0.3 /end COMPU_METHOD
/begin COMPU_METHOD COMP_0341_S "0.1degCA/se" RAT_FUNC "%8.2" "degCA/se" COEFFS 0 1 0 0 0 0.1 /end COMPU_METHOD
/begin COMPU_METHOD COMP_0342_S "0.00003sec" RAT_FUNC "%8.6" "sec" COEFFS 0 1 0 0 0 0.00003 /end COMPU_METHOD
/begin COMPU_METHOD COMP_0343_S "1/65535A" RAT_FUNC "%8.6" "A" COEFFS 0 1 0 0 0 0.000015259 /end COMPU_METHOD
/begin COMPU_METHOD COMP_0344_S "(1/65535)X-1A" RAT_FUNC "%8.6" "A" COEFFS 0 1 1 0 0 0.000015259 /end COMPU_METHOD
/begin COMPU_METHOD COMP_0345_S "fixed axis ℃" RAT_FUNC "%8.2" "℃" COEFFS 0 1 50 0 0 16 /end COMPU_METHOD
/begin COMPU_METHOD COMP_0346_S "0.002/4096-" RAT_FUNC "%8.6" "-" COEFFS 0 1 0 0 0 0.000000488281 /end COMPU_METHOD
/begin COMPU_METHOD COMP_0347_S "fixed axis rpm" RAT_FUNC "%8.2" "rpm" COEFFS 0 1 0 0 0 400 /end COMPU_METHOD
/begin COMPU_METHOD COMP_0348_S "fixed axis ℃" RAT_FUNC "%8.2" "℃" COEFFS 0 1 40 0 0 10 /end COMPU_METHOD
/* RECORD_LAYOUT ------------------------------------------------------ */
/begin RECORD_LAYOUT REC_UBYTE_C FNC_VALUES 1 UBYTE COLUMN_DIR DIRECT /end RECORD_LAYOUT
/begin RECORD_LAYOUT REC_SWORD_C FNC_VALUES 1 SWORD COLUMN_DIR DIRECT /end RECORD_LAYOUT
/begin RECORD_LAYOUT REC_UWORD_C FNC_VALUES 1 UWORD COLUMN_DIR DIRECT /end RECORD_LAYOUT
/begin RECORD_LAYOUT REC_SBYTE_C FNC_VALUES 1 SBYTE COLUMN_DIR DIRECT /end RECORD_LAYOUT
/begin RECORD_LAYOUT REC_SLONG_C FNC_VALUES 1 SLONG COLUMN_DIR DIRECT /end RECORD_LAYOUT
/begin RECORD_LAYOUT REC_ULONG_C FNC_VALUES 1 ULONG COLUMN_DIR DIRECT /end RECORD_LAYOUT
/begin RECORD_LAYOUT REC_AXIS_UBYTE AXIS_PTS_X 1 UBYTE INDEX_INCR DIRECT /end RECORD_LAYOUT
/begin RECORD_LAYOUT REC_AXIS_UWORD AXIS_PTS_X 1 UWORD INDEX_INCR DIRECT /end RECORD_LAYOUT
/end MODULE
/end PROJECT
